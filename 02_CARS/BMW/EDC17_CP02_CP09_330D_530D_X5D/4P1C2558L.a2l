ASAP2_VERSION 1 4
/begin PROJECT P_558 "EDC17_CP02"
/begin HEADER "" VERSION "V1C1" PROJECT_NO P_558 /end HEADER
/begin MODULE DIM ""
/begin MOD_COMMON "" BYTE_ORDER MSB_LAST ALIGNMENT_BYTE 1 ALIGNMENT_WORD 2 ALIGNMENT_LONG 4 ALIGNMENT_FLOAT32_IEEE 4 /end MOD_COMMON
/begin CHARACTERISTIC K_MSANKS "Drehzahlschwelle für dei Kraftschlusserkennung" VALUE 0x80043CD8 TKW_VV_VV_SW 100.0 Def_n_sw_q1p0 -32768.0000 32767.0000 /end CHARACTERISTIC
/begin CHARACTERISTIC K_MSANST "Drehzahlschwelle über der, der Startvorgang auch ohne EAs weiter läuft" VALUE 0x80043CDA TKW_VV_VV_SW 100.0 Def_n_sw_q1p0 -32768.0000 32767.0000 /end CHARACTERISTIC
/begin CHARACTERISTIC K_MSADVKS "Geschwindigkeitsdelta für die Erkennung Kraftschluss" VALUE 0x80043CDC TKW_VV_VV_UW 100.0 Def_v_uw_q1p0 0.0 65535.0000 /end CHARACTERISTIC
/begin CHARACTERISTIC K_MSAVFT "Geschwindigkeitschwelle für die Aktivierung nach Fahrertür auf" VALUE 0x80043CDE TKW_VV_VV_UW 100.0 Def_v_uw_q1p0 0.0 65535.0000 /end CHARACTERISTIC
/begin CHARACTERISTIC S_MSABS "Schalter für MSA Betriebsstrategie" VALUE 0x80043CE0 TKW_VV_VV_UB 100.0 Def_dez_ub_q1 0.0 255.0000 /end CHARACTERISTIC
/begin CHARACTERISTIC S_MSABSERR "Schalter Fehler die MSA verhindern abschalten" VALUE 0x80043CE1 TKW_VV_VV_UB 100.0 Def_dez_ub_q1 0.0 255.0000 /end CHARACTERISTIC
/begin CHARACTERISTIC S_PMMSAEA "Schalter PM EA abschalten" VALUE 0x80043CE2 TKW_VV_VV_UB 100.0 Def_dez_ub_q1 0.0 255.0000 /end CHARACTERISTIC
/begin CHARACTERISTIC K_MSAPWGE "Konstante PWG-Schwelle für MSA-Start" VALUE 0x80043CE4 TKW_VV_VV_SW 100.0 Def_wdk_sw_q0p0244 -800.0000 799.9755 FORMAT "%5.2" /end CHARACTERISTIC
/begin CHARACTERISTIC K_MSAVE "Konstante für Erkennung Fahrzeug rollt" VALUE 0x80043CE6 TKW_VV_VV_UW 100.0 Def_v_uw_q1p0 0.0 65535.0000 /end CHARACTERISTIC
/begin CHARACTERISTIC K_MSAPBREMSU "Konstante Bremsunterdruckschwelle für MSA" VALUE 0x80043CE3 TKW_VV_VV_UB 100.0 Def_p_ub_q0p39 0.0 99.6093 /end CHARACTERISTIC
/begin CHARACTERISTIC K_MSAMANTD "Konstante Verzögerungsszeit für MSA-Start nach Motor aus" VALUE 0x80043CE8 TKW_VV_VV_UB 100.0 Def_td_ub_q0p1 0.0 25.5000 /end CHARACTERISTIC
/begin CHARACTERISTIC K_MSASTTO "Timeout für den Startversuch" VALUE 0x80043CE9 TKW_VV_VV_UB 100.0 Def_td_ub_q0p1 0.0 25.5000 /end CHARACTERISTIC
/begin CHARACTERISTIC K_NGMAXLERN "Obere Signalgrenze fürs Nullgangposition-Lernen" VALUE 0x80043EE8 TKW_VV_VV_UW 100.0 Def_tv_uw_q0p01 0.0 655.3500 FORMAT "%5.2" /end CHARACTERISTIC
/begin CHARACTERISTIC K_NGMINLERN "Untere Signalgrenze fürs Nullgangposition-Lernen" VALUE 0x80043EEA TKW_VV_VV_UW 100.0 Def_tv_uw_q0p01 0.0 655.3500 FORMAT "%5.2" /end CHARACTERISTIC
/begin CHARACTERISTIC K_NGOFFMAX "Offset nach oben für den Nullgangbereich" VALUE 0x80043EEC TKW_VV_VV_UW 100.0 Def_tv_uw_q0p01 0.0 655.3500 FORMAT "%5.2" /end CHARACTERISTIC
/begin CHARACTERISTIC K_NGOFFMIN "Offset nach unten für den Nullgangbereich" VALUE 0x80043EEE TKW_VV_VV_UW 100.0 Def_tv_uw_q0p01 0.0 655.3500 FORMAT "%5.2" /end CHARACTERISTIC
/begin CHARACTERISTIC K_NGSP "Min Spannung fürs Nullgangposition-Lernen" VALUE 0x80043EF0 TKW_VV_VV_UW 100.0 Def_u_uw_q0p0942 0.0 6173.3970 FORMAT "%4.1" /end CHARACTERISTIC
/begin CHARACTERISTIC K_NGSTABIL "Delta für die Stabilitätskontrolle Signal beim Lernen" VALUE 0x80043EF2 TKW_VV_VV_UW 100.0 Def_tv_uw_q0p01 0.0 655.3500 FORMAT "%5.2" /end CHARACTERISTIC
/begin CHARACTERISTIC K_NGTK "Intevall für die Stabilitätskontrolle" VALUE 0x80043EF4 TKW_VV_VV_UW 100.0 Def_td10ms_uw_b655p35 0.0 655.3500 FORMAT "%5.2" /end CHARACTERISTIC
/begin CHARACTERISTIC K_NGTSTL "Zeit über die, der Sensorwert stabil bleiben muss" VALUE 0x80043EF6 TKW_VV_VV_UW 100.0 Def_td10ms_uw_b655p35 0.0 655.3500 FORMAT "%5.2" /end CHARACTERISTIC
/begin CHARACTERISTIC S_NGANG "Codeword Nullgangsensor" VALUE 0x80043EF8 TKW_VV_VV_UB 100.0 Def_dez_ub_q1 0.0 255.0000 /end CHARACTERISTIC
/begin CHARACTERISTIC K_IABGLMOT "Konstante Abgleichstrom Motor" VALUE 0x80040110 TKW_VV_VV_SW 100.0 Def_i_sw_q0p001 -32.7680 32.7670 FORMAT "%6.3" /end CHARACTERISTIC
/begin CHARACTERISTIC K_IABGLNL "Konstante Abgleichstrom Kl. 15" VALUE 0x80040112 TKW_VV_VV_SW 100.0 Def_i_sw_q0p001 -32.7680 32.7670 FORMAT "%6.3" /end CHARACTERISTIC
/begin CHARACTERISTIC K_IABGLST "Konstante Abgleichstrom Start" VALUE 0x80040114 TKW_VV_VV_SW 100.0 Def_i_sw_q0p001 -32.7680 32.7670 FORMAT "%6.3" /end CHARACTERISTIC
/begin CHARACTERISTIC K_IKEINESA "Konstante Strom wenn keine SA" VALUE 0x80040116 TKW_VV_VV_SW 100.0 Def_i_sw_q0p001 -32.7680 32.7670 FORMAT "%6.3" /end CHARACTERISTIC
/begin CHARACTERISTIC K_CRENGOF "" VALUE 0x80040118 TKW_VV_VV_UW 100.0 Def_i_uw_q0p0635 0.0 4095.9375 FORMAT "%6.3" /end CHARACTERISTIC
/begin CHARACTERISTIC K_CRVVTNOT "Wert vvt_iges bei vvt_es Fehlersignal" VALUE 0x8004011A TKW_VV_VV_UW 100.0 Def_i_uw_q0p0635 0.0 4095.9375 FORMAT "%6.3" /end CHARACTERISTIC
/begin CHARACTERISTIC K_CRVVTOF "" VALUE 0x8004011C TKW_VV_VV_UW 100.0 Def_i_uw_q0p0635 0.0 4095.9375 FORMAT "%6.3" /end CHARACTERISTIC
/begin CHARACTERISTIC KL_ELTEMP39 "Temperaturfaktor Elüfter" CURVE 0x8004011E TKL_SW_VV_UW 100.0 Def_f_uw_b512 0.0 511.9921
 /begin AXIS_DESCR STD_AXIS Tans Def_t_sw_q0p1 6 -3276.8000 3276.7000 FORMAT "%4.1" /end AXIS_DESCR
 FORMAT "%6.3" /end CHARACTERISTIC
/begin CHARACTERISTIC KL_ELUB60 "" CURVE 0x80040138 TKL_UW_VV_UW 100.0 Def_f_uw_b512 0.0 511.9921 /begin AXIS_DESCR STD_AXIS Ub Def_u_uw_q0p0942 5 0.0 6173.3970 FORMAT "%4.1" /end AXIS_DESCR FORMAT "%6.3" /end CHARACTERISTIC
/begin CHARACTERISTIC KL_IABGLST "Abgleichstrom Start" CURVE 0x8004014E TKL_UW_VV_UB 100.0 Def_f_ub_b8 0.0 7.9687 /begin AXIS_DESCR STD_AXIS Ub Def_u_uw_q0p0942 5 0.0 6173.3970 FORMAT "%4.1" /end AXIS_DESCR /end CHARACTERISTIC
/begin CHARACTERISTIC KL_IABGLMOT "Abgleichstrom Motor" CURVE 0x80040160 TKL_UW_VV_UB 100.0 Def_f_ub_b8 0.0 7.9687 /begin AXIS_DESCR STD_AXIS Ub Def_u_uw_q0p0942 5 0.0 6173.3970 FORMAT "%4.1" /end AXIS_DESCR /end CHARACTERISTIC
/begin CHARACTERISTIC KL_ELUB39 "" CURVE 0x80040172 TKL_UW_VV_UW 100.0 Def_f_uw_b512 0.0 511.9921 /begin AXIS_DESCR STD_AXIS Ub Def_u_uw_q0p0942 5 0.0 6173.3970 FORMAT "%4.1" /end AXIS_DESCR FORMAT "%6.3" /end CHARACTERISTIC
/begin CHARACTERISTIC KL_ELTEMP60 "Temperaturfaktor Elüfter" CURVE 0x80040188 TKL_SW_VV_UW 100.0 Def_f_uw_b512 0.0 511.9921
 /begin AXIS_DESCR STD_AXIS Tans Def_t_sw_q0p1 6 -3276.8000 3276.7000 FORMAT "%4.1" /end AXIS_DESCR
 FORMAT "%6.3" /end CHARACTERISTIC
/begin CHARACTERISTIC KL_ELSLS "Kennlinie E-Lüfter Strom" CURVE 0x800401A2 TKL_UW_VV_UW 100.0 Def_i_uw_q0p0635 0.0 255.0000 /begin AXIS_DESCR STD_AXIS Ub Def_u_uw_q0p0942 3 0.0 6173.3970 FORMAT "%4.1" /end AXIS_DESCR FORMAT "%6.3" /end CHARACTERISTIC
/begin CHARACTERISTIC KL_IABGLNL "Abgleichstrom Kl. 15" CURVE 0x800401B0 TKL_UW_VV_UB 100.0 Def_f_ub_b8 0.0 7.9687 /begin AXIS_DESCR STD_AXIS Ub Def_u_uw_q0p0942 5 0.0 6173.3970 FORMAT "%4.1" /end AXIS_DESCR /end CHARACTERISTIC
/begin CHARACTERISTIC KF_ELUPWM60 "Strom E-Lüfter über pwm und ub" MAP 0x800401C2 TKF_UW_UB_UW 100.0 Def_i_uw_q0p0635 0.0 64.0000 /begin AXIS_DESCR STD_AXIS L_pwmout Def_tv_ub_q0p390625 8 0.0 99.6093 /end AXIS_DESCR /begin AXIS_DESCR STD_AXIS NO_INPUT_QUANTITY Def_v_uw_q1p0 8 0.0 360.0000 /end AXIS_DESCR FORMAT "%6.3" /end CHARACTERISTIC
/begin CHARACTERISTIC KF_ELUPWM39 "Strom E-Lüfter über pwm und ub" MAP 0x8004025C TKF_UW_UB_UW 100.0 Def_i_uw_q0p0635 0.0 64.0000 /begin AXIS_DESCR STD_AXIS L_pwmout Def_tv_ub_q0p390625 8 0.0 99.6093 /end AXIS_DESCR /begin AXIS_DESCR STD_AXIS NO_INPUT_QUANTITY Def_v_uw_q1p0 8 0.0 360.0000 /end AXIS_DESCR FORMAT "%6.3" /end CHARACTERISTIC
/begin CHARACTERISTIC K_DFRUTYP "DF-Rückschaltungstyp für LLR-Anhebung" VALUE 0x800402F6 TKW_VV_VV_UB 100.0 Def_st_ub_q1 0.0 255.0000 /end CHARACTERISTIC
/begin CHARACTERISTIC K_GENDFVORHS "Zeitkonstante Filterung DF Vorhersage" VALUE 0x800402F7 TKW_VV_VV_UB 100.0 Def_f_ub_b1 0.0 0.9960 /end CHARACTERISTIC
/begin CHARACTERISTIC K_IGENLLRANH "Generatorstromabstand für LL-Anhebung" VALUE 0x800402F8 TKW_VV_VV_UB 100.0 Def_i_ub_q1 0.0 254.0000 /end CHARACTERISTIC
/begin CHARACTERISTIC K_LLRABS_DF "DF-Schwelle für LL-Absenkung" VALUE 0x800402F9 TKW_VV_VV_UB 100.0 Def_f_ub_b100 0.0 99.6093 /end CHARACTERISTIC
/begin CHARACTERISTIC K_LLRANH_DF "DF-Schwelle für LL-Anhebung" VALUE 0x800402FA TKW_VV_VV_UB 100.0 Def_f_ub_b100 0.0 99.6093 /end CHARACTERISTIC
/begin CHARACTERISTIC K_NTWBGLLGEN "Notlaufwert Leerlaufanhebung bei Generatorfehler" VALUE 0x800402FB TKW_VV_VV_UB 100.0 Def_st_ub_q1 0.0 1.0000 /end CHARACTERISTIC
/begin CHARACTERISTIC K_PRELLDFAH "Prellzeit für LLR-Anhebung" VALUE 0x800402FC TKW_VV_VV_UB 100.0 Def_td_ub_q0p1 0.0 25.5000 /end CHARACTERISTIC
/begin CHARACTERISTIC K_PRELLDFRF "Prellzeit für LLR-Absenkung" VALUE 0x800402FD TKW_VV_VV_UB 100.0 Def_td_ub_q0p1 0.0 25.5000 /end CHARACTERISTIC
/begin CHARACTERISTIC K_QMIN "Minimale Einspritzmenge" VALUE 0x800402FE TKW_VV_VV_SW 100.0 Def_me_sw_q0p01 -327.6800 327.6700 FORMAT "%6.3" /end CHARACTERISTIC
/begin CHARACTERISTIC K_BRWTKINT "BRWT K-Integrator" VALUE 0x80040300 TKW_VV_VV_UW 100.0 Def_dez_uw_q1 0.0 65535.0000 /end CHARACTERISTIC
/begin CHARACTERISTIC K_BRWTDA "Berechnete Wandtemp oder Diff zu MAP" VALUE 0x80040302 TKW_VV_VV_UB 100.0 ident 0.0 255.0000 /end CHARACTERISTIC
/begin CHARACTERISTIC K_ENGSTSTRT "Engine Status Start warten auf Startabwurf" VALUE 0x80040303 TKW_VV_VV_UB 100.0 Def_dez_ub_q1 0.0 255.0000 /end CHARACTERISTIC
/begin CHARACTERISTIC S_BRWT "Aktivierung der Funktion Brennraumwandtemperatur" VALUE 0x80040304 TKW_VV_VV_UB 100.0 ident 0.0 255.0000 /end CHARACTERISTIC
/begin CHARACTERISTIC KL_COOLING "KL Abkuehlverhalten" CURVE 0x80040306 TKL_UW_VV_UB 100.0 Def_f_ub_b1 0.0 0.9960 /begin AXIS_DESCR STD_AXIS Tn_abstell Def_dez_uw_q1 6 0.0 65535.0000 /end AXIS_DESCR /end CHARACTERISTIC
/begin CHARACTERISTIC KF_TAIR_MHFM "KF deltaT - TWand-Tans - Ml" MAP 0x8004031A TKF_SW_SW_SW 100.0 Def_t_sw_q0p01 -327.6800 327.6700
 /begin AXIS_DESCR STD_AXIS NO_INPUT_QUANTITY Def_t_sw_q0p01 5 -327.6800 327.6700 FORMAT "%5.2" /end AXIS_DESCR
 /begin AXIS_DESCR STD_AXIS Ml Def_ml_sw_q0p1 5 -3276.8000 3276.7000 FORMAT "%5.2" /end AXIS_DESCR
 FORMAT "%5.2" /end CHARACTERISTIC
/begin CHARACTERISTIC KF_DTW_TWA "KF deltaT - Nkw - TWand-Tans" MAP 0x80040362 TKF_SW_SW_SW 100.0 Def_t_sw_q0p01 -327.6800 327.6700 /begin AXIS_DESCR STD_AXIS Nkw Def_n_sw_q1p0 5 -32768.0000 32767.0000 /end AXIS_DESCR
 /begin AXIS_DESCR STD_AXIS NO_INPUT_QUANTITY Def_t_sw_q0p01 5 -327.6800 327.6700 FORMAT "%5.2" /end AXIS_DESCR
 FORMAT "%5.2" /end CHARACTERISTIC
/begin CHARACTERISTIC KF_TAIRMHFMS "KF deltaT - TWand-Tans - Ml im Schub" MAP 0x800403AA TKF_SW_SW_SW 100.0 Def_t_sw_q0p01 -327.6800 327.6700
 /begin AXIS_DESCR STD_AXIS NO_INPUT_QUANTITY Def_t_sw_q0p01 5 -327.6800 327.6700 FORMAT "%5.2" /end AXIS_DESCR
 /begin AXIS_DESCR STD_AXIS Ml Def_ml_sw_q0p1 5 -3276.8000 3276.7000 FORMAT "%5.2" /end AXIS_DESCR
 FORMAT "%5.2" /end CHARACTERISTIC
/begin CHARACTERISTIC KF_DTW_QN "KF deltaT - Me  - Nkw" MAP 0x800403F2 TKF_SW_SW_SW 100.0 Def_t_sw_q0p01 -327.6800 327.6700 /begin AXIS_DESCR STD_AXIS Nkw Def_n_sw_q1p0 5 -32768.0000 32767.0000 /end AXIS_DESCR
 /begin AXIS_DESCR STD_AXIS Me_ist Def_me_sw_q0p01 5 -327.6800 327.6700 FORMAT "%6.3" /end AXIS_DESCR
 FORMAT "%5.2" /end CHARACTERISTIC
/begin CHARACTERISTIC KF_TWPST_MAP "KF TWand - Nkw - Me von Prüfstand" MAP 0x8004043A TKF_SW_SW_SW 100.0 Def_t_sw_q0p1 -3276.8000 3276.7000 /begin AXIS_DESCR STD_AXIS Nkw Def_n_sw_q1p0 16 -32768.0000 32767.0000 /end AXIS_DESCR
 /begin AXIS_DESCR STD_AXIS Me_ist Def_me_sw_q0p01 16 -327.6800 327.6700 FORMAT "%6.3" /end AXIS_DESCR
 FORMAT "%4.1" /end CHARACTERISTIC
/begin CHARACTERISTIC K_APPCO2M2L "" VALUE 0x8004067C TKW_VV_VV_SW 100.0 Def_f_sw_b100 -100.0000 99.9969 FORMAT "%6.3" /end CHARACTERISTIC
/begin CHARACTERISTIC K_DSOCABSAV1 "" VALUE 0x8004067E TKW_VV_VV_SW 100.0 Def_f_sw_b100 -100.0000 99.9969 FORMAT "%6.3" /end CHARACTERISTIC
/begin CHARACTERISTIC K_DSOCABSAV2 "" VALUE 0x80040680 TKW_VV_VV_SW 100.0 Def_f_sw_b100 -100.0000 99.9969 FORMAT "%6.3" /end CHARACTERISTIC
/begin CHARACTERISTIC K_DSOCABSEA1 "" VALUE 0x80040682 TKW_VV_VV_SW 100.0 Def_f_sw_b100 -100.0000 99.9969 FORMAT "%6.3" /end CHARACTERISTIC
/begin CHARACTERISTIC K_DSOCABSEA2 "" VALUE 0x80040684 TKW_VV_VV_SW 100.0 Def_f_sw_b100 -100.0000 99.9969 FORMAT "%6.3" /end CHARACTERISTIC
/begin CHARACTERISTIC K_IGRDSOC_MX "" VALUE 0x80040686 TKW_VV_VV_SW 100.0 Def_f_sw_b100 -100.0000 99.9969 FORMAT "%6.3" /end CHARACTERISTIC
/begin CHARACTERISTIC K_IGRDSOC_OS "" VALUE 0x80040688 TKW_VV_VV_SW 100.0 Def_f_sw_b100 -100.0000 99.9969 FORMAT "%6.3" /end CHARACTERISTIC
/begin CHARACTERISTIC K_IBZYKIGR "" VALUE 0x8004068A TKW_VV_VV_UW 100.0 Def_i_uw_q0p08_o200 -200.0000 5042.8000 FORMAT "%6.3" /end CHARACTERISTIC
/begin CHARACTERISTIC K_IB_ZYKMSA "" VALUE 0x8004068C TKW_VV_VV_UW 100.0 Def_i_uw_q0p08_o200 -200.0000 5042.8000 FORMAT "%6.3" /end CHARACTERISTIC
/begin CHARACTERISTIC K_APPMSAAV "" VALUE 0x8004068E TKW_VV_VV_UB 100.0 Identity 0.0 1.0000 /end CHARACTERISTIC
/begin CHARACTERISTIC K_APPMSAEA "" VALUE 0x8004068F TKW_VV_VV_UB 100.0 Identity 0.0 1.0000 /end CHARACTERISTIC
/begin CHARACTERISTIC K_APPMSAEACC "" VALUE 0x80040690 TKW_VV_VV_UB 100.0 Identity 0.0 1.0000 /end CHARACTERISTIC
/begin CHARACTERISTIC K_DEAKMSA "" VALUE 0x80040691 TKW_VV_VV_UB 100.0 Identity 0.0 1.0000 /end CHARACTERISTIC
/begin CHARACTERISTIC K_EDMSAONW "" VALUE 0x80040692 TKW_VV_VV_UB 100.0 Identity 0.0 1.0000 /end CHARACTERISTIC
/begin CHARACTERISTIC K_IGRHIGHEN "" VALUE 0x80040693 TKW_VV_VV_UB 100.0 Identity 0.0 1.0000 /end CHARACTERISTIC
/begin CHARACTERISTIC K_IGRMEDEN "" VALUE 0x80040694 TKW_VV_VV_UB 100.0 Identity 0.0 1.0000 /end CHARACTERISTIC
/begin CHARACTERISTIC K_LANGFAV "" VALUE 0x80040695 TKW_VV_VV_UB 100.0 Identity 0.0 1.0000 /end CHARACTERISTIC
/begin CHARACTERISTIC S_APPCO2IGRON "" VALUE 0x80040696 TKW_VV_VV_UB 100.0 Identity 0.0 1.0000 /end CHARACTERISTIC
/begin CHARACTERISTIC S_APPCO2M2L "" VALUE 0x80040697 TKW_VV_VV_UB 100.0 Identity 0.0 1.0000 /end CHARACTERISTIC
/begin CHARACTERISTIC S_APPIGRHION "" VALUE 0x80040698 TKW_VV_VV_UB 100.0 Identity 0.0 1.0000 /end CHARACTERISTIC
/begin CHARACTERISTIC S_APPIGRMEON "" VALUE 0x80040699 TKW_VV_VV_UB 100.0 Identity 0.0 1.0000 /end CHARACTERISTIC
/begin CHARACTERISTIC S_APPMSAON "" VALUE 0x8004069A TKW_VV_VV_UB 100.0 Identity 0.0 1.0000 /end CHARACTERISTIC
/begin CHARACTERISTIC K_GEN_DNMIN "Motordrehzahlschwelle  für Auswertung der Generatorfehler" VALUE 0x8004069C TKW_VV_VV_SW 100.0 Def_n_sw_q1p0 -32768.0000 32767.0000 /end CHARACTERISTIC
/begin CHARACTERISTIC K_SNMBSDKL61 "" VALUE 0x8004069E TKW_VV_VV_SW 100.0 Def_n_sw_q1p0 -32768.0000 32767.0000 /end CHARACTERISTIC
/begin CHARACTERISTIC K_PLAUSAUS "Zeitdauer Ausschaltentprellung Plausibilisierung Fehler" VALUE 0x800406A0 TKW_VV_VV_UW 100.0 Def_td_uw_q0p1 0.0 6553.5000 FORMAT "%4.1" /end CHARACTERISTIC
/begin CHARACTERISTIC K_PLAUSEIN "Zeitdauer Einschaltentprellung Plausibilisierung Fehler" VALUE 0x800406A2 TKW_VV_VV_UW 100.0 Def_td_uw_q0p1 0.0 6553.5000 FORMAT "%4.1" /end CHARACTERISTIC
/begin CHARACTERISTIC K_TD_UGENDIAG "Entprellzeit Unterspannungsdiagnose Generator" VALUE 0x800406A4 TKW_VV_VV_UW 100.0 Def_td_uw_q0p1 0.0 6553.5000 FORMAT "%4.1" /end CHARACTERISTIC
/begin CHARACTERISTIC K_UGENDIAG "Diagoseschwelle Generatorunterspannung" VALUE 0x800406A6 TKW_VV_VV_UW 100.0 Def_u_uw_q0p0942 0.0 6173.3970 FORMAT "%4.1" /end CHARACTERISTIC
/begin CHARACTERISTIC K_UGOFFSET "Offset zur Schwelle Generatorunterspannungs Diagnose" VALUE 0x800406A8 TKW_VV_VV_UW 100.0 Def_u_uw_q0p0942 0.0 6173.3970 FORMAT "%4.1" /end CHARACTERISTIC
/begin CHARACTERISTIC K_GENPDTIME "Predrivetime für Ladekontrollampe KL61" VALUE 0x800406AA TKW_VV_VV_UB 100.0 Def_td_ub_q0p1 0.0 25.5000 /end CHARACTERISTIC
/begin CHARACTERISTIC K_MSKGENDFP "Bitmaske Generator Fehler-> DFP" VALUE 0x800406AB TKW_VV_VV_UB 100.0 Def_st_ub_q1 0.0 255.0000 /end CHARACTERISTIC
/begin CHARACTERISTIC K_MSKGENKL61 "Bitmaske fuer Generatorfehler -> Ladekontrolle" VALUE 0x800406AC TKW_VV_VV_UB 100.0 Def_st_ub_q1 0.0 255.0000 /end CHARACTERISTIC
/begin CHARACTERISTIC S_ENUGDIAG "Freigabe Unterspannungsdiagnose Generator" VALUE 0x800406AD TKW_VV_VV_UB 100.0 Identity 0.0 1.0000 /end CHARACTERISTIC
/begin CHARACTERISTIC S_BSDKOORD "" VALUE 0x800406AE TKW_VV_VV_UB 100.0 Identity 0.0 1.0000 /end CHARACTERISTIC
/begin CHARACTERISTIC K_MSKIBSDFP "Bitmaske Generator Fehler-> DFP" VALUE 0x800406AF TKW_VV_VV_UB 100.0 Def_st_ub_q1 0.0 255.0000 /end CHARACTERISTIC
/begin CHARACTERISTIC K_MSKIBSDFP2 "" VALUE 0x800406B0 TKW_VV_VV_UB 100.0 Def_st_ub_q1 0.0 255.0000 /end CHARACTERISTIC
/begin CHARACTERISTIC K_MSKIBSDIAG "Test AK disable Diagnose" VALUE 0x800406B1 TKW_VV_VV_UB 100.0 Def_st_ub_q1 0.0 255.0000 /end CHARACTERISTIC
/begin CHARACTERISTIC K_MSKIBSERR "" VALUE 0x800406B2 TKW_VV_VV_UB 100.0 ident 0.0 255.0000 /end CHARACTERISTIC
/begin CHARACTERISTIC K_MSKIBSERR2 "" VALUE 0x800406B3 TKW_VV_VV_UB 100.0 ident 0.0 255.0000 /end CHARACTERISTIC
/begin CHARACTERISTIC K_OZDIAGNMOT "Mindestdrehzahl zur QLT-Diagnose" VALUE 0x800406B4 TKW_VV_VV_SW 100.0 Def_n_sw_q1p0 -32768.0000 32767.0000 /end CHARACTERISTIC
/begin CHARACTERISTIC K_OZDIAGNMOT2 "Max Drehzahl zur QLT-Diagnose" VALUE 0x800406B6 TKW_VV_VV_SW 100.0 Def_n_sw_q1p0 -32768.0000 32767.0000 /end CHARACTERISTIC
/begin CHARACTERISTIC K_OZTEMPQERR "Temperaturschwelle für den Permittivitätsfehler" VALUE 0x800406B8 TKW_VV_VV_SW 100.0 Def_t_sw_q0p1 -3276.8000 3276.7000 FORMAT "%4.1" /end CHARACTERISTIC
/begin CHARACTERISTIC K_DTOG_UBMIN "" VALUE 0x800406BA TKW_VV_VV_UW 100.0 Def_u_uw_q0p0942 0.0 6173.3970 FORMAT "%4.1" /end CHARACTERISTIC
/begin CHARACTERISTIC K_OZDELTOE "Verzögerung für das Schreiben in Fehlerspeicher Töns-Fehler" VALUE 0x800406BC TKW_VV_VV_UW 100.0 Def_dez_uw_q1 0.0 65535.0000 /end CHARACTERISTIC
/begin CHARACTERISTIC K_OZDIAGSPG "Spannung, unterhalb der die Diagnose ausgeblendet wird" VALUE 0x800406BE TKW_VV_VV_UW 100.0 Def_u_uw_q0p0942 0.0 6173.3970 FORMAT "%4.1" /end CHARACTERISTIC
/begin CHARACTERISTIC K_OZERRD "Entprellzeit Sensor- und Kommunikationsfehler" VALUE 0x800406C0 TKW_VV_VV_UW 100.0 Def_dez_uw_q1 0.0 65535.0000 /end CHARACTERISTIC
/begin CHARACTERISTIC K_OZHEAL "Entprellzeit Fehler-Healing" VALUE 0x800406C2 TKW_VV_VV_UW 100.0 Def_dez_uw_q1 0.0 65535.0000 /end CHARACTERISTIC
/begin CHARACTERISTIC K_OZZTEMP "Max Zeit mit dem selben Temperaturwert (Plausibilisierung wegen ASIC-Pins Bruch)" VALUE 0x800406C4 TKW_VV_VV_UW 100.0 Def_dez_uw_q1 0.0 65535.0000 /end CHARACTERISTIC
/begin CHARACTERISTIC K_TOG_CNTMAX "" VALUE 0x800406C6 TKW_VV_VV_UW 100.0 Def_td_uw_q0p01 0.0 655.3500 FORMAT "%5.2" /end CHARACTERISTIC
/begin CHARACTERISTIC K_OZPLTEMP "Max Temperatursprung QLT (Plausibilisierung wegen ASIC-Pins Bruch)" VALUE 0x800406C8 TKW_VV_VV_UB 100.0 Def_dez_ub_q1 0.0 255.0000 /end CHARACTERISTIC
/begin CHARACTERISTIC K_OZPLZTEMP "Max unplausibel Sprünge (Plausibilisierung wegen ASIC-Pins Bruch)" VALUE 0x800406C9 TKW_VV_VV_UB 100.0 Def_dez_ub_q1 0.0 255.0000 /end CHARACTERISTIC
/begin CHARACTERISTIC K_TOGMAXUNPL "" VALUE 0x800406CA TKW_VV_VV_UB 100.0 Def_dez_ub_q1 0.0 255.0000 /end CHARACTERISTIC
/begin CHARACTERISTIC S_OZBSDKOORD "BSD Koordinator aktiv" VALUE 0x800406CB TKW_VV_VV_UB 100.0 Def_dez_ub_q1 0.0 255.0000 /end CHARACTERISTIC
/begin MEASUREMENT St_msaa.B_msastart "Bedingung Startanforderung MSA" UBYTE Def_bit_ub_0 0 0 0.0 255.0 ECU_ADDRESS 0xD00006B4 BIT_MASK 0x1 /end MEASUREMENT
/begin MEASUREMENT St_msaa.B_msastartf "Bedingung Startfreigabe MSA" UBYTE Def_bit_ub_1 0 0 0.0 255.0 ECU_ADDRESS 0xD00006B4 BIT_MASK 0x2 /end MEASUREMENT
/begin MEASUREMENT St_msaa.B_msastopp "Bedingung Stoppanforderung MSA" UBYTE Def_bit_ub_2 0 0 0.0 255.0 ECU_ADDRESS 0xD00006B4 BIT_MASK 0x4 /end MEASUREMENT
/begin MEASUREMENT St_msaa "Statuswort" UBYTE Def_st_ub_q1 0 0 0.0 255.0000 ECU_ADDRESS 0xD00006B4 /end MEASUREMENT
/begin MEASUREMENT St_msaanz.B_msaakt "Bedingung MSA aktiv" UWORD Def_bit_uw_0 0 0 0.0 65535.0 ECU_ADDRESS 0xD00006B8 BIT_MASK 0x1 /end MEASUREMENT
/begin MEASUREMENT St_msaanz.B_msaaktber "Bedingung MSA aktiv und bereit" UWORD Def_bit_uw_1 0 0 0.0 65535.0 ECU_ADDRESS 0xD00006B8 BIT_MASK 0x2 /end MEASUREMENT
/begin MEASUREMENT St_msaanz.B_msanakt "Bedingung MSA nicht aktiv" UWORD Def_bit_uw_2 0 0 0.0 65535.0 ECU_ADDRESS 0xD00006B8 BIT_MASK 0x4 /end MEASUREMENT
/begin MEASUREMENT St_msaanz.B_msaerr "Bedingung Fehler MSA" UWORD Def_bit_uw_3 0 0 0.0 65535.0 ECU_ADDRESS 0xD00006B8 BIT_MASK 0x8 /end MEASUREMENT
/begin MEASUREMENT St_msaanz "Statuswort" UWORD Def_st_uw_q1 0 0 0.0 65535.0000 ECU_ADDRESS 0xD00006B8 /end MEASUREMENT
/begin MEASUREMENT St_msabs.B_msastopp1 "Bedingung erste Stoppanforderung MSA" UBYTE Def_bit_ub_0 0 0 0.0 255.0 ECU_ADDRESS 0xD00006B5 BIT_MASK 0x1 /end MEASUREMENT
/begin MEASUREMENT St_msabs.B_msastarts "Bedingung MSA-Startstatus (für Powermanagement)" UBYTE Def_bit_ub_1 0 0 0.0 255.0 ECU_ADDRESS 0xD00006B5 BIT_MASK 0x2 /end MEASUREMENT
/begin MEASUREMENT St_msabs.B_msastops "Bedingung MSA-Stoppstatus (für Powermanagement)" UBYTE Def_bit_ub_2 0 0 0.0 255.0 ECU_ADDRESS 0xD00006B5 BIT_MASK 0x4 /end MEASUREMENT
/begin MEASUREMENT St_msabs.B_abwuergen "Bedingung Motor abgewürgt" UBYTE Def_bit_ub_3 0 0 0.0 255.0 ECU_ADDRESS 0xD00006B5 BIT_MASK 0x8 /end MEASUREMENT
/begin MEASUREMENT St_msabs.B_msataste "Bedingung MSA via Taster enabled" UBYTE Def_bit_ub_4 0 0 0.0 255.0 ECU_ADDRESS 0xD00006B5 BIT_MASK 0x10 /end MEASUREMENT
/begin MEASUREMENT St_msabs.B_msamhauf "Motorhaube mal offen" UBYTE Def_bit_ub_5 0 0 0.0 255.0 ECU_ADDRESS 0xD00006B5 BIT_MASK 0x20 /end MEASUREMENT
/begin MEASUREMENT St_msabs.B_msaftman "Fahrertür offen bei laufendem Motor" UBYTE Def_bit_ub_6 0 0 0.0 255.0 ECU_ADDRESS 0xD00006B5 BIT_MASK 0x40 /end MEASUREMENT
/begin MEASUREMENT St_msabs.B_msaftmaus "Fahrertür offen in der MSA-Stopp-Phase" UBYTE Def_bit_ub_7 0 0 0.0 255.0 ECU_ADDRESS 0xD00006B5 BIT_MASK 0x80 /end MEASUREMENT
/begin MEASUREMENT St_msabs "Statuswort" UBYTE Def_st_ub_q1 0 0 0.0 255.0000 ECU_ADDRESS 0xD00006B5 /end MEASUREMENT
/begin MEASUREMENT St_msabs1.B_msatastft "Status B_msataste bei öffnen der Fahrertür mit Motor an" UBYTE Def_bit_ub_0 0 0 0.0 255.0 ECU_ADDRESS 0xD00006B6 BIT_MASK 0x1 /end MEASUREMENT
/begin MEASUREMENT St_msabs1.B_msastverl "Bit für die Verlängerung Startsignal ab Drehzahl > K_MSANST" UBYTE Def_bit_ub_1 0 0 0.0 255.0 ECU_ADDRESS 0xD00006B6 BIT_MASK 0x2 /end MEASUREMENT
/begin MEASUREMENT St_msabs1.B_msaks "Kraftsluss erkannt" UBYTE Def_bit_ub_2 0 0 0.0 255.0 ECU_ADDRESS 0xD00006B6 BIT_MASK 0x4 /end MEASUREMENT
/begin MEASUREMENT St_msabs1 "Statuswort" UBYTE Def_st_ub_q1 0 0 0.0 255.0000 ECU_ADDRESS 0xD00006B6 /end MEASUREMENT
/begin MEASUREMENT St_msabsd.B_msabs00 "Globale MSA Abschalter - Bit 0" UWORD Def_bit_uw_0 0 0 0.0 65535.0 ECU_ADDRESS 0xD00006BA BIT_MASK 0x1 /end MEASUREMENT
/begin MEASUREMENT St_msabsd.B_msabs01 "Globale MSA Abschalter - Bit 01" UWORD Def_bit_uw_1 0 0 0.0 65535.0 ECU_ADDRESS 0xD00006BA BIT_MASK 0x2 /end MEASUREMENT
/begin MEASUREMENT St_msabsd.B_msabs02 "Globale MSA Abschalter - Bit 02" UWORD Def_bit_uw_2 0 0 0.0 65535.0 ECU_ADDRESS 0xD00006BA BIT_MASK 0x4 /end MEASUREMENT
/begin MEASUREMENT St_msabsd.B_msabs03 "Globale MSA Abschalter - Bit 03" UWORD Def_bit_uw_3 0 0 0.0 65535.0 ECU_ADDRESS 0xD00006BA BIT_MASK 0x8 /end MEASUREMENT
/begin MEASUREMENT St_msabsd.B_msabs04 "Globale MSA Abschalter - Bit 04" UWORD Def_bit_uw_4 0 0 0.0 65535.0 ECU_ADDRESS 0xD00006BA BIT_MASK 0x10 /end MEASUREMENT
/begin MEASUREMENT St_msabsd.B_msabs05 "Globale MSA Abschalter - Bit 05" UWORD Def_bit_uw_5 0 0 0.0 65535.0 ECU_ADDRESS 0xD00006BA BIT_MASK 0x20 /end MEASUREMENT
/begin MEASUREMENT St_msabsd.B_msabs06 "Globale MSA Abschalter - Bit 06" UWORD Def_bit_uw_6 0 0 0.0 65535.0 ECU_ADDRESS 0xD00006BA BIT_MASK 0x40 /end MEASUREMENT
/begin MEASUREMENT St_msabsd.B_msabs07 "Globale MSA Abschalter - Bit 07" UWORD Def_bit_uw_7 0 0 0.0 65535.0 ECU_ADDRESS 0xD00006BA BIT_MASK 0x80 /end MEASUREMENT
/begin MEASUREMENT St_msabsd.B_msabs08 "Globale MSA Abschalter - Bit 08" UWORD Def_bit_uw_8 0 0 0.0 65535.0 ECU_ADDRESS 0xD00006BA BIT_MASK 0x100 /end MEASUREMENT
/begin MEASUREMENT St_msabsd.B_msabs09 "Globale MSA Abschalter - Bit 09" UWORD Def_bit_uw_9 0 0 0.0 65535.0 ECU_ADDRESS 0xD00006BA BIT_MASK 0x200 /end MEASUREMENT
/begin MEASUREMENT St_msabsd.B_msabs10 "Globale MSA Abschalter - Bit 10" UWORD Def_bit_uw_10 0 0 0.0 65535.0 ECU_ADDRESS 0xD00006BA BIT_MASK 0x400 /end MEASUREMENT
/begin MEASUREMENT St_msabsd.B_msabs11 "Globale MSA Abschalter - Bit 11" UWORD Def_bit_uw_11 0 0 0.0 65535.0 ECU_ADDRESS 0xD00006BA BIT_MASK 0x800 /end MEASUREMENT
/begin MEASUREMENT St_msabsd.B_msabs12 "Globale MSA Abschalter - Bit 12" UWORD Def_bit_uw_12 0 0 0.0 65535.0 ECU_ADDRESS 0xD00006BA BIT_MASK 0x1000 /end MEASUREMENT
/begin MEASUREMENT St_msabsd.B_msabs13 "Globale MSA Abschalter - Bit 13" UWORD Def_bit_uw_13 0 0 0.0 65535.0 ECU_ADDRESS 0xD00006BA BIT_MASK 0x2000 /end MEASUREMENT
/begin MEASUREMENT St_msabsd.B_msabs14 "Globale MSA Abschalter - Bit 14" UWORD Def_bit_uw_14 0 0 0.0 65535.0 ECU_ADDRESS 0xD00006BA BIT_MASK 0x4000 /end MEASUREMENT
/begin MEASUREMENT St_msabsd.B_msabs15 "Globale MSA Abschalter - Bit 15" UWORD Def_bit_uw_15 0 0 0.0 65535.0 ECU_ADDRESS 0xD00006BA BIT_MASK 0x8000 /end MEASUREMENT
/begin MEASUREMENT St_msabsd "Statuswort" UWORD Def_st_uw_q1 0 0 0.0 65535.0000 ECU_ADDRESS 0xD00006BA /end MEASUREMENT
/begin MEASUREMENT Stmsa "Status MSA und Funktionsabschalter" ULONG Def_dez_ul_q1 0 0 0.0 4294967295.0000 ECU_ADDRESS 0xD0000AB0 /end MEASUREMENT
/begin MEASUREMENT Stmsaaa "Status MSA Auschaltaufforderer" ULONG Def_dez_ul_q1 0 0 0.0 4294967295.0000 ECU_ADDRESS 0xD0000AB4 /end MEASUREMENT
/begin MEASUREMENT Stmsaav "Status MSA aktiv und bereit und Abschaltverhinderer" ULONG Def_dez_ul_q1 0 0 0.0 4294967295.0000 ECU_ADDRESS 0xD0000AB8 /end MEASUREMENT
/begin MEASUREMENT Stmsaea "Status MSA Einschaltaufforderer" ULONG Def_dez_ul_q1 0 0 0.0 4294967295.0000 ECU_ADDRESS 0xD0000ABC /end MEASUREMENT
/begin MEASUREMENT Stmsaev "Status MSA Einschaltverhinderer" ULONG Def_dez_ul_q1 0 0 0.0 4294967295.0000 ECU_ADDRESS 0xD0000AC0 /end MEASUREMENT
/begin MEASUREMENT Msa_vstart "Merker Geschwindigkeit am Startbeginn" UWORD Def_v_uw_q1p0 0 0 0.0 65535.0000 ECU_ADDRESS 0xD00006BC /end MEASUREMENT
/begin MEASUREMENT St_msaea.B_msaea "Bedingung MSA Einschaltaufforderer" UBYTE Def_bit_ub_0 0 0 0.0 255.0 ECU_ADDRESS 0xD00006C4 BIT_MASK 0x1 /end MEASUREMENT
/begin MEASUREMENT St_msaea.B_msaeafa "Bedingung MSA Einschaltaufforderer von Fahrer" UBYTE Def_bit_ub_1 0 0 0.0 255.0 ECU_ADDRESS 0xD00006C4 BIT_MASK 0x2 /end MEASUREMENT
/begin MEASUREMENT St_msaea.B_msaeaauto "Bedingung automatischer MSA Einschaltaufforderer" UBYTE Def_bit_ub_2 0 0 0.0 255.0 ECU_ADDRESS 0xD00006C4 BIT_MASK 0x4 /end MEASUREMENT
/begin MEASUREMENT St_msaea "Statuswort" UBYTE Def_st_ub_q1 0 0 0.0 255.0000 ECU_ADDRESS 0xD00006C4 /end MEASUREMENT
/begin MEASUREMENT St_msaead.B_msaea00 "EAs für Diagnose - Bit 0" UWORD Def_bit_uw_0 0 0 0.0 65535.0 ECU_ADDRESS 0xD00006C8 BIT_MASK 0x1 /end MEASUREMENT
/begin MEASUREMENT St_msaead.B_msaea01 "EAs für Diagnose - Bit 0" UWORD Def_bit_uw_1 0 0 0.0 65535.0 ECU_ADDRESS 0xD00006C8 BIT_MASK 0x2 /end MEASUREMENT
/begin MEASUREMENT St_msaead.B_msaea02 "EAs für Diagnose - Bit 0" UWORD Def_bit_uw_2 0 0 0.0 65535.0 ECU_ADDRESS 0xD00006C8 BIT_MASK 0x4 /end MEASUREMENT
/begin MEASUREMENT St_msaead.B_msaea03 "EAs für Diagnose - Bit 0" UWORD Def_bit_uw_3 0 0 0.0 65535.0 ECU_ADDRESS 0xD00006C8 BIT_MASK 0x8 /end MEASUREMENT
/begin MEASUREMENT St_msaead.B_msaea04 "EAs für Diagnose - Bit 0" UWORD Def_bit_uw_4 0 0 0.0 65535.0 ECU_ADDRESS 0xD00006C8 BIT_MASK 0x10 /end MEASUREMENT
/begin MEASUREMENT St_msaead.B_msaea05 "EAs für Diagnose - Bit 0" UWORD Def_bit_uw_5 0 0 0.0 65535.0 ECU_ADDRESS 0xD00006C8 BIT_MASK 0x20 /end MEASUREMENT
/begin MEASUREMENT St_msaead "Statuswort" UWORD Def_st_uw_q1 0 0 0.0 65535.0000 ECU_ADDRESS 0xD00006C8 /end MEASUREMENT
/begin MEASUREMENT St_msaev.B_msaev "Bedingung MSA Einschaltverhinderer" UBYTE Def_bit_ub_0 0 0 0.0 255.0 ECU_ADDRESS 0xD0001D10 BIT_MASK 0x1 /end MEASUREMENT
/begin MEASUREMENT St_msaev.B_msastlock "Start-Verriegelung nach 20sec Versuch" UBYTE Def_bit_ub_1 0 0 0.0 255.0 ECU_ADDRESS 0xD0001D10 BIT_MASK 0x2 /end MEASUREMENT
/begin MEASUREMENT St_msaev "Statuswort" UBYTE Def_st_ub_q1 0 0 0.0 255.0000 ECU_ADDRESS 0xD0001D10 /end MEASUREMENT
/begin MEASUREMENT St_msaevd.B_msaev00 "EVs für Diagnose - Bit 0" UWORD Def_bit_uw_0 0 0 0.0 65535.0 ECU_ADDRESS 0xD0001D1C BIT_MASK 0x1 /end MEASUREMENT
/begin MEASUREMENT St_msaevd.B_msaev01 "EVs für Diagnose - Bit 1" UWORD Def_bit_uw_1 0 0 0.0 65535.0 ECU_ADDRESS 0xD0001D1C BIT_MASK 0x2 /end MEASUREMENT
/begin MEASUREMENT St_msaevd.B_msaev02 "EVs für Diagnose - Bit 2" UWORD Def_bit_uw_2 0 0 0.0 65535.0 ECU_ADDRESS 0xD0001D1C BIT_MASK 0x4 /end MEASUREMENT
/begin MEASUREMENT St_msaevd "Statuswort" UWORD Def_st_uw_q1 0 0 0.0 65535.0000 ECU_ADDRESS 0xD0001D1C /end MEASUREMENT
/begin MEASUREMENT St_ngang0.B_ngangdok "Nullgangsensor-Diagnose ok" UBYTE Def_bit_ub_0 0 0 0.0 255.0 ECU_ADDRESS 0xD0000744 BIT_MASK 0x1 /end MEASUREMENT
/begin MEASUREMENT St_ngang0.B_gangnull "Getriebe in Nullgang " UBYTE Def_bit_ub_1 0 0 0.0 255.0 ECU_ADDRESS 0xD0000744 BIT_MASK 0x2 /end MEASUREMENT
/begin MEASUREMENT St_ngang0 "Statuswort" UBYTE Def_st_ub_q1 0 0 0.0 255.0000 ECU_ADDRESS 0xD0000744 /end MEASUREMENT
/begin MEASUREMENT Tvneutral "Nullgang-Position" UWORD Def_tv_uw_q0p01 0 0 0.0 655.3500 ECU_ADDRESS 0xD0009E46 /end MEASUREMENT
/begin MEASUREMENT St_ngang "Status Nullgangerkennung" UBYTE Def_dez_ub_q1 0 0 0.0 255.0000 ECU_ADDRESS 0xD0009E48 /end MEASUREMENT
/begin MEASUREMENT Tvngangalt "Nullgangsensor alte Position für die Signal-Stabilitätskontrolle" UWORD Def_tv_uw_q0p01 0 0 0.0 655.3500 ECU_ADDRESS 0xD000074C /end MEASUREMENT
/begin MEASUREMENT I_craweng "Strombedarf Motor" SWORD Def_i_sw_q1 0 0 -10.0000 254.0000 ECU_ADDRESS 0xD0001338 /end MEASUREMENT
/begin MEASUREMENT Fak_ttansel "Ansaugluftfaktor E-Lüfterstrom" UWORD Def_f_uw_b512 0 0 0.0 511.9921 ECU_ADDRESS 0xD000133A /end MEASUREMENT
/begin MEASUREMENT Fak_tubel "Faktor Lüfterstrom aus Geschwindigkeit" UWORD Def_f_uw_b512 0 0 0.0 511.9921 ECU_ADDRESS 0xD000133C /end MEASUREMENT
/begin MEASUREMENT I_elu_vvt "Strom E-Lüfter und VVT-System" UWORD Def_i_uw_q0p0635 0 0 0.0 4095.9375 ECU_ADDRESS 0xD000133E /end MEASUREMENT
/begin MEASUREMENT I_eluefter "E-Lüfter Stromaufnahme" UWORD Def_i_uw_q0p0635 0 0 0.0 4095.9375 ECU_ADDRESS 0xD0001340 /end MEASUREMENT
/begin MEASUREMENT I_elupwm "Lüfterstrom ohne Temperatur- und Geschwindigkeitseinfluss" UWORD Def_i_uw_q0p0635 0 0 0.0 64.0000 ECU_ADDRESS 0xD0001342 /end MEASUREMENT
/begin MEASUREMENT I_eluvfzg "Lüfterstrom ohne Geschwindigkeitseinfluss" UWORD Def_i_uw_q0p0635 0 0 0.0 128.0000 ECU_ADDRESS 0xD0001344 /end MEASUREMENT
/begin MEASUREMENT I_gle "Glühstrom" UWORD Def_i_uw_q0p0635 0 0 0.0 4095.9375 ECU_ADDRESS 0xD0001346 /end MEASUREMENT
/begin MEASUREMENT I_sls "berechnete Groesse Strombedarf Sekundärluftpumpe" UWORD Def_i_uw_q0p0635 0 0 0.0 255.0000 ECU_ADDRESS 0xD0001348 /end MEASUREMENT
/begin MEASUREMENT Vvt_ib1_2 "Gesamtstrom VVT Bank1 bzw 4Zyl. und Bank2" UWORD Def_i_uw_q0p0635 0 0 0.0 4095.9375 ECU_ADDRESS 0xD000134A /end MEASUREMENT
/begin MEASUREMENT Vvt_iges "Strombedarf des gesamten VVT-Systems" UWORD Def_i_uw_q0p0635 0 0 0.0 192.0000 ECU_ADDRESS 0xD000134C /end MEASUREMENT
/begin MEASUREMENT St_bgllgen0.B_hysllrah "Hysterese LL Anhebung" UBYTE Def_bit_ub_0 0 0 0.0 255.0 ECU_ADDRESS 0xD0000018 BIT_MASK 0x1 /end MEASUREMENT
/begin MEASUREMENT St_bgllgen0 "Statuswort" UBYTE Def_st_ub_q1 0 0 0.0 255.0000 ECU_ADDRESS 0xD0000018 /end MEASUREMENT
/begin MEASUREMENT N_idlgspec "Anforderung LL-Anhebung" UBYTE Def_st_ub_q1 0 0 0.0 255.0000 ECU_ADDRESS 0xD000135C /end MEASUREMENT
/begin MEASUREMENT N_genll "Drehzahl Generator bei LL Anhebung" SWORD Def_n_sw_q1p0 0 0 -32768.0000 32767.0000 ECU_ADDRESS 0xD000136C /end MEASUREMENT
/begin MEASUREMENT Gen_dfvorhs "DF-Signal Vorhersage" UBYTE Def_f_ub_b100 0 0 0.0 99.6093 ECU_ADDRESS 0xD000135D /end MEASUREMENT
/begin MEASUREMENT Gen_dfvorhsnofil "DF-Signal Vorhersage ungefiltert" UBYTE Def_f_ub_b100 0 0 0.0 99.6093 ECU_ADDRESS 0xD000135E /end MEASUREMENT
/begin MEASUREMENT I_erripol1 "Ergebnis inverse Interpolation1" UBYTE Def_i_ub_q0p125 0 0 0.0 31.8750 ECU_ADDRESS 0xD000135F /end MEASUREMENT
/begin MEASUREMENT I_erripol2 "Ergebnis inverse Interpolation2" UBYTE Def_i_ub_q0p125 0 0 0.0 31.8750 ECU_ADDRESS 0xD0001360 /end MEASUREMENT
/begin MEASUREMENT I_erripol3 "Ergebnis inverse Interpolation3" UBYTE Def_i_ub_q0p125 0 0 0.0 31.8750 ECU_ADDRESS 0xD0001361 /end MEASUREMENT
/begin MEASUREMENT Ierr_vorhs "Vorhergesagter Erregerstrom bei LL Anhebung" UBYTE Def_i_ub_q0p125 0 0 0.0 31.8750 ECU_ADDRESS 0xD0001362 /end MEASUREMENT
/begin MEASUREMENT T_brw "Temp Brennraumwand" SWORD Def_t_sw_q0p1 0 0 -50.2000 899.8000 ECU_ADDRESS 0xD000138C /end MEASUREMENT
/begin MEASUREMENT T_brwnv "Temp Brennraumwand NV" SWORD Def_t_sw_q0p1 0 0 -50.2000 899.8000 ECU_ADDRESS 0xD00095A0 /end MEASUREMENT
/begin MEASUREMENT T_brwd1 "Tempdiff aus KF QN" SWORD Def_t_sw_q0p01 0 0 -327.6800 327.6700 ECU_ADDRESS 0xD000138E /end MEASUREMENT
/begin MEASUREMENT T_brwd2 "Tempdiff aus KF HFM" SWORD Def_t_sw_q0p01 0 0 -327.6800 327.6700 ECU_ADDRESS 0xD0001390 /end MEASUREMENT
/begin MEASUREMENT T_brwd3 "Tempdiff aus KF HFMS" SWORD Def_t_sw_q0p01 0 0 -327.6800 327.6700 ECU_ADDRESS 0xD0001392 /end MEASUREMENT
/begin MEASUREMENT T_brwd4 "Tempdiff aus KF TWA" SWORD Def_t_sw_q0p01 0 0 -327.6800 327.6700 ECU_ADDRESS 0xD0001394 /end MEASUREMENT
/begin MEASUREMENT T_brwdg "Summe Tempdiff aus Kennfeldern" SWORD Def_t_sw_q0p01 0 0 -327.6800 327.6700 ECU_ADDRESS 0xD0001396 /end MEASUREMENT
/begin MEASUREMENT T_brwdiff "Temperatur Brennraumwand Differenz MAP zu calc" SWORD Def_t_sw_q0p1 0 0 -50.2000 899.8000 ECU_ADDRESS 0xD0001398 /end MEASUREMENT
/begin MEASUREMENT T_brwsd "Start Tempdiff Tmot zu T_brw" SWORD Def_t_sw_q0p1 0 0 -3276.8000 3276.7000 ECU_ADDRESS 0xD000139A /end MEASUREMENT
/begin MEASUREMENT T_brwsde "Abgeklungene Tempdiff Tmot zu T_brw" SWORD Def_t_sw_q0p1 0 0 -3276.8000 3276.7000 ECU_ADDRESS 0xD000139C /end MEASUREMENT
/begin MEASUREMENT St_co2mng.B_igrhigh "" UBYTE Def_bit_ub_0 0 0 0.0 255.0 ECU_ADDRESS 0xD00013B0 BIT_MASK 0x1 /end MEASUREMENT
/begin MEASUREMENT St_co2mng.B_igrmed "" UBYTE Def_bit_ub_1 0 0 0.0 255.0 ECU_ADDRESS 0xD00013B0 BIT_MASK 0x2 /end MEASUREMENT
/begin MEASUREMENT St_co2mng.B_cdmsaonw "" UBYTE Def_bit_ub_2 0 0 0.0 255.0 ECU_ADDRESS 0xD00013B0 BIT_MASK 0x4 /end MEASUREMENT
/begin MEASUREMENT St_co2mng.B_lang_fav "" UBYTE Def_bit_ub_3 0 0 0.0 255.0 ECU_ADDRESS 0xD00013B0 BIT_MASK 0x8 /end MEASUREMENT
/begin MEASUREMENT St_co2mng.B_zykl_msaoff "" UBYTE Def_bit_ub_4 0 0 0.0 255.0 ECU_ADDRESS 0xD00013B0 BIT_MASK 0x10 /end MEASUREMENT
/begin MEASUREMENT St_co2mng.B_zykl_igroff "" UBYTE Def_bit_ub_5 0 0 0.0 255.0 ECU_ADDRESS 0xD00013B0 BIT_MASK 0x20 /end MEASUREMENT
/begin MEASUREMENT St_co2mng.B_co2_msaoff "" UBYTE Def_bit_ub_6 0 0 0.0 255.0 ECU_ADDRESS 0xD00013B0 BIT_MASK 0x40 /end MEASUREMENT
/begin MEASUREMENT St_co2mng.B_co2_igroff "" UBYTE Def_bit_ub_7 0 0 0.0 255.0 ECU_ADDRESS 0xD00013B0 BIT_MASK 0x80 /end MEASUREMENT
/begin MEASUREMENT St_co2mng "Statuswort" UBYTE Def_st_ub_q1 0 0 0.0 255.0000 ECU_ADDRESS 0xD00013B0 /end MEASUREMENT
/begin MEASUREMENT St_co2mng_1.B_co2_av "" UBYTE Def_bit_ub_0 0 0 0.0 255.0 ECU_ADDRESS 0xD00013B1 BIT_MASK 0x1 /end MEASUREMENT
/begin MEASUREMENT St_co2mng_1.B_co2_ea "" UBYTE Def_bit_ub_1 0 0 0.0 255.0 ECU_ADDRESS 0xD00013B1 BIT_MASK 0x2 /end MEASUREMENT
/begin MEASUREMENT St_co2mng_1.B_co2_eacc "" UBYTE Def_bit_ub_2 0 0 0.0 255.0 ECU_ADDRESS 0xD00013B1 BIT_MASK 0x4 /end MEASUREMENT
/begin MEASUREMENT St_co2mng_1.B_deakmsa "" UBYTE Def_bit_ub_3 0 0 0.0 255.0 ECU_ADDRESS 0xD00013B1 BIT_MASK 0x8 /end MEASUREMENT
/begin MEASUREMENT St_co2mng_1 "Statuswort" UBYTE Def_st_ub_q1 0 0 0.0 255.0000 ECU_ADDRESS 0xD00013B1 /end MEASUREMENT
/begin MEASUREMENT Dsoc_abs "" SWORD Def_f_sw_b100 0 0 -100.0000 99.9969 ECU_ADDRESS 0xD00013B8 /end MEASUREMENT
/begin MEASUREMENT Dsoc_igrmax "" SWORD Def_f_sw_b100 0 0 -100.0000 99.9969 ECU_ADDRESS 0xD00013BA /end MEASUREMENT
/begin MEASUREMENT Dsoc_igrmin "" SWORD Def_f_sw_b100 0 0 -100.0000 99.9969 ECU_ADDRESS 0xD00013BC /end MEASUREMENT
/begin MEASUREMENT Dsoc_msaav1 "" SWORD Def_f_sw_b100 0 0 -100.0000 99.9969 ECU_ADDRESS 0xD00013BE /end MEASUREMENT
/begin MEASUREMENT Dsoc_msaav2 "" SWORD Def_f_sw_b100 0 0 -100.0000 99.9969 ECU_ADDRESS 0xD00013C0 /end MEASUREMENT
/begin MEASUREMENT Dsoc_msaea1 "" SWORD Def_f_sw_b100 0 0 -100.0000 99.9969 ECU_ADDRESS 0xD00013C2 /end MEASUREMENT
/begin MEASUREMENT Dsoc_msaea2 "" SWORD Def_f_sw_b100 0 0 -100.0000 99.9969 ECU_ADDRESS 0xD00013C4 /end MEASUREMENT
/begin MEASUREMENT St_dgen0.B_1stbsder "" UBYTE Def_bit_ub_0 0 0 0.0 255.0 ECU_ADDRESS 0xD0000019 BIT_MASK 0x1 /end MEASUREMENT
/begin MEASUREMENT St_dgen0.B_kl61 "Bedingung Ladekontroll Laempchen an" UBYTE Def_bit_ub_1 0 0 0.0 255.0 ECU_ADDRESS 0xD0000019 BIT_MASK 0x2 /end MEASUREMENT
/begin MEASUREMENT St_dgen0.B_genfprl "Bedingung Generatorfehler entprellt" UBYTE Def_bit_ub_2 0 0 0.0 255.0 ECU_ADDRESS 0xD0000019 BIT_MASK 0x4 /end MEASUREMENT
/begin MEASUREMENT St_dgen0.B_gfbsupak "Generator Typ unplausibel^aus Fehlerspeicher" UBYTE Def_bit_ub_3 0 0 0.0 255.0 ECU_ADDRESS 0xD0000019 BIT_MASK 0x8 /end MEASUREMENT
/begin MEASUREMENT St_dgen0.B_gfelak "Generatorfehler elektrisch aus Fehlerspeicher" UBYTE Def_bit_ub_4 0 0 0.0 255.0 ECU_ADDRESS 0xD0000019 BIT_MASK 0x10 /end MEASUREMENT
/begin MEASUREMENT St_dgen0.B_gfhtak "Generatorfehler Uebertemperatur aus Fehlerspeicher" UBYTE Def_bit_ub_5 0 0 0.0 255.0 ECU_ADDRESS 0xD0000019 BIT_MASK 0x20 /end MEASUREMENT
/begin MEASUREMENT St_dgen0.B_gfmeak "Generatorfehler mechanisch aus Fehlerspeicher" UBYTE Def_bit_ub_6 0 0 0.0 255.0 ECU_ADDRESS 0xD0000019 BIT_MASK 0x40 /end MEASUREMENT
/begin MEASUREMENT St_dgen0.B_gfnobsak "Generator BSD Kommunikationsverlust aus Fehlerspeicher" UBYTE Def_bit_ub_7 0 0 0.0 255.0 ECU_ADDRESS 0xD0000019 BIT_MASK 0x80 /end MEASUREMENT
/begin MEASUREMENT St_dgen0 "Statuswort" UBYTE Def_st_ub_q1 0 0 0.0 255.0000 ECU_ADDRESS 0xD0000019 /end MEASUREMENT
/begin MEASUREMENT St_dgen1.B_genudiag "Bedingung Unterspannung Generator" UBYTE Def_bit_ub_0 0 0 0.0 255.0 ECU_ADDRESS 0xD000001A BIT_MASK 0x1 /end MEASUREMENT
/begin MEASUREMENT St_dgen1 "Statuswort" UBYTE Def_st_ub_q1 0 0 0.0 255.0000 ECU_ADDRESS 0xD000001A /end MEASUREMENT
/begin MEASUREMENT St_gen "Generatorstatus" UBYTE Def_st_ub_q1 0 0 0.0 255.0000 ECU_ADDRESS 0xD000141C /end MEASUREMENT
/begin MEASUREMENT St_genbsd "" UWORD Def_st_uw_q1 0 0 0.0 65535.0000 ECU_ADDRESS 0xD0001420 /end MEASUREMENT
/begin MEASUREMENT St_gengen "" UWORD Def_st_uw_q1 0 0 0.0 65535.0000 ECU_ADDRESS 0xD0001422 /end MEASUREMENT
/begin MEASUREMENT Gen_fbsak "BSD Uebertragungsfehler kodiert fuer FSPVDGEN" UBYTE Def_st_ub_q1 0 0 0.0 255.0000 ECU_ADDRESS 0xD000141D /end MEASUREMENT
/begin MEASUREMENT Gen_statroh "Generatorfehler kodiert fuer FSPVDGEN" UBYTE Def_st_ub_q1 0 0 0.0 255.0000 ECU_ADDRESS 0xD000141E /end MEASUREMENT
/begin MEASUREMENT St_dibs1.B_ifbsak "BSD Kommunikation zum IBS gestoert" UBYTE Def_bit_ub_2 0 0 0.0 255.0 ECU_ADDRESS 0xD000001B BIT_MASK 0x4 /end MEASUREMENT
/begin MEASUREMENT St_dibs1.B_ifebsak "Fehler erweiterte BSD Kommunikation zum IBS" UBYTE Def_bit_ub_3 0 0 0.0 255.0 ECU_ADDRESS 0xD000001B BIT_MASK 0x8 /end MEASUREMENT
/begin MEASUREMENT St_dibs1.B_ifuplak "Fehler IBS Version unplausibel" UBYTE Def_bit_ub_4 0 0 0.0 255.0 ECU_ADDRESS 0xD000001B BIT_MASK 0x10 /end MEASUREMENT
/begin MEASUREMENT St_dibs1 "Statuswort" UBYTE Def_st_ub_q1 0 0 0.0 255.0000 ECU_ADDRESS 0xD000001B /end MEASUREMENT
/begin MEASUREMENT St_dibs2.B_ifisak "IBS Stromfehler" UBYTE Def_bit_ub_0 0 0 0.0 255.0 ECU_ADDRESS 0xD000001C BIT_MASK 0x1 /end MEASUREMENT
/begin MEASUREMENT St_dibs2.B_ifusak "IBS Spannungsfehler" UBYTE Def_bit_ub_1 0 0 0.0 255.0 ECU_ADDRESS 0xD000001C BIT_MASK 0x2 /end MEASUREMENT
/begin MEASUREMENT St_dibs2.B_iftempak "IBS Temperaturfehler" UBYTE Def_bit_ub_2 0 0 0.0 255.0 ECU_ADDRESS 0xD000001C BIT_MASK 0x4 /end MEASUREMENT
/begin MEASUREMENT St_dibs2.B_ifwugdak "IBS KL15 Masseschluss" UBYTE Def_bit_ub_3 0 0 0.0 255.0 ECU_ADDRESS 0xD000001C BIT_MASK 0x8 /end MEASUREMENT
/begin MEASUREMENT St_dibs2.B_ifwuplak "" UBYTE Def_bit_ub_4 0 0 0.0 255.0 ECU_ADDRESS 0xD000001C BIT_MASK 0x10 /end MEASUREMENT
/begin MEASUREMENT St_dibs2.B_ifsysak "" UBYTE Def_bit_ub_5 0 0 0.0 255.0 ECU_ADDRESS 0xD000001C BIT_MASK 0x20 /end MEASUREMENT
/begin MEASUREMENT St_dibs2 "Statuswort" UBYTE Def_st_ub_q1 0 0 0.0 255.0000 ECU_ADDRESS 0xD000001C /end MEASUREMENT
/begin MEASUREMENT St_dibs0.B_dibloc1 "Signal nv lave loc zur Flankenerkennung" UBYTE Def_bit_ub_0 0 0 0.0 255.0 ECU_ADDRESS 0xD00095A2 BIT_MASK 0x1 /end MEASUREMENT
/begin MEASUREMENT St_dibs0.B_dibloc2 "Signal nv lave loc zur Flankenerkennung" UBYTE Def_bit_ub_1 0 0 0.0 255.0 ECU_ADDRESS 0xD00095A2 BIT_MASK 0x2 /end MEASUREMENT
/begin MEASUREMENT St_dibs0 "Statuswort" UBYTE Def_st_ub_q1 0 0 0.0 255.0000 ECU_ADDRESS 0xD00095A2 /end MEASUREMENT
/begin MEASUREMENT Ibs1_errstat "" UWORD Def_st_uw_q1 0 0 0.0 65535.0000 ECU_ADDRESS 0xD0001424 /end MEASUREMENT
/begin MEASUREMENT Ibs2_errstat "" UWORD Def_st_uw_q1 0 0 0.0 65535.0000 ECU_ADDRESS 0xD0001426 /end MEASUREMENT
/begin MEASUREMENT Ibs3_errstat "" UWORD Def_st_uw_q1 0 0 0.0 65535.0000 ECU_ADDRESS 0xD0001428 /end MEASUREMENT
/begin MEASUREMENT T_count_dibs1 "" UBYTE Def_i_ub_q1 0 0 0.0 255.0000 ECU_ADDRESS 0xD000142A /end MEASUREMENT
/begin MEASUREMENT T_count_dibs2 "" UBYTE Def_i_ub_q1 0 0 0.0 255.0000 ECU_ADDRESS 0xD000142B /end MEASUREMENT
/begin MEASUREMENT T_count_dibs3 "" UBYTE ident 0 0 0.0 255.0000 ECU_ADDRESS 0xD000142C /end MEASUREMENT
/begin MEASUREMENT T_count_dibs4 "" UBYTE ident 0 0 0.0 255.0000 ECU_ADDRESS 0xD000142D /end MEASUREMENT
/begin MEASUREMENT Ibsderrs2 "Fehlerzähler IBS EBSD Kommunikation" UWORD Def_dez_uw_q1 0 0 0.0 65535.0000 ECU_ADDRESS 0xD00095A6 /end MEASUREMENT
/begin MEASUREMENT Ibsderrs1 "Fehlerzähler IBS BSD Kommunikation" UBYTE Def_dez_ub_q1 0 0 0.0 255.0000 ECU_ADDRESS 0xD00095A3 /end MEASUREMENT
/begin MEASUREMENT Ibspreco2 "Vorteiler /10 fuer Ibsderrs2" UBYTE Def_dez_ub_q1 0 0 0.0 255.0000 ECU_ADDRESS 0xD00095A4 /end MEASUREMENT
/begin MEASUREMENT St_dqlt0.B_ozlerr "Messfehler Ölniveau" UBYTE Def_bit_ub_0 0 0 0.0 255.0 ECU_ADDRESS 0xD000001E BIT_MASK 0x1 /end MEASUREMENT
/begin MEASUREMENT St_dqlt0.B_ozqerr "Messfehler Ölzustand" UBYTE Def_bit_ub_1 0 0 0.0 255.0 ECU_ADDRESS 0xD000001E BIT_MASK 0x2 /end MEASUREMENT
/begin MEASUREMENT St_dqlt0.B_ozterr "Messfehler Öltemperatur" UBYTE Def_bit_ub_2 0 0 0.0 255.0 ECU_ADDRESS 0xD000001E BIT_MASK 0x4 /end MEASUREMENT
/begin MEASUREMENT St_dqlt0.B_td_ogerr "" UBYTE Def_bit_ub_3 0 0 0.0 255.0 ECU_ADDRESS 0xD000001E BIT_MASK 0x8 /end MEASUREMENT
/begin MEASUREMENT St_dqlt0.B_td_ogupl "" UBYTE Def_bit_ub_4 0 0 0.0 255.0 ECU_ADDRESS 0xD000001E BIT_MASK 0x10 /end MEASUREMENT
/begin MEASUREMENT St_dqlt0.B_ozkttoens "Töns-Sensor verbaut" UBYTE Def_bit_ub_5 0 0 0.0 255.0 ECU_ADDRESS 0xD000001E BIT_MASK 0x20 /end MEASUREMENT
/begin MEASUREMENT St_dqlt0.B_ozerrbsd "BSD global Fehler" UBYTE Def_bit_ub_6 0 0 0.0 255.0 ECU_ADDRESS 0xD000001E BIT_MASK 0x40 /end MEASUREMENT
/begin MEASUREMENT St_dqlt0.B_ozdiagnmotok "Motordrehzahl ok für die Diagnose" UBYTE Def_bit_ub_7 0 0 0.0 255.0 ECU_ADDRESS 0xD000001E BIT_MASK 0x80 /end MEASUREMENT
/begin MEASUREMENT St_dqlt0 "Statuswort" UBYTE Def_st_ub_q1 0 0 0.0 255.0000 ECU_ADDRESS 0xD000001E /end MEASUREMENT
/begin MEASUREMENT St_dqlt1.B_ozerr "Sensorfehler in FS eingetragen" UBYTE Def_bit_ub_0 0 0 0.0 255.0 ECU_ADDRESS 0xD000001F BIT_MASK 0x1 /end MEASUREMENT
/begin MEASUREMENT St_dqlt1.B_ozfbsd2 "BSD Sensor Fehler von FI_BSD_4" UBYTE Def_bit_ub_1 0 0 0.0 255.0 ECU_ADDRESS 0xD000001F BIT_MASK 0x2 /end MEASUREMENT
/begin MEASUREMENT St_dqlt1.B_oztemppl "QLT Temperatur unplausibel" UBYTE Def_bit_ub_2 0 0 0.0 255.0 ECU_ADDRESS 0xD000001F BIT_MASK 0x4 /end MEASUREMENT
/begin MEASUREMENT St_dqlt1 "Statuswort" UBYTE Def_st_ub_q1 0 0 0.0 255.0000 ECU_ADDRESS 0xD000001F /end MEASUREMENT
/begin MEASUREMENT St_oz_o.B_oztemic "QLT-Temic verbaut" UBYTE Def_bit_ub_0 0 0 0.0 255.0 ECU_ADDRESS 0xD000001D BIT_MASK 0x1 /end MEASUREMENT
/begin MEASUREMENT St_oz_o.B_mol_sf "Sensorfehler in FS eingetragen für CC-Meldung" UBYTE Def_bit_ub_1 0 0 0.0 255.0 ECU_ADDRESS 0xD000001D BIT_MASK 0x2 /end MEASUREMENT
/begin MEASUREMENT St_oz_o "Statuswort" UBYTE Def_st_ub_q1 0 0 0.0 255.0000 ECU_ADDRESS 0xD000001D /end MEASUREMENT
/begin MEASUREMENT Oz_permerrz "" UBYTE Def_dez_ub_q1 0 0 0.0 255.0000 ECU_ADDRESS 0xD00095A8 /end MEASUREMENT
/begin MEASUREMENT Oz_diagtoens "Töns Diagnose Byte" UWORD Def_dez_uw_q1 0 0 0.0 65535.0000 ECU_ADDRESS 0xD0001470 /end MEASUREMENT
/begin MEASUREMENT Oz_tempplz "Anzahl der unplausibel Sprünge QLT Temperatur" UBYTE Def_dez_ub_q1 0 0 0.0 255.0000 ECU_ADDRESS 0xD0001472 /end MEASUREMENT
/begin MEASUREMENT Oz_temprold "Alte QLT Temperatur für die Plausibilisierung" UBYTE Def_dez_ub_q1 0 0 0.0 255.0000 ECU_ADDRESS 0xD0001473 /end MEASUREMENT
/begin FUNCTION MSABS "" /begin DEF_CHARACTERISTIC K_MSADVKS K_MSANKS K_MSANST K_MSAVFT S_MSABS S_MSABSERR /end DEF_CHARACTERISTIC /begin REF_CHARACTERISTIC /end REF_CHARACTERISTIC /begin IN_MEASUREMENT /end IN_MEASUREMENT
 /begin OUT_MEASUREMENT Msa_vstart St_msaa St_msaa.B_msastart St_msaa.B_msastartf St_msaa.B_msastopp St_msaanz St_msaanz.B_msaakt St_msaanz.B_msaaktber St_msaanz.B_msaerr St_msaanz.B_msanakt St_msabs St_msabs.B_abwuergen St_msabs.B_msaftman St_msabs.B_msaftmaus St_msabs.B_msamhauf St_msabs.B_msastarts St_msabs.B_msastopp1 St_msabs.B_msastops St_msabs.B_msataste St_msabs1 St_msabs1.B_msaks St_msabs1.B_msastverl St_msabs1.B_msatastft St_msabsd St_msabsd.B_msabs00 St_msabsd.B_msabs01 St_msabsd.B_msabs02 St_msabsd.B_msabs03 St_msabsd.B_msabs04 St_msabsd.B_msabs05 St_msabsd.B_msabs06 St_msabsd.B_msabs07 St_msabsd.B_msabs08 St_msabsd.B_msabs09 St_msabsd.B_msabs10 St_msabsd.B_msabs11 St_msabsd.B_msabs12 St_msabsd.B_msabs13 St_msabsd.B_msabs14 St_msabsd.B_msabs15 Stmsa Stmsaaa Stmsaav Stmsaea Stmsaev /end OUT_MEASUREMENT
/end FUNCTION
/begin FUNCTION MSAEA "" /begin DEF_CHARACTERISTIC K_MSAPBREMSU K_MSAPWGE K_MSAVE S_PMMSAEA /end DEF_CHARACTERISTIC /begin REF_CHARACTERISTIC /end REF_CHARACTERISTIC /begin IN_MEASUREMENT /end IN_MEASUREMENT
 /begin OUT_MEASUREMENT St_msaea St_msaea.B_msaea St_msaea.B_msaeaauto St_msaea.B_msaeafa St_msaead St_msaead.B_msaea00 St_msaead.B_msaea01 St_msaead.B_msaea02 St_msaead.B_msaea03 St_msaead.B_msaea04 St_msaead.B_msaea05 /end OUT_MEASUREMENT
/end FUNCTION
/begin FUNCTION MSAEV "" /begin DEF_CHARACTERISTIC K_MSAMANTD K_MSASTTO /end DEF_CHARACTERISTIC /begin REF_CHARACTERISTIC /end REF_CHARACTERISTIC /begin IN_MEASUREMENT /end IN_MEASUREMENT
 /begin OUT_MEASUREMENT St_msaev St_msaev.B_msaev St_msaev.B_msastlock St_msaevd St_msaevd.B_msaev00 St_msaevd.B_msaev01 St_msaevd.B_msaev02 /end OUT_MEASUREMENT
/end FUNCTION
/begin FUNCTION NGANG ""
 /begin DEF_CHARACTERISTIC K_NGMAXLERN K_NGMINLERN K_NGOFFMAX K_NGOFFMIN K_NGSP K_NGSTABIL K_NGTK K_NGTSTL S_NGANG /end DEF_CHARACTERISTIC
 /begin REF_CHARACTERISTIC /end REF_CHARACTERISTIC
 /begin IN_MEASUREMENT /end IN_MEASUREMENT
 /begin OUT_MEASUREMENT St_ngang St_ngang0 St_ngang0.B_gangnull St_ngang0.B_ngangdok Tvneutral Tvngangalt /end OUT_MEASUREMENT
/end FUNCTION
/begin FUNCTION BGCRENG ""
 /begin DEF_CHARACTERISTIC KF_ELUPWM39 KF_ELUPWM60 KL_ELSLS KL_ELTEMP39 KL_ELTEMP60 KL_ELUB39 KL_ELUB60 KL_IABGLMOT KL_IABGLNL KL_IABGLST K_CRENGOF K_CRVVTNOT K_CRVVTOF K_IABGLMOT K_IABGLNL K_IABGLST K_IKEINESA /end DEF_CHARACTERISTIC
 /begin REF_CHARACTERISTIC /end REF_CHARACTERISTIC
 /begin IN_MEASUREMENT /end IN_MEASUREMENT
 /begin OUT_MEASUREMENT Fak_ttansel Fak_tubel I_craweng I_elu_vvt I_eluefter I_elupwm I_eluvfzg I_gle I_sls Vvt_ib1_2 Vvt_iges /end OUT_MEASUREMENT
/end FUNCTION
/begin FUNCTION BGLLGEN ""
 /begin DEF_CHARACTERISTIC K_DFRUTYP K_GENDFVORHS K_IGENLLRANH K_LLRABS_DF K_LLRANH_DF K_NTWBGLLGEN K_PRELLDFAH K_PRELLDFRF /end DEF_CHARACTERISTIC
 /begin REF_CHARACTERISTIC /end REF_CHARACTERISTIC
 /begin IN_MEASUREMENT /end IN_MEASUREMENT
 /begin OUT_MEASUREMENT Gen_dfvorhs Gen_dfvorhsnofil I_erripol1 I_erripol2 I_erripol3 Ierr_vorhs N_genll N_idlgspec St_bgllgen0 St_bgllgen0.B_hysllrah /end OUT_MEASUREMENT
/end FUNCTION
/begin FUNCTION BRWT ""
 /begin DEF_CHARACTERISTIC KF_DTW_QN KF_DTW_TWA KF_TAIRMHFMS KF_TAIR_MHFM KF_TWPST_MAP KL_COOLING K_BRWTDA K_BRWTKINT K_ENGSTSTRT K_QMIN S_BRWT /end DEF_CHARACTERISTIC
 /begin REF_CHARACTERISTIC /end REF_CHARACTERISTIC
 /begin IN_MEASUREMENT /end IN_MEASUREMENT
 /begin OUT_MEASUREMENT T_brw T_brwd1 T_brwd2 T_brwd3 T_brwd4 T_brwdg T_brwdiff T_brwnv T_brwsd T_brwsde /end OUT_MEASUREMENT
/end FUNCTION
/begin FUNCTION CO2MNG ""
 /begin DEF_CHARACTERISTIC K_APPCO2M2L K_APPMSAAV K_APPMSAEA K_APPMSAEACC K_DEAKMSA K_DSOCABSAV1 K_DSOCABSAV2 K_DSOCABSEA1 K_DSOCABSEA2 K_EDMSAONW K_IBZYKIGR K_IB_ZYKMSA K_IGRDSOC_MX K_IGRDSOC_OS K_IGRHIGHEN K_IGRMEDEN K_LANGFAV S_APPCO2IGRON S_APPCO2M2L S_APPIGRHION S_APPIGRMEON S_APPMSAON /end DEF_CHARACTERISTIC
 /begin REF_CHARACTERISTIC /end REF_CHARACTERISTIC
 /begin IN_MEASUREMENT /end IN_MEASUREMENT
 /begin OUT_MEASUREMENT Dsoc_abs Dsoc_igrmax Dsoc_igrmin Dsoc_msaav1 Dsoc_msaav2 Dsoc_msaea1 Dsoc_msaea2 St_co2mng St_co2mng.B_cdmsaonw St_co2mng.B_co2_igroff St_co2mng.B_co2_msaoff St_co2mng.B_igrhigh St_co2mng.B_igrmed St_co2mng.B_lang_fav St_co2mng.B_zykl_igroff St_co2mng.B_zykl_msaoff St_co2mng_1 St_co2mng_1.B_co2_av St_co2mng_1.B_co2_ea St_co2mng_1.B_co2_eacc St_co2mng_1.B_deakmsa /end OUT_MEASUREMENT
/end FUNCTION
/begin FUNCTION DGEN ""
 /begin DEF_CHARACTERISTIC K_GENPDTIME K_GEN_DNMIN K_MSKGENDFP K_MSKGENKL61 K_PLAUSAUS K_PLAUSEIN K_SNMBSDKL61 K_TD_UGENDIAG K_UGENDIAG K_UGOFFSET S_ENUGDIAG /end DEF_CHARACTERISTIC
 /begin REF_CHARACTERISTIC /end REF_CHARACTERISTIC
 /begin IN_MEASUREMENT /end IN_MEASUREMENT
 /begin OUT_MEASUREMENT Gen_fbsak Gen_statroh St_dgen0 St_dgen0.B_1stbsder St_dgen0.B_genfprl St_dgen0.B_gfbsupak St_dgen0.B_gfelak St_dgen0.B_gfhtak St_dgen0.B_gfmeak St_dgen0.B_gfnobsak St_dgen0.B_kl61 St_dgen1 St_dgen1.B_genudiag St_gen St_genbsd St_gengen /end OUT_MEASUREMENT
/end FUNCTION
/begin FUNCTION DIBS ""
 /begin DEF_CHARACTERISTIC K_MSKIBSDFP K_MSKIBSDFP2 K_MSKIBSDIAG K_MSKIBSERR K_MSKIBSERR2 S_BSDKOORD /end DEF_CHARACTERISTIC
 /begin REF_CHARACTERISTIC /end REF_CHARACTERISTIC
 /begin IN_MEASUREMENT /end IN_MEASUREMENT
 /begin OUT_MEASUREMENT Ibs1_errstat Ibs2_errstat Ibs3_errstat Ibsderrs1 Ibsderrs2 Ibspreco2 St_dibs0 St_dibs0.B_dibloc1 St_dibs0.B_dibloc2 St_dibs1 St_dibs1.B_ifbsak St_dibs1.B_ifebsak St_dibs1.B_ifuplak St_dibs2 St_dibs2.B_ifisak St_dibs2.B_ifsysak St_dibs2.B_iftempak St_dibs2.B_ifusak St_dibs2.B_ifwugdak St_dibs2.B_ifwuplak T_count_dibs1 T_count_dibs2 T_count_dibs3 T_count_dibs4 /end OUT_MEASUREMENT
/end FUNCTION
/begin FUNCTION DQLT ""
 /begin DEF_CHARACTERISTIC K_DTOG_UBMIN K_OZDELTOE K_OZDIAGNMOT K_OZDIAGNMOT2 K_OZDIAGSPG K_OZERRD K_OZHEAL K_OZPLTEMP K_OZPLZTEMP K_OZTEMPQERR K_OZZTEMP K_TOGMAXUNPL K_TOG_CNTMAX S_OZBSDKOORD /end DEF_CHARACTERISTIC
 /begin REF_CHARACTERISTIC /end REF_CHARACTERISTIC
 /begin IN_MEASUREMENT /end IN_MEASUREMENT
 /begin OUT_MEASUREMENT Oz_diagtoens Oz_permerrz Oz_tempplz Oz_temprold St_dqlt0 St_dqlt0.B_ozdiagnmotok St_dqlt0.B_ozerrbsd St_dqlt0.B_ozkttoens St_dqlt0.B_ozlerr St_dqlt0.B_ozqerr St_dqlt0.B_ozterr St_dqlt0.B_td_ogerr St_dqlt0.B_td_ogupl St_dqlt1 St_dqlt1.B_ozerr St_dqlt1.B_ozfbsd2 St_dqlt1.B_oztemppl St_oz_o St_oz_o.B_mol_sf St_oz_o.B_oztemic /end OUT_MEASUREMENT
/end FUNCTION
/begin COMPU_METHOD Def_dez_ub_q1 "Def_dez_ub_q1" RAT_FUNC "%3.0" "-" COEFFS 0 1 0 0 0 1 /end COMPU_METHOD
/begin COMPU_METHOD Def_dez_ul_q1 "Def_dez_ul_q1" RAT_FUNC "%7.0" "-" COEFFS 0 1 0 0 0 1 /end COMPU_METHOD
/begin COMPU_METHOD Def_dez_uw_q1 "Def_dez_uw_q1" RAT_FUNC "%5.0" "-" COEFFS 0 1 0 0 0 1 /end COMPU_METHOD
/begin COMPU_METHOD Def_st_ub_q1 "Def_st_ub_q1" RAT_FUNC "%3.0" "-" COEFFS 0 1 0 0 0 1 /end COMPU_METHOD
/begin COMPU_METHOD Def_f_ub_b100 "Def_f_ub_b100" RAT_FUNC "%5.2" "%" COEFFS 0 256 0 0 0 100 /end COMPU_METHOD
/begin COMPU_METHOD Def_f_sw_b100 "Def_f_sw_b100" RAT_FUNC "%8.3" "-" COEFFS 0 32768 0 0 0 100 /end COMPU_METHOD
/begin COMPU_METHOD Def_i_ub_q0p125 "Def_i_ub_q0p125" RAT_FUNC "%6.3" "A" COEFFS 0 8 0 0 0 1 /end COMPU_METHOD
/begin COMPU_METHOD Def_tv_ub_q0p390625 "Def_tv_ub_q0p390625" RAT_FUNC "%5.2" "%" COEFFS 0 256 0 0 0 100 /end COMPU_METHOD
/begin COMPU_METHOD Def_me_sw_q0p01 "Def_me_sw_q0p01" RAT_FUNC "%8.3" "mg/cyc" COEFFS 0 100 0 0 0 1 /end COMPU_METHOD
/begin COMPU_METHOD Def_ml_sw_q0p1 "Def_ml_sw_q0p1" RAT_FUNC "%7.2" "mg/Hub" COEFFS 0 10 0 0 0 1 /end COMPU_METHOD
/begin COMPU_METHOD Def_n_sw_q1p0 "Def_n_sw_q1p0" RAT_FUNC "%5.0" "Upm" COEFFS 0 1 0 0 0 1 /end COMPU_METHOD
/begin COMPU_METHOD Def_p_ub_q0p39 "Def_p_ub_q0p39" RAT_FUNC "%5.2" "Bar" COEFFS 0 256 0 0 0 100 /end COMPU_METHOD
/begin COMPU_METHOD Def_wdk_sw_q0p0244 "Def_wdk_sw_q0p0244" RAT_FUNC "%7.2" "%" COEFFS 0 4096 0 0 0 100 /end COMPU_METHOD
/begin COMPU_METHOD Def_bit_ub_1 "Def_bit_ub_1" TAB_VERB "%5.2" "-" COMPU_TAB_REF Def_bit_ub_1_VTAB /end COMPU_METHOD
/begin COMPU_METHOD Def_bit_ub_2 "Def_bit_ub_2" TAB_VERB "%5.2" "-" COMPU_TAB_REF Def_bit_ub_2_VTAB /end COMPU_METHOD
/begin COMPU_METHOD Def_bit_ub_0 "Def_bit_ub_0" TAB_VERB "%5.2" "-" COMPU_TAB_REF Def_bit_ub_0_VTAB /end COMPU_METHOD
/begin COMPU_METHOD Def_bit_ub_3 "Def_bit_ub_3" TAB_VERB "%5.2" "-" COMPU_TAB_REF Def_bit_ub_3_VTAB /end COMPU_METHOD
/begin COMPU_METHOD Def_bit_ub_4 "Def_bit_ub_4" TAB_VERB "%5.2" "-" COMPU_TAB_REF Def_bit_ub_4_VTAB /end COMPU_METHOD
/begin COMPU_METHOD Def_bit_ub_5 "Def_bit_ub_5" TAB_VERB "%5.2" "-" COMPU_TAB_REF Def_bit_ub_5_VTAB /end COMPU_METHOD
/begin COMPU_METHOD Def_bit_ub_6 "Def_bit_ub_6" TAB_VERB "%5.2" "-" COMPU_TAB_REF Def_bit_ub_6_VTAB /end COMPU_METHOD
/begin COMPU_METHOD Def_bit_ub_7 "Def_bit_ub_7" TAB_VERB "%5.2" "-" COMPU_TAB_REF Def_bit_ub_7_VTAB /end COMPU_METHOD
/begin COMPU_METHOD Def_bit_uw_0 "Def_bit_uw_0" TAB_VERB "%7.2" "-" COMPU_TAB_REF Def_bit_uw_0_VTAB /end COMPU_METHOD
/begin COMPU_METHOD Def_st_uw_q1 "Def_st_uw_q1" RAT_FUNC "%5.0" "-" COEFFS 0 1 0 0 0 1 /end COMPU_METHOD
/begin COMPU_METHOD Def_bit_uw_3 "Def_bit_uw_3" TAB_VERB "%7.2" "-" COMPU_TAB_REF Def_bit_uw_3_VTAB /end COMPU_METHOD
/begin COMPU_METHOD Def_bit_uw_5 "Def_bit_uw_5" TAB_VERB "%7.2" "-" COMPU_TAB_REF Def_bit_uw_5_VTAB /end COMPU_METHOD
/begin COMPU_METHOD Def_bit_uw_6 "Def_bit_uw_6" TAB_VERB "%7.2" "-" COMPU_TAB_REF Def_bit_uw_6_VTAB /end COMPU_METHOD
/begin COMPU_METHOD Def_bit_uw_1 "Def_bit_uw_1" TAB_VERB "%7.2" "-" COMPU_TAB_REF Def_bit_uw_1_VTAB /end COMPU_METHOD
/begin COMPU_METHOD Def_bit_uw_2 "Def_bit_uw_2" TAB_VERB "%7.2" "-" COMPU_TAB_REF Def_bit_uw_2_VTAB /end COMPU_METHOD
/begin COMPU_METHOD Def_bit_uw_4 "Def_bit_uw_4" TAB_VERB "%7.2" "-" COMPU_TAB_REF Def_bit_uw_4_VTAB /end COMPU_METHOD
/begin COMPU_METHOD Def_bit_uw_9 "Def_bit_uw_9" TAB_VERB "%7.2" "-" COMPU_TAB_REF Def_bit_uw_9_VTAB /end COMPU_METHOD
/begin COMPU_METHOD Def_bit_uw_11 "Def_bit_uw_11" TAB_VERB "%7.2" "-" COMPU_TAB_REF Def_bit_uw_11_VTAB /end COMPU_METHOD
/begin COMPU_METHOD Def_bit_uw_12 "Def_bit_uw_12" TAB_VERB "%7.2" "-" COMPU_TAB_REF Def_bit_uw_12_VTAB /end COMPU_METHOD
/begin COMPU_METHOD Def_t_sw_q0p1 "Def_t_sw_q0p1" RAT_FUNC "%6.1" "°C" COEFFS 0 10 0 0 0 1 /end COMPU_METHOD
/begin COMPU_METHOD Def_td_uw_q0p01 "Def_td_uw_q0p01" RAT_FUNC "%7.2" "s" COEFFS 0 100 0 0 0 1 /end COMPU_METHOD
/begin COMPU_METHOD Def_td_uw_q0p1 "Def_td_uw_q0p1" RAT_FUNC "%6.1" "s" COEFFS 0 10 0 0 0 1 /end COMPU_METHOD
/begin COMPU_METHOD Def_td_ub_q0p1 "Def_td_ub_q0p1" RAT_FUNC "%4.1" "s" COEFFS 0 10 0 0 0 1 /end COMPU_METHOD
/begin COMPU_METHOD Def_t_sw_q0p01 "Def_t_sw_q0p01" RAT_FUNC "%7.2" "°C" COEFFS 0 100 0 0 0 1 /end COMPU_METHOD
/begin COMPU_METHOD Def_tv_uw_q0p01 "Def_tv_uw_q0p01" RAT_FUNC "%7.2" "%" COEFFS 0 100 0 0 0 1 /end COMPU_METHOD
/begin COMPU_METHOD Def_u_uw_q0p0942 "Def_u_uw_q0p0942" RAT_FUNC "%6.1" "V" COEFFS 0 1 0 0 0 0.0942 /end COMPU_METHOD
/begin COMPU_METHOD Def_v_uw_q1p0 "Def_v_uw_q1p0" RAT_FUNC "%5.0" "km/h" COEFFS 0 1 0 0 0 1 /end COMPU_METHOD
/begin COMPU_METHOD Def_bit_ub_0 "Def_bit_ub_0" TAB_VERB "%5.2" "-" COMPU_TAB_REF Def_bit_ub_0_VTAB /end COMPU_METHOD
/begin COMPU_METHOD Def_bit_ub_1 "Def_bit_ub_1" TAB_VERB "%5.2" "-" COMPU_TAB_REF Def_bit_ub_1_VTAB /end COMPU_METHOD
/begin COMPU_METHOD Def_bit_ub_2 "Def_bit_ub_2" TAB_VERB "%5.2" "-" COMPU_TAB_REF Def_bit_ub_2_VTAB /end COMPU_METHOD
/begin COMPU_METHOD Def_bit_ub_3 "Def_bit_ub_3" TAB_VERB "%5.2" "-" COMPU_TAB_REF Def_bit_ub_3_VTAB /end COMPU_METHOD
/begin COMPU_METHOD Def_st_ub_q1 "Def_st_ub_q1" RAT_FUNC "%3.0" "-" COEFFS 0 1 0 0 0 1 /end COMPU_METHOD
/begin COMPU_METHOD Def_bit_uw_0 "Def_bit_uw_0" TAB_VERB "%7.2" "-" COMPU_TAB_REF Def_bit_uw_0_VTAB /end COMPU_METHOD
/begin COMPU_METHOD Def_bit_uw_1 "Def_bit_uw_1" TAB_VERB "%7.2" "-" COMPU_TAB_REF Def_bit_uw_1_VTAB /end COMPU_METHOD
/begin COMPU_METHOD Def_bit_uw_2 "Def_bit_uw_2" TAB_VERB "%7.2" "-" COMPU_TAB_REF Def_bit_uw_2_VTAB /end COMPU_METHOD
/begin COMPU_METHOD Def_bit_uw_3 "Def_bit_uw_3" TAB_VERB "%7.2" "-" COMPU_TAB_REF Def_bit_uw_3_VTAB /end COMPU_METHOD
/begin COMPU_METHOD Def_bit_uw_4 "Def_bit_uw_4" TAB_VERB "%7.2" "-" COMPU_TAB_REF Def_bit_uw_4_VTAB /end COMPU_METHOD
/begin COMPU_METHOD Def_bit_uw_5 "Def_bit_uw_5" TAB_VERB "%7.2" "-" COMPU_TAB_REF Def_bit_uw_5_VTAB /end COMPU_METHOD
/begin COMPU_METHOD Def_bit_uw_6 "Def_bit_uw_6" TAB_VERB "%7.2" "-" COMPU_TAB_REF Def_bit_uw_6_VTAB /end COMPU_METHOD
/begin COMPU_METHOD Def_st_uw_q1 "Def_st_uw_q1" RAT_FUNC "%5.0" "-" COEFFS 0 1 0 0 0 1 /end COMPU_METHOD
/begin COMPU_METHOD Def_wdk_sw_q0p0244 "Def_wdk_sw_q0p0244" RAT_FUNC "%7.2" "%" COEFFS 0 4096 0 0 0 100 /end COMPU_METHOD
/begin COMPU_METHOD Def_v_uw_q1p0 "Def_v_uw_q1p0" RAT_FUNC "%5.0" "km/h" COEFFS 0 1 0 0 0 1 /end COMPU_METHOD
/begin COMPU_METHOD Def_bit_ub_0 "Def_bit_ub_0" TAB_VERB "%5.2" "-" COMPU_TAB_REF Def_bit_ub_0_VTAB /end COMPU_METHOD
/begin COMPU_METHOD Def_st_ub_q1 "Def_st_ub_q1" RAT_FUNC "%3.0" "-" COEFFS 0 1 0 0 0 1 /end COMPU_METHOD
/begin COMPU_METHOD Def_bit_uw_0 "Def_bit_uw_0" TAB_VERB "%7.2" "-" COMPU_TAB_REF Def_bit_uw_0_VTAB /end COMPU_METHOD
/begin COMPU_METHOD Def_bit_uw_1 "Def_bit_uw_1" TAB_VERB "%7.2" "-" COMPU_TAB_REF Def_bit_uw_1_VTAB /end COMPU_METHOD
/begin COMPU_METHOD Def_bit_uw_2 "Def_bit_uw_2" TAB_VERB "%7.2" "-" COMPU_TAB_REF Def_bit_uw_2_VTAB /end COMPU_METHOD
/begin COMPU_METHOD Def_bit_uw_3 "Def_bit_uw_3" TAB_VERB "%7.2" "-" COMPU_TAB_REF Def_bit_uw_3_VTAB /end COMPU_METHOD
/begin COMPU_METHOD Def_bit_uw_4 "Def_bit_uw_4" TAB_VERB "%7.2" "-" COMPU_TAB_REF Def_bit_uw_4_VTAB /end COMPU_METHOD
/begin COMPU_METHOD Def_bit_uw_5 "Def_bit_uw_5" TAB_VERB "%7.2" "-" COMPU_TAB_REF Def_bit_uw_5_VTAB /end COMPU_METHOD
/begin COMPU_METHOD Def_bit_uw_6 "Def_bit_uw_6" TAB_VERB "%7.2" "-" COMPU_TAB_REF Def_bit_uw_6_VTAB /end COMPU_METHOD
/begin COMPU_METHOD Def_bit_uw_7 "Def_bit_uw_7" TAB_VERB "%7.2" "-" COMPU_TAB_REF Def_bit_uw_7_VTAB /end COMPU_METHOD
/begin COMPU_METHOD Def_bit_uw_8 "Def_bit_uw_8" TAB_VERB "%7.2" "-" COMPU_TAB_REF Def_bit_uw_8_VTAB /end COMPU_METHOD
/begin COMPU_METHOD Def_bit_uw_9 "Def_bit_uw_9" TAB_VERB "%7.2" "-" COMPU_TAB_REF Def_bit_uw_9_VTAB /end COMPU_METHOD
/begin COMPU_METHOD Def_bit_uw_10 "Def_bit_uw_10" TAB_VERB "%7.2" "-" COMPU_TAB_REF Def_bit_uw_10_VTAB /end COMPU_METHOD
/begin COMPU_METHOD Def_bit_uw_11 "Def_bit_uw_11" TAB_VERB "%7.2" "-" COMPU_TAB_REF Def_bit_uw_11_VTAB /end COMPU_METHOD
/begin COMPU_METHOD Def_bit_uw_12 "Def_bit_uw_12" TAB_VERB "%7.2" "-" COMPU_TAB_REF Def_bit_uw_12_VTAB /end COMPU_METHOD
/begin COMPU_METHOD Def_st_uw_q1 "Def_st_uw_q1" RAT_FUNC "%5.0" "-" COEFFS 0 1 0 0 0 1 /end COMPU_METHOD
/begin COMPU_METHOD Def_dez_ul_q1 "Def_dez_ul_q1" RAT_FUNC "%7.0" "-" COEFFS 0 1 0 0 0 1 /end COMPU_METHOD
/begin COMPU_METHOD Def_dez_ub_q1 "Def_dez_ub_q1" RAT_FUNC "%3.0" "-" COEFFS 0 1 0 0 0 1 /end COMPU_METHOD
/begin COMPU_METHOD Def_f_sw_b100 "Def_f_sw_b100" RAT_FUNC "%8.3" "-" COEFFS 0 32768 0 0 0 100 /end COMPU_METHOD
/begin COMPU_METHOD Def_t_sw_q0p1 "Def_t_sw_q0p1" RAT_FUNC "%6.1" "°C" COEFFS 0 10 0 0 0 1 /end COMPU_METHOD
/begin COMPU_METHOD Def_t_sw_q0p01 "Def_t_sw_q0p01" RAT_FUNC "%7.2" "°C" COEFFS 0 100 0 0 0 1 /end COMPU_METHOD
/begin COMPU_METHOD Def_p_ub_q0p39 "Def_p_ub_q0p39" RAT_FUNC "%5.2" "Bar" COEFFS 0 256 0 0 0 100 /end COMPU_METHOD
/begin COMPU_METHOD Def_bit_ub_0 "Def_bit_ub_0" TAB_VERB "%5.2" "-" COMPU_TAB_REF Def_bit_ub_0_VTAB /end COMPU_METHOD
/begin COMPU_METHOD Def_bit_ub_1 "Def_bit_ub_1" TAB_VERB "%5.2" "-" COMPU_TAB_REF Def_bit_ub_1_VTAB /end COMPU_METHOD
/begin COMPU_METHOD Def_bit_ub_2 "Def_bit_ub_2" TAB_VERB "%5.2" "-" COMPU_TAB_REF Def_bit_ub_2_VTAB /end COMPU_METHOD
/begin COMPU_METHOD Def_st_ub_q1 "Def_st_ub_q1" RAT_FUNC "%3.0" "-" COEFFS 0 1 0 0 0 1 /end COMPU_METHOD
/begin COMPU_METHOD Def_bit_uw_0 "Def_bit_uw_0" TAB_VERB "%7.2" "-" COMPU_TAB_REF Def_bit_uw_0_VTAB /end COMPU_METHOD
/begin COMPU_METHOD Def_bit_uw_1 "Def_bit_uw_1" TAB_VERB "%7.2" "-" COMPU_TAB_REF Def_bit_uw_1_VTAB /end COMPU_METHOD
/begin COMPU_METHOD Def_bit_uw_2 "Def_bit_uw_2" TAB_VERB "%7.2" "-" COMPU_TAB_REF Def_bit_uw_2_VTAB /end COMPU_METHOD
/begin COMPU_METHOD Def_bit_uw_3 "Def_bit_uw_3" TAB_VERB "%7.2" "-" COMPU_TAB_REF Def_bit_uw_3_VTAB /end COMPU_METHOD
/begin COMPU_METHOD Def_st_uw_q1 "Def_st_uw_q1" RAT_FUNC "%5.0" "-" COEFFS 0 1 0 0 0 1 /end COMPU_METHOD
/begin COMPU_METHOD Def_bit_ub_3 "Def_bit_ub_3" TAB_VERB "%5.2" "-" COMPU_TAB_REF Def_bit_ub_3_VTAB /end COMPU_METHOD
/begin COMPU_METHOD Def_bit_ub_4 "Def_bit_ub_4" TAB_VERB "%5.2" "-" COMPU_TAB_REF Def_bit_ub_4_VTAB /end COMPU_METHOD
/begin COMPU_METHOD Def_bit_ub_5 "Def_bit_ub_5" TAB_VERB "%5.2" "-" COMPU_TAB_REF Def_bit_ub_5_VTAB /end COMPU_METHOD
/begin COMPU_METHOD Def_bit_ub_6 "Def_bit_ub_6" TAB_VERB "%5.2" "-" COMPU_TAB_REF Def_bit_ub_6_VTAB /end COMPU_METHOD
/begin COMPU_METHOD Def_bit_ub_7 "Def_bit_ub_7" TAB_VERB "%5.2" "-" COMPU_TAB_REF Def_bit_ub_7_VTAB /end COMPU_METHOD
/begin COMPU_METHOD Def_bit_uw_4 "Def_bit_uw_4" TAB_VERB "%7.2" "-" COMPU_TAB_REF Def_bit_uw_4_VTAB /end COMPU_METHOD
/begin COMPU_METHOD Def_bit_uw_5 "Def_bit_uw_5" TAB_VERB "%7.2" "-" COMPU_TAB_REF Def_bit_uw_5_VTAB /end COMPU_METHOD
/begin COMPU_METHOD Def_bit_uw_6 "Def_bit_uw_6" TAB_VERB "%7.2" "-" COMPU_TAB_REF Def_bit_uw_6_VTAB /end COMPU_METHOD
/begin COMPU_METHOD Def_bit_uw_7 "Def_bit_uw_7" TAB_VERB "%7.2" "-" COMPU_TAB_REF Def_bit_uw_7_VTAB /end COMPU_METHOD
/begin COMPU_METHOD Def_bit_uw_8 "Def_bit_uw_8" TAB_VERB "%7.2" "-" COMPU_TAB_REF Def_bit_uw_8_VTAB /end COMPU_METHOD
/begin COMPU_METHOD Def_bit_uw_9 "Def_bit_uw_9" TAB_VERB "%7.2" "-" COMPU_TAB_REF Def_bit_uw_9_VTAB /end COMPU_METHOD
/begin COMPU_METHOD Def_bit_uw_10 "Def_bit_uw_10" TAB_VERB "%7.2" "-" COMPU_TAB_REF Def_bit_uw_10_VTAB /end COMPU_METHOD
/begin COMPU_METHOD Def_bit_uw_11 "Def_bit_uw_11" TAB_VERB "%7.2" "-" COMPU_TAB_REF Def_bit_uw_11_VTAB /end COMPU_METHOD
/begin COMPU_METHOD Def_bit_uw_12 "Def_bit_uw_12" TAB_VERB "%7.2" "-" COMPU_TAB_REF Def_bit_uw_12_VTAB /end COMPU_METHOD
/begin COMPU_METHOD Def_bit_uw_13 "Def_bit_uw_13" TAB_VERB "%7.2" "-" COMPU_TAB_REF Def_bit_uw_13_VTAB /end COMPU_METHOD
/begin COMPU_METHOD Def_bit_uw_14 "Def_bit_uw_14" TAB_VERB "%7.2" "-" COMPU_TAB_REF Def_bit_uw_14_VTAB /end COMPU_METHOD
/begin COMPU_METHOD Def_bit_uw_15 "Def_bit_uw_15" TAB_VERB "%7.2" "-" COMPU_TAB_REF Def_bit_uw_15_VTAB /end COMPU_METHOD
/begin COMPU_METHOD Def_dez_ul_q1 "Def_dez_ul_q1" RAT_FUNC "%7.0" "-" COEFFS 0 1 0 0 0 1 /end COMPU_METHOD
/begin COMPU_METHOD Def_v_uw_q1p0 "Def_v_uw_q1p0" RAT_FUNC "%5.0" "km/h" COEFFS 0 1 0 0 0 1 /end COMPU_METHOD
/begin COMPU_METHOD Def_n_sw_q1p0 "Def_n_sw_q1p0" RAT_FUNC "%5.0" "Upm" COEFFS 0 1 0 0 0 1 /end COMPU_METHOD
/begin COMPU_METHOD Def_dez_ub_q1 "Def_dez_ub_q1" RAT_FUNC "%3.0" "-" COEFFS 0 1 0 0 0 1 /end COMPU_METHOD
/begin COMPU_METHOD Def_bit_ub_0 "Def_bit_ub_0" TAB_VERB "%5.2" "-" COMPU_TAB_REF Def_bit_ub_0_VTAB /end COMPU_METHOD
/begin COMPU_METHOD Def_bit_ub_1 "Def_bit_ub_1" TAB_VERB "%5.2" "-" COMPU_TAB_REF Def_bit_ub_1_VTAB /end COMPU_METHOD
/begin COMPU_METHOD Def_bit_ub_2 "Def_bit_ub_2" TAB_VERB "%5.2" "-" COMPU_TAB_REF Def_bit_ub_2_VTAB /end COMPU_METHOD
/begin COMPU_METHOD Def_st_ub_q1 "Def_st_ub_q1" RAT_FUNC "%3.0" "-" COEFFS 0 1 0 0 0 1 /end COMPU_METHOD
/begin COMPU_METHOD Def_bit_uw_0 "Def_bit_uw_0" TAB_VERB "%7.2" "-" COMPU_TAB_REF Def_bit_uw_0_VTAB /end COMPU_METHOD
/begin COMPU_METHOD Def_bit_uw_1 "Def_bit_uw_1" TAB_VERB "%7.2" "-" COMPU_TAB_REF Def_bit_uw_1_VTAB /end COMPU_METHOD
/begin COMPU_METHOD Def_bit_uw_2 "Def_bit_uw_2" TAB_VERB "%7.2" "-" COMPU_TAB_REF Def_bit_uw_2_VTAB /end COMPU_METHOD
/begin COMPU_METHOD Def_bit_uw_3 "Def_bit_uw_3" TAB_VERB "%7.2" "-" COMPU_TAB_REF Def_bit_uw_3_VTAB /end COMPU_METHOD
/begin COMPU_METHOD Def_bit_uw_4 "Def_bit_uw_4" TAB_VERB "%7.2" "-" COMPU_TAB_REF Def_bit_uw_4_VTAB /end COMPU_METHOD
/begin COMPU_METHOD Def_bit_uw_5 "Def_bit_uw_5" TAB_VERB "%7.2" "-" COMPU_TAB_REF Def_bit_uw_5_VTAB /end COMPU_METHOD
/begin COMPU_METHOD Def_st_uw_q1 "Def_st_uw_q1" RAT_FUNC "%5.0" "-" COEFFS 0 1 0 0 0 1 /end COMPU_METHOD
/begin COMPU_METHOD Def_dez_ub_q1 "Def_dez_ub_q1" RAT_FUNC "%3.0" "-" COEFFS 0 1 0 0 0 1 /end COMPU_METHOD
/begin COMPU_METHOD Def_wdk_sw_q0p0244 "Def_wdk_sw_q0p0244" RAT_FUNC "%7.2" "%" COEFFS 0 4096 0 0 0 100 /end COMPU_METHOD
/begin COMPU_METHOD Def_v_uw_q1p0 "Def_v_uw_q1p0" RAT_FUNC "%5.0" "km/h" COEFFS 0 1 0 0 0 1 /end COMPU_METHOD
/begin COMPU_METHOD Def_p_ub_q0p39 "Def_p_ub_q0p39" RAT_FUNC "%5.2" "Bar" COEFFS 0 256 0 0 0 100 /end COMPU_METHOD
/begin COMPU_METHOD Def_bit_ub_0 "Def_bit_ub_0" TAB_VERB "%5.2" "-" COMPU_TAB_REF Def_bit_ub_0_VTAB /end COMPU_METHOD
/begin COMPU_METHOD Def_bit_ub_1 "Def_bit_ub_1" TAB_VERB "%5.2" "-" COMPU_TAB_REF Def_bit_ub_1_VTAB /end COMPU_METHOD
/begin COMPU_METHOD Def_st_ub_q1 "Def_st_ub_q1" RAT_FUNC "%3.0" "-" COEFFS 0 1 0 0 0 1 /end COMPU_METHOD
/begin COMPU_METHOD Def_bit_uw_0 "Def_bit_uw_0" TAB_VERB "%7.2" "-" COMPU_TAB_REF Def_bit_uw_0_VTAB /end COMPU_METHOD
/begin COMPU_METHOD Def_bit_uw_1 "Def_bit_uw_1" TAB_VERB "%7.2" "-" COMPU_TAB_REF Def_bit_uw_1_VTAB /end COMPU_METHOD
/begin COMPU_METHOD Def_bit_uw_2 "Def_bit_uw_2" TAB_VERB "%7.2" "-" COMPU_TAB_REF Def_bit_uw_2_VTAB /end COMPU_METHOD
/begin COMPU_METHOD Def_st_uw_q1 "Def_st_uw_q1" RAT_FUNC "%5.0" "-" COEFFS 0 1 0 0 0 1 /end COMPU_METHOD
/begin COMPU_METHOD Def_td_ub_q0p1 "Def_td_ub_q0p1" RAT_FUNC "%4.1" "s" COEFFS 0 10 0 0 0 1 /end COMPU_METHOD
/begin COMPU_METHOD Def_bit_ub_0 "Def_bit_ub_0" TAB_VERB "%5.2" "-" COMPU_TAB_REF Def_bit_ub_0_VTAB /end COMPU_METHOD
/begin COMPU_METHOD Def_bit_ub_1 "Def_bit_ub_1" TAB_VERB "%5.2" "-" COMPU_TAB_REF Def_bit_ub_1_VTAB /end COMPU_METHOD
/begin COMPU_METHOD Def_st_ub_q1 "Def_st_ub_q1" RAT_FUNC "%3.0" "-" COEFFS 0 1 0 0 0 1 /end COMPU_METHOD
/begin COMPU_METHOD Def_tv_uw_q0p01 "Def_tv_uw_q0p01" RAT_FUNC "%7.2" "%" COEFFS 0 100 0 0 0 1 /end COMPU_METHOD
/begin COMPU_METHOD Def_dez_ub_q1 "Def_dez_ub_q1" RAT_FUNC "%3.0" "-" COEFFS 0 1 0 0 0 1 /end COMPU_METHOD
/begin COMPU_METHOD Def_u_uw_q0p0942 "Def_u_uw_q0p0942" RAT_FUNC "%6.1" "V" COEFFS 0 1 0 0 0 0.0942 /end COMPU_METHOD
/begin COMPU_METHOD Def_td10ms_uw_b655p35 "Def_td10ms_uw_b655p35" RAT_FUNC "%7.2" "s" COEFFS 0 100 0 0 0 1 /end COMPU_METHOD
/begin COMPU_METHOD Def_i_sw_q1 "Def_i_sw_q1" RAT_FUNC "%8.3" "A" COEFFS 0 1 0 0 0 1 /end COMPU_METHOD
/begin COMPU_METHOD Def_f_uw_b512 "Def_f_uw_b512" RAT_FUNC "%8.3" "-" COEFFS 0 65536 0 0 0 512 /end COMPU_METHOD
/begin COMPU_METHOD Def_i_uw_q0p0635 "Def_i_uw_q0p0635" RAT_FUNC "%8.3" "A" COEFFS 0 65536 0 0 0 4096 /end COMPU_METHOD
/begin COMPU_METHOD Def_i_sw_q0p001 "Def_i_sw_q0p001" RAT_FUNC "%8.3" "A" COEFFS 0 1000 0 0 0 1 /end COMPU_METHOD
/begin COMPU_METHOD Def_t_sw_q0p1 "Def_t_sw_q0p1" RAT_FUNC "%6.1" "°C" COEFFS 0 10 0 0 0 1 /end COMPU_METHOD
/begin COMPU_METHOD Def_u_uw_q0p0942 "Def_u_uw_q0p0942" RAT_FUNC "%6.1" "V" COEFFS 0 1 0 0 0 0.0942 /end COMPU_METHOD
/begin COMPU_METHOD Def_f_ub_b8 "Def_f_ub_b8" RAT_FUNC "%5.2" "-" COEFFS 0 256 0 0 0 8 /end COMPU_METHOD
/begin COMPU_METHOD Def_v_uw_q1p0 "Def_v_uw_q1p0" RAT_FUNC "%5.0" "km/h" COEFFS 0 1 0 0 0 1 /end COMPU_METHOD
/begin COMPU_METHOD Def_tv_ub_q0p390625 "Def_tv_ub_q0p390625" RAT_FUNC "%5.2" "%" COEFFS 0 256 0 0 0 100 /end COMPU_METHOD
/begin COMPU_METHOD Def_bit_ub_0 "Def_bit_ub_0" TAB_VERB "%5.2" "-" COMPU_TAB_REF Def_bit_ub_0_VTAB /end COMPU_METHOD
/begin COMPU_METHOD Def_st_ub_q1 "Def_st_ub_q1" RAT_FUNC "%3.0" "-" COEFFS 0 1 0 0 0 1 /end COMPU_METHOD
/begin COMPU_METHOD Def_n_sw_q1p0 "Def_n_sw_q1p0" RAT_FUNC "%5.0" "Upm" COEFFS 0 1 0 0 0 1 /end COMPU_METHOD
/begin COMPU_METHOD Def_f_ub_b100 "Def_f_ub_b100" RAT_FUNC "%5.2" "%" COEFFS 0 256 0 0 0 100 /end COMPU_METHOD
/begin COMPU_METHOD Def_i_ub_q0p125 "Def_i_ub_q0p125" RAT_FUNC "%6.3" "A" COEFFS 0 8 0 0 0 1 /end COMPU_METHOD
/begin COMPU_METHOD Def_f_ub_b1 "Def_f_ub_b1" RAT_FUNC "%6.3" "-" COEFFS 0 256 0 0 0 1 /end COMPU_METHOD
/begin COMPU_METHOD Def_i_ub_q1 "Def_i_ub_q1" RAT_FUNC "%6.3" "" COEFFS 0 1 0 0 0 1 /end COMPU_METHOD
/begin COMPU_METHOD Def_td_ub_q0p1 "Def_td_ub_q0p1" RAT_FUNC "%4.1" "s" COEFFS 0 10 0 0 0 1 /end COMPU_METHOD
/begin COMPU_METHOD Def_t_sw_q0p1 "Def_t_sw_q0p1" RAT_FUNC "%6.1" "°C" COEFFS 0 10 0 0 0 1 /end COMPU_METHOD
/begin COMPU_METHOD Def_t_sw_q0p01 "Def_t_sw_q0p01" RAT_FUNC "%7.2" "°C" COEFFS 0 100 0 0 0 1 /end COMPU_METHOD
/begin COMPU_METHOD Def_me_sw_q0p01 "Def_me_sw_q0p01" RAT_FUNC "%8.3" "mg/cyc" COEFFS 0 100 0 0 0 1 /end COMPU_METHOD
/begin COMPU_METHOD Def_dez_uw_q1 "Def_dez_uw_q1" RAT_FUNC "%5.0" "-" COEFFS 0 1 0 0 0 1 /end COMPU_METHOD
/begin COMPU_METHOD ident "ident" RAT_FUNC "%3.0" "-" COEFFS 0 1 0 0 0 1 /end COMPU_METHOD
/begin COMPU_METHOD Def_dez_ub_q1 "Def_dez_ub_q1" RAT_FUNC "%3.0" "-" COEFFS 0 1 0 0 0 1 /end COMPU_METHOD
/begin COMPU_METHOD Def_f_ub_b1 "Def_f_ub_b1" RAT_FUNC "%6.3" "-" COEFFS 0 256 0 0 0 1 /end COMPU_METHOD
/begin COMPU_METHOD Def_ml_sw_q0p1 "Def_ml_sw_q0p1" RAT_FUNC "%7.2" "mg/Hub" COEFFS 0 10 0 0 0 1 /end COMPU_METHOD
/begin COMPU_METHOD Def_n_sw_q1p0 "Def_n_sw_q1p0" RAT_FUNC "%5.0" "Upm" COEFFS 0 1 0 0 0 1 /end COMPU_METHOD
/begin COMPU_METHOD Def_bit_ub_0 "Def_bit_ub_0" TAB_VERB "%5.2" "-" COMPU_TAB_REF Def_bit_ub_0_VTAB /end COMPU_METHOD
/begin COMPU_METHOD Def_bit_ub_1 "Def_bit_ub_1" TAB_VERB "%5.2" "-" COMPU_TAB_REF Def_bit_ub_1_VTAB /end COMPU_METHOD
/begin COMPU_METHOD Def_bit_ub_2 "Def_bit_ub_2" TAB_VERB "%5.2" "-" COMPU_TAB_REF Def_bit_ub_2_VTAB /end COMPU_METHOD
/begin COMPU_METHOD Def_bit_ub_3 "Def_bit_ub_3" TAB_VERB "%5.2" "-" COMPU_TAB_REF Def_bit_ub_3_VTAB /end COMPU_METHOD
/begin COMPU_METHOD Def_bit_ub_4 "Def_bit_ub_4" TAB_VERB "%5.2" "-" COMPU_TAB_REF Def_bit_ub_4_VTAB /end COMPU_METHOD
/begin COMPU_METHOD Def_bit_ub_5 "Def_bit_ub_5" TAB_VERB "%5.2" "-" COMPU_TAB_REF Def_bit_ub_5_VTAB /end COMPU_METHOD
/begin COMPU_METHOD Def_bit_ub_6 "Def_bit_ub_6" TAB_VERB "%5.2" "-" COMPU_TAB_REF Def_bit_ub_6_VTAB /end COMPU_METHOD
/begin COMPU_METHOD Def_bit_ub_7 "Def_bit_ub_7" TAB_VERB "%5.2" "-" COMPU_TAB_REF Def_bit_ub_7_VTAB /end COMPU_METHOD
/begin COMPU_METHOD Def_st_ub_q1 "Def_st_ub_q1" RAT_FUNC "%3.0" "-" COEFFS 0 1 0 0 0 1 /end COMPU_METHOD
/begin COMPU_METHOD Def_f_sw_b100 "Def_f_sw_b100" RAT_FUNC "%8.3" "-" COEFFS 0 32768 0 0 0 100 /end COMPU_METHOD
/begin COMPU_METHOD Def_i_uw_q0p08_o200 "Def_i_uw_q0p08_o200" RAT_FUNC "%8.3" "" COEFFS 0 25 5000 0 0 2 /end COMPU_METHOD
/begin COMPU_METHOD Identity "Identity" RAT_FUNC "%3.0" "-" COEFFS 0 1 0 0 0 1 /end COMPU_METHOD
/begin COMPU_METHOD Def_bit_ub_0 "Def_bit_ub_0" TAB_VERB "%5.2" "-" COMPU_TAB_REF Def_bit_ub_0_VTAB /end COMPU_METHOD
/begin COMPU_METHOD Def_bit_ub_1 "Def_bit_ub_1" TAB_VERB "%5.2" "-" COMPU_TAB_REF Def_bit_ub_1_VTAB /end COMPU_METHOD
/begin COMPU_METHOD Def_bit_ub_2 "Def_bit_ub_2" TAB_VERB "%5.2" "-" COMPU_TAB_REF Def_bit_ub_2_VTAB /end COMPU_METHOD
/begin COMPU_METHOD Def_bit_ub_3 "Def_bit_ub_3" TAB_VERB "%5.2" "-" COMPU_TAB_REF Def_bit_ub_3_VTAB /end COMPU_METHOD
/begin COMPU_METHOD Def_bit_ub_4 "Def_bit_ub_4" TAB_VERB "%5.2" "-" COMPU_TAB_REF Def_bit_ub_4_VTAB /end COMPU_METHOD
/begin COMPU_METHOD Def_bit_ub_5 "Def_bit_ub_5" TAB_VERB "%5.2" "-" COMPU_TAB_REF Def_bit_ub_5_VTAB /end COMPU_METHOD
/begin COMPU_METHOD Def_bit_ub_6 "Def_bit_ub_6" TAB_VERB "%5.2" "-" COMPU_TAB_REF Def_bit_ub_6_VTAB /end COMPU_METHOD
/begin COMPU_METHOD Def_bit_ub_7 "Def_bit_ub_7" TAB_VERB "%5.2" "-" COMPU_TAB_REF Def_bit_ub_7_VTAB /end COMPU_METHOD
/begin COMPU_METHOD Def_st_ub_q1 "Def_st_ub_q1" RAT_FUNC "%3.0" "-" COEFFS 0 1 0 0 0 1 /end COMPU_METHOD
/begin COMPU_METHOD Def_st_uw_q1 "Def_st_uw_q1" RAT_FUNC "%5.0" "-" COEFFS 0 1 0 0 0 1 /end COMPU_METHOD
/begin COMPU_METHOD Def_n_sw_q1p0 "Def_n_sw_q1p0" RAT_FUNC "%5.0" "Upm" COEFFS 0 1 0 0 0 1 /end COMPU_METHOD
/begin COMPU_METHOD Def_td_uw_q0p1 "Def_td_uw_q0p1" RAT_FUNC "%6.1" "s" COEFFS 0 10 0 0 0 1 /end COMPU_METHOD
/begin COMPU_METHOD Def_u_uw_q0p0942 "Def_u_uw_q0p0942" RAT_FUNC "%6.1" "V" COEFFS 0 1 0 0 0 0.0942 /end COMPU_METHOD
/begin COMPU_METHOD Def_td_ub_q0p1 "Def_td_ub_q0p1" RAT_FUNC "%4.1" "s" COEFFS 0 10 0 0 0 1 /end COMPU_METHOD
/begin COMPU_METHOD Identity "Identity" RAT_FUNC "%3.0" "-" COEFFS 0 1 0 0 0 1 /end COMPU_METHOD
/begin COMPU_METHOD Def_bit_ub_2 "Def_bit_ub_2" TAB_VERB "%5.2" "-" COMPU_TAB_REF Def_bit_ub_2_VTAB /end COMPU_METHOD
/begin COMPU_METHOD Def_bit_ub_3 "Def_bit_ub_3" TAB_VERB "%5.2" "-" COMPU_TAB_REF Def_bit_ub_3_VTAB /end COMPU_METHOD
/begin COMPU_METHOD Def_bit_ub_4 "Def_bit_ub_4" TAB_VERB "%5.2" "-" COMPU_TAB_REF Def_bit_ub_4_VTAB /end COMPU_METHOD
/begin COMPU_METHOD Def_st_ub_q1 "Def_st_ub_q1" RAT_FUNC "%3.0" "-" COEFFS 0 1 0 0 0 1 /end COMPU_METHOD
/begin COMPU_METHOD Def_bit_ub_0 "Def_bit_ub_0" TAB_VERB "%5.2" "-" COMPU_TAB_REF Def_bit_ub_0_VTAB /end COMPU_METHOD
/begin COMPU_METHOD Def_bit_ub_1 "Def_bit_ub_1" TAB_VERB "%5.2" "-" COMPU_TAB_REF Def_bit_ub_1_VTAB /end COMPU_METHOD
/begin COMPU_METHOD Def_bit_ub_5 "Def_bit_ub_5" TAB_VERB "%5.2" "-" COMPU_TAB_REF Def_bit_ub_5_VTAB /end COMPU_METHOD
/begin COMPU_METHOD Def_st_uw_q1 "Def_st_uw_q1" RAT_FUNC "%5.0" "-" COEFFS 0 1 0 0 0 1 /end COMPU_METHOD
/begin COMPU_METHOD Def_i_ub_q1 "Def_i_ub_q1" RAT_FUNC "%6.3" "" COEFFS 0 1 0 0 0 1 /end COMPU_METHOD
/begin COMPU_METHOD ident "ident" RAT_FUNC "%3.0" "-" COEFFS 0 1 0 0 0 1 /end COMPU_METHOD
/begin COMPU_METHOD Def_dez_uw_q1 "Def_dez_uw_q1" RAT_FUNC "%5.0" "-" COEFFS 0 1 0 0 0 1 /end COMPU_METHOD
/begin COMPU_METHOD Def_dez_ub_q1 "Def_dez_ub_q1" RAT_FUNC "%3.0" "-" COEFFS 0 1 0 0 0 1 /end COMPU_METHOD
/begin COMPU_METHOD Identity "Identity" RAT_FUNC "%3.0" "-" COEFFS 0 1 0 0 0 1 /end COMPU_METHOD
/begin COMPU_METHOD Def_bit_ub_0 "Def_bit_ub_0" TAB_VERB "%5.2" "-" COMPU_TAB_REF Def_bit_ub_0_VTAB /end COMPU_METHOD
/begin COMPU_METHOD Def_bit_ub_1 "Def_bit_ub_1" TAB_VERB "%5.2" "-" COMPU_TAB_REF Def_bit_ub_1_VTAB /end COMPU_METHOD
/begin COMPU_METHOD Def_bit_ub_2 "Def_bit_ub_2" TAB_VERB "%5.2" "-" COMPU_TAB_REF Def_bit_ub_2_VTAB /end COMPU_METHOD
/begin COMPU_METHOD Def_bit_ub_3 "Def_bit_ub_3" TAB_VERB "%5.2" "-" COMPU_TAB_REF Def_bit_ub_3_VTAB /end COMPU_METHOD
/begin COMPU_METHOD Def_bit_ub_4 "Def_bit_ub_4" TAB_VERB "%5.2" "-" COMPU_TAB_REF Def_bit_ub_4_VTAB /end COMPU_METHOD
/begin COMPU_METHOD Def_bit_ub_5 "Def_bit_ub_5" TAB_VERB "%5.2" "-" COMPU_TAB_REF Def_bit_ub_5_VTAB /end COMPU_METHOD
/begin COMPU_METHOD Def_bit_ub_6 "Def_bit_ub_6" TAB_VERB "%5.2" "-" COMPU_TAB_REF Def_bit_ub_6_VTAB /end COMPU_METHOD
/begin COMPU_METHOD Def_bit_ub_7 "Def_bit_ub_7" TAB_VERB "%5.2" "-" COMPU_TAB_REF Def_bit_ub_7_VTAB /end COMPU_METHOD
/begin COMPU_METHOD Def_st_ub_q1 "Def_st_ub_q1" RAT_FUNC "%3.0" "-" COEFFS 0 1 0 0 0 1 /end COMPU_METHOD
/begin COMPU_METHOD Def_dez_ub_q1 "Def_dez_ub_q1" RAT_FUNC "%3.0" "-" COEFFS 0 1 0 0 0 1 /end COMPU_METHOD
/begin COMPU_METHOD Def_dez_uw_q1 "Def_dez_uw_q1" RAT_FUNC "%5.0" "-" COEFFS 0 1 0 0 0 1 /end COMPU_METHOD
/begin COMPU_METHOD Def_n_sw_q1p0 "Def_n_sw_q1p0" RAT_FUNC "%5.0" "Upm" COEFFS 0 1 0 0 0 1 /end COMPU_METHOD
/begin COMPU_METHOD Def_t_sw_q0p1 "Def_t_sw_q0p1" RAT_FUNC "%6.1" "°C" COEFFS 0 10 0 0 0 1 /end COMPU_METHOD
/begin COMPU_METHOD Def_u_uw_q0p0942 "Def_u_uw_q0p0942" RAT_FUNC "%6.1" "V" COEFFS 0 1 0 0 0 0.0942 /end COMPU_METHOD
/begin COMPU_METHOD Def_td_uw_q0p01 "Def_td_uw_q0p01" RAT_FUNC "%7.2" "s" COEFFS 0 100 0 0 0 1 /end COMPU_METHOD
/begin COMPU_METHOD Def_bit_ub_0 "Def_bit_ub_0" TAB_VERB "%5.2" "-" COMPU_TAB_REF Def_bit_ub_0_VTAB /end COMPU_METHOD
/begin COMPU_METHOD Def_bit_ub_1 "Def_bit_ub_1" TAB_VERB "%5.2" "-" COMPU_TAB_REF Def_bit_ub_1_VTAB /end COMPU_METHOD
/begin COMPU_METHOD Def_bit_ub_3 "Def_bit_ub_3" TAB_VERB "%5.2" "-" COMPU_TAB_REF Def_bit_ub_3_VTAB /end COMPU_METHOD
/begin COMPU_METHOD Def_bit_ub_5 "Def_bit_ub_5" TAB_VERB "%5.2" "-" COMPU_TAB_REF Def_bit_ub_5_VTAB /end COMPU_METHOD
/begin COMPU_METHOD Def_bit_ub_6 "Def_bit_ub_6" TAB_VERB "%5.2" "-" COMPU_TAB_REF Def_bit_ub_6_VTAB /end COMPU_METHOD
/begin COMPU_METHOD Def_bit_ub_7 "Def_bit_ub_7" TAB_VERB "%5.2" "-" COMPU_TAB_REF Def_bit_ub_7_VTAB /end COMPU_METHOD
/begin COMPU_METHOD Def_st_ub_q1 "Def_st_ub_q1" RAT_FUNC "%3.0" "-" COEFFS 0 1 0 0 0 1 /end COMPU_METHOD
/begin COMPU_METHOD Def_bit_ub_2 "Def_bit_ub_2" TAB_VERB "%5.2" "-" COMPU_TAB_REF Def_bit_ub_2_VTAB /end COMPU_METHOD
/begin COMPU_METHOD Def_bit_ub_4 "Def_bit_ub_4" TAB_VERB "%5.2" "-" COMPU_TAB_REF Def_bit_ub_4_VTAB /end COMPU_METHOD
/begin COMPU_METHOD Def_dez_ub_q1 "Def_dez_ub_q1" RAT_FUNC "%3.0" "-" COEFFS 0 1 0 0 0 1 /end COMPU_METHOD
/begin COMPU_METHOD Def_n_sw_q1p0 "Def_n_sw_q1p0" RAT_FUNC "%5.0" "Upm" COEFFS 0 1 0 0 0 1 /end COMPU_METHOD
/begin COMPU_METHOD Def_td_uw_q0p1 "Def_td_uw_q0p1" RAT_FUNC "%6.1" "s" COEFFS 0 10 0 0 0 1 /end COMPU_METHOD
/begin COMPU_METHOD Def_wdk_sw_q0p0244 "Def_wdk_sw_q0p0244" RAT_FUNC "%7.2" "%" COEFFS 0 4096 0 0 0 100 /end COMPU_METHOD
/begin COMPU_METHOD Def_dez_uw_q1 "Def_dez_uw_q1" RAT_FUNC "%5.0" "-" COEFFS 0 1 0 0 0 1 /end COMPU_METHOD
/begin COMPU_METHOD Def_v_uw_q1p0 "Def_v_uw_q1p0" RAT_FUNC "%5.0" "km/h" COEFFS 0 1 0 0 0 1 /end COMPU_METHOD
/begin COMPU_METHOD Identity "Identity" RAT_FUNC "%3.0" "-" COEFFS 0 1 0 0 0 1 /end COMPU_METHOD
/begin COMPU_METHOD Def_t_sw_q0p01 "Def_t_sw_q0p01" RAT_FUNC "%7.2" "°C" COEFFS 0 100 0 0 0 1 /end COMPU_METHOD
/begin COMPU_METHOD Def_bit_ub_0 "Def_bit_ub_0" TAB_VERB "%5.2" "-" COMPU_TAB_REF Def_bit_ub_0_VTAB /end COMPU_METHOD
/begin COMPU_METHOD Def_bit_ub_1 "Def_bit_ub_1" TAB_VERB "%5.2" "-" COMPU_TAB_REF Def_bit_ub_1_VTAB /end COMPU_METHOD
/begin COMPU_METHOD Def_bit_ub_2 "Def_bit_ub_2" TAB_VERB "%5.2" "-" COMPU_TAB_REF Def_bit_ub_2_VTAB /end COMPU_METHOD
/begin COMPU_METHOD Def_bit_ub_4 "Def_bit_ub_4" TAB_VERB "%5.2" "-" COMPU_TAB_REF Def_bit_ub_4_VTAB /end COMPU_METHOD
/begin COMPU_METHOD Def_bit_ub_5 "Def_bit_ub_5" TAB_VERB "%5.2" "-" COMPU_TAB_REF Def_bit_ub_5_VTAB /end COMPU_METHOD
/begin COMPU_METHOD Def_st_ub_q1 "Def_st_ub_q1" RAT_FUNC "%3.0" "-" COEFFS 0 1 0 0 0 1 /end COMPU_METHOD
/begin COMPU_METHOD Def_ml_sw_q0p1 "Def_ml_sw_q0p1" RAT_FUNC "%7.2" "mg/Hub" COEFFS 0 10 0 0 0 1 /end COMPU_METHOD
/begin COMPU_METHOD Def_dez_uw_q1 "Def_dez_uw_q1" RAT_FUNC "%5.0" "-" COEFFS 0 1 0 0 0 1 /end COMPU_METHOD
/begin COMPU_METHOD Def_dez_ub_q1 "Def_dez_ub_q1" RAT_FUNC "%3.0" "-" COEFFS 0 1 0 0 0 1 /end COMPU_METHOD
/begin COMPU_METHOD Def_dez_ul_q1 "Def_dez_ul_q1" RAT_FUNC "%7.0" "-" COEFFS 0 1 0 0 0 1 /end COMPU_METHOD
/begin COMPU_METHOD Def_me_sw_q0p01 "Def_me_sw_q0p01" RAT_FUNC "%8.3" "mg/cyc" COEFFS 0 100 0 0 0 1 /end COMPU_METHOD
/begin COMPU_METHOD Def_n_sw_q1p0 "Def_n_sw_q1p0" RAT_FUNC "%5.0" "Upm" COEFFS 0 1 0 0 0 1 /end COMPU_METHOD
/begin COMPU_METHOD Identity "Identity" RAT_FUNC "%3.0" "-" COEFFS 0 1 0 0 0 1 /end COMPU_METHOD
/begin COMPU_METHOD Def_bit_ub_0 "Def_bit_ub_0" TAB_VERB "%5.2" "-" COMPU_TAB_REF Def_bit_ub_0_VTAB /end COMPU_METHOD
/begin COMPU_METHOD Def_st_ub_q1 "Def_st_ub_q1" RAT_FUNC "%3.0" "-" COEFFS 0 1 0 0 0 1 /end COMPU_METHOD
/begin COMPU_METHOD Def_dez_ul_q1 "Def_dez_ul_q1" RAT_FUNC "%7.0" "-" COEFFS 0 1 0 0 0 1 /end COMPU_METHOD
/begin COMPU_METHOD Def_td_ub_q0p1 "Def_td_ub_q0p1" RAT_FUNC "%4.1" "s" COEFFS 0 10 0 0 0 1 /end COMPU_METHOD
/begin COMPU_METHOD Def_dez_ub_q1 "Def_dez_ub_q1" RAT_FUNC "%3.0" "-" COEFFS 0 1 0 0 0 1 /end COMPU_METHOD
/begin COMPU_METHOD Def_bit_ub_0 "Def_bit_ub_0" TAB_VERB "%5.2" "-" COMPU_TAB_REF Def_bit_ub_0_VTAB /end COMPU_METHOD
/begin COMPU_METHOD Def_bit_ub_1 "Def_bit_ub_1" TAB_VERB "%5.2" "-" COMPU_TAB_REF Def_bit_ub_1_VTAB /end COMPU_METHOD
/begin COMPU_METHOD Def_bit_ub_2 "Def_bit_ub_2" TAB_VERB "%5.2" "-" COMPU_TAB_REF Def_bit_ub_2_VTAB /end COMPU_METHOD
/begin COMPU_METHOD Def_bit_ub_3 "Def_bit_ub_3" TAB_VERB "%5.2" "-" COMPU_TAB_REF Def_bit_ub_3_VTAB /end COMPU_METHOD
/begin COMPU_METHOD Def_bit_ub_4 "Def_bit_ub_4" TAB_VERB "%5.2" "-" COMPU_TAB_REF Def_bit_ub_4_VTAB /end COMPU_METHOD
/begin COMPU_METHOD Def_st_ub_q1 "Def_st_ub_q1" RAT_FUNC "%3.0" "-" COEFFS 0 1 0 0 0 1 /end COMPU_METHOD
/begin COMPU_METHOD Def_dez_ub_q1 "Def_dez_ub_q1" RAT_FUNC "%3.0" "-" COEFFS 0 1 0 0 0 1 /end COMPU_METHOD
/begin COMPU_METHOD Def_f_ub_b100 "Def_f_ub_b100" RAT_FUNC "%5.2" "%" COEFFS 0 256 0 0 0 100 /end COMPU_METHOD
/begin COMPU_METHOD Def_td_ub_q0p1 "Def_td_ub_q0p1" RAT_FUNC "%4.1" "s" COEFFS 0 10 0 0 0 1 /end COMPU_METHOD
/begin COMPU_METHOD Def_bit_ub_0 "Def_bit_ub_0" TAB_VERB "%5.2" "-" COMPU_TAB_REF Def_bit_ub_0_VTAB /end COMPU_METHOD
/begin COMPU_METHOD Def_bit_ub_1 "Def_bit_ub_1" TAB_VERB "%5.2" "-" COMPU_TAB_REF Def_bit_ub_1_VTAB /end COMPU_METHOD
/begin COMPU_METHOD Def_bit_ub_2 "Def_bit_ub_2" TAB_VERB "%5.2" "-" COMPU_TAB_REF Def_bit_ub_2_VTAB /end COMPU_METHOD
/begin COMPU_METHOD Def_bit_ub_3 "Def_bit_ub_3" TAB_VERB "%5.2" "-" COMPU_TAB_REF Def_bit_ub_3_VTAB /end COMPU_METHOD
/begin COMPU_METHOD Def_bit_ub_4 "Def_bit_ub_4" TAB_VERB "%5.2" "-" COMPU_TAB_REF Def_bit_ub_4_VTAB /end COMPU_METHOD
/begin COMPU_METHOD Def_bit_ub_5 "Def_bit_ub_5" TAB_VERB "%5.2" "-" COMPU_TAB_REF Def_bit_ub_5_VTAB /end COMPU_METHOD
/begin COMPU_METHOD Def_bit_ub_6 "Def_bit_ub_6" TAB_VERB "%5.2" "-" COMPU_TAB_REF Def_bit_ub_6_VTAB /end COMPU_METHOD
/begin COMPU_METHOD Def_bit_ub_7 "Def_bit_ub_7" TAB_VERB "%5.2" "-" COMPU_TAB_REF Def_bit_ub_7_VTAB /end COMPU_METHOD
/begin COMPU_METHOD Def_st_ub_q1 "Def_st_ub_q1" RAT_FUNC "%3.0" "-" COEFFS 0 1 0 0 0 1 /end COMPU_METHOD
/begin COMPU_METHOD Def_dez_ub_q1 "Def_dez_ub_q1" RAT_FUNC "%3.0" "-" COEFFS 0 1 0 0 0 1 /end COMPU_METHOD
/begin COMPU_METHOD Def_dez_ul_q1 "Def_dez_ul_q1" RAT_FUNC "%7.0" "-" COEFFS 0 1 0 0 0 1 /end COMPU_METHOD
/begin COMPU_METHOD Def_f_ub_b100 "Def_f_ub_b100" RAT_FUNC "%5.2" "%" COEFFS 0 256 0 0 0 100 /end COMPU_METHOD
/begin COMPU_METHOD Def_td_ub_q0p1 "Def_td_ub_q0p1" RAT_FUNC "%4.1" "s" COEFFS 0 10 0 0 0 1 /end COMPU_METHOD
/begin COMPU_METHOD Def_bit_ub_0 "Def_bit_ub_0" TAB_VERB "%5.2" "-" COMPU_TAB_REF Def_bit_ub_0_VTAB /end COMPU_METHOD
/begin COMPU_METHOD Def_bit_ub_1 "Def_bit_ub_1" TAB_VERB "%5.2" "-" COMPU_TAB_REF Def_bit_ub_1_VTAB /end COMPU_METHOD
/begin COMPU_METHOD Def_st_ub_q1 "Def_st_ub_q1" RAT_FUNC "%3.0" "-" COEFFS 0 1 0 0 0 1 /end COMPU_METHOD
/begin COMPU_METHOD Def_v_uw_q1p0 "Def_v_uw_q1p0" RAT_FUNC "%5.0" "km/h" COEFFS 0 1 0 0 0 1 /end COMPU_METHOD
/begin COMPU_METHOD ident "ident" RAT_FUNC "%3.0" "-" COEFFS 0 1 0 0 0 1 /end COMPU_METHOD
/begin COMPU_METHOD Identity "Identity" RAT_FUNC "%3.0" "-" COEFFS 0 1 0 0 0 1 /end COMPU_METHOD
/begin COMPU_METHOD Def_bit_ub_1 "Def_bit_ub_1" TAB_VERB "%5.2" "-" COMPU_TAB_REF Def_bit_ub_1_VTAB /end COMPU_METHOD
/begin COMPU_METHOD Def_bit_ub_2 "Def_bit_ub_2" TAB_VERB "%5.2" "-" COMPU_TAB_REF Def_bit_ub_2_VTAB /end COMPU_METHOD
/begin COMPU_METHOD Def_bit_ub_3 "Def_bit_ub_3" TAB_VERB "%5.2" "-" COMPU_TAB_REF Def_bit_ub_3_VTAB /end COMPU_METHOD
/begin COMPU_METHOD Def_st_ub_q1 "Def_st_ub_q1" RAT_FUNC "%3.0" "-" COEFFS 0 1 0 0 0 1 /end COMPU_METHOD
/begin COMPU_METHOD Def_bit_ub_0 "Def_bit_ub_0" TAB_VERB "%5.2" "-" COMPU_TAB_REF Def_bit_ub_0_VTAB /end COMPU_METHOD
/begin COMPU_METHOD Def_t_sw_q0p1 "Def_t_sw_q0p1" RAT_FUNC "%6.1" "°C" COEFFS 0 10 0 0 0 1 /end COMPU_METHOD
/begin COMPU_METHOD Def_n_sw_q1p0 "Def_n_sw_q1p0" RAT_FUNC "%5.0" "Upm" COEFFS 0 1 0 0 0 1 /end COMPU_METHOD
/begin COMPU_METHOD Def_i_ub_q1 "Def_i_ub_q1" RAT_FUNC "%6.3" "" COEFFS 0 1 0 0 0 1 /end COMPU_METHOD
/begin COMPU_METHOD Def_f_ub_b100 "Def_f_ub_b100" RAT_FUNC "%5.2" "%" COEFFS 0 256 0 0 0 100 /end COMPU_METHOD
/begin COMPU_METHOD Def_td_uw_q0p01 "Def_td_uw_q0p01" RAT_FUNC "%7.2" "s" COEFFS 0 100 0 0 0 1 /end COMPU_METHOD
/begin COMPU_METHOD Def_td_uw_q0p1 "Def_td_uw_q0p1" RAT_FUNC "%6.1" "s" COEFFS 0 10 0 0 0 1 /end COMPU_METHOD
/begin COMPU_METHOD Def_f_ub_b1 "Def_f_ub_b1" RAT_FUNC "%6.3" "-" COEFFS 0 256 0 0 0 1 /end COMPU_METHOD
/begin COMPU_METHOD Def_bit_ub_0 "Def_bit_ub_0" TAB_VERB "%5.2" "-" COMPU_TAB_REF Def_bit_ub_0_VTAB /end COMPU_METHOD
/begin COMPU_METHOD Def_bit_ub_1 "Def_bit_ub_1" TAB_VERB "%5.2" "-" COMPU_TAB_REF Def_bit_ub_1_VTAB /end COMPU_METHOD
/begin COMPU_METHOD Def_st_ub_q1 "Def_st_ub_q1" RAT_FUNC "%3.0" "-" COEFFS 0 1 0 0 0 1 /end COMPU_METHOD
/begin COMPU_METHOD Def_dez_ub_q1 "Def_dez_ub_q1" RAT_FUNC "%3.0" "-" COEFFS 0 1 0 0 0 1 /end COMPU_METHOD
/begin COMPU_METHOD Def_n_sw_q1p0 "Def_n_sw_q1p0" RAT_FUNC "%5.0" "Upm" COEFFS 0 1 0 0 0 1 /end COMPU_METHOD
/begin COMPU_METHOD Def_td_uw_q0p01 "Def_td_uw_q0p01" RAT_FUNC "%7.2" "s" COEFFS 0 100 0 0 0 1 /end COMPU_METHOD
/begin COMPU_METHOD Identity "Identity" RAT_FUNC "%3.0" "-" COEFFS 0 1 0 0 0 1 /end COMPU_METHOD
/begin COMPU_METHOD Def_i_ub_q0p125 "Def_i_ub_q0p125" RAT_FUNC "%6.3" "A" COEFFS 0 8 0 0 0 1 /end COMPU_METHOD
/begin COMPU_METHOD Def_st_ub_q1 "Def_st_ub_q1" RAT_FUNC "%3.0" "-" COEFFS 0 1 0 0 0 1 /end COMPU_METHOD
/begin COMPU_METHOD Def_bit_ub_0 "Def_bit_ub_0" TAB_VERB "%5.2" "-" COMPU_TAB_REF Def_bit_ub_0_VTAB /end COMPU_METHOD
/begin COMPU_METHOD Def_dez_ub_q1 "Def_dez_ub_q1" RAT_FUNC "%3.0" "-" COEFFS 0 1 0 0 0 1 /end COMPU_METHOD
/begin COMPU_METHOD Def_i_ub_q0p125 "Def_i_ub_q0p125" RAT_FUNC "%6.3" "A" COEFFS 0 8 0 0 0 1 /end COMPU_METHOD
/begin COMPU_METHOD Def_dez_uw_q1 "Def_dez_uw_q1" RAT_FUNC "%5.0" "-" COEFFS 0 1 0 0 0 1 /end COMPU_METHOD
/begin COMPU_METHOD Def_dez_ul_q1 "Def_dez_ul_q1" RAT_FUNC "%7.0" "-" COEFFS 0 1 0 0 0 1 /end COMPU_METHOD
/begin COMPU_METHOD Def_bit_ub_0 "Def_bit_ub_0" TAB_VERB "%5.2" "-" COMPU_TAB_REF Def_bit_ub_0_VTAB /end COMPU_METHOD
/begin COMPU_METHOD Def_bit_ub_1 "Def_bit_ub_1" TAB_VERB "%5.2" "-" COMPU_TAB_REF Def_bit_ub_1_VTAB /end COMPU_METHOD
/begin COMPU_METHOD Def_st_ub_q1 "Def_st_ub_q1" RAT_FUNC "%3.0" "-" COEFFS 0 1 0 0 0 1 /end COMPU_METHOD
/begin COMPU_METHOD Def_dez_ub_q1 "Def_dez_ub_q1" RAT_FUNC "%3.0" "-" COEFFS 0 1 0 0 0 1 /end COMPU_METHOD
/begin COMPU_METHOD Def_n_sw_q1p0 "Def_n_sw_q1p0" RAT_FUNC "%5.0" "Upm" COEFFS 0 1 0 0 0 1 /end COMPU_METHOD
/begin COMPU_METHOD Def_t_sw_q0p1 "Def_t_sw_q0p1" RAT_FUNC "%6.1" "°C" COEFFS 0 10 0 0 0 1 /end COMPU_METHOD
/begin COMPU_METHOD Def_t_sw_q0p01 "Def_t_sw_q0p01" RAT_FUNC "%7.2" "°C" COEFFS 0 100 0 0 0 1 /end COMPU_METHOD
/begin COMPU_METHOD Def_st_uw_q1 "Def_st_uw_q1" RAT_FUNC "%5.0" "-" COEFFS 0 1 0 0 0 1 /end COMPU_METHOD
/begin COMPU_METHOD Def_td_uw_q0p1 "Def_td_uw_q0p1" RAT_FUNC "%6.1" "s" COEFFS 0 10 0 0 0 1 /end COMPU_METHOD
/begin COMPU_METHOD Def_v_uw_q1p0 "Def_v_uw_q1p0" RAT_FUNC "%5.0" "km/h" COEFFS 0 1 0 0 0 1 /end COMPU_METHOD
/begin COMPU_METHOD Identity "Identity" RAT_FUNC "%3.0" "-" COEFFS 0 1 0 0 0 1 /end COMPU_METHOD
/begin COMPU_METHOD Def_bit_ub_0 "Def_bit_ub_0" TAB_VERB "%5.2" "-" COMPU_TAB_REF Def_bit_ub_0_VTAB /end COMPU_METHOD
/begin COMPU_METHOD Def_bit_ub_1 "Def_bit_ub_1" TAB_VERB "%5.2" "-" COMPU_TAB_REF Def_bit_ub_1_VTAB /end COMPU_METHOD
/begin COMPU_METHOD Def_st_ub_q1 "Def_st_ub_q1" RAT_FUNC "%3.0" "-" COEFFS 0 1 0 0 0 1 /end COMPU_METHOD
/begin COMPU_METHOD Def_td_ub_q0p1 "Def_td_ub_q0p1" RAT_FUNC "%4.1" "s" COEFFS 0 10 0 0 0 1 /end COMPU_METHOD
/begin COMPU_METHOD Def_dez_ub_q1 "Def_dez_ub_q1" RAT_FUNC "%3.0" "-" COEFFS 0 1 0 0 0 1 /end COMPU_METHOD
/begin COMPU_METHOD Identity "Identity" RAT_FUNC "%3.0" "-" COEFFS 0 1 0 0 0 1 /end COMPU_METHOD
/begin COMPU_METHOD Def_t_sw_q0p01 "Def_t_sw_q0p01" RAT_FUNC "%7.2" "°C" COEFFS 0 100 0 0 0 1 /end COMPU_METHOD
/begin COMPU_METHOD Def_n_sw_q1p0 "Def_n_sw_q1p0" RAT_FUNC "%5.0" "Upm" COEFFS 0 1 0 0 0 1 /end COMPU_METHOD
/begin COMPU_METHOD Def_i_ub_q0p125 "Def_i_ub_q0p125" RAT_FUNC "%6.3" "A" COEFFS 0 8 0 0 0 1 /end COMPU_METHOD
/begin COMPU_METHOD Def_st_ub_q1 "Def_st_ub_q1" RAT_FUNC "%3.0" "-" COEFFS 0 1 0 0 0 1 /end COMPU_METHOD
/begin COMPU_METHOD Def_bit_ub_0 "Def_bit_ub_0" TAB_VERB "%5.2" "-" COMPU_TAB_REF Def_bit_ub_0_VTAB /end COMPU_METHOD
/begin COMPU_METHOD Def_bit_ub_1 "Def_bit_ub_1" TAB_VERB "%5.2" "-" COMPU_TAB_REF Def_bit_ub_1_VTAB /end COMPU_METHOD
/begin COMPU_METHOD Def_bit_ub_2 "Def_bit_ub_2" TAB_VERB "%5.2" "-" COMPU_TAB_REF Def_bit_ub_2_VTAB /end COMPU_METHOD
/begin COMPU_METHOD Def_bit_ub_3 "Def_bit_ub_3" TAB_VERB "%5.2" "-" COMPU_TAB_REF Def_bit_ub_3_VTAB /end COMPU_METHOD
/begin COMPU_METHOD Def_bit_ub_4 "Def_bit_ub_4" TAB_VERB "%5.2" "-" COMPU_TAB_REF Def_bit_ub_4_VTAB /end COMPU_METHOD
/begin COMPU_METHOD Def_dez_ub_q1 "Def_dez_ub_q1" RAT_FUNC "%3.0" "-" COEFFS 0 1 0 0 0 1 /end COMPU_METHOD
/begin COMPU_METHOD Def_td_uw_q0p01 "Def_td_uw_q0p01" RAT_FUNC "%7.2" "s" COEFFS 0 100 0 0 0 1 /end COMPU_METHOD
/begin COMPU_METHOD Def_wdk_sw_q0p0244 "Def_wdk_sw_q0p0244" RAT_FUNC "%7.2" "%" COEFFS 0 4096 0 0 0 100 /end COMPU_METHOD
/begin COMPU_METHOD Def_n_sw_q1p0 "Def_n_sw_q1p0" RAT_FUNC "%5.0" "Upm" COEFFS 0 1 0 0 0 1 /end COMPU_METHOD
/begin COMPU_METHOD Def_td_ub_q0p1 "Def_td_ub_q0p1" RAT_FUNC "%4.1" "s" COEFFS 0 10 0 0 0 1 /end COMPU_METHOD
/begin COMPU_METHOD Def_t_sw_q0p1 "Def_t_sw_q0p1" RAT_FUNC "%6.1" "°C" COEFFS 0 10 0 0 0 1 /end COMPU_METHOD
/begin COMPU_METHOD Def_v_uw_q1p0 "Def_v_uw_q1p0" RAT_FUNC "%5.0" "km/h" COEFFS 0 1 0 0 0 1 /end COMPU_METHOD
/begin COMPU_METHOD Def_t_sw_q0p01 "Def_t_sw_q0p01" RAT_FUNC "%7.2" "°C" COEFFS 0 100 0 0 0 1 /end COMPU_METHOD
/begin COMPU_METHOD Def_dez_ub_q1 "Def_dez_ub_q1" RAT_FUNC "%3.0" "-" COEFFS 0 1 0 0 0 1 /end COMPU_METHOD
/begin COMPU_METHOD Def_st_ub_q1 "Def_st_ub_q1" RAT_FUNC "%3.0" "-" COEFFS 0 1 0 0 0 1 /end COMPU_METHOD
/begin COMPU_METHOD Def_bit_ub_0 "Def_bit_ub_0" TAB_VERB "%5.2" "-" COMPU_TAB_REF Def_bit_ub_0_VTAB /end COMPU_METHOD
/begin COMPU_METHOD Def_bit_ub_1 "Def_bit_ub_1" TAB_VERB "%5.2" "-" COMPU_TAB_REF Def_bit_ub_1_VTAB /end COMPU_METHOD
/begin COMPU_METHOD Def_bit_ub_2 "Def_bit_ub_2" TAB_VERB "%5.2" "-" COMPU_TAB_REF Def_bit_ub_2_VTAB /end COMPU_METHOD
/begin COMPU_METHOD Def_bit_ub_0 "Def_bit_ub_0" TAB_VERB "%5.2" "-" COMPU_TAB_REF Def_bit_ub_0_VTAB /end COMPU_METHOD
/begin COMPU_METHOD Def_st_ub_q1 "Def_st_ub_q1" RAT_FUNC "%3.0" "-" COEFFS 0 1 0 0 0 1 /end COMPU_METHOD
/begin COMPU_METHOD Def_bit_ub_1 "Def_bit_ub_1" TAB_VERB "%5.2" "-" COMPU_TAB_REF Def_bit_ub_1_VTAB /end COMPU_METHOD
/begin COMPU_METHOD Def_bit_ub_4 "Def_bit_ub_4" TAB_VERB "%5.2" "-" COMPU_TAB_REF Def_bit_ub_4_VTAB /end COMPU_METHOD
/begin COMPU_METHOD Def_bit_ub_5 "Def_bit_ub_5" TAB_VERB "%5.2" "-" COMPU_TAB_REF Def_bit_ub_5_VTAB /end COMPU_METHOD
/begin COMPU_METHOD Def_bit_ub_3 "Def_bit_ub_3" TAB_VERB "%5.2" "-" COMPU_TAB_REF Def_bit_ub_3_VTAB /end COMPU_METHOD
/begin COMPU_METHOD Def_dez_ub_q1 "Def_dez_ub_q1" RAT_FUNC "%3.0" "-" COEFFS 0 1 0 0 0 1 /end COMPU_METHOD
/begin COMPU_METHOD Def_bit_ub_2 "Def_bit_ub_2" TAB_VERB "%5.2" "-" COMPU_TAB_REF Def_bit_ub_2_VTAB /end COMPU_METHOD
/begin COMPU_METHOD Def_dez_uw_q1 "Def_dez_uw_q1" RAT_FUNC "%5.0" "-" COEFFS 0 1 0 0 0 1 /end COMPU_METHOD
/begin COMPU_METHOD Def_i_uw_q0p08_o200 "Def_i_uw_q0p08_o200" RAT_FUNC "%8.3" "" COEFFS 0 25 5000 0 0 2 /end COMPU_METHOD
/begin COMPU_METHOD Def_t_sw_q0p1 "Def_t_sw_q0p1" RAT_FUNC "%6.1" "°C" COEFFS 0 10 0 0 0 1 /end COMPU_METHOD
/begin COMPU_METHOD Def_dez_ul_q1 "Def_dez_ul_q1" RAT_FUNC "%7.0" "-" COEFFS 0 1 0 0 0 1 /end COMPU_METHOD
/begin COMPU_METHOD ident "ident" RAT_FUNC "%3.0" "-" COEFFS 0 1 0 0 0 1 /end COMPU_METHOD
/begin COMPU_METHOD Def_bit_ub_0 "Def_bit_ub_0" TAB_VERB "%5.2" "-" COMPU_TAB_REF Def_bit_ub_0_VTAB /end COMPU_METHOD
/begin COMPU_METHOD Def_st_ub_q1 "Def_st_ub_q1" RAT_FUNC "%3.0" "-" COEFFS 0 1 0 0 0 1 /end COMPU_METHOD
/begin COMPU_METHOD Def_n_sw_q1p0 "Def_n_sw_q1p0" RAT_FUNC "%5.0" "Upm" COEFFS 0 1 0 0 0 1 /end COMPU_METHOD
/begin COMPU_METHOD Def_u_uw_q0p0942 "Def_u_uw_q0p0942" RAT_FUNC "%6.1" "V" COEFFS 0 1 0 0 0 0.0942 /end COMPU_METHOD
/begin COMPU_METHOD Def_f_ub_b100 "Def_f_ub_b100" RAT_FUNC "%5.2" "%" COEFFS 0 256 0 0 0 100 /end COMPU_METHOD
/begin COMPU_METHOD Def_dez_ub_q1 "Def_dez_ub_q1" RAT_FUNC "%3.0" "-" COEFFS 0 1 0 0 0 1 /end COMPU_METHOD
/begin COMPU_METHOD Def_i_ub_q0p125 "Def_i_ub_q0p125" RAT_FUNC "%6.3" "A" COEFFS 0 8 0 0 0 1 /end COMPU_METHOD
/begin COMPU_METHOD Def_td_uw_q0p01 "Def_td_uw_q0p01" RAT_FUNC "%7.2" "s" COEFFS 0 100 0 0 0 1 /end COMPU_METHOD
/begin COMPU_METHOD Def_f_ub_b1 "Def_f_ub_b1" RAT_FUNC "%6.3" "-" COEFFS 0 256 0 0 0 1 /end COMPU_METHOD
/begin COMPU_METHOD Def_t_sw_q0p1 "Def_t_sw_q0p1" RAT_FUNC "%6.1" "°C" COEFFS 0 10 0 0 0 1 /end COMPU_METHOD
/begin COMPU_METHOD Def_st_ub_q1 "Def_st_ub_q1" RAT_FUNC "%3.0" "-" COEFFS 0 1 0 0 0 1 /end COMPU_METHOD
/begin COMPU_METHOD Def_f_sw_b100 "Def_f_sw_b100" RAT_FUNC "%8.3" "-" COEFFS 0 32768 0 0 0 100 /end COMPU_METHOD
/begin COMPU_METHOD Def_n_sw_q1p0 "Def_n_sw_q1p0" RAT_FUNC "%5.0" "Upm" COEFFS 0 1 0 0 0 1 /end COMPU_METHOD
/begin COMPU_METHOD Def_f_ub_b100 "Def_f_ub_b100" RAT_FUNC "%5.2" "%" COEFFS 0 256 0 0 0 100 /end COMPU_METHOD
/begin COMPU_METHOD Identity "Identity" RAT_FUNC "%3.0" "-" COEFFS 0 1 0 0 0 1 /end COMPU_METHOD
/begin COMPU_METHOD Def_bit_ub_0 "Def_bit_ub_0" TAB_VERB "%5.2" "-" COMPU_TAB_REF Def_bit_ub_0_VTAB /end COMPU_METHOD
/begin COMPU_METHOD Def_bit_ub_1 "Def_bit_ub_1" TAB_VERB "%5.2" "-" COMPU_TAB_REF Def_bit_ub_1_VTAB /end COMPU_METHOD
/begin COMPU_METHOD Def_bit_ub_2 "Def_bit_ub_2" TAB_VERB "%5.2" "-" COMPU_TAB_REF Def_bit_ub_2_VTAB /end COMPU_METHOD
/begin COMPU_METHOD Def_st_ub_q1 "Def_st_ub_q1" RAT_FUNC "%3.0" "-" COEFFS 0 1 0 0 0 1 /end COMPU_METHOD
/begin COMPU_METHOD Def_n_sw_q1p0 "Def_n_sw_q1p0" RAT_FUNC "%5.0" "Upm" COEFFS 0 1 0 0 0 1 /end COMPU_METHOD
/begin COMPU_METHOD Def_bit_uw_0 "Def_bit_uw_0" TAB_VERB "%7.2" "-" COMPU_TAB_REF Def_bit_uw_0_VTAB /end COMPU_METHOD
/begin COMPU_METHOD Def_bit_uw_1 "Def_bit_uw_1" TAB_VERB "%7.2" "-" COMPU_TAB_REF Def_bit_uw_1_VTAB /end COMPU_METHOD
/begin COMPU_METHOD Def_bit_uw_2 "Def_bit_uw_2" TAB_VERB "%7.2" "-" COMPU_TAB_REF Def_bit_uw_2_VTAB /end COMPU_METHOD
/begin COMPU_METHOD Def_bit_uw_3 "Def_bit_uw_3" TAB_VERB "%7.2" "-" COMPU_TAB_REF Def_bit_uw_3_VTAB /end COMPU_METHOD
/begin COMPU_METHOD Def_bit_uw_4 "Def_bit_uw_4" TAB_VERB "%7.2" "-" COMPU_TAB_REF Def_bit_uw_4_VTAB /end COMPU_METHOD
/begin COMPU_METHOD Def_bit_uw_5 "Def_bit_uw_5" TAB_VERB "%7.2" "-" COMPU_TAB_REF Def_bit_uw_5_VTAB /end COMPU_METHOD
/begin COMPU_METHOD Def_bit_uw_6 "Def_bit_uw_6" TAB_VERB "%7.2" "-" COMPU_TAB_REF Def_bit_uw_6_VTAB /end COMPU_METHOD
/begin COMPU_METHOD Def_bit_uw_7 "Def_bit_uw_7" TAB_VERB "%7.2" "-" COMPU_TAB_REF Def_bit_uw_7_VTAB /end COMPU_METHOD
/begin COMPU_METHOD Def_bit_uw_8 "Def_bit_uw_8" TAB_VERB "%7.2" "-" COMPU_TAB_REF Def_bit_uw_8_VTAB /end COMPU_METHOD
/begin COMPU_METHOD Def_st_uw_q1 "Def_st_uw_q1" RAT_FUNC "%5.0" "-" COEFFS 0 1 0 0 0 1 /end COMPU_METHOD
/begin COMPU_METHOD Def_dez_ul_q1 "Def_dez_ul_q1" RAT_FUNC "%7.0" "-" COEFFS 0 1 0 0 0 1 /end COMPU_METHOD
/begin COMPU_METHOD Def_dez_uw_q1 "Def_dez_uw_q1" RAT_FUNC "%5.0" "-" COEFFS 0 1 0 0 0 1 /end COMPU_METHOD
/begin COMPU_METHOD Def_dez_ub_q1 "Def_dez_ub_q1" RAT_FUNC "%3.0" "-" COEFFS 0 1 0 0 0 1 /end COMPU_METHOD
/begin COMPU_METHOD Def_me_sw_q0p01 "Def_me_sw_q0p01" RAT_FUNC "%8.3" "mg/cyc" COEFFS 0 100 0 0 0 1 /end COMPU_METHOD
/begin COMPU_METHOD Def_ml_sw_q0p1 "Def_ml_sw_q0p1" RAT_FUNC "%7.2" "mg/Hub" COEFFS 0 10 0 0 0 1 /end COMPU_METHOD
/begin COMPU_METHOD Def_n_sw_q1p0 "Def_n_sw_q1p0" RAT_FUNC "%5.0" "Upm" COEFFS 0 1 0 0 0 1 /end COMPU_METHOD
/begin COMPU_METHOD Def_t_sw_q0p01 "Def_t_sw_q0p01" RAT_FUNC "%7.2" "°C" COEFFS 0 100 0 0 0 1 /end COMPU_METHOD
/begin COMPU_METHOD Def_f_ub_b1 "Def_f_ub_b1" RAT_FUNC "%6.3" "-" COEFFS 0 256 0 0 0 1 /end COMPU_METHOD
/begin COMPU_METHOD Def_bit_ub_0 "Def_bit_ub_0" TAB_VERB "%5.2" "-" COMPU_TAB_REF Def_bit_ub_0_VTAB /end COMPU_METHOD
/begin COMPU_METHOD Def_st_ub_q1 "Def_st_ub_q1" RAT_FUNC "%3.0" "-" COEFFS 0 1 0 0 0 1 /end COMPU_METHOD
/begin COMPU_METHOD Def_dez_uw_q1 "Def_dez_uw_q1" RAT_FUNC "%5.0" "-" COEFFS 0 1 0 0 0 1 /end COMPU_METHOD
/begin COMPU_METHOD Def_dez_ul_q1 "Def_dez_ul_q1" RAT_FUNC "%7.0" "-" COEFFS 0 1 0 0 0 1 /end COMPU_METHOD
/begin COMPU_METHOD Def_t_sw_q0p01 "Def_t_sw_q0p01" RAT_FUNC "%7.2" "°C" COEFFS 0 100 0 0 0 1 /end COMPU_METHOD
/begin COMPU_METHOD Def_n_sw_q1p0 "Def_n_sw_q1p0" RAT_FUNC "%5.0" "Upm" COEFFS 0 1 0 0 0 1 /end COMPU_METHOD
/begin COMPU_METHOD Def_me_sw_q0p01 "Def_me_sw_q0p01" RAT_FUNC "%8.3" "mg/cyc" COEFFS 0 100 0 0 0 1 /end COMPU_METHOD
/begin COMPU_METHOD Def_u_uw_q0p0942 "Def_u_uw_q0p0942" RAT_FUNC "%6.1" "V" COEFFS 0 1 0 0 0 0.0942 /end COMPU_METHOD
/begin COMPU_METHOD Def_bit_ub_0 "Def_bit_ub_0" TAB_VERB "%5.2" "-" COMPU_TAB_REF Def_bit_ub_0_VTAB /end COMPU_METHOD
/begin COMPU_METHOD Def_bit_ub_1 "Def_bit_ub_1" TAB_VERB "%5.2" "-" COMPU_TAB_REF Def_bit_ub_1_VTAB /end COMPU_METHOD
/begin COMPU_METHOD Def_bit_ub_2 "Def_bit_ub_2" TAB_VERB "%5.2" "-" COMPU_TAB_REF Def_bit_ub_2_VTAB /end COMPU_METHOD
/begin COMPU_METHOD Def_bit_ub_3 "Def_bit_ub_3" TAB_VERB "%5.2" "-" COMPU_TAB_REF Def_bit_ub_3_VTAB /end COMPU_METHOD
/begin COMPU_METHOD Def_bit_ub_4 "Def_bit_ub_4" TAB_VERB "%5.2" "-" COMPU_TAB_REF Def_bit_ub_4_VTAB /end COMPU_METHOD
/begin COMPU_METHOD Def_bit_ub_5 "Def_bit_ub_5" TAB_VERB "%5.2" "-" COMPU_TAB_REF Def_bit_ub_5_VTAB /end COMPU_METHOD
/begin COMPU_METHOD Def_bit_ub_6 "Def_bit_ub_6" TAB_VERB "%5.2" "-" COMPU_TAB_REF Def_bit_ub_6_VTAB /end COMPU_METHOD
/begin COMPU_METHOD Def_bit_ub_7 "Def_bit_ub_7" TAB_VERB "%5.2" "-" COMPU_TAB_REF Def_bit_ub_7_VTAB /end COMPU_METHOD
/begin COMPU_METHOD Def_st_ub_q1 "Def_st_ub_q1" RAT_FUNC "%3.0" "-" COEFFS 0 1 0 0 0 1 /end COMPU_METHOD
/begin COMPU_METHOD Def_t_sw_q0p1 "Def_t_sw_q0p1" RAT_FUNC "%6.1" "°C" COEFFS 0 10 0 0 0 1 /end COMPU_METHOD
/begin COMPU_METHOD Def_dez_uw_q1 "Def_dez_uw_q1" RAT_FUNC "%5.0" "-" COEFFS 0 1 0 0 0 1 /end COMPU_METHOD
/begin COMPU_METHOD Def_dez_ub_q1 "Def_dez_ub_q1" RAT_FUNC "%3.0" "-" COEFFS 0 1 0 0 0 1 /end COMPU_METHOD
/begin COMPU_METHOD Def_bit_ub_0 "Def_bit_ub_0" TAB_VERB "%5.2" "-" COMPU_TAB_REF Def_bit_ub_0_VTAB /end COMPU_METHOD
/begin COMPU_METHOD Def_bit_ub_1 "Def_bit_ub_1" TAB_VERB "%5.2" "-" COMPU_TAB_REF Def_bit_ub_1_VTAB /end COMPU_METHOD
/begin COMPU_METHOD Def_bit_ub_2 "Def_bit_ub_2" TAB_VERB "%5.2" "-" COMPU_TAB_REF Def_bit_ub_2_VTAB /end COMPU_METHOD
/begin COMPU_METHOD Def_bit_ub_3 "Def_bit_ub_3" TAB_VERB "%5.2" "-" COMPU_TAB_REF Def_bit_ub_3_VTAB /end COMPU_METHOD
/begin COMPU_METHOD Def_bit_ub_4 "Def_bit_ub_4" TAB_VERB "%5.2" "-" COMPU_TAB_REF Def_bit_ub_4_VTAB /end COMPU_METHOD
/begin COMPU_METHOD Def_bit_ub_5 "Def_bit_ub_5" TAB_VERB "%5.2" "-" COMPU_TAB_REF Def_bit_ub_5_VTAB /end COMPU_METHOD
/begin COMPU_METHOD Def_bit_ub_6 "Def_bit_ub_6" TAB_VERB "%5.2" "-" COMPU_TAB_REF Def_bit_ub_6_VTAB /end COMPU_METHOD
/begin COMPU_METHOD Def_bit_ub_7 "Def_bit_ub_7" TAB_VERB "%5.2" "-" COMPU_TAB_REF Def_bit_ub_7_VTAB /end COMPU_METHOD
/begin COMPU_METHOD Def_st_ub_q1 "Def_st_ub_q1" RAT_FUNC "%3.0" "-" COEFFS 0 1 0 0 0 1 /end COMPU_METHOD
/begin COMPU_METHOD Def_t_sw_q0p1 "Def_t_sw_q0p1" RAT_FUNC "%6.1" "°C" COEFFS 0 10 0 0 0 1 /end COMPU_METHOD
/begin COMPU_METHOD Def_dez_ub_q1 "Def_dez_ub_q1" RAT_FUNC "%3.0" "-" COEFFS 0 1 0 0 0 1 /end COMPU_METHOD
/begin COMPU_METHOD Def_dez_uw_q1 "Def_dez_uw_q1" RAT_FUNC "%5.0" "-" COEFFS 0 1 0 0 0 1 /end COMPU_METHOD
/begin COMPU_METHOD Def_td_uw_q0p01 "Def_td_uw_q0p01" RAT_FUNC "%7.2" "s" COEFFS 0 100 0 0 0 1 /end COMPU_METHOD
/begin COMPU_METHOD Def_td_uw_q0p1 "Def_td_uw_q0p1" RAT_FUNC "%6.1" "s" COEFFS 0 10 0 0 0 1 /end COMPU_METHOD
/begin COMPU_METHOD Def_dez_ub_q1 "Def_dez_ub_q1" RAT_FUNC "%3.0" "-" COEFFS 0 1 0 0 0 1 /end COMPU_METHOD
/begin COMPU_METHOD Def_bit_ub_0 "Def_bit_ub_0" TAB_VERB "%5.2" "-" COMPU_TAB_REF Def_bit_ub_0_VTAB /end COMPU_METHOD
/begin COMPU_METHOD Def_bit_ub_1 "Def_bit_ub_1" TAB_VERB "%5.2" "-" COMPU_TAB_REF Def_bit_ub_1_VTAB /end COMPU_METHOD
/begin COMPU_METHOD Def_bit_ub_2 "Def_bit_ub_2" TAB_VERB "%5.2" "-" COMPU_TAB_REF Def_bit_ub_2_VTAB /end COMPU_METHOD
/begin COMPU_METHOD Def_bit_ub_3 "Def_bit_ub_3" TAB_VERB "%5.2" "-" COMPU_TAB_REF Def_bit_ub_3_VTAB /end COMPU_METHOD
/begin COMPU_METHOD Def_bit_ub_4 "Def_bit_ub_4" TAB_VERB "%5.2" "-" COMPU_TAB_REF Def_bit_ub_4_VTAB /end COMPU_METHOD
/begin COMPU_METHOD Def_bit_ub_5 "Def_bit_ub_5" TAB_VERB "%5.2" "-" COMPU_TAB_REF Def_bit_ub_5_VTAB /end COMPU_METHOD
/begin COMPU_METHOD Def_bit_ub_6 "Def_bit_ub_6" TAB_VERB "%5.2" "-" COMPU_TAB_REF Def_bit_ub_6_VTAB /end COMPU_METHOD
/begin COMPU_METHOD Def_bit_ub_7 "Def_bit_ub_7" TAB_VERB "%5.2" "-" COMPU_TAB_REF Def_bit_ub_7_VTAB /end COMPU_METHOD
/begin COMPU_METHOD Def_st_ub_q1 "Def_st_ub_q1" RAT_FUNC "%3.0" "-" COEFFS 0 1 0 0 0 1 /end COMPU_METHOD
/begin COMPU_METHOD Def_dez_ub_q1 "Def_dez_ub_q1" RAT_FUNC "%3.0" "-" COEFFS 0 1 0 0 0 1 /end COMPU_METHOD
/begin COMPU_METHOD Def_dez_uw_q1 "Def_dez_uw_q1" RAT_FUNC "%5.0" "-" COEFFS 0 1 0 0 0 1 /end COMPU_METHOD
/begin COMPU_METHOD Def_n_sw_q1p0 "Def_n_sw_q1p0" RAT_FUNC "%5.0" "Upm" COEFFS 0 1 0 0 0 1 /end COMPU_METHOD
/begin COMPU_METHOD Def_t_sw_q0p1 "Def_t_sw_q0p1" RAT_FUNC "%6.1" "°C" COEFFS 0 10 0 0 0 1 /end COMPU_METHOD
/begin COMPU_METHOD Def_td_uw_q0p01 "Def_td_uw_q0p01" RAT_FUNC "%7.2" "s" COEFFS 0 100 0 0 0 1 /end COMPU_METHOD
/begin COMPU_METHOD Def_t_sw_q0p01 "Def_t_sw_q0p01" RAT_FUNC "%7.2" "°C" COEFFS 0 100 0 0 0 1 /end COMPU_METHOD
/begin COMPU_METHOD Def_f_ub_b8 "Def_f_ub_b8" RAT_FUNC "%5.2" "-" COEFFS 0 256 0 0 0 8 /end COMPU_METHOD
/begin COMPU_METHOD Def_bit_ub_0 "Def_bit_ub_0" TAB_VERB "%5.2" "-" COMPU_TAB_REF Def_bit_ub_0_VTAB /end COMPU_METHOD
/begin COMPU_METHOD Def_bit_ub_1 "Def_bit_ub_1" TAB_VERB "%5.2" "-" COMPU_TAB_REF Def_bit_ub_1_VTAB /end COMPU_METHOD
/begin COMPU_METHOD Def_bit_ub_2 "Def_bit_ub_2" TAB_VERB "%5.2" "-" COMPU_TAB_REF Def_bit_ub_2_VTAB /end COMPU_METHOD
/begin COMPU_METHOD Def_bit_ub_3 "Def_bit_ub_3" TAB_VERB "%5.2" "-" COMPU_TAB_REF Def_bit_ub_3_VTAB /end COMPU_METHOD
/begin COMPU_METHOD Def_st_ub_q1 "Def_st_ub_q1" RAT_FUNC "%3.0" "-" COEFFS 0 1 0 0 0 1 /end COMPU_METHOD
/begin COMPU_METHOD Def_bit_ub_4 "Def_bit_ub_4" TAB_VERB "%5.2" "-" COMPU_TAB_REF Def_bit_ub_4_VTAB /end COMPU_METHOD
/begin COMPU_METHOD Def_bit_ub_5 "Def_bit_ub_5" TAB_VERB "%5.2" "-" COMPU_TAB_REF Def_bit_ub_5_VTAB /end COMPU_METHOD
/begin COMPU_METHOD Def_dez_uw_q1 "Def_dez_uw_q1" RAT_FUNC "%5.0" "-" COEFFS 0 1 0 0 0 1 /end COMPU_METHOD
/begin COMPU_METHOD Def_n_sw_q1p0 "Def_n_sw_q1p0" RAT_FUNC "%5.0" "Upm" COEFFS 0 1 0 0 0 1 /end COMPU_METHOD
/begin COMPU_METHOD Def_t_sw_q0p1 "Def_t_sw_q0p1" RAT_FUNC "%6.1" "°C" COEFFS 0 10 0 0 0 1 /end COMPU_METHOD
/begin COMPU_METHOD Def_bit_ub_0 "Def_bit_ub_0" TAB_VERB "%5.2" "-" COMPU_TAB_REF Def_bit_ub_0_VTAB /end COMPU_METHOD
/begin COMPU_METHOD Def_st_ub_q1 "Def_st_ub_q1" RAT_FUNC "%3.0" "-" COEFFS 0 1 0 0 0 1 /end COMPU_METHOD
/begin COMPU_METHOD Def_bit_ub_1 "Def_bit_ub_1" TAB_VERB "%5.2" "-" COMPU_TAB_REF Def_bit_ub_1_VTAB /end COMPU_METHOD
/begin COMPU_METHOD Def_bit_ub_2 "Def_bit_ub_2" TAB_VERB "%5.2" "-" COMPU_TAB_REF Def_bit_ub_2_VTAB /end COMPU_METHOD
/begin COMPU_METHOD Def_bit_ub_3 "Def_bit_ub_3" TAB_VERB "%5.2" "-" COMPU_TAB_REF Def_bit_ub_3_VTAB /end COMPU_METHOD
/begin COMPU_METHOD Def_dez_uw_q1 "Def_dez_uw_q1" RAT_FUNC "%5.0" "-" COEFFS 0 1 0 0 0 1 /end COMPU_METHOD
/begin COMPU_METHOD Def_dez_ub_q1 "Def_dez_ub_q1" RAT_FUNC "%3.0" "-" COEFFS 0 1 0 0 0 1 /end COMPU_METHOD
/begin COMPU_METHOD Def_f_ub_b1 "Def_f_ub_b1" RAT_FUNC "%6.3" "-" COEFFS 0 256 0 0 0 1 /end COMPU_METHOD
/begin COMPU_METHOD Def_t_sw_q0p1 "Def_t_sw_q0p1" RAT_FUNC "%6.1" "°C" COEFFS 0 10 0 0 0 1 /end COMPU_METHOD
/begin COMPU_METHOD Def_t_sw_q0p1 "Def_t_sw_q0p1" RAT_FUNC "%6.1" "°C" COEFFS 0 10 0 0 0 1 /end COMPU_METHOD
/begin COMPU_METHOD Def_n_sw_q1p0 "Def_n_sw_q1p0" RAT_FUNC "%5.0" "Upm" COEFFS 0 1 0 0 0 1 /end COMPU_METHOD
/begin COMPU_METHOD Def_t_sw_q0p01 "Def_t_sw_q0p01" RAT_FUNC "%7.2" "°C" COEFFS 0 100 0 0 0 1 /end COMPU_METHOD
/begin COMPU_METHOD Def_dez_ub_q1 "Def_dez_ub_q1" RAT_FUNC "%3.0" "-" COEFFS 0 1 0 0 0 1 /end COMPU_METHOD
/begin COMPU_METHOD Def_bit_ub_0 "Def_bit_ub_0" TAB_VERB "%5.2" "-" COMPU_TAB_REF Def_bit_ub_0_VTAB /end COMPU_METHOD
/begin COMPU_METHOD Def_bit_ub_1 "Def_bit_ub_1" TAB_VERB "%5.2" "-" COMPU_TAB_REF Def_bit_ub_1_VTAB /end COMPU_METHOD
/begin COMPU_METHOD Def_bit_ub_2 "Def_bit_ub_2" TAB_VERB "%5.2" "-" COMPU_TAB_REF Def_bit_ub_2_VTAB /end COMPU_METHOD
/begin COMPU_METHOD Def_st_ub_q1 "Def_st_ub_q1" RAT_FUNC "%3.0" "-" COEFFS 0 1 0 0 0 1 /end COMPU_METHOD
/begin COMPU_METHOD Def_bit_ub_3 "Def_bit_ub_3" TAB_VERB "%5.2" "-" COMPU_TAB_REF Def_bit_ub_3_VTAB /end COMPU_METHOD
/begin COMPU_METHOD Def_bit_ub_4 "Def_bit_ub_4" TAB_VERB "%5.2" "-" COMPU_TAB_REF Def_bit_ub_4_VTAB /end COMPU_METHOD
/begin COMPU_METHOD Def_i_ub_q0p125 "Def_i_ub_q0p125" RAT_FUNC "%6.3" "A" COEFFS 0 8 0 0 0 1 /end COMPU_METHOD
/begin COMPU_METHOD Def_dez_ub_q1 "Def_dez_ub_q1" RAT_FUNC "%3.0" "-" COEFFS 0 1 0 0 0 1 /end COMPU_METHOD
/begin COMPU_METHOD Def_n_sw_q1p0 "Def_n_sw_q1p0" RAT_FUNC "%5.0" "Upm" COEFFS 0 1 0 0 0 1 /end COMPU_METHOD
/begin COMPU_METHOD Def_wdk_sw_q0p0244 "Def_wdk_sw_q0p0244" RAT_FUNC "%7.2" "%" COEFFS 0 4096 0 0 0 100 /end COMPU_METHOD
/begin COMPU_METHOD Def_t_sw_q0p01 "Def_t_sw_q0p01" RAT_FUNC "%7.2" "°C" COEFFS 0 100 0 0 0 1 /end COMPU_METHOD
/begin COMPU_METHOD Def_td_uw_q0p01 "Def_td_uw_q0p01" RAT_FUNC "%7.2" "s" COEFFS 0 100 0 0 0 1 /end COMPU_METHOD
/begin COMPU_METHOD Def_v_uw_q1p0 "Def_v_uw_q1p0" RAT_FUNC "%5.0" "km/h" COEFFS 0 1 0 0 0 1 /end COMPU_METHOD
/begin COMPU_METHOD Def_f_ub_b100 "Def_f_ub_b100" RAT_FUNC "%5.2" "%" COEFFS 0 256 0 0 0 100 /end COMPU_METHOD
/begin COMPU_METHOD Def_f_ub_b1 "Def_f_ub_b1" RAT_FUNC "%6.3" "-" COEFFS 0 256 0 0 0 1 /end COMPU_METHOD
/begin COMPU_METHOD Identity "Identity" RAT_FUNC "%3.0" "-" COEFFS 0 1 0 0 0 1 /end COMPU_METHOD
/begin COMPU_METHOD Def_f_ub_b8 "Def_f_ub_b8" RAT_FUNC "%5.2" "-" COEFFS 0 256 0 0 0 8 /end COMPU_METHOD
/begin COMPU_METHOD Def_bit_ub_0 "Def_bit_ub_0" TAB_VERB "%5.2" "-" COMPU_TAB_REF Def_bit_ub_0_VTAB /end COMPU_METHOD
/begin COMPU_METHOD Def_bit_ub_1 "Def_bit_ub_1" TAB_VERB "%5.2" "-" COMPU_TAB_REF Def_bit_ub_1_VTAB /end COMPU_METHOD
/begin COMPU_METHOD Def_bit_ub_2 "Def_bit_ub_2" TAB_VERB "%5.2" "-" COMPU_TAB_REF Def_bit_ub_2_VTAB /end COMPU_METHOD
/begin COMPU_METHOD Def_bit_ub_3 "Def_bit_ub_3" TAB_VERB "%5.2" "-" COMPU_TAB_REF Def_bit_ub_3_VTAB /end COMPU_METHOD
/begin COMPU_METHOD Def_bit_ub_4 "Def_bit_ub_4" TAB_VERB "%5.2" "-" COMPU_TAB_REF Def_bit_ub_4_VTAB /end COMPU_METHOD
/begin COMPU_METHOD Def_bit_ub_5 "Def_bit_ub_5" TAB_VERB "%5.2" "-" COMPU_TAB_REF Def_bit_ub_5_VTAB /end COMPU_METHOD
/begin COMPU_METHOD Def_st_ub_q1 "Def_st_ub_q1" RAT_FUNC "%3.0" "-" COEFFS 0 1 0 0 0 1 /end COMPU_METHOD
/begin COMPU_METHOD Def_t_sw_q0p1 "Def_t_sw_q0p1" RAT_FUNC "%6.1" "°C" COEFFS 0 10 0 0 0 1 /end COMPU_METHOD
/begin COMPU_METHOD Def_tv_ub_q0p390625 "Def_tv_ub_q0p390625" RAT_FUNC "%5.2" "%" COEFFS 0 256 0 0 0 100 /end COMPU_METHOD
/begin COMPU_METHOD Def_i_ub_q0p125 "Def_i_ub_q0p125" RAT_FUNC "%6.3" "A" COEFFS 0 8 0 0 0 1 /end COMPU_METHOD
/begin COMPU_METHOD Def_n_sw_q1p0 "Def_n_sw_q1p0" RAT_FUNC "%5.0" "Upm" COEFFS 0 1 0 0 0 1 /end COMPU_METHOD
/begin COMPU_METHOD Def_u_uw_q0p0942 "Def_u_uw_q0p0942" RAT_FUNC "%6.1" "V" COEFFS 0 1 0 0 0 0.0942 /end COMPU_METHOD
/begin COMPU_METHOD Def_f_ub_b1 "Def_f_ub_b1" RAT_FUNC "%6.3" "-" COEFFS 0 256 0 0 0 1 /end COMPU_METHOD
/begin COMPU_METHOD Identity "Identity" RAT_FUNC "%3.0" "-" COEFFS 0 1 0 0 0 1 /end COMPU_METHOD
/begin COMPU_METHOD Def_bit_ub_0 "Def_bit_ub_0" TAB_VERB "%5.2" "-" COMPU_TAB_REF Def_bit_ub_0_VTAB /end COMPU_METHOD
/begin COMPU_METHOD Def_bit_ub_1 "Def_bit_ub_1" TAB_VERB "%5.2" "-" COMPU_TAB_REF Def_bit_ub_1_VTAB /end COMPU_METHOD
/begin COMPU_METHOD Def_bit_ub_2 "Def_bit_ub_2" TAB_VERB "%5.2" "-" COMPU_TAB_REF Def_bit_ub_2_VTAB /end COMPU_METHOD
/begin COMPU_METHOD Def_bit_ub_4 "Def_bit_ub_4" TAB_VERB "%5.2" "-" COMPU_TAB_REF Def_bit_ub_4_VTAB /end COMPU_METHOD
/begin COMPU_METHOD Def_bit_ub_5 "Def_bit_ub_5" TAB_VERB "%5.2" "-" COMPU_TAB_REF Def_bit_ub_5_VTAB /end COMPU_METHOD
/begin COMPU_METHOD Def_bit_ub_6 "Def_bit_ub_6" TAB_VERB "%5.2" "-" COMPU_TAB_REF Def_bit_ub_6_VTAB /end COMPU_METHOD
/begin COMPU_METHOD Def_bit_ub_7 "Def_bit_ub_7" TAB_VERB "%5.2" "-" COMPU_TAB_REF Def_bit_ub_7_VTAB /end COMPU_METHOD
/begin COMPU_METHOD Def_st_ub_q1 "Def_st_ub_q1" RAT_FUNC "%3.0" "-" COEFFS 0 1 0 0 0 1 /end COMPU_METHOD
/begin COMPU_METHOD Def_bit_ub_3 "Def_bit_ub_3" TAB_VERB "%5.2" "-" COMPU_TAB_REF Def_bit_ub_3_VTAB /end COMPU_METHOD
/begin COMPU_METHOD Def_f_sw_b100 "Def_f_sw_b100" RAT_FUNC "%8.3" "-" COEFFS 0 32768 0 0 0 100 /end COMPU_METHOD
/begin COMPU_METHOD Def_t_sw_q0p1 "Def_t_sw_q0p1" RAT_FUNC "%6.1" "°C" COEFFS 0 10 0 0 0 1 /end COMPU_METHOD
/begin COMPU_METHOD Def_td_uw_q0p1 "Def_td_uw_q0p1" RAT_FUNC "%6.1" "s" COEFFS 0 10 0 0 0 1 /end COMPU_METHOD
/begin COMPU_METHOD Def_dez_ub_q1 "Def_dez_ub_q1" RAT_FUNC "%3.0" "-" COEFFS 0 1 0 0 0 1 /end COMPU_METHOD
/begin COMPU_METHOD Def_n_sw_q1p0 "Def_n_sw_q1p0" RAT_FUNC "%5.0" "Upm" COEFFS 0 1 0 0 0 1 /end COMPU_METHOD
/begin COMPU_METHOD Def_v_uw_q1p0 "Def_v_uw_q1p0" RAT_FUNC "%5.0" "km/h" COEFFS 0 1 0 0 0 1 /end COMPU_METHOD
/begin COMPU_METHOD Def_st_uw_q1 "Def_st_uw_q1" RAT_FUNC "%5.0" "-" COEFFS 0 1 0 0 0 1 /end COMPU_METHOD
/begin COMPU_METHOD Identity "Identity" RAT_FUNC "%3.0" "-" COEFFS 0 1 0 0 0 1 /end COMPU_METHOD
/begin COMPU_METHOD Def_td_ub_q0p1 "Def_td_ub_q0p1" RAT_FUNC "%4.1" "s" COEFFS 0 10 0 0 0 1 /end COMPU_METHOD
/begin COMPU_METHOD Def_f_ub_b100 "Def_f_ub_b100" RAT_FUNC "%5.2" "%" COEFFS 0 256 0 0 0 100 /end COMPU_METHOD
/begin COMPU_METHOD Def_bit_ub_0 "Def_bit_ub_0" TAB_VERB "%5.2" "-" COMPU_TAB_REF Def_bit_ub_0_VTAB /end COMPU_METHOD
/begin COMPU_METHOD Def_bit_ub_1 "Def_bit_ub_1" TAB_VERB "%5.2" "-" COMPU_TAB_REF Def_bit_ub_1_VTAB /end COMPU_METHOD
/begin COMPU_METHOD Def_bit_ub_2 "Def_bit_ub_2" TAB_VERB "%5.2" "-" COMPU_TAB_REF Def_bit_ub_2_VTAB /end COMPU_METHOD
/begin COMPU_METHOD Def_bit_ub_3 "Def_bit_ub_3" TAB_VERB "%5.2" "-" COMPU_TAB_REF Def_bit_ub_3_VTAB /end COMPU_METHOD
/begin COMPU_METHOD Def_st_ub_q1 "Def_st_ub_q1" RAT_FUNC "%3.0" "-" COEFFS 0 1 0 0 0 1 /end COMPU_METHOD
/begin COMPU_METHOD Def_td_uw_q0p01 "Def_td_uw_q0p01" RAT_FUNC "%7.2" "s" COEFFS 0 100 0 0 0 1 /end COMPU_METHOD
/begin COMPU_METHOD Def_f_ub_b100 "Def_f_ub_b100" RAT_FUNC "%5.2" "%" COEFFS 0 256 0 0 0 100 /end COMPU_METHOD
/begin COMPU_METHOD Def_td_ub_q0p1 "Def_td_ub_q0p1" RAT_FUNC "%4.1" "s" COEFFS 0 10 0 0 0 1 /end COMPU_METHOD
/begin COMPU_METHOD Def_dez_ub_q1 "Def_dez_ub_q1" RAT_FUNC "%3.0" "-" COEFFS 0 1 0 0 0 1 /end COMPU_METHOD
/begin COMPU_METHOD Def_f_uw_b512 "Def_f_uw_b512" RAT_FUNC "%8.3" "-" COEFFS 0 65536 0 0 0 512 /end COMPU_METHOD
/begin COMPU_METHOD Def_i_uw_q0p08_o200 "Def_i_uw_q0p08_o200" RAT_FUNC "%8.3" "" COEFFS 0 25 5000 0 0 2 /end COMPU_METHOD
/begin COMPU_METHOD Identity "Identity" RAT_FUNC "%3.0" "-" COEFFS 0 1 0 0 0 1 /end COMPU_METHOD
/begin COMPU_METHOD Def_f_ub_b1 "Def_f_ub_b1" RAT_FUNC "%6.3" "-" COEFFS 0 256 0 0 0 1 /end COMPU_METHOD
/begin COMPU_METHOD Def_bit_ub_0 "Def_bit_ub_0" TAB_VERB "%5.2" "-" COMPU_TAB_REF Def_bit_ub_0_VTAB /end COMPU_METHOD
/begin COMPU_METHOD Def_bit_ub_1 "Def_bit_ub_1" TAB_VERB "%5.2" "-" COMPU_TAB_REF Def_bit_ub_1_VTAB /end COMPU_METHOD
/begin COMPU_METHOD Def_bit_ub_2 "Def_bit_ub_2" TAB_VERB "%5.2" "-" COMPU_TAB_REF Def_bit_ub_2_VTAB /end COMPU_METHOD
/begin COMPU_METHOD Def_bit_ub_3 "Def_bit_ub_3" TAB_VERB "%5.2" "-" COMPU_TAB_REF Def_bit_ub_3_VTAB /end COMPU_METHOD
/begin COMPU_METHOD Def_bit_ub_4 "Def_bit_ub_4" TAB_VERB "%5.2" "-" COMPU_TAB_REF Def_bit_ub_4_VTAB /end COMPU_METHOD
/begin COMPU_METHOD Def_bit_ub_5 "Def_bit_ub_5" TAB_VERB "%5.2" "-" COMPU_TAB_REF Def_bit_ub_5_VTAB /end COMPU_METHOD
/begin COMPU_METHOD Def_st_ub_q1 "Def_st_ub_q1" RAT_FUNC "%3.0" "-" COEFFS 0 1 0 0 0 1 /end COMPU_METHOD
/begin COMPU_METHOD Def_dez_uw_q1 "Def_dez_uw_q1" RAT_FUNC "%5.0" "-" COEFFS 0 1 0 0 0 1 /end COMPU_METHOD
/begin COMPU_METHOD Def_dez_ub_q1 "Def_dez_ub_q1" RAT_FUNC "%3.0" "-" COEFFS 0 1 0 0 0 1 /end COMPU_METHOD
/begin COMPU_METHOD Def_bit_ub_0 "Def_bit_ub_0" TAB_VERB "%5.2" "-" COMPU_TAB_REF Def_bit_ub_0_VTAB /end COMPU_METHOD
/begin COMPU_METHOD Def_bit_ub_1 "Def_bit_ub_1" TAB_VERB "%5.2" "-" COMPU_TAB_REF Def_bit_ub_1_VTAB /end COMPU_METHOD
/begin COMPU_METHOD Def_bit_ub_2 "Def_bit_ub_2" TAB_VERB "%5.2" "-" COMPU_TAB_REF Def_bit_ub_2_VTAB /end COMPU_METHOD
/begin COMPU_METHOD Def_bit_ub_3 "Def_bit_ub_3" TAB_VERB "%5.2" "-" COMPU_TAB_REF Def_bit_ub_3_VTAB /end COMPU_METHOD
/begin COMPU_METHOD Def_bit_ub_4 "Def_bit_ub_4" TAB_VERB "%5.2" "-" COMPU_TAB_REF Def_bit_ub_4_VTAB /end COMPU_METHOD
/begin COMPU_METHOD Def_bit_ub_5 "Def_bit_ub_5" TAB_VERB "%5.2" "-" COMPU_TAB_REF Def_bit_ub_5_VTAB /end COMPU_METHOD
/begin COMPU_METHOD Def_bit_ub_6 "Def_bit_ub_6" TAB_VERB "%5.2" "-" COMPU_TAB_REF Def_bit_ub_6_VTAB /end COMPU_METHOD
/begin COMPU_METHOD Def_bit_ub_7 "Def_bit_ub_7" TAB_VERB "%5.2" "-" COMPU_TAB_REF Def_bit_ub_7_VTAB /end COMPU_METHOD
/begin COMPU_METHOD Def_st_ub_q1 "Def_st_ub_q1" RAT_FUNC "%3.0" "-" COEFFS 0 1 0 0 0 1 /end COMPU_METHOD
/begin COMPU_METHOD Def_dez_uw_q1 "Def_dez_uw_q1" RAT_FUNC "%5.0" "-" COEFFS 0 1 0 0 0 1 /end COMPU_METHOD
/begin COMPU_METHOD Def_td_uw_q0p1 "Def_td_uw_q0p1" RAT_FUNC "%6.1" "s" COEFFS 0 10 0 0 0 1 /end COMPU_METHOD
/begin COMPU_METHOD Def_dez_ub_q1 "Def_dez_ub_q1" RAT_FUNC "%3.0" "-" COEFFS 0 1 0 0 0 1 /end COMPU_METHOD
/begin COMPU_METHOD Def_td_ub_q0p1 "Def_td_ub_q0p1" RAT_FUNC "%4.1" "s" COEFFS 0 10 0 0 0 1 /end COMPU_METHOD
/begin COMPU_METHOD Identity "Identity" RAT_FUNC "%3.0" "-" COEFFS 0 1 0 0 0 1 /end COMPU_METHOD
/begin COMPU_METHOD Def_f_sw_b100 "Def_f_sw_b100" RAT_FUNC "%8.3" "-" COEFFS 0 32768 0 0 0 100 /end COMPU_METHOD
/begin COMPU_METHOD Def_bit_ub_0 "Def_bit_ub_0" TAB_VERB "%5.2" "-" COMPU_TAB_REF Def_bit_ub_0_VTAB /end COMPU_METHOD
/begin COMPU_METHOD Def_bit_ub_1 "Def_bit_ub_1" TAB_VERB "%5.2" "-" COMPU_TAB_REF Def_bit_ub_1_VTAB /end COMPU_METHOD
/begin COMPU_METHOD Def_bit_ub_2 "Def_bit_ub_2" TAB_VERB "%5.2" "-" COMPU_TAB_REF Def_bit_ub_2_VTAB /end COMPU_METHOD
/begin COMPU_METHOD Def_bit_ub_3 "Def_bit_ub_3" TAB_VERB "%5.2" "-" COMPU_TAB_REF Def_bit_ub_3_VTAB /end COMPU_METHOD
/begin COMPU_METHOD Def_bit_ub_4 "Def_bit_ub_4" TAB_VERB "%5.2" "-" COMPU_TAB_REF Def_bit_ub_4_VTAB /end COMPU_METHOD
/begin COMPU_METHOD Def_bit_ub_5 "Def_bit_ub_5" TAB_VERB "%5.2" "-" COMPU_TAB_REF Def_bit_ub_5_VTAB /end COMPU_METHOD
/begin COMPU_METHOD Def_st_ub_q1 "Def_st_ub_q1" RAT_FUNC "%3.0" "-" COEFFS 0 1 0 0 0 1 /end COMPU_METHOD
/begin COMPU_METHOD Def_bit_ub_6 "Def_bit_ub_6" TAB_VERB "%5.2" "-" COMPU_TAB_REF Def_bit_ub_6_VTAB /end COMPU_METHOD
/begin COMPU_METHOD Def_i_uw_q0p08_o200 "Def_i_uw_q0p08_o200" RAT_FUNC "%8.3" "" COEFFS 0 25 5000 0 0 2 /end COMPU_METHOD
/begin COMPU_METHOD Def_dez_ub_q1 "Def_dez_ub_q1" RAT_FUNC "%3.0" "-" COEFFS 0 1 0 0 0 1 /end COMPU_METHOD
/begin COMPU_METHOD Def_t_sw_q0p1 "Def_t_sw_q0p1" RAT_FUNC "%6.1" "°C" COEFFS 0 10 0 0 0 1 /end COMPU_METHOD
/begin COMPU_METHOD Def_dez_uw_q1 "Def_dez_uw_q1" RAT_FUNC "%5.0" "-" COEFFS 0 1 0 0 0 1 /end COMPU_METHOD
/begin COMPU_METHOD Def_i_ub_q1 "Def_i_ub_q1" RAT_FUNC "%6.3" "" COEFFS 0 1 0 0 0 1 /end COMPU_METHOD
/begin COMPU_METHOD Def_t_sw_q0p01 "Def_t_sw_q0p01" RAT_FUNC "%7.2" "°C" COEFFS 0 100 0 0 0 1 /end COMPU_METHOD
/begin COMPU_METHOD Def_bit_ub_0 "Def_bit_ub_0" TAB_VERB "%5.2" "-" COMPU_TAB_REF Def_bit_ub_0_VTAB /end COMPU_METHOD
/begin COMPU_METHOD Def_st_ub_q1 "Def_st_ub_q1" RAT_FUNC "%3.0" "-" COEFFS 0 1 0 0 0 1 /end COMPU_METHOD
/begin COMPU_METHOD Def_dez_ul_q1 "Def_dez_ul_q1" RAT_FUNC "%7.0" "-" COEFFS 0 1 0 0 0 1 /end COMPU_METHOD
/begin COMPU_METHOD Def_st_uw_q1 "Def_st_uw_q1" RAT_FUNC "%5.0" "-" COEFFS 0 1 0 0 0 1 /end COMPU_METHOD
/begin COMPU_METHOD Def_dez_ub_q1 "Def_dez_ub_q1" RAT_FUNC "%3.0" "-" COEFFS 0 1 0 0 0 1 /end COMPU_METHOD
/begin COMPU_METHOD Def_dez_uw_q1 "Def_dez_uw_q1" RAT_FUNC "%5.0" "-" COEFFS 0 1 0 0 0 1 /end COMPU_METHOD
/begin COMPU_METHOD Identity "Identity" RAT_FUNC "%3.0" "-" COEFFS 0 1 0 0 0 1 /end COMPU_METHOD
/begin COMPU_METHOD Def_bit_ub_0 "Def_bit_ub_0" TAB_VERB "%5.2" "-" COMPU_TAB_REF Def_bit_ub_0_VTAB /end COMPU_METHOD
/begin COMPU_METHOD Def_bit_ub_1 "Def_bit_ub_1" TAB_VERB "%5.2" "-" COMPU_TAB_REF Def_bit_ub_1_VTAB /end COMPU_METHOD
/begin COMPU_METHOD Def_bit_ub_2 "Def_bit_ub_2" TAB_VERB "%5.2" "-" COMPU_TAB_REF Def_bit_ub_2_VTAB /end COMPU_METHOD
/begin COMPU_METHOD Def_bit_ub_3 "Def_bit_ub_3" TAB_VERB "%5.2" "-" COMPU_TAB_REF Def_bit_ub_3_VTAB /end COMPU_METHOD
/begin COMPU_METHOD Def_bit_ub_4 "Def_bit_ub_4" TAB_VERB "%5.2" "-" COMPU_TAB_REF Def_bit_ub_4_VTAB /end COMPU_METHOD
/begin COMPU_METHOD Def_bit_ub_5 "Def_bit_ub_5" TAB_VERB "%5.2" "-" COMPU_TAB_REF Def_bit_ub_5_VTAB /end COMPU_METHOD
/begin COMPU_METHOD Def_bit_ub_6 "Def_bit_ub_6" TAB_VERB "%5.2" "-" COMPU_TAB_REF Def_bit_ub_6_VTAB /end COMPU_METHOD
/begin COMPU_METHOD Def_bit_ub_7 "Def_bit_ub_7" TAB_VERB "%5.2" "-" COMPU_TAB_REF Def_bit_ub_7_VTAB /end COMPU_METHOD
/begin COMPU_METHOD Def_st_ub_q1 "Def_st_ub_q1" RAT_FUNC "%3.0" "-" COEFFS 0 1 0 0 0 1 /end COMPU_METHOD
/begin COMPU_METHOD Def_dez_uw_q1 "Def_dez_uw_q1" RAT_FUNC "%5.0" "-" COEFFS 0 1 0 0 0 1 /end COMPU_METHOD
/begin COMPU_METHOD Def_i_uw_q0p08_o200 "Def_i_uw_q0p08_o200" RAT_FUNC "%8.3" "" COEFFS 0 25 5000 0 0 2 /end COMPU_METHOD
/begin COMPU_METHOD Def_f_uw_b512 "Def_f_uw_b512" RAT_FUNC "%8.3" "-" COEFFS 0 65536 0 0 0 512 /end COMPU_METHOD
/begin COMPU_METHOD Def_u_uw_q0p0942 "Def_u_uw_q0p0942" RAT_FUNC "%6.1" "V" COEFFS 0 1 0 0 0 0.0942 /end COMPU_METHOD
/begin COMPU_METHOD Def_dez_ub_q1 "Def_dez_ub_q1" RAT_FUNC "%3.0" "-" COEFFS 0 1 0 0 0 1 /end COMPU_METHOD
/begin COMPU_METHOD Def_f_ub_b100 "Def_f_ub_b100" RAT_FUNC "%5.2" "%" COEFFS 0 256 0 0 0 100 /end COMPU_METHOD
/begin COMPU_METHOD Def_i_ub_q1 "Def_i_ub_q1" RAT_FUNC "%6.3" "" COEFFS 0 1 0 0 0 1 /end COMPU_METHOD
/begin COMPU_METHOD Def_td_ub_q0p1 "Def_td_ub_q0p1" RAT_FUNC "%4.1" "s" COEFFS 0 10 0 0 0 1 /end COMPU_METHOD
/begin COMPU_METHOD Def_n_sw_q1p0 "Def_n_sw_q1p0" RAT_FUNC "%5.0" "Upm" COEFFS 0 1 0 0 0 1 /end COMPU_METHOD
/begin COMPU_METHOD Def_td_uw_q0p1 "Def_td_uw_q0p1" RAT_FUNC "%6.1" "s" COEFFS 0 10 0 0 0 1 /end COMPU_METHOD
/begin COMPU_METHOD Def_f_ub_b1 "Def_f_ub_b1" RAT_FUNC "%6.3" "-" COEFFS 0 256 0 0 0 1 /end COMPU_METHOD
/begin COMPU_METHOD Identity "Identity" RAT_FUNC "%3.0" "-" COEFFS 0 1 0 0 0 1 /end COMPU_METHOD
/begin COMPU_METHOD Def_t_sw_q0p1 "Def_t_sw_q0p1" RAT_FUNC "%6.1" "°C" COEFFS 0 10 0 0 0 1 /end COMPU_METHOD
/begin COMPU_METHOD Def_f_sw_b100 "Def_f_sw_b100" RAT_FUNC "%8.3" "-" COEFFS 0 32768 0 0 0 100 /end COMPU_METHOD
/begin COMPU_METHOD Def_bit_ub_1 "Def_bit_ub_1" TAB_VERB "%5.2" "-" COMPU_TAB_REF Def_bit_ub_1_VTAB /end COMPU_METHOD
/begin COMPU_METHOD Def_bit_ub_2 "Def_bit_ub_2" TAB_VERB "%5.2" "-" COMPU_TAB_REF Def_bit_ub_2_VTAB /end COMPU_METHOD
/begin COMPU_METHOD Def_st_ub_q1 "Def_st_ub_q1" RAT_FUNC "%3.0" "-" COEFFS 0 1 0 0 0 1 /end COMPU_METHOD
/begin COMPU_METHOD Def_bit_ub_0 "Def_bit_ub_0" TAB_VERB "%5.2" "-" COMPU_TAB_REF Def_bit_ub_0_VTAB /end COMPU_METHOD
/begin COMPU_METHOD Def_t_sw_q0p1 "Def_t_sw_q0p1" RAT_FUNC "%6.1" "°C" COEFFS 0 10 0 0 0 1 /end COMPU_METHOD
/begin COMPU_METHOD Def_dez_ub_q1 "Def_dez_ub_q1" RAT_FUNC "%3.0" "-" COEFFS 0 1 0 0 0 1 /end COMPU_METHOD
/begin COMPU_METHOD Def_f_ub_b8 "Def_f_ub_b8" RAT_FUNC "%5.2" "-" COEFFS 0 256 0 0 0 8 /end COMPU_METHOD
/begin COMPU_METHOD Def_i_uw_q0p08_o200 "Def_i_uw_q0p08_o200" RAT_FUNC "%8.3" "" COEFFS 0 25 5000 0 0 2 /end COMPU_METHOD
/begin COMPU_METHOD Def_dez_ub_q1 "Def_dez_ub_q1" RAT_FUNC "%3.0" "-" COEFFS 0 1 0 0 0 1 /end COMPU_METHOD
/begin COMPU_METHOD Def_t_sw_q0p1 "Def_t_sw_q0p1" RAT_FUNC "%6.1" "°C" COEFFS 0 10 0 0 0 1 /end COMPU_METHOD
/begin COMPU_METHOD Def_bit_ub_0 "Def_bit_ub_0" TAB_VERB "%5.2" "-" COMPU_TAB_REF Def_bit_ub_0_VTAB /end COMPU_METHOD
/begin COMPU_METHOD Def_bit_ub_1 "Def_bit_ub_1" TAB_VERB "%5.2" "-" COMPU_TAB_REF Def_bit_ub_1_VTAB /end COMPU_METHOD
/begin COMPU_METHOD Def_bit_ub_2 "Def_bit_ub_2" TAB_VERB "%5.2" "-" COMPU_TAB_REF Def_bit_ub_2_VTAB /end COMPU_METHOD
/begin COMPU_METHOD Def_bit_ub_3 "Def_bit_ub_3" TAB_VERB "%5.2" "-" COMPU_TAB_REF Def_bit_ub_3_VTAB /end COMPU_METHOD
/begin COMPU_METHOD Def_bit_ub_4 "Def_bit_ub_4" TAB_VERB "%5.2" "-" COMPU_TAB_REF Def_bit_ub_4_VTAB /end COMPU_METHOD
/begin COMPU_METHOD Def_bit_ub_5 "Def_bit_ub_5" TAB_VERB "%5.2" "-" COMPU_TAB_REF Def_bit_ub_5_VTAB /end COMPU_METHOD
/begin COMPU_METHOD Def_st_ub_q1 "Def_st_ub_q1" RAT_FUNC "%3.0" "-" COEFFS 0 1 0 0 0 1 /end COMPU_METHOD
/begin COMPU_METHOD Def_f_sw_b100 "Def_f_sw_b100" RAT_FUNC "%8.3" "-" COEFFS 0 32768 0 0 0 100 /end COMPU_METHOD
/begin COMPU_METHOD Def_t_sw_q0p1 "Def_t_sw_q0p1" RAT_FUNC "%6.1" "°C" COEFFS 0 10 0 0 0 1 /end COMPU_METHOD
/begin COMPU_METHOD Identity "Identity" RAT_FUNC "%3.0" "-" COEFFS 0 1 0 0 0 1 /end COMPU_METHOD
/begin COMPU_METHOD Def_st_uw_q1 "Def_st_uw_q1" RAT_FUNC "%5.0" "-" COEFFS 0 1 0 0 0 1 /end COMPU_METHOD
/begin COMPU_METHOD Def_dez_uw_q1 "Def_dez_uw_q1" RAT_FUNC "%5.0" "-" COEFFS 0 1 0 0 0 1 /end COMPU_METHOD
/begin COMPU_METHOD Def_dez_ub_q1 "Def_dez_ub_q1" RAT_FUNC "%3.0" "-" COEFFS 0 1 0 0 0 1 /end COMPU_METHOD
/begin COMPU_METHOD Def_bit_ub_0 "Def_bit_ub_0" TAB_VERB "%5.2" "-" COMPU_TAB_REF Def_bit_ub_0_VTAB /end COMPU_METHOD
/begin COMPU_METHOD Def_bit_ub_1 "Def_bit_ub_1" TAB_VERB "%5.2" "-" COMPU_TAB_REF Def_bit_ub_1_VTAB /end COMPU_METHOD
/begin COMPU_METHOD Def_bit_ub_2 "Def_bit_ub_2" TAB_VERB "%5.2" "-" COMPU_TAB_REF Def_bit_ub_2_VTAB /end COMPU_METHOD
/begin COMPU_METHOD Def_bit_ub_3 "Def_bit_ub_3" TAB_VERB "%5.2" "-" COMPU_TAB_REF Def_bit_ub_3_VTAB /end COMPU_METHOD
/begin COMPU_METHOD Def_st_ub_q1 "Def_st_ub_q1" RAT_FUNC "%3.0" "-" COEFFS 0 1 0 0 0 1 /end COMPU_METHOD
/begin COMPU_METHOD Def_n_sw_q1p0 "Def_n_sw_q1p0" RAT_FUNC "%5.0" "Upm" COEFFS 0 1 0 0 0 1 /end COMPU_METHOD
/begin COMPU_METHOD Def_u_uw_q0p0942 "Def_u_uw_q0p0942" RAT_FUNC "%6.1" "V" COEFFS 0 1 0 0 0 0.0942 /end COMPU_METHOD
/begin COMPU_METHOD Def_dez_ub_q1 "Def_dez_ub_q1" RAT_FUNC "%3.0" "-" COEFFS 0 1 0 0 0 1 /end COMPU_METHOD
/begin COMPU_METHOD Def_td_uw_q0p01 "Def_td_uw_q0p01" RAT_FUNC "%7.2" "s" COEFFS 0 100 0 0 0 1 /end COMPU_METHOD
/begin COMPU_METHOD Identity "Identity" RAT_FUNC "%3.0" "-" COEFFS 0 1 0 0 0 1 /end COMPU_METHOD
/begin COMPU_METHOD Def_t_sw_q0p1 "Def_t_sw_q0p1" RAT_FUNC "%6.1" "°C" COEFFS 0 10 0 0 0 1 /end COMPU_METHOD
/begin COMPU_METHOD Def_bit_ub_0 "Def_bit_ub_0" TAB_VERB "%5.2" "-" COMPU_TAB_REF Def_bit_ub_0_VTAB /end COMPU_METHOD
/begin COMPU_METHOD Def_bit_ub_1 "Def_bit_ub_1" TAB_VERB "%5.2" "-" COMPU_TAB_REF Def_bit_ub_1_VTAB /end COMPU_METHOD
/begin COMPU_METHOD Def_bit_ub_2 "Def_bit_ub_2" TAB_VERB "%5.2" "-" COMPU_TAB_REF Def_bit_ub_2_VTAB /end COMPU_METHOD
/begin COMPU_METHOD Def_bit_ub_3 "Def_bit_ub_3" TAB_VERB "%5.2" "-" COMPU_TAB_REF Def_bit_ub_3_VTAB /end COMPU_METHOD
/begin COMPU_METHOD Def_bit_ub_4 "Def_bit_ub_4" TAB_VERB "%5.2" "-" COMPU_TAB_REF Def_bit_ub_4_VTAB /end COMPU_METHOD
/begin COMPU_METHOD Def_st_ub_q1 "Def_st_ub_q1" RAT_FUNC "%3.0" "-" COEFFS 0 1 0 0 0 1 /end COMPU_METHOD
/begin COMPU_METHOD Def_dez_uw_q1 "Def_dez_uw_q1" RAT_FUNC "%5.0" "-" COEFFS 0 1 0 0 0 1 /end COMPU_METHOD
/begin COMPU_METHOD Def_dez_ub_q1 "Def_dez_ub_q1" RAT_FUNC "%3.0" "-" COEFFS 0 1 0 0 0 1 /end COMPU_METHOD
/begin COMPU_METHOD Def_v_uw_q1p0 "Def_v_uw_q1p0" RAT_FUNC "%5.0" "km/h" COEFFS 0 1 0 0 0 1 /end COMPU_METHOD
/begin COMPU_METHOD Def_td_uw_q0p01 "Def_td_uw_q0p01" RAT_FUNC "%7.2" "s" COEFFS 0 100 0 0 0 1 /end COMPU_METHOD
/begin COMPU_METHOD Def_f_ub_b100 "Def_f_ub_b100" RAT_FUNC "%5.2" "%" COEFFS 0 256 0 0 0 100 /end COMPU_METHOD
/begin COMPU_METHOD Def_bit_ub_0 "Def_bit_ub_0" TAB_VERB "%5.2" "-" COMPU_TAB_REF Def_bit_ub_0_VTAB /end COMPU_METHOD
/begin COMPU_METHOD Def_bit_ub_1 "Def_bit_ub_1" TAB_VERB "%5.2" "-" COMPU_TAB_REF Def_bit_ub_1_VTAB /end COMPU_METHOD
/begin COMPU_METHOD Def_st_ub_q1 "Def_st_ub_q1" RAT_FUNC "%3.0" "-" COEFFS 0 1 0 0 0 1 /end COMPU_METHOD
/begin COMPU_METHOD Def_dez_ub_q1 "Def_dez_ub_q1" RAT_FUNC "%3.0" "-" COEFFS 0 1 0 0 0 1 /end COMPU_METHOD
/begin COMPU_METHOD Def_bit_ub_3 "Def_bit_ub_3" TAB_VERB "%5.2" "-" COMPU_TAB_REF Def_bit_ub_3_VTAB /end COMPU_METHOD
/begin COMPU_METHOD Def_bit_ub_4 "Def_bit_ub_4" TAB_VERB "%5.2" "-" COMPU_TAB_REF Def_bit_ub_4_VTAB /end COMPU_METHOD
/begin COMPU_METHOD Def_st_ub_q1 "Def_st_ub_q1" RAT_FUNC "%3.0" "-" COEFFS 0 1 0 0 0 1 /end COMPU_METHOD
/begin COMPU_METHOD Def_bit_ub_0 "Def_bit_ub_0" TAB_VERB "%5.2" "-" COMPU_TAB_REF Def_bit_ub_0_VTAB /end COMPU_METHOD
/begin COMPU_METHOD Def_dez_uw_q1 "Def_dez_uw_q1" RAT_FUNC "%5.0" "-" COEFFS 0 1 0 0 0 1 /end COMPU_METHOD
/begin COMPU_METHOD Def_dez_ub_q1 "Def_dez_ub_q1" RAT_FUNC "%3.0" "-" COEFFS 0 1 0 0 0 1 /end COMPU_METHOD
/begin COMPU_METHOD Def_f_ub_b100 "Def_f_ub_b100" RAT_FUNC "%5.2" "%" COEFFS 0 256 0 0 0 100 /end COMPU_METHOD
/begin COMPU_METHOD Def_i_ub_q1 "Def_i_ub_q1" RAT_FUNC "%6.3" "" COEFFS 0 1 0 0 0 1 /end COMPU_METHOD
/begin COMPU_METHOD Identity "Identity" RAT_FUNC "%3.0" "-" COEFFS 0 1 0 0 0 1 /end COMPU_METHOD
/begin COMPU_METHOD Def_dez_uw_q1 "Def_dez_uw_q1" RAT_FUNC "%5.0" "-" COEFFS 0 1 0 0 0 1 /end COMPU_METHOD
/begin COMPU_METHOD Def_bit_ub_0 "Def_bit_ub_0" TAB_VERB "%5.2" "-" COMPU_TAB_REF Def_bit_ub_0_VTAB /end COMPU_METHOD
/begin COMPU_METHOD Def_bit_ub_1 "Def_bit_ub_1" TAB_VERB "%5.2" "-" COMPU_TAB_REF Def_bit_ub_1_VTAB /end COMPU_METHOD
/begin COMPU_METHOD Def_bit_ub_2 "Def_bit_ub_2" TAB_VERB "%5.2" "-" COMPU_TAB_REF Def_bit_ub_2_VTAB /end COMPU_METHOD
/begin COMPU_METHOD Def_bit_ub_3 "Def_bit_ub_3" TAB_VERB "%5.2" "-" COMPU_TAB_REF Def_bit_ub_3_VTAB /end COMPU_METHOD
/begin COMPU_METHOD Def_bit_ub_4 "Def_bit_ub_4" TAB_VERB "%5.2" "-" COMPU_TAB_REF Def_bit_ub_4_VTAB /end COMPU_METHOD
/begin COMPU_METHOD Def_bit_ub_5 "Def_bit_ub_5" TAB_VERB "%5.2" "-" COMPU_TAB_REF Def_bit_ub_5_VTAB /end COMPU_METHOD
/begin COMPU_METHOD Def_st_ub_q1 "Def_st_ub_q1" RAT_FUNC "%3.0" "-" COEFFS 0 1 0 0 0 1 /end COMPU_METHOD
/begin COMPU_METHOD Def_dez_ub_q1 "Def_dez_ub_q1" RAT_FUNC "%3.0" "-" COEFFS 0 1 0 0 0 1 /end COMPU_METHOD
/begin COMPU_METHOD Identity "Identity" RAT_FUNC "%3.0" "-" COEFFS 0 1 0 0 0 1 /end COMPU_METHOD
/begin COMPU_METHOD Def_t_sw_q0p1 "Def_t_sw_q0p1" RAT_FUNC "%6.1" "°C" COEFFS 0 10 0 0 0 1 /end COMPU_METHOD
/begin COMPU_METHOD Def_bit_ub_0 "Def_bit_ub_0" TAB_VERB "%5.2" "-" COMPU_TAB_REF Def_bit_ub_0_VTAB /end COMPU_METHOD
/begin COMPU_METHOD Def_st_ub_q1 "Def_st_ub_q1" RAT_FUNC "%3.0" "-" COEFFS 0 1 0 0 0 1 /end COMPU_METHOD
/begin COMPU_METHOD Def_dez_ub_q1 "Def_dez_ub_q1" RAT_FUNC "%3.0" "-" COEFFS 0 1 0 0 0 1 /end COMPU_METHOD
/begin COMPU_METHOD Def_td_uw_q0p1 "Def_td_uw_q0p1" RAT_FUNC "%6.1" "s" COEFFS 0 10 0 0 0 1 /end COMPU_METHOD
/begin COMPU_METHOD Def_dez_uw_q1 "Def_dez_uw_q1" RAT_FUNC "%5.0" "-" COEFFS 0 1 0 0 0 1 /end COMPU_METHOD
/begin COMPU_METHOD Def_bit_ub_0 "Def_bit_ub_0" TAB_VERB "%5.2" "-" COMPU_TAB_REF Def_bit_ub_0_VTAB /end COMPU_METHOD
/begin COMPU_METHOD Def_st_ub_q1 "Def_st_ub_q1" RAT_FUNC "%3.0" "-" COEFFS 0 1 0 0 0 1 /end COMPU_METHOD
/begin COMPU_METHOD Def_dez_ul_q1 "Def_dez_ul_q1" RAT_FUNC "%7.0" "-" COEFFS 0 1 0 0 0 1 /end COMPU_METHOD
/begin COMPU_METHOD Def_dez_uw_q1 "Def_dez_uw_q1" RAT_FUNC "%5.0" "-" COEFFS 0 1 0 0 0 1 /end COMPU_METHOD
/begin COMPU_METHOD Def_f_ub_b100 "Def_f_ub_b100" RAT_FUNC "%5.2" "%" COEFFS 0 256 0 0 0 100 /end COMPU_METHOD
/begin COMPU_METHOD Def_n_sw_q1p0 "Def_n_sw_q1p0" RAT_FUNC "%5.0" "Upm" COEFFS 0 1 0 0 0 1 /end COMPU_METHOD
/begin COMPU_VTAB Def_bit_ub_1_VTAB "Def_bit_ub_1_VTAB" TAB_VERB 2 0 "FALSE" 1 "TRUE" DEFAULT_VALUE "TRUE" /end COMPU_VTAB
/begin COMPU_VTAB Def_bit_ub_2_VTAB "Def_bit_ub_2_VTAB" TAB_VERB 2 0 "FALSE" 1 "TRUE" DEFAULT_VALUE "TRUE" /end COMPU_VTAB
/begin COMPU_VTAB Def_bit_ub_0_VTAB "Def_bit_ub_0_VTAB" TAB_VERB 2 0 "FALSE" 1 "TRUE" DEFAULT_VALUE "TRUE" /end COMPU_VTAB
/begin COMPU_VTAB Def_bit_ub_3_VTAB "Def_bit_ub_3_VTAB" TAB_VERB 2 0 "FALSE" 1 "TRUE" DEFAULT_VALUE "TRUE" /end COMPU_VTAB
/begin COMPU_VTAB Def_bit_ub_4_VTAB "Def_bit_ub_4_VTAB" TAB_VERB 2 0 "FALSE" 1 "TRUE" DEFAULT_VALUE "TRUE" /end COMPU_VTAB
/begin COMPU_VTAB Def_bit_ub_5_VTAB "Def_bit_ub_5_VTAB" TAB_VERB 2 0 "FALSE" 1 "TRUE" DEFAULT_VALUE "TRUE" /end COMPU_VTAB
/begin COMPU_VTAB Def_bit_ub_6_VTAB "Def_bit_ub_6_VTAB" TAB_VERB 2 0 "FALSE" 1 "TRUE" DEFAULT_VALUE "TRUE" /end COMPU_VTAB
/begin COMPU_VTAB Def_bit_ub_7_VTAB "Def_bit_ub_7_VTAB" TAB_VERB 2 0 "FALSE" 1 "TRUE" DEFAULT_VALUE "TRUE" /end COMPU_VTAB
/begin COMPU_VTAB Def_bit_uw_0_VTAB "Def_bit_uw_0_VTAB" TAB_VERB 2 0 "FALSE" 1 "TRUE" DEFAULT_VALUE "TRUE" /end COMPU_VTAB
/begin COMPU_VTAB Def_bit_uw_3_VTAB "Def_bit_uw_3_VTAB" TAB_VERB 2 0 "FALSE" 1 "TRUE" DEFAULT_VALUE "TRUE" /end COMPU_VTAB
/begin COMPU_VTAB Def_bit_uw_5_VTAB "Def_bit_uw_5_VTAB" TAB_VERB 2 0 "FALSE" 1 "TRUE" DEFAULT_VALUE "TRUE" /end COMPU_VTAB
/begin COMPU_VTAB Def_bit_uw_6_VTAB "Def_bit_uw_6_VTAB" TAB_VERB 2 0 "FALSE" 1 "TRUE" DEFAULT_VALUE "TRUE" /end COMPU_VTAB
/begin COMPU_VTAB Def_bit_uw_1_VTAB "Def_bit_uw_1_VTAB" TAB_VERB 2 0 "FALSE" 1 "TRUE" DEFAULT_VALUE "TRUE" /end COMPU_VTAB
/begin COMPU_VTAB Def_bit_uw_2_VTAB "Def_bit_uw_2_VTAB" TAB_VERB 2 0 "FALSE" 1 "TRUE" DEFAULT_VALUE "TRUE" /end COMPU_VTAB
/begin COMPU_VTAB Def_bit_uw_4_VTAB "Def_bit_uw_4_VTAB" TAB_VERB 2 0 "FALSE" 1 "TRUE" DEFAULT_VALUE "TRUE" /end COMPU_VTAB
/begin COMPU_VTAB Def_bit_uw_9_VTAB "Def_bit_uw_9_VTAB" TAB_VERB 2 0 "FALSE" 1 "TRUE" DEFAULT_VALUE "TRUE" /end COMPU_VTAB
/begin COMPU_VTAB Def_bit_uw_11_VTAB "Def_bit_uw_11_VTAB" TAB_VERB 2 0 "FALSE" 1 "TRUE" DEFAULT_VALUE "TRUE" /end COMPU_VTAB
/begin COMPU_VTAB Def_bit_uw_12_VTAB "Def_bit_uw_12_VTAB" TAB_VERB 2 0 "FALSE" 1 "TRUE" DEFAULT_VALUE "TRUE" /end COMPU_VTAB
/begin COMPU_VTAB Def_bit_ub_0_VTAB "Def_bit_ub_0_VTAB" TAB_VERB 2 0 "FALSE" 1 "TRUE" DEFAULT_VALUE "TRUE" /end COMPU_VTAB
/begin COMPU_VTAB Def_bit_ub_1_VTAB "Def_bit_ub_1_VTAB" TAB_VERB 2 0 "FALSE" 1 "TRUE" DEFAULT_VALUE "TRUE" /end COMPU_VTAB
/begin COMPU_VTAB Def_bit_ub_2_VTAB "Def_bit_ub_2_VTAB" TAB_VERB 2 0 "FALSE" 1 "TRUE" DEFAULT_VALUE "TRUE" /end COMPU_VTAB
/begin COMPU_VTAB Def_bit_ub_3_VTAB "Def_bit_ub_3_VTAB" TAB_VERB 2 0 "FALSE" 1 "TRUE" DEFAULT_VALUE "TRUE" /end COMPU_VTAB
/begin COMPU_VTAB Def_bit_uw_0_VTAB "Def_bit_uw_0_VTAB" TAB_VERB 2 0 "FALSE" 1 "TRUE" DEFAULT_VALUE "TRUE" /end COMPU_VTAB
/begin COMPU_VTAB Def_bit_uw_1_VTAB "Def_bit_uw_1_VTAB" TAB_VERB 2 0 "FALSE" 1 "TRUE" DEFAULT_VALUE "TRUE" /end COMPU_VTAB
/begin COMPU_VTAB Def_bit_uw_2_VTAB "Def_bit_uw_2_VTAB" TAB_VERB 2 0 "FALSE" 1 "TRUE" DEFAULT_VALUE "TRUE" /end COMPU_VTAB
/begin COMPU_VTAB Def_bit_uw_3_VTAB "Def_bit_uw_3_VTAB" TAB_VERB 2 0 "FALSE" 1 "TRUE" DEFAULT_VALUE "TRUE" /end COMPU_VTAB
/begin COMPU_VTAB Def_bit_uw_4_VTAB "Def_bit_uw_4_VTAB" TAB_VERB 2 0 "FALSE" 1 "TRUE" DEFAULT_VALUE "TRUE" /end COMPU_VTAB
/begin COMPU_VTAB Def_bit_uw_5_VTAB "Def_bit_uw_5_VTAB" TAB_VERB 2 0 "FALSE" 1 "TRUE" DEFAULT_VALUE "TRUE" /end COMPU_VTAB
/begin COMPU_VTAB Def_bit_uw_6_VTAB "Def_bit_uw_6_VTAB" TAB_VERB 2 0 "FALSE" 1 "TRUE" DEFAULT_VALUE "TRUE" /end COMPU_VTAB
/begin COMPU_VTAB Def_bit_ub_0_VTAB "Def_bit_ub_0_VTAB" TAB_VERB 2 0 "FALSE" 1 "TRUE" DEFAULT_VALUE "TRUE" /end COMPU_VTAB
/begin COMPU_VTAB Def_bit_uw_0_VTAB "Def_bit_uw_0_VTAB" TAB_VERB 2 0 "FALSE" 1 "TRUE" DEFAULT_VALUE "TRUE" /end COMPU_VTAB
/begin COMPU_VTAB Def_bit_uw_1_VTAB "Def_bit_uw_1_VTAB" TAB_VERB 2 0 "FALSE" 1 "TRUE" DEFAULT_VALUE "TRUE" /end COMPU_VTAB
/begin COMPU_VTAB Def_bit_uw_2_VTAB "Def_bit_uw_2_VTAB" TAB_VERB 2 0 "FALSE" 1 "TRUE" DEFAULT_VALUE "TRUE" /end COMPU_VTAB
/begin COMPU_VTAB Def_bit_uw_3_VTAB "Def_bit_uw_3_VTAB" TAB_VERB 2 0 "FALSE" 1 "TRUE" DEFAULT_VALUE "TRUE" /end COMPU_VTAB
/begin COMPU_VTAB Def_bit_uw_4_VTAB "Def_bit_uw_4_VTAB" TAB_VERB 2 0 "FALSE" 1 "TRUE" DEFAULT_VALUE "TRUE" /end COMPU_VTAB
/begin COMPU_VTAB Def_bit_uw_5_VTAB "Def_bit_uw_5_VTAB" TAB_VERB 2 0 "FALSE" 1 "TRUE" DEFAULT_VALUE "TRUE" /end COMPU_VTAB
/begin COMPU_VTAB Def_bit_uw_6_VTAB "Def_bit_uw_6_VTAB" TAB_VERB 2 0 "FALSE" 1 "TRUE" DEFAULT_VALUE "TRUE" /end COMPU_VTAB
/begin COMPU_VTAB Def_bit_uw_7_VTAB "Def_bit_uw_7_VTAB" TAB_VERB 2 0 "FALSE" 1 "TRUE" DEFAULT_VALUE "TRUE" /end COMPU_VTAB
/begin COMPU_VTAB Def_bit_uw_8_VTAB "Def_bit_uw_8_VTAB" TAB_VERB 2 0 "FALSE" 1 "TRUE" DEFAULT_VALUE "TRUE" /end COMPU_VTAB
/begin COMPU_VTAB Def_bit_uw_9_VTAB "Def_bit_uw_9_VTAB" TAB_VERB 2 0 "FALSE" 1 "TRUE" DEFAULT_VALUE "TRUE" /end COMPU_VTAB
/begin COMPU_VTAB Def_bit_uw_10_VTAB "Def_bit_uw_10_VTAB" TAB_VERB 2 0 "FALSE" 1 "TRUE" DEFAULT_VALUE "TRUE" /end COMPU_VTAB
/begin COMPU_VTAB Def_bit_uw_11_VTAB "Def_bit_uw_11_VTAB" TAB_VERB 2 0 "FALSE" 1 "TRUE" DEFAULT_VALUE "TRUE" /end COMPU_VTAB
/begin COMPU_VTAB Def_bit_uw_12_VTAB "Def_bit_uw_12_VTAB" TAB_VERB 2 0 "FALSE" 1 "TRUE" DEFAULT_VALUE "TRUE" /end COMPU_VTAB
/begin COMPU_VTAB Def_bit_ub_0_VTAB "Def_bit_ub_0_VTAB" TAB_VERB 2 0 "FALSE" 1 "TRUE" DEFAULT_VALUE "TRUE" /end COMPU_VTAB
/begin COMPU_VTAB Def_bit_ub_1_VTAB "Def_bit_ub_1_VTAB" TAB_VERB 2 0 "FALSE" 1 "TRUE" DEFAULT_VALUE "TRUE" /end COMPU_VTAB
/begin COMPU_VTAB Def_bit_ub_2_VTAB "Def_bit_ub_2_VTAB" TAB_VERB 2 0 "FALSE" 1 "TRUE" DEFAULT_VALUE "TRUE" /end COMPU_VTAB
/begin COMPU_VTAB Def_bit_uw_0_VTAB "Def_bit_uw_0_VTAB" TAB_VERB 2 0 "FALSE" 1 "TRUE" DEFAULT_VALUE "TRUE" /end COMPU_VTAB
/begin COMPU_VTAB Def_bit_uw_1_VTAB "Def_bit_uw_1_VTAB" TAB_VERB 2 0 "FALSE" 1 "TRUE" DEFAULT_VALUE "TRUE" /end COMPU_VTAB
/begin COMPU_VTAB Def_bit_uw_2_VTAB "Def_bit_uw_2_VTAB" TAB_VERB 2 0 "FALSE" 1 "TRUE" DEFAULT_VALUE "TRUE" /end COMPU_VTAB
/begin COMPU_VTAB Def_bit_uw_3_VTAB "Def_bit_uw_3_VTAB" TAB_VERB 2 0 "FALSE" 1 "TRUE" DEFAULT_VALUE "TRUE" /end COMPU_VTAB
/begin COMPU_VTAB Def_bit_ub_3_VTAB "Def_bit_ub_3_VTAB" TAB_VERB 2 0 "FALSE" 1 "TRUE" DEFAULT_VALUE "TRUE" /end COMPU_VTAB
/begin COMPU_VTAB Def_bit_ub_4_VTAB "Def_bit_ub_4_VTAB" TAB_VERB 2 0 "FALSE" 1 "TRUE" DEFAULT_VALUE "TRUE" /end COMPU_VTAB
/begin COMPU_VTAB Def_bit_ub_5_VTAB "Def_bit_ub_5_VTAB" TAB_VERB 2 0 "FALSE" 1 "TRUE" DEFAULT_VALUE "TRUE" /end COMPU_VTAB
/begin COMPU_VTAB Def_bit_ub_6_VTAB "Def_bit_ub_6_VTAB" TAB_VERB 2 0 "FALSE" 1 "TRUE" DEFAULT_VALUE "TRUE" /end COMPU_VTAB
/begin COMPU_VTAB Def_bit_ub_7_VTAB "Def_bit_ub_7_VTAB" TAB_VERB 2 0 "FALSE" 1 "TRUE" DEFAULT_VALUE "TRUE" /end COMPU_VTAB
/begin COMPU_VTAB Def_bit_uw_4_VTAB "Def_bit_uw_4_VTAB" TAB_VERB 2 0 "FALSE" 1 "TRUE" DEFAULT_VALUE "TRUE" /end COMPU_VTAB
/begin COMPU_VTAB Def_bit_uw_5_VTAB "Def_bit_uw_5_VTAB" TAB_VERB 2 0 "FALSE" 1 "TRUE" DEFAULT_VALUE "TRUE" /end COMPU_VTAB
/begin COMPU_VTAB Def_bit_uw_6_VTAB "Def_bit_uw_6_VTAB" TAB_VERB 2 0 "FALSE" 1 "TRUE" DEFAULT_VALUE "TRUE" /end COMPU_VTAB
/begin COMPU_VTAB Def_bit_uw_7_VTAB "Def_bit_uw_7_VTAB" TAB_VERB 2 0 "FALSE" 1 "TRUE" DEFAULT_VALUE "TRUE" /end COMPU_VTAB
/begin COMPU_VTAB Def_bit_uw_8_VTAB "Def_bit_uw_8_VTAB" TAB_VERB 2 0 "FALSE" 1 "TRUE" DEFAULT_VALUE "TRUE" /end COMPU_VTAB
/begin COMPU_VTAB Def_bit_uw_9_VTAB "Def_bit_uw_9_VTAB" TAB_VERB 2 0 "FALSE" 1 "TRUE" DEFAULT_VALUE "TRUE" /end COMPU_VTAB
/begin COMPU_VTAB Def_bit_uw_10_VTAB "Def_bit_uw_10_VTAB" TAB_VERB 2 0 "FALSE" 1 "TRUE" DEFAULT_VALUE "TRUE" /end COMPU_VTAB
/begin COMPU_VTAB Def_bit_uw_11_VTAB "Def_bit_uw_11_VTAB" TAB_VERB 2 0 "FALSE" 1 "TRUE" DEFAULT_VALUE "TRUE" /end COMPU_VTAB
/begin COMPU_VTAB Def_bit_uw_12_VTAB "Def_bit_uw_12_VTAB" TAB_VERB 2 0 "FALSE" 1 "TRUE" DEFAULT_VALUE "TRUE" /end COMPU_VTAB
/begin COMPU_VTAB Def_bit_uw_13_VTAB "Def_bit_uw_13_VTAB" TAB_VERB 2 0 "FALSE" 1 "TRUE" DEFAULT_VALUE "TRUE" /end COMPU_VTAB
/begin COMPU_VTAB Def_bit_uw_14_VTAB "Def_bit_uw_14_VTAB" TAB_VERB 2 0 "FALSE" 1 "TRUE" DEFAULT_VALUE "TRUE" /end COMPU_VTAB
/begin COMPU_VTAB Def_bit_uw_15_VTAB "Def_bit_uw_15_VTAB" TAB_VERB 2 0 "FALSE" 1 "TRUE" DEFAULT_VALUE "TRUE" /end COMPU_VTAB
/begin COMPU_VTAB Def_bit_ub_0_VTAB "Def_bit_ub_0_VTAB" TAB_VERB 2 0 "FALSE" 1 "TRUE" DEFAULT_VALUE "TRUE" /end COMPU_VTAB
/begin COMPU_VTAB Def_bit_ub_1_VTAB "Def_bit_ub_1_VTAB" TAB_VERB 2 0 "FALSE" 1 "TRUE" DEFAULT_VALUE "TRUE" /end COMPU_VTAB
/begin COMPU_VTAB Def_bit_ub_2_VTAB "Def_bit_ub_2_VTAB" TAB_VERB 2 0 "FALSE" 1 "TRUE" DEFAULT_VALUE "TRUE" /end COMPU_VTAB
/begin COMPU_VTAB Def_bit_uw_0_VTAB "Def_bit_uw_0_VTAB" TAB_VERB 2 0 "FALSE" 1 "TRUE" DEFAULT_VALUE "TRUE" /end COMPU_VTAB
/begin COMPU_VTAB Def_bit_uw_1_VTAB "Def_bit_uw_1_VTAB" TAB_VERB 2 0 "FALSE" 1 "TRUE" DEFAULT_VALUE "TRUE" /end COMPU_VTAB
/begin COMPU_VTAB Def_bit_uw_2_VTAB "Def_bit_uw_2_VTAB" TAB_VERB 2 0 "FALSE" 1 "TRUE" DEFAULT_VALUE "TRUE" /end COMPU_VTAB
/begin COMPU_VTAB Def_bit_uw_3_VTAB "Def_bit_uw_3_VTAB" TAB_VERB 2 0 "FALSE" 1 "TRUE" DEFAULT_VALUE "TRUE" /end COMPU_VTAB
/begin COMPU_VTAB Def_bit_uw_4_VTAB "Def_bit_uw_4_VTAB" TAB_VERB 2 0 "FALSE" 1 "TRUE" DEFAULT_VALUE "TRUE" /end COMPU_VTAB
/begin COMPU_VTAB Def_bit_uw_5_VTAB "Def_bit_uw_5_VTAB" TAB_VERB 2 0 "FALSE" 1 "TRUE" DEFAULT_VALUE "TRUE" /end COMPU_VTAB
/begin COMPU_VTAB Def_bit_ub_0_VTAB "Def_bit_ub_0_VTAB" TAB_VERB 2 0 "FALSE" 1 "TRUE" DEFAULT_VALUE "TRUE" /end COMPU_VTAB
/begin COMPU_VTAB Def_bit_ub_1_VTAB "Def_bit_ub_1_VTAB" TAB_VERB 2 0 "FALSE" 1 "TRUE" DEFAULT_VALUE "TRUE" /end COMPU_VTAB
/begin COMPU_VTAB Def_bit_uw_0_VTAB "Def_bit_uw_0_VTAB" TAB_VERB 2 0 "FALSE" 1 "TRUE" DEFAULT_VALUE "TRUE" /end COMPU_VTAB
/begin COMPU_VTAB Def_bit_uw_1_VTAB "Def_bit_uw_1_VTAB" TAB_VERB 2 0 "FALSE" 1 "TRUE" DEFAULT_VALUE "TRUE" /end COMPU_VTAB
/begin COMPU_VTAB Def_bit_uw_2_VTAB "Def_bit_uw_2_VTAB" TAB_VERB 2 0 "FALSE" 1 "TRUE" DEFAULT_VALUE "TRUE" /end COMPU_VTAB
/begin COMPU_VTAB Def_bit_ub_0_VTAB "Def_bit_ub_0_VTAB" TAB_VERB 2 0 "FALSE" 1 "TRUE" DEFAULT_VALUE "TRUE" /end COMPU_VTAB
/begin COMPU_VTAB Def_bit_ub_1_VTAB "Def_bit_ub_1_VTAB" TAB_VERB 2 0 "FALSE" 1 "TRUE" DEFAULT_VALUE "TRUE" /end COMPU_VTAB
/begin COMPU_VTAB Def_bit_ub_0_VTAB "Def_bit_ub_0_VTAB" TAB_VERB 2 0 "FALSE" 1 "TRUE" DEFAULT_VALUE "TRUE" /end COMPU_VTAB
/begin COMPU_VTAB Def_bit_ub_0_VTAB "Def_bit_ub_0_VTAB" TAB_VERB 2 0 "FALSE" 1 "TRUE" DEFAULT_VALUE "TRUE" /end COMPU_VTAB
/begin COMPU_VTAB Def_bit_ub_1_VTAB "Def_bit_ub_1_VTAB" TAB_VERB 2 0 "FALSE" 1 "TRUE" DEFAULT_VALUE "TRUE" /end COMPU_VTAB
/begin COMPU_VTAB Def_bit_ub_2_VTAB "Def_bit_ub_2_VTAB" TAB_VERB 2 0 "FALSE" 1 "TRUE" DEFAULT_VALUE "TRUE" /end COMPU_VTAB
/begin COMPU_VTAB Def_bit_ub_3_VTAB "Def_bit_ub_3_VTAB" TAB_VERB 2 0 "FALSE" 1 "TRUE" DEFAULT_VALUE "TRUE" /end COMPU_VTAB
/begin COMPU_VTAB Def_bit_ub_4_VTAB "Def_bit_ub_4_VTAB" TAB_VERB 2 0 "FALSE" 1 "TRUE" DEFAULT_VALUE "TRUE" /end COMPU_VTAB
/begin COMPU_VTAB Def_bit_ub_5_VTAB "Def_bit_ub_5_VTAB" TAB_VERB 2 0 "FALSE" 1 "TRUE" DEFAULT_VALUE "TRUE" /end COMPU_VTAB
/begin COMPU_VTAB Def_bit_ub_6_VTAB "Def_bit_ub_6_VTAB" TAB_VERB 2 0 "FALSE" 1 "TRUE" DEFAULT_VALUE "TRUE" /end COMPU_VTAB
/begin COMPU_VTAB Def_bit_ub_7_VTAB "Def_bit_ub_7_VTAB" TAB_VERB 2 0 "FALSE" 1 "TRUE" DEFAULT_VALUE "TRUE" /end COMPU_VTAB
/begin COMPU_VTAB Def_bit_ub_0_VTAB "Def_bit_ub_0_VTAB" TAB_VERB 2 0 "FALSE" 1 "TRUE" DEFAULT_VALUE "TRUE" /end COMPU_VTAB
/begin COMPU_VTAB Def_bit_ub_1_VTAB "Def_bit_ub_1_VTAB" TAB_VERB 2 0 "FALSE" 1 "TRUE" DEFAULT_VALUE "TRUE" /end COMPU_VTAB
/begin COMPU_VTAB Def_bit_ub_2_VTAB "Def_bit_ub_2_VTAB" TAB_VERB 2 0 "FALSE" 1 "TRUE" DEFAULT_VALUE "TRUE" /end COMPU_VTAB
/begin COMPU_VTAB Def_bit_ub_3_VTAB "Def_bit_ub_3_VTAB" TAB_VERB 2 0 "FALSE" 1 "TRUE" DEFAULT_VALUE "TRUE" /end COMPU_VTAB
/begin COMPU_VTAB Def_bit_ub_4_VTAB "Def_bit_ub_4_VTAB" TAB_VERB 2 0 "FALSE" 1 "TRUE" DEFAULT_VALUE "TRUE" /end COMPU_VTAB
/begin COMPU_VTAB Def_bit_ub_5_VTAB "Def_bit_ub_5_VTAB" TAB_VERB 2 0 "FALSE" 1 "TRUE" DEFAULT_VALUE "TRUE" /end COMPU_VTAB
/begin COMPU_VTAB Def_bit_ub_6_VTAB "Def_bit_ub_6_VTAB" TAB_VERB 2 0 "FALSE" 1 "TRUE" DEFAULT_VALUE "TRUE" /end COMPU_VTAB
/begin COMPU_VTAB Def_bit_ub_7_VTAB "Def_bit_ub_7_VTAB" TAB_VERB 2 0 "FALSE" 1 "TRUE" DEFAULT_VALUE "TRUE" /end COMPU_VTAB
/begin COMPU_VTAB Def_bit_ub_2_VTAB "Def_bit_ub_2_VTAB" TAB_VERB 2 0 "FALSE" 1 "TRUE" DEFAULT_VALUE "TRUE" /end COMPU_VTAB
/begin COMPU_VTAB Def_bit_ub_3_VTAB "Def_bit_ub_3_VTAB" TAB_VERB 2 0 "FALSE" 1 "TRUE" DEFAULT_VALUE "TRUE" /end COMPU_VTAB
/begin COMPU_VTAB Def_bit_ub_4_VTAB "Def_bit_ub_4_VTAB" TAB_VERB 2 0 "FALSE" 1 "TRUE" DEFAULT_VALUE "TRUE" /end COMPU_VTAB
/begin COMPU_VTAB Def_bit_ub_0_VTAB "Def_bit_ub_0_VTAB" TAB_VERB 2 0 "FALSE" 1 "TRUE" DEFAULT_VALUE "TRUE" /end COMPU_VTAB
/begin COMPU_VTAB Def_bit_ub_1_VTAB "Def_bit_ub_1_VTAB" TAB_VERB 2 0 "FALSE" 1 "TRUE" DEFAULT_VALUE "TRUE" /end COMPU_VTAB
/begin COMPU_VTAB Def_bit_ub_5_VTAB "Def_bit_ub_5_VTAB" TAB_VERB 2 0 "FALSE" 1 "TRUE" DEFAULT_VALUE "TRUE" /end COMPU_VTAB
/begin COMPU_VTAB Def_bit_ub_0_VTAB "Def_bit_ub_0_VTAB" TAB_VERB 2 0 "FALSE" 1 "TRUE" DEFAULT_VALUE "TRUE" /end COMPU_VTAB
/begin COMPU_VTAB Def_bit_ub_1_VTAB "Def_bit_ub_1_VTAB" TAB_VERB 2 0 "FALSE" 1 "TRUE" DEFAULT_VALUE "TRUE" /end COMPU_VTAB
/begin COMPU_VTAB Def_bit_ub_2_VTAB "Def_bit_ub_2_VTAB" TAB_VERB 2 0 "FALSE" 1 "TRUE" DEFAULT_VALUE "TRUE" /end COMPU_VTAB
/begin COMPU_VTAB Def_bit_ub_3_VTAB "Def_bit_ub_3_VTAB" TAB_VERB 2 0 "FALSE" 1 "TRUE" DEFAULT_VALUE "TRUE" /end COMPU_VTAB
/begin COMPU_VTAB Def_bit_ub_4_VTAB "Def_bit_ub_4_VTAB" TAB_VERB 2 0 "FALSE" 1 "TRUE" DEFAULT_VALUE "TRUE" /end COMPU_VTAB
/begin COMPU_VTAB Def_bit_ub_5_VTAB "Def_bit_ub_5_VTAB" TAB_VERB 2 0 "FALSE" 1 "TRUE" DEFAULT_VALUE "TRUE" /end COMPU_VTAB
/begin COMPU_VTAB Def_bit_ub_6_VTAB "Def_bit_ub_6_VTAB" TAB_VERB 2 0 "FALSE" 1 "TRUE" DEFAULT_VALUE "TRUE" /end COMPU_VTAB
/begin COMPU_VTAB Def_bit_ub_7_VTAB "Def_bit_ub_7_VTAB" TAB_VERB 2 0 "FALSE" 1 "TRUE" DEFAULT_VALUE "TRUE" /end COMPU_VTAB
/begin COMPU_VTAB Def_bit_ub_0_VTAB "Def_bit_ub_0_VTAB" TAB_VERB 2 0 "FALSE" 1 "TRUE" DEFAULT_VALUE "TRUE" /end COMPU_VTAB
/begin COMPU_VTAB Def_bit_ub_1_VTAB "Def_bit_ub_1_VTAB" TAB_VERB 2 0 "FALSE" 1 "TRUE" DEFAULT_VALUE "TRUE" /end COMPU_VTAB
/begin COMPU_VTAB Def_bit_ub_3_VTAB "Def_bit_ub_3_VTAB" TAB_VERB 2 0 "FALSE" 1 "TRUE" DEFAULT_VALUE "TRUE" /end COMPU_VTAB
/begin COMPU_VTAB Def_bit_ub_5_VTAB "Def_bit_ub_5_VTAB" TAB_VERB 2 0 "FALSE" 1 "TRUE" DEFAULT_VALUE "TRUE" /end COMPU_VTAB
/begin COMPU_VTAB Def_bit_ub_6_VTAB "Def_bit_ub_6_VTAB" TAB_VERB 2 0 "FALSE" 1 "TRUE" DEFAULT_VALUE "TRUE" /end COMPU_VTAB
/begin COMPU_VTAB Def_bit_ub_7_VTAB "Def_bit_ub_7_VTAB" TAB_VERB 2 0 "FALSE" 1 "TRUE" DEFAULT_VALUE "TRUE" /end COMPU_VTAB
/begin COMPU_VTAB Def_bit_ub_2_VTAB "Def_bit_ub_2_VTAB" TAB_VERB 2 0 "FALSE" 1 "TRUE" DEFAULT_VALUE "TRUE" /end COMPU_VTAB
/begin COMPU_VTAB Def_bit_ub_4_VTAB "Def_bit_ub_4_VTAB" TAB_VERB 2 0 "FALSE" 1 "TRUE" DEFAULT_VALUE "TRUE" /end COMPU_VTAB
/begin COMPU_VTAB Def_bit_ub_0_VTAB "Def_bit_ub_0_VTAB" TAB_VERB 2 0 "FALSE" 1 "TRUE" DEFAULT_VALUE "TRUE" /end COMPU_VTAB
/begin COMPU_VTAB Def_bit_ub_1_VTAB "Def_bit_ub_1_VTAB" TAB_VERB 2 0 "FALSE" 1 "TRUE" DEFAULT_VALUE "TRUE" /end COMPU_VTAB
/begin COMPU_VTAB Def_bit_ub_2_VTAB "Def_bit_ub_2_VTAB" TAB_VERB 2 0 "FALSE" 1 "TRUE" DEFAULT_VALUE "TRUE" /end COMPU_VTAB
/begin COMPU_VTAB Def_bit_ub_4_VTAB "Def_bit_ub_4_VTAB" TAB_VERB 2 0 "FALSE" 1 "TRUE" DEFAULT_VALUE "TRUE" /end COMPU_VTAB
/begin COMPU_VTAB Def_bit_ub_5_VTAB "Def_bit_ub_5_VTAB" TAB_VERB 2 0 "FALSE" 1 "TRUE" DEFAULT_VALUE "TRUE" /end COMPU_VTAB
/begin COMPU_VTAB Def_bit_ub_0_VTAB "Def_bit_ub_0_VTAB" TAB_VERB 2 0 "FALSE" 1 "TRUE" DEFAULT_VALUE "TRUE" /end COMPU_VTAB
/begin COMPU_VTAB Def_bit_ub_0_VTAB "Def_bit_ub_0_VTAB" TAB_VERB 2 0 "FALSE" 1 "TRUE" DEFAULT_VALUE "TRUE" /end COMPU_VTAB
/begin COMPU_VTAB Def_bit_ub_1_VTAB "Def_bit_ub_1_VTAB" TAB_VERB 2 0 "FALSE" 1 "TRUE" DEFAULT_VALUE "TRUE" /end COMPU_VTAB
/begin COMPU_VTAB Def_bit_ub_2_VTAB "Def_bit_ub_2_VTAB" TAB_VERB 2 0 "FALSE" 1 "TRUE" DEFAULT_VALUE "TRUE" /end COMPU_VTAB
/begin COMPU_VTAB Def_bit_ub_3_VTAB "Def_bit_ub_3_VTAB" TAB_VERB 2 0 "FALSE" 1 "TRUE" DEFAULT_VALUE "TRUE" /end COMPU_VTAB
/begin COMPU_VTAB Def_bit_ub_4_VTAB "Def_bit_ub_4_VTAB" TAB_VERB 2 0 "FALSE" 1 "TRUE" DEFAULT_VALUE "TRUE" /end COMPU_VTAB
/begin COMPU_VTAB Def_bit_ub_0_VTAB "Def_bit_ub_0_VTAB" TAB_VERB 2 0 "FALSE" 1 "TRUE" DEFAULT_VALUE "TRUE" /end COMPU_VTAB
/begin COMPU_VTAB Def_bit_ub_1_VTAB "Def_bit_ub_1_VTAB" TAB_VERB 2 0 "FALSE" 1 "TRUE" DEFAULT_VALUE "TRUE" /end COMPU_VTAB
/begin COMPU_VTAB Def_bit_ub_2_VTAB "Def_bit_ub_2_VTAB" TAB_VERB 2 0 "FALSE" 1 "TRUE" DEFAULT_VALUE "TRUE" /end COMPU_VTAB
/begin COMPU_VTAB Def_bit_ub_3_VTAB "Def_bit_ub_3_VTAB" TAB_VERB 2 0 "FALSE" 1 "TRUE" DEFAULT_VALUE "TRUE" /end COMPU_VTAB
/begin COMPU_VTAB Def_bit_ub_4_VTAB "Def_bit_ub_4_VTAB" TAB_VERB 2 0 "FALSE" 1 "TRUE" DEFAULT_VALUE "TRUE" /end COMPU_VTAB
/begin COMPU_VTAB Def_bit_ub_5_VTAB "Def_bit_ub_5_VTAB" TAB_VERB 2 0 "FALSE" 1 "TRUE" DEFAULT_VALUE "TRUE" /end COMPU_VTAB
/begin COMPU_VTAB Def_bit_ub_6_VTAB "Def_bit_ub_6_VTAB" TAB_VERB 2 0 "FALSE" 1 "TRUE" DEFAULT_VALUE "TRUE" /end COMPU_VTAB
/begin COMPU_VTAB Def_bit_ub_7_VTAB "Def_bit_ub_7_VTAB" TAB_VERB 2 0 "FALSE" 1 "TRUE" DEFAULT_VALUE "TRUE" /end COMPU_VTAB
/begin COMPU_VTAB Def_bit_ub_0_VTAB "Def_bit_ub_0_VTAB" TAB_VERB 2 0 "FALSE" 1 "TRUE" DEFAULT_VALUE "TRUE" /end COMPU_VTAB
/begin COMPU_VTAB Def_bit_ub_1_VTAB "Def_bit_ub_1_VTAB" TAB_VERB 2 0 "FALSE" 1 "TRUE" DEFAULT_VALUE "TRUE" /end COMPU_VTAB
/begin COMPU_VTAB Def_bit_ub_1_VTAB "Def_bit_ub_1_VTAB" TAB_VERB 2 0 "FALSE" 1 "TRUE" DEFAULT_VALUE "TRUE" /end COMPU_VTAB
/begin COMPU_VTAB Def_bit_ub_2_VTAB "Def_bit_ub_2_VTAB" TAB_VERB 2 0 "FALSE" 1 "TRUE" DEFAULT_VALUE "TRUE" /end COMPU_VTAB
/begin COMPU_VTAB Def_bit_ub_3_VTAB "Def_bit_ub_3_VTAB" TAB_VERB 2 0 "FALSE" 1 "TRUE" DEFAULT_VALUE "TRUE" /end COMPU_VTAB
/begin COMPU_VTAB Def_bit_ub_0_VTAB "Def_bit_ub_0_VTAB" TAB_VERB 2 0 "FALSE" 1 "TRUE" DEFAULT_VALUE "TRUE" /end COMPU_VTAB
/begin COMPU_VTAB Def_bit_ub_0_VTAB "Def_bit_ub_0_VTAB" TAB_VERB 2 0 "FALSE" 1 "TRUE" DEFAULT_VALUE "TRUE" /end COMPU_VTAB
/begin COMPU_VTAB Def_bit_ub_1_VTAB "Def_bit_ub_1_VTAB" TAB_VERB 2 0 "FALSE" 1 "TRUE" DEFAULT_VALUE "TRUE" /end COMPU_VTAB
/begin COMPU_VTAB Def_bit_ub_0_VTAB "Def_bit_ub_0_VTAB" TAB_VERB 2 0 "FALSE" 1 "TRUE" DEFAULT_VALUE "TRUE" /end COMPU_VTAB
/begin COMPU_VTAB Def_bit_ub_0_VTAB "Def_bit_ub_0_VTAB" TAB_VERB 2 0 "FALSE" 1 "TRUE" DEFAULT_VALUE "TRUE" /end COMPU_VTAB
/begin COMPU_VTAB Def_bit_ub_1_VTAB "Def_bit_ub_1_VTAB" TAB_VERB 2 0 "FALSE" 1 "TRUE" DEFAULT_VALUE "TRUE" /end COMPU_VTAB
/begin COMPU_VTAB Def_bit_ub_0_VTAB "Def_bit_ub_0_VTAB" TAB_VERB 2 0 "FALSE" 1 "TRUE" DEFAULT_VALUE "TRUE" /end COMPU_VTAB
/begin COMPU_VTAB Def_bit_ub_1_VTAB "Def_bit_ub_1_VTAB" TAB_VERB 2 0 "FALSE" 1 "TRUE" DEFAULT_VALUE "TRUE" /end COMPU_VTAB
/begin COMPU_VTAB Def_bit_ub_0_VTAB "Def_bit_ub_0_VTAB" TAB_VERB 2 0 "FALSE" 1 "TRUE" DEFAULT_VALUE "TRUE" /end COMPU_VTAB
/begin COMPU_VTAB Def_bit_ub_1_VTAB "Def_bit_ub_1_VTAB" TAB_VERB 2 0 "FALSE" 1 "TRUE" DEFAULT_VALUE "TRUE" /end COMPU_VTAB
/begin COMPU_VTAB Def_bit_ub_2_VTAB "Def_bit_ub_2_VTAB" TAB_VERB 2 0 "FALSE" 1 "TRUE" DEFAULT_VALUE "TRUE" /end COMPU_VTAB
/begin COMPU_VTAB Def_bit_ub_3_VTAB "Def_bit_ub_3_VTAB" TAB_VERB 2 0 "FALSE" 1 "TRUE" DEFAULT_VALUE "TRUE" /end COMPU_VTAB
/begin COMPU_VTAB Def_bit_ub_4_VTAB "Def_bit_ub_4_VTAB" TAB_VERB 2 0 "FALSE" 1 "TRUE" DEFAULT_VALUE "TRUE" /end COMPU_VTAB
/begin COMPU_VTAB Def_bit_ub_0_VTAB "Def_bit_ub_0_VTAB" TAB_VERB 2 0 "FALSE" 1 "TRUE" DEFAULT_VALUE "TRUE" /end COMPU_VTAB
/begin COMPU_VTAB Def_bit_ub_1_VTAB "Def_bit_ub_1_VTAB" TAB_VERB 2 0 "FALSE" 1 "TRUE" DEFAULT_VALUE "TRUE" /end COMPU_VTAB
/begin COMPU_VTAB Def_bit_ub_2_VTAB "Def_bit_ub_2_VTAB" TAB_VERB 2 0 "FALSE" 1 "TRUE" DEFAULT_VALUE "TRUE" /end COMPU_VTAB
/begin COMPU_VTAB Def_bit_ub_0_VTAB "Def_bit_ub_0_VTAB" TAB_VERB 2 0 "FALSE" 1 "TRUE" DEFAULT_VALUE "TRUE" /end COMPU_VTAB
/begin COMPU_VTAB Def_bit_ub_1_VTAB "Def_bit_ub_1_VTAB" TAB_VERB 2 0 "FALSE" 1 "TRUE" DEFAULT_VALUE "TRUE" /end COMPU_VTAB
/begin COMPU_VTAB Def_bit_ub_4_VTAB "Def_bit_ub_4_VTAB" TAB_VERB 2 0 "FALSE" 1 "TRUE" DEFAULT_VALUE "TRUE" /end COMPU_VTAB
/begin COMPU_VTAB Def_bit_ub_5_VTAB "Def_bit_ub_5_VTAB" TAB_VERB 2 0 "FALSE" 1 "TRUE" DEFAULT_VALUE "TRUE" /end COMPU_VTAB
/begin COMPU_VTAB Def_bit_ub_3_VTAB "Def_bit_ub_3_VTAB" TAB_VERB 2 0 "FALSE" 1 "TRUE" DEFAULT_VALUE "TRUE" /end COMPU_VTAB
/begin COMPU_VTAB Def_bit_ub_2_VTAB "Def_bit_ub_2_VTAB" TAB_VERB 2 0 "FALSE" 1 "TRUE" DEFAULT_VALUE "TRUE" /end COMPU_VTAB
/begin COMPU_VTAB Def_bit_ub_0_VTAB "Def_bit_ub_0_VTAB" TAB_VERB 2 0 "FALSE" 1 "TRUE" DEFAULT_VALUE "TRUE" /end COMPU_VTAB
/begin COMPU_VTAB Def_bit_ub_0_VTAB "Def_bit_ub_0_VTAB" TAB_VERB 2 0 "FALSE" 1 "TRUE" DEFAULT_VALUE "TRUE" /end COMPU_VTAB
/begin COMPU_VTAB Def_bit_ub_1_VTAB "Def_bit_ub_1_VTAB" TAB_VERB 2 0 "FALSE" 1 "TRUE" DEFAULT_VALUE "TRUE" /end COMPU_VTAB
/begin COMPU_VTAB Def_bit_ub_2_VTAB "Def_bit_ub_2_VTAB" TAB_VERB 2 0 "FALSE" 1 "TRUE" DEFAULT_VALUE "TRUE" /end COMPU_VTAB
/begin COMPU_VTAB Def_bit_uw_0_VTAB "Def_bit_uw_0_VTAB" TAB_VERB 2 0 "FALSE" 1 "TRUE" DEFAULT_VALUE "TRUE" /end COMPU_VTAB
/begin COMPU_VTAB Def_bit_uw_1_VTAB "Def_bit_uw_1_VTAB" TAB_VERB 2 0 "FALSE" 1 "TRUE" DEFAULT_VALUE "TRUE" /end COMPU_VTAB
/begin COMPU_VTAB Def_bit_uw_2_VTAB "Def_bit_uw_2_VTAB" TAB_VERB 2 0 "FALSE" 1 "TRUE" DEFAULT_VALUE "TRUE" /end COMPU_VTAB
/begin COMPU_VTAB Def_bit_uw_3_VTAB "Def_bit_uw_3_VTAB" TAB_VERB 2 0 "FALSE" 1 "TRUE" DEFAULT_VALUE "TRUE" /end COMPU_VTAB
/begin COMPU_VTAB Def_bit_uw_4_VTAB "Def_bit_uw_4_VTAB" TAB_VERB 2 0 "FALSE" 1 "TRUE" DEFAULT_VALUE "TRUE" /end COMPU_VTAB
/begin COMPU_VTAB Def_bit_uw_5_VTAB "Def_bit_uw_5_VTAB" TAB_VERB 2 0 "FALSE" 1 "TRUE" DEFAULT_VALUE "TRUE" /end COMPU_VTAB
/begin COMPU_VTAB Def_bit_uw_6_VTAB "Def_bit_uw_6_VTAB" TAB_VERB 2 0 "FALSE" 1 "TRUE" DEFAULT_VALUE "TRUE" /end COMPU_VTAB
/begin COMPU_VTAB Def_bit_uw_7_VTAB "Def_bit_uw_7_VTAB" TAB_VERB 2 0 "FALSE" 1 "TRUE" DEFAULT_VALUE "TRUE" /end COMPU_VTAB
/begin COMPU_VTAB Def_bit_uw_8_VTAB "Def_bit_uw_8_VTAB" TAB_VERB 2 0 "FALSE" 1 "TRUE" DEFAULT_VALUE "TRUE" /end COMPU_VTAB
/begin COMPU_VTAB Def_bit_ub_0_VTAB "Def_bit_ub_0_VTAB" TAB_VERB 2 0 "FALSE" 1 "TRUE" DEFAULT_VALUE "TRUE" /end COMPU_VTAB
/begin COMPU_VTAB Def_bit_ub_0_VTAB "Def_bit_ub_0_VTAB" TAB_VERB 2 0 "FALSE" 1 "TRUE" DEFAULT_VALUE "TRUE" /end COMPU_VTAB
/begin COMPU_VTAB Def_bit_ub_1_VTAB "Def_bit_ub_1_VTAB" TAB_VERB 2 0 "FALSE" 1 "TRUE" DEFAULT_VALUE "TRUE" /end COMPU_VTAB
/begin COMPU_VTAB Def_bit_ub_2_VTAB "Def_bit_ub_2_VTAB" TAB_VERB 2 0 "FALSE" 1 "TRUE" DEFAULT_VALUE "TRUE" /end COMPU_VTAB
/begin COMPU_VTAB Def_bit_ub_3_VTAB "Def_bit_ub_3_VTAB" TAB_VERB 2 0 "FALSE" 1 "TRUE" DEFAULT_VALUE "TRUE" /end COMPU_VTAB
/begin COMPU_VTAB Def_bit_ub_4_VTAB "Def_bit_ub_4_VTAB" TAB_VERB 2 0 "FALSE" 1 "TRUE" DEFAULT_VALUE "TRUE" /end COMPU_VTAB
/begin COMPU_VTAB Def_bit_ub_5_VTAB "Def_bit_ub_5_VTAB" TAB_VERB 2 0 "FALSE" 1 "TRUE" DEFAULT_VALUE "TRUE" /end COMPU_VTAB
/begin COMPU_VTAB Def_bit_ub_6_VTAB "Def_bit_ub_6_VTAB" TAB_VERB 2 0 "FALSE" 1 "TRUE" DEFAULT_VALUE "TRUE" /end COMPU_VTAB
/begin COMPU_VTAB Def_bit_ub_7_VTAB "Def_bit_ub_7_VTAB" TAB_VERB 2 0 "FALSE" 1 "TRUE" DEFAULT_VALUE "TRUE" /end COMPU_VTAB
/begin COMPU_VTAB Def_bit_ub_0_VTAB "Def_bit_ub_0_VTAB" TAB_VERB 2 0 "FALSE" 1 "TRUE" DEFAULT_VALUE "TRUE" /end COMPU_VTAB
/begin COMPU_VTAB Def_bit_ub_1_VTAB "Def_bit_ub_1_VTAB" TAB_VERB 2 0 "FALSE" 1 "TRUE" DEFAULT_VALUE "TRUE" /end COMPU_VTAB
/begin COMPU_VTAB Def_bit_ub_2_VTAB "Def_bit_ub_2_VTAB" TAB_VERB 2 0 "FALSE" 1 "TRUE" DEFAULT_VALUE "TRUE" /end COMPU_VTAB
/begin COMPU_VTAB Def_bit_ub_3_VTAB "Def_bit_ub_3_VTAB" TAB_VERB 2 0 "FALSE" 1 "TRUE" DEFAULT_VALUE "TRUE" /end COMPU_VTAB
/begin COMPU_VTAB Def_bit_ub_4_VTAB "Def_bit_ub_4_VTAB" TAB_VERB 2 0 "FALSE" 1 "TRUE" DEFAULT_VALUE "TRUE" /end COMPU_VTAB
/begin COMPU_VTAB Def_bit_ub_5_VTAB "Def_bit_ub_5_VTAB" TAB_VERB 2 0 "FALSE" 1 "TRUE" DEFAULT_VALUE "TRUE" /end COMPU_VTAB
/begin COMPU_VTAB Def_bit_ub_6_VTAB "Def_bit_ub_6_VTAB" TAB_VERB 2 0 "FALSE" 1 "TRUE" DEFAULT_VALUE "TRUE" /end COMPU_VTAB
/begin COMPU_VTAB Def_bit_ub_7_VTAB "Def_bit_ub_7_VTAB" TAB_VERB 2 0 "FALSE" 1 "TRUE" DEFAULT_VALUE "TRUE" /end COMPU_VTAB
/begin COMPU_VTAB Def_bit_ub_0_VTAB "Def_bit_ub_0_VTAB" TAB_VERB 2 0 "FALSE" 1 "TRUE" DEFAULT_VALUE "TRUE" /end COMPU_VTAB
/begin COMPU_VTAB Def_bit_ub_1_VTAB "Def_bit_ub_1_VTAB" TAB_VERB 2 0 "FALSE" 1 "TRUE" DEFAULT_VALUE "TRUE" /end COMPU_VTAB
/begin COMPU_VTAB Def_bit_ub_2_VTAB "Def_bit_ub_2_VTAB" TAB_VERB 2 0 "FALSE" 1 "TRUE" DEFAULT_VALUE "TRUE" /end COMPU_VTAB
/begin COMPU_VTAB Def_bit_ub_3_VTAB "Def_bit_ub_3_VTAB" TAB_VERB 2 0 "FALSE" 1 "TRUE" DEFAULT_VALUE "TRUE" /end COMPU_VTAB
/begin COMPU_VTAB Def_bit_ub_4_VTAB "Def_bit_ub_4_VTAB" TAB_VERB 2 0 "FALSE" 1 "TRUE" DEFAULT_VALUE "TRUE" /end COMPU_VTAB
/begin COMPU_VTAB Def_bit_ub_5_VTAB "Def_bit_ub_5_VTAB" TAB_VERB 2 0 "FALSE" 1 "TRUE" DEFAULT_VALUE "TRUE" /end COMPU_VTAB
/begin COMPU_VTAB Def_bit_ub_6_VTAB "Def_bit_ub_6_VTAB" TAB_VERB 2 0 "FALSE" 1 "TRUE" DEFAULT_VALUE "TRUE" /end COMPU_VTAB
/begin COMPU_VTAB Def_bit_ub_7_VTAB "Def_bit_ub_7_VTAB" TAB_VERB 2 0 "FALSE" 1 "TRUE" DEFAULT_VALUE "TRUE" /end COMPU_VTAB
/begin COMPU_VTAB Def_bit_ub_0_VTAB "Def_bit_ub_0_VTAB" TAB_VERB 2 0 "FALSE" 1 "TRUE" DEFAULT_VALUE "TRUE" /end COMPU_VTAB
/begin COMPU_VTAB Def_bit_ub_1_VTAB "Def_bit_ub_1_VTAB" TAB_VERB 2 0 "FALSE" 1 "TRUE" DEFAULT_VALUE "TRUE" /end COMPU_VTAB
/begin COMPU_VTAB Def_bit_ub_2_VTAB "Def_bit_ub_2_VTAB" TAB_VERB 2 0 "FALSE" 1 "TRUE" DEFAULT_VALUE "TRUE" /end COMPU_VTAB
/begin COMPU_VTAB Def_bit_ub_3_VTAB "Def_bit_ub_3_VTAB" TAB_VERB 2 0 "FALSE" 1 "TRUE" DEFAULT_VALUE "TRUE" /end COMPU_VTAB
/begin COMPU_VTAB Def_bit_ub_4_VTAB "Def_bit_ub_4_VTAB" TAB_VERB 2 0 "FALSE" 1 "TRUE" DEFAULT_VALUE "TRUE" /end COMPU_VTAB
/begin COMPU_VTAB Def_bit_ub_5_VTAB "Def_bit_ub_5_VTAB" TAB_VERB 2 0 "FALSE" 1 "TRUE" DEFAULT_VALUE "TRUE" /end COMPU_VTAB
/begin COMPU_VTAB Def_bit_ub_0_VTAB "Def_bit_ub_0_VTAB" TAB_VERB 2 0 "FALSE" 1 "TRUE" DEFAULT_VALUE "TRUE" /end COMPU_VTAB
/begin COMPU_VTAB Def_bit_ub_1_VTAB "Def_bit_ub_1_VTAB" TAB_VERB 2 0 "FALSE" 1 "TRUE" DEFAULT_VALUE "TRUE" /end COMPU_VTAB
/begin COMPU_VTAB Def_bit_ub_2_VTAB "Def_bit_ub_2_VTAB" TAB_VERB 2 0 "FALSE" 1 "TRUE" DEFAULT_VALUE "TRUE" /end COMPU_VTAB
/begin COMPU_VTAB Def_bit_ub_3_VTAB "Def_bit_ub_3_VTAB" TAB_VERB 2 0 "FALSE" 1 "TRUE" DEFAULT_VALUE "TRUE" /end COMPU_VTAB
/begin COMPU_VTAB Def_bit_ub_0_VTAB "Def_bit_ub_0_VTAB" TAB_VERB 2 0 "FALSE" 1 "TRUE" DEFAULT_VALUE "TRUE" /end COMPU_VTAB
/begin COMPU_VTAB Def_bit_ub_1_VTAB "Def_bit_ub_1_VTAB" TAB_VERB 2 0 "FALSE" 1 "TRUE" DEFAULT_VALUE "TRUE" /end COMPU_VTAB
/begin COMPU_VTAB Def_bit_ub_2_VTAB "Def_bit_ub_2_VTAB" TAB_VERB 2 0 "FALSE" 1 "TRUE" DEFAULT_VALUE "TRUE" /end COMPU_VTAB
/begin COMPU_VTAB Def_bit_ub_3_VTAB "Def_bit_ub_3_VTAB" TAB_VERB 2 0 "FALSE" 1 "TRUE" DEFAULT_VALUE "TRUE" /end COMPU_VTAB
/begin COMPU_VTAB Def_bit_ub_4_VTAB "Def_bit_ub_4_VTAB" TAB_VERB 2 0 "FALSE" 1 "TRUE" DEFAULT_VALUE "TRUE" /end COMPU_VTAB
/begin COMPU_VTAB Def_bit_ub_0_VTAB "Def_bit_ub_0_VTAB" TAB_VERB 2 0 "FALSE" 1 "TRUE" DEFAULT_VALUE "TRUE" /end COMPU_VTAB
/begin COMPU_VTAB Def_bit_ub_1_VTAB "Def_bit_ub_1_VTAB" TAB_VERB 2 0 "FALSE" 1 "TRUE" DEFAULT_VALUE "TRUE" /end COMPU_VTAB
/begin COMPU_VTAB Def_bit_ub_2_VTAB "Def_bit_ub_2_VTAB" TAB_VERB 2 0 "FALSE" 1 "TRUE" DEFAULT_VALUE "TRUE" /end COMPU_VTAB
/begin COMPU_VTAB Def_bit_ub_3_VTAB "Def_bit_ub_3_VTAB" TAB_VERB 2 0 "FALSE" 1 "TRUE" DEFAULT_VALUE "TRUE" /end COMPU_VTAB
/begin COMPU_VTAB Def_bit_ub_4_VTAB "Def_bit_ub_4_VTAB" TAB_VERB 2 0 "FALSE" 1 "TRUE" DEFAULT_VALUE "TRUE" /end COMPU_VTAB
/begin COMPU_VTAB Def_bit_ub_5_VTAB "Def_bit_ub_5_VTAB" TAB_VERB 2 0 "FALSE" 1 "TRUE" DEFAULT_VALUE "TRUE" /end COMPU_VTAB
/begin COMPU_VTAB Def_bit_ub_0_VTAB "Def_bit_ub_0_VTAB" TAB_VERB 2 0 "FALSE" 1 "TRUE" DEFAULT_VALUE "TRUE" /end COMPU_VTAB
/begin COMPU_VTAB Def_bit_ub_1_VTAB "Def_bit_ub_1_VTAB" TAB_VERB 2 0 "FALSE" 1 "TRUE" DEFAULT_VALUE "TRUE" /end COMPU_VTAB
/begin COMPU_VTAB Def_bit_ub_2_VTAB "Def_bit_ub_2_VTAB" TAB_VERB 2 0 "FALSE" 1 "TRUE" DEFAULT_VALUE "TRUE" /end COMPU_VTAB
/begin COMPU_VTAB Def_bit_ub_4_VTAB "Def_bit_ub_4_VTAB" TAB_VERB 2 0 "FALSE" 1 "TRUE" DEFAULT_VALUE "TRUE" /end COMPU_VTAB
/begin COMPU_VTAB Def_bit_ub_5_VTAB "Def_bit_ub_5_VTAB" TAB_VERB 2 0 "FALSE" 1 "TRUE" DEFAULT_VALUE "TRUE" /end COMPU_VTAB
/begin COMPU_VTAB Def_bit_ub_6_VTAB "Def_bit_ub_6_VTAB" TAB_VERB 2 0 "FALSE" 1 "TRUE" DEFAULT_VALUE "TRUE" /end COMPU_VTAB
/begin COMPU_VTAB Def_bit_ub_7_VTAB "Def_bit_ub_7_VTAB" TAB_VERB 2 0 "FALSE" 1 "TRUE" DEFAULT_VALUE "TRUE" /end COMPU_VTAB
/begin COMPU_VTAB Def_bit_ub_3_VTAB "Def_bit_ub_3_VTAB" TAB_VERB 2 0 "FALSE" 1 "TRUE" DEFAULT_VALUE "TRUE" /end COMPU_VTAB
/begin COMPU_VTAB Def_bit_ub_0_VTAB "Def_bit_ub_0_VTAB" TAB_VERB 2 0 "FALSE" 1 "TRUE" DEFAULT_VALUE "TRUE" /end COMPU_VTAB
/begin COMPU_VTAB Def_bit_ub_1_VTAB "Def_bit_ub_1_VTAB" TAB_VERB 2 0 "FALSE" 1 "TRUE" DEFAULT_VALUE "TRUE" /end COMPU_VTAB
/begin COMPU_VTAB Def_bit_ub_2_VTAB "Def_bit_ub_2_VTAB" TAB_VERB 2 0 "FALSE" 1 "TRUE" DEFAULT_VALUE "TRUE" /end COMPU_VTAB
/begin COMPU_VTAB Def_bit_ub_3_VTAB "Def_bit_ub_3_VTAB" TAB_VERB 2 0 "FALSE" 1 "TRUE" DEFAULT_VALUE "TRUE" /end COMPU_VTAB
/begin COMPU_VTAB Def_bit_ub_0_VTAB "Def_bit_ub_0_VTAB" TAB_VERB 2 0 "FALSE" 1 "TRUE" DEFAULT_VALUE "TRUE" /end COMPU_VTAB
/begin COMPU_VTAB Def_bit_ub_1_VTAB "Def_bit_ub_1_VTAB" TAB_VERB 2 0 "FALSE" 1 "TRUE" DEFAULT_VALUE "TRUE" /end COMPU_VTAB
/begin COMPU_VTAB Def_bit_ub_2_VTAB "Def_bit_ub_2_VTAB" TAB_VERB 2 0 "FALSE" 1 "TRUE" DEFAULT_VALUE "TRUE" /end COMPU_VTAB
/begin COMPU_VTAB Def_bit_ub_3_VTAB "Def_bit_ub_3_VTAB" TAB_VERB 2 0 "FALSE" 1 "TRUE" DEFAULT_VALUE "TRUE" /end COMPU_VTAB
/begin COMPU_VTAB Def_bit_ub_4_VTAB "Def_bit_ub_4_VTAB" TAB_VERB 2 0 "FALSE" 1 "TRUE" DEFAULT_VALUE "TRUE" /end COMPU_VTAB
/begin COMPU_VTAB Def_bit_ub_5_VTAB "Def_bit_ub_5_VTAB" TAB_VERB 2 0 "FALSE" 1 "TRUE" DEFAULT_VALUE "TRUE" /end COMPU_VTAB
/begin COMPU_VTAB Def_bit_ub_0_VTAB "Def_bit_ub_0_VTAB" TAB_VERB 2 0 "FALSE" 1 "TRUE" DEFAULT_VALUE "TRUE" /end COMPU_VTAB
/begin COMPU_VTAB Def_bit_ub_1_VTAB "Def_bit_ub_1_VTAB" TAB_VERB 2 0 "FALSE" 1 "TRUE" DEFAULT_VALUE "TRUE" /end COMPU_VTAB
/begin COMPU_VTAB Def_bit_ub_2_VTAB "Def_bit_ub_2_VTAB" TAB_VERB 2 0 "FALSE" 1 "TRUE" DEFAULT_VALUE "TRUE" /end COMPU_VTAB
/begin COMPU_VTAB Def_bit_ub_3_VTAB "Def_bit_ub_3_VTAB" TAB_VERB 2 0 "FALSE" 1 "TRUE" DEFAULT_VALUE "TRUE" /end COMPU_VTAB
/begin COMPU_VTAB Def_bit_ub_4_VTAB "Def_bit_ub_4_VTAB" TAB_VERB 2 0 "FALSE" 1 "TRUE" DEFAULT_VALUE "TRUE" /end COMPU_VTAB
/begin COMPU_VTAB Def_bit_ub_5_VTAB "Def_bit_ub_5_VTAB" TAB_VERB 2 0 "FALSE" 1 "TRUE" DEFAULT_VALUE "TRUE" /end COMPU_VTAB
/begin COMPU_VTAB Def_bit_ub_6_VTAB "Def_bit_ub_6_VTAB" TAB_VERB 2 0 "FALSE" 1 "TRUE" DEFAULT_VALUE "TRUE" /end COMPU_VTAB
/begin COMPU_VTAB Def_bit_ub_7_VTAB "Def_bit_ub_7_VTAB" TAB_VERB 2 0 "FALSE" 1 "TRUE" DEFAULT_VALUE "TRUE" /end COMPU_VTAB
/begin COMPU_VTAB Def_bit_ub_0_VTAB "Def_bit_ub_0_VTAB" TAB_VERB 2 0 "FALSE" 1 "TRUE" DEFAULT_VALUE "TRUE" /end COMPU_VTAB
/begin COMPU_VTAB Def_bit_ub_1_VTAB "Def_bit_ub_1_VTAB" TAB_VERB 2 0 "FALSE" 1 "TRUE" DEFAULT_VALUE "TRUE" /end COMPU_VTAB
/begin COMPU_VTAB Def_bit_ub_2_VTAB "Def_bit_ub_2_VTAB" TAB_VERB 2 0 "FALSE" 1 "TRUE" DEFAULT_VALUE "TRUE" /end COMPU_VTAB
/begin COMPU_VTAB Def_bit_ub_3_VTAB "Def_bit_ub_3_VTAB" TAB_VERB 2 0 "FALSE" 1 "TRUE" DEFAULT_VALUE "TRUE" /end COMPU_VTAB
/begin COMPU_VTAB Def_bit_ub_4_VTAB "Def_bit_ub_4_VTAB" TAB_VERB 2 0 "FALSE" 1 "TRUE" DEFAULT_VALUE "TRUE" /end COMPU_VTAB
/begin COMPU_VTAB Def_bit_ub_5_VTAB "Def_bit_ub_5_VTAB" TAB_VERB 2 0 "FALSE" 1 "TRUE" DEFAULT_VALUE "TRUE" /end COMPU_VTAB
/begin COMPU_VTAB Def_bit_ub_6_VTAB "Def_bit_ub_6_VTAB" TAB_VERB 2 0 "FALSE" 1 "TRUE" DEFAULT_VALUE "TRUE" /end COMPU_VTAB
/begin COMPU_VTAB Def_bit_ub_0_VTAB "Def_bit_ub_0_VTAB" TAB_VERB 2 0 "FALSE" 1 "TRUE" DEFAULT_VALUE "TRUE" /end COMPU_VTAB
/begin COMPU_VTAB Def_bit_ub_0_VTAB "Def_bit_ub_0_VTAB" TAB_VERB 2 0 "FALSE" 1 "TRUE" DEFAULT_VALUE "TRUE" /end COMPU_VTAB
/begin COMPU_VTAB Def_bit_ub_1_VTAB "Def_bit_ub_1_VTAB" TAB_VERB 2 0 "FALSE" 1 "TRUE" DEFAULT_VALUE "TRUE" /end COMPU_VTAB
/begin COMPU_VTAB Def_bit_ub_2_VTAB "Def_bit_ub_2_VTAB" TAB_VERB 2 0 "FALSE" 1 "TRUE" DEFAULT_VALUE "TRUE" /end COMPU_VTAB
/begin COMPU_VTAB Def_bit_ub_3_VTAB "Def_bit_ub_3_VTAB" TAB_VERB 2 0 "FALSE" 1 "TRUE" DEFAULT_VALUE "TRUE" /end COMPU_VTAB
/begin COMPU_VTAB Def_bit_ub_4_VTAB "Def_bit_ub_4_VTAB" TAB_VERB 2 0 "FALSE" 1 "TRUE" DEFAULT_VALUE "TRUE" /end COMPU_VTAB
/begin COMPU_VTAB Def_bit_ub_5_VTAB "Def_bit_ub_5_VTAB" TAB_VERB 2 0 "FALSE" 1 "TRUE" DEFAULT_VALUE "TRUE" /end COMPU_VTAB
/begin COMPU_VTAB Def_bit_ub_6_VTAB "Def_bit_ub_6_VTAB" TAB_VERB 2 0 "FALSE" 1 "TRUE" DEFAULT_VALUE "TRUE" /end COMPU_VTAB
/begin COMPU_VTAB Def_bit_ub_7_VTAB "Def_bit_ub_7_VTAB" TAB_VERB 2 0 "FALSE" 1 "TRUE" DEFAULT_VALUE "TRUE" /end COMPU_VTAB
/begin COMPU_VTAB Def_bit_ub_1_VTAB "Def_bit_ub_1_VTAB" TAB_VERB 2 0 "FALSE" 1 "TRUE" DEFAULT_VALUE "TRUE" /end COMPU_VTAB
/begin COMPU_VTAB Def_bit_ub_2_VTAB "Def_bit_ub_2_VTAB" TAB_VERB 2 0 "FALSE" 1 "TRUE" DEFAULT_VALUE "TRUE" /end COMPU_VTAB
/begin COMPU_VTAB Def_bit_ub_0_VTAB "Def_bit_ub_0_VTAB" TAB_VERB 2 0 "FALSE" 1 "TRUE" DEFAULT_VALUE "TRUE" /end COMPU_VTAB
/begin COMPU_VTAB Def_bit_ub_0_VTAB "Def_bit_ub_0_VTAB" TAB_VERB 2 0 "FALSE" 1 "TRUE" DEFAULT_VALUE "TRUE" /end COMPU_VTAB
/begin COMPU_VTAB Def_bit_ub_1_VTAB "Def_bit_ub_1_VTAB" TAB_VERB 2 0 "FALSE" 1 "TRUE" DEFAULT_VALUE "TRUE" /end COMPU_VTAB
/begin COMPU_VTAB Def_bit_ub_2_VTAB "Def_bit_ub_2_VTAB" TAB_VERB 2 0 "FALSE" 1 "TRUE" DEFAULT_VALUE "TRUE" /end COMPU_VTAB
/begin COMPU_VTAB Def_bit_ub_3_VTAB "Def_bit_ub_3_VTAB" TAB_VERB 2 0 "FALSE" 1 "TRUE" DEFAULT_VALUE "TRUE" /end COMPU_VTAB
/begin COMPU_VTAB Def_bit_ub_4_VTAB "Def_bit_ub_4_VTAB" TAB_VERB 2 0 "FALSE" 1 "TRUE" DEFAULT_VALUE "TRUE" /end COMPU_VTAB
/begin COMPU_VTAB Def_bit_ub_5_VTAB "Def_bit_ub_5_VTAB" TAB_VERB 2 0 "FALSE" 1 "TRUE" DEFAULT_VALUE "TRUE" /end COMPU_VTAB
/begin COMPU_VTAB Def_bit_ub_0_VTAB "Def_bit_ub_0_VTAB" TAB_VERB 2 0 "FALSE" 1 "TRUE" DEFAULT_VALUE "TRUE" /end COMPU_VTAB
/begin COMPU_VTAB Def_bit_ub_1_VTAB "Def_bit_ub_1_VTAB" TAB_VERB 2 0 "FALSE" 1 "TRUE" DEFAULT_VALUE "TRUE" /end COMPU_VTAB
/begin COMPU_VTAB Def_bit_ub_2_VTAB "Def_bit_ub_2_VTAB" TAB_VERB 2 0 "FALSE" 1 "TRUE" DEFAULT_VALUE "TRUE" /end COMPU_VTAB
/begin COMPU_VTAB Def_bit_ub_3_VTAB "Def_bit_ub_3_VTAB" TAB_VERB 2 0 "FALSE" 1 "TRUE" DEFAULT_VALUE "TRUE" /end COMPU_VTAB
/begin COMPU_VTAB Def_bit_ub_0_VTAB "Def_bit_ub_0_VTAB" TAB_VERB 2 0 "FALSE" 1 "TRUE" DEFAULT_VALUE "TRUE" /end COMPU_VTAB
/begin COMPU_VTAB Def_bit_ub_1_VTAB "Def_bit_ub_1_VTAB" TAB_VERB 2 0 "FALSE" 1 "TRUE" DEFAULT_VALUE "TRUE" /end COMPU_VTAB
/begin COMPU_VTAB Def_bit_ub_2_VTAB "Def_bit_ub_2_VTAB" TAB_VERB 2 0 "FALSE" 1 "TRUE" DEFAULT_VALUE "TRUE" /end COMPU_VTAB
/begin COMPU_VTAB Def_bit_ub_3_VTAB "Def_bit_ub_3_VTAB" TAB_VERB 2 0 "FALSE" 1 "TRUE" DEFAULT_VALUE "TRUE" /end COMPU_VTAB
/begin COMPU_VTAB Def_bit_ub_4_VTAB "Def_bit_ub_4_VTAB" TAB_VERB 2 0 "FALSE" 1 "TRUE" DEFAULT_VALUE "TRUE" /end COMPU_VTAB
/begin COMPU_VTAB Def_bit_ub_0_VTAB "Def_bit_ub_0_VTAB" TAB_VERB 2 0 "FALSE" 1 "TRUE" DEFAULT_VALUE "TRUE" /end COMPU_VTAB
/begin COMPU_VTAB Def_bit_ub_1_VTAB "Def_bit_ub_1_VTAB" TAB_VERB 2 0 "FALSE" 1 "TRUE" DEFAULT_VALUE "TRUE" /end COMPU_VTAB
/begin COMPU_VTAB Def_bit_ub_3_VTAB "Def_bit_ub_3_VTAB" TAB_VERB 2 0 "FALSE" 1 "TRUE" DEFAULT_VALUE "TRUE" /end COMPU_VTAB
/begin COMPU_VTAB Def_bit_ub_4_VTAB "Def_bit_ub_4_VTAB" TAB_VERB 2 0 "FALSE" 1 "TRUE" DEFAULT_VALUE "TRUE" /end COMPU_VTAB
/begin COMPU_VTAB Def_bit_ub_0_VTAB "Def_bit_ub_0_VTAB" TAB_VERB 2 0 "FALSE" 1 "TRUE" DEFAULT_VALUE "TRUE" /end COMPU_VTAB
/begin COMPU_VTAB Def_bit_ub_0_VTAB "Def_bit_ub_0_VTAB" TAB_VERB 2 0 "FALSE" 1 "TRUE" DEFAULT_VALUE "TRUE" /end COMPU_VTAB
/begin COMPU_VTAB Def_bit_ub_1_VTAB "Def_bit_ub_1_VTAB" TAB_VERB 2 0 "FALSE" 1 "TRUE" DEFAULT_VALUE "TRUE" /end COMPU_VTAB
/begin COMPU_VTAB Def_bit_ub_2_VTAB "Def_bit_ub_2_VTAB" TAB_VERB 2 0 "FALSE" 1 "TRUE" DEFAULT_VALUE "TRUE" /end COMPU_VTAB
/begin COMPU_VTAB Def_bit_ub_3_VTAB "Def_bit_ub_3_VTAB" TAB_VERB 2 0 "FALSE" 1 "TRUE" DEFAULT_VALUE "TRUE" /end COMPU_VTAB
/begin COMPU_VTAB Def_bit_ub_4_VTAB "Def_bit_ub_4_VTAB" TAB_VERB 2 0 "FALSE" 1 "TRUE" DEFAULT_VALUE "TRUE" /end COMPU_VTAB
/begin COMPU_VTAB Def_bit_ub_5_VTAB "Def_bit_ub_5_VTAB" TAB_VERB 2 0 "FALSE" 1 "TRUE" DEFAULT_VALUE "TRUE" /end COMPU_VTAB
/begin COMPU_VTAB Def_bit_ub_0_VTAB "Def_bit_ub_0_VTAB" TAB_VERB 2 0 "FALSE" 1 "TRUE" DEFAULT_VALUE "TRUE" /end COMPU_VTAB
/begin COMPU_VTAB Def_bit_ub_0_VTAB "Def_bit_ub_0_VTAB" TAB_VERB 2 0 "FALSE" 1 "TRUE" DEFAULT_VALUE "TRUE" /end COMPU_VTAB
/begin COMPU_METHOD TrqInrKd_16 "" RAT_FUNC "%7.6" "%/Nm" COEFFS 0 40960 0 0 0 1 /end COMPU_METHOD
/begin COMPU_METHOD TrqInrKi "" RAT_FUNC "%7.6" "%/(Nm*s)" COEFFS 0 21474.83648 0 0 0 1 /end COMPU_METHOD
/begin RECORD_LAYOUT TKW_VV_VV_UW FNC_VALUES 1 UWORD COLUMN_DIR DIRECT /end RECORD_LAYOUT
/begin RECORD_LAYOUT TKW_VV_VV_SW FNC_VALUES 1 SWORD COLUMN_DIR DIRECT /end RECORD_LAYOUT
/begin RECORD_LAYOUT TKW_VV_VV_UB FNC_VALUES 1 UBYTE COLUMN_DIR DIRECT /end RECORD_LAYOUT
/begin RECORD_LAYOUT TKW_VV_VV_UW FNC_VALUES 1 UWORD COLUMN_DIR DIRECT /end RECORD_LAYOUT
/begin RECORD_LAYOUT TKW_VV_VV_SW FNC_VALUES 1 SWORD COLUMN_DIR DIRECT /end RECORD_LAYOUT
/begin RECORD_LAYOUT TKW_VV_VV_UB FNC_VALUES 1 UBYTE COLUMN_DIR DIRECT /end RECORD_LAYOUT
/begin RECORD_LAYOUT TKW_VV_VV_UW FNC_VALUES 1 UWORD COLUMN_DIR DIRECT /end RECORD_LAYOUT
/begin RECORD_LAYOUT TKW_VV_VV_SW FNC_VALUES 1 SWORD COLUMN_DIR DIRECT /end RECORD_LAYOUT
/begin RECORD_LAYOUT TKW_VV_VV_UB FNC_VALUES 1 UBYTE COLUMN_DIR DIRECT /end RECORD_LAYOUT
/begin RECORD_LAYOUT TKW_VV_VV_UW FNC_VALUES 1 UWORD COLUMN_DIR DIRECT /end RECORD_LAYOUT
/begin RECORD_LAYOUT TKW_VV_VV_SW FNC_VALUES 1 SWORD COLUMN_DIR DIRECT /end RECORD_LAYOUT
/begin RECORD_LAYOUT TKW_VV_VV_UB FNC_VALUES 1 UBYTE COLUMN_DIR DIRECT /end RECORD_LAYOUT
/begin RECORD_LAYOUT TKW_VV_VV_UB FNC_VALUES 1 UBYTE COLUMN_DIR DIRECT /end RECORD_LAYOUT
/begin RECORD_LAYOUT TKW_VV_VV_UW FNC_VALUES 1 UWORD COLUMN_DIR DIRECT /end RECORD_LAYOUT
/begin RECORD_LAYOUT TKW_VV_VV_UW FNC_VALUES 1 UWORD COLUMN_DIR DIRECT /end RECORD_LAYOUT
/begin RECORD_LAYOUT TKW_VV_VV_SW FNC_VALUES 1 SWORD COLUMN_DIR DIRECT /end RECORD_LAYOUT
/begin RECORD_LAYOUT TKL_UW_VV_UB NO_AXIS_PTS_X 1 UBYTE RESERVED 2 BYTE AXIS_PTS_X 3 UWORD INDEX_INCR DIRECT FNC_VALUES 4 UBYTE COLUMN_DIR DIRECT /end RECORD_LAYOUT
/begin RECORD_LAYOUT TKL_UW_VV_UW NO_AXIS_PTS_X 1 UBYTE RESERVED 2 BYTE AXIS_PTS_X 3 UWORD INDEX_INCR DIRECT FNC_VALUES 4 UWORD COLUMN_DIR DIRECT /end RECORD_LAYOUT
/begin RECORD_LAYOUT TKL_SW_VV_UW NO_AXIS_PTS_X 1 UBYTE RESERVED 2 BYTE AXIS_PTS_X 3 SWORD INDEX_INCR DIRECT FNC_VALUES 4 UWORD COLUMN_DIR DIRECT /end RECORD_LAYOUT
/begin RECORD_LAYOUT TKF_UW_UB_UW NO_AXIS_PTS_X 1 UBYTE NO_AXIS_PTS_Y 2 UBYTE AXIS_PTS_X 3 UBYTE INDEX_INCR DIRECT AXIS_PTS_Y 4 UWORD INDEX_INCR DIRECT FNC_VALUES 5 UWORD COLUMN_DIR DIRECT /end RECORD_LAYOUT
/begin RECORD_LAYOUT TKW_VV_VV_UB FNC_VALUES 1 UBYTE COLUMN_DIR DIRECT /end RECORD_LAYOUT
/begin RECORD_LAYOUT TKW_VV_VV_UB FNC_VALUES 1 UBYTE COLUMN_DIR DIRECT /end RECORD_LAYOUT
/begin RECORD_LAYOUT TKW_VV_VV_UW FNC_VALUES 1 UWORD COLUMN_DIR DIRECT /end RECORD_LAYOUT
/begin RECORD_LAYOUT TKW_VV_VV_SW FNC_VALUES 1 SWORD COLUMN_DIR DIRECT /end RECORD_LAYOUT
/begin RECORD_LAYOUT TKL_UW_VV_UB NO_AXIS_PTS_X 1 UBYTE RESERVED 2 BYTE AXIS_PTS_X 3 UWORD INDEX_INCR DIRECT FNC_VALUES 4 UBYTE COLUMN_DIR DIRECT /end RECORD_LAYOUT
/begin RECORD_LAYOUT TKF_SW_SW_SW NO_AXIS_PTS_X 1 UBYTE NO_AXIS_PTS_Y 2 UBYTE AXIS_PTS_X 3 SWORD INDEX_INCR DIRECT AXIS_PTS_Y 4 SWORD INDEX_INCR DIRECT FNC_VALUES 5 SWORD COLUMN_DIR DIRECT /end RECORD_LAYOUT
/begin RECORD_LAYOUT TKW_VV_VV_UB FNC_VALUES 1 UBYTE COLUMN_DIR DIRECT /end RECORD_LAYOUT
/begin RECORD_LAYOUT TKW_VV_VV_UW FNC_VALUES 1 UWORD COLUMN_DIR DIRECT /end RECORD_LAYOUT
/begin RECORD_LAYOUT TKW_VV_VV_SW FNC_VALUES 1 SWORD COLUMN_DIR DIRECT /end RECORD_LAYOUT
/begin RECORD_LAYOUT TKW_VV_VV_UB FNC_VALUES 1 UBYTE COLUMN_DIR DIRECT /end RECORD_LAYOUT
/begin RECORD_LAYOUT TKW_VV_VV_UW FNC_VALUES 1 UWORD COLUMN_DIR DIRECT /end RECORD_LAYOUT
/begin RECORD_LAYOUT TKW_VV_VV_SW FNC_VALUES 1 SWORD COLUMN_DIR DIRECT /end RECORD_LAYOUT
/begin RECORD_LAYOUT TKW_VV_VV_UB FNC_VALUES 1 UBYTE COLUMN_DIR DIRECT /end RECORD_LAYOUT
/begin RECORD_LAYOUT TKW_VV_VV_UB FNC_VALUES 1 UBYTE COLUMN_DIR DIRECT /end RECORD_LAYOUT
/begin RECORD_LAYOUT TKW_VV_VV_UW FNC_VALUES 1 UWORD COLUMN_DIR DIRECT /end RECORD_LAYOUT
/begin RECORD_LAYOUT TKW_VV_VV_SW FNC_VALUES 1 SWORD COLUMN_DIR DIRECT /end RECORD_LAYOUT
/begin RECORD_LAYOUT TKW_VV_VV_UB FNC_VALUES 1 UBYTE COLUMN_DIR DIRECT /end RECORD_LAYOUT
/begin RECORD_LAYOUT TKW_VV_VV_UW FNC_VALUES 1 UWORD COLUMN_DIR DIRECT /end RECORD_LAYOUT
/begin RECORD_LAYOUT TKW_VV_VV_SW FNC_VALUES 1 SWORD COLUMN_DIR DIRECT /end RECORD_LAYOUT
/begin RECORD_LAYOUT TKL_SW_VV_UW NO_AXIS_PTS_X 1 UBYTE RESERVED 2 BYTE AXIS_PTS_X 3 SWORD INDEX_INCR DIRECT FNC_VALUES 4 UWORD COLUMN_DIR DIRECT /end RECORD_LAYOUT
/begin RECORD_LAYOUT TKW_VV_VV_UB FNC_VALUES 1 UBYTE COLUMN_DIR DIRECT /end RECORD_LAYOUT
/begin RECORD_LAYOUT TKW_VV_VV_UW FNC_VALUES 1 UWORD COLUMN_DIR DIRECT /end RECORD_LAYOUT
/begin RECORD_LAYOUT TKW_VV_VV_SW FNC_VALUES 1 SWORD COLUMN_DIR DIRECT /end RECORD_LAYOUT
/begin RECORD_LAYOUT TKL_UW_VV_UW NO_AXIS_PTS_X 1 UBYTE RESERVED 2 BYTE AXIS_PTS_X 3 UWORD INDEX_INCR DIRECT FNC_VALUES 4 UWORD COLUMN_DIR DIRECT /end RECORD_LAYOUT
/begin RECORD_LAYOUT TKW_VV_VV_UB FNC_VALUES 1 UBYTE COLUMN_DIR DIRECT /end RECORD_LAYOUT
/begin RECORD_LAYOUT TKW_VV_VV_UB FNC_VALUES 1 UBYTE COLUMN_DIR DIRECT /end RECORD_LAYOUT
/begin RECORD_LAYOUT TKW_VV_VV_UW FNC_VALUES 1 UWORD COLUMN_DIR DIRECT /end RECORD_LAYOUT
/begin RECORD_LAYOUT TKW_VV_VV_SW FNC_VALUES 1 SWORD COLUMN_DIR DIRECT /end RECORD_LAYOUT
/begin RECORD_LAYOUT TKW_VV_VV_UB FNC_VALUES 1 UBYTE COLUMN_DIR DIRECT /end RECORD_LAYOUT
/begin RECORD_LAYOUT TKW_VV_VV_UB FNC_VALUES 1 UBYTE COLUMN_DIR DIRECT /end RECORD_LAYOUT
/begin RECORD_LAYOUT TKW_VV_VV_UW FNC_VALUES 1 UWORD COLUMN_DIR DIRECT /end RECORD_LAYOUT
/begin RECORD_LAYOUT TKW_VV_VV_UB FNC_VALUES 1 UBYTE COLUMN_DIR DIRECT /end RECORD_LAYOUT
/begin RECORD_LAYOUT TKW_VV_VV_UW FNC_VALUES 1 UWORD COLUMN_DIR DIRECT /end RECORD_LAYOUT
/begin RECORD_LAYOUT TKW_VV_VV_SW FNC_VALUES 1 SWORD COLUMN_DIR DIRECT /end RECORD_LAYOUT
/begin RECORD_LAYOUT TKF_SW_SW_SW NO_AXIS_PTS_X 1 UBYTE NO_AXIS_PTS_Y 2 UBYTE AXIS_PTS_X 3 SWORD INDEX_INCR DIRECT AXIS_PTS_Y 4 SWORD INDEX_INCR DIRECT FNC_VALUES 5 SWORD COLUMN_DIR DIRECT /end RECORD_LAYOUT
/begin RECORD_LAYOUT TKW_VV_VV_UB FNC_VALUES 1 UBYTE COLUMN_DIR DIRECT /end RECORD_LAYOUT
/begin RECORD_LAYOUT TKW_VV_VV_UW FNC_VALUES 1 UWORD COLUMN_DIR DIRECT /end RECORD_LAYOUT
/begin RECORD_LAYOUT TKW_VV_VV_SW FNC_VALUES 1 SWORD COLUMN_DIR DIRECT /end RECORD_LAYOUT
/begin RECORD_LAYOUT TKW_VV_VV_UB FNC_VALUES 1 UBYTE COLUMN_DIR DIRECT /end RECORD_LAYOUT
/begin RECORD_LAYOUT TKW_VV_VV_UB FNC_VALUES 1 UBYTE COLUMN_DIR DIRECT /end RECORD_LAYOUT
/begin RECORD_LAYOUT TKW_VV_VV_UW FNC_VALUES 1 UWORD COLUMN_DIR DIRECT /end RECORD_LAYOUT
/begin RECORD_LAYOUT TKW_VV_VV_SW FNC_VALUES 1 SWORD COLUMN_DIR DIRECT /end RECORD_LAYOUT
/begin RECORD_LAYOUT TKW_VV_VV_UB FNC_VALUES 1 UBYTE COLUMN_DIR DIRECT /end RECORD_LAYOUT
/begin RECORD_LAYOUT TKW_VV_VV_SW FNC_VALUES 1 SWORD COLUMN_DIR DIRECT /end RECORD_LAYOUT
/begin RECORD_LAYOUT TKW_VV_VV_UB FNC_VALUES 1 UBYTE COLUMN_DIR DIRECT /end RECORD_LAYOUT
/begin RECORD_LAYOUT TKW_VV_VV_UW FNC_VALUES 1 UWORD COLUMN_DIR DIRECT /end RECORD_LAYOUT
/begin RECORD_LAYOUT TKW_VV_VV_SW FNC_VALUES 1 SWORD COLUMN_DIR DIRECT /end RECORD_LAYOUT
/begin RECORD_LAYOUT TKF_SW_SW_SW NO_AXIS_PTS_X 1 UBYTE NO_AXIS_PTS_Y 2 UBYTE AXIS_PTS_X 3 SWORD INDEX_INCR DIRECT AXIS_PTS_Y 4 SWORD INDEX_INCR DIRECT FNC_VALUES 5 SWORD COLUMN_DIR DIRECT /end RECORD_LAYOUT
/begin RECORD_LAYOUT TKW_VV_VV_UB FNC_VALUES 1 UBYTE COLUMN_DIR DIRECT /end RECORD_LAYOUT
/begin RECORD_LAYOUT TKW_VV_VV_SW FNC_VALUES 1 SWORD COLUMN_DIR DIRECT /end RECORD_LAYOUT
/begin RECORD_LAYOUT TKW_VV_VV_UB FNC_VALUES 1 UBYTE COLUMN_DIR DIRECT /end RECORD_LAYOUT
/begin RECORD_LAYOUT TKW_VV_VV_UW FNC_VALUES 1 UWORD COLUMN_DIR DIRECT /end RECORD_LAYOUT
/begin RECORD_LAYOUT TKW_VV_VV_UB FNC_VALUES 1 UBYTE COLUMN_DIR DIRECT /end RECORD_LAYOUT
/begin RECORD_LAYOUT TKW_VV_VV_UW FNC_VALUES 1 UWORD COLUMN_DIR DIRECT /end RECORD_LAYOUT
/begin RECORD_LAYOUT TKW_VV_VV_UB FNC_VALUES 1 UBYTE COLUMN_DIR DIRECT /end RECORD_LAYOUT
/begin RECORD_LAYOUT TKW_VV_VV_SW FNC_VALUES 1 SWORD COLUMN_DIR DIRECT /end RECORD_LAYOUT
/begin RECORD_LAYOUT TKW_VV_VV_UB FNC_VALUES 1 UBYTE COLUMN_DIR DIRECT /end RECORD_LAYOUT
/begin RECORD_LAYOUT TKW_VV_VV_SW FNC_VALUES 1 SWORD COLUMN_DIR DIRECT /end RECORD_LAYOUT
/begin RECORD_LAYOUT TKW_VV_VV_UB FNC_VALUES 1 UBYTE COLUMN_DIR DIRECT /end RECORD_LAYOUT
/begin RECORD_LAYOUT TKW_VV_VV_UW FNC_VALUES 1 UWORD COLUMN_DIR DIRECT /end RECORD_LAYOUT
/begin RECORD_LAYOUT TKW_VV_VV_SW FNC_VALUES 1 SWORD COLUMN_DIR DIRECT /end RECORD_LAYOUT
/begin RECORD_LAYOUT TKL_UW_VV_UW NO_AXIS_PTS_X 1 UBYTE RESERVED 2 BYTE AXIS_PTS_X 3 UWORD INDEX_INCR DIRECT FNC_VALUES 4 UWORD COLUMN_DIR DIRECT /end RECORD_LAYOUT
/begin RECORD_LAYOUT TKW_VV_VV_UW FNC_VALUES 1 UWORD COLUMN_DIR DIRECT /end RECORD_LAYOUT
/begin RECORD_LAYOUT TKW_VV_VV_SW FNC_VALUES 1 SWORD COLUMN_DIR DIRECT /end RECORD_LAYOUT
/begin RECORD_LAYOUT TKL_SW_VV_UW NO_AXIS_PTS_X 1 UBYTE RESERVED 2 BYTE AXIS_PTS_X 3 SWORD INDEX_INCR DIRECT FNC_VALUES 4 UWORD COLUMN_DIR DIRECT /end RECORD_LAYOUT
/begin RECORD_LAYOUT TKF_SW_SW_SW NO_AXIS_PTS_X 1 UBYTE NO_AXIS_PTS_Y 2 UBYTE AXIS_PTS_X 3 SWORD INDEX_INCR DIRECT AXIS_PTS_Y 4 SWORD INDEX_INCR DIRECT FNC_VALUES 5 SWORD COLUMN_DIR DIRECT /end RECORD_LAYOUT
/begin RECORD_LAYOUT TKW_VV_VV_UB FNC_VALUES 1 UBYTE COLUMN_DIR DIRECT /end RECORD_LAYOUT
/begin RECORD_LAYOUT TKW_VV_VV_UW FNC_VALUES 1 UWORD COLUMN_DIR DIRECT /end RECORD_LAYOUT
/begin RECORD_LAYOUT TKW_VV_VV_UB FNC_VALUES 1 UBYTE COLUMN_DIR DIRECT /end RECORD_LAYOUT
/begin RECORD_LAYOUT TKW_VV_VV_UW FNC_VALUES 1 UWORD COLUMN_DIR DIRECT /end RECORD_LAYOUT
/begin RECORD_LAYOUT TKL_UW_VV_UW NO_AXIS_PTS_X 1 UBYTE RESERVED 2 BYTE AXIS_PTS_X 3 UWORD INDEX_INCR DIRECT FNC_VALUES 4 UWORD COLUMN_DIR DIRECT /end RECORD_LAYOUT
/begin RECORD_LAYOUT TKW_VV_VV_UB FNC_VALUES 1 UBYTE COLUMN_DIR DIRECT /end RECORD_LAYOUT
/begin RECORD_LAYOUT TKW_VV_VV_UW FNC_VALUES 1 UWORD COLUMN_DIR DIRECT /end RECORD_LAYOUT
/begin RECORD_LAYOUT TKW_VV_VV_SW FNC_VALUES 1 SWORD COLUMN_DIR DIRECT /end RECORD_LAYOUT
/begin RECORD_LAYOUT TKL_UW_VV_UB NO_AXIS_PTS_X 1 UBYTE RESERVED 2 BYTE AXIS_PTS_X 3 UWORD INDEX_INCR DIRECT FNC_VALUES 4 UBYTE COLUMN_DIR DIRECT /end RECORD_LAYOUT
/begin RECORD_LAYOUT TKW_VV_VV_UB FNC_VALUES 1 UBYTE COLUMN_DIR DIRECT /end RECORD_LAYOUT
/begin RECORD_LAYOUT TKW_VV_VV_UW FNC_VALUES 1 UWORD COLUMN_DIR DIRECT /end RECORD_LAYOUT
/begin RECORD_LAYOUT TKW_VV_VV_SW FNC_VALUES 1 SWORD COLUMN_DIR DIRECT /end RECORD_LAYOUT
/begin RECORD_LAYOUT TKW_VV_VV_UB FNC_VALUES 1 UBYTE COLUMN_DIR DIRECT /end RECORD_LAYOUT
/begin RECORD_LAYOUT TKW_VV_VV_UW FNC_VALUES 1 UWORD COLUMN_DIR DIRECT /end RECORD_LAYOUT
/begin RECORD_LAYOUT TKW_VV_VV_SW FNC_VALUES 1 SWORD COLUMN_DIR DIRECT /end RECORD_LAYOUT
/begin RECORD_LAYOUT TKL_UW_VV_UW NO_AXIS_PTS_X 1 UBYTE RESERVED 2 BYTE AXIS_PTS_X 3 UWORD INDEX_INCR DIRECT FNC_VALUES 4 UWORD COLUMN_DIR DIRECT /end RECORD_LAYOUT
/begin RECORD_LAYOUT TKW_VV_VV_UW FNC_VALUES 1 UWORD COLUMN_DIR DIRECT /end RECORD_LAYOUT
/begin RECORD_LAYOUT TKF_SW_SW_SW NO_AXIS_PTS_X 1 UBYTE NO_AXIS_PTS_Y 2 UBYTE AXIS_PTS_X 3 SWORD INDEX_INCR DIRECT AXIS_PTS_Y 4 SWORD INDEX_INCR DIRECT FNC_VALUES 5 SWORD COLUMN_DIR DIRECT /end RECORD_LAYOUT
/begin RECORD_LAYOUT TKW_VV_VV_UB FNC_VALUES 1 UBYTE COLUMN_DIR DIRECT /end RECORD_LAYOUT
/begin RECORD_LAYOUT TKW_VV_VV_UW FNC_VALUES 1 UWORD COLUMN_DIR DIRECT /end RECORD_LAYOUT
/begin RECORD_LAYOUT TKW_VV_VV_SW FNC_VALUES 1 SWORD COLUMN_DIR DIRECT /end RECORD_LAYOUT
/begin RECORD_LAYOUT TKW_VV_VV_UB FNC_VALUES 1 UBYTE COLUMN_DIR DIRECT /end RECORD_LAYOUT
/begin RECORD_LAYOUT TKW_VV_VV_UW FNC_VALUES 1 UWORD COLUMN_DIR DIRECT /end RECORD_LAYOUT
/begin RECORD_LAYOUT TKW_VV_VV_SW FNC_VALUES 1 SWORD COLUMN_DIR DIRECT /end RECORD_LAYOUT
/begin RECORD_LAYOUT TKF_SW_SW_SW NO_AXIS_PTS_X 1 UBYTE NO_AXIS_PTS_Y 2 UBYTE AXIS_PTS_X 3 SWORD INDEX_INCR DIRECT AXIS_PTS_Y 4 SWORD INDEX_INCR DIRECT FNC_VALUES 5 SWORD COLUMN_DIR DIRECT /end RECORD_LAYOUT
/begin RECORD_LAYOUT TKW_VV_VV_UB FNC_VALUES 1 UBYTE COLUMN_DIR DIRECT /end RECORD_LAYOUT
/begin RECORD_LAYOUT TKW_VV_VV_UW FNC_VALUES 1 UWORD COLUMN_DIR DIRECT /end RECORD_LAYOUT
/begin RECORD_LAYOUT TKW_VV_VV_SW FNC_VALUES 1 SWORD COLUMN_DIR DIRECT /end RECORD_LAYOUT
/begin RECORD_LAYOUT TKL_UW_VV_UW NO_AXIS_PTS_X 1 UBYTE RESERVED 2 BYTE AXIS_PTS_X 3 UWORD INDEX_INCR DIRECT FNC_VALUES 4 UWORD COLUMN_DIR DIRECT /end RECORD_LAYOUT
/begin RECORD_LAYOUT TKW_VV_VV_UB FNC_VALUES 1 UBYTE COLUMN_DIR DIRECT /end RECORD_LAYOUT
/begin RECORD_LAYOUT TKW_VV_VV_UW FNC_VALUES 1 UWORD COLUMN_DIR DIRECT /end RECORD_LAYOUT
/begin RECORD_LAYOUT TKL_UW_VV_UB NO_AXIS_PTS_X 1 UBYTE RESERVED 2 BYTE AXIS_PTS_X 3 UWORD INDEX_INCR DIRECT FNC_VALUES 4 UBYTE COLUMN_DIR DIRECT /end RECORD_LAYOUT
/begin RECORD_LAYOUT TKW_VV_VV_UB FNC_VALUES 1 UBYTE COLUMN_DIR DIRECT /end RECORD_LAYOUT
/begin RECORD_LAYOUT TKW_VV_VV_UW FNC_VALUES 1 UWORD COLUMN_DIR DIRECT /end RECORD_LAYOUT
/begin RECORD_LAYOUT TKW_VV_VV_SW FNC_VALUES 1 SWORD COLUMN_DIR DIRECT /end RECORD_LAYOUT
/begin RECORD_LAYOUT TKW_VV_VV_UB FNC_VALUES 1 UBYTE COLUMN_DIR DIRECT /end RECORD_LAYOUT
/begin RECORD_LAYOUT TKW_VV_VV_UW FNC_VALUES 1 UWORD COLUMN_DIR DIRECT /end RECORD_LAYOUT
/begin RECORD_LAYOUT TKW_VV_VV_SW FNC_VALUES 1 SWORD COLUMN_DIR DIRECT /end RECORD_LAYOUT
/begin RECORD_LAYOUT TKL_UW_VV_UW NO_AXIS_PTS_X 1 UBYTE RESERVED 2 BYTE AXIS_PTS_X 3 UWORD INDEX_INCR DIRECT FNC_VALUES 4 UWORD COLUMN_DIR DIRECT /end RECORD_LAYOUT
/begin RECORD_LAYOUT TKW_VV_VV_UB FNC_VALUES 1 UBYTE COLUMN_DIR DIRECT /end RECORD_LAYOUT
/begin RECORD_LAYOUT TKW_VV_VV_UW FNC_VALUES 1 UWORD COLUMN_DIR DIRECT /end RECORD_LAYOUT
/begin RECORD_LAYOUT TKW_VV_VV_SW FNC_VALUES 1 SWORD COLUMN_DIR DIRECT /end RECORD_LAYOUT
/begin RECORD_LAYOUT TKL_SW_VV_UW NO_AXIS_PTS_X 1 UBYTE RESERVED 2 BYTE AXIS_PTS_X 3 SWORD INDEX_INCR DIRECT FNC_VALUES 4 UWORD COLUMN_DIR DIRECT /end RECORD_LAYOUT
/begin RECORD_LAYOUT TKW_VV_VV_UB FNC_VALUES 1 UBYTE COLUMN_DIR DIRECT /end RECORD_LAYOUT
/begin RECORD_LAYOUT TKW_VV_VV_UW FNC_VALUES 1 UWORD COLUMN_DIR DIRECT /end RECORD_LAYOUT
/begin RECORD_LAYOUT TKW_VV_VV_UB FNC_VALUES 1 UBYTE COLUMN_DIR DIRECT /end RECORD_LAYOUT
/begin RECORD_LAYOUT TKW_VV_VV_UW FNC_VALUES 1 UWORD COLUMN_DIR DIRECT /end RECORD_LAYOUT
/begin RECORD_LAYOUT TKW_VV_VV_SW FNC_VALUES 1 SWORD COLUMN_DIR DIRECT /end RECORD_LAYOUT
/begin RECORD_LAYOUT TKL_UW_VV_UB NO_AXIS_PTS_X 1 UBYTE RESERVED 2 BYTE AXIS_PTS_X 3 UWORD INDEX_INCR DIRECT FNC_VALUES 4 UBYTE COLUMN_DIR DIRECT /end RECORD_LAYOUT
/begin RECORD_LAYOUT TKL_SW_VV_UW NO_AXIS_PTS_X 1 UBYTE RESERVED 2 BYTE AXIS_PTS_X 3 SWORD INDEX_INCR DIRECT FNC_VALUES 4 UWORD COLUMN_DIR DIRECT /end RECORD_LAYOUT
/begin RECORD_LAYOUT TKW_VV_VV_UB FNC_VALUES 1 UBYTE COLUMN_DIR DIRECT /end RECORD_LAYOUT
/begin RECORD_LAYOUT TKW_VV_VV_UW FNC_VALUES 1 UWORD COLUMN_DIR DIRECT /end RECORD_LAYOUT
/begin RECORD_LAYOUT TKW_VV_VV_UB FNC_VALUES 1 UBYTE COLUMN_DIR DIRECT /end RECORD_LAYOUT
/begin RECORD_LAYOUT TKW_VV_VV_UW FNC_VALUES 1 UWORD COLUMN_DIR DIRECT /end RECORD_LAYOUT
/begin RECORD_LAYOUT TKL_UW_VV_UW NO_AXIS_PTS_X 1 UBYTE RESERVED 2 BYTE AXIS_PTS_X 3 UWORD INDEX_INCR DIRECT FNC_VALUES 4 UWORD COLUMN_DIR DIRECT /end RECORD_LAYOUT
/begin RECORD_LAYOUT TKW_VV_VV_UB FNC_VALUES 1 UBYTE COLUMN_DIR DIRECT /end RECORD_LAYOUT
/begin RECORD_LAYOUT TKW_VV_VV_UW FNC_VALUES 1 UWORD COLUMN_DIR DIRECT /end RECORD_LAYOUT
/begin RECORD_LAYOUT TKW_VV_VV_SW FNC_VALUES 1 SWORD COLUMN_DIR DIRECT /end RECORD_LAYOUT
/begin RECORD_LAYOUT TKL_SW_VV_UW NO_AXIS_PTS_X 1 UBYTE RESERVED 2 BYTE AXIS_PTS_X 3 SWORD INDEX_INCR DIRECT FNC_VALUES 4 UWORD COLUMN_DIR DIRECT /end RECORD_LAYOUT
/begin RECORD_LAYOUT TKW_VV_VV_UB FNC_VALUES 1 UBYTE COLUMN_DIR DIRECT /end RECORD_LAYOUT
/begin RECORD_LAYOUT TKW_VV_VV_UW FNC_VALUES 1 UWORD COLUMN_DIR DIRECT /end RECORD_LAYOUT
/begin RECORD_LAYOUT TKL_SW_VV_UW NO_AXIS_PTS_X 1 UBYTE RESERVED 2 BYTE AXIS_PTS_X 3 SWORD INDEX_INCR DIRECT FNC_VALUES 4 UWORD COLUMN_DIR DIRECT /end RECORD_LAYOUT
/begin RECORD_LAYOUT TKW_VV_VV_UB FNC_VALUES 1 UBYTE COLUMN_DIR DIRECT /end RECORD_LAYOUT
/begin RECORD_LAYOUT TKW_VV_VV_UW FNC_VALUES 1 UWORD COLUMN_DIR DIRECT /end RECORD_LAYOUT
/begin RECORD_LAYOUT TKL_UW_VV_UB NO_AXIS_PTS_X 1 UBYTE RESERVED 2 BYTE AXIS_PTS_X 3 UWORD INDEX_INCR DIRECT FNC_VALUES 4 UBYTE COLUMN_DIR DIRECT /end RECORD_LAYOUT
/begin RECORD_LAYOUT TKW_VV_VV_UB FNC_VALUES 1 UBYTE COLUMN_DIR DIRECT /end RECORD_LAYOUT
/begin RECORD_LAYOUT TKW_VV_VV_UW FNC_VALUES 1 UWORD COLUMN_DIR DIRECT /end RECORD_LAYOUT
/begin RECORD_LAYOUT TKW_VV_VV_UW FNC_VALUES 1 UWORD COLUMN_DIR DIRECT /end RECORD_LAYOUT
/begin RECORD_LAYOUT TKW_VV_VV_UB FNC_VALUES 1 UBYTE COLUMN_DIR DIRECT /end RECORD_LAYOUT
/begin RECORD_LAYOUT TKW_VV_VV_UB FNC_VALUES 1 UBYTE COLUMN_DIR DIRECT /end RECORD_LAYOUT
/begin RECORD_LAYOUT TKW_VV_VV_UW FNC_VALUES 1 UWORD COLUMN_DIR DIRECT /end RECORD_LAYOUT
/begin RECORD_LAYOUT TKW_VV_VV_SW FNC_VALUES 1 SWORD COLUMN_DIR DIRECT /end RECORD_LAYOUT
/end MODULE
/end PROJECT
