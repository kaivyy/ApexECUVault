ASAP2_VERSION 1 30
/begin PROJECT MSS65-ign "Generiert am 14.10.05 um 09:57:47"
/begin HEADER "" VERSION "R341" /end HEADER
/begin MODULE _MSS65-ign "Generiert am 14.10.05 um 09:57:47"
/begin MOD_COMMON "" BYTE_ORDER MSB_FIRST ALIGNMENT_BYTE 1 ALIGNMENT_WORD 2 ALIGNMENT_LONG 4 ALIGNMENT_FLOAT32_IEEE 4 ALIGNMENT_FLOAT64_IEEE 8 /end MOD_COMMON
/begin CHARACTERISTIC K_DSP_MESSEN "Schalter Freigabe DSP MESS: 0 = Aus; 1 = Aktiv" VALUE 0x7B512 TKW_VV_VV_UB 100.0 FORMULA_0003 0.0 1.0 /end CHARACTERISTIC
/begin CHARACTERISTIC K_EGAS_AQ_SOLL_GRAD_TAU "Tau fuer AQ-Soll" VALUE 0x719A7 TKW_VV_VV_UB 100.0 FORMULA_0470 5.100000184029341e-003 1.279999971389771 /end CHARACTERISTIC
/begin CHARACTERISTIC K_EGAS_CAN_ALIVE_ERR_MAX "max. Zeit für CAN-Alive" VALUE 0x719D1 TKW_VV_VV_UB 100.0 FORMULA_0003 0.0 255.0 /end CHARACTERISTIC
/begin CHARACTERISTIC K_EGAS_CAN_ED_TSPERR "Wartezeit fuer CAN-Diagnose" VALUE 0x719D2 TKW_VV_VV_UB 100.0 FORMULA_0581 0.0 1.274999976158142 /end CHARACTERISTIC
/begin CHARACTERISTIC K_EGAS_CAN_ED_UB_MIN "min. Ub fuer CAN-Diagnose" VALUE 0x719D4 TKW_VV_VV_SW 100.0 FORMULA_0008 0.0 28.0 FORMAT "%4.1" /end CHARACTERISTIC
/begin CHARACTERISTIC K_EGAS_CFG_AQ_SOLL "Filter-Konfiguration" VALUE 0x719A5 TKW_VV_VV_UB 100.0 FORMULA_0604 0.0 255.0 /end CHARACTERISTIC
/begin CHARACTERISTIC K_EGAS_CFG_DK "DK-Konfiguration" VALUE 0x719A2 TKW_VV_VV_UB 100.0 FORMULA_0601 0.0 255.0 /end CHARACTERISTIC
/begin CHARACTERISTIC K_EGAS_CFG_LLS "LLS-Konfiguration" VALUE 0x719A3 TKW_VV_VV_UB 100.0 FORMULA_0602 0.0 255.0 /end CHARACTERISTIC
/begin CHARACTERISTIC K_EGAS_CFG_MCS_SOLL "Konfiguration MCS-Vorgabe" VALUE 0x719A6 TKW_VV_VV_UB 100.0 FORMULA_0605 0.0 255.0 /end CHARACTERISTIC
/begin CHARACTERISTIC K_EGAS_CFG_WDK "WDK-Konfiguration" VALUE 0x719A4 TKW_VV_VV_UB 100.0 FORMULA_0603 0.0 255.0 /end CHARACTERISTIC
/begin CHARACTERISTIC K_EGAS_DK_R_DIAG_CLR "Fehlermaske fuer ClrDiag" VALUE 0x719DA TKW_VV_VV_UW 100.0 FORMULA_0010 0.0 65535.0 /end CHARACTERISTIC
/begin CHARACTERISTIC K_EGAS_DK_R_DIAG_CLR_MAX "max. Anzahl fuer ClrDiag DK" VALUE 0x719DF TKW_VV_VV_UB 100.0 FORMULA_0003 0.0 255.0 /end CHARACTERISTIC
/begin CHARACTERISTIC K_EGAS_DK_R_DIAG_FAIL "Fehlermaske fuer Failsafe" VALUE 0x719DC TKW_VV_VV_UW 100.0 FORMULA_0010 0.0 65535.0 /end CHARACTERISTIC
/begin CHARACTERISTIC K_EGAS_EXD_GS_SOLL "Sollwert Grosssprung" VALUE 0x72626 TKW_VV_VV_SW 100.0 FORMULA_0001 -10.0 120.0 FORMAT "%4.1" /end CHARACTERISTIC
/begin CHARACTERISTIC K_EGAS_EXD_GS_T_MAX "max. Zeit Grosssprung" VALUE 0x72621 TKW_VV_VV_UB 100.0 FORMULA_0357 0.0 1.274999976158142 /end CHARACTERISTIC
/begin CHARACTERISTIC K_EGAS_EXD_KS_SOLL "Sollwert Kleinsprung" VALUE 0x72624 TKW_VV_VV_SW 100.0 FORMULA_0001 -10.0 120.0 FORMAT "%4.1" /end CHARACTERISTIC
/begin CHARACTERISTIC K_EGAS_EXD_KS_T_MAX "max. Zeit Kleinsprung" VALUE 0x72620 TKW_VV_VV_UB 100.0 FORMULA_0357 0.0 1.274999976158142 /end CHARACTERISTIC
/begin CHARACTERISTIC K_EGAS_EXD_R1_SOLL "Endwert Rampe 1 - Oeffnen 1" VALUE 0x7262A TKW_VV_VV_SW 100.0 FORMULA_0001 -10.0 120.0 FORMAT "%4.1" /end CHARACTERISTIC
/begin CHARACTERISTIC K_EGAS_EXD_R1_SOLL_TV "min. Sollwert fuer TV - Oeffnen 1" VALUE 0x72628 TKW_VV_VV_SW 100.0 FORMULA_0001 -10.0 120.0 FORMAT "%4.1" /end CHARACTERISTIC
/begin CHARACTERISTIC K_EGAS_EXD_R1_TIME "Zeit Rampe 1 - Oeffnen 1" VALUE 0x7262E TKW_VV_VV_UW 100.0 FORMULA_0109 0.0 325.0 FORMAT "%5.2" /end CHARACTERISTIC
/begin CHARACTERISTIC K_EGAS_EXD_R2_SOLL "Endwert Rampe 2 - Oeffnen 2" VALUE 0x7262C TKW_VV_VV_SW 100.0 FORMULA_0001 -10.0 120.0 FORMAT "%4.1" /end CHARACTERISTIC
/begin CHARACTERISTIC K_EGAS_EXD_R2_TIME "Zeit Rampe 2 - Oeffnen 2" VALUE 0x72630 TKW_VV_VV_UW 100.0 FORMULA_0109 0.0 325.0 FORMAT "%5.2" /end CHARACTERISTIC
/begin CHARACTERISTIC K_EGAS_EXD_R3_TIME "Zeit Rampe 3 - Schliessen" VALUE 0x72632 TKW_VV_VV_UW 100.0 FORMULA_0109 0.0 325.0 FORMAT "%5.2" /end CHARACTERISTIC
/begin CHARACTERISTIC K_EGAS_EXD_SW_SOLL "Startwert Sprunge" VALUE 0x72622 TKW_VV_VV_SW 100.0 FORMULA_0001 -10.0 120.0 FORMAT "%4.1" /end CHARACTERISTIC
/begin CHARACTERISTIC K_EGAS_EXD_UB_MAX "max. Ub fuer DK-Diagnose" VALUE 0x7261E TKW_VV_VV_SW 100.0 FORMULA_0008 0.0 28.0 FORMAT "%4.1" /end CHARACTERISTIC
/begin CHARACTERISTIC K_EGAS_EXD_UB_MIN "min. Ub fuer DK-Diagnose" VALUE 0x7261C TKW_VV_VV_SW 100.0 FORMULA_0008 0.0 28.0 FORMAT "%4.1" /end CHARACTERISTIC
/begin CHARACTERISTIC K_EGAS_LLS_R_DIAG_CLR "Fehlermaske fuer ClrDiag" VALUE 0x719D6 TKW_VV_VV_UW 100.0 FORMULA_0010 0.0 65535.0 /end CHARACTERISTIC
/begin CHARACTERISTIC K_EGAS_LLS_R_DIAG_CLR_MAX "max. Anzahl fuer ClrDiag LLS" VALUE 0x719DE TKW_VV_VV_UB 100.0 FORMULA_0003 0.0 255.0 /end CHARACTERISTIC
/begin CHARACTERISTIC K_EGAS_LLS_R_DIAG_FAIL "Fehlermaske fuer Failsafe" VALUE 0x719D8 TKW_VV_VV_UW 100.0 FORMULA_0010 0.0 65535.0 /end CHARACTERISTIC
/begin CHARACTERISTIC K_EGAS_SK_CONTROL "SK-Schalter" VALUE 0x725A0 TKW_VV_VV_UB 100.0 FORMULA_0618 0.0 255.0 /end CHARACTERISTIC
/begin CHARACTERISTIC K_EGAS_SK_DK_OFFEN_1 "Schwelle fuer Spalt offen" VALUE 0x725BA TKW_VV_VV_SW 100.0 FORMULA_0001 -10.0 120.0 FORMAT "%4.1" /end CHARACTERISTIC
/begin CHARACTERISTIC K_EGAS_SK_DK_OFFEN_2 "Schwelle fuer Klemmen offen" VALUE 0x725BC TKW_VV_VV_SW 100.0 FORMULA_0001 -10.0 120.0 FORMAT "%4.1" /end CHARACTERISTIC
/begin CHARACTERISTIC K_EGAS_SK_FAIL_MAX "max. Anzahl fuer Fail-Status" VALUE 0x725BF TKW_VV_VV_UB 100.0 FORMULA_0003 0.0 255.0 /end CHARACTERISTIC
/begin CHARACTERISTIC K_EGAS_SK_IST_DIFF_LLS "max. Differenz Istwertabweichung" VALUE 0x725A8 TKW_VV_VV_SW 100.0 FORMULA_0001 -10.0 120.0 FORMAT "%4.1" /end CHARACTERISTIC
/begin CHARACTERISTIC K_EGAS_SK_NEUINIT_MAX "max. Anzahl fuer Neuinits" VALUE 0x725BE TKW_VV_VV_UB 100.0 FORMULA_0003 0.0 255.0 /end CHARACTERISTIC
/begin CHARACTERISTIC K_EGAS_SK_RF_IO_DK "Fehlerschwelle fuer DK iO" VALUE 0x725C6 TKW_VV_VV_UB 100.0 FORMULA_0003 0.0 16.0 /end CHARACTERISTIC
/begin CHARACTERISTIC K_EGAS_SK_RF_IO_FAK "Faktor der zulaessigen Differenz wdk-rf" VALUE 0x725C4 TKW_VV_VV_UW 100.0 FORMULA_0073 0.0 4.0 FORMAT "%6.3" /end CHARACTERISTIC
/begin CHARACTERISTIC K_EGAS_SK_RF_IO_OFF "Offset der zulaessigen Differenz wdk-rf" VALUE 0x725C2 TKW_VV_VV_SW 100.0 FORMULA_0007 0.0 2.0 FORMAT "%6.3" /end CHARACTERISTIC
/begin CHARACTERISTIC K_EGAS_SK_RF_IO_WDK "Fehlerschwelle fuer WDK iO" VALUE 0x725C7 TKW_VV_VV_UB 100.0 FORMULA_0003 0.0 16.0 /end CHARACTERISTIC
/begin CHARACTERISTIC K_EGAS_SK_RF_TSTART "Wartezeit nach Start" VALUE 0x725C0 TKW_VV_VV_UW 100.0 FORMULA_0021 0.0 10.0 FORMAT "%5.2" /end CHARACTERISTIC
/begin CHARACTERISTIC K_EGAS_SK_SOLL_DIFF "max. Differenz Sollwertabweichung" VALUE 0x725A4 TKW_VV_VV_SW 100.0 FORMULA_0001 -10.0 120.0 FORMAT "%4.1" /end CHARACTERISTIC
/begin CHARACTERISTIC K_EGAS_SK_SOLL_DIFF_LLS "max. Differenz Sollwertabweichung" VALUE 0x725A6 TKW_VV_VV_SW 100.0 FORMULA_0001 -10.0 120.0 FORMAT "%4.1" /end CHARACTERISTIC
/begin CHARACTERISTIC K_EGAS_SK_T_IST "max. Zeit Soll-/Istabweichung" VALUE 0x725AE TKW_VV_VV_UW 100.0 FORMULA_0021 0.0 10.0 FORMAT "%5.2" /end CHARACTERISTIC
/begin CHARACTERISTIC K_EGAS_SK_T_IST_LLS "max. Zeit Istwertabweichung" VALUE 0x725B2 TKW_VV_VV_UW 100.0 FORMULA_0021 0.0 10.0 FORMAT "%5.2" /end CHARACTERISTIC
/begin CHARACTERISTIC K_EGAS_SK_T_MODE "max. Zeit Modeabweichung" VALUE 0x725B4 TKW_VV_VV_UW 100.0 FORMULA_0021 0.0 10.0 FORMAT "%5.2" /end CHARACTERISTIC
/begin CHARACTERISTIC K_EGAS_SK_T_MODE_INIT "max. Zeit Modeabweichung LLS-Init" VALUE 0x725B6 TKW_VV_VV_UW 100.0 FORMULA_0021 0.0 10.0 FORMAT "%5.2" /end CHARACTERISTIC
/begin CHARACTERISTIC K_EGAS_SK_T_NP_MAX "max. Dauer fuer NP-Adaption" VALUE 0x725B8 TKW_VV_VV_UW 100.0 FORMULA_0590 0.0 327.6749877929688 FORMAT "%5.2" /end CHARACTERISTIC
/begin CHARACTERISTIC K_EGAS_SK_T_OFFEN "max. Zeit Istwertabweichung" VALUE 0x725A1 TKW_VV_VV_UB 100.0 FORMULA_0306 0.0 2.549999952316284 /end CHARACTERISTIC
/begin CHARACTERISTIC K_EGAS_SK_T_RGPOS "max. Zeit CAN-Fehlerkennung" VALUE 0x725C8 TKW_VV_VV_UB 100.0 FORMULA_0306 0.0 2.0 /end CHARACTERISTIC
/begin CHARACTERISTIC K_EGAS_SK_T_SOLL "max. Zeit Sollwertabweichung" VALUE 0x725AA TKW_VV_VV_UW 100.0 FORMULA_0021 0.0 10.0 FORMAT "%5.2" /end CHARACTERISTIC
/begin CHARACTERISTIC K_EGAS_SK_T_SOLL_LLS "max. Zeit Sollwertabweichung" VALUE 0x725B0 TKW_VV_VV_UW 100.0 FORMULA_0021 0.0 10.0 FORMAT "%5.2" /end CHARACTERISTIC
/begin CHARACTERISTIC K_EGAS_SK_T_WDK "max. Zeit Analog-/CAN-Abweichung" VALUE 0x725AC TKW_VV_VV_UW 100.0 FORMULA_0021 0.0 10.0 FORMAT "%5.2" /end CHARACTERISTIC
/begin CHARACTERISTIC K_EGAS_SK_TAU_DK "Filter DK-Ueberwachung" VALUE 0x725A3 TKW_VV_VV_UB 100.0 FORMULA_0455 1.009999960660934e-002 2.559999942779541 /end CHARACTERISTIC
/begin CHARACTERISTIC K_EGAS_SK_TAU_LLS "Filter LLS-Ueberwachung" VALUE 0x725A2 TKW_VV_VV_UB 100.0 FORMULA_0455 1.009999960660934e-002 2.559999942779541 /end CHARACTERISTIC
/begin CHARACTERISTIC K_EGAS_SOLL_AQ_KH_N_MAX "Drehzahlschwelle fuer KH-Querschnitt" VALUE 0x719AA TKW_VV_VV_SW 100.0 FORMULA_0006 0.0 10000.0 /end CHARACTERISTIC
/begin CHARACTERISTIC K_EGAS_SOLL_AQ_TI_OFF "Notlaufquerschnitt bei Bankabschaltung" VALUE 0x719A8 TKW_VV_VV_UW 100.0 FORMULA_0143 0.0 6500.0 FORMAT "%4.1" /end CHARACTERISTIC
/begin CHARACTERISTIC K_EGAS_SOLL_BOWDEN_LLS_F "Wichtungsfaktor" VALUE 0x719E2 TKW_VV_VV_UW 100.0 FORMULA_0073 0.0 10.0 FORMAT "%6.3" /end CHARACTERISTIC
/begin CHARACTERISTIC K_EGAS_SOLL_BOWDEN_MIN "min. LLS-Schwelle" VALUE 0x719E4 TKW_VV_VV_SW 100.0 FORMULA_0001 -10.0 120.0 FORMAT "%4.1" /end CHARACTERISTIC
/begin CHARACTERISTIC K_EGAS_SOLL_ENTDR_SCHW "dr_rel-Schwelle fuer entdr. Betrieb" VALUE 0x719AE TKW_VV_VV_SW 100.0 FORMULA_0106 0.0 199.9938049316406 FORMAT "%5.2" /end CHARACTERISTIC
/begin CHARACTERISTIC K_EGAS_SOLL_GT_OFF "Offsetsprung beim Gestaengetest" VALUE 0x719B0 TKW_VV_VV_SW 100.0 FORMULA_0001 -10.0 120.0 FORMAT "%4.1" /end CHARACTERISTIC
/begin CHARACTERISTIC K_EGAS_SOLL_LLS_DELTA "Rampe fuer LLS-Schwebung" VALUE 0x719B8 TKW_VV_VV_UB 100.0 FORMULA_0607 0.0 25.0 /end CHARACTERISTIC
/begin CHARACTERISTIC K_EGAS_SOLL_LLS_DK_SCHW "DK-Schwelle fuer LLS-Schwebung" VALUE 0x719B6 TKW_VV_VV_UB 100.0 FORMULA_0471 0.0 25.0 /end CHARACTERISTIC
/begin CHARACTERISTIC K_EGAS_SOLL_LLS_OFF "Offset fuer LLS-Schwebung" VALUE 0x719B7 TKW_VV_VV_UB 100.0 FORMULA_0471 0.0 25.0 /end CHARACTERISTIC
/begin CHARACTERISTIC K_EGAS_SOLL_MCS_DK "DK-Sollwert" VALUE 0x719B4 TKW_VV_VV_SW 100.0 FORMULA_0001 -10.0 120.0 FORMAT "%4.1" /end CHARACTERISTIC
/begin CHARACTERISTIC K_EGAS_SOLL_MCS_LLS "DK-Sollwert" VALUE 0x719B2 TKW_VV_VV_SW 100.0 FORMULA_0001 -10.0 120.0 FORMAT "%4.1" /end CHARACTERISTIC
/begin CHARACTERISTIC K_EGAS_SOLL_VL_FAK "Anhebung bei Vollast" VALUE 0x719AC TKW_VV_VV_UW 100.0 FORMULA_0606 1.0 64.99900054931641 FORMAT "%5.2" /end CHARACTERISTIC
/begin CHARACTERISTIC K_EGAS_STM_DK_FT_TMOT "min. Temp fuer Federntest" VALUE 0x7260C TKW_VV_VV_SW 100.0 FORMULA_0023 -50.0 170.0 FORMAT "%4.1" /end CHARACTERISTIC
/begin CHARACTERISTIC K_EGAS_STM_DK_GT_MAX "max. Position fuer Abbruch Gestaengetest" VALUE 0x72606 TKW_VV_VV_SW 100.0 FORMULA_0001 -10.0 120.0 FORMAT "%4.1" /end CHARACTERISTIC
/begin CHARACTERISTIC K_EGAS_STM_DK_GT_MIN "min. Delta fuer Gestaengetest" VALUE 0x72604 TKW_VV_VV_SW 100.0 FORMULA_0001 -10.0 120.0 FORMAT "%4.1" /end CHARACTERISTIC
/begin CHARACTERISTIC K_EGAS_STM_DK_GT_TIME "max. Zeit fuer Gestaengetest" VALUE 0x725FE TKW_VV_VV_UW 100.0 FORMULA_0627 0.0 327.6749877929688 FORMAT "%5.2" /end CHARACTERISTIC
/begin CHARACTERISTIC K_EGAS_STM_DK_GT_TMOT "min. Temp fuer Gestaengetest" VALUE 0x72600 TKW_VV_VV_SW 100.0 FORMULA_0023 -50.0 170.0 FORMAT "%4.1" /end CHARACTERISTIC
/begin CHARACTERISTIC K_EGAS_STM_DK_GT_UB "min. Ub fuer Gestaengetest" VALUE 0x72602 TKW_VV_VV_SW 100.0 FORMULA_0008 0.0 28.0 FORMAT "%4.1" /end CHARACTERISTIC
/begin CHARACTERISTIC K_EGAS_STM_DK_MODE_HW "HW-Nr fuer ModeVgl-Hosentraeger" VALUE 0x7261A TKW_VV_VV_UW 100.0 FORMULA_0010 0.0 65535.0 /end CHARACTERISTIC
/begin CHARACTERISTIC K_EGAS_STM_DK_N_FAST "schneller DK-Hochlauf beim Reset" VALUE 0x72608 TKW_VV_VV_SW 100.0 FORMULA_0006 0.0 10000.0 /end CHARACTERISTIC
/begin CHARACTERISTIC K_EGAS_STM_DK_N_KL50 "schneller DK-Hochlauf bei Kl50" VALUE 0x7260A TKW_VV_VV_SW 100.0 FORMULA_0006 0.0 10000.0 /end CHARACTERISTIC
/begin CHARACTERISTIC K_EGAS_STM_DK_NP_NMAX "max. Drehzahl fuer Nachadaption" VALUE 0x72610 TKW_VV_VV_SW 100.0 FORMULA_0006 0.0 10000.0 /end CHARACTERISTIC
/begin CHARACTERISTIC K_EGAS_STM_DK_NP_PMAX "max. Psau fuer Nachadaption" VALUE 0x72618 TKW_VV_VV_SW 100.0 FORMULA_0106 0.0 120.0 FORMAT "%5.2" /end CHARACTERISTIC
/begin CHARACTERISTIC K_EGAS_STM_DK_NP_PMIN "min. Psau fuer Nachadaption" VALUE 0x72616 TKW_VV_VV_SW 100.0 FORMULA_0106 0.0 120.0 FORMAT "%5.2" /end CHARACTERISTIC
/begin CHARACTERISTIC K_EGAS_STM_DK_NP_TMOT "Differenz fuer Nachadaption" VALUE 0x72612 TKW_VV_VV_SW 100.0 FORMULA_0074 -1000.0 1000.0 FORMAT "%4.1" /end CHARACTERISTIC
/begin CHARACTERISTIC K_EGAS_STM_DK_NP_TMOT_MIN "min. Temp fuer Nullpunktadaption" VALUE 0x72614 TKW_VV_VV_SW 100.0 FORMULA_0023 -50.0 170.0 FORMAT "%4.1" /end CHARACTERISTIC
/begin CHARACTERISTIC K_EGAS_STM_DK_NP_UB "min. Ub fuer Nullpunktsadaption" VALUE 0x7260E TKW_VV_VV_SW 100.0 FORMULA_0008 0.0 28.0 FORMAT "%4.1" /end CHARACTERISTIC
/begin CHARACTERISTIC K_EGAS_STM_DK_SK_TST "SK-Testzeit" VALUE 0x725FC TKW_VV_VV_UW 100.0 FORMULA_0627 0.0 327.6749877929688 FORMAT "%5.2" /end CHARACTERISTIC
/begin CHARACTERISTIC K_EGAS_STM_DK_SK_ZU "Schwelle fuer SK-/GT-Test" VALUE 0x725FA TKW_VV_VV_SW 100.0 FORMULA_0001 -10.0 120.0 FORMAT "%4.1" /end CHARACTERISTIC
/begin CHARACTERISTIC K_EGAS_STM_DK_WAIT_DIS "Warten auf Disable" VALUE 0x725F8 TKW_VV_VV_UW 100.0 FORMULA_0627 0.0 327.6749877929688 FORMAT "%5.2" /end CHARACTERISTIC
/begin CHARACTERISTIC K_EGAS_STM_LLS_DK_SCHW "DK-Schwelle fuer LLS-Adaption" VALUE 0x725F2 TKW_VV_VV_SW 100.0 FORMULA_0001 -10.0 120.0 FORMAT "%4.1" /end CHARACTERISTIC
/begin CHARACTERISTIC K_EGAS_STM_LLS_T_ADAPT "max. Zeit fuer LLS-Adaption" VALUE 0x725F4 TKW_VV_VV_UW 100.0 FORMULA_0627 0.0 327.6749877929688 FORMAT "%5.2" /end CHARACTERISTIC
/begin CHARACTERISTIC K_EGAS_STM_NOINIT_FAIL "Fail-Fehler ohne Neuinit" VALUE 0x725F0 TKW_VV_VV_UW 100.0 FORMULA_0010 0.0 65535.0 /end CHARACTERISTIC
/begin CHARACTERISTIC K_EGAS_STM_NOINIT_SK "SK-Fehler ohne Neuinit" VALUE 0x725EE TKW_VV_VV_UW 100.0 FORMULA_0010 0.0 65535.0 /end CHARACTERISTIC
/begin CHARACTERISTIC K_EGAS_STM_T_ADAPT "Adaptionszyklus fuer LLS und DK" VALUE 0x725F6 TKW_VV_VV_UW 100.0 FORMULA_0620 0.0 1092.25 /end CHARACTERISTIC
/begin CHARACTERISTIC K_EGAS_T_KL50 "Wartezeit bei KL50" VALUE 0x719E0 TKW_VV_VV_UB 100.0 FORMULA_0357 0.0 1.274999976158142 /end CHARACTERISTIC
/begin CHARACTERISTIC K_EGAS_WDK_A0_ANZAHL "Anzahl der A0-Mittelwerte" VALUE 0x719D0 TKW_VV_VV_UB 100.0 FORMULA_0423 0.0 250.0 /end CHARACTERISTIC
/begin CHARACTERISTIC K_EGAS_WDK_A0_DELTA_MAX "max. A0-Delta" VALUE 0x719CE TKW_VV_VV_SW 100.0 FORMULA_0250 0.0 5.0 FORMAT "%6.3" /end CHARACTERISTIC
/begin CHARACTERISTIC K_EGAS_WDK_A0_DFT "Default A0-Wert" VALUE 0x719CC TKW_VV_VV_SW 100.0 FORMULA_0250 0.0 5.0 FORMAT "%6.3" /end CHARACTERISTIC
/begin CHARACTERISTIC K_EGAS_WDK_A0_KONST "A0 konstant" VALUE 0x719C2 TKW_VV_VV_SW 100.0 FORMULA_0250 0.0 0.5 FORMAT "%6.3" /end CHARACTERISTIC
/begin CHARACTERISTIC K_EGAS_WDK_A0_MAX "max. A0-Wert" VALUE 0x719CA TKW_VV_VV_SW 100.0 FORMULA_0250 0.0 5.0 FORMAT "%6.3" /end CHARACTERISTIC
/begin CHARACTERISTIC K_EGAS_WDK_A0_MIN "min. A0-Wert" VALUE 0x719C8 TKW_VV_VV_SW 100.0 FORMULA_0250 0.0 5.0 FORMAT "%6.3" /end CHARACTERISTIC
/begin CHARACTERISTIC K_EGAS_WDK_A0_OFF_B1 "min. A0-Wert" VALUE 0x719C4 TKW_VV_VV_SW 100.0 FORMULA_0250 -2.0 2.0 FORMAT "%6.3" /end CHARACTERISTIC
/begin CHARACTERISTIC K_EGAS_WDK_A0_OFF_B2 "min. A0-Wert" VALUE 0x719C6 TKW_VV_VV_SW 100.0 FORMULA_0250 -2.0 2.0 FORMAT "%6.3" /end CHARACTERISTIC
/begin CHARACTERISTIC K_EGAS_WDK_A0_TIME "Zeit fuer Konstantwert" VALUE 0x719C0 TKW_VV_VV_UB 100.0 FORMULA_0584 0.0 1000.0 /end CHARACTERISTIC
/begin CHARACTERISTIC K_EGAS_WDK_MAX "max. WDK" VALUE 0x719BC TKW_VV_VV_SW 100.0 FORMULA_0250 0.0 5.0 FORMAT "%6.3" /end CHARACTERISTIC
/begin CHARACTERISTIC K_EGAS_WDK_MIN "min. WDK" VALUE 0x719BA TKW_VV_VV_SW 100.0 FORMULA_0250 0.0 5.0 FORMAT "%6.3" /end CHARACTERISTIC
/begin CHARACTERISTIC K_EGAS_WDK_NORM "Umrechnung V in %" VALUE 0x719BE TKW_VV_VV_SW 100.0 FORMULA_0608 0.0 100.0 FORMAT "%6.3" /end CHARACTERISTIC
/begin CHARACTERISTIC KF_EGAS_N_AQ_KH_NEG "neg. Drehzahlfilter bei KH" MAP 0x72396 TKF_SW_SW_UB 100.0 FORMULA_0470 5.100000184029341e-003 1.279999971389771 /begin AXIS_DESCR STD_AXIS n FORMULA_0006 8 0.0 10000.0 MAX_GRAD 0.0 /end AXIS_DESCR
 /begin AXIS_DESCR STD_AXIS egas_aq_soll FORMULA_0143 8 0.0 3200.0 MAX_GRAD 0.0 FORMAT "%4.1" /end AXIS_DESCR
/end CHARACTERISTIC
/begin CHARACTERISTIC KF_EGAS_N_AQ_KH_POS "pos. Drehzahlfilter bei KH" MAP 0x723F8 TKF_SW_SW_UB 100.0 FORMULA_0470 5.100000184029341e-003 1.279999971389771 /begin AXIS_DESCR STD_AXIS n FORMULA_0006 8 0.0 10000.0 MAX_GRAD 0.0 /end AXIS_DESCR
 /begin AXIS_DESCR STD_AXIS egas_aq_soll FORMULA_0143 8 0.0 3200.0 MAX_GRAD 0.0 FORMAT "%4.1" /end AXIS_DESCR
/end CHARACTERISTIC
/begin CHARACTERISTIC KF_EGAS_N_AQ_ML_NEG "neg. Drehzahlfilter bei ML" MAP 0x7245A TKF_SW_SW_UB 100.0 FORMULA_0470 5.100000184029341e-003 1.279999971389771 /begin AXIS_DESCR STD_AXIS n FORMULA_0006 8 0.0 10000.0 MAX_GRAD 0.0 /end AXIS_DESCR
 /begin AXIS_DESCR STD_AXIS egas_aq_soll FORMULA_0143 8 0.0 3200.0 MAX_GRAD 0.0 FORMAT "%4.1" /end AXIS_DESCR
/end CHARACTERISTIC
/begin CHARACTERISTIC KF_EGAS_N_AQ_ML_POS "pos. Drehzahlfilter bei ML" MAP 0x724BC TKF_SW_SW_UB 100.0 FORMULA_0470 5.100000184029341e-003 1.279999971389771 /begin AXIS_DESCR STD_AXIS n FORMULA_0006 8 0.0 10000.0 MAX_GRAD 0.0 /end AXIS_DESCR
 /begin AXIS_DESCR STD_AXIS egas_aq_soll FORMULA_0143 8 0.0 3200.0 MAX_GRAD 0.0 FORMAT "%4.1" /end AXIS_DESCR
/end CHARACTERISTIC
/begin CHARACTERISTIC KF_EGAS_SOLL_AQ "AQ-Sollwert pro Bank" MAP 0x71A0E TKF_SW_SW_SW 100.0 FORMULA_0007 0.0 2.0 FORMAT "%6.3" /begin AXIS_DESCR STD_AXIS n FORMULA_0006 22 0.0 10000.0 MAX_GRAD 0.0 /end AXIS_DESCR
 /begin AXIS_DESCR STD_AXIS aq_abs FORMULA_0143 22 0.0 3200.0 MAX_GRAD 0.0 FORMAT "%4.1" /end AXIS_DESCR
/end CHARACTERISTIC
/begin CHARACTERISTIC KF_EGAS_SOLL_AQ_NOTL "AQ-Sollwert Notlauf pro Bank" MAP 0x71E30 TKF_SW_SW_SW 100.0 FORMULA_0007 0.0 2.0 FORMAT "%6.3" /begin AXIS_DESCR STD_AXIS n FORMULA_0006 22 0.0 10000.0 MAX_GRAD 0.0 /end AXIS_DESCR
 /begin AXIS_DESCR STD_AXIS aq_abs FORMULA_0143 22 0.0 3200.0 MAX_GRAD 0.0 FORMAT "%4.1" /end AXIS_DESCR
/end CHARACTERISTIC
/begin CHARACTERISTIC KF_EGAS_SOLL_AQ_START "AQ im Start" MAP 0x7251E TKF_SW_SW_UW 100.0 FORMULA_0143 0.0 6500.0 FORMAT "%4.1" /begin AXIS_DESCR STD_AXIS n FORMULA_0006 4 0.0 10000.0 MAX_GRAD 0.0 /end AXIS_DESCR
 /begin AXIS_DESCR STD_AXIS egas_aq_soll FORMULA_0007 12 0.0 2.0 MAX_GRAD 0.0 FORMAT "%6.3" /end AXIS_DESCR
/end CHARACTERISTIC
/begin CHARACTERISTIC KF_EGAS_SOLL_WL_GEW_F "Warmlaufegwichtungsfaktor, Faktor um 0" MAP 0x722F4 TKF_SW_SW_SW 100.0 FORMULA_0073 -4.0 4.0 FORMAT "%6.3"
 /begin AXIS_DESCR STD_AXIS tmot_dk FORMULA_0023 8 -50.0 170.0 MAX_GRAD 0.0 FORMAT "%4.1" /end AXIS_DESCR
 /begin AXIS_DESCR STD_AXIS zust_tmot_start FORMULA_0023 8 -50.0 170.0 MAX_GRAD 0.0 FORMAT "%4.1" /end AXIS_DESCR
/end CHARACTERISTIC
/begin CHARACTERISTIC KF_EGAS_SOLL_WL_OFFS "Warmlaufkorrektur, Faktor um 0" MAP 0x72252 TKF_SW_SW_SW 100.0 FORMULA_0073 -4.0 4.0 FORMAT "%6.3" /begin AXIS_DESCR STD_AXIS n FORMULA_0006 8 0.0 10000.0 MAX_GRAD 0.0 /end AXIS_DESCR
 /begin AXIS_DESCR STD_AXIS rf FORMULA_0007 8 0.0 2.0 MAX_GRAD 0.0 FORMAT "%6.3" /end AXIS_DESCR
/end CHARACTERISTIC
/begin CHARACTERISTIC KL_EGAS_EXD_VORST_DK_AUF "Vorsteuerwert DK-Auf" CURVE 0x72650 TKL_SW_VV_UB 100.0 FORMULA_0628 0.0 199.2187042236328
 /begin AXIS_DESCR STD_AXIS r_sollw FORMULA_0001 4 -10.0 120.0 MAX_GRAD 0.0 FORMAT "%4.1" /end AXIS_DESCR
/end CHARACTERISTIC
/begin CHARACTERISTIC KL_EGAS_EXD_VORST_DK_ZU "Vorsteuerwert DK-Zu" CURVE 0x7265E TKL_SW_VV_UB 100.0 FORMULA_0628 0.0 199.2187042236328
 /begin AXIS_DESCR STD_AXIS r_sollw FORMULA_0001 4 -10.0 120.0 MAX_GRAD 0.0 FORMAT "%4.1" /end AXIS_DESCR
/end CHARACTERISTIC
/begin CHARACTERISTIC KL_EGAS_EXD_VORST_LLS_AUF "Vorsteuerwert LLS-Auf" CURVE 0x72634 TKL_SW_VV_UB 100.0 FORMULA_0628 0.0 199.2187042236328
 /begin AXIS_DESCR STD_AXIS r_sollw FORMULA_0001 4 -10.0 120.0 MAX_GRAD 0.0 FORMAT "%4.1" /end AXIS_DESCR
/end CHARACTERISTIC
/begin CHARACTERISTIC KL_EGAS_EXD_VORST_LLS_ZU "Vorsteuerwert LLS-Zu" CURVE 0x72642 TKL_SW_VV_UB 100.0 FORMULA_0628 0.0 199.2187042236328
 /begin AXIS_DESCR STD_AXIS r_sollw FORMULA_0001 4 -10.0 120.0 MAX_GRAD 0.0 FORMAT "%4.1" /end AXIS_DESCR
/end CHARACTERISTIC
/begin CHARACTERISTIC KL_EGAS_N_AQ_START_NEG "neg. Drehzahlfilter im Start" CURVE 0x719FA TKL_SW_VV_UB 100.0 FORMULA_0470 5.100000184029341e-003 1.279999971389771 /begin AXIS_DESCR STD_AXIS n FORMULA_0006 6 0.0 10000.0 MAX_GRAD 0.0 /end AXIS_DESCR /end CHARACTERISTIC
/begin CHARACTERISTIC KL_EGAS_N_AQ_START_POS "pos. Drehzahlfilter im Start" CURVE 0x719E6 TKL_SW_VV_UB 100.0 FORMULA_0470 5.100000184029341e-003 1.279999971389771 /begin AXIS_DESCR STD_AXIS n FORMULA_0006 6 0.0 10000.0 MAX_GRAD 0.0 /end AXIS_DESCR /end CHARACTERISTIC
/begin CHARACTERISTIC KL_EGAS_SK_DK_DIFF_MAX "max. Differenz Soll/Ist" CURVE 0x725CA TKL_SW_VV_SW 100.0 FORMULA_0001 -10.0 120.0 FORMAT "%4.1"
 /begin AXIS_DESCR STD_AXIS dk_soll FORMULA_0001 4 -10.0 120.0 MAX_GRAD 0.0 FORMAT "%4.1" /end AXIS_DESCR
/end CHARACTERISTIC
/begin CHARACTERISTIC KL_EGAS_SK_WDK_DIFF "max. Differenz Analog-/CAN-Abweichung" CURVE 0x725DC TKL_SW_VV_SW 100.0 FORMULA_0001 -10.0 120.0 FORMAT "%4.1"
 /begin AXIS_DESCR STD_AXIS dk_ist FORMULA_0001 4 -10.0 120.0 MAX_GRAD 0.0 FORMAT "%4.1" /end AXIS_DESCR
/end CHARACTERISTIC
/begin MEASUREMENT dsp_100KHzDat_10of10_.dsp_ion "dsp_ion,1,Y, !!! Dummy not for Gredi !!!" UWORD FORMULA_0862 0 0.0 0.0 5.0 READ_WRITE ECU_ADDRESS 0xC60CEC /end MEASUREMENT
/begin MEASUREMENT dsp_100KHzDat_10of10_.dsp_p "dsp_p,2,Y, !!! Dummy not for Gredi !!!" UWORD FORMULA_0863 0 0.0 0.0 150.0 READ_WRITE ECU_ADDRESS 0xC60CEE /end MEASUREMENT
/begin MEASUREMENT dsp_100KHzDat_1of10_.dsp_ion "dsp_ion,1,Y, !!! Dummy not for Gredi !!!" UWORD FORMULA_0862 0 0.0 0.0 5.0 READ_WRITE ECU_ADDRESS 0xC60CC8 /end MEASUREMENT
/begin MEASUREMENT dsp_100KHzDat_1of10_.dsp_p "dsp_p,2,Y, !!! Dummy not for Gredi !!!" UWORD FORMULA_0863 0 0.0 0.0 150.0 READ_WRITE ECU_ADDRESS 0xC60CCA /end MEASUREMENT
/begin MEASUREMENT dsp_100KHzDat_2of10_.dsp_ion "dsp_ion,1,Y, !!! Dummy not for Gredi !!!" UWORD FORMULA_0862 0 0.0 0.0 5.0 READ_WRITE ECU_ADDRESS 0xC60CCC /end MEASUREMENT
/begin MEASUREMENT dsp_100KHzDat_2of10_.dsp_p "dsp_p,2,Y, !!! Dummy not for Gredi !!!" UWORD FORMULA_0863 0 0.0 0.0 150.0 READ_WRITE ECU_ADDRESS 0xC60CCE /end MEASUREMENT
/begin MEASUREMENT dsp_100KHzDat_3of10_.dsp_ion "dsp_ion,1,Y, !!! Dummy not for Gredi !!!" UWORD FORMULA_0862 0 0.0 0.0 5.0 READ_WRITE ECU_ADDRESS 0xC60CD0 /end MEASUREMENT
/begin MEASUREMENT dsp_100KHzDat_3of10_.dsp_p "dsp_p,2,Y, !!! Dummy not for Gredi !!!" UWORD FORMULA_0863 0 0.0 0.0 150.0 READ_WRITE ECU_ADDRESS 0xC60CD2 /end MEASUREMENT
/begin MEASUREMENT dsp_100KHzDat_4of10_.dsp_ion "dsp_ion,1,Y, !!! Dummy not for Gredi !!!" UWORD FORMULA_0862 0 0.0 0.0 5.0 READ_WRITE ECU_ADDRESS 0xC60CD4 /end MEASUREMENT
/begin MEASUREMENT dsp_100KHzDat_4of10_.dsp_p "dsp_p,2,Y, !!! Dummy not for Gredi !!!" UWORD FORMULA_0863 0 0.0 0.0 150.0 READ_WRITE ECU_ADDRESS 0xC60CD6 /end MEASUREMENT
/begin MEASUREMENT dsp_100KHzDat_5of10_.dsp_ion "dsp_ion,1,Y, !!! Dummy not for Gredi !!!" UWORD FORMULA_0862 0 0.0 0.0 5.0 READ_WRITE ECU_ADDRESS 0xC60CD8 /end MEASUREMENT
/begin MEASUREMENT dsp_100KHzDat_5of10_.dsp_p "dsp_p,2,Y, !!! Dummy not for Gredi !!!" UWORD FORMULA_0863 0 0.0 0.0 150.0 READ_WRITE ECU_ADDRESS 0xC60CDA /end MEASUREMENT
/begin MEASUREMENT dsp_100KHzDat_6of10_.dsp_ion "dsp_ion,1,Y, !!! Dummy not for Gredi !!!" UWORD FORMULA_0862 0 0.0 0.0 5.0 READ_WRITE ECU_ADDRESS 0xC60CDC /end MEASUREMENT
/begin MEASUREMENT dsp_100KHzDat_6of10_.dsp_p "dsp_p,2,Y, !!! Dummy not for Gredi !!!" UWORD FORMULA_0863 0 0.0 0.0 150.0 READ_WRITE ECU_ADDRESS 0xC60CDE /end MEASUREMENT
/begin MEASUREMENT dsp_100KHzDat_7of10_.dsp_ion "dsp_ion,1,Y, !!! Dummy not for Gredi !!!" UWORD FORMULA_0862 0 0.0 0.0 5.0 READ_WRITE ECU_ADDRESS 0xC60CE0 /end MEASUREMENT
/begin MEASUREMENT dsp_100KHzDat_7of10_.dsp_p "dsp_p,2,Y, !!! Dummy not for Gredi !!!" UWORD FORMULA_0863 0 0.0 0.0 150.0 READ_WRITE ECU_ADDRESS 0xC60CE2 /end MEASUREMENT
/begin MEASUREMENT dsp_100KHzDat_8of10_.dsp_ion "dsp_ion,1,Y, !!! Dummy not for Gredi !!!" UWORD FORMULA_0862 0 0.0 0.0 5.0 READ_WRITE ECU_ADDRESS 0xC60CE4 /end MEASUREMENT
/begin MEASUREMENT dsp_100KHzDat_8of10_.dsp_p "dsp_p,2,Y, !!! Dummy not for Gredi !!!" UWORD FORMULA_0863 0 0.0 0.0 150.0 READ_WRITE ECU_ADDRESS 0xC60CE6 /end MEASUREMENT
/begin MEASUREMENT dsp_100KHzDat_9of10_.dsp_ion "dsp_ion,1,Y, !!! Dummy not for Gredi !!!" UWORD FORMULA_0862 0 0.0 0.0 5.0 READ_WRITE ECU_ADDRESS 0xC60CE8 /end MEASUREMENT
/begin MEASUREMENT dsp_100KHzDat_9of10_.dsp_p "dsp_p,2,Y, !!! Dummy not for Gredi !!!" UWORD FORMULA_0863 0 0.0 0.0 150.0 READ_WRITE ECU_ADDRESS 0xC60CEA /end MEASUREMENT
/begin MEASUREMENT dsp_alive_cnt "DSP Alive Counter." UBYTE FORMULA_0003 0 0.0 0.0 255.0 READ_WRITE ECU_ADDRESS 0x3FB5A4 /end MEASUREMENT
/begin MEASUREMENT dsp_alive_cnt_err "Fehlerzaehler DSP Alive Fehlerzaehler." UBYTE FORMULA_0003 0 0.0 0.0 255.0 READ_WRITE ECU_ADDRESS 0x3FB5A6 /end MEASUREMENT
/begin MEASUREMENT dsp_alive_cnt_old "Letzten DSP Alive Counter." UBYTE FORMULA_0003 0 0.0 0.0 255.0 READ_WRITE ECU_ADDRESS 0x3FB5A5 /end MEASUREMENT
/begin MEASUREMENT dsp_bank_cnt_b1 "DSP bank counter." UWORD FORMULA_0010 0 0.0 0.0 65535.0 READ_WRITE ECU_ADDRESS 0x3FB5B8 /end MEASUREMENT
/begin MEASUREMENT dsp_bank_cnt_b2 "DSP bank counter." UWORD FORMULA_0010 0 0.0 0.0 65535.0 READ_WRITE ECU_ADDRESS 0x3FB5BA /end MEASUREMENT
/begin MEASUREMENT dsp_bus_cnt "DSP bus error counter." UBYTE FORMULA_0003 0 0.0 0.0 255.0 READ_WRITE ECU_ADDRESS 0x3FE75C /end MEASUREMENT
/begin MEASUREMENT dsp_cnt_b1 "DSP counter." UWORD FORMULA_0010 0 0.0 0.0 65535.0 READ_WRITE ECU_ADDRESS 0x3FB5B4 /end MEASUREMENT
/begin MEASUREMENT dsp_cnt_b2 "DSP counter." UWORD FORMULA_0010 0 0.0 0.0 65535.0 READ_WRITE ECU_ADDRESS 0x3FB5B6 /end MEASUREMENT
/begin MEASUREMENT dsp_d2p_b1.cam_cycle_cnt "Arbeitsspielzaehler." ULONG FORMULA_0000 0 0.0 0.0 4294967295.0 READ_WRITE ECU_ADDRESS 0x3FB614 /end MEASUREMENT
/begin MEASUREMENT dsp_d2p_b1.fbs "Energiespektrum." FLOAT32_IEEE FORMULA_0044 0 0.0 -3.402823466385289e+038 3.402823466385289e+038 READ_WRITE ECU_ADDRESS 0x3FB618 /end MEASUREMENT
/begin MEASUREMENT dsp_d2p_b1.lp_int_value "TP-Integral im Aussetzerfenster." SLONG FORMULA_0579 0 0.0 0.0 50.0 READ_WRITE ECU_ADDRESS 0x3FB5FC /end MEASUREMENT
/begin MEASUREMENT dsp_d2p_b1.lp_samples "Laenge Aussetzerfenster." ULONG FORMULA_0578 0 0.0 0.0 24.576 READ_WRITE ECU_ADDRESS 0x3FB5F8 /end MEASUREMENT
/begin MEASUREMENT dsp_d2p_b1.min_avg_int "Minimalintegral im Aussetzerfenster." SLONG FORMULA_0579 0 0.0 0.0 50.0 READ_WRITE ECU_ADDRESS 0x3FB600 /end MEASUREMENT
/begin MEASUREMENT dsp_d2p_b1.min_avg_samples "Anzahl Messpunkte Minimalintegral." ULONG FORMULA_0578 0 0.0 0.0 24.576 READ_WRITE ECU_ADDRESS 0x3FB604 /end MEASUREMENT
/begin MEASUREMENT dsp_d2p_b1.ns_samples "Laenge Nebenschluss." ULONG FORMULA_0578 0 0.0 0.0 24.576 READ_WRITE ECU_ADDRESS 0x3FB5F4 /end MEASUREMENT
/begin MEASUREMENT dsp_d2p_b1.spark_time "Funkenbrenndauer." ULONG FORMULA_0578 0 0.0 0.0 24.576 READ_WRITE ECU_ADDRESS 0x3FB5F0 /end MEASUREMENT
/begin MEASUREMENT dsp_d2p_b1.vr_int_value "TP-Integral im Klopffenster." SLONG FORMULA_0579 0 0.0 0.0 50.0 READ_WRITE ECU_ADDRESS 0x3FB610 /end MEASUREMENT
/begin MEASUREMENT dsp_d2p_b1.vr_max_value "Maximalwert im Klopffenster." SLONG FORMULA_0580 0 0.0 0.0 3.3 READ_WRITE ECU_ADDRESS 0x3FB60C /end MEASUREMENT
/begin MEASUREMENT dsp_d2p_b1.vr_samples "Laenge Klopffenster." ULONG FORMULA_0578 0 0.0 0.0 24.576 READ_WRITE ECU_ADDRESS 0x3FB608 /end MEASUREMENT
/begin MEASUREMENT dsp_d2p_b2.cam_cycle_cnt "Arbeitsspielzaehler." ULONG FORMULA_0000 0 0.0 0.0 4294967295.0 READ_WRITE ECU_ADDRESS 0x3FB640 /end MEASUREMENT
/begin MEASUREMENT dsp_d2p_b2.fbs "Energiespektrum." FLOAT32_IEEE FORMULA_0044 0 0.0 -3.402823466385289e+038 3.402823466385289e+038 READ_WRITE ECU_ADDRESS 0x3FB644 /end MEASUREMENT
/begin MEASUREMENT dsp_d2p_b2.lp_int_value "TP-Integral im Aussetzerfenster." SLONG FORMULA_0579 0 0.0 0.0 50.0 READ_WRITE ECU_ADDRESS 0x3FB628 /end MEASUREMENT
/begin MEASUREMENT dsp_d2p_b2.lp_samples "Laenge Aussetzerfenster." ULONG FORMULA_0578 0 0.0 0.0 24.576 READ_WRITE ECU_ADDRESS 0x3FB624 /end MEASUREMENT
/begin MEASUREMENT dsp_d2p_b2.min_avg_int "Minimalintegral im Aussetzerfenster." SLONG FORMULA_0579 0 0.0 0.0 50.0 READ_WRITE ECU_ADDRESS 0x3FB62C /end MEASUREMENT
/begin MEASUREMENT dsp_d2p_b2.min_avg_samples "Anzahl Messpunkte Minimalintegral." ULONG FORMULA_0578 0 0.0 0.0 24.576 READ_WRITE ECU_ADDRESS 0x3FB630 /end MEASUREMENT
/begin MEASUREMENT dsp_d2p_b2.ns_samples "Laenge Nebenschluss." ULONG FORMULA_0578 0 0.0 0.0 24.576 READ_WRITE ECU_ADDRESS 0x3FB620 /end MEASUREMENT
/begin MEASUREMENT dsp_d2p_b2.spark_time "Funkenbrenndauer." ULONG FORMULA_0578 0 0.0 0.0 24.576 READ_WRITE ECU_ADDRESS 0x3FB61C /end MEASUREMENT
/begin MEASUREMENT dsp_d2p_b2.vr_int_value "TP-Integral im Klopffenster." SLONG FORMULA_0579 0 0.0 0.0 50.0 READ_WRITE ECU_ADDRESS 0x3FB63C /end MEASUREMENT
/begin MEASUREMENT dsp_d2p_b2.vr_max_value "Maximalwert im Klopffenster." SLONG FORMULA_0580 0 0.0 0.0 3.3 READ_WRITE ECU_ADDRESS 0x3FB638 /end MEASUREMENT
/begin MEASUREMENT dsp_d2p_b2.vr_samples "Laenge Klopffenster." ULONG FORMULA_0578 0 0.0 0.0 24.576 READ_WRITE ECU_ADDRESS 0x3FB634 /end MEASUREMENT
/begin MEASUREMENT dsp_dma_st "DSP DMA status." UBYTE FORMULA_0575 0 0.0 0.0 255.0 READ_WRITE ECU_ADDRESS 0x3FB5A9 /end MEASUREMENT
/begin MEASUREMENT dsp_irq_cnt "DSP interrupt counter." UWORD FORMULA_0010 0 0.0 0.0 65535.0 READ_WRITE ECU_ADDRESS 0x3FB5B0 /end MEASUREMENT
/begin MEASUREMENT dsp_KWG.KWG "KWG,1,X, !!! Dummy not for Gredi !!!" SWORD FORMULA_0864 0 0.0 -50.0 60.0 READ_WRITE ECU_ADDRESS 0xC60CF0 /end MEASUREMENT
/begin MEASUREMENT dsp_load "DSP Lastanzeige." UWORD FORMULA_0577 0 0.0 0.0 100.0 READ_WRITE ECU_ADDRESS 0x3FB5AE /end MEASUREMENT
/begin MEASUREMENT dsp_MotDat.auss_erk_ns "Status Nebenschluss Zuendkerze,18,Y, !!! Dummy not for Gredi !!!" ULONG FORMULA_0847 0 0.0 0.0 4095.0 READ_WRITE ECU_ADDRESS 0xC60A64 /end MEASUREMENT
/begin MEASUREMENT dsp_MotDat.auss_erk_ns_zyl1 "Status Nebenschluss Zuendkerze 1,18,Y, !!! Dummy not for Gredi !!!" ULONG FORMULA_0848 0 0 0.0 255.0 READ_WRITE BIT_MASK 0x1 ECU_ADDRESS 0xC60A64 /end MEASUREMENT
/begin MEASUREMENT dsp_MotDat.auss_erk_ns_zyl10 "Status Nebenschluss Zuendkerze 10,18,Y, !!! Dummy not for Gredi !!!" ULONG FORMULA_0857 0 0 0.0 255.0 READ_WRITE BIT_MASK 0x200 ECU_ADDRESS 0xC60A64 /end MEASUREMENT
/begin MEASUREMENT dsp_MotDat.auss_erk_ns_zyl2 "Status Nebenschluss Zuendkerze 2,18,Y, !!! Dummy not for Gredi !!!" ULONG FORMULA_0849 0 0 0.0 255.0 READ_WRITE BIT_MASK 0x2 ECU_ADDRESS 0xC60A64 /end MEASUREMENT
/begin MEASUREMENT dsp_MotDat.auss_erk_ns_zyl3 "Status Nebenschluss Zuendkerze 3,18,Y, !!! Dummy not for Gredi !!!" ULONG FORMULA_0850 0 0 0.0 255.0 READ_WRITE BIT_MASK 0x4 ECU_ADDRESS 0xC60A64 /end MEASUREMENT
/begin MEASUREMENT dsp_MotDat.auss_erk_ns_zyl4 "Status Nebenschluss Zuendkerze 4,18,Y, !!! Dummy not for Gredi !!!" ULONG FORMULA_0851 0 0 0.0 255.0 READ_WRITE BIT_MASK 0x8 ECU_ADDRESS 0xC60A64 /end MEASUREMENT
/begin MEASUREMENT dsp_MotDat.auss_erk_ns_zyl5 "Status Nebenschluss Zuendkerze 5,18,Y, !!! Dummy not for Gredi !!!" ULONG FORMULA_0852 0 0 0.0 255.0 READ_WRITE BIT_MASK 0x10 ECU_ADDRESS 0xC60A64 /end MEASUREMENT
/begin MEASUREMENT dsp_MotDat.auss_erk_ns_zyl6 "Status Nebenschluss Zuendkerze 6,18,Y, !!! Dummy not for Gredi !!!" ULONG FORMULA_0853 0 0 0.0 255.0 READ_WRITE BIT_MASK 0x20 ECU_ADDRESS 0xC60A64 /end MEASUREMENT
/begin MEASUREMENT dsp_MotDat.auss_erk_ns_zyl7 "Status Nebenschluss Zuendkerze 7,18,Y, !!! Dummy not for Gredi !!!" ULONG FORMULA_0854 0 0 0.0 255.0 READ_WRITE BIT_MASK 0x40 ECU_ADDRESS 0xC60A64 /end MEASUREMENT
/begin MEASUREMENT dsp_MotDat.auss_erk_ns_zyl8 "Status Nebenschluss Zuendkerze 8,18,Y, !!! Dummy not for Gredi !!!" ULONG FORMULA_0855 0 0 0.0 255.0 READ_WRITE BIT_MASK 0x80 ECU_ADDRESS 0xC60A64 /end MEASUREMENT
/begin MEASUREMENT dsp_MotDat.auss_erk_ns_zyl9 "Status Nebenschluss Zuendkerze 9,18,Y, !!! Dummy not for Gredi !!!" ULONG FORMULA_0856 0 0 0.0 255.0 READ_WRITE BIT_MASK 0x100 ECU_ADDRESS 0xC60A64 /end MEASUREMENT
/begin MEASUREMENT dsp_MotDat.auss_erk_ti "Status Verbrennungsaussetzer,17,Y, !!! Dummy not for Gredi !!!" ULONG FORMULA_0836 0 0.0 0.0 4095.0 READ_WRITE ECU_ADDRESS 0xC60A60 /end MEASUREMENT
/begin MEASUREMENT dsp_MotDat.auss_erk_ti_zyl1 "Status Verbrennung Zylinder 1,17,Y, !!! Dummy not for Gredi !!!" ULONG FORMULA_0837 0 0 0.0 255.0 READ_WRITE BIT_MASK 0x1 ECU_ADDRESS 0xC60A60 /end MEASUREMENT
/begin MEASUREMENT dsp_MotDat.auss_erk_ti_zyl10 "Status Verbrennung Zylinder 10,17,Y, !!! Dummy not for Gredi !!!" ULONG FORMULA_0846 0 0 0.0 255.0 READ_WRITE BIT_MASK 0x200 ECU_ADDRESS 0xC60A60 /end MEASUREMENT
/begin MEASUREMENT dsp_MotDat.auss_erk_ti_zyl2 "Status Verbrennung Zylinder 2,17,Y, !!! Dummy not for Gredi !!!" ULONG FORMULA_0838 0 0 0.0 255.0 READ_WRITE BIT_MASK 0x2 ECU_ADDRESS 0xC60A60 /end MEASUREMENT
/begin MEASUREMENT dsp_MotDat.auss_erk_ti_zyl3 "Status Verbrennung Zylinder 3,17,Y, !!! Dummy not for Gredi !!!" ULONG FORMULA_0839 0 0 0.0 255.0 READ_WRITE BIT_MASK 0x4 ECU_ADDRESS 0xC60A60 /end MEASUREMENT
/begin MEASUREMENT dsp_MotDat.auss_erk_ti_zyl4 "Status Verbrennung Zylinder 4,17,Y, !!! Dummy not for Gredi !!!" ULONG FORMULA_0840 0 0 0.0 255.0 READ_WRITE BIT_MASK 0x8 ECU_ADDRESS 0xC60A60 /end MEASUREMENT
/begin MEASUREMENT dsp_MotDat.auss_erk_ti_zyl5 "Status Verbrennung Zylinder 5,17,Y, !!! Dummy not for Gredi !!!" ULONG FORMULA_0841 0 0 0.0 255.0 READ_WRITE BIT_MASK 0x10 ECU_ADDRESS 0xC60A60 /end MEASUREMENT
/begin MEASUREMENT dsp_MotDat.auss_erk_ti_zyl6 "Status Verbrennung Zylinder 6,17,Y, !!! Dummy not for Gredi !!!" ULONG FORMULA_0842 0 0 0.0 255.0 READ_WRITE BIT_MASK 0x20 ECU_ADDRESS 0xC60A60 /end MEASUREMENT
/begin MEASUREMENT dsp_MotDat.auss_erk_ti_zyl7 "Status Verbrennung Zylinder 7,17,Y, !!! Dummy not for Gredi !!!" ULONG FORMULA_0843 0 0 0.0 255.0 READ_WRITE BIT_MASK 0x40 ECU_ADDRESS 0xC60A60 /end MEASUREMENT
/begin MEASUREMENT dsp_MotDat.auss_erk_ti_zyl8 "Status Verbrennung Zylinder 8,17,Y, !!! Dummy not for Gredi !!!" ULONG FORMULA_0844 0 0 0.0 255.0 READ_WRITE BIT_MASK 0x80 ECU_ADDRESS 0xC60A60 /end MEASUREMENT
/begin MEASUREMENT dsp_MotDat.auss_erk_ti_zyl9 "Status Verbrennung Zylinder 9,17,Y, !!! Dummy not for Gredi !!!" ULONG FORMULA_0845 0 0 0.0 255.0 READ_WRITE BIT_MASK 0x100 ECU_ADDRESS 0xC60A60 /end MEASUREMENT
/begin MEASUREMENT dsp_MotDat.auss_erk_tz "Status Ausschwingen Zuendspule,16,Dummy not for Gredi !!!" ULONG FORMULA_0825 0 0.0 0.0 4095.0 READ_WRITE ECU_ADDRESS 0xC60A5C /end MEASUREMENT
/begin MEASUREMENT dsp_MotDat.auss_erk_tz_zyl1 "Status Ausschwingen Zuendspule 1,16,Y, !!! Dummy not for Gredi !!!" ULONG FORMULA_0826 0 0 0.0 255.0 READ_WRITE BIT_MASK 0x1 ECU_ADDRESS 0xC60A5C /end MEASUREMENT
/begin MEASUREMENT dsp_MotDat.auss_erk_tz_zyl10 "Status Ausschwingen Zuendspule 10,16,Y, !!! Dummy not for Gredi !!!" ULONG FORMULA_0835 0 0 0.0 255.0 READ_WRITE BIT_MASK 0x200 ECU_ADDRESS 0xC60A5C /end MEASUREMENT
/begin MEASUREMENT dsp_MotDat.auss_erk_tz_zyl2 "Status Ausschwingen Zuendspule 2,16,Y, !!! Dummy not for Gredi !!!" ULONG FORMULA_0827 0 0 0.0 255.0 READ_WRITE BIT_MASK 0x2 ECU_ADDRESS 0xC60A5C /end MEASUREMENT
/begin MEASUREMENT dsp_MotDat.auss_erk_tz_zyl3 "Status Ausschwingen Zuendspule 3,16,Y, !!! Dummy not for Gredi !!!" ULONG FORMULA_0828 0 0 0.0 255.0 READ_WRITE BIT_MASK 0x4 ECU_ADDRESS 0xC60A5C /end MEASUREMENT
/begin MEASUREMENT dsp_MotDat.auss_erk_tz_zyl4 "Status Ausschwingen Zuendspule 4,16,Y, !!! Dummy not for Gredi !!!" ULONG FORMULA_0829 0 0 0.0 255.0 READ_WRITE BIT_MASK 0x8 ECU_ADDRESS 0xC60A5C /end MEASUREMENT
/begin MEASUREMENT dsp_MotDat.auss_erk_tz_zyl5 "Status Ausschwingen Zuendspule 5,16,Y, !!! Dummy not for Gredi !!!" ULONG FORMULA_0830 0 0 0.0 255.0 READ_WRITE BIT_MASK 0x10 ECU_ADDRESS 0xC60A5C /end MEASUREMENT
/begin MEASUREMENT dsp_MotDat.auss_erk_tz_zyl6 "Status Ausschwingen Zuendspule 6,16,Y, !!! Dummy not for Gredi !!!" ULONG FORMULA_0831 0 0 0.0 255.0 READ_WRITE BIT_MASK 0x20 ECU_ADDRESS 0xC60A5C /end MEASUREMENT
/begin MEASUREMENT dsp_MotDat.auss_erk_tz_zyl7 "Status Ausschwingen Zuendspule 7,16,Y, !!! Dummy not for Gredi !!!" ULONG FORMULA_0832 0 0 0.0 255.0 READ_WRITE BIT_MASK 0x40 ECU_ADDRESS 0xC60A5C /end MEASUREMENT
/begin MEASUREMENT dsp_MotDat.auss_erk_tz_zyl8 "Status Ausschwingen Zuendspule 8,16,Y, !!! Dummy not for Gredi !!!" ULONG FORMULA_0833 0 0 0.0 255.0 READ_WRITE BIT_MASK 0x80 ECU_ADDRESS 0xC60A5C /end MEASUREMENT
/begin MEASUREMENT dsp_MotDat.auss_erk_tz_zyl9 "Status Ausschwingen Zuendspule 9,16,Y, !!! Dummy not for Gredi !!!" ULONG FORMULA_0834 0 0 0.0 255.0 READ_WRITE BIT_MASK 0x100 ECU_ADDRESS 0xC60A5C /end MEASUREMENT
/begin MEASUREMENT dsp_MotDat.auss_st_b1 "Zustand Aussetzererkennung B2.,12,Y, !!! Dummy not for Gredi !!!" ULONG FORMULA_0823 0 0.0 0.0 511.0 READ_WRITE ECU_ADDRESS 0xC60A4C /end MEASUREMENT
/begin MEASUREMENT dsp_MotDat.auss_st_b2 "Zustand Aussetzererkennung B2,13,Y, !!! Dummy not for Gredi !!!" ULONG FORMULA_0823 0 0.0 0.0 511.0 READ_WRITE ECU_ADDRESS 0xC60A50 /end MEASUREMENT
/begin MEASUREMENT dsp_MotDat.auss_st_ti_b1 "Zustandsvariable Verbrennungsaussetzererkennung,19,Y, !!! Dummy not for Gredi !!!" ULONG FORMULA_0858 0 0.0 0.0 511.0 READ_WRITE ECU_ADDRESS 0xC60A68 /end MEASUREMENT
/begin MEASUREMENT dsp_MotDat.auss_st_ti_b2 "Zustandsvariable Verbrennungsaussetzererkennung,20,Y, !!! Dummy not for Gredi !!!" ULONG FORMULA_0858 0 0.0 0.0 511.0 READ_WRITE ECU_ADDRESS 0xC60A6C /end MEASUREMENT
/begin MEASUREMENT dsp_MotDat.dr_rel_b1 "rel. Drosselung B1,6,Y, !!! Dummy not for Gredi !!!" SLONG FORMULA_0822 0 0.0 0.0 199.9938 READ_WRITE ECU_ADDRESS 0xC60A34 /end MEASUREMENT
/begin MEASUREMENT dsp_MotDat.dr_rel_b2 "rel. Drosselung B2,7,Y, !!! Dummy not for Gredi !!!" SLONG FORMULA_0822 0 0.0 0.0 199.9938 READ_WRITE ECU_ADDRESS 0xC60A38 /end MEASUREMENT
/begin MEASUREMENT dsp_MotDat.kr_asp_cnt "KR Arbeitsspielzaehler,14,Y, !!! Dummy not for Gredi !!!" ULONG FORMULA_0000 0 0.0 0.0 65535.0 READ_WRITE ECU_ADDRESS 0xC60A54 /end MEASUREMENT
/begin MEASUREMENT dsp_MotDat.kr_st "Status Klopfregelung,15,Y, !!! Dummy not for Gredi !!!" ULONG FORMULA_0824 0 0.0 0.0 255.0 READ_WRITE ECU_ADDRESS 0xC60A58 /end MEASUREMENT
/begin MEASUREMENT dsp_MotDat.lam_ist_mw_b1 "Mittelwert IST-Lambda B1,4,Y, !!! Dummy not for Gredi !!!" SLONG FORMULA_0821 0 0.0 0.0 3.999 READ_WRITE ECU_ADDRESS 0xC60A2C /end MEASUREMENT
/begin MEASUREMENT dsp_MotDat.lam_ist_mw_b2 "Mittelwert IST-Lambda B2,5,Y, !!! Dummy not for Gredi !!!" SLONG FORMULA_0821 0 0.0 0.0 3.999 READ_WRITE ECU_ADDRESS 0xC60A30 /end MEASUREMENT
/begin MEASUREMENT dsp_MotDat.n "n,0,Y, !!! Dummy not for Gredi !!!" SLONG FORMULA_0818 0 0.0 0.0 10000.0 READ_WRITE ECU_ADDRESS 0xC60A1C /end MEASUREMENT
/begin MEASUREMENT dsp_MotDat.rf_b1 "rf_b1,2,Y, !!! Dummy not for Gredi !!!" SLONG FORMULA_0820 0 0.0 0.0 2.0 READ_WRITE ECU_ADDRESS 0xC60A24 /end MEASUREMENT
/begin MEASUREMENT dsp_MotDat.rf_b2 "rf_b2,3,Y, !!! Dummy not for Gredi !!!" SLONG FORMULA_0820 0 0.0 0.0 2.0 READ_WRITE ECU_ADDRESS 0xC60A28 /end MEASUREMENT
/begin MEASUREMENT dsp_MotDat.van_ist_A1 "Vanos Ist A1,9,Y, !!! Dummy not for Gredi !!!" SLONG FORMULA_0226 0 0.0 50.0 160.0 READ_WRITE ECU_ADDRESS 0xC60A40 /end MEASUREMENT
/begin MEASUREMENT dsp_MotDat.van_ist_A2 "Vanos Ist A2,11,Y, !!! Dummy not for Gredi !!!" SLONG FORMULA_0226 0 0.0 50.0 160.0 READ_WRITE ECU_ADDRESS 0xC60A48 /end MEASUREMENT
/begin MEASUREMENT dsp_MotDat.van_ist_E1 "Vanos Ist E1,8,Y, !!! Dummy not for Gredi !!!" SLONG FORMULA_0226 0 0.0 50.0 160.0 READ_WRITE ECU_ADDRESS 0xC60A3C /end MEASUREMENT
/begin MEASUREMENT dsp_MotDat.van_ist_E2 "Vanos Ist E2,10,Y, !!! Dummy not for Gredi !!!" SLONG FORMULA_0226 0 0.0 50.0 160.0 READ_WRITE ECU_ADDRESS 0xC60A44 /end MEASUREMENT
/begin MEASUREMENT dsp_MotDat.zustand_motor "Zustand Motor,1,Y, !!! Dummy not for Gredi !!!" ULONG FORMULA_0819 0 0.0 0.0 4294967295.0 READ_WRITE ECU_ADDRESS 0xC60A20 /end MEASUREMENT
/begin MEASUREMENT dsp_msgr_0 "DSP Message Register." ULONG FORMULA_0000 0 0.0 0.0 4294967295.0 READ_WRITE ECU_ADDRESS 0x3FB5D0 /end MEASUREMENT
/begin MEASUREMENT dsp_msgr_1 "DSP Message Register." ULONG FORMULA_0000 0 0.0 0.0 4294967295.0 READ_WRITE ECU_ADDRESS 0x3FB5D4 /end MEASUREMENT
/begin MEASUREMENT dsp_msgr_2 "DSP Message Register." ULONG FORMULA_0000 0 0.0 0.0 4294967295.0 READ_WRITE ECU_ADDRESS 0x3FB5D8 /end MEASUREMENT
/begin MEASUREMENT dsp_msgr_3 "DSP Message Register." ULONG FORMULA_0000 0 0.0 0.0 4294967295.0 READ_WRITE ECU_ADDRESS 0x3FB5DC /end MEASUREMENT
/begin MEASUREMENT dsp_msgr_4 "DSP Message Register." ULONG FORMULA_0000 0 0.0 0.0 4294967295.0 READ_WRITE ECU_ADDRESS 0x3FB5E0 /end MEASUREMENT
/begin MEASUREMENT dsp_msgr_5 "DSP Message Register." ULONG FORMULA_0000 0 0.0 0.0 4294967295.0 READ_WRITE ECU_ADDRESS 0x3FB5E4 /end MEASUREMENT
/begin MEASUREMENT dsp_msgr_6 "DSP Message Register." ULONG FORMULA_0000 0 0.0 0.0 4294967295.0 READ_WRITE ECU_ADDRESS 0x3FB5E8 /end MEASUREMENT
/begin MEASUREMENT dsp_msgr_7 "DSP Message Register." ULONG FORMULA_0000 0 0.0 0.0 4294967295.0 READ_WRITE ECU_ADDRESS 0x3FB5EC /end MEASUREMENT
/begin MEASUREMENT dsp_stack_cnt_err "Fehlerzaehler Stack Fehlerzaehler." UBYTE FORMULA_0003 0 0.0 0.0 255.0 READ_WRITE ECU_ADDRESS 0x3FB5A7 /end MEASUREMENT
/begin MEASUREMENT dsp_stack_unused "DSP unused stack space counter." UWORD FORMULA_0010 0 0.0 0.0 65535.0 READ_WRITE ECU_ADDRESS 0x3FB5AC /end MEASUREMENT
/begin MEASUREMENT dsp_status "DSP status." UWORD FORMULA_0576 0 0.0 0.0 65535.0 READ_WRITE ECU_ADDRESS 0x3FB5AA /end MEASUREMENT
/begin MEASUREMENT dsp_zyl_err "Fehlerzaehler DSP Zylinderueberwachung." UBYTE FORMULA_0003 0 0.0 0.0 255.0 READ_WRITE ECU_ADDRESS 0x3FB5A8 /end MEASUREMENT
/begin MEASUREMENT dsp_zyl_st "Quitierung DSP Zylinderueberwachung." UWORD FORMULA_0010 0 0.0 0.0 65535.0 READ_WRITE ECU_ADDRESS 0x3FB5B2 /end MEASUREMENT
/begin MEASUREMENT dsp_zyl1 "DSP cylinder counter." UWORD FORMULA_0010 0 0.0 0.0 65535.0 READ_WRITE ECU_ADDRESS 0x3FB5BC /end MEASUREMENT
/begin MEASUREMENT dsp_zyl10 "DSP cylinder counter." UWORD FORMULA_0010 0 0.0 0.0 65535.0 READ_WRITE ECU_ADDRESS 0x3FB5CE /end MEASUREMENT
/begin MEASUREMENT dsp_zyl2 "DSP cylinder counter." UWORD FORMULA_0010 0 0.0 0.0 65535.0 READ_WRITE ECU_ADDRESS 0x3FB5BE /end MEASUREMENT
/begin MEASUREMENT dsp_zyl3 "DSP cylinder counter." UWORD FORMULA_0010 0 0.0 0.0 65535.0 READ_WRITE ECU_ADDRESS 0x3FB5C0 /end MEASUREMENT
/begin MEASUREMENT dsp_zyl4 "DSP cylinder counter." UWORD FORMULA_0010 0 0.0 0.0 65535.0 READ_WRITE ECU_ADDRESS 0x3FB5C2 /end MEASUREMENT
/begin MEASUREMENT dsp_zyl5 "DSP cylinder counter." UWORD FORMULA_0010 0 0.0 0.0 65535.0 READ_WRITE ECU_ADDRESS 0x3FB5C4 /end MEASUREMENT
/begin MEASUREMENT dsp_zyl6 "DSP cylinder counter." UWORD FORMULA_0010 0 0.0 0.0 65535.0 READ_WRITE ECU_ADDRESS 0x3FB5C6 /end MEASUREMENT
/begin MEASUREMENT dsp_zyl7 "DSP cylinder counter." UWORD FORMULA_0010 0 0.0 0.0 65535.0 READ_WRITE ECU_ADDRESS 0x3FB5C8 /end MEASUREMENT
/begin MEASUREMENT dsp_zyl8 "DSP cylinder counter." UWORD FORMULA_0010 0 0.0 0.0 65535.0 READ_WRITE ECU_ADDRESS 0x3FB5CA /end MEASUREMENT
/begin MEASUREMENT dsp_zyl9 "DSP cylinder counter." UWORD FORMULA_0010 0 0.0 0.0 65535.0 READ_WRITE ECU_ADDRESS 0x3FB5CC /end MEASUREMENT
/begin MEASUREMENT dsp_ZylDat_zyl1.auss_spark_time "Funkenbrenndauer,13,Y, !!! Dummy not for Gredi !!!" ULONG FORMULA_0017 0 0.0 0.0 4.681 READ_WRITE ECU_ADDRESS 0xC60AA4 /end MEASUREMENT
/begin MEASUREMENT dsp_ZylDat_zyl1.dsp_cam_cycle_cnt "DFT Spannungsspektrum,8,Y, !!! Dummy not for Gredi !!!" ULONG FORMULA_0044 0 0.0 0.0 4294967295.0 READ_WRITE ECU_ADDRESS 0xC60A94 /end MEASUREMENT
/begin MEASUREMENT dsp_ZylDat_zyl1.dsp_fbs "DFT Energiespektrum,8,Y, !!! Dummy not for Gredi !!!" FLOAT32_IEEE FORMULA_0044 0 0.0 -3.402823466385289e+038 3.402823466385289e+038 READ_WRITE ECU_ADDRESS 0xC60A90 /end MEASUREMENT
/begin MEASUREMENT dsp_ZylDat_zyl1.dsp_lp_int_value "TP-Integral im Aussetzerfenster,4,Y, !!! Dummy not for Gredi !!!" SLONG FORMULA_0579 0 0.0 0.0 50.0 READ_WRITE ECU_ADDRESS 0xC60A80 /end MEASUREMENT
/begin MEASUREMENT dsp_ZylDat_zyl1.dsp_lp_length "Aussetzerfenster Länge,2,Y, !!! Dummy not for Gredi !!!" ULONG FORMULA_0578 0 0.0 0.0 24.576 READ_WRITE ECU_ADDRESS 0xC60A78 /end MEASUREMENT
/begin MEASUREMENT dsp_ZylDat_zyl1.dsp_lp_start "DSP Start Aussetzerfenster,1,Y, !!! Dummy not for Gredi !!!" ULONG FORMULA_0578 0 0.0 0.0 24.576 READ_WRITE ECU_ADDRESS 0xC60A74 /end MEASUREMENT
/begin MEASUREMENT dsp_ZylDat_zyl1.dsp_min_avg_int "Minimalintegral im Aussetzerfenster,3,Y, !!! Dummy not for Gredi !!!" SLONG FORMULA_0579 0 0.0 0.0 50.0 READ_WRITE ECU_ADDRESS 0xC60A7C /end MEASUREMENT
/begin MEASUREMENT dsp_ZylDat_zyl1.dsp_vr_length "Klopffenster Länge,6,Y, !!! Dummy not for Gredi !!!" ULONG FORMULA_0578 0 0.0 0.0 24.576 READ_WRITE ECU_ADDRESS 0xC60A88 /end MEASUREMENT
/begin MEASUREMENT dsp_ZylDat_zyl1.dsp_vr_max_value "Maximalwert im Klopffenster,7,Y, !!! Dummy not for Gredi !!!" SLONG FORMULA_0580 0 0.0 0.0 3.3 READ_WRITE ECU_ADDRESS 0xC60A8C /end MEASUREMENT
/begin MEASUREMENT dsp_ZylDat_zyl1.dsp_vr_start "Start Klopffenster,5,Y, !!! Dummy not for Gredi !!!" ULONG FORMULA_0578 0 0.0 0.0 24.576 READ_WRITE ECU_ADDRESS 0xC60A84 /end MEASUREMENT
/begin MEASUREMENT dsp_ZylDat_zyl1.kr_dtz "Klopfreglungseingriff,11,Y, !!! Dummy not for Gredi !!!" SLONG FORMULA_0226 0 0.0 -50.0 60.0 READ_WRITE ECU_ADDRESS 0xC60A9C /end MEASUREMENT
/begin MEASUREMENT dsp_ZylDat_zyl1.kr_st_erk "Status Klopferkennung,10,Y, !!! Dummy not for Gredi !!!" ULONG FORMULA_0860 0 0 0.0 255.0 READ_WRITE BIT_MASK 0x1 ECU_ADDRESS 0xC60A98 /end MEASUREMENT
/begin MEASUREMENT dsp_ZylDat_zyl1.min_avg_samples "Anzahl Messpunkte Minimalintegral,14,Y, !!! Dummy not for Gredi !!!" ULONG FORMULA_0578 0 0.0 0.0 24.576 READ_WRITE ECU_ADDRESS 0xC60AA8 /end MEASUREMENT
/begin MEASUREMENT dsp_ZylDat_zyl1.tz "Zündwinkel,0,Y, !!! Dummy not for Gredi !!!" SLONG FORMULA_0859 0 0.0 -50.0 60.0 READ_WRITE ECU_ADDRESS 0xC60A70 /end MEASUREMENT
/begin MEASUREMENT dsp_ZylDat_zyl1.vr_mess "Istverstaerkung,12,Y, !!! Dummy not for Gredi !!!" SLONG FORMULA_0861 0 0.0 0.0 32.0 READ_WRITE ECU_ADDRESS 0xC60AA0 /end MEASUREMENT
/begin MEASUREMENT dsp_ZylDat_zyl10.auss_spark_time "Funkenbrenndauer,13,Y, !!! Dummy not for Gredi !!!" ULONG FORMULA_0017 0 0.0 0.0 4.681 READ_WRITE ECU_ADDRESS 0xC60CC0 /end MEASUREMENT
/begin MEASUREMENT dsp_ZylDat_zyl10.dsp_cam_cycle_cnt "DFT Spannungsspektrum,8,Y, !!! Dummy not for Gredi !!!" ULONG FORMULA_0044 0 0.0 0.0 4294967295.0 READ_WRITE ECU_ADDRESS 0xC60CB0 /end MEASUREMENT
/begin MEASUREMENT dsp_ZylDat_zyl10.dsp_fbs "DFT Energiespektrum,8,Y, !!! Dummy not for Gredi !!!" FLOAT32_IEEE FORMULA_0044 0 0.0 -3.402823466385289e+038 3.402823466385289e+038 READ_WRITE ECU_ADDRESS 0xC60CAC /end MEASUREMENT
/begin MEASUREMENT dsp_ZylDat_zyl10.dsp_lp_int_value "TP-Integral im Aussetzerfenster,4,Y, !!! Dummy not for Gredi !!!" SLONG FORMULA_0579 0 0.0 0.0 50.0 READ_WRITE ECU_ADDRESS 0xC60C9C /end MEASUREMENT
/begin MEASUREMENT dsp_ZylDat_zyl10.dsp_lp_length "Aussetzerfenster Länge,2,Y, !!! Dummy not for Gredi !!!" ULONG FORMULA_0578 0 0.0 0.0 24.576 READ_WRITE ECU_ADDRESS 0xC60C94 /end MEASUREMENT
/begin MEASUREMENT dsp_ZylDat_zyl10.dsp_lp_start "DSP Start Aussetzerfenster,1,Y, !!! Dummy not for Gredi !!!" ULONG FORMULA_0578 0 0.0 0.0 24.576 READ_WRITE ECU_ADDRESS 0xC60C90 /end MEASUREMENT
/begin MEASUREMENT dsp_ZylDat_zyl10.dsp_min_avg_int "Minimalintegral im Aussetzerfenster,3,Y, !!! Dummy not for Gredi !!!" SLONG FORMULA_0579 0 0.0 0.0 50.0 READ_WRITE ECU_ADDRESS 0xC60C98 /end MEASUREMENT
/begin MEASUREMENT dsp_ZylDat_zyl10.dsp_vr_length "Klopffenster Länge,6,Y, !!! Dummy not for Gredi !!!" ULONG FORMULA_0578 0 0.0 0.0 24.576 READ_WRITE ECU_ADDRESS 0xC60CA4 /end MEASUREMENT
/begin MEASUREMENT dsp_ZylDat_zyl10.dsp_vr_max_value "Maximalwert im Klopffenster,7,Y, !!! Dummy not for Gredi !!!" SLONG FORMULA_0580 0 0.0 0.0 3.3 READ_WRITE ECU_ADDRESS 0xC60CA8 /end MEASUREMENT
/begin MEASUREMENT dsp_ZylDat_zyl10.dsp_vr_start "Start Klopffenster,5,Y, !!! Dummy not for Gredi !!!" ULONG FORMULA_0578 0 0.0 0.0 24.576 READ_WRITE ECU_ADDRESS 0xC60CA0 /end MEASUREMENT
/begin MEASUREMENT dsp_ZylDat_zyl10.kr_dtz "Klopfreglungseingriff,11,Y, !!! Dummy not for Gredi !!!" SLONG FORMULA_0226 0 0.0 -50.0 60.0 READ_WRITE ECU_ADDRESS 0xC60CB8 /end MEASUREMENT
/begin MEASUREMENT dsp_ZylDat_zyl10.kr_st_erk "Status Klopferkennung,10,Y, !!! Dummy not for Gredi !!!" ULONG FORMULA_0860 0 0 0.0 255.0 READ_WRITE BIT_MASK 0x1 ECU_ADDRESS 0xC60CB4 /end MEASUREMENT
/begin MEASUREMENT dsp_ZylDat_zyl10.min_avg_samples "Anzahl Messpunkte Minimalintegral,14,Y, !!! Dummy not for Gredi !!!" ULONG FORMULA_0578 0 0.0 0.0 24.576 READ_WRITE ECU_ADDRESS 0xC60CC4 /end MEASUREMENT
/begin MEASUREMENT dsp_ZylDat_zyl10.tz "Zündwinkel,0,Y, !!! Dummy not for Gredi !!!" SLONG FORMULA_0859 0 0.0 -50.0 60.0 READ_WRITE ECU_ADDRESS 0xC60C8C /end MEASUREMENT
/begin MEASUREMENT dsp_ZylDat_zyl10.vr_mess "Istverstaerkung,12,Y, !!! Dummy not for Gredi !!!" SLONG FORMULA_0861 0 0.0 0.0 32.0 READ_WRITE ECU_ADDRESS 0xC60CBC /end MEASUREMENT
/begin MEASUREMENT dsp_ZylDat_zyl2.auss_spark_time "Funkenbrenndauer,13,Y, !!! Dummy not for Gredi !!!" ULONG FORMULA_0017 0 0.0 0.0 4.681 READ_WRITE ECU_ADDRESS 0xC60AE0 /end MEASUREMENT
/begin MEASUREMENT dsp_ZylDat_zyl2.dsp_cam_cycle_cnt "DFT Spannungsspektrum,8,Y, !!! Dummy not for Gredi !!!" ULONG FORMULA_0044 0 0.0 0.0 4294967295.0 READ_WRITE ECU_ADDRESS 0xC60AD0 /end MEASUREMENT
/begin MEASUREMENT dsp_ZylDat_zyl2.dsp_fbs "DFT Energiespektrum,8,Y, !!! Dummy not for Gredi !!!" FLOAT32_IEEE FORMULA_0044 0 0.0 -3.402823466385289e+038 3.402823466385289e+038 READ_WRITE ECU_ADDRESS 0xC60ACC /end MEASUREMENT
/begin MEASUREMENT dsp_ZylDat_zyl2.dsp_lp_int_value "TP-Integral im Aussetzerfenster,4,Y, !!! Dummy not for Gredi !!!" SLONG FORMULA_0579 0 0.0 0.0 50.0 READ_WRITE ECU_ADDRESS 0xC60ABC /end MEASUREMENT
/begin MEASUREMENT dsp_ZylDat_zyl2.dsp_lp_length "Aussetzerfenster Länge,2,Y, !!! Dummy not for Gredi !!!" ULONG FORMULA_0578 0 0.0 0.0 24.576 READ_WRITE ECU_ADDRESS 0xC60AB4 /end MEASUREMENT
/begin MEASUREMENT dsp_ZylDat_zyl2.dsp_lp_start "DSP Start Aussetzerfenster,1,Y, !!! Dummy not for Gredi !!!" ULONG FORMULA_0578 0 0.0 0.0 24.576 READ_WRITE ECU_ADDRESS 0xC60AB0 /end MEASUREMENT
/begin MEASUREMENT dsp_ZylDat_zyl2.dsp_min_avg_int "Minimalintegral im Aussetzerfenster,3,Y, !!! Dummy not for Gredi !!!" SLONG FORMULA_0579 0 0.0 0.0 50.0 READ_WRITE ECU_ADDRESS 0xC60AB8 /end MEASUREMENT
/begin MEASUREMENT dsp_ZylDat_zyl2.dsp_vr_length "Klopffenster Länge,6,Y, !!! Dummy not for Gredi !!!" ULONG FORMULA_0578 0 0.0 0.0 24.576 READ_WRITE ECU_ADDRESS 0xC60AC4 /end MEASUREMENT
/begin MEASUREMENT dsp_ZylDat_zyl2.dsp_vr_max_value "Maximalwert im Klopffenster,7,Y, !!! Dummy not for Gredi !!!" SLONG FORMULA_0580 0 0.0 0.0 3.3 READ_WRITE ECU_ADDRESS 0xC60AC8 /end MEASUREMENT
/begin MEASUREMENT dsp_ZylDat_zyl2.dsp_vr_start "Start Klopffenster,5,Y, !!! Dummy not for Gredi !!!" ULONG FORMULA_0578 0 0.0 0.0 24.576 READ_WRITE ECU_ADDRESS 0xC60AC0 /end MEASUREMENT
/begin MEASUREMENT dsp_ZylDat_zyl2.kr_dtz "Klopfreglungseingriff,11,Y, !!! Dummy not for Gredi !!!" SLONG FORMULA_0226 0 0.0 -50.0 60.0 READ_WRITE ECU_ADDRESS 0xC60AD8 /end MEASUREMENT
/begin MEASUREMENT dsp_ZylDat_zyl2.kr_st_erk "Status Klopferkennung,10,Y, !!! Dummy not for Gredi !!!" ULONG FORMULA_0860 0 0 0.0 255.0 READ_WRITE BIT_MASK 0x1 ECU_ADDRESS 0xC60AD4 /end MEASUREMENT
/begin MEASUREMENT dsp_ZylDat_zyl2.min_avg_samples "Anzahl Messpunkte Minimalintegral,14,Y, !!! Dummy not for Gredi !!!" ULONG FORMULA_0578 0 0.0 0.0 24.576 READ_WRITE ECU_ADDRESS 0xC60AE4 /end MEASUREMENT
/begin MEASUREMENT dsp_ZylDat_zyl2.tz "Zündwinkel,0,Y, !!! Dummy not for Gredi !!!" SLONG FORMULA_0859 0 0.0 -50.0 60.0 READ_WRITE ECU_ADDRESS 0xC60AAC /end MEASUREMENT
/begin MEASUREMENT dsp_ZylDat_zyl2.vr_mess "Istverstaerkung,12,Y, !!! Dummy not for Gredi !!!" SLONG FORMULA_0861 0 0.0 0.0 32.0 READ_WRITE ECU_ADDRESS 0xC60ADC /end MEASUREMENT
/begin MEASUREMENT dsp_ZylDat_zyl3.auss_spark_time "Funkenbrenndauer,13,Y, !!! Dummy not for Gredi !!!" ULONG FORMULA_0017 0 0.0 0.0 4.681 READ_WRITE ECU_ADDRESS 0xC60B1C /end MEASUREMENT
/begin MEASUREMENT dsp_ZylDat_zyl3.dsp_cam_cycle_cnt "DFT Spannungsspektrum,8,Y, !!! Dummy not for Gredi !!!" ULONG FORMULA_0044 0 0.0 0.0 4294967295.0 READ_WRITE ECU_ADDRESS 0xC60B0C /end MEASUREMENT
/begin MEASUREMENT dsp_ZylDat_zyl3.dsp_fbs "DFT Energiespektrum,8,Y, !!! Dummy not for Gredi !!!" FLOAT32_IEEE FORMULA_0044 0 0.0 -3.402823466385289e+038 3.402823466385289e+038 READ_WRITE ECU_ADDRESS 0xC60B08 /end MEASUREMENT
/begin MEASUREMENT dsp_ZylDat_zyl3.dsp_lp_int_value "TP-Integral im Aussetzerfenster,4,Y, !!! Dummy not for Gredi !!!" SLONG FORMULA_0579 0 0.0 0.0 50.0 READ_WRITE ECU_ADDRESS 0xC60AF8 /end MEASUREMENT
/begin MEASUREMENT dsp_ZylDat_zyl3.dsp_lp_length "Aussetzerfenster Länge,2,Y, !!! Dummy not for Gredi !!!" ULONG FORMULA_0578 0 0.0 0.0 24.576 READ_WRITE ECU_ADDRESS 0xC60AF0 /end MEASUREMENT
/begin MEASUREMENT dsp_ZylDat_zyl3.dsp_lp_start "DSP Start Aussetzerfenster,1,Y, !!! Dummy not for Gredi !!!" ULONG FORMULA_0578 0 0.0 0.0 24.576 READ_WRITE ECU_ADDRESS 0xC60AEC /end MEASUREMENT
/begin MEASUREMENT dsp_ZylDat_zyl3.dsp_min_avg_int "Minimalintegral im Aussetzerfenster,3,Y, !!! Dummy not for Gredi !!!" SLONG FORMULA_0579 0 0.0 0.0 50.0 READ_WRITE ECU_ADDRESS 0xC60AF4 /end MEASUREMENT
/begin MEASUREMENT dsp_ZylDat_zyl3.dsp_vr_length "Klopffenster Länge,6,Y, !!! Dummy not for Gredi !!!" ULONG FORMULA_0578 0 0.0 0.0 24.576 READ_WRITE ECU_ADDRESS 0xC60B00 /end MEASUREMENT
/begin MEASUREMENT dsp_ZylDat_zyl3.dsp_vr_max_value "Maximalwert im Klopffenster,7,Y, !!! Dummy not for Gredi !!!" SLONG FORMULA_0580 0 0.0 0.0 3.3 READ_WRITE ECU_ADDRESS 0xC60B04 /end MEASUREMENT
/begin MEASUREMENT dsp_ZylDat_zyl3.dsp_vr_start "Start Klopffenster,5,Y, !!! Dummy not for Gredi !!!" ULONG FORMULA_0578 0 0.0 0.0 24.576 READ_WRITE ECU_ADDRESS 0xC60AFC /end MEASUREMENT
/begin MEASUREMENT dsp_ZylDat_zyl3.kr_dtz "Klopfreglungseingriff,11,Y, !!! Dummy not for Gredi !!!" SLONG FORMULA_0226 0 0.0 -50.0 60.0 READ_WRITE ECU_ADDRESS 0xC60B14 /end MEASUREMENT
/begin MEASUREMENT dsp_ZylDat_zyl3.kr_st_erk "Status Klopferkennung,10,Y, !!! Dummy not for Gredi !!!" ULONG FORMULA_0860 0 0 0.0 255.0 READ_WRITE BIT_MASK 0x1 ECU_ADDRESS 0xC60B10 /end MEASUREMENT
/begin MEASUREMENT dsp_ZylDat_zyl3.min_avg_samples "Anzahl Messpunkte Minimalintegral,14,Y, !!! Dummy not for Gredi !!!" ULONG FORMULA_0578 0 0.0 0.0 24.576 READ_WRITE ECU_ADDRESS 0xC60B20 /end MEASUREMENT
/begin MEASUREMENT dsp_ZylDat_zyl3.tz "Zündwinkel,0,Y, !!! Dummy not for Gredi !!!" SLONG FORMULA_0859 0 0.0 -50.0 60.0 READ_WRITE ECU_ADDRESS 0xC60AE8 /end MEASUREMENT
/begin MEASUREMENT dsp_ZylDat_zyl3.vr_mess "Istverstaerkung,12,Y, !!! Dummy not for Gredi !!!" SLONG FORMULA_0861 0 0.0 0.0 32.0 READ_WRITE ECU_ADDRESS 0xC60B18 /end MEASUREMENT
/begin MEASUREMENT dsp_ZylDat_zyl4.auss_spark_time "Funkenbrenndauer,13,Y, !!! Dummy not for Gredi !!!" ULONG FORMULA_0017 0 0.0 0.0 4.681 READ_WRITE ECU_ADDRESS 0xC60B58 /end MEASUREMENT
/begin MEASUREMENT dsp_ZylDat_zyl4.dsp_cam_cycle_cnt "DFT Spannungsspektrum,8,Y, !!! Dummy not for Gredi !!!" ULONG FORMULA_0044 0 0.0 0.0 4294967295.0 READ_WRITE ECU_ADDRESS 0xC60B48 /end MEASUREMENT
/begin MEASUREMENT dsp_ZylDat_zyl4.dsp_fbs "DFT Energiespektrum,8,Y, !!! Dummy not for Gredi !!!" FLOAT32_IEEE FORMULA_0044 0 0.0 -3.402823466385289e+038 3.402823466385289e+038 READ_WRITE ECU_ADDRESS 0xC60B44 /end MEASUREMENT
/begin MEASUREMENT dsp_ZylDat_zyl4.dsp_lp_int_value "TP-Integral im Aussetzerfenster,4,Y, !!! Dummy not for Gredi !!!" SLONG FORMULA_0579 0 0.0 0.0 50.0 READ_WRITE ECU_ADDRESS 0xC60B34 /end MEASUREMENT
/begin MEASUREMENT dsp_ZylDat_zyl4.dsp_lp_length "Aussetzerfenster Länge,2,Y, !!! Dummy not for Gredi !!!" ULONG FORMULA_0578 0 0.0 0.0 24.576 READ_WRITE ECU_ADDRESS 0xC60B2C /end MEASUREMENT
/begin MEASUREMENT dsp_ZylDat_zyl4.dsp_lp_start "DSP Start Aussetzerfenster,1,Y, !!! Dummy not for Gredi !!!" ULONG FORMULA_0578 0 0.0 0.0 24.576 READ_WRITE ECU_ADDRESS 0xC60B28 /end MEASUREMENT
/begin MEASUREMENT dsp_ZylDat_zyl4.dsp_min_avg_int "Minimalintegral im Aussetzerfenster,3,Y, !!! Dummy not for Gredi !!!" SLONG FORMULA_0579 0 0.0 0.0 50.0 READ_WRITE ECU_ADDRESS 0xC60B30 /end MEASUREMENT
/begin MEASUREMENT dsp_ZylDat_zyl4.dsp_vr_length "Klopffenster Länge,6,Y, !!! Dummy not for Gredi !!!" ULONG FORMULA_0578 0 0.0 0.0 24.576 READ_WRITE ECU_ADDRESS 0xC60B3C /end MEASUREMENT
/begin MEASUREMENT dsp_ZylDat_zyl4.dsp_vr_max_value "Maximalwert im Klopffenster,7,Y, !!! Dummy not for Gredi !!!" SLONG FORMULA_0580 0 0.0 0.0 3.3 READ_WRITE ECU_ADDRESS 0xC60B40 /end MEASUREMENT
/begin MEASUREMENT dsp_ZylDat_zyl4.dsp_vr_start "Start Klopffenster,5,Y, !!! Dummy not for Gredi !!!" ULONG FORMULA_0578 0 0.0 0.0 24.576 READ_WRITE ECU_ADDRESS 0xC60B38 /end MEASUREMENT
/begin MEASUREMENT dsp_ZylDat_zyl4.kr_dtz "Klopfreglungseingriff,11,Y, !!! Dummy not for Gredi !!!" SLONG FORMULA_0226 0 0.0 -50.0 60.0 READ_WRITE ECU_ADDRESS 0xC60B50 /end MEASUREMENT
/begin MEASUREMENT dsp_ZylDat_zyl4.kr_st_erk "Status Klopferkennung,10,Y, !!! Dummy not for Gredi !!!" ULONG FORMULA_0860 0 0 0.0 255.0 READ_WRITE BIT_MASK 0x1 ECU_ADDRESS 0xC60B4C /end MEASUREMENT
/begin MEASUREMENT dsp_ZylDat_zyl4.min_avg_samples "Anzahl Messpunkte Minimalintegral,14,Y, !!! Dummy not for Gredi !!!" ULONG FORMULA_0578 0 0.0 0.0 24.576 READ_WRITE ECU_ADDRESS 0xC60B5C /end MEASUREMENT
/begin MEASUREMENT dsp_ZylDat_zyl4.tz "Zündwinkel,0,Y, !!! Dummy not for Gredi !!!" SLONG FORMULA_0859 0 0.0 -50.0 60.0 READ_WRITE ECU_ADDRESS 0xC60B24 /end MEASUREMENT
/begin MEASUREMENT dsp_ZylDat_zyl4.vr_mess "Istverstaerkung,12,Y, !!! Dummy not for Gredi !!!" SLONG FORMULA_0861 0 0.0 0.0 32.0 READ_WRITE ECU_ADDRESS 0xC60B54 /end MEASUREMENT
/begin MEASUREMENT dsp_ZylDat_zyl5.auss_spark_time "Funkenbrenndauer,13,Y, !!! Dummy not for Gredi !!!" ULONG FORMULA_0017 0 0.0 0.0 4.681 READ_WRITE ECU_ADDRESS 0xC60B94 /end MEASUREMENT
/begin MEASUREMENT dsp_ZylDat_zyl5.dsp_cam_cycle_cnt "DFT Spannungsspektrum,8,Y, !!! Dummy not for Gredi !!!" ULONG FORMULA_0044 0 0.0 0.0 4294967295.0 READ_WRITE ECU_ADDRESS 0xC60B84 /end MEASUREMENT
/begin MEASUREMENT dsp_ZylDat_zyl5.dsp_fbs "DFT Energiespektrum,8,Y, !!! Dummy not for Gredi !!!" FLOAT32_IEEE FORMULA_0044 0 0.0 -3.402823466385289e+038 3.402823466385289e+038 READ_WRITE ECU_ADDRESS 0xC60B80 /end MEASUREMENT
/begin MEASUREMENT dsp_ZylDat_zyl5.dsp_lp_int_value "TP-Integral im Aussetzerfenster,4,Y, !!! Dummy not for Gredi !!!" SLONG FORMULA_0579 0 0.0 0.0 50.0 READ_WRITE ECU_ADDRESS 0xC60B70 /end MEASUREMENT
/begin MEASUREMENT dsp_ZylDat_zyl5.dsp_lp_length "Aussetzerfenster Länge,2,Y, !!! Dummy not for Gredi !!!" ULONG FORMULA_0578 0 0.0 0.0 24.576 READ_WRITE ECU_ADDRESS 0xC60B68 /end MEASUREMENT
/begin MEASUREMENT dsp_ZylDat_zyl5.dsp_lp_start "DSP Start Aussetzerfenster,1,Y, !!! Dummy not for Gredi !!!" ULONG FORMULA_0578 0 0.0 0.0 24.576 READ_WRITE ECU_ADDRESS 0xC60B64 /end MEASUREMENT
/begin MEASUREMENT dsp_ZylDat_zyl5.dsp_min_avg_int "Minimalintegral im Aussetzerfenster,3,Y, !!! Dummy not for Gredi !!!" SLONG FORMULA_0579 0 0.0 0.0 50.0 READ_WRITE ECU_ADDRESS 0xC60B6C /end MEASUREMENT
/begin MEASUREMENT dsp_ZylDat_zyl5.dsp_vr_length "Klopffenster Länge,6,Y, !!! Dummy not for Gredi !!!" ULONG FORMULA_0578 0 0.0 0.0 24.576 READ_WRITE ECU_ADDRESS 0xC60B78 /end MEASUREMENT
/begin MEASUREMENT dsp_ZylDat_zyl5.dsp_vr_max_value "Maximalwert im Klopffenster,7,Y, !!! Dummy not for Gredi !!!" SLONG FORMULA_0580 0 0.0 0.0 3.3 READ_WRITE ECU_ADDRESS 0xC60B7C /end MEASUREMENT
/begin MEASUREMENT dsp_ZylDat_zyl5.dsp_vr_start "Start Klopffenster,5,Y, !!! Dummy not for Gredi !!!" ULONG FORMULA_0578 0 0.0 0.0 24.576 READ_WRITE ECU_ADDRESS 0xC60B74 /end MEASUREMENT
/begin MEASUREMENT dsp_ZylDat_zyl5.kr_dtz "Klopfreglungseingriff,11,Y, !!! Dummy not for Gredi !!!" SLONG FORMULA_0226 0 0.0 -50.0 60.0 READ_WRITE ECU_ADDRESS 0xC60B8C /end MEASUREMENT
/begin MEASUREMENT dsp_ZylDat_zyl5.kr_st_erk "Status Klopferkennung,10,Y, !!! Dummy not for Gredi !!!" ULONG FORMULA_0860 0 0 0.0 255.0 READ_WRITE BIT_MASK 0x1 ECU_ADDRESS 0xC60B88 /end MEASUREMENT
/begin MEASUREMENT dsp_ZylDat_zyl5.min_avg_samples "Anzahl Messpunkte Minimalintegral,14,Y, !!! Dummy not for Gredi !!!" ULONG FORMULA_0578 0 0.0 0.0 24.576 READ_WRITE ECU_ADDRESS 0xC60B98 /end MEASUREMENT
/begin MEASUREMENT dsp_ZylDat_zyl5.tz "Zündwinkel,0,Y, !!! Dummy not for Gredi !!!" SLONG FORMULA_0859 0 0.0 -50.0 60.0 READ_WRITE ECU_ADDRESS 0xC60B60 /end MEASUREMENT
/begin MEASUREMENT dsp_ZylDat_zyl5.vr_mess "Istverstaerkung,12,Y, !!! Dummy not for Gredi !!!" SLONG FORMULA_0861 0 0.0 0.0 32.0 READ_WRITE ECU_ADDRESS 0xC60B90 /end MEASUREMENT
/begin MEASUREMENT dsp_ZylDat_zyl6.auss_spark_time "Funkenbrenndauer,13,Y, !!! Dummy not for Gredi !!!" ULONG FORMULA_0017 0 0.0 0.0 4.681 READ_WRITE ECU_ADDRESS 0xC60BD0 /end MEASUREMENT
/begin MEASUREMENT dsp_ZylDat_zyl6.dsp_cam_cycle_cnt "DFT Spannungsspektrum,8,Y, !!! Dummy not for Gredi !!!" ULONG FORMULA_0044 0 0.0 0.0 4294967295.0 READ_WRITE ECU_ADDRESS 0xC60BC0 /end MEASUREMENT
/begin MEASUREMENT dsp_ZylDat_zyl6.dsp_fbs "DFT Energiespektrum,8,Y, !!! Dummy not for Gredi !!!" FLOAT32_IEEE FORMULA_0044 0 0.0 -3.402823466385289e+038 3.402823466385289e+038 READ_WRITE ECU_ADDRESS 0xC60BBC /end MEASUREMENT
/begin MEASUREMENT dsp_ZylDat_zyl6.dsp_lp_int_value "TP-Integral im Aussetzerfenster,4,Y, !!! Dummy not for Gredi !!!" SLONG FORMULA_0579 0 0.0 0.0 50.0 READ_WRITE ECU_ADDRESS 0xC60BAC /end MEASUREMENT
/begin MEASUREMENT dsp_ZylDat_zyl6.dsp_lp_length "Aussetzerfenster Länge,2,Y, !!! Dummy not for Gredi !!!" ULONG FORMULA_0578 0 0.0 0.0 24.576 READ_WRITE ECU_ADDRESS 0xC60BA4 /end MEASUREMENT
/begin MEASUREMENT dsp_ZylDat_zyl6.dsp_lp_start "DSP Start Aussetzerfenster,1,Y, !!! Dummy not for Gredi !!!" ULONG FORMULA_0578 0 0.0 0.0 24.576 READ_WRITE ECU_ADDRESS 0xC60BA0 /end MEASUREMENT
/begin MEASUREMENT dsp_ZylDat_zyl6.dsp_min_avg_int "Minimalintegral im Aussetzerfenster,3,Y, !!! Dummy not for Gredi !!!" SLONG FORMULA_0579 0 0.0 0.0 50.0 READ_WRITE ECU_ADDRESS 0xC60BA8 /end MEASUREMENT
/begin MEASUREMENT dsp_ZylDat_zyl6.dsp_vr_length "Klopffenster Länge,6,Y, !!! Dummy not for Gredi !!!" ULONG FORMULA_0578 0 0.0 0.0 24.576 READ_WRITE ECU_ADDRESS 0xC60BB4 /end MEASUREMENT
/begin MEASUREMENT dsp_ZylDat_zyl6.dsp_vr_max_value "Maximalwert im Klopffenster,7,Y, !!! Dummy not for Gredi !!!" SLONG FORMULA_0580 0 0.0 0.0 3.3 READ_WRITE ECU_ADDRESS 0xC60BB8 /end MEASUREMENT
/begin MEASUREMENT dsp_ZylDat_zyl6.dsp_vr_start "Start Klopffenster,5,Y, !!! Dummy not for Gredi !!!" ULONG FORMULA_0578 0 0.0 0.0 24.576 READ_WRITE ECU_ADDRESS 0xC60BB0 /end MEASUREMENT
/begin MEASUREMENT dsp_ZylDat_zyl6.kr_dtz "Klopfreglungseingriff,11,Y, !!! Dummy not for Gredi !!!" SLONG FORMULA_0226 0 0.0 -50.0 60.0 READ_WRITE ECU_ADDRESS 0xC60BC8 /end MEASUREMENT
/begin MEASUREMENT dsp_ZylDat_zyl6.kr_st_erk "Status Klopferkennung,10,Y, !!! Dummy not for Gredi !!!" ULONG FORMULA_0860 0 0 0.0 255.0 READ_WRITE BIT_MASK 0x1 ECU_ADDRESS 0xC60BC4 /end MEASUREMENT
/begin MEASUREMENT dsp_ZylDat_zyl6.min_avg_samples "Anzahl Messpunkte Minimalintegral,14,Y, !!! Dummy not for Gredi !!!" ULONG FORMULA_0578 0 0.0 0.0 24.576 READ_WRITE ECU_ADDRESS 0xC60BD4 /end MEASUREMENT
/begin MEASUREMENT dsp_ZylDat_zyl6.tz "Zündwinkel,0,Y, !!! Dummy not for Gredi !!!" SLONG FORMULA_0859 0 0.0 -50.0 60.0 READ_WRITE ECU_ADDRESS 0xC60B9C /end MEASUREMENT
/begin MEASUREMENT dsp_ZylDat_zyl6.vr_mess "Istverstaerkung,12,Y, !!! Dummy not for Gredi !!!" SLONG FORMULA_0861 0 0.0 0.0 32.0 READ_WRITE ECU_ADDRESS 0xC60BCC /end MEASUREMENT
/begin MEASUREMENT dsp_ZylDat_zyl7.auss_spark_time "Funkenbrenndauer,13,Y, !!! Dummy not for Gredi !!!" ULONG FORMULA_0017 0 0.0 0.0 4.681 READ_WRITE ECU_ADDRESS 0xC60C0C /end MEASUREMENT
/begin MEASUREMENT dsp_ZylDat_zyl7.dsp_cam_cycle_cnt "DFT Spannungsspektrum,8,Y, !!! Dummy not for Gredi !!!" ULONG FORMULA_0044 0 0.0 0.0 4294967295.0 READ_WRITE ECU_ADDRESS 0xC60BFC /end MEASUREMENT
/begin MEASUREMENT dsp_ZylDat_zyl7.dsp_fbs "DFT Energiespektrum,8,Y, !!! Dummy not for Gredi !!!" FLOAT32_IEEE FORMULA_0044 0 0.0 -3.402823466385289e+038 3.402823466385289e+038 READ_WRITE ECU_ADDRESS 0xC60BF8 /end MEASUREMENT
/begin MEASUREMENT dsp_ZylDat_zyl7.dsp_lp_int_value "TP-Integral im Aussetzerfenster,4,Y, !!! Dummy not for Gredi !!!" SLONG FORMULA_0579 0 0.0 0.0 50.0 READ_WRITE ECU_ADDRESS 0xC60BE8 /end MEASUREMENT
/begin MEASUREMENT dsp_ZylDat_zyl7.dsp_lp_length "Aussetzerfenster Länge,2,Y, !!! Dummy not for Gredi !!!" ULONG FORMULA_0578 0 0.0 0.0 24.576 READ_WRITE ECU_ADDRESS 0xC60BE0 /end MEASUREMENT
/begin MEASUREMENT dsp_ZylDat_zyl7.dsp_lp_start "DSP Start Aussetzerfenster,1,Y, !!! Dummy not for Gredi !!!" ULONG FORMULA_0578 0 0.0 0.0 24.576 READ_WRITE ECU_ADDRESS 0xC60BDC /end MEASUREMENT
/begin MEASUREMENT dsp_ZylDat_zyl7.dsp_min_avg_int "Minimalintegral im Aussetzerfenster,3,Y, !!! Dummy not for Gredi !!!" SLONG FORMULA_0579 0 0.0 0.0 50.0 READ_WRITE ECU_ADDRESS 0xC60BE4 /end MEASUREMENT
/begin MEASUREMENT dsp_ZylDat_zyl7.dsp_vr_length "Klopffenster Länge,6,Y, !!! Dummy not for Gredi !!!" ULONG FORMULA_0578 0 0.0 0.0 24.576 READ_WRITE ECU_ADDRESS 0xC60BF0 /end MEASUREMENT
/begin MEASUREMENT dsp_ZylDat_zyl7.dsp_vr_max_value "Maximalwert im Klopffenster,7,Y, !!! Dummy not for Gredi !!!" SLONG FORMULA_0580 0 0.0 0.0 3.3 READ_WRITE ECU_ADDRESS 0xC60BF4 /end MEASUREMENT
/begin MEASUREMENT dsp_ZylDat_zyl7.dsp_vr_start "Start Klopffenster,5,Y, !!! Dummy not for Gredi !!!" ULONG FORMULA_0578 0 0.0 0.0 24.576 READ_WRITE ECU_ADDRESS 0xC60BEC /end MEASUREMENT
/begin MEASUREMENT dsp_ZylDat_zyl7.kr_dtz "Klopfreglungseingriff,11,Y, !!! Dummy not for Gredi !!!" SLONG FORMULA_0226 0 0.0 -50.0 60.0 READ_WRITE ECU_ADDRESS 0xC60C04 /end MEASUREMENT
/begin MEASUREMENT dsp_ZylDat_zyl7.kr_st_erk "Status Klopferkennung,10,Y, !!! Dummy not for Gredi !!!" ULONG FORMULA_0860 0 0 0.0 255.0 READ_WRITE BIT_MASK 0x1 ECU_ADDRESS 0xC60C00 /end MEASUREMENT
/begin MEASUREMENT dsp_ZylDat_zyl7.min_avg_samples "Anzahl Messpunkte Minimalintegral,14,Y, !!! Dummy not for Gredi !!!" ULONG FORMULA_0578 0 0.0 0.0 24.576 READ_WRITE ECU_ADDRESS 0xC60C10 /end MEASUREMENT
/begin MEASUREMENT dsp_ZylDat_zyl7.tz "Zündwinkel,0,Y, !!! Dummy not for Gredi !!!" SLONG FORMULA_0859 0 0.0 -50.0 60.0 READ_WRITE ECU_ADDRESS 0xC60BD8 /end MEASUREMENT
/begin MEASUREMENT dsp_ZylDat_zyl7.vr_mess "Istverstaerkung,12,Y, !!! Dummy not for Gredi !!!" SLONG FORMULA_0861 0 0.0 0.0 32.0 READ_WRITE ECU_ADDRESS 0xC60C08 /end MEASUREMENT
/begin MEASUREMENT dsp_ZylDat_zyl8.auss_spark_time "Funkenbrenndauer,13,Y, !!! Dummy not for Gredi !!!" ULONG FORMULA_0017 0 0.0 0.0 4.681 READ_WRITE ECU_ADDRESS 0xC60C48 /end MEASUREMENT
/begin MEASUREMENT dsp_ZylDat_zyl8.dsp_cam_cycle_cnt "DFT Spannungsspektrum,8,Y, !!! Dummy not for Gredi !!!" ULONG FORMULA_0044 0 0.0 0.0 4294967295.0 READ_WRITE ECU_ADDRESS 0xC60C38 /end MEASUREMENT
/begin MEASUREMENT dsp_ZylDat_zyl8.dsp_fbs "DFT Energiespektrum,8,Y, !!! Dummy not for Gredi !!!" FLOAT32_IEEE FORMULA_0044 0 0.0 -3.402823466385289e+038 3.402823466385289e+038 READ_WRITE ECU_ADDRESS 0xC60C34 /end MEASUREMENT
/begin MEASUREMENT dsp_ZylDat_zyl8.dsp_lp_int_value "TP-Integral im Aussetzerfenster,4,Y, !!! Dummy not for Gredi !!!" SLONG FORMULA_0579 0 0.0 0.0 50.0 READ_WRITE ECU_ADDRESS 0xC60C24 /end MEASUREMENT
/begin MEASUREMENT dsp_ZylDat_zyl8.dsp_lp_length "Aussetzerfenster Länge,2,Y, !!! Dummy not for Gredi !!!" ULONG FORMULA_0578 0 0.0 0.0 24.576 READ_WRITE ECU_ADDRESS 0xC60C1C /end MEASUREMENT
/begin MEASUREMENT dsp_ZylDat_zyl8.dsp_lp_start "DSP Start Aussetzerfenster,1,Y, !!! Dummy not for Gredi !!!" ULONG FORMULA_0578 0 0.0 0.0 24.576 READ_WRITE ECU_ADDRESS 0xC60C18 /end MEASUREMENT
/begin MEASUREMENT dsp_ZylDat_zyl8.dsp_min_avg_int "Minimalintegral im Aussetzerfenster,3,Y, !!! Dummy not for Gredi !!!" SLONG FORMULA_0579 0 0.0 0.0 50.0 READ_WRITE ECU_ADDRESS 0xC60C20 /end MEASUREMENT
/begin MEASUREMENT dsp_ZylDat_zyl8.dsp_vr_length "Klopffenster Länge,6,Y, !!! Dummy not for Gredi !!!" ULONG FORMULA_0578 0 0.0 0.0 24.576 READ_WRITE ECU_ADDRESS 0xC60C2C /end MEASUREMENT
/begin MEASUREMENT dsp_ZylDat_zyl8.dsp_vr_max_value "Maximalwert im Klopffenster,7,Y, !!! Dummy not for Gredi !!!" SLONG FORMULA_0580 0 0.0 0.0 3.3 READ_WRITE ECU_ADDRESS 0xC60C30 /end MEASUREMENT
/begin MEASUREMENT dsp_ZylDat_zyl8.dsp_vr_start "Start Klopffenster,5,Y, !!! Dummy not for Gredi !!!" ULONG FORMULA_0578 0 0.0 0.0 24.576 READ_WRITE ECU_ADDRESS 0xC60C28 /end MEASUREMENT
/begin MEASUREMENT dsp_ZylDat_zyl8.kr_dtz "Klopfreglungseingriff,11,Y, !!! Dummy not for Gredi !!!" SLONG FORMULA_0226 0 0.0 -50.0 60.0 READ_WRITE ECU_ADDRESS 0xC60C40 /end MEASUREMENT
/begin MEASUREMENT dsp_ZylDat_zyl8.kr_st_erk "Status Klopferkennung,10,Y, !!! Dummy not for Gredi !!!" ULONG FORMULA_0860 0 0 0.0 255.0 READ_WRITE BIT_MASK 0x1 ECU_ADDRESS 0xC60C3C /end MEASUREMENT
/begin MEASUREMENT dsp_ZylDat_zyl8.min_avg_samples "Anzahl Messpunkte Minimalintegral,14,Y, !!! Dummy not for Gredi !!!" ULONG FORMULA_0578 0 0.0 0.0 24.576 READ_WRITE ECU_ADDRESS 0xC60C4C /end MEASUREMENT
/begin MEASUREMENT dsp_ZylDat_zyl8.tz "Zündwinkel,0,Y, !!! Dummy not for Gredi !!!" SLONG FORMULA_0859 0 0.0 -50.0 60.0 READ_WRITE ECU_ADDRESS 0xC60C14 /end MEASUREMENT
/begin MEASUREMENT dsp_ZylDat_zyl8.vr_mess "Istverstaerkung,12,Y, !!! Dummy not for Gredi !!!" SLONG FORMULA_0861 0 0.0 0.0 32.0 READ_WRITE ECU_ADDRESS 0xC60C44 /end MEASUREMENT
/begin MEASUREMENT dsp_ZylDat_zyl9.auss_spark_time "Funkenbrenndauer,13,Y, !!! Dummy not for Gredi !!!" ULONG FORMULA_0017 0 0.0 0.0 4.681 READ_WRITE ECU_ADDRESS 0xC60C84 /end MEASUREMENT
/begin MEASUREMENT dsp_ZylDat_zyl9.dsp_cam_cycle_cnt "DFT Spannungsspektrum,8,Y, !!! Dummy not for Gredi !!!" ULONG FORMULA_0044 0 0.0 0.0 4294967295.0 READ_WRITE ECU_ADDRESS 0xC60C74 /end MEASUREMENT
/begin MEASUREMENT dsp_ZylDat_zyl9.dsp_fbs "DFT Energiespektrum,8,Y, !!! Dummy not for Gredi !!!" FLOAT32_IEEE FORMULA_0044 0 0.0 -3.402823466385289e+038 3.402823466385289e+038 READ_WRITE ECU_ADDRESS 0xC60C70 /end MEASUREMENT
/begin MEASUREMENT dsp_ZylDat_zyl9.dsp_lp_int_value "TP-Integral im Aussetzerfenster,4,Y, !!! Dummy not for Gredi !!!" SLONG FORMULA_0579 0 0.0 0.0 50.0 READ_WRITE ECU_ADDRESS 0xC60C60 /end MEASUREMENT
/begin MEASUREMENT dsp_ZylDat_zyl9.dsp_lp_length "Aussetzerfenster Länge,2,Y, !!! Dummy not for Gredi !!!" ULONG FORMULA_0578 0 0.0 0.0 24.576 READ_WRITE ECU_ADDRESS 0xC60C58 /end MEASUREMENT
/begin MEASUREMENT dsp_ZylDat_zyl9.dsp_lp_start "DSP Start Aussetzerfenster,1,Y, !!! Dummy not for Gredi !!!" ULONG FORMULA_0578 0 0.0 0.0 24.576 READ_WRITE ECU_ADDRESS 0xC60C54 /end MEASUREMENT
/begin MEASUREMENT dsp_ZylDat_zyl9.dsp_min_avg_int "Minimalintegral im Aussetzerfenster,3,Y, !!! Dummy not for Gredi !!!" SLONG FORMULA_0579 0 0.0 0.0 50.0 READ_WRITE ECU_ADDRESS 0xC60C5C /end MEASUREMENT
/begin MEASUREMENT dsp_ZylDat_zyl9.dsp_vr_length "Klopffenster Länge,6,Y, !!! Dummy not for Gredi !!!" ULONG FORMULA_0578 0 0.0 0.0 24.576 READ_WRITE ECU_ADDRESS 0xC60C68 /end MEASUREMENT
/begin MEASUREMENT dsp_ZylDat_zyl9.dsp_vr_max_value "Maximalwert im Klopffenster,7,Y, !!! Dummy not for Gredi !!!" SLONG FORMULA_0580 0 0.0 0.0 3.3 READ_WRITE ECU_ADDRESS 0xC60C6C /end MEASUREMENT
/begin MEASUREMENT dsp_ZylDat_zyl9.dsp_vr_start "Start Klopffenster,5,Y, !!! Dummy not for Gredi !!!" ULONG FORMULA_0578 0 0.0 0.0 24.576 READ_WRITE ECU_ADDRESS 0xC60C64 /end MEASUREMENT
/begin MEASUREMENT dsp_ZylDat_zyl9.kr_dtz "Klopfreglungseingriff,11,Y, !!! Dummy not for Gredi !!!" SLONG FORMULA_0226 0 0.0 -50.0 60.0 READ_WRITE ECU_ADDRESS 0xC60C7C /end MEASUREMENT
/begin MEASUREMENT dsp_ZylDat_zyl9.kr_st_erk "Status Klopferkennung,10,Y, !!! Dummy not for Gredi !!!" ULONG FORMULA_0860 0 0 0.0 255.0 READ_WRITE BIT_MASK 0x1 ECU_ADDRESS 0xC60C78 /end MEASUREMENT
/begin MEASUREMENT dsp_ZylDat_zyl9.min_avg_samples "Anzahl Messpunkte Minimalintegral,14,Y, !!! Dummy not for Gredi !!!" ULONG FORMULA_0578 0 0.0 0.0 24.576 READ_WRITE ECU_ADDRESS 0xC60C88 /end MEASUREMENT
/begin MEASUREMENT dsp_ZylDat_zyl9.tz "Zündwinkel,0,Y, !!! Dummy not for Gredi !!!" SLONG FORMULA_0859 0 0.0 -50.0 60.0 READ_WRITE ECU_ADDRESS 0xC60C50 /end MEASUREMENT
/begin MEASUREMENT dsp_ZylDat_zyl9.vr_mess "Istverstaerkung,12,Y, !!! Dummy not for Gredi !!!" SLONG FORMULA_0861 0 0.0 0.0 32.0 READ_WRITE ECU_ADDRESS 0xC60C80 /end MEASUREMENT
/begin MEASUREMENT ed_debug_laufzeit "Laufzeitmessung" ULONG FORMULA_0072 0 0.0 0.0 4294967295.0 READ_WRITE ECU_ADDRESS 0x3FB650 /end MEASUREMENT
/begin MEASUREMENT ed_fil_afz_hs.art_aktuell_nv "Fehlerart und Statusbits" UWORD FORMULA_0052 0 0.0 0.0 65535.0 READ_WRITE BIT_MASK 0xB4F ECU_ADDRESS 0x3F957A /end MEASUREMENT
/begin MEASUREMENT ed_fil_afz_hs.fehler_aufrufe_nv "Gesamtzahl der Fehleraufrufe" UBYTE FORMULA_0003 0 0.0 0.0 255.0 READ_WRITE ECU_ADDRESS 0x3F957D /end MEASUREMENT
/begin MEASUREMENT ed_fil_afz_hs.filter_max_nv "Maximaler Fehlerfilterwert" UBYTE FORMULA_0003 0 0.0 0.0 255.0 READ_WRITE ECU_ADDRESS 0x3F957C /end MEASUREMENT
/begin MEASUREMENT ed_fil_afz_hs.filter_nv "Filterwert vor und nach Eintrag" UBYTE FORMULA_0003 0 0.0 0.0 255.0 READ_WRITE ECU_ADDRESS 0x3F9578 /end MEASUREMENT
/begin MEASUREMENT ed_fil_afz_hs.zyklus_filter_nv "Vorwaertsfilter zur Fehlerzustandsbestaetigung" UBYTE FORMULA_0003 0 0.0 0.0 255.0 READ_WRITE ECU_ADDRESS 0x3F9579 /end MEASUREMENT
/begin MEASUREMENT ed_fil_appl_data_ign.art_aktuell_nv "Fehlerart und Statusbits" UWORD FORMULA_0052 0 0.0 0.0 65535.0 READ_WRITE BIT_MASK 0xB4F ECU_ADDRESS 0x3F934C /end MEASUREMENT
/begin MEASUREMENT ed_fil_appl_data_ign.fehler_aufrufe_nv "Gesamtzahl der Fehleraufrufe" UBYTE FORMULA_0003 0 0.0 0.0 255.0 READ_WRITE ECU_ADDRESS 0x3F934F /end MEASUREMENT
/begin MEASUREMENT ed_fil_appl_data_ign.filter_max_nv "Maximaler Fehlerfilterwert" UBYTE FORMULA_0003 0 0.0 0.0 255.0 READ_WRITE ECU_ADDRESS 0x3F934E /end MEASUREMENT
/begin MEASUREMENT ed_fil_appl_data_ign.filter_nv "Filterwert vor und nach Eintrag" UBYTE FORMULA_0003 0 0.0 0.0 255.0 READ_WRITE ECU_ADDRESS 0x3F934A /end MEASUREMENT
/begin MEASUREMENT ed_fil_appl_data_ign.zyklus_filter_nv "Vorwaertsfilter zur Fehlerzustandsbestaetigung" UBYTE FORMULA_0003 0 0.0 0.0 255.0 READ_WRITE ECU_ADDRESS 0x3F934B /end MEASUREMENT
/begin MEASUREMENT ed_fil_auss_abg_mult.art_aktuell_nv "Fehlerart und Statusbits" UWORD FORMULA_0052 0 0.0 0.0 65535.0 READ_WRITE BIT_MASK 0xB4F ECU_ADDRESS 0x3F950E /end MEASUREMENT
/begin MEASUREMENT ed_fil_auss_abg_mult.fehler_aufrufe_nv "Gesamtzahl der Fehleraufrufe" UBYTE FORMULA_0003 0 0.0 0.0 255.0 READ_WRITE ECU_ADDRESS 0x3F9511 /end MEASUREMENT
/begin MEASUREMENT ed_fil_auss_abg_mult.filter_max_nv "Maximaler Fehlerfilterwert" UBYTE FORMULA_0003 0 0.0 0.0 255.0 READ_WRITE ECU_ADDRESS 0x3F9510 /end MEASUREMENT
/begin MEASUREMENT ed_fil_auss_abg_mult.filter_nv "Filterwert vor und nach Eintrag" UBYTE FORMULA_0003 0 0.0 0.0 255.0 READ_WRITE ECU_ADDRESS 0x3F950C /end MEASUREMENT
/begin MEASUREMENT ed_fil_auss_abg_mult.zyklus_filter_nv "Vorwaertsfilter zur Fehlerzustandsbestaetigung" UBYTE FORMULA_0003 0 0.0 0.0 255.0 READ_WRITE ECU_ADDRESS 0x3F950D /end MEASUREMENT
/begin MEASUREMENT ed_fil_auss_abg_z1.art_aktuell_nv "Fehlerart und Statusbits" UWORD FORMULA_0052 0 0.0 0.0 65535.0 READ_WRITE BIT_MASK 0xB4F ECU_ADDRESS 0x3F94C6 /end MEASUREMENT
/begin MEASUREMENT ed_fil_auss_abg_z1.fehler_aufrufe_nv "Gesamtzahl der Fehleraufrufe" UBYTE FORMULA_0003 0 0.0 0.0 255.0 READ_WRITE ECU_ADDRESS 0x3F94C9 /end MEASUREMENT
/begin MEASUREMENT ed_fil_auss_abg_z1.filter_max_nv "Maximaler Fehlerfilterwert" UBYTE FORMULA_0003 0 0.0 0.0 255.0 READ_WRITE ECU_ADDRESS 0x3F94C8 /end MEASUREMENT
/begin MEASUREMENT ed_fil_auss_abg_z1.filter_nv "Filterwert vor und nach Eintrag" UBYTE FORMULA_0003 0 0.0 0.0 255.0 READ_WRITE ECU_ADDRESS 0x3F94C4 /end MEASUREMENT
/begin MEASUREMENT ed_fil_auss_abg_z1.zyklus_filter_nv "Vorwaertsfilter zur Fehlerzustandsbestaetigung" UBYTE FORMULA_0003 0 0.0 0.0 255.0 READ_WRITE ECU_ADDRESS 0x3F94C5 /end MEASUREMENT
/begin MEASUREMENT ed_fil_auss_abg_z10.art_aktuell_nv "Fehlerart und Statusbits" UWORD FORMULA_0052 0 0.0 0.0 65535.0 READ_WRITE BIT_MASK 0xB4F ECU_ADDRESS 0x3F94FC /end MEASUREMENT
/begin MEASUREMENT ed_fil_auss_abg_z10.fehler_aufrufe_nv "Gesamtzahl der Fehleraufrufe" UBYTE FORMULA_0003 0 0.0 0.0 255.0 READ_WRITE ECU_ADDRESS 0x3F94FF /end MEASUREMENT
/begin MEASUREMENT ed_fil_auss_abg_z10.filter_max_nv "Maximaler Fehlerfilterwert" UBYTE FORMULA_0003 0 0.0 0.0 255.0 READ_WRITE ECU_ADDRESS 0x3F94FE /end MEASUREMENT
/begin MEASUREMENT ed_fil_auss_abg_z10.filter_nv "Filterwert vor und nach Eintrag" UBYTE FORMULA_0003 0 0.0 0.0 255.0 READ_WRITE ECU_ADDRESS 0x3F94FA /end MEASUREMENT
/begin MEASUREMENT ed_fil_auss_abg_z10.zyklus_filter_nv "Vorwaertsfilter zur Fehlerzustandsbestaetigung" UBYTE FORMULA_0003 0 0.0 0.0 255.0 READ_WRITE ECU_ADDRESS 0x3F94FB /end MEASUREMENT
/begin MEASUREMENT ed_fil_auss_abg_z2.art_aktuell_nv "Fehlerart und Statusbits" UWORD FORMULA_0052 0 0.0 0.0 65535.0 READ_WRITE BIT_MASK 0xB4F ECU_ADDRESS 0x3F94CC /end MEASUREMENT
/begin MEASUREMENT ed_fil_auss_abg_z2.fehler_aufrufe_nv "Gesamtzahl der Fehleraufrufe" UBYTE FORMULA_0003 0 0.0 0.0 255.0 READ_WRITE ECU_ADDRESS 0x3F94CF /end MEASUREMENT
/begin MEASUREMENT ed_fil_auss_abg_z2.filter_max_nv "Maximaler Fehlerfilterwert" UBYTE FORMULA_0003 0 0.0 0.0 255.0 READ_WRITE ECU_ADDRESS 0x3F94CE /end MEASUREMENT
/begin MEASUREMENT ed_fil_auss_abg_z2.filter_nv "Filterwert vor und nach Eintrag" UBYTE FORMULA_0003 0 0.0 0.0 255.0 READ_WRITE ECU_ADDRESS 0x3F94CA /end MEASUREMENT
/begin MEASUREMENT ed_fil_auss_abg_z2.zyklus_filter_nv "Vorwaertsfilter zur Fehlerzustandsbestaetigung" UBYTE FORMULA_0003 0 0.0 0.0 255.0 READ_WRITE ECU_ADDRESS 0x3F94CB /end MEASUREMENT
/begin MEASUREMENT ed_fil_auss_abg_z3.art_aktuell_nv "Fehlerart und Statusbits" UWORD FORMULA_0052 0 0.0 0.0 65535.0 READ_WRITE BIT_MASK 0xB4F ECU_ADDRESS 0x3F94D2 /end MEASUREMENT
/begin MEASUREMENT ed_fil_auss_abg_z3.fehler_aufrufe_nv "Gesamtzahl der Fehleraufrufe" UBYTE FORMULA_0003 0 0.0 0.0 255.0 READ_WRITE ECU_ADDRESS 0x3F94D5 /end MEASUREMENT
/begin MEASUREMENT ed_fil_auss_abg_z3.filter_max_nv "Maximaler Fehlerfilterwert" UBYTE FORMULA_0003 0 0.0 0.0 255.0 READ_WRITE ECU_ADDRESS 0x3F94D4 /end MEASUREMENT
/begin MEASUREMENT ed_fil_auss_abg_z3.filter_nv "Filterwert vor und nach Eintrag" UBYTE FORMULA_0003 0 0.0 0.0 255.0 READ_WRITE ECU_ADDRESS 0x3F94D0 /end MEASUREMENT
/begin MEASUREMENT ed_fil_auss_abg_z3.zyklus_filter_nv "Vorwaertsfilter zur Fehlerzustandsbestaetigung" UBYTE FORMULA_0003 0 0.0 0.0 255.0 READ_WRITE ECU_ADDRESS 0x3F94D1 /end MEASUREMENT
/begin MEASUREMENT ed_fil_auss_abg_z4.art_aktuell_nv "Fehlerart und Statusbits" UWORD FORMULA_0052 0 0.0 0.0 65535.0 READ_WRITE BIT_MASK 0xB4F ECU_ADDRESS 0x3F94D8 /end MEASUREMENT
/begin MEASUREMENT ed_fil_auss_abg_z4.fehler_aufrufe_nv "Gesamtzahl der Fehleraufrufe" UBYTE FORMULA_0003 0 0.0 0.0 255.0 READ_WRITE ECU_ADDRESS 0x3F94DB /end MEASUREMENT
/begin MEASUREMENT ed_fil_auss_abg_z4.filter_max_nv "Maximaler Fehlerfilterwert" UBYTE FORMULA_0003 0 0.0 0.0 255.0 READ_WRITE ECU_ADDRESS 0x3F94DA /end MEASUREMENT
/begin MEASUREMENT ed_fil_auss_abg_z4.filter_nv "Filterwert vor und nach Eintrag" UBYTE FORMULA_0003 0 0.0 0.0 255.0 READ_WRITE ECU_ADDRESS 0x3F94D6 /end MEASUREMENT
/begin MEASUREMENT ed_fil_auss_abg_z4.zyklus_filter_nv "Vorwaertsfilter zur Fehlerzustandsbestaetigung" UBYTE FORMULA_0003 0 0.0 0.0 255.0 READ_WRITE ECU_ADDRESS 0x3F94D7 /end MEASUREMENT
/begin MEASUREMENT ed_fil_auss_abg_z5.art_aktuell_nv "Fehlerart und Statusbits" UWORD FORMULA_0052 0 0.0 0.0 65535.0 READ_WRITE BIT_MASK 0xB4F ECU_ADDRESS 0x3F94DE /end MEASUREMENT
/begin MEASUREMENT ed_fil_auss_abg_z5.fehler_aufrufe_nv "Gesamtzahl der Fehleraufrufe" UBYTE FORMULA_0003 0 0.0 0.0 255.0 READ_WRITE ECU_ADDRESS 0x3F94E1 /end MEASUREMENT
/begin MEASUREMENT ed_fil_auss_abg_z5.filter_max_nv "Maximaler Fehlerfilterwert" UBYTE FORMULA_0003 0 0.0 0.0 255.0 READ_WRITE ECU_ADDRESS 0x3F94E0 /end MEASUREMENT
/begin MEASUREMENT ed_fil_auss_abg_z5.filter_nv "Filterwert vor und nach Eintrag" UBYTE FORMULA_0003 0 0.0 0.0 255.0 READ_WRITE ECU_ADDRESS 0x3F94DC /end MEASUREMENT
/begin MEASUREMENT ed_fil_auss_abg_z5.zyklus_filter_nv "Vorwaertsfilter zur Fehlerzustandsbestaetigung" UBYTE FORMULA_0003 0 0.0 0.0 255.0 READ_WRITE ECU_ADDRESS 0x3F94DD /end MEASUREMENT
/begin MEASUREMENT ed_fil_auss_abg_z6.art_aktuell_nv "Fehlerart und Statusbits" UWORD FORMULA_0052 0 0.0 0.0 65535.0 READ_WRITE BIT_MASK 0xB4F ECU_ADDRESS 0x3F94E4 /end MEASUREMENT
/begin MEASUREMENT ed_fil_auss_abg_z6.fehler_aufrufe_nv "Gesamtzahl der Fehleraufrufe" UBYTE FORMULA_0003 0 0.0 0.0 255.0 READ_WRITE ECU_ADDRESS 0x3F94E7 /end MEASUREMENT
/begin MEASUREMENT ed_fil_auss_abg_z6.filter_max_nv "Maximaler Fehlerfilterwert" UBYTE FORMULA_0003 0 0.0 0.0 255.0 READ_WRITE ECU_ADDRESS 0x3F94E6 /end MEASUREMENT
/begin MEASUREMENT ed_fil_auss_abg_z6.filter_nv "Filterwert vor und nach Eintrag" UBYTE FORMULA_0003 0 0.0 0.0 255.0 READ_WRITE ECU_ADDRESS 0x3F94E2 /end MEASUREMENT
/begin MEASUREMENT ed_fil_auss_abg_z6.zyklus_filter_nv "Vorwaertsfilter zur Fehlerzustandsbestaetigung" UBYTE FORMULA_0003 0 0.0 0.0 255.0 READ_WRITE ECU_ADDRESS 0x3F94E3 /end MEASUREMENT
/begin MEASUREMENT ed_fil_auss_abg_z7.art_aktuell_nv "Fehlerart und Statusbits" UWORD FORMULA_0052 0 0.0 0.0 65535.0 READ_WRITE BIT_MASK 0xB4F ECU_ADDRESS 0x3F94EA /end MEASUREMENT
/begin MEASUREMENT ed_fil_auss_abg_z7.fehler_aufrufe_nv "Gesamtzahl der Fehleraufrufe" UBYTE FORMULA_0003 0 0.0 0.0 255.0 READ_WRITE ECU_ADDRESS 0x3F94ED /end MEASUREMENT
/begin MEASUREMENT ed_fil_auss_abg_z7.filter_max_nv "Maximaler Fehlerfilterwert" UBYTE FORMULA_0003 0 0.0 0.0 255.0 READ_WRITE ECU_ADDRESS 0x3F94EC /end MEASUREMENT
/begin MEASUREMENT ed_fil_auss_abg_z7.filter_nv "Filterwert vor und nach Eintrag" UBYTE FORMULA_0003 0 0.0 0.0 255.0 READ_WRITE ECU_ADDRESS 0x3F94E8 /end MEASUREMENT
/begin MEASUREMENT ed_fil_auss_abg_z7.zyklus_filter_nv "Vorwaertsfilter zur Fehlerzustandsbestaetigung" UBYTE FORMULA_0003 0 0.0 0.0 255.0 READ_WRITE ECU_ADDRESS 0x3F94E9 /end MEASUREMENT
/begin MEASUREMENT ed_fil_auss_abg_z8.art_aktuell_nv "Fehlerart und Statusbits" UWORD FORMULA_0052 0 0.0 0.0 65535.0 READ_WRITE BIT_MASK 0xB4F ECU_ADDRESS 0x3F94F0 /end MEASUREMENT
/begin MEASUREMENT ed_fil_auss_abg_z8.fehler_aufrufe_nv "Gesamtzahl der Fehleraufrufe" UBYTE FORMULA_0003 0 0.0 0.0 255.0 READ_WRITE ECU_ADDRESS 0x3F94F3 /end MEASUREMENT
/begin MEASUREMENT ed_fil_auss_abg_z8.filter_max_nv "Maximaler Fehlerfilterwert" UBYTE FORMULA_0003 0 0.0 0.0 255.0 READ_WRITE ECU_ADDRESS 0x3F94F2 /end MEASUREMENT
/begin MEASUREMENT ed_fil_auss_abg_z8.filter_nv "Filterwert vor und nach Eintrag" UBYTE FORMULA_0003 0 0.0 0.0 255.0 READ_WRITE ECU_ADDRESS 0x3F94EE /end MEASUREMENT
/begin MEASUREMENT ed_fil_auss_abg_z8.zyklus_filter_nv "Vorwaertsfilter zur Fehlerzustandsbestaetigung" UBYTE FORMULA_0003 0 0.0 0.0 255.0 READ_WRITE ECU_ADDRESS 0x3F94EF /end MEASUREMENT
/begin MEASUREMENT ed_fil_auss_abg_z9.art_aktuell_nv "Fehlerart und Statusbits" UWORD FORMULA_0052 0 0.0 0.0 65535.0 READ_WRITE BIT_MASK 0xB4F ECU_ADDRESS 0x3F94F6 /end MEASUREMENT
/begin MEASUREMENT ed_fil_auss_abg_z9.fehler_aufrufe_nv "Gesamtzahl der Fehleraufrufe" UBYTE FORMULA_0003 0 0.0 0.0 255.0 READ_WRITE ECU_ADDRESS 0x3F94F9 /end MEASUREMENT
/begin MEASUREMENT ed_fil_auss_abg_z9.filter_max_nv "Maximaler Fehlerfilterwert" UBYTE FORMULA_0003 0 0.0 0.0 255.0 READ_WRITE ECU_ADDRESS 0x3F94F8 /end MEASUREMENT
/begin MEASUREMENT ed_fil_auss_abg_z9.filter_nv "Filterwert vor und nach Eintrag" UBYTE FORMULA_0003 0 0.0 0.0 255.0 READ_WRITE ECU_ADDRESS 0x3F94F4 /end MEASUREMENT
/begin MEASUREMENT ed_fil_auss_abg_z9.zyklus_filter_nv "Vorwaertsfilter zur Fehlerzustandsbestaetigung" UBYTE FORMULA_0003 0 0.0 0.0 255.0 READ_WRITE ECU_ADDRESS 0x3F94F5 /end MEASUREMENT
/begin MEASUREMENT ed_fil_auss_kat_mult.art_aktuell_nv "Fehlerart und Statusbits" UWORD FORMULA_0052 0 0.0 0.0 65535.0 READ_WRITE BIT_MASK 0xB4F ECU_ADDRESS 0x3F94C0 /end MEASUREMENT
/begin MEASUREMENT ed_fil_auss_kat_mult.fehler_aufrufe_nv "Gesamtzahl der Fehleraufrufe" UBYTE FORMULA_0003 0 0.0 0.0 255.0 READ_WRITE ECU_ADDRESS 0x3F94C3 /end MEASUREMENT
/begin MEASUREMENT ed_fil_auss_kat_mult.filter_max_nv "Maximaler Fehlerfilterwert" UBYTE FORMULA_0003 0 0.0 0.0 255.0 READ_WRITE ECU_ADDRESS 0x3F94C2 /end MEASUREMENT
/begin MEASUREMENT ed_fil_auss_kat_mult.filter_nv "Filterwert vor und nach Eintrag" UBYTE FORMULA_0003 0 0.0 0.0 255.0 READ_WRITE ECU_ADDRESS 0x3F94BE /end MEASUREMENT
/begin MEASUREMENT ed_fil_auss_kat_mult.zyklus_filter_nv "Vorwaertsfilter zur Fehlerzustandsbestaetigung" UBYTE FORMULA_0003 0 0.0 0.0 255.0 READ_WRITE ECU_ADDRESS 0x3F94BF /end MEASUREMENT
/begin MEASUREMENT ed_fil_auss_kat_z1.art_aktuell_nv "Fehlerart und Statusbits" UWORD FORMULA_0052 0 0.0 0.0 65535.0 READ_WRITE BIT_MASK 0xB4F ECU_ADDRESS 0x3F9478 /end MEASUREMENT
/begin MEASUREMENT ed_fil_auss_kat_z1.fehler_aufrufe_nv "Gesamtzahl der Fehleraufrufe" UBYTE FORMULA_0003 0 0.0 0.0 255.0 READ_WRITE ECU_ADDRESS 0x3F947B /end MEASUREMENT
/begin MEASUREMENT ed_fil_auss_kat_z1.filter_max_nv "Maximaler Fehlerfilterwert" UBYTE FORMULA_0003 0 0.0 0.0 255.0 READ_WRITE ECU_ADDRESS 0x3F947A /end MEASUREMENT
/begin MEASUREMENT ed_fil_auss_kat_z1.filter_nv "Filterwert vor und nach Eintrag" UBYTE FORMULA_0003 0 0.0 0.0 255.0 READ_WRITE ECU_ADDRESS 0x3F9476 /end MEASUREMENT
/begin MEASUREMENT ed_fil_auss_kat_z1.zyklus_filter_nv "Vorwaertsfilter zur Fehlerzustandsbestaetigung" UBYTE FORMULA_0003 0 0.0 0.0 255.0 READ_WRITE ECU_ADDRESS 0x3F9477 /end MEASUREMENT
/begin MEASUREMENT ed_fil_auss_kat_z10.art_aktuell_nv "Fehlerart und Statusbits" UWORD FORMULA_0052 0 0.0 0.0 65535.0 READ_WRITE BIT_MASK 0xB4F ECU_ADDRESS 0x3F94AE /end MEASUREMENT
/begin MEASUREMENT ed_fil_auss_kat_z10.fehler_aufrufe_nv "Gesamtzahl der Fehleraufrufe" UBYTE FORMULA_0003 0 0.0 0.0 255.0 READ_WRITE ECU_ADDRESS 0x3F94B1 /end MEASUREMENT
/begin MEASUREMENT ed_fil_auss_kat_z10.filter_max_nv "Maximaler Fehlerfilterwert" UBYTE FORMULA_0003 0 0.0 0.0 255.0 READ_WRITE ECU_ADDRESS 0x3F94B0 /end MEASUREMENT
/begin MEASUREMENT ed_fil_auss_kat_z10.filter_nv "Filterwert vor und nach Eintrag" UBYTE FORMULA_0003 0 0.0 0.0 255.0 READ_WRITE ECU_ADDRESS 0x3F94AC /end MEASUREMENT
/begin MEASUREMENT ed_fil_auss_kat_z10.zyklus_filter_nv "Vorwaertsfilter zur Fehlerzustandsbestaetigung" UBYTE FORMULA_0003 0 0.0 0.0 255.0 READ_WRITE ECU_ADDRESS 0x3F94AD /end MEASUREMENT
/begin MEASUREMENT ed_fil_auss_kat_z2.art_aktuell_nv "Fehlerart und Statusbits" UWORD FORMULA_0052 0 0.0 0.0 65535.0 READ_WRITE BIT_MASK 0xB4F ECU_ADDRESS 0x3F947E /end MEASUREMENT
/begin MEASUREMENT ed_fil_auss_kat_z2.fehler_aufrufe_nv "Gesamtzahl der Fehleraufrufe" UBYTE FORMULA_0003 0 0.0 0.0 255.0 READ_WRITE ECU_ADDRESS 0x3F9481 /end MEASUREMENT
/begin MEASUREMENT ed_fil_auss_kat_z2.filter_max_nv "Maximaler Fehlerfilterwert" UBYTE FORMULA_0003 0 0.0 0.0 255.0 READ_WRITE ECU_ADDRESS 0x3F9480 /end MEASUREMENT
/begin MEASUREMENT ed_fil_auss_kat_z2.filter_nv "Filterwert vor und nach Eintrag" UBYTE FORMULA_0003 0 0.0 0.0 255.0 READ_WRITE ECU_ADDRESS 0x3F947C /end MEASUREMENT
/begin MEASUREMENT ed_fil_auss_kat_z2.zyklus_filter_nv "Vorwaertsfilter zur Fehlerzustandsbestaetigung" UBYTE FORMULA_0003 0 0.0 0.0 255.0 READ_WRITE ECU_ADDRESS 0x3F947D /end MEASUREMENT
/begin MEASUREMENT ed_fil_auss_kat_z3.art_aktuell_nv "Fehlerart und Statusbits" UWORD FORMULA_0052 0 0.0 0.0 65535.0 READ_WRITE BIT_MASK 0xB4F ECU_ADDRESS 0x3F9484 /end MEASUREMENT
/begin MEASUREMENT ed_fil_auss_kat_z3.fehler_aufrufe_nv "Gesamtzahl der Fehleraufrufe" UBYTE FORMULA_0003 0 0.0 0.0 255.0 READ_WRITE ECU_ADDRESS 0x3F9487 /end MEASUREMENT
/begin MEASUREMENT ed_fil_auss_kat_z3.filter_max_nv "Maximaler Fehlerfilterwert" UBYTE FORMULA_0003 0 0.0 0.0 255.0 READ_WRITE ECU_ADDRESS 0x3F9486 /end MEASUREMENT
/begin MEASUREMENT eeprom_seite_lesen "Wo wurde der letzte Datensatz gefunden" UBYTE FORMULA_0077 0 0.0 0.0 255.0 READ_WRITE ECU_ADDRESS 0x3FB654 /end MEASUREMENT
/begin MEASUREMENT eeprom_seite_lesen_hdw "Wo wurde der letzte HDW-Datensatz gefunden" UBYTE FORMULA_0077 0 0.0 0.0 255.0 READ_WRITE ECU_ADDRESS 0x3FB655 /end MEASUREMENT
/begin MEASUREMENT eeprom_seite_schreiben "Wo hin soll der naechste Datensatz geschrieben werden" UBYTE FORMULA_0078 0 0.0 0.0 255.0 READ_WRITE ECU_ADDRESS 0x3FB656 /end MEASUREMENT
/begin MEASUREMENT eeprom_st "Status der EEPROM-Emulation" UBYTE FORMULA_0079 0 0.0 0.0 255.0 READ_WRITE ECU_ADDRESS 0x3FB657 /end MEASUREMENT
/begin MEASUREMENT egas_aq_rf_wl_f "Warmlauffaktor" UWORD FORMULA_0073 0 0.0 0.0 4.0 READ_WRITE ECU_ADDRESS 0x3FB704 /end MEASUREMENT
/begin MEASUREMENT egas_aq_soll_dk_b1 "AQ-Soll fuer DK" UWORD FORMULA_0143 0 0.0 0.0 6500.0 READ_WRITE ECU_ADDRESS 0x3FB66E /end MEASUREMENT
/begin MEASUREMENT egas_aq_soll_dk_b2 "AQ-Soll fuer DK" UWORD FORMULA_0143 0 0.0 0.0 6500.0 READ_WRITE ECU_ADDRESS 0x3FB670 /end MEASUREMENT
/begin MEASUREMENT egas_aq_soll_fil_b1 "AQ-Soll gefilteret" UWORD FORMULA_0143 0 0.0 0.0 6500.0 READ_WRITE ECU_ADDRESS 0x3FB666 /end MEASUREMENT
/begin MEASUREMENT egas_aq_soll_fil_b2 "AQ-Soll gefilteret" UWORD FORMULA_0143 0 0.0 0.0 6500.0 READ_WRITE ECU_ADDRESS 0x3FB668 /end MEASUREMENT
/begin MEASUREMENT egas_aq_soll_lls_b1 "AQ-Soll fuer LLS" UWORD FORMULA_0143 0 0.0 0.0 6500.0 READ_WRITE ECU_ADDRESS 0x3FB66A /end MEASUREMENT
/begin MEASUREMENT egas_aq_soll_lls_b2 "AQ-Soll fuer LLS" UWORD FORMULA_0143 0 0.0 0.0 6500.0 READ_WRITE ECU_ADDRESS 0x3FB66C /end MEASUREMENT
/begin MEASUREMENT egas_can_ed_tsperr_dk "Wartezeit CAN-DK" UBYTE FORMULA_0581 0 0.0 0.0 1.274999976158142 READ_WRITE ECU_ADDRESS 0x3FB663 /end MEASUREMENT
/begin MEASUREMENT egas_can_ed_tsperr_lls "Wartezeit CAN-LLS" UBYTE FORMULA_0581 0 0.0 0.0 1.274999976158142 READ_WRITE ECU_ADDRESS 0x3FB662 /end MEASUREMENT
/begin MEASUREMENT egas_dk.flags_en_b1 "Enable-Flag" UBYTE FORMULA_0591 0 0 0.0 255.0 READ_WRITE BIT_MASK 0x1 ECU_ADDRESS 0x3FB6AE /end MEASUREMENT
/begin MEASUREMENT egas_dk.flags_en_b2 "Enable-Flag" UBYTE FORMULA_0591 0 0 0.0 255.0 READ_WRITE BIT_MASK 0x1 ECU_ADDRESS 0x3FB6C8 /end MEASUREMENT
/begin MEASUREMENT egas_dk.flags_ftime_b1 "Failtimer abgelaufen" UBYTE FORMULA_0593 0 0 0.0 255.0 READ_WRITE BIT_MASK 0x20 ECU_ADDRESS 0x3FB6AE /end MEASUREMENT
/begin MEASUREMENT egas_dk.flags_ftime_b2 "Failtimer abgelaufen" UBYTE FORMULA_0593 0 0 0.0 255.0 READ_WRITE BIT_MASK 0x20 ECU_ADDRESS 0x3FB6C8 /end MEASUREMENT
/begin MEASUREMENT egas_dk.flags_kh_b1 "KH-Querschnitt" UBYTE FORMULA_0595 0 0 0.0 255.0 READ_WRITE BIT_MASK 0x80 ECU_ADDRESS 0x3FB6AE /end MEASUREMENT
/begin MEASUREMENT egas_dk.flags_kh_b2 "KH-Querschnitt" UBYTE FORMULA_0595 0 0 0.0 255.0 READ_WRITE BIT_MASK 0x80 ECU_ADDRESS 0x3FB6C8 /end MEASUREMENT
/begin MEASUREMENT egas_dk.flags_nachadapt_b1 "Nachadaption" UBYTE FORMULA_0594 0 0 0.0 255.0 READ_WRITE BIT_MASK 0x40 ECU_ADDRESS 0x3FB6AE /end MEASUREMENT
/begin MEASUREMENT egas_dk.flags_nachadapt_b2 "Nachadaption" UBYTE FORMULA_0594 0 0 0.0 255.0 READ_WRITE BIT_MASK 0x40 ECU_ADDRESS 0x3FB6C8 /end MEASUREMENT
/begin MEASUREMENT egas_dk.flags_tst_b1 "durchgeführte Tests" UBYTE FORMULA_0592 0 0.0 0.0 255.0 READ_WRITE BIT_MASK 0x1E ECU_ADDRESS 0x3FB6AE /end MEASUREMENT
/begin MEASUREMENT egas_dk.flags_tst_b2 "durchgeführte Tests" UBYTE FORMULA_0592 0 0.0 0.0 255.0 READ_WRITE BIT_MASK 0x1E ECU_ADDRESS 0x3FB6C8 /end MEASUREMENT
/begin MEASUREMENT egas_dk_b1.alive_err "Zaehler Aliveerror" UBYTE FORMULA_0003 0 0.0 0.0 255.0 READ_WRITE ECU_ADDRESS 0x3FB6AF /end MEASUREMENT
/begin MEASUREMENT egas_dk_b1.can_st "CAN-Status" UBYTE FORMULA_0117 0 0.0 0.0 255.0 READ_WRITE ECU_ADDRESS 0x3FB6A7 /end MEASUREMENT
/begin MEASUREMENT egas_dk_b1.fail_cnt "Zaehler Fail-Status" UBYTE FORMULA_0003 0 0.0 0.0 255.0 READ_WRITE ECU_ADDRESS 0x3FB6B4 /end MEASUREMENT
/begin MEASUREMENT egas_dk_b1.fail_st "Failsafe-Status" UWORD FORMULA_0596 0 0.0 0.0 65535.0 READ_WRITE ECU_ADDRESS 0x3FB6B0 /end MEASUREMENT
/begin MEASUREMENT egas_dk_b1.flags "Flags" UBYTE FORMULA_0003 0 0.0 0.0 255.0 READ_WRITE ECU_ADDRESS 0x3FB6AE /end MEASUREMENT
/begin MEASUREMENT egas_dk_b1.mode "Mode" UBYTE FORMULA_0435 0 0.0 0.0 255.0 READ_WRITE ECU_ADDRESS 0x3FB6A8 /end MEASUREMENT
/begin MEASUREMENT egas_dk_b1.mode_can "DK-Mode CAN" UBYTE FORMULA_0587 0 0.0 0.0 255.0 READ_WRITE ECU_ADDRESS 0x3FB6A9 /end MEASUREMENT
/begin MEASUREMENT egas_dk_b1.r_adapt_st "R-Adaption" UBYTE FORMULA_0588 0 0.0 0.0 255.0 READ_WRITE ECU_ADDRESS 0x3FB69D /end MEASUREMENT
/begin MEASUREMENT egas_dk_b1.r_alive "R-Alive" UBYTE FORMULA_0003 0 0.0 0.0 255.0 READ_WRITE ECU_ADDRESS 0x3FB6A5 /end MEASUREMENT
/begin MEASUREMENT egas_dk_b1.r_diag_clr "Zaehler DiagClr" UBYTE FORMULA_0003 0 0.0 0.0 255.0 READ_WRITE ECU_ADDRESS 0x3FB6B5 /end MEASUREMENT
/begin MEASUREMENT egas_dk_b1.r_diag_st "Diagnosestatus" UWORD FORMULA_0433 0 0.0 0.0 65535.0 READ_WRITE ECU_ADDRESS 0x3FB69E /end MEASUREMENT
/begin MEASUREMENT egas_dk_b1.r_enable "R-Enable" UBYTE FORMULA_0586 0 0.0 0.0 255.0 READ_WRITE ECU_ADDRESS 0x3FB6A4 /end MEASUREMENT
/begin MEASUREMENT egas_dk_b1.r_gpos "Istwert (roh)" SWORD FORMULA_0001 0 0.0 -10.0 120.0 READ_WRITE ECU_ADDRESS 0x3FB6A2 /end MEASUREMENT
/begin MEASUREMENT egas_dk_b1.r_mode "R-Mode" UBYTE FORMULA_0587 0 0.0 0.0 255.0 READ_WRITE ECU_ADDRESS 0x3FB69C /end MEASUREMENT
/begin MEASUREMENT egas_dk_b1.r_sollw "R-Sollwert" SWORD FORMULA_0001 0 0.0 -10.0 120.0 READ_WRITE ECU_ADDRESS 0x3FB6A0 /end MEASUREMENT
/begin MEASUREMENT egas_dk_b1.r_tv "Tastverhaeltnis" UBYTE FORMULA_0585 0 0.0 -100.0 99.21869659423828 READ_WRITE ECU_ADDRESS 0x3FB6A6 /end MEASUREMENT
/begin MEASUREMENT egas_dk_b1.state "State" UBYTE FORMULA_0589 0 0.0 0.0 255.0 READ_WRITE ECU_ADDRESS 0x3FB6AA /end MEASUREMENT
/begin MEASUREMENT egas_dk_b1.state_time "Zeit im akt. State" UWORD FORMULA_0590 0 0.0 0.0 327.6749877929688 READ_WRITE ECU_ADDRESS 0x3FB6AC /end MEASUREMENT
/begin MEASUREMENT egas_dk_b2.alive_err "Zaehler Aliveerror" UBYTE FORMULA_0003 0 0.0 0.0 255.0 READ_WRITE ECU_ADDRESS 0x3FB6C9 /end MEASUREMENT
/begin MEASUREMENT egas_dk_b2.can_st "CAN-Status" UBYTE FORMULA_0117 0 0.0 0.0 255.0 READ_WRITE ECU_ADDRESS 0x3FB6C1 /end MEASUREMENT
/begin MEASUREMENT egas_dk_b2.fail_cnt "Zaehler Fail-Status" UBYTE FORMULA_0003 0 0.0 0.0 255.0 READ_WRITE ECU_ADDRESS 0x3FB6CE /end MEASUREMENT
/begin MEASUREMENT egas_dk_b2.fail_st "Failsafe-Status" UWORD FORMULA_0596 0 0.0 0.0 65535.0 READ_WRITE ECU_ADDRESS 0x3FB6CA /end MEASUREMENT
/begin MEASUREMENT egas_dk_b2.flags "Flags" UBYTE FORMULA_0003 0 0.0 0.0 255.0 READ_WRITE ECU_ADDRESS 0x3FB6C8 /end MEASUREMENT
/begin MEASUREMENT egas_dk_b2.mode "Mode" UBYTE FORMULA_0435 0 0.0 0.0 255.0 READ_WRITE ECU_ADDRESS 0x3FB6C2 /end MEASUREMENT
/begin MEASUREMENT egas_dk_b2.mode_can "DK-Mode CAN" UBYTE FORMULA_0587 0 0.0 0.0 255.0 READ_WRITE ECU_ADDRESS 0x3FB6C3 /end MEASUREMENT
/begin MEASUREMENT egas_dk_b2.r_adapt_st "R-Adaption" UBYTE FORMULA_0588 0 0.0 0.0 255.0 READ_WRITE ECU_ADDRESS 0x3FB6B7 /end MEASUREMENT
/begin MEASUREMENT egas_dk_b2.r_alive "R-Alive" UBYTE FORMULA_0003 0 0.0 0.0 255.0 READ_WRITE ECU_ADDRESS 0x3FB6BF /end MEASUREMENT
/begin MEASUREMENT egas_dk_b2.r_diag_clr "Zaehler DiagClr" UBYTE FORMULA_0003 0 0.0 0.0 255.0 READ_WRITE ECU_ADDRESS 0x3FB6CF /end MEASUREMENT
/begin MEASUREMENT egas_dk_b2.r_diag_st "Diagnosestatus" UWORD FORMULA_0433 0 0.0 0.0 65535.0 READ_WRITE ECU_ADDRESS 0x3FB6B8 /end MEASUREMENT
/begin MEASUREMENT egas_dk_b2.r_enable "R-Enable" UBYTE FORMULA_0586 0 0.0 0.0 255.0 READ_WRITE ECU_ADDRESS 0x3FB6BE /end MEASUREMENT
/begin MEASUREMENT egas_dk_b2.r_gpos "Istwert (roh)" SWORD FORMULA_0001 0 0.0 -10.0 120.0 READ_WRITE ECU_ADDRESS 0x3FB6BC /end MEASUREMENT
/begin MEASUREMENT egas_dk_b2.r_mode "R-Mode" UBYTE FORMULA_0587 0 0.0 0.0 255.0 READ_WRITE ECU_ADDRESS 0x3FB6B6 /end MEASUREMENT
/begin MEASUREMENT egas_dk_b2.r_sollw "R-Sollwert" SWORD FORMULA_0001 0 0.0 -10.0 120.0 READ_WRITE ECU_ADDRESS 0x3FB6BA /end MEASUREMENT
/begin MEASUREMENT egas_dk_b2.r_tv "Tastverhaeltnis" UBYTE FORMULA_0585 0 0.0 -100.0 99.21869659423828 READ_WRITE ECU_ADDRESS 0x3FB6C0 /end MEASUREMENT
/begin MEASUREMENT egas_dk_b2.state "State" UBYTE FORMULA_0589 0 0.0 0.0 255.0 READ_WRITE ECU_ADDRESS 0x3FB6C4 /end MEASUREMENT
/begin MEASUREMENT egas_dk_b2.state_time "Zeit im akt. State" UWORD FORMULA_0590 0 0.0 0.0 327.6749877929688 READ_WRITE ECU_ADDRESS 0x3FB6C6 /end MEASUREMENT
/begin MEASUREMENT egas_dk_fil_fail "DK-Fehlerfilter" UBYTE FORMULA_0621 0 0.0 0.0 255.0 READ_WRITE ECU_ADDRESS 0x3FB804 /end MEASUREMENT
/begin MEASUREMENT egas_dk_neuinit_cnt "Anzahl DK-Neuinits" UBYTE FORMULA_0003 0 0.0 0.0 255.0 READ_WRITE ECU_ADDRESS 0x3FB801 /end MEASUREMENT
/begin MEASUREMENT egas_dk_startup "DK-Startstate" UBYTE FORMULA_0619 0 0.0 0.0 255.0 READ_WRITE ECU_ADDRESS 0x3FB7FE /end MEASUREMENT
/begin MEASUREMENT egas_exd_dk_soll "Sollwert ext. DK-Diagnose" SWORD FORMULA_0001 0 0.0 -10.0 120.0 READ_WRITE ECU_ADDRESS 0x3FB80A /end MEASUREMENT
/begin MEASUREMENT egas_exd_dk_state "Status ext. DK-Diagnose" UBYTE FORMULA_0622 0 0.0 0.0 255.0 READ_WRITE ECU_ADDRESS 0x3FB805 /end MEASUREMENT
/begin MEASUREMENT egas_exd_gs_time_dn_b1 "Zeit Grosssprung Down" UWORD FORMULA_0623 0 0.0 0.0 325.0 READ_WRITE ECU_ADDRESS 0x3FB81A /end MEASUREMENT
/begin MEASUREMENT egas_exd_gs_time_dn_b2 "Zeit Grosssprung Down" UWORD FORMULA_0623 0 0.0 0.0 325.0 READ_WRITE ECU_ADDRESS 0x3FB81C /end MEASUREMENT
/begin MEASUREMENT egas_exd_gs_time_up_b1 "Zeit Grosssprung Up" UWORD FORMULA_0623 0 0.0 0.0 325.0 READ_WRITE ECU_ADDRESS 0x3FB816 /end MEASUREMENT
/begin MEASUREMENT egas_exd_gs_time_up_b2 "Zeit Grosssprung Up" UWORD FORMULA_0623 0 0.0 0.0 325.0 READ_WRITE ECU_ADDRESS 0x3FB818 /end MEASUREMENT
/begin MEASUREMENT egas_exd_ks_time_dn_b1 "Zeit Kleinsprung Down" UWORD FORMULA_0623 0 0.0 0.0 325.0 READ_WRITE ECU_ADDRESS 0x3FB812 /end MEASUREMENT
/begin MEASUREMENT egas_exd_ks_time_dn_b2 "Zeit Kleinsprung Down" UWORD FORMULA_0623 0 0.0 0.0 325.0 READ_WRITE ECU_ADDRESS 0x3FB814 /end MEASUREMENT
/begin MEASUREMENT egas_exd_ks_time_up_b1 "Zeit Kleinsprung Up" UWORD FORMULA_0623 0 0.0 0.0 325.0 READ_WRITE ECU_ADDRESS 0x3FB80E /end MEASUREMENT
/begin MEASUREMENT egas_exd_ks_time_up_b2 "Zeit Kleinsprung Up" UWORD FORMULA_0623 0 0.0 0.0 325.0 READ_WRITE ECU_ADDRESS 0x3FB810 /end MEASUREMENT
/begin MEASUREMENT egas_exd_lls_soll "Sollwert ext. LLS-Diagnose" SWORD FORMULA_0001 0 0.0 -10.0 120.0 READ_WRITE ECU_ADDRESS 0x3FB80C /end MEASUREMENT
/begin MEASUREMENT egas_exd_lls_state "Status ext. LLS-Diagnose" UBYTE FORMULA_0622 0 0.0 0.0 255.0 READ_WRITE ECU_ADDRESS 0x3FB806 /end MEASUREMENT
/begin MEASUREMENT egas_exd_r1_ra_max_b1 "max. Regeldifferenz Oeffnen 1" SWORD FORMULA_0001 0 0.0 -10.0 120.0 READ_WRITE ECU_ADDRESS 0x3FB81E /end MEASUREMENT
/begin MEASUREMENT egas_exd_r1_ra_max_b2 "max. Regeldifferenz Oeffnen 1" SWORD FORMULA_0001 0 0.0 -10.0 120.0 READ_WRITE ECU_ADDRESS 0x3FB820 /end MEASUREMENT
/begin MEASUREMENT egas_exd_r1_ra_sum_b1 "Integral Regelabweichung Oeffnen 1" ULONG FORMULA_0625 0 0.0 0.0 429496729.5 READ_WRITE ECU_ADDRESS 0x3FB85C /end MEASUREMENT
/begin MEASUREMENT egas_exd_r1_ra_sum_b2 "Integral Regelabweichung Oeffnen 1" ULONG FORMULA_0625 0 0.0 0.0 429496729.5 READ_WRITE ECU_ADDRESS 0x3FB860 /end MEASUREMENT
/begin MEASUREMENT egas_exd_r1_tv_mw_b1 "Mittelwert Tastverhaeltnis Oeffnen 1" SLONG FORMULA_0624 0 0.0 -1677721600.0 1677721599.2187 READ_WRITE ECU_ADDRESS 0x3FB844 /end MEASUREMENT
/begin MEASUREMENT egas_exd_r1_tv_mw_b2 "Mittelwert Tastverhaeltnis Oeffnen 1" SLONG FORMULA_0624 0 0.0 -1677721600.0 1677721599.2187 READ_WRITE ECU_ADDRESS 0x3FB848 /end MEASUREMENT
/begin MEASUREMENT egas_exd_r1_tv_sum_b1 "Integral Tastverhaeltnis Oeffnen 1" ULONG FORMULA_0624 0 0.0 0.0 3355443199.2187 READ_WRITE ECU_ADDRESS 0x3FB82C /end MEASUREMENT
/begin MEASUREMENT egas_exd_r1_tv_sum_b2 "Integral Tastverhaeltnis Oeffnen 1" ULONG FORMULA_0624 0 0.0 0.0 3355443199.2187 READ_WRITE ECU_ADDRESS 0x3FB830 /end MEASUREMENT
/begin MEASUREMENT egas_exd_r2_ra_max_b1 "max. Regeldifferenz Oeffnen 2" SWORD FORMULA_0001 0 0.0 -10.0 120.0 READ_WRITE ECU_ADDRESS 0x3FB822 /end MEASUREMENT
/begin MEASUREMENT egas_exd_r2_ra_max_b2 "max. Regeldifferenz Oeffnen 2" SWORD FORMULA_0001 0 0.0 -10.0 120.0 READ_WRITE ECU_ADDRESS 0x3FB824 /end MEASUREMENT
/begin MEASUREMENT egas_exd_r2_ra_sum_b1 "Integral Regelabweichung Oeffnen 1" ULONG FORMULA_0625 0 0.0 0.0 429496729.5 READ_WRITE ECU_ADDRESS 0x3FB864 /end MEASUREMENT
/begin MEASUREMENT egas_exd_r2_ra_sum_b2 "Integral Regelabweichung Oeffnen 1" ULONG FORMULA_0625 0 0.0 0.0 429496729.5 READ_WRITE ECU_ADDRESS 0x3FB868 /end MEASUREMENT
/begin MEASUREMENT egas_exd_r2_tv_mw_b1 "Mittelwert Tastverhaeltnis Oeffnen 2" SLONG FORMULA_0624 0 0.0 -1677721600.0 1677721599.2187 READ_WRITE ECU_ADDRESS 0x3FB84C /end MEASUREMENT
/begin MEASUREMENT egas_exd_r2_tv_mw_b2 "Mittelwert Tastverhaeltnis Oeffnen 2" SLONG FORMULA_0624 0 0.0 -1677721600.0 1677721599.2187 READ_WRITE ECU_ADDRESS 0x3FB850 /end MEASUREMENT
/begin MEASUREMENT egas_exd_r2_tv_sum_b1 "Integral Tastverhaeltnis Oeffnen 2" ULONG FORMULA_0624 0 0.0 0.0 3355443199.2187 READ_WRITE ECU_ADDRESS 0x3FB834 /end MEASUREMENT
/begin MEASUREMENT egas_exd_r2_tv_sum_b2 "Integral Tastverhaeltnis Oeffnen 2" ULONG FORMULA_0624 0 0.0 0.0 3355443199.2187 READ_WRITE ECU_ADDRESS 0x3FB838 /end MEASUREMENT
/begin MEASUREMENT egas_exd_r3_ra_max_b1 "max. Regeldifferenz Schliessen" SWORD FORMULA_0001 0 0.0 -10.0 120.0 READ_WRITE ECU_ADDRESS 0x3FB826 /end MEASUREMENT
/begin MEASUREMENT egas_exd_r3_ra_max_b2 "max. Regeldifferenz Schliessen" SWORD FORMULA_0001 0 0.0 -10.0 120.0 READ_WRITE ECU_ADDRESS 0x3FB828 /end MEASUREMENT
/begin MEASUREMENT egas_exd_r3_ra_sum_b1 "Integral Regelabweichung Oeffnen 1" ULONG FORMULA_0625 0 0.0 0.0 429496729.5 READ_WRITE ECU_ADDRESS 0x3FB86C /end MEASUREMENT
/begin MEASUREMENT egas_exd_r3_ra_sum_b2 "Integral Regelabweichung Oeffnen 1" ULONG FORMULA_0625 0 0.0 0.0 429496729.5 READ_WRITE ECU_ADDRESS 0x3FB870 /end MEASUREMENT
/begin MEASUREMENT egas_exd_r3_tv_mw_b1 "Mittelwert Tastverhaeltnis Schliessen" SLONG FORMULA_0624 0 0.0 -1677721600.0 1677721599.2187 READ_WRITE ECU_ADDRESS 0x3FB854 /end MEASUREMENT
/begin MEASUREMENT egas_exd_r3_tv_mw_b2 "Mittelwert Tastverhaeltnis Schliessen" SLONG FORMULA_0624 0 0.0 -1677721600.0 1677721599.2187 READ_WRITE ECU_ADDRESS 0x3FB858 /end MEASUREMENT
/begin MEASUREMENT egas_exd_r3_tv_sum_b1 "Integral Tastverhaeltnis Schliessen" ULONG FORMULA_0624 0 0.0 0.0 3355443199.2187 READ_WRITE ECU_ADDRESS 0x3FB83C /end MEASUREMENT
/begin MEASUREMENT egas_exd_r3_tv_sum_b2 "Integral Tastverhaeltnis Schliessen" ULONG FORMULA_0624 0 0.0 0.0 3355443199.2187 READ_WRITE ECU_ADDRESS 0x3FB840 /end MEASUREMENT
/begin MEASUREMENT egas_exd_soll "Sollwert ext. Diagnose" SWORD FORMULA_0001 0 0.0 -10.0 120.0 READ_WRITE ARRAY_SIZE 4 ECU_ADDRESS 0x3FB874 MATRIX_DIM 4 1 1 /end MEASUREMENT
/begin MEASUREMENT egas_exd_timeout "Sollwert Timeout" UWORD FORMULA_0626 0 0.0 0.0 65535.0 READ_WRITE ARRAY_SIZE 4 ECU_ADDRESS 0x3FB87C MATRIX_DIM 4 1 1 /end MEASUREMENT
/begin MEASUREMENT egas_exd_timeout_en "EnLtg Timeout" UWORD FORMULA_0626 0 0.0 0.0 65535.0 READ_WRITE ECU_ADDRESS 0x3FB884 /end MEASUREMENT
/begin MEASUREMENT egas_exd_timer "Timer ext. Diagnose" UWORD FORMULA_0590 0 0.0 0.0 327.6749877929688 READ_WRITE ECU_ADDRESS 0x3FB808 /end MEASUREMENT
/begin MEASUREMENT egas_lls.flags_adpt_b1 "Adaptionsflag" UBYTE FORMULA_0600 0 0.0 0.0 255.0 READ_WRITE BIT_MASK 0x3 ECU_ADDRESS 0x3FB6E2 /end MEASUREMENT
/begin MEASUREMENT egas_lls.flags_adpt_b2 "Adaptionsflag" UBYTE FORMULA_0600 0 0.0 0.0 255.0 READ_WRITE BIT_MASK 0x3 ECU_ADDRESS 0x3FB6FC /end MEASUREMENT
/begin MEASUREMENT egas_lls_b1.alive_err "Zaehler Aliveerror" UBYTE FORMULA_0003 0 0.0 0.0 255.0 READ_WRITE ECU_ADDRESS 0x3FB6E3 /end MEASUREMENT
/begin MEASUREMENT egas_lls_b1.can_st "CAN-Status" UBYTE FORMULA_0117 0 0.0 0.0 255.0 READ_WRITE ECU_ADDRESS 0x3FB6DB /end MEASUREMENT
/begin MEASUREMENT egas_lls_b1.fail_cnt "Zaehler Fail-Status" UBYTE FORMULA_0003 0 0.0 0.0 255.0 READ_WRITE ECU_ADDRESS 0x3FB6E8 /end MEASUREMENT
/begin MEASUREMENT egas_lls_b1.fail_st "Failsafe-Status" UWORD FORMULA_0596 0 0.0 0.0 65535.0 READ_WRITE ECU_ADDRESS 0x3FB6E4 /end MEASUREMENT
/begin MEASUREMENT egas_lls_b1.flags "LLS-Flags" UBYTE FORMULA_0003 0 0.0 0.0 255.0 READ_WRITE ECU_ADDRESS 0x3FB6E2 /end MEASUREMENT
/begin MEASUREMENT egas_lls_b1.mode "LLS-Mode" UBYTE FORMULA_0598 0 0.0 0.0 255.0 READ_WRITE ECU_ADDRESS 0x3FB6DC /end MEASUREMENT
/begin MEASUREMENT egas_lls_b1.mode_can "LLS-Mode CAN" UBYTE FORMULA_0599 0 0.0 0.0 255.0 READ_WRITE ECU_ADDRESS 0x3FB6DD /end MEASUREMENT
/begin MEASUREMENT egas_lls_b1.r_adapt_st "Adaptionsstatus" UBYTE FORMULA_0434 0 0.0 0.0 255.0 READ_WRITE ECU_ADDRESS 0x3FB6D1 /end MEASUREMENT
/begin MEASUREMENT egas_lls_b1.r_alive "R-Alive" UBYTE FORMULA_0003 0 0.0 0.0 255.0 READ_WRITE ECU_ADDRESS 0x3FB6D9 /end MEASUREMENT
/begin MEASUREMENT egas_lls_b1.r_diag_clr "Zaehler DiagClr" UBYTE FORMULA_0003 0 0.0 0.0 255.0 READ_WRITE ECU_ADDRESS 0x3FB6E9 /end MEASUREMENT
/begin MEASUREMENT egas_lls_b1.r_diag_st "Diagnosestatus" UWORD FORMULA_0433 0 0.0 0.0 65535.0 READ_WRITE ECU_ADDRESS 0x3FB6D2 /end MEASUREMENT
/begin MEASUREMENT egas_lls_b1.r_gpos "Istwert (roh)" SWORD FORMULA_0001 0 0.0 -10.0 120.0 READ_WRITE ECU_ADDRESS 0x3FB6D6 /end MEASUREMENT
/begin MEASUREMENT egas_lls_b1.r_mode "R-Mode" UBYTE FORMULA_0597 0 0.0 0.0 255.0 READ_WRITE ECU_ADDRESS 0x3FB6D0 /end MEASUREMENT
/begin MEASUREMENT egas_lls_b1.r_sollw "R-Sollwert" SWORD FORMULA_0001 0 0.0 -10.0 120.0 READ_WRITE ECU_ADDRESS 0x3FB6D4 /end MEASUREMENT
/begin MEASUREMENT egas_lls_b1.r_tv "Tastverhaeltnis" UBYTE FORMULA_0585 0 0.0 -100.0 99.21869659423828 READ_WRITE ECU_ADDRESS 0x3FB6DA /end MEASUREMENT
/begin MEASUREMENT egas_lls_b1.state "State" UBYTE FORMULA_0436 0 0.0 0.0 255.0 READ_WRITE ECU_ADDRESS 0x3FB6DE /end MEASUREMENT
/begin MEASUREMENT egas_lls_b1.state_time "Zeit im akt. State" UWORD FORMULA_0590 0 0.0 0.0 327.6749877929688 READ_WRITE ECU_ADDRESS 0x3FB6E0 /end MEASUREMENT
/begin MEASUREMENT egas_lls_b2.alive_err "Zaehler Aliveerror" UBYTE FORMULA_0003 0 0.0 0.0 255.0 READ_WRITE ECU_ADDRESS 0x3FB6FD /end MEASUREMENT
/begin MEASUREMENT egas_lls_b2.can_st "CAN-Status" UBYTE FORMULA_0117 0 0.0 0.0 255.0 READ_WRITE ECU_ADDRESS 0x3FB6F5 /end MEASUREMENT
/begin MEASUREMENT egas_lls_b2.fail_cnt "Zaehler Fail-Status" UBYTE FORMULA_0003 0 0.0 0.0 255.0 READ_WRITE ECU_ADDRESS 0x3FB702 /end MEASUREMENT
/begin MEASUREMENT egas_lls_b2.fail_st "Failsafe-Status" UWORD FORMULA_0596 0 0.0 0.0 65535.0 READ_WRITE ECU_ADDRESS 0x3FB6FE /end MEASUREMENT
/begin MEASUREMENT egas_lls_b2.flags "LLS-Flags" UBYTE FORMULA_0003 0 0.0 0.0 255.0 READ_WRITE ECU_ADDRESS 0x3FB6FC /end MEASUREMENT
/begin MEASUREMENT egas_lls_b2.mode "LLS-Mode" UBYTE FORMULA_0598 0 0.0 0.0 255.0 READ_WRITE ECU_ADDRESS 0x3FB6F6 /end MEASUREMENT
/begin MEASUREMENT egas_lls_b2.mode_can "LLS-Mode CAN" UBYTE FORMULA_0599 0 0.0 0.0 255.0 READ_WRITE ECU_ADDRESS 0x3FB6F7 /end MEASUREMENT
/begin MEASUREMENT egas_lls_b2.r_adapt_st "Adaptionsstatus" UBYTE FORMULA_0434 0 0.0 0.0 255.0 READ_WRITE ECU_ADDRESS 0x3FB6EB /end MEASUREMENT
/begin MEASUREMENT egas_lls_b2.r_alive "R-Alive" UBYTE FORMULA_0003 0 0.0 0.0 255.0 READ_WRITE ECU_ADDRESS 0x3FB6F3 /end MEASUREMENT
/begin MEASUREMENT egas_lls_b2.r_diag_clr "Zaehler DiagClr" UBYTE FORMULA_0003 0 0.0 0.0 255.0 READ_WRITE ECU_ADDRESS 0x3FB703 /end MEASUREMENT
/begin MEASUREMENT egas_lls_b2.r_diag_st "Diagnosestatus" UWORD FORMULA_0433 0 0.0 0.0 65535.0 READ_WRITE ECU_ADDRESS 0x3FB6EC /end MEASUREMENT
/begin MEASUREMENT egas_lls_b2.r_gpos "Istwert (roh)" SWORD FORMULA_0001 0 0.0 -10.0 120.0 READ_WRITE ECU_ADDRESS 0x3FB6F0 /end MEASUREMENT
/begin MEASUREMENT egas_lls_b2.r_mode "R-Mode" UBYTE FORMULA_0597 0 0.0 0.0 255.0 READ_WRITE ECU_ADDRESS 0x3FB6EA /end MEASUREMENT
/begin MEASUREMENT egas_lls_b2.r_sollw "R-Sollwert" SWORD FORMULA_0001 0 0.0 -10.0 120.0 READ_WRITE ECU_ADDRESS 0x3FB6EE /end MEASUREMENT
/begin MEASUREMENT egas_lls_b2.r_tv "Tastverhaeltnis" UBYTE FORMULA_0585 0 0.0 -100.0 99.21869659423828 READ_WRITE ECU_ADDRESS 0x3FB6F4 /end MEASUREMENT
/begin MEASUREMENT egas_lls_b2.state "State" UBYTE FORMULA_0436 0 0.0 0.0 255.0 READ_WRITE ECU_ADDRESS 0x3FB6F8 /end MEASUREMENT
/begin MEASUREMENT egas_lls_b2.state_time "Zeit im akt. State" UWORD FORMULA_0590 0 0.0 0.0 327.6749877929688 READ_WRITE ECU_ADDRESS 0x3FB6FA /end MEASUREMENT
/begin MEASUREMENT egas_lls_neuinit_cnt "Anzahl LLS-Neuinits" UBYTE FORMULA_0003 0 0.0 0.0 255.0 READ_WRITE ECU_ADDRESS 0x3FB800 /end MEASUREMENT
/begin MEASUREMENT egas_lls_startup "LLS-Startstate" UBYTE FORMULA_0619 0 0.0 0.0 255.0 READ_WRITE ECU_ADDRESS 0x3FB7FC /end MEASUREMENT
/begin MEASUREMENT egas_n_aq "gefilterte Drehzahl" SWORD FORMULA_0006 0 0.0 0.0 10000.0 READ_WRITE ECU_ADDRESS 0x3FB660 /end MEASUREMENT
/begin MEASUREMENT egas_rec_dk_b1.cs_err "CS-Error" UBYTE FORMULA_0003 0 0.0 0.0 255.0 READ_WRITE ECU_ADDRESS 0x3FB77B /end MEASUREMENT
/begin MEASUREMENT egas_rec_dk_b1.ed "ED-Status" UWORD FORMULA_0612 0 0.0 0.0 65535.0 READ_WRITE ECU_ADDRESS 0x3FB782 /end MEASUREMENT
/begin MEASUREMENT egas_rec_dk_b1.r_bank "Zylinder" UBYTE FORMULA_0003 0 0.0 0.0 255.0 READ_WRITE ECU_ADDRESS 0x3FB772 /end MEASUREMENT
/begin MEASUREMENT egas_rec_dk_b1.r_cmd "R-CMD-B1" UBYTE FORMULA_0610 0 0.0 0.0 255.0 READ_WRITE ECU_ADDRESS 0x3FB771 /end MEASUREMENT
/begin MEASUREMENT egas_rec_dk_b1.r_diag_st "Diagnosestatus" UWORD FORMULA_0613 0 0.0 0.0 65535.0 READ_WRITE ECU_ADDRESS 0x3FB778 /end MEASUREMENT
/begin MEASUREMENT egas_rec_dk_b1.r_hw_vers "HW-Version" UWORD FORMULA_0010 0 0.0 0.0 65535.0 READ_WRITE ECU_ADDRESS 0x3FB774 /end MEASUREMENT
/begin MEASUREMENT egas_rec_dk_b1.r_ko_vers "Kommunikationsversion" UBYTE FORMULA_0003 0 0.0 0.0 255.0 READ_WRITE ECU_ADDRESS 0x3FB773 /end MEASUREMENT
/begin MEASUREMENT egas_rec_dk_b1.r_set_vers "Kommunikationsversion" UBYTE FORMULA_0003 0 0.0 0.0 255.0 READ_WRITE ECU_ADDRESS 0x3FB77A /end MEASUREMENT
/begin MEASUREMENT egas_rec_dk_b1.r_sw_vers "SW-Version" UWORD FORMULA_0010 0 0.0 0.0 65535.0 READ_WRITE ECU_ADDRESS 0x3FB776 /end MEASUREMENT
/begin MEASUREMENT egas_rec_dk_b1.rec_ack "Receive-Ack" UWORD FORMULA_0080 0 0.0 0.0 65535.0 READ_WRITE ECU_ADDRESS 0x3FB77E /end MEASUREMENT
/begin MEASUREMENT egas_rec_dk_b1.rec_err "Receive-Error" UWORD FORMULA_0080 0 0.0 0.0 65535.0 READ_WRITE ECU_ADDRESS 0x3FB780 /end MEASUREMENT
/begin MEASUREMENT egas_rec_dk_b1.status "Empfangsstatus" UBYTE FORMULA_0611 0 0.0 0.0 255.0 READ_WRITE ECU_ADDRESS 0x3FB77C /end MEASUREMENT
/begin MEASUREMENT egas_rec_dk_b2.cs_err "CS-Error" UBYTE FORMULA_0003 0 0.0 0.0 255.0 READ_WRITE ECU_ADDRESS 0x3FB78F /end MEASUREMENT
/begin MEASUREMENT egas_rec_dk_b2.ed "ED-Status" UWORD FORMULA_0612 0 0.0 0.0 65535.0 READ_WRITE ECU_ADDRESS 0x3FB796 /end MEASUREMENT
/begin MEASUREMENT egas_rec_dk_b2.r_bank "Zylinder" UBYTE FORMULA_0003 0 0.0 0.0 255.0 READ_WRITE ECU_ADDRESS 0x3FB786 /end MEASUREMENT
/begin MEASUREMENT egas_rec_dk_b2.r_cmd "R-CMD-B1" UBYTE FORMULA_0610 0 0.0 0.0 255.0 READ_WRITE ECU_ADDRESS 0x3FB785 /end MEASUREMENT
/begin MEASUREMENT egas_rec_dk_b2.r_diag_st "Diagnosestatus" UWORD FORMULA_0613 0 0.0 0.0 65535.0 READ_WRITE ECU_ADDRESS 0x3FB78C /end MEASUREMENT
/begin MEASUREMENT egas_rec_dk_b2.r_hw_vers "HW-Version" UWORD FORMULA_0010 0 0.0 0.0 65535.0 READ_WRITE ECU_ADDRESS 0x3FB788 /end MEASUREMENT
/begin MEASUREMENT egas_rec_dk_b2.r_ko_vers "Kommunikationsversion" UBYTE FORMULA_0003 0 0.0 0.0 255.0 READ_WRITE ECU_ADDRESS 0x3FB787 /end MEASUREMENT
/begin MEASUREMENT egas_rec_dk_b2.r_set_vers "Kommunikationsversion" UBYTE FORMULA_0003 0 0.0 0.0 255.0 READ_WRITE ECU_ADDRESS 0x3FB78E /end MEASUREMENT
/begin MEASUREMENT egas_rec_dk_b2.r_sw_vers "SW-Version" UWORD FORMULA_0010 0 0.0 0.0 65535.0 READ_WRITE ECU_ADDRESS 0x3FB78A /end MEASUREMENT
/begin MEASUREMENT egas_rec_dk_b2.rec_ack "Receive-Ack" UWORD FORMULA_0080 0 0.0 0.0 65535.0 READ_WRITE ECU_ADDRESS 0x3FB792 /end MEASUREMENT
/begin MEASUREMENT egas_rec_dk_b2.rec_err "Receive-Error" UWORD FORMULA_0080 0 0.0 0.0 65535.0 READ_WRITE ECU_ADDRESS 0x3FB794 /end MEASUREMENT
/begin MEASUREMENT egas_rec_dk_b2.status "Empfangsstatus" UBYTE FORMULA_0611 0 0.0 0.0 255.0 READ_WRITE ECU_ADDRESS 0x3FB790 /end MEASUREMENT
/begin MEASUREMENT egas_rec_dk_bX.cs_err "CS-Error" UBYTE FORMULA_0003 0 0.0 0.0 255.0 READ_WRITE ECU_ADDRESS 0x3FB7A3 /end MEASUREMENT
/begin MEASUREMENT egas_rec_dk_bX.ed "ED-Status" UWORD FORMULA_0612 0 0.0 0.0 65535.0 READ_WRITE ECU_ADDRESS 0x3FB7AA /end MEASUREMENT
/begin MEASUREMENT egas_rec_dk_bX.r_bank "Zylinder" UBYTE FORMULA_0003 0 0.0 0.0 255.0 READ_WRITE ECU_ADDRESS 0x3FB79A /end MEASUREMENT
/begin MEASUREMENT egas_rec_dk_bX.r_cmd "R-CMD-B1" UBYTE FORMULA_0610 0 0.0 0.0 255.0 READ_WRITE ECU_ADDRESS 0x3FB799 /end MEASUREMENT
/begin MEASUREMENT egas_rec_dk_bX.r_diag_st "Diagnosestatus" UWORD FORMULA_0613 0 0.0 0.0 65535.0 READ_WRITE ECU_ADDRESS 0x3FB7A0 /end MEASUREMENT
/begin MEASUREMENT egas_rec_dk_bX.r_hw_vers "HW-Version" UWORD FORMULA_0010 0 0.0 0.0 65535.0 READ_WRITE ECU_ADDRESS 0x3FB79C /end MEASUREMENT
/begin MEASUREMENT egas_rec_dk_bX.r_ko_vers "Kommunikationsversion" UBYTE FORMULA_0003 0 0.0 0.0 255.0 READ_WRITE ECU_ADDRESS 0x3FB79B /end MEASUREMENT
/begin MEASUREMENT egas_rec_dk_bX.r_set_vers "Kommunikationsversion" UBYTE FORMULA_0003 0 0.0 0.0 255.0 READ_WRITE ECU_ADDRESS 0x3FB7A2 /end MEASUREMENT
/begin MEASUREMENT egas_rec_dk_bX.r_sw_vers "SW-Version" UWORD FORMULA_0010 0 0.0 0.0 65535.0 READ_WRITE ECU_ADDRESS 0x3FB79E /end MEASUREMENT
/begin MEASUREMENT egas_rec_dk_bX.rec_ack "Receive-Ack" UWORD FORMULA_0080 0 0.0 0.0 65535.0 READ_WRITE ECU_ADDRESS 0x3FB7A6 /end MEASUREMENT
/begin MEASUREMENT egas_rec_dk_bX.rec_err "Receive-Error" UWORD FORMULA_0080 0 0.0 0.0 65535.0 READ_WRITE ECU_ADDRESS 0x3FB7A8 /end MEASUREMENT
/begin MEASUREMENT egas_rec_dk_bX.status "Empfangsstatus" UBYTE FORMULA_0611 0 0.0 0.0 255.0 READ_WRITE ECU_ADDRESS 0x3FB7A4 /end MEASUREMENT
/begin MEASUREMENT egas_rec_lls_b1.cs_err "CS-Error" UBYTE FORMULA_0003 0 0.0 0.0 255.0 READ_WRITE ECU_ADDRESS 0x3FB729 /end MEASUREMENT
/begin MEASUREMENT egas_rec_lls_b1.ed "ED-Status" UWORD FORMULA_0612 0 0.0 0.0 65535.0 READ_WRITE ECU_ADDRESS 0x3FB730 /end MEASUREMENT
/begin MEASUREMENT egas_rec_lls_b1.r_bank "Zylinder" UBYTE FORMULA_0003 0 0.0 0.0 255.0 READ_WRITE ECU_ADDRESS 0x3FB720 /end MEASUREMENT
/begin MEASUREMENT egas_rec_lls_b1.r_cmd "R-CMD-B1" UBYTE FORMULA_0610 0 0.0 0.0 255.0 READ_WRITE ECU_ADDRESS 0x3FB71F /end MEASUREMENT
/begin MEASUREMENT egas_rec_lls_b1.r_diag_st "Diagnosestatus" UWORD FORMULA_0010 0 0.0 0.0 65535.0 READ_WRITE ECU_ADDRESS 0x3FB726 /end MEASUREMENT
/begin MEASUREMENT egas_rec_lls_b1.r_hw_vers "HW-Version" UWORD FORMULA_0010 0 0.0 0.0 65535.0 READ_WRITE ECU_ADDRESS 0x3FB722 /end MEASUREMENT
/begin MEASUREMENT egas_rec_lls_b1.r_ko_vers "Kommunikationsversion" UBYTE FORMULA_0003 0 0.0 0.0 255.0 READ_WRITE ECU_ADDRESS 0x3FB721 /end MEASUREMENT
/begin MEASUREMENT egas_rec_lls_b1.r_set_vers "Kommunikationsversion" UBYTE FORMULA_0003 0 0.0 0.0 255.0 READ_WRITE ECU_ADDRESS 0x3FB728 /end MEASUREMENT
/begin MEASUREMENT egas_rec_lls_b1.r_sw_vers "SW-Version" UWORD FORMULA_0010 0 0.0 0.0 65535.0 READ_WRITE ECU_ADDRESS 0x3FB724 /end MEASUREMENT
/begin MEASUREMENT egas_rec_lls_b1.rec_ack "Receive-Ack" UWORD FORMULA_0080 0 0.0 0.0 65535.0 READ_WRITE ECU_ADDRESS 0x3FB72C /end MEASUREMENT
/begin MEASUREMENT egas_rec_lls_b1.rec_err "Receive-Error" UWORD FORMULA_0080 0 0.0 0.0 65535.0 READ_WRITE ECU_ADDRESS 0x3FB72E /end MEASUREMENT
/begin MEASUREMENT egas_rec_lls_b1.status "Empfangsstatus" UBYTE FORMULA_0611 0 0.0 0.0 255.0 READ_WRITE ECU_ADDRESS 0x3FB72A /end MEASUREMENT
/begin MEASUREMENT egas_rec_lls_b2.cs_err "CS-Error" UBYTE FORMULA_0003 0 0.0 0.0 255.0 READ_WRITE ECU_ADDRESS 0x3FB73D /end MEASUREMENT
/begin MEASUREMENT egas_rec_lls_b2.ed "ED-Status" UWORD FORMULA_0612 0 0.0 0.0 65535.0 READ_WRITE ECU_ADDRESS 0x3FB744 /end MEASUREMENT
/begin MEASUREMENT egas_rec_lls_b2.r_bank "Zylinder" UBYTE FORMULA_0003 0 0.0 0.0 255.0 READ_WRITE ECU_ADDRESS 0x3FB734 /end MEASUREMENT
/begin MEASUREMENT egas_rec_lls_b2.r_cmd "R-CMD-B1" UBYTE FORMULA_0610 0 0.0 0.0 255.0 READ_WRITE ECU_ADDRESS 0x3FB733 /end MEASUREMENT
/begin MEASUREMENT egas_rec_lls_b2.r_diag_st "Diagnosestatus" UWORD FORMULA_0010 0 0.0 0.0 65535.0 READ_WRITE ECU_ADDRESS 0x3FB73A /end MEASUREMENT
/begin MEASUREMENT egas_rec_lls_b2.r_hw_vers "HW-Version" UWORD FORMULA_0010 0 0.0 0.0 65535.0 READ_WRITE ECU_ADDRESS 0x3FB736 /end MEASUREMENT
/begin MEASUREMENT egas_rec_lls_b2.r_ko_vers "Kommunikationsversion" UBYTE FORMULA_0003 0 0.0 0.0 255.0 READ_WRITE ECU_ADDRESS 0x3FB735 /end MEASUREMENT
/begin MEASUREMENT egas_rec_lls_b2.r_set_vers "Kommunikationsversion" UBYTE FORMULA_0003 0 0.0 0.0 255.0 READ_WRITE ECU_ADDRESS 0x3FB73C /end MEASUREMENT
/begin MEASUREMENT egas_rec_lls_b2.r_sw_vers "SW-Version" UWORD FORMULA_0010 0 0.0 0.0 65535.0 READ_WRITE ECU_ADDRESS 0x3FB738 /end MEASUREMENT
/begin MEASUREMENT egas_rec_lls_b2.rec_ack "Receive-Ack" UWORD FORMULA_0080 0 0.0 0.0 65535.0 READ_WRITE ECU_ADDRESS 0x3FB740 /end MEASUREMENT
/begin MEASUREMENT egas_rec_lls_b2.rec_err "Receive-Error" UWORD FORMULA_0080 0 0.0 0.0 65535.0 READ_WRITE ECU_ADDRESS 0x3FB742 /end MEASUREMENT
/begin MEASUREMENT egas_rec_lls_b2.status "Empfangsstatus" UBYTE FORMULA_0611 0 0.0 0.0 255.0 READ_WRITE ECU_ADDRESS 0x3FB73E /end MEASUREMENT
/begin MEASUREMENT egas_rec_lls_bX.cs_err "CS-Error" UBYTE FORMULA_0003 0 0.0 0.0 255.0 READ_WRITE ECU_ADDRESS 0x3FB751 /end MEASUREMENT
/begin MEASUREMENT egas_rec_lls_bX.ed "ED-Status" UWORD FORMULA_0612 0 0.0 0.0 65535.0 READ_WRITE ECU_ADDRESS 0x3FB758 /end MEASUREMENT
/begin MEASUREMENT egas_rec_lls_bX.r_bank "Zylinder" UBYTE FORMULA_0003 0 0.0 0.0 255.0 READ_WRITE ECU_ADDRESS 0x3FB748 /end MEASUREMENT
/begin MEASUREMENT egas_rec_lls_bX.r_cmd "R-CMD-B1" UBYTE FORMULA_0610 0 0.0 0.0 255.0 READ_WRITE ECU_ADDRESS 0x3FB747 /end MEASUREMENT
/begin MEASUREMENT egas_rec_lls_bX.r_diag_st "Diagnosestatus" UWORD FORMULA_0010 0 0.0 0.0 65535.0 READ_WRITE ECU_ADDRESS 0x3FB74E /end MEASUREMENT
/begin MEASUREMENT egas_rec_lls_bX.r_hw_vers "HW-Version" UWORD FORMULA_0010 0 0.0 0.0 65535.0 READ_WRITE ECU_ADDRESS 0x3FB74A /end MEASUREMENT
/begin MEASUREMENT egas_rec_lls_bX.r_ko_vers "Kommunikationsversion" UBYTE FORMULA_0003 0 0.0 0.0 255.0 READ_WRITE ECU_ADDRESS 0x3FB749 /end MEASUREMENT
/begin MEASUREMENT egas_rec_lls_bX.r_set_vers "Kommunikationsversion" UBYTE FORMULA_0003 0 0.0 0.0 255.0 READ_WRITE ECU_ADDRESS 0x3FB750 /end MEASUREMENT
/begin MEASUREMENT egas_rec_lls_bX.r_sw_vers "SW-Version" UWORD FORMULA_0010 0 0.0 0.0 65535.0 READ_WRITE ECU_ADDRESS 0x3FB74C /end MEASUREMENT
/begin MEASUREMENT egas_rec_lls_bX.rec_ack "Receive-Ack" UWORD FORMULA_0080 0 0.0 0.0 65535.0 READ_WRITE ECU_ADDRESS 0x3FB754 /end MEASUREMENT
/begin MEASUREMENT egas_rec_lls_bX.rec_err "Receive-Error" UWORD FORMULA_0080 0 0.0 0.0 65535.0 READ_WRITE ECU_ADDRESS 0x3FB756 /end MEASUREMENT
/begin MEASUREMENT egas_rec_lls_bX.status "Empfangsstatus" UBYTE FORMULA_0611 0 0.0 0.0 255.0 READ_WRITE ECU_ADDRESS 0x3FB752 /end MEASUREMENT
/begin MEASUREMENT egas_sk.fzust_dk_b1 "SK-Zustand der DK" UBYTE FORMULA_0615 0 0.0 0.0 255.0 READ_WRITE BIT_MASK 0xF0 ECU_ADDRESS 0x3FB7AD /end MEASUREMENT
/begin MEASUREMENT egas_sk.fzust_dk_b2 "SK-Zustand der DK" UBYTE FORMULA_0615 0 0.0 0.0 255.0 READ_WRITE BIT_MASK 0xF0 ECU_ADDRESS 0x3FB7D5 /end MEASUREMENT
/begin MEASUREMENT egas_sk_b1.dk_diff_max "max. Differenz Soll/Ist" SWORD FORMULA_0001 0 0.0 -10.0 120.0 READ_WRITE ECU_ADDRESS 0x3FB7AE /end MEASUREMENT
/begin MEASUREMENT egas_sk_b1.dk_off_rampe "DK-Abschaltungrampe" SWORD FORMULA_0617 0 0.0 -655360.0 655340.0 READ_WRITE ECU_ADDRESS 0x3FB7C4 /end MEASUREMENT
/begin MEASUREMENT egas_sk_b1.rf_io "iO-Counter" UBYTE FORMULA_0003 0 0.0 0.0 16.0 READ_WRITE ECU_ADDRESS 0x3FB7D0 /end MEASUREMENT
/begin MEASUREMENT egas_sk_b1.rf_io_delta "Zulaessige Rf-Abweichung" SWORD FORMULA_0007 0 0.0 0.0 2.0 READ_WRITE ECU_ADDRESS 0x3FB7CE /end MEASUREMENT
/begin MEASUREMENT egas_sk_b1.rf_io_ring "Ringpuffer" UWORD FORMULA_0010 0 0.0 0.0 65535.0 READ_WRITE ECU_ADDRESS 0x3FB7CC /end MEASUREMENT
/begin MEASUREMENT egas_sk_b1.soll_dk "DK-Sollwert gefiltert" SWORD FORMULA_0001 0 0.0 -10.0 120.0 READ_WRITE ECU_ADDRESS 0x3FB7C6 /end MEASUREMENT
/begin MEASUREMENT egas_sk_b1.soll_lls "LLS-Sollwert gefiltert" SWORD FORMULA_0001 0 0.0 -10.0 120.0 READ_WRITE ECU_ADDRESS 0x3FB7C8 /end MEASUREMENT
/begin MEASUREMENT egas_sk_b1.t_dk_offen_1 "Zeit fuer Spalt offen" UWORD FORMULA_0021 0 0.0 0.0 10.0 READ_WRITE ECU_ADDRESS 0x3FB7C0 /end MEASUREMENT
/begin MEASUREMENT egas_sk_b1.t_dk_offen_2 "Zeit fuer Klemmen offen" UWORD FORMULA_0021 0 0.0 0.0 10.0 READ_WRITE ECU_ADDRESS 0x3FB7C2 /end MEASUREMENT
/begin MEASUREMENT egas_sk_b1.t_ist_dk "Zeit Soll-/Istabweichung" UWORD FORMULA_0021 0 0.0 0.0 10.0 READ_WRITE ECU_ADDRESS 0x3FB7B6 /end MEASUREMENT
/begin MEASUREMENT egas_sk_b1.t_ist_lls "Zeit Soll-/Istabweichung" UWORD FORMULA_0021 0 0.0 0.0 10.0 READ_WRITE ECU_ADDRESS 0x3FB7B8 /end MEASUREMENT
/begin MEASUREMENT egas_sk_b1.t_mode_dk "Zeit DK-Modeabweichung" UWORD FORMULA_0021 0 0.0 0.0 10.0 READ_WRITE ECU_ADDRESS 0x3FB7BE /end MEASUREMENT
/begin MEASUREMENT egas_sk_b1.t_mode_lls "Zeit LLS-Modeabweichung" UWORD FORMULA_0021 0 0.0 0.0 10.0 READ_WRITE ECU_ADDRESS 0x3FB7BC /end MEASUREMENT
/begin MEASUREMENT egas_sk_b1.t_rgpos_dk "Zeit RGPOS-Fehler" UBYTE FORMULA_0306 0 0.0 0.0 2.0 READ_WRITE ECU_ADDRESS 0x3FB7D2 /end MEASUREMENT
/begin MEASUREMENT egas_sk_b1.t_rgpos_lls "Zeit RGPOS-Fehler" UBYTE FORMULA_0306 0 0.0 0.0 2.0 READ_WRITE ECU_ADDRESS 0x3FB7D1 /end MEASUREMENT
/begin MEASUREMENT egas_sk_b1.t_soll_dk "Zeit Sollwertabweichung" UWORD FORMULA_0021 0 0.0 0.0 10.0 READ_WRITE ECU_ADDRESS 0x3FB7B2 /end MEASUREMENT
/begin MEASUREMENT egas_sk_b1.t_soll_lls "Zeit Sollwertabweichung" UWORD FORMULA_0021 0 0.0 0.0 10.0 READ_WRITE ECU_ADDRESS 0x3FB7B4 /end MEASUREMENT
/begin MEASUREMENT egas_sk_b1.t_wdk "Zeit Analog-/CAN-Abweichung" UWORD FORMULA_0021 0 0.0 0.0 10.0 READ_WRITE ECU_ADDRESS 0x3FB7BA /end MEASUREMENT
/begin MEASUREMENT egas_sk_b1.wdk_diff_max "max. Differenz CAN/WDK" SWORD FORMULA_0001 0 0.0 -10.0 120.0 READ_WRITE ECU_ADDRESS 0x3FB7B0 /end MEASUREMENT
/begin MEASUREMENT egas_sk_b1.zust_dk "SK-Zustand der DK" UBYTE FORMULA_0614 0 0.0 0.0 255.0 READ_WRITE BIT_MASK 0xF ECU_ADDRESS 0x3FB7AD /end MEASUREMENT
/begin MEASUREMENT egas_sk_b1.zust_lls "SK-Zustand der LLS" UBYTE FORMULA_0616 0 0.0 0.0 255.0 READ_WRITE ECU_ADDRESS 0x3FB7AC /end MEASUREMENT
/begin MEASUREMENT egas_sk_b2.dk_diff_max "max. Differenz Soll/Ist" SWORD FORMULA_0001 0 0.0 -10.0 120.0 READ_WRITE ECU_ADDRESS 0x3FB7D6 /end MEASUREMENT
/begin MEASUREMENT egas_sk_b2.dk_off_rampe "DK-Abschaltungrampe" SWORD FORMULA_0617 0 0.0 -655360.0 655340.0 READ_WRITE ECU_ADDRESS 0x3FB7EC /end MEASUREMENT
/begin MEASUREMENT egas_sk_b2.rf_io "iO-Counter" UBYTE FORMULA_0003 0 0.0 0.0 16.0 READ_WRITE ECU_ADDRESS 0x3FB7F8 /end MEASUREMENT
/begin MEASUREMENT egas_sk_b2.rf_io_delta "Zulaessige Rf-Abweichung" SWORD FORMULA_0007 0 0.0 0.0 2.0 READ_WRITE ECU_ADDRESS 0x3FB7F6 /end MEASUREMENT
/begin MEASUREMENT egas_sk_b2.rf_io_ring "Ringpuffer" UWORD FORMULA_0010 0 0.0 0.0 65535.0 READ_WRITE ECU_ADDRESS 0x3FB7F4 /end MEASUREMENT
/begin MEASUREMENT egas_sk_b2.soll_dk "DK-Sollwert gefiltert" SWORD FORMULA_0001 0 0.0 -10.0 120.0 READ_WRITE ECU_ADDRESS 0x3FB7EE /end MEASUREMENT
/begin MEASUREMENT egas_sk_b2.soll_lls "LLS-Sollwert gefiltert" SWORD FORMULA_0001 0 0.0 -10.0 120.0 READ_WRITE ECU_ADDRESS 0x3FB7F0 /end MEASUREMENT
/begin MEASUREMENT egas_sk_b2.t_dk_offen_1 "Zeit fuer Spalt offen" UWORD FORMULA_0021 0 0.0 0.0 10.0 READ_WRITE ECU_ADDRESS 0x3FB7E8 /end MEASUREMENT
/begin MEASUREMENT egas_sk_b2.t_dk_offen_2 "Zeit fuer Klemmen offen" UWORD FORMULA_0021 0 0.0 0.0 10.0 READ_WRITE ECU_ADDRESS 0x3FB7EA /end MEASUREMENT
/begin MEASUREMENT egas_sk_b2.t_ist_dk "Zeit Soll-/Istabweichung" UWORD FORMULA_0021 0 0.0 0.0 10.0 READ_WRITE ECU_ADDRESS 0x3FB7DE /end MEASUREMENT
/begin MEASUREMENT egas_sk_b2.t_ist_lls "Zeit Soll-/Istabweichung" UWORD FORMULA_0021 0 0.0 0.0 10.0 READ_WRITE ECU_ADDRESS 0x3FB7E0 /end MEASUREMENT
/begin MEASUREMENT egas_sk_b2.t_mode_dk "Zeit DK-Modeabweichung" UWORD FORMULA_0021 0 0.0 0.0 10.0 READ_WRITE ECU_ADDRESS 0x3FB7E6 /end MEASUREMENT
/begin MEASUREMENT egas_sk_b2.t_mode_lls "Zeit LLS-Modeabweichung" UWORD FORMULA_0021 0 0.0 0.0 10.0 READ_WRITE ECU_ADDRESS 0x3FB7E4 /end MEASUREMENT
/begin MEASUREMENT egas_sk_b2.t_rgpos_dk "Zeit RGPOS-Fehler" UBYTE FORMULA_0306 0 0.0 0.0 2.0 READ_WRITE ECU_ADDRESS 0x3FB7FA /end MEASUREMENT
/begin MEASUREMENT egas_sk_b2.t_rgpos_lls "Zeit RGPOS-Fehler" UBYTE FORMULA_0306 0 0.0 0.0 2.0 READ_WRITE ECU_ADDRESS 0x3FB7F9 /end MEASUREMENT
/begin MEASUREMENT egas_sk_b2.t_soll_dk "Zeit Sollwertabweichung" UWORD FORMULA_0021 0 0.0 0.0 10.0 READ_WRITE ECU_ADDRESS 0x3FB7DA /end MEASUREMENT
/begin MEASUREMENT egas_sk_b2.t_soll_lls "Zeit Sollwertabweichung" UWORD FORMULA_0021 0 0.0 0.0 10.0 READ_WRITE ECU_ADDRESS 0x3FB7DC /end MEASUREMENT
/begin MEASUREMENT egas_sk_b2.t_wdk "Zeit Analog-/CAN-Abweichung" UWORD FORMULA_0021 0 0.0 0.0 10.0 READ_WRITE ECU_ADDRESS 0x3FB7E2 /end MEASUREMENT
/begin MEASUREMENT egas_sk_b2.wdk_diff_max "max. Differenz CAN/WDK" SWORD FORMULA_0001 0 0.0 -10.0 120.0 READ_WRITE ECU_ADDRESS 0x3FB7D8 /end MEASUREMENT
/begin MEASUREMENT egas_sk_b2.zust_dk "SK-Zustand der DK" UBYTE FORMULA_0614 0 0.0 0.0 255.0 READ_WRITE BIT_MASK 0xF ECU_ADDRESS 0x3FB7D5 /end MEASUREMENT
/begin MEASUREMENT egas_sk_b2.zust_lls "SK-Zustand der LLS" UBYTE FORMULA_0616 0 0.0 0.0 255.0 READ_WRITE ECU_ADDRESS 0x3FB7D4 /end MEASUREMENT
/begin MEASUREMENT egas_snd_dk.cmd_b1 "CMD-B1" UBYTE FORMULA_0609 0 0.0 0.0 255.0 READ_WRITE ECU_ADDRESS 0x3FB75A /end MEASUREMENT
/begin MEASUREMENT egas_snd_dk.cmd_b1_fifo_1of5_ "CMD-B2" UBYTE FORMULA_0610 0 0.0 0.0 255.0 READ_WRITE ECU_ADDRESS 0x3FB75C /end MEASUREMENT
/begin MEASUREMENT egas_snd_dk.cmd_b1_fifo_2of5_ "CMD-B2" UBYTE FORMULA_0610 0 0.0 0.0 255.0 READ_WRITE ECU_ADDRESS 0x3FB75D /end MEASUREMENT
/begin MEASUREMENT egas_snd_dk.cmd_b1_fifo_3of5_ "CMD-B2" UBYTE FORMULA_0610 0 0.0 0.0 255.0 READ_WRITE ECU_ADDRESS 0x3FB75E /end MEASUREMENT
/begin MEASUREMENT egas_snd_dk.cmd_b1_fifo_4of5_ "CMD-B2" UBYTE FORMULA_0610 0 0.0 0.0 255.0 READ_WRITE ECU_ADDRESS 0x3FB75F /end MEASUREMENT
/begin MEASUREMENT egas_snd_dk.cmd_b1_fifo_5of5_ "CMD-B2" UBYTE FORMULA_0610 0 0.0 0.0 255.0 READ_WRITE ECU_ADDRESS 0x3FB760 /end MEASUREMENT
/begin MEASUREMENT egas_snd_dk.cmd_b2 "CMD-B2" UBYTE FORMULA_0610 0 0.0 0.0 255.0 READ_WRITE ECU_ADDRESS 0x3FB75B /end MEASUREMENT
/begin MEASUREMENT egas_snd_dk.cmd_b2_fifo_1of5_ "CMD-B2" UBYTE FORMULA_0610 0 0.0 0.0 255.0 READ_WRITE ECU_ADDRESS 0x3FB761 /end MEASUREMENT
/begin MEASUREMENT egas_snd_dk.cmd_b2_fifo_2of5_ "CMD-B2" UBYTE FORMULA_0610 0 0.0 0.0 255.0 READ_WRITE ECU_ADDRESS 0x3FB762 /end MEASUREMENT
/begin MEASUREMENT egas_snd_dk.cmd_b2_fifo_3of5_ "CMD-B2" UBYTE FORMULA_0610 0 0.0 0.0 255.0 READ_WRITE ECU_ADDRESS 0x3FB763 /end MEASUREMENT
/begin MEASUREMENT egas_snd_dk.cmd_b2_fifo_4of5_ "CMD-B2" UBYTE FORMULA_0610 0 0.0 0.0 255.0 READ_WRITE ECU_ADDRESS 0x3FB764 /end MEASUREMENT
/begin MEASUREMENT egas_snd_dk.cmd_b2_fifo_5of5_ "CMD-B2" UBYTE FORMULA_0610 0 0.0 0.0 255.0 READ_WRITE ECU_ADDRESS 0x3FB765 /end MEASUREMENT
/begin MEASUREMENT egas_snd_dk.time "Timeout" UWORD FORMULA_0071 0 0.0 0.0 6553.5 READ_WRITE ECU_ADDRESS 0x3FB766 /end MEASUREMENT
/begin MEASUREMENT egas_snd_dk.v_bank "Vorgabe BANK" UBYTE FORMULA_0003 0 0.0 0.0 255.0 READ_WRITE ECU_ADDRESS 0x3FB769 /end MEASUREMENT
/begin MEASUREMENT egas_snd_dk.v_clr_diag_b1 "Diag Bank1" UWORD FORMULA_0010 0 0.0 0.0 65535.0 READ_WRITE ECU_ADDRESS 0x3FB76A /end MEASUREMENT
/begin MEASUREMENT egas_snd_dk.v_clr_diag_b2 "Diag Bank1" UWORD FORMULA_0010 0 0.0 0.0 65535.0 READ_WRITE ECU_ADDRESS 0x3FB76C /end MEASUREMENT
/begin MEASUREMENT egas_snd_dk.v_ko_vers "Vorgabe KOMM" UBYTE FORMULA_0003 0 0.0 0.0 255.0 READ_WRITE ECU_ADDRESS 0x3FB768 /end MEASUREMENT
/begin MEASUREMENT egas_snd_lls.cmd_b1 "CMD-B1" UBYTE FORMULA_0609 0 0.0 0.0 255.0 READ_WRITE ECU_ADDRESS 0x3FB708 /end MEASUREMENT
/begin MEASUREMENT egas_snd_lls.cmd_b1_fifo_1of5_ "CMD-B2" UBYTE FORMULA_0610 0 0.0 0.0 255.0 READ_WRITE ECU_ADDRESS 0x3FB70A /end MEASUREMENT
/begin MEASUREMENT egas_snd_lls.cmd_b1_fifo_2of5_ "CMD-B2" UBYTE FORMULA_0610 0 0.0 0.0 255.0 READ_WRITE ECU_ADDRESS 0x3FB70B /end MEASUREMENT
/begin MEASUREMENT egas_snd_lls.cmd_b1_fifo_3of5_ "CMD-B2" UBYTE FORMULA_0610 0 0.0 0.0 255.0 READ_WRITE ECU_ADDRESS 0x3FB70C /end MEASUREMENT
/begin MEASUREMENT egas_snd_lls.cmd_b1_fifo_4of5_ "CMD-B2" UBYTE FORMULA_0610 0 0.0 0.0 255.0 READ_WRITE ECU_ADDRESS 0x3FB70D /end MEASUREMENT
/begin MEASUREMENT egas_snd_lls.cmd_b1_fifo_5of5_ "CMD-B2" UBYTE FORMULA_0610 0 0.0 0.0 255.0 READ_WRITE ECU_ADDRESS 0x3FB70E /end MEASUREMENT
/begin MEASUREMENT egas_snd_lls.cmd_b2 "CMD-B2" UBYTE FORMULA_0610 0 0.0 0.0 255.0 READ_WRITE ECU_ADDRESS 0x3FB709 /end MEASUREMENT
/begin MEASUREMENT egas_snd_lls.cmd_b2_fifo_1of5_ "CMD-B2" UBYTE FORMULA_0610 0 0.0 0.0 255.0 READ_WRITE ECU_ADDRESS 0x3FB70F /end MEASUREMENT
/begin MEASUREMENT egas_snd_lls.cmd_b2_fifo_2of5_ "CMD-B2" UBYTE FORMULA_0610 0 0.0 0.0 255.0 READ_WRITE ECU_ADDRESS 0x3FB710 /end MEASUREMENT
/begin MEASUREMENT egas_snd_lls.cmd_b2_fifo_3of5_ "CMD-B2" UBYTE FORMULA_0610 0 0.0 0.0 255.0 READ_WRITE ECU_ADDRESS 0x3FB711 /end MEASUREMENT
/begin MEASUREMENT egas_snd_lls.cmd_b2_fifo_4of5_ "CMD-B2" UBYTE FORMULA_0610 0 0.0 0.0 255.0 READ_WRITE ECU_ADDRESS 0x3FB712 /end MEASUREMENT
/begin MEASUREMENT egas_snd_lls.cmd_b2_fifo_5of5_ "CMD-B2" UBYTE FORMULA_0610 0 0.0 0.0 255.0 READ_WRITE ECU_ADDRESS 0x3FB713 /end MEASUREMENT
/begin MEASUREMENT egas_snd_lls.time "Timeout" UWORD FORMULA_0071 0 0.0 0.0 6553.5 READ_WRITE ECU_ADDRESS 0x3FB714 /end MEASUREMENT
/begin MEASUREMENT egas_snd_lls.v_bank "Vorgabe BANK" UBYTE FORMULA_0003 0 0.0 0.0 255.0 READ_WRITE ECU_ADDRESS 0x3FB717 /end MEASUREMENT
/begin MEASUREMENT egas_snd_lls.v_clr_diag_b1 "Diag Bank1" UWORD FORMULA_0010 0 0.0 0.0 65535.0 READ_WRITE ECU_ADDRESS 0x3FB718 /end MEASUREMENT
/begin MEASUREMENT egas_snd_lls.v_clr_diag_b2 "Diag Bank1" UWORD FORMULA_0010 0 0.0 0.0 65535.0 READ_WRITE ECU_ADDRESS 0x3FB71A /end MEASUREMENT
/begin MEASUREMENT egas_snd_lls.v_ko_vers "Vorgabe KOMM" UBYTE FORMULA_0003 0 0.0 0.0 255.0 READ_WRITE ECU_ADDRESS 0x3FB716 /end MEASUREMENT
/begin MEASUREMENT egas_st_empf "Egas-Empfangsstaus" UBYTE FORMULA_0582 0 0.0 0.0 255.0 READ_WRITE ECU_ADDRESS 0x3FB664 /end MEASUREMENT
/begin MEASUREMENT egas_st_empf_hys "Egas-Empfangsstaus pro SG-Lauf" UBYTE FORMULA_0582 0 0.0 0.0 255.0 READ_WRITE ECU_ADDRESS 0x3FB665 /end MEASUREMENT
/begin MEASUREMENT egas_stm_lls_time_oa "letzte Adaptionszeit" UWORD FORMULA_0620 0 0.0 0.0 1092.25 READ_WRITE ECU_ADDRESS 0x3FB802 /end MEASUREMENT
/begin MEASUREMENT egas_t_kl50 "KL50-Einfluss auf Istposition" UBYTE FORMULA_0357 0 0.0 0.0 1.274999976158142 READ_WRITE ECU_ADDRESS 0x3FB706 /end MEASUREMENT
/begin MEASUREMENT egas_wdk_b1.a0_cnt "Adaptionszaehler" UBYTE FORMULA_0003 0 0.0 0.0 255.0 READ_WRITE ECU_ADDRESS 0x3FB684 /end MEASUREMENT
/begin MEASUREMENT egas_wdk_b1.a0_max "max. Wert der Adaption" SWORD FORMULA_0250 0 0.0 0.0 5.0 READ_WRITE ECU_ADDRESS 0x3FB67A /end MEASUREMENT
/begin MEASUREMENT egas_wdk_b1.a0_min "min. Wert der Adaption" SWORD FORMULA_0250 0 0.0 0.0 5.0 READ_WRITE ECU_ADDRESS 0x3FB678 /end MEASUREMENT
/begin MEASUREMENT egas_wdk_b1.a0_sum "Adaptionssumme" SLONG FORMULA_0583 0 0.0 0.0 5.0 READ_WRITE ECU_ADDRESS 0x3FB680 /end MEASUREMENT
/begin MEASUREMENT egas_wdk_b1.a0_time "Timer fuer Vgl-Wert" UBYTE FORMULA_0584 0 0.0 0.0 1275.0 READ_WRITE ECU_ADDRESS 0x3FB685 /end MEASUREMENT
/begin MEASUREMENT egas_wdk_b1.a0_vgl "Vergleichswert der Adaption" SWORD FORMULA_0250 0 0.0 0.0 5.0 READ_WRITE ECU_ADDRESS 0x3FB67C /end MEASUREMENT
/begin MEASUREMENT egas_wdk_b1.abs "korr. U_WDK" SWORD FORMULA_0250 0 0.0 0.0 5.0 READ_WRITE ECU_ADDRESS 0x3FB676 /end MEASUREMENT
/begin MEASUREMENT egas_wdk_b1.abs_roh "nicht korr. U_WDK" SWORD FORMULA_0250 0 0.0 0.0 5.0 READ_WRITE ECU_ADDRESS 0x3FB674 /end MEASUREMENT
/begin MEASUREMENT egas_wdk_b2.a0_cnt "Adaptionszaehler" UBYTE FORMULA_0003 0 0.0 0.0 255.0 READ_WRITE ECU_ADDRESS 0x3FB698 /end MEASUREMENT
/begin MEASUREMENT egas_wdk_b2.a0_max "max. Wert der Adaption" SWORD FORMULA_0250 0 0.0 0.0 5.0 READ_WRITE ECU_ADDRESS 0x3FB68E /end MEASUREMENT
/begin MEASUREMENT egas_wdk_b2.a0_min "min. Wert der Adaption" SWORD FORMULA_0250 0 0.0 0.0 5.0 READ_WRITE ECU_ADDRESS 0x3FB68C /end MEASUREMENT
/begin MEASUREMENT egas_wdk_b2.a0_sum "Adaptionssumme" SLONG FORMULA_0583 0 0.0 0.0 5.0 READ_WRITE ECU_ADDRESS 0x3FB694 /end MEASUREMENT
/begin MEASUREMENT egas_wdk_b2.a0_time "Timer fuer Vgl-Wert" UBYTE FORMULA_0584 0 0.0 0.0 1275.0 READ_WRITE ECU_ADDRESS 0x3FB699 /end MEASUREMENT
/begin MEASUREMENT egas_wdk_b2.a0_vgl "Vergleichswert der Adaption" SWORD FORMULA_0250 0 0.0 0.0 5.0 READ_WRITE ECU_ADDRESS 0x3FB690 /end MEASUREMENT
/begin MEASUREMENT egas_wdk_b2.abs "korr. U_WDK" SWORD FORMULA_0250 0 0.0 0.0 5.0 READ_WRITE ECU_ADDRESS 0x3FB68A /end MEASUREMENT
/begin MEASUREMENT egas_wdk_b2.abs_roh "nicht korr. U_WDK" SWORD FORMULA_0250 0 0.0 0.0 5.0 READ_WRITE ECU_ADDRESS 0x3FB688 /end MEASUREMENT
/begin MEASUREMENT eth_ok "Ethernet Controller OK" UBYTE FORMULA_0629 0 0.0 0.0 255.0 READ_WRITE ECU_ADDRESS 0x3FA620 /end MEASUREMENT
/begin COMPU_METHOD FORMULA_0000 "FORMULA_0000" RAT_FUNC "%7.0" "-" COEFFS 0 1 0 0 0 1 /end COMPU_METHOD
/begin COMPU_METHOD FORMULA_0001 "FORMULA_0001" RAT_FUNC "%6.1" "%" COEFFS 0 10.0 0.0 0 0.0 1.0 /end COMPU_METHOD
/begin COMPU_METHOD FORMULA_0003 "FORMULA_0003" RAT_FUNC "%3.0" "-" COEFFS 0 1 0 0 0 1 /end COMPU_METHOD
/begin COMPU_METHOD FORMULA_0006 "FORMULA_0006" RAT_FUNC "%5.0" "Upm" COEFFS 0 1 0 0 0 1 /end COMPU_METHOD
/begin COMPU_METHOD FORMULA_0007 "FORMULA_0007" RAT_FUNC "%8.3" "-" COEFFS 0 10000.0 0.0 0 0.0 1.0 /end COMPU_METHOD
/begin COMPU_METHOD FORMULA_0008 "FORMULA_0008" RAT_FUNC "%6.1" "V" COEFFS 0 10.0 0.0 0 0.0 1.0 /end COMPU_METHOD
/begin COMPU_METHOD FORMULA_0010 "FORMULA_0010" RAT_FUNC "%5.0" "-" COEFFS 0 1 0 0 0 1 /end COMPU_METHOD
/begin COMPU_METHOD FORMULA_0017 "FORMULA_0017" RAT_FUNC "%9.2" "ms" COEFFS 0 7000.0 0.0 0 0.0 1.0 /end COMPU_METHOD
/begin COMPU_METHOD FORMULA_0021 "FORMULA_0021" RAT_FUNC "%7.2" "s" COEFFS 0 100.0 0.0 0 0.0 1.0 /end COMPU_METHOD
/begin COMPU_METHOD FORMULA_0023 "FORMULA_0023" RAT_FUNC "%6.1" "°C" COEFFS 0 10.0 2732.0 0 0.0 1.0 /end COMPU_METHOD
/begin COMPU_METHOD FORMULA_0044 "FORMULA_0044" RAT_FUNC "%9.2" "-" COEFFS 0 1 0 0 0 1 /end COMPU_METHOD
/begin COMPU_METHOD FORMULA_0052 "FORMULA_0052" TAB_VERB "%7.2" "-" COMPU_TAB_REF FORMULA_0052_VTAB /end COMPU_METHOD
/begin COMPU_METHOD FORMULA_0071 "FORMULA_0071" RAT_FUNC "%6.1" "s" COEFFS 0 10.0 0.0 0 0.0 1.0 /end COMPU_METHOD
/begin COMPU_METHOD FORMULA_0072 "FORMULA_0072" RAT_FUNC "%7.0" "us" COEFFS 0 1 0 0 0 1 /end COMPU_METHOD
/begin COMPU_METHOD FORMULA_0073 "FORMULA_0073" RAT_FUNC "%8.3" "-" COEFFS 0 1024.0 0.0 0 0.0 1.0 /end COMPU_METHOD
/begin COMPU_METHOD FORMULA_0074 "FORMULA_0074" RAT_FUNC "%6.1" "Kelvin" COEFFS 0 10.0 0.0 0 0.0 1.0 /end COMPU_METHOD
/begin COMPU_METHOD FORMULA_0077 "FORMULA_0077" TAB_VERB "%3.0" "Seite" COMPU_TAB_REF FORMULA_0077_VTAB /end COMPU_METHOD
/begin COMPU_METHOD FORMULA_0078 "FORMULA_0078" TAB_VERB "%3.0" "Seite" COMPU_TAB_REF FORMULA_0078_VTAB /end COMPU_METHOD
/begin COMPU_METHOD FORMULA_0079 "FORMULA_0079" TAB_VERB "%3.0" "-" COMPU_TAB_REF FORMULA_0079_VTAB /end COMPU_METHOD
/begin COMPU_METHOD FORMULA_0080 "FORMULA_0080" RAT_FUNC "%7.2" "-" COEFFS 0 1 0 0 0 1 /end COMPU_METHOD
/begin COMPU_METHOD FORMULA_0106 "FORMULA_0106" RAT_FUNC "%7.2" "%" COEFFS 0 163.84 0.0 0 0.0 1.0 /end COMPU_METHOD
/begin COMPU_METHOD FORMULA_0109 "FORMULA_0109" RAT_FUNC "%7.2" "s" COEFFS 0 200.0 0.0 0 0.0 1.0 /end COMPU_METHOD
/begin COMPU_METHOD FORMULA_0117 "FORMULA_0117" TAB_VERB "%3.0" "-" COMPU_TAB_REF FORMULA_0117_VTAB /end COMPU_METHOD
/begin COMPU_METHOD FORMULA_0143 "FORMULA_0143" RAT_FUNC "%6.1" "qmm" COEFFS 0 10.0 0.0 0 0.0 1.0 /end COMPU_METHOD
/begin COMPU_METHOD FORMULA_0226 "FORMULA_0226" RAT_FUNC "%8.1" "°KW" COEFFS 0 10.0 0.0 0 0.0 1.0 /end COMPU_METHOD
/begin COMPU_METHOD FORMULA_0250 "FORMULA_0250" RAT_FUNC "%8.3" "V" COEFFS 0 204.8 0.0 0 0.0 1.0 /end COMPU_METHOD
/begin COMPU_METHOD FORMULA_0306 "FORMULA_0306" RAT_FUNC "%5.2" "s" COEFFS 0 100.0 0.0 0 0.0 1.0 /end COMPU_METHOD
/begin COMPU_METHOD FORMULA_0357 "FORMULA_0357" RAT_FUNC "%5.2" "s" COEFFS 0 200.0 0.0 0 0.0 1.0 /end COMPU_METHOD
/begin COMPU_METHOD FORMULA_0423 "FORMULA_0423" RAT_FUNC "%3.0" "mal" COEFFS 0 1 0 0 0 1 /end COMPU_METHOD
/begin COMPU_METHOD FORMULA_0433 "FORMULA_0433" TAB_VERB "%5.0" "-" COMPU_TAB_REF FORMULA_0433_VTAB /end COMPU_METHOD
/begin COMPU_METHOD FORMULA_0434 "FORMULA_0434" TAB_VERB "%3.0" "-" COMPU_TAB_REF FORMULA_0434_VTAB /end COMPU_METHOD
/begin COMPU_METHOD FORMULA_0435 "FORMULA_0435" TAB_VERB "%3.0" "-" COMPU_TAB_REF FORMULA_0435_VTAB /end COMPU_METHOD
/begin COMPU_METHOD FORMULA_0436 "FORMULA_0436" TAB_VERB "%5.2" "-" COMPU_TAB_REF FORMULA_0436_VTAB /end COMPU_METHOD
/begin COMPU_METHOD FORMULA_0455 "FORMULA_0455" RAT_FUNC "%5.2" "s" COEFFS 0 0 2.56 0 1 0 /end COMPU_METHOD
/begin COMPU_METHOD FORMULA_0470 "FORMULA_0470" RAT_FUNC "%6.3" "s" COEFFS 0 0 1.28 0 1 0 /end COMPU_METHOD
/begin COMPU_METHOD FORMULA_0471 "FORMULA_0471" RAT_FUNC "%4.1" "%" COEFFS 0 10.0 0.0 0 0.0 1.0 /end COMPU_METHOD
/begin COMPU_METHOD FORMULA_0575 "FORMULA_0575" TAB_VERB "%3.0" "-" COMPU_TAB_REF FORMULA_0575_VTAB /end COMPU_METHOD
/begin COMPU_METHOD FORMULA_0576 "FORMULA_0576" TAB_VERB "%5.0" "-" COMPU_TAB_REF FORMULA_0576_VTAB /end COMPU_METHOD
/begin COMPU_METHOD FORMULA_0577 "FORMULA_0577" RAT_FUNC "%6.1" "%" COEFFS 0 120.0 0.0 0 0.0 1.0 /end COMPU_METHOD
/begin COMPU_METHOD FORMULA_0578 "FORMULA_0578" RAT_FUNC "%9.2" "ms" COEFFS 0 250.0 0.0 0 0.0 1.0 /end COMPU_METHOD
/begin COMPU_METHOD FORMULA_0579 "FORMULA_0579" RAT_FUNC "%9.2" "mVs" COEFFS 0 0.3103030303030303 0.0 0 0.0 1.0 /end COMPU_METHOD
/begin COMPU_METHOD FORMULA_0580 "FORMULA_0580" RAT_FUNC "%9.2" "V" COEFFS 0 1241.21837996177 0.0 0 0.0 1.0 /end COMPU_METHOD
/begin COMPU_METHOD FORMULA_0581 "FORMULA_0581" RAT_FUNC "%5.2" "sec" COEFFS 0 200.0 0.0 0 0.0 1.0 /end COMPU_METHOD
/begin COMPU_METHOD FORMULA_0582 "FORMULA_0582" TAB_VERB "%3.0" "-" COMPU_TAB_REF FORMULA_0582_VTAB /end COMPU_METHOD
/begin COMPU_METHOD FORMULA_0583 "FORMULA_0583" RAT_FUNC "%10.3" "V" COEFFS 0 204.8 0.0 0 0.0 1.0 /end COMPU_METHOD
/begin COMPU_METHOD FORMULA_0584 "FORMULA_0584" RAT_FUNC "%3.0" "ms" COEFFS 0 0.2 0.0 0 0.0 1.0 /end COMPU_METHOD
/begin COMPU_METHOD FORMULA_0585 "FORMULA_0585" RAT_FUNC "%4.1" "%" COEFFS 0 1.28 128.0 0 0.0 1.0 /end COMPU_METHOD
/begin COMPU_METHOD FORMULA_0586 "FORMULA_0586" TAB_VERB "%5.2" "-" COMPU_TAB_REF FORMULA_0586_VTAB /end COMPU_METHOD
/begin COMPU_METHOD FORMULA_0587 "FORMULA_0587" TAB_VERB "%5.2" "-" COMPU_TAB_REF FORMULA_0587_VTAB /end COMPU_METHOD
/begin COMPU_METHOD FORMULA_0588 "FORMULA_0588" TAB_VERB "%3.0" "-" COMPU_TAB_REF FORMULA_0588_VTAB /end COMPU_METHOD
/begin COMPU_METHOD FORMULA_0589 "FORMULA_0589" TAB_VERB "%5.2" "-" COMPU_TAB_REF FORMULA_0589_VTAB /end COMPU_METHOD
/begin COMPU_METHOD FORMULA_0590 "FORMULA_0590" RAT_FUNC "%7.2" "sec" COEFFS 0 200.0 0.0 0 0.0 1.0 /end COMPU_METHOD
/begin COMPU_METHOD FORMULA_0591 "FORMULA_0591" TAB_VERB "%3.0" "-" COMPU_TAB_REF FORMULA_0591_VTAB /end COMPU_METHOD
/begin COMPU_METHOD FORMULA_0592 "FORMULA_0592" TAB_VERB "%3.0" "-" COMPU_TAB_REF FORMULA_0592_VTAB /end COMPU_METHOD
/begin COMPU_METHOD FORMULA_0593 "FORMULA_0593" TAB_VERB "%3.0" "-" COMPU_TAB_REF FORMULA_0593_VTAB /end COMPU_METHOD
/begin COMPU_METHOD FORMULA_0594 "FORMULA_0594" TAB_VERB "%3.0" "-" COMPU_TAB_REF FORMULA_0594_VTAB /end COMPU_METHOD
/begin COMPU_METHOD FORMULA_0595 "FORMULA_0595" TAB_VERB "%3.0" "-" COMPU_TAB_REF FORMULA_0595_VTAB /end COMPU_METHOD
/begin COMPU_METHOD FORMULA_0596 "FORMULA_0596" TAB_VERB "%5.0" "-" COMPU_TAB_REF FORMULA_0596_VTAB /end COMPU_METHOD
/begin COMPU_METHOD FORMULA_0597 "FORMULA_0597" TAB_VERB "%5.2" "-" COMPU_TAB_REF FORMULA_0597_VTAB /end COMPU_METHOD
/begin COMPU_METHOD FORMULA_0598 "FORMULA_0598" TAB_VERB "%5.2" "-" COMPU_TAB_REF FORMULA_0598_VTAB /end COMPU_METHOD
/begin COMPU_METHOD FORMULA_0599 "FORMULA_0599" TAB_VERB "%5.2" "-" COMPU_TAB_REF FORMULA_0599_VTAB /end COMPU_METHOD
/begin COMPU_METHOD FORMULA_0600 "FORMULA_0600" TAB_VERB "%5.2" "-" COMPU_TAB_REF FORMULA_0600_VTAB /end COMPU_METHOD
/begin COMPU_METHOD FORMULA_0601 "FORMULA_0601" TAB_VERB "%5.2" "-" COMPU_TAB_REF FORMULA_0601_VTAB /end COMPU_METHOD
/begin COMPU_METHOD FORMULA_0602 "FORMULA_0602" TAB_VERB "%5.2" "-" COMPU_TAB_REF FORMULA_0602_VTAB /end COMPU_METHOD
/begin COMPU_METHOD FORMULA_0603 "FORMULA_0603" TAB_VERB "%5.2" "-" COMPU_TAB_REF FORMULA_0603_VTAB /end COMPU_METHOD
/begin COMPU_METHOD FORMULA_0604 "FORMULA_0604" TAB_VERB "%5.2" "-" COMPU_TAB_REF FORMULA_0604_VTAB /end COMPU_METHOD
/begin COMPU_METHOD FORMULA_0605 "FORMULA_0605" TAB_VERB "%3.0" "-" COMPU_TAB_REF FORMULA_0605_VTAB /end COMPU_METHOD
/begin COMPU_METHOD FORMULA_0606 "FORMULA_0606" RAT_FUNC "%7.2" "-" COEFFS 0 1024.0 -1024.0 0 0.0 1.0 /end COMPU_METHOD
/begin COMPU_METHOD FORMULA_0607 "FORMULA_0607" RAT_FUNC "%4.1" "%/s" COEFFS 0 10.0 0.0 0 0.0 1.0 /end COMPU_METHOD
/begin COMPU_METHOD FORMULA_0608 "FORMULA_0608" RAT_FUNC "%8.3" "%/V" COEFFS 0 100.0977517106549 0.0 0 0.0 1.0 /end COMPU_METHOD
/begin COMPU_METHOD FORMULA_0609 "FORMULA_0609" TAB_VERB "%5.2" "-" COMPU_TAB_REF FORMULA_0609_VTAB /end COMPU_METHOD
/begin COMPU_METHOD FORMULA_0610 "FORMULA_0610" TAB_VERB "%3.0" "-" COMPU_TAB_REF FORMULA_0610_VTAB /end COMPU_METHOD
/begin COMPU_METHOD FORMULA_0611 "FORMULA_0611" TAB_VERB "%5.2" "-" COMPU_TAB_REF FORMULA_0611_VTAB /end COMPU_METHOD
/begin COMPU_METHOD FORMULA_0612 "FORMULA_0612" TAB_VERB "%7.2" "-" COMPU_TAB_REF FORMULA_0612_VTAB /end COMPU_METHOD
/begin COMPU_METHOD FORMULA_0613 "FORMULA_0613" TAB_VERB "%5.0" "-" COMPU_TAB_REF FORMULA_0613_VTAB /end COMPU_METHOD
/begin COMPU_METHOD FORMULA_0614 "FORMULA_0614" TAB_VERB "%5.2" "-" COMPU_TAB_REF FORMULA_0614_VTAB /end COMPU_METHOD
/begin COMPU_METHOD FORMULA_0615 "FORMULA_0615" TAB_VERB "%5.2" "-" COMPU_TAB_REF FORMULA_0615_VTAB /end COMPU_METHOD
/begin COMPU_METHOD FORMULA_0616 "FORMULA_0616" TAB_VERB "%5.2" "-" COMPU_TAB_REF FORMULA_0616_VTAB /end COMPU_METHOD
/begin COMPU_METHOD FORMULA_0617 "FORMULA_0617" RAT_FUNC "%7.2" "%/sec" COEFFS 0 5.e-002 0.0 0 0.0 1.0 /end COMPU_METHOD
/begin COMPU_METHOD FORMULA_0618 "FORMULA_0618" TAB_VERB "%5.2" "-" COMPU_TAB_REF FORMULA_0618_VTAB /end COMPU_METHOD
/begin COMPU_METHOD FORMULA_0619 "FORMULA_0619" TAB_VERB "%5.2" "-" COMPU_TAB_REF FORMULA_0619_VTAB /end COMPU_METHOD
/begin COMPU_METHOD FORMULA_0620 "FORMULA_0620" RAT_FUNC "%5.0" "min" COEFFS 0 60.0 0.0 0 0.0 1.0 /end COMPU_METHOD
/begin COMPU_METHOD FORMULA_0621 "FORMULA_0621" TAB_VERB "%5.2" "-" COMPU_TAB_REF FORMULA_0621_VTAB /end COMPU_METHOD
/begin COMPU_METHOD FORMULA_0622 "FORMULA_0622" TAB_VERB "%3.0" "-" COMPU_TAB_REF FORMULA_0622_VTAB /end COMPU_METHOD
/begin COMPU_METHOD FORMULA_0623 "FORMULA_0623" RAT_FUNC "%8.3" "s" COEFFS 0 200.0 0.0 0 0.0 1.0 /end COMPU_METHOD
/begin COMPU_METHOD FORMULA_0624 "FORMULA_0624" RAT_FUNC "%8.1" "%" COEFFS 0 1.28 0.0 0 0.0 1.0 /end COMPU_METHOD
/begin COMPU_METHOD FORMULA_0625 "FORMULA_0625" RAT_FUNC "%8.1" "%" COEFFS 0 10.0 0.0 0 0.0 1.0 /end COMPU_METHOD
/begin COMPU_METHOD FORMULA_0626 "FORMULA_0626" RAT_FUNC "%5.0" "s" COEFFS 0 1 0 0 0 1 /end COMPU_METHOD
/begin COMPU_METHOD FORMULA_0627 "FORMULA_0627" RAT_FUNC "%7.2" "sec" COEFFS 0 200.0 0.0 0 0.0 1.0 /end COMPU_METHOD
/begin COMPU_METHOD FORMULA_0628 "FORMULA_0628" RAT_FUNC "%4.1" "%" COEFFS 0 1.28 0.0 0 0.0 1.0 /end COMPU_METHOD
/begin COMPU_METHOD FORMULA_0629 "FORMULA_0629" TAB_VERB "%4.1" "-" COMPU_TAB_REF FORMULA_0629_VTAB /end COMPU_METHOD
/begin COMPU_METHOD FORMULA_0818 "FORMULA_0818" RAT_FUNC "%7.0" "U/min" COEFFS 0 1 0 0 0 1 /end COMPU_METHOD
/begin COMPU_METHOD FORMULA_0819 "FORMULA_0819" TAB_VERB "%9.2" "-" COMPU_TAB_REF FORMULA_0819_VTAB /end COMPU_METHOD
/begin COMPU_METHOD FORMULA_0820 "FORMULA_0820" RAT_FUNC "%10.3" "-" COEFFS 0 10000.0 0.0 0 0.0 1.0 /end COMPU_METHOD
/begin COMPU_METHOD FORMULA_0821 "FORMULA_0821" RAT_FUNC "%10.3" "-" COEFFS 0 16384.0 0.0 0 0.0 1.0 /end COMPU_METHOD
/begin COMPU_METHOD FORMULA_0822 "FORMULA_0822" RAT_FUNC "%9.2" "%" COEFFS 0 163.84 0.0 0 0.0 1.0 /end COMPU_METHOD
/begin COMPU_METHOD FORMULA_0823 "FORMULA_0823" TAB_VERB "%7.0" "-" COMPU_TAB_REF FORMULA_0823_VTAB /end COMPU_METHOD
/begin COMPU_METHOD FORMULA_0824 "FORMULA_0824" TAB_VERB "%7.0" "-" COMPU_TAB_REF FORMULA_0824_VTAB /end COMPU_METHOD
/begin COMPU_METHOD FORMULA_0825 "FORMULA_0825" TAB_VERB "%7.0" "-" COMPU_TAB_REF FORMULA_0825_VTAB /end COMPU_METHOD
/begin COMPU_METHOD FORMULA_0826 "FORMULA_0826" TAB_VERB "%7.0" "-" COMPU_TAB_REF FORMULA_0826_VTAB /end COMPU_METHOD
/begin COMPU_METHOD FORMULA_0827 "FORMULA_0827" TAB_VERB "%7.0" "-" COMPU_TAB_REF FORMULA_0827_VTAB /end COMPU_METHOD
/begin COMPU_METHOD FORMULA_0828 "FORMULA_0828" TAB_VERB "%7.0" "-" COMPU_TAB_REF FORMULA_0828_VTAB /end COMPU_METHOD
/begin COMPU_METHOD FORMULA_0829 "FORMULA_0829" TAB_VERB "%7.0" "-" COMPU_TAB_REF FORMULA_0829_VTAB /end COMPU_METHOD
/begin COMPU_METHOD FORMULA_0830 "FORMULA_0830" TAB_VERB "%7.0" "-" COMPU_TAB_REF FORMULA_0830_VTAB /end COMPU_METHOD
/begin COMPU_METHOD FORMULA_0831 "FORMULA_0831" TAB_VERB "%7.0" "-" COMPU_TAB_REF FORMULA_0831_VTAB /end COMPU_METHOD
/begin COMPU_METHOD FORMULA_0832 "FORMULA_0832" TAB_VERB "%7.0" "-" COMPU_TAB_REF FORMULA_0832_VTAB /end COMPU_METHOD
/begin COMPU_METHOD FORMULA_0833 "FORMULA_0833" TAB_VERB "%7.0" "-" COMPU_TAB_REF FORMULA_0833_VTAB /end COMPU_METHOD
/begin COMPU_METHOD FORMULA_0834 "FORMULA_0834" TAB_VERB "%7.0" "-" COMPU_TAB_REF FORMULA_0834_VTAB /end COMPU_METHOD
/begin COMPU_METHOD FORMULA_0835 "FORMULA_0835" TAB_VERB "%7.0" "-" COMPU_TAB_REF FORMULA_0835_VTAB /end COMPU_METHOD
/begin COMPU_METHOD FORMULA_0836 "FORMULA_0836" TAB_VERB "%7.0" "-" COMPU_TAB_REF FORMULA_0836_VTAB /end COMPU_METHOD
/begin COMPU_METHOD FORMULA_0837 "FORMULA_0837" TAB_VERB "%7.0" "-" COMPU_TAB_REF FORMULA_0837_VTAB /end COMPU_METHOD
/begin COMPU_METHOD FORMULA_0838 "FORMULA_0838" TAB_VERB "%7.0" "-" COMPU_TAB_REF FORMULA_0838_VTAB /end COMPU_METHOD
/begin COMPU_METHOD FORMULA_0839 "FORMULA_0839" TAB_VERB "%7.0" "-" COMPU_TAB_REF FORMULA_0839_VTAB /end COMPU_METHOD
/begin COMPU_METHOD FORMULA_0840 "FORMULA_0840" TAB_VERB "%7.0" "-" COMPU_TAB_REF FORMULA_0840_VTAB /end COMPU_METHOD
/begin COMPU_METHOD FORMULA_0841 "FORMULA_0841" TAB_VERB "%7.0" "-" COMPU_TAB_REF FORMULA_0841_VTAB /end COMPU_METHOD
/begin COMPU_METHOD FORMULA_0842 "FORMULA_0842" TAB_VERB "%7.0" "-" COMPU_TAB_REF FORMULA_0842_VTAB /end COMPU_METHOD
/begin COMPU_METHOD FORMULA_0843 "FORMULA_0843" TAB_VERB "%7.0" "-" COMPU_TAB_REF FORMULA_0843_VTAB /end COMPU_METHOD
/begin COMPU_METHOD FORMULA_0844 "FORMULA_0844" TAB_VERB "%7.0" "-" COMPU_TAB_REF FORMULA_0844_VTAB /end COMPU_METHOD
/begin COMPU_METHOD FORMULA_0845 "FORMULA_0845" TAB_VERB "%7.0" "-" COMPU_TAB_REF FORMULA_0845_VTAB /end COMPU_METHOD
/begin COMPU_METHOD FORMULA_0846 "FORMULA_0846" TAB_VERB "%7.0" "-" COMPU_TAB_REF FORMULA_0846_VTAB /end COMPU_METHOD
/begin COMPU_METHOD FORMULA_0847 "FORMULA_0847" TAB_VERB "%7.0" "-" COMPU_TAB_REF FORMULA_0847_VTAB /end COMPU_METHOD
/begin COMPU_METHOD FORMULA_0848 "FORMULA_0848" TAB_VERB "%7.0" "-" COMPU_TAB_REF FORMULA_0848_VTAB /end COMPU_METHOD
/begin COMPU_METHOD FORMULA_0849 "FORMULA_0849" TAB_VERB "%7.0" "-" COMPU_TAB_REF FORMULA_0849_VTAB /end COMPU_METHOD
/begin COMPU_METHOD FORMULA_0850 "FORMULA_0850" TAB_VERB "%7.0" "-" COMPU_TAB_REF FORMULA_0850_VTAB /end COMPU_METHOD
/begin COMPU_METHOD FORMULA_0851 "FORMULA_0851" TAB_VERB "%7.0" "-" COMPU_TAB_REF FORMULA_0851_VTAB /end COMPU_METHOD
/begin COMPU_METHOD FORMULA_0852 "FORMULA_0852" TAB_VERB "%7.0" "-" COMPU_TAB_REF FORMULA_0852_VTAB /end COMPU_METHOD
/begin COMPU_METHOD FORMULA_0853 "FORMULA_0853" TAB_VERB "%7.0" "-" COMPU_TAB_REF FORMULA_0853_VTAB /end COMPU_METHOD
/begin COMPU_METHOD FORMULA_0854 "FORMULA_0854" TAB_VERB "%7.0" "-" COMPU_TAB_REF FORMULA_0854_VTAB /end COMPU_METHOD
/begin COMPU_METHOD FORMULA_0855 "FORMULA_0855" TAB_VERB "%7.0" "-" COMPU_TAB_REF FORMULA_0855_VTAB /end COMPU_METHOD
/begin COMPU_METHOD FORMULA_0856 "FORMULA_0856" TAB_VERB "%7.0" "-" COMPU_TAB_REF FORMULA_0856_VTAB /end COMPU_METHOD
/begin COMPU_METHOD FORMULA_0857 "FORMULA_0857" TAB_VERB "%7.0" "-" COMPU_TAB_REF FORMULA_0857_VTAB /end COMPU_METHOD
/begin COMPU_METHOD FORMULA_0858 "FORMULA_0858" TAB_VERB "%7.0" "-" COMPU_TAB_REF FORMULA_0858_VTAB /end COMPU_METHOD
/begin COMPU_METHOD FORMULA_0859 "FORMULA_0859" RAT_FUNC "%8.1" "Grad" COEFFS 0 10.0 0.0 0 0.0 1.0 /end COMPU_METHOD
/begin COMPU_METHOD FORMULA_0860 "FORMULA_0860" TAB_VERB "%7.0" "-" COMPU_TAB_REF FORMULA_0860_VTAB /end COMPU_METHOD
/begin COMPU_METHOD FORMULA_0861 "FORMULA_0861" RAT_FUNC "%10.3" "*" COEFFS 0 512.0 0.0 0 0.0 1.0 /end COMPU_METHOD
/begin COMPU_METHOD FORMULA_0862 "FORMULA_0862" RAT_FUNC "%5.0" "Volt" COEFFS 0 1241.21837996177 0.0 0 0.0 1.0 /end COMPU_METHOD
/begin COMPU_METHOD FORMULA_0863 "FORMULA_0863" RAT_FUNC "%5.0" "Bar" COEFFS 0 31.02699348433137 0.0 0 0.0 1.0 /end COMPU_METHOD
/begin COMPU_METHOD FORMULA_0864 "FORMULA_0864" RAT_FUNC "%6.1" "Grad" COEFFS 0 100.0 0.0 0 0.0 1.0 /end COMPU_METHOD
/begin COMPU_VTAB FORMULA_0052_VTAB "FORMULA_0052_VTAB" TAB_VERB 44 0 "O.K." 1 "SH_TO_UB" 2 "SH_TO_GND" 4 "OPENLOAD" 8 "UNPLAUSI" 256 "O.K./ZYKLUS" 512 "FILTER" 513 "FIL/SH_TO_UB" 514 "FIL/SH_TO_GND" 516 "FIL/OPENLOAD" 520 "FIL/UNPLAUSI" 576 "VORHANDEN" 577 "VORH/SH_TO_UB" 578 "VORH/SH_TO_GND" 580 "VORH/OPENLOAD" 584 "VORH/UNPLAUSI" 768 "FILTER/ZYKLUS" 769 "FIL/ZYK/SH_TO_UB" 770 "FIL/ZYK/SH_TO_GND" 772 "FIL/ZYK/OPENLOAD" 776 "FIL/ZYK/UNPLAUSI" 832 "VORHANDEN/ZYKLUS" 833 "VORH/ZYK/SH_TO_UB" 834 "VORH/ZYK/SH_TO_GND" 836 "VORH/ZYK/OPENLOAD" 840 "VORH/ZYK/UNPLAUSI" 2048 "O.K./SCDN" 2304 "O.K./S/ZYKLUS" 2561 "FIL/S/SH_TO_UB" 2562 "FIL/S/SH_TO_GND" 2564 "FIL/S/OPENLOAD" 2568 "FIL/S/UNPLAUSI" 2625 "VORH/S/SH_TO_UB" 2626 "VORH/S/SH_TO_GND" 2628 "VORH/S/OPENLOAD" 2632 "VORH/S/UNPLAUSI" 2817 "FIL/ZYK/S/SH_TO_UB" 2818 "FIL/ZYK/S/SH_TO_GND" 2820 "FIL/ZYK/S/OPENLOAD" 2824 "FIL/ZYK/S/UNPLAUSI" 2881 "VORH/ZYK/S/SH_TO_UB" 2882 "VORH/ZYK/S/SH_TO_GND" 2884 "VORH/ZYK/S/OPENLOAD" 2888 "VORH/ZYK/S/UNPLAUSI" /end COMPU_VTAB
/begin COMPU_VTAB FORMULA_0077_VTAB "FORMULA_0077_VTAB" TAB_VERB 1 128 "Keine Daten)" /end COMPU_VTAB
/begin COMPU_VTAB FORMULA_0078_VTAB "FORMULA_0078_VTAB" TAB_VERB 2 64 "Sektoren voll->A" 72 "Sektoren voll->B" /end COMPU_VTAB
/begin COMPU_VTAB FORMULA_0079_VTAB "FORMULA_0079_VTAB" TAB_VERB 9 0 "Daten o.k." 1 "CRC Stand falsch" 2 "Andere Erstellung" 4 "Andere Version" 8 "Wichtig groesser" 16 "Wichtig kleiner" 32 "Wichtig CRC falsch" 64 "Wichtig Laenge nio" 128 "keine Daten" /end COMPU_VTAB
/begin COMPU_VTAB FORMULA_0117_VTAB "FORMULA_0117_VTAB" TAB_VERB 8 0 "O.K." 1 "BusOff" 2 "DPR" 4 "Timeout" 5 "BusOff+Timeout" 8 "Overflow" 16 "Chksum" 32 "Alive" DEFAULT_VALUE "Mehrfachfehler" /end COMPU_VTAB
/begin COMPU_VTAB FORMULA_0433_VTAB "FORMULA_0433_VTAB" TAB_VERB 17 0 "kein Fehler" 1 "RAM-Fehler" 2 "ROM-Fehler" 4 "A/D Wandler-Fehler" 8 "Software Reset" 16 "CAN-Bus Fehler" 32 "CAN-Timeout" 64 "CAN-Fehler Chksum" 128 "CAN-Fehler Alive" 256 "Zylinderbankzuordnung" 512 "Bereichsueberwachung" 1024 "Gradientenueberwachung" 2048 "Lagereglerueberwachung" 4096 "therm. Ueberlast" 8192 "Motorschutz" 16384 "NP-Fehler" 32768 "NP-Abbruch" DEFAULT_VALUE "Mehrfachfehler" /end COMPU_VTAB
/begin COMPU_VTAB FORMULA_0434_VTAB "FORMULA_0434_VTAB" TAB_VERB 6 1 "oA aus" 2 "oA aktiv" 4 "oA erfolgreich" 9 "oA abgelehnt" 10 "oA abgebrochen" 12 "oA fehlerhaft" DEFAULT_VALUE "undef" /end COMPU_VTAB
/begin COMPU_VTAB FORMULA_0435_VTAB "FORMULA_0435_VTAB" TAB_VERB 7 0 "Init" 1 "Inaktiv" 2 "NP-Adapt" 4 "Aktiv" 8 "Zust bb" 10 "Federtest" 15 "Failsafe" /end COMPU_VTAB
/begin COMPU_VTAB FORMULA_0436_VTAB "FORMULA_0436_VTAB" TAB_VERB 5 0 "Wait" 1 "Inaktiv" 2 "Aktiv" 3 "Aktiv/Adapt" 255 "Failsafe" /end COMPU_VTAB
/begin COMPU_VTAB FORMULA_0575_VTAB "FORMULA_0575_VTAB" TAB_VERB 4 0 "DMA Ok" 1 "Write Error" 2 "Read Error" 3 "Read+Write Error" DEFAULT_VALUE "Unknown Status" /end COMPU_VTAB
/begin COMPU_VTAB FORMULA_0576_VTAB "FORMULA_0576_VTAB" TAB_VERB 32 0 "Bus Ok" 2 "Loaded" 6 "Booted" 14 "Run" 1 "Bus Error" 3 "Bus Error" 7 "Bus Error" 15 "Bus Error" 16 "Stack Error" 18 "Stack Error" 22 "Stack Error" 30 "Stack Error" 32 "Watchdog" 34 "Watchdog" 38 "Watchdog" 46 "Watchdog" 64 "Run Error" 66 "Run Error" 70 "Run Error" 78 "Run Error" 128 "MISC Error" 130 "MISC Error" 134 "MISC Error" 142 "MISC Error" 256 "PM Error" 258 "PM Error" 262 "PM Error" 270 "PM Error" 512 "DM Error" 514 "DM Error" 518 "DM Error" 526 "DM Error" DEFAULT_VALUE "Access denied" /end COMPU_VTAB
/begin COMPU_VTAB FORMULA_0582_VTAB "FORMULA_0582_VTAB" TAB_VERB 8 0 "Keine" 1 "LLS1" 2 "LLS2" 3 "LLS1+2" 4 "DK1" 8 "DK2" 12 "DK1+2" 15 "Alle" /end COMPU_VTAB
/begin COMPU_VTAB FORMULA_0586_VTAB "FORMULA_0586_VTAB" TAB_VERB 2 0 "disable" 1 "enable" /end COMPU_VTAB
/begin COMPU_VTAB FORMULA_0587_VTAB "FORMULA_0587_VTAB" TAB_VERB 7 0 "Init" 1 "Inaktiv" 2 "NP-Adapt" 4 "Aktiv" 8 "Zust bb" 10 "Federtest" 15 "Failsafe" /end COMPU_VTAB
/begin COMPU_VTAB FORMULA_0588_VTAB "FORMULA_0588_VTAB" TAB_VERB 13 0 "NP aus" 1 "NP default" 2 "NP aktiv" 3 "NP erfolgreich" 4 "NP abgelehnt" 5 "NP abgebrochen" 6 "NP fehlerhaft" 8 "FT aus" 10 "FT aktiv" 11 "FT erfolgreich" 12 "FT abgelehnt" 13 "FT abgebrochen" 14 "FT fehlerhaft" DEFAULT_VALUE "undef" /end COMPU_VTAB
/begin COMPU_VTAB FORMULA_0589_VTAB "FORMULA_0589_VTAB" TAB_VERB 9 0 "Wait" 1 "Inaktiv" 2 "Gestaengetest" 3 "Adaption" 4 "EnableLtg-S" 5 "EnableLtg" 6 "Aktiv" 7 "Federtest" 255 "Failsafe" /end COMPU_VTAB
/begin COMPU_VTAB FORMULA_0591_VTAB "FORMULA_0591_VTAB" TAB_VERB 1 0 "Disable" DEFAULT_VALUE "Enable" /end COMPU_VTAB
/begin COMPU_VTAB FORMULA_0592_VTAB "FORMULA_0592_VTAB" TAB_VERB 15 0 "No" 1 "NP" 2 "EN" 3 "NP+EN" 4 "FT" 5 "NP+FT" 6 "EN+FT" 7 "NP+En+FT" 8 "GT" 9 "GT+NP" 10 "GT+EN" 11 "GT+NP+EN" 12 "GT+FT" 14 "GT+FT+EN" 15 "GT+NP+EN+FT" /end COMPU_VTAB
/begin COMPU_VTAB FORMULA_0593_VTAB "FORMULA_0593_VTAB" TAB_VERB 1 0 "Nein" DEFAULT_VALUE "Ja" /end COMPU_VTAB
/begin COMPU_VTAB FORMULA_0594_VTAB "FORMULA_0594_VTAB" TAB_VERB 1 0 "Nein" DEFAULT_VALUE "Frei" /end COMPU_VTAB
/begin COMPU_VTAB FORMULA_0595_VTAB "FORMULA_0595_VTAB" TAB_VERB 1 0 "Inaktiv" DEFAULT_VALUE "Aktiv" /end COMPU_VTAB
/begin COMPU_VTAB FORMULA_0596_VTAB "FORMULA_0596_VTAB" TAB_VERB 12 0 "kein Fehler" 1 "R-Mode" 2 "Diagnose" 4 "undef" 8 "CAN-Fehler" 16 "EnLtg-Err" 32 "EnLtg-Diag" 64 "Startup" 128 "EnLtg-En" 256 "Gestaenge" 512 "EnLtg-Dis" 1024 "Federntest" DEFAULT_VALUE "Mehrfachfehler" /end COMPU_VTAB
/begin COMPU_VTAB FORMULA_0597_VTAB "FORMULA_0597_VTAB" TAB_VERB 6 0 "Init" 1 "Inaktiv" 4 "Aktiv" 6 "Aktiv/Adapt" 8 "Zust bb" 15 "Failsafe" /end COMPU_VTAB
/begin COMPU_VTAB FORMULA_0598_VTAB "FORMULA_0598_VTAB" TAB_VERB 5 0 "Init" 1 "Inaktiv" 4 "Aktiv" 6 "Aktiv/Adapt" 15 "Failsafe" /end COMPU_VTAB
/begin COMPU_VTAB FORMULA_0599_VTAB "FORMULA_0599_VTAB" TAB_VERB 6 0 "Init" 1 "Inaktiv" 4 "Aktiv" 6 "Aktiv/Adapt" 8 "Zust bb" 15 "Failsafe" /end COMPU_VTAB
/begin COMPU_VTAB FORMULA_0600_VTAB "FORMULA_0600_VTAB" TAB_VERB 1 0 "aus" DEFAULT_VALUE "Adaption" /end COMPU_VTAB
/begin COMPU_VTAB FORMULA_0601_VTAB "FORMULA_0601_VTAB" TAB_VERB 3 0 "no Testmode" 1 "noKL50" 2 "Testmode" DEFAULT_VALUE "undef" /end COMPU_VTAB
/begin COMPU_VTAB FORMULA_0602_VTAB "FORMULA_0602_VTAB" TAB_VERB 2 0 "no Testmode" 1 "Testmode" DEFAULT_VALUE "undef" /end COMPU_VTAB
/begin COMPU_VTAB FORMULA_0603_VTAB "FORMULA_0603_VTAB" TAB_VERB 2 0 "Poti normal" 1 "Poti invers" /end COMPU_VTAB
/begin COMPU_VTAB FORMULA_0604_VTAB "FORMULA_0604_VTAB" TAB_VERB 4 0 "aus" 1 "KH" 2 "ML" 3 "KH+ML" /end COMPU_VTAB
/begin COMPU_VTAB FORMULA_0605_VTAB "FORMULA_0605_VTAB" TAB_VERB 11 0 "Inaktiv" 1 "LLS1" 2 "LLS2" 3 "LLS1+2" 4 "DK1" 5 "LLS1+DK1" 8 "DK2" 10 "LLS2+DK2" 12 "DK1+2" 15 "Alle" 16 "Bowdenzug" /end COMPU_VTAB
/begin COMPU_VTAB FORMULA_0609_VTAB "FORMULA_0609_VTAB" TAB_VERB 9 0 "INAKTIV" 3 "NEUINIT" 5 "GET_VERS" 6 "SET_VERS" 9 "CLR_DIAGST" 10 "SET_ZYLBANK" 12 "CLR_EEPROM" 14 "CS_ERROR" 15 "UNKNOWN" /end COMPU_VTAB
/begin COMPU_VTAB FORMULA_0610_VTAB "FORMULA_0610_VTAB" TAB_VERB 9 0 "INAKTIV" 3 "NEUINIT" 5 "GET_VERS" 6 "SET_VERS" 9 "CLR_DIAGST" 10 "SET_ZYLBANK" 12 "CLR_EEPROM" 14 "CS_ERROR" 15 "UNKNOWN" /end COMPU_VTAB
/begin COMPU_VTAB FORMULA_0611_VTAB "FORMULA_0611_VTAB" TAB_VERB 3 0 "nothing" 1 "ackn" 15 "timeout" /end COMPU_VTAB
/begin COMPU_VTAB FORMULA_0612_VTAB "FORMULA_0612_VTAB" TAB_VERB 44 0 "O.K." 1 "SH_TO_UB" 2 "SH_TO_GND" 4 "OPENLOAD" 8 "UNPLAUSI" 256 "O.K./ZYKLUS" 512 "FILTER" 513 "FIL/SH_TO_UB" 514 "FIL/SH_TO_GND" 516 "FIL/OPENLOAD" 520 "FIL/UNPLAUSI" 576 "VORHANDEN" 577 "VORH/SH_TO_UB" 578 "VORH/SH_TO_GND" 580 "VORH/OPENLOAD" 584 "VORH/UNPLAUSI" 768 "FILTER/ZYKLUS" 769 "FIL/ZYK/SH_TO_UB" 770 "FIL/ZYK/SH_TO_GND" 772 "FIL/ZYK/OPENLOAD" 776 "FIL/ZYK/UNPLAUSI" 832 "VORHANDEN/ZYKLUS" 833 "VORH/ZYK/SH_TO_UB" 834 "VORH/ZYK/SH_TO_GND" 836 "VORH/ZYK/OPENLOAD" 840 "VORH/ZYK/UNPLAUSI" 2048 "O.K./SCDN" 2304 "O.K./S/ZYKLUS" 2561 "FIL/S/SH_TO_UB" 2562 "FIL/S/SH_TO_GND" 2564 "FIL/S/OPENLOAD" 2568 "FIL/S/UNPLAUSI" 2625 "VORH/S/SH_TO_UB" 2626 "VORH/S/SH_TO_GND" 2628 "VORH/S/OPENLOAD" 2632 "VORH/S/UNPLAUSI" 2817 "FIL/ZYK/S/SH_TO_UB" 2818 "FIL/ZYK/S/SH_TO_GND" 2820 "FIL/ZYK/S/OPENLOAD" 2824 "FIL/ZYK/S/UNPLAUSI" 2881 "VORH/ZYK/S/SH_TO_UB" 2882 "VORH/ZYK/S/SH_TO_GND" 2884 "VORH/ZYK/S/OPENLOAD" 2888 "VORH/ZYK/S/UNPLAUSI" /end COMPU_VTAB
/begin COMPU_VTAB FORMULA_0613_VTAB "FORMULA_0613_VTAB" TAB_VERB 3 0 "nothing" 1 "ackn" 15 "timeout" /end COMPU_VTAB
/begin COMPU_VTAB FORMULA_0614_VTAB "FORMULA_0614_VTAB" TAB_VERB 5 0 "kein Fehler" 1 "Soll-Vgl" 2 "Soll-Ist-Vgl" 4 "Mode-Vgl" 8 "CAN-Istwert" DEFAULT_VALUE "Mehrfachfehler" /end COMPU_VTAB
/begin COMPU_VTAB FORMULA_0615_VTAB "FORMULA_0615_VTAB" TAB_VERB 6 0 "kein Fehler" 1 "Spalt offen" 2 "Klemmen offen" 4 "WDK-Istwert" 8 "WDK-CAN-Vgl" 12 "WDK-Istwert" DEFAULT_VALUE "Mehrfachfehler" /end COMPU_VTAB
/begin COMPU_VTAB FORMULA_0616_VTAB "FORMULA_0616_VTAB" TAB_VERB 4 0 "kein Fehler" 1 "Soll-Vgl" 2 "Soll-Ist-Vgl" 4 "Mode-Vgl" DEFAULT_VALUE "Mehrfachfehler" /end COMPU_VTAB
/begin COMPU_VTAB FORMULA_0618_VTAB "FORMULA_0618_VTAB" TAB_VERB 2 0 "SK aus" 1 "SK aktiv" /end COMPU_VTAB
/begin COMPU_VTAB FORMULA_0619_VTAB "FORMULA_0619_VTAB" TAB_VERB 6 0 "Init" 1 "Versionsabfrage" 2 "Versionsvorgabe" 3 "Bankzuordnung" 4 "Statusabfrage" 5 "Kl15 aus" /end COMPU_VTAB
/begin COMPU_VTAB FORMULA_0621_VTAB "FORMULA_0621_VTAB" TAB_VERB 1 0 "kein Fehler" DEFAULT_VALUE "mind. 1 Fehler" /end COMPU_VTAB
/begin COMPU_VTAB FORMULA_0622_VTAB "FORMULA_0622_VTAB" TAB_VERB 11 0 "Aus" 1 "Start" 2 "Predrive" 3 "Start KlSpr" 4 "Kl.Sprung" 5 "Gr. Sprung" 6 "Start Rampe" 7 "Oeffnen 1" 8 "Oeffnen 2" 9 "Schliessen" 15 "Abbruch" DEFAULT_VALUE "undef" /end COMPU_VTAB
/begin COMPU_VTAB FORMULA_0629_VTAB "FORMULA_0629_VTAB" TAB_VERB 2 0 "nein" 1 "ja" /end COMPU_VTAB
/begin COMPU_VTAB FORMULA_0819_VTAB "FORMULA_0819_VTAB" TAB_VERB 13 1 "Motor steht" 2 "Motor presync" 4 "Start" 8 "LLOKS" 16 "LLMKS" 32 "TL" 64 "VL" 128 "SA" 256 "NL" 512 "Abgew." 1024 "Kl15 aus" 2048 "Wakeup" 4096 "Schub" DEFAULT_VALUE "undefiniert" /end COMPU_VTAB
/begin COMPU_VTAB FORMULA_0823_VTAB "FORMULA_0823_VTAB" TAB_VERB 5 0 "Aus" 7 "Aktiv" 1 "Einspr. aus" 5 "Einspr. aus" 3 "Zuendung aus" DEFAULT_VALUE "Idle" /end COMPU_VTAB
/begin COMPU_VTAB FORMULA_0824_VTAB "FORMULA_0824_VTAB" TAB_VERB 1 0 "Aus" DEFAULT_VALUE "Aktiv" /end COMPU_VTAB
/begin COMPU_VTAB FORMULA_0825_VTAB "FORMULA_0825_VTAB" TAB_VERB 1 0 "Ausschwingen ok." DEFAULT_VALUE "Fehler Ausschwingen." /end COMPU_VTAB
/begin COMPU_VTAB FORMULA_0826_VTAB "FORMULA_0826_VTAB" TAB_VERB 1 0 "Zyl. 1 ok." DEFAULT_VALUE "Fehler Ausschw. Zyl. 1." /end COMPU_VTAB
/begin COMPU_VTAB FORMULA_0827_VTAB "FORMULA_0827_VTAB" TAB_VERB 1 0 "Zyl. 2 ok." DEFAULT_VALUE "Fehler Ausschw. Zyl. 2." /end COMPU_VTAB
/begin COMPU_VTAB FORMULA_0828_VTAB "FORMULA_0828_VTAB" TAB_VERB 1 0 "Zyl. 3 ok." DEFAULT_VALUE "Fehler Ausschw. Zyl. 3." /end COMPU_VTAB
/begin COMPU_VTAB FORMULA_0829_VTAB "FORMULA_0829_VTAB" TAB_VERB 1 0 "Zyl. 4 ok." DEFAULT_VALUE "Fehler Ausschw. Zyl. 4." /end COMPU_VTAB
/begin COMPU_VTAB FORMULA_0830_VTAB "FORMULA_0830_VTAB" TAB_VERB 1 0 "Zyl. 5 ok." DEFAULT_VALUE "Fehler Ausschw. Zyl. 5." /end COMPU_VTAB
/begin COMPU_VTAB FORMULA_0831_VTAB "FORMULA_0831_VTAB" TAB_VERB 1 0 "Zyl. 6 ok." DEFAULT_VALUE "Fehler Ausschw. Zyl. 6." /end COMPU_VTAB
/begin COMPU_VTAB FORMULA_0832_VTAB "FORMULA_0832_VTAB" TAB_VERB 1 0 "Zyl. 7 ok." DEFAULT_VALUE "Fehler Ausschw. Zyl. 7." /end COMPU_VTAB
/begin COMPU_VTAB FORMULA_0833_VTAB "FORMULA_0833_VTAB" TAB_VERB 1 0 "Zyl. 8 ok." DEFAULT_VALUE "Fehler Ausschw. Zyl. 8." /end COMPU_VTAB
/begin COMPU_VTAB FORMULA_0834_VTAB "FORMULA_0834_VTAB" TAB_VERB 1 0 "Zyl. 9 ok." DEFAULT_VALUE "Fehler Ausschw. Zyl. 9." /end COMPU_VTAB
/begin COMPU_VTAB FORMULA_0835_VTAB "FORMULA_0835_VTAB" TAB_VERB 1 0 "Zyl. 10 ok." DEFAULT_VALUE "Fehler Ausschw. Zyl. 10." /end COMPU_VTAB
/begin COMPU_VTAB FORMULA_0836_VTAB "FORMULA_0836_VTAB" TAB_VERB 1 0 "Verbrennung ok." DEFAULT_VALUE "Fehler Verbrennung." /end COMPU_VTAB
/begin COMPU_VTAB FORMULA_0837_VTAB "FORMULA_0837_VTAB" TAB_VERB 1 0 "Zyl. 1 ok." DEFAULT_VALUE "Fehler Verbr. Zyl. 1." /end COMPU_VTAB
/begin COMPU_VTAB FORMULA_0838_VTAB "FORMULA_0838_VTAB" TAB_VERB 1 0 "Zyl. 2 ok." DEFAULT_VALUE "Fehler Verbr. Zyl. 2." /end COMPU_VTAB
/begin COMPU_VTAB FORMULA_0839_VTAB "FORMULA_0839_VTAB" TAB_VERB 1 0 "Zyl. 3 ok." DEFAULT_VALUE "Fehler Verbr. Zyl. 3." /end COMPU_VTAB
/begin COMPU_VTAB FORMULA_0840_VTAB "FORMULA_0840_VTAB" TAB_VERB 1 0 "Zyl. 4 ok." DEFAULT_VALUE "Fehler Verbr. Zyl. 4." /end COMPU_VTAB
/begin COMPU_VTAB FORMULA_0841_VTAB "FORMULA_0841_VTAB" TAB_VERB 1 0 "Zyl. 5 ok." DEFAULT_VALUE "Fehler Verbr. Zyl. 5." /end COMPU_VTAB
/begin COMPU_VTAB FORMULA_0842_VTAB "FORMULA_0842_VTAB" TAB_VERB 1 0 "Zyl. 6 ok." DEFAULT_VALUE "Fehler Verbr. Zyl. 6." /end COMPU_VTAB
/begin COMPU_VTAB FORMULA_0843_VTAB "FORMULA_0843_VTAB" TAB_VERB 1 0 "Zyl. 7 ok." DEFAULT_VALUE "Fehler Verbr. Zyl. 7." /end COMPU_VTAB
/begin COMPU_VTAB FORMULA_0844_VTAB "FORMULA_0844_VTAB" TAB_VERB 1 0 "Zyl. 8 ok." DEFAULT_VALUE "Fehler Verbr. Zyl. 8." /end COMPU_VTAB
/begin COMPU_VTAB FORMULA_0845_VTAB "FORMULA_0845_VTAB" TAB_VERB 1 0 "Zyl. 9 ok." DEFAULT_VALUE "Fehler Verbr. Zyl. 9." /end COMPU_VTAB
/begin COMPU_VTAB FORMULA_0846_VTAB "FORMULA_0846_VTAB" TAB_VERB 1 0 "Zyl. 10 ok." DEFAULT_VALUE "Fehler Verbr. Zyl. 10." /end COMPU_VTAB
/begin COMPU_VTAB FORMULA_0847_VTAB "FORMULA_0847_VTAB" TAB_VERB 1 0 "Kein Nebenschluss." DEFAULT_VALUE "Fehler Nebenschluss." /end COMPU_VTAB
/begin COMPU_VTAB FORMULA_0848_VTAB "FORMULA_0848_VTAB" TAB_VERB 1 0 "Zyl. 1 ok." DEFAULT_VALUE "Fehler Nebenschluss. Zyl. 1." /end COMPU_VTAB
/begin COMPU_VTAB FORMULA_0849_VTAB "FORMULA_0849_VTAB" TAB_VERB 1 0 "Zyl. 2 ok." DEFAULT_VALUE "Fehler Nebenschluss. Zyl. 2." /end COMPU_VTAB
/begin COMPU_VTAB FORMULA_0850_VTAB "FORMULA_0850_VTAB" TAB_VERB 1 0 "Zyl. 3 ok." DEFAULT_VALUE "Fehler Nebenschluss. Zyl. 3." /end COMPU_VTAB
/begin COMPU_VTAB FORMULA_0851_VTAB "FORMULA_0851_VTAB" TAB_VERB 1 0 "Zyl. 4 ok." DEFAULT_VALUE "Fehler Nebenschluss. Zyl. 4." /end COMPU_VTAB
/begin COMPU_VTAB FORMULA_0852_VTAB "FORMULA_0852_VTAB" TAB_VERB 1 0 "Zyl. 5 ok." DEFAULT_VALUE "Fehler Nebenschluss. Zyl. 5." /end COMPU_VTAB
/begin COMPU_VTAB FORMULA_0853_VTAB "FORMULA_0853_VTAB" TAB_VERB 1 0 "Zyl. 6 ok." DEFAULT_VALUE "Fehler Nebenschluss. Zyl. 6." /end COMPU_VTAB
/begin COMPU_VTAB FORMULA_0854_VTAB "FORMULA_0854_VTAB" TAB_VERB 1 0 "Zyl. 7 ok." DEFAULT_VALUE "Fehler Nebenschluss. Zyl. 7." /end COMPU_VTAB
/begin COMPU_VTAB FORMULA_0855_VTAB "FORMULA_0855_VTAB" TAB_VERB 1 0 "Zyl. 8 ok." DEFAULT_VALUE "Fehler Nebenschluss. Zyl. 8." /end COMPU_VTAB
/begin COMPU_VTAB FORMULA_0856_VTAB "FORMULA_0856_VTAB" TAB_VERB 1 0 "Zyl. 9 ok." DEFAULT_VALUE "Fehler Nebenschluss. Zyl. 9." /end COMPU_VTAB
/begin COMPU_VTAB FORMULA_0857_VTAB "FORMULA_0857_VTAB" TAB_VERB 1 0 "Zyl. 10 ok." DEFAULT_VALUE "Fehler Nebenschluss. Zyl. 10." /end COMPU_VTAB
/begin COMPU_VTAB FORMULA_0858_VTAB "FORMULA_0858_VTAB" TAB_VERB 11 0 "Aus" 511 "Aktiv" 505 "Einspr. aus" 509 "Einspr. aus" 507 "Zuendung aus" 503 "Rueckziehwinkel" 495 "N Schwelle" 479 "RF Schwelle" 447 "Diag. Fehler" 383 "Pos. Dynamik" 255 "Neg. Dynamik" DEFAULT_VALUE "Idle" /end COMPU_VTAB
/begin COMPU_VTAB FORMULA_0860_VTAB "FORMULA_0860_VTAB" TAB_VERB 1 0 "Kein Klopfen." DEFAULT_VALUE "Klopfen Erkannt." /end COMPU_VTAB
/begin FUNCTION DSP "" /begin DEF_CHARACTERISTIC K_DSP_MESSEN /end DEF_CHARACTERISTIC
 /begin OUT_MEASUREMENT dsp_100KHzDat_10of10_.dsp_ion dsp_100KHzDat_10of10_.dsp_p dsp_100KHzDat_1of10_.dsp_ion dsp_100KHzDat_1of10_.dsp_p dsp_100KHzDat_2of10_.dsp_ion dsp_100KHzDat_2of10_.dsp_p dsp_100KHzDat_3of10_.dsp_ion dsp_100KHzDat_3of10_.dsp_p dsp_100KHzDat_4of10_.dsp_ion dsp_100KHzDat_4of10_.dsp_p dsp_100KHzDat_5of10_.dsp_ion dsp_100KHzDat_5of10_.dsp_p dsp_100KHzDat_6of10_.dsp_ion dsp_100KHzDat_6of10_.dsp_p dsp_100KHzDat_7of10_.dsp_ion dsp_100KHzDat_7of10_.dsp_p dsp_100KHzDat_8of10_.dsp_ion dsp_100KHzDat_8of10_.dsp_p dsp_100KHzDat_9of10_.dsp_ion dsp_100KHzDat_9of10_.dsp_p dsp_alive_cnt dsp_alive_cnt_err dsp_alive_cnt_old dsp_bank_cnt_b1 dsp_bank_cnt_b2 dsp_bus_cnt dsp_cnt_b1 dsp_cnt_b2 dsp_d2p_b1.cam_cycle_cnt dsp_d2p_b1.fbs dsp_d2p_b1.lp_int_value dsp_d2p_b1.lp_samples dsp_d2p_b1.min_avg_int dsp_d2p_b1.min_avg_samples dsp_d2p_b1.ns_samples dsp_d2p_b1.spark_time dsp_d2p_b1.vr_int_value dsp_d2p_b1.vr_max_value dsp_d2p_b1.vr_samples dsp_d2p_b2.cam_cycle_cnt dsp_d2p_b2.fbs dsp_d2p_b2.lp_int_value dsp_d2p_b2.lp_samples dsp_d2p_b2.min_avg_int dsp_d2p_b2.min_avg_samples dsp_d2p_b2.ns_samples dsp_d2p_b2.spark_time dsp_d2p_b2.vr_int_value dsp_d2p_b2.vr_max_value dsp_d2p_b2.vr_samples dsp_dma_st dsp_irq_cnt dsp_KWG.KWG dsp_load dsp_MotDat.auss_erk_ns dsp_MotDat.auss_erk_ns_zyl1 dsp_MotDat.auss_erk_ns_zyl10 dsp_MotDat.auss_erk_ns_zyl2 dsp_MotDat.auss_erk_ns_zyl3 dsp_MotDat.auss_erk_ns_zyl4 dsp_MotDat.auss_erk_ns_zyl5 dsp_MotDat.auss_erk_ns_zyl6 dsp_MotDat.auss_erk_ns_zyl7 dsp_MotDat.auss_erk_ns_zyl8 dsp_MotDat.auss_erk_ns_zyl9 dsp_MotDat.auss_erk_ti dsp_MotDat.auss_erk_ti_zyl1 dsp_MotDat.auss_erk_ti_zyl10 dsp_MotDat.auss_erk_ti_zyl2 dsp_MotDat.auss_erk_ti_zyl3 dsp_MotDat.auss_erk_ti_zyl4 dsp_MotDat.auss_erk_ti_zyl5 dsp_MotDat.auss_erk_ti_zyl6 dsp_MotDat.auss_erk_ti_zyl7 dsp_MotDat.auss_erk_ti_zyl8 dsp_MotDat.auss_erk_ti_zyl9 dsp_MotDat.auss_erk_tz dsp_MotDat.auss_erk_tz_zyl1 dsp_MotDat.auss_erk_tz_zyl10 dsp_MotDat.auss_erk_tz_zyl2 dsp_MotDat.auss_erk_tz_zyl3 dsp_MotDat.auss_erk_tz_zyl4 dsp_MotDat.auss_erk_tz_zyl5 dsp_MotDat.auss_erk_tz_zyl6 dsp_MotDat.auss_erk_tz_zyl7 dsp_MotDat.auss_erk_tz_zyl8 dsp_MotDat.auss_erk_tz_zyl9 dsp_MotDat.auss_st_b1 dsp_MotDat.auss_st_b2 dsp_MotDat.auss_st_ti_b1 dsp_MotDat.auss_st_ti_b2 dsp_MotDat.dr_rel_b1 dsp_MotDat.dr_rel_b2 dsp_MotDat.kr_asp_cnt dsp_MotDat.kr_st dsp_MotDat.lam_ist_mw_b1 dsp_MotDat.lam_ist_mw_b2 dsp_MotDat.n dsp_MotDat.rf_b1 dsp_MotDat.rf_b2 dsp_MotDat.van_ist_A1 dsp_MotDat.van_ist_A2 dsp_MotDat.van_ist_E1 dsp_MotDat.van_ist_E2 dsp_MotDat.zustand_motor dsp_msgr_0 dsp_msgr_1 dsp_msgr_2 dsp_msgr_3 dsp_msgr_4 dsp_msgr_5 dsp_msgr_6 dsp_msgr_7 dsp_stack_cnt_err dsp_stack_unused dsp_status dsp_zyl_err dsp_zyl_st dsp_zyl1 dsp_zyl10 dsp_zyl2 dsp_zyl3 dsp_zyl4 dsp_zyl5 dsp_zyl6 dsp_zyl7 dsp_zyl8 dsp_zyl9 dsp_ZylDat_zyl1.auss_spark_time dsp_ZylDat_zyl1.dsp_cam_cycle_cnt dsp_ZylDat_zyl1.dsp_fbs dsp_ZylDat_zyl1.dsp_lp_int_value dsp_ZylDat_zyl1.dsp_lp_length dsp_ZylDat_zyl1.dsp_lp_start dsp_ZylDat_zyl1.dsp_min_avg_int dsp_ZylDat_zyl1.dsp_vr_length dsp_ZylDat_zyl1.dsp_vr_max_value dsp_ZylDat_zyl1.dsp_vr_start dsp_ZylDat_zyl1.kr_dtz dsp_ZylDat_zyl1.kr_st_erk dsp_ZylDat_zyl1.min_avg_samples dsp_ZylDat_zyl1.tz dsp_ZylDat_zyl1.vr_mess dsp_ZylDat_zyl10.auss_spark_time dsp_ZylDat_zyl10.dsp_cam_cycle_cnt dsp_ZylDat_zyl10.dsp_fbs dsp_ZylDat_zyl10.dsp_lp_int_value dsp_ZylDat_zyl10.dsp_lp_length dsp_ZylDat_zyl10.dsp_lp_start dsp_ZylDat_zyl10.dsp_min_avg_int dsp_ZylDat_zyl10.dsp_vr_length dsp_ZylDat_zyl10.dsp_vr_max_value dsp_ZylDat_zyl10.dsp_vr_start dsp_ZylDat_zyl10.kr_dtz dsp_ZylDat_zyl10.kr_st_erk dsp_ZylDat_zyl10.min_avg_samples dsp_ZylDat_zyl10.tz dsp_ZylDat_zyl10.vr_mess dsp_ZylDat_zyl2.auss_spark_time dsp_ZylDat_zyl2.dsp_cam_cycle_cnt dsp_ZylDat_zyl2.dsp_fbs dsp_ZylDat_zyl2.dsp_lp_int_value dsp_ZylDat_zyl2.dsp_lp_length dsp_ZylDat_zyl2.dsp_lp_start dsp_ZylDat_zyl2.dsp_min_avg_int dsp_ZylDat_zyl2.dsp_vr_length dsp_ZylDat_zyl2.dsp_vr_max_value dsp_ZylDat_zyl2.dsp_vr_start dsp_ZylDat_zyl2.kr_dtz dsp_ZylDat_zyl2.kr_st_erk dsp_ZylDat_zyl2.min_avg_samples dsp_ZylDat_zyl2.tz dsp_ZylDat_zyl2.vr_mess dsp_ZylDat_zyl3.auss_spark_time dsp_ZylDat_zyl3.dsp_cam_cycle_cnt dsp_ZylDat_zyl3.dsp_fbs dsp_ZylDat_zyl3.dsp_lp_int_value dsp_ZylDat_zyl3.dsp_lp_length dsp_ZylDat_zyl3.dsp_lp_start dsp_ZylDat_zyl3.dsp_min_avg_int dsp_ZylDat_zyl3.dsp_vr_length dsp_ZylDat_zyl3.dsp_vr_max_value dsp_ZylDat_zyl3.dsp_vr_start dsp_ZylDat_zyl3.kr_dtz dsp_ZylDat_zyl3.kr_st_erk dsp_ZylDat_zyl3.min_avg_samples dsp_ZylDat_zyl3.tz dsp_ZylDat_zyl3.vr_mess dsp_ZylDat_zyl4.auss_spark_time dsp_ZylDat_zyl4.dsp_cam_cycle_cnt dsp_ZylDat_zyl4.dsp_fbs dsp_ZylDat_zyl4.dsp_lp_int_value dsp_ZylDat_zyl4.dsp_lp_length dsp_ZylDat_zyl4.dsp_lp_start dsp_ZylDat_zyl4.dsp_min_avg_int dsp_ZylDat_zyl4.dsp_vr_length dsp_ZylDat_zyl4.dsp_vr_max_value dsp_ZylDat_zyl4.dsp_vr_start dsp_ZylDat_zyl4.kr_dtz dsp_ZylDat_zyl4.kr_st_erk dsp_ZylDat_zyl4.min_avg_samples dsp_ZylDat_zyl4.tz dsp_ZylDat_zyl4.vr_mess dsp_ZylDat_zyl5.auss_spark_time dsp_ZylDat_zyl5.dsp_cam_cycle_cnt dsp_ZylDat_zyl5.dsp_fbs dsp_ZylDat_zyl5.dsp_lp_int_value dsp_ZylDat_zyl5.dsp_lp_length dsp_ZylDat_zyl5.dsp_lp_start dsp_ZylDat_zyl5.dsp_min_avg_int dsp_ZylDat_zyl5.dsp_vr_length dsp_ZylDat_zyl5.dsp_vr_max_value dsp_ZylDat_zyl5.dsp_vr_start dsp_ZylDat_zyl5.kr_dtz dsp_ZylDat_zyl5.kr_st_erk dsp_ZylDat_zyl5.min_avg_samples dsp_ZylDat_zyl5.tz dsp_ZylDat_zyl5.vr_mess dsp_ZylDat_zyl6.auss_spark_time dsp_ZylDat_zyl6.dsp_cam_cycle_cnt dsp_ZylDat_zyl6.dsp_fbs dsp_ZylDat_zyl6.dsp_lp_int_value dsp_ZylDat_zyl6.dsp_lp_length dsp_ZylDat_zyl6.dsp_lp_start dsp_ZylDat_zyl6.dsp_min_avg_int dsp_ZylDat_zyl6.dsp_vr_length dsp_ZylDat_zyl6.dsp_vr_max_value dsp_ZylDat_zyl6.dsp_vr_start dsp_ZylDat_zyl6.kr_dtz dsp_ZylDat_zyl6.kr_st_erk dsp_ZylDat_zyl6.min_avg_samples dsp_ZylDat_zyl6.tz dsp_ZylDat_zyl6.vr_mess dsp_ZylDat_zyl7.auss_spark_time dsp_ZylDat_zyl7.dsp_cam_cycle_cnt dsp_ZylDat_zyl7.dsp_fbs dsp_ZylDat_zyl7.dsp_lp_int_value dsp_ZylDat_zyl7.dsp_lp_length dsp_ZylDat_zyl7.dsp_lp_start dsp_ZylDat_zyl7.dsp_min_avg_int dsp_ZylDat_zyl7.dsp_vr_length dsp_ZylDat_zyl7.dsp_vr_max_value dsp_ZylDat_zyl7.dsp_vr_start dsp_ZylDat_zyl7.kr_dtz dsp_ZylDat_zyl7.kr_st_erk dsp_ZylDat_zyl7.min_avg_samples dsp_ZylDat_zyl7.tz dsp_ZylDat_zyl7.vr_mess dsp_ZylDat_zyl8.auss_spark_time dsp_ZylDat_zyl8.dsp_cam_cycle_cnt dsp_ZylDat_zyl8.dsp_fbs dsp_ZylDat_zyl8.dsp_lp_int_value dsp_ZylDat_zyl8.dsp_lp_length dsp_ZylDat_zyl8.dsp_lp_start dsp_ZylDat_zyl8.dsp_min_avg_int dsp_ZylDat_zyl8.dsp_vr_length dsp_ZylDat_zyl8.dsp_vr_max_value dsp_ZylDat_zyl8.dsp_vr_start dsp_ZylDat_zyl8.kr_dtz dsp_ZylDat_zyl8.kr_st_erk dsp_ZylDat_zyl8.min_avg_samples dsp_ZylDat_zyl8.tz dsp_ZylDat_zyl8.vr_mess dsp_ZylDat_zyl9.auss_spark_time dsp_ZylDat_zyl9.dsp_cam_cycle_cnt dsp_ZylDat_zyl9.dsp_fbs dsp_ZylDat_zyl9.dsp_lp_int_value dsp_ZylDat_zyl9.dsp_lp_length dsp_ZylDat_zyl9.dsp_lp_start dsp_ZylDat_zyl9.dsp_min_avg_int dsp_ZylDat_zyl9.dsp_vr_length dsp_ZylDat_zyl9.dsp_vr_max_value dsp_ZylDat_zyl9.dsp_vr_start dsp_ZylDat_zyl9.kr_dtz dsp_ZylDat_zyl9.kr_st_erk dsp_ZylDat_zyl9.min_avg_samples dsp_ZylDat_zyl9.tz dsp_ZylDat_zyl9.vr_mess eth_ok /end OUT_MEASUREMENT
/end FUNCTION
/begin FUNCTION EEPROM ""
 /begin OUT_MEASUREMENT eeprom_seite_lesen eeprom_seite_lesen_hdw eeprom_seite_schreiben eeprom_st /end OUT_MEASUREMENT
/end FUNCTION
/begin FUNCTION Egas ""
 /begin DEF_CHARACTERISTIC K_EGAS_AQ_SOLL_GRAD_TAU K_EGAS_CAN_ALIVE_ERR_MAX K_EGAS_CAN_ED_TSPERR K_EGAS_CAN_ED_UB_MIN K_EGAS_CFG_AQ_SOLL K_EGAS_CFG_DK K_EGAS_CFG_LLS K_EGAS_CFG_MCS_SOLL K_EGAS_CFG_WDK K_EGAS_DK_R_DIAG_CLR K_EGAS_DK_R_DIAG_CLR_MAX K_EGAS_DK_R_DIAG_FAIL K_EGAS_EXD_GS_SOLL K_EGAS_EXD_GS_T_MAX K_EGAS_EXD_KS_SOLL K_EGAS_EXD_KS_T_MAX K_EGAS_EXD_R1_SOLL K_EGAS_EXD_R1_SOLL_TV K_EGAS_EXD_R1_TIME K_EGAS_EXD_R2_SOLL K_EGAS_EXD_R2_TIME K_EGAS_EXD_R3_TIME K_EGAS_EXD_SW_SOLL K_EGAS_EXD_UB_MAX K_EGAS_EXD_UB_MIN K_EGAS_LLS_R_DIAG_CLR K_EGAS_LLS_R_DIAG_CLR_MAX K_EGAS_LLS_R_DIAG_FAIL K_EGAS_SK_CONTROL K_EGAS_SK_DK_OFFEN_1 K_EGAS_SK_DK_OFFEN_2 K_EGAS_SK_FAIL_MAX K_EGAS_SK_IST_DIFF_LLS K_EGAS_SK_NEUINIT_MAX K_EGAS_SK_RF_IO_DK K_EGAS_SK_RF_IO_FAK K_EGAS_SK_RF_IO_OFF K_EGAS_SK_RF_IO_WDK K_EGAS_SK_RF_TSTART K_EGAS_SK_SOLL_DIFF K_EGAS_SK_SOLL_DIFF_LLS K_EGAS_SK_T_IST K_EGAS_SK_T_IST_LLS K_EGAS_SK_T_MODE K_EGAS_SK_T_MODE_INIT K_EGAS_SK_T_NP_MAX K_EGAS_SK_T_OFFEN K_EGAS_SK_T_RGPOS K_EGAS_SK_T_SOLL K_EGAS_SK_T_SOLL_LLS K_EGAS_SK_T_WDK K_EGAS_SK_TAU_DK K_EGAS_SK_TAU_LLS K_EGAS_SOLL_AQ_KH_N_MAX K_EGAS_SOLL_AQ_TI_OFF K_EGAS_SOLL_BOWDEN_LLS_F K_EGAS_SOLL_BOWDEN_MIN K_EGAS_SOLL_ENTDR_SCHW K_EGAS_SOLL_GT_OFF K_EGAS_SOLL_LLS_DELTA K_EGAS_SOLL_LLS_DK_SCHW K_EGAS_SOLL_LLS_OFF K_EGAS_SOLL_MCS_DK K_EGAS_SOLL_MCS_LLS K_EGAS_SOLL_VL_FAK K_EGAS_STM_DK_FT_TMOT K_EGAS_STM_DK_GT_MAX K_EGAS_STM_DK_GT_MIN K_EGAS_STM_DK_GT_TIME K_EGAS_STM_DK_GT_TMOT K_EGAS_STM_DK_GT_UB K_EGAS_STM_DK_MODE_HW K_EGAS_STM_DK_N_FAST K_EGAS_STM_DK_N_KL50 K_EGAS_STM_DK_NP_NMAX K_EGAS_STM_DK_NP_PMAX K_EGAS_STM_DK_NP_PMIN K_EGAS_STM_DK_NP_TMOT K_EGAS_STM_DK_NP_TMOT_MIN K_EGAS_STM_DK_NP_UB K_EGAS_STM_DK_SK_TST K_EGAS_STM_DK_SK_ZU K_EGAS_STM_DK_WAIT_DIS K_EGAS_STM_LLS_DK_SCHW K_EGAS_STM_LLS_T_ADAPT K_EGAS_STM_NOINIT_FAIL K_EGAS_STM_NOINIT_SK K_EGAS_STM_T_ADAPT K_EGAS_T_KL50 K_EGAS_WDK_A0_ANZAHL K_EGAS_WDK_A0_DELTA_MAX K_EGAS_WDK_A0_DFT K_EGAS_WDK_A0_KONST K_EGAS_WDK_A0_MAX K_EGAS_WDK_A0_MIN K_EGAS_WDK_A0_OFF_B1 K_EGAS_WDK_A0_OFF_B2 K_EGAS_WDK_A0_TIME K_EGAS_WDK_MAX K_EGAS_WDK_MIN K_EGAS_WDK_NORM KF_EGAS_N_AQ_KH_NEG KF_EGAS_N_AQ_KH_POS KF_EGAS_N_AQ_ML_NEG KF_EGAS_N_AQ_ML_POS KF_EGAS_SOLL_AQ KF_EGAS_SOLL_AQ_NOTL KF_EGAS_SOLL_AQ_START KF_EGAS_SOLL_WL_GEW_F KF_EGAS_SOLL_WL_OFFS KL_EGAS_EXD_VORST_DK_AUF KL_EGAS_EXD_VORST_DK_ZU KL_EGAS_EXD_VORST_LLS_AUF KL_EGAS_EXD_VORST_LLS_ZU KL_EGAS_N_AQ_START_NEG KL_EGAS_N_AQ_START_POS KL_EGAS_SK_DK_DIFF_MAX KL_EGAS_SK_WDK_DIFF /end DEF_CHARACTERISTIC
 /begin OUT_MEASUREMENT egas_aq_rf_wl_f egas_aq_soll_dk_b1 egas_aq_soll_dk_b2 egas_aq_soll_fil_b1 egas_aq_soll_fil_b2 egas_aq_soll_lls_b1 egas_aq_soll_lls_b2 egas_can_ed_tsperr_dk egas_can_ed_tsperr_lls egas_dk.flags_en_b1 egas_dk.flags_en_b2 egas_dk.flags_ftime_b1 egas_dk.flags_ftime_b2 egas_dk.flags_kh_b1 egas_dk.flags_kh_b2 egas_dk.flags_nachadapt_b1 egas_dk.flags_nachadapt_b2 egas_dk.flags_tst_b1 egas_dk.flags_tst_b2 egas_dk_b1.alive_err egas_dk_b1.can_st egas_dk_b1.fail_cnt egas_dk_b1.fail_st egas_dk_b1.flags egas_dk_b1.mode egas_dk_b1.mode_can egas_dk_b1.r_adapt_st egas_dk_b1.r_alive egas_dk_b1.r_diag_clr egas_dk_b1.r_diag_st egas_dk_b1.r_enable egas_dk_b1.r_gpos egas_dk_b1.r_mode egas_dk_b1.r_sollw egas_dk_b1.r_tv egas_dk_b1.state egas_dk_b1.state_time egas_dk_b2.alive_err egas_dk_b2.can_st egas_dk_b2.fail_cnt egas_dk_b2.fail_st egas_dk_b2.flags egas_dk_b2.mode egas_dk_b2.mode_can egas_dk_b2.r_adapt_st egas_dk_b2.r_alive egas_dk_b2.r_diag_clr egas_dk_b2.r_diag_st egas_dk_b2.r_enable egas_dk_b2.r_gpos egas_dk_b2.r_mode egas_dk_b2.r_sollw egas_dk_b2.r_tv egas_dk_b2.state egas_dk_b2.state_time egas_dk_fil_fail egas_dk_neuinit_cnt egas_dk_startup egas_exd_dk_soll egas_exd_dk_state egas_exd_gs_time_dn_b1 egas_exd_gs_time_dn_b2 egas_exd_gs_time_up_b1 egas_exd_gs_time_up_b2 egas_exd_ks_time_dn_b1 egas_exd_ks_time_dn_b2 egas_exd_ks_time_up_b1 egas_exd_ks_time_up_b2 egas_exd_lls_soll egas_exd_lls_state egas_exd_r1_ra_max_b1 egas_exd_r1_ra_max_b2 egas_exd_r1_ra_sum_b1 egas_exd_r1_ra_sum_b2 egas_exd_r1_tv_mw_b1 egas_exd_r1_tv_mw_b2 egas_exd_r1_tv_sum_b1 egas_exd_r1_tv_sum_b2 egas_exd_r2_ra_max_b1 egas_exd_r2_ra_max_b2 egas_exd_r2_ra_sum_b1 egas_exd_r2_ra_sum_b2 egas_exd_r2_tv_mw_b1 egas_exd_r2_tv_mw_b2 egas_exd_r2_tv_sum_b1 egas_exd_r2_tv_sum_b2 egas_exd_r3_ra_max_b1 egas_exd_r3_ra_max_b2 egas_exd_r3_ra_sum_b1 egas_exd_r3_ra_sum_b2 egas_exd_r3_tv_mw_b1 egas_exd_r3_tv_mw_b2 egas_exd_r3_tv_sum_b1 egas_exd_r3_tv_sum_b2 egas_exd_soll egas_exd_timeout egas_exd_timeout_en egas_exd_timer egas_lls.flags_adpt_b1 egas_lls.flags_adpt_b2 egas_lls_b1.alive_err egas_lls_b1.can_st egas_lls_b1.fail_cnt egas_lls_b1.fail_st egas_lls_b1.flags egas_lls_b1.mode egas_lls_b1.mode_can egas_lls_b1.r_adapt_st egas_lls_b1.r_alive egas_lls_b1.r_diag_clr egas_lls_b1.r_diag_st egas_lls_b1.r_gpos egas_lls_b1.r_mode egas_lls_b1.r_sollw egas_lls_b1.r_tv egas_lls_b1.state egas_lls_b1.state_time egas_lls_b2.alive_err egas_lls_b2.can_st egas_lls_b2.fail_cnt egas_lls_b2.fail_st egas_lls_b2.flags egas_lls_b2.mode egas_lls_b2.mode_can egas_lls_b2.r_adapt_st egas_lls_b2.r_alive egas_lls_b2.r_diag_clr egas_lls_b2.r_diag_st egas_lls_b2.r_gpos egas_lls_b2.r_mode egas_lls_b2.r_sollw egas_lls_b2.r_tv egas_lls_b2.state egas_lls_b2.state_time egas_lls_neuinit_cnt egas_lls_startup egas_n_aq egas_rec_dk_b1.cs_err egas_rec_dk_b1.ed egas_rec_dk_b1.r_bank egas_rec_dk_b1.r_cmd egas_rec_dk_b1.r_diag_st egas_rec_dk_b1.r_hw_vers egas_rec_dk_b1.r_ko_vers egas_rec_dk_b1.r_set_vers egas_rec_dk_b1.r_sw_vers egas_rec_dk_b1.rec_ack egas_rec_dk_b1.rec_err egas_rec_dk_b1.status egas_rec_dk_b2.cs_err egas_rec_dk_b2.ed egas_rec_dk_b2.r_bank egas_rec_dk_b2.r_cmd egas_rec_dk_b2.r_diag_st egas_rec_dk_b2.r_hw_vers egas_rec_dk_b2.r_ko_vers egas_rec_dk_b2.r_set_vers egas_rec_dk_b2.r_sw_vers egas_rec_dk_b2.rec_ack egas_rec_dk_b2.rec_err egas_rec_dk_b2.status egas_rec_dk_bX.cs_err egas_rec_dk_bX.ed egas_rec_dk_bX.r_bank egas_rec_dk_bX.r_cmd egas_rec_dk_bX.r_diag_st egas_rec_dk_bX.r_hw_vers egas_rec_dk_bX.r_ko_vers egas_rec_dk_bX.r_set_vers egas_rec_dk_bX.r_sw_vers egas_rec_dk_bX.rec_ack egas_rec_dk_bX.rec_err egas_rec_dk_bX.status egas_rec_lls_b1.cs_err egas_rec_lls_b1.ed egas_rec_lls_b1.r_bank egas_rec_lls_b1.r_cmd egas_rec_lls_b1.r_diag_st egas_rec_lls_b1.r_hw_vers egas_rec_lls_b1.r_ko_vers egas_rec_lls_b1.r_set_vers egas_rec_lls_b1.r_sw_vers egas_rec_lls_b1.rec_ack egas_rec_lls_b1.rec_err egas_rec_lls_b1.status egas_rec_lls_b2.cs_err egas_rec_lls_b2.ed egas_rec_lls_b2.r_bank egas_rec_lls_b2.r_cmd egas_rec_lls_b2.r_diag_st egas_rec_lls_b2.r_hw_vers egas_rec_lls_b2.r_ko_vers egas_rec_lls_b2.r_set_vers egas_rec_lls_b2.r_sw_vers egas_rec_lls_b2.rec_ack egas_rec_lls_b2.rec_err egas_rec_lls_b2.status egas_rec_lls_bX.cs_err egas_rec_lls_bX.ed egas_rec_lls_bX.r_bank egas_rec_lls_bX.r_cmd egas_rec_lls_bX.r_diag_st egas_rec_lls_bX.r_hw_vers egas_rec_lls_bX.r_ko_vers egas_rec_lls_bX.r_set_vers egas_rec_lls_bX.r_sw_vers egas_rec_lls_bX.rec_ack egas_rec_lls_bX.rec_err egas_rec_lls_bX.status egas_sk.fzust_dk_b1 egas_sk.fzust_dk_b2 egas_sk_b1.dk_diff_max egas_sk_b1.dk_off_rampe egas_sk_b1.rf_io egas_sk_b1.rf_io_delta egas_sk_b1.rf_io_ring egas_sk_b1.soll_dk egas_sk_b1.soll_lls egas_sk_b1.t_dk_offen_1 egas_sk_b1.t_dk_offen_2 egas_sk_b1.t_ist_dk egas_sk_b1.t_ist_lls egas_sk_b1.t_mode_dk egas_sk_b1.t_mode_lls egas_sk_b1.t_rgpos_dk egas_sk_b1.t_rgpos_lls egas_sk_b1.t_soll_dk egas_sk_b1.t_soll_lls egas_sk_b1.t_wdk egas_sk_b1.wdk_diff_max egas_sk_b1.zust_dk egas_sk_b1.zust_lls egas_sk_b2.dk_diff_max egas_sk_b2.dk_off_rampe egas_sk_b2.rf_io egas_sk_b2.rf_io_delta egas_sk_b2.rf_io_ring egas_sk_b2.soll_dk egas_sk_b2.soll_lls egas_sk_b2.t_dk_offen_1 egas_sk_b2.t_dk_offen_2 egas_sk_b2.t_ist_dk egas_sk_b2.t_ist_lls egas_sk_b2.t_mode_dk egas_sk_b2.t_mode_lls egas_sk_b2.t_rgpos_dk egas_sk_b2.t_rgpos_lls egas_sk_b2.t_soll_dk egas_sk_b2.t_soll_lls egas_sk_b2.t_wdk egas_sk_b2.wdk_diff_max egas_sk_b2.zust_dk egas_sk_b2.zust_lls egas_snd_dk.cmd_b1 egas_snd_dk.cmd_b1_fifo_1of5_ egas_snd_dk.cmd_b1_fifo_2of5_ egas_snd_dk.cmd_b1_fifo_3of5_ egas_snd_dk.cmd_b1_fifo_4of5_ egas_snd_dk.cmd_b1_fifo_5of5_ egas_snd_dk.cmd_b2 egas_snd_dk.cmd_b2_fifo_1of5_ egas_snd_dk.cmd_b2_fifo_2of5_ egas_snd_dk.cmd_b2_fifo_3of5_ egas_snd_dk.cmd_b2_fifo_4of5_ egas_snd_dk.cmd_b2_fifo_5of5_ egas_snd_dk.time egas_snd_dk.v_bank egas_snd_dk.v_clr_diag_b1 egas_snd_dk.v_clr_diag_b2 egas_snd_dk.v_ko_vers egas_snd_lls.cmd_b1 egas_snd_lls.cmd_b1_fifo_1of5_ egas_snd_lls.cmd_b1_fifo_2of5_ egas_snd_lls.cmd_b1_fifo_3of5_ egas_snd_lls.cmd_b1_fifo_4of5_ egas_snd_lls.cmd_b1_fifo_5of5_ egas_snd_lls.cmd_b2 egas_snd_lls.cmd_b2_fifo_1of5_ egas_snd_lls.cmd_b2_fifo_2of5_ egas_snd_lls.cmd_b2_fifo_3of5_ egas_snd_lls.cmd_b2_fifo_4of5_ egas_snd_lls.cmd_b2_fifo_5of5_ egas_snd_lls.time egas_snd_lls.v_bank egas_snd_lls.v_clr_diag_b1 egas_snd_lls.v_clr_diag_b2 egas_snd_lls.v_ko_vers egas_st_empf egas_st_empf_hys egas_stm_lls_time_oa egas_t_kl50 egas_wdk_b1.a0_cnt egas_wdk_b1.a0_max egas_wdk_b1.a0_min egas_wdk_b1.a0_sum egas_wdk_b1.a0_time egas_wdk_b1.a0_vgl egas_wdk_b1.abs egas_wdk_b1.abs_roh egas_wdk_b2.a0_cnt egas_wdk_b2.a0_max egas_wdk_b2.a0_min egas_wdk_b2.a0_sum egas_wdk_b2.a0_time egas_wdk_b2.a0_vgl egas_wdk_b2.abs egas_wdk_b2.abs_roh /end OUT_MEASUREMENT
/end FUNCTION
/begin FUNCTION Egas-Ebene_2 "" /end FUNCTION
/begin FUNCTION Eigendiagnose ""
 /begin OUT_MEASUREMENT ed_debug_laufzeit ed_fil_afz_hs.art_aktuell_nv ed_fil_afz_hs.fehler_aufrufe_nv ed_fil_afz_hs.filter_max_nv ed_fil_afz_hs.filter_nv ed_fil_afz_hs.zyklus_filter_nv ed_fil_appl_data_ign.art_aktuell_nv ed_fil_appl_data_ign.fehler_aufrufe_nv ed_fil_appl_data_ign.filter_max_nv ed_fil_appl_data_ign.filter_nv ed_fil_appl_data_ign.zyklus_filter_nv ed_fil_auss_abg_mult.art_aktuell_nv ed_fil_auss_abg_mult.fehler_aufrufe_nv ed_fil_auss_abg_mult.filter_max_nv ed_fil_auss_abg_mult.filter_nv ed_fil_auss_abg_mult.zyklus_filter_nv ed_fil_auss_abg_z1.art_aktuell_nv ed_fil_auss_abg_z1.fehler_aufrufe_nv ed_fil_auss_abg_z1.filter_max_nv ed_fil_auss_abg_z1.filter_nv ed_fil_auss_abg_z1.zyklus_filter_nv ed_fil_auss_abg_z10.art_aktuell_nv ed_fil_auss_abg_z10.fehler_aufrufe_nv ed_fil_auss_abg_z10.filter_max_nv ed_fil_auss_abg_z10.filter_nv ed_fil_auss_abg_z10.zyklus_filter_nv ed_fil_auss_abg_z2.art_aktuell_nv ed_fil_auss_abg_z2.fehler_aufrufe_nv ed_fil_auss_abg_z2.filter_max_nv ed_fil_auss_abg_z2.filter_nv ed_fil_auss_abg_z2.zyklus_filter_nv ed_fil_auss_abg_z3.art_aktuell_nv ed_fil_auss_abg_z3.fehler_aufrufe_nv ed_fil_auss_abg_z3.filter_max_nv ed_fil_auss_abg_z3.filter_nv ed_fil_auss_abg_z3.zyklus_filter_nv ed_fil_auss_abg_z4.art_aktuell_nv ed_fil_auss_abg_z4.fehler_aufrufe_nv ed_fil_auss_abg_z4.filter_max_nv ed_fil_auss_abg_z4.filter_nv ed_fil_auss_abg_z4.zyklus_filter_nv ed_fil_auss_abg_z5.art_aktuell_nv ed_fil_auss_abg_z5.fehler_aufrufe_nv ed_fil_auss_abg_z5.filter_max_nv ed_fil_auss_abg_z5.filter_nv ed_fil_auss_abg_z5.zyklus_filter_nv ed_fil_auss_abg_z6.art_aktuell_nv ed_fil_auss_abg_z6.fehler_aufrufe_nv ed_fil_auss_abg_z6.filter_max_nv ed_fil_auss_abg_z6.filter_nv ed_fil_auss_abg_z6.zyklus_filter_nv ed_fil_auss_abg_z7.art_aktuell_nv ed_fil_auss_abg_z7.fehler_aufrufe_nv ed_fil_auss_abg_z7.filter_max_nv ed_fil_auss_abg_z7.filter_nv ed_fil_auss_abg_z7.zyklus_filter_nv ed_fil_auss_abg_z8.art_aktuell_nv ed_fil_auss_abg_z8.fehler_aufrufe_nv ed_fil_auss_abg_z8.filter_max_nv ed_fil_auss_abg_z8.filter_nv ed_fil_auss_abg_z8.zyklus_filter_nv ed_fil_auss_abg_z9.art_aktuell_nv ed_fil_auss_abg_z9.fehler_aufrufe_nv ed_fil_auss_abg_z9.filter_max_nv ed_fil_auss_abg_z9.filter_nv ed_fil_auss_abg_z9.zyklus_filter_nv ed_fil_auss_kat_mult.art_aktuell_nv ed_fil_auss_kat_mult.fehler_aufrufe_nv ed_fil_auss_kat_mult.filter_max_nv ed_fil_auss_kat_mult.filter_nv ed_fil_auss_kat_mult.zyklus_filter_nv ed_fil_auss_kat_z1.art_aktuell_nv ed_fil_auss_kat_z1.fehler_aufrufe_nv ed_fil_auss_kat_z1.filter_max_nv ed_fil_auss_kat_z1.filter_nv ed_fil_auss_kat_z1.zyklus_filter_nv ed_fil_auss_kat_z10.art_aktuell_nv ed_fil_auss_kat_z10.fehler_aufrufe_nv ed_fil_auss_kat_z10.filter_max_nv ed_fil_auss_kat_z10.filter_nv ed_fil_auss_kat_z10.zyklus_filter_nv ed_fil_auss_kat_z2.art_aktuell_nv ed_fil_auss_kat_z2.fehler_aufrufe_nv ed_fil_auss_kat_z2.filter_max_nv ed_fil_auss_kat_z2.filter_nv ed_fil_auss_kat_z2.zyklus_filter_nv ed_fil_auss_kat_z3.art_aktuell_nv ed_fil_auss_kat_z3.fehler_aufrufe_nv ed_fil_auss_kat_z3.filter_max_nv /end OUT_MEASUREMENT
/end FUNCTION
/begin RECORD_LAYOUT TKF_SW_SW_SW FNC_VALUES 5 SWORD COLUMN_DIR DIRECT AXIS_PTS_X 3 SWORD INDEX_INCR DIRECT AXIS_PTS_Y 4 SWORD INDEX_INCR DIRECT NO_AXIS_PTS_X 1 UBYTE NO_AXIS_PTS_Y 2 UBYTE /end RECORD_LAYOUT
/begin RECORD_LAYOUT TKF_SW_SW_UB FNC_VALUES 5 UBYTE COLUMN_DIR DIRECT AXIS_PTS_X 3 SWORD INDEX_INCR DIRECT AXIS_PTS_Y 4 SWORD INDEX_INCR DIRECT NO_AXIS_PTS_X 1 UBYTE NO_AXIS_PTS_Y 2 UBYTE /end RECORD_LAYOUT
/begin RECORD_LAYOUT TKF_SW_SW_UW FNC_VALUES 5 UWORD COLUMN_DIR DIRECT AXIS_PTS_X 3 SWORD INDEX_INCR DIRECT AXIS_PTS_Y 4 SWORD INDEX_INCR DIRECT NO_AXIS_PTS_X 1 UBYTE NO_AXIS_PTS_Y 2 UBYTE /end RECORD_LAYOUT
/begin RECORD_LAYOUT TKL_SW_VV_SW FNC_VALUES 4 SWORD COLUMN_DIR DIRECT AXIS_PTS_X 3 SWORD INDEX_INCR DIRECT NO_AXIS_PTS_X 1 UBYTE RESERVED 2 BYTE /end RECORD_LAYOUT
/begin RECORD_LAYOUT TKL_SW_VV_UB FNC_VALUES 4 UBYTE COLUMN_DIR DIRECT AXIS_PTS_X 3 SWORD INDEX_INCR DIRECT NO_AXIS_PTS_X 1 UBYTE RESERVED 2 BYTE /end RECORD_LAYOUT
/begin RECORD_LAYOUT TKW_VV_VV_SW FNC_VALUES 1 SWORD COLUMN_DIR DIRECT /end RECORD_LAYOUT
/begin RECORD_LAYOUT TKW_VV_VV_UB FNC_VALUES 1 UBYTE COLUMN_DIR DIRECT /end RECORD_LAYOUT
/begin RECORD_LAYOUT TKW_VV_VV_UW FNC_VALUES 1 UWORD COLUMN_DIR DIRECT /end RECORD_LAYOUT
/end MODULE
/end PROJECT
