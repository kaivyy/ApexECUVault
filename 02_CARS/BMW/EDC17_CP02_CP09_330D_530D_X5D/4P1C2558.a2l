ASAP2_VERSION 1 4
/begin PROJECT P_558 "EDC17_CP02"
/begin HEADER "" VERSION "V1C1" PROJECT_NO P_558 /end HEADER
/begin MODULE DIM ""
/begin MOD_COMMON "" BYTE_ORDER MSB_LAST ALIGNMENT_BYTE 1 ALIGNMENT_WORD 2 ALIGNMENT_LONG 4 ALIGNMENT_FLOAT32_IEEE 4 /end MOD_COMMON
/begin CHARACTERISTIC Exh_numFldTOxiCatUs_C "" VALUE 0x8006D120 Val_Ws16 65535.00 OneToOne -32768.00 32767.00 FORMAT "%8.2" /end CHARACTERISTIC
/begin CHARACTERISTIC Exh_numTOxiCatUs_C "" VALUE 0x8006D122 Val_Wu8 255.0 OneToOne 0.00 255.0 FORMAT "%5.1" /end CHARACTERISTIC
/begin CHARACTERISTIC Exh_numTPFltUs_C "" VALUE 0x8006D1D0 Val_Wu8 255.0 OneToOne 0.00 255.0 FORMAT "%5.1" /end CHARACTERISTIC
/begin CHARACTERISTIC Exh_RmpSlpTOxiCatUs.Pos_C "/" VALUE 0x8006D124 Kw_Ws32 3276799.99847 RmpTemp 0.00 3276799.99847 FORMAT "%13.5" EXTENDED_LIMITS -3276800.00000 3276799.99847 /end CHARACTERISTIC
/begin CHARACTERISTIC Exh_RmpSlpTOxiCatUs.Neg_C "/" VALUE 0x8006D128 Kw_Ws32 3276799.99847 RmpTemp 0.00 3276799.99847 FORMAT "%13.5" EXTENDED_LIMITS -3276800.00000 3276799.99847 /end CHARACTERISTIC
/begin CHARACTERISTIC Exh_RmpSlpTPFltUs.Pos_C "/" VALUE 0x8006D1D4 Kw_Ws32 3276799.99847 RmpTemp 0.00 3276799.99847 FORMAT "%13.5" EXTENDED_LIMITS -3276800.00000 3276799.99847 /end CHARACTERISTIC
/begin CHARACTERISTIC Exh_RmpSlpTPFltUs.Neg_C "/" VALUE 0x8006D1D8 Kw_Ws32 3276799.99847 RmpTemp 0.00 3276799.99847 FORMAT "%13.5" EXTENDED_LIMITS -3276800.00000 3276799.99847 /end CHARACTERISTIC
/begin CHARACTERISTIC Exh_SRCTOxiCatUs.uMin_C "/" VALUE 0x8006D0B4 Val_Ws16 13107.00 Volt -6553.600 6553.400 FORMAT "%8.3" /end CHARACTERISTIC
/begin CHARACTERISTIC Exh_SRCTOxiCatUs.uMax_C "/" VALUE 0x8006D0B6 Val_Ws16 1800.000 Volt 3000.000 4800.000 FORMAT "%8.3" EXTENDED_LIMITS -6553.600 6553.400 /end CHARACTERISTIC
/begin CHARACTERISTIC Exh_SRCTPFltUs.uMin_C "/" VALUE 0x8006D1C0 Val_Ws16 250.0000 Volt 0.00 250.0000 FORMAT "%8.4" EXTENDED_LIMITS -6553.600 6553.400 /end CHARACTERISTIC
/begin CHARACTERISTIC Exh_SRCTPFltUs.uMax_C "/" VALUE 0x8006D1C2 Val_Ws16 1800.000 Volt 3000.000 4800.000 FORMAT "%8.3" EXTENDED_LIMITS -6553.600 6553.400 /end CHARACTERISTIC
/begin CHARACTERISTIC Exh_stMaskLckNplTPFltUs_C "" VALUE 0x8006D1DC Val_Wu32 4294967295.00 OneToOne 0.00 4294967295.00 FORMAT "%13.2" /end CHARACTERISTIC
/begin CHARACTERISTIC Exh_stMskLckNplTOxiCatUs_C "" VALUE 0x8006D12C Val_Wu32 4294967295.00 OneToOne 0.00 4294967295.00 FORMAT "%13.2" /end CHARACTERISTIC
/begin CHARACTERISTIC Exh_swtDflTPFltUs_C "" VALUE 0x8006D1E0 Val_Wu8 255.0 OneToOne 0.00 255.0 FORMAT "%5.1" /end CHARACTERISTIC
/begin CHARACTERISTIC Exh_swtSensTOxiCatUs_C "" VALUE 0x8006D0B8 Val_Wu8 255.0 OneToOne 0.00 255.0 FORMAT "%5.1" /end CHARACTERISTIC
/begin CHARACTERISTIC Exh_tDiffNegTOxiCatUs_CUR "" CURVE 0x8006D130 Kl_Xs16_Ws16 6553.500 TempDiff_Kelv -3276.800 3276.700 FORMAT "%8.3"
 /begin AXIS_DESCR STD_AXIS Exh_tModTOxiCatUs_mp Temp_Cels 16 -3549.940 3003.560 FORMAT "%8.3" DEPOSIT ABSOLUTE /end AXIS_DESCR
/end CHARACTERISTIC
/begin CHARACTERISTIC Exh_tDiffNegTPFltUs_CUR "" CURVE 0x8006D1E2 Cur_Xs16Ws16 300.0000 TempDiff_Kelv -200.0000 100.0000 FORMAT "%8.4" EXTENDED_LIMITS -3276.800 3276.700
 /begin AXIS_DESCR STD_AXIS Exh_tEGFldTPFltUs_mp Temp_Cels 2 -45.04000 999.9600 FORMAT "%8.3" EXTENDED_LIMITS -3549.940 3003.560 DEPOSIT ABSOLUTE /end AXIS_DESCR
/end CHARACTERISTIC
/begin CHARACTERISTIC Exh_tDiffPosTOxiCatUs_CUR "" CURVE 0x8006D172 Kl_Xs16_Ws16 6553.500 TempDiff_Kelv -3276.800 3276.700 FORMAT "%8.3"
 /begin AXIS_DESCR STD_AXIS Exh_tModTOxiCatUs_mp Temp_Cels 16 -3549.940 3003.560 FORMAT "%8.3" DEPOSIT ABSOLUTE /end AXIS_DESCR
/end CHARACTERISTIC
/begin CHARACTERISTIC Exh_tDiffPosTPFltUs_CUR "" CURVE 0x8006D1EC Cur_Xs16Ws16 300.0000 TempDiff_Kelv 0.00 300.0000 FORMAT "%8.4" EXTENDED_LIMITS -3276.800 3276.700
 /begin AXIS_DESCR STD_AXIS Exh_tEGFldTPFltUs_mp Temp_Cels 2 -0.04000000 1099.960 FORMAT "%8.3" EXTENDED_LIMITS -3549.940 3003.560 DEPOSIT ABSOLUTE /end AXIS_DESCR
/end CHARACTERISTIC
/begin CHARACTERISTIC Exh_tiLckNplRgnTOxiCatUs_C "" VALUE 0x8006D1B4 Val_Ws16 655.3500 Time_s -327.6800 327.6700 FORMAT "%8.4" /end CHARACTERISTIC
/begin CHARACTERISTIC Exh_tiLckNplRgnTPFltUs_C "" VALUE 0x8006D1F6 Val_Ws16 655.3500 Time_s -327.6800 327.6700 FORMAT "%8.4" /end CHARACTERISTIC
/begin CHARACTERISTIC Exh_tiLckNplTOxiCatUs_C "" VALUE 0x8006D1B6 Val_Ws16 655.3500 Time_s -327.6800 327.6700 FORMAT "%8.4" /end CHARACTERISTIC
/begin CHARACTERISTIC Exh_tiLckNplTPFltUs_C "" VALUE 0x8006D1F8 Val_Ws16 655.3500 Time_s -327.6800 327.6700 FORMAT "%8.4" /end CHARACTERISTIC
/begin CHARACTERISTIC Exh_tiLPFltPT1TOxiCatUs_C "" VALUE 0x8006D1B8 Val_Ws32 4294.9672940 TimeDelay_s 0.000002000000001 4294.9672960 FORMAT "%12.7" /end CHARACTERISTIC
/begin CHARACTERISTIC Exh_TransStageParTPFltUs.Dfl_C "/" VALUE 0x8006D1FA Kw_Ws16 199.0000 Temp_Cels -0.04000000 198.9600 FORMAT "%8.4" EXTENDED_LIMITS -3549.940 3003.560 /end CHARACTERISTIC
/begin CHARACTERISTIC Exh_TransStageParTPFltUs.stSensId_C "/" VALUE 0x8006D1FC Kw_Wu8 255.0 OneToOne 0.00 255.0 FORMAT "%5.1" /end CHARACTERISTIC
/begin CHARACTERISTIC Exh_TransStgTOxiCatUs.Dfl_C "/" VALUE 0x8006D1BC Kw_Ws16 250.0000 Temp_Cels -50.04000 199.9600 FORMAT "%8.4" EXTENDED_LIMITS -3549.940 3003.560 /end CHARACTERISTIC
/begin CHARACTERISTIC Exh_TransStgTOxiCatUs.stSensId_C "/" VALUE 0x8006D1BE Kw_Wu8 255.0 OneToOne 0.00 255.0 FORMAT "%5.1" /end CHARACTERISTIC
/begin CHARACTERISTIC Exh_tTransfTOxiCatUs_CUR "" CURVE 0x8006D0BA Cur_Xs16Ws16 225.0000 Temp_Cels -45.04000 179.9600 FORMAT "%8.4" EXTENDED_LIMITS -3549.940 3003.560
 /begin AXIS_DESCR STD_AXIS Exh_uRawTOxiCatUs Volt 25 0.00 4800.000 FORMAT "%8.3" EXTENDED_LIMITS -6553.600 6553.400 DEPOSIT ABSOLUTE /end AXIS_DESCR
/end CHARACTERISTIC
/begin CHARACTERISTIC Exh_tTransfTPFltUs_CUR "" CURVE 0x8006D1C4 Cur_Xs16Ws16 225.0000 Temp_Cels -45.04000 179.9600 FORMAT "%8.4" EXTENDED_LIMITS -3549.940 3003.560
 /begin AXIS_DESCR STD_AXIS Exh_uRawTPFltUs Volt 2 0.00 4800.000 FORMAT "%8.3" EXTENDED_LIMITS -6553.600 6553.400 DEPOSIT ABSOLUTE /end AXIS_DESCR
/end CHARACTERISTIC
/begin CHARACTERISTIC PT_numTraGear1_C "" VALUE 0x8006D2E8 Val_Wu8 255.0 OneToOne 0.00 255.0 FORMAT "%5.1" /end CHARACTERISTIC
/begin CHARACTERISTIC PT_numTraGear2_C "" VALUE 0x8006D2E9 Val_Wu8 255.0 OneToOne 0.00 255.0 FORMAT "%5.1" /end CHARACTERISTIC
/begin CHARACTERISTIC PT_numTraGear3_C "" VALUE 0x8006D2EA Val_Wu8 255.0 OneToOne 0.00 255.0 FORMAT "%5.1" /end CHARACTERISTIC
/begin CHARACTERISTIC PT_numTraGear4_C "" VALUE 0x8006D2EB Val_Wu8 255.0 OneToOne 0.00 255.0 FORMAT "%5.1" /end CHARACTERISTIC
/begin CHARACTERISTIC PT_numTraGear5_C "" VALUE 0x8006D2EC Val_Wu8 255.0 OneToOne 0.00 255.0 FORMAT "%5.1" /end CHARACTERISTIC
/begin CHARACTERISTIC PT_numTraGear6_C "" VALUE 0x8006D2ED Val_Wu8 255.0 OneToOne 0.00 255.0 FORMAT "%5.1" /end CHARACTERISTIC
/begin CHARACTERISTIC PT_numTraGear7_C "" VALUE 0x8006D2EE Val_Wu8 255.0 OneToOne 0.00 255.0 FORMAT "%5.1" /end CHARACTERISTIC
/begin CHARACTERISTIC PT_numTraGearR_C "" VALUE 0x8006D2EF Val_Wu8 255.0 OneToOne 0.00 255.0 FORMAT "%5.1" /end CHARACTERISTIC
/begin CHARACTERISTIC PT_numTraNoGear_C "Applikationsparameter für Leergang" VALUE 0x8006D2F0 Val_Wu8 255.0 OneToOne 0.00 255.0 FORMAT "%5.1" /end CHARACTERISTIC
/begin CHARACTERISTIC PT_rTraGear1_C "" VALUE 0x8006D2F2 Val_Ws16 655.3500 TransR -327.6800 327.6700 FORMAT "%8.4" /end CHARACTERISTIC
/begin CHARACTERISTIC PT_rTraGear2_C "" VALUE 0x8006D2F4 Val_Ws16 655.3500 TransR -327.6800 327.6700 FORMAT "%8.4" /end CHARACTERISTIC
/begin CHARACTERISTIC PT_rTraGear3_C "" VALUE 0x8006D2F6 Val_Ws16 655.3500 TransR -327.6800 327.6700 FORMAT "%8.4" /end CHARACTERISTIC
/begin CHARACTERISTIC PT_rTraGear4_C "" VALUE 0x8006D2F8 Val_Ws16 655.3500 TransR -327.6800 327.6700 FORMAT "%8.4" /end CHARACTERISTIC
/begin CHARACTERISTIC PT_rTraGear5_C "" VALUE 0x8006D2FA Val_Ws16 655.3500 TransR -327.6800 327.6700 FORMAT "%8.4" /end CHARACTERISTIC
/begin CHARACTERISTIC PT_rTraGear6_C "" VALUE 0x8006D2FC Val_Ws16 655.3500 TransR -327.6800 327.6700 FORMAT "%8.4" /end CHARACTERISTIC
/begin CHARACTERISTIC PT_rTraGearR_C "" VALUE 0x8006D2FE Val_Ws16 655.3500 TransR -327.6800 327.6700 FORMAT "%8.4" /end CHARACTERISTIC
/begin CHARACTERISTIC PT_rTraLoRng_C "" VALUE 0x8006D300 Val_Ws16 655.3500 TransR -327.6800 327.6700 FORMAT "%8.4" /end CHARACTERISTIC
/begin CHARACTERISTIC PT_rTraMax_C "" VALUE 0x8006D302 Val_Ws16 655.3500 TransR -327.6800 327.6700 FORMAT "%8.4" /end CHARACTERISTIC
/begin CHARACTERISTIC Rail_ctATSSel_C "Selektionsparameter für Arrayelement Ansauglufttemperatur (EngDa_tFld)" VALUE 0x8006BD78 Val_Wu8 2.00000000000 IndSysTempFldSel 0.00 2.00000000000 FORMAT "%13.11" /end CHARACTERISTIC
/begin CHARACTERISTIC Rail_facSetPointAPSCor0Rgn_GCUR "atmosphärendruckabhängigen Korrekturkennlinie für die Raildrucksollwertbildung für die Regenerationsstufe 1" CURVE 0x8006BDE0 CurG_Ws16 1.000000 Fact 0.00 1.000000 FORMAT "%8.6" EXTENDED_LIMITS -4.000000 3.999878
 /begin AXIS_DESCR COM_AXIS EnvP_p Pres_hPa 12 0.00 3500.000 FORMAT "%8.3" EXTENDED_LIMITS -32768.00 32767.00 AXIS_PTS_REF Rail_facSetPointAPSCorRgn_AXIS /end AXIS_DESCR
/end CHARACTERISTIC
/begin CHARACTERISTIC Rail_facSetPointAPSCor1Rgn_GCUR "atmosphärendruckabhängigen Korrekturkennlinie für die Raildrucksollwertbildung für die Regenerationsstufe 2" CURVE 0x8006BDF8 CurG_Ws16 1.000000 Fact 0.00 1.000000 FORMAT "%8.6" EXTENDED_LIMITS -4.000000 3.999878
 /begin AXIS_DESCR COM_AXIS EnvP_p Pres_hPa 12 0.00 3500.000 FORMAT "%8.3" EXTENDED_LIMITS -32768.00 32767.00 AXIS_PTS_REF Rail_facSetPointAPSCorRgn_AXIS /end AXIS_DESCR
/end CHARACTERISTIC
/begin AXIS_PTS Rail_facSetPointAPSCorRgn_AXIS "Stützstellenverteilung für die atmosphärendruckabhängigen Korrekturkennlinien" 0x8006BE10 EnvP_p Axis_Xs16 3500.000 Pres_hPa 12 0.00 3500.000 FORMAT "%8.3" EXTENDED_LIMITS -32768.00 32767.00 DEPOSIT ABSOLUTE /end AXIS_PTS
/begin CHARACTERISTIC Rail_facSetPointAPSCor_CUR "Gewichtungsfaktor, abhängig vom Atmosphärendruck für die Sollwertkorrektur des Raildrucks" CURVE 0x8006BD7A Cur_Xs16Ws16 1.000000 Fact 0.00 1.000000 FORMAT "%8.6" EXTENDED_LIMITS -4.000000 3.999878
 /begin AXIS_DESCR STD_AXIS EnvP_p Pres_hPa 8 0.00 3500.000 FORMAT "%8.3" EXTENDED_LIMITS -32768.00 32767.00 DEPOSIT ABSOLUTE /end AXIS_DESCR
/end CHARACTERISTIC
/begin CHARACTERISTIC Rail_facSetPointATSCor0Rgn_GCUR "ansauglufttemperaturabhängige Korrekturkennlinie für die Raildrucksollwertbildung für die Regenerationsstufe 1" CURVE 0x8006BE2A CurG_Ws16 1.000000 Fact 0.00 1.000000 FORMAT "%8.6" EXTENDED_LIMITS -4.000000 3.999878
 /begin AXIS_DESCR COM_AXIS Rail_tAir Temp_Cels 12 -50.14000 199.8600 FORMAT "%8.4" EXTENDED_LIMITS -3549.940 3003.560 AXIS_PTS_REF Rail_facSetPointATSCorRgn_AXIS /end AXIS_DESCR
/end CHARACTERISTIC
/begin CHARACTERISTIC Rail_facSetPointATSCor1Rgn_GCUR "ansauglufttemperaturabhängige Korrekturkennlinie für die Raildrucksollwertbildung für die Regenerationsstufe 2" CURVE 0x8006BE42 CurG_Ws16 1.000000 Fact 0.00 1.000000 FORMAT "%8.6" EXTENDED_LIMITS -4.000000 3.999878
 /begin AXIS_DESCR COM_AXIS Rail_tAir Temp_Cels 12 -50.14000 199.8600 FORMAT "%8.4" EXTENDED_LIMITS -3549.940 3003.560 AXIS_PTS_REF Rail_facSetPointATSCorRgn_AXIS /end AXIS_DESCR
/end CHARACTERISTIC
/begin AXIS_PTS Rail_facSetPointATSCorRgn_AXIS "Stützstellenverteilung für die ansauglufttemperaturabhängigen Korrekturkennlinie" 0x8006BE5A Rail_tAir Axis_Xs16 250.0000 Temp_Cels 12 -50.14000 199.8600 FORMAT "%8.4" EXTENDED_LIMITS -3549.940 3003.560 DEPOSIT ABSOLUTE /end AXIS_PTS
/begin CHARACTERISTIC Rail_facSetPointATSCor_CUR "Gewichtungsfaktor, abhängig von der Ansauglufttemperatur für die Sollwertkorrektur des Raildrucks" CURVE 0x8006BD9C Cur_Xs16Ws16 1.000000 Fact 0.00 1.000000 FORMAT "%8.6" EXTENDED_LIMITS -4.000000 3.999878
 /begin AXIS_DESCR STD_AXIS CACDsT_t Temp_Cels 8 -50.14000 199.8600 FORMAT "%8.4" EXTENDED_LIMITS -3549.940 3003.560 DEPOSIT ABSOLUTE /end AXIS_DESCR
/end CHARACTERISTIC
/begin CHARACTERISTIC Rail_facSetPointEnvCorRgnMax_C "oberer Begrenzungsfaktor für die Korrektur des Raildrucksollwertes im Regenerationsbetrieb" VALUE 0x8006B4EC Val_Ws16 1.000000 Fact 0.00 1.000000 FORMAT "%8.6" EXTENDED_LIMITS -4.000000 3.999878 /end CHARACTERISTIC
/begin CHARACTERISTIC Rail_facSetPointEnvCorRgnMin_C "unterer Begrenzungsfaktor für die Korrektur des Raildrucksollwertes im Regenerationsbetrieb" VALUE 0x8006B4EE Val_Ws16 1.000000 Fact 0.00 1.000000 FORMAT "%8.6" EXTENDED_LIMITS -4.000000 3.999878 /end CHARACTERISTIC
/begin CHARACTERISTIC Rail_facSetPointETSCor0Rgn_GCUR "motortemperaturabhängige Korrekturkennlinie für die Raildrucksollwertbildung für die Regenerationsstufe 1" CURVE 0x8006BE74 CurG_Ws16 1.000000 Fact 0.00 1.000000 FORMAT "%8.6" EXTENDED_LIMITS -4.000000 3.999878
 /begin AXIS_DESCR COM_AXIS InjSys_tEng Temp_Cels 12 -50.14000 199.8600 FORMAT "%8.4" EXTENDED_LIMITS -3549.940 3003.560 AXIS_PTS_REF Rail_facSetPointETSCorRgn_AXIS /end AXIS_DESCR
/end CHARACTERISTIC
/begin CHARACTERISTIC Rail_facSetPointETSCor1Rgn_GCUR "motortemperaturabhängige Korrekturkennlinie für die Raildrucksollwertbildung für die Regenerationsstufe 2" CURVE 0x8006BE8C CurG_Ws16 1.000000 Fact 0.00 1.000000 FORMAT "%8.6" EXTENDED_LIMITS -4.000000 3.999878
 /begin AXIS_DESCR COM_AXIS InjSys_tEng Temp_Cels 12 -50.14000 199.8600 FORMAT "%8.4" EXTENDED_LIMITS -3549.940 3003.560 AXIS_PTS_REF Rail_facSetPointETSCorRgn_AXIS /end AXIS_DESCR
/end CHARACTERISTIC
/begin AXIS_PTS Rail_facSetPointETSCorRgn_AXIS "Stützstellenverteilung für die motortemperaturabhängige Korrekturkennlinien" 0x8006BEA4 InjSys_tEng Axis_Xs16 250.0000 Temp_Cels 12 -50.14000 199.8600 FORMAT "%8.4" EXTENDED_LIMITS -3549.940 3003.560 DEPOSIT ABSOLUTE /end AXIS_PTS
/begin CHARACTERISTIC Rail_facSetPointETSCor_CUR "Gewichtungsfaktor, abhängig von der Motortemperatur für die Sollwertkorrektur des Raildrucks" CURVE 0x8006BDBE Cur_Xs16Ws16 1.000000 Fact 0.00 1.000000 FORMAT "%8.6" EXTENDED_LIMITS -4.000000 3.999878
 /begin AXIS_DESCR STD_AXIS InjSys_tEng Temp_Cels 8 -50.14000 199.8600 FORMAT "%8.4" EXTENDED_LIMITS -3549.940 3003.560 DEPOSIT ABSOLUTE /end AXIS_DESCR
/end CHARACTERISTIC
/begin CHARACTERISTIC Rail_pFltMinZFC_C "Minimaler Raildruck für die Überwachung bei aktiver ZFC" VALUE 0x8006BF64 Val_Ws16 2000.000 Pres_Rail 0.00 2000.000 FORMAT "%5.3" EXTENDED_LIMITS -3276.800 3276.700 /end CHARACTERISTIC
/begin CHARACTERISTIC Rail_pSetPointAPSCor0Rgn_GMAP "druckabhängiger Basiswert für die Korrektur der Raildrucksollwertbildung für die Regenerationsstufe 1" MAP 0x8006B4F0 MapG_Ws16 2000.000 Pres_Rail 0.00 2000.000 FORMAT "%5.3" EXTENDED_LIMITS -3276.800 3276.700
 /begin AXIS_DESCR COM_AXIS Epm_nEng EngN 16 0.00 6000.000 FORMAT "%8.3" EXTENDED_LIMITS -16384.00 16383.50 AXIS_PTS_REF Rail_pSetPointAPSCorRgnX_AXIS /end AXIS_DESCR
 /begin AXIS_DESCR COM_AXIS InjCtl_qSetUnBal InjMass 16 0.00 327.6700 FORMAT "%8.4" EXTENDED_LIMITS -327.6800 327.6700 AXIS_PTS_REF Rail_pSetPointAPSCorRgnY_AXIS /end AXIS_DESCR
/end CHARACTERISTIC
/begin CHARACTERISTIC Rail_pSetPointAPSCor1Rgn_GMAP "druckabhängiger Basiswert für die Korrektur der Raildrucksollwertbildung für die Regenerationsstufe 2" MAP 0x8006B6F0 MapG_Ws16 2000.000 Pres_Rail 0.00 2000.000 FORMAT "%5.3" EXTENDED_LIMITS -3276.800 3276.700
 /begin AXIS_DESCR COM_AXIS Epm_nEng EngN 16 0.00 6000.000 FORMAT "%8.3" EXTENDED_LIMITS -16384.00 16383.50 AXIS_PTS_REF Rail_pSetPointAPSCorRgnX_AXIS /end AXIS_DESCR
 /begin AXIS_DESCR COM_AXIS InjCtl_qSetUnBal InjMass 16 0.00 327.6700 FORMAT "%8.4" EXTENDED_LIMITS -327.6800 327.6700 AXIS_PTS_REF Rail_pSetPointAPSCorRgnY_AXIS /end AXIS_DESCR
/end CHARACTERISTIC
/begin AXIS_PTS Rail_pSetPointAPSCorRgnX_AXIS "Stützstellenverteilung für die druckabhängigen Gruppenkorrekturfelder Rail_pSetPointAPSCor%Rgn_GMAP für die Eingangsgröße Epm_nEng" 0x8006B8F0 Epm_nEng Axis_Xs16 6000.000 EngN 16 0.00 6000.000 FORMAT "%8.3" EXTENDED_LIMITS -16384.00 16383.50 DEPOSIT ABSOLUTE /end AXIS_PTS
/begin AXIS_PTS Rail_pSetPointAPSCorRgnY_AXIS "Stützstellenverteilung für die druckabhängigen Gruppenkorrekturfelder Rail_pSetPointAPSCor%Rgn_GMAP für die Eingangsgröße InjCtl_qSetUnBal \ PthSet_trqInrSet" 0x8006B912 InjCtl_qSetUnBal Axis_Xs16 327.6700 InjMass 16 0.00 327.6700 FORMAT "%8.4" EXTENDED_LIMITS -327.6800 327.6700 DEPOSIT ABSOLUTE /end AXIS_PTS
/begin CHARACTERISTIC Rail_pSetPointBaseStrt_MAP "Basiskennfeld für den Raildrucksollwert beim Start" MAP 0x8006BEBE Map_Xs16Ys16Ws16 2000.000 Pres_Rail 0.00 2000.000 FORMAT "%5.3" EXTENDED_LIMITS -3276.800 3276.700
 /begin AXIS_DESCR STD_AXIS Epm_nEng EngN 8 0.00 6000.000 FORMAT "%8.3" EXTENDED_LIMITS -16384.00 16383.50 DEPOSIT ABSOLUTE /end AXIS_DESCR
 /begin AXIS_DESCR STD_AXIS InjCtl_qCurr InjMass 8 0.00 327.6700 FORMAT "%8.4" EXTENDED_LIMITS -327.6800 327.6700 DEPOSIT ABSOLUTE /end AXIS_DESCR
/end CHARACTERISTIC
/begin CHARACTERISTIC Rail_pSetPointTempCor0Rgn_GMAP "Temperaturabhängiger Basiswert für die Korrektur der Raildrucksollwertbildung für die Regenerationsstufe 1" MAP 0x8006B934 MapG_Ws16 2000.000 Pres_Rail 0.00 2000.000 FORMAT "%5.3" EXTENDED_LIMITS -3276.800 3276.700
 /begin AXIS_DESCR COM_AXIS Epm_nEng EngN 16 0.00 6000.000 FORMAT "%8.3" EXTENDED_LIMITS -16384.00 16383.50 AXIS_PTS_REF Rail_pSetPointTempCorRgnX_AXIS /end AXIS_DESCR
 /begin AXIS_DESCR COM_AXIS InjCtl_qSetUnBal InjMass 16 0.00 327.6700 FORMAT "%8.4" EXTENDED_LIMITS -327.6800 327.6700 AXIS_PTS_REF Rail_pSetPointTempCorRgnY_AXIS /end AXIS_DESCR
/end CHARACTERISTIC
/begin CHARACTERISTIC Rail_pSetPointTempCor1Rgn_GMAP "Temperaturabhängiger Basiswert für die Korrektur der Raildrucksollwertbildung für die Regenerationsstufe 2" MAP 0x8006BB34 MapG_Ws16 2000.000 Pres_Rail 0.00 2000.000 FORMAT "%5.3" EXTENDED_LIMITS -3276.800 3276.700
 /begin AXIS_DESCR COM_AXIS Epm_nEng EngN 16 0.00 6000.000 FORMAT "%8.3" EXTENDED_LIMITS -16384.00 16383.50 AXIS_PTS_REF Rail_pSetPointTempCorRgnX_AXIS /end AXIS_DESCR
 /begin AXIS_DESCR COM_AXIS InjCtl_qSetUnBal InjMass 16 0.00 327.6700 FORMAT "%8.4" EXTENDED_LIMITS -327.6800 327.6700 AXIS_PTS_REF Rail_pSetPointTempCorRgnY_AXIS /end AXIS_DESCR
/end CHARACTERISTIC
/begin AXIS_PTS Rail_pSetPointTempCorRgnX_AXIS "Stützstellenverteilung für die Gruppenkorrekturfelder Rail_pSetPointTempCor%Rgn_GMAP für die Eingangsgröße Epm_nEng" 0x8006BD34 Epm_nEng Axis_Xs16 6000.000 EngN 16 0.00 6000.000 FORMAT "%8.3" EXTENDED_LIMITS -16384.00 16383.50 DEPOSIT ABSOLUTE /end AXIS_PTS
/begin AXIS_PTS Rail_pSetPointTempCorRgnY_AXIS "Stützstellenverteilung für die Gruppenkorrekturfelder Rail_pSetPointTempCor%Rgn_GMAP für die Eingangsgröße InjCtl_qSetUnBal" 0x8006BD56 InjCtl_qSetUnBal Axis_Xs16 327.6700 InjMass 16 0.00 327.6700 FORMAT "%8.4" EXTENDED_LIMITS -327.6800 327.6700 DEPOSIT ABSOLUTE /end AXIS_PTS
/begin CHARACTERISTIC Rail_pSetPointZFCMax_C "Maximaler Raildrucksollwert bei aktiver Nullmengenkalibrierung" VALUE 0x8006BF66 Val_Ws16 2000.000 Pres_Rail 0.00 2000.000 FORMAT "%5.3" EXTENDED_LIMITS -3276.800 3276.700 /end CHARACTERISTIC
/begin CHARACTERISTIC Rail_pSetPointZFCMin_C "Minimaler Raildrucksollwert bei aktiver Nullmengenkalibrierung" VALUE 0x8006BF68 Val_Ws16 2000.000 Pres_Rail 0.00 2000.000 FORMAT "%5.3" EXTENDED_LIMITS -3276.800 3276.700 /end CHARACTERISTIC
/begin CHARACTERISTIC Rail_rFltMinSlpZFC_C "Rampensteigung bei minimalem Raildruck nach Kalibrierung der ZFC" VALUE 0x8006BF6A Val_Ws16 100.0000 Prc 0.00 100.0000 FORMAT "%8.4" EXTENDED_LIMITS -400.0000 399.9878 /end CHARACTERISTIC
/begin CHARACTERISTIC Rail_rZFCInitDwn_CUR "Faktor für anfänglichen Raildrucksollwert des PT1 Filters (abwärts)" CURVE 0x8006BF6C Cur_Xs16Ws16 100.0000 Prc 0.00 100.0000 FORMAT "%8.4" EXTENDED_LIMITS -400.0000 399.9878
 /begin AXIS_DESCR STD_AXIS ZFC_pRailSetPoint_mp Pres_Rail 2 0.00 2000.000 FORMAT "%5.3" EXTENDED_LIMITS -3276.800 3276.700 DEPOSIT ABSOLUTE /end AXIS_DESCR
/end CHARACTERISTIC
/begin CHARACTERISTIC Rail_rZFCInitUp_CUR "Faktor für anfänglichen Raildrucksollwert des PT1 Filters (aufwärts)" CURVE 0x8006BF76 Cur_Xs16Ws16 100.0000 Prc 0.00 100.0000 FORMAT "%8.4" EXTENDED_LIMITS -400.0000 399.9878
 /begin AXIS_DESCR STD_AXIS ZFC_pRailSetPoint_mp Pres_Rail 2 0.00 2000.000 FORMAT "%5.3" EXTENDED_LIMITS -3276.800 3276.700 DEPOSIT ABSOLUTE /end AXIS_DESCR
/end CHARACTERISTIC
/begin CHARACTERISTIC Rail_tiZFCDemDel_C "Verzögerungszeit für Umschaltung auf geschlossenes Druckregelventil bei aktiver Lernphase der ZFC" VALUE 0x8006BF80 Val_Ws16 327670.0 Time_ms 0.00 327670.0 FORMAT "%8.1" EXTENDED_LIMITS -327680.0 327670.0 /end CHARACTERISTIC
/begin CHARACTERISTIC Rail_tiZFCPT1_C "Parameter für ZFC Raildrucksollwert PT1 Filter" VALUE 0x8006BF84 Val_Ws32 4294.9630010 TimeDelay_s 0.0042949672960 4294.9672960 FORMAT "%12.7" EXTENDED_LIMITS 0.000002000000001 4294.9672960 /end CHARACTERISTIC
/begin CHARACTERISTIC Reset_xGrpId_C "" VALUE 0x8006BF88 Val_Wu8 255.0 OneToOne 0.00 255.0 FORMAT "%5.1" /end CHARACTERISTIC
/begin CHARACTERISTIC Reset_xTrgId_C "" VALUE 0x8006BF8A Val_Wu16 65535.00 OneToOne 0.00 65535.00 FORMAT "%8.2" /end CHARACTERISTIC
/begin CHARACTERISTIC RngMod_nLIDvtnMax_C "Maximal zulässige Leerlaufregelabweichung für Verlustmomentenadaption" VALUE 0x8006C240 Val_Ws16 32767.50 EngN -16384.00 16383.50 FORMAT "%8.2" /end CHARACTERISTIC
/begin CHARACTERISTIC RngMod_numTrqFrc_C "Parameter zur Auswahl der Eingangstemperatur" VALUE 0x8006BF8C Val_Wu8 2.00000000000 EngTempFldSel 0.00 2.00000000000 FORMAT "%13.11" /end CHARACTERISTIC
/begin CHARACTERISTIC RngMod_stHydConvMtd_C "Schalter: Hydarulische Wandlerkupplung verbaut ?" VALUE 0x8006C242 Val_Wu8 255.0 OneToOne 0.00 255.0 FORMAT "%5.1" /end CHARACTERISTIC
/begin CHARACTERISTIC RngMod_stNormal_C "Schalter zum Ausblenden der zusätzlichen Verluste" VALUE 0x8006BF90 Val_Wu32 4294967295.00 OneToOne 0.00 4294967295.00 FORMAT "%13.2" /end CHARACTERISTIC
/begin CHARACTERISTIC RngMod_T1FltAdap_C "Zeitkonstante der Verlustmomentenadaptionsfilter" VALUE 0x8006C244 Val_Ws32 4294967.2940 TimeDelay_ms 0.0020000000009 4294967.2960 FORMAT "%12.4" /end CHARACTERISTIC
/begin CHARACTERISTIC RngMod_tAdapMin_C "Minimale zulässige Motortemperatur für Verlustmomentenadaption" VALUE 0x8006C248 Val_Ws16 6553.500 Temp_Cels -3549.940 3003.560 FORMAT "%8.3" /end CHARACTERISTIC
/begin CHARACTERISTIC RngMod_tiRelAdap_C "Entprellzeit für Freigabe der Verlustmomentenadaption" VALUE 0x8006C24A Val_Ws16 327620.0 Time_ms 50.00000 327670.0 FORMAT "%8.1" EXTENDED_LIMITS -327680.0 327670.0 /end CHARACTERISTIC
/begin CHARACTERISTIC RngMod_trqFrc_MAP "Schleppkennfeld, Reibkennfeld" MAP 0x8006BF94 Map_Xs16Ys16Ws16 100.0000 Trq -100.0000 0.00 FORMAT "%8.4" EXTENDED_LIMITS -3276.800 3276.700
 /begin AXIS_DESCR STD_AXIS Epm_nEng EngN 16 0.00 16383.50 FORMAT "%8.2" EXTENDED_LIMITS -16384.00 16383.50 DEPOSIT ABSOLUTE /end AXIS_DESCR
 /begin AXIS_DESCR STD_AXIS RngMod_tTrqFrc_mp Temp_Cels 16 -273.1400 3003.560 FORMAT "%8.3" EXTENDED_LIMITS -3549.940 3003.560 DEPOSIT ABSOLUTE /end AXIS_DESCR
/end CHARACTERISTIC
/begin CHARACTERISTIC RngMod_trqSpd_CUR "drehzahlabhängige Kennlinie zur Bestimmung maximales Moment" CURVE 0x8006C1D8 Cur_Xs16Ws16 3276.700 Trq 0.00 3276.700 FORMAT "%8.3" EXTENDED_LIMITS -3276.800 3276.700
 /begin AXIS_DESCR STD_AXIS Epm_nEng EngN 25 0.00 6000.000 FORMAT "%8.3" EXTENDED_LIMITS -16384.00 16383.50 DEPOSIT ABSOLUTE /end AXIS_DESCR
/end CHARACTERISTIC
/begin CHARACTERISTIC RngMod_vLimTrans_C "Geschwindigkeitsschwelle für Zustandsübergang REFUSE_ADAPT --> NO_ADAPT" VALUE 0x8006C24C Val_Ws16 655.3500 Vel -327.6800 327.6700 FORMAT "%8.4" /end CHARACTERISTIC
/begin CHARACTERISTIC Rtmo_adCalling_u32 "Address of calling element" VALUE 0x8006C250 Val_Wu32 4294967295.00 OneToOne 0.00 4294967295.00 FORMAT "%13.2" /end CHARACTERISTIC
/begin CHARACTERISTIC Rtmo_adData_u32 "Address of measur-element" VALUE 0x8006C254 Val_Wu32 4294967295.00 OneToOne 0.00 4294967295.00 FORMAT "%13.2" /end CHARACTERISTIC
/begin CHARACTERISTIC Rtmo_stSampleTime_u8 "Sampling time" VALUE 0x8006C258 Val_Wu8 255.0 OneToOne 0.00 255.0 FORMAT "%5.1" /end CHARACTERISTIC
/begin CHARACTERISTIC Rtmo_swMode_u8 "Mode" VALUE 0x8006C259 Val_Wu8 255.0 OneToOne 0.00 255.0 FORMAT "%5.1" /end CHARACTERISTIC
/begin CHARACTERISTIC Rtmo_tiIntOverhead_Tick "Overhead of interrupt measure function" VALUE 0x8006C25C Val_Wu32 4294967295.00 OneToOne 0.00 4294967295.00 FORMAT "%13.2" /end CHARACTERISTIC
/begin CHARACTERISTIC Rtmo_tiOverhead_Tick "Overhead of measure function" VALUE 0x8006C260 Val_Wu32 4294967295.00 OneToOne 0.00 4294967295.00 FORMAT "%13.2" /end CHARACTERISTIC
/begin CHARACTERISTIC Sia_swtDisable_C "" VALUE 0x8006C264 Val_Wu8 255.0 OneToOne 0.00 255.0 FORMAT "%5.1" /end CHARACTERISTIC
/begin CHARACTERISTIC Signals_Mode1Pid_CA "" VAL_BLK 0x8007DD80 ValA_Wu8 65.0000000000 Signals_PidVerb 0.00 65.0000000000 FORMAT "%13.10" NUMBER 3 /end CHARACTERISTIC
/begin CHARACTERISTIC Signals_Mode1SigNum_CA "" VAL_BLK 0x8007DD84 ValA_Wu16 161.000000000 Signals_IntSigNumVerb 0.00 161.000000000 FORMAT "%13.9" NUMBER 3 /end CHARACTERISTIC
/begin CHARACTERISTIC Sil_nEngLim_C "" VALUE 0x8006C268 Val_Ws16 32767.50 EngN -16384.00 16383.50 FORMAT "%8.2" /end CHARACTERISTIC
/begin CHARACTERISTIC Sil_rLogicOutNHys_C "" VALUE 0x8006C26A Val_Ws16 100.0000 Prc 0.00 100.0000 FORMAT "%8.4" EXTENDED_LIMITS -400.0000 399.9878 /end CHARACTERISTIC
/begin CHARACTERISTIC Sil_rLogicOutQHys_C "" VALUE 0x8006C26C Val_Ws16 100.0000 Prc 0.00 100.0000 FORMAT "%8.4" EXTENDED_LIMITS -400.0000 399.9878 /end CHARACTERISTIC
/begin CHARACTERISTIC Sil_stFlapRgn_MAP "" MAP 0x8006C26E Map_Xs16Ys16Ws16 1.000000 OneToOne 0.00 1.000000 FORMAT "%8.6" EXTENDED_LIMITS -32768.00 32767.00
 /begin AXIS_DESCR STD_AXIS Epm_nEng EngN 8 0.00 6000.000 FORMAT "%8.3" EXTENDED_LIMITS -16384.00 16383.50 DEPOSIT ABSOLUTE /end AXIS_DESCR
 /begin AXIS_DESCR STD_AXIS InjCtl_qCurr InjMass 8 0.00 327.6700 FORMAT "%8.4" EXTENDED_LIMITS -327.6800 327.6700 DEPOSIT ABSOLUTE /end AXIS_DESCR
/end CHARACTERISTIC
/begin CHARACTERISTIC Sil_stFlap_MAP "" MAP 0x8006C312 Map_Xs16Ys16Ws16 1.000000 OneToOne 0.00 1.000000 FORMAT "%8.6" EXTENDED_LIMITS -32768.00 32767.00
 /begin AXIS_DESCR STD_AXIS Epm_nEng EngN 8 0.00 6000.000 FORMAT "%8.3" EXTENDED_LIMITS -16384.00 16383.50 DEPOSIT ABSOLUTE /end AXIS_DESCR
 /begin AXIS_DESCR STD_AXIS InjCtl_qCurr InjMass 8 0.00 327.6700 FORMAT "%8.4" EXTENDED_LIMITS -327.6800 327.6700 DEPOSIT ABSOLUTE /end AXIS_DESCR
/end CHARACTERISTIC
/begin CHARACTERISTIC Sil_stMskRgn_C "" VALUE 0x8006C3B8 Val_Wu32 4294967295.00 OneToOne 0.00 4294967295.00 FORMAT "%13.2" /end CHARACTERISTIC
/begin CHARACTERISTIC SmkLim_mAirPerCylMin_C "untere Begrenzung der Luftmasse" VALUE 0x8007DD8A Kw_Ws16 6553.500 AirMassPerCyl -3276.800 3276.700 FORMAT "%8.3" /end CHARACTERISTIC
/begin CHARACTERISTIC SmkLim_numSmkLim_C "Index für Temperatur aus dem Motortemperaturfeld" VALUE 0x8007DD8C Kw_Wu8 2.00000000000 EngTempFldSel 0.00 2.00000000000 FORMAT "%13.11" /end CHARACTERISTIC
/begin CHARACTERISTIC SmkLim_rLamFullLd_MAP "Kennfeld zur Ermittlung des Lambda-Werts der motortemperaturabhängigen Vollasterhöhung" MAP 0x8007DD8E Kf_Xs16_Ys16_Ws16 64.00000 lambda -32.00000 32.00000 FORMAT "%8.5" EXTENDED_LIMITS -32.76800 32.76700
 /begin AXIS_DESCR STD_AXIS Epm_nEng EngN 16 0.00 6000.000 FORMAT "%8.3" EXTENDED_LIMITS -16384.00 16383.50 DEPOSIT ABSOLUTE /end AXIS_DESCR
 /begin AXIS_DESCR STD_AXIS SmkLim_tSmkLim_mp Temp_Cels 16 -273.1400 429.9600 FORMAT "%8.4" EXTENDED_LIMITS -3549.940 3003.560 DEPOSIT ABSOLUTE /end AXIS_DESCR
/end CHARACTERISTIC
/begin CHARACTERISTIC SmkLim_rLamMax_C "maximales Lambda für Rauchbegrenzung" VALUE 0x8007DFD2 Kw_Ws16 3.200000 lambda 0.00 3.200000 FORMAT "%8.6" EXTENDED_LIMITS -32.76800 32.76700 /end CHARACTERISTIC
/begin CHARACTERISTIC SmkLim_rLamMin_C "minimales Lambda für Rauchbegrenzung" VALUE 0x8007DFD4 Kw_Ws16 3.200000 lambda 0.00 3.200000 FORMAT "%8.6" EXTENDED_LIMITS -32.76800 32.76700 /end CHARACTERISTIC
/begin CHARACTERISTIC SmkLim_rLamSmk_MAP "Kennfeld zur Ermittlung des Lambda-Werts der Rauchbegrenzung" MAP 0x8007DFD6 Kf_Xs16_Ys16_Ws16 32.00000 lambda 0.00 32.00000 FORMAT "%8.5" EXTENDED_LIMITS -32.76800 32.76700
 /begin AXIS_DESCR STD_AXIS Epm_nEng EngN 16 0.00 6000.000 FORMAT "%8.3" EXTENDED_LIMITS -16384.00 16383.50 DEPOSIT ABSOLUTE /end AXIS_DESCR
 /begin AXIS_DESCR STD_AXIS SmkLim_mAirPerCyl AirMassPerCyl 16 0.00 2500.000 FORMAT "%8.3" EXTENDED_LIMITS -3276.800 3276.700 DEPOSIT ABSOLUTE /end AXIS_DESCR
/end CHARACTERISTIC
/begin CHARACTERISTIC SpdGov_stMskMoLimFunc_C "Schalter (bitkodiert) zur Auswahl der zu begrenzenden Funktionen durch Ebene 2 (Bit1: HLSDem, Bit2: GSHdem, Bit3: WESDem)" VALUE 0x8006C3BC Val_Wu16 15.00000 OneToOne 0.00 15.00000 FORMAT "%8.5" EXTENDED_LIMITS 0.00 65535.00 /end CHARACTERISTIC
/begin CHARACTERISTIC SpdGov_stMskMoLimTrq_C "Schalter (bitkodiert) zur Auswahl der zu begrenzenden Ausgangsdrehmomente (Bit0: SpdGov_trqSet, Bit1: SpdGov_trqLead, Bit2: SpdGov_trqFlt)" VALUE 0x8006C3BE Val_Wu16 15.00000 OneToOne 0.00 15.00000 FORMAT "%8.5" EXTENDED_LIMITS 0.00 65535.00 /end CHARACTERISTIC
/begin CHARACTERISTIC SpdGov_stMskNegCurrTrqEna_C "Freigabe der Drehmomentaufschaltung für negative SpdGov Drehmomente auf den Raildruckpfad" VALUE 0x8006C3C0 Val_Wu16 7.000000 OneToOne 0.00 7.000000 FORMAT "%8.6" EXTENDED_LIMITS 0.00 65535.00 /end CHARACTERISTIC
/begin CHARACTERISTIC SpdGov_stMskNegLdTrqEna_C "Freigabe der Drehmomentaufschaltung für negative SpdGov Drehmomente auf den Luftpfad" VALUE 0x8006C3C2 Val_Wu16 7.000000 OneToOne 0.00 7.000000 FORMAT "%8.6" EXTENDED_LIMITS 0.00 65535.00 /end CHARACTERISTIC
/begin CHARACTERISTIC SSwtS_swtGlbTyp_C "" VALUE 0x8007E21A Val_Wu8 1.000 OneToOne 1.000 2.000 FORMAT "%5.3" EXTENDED_LIMITS 0.00 255.0 /end CHARACTERISTIC
/begin CHARACTERISTIC SSwtS_Val.WaHtEl_swtVal_C "/" VALUE 0x8007E21B Val_Wu8 2.000 OneToOne 0.00 2.000 FORMAT "%5.3" EXTENDED_LIMITS 0.00 255.0 /end CHARACTERISTIC
/begin CHARACTERISTIC StAPmp_facBas_MAP "Skalierungsfaktor = f(vehicle speed, engine speed)" MAP 0x8007E21C Map_Xs16Ys16Ws16 7.999878 Fact -4.000000 3.999878 FORMAT "%8.6"
 /begin AXIS_DESCR STD_AXIS GlbDa_vX Vel 7 -327.6800 327.6700 FORMAT "%8.4" DEPOSIT ABSOLUTE /end AXIS_DESCR
 /begin AXIS_DESCR STD_AXIS Epm_nEng EngN 7 -16384.00 16383.50 FORMAT "%8.2" DEPOSIT ABSOLUTE /end AXIS_DESCR
/end CHARACTERISTIC
/begin CHARACTERISTIC StAPmp_facTxRatio_C "Übersetzungsverhältnis zwischen Lenkhilfepumpe und Kurbelwelle" VALUE 0x8007E29E Val_Ws16 511.9922 Fact1 -256.0000 255.9922 FORMAT "%8.4" /end CHARACTERISTIC
/begin CHARACTERISTIC StAPmp_nMin_C "Mindestdrehzahl" VALUE 0x8007E2A0 Val_Ws16 32767.50 EngN -16384.00 16383.50 FORMAT "%8.2" /end CHARACTERISTIC
/begin CHARACTERISTIC StAPmp_nResvXHi_C "Obere Grenze der Motordrehzahl für Reservemoment" VALUE 0x8007E2A2 Val_Ws16 32767.50 EngN -16384.00 16383.50 FORMAT "%8.2" /end CHARACTERISTIC
/begin CHARACTERISTIC StAPmp_nResvXLo_C "Untere Grenze der Motordrehzahl für Reservemoment" VALUE 0x8007E2A4 Val_Ws16 32767.50 EngN -16384.00 16383.50 FORMAT "%8.2" /end CHARACTERISTIC
/begin CHARACTERISTIC StAPmp_phiDiffWhlMax_C "Schwelle: Lenkwinkel, Leerlaufdrehzahlanhebung." VALUE 0x8007E2A6 Val_Ws16 2047.969 Angle -1024.000 1023.969 FORMAT "%8.3" /end CHARACTERISTIC
/begin CHARACTERISTIC StAPmp_rWhlPhi_C "Schwelle: Normierter Lenkwinkel" VALUE 0x8007E2A8 Val_Ws16 7.999878 Fact -4.000000 3.999878 FORMAT "%8.6" /end CHARACTERISTIC
/begin CHARACTERISTIC StAPmp_stTrqResvEn_CW "Codewort: Aktivierung des motordrehzahlabhängigen Reserve-Moments" VALUE 0x8007E2AA Kw_Wu8 255.0 OneToOne 0.00 255.0 FORMAT "%5.1" /end CHARACTERISTIC
/begin CHARACTERISTIC StAPmp_tiTrqDes_C "Timer: Deaktivierung des Momentenlastsingals" VALUE 0x8007E2AC Val_Ws32 4294967295.00 TimeDT -2147483648.00 2147483647.00 FORMAT "%13.2" /end CHARACTERISTIC
/begin CHARACTERISTIC StAPmp_tiTrqDynPT1_C "Zeit: PT1-Filter, Dynamisches Moment" VALUE 0x8007E2B0 Val_Ws32 4294.9672940 TimeDelay_s 0.000002000000001 4294.9672960 FORMAT "%12.7" /end CHARACTERISTIC
/begin CHARACTERISTIC StAPmp_tiTrqResv_C "Zeit: PT1-Filter, Reserve Moment" VALUE 0x8007E2B4 Val_Ws32 4294967295.00 TimeDT -2147483648.00 2147483647.00 FORMAT "%13.2" /end CHARACTERISTIC
/begin CHARACTERISTIC StAPmp_trqBasDef_C "Ersatzwert: Fehler im Lenkwinkelsignal" VALUE 0x8007E2B8 Val_Ws16 6553.500 Trq -3276.800 3276.700 FORMAT "%8.3" /end CHARACTERISTIC
/begin CHARACTERISTIC StAPmp_trqBas_CUR "Basis Moment = f(phi)" CURVE 0x8007E2BA Cur_Xs16Ws16 6553.500 Trq -3276.800 3276.700 FORMAT "%8.3"
 /begin AXIS_DESCR STD_AXIS StAPmp_phiStrgWhlAbs Angle 10 -1024.000 1023.969 FORMAT "%8.3" DEPOSIT ABSOLUTE /end AXIS_DESCR
/end CHARACTERISTIC
/begin CHARACTERISTIC StAPmp_trqDesHysHi_C "Hysterese: Obere Schwelle, Ist-Moment" VALUE 0x8007E2E4 Val_Ws16 6553.500 Trq -3276.800 3276.700 FORMAT "%8.3" /end CHARACTERISTIC
/begin CHARACTERISTIC StAPmp_trqDesHysLo_C "Hysterese: Untere Schwelle, Ist-Moment" VALUE 0x8007E2E6 Val_Ws16 6553.500 Trq -3276.800 3276.700 FORMAT "%8.3" /end CHARACTERISTIC
/begin CHARACTERISTIC StAPmp_trqDesMaxLim_C "Obere Grenze: Ist-Moment" VALUE 0x8007E2E8 Val_Ws16 6553.500 Trq -3276.800 3276.700 FORMAT "%8.3" /end CHARACTERISTIC
/begin CHARACTERISTIC StAPmp_trqDesMinLim_C "Untere Grenze: Ist-Moment" VALUE 0x8007E2EA Val_Ws16 6553.500 Trq -3276.800 3276.700 FORMAT "%8.3" /end CHARACTERISTIC
/begin CHARACTERISTIC StAPmp_trqDynDef_C "Ersatzwert: Dynamisches Moment" VALUE 0x8007E2EC Val_Ws16 6553.500 Trq -3276.800 3276.700 FORMAT "%8.3" /end CHARACTERISTIC
/begin CHARACTERISTIC StAPmp_trqDyn_MAP "Dynamisches Moment = f(|phi| , dphi)" MAP 0x8007E2EE Map_Xs16Ys16Ws16 6553.500 Trq -3276.800 3276.700 FORMAT "%8.3"
 /begin AXIS_DESCR STD_AXIS StAPmp_phiStrgWhlAbs Angle 10 -1024.000 1023.969 FORMAT "%8.3" DEPOSIT ABSOLUTE /end AXIS_DESCR
 /begin AXIS_DESCR STD_AXIS StDa_dphiStrgWhl AngleDerivative 4 -2048.000 2047.938 FORMAT "%8.3" DEPOSIT ABSOLUTE /end AXIS_DESCR
/end CHARACTERISTIC
/begin CHARACTERISTIC StAPmp_trqPhiMax_C "Maximalwert: Lenkradwinkel" VALUE 0x8007E35E Val_Ws16 6553.500 Trq -3276.800 3276.700 FORMAT "%8.3" /end CHARACTERISTIC
/begin CHARACTERISTIC StAPmp_trqResvDef_C "Alternativwert: Reservemoment" VALUE 0x8007E360 Val_Ws16 6553.500 Trq -3276.800 3276.700 FORMAT "%8.3" /end CHARACTERISTIC
/begin CHARACTERISTIC StAPmp_trqResvHysHi_C "Hysterese: Obere Grenze, Reserve Moment" VALUE 0x8007E362 Val_Ws16 6553.500 Trq -3276.800 3276.700 FORMAT "%8.3" /end CHARACTERISTIC
/begin CHARACTERISTIC StAPmp_trqResvHysLo_C "Hysterese: Untere Grenze, Reserve Moment" VALUE 0x8007E364 Val_Ws16 6553.500 Trq -3276.800 3276.700 FORMAT "%8.3" /end CHARACTERISTIC
/begin CHARACTERISTIC StAPmp_trqResvMaxLim_C "Maximalwert: Reserve Moment" VALUE 0x8007E366 Val_Ws16 6553.500 Trq -3276.800 3276.700 FORMAT "%8.3" /end CHARACTERISTIC
/begin CHARACTERISTIC StAPmp_trqResvMinLim_C "Minimalwert: Reserve Moment" VALUE 0x8007E368 Val_Ws16 6553.500 Trq -3276.800 3276.700 FORMAT "%8.3" /end CHARACTERISTIC
/begin CHARACTERISTIC StAPmp_trqResv_MAP "Kennfeld: Reserve Moment" MAP 0x8007E36A Map_Xs16Ys16Ws16 6553.500 Trq -3276.800 3276.700 FORMAT "%8.3"
 /begin AXIS_DESCR STD_AXIS StDa_ddphiStrgWhl Angle2ndDerivative 5 -4096.000 4095.875 FORMAT "%8.3" DEPOSIT ABSOLUTE /end AXIS_DESCR
 /begin AXIS_DESCR STD_AXIS StAPmp_phiDiffStrgWhl Angle 10 -1024.000 1023.969 FORMAT "%8.3" DEPOSIT ABSOLUTE /end AXIS_DESCR
/end CHARACTERISTIC
/begin CHARACTERISTIC StDa_ddphiInitVal_C "Init-Wert" VALUE 0x8007E3F0 Val_Ws16 8191.875 Angle2ndDerivative -4096.000 4095.875 FORMAT "%8.3" /end CHARACTERISTIC
/begin CHARACTERISTIC StDa_ddphiStrgWhlMax_C "Maximum: 2. Ableitung des Lenkradwinkels" VALUE 0x8007E3F2 Val_Ws16 8191.875 Angle2ndDerivative -4096.000 4095.875 FORMAT "%8.3" /end CHARACTERISTIC
/begin CHARACTERISTIC StDa_ddphiStrgWhlMin_C "Minimum: 2. Ableitung des Lenkradwinkels" VALUE 0x8007E3F4 Val_Ws16 8191.875 Angle2ndDerivative -4096.000 4095.875 FORMAT "%8.3" /end CHARACTERISTIC
/begin CHARACTERISTIC StDa_dphiInitVal_C "Init-Wert" VALUE 0x8007E3F6 Val_Ws16 4095.938 AngleDerivative -2048.000 2047.938 FORMAT "%8.3" /end CHARACTERISTIC
/begin CHARACTERISTIC StDa_dphiStrgWhlMax_C "Maximum: 1. Ableitung des Lenkradwinkels" VALUE 0x8007E3F8 Val_Ws16 4095.938 AngleDerivative -2048.000 2047.938 FORMAT "%8.3" /end CHARACTERISTIC
/begin CHARACTERISTIC StDa_dphiStrgWhlMin_C "Minimum: 1. Ableitung des Lenkradwinkels" VALUE 0x8007E3FA Val_Ws16 4095.938 AngleDerivative -2048.000 2047.938 FORMAT "%8.3" /end CHARACTERISTIC
/begin CHARACTERISTIC StDa_phiInitVal_C "Init-Wert" VALUE 0x8007E3FC Val_Ws16 2047.969 Angle -1024.000 1023.969 FORMAT "%8.3" /end CHARACTERISTIC
/begin CHARACTERISTIC StDa_phiStrgWhlMax_C "Maximum: Lenkwinkel" VALUE 0x8007E3FE Val_Ws16 2047.969 Angle -1024.000 1023.969 FORMAT "%8.3" /end CHARACTERISTIC
/begin CHARACTERISTIC StDa_stAddFilter_CW "Codewort: Filter an / aus" VALUE 0x8007E400 Val_Wu8 255.0 OneToOne 0.00 255.0 FORMAT "%5.1" /end CHARACTERISTIC
/begin CHARACTERISTIC StDa_stDphiDE_CW "Codewort: dPhi über CAN oder DE" VALUE 0x8007E401 Val_Wu8 255.0 OneToOne 0.00 255.0 FORMAT "%5.1" /end CHARACTERISTIC
/begin CHARACTERISTIC StDa_tiddPhiPT1_C "Zeit: Für Tiefpass-Filter" VALUE 0x8007E404 Val_Ws32 4294.9672940 TimeDelay_s 0.000002000000001 4294.9672960 FORMAT "%12.7" /end CHARACTERISTIC
/begin CHARACTERISTIC StDa_tidPhiPT1_C "Zeit: Für Tiefpass-Filter" VALUE 0x8007E408 Val_Ws32 4294.9672940 TimeDelay_s 0.000002000000001 4294.9672960 FORMAT "%12.7" /end CHARACTERISTIC
/begin CHARACTERISTIC StDa_tiHoldTimeSec_C "Zeit: Halteglied" VALUE 0x8007E40C Val_Ws32 4294967295.00 TimeDT -2147483648.00 2147483647.00 FORMAT "%13.2" /end CHARACTERISTIC
/begin CHARACTERISTIC StDa_tiPhiPT1_C "Zeit: Für Tiefpass-Filter" VALUE 0x8007E410 Val_Ws32 4294.9672940 TimeDelay_s 0.000002000000001 4294.9672960 FORMAT "%12.7" /end CHARACTERISTIC
/begin CHARACTERISTIC StDa_vXLimit_C "Schwelle: Fahrgeschwindigkeit" VALUE 0x8007E414 Val_Ws16 655.3500 Vel -327.6800 327.6700 FORMAT "%8.4" /end CHARACTERISTIC
/begin CHARACTERISTIC Strt_DigOut.tiBtwTstSCB_C "/" VALUE 0x8006C634 Kw_Ws16 1000.000 Time_ms 0.00 1000.000 FORMAT "%8.3" EXTENDED_LIMITS -327680.0 327670.0 /end CHARACTERISTIC
/begin CHARACTERISTIC Strt_DigOut.tiBtwTstOT_C "/" VALUE 0x8006C636 Kw_Ws16 1000.000 Time_s 0.00 1000.000 FORMAT "%8.3" EXTENDED_LIMITS -327.6800 327.6700 /end CHARACTERISTIC
/begin CHARACTERISTIC Strt_DigOut.numTstMax_C "/" VALUE 0x8006C638 Kw_Wu16 65535.00 OneToOne 0.00 65535.00 FORMAT "%8.2" /end CHARACTERISTIC
/begin CHARACTERISTIC Strt_stPsDiaDisbl_C "" VALUE 0x8006C63A Val_Wu8 255.0 OneToOne 0.00 255.0 FORMAT "%5.1" /end CHARACTERISTIC
/begin CHARACTERISTIC Strt_stPsDisbl_C "" VALUE 0x8006C63B Val_Wu8 255.0 OneToOne 0.00 255.0 FORMAT "%5.1" /end CHARACTERISTIC
/begin CHARACTERISTIC StSys_CldEng.dtrqInc_C "Parametersatz für kalten Motor/" VALUE 0x8006C604 Val_Wu32 6553599.99847 RmpTrq 0.00 6553599.99847 FORMAT "%13.5" /end CHARACTERISTIC
/begin CHARACTERISTIC StSys_CldEng.tiRmpLck_C "Parametersatz für kalten Motor/" VALUE 0x8006C608 Val_Ws16 655350.0 Time_ms -327680.0 327670.0 FORMAT "%8.1" /end CHARACTERISTIC
/begin CHARACTERISTIC StSys_CldEng.trqLim_C "Parametersatz für kalten Motor/" VALUE 0x8006C60A Val_Ws16 3276.700 Trq 0.00 3276.700 FORMAT "%8.3" EXTENDED_LIMITS -3276.800 3276.700 /end CHARACTERISTIC
/begin CHARACTERISTIC StSys_facAPSCor_CUR "atmospheric pressure correction factor" CURVE 0x8006C3C4 Kl_Xs16_Ws16 4.000000 Fact 0.00 4.000000 FORMAT "%8.6" EXTENDED_LIMITS -4.000000 3.999878
 /begin AXIS_DESCR STD_AXIS EnvP_p Pres_hPa 8 0.00 3500.000 FORMAT "%8.3" EXTENDED_LIMITS -32768.00 32767.00 DEPOSIT ABSOLUTE /end AXIS_DESCR
/end CHARACTERISTIC
/begin CHARACTERISTIC StSys_HotEng.dtrqInc_C "Parametersatz für heißen Motor/" VALUE 0x8006C60C Val_Wu32 6553599.99847 RmpTrq 0.00 6553599.99847 FORMAT "%13.5" /end CHARACTERISTIC
/begin CHARACTERISTIC StSys_HotEng.tiRmpLck_C "Parametersatz für heißen Motor/" VALUE 0x8006C610 Val_Ws16 655350.0 Time_ms -327680.0 327670.0 FORMAT "%8.1" /end CHARACTERISTIC
/begin CHARACTERISTIC StSys_HotEng.trqLim_C "Parametersatz für heißen Motor/" VALUE 0x8006C612 Val_Ws16 3276.700 Trq 0.00 3276.700 FORMAT "%8.3" EXTENDED_LIMITS -3276.800 3276.700 /end CHARACTERISTIC
/begin CHARACTERISTIC StSys_n2MsWhlLoLim_C "untere kritische Drehzahlgrenze (ZMS-Resonanz)" VALUE 0x8006C628 Val_Ws16 1000.000 EngN 0.00 1000.000 FORMAT "%8.3" EXTENDED_LIMITS -16384.00 16383.50 /end CHARACTERISTIC
/begin CHARACTERISTIC StSys_n2MsWhlUpOfs_C "Offset for starting trq shutoff" VALUE 0x8006C62A Val_Ws16 1000.000 EngN 0.00 1000.000 FORMAT "%8.3" EXTENDED_LIMITS -16384.00 16383.50 /end CHARACTERISTIC
/begin CHARACTERISTIC StSys_nAdjMax_C "Abgleichende-Drehzahl" VALUE 0x8006C534 Val_Ws16 32767.50 EngN -16384.00 16383.50 FORMAT "%8.2" /end CHARACTERISTIC
/begin CHARACTERISTIC StSys_nFreezeTrqRmp_C "Rampenbegrenzungsdrehzahl" VALUE 0x8006C614 Val_Ws16 32767.50 EngN -16384.00 16383.50 FORMAT "%8.2" /end CHARACTERISTIC
/begin CHARACTERISTIC StSys_nReleaseTrqRmp_C "Rampenfreigabedrehzahl" VALUE 0x8006C616 Val_Ws16 32767.50 EngN -16384.00 16383.50 FORMAT "%8.2" /end CHARACTERISTIC
/begin CHARACTERISTIC StSys_nStrtCutOut_MAP "Startabwurf-Drehzahl" MAP 0x8006C48C Map_Xs16Ys16Ws16 6000.000 EngN 0.00 6000.000 FORMAT "%8.3" EXTENDED_LIMITS -16384.00 16383.50
 /begin AXIS_DESCR STD_AXIS StSys_tStrt_mp Temp_Cels 8 -50.04000 149.9600 FORMAT "%8.4" EXTENDED_LIMITS -3549.940 3003.560 DEPOSIT ABSOLUTE /end AXIS_DESCR
 /begin AXIS_DESCR STD_AXIS EnvP_p Pres_hPa 8 700.0000 3500.000 FORMAT "%8.3" EXTENDED_LIMITS -32768.00 32767.00 DEPOSIT ABSOLUTE /end AXIS_DESCR
/end CHARACTERISTIC
/begin CHARACTERISTIC StSys_nStrtTipMax_MAP "" MAP 0x8007E418 Kf_Xs16_Ys16_Ws16 6000.000 EngN 0.00 6000.000 FORMAT "%8.3" EXTENDED_LIMITS -16384.00 16383.50
 /begin AXIS_DESCR STD_AXIS EngDa_tEng Temp_Cels 8 222.9600 422.9600 FORMAT "%8.4" EXTENDED_LIMITS -3549.940 3003.560 DEPOSIT ABSOLUTE /end AXIS_DESCR
 /begin AXIS_DESCR STD_AXIS EnvP_p Pres_hPa 8 0.00 3500.000 FORMAT "%8.3" EXTENDED_LIMITS -32768.00 32767.00 DEPOSIT ABSOLUTE /end AXIS_DESCR
/end CHARACTERISTIC
/begin CHARACTERISTIC StSys_nStrtTipProt_C "" VALUE 0x8007E4BC Kw_Ws16 6000.000 EngN 0.00 6000.000 FORMAT "%8.3" EXTENDED_LIMITS -16384.00 16383.50 /end CHARACTERISTIC
/begin CHARACTERISTIC StSys_numStrtAddCor_C "Selection of used engine temperature (e.g. CTSCD_tClnt, etc.)" VALUE 0x8006C3E6 Kw_Wu8 2.00000000000 EngTempFldSel 0.00 2.00000000000 FORMAT "%13.11" /end CHARACTERISTIC
/begin CHARACTERISTIC StSys_numStrtBas_C "Auswahlparameter für das Motortemperatur-Feld Eng_tFld" VALUE 0x8006C536 Val_Wu8 2.00000000000 EngTempFldSel 0.00 2.00000000000 FORMAT "%13.11" /end CHARACTERISTIC
/begin CHARACTERISTIC StSys_numStrtRmp_C "Parameter um die gewünschte Motortemperatur aus dem Motortemperatur-Feld Eng_tFld zu selektieren" VALUE 0x8006C618 Val_Wu8 2.00000000000 EngTempFldSel 0.00 2.00000000000 FORMAT "%13.11" /end CHARACTERISTIC
/begin CHARACTERISTIC StSys_numStrt_C "Parameter um die Motortemperatur für den Startabwurf aus dem Motortemperatur-Feld Eng_tFld zu selektieren" VALUE 0x8006C530 Val_Wu8 2.00000000000 EngTempFldSel 0.00 2.00000000000 FORMAT "%13.11" /end CHARACTERISTIC
/begin CHARACTERISTIC StSys_swtGlwLamp_C "" VALUE 0x8007E4BE Kw_Wu8 1.000 OneToOne 0.00 1.000 FORMAT "%5.3" EXTENDED_LIMITS 0.00 255.0 /end CHARACTERISTIC
/begin CHARACTERISTIC StSys_swtShOffGearbxRec_C "" VALUE 0x8007E4BF Kw_Wu8 1.000 OneToOne 0.00 1.000 FORMAT "%5.3" EXTENDED_LIMITS 0.00 255.0 /end CHARACTERISTIC
/begin CHARACTERISTIC StSys_swtShutOff_C "Label zum Aktivieren des Tipstart-Pfades (1: aktiviert, 0: deaktiviert)" VALUE 0x8006C62C Val_Wu8 1.000 OneToOne 0.00 1.000 FORMAT "%5.3" EXTENDED_LIMITS 0.00 255.0 /end CHARACTERISTIC
/begin CHARACTERISTIC StSys_swtStrtTipActv_C "" VALUE 0x8007E4C0 Kw_Wu8 255.0 OneToOne 0.00 255.0 FORMAT "%5.1" /end CHARACTERISTIC
/begin CHARACTERISTIC StSys_tClntHi_C "Temperaturschwelle Motor warm -> heiß" VALUE 0x8006C61A Val_Ws16 3053.700 Temp_Cels -50.14000 3003.560 FORMAT "%8.3" EXTENDED_LIMITS -3549.940 3003.560 /end CHARACTERISTIC
/begin CHARACTERISTIC StSys_tClntLo_C "Temperaturschwelle Motor kalt -> warm" VALUE 0x8006C61C Val_Ws16 3053.700 Temp_Cels -50.14000 3003.560 FORMAT "%8.3" EXTENDED_LIMITS -3549.940 3003.560 /end CHARACTERISTIC
/begin CHARACTERISTIC StSys_ti2MsWhlPrt_C "Verzögerungszeit Startmomentenabschaltung" VALUE 0x8006C62E Val_Wu16 655350.0 Time_ms 0.00 655350.0 FORMAT "%8.1" /end CHARACTERISTIC
/begin CHARACTERISTIC StSys_tiEngTempValid_C "Verzögerungszeit bis Motortemperatur gueltig" VALUE 0x8006C61E Val_Ws16 327670.0 Time_ms 0.00 327670.0 FORMAT "%8.1" EXTENDED_LIMITS -327680.0 327670.0 /end CHARACTERISTIC
/begin CHARACTERISTIC StSys_tinFltPT1_C "time constant for the engine speed low pass filter" VALUE 0x8006C630 Val_Ws32 4294.9672940 TimeDelay_s 0.000002000000001 4294.9672960 FORMAT "%12.7" /end CHARACTERISTIC
/begin CHARACTERISTIC StSys_tiStrtCutOut_C "Startabwurf-Sperrzeit" VALUE 0x8006C532 Val_Ws16 327670.0 Time_ms 0.00 327670.0 FORMAT "%8.1" EXTENDED_LIMITS -327680.0 327670.0 /end CHARACTERISTIC
/begin CHARACTERISTIC StSys_tiStrtLck_C "" VALUE 0x8007E4C2 Kw_Wu16 655350.0 Time_ms 0.00 655350.0 FORMAT "%8.1" /end CHARACTERISTIC
/begin CHARACTERISTIC StSys_tiStrtMax_C "" VALUE 0x8007E4C4 Kw_Wu16 655350.0 Time_ms 0.00 655350.0 FORMAT "%8.1" /end CHARACTERISTIC
/begin CHARACTERISTIC StSys_tiStrtTipMin_C "" VALUE 0x8007E4C6 Kw_Wu16 655350.0 Time_ms 0.00 655350.0 FORMAT "%8.1" /end CHARACTERISTIC
/begin CHARACTERISTIC StSys_tiStrtTipNoMonitor_C "" VALUE 0x8007E4C8 Kw_Wu16 655350.0 Time_ms 0.00 655350.0 FORMAT "%8.1" /end CHARACTERISTIC
/begin CHARACTERISTIC StSys_tiStrtTipProt_C "" VALUE 0x8007E4CA Kw_Wu16 655350.0 Time_ms 0.00 655350.0 FORMAT "%8.1" /end CHARACTERISTIC
/begin CHARACTERISTIC StSys_trqAdjMax_C "maximales Moment fuer den Startabgleich" VALUE 0x8006C538 Val_Ws16 6553.500 Trq -3276.800 3276.700 FORMAT "%8.3" /end CHARACTERISTIC
/begin CHARACTERISTIC StSys_trqAdjVal_C "Abgleichwert fuer das Startmoment" VALUE 0x8006C53A Val_Ws16 6553.500 Trq -3276.800 3276.700 FORMAT "%8.3" /end CHARACTERISTIC
/begin CHARACTERISTIC StSys_trqStrtAPSCor_MAP "Base map for correction for starting torque" MAP 0x8006C3E8 Kf_Xs16_Ys16_Ws16 240.0000 Trq -40.10000 199.9000 FORMAT "%8.4" EXTENDED_LIMITS -3276.800 3276.700
 /begin AXIS_DESCR STD_AXIS Epm_nEng EngN 8 0.00 6000.000 FORMAT "%8.3" EXTENDED_LIMITS -16384.00 16383.50 DEPOSIT ABSOLUTE /end AXIS_DESCR
 /begin AXIS_DESCR STD_AXIS StSys_tStrtCor_mp Temp_Cels 8 -3549.940 3003.560 FORMAT "%8.3" DEPOSIT ABSOLUTE /end AXIS_DESCR
/end CHARACTERISTIC
/begin CHARACTERISTIC StSys_trqStrtBas_MAP "Basismoment fuer den Start" MAP 0x8006C53C Map_Xs16Ys16Ws16 3276.700 Trq 0.00 3276.700 FORMAT "%8.3" EXTENDED_LIMITS -3276.800 3276.700
 /begin AXIS_DESCR STD_AXIS Epm_nEng EngN 8 0.00 6000.000 FORMAT "%8.3" EXTENDED_LIMITS -16384.00 16383.50 DEPOSIT ABSOLUTE /end AXIS_DESCR
 /begin AXIS_DESCR STD_AXIS StSys_tStrtBas_mp Temp_Cels 10 -50.14000 149.8600 FORMAT "%8.4" EXTENDED_LIMITS -3549.940 3003.560 DEPOSIT ABSOLUTE /end AXIS_DESCR
/end CHARACTERISTIC
/begin CHARACTERISTIC StSys_WrmEng.dtrqInc_C "Parametersatz für warmen Motor/" VALUE 0x8006C620 Val_Wu32 6553599.99847 RmpTrq 0.00 6553599.99847 FORMAT "%13.5" /end CHARACTERISTIC
/begin CHARACTERISTIC StSys_WrmEng.tiRmpLck_C "Parametersatz für warmen Motor/" VALUE 0x8006C624 Val_Ws16 655350.0 Time_ms -327680.0 327670.0 FORMAT "%8.1" /end CHARACTERISTIC
/begin CHARACTERISTIC StSys_WrmEng.trqLim_C "Parametersatz für warmen Motor/" VALUE 0x8006C626 Val_Ws16 3276.700 Trq 0.00 3276.700 FORMAT "%8.3" EXTENDED_LIMITS -3276.800 3276.700 /end CHARACTERISTIC
/begin CHARACTERISTIC SyC_stTest_C "Steuerung des Testmodus der Systemsteuerung" VALUE 0x8006C63C Val_Wu8 255.0 OneToOne 0.00 255.0 FORMAT "%5.1" /end CHARACTERISTIC
/begin CHARACTERISTIC SyC_swtPreDrv_C "Schalter/Codewort für PreDrive-Steuerung" VALUE 0x8006C642 Val_Wu8 255.0 OneToOne 0.00 255.0 FORMAT "%5.1" /end CHARACTERISTIC
/begin CHARACTERISTIC SyC_swtTestEna_C "Schalter/Codewort zum Aktivieren eines Testmodus der Systemsteuerung" VALUE 0x8006C63D Val_Wu8 255.0 OneToOne 0.00 255.0 FORMAT "%5.1" /end CHARACTERISTIC
/begin CHARACTERISTIC SyC_tiPostDrvMax_C "Maximale Zeit im Zustand PostDrive" VALUE 0x8006C63E Val_Wu16 2697.000 SyC_Time_100ms 3.000000 2700.000 FORMAT "%8.3" EXTENDED_LIMITS 0.00 6553.500 /end CHARACTERISTIC
/begin CHARACTERISTIC SyC_tiPostDrvMin_C "Minimale Zeit im Zustand PostDrive" VALUE 0x8006C640 Val_Wu16 59.80000 SyC_Time_100ms 0.2000000 60.00000 FORMAT "%8.5" EXTENDED_LIMITS 0.00 6553.500 /end CHARACTERISTIC
/begin CHARACTERISTIC SyC_tiPreDrvMax_C "Maximale Zeit, um die PreDrive verlängert werden kann" VALUE 0x8006C644 Val_Wu16 65534.00 SyC_Time_1s 1.000000 65535.00 FORMAT "%8.2" EXTENDED_LIMITS 0.00 65535.00 /end CHARACTERISTIC
/begin CHARACTERISTIC SyC_tiStopCntMax_C "Maximal erfassbare Steuergeräteauszeit" VALUE 0x8006C646 Val_Wu16 544.0000 SyC_Time_2min 2.000000 546.0000 FORMAT "%8.4" EXTENDED_LIMITS 0.00 131070.0 /end CHARACTERISTIC
/begin CHARACTERISTIC T15_Deb.tiHiLo_C "/" VALUE 0x8006C648 Kw_Ws16 655350.0 TimeDeb -327680.0 327670.0 FORMAT "%8.1" /end CHARACTERISTIC
/begin CHARACTERISTIC T15_Deb.tiLoHi_C "/" VALUE 0x8006C64A Kw_Ws16 655350.0 TimeDeb -327680.0 327670.0 FORMAT "%8.1" /end CHARACTERISTIC
/begin CHARACTERISTIC T15_tiDebWakeUp_C "Maximale Zeitverzögerung zwischen pos.Flankedesentprellen WakeUp Signals und Klemme15 über CAN" VALUE 0x8006C64C Val_Wu16 655.3500 Time_s 0.00 655.3500 FORMAT "%8.4" /end CHARACTERISTIC
/begin CHARACTERISTIC T50_Deb.tiHiLo_C "T50 Entprellzeit/" VALUE 0x8007E4CC Val_Ws16 655350.0 TimeDeb -327680.0 327670.0 FORMAT "%8.1" /end CHARACTERISTIC
/begin CHARACTERISTIC T50_Deb.tiLoHi_C "T50 Entprellzeit/" VALUE 0x8007E4CE Val_Ws16 655350.0 TimeDeb -327680.0 327670.0 FORMAT "%8.1" /end CHARACTERISTIC
/begin CHARACTERISTIC T50_stDflVal_C "Vorgabewert Zustand T50" VALUE 0x8007E4D0 Val_Wu8 255.0 OneToOne 0.00 255.0 FORMAT "%5.1" /end CHARACTERISTIC
/begin CHARACTERISTIC T50_swtSig_C "Signalschalter T50 (1=CAN 0=HW)" VALUE 0x8007E4D1 Val_Wu8 255.0 OneToOne 0.00 255.0 FORMAT "%5.1" /end CHARACTERISTIC
/begin CHARACTERISTIC TAA_ctIncTstOfs_C "Offset für Index von TAA_tiIncTst_CA (nur für Testzwecke)" VALUE 0x8006C6A8 Val_Wu8 2.000 OneToOne 0.00 2.000 FORMAT "%5.3" EXTENDED_LIMITS 0.00 255.0 /end CHARACTERISTIC
/begin CHARACTERISTIC TAA_facDynMax_C "maximal zulässige Drehzahldynamik für Inkrementwinkel-Lernverfahren" VALUE 0x8006C650 Val_Ws16 1.000000 Fact 0.00 1.000000 FORMAT "%8.6" EXTENDED_LIMITS -4.000000 3.999878 /end CHARACTERISTIC
/begin CHARACTERISTIC TAA_facSinTab_CA "Filterkoeffizienten für Inkrementwinkel-Lernverfahren" VAL_BLK 0x8006C652 ValA_Ws16 2.000000 FacTrigoFunc -1.000000 1.000000 FORMAT "%8.6" EXTENDED_LIMITS -8.000000 7.999756 NUMBER 30 /end CHARACTERISTIC
/begin CHARACTERISTIC TAA_nAdapMid_CA "Mittendrehzahlen der Lernbereiche für Inkrementwinkel-Lernverfahren" VAL_BLK 0x8006C68E ValA_Ws16 6000.000 EngN 0.00 6000.000 FORMAT "%8.3" EXTENDED_LIMITS -16384.00 16383.50 NUMBER 3 /end CHARACTERISTIC
/begin CHARACTERISTIC TAA_nAdapRng_CA "Breite der Lernbereiche für Inkrementwinkel-Lernverfahren" VAL_BLK 0x8006C694 ValA_Ws16 6000.000 EngN 0.00 6000.000 FORMAT "%8.3" EXTENDED_LIMITS -16384.00 16383.50 NUMBER 3 /end CHARACTERISTIC
/begin CHARACTERISTIC TAA_nMax_C "maximale Drehzahl für Inkrementwinkel-Lernverfahren" VALUE 0x8006C6AA Val_Wu16 6000.000 EngN 0.00 6000.000 FORMAT "%8.3" EXTENDED_LIMITS 0.00 32767.50 /end CHARACTERISTIC
/begin CHARACTERISTIC TAA_nMin_C "minimale Drehzahl für Inkrementwinkel-Lernverfahren" VALUE 0x8006C6AC Val_Wu16 6000.000 EngN 0.00 6000.000 FORMAT "%8.3" EXTENDED_LIMITS 0.00 32767.50 /end CHARACTERISTIC
/begin CHARACTERISTIC TAA_numActv_CA "Anzahl auszuwertender Inkremente je Rechenraster im Inkrementwinkel-Lernverfahren" VAL_BLK 0x8006C6AE ValA_Wu8 125.0 OneToOne 0.00 125.0 FORMAT "%5.1" EXTENDED_LIMITS 0.00 255.0 NUMBER 8 /end CHARACTERISTIC
/begin CHARACTERISTIC TAA_numGapIpoInc_C "Anzahl Inkremente für Lückeninterpolation in Inkrementwinkel-Lernverfahren" VALUE 0x8006C69A Val_Wu8 9.000 OneToOne 1.000 10.00 FORMAT "%5.2" EXTENDED_LIMITS 0.00 255.0 /end CHARACTERISTIC
/begin CHARACTERISTIC TAA_numIncGap_CA "Lückenkonfiguration des Geberrads für Inkrementwinkel-Lernverfahren" VAL_BLK 0x8006C6B6 ValA_Wu8 10.00 OneToOne 0.00 10.00 FORMAT "%5.2" EXTENDED_LIMITS 0.00 255.0 NUMBER 2 /end CHARACTERISTIC
/begin CHARACTERISTIC TAA_numRevCor_C "Anzahl Kurbelwellenumdrehungen für Aktualisierung Korrekturwerte im Inkrementwinkel-Lernverfahren" VALUE 0x8006C6B8 Val_Wu8 19.00 OneToOne 1.000 20.00 FORMAT "%5.2" EXTENDED_LIMITS 0.00 255.0 /end CHARACTERISTIC
/begin CHARACTERISTIC TAA_numSinTab_C "Anzahl der Filterkoeffizienten in TAA_facSinTab_CA für Inkrementwinkel-Lernverfahren" VALUE 0x8006C69B Val_Wu8 30.00 OneToOne 0.00 30.00 FORMAT "%5.2" EXTENDED_LIMITS 0.00 255.0 /end CHARACTERISTIC
/begin CHARACTERISTIC TAA_phiDiffMax_CA "Schwellwerte für Einschwingzustand der Drehzahlbereiche im Inkrementwinkel-Lernverfahren" VAL_BLK 0x8006C69C ValA_Ws16 0.2499466 AgCrSHiReso 0.00 0.2499466 FORMAT "%9.7" EXTENDED_LIMITS -5.625172 5.625000 NUMBER 3 /end CHARACTERISTIC
/begin CHARACTERISTIC TAA_rTrqMax_C "maximale Übersetzung des Antriebsstrangs für Aktivierung des Inkrementwinkel-Lernverfahrens" VALUE 0x8006C6BA Val_Wu16 100.0000 TransR 0.00 100.0000 FORMAT "%8.4" EXTENDED_LIMITS 0.00 655.3500 /end CHARACTERISTIC
/begin CHARACTERISTIC TAA_stAdapMode_C "Berechnungsmodus für Korrektur der Inkrementwinkel" VALUE 0x8006C6BC Val_Wu8 4.000 OneToOne 0.00 4.000 FORMAT "%5.3" EXTENDED_LIMITS 0.00 255.0 /end CHARACTERISTIC
/begin CHARACTERISTIC TAA_stEvalFin_C "letzter auszuführender Teilalgorithmus im Inkrementwinkel-Lernverfahren" VALUE 0x8006C6BE Val_Wu16 128.0000 OneToOne 0.00 128.0000 FORMAT "%8.4" EXTENDED_LIMITS 0.00 65535.00 /end CHARACTERISTIC
/begin CHARACTERISTIC TAA_stExtp_C "Freigabe für Extrapolation der Inkrementwinkel-Korrekturwerte" VALUE 0x8006C6C0 Val_Wu8 1.000 OneToOne 0.00 1.000 FORMAT "%5.3" EXTENDED_LIMITS 0.00 255.0 /end CHARACTERISTIC
/begin CHARACTERISTIC TAA_stMainSpdRng_C "Hauptdrehzahlbereich für Inkrementwinkel-Lernverfahren" VALUE 0x8006C6A2 Val_Wu8 255.0 OneToOne 0.00 255.0 FORMAT "%5.1" /end CHARACTERISTIC
/begin CHARACTERISTIC TAA_stReqRstVal_C "Löschanforderung für Adaptionswerte Inkrementwinkel-Lernen" VALUE 0x8006C6A3 Val_Wu8 1.000 OneToOne 0.00 1.000 FORMAT "%5.3" EXTENDED_LIMITS 0.00 255.0 /end CHARACTERISTIC
/begin CHARACTERISTIC TAA_stTstMode_C "Freigabe Testmodus Inkrementwinkel-Lernverfahren" VALUE 0x8006C6C1 Val_Wu8 31.00 OneToOne 0.00 31.00 FORMAT "%5.2" EXTENDED_LIMITS 0.00 255.0 /end CHARACTERISTIC
/begin CHARACTERISTIC TAA_tiEnaDel_C "Wartezeit nach Schubübergang für Aktivierung Inkrementwinkel-Lernverfahren" VALUE 0x8006C6C2 Val_Wu16 100.0000 Time_s 0.00 100.0000 FORMAT "%8.4" EXTENDED_LIMITS 0.00 655.3500 /end CHARACTERISTIC
/begin CHARACTERISTIC TAA_tiIncDvtFlt_C "Filterzeitkonstante für Inkrementwinkel-Abweichungen" VALUE 0x8006C6A4 Val_Ws32 99.782961134 TimeDelay_s 0.099999238556 99.882960372 FORMAT "%12.8" EXTENDED_LIMITS 0.000002000000001 4294.9672960 /end CHARACTERISTIC
/begin CHARACTERISTIC TAA_tiIncTst_CA "Inkrement-Periodendauern zum Test des Inkrementwinkel-Lernverfahrens" VAL_BLK 0x8006C6C4 ValA_Ws16 1380.000 TIncPerDur_us 120.0000 1500.000 FORMAT "%8.3" EXTENDED_LIMITS -3276.800 3276.700 NUMBER 360 /end CHARACTERISTIC
/begin CHARACTERISTIC TAA_vMin_C "minimale Fahrzeuggeschwindigkeit für Aktivierung Inkrementwinkel-Lernverfahren" VALUE 0x8006C994 Val_Wu16 300.0000 Vel 0.00 300.0000 FORMAT "%8.4" EXTENDED_LIMITS 0.00 655.3500 /end CHARACTERISTIC
/begin CHARACTERISTIC TCPrt_DKdChrgPmpCtlQDT1_C "" VALUE 0x8006CD60 Val_Ws32 6999.99999255 Kd_InjMass2Prc -3499.99999627 3499.99999627 FORMAT "%13.8" EXTENDED_LIMITS -40000.0000000 39999.9999814 /end CHARACTERISTIC
/begin CHARACTERISTIC TCPrt_DkdChrgPmpDetMDT12_C "Applikationslabel für kd" VALUE 0x8006CD0C Val_Ws32 1000.00000000 Kd_dm2FactM 0.00 1000.00000000 FORMAT "%13.8" EXTENDED_LIMITS -20480.0000000 20479.9999905 /end CHARACTERISTIC
/begin CHARACTERISTIC TCPrt_DkdChrgPmpDetMDT1_C "Applikationslabel für kd" VALUE 0x8006CD10 Val_Ws32 1000.00000000 Kd_dm2FactM 0.00 1000.00000000 FORMAT "%13.8" EXTENDED_LIMITS -20480.0000000 20479.9999905 /end CHARACTERISTIC
/begin CHARACTERISTIC TCPrt_dnChrgPmpCtlHigh_CUR "Höhere Begrenzung, damit Hysteresis Änderungsgeschwindigkeit von Epm_nEng für Anti-Schwankung LIGov überwacht" CURVE 0x8006C998 Cur_Xs16Ws16 3000.000 EngNGrd 0.00 3000.000 FORMAT "%8.3" EXTENDED_LIMITS -16384.00 16383.50
 /begin AXIS_DESCR STD_AXIS Epm_nEng EngN 5 0.00 6000.000 FORMAT "%8.3" EXTENDED_LIMITS -16384.00 16383.50 DEPOSIT ABSOLUTE /end AXIS_DESCR
/end CHARACTERISTIC
/begin CHARACTERISTIC TCPrt_dnChrgPmpCtlLow_CUR "Unterere Grenze, damit Hysteresis Änderungsgeschwindigkeit von Epm_nEng für Anti-Schwankung LIGov überwacht" CURVE 0x8006C9AE Cur_Xs16Ws16 3000.000 EngNGrd 0.00 3000.000 FORMAT "%8.3" EXTENDED_LIMITS -16384.00 16383.50
 /begin AXIS_DESCR STD_AXIS Epm_nEng EngN 5 0.00 6000.000 FORMAT "%8.3" EXTENDED_LIMITS -16384.00 16383.50 DEPOSIT ABSOLUTE /end AXIS_DESCR
/end CHARACTERISTIC
/begin CHARACTERISTIC TCPrt_dnChrgPmpCtlRls_C "" VALUE 0x8006CD64 Val_Ws16 3000.000 EngNGrd 0.00 3000.000 FORMAT "%8.3" EXTENDED_LIMITS -16384.00 16383.50 /end CHARACTERISTIC
/begin CHARACTERISTIC TCPrt_dpChrgPmpCtlRmpDwn_C "" VALUE 0x8006CD68 Val_Ws32 65000000.0000 RmpPres_hPa 0.00 65000000.0000 FORMAT "%13.4" EXTENDED_LIMITS -32768000.0000 32767999.9847 /end CHARACTERISTIC
/begin CHARACTERISTIC TCPrt_dpChrgPmpCtlRmpUp_C "" VALUE 0x8006CD6C Val_Ws32 65000000.0000 RmpPres_hPa 0.00 65000000.0000 FORMAT "%13.4" EXTENDED_LIMITS -32768000.0000 32767999.9847 /end CHARACTERISTIC
/begin CHARACTERISTIC TCPrt_dqChrgPmpCtlRls_C "" VALUE 0x8006CD70 Val_Ws16 200.0000 InjMassPerSec_20ms 0.00 200.0000 FORMAT "%8.4" EXTENDED_LIMITS -16384.00 16383.50 /end CHARACTERISTIC
/begin CHARACTERISTIC TCPrt_drChrgPmpCtlRmpDwn_C "" VALUE 0x8006CD74 Val_Ws32 750000.000000 RmpPrc 0.00 750000.000000 FORMAT "%13.6" EXTENDED_LIMITS -400000.000000 399999.999814 /end CHARACTERISTIC
/begin CHARACTERISTIC TCPrt_drChrgPmpCtlRmpUp_C "" VALUE 0x8006CD78 Val_Ws32 750000.000000 RmpPrc 0.00 750000.000000 FORMAT "%13.6" EXTENDED_LIMITS -400000.000000 399999.999814 /end CHARACTERISTIC
/begin CHARACTERISTIC TCPrt_facAFSensAmpMax_C "Obere Grenzwert für die Turboladerpumpgrenzerkennung" VALUE 0x8006CD14 Val_Ws16 2047.938 FactM 0.00 2047.938 FORMAT "%8.3" EXTENDED_LIMITS -2048.000 2047.938 /end CHARACTERISTIC
/begin CHARACTERISTIC TCPrt_facAFSensAmpMin_C "Untere Grenzwert für die Turboladerpumpgrenzerkennung" VALUE 0x8006CD16 Val_Ws16 2047.938 FactM 0.00 2047.938 FORMAT "%8.3" EXTENDED_LIMITS -2048.000 2047.938 /end CHARACTERISTIC
/begin CHARACTERISTIC TCPrt_facChrgPmpDes_MAP "" MAP 0x8006CD7C Map_Xs16Ys16Ws16 1.000000 FactM 0.00 1.000000 FORMAT "%8.6" EXTENDED_LIMITS -2048.000 2047.938
 /begin AXIS_DESCR STD_AXIS Epm_nEng EngN 6 0.00 6000.000 FORMAT "%8.3" EXTENDED_LIMITS -16384.00 16383.50 DEPOSIT ABSOLUTE /end AXIS_DESCR
 /begin AXIS_DESCR STD_AXIS EnvP_pSens Pres_hPa 4 0.00 3500.000 FORMAT "%8.3" EXTENDED_LIMITS -32768.00 32767.00 DEPOSIT ABSOLUTE /end AXIS_DESCR
/end CHARACTERISTIC
/begin CHARACTERISTIC TCPrt_facChrgPmpIWinNeg_C "" VALUE 0x8006CDC4 Val_Ws32 4000.00000000 FactM -2000.00000000 2000.00000000 FORMAT "%13.8" EXTENDED_LIMITS -134217728.000 134217727.938 /end CHARACTERISTIC
/begin CHARACTERISTIC TCPrt_facChrgPmpIWinPos_C "" VALUE 0x8006CDC8 Val_Ws32 4000.00000000 FactM -2000.00000000 2000.00000000 FORMAT "%13.8" EXTENDED_LIMITS -134217728.000 134217727.938 /end CHARACTERISTIC
/begin CHARACTERISTIC TCPrt_facChrgPmpI_MAP "" MAP 0x8006CDCC Map_Xs16Ys16Ws16 1.000000 Fact1 0.00 1.000000 FORMAT "%8.6" EXTENDED_LIMITS -256.0000 255.9922
 /begin AXIS_DESCR STD_AXIS Epm_nEng EngN 6 0.00 6000.000 FORMAT "%8.3" EXTENDED_LIMITS -16384.00 16383.50 DEPOSIT ABSOLUTE /end AXIS_DESCR
 /begin AXIS_DESCR STD_AXIS EnvP_pSens Pres_hPa 4 0.00 3500.000 FORMAT "%8.3" EXTENDED_LIMITS -32768.00 32767.00 DEPOSIT ABSOLUTE /end AXIS_DESCR
/end CHARACTERISTIC
/begin CHARACTERISTIC TCPrt_facChrgPmpPWinNeg_C "" VALUE 0x8006CE14 Val_Ws32 4000.00000000 FactM -2000.00000000 2000.00000000 FORMAT "%13.8" EXTENDED_LIMITS -134217728.000 134217727.938 /end CHARACTERISTIC
/begin CHARACTERISTIC TCPrt_facChrgPmpPWinPos_C "" VALUE 0x8006CE18 Val_Ws32 4000.00000000 FactM -2000.00000000 2000.00000000 FORMAT "%13.8" EXTENDED_LIMITS -134217728.000 134217727.938 /end CHARACTERISTIC
/begin CHARACTERISTIC TCPrt_facChrgPmpP_MAP "" MAP 0x8006CE1C Map_Xs16Ys16Ws16 1.000000 Fact1 0.00 1.000000 FORMAT "%8.6" EXTENDED_LIMITS -256.0000 255.9922
 /begin AXIS_DESCR STD_AXIS Epm_nEng EngN 6 0.00 6000.000 FORMAT "%8.3" EXTENDED_LIMITS -16384.00 16383.50 DEPOSIT ABSOLUTE /end AXIS_DESCR
 /begin AXIS_DESCR STD_AXIS EnvP_pSens Pres_hPa 4 0.00 3500.000 FORMAT "%8.3" EXTENDED_LIMITS -32768.00 32767.00 DEPOSIT ABSOLUTE /end AXIS_DESCR
/end CHARACTERISTIC
/begin CHARACTERISTIC TCPrt_facCnv_CUR "Kennlinie zur Amplitudenhöhe der oszillierenden Frischluftmasse beim Laderpumpen" CURVE 0x8006CD18 Cur_Xs16Ws16 1.000000 FactM 0.00 1.000000 FORMAT "%8.6" EXTENDED_LIMITS -2048.000 2047.938
 /begin AXIS_DESCR STD_AXIS TCPrt_facAFSensAmpFlt_mp FactM 10 0.00 10.00000 FORMAT "%8.5" EXTENDED_LIMITS -2048.000 2047.938 DEPOSIT ABSOLUTE /end AXIS_DESCR
/end CHARACTERISTIC
/begin CHARACTERISTIC TCPrt_IChrgPmpKiNeg_C "" VALUE 0x8006CE64 Val_Ws32 15000000.0000 Ki_Pres_fac2hPa 0.00 15000000.0000 FORMAT "%13.4" EXTENDED_LIMITS -16000000.0000 15999999.9925 /end CHARACTERISTIC
/begin CHARACTERISTIC TCPrt_IChrgPmpKiPos_C "" VALUE 0x8006CE68 Val_Ws32 15000000.0000 Ki_Pres_fac2hPa 0.00 15000000.0000 FORMAT "%13.4" EXTENDED_LIMITS -16000000.0000 15999999.9925 /end CHARACTERISTIC
/begin CHARACTERISTIC TCPrt_IChrgPmpKi_C "" VALUE 0x8006CE6C Val_Ws32 15000000.0000 Ki_Pres_fac2hPa 0.00 15000000.0000 FORMAT "%13.4" EXTENDED_LIMITS -16000000.0000 15999999.9925 /end CHARACTERISTIC
/begin CHARACTERISTIC TCPrt_nChrgPmpMon1_C "Schwelle Low Überwachung Anti-Surge LIGov/TCPrt_nSetpoint" VALUE 0x8006C9C4 Val_Ws16 6000.000 EngN 0.00 6000.000 FORMAT "%8.3" EXTENDED_LIMITS -16384.00 16383.50 /end CHARACTERISTIC
/begin CHARACTERISTIC TCPrt_nChrgPmpMon2_C "Schwelle High Überwachung Anti-Surge LIGov/TCPrt_nSetpoint" VALUE 0x8006C9C6 Val_Ws16 6000.000 EngN 0.00 6000.000 FORMAT "%8.3" EXTENDED_LIMITS -16384.00 16383.50 /end CHARACTERISTIC
/begin CHARACTERISTIC TCPrt_nHLSDemBase_C "LL-Solldrehzahl bei Anti-Surge inaktiv" VALUE 0x8006C9C8 Val_Ws16 6000.000 EngN 0.00 6000.000 FORMAT "%8.3" EXTENDED_LIMITS -16384.00 16383.50 /end CHARACTERISTIC
/begin CHARACTERISTIC TCPrt_nSetPointHLSDem_C "LIGov Einstellpunkt für Anti_Surge" VALUE 0x8006C9CA Val_Ws16 6000.000 EngN 0.00 6000.000 FORMAT "%8.3" EXTENDED_LIMITS -16384.00 16383.50 /end CHARACTERISTIC
/begin CHARACTERISTIC TCPrt_pChrgPmpCtlVal_MAP "" MAP 0x8006CE70 Map_Xs16Ys16Ws16 3500.000 Pres_hPa 0.00 3500.000 FORMAT "%8.3" EXTENDED_LIMITS -32768.00 32767.00
 /begin AXIS_DESCR STD_AXIS Epm_nEng EngN 6 0.00 6000.000 FORMAT "%8.3" EXTENDED_LIMITS -16384.00 16383.50 DEPOSIT ABSOLUTE /end AXIS_DESCR
 /begin AXIS_DESCR STD_AXIS EnvP_pSens Pres_hPa 6 0.00 3500.000 FORMAT "%8.3" EXTENDED_LIMITS -32768.00 32767.00 DEPOSIT ABSOLUTE /end AXIS_DESCR
/end CHARACTERISTIC
/begin CHARACTERISTIC TCPrt_PChrgPmpKpNeg_C "" VALUE 0x8006CED4 Val_Ws32 1048000.00000 Kp_Pres_fac2hPa 0.00 1048000.00000 FORMAT "%13.5" EXTENDED_LIMITS -1048576.00000 1048575.99951 /end CHARACTERISTIC
/begin CHARACTERISTIC TCPrt_PChrgPmpKpPos_C "" VALUE 0x8006CED8 Val_Ws32 1048000.00000 Kp_Pres_fac2hPa 0.00 1048000.00000 FORMAT "%13.5" EXTENDED_LIMITS -1048576.00000 1048575.99951 /end CHARACTERISTIC
/begin CHARACTERISTIC TCPrt_PChrgPmpKp_C "" VALUE 0x8006CEDC Val_Ws32 1048000.00000 Kp_Pres_fac2hPa 0.00 1048000.00000 FORMAT "%13.5" EXTENDED_LIMITS -1048576.00000 1048575.99951 /end CHARACTERISTIC
/begin CHARACTERISTIC TCPrt_pChrgPmpMax_MAP "" MAP 0x8006CEE0 Map_Xs16Ys16Ws16 3500.000 Pres_hPa 0.00 3500.000 FORMAT "%8.3" EXTENDED_LIMITS -32768.00 32767.00
 /begin AXIS_DESCR STD_AXIS Epm_nEng EngN 5 0.00 6000.000 FORMAT "%8.3" EXTENDED_LIMITS -16384.00 16383.50 DEPOSIT ABSOLUTE /end AXIS_DESCR
 /begin AXIS_DESCR STD_AXIS EnvP_pSens Pres_hPa 5 0.00 3500.000 FORMAT "%8.3" EXTENDED_LIMITS -32768.00 32767.00 DEPOSIT ABSOLUTE /end AXIS_DESCR
/end CHARACTERISTIC
/begin CHARACTERISTIC TCPrt_pChrgPmpMin_MAP "" MAP 0x8006CF2A Map_Xs16Ys16Ws16 3500.000 Pres_hPa 0.00 3500.000 FORMAT "%8.3" EXTENDED_LIMITS -32768.00 32767.00
 /begin AXIS_DESCR STD_AXIS Epm_nEng EngN 5 0.00 6000.000 FORMAT "%8.3" EXTENDED_LIMITS -16384.00 16383.50 DEPOSIT ABSOLUTE /end AXIS_DESCR
 /begin AXIS_DESCR STD_AXIS EnvP_pSens Pres_hPa 5 0.00 3500.000 FORMAT "%8.3" EXTENDED_LIMITS -32768.00 32767.00 DEPOSIT ABSOLUTE /end AXIS_DESCR
/end CHARACTERISTIC
/begin CHARACTERISTIC TCPrt_pDesChrgPmp_CUR "" CURVE 0x8006CF74 Cur_Xs16Ws16 3500.000 Pres_hPa 0.00 3500.000 FORMAT "%8.3" EXTENDED_LIMITS -32768.00 32767.00
 /begin AXIS_DESCR STD_AXIS TCPrt_pChrgPmpPICtlLim_mp Pres_hPa 2 0.00 3500.000 FORMAT "%8.3" EXTENDED_LIMITS -32768.00 32767.00 DEPOSIT ABSOLUTE /end AXIS_DESCR
/end CHARACTERISTIC
/begin CHARACTERISTIC TCPrt_pDvtChrgPmpCtlRls_C "" VALUE 0x8006CF7E Val_Ws16 3500.000 Pres_hPa 0.00 3500.000 FORMAT "%8.3" EXTENDED_LIMITS -32768.00 32767.00 /end CHARACTERISTIC
/begin CHARACTERISTIC TCPrt_qChrgPmpCtlHigh_CUR "Höhere Quantität Begrenzung für Hysteresis der Anti-Schwankung LIGov" CURVE 0x8006C9CC Cur_Xs16Ws16 100.0000 InjMass 0.00 100.0000 FORMAT "%8.4" EXTENDED_LIMITS -327.6800 327.6700
 /begin AXIS_DESCR STD_AXIS Epm_nEng EngN 5 0.00 6000.000 FORMAT "%8.3" EXTENDED_LIMITS -16384.00 16383.50 DEPOSIT ABSOLUTE /end AXIS_DESCR
/end CHARACTERISTIC
/begin CHARACTERISTIC TCPrt_qChrgPmpCtlLow_CUR "Senken Sie Quantität Begrenzung für Hysteresis der Anti-Schwankung LIGov" CURVE 0x8006C9E2 Cur_Xs16Ws16 100.0000 InjMass 0.00 100.0000 FORMAT "%8.4" EXTENDED_LIMITS -327.6800 327.6700
 /begin AXIS_DESCR STD_AXIS Epm_nEng EngN 5 0.00 6000.000 FORMAT "%8.3" EXTENDED_LIMITS -16384.00 16383.50 DEPOSIT ABSOLUTE /end AXIS_DESCR
/end CHARACTERISTIC
/begin CHARACTERISTIC TCPrt_rChrgPmpCtlValHigh_MAP "Hystereseschwelle oben Druckverhältnis Anti-Surge LIGov" MAP 0x8006C9F8 Map_Xs16Ys16Ws16 100.0000 Prc 0.00 100.0000 FORMAT "%8.4" EXTENDED_LIMITS -400.0000 399.9878
 /begin AXIS_DESCR STD_AXIS Epm_nEng EngN 8 0.00 6000.000 FORMAT "%8.3" EXTENDED_LIMITS -16384.00 16383.50 DEPOSIT ABSOLUTE /end AXIS_DESCR
 /begin AXIS_DESCR STD_AXIS EnvP_p Pres_hPa 3 0.00 3500.000 FORMAT "%8.3" EXTENDED_LIMITS -32768.00 32767.00 DEPOSIT ABSOLUTE /end AXIS_DESCR
/end CHARACTERISTIC
/begin CHARACTERISTIC TCPrt_rChrgPmpCtlValOfs_CUR "Senken Sie ATL Druck-Verhältnisbegrenzung für Hysteresis der Anti-Schwankung LIGov" CURVE 0x8006CA42 Cur_Xs16Ws16 100.0000 Prc 0.00 100.0000 FORMAT "%8.4" EXTENDED_LIMITS -400.0000 399.9878
 /begin AXIS_DESCR STD_AXIS Epm_nEng EngN 5 0.00 6000.000 FORMAT "%8.3" EXTENDED_LIMITS -16384.00 16383.50 DEPOSIT ABSOLUTE /end AXIS_DESCR
/end CHARACTERISTIC
/begin CHARACTERISTIC TCPrt_rChrgPmpCtlVal_MAP "Erhöhung Druckregelungwert für Anti-Schwankung LIGov" MAP 0x8006CA58 Map_Xs16Ys16Ws16 100.0000 Prc 0.00 100.0000 FORMAT "%8.4" EXTENDED_LIMITS -400.0000 399.9878
 /begin AXIS_DESCR STD_AXIS PCR_qCtlVal InjMass 16 0.00 327.6700 FORMAT "%8.4" EXTENDED_LIMITS -327.6800 327.6700 DEPOSIT ABSOLUTE /end AXIS_DESCR
 /begin AXIS_DESCR STD_AXIS Epm_nEng EngN 16 0.00 6000.000 FORMAT "%8.3" EXTENDED_LIMITS -16384.00 16383.50 DEPOSIT ABSOLUTE /end AXIS_DESCR
/end CHARACTERISTIC
/begin CHARACTERISTIC TCPrt_rChrgPmpGovOff_CUR "" CURVE 0x8006CF80 Cur_Xs16Ws16 100.0000 Prc 0.00 100.0000 FORMAT "%8.4" EXTENDED_LIMITS -400.0000 399.9878
 /begin AXIS_DESCR STD_AXIS Epm_nEng EngN 5 0.00 6000.000 FORMAT "%8.3" EXTENDED_LIMITS -16384.00 16383.50 DEPOSIT ABSOLUTE /end AXIS_DESCR
/end CHARACTERISTIC
/begin CHARACTERISTIC TCPrt_rChrgPmpGovOn_MAP "" MAP 0x8006CF96 Map_Xs16Ys16Ws16 100.0000 Prc 0.00 100.0000 FORMAT "%8.4" EXTENDED_LIMITS -400.0000 399.9878
 /begin AXIS_DESCR STD_AXIS Epm_nEng EngN 6 0.00 6000.000 FORMAT "%8.3" EXTENDED_LIMITS -16384.00 16383.50 DEPOSIT ABSOLUTE /end AXIS_DESCR
 /begin AXIS_DESCR STD_AXIS EnvP_pSens Pres_hPa 4 0.00 3500.000 FORMAT "%8.3" EXTENDED_LIMITS -32768.00 32767.00 DEPOSIT ABSOLUTE /end AXIS_DESCR
/end CHARACTERISTIC
/begin CHARACTERISTIC TCPrt_rChrgPmpGov_MAP "" MAP 0x8006CFDE Map_Xs16Ys16Ws16 100.0000 Prc 0.00 100.0000 FORMAT "%8.4" EXTENDED_LIMITS -400.0000 399.9878
 /begin AXIS_DESCR STD_AXIS TCPrt_pChrgPmpPICtlLim_mp Pres_hPa 5 0.00 3500.000 FORMAT "%8.3" EXTENDED_LIMITS -32768.00 32767.00 DEPOSIT ABSOLUTE /end AXIS_DESCR
 /begin AXIS_DESCR STD_AXIS Epm_nEng EngN 5 0.00 6000.000 FORMAT "%8.3" EXTENDED_LIMITS -16384.00 16383.50 DEPOSIT ABSOLUTE /end AXIS_DESCR
/end CHARACTERISTIC
/begin CHARACTERISTIC TCPrt_rChrgPmpHigh_MAP "Hystereseschwelle oben Druckverhältnis Anti-Surge LIGov" MAP 0x8006CC9C Map_Xs16Ys16Ws16 100.0000 Prc 0.00 100.0000 FORMAT "%8.4" EXTENDED_LIMITS -400.0000 399.9878
 /begin AXIS_DESCR STD_AXIS Epm_nEng EngN 8 0.00 6000.000 FORMAT "%8.3" EXTENDED_LIMITS -16384.00 16383.50 DEPOSIT ABSOLUTE /end AXIS_DESCR
 /begin AXIS_DESCR STD_AXIS EnvP_p Pres_hPa 3 0.00 3500.000 FORMAT "%8.3" EXTENDED_LIMITS -32768.00 32767.00 DEPOSIT ABSOLUTE /end AXIS_DESCR
/end CHARACTERISTIC
/begin CHARACTERISTIC TCPrt_rChrgPmpOfs_CUR "Senken Sie ATL Druck-Verhältnisbegrenzung für Hysteresis der Anti-Schwankung LIGov" CURVE 0x8006CCE6 Cur_Xs16Ws16 280.0049 Prc 0.00 280.0049 FORMAT "%8.4" EXTENDED_LIMITS -400.0000 399.9878
 /begin AXIS_DESCR STD_AXIS Epm_nEng EngN 5 0.00 6000.000 FORMAT "%8.3" EXTENDED_LIMITS -16384.00 16383.50 DEPOSIT ABSOLUTE /end AXIS_DESCR
/end CHARACTERISTIC
/begin CHARACTERISTIC TCPrt_swtChrgPmpGearHLSDem_C "Maske AntiSurge-LLR Gang-Auswahl (Bit0/1 für Clth_st = 0/1, Bit4/5/6 für Com_stClth = 0/1/2)" VALUE 0x8006CCFC Val_Wu8 3.000 OneToOne 0.00 3.000 FORMAT "%5.3" EXTENDED_LIMITS 0.00 255.0 /end CHARACTERISTIC
/begin CHARACTERISTIC TCPrt_swtChrgPmpGearTrbCh_C "Maske AntiSurge-LDR Gang-Auswahl (Bit0 für Com_stClth =0, bit1 für Com_stClth =1)" VALUE 0x8006CCFD Val_Wu8 127.0 OneToOne 0.00 127.0 FORMAT "%5.1" EXTENDED_LIMITS 0.00 255.0 /end CHARACTERISTIC
/begin CHARACTERISTIC TCPrt_swtChrgPmpGovActv_C "" VALUE 0x8006D028 Val_Wu8 1.000 OneToOne 0.00 1.000 FORMAT "%5.3" EXTENDED_LIMITS 0.00 255.0 /end CHARACTERISTIC
/begin CHARACTERISTIC TCPrt_swtChrgPmpGovSel_C "" VALUE 0x8006D029 Val_Wu8 255.0 OneToOne 0.00 255.0 FORMAT "%5.1" /end CHARACTERISTIC
/begin CHARACTERISTIC TCPrt_swtOffStat1_C "Schalter um den Einfluss von TCPrt_stChrgPmpHLSDem_mp zu deaktivieren (1...deaktiviert, 0...aktiviert)" VALUE 0x8006CCFE Val_Wu8 1.000 OneToOne 0.00 1.000 FORMAT "%5.3" EXTENDED_LIMITS 0.00 255.0 /end CHARACTERISTIC
/begin CHARACTERISTIC TCPrt_tiAFSensPTCtlFlt1_C "Parameter für PT1-Glied für Tiefpassfilterung der Amplitude der oszillierenden FrischluftmasseCtl-Flt1" VALUE 0x8006CD44 Val_Ws32 4294967.2940 TimeDelay_ms 0.0020000000009 4294967.2960 FORMAT "%12.4" /end CHARACTERISTIC
/begin CHARACTERISTIC TCPrt_tiAFSensPTCtlFlt2_C "Parameter für PT1-Glied für Tiefpassfilterung der Amplitude" VALUE 0x8006CD48 Val_Ws32 4294967.2940 TimeDelay_ms 0.0020000000009 4294967.2960 FORMAT "%12.4" /end CHARACTERISTIC
/begin CHARACTERISTIC TCPrt_tiAFSensPTCtlFlt3_C "Parameter für PT1-Glied für Tiefpassfilterung der Amplitude der oszillierenden FrischluftmasseCtl-Flt2" VALUE 0x8006CD4C Val_Ws32 4294967.2940 TimeDelay_ms 0.0020000000009 4294967.2960 FORMAT "%12.4" /end CHARACTERISTIC
/begin CHARACTERISTIC TCPrt_tiChrgPmpCtlHiLoRls3_C "" VALUE 0x8006D02A Val_Ws16 327670.0 TimeDeb 0.00 327670.0 FORMAT "%8.1" EXTENDED_LIMITS -327680.0 327670.0 /end CHARACTERISTIC
/begin CHARACTERISTIC TCPrt_tiChrgPmpCtlHiLo_C "Entprellzeit für Status TCPrt_stCrgPmpCtl für Übergang von 1 auf 0" VALUE 0x8006CD00 Val_Wu16 4000.000 Time_ms 0.00 4000.000 FORMAT "%8.3" EXTENDED_LIMITS 0.00 655350.0 /end CHARACTERISTIC
/begin CHARACTERISTIC TCPrt_tiChrgPmpCtlLoHiRls3_C "" VALUE 0x8006D02C Val_Ws16 327670.0 TimeDeb 0.00 327670.0 FORMAT "%8.1" EXTENDED_LIMITS -327680.0 327670.0 /end CHARACTERISTIC
/begin CHARACTERISTIC TCPrt_tiChrgPmpCtlLoHi_C "Entprellzeit für Status TCPrt_stCrgPmpCtl für Übergang von 0 auf 1" VALUE 0x8006CD02 Val_Wu16 4000.000 Time_ms 0.00 4000.000 FORMAT "%8.3" EXTENDED_LIMITS 0.00 655350.0 /end CHARACTERISTIC
/begin CHARACTERISTIC TCPrt_tiChrgPmpCtlQDT1_C "" VALUE 0x8006D030 Val_Ws32 4294.9662960 TimeDelay_s 0.0010000000689 4294.9672960 FORMAT "%12.7" EXTENDED_LIMITS 0.000002000000001 4294.9672960 /end CHARACTERISTIC
/begin CHARACTERISTIC TCPrt_tiChrgPmpDetMDT12_C "Zeitabschnitt für die zweiten DT1-filter" VALUE 0x8006CD50 Val_Ws32 4294.9662960 TimeDelay_s 0.0010000000689 4294.9672960 FORMAT "%12.7" EXTENDED_LIMITS 0.000002000000001 4294.9672960 /end CHARACTERISTIC
/begin CHARACTERISTIC TCPrt_tiChrgPmpDetMDT1_C "Zeitabschnitt für die DT1-filter" VALUE 0x8006CD54 Val_Ws32 4294.9662960 TimeDelay_s 0.0010000000689 4294.9672960 FORMAT "%12.7" EXTENDED_LIMITS 0.000002000000001 4294.9672960 /end CHARACTERISTIC
/begin CHARACTERISTIC TCPrt_tiChrgPmpGovPT1_C "" VALUE 0x8006D034 Val_Ws32 4294.9662960 TimeDelay_s 0.0010000000689 4294.9672960 FORMAT "%12.7" EXTENDED_LIMITS 0.000002000000001 4294.9672960 /end CHARACTERISTIC
/begin CHARACTERISTIC TCPrt_tiChrgPmpGovRlsAllHiLo_C "" VALUE 0x8006D038 Val_Ws16 327670.0 TimeDeb 0.00 327670.0 FORMAT "%8.1" EXTENDED_LIMITS -327680.0 327670.0 /end CHARACTERISTIC
/begin CHARACTERISTIC TCPrt_tiChrgPmpGovRlsAllLoHi_C "" VALUE 0x8006D03A Val_Ws16 327670.0 TimeDeb 0.00 327670.0 FORMAT "%8.1" EXTENDED_LIMITS -327680.0 327670.0 /end CHARACTERISTIC
/begin CHARACTERISTIC TCPrt_tiChrgPmpMonHLSDem_C "Überwachungszeit Drehzahlanhebung Anti-Surge" VALUE 0x8006CD04 Val_Wu16 655.3500 Time_s 0.00 655.3500 FORMAT "%8.4" /end CHARACTERISTIC
/begin CHARACTERISTIC TCPrt_tiChrgPmpPT1_C "Zeitkonstante von PT1 Verzögerungsglied" VALUE 0x8006CD08 Val_Wu32 4294.8272945 TimeDelay_s 0.14000154169 4294.9672960 FORMAT "%12.7" EXTENDED_LIMITS 0.000001000000000 4294.9672960 /end CHARACTERISTIC
/begin CHARACTERISTIC TCPrt_tiDebChrgPmpHiLo_C "Parameter 2 für die Entprellung der Erkennung oszillierende Luftmasse mit großer Amplitude" VALUE 0x8006CD58 Val_Ws16 655140.0 TimeDeb 0.00 655140.0 FORMAT "%8.1" EXTENDED_LIMITS -327680.0 327670.0 /end CHARACTERISTIC
/begin CHARACTERISTIC TCPrt_tiDebChrgPmpLoHi_C "" VALUE 0x8006CD5A Val_Ws16 655140.0 TimeDeb 0.00 655140.0 FORMAT "%8.1" EXTENDED_LIMITS -327680.0 327670.0 /end CHARACTERISTIC
/begin CHARACTERISTIC TCPrt_tiDebPreChrgPmpDetHiLo_C "" VALUE 0x8006CD5C Val_Ws16 655140.0 TimeDeb 0.00 655140.0 FORMAT "%8.1" EXTENDED_LIMITS -327680.0 327670.0 /end CHARACTERISTIC
/begin CHARACTERISTIC TCPrt_tiDebPreChrgPmpDetLoHi_C "" VALUE 0x8006CD5E Val_Ws16 655140.0 TimeDeb 0.00 655140.0 FORMAT "%8.1" EXTENDED_LIMITS -327680.0 327670.0 /end CHARACTERISTIC
/begin CHARACTERISTIC TECU_RmpSlp.Pos_C "/" VALUE 0x8006D0A8 Kw_Ws32 3276798.99750 RmpTemp 1.00097656250 3276799.99847 FORMAT "%13.5" EXTENDED_LIMITS -3276800.00000 3276799.99847 /end CHARACTERISTIC
/begin CHARACTERISTIC TECU_RmpSlp.Neg_C "/" VALUE 0x8006D0AC Kw_Ws32 3276798.99750 RmpTemp 1.00097656250 3276799.99847 FORMAT "%13.5" EXTENDED_LIMITS -3276800.00000 3276799.99847 /end CHARACTERISTIC
/begin CHARACTERISTIC TECU_SRC.uMin_C "/" VALUE 0x8006D03C Kw_Ws16 750.0000 Volt 0.00 750.0000 FORMAT "%8.4" EXTENDED_LIMITS -6553.600 6553.400 /end CHARACTERISTIC
/begin CHARACTERISTIC TECU_SRC.uMax_C "/" VALUE 0x8006D03E Kw_Ws16 800.0000 Volt 2500.000 3300.000 FORMAT "%8.3" EXTENDED_LIMITS -6553.600 6553.400 /end CHARACTERISTIC
/begin CHARACTERISTIC TECU_TransStg.Dfl_C "/" VALUE 0x8006D0B0 Kw_Ws16 250.0000 Temp_Cels -50.04000 199.9600 FORMAT "%8.4" EXTENDED_LIMITS -3549.940 3003.560 /end CHARACTERISTIC
/begin CHARACTERISTIC TECU_TransStg.stSensId_C "/" VALUE 0x8006D0B2 Kw_Wu8 4.000 OneToOne 0.00 4.000 FORMAT "%5.3" EXTENDED_LIMITS 0.00 255.0 /end CHARACTERISTIC
/begin CHARACTERISTIC TECU_tTransf_CUR "" CURVE 0x8006D040 Cur_Xs16Ws16 250.0000 Temp_Cels -50.04000 199.9600 FORMAT "%8.4" EXTENDED_LIMITS -3549.940 3003.560
 /begin AXIS_DESCR STD_AXIS TECU_uRaw Volt 25 0.00 5000.000 FORMAT "%8.3" EXTENDED_LIMITS -6553.600 6553.400 DEPOSIT ABSOLUTE /end AXIS_DESCR
/end CHARACTERISTIC
/begin CHARACTERISTIC ThrVlv_4WinSigDur.tiErr1Min_C "/" VALUE 0x8006D202 Kw_Ws16 655350.0 Time_ms -327680.0 327670.0 FORMAT "%8.1" /end CHARACTERISTIC
/begin CHARACTERISTIC ThrVlv_4WinSigDur.tiErr1Max_C "/" VALUE 0x8006D204 Kw_Ws16 655350.0 Time_ms -327680.0 327670.0 FORMAT "%8.1" /end CHARACTERISTIC
/begin CHARACTERISTIC ThrVlv_4WinSigDur.tiErr2Min_C "/" VALUE 0x8006D206 Kw_Ws16 655350.0 Time_ms -327680.0 327670.0 FORMAT "%8.1" /end CHARACTERISTIC
/begin CHARACTERISTIC ThrVlv_4WinSigDur.tiErr2Max_C "/" VALUE 0x8006D208 Kw_Ws16 655350.0 Time_ms -327680.0 327670.0 FORMAT "%8.1" /end CHARACTERISTIC
/begin CHARACTERISTIC ThrVlv_4WinSigDur.tiErr3Min_C "/" VALUE 0x8006D20A Kw_Ws16 655350.0 Time_ms -327680.0 327670.0 FORMAT "%8.1" /end CHARACTERISTIC
/begin CHARACTERISTIC ThrVlv_4WinSigDur.tiErr3Max_C "/" VALUE 0x8006D20C Kw_Ws16 655350.0 Time_ms -327680.0 327670.0 FORMAT "%8.1" /end CHARACTERISTIC
/begin CHARACTERISTIC ThrVlv_4WinSigDur.tiErr4Min_C "/" VALUE 0x8006D20E Kw_Ws16 655350.0 Time_ms -327680.0 327670.0 FORMAT "%8.1" /end CHARACTERISTIC
/begin CHARACTERISTIC ThrVlv_4WinSigDur.tiErr4Max_C "/" VALUE 0x8006D210 Kw_Ws16 655350.0 Time_ms -327680.0 327670.0 FORMAT "%8.1" /end CHARACTERISTIC
/begin CHARACTERISTIC ThrVlv_Pwm.tiPer_C "/" VALUE 0x8006D212 Val_Ws16 9.900000 Period 0.1000000 10.00000 FORMAT "%8.5" EXTENDED_LIMITS -3276.800 3276.700 /end CHARACTERISTIC
/begin CHARACTERISTIC ThrVlv_Pwm.stLvl_C "/" VALUE 0x8006D214 Val_Wu8 1.000 OneToOne 0.00 1.000 FORMAT "%5.3" EXTENDED_LIMITS 0.00 255.0 /end CHARACTERISTIC
/begin CHARACTERISTIC ThrVlv_Pwm.rMaxDty_C "/" VALUE 0x8006D216 Val_Ws16 100.0000 DtyCyc 0.00 100.0000 FORMAT "%8.4" EXTENDED_LIMITS -327.6800 327.6700 /end CHARACTERISTIC
/begin CHARACTERISTIC ThrVlv_Pwm.rPerUn_C "/" VALUE 0x8006D218 Val_Ws16 3276.700 Period 0.00 3276.700 FORMAT "%8.3" EXTENDED_LIMITS -3276.800 3276.700 /end CHARACTERISTIC
/begin CHARACTERISTIC ThrVlv_Pwm.tiPh_C "/" VALUE 0x8006D21A Val_Ws16 65535.00 OneToOne -32768.00 32767.00 FORMAT "%8.2" /end CHARACTERISTIC
/begin CHARACTERISTIC ThrVlv_PwmOut.rMin_C "/" VALUE 0x8006D21C Kw_Ws16 100.0000 DtyCyc 0.00 100.0000 FORMAT "%8.4" EXTENDED_LIMITS -327.6800 327.6700 /end CHARACTERISTIC
/begin CHARACTERISTIC ThrVlv_PwmOut.rMax_C "/" VALUE 0x8006D21E Kw_Ws16 100.0000 DtyCyc 0.00 100.0000 FORMAT "%8.4" EXTENDED_LIMITS -327.6800 327.6700 /end CHARACTERISTIC
/begin CHARACTERISTIC ThrVlv_PwmOut.tiBtwTstSCB_C "/" VALUE 0x8006D220 Kw_Ws16 1000.000 Time_ms 0.00 1000.000 FORMAT "%8.3" EXTENDED_LIMITS -327680.0 327670.0 /end CHARACTERISTIC
/begin CHARACTERISTIC ThrVlv_PwmOut.tiBtwTstOT_C "/" VALUE 0x8006D222 Kw_Ws16 327.6700 Time_s 0.00 327.6700 FORMAT "%8.4" EXTENDED_LIMITS -327.6800 327.6700 /end CHARACTERISTIC
/begin CHARACTERISTIC ThrVlv_PwmOut.numTstMax_C "/" VALUE 0x8006D224 Kw_Wu16 65535.00 OneToOne 0.00 65535.00 FORMAT "%8.2" /end CHARACTERISTIC
/begin CHARACTERISTIC ThrVlv_PwmOut.swtBattCor_C "/" VALUE 0x8006D226 Kw_Wu8 1.000 OneToOne 0.00 1.000 FORMAT "%5.3" EXTENDED_LIMITS 0.00 255.0 /end CHARACTERISTIC
/begin CHARACTERISTIC ThrVlv_PwmOut.swtPsInv_C "/" VALUE 0x8006D227 Kw_Wu8 255.0 OneToOne 0.00 255.0 FORMAT "%5.1" /end CHARACTERISTIC
/begin CHARACTERISTIC ThrVlv_rCnv_CUR "" CURVE 0x8006D228 Cur_Xs16Ws16 100.0000 DtyCyc 0.00 100.0000 FORMAT "%8.4" EXTENDED_LIMITS -327.6800 327.6700
 /begin AXIS_DESCR STD_AXIS ThrVlv_r Prc 16 -400.0000 399.9878 FORMAT "%8.4" DEPOSIT ABSOLUTE /end AXIS_DESCR
/end CHARACTERISTIC
/begin CHARACTERISTIC ThrVlv_RmpSlp.Pos_C "/" VALUE 0x8006D2DC Kw_Ws32 327679.999847 RmpDtyCyc 0.00 327679.999847 FORMAT "%13.6" EXTENDED_LIMITS -327680.000000 327679.999847 /end CHARACTERISTIC
/begin CHARACTERISTIC ThrVlv_RmpSlp.Neg_C "/" VALUE 0x8006D2E0 Kw_Ws32 327679.999847 RmpDtyCyc 0.00 327679.999847 FORMAT "%13.6" EXTENDED_LIMITS -327680.000000 327679.999847 /end CHARACTERISTIC
/begin CHARACTERISTIC ThrVlv_rPsDisbl_C "" VALUE 0x8006D26A Val_Ws16 100.0000 DtyCyc 0.00 100.0000 FORMAT "%8.4" EXTENDED_LIMITS -327.6800 327.6700 /end CHARACTERISTIC
/begin CHARACTERISTIC ThrVlv_rTransf_CUR "" CURVE 0x8006D270 Cur_Xs16Ws16 655.3500 DtyCyc -327.6800 327.6700 FORMAT "%8.4"
 /begin AXIS_DESCR STD_AXIS ThrVlv_uRaw Volt 25 0.00 5200.000 FORMAT "%8.3" EXTENDED_LIMITS -6553.600 6553.400 DEPOSIT ABSOLUTE /end AXIS_DESCR
/end CHARACTERISTIC
/begin CHARACTERISTIC ThrVlv_SRC.uMin_C "/" VALUE 0x8006D2D6 Val_Ws16 5200.000 Volt 0.00 5200.000 FORMAT "%8.3" EXTENDED_LIMITS -6553.600 6553.400 /end CHARACTERISTIC
/begin CHARACTERISTIC ThrVlv_SRC.uMax_C "/" VALUE 0x8006D2D8 Val_Ws16 5200.000 Volt 0.00 5200.000 FORMAT "%8.3" EXTENDED_LIMITS -6553.600 6553.400 /end CHARACTERISTIC
/begin CHARACTERISTIC ThrVlv_stPsDiaDisbl_C "" VALUE 0x8006D26C Val_Wu8 255.0 OneToOne 0.00 255.0 FORMAT "%5.1" /end CHARACTERISTIC
/begin CHARACTERISTIC ThrVlv_stPsDisbl_C "" VALUE 0x8006D26D Val_Wu8 255.0 OneToOne 0.00 255.0 FORMAT "%5.1" /end CHARACTERISTIC
/begin CHARACTERISTIC ThrVlv_TransStagePar.Dfl_C "/" VALUE 0x8006D2E4 Kw_Ws16 100.0000 DtyCyc 0.00 100.0000 FORMAT "%8.4" EXTENDED_LIMITS -327.6800 327.6700 /end CHARACTERISTIC
/begin CHARACTERISTIC ThrVlv_TransStagePar.stSensId_C "/" VALUE 0x8006D2E6 Kw_Wu8 255.0 OneToOne 0.00 255.0 FORMAT "%5.1" /end CHARACTERISTIC
/begin CHARACTERISTIC ThrVlv_typ4WinDia_C "" VALUE 0x8006D26E Val_Wu8 1.00000000000 Typ4WinDia 0.00 1.00000000000 FORMAT "%13.11" EXTENDED_LIMITS 0.00 3.00000000000 /end CHARACTERISTIC
/begin CHARACTERISTIC Tra_bCanAirCanPtd_C "Bedingung relative Kühlleistungsanforderung vom CAN" VALUE 0x8007E4D2 Val_Wu8 255.0 OneToOne 0.00 255.0 FORMAT "%5.1" /end CHARACTERISTIC
/begin CHARACTERISTIC Tra_bCanClntCanPtd_C "" VALUE 0x8007E4D3 Val_Wu8 255.0 OneToOne 0.00 255.0 FORMAT "%5.1" /end CHARACTERISTIC
/begin CHARACTERISTIC Tra_bCanInfoCan_C "" VALUE 0x8006D304 Val_Wu8 255.0 OneToOne 0.00 255.0 FORMAT "%5.1" /end CHARACTERISTIC
/begin CHARACTERISTIC Tra_bCanLevPos_C "" VALUE 0x8006D305 Val_Wu8 255.0 OneToOne 0.00 255.0 FORMAT "%5.1" /end CHARACTERISTIC
/begin CHARACTERISTIC Tra_bCanLoRng_C "" VALUE 0x8006D306 Val_Wu8 255.0 OneToOne 0.00 255.0 FORMAT "%5.1" /end CHARACTERISTIC
/begin CHARACTERISTIC Tra_bCanRevGear_C "" VALUE 0x8006D307 Val_Wu8 255.0 OneToOne 0.00 255.0 FORMAT "%5.1" /end CHARACTERISTIC
/begin CHARACTERISTIC Tra_bCanRTra_C "" VALUE 0x8006D308 Val_Wu8 255.0 OneToOne 0.00 255.0 FORMAT "%5.1" /end CHARACTERISTIC
/begin CHARACTERISTIC Tra_bGbxNPosEna_C "" VALUE 0x8006D309 Val_Wu8 255.0 OneToOne 0.00 255.0 FORMAT "%5.1" /end CHARACTERISTIC
/begin CHARACTERISTIC Tra_bStrtStopEnaDfl_C "" VALUE 0x8006D30A Val_Wu8 255.0 OneToOne 0.00 255.0 FORMAT "%5.1" /end CHARACTERISTIC
/begin CHARACTERISTIC Tra_nEngMin_C "" VALUE 0x8006D30C Val_Ws16 32767.50 EngN -16384.00 16383.50 FORMAT "%8.2" /end CHARACTERISTIC
/begin CHARACTERISTIC Tra_numLevPosCan_C "" VALUE 0x8006D30E Val_Wu8 255.0 OneToOne 0.00 255.0 FORMAT "%5.1" /end CHARACTERISTIC
/begin CHARACTERISTIC Tra_rClgDem_C "Parameter relative Lüfterkühlleistung" VALUE 0x8007E4D4 Val_Ws16 799.9878 Prc -400.0000 399.9878 FORMAT "%8.4" /end CHARACTERISTIC
/begin CHARACTERISTIC Tra_rV2NDfl_C "" VALUE 0x8006D310 Val_Ws16 0.6553500 VelToN -0.3276800 0.3276700 FORMAT "%9.7" /end CHARACTERISTIC
/begin CHARACTERISTIC Tra_rVn1H_C "" VALUE 0x8006D312 Val_Ws16 0.6553500 VelToN -0.3276800 0.3276700 FORMAT "%9.7" /end CHARACTERISTIC
/begin CHARACTERISTIC Tra_rVn1L_C "" VALUE 0x8006D314 Val_Ws16 0.6553500 VelToN -0.3276800 0.3276700 FORMAT "%9.7" /end CHARACTERISTIC
/begin CHARACTERISTIC Tra_rVn1To2Des_C "" VALUE 0x8006D316 Val_Ws16 0.6553500 VelToN -0.3276800 0.3276700 FORMAT "%9.7" /end CHARACTERISTIC
/begin CHARACTERISTIC Tra_rVn2H_C "" VALUE 0x8006D318 Val_Ws16 0.6553500 VelToN -0.3276800 0.3276700 FORMAT "%9.7" /end CHARACTERISTIC
/begin CHARACTERISTIC Tra_rVn2L_C "" VALUE 0x8006D31A Val_Ws16 0.6553500 VelToN -0.3276800 0.3276700 FORMAT "%9.7" /end CHARACTERISTIC
/begin CHARACTERISTIC Tra_rVn2To3Des_C "" VALUE 0x8006D31C Val_Ws16 0.6553500 VelToN -0.3276800 0.3276700 FORMAT "%9.7" /end CHARACTERISTIC
/begin CHARACTERISTIC Tra_rVn3H_C "" VALUE 0x8006D31E Val_Ws16 0.6553500 VelToN -0.3276800 0.3276700 FORMAT "%9.7" /end CHARACTERISTIC
/begin CHARACTERISTIC Tra_rVn3L_C "" VALUE 0x8006D320 Val_Ws16 0.6553500 VelToN -0.3276800 0.3276700 FORMAT "%9.7" /end CHARACTERISTIC
/begin CHARACTERISTIC Tra_rVn3To4Des_C "" VALUE 0x8006D322 Val_Ws16 0.6553500 VelToN -0.3276800 0.3276700 FORMAT "%9.7" /end CHARACTERISTIC
/begin CHARACTERISTIC Tra_rVn4H_C "" VALUE 0x8006D324 Val_Ws16 0.6553500 VelToN -0.3276800 0.3276700 FORMAT "%9.7" /end CHARACTERISTIC
/begin CHARACTERISTIC Tra_rVn4L_C "" VALUE 0x8006D326 Val_Ws16 0.6553500 VelToN -0.3276800 0.3276700 FORMAT "%9.7" /end CHARACTERISTIC
/begin CHARACTERISTIC Tra_rVn4To5Des_C "" VALUE 0x8006D328 Val_Ws16 0.6553500 VelToN -0.3276800 0.3276700 FORMAT "%9.7" /end CHARACTERISTIC
/begin CHARACTERISTIC Tra_rVn5H_C "" VALUE 0x8006D32A Val_Ws16 0.6553500 VelToN -0.3276800 0.3276700 FORMAT "%9.7" /end CHARACTERISTIC
/begin CHARACTERISTIC Tra_rVn5L_C "" VALUE 0x8006D32C Val_Ws16 0.6553500 VelToN -0.3276800 0.3276700 FORMAT "%9.7" /end CHARACTERISTIC
/begin CHARACTERISTIC Tra_rVn5To6Des_C "" VALUE 0x8006D32E Val_Ws16 0.6553500 VelToN -0.3276800 0.3276700 FORMAT "%9.7" /end CHARACTERISTIC
/begin CHARACTERISTIC Tra_rVn6H_C "" VALUE 0x8006D330 Val_Ws16 0.6553500 VelToN -0.3276800 0.3276700 FORMAT "%9.7" /end CHARACTERISTIC
/begin CHARACTERISTIC Tra_rVn6L_C "" VALUE 0x8006D332 Val_Ws16 0.6553500 VelToN -0.3276800 0.3276700 FORMAT "%9.7" /end CHARACTERISTIC
/begin CHARACTERISTIC Tra_rVnRH_C "" VALUE 0x8006D334 Val_Ws16 0.6553500 VelToN -0.3276800 0.3276700 FORMAT "%9.7" /end CHARACTERISTIC
/begin CHARACTERISTIC Tra_rVnRL_C "" VALUE 0x8006D336 Val_Ws16 0.6553500 VelToN -0.3276800 0.3276700 FORMAT "%9.7" /end CHARACTERISTIC
/begin CHARACTERISTIC Tra_stLevPosD_C "" VALUE 0x8006D338 Val_Wu8 255.0 OneToOne 0.00 255.0 FORMAT "%5.1" /end CHARACTERISTIC
/begin CHARACTERISTIC Tra_swtLevPosSlct_CA "" VAL_BLK 0x8006D339 ValA_Wu8 255.0 OneToOne 0.00 255.0 FORMAT "%5.1" NUMBER 8 /end CHARACTERISTIC
/begin CHARACTERISTIC Tra_swtTypeSlct_CA "" VAL_BLK 0x8006D341 ValA_Wu8 255.0 OneToOne 0.00 255.0 FORMAT "%5.1" NUMBER 8 /end CHARACTERISTIC
/begin CHARACTERISTIC Tra_tClntDes_C "Parameter Kühlmitteltemperatur-Sollwert" VALUE 0x8007E4D6 Val_Ws16 6553.500 Temp_Cels -3549.940 3003.560 FORMAT "%8.3" /end CHARACTERISTIC
/begin CHARACTERISTIC Tra_tOilDfl_C "applikativer Defaultwert für die Getriebeöltemperatur" VALUE 0x8006D34A Val_Ws16 6553.500 Temp_Cels -3549.940 3003.560 FORMAT "%8.3" /end CHARACTERISTIC
/begin CHARACTERISTIC Tra_trqLos_C "Parameter Getriebeverlustmoment" VALUE 0x8006D34E Kw_Ws16 6553.500 Trq -3276.800 3276.700 FORMAT "%8.3" /end CHARACTERISTIC
/begin CHARACTERISTIC Tra_vMin_C "" VALUE 0x8006D34C Val_Ws16 655.3500 Vel -327.6800 327.6700 FORMAT "%8.4" /end CHARACTERISTIC
/begin MEASUREMENT Exh_stEgtTOxiCatUs_mp "" UBYTE OneToOne 1 100 0.00 255.0 FORMAT "%5.1" ECU_ADDRESS 0xC0001A7D /end MEASUREMENT
/begin MEASUREMENT Exh_stTmrPlausTOxiCatUs_mp "" UBYTE OneToOne 1 100 0.00 255.0 FORMAT "%5.1" ECU_ADDRESS 0xC0001A7E /end MEASUREMENT
/begin MEASUREMENT Exh_tAdapTOxiCatUs "" SWORD Temp_Cels 1 100 -3549.940 3003.560 FORMAT "%8.3" ECU_ADDRESS 0xD0006EC2 /end MEASUREMENT
/begin MEASUREMENT Exh_tAdapTPFltUs "" SWORD Temp_Cels 1 100 -3549.940 3003.560 FORMAT "%8.3" ECU_ADDRESS 0xD0006EC4 /end MEASUREMENT
/begin MEASUREMENT Exh_tDiffNegTOxiCatUs_mp "" SWORD TempDiff_Kelv 1 100 -3276.800 3276.700 FORMAT "%8.3" ECU_ADDRESS 0xC0001A80 /end MEASUREMENT
/begin MEASUREMENT Exh_tDiffNegTPFltUs_mp "" SWORD TempDiff_Kelv 1 100 -3276.800 3276.700 FORMAT "%8.3" ECU_ADDRESS 0xC0001A86 /end MEASUREMENT
/begin MEASUREMENT Exh_tDiffPosTOxiCatUs_mp "" SWORD TempDiff_Kelv 1 100 -3276.800 3276.700 FORMAT "%8.3" ECU_ADDRESS 0xC0001A82 /end MEASUREMENT
/begin MEASUREMENT Exh_tDiffPosTPFltUs_mp "" SWORD TempDiff_Kelv 1 100 -3276.800 3276.700 FORMAT "%8.3" ECU_ADDRESS 0xC0001A88 /end MEASUREMENT
/begin MEASUREMENT Exh_tDiffTPFltUs_mp "" SWORD TempDiff_Kelv 1 100 -3276.800 3276.700 FORMAT "%8.3" ECU_ADDRESS 0xC0001A8A /end MEASUREMENT
/begin MEASUREMENT Exh_tEGFldTPFltUs_mp "" SWORD Temp_Cels 1 100 -3549.940 3003.560 FORMAT "%8.3" ECU_ADDRESS 0xC0001A8C /end MEASUREMENT
/begin MEASUREMENT Exh_tModTOxiCatUs_mp "" SWORD Temp_Cels 1 100 -3549.940 3003.560 FORMAT "%8.3" ECU_ADDRESS 0xC0001A84 /end MEASUREMENT
/begin MEASUREMENT Exh_tOxiCatUs "" SWORD Temp_Cels 1 100 -3549.940 3003.560 FORMAT "%8.3" ECU_ADDRESS 0xD0006ED8 /end MEASUREMENT
/begin MEASUREMENT Exh_tPFltUs "" SWORD Temp_Cels 1 100 -3549.940 3003.560 FORMAT "%8.3" ECU_ADDRESS 0xD0006EDA /end MEASUREMENT
/begin MEASUREMENT Exh_tSensTOxiCatUs "" SWORD Temp_Cels 1 100 -3549.940 3003.560 FORMAT "%8.3" ECU_ADDRESS 0xD0006EE0 /end MEASUREMENT
/begin MEASUREMENT Exh_tSensTPFltUs "" SWORD Temp_Cels 1 100 -3549.940 3003.560 FORMAT "%8.3" ECU_ADDRESS 0xD0006EE2 /end MEASUREMENT
/begin MEASUREMENT Exh_uRawTOxiCatUs "" SWORD Volt 1 100 -6553.600 6553.400 FORMAT "%8.3" ECU_ADDRESS 0xD0006EE6 /end MEASUREMENT
/begin MEASUREMENT Exh_uRawTPFltUs "" SWORD Volt 1 100 -6553.600 6553.400 FORMAT "%8.3" ECU_ADDRESS 0xD0006EE8 /end MEASUREMENT
/begin MEASUREMENT PT_numTraGear "" UBYTE OneToOne 1 100 0.00 255.0 FORMAT "%5.1" ECU_ADDRESS 0xD0009131 /end MEASUREMENT
/begin MEASUREMENT PT_numTraGearDes "" UBYTE OneToOne 1 100 0.00 255.0 FORMAT "%5.1" ECU_ADDRESS 0xD0009132 /end MEASUREMENT
/begin MEASUREMENT PT_numTraParGear "" UBYTE OneToOne 1 100 0.00 255.0 FORMAT "%5.1" ECU_ADDRESS 0xD0009133 /end MEASUREMENT
/begin MEASUREMENT PT_rTraGear "" SWORD TransR 1 100 -327.6800 327.6700 FORMAT "%8.4" ECU_ADDRESS 0xD0007460 /end MEASUREMENT
/begin MEASUREMENT PT_rTraGearDes "" SWORD TransR 1 100 -327.6800 327.6700 FORMAT "%8.4" ECU_ADDRESS 0xD0007462 /end MEASUREMENT
/begin MEASUREMENT PT_rTraV2N "" SWORD VelToN 1 100 -0.3276800 0.3276700 FORMAT "%9.7" ECU_ADDRESS 0xD0007464 /end MEASUREMENT
/begin MEASUREMENT PT_stTraGrip "Kraftschlusszustand Getriebe" UBYTE OneToOne 1 100 0.00 255.0 FORMAT "%5.1" ECU_ADDRESS 0xD0009139 /end MEASUREMENT
/begin MEASUREMENT PT_stTraLoRng "" UBYTE OneToOne 1 100 0.00 255.0 FORMAT "%5.1" ECU_ADDRESS 0xD000913B /end MEASUREMENT
/begin MEASUREMENT PT_stTraRevGear "" UBYTE OneToOne 1 100 0.00 255.0 FORMAT "%5.1" ECU_ADDRESS 0xD000913C /end MEASUREMENT
/begin MEASUREMENT PT_stTraShftOp "" UBYTE OneToOne 1 100 0.00 255.0 FORMAT "%5.1" ECU_ADDRESS 0xD000913D /end MEASUREMENT
/begin MEASUREMENT Rail_facSetPointAPSCor "Gewichtungsfaktor für atmosphärendruckabhängige Sollwertkorrektur des Raildrucks" SWORD Fact 1 100 -4.000000 3.999878 FORMAT "%8.6" ECU_ADDRESS 0xD00074B0 /end MEASUREMENT
/begin MEASUREMENT Rail_facSetPointAPSCorRgn "Gewichtungsfaktor für atmosphärendruckabhängige Sollwertkorrektur des Raildrucks im Regenerationsbetrieb" SWORD Fact 1 100 -4.000000 3.999878 FORMAT "%8.6" ARRAY_SIZE 2 ECU_ADDRESS 0xD00074B2 /end MEASUREMENT
/begin MEASUREMENT Rail_facSetPointATSCor "Gewichtungsfaktor für ansauglufttemperaturabhängige Sollwertkorrektur des Raildrucks" SWORD Fact 1 100 -4.000000 3.999878 FORMAT "%8.6" ECU_ADDRESS 0xD00074B6 /end MEASUREMENT
/begin MEASUREMENT Rail_facSetPointATSCorRgn "Gewichtungsfaktor für ansauglufttemperaturabhängige Sollwertkorrektur des Raildrucks im Regenerationsbetrieb" SWORD Fact 1 100 -4.000000 3.999878 FORMAT "%8.6" ARRAY_SIZE 2 ECU_ADDRESS 0xD00074B8 /end MEASUREMENT
/begin MEASUREMENT Rail_facSetPointETSCor "Gewichtungsfaktor für motortemperaturabhängige Sollwertkorrektur des Raildrucks" SWORD Fact 1 100 -4.000000 3.999878 FORMAT "%8.6" ECU_ADDRESS 0xD00074BC /end MEASUREMENT
/begin MEASUREMENT Rail_facSetPointETSCorRgn "Gewichtungsfaktor für motortemperaturabhängige Sollwertkorrektur des Raildrucks im Regenerationsbetrieb" SWORD Fact 1 100 -4.000000 3.999878 FORMAT "%8.6" ARRAY_SIZE 2 ECU_ADDRESS 0xD00074BE /end MEASUREMENT
/begin MEASUREMENT Rail_facSetPointTempCorRgn_mp "Summe der temperaturabhängigen Korrekturfaktoren für den Raildruck im Regenerationsbetrieb" SWORD Fact 1 100 -4.000000 3.999878 FORMAT "%8.6" ARRAY_SIZE 2 ECU_ADDRESS 0xC0001948 /end MEASUREMENT
/begin MEASUREMENT Rail_pSetPointAPSCorRgn_mp "Raildruck-Korrekturwert im Regenerationsbetrieb, abhängig vom Atmosphärendruck" SWORD Pres_Rail 1 100 -3276.800 2000.000 FORMAT "%5.3" ARRAY_SIZE 2 ECU_ADDRESS 0xC000194C /end MEASUREMENT
/begin MEASUREMENT Rail_pSetPointBaseStrt_mp "Messpunkt für das Basiskennfeld des Raildrucksollwerts beim Start" SWORD Pres_Rail 1 100 -3276.800 2000.000 FORMAT "%5.3" ECU_ADDRESS 0xC0001954 /end MEASUREMENT
/begin MEASUREMENT Rail_pSetPointCorStrt_mp "Raildrucksollwert beim Start" SWORD Pres_Rail 1 100 -3276.800 2000.000 FORMAT "%5.3" ECU_ADDRESS 0xC0001956 /end MEASUREMENT
/begin MEASUREMENT Rail_pSetPointEnvCorRgn "Raildruck-Korrekturwert, abhängig von den Umgebungsbedingungen im Regenerationsbetrieb" SWORD Pres_Rail 1 100 -3276.800 2000.000 FORMAT "%5.3" ARRAY_SIZE 2 ECU_ADDRESS 0xD00074D0 /end MEASUREMENT
/begin MEASUREMENT Rail_pSetPointSubst "Externe Anforderung für den Raildruck-Sollwert" SWORD Pres_Rail 1 100 -3276.800 2000.000 FORMAT "%5.3" ECU_ADDRESS 0xD00074E6 /end MEASUREMENT
/begin MEASUREMENT Rail_pSetPointTempCorRgn_mp "Gewichtete Korrekturen abhängig von der Motortemperatur für die Raildrucksollwertbildung im Regenerationsbetrieb" SWORD Pres_Rail 1 100 -3276.800 2000.000 FORMAT "%5.3" ARRAY_SIZE 2 ECU_ADDRESS 0xC0001950 /end MEASUREMENT
/begin MEASUREMENT Rail_pZFCInit_mp "anfänglicher ZFC Raildrucksollwert für PT1 Filter" SWORD Pres_Rail 1 100 -3276.800 2000.000 FORMAT "%5.3" ECU_ADDRESS 0xC0001958 /end MEASUREMENT
/begin MEASUREMENT Rail_stPresMinZFC_mp "Zustand des Automaten Bestimmung der Mindestschwelle des Raildrucks" UBYTE OneToOne 1 100 0.00 255.0 FORMAT "%5.1" ECU_ADDRESS 0xC000195A /end MEASUREMENT
/begin MEASUREMENT Rail_tAir "Ansauglufttemperatur für das Subsystem Rail" SWORD Temp_Cels 1 100 -3549.940 3003.560 FORMAT "%8.3" ECU_ADDRESS 0xD00074E8 /end MEASUREMENT
/begin MEASUREMENT Reset_Env.adLoc "" ULONG OneToOne 1 100 0.00 4294967295.00 FORMAT "%13.2" ECU_ADDRESS 0xD0004BA0 /end MEASUREMENT
/begin MEASUREMENT Reset_Env.xUserValue "" ULONG OneToOne 1 100 0.00 4294967295.00 FORMAT "%13.2" ECU_ADDRESS 0xD0004BA4 /end MEASUREMENT
/begin MEASUREMENT Reset_Env.xId "" UWORD OneToOne 1 100 0.00 65535.00 FORMAT "%8.2" ECU_ADDRESS 0xD0004BA8 /end MEASUREMENT
/begin MEASUREMENT Reset_Env.xGrp "" UBYTE OneToOne 1 100 0.00 255.0 FORMAT "%5.1" ECU_ADDRESS 0xD0004BAA /end MEASUREMENT
/begin MEASUREMENT Reset_Env.ctRst "" UBYTE OneToOne 1 100 0.00 255.0 FORMAT "%5.1" ECU_ADDRESS 0xD0004BAB /end MEASUREMENT
/begin MEASUREMENT Reset_xHistBuf "" UWORD OneToOne 1 100 0.00 65535.00 FORMAT "%8.2" ARRAY_SIZE 8 ECU_ADDRESS 0xD000C98A /end MEASUREMENT
/begin MEASUREMENT RngMod_nLIDvtn_mp "Regelabweichung Leerlaufregler für Verlustmomentenkompensation" SWORD EngN 1 100 -16384.00 16383.50 FORMAT "%8.2" ECU_ADDRESS 0xC000195C /end MEASUREMENT
/begin MEASUREMENT RngMod_stAdap "Status Verlustmomentenadaption" UBYTE OneToOne 1 100 0.00 255.0 FORMAT "%5.1" ECU_ADDRESS 0xD0009153 /end MEASUREMENT
/begin MEASUREMENT RngMod_stDrvState_mp "Zustandsvariable der Betriebszustanderkennung der Verlustmomentenkompensation" UBYTE OneToOne 1 100 0.00 255.0 FORMAT "%5.1" ECU_ADDRESS 0xC000195E /end MEASUREMENT
/begin MEASUREMENT RngMod_stGenRel_mp "Zustandsvariable der generellen Freigabebedingungen der Verlustmomentenkompensation" UBYTE OneToOne 1 100 0.00 255.0 FORMAT "%5.1" ECU_ADDRESS 0xC000195F /end MEASUREMENT
/begin MEASUREMENT RngMod_stLIStat_mp "Zustandsvariable Leerlaufregler eingeschwungen" UBYTE OneToOne 1 100 0.00 255.0 FORMAT "%5.1" ECU_ADDRESS 0xC0001960 /end MEASUREMENT
/begin MEASUREMENT RngMod_trqClthMax "maximales Kupplungsmoment" SWORD Trq 1 100 -3276.800 3276.700 FORMAT "%8.3" ECU_ADDRESS 0xD00074EE /end MEASUREMENT
/begin MEASUREMENT RngMod_trqClthMin "minimales Kupplungsmoment" SWORD Trq 1 100 -3276.800 3276.700 FORMAT "%8.3" ECU_ADDRESS 0xD00074F0 /end MEASUREMENT
/begin MEASUREMENT RngMod_trqComp "zu kompensierendes Moment" SWORD Trq 1 100 -3276.800 3276.700 FORMAT "%8.3" ECU_ADDRESS 0xD00074F4 /end MEASUREMENT
/begin MEASUREMENT RngMod_trqDiffAdap "Adaptiertes Differenzverlustmoment" SWORD Trq 1 100 -3276.800 3276.700 FORMAT "%8.3" ECU_ADDRESS 0xD00074F6 /end MEASUREMENT
/begin MEASUREMENT RngMod_trqFltACGear_mp "Adaptionsfilterausgang: Klima an / Gang eingelegt" SWORD Trq 1 100 -3276.800 3276.700 FORMAT "%8.3" ECU_ADDRESS 0xC0001962 /end MEASUREMENT
/begin MEASUREMENT RngMod_trqFltACNoGear_mp "Adaptionsfilterausgang: Klima an / Kein Gang eingelegt" SWORD Trq 1 100 -3276.800 3276.700 FORMAT "%8.3" ECU_ADDRESS 0xC0001964 /end MEASUREMENT
/begin MEASUREMENT RngMod_trqFltNoACGear_mp "Adaptionsfilterausgang: Klima aus / Gang eingelegt" SWORD Trq 1 100 -3276.800 3276.700 FORMAT "%8.3" ECU_ADDRESS 0xC0001966 /end MEASUREMENT
/begin MEASUREMENT RngMod_trqFltNoACNoGear_mp "Adaptionsfilterausgang: Klima aus / Kein Gang eingelegt" SWORD Trq 1 100 -3276.800 3276.700 FORMAT "%8.3" ECU_ADDRESS 0xC0001968 /end MEASUREMENT
/begin MEASUREMENT RngMod_trqFrc "aktuelles Reibmoment" SWORD Trq 1 100 -3276.800 3276.700 FORMAT "%8.3" ECU_ADDRESS 0xD00074F8 /end MEASUREMENT
/begin MEASUREMENT RngMod_trqLosAdap "Adaptiertes Gesamtverlustmoment des Motors" SWORD Trq 1 100 -3276.800 3276.700 FORMAT "%8.3" ECU_ADDRESS 0xD00074FA /end MEASUREMENT
/begin MEASUREMENT RngMod_trqLosCompl_mp "Summe aller Motorverlustmomente inkl. Momentenbedarf der Wandlerkupplung" SWORD Trq 1 100 -3276.800 3276.700 FORMAT "%8.3" ECU_ADDRESS 0xC000196A /end MEASUREMENT
/begin MEASUREMENT RngMod_trqLosDiff_mp "Differenzmoment zwischen Istmoment und vorgesteuertem Verlustmoment" SWORD Trq 1 100 -3276.800 3276.700 FORMAT "%8.3" ECU_ADDRESS 0xC000196C /end MEASUREMENT
/begin MEASUREMENT RngMod_trqLossComp "zu kompensierendes Moment" SWORD Trq 1 100 -3276.800 3276.700 FORMAT "%8.3" ECU_ADDRESS 0xD00074FC /end MEASUREMENT
/begin MEASUREMENT RngMod_trqMax "Momentintervall Maximum" SWORD Trq 1 100 -3276.800 3276.700 FORMAT "%8.3" ECU_ADDRESS 0xD00074FE /end MEASUREMENT
/begin MEASUREMENT RngMod_trqMin "Schleppmoment (minimales Moment)" SWORD Trq 1 100 -3276.800 3276.700 FORMAT "%8.3" ECU_ADDRESS 0xD0007500 /end MEASUREMENT
/begin MEASUREMENT RngMod_tTrqFrc_mp "Eingangstemperatur in Kennfeld zur Bestimmung des aktuellen Reibmoments" SWORD Temp_Cels 1 100 -3549.940 3003.560 FORMAT "%8.3" ECU_ADDRESS 0xC000196E /end MEASUREMENT
/begin MEASUREMENT Rtmo_ctInterrupt_u16 "Interrupt occurence in this sample" UWORD OneToOne 1 100 0.00 65535.00 FORMAT "%8.2" ECU_ADDRESS 0xC0001970 /end MEASUREMENT
/begin MEASUREMENT Rtmo_ctReentrantSample_u32 "Reentrant samples" ULONG OneToOne 1 100 0.00 4294967295.00 FORMAT "%13.2" ECU_ADDRESS 0xC0001974 /end MEASUREMENT
/begin MEASUREMENT Rtmo_ctSampleProc_u8 "count of measurements" UBYTE OneToOne 1 100 0.00 255.0 FORMAT "%5.1" ECU_ADDRESS 0xC0001978 /end MEASUREMENT
/begin MEASUREMENT Rtmo_ctSample_u16 "samples in the specified sampling-time" UWORD OneToOne 1 100 0.00 65535.00 FORMAT "%8.2" ECU_ADDRESS 0xC000197A /end MEASUREMENT
/begin MEASUREMENT Rtmo_tiAvrg_Tick "Average runtime" ULONG Rtmo_Time_us 1 100 0.00 57266230.6000 FORMAT "%13.4" ECU_ADDRESS 0xC000197C /end MEASUREMENT
/begin MEASUREMENT Rtmo_tiMaxCalldist_Tick "Maximal calldistance" ULONG Rtmo_Time_us 1 100 0.00 57266230.6000 FORMAT "%13.4" ECU_ADDRESS 0xC0001980 /end MEASUREMENT
/begin MEASUREMENT Rtmo_tiMax_Tick "Maximal runtime" ULONG Rtmo_Time_us 1 100 0.00 57266230.6000 FORMAT "%13.4" ECU_ADDRESS 0xC0001984 /end MEASUREMENT
/begin MEASUREMENT Rtmo_tiMinCalldist_Tick "Minimal calldistance" ULONG Rtmo_Time_us 1 100 0.00 57266230.6000 FORMAT "%13.4" ECU_ADDRESS 0xC0001988 /end MEASUREMENT
/begin MEASUREMENT Rtmo_tiMin_Tick "Minimal runtime" ULONG Rtmo_Time_us 1 100 0.00 57266230.6000 FORMAT "%13.4" ECU_ADDRESS 0xC000198C /end MEASUREMENT
/begin MEASUREMENT sia_500ms_mp "" UBYTE OneToOne 1 100 0.00 255.0 FORMAT "%5.1" ECU_ADDRESS 0xC0001990 /end MEASUREMENT
/begin MEASUREMENT Sia_bFlPmpLck "" UBYTE OneToOne 1 100 0.00 255.0 FORMAT "%5.1" ECU_ADDRESS 0xD000915D /end MEASUREMENT
/begin MEASUREMENT Sia_bFshPrgLck "" UBYTE OneToOne 1 100 0.00 255.0 FORMAT "%5.1" ECU_ADDRESS 0xD000915E /end MEASUREMENT
/begin MEASUREMENT Sia_bIgnLck "" UBYTE OneToOne 1 100 0.00 255.0 FORMAT "%5.1" ECU_ADDRESS 0xD000915F /end MEASUREMENT
/begin MEASUREMENT Sia_bInjLck "" UBYTE OneToOne 1 100 0.00 255.0 FORMAT "%5.1" ECU_ADDRESS 0xD0009160 /end MEASUREMENT
/begin MEASUREMENT Sia_bStaLck "" UBYTE OneToOne 1 100 0.00 255.0 FORMAT "%5.1" ECU_ADDRESS 0xD0009161 /end MEASUREMENT
/begin MEASUREMENT Sia_bThrVlvLck "" UBYTE OneToOne 1 100 0.00 255.0 FORMAT "%5.1" ECU_ADDRESS 0xD0009162 /end MEASUREMENT
/begin MEASUREMENT sia_B_Auth_Cycl "" UBYTE OneToOne 1 100 0.00 255.0 FORMAT "%5.1" ECU_ADDRESS 0xD00091A6 /end MEASUREMENT
/begin MEASUREMENT sia_B_Auth_Delay "" UBYTE OneToOne 1 100 0.00 255.0 FORMAT "%5.1" ECU_ADDRESS 0xD00091A7 /end MEASUREMENT
/begin MEASUREMENT sia_B_Calc_Chal "" UBYTE OneToOne 1 100 0.00 255.0 FORMAT "%5.1" ECU_ADDRESS 0xD00091A8 /end MEASUREMENT
/begin MEASUREMENT sia_B_Calc_Resp "" UBYTE OneToOne 1 100 0.00 255.0 FORMAT "%5.1" ECU_ADDRESS 0xD00091A9 /end MEASUREMENT
/begin MEASUREMENT sia_B_Chal_Rdy "" UBYTE OneToOne 1 100 0.00 255.0 FORMAT "%5.1" ECU_ADDRESS 0xD00091AA /end MEASUREMENT
/begin MEASUREMENT sia_B_Cmp_Ok "" UBYTE OneToOne 1 100 0.00 255.0 FORMAT "%5.1" ECU_ADDRESS 0xD00091AB /end MEASUREMENT
/begin MEASUREMENT sia_B_Cmp_Rdy "" UBYTE OneToOne 1 100 0.00 255.0 FORMAT "%5.1" ECU_ADDRESS 0xD00091AC /end MEASUREMENT
/begin MEASUREMENT sia_B_Hlp_Cycl "" UBYTE OneToOne 1 100 0.00 255.0 FORMAT "%5.1" ECU_ADDRESS 0xD00091AD /end MEASUREMENT
/begin MEASUREMENT Sia_B_kl15 "" UBYTE OneToOne 1 100 0.00 255.0 FORMAT "%5.1" ECU_ADDRESS 0xD0009159 /end MEASUREMENT
/begin MEASUREMENT sia_B_Load_SKA "" UBYTE OneToOne 1 100 0.00 255.0 FORMAT "%5.1" ECU_ADDRESS 0xD00091AE /end MEASUREMENT
/begin MEASUREMENT sia_B_Load_ZZ "" UBYTE OneToOne 1 100 0.00 255.0 FORMAT "%5.1" ECU_ADDRESS 0xD00091AF /end MEASUREMENT
/begin MEASUREMENT sia_B_New_Data "" UBYTE OneToOne 1 100 0.00 255.0 FORMAT "%5.1" ECU_ADDRESS 0xD00091B0 /end MEASUREMENT
/begin MEASUREMENT Sia_B_nmot "" UBYTE OneToOne 1 100 0.00 255.0 FORMAT "%5.1" ECU_ADDRESS 0xD000915A /end MEASUREMENT
/begin MEASUREMENT Sia_B_pwf "" UBYTE OneToOne 1 100 0.00 255.0 FORMAT "%5.1" ECU_ADDRESS 0xD000915B /end MEASUREMENT
/begin MEASUREMENT sia_B_SKA_Rdy "" UBYTE OneToOne 1 100 0.00 255.0 FORMAT "%5.1" ECU_ADDRESS 0xD00091B1 /end MEASUREMENT
/begin MEASUREMENT Sia_B_stkeyvld "" UBYTE OneToOne 1 100 0.00 255.0 FORMAT "%5.1" ECU_ADDRESS 0xD000915C /end MEASUREMENT
/begin MEASUREMENT sia_B_Wr_SKA "" UBYTE OneToOne 1 100 0.00 255.0 FORMAT "%5.1" ECU_ADDRESS 0xD00091B2 /end MEASUREMENT
/begin MEASUREMENT sia_B_Wr_ZZ "" UBYTE OneToOne 1 100 0.00 255.0 FORMAT "%5.1" ECU_ADDRESS 0xD00091B3 /end MEASUREMENT
/begin MEASUREMENT sia_B_ZZ_Rdy "" UBYTE OneToOne 1 100 0.00 255.0 FORMAT "%5.1" ECU_ADDRESS 0xD00091B4 /end MEASUREMENT
/begin MEASUREMENT sia_Check_Cond_mp "" UBYTE OneToOne 1 100 0.00 255.0 FORMAT "%5.1" ECU_ADDRESS 0xC0001991 /end MEASUREMENT
/begin MEASUREMENT sia_Com_Cnt "" UBYTE OneToOne 1 100 0.00 255.0 FORMAT "%5.1" ECU_ADDRESS 0xD00091B5 /end MEASUREMENT
/begin MEASUREMENT sia_Com_Command_mp "" UBYTE OneToOne 1 100 0.00 255.0 FORMAT "%5.1" ECU_ADDRESS 0xC0001992 /end MEASUREMENT
/begin MEASUREMENT sia_Com_Ctrl "" UBYTE OneToOne 1 100 0.00 255.0 FORMAT "%5.1" ECU_ADDRESS 0xD00091B6 /end MEASUREMENT
/begin MEASUREMENT sia_Com_Status_mp "" UBYTE OneToOne 1 100 0.00 255.0 FORMAT "%5.1" ECU_ADDRESS 0xC0001993 /end MEASUREMENT
/begin MEASUREMENT sia_Com_Timer "" UBYTE OneToOne 1 100 0.00 255.0 FORMAT "%5.1" ECU_ADDRESS 0xD00091B7 /end MEASUREMENT
/begin MEASUREMENT Sia_DataEepProt_command_mp "" UBYTE OneToOne 1 100 0.00 255.0 FORMAT "%5.1" ECU_ADDRESS 0xC0001996 /end MEASUREMENT
/begin MEASUREMENT Sia_DataEepProt_length_mp "" UBYTE OneToOne 1 100 0.00 255.0 FORMAT "%5.1" ECU_ADDRESS 0xC0001997 /end MEASUREMENT
/begin MEASUREMENT Sia_DataEepProt_status_mp "" UBYTE OneToOne 1 100 0.00 255.0 FORMAT "%5.1" ECU_ADDRESS 0xC0001998 /end MEASUREMENT
/begin MEASUREMENT sia_Data_Buf_Chal "" UBYTE OneToOne 1 100 0.00 255.0 FORMAT "%5.1" ARRAY_SIZE 16 ECU_ADDRESS 0xD00091B8 /end MEASUREMENT
/begin MEASUREMENT sia_Data_Buf_Cmp "" UBYTE OneToOne 1 100 0.00 255.0 FORMAT "%5.1" ARRAY_SIZE 16 ECU_ADDRESS 0xD00091C8 /end MEASUREMENT
/begin MEASUREMENT sia_Data_Buf_Resp "" UBYTE OneToOne 1 100 0.00 255.0 FORMAT "%5.1" ARRAY_SIZE 6 ECU_ADDRESS 0xD00091D8 /end MEASUREMENT
/begin MEASUREMENT sia_Elem_No "" UBYTE OneToOne 1 100 0.00 255.0 FORMAT "%5.1" ECU_ADDRESS 0xD00091DE /end MEASUREMENT
/begin MEASUREMENT sia_Error1_Tmp "" ULONG OneToOne 1 100 0.00 4294967295.00 FORMAT "%13.2" ECU_ADDRESS 0xD0004604 /end MEASUREMENT
/begin MEASUREMENT Sia_errorCommand_mp "" ULONG OneToOne 1 100 0.00 4294967295.00 FORMAT "%13.2" ECU_ADDRESS 0xC000199C /end MEASUREMENT
/begin MEASUREMENT sia_Error_1 "" ULONG OneToOne 1 100 0.00 4294967295.00 FORMAT "%13.2" ECU_ADDRESS 0xD0004608 /end MEASUREMENT
/begin MEASUREMENT sia_Error_2 "" ULONG OneToOne 1 100 0.00 4294967295.00 FORMAT "%13.2" ECU_ADDRESS 0xD000460C /end MEASUREMENT
/begin MEASUREMENT sia_Error_Array "" ULONG OneToOne 1 100 0.00 4294967295.00 FORMAT "%13.2" ARRAY_SIZE 2 ECU_ADDRESS 0xD0004610 /end MEASUREMENT
/begin MEASUREMENT Sia_numDataByte_mp "" UBYTE OneToOne 1 100 0.00 255.0 FORMAT "%5.1" ECU_ADDRESS 0xC00019A0 /end MEASUREMENT
/begin MEASUREMENT Sia_numDfp_mp "" UBYTE OneToOne 1 100 0.00 255.0 FORMAT "%5.1" ECU_ADDRESS 0xC00019A1 /end MEASUREMENT
/begin MEASUREMENT sia_NvMem_Cd "" UBYTE OneToOne 1 100 0.00 255.0 FORMAT "%5.1" ECU_ADDRESS 0xD00091DF /end MEASUREMENT
/begin MEASUREMENT sia_NvMem_Cd_St "" UBYTE OneToOne 1 100 0.00 255.0 FORMAT "%5.1" ECU_ADDRESS 0xD00091E0 /end MEASUREMENT
/begin MEASUREMENT sia_NvMem_Cnt "" UBYTE OneToOne 1 100 0.00 255.0 FORMAT "%5.1" ECU_ADDRESS 0xD00091E1 /end MEASUREMENT
/begin MEASUREMENT sia_Release "" UBYTE OneToOne 1 100 0.00 255.0 FORMAT "%5.1" ECU_ADDRESS 0xD00091E2 /end MEASUREMENT
/begin MEASUREMENT sia_Resp_Rdy_mp "" UBYTE OneToOne 1 100 0.00 255.0 FORMAT "%5.1" ECU_ADDRESS 0xC0001994 /end MEASUREMENT
/begin MEASUREMENT sia_RndOutb "" UBYTE OneToOne 1 100 0.00 255.0 FORMAT "%5.1" ECU_ADDRESS 0xD00091E3 /end MEASUREMENT
/begin MEASUREMENT sia_Rnd_D "" UBYTE OneToOne 1 100 0.00 255.0 FORMAT "%5.1" ARRAY_SIZE 6 ECU_ADDRESS 0xD00091E4 /end MEASUREMENT
/begin MEASUREMENT sia_Rnd_ZZ "" UBYTE OneToOne 1 100 0.00 255.0 FORMAT "%5.1" ARRAY_SIZE 6 ECU_ADDRESS 0xD00091EA /end MEASUREMENT
/begin MEASUREMENT sia_Secret_Key_A "" UBYTE OneToOne 1 100 0.00 255.0 FORMAT "%5.1" ARRAY_SIZE 16 ECU_ADDRESS 0xD0009201 /end MEASUREMENT
/begin MEASUREMENT sia_SK_Hlp_Ar "" UBYTE OneToOne 1 100 0.00 255.0 FORMAT "%5.1" ARRAY_SIZE 16 ECU_ADDRESS 0xD00091F0 /end MEASUREMENT
/begin MEASUREMENT sia_SM "" UBYTE OneToOne 1 100 0.00 255.0 FORMAT "%5.1" ECU_ADDRESS 0xD0009200 /end MEASUREMENT
/begin MEASUREMENT sia_sm_mp "" UBYTE OneToOne 1 100 0.00 255.0 FORMAT "%5.1" ECU_ADDRESS 0xC0001995 /end MEASUREMENT
/begin MEASUREMENT Sia_stEepOrder_mp "" UBYTE OneToOne 1 100 0.00 255.0 FORMAT "%5.1" ECU_ADDRESS 0xC00019A2 /end MEASUREMENT
/begin MEASUREMENT Sia_stType_mp "" UBYTE OneToOne 1 100 0.00 255.0 FORMAT "%5.1" ECU_ADDRESS 0xC00019A3 /end MEASUREMENT
/begin MEASUREMENT sia_Tstr_Array "" UBYTE OneToOne 1 100 0.00 255.0 FORMAT "%5.1" ARRAY_SIZE 16 ECU_ADDRESS 0xD0009212 /end MEASUREMENT
/begin MEASUREMENT sia_Tstr_Cnt "" UBYTE OneToOne 1 100 0.00 255.0 FORMAT "%5.1" ECU_ADDRESS 0xD0009222 /end MEASUREMENT
/begin MEASUREMENT sia_TS_Res "" UBYTE OneToOne 1 100 0.00 255.0 FORMAT "%5.1" ECU_ADDRESS 0xD0009211 /end MEASUREMENT
/begin MEASUREMENT sia_t_Auth_Cycl "" UBYTE OneToOne 1 100 0.00 255.0 FORMAT "%5.1" ECU_ADDRESS 0xD0009223 /end MEASUREMENT
/begin MEASUREMENT sia_t_Auth_Delay "" UBYTE OneToOne 1 100 0.00 255.0 FORMAT "%5.1" ECU_ADDRESS 0xD0009224 /end MEASUREMENT
/begin MEASUREMENT Sil_stDemFlap_mp "" UBYTE OneToOne 1 100 0.00 255.0 FORMAT "%5.1" ECU_ADDRESS 0xC00019A4 /end MEASUREMENT
/begin MEASUREMENT SmkLim_mAirPerCyl "Luftmasse für Rauchbegrenzung" SWORD AirMassPerCyl 1 100 -3276.800 3276.700 FORMAT "%8.3" ECU_ADDRESS 0xD0007508 /end MEASUREMENT
/begin MEASUREMENT SmkLim_mAirPerCylLim_mp "begrenzte Luftmasse" SWORD AirMassPerCyl 1 100 -3276.800 3276.700 FORMAT "%8.3" ECU_ADDRESS 0xC00019A6 /end MEASUREMENT
/begin MEASUREMENT SmkLim_qFullLdRgl "Korrekturmenge der Volllastregelung" SWORD InjMass 1 100 -327.6800 327.6700 FORMAT "%8.4" ECU_ADDRESS 0xD000750A /end MEASUREMENT
/begin MEASUREMENT SmkLim_qLimSmk "Begrenzungsmenge zur Rauchbegrenzung" SWORD InjMass 1 100 -327.6800 327.6700 FORMAT "%8.4" ECU_ADDRESS 0xD000750C /end MEASUREMENT
/begin MEASUREMENT SmkLim_qLimSmkBas_mp "Basiswert der maximal zulässigen Kraftstoffmenge der Rauchbegrenzung" SWORD InjMass 1 100 -327.6800 327.6700 FORMAT "%8.4" ECU_ADDRESS 0xC00019A8 /end MEASUREMENT
/begin MEASUREMENT SmkLim_rLamFullLd_mp "Lambda-Wert der dynamischen Vollasterhöhung" SWORD lambda 1 100 -32.76800 32.76700 FORMAT "%8.5" ECU_ADDRESS 0xC00019AA /end MEASUREMENT
/begin MEASUREMENT SmkLim_rLamSet "Stellgröße für Lambda-Regler" SWORD lambda 1 100 -32.76800 32.76700 FORMAT "%8.5" ECU_ADDRESS 0xD000750E /end MEASUREMENT
/begin MEASUREMENT SmkLim_rLamSmk_mp "Lambda-Wert der Rauchbegrenzung" SWORD lambda 1 100 -32.76800 32.76700 FORMAT "%8.5" ECU_ADDRESS 0xC00019AC /end MEASUREMENT
/begin MEASUREMENT SmkLim_rLamUnLim_mp "unbegrenztes minimal zulässiges Lambda" SWORD lambda 1 100 -32.76800 32.76700 FORMAT "%8.5" ECU_ADDRESS 0xC00019AE /end MEASUREMENT
/begin MEASUREMENT SmkLim_tSmkLim_mp "ausgewählte Temperatur aus dem Motortemperaturfeld" SWORD Temp_Cels 1 100 -3549.940 3003.560 FORMAT "%8.3" ECU_ADDRESS 0xC00019B0 /end MEASUREMENT
/begin MEASUREMENT SpdGov_nSetPHi "Drehzahlarray für obere Solldrehzahlen" SWORD EngN 1 100 -16384.00 16383.50 FORMAT "%8.2" ARRAY_SIZE 3 ECU_ADDRESS 0xD0007510 /end MEASUREMENT
/begin MEASUREMENT SpdGov_nSetPLo "Drehzahlarray für untere Solldrehzahlen" SWORD EngN 1 100 -16384.00 16383.50 FORMAT "%8.2" ARRAY_SIZE 3 ECU_ADDRESS 0xD0007516 /end MEASUREMENT
/begin MEASUREMENT SpdGov_st "Statusinformation des SpdGov" UWORD OneToOne 1 100 0.00 65535.00 FORMAT "%8.2" ECU_ADDRESS 0xD0007690 /end MEASUREMENT
/begin MEASUREMENT SpdGov_stMoLim_mp "Statusinformation, ob eine Drehmomentenbegrenzung durch Ebene 2 erfolgt (Bit0: SpdGov_trqSet, Bit1: SpdGov_trqLead, Bit2: SpdGov_trqFlt)" UWORD OneToOne 1 100 0.00 65535.00 FORMAT "%8.2" ECU_ADDRESS 0xC00019B2 /end MEASUREMENT
/begin MEASUREMENT SpdGov_trqFlt "gefiltertes Solldrehmoment des SpdGov" SWORD Trq 1 100 -3276.800 3276.700 FORMAT "%8.3" ECU_ADDRESS 0xD000751C /end MEASUREMENT
/begin MEASUREMENT SpdGov_trqInrLimSet "Solldrehmoment des SpdGov für die Begrenzung des Führungsformer (ASDrf) Eingangs" SWORD Trq 1 100 -3276.800 3276.700 FORMAT "%8.3" ECU_ADDRESS 0xD000751E /end MEASUREMENT
/begin MEASUREMENT SpdGov_trqLead "Solldrehmoment des SpdGov auf dem Luftpfad" SWORD Trq 1 100 -3276.800 3276.700 FORMAT "%8.3" ECU_ADDRESS 0xD0007520 /end MEASUREMENT
/begin MEASUREMENT SpdGov_trqSet "Solldrehmoment des SpdGov auf dem Kraftstoffpfad" SWORD Trq 1 100 -3276.800 3276.700 FORMAT "%8.3" ECU_ADDRESS 0xD0007522 /end MEASUREMENT
/begin MEASUREMENT SSEUI_stStopStrtEna "Schalter Stopp-Start Betrieb (SSE) ein (1) / aus (0)" UBYTE OneToOne 1 100 0.00 255.0 FORMAT "%5.1" ECU_ADDRESS 0xD0009154 /end MEASUREMENT
/begin MEASUREMENT StAPmp_phiDiffStrgWhl "Differenz des Lenkradwinkels zum Maximum" SWORD Angle 1 100 -1024.000 1023.969 FORMAT "%8.3" ECU_ADDRESS 0xD0007524 /end MEASUREMENT
/begin MEASUREMENT StAPmp_phiDiffStrgWhl_mp "Differenz des Lenkradwinkels zum Maximum" SWORD Angle 1 100 -1024.000 1023.969 FORMAT "%8.3" ECU_ADDRESS 0xC00019B4 /end MEASUREMENT
/begin MEASUREMENT StAPmp_phiStrgWhlAbs "Betrag des Lenkwinkelsignals" SWORD Angle 1 100 -1024.000 1023.969 FORMAT "%8.3" ECU_ADDRESS 0xD0007526 /end MEASUREMENT
/begin MEASUREMENT StAPmp_phiStrgWhlAbs_mp "Betrag des Lenkwinkelsignals" SWORD Angle 1 100 -1024.000 1023.969 FORMAT "%8.3" ECU_ADDRESS 0xC00019B6 /end MEASUREMENT
/begin MEASUREMENT StAPmp_stHysDes_mp "Status Hysterese" SWORD OneToOne 1 100 -32768.00 32767.00 FORMAT "%8.2" ECU_ADDRESS 0xC00019B8 /end MEASUREMENT
/begin MEASUREMENT StAPmp_stHysResv_mp "Status Hysterese" SWORD OneToOne 1 100 -32768.00 32767.00 FORMAT "%8.2" ECU_ADDRESS 0xC00019B9 /end MEASUREMENT
/begin MEASUREMENT StAPmp_trqBas_mp "Basis-Moment" SWORD Trq 1 100 -3276.800 3276.700 FORMAT "%8.3" ECU_ADDRESS 0xC00019BA /end MEASUREMENT
/begin MEASUREMENT StAPmp_trqDesLim_mp "Ist-Moment nach Limiter" SWORD Trq 1 100 -3276.800 3276.700 FORMAT "%8.3" ECU_ADDRESS 0xC00019BC /end MEASUREMENT
/begin MEASUREMENT StAPmp_trqDesWhlMaxFac_mp "Ist-Moment nach Skalierung" SWORD Trq 1 100 -3276.800 3276.700 FORMAT "%8.3" ECU_ADDRESS 0xC00019BE /end MEASUREMENT
/begin MEASUREMENT StAPmp_trqDes_mp "Gewünschtes Ist-Moment" SWORD Trq 1 100 -3276.800 3276.700 FORMAT "%8.3" ECU_ADDRESS 0xC00019C0 /end MEASUREMENT
/begin MEASUREMENT StAPmp_trqDynRaw_mp "Rohwert des dynamischen Momentes" SWORD Trq 1 100 -3276.800 3276.700 FORMAT "%8.3" ECU_ADDRESS 0xC00019C2 /end MEASUREMENT
/begin MEASUREMENT StAPmp_trqDyn_mp "Gefiltertes dynamisches Moment" SWORD Trq 1 100 -3276.800 3276.700 FORMAT "%8.3" ECU_ADDRESS 0xC00019C4 /end MEASUREMENT
/begin MEASUREMENT StAPmp_trqResvFinal_mp "Endwert des Reserve Moments" SWORD Trq 1 100 -3276.800 3276.700 FORMAT "%8.3" ECU_ADDRESS 0xC00019C6 /end MEASUREMENT
/begin MEASUREMENT StAPmp_trqResvLim_mp "Reserve Moment nach Limiter" SWORD Trq 1 100 -3276.800 3276.700 FORMAT "%8.3" ECU_ADDRESS 0xC00019C8 /end MEASUREMENT
/begin MEASUREMENT StDa_ddphiSign_mp "2. Ableitung des Lenkradwinkels (vorzeichenbehaftet)" SWORD Angle2ndDerivative 1 100 -4096.000 4095.875 FORMAT "%8.3" ECU_ADDRESS 0xC00019CA /end MEASUREMENT
/begin MEASUREMENT StDa_ddphiStrgWhl "2. Ableitung des Lenkradwinkelsignals (gefiltert)" SWORD Angle2ndDerivative 1 100 -4096.000 4095.875 FORMAT "%8.3" ECU_ADDRESS 0xD0007528 /end MEASUREMENT
/begin MEASUREMENT StDa_ddphiStrgWhl1_mp "2. Ableitung des Lenkradwinkels (Zwischengröße)" SWORD Angle2ndDerivative 1 100 -4096.000 4095.875 FORMAT "%8.3" ECU_ADDRESS 0xC00019CC /end MEASUREMENT
/begin MEASUREMENT StDa_ddphiStrgWhl2_mp "2. Ableitung des Lenkradwinkels (Zwischengröße)" SWORD Angle2ndDerivative 1 100 -4096.000 4095.875 FORMAT "%8.3" ECU_ADDRESS 0xC00019CE /end MEASUREMENT
/begin MEASUREMENT StDa_ddphiStrgWhl3_mp "2. Ableitung des Lenkradwinkels (Zwischengröße)" SWORD Angle2ndDerivative 1 100 -4096.000 4095.875 FORMAT "%8.3" ECU_ADDRESS 0xC00019D0 /end MEASUREMENT
/begin MEASUREMENT StDa_dphiSign_mp "1. Ableitung des Lenkradwinkels (vorzeichenbehaftet)" SWORD AngleDerivative 1 100 -2048.000 2047.938 FORMAT "%8.3" ECU_ADDRESS 0xC00019D2 /end MEASUREMENT
/begin MEASUREMENT StDa_dphiStrgWhl "1. Ableitung des Lenkradwinkelsignals (gefiltert)" SWORD AngleDerivative 1 100 -2048.000 2047.938 FORMAT "%8.3" ECU_ADDRESS 0xD000752A /end MEASUREMENT
/begin MEASUREMENT StDa_dphiStrgWhl1_mp "1. Ableitung des Lenkradwinkels (vorzeichenbehaftet)" SWORD AngleDerivative 1 100 -2048.000 2047.938 FORMAT "%8.3" ECU_ADDRESS 0xC00019D4 /end MEASUREMENT
/begin MEASUREMENT StDa_dphiStrgWhl2_mp "1. Ableitung des Lenkradwinkels (vorzeichenbehaftet)" SWORD AngleDerivative 1 100 -2048.000 2047.938 FORMAT "%8.3" ECU_ADDRESS 0xC00019D6 /end MEASUREMENT
/begin MEASUREMENT StDa_dphiStrgWhl3_mp "1. Ableitung des Lenkradwinkels (vorzeichenbehaftet)" SWORD AngleDerivative 1 100 -2048.000 2047.938 FORMAT "%8.3" ECU_ADDRESS 0xC00019D8 /end MEASUREMENT
/begin MEASUREMENT StDa_phiStrgWhlMax "Maximum: Lenkradwinkel" SWORD Angle 1 100 -1024.000 1023.969 FORMAT "%8.3" ECU_ADDRESS 0xD000752C /end MEASUREMENT
/begin MEASUREMENT StDa_stCount_mp "Status: Halteglied" UBYTE OneToOne 1 100 0.00 255.0 FORMAT "%5.1" ECU_ADDRESS 0xC00019DA /end MEASUREMENT
/begin MEASUREMENT StDa_stSpeed_mp "Status: Schwelle Fahrgeschwindigkeit" UBYTE OneToOne 1 100 0.00 255.0 FORMAT "%5.1" ECU_ADDRESS 0xC00019DB /end MEASUREMENT
/begin MEASUREMENT Strg_nMax "Leerlaufdrehzahlanforderung des Lenkhilfemoduls" SWORD EngN 1 100 -16384.00 16383.50 FORMAT "%8.2" ECU_ADDRESS 0xD000753C /end MEASUREMENT
/begin MEASUREMENT Strg_nMin "Leerlaufdrehzahlanforderung" SWORD EngN 1 100 -16384.00 16383.50 FORMAT "%8.2" ECU_ADDRESS 0xD000753E /end MEASUREMENT
/begin MEASUREMENT Strg_trqDes "Gewünschtes Ist-Moment" SWORD Trq 1 100 -3276.800 3276.700 FORMAT "%8.3" ECU_ADDRESS 0xD0007540 /end MEASUREMENT
/begin MEASUREMENT Strg_trqResv "Reserve-Moment" SWORD Trq 1 100 -3276.800 3276.700 FORMAT "%8.3" ECU_ADDRESS 0xD0007542 /end MEASUREMENT
/begin MEASUREMENT Strt_st "" UBYTE OneToOne 1 100 0.00 255.0 FORMAT "%5.1" ECU_ADDRESS 0xD000916F /end MEASUREMENT
/begin MEASUREMENT Strt_stPs "" UBYTE OneToOne 1 100 0.00 255.0 FORMAT "%5.1" ECU_ADDRESS 0xD0009170 /end MEASUREMENT
/begin MEASUREMENT StSys_facAPSCor_mp "factor for starting torque correction value" SWORD Fact 1 100 -4.000000 3.999878 FORMAT "%8.6" ECU_ADDRESS 0xC00019DC /end MEASUREMENT
/begin MEASUREMENT StSys_nEpmFlt_mp "engine speed after PT1 filter" SWORD EngN 1 100 -16384.00 16383.50 FORMAT "%8.2" ECU_ADDRESS 0xC00019F2 /end MEASUREMENT
/begin MEASUREMENT StSys_nThresStrtCutOut_mp "Startabwurfdrehzahl" SWORD EngN 1 100 -16384.00 16383.50 FORMAT "%8.2" ECU_ADDRESS 0xC00019E4 /end MEASUREMENT
/begin MEASUREMENT StSys_st "Anlasserzustand" UBYTE OneToOne 1 100 0.00 255.0 FORMAT "%5.1" ECU_ADDRESS 0xD0009163 /end MEASUREMENT
/begin MEASUREMENT StSys_stNewStrt "Statusanzeige bei Neustart während eines aktiven Fahrzyklus" UBYTE OneToOne 1 100 0.00 255.0 FORMAT "%5.1" ECU_ADDRESS 0xD0009164 /end MEASUREMENT
/begin MEASUREMENT StSys_stRmpMon "Zustand der Startmomenterhoehung" UBYTE OneToOne 1 100 0.00 255.0 FORMAT "%5.1" ECU_ADDRESS 0xD0009165 /end MEASUREMENT
/begin MEASUREMENT StSys_stStrt "Startzustand" UBYTE OneToOne 1 100 0.00 255.0 FORMAT "%5.1" ECU_ADDRESS 0xD0009166 /end MEASUREMENT
/begin MEASUREMENT StSys_stStrtCutOutMon "Zustand des Startabwurfs" UBYTE OneToOne 1 100 0.00 255.0 FORMAT "%5.1" ECU_ADDRESS 0xD0009167 /end MEASUREMENT
/begin MEASUREMENT StSys_stStrtTip "" UWORD OneToOne 1 100 0.00 65535.00 FORMAT "%8.2" ECU_ADDRESS 0xD0007692 /end MEASUREMENT
/begin MEASUREMENT StSys_stStrtTipOFF "" UBYTE OneToOne 1 100 0.00 255.0 FORMAT "%5.1" ECU_ADDRESS 0xD0009168 /end MEASUREMENT
/begin MEASUREMENT StSys_stStrtTipON "" UBYTE OneToOne 1 100 0.00 255.0 FORMAT "%5.1" ECU_ADDRESS 0xD0009169 /end MEASUREMENT
/begin MEASUREMENT StSys_stTrqShutOff "globales Interface fuer die Startmomentabschaltung" UBYTE OneToOne 1 100 0.00 255.0 FORMAT "%5.1" ECU_ADDRESS 0xD000916A /end MEASUREMENT
/begin MEASUREMENT StSys_stTrqShutOffCond_mp "bitcodierter Zustand der Abschaltbedingungen der Startmomentenabschaltung" UWORD OneToOne 1 100 0.00 65535.00 FORMAT "%8.2" ECU_ADDRESS 0xC00019F4 /end MEASUREMENT
/begin MEASUREMENT StSys_trqAddCor "zusaetzliches Korrekturmoment f. Startmoment" SWORD Trq 1 100 -3276.800 3276.700 FORMAT "%8.3" ECU_ADDRESS 0xD0007530 /end MEASUREMENT
/begin MEASUREMENT StSys_trqAdj_mp "Startmomentkorrektur" SWORD Trq 1 100 -3276.800 3276.700 FORMAT "%8.3" ECU_ADDRESS 0xC00019E8 /end MEASUREMENT
/begin MEASUREMENT StSys_trqBas "Startbasismoment" SWORD Trq 1 100 -3276.800 3276.700 FORMAT "%8.3" ECU_ADDRESS 0xD0007532 /end MEASUREMENT
/begin MEASUREMENT StSys_trqRmpState "Moment der Startrampe" SWORD Trq 1 100 -3276.800 3276.700 FORMAT "%8.3" ECU_ADDRESS 0xD0007534 /end MEASUREMENT
/begin MEASUREMENT StSys_trqSetAdjVal_mp "EEPROM Abgleichwert Startmoment-Korrektur" SWORD Trq 1 100 -3276.800 3276.700 FORMAT "%8.3" ECU_ADDRESS 0xC00019EA /end MEASUREMENT
/begin MEASUREMENT StSys_trqStrt "inneres Moment Startwert" SWORD Trq 1 100 -3276.800 3276.700 FORMAT "%8.3" ECU_ADDRESS 0xD0007536 /end MEASUREMENT
/begin MEASUREMENT StSys_trqStrtAPSCor_mp "starting torque correction" SWORD Trq 1 100 -3276.800 3276.700 FORMAT "%8.3" ECU_ADDRESS 0xC00019DE /end MEASUREMENT
/begin MEASUREMENT StSys_trqStrtAPS_mp "starting torque correction" SWORD Trq 1 100 -3276.800 3276.700 FORMAT "%8.3" ECU_ADDRESS 0xC00019E0 /end MEASUREMENT
/begin MEASUREMENT StSys_trqStrtBas_mp "Basismoment fuer Start" SWORD Trq 1 100 -3276.800 3276.700 FORMAT "%8.3" ECU_ADDRESS 0xC00019EC /end MEASUREMENT
/begin MEASUREMENT StSys_tStrtBas_mp "Aus dem Motortemperaturfeld Eng_tFld ausgewählte Temperatur" SWORD Temp_Cels 1 100 -3549.940 3003.560 FORMAT "%8.3" ECU_ADDRESS 0xC00019EE /end MEASUREMENT
/begin MEASUREMENT StSys_tStrtCor_mp "Aus dem Motortemperaturfeld Eng_tFld ausgewählte Temperatur" SWORD Temp_Cels 1 100 -3549.940 3003.560 FORMAT "%8.3" ECU_ADDRESS 0xC00019E2 /end MEASUREMENT
/begin MEASUREMENT StSys_tStrtRmp_mp "Aus dem Motortemperaturfeld Eng_tFld ausgewählte Temperatur" SWORD Temp_Cels 1 100 -3549.940 3003.560 FORMAT "%8.3" ECU_ADDRESS 0xC00019F0 /end MEASUREMENT
/begin MEASUREMENT StSys_tStrt_mp "Aus dem Motortemperaturfeld Eng_tFld ausgewählte Temperatur für den Startabwurf" SWORD Temp_Cels 1 100 -3549.940 3003.560 FORMAT "%8.3" ECU_ADDRESS 0xC00019E6 /end MEASUREMENT
/begin MEASUREMENT SyC_ctDeadline1msErr "Anzahl der Zeitüberschreitungen der 1ms-Task" UBYTE OneToOne 1 100 0.00 255.0 FORMAT "%5.1" ECU_ADDRESS 0xD00093EE /end MEASUREMENT
/begin MEASUREMENT SyC_ctInit_mp "Anzahl der Steuergeräteinitialisierungen seit dem Einschalten des Steuergerätes" UBYTE OneToOne 1 100 0.00 255.0 FORMAT "%5.1" ECU_ADDRESS 0xD000DA46 /end MEASUREMENT
/begin MEASUREMENT SyC_ctIrrSwOff_mp "Zähler zur Erkennung einer irregulären Abschaltung des Steuergeräts" UBYTE OneToOne 1 100 0.00 255.0 FORMAT "%5.1" ECU_ADDRESS 0xC00019F6 /end MEASUREMENT
/begin MEASUREMENT SyC_ctSwtOnCan_mp "Zähler Einschalten durch CAN" UBYTE OneToOne 1 100 0.00 255.0 FORMAT "%5.1" ECU_ADDRESS 0xC0001A07 /end MEASUREMENT
/begin MEASUREMENT SyC_ctSwtOnEin_mp "Zähler Einschalten durch Klemme 15" UBYTE OneToOne 1 100 0.00 255.0 FORMAT "%5.1" ECU_ADDRESS 0xC0001A08 /end MEASUREMENT
/begin MEASUREMENT SyC_ctSwtOnStc_mp "Zähler Einschalten durch Stopcounter" UBYTE OneToOne 1 100 0.00 255.0 FORMAT "%5.1" ECU_ADDRESS 0xC0001A09 /end MEASUREMENT
/begin MEASUREMENT SyC_ctSwtOnWak_mp "Zähler Einschalten durch Wakeup Pin" UBYTE OneToOne 1 100 0.00 255.0 FORMAT "%5.1" ECU_ADDRESS 0xC0001A0A /end MEASUREMENT
/begin MEASUREMENT SyC_ctUnderVltg_mp "Anzahl der 5V Unterspannungsfälle seit dem Einschalten des Steuergerätes" UBYTE OneToOne 1 100 0.00 255.0 FORMAT "%5.1" ECU_ADDRESS 0xD000DA47 /end MEASUREMENT
/begin MEASUREMENT SyC_stMn "Aktueller System/ECU-Zustand" UBYTE ExeCon_State_01 1 100 0.00 3.00000000000 FORMAT "%13.11" ECU_ADDRESS 0xD0009171 /end MEASUREMENT
/begin MEASUREMENT SyC_stMnOld "Vorhergehender System/ECU-Zustand" UBYTE ExeCon_State_01 1 100 0.00 3.00000000000 FORMAT "%13.11" ECU_ADDRESS 0xD0009172 /end MEASUREMENT
/begin MEASUREMENT SyC_stPostDrv "Zustand der PostDrive-Steuerung" UBYTE SyC_PostDrv_State 1 100 0.00 7.00000000000 FORMAT "%13.11" ECU_ADDRESS 0xD0009173 /end MEASUREMENT
/begin MEASUREMENT SyC_stPostDrvFin_mp "PostDrive wurde seit letztem Einschalten regulär beendet" UBYTE OneToOne 1 100 0.00 255.0 FORMAT "%5.1" ECU_ADDRESS 0xC0001A06 /end MEASUREMENT
/begin MEASUREMENT SyC_stPreDrv "Zustand der PreDrive-Steuerung" UBYTE SyC_PreDrv_State 1 100 0.00 9.00000000000 FORMAT "%13.11" ECU_ADDRESS 0xD0009174 /end MEASUREMENT
/begin MEASUREMENT SyC_stSub "Aktueller System/ECU-Unterzustand" UBYTE ExeCon_State_02 1 100 0.00 6.00000000000 FORMAT "%13.11" ECU_ADDRESS 0xD0009175 /end MEASUREMENT
/begin MEASUREMENT SyC_stSubOld "Vorhergehender System/ECU-Unterzustand" UBYTE ExeCon_State_02 1 100 0.00 6.00000000000 FORMAT "%13.11" ECU_ADDRESS 0xD0009176 /end MEASUREMENT
/begin MEASUREMENT SyC_stSwtOn_mp "Status Einschaltursache aktueller Wert" UBYTE OneToOne 1 100 0.00 255.0 FORMAT "%5.1" ECU_ADDRESS 0xC0001A0B /end MEASUREMENT
/begin MEASUREMENT SyC_stT15 "Zustand der Klemme 15 für die Systemsteuerung" UBYTE OneToOne 1 100 0.00 255.0 FORMAT "%5.1" ECU_ADDRESS 0xD0009231 /end MEASUREMENT
/begin MEASUREMENT SyC_stVldTiEcuOff "Steuergeräteauszeit gültig" UBYTE OneToOne 1 100 0.00 255.0 FORMAT "%5.1" ECU_ADDRESS 0xD0009232 /end MEASUREMENT
/begin MEASUREMENT SyC_tiBoot_mp "Zeit vom Einschalten des Steuergerätes bis zum Erreichen des Systemzustandes SYC_INI" ULONG OneToOne_us 1 100 0.00 4294967295.00 FORMAT "%13.2" ECU_ADDRESS 0xC00019F8 /end MEASUREMENT
/begin MEASUREMENT SyC_tiDrv "Zeit seit Erreichen des Zustands SYC_DRIVE" ULONG Time_ms 1 100 0.00 42949672950.0 FORMAT "%13.1" ECU_ADDRESS 0xD00045E0 /end MEASUREMENT
/begin MEASUREMENT SyC_tiEcuOff "Steuergeräteauszeit" SLONG SyC_Time_1s 1 100 -2147483648.00 2147483647.00 FORMAT "%13.2" ECU_ADDRESS 0xD00043C4 /end MEASUREMENT
/begin MEASUREMENT SyC_tiIniEnd_mp "Dauer des Systemzustandes SYC_INIEND" UWORD OneToOne_us 1 100 0.00 65535.00 FORMAT "%8.2" ECU_ADDRESS 0xC00019FC /end MEASUREMENT
/begin MEASUREMENT SyC_tiIniSyn_mp "Dauer des Systemzustandes SYC_INISYN" UWORD OneToOne_us 1 100 0.00 65535.00 FORMAT "%8.2" ECU_ADDRESS 0xC00019FE /end MEASUREMENT
/begin MEASUREMENT SyC_tiIni_mp "Dauer des Systemzustandes SYC_INI" ULONG OneToOne_us 1 100 0.00 4294967295.00 FORMAT "%13.2" ECU_ADDRESS 0xC0001A00 /end MEASUREMENT
/begin MEASUREMENT SyC_tiPostDrv "Zeit seit Erreichen des Zustands SYC_POSTDRIVE" ULONG Time_ms 1 100 0.00 42949672950.0 FORMAT "%13.1" ECU_ADDRESS 0xD00045E4 /end MEASUREMENT
/begin MEASUREMENT SyC_tiPreDrv "Zeit seit Erreichen des Zustands SYC_PREDRIVE" ULONG Time_ms 1 100 0.00 42949672950.0 FORMAT "%13.1" ECU_ADDRESS 0xD00045E8 /end MEASUREMENT
/begin MEASUREMENT SyC_tiShutdown_mp "Dauer des Systemzustandes SYC_SHUTDOWN" UWORD OneToOne_ms 1 100 0.00 65535.00 FORMAT "%8.2" ECU_ADDRESS 0xC0001A04 /end MEASUREMENT
/begin MEASUREMENT SyC_tiUnderVltg_mp "Dauer der letzten 5V Unterspannung" UBYTE OneToOne_ms 1 100 0.00 255.0 FORMAT "%5.1" ECU_ADDRESS 0xC0001A0C /end MEASUREMENT
/begin MEASUREMENT T15_st "entprellter Wert der Klemme 15" UBYTE OneToOne 1 100 0.00 255.0 FORMAT "%5.1" ECU_ADDRESS 0xD0009177 /end MEASUREMENT
/begin MEASUREMENT T15_stCondDeb_mp "Bedingungen (Bitleiste) für Auswertung T15_ st" UBYTE OneToOne 1 100 0.00 255.0 FORMAT "%5.1" ECU_ADDRESS 0xC0001A0D /end MEASUREMENT
/begin MEASUREMENT T15_stDebWakeUp "entprellter Wake Up Signaleingang" UBYTE OneToOne 1 100 0.00 255.0 FORMAT "%5.1" ECU_ADDRESS 0xD0009178 /end MEASUREMENT
/begin MEASUREMENT T15_stLogic_mp "Staatsmaschine für T15 in der neu ""Anpassung wakeup Konzept""" UBYTE OneToOne 1 100 0.00 255.0 FORMAT "%5.1" ECU_ADDRESS 0xC0001A0E /end MEASUREMENT
/begin MEASUREMENT T15_stRaw "Rohwert Wert der Klemme 15 wakeup Signal" UBYTE OneToOne 1 100 0.00 255.0 FORMAT "%5.1" ECU_ADDRESS 0xD0009179 /end MEASUREMENT
/begin MEASUREMENT T15_stWakeUp "Wake Up Zustand" UBYTE OneToOne 1 100 0.00 255.0 FORMAT "%5.1" ECU_ADDRESS 0xD000917A /end MEASUREMENT
/begin MEASUREMENT T50_st "Entprellter Statuswert der Klemme 50" UBYTE OneToOne 1 100 0.00 255.0 FORMAT "%5.1" ECU_ADDRESS 0xD000917B /end MEASUREMENT
/begin MEASUREMENT T50_stRaw "Unentprellter Wert des Eingangssignals für Klemme 50" UBYTE OneToOne 1 100 0.00 255.0 FORMAT "%5.1" ECU_ADDRESS 0xD000917C /end MEASUREMENT
/begin MEASUREMENT TAA_ctAngDvt_mp "Inkrementnummer für Winkelkorrekturwert TAA_phiAngDvt_mp" UBYTE OneToOne 1 100 0.00 255.0 FORMAT "%5.1" ECU_ADDRESS 0xC0001A1E /end MEASUREMENT
/begin MEASUREMENT TAA_ctBufSect_mp "Abschnitt-Tabelle des Geberrads für Inkrementwinkel-Lernverfahren (nur für Testzwecke)" UBYTE OneToOne 1 100 0.00 255.0 FORMAT "%5.1" ECU_ADDRESS 0xC0001A0F /end MEASUREMENT
/begin MEASUREMENT TAA_facDyn_mp "dynamische Änderung der Inkrementperiodendauer pro Geberrad-Umdrehung" SWORD Fact 1 100 -4.000000 3.999878 FORMAT "%8.6" ECU_ADDRESS 0xC0001A10 /end MEASUREMENT
/begin MEASUREMENT TAA_facIpo_mp "Interpolationsfaktor für Inkrementwinkel-Korrekturwerte" SWORD Fact 1 100 -4.000000 3.999878 FORMAT "%8.6" ECU_ADDRESS 0xC0001A20 /end MEASUREMENT
/begin MEASUREMENT TAA_nMinCalc_mp "minimale Drehzahl für Inkrementwinkel-Lernverfahren infolge interner Zahlendarstellung" SWORD EngN 1 100 -16384.00 16383.50 FORMAT "%8.2" ECU_ADDRESS 0xC0001A22 /end MEASUREMENT
/begin MEASUREMENT TAA_numActv "Anzahl auszuwertender Inkremente je Rechenraster in Inkrementwinkel-Lernverfahren" UBYTE OneToOne 1 100 0.00 255.0 FORMAT "%5.1" ECU_ADDRESS 0xD000917D /end MEASUREMENT
/begin MEASUREMENT TAA_numIncBefGap_mp "Nummer des Inkrements vor erster Lücke des Geberrads" UBYTE OneToOne 1 100 0.00 255.0 FORMAT "%5.1" ECU_ADDRESS 0xC0001A24 /end MEASUREMENT
/begin MEASUREMENT TAA_numIncIR_mp "Inkrementzahl pro drehzahlsynchronen Interrupt" UBYTE OneToOne 1 100 0.00 255.0 FORMAT "%5.1" ECU_ADDRESS 0xC0001A25 /end MEASUREMENT
/begin MEASUREMENT TAA_phiAngDvt_mp "Winkelkorrektur für Inkrement TAA_ctAngDvt_mp" SBYTE AngleCrS 1 100 -2.813 2.791 FORMAT "%5.3" ECU_ADDRESS 0xC0001A26 /end MEASUREMENT
/begin MEASUREMENT TAA_phiIncDvt_mp "nichtinterpolierte Inkrementwinkel-Abweichungen (nur für Testzwecke)" SWORD AgCrSHiReso 1 100 -5.625172 5.625000 FORMAT "%8.6" ECU_ADDRESS 0xC0001A12 /end MEASUREMENT
/begin MEASUREMENT TAA_stAdap "auszuführender Teilalgorithmus im Inkrementwinkel-Lernverfahren" UWORD OneToOne 1 100 0.00 65535.00 FORMAT "%8.2" ECU_ADDRESS 0xD0007694 /end MEASUREMENT
/begin MEASUREMENT TAA_stAdapMode_mp "Adaptionsmodus für Inkrementwinkel-Lernverfahren (kein / in / ausserhalb Hauptdrehzahlbereich)" UBYTE OneToOne 1 100 0.00 255.0 FORMAT "%5.1" ECU_ADDRESS 0xC0001A14 /end MEASUREMENT
/begin MEASUREMENT TAA_stAdapVal_mp "Einschwingzustand Inkrementwinkel-Lernverfahren" UBYTE OneToOne 1 100 0.00 255.0 FORMAT "%5.1" ECU_ADDRESS 0xC0001A15 /end MEASUREMENT
/begin MEASUREMENT TAA_stEnaCond_mp "Aktivierungsbedingung Inkrementwinkel-Lernverfahren (ohne Schubbedingung)" UBYTE OneToOne 1 100 0.00 255.0 FORMAT "%5.1" ECU_ADDRESS 0xC0001A27 /end MEASUREMENT
/begin MEASUREMENT TAA_stErr_mp "Konfigurationsfehler bei Inkrementwinkel-Lernverfahren" UBYTE OneToOne 1 100 0.00 255.0 FORMAT "%5.1" ECU_ADDRESS 0xC0001A28 /end MEASUREMENT
/begin MEASUREMENT TAA_stFin "zuletzt ausgeführter Teilalgorithmus Inkrementwinkel-Lernverfahren" UWORD OneToOne 1 100 0.00 65535.00 FORMAT "%8.2" ECU_ADDRESS 0xD0007696 /end MEASUREMENT
/begin MEASUREMENT TAA_stIdxSync_mp "Inkrementwinkel-Lernverfahren ist synchron mit Winkelsystem" UBYTE OneToOne 1 100 0.00 255.0 FORMAT "%5.1" ECU_ADDRESS 0xC0001A29 /end MEASUREMENT
/begin MEASUREMENT TAA_stIpoMode_mp "aktueller Interpolationsmodus für Inkrementwinkel-Korrekturwerte" UBYTE OneToOne 1 100 0.00 255.0 FORMAT "%5.1" ECU_ADDRESS 0xC0001A2A /end MEASUREMENT
/begin MEASUREMENT TAA_stRev2Fin_mp "Triggersignal: zwei Geberradumdrehungen abgeschlossen" UBYTE OneToOne 1 100 0.00 255.0 FORMAT "%5.1" ECU_ADDRESS 0xC0001A2B /end MEASUREMENT
/begin MEASUREMENT TAA_stRlsOvrRunCo_mp "Aktivierungsbedingung Inkrementwinkel-Lernverfahren" UBYTE OneToOne 1 100 0.00 255.0 FORMAT "%5.1" ECU_ADDRESS 0xC0001A2C /end MEASUREMENT
/begin MEASUREMENT TAA_stSpdRngRdHi_mp "oberer Drehzahlbereich für Interpolation der Winkelkorrekturwerte" UBYTE OneToOne 1 100 0.00 255.0 FORMAT "%5.1" ECU_ADDRESS 0xC0001A2D /end MEASUREMENT
/begin MEASUREMENT TAA_stSpdRngRdLo_mp "unterer Drehzahlbereich für Interpolation der Winkelkorrekturwerte" UBYTE OneToOne 1 100 0.00 255.0 FORMAT "%5.1" ECU_ADDRESS 0xC0001A2E /end MEASUREMENT
/begin MEASUREMENT TAA_stSpdRngWr_mp "aktueller Drehzahlbereich für Inkrementwinkel-Lernverfahren" UBYTE OneToOne 1 100 0.00 255.0 FORMAT "%5.1" ECU_ADDRESS 0xC0001A16 /end MEASUREMENT
/begin MEASUREMENT TAA_tiIncAvrg_mp "mittlere Inkrementperiodendauer aus zwei Geberrad-Umdrehungen" SLONG TIncPerDur_us 1 100 -214748364.800 214748364.700 FORMAT "%13.3" ECU_ADDRESS 0xC0001A18 /end MEASUREMENT
/begin MEASUREMENT TAA_tiInc_mp "privater Inkrementperioden-Puffer im Inkrementwinkel-Lernverfahren (nur für Testzwecke)" SWORD TIncPerDur_us 1 100 -3276.800 3276.700 FORMAT "%8.3" ECU_ADDRESS 0xC0001A1C /end MEASUREMENT
/begin MEASUREMENT TCPrt_dnAvrg "Drehzahlgradient Basis für Korrekturfaktor D-Verstärkung" SWORD EngNGrd 1 100 -16384.00 16383.50 FORMAT "%8.2" ECU_ADDRESS 0xD0007544 /end MEASUREMENT
/begin MEASUREMENT TCPrt_dnAvrgNeg_mp "Änderungsgeschwindigkeit der Motordrehzahl in der negativen Richtung" SWORD EngNGrd 1 100 -16384.00 16383.50 FORMAT "%8.2" ECU_ADDRESS 0xC0001A30 /end MEASUREMENT
/begin MEASUREMENT TCPrt_dnChrgPmpCtlHigh_mp "Höhere Begrenzung, damit Hysteresis Änderungsgeschwindigkeit von Epm_nEng für Anti-Schwankung LIGov überwacht" SWORD EngNGrd 1 100 -16384.00 16383.50 FORMAT "%8.2" ECU_ADDRESS 0xC0001A32 /end MEASUREMENT
/begin MEASUREMENT TCPrt_dnChrgPmpCtlLow_mp "Unterere Grenze, damit Hysteresis Änderungsgeschwindigkeit von Epm_nEng für Anti-Schwankung LIGov überwacht" SWORD EngNGrd 1 100 -16384.00 16383.50 FORMAT "%8.2" ECU_ADDRESS 0xC0001A34 /end MEASUREMENT
/begin MEASUREMENT TCPrt_dqInjCtlQRaw_mp "" SWORD InjMassPerSec_20ms 1 100 -16384.00 16383.50 FORMAT "%8.2" ECU_ADDRESS 0xC0001A54 /end MEASUREMENT
/begin MEASUREMENT TCPrt_facAFSensAmpFlt "Amplitudenhöhe der oszillierenden Frischluftmasse beim La-derpumpen tiefpassgefiltert" SWORD FactM 1 100 -2048.000 2047.938 FORMAT "%8.3" ECU_ADDRESS 0xD0007546 /end MEASUREMENT
/begin MEASUREMENT TCPrt_facAFSensAmpFlt_mp "Amplitudenhöhe der oszillierenden Frischluftmasse beim Laderpumpen nach DFT tiefpassgefilter (PT1)" SWORD FactM 1 100 -2048.000 2047.938 FORMAT "%8.3" ECU_ADDRESS 0xC0001A46 /end MEASUREMENT
/begin MEASUREMENT TCPrt_facAFSensDTAbsAmp2_mp "Faktor des Absolutwerts von zweitem PT1 - filtern" SWORD FactM 1 100 -2048.000 2047.938 FORMAT "%8.3" ECU_ADDRESS 0xC0001A48 /end MEASUREMENT
/begin MEASUREMENT TCPrt_facAFSensDTAmp12_mp "Messender Punkt für Ausgang zweiter DT1-filter" SWORD FactM 1 100 -2048.000 2047.938 FORMAT "%8.3" ECU_ADDRESS 0xC0001A4A /end MEASUREMENT
/begin MEASUREMENT TCPrt_facAFSensPTAmp12_mp "Maßpunkt für das otput zweiter PT1-filter" SWORD FactM 1 100 -2048.000 2047.938 FORMAT "%8.3" ECU_ADDRESS 0xC0001A4C /end MEASUREMENT
/begin MEASUREMENT TCPrt_facAFSensPTAmp1_mp "Amplitudenhöhe der oszillierenden Frischluftmasse beim Laderpumpen (nach PT1-Ctl1)" SWORD FactM 1 100 -2048.000 2047.938 FORMAT "%8.3" ECU_ADDRESS 0xC0001A4E /end MEASUREMENT
/begin MEASUREMENT TCPrt_facAFSensPTAmp2_mp "Amplitudenhöhe der oszillierenden Frischluftmasse beim Laderpumpen (früher PT1-Ctl2)" SWORD FactM 1 100 -2048.000 2047.938 FORMAT "%8.3" ECU_ADDRESS 0xC0001A50 /end MEASUREMENT
/begin MEASUREMENT TCPrt_facAFSensPTAmpFlt_mp "Amplitudenhöhe der oszillierenden Frischluftmasse beim Laderpumpen (nach PT1-Ctl2)" SWORD FactM 1 100 -2048.000 2047.938 FORMAT "%8.3" ECU_ADDRESS 0xC0001A52 /end MEASUREMENT
/begin MEASUREMENT TCPrt_facChrgPmpDes_mp "" SWORD FactM 1 100 -2048.000 2047.938 FORMAT "%8.3" ECU_ADDRESS 0xC0001A56 /end MEASUREMENT
/begin MEASUREMENT TCPrt_facChrgPmpGovDevI_mp "" SWORD FactM 1 100 -2048.000 2047.938 FORMAT "%8.3" ECU_ADDRESS 0xC0001A58 /end MEASUREMENT
/begin MEASUREMENT TCPrt_facChrgPmpGovDev_mp "" SWORD FactM 1 100 -2048.000 2047.938 FORMAT "%8.3" ECU_ADDRESS 0xC0001A5A /end MEASUREMENT
/begin MEASUREMENT TCPrt_facChrgPmpI_mp "" SWORD Fact1 1 100 -256.0000 255.9922 FORMAT "%8.4" ECU_ADDRESS 0xC0001A5C /end MEASUREMENT
/begin MEASUREMENT TCPrt_facChrgPmpP_mp "" SWORD Fact1 1 100 -256.0000 255.9922 FORMAT "%8.4" ECU_ADDRESS 0xC0001A5E /end MEASUREMENT
/begin MEASUREMENT TCPrt_nSetPointChrgPmp "Einstellpunkt für Anti-Schwankung LIGov" SWORD EngN 1 100 -16384.00 16383.50 FORMAT "%8.2" ECU_ADDRESS 0xD0007548 /end MEASUREMENT
/begin MEASUREMENT TCPrt_pChrgPmpCtlVal_mp "" SWORD Pres_hPa 1 100 -32768.00 3500.00 FORMAT "%8.2" ECU_ADDRESS 0xC0001A60 /end MEASUREMENT
/begin MEASUREMENT TCPrt_pChrgPmpMax_mp "" SWORD Pres_hPa 1 100 -32768.00 3500.00 FORMAT "%8.2" ECU_ADDRESS 0xC0001A62 /end MEASUREMENT
/begin MEASUREMENT TCPrt_pChrgPmpMin_mp "" SWORD Pres_hPa 1 100 -32768.00 3500.00 FORMAT "%8.2" ECU_ADDRESS 0xC0001A64 /end MEASUREMENT
/begin MEASUREMENT TCPrt_pChrgPmpPICtlLim_mp "" SWORD Pres_hPa 1 100 -32768.00 3500.00 FORMAT "%8.2" ECU_ADDRESS 0xC0001A66 /end MEASUREMENT
/begin MEASUREMENT TCPrt_pChrgPmpPICtl_mp "" SWORD Pres_hPa 1 100 -32768.00 3500.00 FORMAT "%8.2" ECU_ADDRESS 0xC0001A68 /end MEASUREMENT
/begin MEASUREMENT TCPrt_pChrgPmpstI_mp "" SWORD Pres_hPa 1 100 -32768.00 3500.00 FORMAT "%8.2" ECU_ADDRESS 0xC0001A6A /end MEASUREMENT
/begin MEASUREMENT TCPrt_pDesChrgPmpGov "" SWORD Pres_hPa 1 100 -32768.00 3500.00 FORMAT "%8.2" ECU_ADDRESS 0xD000754A /end MEASUREMENT
/begin MEASUREMENT TCPrt_pDesChrgPmpRaw_mp "" SWORD Pres_hPa 1 100 -32768.00 3500.00 FORMAT "%8.2" ECU_ADDRESS 0xC0001A6C /end MEASUREMENT
/begin MEASUREMENT TCPrt_pOutI_mp "" SWORD Pres_hPa 1 100 -32768.00 3500.00 FORMAT "%8.2" ECU_ADDRESS 0xC0001A6E /end MEASUREMENT
/begin MEASUREMENT TCPrt_pOutP_mp "" SWORD Pres_hPa 1 100 -32768.00 3500.00 FORMAT "%8.2" ECU_ADDRESS 0xC0001A70 /end MEASUREMENT
/begin MEASUREMENT TCPrt_qChrgPmpCtlHigh_mp "Höhere Quantität Begrenzung für Hysteresis der Anti-Schwankung LIGov" SWORD InjMass 1 100 -327.6800 327.6700 FORMAT "%8.4" ECU_ADDRESS 0xC0001A36 /end MEASUREMENT
/begin MEASUREMENT TCPrt_qChrgPmpCtlLow_mp "Senken Sie Quantität Begrenzung für Hysteresis der Anti-Schwankung LIGov" SWORD InjMass 1 100 -327.6800 327.6700 FORMAT "%8.4" ECU_ADDRESS 0xC0001A38 /end MEASUREMENT
/begin MEASUREMENT TCPrt_rChrgPmpCtlVal "Ladedruck Steueranteil der Stellgrösse" SWORD Prc 1 100 -400.0000 399.9878 FORMAT "%8.4" ECU_ADDRESS 0xD000754C /end MEASUREMENT
/begin MEASUREMENT TCPrt_rChrgPmpCtlValHigh_mp "Höhere ATL Druck-Verhältnisbegrenzung für Hysteresis der Anti-Schwankung LIGov" SWORD Prc 1 100 -400.0000 399.9878 FORMAT "%8.4" ECU_ADDRESS 0xC0001A3A /end MEASUREMENT
/begin MEASUREMENT TCPrt_rChrgPmpCtlValLow_mp "Senken Sie ATL Druck-Verhältnisbegrenzung für Hysteresis der Anti-Schwankung LIGov" SWORD Prc 1 100 -400.0000 399.9878 FORMAT "%8.4" ECU_ADDRESS 0xC0001A3C /end MEASUREMENT
/begin MEASUREMENT TCPrt_rChrgPmpGov "" SWORD Prc 1 100 -400.0000 399.9878 FORMAT "%8.4" ECU_ADDRESS 0xD000754E /end MEASUREMENT
/begin MEASUREMENT TCPrt_rChrgPmpGovHysOff_mp "" SWORD Prc 1 100 -400.0000 399.9878 FORMAT "%8.4" ECU_ADDRESS 0xC0001A72 /end MEASUREMENT
/begin MEASUREMENT TCPrt_rChrgPmpGovOff_mp "" SWORD Prc 1 100 -400.0000 399.9878 FORMAT "%8.4" ECU_ADDRESS 0xC0001A74 /end MEASUREMENT
/begin MEASUREMENT TCPrt_rChrgPmpGovOn_mp "" SWORD Prc 1 100 -400.0000 399.9878 FORMAT "%8.4" ECU_ADDRESS 0xC0001A76 /end MEASUREMENT
/begin MEASUREMENT TCPrt_rChrgPmpGovRaw_mp "" SWORD Prc 1 100 -400.0000 399.9878 FORMAT "%8.4" ECU_ADDRESS 0xC0001A78 /end MEASUREMENT
/begin MEASUREMENT TCPrt_rChrgPmpHysHigh_mp "Höhere ATL Druck-Verhältnisbegrenzung für Hysteresis der Anti-Schwankung LIGov" SWORD Prc 1 100 -400.0000 399.9878 FORMAT "%8.4" ECU_ADDRESS 0xC0001A3E /end MEASUREMENT
/begin MEASUREMENT TCPrt_rChrgPmpHysLow_mp "Senken Sie ATL Druck-Verhältnisbegrenzung für Hysteresis der Anti-Schwankung LIGov" SWORD Prc 1 100 -400.0000 399.9878 FORMAT "%8.4" ECU_ADDRESS 0xC0001A40 /end MEASUREMENT
/begin MEASUREMENT TCPrt_rPresRat "ATL- Druckverhältnis" SWORD Prc 1 100 -400.0000 399.9878 FORMAT "%8.4" ECU_ADDRESS 0xD0007550 /end MEASUREMENT
/begin MEASUREMENT TCPrt_stChrgPmp "Status der Erkennung für Laderpumpen Zustand 2 (oszillierende Frischluftmasse mit großer Amplitude)" UBYTE OneToOne 1 100 0.00 255.0 FORMAT "%5.1" ECU_ADDRESS 0xD000917E /end MEASUREMENT
/begin MEASUREMENT TCPrt_stChrgPmp1_mp "Anti-Schwankung LIGov status1, ohne Motordrehzahlzu überwachen" UBYTE OneToOne 1 100 0.00 255.0 FORMAT "%5.1" ECU_ADDRESS 0xC0001A42 /end MEASUREMENT
/begin MEASUREMENT TCPrt_stChrgPmpCtl "Anti-Schwankung LIGov status2" UBYTE OneToOne 1 100 0.00 255.0 FORMAT "%5.1" ECU_ADDRESS 0xD000917F /end MEASUREMENT
/begin MEASUREMENT TCPrt_stChrgPmpCtl_mp "Status Pre1 der Anti-Schwankung LIGov" UBYTE OneToOne 1 100 0.00 255.0 FORMAT "%5.1" ECU_ADDRESS 0xC0001A43 /end MEASUREMENT
/begin MEASUREMENT TCPrt_stChrgPmpHLSDem_mp "Anti-Schwankung LIGov status1" UBYTE OneToOne 1 100 0.00 255.0 FORMAT "%5.1" ECU_ADDRESS 0xC0001A44 /end MEASUREMENT
/begin MEASUREMENT TCPrt_stChrgPmpPre1_mp "Status Pre1 der Anti-Schwankung LIGov" UBYTE OneToOne 1 100 0.00 255.0 FORMAT "%5.1" ECU_ADDRESS 0xC0001A45 /end MEASUREMENT
/begin MEASUREMENT TCPrt_stPreChrgPmp "Status der Erkennung für Laderpumpen Zustand 1 (oszillierende Frischluftmasse mit kleiner Amplitude)" UBYTE OneToOne 1 100 0.00 255.0 FORMAT "%5.1" ECU_ADDRESS 0xD0009180 /end MEASUREMENT
/begin MEASUREMENT TCPrt_swtChrgPmpGov "" UBYTE OneToOne 1 100 0.00 255.0 FORMAT "%5.1" ECU_ADDRESS 0xD0009181 /end MEASUREMENT
/begin MEASUREMENT TCPrt_swtChrgPmpGovRls_mp "" UBYTE OneToOne 1 100 0.00 255.0 FORMAT "%5.1" ECU_ADDRESS 0xC0001A7A /end MEASUREMENT
/begin MEASUREMENT TCPrt_swtChrgPmpGovSel_mp "" UBYTE OneToOne 1 100 0.00 255.0 FORMAT "%5.1" ECU_ADDRESS 0xC0001A7B /end MEASUREMENT
/begin MEASUREMENT TECU_t "" SWORD Temp_Cels 1 100 -3549.940 3003.560 FORMAT "%8.3" ECU_ADDRESS 0xD0007552 /end MEASUREMENT
/begin MEASUREMENT TECU_tSens "" SWORD Temp_Cels 1 100 -3549.940 3003.560 FORMAT "%8.3" ECU_ADDRESS 0xD0007554 /end MEASUREMENT
/begin MEASUREMENT TECU_uRaw "" SWORD Volt 1 100 -6553.600 6553.400 FORMAT "%8.3" ECU_ADDRESS 0xD0007556 /end MEASUREMENT
/begin MEASUREMENT ThrVlv_r "" SWORD Prc 1 100 -400.0000 399.9878 FORMAT "%8.4" ECU_ADDRESS 0xD000756C /end MEASUREMENT
/begin MEASUREMENT ThrVlv_rAct "" SWORD DtyCyc 1 100 -327.6800 327.6700 FORMAT "%8.4" ECU_ADDRESS 0xD000756E /end MEASUREMENT
/begin MEASUREMENT ThrVlv_rPs "" SWORD DtyCyc 1 100 -327.6800 327.6700 FORMAT "%8.4" ECU_ADDRESS 0xD0007578 /end MEASUREMENT
/begin MEASUREMENT ThrVlv_rSens "" SWORD DtyCyc 1 100 -327.6800 327.6700 FORMAT "%8.4" ECU_ADDRESS 0xD000757A /end MEASUREMENT
/begin MEASUREMENT ThrVlv_stErrMsg_mp "" UBYTE OneToOne 1 100 0.00 255.0 FORMAT "%5.1" ECU_ADDRESS 0xC0001A7C /end MEASUREMENT
/begin MEASUREMENT ThrVlv_uRaw "" SWORD Volt 1 100 -6553.600 6553.400 FORMAT "%8.3" ECU_ADDRESS 0xD000757C /end MEASUREMENT
/begin MEASUREMENT Tra_numDflGear_mp "" UBYTE OneToOne 1 100 0.00 255.0 FORMAT "%5.1" ECU_ADDRESS 0xC0001A8E /end MEASUREMENT
/begin MEASUREMENT Tra_numOldGear "" UBYTE OneToOne 1 100 0.00 255.0 FORMAT "%5.1" ECU_ADDRESS 0xD0009185 /end MEASUREMENT
/begin MEASUREMENT Tra_numOldParGear "" UBYTE OneToOne 1 100 0.00 255.0 FORMAT "%5.1" ECU_ADDRESS 0xD0009186 /end MEASUREMENT
/begin MEASUREMENT Tra_rClgDem "Relative Lüfterkühlleistung" SWORD Prc 1 100 -400.0000 399.9878 FORMAT "%8.4" ECU_ADDRESS 0xD0007584 /end MEASUREMENT
/begin MEASUREMENT Tra_rV2NLoRng_mp "" SWORD VelToN 1 100 -0.3276800 0.3276700 FORMAT "%9.7" ECU_ADDRESS 0xC0001A90 /end MEASUREMENT
/begin MEASUREMENT Tra_stStopEna "" UBYTE OneToOne 1 100 0.00 255.0 FORMAT "%5.1" ECU_ADDRESS 0xD0009189 /end MEASUREMENT
/begin MEASUREMENT Tra_stStrtEna "" UBYTE OneToOne 1 100 0.00 255.0 FORMAT "%5.1" ECU_ADDRESS 0xD000918A /end MEASUREMENT
/begin MEASUREMENT Tra_swtSlctGearInfoCan_mp "" UBYTE OneToOne 1 100 0.00 255.0 FORMAT "%5.1" ECU_ADDRESS 0xC0001A92 /end MEASUREMENT
/begin MEASUREMENT Tra_tClntDes "Kühlmitteltemperatur-Sollwert" SWORD Temp_Cels 1 100 -3549.940 3003.560 FORMAT "%8.3" ECU_ADDRESS 0xD0007586 /end MEASUREMENT
/begin MEASUREMENT Tra_tOil "Getriebeöltemperatur" SWORD Temp_Cels 1 100 -3549.940 3003.560 FORMAT "%8.3" ECU_ADDRESS 0xD0007588 /end MEASUREMENT
/begin MEASUREMENT Tra_trqLos "Getriebeverlustmoment" SWORD Trq 1 100 -3276.800 3276.700 FORMAT "%8.3" ECU_ADDRESS 0xD0007594 /end MEASUREMENT
/begin MEASUREMENT VehMot_phiStrgWhl "Lenkradwinkel (gefiltert)" SWORD Angle 1 100 -1024.000 1023.969 FORMAT "%8.3" ECU_ADDRESS 0xD00075F6 /end MEASUREMENT
/begin FUNCTION Rail_SetPointEnvCorRgn ""
 /begin DEF_CHARACTERISTIC Rail_facSetPointEnvCorRgnMax_C Rail_facSetPointEnvCorRgnMin_C Rail_pSetPointAPSCor0Rgn_GMAP Rail_pSetPointAPSCor1Rgn_GMAP Rail_pSetPointAPSCorRgnX_AXIS Rail_pSetPointAPSCorRgnY_AXIS Rail_pSetPointTempCor0Rgn_GMAP Rail_pSetPointTempCor1Rgn_GMAP Rail_pSetPointTempCorRgnX_AXIS Rail_pSetPointTempCorRgnY_AXIS /end DEF_CHARACTERISTIC
 /begin IN_MEASUREMENT Epm_nEng InjCtl_qSetUnBal Rail_facSetPointAPSCorRgn Rail_facSetPointATSCorRgn Rail_facSetPointETSCorRgn Rail_stEnvCorRgn /end IN_MEASUREMENT
 /begin OUT_MEASUREMENT Rail_pSetPointEnvCorRgn /end OUT_MEASUREMENT
 /begin LOC_MEASUREMENT Rail_facSetPointTempCorRgn_mp Rail_pSetPointAPSCorRgn_mp Rail_pSetPointTempCorRgn_mp /end LOC_MEASUREMENT
/end FUNCTION
/begin FUNCTION Rail_SetPointEnvCorSlow ""
 /begin DEF_CHARACTERISTIC Rail_ctATSSel_C Rail_facSetPointAPSCor_CUR Rail_facSetPointATSCor_CUR Rail_facSetPointETSCor_CUR /end DEF_CHARACTERISTIC
 /begin IN_MEASUREMENT AirSys_tFld CACDsT_t EnvP_p InjSys_tEng /end IN_MEASUREMENT
 /begin OUT_MEASUREMENT Rail_facSetPointAPSCor Rail_facSetPointATSCor Rail_facSetPointETSCor Rail_tAir /end OUT_MEASUREMENT
/end FUNCTION
/begin FUNCTION Rail_SetPointEnvCorSlowRgn ""
 /begin DEF_CHARACTERISTIC Rail_facSetPointAPSCor0Rgn_GCUR Rail_facSetPointAPSCor1Rgn_GCUR Rail_facSetPointAPSCorRgn_AXIS Rail_facSetPointATSCor0Rgn_GCUR Rail_facSetPointATSCor1Rgn_GCUR Rail_facSetPointATSCorRgn_AXIS Rail_facSetPointETSCor0Rgn_GCUR Rail_facSetPointETSCor1Rgn_GCUR Rail_facSetPointETSCorRgn_AXIS /end DEF_CHARACTERISTIC
 /begin IN_MEASUREMENT EnvP_p InjSys_tEng Rail_tAir /end IN_MEASUREMENT
 /begin OUT_MEASUREMENT Rail_facSetPointAPSCorRgn Rail_facSetPointATSCorRgn Rail_facSetPointETSCorRgn /end OUT_MEASUREMENT
/end FUNCTION
/begin FUNCTION Rail_SetPointStrt "" /begin DEF_CHARACTERISTIC Rail_pSetPointBaseStrt_MAP /end DEF_CHARACTERISTIC /begin IN_MEASUREMENT Epm_nEng InjCtl_qCurr Rail_pSetPointEnvCorStrt /end IN_MEASUREMENT /begin LOC_MEASUREMENT Rail_pSetPointBaseStrt_mp Rail_pSetPointCorStrt_mp /end LOC_MEASUREMENT /end FUNCTION
/begin FUNCTION Rail_SetSubst "" /begin OUT_MEASUREMENT Rail_pSetPointSubst /end OUT_MEASUREMENT /end FUNCTION
/begin FUNCTION Rail_ZFCLib ""
 /begin DEF_CHARACTERISTIC Rail_pFltMinZFC_C Rail_pSetPointZFCMax_C Rail_pSetPointZFCMin_C Rail_rFltMinSlpZFC_C Rail_rZFCInitDwn_CUR Rail_rZFCInitUp_CUR Rail_tiZFCDemDel_C Rail_tiZFCPT1_C /end DEF_CHARACTERISTIC
 /begin IN_MEASUREMENT RailP_pFlt ZFC_pRailSetPoint_mp /end IN_MEASUREMENT
 /begin LOC_MEASUREMENT Rail_pZFCInit_mp Rail_stPresMinZFC_mp /end LOC_MEASUREMENT
/end FUNCTION
/begin FUNCTION Reg "" /end FUNCTION
/begin FUNCTION Reset "" /begin DEF_CHARACTERISTIC Reset_xGrpId_C Reset_xTrgId_C /end DEF_CHARACTERISTIC
 /begin OUT_MEASUREMENT Reset_Env.adLoc Reset_Env.xUserValue Reset_Env.xId Reset_Env.xGrp Reset_Env.ctRst Reset_xHistBuf /end OUT_MEASUREMENT
/end FUNCTION
/begin FUNCTION RngMod_TrqCalc ""
 /begin IN_MEASUREMENT CoVeh_trqAcs RngMod_trqLossComp RngMod_trqMax RngMod_trqMin /end IN_MEASUREMENT
 /begin OUT_MEASUREMENT RngMod_trqClthMax RngMod_trqClthMin RngMod_trqComp /end OUT_MEASUREMENT
/end FUNCTION
/begin FUNCTION RngMod_trqFrcAdpt ""
 /begin DEF_CHARACTERISTIC RngMod_nLIDvtnMax_C RngMod_stHydConvMtd_C RngMod_T1FltAdap_C RngMod_tAdapMin_C RngMod_tiRelAdap_C RngMod_vLimTrans_C /end DEF_CHARACTERISTIC
 /begin IN_MEASUREMENT ACCtl_stOut ActMod_trqInr APP_r Conv_trqLd EngDa_tEng Epm_nEng HLSDem_nSetPLo PT_numTraGear RngMod_trqClthMin SpdGov_st VehV_v /end IN_MEASUREMENT
 /begin OUT_MEASUREMENT RngMod_stAdap RngMod_trqLosAdap /end OUT_MEASUREMENT
 /begin LOC_MEASUREMENT RngMod_nLIDvtn_mp RngMod_stDrvState_mp RngMod_stGenRel_mp RngMod_stLIStat_mp RngMod_trqDiffAdap RngMod_trqFltACGear_mp RngMod_trqFltACNoGear_mp RngMod_trqFltNoACGear_mp RngMod_trqFltNoACNoGear_mp RngMod_trqLosCompl_mp RngMod_trqLosDiff_mp /end LOC_MEASUREMENT
/end FUNCTION
/begin FUNCTION RngMod_TrqFrcCalc "" /begin DEF_CHARACTERISTIC RngMod_numTrqFrc_C RngMod_stNormal_C RngMod_trqFrc_MAP /end DEF_CHARACTERISTIC /begin IN_MEASUREMENT CoEOM_stOpModeAct EngDa_tFld Epm_nEng /end IN_MEASUREMENT /begin OUT_MEASUREMENT RngMod_trqFrc RngMod_trqLossComp RngMod_trqMin /end OUT_MEASUREMENT /begin LOC_MEASUREMENT RngMod_tTrqFrc_mp /end LOC_MEASUREMENT /end FUNCTION
/begin FUNCTION RngMod_TrqSpdCrv "" /begin DEF_CHARACTERISTIC RngMod_trqSpd_CUR /end DEF_CHARACTERISTIC /begin IN_MEASUREMENT Epm_nEng /end IN_MEASUREMENT /begin OUT_MEASUREMENT RngMod_trqMax /end OUT_MEASUREMENT /end FUNCTION
/begin FUNCTION Rtmo ""
 /begin DEF_CHARACTERISTIC Rtmo_adCalling_u32 Rtmo_adData_u32 Rtmo_stSampleTime_u8 Rtmo_swMode_u8 Rtmo_tiIntOverhead_Tick Rtmo_tiOverhead_Tick /end DEF_CHARACTERISTIC
 /begin OUT_MEASUREMENT Rtmo_ctInterrupt_u16 Rtmo_ctReentrantSample_u32 Rtmo_ctSampleProc_u8 Rtmo_ctSample_u16 Rtmo_tiAvrg_Tick Rtmo_tiMaxCalldist_Tick Rtmo_tiMax_Tick Rtmo_tiMinCalldist_Tick Rtmo_tiMin_Tick /end OUT_MEASUREMENT
/end FUNCTION
/begin FUNCTION SB "" /end FUNCTION
/begin FUNCTION Sia_Adapt "" /begin DEF_CHARACTERISTIC Sia_swtDisable_C /end DEF_CHARACTERISTIC /begin IN_MEASUREMENT CoEng_st Com_stKeyVld SyC_stSub T15_st /end IN_MEASUREMENT /begin OUT_MEASUREMENT Sia_B_kl15 Sia_B_pwf Sia_B_stkeyvld /end OUT_MEASUREMENT /begin LOC_MEASUREMENT Sia_B_nmot /end LOC_MEASUREMENT /end FUNCTION
/begin FUNCTION sia_comifc "" /end FUNCTION
/begin FUNCTION Sia_Core "" /begin IN_MEASUREMENT Sia_B_kl15 Sia_B_nmot Sia_B_stkeyvld /end IN_MEASUREMENT
 /begin LOC_MEASUREMENT sia_500ms_mp sia_B_Auth_Cycl sia_B_Auth_Delay sia_B_Calc_Chal sia_B_Calc_Resp sia_B_Chal_Rdy sia_B_Cmp_Ok sia_B_Cmp_Rdy sia_B_Hlp_Cycl sia_B_Load_SKA sia_B_Load_ZZ sia_B_New_Data sia_B_SKA_Rdy sia_B_Wr_SKA sia_B_Wr_ZZ sia_B_ZZ_Rdy sia_Check_Cond_mp sia_Com_Cnt sia_Com_Command_mp sia_Com_Ctrl sia_Com_Status_mp sia_Com_Timer sia_Data_Buf_Chal sia_Data_Buf_Cmp sia_Data_Buf_Resp sia_Elem_No sia_Error1_Tmp sia_Error_1 sia_Error_2 sia_Error_Array sia_NvMem_Cd sia_NvMem_Cd_St sia_NvMem_Cnt sia_Release sia_Resp_Rdy_mp sia_RndOutb sia_Rnd_D sia_Rnd_ZZ sia_Secret_Key_A sia_SK_Hlp_Ar sia_SM sia_sm_mp sia_Tstr_Array sia_Tstr_Cnt sia_TS_Res sia_t_Auth_Cycl sia_t_Auth_Delay /end LOC_MEASUREMENT
/end FUNCTION
/begin FUNCTION Sia_EmsIfc ""
 /begin LOC_MEASUREMENT Sia_bFlPmpLck Sia_bFshPrgLck Sia_bIgnLck Sia_bInjLck Sia_bStaLck Sia_bThrVlvLck Sia_DataEepProt_command_mp Sia_DataEepProt_length_mp Sia_DataEepProt_status_mp Sia_errorCommand_mp Sia_numDataByte_mp Sia_numDfp_mp Sia_stEepOrder_mp Sia_stType_mp /end LOC_MEASUREMENT
/end FUNCTION
/begin FUNCTION Signals "" /end FUNCTION
/begin FUNCTION signals_auto "" /begin DEF_CHARACTERISTIC Signals_Mode1Pid_CA Signals_Mode1SigNum_CA /end DEF_CHARACTERISTIC /end FUNCTION
/begin FUNCTION Sil_FlapCtl ""
 /begin DEF_CHARACTERISTIC Sil_nEngLim_C Sil_rLogicOutNHys_C Sil_rLogicOutQHys_C Sil_stFlapRgn_MAP Sil_stFlap_MAP Sil_stMskRgn_C /end DEF_CHARACTERISTIC
 /begin IN_MEASUREMENT CoEng_st CoEOM_stOpModeAct Epm_nEng InjCtl_qCurr Sil_stLogic /end IN_MEASUREMENT
 /begin LOC_MEASUREMENT Sil_stDemFlap_mp /end LOC_MEASUREMENT
/end FUNCTION
/begin FUNCTION smklim_airmssel "" /begin OUT_MEASUREMENT SmkLim_mAirPerCyl /end OUT_MEASUREMENT /end FUNCTION
/begin FUNCTION smklim_fullldrgl "" /begin OUT_MEASUREMENT SmkLim_qFullLdRgl /end OUT_MEASUREMENT /end FUNCTION
/begin FUNCTION smklim_injmasslim ""
 /begin DEF_CHARACTERISTIC SmkLim_mAirPerCylMin_C SmkLim_numSmkLim_C SmkLim_rLamFullLd_MAP SmkLim_rLamMax_C SmkLim_rLamMin_C SmkLim_rLamSmk_MAP /end DEF_CHARACTERISTIC
 /begin IN_MEASUREMENT Epm_nEng SmkLim_mAirPerCyl /end IN_MEASUREMENT
 /begin OUT_MEASUREMENT SmkLim_mAirPerCylLim_mp SmkLim_qLimSmk SmkLim_qLimSmkBas_mp SmkLim_rLamFullLd_mp SmkLim_rLamSet SmkLim_rLamSmk_mp SmkLim_rLamUnLim_mp SmkLim_tSmkLim_mp /end OUT_MEASUREMENT
/end FUNCTION
/begin FUNCTION SpdGov_TrqCalc ""
 /begin DEF_CHARACTERISTIC SpdGov_stMskMoLimFunc_C SpdGov_stMskMoLimTrq_C SpdGov_stMskNegCurrTrqEna_C SpdGov_stMskNegLdTrqEna_C /end DEF_CHARACTERISTIC
 /begin IN_MEASUREMENT EngTrqPtd_trqSpdG HLSDem_nSetPHi HLSDem_nSetPLo ISC_nSetPHi ISC_nSetPLo ISC_numCurrFunc ISC_trq ISC_trqFlt ISC_trqLoLimMin ISC_trqLoLtd /end IN_MEASUREMENT
 /begin OUT_MEASUREMENT SpdGov_nSetPHi SpdGov_nSetPLo SpdGov_st SpdGov_trqFlt SpdGov_trqInrLimSet SpdGov_trqLead /end OUT_MEASUREMENT
 /begin LOC_MEASUREMENT SpdGov_stMoLim_mp SpdGov_trqSet /end LOC_MEASUREMENT
/end FUNCTION
/begin FUNCTION Spi "" /end FUNCTION
/begin FUNCTION Srv "" /begin SUB_FUNCTION SrvB SrvF SrvX ExeCon /end SUB_FUNCTION /end FUNCTION
/begin FUNCTION SrvB "" /end FUNCTION
/begin FUNCTION SrvF "" /end FUNCTION
/begin FUNCTION SrvX "" /end FUNCTION
/begin FUNCTION sseui_setdata "" /begin IN_MEASUREMENT SSEUI_stStopStrtSwt /end IN_MEASUREMENT /begin OUT_MEASUREMENT SSEUI_stStopStrtEna /end OUT_MEASUREMENT /end FUNCTION
/begin FUNCTION sswts_auto "" /begin DEF_CHARACTERISTIC SSwtS_swtGlbTyp_C SSwtS_Val.WaHtEl_swtVal_C /end DEF_CHARACTERISTIC /end FUNCTION
/begin FUNCTION SSwtS_GetSwt "" /end FUNCTION
/begin FUNCTION SSwtS_SetSwt "" /end FUNCTION
/begin FUNCTION stapmp_trqload ""
 /begin DEF_CHARACTERISTIC StAPmp_facBas_MAP StAPmp_facTxRatio_C StAPmp_nMin_C StAPmp_nResvXHi_C StAPmp_nResvXLo_C StAPmp_phiDiffWhlMax_C StAPmp_rWhlPhi_C StAPmp_stTrqResvEn_CW StAPmp_tiTrqDes_C StAPmp_tiTrqDynPT1_C StAPmp_tiTrqResv_C StAPmp_trqBasDef_C StAPmp_trqBas_CUR StAPmp_trqDesHysHi_C StAPmp_trqDesHysLo_C StAPmp_trqDesMaxLim_C StAPmp_trqDesMinLim_C StAPmp_trqDynDef_C StAPmp_trqDyn_MAP StAPmp_trqPhiMax_C StAPmp_trqResvDef_C StAPmp_trqResvHysHi_C StAPmp_trqResvHysLo_C StAPmp_trqResvMaxLim_C StAPmp_trqResvMinLim_C StAPmp_trqResv_MAP /end DEF_CHARACTERISTIC
 /begin IN_MEASUREMENT Epm_nEng GlbDa_vX StDa_ddphiStrgWhl StDa_dphiStrgWhl StDa_phiStrgWhlMax VehMot_phiStrgWhl /end IN_MEASUREMENT
 /begin OUT_MEASUREMENT Strg_nMin Strg_trqDes Strg_trqResv /end OUT_MEASUREMENT
 /begin LOC_MEASUREMENT StAPmp_phiDiffStrgWhl StAPmp_phiDiffStrgWhl_mp StAPmp_phiStrgWhlAbs StAPmp_phiStrgWhlAbs_mp StAPmp_stHysDes_mp StAPmp_stHysResv_mp StAPmp_trqBas_mp StAPmp_trqDesLim_mp StAPmp_trqDesWhlMaxFac_mp StAPmp_trqDes_mp StAPmp_trqDynRaw_mp StAPmp_trqDyn_mp StAPmp_trqResvFinal_mp StAPmp_trqResvLim_mp /end LOC_MEASUREMENT
/end FUNCTION
/begin FUNCTION stapmp_trqload_inl "" /end FUNCTION
/begin FUNCTION stda_dataacq ""
 /begin DEF_CHARACTERISTIC StDa_ddphiInitVal_C StDa_ddphiStrgWhlMax_C StDa_ddphiStrgWhlMin_C StDa_dphiInitVal_C StDa_dphiStrgWhlMax_C StDa_dphiStrgWhlMin_C StDa_phiInitVal_C StDa_phiStrgWhlMax_C StDa_stAddFilter_CW StDa_stDphiDE_CW StDa_tiddPhiPT1_C StDa_tidPhiPT1_C StDa_tiHoldTimeSec_C StDa_tiPhiPT1_C StDa_vXLimit_C /end DEF_CHARACTERISTIC
 /begin IN_MEASUREMENT GlbDa_vX StWhl_dphiAg StWhl_phiAg /end IN_MEASUREMENT
 /begin OUT_MEASUREMENT StDa_ddphiStrgWhl StDa_dphiStrgWhl StDa_phiStrgWhlMax VehMot_phiStrgWhl /end OUT_MEASUREMENT
 /begin LOC_MEASUREMENT StDa_ddphiSign_mp StDa_ddphiStrgWhl1_mp StDa_ddphiStrgWhl2_mp StDa_ddphiStrgWhl3_mp StDa_dphiSign_mp StDa_dphiStrgWhl1_mp StDa_dphiStrgWhl2_mp StDa_dphiStrgWhl3_mp StDa_stCount_mp StDa_stSpeed_mp /end LOC_MEASUREMENT
/end FUNCTION
/begin FUNCTION Stm58Bw016 "" /end FUNCTION
/begin FUNCTION strg_demand "" /begin OUT_MEASUREMENT Strg_nMax /end OUT_MEASUREMENT /end FUNCTION
/begin FUNCTION Strt_DD ""
 /begin DEF_CHARACTERISTIC Strt_DigOut.tiBtwTstSCB_C Strt_DigOut.tiBtwTstOT_C Strt_DigOut.numTstMax_C Strt_stPsDiaDisbl_C Strt_stPsDisbl_C /end DEF_CHARACTERISTIC
 /begin IN_MEASUREMENT DevLib_stPwrStgEnaCond /end IN_MEASUREMENT
 /begin OUT_MEASUREMENT Strt_st Strt_stPs /end OUT_MEASUREMENT
/end FUNCTION
/begin FUNCTION StSys_AddCor ""
 /begin DEF_CHARACTERISTIC StSys_facAPSCor_CUR StSys_numStrtAddCor_C StSys_trqStrtAPSCor_MAP /end DEF_CHARACTERISTIC
 /begin IN_MEASUREMENT EnvP_p Epm_nEng /end IN_MEASUREMENT
 /begin OUT_MEASUREMENT StSys_facAPSCor_mp StSys_trqAddCor StSys_trqStrtAPSCor_mp StSys_trqStrtAPS_mp StSys_tStrtCor_mp /end OUT_MEASUREMENT
/end FUNCTION
/begin FUNCTION StSys_Strt "" /begin DEF_CHARACTERISTIC StSys_nStrtCutOut_MAP StSys_numStrt_C StSys_tiStrtCutOut_C /end DEF_CHARACTERISTIC /begin IN_MEASUREMENT CoEng_st EngDa_tFld EnvP_p Epm_nEng /end IN_MEASUREMENT /begin OUT_MEASUREMENT StSys_stNewStrt StSys_stStrt StSys_stStrtCutOutMon /end OUT_MEASUREMENT /begin LOC_MEASUREMENT StSys_nThresStrtCutOut_mp StSys_tStrt_mp /end LOC_MEASUREMENT /end FUNCTION
/begin FUNCTION StSys_StrtBas ""
 /begin DEF_CHARACTERISTIC StSys_nAdjMax_C StSys_numStrtBas_C StSys_trqAdjMax_C StSys_trqAdjVal_C StSys_trqStrtBas_MAP /end DEF_CHARACTERISTIC
 /begin IN_MEASUREMENT CoEng_st EngDa_tFld Epm_nEng StSys_trqAddCor /end IN_MEASUREMENT
 /begin OUT_MEASUREMENT StSys_trqBas /end OUT_MEASUREMENT
 /begin LOC_MEASUREMENT StSys_trqAdj_mp StSys_trqSetAdjVal_mp StSys_trqStrtBas_mp StSys_tStrtBas_mp /end LOC_MEASUREMENT
/end FUNCTION
/begin FUNCTION StSys_StrtCtl "" /begin IN_MEASUREMENT StSys_stStrtTip /end IN_MEASUREMENT /begin OUT_MEASUREMENT StSys_st /end OUT_MEASUREMENT /begin SUB_FUNCTION StSys_StrtCtl /end SUB_FUNCTION /end FUNCTION
/begin FUNCTION StSys_StrtRmp ""
 /begin DEF_CHARACTERISTIC StSys_CldEng.dtrqInc_C StSys_CldEng.tiRmpLck_C StSys_CldEng.trqLim_C StSys_HotEng.dtrqInc_C StSys_HotEng.tiRmpLck_C StSys_HotEng.trqLim_C StSys_nFreezeTrqRmp_C StSys_nReleaseTrqRmp_C StSys_numStrtRmp_C StSys_tClntHi_C StSys_tClntLo_C StSys_tiEngTempValid_C StSys_WrmEng.dtrqInc_C StSys_WrmEng.tiRmpLck_C StSys_WrmEng.trqLim_C /end DEF_CHARACTERISTIC
 /begin IN_MEASUREMENT CoEng_st EngDa_tFld Epm_nEng StSys_stTrqShutOff StSys_trqBas /end IN_MEASUREMENT
 /begin OUT_MEASUREMENT StSys_stRmpMon StSys_trqRmpState StSys_trqStrt /end OUT_MEASUREMENT
 /begin LOC_MEASUREMENT StSys_tStrtRmp_mp /end LOC_MEASUREMENT
/end FUNCTION
/begin FUNCTION stsys_strttip ""
 /begin DEF_CHARACTERISTIC StSys_nStrtTipMax_MAP StSys_nStrtTipProt_C StSys_swtGlwLamp_C StSys_swtShOffGearbxRec_C StSys_swtStrtTipActv_C StSys_tiStrtLck_C StSys_tiStrtMax_C StSys_tiStrtTipMin_C StSys_tiStrtTipNoMonitor_C StSys_tiStrtTipProt_C /end DEF_CHARACTERISTIC
 /begin IN_MEASUREMENT EngDa_tEng EnvP_p /end IN_MEASUREMENT
 /begin OUT_MEASUREMENT StSys_stStrtTip StSys_stStrtTipOFF StSys_stStrtTipON /end OUT_MEASUREMENT
/end FUNCTION
/begin FUNCTION StSys_TrqShutOff ""
 /begin DEF_CHARACTERISTIC StSys_n2MsWhlLoLim_C StSys_n2MsWhlUpOfs_C StSys_swtShutOff_C StSys_ti2MsWhlPrt_C StSys_tinFltPT1_C /end DEF_CHARACTERISTIC
 /begin OUT_MEASUREMENT StSys_stTrqShutOff /end OUT_MEASUREMENT
 /begin LOC_MEASUREMENT StSys_nEpmFlt_mp StSys_stTrqShutOffCond_mp /end LOC_MEASUREMENT
/end FUNCTION
/begin FUNCTION SyC_CalWakeup "" /begin IN_MEASUREMENT SyC_stMn SyC_stT15 /end IN_MEASUREMENT /end FUNCTION
/begin FUNCTION SyC_Deadline "" /begin LOC_MEASUREMENT SyC_ctDeadline1msErr /end LOC_MEASUREMENT /end FUNCTION
/begin FUNCTION SyC_Main "" /begin DEF_CHARACTERISTIC SyC_stTest_C SyC_swtTestEna_C /end DEF_CHARACTERISTIC /begin IN_MEASUREMENT MoCCom_stWDAActvMsg SyC_stPostDrv SyC_stPreDrv T15_st /end IN_MEASUREMENT
 /begin OUT_MEASUREMENT SyC_stMn SyC_stMnOld SyC_stSub SyC_stSubOld SyC_stT15 SyC_tiDrv SyC_tiPostDrv SyC_tiPreDrv /end OUT_MEASUREMENT
 /begin LOC_MEASUREMENT SyC_ctIrrSwOff_mp SyC_tiBoot_mp SyC_tiIniEnd_mp SyC_tiIniSyn_mp SyC_tiIni_mp SyC_tiShutdown_mp /end LOC_MEASUREMENT
/end FUNCTION
/begin FUNCTION SyC_PostDrv "" /begin DEF_CHARACTERISTIC SyC_tiPostDrvMax_C SyC_tiPostDrvMin_C /end DEF_CHARACTERISTIC /begin IN_MEASUREMENT Epm_nEng SyC_stSub /end IN_MEASUREMENT /begin OUT_MEASUREMENT SyC_stPostDrv /end OUT_MEASUREMENT /begin LOC_MEASUREMENT SyC_stPostDrvFin_mp /end LOC_MEASUREMENT /end FUNCTION
/begin FUNCTION SyC_PreDrv "" /begin DEF_CHARACTERISTIC SyC_swtPreDrv_C SyC_tiPreDrvMax_C /end DEF_CHARACTERISTIC /begin IN_MEASUREMENT MRly_st MRly_stAct SyC_stSub SyC_stT15 /end IN_MEASUREMENT /begin OUT_MEASUREMENT SyC_stPreDrv /end OUT_MEASUREMENT
 /begin LOC_MEASUREMENT SyC_ctSwtOnCan_mp SyC_ctSwtOnEin_mp SyC_ctSwtOnStc_mp SyC_ctSwtOnWak_mp SyC_stSwtOn_mp /end LOC_MEASUREMENT
/end FUNCTION
/begin FUNCTION SyC_Shutdown "" /end FUNCTION
/begin FUNCTION SyC_StopCnt "" /begin DEF_CHARACTERISTIC SyC_tiStopCntMax_C /end DEF_CHARACTERISTIC /begin OUT_MEASUREMENT SyC_stVldTiEcuOff SyC_tiEcuOff /end OUT_MEASUREMENT /end FUNCTION
/begin FUNCTION SyC_UnderVltg "" /begin LOC_MEASUREMENT SyC_ctInit_mp SyC_ctUnderVltg_mp SyC_tiUnderVltg_mp /end LOC_MEASUREMENT /end FUNCTION
/begin FUNCTION T15_DD "" /begin DEF_CHARACTERISTIC T15_Deb.tiHiLo_C T15_Deb.tiLoHi_C /end DEF_CHARACTERISTIC /begin OUT_MEASUREMENT T15_stRaw /end OUT_MEASUREMENT /end FUNCTION
/begin FUNCTION T15_Rst "" /end FUNCTION
/begin FUNCTION T15_VD "" /begin DEF_CHARACTERISTIC T15_tiDebWakeUp_C /end DEF_CHARACTERISTIC /begin IN_MEASUREMENT Com_stT15 T15_stRaw /end IN_MEASUREMENT /begin OUT_MEASUREMENT T15_st T15_stWakeUp /end OUT_MEASUREMENT /begin LOC_MEASUREMENT T15_stCondDeb_mp T15_stDebWakeUp T15_stLogic_mp /end LOC_MEASUREMENT /end FUNCTION
/begin FUNCTION t15_vd_calwup "" /end FUNCTION
/begin FUNCTION t50_dd ""
 /begin DEF_CHARACTERISTIC T50_Deb.tiHiLo_C T50_Deb.tiLoHi_C T50_stDflVal_C T50_swtSig_C /end DEF_CHARACTERISTIC
 /begin IN_MEASUREMENT Com_stT50 /end IN_MEASUREMENT
 /begin LOC_MEASUREMENT T50_stRaw /end LOC_MEASUREMENT
/end FUNCTION
/begin FUNCTION t50_vd "" /begin OUT_MEASUREMENT T50_st /end OUT_MEASUREMENT /end FUNCTION
/begin FUNCTION TAA_Adap ""
 /begin DEF_CHARACTERISTIC TAA_facDynMax_C TAA_facSinTab_CA TAA_nAdapMid_CA TAA_nAdapRng_CA TAA_numGapIpoInc_C TAA_numSinTab_C TAA_phiDiffMax_CA TAA_stMainSpdRng_C TAA_stReqRstVal_C TAA_tiIncDvtFlt_C /end DEF_CHARACTERISTIC
 /begin IN_MEASUREMENT TAA_numActv TAA_stAdap /end IN_MEASUREMENT
 /begin OUT_MEASUREMENT TAA_stFin /end OUT_MEASUREMENT
 /begin LOC_MEASUREMENT TAA_ctBufSect_mp TAA_facDyn_mp TAA_phiIncDvt_mp TAA_stAdapMode_mp TAA_stAdapVal_mp TAA_stSpdRngWr_mp TAA_tiIncAvrg_mp TAA_tiInc_mp /end LOC_MEASUREMENT
/end FUNCTION
/begin FUNCTION TAA_Ctl ""
 /begin DEF_CHARACTERISTIC TAA_ctIncTstOfs_C TAA_nMax_C TAA_nMin_C TAA_numActv_CA TAA_numIncGap_CA TAA_numRevCor_C TAA_rTrqMax_C TAA_stAdapMode_C TAA_stEvalFin_C TAA_stExtp_C TAA_stTstMode_C TAA_tiEnaDel_C TAA_tiIncTst_CA TAA_vMin_C /end DEF_CHARACTERISTIC
 /begin REF_CHARACTERISTIC EpmSeq_phiInt_CA Epm_numCyl_C Epm_phiTdc1_C /end REF_CHARACTERISTIC
 /begin IN_MEASUREMENT Brk_st Clth_st CoEng_st EpmSeq_numInt EpmSyn_phiInt Epm_nEng Epm_stOpMode Epm_stSync PthSet_stOvrRunCoord PT_rTrq TAA_stFin VehV_v /end IN_MEASUREMENT
 /begin OUT_MEASUREMENT TAA_numActv TAA_stAdap /end OUT_MEASUREMENT
 /begin LOC_MEASUREMENT TAA_ctAngDvt_mp TAA_facIpo_mp TAA_nMinCalc_mp TAA_numIncBefGap_mp TAA_numIncIR_mp TAA_phiAngDvt_mp TAA_stEnaCond_mp TAA_stErr_mp TAA_stIdxSync_mp TAA_stIpoMode_mp TAA_stRev2Fin_mp TAA_stRlsOvrRunCo_mp TAA_stSpdRngRdHi_mp TAA_stSpdRngRdLo_mp /end LOC_MEASUREMENT
/end FUNCTION
/begin FUNCTION TAA_FuncLib "" /begin REF_CHARACTERISTIC Epm_phiGap2Zero_C /end REF_CHARACTERISTIC /end FUNCTION
/begin FUNCTION TAA_HndlBuf "" /end FUNCTION
/begin FUNCTION TCPrt_ChrgPmpCtl ""
 /begin DEF_CHARACTERISTIC TCPrt_dnChrgPmpCtlHigh_CUR TCPrt_dnChrgPmpCtlLow_CUR TCPrt_nChrgPmpMon1_C TCPrt_nChrgPmpMon2_C TCPrt_nHLSDemBase_C TCPrt_nSetPointHLSDem_C TCPrt_qChrgPmpCtlHigh_CUR TCPrt_qChrgPmpCtlLow_CUR TCPrt_rChrgPmpCtlValHigh_MAP TCPrt_rChrgPmpCtlValOfs_CUR TCPrt_rChrgPmpCtlVal_MAP TCPrt_rChrgPmpHigh_MAP TCPrt_rChrgPmpOfs_CUR TCPrt_swtChrgPmpGearHLSDem_C TCPrt_swtChrgPmpGearTrbCh_C TCPrt_swtOffStat1_C TCPrt_tiChrgPmpCtlHiLo_C TCPrt_tiChrgPmpCtlLoHi_C TCPrt_tiChrgPmpMonHLSDem_C TCPrt_tiChrgPmpPT1_C /end DEF_CHARACTERISTIC
 /begin IN_MEASUREMENT Air_pCACDs Clth_st EnvP_p Epm_dnEng Epm_nEng PCR_qCtlVal PT_stTraType /end IN_MEASUREMENT
 /begin OUT_MEASUREMENT TCPrt_dnAvrg TCPrt_nSetPointChrgPmp TCPrt_rChrgPmpCtlVal TCPrt_rPresRat TCPrt_stChrgPmpCtl /end OUT_MEASUREMENT
 /begin LOC_MEASUREMENT TCPrt_dnAvrgNeg_mp TCPrt_dnChrgPmpCtlHigh_mp TCPrt_dnChrgPmpCtlLow_mp TCPrt_qChrgPmpCtlHigh_mp TCPrt_qChrgPmpCtlLow_mp TCPrt_rChrgPmpCtlValHigh_mp TCPrt_rChrgPmpCtlValLow_mp TCPrt_rChrgPmpHysHigh_mp TCPrt_rChrgPmpHysLow_mp TCPrt_stChrgPmp1_mp TCPrt_stChrgPmpCtl_mp TCPrt_stChrgPmpHLSDem_mp TCPrt_stChrgPmpPre1_mp /end LOC_MEASUREMENT
/end FUNCTION
/begin FUNCTION TCPrt_ChrgPmpDet ""
 /begin DEF_CHARACTERISTIC TCPrt_DkdChrgPmpDetMDT12_C TCPrt_DkdChrgPmpDetMDT1_C TCPrt_facAFSensAmpMax_C TCPrt_facAFSensAmpMin_C TCPrt_facCnv_CUR TCPrt_tiAFSensPTCtlFlt1_C TCPrt_tiAFSensPTCtlFlt2_C TCPrt_tiAFSensPTCtlFlt3_C TCPrt_tiChrgPmpDetMDT12_C TCPrt_tiChrgPmpDetMDT1_C TCPrt_tiDebChrgPmpHiLo_C TCPrt_tiDebChrgPmpLoHi_C TCPrt_tiDebPreChrgPmpDetHiLo_C TCPrt_tiDebPreChrgPmpDetLoHi_C /end DEF_CHARACTERISTIC
 /begin IN_MEASUREMENT AFS_dmSens /end IN_MEASUREMENT
 /begin OUT_MEASUREMENT TCPrt_facAFSensAmpFlt TCPrt_stChrgPmp TCPrt_stPreChrgPmp /end OUT_MEASUREMENT
 /begin LOC_MEASUREMENT TCPrt_facAFSensAmpFlt_mp TCPrt_facAFSensDTAbsAmp2_mp TCPrt_facAFSensDTAmp12_mp TCPrt_facAFSensPTAmp12_mp TCPrt_facAFSensPTAmp1_mp TCPrt_facAFSensPTAmp2_mp TCPrt_facAFSensPTAmpFlt_mp /end LOC_MEASUREMENT
/end FUNCTION
/begin FUNCTION TCPrt_ChrgPmpGov ""
 /begin DEF_CHARACTERISTIC TCPrt_DKdChrgPmpCtlQDT1_C TCPrt_dnChrgPmpCtlRls_C TCPrt_dpChrgPmpCtlRmpDwn_C TCPrt_dpChrgPmpCtlRmpUp_C TCPrt_dqChrgPmpCtlRls_C TCPrt_drChrgPmpCtlRmpDwn_C TCPrt_drChrgPmpCtlRmpUp_C TCPrt_facChrgPmpDes_MAP TCPrt_facChrgPmpIWinNeg_C TCPrt_facChrgPmpIWinPos_C TCPrt_facChrgPmpI_MAP TCPrt_facChrgPmpPWinNeg_C TCPrt_facChrgPmpPWinPos_C TCPrt_facChrgPmpP_MAP TCPrt_IChrgPmpKiNeg_C TCPrt_IChrgPmpKiPos_C TCPrt_IChrgPmpKi_C TCPrt_pChrgPmpCtlVal_MAP TCPrt_PChrgPmpKpNeg_C TCPrt_PChrgPmpKpPos_C TCPrt_PChrgPmpKp_C TCPrt_pChrgPmpMax_MAP TCPrt_pChrgPmpMin_MAP TCPrt_pDesChrgPmp_CUR TCPrt_pDvtChrgPmpCtlRls_C TCPrt_rChrgPmpGovOff_CUR TCPrt_rChrgPmpGovOn_MAP TCPrt_rChrgPmpGov_MAP TCPrt_swtChrgPmpGovActv_C TCPrt_swtChrgPmpGovSel_C TCPrt_tiChrgPmpCtlHiLoRls3_C TCPrt_tiChrgPmpCtlLoHiRls3_C TCPrt_tiChrgPmpCtlQDT1_C TCPrt_tiChrgPmpGovPT1_C TCPrt_tiChrgPmpGovRlsAllHiLo_C TCPrt_tiChrgPmpGovRlsAllLoHi_C /end DEF_CHARACTERISTIC
 /begin IN_MEASUREMENT EnvP_pSens Epm_nEng /end IN_MEASUREMENT
 /begin OUT_MEASUREMENT TCPrt_pDesChrgPmpGov TCPrt_rChrgPmpGov TCPrt_swtChrgPmpGov /end OUT_MEASUREMENT
 /begin LOC_MEASUREMENT TCPrt_dqInjCtlQRaw_mp TCPrt_facChrgPmpDes_mp TCPrt_facChrgPmpGovDevI_mp TCPrt_facChrgPmpGovDev_mp TCPrt_facChrgPmpI_mp TCPrt_facChrgPmpP_mp TCPrt_pChrgPmpCtlVal_mp TCPrt_pChrgPmpMax_mp TCPrt_pChrgPmpMin_mp TCPrt_pChrgPmpPICtlLim_mp TCPrt_pChrgPmpPICtl_mp TCPrt_pChrgPmpstI_mp TCPrt_pDesChrgPmpRaw_mp TCPrt_pOutI_mp TCPrt_pOutP_mp TCPrt_rChrgPmpGovHysOff_mp TCPrt_rChrgPmpGovOff_mp TCPrt_rChrgPmpGovOn_mp TCPrt_rChrgPmpGovRaw_mp TCPrt_swtChrgPmpGovRls_mp TCPrt_swtChrgPmpGovSel_mp /end LOC_MEASUREMENT
/end FUNCTION
/begin FUNCTION TECU_DD "" /begin DEF_CHARACTERISTIC TECU_SRC.uMin_C TECU_SRC.uMax_C TECU_tTransf_CUR /end DEF_CHARACTERISTIC /begin OUT_MEASUREMENT TECU_tSens TECU_uRaw /end OUT_MEASUREMENT /end FUNCTION
/begin FUNCTION TECU_VD ""
 /begin DEF_CHARACTERISTIC TECU_RmpSlp.Pos_C TECU_RmpSlp.Neg_C TECU_TransStg.Dfl_C TECU_TransStg.stSensId_C /end DEF_CHARACTERISTIC
 /begin OUT_MEASUREMENT TECU_t /end OUT_MEASUREMENT
/end FUNCTION
/begin FUNCTION ThrVlv_DD ""
 /begin DEF_CHARACTERISTIC ThrVlv_4WinSigDur.tiErr1Min_C ThrVlv_4WinSigDur.tiErr1Max_C ThrVlv_4WinSigDur.tiErr2Min_C ThrVlv_4WinSigDur.tiErr2Max_C ThrVlv_4WinSigDur.tiErr3Min_C ThrVlv_4WinSigDur.tiErr3Max_C ThrVlv_4WinSigDur.tiErr4Min_C ThrVlv_4WinSigDur.tiErr4Max_C ThrVlv_Pwm.tiPer_C ThrVlv_Pwm.stLvl_C ThrVlv_Pwm.rMaxDty_C ThrVlv_Pwm.rPerUn_C ThrVlv_Pwm.tiPh_C ThrVlv_PwmOut.rMin_C ThrVlv_PwmOut.rMax_C ThrVlv_PwmOut.tiBtwTstSCB_C ThrVlv_PwmOut.tiBtwTstOT_C ThrVlv_PwmOut.numTstMax_C ThrVlv_PwmOut.swtBattCor_C ThrVlv_PwmOut.swtPsInv_C ThrVlv_rCnv_CUR ThrVlv_rPsDisbl_C ThrVlv_stPsDiaDisbl_C ThrVlv_stPsDisbl_C ThrVlv_typ4WinDia_C /end DEF_CHARACTERISTIC
 /begin IN_MEASUREMENT BattU_facCor DevLib_stPwrStgEnaCond /end IN_MEASUREMENT
 /begin OUT_MEASUREMENT ThrVlv_r ThrVlv_rPs /end OUT_MEASUREMENT
 /begin LOC_MEASUREMENT ThrVlv_stErrMsg_mp /end LOC_MEASUREMENT
/end FUNCTION
/begin FUNCTION ThrVlv_DDSens "" /begin DEF_CHARACTERISTIC ThrVlv_rTransf_CUR ThrVlv_SRC.uMin_C ThrVlv_SRC.uMax_C /end DEF_CHARACTERISTIC /begin OUT_MEASUREMENT ThrVlv_rSens ThrVlv_uRaw /end OUT_MEASUREMENT /end FUNCTION
/begin FUNCTION ThrVlv_VDSens ""
 /begin DEF_CHARACTERISTIC ThrVlv_RmpSlp.Pos_C ThrVlv_RmpSlp.Neg_C ThrVlv_TransStagePar.Dfl_C ThrVlv_TransStagePar.stSensId_C /end DEF_CHARACTERISTIC
 /begin OUT_MEASUREMENT ThrVlv_rAct /end OUT_MEASUREMENT
/end FUNCTION
/begin FUNCTION Tle6232 "" /end FUNCTION
/begin FUNCTION TOxiCatUs_DD ""
 /begin DEF_CHARACTERISTIC Exh_SRCTOxiCatUs.uMin_C Exh_SRCTOxiCatUs.uMax_C Exh_swtSensTOxiCatUs_C Exh_tTransfTOxiCatUs_CUR /end DEF_CHARACTERISTIC
 /begin OUT_MEASUREMENT Exh_tSensTOxiCatUs Exh_uRawTOxiCatUs /end OUT_MEASUREMENT
/end FUNCTION
/begin FUNCTION TOxiCatUs_VD ""
 /begin DEF_CHARACTERISTIC Exh_numFldTOxiCatUs_C Exh_numTOxiCatUs_C Exh_RmpSlpTOxiCatUs.Pos_C Exh_RmpSlpTOxiCatUs.Neg_C Exh_stMskLckNplTOxiCatUs_C Exh_tDiffNegTOxiCatUs_CUR Exh_tDiffPosTOxiCatUs_CUR Exh_tiLckNplRgnTOxiCatUs_C Exh_tiLckNplTOxiCatUs_C Exh_tiLPFltPT1TOxiCatUs_C Exh_TransStgTOxiCatUs.Dfl_C Exh_TransStgTOxiCatUs.stSensId_C /end DEF_CHARACTERISTIC
 /begin IN_MEASUREMENT ASMod_tEGFld CoEng_st CoEOM_stOpModeAct Exh_tFld /end IN_MEASUREMENT
 /begin OUT_MEASUREMENT Exh_tAdapTOxiCatUs Exh_tOxiCatUs /end OUT_MEASUREMENT
 /begin LOC_MEASUREMENT Exh_stEgtTOxiCatUs_mp Exh_stTmrPlausTOxiCatUs_mp Exh_tDiffNegTOxiCatUs_mp Exh_tDiffPosTOxiCatUs_mp Exh_tModTOxiCatUs_mp /end LOC_MEASUREMENT
/end FUNCTION
/begin FUNCTION TPFltUs_DD ""
 /begin DEF_CHARACTERISTIC Exh_SRCTPFltUs.uMin_C Exh_SRCTPFltUs.uMax_C Exh_tTransfTPFltUs_CUR /end DEF_CHARACTERISTIC
 /begin OUT_MEASUREMENT Exh_tSensTPFltUs Exh_uRawTPFltUs /end OUT_MEASUREMENT
/end FUNCTION
/begin FUNCTION TPFltUs_VD ""
 /begin DEF_CHARACTERISTIC Exh_numTPFltUs_C Exh_RmpSlpTPFltUs.Pos_C Exh_RmpSlpTPFltUs.Neg_C Exh_stMaskLckNplTPFltUs_C Exh_swtDflTPFltUs_C Exh_tDiffNegTPFltUs_CUR Exh_tDiffPosTPFltUs_CUR Exh_tiLckNplRgnTPFltUs_C Exh_tiLckNplTPFltUs_C Exh_TransStageParTPFltUs.Dfl_C Exh_TransStageParTPFltUs.stSensId_C /end DEF_CHARACTERISTIC
 /begin IN_MEASUREMENT ASMod_tEGFld CoEng_st CoEOM_stOpModeAct /end IN_MEASUREMENT
 /begin OUT_MEASUREMENT Exh_tAdapTPFltUs Exh_tPFltUs /end OUT_MEASUREMENT
 /begin LOC_MEASUREMENT Exh_tDiffNegTPFltUs_mp Exh_tDiffPosTPFltUs_mp Exh_tDiffTPFltUs_mp Exh_tEGFldTPFltUs_mp /end LOC_MEASUREMENT
/end FUNCTION
/begin FUNCTION tra_add ""
 /begin DEF_CHARACTERISTIC Tra_bCanAirCanPtd_C Tra_bCanClntCanPtd_C Tra_rClgDem_C Tra_tClntDes_C /end DEF_CHARACTERISTIC
 /begin IN_MEASUREMENT Gbx_rFanClgDem Gbx_tClntDes /end IN_MEASUREMENT
 /begin OUT_MEASUREMENT Tra_rClgDem Tra_tClntDes /end OUT_MEASUREMENT
/end FUNCTION
/begin FUNCTION Tra_GearInfo ""
 /begin DEF_CHARACTERISTIC PT_numTraGear1_C PT_numTraGear2_C PT_numTraGear3_C PT_numTraGear4_C PT_numTraGear5_C PT_numTraGear6_C PT_numTraGear7_C PT_numTraGearR_C PT_numTraNoGear_C PT_rTraGear1_C PT_rTraGear2_C PT_rTraGear3_C PT_rTraGear4_C PT_rTraGear5_C PT_rTraGear6_C PT_rTraGearR_C PT_rTraLoRng_C PT_rTraMax_C Tra_bCanInfoCan_C Tra_bCanLevPos_C Tra_bCanLoRng_C Tra_bCanRevGear_C Tra_bCanRTra_C Tra_bGbxNPosEna_C Tra_bStrtStopEnaDfl_C Tra_nEngMin_C Tra_numLevPosCan_C Tra_rV2NDfl_C Tra_rVn1H_C Tra_rVn1L_C Tra_rVn1To2Des_C Tra_rVn2H_C Tra_rVn2L_C Tra_rVn2To3Des_C Tra_rVn3H_C Tra_rVn3L_C Tra_rVn3To4Des_C Tra_rVn4H_C Tra_rVn4L_C Tra_rVn4To5Des_C Tra_rVn5H_C Tra_rVn5L_C Tra_rVn5To6Des_C Tra_rVn6H_C Tra_rVn6L_C Tra_rVnRH_C Tra_rVnRL_C Tra_stLevPosD_C Tra_swtLevPosSlct_CA Tra_swtTypeSlct_CA Tra_tOilDfl_C Tra_vMin_C /end DEF_CHARACTERISTIC
 /begin IN_MEASUREMENT Dfftl_bLowRng Epm_nEng GbxNPos_st Gbx_bRevGear Gbx_rTrqTra Gbx_stGear Gbx_stGearLvr Gbx_stGearTrgt GlbDa_vX PT_stTraType /end IN_MEASUREMENT
 /begin OUT_MEASUREMENT PT_numTraGear PT_numTraGearDes PT_numTraParGear PT_rTraGear PT_rTraGearDes PT_rTraV2N PT_stTraLoRng PT_stTraRevGear PT_stTraShftOp Tra_stStopEna Tra_stStrtEna /end OUT_MEASUREMENT
 /begin LOC_MEASUREMENT Tra_numDflGear_mp Tra_numOldGear Tra_numOldParGear Tra_rV2NLoRng_mp Tra_swtSlctGearInfoCan_mp Tra_tOil /end LOC_MEASUREMENT
/end FUNCTION
/begin FUNCTION tra_gearinfo_inl "" /end FUNCTION
/begin FUNCTION tra_grip "" /begin REF_CHARACTERISTIC PT_numTraNoGear_C /end REF_CHARACTERISTIC /begin IN_MEASUREMENT PT_numTraGear /end IN_MEASUREMENT /begin OUT_MEASUREMENT PT_stTraGrip /end OUT_MEASUREMENT /end FUNCTION
/begin FUNCTION Tra_Los "" /begin DEF_CHARACTERISTIC Tra_trqLos_C /end DEF_CHARACTERISTIC /begin OUT_MEASUREMENT Tra_trqLos /end OUT_MEASUREMENT /end FUNCTION
/begin COMPU_METHOD AgCrSHiReso "" RAT_FUNC "%6.5" "deg CrS" COEFFS 0 5825.24444444444 0 0 0 1 /end COMPU_METHOD
/begin COMPU_METHOD AirMassPerCyl "" RAT_FUNC "%6.3" "mg/Hub" COEFFS 0 10 0 0 0 1 /end COMPU_METHOD
/begin COMPU_METHOD Angle "" RAT_FUNC "%6.4" "deg" COEFFS 0 32 0 0 0 1 /end COMPU_METHOD
/begin COMPU_METHOD Angle2ndDerivative "" RAT_FUNC "%6.3" "deg/s2" COEFFS 0 8 0 0 0 1 /end COMPU_METHOD
/begin COMPU_METHOD AngleCrS "" RAT_FUNC "%6.4" "deg CrS" COEFFS 0 45.5097222222222 0 0 0 1 /end COMPU_METHOD
/begin COMPU_METHOD AngleDerivative "" RAT_FUNC "%6.4" "deg/s" COEFFS 0 16 0 0 0 1 /end COMPU_METHOD
/begin COMPU_METHOD DtyCyc "" RAT_FUNC "%6.4" "%" COEFFS 0 100 0 0 0 1 /end COMPU_METHOD
/begin COMPU_METHOD EngN "" RAT_FUNC "%6.3" "rpm" COEFFS 0 2 0 0 0 1 /end COMPU_METHOD
/begin COMPU_METHOD EngNGrd "" RAT_FUNC "%6.3" "rpm/s" COEFFS 0 2 0 0 0 1 /end COMPU_METHOD
/begin COMPU_METHOD EngTempFldSel "" TAB_VERB "%6.3" "-" COMPU_TAB_REF EngTempFldSel /end COMPU_METHOD
/begin COMPU_VTAB EngTempFldSel "" TAB_VERB 3 0 "Coolant_Temperature" 1 "Oil_Temperature" 2 "EngDa_tEng" /end COMPU_VTAB
/begin COMPU_METHOD ExeCon_State_01 "" TAB_VERB "%6.3" "-" COMPU_TAB_REF ExeCon_State_01 /end COMPU_METHOD
/begin COMPU_VTAB ExeCon_State_01 "" TAB_VERB 4 0 "SYC_BOOT" 1 "SYC_PROC_INIT" 2 "SYC_PROC_EXEC" 3 "SYC_SHUTDOWN" /end COMPU_VTAB
/begin COMPU_METHOD ExeCon_State_02 "" TAB_VERB "%6.3" "-" COMPU_TAB_REF ExeCon_State_02 /end COMPU_METHOD
/begin COMPU_VTAB ExeCon_State_02 "" TAB_VERB 7 0 "SYC_INI" 1 "SYC_INISYN" 2 "SYC_INIEND" 3 "SYC_PREDRIVE" 4 "SYC_DRIVE" 5 "SYC_POSTDRIVE" 6 "SYC_POST_OS_EXIT" /end COMPU_VTAB
/begin COMPU_METHOD Fact "" RAT_FUNC "%6.5" "-" COEFFS 0 8192 0 0 0 1 /end COMPU_METHOD
/begin COMPU_METHOD Fact1 "" RAT_FUNC "%6.4" "-" COEFFS 0 128 0 0 0 1 /end COMPU_METHOD
/begin COMPU_METHOD FactM "" RAT_FUNC "%6.4" "-" COEFFS 0 16 0 0 0 1 /end COMPU_METHOD
/begin COMPU_METHOD FacTrigoFunc "" RAT_FUNC "%6.5" "-" COEFFS 0 4096 0 0 0 1 /end COMPU_METHOD
/begin COMPU_METHOD IndSysTempFldSel "" TAB_VERB "%6.3" "-" COMPU_TAB_REF IndSysTempFldSel /end COMPU_METHOD
/begin COMPU_VTAB IndSysTempFldSel "" TAB_VERB 3 0 "CACDsT_t" 1 "AFST_t" 2 "EnvT_t" /end COMPU_VTAB
/begin COMPU_METHOD InjMass "" RAT_FUNC "%6.4" "mg/hub" COEFFS 0 100 0 0 0 1 /end COMPU_METHOD
/begin COMPU_METHOD InjMassPerSec_20ms "" RAT_FUNC "%6.3" "mg/hub/s" COEFFS 0 2 0 0 0 1 /end COMPU_METHOD
/begin COMPU_METHOD Kd_dm2FactM "" RAT_FUNC "%8.7" "Kg/h" COEFFS 0 104857.6 0 0 0 1 /end COMPU_METHOD
/begin COMPU_METHOD Kd_InjMass2Prc "" RAT_FUNC "%7.6" "%/(mg/Hub)" COEFFS 0 53687.0912 0 0 0 1 /end COMPU_METHOD
/begin COMPU_METHOD Ki_Pres_fac2hPa "" RAT_FUNC "%6.4" "hPa/s" COEFFS 0 134.217728 0 0 0 1 /end COMPU_METHOD
/begin COMPU_METHOD Kp_Pres_fac2hPa "" RAT_FUNC "%6.5" "hPa" COEFFS 0 2048 0 0 0 1 /end COMPU_METHOD
/begin COMPU_METHOD lambda "" RAT_FUNC "%6.5" "-" COEFFS 0 1000 0 0 0 1 /end COMPU_METHOD
/begin COMPU_METHOD OneToOne "" RAT_FUNC "%6.2" "-" COEFFS 0 1 0 0 0 1 /end COMPU_METHOD
/begin COMPU_METHOD OneToOne_ms "" RAT_FUNC "%6.2" "ms" COEFFS 0 1 0 0 0 1 /end COMPU_METHOD
/begin COMPU_METHOD OneToOne_us "" RAT_FUNC "%6.2" "us" COEFFS 0 1 0 0 0 1 /end COMPU_METHOD
/begin COMPU_METHOD Period "" RAT_FUNC "%6.3" "ms" COEFFS 0 10 0 0 0 1 /end COMPU_METHOD
/begin COMPU_METHOD Prc "" RAT_FUNC "%6.4" "%" COEFFS 0 81.92 0 0 0 1 /end COMPU_METHOD
/begin COMPU_METHOD Pres_hPa "" RAT_FUNC "%6.2" "hPa" COEFFS 0 1 0 0 0 1 /end COMPU_METHOD
/begin COMPU_METHOD Pres_Rail "" RAT_FUNC "%4.3" "bar" COEFFS 0 10.000000 0 0 0 1 /end COMPU_METHOD
/begin COMPU_METHOD RmpDtyCyc "" RAT_FUNC "%6.5" "%/s" COEFFS 0 6553.6 0 0 0 1 /end COMPU_METHOD
/begin COMPU_METHOD RmpPrc "" RAT_FUNC "%6.5" "%/s" COEFFS 0 5368.70912 0 0 0 1 /end COMPU_METHOD
/begin COMPU_METHOD RmpPres_hPa "" RAT_FUNC "%6.4" "hPa/s" COEFFS 0 65.536 0 0 0 1 /end COMPU_METHOD
/begin COMPU_METHOD RmpTemp "" RAT_FUNC "%6.4" "K/s" COEFFS 0 655.36 0 0 0 1 /end COMPU_METHOD
/begin COMPU_METHOD RmpTrq "" RAT_FUNC "%6.4" "Nm/s" COEFFS 0 655.36 0 0 0 1 /end COMPU_METHOD
/begin COMPU_METHOD Rtmo_Time_us "" RAT_FUNC "%6.4" "us" COEFFS 0 75 0 0 0 1 /end COMPU_METHOD
/begin COMPU_METHOD Signals_IntSigNumVerb "" TAB_VERB "%6.3" "-" COMPU_TAB_REF Signals_IntSigNumVerb /end COMPU_METHOD
/begin COMPU_VTAB Signals_IntSigNumVerb "" TAB_VERB 162 0 "SIGNALS_Signals_Default" 1 "SIGNALS_ETClb_ctLrn_mp[0]" 2 "SIGNALS_ETClb_ctLrn_mp[1]" 3 "SIGNALS_ETClb_ctLrn_mp[2]" 4 "SIGNALS_ETClb_dtiETFlt0_mp[0]" 5 "SIGNALS_ETClb_dtiETFlt0_mp[1]" 6 "SIGNALS_ETClb_dtiETFlt0_mp[2]" 7 "SIGNALS_ETClb_dtiETFlt0_mp[3]" 8 "SIGNALS_ETClb_dtiETFlt0_mp[4]" 9 "SIGNALS_ETClb_dtiETFlt0_mp[5]" 10 "SIGNALS_ETClb_dtiETFlt1_mp[0]" 11 "SIGNALS_ETClb_dtiETFlt1_mp[1]" 12 "SIGNALS_ETClb_dtiETFlt1_mp[2]" 13 "SIGNALS_ETClb_dtiETFlt1_mp[3]" 14 "SIGNALS_ETClb_dtiETFlt1_mp[4]" 15 "SIGNALS_ETClb_dtiETFlt1_mp[5]" 16 "SIGNALS_ETClb_dtiETFlt2_mp[0]" 17 "SIGNALS_ETClb_dtiETFlt2_mp[1]" 18 "SIGNALS_ETClb_dtiETFlt2_mp[2]" 19 "SIGNALS_ETClb_dtiETFlt2_mp[3]" 20 "SIGNALS_ETClb_dtiETFlt2_mp[4]" 21 "SIGNALS_ETClb_dtiETFlt2_mp[5]" 22 "SIGNALS_ETClb_pRailSet[0]" 23 "SIGNALS_ETClb_pRailSet[1]" 24 "SIGNALS_ETClb_pRailSet[2]" 25 "SIGNALS_ETClb_stCor" 26 "SIGNALS_ETClb_stRlsCylCor_mp" 27 "SIGNALS_ETClb_tiETAvrg[0]" 28 "SIGNALS_ETClb_tiETAvrg[1]" 29 "SIGNALS_ETClb_tiETAvrg[2]" 30 "SIGNALS_ETClb_tiETMax[0]" 31 "SIGNALS_ETClb_tiETMax[1]" 32 "SIGNALS_ETClb_tiETMax[2]" 33 "SIGNALS_ETClb_tiETMin[0]" 34 "SIGNALS_ETClb_tiETMin[1]" 35 "SIGNALS_ETClb_tiETMin[2]" 36 "SIGNALS_InjUn_stStrt" 37 "SIGNALS_InjVlv_tiMI1ET_mp" 38 "SIGNALS_InjVlv_tiPiI1ET_mp" 39 "SIGNALS_InjVlv_volMI1_mp" 40 "SIGNALS_InjVlv_volPiI1_mp" 41 "SIGNALS_MeUn_dvolSet" 42 "SIGNALS_MeUn_iActFlt_mp" 43 "SIGNALS_MeUn_iSet_mp" 44 "SIGNALS_MeUn_uRaw_mp" 45 "SIGNALS_PCV_iActFlt_mp" 46 "SIGNALS_PCV_iSet" 47 "SIGNALS_PCV_pSet" 48 "SIGNALS_PCV_uRaw_mp" 49 "SIGNALS_PFltSrv_stCondTstr" 50 "SIGNALS_PFltSrv_stRgnTstr" 51 "SIGNALS_PID01h" 52 "SIGNALS_PSP_stPs_mp" 53 "SIGNALS_RailP_pCurr_mp" 54 "SIGNALS_RailP_pLin" 55 "SIGNALS_Rail_dvolPreCtl" 56 "SIGNALS_Rail_stCtlLoop" 57 "SIGNALS_AFS_dm" 58 "SIGNALS_AFS_dmSens" 59 "SIGNALS_AFS_mAirPerCyl" 60 "SIGNALS_APP_rFlt_mp" 61 "SIGNALS_APP_rUnFlt" 62 "SIGNALS_APP_uRaw1" 63 "SIGNALS_APP_uRaw2" 64 "SIGNALS_ASMod_dvolPFltEG" 65 "SIGNALS_Absch_korr" 66 "SIGNALS_ActMod_trq" 67 "SIGNALS_ActMod_trqInr" 68 "SIGNALS_AirCtl_mDesVal" 69 "SIGNALS_Air_pCACDs" 70 "SIGNALS_Air_pSensPCACDs" 71 "SIGNALS_Air_rRawTAFS" 72 "SIGNALS_Air_tCACDs" 73 "SIGNALS_Air_uRawPCACDs" 74 "SIGNALS_Air_uRawTCACDs" 75 "SIGNALS_AltIO_rAltLoad" 76 "SIGNALS_BattU_uSens" 77 "SIGNALS_CEngDsT_t" 78 "SIGNALS_CEngDsT_tSens" 79 "SIGNALS_CEngDsT_uRaw" 80 "SIGNALS_CoEOM_stOpModeAct" 81 "SIGNALS_CoETS_rTrq" 82 "SIGNALS_CoEng_st" 83 "SIGNALS_Com_lSum" 84 "SIGNALS_Com_nPsp" 85 "SIGNALS_Com_rPspSetPoint" 86 "SIGNALS_DSMDur_ctGlb_0" 87 "SIGNALS_DSMRdy_xPId41" 88 "SIGNALS_D_soc" 89 "SIGNALS_EGRVlv_rPs" 90 "SIGNALS_EMDmp_stPs" 91 "SIGNALS_EngDa_tiEngOn" 92 "SIGNALS_EnvP_p" 93 "SIGNALS_EnvP_uRaw" 94 "SIGNALS_EpmCaS_phiOfsCorr" 95 "SIGNALS_EpmHCrS_stSigMode" 96 "SIGNALS_Epm_nEng" 97 "SIGNALS_Epm_stOpMode" 98 "SIGNALS_Epm_stSync" 99 "SIGNALS_Exh_pAdapPPFltDiff" 100 "SIGNALS_Exh_pPFltUs" 101 "SIGNALS_Exh_tOxiCatUs" 102 "SIGNALS_Exh_tPFltUs" 103 "SIGNALS_Exh_uRawPPFltUs" 104 "SIGNALS_Exh_uRawTOxiCatUs" 105 "SIGNALS_Exh_uRawTPFltUs" 106 "SIGNALS_FBC_qDvtCylPhys_01" 107 "SIGNALS_FBC_qDvtCylPhys_02" 108 "SIGNALS_FBC_qDvtCylPhys_03" 109 "SIGNALS_FBC_qDvtCylPhys_04" 110 "SIGNALS_FBC_qDvtCylPhys_05" 111 "SIGNALS_FBC_qDvtCylPhys_06" 112 "SIGNALS_FBC_qDvtCylPhys_07" 113 "SIGNALS_FBC_qDvtCylPhys_08" 114 "SIGNALS_FBC_qDvtCylPhys_09" 115 "SIGNALS_FBC_qDvtCylPhys_10" 116 "SIGNALS_Fan_rPs" 117 "SIGNALS_FlFlt_stRaw" 118 "SIGNALS_FuelT_t" 119 "SIGNALS_FuelT_uRaw" 120 "SIGNALS_GlwPlg_numPwrOut" 121 "SIGNALS_ISC_nSetPLo" 122 "SIGNALS_ISC_trq" 123 "SIGNALS_I_batt" 124 "SIGNALS_InjCtl_qCurr" 125 "SIGNALS_InjCtl_qSetUnBal" 126 "SIGNALS_LSU_rO2Adap[0]" 127 "SIGNALS_MeUn_rPs_mp" 128 "SIGNALS_MoFInjDat_tiTDCAvrg" 129 "SIGNALS_OilPLmp_st" 130 "SIGNALS_Oil_tSwmp" 131 "SIGNALS_Oz_oelkm" 132 "SIGNALS_PCR_pDesVal" 133 "SIGNALS_PCV_rPs_mp" 134 "SIGNALS_PFltLd_mOilAshEG_mp" 135 "SIGNALS_PFltLd_mSot" 136 "SIGNALS_PFltLd_mSotSim" 137 "SIGNALS_PFltRgn_qFl_mp" 138 "SIGNALS_PFltRgn_stIntr" 139 "SIGNALS_PFltRgn_stLck" 140 "SIGNALS_PID41h" 141 "SIGNALS_PSP_dvolOut" 142 "SIGNALS_PthSet_trqInrSet" 143 "SIGNALS_RailP_pFlt" 144 "SIGNALS_RailP_uRaw" 145 "SIGNALS_Rail_pSetPoint" 146 "SIGNALS_Stat_sv_reg" 147 "SIGNALS_T2hist" 148 "SIGNALS_T3hist" 149 "SIGNALS_T4hist" 150 "SIGNALS_T_batt" 151 "SIGNALS_ThrVlv_rPs" 152 "SIGNALS_Tn_abstell" 153 "SIGNALS_Toel" 154 "SIGNALS_TrbCh_r" 155 "SIGNALS_TrbCh_rPs" 156 "SIGNALS_U_batt" 157 "SIGNALS_U_gen" 158 "SIGNALS_VSwVlv_rPs" 159 "SIGNALS_VehV_v" 160 "SIGNALS_VehV_vSens" 161 "SIGNALS_WaHtEl_rPs" /end COMPU_VTAB
/begin COMPU_METHOD Signals_PidVerb "" TAB_VERB "%6.3" "-" COMPU_TAB_REF Signals_PidVerb /end COMPU_METHOD
/begin COMPU_VTAB Signals_PidVerb "" TAB_VERB 4 0 "SIGNALS_PID_NOT_SUPPORTED" 1 "SIGNALS_PID_0x01" 35 "SIGNALS_PID_0x23" 65 "SIGNALS_PID_0x41" /end COMPU_VTAB
/begin COMPU_METHOD SyC_PostDrv_State "" TAB_VERB "%6.3" "-" COMPU_TAB_REF SyC_PostDrv_State /end COMPU_METHOD
/begin COMPU_VTAB SyC_PostDrv_State "" TAB_VERB 8 0 "SYC_POSTDRV_INACTV" 1 "SYC_POSTDRV_DSM_BGN" 2 "SYC_POSTDRV_EEP_BGN" 3 "SYC_POSTDRV_WAIT" 4 "SYC_POSTDRV_DSM_END" 5 "SYC_POSTDRV_EEP_END" 6 "SYC_POSTDRV_MIN_TIME" 7 "SYC_POSTDRV_DONE" /end COMPU_VTAB
/begin COMPU_METHOD SyC_PreDrv_State "" TAB_VERB "%6.3" "-" COMPU_TAB_REF SyC_PreDrv_State /end COMPU_METHOD
/begin COMPU_VTAB SyC_PreDrv_State "" TAB_VERB 10 0 "SYC_PREDRV_INI_DRV" 1 "SYC_PREDRV_DONE" 2 "SYC_PREDRV_INI_SHDWN" 3 "SYC_PREDRV_PROLONG" 4 "SYC_PREDRV_NWM" 5 "SYC_PREDRV_DSM" 6 "SYC_PREDRV_EEP" 7 "SYC_PREDRV_MR" 8 "SYC_PREDRV_MOM" 9 "SYC_PREDRV_EXIT" /end COMPU_VTAB
/begin COMPU_METHOD SyC_Time_100ms "" RAT_FUNC "%6.3" "s" COEFFS 0 1000 0 0 0 100 /end COMPU_METHOD
/begin COMPU_METHOD SyC_Time_1s "" RAT_FUNC "%6.2" "s" COEFFS 0 1 0 0 0 1 /end COMPU_METHOD
/begin COMPU_METHOD SyC_Time_2min "" RAT_FUNC "%6.2" "min" COEFFS 0 1 0 0 0 2 /end COMPU_METHOD
/begin COMPU_METHOD TempDiff_Kelv "" RAT_FUNC "%6.3" "K" COEFFS 0 10 0 0 0 1 /end COMPU_METHOD
/begin COMPU_METHOD Temp_Cels "" RAT_FUNC "%6.1" "deg C" COEFFS 0 10 2731.4 0 0 1 /end COMPU_METHOD
/begin COMPU_METHOD TimeDeb "" RAT_FUNC "%6.1" "ms" COEFFS 0 0.1 0 0 0 1 /end COMPU_METHOD
/begin COMPU_METHOD TimeDelay_ms "" RAT_FUNC "%12.1" "ms" COEFFS 0 0 1 0 2.3283064365387e-007 0 /end COMPU_METHOD
/begin COMPU_METHOD TimeDelay_s "" RAT_FUNC "%12.4" "s" COEFFS 0 0 1 0 0.00023283064365387 0 /end COMPU_METHOD
/begin COMPU_METHOD TimeDT "" RAT_FUNC "%6.2" "us" COEFFS 0 1 0 0 0 1 /end COMPU_METHOD
/begin COMPU_METHOD Time_ms "" RAT_FUNC "%6.1" "ms" COEFFS 0 0.1 0 0 0 1 /end COMPU_METHOD
/begin COMPU_METHOD Time_s "" RAT_FUNC "%6.4" "s" COEFFS 0 100 0 0 0 1 /end COMPU_METHOD
/begin COMPU_METHOD TIncPerDur_us "" RAT_FUNC "%6.3" "us" COEFFS 0 10 0 0 0 1 /end COMPU_METHOD
/begin COMPU_METHOD TransR "" RAT_FUNC "%6.4" "-" COEFFS 0 100 0 0 0 1 /end COMPU_METHOD
/begin COMPU_METHOD Trq "" RAT_FUNC "%6.3" "Nm" COEFFS 0 10 0 0 0 1 /end COMPU_METHOD
/begin COMPU_METHOD TrqInrKd "" RAT_FUNC "%8.7" "%/Nm" COEFFS 0 655360 0 0 0 1 /end COMPU_METHOD
/begin COMPU_METHOD TrqInrKd_16 "" RAT_FUNC "%7.6" "%/Nm" COEFFS 0 40960 0 0 0 1 /end COMPU_METHOD
/begin COMPU_METHOD TrqInrKi "" RAT_FUNC "%7.6" "%/(Nm*s)" COEFFS 0 21474.83648 0 0 0 1 /end COMPU_METHOD
/begin COMPU_METHOD TrqInrKi_8 "" RAT_FUNC "%6.5" "%/(Nm*s)" COEFFS 0 2684.35456 0 0 0 1 /end COMPU_METHOD
/begin COMPU_METHOD TrqInrKp "" RAT_FUNC "%8.7" "%/Nm" COEFFS 0 327680 0 0 0 1 /end COMPU_METHOD
/begin COMPU_METHOD TrqInrKp_128 "" RAT_FUNC "%6.5" "%/Nm" COEFFS 0 2560 0 0 0 1 /end COMPU_METHOD
/begin COMPU_METHOD Typ4WinDia "" TAB_VERB "%6.3" "-" COMPU_TAB_REF Typ4WinDia /end COMPU_METHOD
/begin COMPU_VTAB Typ4WinDia "" TAB_VERB 4 0 "4 Window diagnosis over PWM control line" 1 "4 Window diagnosis through Digital input" 2 "4 Window diagnosis over external interface" 3 "No 4 Window diagnosis." /end COMPU_VTAB
/begin COMPU_METHOD Vel "" RAT_FUNC "%6.4" "km/h" COEFFS 0 100 0 0 0 1 /end COMPU_METHOD
/begin COMPU_METHOD VelToN "" RAT_FUNC "%8.7" "(km/h)/rpm" COEFFS 0 100000 0 0 0 1 /end COMPU_METHOD
/begin COMPU_METHOD Volt "" RAT_FUNC "%6.3" "mV" COEFFS 0 5 0 0 0 1 /end COMPU_METHOD
/begin RECORD_LAYOUT Axis_Xs16 NO_AXIS_PTS_X 1 SWORD AXIS_PTS_X 2 SWORD INDEX_INCR DIRECT /end RECORD_LAYOUT
/begin RECORD_LAYOUT CurG_Ws16 FNC_VALUES 1 SWORD COLUMN_DIR DIRECT /end RECORD_LAYOUT
/begin RECORD_LAYOUT Cur_Xs16Ws16 NO_AXIS_PTS_X 1 SWORD AXIS_PTS_X 2 SWORD INDEX_INCR DIRECT FNC_VALUES 3 SWORD COLUMN_DIR DIRECT /end RECORD_LAYOUT
/begin RECORD_LAYOUT Kf_Xs16_Ys16_Ws16 NO_AXIS_PTS_X 1 SWORD NO_AXIS_PTS_Y 2 SWORD AXIS_PTS_X 3 SWORD INDEX_INCR DIRECT AXIS_PTS_Y 4 SWORD INDEX_INCR DIRECT FNC_VALUES 5 SWORD COLUMN_DIR DIRECT /end RECORD_LAYOUT
/begin RECORD_LAYOUT Kl_Xs16_Ws16 NO_AXIS_PTS_X 1 SWORD AXIS_PTS_X 2 SWORD INDEX_INCR DIRECT FNC_VALUES 3 SWORD COLUMN_DIR DIRECT /end RECORD_LAYOUT
/begin RECORD_LAYOUT Kw_Ws16 FNC_VALUES 1 SWORD COLUMN_DIR DIRECT /end RECORD_LAYOUT
/begin RECORD_LAYOUT Kw_Ws32 FNC_VALUES 1 SLONG COLUMN_DIR DIRECT /end RECORD_LAYOUT
/begin RECORD_LAYOUT Kw_Wu16 FNC_VALUES 1 UWORD COLUMN_DIR DIRECT /end RECORD_LAYOUT
/begin RECORD_LAYOUT Kw_Wu8 FNC_VALUES 1 UBYTE COLUMN_DIR DIRECT /end RECORD_LAYOUT
/begin RECORD_LAYOUT MapG_Ws16 FNC_VALUES 1 SWORD COLUMN_DIR DIRECT /end RECORD_LAYOUT
/begin RECORD_LAYOUT Map_Xs16Ys16Ws16 NO_AXIS_PTS_X 1 SWORD NO_AXIS_PTS_Y 2 SWORD AXIS_PTS_X 3 SWORD INDEX_INCR DIRECT AXIS_PTS_Y 4 SWORD INDEX_INCR DIRECT FNC_VALUES 5 SWORD COLUMN_DIR DIRECT /end RECORD_LAYOUT
/begin RECORD_LAYOUT ValA_Ws16 FNC_VALUES 1 SWORD COLUMN_DIR DIRECT /end RECORD_LAYOUT
/begin RECORD_LAYOUT ValA_Wu16 FNC_VALUES 1 UWORD COLUMN_DIR DIRECT /end RECORD_LAYOUT
/begin RECORD_LAYOUT ValA_Wu8 FNC_VALUES 1 UBYTE COLUMN_DIR DIRECT /end RECORD_LAYOUT
/begin RECORD_LAYOUT Val_Ws16 FNC_VALUES 1 SWORD COLUMN_DIR DIRECT /end RECORD_LAYOUT
/begin RECORD_LAYOUT Val_Ws32 FNC_VALUES 1 SLONG COLUMN_DIR DIRECT /end RECORD_LAYOUT
/begin RECORD_LAYOUT Val_Wu16 FNC_VALUES 1 UWORD COLUMN_DIR DIRECT /end RECORD_LAYOUT
/begin RECORD_LAYOUT Val_Wu32 FNC_VALUES 1 ULONG COLUMN_DIR DIRECT /end RECORD_LAYOUT
/begin RECORD_LAYOUT Val_Wu8 FNC_VALUES 1 UBYTE COLUMN_DIR DIRECT /end RECORD_LAYOUT
/end MODULE
/end PROJECT
