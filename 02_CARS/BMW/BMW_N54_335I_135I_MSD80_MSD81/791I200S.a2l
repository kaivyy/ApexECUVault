ASAP2_VERSION 1 41
/begin PROJECT MSD85 "Spray Guided DI-System with Piezo Injectors for 8-Cylinder"
/begin HEADER "_default_HeaderComment" PROJECT_NO _91 /end HEADER
/begin MODULE _default_ModuleName "_default_ModuleLongIdentifier"
/begin MOD_COMMON "_default_ModCommonComment" DEPOSIT ABSOLUTE BYTE_ORDER MSB_LAST ALIGNMENT_BYTE 1 ALIGNMENT_WORD 2 ALIGNMENT_LONG 2 ALIGNMENT_FLOAT32_IEEE 2 ALIGNMENT_FLOAT64_IEEE 4 /end MOD_COMMON
/begin AXIS_PTS ldpm_gear_ef_1 "" 0xa0809444 gear_ef _REC_AXS_20_u1 6. _CNV_A_R_LINEAR_____0_CM 7 0. 6. FORMAT "%1.0" /end AXIS_PTS
/begin AXIS_PTS ldpm_n_ef "" 0xa08096aa n_ef _REC_AXS_20_u1 8160. _CNV_A_R_LINEAR_____10_CM 6 0. 8160. FORMAT "%4.0" /end AXIS_PTS
/begin AXIS_PTS ldp_n_32_ip_t_dly_ef "" 0xa0808a38 n_32 _REC_AXS_20_u1 8160. _CNV_A_R_LINEAR_____10_CM 8 0. 8160. FORMAT "%4.0" /end AXIS_PTS
/begin AXIS_PTS ldp_maf__thd_is_er_diag "" 0xa080882a maf _REC_AXS_20_u1 1389. _CNV_A_R_LINEAR_____15_CM 4 0. 1389. FORMAT "%4.0" /end AXIS_PTS
/begin AXIS_PTS ldp_n__thd_is_er_diag "" 0xa0808ad0 n _REC_AXS_20_u2 816. _CNV_A_R_LINEAR_____14_CM 4 0. 8160. FORMAT "%4.0" /end AXIS_PTS
/begin AXIS_PTS ldp_tco__fac_thd_is_er_diag "" 0xa0808dd0 tco _REC_AXS_20_u1 190.5 _CNV_A_R_LINEAR_____17_CM 8 -48. 142.5 FORMAT "%5.1" /end AXIS_PTS
/begin AXIS_PTS ldpm_n_sof "" 0xa08096ea n_sof _REC_AXS_20_u1 8160. _CNV_A_R_LINEAR_____10_CM 6 0. 8160. FORMAT "%4.0" /end AXIS_PTS
/begin AXIS_PTS ldp_n_32_ip_t_dly_sof "" 0xa0808a44 n_32 _REC_AXS_20_u1 8160. _CNV_A_R_LINEAR_____10_CM 8 0. 8160. FORMAT "%4.0" /end AXIS_PTS
/begin AXIS_PTS ldpm_n_32__t_acc "" 0xa0809600 n_32 _REC_AXS_20_u1 8160. _CNV_A_R_LINEAR_____10_CM 3 0. 8160. FORMAT "%4.0" /end AXIS_PTS
/begin AXIS_PTS ldp_vs__amp_raw_cor "" 0xa08092ac vs _REC_AXS_20_u1 255. _CNV_A_R_LINEAR_____6_CM 8 0. 255. FORMAT "%3.0" /end AXIS_PTS
/begin AXIS_PTS ldp_v_amp__amp_raw "" 0xa080907c v_amp _REC_AXS_20_u2 4.9951171875 _CNV_A_R_LINEAR_____2_CM 8 0. 4.9951171875 FORMAT "%5.3" /end AXIS_PTS
/begin AXIS_PTS ldpm_n_2_3 "" 0xa080958c n _REC_AXS_20_u2 816. _CNV_A_R_LINEAR_____14_CM 16 0. 8160. FORMAT "%4.0" /end AXIS_PTS
/begin AXIS_PTS lpdm_ctr_km_can "" 0xa0809928 ctr_km_can _REC_AXS_20_u2 655340. _CNV_A_R_LINEAR_____58_CM 4 0. 655340. FORMAT "%6.0" /end AXIS_PTS
/begin AXIS_PTS ldp_toil__t_dly_poil_swi_can "" 0xa0808eee toil _REC_AXS_20_u1 200. _CNV_A_R_LINEAR_____26_CM 6 -40. 160. FORMAT "%3.0" /end AXIS_PTS
/begin CHARACTERISTIC lc_snd_msg_oil_key_aux "LC for transmitting Layer-values independent of Kl.15" VALUE 0xa080c5ee _REC_VAL_20_u1 1. _CNV_S_2_RANGE__0___1_CM 0. 1. DISPLAY_IDENTIFIER LC_SND_MSG_OIL_KEY_AUX /end CHARACTERISTIC
/begin AXIS_PTS ldpm_t_ctl_cru_1 "" 0xa0809766 t_ctl_cru _REC_AXS_20_u1 2.55 _CNV_A_R_LINEAR_____4_CM 5 0. 25.5 FORMAT "%4.1" /end AXIS_PTS
/begin AXIS_PTS ldp_vs_dif_cru__fac_prop_cru "" 0xa08092b8 vs_dif_cru _REC_AXS_20_u2 511.9921875 _CNV_A_R_LINEAR_____101_CM 4 -256. 255.9921875 FORMAT "%7.3" /end AXIS_PTS
/begin AXIS_PTS ldpm_vs_sp_dif_cru_1 "" 0xa0809904 vs_sp_dif_cru _REC_AXS_20_u2 511.9921875 _CNV_A_R_LINEAR_____101_CM 5 -256. 255.9921875 FORMAT "%7.3" /end AXIS_PTS
/begin AXIS_PTS ldpm_n_21 "" 0xa0809586 n_32 _REC_AXS_20_u1 8160. _CNV_A_R_LINEAR_____10_CM 3 0. 8160. FORMAT "%4.0" /end AXIS_PTS
/begin AXIS_PTS ldpm_vs_sp_cru_1 "" 0xa08098f8 vs_sp_cru _REC_AXS_20_u2 511.99218 _CNV_A_R_LINEAR_____86_CM 5 0. 511.99218 FORMAT "%7.3" /end AXIS_PTS
/begin AXIS_PTS ldpm_ac_cru__fac_tq_cru "" 0xa0809314 ac_cru _REC_AXS_20_u2 31.43952 _CNV_A_R_LINEAR_____106_CM 6 -15.72 15.71952 FORMAT "%8.4" /end AXIS_PTS
/begin AXIS_PTS ldpm_gear__fac_tq_cru "" 0xa0809424 gear _REC_AXS_20_u1 255. _CNV_A_R_LINEAR_____0_CM 12 0. 255. FORMAT "%3.0" /end AXIS_PTS
/begin AXIS_PTS ldp_n_32__fac_tq_cru "" 0xa080898c n_32 _REC_AXS_20_u1 816. _CNV_A_R_LINEAR_____10_CM 5 0. 8160. FORMAT "%4.0" /end AXIS_PTS
/begin AXIS_PTS ldpm_fac_tq_cru_1 "" 0xa08093fc fac_tq_cru _REC_AXS_20_u2 99.99847412109381 _CNV_A_R_LINEAR_____8_CM 3 0. 99.99847412109381 /end AXIS_PTS
/begin AXIS_PTS ldp_n_32__fac_tq_req_clu_is "" 0xa0808992 n_32 _REC_AXS_20_u1 8160. _CNV_A_R_LINEAR_____10_CM 3 0. 8160. FORMAT "%4.0" /end AXIS_PTS
/begin AXIS_PTS ldp_iga_dif_bas_cyl_lam_ip_crk "" 0xa08087f0 iga_dif_bas_crk_cyl_lam _REC_AXS_20_u2 359.9375 _CNV_A_R_LINEAR_____133_CM 8 -180. 179.9375 FORMAT "%8.4" /end AXIS_PTS
/begin CHARACTERISTIC ip_crk_delta_iga_lam_cyl_sel "Phase shift deviation caused by IGA difference" CURVE 0xa0809fb4 _REC_CUR_20_u1_u2 1440. _CNV_A_R_CYBL_LINEA_122_CM -720. 720. DISPLAY_IDENTIFIER IP_CRK_DELTA_IGA_LAM_CYL_SEL FORMAT "%4.0"
 /begin AXIS_DESCR COM_AXIS iga_dif_bas_crk_cyl_lam _CNV_A_R_LINEAR_____133_CM 8 -180. 179.9375 FORMAT "%8.4" AXIS_PTS_REF ldp_iga_dif_bas_cyl_lam_ip_crk /end AXIS_DESCR
/end CHARACTERISTIC
/begin AXIS_PTS ldp_ftl__t_cur_dmtl_stat "" 0xa0808698 ftl _REC_AXS_20_u1 126. _CNV_A_R_LINEAR_____75_CM 8 0. 126. FORMAT "%3.0" /end AXIS_PTS
/begin AXIS_PTS ldp_ftl__t_small_leak_test "" 0xa08086a8 ftl _REC_AXS_20_u1 126. _CNV_A_R_LINEAR_____75_CM 5 0. 126. FORMAT "%3.0" /end AXIS_PTS
/begin AXIS_PTS ldp_vb_dmtl_fil__fac_cur_dmtl "" 0xa0809100 vb_dmtl_fil _REC_AXS_20_u2 26. _CNV_A_R_LINEAR_____155_CM 6 0. 26. FORMAT "%7.4" /end AXIS_PTS
/begin AXIS_PTS ldpm_cur_dmtldifrefroughleak_1 "" 0xa0809360 cur_dmtl_dif_ref_rough_leak _REC_AXS_20_u2 400. _CNV_A_R_LINEAR_____148_CM 8 0. 400. FORMAT "%7.3" /end AXIS_PTS
/begin AXIS_PTS ldp_ftl__t_rough_leak_test "" 0xa08086a2 ftl _REC_AXS_20_u1 126. _CNV_A_R_LINEAR_____75_CM 5 0. 126. FORMAT "%3.0" /end AXIS_PTS
/begin AXIS_PTS ldpm_tco_1_6 "" 0xa0809778 tco _REC_AXS_20_u1 28.575 _CNV_A_R_LINEAR_____17_CM 6 -48. 142.5 FORMAT "%5.1" /end AXIS_PTS
/begin AXIS_PTS ldpm_gr_mt_3 "" 0xa0809458 gr_mt _REC_AXS_20_u1 255. _CNV_A_R_LINEAR_____0_CM 8 0. 255. FORMAT "%3.0" /end AXIS_PTS
/begin AXIS_PTS ldpm_tco_9 "" 0xa0809788 tco _REC_AXS_20_u1 28.575 _CNV_A_R_LINEAR_____17_CM 9 -48. 142.5 FORMAT "%5.1" /end AXIS_PTS
/begin AXIS_PTS ldp_n__t_min_pu "" 0xa0808abc n _REC_AXS_20_u2 8159. _CNV_A_R_LINEAR_____14_CM 8 1. 8160. FORMAT "%4.0" /end AXIS_PTS
/begin AXIS_PTS ldp_tco__t_min_pu "" 0xa0808dec tco _REC_AXS_20_u1 190.5 _CNV_A_R_LINEAR_____17_CM 6 -48. 142.5 FORMAT "%5.1" /end AXIS_PTS
/begin AXIS_PTS ldp_tq_loss_ars_sp_can__puc "" 0xa0808fcc tq_loss_ars_sp_can _REC_AXS_20_u2 2047.96875 _CNV_A_R_LINEAR_____87_CM 6 -1024. 1023.96875 FORMAT "%6.2" /end AXIS_PTS
/begin AXIS_PTS ldp_n_grd_n_dif_max_is "" 0xa0808b18 n_grd _REC_AXS_20_u1 8160. _CNV_A_R_LINEAR_____29_CM 6 -4096. 4064. FORMAT "%5.0" /end AXIS_PTS
/begin AXIS_PTS ldp_tq_loss_pste_2_sp_can__puc "" 0xa0809024 tq_loss_pste_2_sp_can _REC_AXS_20_u2 2047.96875 _CNV_A_R_LINEAR_____87_CM 6 -1024. 1023.96875 FORMAT "%6.2" /end AXIS_PTS
/begin AXIS_PTS ldpm_n_t_min_pu_opm "" 0xa0809704 n _REC_AXS_20_u2 8160. _CNV_A_R_LINEAR_____14_CM 3 0. 8160. FORMAT "%4.0" /end AXIS_PTS
/begin AXIS_PTS ldpm_gr_at_3 "" 0xa080944c gr_at _REC_AXS_20_u1 255. _CNV_A_R_LINEAR_____0_CM 8 0. 255. FORMAT "%3.0" /end AXIS_PTS
/begin AXIS_PTS ldpm_vs "" 0xa08098c2 vs _REC_AXS_20_u1 255. _CNV_A_R_LINEAR_____6_CM 4 0. 255. FORMAT "%3.0" /end AXIS_PTS
/begin AXIS_PTS ldp_tq_loss_add__puc "" 0xa0808fa8 tq_loss_add _REC_AXS_20_u2 2047.96875 _CNV_A_R_LINEAR_____87_CM 6 -1024. 1023.96875 FORMAT "%6.2" /end AXIS_PTS
/begin AXIS_PTS ldp_n_vs_ratio_gr_mt "" 0xa0808bc4 n_vs_ratio _REC_AXS_20_u1 255. _CNV_A_R_LINEAR_____0_CM 13 0. 255. FORMAT "%3.0" /end AXIS_PTS
/begin AXIS_PTS ldp_teg_dyn_hys "" 0xa0808e28 teg_dyn_hys _REC_AXS_20_u2 2047. _CNV_A_R_LINEAR_____130_CM 16 0. 2047. FORMAT "%7.2" /end AXIS_PTS
/begin AXIS_PTS ldpm_n_sp_is_tq_add_is_bol_bas "" 0xa08096f4 n_sp_is _REC_AXS_20_u2 8160. _CNV_A_R_LINEAR_____14_CM 6 0. 8160. FORMAT "%4.0" /end AXIS_PTS
/begin AXIS_PTS ldpm_tco_tq_add_is_bol_bas "" 0xa0809822 tco _REC_AXS_20_u1 190.5 _CNV_A_R_LINEAR_____17_CM 6 -48. 142.5 FORMAT "%5.1" /end AXIS_PTS
/begin AXIS_PTS ldpm_toil_ip_fac_temp_tq_add_is "" 0xa0809872 toil _REC_AXS_20_u1 200. _CNV_A_R_LINEAR_____26_CM 6 -40. 160. FORMAT "%3.0" /end AXIS_PTS
/begin AXIS_PTS ldpm_tia_ip_fac_temp_tq_add_is "" 0xa080984a tia _REC_AXS_20_u1 190.5 _CNV_A_R_LINEAR_____17_CM 6 -48. 142.5 FORMAT "%5.1" /end AXIS_PTS
/begin AXIS_PTS ldpm_maf_fac_tq_add_is "" 0xa08094b4 maf _REC_AXS_20_u2 1389. _CNV_A_R_LINEAR_____111_CM 6 0. 1389. FORMAT "%4.0" /end AXIS_PTS
/begin AXIS_PTS ldpm_vs_fil_ip_fac_vs_tq_add_is "" 0xa08098ec vs_fil _REC_AXS_20_u2 511.99218 _CNV_A_R_LINEAR_____86_CM 4 0. 511.99218 FORMAT "%7.3" /end AXIS_PTS
/begin AXIS_PTS ldpm_maf_lgrd_tq_add_is_bol "" 0xa0809520 maf _REC_AXS_20_u2 1389. _CNV_A_R_LINEAR_____111_CM 6 0. 1389. FORMAT "%4.0" /end AXIS_PTS
/begin AXIS_PTS ldp_vlft_min_ip_tq_add_is_cor "" 0xa0809170 NO_INPUT_QUANTITY _REC_AXS_20_u2 65.535 _CNV_A_R_LINEAR_____194_CM 6 0. 65.535 /end AXIS_PTS
/begin AXIS_PTS ldp_map_dip_sp_mmv_ip_tq_add_is "" 0xa0808928 NO_INPUT_QUANTITY _REC_AXS_20_u2 2559.9609375 _CNV_A_R_LINEAR_____195_CM 6 -1280. 1279.9609375 FORMAT "%8.2" /end AXIS_PTS
/begin AXIS_PTS ldpm_n_lgrd_tq_add_is_bol "" 0xa08096dc n _REC_AXS_20_u2 8160. _CNV_A_R_LINEAR_____14_CM 6 0. 8160. FORMAT "%4.0" /end AXIS_PTS
/begin AXIS_PTS ldpm_n_dif_pred_fac_tq_add_is "" 0xa0809698 n_dif_pred_pl_drof _REC_AXS_20_u2 65535. _CNV_A_R_LINEAR_____193_CM 8 -32768. 32767. FORMAT "%6.0" /end AXIS_PTS
/begin AXIS_PTS ldpm_n_4_9 "" 0xa0809652 n_knk _REC_AXS_20_u1 8160. _CNV_A_R_LINEAR_____10_CM 3 0. 8160. FORMAT "%4.0" /end AXIS_PTS
/begin AXIS_PTS ldpm_n_6_4 "" 0xa0809666 n_knk _REC_AXS_20_u1 8160. _CNV_A_R_LINEAR_____10_CM 4 0. 8160. FORMAT "%4.0" /end AXIS_PTS
/begin AXIS_PTS ldpm_n_2_9 "" 0xa08095b0 n_knk _REC_AXS_20_u1 8160. _CNV_A_R_LINEAR_____10_CM 16 0. 8160. FORMAT "%4.0" /end AXIS_PTS
/begin AXIS_PTS ldpm_maf_1_9 "" 0xa0809472 maf_knk _REC_AXS_20_u1 69.45 _CNV_A_R_LINEAR_____15_CM 4 0. 1389. FORMAT "%4.0" /end AXIS_PTS
/begin AXIS_PTS ldpm_maf_gain_knk "" 0xa08094d8 maf_knk _REC_AXS_20_u1 69.45 _CNV_A_R_LINEAR_____15_CM 8 0. 1389. FORMAT "%4.0" /end AXIS_PTS
/begin AXIS_PTS ldp_n__pq_sp_puls "" 0xa0808aac n _REC_AXS_20_u2 816. _CNV_A_R_LINEAR_____14_CM 6 0. 8160. FORMAT "%4.0" /end AXIS_PTS
/begin AXIS_PTS ldp_maf_kgh_mes_bas "" 0xa08088b0 NO_INPUT_QUANTITY _REC_AXS_20_u2 2047.96875 _CNV_A_R_LINEAR_____215_CM 16 0. 2047.96875 FORMAT "%7.2" /end AXIS_PTS
/begin AXIS_PTS ldp_tia_ip_fac_maf_kgh_cor "" 0xa0808e8e tia _REC_AXS_20_u1 190.5 _CNV_A_R_LINEAR_____17_CM 6 -48. 142.5 FORMAT "%6.2" /end AXIS_PTS
/begin AXIS_PTS ldpm_maf_cyl_ex "" 0xa08094a0 maf_cyl _REC_AXS_20_u2 2047.96875 _CNV_A_R_LINEAR_____215_CM 8 0. 2047.96875 FORMAT "%6.2" /end AXIS_PTS
/begin AXIS_PTS ldpm_maf_flow_egr "" 0xa08094c4 maf_flow_ex _REC_AXS_20_u2 2047.96875 _CNV_A_R_LINEAR_____215_CM 8 0. 2047.96875 FORMAT "%6.2" /end AXIS_PTS
/begin AXIS_PTS ldp_n_32_ip_crlc_eff_vol_temp "" 0xa08089d8 n_32 _REC_AXS_20_u1 8160. _CNV_A_R_LINEAR_____10_CM 6 0. 8160. FORMAT "%4.0" /end AXIS_PTS
/begin AXIS_PTS ldpm_n_32__eff_vol_cor "" 0xa08095d4 n_32 _REC_AXS_20_u1 8160. _CNV_A_R_LINEAR_____10_CM 8 0. 8160. FORMAT "%4.0" /end AXIS_PTS
/begin AXIS_PTS ldpm_maf__eff_vol_cor "" 0xa080948c maf _REC_AXS_20_u2 1389. _CNV_A_R_LINEAR_____111_CM 8 0. 1389. FORMAT "%7.2" /end AXIS_PTS
/begin AXIS_PTS ldp_v_map__map_mes_bas "" 0xa08090aa online_dummy _REC_AXS_20_u2 4.5 _CNV_A_R_LINEAR_____2_CM 2 0. 5. FORMAT "%5.3" /end AXIS_PTS
/begin AXIS_PTS ldpm_tco_n_sp_1 "" 0xa08097f4 tco _REC_AXS_20_u1 190.5 _CNV_A_R_LINEAR_____17_CM 8 -48. 142.5 FORMAT "%5.1" /end AXIS_PTS
/begin AXIS_PTS ldpm_tco_n_sp_is_pste "" 0xa08097fe tco _REC_AXS_20_u1 190.5 _CNV_A_R_LINEAR_____17_CM 6 -48. 142.5 FORMAT "%6.2" /end AXIS_PTS
/begin AXIS_PTS ldpm_toil_n_sp_is_toil "" 0xa080987a toil _REC_AXS_20_u1 200. _CNV_A_R_LINEAR_____26_CM 4 -40. 160. FORMAT "%3.0" /end AXIS_PTS
/begin AXIS_PTS ldpm_iga_n_sp_is_knk "" 0xa0809462 iga_mv_adj_knk_cus _REC_AXS_20_u1 48. _CNV_A_R_LINEAR_____198_CM 4 -48. 0. FORMAT "%7.3" /end AXIS_PTS
/begin AXIS_PTS ldp_toil_ip_n_sp_is_cs_opm_1 "" 0xa0808f0c toil _REC_AXS_20_u1 200. _CNV_A_R_LINEAR_____26_CM 8 -40. 160. FORMAT "%3.0" /end AXIS_PTS
/begin AXIS_PTS ldp_n_n_sp_is_pl_opm_1 "" 0xa0808b8c n _REC_AXS_20_u2 8160. _CNV_A_R_LINEAR_____14_CM 6 0. 8160. FORMAT "%4.0" /end AXIS_PTS
/begin AXIS_PTS ldp_n_n_sp_is_pl_amt_opm_1 "" 0xa0808b7c n _REC_AXS_20_u2 8160. _CNV_A_R_LINEAR_____14_CM 6 0. 8160. FORMAT "%4.0" /end AXIS_PTS
/begin AXIS_PTS ldp_tq_loss_n_sp_is_pl_opm_1 "" 0xa0809000 tq_loss _REC_AXS_20_u2 2047.96875 _CNV_A_R_LINEAR_____87_CM 6 -1024. 1023.96875 FORMAT "%6.2" /end AXIS_PTS
/begin AXIS_PTS ldp_tq_loss_n_sp_is_pl_amt_opm_1 "" 0xa0808ff0 tq_loss _REC_AXS_20_u2 2047.96875 _CNV_A_R_LINEAR_____87_CM 6 -1024. 1023.96875 FORMAT "%6.2" /end AXIS_PTS
/begin AXIS_PTS ldp_n_32_n_grd_thd "" 0xa0808a74 n_32 _REC_AXS_20_u1 8160. _CNV_A_R_LINEAR_____10_CM 8 0. 8160. FORMAT "%4.0" /end AXIS_PTS
/begin AXIS_PTS ldpm_gear "" 0xa0809418 gear _REC_AXS_20_u1 255. _CNV_A_R_LINEAR_____0_CM 9 0. 255. FORMAT "%3.0" /end AXIS_PTS
/begin AXIS_PTS ldp_tco__n_max_1 "" 0xa0808de0 tco _REC_AXS_20_u1 190.5 _CNV_A_R_LINEAR_____17_CM 4 -48. 142.5 FORMAT "%6.2" /end AXIS_PTS
/begin AXIS_PTS ldp_tco__n_max_2 "" 0xa0808de6 tco _REC_AXS_20_u1 190.5 _CNV_A_R_LINEAR_____17_CM 4 -48. 142.5 FORMAT "%6.2" /end AXIS_PTS
/begin AXIS_PTS ldp_vs_n_max_drof "" 0xa0809304 vs _REC_AXS_20_u1 255. _CNV_A_R_LINEAR_____6_CM 8 0. 255. FORMAT "%3.0" /end AXIS_PTS
/begin AXIS_PTS ldp_pv_av_n_max_etc_lih_2 "" 0xa0808c84 pv_av _REC_AXS_20_u1 99.609375 _CNV_A_R_LINEAR_____5_CM 4 0. 99.609375 FORMAT "%5.2" /end AXIS_PTS
/begin AXIS_PTS ldp_n_32__pv_lih_max "" 0xa080899c n_32 _REC_AXS_20_u1 816. _CNV_A_R_LINEAR_____10_CM 6 0. 8160. FORMAT "%4.0" /end AXIS_PTS
/begin AXIS_PTS ldp_v_pvs_min "" 0xa08090d4 online_dummy _REC_AXS_20_u2 4.9951171875 _CNV_A_R_LINEAR_____2_CM 2 0. 4.9951171875 FORMAT "%5.3" /end AXIS_PTS
/begin AXIS_PTS ldp_vp_tecu__tecu "" 0xa0809208 vp_tecu _REC_AXS_20_u2 4.4998623 _CNV_A_R_LINEAR_____172_CM 16 0. 4.999847 FORMAT "%7.5" /end AXIS_PTS
/begin AXIS_PTS ldpm_tia_ip_ti_cast "" 0xa0809852 tia _REC_AXS_20_u1 28.575 _CNV_A_R_LINEAR_____17_CM 2 -48. 142.5 FORMAT "%5.1" /end AXIS_PTS
/begin AXIS_PTS ldpm_tco__mff_deac_cst "" 0xa08097ac tco _REC_AXS_20_u1 19.05 _CNV_A_R_LINEAR_____17_CM 10 -48. 142.5 FORMAT "%5.1" /end AXIS_PTS
/begin AXIS_PTS ldpm_fac_st_rest "" 0xa08093aa fac_st_rest _REC_AXS_20_u1 1.99220002 _CNV_A_R_LINEAR_____100_CM 6 0. 1.99220002 FORMAT "%5.3" /end AXIS_PTS
/begin AXIS_PTS ldpm_cyc_cast_1 "" 0xa0809374 cyc_cast _REC_AXS_20_u2 65535. _CNV_A_R_LINEAR_____0_CM 8 0. 65535. FORMAT "%5.0" /end AXIS_PTS
/begin AXIS_PTS ldpm_cyc_cast_2 "" 0xa0809388 cyc_cast _REC_AXS_20_u2 65535. _CNV_A_R_LINEAR_____0_CM 16 0. 65535. FORMAT "%5.0" /end AXIS_PTS
/begin AXIS_PTS ldp_fup_fac_ti_cast "" 0xa0808728 fup[0] _REC_AXS_20_u2 347776. _CNV_A_R_LINEAR_____171_CM 6 0. 347776. FORMAT "%6.0" /end AXIS_PTS
/begin AXIS_PTS ldpm_tco__ti_st_rest "" 0xa08097c4 tco _REC_AXS_20_u1 28.575 _CNV_A_R_LINEAR_____17_CM 8 -48. 142.5 FORMAT "%5.1" /end AXIS_PTS
/begin AXIS_PTS ldp_tco_stop__fac_rest "" 0xa0808e1c tco_stop _REC_AXS_20_u1 28.575 _CNV_A_R_LINEAR_____17_CM 8 -48. 142.5 FORMAT "%5.1" /end AXIS_PTS
/begin AXIS_PTS ldpm_tco__fac_stall "" 0xa0809794 tco _REC_AXS_20_u1 28.575 _CNV_A_R_LINEAR_____17_CM 8 -48. 142.5 FORMAT "%5.1" /end AXIS_PTS
/begin AXIS_PTS ldp_t_es__rest "" 0xa0808d2c t_es _REC_AXS_20_u2 9830.25 _CNV_A_R_LINEAR_____84_CM 8 0. 65535. FORMAT "%5.0" /end AXIS_PTS
/begin AXIS_PTS ldp_t_ast_rest "" 0xa0808d18 t_ast_rest _REC_AXS_20_u2 983.025 _CNV_A_R_LINEAR_____4_CM 8 0. 6553.5 FORMAT "%6.1" /end AXIS_PTS
/begin AXIS_PTS ldpm_maf_hb__ti_wup "" 0xa08094e4 maf_hb _REC_AXS_20_u1 1389. _CNV_A_R_LINEAR_____15_CM 8 0. 1389. FORMAT "%4.0" /end AXIS_PTS
/begin AXIS_PTS ldpm_n_32__ti_wup "" 0xa0809604 n_32 _REC_AXS_20_u1 8160. _CNV_A_R_LINEAR_____10_CM 8 0. 8160. FORMAT "%4.0" /end AXIS_PTS
/begin AXIS_PTS ldp_map_dif__fac_ti_vo_wup "" 0xa0808914 online_dummy _REC_AXS_20_u2 5434. _CNV_A_R_LINEAR_____27_CM 8 0. 5434. FORMAT "%7.2" /end AXIS_PTS
/begin AXIS_PTS ldp_map__ti_fac_n_map "" 0xa0808900 map _REC_AXS_20_u2 5434. _CNV_A_R_LINEAR_____27_CM 8 0. 5434. FORMAT "%7.2" /end AXIS_PTS
/begin AXIS_PTS ldp_n_32__ti_fac_n_map "" 0xa08089a4 n_32 _REC_AXS_20_u1 8160. _CNV_A_R_LINEAR_____10_CM 8 0. 8160. FORMAT "%4.0" /end AXIS_PTS
/begin AXIS_PTS ldp_toil_ti_fac_tia_toil "" 0xa0808f46 toil _REC_AXS_20_u1 200. _CNV_A_R_LINEAR_____26_CM 6 -40. 160. FORMAT "%3.0" /end AXIS_PTS
/begin AXIS_PTS ldp_tia_ti_fac_tia_toil "" 0xa0808e9e tia _REC_AXS_20_u1 190.5 _CNV_A_R_LINEAR_____17_CM 6 -48. 142.5 FORMAT "%6.2" /end AXIS_PTS
/begin AXIS_PTS ldp_tco__ti_fac_tco "" 0xa0808df4 tco _REC_AXS_20_u1 190.5 _CNV_A_R_LINEAR_____17_CM 3 -48. 142.5 FORMAT "%6.2" /end AXIS_PTS
/begin AXIS_PTS ldpm_tco__ti_wup_h_prs "" 0xa08097d0 tco _REC_AXS_20_u1 190.5 _CNV_A_R_LINEAR_____17_CM 8 -48. 142.5 FORMAT "%6.2" /end AXIS_PTS
/begin AXIS_PTS ldpm_tco__ti_wup_lih_l_prs "" 0xa08097dc tco _REC_AXS_20_u1 190.5 _CNV_A_R_LINEAR_____17_CM 8 -48. 142.5 FORMAT "%6.2" /end AXIS_PTS
/begin AXIS_PTS ldp_tco_st_ti_tco_wup_h_prs "" 0xa0808e12 tco_st _REC_AXS_20_u1 190.5 _CNV_A_R_LINEAR_____17_CM 3 -48. 142.5 FORMAT "%6.2" /end AXIS_PTS
/begin AXIS_PTS ldp_tco_st_ti_tco_wup_lih_l_prs "" 0xa0808e16 tco_st _REC_AXS_20_u1 190.5 _CNV_A_R_LINEAR_____17_CM 3 -48. 142.5 FORMAT "%6.2" /end AXIS_PTS
/begin AXIS_PTS ldp_fup_fac_ti_wup "" 0xa0808738 fup[0] _REC_AXS_20_u2 347776. _CNV_A_R_LINEAR_____171_CM 6 0. 347776. FORMAT "%6.0" /end AXIS_PTS
/begin AXIS_PTS ldp_vp_tia_thr "" 0xa0809264 online_dummy _REC_AXS_20_u2 4.4998623 _CNV_A_R_LINEAR_____172_CM 16 0. 4.999847 FORMAT "%7.5" /end AXIS_PTS
/begin AXIS_PTS ldp_vp_tia_tia "" 0xa0809288 online_dummy _REC_AXS_20_u2 4.4998623 _CNV_A_R_LINEAR_____172_CM 16 0. 4.999847 FORMAT "%7.5" /end AXIS_PTS
/begin AXIS_PTS ldp_t_acc_ip_fac_tq_loss_acc_on "" 0xa0808cc0 t_acc _REC_AXS_20_u1 2.55 _CNV_A_R_LINEAR_____3_CM 8 0. 2.55 FORMAT "%4.2" /end AXIS_PTS
/begin AXIS_PTS ldp_n_32_ip_fac_tq_loss_acc_on "" 0xa0808a04 n_32 _REC_AXS_20_u1 8160. _CNV_A_R_LINEAR_____10_CM 8 0. 8160. FORMAT "%4.0" /end AXIS_PTS
/begin AXIS_PTS ldp_n_32__tq_add_acc "" 0xa08089ae n_32 _REC_AXS_20_u1 8160. _CNV_A_R_LINEAR_____10_CM 6 0. 8160. FORMAT "%4.0" /end AXIS_PTS
/begin AXIS_PTS ldp_t_acc_fac_tq_loss_acc "" 0xa0808cb4 t_acc _REC_AXS_20_u1 2.55 _CNV_A_R_LINEAR_____3_CM 8 0. 2.55 FORMAT "%4.2" /end AXIS_PTS
/begin AXIS_PTS ldp_n_32__tq_add_heat_acc "" 0xa08089b6 n_32 _REC_AXS_20_u1 8160. _CNV_A_R_LINEAR_____10_CM 6 0. 8160. FORMAT "%4.0" /end AXIS_PTS
/begin AXIS_PTS ldp_n_32__tq_loss_acc "" 0xa08089ca n_32 _REC_AXS_20_u1 8160. _CNV_A_R_LINEAR_____10_CM 6 0. 8160. FORMAT "%4.0" /end AXIS_PTS
/begin AXIS_PTS ldp_tq_accin_can__tq_loss_acc "" 0xa0808f4e tq_accin_can _REC_AXS_20_u1 127.5 _CNV_A_R_LINEAR_____57_CM 6 0. 127.5 FORMAT "%5.2" /end AXIS_PTS
/begin AXIS_PTS ldp_tq_loss_acc_inp__tq_add_acc "" 0xa0808f98 tq_loss_acc_inp _REC_AXS_20_u2 2047.96875 _CNV_A_R_LINEAR_____87_CM 6 -1024. 1023.96875 FORMAT "%6.2" /end AXIS_PTS
/begin AXIS_PTS ldpm_ac_veh_trv_tcs "" 0xa0809324 ac_veh_trv_tcs _REC_AXS_20_u2 102.35 _CNV_A_R_LINEAR_____256_CM 8 -51.175 51.175 FORMAT "%7.4" /end AXIS_PTS
/begin AXIS_PTS ldpm_vs_fil "" 0xa08098c8 vs_fil _REC_AXS_20_u2 511.99218 _CNV_A_R_LINEAR_____86_CM 8 0. 511.99218 FORMAT "%7.3" /end AXIS_PTS
/begin AXIS_PTS ldpm_n_32__tq_loss_ars "" 0xa0809610 n_32 _REC_AXS_20_u1 8160. _CNV_A_R_LINEAR_____10_CM 8 0. 8160. FORMAT "%4.0" /end AXIS_PTS
/begin AXIS_PTS ldp_tq_loss_ars_sp_can_max "" 0xa0808fdc tq_loss_ars_sp_can _REC_AXS_20_u2 2047.96875 _CNV_A_R_LINEAR_____87_CM 8 -1024. 1023.96875 FORMAT "%6.2" /end AXIS_PTS
/begin AXIS_PTS ldp_tq_loss_ars_av_can_max "" 0xa0808fb8 tq_loss_ars_av_can _REC_AXS_20_u2 2047.96875 _CNV_A_R_LINEAR_____87_CM 8 -1024. 1023.96875 FORMAT "%6.2" /end AXIS_PTS
/begin AXIS_PTS ldp_tco__tq_clu_amt "" 0xa0808df8 tco _REC_AXS_20_u1 190.5 _CNV_A_R_LINEAR_____17_CM 6 -48. 142.5 FORMAT "%5.1" /end AXIS_PTS
/begin AXIS_PTS ldp_n_dif__tq_clu_amt "" 0xa0808ae8 n_dif _REC_AXS_20_u2 65535. _CNV_A_R_LINEAR_____193_CM 6 -32768. 32767. FORMAT "%6.0" /end AXIS_PTS
/begin AXIS_PTS ldp_n_32_ip_tq_add_conv "" 0xa0808a56 n_32 _REC_AXS_20_u1 8160. _CNV_A_R_LINEAR_____10_CM 6 0. 8160. FORMAT "%4.0" /end AXIS_PTS
/begin AXIS_PTS ldp_n_32_ip_tq_add_amt "" 0xa0808a4e n_32 _REC_AXS_20_u1 8160. _CNV_A_R_LINEAR_____10_CM 6 0. 8160. FORMAT "%4.0" /end AXIS_PTS
/begin AXIS_PTS ldp_vs_fil__tq_clu_amt "" 0xa08092c4 vs_fil _REC_AXS_20_u2 511.99218 _CNV_A_R_LINEAR_____86_CM 6 0. 511.99218 FORMAT "%7.3" /end AXIS_PTS
/begin AXIS_PTS ldp_n_ratio_conv_fac_tq_conv "" 0xa0808b9c n_ratio_conv _REC_AXS_20_u1 0.99609375 _CNV_A_R_LINEAR_____28_CM 8 0. 0.99609375 FORMAT "%5.3" /end AXIS_PTS
/begin AXIS_PTS ldp_toil_t_dly_n_sp_is "" 0xa0808f24 toil _REC_AXS_20_u1 200. _CNV_A_R_LINEAR_____26_CM 8 -40. 160. FORMAT "%3.0" /end AXIS_PTS
/begin AXIS_PTS ldp_toil_t_dly_conv "" 0xa0808f18 toil _REC_AXS_20_u1 200. _CNV_A_R_LINEAR_____26_CM 8 -40. 160. FORMAT "%3.0" /end AXIS_PTS
/begin AXIS_PTS ldp_toil_fac_conv "" 0xa0808ef8 toil _REC_AXS_20_u1 200. _CNV_A_R_LINEAR_____26_CM 8 -40. 160. FORMAT "%3.0" /end AXIS_PTS
/begin AXIS_PTS ldp_gr_at_n_tur "" 0xa0808778 gr_at _REC_AXS_20_u1 8. _CNV_A_R_LINEAR_____0_CM 13 0. 8. FORMAT "%1.0" /end AXIS_PTS
/begin AXIS_PTS ldp_n_32__tq_conv "" 0xa08089c0 n_32 _REC_AXS_20_u1 8160. _CNV_A_R_LINEAR_____10_CM 8 0. 8160. FORMAT "%4.0" /end AXIS_PTS
/begin AXIS_PTS ldp_vs_n_tur "" 0xa080930e vs _REC_AXS_20_u1 255. _CNV_A_R_LINEAR_____6_CM 2 0. 255. FORMAT "%3.0" /end AXIS_PTS
/begin AXIS_PTS ldp_tq_conv_can__tq_conv "" 0xa0808f64 tq_conv_can _REC_AXS_20_u2 2047.96875 _CNV_A_R_LINEAR_____87_CM 8 -1024. 1023.96875 FORMAT "%6.2" /end AXIS_PTS
/begin AXIS_PTS ldp_toil_t_ramp_conv_pos "" 0xa0808f3c toil _REC_AXS_20_u1 200. _CNV_A_R_LINEAR_____26_CM 8 -40. 160. FORMAT "%3.0" /end AXIS_PTS
/begin AXIS_PTS ldp_toil_t_ramp_conv_neg "" 0xa0808f30 toil _REC_AXS_20_u1 200. _CNV_A_R_LINEAR_____26_CM 8 -40. 160. FORMAT "%3.0" /end AXIS_PTS
/begin AXIS_PTS ldpm_toil_tq_add_conv "" 0xa0809880 toil _REC_AXS_20_u1 200. _CNV_A_R_LINEAR_____26_CM 6 -40. 160. FORMAT "%3.0" /end AXIS_PTS
/begin AXIS_PTS ldpm_vs_tq_add_conv "" 0xa0809910 vs _REC_AXS_20_u1 255. _CNV_A_R_LINEAR_____6_CM 6 0. 255. FORMAT "%3.0" /end AXIS_PTS
/begin AXIS_PTS ldp_n_grd_tq_add_conv "" 0xa0808b28 n_grd _REC_AXS_20_u1 8160. _CNV_A_R_LINEAR_____29_CM 6 -4096. 4064. FORMAT "%5.0" /end AXIS_PTS
/begin AXIS_PTS ldp_ac_cru_tq_add_conv "" 0xa08084e0 ac_cru _REC_AXS_20_u2 31.43952 _CNV_A_R_LINEAR_____258_CM 6 -15.72 15.71952 FORMAT "%8.4" /end AXIS_PTS
/begin AXIS_PTS ldp_eff_scc_sp__nr_pat_scc "" 0xa08085ac eff_scc_sp _REC_AXS_20_u2 1.99996948242188 _CNV_A_R_LINEAR_____9_CM 13 0. 1.99996948242188 FORMAT "%7.5" /end AXIS_PTS
/begin AXIS_PTS ldp_maf__min_fcut_fast "" 0xa0808820 maf _REC_AXS_20_u2 1389. _CNV_A_R_LINEAR_____111_CM 4 0. 1389. FORMAT "%7.2" /end AXIS_PTS
/begin AXIS_PTS ldp_n__min_fcut_fast "" 0xa0808aa0 n _REC_AXS_20_u2 8160. _CNV_A_R_LINEAR_____14_CM 4 0. 8160. FORMAT "%4.0" /end AXIS_PTS
/begin AXIS_PTS ldpm_tco_ip_tq_st "" 0xa08097e8 tco _REC_AXS_20_u1 190.5 _CNV_A_R_LINEAR_____17_CM 8 -48. 142.5 FORMAT "%5.1" /end AXIS_PTS
/begin AXIS_PTS ldpm_n_dif_ip_tq_st "" 0xa0809684 n_dif _REC_AXS_20_u2 65535. _CNV_A_R_LINEAR_____193_CM 8 -32768. 32767. FORMAT "%6.0" /end AXIS_PTS
/begin AXIS_PTS ldp_n_32__tqi_dif_lim "" 0xa08089d2 n_32 _REC_AXS_20_u1 8160. _CNV_A_R_LINEAR_____10_CM 4 0. 8160. FORMAT "%4.0" /end AXIS_PTS
/begin AXIS_PTS ldp_tqi_sp_mon__tqi_dif_lim "" 0xa0809076 tqi_sp_mon _REC_AXS_20_u1 510. _CNV_A_R_LINEAR_____262_CM 4 0. 510. FORMAT "%3.0" /end AXIS_PTS
/begin AXIS_PTS ldpm_gear__tq_p_max "" 0xa0809434 gear _REC_AXS_20_u1 12. _CNV_A_R_LINEAR_____50_CM 13 0. 12. FORMAT "%3.0" /end AXIS_PTS
/begin AXIS_PTS ldpm_vs_fil__tq_p_max "" 0xa08098dc vs_fil _REC_AXS_20_u2 511.99218 _CNV_A_R_LINEAR_____86_CM 6 0. 511.99218 FORMAT "%7.3" /end AXIS_PTS
/begin AXIS_PTS ldpm_ang_pste_stnd_tqlo_1 "" 0xa080934c ang_pste_stnd _REC_AXS_20_u2 199.99694824 _CNV_A_R_LINEAR_____263_CM 8 -100. 99.99694824 FORMAT "%8.3" /end AXIS_PTS
/begin AXIS_PTS ldpm_ang_pste_stnd_tqlo "" 0xa0809338 ang_pste_stnd _REC_AXS_20_u2 199.99694824 _CNV_A_R_LINEAR_____263_CM 8 -100. 99.99694824 FORMAT "%8.3" /end AXIS_PTS
/begin AXIS_PTS ldp_tq_loss_pste_2_sp_can "" 0xa0809010 tq_loss_pste_2_sp_can _REC_AXS_20_u2 2047.96875 _CNV_A_R_LINEAR_____87_CM 8 -1024. 1023.96875 FORMAT "%6.2" /end AXIS_PTS
/begin AXIS_PTS ldpm_tq_loss_pste_3_sp_can "" 0xa0809888 tq_loss_pste_3_sp_can _REC_AXS_20_u2 2047.96875 _CNV_A_R_LINEAR_____87_CM 8 -1024. 1023.96875 FORMAT "%6.2" /end AXIS_PTS
/begin AXIS_PTS ldp_n__fac_tq_add_pste "" 0xa0808a8c n _REC_AXS_20_u2 8160. _CNV_A_R_LINEAR_____14_CM 8 0. 8160. FORMAT "%4.0" /end AXIS_PTS
/begin AXIS_PTS ldpm_vs_tq_loss_pste_2 "" 0xa0809918 vs _REC_AXS_20_u1 255. _CNV_A_R_LINEAR_____6_CM 6 0. 255. FORMAT "%3.0" /end AXIS_PTS
/begin AXIS_PTS ldpm_vs_tq_loss_pste_3 "" 0xa0809920 vs _REC_AXS_20_u1 255. _CNV_A_R_LINEAR_____6_CM 6 0. 255. FORMAT "%3.0" /end AXIS_PTS
/begin AXIS_PTS ldp_vel_ang_pste_tqlo_1 "" 0xa0809110 vel_ang_pste_cor _REC_AXS_20_u2 2879.935575 _CNV_A_R_LINEAR_____265_CM 8 -1439.98976 1439.945815 FORMAT "%8.2" /end AXIS_PTS
/begin AXIS_PTS ldpm_vel_ang_pste_tqlo "" 0xa08098b0 vel_ang_pste_cor _REC_AXS_20_u2 2879.935575 _CNV_A_R_LINEAR_____265_CM 8 -1439.98976 1439.945815 FORMAT "%8.2" /end AXIS_PTS
/begin AXIS_PTS ldpm_n_32__pste_3 "" 0xa08095f0 n_32 _REC_AXS_20_u1 8160. _CNV_A_R_LINEAR_____10_CM 8 0. 8160. FORMAT "%4.0" /end AXIS_PTS
/begin CHARACTERISTIC ip_tq_loss_pste_3_mdl_pste "" MAP 0xa0816c84 _REC_MAP_20_u2_u2_u2 2047.96875 _CNV_A_R_LINEAR_____87_CM -1024. 1023.96875 DISPLAY_IDENTIFIER IP_TQ_LOSS_PSTE_3_MDL_PSTE FORMAT "%6.2"
 /begin AXIS_DESCR COM_AXIS ang_pste_stnd _CNV_A_R_LINEAR_____263_CM 8 -100. 99.99694824 FORMAT "%8.3" AXIS_PTS_REF ldpm_ang_pste_stnd_tqlo /end AXIS_DESCR
 /begin AXIS_DESCR COM_AXIS vel_ang_pste_cor _CNV_A_R_LINEAR_____265_CM 8 -1439.98976 1439.945815 FORMAT "%8.2" AXIS_PTS_REF ldpm_vel_ang_pste_tqlo /end AXIS_DESCR
/end CHARACTERISTIC
/begin CHARACTERISTIC ip_tq_loss_pste_3_mdl_pste_2 "" MAP 0xa0816d04 _REC_MAP_20_u2_u2_u2 2047.96875 _CNV_A_R_LINEAR_____87_CM -1024. 1023.96875 DISPLAY_IDENTIFIER IP_TQ_LOSS_PSTE_3_MDL_PSTE_2 FORMAT "%6.2"
 /begin AXIS_DESCR COM_AXIS ang_pste_stnd _CNV_A_R_LINEAR_____263_CM 8 -100. 99.99694824 FORMAT "%8.3" AXIS_PTS_REF ldpm_ang_pste_stnd_tqlo /end AXIS_DESCR
 /begin AXIS_DESCR COM_AXIS vel_ang_pste_cor _CNV_A_R_LINEAR_____265_CM 8 -1439.98976 1439.945815 FORMAT "%8.2" AXIS_PTS_REF ldpm_vel_ang_pste_tqlo /end AXIS_DESCR
/end CHARACTERISTIC
/begin CHARACTERISTIC ip_fac_tq_loss_pste_3_mdl_pste "" MAP 0xa080ab04 _REC_MAP_20_u1_u1_u1 3.984375 _CNV_A_R_LINEAR_____243_CM 0. 3.984375 DISPLAY_IDENTIFIER IP_FAC_TQ_LOSS_PSTE_3_MDL_PSTE FORMAT "%4.2"
 /begin AXIS_DESCR COM_AXIS vs _CNV_A_R_LINEAR_____6_CM 6 0. 255. FORMAT "%3.0" AXIS_PTS_REF ldpm_vs_tq_loss_pste_3 /end AXIS_DESCR
 /begin AXIS_DESCR COM_AXIS n_32 _CNV_A_R_LINEAR_____10_CM 8 0. 8160. FORMAT "%4.0" AXIS_PTS_REF ldpm_n_32__pste_3 /end AXIS_DESCR
/end CHARACTERISTIC
/begin CHARACTERISTIC ip_fac_tq_loss_pste_3_mdl_pste2 "" MAP 0xa080ab34 _REC_MAP_20_u1_u1_u1 3.984375 _CNV_A_R_LINEAR_____243_CM 0. 3.984375 DISPLAY_IDENTIFIER IP_FAC_TQ_LOSS_PSTE_3_MDL_PSTE2 FORMAT "%4.2"
 /begin AXIS_DESCR COM_AXIS vs _CNV_A_R_LINEAR_____6_CM 6 0. 255. FORMAT "%3.0" AXIS_PTS_REF ldpm_vs_tq_loss_pste_3 /end AXIS_DESCR
 /begin AXIS_DESCR COM_AXIS n_32 _CNV_A_R_LINEAR_____10_CM 8 0. 8160. FORMAT "%4.0" AXIS_PTS_REF ldpm_n_32__pste_3 /end AXIS_DESCR
/end CHARACTERISTIC
/begin CHARACTERISTIC ip_tq_loss_pste_3_cor_pste "" MAP 0xa080b7e0 _REC_MAP_20_u1_u2_u2 3.984375 _CNV_A_R_LINEAR_____243_CM 0. 3.984375 DISPLAY_IDENTIFIER IP_TQ_LOSS_PSTE_3_COR_PSTE FORMAT "%4.2"
 /begin AXIS_DESCR COM_AXIS ang_pste_stnd _CNV_A_R_LINEAR_____263_CM 8 -100. 99.99694824 FORMAT "%8.3" AXIS_PTS_REF ldpm_ang_pste_stnd_tqlo /end AXIS_DESCR
 /begin AXIS_DESCR COM_AXIS vel_ang_pste_cor _CNV_A_R_LINEAR_____265_CM 8 -1439.98976 1439.945815 FORMAT "%8.2" AXIS_PTS_REF ldpm_vel_ang_pste_tqlo /end AXIS_DESCR
/end CHARACTERISTIC
/begin CHARACTERISTIC ip_tq_loss_pste_3_cor_pste_2 "" MAP 0xa080b820 _REC_MAP_20_u1_u2_u2 3.984375 _CNV_A_R_LINEAR_____243_CM 0. 3.984375 DISPLAY_IDENTIFIER IP_TQ_LOSS_PSTE_3_COR_PSTE_2 FORMAT "%4.2"
 /begin AXIS_DESCR COM_AXIS ang_pste_stnd _CNV_A_R_LINEAR_____263_CM 8 -100. 99.99694824 FORMAT "%8.3" AXIS_PTS_REF ldpm_ang_pste_stnd_tqlo /end AXIS_DESCR
 /begin AXIS_DESCR COM_AXIS vel_ang_pste_cor _CNV_A_R_LINEAR_____265_CM 8 -1439.98976 1439.945815 FORMAT "%8.2" AXIS_PTS_REF ldpm_vel_ang_pste_tqlo /end AXIS_DESCR
/end CHARACTERISTIC
/begin CHARACTERISTIC ip_tq_loss_pste_3_ang_pste "" MAP 0xa080b760 _REC_MAP_20_u1_u2_u2 3.984375 _CNV_A_R_LINEAR_____243_CM 0. 3.984375 DISPLAY_IDENTIFIER IP_TQ_LOSS_PSTE_3_ANG_PSTE FORMAT "%4.2"
 /begin AXIS_DESCR COM_AXIS ang_pste_stnd _CNV_A_R_LINEAR_____263_CM 8 -100. 99.99694824 FORMAT "%8.3" AXIS_PTS_REF ldpm_ang_pste_stnd_tqlo /end AXIS_DESCR
 /begin AXIS_DESCR COM_AXIS vel_ang_pste_cor _CNV_A_R_LINEAR_____265_CM 8 -1439.98976 1439.945815 FORMAT "%8.2" AXIS_PTS_REF ldpm_vel_ang_pste_tqlo /end AXIS_DESCR
/end CHARACTERISTIC
/begin CHARACTERISTIC ip_tq_loss_pste_3_ang_pste_2 "" MAP 0xa080b7a0 _REC_MAP_20_u1_u2_u2 3.984375 _CNV_A_R_LINEAR_____243_CM 0. 3.984375 DISPLAY_IDENTIFIER IP_TQ_LOSS_PSTE_3_ANG_PSTE_2 FORMAT "%4.2"
 /begin AXIS_DESCR COM_AXIS ang_pste_stnd _CNV_A_R_LINEAR_____263_CM 8 -100. 99.99694824 FORMAT "%8.3" AXIS_PTS_REF ldpm_ang_pste_stnd_tqlo /end AXIS_DESCR
 /begin AXIS_DESCR COM_AXIS vel_ang_pste_cor _CNV_A_R_LINEAR_____265_CM 8 -1439.98976 1439.945815 FORMAT "%8.2" AXIS_PTS_REF ldpm_vel_ang_pste_tqlo /end AXIS_DESCR
/end CHARACTERISTIC
/begin CHARACTERISTIC ip_fac_tq_loss_pste_3_cor_pste "" MAP 0xa080aaa4 _REC_MAP_20_u1_u1_u1 3.984375 _CNV_A_R_LINEAR_____243_CM 0. 3.984375 DISPLAY_IDENTIFIER IP_FAC_TQ_LOSS_PSTE_3_COR_PSTE FORMAT "%4.2"
 /begin AXIS_DESCR COM_AXIS vs _CNV_A_R_LINEAR_____6_CM 6 0. 255. FORMAT "%3.0" AXIS_PTS_REF ldpm_vs_tq_loss_pste_3 /end AXIS_DESCR
 /begin AXIS_DESCR COM_AXIS n_32 _CNV_A_R_LINEAR_____10_CM 8 0. 8160. FORMAT "%4.0" AXIS_PTS_REF ldpm_n_32__pste_3 /end AXIS_DESCR
/end CHARACTERISTIC
/begin CHARACTERISTIC ip_fac_tq_loss_pste_3_cor_pste2 "" MAP 0xa080aad4 _REC_MAP_20_u1_u1_u1 3.984375 _CNV_A_R_LINEAR_____243_CM 0. 3.984375 DISPLAY_IDENTIFIER IP_FAC_TQ_LOSS_PSTE_3_COR_PSTE2 FORMAT "%4.2"
 /begin AXIS_DESCR COM_AXIS vs _CNV_A_R_LINEAR_____6_CM 6 0. 255. FORMAT "%3.0" AXIS_PTS_REF ldpm_vs_tq_loss_pste_3 /end AXIS_DESCR
 /begin AXIS_DESCR COM_AXIS n_32 _CNV_A_R_LINEAR_____10_CM 8 0. 8160. FORMAT "%4.0" AXIS_PTS_REF ldpm_n_32__pste_3 /end AXIS_DESCR
/end CHARACTERISTIC
/begin CHARACTERISTIC ip_fac_tq_loss_pste_3_pste "" MAP 0xa080ab64 _REC_MAP_20_u1_u1_u1 3.984375 _CNV_A_R_LINEAR_____243_CM 0. 3.984375 DISPLAY_IDENTIFIER IP_FAC_TQ_LOSS_PSTE_3_PSTE FORMAT "%4.2"
 /begin AXIS_DESCR COM_AXIS vs _CNV_A_R_LINEAR_____6_CM 6 0. 255. FORMAT "%3.0" AXIS_PTS_REF ldpm_vs_tq_loss_pste_3 /end AXIS_DESCR
 /begin AXIS_DESCR COM_AXIS n_32 _CNV_A_R_LINEAR_____10_CM 8 0. 8160. FORMAT "%4.0" AXIS_PTS_REF ldpm_n_32__pste_3 /end AXIS_DESCR
/end CHARACTERISTIC
/begin CHARACTERISTIC ip_fac_tq_loss_pste_3_pste_2 "" MAP 0xa080ab94 _REC_MAP_20_u1_u1_u1 3.984375 _CNV_A_R_LINEAR_____243_CM 0. 3.984375 DISPLAY_IDENTIFIER IP_FAC_TQ_LOSS_PSTE_3_PSTE_2 FORMAT "%4.2"
 /begin AXIS_DESCR COM_AXIS vs _CNV_A_R_LINEAR_____6_CM 6 0. 255. FORMAT "%3.0" AXIS_PTS_REF ldpm_vs_tq_loss_pste_3 /end AXIS_DESCR
 /begin AXIS_DESCR COM_AXIS n_32 _CNV_A_R_LINEAR_____10_CM 8 0. 8160. FORMAT "%4.0" AXIS_PTS_REF ldpm_n_32__pste_3 /end AXIS_DESCR
/end CHARACTERISTIC
/begin AXIS_PTS ldpm_n_32_ip_rel_flow_max_cps "" 0xa0805168 n_32 _REC_AXS_20_u1 8160. _CNV_A_R_LINEAR_____10_CM 12 0. 8160. FORMAT "%4.0" /end AXIS_PTS
/begin AXIS_PTS ldpm_maf_kgh__crlc_vls_down "" 0xa0806778 maf_kgh _REC_AXS_20_u2 2047.96875 _CNV_A_R_LINEAR_____215_CM 4 0. 2047.96875 FORMAT "%7.2" /end AXIS_PTS
/begin AXIS_PTS ldpm_vs_wheel_grd_mmv_thd "" 0xa0806ee8 vs _REC_AXS_20_u1 255. _CNV_A_R_LINEAR_____6_CM 9 0. 255. FORMAT "%3.0" /end AXIS_PTS
/begin AXIS_PTS ldpm_tia_1 "" 0xa080983a tia _REC_AXS_20_u1 190.5 _CNV_A_R_LINEAR_____17_CM 6 -48. 142.5 FORMAT "%5.1" /end AXIS_PTS
/begin CHARACTERISTIC c_var_state "Country variant of the dataset" VALUE 0xa080c414 _REC_VAL_20_u1 255. _CNV_A_R_LINEAR_____0_CM 0. 255. DISPLAY_IDENTIFIER C_VAR_STATE FORMAT "%3.0" /end CHARACTERISTIC
/begin CHARACTERISTIC lc_egy_min_kwp "Switch to enable the configuration of FeTraWe-mode in ECU / enable =1 " VALUE 0xa080c558 _REC_VAL_20_u1 1. _CNV_S_2_RANGE______76_CM 0. 1. DISPLAY_IDENTIFIER LC_EGY_MIN_KWP /end CHARACTERISTIC
/begin CHARACTERISTIC c_poil_min_kwp " " VALUE 0xa080c080 _REC_VAL_20_u2 20. _CNV_A_R_LINEAR_____430_CM 0. 20. DISPLAY_IDENTIFIER C_POIL_MIN_KWP /end CHARACTERISTIC
/begin CHARACTERISTIC c_poil_max_kwp " " VALUE 0xa080c07e _REC_VAL_20_u2 20. _CNV_A_R_LINEAR_____430_CM 0. 20. DISPLAY_IDENTIFIER C_POIL_MAX_KWP /end CHARACTERISTIC
/begin AXIS_PTS ldp_fmy_dtc "" 0xa0808688 online_dummy _REC_AXS_20_u2 5. _CNV_A_R_LINEAR_____50_CM 6 0. 5. FORMAT "%2.0" /end AXIS_PTS
/begin AXIS_PTS ldp_tco_ip_t_ast_is_ad_inh "" 0xa0807fcc tco _REC_AXS_20_u1 190.5 _CNV_A_R_LINEAR_____17_CM 4 -48. 142.5 FORMAT "%5.1" /end AXIS_PTS
/begin AXIS_PTS ldp_ecfpwm "" 0xa0802614 ecfpwm[0] _REC_AXS_20_u1 99.609375 _CNV_A_R_LINEAR_____5_CM 8 0. 99.609375 FORMAT "%9.6" /end AXIS_PTS
/begin CHARACTERISTIC lc_swi_tco_2_sub "Minimum engine cooling temperature eo activate the diagnosis condition" VALUE 0xa08028cf _REC_VAL_20_u1 1. _CNV_A_R_LINEAR_____0_CM 0. 1. DISPLAY_IDENTIFIER LC_SWI_TCO_2_SUB FORMAT "%2.0" /end CHARACTERISTIC
/begin AXIS_PTS ldpm_n_t_n_dif_ofs_pred "" 0xa080970c n _REC_AXS_20_u2 8160. _CNV_A_R_LINEAR_____14_CM 8 0. 8160. FORMAT "%4.0" /end AXIS_PTS
/begin AXIS_PTS ldp_vs_fil_ip_fac_vs_tq_add_pl "" 0xa08092e4 vs_fil _REC_AXS_20_u2 511.99218 _CNV_A_R_LINEAR_____86_CM 4 0. 511.99218 FORMAT "%7.3" /end AXIS_PTS
/begin AXIS_PTS ldp_tq_av_ip_fac_n_grd "" 0xa0808f58 tq_av _REC_AXS_20_u2 2047.96875 _CNV_A_R_LINEAR_____87_CM 4 -1024. 1023.96875 FORMAT "%6.2" /end AXIS_PTS
/begin AXIS_PTS ldp_fac_tq_req_ip_fac_tq_drof "" 0xa080864c fac_tq_req _REC_AXS_20_u2 1.99996948242188 _CNV_A_R_LINEAR_____9_CM 6 0. 1.99996948242188 FORMAT "%9.8" /end AXIS_PTS
/begin AXIS_PTS ldp_n_dif_drof__id_tq_drof "" 0xa0808af8 n_dif_drof _REC_AXS_20_u2 65535. _CNV_A_R_LINEAR_____193_CM 3 -32768. 32767. FORMAT "%6.0" /end AXIS_PTS
/begin AXIS_PTS ldp_n_grd__id_tq_drof "" 0xa0808b0e n_grd _REC_AXS_20_u1 8160. _CNV_A_R_LINEAR_____29_CM 3 -4096. 4064. FORMAT "%5.0" /end AXIS_PTS
/begin AXIS_PTS ldp_gear__var_amt_load_im "" 0xa080876c gear _REC_AXS_20_u1 255. _CNV_A_R_LINEAR_____0_CM 8 0. 255. FORMAT "%3.0" /end AXIS_PTS
/begin AXIS_PTS ldp_n_dif_pred_fac_tq_add_is_1 "" 0xa0808b00 n_dif_pred_pl_drof _REC_AXS_20_u2 65535. _CNV_A_R_LINEAR_____193_CM 6 -32768. 32767. FORMAT "%6.0" /end AXIS_PTS
/begin AXIS_PTS ldp_fac_tq_req_drof_1 "" 0xa080863c fac_tq_req _REC_AXS_20_u2 1.99996948242188 _CNV_A_R_LINEAR_____9_CM 6 0. 1.99996948242188 FORMAT "%7.5" /end AXIS_PTS
/begin AXIS_PTS ldp_tia_ip_fac_temp_tq_add_1 "" 0xa0808e96 tia _REC_AXS_20_u1 190.5 _CNV_A_R_LINEAR_____17_CM 6 -48. 142.5 FORMAT "%5.1" /end AXIS_PTS
/begin AXIS_PTS ldp_toil_ip_fac_temp_tq_add_1 "" 0xa0808f02 toil _REC_AXS_20_u1 200. _CNV_A_R_LINEAR_____26_CM 6 -40. 160. FORMAT "%3.0" /end AXIS_PTS
/begin AXIS_PTS ldp_n_grd_ip_n_dif_add_drof_1 "" 0xa0808b12 n_grd _REC_AXS_20_u1 8160. _CNV_A_R_LINEAR_____29_CM 4 -4096. 4064. FORMAT "%5.0" /end AXIS_PTS
/begin AXIS_PTS ldp_n_sp_is_ip_n_dif_add_drof_1 "" 0xa0808ba8 n_sp_is _REC_AXS_20_u2 8160. _CNV_A_R_LINEAR_____14_CM 4 0. 8160. FORMAT "%4.0" /end AXIS_PTS
/begin AXIS_PTS ldpm_n_dif_drof_ip_tq_drof_1 "" 0xa080966c n_dif_drof _REC_AXS_20_u2 65535. _CNV_A_R_LINEAR_____193_CM 11 -32768. 32767. FORMAT "%6.0" /end AXIS_PTS
/begin AXIS_PTS ldpm_n_grd_ip_tq_drof_1 "" 0xa08096b8 n_grd _REC_AXS_20_u1 8160. _CNV_A_R_LINEAR_____29_CM 10 -4096. 4064. FORMAT "%5.0" /end AXIS_PTS
/begin AXIS_PTS ldp_vs_fil_ip_fac_tq_drof_vs_1 "" 0xa08092d4 vs_fil _REC_AXS_20_u2 511.99218 _CNV_A_R_LINEAR_____86_CM 6 0. 511.99218 FORMAT "%7.3" /end AXIS_PTS
/begin AXIS_PTS ldp_n_ip_fac_tq_drof_vs_1 "" 0xa0808b5c n _REC_AXS_20_u2 8160. _CNV_A_R_LINEAR_____14_CM 6 0. 8160. FORMAT "%4.0" /end AXIS_PTS
/begin AXIS_PTS ldp_tq_drof_grd_deac_1 "" 0xa0808f78 tq_drof_fast _REC_AXS_20_u2 1023.96875 _CNV_A_R_LINEAR_____31_CM 6 0. 1023.96875 FORMAT "%7.2" /end AXIS_PTS
/begin AXIS_PTS ldp_tq_drof_grd_deac_2 "" 0xa0808f88 tq_drof_fast _REC_AXS_20_u2 1023.96875 _CNV_A_R_LINEAR_____31_CM 6 0. 1023.96875 FORMAT "%7.2" /end AXIS_PTS
/begin AXIS_PTS ldp_maf_thr_ip_amp_dec "" 0xa08088f4 maf_thr _REC_AXS_20_u2 2047.96875 _CNV_A_R_LINEAR_____215_CM 4 0. 2047.96875 FORMAT "%6.2" /end AXIS_PTS
/begin MEASUREMENT mff_sp_3_s[4] "Fuel mass setpoint for the third  pulse at stratified mode " UWORD _CNV_A_R_LINEAR_____111_CM 1 100. 0. 1389. DISPLAY_IDENTIFIER MFF_SP_3_S[4] ECU_ADDRESS 0xd00069cc FORMAT "%7.2" /end MEASUREMENT
/begin MEASUREMENT mff_sp_3_s[5] "Fuel mass setpoint for the third  pulse at stratified mode " UWORD _CNV_A_R_LINEAR_____111_CM 1 100. 0. 1389. DISPLAY_IDENTIFIER MFF_SP_3_S[5] ECU_ADDRESS 0xd00069ce FORMAT "%7.2" /end MEASUREMENT
/begin MEASUREMENT mff_sp_3_s[6] "Fuel mass setpoint for the third  pulse at stratified mode " UWORD _CNV_A_R_LINEAR_____111_CM 1 100. 0. 1389. DISPLAY_IDENTIFIER MFF_SP_3_S[6] ECU_ADDRESS 0xd00069d0 FORMAT "%7.2" /end MEASUREMENT
/begin MEASUREMENT mff_sp_3_s[7] "Fuel mass setpoint for the third  pulse at stratified mode " UWORD _CNV_A_R_LINEAR_____111_CM 1 100. 0. 1389. DISPLAY_IDENTIFIER MFF_SP_3_S[7] ECU_ADDRESS 0xd00069d2 FORMAT "%7.2" /end MEASUREMENT
/begin MEASUREMENT mff_sp_1_hom[0] "Fuel mass setpoint for the first pulse at homogeneous  mode " UWORD _CNV_A_R_LINEAR_____111_CM 1 100. 0. 1389. DISPLAY_IDENTIFIER MFF_SP_1_HOM[0] ECU_ADDRESS 0xd0006954 FORMAT "%7.2" /end MEASUREMENT
/begin MEASUREMENT mff_sp_1_hom[1] "Fuel mass setpoint for the first pulse at homogeneous  mode " UWORD _CNV_A_R_LINEAR_____111_CM 1 100. 0. 1389. DISPLAY_IDENTIFIER MFF_SP_1_HOM[1] ECU_ADDRESS 0xd0006956 FORMAT "%7.2" /end MEASUREMENT
/begin MEASUREMENT mff_sp_1_hom[2] "Fuel mass setpoint for the first pulse at homogeneous  mode " UWORD _CNV_A_R_LINEAR_____111_CM 1 100. 0. 1389. DISPLAY_IDENTIFIER MFF_SP_1_HOM[2] ECU_ADDRESS 0xd0006958 FORMAT "%7.2" /end MEASUREMENT
/begin MEASUREMENT mff_sp_1_hom[3] "Fuel mass setpoint for the first pulse at homogeneous  mode " UWORD _CNV_A_R_LINEAR_____111_CM 1 100. 0. 1389. DISPLAY_IDENTIFIER MFF_SP_1_HOM[3] ECU_ADDRESS 0xd000695a FORMAT "%7.2" /end MEASUREMENT
/begin MEASUREMENT mff_sp_1_hom[4] "Fuel mass setpoint for the first pulse at homogeneous  mode " UWORD _CNV_A_R_LINEAR_____111_CM 1 100. 0. 1389. DISPLAY_IDENTIFIER MFF_SP_1_HOM[4] ECU_ADDRESS 0xd000695c FORMAT "%7.2" /end MEASUREMENT
/begin MEASUREMENT mff_sp_1_hom[5] "Fuel mass setpoint for the first pulse at homogeneous  mode " UWORD _CNV_A_R_LINEAR_____111_CM 1 100. 0. 1389. DISPLAY_IDENTIFIER MFF_SP_1_HOM[5] ECU_ADDRESS 0xd000695e FORMAT "%7.2" /end MEASUREMENT
/begin MEASUREMENT mff_sp_1_hom[6] "Fuel mass setpoint for the first pulse at homogeneous  mode " UWORD _CNV_A_R_LINEAR_____111_CM 1 100. 0. 1389. DISPLAY_IDENTIFIER MFF_SP_1_HOM[6] ECU_ADDRESS 0xd0006960 FORMAT "%7.2" /end MEASUREMENT
/begin MEASUREMENT mff_sp_1_hom[7] "Fuel mass setpoint for the first pulse at homogeneous  mode " UWORD _CNV_A_R_LINEAR_____111_CM 1 100. 0. 1389. DISPLAY_IDENTIFIER MFF_SP_1_HOM[7] ECU_ADDRESS 0xd0006962 FORMAT "%7.2" /end MEASUREMENT
/begin MEASUREMENT mff_sp_2_hom[0] "Fuel mass setpoint for the second  pulse at homogeneous  mode " UWORD _CNV_A_R_LINEAR_____111_CM 1 100. 0. 1389. DISPLAY_IDENTIFIER MFF_SP_2_HOM[0] ECU_ADDRESS 0xd0006984 FORMAT "%7.2" /end MEASUREMENT
/begin MEASUREMENT mff_sp_2_hom[1] "Fuel mass setpoint for the second  pulse at homogeneous  mode " UWORD _CNV_A_R_LINEAR_____111_CM 1 100. 0. 1389. DISPLAY_IDENTIFIER MFF_SP_2_HOM[1] ECU_ADDRESS 0xd0006986 FORMAT "%7.2" /end MEASUREMENT
/begin MEASUREMENT mff_sp_2_hom[2] "Fuel mass setpoint for the second  pulse at homogeneous  mode " UWORD _CNV_A_R_LINEAR_____111_CM 1 100. 0. 1389. DISPLAY_IDENTIFIER MFF_SP_2_HOM[2] ECU_ADDRESS 0xd0006988 FORMAT "%7.2" /end MEASUREMENT
/begin MEASUREMENT mff_sp_2_hom[3] "Fuel mass setpoint for the second  pulse at homogeneous  mode " UWORD _CNV_A_R_LINEAR_____111_CM 1 100. 0. 1389. DISPLAY_IDENTIFIER MFF_SP_2_HOM[3] ECU_ADDRESS 0xd000698a FORMAT "%7.2" /end MEASUREMENT
/begin MEASUREMENT mff_sp_2_hom[4] "Fuel mass setpoint for the second  pulse at homogeneous  mode " UWORD _CNV_A_R_LINEAR_____111_CM 1 100. 0. 1389. DISPLAY_IDENTIFIER MFF_SP_2_HOM[4] ECU_ADDRESS 0xd000698c FORMAT "%7.2" /end MEASUREMENT
/begin MEASUREMENT mff_sp_2_hom[5] "Fuel mass setpoint for the second  pulse at homogeneous  mode " UWORD _CNV_A_R_LINEAR_____111_CM 1 100. 0. 1389. DISPLAY_IDENTIFIER MFF_SP_2_HOM[5] ECU_ADDRESS 0xd000698e FORMAT "%7.2" /end MEASUREMENT
/begin MEASUREMENT mff_sp_2_hom[6] "Fuel mass setpoint for the second  pulse at homogeneous  mode " UWORD _CNV_A_R_LINEAR_____111_CM 1 100. 0. 1389. DISPLAY_IDENTIFIER MFF_SP_2_HOM[6] ECU_ADDRESS 0xd0006990 FORMAT "%7.2" /end MEASUREMENT
/begin MEASUREMENT mff_sp_2_hom[7] "Fuel mass setpoint for the second  pulse at homogeneous  mode " UWORD _CNV_A_R_LINEAR_____111_CM 1 100. 0. 1389. DISPLAY_IDENTIFIER MFF_SP_2_HOM[7] ECU_ADDRESS 0xd0006992 FORMAT "%7.2" /end MEASUREMENT
/begin MEASUREMENT lv_eoi_st_ena "Indicates if an EOI based start is requested" UBYTE _CNV_S_2_RANGE__0___1_CM 1 100. 0. 1. DISPLAY_IDENTIFIER LV_EOI_ST_ENA ECU_ADDRESS 0xd0007611 /end MEASUREMENT
/begin MEASUREMENT lv_ti_cor_wf_opm_1_act "wall film operation mode switch" UBYTE _CNV_S_2_RANGE__0___1_CM 1 100. 0. 1. DISPLAY_IDENTIFIER LV_TI_COR_WF_OPM_1_ACT ECU_ADDRESS 0xd0007613 BIT_MASK 0x1 /end MEASUREMENT
/begin CHARACTERISTIC c_mff_sp_1_hom_man "Fuel mass setpoint for the first pulse in homogeneus mode (manual adjustment)" VALUE 0xa080be96 _REC_VAL_20_u2 1389. _CNV_A_R_LINEAR_____111_CM 0. 1389. DISPLAY_IDENTIFIER C_MFF_SP_1_HOM_MAN FORMAT "%7.2" /end CHARACTERISTIC
/begin CHARACTERISTIC c_mff_sp_2_hom_man "Fuel mass setpoint for the second pulse in homogeneus mode (manual adjustment)" VALUE 0xa080be9c _REC_VAL_20_u2 1389. _CNV_A_R_LINEAR_____111_CM 0. 1389. DISPLAY_IDENTIFIER C_MFF_SP_2_HOM_MAN FORMAT "%7.2" /end CHARACTERISTIC
/begin CHARACTERISTIC c_mff_sp_1_s_man "Fuel mass setpoint for the first pulse in stratified mode (manual adjustment)" VALUE 0xa080be9a _REC_VAL_20_u2 1389. _CNV_A_R_LINEAR_____111_CM 0. 1389. DISPLAY_IDENTIFIER C_MFF_SP_1_S_MAN FORMAT "%7.2" /end CHARACTERISTIC
/begin CHARACTERISTIC c_mff_sp_2_s_man "Fuel mass setpoint for the second pulse in stratified mode (manual adjustment)" VALUE 0xa080bea0 _REC_VAL_20_u2 1389. _CNV_A_R_LINEAR_____111_CM 0. 1389. DISPLAY_IDENTIFIER C_MFF_SP_2_S_MAN FORMAT "%7.2" /end CHARACTERISTIC
/begin CHARACTERISTIC c_mff_sp_3_s_man "Fuel mass setpoint for the third pulse in stratified mode (manual adjustment)" VALUE 0xa080bea4 _REC_VAL_20_u2 1389. _CNV_A_R_LINEAR_____111_CM 0. 1389. DISPLAY_IDENTIFIER C_MFF_SP_3_S_MAN FORMAT "%7.2" /end CHARACTERISTIC
/begin CHARACTERISTIC lc_mff_sp_hom_man_act "Switch for manual homogeneus mode active" VALUE 0xa080c5b0 _REC_VAL_20_u1 1. _CNV_S_2_RANGE__0___1_CM 0. 1. DISPLAY_IDENTIFIER LC_MFF_SP_HOM_MAN_ACT /end CHARACTERISTIC
/begin MEASUREMENT lv_st_inj_auth "Flag indicating injection authorized" UBYTE _CNV_S_2_RANGE__0___1_CM 1 100. 0. 1. DISPLAY_IDENTIFIER LV_ST_INJ_AUTH ECU_ADDRESS 0xd0007612 BIT_MASK 0x1 /end MEASUREMENT
/begin CHARACTERISTIC lc_mff_sp_s_man_act "Switch for manual stratified mode active" VALUE 0xa080c5b2 _REC_VAL_20_u1 1. _CNV_S_2_RANGE__0___1_CM 0. 1. DISPLAY_IDENTIFIER LC_MFF_SP_S_MAN_ACT /end CHARACTERISTIC
/begin CHARACTERISTIC lc_mff_add_ad_lam_bal_man "Manual switch to consider lamda adaption values for MFF_SP_1_S calculation" VALUE 0xa080c5ab _REC_VAL_20_u1 1. _CNV_S_2_RANGE__0___1_CM 0. 1. DISPLAY_IDENTIFIER LC_MFF_ADD_AD_LAM_BAL_MAN /end CHARACTERISTIC
/begin MEASUREMENT lv_add_pulse_ena "Switch to enable additional injection pulse at homogeneous mode, single injection mode" UBYTE _CNV_S_2_RANGE__0___1_CM 1 100. 0. 1. DISPLAY_IDENTIFIER LV_ADD_PULSE_ENA ECU_ADDRESS 0xd0007610 /end MEASUREMENT
/begin MEASUREMENT mff_sp_1_homs[0] "Fuel mass setpoint for the first pulse at homogeneous-stratified mode" UWORD _CNV_A_R_LINEAR_____111_CM 1 100. 0. 1389. DISPLAY_IDENTIFIER MFF_SP_1_HOMS[0] ECU_ADDRESS 0xd0006964 FORMAT "%7.2" /end MEASUREMENT
/begin MEASUREMENT mff_sp_1_homs[1] "Fuel mass setpoint for the first pulse at homogeneous-stratified mode" UWORD _CNV_A_R_LINEAR_____111_CM 1 100. 0. 1389. DISPLAY_IDENTIFIER MFF_SP_1_HOMS[1] ECU_ADDRESS 0xd0006966 FORMAT "%7.2" /end MEASUREMENT
/begin MEASUREMENT mff_sp_1_homs[2] "Fuel mass setpoint for the first pulse at homogeneous-stratified mode" UWORD _CNV_A_R_LINEAR_____111_CM 1 100. 0. 1389. DISPLAY_IDENTIFIER MFF_SP_1_HOMS[2] ECU_ADDRESS 0xd0006968 FORMAT "%7.2" /end MEASUREMENT
/begin MEASUREMENT mff_sp_1_homs[3] "Fuel mass setpoint for the first pulse at homogeneous-stratified mode" UWORD _CNV_A_R_LINEAR_____111_CM 1 100. 0. 1389. DISPLAY_IDENTIFIER MFF_SP_1_HOMS[3] ECU_ADDRESS 0xd000696a FORMAT "%7.2" /end MEASUREMENT
/begin MEASUREMENT mff_sp_1_homs[4] "Fuel mass setpoint for the first pulse at homogeneous-stratified mode" UWORD _CNV_A_R_LINEAR_____111_CM 1 100. 0. 1389. DISPLAY_IDENTIFIER MFF_SP_1_HOMS[4] ECU_ADDRESS 0xd000696c FORMAT "%7.2" /end MEASUREMENT
/begin MEASUREMENT mff_sp_1_homs[5] "Fuel mass setpoint for the first pulse at homogeneous-stratified mode" UWORD _CNV_A_R_LINEAR_____111_CM 1 100. 0. 1389. DISPLAY_IDENTIFIER MFF_SP_1_HOMS[5] ECU_ADDRESS 0xd000696e FORMAT "%7.2" /end MEASUREMENT
/begin MEASUREMENT mff_sp_1_homs[6] "Fuel mass setpoint for the first pulse at homogeneous-stratified mode" UWORD _CNV_A_R_LINEAR_____111_CM 1 100. 0. 1389. DISPLAY_IDENTIFIER MFF_SP_1_HOMS[6] ECU_ADDRESS 0xd0006970 FORMAT "%7.2" /end MEASUREMENT
/begin MEASUREMENT mff_sp_1_homs[7] "Fuel mass setpoint for the first pulse at homogeneous-stratified mode" UWORD _CNV_A_R_LINEAR_____111_CM 1 100. 0. 1389. DISPLAY_IDENTIFIER MFF_SP_1_HOMS[7] ECU_ADDRESS 0xd0006972 FORMAT "%7.2" /end MEASUREMENT
/begin MEASUREMENT mff_sp_homs "Fuel mass flow setpoint at homogeneous-stratified combustion mode " UWORD _CNV_A_R_LINEAR_____111_CM 1 100. 0. 1389. DISPLAY_IDENTIFIER MFF_SP_HOMS ECU_ADDRESS 0xd00069d8 FORMAT "%7.2" /end MEASUREMENT
/begin MEASUREMENT mff_sp_3_hom[0] "Fuel mass setpoint for the third pulse at homogeneous mode" UWORD _CNV_A_R_LINEAR_____111_CM 1 100. 0. 1389. DISPLAY_IDENTIFIER MFF_SP_3_HOM[0] ECU_ADDRESS 0xd00069b4 FORMAT "%7.2" /end MEASUREMENT
/begin MEASUREMENT mff_sp_3_hom[1] "Fuel mass setpoint for the third pulse at homogeneous mode" UWORD _CNV_A_R_LINEAR_____111_CM 1 100. 0. 1389. DISPLAY_IDENTIFIER MFF_SP_3_HOM[1] ECU_ADDRESS 0xd00069b6 FORMAT "%7.2" /end MEASUREMENT
/begin MEASUREMENT mff_sp_3_hom[2] "Fuel mass setpoint for the third pulse at homogeneous mode" UWORD _CNV_A_R_LINEAR_____111_CM 1 100. 0. 1389. DISPLAY_IDENTIFIER MFF_SP_3_HOM[2] ECU_ADDRESS 0xd00069b8 FORMAT "%7.2" /end MEASUREMENT
/begin MEASUREMENT mff_sp_3_hom[3] "Fuel mass setpoint for the third pulse at homogeneous mode" UWORD _CNV_A_R_LINEAR_____111_CM 1 100. 0. 1389. DISPLAY_IDENTIFIER MFF_SP_3_HOM[3] ECU_ADDRESS 0xd00069ba FORMAT "%7.2" /end MEASUREMENT
/begin MEASUREMENT mff_sp_3_hom[4] "Fuel mass setpoint for the third pulse at homogeneous mode" UWORD _CNV_A_R_LINEAR_____111_CM 1 100. 0. 1389. DISPLAY_IDENTIFIER MFF_SP_3_HOM[4] ECU_ADDRESS 0xd00069bc FORMAT "%7.2" /end MEASUREMENT
/begin MEASUREMENT mff_sp_3_hom[5] "Fuel mass setpoint for the third pulse at homogeneous mode" UWORD _CNV_A_R_LINEAR_____111_CM 1 100. 0. 1389. DISPLAY_IDENTIFIER MFF_SP_3_HOM[5] ECU_ADDRESS 0xd00069be FORMAT "%7.2" /end MEASUREMENT
/begin MEASUREMENT mff_sp_3_hom[6] "Fuel mass setpoint for the third pulse at homogeneous mode" UWORD _CNV_A_R_LINEAR_____111_CM 1 100. 0. 1389. DISPLAY_IDENTIFIER MFF_SP_3_HOM[6] ECU_ADDRESS 0xd00069c0 FORMAT "%7.2" /end MEASUREMENT
/begin MEASUREMENT mff_sp_3_hom[7] "Fuel mass setpoint for the third pulse at homogeneous mode" UWORD _CNV_A_R_LINEAR_____111_CM 1 100. 0. 1389. DISPLAY_IDENTIFIER MFF_SP_3_HOM[7] ECU_ADDRESS 0xd00069c2 FORMAT "%7.2" /end MEASUREMENT
/begin CHARACTERISTIC c_mff_sp_3_hom_man "Fuel mass setpoint for the third pulse in homogeneous mode (manual adjustment)" VALUE 0xa080bea2 _REC_VAL_20_u2 1389. _CNV_A_R_LINEAR_____111_CM 0. 1389. DISPLAY_IDENTIFIER C_MFF_SP_3_HOM_MAN FORMAT "%7.2" /end CHARACTERISTIC
/begin MEASUREMENT inj_mod_hom_req "injection mode selection hom(single/multi)" UBYTE _CNV_A_R_LINEAR_____0_CM 1 100. 0. 255. DISPLAY_IDENTIFIER INJ_MOD_HOM_REQ ECU_ADDRESS 0xd000760c FORMAT "%3.0" /end MEASUREMENT
/begin MEASUREMENT nr_inj_pls_hom_req "Number of requested injection pulses for homogeneous mode" UBYTE _CNV_A_R_LINEAR_____0_CM 1 100. 0. 3. DISPLAY_IDENTIFIER NR_INJ_PLS_HOM_REQ ECU_ADDRESS 0xd000760e FORMAT "%1.0" /end MEASUREMENT
/begin MEASUREMENT mff_sp_2_homs[0] "Fuel mass setpoint for the second pulse at homogeneous-stratified mode" UWORD _CNV_A_R_LINEAR_____111_CM 1 100. 0. 1389. DISPLAY_IDENTIFIER MFF_SP_2_HOMS[0] ECU_ADDRESS 0xd0006994 FORMAT "%7.2" /end MEASUREMENT
/begin MEASUREMENT mff_sp_2_homs[1] "Fuel mass setpoint for the second pulse at homogeneous-stratified mode" UWORD _CNV_A_R_LINEAR_____111_CM 1 100. 0. 1389. DISPLAY_IDENTIFIER MFF_SP_2_HOMS[1] ECU_ADDRESS 0xd0006996 FORMAT "%7.2" /end MEASUREMENT
/begin MEASUREMENT mff_sp_2_homs[2] "Fuel mass setpoint for the second pulse at homogeneous-stratified mode" UWORD _CNV_A_R_LINEAR_____111_CM 1 100. 0. 1389. DISPLAY_IDENTIFIER MFF_SP_2_HOMS[2] ECU_ADDRESS 0xd0006998 FORMAT "%7.2" /end MEASUREMENT
/begin MEASUREMENT mff_sp_2_homs[3] "Fuel mass setpoint for the second pulse at homogeneous-stratified mode" UWORD _CNV_A_R_LINEAR_____111_CM 1 100. 0. 1389. DISPLAY_IDENTIFIER MFF_SP_2_HOMS[3] ECU_ADDRESS 0xd000699a FORMAT "%7.2" /end MEASUREMENT
/begin MEASUREMENT mff_sp_2_homs[4] "Fuel mass setpoint for the second pulse at homogeneous-stratified mode" UWORD _CNV_A_R_LINEAR_____111_CM 1 100. 0. 1389. DISPLAY_IDENTIFIER MFF_SP_2_HOMS[4] ECU_ADDRESS 0xd000699c FORMAT "%7.2" /end MEASUREMENT
/begin MEASUREMENT mff_sp_2_homs[5] "Fuel mass setpoint for the second pulse at homogeneous-stratified mode" UWORD _CNV_A_R_LINEAR_____111_CM 1 100. 0. 1389. DISPLAY_IDENTIFIER MFF_SP_2_HOMS[5] ECU_ADDRESS 0xd000699e FORMAT "%7.2" /end MEASUREMENT
/begin MEASUREMENT mff_sp_2_homs[6] "Fuel mass setpoint for the second pulse at homogeneous-stratified mode" UWORD _CNV_A_R_LINEAR_____111_CM 1 100. 0. 1389. DISPLAY_IDENTIFIER MFF_SP_2_HOMS[6] ECU_ADDRESS 0xd00069a0 FORMAT "%7.2" /end MEASUREMENT
/begin MEASUREMENT mff_sp_2_homs[7] "Fuel mass setpoint for the second pulse at homogeneous-stratified mode" UWORD _CNV_A_R_LINEAR_____111_CM 1 100. 0. 1389. DISPLAY_IDENTIFIER MFF_SP_2_HOMS[7] ECU_ADDRESS 0xd00069a2 FORMAT "%7.2" /end MEASUREMENT
/begin MEASUREMENT fac_1_hom_cor[0] "MFF additive correction on 1st. injection pulse (homogeneous modus)" UWORD _CNV_A_R_LINEAR_____89_CM 1 100. 0. 0.9999847412109381 DISPLAY_IDENTIFIER FAC_1_HOM_COR[0] ECU_ADDRESS 0xd00068f0 FORMAT "%7.5" /end MEASUREMENT
/begin MEASUREMENT fac_1_hom_cor[1] "MFF additive correction on 1st. injection pulse (homogeneous modus)" UWORD _CNV_A_R_LINEAR_____89_CM 1 100. 0. 0.9999847412109381 DISPLAY_IDENTIFIER FAC_1_HOM_COR[1] ECU_ADDRESS 0xd00068f2 FORMAT "%7.5" /end MEASUREMENT
/begin MEASUREMENT fac_1_hom_cor[2] "MFF additive correction on 1st. injection pulse (homogeneous modus)" UWORD _CNV_A_R_LINEAR_____89_CM 1 100. 0. 0.9999847412109381 DISPLAY_IDENTIFIER FAC_1_HOM_COR[2] ECU_ADDRESS 0xd00068f4 FORMAT "%7.5" /end MEASUREMENT
/begin MEASUREMENT fac_1_hom_cor[3] "MFF additive correction on 1st. injection pulse (homogeneous modus)" UWORD _CNV_A_R_LINEAR_____89_CM 1 100. 0. 0.9999847412109381 DISPLAY_IDENTIFIER FAC_1_HOM_COR[3] ECU_ADDRESS 0xd00068f6 FORMAT "%7.5" /end MEASUREMENT
/begin MEASUREMENT fac_1_hom_cor[4] "MFF additive correction on 1st. injection pulse (homogeneous modus)" UWORD _CNV_A_R_LINEAR_____89_CM 1 100. 0. 0.9999847412109381 DISPLAY_IDENTIFIER FAC_1_HOM_COR[4] ECU_ADDRESS 0xd00068f8 FORMAT "%7.5" /end MEASUREMENT
/begin MEASUREMENT fac_1_hom_cor[5] "MFF additive correction on 1st. injection pulse (homogeneous modus)" UWORD _CNV_A_R_LINEAR_____89_CM 1 100. 0. 0.9999847412109381 DISPLAY_IDENTIFIER FAC_1_HOM_COR[5] ECU_ADDRESS 0xd00068fa FORMAT "%7.5" /end MEASUREMENT
/begin MEASUREMENT fac_1_hom_cor[6] "MFF additive correction on 1st. injection pulse (homogeneous modus)" UWORD _CNV_A_R_LINEAR_____89_CM 1 100. 0. 0.9999847412109381 DISPLAY_IDENTIFIER FAC_1_HOM_COR[6] ECU_ADDRESS 0xd00068fc FORMAT "%7.5" /end MEASUREMENT
/begin MEASUREMENT fac_1_hom_cor[7] "MFF additive correction on 1st. injection pulse (homogeneous modus)" UWORD _CNV_A_R_LINEAR_____89_CM 1 100. 0. 0.9999847412109381 DISPLAY_IDENTIFIER FAC_1_HOM_COR[7] ECU_ADDRESS 0xd00068fe FORMAT "%7.5" /end MEASUREMENT
/begin MEASUREMENT fac_2_hom_cor[0] "MFF additive correction on 2nd. injection pulse (homogeneous modus)" UWORD _CNV_A_R_LINEAR_____89_CM 1 100. 0. 0.9999847412109381 DISPLAY_IDENTIFIER FAC_2_HOM_COR[0] ECU_ADDRESS 0xd0006910 FORMAT "%7.5" /end MEASUREMENT
/begin MEASUREMENT fac_2_hom_cor[1] "MFF additive correction on 2nd. injection pulse (homogeneous modus)" UWORD _CNV_A_R_LINEAR_____89_CM 1 100. 0. 0.9999847412109381 DISPLAY_IDENTIFIER FAC_2_HOM_COR[1] ECU_ADDRESS 0xd0006912 FORMAT "%7.5" /end MEASUREMENT
/begin MEASUREMENT fac_2_hom_cor[2] "MFF additive correction on 2nd. injection pulse (homogeneous modus)" UWORD _CNV_A_R_LINEAR_____89_CM 1 100. 0. 0.9999847412109381 DISPLAY_IDENTIFIER FAC_2_HOM_COR[2] ECU_ADDRESS 0xd0006914 FORMAT "%7.5" /end MEASUREMENT
/begin MEASUREMENT fac_2_hom_cor[3] "MFF additive correction on 2nd. injection pulse (homogeneous modus)" UWORD _CNV_A_R_LINEAR_____89_CM 1 100. 0. 0.9999847412109381 DISPLAY_IDENTIFIER FAC_2_HOM_COR[3] ECU_ADDRESS 0xd0006916 FORMAT "%7.5" /end MEASUREMENT
/begin MEASUREMENT fac_2_hom_cor[4] "MFF additive correction on 2nd. injection pulse (homogeneous modus)" UWORD _CNV_A_R_LINEAR_____89_CM 1 100. 0. 0.9999847412109381 DISPLAY_IDENTIFIER FAC_2_HOM_COR[4] ECU_ADDRESS 0xd0006918 FORMAT "%7.5" /end MEASUREMENT
/begin MEASUREMENT fac_2_hom_cor[5] "MFF additive correction on 2nd. injection pulse (homogeneous modus)" UWORD _CNV_A_R_LINEAR_____89_CM 1 100. 0. 0.9999847412109381 DISPLAY_IDENTIFIER FAC_2_HOM_COR[5] ECU_ADDRESS 0xd000691a FORMAT "%7.5" /end MEASUREMENT
/begin MEASUREMENT fac_2_hom_cor[6] "MFF additive correction on 2nd. injection pulse (homogeneous modus)" UWORD _CNV_A_R_LINEAR_____89_CM 1 100. 0. 0.9999847412109381 DISPLAY_IDENTIFIER FAC_2_HOM_COR[6] ECU_ADDRESS 0xd000691c FORMAT "%7.5" /end MEASUREMENT
/begin MEASUREMENT fac_2_hom_cor[7] "MFF additive correction on 2nd. injection pulse (homogeneous modus)" UWORD _CNV_A_R_LINEAR_____89_CM 1 100. 0. 0.9999847412109381 DISPLAY_IDENTIFIER FAC_2_HOM_COR[7] ECU_ADDRESS 0xd000691e FORMAT "%7.5" /end MEASUREMENT
/begin MEASUREMENT fac_3_hom_cor[0] "MFF additive correction on 3rd. injection pulse (homogeneous modus)" UWORD _CNV_A_R_LINEAR_____89_CM 1 100. 0. 0.9999847412109381 DISPLAY_IDENTIFIER FAC_3_HOM_COR[0] ECU_ADDRESS 0xd0006930 FORMAT "%7.5" /end MEASUREMENT
/begin MEASUREMENT fac_3_hom_cor[1] "MFF additive correction on 3rd. injection pulse (homogeneous modus)" UWORD _CNV_A_R_LINEAR_____89_CM 1 100. 0. 0.9999847412109381 DISPLAY_IDENTIFIER FAC_3_HOM_COR[1] ECU_ADDRESS 0xd0006932 FORMAT "%7.5" /end MEASUREMENT
/begin MEASUREMENT fac_3_hom_cor[2] "MFF additive correction on 3rd. injection pulse (homogeneous modus)" UWORD _CNV_A_R_LINEAR_____89_CM 1 100. 0. 0.9999847412109381 DISPLAY_IDENTIFIER FAC_3_HOM_COR[2] ECU_ADDRESS 0xd0006934 FORMAT "%7.5" /end MEASUREMENT
/begin MEASUREMENT fac_3_hom_cor[3] "MFF additive correction on 3rd. injection pulse (homogeneous modus)" UWORD _CNV_A_R_LINEAR_____89_CM 1 100. 0. 0.9999847412109381 DISPLAY_IDENTIFIER FAC_3_HOM_COR[3] ECU_ADDRESS 0xd0006936 FORMAT "%7.5" /end MEASUREMENT
/begin MEASUREMENT fac_3_hom_cor[4] "MFF additive correction on 3rd. injection pulse (homogeneous modus)" UWORD _CNV_A_R_LINEAR_____89_CM 1 100. 0. 0.9999847412109381 DISPLAY_IDENTIFIER FAC_3_HOM_COR[4] ECU_ADDRESS 0xd0006938 FORMAT "%7.5" /end MEASUREMENT
/begin MEASUREMENT fac_3_hom_cor[5] "MFF additive correction on 3rd. injection pulse (homogeneous modus)" UWORD _CNV_A_R_LINEAR_____89_CM 1 100. 0. 0.9999847412109381 DISPLAY_IDENTIFIER FAC_3_HOM_COR[5] ECU_ADDRESS 0xd000693a FORMAT "%7.5" /end MEASUREMENT
/begin MEASUREMENT fac_3_hom_cor[6] "MFF additive correction on 3rd. injection pulse (homogeneous modus)" UWORD _CNV_A_R_LINEAR_____89_CM 1 100. 0. 0.9999847412109381 DISPLAY_IDENTIFIER FAC_3_HOM_COR[6] ECU_ADDRESS 0xd000693c FORMAT "%7.5" /end MEASUREMENT
/begin MEASUREMENT fac_3_hom_cor[7] "MFF additive correction on 3rd. injection pulse (homogeneous modus)" UWORD _CNV_A_R_LINEAR_____89_CM 1 100. 0. 0.9999847412109381 DISPLAY_IDENTIFIER FAC_3_HOM_COR[7] ECU_ADDRESS 0xd000693e FORMAT "%7.5" /end MEASUREMENT
/begin MEASUREMENT fac_1_s_cor[0] "MFF additive correction on 1st. injection pulse (stratified modus)" UWORD _CNV_A_R_LINEAR_____89_CM 1 100. 0. 0.9999847412109381 DISPLAY_IDENTIFIER FAC_1_S_COR[0] ECU_ADDRESS 0xd0006900 FORMAT "%7.5" /end MEASUREMENT
/begin MEASUREMENT fac_1_s_cor[1] "MFF additive correction on 1st. injection pulse (stratified modus)" UWORD _CNV_A_R_LINEAR_____89_CM 1 100. 0. 0.9999847412109381 DISPLAY_IDENTIFIER FAC_1_S_COR[1] ECU_ADDRESS 0xd0006902 FORMAT "%7.5" /end MEASUREMENT
/begin MEASUREMENT fac_1_s_cor[2] "MFF additive correction on 1st. injection pulse (stratified modus)" UWORD _CNV_A_R_LINEAR_____89_CM 1 100. 0. 0.9999847412109381 DISPLAY_IDENTIFIER FAC_1_S_COR[2] ECU_ADDRESS 0xd0006904 FORMAT "%7.5" /end MEASUREMENT
/begin MEASUREMENT fac_1_s_cor[3] "MFF additive correction on 1st. injection pulse (stratified modus)" UWORD _CNV_A_R_LINEAR_____89_CM 1 100. 0. 0.9999847412109381 DISPLAY_IDENTIFIER FAC_1_S_COR[3] ECU_ADDRESS 0xd0006906 FORMAT "%7.5" /end MEASUREMENT
/begin MEASUREMENT fac_1_s_cor[4] "MFF additive correction on 1st. injection pulse (stratified modus)" UWORD _CNV_A_R_LINEAR_____89_CM 1 100. 0. 0.9999847412109381 DISPLAY_IDENTIFIER FAC_1_S_COR[4] ECU_ADDRESS 0xd0006908 FORMAT "%7.5" /end MEASUREMENT
/begin MEASUREMENT fac_1_s_cor[5] "MFF additive correction on 1st. injection pulse (stratified modus)" UWORD _CNV_A_R_LINEAR_____89_CM 1 100. 0. 0.9999847412109381 DISPLAY_IDENTIFIER FAC_1_S_COR[5] ECU_ADDRESS 0xd000690a FORMAT "%7.5" /end MEASUREMENT
/begin MEASUREMENT fac_1_s_cor[6] "MFF additive correction on 1st. injection pulse (stratified modus)" UWORD _CNV_A_R_LINEAR_____89_CM 1 100. 0. 0.9999847412109381 DISPLAY_IDENTIFIER FAC_1_S_COR[6] ECU_ADDRESS 0xd000690c FORMAT "%7.5" /end MEASUREMENT
/begin MEASUREMENT fac_1_s_cor[7] "MFF additive correction on 1st. injection pulse (stratified modus)" UWORD _CNV_A_R_LINEAR_____89_CM 1 100. 0. 0.9999847412109381 DISPLAY_IDENTIFIER FAC_1_S_COR[7] ECU_ADDRESS 0xd000690e FORMAT "%7.5" /end MEASUREMENT
/begin MEASUREMENT fac_2_s_cor[0] "MFF additive correction on 2nd. injection pulse (stratified modus)" UWORD _CNV_A_R_LINEAR_____89_CM 1 100. 0. 0.9999847412109381 DISPLAY_IDENTIFIER FAC_2_S_COR[0] ECU_ADDRESS 0xd0006920 FORMAT "%7.5" /end MEASUREMENT
/begin MEASUREMENT fac_2_s_cor[1] "MFF additive correction on 2nd. injection pulse (stratified modus)" UWORD _CNV_A_R_LINEAR_____89_CM 1 100. 0. 0.9999847412109381 DISPLAY_IDENTIFIER FAC_2_S_COR[1] ECU_ADDRESS 0xd0006922 FORMAT "%7.5" /end MEASUREMENT
/begin MEASUREMENT fac_2_s_cor[2] "MFF additive correction on 2nd. injection pulse (stratified modus)" UWORD _CNV_A_R_LINEAR_____89_CM 1 100. 0. 0.9999847412109381 DISPLAY_IDENTIFIER FAC_2_S_COR[2] ECU_ADDRESS 0xd0006924 FORMAT "%7.5" /end MEASUREMENT
/begin MEASUREMENT fac_2_s_cor[3] "MFF additive correction on 2nd. injection pulse (stratified modus)" UWORD _CNV_A_R_LINEAR_____89_CM 1 100. 0. 0.9999847412109381 DISPLAY_IDENTIFIER FAC_2_S_COR[3] ECU_ADDRESS 0xd0006926 FORMAT "%7.5" /end MEASUREMENT
/begin MEASUREMENT fac_2_s_cor[4] "MFF additive correction on 2nd. injection pulse (stratified modus)" UWORD _CNV_A_R_LINEAR_____89_CM 1 100. 0. 0.9999847412109381 DISPLAY_IDENTIFIER FAC_2_S_COR[4] ECU_ADDRESS 0xd0006928 FORMAT "%7.5" /end MEASUREMENT
/begin MEASUREMENT fac_2_s_cor[5] "MFF additive correction on 2nd. injection pulse (stratified modus)" UWORD _CNV_A_R_LINEAR_____89_CM 1 100. 0. 0.9999847412109381 DISPLAY_IDENTIFIER FAC_2_S_COR[5] ECU_ADDRESS 0xd000692a FORMAT "%7.5" /end MEASUREMENT
/begin MEASUREMENT fac_2_s_cor[6] "MFF additive correction on 2nd. injection pulse (stratified modus)" UWORD _CNV_A_R_LINEAR_____89_CM 1 100. 0. 0.9999847412109381 DISPLAY_IDENTIFIER FAC_2_S_COR[6] ECU_ADDRESS 0xd000692c FORMAT "%7.5" /end MEASUREMENT
/begin MEASUREMENT fac_2_s_cor[7] "MFF additive correction on 2nd. injection pulse (stratified modus)" UWORD _CNV_A_R_LINEAR_____89_CM 1 100. 0. 0.9999847412109381 DISPLAY_IDENTIFIER FAC_2_S_COR[7] ECU_ADDRESS 0xd000692e FORMAT "%7.5" /end MEASUREMENT
/begin MEASUREMENT fac_3_s_cor[0] "MFF additive correction on 3rd. injection pulse (stratified modus)" UWORD _CNV_A_R_LINEAR_____89_CM 1 100. 0. 0.9999847412109381 DISPLAY_IDENTIFIER FAC_3_S_COR[0] ECU_ADDRESS 0xd0006940 FORMAT "%7.5" /end MEASUREMENT
/begin MEASUREMENT fac_3_s_cor[1] "MFF additive correction on 3rd. injection pulse (stratified modus)" UWORD _CNV_A_R_LINEAR_____89_CM 1 100. 0. 0.9999847412109381 DISPLAY_IDENTIFIER FAC_3_S_COR[1] ECU_ADDRESS 0xd0006942 FORMAT "%7.5" /end MEASUREMENT
/begin MEASUREMENT fac_3_s_cor[2] "MFF additive correction on 3rd. injection pulse (stratified modus)" UWORD _CNV_A_R_LINEAR_____89_CM 1 100. 0. 0.9999847412109381 DISPLAY_IDENTIFIER FAC_3_S_COR[2] ECU_ADDRESS 0xd0006944 FORMAT "%7.5" /end MEASUREMENT
/begin MEASUREMENT fac_3_s_cor[3] "MFF additive correction on 3rd. injection pulse (stratified modus)" UWORD _CNV_A_R_LINEAR_____89_CM 1 100. 0. 0.9999847412109381 DISPLAY_IDENTIFIER FAC_3_S_COR[3] ECU_ADDRESS 0xd0006946 FORMAT "%7.5" /end MEASUREMENT
/begin MEASUREMENT fac_3_s_cor[4] "MFF additive correction on 3rd. injection pulse (stratified modus)" UWORD _CNV_A_R_LINEAR_____89_CM 1 100. 0. 0.9999847412109381 DISPLAY_IDENTIFIER FAC_3_S_COR[4] ECU_ADDRESS 0xd0006948 FORMAT "%7.5" /end MEASUREMENT
/begin MEASUREMENT fac_3_s_cor[5] "MFF additive correction on 3rd. injection pulse (stratified modus)" UWORD _CNV_A_R_LINEAR_____89_CM 1 100. 0. 0.9999847412109381 DISPLAY_IDENTIFIER FAC_3_S_COR[5] ECU_ADDRESS 0xd000694a FORMAT "%7.5" /end MEASUREMENT
/begin MEASUREMENT fac_3_s_cor[6] "MFF additive correction on 3rd. injection pulse (stratified modus)" UWORD _CNV_A_R_LINEAR_____89_CM 1 100. 0. 0.9999847412109381 DISPLAY_IDENTIFIER FAC_3_S_COR[6] ECU_ADDRESS 0xd000694c FORMAT "%7.5" /end MEASUREMENT
/begin MEASUREMENT fac_3_s_cor[7] "MFF additive correction on 3rd. injection pulse (stratified modus)" UWORD _CNV_A_R_LINEAR_____89_CM 1 100. 0. 0.9999847412109381 DISPLAY_IDENTIFIER FAC_3_S_COR[7] ECU_ADDRESS 0xd000694e FORMAT "%7.5" /end MEASUREMENT
/begin MEASUREMENT mff_sp_hom_bas[0] "Mass fuel flow setpoint for homogeneous mode (exhaust gas bank specific) " UWORD _CNV_A_R_LINEAR_____111_CM 1 100. 0. 1389. DISPLAY_IDENTIFIER MFF_SP_HOM_BAS[1] ECU_ADDRESS 0xd00069d4 FORMAT "%7.2" /end MEASUREMENT
/begin MEASUREMENT mff_sp_hom_bas[1] "Mass fuel flow setpoint for homogeneous mode (exhaust gas bank specific) " UWORD _CNV_A_R_LINEAR_____111_CM 1 100. 0. 1389. DISPLAY_IDENTIFIER MFF_SP_HOM_BAS[2] ECU_ADDRESS 0xd00069d6 FORMAT "%7.2" /end MEASUREMENT
/begin MEASUREMENT fac_mff_wup_homs "Mass fuel flow correction during homogeneous lean warm-up phase" UBYTE _CNV_A_R_LINEAR_____103_CM 1 100. 0. 1.9921875 DISPLAY_IDENTIFIER FAC_MFF_WUP_HOMS ECU_ADDRESS 0xd0007607 FORMAT "%5.3" /end MEASUREMENT
/begin MEASUREMENT fac_mff_wup_s "Mass fuel flow correction stratified warm-up phase" UBYTE _CNV_A_R_LINEAR_____103_CM 1 100. 0. 1.9921875 DISPLAY_IDENTIFIER FAC_MFF_WUP_S ECU_ADDRESS 0xd0007608 FORMAT "%5.3" /end MEASUREMENT
/begin MEASUREMENT mff_add_wf "Total fuel amount for wall film compensation" SWORD _CNV_A_R_LINEAR_____202_CM 1 100. -694.5 694.478806 DISPLAY_IDENTIFIER MFF_ADD_WF ECU_ADDRESS 0xd0006950 FORMAT "%7.2" /end MEASUREMENT
/begin MEASUREMENT injr.STR_INJR_ISPCLEGYIV0.fac_mff_dif_hom[0] "MFF-difference factor - homogenous operation" UWORD _CNV_A_R_INJR_LINEA_465_CM 1 100. -1. 0.99996948 DISPLAY_IDENTIFIER FAC_MFF_DIF_HOM[0] ECU_ADDRESS 0xd0006e3c FORMAT "%8.5" /end MEASUREMENT
/begin MEASUREMENT injr.STR_INJR_ISPCLEGYIV0.fac_mff_dif_hom[1] "MFF-difference factor - homogenous operation" UWORD _CNV_A_R_INJR_LINEA_465_CM 1 100. -1. 0.99996948 DISPLAY_IDENTIFIER FAC_MFF_DIF_HOM[1] ECU_ADDRESS 0xd0006e3e FORMAT "%8.5" /end MEASUREMENT
/begin MEASUREMENT injr.STR_INJR_ISPCLEGYIV0.fac_mff_dif_hom[2] "MFF-difference factor - homogenous operation" UWORD _CNV_A_R_INJR_LINEA_465_CM 1 100. -1. 0.99996948 DISPLAY_IDENTIFIER FAC_MFF_DIF_HOM[2] ECU_ADDRESS 0xd0006e40 FORMAT "%8.5" /end MEASUREMENT
/begin MEASUREMENT injr.STR_INJR_ISPCLEGYIV0.fac_mff_dif_hom[3] "MFF-difference factor - homogenous operation" UWORD _CNV_A_R_INJR_LINEA_465_CM 1 100. -1. 0.99996948 DISPLAY_IDENTIFIER FAC_MFF_DIF_HOM[3] ECU_ADDRESS 0xd0006e42 FORMAT "%8.5" /end MEASUREMENT
/begin MEASUREMENT injr.STR_INJR_ISPCLEGYIV0.fac_mff_dif_hom[4] "MFF-difference factor - homogenous operation" UWORD _CNV_A_R_INJR_LINEA_465_CM 1 100. -1. 0.99996948 DISPLAY_IDENTIFIER FAC_MFF_DIF_HOM[4] ECU_ADDRESS 0xd0006e44 FORMAT "%8.5" /end MEASUREMENT
/begin MEASUREMENT injr.STR_INJR_ISPCLEGYIV0.fac_mff_dif_hom[5] "MFF-difference factor - homogenous operation" UWORD _CNV_A_R_INJR_LINEA_465_CM 1 100. -1. 0.99996948 DISPLAY_IDENTIFIER FAC_MFF_DIF_HOM[5] ECU_ADDRESS 0xd0006e46 FORMAT "%8.5" /end MEASUREMENT
/begin MEASUREMENT injr.STR_INJR_ISPCLEGYIV0.fac_mff_dif_hom[6] "MFF-difference factor - homogenous operation" UWORD _CNV_A_R_INJR_LINEA_465_CM 1 100. -1. 0.99996948 DISPLAY_IDENTIFIER FAC_MFF_DIF_HOM[6] ECU_ADDRESS 0xd0006e48 FORMAT "%8.5" /end MEASUREMENT
/begin MEASUREMENT injr.STR_INJR_ISPCLEGYIV0.fac_mff_dif_hom[7] "MFF-difference factor - homogenous operation" UWORD _CNV_A_R_INJR_LINEA_465_CM 1 100. -1. 0.99996948 DISPLAY_IDENTIFIER FAC_MFF_DIF_HOM[7] ECU_ADDRESS 0xd0006e4a FORMAT "%8.5" /end MEASUREMENT
/begin AXIS_PTS ldp_amp_ip_load_clc_amp "" 0xa08028dc amp _REC_AXS_20_u2 5434. _CNV_A_R_LINEAR_____27_CM 6 0. 5434. FORMAT "%7.2" /end AXIS_PTS
/begin AXIS_PTS ldp_n_32_ip_load_clc "" 0xa080290c n_32 _REC_AXS_20_u1 8160. _CNV_A_R_LINEAR_____10_CM 8 0. 8160. FORMAT "%4.0" /end AXIS_PTS
/begin AXIS_PTS ldp_maf_ip_load_clc "" 0xa08028f8 maf _REC_AXS_20_u2 1389. _CNV_A_R_LINEAR_____111_CM 8 0. 1389. FORMAT "%7.2" /end AXIS_PTS
/begin MEASUREMENT lv_inh_dc_rbm "" UBYTE _CNV_S_2_RANGE__0___1_CM 1 100. 0. 1. DISPLAY_IDENTIFIER LV_INH_DC_RBM ECU_ADDRESS 0xd000812e BIT_MASK 0x1 /end MEASUREMENT
/begin MEASUREMENT lv_cdn_cst_rbm "Cold start conditions for individual denominator calculation" UBYTE _CNV_S_2_RANGE__0___1_CM 1 100. 0. 1. DISPLAY_IDENTIFIER LV_CDN_CST_RBM ECU_ADDRESS 0xd000812d BIT_MASK 0x1 /end MEASUREMENT
/begin AXIS_PTS ldpm_tco__n_stall "" 0xa08097b8 tco _REC_AXS_20_u1 190.5 _CNV_A_R_LINEAR_____17_CM 9 -48. 142.5 FORMAT "%5.1" /end AXIS_PTS
/begin AXIS_PTS ldp_n_32__iga_egr_s "" 0xa0808996 n_32 _REC_AXS_20_u1 8160. _CNV_A_R_LINEAR_____10_CM 5 0. 8160. FORMAT "%4.0" /end AXIS_PTS
/begin AXIS_PTS ldp_mff_sp_s__egr_iga "" 0xa0808980 mff_sp_s _REC_AXS_20_u2 1389. _CNV_A_R_LINEAR_____111_CM 5 0. 1389. FORMAT "%7.2" /end AXIS_PTS
/begin AXIS_PTS ldp_egr_ratio_cor_2__iga_bas "" 0xa08085c8 egr_ratio_cor_2 _REC_AXS_20_u2 99.99847412109381 _CNV_A_R_LINEAR_____480_CM 6 0. 99.99847412109381 /end AXIS_PTS
/begin AXIS_PTS ldpm_tco__iga_egr "" 0xa08097a0 tco _REC_AXS_20_u1 190.5 _CNV_A_R_LINEAR_____17_CM 8 -48. 142.5 FORMAT "%5.1" /end AXIS_PTS
/begin AXIS_PTS ldpm_n_32_ip_egr_ratio "" 0xa0809628 n_32 _REC_AXS_20_u1 8160. _CNV_A_R_LINEAR_____10_CM 12 0. 8160. FORMAT "%4.0" /end AXIS_PTS
/begin AXIS_PTS ldpm_maf_ip_egr_ratio "" 0xa08094f8 maf _REC_AXS_20_u2 1389. _CNV_A_R_LINEAR_____111_CM 12 0. 1389. FORMAT "%7.2" /end AXIS_PTS
/begin MEASUREMENT lv_swi_aeb "switch to control the active engine brackets" UBYTE _CNV_S_2_RANGE__0___1_CM 1 100. 0. 1. DISPLAY_IDENTIFIER LV_SWI_AEB ECU_ADDRESS 0xd0008d00 BIT_MASK 0x1 /end MEASUREMENT
/begin MEASUREMENT lv_err_ns_obd_1_1 "OBD I failure for NOx sensor 1." UBYTE _CNV_S_2_RANGE__0___1_CM 1 100. 0. 1. DISPLAY_IDENTIFIER LV_ERR_NS_OBD_1[1] ECU_ADDRESS 0xd0007fd1 BIT_MASK 0x1 /end MEASUREMENT
/begin MEASUREMENT lv_err_ns_obd_1_2 "OBD I failure for NOx sensor 2." UBYTE _CNV_S_2_RANGE__0___1_CM 1 100. 0. 1. DISPLAY_IDENTIFIER LV_ERR_NS_OBD_1[2] ECU_ADDRESS 0xd0007fd2 BIT_MASK 0x1 /end MEASUREMENT
/begin CHARACTERISTIC c_abc_inc_ns_obd_1 "Anti-bounce counter increment of NOx-Sensor OBD I diagnosis" VALUE 0xa0807a1c _REC_VAL_20_u1 255. _CNV_A_R_LINEAR_____0_CM 0. 255. DISPLAY_IDENTIFIER C_ABC_INC_NS_OBD_1 FORMAT "%3.0" /end CHARACTERISTIC
/begin CHARACTERISTIC c_abc_max_ns_obd_1 "Maximum value of the anti-bounce counter for NOx-Sensor OBD I diagnosis" VALUE 0xa0807a1d _REC_VAL_20_u1 254. _CNV_A_R_LINEAR_____0_CM 1. 255. DISPLAY_IDENTIFIER C_ABC_MAX_NS_OBD_1 FORMAT "%3.0" /end CHARACTERISTIC
/begin MEASUREMENT lv_inh_nt_act "flag inhibiting the NOx catalyst management" UBYTE _CNV_S_2_RANGE__0___1_CM 1 100. 0. 1. DISPLAY_IDENTIFIER LV_INH_NT_ACT ECU_ADDRESS 0xd0008949 BIT_MASK 0x1 /end MEASUREMENT
/begin MEASUREMENT lv_inh_rgn_req "flag inhibiting the request of a NOx catalyst regeneration" UBYTE _CNV_S_2_RANGE__0___1_CM 1 100. 0. 1. DISPLAY_IDENTIFIER LV_INH_RGN_REQ ECU_ADDRESS 0xd000894b BIT_MASK 0x1 /end MEASUREMENT
/begin MEASUREMENT lv_inh_nt_afl "flag inhibiting lean operation (requests air/fuel stoichiometric)" UBYTE _CNV_S_2_RANGE__0___1_CM 1 100. 0. 1. DISPLAY_IDENTIFIER LV_INH_NT_AFL ECU_ADDRESS 0xd000894c BIT_MASK 0x1 /end MEASUREMENT
/begin MEASUREMENT lv_inh_nt_prj_act "flag inhibiting the NOx catalyst auxiliary functionalities (complete)" UBYTE _CNV_S_2_RANGE__0___1_CM 1 100. 0. 1. DISPLAY_IDENTIFIER LV_INH_NT_PRJ_ACT ECU_ADDRESS 0xd0008950 BIT_MASK 0x1 /end MEASUREMENT
/begin MEASUREMENT lv_inh_nt_stc_max "flag inhibiting the full saturation" UBYTE _CNV_S_2_RANGE__0___1_CM 1 100. 0. 1. DISPLAY_IDENTIFIER LV_INH_NT_STC_MAX ECU_ADDRESS 0xd0008951 BIT_MASK 0x1 /end MEASUREMENT
/begin MEASUREMENT lv_inh_nt_o2_stc "Flag for inhibition of oxygen storage capacity adaptation" UBYTE _CNV_S_2_RANGE__0___1_CM 1 100. 0. 1. DISPLAY_IDENTIFIER LV_INH_NT_O2_STC ECU_ADDRESS 0xd0008952 BIT_MASK 0x1 /end MEASUREMENT
/begin MEASUREMENT lv_inh_rgn_req_ntld "flah inhibiting the request of a NOx catalyst regeneration due to high loading degree" UBYTE _CNV_S_2_RANGE__0___1_CM 1 100. 0. 1. DISPLAY_IDENTIFIER LV_INH_RGN_REQ_NTLD ECU_ADDRESS 0xd000894f BIT_MASK 0x1 /end MEASUREMENT
/begin MEASUREMENT lv_inh_rgn_req_nox_sens "Inhibition flag for NOx catalyst regeneration request by NOx sensor readiness" UBYTE _CNV_S_2_RANGE__0___1_CM 1 100. 0. 1. DISPLAY_IDENTIFIER LV_INH_RGN_REQ_NOX_SENS ECU_ADDRESS 0xd000894d BIT_MASK 0x1 /end MEASUREMENT
/begin MEASUREMENT lv_adj_nox_sens_rgn "Exclusively regeneration by NOx sensor is allowed(=0)" UBYTE _CNV_S_2_RANGE__0___1_CM 1 100. 0. 1. DISPLAY_IDENTIFIER LV_ADJ_NOX_SENS_RGN ECU_ADDRESS 0xd0008954 BIT_MASK 0x1 /end MEASUREMENT
/begin MEASUREMENT state_rgn_req "State of regenration request" UBYTE _CNV_S_4_STATE_RGN__483_CM 1 100. 0. 3. DISPLAY_IDENTIFIER STATE_RGN_REQ ECU_ADDRESS 0xd0001531 /end MEASUREMENT
/begin MEASUREMENT lv_ntld_adj "Flag to activate NOx catalyst loading degree threshold for regeneration without NOx sensor readiness" UBYTE _CNV_S_2_RANGE__0___1_CM 1 100. 0. 1. DISPLAY_IDENTIFIER LV_NTLD_ADJ ECU_ADDRESS 0xd0008955 BIT_MASK 0x1 /end MEASUREMENT
/begin MEASUREMENT lv_tnt_mdl_max_ofs "Catalyst cooling function activation flag" UBYTE _CNV_S_2_RANGE__0___1_CM 1 100. 0. 1. DISPLAY_IDENTIFIER LV_TNT_MDL_MAX_OFS ECU_ADDRESS 0xd0008953 BIT_MASK 0x1 /end MEASUREMENT
/begin MEASUREMENT tnt_mdl_max_ofs "Nox catalyst temperature offset to enable catalyst cooling at standing car" SBYTE _CNV_A_R_LINEAR_____481_CM 1 100. -512. 508. DISPLAY_IDENTIFIER TNT_MDL_MAX_OFS ECU_ADDRESS 0xd0008948 FORMAT "%4.2" /end MEASUREMENT
/begin MEASUREMENT t_vs_is_nt "Catalyst cooling function activation timer" UBYTE _CNV_A_R_LINEAR_____4_CM 1 100. 0. 25.5 DISPLAY_IDENTIFIER T_VS_IS_NT ECU_ADDRESS 0xd0001532 FORMAT "%4.1" /end MEASUREMENT
/begin MEASUREMENT fac_maf_rel "relative filling" UWORD _CNV_A_R_LINEAR_____226_CM 1 100. 0. 300. DISPLAY_IDENTIFIER FAC_MAF_REL ECU_ADDRESS 0xd00072e2 FORMAT "%5.1" /end MEASUREMENT
/begin MEASUREMENT maf_sp "MAF setpoint output for inverse air path" UWORD _CNV_A_R_LINEAR_____111_CM 1 100. 0. 1389. DISPLAY_IDENTIFIER MAF_SP ECU_ADDRESS 0xd00072d0 FORMAT "%6.2" /end MEASUREMENT
/begin MEASUREMENT map_drv1[0] "First derivative of  intake  manifold pressure " SWORD _CNV_A_R_LINEAR_____524_CM 1 100. -82.91625999999999 82.91377 DISPLAY_IDENTIFIER MAP_DRV1[1] ECU_ADDRESS 0xd00072ee FORMAT "%7.3" /end MEASUREMENT
/begin MEASUREMENT map_drv1[1] "First derivative of  intake  manifold pressure " SWORD _CNV_A_R_LINEAR_____524_CM 1 100. -82.91625999999999 82.91377 DISPLAY_IDENTIFIER MAP_DRV1[2] ECU_ADDRESS 0xd00072f0 FORMAT "%7.3" /end MEASUREMENT
/begin MEASUREMENT map_sp[0] " manifold air pressure setpoint" UWORD _CNV_A_R_LINEAR_____27_CM 1 100. 0. 5434. DISPLAY_IDENTIFIER MAP_SP[1] ECU_ADDRESS 0xd00072f2 FORMAT "%7.2" /end MEASUREMENT
/begin MEASUREMENT map_sp[1] " manifold air pressure setpoint" UWORD _CNV_A_R_LINEAR_____27_CM 1 100. 0. 5434. DISPLAY_IDENTIFIER MAP_SP[2] ECU_ADDRESS 0xd00072f4 FORMAT "%7.2" /end MEASUREMENT
/begin MEASUREMENT pq_egr_sp "pressure quotient between exhausted branch and MAP" UWORD _CNV_A_R_LINEAR_____165_CM 1 100. 0. 1. DISPLAY_IDENTIFIER PQ_EGR_SP ECU_ADDRESS 0xd000a330 FORMAT "%8.6" /end MEASUREMENT
/begin MEASUREMENT maf_egr_neut_gas "mass flow of inert gas" UWORD _CNV_A_R_LINEAR_____111_CM 1 100. 0. 1389. DISPLAY_IDENTIFIER MAF_EGR_NEUT_GAS ECU_ADDRESS 0xd00072f8 FORMAT "%6.2" /end MEASUREMENT
/begin MEASUREMENT lv_tps_sub_diag_not_vld "Bedingung Berechnung DKWinkel aus Signal des HF-Sensors ungedrosselt " UBYTE _CNV_S_2_RANGE__0___1_CM 1 100. 0. 1. DISPLAY_IDENTIFIER LV_TPS_SUB_DIAG_NOT_VLD ECU_ADDRESS 0xd00077e0 /end MEASUREMENT
/begin MEASUREMENT fac_maf_ad_thr_kwp[0] "Testerwert NN DK-Adaption" SWORD _CNV_A_R_LINEAR_____259_CM 1 100. -1. 0.999969482421875 DISPLAY_IDENTIFIER FAC_MAF_AD_THR_KWP[0] ECU_ADDRESS 0xd00072fa FORMAT "%8.5" /end MEASUREMENT
/begin MEASUREMENT fac_maf_ad_thr_kwp[1] "Testerwert NN DK-Adaption" SWORD _CNV_A_R_LINEAR_____259_CM 1 100. -1. 0.999969482421875 DISPLAY_IDENTIFIER FAC_MAF_AD_THR_KWP[1] ECU_ADDRESS 0xd00072fc FORMAT "%8.5" /end MEASUREMENT
/begin MEASUREMENT fac_maf_ad_egr_kwp[0] "Testerwert NN PR-Adaption" SWORD _CNV_A_R_LINEAR_____24_CM 1 100. -2. 1.99993896484375 DISPLAY_IDENTIFIER FAC_MAF_AD_EGR_KWP[0] ECU_ADDRESS 0xd00072fe FORMAT "%8.5" /end MEASUREMENT
/begin MEASUREMENT fac_maf_ad_egr_kwp[1] "Testerwert NN PR-Adaption" SWORD _CNV_A_R_LINEAR_____24_CM 1 100. -2. 1.99993896484375 DISPLAY_IDENTIFIER FAC_MAF_AD_EGR_KWP[1] ECU_ADDRESS 0xd0007300 FORMAT "%8.5" /end MEASUREMENT
/begin AXIS_PTS ldp_mff_sp_mv_ip_fac_egy_bal "" 0xa080896c mff_sp_mv _REC_AXS_20_u2 1389. _CNV_A_R_LINEAR_____111_CM 8 0. 1389. FORMAT "%7.2" /end AXIS_PTS
/begin CHARACTERISTIC ip_fac_egy_level_iv_bal_cor "Index table for cylinder balancing injection valve energy level correction factor" CURVE 0xa080a314 _REC_CUR_20_u2_u2 3.99993896484375 _CNV_A_R_LINEAR_____24_CM 0. 3.99993896484375 DISPLAY_IDENTIFIER IP_FAC_EGY_LEVEL_IV_BAL_COR FORMAT "%7.5"
 /begin AXIS_DESCR COM_AXIS mff_sp_mv _CNV_A_R_LINEAR_____111_CM 8 0. 1389. FORMAT "%7.2" AXIS_PTS_REF ldp_mff_sp_mv_ip_fac_egy_bal /end AXIS_DESCR
/end CHARACTERISTIC
/begin CHARACTERISTIC lc_rpu_lamb_rgn_2 "switch to use RPU value of LAMB_RGN_i" VALUE 0xa080c5e2 _REC_VAL_20_u1 1. _CNV_A_R_LINEAR_____0_CM 0. 1. DISPLAY_IDENTIFIER LC_RPU_LAMB_RGN_2 FORMAT "%1.0" /end CHARACTERISTIC
/begin MEASUREMENT lv_puc_lock_tnt "PUC prohibited, if TNT_MDL_H to large" UBYTE _CNV_S_2_RANGE__0___1_CM 1 100. 0. 1. DISPLAY_IDENTIFIER LV_PUC_LOCK_TNT ECU_ADDRESS 0xd00086b8 BIT_MASK 0x1 /end MEASUREMENT
/begin MEASUREMENT lamb_pls_ext[0] "lambda set point deviation from external source" SWORD _CNV_A_R_LINEAR_____24_CM 1 100. -0.125 0.125 DISPLAY_IDENTIFIER LAMB_PLS_EXT[1] ECU_ADDRESS 0xd000a204 FORMAT "%8.5" /end MEASUREMENT
/begin MEASUREMENT lamb_pls_ext[1] "lambda set point deviation from external source" SWORD _CNV_A_R_LINEAR_____24_CM 1 100. -0.125 0.125 DISPLAY_IDENTIFIER LAMB_PLS_EXT[2] ECU_ADDRESS 0xd000a206 FORMAT "%8.5" /end MEASUREMENT
/begin MEASUREMENT tq_max_acc "air-conditioning-compressor limit torque" UBYTE _CNV_A_R_LINEAR_____57_CM 1 100. 0. 127.5 DISPLAY_IDENTIFIER TQ_MAX_ACC ECU_ADDRESS 0xd0008669 FORMAT "%3.1" /end MEASUREMENT
/begin MEASUREMENT state_egy_cns_off "state all electrical consumers off" UBYTE _CNV_A_R_LINEAR_____0_CM 1 100. 0. 255. DISPLAY_IDENTIFIER STATE_EGY_CNS_OFF ECU_ADDRESS 0xd0008673 FORMAT "%3.0" /end MEASUREMENT
/begin MEASUREMENT state_engg_pos "state engagement positve" UBYTE _CNV_A_R_LINEAR_____0_CM 1 100. 0. 255. DISPLAY_IDENTIFIER STATE_ENGG_POS ECU_ADDRESS 0xd0008675 FORMAT "%3.0" /end MEASUREMENT
/begin MEASUREMENT state_tq_wheel "state torque wheel" UBYTE _CNV_A_R_LINEAR_____0_CM 1 100. 0. 255. DISPLAY_IDENTIFIER STATE_TQ_WHEEL ECU_ADDRESS 0xd0008676 FORMAT "%3.0" /end MEASUREMENT
/begin MEASUREMENT tq_wheel "torque wheel actual value" UWORD _CNV_A_R_LINEAR_____543_CM 1 100. -32000. 33535. DISPLAY_IDENTIFIER TQ_WHEEL ECU_ADDRESS 0xd000a136 FORMAT "%6.0" /end MEASUREMENT
/begin MEASUREMENT tq_max_wheel "maximum torque wheel" UWORD _CNV_A_R_LINEAR_____543_CM 1 100. -32000. 33535. DISPLAY_IDENTIFIER TQ_MAX_WHEEL ECU_ADDRESS 0xd000a138 FORMAT "%6.0" /end MEASUREMENT
/begin MEASUREMENT tq_min_wheel_l "minimum torque wheel low" UWORD _CNV_A_R_LINEAR_____543_CM 1 100. -32000. 33535. DISPLAY_IDENTIFIER TQ_MIN_WHEEL_L ECU_ADDRESS 0xd000a13a FORMAT "%6.0" /end MEASUREMENT
/begin MEASUREMENT lv_can_snd_msg_pwr_mng_0 "Flag indicating \"Bedingung POWERMANAGMENT VERBRAUCHERSTEUERUNG Sendeanforderung\"" UBYTE _CNV_S_2_RANGE__0___1_CM 1 100. 0. 1. DISPLAY_IDENTIFIER LV_CAN_SND_MSG_PWR_MNG_0 ECU_ADDRESS 0xd0008679 BIT_MASK 0x1 /end MEASUREMENT
/begin MEASUREMENT lv_can_snd_msg_pwr_mng_1 "Flag indicating \"Bedingung POWERMANAGMENT BATTERIESPANNUNG Sendeanforderung\"" UBYTE _CNV_S_2_RANGE__0___1_CM 1 100. 0. 1. DISPLAY_IDENTIFIER LV_CAN_SND_MSG_PWR_MNG_1 ECU_ADDRESS 0xd000867a BIT_MASK 0x1 /end MEASUREMENT
/begin MEASUREMENT lv_oil_cns_warn_1 "LV warning oil consumption" UBYTE _CNV_S_2_RANGE__0___1_CM 1 100. 0. 1. DISPLAY_IDENTIFIER LV_OIL_CNS_WARN_1 ECU_ADDRESS 0xd000867b BIT_MASK 0x1 /end MEASUREMENT
/begin MEASUREMENT lv_oil_cns_warn_2 "LV warning oil consumption" UBYTE _CNV_S_2_RANGE__0___1_CM 1 100. 0. 1. DISPLAY_IDENTIFIER LV_OIL_CNS_WARN_2 ECU_ADDRESS 0xd000867c BIT_MASK 0x1 /end MEASUREMENT
/begin MEASUREMENT lv_ldm_off "LDM off requested by DME" UBYTE _CNV_S_2_RANGE__0___1_CM 1 100. 0. 1. DISPLAY_IDENTIFIER LV_LDM_OFF ECU_ADDRESS 0xd000867d BIT_MASK 0x1 /end MEASUREMENT
/begin MEASUREMENT lv_gs_up "Gear-shift up" UBYTE _CNV_S_2_RANGE__0___1_CM 1 100. 0. 1. DISPLAY_IDENTIFIER LV_GS_UP ECU_ADDRESS 0xd000867e BIT_MASK 0x1 /end MEASUREMENT
/begin MEASUREMENT lv_gs_down "Gear-shift down" UBYTE _CNV_S_2_RANGE__0___1_CM 1 100. 0. 1. DISPLAY_IDENTIFIER LV_GS_DOWN ECU_ADDRESS 0xd000867f BIT_MASK 0x1 /end MEASUREMENT
/begin MEASUREMENT lv_ldm_driv_act "Condition LDM driver active" UBYTE _CNV_S_2_RANGE__0___1_CM 1 100. 0. 1. DISPLAY_IDENTIFIER LV_LDM_DRIV_ACT ECU_ADDRESS 0xd0008680 BIT_MASK 0x1 /end MEASUREMENT
/begin MEASUREMENT gr_dt "Gear ratio factor" UBYTE _CNV_A_R_EGCP_LINEA_355_CM 1 100. 0. 31.875 DISPLAY_IDENTIFIER GR_DT ECU_ADDRESS 0xd0008674 /end MEASUREMENT
/begin MEASUREMENT cur_rng_ctl "Control current path" UBYTE _CNV_A_R_LINEAR_____0_CM 1 100. 0. 255. DISPLAY_IDENTIFIER CUR_RNG_CTL ECU_ADDRESS 0xd000866a FORMAT "%3.0" /end MEASUREMENT
/begin MEASUREMENT pow_ctl_pri_peak_red "Control priority peak reduction" UBYTE _CNV_A_R_LINEAR_____0_CM 1 100. 0. 255. DISPLAY_IDENTIFIER POW_CTL_PRI_PEAK_RED ECU_ADDRESS 0xd000866c FORMAT "%3.0" /end MEASUREMENT
/begin MEASUREMENT pow_ctl_pri_peak_red_cft "Control priority peak reduction comfort" UBYTE _CNV_A_R_LINEAR_____0_CM 1 100. 0. 255. DISPLAY_IDENTIFIER POW_CTL_PRI_PEAK_RED_CFT ECU_ADDRESS 0xd000866d FORMAT "%3.0" /end MEASUREMENT
/begin MEASUREMENT pow_ctl_park_cns "Control park consumer" UBYTE _CNV_A_R_LINEAR_____0_CM 1 100. 0. 255. DISPLAY_IDENTIFIER POW_CTL_PARK_CNS ECU_ADDRESS 0xd000866b FORMAT "%3.0" /end MEASUREMENT
/begin MEASUREMENT pow_ctl_pwr_cns_1 "Control power consumer" UWORD _CNV_A_R_LINEAR_____0_CM 1 100. 0. 65535. DISPLAY_IDENTIFIER POW_CTL_PWR_CNS_1 ECU_ADDRESS 0xd000a132 FORMAT "%5.0" /end MEASUREMENT
/begin MEASUREMENT pow_ctl_pwr_cns_2 "Control power special consumer" UBYTE _CNV_A_R_LINEAR_____452_CM 1 100. 0. 127.5 DISPLAY_IDENTIFIER POW_CTL_PWR_CNS_2 ECU_ADDRESS 0xd000866e FORMAT "%5.1" /end MEASUREMENT
/begin MEASUREMENT idfbosmg_w "Control power consumer" UWORD _CNV_A_R_LINEAR_____0_CM 1 100. 0. 65535. DISPLAY_IDENTIFIER IDFBOSMG_W ECU_ADDRESS 0xd000a134 FORMAT "%5.0" /end MEASUREMENT
/begin MEASUREMENT state_tq_wheel_driv_asi_av "actual state of TQ_WHEEL_DRIV_ASI functionality (get from layer)" UBYTE _CNV_A_R_LINEAR_____0_CM 1 100. 0. 255. DISPLAY_IDENTIFIER STATE_TQ_WHEEL_DRIV_ASI_AV ECU_ADDRESS 0xd0008677 FORMAT "%3.0" /end MEASUREMENT
/begin MEASUREMENT state_tq_wheel_tcs_av "Actual state of TQ_Wheel_TCS functionality (get from Layer)" UBYTE _CNV_A_R_LINEAR_____0_CM 1 100. 0. 255. DISPLAY_IDENTIFIER STATE_TQ_WHEEL_TCS_AV ECU_ADDRESS 0xd0008678 FORMAT "%3.0" /end MEASUREMENT
/begin AXIS_PTS ldp_tq_loss_alter_1__tq_alter "" 0xa0807fd4 tq_loss_alter_1 _REC_AXS_20_u2 2047.96875 _CNV_A_R_LINEAR_____87_CM 6 -1024. 1023.96875 FORMAT "%6.2" /end AXIS_PTS
/begin AXIS_PTS ldp_n_32__tq_alter "" 0xa0807fc4 n_32 _REC_AXS_20_u1 816. _CNV_A_R_LINEAR_____10_CM 6 0. 8160. FORMAT "%4.0" /end AXIS_PTS
/begin MEASUREMENT lv_err_ftl_obd "error flag fuel tank level" UBYTE _CNV_S_2_RANGE__0___1_CM 1 100. 0. 1. DISPLAY_IDENTIFIER LV_ERR_FTL_OBD ECU_ADDRESS 0xd0007fdc BIT_MASK 0x1 /end MEASUREMENT
/begin MEASUREMENT lv_err_ftl_le_can "error flag for left (second) fuel tank level" UBYTE _CNV_S_2_RANGE__0___1_CM 1 100. 0. 1. DISPLAY_IDENTIFIER LV_ERR_FTL_LE_CAN ECU_ADDRESS 0xd0007fdd BIT_MASK 0x1 /end MEASUREMENT
/begin MEASUREMENT lv_err_ftl_ri_can "error flag for right (first) fuel tank level" UBYTE _CNV_S_2_RANGE__0___1_CM 1 100. 0. 1. DISPLAY_IDENTIFIER LV_ERR_FTL_RI_CAN ECU_ADDRESS 0xd0007fde BIT_MASK 0x1 /end MEASUREMENT
/begin MEASUREMENT n_max_lih_state_cmb_s "Engine speed limit for required  stratified limp home mode" UWORD _CNV_A_R_LINEAR_____14_CM 1 100. 0. 8160. DISPLAY_IDENTIFIER N_MAX_LIH_STATE_CMB_S ECU_ADDRESS 0xd000a158 FORMAT "%4.0" /end MEASUREMENT
/begin AXIS_PTS ldp_idx_bsd_sdl_tbl "" 0xa0808794 online_dummy _REC_AXS_20_u1 255. _CNV_A_R_LINEAR_____0_CM 32 0. 255. FORMAT "%3.0" /end AXIS_PTS
/begin MEASUREMENT lv_cp_inh_cus "CPS-INH request from customer" UBYTE _CNV_S_2_RANGE__0___1_CM 1 100. 0. 1. DISPLAY_IDENTIFIER LV_CP_INH_CUS ECU_ADDRESS 0xd00087b8 BIT_MASK 0x1 /end MEASUREMENT
/begin MEASUREMENT mff_max_cp_cus "Maximum mass flow from canister purge" SWORD _CNV_A_R_LINEAR_____128_CM 1 100. -694.510597390707 694.4894026092931 DISPLAY_IDENTIFIER MFF_MAX_CP_CUS ECU_ADDRESS 0xd000a398 FORMAT "%7.2" /end MEASUREMENT
/begin MEASUREMENT mff_add_tq_cp "TQ relevant mass flow" SWORD _CNV_A_R_LINEAR_____128_CM 1 100. -694.510597390707 694.4894026092931 DISPLAY_IDENTIFIER MFF_ADD_TQ_CP ECU_ADDRESS 0xd000a39a FORMAT "%7.2" /end MEASUREMENT
/begin MEASUREMENT mff_max_s_cus "MFF threshold for engine operation mode change HOMS <-> S" SWORD _CNV_A_R_LINEAR_____128_CM 1 100. -694.510597390707 694.4894026092931 DISPLAY_IDENTIFIER MFF_MAX_S_CUS ECU_ADDRESS 0xd000a39c FORMAT "%7.2" /end MEASUREMENT
/begin MEASUREMENT mff_max_homs_cus "MFF threshold for engine operation mode change HOM <-> HOMS" SWORD _CNV_A_R_LINEAR_____128_CM 1 100. -694.510597390707 694.4894026092931 DISPLAY_IDENTIFIER MFF_MAX_HOMS_CUS ECU_ADDRESS 0xd000a39e FORMAT "%7.2" /end MEASUREMENT
/begin CHARACTERISTIC lc_diagcps_eol_hom_req "Homogeneous AFS request due to acive EOL DIAGCPS" VALUE 0xa080c54c _REC_VAL_20_u1 1. _CNV_A_R_LINEAR_____0_CM 0. 1. DISPLAY_IDENTIFIER LC_DIAGCPS_EOL_HOM_REQ FORMAT "%2.0" /end CHARACTERISTIC
/begin MEASUREMENT lv_nt_req_rgn "Logical value for regeneration phase request" UBYTE _CNV_S_2_RANGE__0___1_CM 1 100. 0. 1. DISPLAY_IDENTIFIER LV_NT_REQ_RGN ECU_ADDRESS 0xd0008703 BIT_MASK 0x1 /end MEASUREMENT
/begin MEASUREMENT teg_dyn_stop "Modelled exhaust gas temperature at last engine stop" UWORD _CNV_A_R_LINEAR_____130_CM 1 100. 0. 2047. DISPLAY_IDENTIFIER TEG_DYN_STOP ECU_ADDRESS 0xd000a2c8 FORMAT "%7.2" /end MEASUREMENT
/begin MEASUREMENT temp_cat "modelled catalyst monolith temperature (average value)" UWORD _CNV_A_R_LINEAR_____780_CM 1 100. -33. 990.984375 DISPLAY_IDENTIFIER TEMP_CAT ECU_ADDRESS 0xd000a29c FORMAT "%6.2" /end MEASUREMENT
/begin MEASUREMENT teg_cat_down_mdl "Bank selektive modelled exhaust gas temperature downstream for interfaces" UWORD _CNV_A_R_LINEAR_____130_CM 1 100. 0. 2047. DISPLAY_IDENTIFIER TEG_CAT_DOWN_MDL ECU_ADDRESS 0xd000a29e FORMAT "%7.2" /end MEASUREMENT
/begin MEASUREMENT teg_dyn "Gemittelte Agbastemperatur vor Kat" UWORD _CNV_A_R_LINEAR_____130_CM 1 100. 0. 2047. DISPLAY_IDENTIFIER TEG_DYN ECU_ADDRESS 0xd000a2a4 FORMAT "%7.2" /end MEASUREMENT
/begin MEASUREMENT teg_cat_down_mdl_cbk[0] "Agbastemperatur nach Kat Bank specific" UWORD _CNV_A_R_LINEAR_____130_CM 1 100. 0. 2047. DISPLAY_IDENTIFIER TEG_CAT_DOWN_MDL[1] ECU_ADDRESS 0xd000a2a0 FORMAT "%7.2" /end MEASUREMENT
/begin MEASUREMENT teg_cat_down_mdl_cbk[1] "Agbastemperatur nach Kat Bank specific" UWORD _CNV_A_R_LINEAR_____130_CM 1 100. 0. 2047. DISPLAY_IDENTIFIER TEG_CAT_DOWN_MDL[2] ECU_ADDRESS 0xd000a2a2 FORMAT "%7.2" /end MEASUREMENT
/begin MEASUREMENT teg_stat_max_1 "Agbastemperatur nach Kat Bank 1" UWORD _CNV_A_R_LINEAR_____130_CM 1 100. 0. 2047. DISPLAY_IDENTIFIER TEG_STAT_MAX_1 ECU_ADDRESS 0xd000a298 FORMAT "%7.2" /end MEASUREMENT
/begin MEASUREMENT teg_stat_max_2 "Agbastemperatur nach Kat Bank 1" UWORD _CNV_A_R_LINEAR_____130_CM 1 100. 0. 2047. DISPLAY_IDENTIFIER TEG_STAT_MAX_2 ECU_ADDRESS 0xd000a2c4 FORMAT "%7.2" /end MEASUREMENT
/begin MEASUREMENT teg_stat_max "Agbastemperatur nach Kat Bank 1" UWORD _CNV_A_R_LINEAR_____130_CM 1 100. 0. 2047. DISPLAY_IDENTIFIER TEG_STAT_MAX ECU_ADDRESS 0xd000a29a FORMAT "%7.2" /end MEASUREMENT
/begin MEASUREMENT teg_wall_cat_up_mdl[0] "Model of exhaust wall temperature pre catalyst upstream" UWORD _CNV_A_R_LINEAR_____222_CM 1 100. -48. 1459.3 DISPLAY_IDENTIFIER TEG_WALL_CAT_UP_MDL[1] ECU_ADDRESS 0xd000a288 FORMAT "%7.2" /end MEASUREMENT
/begin MEASUREMENT teg_wall_cat_up_mdl[1] "Model of exhaust wall temperature pre catalyst upstream" UWORD _CNV_A_R_LINEAR_____222_CM 1 100. -48. 1459.3 DISPLAY_IDENTIFIER TEG_WALL_CAT_UP_MDL[2] ECU_ADDRESS 0xd000a28a FORMAT "%7.2" /end MEASUREMENT
/begin MEASUREMENT teg_wall_cat_down_mdl[0] "Model of exhaust wall temperature pre catalyst upstream" UWORD _CNV_A_R_LINEAR_____222_CM 1 100. -48. 1459.3 DISPLAY_IDENTIFIER TEG_WALL_CAT_DOWN_MDL[1] ECU_ADDRESS 0xd000a28c FORMAT "%7.2" /end MEASUREMENT
/begin MEASUREMENT teg_wall_cat_down_mdl[1] "Model of exhaust wall temperature pre catalyst upstream" UWORD _CNV_A_R_LINEAR_____222_CM 1 100. -48. 1459.3 DISPLAY_IDENTIFIER TEG_WALL_CAT_DOWN_MDL[2] ECU_ADDRESS 0xd000a28e FORMAT "%7.2" /end MEASUREMENT
/begin MEASUREMENT teg_cat_down_mdl_bas[0] "Model of exhaust temperature post catalyst downstream" UWORD _CNV_A_R_LINEAR_____222_CM 1 100. -48. 1459.3 DISPLAY_IDENTIFIER TEG_CAT_DOWN_MDL_BAS[1] ECU_ADDRESS 0xd000a290 FORMAT "%7.2" /end MEASUREMENT
/begin MEASUREMENT teg_cat_down_mdl_bas[1] "Model of exhaust temperature post catalyst downstream" UWORD _CNV_A_R_LINEAR_____222_CM 1 100. -48. 1459.3 DISPLAY_IDENTIFIER TEG_CAT_DOWN_MDL_BAS[2] ECU_ADDRESS 0xd000a292 FORMAT "%7.2" /end MEASUREMENT
/begin MEASUREMENT teg_cat_up_mdl[0] "Modelled exhaust gas temperature; engine out (bank selective)" UWORD _CNV_A_R_LINEAR_____130_CM 1 100. 0. 2047. DISPLAY_IDENTIFIER TEG_CAT_UP_MDL[1] ECU_ADDRESS 0xd000a294 FORMAT "%7.2" /end MEASUREMENT
/begin MEASUREMENT teg_cat_up_mdl[1] "Modelled exhaust gas temperature; engine out (bank selective)" UWORD _CNV_A_R_LINEAR_____130_CM 1 100. 0. 2047. DISPLAY_IDENTIFIER TEG_CAT_UP_MDL[2] ECU_ADDRESS 0xd000a296 FORMAT "%7.2" /end MEASUREMENT
/begin MEASUREMENT lv_lamb_ohp_1 "Flag indicating enrichment for overheating prevention (bank 1)" UBYTE _CNV_S_2_RANGE__0___1_CM 1 100. 0. 1. DISPLAY_IDENTIFIER LV_LAMB_OHP_1 ECU_ADDRESS 0xd00086ce BIT_MASK 0x1 /end MEASUREMENT
/begin MEASUREMENT lv_lamb_ohp_2 "Flag indicating enrichment for overheating prevention (bank 2)" UBYTE _CNV_S_2_RANGE__0___1_CM 1 100. 0. 1. DISPLAY_IDENTIFIER LV_LAMB_OHP_2 ECU_ADDRESS 0xd00086d6 BIT_MASK 0x1 /end MEASUREMENT
/begin MEASUREMENT tam_st "Ambient air temperature at start" UBYTE _CNV_A_R_LINEAR_____17_CM 1 100. -48. 142.5 DISPLAY_IDENTIFIER TAM_ST ECU_ADDRESS 0xd0008a24 FORMAT "%5.1" /end MEASUREMENT
/begin MEASUREMENT tam_stop "Ambient air temperature at engine stop" UBYTE _CNV_A_R_LINEAR_____17_CM 1 100. -48. 142.5 DISPLAY_IDENTIFIER TAM_STOP ECU_ADDRESS 0xd0008a25 FORMAT "%5.1" /end MEASUREMENT
/begin MEASUREMENT state_rbm_ftl_obd "Interface of FTL_OBD monitor with the Rate-Based Monitoring statistics" UBYTE _CNV_A_R_LINEAR_____0_CM 1 100. 0. 7. DISPLAY_IDENTIFIER STATE_RBM_FTL_OBD ECU_ADDRESS 0xd0008e50 FORMAT "%1.0" /end MEASUREMENT
/begin MEASUREMENT lv_err_map "MAP sensor error detected" UBYTE _CNV_S_2_RANGE__0___1_CM 1 100. 0. 1. DISPLAY_IDENTIFIER LV_ERR_MAP ECU_ADDRESS 0xd0008774 BIT_MASK 0x1 /end MEASUREMENT
/begin MEASUREMENT rfppwm[0] "PWM output recirculation flap 0" UWORD _CNV_A_R_LINEAR_____8_CM 1 100. 0. 99.99847412109381 DISPLAY_IDENTIFIER RFPPWM_0 ECU_ADDRESS 0xd000a23c /end MEASUREMENT
/begin MEASUREMENT rfppwm[1] "PWM output recirculation flap 1" UWORD _CNV_A_R_LINEAR_____8_CM 1 100. 0. 99.99847412109381 DISPLAY_IDENTIFIER RFPPWM_1 ECU_ADDRESS 0xd000a23e /end MEASUREMENT
/begin MEASUREMENT wgpwm[0] "PWM output wastegate 0" UWORD _CNV_A_R_LINEAR_____8_CM 1 100. 0. 99.99847412109381 DISPLAY_IDENTIFIER WGPWM_0 ECU_ADDRESS 0xd000a238 /end MEASUREMENT
/begin MEASUREMENT wgpwm[1] "PWM output wastegate 1" UWORD _CNV_A_R_LINEAR_____8_CM 1 100. 0. 99.99847412109381 DISPLAY_IDENTIFIER WGPWM_1 ECU_ADDRESS 0xd000a23a /end MEASUREMENT
/begin CHARACTERISTIC c_wgpwm_sub_diag "PWM output wastegate in case of  electrical failure" VALUE 0xa080c50e _REC_VAL_20_u2 99.99847412109381 _CNV_A_R_LINEAR_____8_CM 0. 99.99847412109381 DISPLAY_IDENTIFIER C_WGPWM_SUB_DIAG /end CHARACTERISTIC
/begin MEASUREMENT lv_inh_puc_cus "Flag indicating \"Bedingung Schubabschaltung verboten\"" UBYTE _CNV_S_2_RANGE__0___1_CM 1 100. 0. 1. DISPLAY_IDENTIFIER LV_INH_PUC_CUS ECU_ADDRESS 0xd0008690 BIT_MASK 0x1 /end MEASUREMENT
/begin AXIS_PTS ldpm_opm_av "" 0xa0809750 opm_av _REC_AXS_20_u1 8. _CNV_A_R_LINEAR_____0_CM 8 0. 8. FORMAT "%1.0" /end AXIS_PTS
/begin AXIS_PTS ldpm_opm_req "" 0xa080975c opm_req _REC_AXS_20_u1 8. _CNV_A_R_LINEAR_____0_CM 8 0. 8. FORMAT "%1.0" /end AXIS_PTS
/begin AXIS_PTS ldp_tco_st_ip_fac_tq_add_ch_amp "" 0xa0805848 tco_st _REC_AXS_20_u1 190.5 _CNV_A_R_LINEAR_____17_CM 8 -48. 142.5 FORMAT "%6.2" /end AXIS_PTS
/begin CHARACTERISTIC c_v_map_bas_max_diag "Maximum diagnostic value for the manifold differential pressure value" VALUE 0xa080c3d2 _REC_VAL_20_u2 4.9951171875 _CNV_A_R_LINEAR_____2_CM 0. 4.9951171875 DISPLAY_IDENTIFIER C_V_MAP_BAS_MAX_DIAG FORMAT "%5.3" /end CHARACTERISTIC
/begin CHARACTERISTIC c_v_map_bas_min_diag "Minimum diagnostic value for the manifold differential pressure value" VALUE 0xa080c3d4 _REC_VAL_20_u2 4.9951171875 _CNV_A_R_LINEAR_____2_CM 0. 4.9951171875 DISPLAY_IDENTIFIER C_V_MAP_BAS_MIN_DIAG FORMAT "%5.3" /end CHARACTERISTIC
/begin MEASUREMENT lv_err_map_dip_sens "MAP_DIP sensor error present" UBYTE _CNV_S_2_RANGE__0___1_CM 1 100. 0. 1. DISPLAY_IDENTIFIER LV_ERR_MAP_DIP_SENS ECU_ADDRESS 0xd00088e4 BIT_MASK 0x1 /end MEASUREMENT
/begin MEASUREMENT lv_err_map_sens_1 "MAP sensor error present" UBYTE _CNV_S_2_RANGE__0___1_CM 1 100. 0. 1. DISPLAY_IDENTIFIER LV_ERR_MAP_SENS[1] ECU_ADDRESS 0xd0007fc6 BIT_MASK 0x1 /end MEASUREMENT
/begin MEASUREMENT lv_err_map_sens_2 "MAP sensor error present" UBYTE _CNV_S_2_RANGE__0___1_CM 1 100. 0. 1. DISPLAY_IDENTIFIER LV_ERR_MAP_SENS[2] ECU_ADDRESS 0xd0007fc7 BIT_MASK 0x1 /end MEASUREMENT
/begin MEASUREMENT lv_err_map_dip_shift "MAP_DIP sensor error present" UBYTE _CNV_S_2_RANGE__0___1_CM 1 100. 0. 1. DISPLAY_IDENTIFIER LV_ERR_MAP_DIP_SHIFT ECU_ADDRESS 0xd00088e5 BIT_MASK 0x1 /end MEASUREMENT
/begin MEASUREMENT lv_err_map_shift_1 "MAP sensor error present" UBYTE _CNV_S_2_RANGE__0___1_CM 1 100. 0. 1. DISPLAY_IDENTIFIER LV_ERR_MAP_SHIFT[1] ECU_ADDRESS 0xd0007fe2 BIT_MASK 0x1 /end MEASUREMENT
/begin MEASUREMENT lv_err_map_shift_2 "MAP sensor error present" UBYTE _CNV_S_2_RANGE__0___1_CM 1 100. 0. 1. DISPLAY_IDENTIFIER LV_ERR_MAP_SHIFT[2] ECU_ADDRESS 0xd0007fe3 BIT_MASK 0x1 /end MEASUREMENT
/begin MEASUREMENT rst_info.rst_data[0].rst_dbg_backtrace_address[0] "info last available caller addresses (default 0)" ULONG _CNV_A_R_LINEAR_____50_CM 1 100. 0. 4294967295. DISPLAY_IDENTIFIER RST_DBG_BACKTRACE_ADDRESS[0][0] ECU_ADDRESS 0xd00054b8 FORMAT "%11.0" /end MEASUREMENT
/begin MEASUREMENT rst_info.rst_data[0].rst_dbg_backtrace_address[1] "info last available caller addresses (default 0)" ULONG _CNV_A_R_LINEAR_____50_CM 1 100. 0. 4294967295. DISPLAY_IDENTIFIER RST_DBG_BACKTRACE_ADDRESS[0][1] ECU_ADDRESS 0xd00054bc FORMAT "%11.0" /end MEASUREMENT
/begin MEASUREMENT rst_info.rst_data[0].rst_dbg_backtrace_address[2] "info last available caller addresses (default 0)" ULONG _CNV_A_R_LINEAR_____50_CM 1 100. 0. 4294967295. DISPLAY_IDENTIFIER RST_DBG_BACKTRACE_ADDRESS[0][2] ECU_ADDRESS 0xd00054c0 FORMAT "%11.0" /end MEASUREMENT
/begin MEASUREMENT rst_info.rst_data[0].rst_dbg_backtrace_address[3] "info last available caller addresses (default 0)" ULONG _CNV_A_R_LINEAR_____50_CM 1 100. 0. 4294967295. DISPLAY_IDENTIFIER RST_DBG_BACKTRACE_ADDRESS[0][3] ECU_ADDRESS 0xd00054c4 FORMAT "%11.0" /end MEASUREMENT
/begin MEASUREMENT rst_info.rst_data[0].rst_dbg_backtrace_address[4] "info last available caller addresses (default 0)" ULONG _CNV_A_R_LINEAR_____50_CM 1 100. 0. 4294967295. DISPLAY_IDENTIFIER RST_DBG_BACKTRACE_ADDRESS[0][4] ECU_ADDRESS 0xd00054c8 FORMAT "%11.0" /end MEASUREMENT
/begin MEASUREMENT rst_info.rst_data[0].rst_dbg_backtrace_address[5] "info last available caller addresses (default 0)" ULONG _CNV_A_R_LINEAR_____50_CM 1 100. 0. 4294967295. DISPLAY_IDENTIFIER RST_DBG_BACKTRACE_ADDRESS[0][5] ECU_ADDRESS 0xd00054cc FORMAT "%11.0" /end MEASUREMENT
/begin MEASUREMENT rst_info.rst_data[0].rst_dbg_backtrace_address[6] "info last available caller addresses (default 0)" ULONG _CNV_A_R_LINEAR_____50_CM 1 100. 0. 4294967295. DISPLAY_IDENTIFIER RST_DBG_BACKTRACE_ADDRESS[0][6] ECU_ADDRESS 0xd00054d0 FORMAT "%11.0" /end MEASUREMENT
/begin MEASUREMENT rst_info.rst_data[0].rst_dbg_backtrace_address[7] "info last available caller addresses (default 0)" ULONG _CNV_A_R_LINEAR_____50_CM 1 100. 0. 4294967295. DISPLAY_IDENTIFIER RST_DBG_BACKTRACE_ADDRESS[0][7] ECU_ADDRESS 0xd00054d4 FORMAT "%11.0" /end MEASUREMENT
/begin MEASUREMENT rst_info.rst_data[0].rst_dbg_backtrace_address[8] "info last available caller addresses (default 0)" ULONG _CNV_A_R_LINEAR_____50_CM 1 100. 0. 4294967295. DISPLAY_IDENTIFIER RST_DBG_BACKTRACE_ADDRESS[0][8] ECU_ADDRESS 0xd00054d8 FORMAT "%11.0" /end MEASUREMENT
/begin MEASUREMENT rst_info.rst_data[0].rst_dbg_backtrace_address[9] "info last available caller addresses (default 0)" ULONG _CNV_A_R_LINEAR_____50_CM 1 100. 0. 4294967295. DISPLAY_IDENTIFIER RST_DBG_BACKTRACE_ADDRESS[0][9] ECU_ADDRESS 0xd00054dc FORMAT "%11.0" /end MEASUREMENT
/begin MEASUREMENT rst_info.rst_data[0].rst_info_add "additional reset info (cause)" ULONG _CNV_A_R_LINEAR_____50_CM 1 100. 0. 4294967295. DISPLAY_IDENTIFIER RST_INFO_ADD[0] ECU_ADDRESS 0xd00054b4 FORMAT "%11.0" /end MEASUREMENT
/begin MEASUREMENT rst_info.rst_data[0].rst_clas_typ "reset type" UBYTE _CNV_A_R_LINEAR_____0_CM 1 100. 0. 255. DISPLAY_IDENTIFIER RST_CLAS_TYP[0] ECU_ADDRESS 0xd0005595 FORMAT "%3.0" /end MEASUREMENT
/begin MEASUREMENT rst_info.rst_data[0].rst_clas_sec "reset security info (reason for atypical reset)" UBYTE _CNV_A_R_LINEAR_____0_CM 1 100. 0. 255. DISPLAY_IDENTIFIER RST_CLAS_SEC[0] ECU_ADDRESS 0xd0005596 FORMAT "%3.0" /end MEASUREMENT
/begin MEASUREMENT rst_info.rst_data[0].rst_dbg_back_info_vld "background info for last reset valid" UBYTE _CNV_A_R_LINEAR_____0_CM 1 100. 0. 1. DISPLAY_IDENTIFIER RST_DBG_BACK_INFO_VLD[0] ECU_ADDRESS 0xd0005594 FORMAT "%1.0" /end MEASUREMENT
/begin MEASUREMENT rst_info.rst_data[0].rst_run.dist_rst_det "" ULONG _CNV_A_R_LINEAR_____434_CM 1 100. 0. 429496729500. DISPLAY_IDENTIFIER DIST_RST_DET[0] ECU_ADDRESS 0xd0005598 FORMAT "%13.0" /end MEASUREMENT
/begin MEASUREMENT rst_info.rst_data[0].rst_run.trt_rst_det "" ULONG _CNV_A_R_LINEAR_____152_CM 1 100. 0. 119304.6471 DISPLAY_IDENTIFIER TRT_RST_DET[0] ECU_ADDRESS 0xd000559c FORMAT "%12.5" /end MEASUREMENT
/begin MEASUREMENT rst_info.rst_data[0].rst_run.cpu_load_rst_det "" UWORD _CNV_A_R_CPULOAD__0_448_CM 1 100. 0. 100. DISPLAY_IDENTIFIER CPU_LOAD_RST_DET[0] ECU_ADDRESS 0xd00055a0 FORMAT "%3.1" /end MEASUREMENT
/begin MEASUREMENT rst_info.rst_data[0].rst_run.n_rst_det "" UWORD _CNV_A_R_LINEAR_____14_CM 1 100. 0. 8160. DISPLAY_IDENTIFIER N_RST_DET[0] ECU_ADDRESS 0xd00055a2 FORMAT "%4.0" /end MEASUREMENT
/begin MEASUREMENT rst_info.rst_data[0].rst_run.cpu_load_max_rst_det "" UWORD _CNV_A_R_CPULOAD__0_448_CM 1 100. 0. 100. DISPLAY_IDENTIFIER CPU_LOAD_MAX_RST_DET[0] ECU_ADDRESS 0xd00055a4 FORMAT "%3.1" /end MEASUREMENT
/begin MEASUREMENT rst_info.rst_data[0].rst_run.n_cpu_load_max_rst_det "" UWORD _CNV_A_R_LINEAR_____14_CM 1 100. 0. 8160. DISPLAY_IDENTIFIER N_CPU_LOAD_MAX_RST_DET[0] ECU_ADDRESS 0xd00055a6 FORMAT "%4.0" /end MEASUREMENT
/begin MEASUREMENT t_veh_pow_var_act "time since function check of power variant activation" UBYTE _CNV_A_R_LINEAR_____4_CM 1 100. 0. 25.5 DISPLAY_IDENTIFIER T_VEH_POW_VAR_ACT ECU_ADDRESS 0xd0000394 FORMAT "%4.1" /end MEASUREMENT
/begin CHARACTERISTIC c_t_min_pow_clas_veh_can_req "delay time before check of power variant coding" VALUE 0xa080c226 _REC_VAL_20_u1 25.5 _CNV_A_R_LINEAR_____4_CM 0. 25.5 DISPLAY_IDENTIFIER C_T_MIN_POW_CLAS_VEH_CAN_REQ FORMAT "%4.1" /end CHARACTERISTIC
/begin CHARACTERISTIC c_t_max_pow_clas_veh_can_rcv "timeout for receiving LV_POW_CLAS_VEH_CAN_RCV" VALUE 0xa080c1f6 _REC_VAL_20_u1 25.5 _CNV_A_R_LINEAR_____4_CM 0. 25.5 DISPLAY_IDENTIFIER C_T_MAX_POW_CLAS_VEH_CAN_RCV FORMAT "%4.1" /end CHARACTERISTIC
/begin CHARACTERISTIC c_state_pow_clas_veh "calibrated status vehicle power class" VALUE 0xa080c0e9 _REC_VAL_20_u1 3. _CNV_A_R_LINEAR_____0_CM 0. 3. DISPLAY_IDENTIFIER C_STATE_POW_CLAS_VEH FORMAT "%2.0" /end CHARACTERISTIC
/begin CHARACTERISTIC lc_veh_pow_var_err_dis "Logical constant to disable check of power variant coding" VALUE 0xa080c61f _REC_VAL_20_u1 1. _CNV_A_R_LINEAR_____0_CM 0. 1. DISPLAY_IDENTIFIER LC_VEH_POW_VAR_ERR_DIS FORMAT "%2.0" /end CHARACTERISTIC
/begin CHARACTERISTIC c_abc_max_pow_clas_veh_err "number of timeouts for antibounce of LV_ERR_VEH_POW_VAR" VALUE 0xa080ba35 _REC_VAL_20_u1 254. _CNV_A_R_LINEAR_____0_CM 1. 255. DISPLAY_IDENTIFIER C_ABC_MAX_POW_CLAS_VEH_ERR FORMAT "%3.0" /end CHARACTERISTIC
/begin CHARACTERISTIC c_idx_cod_conv "BMW coding index to disable check of successful BMW coding of variants via KWP" VALUE 0xa0800600 _REC_VAL_20_u1 255. _CNV_A_R_LINEAR_____0_CM 0. 255. DISPLAY_IDENTIFIER C_IDX_COD_CONV FORMAT "%3.0" /end CHARACTERISTIC
/begin MEASUREMENT lv_err_var_cod "Configuration variant coding error" UBYTE _CNV_S_2_RANGE__0___1_CM 1 100. 0. 1. DISPLAY_IDENTIFIER LV_ERR_VAR_COD ECU_ADDRESS 0xd000802b BIT_MASK 0x1 /end MEASUREMENT
/begin MEASUREMENT lv_err_veh_pow_var "Present error of wrong or unknown power variant" UBYTE _CNV_S_2_RANGE__0___1_CM 1 100. 0. 1. DISPLAY_IDENTIFIER LV_ERR_VEH_POW_VAR ECU_ADDRESS 0xd000802c BIT_MASK 0x1 /end MEASUREMENT
/begin MEASUREMENT lv_pow_clas_veh_can_req "LV to request CAN signal vehicle type" UBYTE _CNV_S_2_RANGE__0___1_CM 1 100. 0. 1. DISPLAY_IDENTIFIER LV_POW_CLAS_VEH_CAN_REQ ECU_ADDRESS 0xd0008b3f BIT_MASK 0x1 /end MEASUREMENT
/begin MEASUREMENT lv_cat_conf_dis_ext_req "disable of learning cat variants and setting variant to NO CAT via tester" UBYTE _CNV_S_2_RANGE__0___1_CM 1 100. 0. 1. DISPLAY_IDENTIFIER LV_CAT_CONF_DIS_EXT_REQ ECU_ADDRESS 0xd0008b4a BIT_MASK 0x1 /end MEASUREMENT
/begin MEASUREMENT state_mil_on_dis_ext_req "request for variant MIL_OFF via tester" UBYTE _CNV_A_R_LINEAR_____0_CM 1 100. 0. 2. DISPLAY_IDENTIFIER STATE_MIL_ON_DIS_EXT_REQ ECU_ADDRESS 0xd0008b49 FORMAT "%2.0" /end MEASUREMENT
/begin MEASUREMENT pow_conf_idx_ext_req "Selected power configuration code via tester" UBYTE _CNV_A_R_LINEAR_____0_CM 1 100. 0. 3. DISPLAY_IDENTIFIER POW_CONF_IDX_EXT_REQ ECU_ADDRESS 0xd0008b4c FORMAT "%2.0" /end MEASUREMENT
/begin MEASUREMENT t_pow_clas_veh_can_req "time since request of CAN signal vehicle type" UBYTE _CNV_A_R_LINEAR_____4_CM 1 100. 0. 25.5 DISPLAY_IDENTIFIER T_POW_CLAS_VEH_CAN_REQ ECU_ADDRESS 0xd0000395 FORMAT "%4.1" /end MEASUREMENT
/begin MEASUREMENT idx_var_cod[0] "changing index of vehicle configuration code via tester" UBYTE _CNV_A_R_LINEAR_____0_CM 1 100. 0. 255. DISPLAY_IDENTIFIER IDX_VAR_COD[0] ECU_ADDRESS 0xd0008b40 FORMAT "%3.0" /end MEASUREMENT
/begin MEASUREMENT idx_var_cod[1] "changing index of vehicle configuration code via tester" UBYTE _CNV_A_R_LINEAR_____0_CM 1 100. 0. 255. DISPLAY_IDENTIFIER IDX_VAR_COD[1] ECU_ADDRESS 0xd0008b41 FORMAT "%3.0" /end MEASUREMENT
/begin MEASUREMENT vin_sho[0] "short vehicle identification number" UBYTE _CNV_A_R_LINEAR_____0_CM 1 100. 0. 255. DISPLAY_IDENTIFIER VIN_SHO[0] ECU_ADDRESS 0xd0008b42 FORMAT "%3.0" /end MEASUREMENT
/begin MEASUREMENT vin_sho[1] "short vehicle identification number" UBYTE _CNV_A_R_LINEAR_____0_CM 1 100. 0. 255. DISPLAY_IDENTIFIER VIN_SHO[1] ECU_ADDRESS 0xd0008b43 FORMAT "%3.0" /end MEASUREMENT
/begin MEASUREMENT vin_sho[2] "short vehicle identification number" UBYTE _CNV_A_R_LINEAR_____0_CM 1 100. 0. 255. DISPLAY_IDENTIFIER VIN_SHO[2] ECU_ADDRESS 0xd0008b44 FORMAT "%3.0" /end MEASUREMENT
/begin MEASUREMENT vin_sho[3] "short vehicle identification number" UBYTE _CNV_A_R_LINEAR_____0_CM 1 100. 0. 255. DISPLAY_IDENTIFIER VIN_SHO[3] ECU_ADDRESS 0xd0008b45 FORMAT "%3.0" /end MEASUREMENT
/begin MEASUREMENT vin_sho[4] "short vehicle identification number" UBYTE _CNV_A_R_LINEAR_____0_CM 1 100. 0. 255. DISPLAY_IDENTIFIER VIN_SHO[4] ECU_ADDRESS 0xd0008b46 FORMAT "%3.0" /end MEASUREMENT
/begin MEASUREMENT vin_sho[5] "short vehicle identification number" UBYTE _CNV_A_R_LINEAR_____0_CM 1 100. 0. 255. DISPLAY_IDENTIFIER VIN_SHO[5] ECU_ADDRESS 0xd0008b47 FORMAT "%3.0" /end MEASUREMENT
/begin MEASUREMENT vin_sho[6] "short vehicle identification number" UBYTE _CNV_A_R_LINEAR_____0_CM 1 100. 0. 255. DISPLAY_IDENTIFIER VIN_SHO[6] ECU_ADDRESS 0xd0008b48 FORMAT "%3.0" /end MEASUREMENT
/begin MEASUREMENT prot_conf_idx_ext_req "Selected data transmission protocol  via tester( 0/1 - 15765-4, 2 -14230 )" UBYTE _CNV_A_R_LINEAR_____0_CM 1 100. 0. 2. DISPLAY_IDENTIFIER PROT_CONF_IDX_EXT_REQ ECU_ADDRESS 0xd0008b4d FORMAT "%1.0" /end MEASUREMENT
/begin AXIS_PTS ldp_vs_ip_clrc_amp_plaus "" 0xa08092ee vs _REC_AXS_20_u1 255. _CNV_A_R_LINEAR_____6_CM 4 0. 255. FORMAT "%3.0" /end AXIS_PTS
/begin MEASUREMENT lv_inh_diag_amp_plaus "Inhibition of AMP_PLAUS diagnosis" UBYTE _CNV_S_2_RANGE__0___1_CM 1 100. 0. 1. DISPLAY_IDENTIFIER LV_INH_DIAG_AMP_PLAUS ECU_ADDRESS 0xd0008e78 BIT_MASK 0x1 /end MEASUREMENT
/begin MEASUREMENT state_rbm_amp_plaus "Interface of AMP_PLAUS monitor with the Rate-Based Monitoring statistics" UBYTE _CNV_A_R_LINEAR_____0_CM 1 100. 0. 7. DISPLAY_IDENTIFIER STATE_RBM_AMP_PLAUS ECU_ADDRESS 0xd0008e79 FORMAT "%2.0" /end MEASUREMENT
/begin AXIS_PTS ldp_tco_st_ip_fac_fup_sp_ch "Factor for fuel pressure setpoint during (MPLH)   catalyst heating" 0xa0805842 tco_st _REC_AXS_20_u1 190.5 _CNV_A_R_LINEAR_____17_CM 4 -48. 142.5 FORMAT "%5.1" /end AXIS_PTS
/begin AXIS_PTS ldp_t_ast_ip_fac_fup_sp_ch "Factor for fuel pressure setpoint during (MPLH)   catalyst heating" 0xa0805814 t_ast _REC_AXS_20_u2 6553.5 _CNV_A_R_LINEAR_____4_CM 6 0. 6553.5 FORMAT "%6.1" /end AXIS_PTS
/begin AXIS_PTS ldp_n_32_ip_fup_sp_ch "Fuel pressure setpoint for catalyst heating   used for MPLH mode" 0xa08057a6 n_32 _REC_AXS_20_u1 8160. _CNV_A_R_LINEAR_____10_CM 6 0. 8160. FORMAT "%4.0" /end AXIS_PTS
/begin AXIS_PTS ldp_tqi_req_tra_ip_fup_sp_ch "Fuel pressure setpoint for catalyst heating   used for MPLH mode" 0xa0805898 tqi_req_tra _REC_AXS_20_u2 1023.96875 _CNV_A_R_LINEAR_____31_CM 6 0. 1023.96875 FORMAT "%7.2" /end AXIS_PTS
/begin CHARACTERISTIC ip_fac_fup_sp_ch "Factor for fuel pressure setpoint during (MPLH)   catalyst heating" MAP 0xa0805cc8 _REC_MAP_20_u1_u1_u2 0.99609375 _CNV_A_R_LINEAR_____185_CM 0. 0.99609375 DISPLAY_IDENTIFIER IP_FAC_FUP_SP_CH FORMAT "%5.3"
 /begin AXIS_DESCR COM_AXIS tco_st _CNV_A_R_LINEAR_____17_CM 4 -48. 142.5 FORMAT "%5.1" AXIS_PTS_REF ldp_tco_st_ip_fac_fup_sp_ch /end AXIS_DESCR
 /begin AXIS_DESCR COM_AXIS t_ast _CNV_A_R_LINEAR_____4_CM 6 0. 6553.5 FORMAT "%6.1" AXIS_PTS_REF ldp_t_ast_ip_fac_fup_sp_ch /end AXIS_DESCR
/end CHARACTERISTIC
/begin CHARACTERISTIC ip_fup_sp_ch "Fuel pressure setpoint for catalyst heating   used for MPLH mode" MAP 0xa0810890 _REC_MAP_20_u2_u1_u2 347776. _CNV_A_R_LINEAR_____171_CM 0. 347776. DISPLAY_IDENTIFIER IP_FUP_SP_CH FORMAT "%6.0"
 /begin AXIS_DESCR COM_AXIS n_32 _CNV_A_R_LINEAR_____10_CM 6 0. 8160. FORMAT "%4.0" AXIS_PTS_REF ldp_n_32_ip_fup_sp_ch /end AXIS_DESCR
 /begin AXIS_DESCR COM_AXIS tqi_req_tra _CNV_A_R_LINEAR_____31_CM 6 0. 1023.96875 FORMAT "%7.2" AXIS_PTS_REF ldp_tqi_req_tra_ip_fup_sp_ch /end AXIS_DESCR
/end CHARACTERISTIC
/begin MEASUREMENT lv_err_rly_crcv_heat "Boolean for error currently present on RLY_CRCV_HEAT" UBYTE _CNV_S_2_RANGE__0___1_CM 1 100. 0. 1. DISPLAY_IDENTIFIER LV_ERR_RLY_CRCV_HEAT ECU_ADDRESS 0xd0007f87 BIT_MASK 0x1 /end MEASUREMENT
/begin MEASUREMENT cdn_diag_rly_crcv_heat "Activation conditions for rly_crcv_heat" UBYTE _CNV_A_R_LINEAR_____0_CM 1 100. 0. 255. DISPLAY_IDENTIFIER CDN_DIAG_RLY_CRCV_HEAT ECU_ADDRESS 0xd0000514 FORMAT "%3.0" /end MEASUREMENT
/begin MEASUREMENT lv_inh_diag_rly_crcv_heat "Inhibit diagnosis rly_crcv_heat" UBYTE _CNV_S_2_RANGE__0___1_CM 1 100. 0. 1. DISPLAY_IDENTIFIER LV_INH_DIAG_RLY_CRCV_HEAT ECU_ADDRESS 0xd0008ddc BIT_MASK 0x1 /end MEASUREMENT
/begin CHARACTERISTIC c_fac_k_fil_acr_ctl "Pre-Filter amplification of the ACR position controlller" VALUE 0xa0800754 _REC_VAL_20_u2 0.9999847412109381 _CNV_A_R_LINEAR_____89_CM 0. 0.9999847412109381 DISPLAY_IDENTIFIER C_FAC_K_FIL_ACR_CTL FORMAT "%10.9" /end CHARACTERISTIC
/begin CHARACTERISTIC c_fac_opg_sp_acr "Weighting factor for setpoint rate limitation of the ACR position controller" VALUE 0xa0800756 _REC_VAL_20_u1 1. _CNV_A_R_LINEAR_____803_CM 0. 1. DISPLAY_IDENTIFIER C_FAC_OPG_SP_ACR FORMAT "%7.5" /end CHARACTERISTIC
/begin MEASUREMENT loc_state_adaption "" UBYTE _CNV_A_R_LINEAR_____0_CM 1 100. 0. 255. DISPLAY_IDENTIFIER LOC_STATE_ADAPTION ECU_ADDRESS 0xd00004e0 FORMAT "%1.0" /end MEASUREMENT
/begin CHARACTERISTIC c_ccp_pt_act "Security pattern to activate the CCP on powertrain CAN" VALUE 0xa080c664 _REC_VAL_20_u2 65535. _CNV_A_R_LINEAR_____0_CM 0. 65535. DISPLAY_IDENTIFIER C_CCP_PT_ACT FORMAT "%5.0" /end CHARACTERISTIC
/begin AXIS_PTS ldp_state_vit_id_state_srv_9 "" 0xa0808152 NO_INPUT_QUANTITY _REC_AXS_20_u1 255. _CNV_A_R_LINEAR_____50_CM 4 0. 255. /end AXIS_PTS
/begin AXIS_PTS ldp_mff_mon2_ip_tqi_cus_mon2 "" 0xa080094c online_dummy _REC_AXS_20_u2 1389. _CNV_A_R_LINEAR_____111_CM 8 0. 1389. FORMAT "%7.2" /end AXIS_PTS
/begin AXIS_PTS ldp_maf_mon2_ip_iga_ref_mon2 "" 0xa080092c online_dummy _REC_AXS_20_u1 1389. _CNV_A_R_LINEAR_____15_CM 8 0. 1389. FORMAT "%4.0" /end AXIS_PTS
/begin MEASUREMENT lv_cdn_rbm_diag_t_es "Individual diagnosis condition for T_ES diagnosis" UBYTE _CNV_S_2_RANGE__0___1_CM 1 100. 0. 1. DISPLAY_IDENTIFIER LV_CDN_RBM_DIAG_T_ES ECU_ADDRESS 0xd0000c4c BIT_MASK 0x1 /end MEASUREMENT
/begin AXIS_PTS ldp_t_per_maf_frq_ofs "" 0xa0813928 online_dummy _REC_AXS_20_u2 65535. _CNV_A_R_LINEAR_____410_CM 256 0. 65535. FORMAT "%5.0" /end AXIS_PTS
/begin MEASUREMENT tcc_com_2_icl "Alive counter for communication on FA-CAN" UBYTE _CNV_A_R_LINEAR_____50_CM 1 100. 0. 14. DISPLAY_IDENTIFIER TCC_COM_2_ICL ECU_ADDRESS 0xd000854c FORMAT "%2.0" /end MEASUREMENT
/begin MEASUREMENT lv_err_com_2_t_icl "Present error communication bus 2 ( FA-CAN )" UBYTE _CNV_S_2_RANGE__0___1_CM 1 100. 0. 1. DISPLAY_IDENTIFIER LV_ERR_COM_2_T_ICL ECU_ADDRESS 0xd0008083 BIT_MASK 0x1 /end MEASUREMENT
/begin MEASUREMENT ctr_tout_com_2_t_icl "Diagnosis counter for timeout counter error symptom detection" UBYTE _CNV_A_R_LINEAR_____0_CM 1 100. 0. 255. DISPLAY_IDENTIFIER CTR_TOUT_COM_2_T_ICL ECU_ADDRESS 0xd000850e FORMAT "%3.0" /end MEASUREMENT
/begin MEASUREMENT lv_err_com_2_km_icl "Present error communication bus 2 ( FA-CAN )" UBYTE _CNV_S_2_RANGE__0___1_CM 1 100. 0. 1. DISPLAY_IDENTIFIER LV_ERR_COM_2_KM_ICL ECU_ADDRESS 0xd0008082 BIT_MASK 0x1 /end MEASUREMENT
/begin MEASUREMENT ctr_tout_com_2_km_icl "Diagnosis counter for timeout counter error symptom detection" UBYTE _CNV_A_R_LINEAR_____0_CM 1 100. 0. 255. DISPLAY_IDENTIFIER CTR_TOUT_COM_2_KM_ICL ECU_ADDRESS 0xd0008506 FORMAT "%3.0" /end MEASUREMENT
/begin MEASUREMENT lv_err_com_2_t_absl_icl "Present error communication bus 2 ( FA-CAN )" UBYTE _CNV_S_2_RANGE__0___1_CM 1 100. 0. 1. DISPLAY_IDENTIFIER LV_ERR_COM_2_T_ABSL_ICL ECU_ADDRESS 0xd0008087 BIT_MASK 0x1 /end MEASUREMENT
/begin MEASUREMENT lv_err_com_2_icl "Present error communication bus 2 ( FA-CAN )" UBYTE _CNV_S_2_RANGE__0___1_CM 1 100. 0. 1. DISPLAY_IDENTIFIER LV_ERR_COM_2_ICL ECU_ADDRESS 0xd000808e BIT_MASK 0x1 /end MEASUREMENT
/begin MEASUREMENT ctr_tout_com_2_icl "Diagnosis counter for timeout counter error symptom detection" UBYTE _CNV_A_R_LINEAR_____0_CM 1 100. 0. 255. DISPLAY_IDENTIFIER CTR_TOUT_COM_2_ICL ECU_ADDRESS 0xd0008522 FORMAT "%3.0" /end MEASUREMENT
/begin MEASUREMENT ctr_tcc_com_2_icl "Diagnosis counter for alive-counter error symptom detection" UBYTE _CNV_A_R_LINEAR_____0_CM 1 100. 0. 255. DISPLAY_IDENTIFIER CTR_TCC_COM_2_ICL ECU_ADDRESS 0xd0008520 FORMAT "%3.0" /end MEASUREMENT
/begin MEASUREMENT lv_err_com_2_t_clk "Present error communication on bus 2 ( FA-CAN )" UBYTE _CNV_S_2_RANGE__0___1_CM 1 100. 0. 1. DISPLAY_IDENTIFIER LV_ERR_COM_2_T_CLK ECU_ADDRESS 0xd0008085 BIT_MASK 0x1 /end MEASUREMENT
/begin MEASUREMENT ctr_tout_com_2_t_clk "Diagnosis counter for timeout counter error symptom detection" UBYTE _CNV_A_R_LINEAR_____0_CM 1 100. 0. 255. DISPLAY_IDENTIFIER CTR_TOUT_COM_2_T_CLK ECU_ADDRESS 0xd000852a FORMAT "%3.0" /end MEASUREMENT
/begin MEASUREMENT t_wait_absv_com "timer for incrementing T_ABSV_COM" UBYTE _CNV_A_R_LINEAR_____4_CM 1 100. 0. 25.5 DISPLAY_IDENTIFIER T_WAIT_ABSV_COM ECU_ADDRESS 0xd0001314 FORMAT "%4.1" /end MEASUREMENT
/begin MEASUREMENT lv_err_com_2_tam_icl "" UBYTE _CNV_S_2_RANGE__0___1_CM 1 100. 0. 1. DISPLAY_IDENTIFIER LV_ERR_COM_2_TAM_ICL ECU_ADDRESS 0xd0008084 BIT_MASK 0x1 /end MEASUREMENT
/begin MEASUREMENT ctr_tout_com_2_tam_icl "Diagnosis counter for timeout counter error symptom detection" UBYTE _CNV_A_R_LINEAR_____0_CM 1 100. 0. 255. DISPLAY_IDENTIFIER CTR_TOUT_COM_2_TAM_ICL ECU_ADDRESS 0xd00084ee FORMAT "%3.0" /end MEASUREMENT
/begin AXIS_PTS ldp_nmot_klphdrn_rb_0 "" 0xa08081f0 nmot_rb _REC_AXS_20_u1 10200. _CNV_A_R_LINEAR_____905_CM 8 0. 10200. FORMAT "%6.0" /end AXIS_PTS
/begin AXIS_PTS ldp_nmot_klphdrn_rb_1 "" 0xa08083c0 nmot_rb _REC_AXS_20_u1 10200. _CNV_A_R_LINEAR_____905_CM 8 0. 10200. FORMAT "%6.0" /end AXIS_PTS
/begin AXIS_PTS ldp_nmot_fwphdr_rb_0 "" 0xa08081d4 nmot_rb _REC_AXS_20_u1 10200. _CNV_A_R_LINEAR_____905_CM 8 0. 10200. FORMAT "%6.0" /end AXIS_PTS
/begin AXIS_PTS ldp_nmot_fwphdr_rb_1 "" 0xa08083a4 nmot_rb _REC_AXS_20_u1 10200. _CNV_A_R_LINEAR_____905_CM 8 0. 10200. FORMAT "%6.0" /end AXIS_PTS
/begin AXIS_PTS ldp_nmot_fwihdr_rb_1 "" 0xa0808398 nmot_rb _REC_AXS_20_u1 10200. _CNV_A_R_LINEAR_____905_CM 8 0. 10200. FORMAT "%6.0" /end AXIS_PTS
/begin AXIS_PTS spd06hdsw_rb_0 "" 0xa0808264 prdiff_w_rb[0] _REC_AXS_20_u2 32.7675 _CNV_A_R_LINEAR_____909_CM 8 -16.384 16.3835 FORMAT "%8.4" /end AXIS_PTS
/begin AXIS_PTS spd06hdsw_rb_1 "" 0xa0808428 prdiff_w_rb[1] _REC_AXS_20_u2 32.7675 _CNV_A_R_LINEAR_____909_CM 8 -16.384 16.3835 FORMAT "%8.4" /end AXIS_PTS
/begin AXIS_PTS snm08hduw_rb_0 "" 0xa0808250 nmot_w_rb _REC_AXS_20_u2 16383.75 _CNV_A_R_LINEAR_____170_CM 8 0. 16383.75 FORMAT "%8.2" /end AXIS_PTS
/begin AXIS_PTS snm08hduw_rb_1 "" 0xa0808414 nmot_w_rb _REC_AXS_20_u2 16383.75 _CNV_A_R_LINEAR_____170_CM 8 0. 16383.75 FORMAT "%8.2" /end AXIS_PTS
/begin AXIS_PTS spr06hduw_rb_0 "" 0xa0808278 prsoll_w_rb[0] _REC_AXS_20_u2 32.7675 _CNV_A_R_LINEAR_____801_CM 6 0. 32.7675 FORMAT "%7.4" /end AXIS_PTS
/begin AXIS_PTS spr06hduw_rb_1 "" 0xa080843c prsoll_w_rb[1] _REC_AXS_20_u2 32.7675 _CNV_A_R_LINEAR_____801_CM 6 0. 32.7675 FORMAT "%7.4" /end AXIS_PTS
/begin AXIS_PTS ldp_nmot_w_kftamsv_rb_0 "" 0xa08081fc nmot_w_rb _REC_AXS_20_u2 16383.75 _CNV_A_R_LINEAR_____170_CM 8 0. 16383.75 FORMAT "%8.2" /end AXIS_PTS
/begin AXIS_PTS ldp_nmot_w_kftamsv_rb_1 "" 0xa08083cc nmot_w_rb _REC_AXS_20_u2 16383.75 _CNV_A_R_LINEAR_____170_CM 8 0. 16383.75 FORMAT "%8.2" /end AXIS_PTS
/begin AXIS_PTS ldp_ubsqf_w_kftamsv_rb_0 "" 0xa0808240 ubsqf_w_rb _REC_AXS_20_u2 25.59960938 _CNV_A_R_LINEAR_____907_CM 6 0. 25.59960938 FORMAT "%9.6" /end AXIS_PTS
/begin AXIS_PTS ldp_ubsqf_w_kftamsv_rb_1 "" 0xa0808404 ubsqf_w_rb _REC_AXS_20_u2 25.59960938 _CNV_A_R_LINEAR_____907_CM 6 0. 25.59960938 FORMAT "%9.6" /end AXIS_PTS
/begin AXIS_PTS ldp_ubsqf_klvzmsv_rb_1 "" 0xa08083fa ubsqf_rb _REC_AXS_20_u1 25.5 _CNV_A_R_LINEAR_____425_CM 6 0. 25.5 FORMAT "%4.1" /end AXIS_PTS
/begin AXIS_PTS ldp_tmsvm_klvzmsvt_rb_1 "" 0xa08083e6 tmsvm_rb[1] _REC_AXS_20_u1 191.25 _CNV_A_R_LINEAR_____17_CM 3 -48. 143.25 FORMAT "%5.1" /end AXIS_PTS
/begin AXIS_PTS ldp_tmsvm_klvzmsvt_rb_0 "" 0xa0808216 tmsvm_rb[0] _REC_AXS_20_u1 191.25 _CNV_A_R_LINEAR_____17_CM 3 -48. 143.25 FORMAT "%5.1" /end AXIS_PTS
/begin AXIS_PTS ldp_nmot_fwihdr_rb_0 "" 0xa08081c8 nmot_rb _REC_AXS_20_u1 10200. _CNV_A_R_LINEAR_____905_CM 8 0. 10200. FORMAT "%6.0" /end AXIS_PTS
/begin AXIS_PTS ldp_dwmsvd_kfvzmsvdw_rb_0 "" 0xa08081bc dwmsvd_w_rb[0] _REC_AXS_20_u2 6553.5 _CNV_A_R_LINEAR_____910_CM 4 -3276.8 3276.7 FORMAT "%7.1" /end AXIS_PTS
/begin AXIS_PTS ldp_dwmsvd_kfvzmsvdw_rb_1 "" 0xa080838c dwmsvd_w_rb[1] _REC_AXS_20_u2 6553.5 _CNV_A_R_LINEAR_____910_CM 4 -3276.8 3276.7 FORMAT "%7.1" /end AXIS_PTS
/begin AXIS_PTS ldp_nmot_kfvzmsvdw_rb_0 "" 0xa08081de nmot_rb _REC_AXS_20_u1 10200. _CNV_A_R_LINEAR_____905_CM 4 0. 10200. FORMAT "%6.0" /end AXIS_PTS
/begin AXIS_PTS ldp_nmot_kfvzmsvdw_rb_1 "" 0xa08083ae nmot_rb _REC_AXS_20_u1 10200. _CNV_A_R_LINEAR_____905_CM 4 0. 10200. FORMAT "%6.0" /end AXIS_PTS
/begin AXIS_PTS ldp_ubsqf_klvzmsv_rb_0 "" 0xa0808236 ubsqf_rb _REC_AXS_20_u1 25.5 _CNV_A_R_LINEAR_____425_CM 6 0. 25.5 FORMAT "%4.1" /end AXIS_PTS
/begin AXIS_PTS ldp_ubsqf_kltamsvub_rb "" 0xa080822a ubsqf_rb _REC_AXS_20_u1 25.5 _CNV_A_R_LINEAR_____425_CM 6 0. 25.5 FORMAT "%4.1" /end AXIS_PTS
/begin AXIS_PTS ldp_tnse_w_klftmsv_rb_0 "" 0xa080821c tnse_w_rb _REC_AXS_20_u2 6553.5 _CNV_A_R_LINEAR_____4_CM 4 0. 6553.5 FORMAT "%6.1" /end AXIS_PTS
/begin AXIS_PTS ldp_tnse_w_klftmsv_rb_1 "" 0xa08083ec tnse_w_rb _REC_AXS_20_u2 6553.5 _CNV_A_R_LINEAR_____4_CM 4 0. 6553.5 FORMAT "%6.1" /end AXIS_PTS
/begin AXIS_PTS ldp_nmot_klnmtmsv_rb_0 "" 0xa08081ea nmot_rb _REC_AXS_20_u1 10200. _CNV_A_R_LINEAR_____905_CM 4 0. 10200. FORMAT "%6.0" /end AXIS_PTS
/begin AXIS_PTS ldp_nmot_klnmtmsv_rb_1 "" 0xa08083ba nmot_rb _REC_AXS_20_u1 10200. _CNV_A_R_LINEAR_____905_CM 4 0. 10200. FORMAT "%6.0" /end AXIS_PTS
/begin AXIS_PTS ldp_tfuelsq_klfvstgtf_rb_0 "" 0xa080820e tfuelsq_rb _REC_AXS_20_u1 191.25 _CNV_A_R_LINEAR_____17_CM 3 -48. 143.25 FORMAT "%5.1" /end AXIS_PTS
/begin AXIS_PTS ldp_tfuelsq_klfvstgtf_rb_1 "" 0xa08083de tfuelsq_rb _REC_AXS_20_u1 191.25 _CNV_A_R_LINEAR_____17_CM 3 -48. 143.25 FORMAT "%5.1" /end AXIS_PTS
/begin AXIS_PTS ldp_tfuelsq_klfvstotf_rb_0 "" 0xa0808212 tfuelsq_rb _REC_AXS_20_u1 191.25 _CNV_A_R_LINEAR_____17_CM 3 -48. 143.25 FORMAT "%5.1" /end AXIS_PTS
/begin AXIS_PTS ldp_tfuelsq_klfvstotf_rb_1 "" 0xa08083e2 tfuelsq_rb _REC_AXS_20_u1 191.25 _CNV_A_R_LINEAR_____17_CM 3 -48. 143.25 FORMAT "%5.1" /end AXIS_PTS
/begin AXIS_PTS ldp_nmot_kfwhzmsv_rb_0 "" 0xa08081e4 nmot_rb _REC_AXS_20_u1 10200. _CNV_A_R_LINEAR_____905_CM 5 0. 10200. FORMAT "%6.0" /end AXIS_PTS
/begin AXIS_PTS ldp_nmot_kfwhzmsv_rb_1 "" 0xa08083b4 nmot_rb _REC_AXS_20_u1 10200. _CNV_A_R_LINEAR_____905_CM 5 0. 10200. FORMAT "%6.0" /end AXIS_PTS
/begin AXIS_PTS ldp_ubsqf_kfwhzmsv_rb_0 "" 0xa0808226 ubsqf_rb _REC_AXS_20_u1 25.5 _CNV_A_R_LINEAR_____425_CM 3 0. 25.5 FORMAT "%4.1" /end AXIS_PTS
/begin AXIS_PTS ldp_ubsqf_kfwhzmsv_rb_1 "" 0xa08083f6 ubsqf_rb _REC_AXS_20_u1 25.5 _CNV_A_R_LINEAR_____425_CM 3 0. 25.5 FORMAT "%4.1" /end AXIS_PTS
/begin AXIS_PTS ldp_ubsqf_kltamsvubs_rb "" 0xa0808232 ubsqf_rb _REC_AXS_20_u1 25.5 _CNV_A_R_LINEAR_____425_CM 2 0. 25.5 FORMAT "%4.1" /end AXIS_PTS
/begin MEASUREMENT lv_err_com_2_cas_2 "Present error communication bus 2 ( FA-CAN )" UBYTE _CNV_S_2_RANGE__0___1_CM 1 100. 0. 1. DISPLAY_IDENTIFIER LV_ERR_COM_2_CAS_2 ECU_ADDRESS 0xd0008080 BIT_MASK 0x1 /end MEASUREMENT
/begin MEASUREMENT ctr_tout_com_2_cas_2 "Diagnosis counter for timeout counter error symptom detection" UBYTE _CNV_A_R_LINEAR_____0_CM 1 100. 0. 255. DISPLAY_IDENTIFIER CTR_TOUT_COM_2_CAS_2 ECU_ADDRESS 0xd000850a FORMAT "%3.0" /end MEASUREMENT
/begin MEASUREMENT ctr_tcc_com_2_cas_2 "Diagnosis counter for alive counter error symptom detection" UBYTE _CNV_A_R_LINEAR_____0_CM 1 100. 0. 255. DISPLAY_IDENTIFIER CTR_TCC_COM_2_CAS_2 ECU_ADDRESS 0xd0008508 FORMAT "%3.0" /end MEASUREMENT
/begin MEASUREMENT ctr_crc_com_2_cas_2 "Diagnosis counter for checksum counter error symptom detection" UBYTE _CNV_A_R_LINEAR_____0_CM 1 100. 0. 255. DISPLAY_IDENTIFIER CTR_CRC_COM_2_CAS_2 ECU_ADDRESS 0xd0008509 FORMAT "%3.0" /end MEASUREMENT
/begin MEASUREMENT lv_err_com_2_cas "Present error communication bus 2 ( FA-CAN )" UBYTE _CNV_S_2_RANGE__0___1_CM 1 100. 0. 1. DISPLAY_IDENTIFIER LV_ERR_COM_2_CAS ECU_ADDRESS 0xd0008088 BIT_MASK 0x1 /end MEASUREMENT
/begin MEASUREMENT lv_err_com_2_pow_off "Present error communication on bus 2 ( FA-CAN )" UBYTE _CNV_S_2_RANGE__0___1_CM 1 100. 0. 1. DISPLAY_IDENTIFIER LV_ERR_COM_2_POW_OFF ECU_ADDRESS 0xd000808a BIT_MASK 0x1 /end MEASUREMENT
/begin MEASUREMENT ctr_tout_com_2_pow_off "Diagnosis counter for timeout counter error symptom detection" UBYTE _CNV_A_R_LINEAR_____0_CM 1 100. 0. 255. DISPLAY_IDENTIFIER CTR_TOUT_COM_2_POW_OFF ECU_ADDRESS 0xd00084fe FORMAT "%3.0" /end MEASUREMENT
/begin MEASUREMENT lv_err_com_2_cdn_door "Present error communication on bus 2 ( FA-CAN )" UBYTE _CNV_S_2_RANGE__0___1_CM 1 100. 0. 1. DISPLAY_IDENTIFIER LV_ERR_COM_2_CDN_DOOR ECU_ADDRESS 0xd0008090 BIT_MASK 0x1 /end MEASUREMENT
/begin MEASUREMENT ctr_tout_com_2_cdn_door "Diagnosis counter for timeout counter error symptom detection" UBYTE _CNV_A_R_LINEAR_____0_CM 1 100. 0. 255. DISPLAY_IDENTIFIER CTR_TOUT_COM_2_CDN_DOOR ECU_ADDRESS 0xd0008526 FORMAT "%3.0" /end MEASUREMENT
/begin MEASUREMENT state_veh "State of vehicle" UBYTE _CNV_A_R_LINEAR_____50_CM 1 100. 0. 255. DISPLAY_IDENTIFIER STATE_VEH ECU_ADDRESS 0xd0008578 /end MEASUREMENT
/begin MEASUREMENT lv_err_com_2_state_veh "Present error communication on bus 2 (FA-CAN)" UBYTE _CNV_S_2_RANGE__0___1_CM 1 100. 0. 1. DISPLAY_IDENTIFIER LV_ERR_COM_2_STATE_VEH ECU_ADDRESS 0xd000807f BIT_MASK 0x1 /end MEASUREMENT
/begin MEASUREMENT lv_err_com_2_gear_rev "Present error communication on bus 2 (FA-CAN)" UBYTE _CNV_S_2_RANGE__0___1_CM 1 100. 0. 1. DISPLAY_IDENTIFIER LV_ERR_COM_2_GEAR_REV ECU_ADDRESS 0xd000808f BIT_MASK 0x1 /end MEASUREMENT
/begin MEASUREMENT lv_err_com_2_trl "Present error communication on bus 2 (FA-CAN)" UBYTE _CNV_S_2_RANGE__0___1_CM 1 100. 0. 1. DISPLAY_IDENTIFIER LV_ERR_COM_2_TRL ECU_ADDRESS 0xd000808c BIT_MASK 0x1 /end MEASUREMENT
/begin MEASUREMENT lv_err_com_2_hiv "Present error communication on bus 2 (FA-CAN)" UBYTE _CNV_S_2_RANGE__0___1_CM 1 100. 0. 1. DISPLAY_IDENTIFIER LV_ERR_COM_2_HIV ECU_ADDRESS 0xd000808d BIT_MASK 0x1 /end MEASUREMENT
/begin MEASUREMENT ctr_tout_com_2_gear_rev "Diagnosis counter for timeout counter error symptom detection" UBYTE _CNV_A_R_LINEAR_____0_CM 1 100. 0. 255. DISPLAY_IDENTIFIER CTR_TOUT_COM_2_GEAR_REV ECU_ADDRESS 0xd000851e FORMAT "%3.0" /end MEASUREMENT
/begin MEASUREMENT ctr_tout_com_2_state_veh "Diagnosis counter for timeout counter error symptom detection" UBYTE _CNV_A_R_LINEAR_____0_CM 1 100. 0. 255. DISPLAY_IDENTIFIER CTR_TOUT_COM_2_STATE_VEH ECU_ADDRESS 0xd0008502 FORMAT "%3.0" /end MEASUREMENT
/begin MEASUREMENT ctr_tout_com_2_trl "Diagnosis counter for timeout counter error symptom detection" UBYTE _CNV_A_R_LINEAR_____0_CM 1 100. 0. 255. DISPLAY_IDENTIFIER CTR_TOUT_COM_2_TRL ECU_ADDRESS 0xd000851a FORMAT "%3.0" /end MEASUREMENT
/begin MEASUREMENT ctr_tout_veh_state "Timeout counter for CAN message after rest" UBYTE _CNV_A_R_LINEAR_____0_CM 1 100. 0. 15. DISPLAY_IDENTIFIER CTR_TOUT_VEH_STATE ECU_ADDRESS 0xd0008579 FORMAT "%2.0" /end MEASUREMENT
/begin MEASUREMENT ctr_tout_com_2_efp_crash "Diagnosis counter for timeout counter error symptom detection" UBYTE _CNV_A_R_LINEAR_____0_CM 1 100. 0. 255. DISPLAY_IDENTIFIER CTR_TOUT_COM_2_EFP_CRASH ECU_ADDRESS 0xd00084f6 FORMAT "%3.0" /end MEASUREMENT
/begin MEASUREMENT lv_err_com_1_vs "Present error communication on bus 1 (FlexRay)" UBYTE _CNV_S_2_RANGE__0___1_CM 1 100. 0. 1. DISPLAY_IDENTIFIER LV_ERR_COM_1_VS ECU_ADDRESS 0xd0008078 BIT_MASK 0x1 /end MEASUREMENT
/begin MEASUREMENT lv_err_com_1_tq_pste "Present error communication on bus 1 (FlexRay)" UBYTE _CNV_S_2_RANGE__0___1_CM 1 100. 0. 1. DISPLAY_IDENTIFIER LV_ERR_COM_1_TQ_PSTE ECU_ADDRESS 0xd0008072 BIT_MASK 0x1 /end MEASUREMENT
/begin MEASUREMENT lv_err_com_1_req_tqdw "Present error communication on bus 1 (FlexRay)" UBYTE _CNV_S_2_RANGE__0___1_CM 1 100. 0. 1. DISPLAY_IDENTIFIER LV_ERR_COM_1_REQ_TQDW ECU_ADDRESS 0xd0008071 BIT_MASK 0x1 /end MEASUREMENT
/begin MEASUREMENT lv_err_com_1_ac_lgt "Present error communication on bus 1 (FlexRay)" UBYTE _CNV_S_2_RANGE__0___1_CM 1 100. 0. 1. DISPLAY_IDENTIFIER LV_ERR_COM_1_AC_LGT ECU_ADDRESS 0xd0008075 BIT_MASK 0x1 /end MEASUREMENT
/begin MEASUREMENT lv_err_com_1_ac_trv "Present error communication on bus 1 (FlexRay)" UBYTE _CNV_S_2_RANGE__0___1_CM 1 100. 0. 1. DISPLAY_IDENTIFIER LV_ERR_COM_1_AC_TRV ECU_ADDRESS 0xd0008074 BIT_MASK 0x1 /end MEASUREMENT
/begin MEASUREMENT ctr_tout_com_1_vs "Diagnosis counter for timeout counter error symptom detection" UBYTE _CNV_A_R_LINEAR_____0_CM 1 100. 0. 255. DISPLAY_IDENTIFIER CTR_TOUT_COM_1_VS ECU_ADDRESS 0xd00084ea FORMAT "%3.0" /end MEASUREMENT
/begin MEASUREMENT ctr_tcc_com_1_vs "Diagnosis counter for alive counter error symptom detection" UBYTE _CNV_A_R_LINEAR_____0_CM 1 100. 0. 255. DISPLAY_IDENTIFIER CTR_TCC_COM_1_VS ECU_ADDRESS 0xd00084e8 FORMAT "%3.0" /end MEASUREMENT
/begin MEASUREMENT ctr_crc_com_1_vs "Diagnosis counter for checksum counter error symptom detection" UBYTE _CNV_A_R_LINEAR_____0_CM 1 100. 0. 255. DISPLAY_IDENTIFIER CTR_CRC_COM_1_VS ECU_ADDRESS 0xd00084e9 FORMAT "%3.0" /end MEASUREMENT
/begin MEASUREMENT ctr_tout_com_1_ac_lgt "Diagnosis counter for timeout counter error symptom detection" UBYTE _CNV_A_R_LINEAR_____0_CM 1 100. 0. 255. DISPLAY_IDENTIFIER CTR_TOUT_COM_1_AC_LGT ECU_ADDRESS 0xd00084c2 FORMAT "%3.0" /end MEASUREMENT
/begin MEASUREMENT ctr_tcc_com_1_ac_lgt "Diagnosis counter for alive counter error symptom detection" UBYTE _CNV_A_R_LINEAR_____0_CM 1 100. 0. 255. DISPLAY_IDENTIFIER CTR_TCC_COM_1_AC_LGT ECU_ADDRESS 0xd00084c0 FORMAT "%3.0" /end MEASUREMENT
/begin MEASUREMENT ctr_crc_com_1_ac_lgt "Diagnosis counter for checksum counter error symptom detection" UBYTE _CNV_A_R_LINEAR_____0_CM 1 100. 0. 255. DISPLAY_IDENTIFIER CTR_CRC_COM_1_AC_LGT ECU_ADDRESS 0xd00084c1 FORMAT "%3.0" /end MEASUREMENT
/begin CHARACTERISTIC lc_add_pls_mplh_pls3_ena "Logical constant to enable additive pulse updates of the second pulse during homogeneous triple injection mode" VALUE 0xa08008e1 _REC_VAL_20_u1 1. _CNV_S_2_RANGE__0___1_CM 0. 1. DISPLAY_IDENTIFIER LC_ADD_PLS_MPLH_PLS3_ENA BIT_MASK 0x1 /end CHARACTERISTIC
/begin CHARACTERISTIC c_mod_1_pid_1_diag "Calibration byte which defines the PIDs supported by mode 01 (01h -08h)" VALUE 0xa080bec7 _REC_VAL_20_u1 255. _CNV_A_R_LINEAR_____0_CM 0. 255. DISPLAY_IDENTIFIER C_MOD_1_PID_1_DIAG FORMAT "%3.0" /end CHARACTERISTIC
/begin CHARACTERISTIC c_mod_1_pid_2_diag "Calibration byte which defines the PIDs supported by mode 01 (09h -10h)" VALUE 0xa080bec8 _REC_VAL_20_u1 255. _CNV_A_R_LINEAR_____0_CM 0. 255. DISPLAY_IDENTIFIER C_MOD_1_PID_2_DIAG FORMAT "%3.0" /end CHARACTERISTIC
/begin CHARACTERISTIC c_mod_1_pid_3_diag "Calibration byte which defines the PIDs supported by mode 01 (11h -18h)" VALUE 0xa080bec9 _REC_VAL_20_u1 255. _CNV_A_R_LINEAR_____0_CM 0. 255. DISPLAY_IDENTIFIER C_MOD_1_PID_3_DIAG FORMAT "%3.0" /end CHARACTERISTIC
/begin CHARACTERISTIC c_mod_1_pid_4_diag "Calibration byte which defines the PIDs supported by mode 01 (19h -20h)" VALUE 0xa080beca _REC_VAL_20_u1 255. _CNV_A_R_LINEAR_____0_CM 0. 255. DISPLAY_IDENTIFIER C_MOD_1_PID_4_DIAG FORMAT "%3.0" /end CHARACTERISTIC
/begin CHARACTERISTIC c_mod_1_pid_5_diag "Calibration byte which defines the PIDs supported by mode 01 (21h -28h)" VALUE 0xa080becb _REC_VAL_20_u1 255. _CNV_A_R_LINEAR_____0_CM 0. 255. DISPLAY_IDENTIFIER C_MOD_1_PID_5_DIAG FORMAT "%3.0" /end CHARACTERISTIC
/begin CHARACTERISTIC c_mod_1_pid_6_diag "Calibration byte which defines the PIDs supported by mode 01 (29h -30h)" VALUE 0xa080becc _REC_VAL_20_u1 255. _CNV_A_R_LINEAR_____0_CM 0. 255. DISPLAY_IDENTIFIER C_MOD_1_PID_6_DIAG FORMAT "%3.0" /end CHARACTERISTIC
/begin CHARACTERISTIC c_mod_1_pid_7_diag "Calibration byte which defines the PIDs supported by mode 01 (31h -38h)" VALUE 0xa080becd _REC_VAL_20_u1 255. _CNV_A_R_LINEAR_____0_CM 0. 255. DISPLAY_IDENTIFIER C_MOD_1_PID_7_DIAG FORMAT "%3.0" /end CHARACTERISTIC
/begin CHARACTERISTIC c_mod_2_pid_1_diag "Calibration byte which defines the PIDs supported by mode 02 (01h -08h)" VALUE 0xa080bed3 _REC_VAL_20_u1 255. _CNV_A_R_LINEAR_____0_CM 0. 255. DISPLAY_IDENTIFIER C_MOD_2_PID_1_DIAG FORMAT "%3.0" /end CHARACTERISTIC
/begin CHARACTERISTIC c_mod_2_pid_2_diag "Calibration byte which defines the PIDs supported by mode 02 (09h -10h)" VALUE 0xa080bed4 _REC_VAL_20_u1 255. _CNV_A_R_LINEAR_____0_CM 0. 255. DISPLAY_IDENTIFIER C_MOD_2_PID_2_DIAG FORMAT "%3.0" /end CHARACTERISTIC
/begin CHARACTERISTIC c_mod_2_pid_3_diag "Calibration byte which defines the PIDs supported by mode 02 (11h -18h)" VALUE 0xa080bed5 _REC_VAL_20_u1 255. _CNV_A_R_LINEAR_____0_CM 0. 255. DISPLAY_IDENTIFIER C_MOD_2_PID_3_DIAG FORMAT "%3.0" /end CHARACTERISTIC
/begin CHARACTERISTIC c_obd_req "byte wich indicates the OBD requirements" VALUE 0xa080c062 _REC_VAL_20_u1 255. _CNV_A_R_LINEAR_____0_CM 0. 255. DISPLAY_IDENTIFIER C_OBD_REQ FORMAT "%3.0" /end CHARACTERISTIC
/begin CHARACTERISTIC c_mod_1_pid_8_diag "Calibration byte which defines the PIDs supported by mode 01 (39h -40h)" VALUE 0xa080bece _REC_VAL_20_u1 255. _CNV_A_R_LINEAR_____0_CM 0. 255. DISPLAY_IDENTIFIER C_MOD_1_PID_8_DIAG FORMAT "%3.0" /end CHARACTERISTIC
/begin CHARACTERISTIC c_mod_1_pid_9_diag "Calibration byte which defines the PIDs supported by mode 01 (39h -40h)" VALUE 0xa080becf _REC_VAL_20_u1 255. _CNV_A_R_LINEAR_____0_CM 0. 255. DISPLAY_IDENTIFIER C_MOD_1_PID_9_DIAG FORMAT "%3.0" /end CHARACTERISTIC
/begin CHARACTERISTIC c_mod_1_pid_A_diag "Calibration byte which defines the PIDs supported by mode 01 (39h -40h)" VALUE 0xa080bed0 _REC_VAL_20_u1 255. _CNV_A_R_LINEAR_____0_CM 0. 255. DISPLAY_IDENTIFIER C_MOD_1_PID_A_DIAG FORMAT "%3.0" /end CHARACTERISTIC
/begin CHARACTERISTIC c_mod_1_pid_B_diag "Calibration byte which defines the PIDs supported by mode 01 (39h -40h)" VALUE 0xa080bed1 _REC_VAL_20_u1 255. _CNV_A_R_LINEAR_____0_CM 0. 255. DISPLAY_IDENTIFIER C_MOD_1_PID_B_DIAG FORMAT "%3.0" /end CHARACTERISTIC
/begin CHARACTERISTIC c_mod_1_pid_C_diag "Calibration byte which defines the PIDs supported by mode 01 (39h -40h)" VALUE 0xa080bed2 _REC_VAL_20_u1 255. _CNV_A_R_LINEAR_____0_CM 0. 255. DISPLAY_IDENTIFIER C_MOD_1_PID_C_DIAG FORMAT "%3.0" /end CHARACTERISTIC
/begin CHARACTERISTIC c_mod_2_pid_4_diag "Calibration byte which defines the PIDs supported by mode 02 (19h -20h)" VALUE 0xa080bed6 _REC_VAL_20_u1 255. _CNV_A_R_LINEAR_____0_CM 0. 255. DISPLAY_IDENTIFIER C_MOD_2_PID_4_DIAG FORMAT "%3.0" /end CHARACTERISTIC
/begin MEASUREMENT mod_1_pid_1_diag "" UBYTE _CNV_A_R_LINEAR_____0_CM 1 100. 0. 255. DISPLAY_IDENTIFIER MOD_1_PID_1_DIAG ECU_ADDRESS 0xd0008821 FORMAT "%3.0" /end MEASUREMENT
/begin MEASUREMENT mod_1_pid_2_diag "" UBYTE _CNV_A_R_LINEAR_____0_CM 1 100. 0. 255. DISPLAY_IDENTIFIER MOD_1_PID_2_DIAG ECU_ADDRESS 0xd0008822 FORMAT "%3.0" /end MEASUREMENT
/begin MEASUREMENT mod_1_pid_3_diag "" UBYTE _CNV_A_R_LINEAR_____0_CM 1 100. 0. 255. DISPLAY_IDENTIFIER MOD_1_PID_3_DIAG ECU_ADDRESS 0xd0008823 FORMAT "%3.0" /end MEASUREMENT
/begin MEASUREMENT mod_1_pid_4_diag "" UBYTE _CNV_A_R_LINEAR_____0_CM 1 100. 0. 255. DISPLAY_IDENTIFIER MOD_1_PID_4_DIAG ECU_ADDRESS 0xd0008824 FORMAT "%3.0" /end MEASUREMENT
/begin MEASUREMENT mod_1_pid_5_diag "" UBYTE _CNV_A_R_LINEAR_____0_CM 1 100. 0. 255. DISPLAY_IDENTIFIER MOD_1_PID_5_DIAG ECU_ADDRESS 0xd0008825 FORMAT "%3.0" /end MEASUREMENT
/begin MEASUREMENT mod_1_pid_6_diag "" UBYTE _CNV_A_R_LINEAR_____0_CM 1 100. 0. 255. DISPLAY_IDENTIFIER MOD_1_PID_6_DIAG ECU_ADDRESS 0xd0008826 FORMAT "%3.0" /end MEASUREMENT
/begin MEASUREMENT mod_1_pid_7_diag "" UBYTE _CNV_A_R_LINEAR_____0_CM 1 100. 0. 255. DISPLAY_IDENTIFIER MOD_1_PID_7_DIAG ECU_ADDRESS 0xd0008827 FORMAT "%3.0" /end MEASUREMENT
/begin MEASUREMENT mod_1_pid_8_diag "" UBYTE _CNV_A_R_LINEAR_____0_CM 1 100. 0. 255. DISPLAY_IDENTIFIER MOD_1_PID_8_DIAG ECU_ADDRESS 0xd0008828 FORMAT "%3.0" /end MEASUREMENT
/begin MEASUREMENT mod_1_pid_9_diag "" UBYTE _CNV_A_R_LINEAR_____0_CM 1 100. 0. 255. DISPLAY_IDENTIFIER MOD_1_PID_9_DIAG ECU_ADDRESS 0xd0008829 FORMAT "%3.0" /end MEASUREMENT
/begin MEASUREMENT mod_1_pid_A_diag "" UBYTE _CNV_A_R_LINEAR_____0_CM 1 100. 0. 255. DISPLAY_IDENTIFIER MOD_1_PID_A_DIAG ECU_ADDRESS 0xd000882a FORMAT "%3.0" /end MEASUREMENT
/begin MEASUREMENT mod_1_pid_B_diag "" UBYTE _CNV_A_R_LINEAR_____0_CM 1 100. 0. 255. DISPLAY_IDENTIFIER MOD_1_PID_B_DIAG ECU_ADDRESS 0xd000882b FORMAT "%3.0" /end MEASUREMENT
/begin MEASUREMENT mod_1_pid_C_diag "" UBYTE _CNV_A_R_LINEAR_____0_CM 1 100. 0. 255. DISPLAY_IDENTIFIER MOD_1_PID_C_DIAG ECU_ADDRESS 0xd000882c FORMAT "%3.0" /end MEASUREMENT
/begin MEASUREMENT mod_2_pid_1_diag "" UBYTE _CNV_A_R_LINEAR_____0_CM 1 100. 0. 255. DISPLAY_IDENTIFIER MOD_2_PID_1_DIAG ECU_ADDRESS 0xd000882d FORMAT "%3.0" /end MEASUREMENT
/begin MEASUREMENT mod_2_pid_2_diag "" UBYTE _CNV_A_R_LINEAR_____0_CM 1 100. 0. 255. DISPLAY_IDENTIFIER MOD_2_PID_2_DIAG ECU_ADDRESS 0xd000882e FORMAT "%3.0" /end MEASUREMENT
/begin MEASUREMENT mod_2_pid_3_diag "" UBYTE _CNV_A_R_LINEAR_____0_CM 1 100. 0. 255. DISPLAY_IDENTIFIER MOD_2_PID_3_DIAG ECU_ADDRESS 0xd000882f FORMAT "%3.0" /end MEASUREMENT
/begin MEASUREMENT mod_2_pid_4_diag "" UBYTE _CNV_A_R_LINEAR_____0_CM 1 100. 0. 255. DISPLAY_IDENTIFIER MOD_2_PID_4_DIAG ECU_ADDRESS 0xd0008830 FORMAT "%3.0" /end MEASUREMENT
/begin MEASUREMENT mod_2_pid_5_diag "" UBYTE _CNV_A_R_LINEAR_____0_CM 1 100. 0. 255. DISPLAY_IDENTIFIER MOD_2_PID_5_DIAG ECU_ADDRESS 0xd0008831 FORMAT "%3.0" /end MEASUREMENT
/begin MEASUREMENT mod_2_pid_6_diag "" UBYTE _CNV_A_R_LINEAR_____0_CM 1 100. 0. 255. DISPLAY_IDENTIFIER MOD_2_PID_6_DIAG ECU_ADDRESS 0xd0008832 FORMAT "%3.0" /end MEASUREMENT
/begin MEASUREMENT mod_2_pid_7_diag "" UBYTE _CNV_A_R_LINEAR_____0_CM 1 100. 0. 255. DISPLAY_IDENTIFIER MOD_2_PID_7_DIAG ECU_ADDRESS 0xd0008833 FORMAT "%3.0" /end MEASUREMENT
/begin MEASUREMENT mod_2_pid_8_diag "" UBYTE _CNV_A_R_LINEAR_____0_CM 1 100. 0. 255. DISPLAY_IDENTIFIER MOD_2_PID_8_DIAG ECU_ADDRESS 0xd0008834 FORMAT "%3.0" /end MEASUREMENT
/begin MEASUREMENT mod_2_pid_9_diag "" UBYTE _CNV_A_R_LINEAR_____0_CM 1 100. 0. 255. DISPLAY_IDENTIFIER MOD_2_PID_9_DIAG ECU_ADDRESS 0xd0008835 FORMAT "%3.0" /end MEASUREMENT
/begin MEASUREMENT mod_2_pid_A_diag "" UBYTE _CNV_A_R_LINEAR_____0_CM 1 100. 0. 255. DISPLAY_IDENTIFIER MOD_2_PID_A_DIAG ECU_ADDRESS 0xd0008836 FORMAT "%3.0" /end MEASUREMENT
/begin MEASUREMENT mod_2_pid_B_diag "" UBYTE _CNV_A_R_LINEAR_____0_CM 1 100. 0. 255. DISPLAY_IDENTIFIER MOD_2_PID_B_DIAG ECU_ADDRESS 0xd0008837 FORMAT "%3.0" /end MEASUREMENT
/begin MEASUREMENT mod_2_pid_C_diag "" UBYTE _CNV_A_R_LINEAR_____0_CM 1 100. 0. 255. DISPLAY_IDENTIFIER MOD_2_PID_C_DIAG ECU_ADDRESS 0xd0008838 FORMAT "%3.0" /end MEASUREMENT
/begin MEASUREMENT mod_5_tid_1_diag "" UBYTE _CNV_A_R_LINEAR_____0_CM 1 100. 0. 255. DISPLAY_IDENTIFIER MOD_5_TID_1_DIAG ECU_ADDRESS 0xd0008839 FORMAT "%3.0" /end MEASUREMENT
/begin MEASUREMENT mod_5_tid_2_diag "" UBYTE _CNV_A_R_LINEAR_____0_CM 1 100. 0. 255. DISPLAY_IDENTIFIER MOD_5_TID_2_DIAG ECU_ADDRESS 0xd000883a FORMAT "%3.0" /end MEASUREMENT
/begin MEASUREMENT mod_5_tid_3_diag "" UBYTE _CNV_A_R_LINEAR_____0_CM 1 100. 0. 255. DISPLAY_IDENTIFIER MOD_5_TID_3_DIAG ECU_ADDRESS 0xd000883b FORMAT "%3.0" /end MEASUREMENT
/begin MEASUREMENT mod_5_tid_4_diag "" UBYTE _CNV_A_R_LINEAR_____0_CM 1 100. 0. 255. DISPLAY_IDENTIFIER MOD_5_TID_4_DIAG ECU_ADDRESS 0xd000883c FORMAT "%3.0" /end MEASUREMENT
/begin MEASUREMENT mod_5_tid_5_diag "" UBYTE _CNV_A_R_LINEAR_____0_CM 1 100. 0. 255. DISPLAY_IDENTIFIER MOD_5_TID_5_DIAG ECU_ADDRESS 0xd000883d FORMAT "%3.0" /end MEASUREMENT
/begin MEASUREMENT mod_5_tid_6_diag "" UBYTE _CNV_A_R_LINEAR_____0_CM 1 100. 0. 255. DISPLAY_IDENTIFIER MOD_5_TID_6_DIAG ECU_ADDRESS 0xd000883e FORMAT "%3.0" /end MEASUREMENT
/begin MEASUREMENT mod_5_tid_7_diag "" UBYTE _CNV_A_R_LINEAR_____0_CM 1 100. 0. 255. DISPLAY_IDENTIFIER MOD_5_TID_7_DIAG ECU_ADDRESS 0xd000883f FORMAT "%3.0" /end MEASUREMENT
/begin MEASUREMENT mod_5_tid_8_diag "" UBYTE _CNV_A_R_LINEAR_____0_CM 1 100. 0. 255. DISPLAY_IDENTIFIER MOD_5_TID_8_DIAG ECU_ADDRESS 0xd0008840 FORMAT "%3.0" /end MEASUREMENT
/begin MEASUREMENT mod_5_tid_9_diag "" UBYTE _CNV_A_R_LINEAR_____0_CM 1 100. 0. 255. DISPLAY_IDENTIFIER MOD_5_TID_9_DIAG ECU_ADDRESS 0xd0008841 FORMAT "%3.0" /end MEASUREMENT
/begin MEASUREMENT mod_5_tid_10_diag "" UBYTE _CNV_A_R_LINEAR_____0_CM 1 100. 0. 255. DISPLAY_IDENTIFIER MOD_5_TID_10_DIAG ECU_ADDRESS 0xd0008842 FORMAT "%3.0" /end MEASUREMENT
/begin MEASUREMENT mod_5_tid_11_diag "" UBYTE _CNV_A_R_LINEAR_____0_CM 1 100. 0. 255. DISPLAY_IDENTIFIER MOD_5_TID_11_DIAG ECU_ADDRESS 0xd0008843 FORMAT "%3.0" /end MEASUREMENT
/begin MEASUREMENT mod_5_tid_12_diag "" UBYTE _CNV_A_R_LINEAR_____0_CM 1 100. 0. 255. DISPLAY_IDENTIFIER MOD_5_TID_12_DIAG ECU_ADDRESS 0xd0008844 FORMAT "%3.0" /end MEASUREMENT
/begin MEASUREMENT mod_5_tid_13_diag "" UBYTE _CNV_A_R_LINEAR_____0_CM 1 100. 0. 255. DISPLAY_IDENTIFIER MOD_5_TID_13_DIAG ECU_ADDRESS 0xd0008845 FORMAT "%3.0" /end MEASUREMENT
/begin MEASUREMENT mod_5_tid_14_diag "" UBYTE _CNV_A_R_LINEAR_____0_CM 1 100. 0. 255. DISPLAY_IDENTIFIER MOD_5_TID_14_DIAG ECU_ADDRESS 0xd0008846 FORMAT "%3.0" /end MEASUREMENT
/begin MEASUREMENT mod_5_tid_15_diag "" UBYTE _CNV_A_R_LINEAR_____0_CM 1 100. 0. 255. DISPLAY_IDENTIFIER MOD_5_TID_15_DIAG ECU_ADDRESS 0xd0008847 FORMAT "%3.0" /end MEASUREMENT
/begin MEASUREMENT mod_5_tid_16_diag "" UBYTE _CNV_A_R_LINEAR_____0_CM 1 100. 0. 255. DISPLAY_IDENTIFIER MOD_5_TID_16_DIAG ECU_ADDRESS 0xd0008848 FORMAT "%3.0" /end MEASUREMENT
/begin MEASUREMENT mod_5_tid_17_diag "" UBYTE _CNV_A_R_LINEAR_____0_CM 1 100. 0. 255. DISPLAY_IDENTIFIER MOD_5_TID_17_DIAG ECU_ADDRESS 0xd0008849 FORMAT "%3.0" /end MEASUREMENT
/begin MEASUREMENT mod_5_tid_18_diag "" UBYTE _CNV_A_R_LINEAR_____0_CM 1 100. 0. 255. DISPLAY_IDENTIFIER MOD_5_TID_18_DIAG ECU_ADDRESS 0xd000884a FORMAT "%3.0" /end MEASUREMENT
/begin MEASUREMENT mod_5_tid_19_diag "" UBYTE _CNV_A_R_LINEAR_____0_CM 1 100. 0. 255. DISPLAY_IDENTIFIER MOD_5_TID_19_DIAG ECU_ADDRESS 0xd000884b FORMAT "%3.0" /end MEASUREMENT
/begin MEASUREMENT mod_5_tid_20_diag "" UBYTE _CNV_A_R_LINEAR_____0_CM 1 100. 0. 255. DISPLAY_IDENTIFIER MOD_5_TID_20_DIAG ECU_ADDRESS 0xd000884c FORMAT "%3.0" /end MEASUREMENT
/begin MEASUREMENT mod_6_tid_1_diag "" UBYTE _CNV_A_R_LINEAR_____0_CM 1 100. 0. 255. DISPLAY_IDENTIFIER MOD_6_TID_1_DIAG ECU_ADDRESS 0xd000884d FORMAT "%3.0" /end MEASUREMENT
/begin MEASUREMENT mod_6_tid_2_diag "" UBYTE _CNV_A_R_LINEAR_____0_CM 1 100. 0. 255. DISPLAY_IDENTIFIER MOD_6_TID_2_DIAG ECU_ADDRESS 0xd000884e FORMAT "%3.0" /end MEASUREMENT
/begin MEASUREMENT mod_6_tid_3_diag "" UBYTE _CNV_A_R_LINEAR_____0_CM 1 100. 0. 255. DISPLAY_IDENTIFIER MOD_6_TID_3_DIAG ECU_ADDRESS 0xd000884f FORMAT "%3.0" /end MEASUREMENT
/begin MEASUREMENT mod_6_tid_4_diag "" UBYTE _CNV_A_R_LINEAR_____0_CM 1 100. 0. 255. DISPLAY_IDENTIFIER MOD_6_TID_4_DIAG ECU_ADDRESS 0xd0008850 FORMAT "%3.0" /end MEASUREMENT
/begin MEASUREMENT mod_9_vit_1_diag "" UBYTE _CNV_A_R_LINEAR_____0_CM 1 100. 0. 255. DISPLAY_IDENTIFIER MOD_9_VIT_1_DIAG ECU_ADDRESS 0xd0008871 FORMAT "%3.0" /end MEASUREMENT
/begin MEASUREMENT mod_9_vit_2_diag "" UBYTE _CNV_A_R_LINEAR_____0_CM 1 100. 0. 255. DISPLAY_IDENTIFIER MOD_9_VIT_2_DIAG ECU_ADDRESS 0xd0008872 FORMAT "%3.0" /end MEASUREMENT
/begin MEASUREMENT mod_9_vit_3_diag "" UBYTE _CNV_A_R_LINEAR_____0_CM 1 100. 0. 255. DISPLAY_IDENTIFIER MOD_9_VIT_3_DIAG ECU_ADDRESS 0xd0008873 FORMAT "%3.0" /end MEASUREMENT
/begin MEASUREMENT mod_9_vit_4_diag "" UBYTE _CNV_A_R_LINEAR_____0_CM 1 100. 0. 255. DISPLAY_IDENTIFIER MOD_9_VIT_4_DIAG ECU_ADDRESS 0xd0008874 FORMAT "%3.0" /end MEASUREMENT
/begin MEASUREMENT state_etcu_pos_disp "State position display gearbox" UBYTE _CNV_A_R_LINEAR_____0_CM 1 100. 0. 15. DISPLAY_IDENTIFIER STATE_ETCU_POS_DISP ECU_ADDRESS 0xd00085d9 FORMAT "%2.0" /end MEASUREMENT
/begin MEASUREMENT state_gear_can "State gear selection from gearbox" UBYTE _CNV_A_R_LINEAR_____0_CM 1 100. 0. 15. DISPLAY_IDENTIFIER STATE_GEAR_CAN ECU_ADDRESS 0xd00085d7 FORMAT "%2.0" /end MEASUREMENT
/begin MEASUREMENT state_etcu_gear_disp "State data displaying of gearbox" UBYTE _CNV_A_R_LINEAR_____0_CM 1 100. 0. 15. DISPLAY_IDENTIFIER STATE_ETCU_GEAR_DISP ECU_ADDRESS 0xd00085da FORMAT "%2.0" /end MEASUREMENT
/begin MEASUREMENT state_etcu_lih "State gearbox for starting emergency program" UBYTE _CNV_A_R_LINEAR_____0_CM 1 100. 0. 3. DISPLAY_IDENTIFIER STATE_ETCU_LIH ECU_ADDRESS 0xd00085ed FORMAT "%1.0" /end MEASUREMENT
/begin MEASUREMENT state_lock_st_gb "State interlock starter of gearbox" UBYTE _CNV_A_R_LINEAR_____0_CM 1 100. 0. 3. DISPLAY_IDENTIFIER STATE_LOCK_ST_GB ECU_ADDRESS 0xd00085db FORMAT "%1.0" /end MEASUREMENT
/begin MEASUREMENT state_gs "State activation gear lever" UBYTE _CNV_A_R_LINEAR_____0_CM 1 100. 0. 3. DISPLAY_IDENTIFIER STATE_GS ECU_ADDRESS 0xd00085dd FORMAT "%1.0" /end MEASUREMENT
/begin MEASUREMENT n_gb_mpg "Input shaft speed turbine/gearbox (AT) - mapped signal for routing" UWORD _CNV_A_R_LINEAR_____0_CM 1 100. 0. 65535. DISPLAY_IDENTIFIER N_GB_MPG ECU_ADDRESS 0xd000a0c4 FORMAT "%5.0" /end MEASUREMENT
/begin MEASUREMENT n_gb_out_mpg "Output speed drive train gearbox - mapped signal for routing" UWORD _CNV_A_R_LINEAR_____0_CM 1 100. 0. 65535. DISPLAY_IDENTIFIER N_GB_OUT_MPG ECU_ADDRESS 0xd000a0c0 FORMAT "%5.0" /end MEASUREMENT
/begin MEASUREMENT fac_gb_gain_mpg "gearbox-drive-train gain - mapped signal for routing" UWORD _CNV_A_R_LINEAR_____0_CM 1 100. 0. 4095. DISPLAY_IDENTIFIER FAC_GB_GAIN_MPG ECU_ADDRESS 0xd000a0c6 FORMAT "%5.0" /end MEASUREMENT
/begin MEASUREMENT n_gb_out "Output speed drive train gearbox" UWORD _CNV_A_R_LINEAR_____193_CM 1 100. -32768. 32767. DISPLAY_IDENTIFIER N_GB_OUT ECU_ADDRESS 0xd000a0c2 FORMAT "%6.0" /end MEASUREMENT
/begin MEASUREMENT crc_com_2_tq_etcu "CRC for Communication on FA-CAN" UBYTE _CNV_A_R_LINEAR_____0_CM 1 100. 0. 255. DISPLAY_IDENTIFIER CRC_COM_2_TQ_ETCU ECU_ADDRESS 0xd00085d0 FORMAT "%3.0" /end MEASUREMENT
/begin MEASUREMENT crc_com_3_tq_etcu "CRC for communication on A-CAN" UBYTE _CNV_A_R_LINEAR_____0_CM 1 100. 0. 255. DISPLAY_IDENTIFIER CRC_COM_3_TQ_ETCU ECU_ADDRESS 0xd00085d6 FORMAT "%3.0" /end MEASUREMENT
/begin MEASUREMENT tcc_com_2_tq_etcu "Alive counter for communication on FA-CAN" UBYTE _CNV_A_R_LINEAR_____50_CM 1 100. 0. 14. DISPLAY_IDENTIFIER TCC_COM_2_TQ_ETCU ECU_ADDRESS 0xd00085d1 FORMAT "%2.0" /end MEASUREMENT
/begin MEASUREMENT tcc_com_3_tq_etcu "Alive counter for communication on A-CAN" UBYTE _CNV_A_R_LINEAR_____50_CM 1 100. 0. 14. DISPLAY_IDENTIFIER TCC_COM_3_TQ_ETCU ECU_ADDRESS 0xd00085de FORMAT "%2.0" /end MEASUREMENT
/begin MEASUREMENT crc_clc_com_2_tq_etcu "Checksum calculation for communication on FA-CAN" UBYTE _CNV_A_R_LINEAR_____0_CM 1 100. 0. 255. DISPLAY_IDENTIFIER CRC_CLC_COM_2_TQ_ETCU ECU_ADDRESS 0xd00085e3 FORMAT "%3.0" /end MEASUREMENT
/begin MEASUREMENT crc_clc_com_3_tq_etcu "Checksum calculation for communication on A-CAN" UBYTE _CNV_A_R_LINEAR_____0_CM 1 100. 0. 255. DISPLAY_IDENTIFIER CRC_CLC_COM_3_TQ_ETCU ECU_ADDRESS 0xd00085e4 FORMAT "%3.0" /end MEASUREMENT
/begin MEASUREMENT crc_com_2_etcu "CRC for communication on FA-CAN" UBYTE _CNV_A_R_LINEAR_____0_CM 1 100. 0. 255. DISPLAY_IDENTIFIER CRC_COM_2_ETCU ECU_ADDRESS 0xd00085d4 FORMAT "%3.0" /end MEASUREMENT
/begin MEASUREMENT crc_com_3_etcu "CRC for communication on A-CAN" UBYTE _CNV_A_R_LINEAR_____0_CM 1 100. 0. 255. DISPLAY_IDENTIFIER CRC_COM_3_ETCU ECU_ADDRESS 0xd00085d5 FORMAT "%3.0" /end MEASUREMENT
/begin MEASUREMENT tcc_com_2_etcu "Alive counter for communication on FA-CAN" UBYTE _CNV_A_R_LINEAR_____50_CM 1 100. 0. 14. DISPLAY_IDENTIFIER TCC_COM_2_ETCU ECU_ADDRESS 0xd00085d3 FORMAT "%2.0" /end MEASUREMENT
/begin MEASUREMENT tcc_com_3_etcu "Alive counter for communication on A-CAN" UBYTE _CNV_A_R_LINEAR_____50_CM 1 100. 0. 14. DISPLAY_IDENTIFIER TCC_COM_3_ETCU ECU_ADDRESS 0xd00085dc FORMAT "%2.0" /end MEASUREMENT
/begin MEASUREMENT crc_clc_com_2_etcu "Checksum calculation for communication on FA-CAN" UBYTE _CNV_A_R_LINEAR_____0_CM 1 100. 0. 255. DISPLAY_IDENTIFIER CRC_CLC_COM_2_ETCU ECU_ADDRESS 0xd00085e5 FORMAT "%3.0" /end MEASUREMENT
/begin MEASUREMENT crc_clc_com_3_etcu "Checksum calculation for communication on A-CAN" UBYTE _CNV_A_R_LINEAR_____0_CM 1 100. 0. 255. DISPLAY_IDENTIFIER CRC_CLC_COM_3_ETCU ECU_ADDRESS 0xd00085e6 FORMAT "%3.0" /end MEASUREMENT
/begin MEASUREMENT lv_err_com_2_tq_etcu "Present error communication bus 2 ( FA-CAN )" UBYTE _CNV_S_2_RANGE__0___1_CM 1 100. 0. 1. DISPLAY_IDENTIFIER LV_ERR_COM_2_TQ_ETCU ECU_ADDRESS 0xd000807e BIT_MASK 0x1 /end MEASUREMENT
/begin MEASUREMENT ctr_tout_com_2_tq_etcu "Diagnosis counter for timeout counter error symptom detection" UBYTE _CNV_A_R_LINEAR_____0_CM 1 100. 0. 255. DISPLAY_IDENTIFIER CTR_TOUT_COM_2_TQ_ETCU ECU_ADDRESS 0xd0008512 FORMAT "%3.0" /end MEASUREMENT
/begin MEASUREMENT ctr_tcc_com_2_tq_etcu "Diagnosis counter for alive counter error symptom detection" UBYTE _CNV_A_R_LINEAR_____0_CM 1 100. 0. 255. DISPLAY_IDENTIFIER CTR_TCC_COM_2_TQ_ETCU ECU_ADDRESS 0xd0008510 FORMAT "%3.0" /end MEASUREMENT
/begin MEASUREMENT ctr_crc_com_2_tq_etcu "Diagnosis counter for checksum counter error symptom detection" UBYTE _CNV_A_R_LINEAR_____0_CM 1 100. 0. 255. DISPLAY_IDENTIFIER CTR_CRC_COM_2_TQ_ETCU ECU_ADDRESS 0xd0008511 FORMAT "%3.0" /end MEASUREMENT
/begin MEASUREMENT lv_err_com_3_tq_etcu "Present error communication bus 3 ( A-CAN )" UBYTE _CNV_S_2_RANGE__0___1_CM 1 100. 0. 1. DISPLAY_IDENTIFIER LV_ERR_COM_3_TQ_ETCU ECU_ADDRESS 0xd0008093 BIT_MASK 0x1 /end MEASUREMENT
/begin MEASUREMENT ctr_tout_com_3_tq_etcu "Diagnosis counter for timeout counter error symptom detection" UBYTE _CNV_A_R_LINEAR_____0_CM 1 100. 0. 255. DISPLAY_IDENTIFIER CTR_TOUT_COM_3_TQ_ETCU ECU_ADDRESS 0xd000853e FORMAT "%3.0" /end MEASUREMENT
/begin MEASUREMENT ctr_tcc_com_3_tq_etcu "Diagnosis counter for alive counter error symptom detection" UBYTE _CNV_A_R_LINEAR_____0_CM 1 100. 0. 255. DISPLAY_IDENTIFIER CTR_TCC_COM_3_TQ_ETCU ECU_ADDRESS 0xd000853c FORMAT "%3.0" /end MEASUREMENT
/begin MEASUREMENT ctr_crc_com_3_tq_etcu "Diagnosis counter for checksum counter error symptom detection" UBYTE _CNV_A_R_LINEAR_____0_CM 1 100. 0. 255. DISPLAY_IDENTIFIER CTR_CRC_COM_3_TQ_ETCU ECU_ADDRESS 0xd000853d FORMAT "%3.0" /end MEASUREMENT
/begin MEASUREMENT lv_err_com_2_etcu "Present error communication bus 2 ( FA-CAN )" UBYTE _CNV_S_2_RANGE__0___1_CM 1 100. 0. 1. DISPLAY_IDENTIFIER LV_ERR_COM_2_ETCU ECU_ADDRESS 0xd000807d BIT_MASK 0x1 /end MEASUREMENT
/begin MEASUREMENT ctr_tout_com_2_etcu "Diagnosis counter for timeout counter error symptom detection" UBYTE _CNV_A_R_LINEAR_____0_CM 1 100. 0. 255. DISPLAY_IDENTIFIER CTR_TOUT_COM_2_ETCU ECU_ADDRESS 0xd00084fa FORMAT "%3.0" /end MEASUREMENT
/begin MEASUREMENT ctr_tcc_com_2_etcu "Diagnosis counter for alive counter error symptom detection" UBYTE _CNV_A_R_LINEAR_____0_CM 1 100. 0. 255. DISPLAY_IDENTIFIER CTR_TCC_COM_2_ETCU ECU_ADDRESS 0xd00084f8 FORMAT "%3.0" /end MEASUREMENT
/begin MEASUREMENT ctr_crc_com_2_etcu "Diagnosis counter for checksum counter error symptom detection" UBYTE _CNV_A_R_LINEAR_____0_CM 1 100. 0. 255. DISPLAY_IDENTIFIER CTR_CRC_COM_2_ETCU ECU_ADDRESS 0xd00084f9 FORMAT "%3.0" /end MEASUREMENT
/begin MEASUREMENT lv_err_com_3_etcu "Present error communication bus 3 ( A-CAN )" UBYTE _CNV_S_2_RANGE__0___1_CM 1 100. 0. 1. DISPLAY_IDENTIFIER LV_ERR_COM_3_ETCU ECU_ADDRESS 0xd0008094 BIT_MASK 0x1 /end MEASUREMENT
/begin MEASUREMENT ctr_tout_com_3_etcu "Diagnosis counter for timeout counter error symptom detection" UBYTE _CNV_A_R_LINEAR_____0_CM 1 100. 0. 255. DISPLAY_IDENTIFIER CTR_TOUT_COM_3_ETCU ECU_ADDRESS 0xd000853a FORMAT "%3.0" /end MEASUREMENT
/begin MEASUREMENT ctr_tcc_com_3_etcu "Diagnosis counter for alive counter error symptom detection" UBYTE _CNV_A_R_LINEAR_____0_CM 1 100. 0. 255. DISPLAY_IDENTIFIER CTR_TCC_COM_3_ETCU ECU_ADDRESS 0xd0008538 FORMAT "%3.0" /end MEASUREMENT
/begin MEASUREMENT ctr_crc_com_3_etcu "Diagnosis counter for checksum counter error symptom detection" UBYTE _CNV_A_R_LINEAR_____0_CM 1 100. 0. 255. DISPLAY_IDENTIFIER CTR_CRC_COM_3_ETCU ECU_ADDRESS 0xd0008539 FORMAT "%3.0" /end MEASUREMENT
/begin MEASUREMENT lv_err_com_2_etcu_disp "Present error communication bus 2 ( FA-CAN )" UBYTE _CNV_S_2_RANGE__0___1_CM 1 100. 0. 1. DISPLAY_IDENTIFIER LV_ERR_COM_2_ETCU_DISP ECU_ADDRESS 0xd0008089 BIT_MASK 0x1 /end MEASUREMENT
/begin MEASUREMENT lv_err_com_3_etcu_disp "Present error communication bus 3 ( A-CAN )" UBYTE _CNV_S_2_RANGE__0___1_CM 1 100. 0. 1. DISPLAY_IDENTIFIER LV_ERR_COM_3_ETCU_DISP ECU_ADDRESS 0xd0008095 BIT_MASK 0x1 /end MEASUREMENT
/begin MEASUREMENT ctr_tout_com_3_etcu_disp "Diagnosis counter for timeout counter error symptom detection" UBYTE _CNV_A_R_LINEAR_____0_CM 1 100. 0. 255. DISPLAY_IDENTIFIER CTR_TOUT_COM_3_ETCU_DISP ECU_ADDRESS 0xd0008536 FORMAT "%3.0" /end MEASUREMENT
/begin MEASUREMENT lv_err_com_3_etcu_obd "Present error communication bus 3 ( A-CAN )" UBYTE _CNV_S_2_RANGE__0___1_CM 1 100. 0. 1. DISPLAY_IDENTIFIER LV_ERR_COM_3_ETCU_OBD ECU_ADDRESS 0xd0008096 BIT_MASK 0x1 /end MEASUREMENT
/begin MEASUREMENT ctr_tout_com_3_etcu_obd "Diagnosis counter for timeout counter error symptom detection" UBYTE _CNV_A_R_LINEAR_____0_CM 1 100. 0. 255. DISPLAY_IDENTIFIER CTR_TOUT_COM_3_ETCU_OBD ECU_ADDRESS 0xd0008532 FORMAT "%3.0" /end MEASUREMENT
/begin MEASUREMENT lv_err_com_2_gb "Present error communication bus 2 ( FA-CAN )" UBYTE _CNV_S_2_RANGE__0___1_CM 1 100. 0. 1. DISPLAY_IDENTIFIER LV_ERR_COM_2_GB ECU_ADDRESS 0xd000807c BIT_MASK 0x1 /end MEASUREMENT
/begin MEASUREMENT ctr_tout_com_2_gb "Diagnosis counter for timeout counter error symptom detection" UBYTE _CNV_A_R_LINEAR_____0_CM 1 100. 0. 255. DISPLAY_IDENTIFIER CTR_TOUT_COM_2_GB ECU_ADDRESS 0xd0008516 FORMAT "%3.0" /end MEASUREMENT
/begin MEASUREMENT lv_err_com_3_gb "Present error communication bus 3 ( A-CAN )" UBYTE _CNV_S_2_RANGE__0___1_CM 1 100. 0. 1. DISPLAY_IDENTIFIER LV_ERR_COM_3_GB ECU_ADDRESS 0xd0008097 BIT_MASK 0x1 /end MEASUREMENT
/begin MEASUREMENT ctr_tout_com_3_gb "Diagnosis counter for timeout counter error symptom detection" UBYTE _CNV_A_R_LINEAR_____0_CM 1 100. 0. 255. DISPLAY_IDENTIFIER CTR_TOUT_COM_3_GB ECU_ADDRESS 0xd0008546 FORMAT "%3.0" /end MEASUREMENT
/begin MEASUREMENT state_etcu_clu "State gearbox for starting-clutch" UBYTE _CNV_A_R_LINEAR_____0_CM 1 100. 0. 7. DISPLAY_IDENTIFIER STATE_ETCU_CLU ECU_ADDRESS 0xd00085ee FORMAT "%1.0" /end MEASUREMENT
/begin MEASUREMENT crc_clc_com_3_etcu_disp "Checksum calculation for communication on A-CAN" UBYTE _CNV_A_R_LINEAR_____0_CM 1 100. 0. 255. ECU_ADDRESS 0xd00085ec FORMAT "%3.0" /end MEASUREMENT
/begin MEASUREMENT tcc_com_3_etcu_disp "Alive counter for communication on A-CAN" UBYTE _CNV_A_R_LINEAR_____50_CM 1 100. 0. 14. ECU_ADDRESS 0xd00085eb FORMAT "%2.0" /end MEASUREMENT
/begin MEASUREMENT crc_com_3_etcu_disp "CRC for Communication on A-CAN" UBYTE _CNV_A_R_LINEAR_____0_CM 1 100. 0. 255. ECU_ADDRESS 0xd00085ea FORMAT "%3.0" /end MEASUREMENT
/begin MEASUREMENT state_etcu_shift_idc "State of gear change announcement" UBYTE _CNV_A_R_LINEAR_____0_CM 1 100. 0. 3. DISPLAY_IDENTIFIER STATE_ETCU_SHIFT_IDC ECU_ADDRESS 0xd00085e9 FORMAT "%1.0" /end MEASUREMENT
/begin MEASUREMENT state_etcu_spt_gb "State for displaying sport mode" UBYTE _CNV_A_R_LINEAR_____0_CM 1 100. 0. 3. DISPLAY_IDENTIFIER STATE_ETCU_SPT_GB ECU_ADDRESS 0xd00085e8 FORMAT "%1.0" /end MEASUREMENT
/begin MEASUREMENT state_etcu_idc_dir "State of gearbox indicating direction" UBYTE _CNV_A_R_LINEAR_____0_CM 1 100. 0. 3. DISPLAY_IDENTIFIER STATE_ETCU_IDC_DIR ECU_ADDRESS 0xd00085e7 FORMAT "%1.0" /end MEASUREMENT
/begin MEASUREMENT lv_at "" UBYTE _CNV_S_2_RANGE__0___1_CM 1 100. 0. 1. DISPLAY_IDENTIFIER LV_AT ECU_ADDRESS 0xd000824d BIT_MASK 0x1 /end MEASUREMENT
/begin MEASUREMENT lv_var_pste "" UBYTE _CNV_S_2_RANGE__0___1_CM 1 100. 0. 1. DISPLAY_IDENTIFIER LV_VAR_PSTE ECU_ADDRESS 0xd0008265 BIT_MASK 0x1 /end MEASUREMENT
/begin MEASUREMENT lv_err_com_1_ang_pste "Present error communication bus 1 (Flexray)" UBYTE _CNV_S_2_RANGE__0___1_CM 1 100. 0. 1. DISPLAY_IDENTIFIER LV_ERR_COM_1_ANG_PSTE ECU_ADDRESS 0xd0008073 BIT_MASK 0x1 /end MEASUREMENT
/begin MEASUREMENT ctr_tout_com_1_ang_pste "Diagnosis counter for timeout counter error symptom detection" UBYTE _CNV_A_R_LINEAR_____0_CM 1 100. 0. 255. DISPLAY_IDENTIFIER CTR_TOUT_COM_1_ANG_PSTE ECU_ADDRESS 0xd00084ce FORMAT "%3.0" /end MEASUREMENT
/begin MEASUREMENT lv_err_com_1_tcs "Present error communication bus 1 ( Flexray )" UBYTE _CNV_S_2_RANGE__0___1_CM 1 100. 0. 1. DISPLAY_IDENTIFIER LV_ERR_COM_1_TCS ECU_ADDRESS 0xd0008079 BIT_MASK 0x1 /end MEASUREMENT
/begin MEASUREMENT ctr_tout_com_1_tcs "Diagnosis counter for timeout counter error symptom detection" UBYTE _CNV_A_R_LINEAR_____0_CM 1 100. 0. 255. DISPLAY_IDENTIFIER CTR_TOUT_COM_1_TCS ECU_ADDRESS 0xd00084e6 FORMAT "%3.0" /end MEASUREMENT
/begin MEASUREMENT ctr_tcc_com_1_tcs "Diagnosis  counter for alive counter error symptom detection" UBYTE _CNV_A_R_LINEAR_____0_CM 1 100. 0. 255. DISPLAY_IDENTIFIER CTR_TCC_COM_1_TCS ECU_ADDRESS 0xd00084e4 FORMAT "%3.0" /end MEASUREMENT
/begin MEASUREMENT ctr_crc_com_1_tcs "Diagnosis counter for checksum counter error symptom detection" UBYTE _CNV_A_R_LINEAR_____0_CM 1 100. 0. 255. DISPLAY_IDENTIFIER CTR_CRC_COM_1_TCS ECU_ADDRESS 0xd00084e5 FORMAT "%3.0" /end MEASUREMENT
/begin MEASUREMENT tcc_com_1_tcs "alive counter for communication" UBYTE _CNV_A_R_LINEAR_____50_CM 1 100. 0. 14. DISPLAY_IDENTIFIER TCC_COM_1_TCS ECU_ADDRESS 0xd0008590 FORMAT "%2.0" /end MEASUREMENT
/begin MEASUREMENT crc_com_1_tcs "CRC for communication" UBYTE _CNV_A_R_LINEAR_____0_CM 1 100. 0. 255. DISPLAY_IDENTIFIER CRC_COM_1_TCS ECU_ADDRESS 0xd0008591 FORMAT "%3.0" /end MEASUREMENT
/begin MEASUREMENT crc_clc_com_1_tcs "CRC calculated for communication" UBYTE _CNV_A_R_LINEAR_____0_CM 1 100. 0. 255. DISPLAY_IDENTIFIER CRC_CLC_COM_1_TCS ECU_ADDRESS 0xd0008592 FORMAT "%3.0" /end MEASUREMENT
/begin MEASUREMENT lv_err_com_1_tq_tcs "Present error communication bus 1 ( Flexray )" UBYTE _CNV_S_2_RANGE__0___1_CM 1 100. 0. 1. DISPLAY_IDENTIFIER LV_ERR_COM_1_TQ_TCS ECU_ADDRESS 0xd000806e BIT_MASK 0x1 /end MEASUREMENT
/begin MEASUREMENT lv_err_com_1_brake_tcs "Present error communication bus 1 ( Flexray )" UBYTE _CNV_S_2_RANGE__0___1_CM 1 100. 0. 1. DISPLAY_IDENTIFIER LV_ERR_COM_1_BRAKE_TCS ECU_ADDRESS 0xd000806c BIT_MASK 0x1 /end MEASUREMENT
/begin MEASUREMENT lv_err_com_1_tqb_tcs "Present error communication bus 1 ( Flexray )" UBYTE _CNV_S_2_RANGE__0___1_CM 1 100. 0. 1. DISPLAY_IDENTIFIER LV_ERR_COM_1_TQB_TCS ECU_ADDRESS 0xd000806f BIT_MASK 0x1 /end MEASUREMENT
/begin MEASUREMENT lv_err_com_1_wheel_tcs "Present error communication bus 1 ( Flexray )" UBYTE _CNV_S_2_RANGE__0___1_CM 1 100. 0. 1. DISPLAY_IDENTIFIER LV_ERR_COM_1_WHEEL_TCS ECU_ADDRESS 0xd0008070 BIT_MASK 0x1 /end MEASUREMENT
/begin MEASUREMENT crc_com_1_tq_tcs "CRC calculated for communication" UBYTE _CNV_A_R_LINEAR_____0_CM 1 100. 0. 255. DISPLAY_IDENTIFIER CRC_COM_1_TQ_TCS ECU_ADDRESS 0xd0008593 FORMAT "%3.0" /end MEASUREMENT
/begin MEASUREMENT crc_clc_com_1_tq_tcs "CRC calculated for communication" UBYTE _CNV_A_R_LINEAR_____0_CM 1 100. 0. 255. DISPLAY_IDENTIFIER CRC_CLC_COM_1_TQ_TCS ECU_ADDRESS 0xd0008595 FORMAT "%3.0" /end MEASUREMENT
/begin MEASUREMENT state_tq_wheel_tcs_slow "Qualifier concept to target wheel torque on powertrain" UBYTE _CNV_A_R_LINEAR_____0_CM 1 100. 0. 255. DISPLAY_IDENTIFIER STATE_TQ_WHEEL_TCS_SLOW ECU_ADDRESS 0xd0008597 FORMAT "%3.0" /end MEASUREMENT
/begin MEASUREMENT crc_com_1_wheel_tcs "CRC for Communication on FLX" UBYTE _CNV_A_R_LINEAR_____0_CM 1 100. 0. 255. DISPLAY_IDENTIFIER CRC_COM_1_WHEEL_TCS ECU_ADDRESS 0xd000859e FORMAT "%3.0" /end MEASUREMENT
/begin MEASUREMENT crc_clc_com_1_wheel_tcs "Checksum calculated for communication on FLX" UBYTE _CNV_A_R_LINEAR_____0_CM 1 100. 0. 255. DISPLAY_IDENTIFIER CRC_CLC_COM_1_WHEEL_TCS ECU_ADDRESS 0xd000859f FORMAT "%3.0" /end MEASUREMENT
/begin MEASUREMENT lv_err_com_3_efp "Present error communication on bus 3 ( A-CAN )" UBYTE _CNV_S_2_RANGE__0___1_CM 1 100. 0. 1. DISPLAY_IDENTIFIER LV_ERR_COM_3_EFP ECU_ADDRESS 0xd0008092 BIT_MASK 0x1 /end MEASUREMENT
/begin MEASUREMENT ctr_tout_com_3_efp "Diagnosis counter for timeout counter error symptom detection" UBYTE _CNV_A_R_LINEAR_____0_CM 1 100. 0. 255. DISPLAY_IDENTIFIER CTR_TOUT_COM_3_EFP ECU_ADDRESS 0xd0008542 FORMAT "%3.0" /end MEASUREMENT
/begin MEASUREMENT sum_afl_vls_diag_sa_1_sae "Lean indication counter cylinder group 1 for the mode 6" UWORD _CNV_A_R_LINEAR_____0_CM 1 100. 0. 65535. DISPLAY_IDENTIFIER SUM_AFL_VLS_DIAG_SA_1_SAE ECU_ADDRESS 0xd000a3a0 FORMAT "%5.0" /end MEASUREMENT
/begin MEASUREMENT sum_afl_vls_diag_sa_2_sae "Lean indication counter cylinder group 2 for the mode 6" UWORD _CNV_A_R_LINEAR_____0_CM 1 100. 0. 65535. DISPLAY_IDENTIFIER SUM_AFL_VLS_DIAG_SA_2_SAE ECU_ADDRESS 0xd000a3a2 FORMAT "%5.0" /end MEASUREMENT
/begin MEASUREMENT vls_cor_lsl[0] "Corrected output signal of  lambda sensor" UWORD _CNV_A_R_LINEAR_____2_CM 1 100. 0. 4.9951171875 DISPLAY_IDENTIFIER VLS_COR_LSL[1] ECU_ADDRESS 0xd000a3a4 FORMAT "%5.3" /end MEASUREMENT
/begin MEASUREMENT vls_cor_lsl[1] "Corrected output signal of  lambda sensor" UWORD _CNV_A_R_LINEAR_____2_CM 1 100. 0. 4.9951171875 DISPLAY_IDENTIFIER VLS_COR_LSL[2] ECU_ADDRESS 0xd000a3a6 FORMAT "%5.3" /end MEASUREMENT
/begin MEASUREMENT lv_bts "Braketest switch variable" UBYTE _CNV_S_2_RANGE__0___1_CM 1 100. 0. 1. DISPLAY_IDENTIFIER LV_BTS ECU_ADDRESS 0xd000749f BIT_MASK 0x1 /end MEASUREMENT
/begin MEASUREMENT lv_clu_open "Boolean for open clutch" UBYTE _CNV_S_2_RANGE__0___1_CM 1 100. 0. 1. DISPLAY_IDENTIFIER LV_CLU_OPEN ECU_ADDRESS 0xd00074a0 BIT_MASK 0x1 /end MEASUREMENT
/begin MEASUREMENT lv_cvt "CVT-Getriebe verbaut (Block 4)" UBYTE _CNV_S_2_RANGE__0___1_CM 1 100. 0. 1. DISPLAY_IDENTIFIER LV_CVT ECU_ADDRESS 0xd00074a3 BIT_MASK 0x1 /end MEASUREMENT
/begin MEASUREMENT lv_drof_inh "Inhibition bit of DROF functionality" UBYTE _CNV_S_2_RANGE__0___1_CM 1 100. 0. 1. DISPLAY_IDENTIFIER LV_DROF_INH ECU_ADDRESS 0xd00074a5 BIT_MASK 0x1 /end MEASUREMENT
/begin MEASUREMENT lv_isc_diag_inh "Flag for inhibitation of the Idle Speed Control Diagnosis" UBYTE _CNV_S_2_RANGE__0___1_CM 1 100. 0. 1. DISPLAY_IDENTIFIER LV_ISC_DIAG_INH ECU_ADDRESS 0xd00074a6 BIT_MASK 0x1 /end MEASUREMENT
/begin MEASUREMENT n_sp_is_clc "Calculated nominal idle speed" UWORD _CNV_A_R_LINEAR_____14_CM 1 100. 0. 8160. DISPLAY_IDENTIFIER N_SP_IS_CLC ECU_ADDRESS 0xd0006670 FORMAT "%4.0" /end MEASUREMENT
/begin MEASUREMENT t_ramp_lim_p_d_drof_is "Ramping time constant for PD part at driving off deactivation" UWORD _CNV_A_R_LINEAR_____3_CM 1 100. 0. 655.35 DISPLAY_IDENTIFIER T_RAMP_LIM_P_D_DROF_IS ECU_ADDRESS 0xd0006676 FORMAT "%5.2" /end MEASUREMENT
/begin MEASUREMENT tq_delta_dif_is_ad "Delta torque adaption considered in the I Part of idle speed controller" SWORD _CNV_A_R_LINEAR_____236_CM 1 100. -4. 3.99987793 DISPLAY_IDENTIFIER TQ_DELTA_DIF_IS_AD ECU_ADDRESS 0xd000667c FORMAT "%7.4" /end MEASUREMENT
/begin MEASUREMENT tq_dif_p_d_drof_is_min "Minimum torque request for PD part while DROF" SWORD _CNV_A_R_LINEAR_____31_CM 1 100. -1024. 1023.96875 DISPLAY_IDENTIFIER TQ_DIF_P_D_DROF_IS_MIN ECU_ADDRESS 0xd0006684 FORMAT "%6.2" /end MEASUREMENT
/begin MEASUREMENT tq_dif_p_d_fast_drof_is "Torque request PD part at driving off for fast path" SWORD _CNV_A_R_LINEAR_____31_CM 1 100. -1024. 1023.96875 DISPLAY_IDENTIFIER TQ_DIF_P_D_FAST_DROF_IS ECU_ADDRESS 0xd0006686 FORMAT "%6.2" /end MEASUREMENT
/begin MEASUREMENT tq_dif_p_d_slow_drof_is "Torque request PD part at driving off for slow path" SWORD _CNV_A_R_LINEAR_____31_CM 1 100. -1024. 1023.96875 DISPLAY_IDENTIFIER TQ_DIF_P_D_SLOW_DROF_IS ECU_ADDRESS 0xd0006690 FORMAT "%6.2" /end MEASUREMENT
/begin MEASUREMENT lv_bls "Boolean for battery voltage condition fulfilled for OBD II diagnosis" UBYTE _CNV_S_2_RANGE__0___1_CM 1 100. 0. 1. DISPLAY_IDENTIFIER LV_BLS ECU_ADDRESS 0xd000749e BIT_MASK 0x1 /end MEASUREMENT
/begin MEASUREMENT lv_amt "Logical variable for Automated Manual Transmission" UBYTE _CNV_S_2_RANGE__0___1_CM 1 100. 0. 1. DISPLAY_IDENTIFIER LV_AMT ECU_ADDRESS 0xd000749d BIT_MASK 0x1 /end MEASUREMENT
/begin MEASUREMENT lv_n_sp_is_ch "Flag for active idle speed increase for catalyst heating" UBYTE _CNV_S_2_RANGE__0___1_CM 1 100. 0. 1. DISPLAY_IDENTIFIER LV_N_SP_IS_CH ECU_ADDRESS 0xd00074ab BIT_MASK 0x1 /end MEASUREMENT
/begin MEASUREMENT lv_mtc_lih_cur_off "ETC-LIMP-HOME-1" UBYTE _CNV_S_2_RANGE__0___1_CM 1 100. 0. 1. DISPLAY_IDENTIFIER LV_MTC_LIH_CUR_OFF ECU_ADDRESS 0xd00074a9 BIT_MASK 0x1 /end MEASUREMENT
/begin MEASUREMENT lv_clu_swi "" UBYTE _CNV_S_2_RANGE__0___1_CM 1 100. 0. 1. DISPLAY_IDENTIFIER LV_CLU_SWI ECU_ADDRESS 0xd00074a1 /end MEASUREMENT
/begin MEASUREMENT lv_clu_swi_2 "" UBYTE _CNV_S_2_RANGE__0___1_CM 1 100. 0. 1. DISPLAY_IDENTIFIER LV_CLU_SWI_2 ECU_ADDRESS 0xd00074a2 /end MEASUREMENT
/begin MEASUREMENT lv_pas_ramp_act_i_is "" UBYTE _CNV_S_2_RANGE__0___1_CM 1 100. 0. 1. DISPLAY_IDENTIFIER LV_PAS_RAMP_ACT_I_IS ECU_ADDRESS 0xd00074ad /end MEASUREMENT
/begin MEASUREMENT lv_n_max_clc_MDBAPRIO_10MS "Flag inidication runtime reduction on funktion call MDBAPRIO_10MS" UBYTE _CNV_S_2_RANGE__0___1_CM 1 100. 0. 1. DISPLAY_IDENTIFIER LV_N_MAX_CLC_MDBAPRIO_10MS ECU_ADDRESS 0xd0008bb8 BIT_MASK 0x1 /end MEASUREMENT
/begin MEASUREMENT lv_n_max_clc_AUSY_TURB_SEG "Flag inidication runtime reduction on funktion call AUSY_TURB_SEG" UBYTE _CNV_S_2_RANGE__0___1_CM 1 100. 0. 1. DISPLAY_IDENTIFIER LV_N_MAX_CLC_AUSY_TURB_SEG ECU_ADDRESS 0xd0008bb9 BIT_MASK 0x1 /end MEASUREMENT
/begin MEASUREMENT lv_n_max_clc_WESE_SEG "Flag inidication runtime reduction on funktion call WESE_SEG" UBYTE _CNV_S_2_RANGE__0___1_CM 1 100. 0. 1. DISPLAY_IDENTIFIER LV_N_MAX_CLC_WESE_SEG ECU_ADDRESS 0xd0008bba BIT_MASK 0x1 /end MEASUREMENT
/begin MEASUREMENT lv_n_max_clc_MDRK_SEG "Flag inidication runtime reduction on funktion call MDRK_SEG" UBYTE _CNV_S_2_RANGE__0___1_CM 1 100. 0. 1. DISPLAY_IDENTIFIER LV_N_MAX_CLC_MDRK_SEG ECU_ADDRESS 0xd0008bbb BIT_MASK 0x1 /end MEASUREMENT
/begin MEASUREMENT lv_n_max_clc_KLANN_20MS "Flag inidication runtime reduction on funktion call KLANN_20MS" UBYTE _CNV_S_2_RANGE__0___1_CM 1 100. 0. 1. DISPLAY_IDENTIFIER LV_N_MAX_CLC_KLANN_20MS ECU_ADDRESS 0xd0008bbc BIT_MASK 0x1 /end MEASUREMENT
/begin MEASUREMENT lv_n_max_clc_EISY_VERD_SEG "Flag inidication runtime reduction on funktion call EISY_VERD_SEG" UBYTE _CNV_S_2_RANGE__0___1_CM 1 100. 0. 1. DISPLAY_IDENTIFIER LV_N_MAX_CLC_EISY_VERD_SEG ECU_ADDRESS 0xd0008bbd BIT_MASK 0x1 /end MEASUREMENT
/begin MEASUREMENT lv_n_max_clc_MDBAFAK_10MS "Flag inidication runtime reduction on funktion call MDBAFAK_10MS" UBYTE _CNV_S_2_RANGE__0___1_CM 1 100. 0. 1. DISPLAY_IDENTIFIER LV_N_MAX_CLC_MDBAFAK_10MS ECU_ADDRESS 0xd0008bbe BIT_MASK 0x1 /end MEASUREMENT
/begin MEASUREMENT lv_n_max_clc_MDBANL_10MS "Flag inidication runtime reduction on funktion call MDBANL_10MS" UBYTE _CNV_S_2_RANGE__0___1_CM 1 100. 0. 1. DISPLAY_IDENTIFIER LV_N_MAX_CLC_MDBANL_10MS ECU_ADDRESS 0xd0008bbf BIT_MASK 0x1 /end MEASUREMENT
/begin MEASUREMENT lv_n_max_clc_ULVREG_10MS "Flag inidication runtime reduction on funktion call ULVREG_10MS" UBYTE _CNV_S_2_RANGE__0___1_CM 1 100. 0. 1. DISPLAY_IDENTIFIER LV_N_MAX_CLC_ULVREG_10MS ECU_ADDRESS 0xd0008bc0 BIT_MASK 0x1 /end MEASUREMENT
/begin MEASUREMENT lv_n_max_clc_RAILKO_10MS "Flag inidication runtime reduction on funktion call RAILKO_10MS" UBYTE _CNV_S_2_RANGE__0___1_CM 1 100. 0. 1. DISPLAY_IDENTIFIER LV_N_MAX_CLC_RAILKO_10MS ECU_ADDRESS 0xd0008bc1 BIT_MASK 0x1 /end MEASUREMENT
/begin MEASUREMENT lv_n_max_clc_ULVOUT_10MS "Flag inidication runtime reduction on funktion call ULVOUT_10MS" UBYTE _CNV_S_2_RANGE__0___1_CM 1 100. 0. 1. DISPLAY_IDENTIFIER LV_N_MAX_CLC_ULVOUT_10MS ECU_ADDRESS 0xd0008bc2 BIT_MASK 0x1 /end MEASUREMENT
/begin MEASUREMENT dtc_pres[0] "List of present DTC's in dynamic error memory (filled with 0 if no DTC present)" UWORD _CNV_A_R_LINEAR_____0_CM 1 100. 0. 65535. DISPLAY_IDENTIFIER DTC_PRES[0] ECU_ADDRESS 0xd00009cc FORMAT "%5.0" /end MEASUREMENT
/begin MEASUREMENT dtc_pres[1] "List of present DTC's in dynamic error memory (filled with 0 if no DTC present)" UWORD _CNV_A_R_LINEAR_____0_CM 1 100. 0. 65535. DISPLAY_IDENTIFIER DTC_PRES[1] ECU_ADDRESS 0xd00009ce FORMAT "%5.0" /end MEASUREMENT
/begin MEASUREMENT dtc_pres[2] "List of present DTC's in dynamic error memory (filled with 0 if no DTC present)" UWORD _CNV_A_R_LINEAR_____0_CM 1 100. 0. 65535. DISPLAY_IDENTIFIER DTC_PRES[2] ECU_ADDRESS 0xd00009d0 FORMAT "%5.0" /end MEASUREMENT
/begin MEASUREMENT dtc_pres[3] "List of present DTC's in dynamic error memory (filled with 0 if no DTC present)" UWORD _CNV_A_R_LINEAR_____0_CM 1 100. 0. 65535. DISPLAY_IDENTIFIER DTC_PRES[3] ECU_ADDRESS 0xd00009d2 FORMAT "%5.0" /end MEASUREMENT
/begin MEASUREMENT dtc_pres[4] "List of present DTC's in dynamic error memory (filled with 0 if no DTC present)" UWORD _CNV_A_R_LINEAR_____0_CM 1 100. 0. 65535. DISPLAY_IDENTIFIER DTC_PRES[4] ECU_ADDRESS 0xd00009d4 FORMAT "%5.0" /end MEASUREMENT
/begin MEASUREMENT dtc_pres[5] "List of present DTC's in dynamic error memory (filled with 0 if no DTC present)" UWORD _CNV_A_R_LINEAR_____0_CM 1 100. 0. 65535. DISPLAY_IDENTIFIER DTC_PRES[5] ECU_ADDRESS 0xd00009d6 FORMAT "%5.0" /end MEASUREMENT
/begin MEASUREMENT dtc_pres[6] "List of present DTC's in dynamic error memory (filled with 0 if no DTC present)" UWORD _CNV_A_R_LINEAR_____0_CM 1 100. 0. 65535. DISPLAY_IDENTIFIER DTC_PRES[6] ECU_ADDRESS 0xd00009d8 FORMAT "%5.0" /end MEASUREMENT
/begin MEASUREMENT dtc_pres[7] "List of present DTC's in dynamic error memory (filled with 0 if no DTC present)" UWORD _CNV_A_R_LINEAR_____0_CM 1 100. 0. 65535. DISPLAY_IDENTIFIER DTC_PRES[7] ECU_ADDRESS 0xd00009da FORMAT "%5.0" /end MEASUREMENT
/begin MEASUREMENT dtc_pres[8] "List of present DTC's in dynamic error memory (filled with 0 if no DTC present)" UWORD _CNV_A_R_LINEAR_____0_CM 1 100. 0. 65535. DISPLAY_IDENTIFIER DTC_PRES[8] ECU_ADDRESS 0xd00009dc FORMAT "%5.0" /end MEASUREMENT
/begin MEASUREMENT dtc_pres[9] "List of present DTC's in dynamic error memory (filled with 0 if no DTC present)" UWORD _CNV_A_R_LINEAR_____0_CM 1 100. 0. 65535. DISPLAY_IDENTIFIER DTC_PRES[9] ECU_ADDRESS 0xd00009de FORMAT "%5.0" /end MEASUREMENT
/begin MEASUREMENT dtc_old[0] "List of old DTC's" UWORD _CNV_A_R_LINEAR_____0_CM 1 100. 0. 65535. DISPLAY_IDENTIFIER DTC_OLD[0] ECU_ADDRESS 0xd00009e0 FORMAT "%5.0" /end MEASUREMENT
/begin MEASUREMENT dtc_old[1] "List of old DTC's" UWORD _CNV_A_R_LINEAR_____0_CM 1 100. 0. 65535. DISPLAY_IDENTIFIER DTC_OLD[1] ECU_ADDRESS 0xd00009e2 FORMAT "%5.0" /end MEASUREMENT
/begin MEASUREMENT dtc_old[2] "List of old DTC's" UWORD _CNV_A_R_LINEAR_____0_CM 1 100. 0. 65535. DISPLAY_IDENTIFIER DTC_OLD[2] ECU_ADDRESS 0xd00009e4 FORMAT "%5.0" /end MEASUREMENT
/begin MEASUREMENT dtc_old[3] "List of old DTC's" UWORD _CNV_A_R_LINEAR_____0_CM 1 100. 0. 65535. DISPLAY_IDENTIFIER DTC_OLD[3] ECU_ADDRESS 0xd00009e6 FORMAT "%5.0" /end MEASUREMENT
/begin MEASUREMENT dtc_old[4] "List of old DTC's" UWORD _CNV_A_R_LINEAR_____0_CM 1 100. 0. 65535. DISPLAY_IDENTIFIER DTC_OLD[4] ECU_ADDRESS 0xd00009e8 FORMAT "%5.0" /end MEASUREMENT
/begin MEASUREMENT dtc_old[5] "List of old DTC's" UWORD _CNV_A_R_LINEAR_____0_CM 1 100. 0. 65535. DISPLAY_IDENTIFIER DTC_OLD[5] ECU_ADDRESS 0xd00009ea FORMAT "%5.0" /end MEASUREMENT
/begin MEASUREMENT dtc_old[6] "List of old DTC's" UWORD _CNV_A_R_LINEAR_____0_CM 1 100. 0. 65535. DISPLAY_IDENTIFIER DTC_OLD[6] ECU_ADDRESS 0xd00009ec FORMAT "%5.0" /end MEASUREMENT
/begin MEASUREMENT dtc_old[7] "List of old DTC's" UWORD _CNV_A_R_LINEAR_____0_CM 1 100. 0. 65535. DISPLAY_IDENTIFIER DTC_OLD[7] ECU_ADDRESS 0xd00009ee FORMAT "%5.0" /end MEASUREMENT
/begin MEASUREMENT dtc_old[8] "List of old DTC's" UWORD _CNV_A_R_LINEAR_____0_CM 1 100. 0. 65535. DISPLAY_IDENTIFIER DTC_OLD[8] ECU_ADDRESS 0xd00009f0 FORMAT "%5.0" /end MEASUREMENT
/begin MEASUREMENT dtc_old[9] "List of old DTC's" UWORD _CNV_A_R_LINEAR_____0_CM 1 100. 0. 65535. DISPLAY_IDENTIFIER DTC_OLD[9] ECU_ADDRESS 0xd00009f2 FORMAT "%5.0" /end MEASUREMENT
/begin MEASUREMENT nr_dtc_pres "Number of present DTC's in dynamic error memory" UBYTE _CNV_A_R_LINEAR_____0_CM 1 100. 0. 255. DISPLAY_IDENTIFIER NR_DTC_PRES ECU_ADDRESS 0xd0000a95 FORMAT "%3.0" /end MEASUREMENT
/begin MEASUREMENT nr_dtc_new "Number of time stamps and correspondending DTC's which are new in dynamic error memory" UBYTE _CNV_A_R_LINEAR_____0_CM 1 100. 0. 255. DISPLAY_IDENTIFIER NR_DTC_NEW ECU_ADDRESS 0xd0008e66 FORMAT "%3.0" /end MEASUREMENT
/begin MEASUREMENT nr_dtc_trm_req "Number of time stamps and correspondending DTC's which shall be sent via diagnosis job" UBYTE _CNV_A_R_LINEAR_____0_CM 1 100. 0. 255. DISPLAY_IDENTIFIER NR_DTC_TRM_REQ ECU_ADDRESS 0xd0008e65 FORMAT "%3.0" /end MEASUREMENT
/begin MEASUREMENT t_dtc_trm "Time since last request for transmitting time stamp's + DTC's via diagnosis job" UBYTE _CNV_A_R_LINEAR_____36_CM 1 100. 0. 15. DISPLAY_IDENTIFIER T_DTC_TRM ECU_ADDRESS 0xd0000a97 FORMAT "%2.0" /end MEASUREMENT
/begin MEASUREMENT lv_dtc_trm_req "Indicating request for transmitting time stamp's + DTC's via diagnosis job" UBYTE _CNV_S_2_RANGE__0___1_CM 1 100. 0. 1. DISPLAY_IDENTIFIER LV_DTC_TRM_REQ ECU_ADDRESS 0xd0008e64 BIT_MASK 0x1 /end MEASUREMENT
/begin MEASUREMENT lv_dtc_trm_act "Bit indicating start of active DTC transmitting" UBYTE _CNV_S_2_RANGE__0___1_CM 1 100. 0. 1. DISPLAY_IDENTIFIER LV_DTC_TRM_ACT ECU_ADDRESS 0xd00090b4 BIT_MASK 0x1 /end MEASUREMENT
/begin MEASUREMENT lv_dtc_trm_pres "DTC + timestamp transmitting in progress" UBYTE _CNV_S_2_RANGE__0___1_CM 1 100. 0. 1. DISPLAY_IDENTIFIER LV_DTC_TRM_PRES ECU_ADDRESS 0xd00090b5 BIT_MASK 0x1 /end MEASUREMENT
/begin MEASUREMENT lv_err_dtc_trm "Error of active DTC reporting" UBYTE _CNV_S_2_RANGE__0___1_CM 1 100. 0. 1. DISPLAY_IDENTIFIER LV_ERR_DTC_TRM ECU_ADDRESS 0xd0007fc8 BIT_MASK 0x1 /end MEASUREMENT
/begin MEASUREMENT t_dtc_trm_pres "Time since start DTC transmitting" UBYTE _CNV_A_R_LINEAR_____36_CM 1 100. 0. 15. DISPLAY_IDENTIFIER T_DTC_TRM_PRES ECU_ADDRESS 0xd00009c8 FORMAT "%2.0" /end MEASUREMENT
/begin MEASUREMENT lv_err_com_2_acc "Present error communication on bus 2 (FA-CAN)" UBYTE _CNV_S_2_RANGE__0___1_CM 1 100. 0. 1. DISPLAY_IDENTIFIER LV_ERR_COM_2_ACC ECU_ADDRESS 0xd0008081 BIT_MASK 0x1 /end MEASUREMENT
/begin COMPU_METHOD _CNV_A_R_LINEAR_____0_CM "" RAT_FUNC "%6.3" "-" COEFFS 0 1. 0. 0 0 1 /end COMPU_METHOD
/begin COMPU_METHOD _CNV_S_2_RANGE__0___1_CM "" TAB_VERB "%6.3" "-" COMPU_TAB_REF _CNV_S_2_RANGE__0___1 /end COMPU_METHOD
/begin COMPU_VTAB _CNV_S_2_RANGE__0___1 "" TAB_VERB 2 0 "0" 1 "1" /end COMPU_VTAB
/begin COMPU_METHOD _CNV_A_R_LINEAR_____2_CM "" RAT_FUNC "%6.3" "V" COEFFS 0 204.8 0. 0 0 1 /end COMPU_METHOD
/begin COMPU_METHOD _CNV_A_R_LINEAR_____3_CM "" RAT_FUNC "%6.3" "s" COEFFS 0 100. 0. 0 0 1 /end COMPU_METHOD
/begin COMPU_METHOD _CNV_A_R_LINEAR_____4_CM "" RAT_FUNC "%6.3" "s" COEFFS 0 10. 0. 0 0 1 /end COMPU_METHOD
/begin COMPU_METHOD _CNV_A_R_LINEAR_____5_CM "" RAT_FUNC "%6.3" "%" COEFFS 0 2.56 0. 0 0 1 /end COMPU_METHOD
/begin COMPU_METHOD _CNV_A_R_LINEAR_____6_CM "" RAT_FUNC "%6.3" "km/h" COEFFS 0 1. 0. 0 0 1 /end COMPU_METHOD
/begin COMPU_METHOD _CNV_A_R_LINEAR_____8_CM "" RAT_FUNC "%6.3" "%" COEFFS 0 655.3599999999997 0. 0 0 1 /end COMPU_METHOD
/begin COMPU_METHOD _CNV_A_R_LINEAR_____9_CM "" RAT_FUNC "%6.3" "-" COEFFS 0 32767.99999999992 0. 0 0 1 /end COMPU_METHOD
/begin COMPU_METHOD _CNV_A_R_LINEAR_____10_CM "" RAT_FUNC "%6.3" "rpm" COEFFS 0 3.125e-002 0. 0 0 1 /end COMPU_METHOD
/begin COMPU_METHOD _CNV_A_R_LINEAR_____14_CM "" RAT_FUNC "%6.3" "rpm" COEFFS 0 1. 0. 0 0 1 /end COMPU_METHOD
/begin COMPU_METHOD _CNV_A_R_LINEAR_____15_CM "" RAT_FUNC "%6.3" "mg/stk" COEFFS 0 0.183585313174946 0. 0 0 1 /end COMPU_METHOD
/begin COMPU_METHOD _CNV_A_R_LINEAR_____17_CM "" RAT_FUNC "%6.3" "°C" COEFFS 0 1.333333333333333 64. 0 0 1 /end COMPU_METHOD
/begin COMPU_METHOD _CNV_A_R_LINEAR_____24_CM "" RAT_FUNC "%6.3" "-" COEFFS 0 16384. 0. 0 0 1 /end COMPU_METHOD
/begin COMPU_METHOD _CNV_A_R_LINEAR_____26_CM "" RAT_FUNC "%6.3" "°C" COEFFS 0 1. 40. 0 0 1 /end COMPU_METHOD
/begin COMPU_METHOD _CNV_A_R_LINEAR_____27_CM "" RAT_FUNC "%6.3" "hPa" COEFFS 0 12.06017666543982 0. 0 0 1 /end COMPU_METHOD
/begin COMPU_METHOD _CNV_A_R_LINEAR_____28_CM "" RAT_FUNC "%6.3" "-" COEFFS 0 256. 0. 0 0 1 /end COMPU_METHOD
/begin COMPU_METHOD _CNV_A_R_LINEAR_____29_CM "" RAT_FUNC "%6.3" "rpm/s" COEFFS 0 3.125e-002 128. 0 0 1 /end COMPU_METHOD
/begin COMPU_METHOD _CNV_A_R_LINEAR_____31_CM "" RAT_FUNC "%6.3" "Nm" COEFFS 0 32. 0. 0 0 1 /end COMPU_METHOD
/begin COMPU_METHOD _CNV_A_R_LINEAR_____36_CM "" RAT_FUNC "%6.3" "s" COEFFS 0 1. 0. 0 0 1 /end COMPU_METHOD
/begin COMPU_METHOD _CNV_A_R_LINEAR_____50_CM "" RAT_FUNC "%6.3" "" COEFFS 0 1. 0. 0 0 1 /end COMPU_METHOD
/begin COMPU_METHOD _CNV_A_R_LINEAR_____57_CM "" RAT_FUNC "%6.3" "Nm" COEFFS 0 2. 0. 0 0 1 /end COMPU_METHOD
/begin COMPU_METHOD _CNV_A_R_LINEAR_____58_CM "" RAT_FUNC "%6.3" "km" COEFFS 0 0.1 0. 0 0 1 /end COMPU_METHOD
/begin COMPU_METHOD _CNV_A_R_LINEAR_____75_CM "" RAT_FUNC "%6.3" "l" COEFFS 0 1. 0. 0 0 1 /end COMPU_METHOD
/begin COMPU_METHOD _CNV_S_2_RANGE______76_CM "" TAB_VERB "%6.3" "" COMPU_TAB_REF _CNV_S_2_RANGE______76 /end COMPU_METHOD
/begin COMPU_VTAB _CNV_S_2_RANGE______76 "" TAB_VERB 2 0 "0" 1 "1" /end COMPU_VTAB
/begin COMPU_METHOD _CNV_A_R_LINEAR_____84_CM "" RAT_FUNC "%6.3" "min" COEFFS 0 1. 0. 0 0 1 /end COMPU_METHOD
/begin COMPU_METHOD _CNV_A_R_LINEAR_____86_CM "" RAT_FUNC "%6.3" "km/h" COEFFS 0 128.0000018750286 0. 0 0 1 /end COMPU_METHOD
/begin COMPU_METHOD _CNV_A_R_LINEAR_____87_CM "" RAT_FUNC "%6.3" "Nm" COEFFS 0 32. 32768. 0 0 1 /end COMPU_METHOD
/begin COMPU_METHOD _CNV_A_R_LINEAR_____89_CM "" RAT_FUNC "%6.3" "-" COEFFS 0 65535.99999999996 0. 0 0 1 /end COMPU_METHOD
/begin COMPU_METHOD _CNV_A_R_LINEAR_____100_CM "" RAT_FUNC "%6.3" "-" COEFFS 0 127.9991955827809 0. 0 0 1 /end COMPU_METHOD
/begin COMPU_METHOD _CNV_A_R_LINEAR_____101_CM "" RAT_FUNC "%6.3" "km/h" COEFFS 0 128. 32768. 0 0 1 /end COMPU_METHOD
/begin COMPU_METHOD _CNV_A_R_LINEAR_____103_CM "" RAT_FUNC "%6.3" "-" COEFFS 0 128. 0. 0 0 1 /end COMPU_METHOD
/begin COMPU_METHOD _CNV_A_R_LINEAR_____106_CM "" RAT_FUNC "%6.3" "%" COEFFS 0 2084.478388983038 32768.00027481336 0 0 1 /end COMPU_METHOD
/begin COMPU_METHOD _CNV_A_R_LINEAR_____111_CM "" RAT_FUNC "%6.3" "mg/stk" COEFFS 0 47.18142548596112 0. 0 0 1 /end COMPU_METHOD
/begin COMPU_METHOD _CNV_A_R_CYBL_LINEA_122_CM "" RAT_FUNC "%6.3" "°CRK" COEFFS 0 0.1666666666666667 120. 0 0 1 /end COMPU_METHOD
/begin COMPU_METHOD _CNV_A_R_LINEAR_____128_CM "" RAT_FUNC "%6.3" "mg/stk" COEFFS 0 47.18142548596112 -1.455191522836685e-011 0 0 1 /end COMPU_METHOD
/begin COMPU_METHOD _CNV_A_R_LINEAR_____130_CM "" RAT_FUNC "%6.3" "°C" COEFFS 0 16. 0. 0 0 1 /end COMPU_METHOD
/begin COMPU_METHOD _CNV_A_R_LINEAR_____133_CM "" RAT_FUNC "%6.3" "°CRK" COEFFS 0 16.0027782601146 2880.500086820628 0 0 1 /end COMPU_METHOD
/begin COMPU_METHOD _CNV_A_R_LINEAR_____148_CM "" RAT_FUNC "%6.3" "mA" COEFFS 0 163.8375 0. 0 0 1 /end COMPU_METHOD
/begin COMPU_METHOD _CNV_A_R_LINEAR_____152_CM "" RAT_FUNC "%6.3" "h" COEFFS 0 35999.99999497086 0. 0 0 1 /end COMPU_METHOD
/begin COMPU_METHOD _CNV_A_R_LINEAR_____155_CM "" RAT_FUNC "%6.3" "V" COEFFS 0 2510.769230769231 0. 0 0 1 /end COMPU_METHOD
/begin COMPU_METHOD _CNV_A_R_LINEAR_____165_CM "" RAT_FUNC "%6.3" "-" COEFFS 0 65535. 0. 0 0 1 /end COMPU_METHOD
/begin COMPU_METHOD _CNV_A_R_LINEAR_____170_CM "" RAT_FUNC "%6.3" "rpm" COEFFS 0 4. 0. 0 0 1 /end COMPU_METHOD
/begin COMPU_METHOD _CNV_A_R_LINEAR_____171_CM "" RAT_FUNC "%6.3" "hPa" COEFFS 0 0.1884402603974972 0. 0 0 1 /end COMPU_METHOD
/begin COMPU_METHOD _CNV_A_R_LINEAR_____172_CM "" RAT_FUNC "%6.3" "V" COEFFS 0 6553.60054017653 0. 0 0 1 /end COMPU_METHOD
/begin COMPU_METHOD _CNV_A_R_LINEAR_____185_CM "" RAT_FUNC "%6.3" "" COEFFS 0 256. 0. 0 0 1 /end COMPU_METHOD
/begin COMPU_METHOD _CNV_A_R_LINEAR_____193_CM "" RAT_FUNC "%6.3" "rpm" COEFFS 0 1. 32768. 0 0 1 /end COMPU_METHOD
/begin COMPU_METHOD _CNV_A_R_LINEAR_____194_CM "" RAT_FUNC "%6.3" "mm" COEFFS 0 1000. 0. 0 0 1 /end COMPU_METHOD
/begin COMPU_METHOD _CNV_A_R_LINEAR_____195_CM "" RAT_FUNC "%6.3" "hPa" COEFFS 0 25.6 32768. 0 0 1 /end COMPU_METHOD
/begin COMPU_METHOD _CNV_A_R_LINEAR_____198_CM "" RAT_FUNC "%6.3" "°CRK" COEFFS 0 2.666666666666667 128. 0 0 1 /end COMPU_METHOD
/begin COMPU_METHOD _CNV_A_R_LINEAR_____202_CM "" RAT_FUNC "%6.3" "mg/stk" COEFFS 0 47.18214541280769 -1.080506262951531e-005 0 0 1 /end COMPU_METHOD
/begin COMPU_METHOD _CNV_A_R_LINEAR_____215_CM "" RAT_FUNC "%6.3" "kg/h" COEFFS 0 32. 0. 0 0 1 /end COMPU_METHOD
/begin COMPU_METHOD _CNV_A_R_LINEAR_____222_CM "" RAT_FUNC "%6.3" "°C" COEFFS 0 43.47840509520334 2086.96344456976 0 0 1 /end COMPU_METHOD
/begin COMPU_METHOD _CNV_A_R_LINEAR_____226_CM "" RAT_FUNC "%6.3" "%" COEFFS 0 10. 0. 0 0 1 /end COMPU_METHOD
/begin COMPU_METHOD _CNV_A_R_LINEAR_____236_CM "" RAT_FUNC "%6.3" "Nm" COEFFS 0 8191.999999679995 -1.280019205296412e-006 0 0 1 /end COMPU_METHOD
/begin COMPU_METHOD _CNV_A_R_LINEAR_____243_CM "" RAT_FUNC "%6.3" "" COEFFS 0 64. 0. 0 0 1 /end COMPU_METHOD
/begin COMPU_METHOD _CNV_A_R_LINEAR_____256_CM "" RAT_FUNC "%6.3" "m/s²" COEFFS 0 640. 32768. 0 0 1 /end COMPU_METHOD
/begin COMPU_METHOD _CNV_A_R_LINEAR_____258_CM "" RAT_FUNC "%6.3" "m/s²" COEFFS 0 2084.478388983038 32768.00027481336 0 0 1 /end COMPU_METHOD
/begin COMPU_METHOD _CNV_A_R_LINEAR_____259_CM "" RAT_FUNC "%6.3" "-" COEFFS 0 32768. 0. 0 0 1 /end COMPU_METHOD
/begin COMPU_METHOD _CNV_A_R_LINEAR_____262_CM "" RAT_FUNC "%6.3" "Nm" COEFFS 0 0.5 0. 0 0 1 /end COMPU_METHOD
/begin COMPU_METHOD _CNV_A_R_LINEAR_____263_CM "" RAT_FUNC "%6.3" "%" COEFFS 0 327.680000003584 32768.00000035841 0 0 1 /end COMPU_METHOD
/begin COMPU_METHOD _CNV_A_R_LINEAR_____265_CM "" RAT_FUNC "%6.3" "°STW/s" COEFFS 0 22.75571737399022 32768. 0 0 1 /end COMPU_METHOD
/begin COMPU_METHOD _CNV_A_R_EGCP_LINEA_355_CM "" RAT_FUNC "%6.3" "-" COEFFS 0 8. 0. 0 0 1 /end COMPU_METHOD
/begin COMPU_METHOD _CNV_A_R_LINEAR_____410_CM "" RAT_FUNC "%6.3" "µs" COEFFS 0 1. 0. 0 0 1 /end COMPU_METHOD
/begin COMPU_METHOD _CNV_A_R_LINEAR_____425_CM "" RAT_FUNC "%6.3" "V" COEFFS 0 10. 0. 0 0 1 /end COMPU_METHOD
/begin COMPU_METHOD _CNV_A_R_LINEAR_____430_CM "" RAT_FUNC "%6.3" "bar" COEFFS 0 1000. 0. 0 0 1 /end COMPU_METHOD
/begin COMPU_METHOD _CNV_A_R_LINEAR_____434_CM "" RAT_FUNC "%6.3" "m" COEFFS 0 1.e-002 0. 0 0 1 /end COMPU_METHOD
/begin COMPU_METHOD _CNV_A_R_CPULOAD__0_448_CM "" RAT_FUNC "%6.3" "%" COEFFS 0 10.24 0. 0 0 1 /end COMPU_METHOD
/begin COMPU_METHOD _CNV_A_R_LINEAR_____452_CM "" RAT_FUNC "%6.3" "-" COEFFS 0 2. 0. 0 0 1 /end COMPU_METHOD
/begin COMPU_METHOD _CNV_A_R_INJR_LINEA_465_CM "" RAT_FUNC "%6.3" "-" COEFFS 0 32768.00003968061 32768.00003968061 0 0 1 /end COMPU_METHOD
/begin COMPU_METHOD _CNV_A_R_LINEAR_____480_CM "" RAT_FUNC "%6.3" "-" COEFFS 0 655.3599999999997 0. 0 0 1 /end COMPU_METHOD
/begin COMPU_METHOD _CNV_A_R_LINEAR_____481_CM "" RAT_FUNC "%6.3" "°C" COEFFS 0 0.25 0. 0 0 1 /end COMPU_METHOD
/begin COMPU_METHOD _CNV_S_4_STATE_RGN__483_CM "" TAB_VERB "%6.3" "" COMPU_TAB_REF _CNV_S_4_STATE_RGN__483 /end COMPU_METHOD
/begin COMPU_VTAB _CNV_S_4_STATE_RGN__483 "" TAB_VERB 4 0 "SENSOR" 1 "MODEL" 2 "SENSOR_MODEL" 3 "TIME" /end COMPU_VTAB
/begin COMPU_METHOD _CNV_A_R_LINEAR_____524_CM "" RAT_FUNC "%6.3" "hPa/ms" COEFFS 0 395.1938017499002 -7.983716819580877e-003 0 0 1 /end COMPU_METHOD
/begin COMPU_METHOD _CNV_A_R_LINEAR_____543_CM "" RAT_FUNC "%6.3" "Nm" COEFFS 0 1. 32000. 0 0 1 /end COMPU_METHOD
/begin COMPU_METHOD _CNV_A_R_LINEAR_____780_CM "" RAT_FUNC "%6.3" "°C" COEFFS 0 64. 2112. 0 0 1 /end COMPU_METHOD
/begin COMPU_METHOD _CNV_A_R_LINEAR_____801_CM "" RAT_FUNC "%6.3" "MPa" COEFFS 0 2000. 0. 0 0 1 /end COMPU_METHOD
/begin COMPU_METHOD _CNV_A_R_LINEAR_____803_CM "" RAT_FUNC "%6.3" "" COEFFS 0 255. 0. 0 0 1 /end COMPU_METHOD
/begin COMPU_METHOD _CNV_A_R_LINEAR_____905_CM "" RAT_FUNC "%6.3" "rpm" COEFFS 0 2.5e-002 0. 0 0 1 /end COMPU_METHOD
/begin COMPU_METHOD _CNV_A_R_LINEAR_____907_CM "" RAT_FUNC "%6.3" "V" COEFFS 0 2559.999999499993 0. 0 0 1 /end COMPU_METHOD
/begin COMPU_METHOD _CNV_A_R_LINEAR_____909_CM "" RAT_FUNC "%6.3" "MPa" COEFFS 0 2000. 32768. 0 0 1 /end COMPU_METHOD
/begin COMPU_METHOD _CNV_A_R_LINEAR_____910_CM "" RAT_FUNC "%6.3" "°CRK" COEFFS 0 10. 32768. 0 0 1 /end COMPU_METHOD
/begin RECORD_LAYOUT _REC_VAL_20_u1 FNC_VALUES 1 UBYTE COLUMN_DIR DIRECT /end RECORD_LAYOUT
/begin RECORD_LAYOUT _REC_VAL_20_u2 FNC_VALUES 1 UWORD COLUMN_DIR DIRECT /end RECORD_LAYOUT
/begin RECORD_LAYOUT _REC_AXS_20_u1 NO_AXIS_PTS_X 1 UBYTE AXIS_PTS_X 2 UBYTE INDEX_INCR DIRECT /end RECORD_LAYOUT
/begin RECORD_LAYOUT _REC_AXS_20_u2 NO_AXIS_PTS_X 1 UWORD AXIS_PTS_X 2 UWORD INDEX_INCR DIRECT /end RECORD_LAYOUT
/begin RECORD_LAYOUT _REC_CUR_20_u2_u2 FNC_VALUES 1 UWORD COLUMN_DIR DIRECT /end RECORD_LAYOUT
/begin RECORD_LAYOUT _REC_CUR_20_u1_u2 FNC_VALUES 1 UBYTE COLUMN_DIR DIRECT /end RECORD_LAYOUT
/begin RECORD_LAYOUT _REC_MAP_20_u2_u2_u2 FNC_VALUES 1 UWORD COLUMN_DIR DIRECT /end RECORD_LAYOUT
/begin RECORD_LAYOUT _REC_MAP_20_u2_u1_u2 FNC_VALUES 1 UWORD COLUMN_DIR DIRECT /end RECORD_LAYOUT
/begin RECORD_LAYOUT _REC_MAP_20_u1_u2_u2 FNC_VALUES 1 UBYTE COLUMN_DIR DIRECT /end RECORD_LAYOUT
/begin RECORD_LAYOUT _REC_MAP_20_u1_u1_u1 FNC_VALUES 1 UBYTE COLUMN_DIR DIRECT /end RECORD_LAYOUT
/begin RECORD_LAYOUT _REC_MAP_20_u1_u1_u2 FNC_VALUES 1 UBYTE COLUMN_DIR DIRECT /end RECORD_LAYOUT
/begin FUNCTION __DDS_EXPA2_DEFAULT_FUNC__ "__DDS_EXPA2_DEFAULT_FUNC__"
 /begin DEF_CHARACTERISTIC ldpm_gear_ef_1 ldpm_n_ef ldp_n_32_ip_t_dly_ef ldp_maf__thd_is_er_diag ldp_n__thd_is_er_diag ldp_tco__fac_thd_is_er_diag ldpm_n_sof ldp_n_32_ip_t_dly_sof ldpm_n_32__t_acc ldp_vs__amp_raw_cor ldp_v_amp__amp_raw ldpm_n_2_3 lpdm_ctr_km_can ldp_toil__t_dly_poil_swi_can lc_snd_msg_oil_key_aux ldpm_t_ctl_cru_1 ldp_vs_dif_cru__fac_prop_cru ldpm_vs_sp_dif_cru_1 ldpm_n_21 ldpm_vs_sp_cru_1 ldpm_ac_cru__fac_tq_cru ldpm_gear__fac_tq_cru ldp_n_32__fac_tq_cru ldpm_fac_tq_cru_1 ldp_n_32__fac_tq_req_clu_is ldp_iga_dif_bas_cyl_lam_ip_crk ip_crk_delta_iga_lam_cyl_sel ldp_ftl__t_cur_dmtl_stat ldp_ftl__t_small_leak_test ldp_vb_dmtl_fil__fac_cur_dmtl ldpm_cur_dmtldifrefroughleak_1 ldp_ftl__t_rough_leak_test ldpm_tco_1_6 ldpm_gr_mt_3 ldpm_tco_9 ldp_n__t_min_pu ldp_tco__t_min_pu ldp_tq_loss_ars_sp_can__puc ldp_n_grd_n_dif_max_is ldp_tq_loss_pste_2_sp_can__puc ldpm_n_t_min_pu_opm ldpm_gr_at_3 ldpm_vs ldp_tq_loss_add__puc ldp_n_vs_ratio_gr_mt ldp_teg_dyn_hys ldpm_n_sp_is_tq_add_is_bol_bas ldpm_tco_tq_add_is_bol_bas ldpm_toil_ip_fac_temp_tq_add_is ldpm_tia_ip_fac_temp_tq_add_is ldpm_maf_fac_tq_add_is ldpm_vs_fil_ip_fac_vs_tq_add_is ldpm_maf_lgrd_tq_add_is_bol ldp_vlft_min_ip_tq_add_is_cor ldp_map_dip_sp_mmv_ip_tq_add_is ldpm_n_lgrd_tq_add_is_bol ldpm_n_dif_pred_fac_tq_add_is ldpm_n_4_9 ldpm_n_6_4 ldpm_n_2_9 ldpm_maf_1_9 ldpm_maf_gain_knk ldp_n__pq_sp_puls ldp_maf_kgh_mes_bas ldp_tia_ip_fac_maf_kgh_cor ldpm_maf_cyl_ex ldpm_maf_flow_egr ldp_n_32_ip_crlc_eff_vol_temp ldpm_n_32__eff_vol_cor ldpm_maf__eff_vol_cor ldp_v_map__map_mes_bas ldpm_tco_n_sp_1 ldpm_tco_n_sp_is_pste ldpm_toil_n_sp_is_toil ldpm_iga_n_sp_is_knk ldp_toil_ip_n_sp_is_cs_opm_1 ldp_n_n_sp_is_pl_opm_1 ldp_n_n_sp_is_pl_amt_opm_1 ldp_tq_loss_n_sp_is_pl_opm_1 ldp_tq_loss_n_sp_is_pl_amt_opm_1 ldp_n_32_n_grd_thd ldpm_gear ldp_tco__n_max_1 ldp_tco__n_max_2 ldp_vs_n_max_drof ldp_pv_av_n_max_etc_lih_2 ldp_n_32__pv_lih_max ldp_v_pvs_min ldp_vp_tecu__tecu ldpm_tia_ip_ti_cast ldpm_tco__mff_deac_cst ldpm_fac_st_rest ldpm_cyc_cast_1 ldpm_cyc_cast_2 ldp_fup_fac_ti_cast ldpm_tco__ti_st_rest ldp_tco_stop__fac_rest ldpm_tco__fac_stall ldp_t_es__rest ldp_t_ast_rest ldpm_maf_hb__ti_wup ldpm_n_32__ti_wup ldp_map_dif__fac_ti_vo_wup ldp_map__ti_fac_n_map ldp_n_32__ti_fac_n_map ldp_toil_ti_fac_tia_toil ldp_tia_ti_fac_tia_toil ldp_tco__ti_fac_tco ldpm_tco__ti_wup_h_prs ldpm_tco__ti_wup_lih_l_prs ldp_tco_st_ti_tco_wup_h_prs ldp_tco_st_ti_tco_wup_lih_l_prs ldp_fup_fac_ti_wup ldp_vp_tia_thr ldp_vp_tia_tia ldp_t_acc_ip_fac_tq_loss_acc_on ldp_n_32_ip_fac_tq_loss_acc_on ldp_n_32__tq_add_acc ldp_t_acc_fac_tq_loss_acc ldp_n_32__tq_add_heat_acc ldp_n_32__tq_loss_acc ldp_tq_accin_can__tq_loss_acc ldp_tq_loss_acc_inp__tq_add_acc ldpm_ac_veh_trv_tcs ldpm_vs_fil ldpm_n_32__tq_loss_ars ldp_tq_loss_ars_sp_can_max ldp_tq_loss_ars_av_can_max ldp_tco__tq_clu_amt ldp_n_dif__tq_clu_amt ldp_n_32_ip_tq_add_conv ldp_n_32_ip_tq_add_amt ldp_vs_fil__tq_clu_amt ldp_n_ratio_conv_fac_tq_conv ldp_toil_t_dly_n_sp_is ldp_toil_t_dly_conv ldp_toil_fac_conv ldp_gr_at_n_tur ldp_n_32__tq_conv ldp_vs_n_tur ldp_tq_conv_can__tq_conv ldp_toil_t_ramp_conv_pos ldp_toil_t_ramp_conv_neg ldpm_toil_tq_add_conv ldpm_vs_tq_add_conv ldp_n_grd_tq_add_conv ldp_ac_cru_tq_add_conv ldp_eff_scc_sp__nr_pat_scc ldp_maf__min_fcut_fast ldp_n__min_fcut_fast ldpm_tco_ip_tq_st ldpm_n_dif_ip_tq_st ldp_n_32__tqi_dif_lim ldp_tqi_sp_mon__tqi_dif_lim ldpm_gear__tq_p_max ldpm_vs_fil__tq_p_max ldpm_ang_pste_stnd_tqlo_1 ldpm_ang_pste_stnd_tqlo ldp_tq_loss_pste_2_sp_can ldpm_tq_loss_pste_3_sp_can ldp_n__fac_tq_add_pste ldpm_vs_tq_loss_pste_2 ldpm_vs_tq_loss_pste_3 ldp_vel_ang_pste_tqlo_1 ldpm_vel_ang_pste_tqlo ldpm_n_32__pste_3 ip_tq_loss_pste_3_mdl_pste ip_tq_loss_pste_3_mdl_pste_2 ip_fac_tq_loss_pste_3_mdl_pste ip_fac_tq_loss_pste_3_mdl_pste2 ip_tq_loss_pste_3_cor_pste ip_tq_loss_pste_3_cor_pste_2 ip_tq_loss_pste_3_ang_pste ip_tq_loss_pste_3_ang_pste_2 ip_fac_tq_loss_pste_3_cor_pste ip_fac_tq_loss_pste_3_cor_pste2 ip_fac_tq_loss_pste_3_pste ip_fac_tq_loss_pste_3_pste_2 ldpm_n_32_ip_rel_flow_max_cps ldpm_maf_kgh__crlc_vls_down ldpm_vs_wheel_grd_mmv_thd ldpm_tia_1 c_var_state lc_egy_min_kwp c_poil_min_kwp c_poil_max_kwp ldp_fmy_dtc ldp_tco_ip_t_ast_is_ad_inh ldp_ecfpwm lc_swi_tco_2_sub ldpm_n_t_n_dif_ofs_pred ldp_vs_fil_ip_fac_vs_tq_add_pl ldp_tq_av_ip_fac_n_grd ldp_fac_tq_req_ip_fac_tq_drof ldp_n_dif_drof__id_tq_drof ldp_n_grd__id_tq_drof ldp_gear__var_amt_load_im ldp_n_dif_pred_fac_tq_add_is_1 ldp_fac_tq_req_drof_1 ldp_tia_ip_fac_temp_tq_add_1 ldp_toil_ip_fac_temp_tq_add_1 ldp_n_grd_ip_n_dif_add_drof_1 ldp_n_sp_is_ip_n_dif_add_drof_1 ldpm_n_dif_drof_ip_tq_drof_1 ldpm_n_grd_ip_tq_drof_1 ldp_vs_fil_ip_fac_tq_drof_vs_1 ldp_n_ip_fac_tq_drof_vs_1 ldp_tq_drof_grd_deac_1 ldp_tq_drof_grd_deac_2 ldp_maf_thr_ip_amp_dec c_mff_sp_1_hom_man c_mff_sp_2_hom_man c_mff_sp_1_s_man c_mff_sp_2_s_man c_mff_sp_3_s_man lc_mff_sp_hom_man_act lc_mff_sp_s_man_act lc_mff_add_ad_lam_bal_man c_mff_sp_3_hom_man ldp_amp_ip_load_clc_amp ldp_n_32_ip_load_clc ldp_maf_ip_load_clc ldpm_tco__n_stall ldp_n_32__iga_egr_s ldp_mff_sp_s__egr_iga ldp_egr_ratio_cor_2__iga_bas ldpm_tco__iga_egr ldpm_n_32_ip_egr_ratio ldpm_maf_ip_egr_ratio c_abc_inc_ns_obd_1 c_abc_max_ns_obd_1 ip_fac_egy_level_iv_bal_cor lc_rpu_lamb_rgn_2 ldp_tq_loss_alter_1__tq_alter ldp_n_32__tq_alter ldp_idx_bsd_sdl_tbl lc_diagcps_eol_hom_req c_wgpwm_sub_diag ldpm_opm_av ldpm_opm_req ldp_tco_st_ip_fac_tq_add_ch_amp c_v_map_bas_max_diag c_v_map_bas_min_diag c_t_min_pow_clas_veh_can_req c_t_max_pow_clas_veh_can_rcv c_state_pow_clas_veh lc_veh_pow_var_err_dis c_abc_max_pow_clas_veh_err c_idx_cod_conv ldp_vs_ip_clrc_amp_plaus ip_fac_fup_sp_ch ip_fup_sp_ch c_fac_k_fil_acr_ctl c_fac_opg_sp_acr c_ccp_pt_act ldp_state_vit_id_state_srv_9 ldp_mff_mon2_ip_tqi_cus_mon2 ldp_maf_mon2_ip_iga_ref_mon2 ldp_t_per_maf_frq_ofs ldp_nmot_klphdrn_rb_0 ldp_nmot_klphdrn_rb_1 ldp_nmot_fwphdr_rb_0 ldp_nmot_fwphdr_rb_1 ldp_nmot_fwihdr_rb_1 spd06hdsw_rb_0 spd06hdsw_rb_1 snm08hduw_rb_0 snm08hduw_rb_1 spr06hduw_rb_0 spr06hduw_rb_1 ldp_nmot_w_kftamsv_rb_0 ldp_nmot_w_kftamsv_rb_1 ldp_ubsqf_w_kftamsv_rb_0 ldp_ubsqf_w_kftamsv_rb_1 ldp_ubsqf_klvzmsv_rb_1 ldp_tmsvm_klvzmsvt_rb_1 ldp_tmsvm_klvzmsvt_rb_0 ldp_nmot_fwihdr_rb_0 ldp_dwmsvd_kfvzmsvdw_rb_0 ldp_dwmsvd_kfvzmsvdw_rb_1 ldp_nmot_kfvzmsvdw_rb_0 ldp_nmot_kfvzmsvdw_rb_1 ldp_ubsqf_klvzmsv_rb_0 ldp_ubsqf_kltamsvub_rb ldp_tnse_w_klftmsv_rb_0 ldp_tnse_w_klftmsv_rb_1 ldp_nmot_klnmtmsv_rb_0 ldp_nmot_klnmtmsv_rb_1 ldp_tfuelsq_klfvstgtf_rb_0 ldp_tfuelsq_klfvstgtf_rb_1 ldp_tfuelsq_klfvstotf_rb_0 ldp_tfuelsq_klfvstotf_rb_1 ldp_nmot_kfwhzmsv_rb_0 ldp_nmot_kfwhzmsv_rb_1 ldp_ubsqf_kfwhzmsv_rb_0 ldp_ubsqf_kfwhzmsv_rb_1 ldp_ubsqf_kltamsvubs_rb lc_add_pls_mplh_pls3_ena c_mod_1_pid_1_diag c_mod_1_pid_2_diag c_mod_1_pid_3_diag c_mod_1_pid_4_diag c_mod_1_pid_5_diag c_mod_1_pid_6_diag c_mod_1_pid_7_diag c_mod_2_pid_1_diag c_mod_2_pid_2_diag c_mod_2_pid_3_diag c_obd_req c_mod_1_pid_8_diag c_mod_1_pid_9_diag c_mod_1_pid_A_diag c_mod_1_pid_B_diag c_mod_1_pid_C_diag c_mod_2_pid_4_diag /end DEF_CHARACTERISTIC
 /begin OUT_MEASUREMENT mff_sp_3_s[4] mff_sp_3_s[5] mff_sp_3_s[6] mff_sp_3_s[7] mff_sp_1_hom[0] mff_sp_1_hom[1] mff_sp_1_hom[2] mff_sp_1_hom[3] mff_sp_1_hom[4] mff_sp_1_hom[5] mff_sp_1_hom[6] mff_sp_1_hom[7] mff_sp_2_hom[0] mff_sp_2_hom[1] mff_sp_2_hom[2] mff_sp_2_hom[3] mff_sp_2_hom[4] mff_sp_2_hom[5] mff_sp_2_hom[6] mff_sp_2_hom[7] lv_eoi_st_ena lv_ti_cor_wf_opm_1_act lv_st_inj_auth lv_add_pulse_ena mff_sp_1_homs[0] mff_sp_1_homs[1] mff_sp_1_homs[2] mff_sp_1_homs[3] mff_sp_1_homs[4] mff_sp_1_homs[5] mff_sp_1_homs[6] mff_sp_1_homs[7] mff_sp_homs mff_sp_3_hom[0] mff_sp_3_hom[1] mff_sp_3_hom[2] mff_sp_3_hom[3] mff_sp_3_hom[4] mff_sp_3_hom[5] mff_sp_3_hom[6] mff_sp_3_hom[7] inj_mod_hom_req nr_inj_pls_hom_req mff_sp_2_homs[0] mff_sp_2_homs[1] mff_sp_2_homs[2] mff_sp_2_homs[3] mff_sp_2_homs[4] mff_sp_2_homs[5] mff_sp_2_homs[6] mff_sp_2_homs[7] fac_1_hom_cor[0] fac_1_hom_cor[1] fac_1_hom_cor[2] fac_1_hom_cor[3] fac_1_hom_cor[4] fac_1_hom_cor[5] fac_1_hom_cor[6] fac_1_hom_cor[7] fac_2_hom_cor[0] fac_2_hom_cor[1] fac_2_hom_cor[2] fac_2_hom_cor[3] fac_2_hom_cor[4] fac_2_hom_cor[5] fac_2_hom_cor[6] fac_2_hom_cor[7] fac_3_hom_cor[0] fac_3_hom_cor[1] fac_3_hom_cor[2] fac_3_hom_cor[3] fac_3_hom_cor[4] fac_3_hom_cor[5] fac_3_hom_cor[6] fac_3_hom_cor[7] fac_1_s_cor[0] fac_1_s_cor[1] fac_1_s_cor[2] fac_1_s_cor[3] fac_1_s_cor[4] fac_1_s_cor[5] fac_1_s_cor[6] fac_1_s_cor[7] fac_2_s_cor[0] fac_2_s_cor[1] fac_2_s_cor[2] fac_2_s_cor[3] fac_2_s_cor[4] fac_2_s_cor[5] fac_2_s_cor[6] fac_2_s_cor[7] fac_3_s_cor[0] fac_3_s_cor[1] fac_3_s_cor[2] fac_3_s_cor[3] fac_3_s_cor[4] fac_3_s_cor[5] fac_3_s_cor[6] fac_3_s_cor[7] mff_sp_hom_bas[0] mff_sp_hom_bas[1] fac_mff_wup_homs fac_mff_wup_s mff_add_wf injr.STR_INJR_ISPCLEGYIV0.fac_mff_dif_hom[0] injr.STR_INJR_ISPCLEGYIV0.fac_mff_dif_hom[1] injr.STR_INJR_ISPCLEGYIV0.fac_mff_dif_hom[2] injr.STR_INJR_ISPCLEGYIV0.fac_mff_dif_hom[3] injr.STR_INJR_ISPCLEGYIV0.fac_mff_dif_hom[4] injr.STR_INJR_ISPCLEGYIV0.fac_mff_dif_hom[5] injr.STR_INJR_ISPCLEGYIV0.fac_mff_dif_hom[6] injr.STR_INJR_ISPCLEGYIV0.fac_mff_dif_hom[7] lv_inh_dc_rbm lv_cdn_cst_rbm lv_swi_aeb lv_err_ns_obd_1_1 lv_err_ns_obd_1_2 lv_inh_nt_act lv_inh_rgn_req lv_inh_nt_afl lv_inh_nt_prj_act lv_inh_nt_stc_max lv_inh_nt_o2_stc lv_inh_rgn_req_ntld lv_inh_rgn_req_nox_sens lv_adj_nox_sens_rgn state_rgn_req lv_ntld_adj lv_tnt_mdl_max_ofs tnt_mdl_max_ofs t_vs_is_nt fac_maf_rel maf_sp map_drv1[0] map_drv1[1] map_sp[0] map_sp[1] pq_egr_sp maf_egr_neut_gas lv_tps_sub_diag_not_vld fac_maf_ad_thr_kwp[0] fac_maf_ad_thr_kwp[1] fac_maf_ad_egr_kwp[0] fac_maf_ad_egr_kwp[1] lv_puc_lock_tnt lamb_pls_ext[0] lamb_pls_ext[1] tq_max_acc state_egy_cns_off state_engg_pos state_tq_wheel tq_wheel tq_max_wheel tq_min_wheel_l lv_can_snd_msg_pwr_mng_0 lv_can_snd_msg_pwr_mng_1 lv_oil_cns_warn_1 lv_oil_cns_warn_2 lv_ldm_off lv_gs_up lv_gs_down lv_ldm_driv_act gr_dt cur_rng_ctl pow_ctl_pri_peak_red pow_ctl_pri_peak_red_cft pow_ctl_park_cns pow_ctl_pwr_cns_1 pow_ctl_pwr_cns_2 idfbosmg_w state_tq_wheel_driv_asi_av state_tq_wheel_tcs_av lv_err_ftl_obd lv_err_ftl_le_can lv_err_ftl_ri_can n_max_lih_state_cmb_s lv_cp_inh_cus mff_max_cp_cus mff_add_tq_cp mff_max_s_cus mff_max_homs_cus lv_nt_req_rgn teg_dyn_stop temp_cat teg_cat_down_mdl teg_dyn teg_cat_down_mdl_cbk[0] teg_cat_down_mdl_cbk[1] teg_stat_max_1 teg_stat_max_2 teg_stat_max teg_wall_cat_up_mdl[0] teg_wall_cat_up_mdl[1] teg_wall_cat_down_mdl[0] teg_wall_cat_down_mdl[1] teg_cat_down_mdl_bas[0] teg_cat_down_mdl_bas[1] teg_cat_up_mdl[0] teg_cat_up_mdl[1] lv_lamb_ohp_1 lv_lamb_ohp_2 tam_st tam_stop state_rbm_ftl_obd lv_err_map rfppwm[0] rfppwm[1] wgpwm[0] wgpwm[1] lv_inh_puc_cus lv_err_map_dip_sens lv_err_map_sens_1 lv_err_map_sens_2 lv_err_map_dip_shift lv_err_map_shift_1 lv_err_map_shift_2 rst_info.rst_data[0].rst_dbg_backtrace_address[0] rst_info.rst_data[0].rst_dbg_backtrace_address[1] rst_info.rst_data[0].rst_dbg_backtrace_address[2] rst_info.rst_data[0].rst_dbg_backtrace_address[3] rst_info.rst_data[0].rst_dbg_backtrace_address[4] rst_info.rst_data[0].rst_dbg_backtrace_address[5] rst_info.rst_data[0].rst_dbg_backtrace_address[6] rst_info.rst_data[0].rst_dbg_backtrace_address[7] rst_info.rst_data[0].rst_dbg_backtrace_address[8] rst_info.rst_data[0].rst_dbg_backtrace_address[9] rst_info.rst_data[0].rst_info_add rst_info.rst_data[0].rst_clas_typ rst_info.rst_data[0].rst_clas_sec rst_info.rst_data[0].rst_dbg_back_info_vld rst_info.rst_data[0].rst_run.dist_rst_det rst_info.rst_data[0].rst_run.trt_rst_det rst_info.rst_data[0].rst_run.cpu_load_rst_det rst_info.rst_data[0].rst_run.n_rst_det rst_info.rst_data[0].rst_run.cpu_load_max_rst_det rst_info.rst_data[0].rst_run.n_cpu_load_max_rst_det t_veh_pow_var_act lv_err_var_cod lv_err_veh_pow_var lv_pow_clas_veh_can_req lv_cat_conf_dis_ext_req state_mil_on_dis_ext_req pow_conf_idx_ext_req t_pow_clas_veh_can_req idx_var_cod[0] idx_var_cod[1] vin_sho[0] vin_sho[1] vin_sho[2] vin_sho[3] vin_sho[4] vin_sho[5] vin_sho[6] prot_conf_idx_ext_req lv_inh_diag_amp_plaus state_rbm_amp_plaus lv_err_rly_crcv_heat cdn_diag_rly_crcv_heat lv_inh_diag_rly_crcv_heat loc_state_adaption lv_cdn_rbm_diag_t_es tcc_com_2_icl lv_err_com_2_t_icl ctr_tout_com_2_t_icl lv_err_com_2_km_icl ctr_tout_com_2_km_icl lv_err_com_2_t_absl_icl lv_err_com_2_icl ctr_tout_com_2_icl ctr_tcc_com_2_icl lv_err_com_2_t_clk ctr_tout_com_2_t_clk t_wait_absv_com lv_err_com_2_tam_icl ctr_tout_com_2_tam_icl lv_err_com_2_cas_2 ctr_tout_com_2_cas_2 ctr_tcc_com_2_cas_2 ctr_crc_com_2_cas_2 lv_err_com_2_cas lv_err_com_2_pow_off ctr_tout_com_2_pow_off lv_err_com_2_cdn_door ctr_tout_com_2_cdn_door state_veh lv_err_com_2_state_veh lv_err_com_2_gear_rev lv_err_com_2_trl lv_err_com_2_hiv ctr_tout_com_2_gear_rev ctr_tout_com_2_state_veh ctr_tout_com_2_trl ctr_tout_veh_state ctr_tout_com_2_efp_crash lv_err_com_1_vs lv_err_com_1_tq_pste lv_err_com_1_req_tqdw lv_err_com_1_ac_lgt lv_err_com_1_ac_trv ctr_tout_com_1_vs ctr_tcc_com_1_vs ctr_crc_com_1_vs ctr_tout_com_1_ac_lgt ctr_tcc_com_1_ac_lgt ctr_crc_com_1_ac_lgt mod_1_pid_1_diag mod_1_pid_2_diag mod_1_pid_3_diag mod_1_pid_4_diag mod_1_pid_5_diag mod_1_pid_6_diag mod_1_pid_7_diag mod_1_pid_8_diag mod_1_pid_9_diag mod_1_pid_A_diag mod_1_pid_B_diag mod_1_pid_C_diag mod_2_pid_1_diag mod_2_pid_2_diag mod_2_pid_3_diag mod_2_pid_4_diag mod_2_pid_5_diag mod_2_pid_6_diag mod_2_pid_7_diag mod_2_pid_8_diag mod_2_pid_9_diag mod_2_pid_A_diag mod_2_pid_B_diag mod_2_pid_C_diag mod_5_tid_1_diag mod_5_tid_2_diag mod_5_tid_3_diag mod_5_tid_4_diag mod_5_tid_5_diag mod_5_tid_6_diag mod_5_tid_7_diag mod_5_tid_8_diag mod_5_tid_9_diag mod_5_tid_10_diag mod_5_tid_11_diag mod_5_tid_12_diag mod_5_tid_13_diag mod_5_tid_14_diag mod_5_tid_15_diag mod_5_tid_16_diag mod_5_tid_17_diag mod_5_tid_18_diag mod_5_tid_19_diag mod_5_tid_20_diag mod_6_tid_1_diag mod_6_tid_2_diag mod_6_tid_3_diag mod_6_tid_4_diag mod_9_vit_1_diag mod_9_vit_2_diag mod_9_vit_3_diag mod_9_vit_4_diag state_etcu_pos_disp state_gear_can state_etcu_gear_disp state_etcu_lih state_lock_st_gb state_gs n_gb_mpg n_gb_out_mpg fac_gb_gain_mpg n_gb_out crc_com_2_tq_etcu crc_com_3_tq_etcu tcc_com_2_tq_etcu tcc_com_3_tq_etcu crc_clc_com_2_tq_etcu crc_clc_com_3_tq_etcu crc_com_2_etcu crc_com_3_etcu tcc_com_2_etcu tcc_com_3_etcu crc_clc_com_2_etcu crc_clc_com_3_etcu lv_err_com_2_tq_etcu ctr_tout_com_2_tq_etcu ctr_tcc_com_2_tq_etcu ctr_crc_com_2_tq_etcu lv_err_com_3_tq_etcu ctr_tout_com_3_tq_etcu ctr_tcc_com_3_tq_etcu ctr_crc_com_3_tq_etcu lv_err_com_2_etcu ctr_tout_com_2_etcu ctr_tcc_com_2_etcu ctr_crc_com_2_etcu lv_err_com_3_etcu ctr_tout_com_3_etcu ctr_tcc_com_3_etcu ctr_crc_com_3_etcu lv_err_com_2_etcu_disp lv_err_com_3_etcu_disp ctr_tout_com_3_etcu_disp lv_err_com_3_etcu_obd ctr_tout_com_3_etcu_obd lv_err_com_2_gb ctr_tout_com_2_gb lv_err_com_3_gb ctr_tout_com_3_gb state_etcu_clu crc_clc_com_3_etcu_disp tcc_com_3_etcu_disp crc_com_3_etcu_disp state_etcu_shift_idc state_etcu_spt_gb state_etcu_idc_dir lv_at lv_var_pste lv_err_com_1_ang_pste ctr_tout_com_1_ang_pste lv_err_com_1_tcs ctr_tout_com_1_tcs ctr_tcc_com_1_tcs ctr_crc_com_1_tcs tcc_com_1_tcs crc_com_1_tcs crc_clc_com_1_tcs lv_err_com_1_tq_tcs lv_err_com_1_brake_tcs lv_err_com_1_tqb_tcs lv_err_com_1_wheel_tcs crc_com_1_tq_tcs crc_clc_com_1_tq_tcs state_tq_wheel_tcs_slow crc_com_1_wheel_tcs crc_clc_com_1_wheel_tcs lv_err_com_3_efp ctr_tout_com_3_efp sum_afl_vls_diag_sa_1_sae sum_afl_vls_diag_sa_2_sae vls_cor_lsl[0] vls_cor_lsl[1] lv_bts lv_clu_open lv_cvt lv_drof_inh lv_isc_diag_inh n_sp_is_clc t_ramp_lim_p_d_drof_is tq_delta_dif_is_ad tq_dif_p_d_drof_is_min tq_dif_p_d_fast_drof_is tq_dif_p_d_slow_drof_is lv_bls lv_amt lv_n_sp_is_ch lv_mtc_lih_cur_off lv_clu_swi lv_clu_swi_2 lv_pas_ramp_act_i_is lv_n_max_clc_MDBAPRIO_10MS lv_n_max_clc_AUSY_TURB_SEG lv_n_max_clc_WESE_SEG lv_n_max_clc_MDRK_SEG lv_n_max_clc_KLANN_20MS lv_n_max_clc_EISY_VERD_SEG lv_n_max_clc_MDBAFAK_10MS lv_n_max_clc_MDBANL_10MS lv_n_max_clc_ULVREG_10MS lv_n_max_clc_RAILKO_10MS lv_n_max_clc_ULVOUT_10MS dtc_pres[0] dtc_pres[1] dtc_pres[2] dtc_pres[3] dtc_pres[4] dtc_pres[5] dtc_pres[6] dtc_pres[7] dtc_pres[8] dtc_pres[9] dtc_old[0] dtc_old[1] dtc_old[2] dtc_old[3] dtc_old[4] dtc_old[5] dtc_old[6] dtc_old[7] dtc_old[8] dtc_old[9] nr_dtc_pres nr_dtc_new nr_dtc_trm_req t_dtc_trm lv_dtc_trm_req lv_dtc_trm_act lv_dtc_trm_pres lv_err_dtc_trm t_dtc_trm_pres lv_err_com_2_acc /end OUT_MEASUREMENT
/end FUNCTION
/end MODULE
/end PROJECT
