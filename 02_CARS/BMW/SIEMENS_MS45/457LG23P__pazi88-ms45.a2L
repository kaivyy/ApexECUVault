ASAP2_VERSION 1 31
/begin PROJECT MS45 "BMW Motorsteuerung R6"
/begin HEADER "_default_HeaderComment" PROJECT_NO _57 /end HEADER
/begin MODULE _default_ModuleName "_default_ModuleLongIdentifier"
/begin MOD_COMMON "_default_ModCommonComment" DEPOSIT ABSOLUTE BYTE_ORDER MSB_FIRST ALIGNMENT_BYTE 1 ALIGNMENT_WORD 2 ALIGNMENT_LONG 4 ALIGNMENT_FLOAT32_IEEE 4 ALIGNMENT_FLOAT64_IEEE 8 /end MOD_COMMON
/begin CHARACTERISTIC id_clas_b_fmt "" MAP 0xffe4400c _REC_MAP_20_u1_u2_u2 255. _CNV_A_R_LINEAR_____0_CM 0. 255. DISPLAY_IDENTIFIER ID_CLAS_B_FMT FORMAT "%3.0"
 /begin AXIS_DESCR COM_AXIS online_dummy _CNV_A_R_LINEAR_____0_CM 16 0. 65535. FORMAT "%5.0" AXIS_PTS_REF ldpm_clas_a_id_clas_fmy /end AXIS_DESCR
 /begin AXIS_DESCR COM_AXIS online_dummy _CNV_A_R_LINEAR_____0_CM 4 0. 65535. FORMAT "%5.0" AXIS_PTS_REF ldp_clas_b_id_clas_fmy /end AXIS_DESCR
/end CHARACTERISTIC
/begin CHARACTERISTIC id_clas_a_fmt "" CURVE 0xffe43ffc _REC_CUR_20_u1_u2 255. _CNV_A_R_LINEAR_____0_CM 0. 255. DISPLAY_IDENTIFIER ID_CLAS_A_FMT FORMAT "%3.0"
 /begin AXIS_DESCR COM_AXIS online_dummy _CNV_A_R_LINEAR_____0_CM 16 0. 65535. FORMAT "%5.0" AXIS_PTS_REF ldpm_clas_a_id_clas_fmy /end AXIS_DESCR
/end CHARACTERISTIC
/begin MEASUREMENT lv_dc "driving cycle status flag" UBYTE _CNV_S_2_RANGE______192_CM 1 100. 0. 1. DISPLAY_IDENTIFIER LV_DC ECU_ADDRESS 0x3fecf5 BIT_MASK 0x1 /end MEASUREMENT
/begin MEASUREMENT lv_wup_cyc "warm-up cycle status flag" UBYTE _CNV_S_2_RANGE______2_CM 1 100. 0. 1. DISPLAY_IDENTIFIER LV_WUP_CYC ECU_ADDRESS 0x3fecf7 BIT_MASK 0x1 /end MEASUREMENT
/begin MEASUREMENT lv_state_wup "TCO state for exceeding the warm-up cycle tco threshold" UBYTE _CNV_S_2_RANGE______2_CM 1 100. 0. 1. DISPLAY_IDENTIFIER LV_STATE_WUP ECU_ADDRESS 0x3fecf6 BIT_MASK 0x1 /end MEASUREMENT
/begin CHARACTERISTIC c_tco_wup_thd "OBD II required at least 72 °C for GS and 60 °C for DS engines EOBD required at least 70 °C for DS and GS engines" VALUE 0xffe4093c _REC_VAL_20_u1 190.5 _CNV_A_R_LINEAR_____11_CM -48. 142.5 DISPLAY_IDENTIFIER C_TCO_WUP_THD FORMAT "%5.1" /end CHARACTERISTIC
/begin CHARACTERISTIC c_tco_wup_inc "OBDII required at least 23 °C for GS and DS engines EOBD required at least 22 °C for GS and DS engines" VALUE 0xffe4093b _REC_VAL_20_u1 190.5 _CNV_A_R_LINEAR_____11_CM -48. 142.5 DISPLAY_IDENTIFIER C_TCO_WUP_INC FORMAT "%5.1" /end CHARACTERISTIC
/begin CHARACTERISTIC fmy_id_toil.dtc "" CURVE 0xffe41d46 _REC_CUR_20_u2_u2 65535. _CNV_A_R_LINEAR_____0_CM 0. 65535. DISPLAY_IDENTIFIER ID_ERR_DTC_TOIL FORMAT "%5.0"
 /begin AXIS_DESCR COM_AXIS online_dummy _CNV_A_R_LINEAR_____22_CM 6 0. 5. FORMAT "%2.0" AXIS_PTS_REF ldp_fmy_dtc /end AXIS_DESCR
/end CHARACTERISTIC
/begin CHARACTERISTIC fmy_id_toil.c_err_clas "" VALUE 0xffe41d56 _REC_VAL_20_u1 255. _CNV_A_R_LINEAR_____0_CM 0. 255. DISPLAY_IDENTIFIER C_ERR_CLAS_TOIL FORMAT "%3.0" /end CHARACTERISTIC
/begin CHARACTERISTIC fmy_id_tco_ex.dtc "" CURVE 0xffe41d58 _REC_CUR_20_u2_u2 65535. _CNV_A_R_LINEAR_____0_CM 0. 65535. DISPLAY_IDENTIFIER ID_ERR_DTC_TCO_EX FORMAT "%5.0"
 /begin AXIS_DESCR COM_AXIS online_dummy _CNV_A_R_LINEAR_____22_CM 6 0. 5. FORMAT "%2.0" AXIS_PTS_REF ldp_fmy_dtc /end AXIS_DESCR
/end CHARACTERISTIC
/begin CHARACTERISTIC fmy_id_tco_ex.c_err_clas "" VALUE 0xffe41d68 _REC_VAL_20_u1 255. _CNV_A_R_LINEAR_____0_CM 0. 255. DISPLAY_IDENTIFIER C_ERR_CLAS_TCO_EX FORMAT "%3.0" /end CHARACTERISTIC
/begin CHARACTERISTIC fmy_id_tia.dtc "" CURVE 0xffe41d6a _REC_CUR_20_u2_u2 65535. _CNV_A_R_LINEAR_____0_CM 0. 65535. DISPLAY_IDENTIFIER ID_ERR_DTC_TIA FORMAT "%5.0"
 /begin AXIS_DESCR COM_AXIS online_dummy _CNV_A_R_LINEAR_____22_CM 6 0. 5. FORMAT "%2.0" AXIS_PTS_REF ldp_fmy_dtc /end AXIS_DESCR
/end CHARACTERISTIC
/begin CHARACTERISTIC fmy_id_tia.c_err_clas "" VALUE 0xffe41d7a _REC_VAL_20_u1 255. _CNV_A_R_LINEAR_____0_CM 0. 255. DISPLAY_IDENTIFIER C_ERR_CLAS_TIA FORMAT "%3.0" /end CHARACTERISTIC
/begin CHARACTERISTIC fmy_id_amp.dtc "" CURVE 0xffe41d7c _REC_CUR_20_u2_u2 65535. _CNV_A_R_LINEAR_____0_CM 0. 65535. DISPLAY_IDENTIFIER ID_ERR_DTC_AMP FORMAT "%5.0"
 /begin AXIS_DESCR COM_AXIS online_dummy _CNV_A_R_LINEAR_____22_CM 6 0. 5. FORMAT "%2.0" AXIS_PTS_REF ldp_fmy_dtc /end AXIS_DESCR
/end CHARACTERISTIC
/begin CHARACTERISTIC fmy_id_amp.c_err_clas "" VALUE 0xffe41d8c _REC_VAL_20_u1 255. _CNV_A_R_LINEAR_____0_CM 0. 255. DISPLAY_IDENTIFIER C_ERR_CLAS_AMP FORMAT "%3.0" /end CHARACTERISTIC
/begin CHARACTERISTIC fmy_id_maf.dtc "" CURVE 0xffe41d8e _REC_CUR_20_u2_u2 65535. _CNV_A_R_LINEAR_____0_CM 0. 65535. DISPLAY_IDENTIFIER ID_ERR_DTC_MAF FORMAT "%5.0"
 /begin AXIS_DESCR COM_AXIS online_dummy _CNV_A_R_LINEAR_____22_CM 6 0. 5. FORMAT "%2.0" AXIS_PTS_REF ldp_fmy_dtc /end AXIS_DESCR
/end CHARACTERISTIC
/begin CHARACTERISTIC fmy_id_maf.c_err_clas "" VALUE 0xffe41d9e _REC_VAL_20_u1 255. _CNV_A_R_LINEAR_____0_CM 0. 255. DISPLAY_IDENTIFIER C_ERR_CLAS_MAF FORMAT "%3.0" /end CHARACTERISTIC
/begin CHARACTERISTIC fmy_id_vls_down_max_1.dtc "" CURVE 0xffe41da0 _REC_CUR_20_u2_u2 65535. _CNV_A_R_LINEAR_____0_CM 0. 65535. DISPLAY_IDENTIFIER ID_ERR_DTC_VLS_DOWN_MAX_1 FORMAT "%5.0"
 /begin AXIS_DESCR COM_AXIS online_dummy _CNV_A_R_LINEAR_____22_CM 6 0. 5. FORMAT "%2.0" AXIS_PTS_REF ldp_fmy_dtc /end AXIS_DESCR
/end CHARACTERISTIC
/begin CHARACTERISTIC fmy_id_vls_down_max_1.c_err_clas "" VALUE 0xffe41db0 _REC_VAL_20_u1 255. _CNV_A_R_LINEAR_____0_CM 0. 255. DISPLAY_IDENTIFIER C_ERR_CLAS_VLS_DOWN_MAX_1 FORMAT "%3.0" /end CHARACTERISTIC
/begin CHARACTERISTIC fmy_id_vls_down_max_2.dtc "" CURVE 0xffe41db2 _REC_CUR_20_u2_u2 65535. _CNV_A_R_LINEAR_____0_CM 0. 65535. DISPLAY_IDENTIFIER ID_ERR_DTC_VLS_DOWN_MAX_2 FORMAT "%5.0"
 /begin AXIS_DESCR COM_AXIS online_dummy _CNV_A_R_LINEAR_____22_CM 6 0. 5. FORMAT "%2.0" AXIS_PTS_REF ldp_fmy_dtc /end AXIS_DESCR
/end CHARACTERISTIC
/begin CHARACTERISTIC fmy_id_vls_down_max_2.c_err_clas "" VALUE 0xffe41dc2 _REC_VAL_20_u1 255. _CNV_A_R_LINEAR_____0_CM 0. 255. DISPLAY_IDENTIFIER C_ERR_CLAS_VLS_DOWN_MAX_2 FORMAT "%3.0" /end CHARACTERISTIC
/begin CHARACTERISTIC fmy_id_vls_down_min_cold_1.dtc "" CURVE 0xffe41dc4 _REC_CUR_20_u2_u2 65535. _CNV_A_R_LINEAR_____0_CM 0. 65535. DISPLAY_IDENTIFIER ID_ERR_DTC_VLS_DOWN_MIN_COLD_1 FORMAT "%5.0"
 /begin AXIS_DESCR COM_AXIS online_dummy _CNV_A_R_LINEAR_____22_CM 6 0. 5. FORMAT "%2.0" AXIS_PTS_REF ldp_fmy_dtc /end AXIS_DESCR
/end CHARACTERISTIC
/begin CHARACTERISTIC fmy_id_vls_down_min_cold_1.c_err_clas "" VALUE 0xffe41dd4 _REC_VAL_20_u1 255. _CNV_A_R_LINEAR_____0_CM 0. 255. DISPLAY_IDENTIFIER C_ERR_CLAS_VLS_DOWN_MIN_COLD_1 FORMAT "%3.0" /end CHARACTERISTIC
/begin CHARACTERISTIC fmy_id_vls_down_min_cold_2.dtc "" CURVE 0xffe41dd6 _REC_CUR_20_u2_u2 65535. _CNV_A_R_LINEAR_____0_CM 0. 65535. DISPLAY_IDENTIFIER ID_ERR_DTC_VLS_DOWN_MIN_COLD_2 FORMAT "%5.0"
 /begin AXIS_DESCR COM_AXIS online_dummy _CNV_A_R_LINEAR_____22_CM 6 0. 5. FORMAT "%2.0" AXIS_PTS_REF ldp_fmy_dtc /end AXIS_DESCR
/end CHARACTERISTIC
/begin CHARACTERISTIC fmy_id_vls_down_min_cold_2.c_err_clas "" VALUE 0xffe41de6 _REC_VAL_20_u1 255. _CNV_A_R_LINEAR_____0_CM 0. 255. DISPLAY_IDENTIFIER C_ERR_CLAS_VLS_DOWN_MIN_COLD_2 FORMAT "%3.0" /end CHARACTERISTIC
/begin CHARACTERISTIC fmy_id_vls_down_min_1.dtc "" CURVE 0xffe41de8 _REC_CUR_20_u2_u2 65535. _CNV_A_R_LINEAR_____0_CM 0. 65535. DISPLAY_IDENTIFIER ID_ERR_DTC_VLS_DOWN_MIN_1 FORMAT "%5.0"
 /begin AXIS_DESCR COM_AXIS online_dummy _CNV_A_R_LINEAR_____22_CM 6 0. 5. FORMAT "%2.0" AXIS_PTS_REF ldp_fmy_dtc /end AXIS_DESCR
/end CHARACTERISTIC
/begin CHARACTERISTIC fmy_id_vls_down_min_1.c_err_clas "" VALUE 0xffe41df8 _REC_VAL_20_u1 255. _CNV_A_R_LINEAR_____0_CM 0. 255. DISPLAY_IDENTIFIER C_ERR_CLAS_VLS_DOWN_MIN_1 FORMAT "%3.0" /end CHARACTERISTIC
/begin CHARACTERISTIC fmy_id_vls_down_min_2.dtc "" CURVE 0xffe41dfa _REC_CUR_20_u2_u2 65535. _CNV_A_R_LINEAR_____0_CM 0. 65535. DISPLAY_IDENTIFIER ID_ERR_DTC_VLS_DOWN_MIN_2 FORMAT "%5.0"
 /begin AXIS_DESCR COM_AXIS online_dummy _CNV_A_R_LINEAR_____22_CM 6 0. 5. FORMAT "%2.0" AXIS_PTS_REF ldp_fmy_dtc /end AXIS_DESCR
/end CHARACTERISTIC
/begin CHARACTERISTIC fmy_id_vls_down_min_2.c_err_clas "" VALUE 0xffe41e0a _REC_VAL_20_u1 255. _CNV_A_R_LINEAR_____0_CM 0. 255. DISPLAY_IDENTIFIER C_ERR_CLAS_VLS_DOWN_MIN_2 FORMAT "%3.0" /end CHARACTERISTIC
/begin CHARACTERISTIC fmy_id_vls_down_oc_1.dtc "" CURVE 0xffe41e0c _REC_CUR_20_u2_u2 65535. _CNV_A_R_LINEAR_____0_CM 0. 65535. DISPLAY_IDENTIFIER ID_ERR_DTC_VLS_DOWN_OC_1 FORMAT "%5.0"
 /begin AXIS_DESCR COM_AXIS online_dummy _CNV_A_R_LINEAR_____22_CM 6 0. 5. FORMAT "%2.0" AXIS_PTS_REF ldp_fmy_dtc /end AXIS_DESCR
/end CHARACTERISTIC
/begin CHARACTERISTIC fmy_id_vls_down_oc_1.c_err_clas "" VALUE 0xffe41e1c _REC_VAL_20_u1 255. _CNV_A_R_LINEAR_____0_CM 0. 255. DISPLAY_IDENTIFIER C_ERR_CLAS_VLS_DOWN_OC_1 FORMAT "%3.0" /end CHARACTERISTIC
/begin CHARACTERISTIC fmy_id_vls_down_oc_2.dtc "" CURVE 0xffe41e1e _REC_CUR_20_u2_u2 65535. _CNV_A_R_LINEAR_____0_CM 0. 65535. DISPLAY_IDENTIFIER ID_ERR_DTC_VLS_DOWN_OC_2 FORMAT "%5.0"
 /begin AXIS_DESCR COM_AXIS online_dummy _CNV_A_R_LINEAR_____22_CM 6 0. 5. FORMAT "%2.0" AXIS_PTS_REF ldp_fmy_dtc /end AXIS_DESCR
/end CHARACTERISTIC
/begin CHARACTERISTIC fmy_id_vls_down_oc_2.c_err_clas "" VALUE 0xffe41e2e _REC_VAL_20_u1 255. _CNV_A_R_LINEAR_____0_CM 0. 255. DISPLAY_IDENTIFIER C_ERR_CLAS_VLS_DOWN_OC_2 FORMAT "%3.0" /end CHARACTERISTIC
/begin CHARACTERISTIC fmy_id_iv_0.dtc "" CURVE 0xffe41e30 _REC_CUR_20_u2_u2 65535. _CNV_A_R_LINEAR_____0_CM 0. 65535. DISPLAY_IDENTIFIER ID_ERR_DTC_IV_0 FORMAT "%5.0"
 /begin AXIS_DESCR COM_AXIS online_dummy _CNV_A_R_LINEAR_____22_CM 6 0. 5. FORMAT "%2.0" AXIS_PTS_REF ldp_fmy_dtc /end AXIS_DESCR
/end CHARACTERISTIC
/begin CHARACTERISTIC fmy_id_iv_0.c_err_clas "" VALUE 0xffe41e40 _REC_VAL_20_u1 255. _CNV_A_R_LINEAR_____0_CM 0. 255. DISPLAY_IDENTIFIER C_ERR_CLAS_IV_0 FORMAT "%3.0" /end CHARACTERISTIC
/begin CHARACTERISTIC fmy_id_iv_1.dtc "" CURVE 0xffe41e42 _REC_CUR_20_u2_u2 65535. _CNV_A_R_LINEAR_____0_CM 0. 65535. DISPLAY_IDENTIFIER ID_ERR_DTC_IV_1 FORMAT "%5.0"
 /begin AXIS_DESCR COM_AXIS online_dummy _CNV_A_R_LINEAR_____22_CM 6 0. 5. FORMAT "%2.0" AXIS_PTS_REF ldp_fmy_dtc /end AXIS_DESCR
/end CHARACTERISTIC
/begin CHARACTERISTIC fmy_id_iv_1.c_err_clas "" VALUE 0xffe41e52 _REC_VAL_20_u1 255. _CNV_A_R_LINEAR_____0_CM 0. 255. DISPLAY_IDENTIFIER C_ERR_CLAS_IV_1 FORMAT "%3.0" /end CHARACTERISTIC
/begin CHARACTERISTIC fmy_id_iv_2.dtc "" CURVE 0xffe41e54 _REC_CUR_20_u2_u2 65535. _CNV_A_R_LINEAR_____0_CM 0. 65535. DISPLAY_IDENTIFIER ID_ERR_DTC_IV_2 FORMAT "%5.0"
 /begin AXIS_DESCR COM_AXIS online_dummy _CNV_A_R_LINEAR_____22_CM 6 0. 5. FORMAT "%2.0" AXIS_PTS_REF ldp_fmy_dtc /end AXIS_DESCR
/end CHARACTERISTIC
/begin CHARACTERISTIC fmy_id_iv_2.c_err_clas "" VALUE 0xffe41e64 _REC_VAL_20_u1 255. _CNV_A_R_LINEAR_____0_CM 0. 255. DISPLAY_IDENTIFIER C_ERR_CLAS_IV_2 FORMAT "%3.0" /end CHARACTERISTIC
/begin CHARACTERISTIC fmy_id_iv_3.dtc "" CURVE 0xffe41e66 _REC_CUR_20_u2_u2 65535. _CNV_A_R_LINEAR_____0_CM 0. 65535. DISPLAY_IDENTIFIER ID_ERR_DTC_IV_3 FORMAT "%5.0"
 /begin AXIS_DESCR COM_AXIS online_dummy _CNV_A_R_LINEAR_____22_CM 6 0. 5. FORMAT "%2.0" AXIS_PTS_REF ldp_fmy_dtc /end AXIS_DESCR
/end CHARACTERISTIC
/begin CHARACTERISTIC fmy_id_iv_3.c_err_clas "" VALUE 0xffe41e76 _REC_VAL_20_u1 255. _CNV_A_R_LINEAR_____0_CM 0. 255. DISPLAY_IDENTIFIER C_ERR_CLAS_IV_3 FORMAT "%3.0" /end CHARACTERISTIC
/begin CHARACTERISTIC fmy_id_iv_4.dtc "" CURVE 0xffe41e78 _REC_CUR_20_u2_u2 65535. _CNV_A_R_LINEAR_____0_CM 0. 65535. DISPLAY_IDENTIFIER ID_ERR_DTC_IV_4 FORMAT "%5.0"
 /begin AXIS_DESCR COM_AXIS online_dummy _CNV_A_R_LINEAR_____22_CM 6 0. 5. FORMAT "%2.0" AXIS_PTS_REF ldp_fmy_dtc /end AXIS_DESCR
/end CHARACTERISTIC
/begin CHARACTERISTIC fmy_id_iv_4.c_err_clas "" VALUE 0xffe41e88 _REC_VAL_20_u1 255. _CNV_A_R_LINEAR_____0_CM 0. 255. DISPLAY_IDENTIFIER C_ERR_CLAS_IV_4 FORMAT "%3.0" /end CHARACTERISTIC
/begin CHARACTERISTIC fmy_id_iv_5.dtc "" CURVE 0xffe41e8a _REC_CUR_20_u2_u2 65535. _CNV_A_R_LINEAR_____0_CM 0. 65535. DISPLAY_IDENTIFIER ID_ERR_DTC_IV_5 FORMAT "%5.0"
 /begin AXIS_DESCR COM_AXIS online_dummy _CNV_A_R_LINEAR_____22_CM 6 0. 5. FORMAT "%2.0" AXIS_PTS_REF ldp_fmy_dtc /end AXIS_DESCR
/end CHARACTERISTIC
/begin CHARACTERISTIC fmy_id_iv_5.c_err_clas "" VALUE 0xffe41e9a _REC_VAL_20_u1 255. _CNV_A_R_LINEAR_____0_CM 0. 255. DISPLAY_IDENTIFIER C_ERR_CLAS_IV_5 FORMAT "%3.0" /end CHARACTERISTIC
/begin CHARACTERISTIC fmy_id_lsh_up_1.dtc "" CURVE 0xffe41e9c _REC_CUR_20_u2_u2 65535. _CNV_A_R_LINEAR_____0_CM 0. 65535. DISPLAY_IDENTIFIER ID_ERR_DTC_LSH_UP_1 FORMAT "%5.0"
 /begin AXIS_DESCR COM_AXIS online_dummy _CNV_A_R_LINEAR_____22_CM 6 0. 5. FORMAT "%2.0" AXIS_PTS_REF ldp_fmy_dtc /end AXIS_DESCR
/end CHARACTERISTIC
/begin CHARACTERISTIC fmy_id_lsh_up_1.c_err_clas "" VALUE 0xffe41eac _REC_VAL_20_u1 255. _CNV_A_R_LINEAR_____0_CM 0. 255. DISPLAY_IDENTIFIER C_ERR_CLAS_LSH_UP_1 FORMAT "%3.0" /end CHARACTERISTIC
/begin CHARACTERISTIC fmy_id_lsh_up_2.dtc "" CURVE 0xffe41eae _REC_CUR_20_u2_u2 65535. _CNV_A_R_LINEAR_____0_CM 0. 65535. DISPLAY_IDENTIFIER ID_ERR_DTC_LSH_UP_2 FORMAT "%5.0"
 /begin AXIS_DESCR COM_AXIS online_dummy _CNV_A_R_LINEAR_____22_CM 6 0. 5. FORMAT "%2.0" AXIS_PTS_REF ldp_fmy_dtc /end AXIS_DESCR
/end CHARACTERISTIC
/begin CHARACTERISTIC fmy_id_lsh_up_2.c_err_clas "" VALUE 0xffe41ebe _REC_VAL_20_u1 255. _CNV_A_R_LINEAR_____0_CM 0. 255. DISPLAY_IDENTIFIER C_ERR_CLAS_LSH_UP_2 FORMAT "%3.0" /end CHARACTERISTIC
/begin CHARACTERISTIC fmy_id_lsh_down_1.dtc "" CURVE 0xffe41ec0 _REC_CUR_20_u2_u2 65535. _CNV_A_R_LINEAR_____0_CM 0. 65535. DISPLAY_IDENTIFIER ID_ERR_DTC_LSH_DOWN_1 FORMAT "%5.0"
 /begin AXIS_DESCR COM_AXIS online_dummy _CNV_A_R_LINEAR_____22_CM 6 0. 5. FORMAT "%2.0" AXIS_PTS_REF ldp_fmy_dtc /end AXIS_DESCR
/end CHARACTERISTIC
/begin CHARACTERISTIC fmy_id_lsh_down_1.c_err_clas "" VALUE 0xffe41ed0 _REC_VAL_20_u1 255. _CNV_A_R_LINEAR_____0_CM 0. 255. DISPLAY_IDENTIFIER C_ERR_CLAS_LSH_DOWN_1 FORMAT "%3.0" /end CHARACTERISTIC
/begin CHARACTERISTIC fmy_id_lsh_down_2.dtc "" CURVE 0xffe41ed2 _REC_CUR_20_u2_u2 65535. _CNV_A_R_LINEAR_____0_CM 0. 65535. DISPLAY_IDENTIFIER ID_ERR_DTC_LSH_DOWN_2 FORMAT "%5.0"
 /begin AXIS_DESCR COM_AXIS online_dummy _CNV_A_R_LINEAR_____22_CM 6 0. 5. FORMAT "%2.0" AXIS_PTS_REF ldp_fmy_dtc /end AXIS_DESCR
/end CHARACTERISTIC
/begin CHARACTERISTIC fmy_id_lsh_down_2.c_err_clas "" VALUE 0xffe41ee2 _REC_VAL_20_u1 255. _CNV_A_R_LINEAR_____0_CM 0. 255. DISPLAY_IDENTIFIER C_ERR_CLAS_LSH_DOWN_2 FORMAT "%3.0" /end CHARACTERISTIC
/begin CHARACTERISTIC fmy_id_rly_efp.dtc "" CURVE 0xffe41ee4 _REC_CUR_20_u2_u2 65535. _CNV_A_R_LINEAR_____0_CM 0. 65535. DISPLAY_IDENTIFIER ID_ERR_DTC_RLY_EFP FORMAT "%5.0"
 /begin AXIS_DESCR COM_AXIS online_dummy _CNV_A_R_LINEAR_____22_CM 6 0. 5. FORMAT "%2.0" AXIS_PTS_REF ldp_fmy_dtc /end AXIS_DESCR
/end CHARACTERISTIC
/begin CHARACTERISTIC fmy_id_rly_efp.c_err_clas "" VALUE 0xffe41ef4 _REC_VAL_20_u1 255. _CNV_A_R_LINEAR_____0_CM 0. 255. DISPLAY_IDENTIFIER C_ERR_CLAS_RLY_EFP FORMAT "%3.0" /end CHARACTERISTIC
/begin CHARACTERISTIC fmy_id_cps.dtc "" CURVE 0xffe41ef6 _REC_CUR_20_u2_u2 65535. _CNV_A_R_LINEAR_____0_CM 0. 65535. DISPLAY_IDENTIFIER ID_ERR_DTC_CPS FORMAT "%5.0"
 /begin AXIS_DESCR COM_AXIS online_dummy _CNV_A_R_LINEAR_____22_CM 6 0. 5. FORMAT "%2.0" AXIS_PTS_REF ldp_fmy_dtc /end AXIS_DESCR
/end CHARACTERISTIC
/begin CHARACTERISTIC fmy_id_cps.c_err_clas "" VALUE 0xffe41f06 _REC_VAL_20_u1 255. _CNV_A_R_LINEAR_____0_CM 0. 255. DISPLAY_IDENTIFIER C_ERR_CLAS_CPS FORMAT "%3.0" /end CHARACTERISTIC
/begin CHARACTERISTIC fmy_id_mec_ivvt_in_1.dtc "" CURVE 0xffe41f08 _REC_CUR_20_u2_u2 65535. _CNV_A_R_LINEAR_____0_CM 0. 65535. DISPLAY_IDENTIFIER ID_ERR_DTC_MEC_IVVT_IN_1 FORMAT "%5.0"
 /begin AXIS_DESCR COM_AXIS online_dummy _CNV_A_R_LINEAR_____22_CM 6 0. 5. FORMAT "%2.0" AXIS_PTS_REF ldp_fmy_dtc /end AXIS_DESCR
/end CHARACTERISTIC
/begin CHARACTERISTIC fmy_id_mec_ivvt_in_1.c_err_clas "" VALUE 0xffe41f18 _REC_VAL_20_u1 255. _CNV_A_R_LINEAR_____0_CM 0. 255. DISPLAY_IDENTIFIER C_ERR_CLAS_MEC_IVVT_IN_1 FORMAT "%3.0" /end CHARACTERISTIC
/begin CHARACTERISTIC fmy_id_mec_ivvt_ex_1.dtc "" CURVE 0xffe41f1a _REC_CUR_20_u2_u2 65535. _CNV_A_R_LINEAR_____0_CM 0. 65535. DISPLAY_IDENTIFIER ID_ERR_DTC_MEC_IVVT_EX_1 FORMAT "%5.0"
 /begin AXIS_DESCR COM_AXIS online_dummy _CNV_A_R_LINEAR_____22_CM 6 0. 5. FORMAT "%2.0" AXIS_PTS_REF ldp_fmy_dtc /end AXIS_DESCR
/end CHARACTERISTIC
/begin CHARACTERISTIC fmy_id_mec_ivvt_ex_1.c_err_clas "" VALUE 0xffe41f2a _REC_VAL_20_u1 255. _CNV_A_R_LINEAR_____0_CM 0. 255. DISPLAY_IDENTIFIER C_ERR_CLAS_MEC_IVVT_EX_1 FORMAT "%3.0" /end CHARACTERISTIC
/begin CHARACTERISTIC fmy_id_ref_ivvt_in_1.dtc "" CURVE 0xffe41f2c _REC_CUR_20_u2_u2 65535. _CNV_A_R_LINEAR_____0_CM 0. 65535. DISPLAY_IDENTIFIER ID_ERR_DTC_REF_IVVT_IN_1 FORMAT "%5.0"
 /begin AXIS_DESCR COM_AXIS online_dummy _CNV_A_R_LINEAR_____22_CM 6 0. 5. FORMAT "%2.0" AXIS_PTS_REF ldp_fmy_dtc /end AXIS_DESCR
/end CHARACTERISTIC
/begin CHARACTERISTIC fmy_id_ref_ivvt_in_1.c_err_clas "" VALUE 0xffe41f3c _REC_VAL_20_u1 255. _CNV_A_R_LINEAR_____0_CM 0. 255. DISPLAY_IDENTIFIER C_ERR_CLAS_REF_IVVT_IN_1 FORMAT "%3.0" /end CHARACTERISTIC
/begin CHARACTERISTIC fmy_id_ref_ivvt_ex_1.dtc "" CURVE 0xffe41f3e _REC_CUR_20_u2_u2 65535. _CNV_A_R_LINEAR_____0_CM 0. 65535. DISPLAY_IDENTIFIER ID_ERR_DTC_REF_IVVT_EX_1 FORMAT "%5.0"
 /begin AXIS_DESCR COM_AXIS online_dummy _CNV_A_R_LINEAR_____22_CM 6 0. 5. FORMAT "%2.0" AXIS_PTS_REF ldp_fmy_dtc /end AXIS_DESCR
/end CHARACTERISTIC
/begin CHARACTERISTIC fmy_id_ref_ivvt_ex_1.c_err_clas "" VALUE 0xffe41f4e _REC_VAL_20_u1 255. _CNV_A_R_LINEAR_____0_CM 0. 255. DISPLAY_IDENTIFIER C_ERR_CLAS_REF_IVVT_EX_1 FORMAT "%3.0" /end CHARACTERISTIC
/begin CHARACTERISTIC fmy_id_slv_ivvt_in_1.dtc "" CURVE 0xffe41f50 _REC_CUR_20_u2_u2 65535. _CNV_A_R_LINEAR_____0_CM 0. 65535. DISPLAY_IDENTIFIER ID_ERR_DTC_SLV_IVVT_IN_1 FORMAT "%5.0"
 /begin AXIS_DESCR COM_AXIS online_dummy _CNV_A_R_LINEAR_____22_CM 6 0. 5. FORMAT "%2.0" AXIS_PTS_REF ldp_fmy_dtc /end AXIS_DESCR
/end CHARACTERISTIC
/begin CHARACTERISTIC fmy_id_slv_ivvt_in_1.c_err_clas "" VALUE 0xffe41f60 _REC_VAL_20_u1 255. _CNV_A_R_LINEAR_____0_CM 0. 255. DISPLAY_IDENTIFIER C_ERR_CLAS_SLV_IVVT_IN_1 FORMAT "%3.0" /end CHARACTERISTIC
/begin CHARACTERISTIC fmy_id_slv_ivvt_ex_1.dtc "" CURVE 0xffe41f62 _REC_CUR_20_u2_u2 65535. _CNV_A_R_LINEAR_____0_CM 0. 65535. DISPLAY_IDENTIFIER ID_ERR_DTC_SLV_IVVT_EX_1 FORMAT "%5.0"
 /begin AXIS_DESCR COM_AXIS online_dummy _CNV_A_R_LINEAR_____22_CM 6 0. 5. FORMAT "%2.0" AXIS_PTS_REF ldp_fmy_dtc /end AXIS_DESCR
/end CHARACTERISTIC
/begin CHARACTERISTIC fmy_id_slv_ivvt_ex_1.c_err_clas "" VALUE 0xffe41f72 _REC_VAL_20_u1 255. _CNV_A_R_LINEAR_____0_CM 0. 255. DISPLAY_IDENTIFIER C_ERR_CLAS_SLV_IVVT_EX_1 FORMAT "%3.0" /end CHARACTERISTIC
/begin CHARACTERISTIC fmy_id_park_ivvt_in_1.dtc "" CURVE 0xffe41f74 _REC_CUR_20_u2_u2 65535. _CNV_A_R_LINEAR_____0_CM 0. 65535. DISPLAY_IDENTIFIER ID_ERR_DTC_PARK_IVVT_IN_1 FORMAT "%5.0"
 /begin AXIS_DESCR COM_AXIS online_dummy _CNV_A_R_LINEAR_____22_CM 6 0. 5. FORMAT "%2.0" AXIS_PTS_REF ldp_fmy_dtc /end AXIS_DESCR
/end CHARACTERISTIC
/begin CHARACTERISTIC fmy_id_park_ivvt_in_1.c_err_clas "" VALUE 0xffe41f84 _REC_VAL_20_u1 255. _CNV_A_R_LINEAR_____0_CM 0. 255. DISPLAY_IDENTIFIER C_ERR_CLAS_PARK_IVVT_IN_1 FORMAT "%3.0" /end CHARACTERISTIC
/begin CHARACTERISTIC fmy_id_park_ivvt_ex_1.dtc "" CURVE 0xffe41f86 _REC_CUR_20_u2_u2 65535. _CNV_A_R_LINEAR_____0_CM 0. 65535. DISPLAY_IDENTIFIER ID_ERR_DTC_PARK_IVVT_EX_1 FORMAT "%5.0"
 /begin AXIS_DESCR COM_AXIS online_dummy _CNV_A_R_LINEAR_____22_CM 6 0. 5. FORMAT "%2.0" AXIS_PTS_REF ldp_fmy_dtc /end AXIS_DESCR
/end CHARACTERISTIC
/begin CHARACTERISTIC fmy_id_park_ivvt_ex_1.c_err_clas "" VALUE 0xffe41f96 _REC_VAL_20_u1 255. _CNV_A_R_LINEAR_____0_CM 0. 255. DISPLAY_IDENTIFIER C_ERR_CLAS_PARK_IVVT_EX_1 FORMAT "%3.0" /end CHARACTERISTIC
/begin CHARACTERISTIC fmy_id_ecu_cks.dtc "" CURVE 0xffe41f98 _REC_CUR_20_u2_u2 65535. _CNV_A_R_LINEAR_____0_CM 0. 65535. DISPLAY_IDENTIFIER ID_ERR_DTC_ECU_CKS FORMAT "%5.0"
 /begin AXIS_DESCR COM_AXIS online_dummy _CNV_A_R_LINEAR_____22_CM 6 0. 5. FORMAT "%2.0" AXIS_PTS_REF ldp_fmy_dtc /end AXIS_DESCR
/end CHARACTERISTIC
/begin CHARACTERISTIC fmy_id_ecu_cks.c_err_clas "" VALUE 0xffe41fa8 _REC_VAL_20_u1 255. _CNV_A_R_LINEAR_____0_CM 0. 255. DISPLAY_IDENTIFIER C_ERR_CLAS_ECU_CKS FORMAT "%3.0" /end CHARACTERISTIC
/begin CHARACTERISTIC fmy_id_toil_level.dtc "" CURVE 0xffe41faa _REC_CUR_20_u2_u2 65535. _CNV_A_R_LINEAR_____0_CM 0. 65535. DISPLAY_IDENTIFIER ID_ERR_DTC_TOIL_LEVEL FORMAT "%5.0"
 /begin AXIS_DESCR COM_AXIS online_dummy _CNV_A_R_LINEAR_____22_CM 6 0. 5. FORMAT "%2.0" AXIS_PTS_REF ldp_fmy_dtc /end AXIS_DESCR
/end CHARACTERISTIC
/begin CHARACTERISTIC fmy_id_toil_level.c_err_clas "" VALUE 0xffe41fba _REC_VAL_20_u1 255. _CNV_A_R_LINEAR_____0_CM 0. 255. DISPLAY_IDENTIFIER C_ERR_CLAS_TOIL_LEVEL FORMAT "%3.0" /end CHARACTERISTIC
/begin CHARACTERISTIC fmy_id_tout_etcu_1.dtc "" CURVE 0xffe41fbc _REC_CUR_20_u2_u2 65535. _CNV_A_R_LINEAR_____0_CM 0. 65535. DISPLAY_IDENTIFIER ID_ERR_DTC_TOUT_ETCU_1 FORMAT "%5.0"
 /begin AXIS_DESCR COM_AXIS online_dummy _CNV_A_R_LINEAR_____22_CM 6 0. 5. FORMAT "%2.0" AXIS_PTS_REF ldp_fmy_dtc /end AXIS_DESCR
/end CHARACTERISTIC
/begin CHARACTERISTIC fmy_id_tout_etcu_1.c_err_clas "" VALUE 0xffe41fcc _REC_VAL_20_u1 255. _CNV_A_R_LINEAR_____0_CM 0. 255. DISPLAY_IDENTIFIER C_ERR_CLAS_TOUT_ETCU_1 FORMAT "%3.0" /end CHARACTERISTIC
/begin CHARACTERISTIC fmy_id_tout_etcu_2.dtc "" CURVE 0xffe41fce _REC_CUR_20_u2_u2 65535. _CNV_A_R_LINEAR_____0_CM 0. 65535. DISPLAY_IDENTIFIER ID_ERR_DTC_TOUT_ETCU_2 FORMAT "%5.0"
 /begin AXIS_DESCR COM_AXIS online_dummy _CNV_A_R_LINEAR_____22_CM 6 0. 5. FORMAT "%2.0" AXIS_PTS_REF ldp_fmy_dtc /end AXIS_DESCR
/end CHARACTERISTIC
/begin CHARACTERISTIC fmy_id_tout_etcu_2.c_err_clas "" VALUE 0xffe41fde _REC_VAL_20_u1 255. _CNV_A_R_LINEAR_____0_CM 0. 255. DISPLAY_IDENTIFIER C_ERR_CLAS_TOUT_ETCU_2 FORMAT "%3.0" /end CHARACTERISTIC
/begin CHARACTERISTIC fmy_id_tout_icl_2.dtc "" CURVE 0xffe41fe0 _REC_CUR_20_u2_u2 65535. _CNV_A_R_LINEAR_____0_CM 0. 65535. DISPLAY_IDENTIFIER ID_ERR_DTC_TOUT_ICL_2 FORMAT "%5.0"
 /begin AXIS_DESCR COM_AXIS online_dummy _CNV_A_R_LINEAR_____22_CM 6 0. 5. FORMAT "%2.0" AXIS_PTS_REF ldp_fmy_dtc /end AXIS_DESCR
/end CHARACTERISTIC
/begin CHARACTERISTIC fmy_id_tout_icl_2.c_err_clas "" VALUE 0xffe41ff0 _REC_VAL_20_u1 255. _CNV_A_R_LINEAR_____0_CM 0. 255. DISPLAY_IDENTIFIER C_ERR_CLAS_TOUT_ICL_2 FORMAT "%3.0" /end CHARACTERISTIC
/begin CHARACTERISTIC fmy_id_tout_icl_3.dtc "" CURVE 0xffe41ff2 _REC_CUR_20_u2_u2 65535. _CNV_A_R_LINEAR_____0_CM 0. 65535. DISPLAY_IDENTIFIER ID_ERR_DTC_TOUT_ICL_3 FORMAT "%5.0"
 /begin AXIS_DESCR COM_AXIS online_dummy _CNV_A_R_LINEAR_____22_CM 6 0. 5. FORMAT "%2.0" AXIS_PTS_REF ldp_fmy_dtc /end AXIS_DESCR
/end CHARACTERISTIC
/begin CHARACTERISTIC fmy_id_tout_icl_3.c_err_clas "" VALUE 0xffe42002 _REC_VAL_20_u1 255. _CNV_A_R_LINEAR_____0_CM 0. 255. DISPLAY_IDENTIFIER C_ERR_CLAS_TOUT_ICL_3 FORMAT "%3.0" /end CHARACTERISTIC
/begin CHARACTERISTIC fmy_id_tout_asr_1.dtc "" CURVE 0xffe42004 _REC_CUR_20_u2_u2 65535. _CNV_A_R_LINEAR_____0_CM 0. 65535. DISPLAY_IDENTIFIER ID_ERR_DTC_TOUT_ASR_1 FORMAT "%5.0"
 /begin AXIS_DESCR COM_AXIS online_dummy _CNV_A_R_LINEAR_____22_CM 6 0. 5. FORMAT "%2.0" AXIS_PTS_REF ldp_fmy_dtc /end AXIS_DESCR
/end CHARACTERISTIC
/begin CHARACTERISTIC fmy_id_tout_asr_1.c_err_clas "" VALUE 0xffe42014 _REC_VAL_20_u1 255. _CNV_A_R_LINEAR_____0_CM 0. 255. DISPLAY_IDENTIFIER C_ERR_CLAS_TOUT_ASR_1 FORMAT "%3.0" /end CHARACTERISTIC
/begin CHARACTERISTIC fmy_id_tout_asr_3.dtc "" CURVE 0xffe42016 _REC_CUR_20_u2_u2 65535. _CNV_A_R_LINEAR_____0_CM 0. 65535. DISPLAY_IDENTIFIER ID_ERR_DTC_TOUT_ASR_3 FORMAT "%5.0"
 /begin AXIS_DESCR COM_AXIS online_dummy _CNV_A_R_LINEAR_____22_CM 6 0. 5. FORMAT "%2.0" AXIS_PTS_REF ldp_fmy_dtc /end AXIS_DESCR
/end CHARACTERISTIC
/begin CHARACTERISTIC fmy_id_tout_asr_3.c_err_clas "" VALUE 0xffe42026 _REC_VAL_20_u1 255. _CNV_A_R_LINEAR_____0_CM 0. 255. DISPLAY_IDENTIFIER C_ERR_CLAS_TOUT_ASR_3 FORMAT "%3.0" /end CHARACTERISTIC
/begin CHARACTERISTIC fmy_id_tout_asr_4.dtc "" CURVE 0xffe42028 _REC_CUR_20_u2_u2 65535. _CNV_A_R_LINEAR_____0_CM 0. 65535. DISPLAY_IDENTIFIER ID_ERR_DTC_TOUT_ASR_4 FORMAT "%5.0"
 /begin AXIS_DESCR COM_AXIS online_dummy _CNV_A_R_LINEAR_____22_CM 6 0. 5. FORMAT "%2.0" AXIS_PTS_REF ldp_fmy_dtc /end AXIS_DESCR
/end CHARACTERISTIC
/begin CHARACTERISTIC fmy_id_tout_asr_4.c_err_clas "" VALUE 0xffe42038 _REC_VAL_20_u1 255. _CNV_A_R_LINEAR_____0_CM 0. 255. DISPLAY_IDENTIFIER C_ERR_CLAS_TOUT_ASR_4 FORMAT "%3.0" /end CHARACTERISTIC
/begin CHARACTERISTIC fmy_id_tout_pste_1.dtc "" CURVE 0xffe4203a _REC_CUR_20_u2_u2 65535. _CNV_A_R_LINEAR_____0_CM 0. 65535. DISPLAY_IDENTIFIER ID_ERR_DTC_TOUT_PSTE_1 FORMAT "%5.0"
 /begin AXIS_DESCR COM_AXIS online_dummy _CNV_A_R_LINEAR_____22_CM 6 0. 5. FORMAT "%2.0" AXIS_PTS_REF ldp_fmy_dtc /end AXIS_DESCR
/end CHARACTERISTIC
/begin CHARACTERISTIC fmy_id_tout_pste_1.c_err_clas "" VALUE 0xffe4204a _REC_VAL_20_u1 255. _CNV_A_R_LINEAR_____0_CM 0. 255. DISPLAY_IDENTIFIER C_ERR_CLAS_TOUT_PSTE_1 FORMAT "%3.0" /end CHARACTERISTIC
/begin CHARACTERISTIC fmy_id_tout_amt_1.dtc "" CURVE 0xffe4204c _REC_CUR_20_u2_u2 65535. _CNV_A_R_LINEAR_____0_CM 0. 65535. DISPLAY_IDENTIFIER ID_ERR_DTC_TOUT_AMT_1 FORMAT "%5.0"
 /begin AXIS_DESCR COM_AXIS online_dummy _CNV_A_R_LINEAR_____22_CM 6 0. 5. FORMAT "%2.0" AXIS_PTS_REF ldp_fmy_dtc /end AXIS_DESCR
/end CHARACTERISTIC
/begin CHARACTERISTIC fmy_id_tout_amt_1.c_err_clas "" VALUE 0xffe4205c _REC_VAL_20_u1 255. _CNV_A_R_LINEAR_____0_CM 0. 255. DISPLAY_IDENTIFIER C_ERR_CLAS_TOUT_AMT_1 FORMAT "%3.0" /end CHARACTERISTIC
/begin CHARACTERISTIC fmy_id_vs.dtc "" CURVE 0xffe4205e _REC_CUR_20_u2_u2 65535. _CNV_A_R_LINEAR_____0_CM 0. 65535. DISPLAY_IDENTIFIER ID_ERR_DTC_VS FORMAT "%5.0"
 /begin AXIS_DESCR COM_AXIS online_dummy _CNV_A_R_LINEAR_____22_CM 6 0. 5. FORMAT "%2.0" AXIS_PTS_REF ldp_fmy_dtc /end AXIS_DESCR
/end CHARACTERISTIC
/begin CHARACTERISTIC fmy_id_vs.c_err_clas "" VALUE 0xffe4206e _REC_VAL_20_u1 255. _CNV_A_R_LINEAR_____0_CM 0. 255. DISPLAY_IDENTIFIER C_ERR_CLAS_VS FORMAT "%3.0" /end CHARACTERISTIC
/begin CHARACTERISTIC fmy_id_knks_1.dtc "" CURVE 0xffe42070 _REC_CUR_20_u2_u2 65535. _CNV_A_R_LINEAR_____0_CM 0. 65535. DISPLAY_IDENTIFIER ID_ERR_DTC_KNKS_1 FORMAT "%5.0"
 /begin AXIS_DESCR COM_AXIS online_dummy _CNV_A_R_LINEAR_____22_CM 6 0. 5. FORMAT "%2.0" AXIS_PTS_REF ldp_fmy_dtc /end AXIS_DESCR
/end CHARACTERISTIC
/begin CHARACTERISTIC fmy_id_knks_1.c_err_clas "" VALUE 0xffe42080 _REC_VAL_20_u1 255. _CNV_A_R_LINEAR_____0_CM 0. 255. DISPLAY_IDENTIFIER C_ERR_CLAS_KNKS_1 FORMAT "%3.0" /end CHARACTERISTIC
/begin CHARACTERISTIC fmy_id_knks_2.dtc "" CURVE 0xffe42082 _REC_CUR_20_u2_u2 65535. _CNV_A_R_LINEAR_____0_CM 0. 65535. DISPLAY_IDENTIFIER ID_ERR_DTC_KNKS_2 FORMAT "%5.0"
 /begin AXIS_DESCR COM_AXIS online_dummy _CNV_A_R_LINEAR_____22_CM 6 0. 5. FORMAT "%2.0" AXIS_PTS_REF ldp_fmy_dtc /end AXIS_DESCR
/end CHARACTERISTIC
/begin CHARACTERISTIC fmy_id_knks_2.c_err_clas "" VALUE 0xffe42092 _REC_VAL_20_u1 255. _CNV_A_R_LINEAR_____0_CM 0. 255. DISPLAY_IDENTIFIER C_ERR_CLAS_KNKS_2 FORMAT "%3.0" /end CHARACTERISTIC
/begin CHARACTERISTIC fmy_id_td_igc_cut_0.dtc "" CURVE 0xffe42094 _REC_CUR_20_u2_u2 65535. _CNV_A_R_LINEAR_____0_CM 0. 65535. DISPLAY_IDENTIFIER ID_ERR_DTC_TD_IGC_CUT_0 FORMAT "%5.0"
 /begin AXIS_DESCR COM_AXIS online_dummy _CNV_A_R_LINEAR_____22_CM 6 0. 5. FORMAT "%2.0" AXIS_PTS_REF ldp_fmy_dtc /end AXIS_DESCR
/end CHARACTERISTIC
/begin CHARACTERISTIC fmy_id_td_igc_cut_0.c_err_clas "" VALUE 0xffe420a4 _REC_VAL_20_u1 255. _CNV_A_R_LINEAR_____0_CM 0. 255. DISPLAY_IDENTIFIER C_ERR_CLAS_TD_IGC_CUT_0 FORMAT "%3.0" /end CHARACTERISTIC
/begin CHARACTERISTIC fmy_id_td_igc_cut_1.dtc "" CURVE 0xffe420a6 _REC_CUR_20_u2_u2 65535. _CNV_A_R_LINEAR_____0_CM 0. 65535. DISPLAY_IDENTIFIER ID_ERR_DTC_TD_IGC_CUT_1 FORMAT "%5.0"
 /begin AXIS_DESCR COM_AXIS online_dummy _CNV_A_R_LINEAR_____22_CM 6 0. 5. FORMAT "%2.0" AXIS_PTS_REF ldp_fmy_dtc /end AXIS_DESCR
/end CHARACTERISTIC
/begin CHARACTERISTIC fmy_id_td_igc_cut_1.c_err_clas "" VALUE 0xffe420b6 _REC_VAL_20_u1 255. _CNV_A_R_LINEAR_____0_CM 0. 255. DISPLAY_IDENTIFIER C_ERR_CLAS_TD_IGC_CUT_1 FORMAT "%3.0" /end CHARACTERISTIC
/begin CHARACTERISTIC fmy_id_td_igc_cut_2.dtc "" CURVE 0xffe420b8 _REC_CUR_20_u2_u2 65535. _CNV_A_R_LINEAR_____0_CM 0. 65535. DISPLAY_IDENTIFIER ID_ERR_DTC_TD_IGC_CUT_2 FORMAT "%5.0"
 /begin AXIS_DESCR COM_AXIS online_dummy _CNV_A_R_LINEAR_____22_CM 6 0. 5. FORMAT "%2.0" AXIS_PTS_REF ldp_fmy_dtc /end AXIS_DESCR
/end CHARACTERISTIC
/begin CHARACTERISTIC fmy_id_td_igc_cut_2.c_err_clas "" VALUE 0xffe420c8 _REC_VAL_20_u1 255. _CNV_A_R_LINEAR_____0_CM 0. 255. DISPLAY_IDENTIFIER C_ERR_CLAS_TD_IGC_CUT_2 FORMAT "%3.0" /end CHARACTERISTIC
/begin CHARACTERISTIC fmy_id_td_igc_cut_3.dtc "" CURVE 0xffe420ca _REC_CUR_20_u2_u2 65535. _CNV_A_R_LINEAR_____0_CM 0. 65535. DISPLAY_IDENTIFIER ID_ERR_DTC_TD_IGC_CUT_3 FORMAT "%5.0"
 /begin AXIS_DESCR COM_AXIS online_dummy _CNV_A_R_LINEAR_____22_CM 6 0. 5. FORMAT "%2.0" AXIS_PTS_REF ldp_fmy_dtc /end AXIS_DESCR
/end CHARACTERISTIC
/begin CHARACTERISTIC fmy_id_td_igc_cut_3.c_err_clas "" VALUE 0xffe420da _REC_VAL_20_u1 255. _CNV_A_R_LINEAR_____0_CM 0. 255. DISPLAY_IDENTIFIER C_ERR_CLAS_TD_IGC_CUT_3 FORMAT "%3.0" /end CHARACTERISTIC
/begin CHARACTERISTIC fmy_id_td_igc_cut_4.dtc "" CURVE 0xffe420dc _REC_CUR_20_u2_u2 65535. _CNV_A_R_LINEAR_____0_CM 0. 65535. DISPLAY_IDENTIFIER ID_ERR_DTC_TD_IGC_CUT_4 FORMAT "%5.0"
 /begin AXIS_DESCR COM_AXIS online_dummy _CNV_A_R_LINEAR_____22_CM 6 0. 5. FORMAT "%2.0" AXIS_PTS_REF ldp_fmy_dtc /end AXIS_DESCR
/end CHARACTERISTIC
/begin CHARACTERISTIC fmy_id_td_igc_cut_4.c_err_clas "" VALUE 0xffe420ec _REC_VAL_20_u1 255. _CNV_A_R_LINEAR_____0_CM 0. 255. DISPLAY_IDENTIFIER C_ERR_CLAS_TD_IGC_CUT_4 FORMAT "%3.0" /end CHARACTERISTIC
/begin CHARACTERISTIC fmy_id_td_igc_cut_5.dtc "" CURVE 0xffe420ee _REC_CUR_20_u2_u2 65535. _CNV_A_R_LINEAR_____0_CM 0. 65535. DISPLAY_IDENTIFIER ID_ERR_DTC_TD_IGC_CUT_5 FORMAT "%5.0"
 /begin AXIS_DESCR COM_AXIS online_dummy _CNV_A_R_LINEAR_____22_CM 6 0. 5. FORMAT "%2.0" AXIS_PTS_REF ldp_fmy_dtc /end AXIS_DESCR
/end CHARACTERISTIC
/begin CHARACTERISTIC fmy_id_td_igc_cut_5.c_err_clas "" VALUE 0xffe420fe _REC_VAL_20_u1 255. _CNV_A_R_LINEAR_____0_CM 0. 255. DISPLAY_IDENTIFIER C_ERR_CLAS_TD_IGC_CUT_5 FORMAT "%3.0" /end CHARACTERISTIC
/begin CHARACTERISTIC fmy_id_dur_igc_0.dtc "" CURVE 0xffe42100 _REC_CUR_20_u2_u2 65535. _CNV_A_R_LINEAR_____0_CM 0. 65535. DISPLAY_IDENTIFIER ID_ERR_DTC_DUR_IGC_0 FORMAT "%5.0"
 /begin AXIS_DESCR COM_AXIS online_dummy _CNV_A_R_LINEAR_____22_CM 6 0. 5. FORMAT "%2.0" AXIS_PTS_REF ldp_fmy_dtc /end AXIS_DESCR
/end CHARACTERISTIC
/begin CHARACTERISTIC fmy_id_dur_igc_0.c_err_clas "" VALUE 0xffe42110 _REC_VAL_20_u1 255. _CNV_A_R_LINEAR_____0_CM 0. 255. DISPLAY_IDENTIFIER C_ERR_CLAS_DUR_IGC_0 FORMAT "%3.0" /end CHARACTERISTIC
/begin CHARACTERISTIC fmy_id_dur_igc_1.dtc "" CURVE 0xffe42112 _REC_CUR_20_u2_u2 65535. _CNV_A_R_LINEAR_____0_CM 0. 65535. DISPLAY_IDENTIFIER ID_ERR_DTC_DUR_IGC_1 FORMAT "%5.0"
 /begin AXIS_DESCR COM_AXIS online_dummy _CNV_A_R_LINEAR_____22_CM 6 0. 5. FORMAT "%2.0" AXIS_PTS_REF ldp_fmy_dtc /end AXIS_DESCR
/end CHARACTERISTIC
/begin CHARACTERISTIC fmy_id_dur_igc_1.c_err_clas "" VALUE 0xffe42122 _REC_VAL_20_u1 255. _CNV_A_R_LINEAR_____0_CM 0. 255. DISPLAY_IDENTIFIER C_ERR_CLAS_DUR_IGC_1 FORMAT "%3.0" /end CHARACTERISTIC
/begin CHARACTERISTIC fmy_id_dur_igc_2.dtc "" CURVE 0xffe42124 _REC_CUR_20_u2_u2 65535. _CNV_A_R_LINEAR_____0_CM 0. 65535. DISPLAY_IDENTIFIER ID_ERR_DTC_DUR_IGC_2 FORMAT "%5.0"
 /begin AXIS_DESCR COM_AXIS online_dummy _CNV_A_R_LINEAR_____22_CM 6 0. 5. FORMAT "%2.0" AXIS_PTS_REF ldp_fmy_dtc /end AXIS_DESCR
/end CHARACTERISTIC
/begin CHARACTERISTIC fmy_id_dur_igc_2.c_err_clas "" VALUE 0xffe42134 _REC_VAL_20_u1 255. _CNV_A_R_LINEAR_____0_CM 0. 255. DISPLAY_IDENTIFIER C_ERR_CLAS_DUR_IGC_2 FORMAT "%3.0" /end CHARACTERISTIC
/begin CHARACTERISTIC fmy_id_dur_igc_3.dtc "" CURVE 0xffe42136 _REC_CUR_20_u2_u2 65535. _CNV_A_R_LINEAR_____0_CM 0. 65535. DISPLAY_IDENTIFIER ID_ERR_DTC_DUR_IGC_3 FORMAT "%5.0"
 /begin AXIS_DESCR COM_AXIS online_dummy _CNV_A_R_LINEAR_____22_CM 6 0. 5. FORMAT "%2.0" AXIS_PTS_REF ldp_fmy_dtc /end AXIS_DESCR
/end CHARACTERISTIC
/begin CHARACTERISTIC fmy_id_dur_igc_3.c_err_clas "" VALUE 0xffe42146 _REC_VAL_20_u1 255. _CNV_A_R_LINEAR_____0_CM 0. 255. DISPLAY_IDENTIFIER C_ERR_CLAS_DUR_IGC_3 FORMAT "%3.0" /end CHARACTERISTIC
/begin CHARACTERISTIC fmy_id_dur_igc_4.dtc "" CURVE 0xffe42148 _REC_CUR_20_u2_u2 65535. _CNV_A_R_LINEAR_____0_CM 0. 65535. DISPLAY_IDENTIFIER ID_ERR_DTC_DUR_IGC_4 FORMAT "%5.0"
 /begin AXIS_DESCR COM_AXIS online_dummy _CNV_A_R_LINEAR_____22_CM 6 0. 5. FORMAT "%2.0" AXIS_PTS_REF ldp_fmy_dtc /end AXIS_DESCR
/end CHARACTERISTIC
/begin CHARACTERISTIC fmy_id_dur_igc_4.c_err_clas "" VALUE 0xffe42158 _REC_VAL_20_u1 255. _CNV_A_R_LINEAR_____0_CM 0. 255. DISPLAY_IDENTIFIER C_ERR_CLAS_DUR_IGC_4 FORMAT "%3.0" /end CHARACTERISTIC
/begin CHARACTERISTIC fmy_id_dur_igc_5.dtc "" CURVE 0xffe4215a _REC_CUR_20_u2_u2 65535. _CNV_A_R_LINEAR_____0_CM 0. 65535. DISPLAY_IDENTIFIER ID_ERR_DTC_DUR_IGC_5 FORMAT "%5.0"
 /begin AXIS_DESCR COM_AXIS online_dummy _CNV_A_R_LINEAR_____22_CM 6 0. 5. FORMAT "%2.0" AXIS_PTS_REF ldp_fmy_dtc /end AXIS_DESCR
/end CHARACTERISTIC
/begin CHARACTERISTIC fmy_id_dur_igc_5.c_err_clas "" VALUE 0xffe4216a _REC_VAL_20_u1 255. _CNV_A_R_LINEAR_____0_CM 0. 255. DISPLAY_IDENTIFIER C_ERR_CLAS_DUR_IGC_5 FORMAT "%3.0" /end CHARACTERISTIC
/begin CHARACTERISTIC fmy_id_tps_1.dtc "" CURVE 0xffe4216c _REC_CUR_20_u2_u2 65535. _CNV_A_R_LINEAR_____0_CM 0. 65535. DISPLAY_IDENTIFIER ID_ERR_DTC_TPS_1 FORMAT "%5.0"
 /begin AXIS_DESCR COM_AXIS online_dummy _CNV_A_R_LINEAR_____22_CM 6 0. 5. FORMAT "%2.0" AXIS_PTS_REF ldp_fmy_dtc /end AXIS_DESCR
/end CHARACTERISTIC
/begin CHARACTERISTIC fmy_id_tps_1.c_err_clas "" VALUE 0xffe4217c _REC_VAL_20_u1 255. _CNV_A_R_LINEAR_____0_CM 0. 255. DISPLAY_IDENTIFIER C_ERR_CLAS_TPS_1 FORMAT "%3.0" /end CHARACTERISTIC
/begin CHARACTERISTIC fmy_id_tps_2.dtc "" CURVE 0xffe4217e _REC_CUR_20_u2_u2 65535. _CNV_A_R_LINEAR_____0_CM 0. 65535. DISPLAY_IDENTIFIER ID_ERR_DTC_TPS_2 FORMAT "%5.0"
 /begin AXIS_DESCR COM_AXIS online_dummy _CNV_A_R_LINEAR_____22_CM 6 0. 5. FORMAT "%2.0" AXIS_PTS_REF ldp_fmy_dtc /end AXIS_DESCR
/end CHARACTERISTIC
/begin CHARACTERISTIC fmy_id_tps_2.c_err_clas "" VALUE 0xffe4218e _REC_VAL_20_u1 255. _CNV_A_R_LINEAR_____0_CM 0. 255. DISPLAY_IDENTIFIER C_ERR_CLAS_TPS_2 FORMAT "%3.0" /end CHARACTERISTIC
/begin CHARACTERISTIC fmy_id_tps_maf_1.dtc "" CURVE 0xffe42190 _REC_CUR_20_u2_u2 65535. _CNV_A_R_LINEAR_____0_CM 0. 65535. DISPLAY_IDENTIFIER ID_ERR_DTC_TPS_MAF_1 FORMAT "%5.0"
 /begin AXIS_DESCR COM_AXIS online_dummy _CNV_A_R_LINEAR_____22_CM 6 0. 5. FORMAT "%2.0" AXIS_PTS_REF ldp_fmy_dtc /end AXIS_DESCR
/end CHARACTERISTIC
/begin CHARACTERISTIC fmy_id_tps_maf_1.c_err_clas "" VALUE 0xffe421a0 _REC_VAL_20_u1 255. _CNV_A_R_LINEAR_____0_CM 0. 255. DISPLAY_IDENTIFIER C_ERR_CLAS_TPS_MAF_1 FORMAT "%3.0" /end CHARACTERISTIC
/begin CHARACTERISTIC fmy_id_tps_maf_2.dtc "" CURVE 0xffe421a2 _REC_CUR_20_u2_u2 65535. _CNV_A_R_LINEAR_____0_CM 0. 65535. DISPLAY_IDENTIFIER ID_ERR_DTC_TPS_MAF_2 FORMAT "%5.0"
 /begin AXIS_DESCR COM_AXIS online_dummy _CNV_A_R_LINEAR_____22_CM 6 0. 5. FORMAT "%2.0" AXIS_PTS_REF ldp_fmy_dtc /end AXIS_DESCR
/end CHARACTERISTIC
/begin CHARACTERISTIC fmy_id_tps_maf_2.c_err_clas "" VALUE 0xffe421b2 _REC_VAL_20_u1 255. _CNV_A_R_LINEAR_____0_CM 0. 255. DISPLAY_IDENTIFIER C_ERR_CLAS_TPS_MAF_2 FORMAT "%3.0" /end CHARACTERISTIC
/begin CHARACTERISTIC fmy_id_v_ref_1.dtc "" CURVE 0xffe421b4 _REC_CUR_20_u2_u2 65535. _CNV_A_R_LINEAR_____0_CM 0. 65535. DISPLAY_IDENTIFIER ID_ERR_DTC_V_REF_1 FORMAT "%5.0"
 /begin AXIS_DESCR COM_AXIS online_dummy _CNV_A_R_LINEAR_____22_CM 6 0. 5. FORMAT "%2.0" AXIS_PTS_REF ldp_fmy_dtc /end AXIS_DESCR
/end CHARACTERISTIC
/begin CHARACTERISTIC fmy_id_v_ref_1.c_err_clas "" VALUE 0xffe421c4 _REC_VAL_20_u1 255. _CNV_A_R_LINEAR_____0_CM 0. 255. DISPLAY_IDENTIFIER C_ERR_CLAS_V_REF_1 FORMAT "%3.0" /end CHARACTERISTIC
/begin CHARACTERISTIC fmy_id_v_ref_2.dtc "" CURVE 0xffe421c6 _REC_CUR_20_u2_u2 65535. _CNV_A_R_LINEAR_____0_CM 0. 65535. DISPLAY_IDENTIFIER ID_ERR_DTC_V_REF_2 FORMAT "%5.0"
 /begin AXIS_DESCR COM_AXIS online_dummy _CNV_A_R_LINEAR_____22_CM 6 0. 5. FORMAT "%2.0" AXIS_PTS_REF ldp_fmy_dtc /end AXIS_DESCR
/end CHARACTERISTIC
/begin CHARACTERISTIC fmy_id_v_ref_2.c_err_clas "" VALUE 0xffe421d6 _REC_VAL_20_u1 255. _CNV_A_R_LINEAR_____0_CM 0. 255. DISPLAY_IDENTIFIER C_ERR_CLAS_V_REF_2 FORMAT "%3.0" /end CHARACTERISTIC
/begin CHARACTERISTIC fmy_id_pvs_1.dtc "" CURVE 0xffe421d8 _REC_CUR_20_u2_u2 65535. _CNV_A_R_LINEAR_____0_CM 0. 65535. DISPLAY_IDENTIFIER ID_ERR_DTC_PVS_1 FORMAT "%5.0"
 /begin AXIS_DESCR COM_AXIS online_dummy _CNV_A_R_LINEAR_____22_CM 6 0. 5. FORMAT "%2.0" AXIS_PTS_REF ldp_fmy_dtc /end AXIS_DESCR
/end CHARACTERISTIC
/begin CHARACTERISTIC fmy_id_pvs_1.c_err_clas "" VALUE 0xffe421e8 _REC_VAL_20_u1 255. _CNV_A_R_LINEAR_____0_CM 0. 255. DISPLAY_IDENTIFIER C_ERR_CLAS_PVS_1 FORMAT "%3.0" /end CHARACTERISTIC
/begin CHARACTERISTIC fmy_id_pvs_2.dtc "" CURVE 0xffe421ea _REC_CUR_20_u2_u2 65535. _CNV_A_R_LINEAR_____0_CM 0. 65535. DISPLAY_IDENTIFIER ID_ERR_DTC_PVS_2 FORMAT "%5.0"
 /begin AXIS_DESCR COM_AXIS online_dummy _CNV_A_R_LINEAR_____22_CM 6 0. 5. FORMAT "%2.0" AXIS_PTS_REF ldp_fmy_dtc /end AXIS_DESCR
/end CHARACTERISTIC
/begin CHARACTERISTIC fmy_id_pvs_2.c_err_clas "" VALUE 0xffe421fa _REC_VAL_20_u1 255. _CNV_A_R_LINEAR_____0_CM 0. 255. DISPLAY_IDENTIFIER C_ERR_CLAS_PVS_2 FORMAT "%3.0" /end CHARACTERISTIC
/begin CHARACTERISTIC fmy_id_pvs_ratio.dtc "" CURVE 0xffe421fc _REC_CUR_20_u2_u2 65535. _CNV_A_R_LINEAR_____0_CM 0. 65535. DISPLAY_IDENTIFIER ID_ERR_DTC_PVS_RATIO FORMAT "%5.0"
 /begin AXIS_DESCR COM_AXIS online_dummy _CNV_A_R_LINEAR_____22_CM 6 0. 5. FORMAT "%2.0" AXIS_PTS_REF ldp_fmy_dtc /end AXIS_DESCR
/end CHARACTERISTIC
/begin CHARACTERISTIC fmy_id_pvs_ratio.c_err_clas "" VALUE 0xffe4220c _REC_VAL_20_u1 255. _CNV_A_R_LINEAR_____0_CM 0. 255. DISPLAY_IDENTIFIER C_ERR_CLAS_PVS_RATIO FORMAT "%3.0" /end CHARACTERISTIC
/begin CHARACTERISTIC fmy_id_pvs_double.dtc "" CURVE 0xffe4220e _REC_CUR_20_u2_u2 65535. _CNV_A_R_LINEAR_____0_CM 0. 65535. DISPLAY_IDENTIFIER ID_ERR_DTC_PVS_DOUBLE FORMAT "%5.0"
 /begin AXIS_DESCR COM_AXIS online_dummy _CNV_A_R_LINEAR_____22_CM 6 0. 5. FORMAT "%2.0" AXIS_PTS_REF ldp_fmy_dtc /end AXIS_DESCR
/end CHARACTERISTIC
/begin CHARACTERISTIC fmy_id_pvs_double.c_err_clas "" VALUE 0xffe4221e _REC_VAL_20_u1 255. _CNV_A_R_LINEAR_____0_CM 0. 255. DISPLAY_IDENTIFIER C_ERR_CLAS_PVS_DOUBLE FORMAT "%3.0" /end CHARACTERISTIC
/begin CHARACTERISTIC fmy_id_pvs_bls_not_plaus.dtc "" CURVE 0xffe42220 _REC_CUR_20_u2_u2 65535. _CNV_A_R_LINEAR_____0_CM 0. 65535. DISPLAY_IDENTIFIER ID_ERR_DTC_PVS_BLS_NOT_PLAUS FORMAT "%5.0"
 /begin AXIS_DESCR COM_AXIS online_dummy _CNV_A_R_LINEAR_____22_CM 6 0. 5. FORMAT "%2.0" AXIS_PTS_REF ldp_fmy_dtc /end AXIS_DESCR
/end CHARACTERISTIC
/begin CHARACTERISTIC fmy_id_pvs_bls_not_plaus.c_err_clas "" VALUE 0xffe42230 _REC_VAL_20_u1 255. _CNV_A_R_LINEAR_____0_CM 0. 255. DISPLAY_IDENTIFIER C_ERR_CLAS_PVS_BLS_NOT_PLAUS FORMAT "%3.0" /end CHARACTERISTIC
/begin CHARACTERISTIC fmy_id_mtc_dr.dtc "" CURVE 0xffe42232 _REC_CUR_20_u2_u2 65535. _CNV_A_R_LINEAR_____0_CM 0. 65535. DISPLAY_IDENTIFIER ID_ERR_DTC_MTC_DR FORMAT "%5.0"
 /begin AXIS_DESCR COM_AXIS online_dummy _CNV_A_R_LINEAR_____22_CM 6 0. 5. FORMAT "%2.0" AXIS_PTS_REF ldp_fmy_dtc /end AXIS_DESCR
/end CHARACTERISTIC
/begin CHARACTERISTIC fmy_id_mtc_dr.c_err_clas "" VALUE 0xffe42242 _REC_VAL_20_u1 255. _CNV_A_R_LINEAR_____0_CM 0. 255. DISPLAY_IDENTIFIER C_ERR_CLAS_MTC_DR FORMAT "%3.0" /end CHARACTERISTIC
/begin CHARACTERISTIC fmy_id_mtc_ctl_1.dtc "" CURVE 0xffe42244 _REC_CUR_20_u2_u2 65535. _CNV_A_R_LINEAR_____0_CM 0. 65535. DISPLAY_IDENTIFIER ID_ERR_DTC_MTC_CTL_1 FORMAT "%5.0"
 /begin AXIS_DESCR COM_AXIS online_dummy _CNV_A_R_LINEAR_____22_CM 6 0. 5. FORMAT "%2.0" AXIS_PTS_REF ldp_fmy_dtc /end AXIS_DESCR
/end CHARACTERISTIC
/begin CHARACTERISTIC fmy_id_mtc_ctl_1.c_err_clas "" VALUE 0xffe42254 _REC_VAL_20_u1 255. _CNV_A_R_LINEAR_____0_CM 0. 255. DISPLAY_IDENTIFIER C_ERR_CLAS_MTC_CTL_1 FORMAT "%3.0" /end CHARACTERISTIC
/begin CHARACTERISTIC fmy_id_mtc_ctl_2.dtc "" CURVE 0xffe42256 _REC_CUR_20_u2_u2 65535. _CNV_A_R_LINEAR_____0_CM 0. 65535. DISPLAY_IDENTIFIER ID_ERR_DTC_MTC_CTL_2 FORMAT "%5.0"
 /begin AXIS_DESCR COM_AXIS online_dummy _CNV_A_R_LINEAR_____22_CM 6 0. 5. FORMAT "%2.0" AXIS_PTS_REF ldp_fmy_dtc /end AXIS_DESCR
/end CHARACTERISTIC
/begin CHARACTERISTIC fmy_id_mtc_ctl_2.c_err_clas "" VALUE 0xffe42266 _REC_VAL_20_u1 255. _CNV_A_R_LINEAR_____0_CM 0. 255. DISPLAY_IDENTIFIER C_ERR_CLAS_MTC_CTL_2 FORMAT "%3.0" /end CHARACTERISTIC
/begin CHARACTERISTIC fmy_id_mtc_ctl_3.dtc "" CURVE 0xffe42268 _REC_CUR_20_u2_u2 65535. _CNV_A_R_LINEAR_____0_CM 0. 65535. DISPLAY_IDENTIFIER ID_ERR_DTC_MTC_CTL_3 FORMAT "%5.0"
 /begin AXIS_DESCR COM_AXIS online_dummy _CNV_A_R_LINEAR_____22_CM 6 0. 5. FORMAT "%2.0" AXIS_PTS_REF ldp_fmy_dtc /end AXIS_DESCR
/end CHARACTERISTIC
/begin CHARACTERISTIC fmy_id_mtc_ctl_3.c_err_clas "" VALUE 0xffe42278 _REC_VAL_20_u1 255. _CNV_A_R_LINEAR_____0_CM 0. 255. DISPLAY_IDENTIFIER C_ERR_CLAS_MTC_CTL_3 FORMAT "%3.0" /end CHARACTERISTIC
/begin CHARACTERISTIC fmy_id_tps_ad.dtc "" CURVE 0xffe4227a _REC_CUR_20_u2_u2 65535. _CNV_A_R_LINEAR_____0_CM 0. 65535. DISPLAY_IDENTIFIER ID_ERR_DTC_TPS_AD FORMAT "%5.0"
 /begin AXIS_DESCR COM_AXIS online_dummy _CNV_A_R_LINEAR_____22_CM 6 0. 5. FORMAT "%2.0" AXIS_PTS_REF ldp_fmy_dtc /end AXIS_DESCR
/end CHARACTERISTIC
/begin CHARACTERISTIC fmy_id_tps_ad.c_err_clas "" VALUE 0xffe4228a _REC_VAL_20_u1 255. _CNV_A_R_LINEAR_____0_CM 0. 255. DISPLAY_IDENTIFIER C_ERR_CLAS_TPS_AD FORMAT "%3.0" /end CHARACTERISTIC
/begin CHARACTERISTIC fmy_id_tps_ad_bol.dtc "" CURVE 0xffe4228c _REC_CUR_20_u2_u2 65535. _CNV_A_R_LINEAR_____0_CM 0. 65535. DISPLAY_IDENTIFIER ID_ERR_DTC_TPS_AD_BOL FORMAT "%5.0"
 /begin AXIS_DESCR COM_AXIS online_dummy _CNV_A_R_LINEAR_____22_CM 6 0. 5. FORMAT "%2.0" AXIS_PTS_REF ldp_fmy_dtc /end AXIS_DESCR
/end CHARACTERISTIC
/begin CHARACTERISTIC fmy_id_tps_ad_bol.c_err_clas "" VALUE 0xffe4229c _REC_VAL_20_u1 255. _CNV_A_R_LINEAR_____0_CM 0. 255. DISPLAY_IDENTIFIER C_ERR_CLAS_TPS_AD_BOL FORMAT "%3.0" /end CHARACTERISTIC
/begin CHARACTERISTIC fmy_id_tps_st_chk_1.dtc "" CURVE 0xffe4229e _REC_CUR_20_u2_u2 65535. _CNV_A_R_LINEAR_____0_CM 0. 65535. DISPLAY_IDENTIFIER ID_ERR_DTC_TPS_ST_CHK_1 FORMAT "%5.0"
 /begin AXIS_DESCR COM_AXIS online_dummy _CNV_A_R_LINEAR_____22_CM 6 0. 5. FORMAT "%2.0" AXIS_PTS_REF ldp_fmy_dtc /end AXIS_DESCR
/end CHARACTERISTIC
/begin CHARACTERISTIC fmy_id_tps_st_chk_1.c_err_clas "" VALUE 0xffe422ae _REC_VAL_20_u1 255. _CNV_A_R_LINEAR_____0_CM 0. 255. DISPLAY_IDENTIFIER C_ERR_CLAS_TPS_ST_CHK_1 FORMAT "%3.0" /end CHARACTERISTIC
/begin CHARACTERISTIC fmy_id_tps_st_chk_2.dtc "" CURVE 0xffe422b0 _REC_CUR_20_u2_u2 65535. _CNV_A_R_LINEAR_____0_CM 0. 65535. DISPLAY_IDENTIFIER ID_ERR_DTC_TPS_ST_CHK_2 FORMAT "%5.0"
 /begin AXIS_DESCR COM_AXIS online_dummy _CNV_A_R_LINEAR_____22_CM 6 0. 5. FORMAT "%2.0" AXIS_PTS_REF ldp_fmy_dtc /end AXIS_DESCR
/end CHARACTERISTIC
/begin CHARACTERISTIC fmy_id_tps_st_chk_2.c_err_clas "" VALUE 0xffe422c0 _REC_VAL_20_u1 255. _CNV_A_R_LINEAR_____0_CM 0. 255. DISPLAY_IDENTIFIER C_ERR_CLAS_TPS_ST_CHK_2 FORMAT "%3.0" /end CHARACTERISTIC
/begin CHARACTERISTIC fmy_id_gen.dtc "" CURVE 0xffe422c2 _REC_CUR_20_u2_u2 65535. _CNV_A_R_LINEAR_____0_CM 0. 65535. DISPLAY_IDENTIFIER ID_ERR_DTC_GEN FORMAT "%5.0"
 /begin AXIS_DESCR COM_AXIS online_dummy _CNV_A_R_LINEAR_____22_CM 6 0. 5. FORMAT "%2.0" AXIS_PTS_REF ldp_fmy_dtc /end AXIS_DESCR
/end CHARACTERISTIC
/begin CHARACTERISTIC fmy_id_gen.c_err_clas "" VALUE 0xffe422d2 _REC_VAL_20_u1 255. _CNV_A_R_LINEAR_____0_CM 0. 255. DISPLAY_IDENTIFIER C_ERR_CLAS_GEN FORMAT "%3.0" /end CHARACTERISTIC
/begin CHARACTERISTIC fmy_id_gen_if.dtc "" CURVE 0xffe422d4 _REC_CUR_20_u2_u2 65535. _CNV_A_R_LINEAR_____0_CM 0. 65535. DISPLAY_IDENTIFIER ID_ERR_DTC_GEN_IF FORMAT "%5.0"
 /begin AXIS_DESCR COM_AXIS online_dummy _CNV_A_R_LINEAR_____22_CM 6 0. 5. FORMAT "%2.0" AXIS_PTS_REF ldp_fmy_dtc /end AXIS_DESCR
/end CHARACTERISTIC
/begin CHARACTERISTIC fmy_id_gen_if.c_err_clas "" VALUE 0xffe422e4 _REC_VAL_20_u1 255. _CNV_A_R_LINEAR_____0_CM 0. 255. DISPLAY_IDENTIFIER C_ERR_CLAS_GEN_IF FORMAT "%3.0" /end CHARACTERISTIC
/begin CHARACTERISTIC fmy_id_gen_diag.dtc "" CURVE 0xffe422e6 _REC_CUR_20_u2_u2 65535. _CNV_A_R_LINEAR_____0_CM 0. 65535. DISPLAY_IDENTIFIER ID_ERR_DTC_GEN_DIAG FORMAT "%5.0"
 /begin AXIS_DESCR COM_AXIS online_dummy _CNV_A_R_LINEAR_____22_CM 6 0. 5. FORMAT "%2.0" AXIS_PTS_REF ldp_fmy_dtc /end AXIS_DESCR
/end CHARACTERISTIC
/begin CHARACTERISTIC fmy_id_gen_diag.c_err_clas "" VALUE 0xffe422f6 _REC_VAL_20_u1 255. _CNV_A_R_LINEAR_____0_CM 0. 255. DISPLAY_IDENTIFIER C_ERR_CLAS_GEN_DIAG FORMAT "%3.0" /end CHARACTERISTIC
/begin CHARACTERISTIC fmy_id_vim.dtc "" CURVE 0xffe422f8 _REC_CUR_20_u2_u2 65535. _CNV_A_R_LINEAR_____0_CM 0. 65535. DISPLAY_IDENTIFIER ID_ERR_DTC_VIM FORMAT "%5.0"
 /begin AXIS_DESCR COM_AXIS online_dummy _CNV_A_R_LINEAR_____22_CM 6 0. 5. FORMAT "%2.0" AXIS_PTS_REF ldp_fmy_dtc /end AXIS_DESCR
/end CHARACTERISTIC
/begin CHARACTERISTIC fmy_id_vim.c_err_clas "" VALUE 0xffe42308 _REC_VAL_20_u1 255. _CNV_A_R_LINEAR_____0_CM 0. 255. DISPLAY_IDENTIFIER C_ERR_CLAS_VIM FORMAT "%3.0" /end CHARACTERISTIC
/begin CHARACTERISTIC fmy_id_cam_per_0.dtc "" CURVE 0xffe4230a _REC_CUR_20_u2_u2 65535. _CNV_A_R_LINEAR_____0_CM 0. 65535. DISPLAY_IDENTIFIER ID_ERR_DTC_CAM_PER_0 FORMAT "%5.0"
 /begin AXIS_DESCR COM_AXIS online_dummy _CNV_A_R_LINEAR_____22_CM 6 0. 5. FORMAT "%2.0" AXIS_PTS_REF ldp_fmy_dtc /end AXIS_DESCR
/end CHARACTERISTIC
/begin CHARACTERISTIC fmy_id_cam_per_0.c_err_clas "" VALUE 0xffe4231a _REC_VAL_20_u1 255. _CNV_A_R_LINEAR_____0_CM 0. 255. DISPLAY_IDENTIFIER C_ERR_CLAS_CAM_PER_0 FORMAT "%3.0" /end CHARACTERISTIC
/begin CHARACTERISTIC fmy_id_cam_per_1.dtc "" CURVE 0xffe4231c _REC_CUR_20_u2_u2 65535. _CNV_A_R_LINEAR_____0_CM 0. 65535. DISPLAY_IDENTIFIER ID_ERR_DTC_CAM_PER_1 FORMAT "%5.0"
 /begin AXIS_DESCR COM_AXIS online_dummy _CNV_A_R_LINEAR_____22_CM 6 0. 5. FORMAT "%2.0" AXIS_PTS_REF ldp_fmy_dtc /end AXIS_DESCR
/end CHARACTERISTIC
/begin CHARACTERISTIC fmy_id_cam_per_1.c_err_clas "" VALUE 0xffe4232c _REC_VAL_20_u1 255. _CNV_A_R_LINEAR_____0_CM 0. 255. DISPLAY_IDENTIFIER C_ERR_CLAS_CAM_PER_1 FORMAT "%3.0" /end CHARACTERISTIC
/begin CHARACTERISTIC fmy_id_cam_psn_0.dtc "" CURVE 0xffe4232e _REC_CUR_20_u2_u2 65535. _CNV_A_R_LINEAR_____0_CM 0. 65535. DISPLAY_IDENTIFIER ID_ERR_DTC_CAM_PSN_0 FORMAT "%5.0"
 /begin AXIS_DESCR COM_AXIS online_dummy _CNV_A_R_LINEAR_____22_CM 6 0. 5. FORMAT "%2.0" AXIS_PTS_REF ldp_fmy_dtc /end AXIS_DESCR
/end CHARACTERISTIC
/begin CHARACTERISTIC fmy_id_cam_psn_0.c_err_clas "" VALUE 0xffe4233e _REC_VAL_20_u1 255. _CNV_A_R_LINEAR_____0_CM 0. 255. DISPLAY_IDENTIFIER C_ERR_CLAS_CAM_PSN_0 FORMAT "%3.0" /end CHARACTERISTIC
/begin CHARACTERISTIC fmy_id_cam_psn_1.dtc "" CURVE 0xffe42340 _REC_CUR_20_u2_u2 65535. _CNV_A_R_LINEAR_____0_CM 0. 65535. DISPLAY_IDENTIFIER ID_ERR_DTC_CAM_PSN_1 FORMAT "%5.0"
 /begin AXIS_DESCR COM_AXIS online_dummy _CNV_A_R_LINEAR_____22_CM 6 0. 5. FORMAT "%2.0" AXIS_PTS_REF ldp_fmy_dtc /end AXIS_DESCR
/end CHARACTERISTIC
/begin CHARACTERISTIC fmy_id_cam_psn_1.c_err_clas "" VALUE 0xffe42350 _REC_VAL_20_u1 255. _CNV_A_R_LINEAR_____0_CM 0. 255. DISPLAY_IDENTIFIER C_ERR_CLAS_CAM_PSN_1 FORMAT "%3.0" /end CHARACTERISTIC
/begin CHARACTERISTIC fmy_id_cam_0_not_plaus.dtc "" CURVE 0xffe42352 _REC_CUR_20_u2_u2 65535. _CNV_A_R_LINEAR_____0_CM 0. 65535. DISPLAY_IDENTIFIER ID_ERR_DTC_CAM_0_NOT_PLAUS FORMAT "%5.0"
 /begin AXIS_DESCR COM_AXIS online_dummy _CNV_A_R_LINEAR_____22_CM 6 0. 5. FORMAT "%2.0" AXIS_PTS_REF ldp_fmy_dtc /end AXIS_DESCR
/end CHARACTERISTIC
/begin CHARACTERISTIC fmy_id_cam_0_not_plaus.c_err_clas "" VALUE 0xffe42362 _REC_VAL_20_u1 255. _CNV_A_R_LINEAR_____0_CM 0. 255. DISPLAY_IDENTIFIER C_ERR_CLAS_CAM_0_NOT_PLAUS FORMAT "%3.0" /end CHARACTERISTIC
/begin CHARACTERISTIC fmy_id_cam_1_not_plaus.dtc "" CURVE 0xffe42364 _REC_CUR_20_u2_u2 65535. _CNV_A_R_LINEAR_____0_CM 0. 65535. DISPLAY_IDENTIFIER ID_ERR_DTC_CAM_1_NOT_PLAUS FORMAT "%5.0"
 /begin AXIS_DESCR COM_AXIS online_dummy _CNV_A_R_LINEAR_____22_CM 6 0. 5. FORMAT "%2.0" AXIS_PTS_REF ldp_fmy_dtc /end AXIS_DESCR
/end CHARACTERISTIC
/begin CHARACTERISTIC fmy_id_cam_1_not_plaus.c_err_clas "" VALUE 0xffe42374 _REC_VAL_20_u1 255. _CNV_A_R_LINEAR_____0_CM 0. 255. DISPLAY_IDENTIFIER C_ERR_CLAS_CAM_1_NOT_PLAUS FORMAT "%3.0" /end CHARACTERISTIC
/begin CHARACTERISTIC fmy_id_eng_psn.dtc "" CURVE 0xffe42376 _REC_CUR_20_u2_u2 65535. _CNV_A_R_LINEAR_____0_CM 0. 65535. DISPLAY_IDENTIFIER ID_ERR_DTC_ENG_PSN FORMAT "%5.0"
 /begin AXIS_DESCR COM_AXIS online_dummy _CNV_A_R_LINEAR_____22_CM 6 0. 5. FORMAT "%2.0" AXIS_PTS_REF ldp_fmy_dtc /end AXIS_DESCR
/end CHARACTERISTIC
/begin CHARACTERISTIC fmy_id_eng_psn.c_err_clas "" VALUE 0xffe42386 _REC_VAL_20_u1 255. _CNV_A_R_LINEAR_____0_CM 0. 255. DISPLAY_IDENTIFIER C_ERR_CLAS_ENG_PSN FORMAT "%3.0" /end CHARACTERISTIC
/begin CHARACTERISTIC fmy_id_tooth_per.dtc "" CURVE 0xffe42388 _REC_CUR_20_u2_u2 65535. _CNV_A_R_LINEAR_____0_CM 0. 65535. DISPLAY_IDENTIFIER ID_ERR_DTC_TOOTH_PER FORMAT "%5.0"
 /begin AXIS_DESCR COM_AXIS online_dummy _CNV_A_R_LINEAR_____22_CM 6 0. 5. FORMAT "%2.0" AXIS_PTS_REF ldp_fmy_dtc /end AXIS_DESCR
/end CHARACTERISTIC
/begin CHARACTERISTIC fmy_id_tooth_per.c_err_clas "" VALUE 0xffe42398 _REC_VAL_20_u1 255. _CNV_A_R_LINEAR_____0_CM 0. 255. DISPLAY_IDENTIFIER C_ERR_CLAS_TOOTH_PER FORMAT "%3.0" /end CHARACTERISTIC
/begin CHARACTERISTIC fmy_id_tpu_syn.dtc "" CURVE 0xffe4239a _REC_CUR_20_u2_u2 65535. _CNV_A_R_LINEAR_____0_CM 0. 65535. DISPLAY_IDENTIFIER ID_ERR_DTC_TPU_SYN FORMAT "%5.0"
 /begin AXIS_DESCR COM_AXIS online_dummy _CNV_A_R_LINEAR_____22_CM 6 0. 5. FORMAT "%2.0" AXIS_PTS_REF ldp_fmy_dtc /end AXIS_DESCR
/end CHARACTERISTIC
/begin CHARACTERISTIC fmy_id_tpu_syn.c_err_clas "" VALUE 0xffe423aa _REC_VAL_20_u1 255. _CNV_A_R_LINEAR_____0_CM 0. 255. DISPLAY_IDENTIFIER C_ERR_CLAS_TPU_SYN FORMAT "%3.0" /end CHARACTERISTIC
/begin CHARACTERISTIC fmy_id_crk_not_plaus.dtc "" CURVE 0xffe423ac _REC_CUR_20_u2_u2 65535. _CNV_A_R_LINEAR_____0_CM 0. 65535. DISPLAY_IDENTIFIER ID_ERR_DTC_CRK_NOT_PLAUS FORMAT "%5.0"
 /begin AXIS_DESCR COM_AXIS online_dummy _CNV_A_R_LINEAR_____22_CM 6 0. 5. FORMAT "%2.0" AXIS_PTS_REF ldp_fmy_dtc /end AXIS_DESCR
/end CHARACTERISTIC
/begin CHARACTERISTIC fmy_id_crk_not_plaus.c_err_clas "" VALUE 0xffe423bc _REC_VAL_20_u1 255. _CNV_A_R_LINEAR_____0_CM 0. 255. DISPLAY_IDENTIFIER C_ERR_CLAS_CRK_NOT_PLAUS FORMAT "%3.0" /end CHARACTERISTIC
/begin CHARACTERISTIC fmy_id_tout_txu_1.dtc "" CURVE 0xffe423be _REC_CUR_20_u2_u2 65535. _CNV_A_R_LINEAR_____0_CM 0. 65535. DISPLAY_IDENTIFIER ID_ERR_DTC_TOUT_TXU_1 FORMAT "%5.0"
 /begin AXIS_DESCR COM_AXIS online_dummy _CNV_A_R_LINEAR_____22_CM 6 0. 5. FORMAT "%2.0" AXIS_PTS_REF ldp_fmy_dtc /end AXIS_DESCR
/end CHARACTERISTIC
/begin CHARACTERISTIC fmy_id_tout_txu_1.c_err_clas "" VALUE 0xffe423ce _REC_VAL_20_u1 255. _CNV_A_R_LINEAR_____0_CM 0. 255. DISPLAY_IDENTIFIER C_ERR_CLAS_TOUT_TXU_1 FORMAT "%3.0" /end CHARACTERISTIC
/begin CHARACTERISTIC fmy_id_can_boff.dtc "" CURVE 0xffe423d0 _REC_CUR_20_u2_u2 65535. _CNV_A_R_LINEAR_____0_CM 0. 65535. DISPLAY_IDENTIFIER ID_ERR_DTC_CAN_BOFF FORMAT "%5.0"
 /begin AXIS_DESCR COM_AXIS online_dummy _CNV_A_R_LINEAR_____22_CM 6 0. 5. FORMAT "%2.0" AXIS_PTS_REF ldp_fmy_dtc /end AXIS_DESCR
/end CHARACTERISTIC
/begin CHARACTERISTIC fmy_id_can_boff.c_err_clas "" VALUE 0xffe423e0 _REC_VAL_20_u1 255. _CNV_A_R_LINEAR_____0_CM 0. 255. DISPLAY_IDENTIFIER C_ERR_CLAS_CAN_BOFF FORMAT "%3.0" /end CHARACTERISTIC
/begin CHARACTERISTIC fmy_id_rly_main.dtc "" CURVE 0xffe423e2 _REC_CUR_20_u2_u2 65535. _CNV_A_R_LINEAR_____0_CM 0. 65535. DISPLAY_IDENTIFIER ID_ERR_DTC_RLY_MAIN FORMAT "%5.0"
 /begin AXIS_DESCR COM_AXIS online_dummy _CNV_A_R_LINEAR_____22_CM 6 0. 5. FORMAT "%2.0" AXIS_PTS_REF ldp_fmy_dtc /end AXIS_DESCR
/end CHARACTERISTIC
/begin CHARACTERISTIC fmy_id_rly_main.c_err_clas "" VALUE 0xffe423f2 _REC_VAL_20_u1 255. _CNV_A_R_LINEAR_____0_CM 0. 255. DISPLAY_IDENTIFIER C_ERR_CLAS_RLY_MAIN FORMAT "%3.0" /end CHARACTERISTIC
/begin CHARACTERISTIC fmy_id_rly_main_dly.dtc "" CURVE 0xffe423f4 _REC_CUR_20_u2_u2 65535. _CNV_A_R_LINEAR_____0_CM 0. 65535. DISPLAY_IDENTIFIER ID_ERR_DTC_RLY_MAIN_DLY FORMAT "%5.0"
 /begin AXIS_DESCR COM_AXIS online_dummy _CNV_A_R_LINEAR_____22_CM 6 0. 5. FORMAT "%2.0" AXIS_PTS_REF ldp_fmy_dtc /end AXIS_DESCR
/end CHARACTERISTIC
/begin CHARACTERISTIC fmy_id_rly_main_dly.c_err_clas "" VALUE 0xffe42404 _REC_VAL_20_u1 255. _CNV_A_R_LINEAR_____0_CM 0. 255. DISPLAY_IDENTIFIER C_ERR_CLAS_RLY_MAIN_DLY FORMAT "%3.0" /end CHARACTERISTIC
/begin CHARACTERISTIC fmy_id_rly_accout.dtc "" CURVE 0xffe42406 _REC_CUR_20_u2_u2 65535. _CNV_A_R_LINEAR_____0_CM 0. 65535. DISPLAY_IDENTIFIER ID_ERR_DTC_RLY_ACCOUT FORMAT "%5.0"
 /begin AXIS_DESCR COM_AXIS online_dummy _CNV_A_R_LINEAR_____22_CM 6 0. 5. FORMAT "%2.0" AXIS_PTS_REF ldp_fmy_dtc /end AXIS_DESCR
/end CHARACTERISTIC
/begin CHARACTERISTIC fmy_id_rly_accout.c_err_clas "" VALUE 0xffe42416 _REC_VAL_20_u1 255. _CNV_A_R_LINEAR_____0_CM 0. 255. DISPLAY_IDENTIFIER C_ERR_CLAS_RLY_ACCOUT FORMAT "%3.0" /end CHARACTERISTIC
/begin CHARACTERISTIC fmy_id_sap.dtc "" CURVE 0xffe42418 _REC_CUR_20_u2_u2 65535. _CNV_A_R_LINEAR_____0_CM 0. 65535. DISPLAY_IDENTIFIER ID_ERR_DTC_SAP FORMAT "%5.0"
 /begin AXIS_DESCR COM_AXIS online_dummy _CNV_A_R_LINEAR_____22_CM 6 0. 5. FORMAT "%2.0" AXIS_PTS_REF ldp_fmy_dtc /end AXIS_DESCR
/end CHARACTERISTIC
/begin CHARACTERISTIC fmy_id_sap.c_err_clas "" VALUE 0xffe42428 _REC_VAL_20_u1 255. _CNV_A_R_LINEAR_____0_CM 0. 255. DISPLAY_IDENTIFIER C_ERR_CLAS_SAP FORMAT "%3.0" /end CHARACTERISTIC
/begin CHARACTERISTIC fmy_id_sav.dtc "" CURVE 0xffe4242a _REC_CUR_20_u2_u2 65535. _CNV_A_R_LINEAR_____0_CM 0. 65535. DISPLAY_IDENTIFIER ID_ERR_DTC_SAV FORMAT "%5.0"
 /begin AXIS_DESCR COM_AXIS online_dummy _CNV_A_R_LINEAR_____22_CM 6 0. 5. FORMAT "%2.0" AXIS_PTS_REF ldp_fmy_dtc /end AXIS_DESCR
/end CHARACTERISTIC
/begin CHARACTERISTIC fmy_id_sav.c_err_clas "" VALUE 0xffe4243a _REC_VAL_20_u1 255. _CNV_A_R_LINEAR_____0_CM 0. 255. DISPLAY_IDENTIFIER C_ERR_CLAS_SAV FORMAT "%3.0" /end CHARACTERISTIC
/begin CHARACTERISTIC fmy_id_ecf.dtc "" CURVE 0xffe4243c _REC_CUR_20_u2_u2 65535. _CNV_A_R_LINEAR_____0_CM 0. 65535. DISPLAY_IDENTIFIER ID_ERR_DTC_ECF FORMAT "%5.0"
 /begin AXIS_DESCR COM_AXIS online_dummy _CNV_A_R_LINEAR_____22_CM 6 0. 5. FORMAT "%2.0" AXIS_PTS_REF ldp_fmy_dtc /end AXIS_DESCR
/end CHARACTERISTIC
/begin CHARACTERISTIC fmy_id_ecf.c_err_clas "" VALUE 0xffe4244c _REC_VAL_20_u1 255. _CNV_A_R_LINEAR_____0_CM 0. 255. DISPLAY_IDENTIFIER C_ERR_CLAS_ECF FORMAT "%3.0" /end CHARACTERISTIC
/begin CHARACTERISTIC fmy_id_tco_plaus.dtc "" CURVE 0xffe4244e _REC_CUR_20_u2_u2 65535. _CNV_A_R_LINEAR_____0_CM 0. 65535. DISPLAY_IDENTIFIER ID_ERR_DTC_TCO_PLAUS FORMAT "%5.0"
 /begin AXIS_DESCR COM_AXIS online_dummy _CNV_A_R_LINEAR_____22_CM 6 0. 5. FORMAT "%2.0" AXIS_PTS_REF ldp_fmy_dtc /end AXIS_DESCR
/end CHARACTERISTIC
/begin CHARACTERISTIC fmy_id_tco_plaus.c_err_clas "" VALUE 0xffe4245e _REC_VAL_20_u1 255. _CNV_A_R_LINEAR_____0_CM 0. 255. DISPLAY_IDENTIFIER C_ERR_CLAS_TCO_PLAUS FORMAT "%3.0" /end CHARACTERISTIC
/begin CHARACTERISTIC fmy_id_tco_el.dtc "" CURVE 0xffe42460 _REC_CUR_20_u2_u2 65535. _CNV_A_R_LINEAR_____0_CM 0. 65535. DISPLAY_IDENTIFIER ID_ERR_DTC_TCO_EL FORMAT "%5.0"
 /begin AXIS_DESCR COM_AXIS online_dummy _CNV_A_R_LINEAR_____22_CM 6 0. 5. FORMAT "%2.0" AXIS_PTS_REF ldp_fmy_dtc /end AXIS_DESCR
/end CHARACTERISTIC
/begin CHARACTERISTIC fmy_id_tco_el.c_err_clas "" VALUE 0xffe42470 _REC_VAL_20_u1 255. _CNV_A_R_LINEAR_____0_CM 0. 255. DISPLAY_IDENTIFIER C_ERR_CLAS_TCO_EL FORMAT "%3.0" /end CHARACTERISTIC
/begin CHARACTERISTIC fmy_id_tco_grd.dtc "" CURVE 0xffe42472 _REC_CUR_20_u2_u2 65535. _CNV_A_R_LINEAR_____0_CM 0. 65535. DISPLAY_IDENTIFIER ID_ERR_DTC_TCO_GRD FORMAT "%5.0"
 /begin AXIS_DESCR COM_AXIS online_dummy _CNV_A_R_LINEAR_____22_CM 6 0. 5. FORMAT "%2.0" AXIS_PTS_REF ldp_fmy_dtc /end AXIS_DESCR
/end CHARACTERISTIC
/begin CHARACTERISTIC fmy_id_tco_grd.c_err_clas "" VALUE 0xffe42482 _REC_VAL_20_u1 255. _CNV_A_R_LINEAR_____0_CM 0. 255. DISPLAY_IDENTIFIER C_ERR_CLAS_TCO_GRD FORMAT "%3.0" /end CHARACTERISTIC
/begin CHARACTERISTIC fmy_id_tco_stuck.dtc "" CURVE 0xffe42484 _REC_CUR_20_u2_u2 65535. _CNV_A_R_LINEAR_____0_CM 0. 65535. DISPLAY_IDENTIFIER ID_ERR_DTC_TCO_STUCK FORMAT "%5.0"
 /begin AXIS_DESCR COM_AXIS online_dummy _CNV_A_R_LINEAR_____22_CM 6 0. 5. FORMAT "%2.0" AXIS_PTS_REF ldp_fmy_dtc /end AXIS_DESCR
/end CHARACTERISTIC
/begin CHARACTERISTIC fmy_id_tco_stuck.c_err_clas "" VALUE 0xffe42494 _REC_VAL_20_u1 255. _CNV_A_R_LINEAR_____0_CM 0. 255. DISPLAY_IDENTIFIER C_ERR_CLAS_TCO_STUCK FORMAT "%3.0" /end CHARACTERISTIC
/begin CHARACTERISTIC fmy_id_ect_el.dtc "" CURVE 0xffe42496 _REC_CUR_20_u2_u2 65535. _CNV_A_R_LINEAR_____0_CM 0. 65535. DISPLAY_IDENTIFIER ID_ERR_DTC_ECT_EL FORMAT "%5.0"
 /begin AXIS_DESCR COM_AXIS online_dummy _CNV_A_R_LINEAR_____22_CM 6 0. 5. FORMAT "%2.0" AXIS_PTS_REF ldp_fmy_dtc /end AXIS_DESCR
/end CHARACTERISTIC
/begin CHARACTERISTIC fmy_id_ect_el.c_err_clas "" VALUE 0xffe424a6 _REC_VAL_20_u1 255. _CNV_A_R_LINEAR_____0_CM 0. 255. DISPLAY_IDENTIFIER C_ERR_CLAS_ECT_EL FORMAT "%3.0" /end CHARACTERISTIC
/begin CHARACTERISTIC fmy_id_ect_mec.dtc "" CURVE 0xffe424a8 _REC_CUR_20_u2_u2 65535. _CNV_A_R_LINEAR_____0_CM 0. 65535. DISPLAY_IDENTIFIER ID_ERR_DTC_ECT_MEC FORMAT "%5.0"
 /begin AXIS_DESCR COM_AXIS online_dummy _CNV_A_R_LINEAR_____22_CM 6 0. 5. FORMAT "%2.0" AXIS_PTS_REF ldp_fmy_dtc /end AXIS_DESCR
/end CHARACTERISTIC
/begin CHARACTERISTIC fmy_id_ect_mec.c_err_clas "" VALUE 0xffe424b8 _REC_VAL_20_u1 255. _CNV_A_R_LINEAR_____0_CM 0. 255. DISPLAY_IDENTIFIER C_ERR_CLAS_ECT_MEC FORMAT "%3.0" /end CHARACTERISTIC
/begin CHARACTERISTIC fmy_id_isc.dtc "" CURVE 0xffe424ba _REC_CUR_20_u2_u2 65535. _CNV_A_R_LINEAR_____0_CM 0. 65535. DISPLAY_IDENTIFIER ID_ERR_DTC_ISC FORMAT "%5.0"
 /begin AXIS_DESCR COM_AXIS online_dummy _CNV_A_R_LINEAR_____22_CM 6 0. 5. FORMAT "%2.0" AXIS_PTS_REF ldp_fmy_dtc /end AXIS_DESCR
/end CHARACTERISTIC
/begin CHARACTERISTIC fmy_id_isc.c_err_clas "" VALUE 0xffe424ca _REC_VAL_20_u1 255. _CNV_A_R_LINEAR_____0_CM 0. 255. DISPLAY_IDENTIFIER C_ERR_CLAS_ISC FORMAT "%3.0" /end CHARACTERISTIC
/begin CHARACTERISTIC fmy_id_im_bls_plaus.dtc "" CURVE 0xffe424cc _REC_CUR_20_u2_u2 65535. _CNV_A_R_LINEAR_____0_CM 0. 65535. DISPLAY_IDENTIFIER ID_ERR_DTC_IM_BLS_PLAUS FORMAT "%5.0"
 /begin AXIS_DESCR COM_AXIS online_dummy _CNV_A_R_LINEAR_____22_CM 6 0. 5. FORMAT "%2.0" AXIS_PTS_REF ldp_fmy_dtc /end AXIS_DESCR
/end CHARACTERISTIC
/begin CHARACTERISTIC fmy_id_im_bls_plaus.c_err_clas "" VALUE 0xffe424dc _REC_VAL_20_u1 255. _CNV_A_R_LINEAR_____0_CM 0. 255. DISPLAY_IDENTIFIER C_ERR_CLAS_IM_BLS_PLAUS FORMAT "%3.0" /end CHARACTERISTIC
/begin CHARACTERISTIC fmy_id_im_bts_plaus.dtc "" CURVE 0xffe424de _REC_CUR_20_u2_u2 65535. _CNV_A_R_LINEAR_____0_CM 0. 65535. DISPLAY_IDENTIFIER ID_ERR_DTC_IM_BTS_PLAUS FORMAT "%5.0"
 /begin AXIS_DESCR COM_AXIS online_dummy _CNV_A_R_LINEAR_____22_CM 6 0. 5. FORMAT "%2.0" AXIS_PTS_REF ldp_fmy_dtc /end AXIS_DESCR
/end CHARACTERISTIC
/begin CHARACTERISTIC fmy_id_im_bts_plaus.c_err_clas "" VALUE 0xffe424ee _REC_VAL_20_u1 255. _CNV_A_R_LINEAR_____0_CM 0. 255. DISPLAY_IDENTIFIER C_ERR_CLAS_IM_BTS_PLAUS FORMAT "%3.0" /end CHARACTERISTIC
/begin CHARACTERISTIC fmy_id_msw_tog.dtc "" CURVE 0xffe424f0 _REC_CUR_20_u2_u2 65535. _CNV_A_R_LINEAR_____0_CM 0. 65535. DISPLAY_IDENTIFIER ID_ERR_DTC_MSW_TOG FORMAT "%5.0"
 /begin AXIS_DESCR COM_AXIS online_dummy _CNV_A_R_LINEAR_____22_CM 6 0. 5. FORMAT "%2.0" AXIS_PTS_REF ldp_fmy_dtc /end AXIS_DESCR
/end CHARACTERISTIC
/begin CHARACTERISTIC fmy_id_msw_tog.c_err_clas "" VALUE 0xffe42500 _REC_VAL_20_u1 255. _CNV_A_R_LINEAR_____0_CM 0. 255. DISPLAY_IDENTIFIER C_ERR_CLAS_MSW_TOG FORMAT "%3.0" /end CHARACTERISTIC
/begin CHARACTERISTIC fmy_id_msw_2.dtc "" CURVE 0xffe42502 _REC_CUR_20_u2_u2 65535. _CNV_A_R_LINEAR_____0_CM 0. 65535. DISPLAY_IDENTIFIER ID_ERR_DTC_MSW_2 FORMAT "%5.0"
 /begin AXIS_DESCR COM_AXIS online_dummy _CNV_A_R_LINEAR_____22_CM 6 0. 5. FORMAT "%2.0" AXIS_PTS_REF ldp_fmy_dtc /end AXIS_DESCR
/end CHARACTERISTIC
/begin CHARACTERISTIC fmy_id_msw_2.c_err_clas "" VALUE 0xffe42512 _REC_VAL_20_u1 255. _CNV_A_R_LINEAR_____0_CM 0. 255. DISPLAY_IDENTIFIER C_ERR_CLAS_MSW_2 FORMAT "%3.0" /end CHARACTERISTIC
/begin CHARACTERISTIC fmy_id_msw_3.dtc "" CURVE 0xffe42514 _REC_CUR_20_u2_u2 65535. _CNV_A_R_LINEAR_____0_CM 0. 65535. DISPLAY_IDENTIFIER ID_ERR_DTC_MSW_3 FORMAT "%5.0"
 /begin AXIS_DESCR COM_AXIS online_dummy _CNV_A_R_LINEAR_____22_CM 6 0. 5. FORMAT "%2.0" AXIS_PTS_REF ldp_fmy_dtc /end AXIS_DESCR
/end CHARACTERISTIC
/begin CHARACTERISTIC fmy_id_msw_3.c_err_clas "" VALUE 0xffe42524 _REC_VAL_20_u1 255. _CNV_A_R_LINEAR_____0_CM 0. 255. DISPLAY_IDENTIFIER C_ERR_CLAS_MSW_3 FORMAT "%3.0" /end CHARACTERISTIC
/begin CHARACTERISTIC fmy_id_isa_1.dtc "" CURVE 0xffe42526 _REC_CUR_20_u2_u2 65535. _CNV_A_R_LINEAR_____0_CM 0. 65535. DISPLAY_IDENTIFIER ID_ERR_DTC_ISA_1 FORMAT "%5.0"
 /begin AXIS_DESCR COM_AXIS online_dummy _CNV_A_R_LINEAR_____22_CM 6 0. 5. FORMAT "%2.0" AXIS_PTS_REF ldp_fmy_dtc /end AXIS_DESCR
/end CHARACTERISTIC
/begin CHARACTERISTIC fmy_id_isa_1.c_err_clas "" VALUE 0xffe42536 _REC_VAL_20_u1 255. _CNV_A_R_LINEAR_____0_CM 0. 255. DISPLAY_IDENTIFIER C_ERR_CLAS_ISA_1 FORMAT "%3.0" /end CHARACTERISTIC
/begin CHARACTERISTIC fmy_id_isa_2.dtc "" CURVE 0xffe42538 _REC_CUR_20_u2_u2 65535. _CNV_A_R_LINEAR_____0_CM 0. 65535. DISPLAY_IDENTIFIER ID_ERR_DTC_ISA_2 FORMAT "%5.0"
 /begin AXIS_DESCR COM_AXIS online_dummy _CNV_A_R_LINEAR_____22_CM 6 0. 5. FORMAT "%2.0" AXIS_PTS_REF ldp_fmy_dtc /end AXIS_DESCR
/end CHARACTERISTIC
/begin CHARACTERISTIC fmy_id_isa_2.c_err_clas "" VALUE 0xffe42548 _REC_VAL_20_u1 255. _CNV_A_R_LINEAR_____0_CM 0. 255. DISPLAY_IDENTIFIER C_ERR_CLAS_ISA_2 FORMAT "%3.0" /end CHARACTERISTIC
/begin CHARACTERISTIC fmy_id_seg_t_ad.dtc "" CURVE 0xffe4254a _REC_CUR_20_u2_u2 65535. _CNV_A_R_LINEAR_____0_CM 0. 65535. DISPLAY_IDENTIFIER ID_ERR_DTC_SEG_T_AD FORMAT "%5.0"
 /begin AXIS_DESCR COM_AXIS online_dummy _CNV_A_R_LINEAR_____22_CM 6 0. 5. FORMAT "%2.0" AXIS_PTS_REF ldp_fmy_dtc /end AXIS_DESCR
/end CHARACTERISTIC
/begin CHARACTERISTIC fmy_id_seg_t_ad.c_err_clas "" VALUE 0xffe4255a _REC_VAL_20_u1 255. _CNV_A_R_LINEAR_____0_CM 0. 255. DISPLAY_IDENTIFIER C_ERR_CLAS_SEG_T_AD FORMAT "%3.0" /end CHARACTERISTIC
/begin CHARACTERISTIC fmy_id_seg_t.dtc "" CURVE 0xffe4255c _REC_CUR_20_u2_u2 65535. _CNV_A_R_LINEAR_____0_CM 0. 65535. DISPLAY_IDENTIFIER ID_ERR_DTC_SEG_T FORMAT "%5.0"
 /begin AXIS_DESCR COM_AXIS online_dummy _CNV_A_R_LINEAR_____22_CM 6 0. 5. FORMAT "%2.0" AXIS_PTS_REF ldp_fmy_dtc /end AXIS_DESCR
/end CHARACTERISTIC
/begin CHARACTERISTIC fmy_id_seg_t.c_err_clas "" VALUE 0xffe4256c _REC_VAL_20_u1 255. _CNV_A_R_LINEAR_____0_CM 0. 255. DISPLAY_IDENTIFIER C_ERR_CLAS_SEG_T FORMAT "%3.0" /end CHARACTERISTIC
/begin CHARACTERISTIC fmy_id_mis_0.dtc "" CURVE 0xffe4256e _REC_CUR_20_u2_u2 65535. _CNV_A_R_LINEAR_____0_CM 0. 65535. DISPLAY_IDENTIFIER ID_ERR_DTC_MIS_0 FORMAT "%5.0"
 /begin AXIS_DESCR COM_AXIS online_dummy _CNV_A_R_LINEAR_____22_CM 6 0. 5. FORMAT "%2.0" AXIS_PTS_REF ldp_fmy_dtc /end AXIS_DESCR
/end CHARACTERISTIC
/begin CHARACTERISTIC fmy_id_mis_0.c_err_clas "" VALUE 0xffe4257e _REC_VAL_20_u1 255. _CNV_A_R_LINEAR_____0_CM 0. 255. DISPLAY_IDENTIFIER C_ERR_CLAS_MIS_0 FORMAT "%3.0" /end CHARACTERISTIC
/begin CHARACTERISTIC fmy_id_mis_1.dtc "" CURVE 0xffe42580 _REC_CUR_20_u2_u2 65535. _CNV_A_R_LINEAR_____0_CM 0. 65535. DISPLAY_IDENTIFIER ID_ERR_DTC_MIS_1 FORMAT "%5.0"
 /begin AXIS_DESCR COM_AXIS online_dummy _CNV_A_R_LINEAR_____22_CM 6 0. 5. FORMAT "%2.0" AXIS_PTS_REF ldp_fmy_dtc /end AXIS_DESCR
/end CHARACTERISTIC
/begin CHARACTERISTIC fmy_id_mis_1.c_err_clas "" VALUE 0xffe42590 _REC_VAL_20_u1 255. _CNV_A_R_LINEAR_____0_CM 0. 255. DISPLAY_IDENTIFIER C_ERR_CLAS_MIS_1 FORMAT "%3.0" /end CHARACTERISTIC
/begin CHARACTERISTIC fmy_id_mis_2.dtc "" CURVE 0xffe42592 _REC_CUR_20_u2_u2 65535. _CNV_A_R_LINEAR_____0_CM 0. 65535. DISPLAY_IDENTIFIER ID_ERR_DTC_MIS_2 FORMAT "%5.0"
 /begin AXIS_DESCR COM_AXIS online_dummy _CNV_A_R_LINEAR_____22_CM 6 0. 5. FORMAT "%2.0" AXIS_PTS_REF ldp_fmy_dtc /end AXIS_DESCR
/end CHARACTERISTIC
/begin CHARACTERISTIC fmy_id_mis_2.c_err_clas "" VALUE 0xffe425a2 _REC_VAL_20_u1 255. _CNV_A_R_LINEAR_____0_CM 0. 255. DISPLAY_IDENTIFIER C_ERR_CLAS_MIS_2 FORMAT "%3.0" /end CHARACTERISTIC
/begin CHARACTERISTIC fmy_id_mis_3.dtc "" CURVE 0xffe425a4 _REC_CUR_20_u2_u2 65535. _CNV_A_R_LINEAR_____0_CM 0. 65535. DISPLAY_IDENTIFIER ID_ERR_DTC_MIS_3 FORMAT "%5.0"
 /begin AXIS_DESCR COM_AXIS online_dummy _CNV_A_R_LINEAR_____22_CM 6 0. 5. FORMAT "%2.0" AXIS_PTS_REF ldp_fmy_dtc /end AXIS_DESCR
/end CHARACTERISTIC
/begin CHARACTERISTIC fmy_id_mis_3.c_err_clas "" VALUE 0xffe425b4 _REC_VAL_20_u1 255. _CNV_A_R_LINEAR_____0_CM 0. 255. DISPLAY_IDENTIFIER C_ERR_CLAS_MIS_3 FORMAT "%3.0" /end CHARACTERISTIC
/begin CHARACTERISTIC fmy_id_mis_4.dtc "" CURVE 0xffe425b6 _REC_CUR_20_u2_u2 65535. _CNV_A_R_LINEAR_____0_CM 0. 65535. DISPLAY_IDENTIFIER ID_ERR_DTC_MIS_4 FORMAT "%5.0"
 /begin AXIS_DESCR COM_AXIS online_dummy _CNV_A_R_LINEAR_____22_CM 6 0. 5. FORMAT "%2.0" AXIS_PTS_REF ldp_fmy_dtc /end AXIS_DESCR
/end CHARACTERISTIC
/begin CHARACTERISTIC fmy_id_mis_4.c_err_clas "" VALUE 0xffe425c6 _REC_VAL_20_u1 255. _CNV_A_R_LINEAR_____0_CM 0. 255. DISPLAY_IDENTIFIER C_ERR_CLAS_MIS_4 FORMAT "%3.0" /end CHARACTERISTIC
/begin CHARACTERISTIC fmy_id_mis_5.dtc "" CURVE 0xffe425c8 _REC_CUR_20_u2_u2 65535. _CNV_A_R_LINEAR_____0_CM 0. 65535. DISPLAY_IDENTIFIER ID_ERR_DTC_MIS_5 FORMAT "%5.0"
 /begin AXIS_DESCR COM_AXIS online_dummy _CNV_A_R_LINEAR_____22_CM 6 0. 5. FORMAT "%2.0" AXIS_PTS_REF ldp_fmy_dtc /end AXIS_DESCR
/end CHARACTERISTIC
/begin CHARACTERISTIC fmy_id_mis_5.c_err_clas "" VALUE 0xffe425d8 _REC_VAL_20_u1 255. _CNV_A_R_LINEAR_____0_CM 0. 255. DISPLAY_IDENTIFIER C_ERR_CLAS_MIS_5 FORMAT "%3.0" /end CHARACTERISTIC
/begin CHARACTERISTIC fmy_id_mis_low_fuel.dtc "" CURVE 0xffe425da _REC_CUR_20_u2_u2 65535. _CNV_A_R_LINEAR_____0_CM 0. 65535. DISPLAY_IDENTIFIER ID_ERR_DTC_MIS_LOW_FUEL FORMAT "%5.0"
 /begin AXIS_DESCR COM_AXIS online_dummy _CNV_A_R_LINEAR_____22_CM 6 0. 5. FORMAT "%2.0" AXIS_PTS_REF ldp_fmy_dtc /end AXIS_DESCR
/end CHARACTERISTIC
/begin CHARACTERISTIC fmy_id_mis_low_fuel.c_err_clas "" VALUE 0xffe425ea _REC_VAL_20_u1 255. _CNV_A_R_LINEAR_____0_CM 0. 255. DISPLAY_IDENTIFIER C_ERR_CLAS_MIS_LOW_FUEL FORMAT "%3.0" /end CHARACTERISTIC
/begin CHARACTERISTIC fmy_id_mis_mpl.dtc "" CURVE 0xffe425ec _REC_CUR_20_u2_u2 65535. _CNV_A_R_LINEAR_____0_CM 0. 65535. DISPLAY_IDENTIFIER ID_ERR_DTC_MIS_MPL FORMAT "%5.0"
 /begin AXIS_DESCR COM_AXIS online_dummy _CNV_A_R_LINEAR_____22_CM 6 0. 5. FORMAT "%2.0" AXIS_PTS_REF ldp_fmy_dtc /end AXIS_DESCR
/end CHARACTERISTIC
/begin CHARACTERISTIC fmy_id_mis_mpl.c_err_clas "" VALUE 0xffe425fc _REC_VAL_20_u1 255. _CNV_A_R_LINEAR_____0_CM 0. 255. DISPLAY_IDENTIFIER C_ERR_CLAS_MIS_MPL FORMAT "%3.0" /end CHARACTERISTIC
/begin CHARACTERISTIC fmy_id_conv_mon_1.dtc "" CURVE 0xffe425fe _REC_CUR_20_u2_u2 65535. _CNV_A_R_LINEAR_____0_CM 0. 65535. DISPLAY_IDENTIFIER ID_ERR_DTC_CONV_MON_1 FORMAT "%5.0"
 /begin AXIS_DESCR COM_AXIS online_dummy _CNV_A_R_LINEAR_____22_CM 6 0. 5. FORMAT "%2.0" AXIS_PTS_REF ldp_fmy_dtc /end AXIS_DESCR
/end CHARACTERISTIC
/begin CHARACTERISTIC fmy_id_conv_mon_1.c_err_clas "" VALUE 0xffe4260e _REC_VAL_20_u1 255. _CNV_A_R_LINEAR_____0_CM 0. 255. DISPLAY_IDENTIFIER C_ERR_CLAS_CONV_MON_1 FORMAT "%3.0" /end CHARACTERISTIC
/begin CHARACTERISTIC fmy_id_n_32_mon_1.dtc "" CURVE 0xffe42610 _REC_CUR_20_u2_u2 65535. _CNV_A_R_LINEAR_____0_CM 0. 65535. DISPLAY_IDENTIFIER ID_ERR_DTC_N_32_MON_1 FORMAT "%5.0"
 /begin AXIS_DESCR COM_AXIS online_dummy _CNV_A_R_LINEAR_____22_CM 6 0. 5. FORMAT "%2.0" AXIS_PTS_REF ldp_fmy_dtc /end AXIS_DESCR
/end CHARACTERISTIC
/begin CHARACTERISTIC fmy_id_n_32_mon_1.c_err_clas "" VALUE 0xffe42620 _REC_VAL_20_u1 255. _CNV_A_R_LINEAR_____0_CM 0. 255. DISPLAY_IDENTIFIER C_ERR_CLAS_N_32_MON_1 FORMAT "%3.0" /end CHARACTERISTIC
/begin CHARACTERISTIC fmy_id_pvs_mon_1.dtc "" CURVE 0xffe42622 _REC_CUR_20_u2_u2 65535. _CNV_A_R_LINEAR_____0_CM 0. 65535. DISPLAY_IDENTIFIER ID_ERR_DTC_PVS_MON_1 FORMAT "%5.0"
 /begin AXIS_DESCR COM_AXIS online_dummy _CNV_A_R_LINEAR_____22_CM 6 0. 5. FORMAT "%2.0" AXIS_PTS_REF ldp_fmy_dtc /end AXIS_DESCR
/end CHARACTERISTIC
/begin CHARACTERISTIC fmy_id_pvs_mon_1.c_err_clas "" VALUE 0xffe42632 _REC_VAL_20_u1 255. _CNV_A_R_LINEAR_____0_CM 0. 255. DISPLAY_IDENTIFIER C_ERR_CLAS_PVS_MON_1 FORMAT "%3.0" /end CHARACTERISTIC
/begin CHARACTERISTIC fmy_id_maf_tps_mon_1.dtc "" CURVE 0xffe42634 _REC_CUR_20_u2_u2 65535. _CNV_A_R_LINEAR_____0_CM 0. 65535. DISPLAY_IDENTIFIER ID_ERR_DTC_MAF_TPS_MON_1 FORMAT "%5.0"
 /begin AXIS_DESCR COM_AXIS online_dummy _CNV_A_R_LINEAR_____22_CM 6 0. 5. FORMAT "%2.0" AXIS_PTS_REF ldp_fmy_dtc /end AXIS_DESCR
/end CHARACTERISTIC
/begin CHARACTERISTIC fmy_id_maf_tps_mon_1.c_err_clas "" VALUE 0xffe42644 _REC_VAL_20_u1 255. _CNV_A_R_LINEAR_____0_CM 0. 255. DISPLAY_IDENTIFIER C_ERR_CLAS_MAF_TPS_MON_1 FORMAT "%3.0" /end CHARACTERISTIC
/begin CHARACTERISTIC fmy_id_tq_dif_isc_mon_1.dtc "" CURVE 0xffe42646 _REC_CUR_20_u2_u2 65535. _CNV_A_R_LINEAR_____0_CM 0. 65535. DISPLAY_IDENTIFIER ID_ERR_DTC_TQ_DIF_ISC_MON_1 FORMAT "%5.0"
 /begin AXIS_DESCR COM_AXIS online_dummy _CNV_A_R_LINEAR_____22_CM 6 0. 5. FORMAT "%2.0" AXIS_PTS_REF ldp_fmy_dtc /end AXIS_DESCR
/end CHARACTERISTIC
/begin CHARACTERISTIC fmy_id_tq_dif_isc_mon_1.c_err_clas "" VALUE 0xffe42656 _REC_VAL_20_u1 255. _CNV_A_R_LINEAR_____0_CM 0. 255. DISPLAY_IDENTIFIER C_ERR_CLAS_TQ_DIF_ISC_MON_1 FORMAT "%3.0" /end CHARACTERISTIC
/begin CHARACTERISTIC fmy_id_tq_req_mon_1.dtc "" CURVE 0xffe42658 _REC_CUR_20_u2_u2 65535. _CNV_A_R_LINEAR_____0_CM 0. 65535. DISPLAY_IDENTIFIER ID_ERR_DTC_TQ_REQ_MON_1 FORMAT "%5.0"
 /begin AXIS_DESCR COM_AXIS online_dummy _CNV_A_R_LINEAR_____22_CM 6 0. 5. FORMAT "%2.0" AXIS_PTS_REF ldp_fmy_dtc /end AXIS_DESCR
/end CHARACTERISTIC
/begin CHARACTERISTIC fmy_id_tq_req_mon_1.c_err_clas "" VALUE 0xffe42668 _REC_VAL_20_u1 255. _CNV_A_R_LINEAR_____0_CM 0. 255. DISPLAY_IDENTIFIER C_ERR_CLAS_TQ_REQ_MON_1 FORMAT "%3.0" /end CHARACTERISTIC
/begin CHARACTERISTIC fmy_id_tq_ext_mon_1.dtc "" CURVE 0xffe4266a _REC_CUR_20_u2_u2 65535. _CNV_A_R_LINEAR_____0_CM 0. 65535. DISPLAY_IDENTIFIER ID_ERR_DTC_TQ_EXT_MON_1 FORMAT "%5.0"
 /begin AXIS_DESCR COM_AXIS online_dummy _CNV_A_R_LINEAR_____22_CM 6 0. 5. FORMAT "%2.0" AXIS_PTS_REF ldp_fmy_dtc /end AXIS_DESCR
/end CHARACTERISTIC
/begin CHARACTERISTIC fmy_id_tq_ext_mon_1.c_err_clas "" VALUE 0xffe4267a _REC_VAL_20_u1 255. _CNV_A_R_LINEAR_____0_CM 0. 255. DISPLAY_IDENTIFIER C_ERR_CLAS_TQ_EXT_MON_1 FORMAT "%3.0" /end CHARACTERISTIC
/begin CHARACTERISTIC fmy_id_tqi_av_mon_1.dtc "" CURVE 0xffe4267c _REC_CUR_20_u2_u2 65535. _CNV_A_R_LINEAR_____0_CM 0. 65535. DISPLAY_IDENTIFIER ID_ERR_DTC_TQI_AV_MON_1 FORMAT "%5.0"
 /begin AXIS_DESCR COM_AXIS online_dummy _CNV_A_R_LINEAR_____22_CM 6 0. 5. FORMAT "%2.0" AXIS_PTS_REF ldp_fmy_dtc /end AXIS_DESCR
/end CHARACTERISTIC
/begin CHARACTERISTIC fmy_id_tqi_av_mon_1.c_err_clas "" VALUE 0xffe4268c _REC_VAL_20_u1 255. _CNV_A_R_LINEAR_____0_CM 0. 255. DISPLAY_IDENTIFIER C_ERR_CLAS_TQI_AV_MON_1 FORMAT "%3.0" /end CHARACTERISTIC
/begin CHARACTERISTIC fmy_id_tqi_n_max_mon_1.dtc "" CURVE 0xffe4268e _REC_CUR_20_u2_u2 65535. _CNV_A_R_LINEAR_____0_CM 0. 65535. DISPLAY_IDENTIFIER ID_ERR_DTC_TQI_N_MAX_MON_1 FORMAT "%5.0"
 /begin AXIS_DESCR COM_AXIS online_dummy _CNV_A_R_LINEAR_____22_CM 6 0. 5. FORMAT "%2.0" AXIS_PTS_REF ldp_fmy_dtc /end AXIS_DESCR
/end CHARACTERISTIC
/begin CHARACTERISTIC fmy_id_tqi_n_max_mon_1.c_err_clas "" VALUE 0xffe4269e _REC_VAL_20_u1 255. _CNV_A_R_LINEAR_____0_CM 0. 255. DISPLAY_IDENTIFIER C_ERR_CLAS_TQI_N_MAX_MON_1 FORMAT "%3.0" /end CHARACTERISTIC
/begin CHARACTERISTIC fmy_id_cru_inh_mon_1.dtc "" CURVE 0xffe426a0 _REC_CUR_20_u2_u2 65535. _CNV_A_R_LINEAR_____0_CM 0. 65535. DISPLAY_IDENTIFIER ID_ERR_DTC_CRU_INH_MON_1 FORMAT "%5.0"
 /begin AXIS_DESCR COM_AXIS online_dummy _CNV_A_R_LINEAR_____22_CM 6 0. 5. FORMAT "%2.0" AXIS_PTS_REF ldp_fmy_dtc /end AXIS_DESCR
/end CHARACTERISTIC
/begin CHARACTERISTIC fmy_id_cru_inh_mon_1.c_err_clas "" VALUE 0xffe426b0 _REC_VAL_20_u1 255. _CNV_A_R_LINEAR_____0_CM 0. 255. DISPLAY_IDENTIFIER C_ERR_CLAS_CRU_INH_MON_1 FORMAT "%3.0" /end CHARACTERISTIC
/begin CHARACTERISTIC fmy_id_tqi_n_max_nvmy_mon.dtc "" CURVE 0xffe426b2 _REC_CUR_20_u2_u2 65535. _CNV_A_R_LINEAR_____0_CM 0. 65535. DISPLAY_IDENTIFIER ID_ERR_DTC_TQI_N_MAX_NVMY_MON FORMAT "%5.0"
 /begin AXIS_DESCR COM_AXIS online_dummy _CNV_A_R_LINEAR_____22_CM 6 0. 5. FORMAT "%2.0" AXIS_PTS_REF ldp_fmy_dtc /end AXIS_DESCR
/end CHARACTERISTIC
/begin CHARACTERISTIC fmy_id_tqi_n_max_nvmy_mon.c_err_clas "" VALUE 0xffe426c2 _REC_VAL_20_u1 255. _CNV_A_R_LINEAR_____0_CM 0. 255. DISPLAY_IDENTIFIER C_ERR_CLAS_TQI_N_MAX_NVMY_MON FORMAT "%3.0" /end CHARACTERISTIC
/begin CHARACTERISTIC fmy_id_sa_safm.dtc "" CURVE 0xffe426c4 _REC_CUR_20_u2_u2 65535. _CNV_A_R_LINEAR_____0_CM 0. 65535. DISPLAY_IDENTIFIER ID_ERR_DTC_SA_SAFM FORMAT "%5.0"
 /begin AXIS_DESCR COM_AXIS online_dummy _CNV_A_R_LINEAR_____22_CM 6 0. 5. FORMAT "%2.0" AXIS_PTS_REF ldp_fmy_dtc /end AXIS_DESCR
/end CHARACTERISTIC
/begin CHARACTERISTIC fmy_id_sa_safm.c_err_clas "" VALUE 0xffe426d4 _REC_VAL_20_u1 255. _CNV_A_R_LINEAR_____0_CM 0. 255. DISPLAY_IDENTIFIER C_ERR_CLAS_SA_SAFM FORMAT "%3.0" /end CHARACTERISTIC
/begin CHARACTERISTIC fmy_id_sa_sap.dtc "" CURVE 0xffe426d6 _REC_CUR_20_u2_u2 65535. _CNV_A_R_LINEAR_____0_CM 0. 65535. DISPLAY_IDENTIFIER ID_ERR_DTC_SA_SAP FORMAT "%5.0"
 /begin AXIS_DESCR COM_AXIS online_dummy _CNV_A_R_LINEAR_____22_CM 6 0. 5. FORMAT "%2.0" AXIS_PTS_REF ldp_fmy_dtc /end AXIS_DESCR
/end CHARACTERISTIC
/begin CHARACTERISTIC fmy_id_sa_sap.c_err_clas "" VALUE 0xffe426e6 _REC_VAL_20_u1 255. _CNV_A_R_LINEAR_____0_CM 0. 255. DISPLAY_IDENTIFIER C_ERR_CLAS_SA_SAP FORMAT "%3.0" /end CHARACTERISTIC
/begin CHARACTERISTIC fmy_id_sa_sys.dtc "" CURVE 0xffe426e8 _REC_CUR_20_u2_u2 65535. _CNV_A_R_LINEAR_____0_CM 0. 65535. DISPLAY_IDENTIFIER ID_ERR_DTC_SA_SYS FORMAT "%5.0"
 /begin AXIS_DESCR COM_AXIS online_dummy _CNV_A_R_LINEAR_____22_CM 6 0. 5. FORMAT "%2.0" AXIS_PTS_REF ldp_fmy_dtc /end AXIS_DESCR
/end CHARACTERISTIC
/begin CHARACTERISTIC fmy_id_sa_sys.c_err_clas "" VALUE 0xffe426f8 _REC_VAL_20_u1 255. _CNV_A_R_LINEAR_____0_CM 0. 255. DISPLAY_IDENTIFIER C_ERR_CLAS_SA_SYS FORMAT "%3.0" /end CHARACTERISTIC
/begin CHARACTERISTIC fmy_id_sa_sav.dtc "" CURVE 0xffe426fa _REC_CUR_20_u2_u2 65535. _CNV_A_R_LINEAR_____0_CM 0. 65535. DISPLAY_IDENTIFIER ID_ERR_DTC_SA_SAV FORMAT "%5.0"
 /begin AXIS_DESCR COM_AXIS online_dummy _CNV_A_R_LINEAR_____22_CM 6 0. 5. FORMAT "%2.0" AXIS_PTS_REF ldp_fmy_dtc /end AXIS_DESCR
/end CHARACTERISTIC
/begin CHARACTERISTIC fmy_id_sa_sav.c_err_clas "" VALUE 0xffe4270a _REC_VAL_20_u1 255. _CNV_A_R_LINEAR_____0_CM 0. 255. DISPLAY_IDENTIFIER C_ERR_CLAS_SA_SAV FORMAT "%3.0" /end CHARACTERISTIC
/begin CHARACTERISTIC fmy_id_imob_1.dtc "" CURVE 0xffe4270c _REC_CUR_20_u2_u2 65535. _CNV_A_R_LINEAR_____0_CM 0. 65535. DISPLAY_IDENTIFIER ID_ERR_DTC_IMOB_1 FORMAT "%5.0"
 /begin AXIS_DESCR COM_AXIS online_dummy _CNV_A_R_LINEAR_____22_CM 6 0. 5. FORMAT "%2.0" AXIS_PTS_REF ldp_fmy_dtc /end AXIS_DESCR
/end CHARACTERISTIC
/begin CHARACTERISTIC fmy_id_imob_1.c_err_clas "" VALUE 0xffe4271c _REC_VAL_20_u1 255. _CNV_A_R_LINEAR_____0_CM 0. 255. DISPLAY_IDENTIFIER C_ERR_CLAS_IMOB_1 FORMAT "%3.0" /end CHARACTERISTIC
/begin CHARACTERISTIC fmy_id_imob_2.dtc "" CURVE 0xffe4271e _REC_CUR_20_u2_u2 65535. _CNV_A_R_LINEAR_____0_CM 0. 65535. DISPLAY_IDENTIFIER ID_ERR_DTC_IMOB_2 FORMAT "%5.0"
 /begin AXIS_DESCR COM_AXIS online_dummy _CNV_A_R_LINEAR_____22_CM 6 0. 5. FORMAT "%2.0" AXIS_PTS_REF ldp_fmy_dtc /end AXIS_DESCR
/end CHARACTERISTIC
/begin CHARACTERISTIC fmy_id_imob_2.c_err_clas "" VALUE 0xffe4272e _REC_VAL_20_u1 255. _CNV_A_R_LINEAR_____0_CM 0. 255. DISPLAY_IDENTIFIER C_ERR_CLAS_IMOB_2 FORMAT "%3.0" /end CHARACTERISTIC
/begin CHARACTERISTIC fmy_id_imob_3.dtc "" CURVE 0xffe42730 _REC_CUR_20_u2_u2 65535. _CNV_A_R_LINEAR_____0_CM 0. 65535. DISPLAY_IDENTIFIER ID_ERR_DTC_IMOB_3 FORMAT "%5.0"
 /begin AXIS_DESCR COM_AXIS online_dummy _CNV_A_R_LINEAR_____22_CM 6 0. 5. FORMAT "%2.0" AXIS_PTS_REF ldp_fmy_dtc /end AXIS_DESCR
/end CHARACTERISTIC
/begin CHARACTERISTIC fmy_id_imob_3.c_err_clas "" VALUE 0xffe42740 _REC_VAL_20_u1 255. _CNV_A_R_LINEAR_____0_CM 0. 255. DISPLAY_IDENTIFIER C_ERR_CLAS_IMOB_3 FORMAT "%3.0" /end CHARACTERISTIC
/begin CHARACTERISTIC fmy_id_fsd_1.dtc "" CURVE 0xffe42742 _REC_CUR_20_u2_u2 65535. _CNV_A_R_LINEAR_____0_CM 0. 65535. DISPLAY_IDENTIFIER ID_ERR_DTC_FSD_1 FORMAT "%5.0"
 /begin AXIS_DESCR COM_AXIS online_dummy _CNV_A_R_LINEAR_____22_CM 6 0. 5. FORMAT "%2.0" AXIS_PTS_REF ldp_fmy_dtc /end AXIS_DESCR
/end CHARACTERISTIC
/begin CHARACTERISTIC fmy_id_fsd_1.c_err_clas "" VALUE 0xffe42752 _REC_VAL_20_u1 255. _CNV_A_R_LINEAR_____0_CM 0. 255. DISPLAY_IDENTIFIER C_ERR_CLAS_FSD_1 FORMAT "%3.0" /end CHARACTERISTIC
/begin CHARACTERISTIC fmy_id_fsd_2.dtc "" CURVE 0xffe42754 _REC_CUR_20_u2_u2 65535. _CNV_A_R_LINEAR_____0_CM 0. 65535. DISPLAY_IDENTIFIER ID_ERR_DTC_FSD_2 FORMAT "%5.0"
 /begin AXIS_DESCR COM_AXIS online_dummy _CNV_A_R_LINEAR_____22_CM 6 0. 5. FORMAT "%2.0" AXIS_PTS_REF ldp_fmy_dtc /end AXIS_DESCR
/end CHARACTERISTIC
/begin CHARACTERISTIC fmy_id_fsd_2.c_err_clas "" VALUE 0xffe42764 _REC_VAL_20_u1 255. _CNV_A_R_LINEAR_____0_CM 0. 255. DISPLAY_IDENTIFIER C_ERR_CLAS_FSD_2 FORMAT "%3.0" /end CHARACTERISTIC
/begin CHARACTERISTIC fmy_id_ls_down_swt_1.dtc "" CURVE 0xffe42766 _REC_CUR_20_u2_u2 65535. _CNV_A_R_LINEAR_____0_CM 0. 65535. DISPLAY_IDENTIFIER ID_ERR_DTC_LS_DOWN_SWT_1 FORMAT "%5.0"
 /begin AXIS_DESCR COM_AXIS online_dummy _CNV_A_R_LINEAR_____22_CM 6 0. 5. FORMAT "%2.0" AXIS_PTS_REF ldp_fmy_dtc /end AXIS_DESCR
/end CHARACTERISTIC
/begin CHARACTERISTIC fmy_id_ls_down_swt_1.c_err_clas "" VALUE 0xffe42776 _REC_VAL_20_u1 255. _CNV_A_R_LINEAR_____0_CM 0. 255. DISPLAY_IDENTIFIER C_ERR_CLAS_LS_DOWN_SWT_1 FORMAT "%3.0" /end CHARACTERISTIC
/begin CHARACTERISTIC fmy_id_ls_down_swt_2.dtc "" CURVE 0xffe42778 _REC_CUR_20_u2_u2 65535. _CNV_A_R_LINEAR_____0_CM 0. 65535. DISPLAY_IDENTIFIER ID_ERR_DTC_LS_DOWN_SWT_2 FORMAT "%5.0"
 /begin AXIS_DESCR COM_AXIS online_dummy _CNV_A_R_LINEAR_____22_CM 6 0. 5. FORMAT "%2.0" AXIS_PTS_REF ldp_fmy_dtc /end AXIS_DESCR
/end CHARACTERISTIC
/begin CHARACTERISTIC fmy_id_ls_down_swt_2.c_err_clas "" VALUE 0xffe42788 _REC_VAL_20_u1 255. _CNV_A_R_LINEAR_____0_CM 0. 255. DISPLAY_IDENTIFIER C_ERR_CLAS_LS_DOWN_SWT_2 FORMAT "%3.0" /end CHARACTERISTIC
/begin CHARACTERISTIC fmy_id_ls_down_pue_1.dtc "" CURVE 0xffe4278a _REC_CUR_20_u2_u2 65535. _CNV_A_R_LINEAR_____0_CM 0. 65535. DISPLAY_IDENTIFIER ID_ERR_DTC_LS_DOWN_PUE_1 FORMAT "%5.0"
 /begin AXIS_DESCR COM_AXIS online_dummy _CNV_A_R_LINEAR_____22_CM 6 0. 5. FORMAT "%2.0" AXIS_PTS_REF ldp_fmy_dtc /end AXIS_DESCR
/end CHARACTERISTIC
/begin CHARACTERISTIC fmy_id_ls_down_pue_1.c_err_clas "" VALUE 0xffe4279a _REC_VAL_20_u1 255. _CNV_A_R_LINEAR_____0_CM 0. 255. DISPLAY_IDENTIFIER C_ERR_CLAS_LS_DOWN_PUE_1 FORMAT "%3.0" /end CHARACTERISTIC
/begin CHARACTERISTIC fmy_id_ls_down_pue_2.dtc "" CURVE 0xffe4279c _REC_CUR_20_u2_u2 65535. _CNV_A_R_LINEAR_____0_CM 0. 65535. DISPLAY_IDENTIFIER ID_ERR_DTC_LS_DOWN_PUE_2 FORMAT "%5.0"
 /begin AXIS_DESCR COM_AXIS online_dummy _CNV_A_R_LINEAR_____22_CM 6 0. 5. FORMAT "%2.0" AXIS_PTS_REF ldp_fmy_dtc /end AXIS_DESCR
/end CHARACTERISTIC
/begin CHARACTERISTIC fmy_id_ls_down_pue_2.c_err_clas "" VALUE 0xffe427ac _REC_VAL_20_u1 255. _CNV_A_R_LINEAR_____0_CM 0. 255. DISPLAY_IDENTIFIER C_ERR_CLAS_LS_DOWN_PUE_2 FORMAT "%3.0" /end CHARACTERISTIC
/begin CHARACTERISTIC fmy_id_ef.dtc "" CURVE 0xffe427ae _REC_CUR_20_u2_u2 65535. _CNV_A_R_LINEAR_____0_CM 0. 65535. DISPLAY_IDENTIFIER ID_ERR_DTC_EF FORMAT "%5.0"
 /begin AXIS_DESCR COM_AXIS online_dummy _CNV_A_R_LINEAR_____22_CM 6 0. 5. FORMAT "%2.0" AXIS_PTS_REF ldp_fmy_dtc /end AXIS_DESCR
/end CHARACTERISTIC
/begin CHARACTERISTIC fmy_id_ef.c_err_clas "" VALUE 0xffe427be _REC_VAL_20_u1 255. _CNV_A_R_LINEAR_____0_CM 0. 255. DISPLAY_IDENTIFIER C_ERR_CLAS_EF FORMAT "%3.0" /end CHARACTERISTIC
/begin CHARACTERISTIC fmy_id_tecu.dtc "" CURVE 0xffe427c0 _REC_CUR_20_u2_u2 65535. _CNV_A_R_LINEAR_____0_CM 0. 65535. DISPLAY_IDENTIFIER ID_ERR_DTC_TECU FORMAT "%5.0"
 /begin AXIS_DESCR COM_AXIS online_dummy _CNV_A_R_LINEAR_____22_CM 6 0. 5. FORMAT "%2.0" AXIS_PTS_REF ldp_fmy_dtc /end AXIS_DESCR
/end CHARACTERISTIC
/begin CHARACTERISTIC fmy_id_tecu.c_err_clas "" VALUE 0xffe427d0 _REC_VAL_20_u1 255. _CNV_A_R_LINEAR_____0_CM 0. 255. DISPLAY_IDENTIFIER C_ERR_CLAS_TECU FORMAT "%3.0" /end CHARACTERISTIC
/begin CHARACTERISTIC fmy_id_ebox_cfa.dtc "" CURVE 0xffe427d2 _REC_CUR_20_u2_u2 65535. _CNV_A_R_LINEAR_____0_CM 0. 65535. DISPLAY_IDENTIFIER ID_ERR_DTC_EBOX_CFA FORMAT "%5.0"
 /begin AXIS_DESCR COM_AXIS online_dummy _CNV_A_R_LINEAR_____22_CM 6 0. 5. FORMAT "%2.0" AXIS_PTS_REF ldp_fmy_dtc /end AXIS_DESCR
/end CHARACTERISTIC
/begin CHARACTERISTIC fmy_id_ebox_cfa.c_err_clas "" VALUE 0xffe427e2 _REC_VAL_20_u1 255. _CNV_A_R_LINEAR_____0_CM 0. 255. DISPLAY_IDENTIFIER C_ERR_CLAS_EBOX_CFA FORMAT "%3.0" /end CHARACTERISTIC
/begin CHARACTERISTIC fmy_id_ecu_ram.dtc "" CURVE 0xffe427e4 _REC_CUR_20_u2_u2 65535. _CNV_A_R_LINEAR_____0_CM 0. 65535. DISPLAY_IDENTIFIER ID_ERR_DTC_ECU_RAM FORMAT "%5.0"
 /begin AXIS_DESCR COM_AXIS online_dummy _CNV_A_R_LINEAR_____22_CM 6 0. 5. FORMAT "%2.0" AXIS_PTS_REF ldp_fmy_dtc /end AXIS_DESCR
/end CHARACTERISTIC
/begin CHARACTERISTIC fmy_id_ecu_ram.c_err_clas "" VALUE 0xffe427f4 _REC_VAL_20_u1 255. _CNV_A_R_LINEAR_____0_CM 0. 255. DISPLAY_IDENTIFIER C_ERR_CLAS_ECU_RAM FORMAT "%3.0" /end CHARACTERISTIC
/begin CHARACTERISTIC fmy_id_tqi_lim.dtc "" CURVE 0xffe427f6 _REC_CUR_20_u2_u2 65535. _CNV_A_R_LINEAR_____0_CM 0. 65535. DISPLAY_IDENTIFIER ID_ERR_DTC_TQI_LIM FORMAT "%5.0"
 /begin AXIS_DESCR COM_AXIS online_dummy _CNV_A_R_LINEAR_____22_CM 6 0. 5. FORMAT "%2.0" AXIS_PTS_REF ldp_fmy_dtc /end AXIS_DESCR
/end CHARACTERISTIC
/begin CHARACTERISTIC fmy_id_tqi_lim.c_err_clas "" VALUE 0xffe42806 _REC_VAL_20_u1 255. _CNV_A_R_LINEAR_____0_CM 0. 255. DISPLAY_IDENTIFIER C_ERR_CLAS_TQI_LIM FORMAT "%3.0" /end CHARACTERISTIC
/begin CHARACTERISTIC fmy_id_obd2_lsh_down_1.dtc "" CURVE 0xffe42808 _REC_CUR_20_u2_u2 65535. _CNV_A_R_LINEAR_____0_CM 0. 65535. DISPLAY_IDENTIFIER ID_ERR_DTC_OBD2_LSH_DOWN_1 FORMAT "%5.0"
 /begin AXIS_DESCR COM_AXIS online_dummy _CNV_A_R_LINEAR_____22_CM 6 0. 5. FORMAT "%2.0" AXIS_PTS_REF ldp_fmy_dtc /end AXIS_DESCR
/end CHARACTERISTIC
/begin CHARACTERISTIC fmy_id_obd2_lsh_down_1.c_err_clas "" VALUE 0xffe42818 _REC_VAL_20_u1 255. _CNV_A_R_LINEAR_____0_CM 0. 255. DISPLAY_IDENTIFIER C_ERR_CLAS_OBD2_LSH_DOWN_1 FORMAT "%3.0" /end CHARACTERISTIC
/begin CHARACTERISTIC fmy_id_obd2_lsh_down_2.dtc "" CURVE 0xffe4281a _REC_CUR_20_u2_u2 65535. _CNV_A_R_LINEAR_____0_CM 0. 65535. DISPLAY_IDENTIFIER ID_ERR_DTC_OBD2_LSH_DOWN_2 FORMAT "%5.0"
 /begin AXIS_DESCR COM_AXIS online_dummy _CNV_A_R_LINEAR_____22_CM 6 0. 5. FORMAT "%2.0" AXIS_PTS_REF ldp_fmy_dtc /end AXIS_DESCR
/end CHARACTERISTIC
/begin CHARACTERISTIC fmy_id_obd2_lsh_down_2.c_err_clas "" VALUE 0xffe4282a _REC_VAL_20_u1 255. _CNV_A_R_LINEAR_____0_CM 0. 255. DISPLAY_IDENTIFIER C_ERR_CLAS_OBD2_LSH_DOWN_2 FORMAT "%3.0" /end CHARACTERISTIC
/begin CHARACTERISTIC fmy_id_dmtls.dtc "" CURVE 0xffe4282c _REC_CUR_20_u2_u2 65535. _CNV_A_R_LINEAR_____0_CM 0. 65535. DISPLAY_IDENTIFIER ID_ERR_DTC_DMTLS FORMAT "%5.0"
 /begin AXIS_DESCR COM_AXIS online_dummy _CNV_A_R_LINEAR_____22_CM 6 0. 5. FORMAT "%2.0" AXIS_PTS_REF ldp_fmy_dtc /end AXIS_DESCR
/end CHARACTERISTIC
/begin CHARACTERISTIC fmy_id_dmtls.c_err_clas "" VALUE 0xffe4283c _REC_VAL_20_u1 255. _CNV_A_R_LINEAR_____0_CM 0. 255. DISPLAY_IDENTIFIER C_ERR_CLAS_DMTLS FORMAT "%3.0" /end CHARACTERISTIC
/begin CHARACTERISTIC fmy_id_dmtl_pump.dtc "" CURVE 0xffe4283e _REC_CUR_20_u2_u2 65535. _CNV_A_R_LINEAR_____0_CM 0. 65535. DISPLAY_IDENTIFIER ID_ERR_DTC_DMTL_PUMP FORMAT "%5.0"
 /begin AXIS_DESCR COM_AXIS online_dummy _CNV_A_R_LINEAR_____22_CM 6 0. 5. FORMAT "%2.0" AXIS_PTS_REF ldp_fmy_dtc /end AXIS_DESCR
/end CHARACTERISTIC
/begin CHARACTERISTIC fmy_id_dmtl_pump.c_err_clas "" VALUE 0xffe4284e _REC_VAL_20_u1 255. _CNV_A_R_LINEAR_____0_CM 0. 255. DISPLAY_IDENTIFIER C_ERR_CLAS_DMTL_PUMP FORMAT "%3.0" /end CHARACTERISTIC
/begin CHARACTERISTIC fmy_id_dmtlm.dtc "" CURVE 0xffe42850 _REC_CUR_20_u2_u2 65535. _CNV_A_R_LINEAR_____0_CM 0. 65535. DISPLAY_IDENTIFIER ID_ERR_DTC_DMTLM FORMAT "%5.0"
 /begin AXIS_DESCR COM_AXIS online_dummy _CNV_A_R_LINEAR_____22_CM 6 0. 5. FORMAT "%2.0" AXIS_PTS_REF ldp_fmy_dtc /end AXIS_DESCR
/end CHARACTERISTIC
/begin CHARACTERISTIC fmy_id_dmtlm.c_err_clas "" VALUE 0xffe42860 _REC_VAL_20_u1 255. _CNV_A_R_LINEAR_____0_CM 0. 255. DISPLAY_IDENTIFIER C_ERR_CLAS_DMTLM FORMAT "%3.0" /end CHARACTERISTIC
/begin CHARACTERISTIC fmy_id_dmtl_leak.dtc "" CURVE 0xffe42862 _REC_CUR_20_u2_u2 65535. _CNV_A_R_LINEAR_____0_CM 0. 65535. DISPLAY_IDENTIFIER ID_ERR_DTC_DMTL_LEAK FORMAT "%5.0"
 /begin AXIS_DESCR COM_AXIS online_dummy _CNV_A_R_LINEAR_____22_CM 6 0. 5. FORMAT "%2.0" AXIS_PTS_REF ldp_fmy_dtc /end AXIS_DESCR
/end CHARACTERISTIC
/begin CHARACTERISTIC fmy_id_dmtl_leak.c_err_clas "" VALUE 0xffe42872 _REC_VAL_20_u1 255. _CNV_A_R_LINEAR_____0_CM 0. 255. DISPLAY_IDENTIFIER C_ERR_CLAS_DMTL_LEAK FORMAT "%3.0" /end CHARACTERISTIC
/begin CHARACTERISTIC fmy_id_sof.dtc "" CURVE 0xffe42874 _REC_CUR_20_u2_u2 65535. _CNV_A_R_LINEAR_____0_CM 0. 65535. DISPLAY_IDENTIFIER ID_ERR_DTC_SOF FORMAT "%5.0"
 /begin AXIS_DESCR COM_AXIS online_dummy _CNV_A_R_LINEAR_____22_CM 6 0. 5. FORMAT "%2.0" AXIS_PTS_REF ldp_fmy_dtc /end AXIS_DESCR
/end CHARACTERISTIC
/begin CHARACTERISTIC fmy_id_sof.c_err_clas "" VALUE 0xffe42884 _REC_VAL_20_u1 255. _CNV_A_R_LINEAR_____0_CM 0. 255. DISPLAY_IDENTIFIER C_ERR_CLAS_SOF FORMAT "%3.0" /end CHARACTERISTIC
/begin CHARACTERISTIC fmy_id_sof_req.dtc "" CURVE 0xffe42886 _REC_CUR_20_u2_u2 65535. _CNV_A_R_LINEAR_____0_CM 0. 65535. DISPLAY_IDENTIFIER ID_ERR_DTC_SOF_REQ FORMAT "%5.0"
 /begin AXIS_DESCR COM_AXIS online_dummy _CNV_A_R_LINEAR_____22_CM 6 0. 5. FORMAT "%2.0" AXIS_PTS_REF ldp_fmy_dtc /end AXIS_DESCR
/end CHARACTERISTIC
/begin CHARACTERISTIC fmy_id_sof_req.c_err_clas "" VALUE 0xffe42896 _REC_VAL_20_u1 255. _CNV_A_R_LINEAR_____0_CM 0. 255. DISPLAY_IDENTIFIER C_ERR_CLAS_SOF_REQ FORMAT "%3.0" /end CHARACTERISTIC
/begin CHARACTERISTIC fmy_id_rly_st.dtc "" CURVE 0xffe42898 _REC_CUR_20_u2_u2 65535. _CNV_A_R_LINEAR_____0_CM 0. 65535. DISPLAY_IDENTIFIER ID_ERR_DTC_RLY_ST FORMAT "%5.0"
 /begin AXIS_DESCR COM_AXIS online_dummy _CNV_A_R_LINEAR_____22_CM 6 0. 5. FORMAT "%2.0" AXIS_PTS_REF ldp_fmy_dtc /end AXIS_DESCR
/end CHARACTERISTIC
/begin CHARACTERISTIC fmy_id_rly_st.c_err_clas "" VALUE 0xffe428a8 _REC_VAL_20_u1 255. _CNV_A_R_LINEAR_____0_CM 0. 255. DISPLAY_IDENTIFIER C_ERR_CLAS_RLY_ST FORMAT "%3.0" /end CHARACTERISTIC
/begin CHARACTERISTIC fmy_id_bsd.dtc "" CURVE 0xffe428aa _REC_CUR_20_u2_u2 65535. _CNV_A_R_LINEAR_____0_CM 0. 65535. DISPLAY_IDENTIFIER ID_ERR_DTC_BSD FORMAT "%5.0"
 /begin AXIS_DESCR COM_AXIS online_dummy _CNV_A_R_LINEAR_____22_CM 6 0. 5. FORMAT "%2.0" AXIS_PTS_REF ldp_fmy_dtc /end AXIS_DESCR
/end CHARACTERISTIC
/begin CHARACTERISTIC fmy_id_bsd.c_err_clas "" VALUE 0xffe428ba _REC_VAL_20_u1 255. _CNV_A_R_LINEAR_____0_CM 0. 255. DISPLAY_IDENTIFIER C_ERR_CLAS_BSD FORMAT "%3.0" /end CHARACTERISTIC
/begin CHARACTERISTIC fmy_id_poil_swi.dtc "" CURVE 0xffe428bc _REC_CUR_20_u2_u2 65535. _CNV_A_R_LINEAR_____0_CM 0. 65535. DISPLAY_IDENTIFIER ID_ERR_DTC_POIL_SWI FORMAT "%5.0"
 /begin AXIS_DESCR COM_AXIS online_dummy _CNV_A_R_LINEAR_____22_CM 6 0. 5. FORMAT "%2.0" AXIS_PTS_REF ldp_fmy_dtc /end AXIS_DESCR
/end CHARACTERISTIC
/begin CHARACTERISTIC fmy_id_poil_swi.c_err_clas "" VALUE 0xffe428cc _REC_VAL_20_u1 255. _CNV_A_R_LINEAR_____0_CM 0. 255. DISPLAY_IDENTIFIER C_ERR_CLAS_POIL_SWI FORMAT "%3.0" /end CHARACTERISTIC
/begin CHARACTERISTIC fmy_id_tout_efp.dtc "" CURVE 0xffe428ce _REC_CUR_20_u2_u2 65535. _CNV_A_R_LINEAR_____0_CM 0. 65535. DISPLAY_IDENTIFIER ID_ERR_DTC_TOUT_EFP FORMAT "%5.0"
 /begin AXIS_DESCR COM_AXIS online_dummy _CNV_A_R_LINEAR_____22_CM 6 0. 5. FORMAT "%2.0" AXIS_PTS_REF ldp_fmy_dtc /end AXIS_DESCR
/end CHARACTERISTIC
/begin CHARACTERISTIC fmy_id_tout_efp.c_err_clas "" VALUE 0xffe428de _REC_VAL_20_u1 255. _CNV_A_R_LINEAR_____0_CM 0. 255. DISPLAY_IDENTIFIER C_ERR_CLAS_TOUT_EFP FORMAT "%3.0" /end CHARACTERISTIC
/begin CHARACTERISTIC fmy_id_diagcps.dtc "" CURVE 0xffe428e0 _REC_CUR_20_u2_u2 65535. _CNV_A_R_LINEAR_____0_CM 0. 65535. DISPLAY_IDENTIFIER ID_ERR_DTC_DIAGCPS FORMAT "%5.0"
 /begin AXIS_DESCR COM_AXIS online_dummy _CNV_A_R_LINEAR_____22_CM 6 0. 5. FORMAT "%2.0" AXIS_PTS_REF ldp_fmy_dtc /end AXIS_DESCR
/end CHARACTERISTIC
/begin CHARACTERISTIC fmy_id_diagcps.c_err_clas "" VALUE 0xffe428f0 _REC_VAL_20_u1 255. _CNV_A_R_LINEAR_____0_CM 0. 255. DISPLAY_IDENTIFIER C_ERR_CLAS_DIAGCPS FORMAT "%3.0" /end CHARACTERISTIC
/begin CHARACTERISTIC fmy_id_tq_gs_inc_plaus.dtc "" CURVE 0xffe428f2 _REC_CUR_20_u2_u2 65535. _CNV_A_R_LINEAR_____0_CM 0. 65535. DISPLAY_IDENTIFIER ID_ERR_DTC_TQ_GS_INC_PLAUS FORMAT "%5.0"
 /begin AXIS_DESCR COM_AXIS online_dummy _CNV_A_R_LINEAR_____22_CM 6 0. 5. FORMAT "%2.0" AXIS_PTS_REF ldp_fmy_dtc /end AXIS_DESCR
/end CHARACTERISTIC
/begin CHARACTERISTIC fmy_id_tq_gs_inc_plaus.c_err_clas "" VALUE 0xffe42902 _REC_VAL_20_u1 255. _CNV_A_R_LINEAR_____0_CM 0. 255. DISPLAY_IDENTIFIER C_ERR_CLAS_TQ_GS_INC_PLAUS FORMAT "%3.0" /end CHARACTERISTIC
/begin CHARACTERISTIC fmy_id_dcc.dtc "" CURVE 0xffe42904 _REC_CUR_20_u2_u2 65535. _CNV_A_R_LINEAR_____0_CM 0. 65535. DISPLAY_IDENTIFIER ID_ERR_DTC_DCC FORMAT "%5.0"
 /begin AXIS_DESCR COM_AXIS online_dummy _CNV_A_R_LINEAR_____22_CM 6 0. 5. FORMAT "%2.0" AXIS_PTS_REF ldp_fmy_dtc /end AXIS_DESCR
/end CHARACTERISTIC
/begin CHARACTERISTIC fmy_id_dcc.c_err_clas "" VALUE 0xffe42914 _REC_VAL_20_u1 255. _CNV_A_R_LINEAR_____0_CM 0. 255. DISPLAY_IDENTIFIER C_ERR_CLAS_DCC FORMAT "%3.0" /end CHARACTERISTIC
/begin CHARACTERISTIC fmy_id_ecras.dtc "" CURVE 0xffe42916 _REC_CUR_20_u2_u2 65535. _CNV_A_R_LINEAR_____0_CM 0. 65535. DISPLAY_IDENTIFIER ID_ERR_DTC_ECRAS FORMAT "%5.0"
 /begin AXIS_DESCR COM_AXIS online_dummy _CNV_A_R_LINEAR_____22_CM 6 0. 5. FORMAT "%2.0" AXIS_PTS_REF ldp_fmy_dtc /end AXIS_DESCR
/end CHARACTERISTIC
/begin CHARACTERISTIC fmy_id_ecras.c_err_clas "" VALUE 0xffe42926 _REC_VAL_20_u1 255. _CNV_A_R_LINEAR_____0_CM 0. 255. DISPLAY_IDENTIFIER C_ERR_CLAS_ECRAS FORMAT "%3.0" /end CHARACTERISTIC
/begin CHARACTERISTIC fmy_id_dmtlh.dtc "" CURVE 0xffe42928 _REC_CUR_20_u2_u2 65535. _CNV_A_R_LINEAR_____0_CM 0. 65535. DISPLAY_IDENTIFIER ID_ERR_DTC_DMTLH FORMAT "%5.0"
 /begin AXIS_DESCR COM_AXIS online_dummy _CNV_A_R_LINEAR_____22_CM 6 0. 5. FORMAT "%2.0" AXIS_PTS_REF ldp_fmy_dtc /end AXIS_DESCR
/end CHARACTERISTIC
/begin CHARACTERISTIC fmy_id_dmtlh.c_err_clas "" VALUE 0xffe42938 _REC_VAL_20_u1 255. _CNV_A_R_LINEAR_____0_CM 0. 255. DISPLAY_IDENTIFIER C_ERR_CLAS_DMTLH FORMAT "%3.0" /end CHARACTERISTIC
/begin CHARACTERISTIC fmy_id_cs.dtc "" CURVE 0xffe4293a _REC_CUR_20_u2_u2 65535. _CNV_A_R_LINEAR_____0_CM 0. 65535. DISPLAY_IDENTIFIER ID_ERR_DTC_CS FORMAT "%5.0"
 /begin AXIS_DESCR COM_AXIS online_dummy _CNV_A_R_LINEAR_____22_CM 6 0. 5. FORMAT "%2.0" AXIS_PTS_REF ldp_fmy_dtc /end AXIS_DESCR
/end CHARACTERISTIC
/begin CHARACTERISTIC fmy_id_cs.c_err_clas "" VALUE 0xffe4294a _REC_VAL_20_u1 255. _CNV_A_R_LINEAR_____0_CM 0. 255. DISPLAY_IDENTIFIER C_ERR_CLAS_CS FORMAT "%3.0" /end CHARACTERISTIC
/begin CHARACTERISTIC fmy_id_spi_mps.dtc "" CURVE 0xffe4294c _REC_CUR_20_u2_u2 65535. _CNV_A_R_LINEAR_____0_CM 0. 65535. DISPLAY_IDENTIFIER ID_ERR_DTC_SPI_MPS FORMAT "%5.0"
 /begin AXIS_DESCR COM_AXIS online_dummy _CNV_A_R_LINEAR_____22_CM 6 0. 5. FORMAT "%2.0" AXIS_PTS_REF ldp_fmy_dtc /end AXIS_DESCR
/end CHARACTERISTIC
/begin CHARACTERISTIC fmy_id_spi_mps.c_err_clas "" VALUE 0xffe4295c _REC_VAL_20_u1 255. _CNV_A_R_LINEAR_____0_CM 0. 255. DISPLAY_IDENTIFIER C_ERR_CLAS_SPI_MPS FORMAT "%3.0" /end CHARACTERISTIC
/begin CHARACTERISTIC fmy_id_spi_knk.dtc "" CURVE 0xffe4295e _REC_CUR_20_u2_u2 65535. _CNV_A_R_LINEAR_____0_CM 0. 65535. DISPLAY_IDENTIFIER ID_ERR_DTC_SPI_KNK FORMAT "%5.0"
 /begin AXIS_DESCR COM_AXIS online_dummy _CNV_A_R_LINEAR_____22_CM 6 0. 5. FORMAT "%2.0" AXIS_PTS_REF ldp_fmy_dtc /end AXIS_DESCR
/end CHARACTERISTIC
/begin CHARACTERISTIC fmy_id_spi_knk.c_err_clas "" VALUE 0xffe4296e _REC_VAL_20_u1 255. _CNV_A_R_LINEAR_____0_CM 0. 255. DISPLAY_IDENTIFIER C_ERR_CLAS_SPI_KNK FORMAT "%3.0" /end CHARACTERISTIC
/begin CHARACTERISTIC fmy_id_bn_tq_dcc.dtc "" CURVE 0xffe42970 _REC_CUR_20_u2_u2 65535. _CNV_A_R_LINEAR_____0_CM 0. 65535. DISPLAY_IDENTIFIER ID_ERR_DTC_BN_TQ_DCC FORMAT "%5.0"
 /begin AXIS_DESCR COM_AXIS online_dummy _CNV_A_R_LINEAR_____22_CM 6 0. 5. FORMAT "%2.0" AXIS_PTS_REF ldp_fmy_dtc /end AXIS_DESCR
/end CHARACTERISTIC
/begin CHARACTERISTIC fmy_id_bn_tq_dcc.c_err_clas "" VALUE 0xffe42980 _REC_VAL_20_u1 255. _CNV_A_R_LINEAR_____0_CM 0. 255. DISPLAY_IDENTIFIER C_ERR_CLAS_BN_TQ_DCC FORMAT "%3.0" /end CHARACTERISTIC
/begin CHARACTERISTIC fmy_id_bn_tq_pste_2.dtc "" CURVE 0xffe42982 _REC_CUR_20_u2_u2 65535. _CNV_A_R_LINEAR_____0_CM 0. 65535. DISPLAY_IDENTIFIER ID_ERR_DTC_BN_TQ_PSTE_2 FORMAT "%5.0"
 /begin AXIS_DESCR COM_AXIS online_dummy _CNV_A_R_LINEAR_____22_CM 6 0. 5. FORMAT "%2.0" AXIS_PTS_REF ldp_fmy_dtc /end AXIS_DESCR
/end CHARACTERISTIC
/begin CHARACTERISTIC fmy_id_bn_tq_pste_2.c_err_clas "" VALUE 0xffe42992 _REC_VAL_20_u1 255. _CNV_A_R_LINEAR_____0_CM 0. 255. DISPLAY_IDENTIFIER C_ERR_CLAS_BN_TQ_PSTE_2 FORMAT "%3.0" /end CHARACTERISTIC
/begin CHARACTERISTIC fmy_id_bn_ars.dtc "" CURVE 0xffe42994 _REC_CUR_20_u2_u2 65535. _CNV_A_R_LINEAR_____0_CM 0. 65535. DISPLAY_IDENTIFIER ID_ERR_DTC_BN_ARS FORMAT "%5.0"
 /begin AXIS_DESCR COM_AXIS online_dummy _CNV_A_R_LINEAR_____22_CM 6 0. 5. FORMAT "%2.0" AXIS_PTS_REF ldp_fmy_dtc /end AXIS_DESCR
/end CHARACTERISTIC
/begin CHARACTERISTIC fmy_id_bn_ars.c_err_clas "" VALUE 0xffe429a4 _REC_VAL_20_u1 255. _CNV_A_R_LINEAR_____0_CM 0. 255. DISPLAY_IDENTIFIER C_ERR_CLAS_BN_ARS FORMAT "%3.0" /end CHARACTERISTIC
/begin CHARACTERISTIC fmy_id_bn_cas.dtc "" CURVE 0xffe429a6 _REC_CUR_20_u2_u2 65535. _CNV_A_R_LINEAR_____0_CM 0. 65535. DISPLAY_IDENTIFIER ID_ERR_DTC_BN_CAS FORMAT "%5.0"
 /begin AXIS_DESCR COM_AXIS online_dummy _CNV_A_R_LINEAR_____22_CM 6 0. 5. FORMAT "%2.0" AXIS_PTS_REF ldp_fmy_dtc /end AXIS_DESCR
/end CHARACTERISTIC
/begin CHARACTERISTIC fmy_id_bn_cas.c_err_clas "" VALUE 0xffe429b6 _REC_VAL_20_u1 255. _CNV_A_R_LINEAR_____0_CM 0. 255. DISPLAY_IDENTIFIER C_ERR_CLAS_BN_CAS FORMAT "%3.0" /end CHARACTERISTIC
/begin CHARACTERISTIC fmy_id_bn_tq_tcs.dtc "" CURVE 0xffe429b8 _REC_CUR_20_u2_u2 65535. _CNV_A_R_LINEAR_____0_CM 0. 65535. DISPLAY_IDENTIFIER ID_ERR_DTC_BN_TQ_TCS FORMAT "%5.0"
 /begin AXIS_DESCR COM_AXIS online_dummy _CNV_A_R_LINEAR_____22_CM 6 0. 5. FORMAT "%2.0" AXIS_PTS_REF ldp_fmy_dtc /end AXIS_DESCR
/end CHARACTERISTIC
/begin CHARACTERISTIC fmy_id_bn_tq_tcs.c_err_clas "" VALUE 0xffe429c8 _REC_VAL_20_u1 255. _CNV_A_R_LINEAR_____0_CM 0. 255. DISPLAY_IDENTIFIER C_ERR_CLAS_BN_TQ_TCS FORMAT "%3.0" /end CHARACTERISTIC
/begin CHARACTERISTIC fmy_id_bn_vs_tcs.dtc "" CURVE 0xffe429ca _REC_CUR_20_u2_u2 65535. _CNV_A_R_LINEAR_____0_CM 0. 65535. DISPLAY_IDENTIFIER ID_ERR_DTC_BN_VS_TCS FORMAT "%5.0"
 /begin AXIS_DESCR COM_AXIS online_dummy _CNV_A_R_LINEAR_____22_CM 6 0. 5. FORMAT "%2.0" AXIS_PTS_REF ldp_fmy_dtc /end AXIS_DESCR
/end CHARACTERISTIC
/begin CHARACTERISTIC fmy_id_bn_vs_tcs.c_err_clas "" VALUE 0xffe429da _REC_VAL_20_u1 255. _CNV_A_R_LINEAR_____0_CM 0. 255. DISPLAY_IDENTIFIER C_ERR_CLAS_BN_VS_TCS FORMAT "%3.0" /end CHARACTERISTIC
/begin CHARACTERISTIC fmy_id_bn_tcs.dtc "" CURVE 0xffe429dc _REC_CUR_20_u2_u2 65535. _CNV_A_R_LINEAR_____0_CM 0. 65535. DISPLAY_IDENTIFIER ID_ERR_DTC_BN_TCS FORMAT "%5.0"
 /begin AXIS_DESCR COM_AXIS online_dummy _CNV_A_R_LINEAR_____22_CM 6 0. 5. FORMAT "%2.0" AXIS_PTS_REF ldp_fmy_dtc /end AXIS_DESCR
/end CHARACTERISTIC
/begin CHARACTERISTIC fmy_id_bn_tcs.c_err_clas "" VALUE 0xffe429ec _REC_VAL_20_u1 255. _CNV_A_R_LINEAR_____0_CM 0. 255. DISPLAY_IDENTIFIER C_ERR_CLAS_BN_TCS FORMAT "%3.0" /end CHARACTERISTIC
/begin CHARACTERISTIC fmy_id_bn_tq_etcu.dtc "" CURVE 0xffe429ee _REC_CUR_20_u2_u2 65535. _CNV_A_R_LINEAR_____0_CM 0. 65535. DISPLAY_IDENTIFIER ID_ERR_DTC_BN_TQ_ETCU FORMAT "%5.0"
 /begin AXIS_DESCR COM_AXIS online_dummy _CNV_A_R_LINEAR_____22_CM 6 0. 5. FORMAT "%2.0" AXIS_PTS_REF ldp_fmy_dtc /end AXIS_DESCR
/end CHARACTERISTIC
/begin CHARACTERISTIC fmy_id_bn_tq_etcu.c_err_clas "" VALUE 0xffe429fe _REC_VAL_20_u1 255. _CNV_A_R_LINEAR_____0_CM 0. 255. DISPLAY_IDENTIFIER C_ERR_CLAS_BN_TQ_ETCU FORMAT "%3.0" /end CHARACTERISTIC
/begin CHARACTERISTIC fmy_id_bn_etcu.dtc "" CURVE 0xffe42a00 _REC_CUR_20_u2_u2 65535. _CNV_A_R_LINEAR_____0_CM 0. 65535. DISPLAY_IDENTIFIER ID_ERR_DTC_BN_ETCU FORMAT "%5.0"
 /begin AXIS_DESCR COM_AXIS online_dummy _CNV_A_R_LINEAR_____22_CM 6 0. 5. FORMAT "%2.0" AXIS_PTS_REF ldp_fmy_dtc /end AXIS_DESCR
/end CHARACTERISTIC
/begin CHARACTERISTIC fmy_id_bn_etcu.c_err_clas "" VALUE 0xffe42a10 _REC_VAL_20_u1 255. _CNV_A_R_LINEAR_____0_CM 0. 255. DISPLAY_IDENTIFIER C_ERR_CLAS_BN_ETCU FORMAT "%3.0" /end CHARACTERISTIC
/begin CHARACTERISTIC fmy_id_bn_tq_amt.dtc "" CURVE 0xffe42a12 _REC_CUR_20_u2_u2 65535. _CNV_A_R_LINEAR_____0_CM 0. 65535. DISPLAY_IDENTIFIER ID_ERR_DTC_BN_TQ_AMT FORMAT "%5.0"
 /begin AXIS_DESCR COM_AXIS online_dummy _CNV_A_R_LINEAR_____22_CM 6 0. 5. FORMAT "%2.0" AXIS_PTS_REF ldp_fmy_dtc /end AXIS_DESCR
/end CHARACTERISTIC
/begin CHARACTERISTIC fmy_id_bn_tq_amt.c_err_clas "" VALUE 0xffe42a22 _REC_VAL_20_u1 255. _CNV_A_R_LINEAR_____0_CM 0. 255. DISPLAY_IDENTIFIER C_ERR_CLAS_BN_TQ_AMT FORMAT "%3.0" /end CHARACTERISTIC
/begin CHARACTERISTIC fmy_id_bn_acc.dtc "" CURVE 0xffe42a24 _REC_CUR_20_u2_u2 65535. _CNV_A_R_LINEAR_____0_CM 0. 65535. DISPLAY_IDENTIFIER ID_ERR_DTC_BN_ACC FORMAT "%5.0"
 /begin AXIS_DESCR COM_AXIS online_dummy _CNV_A_R_LINEAR_____22_CM 6 0. 5. FORMAT "%2.0" AXIS_PTS_REF ldp_fmy_dtc /end AXIS_DESCR
/end CHARACTERISTIC
/begin CHARACTERISTIC fmy_id_bn_acc.c_err_clas "" VALUE 0xffe42a34 _REC_VAL_20_u1 255. _CNV_A_R_LINEAR_____0_CM 0. 255. DISPLAY_IDENTIFIER C_ERR_CLAS_BN_ACC FORMAT "%3.0" /end CHARACTERISTIC
/begin CHARACTERISTIC fmy_id_bn_t_icl.dtc "" CURVE 0xffe42a36 _REC_CUR_20_u2_u2 65535. _CNV_A_R_LINEAR_____0_CM 0. 65535. DISPLAY_IDENTIFIER ID_ERR_DTC_BN_T_ICL FORMAT "%5.0"
 /begin AXIS_DESCR COM_AXIS online_dummy _CNV_A_R_LINEAR_____22_CM 6 0. 5. FORMAT "%2.0" AXIS_PTS_REF ldp_fmy_dtc /end AXIS_DESCR
/end CHARACTERISTIC
/begin CHARACTERISTIC fmy_id_bn_t_icl.c_err_clas "" VALUE 0xffe42a46 _REC_VAL_20_u1 255. _CNV_A_R_LINEAR_____0_CM 0. 255. DISPLAY_IDENTIFIER C_ERR_CLAS_BN_T_ICL FORMAT "%3.0" /end CHARACTERISTIC
/begin CHARACTERISTIC fmy_id_bn_veh_mod.dtc "" CURVE 0xffe42a48 _REC_CUR_20_u2_u2 65535. _CNV_A_R_LINEAR_____0_CM 0. 65535. DISPLAY_IDENTIFIER ID_ERR_DTC_BN_VEH_MOD FORMAT "%5.0"
 /begin AXIS_DESCR COM_AXIS online_dummy _CNV_A_R_LINEAR_____22_CM 6 0. 5. FORMAT "%2.0" AXIS_PTS_REF ldp_fmy_dtc /end AXIS_DESCR
/end CHARACTERISTIC
/begin CHARACTERISTIC fmy_id_bn_veh_mod.c_err_clas "" VALUE 0xffe42a58 _REC_VAL_20_u1 255. _CNV_A_R_LINEAR_____0_CM 0. 255. DISPLAY_IDENTIFIER C_ERR_CLAS_BN_VEH_MOD FORMAT "%3.0" /end CHARACTERISTIC
/begin CHARACTERISTIC fmy_id_bn_km_icl.dtc "" CURVE 0xffe42a5a _REC_CUR_20_u2_u2 65535. _CNV_A_R_LINEAR_____0_CM 0. 65535. DISPLAY_IDENTIFIER ID_ERR_DTC_BN_KM_ICL FORMAT "%5.0"
 /begin AXIS_DESCR COM_AXIS online_dummy _CNV_A_R_LINEAR_____22_CM 6 0. 5. FORMAT "%2.0" AXIS_PTS_REF ldp_fmy_dtc /end AXIS_DESCR
/end CHARACTERISTIC
/begin CHARACTERISTIC fmy_id_bn_km_icl.c_err_clas "" VALUE 0xffe42a6a _REC_VAL_20_u1 255. _CNV_A_R_LINEAR_____0_CM 0. 255. DISPLAY_IDENTIFIER C_ERR_CLAS_BN_KM_ICL FORMAT "%3.0" /end CHARACTERISTIC
/begin CHARACTERISTIC fmy_id_bn_icl.dtc "" CURVE 0xffe42a6c _REC_CUR_20_u2_u2 65535. _CNV_A_R_LINEAR_____0_CM 0. 65535. DISPLAY_IDENTIFIER ID_ERR_DTC_BN_ICL FORMAT "%5.0"
 /begin AXIS_DESCR COM_AXIS online_dummy _CNV_A_R_LINEAR_____22_CM 6 0. 5. FORMAT "%2.0" AXIS_PTS_REF ldp_fmy_dtc /end AXIS_DESCR
/end CHARACTERISTIC
/begin CHARACTERISTIC fmy_id_bn_icl.c_err_clas "" VALUE 0xffe42a7c _REC_VAL_20_u1 255. _CNV_A_R_LINEAR_____0_CM 0. 255. DISPLAY_IDENTIFIER C_ERR_CLAS_BN_ICL FORMAT "%3.0" /end CHARACTERISTIC
/begin CHARACTERISTIC fmy_id_bn_pow_vb.dtc "" CURVE 0xffe42a7e _REC_CUR_20_u2_u2 65535. _CNV_A_R_LINEAR_____0_CM 0. 65535. DISPLAY_IDENTIFIER ID_ERR_DTC_BN_POW_VB FORMAT "%5.0"
 /begin AXIS_DESCR COM_AXIS online_dummy _CNV_A_R_LINEAR_____22_CM 6 0. 5. FORMAT "%2.0" AXIS_PTS_REF ldp_fmy_dtc /end AXIS_DESCR
/end CHARACTERISTIC
/begin CHARACTERISTIC fmy_id_bn_pow_vb.c_err_clas "" VALUE 0xffe42a8e _REC_VAL_20_u1 255. _CNV_A_R_LINEAR_____0_CM 0. 255. DISPLAY_IDENTIFIER C_ERR_CLAS_BN_POW_VB FORMAT "%3.0" /end CHARACTERISTIC
/begin CHARACTERISTIC fmy_id_bn_pow_gen.dtc "" CURVE 0xffe42a90 _REC_CUR_20_u2_u2 65535. _CNV_A_R_LINEAR_____0_CM 0. 65535. DISPLAY_IDENTIFIER ID_ERR_DTC_BN_POW_GEN FORMAT "%5.0"
 /begin AXIS_DESCR COM_AXIS online_dummy _CNV_A_R_LINEAR_____22_CM 6 0. 5. FORMAT "%2.0" AXIS_PTS_REF ldp_fmy_dtc /end AXIS_DESCR
/end CHARACTERISTIC
/begin CHARACTERISTIC fmy_id_bn_pow_gen.c_err_clas "" VALUE 0xffe42aa0 _REC_VAL_20_u1 255. _CNV_A_R_LINEAR_____0_CM 0. 255. DISPLAY_IDENTIFIER C_ERR_CLAS_BN_POW_GEN FORMAT "%3.0" /end CHARACTERISTIC
/begin CHARACTERISTIC fmy_id_bn_msw.dtc "" CURVE 0xffe42aa2 _REC_CUR_20_u2_u2 65535. _CNV_A_R_LINEAR_____0_CM 0. 65535. DISPLAY_IDENTIFIER ID_ERR_DTC_BN_MSW FORMAT "%5.0"
 /begin AXIS_DESCR COM_AXIS online_dummy _CNV_A_R_LINEAR_____22_CM 6 0. 5. FORMAT "%2.0" AXIS_PTS_REF ldp_fmy_dtc /end AXIS_DESCR
/end CHARACTERISTIC
/begin CHARACTERISTIC fmy_id_bn_msw.c_err_clas "" VALUE 0xffe42ab2 _REC_VAL_20_u1 255. _CNV_A_R_LINEAR_____0_CM 0. 255. DISPLAY_IDENTIFIER C_ERR_CLAS_BN_MSW FORMAT "%3.0" /end CHARACTERISTIC
/begin CHARACTERISTIC fmy_id_bn_ang_pste.dtc "" CURVE 0xffe42ab4 _REC_CUR_20_u2_u2 65535. _CNV_A_R_LINEAR_____0_CM 0. 65535. DISPLAY_IDENTIFIER ID_ERR_DTC_BN_ANG_PSTE FORMAT "%5.0"
 /begin AXIS_DESCR COM_AXIS online_dummy _CNV_A_R_LINEAR_____22_CM 6 0. 5. FORMAT "%2.0" AXIS_PTS_REF ldp_fmy_dtc /end AXIS_DESCR
/end CHARACTERISTIC
/begin CHARACTERISTIC fmy_id_bn_ang_pste.c_err_clas "" VALUE 0xffe42ac4 _REC_VAL_20_u1 255. _CNV_A_R_LINEAR_____0_CM 0. 255. DISPLAY_IDENTIFIER C_ERR_CLAS_BN_ANG_PSTE FORMAT "%3.0" /end CHARACTERISTIC
/begin CHARACTERISTIC fmy_id_bn_efp.dtc "" CURVE 0xffe42ac6 _REC_CUR_20_u2_u2 65535. _CNV_A_R_LINEAR_____0_CM 0. 65535. DISPLAY_IDENTIFIER ID_ERR_DTC_BN_EFP FORMAT "%5.0"
 /begin AXIS_DESCR COM_AXIS online_dummy _CNV_A_R_LINEAR_____22_CM 6 0. 5. FORMAT "%2.0" AXIS_PTS_REF ldp_fmy_dtc /end AXIS_DESCR
/end CHARACTERISTIC
/begin CHARACTERISTIC fmy_id_bn_efp.c_err_clas "" VALUE 0xffe42ad6 _REC_VAL_20_u1 255. _CNV_A_R_LINEAR_____0_CM 0. 255. DISPLAY_IDENTIFIER C_ERR_CLAS_BN_EFP FORMAT "%3.0" /end CHARACTERISTIC
/begin CHARACTERISTIC fmy_id_load_tps_plaus.dtc "" CURVE 0xffe42ad8 _REC_CUR_20_u2_u2 65535. _CNV_A_R_LINEAR_____0_CM 0. 65535. DISPLAY_IDENTIFIER ID_ERR_DTC_LOAD_TPS_PLAUS FORMAT "%5.0"
 /begin AXIS_DESCR COM_AXIS online_dummy _CNV_A_R_LINEAR_____22_CM 6 0. 5. FORMAT "%2.0" AXIS_PTS_REF ldp_fmy_dtc /end AXIS_DESCR
/end CHARACTERISTIC
/begin CHARACTERISTIC fmy_id_load_tps_plaus.c_err_clas "" VALUE 0xffe42ae8 _REC_VAL_20_u1 255. _CNV_A_R_LINEAR_____0_CM 0. 255. DISPLAY_IDENTIFIER C_ERR_CLAS_LOAD_TPS_PLAUS FORMAT "%3.0" /end CHARACTERISTIC
/begin CHARACTERISTIC fmy_id_efp_crash.dtc "" CURVE 0xffe42aea _REC_CUR_20_u2_u2 65535. _CNV_A_R_LINEAR_____0_CM 0. 65535. DISPLAY_IDENTIFIER ID_ERR_DTC_EFP_CRASH FORMAT "%5.0"
 /begin AXIS_DESCR COM_AXIS online_dummy _CNV_A_R_LINEAR_____22_CM 6 0. 5. FORMAT "%2.0" AXIS_PTS_REF ldp_fmy_dtc /end AXIS_DESCR
/end CHARACTERISTIC
/begin CHARACTERISTIC fmy_id_efp_crash.c_err_clas "" VALUE 0xffe42afa _REC_VAL_20_u1 255. _CNV_A_R_LINEAR_____0_CM 0. 255. DISPLAY_IDENTIFIER C_ERR_CLAS_EFP_CRASH FORMAT "%3.0" /end CHARACTERISTIC
/begin CHARACTERISTIC fmy_id_efp.dtc "" CURVE 0xffe42afc _REC_CUR_20_u2_u2 65535. _CNV_A_R_LINEAR_____0_CM 0. 65535. DISPLAY_IDENTIFIER ID_ERR_DTC_EFP FORMAT "%5.0"
 /begin AXIS_DESCR COM_AXIS online_dummy _CNV_A_R_LINEAR_____22_CM 6 0. 5. FORMAT "%2.0" AXIS_PTS_REF ldp_fmy_dtc /end AXIS_DESCR
/end CHARACTERISTIC
/begin CHARACTERISTIC fmy_id_efp.c_err_clas "" VALUE 0xffe42b0c _REC_VAL_20_u1 255. _CNV_A_R_LINEAR_____0_CM 0. 255. DISPLAY_IDENTIFIER C_ERR_CLAS_EFP FORMAT "%3.0" /end CHARACTERISTIC
/begin CHARACTERISTIC fmy_id_locan_boff.dtc "" CURVE 0xffe42b0e _REC_CUR_20_u2_u2 65535. _CNV_A_R_LINEAR_____0_CM 0. 65535. DISPLAY_IDENTIFIER ID_ERR_DTC_LOCAN_BOFF FORMAT "%5.0"
 /begin AXIS_DESCR COM_AXIS online_dummy _CNV_A_R_LINEAR_____22_CM 6 0. 5. FORMAT "%2.0" AXIS_PTS_REF ldp_fmy_dtc /end AXIS_DESCR
/end CHARACTERISTIC
/begin CHARACTERISTIC fmy_id_locan_boff.c_err_clas "" VALUE 0xffe42b1e _REC_VAL_20_u1 255. _CNV_A_R_LINEAR_____0_CM 0. 255. DISPLAY_IDENTIFIER C_ERR_CLAS_LOCAN_BOFF FORMAT "%3.0" /end CHARACTERISTIC
/begin CHARACTERISTIC fmy_id_chg_ls_up.dtc "" CURVE 0xffe42b20 _REC_CUR_20_u2_u2 65535. _CNV_A_R_LINEAR_____0_CM 0. 65535. DISPLAY_IDENTIFIER ID_ERR_DTC_CHG_LS_UP FORMAT "%5.0"
 /begin AXIS_DESCR COM_AXIS online_dummy _CNV_A_R_LINEAR_____22_CM 6 0. 5. FORMAT "%2.0" AXIS_PTS_REF ldp_fmy_dtc /end AXIS_DESCR
/end CHARACTERISTIC
/begin CHARACTERISTIC fmy_id_chg_ls_up.c_err_clas "" VALUE 0xffe42b30 _REC_VAL_20_u1 255. _CNV_A_R_LINEAR_____0_CM 0. 255. DISPLAY_IDENTIFIER C_ERR_CLAS_CHG_LS_UP FORMAT "%3.0" /end CHARACTERISTIC
/begin CHARACTERISTIC fmy_id_chg_ls_down.dtc "" CURVE 0xffe42b32 _REC_CUR_20_u2_u2 65535. _CNV_A_R_LINEAR_____0_CM 0. 65535. DISPLAY_IDENTIFIER ID_ERR_DTC_CHG_LS_DOWN FORMAT "%5.0"
 /begin AXIS_DESCR COM_AXIS online_dummy _CNV_A_R_LINEAR_____22_CM 6 0. 5. FORMAT "%2.0" AXIS_PTS_REF ldp_fmy_dtc /end AXIS_DESCR
/end CHARACTERISTIC
/begin CHARACTERISTIC fmy_id_chg_ls_down.c_err_clas "" VALUE 0xffe42b42 _REC_VAL_20_u1 255. _CNV_A_R_LINEAR_____0_CM 0. 255. DISPLAY_IDENTIFIER C_ERR_CLAS_CHG_LS_DOWN FORMAT "%3.0" /end CHARACTERISTIC
/begin CHARACTERISTIC fmy_id_qoil_sens.dtc "" CURVE 0xffe42b44 _REC_CUR_20_u2_u2 65535. _CNV_A_R_LINEAR_____0_CM 0. 65535. DISPLAY_IDENTIFIER ID_ERR_DTC_QOIL_SENS FORMAT "%5.0"
 /begin AXIS_DESCR COM_AXIS online_dummy _CNV_A_R_LINEAR_____22_CM 6 0. 5. FORMAT "%2.0" AXIS_PTS_REF ldp_fmy_dtc /end AXIS_DESCR
/end CHARACTERISTIC
/begin CHARACTERISTIC fmy_id_qoil_sens.c_err_clas "" VALUE 0xffe42b54 _REC_VAL_20_u1 255. _CNV_A_R_LINEAR_____0_CM 0. 255. DISPLAY_IDENTIFIER C_ERR_CLAS_QOIL_SENS FORMAT "%3.0" /end CHARACTERISTIC
/begin CHARACTERISTIC fmy_id_bat_sens.dtc "" CURVE 0xffe42b56 _REC_CUR_20_u2_u2 65535. _CNV_A_R_LINEAR_____0_CM 0. 65535. DISPLAY_IDENTIFIER ID_ERR_DTC_BAT_SENS FORMAT "%5.0"
 /begin AXIS_DESCR COM_AXIS online_dummy _CNV_A_R_LINEAR_____22_CM 6 0. 5. FORMAT "%2.0" AXIS_PTS_REF ldp_fmy_dtc /end AXIS_DESCR
/end CHARACTERISTIC
/begin CHARACTERISTIC fmy_id_bat_sens.c_err_clas "" VALUE 0xffe42b66 _REC_VAL_20_u1 255. _CNV_A_R_LINEAR_____0_CM 0. 255. DISPLAY_IDENTIFIER C_ERR_CLAS_BAT_SENS FORMAT "%3.0" /end CHARACTERISTIC
/begin CHARACTERISTIC fmy_id_bat_sens_it.dtc "" CURVE 0xffe42b68 _REC_CUR_20_u2_u2 65535. _CNV_A_R_LINEAR_____0_CM 0. 65535. DISPLAY_IDENTIFIER ID_ERR_DTC_BAT_SENS_IT FORMAT "%5.0"
 /begin AXIS_DESCR COM_AXIS online_dummy _CNV_A_R_LINEAR_____22_CM 6 0. 5. FORMAT "%2.0" AXIS_PTS_REF ldp_fmy_dtc /end AXIS_DESCR
/end CHARACTERISTIC
/begin CHARACTERISTIC fmy_id_bat_sens_it.c_err_clas "" VALUE 0xffe42b78 _REC_VAL_20_u1 255. _CNV_A_R_LINEAR_____0_CM 0. 255. DISPLAY_IDENTIFIER C_ERR_CLAS_BAT_SENS_IT FORMAT "%3.0" /end CHARACTERISTIC
/begin CHARACTERISTIC fmy_id_bat_sens_it_el.dtc "" CURVE 0xffe42b7a _REC_CUR_20_u2_u2 65535. _CNV_A_R_LINEAR_____0_CM 0. 65535. DISPLAY_IDENTIFIER ID_ERR_DTC_BAT_SENS_IT_EL FORMAT "%5.0"
 /begin AXIS_DESCR COM_AXIS online_dummy _CNV_A_R_LINEAR_____22_CM 6 0. 5. FORMAT "%2.0" AXIS_PTS_REF ldp_fmy_dtc /end AXIS_DESCR
/end CHARACTERISTIC
/begin CHARACTERISTIC fmy_id_bat_sens_it_el.c_err_clas "" VALUE 0xffe42b8a _REC_VAL_20_u1 255. _CNV_A_R_LINEAR_____0_CM 0. 255. DISPLAY_IDENTIFIER C_ERR_CLAS_BAT_SENS_IT_EL FORMAT "%3.0" /end CHARACTERISTIC
/begin CHARACTERISTIC fmy_id_ecu_nvmy.dtc "" CURVE 0xffe42b8c _REC_CUR_20_u2_u2 65535. _CNV_A_R_LINEAR_____0_CM 0. 65535. DISPLAY_IDENTIFIER ID_ERR_DTC_ECU_NVMY FORMAT "%5.0"
 /begin AXIS_DESCR COM_AXIS online_dummy _CNV_A_R_LINEAR_____22_CM 6 0. 5. FORMAT "%2.0" AXIS_PTS_REF ldp_fmy_dtc /end AXIS_DESCR
/end CHARACTERISTIC
/begin CHARACTERISTIC fmy_id_ecu_nvmy.c_err_clas "" VALUE 0xffe42b9c _REC_VAL_20_u1 255. _CNV_A_R_LINEAR_____0_CM 0. 255. DISPLAY_IDENTIFIER C_ERR_CLAS_ECU_NVMY FORMAT "%3.0" /end CHARACTERISTIC
/begin CHARACTERISTIC fmy_id_gs.dtc "" CURVE 0xffe42b9e _REC_CUR_20_u2_u2 65535. _CNV_A_R_LINEAR_____0_CM 0. 65535. DISPLAY_IDENTIFIER ID_ERR_DTC_GS FORMAT "%5.0"
 /begin AXIS_DESCR COM_AXIS online_dummy _CNV_A_R_LINEAR_____22_CM 6 0. 5. FORMAT "%2.0" AXIS_PTS_REF ldp_fmy_dtc /end AXIS_DESCR
/end CHARACTERISTIC
/begin CHARACTERISTIC fmy_id_gs.c_err_clas "" VALUE 0xffe42bae _REC_VAL_20_u1 255. _CNV_A_R_LINEAR_____0_CM 0. 255. DISPLAY_IDENTIFIER C_ERR_CLAS_GS FORMAT "%3.0" /end CHARACTERISTIC
/begin CHARACTERISTIC fmy_id_o3_conc.dtc "" CURVE 0xffe42bb0 _REC_CUR_20_u2_u2 65535. _CNV_A_R_LINEAR_____0_CM 0. 65535. DISPLAY_IDENTIFIER ID_ERR_DTC_O3_CONC FORMAT "%5.0"
 /begin AXIS_DESCR COM_AXIS online_dummy _CNV_A_R_LINEAR_____22_CM 6 0. 5. FORMAT "%2.0" AXIS_PTS_REF ldp_fmy_dtc /end AXIS_DESCR
/end CHARACTERISTIC
/begin CHARACTERISTIC fmy_id_o3_conc.c_err_clas "" VALUE 0xffe42bc0 _REC_VAL_20_u1 255. _CNV_A_R_LINEAR_____0_CM 0. 255. DISPLAY_IDENTIFIER C_ERR_CLAS_O3_CONC FORMAT "%3.0" /end CHARACTERISTIC
/begin CHARACTERISTIC fmy_id_ls_up_shift_afl_1.dtc "" CURVE 0xffe42bc2 _REC_CUR_20_u2_u2 65535. _CNV_A_R_LINEAR_____0_CM 0. 65535. DISPLAY_IDENTIFIER ID_ERR_DTC_LS_UP_SHIFT_AFL_1 FORMAT "%5.0"
 /begin AXIS_DESCR COM_AXIS online_dummy _CNV_A_R_LINEAR_____22_CM 6 0. 5. FORMAT "%2.0" AXIS_PTS_REF ldp_fmy_dtc /end AXIS_DESCR
/end CHARACTERISTIC
/begin CHARACTERISTIC fmy_id_ls_up_shift_afl_1.c_err_clas "" VALUE 0xffe42bd2 _REC_VAL_20_u1 255. _CNV_A_R_LINEAR_____0_CM 0. 255. DISPLAY_IDENTIFIER C_ERR_CLAS_LS_UP_SHIFT_AFL_1 FORMAT "%3.0" /end CHARACTERISTIC
/begin CHARACTERISTIC fmy_id_ls_up_shift_afl_2.dtc "" CURVE 0xffe42bd4 _REC_CUR_20_u2_u2 65535. _CNV_A_R_LINEAR_____0_CM 0. 65535. DISPLAY_IDENTIFIER ID_ERR_DTC_LS_UP_SHIFT_AFL_2 FORMAT "%5.0"
 /begin AXIS_DESCR COM_AXIS online_dummy _CNV_A_R_LINEAR_____22_CM 6 0. 5. FORMAT "%2.0" AXIS_PTS_REF ldp_fmy_dtc /end AXIS_DESCR
/end CHARACTERISTIC
/begin CHARACTERISTIC fmy_id_ls_up_shift_afl_2.c_err_clas "" VALUE 0xffe42be4 _REC_VAL_20_u1 255. _CNV_A_R_LINEAR_____0_CM 0. 255. DISPLAY_IDENTIFIER C_ERR_CLAS_LS_UP_SHIFT_AFL_2 FORMAT "%3.0" /end CHARACTERISTIC
/begin CHARACTERISTIC fmy_id_ls_up_shift_afr_1.dtc "" CURVE 0xffe42be6 _REC_CUR_20_u2_u2 65535. _CNV_A_R_LINEAR_____0_CM 0. 65535. DISPLAY_IDENTIFIER ID_ERR_DTC_LS_UP_SHIFT_AFR_1 FORMAT "%5.0"
 /begin AXIS_DESCR COM_AXIS online_dummy _CNV_A_R_LINEAR_____22_CM 6 0. 5. FORMAT "%2.0" AXIS_PTS_REF ldp_fmy_dtc /end AXIS_DESCR
/end CHARACTERISTIC
/begin CHARACTERISTIC fmy_id_ls_up_shift_afr_1.c_err_clas "" VALUE 0xffe42bf6 _REC_VAL_20_u1 255. _CNV_A_R_LINEAR_____0_CM 0. 255. DISPLAY_IDENTIFIER C_ERR_CLAS_LS_UP_SHIFT_AFR_1 FORMAT "%3.0" /end CHARACTERISTIC
/begin CHARACTERISTIC fmy_id_ls_up_shift_afr_2.dtc "" CURVE 0xffe42bf8 _REC_CUR_20_u2_u2 65535. _CNV_A_R_LINEAR_____0_CM 0. 65535. DISPLAY_IDENTIFIER ID_ERR_DTC_LS_UP_SHIFT_AFR_2 FORMAT "%5.0"
 /begin AXIS_DESCR COM_AXIS online_dummy _CNV_A_R_LINEAR_____22_CM 6 0. 5. FORMAT "%2.0" AXIS_PTS_REF ldp_fmy_dtc /end AXIS_DESCR
/end CHARACTERISTIC
/begin CHARACTERISTIC fmy_id_ls_up_shift_afr_2.c_err_clas "" VALUE 0xffe42c08 _REC_VAL_20_u1 255. _CNV_A_R_LINEAR_____0_CM 0. 255. DISPLAY_IDENTIFIER C_ERR_CLAS_LS_UP_SHIFT_AFR_2 FORMAT "%3.0" /end CHARACTERISTIC
/begin CHARACTERISTIC fmy_id_oc_lsl_1.dtc "" CURVE 0xffe42c0a _REC_CUR_20_u2_u2 65535. _CNV_A_R_LINEAR_____0_CM 0. 65535. DISPLAY_IDENTIFIER ID_ERR_DTC_OC_LSL_1 FORMAT "%5.0"
 /begin AXIS_DESCR COM_AXIS online_dummy _CNV_A_R_LINEAR_____22_CM 6 0. 5. FORMAT "%2.0" AXIS_PTS_REF ldp_fmy_dtc /end AXIS_DESCR
/end CHARACTERISTIC
/begin CHARACTERISTIC fmy_id_oc_lsl_1.c_err_clas "" VALUE 0xffe42c1a _REC_VAL_20_u1 255. _CNV_A_R_LINEAR_____0_CM 0. 255. DISPLAY_IDENTIFIER C_ERR_CLAS_OC_LSL_1 FORMAT "%3.0" /end CHARACTERISTIC
/begin CHARACTERISTIC fmy_id_oc_lsl_2.dtc "" CURVE 0xffe42c1c _REC_CUR_20_u2_u2 65535. _CNV_A_R_LINEAR_____0_CM 0. 65535. DISPLAY_IDENTIFIER ID_ERR_DTC_OC_LSL_2 FORMAT "%5.0"
 /begin AXIS_DESCR COM_AXIS online_dummy _CNV_A_R_LINEAR_____22_CM 6 0. 5. FORMAT "%2.0" AXIS_PTS_REF ldp_fmy_dtc /end AXIS_DESCR
/end CHARACTERISTIC
/begin CHARACTERISTIC fmy_id_oc_lsl_2.c_err_clas "" VALUE 0xffe42c2c _REC_VAL_20_u1 255. _CNV_A_R_LINEAR_____0_CM 0. 255. DISPLAY_IDENTIFIER C_ERR_CLAS_OC_LSL_2 FORMAT "%3.0" /end CHARACTERISTIC
/begin CHARACTERISTIC fmy_id_cat_diag_1.dtc "" CURVE 0xffe42c2e _REC_CUR_20_u2_u2 65535. _CNV_A_R_LINEAR_____0_CM 0. 65535. DISPLAY_IDENTIFIER ID_ERR_DTC_CAT_DIAG_1 FORMAT "%5.0"
 /begin AXIS_DESCR COM_AXIS online_dummy _CNV_A_R_LINEAR_____22_CM 6 0. 5. FORMAT "%2.0" AXIS_PTS_REF ldp_fmy_dtc /end AXIS_DESCR
/end CHARACTERISTIC
/begin CHARACTERISTIC fmy_id_cat_diag_1.c_err_clas "" VALUE 0xffe42c3e _REC_VAL_20_u1 255. _CNV_A_R_LINEAR_____0_CM 0. 255. DISPLAY_IDENTIFIER C_ERR_CLAS_CAT_DIAG_1 FORMAT "%3.0" /end CHARACTERISTIC
/begin CHARACTERISTIC fmy_id_cat_diag_2.dtc "" CURVE 0xffe42c40 _REC_CUR_20_u2_u2 65535. _CNV_A_R_LINEAR_____0_CM 0. 65535. DISPLAY_IDENTIFIER ID_ERR_DTC_CAT_DIAG_2 FORMAT "%5.0"
 /begin AXIS_DESCR COM_AXIS online_dummy _CNV_A_R_LINEAR_____22_CM 6 0. 5. FORMAT "%2.0" AXIS_PTS_REF ldp_fmy_dtc /end AXIS_DESCR
/end CHARACTERISTIC
/begin CHARACTERISTIC fmy_id_cat_diag_2.c_err_clas "" VALUE 0xffe42c50 _REC_VAL_20_u1 255. _CNV_A_R_LINEAR_____0_CM 0. 255. DISPLAY_IDENTIFIER C_ERR_CLAS_CAT_DIAG_2 FORMAT "%3.0" /end CHARACTERISTIC
/begin CHARACTERISTIC fmy_id_el_lsl_1.dtc "" CURVE 0xffe42c52 _REC_CUR_20_u2_u2 65535. _CNV_A_R_LINEAR_____0_CM 0. 65535. DISPLAY_IDENTIFIER ID_ERR_DTC_EL_LSL_1 FORMAT "%5.0"
 /begin AXIS_DESCR COM_AXIS online_dummy _CNV_A_R_LINEAR_____22_CM 6 0. 5. FORMAT "%2.0" AXIS_PTS_REF ldp_fmy_dtc /end AXIS_DESCR
/end CHARACTERISTIC
/begin CHARACTERISTIC fmy_id_el_lsl_1.c_err_clas "" VALUE 0xffe42c62 _REC_VAL_20_u1 255. _CNV_A_R_LINEAR_____0_CM 0. 255. DISPLAY_IDENTIFIER C_ERR_CLAS_EL_LSL_1 FORMAT "%3.0" /end CHARACTERISTIC
/begin CHARACTERISTIC fmy_id_el_lsl_2.dtc "" CURVE 0xffe42c64 _REC_CUR_20_u2_u2 65535. _CNV_A_R_LINEAR_____0_CM 0. 65535. DISPLAY_IDENTIFIER ID_ERR_DTC_EL_LSL_2 FORMAT "%5.0"
 /begin AXIS_DESCR COM_AXIS online_dummy _CNV_A_R_LINEAR_____22_CM 6 0. 5. FORMAT "%2.0" AXIS_PTS_REF ldp_fmy_dtc /end AXIS_DESCR
/end CHARACTERISTIC
/begin CHARACTERISTIC fmy_id_el_lsl_2.c_err_clas "" VALUE 0xffe42c74 _REC_VAL_20_u1 255. _CNV_A_R_LINEAR_____0_CM 0. 255. DISPLAY_IDENTIFIER C_ERR_CLAS_EL_LSL_2 FORMAT "%3.0" /end CHARACTERISTIC
/begin CHARACTERISTIC fmy_id_cat_diag_nox_1.dtc "" CURVE 0xffe42c76 _REC_CUR_20_u2_u2 65535. _CNV_A_R_LINEAR_____0_CM 0. 65535. DISPLAY_IDENTIFIER ID_ERR_DTC_CAT_DIAG_NOX_1 FORMAT "%5.0"
 /begin AXIS_DESCR COM_AXIS online_dummy _CNV_A_R_LINEAR_____22_CM 6 0. 5. FORMAT "%2.0" AXIS_PTS_REF ldp_fmy_dtc /end AXIS_DESCR
/end CHARACTERISTIC
/begin CHARACTERISTIC fmy_id_cat_diag_nox_1.c_err_clas "" VALUE 0xffe42c86 _REC_VAL_20_u1 255. _CNV_A_R_LINEAR_____0_CM 0. 255. DISPLAY_IDENTIFIER C_ERR_CLAS_CAT_DIAG_NOX_1 FORMAT "%3.0" /end CHARACTERISTIC
/begin CHARACTERISTIC fmy_id_cat_diag_nox_2.dtc "" CURVE 0xffe42c88 _REC_CUR_20_u2_u2 65535. _CNV_A_R_LINEAR_____0_CM 0. 65535. DISPLAY_IDENTIFIER ID_ERR_DTC_CAT_DIAG_NOX_2 FORMAT "%5.0"
 /begin AXIS_DESCR COM_AXIS online_dummy _CNV_A_R_LINEAR_____22_CM 6 0. 5. FORMAT "%2.0" AXIS_PTS_REF ldp_fmy_dtc /end AXIS_DESCR
/end CHARACTERISTIC
/begin CHARACTERISTIC fmy_id_cat_diag_nox_2.c_err_clas "" VALUE 0xffe42c98 _REC_VAL_20_u1 255. _CNV_A_R_LINEAR_____0_CM 0. 255. DISPLAY_IDENTIFIER C_ERR_CLAS_CAT_DIAG_NOX_2 FORMAT "%3.0" /end CHARACTERISTIC
/begin CHARACTERISTIC fmy_id_vls_down_puc_1.dtc "" CURVE 0xffe42c9a _REC_CUR_20_u2_u2 65535. _CNV_A_R_LINEAR_____0_CM 0. 65535. DISPLAY_IDENTIFIER ID_ERR_DTC_VLS_DOWN_PUC_1 FORMAT "%5.0"
 /begin AXIS_DESCR COM_AXIS online_dummy _CNV_A_R_LINEAR_____22_CM 6 0. 5. FORMAT "%2.0" AXIS_PTS_REF ldp_fmy_dtc /end AXIS_DESCR
/end CHARACTERISTIC
/begin CHARACTERISTIC fmy_id_vls_down_puc_1.c_err_clas "" VALUE 0xffe42caa _REC_VAL_20_u1 255. _CNV_A_R_LINEAR_____0_CM 0. 255. DISPLAY_IDENTIFIER C_ERR_CLAS_VLS_DOWN_PUC_1 FORMAT "%3.0" /end CHARACTERISTIC
/begin CHARACTERISTIC fmy_id_vls_down_puc_2.dtc "" CURVE 0xffe42cac _REC_CUR_20_u2_u2 65535. _CNV_A_R_LINEAR_____0_CM 0. 65535. DISPLAY_IDENTIFIER ID_ERR_DTC_VLS_DOWN_PUC_2 FORMAT "%5.0"
 /begin AXIS_DESCR COM_AXIS online_dummy _CNV_A_R_LINEAR_____22_CM 6 0. 5. FORMAT "%2.0" AXIS_PTS_REF ldp_fmy_dtc /end AXIS_DESCR
/end CHARACTERISTIC
/begin CHARACTERISTIC fmy_id_vls_down_puc_2.c_err_clas "" VALUE 0xffe42cbc _REC_VAL_20_u1 255. _CNV_A_R_LINEAR_____0_CM 0. 255. DISPLAY_IDENTIFIER C_ERR_CLAS_VLS_DOWN_PUC_2 FORMAT "%3.0" /end CHARACTERISTIC
/begin CHARACTERISTIC fmy_id_vls_down_fl_1.dtc "" CURVE 0xffe42cbe _REC_CUR_20_u2_u2 65535. _CNV_A_R_LINEAR_____0_CM 0. 65535. DISPLAY_IDENTIFIER ID_ERR_DTC_VLS_DOWN_FL_1 FORMAT "%5.0"
 /begin AXIS_DESCR COM_AXIS online_dummy _CNV_A_R_LINEAR_____22_CM 6 0. 5. FORMAT "%2.0" AXIS_PTS_REF ldp_fmy_dtc /end AXIS_DESCR
/end CHARACTERISTIC
/begin CHARACTERISTIC fmy_id_vls_down_fl_1.c_err_clas "" VALUE 0xffe42cce _REC_VAL_20_u1 255. _CNV_A_R_LINEAR_____0_CM 0. 255. DISPLAY_IDENTIFIER C_ERR_CLAS_VLS_DOWN_FL_1 FORMAT "%3.0" /end CHARACTERISTIC
/begin CHARACTERISTIC fmy_id_vls_down_fl_2.dtc "" CURVE 0xffe42cd0 _REC_CUR_20_u2_u2 65535. _CNV_A_R_LINEAR_____0_CM 0. 65535. DISPLAY_IDENTIFIER ID_ERR_DTC_VLS_DOWN_FL_2 FORMAT "%5.0"
 /begin AXIS_DESCR COM_AXIS online_dummy _CNV_A_R_LINEAR_____22_CM 6 0. 5. FORMAT "%2.0" AXIS_PTS_REF ldp_fmy_dtc /end AXIS_DESCR
/end CHARACTERISTIC
/begin CHARACTERISTIC fmy_id_vls_down_fl_2.c_err_clas "" VALUE 0xffe42ce0 _REC_VAL_20_u1 255. _CNV_A_R_LINEAR_____0_CM 0. 255. DISPLAY_IDENTIFIER C_ERR_CLAS_VLS_DOWN_FL_2 FORMAT "%3.0" /end CHARACTERISTIC
/begin CHARACTERISTIC fmy_id_chk_ls_down_1.dtc "" CURVE 0xffe42ce2 _REC_CUR_20_u2_u2 65535. _CNV_A_R_LINEAR_____0_CM 0. 65535. DISPLAY_IDENTIFIER ID_ERR_DTC_CHK_LS_DOWN_1 FORMAT "%5.0"
 /begin AXIS_DESCR COM_AXIS online_dummy _CNV_A_R_LINEAR_____22_CM 6 0. 5. FORMAT "%2.0" AXIS_PTS_REF ldp_fmy_dtc /end AXIS_DESCR
/end CHARACTERISTIC
/begin CHARACTERISTIC fmy_id_chk_ls_down_1.c_err_clas "" VALUE 0xffe42cf2 _REC_VAL_20_u1 255. _CNV_A_R_LINEAR_____0_CM 0. 255. DISPLAY_IDENTIFIER C_ERR_CLAS_CHK_LS_DOWN_1 FORMAT "%3.0" /end CHARACTERISTIC
/begin CHARACTERISTIC fmy_id_chk_ls_down_2.dtc "" CURVE 0xffe42cf4 _REC_CUR_20_u2_u2 65535. _CNV_A_R_LINEAR_____0_CM 0. 65535. DISPLAY_IDENTIFIER ID_ERR_DTC_CHK_LS_DOWN_2 FORMAT "%5.0"
 /begin AXIS_DESCR COM_AXIS online_dummy _CNV_A_R_LINEAR_____22_CM 6 0. 5. FORMAT "%2.0" AXIS_PTS_REF ldp_fmy_dtc /end AXIS_DESCR
/end CHARACTERISTIC
/begin CHARACTERISTIC fmy_id_chk_ls_down_2.c_err_clas "" VALUE 0xffe42d04 _REC_VAL_20_u1 255. _CNV_A_R_LINEAR_____0_CM 0. 255. DISPLAY_IDENTIFIER C_ERR_CLAS_CHK_LS_DOWN_2 FORMAT "%3.0" /end CHARACTERISTIC
/begin CHARACTERISTIC fmy_id_delta_lamb_i_1.dtc "" CURVE 0xffe42d06 _REC_CUR_20_u2_u2 65535. _CNV_A_R_LINEAR_____0_CM 0. 65535. DISPLAY_IDENTIFIER ID_ERR_DTC_DELTA_LAMB_I_1 FORMAT "%5.0"
 /begin AXIS_DESCR COM_AXIS online_dummy _CNV_A_R_LINEAR_____22_CM 6 0. 5. FORMAT "%2.0" AXIS_PTS_REF ldp_fmy_dtc /end AXIS_DESCR
/end CHARACTERISTIC
/begin CHARACTERISTIC fmy_id_delta_lamb_i_1.c_err_clas "" VALUE 0xffe42d16 _REC_VAL_20_u1 255. _CNV_A_R_LINEAR_____0_CM 0. 255. DISPLAY_IDENTIFIER C_ERR_CLAS_DELTA_LAMB_I_1 FORMAT "%3.0" /end CHARACTERISTIC
/begin CHARACTERISTIC fmy_id_delta_lamb_i_2.dtc "" CURVE 0xffe42d18 _REC_CUR_20_u2_u2 65535. _CNV_A_R_LINEAR_____0_CM 0. 65535. DISPLAY_IDENTIFIER ID_ERR_DTC_DELTA_LAMB_I_2 FORMAT "%5.0"
 /begin AXIS_DESCR COM_AXIS online_dummy _CNV_A_R_LINEAR_____22_CM 6 0. 5. FORMAT "%2.0" AXIS_PTS_REF ldp_fmy_dtc /end AXIS_DESCR
/end CHARACTERISTIC
/begin CHARACTERISTIC fmy_id_delta_lamb_i_2.c_err_clas "" VALUE 0xffe42d28 _REC_VAL_20_u1 255. _CNV_A_R_LINEAR_____0_CM 0. 255. DISPLAY_IDENTIFIER C_ERR_CLAS_DELTA_LAMB_I_2 FORMAT "%3.0" /end CHARACTERISTIC
/begin CHARACTERISTIC fmy_id_o3_up.dtc "" CURVE 0xffe42d2a _REC_CUR_20_u2_u2 65535. _CNV_A_R_LINEAR_____0_CM 0. 65535. DISPLAY_IDENTIFIER ID_ERR_DTC_O3_UP FORMAT "%5.0"
 /begin AXIS_DESCR COM_AXIS online_dummy _CNV_A_R_LINEAR_____22_CM 6 0. 5. FORMAT "%2.0" AXIS_PTS_REF ldp_fmy_dtc /end AXIS_DESCR
/end CHARACTERISTIC
/begin CHARACTERISTIC fmy_id_o3_up.c_err_clas "" VALUE 0xffe42d3a _REC_VAL_20_u1 255. _CNV_A_R_LINEAR_____0_CM 0. 255. DISPLAY_IDENTIFIER C_ERR_CLAS_O3_UP FORMAT "%3.0" /end CHARACTERISTIC
/begin CHARACTERISTIC fmy_id_o3_down.dtc "" CURVE 0xffe42d3c _REC_CUR_20_u2_u2 65535. _CNV_A_R_LINEAR_____0_CM 0. 65535. DISPLAY_IDENTIFIER ID_ERR_DTC_O3_DOWN FORMAT "%5.0"
 /begin AXIS_DESCR COM_AXIS online_dummy _CNV_A_R_LINEAR_____22_CM 6 0. 5. FORMAT "%2.0" AXIS_PTS_REF ldp_fmy_dtc /end AXIS_DESCR
/end CHARACTERISTIC
/begin CHARACTERISTIC fmy_id_o3_down.c_err_clas "" VALUE 0xffe42d4c _REC_VAL_20_u1 255. _CNV_A_R_LINEAR_____0_CM 0. 255. DISPLAY_IDENTIFIER C_ERR_CLAS_O3_DOWN FORMAT "%3.0" /end CHARACTERISTIC
/begin CHARACTERISTIC fmy_id_obd2_ttip_ls_up_1.dtc "" CURVE 0xffe42d4e _REC_CUR_20_u2_u2 65535. _CNV_A_R_LINEAR_____0_CM 0. 65535. DISPLAY_IDENTIFIER ID_ERR_DTC_OBD2_TTIP_LS_UP_1 FORMAT "%5.0"
 /begin AXIS_DESCR COM_AXIS online_dummy _CNV_A_R_LINEAR_____22_CM 6 0. 5. FORMAT "%2.0" AXIS_PTS_REF ldp_fmy_dtc /end AXIS_DESCR
/end CHARACTERISTIC
/begin CHARACTERISTIC fmy_id_obd2_ttip_ls_up_1.c_err_clas "" VALUE 0xffe42d5e _REC_VAL_20_u1 255. _CNV_A_R_LINEAR_____0_CM 0. 255. DISPLAY_IDENTIFIER C_ERR_CLAS_OBD2_TTIP_LS_UP_1 FORMAT "%3.0" /end CHARACTERISTIC
/begin CHARACTERISTIC fmy_id_obd2_ttip_ls_up_2.dtc "" CURVE 0xffe42d60 _REC_CUR_20_u2_u2 65535. _CNV_A_R_LINEAR_____0_CM 0. 65535. DISPLAY_IDENTIFIER ID_ERR_DTC_OBD2_TTIP_LS_UP_2 FORMAT "%5.0"
 /begin AXIS_DESCR COM_AXIS online_dummy _CNV_A_R_LINEAR_____22_CM 6 0. 5. FORMAT "%2.0" AXIS_PTS_REF ldp_fmy_dtc /end AXIS_DESCR
/end CHARACTERISTIC
/begin CHARACTERISTIC fmy_id_obd2_ttip_ls_up_2.c_err_clas "" VALUE 0xffe42d70 _REC_VAL_20_u1 255. _CNV_A_R_LINEAR_____0_CM 0. 255. DISPLAY_IDENTIFIER C_ERR_CLAS_OBD2_TTIP_LS_UP_2 FORMAT "%3.0" /end CHARACTERISTIC
/begin CHARACTERISTIC fmy_id_lsh_ls_up_1.dtc "" CURVE 0xffe42d72 _REC_CUR_20_u2_u2 65535. _CNV_A_R_LINEAR_____0_CM 0. 65535. DISPLAY_IDENTIFIER ID_ERR_DTC_LSH_LS_UP_1 FORMAT "%5.0"
 /begin AXIS_DESCR COM_AXIS online_dummy _CNV_A_R_LINEAR_____22_CM 6 0. 5. FORMAT "%2.0" AXIS_PTS_REF ldp_fmy_dtc /end AXIS_DESCR
/end CHARACTERISTIC
/begin CHARACTERISTIC fmy_id_lsh_ls_up_1.c_err_clas "" VALUE 0xffe42d82 _REC_VAL_20_u1 255. _CNV_A_R_LINEAR_____0_CM 0. 255. DISPLAY_IDENTIFIER C_ERR_CLAS_LSH_LS_UP_1 FORMAT "%3.0" /end CHARACTERISTIC
/begin CHARACTERISTIC fmy_id_lsh_ls_up_2.dtc "" CURVE 0xffe42d84 _REC_CUR_20_u2_u2 65535. _CNV_A_R_LINEAR_____0_CM 0. 65535. DISPLAY_IDENTIFIER ID_ERR_DTC_LSH_LS_UP_2 FORMAT "%5.0"
 /begin AXIS_DESCR COM_AXIS online_dummy _CNV_A_R_LINEAR_____22_CM 6 0. 5. FORMAT "%2.0" AXIS_PTS_REF ldp_fmy_dtc /end AXIS_DESCR
/end CHARACTERISTIC
/begin CHARACTERISTIC fmy_id_lsh_ls_up_2.c_err_clas "" VALUE 0xffe42d94 _REC_VAL_20_u1 255. _CNV_A_R_LINEAR_____0_CM 0. 255. DISPLAY_IDENTIFIER C_ERR_CLAS_LSH_LS_UP_2 FORMAT "%3.0" /end CHARACTERISTIC
/begin CHARACTERISTIC fmy_id_vls_up_thd_over_1.dtc "" CURVE 0xffe42d96 _REC_CUR_20_u2_u2 65535. _CNV_A_R_LINEAR_____0_CM 0. 65535. DISPLAY_IDENTIFIER ID_ERR_DTC_VLS_UP_THD_OVER_1 FORMAT "%5.0"
 /begin AXIS_DESCR COM_AXIS online_dummy _CNV_A_R_LINEAR_____22_CM 6 0. 5. FORMAT "%2.0" AXIS_PTS_REF ldp_fmy_dtc /end AXIS_DESCR
/end CHARACTERISTIC
/begin CHARACTERISTIC fmy_id_vls_up_thd_over_1.c_err_clas "" VALUE 0xffe42da6 _REC_VAL_20_u1 255. _CNV_A_R_LINEAR_____0_CM 0. 255. DISPLAY_IDENTIFIER C_ERR_CLAS_VLS_UP_THD_OVER_1 FORMAT "%3.0" /end CHARACTERISTIC
/begin CHARACTERISTIC fmy_id_vls_up_thd_over_2.dtc "" CURVE 0xffe42da8 _REC_CUR_20_u2_u2 65535. _CNV_A_R_LINEAR_____0_CM 0. 65535. DISPLAY_IDENTIFIER ID_ERR_DTC_VLS_UP_THD_OVER_2 FORMAT "%5.0"
 /begin AXIS_DESCR COM_AXIS online_dummy _CNV_A_R_LINEAR_____22_CM 6 0. 5. FORMAT "%2.0" AXIS_PTS_REF ldp_fmy_dtc /end AXIS_DESCR
/end CHARACTERISTIC
/begin CHARACTERISTIC fmy_id_vls_up_thd_over_2.c_err_clas "" VALUE 0xffe42db8 _REC_VAL_20_u1 255. _CNV_A_R_LINEAR_____0_CM 0. 255. DISPLAY_IDENTIFIER C_ERR_CLAS_VLS_UP_THD_OVER_2 FORMAT "%3.0" /end CHARACTERISTIC
/begin CHARACTERISTIC fmy_id_tout_nox_sens_1.dtc "" CURVE 0xffe42dba _REC_CUR_20_u2_u2 65535. _CNV_A_R_LINEAR_____0_CM 0. 65535. DISPLAY_IDENTIFIER ID_ERR_DTC_TOUT_NOX_SENS_1 FORMAT "%5.0"
 /begin AXIS_DESCR COM_AXIS online_dummy _CNV_A_R_LINEAR_____22_CM 6 0. 5. FORMAT "%2.0" AXIS_PTS_REF ldp_fmy_dtc /end AXIS_DESCR
/end CHARACTERISTIC
/begin CHARACTERISTIC fmy_id_tout_nox_sens_1.c_err_clas "" VALUE 0xffe42dca _REC_VAL_20_u1 255. _CNV_A_R_LINEAR_____0_CM 0. 255. DISPLAY_IDENTIFIER C_ERR_CLAS_TOUT_NOX_SENS_1 FORMAT "%3.0" /end CHARACTERISTIC
/begin CHARACTERISTIC fmy_id_nox_sens_1.dtc "" CURVE 0xffe42dcc _REC_CUR_20_u2_u2 65535. _CNV_A_R_LINEAR_____0_CM 0. 65535. DISPLAY_IDENTIFIER ID_ERR_DTC_NOX_SENS_1 FORMAT "%5.0"
 /begin AXIS_DESCR COM_AXIS online_dummy _CNV_A_R_LINEAR_____22_CM 6 0. 5. FORMAT "%2.0" AXIS_PTS_REF ldp_fmy_dtc /end AXIS_DESCR
/end CHARACTERISTIC
/begin CHARACTERISTIC fmy_id_nox_sens_1.c_err_clas "" VALUE 0xffe42ddc _REC_VAL_20_u1 255. _CNV_A_R_LINEAR_____0_CM 0. 255. DISPLAY_IDENTIFIER C_ERR_CLAS_NOX_SENS_1 FORMAT "%3.0" /end CHARACTERISTIC
/begin CHARACTERISTIC fmy_id_tout_nox_sens_2.dtc "" CURVE 0xffe42dde _REC_CUR_20_u2_u2 65535. _CNV_A_R_LINEAR_____0_CM 0. 65535. DISPLAY_IDENTIFIER ID_ERR_DTC_TOUT_NOX_SENS_2 FORMAT "%5.0"
 /begin AXIS_DESCR COM_AXIS online_dummy _CNV_A_R_LINEAR_____22_CM 6 0. 5. FORMAT "%2.0" AXIS_PTS_REF ldp_fmy_dtc /end AXIS_DESCR
/end CHARACTERISTIC
/begin CHARACTERISTIC fmy_id_tout_nox_sens_2.c_err_clas "" VALUE 0xffe42dee _REC_VAL_20_u1 255. _CNV_A_R_LINEAR_____0_CM 0. 255. DISPLAY_IDENTIFIER C_ERR_CLAS_TOUT_NOX_SENS_2 FORMAT "%3.0" /end CHARACTERISTIC
/begin CHARACTERISTIC fmy_id_nox_sens_2.dtc "" CURVE 0xffe42df0 _REC_CUR_20_u2_u2 65535. _CNV_A_R_LINEAR_____0_CM 0. 65535. DISPLAY_IDENTIFIER ID_ERR_DTC_NOX_SENS_2 FORMAT "%5.0"
 /begin AXIS_DESCR COM_AXIS online_dummy _CNV_A_R_LINEAR_____22_CM 6 0. 5. FORMAT "%2.0" AXIS_PTS_REF ldp_fmy_dtc /end AXIS_DESCR
/end CHARACTERISTIC
/begin CHARACTERISTIC fmy_id_nox_sens_2.c_err_clas "" VALUE 0xffe42e00 _REC_VAL_20_u1 255. _CNV_A_R_LINEAR_____0_CM 0. 255. DISPLAY_IDENTIFIER C_ERR_CLAS_NOX_SENS_2 FORMAT "%3.0" /end CHARACTERISTIC
/begin CHARACTERISTIC fmy_id_if_lsl_1.dtc "" CURVE 0xffe42e02 _REC_CUR_20_u2_u2 65535. _CNV_A_R_LINEAR_____0_CM 0. 65535. DISPLAY_IDENTIFIER ID_ERR_DTC_IF_LSL_1 FORMAT "%5.0"
 /begin AXIS_DESCR COM_AXIS online_dummy _CNV_A_R_LINEAR_____22_CM 6 0. 5. FORMAT "%2.0" AXIS_PTS_REF ldp_fmy_dtc /end AXIS_DESCR
/end CHARACTERISTIC
/begin CHARACTERISTIC fmy_id_if_lsl_1.c_err_clas "" VALUE 0xffe42e12 _REC_VAL_20_u1 255. _CNV_A_R_LINEAR_____0_CM 0. 255. DISPLAY_IDENTIFIER C_ERR_CLAS_IF_LSL_1 FORMAT "%3.0" /end CHARACTERISTIC
/begin CHARACTERISTIC fmy_id_if_lsl_2.dtc "" CURVE 0xffe42e14 _REC_CUR_20_u2_u2 65535. _CNV_A_R_LINEAR_____0_CM 0. 65535. DISPLAY_IDENTIFIER ID_ERR_DTC_IF_LSL_2 FORMAT "%5.0"
 /begin AXIS_DESCR COM_AXIS online_dummy _CNV_A_R_LINEAR_____22_CM 6 0. 5. FORMAT "%2.0" AXIS_PTS_REF ldp_fmy_dtc /end AXIS_DESCR
/end CHARACTERISTIC
/begin CHARACTERISTIC fmy_id_if_lsl_2.c_err_clas "" VALUE 0xffe42e24 _REC_VAL_20_u1 255. _CNV_A_R_LINEAR_____0_CM 0. 255. DISPLAY_IDENTIFIER C_ERR_CLAS_IF_LSL_2 FORMAT "%3.0" /end CHARACTERISTIC
/begin CHARACTERISTIC fmy_id_ls_up_dyn_vld_1.dtc "" CURVE 0xffe42e26 _REC_CUR_20_u2_u2 65535. _CNV_A_R_LINEAR_____0_CM 0. 65535. DISPLAY_IDENTIFIER ID_ERR_DTC_LS_UP_DYN_VLD_1 FORMAT "%5.0"
 /begin AXIS_DESCR COM_AXIS online_dummy _CNV_A_R_LINEAR_____22_CM 6 0. 5. FORMAT "%2.0" AXIS_PTS_REF ldp_fmy_dtc /end AXIS_DESCR
/end CHARACTERISTIC
/begin CHARACTERISTIC fmy_id_ls_up_dyn_vld_1.c_err_clas "" VALUE 0xffe42e36 _REC_VAL_20_u1 255. _CNV_A_R_LINEAR_____0_CM 0. 255. DISPLAY_IDENTIFIER C_ERR_CLAS_LS_UP_DYN_VLD_1 FORMAT "%3.0" /end CHARACTERISTIC
/begin CHARACTERISTIC fmy_id_ls_up_dyn_vld_2.dtc "" CURVE 0xffe42e38 _REC_CUR_20_u2_u2 65535. _CNV_A_R_LINEAR_____0_CM 0. 65535. DISPLAY_IDENTIFIER ID_ERR_DTC_LS_UP_DYN_VLD_2 FORMAT "%5.0"
 /begin AXIS_DESCR COM_AXIS online_dummy _CNV_A_R_LINEAR_____22_CM 6 0. 5. FORMAT "%2.0" AXIS_PTS_REF ldp_fmy_dtc /end AXIS_DESCR
/end CHARACTERISTIC
/begin CHARACTERISTIC fmy_id_ls_up_dyn_vld_2.c_err_clas "" VALUE 0xffe42e48 _REC_VAL_20_u1 255. _CNV_A_R_LINEAR_____0_CM 0. 255. DISPLAY_IDENTIFIER C_ERR_CLAS_LS_UP_DYN_VLD_2 FORMAT "%3.0" /end CHARACTERISTIC
/begin CHARACTERISTIC fmy_id_ls_up_puc_vld_1.dtc "" CURVE 0xffe42e4a _REC_CUR_20_u2_u2 65535. _CNV_A_R_LINEAR_____0_CM 0. 65535. DISPLAY_IDENTIFIER ID_ERR_DTC_LS_UP_PUC_VLD_1 FORMAT "%5.0"
 /begin AXIS_DESCR COM_AXIS online_dummy _CNV_A_R_LINEAR_____22_CM 6 0. 5. FORMAT "%2.0" AXIS_PTS_REF ldp_fmy_dtc /end AXIS_DESCR
/end CHARACTERISTIC
/begin CHARACTERISTIC fmy_id_ls_up_puc_vld_1.c_err_clas "" VALUE 0xffe42e5a _REC_VAL_20_u1 255. _CNV_A_R_LINEAR_____0_CM 0. 255. DISPLAY_IDENTIFIER C_ERR_CLAS_LS_UP_PUC_VLD_1 FORMAT "%3.0" /end CHARACTERISTIC
/begin CHARACTERISTIC fmy_id_ls_up_puc_vld_2.dtc "" CURVE 0xffe42e5c _REC_CUR_20_u2_u2 65535. _CNV_A_R_LINEAR_____0_CM 0. 65535. DISPLAY_IDENTIFIER ID_ERR_DTC_LS_UP_PUC_VLD_2 FORMAT "%5.0"
 /begin AXIS_DESCR COM_AXIS online_dummy _CNV_A_R_LINEAR_____22_CM 6 0. 5. FORMAT "%2.0" AXIS_PTS_REF ldp_fmy_dtc /end AXIS_DESCR
/end CHARACTERISTIC
/begin CHARACTERISTIC fmy_id_ls_up_puc_vld_2.c_err_clas "" VALUE 0xffe42e6c _REC_VAL_20_u1 255. _CNV_A_R_LINEAR_____0_CM 0. 255. DISPLAY_IDENTIFIER C_ERR_CLAS_LS_UP_PUC_VLD_2 FORMAT "%3.0" /end CHARACTERISTIC
/begin CHARACTERISTIC fmy_id_lsh_up_obd2_vld_1.dtc "" CURVE 0xffe42e6e _REC_CUR_20_u2_u2 65535. _CNV_A_R_LINEAR_____0_CM 0. 65535. DISPLAY_IDENTIFIER ID_ERR_DTC_LSH_UP_OBD2_VLD_1 FORMAT "%5.0"
 /begin AXIS_DESCR COM_AXIS online_dummy _CNV_A_R_LINEAR_____22_CM 6 0. 5. FORMAT "%2.0" AXIS_PTS_REF ldp_fmy_dtc /end AXIS_DESCR
/end CHARACTERISTIC
/begin CHARACTERISTIC fmy_id_lsh_up_obd2_vld_1.c_err_clas "" VALUE 0xffe42e7e _REC_VAL_20_u1 255. _CNV_A_R_LINEAR_____0_CM 0. 255. DISPLAY_IDENTIFIER C_ERR_CLAS_LSH_UP_OBD2_VLD_1 FORMAT "%3.0" /end CHARACTERISTIC
/begin CHARACTERISTIC fmy_id_lsh_up_obd2_vld_2.dtc "" CURVE 0xffe42e80 _REC_CUR_20_u2_u2 65535. _CNV_A_R_LINEAR_____0_CM 0. 65535. DISPLAY_IDENTIFIER ID_ERR_DTC_LSH_UP_OBD2_VLD_2 FORMAT "%5.0"
 /begin AXIS_DESCR COM_AXIS online_dummy _CNV_A_R_LINEAR_____22_CM 6 0. 5. FORMAT "%2.0" AXIS_PTS_REF ldp_fmy_dtc /end AXIS_DESCR
/end CHARACTERISTIC
/begin CHARACTERISTIC fmy_id_lsh_up_obd2_vld_2.c_err_clas "" VALUE 0xffe42e90 _REC_VAL_20_u1 255. _CNV_A_R_LINEAR_____0_CM 0. 255. DISPLAY_IDENTIFIER C_ERR_CLAS_LSH_UP_OBD2_VLD_2 FORMAT "%3.0" /end CHARACTERISTIC
/begin CHARACTERISTIC fmy_id_nox_sens_htp_1.dtc "" CURVE 0xffe42e92 _REC_CUR_20_u2_u2 65535. _CNV_A_R_LINEAR_____0_CM 0. 65535. DISPLAY_IDENTIFIER ID_ERR_DTC_NOX_SENS_HTP_1 FORMAT "%5.0"
 /begin AXIS_DESCR COM_AXIS online_dummy _CNV_A_R_LINEAR_____22_CM 6 0. 5. FORMAT "%2.0" AXIS_PTS_REF ldp_fmy_dtc /end AXIS_DESCR
/end CHARACTERISTIC
/begin CHARACTERISTIC fmy_id_nox_sens_htp_1.c_err_clas "" VALUE 0xffe42ea2 _REC_VAL_20_u1 255. _CNV_A_R_LINEAR_____0_CM 0. 255. DISPLAY_IDENTIFIER C_ERR_CLAS_NOX_SENS_HTP_1 FORMAT "%3.0" /end CHARACTERISTIC
/begin CHARACTERISTIC fmy_id_nox_sens_plaus_1.dtc "" CURVE 0xffe42ea4 _REC_CUR_20_u2_u2 65535. _CNV_A_R_LINEAR_____0_CM 0. 65535. DISPLAY_IDENTIFIER ID_ERR_DTC_NOX_SENS_PLAUS_1 FORMAT "%5.0"
 /begin AXIS_DESCR COM_AXIS online_dummy _CNV_A_R_LINEAR_____22_CM 6 0. 5. FORMAT "%2.0" AXIS_PTS_REF ldp_fmy_dtc /end AXIS_DESCR
/end CHARACTERISTIC
/begin CHARACTERISTIC fmy_id_nox_sens_plaus_1.c_err_clas "" VALUE 0xffe42eb4 _REC_VAL_20_u1 255. _CNV_A_R_LINEAR_____0_CM 0. 255. DISPLAY_IDENTIFIER C_ERR_CLAS_NOX_SENS_PLAUS_1 FORMAT "%3.0" /end CHARACTERISTIC
/begin CHARACTERISTIC fmy_id_nox_sens_avl_1.dtc "" CURVE 0xffe42eb6 _REC_CUR_20_u2_u2 65535. _CNV_A_R_LINEAR_____0_CM 0. 65535. DISPLAY_IDENTIFIER ID_ERR_DTC_NOX_SENS_AVL_1 FORMAT "%5.0"
 /begin AXIS_DESCR COM_AXIS online_dummy _CNV_A_R_LINEAR_____22_CM 6 0. 5. FORMAT "%2.0" AXIS_PTS_REF ldp_fmy_dtc /end AXIS_DESCR
/end CHARACTERISTIC
/begin CHARACTERISTIC fmy_id_nox_sens_avl_1.c_err_clas "" VALUE 0xffe42ec6 _REC_VAL_20_u1 255. _CNV_A_R_LINEAR_____0_CM 0. 255. DISPLAY_IDENTIFIER C_ERR_CLAS_NOX_SENS_AVL_1 FORMAT "%3.0" /end CHARACTERISTIC
/begin CHARACTERISTIC fmy_id_nox_sens_dyn_1.dtc "" CURVE 0xffe42ec8 _REC_CUR_20_u2_u2 65535. _CNV_A_R_LINEAR_____0_CM 0. 65535. DISPLAY_IDENTIFIER ID_ERR_DTC_NOX_SENS_DYN_1 FORMAT "%5.0"
 /begin AXIS_DESCR COM_AXIS online_dummy _CNV_A_R_LINEAR_____22_CM 6 0. 5. FORMAT "%2.0" AXIS_PTS_REF ldp_fmy_dtc /end AXIS_DESCR
/end CHARACTERISTIC
/begin CHARACTERISTIC fmy_id_nox_sens_dyn_1.c_err_clas "" VALUE 0xffe42ed8 _REC_VAL_20_u1 255. _CNV_A_R_LINEAR_____0_CM 0. 255. DISPLAY_IDENTIFIER C_ERR_CLAS_NOX_SENS_DYN_1 FORMAT "%3.0" /end CHARACTERISTIC
/begin CHARACTERISTIC fmy_id_nox_sens_ref_air_1.dtc "" CURVE 0xffe42eda _REC_CUR_20_u2_u2 65535. _CNV_A_R_LINEAR_____0_CM 0. 65535. DISPLAY_IDENTIFIER ID_ERR_DTC_NOX_SENS_REF_AIR_1 FORMAT "%5.0"
 /begin AXIS_DESCR COM_AXIS online_dummy _CNV_A_R_LINEAR_____22_CM 6 0. 5. FORMAT "%2.0" AXIS_PTS_REF ldp_fmy_dtc /end AXIS_DESCR
/end CHARACTERISTIC
/begin CHARACTERISTIC fmy_id_nox_sens_ref_air_1.c_err_clas "" VALUE 0xffe42eea _REC_VAL_20_u1 255. _CNV_A_R_LINEAR_____0_CM 0. 255. DISPLAY_IDENTIFIER C_ERR_CLAS_NOX_SENS_REF_AIR_1 FORMAT "%3.0" /end CHARACTERISTIC
/begin CHARACTERISTIC fmy_id_nox_sens_htp_2.dtc "" CURVE 0xffe42eec _REC_CUR_20_u2_u2 65535. _CNV_A_R_LINEAR_____0_CM 0. 65535. DISPLAY_IDENTIFIER ID_ERR_DTC_NOX_SENS_HTP_2 FORMAT "%5.0"
 /begin AXIS_DESCR COM_AXIS online_dummy _CNV_A_R_LINEAR_____22_CM 6 0. 5. FORMAT "%2.0" AXIS_PTS_REF ldp_fmy_dtc /end AXIS_DESCR
/end CHARACTERISTIC
/begin CHARACTERISTIC fmy_id_nox_sens_htp_2.c_err_clas "" VALUE 0xffe42efc _REC_VAL_20_u1 255. _CNV_A_R_LINEAR_____0_CM 0. 255. DISPLAY_IDENTIFIER C_ERR_CLAS_NOX_SENS_HTP_2 FORMAT "%3.0" /end CHARACTERISTIC
/begin CHARACTERISTIC fmy_id_nox_sens_plaus_2.dtc "" CURVE 0xffe42efe _REC_CUR_20_u2_u2 65535. _CNV_A_R_LINEAR_____0_CM 0. 65535. DISPLAY_IDENTIFIER ID_ERR_DTC_NOX_SENS_PLAUS_2 FORMAT "%5.0"
 /begin AXIS_DESCR COM_AXIS online_dummy _CNV_A_R_LINEAR_____22_CM 6 0. 5. FORMAT "%2.0" AXIS_PTS_REF ldp_fmy_dtc /end AXIS_DESCR
/end CHARACTERISTIC
/begin CHARACTERISTIC fmy_id_nox_sens_plaus_2.c_err_clas "" VALUE 0xffe42f0e _REC_VAL_20_u1 255. _CNV_A_R_LINEAR_____0_CM 0. 255. DISPLAY_IDENTIFIER C_ERR_CLAS_NOX_SENS_PLAUS_2 FORMAT "%3.0" /end CHARACTERISTIC
/begin CHARACTERISTIC fmy_id_nox_sens_avl_2.dtc "" CURVE 0xffe42f10 _REC_CUR_20_u2_u2 65535. _CNV_A_R_LINEAR_____0_CM 0. 65535. DISPLAY_IDENTIFIER ID_ERR_DTC_NOX_SENS_AVL_2 FORMAT "%5.0"
 /begin AXIS_DESCR COM_AXIS online_dummy _CNV_A_R_LINEAR_____22_CM 6 0. 5. FORMAT "%2.0" AXIS_PTS_REF ldp_fmy_dtc /end AXIS_DESCR
/end CHARACTERISTIC
/begin CHARACTERISTIC fmy_id_nox_sens_avl_2.c_err_clas "" VALUE 0xffe42f20 _REC_VAL_20_u1 255. _CNV_A_R_LINEAR_____0_CM 0. 255. DISPLAY_IDENTIFIER C_ERR_CLAS_NOX_SENS_AVL_2 FORMAT "%3.0" /end CHARACTERISTIC
/begin CHARACTERISTIC fmy_id_nox_sens_dyn_2.dtc "" CURVE 0xffe42f22 _REC_CUR_20_u2_u2 65535. _CNV_A_R_LINEAR_____0_CM 0. 65535. DISPLAY_IDENTIFIER ID_ERR_DTC_NOX_SENS_DYN_2 FORMAT "%5.0"
 /begin AXIS_DESCR COM_AXIS online_dummy _CNV_A_R_LINEAR_____22_CM 6 0. 5. FORMAT "%2.0" AXIS_PTS_REF ldp_fmy_dtc /end AXIS_DESCR
/end CHARACTERISTIC
/begin CHARACTERISTIC fmy_id_nox_sens_dyn_2.c_err_clas "" VALUE 0xffe42f32 _REC_VAL_20_u1 255. _CNV_A_R_LINEAR_____0_CM 0. 255. DISPLAY_IDENTIFIER C_ERR_CLAS_NOX_SENS_DYN_2 FORMAT "%3.0" /end CHARACTERISTIC
/begin CHARACTERISTIC fmy_id_nox_sens_ref_air_2.dtc "" CURVE 0xffe42f34 _REC_CUR_20_u2_u2 65535. _CNV_A_R_LINEAR_____0_CM 0. 65535. DISPLAY_IDENTIFIER ID_ERR_DTC_NOX_SENS_REF_AIR_2 FORMAT "%5.0"
 /begin AXIS_DESCR COM_AXIS online_dummy _CNV_A_R_LINEAR_____22_CM 6 0. 5. FORMAT "%2.0" AXIS_PTS_REF ldp_fmy_dtc /end AXIS_DESCR
/end CHARACTERISTIC
/begin CHARACTERISTIC fmy_id_nox_sens_ref_air_2.c_err_clas "" VALUE 0xffe42f44 _REC_VAL_20_u1 255. _CNV_A_R_LINEAR_____0_CM 0. 255. DISPLAY_IDENTIFIER C_ERR_CLAS_NOX_SENS_REF_AIR_2 FORMAT "%3.0" /end CHARACTERISTIC
/begin MEASUREMENT lam_bank_1.ls_act_chk_pl.bf.lv_end_chk_ls_up_down "Boolean flag, end of active check of the oxyen sensors" ULONG _CNV_S_2_RANGE______2_CM 1 100. 0. 1. DISPLAY_IDENTIFIER LV_END_CHK_LS_UP_DOWN_1 ECU_ADDRESS 0x3fc540 BYTE_ORDER MSB_LAST BIT_MASK 0x1000000 /end MEASUREMENT
/begin MEASUREMENT lam_bank_1.ls_act_chk_pl.bf.lv_cdn_chk_ls_up_down_afr "Boolean flag, condition to execute AFR active check of the oxygen sensors" ULONG _CNV_S_2_RANGE______2_CM 1 100. 0. 1. DISPLAY_IDENTIFIER LV_CDN_CHK_LS_UP_DOWN_AFR_1 ECU_ADDRESS 0x3fc540 BYTE_ORDER MSB_LAST BIT_MASK 0x20000000 /end MEASUREMENT
/begin MEASUREMENT lam_bank_1.ls_act_chk_pl.bf.lv_cdn_chk_ls_up_down_afl "Boolean flag, condition to execute AFL active check of the oxygen sensors" ULONG _CNV_S_2_RANGE______2_CM 1 100. 0. 1. DISPLAY_IDENTIFIER LV_CDN_CHK_LS_UP_DOWN_AFL_1 ECU_ADDRESS 0x3fc540 BYTE_ORDER MSB_LAST BIT_MASK 0x10000000 /end MEASUREMENT
/begin MEASUREMENT lam_bank_1.ls_act_chk_pl.bf.lv_set_lamb_sp_act_test_afr "Trigger function to change lambda set point for AFR active plausibility test" ULONG _CNV_S_2_RANGE______2_CM 1 100. 0. 1. DISPLAY_IDENTIFIER LV_SET_LAMB_SP_ACT_TEST_AFR_1 ECU_ADDRESS 0x3fc540 BYTE_ORDER MSB_LAST BIT_MASK 0x80000000 /end MEASUREMENT
/begin MEASUREMENT lam_bank_1.ls_act_chk_pl.bf.lv_set_lamb_sp_act_test_afl "Trigger function to change lambda set point for AFL active plausibility test" ULONG _CNV_S_2_RANGE______2_CM 1 100. 0. 1. DISPLAY_IDENTIFIER LV_SET_LAMB_SP_ACT_TEST_AFL_1 ECU_ADDRESS 0x3fc540 BYTE_ORDER MSB_LAST BIT_MASK 0x40000000 /end MEASUREMENT
/begin MEASUREMENT lam_bank_1.ls_act_chk_pl.bf.lv_req_lamb_sp_ls_act_test "Lambda coordination request to change set point for active plausibility test" ULONG _CNV_S_2_RANGE______2_CM 1 100. 0. 1. DISPLAY_IDENTIFIER LV_REQ_LAMB_SP_LS_ACT_TEST_1 ECU_ADDRESS 0x3fc540 BYTE_ORDER MSB_LAST BIT_MASK 0x2000000 /end MEASUREMENT
/begin MEASUREMENT lam_bank_1.ls_act_chk_pl.bf.lv_sym_chk_ls_up_afr "upstream sensor signal too rich" ULONG _CNV_S_2_RANGE______2_CM 1 100. 0. 1. DISPLAY_IDENTIFIER LV_SYM_CHK_LS_UP_AFR_1 ECU_ADDRESS 0x3fc540 BYTE_ORDER MSB_LAST BIT_MASK 0x800000 /end MEASUREMENT
/begin MEASUREMENT lam_bank_1.ls_act_chk_pl.bf.lv_sym_chk_ls_up_afl "upstream sensor signal too lean" ULONG _CNV_S_2_RANGE______2_CM 1 100. 0. 1. DISPLAY_IDENTIFIER LV_SYM_CHK_LS_UP_AFL_1 ECU_ADDRESS 0x3fc540 BYTE_ORDER MSB_LAST BIT_MASK 0x400000 /end MEASUREMENT
/begin MEASUREMENT lam_bank_1.ls_act_chk_pl.bf.sym_chk_ls_up_afl "Error symptom in the upstream sensor during lean test" ULONG _CNV_S_2_RANGE______2_CM 1 100. 0. 1. DISPLAY_IDENTIFIER SYM_CHK_LS_UP_AFL_1 ECU_ADDRESS 0x3fc540 BYTE_ORDER MSB_LAST BIT_MASK 0x100000 /end MEASUREMENT
/begin MEASUREMENT lam_bank_1.ls_act_chk_pl.bf.sym_chk_ls_up_afr "Error symptom in the upstream sensor during rich test" ULONG _CNV_S_2_RANGE______2_CM 1 100. 0. 1. DISPLAY_IDENTIFIER SYM_CHK_LS_UP_AFR_1 ECU_ADDRESS 0x3fc540 BYTE_ORDER MSB_LAST BIT_MASK 0x200000 /end MEASUREMENT
/begin MEASUREMENT lam_bank_1.ls_act_chk_pl.maf_int_chk_ls_up_down "integral of air mass flow while check is active" UWORD _CNV_A_R_LINEAR_____287_CM 1 100. 0. 1820.398 DISPLAY_IDENTIFIER MAF_INT_CHK_LS_UP_DOWN_1 ECU_ADDRESS 0x3fc546 BYTE_ORDER MSB_LAST FORMAT "%7.2" /end MEASUREMENT
/begin MEASUREMENT lam_bank_1.ls_act_chk_pl.lamb_sp_beg_ls_act_test "Inicial value of lambda set point" UWORD _CNV_A_R_LINEAR_____206_CM 1 100. 0. 31.99902344 DISPLAY_IDENTIFIER LAMB_SP_BEG_LS_ACT_TEST_1 ECU_ADDRESS 0x3fc54c BYTE_ORDER MSB_LAST /end MEASUREMENT
/begin MEASUREMENT lam_bank_1.ls_act_chk_pl.t_chk_ls_up_down_afr "Timer for plausibility test under rich AF conditions" UWORD _CNV_A_R_LINEAR_____24_CM 1 100. 0. 6553.5 DISPLAY_IDENTIFIER T_CHK_LS_UP_DOWN_AFR_1 ECU_ADDRESS 0x3fc54a BYTE_ORDER MSB_LAST FORMAT "%5.1" /end MEASUREMENT
/begin MEASUREMENT lam_bank_1.ls_act_chk_pl.t_chk_ls_up_down_afl "Timer for plausibility test under lean AF conditions" UWORD _CNV_A_R_LINEAR_____24_CM 1 100. 0. 6553.5 DISPLAY_IDENTIFIER T_CHK_LS_UP_DOWN_AFL_1 ECU_ADDRESS 0x3fc548 BYTE_ORDER MSB_LAST FORMAT "%5.1" /end MEASUREMENT
/begin MEASUREMENT lam_bank_1.ls_act_chk_pl.delta_lamb_sp_ls_act_test "Increment of lambda set point" SWORD _CNV_A_R_LINEAR_____319_CM 1 100. -32.00000000125 31.99902343875 DISPLAY_IDENTIFIER DELTA_LAMB_SP_LS_ACT_TEST_1 ECU_ADDRESS 0x3fc54e BYTE_ORDER MSB_LAST /end MEASUREMENT
/begin MEASUREMENT lam_bank_1.ls_act_chk_pl.lamb_sp_ls_act_test "Lambda set point for active plausibility test" UWORD _CNV_A_R_LINEAR_____206_CM 1 100. 0. 31.99902344 DISPLAY_IDENTIFIER LAMB_SP_LS_ACT_TEST_1 ECU_ADDRESS 0x3fc550 BYTE_ORDER MSB_LAST /end MEASUREMENT
/begin MEASUREMENT lam_bank_1.ls_act_chk_pl.state_chk_ls_up_down "State of check of downstream oxygen sensor signal for lambda sensor error manager" UBYTE _CNV_S_4_RANGE_STAT_320_CM 1 100. 0. 3. DISPLAY_IDENTIFIER STATE_CHK_LS_UP_DOWN_1 ECU_ADDRESS 0x3fc545 /end MEASUREMENT
/begin MEASUREMENT lam_bank_1.ls_act_chk_pl.ctr_sum_rst_chk_ls_up_afr "Counter for reset lean test anti-bounce" UWORD _CNV_A_R_LINEAR_____0_CM 1 100. 0. 65535. DISPLAY_IDENTIFIER CTR_SUM_RST_CHK_LS_UP_AFR_1 ECU_ADDRESS 0x3fc552 BYTE_ORDER MSB_LAST FORMAT "%5.0" /end MEASUREMENT
/begin MEASUREMENT lam_bank_1.ls_act_chk_pl.ctr_sum_rst_chk_ls_up_afl "Counter for reset lean test anti-bounce" UWORD _CNV_A_R_LINEAR_____0_CM 1 100. 0. 65535. DISPLAY_IDENTIFIER CTR_SUM_RST_CHK_LS_UP_AFL_1 ECU_ADDRESS 0x3fc554 BYTE_ORDER MSB_LAST FORMAT "%5.0" /end MEASUREMENT
/begin MEASUREMENT lam_bank_1.ls_act_chk_pl.ctr_chk_ls_up_afl "lean test anti-bounce" UWORD _CNV_A_R_LINEAR_____0_CM 1 100. 0. 65535. DISPLAY_IDENTIFIER CTR_CHK_LS_UP_AFL_1 ECU_ADDRESS 0x3fc558 BYTE_ORDER MSB_LAST FORMAT "%5.0" /end MEASUREMENT
/begin MEASUREMENT lam_bank_1.ls_act_chk_pl.ctr_chk_ls_up_afr "lean test anti-bounce" UWORD _CNV_A_R_LINEAR_____0_CM 1 100. 0. 65535. DISPLAY_IDENTIFIER CTR_CHK_LS_UP_AFR_1 ECU_ADDRESS 0x3fc556 BYTE_ORDER MSB_LAST FORMAT "%5.0" /end MEASUREMENT
/begin MEASUREMENT lam_bank_1.ls_act_chk_pl.delta_step_lamb_sp_ls_act_test "Stepwise increment of lambda set point" SBYTE _CNV_A_R_LINEAR_____290_CM 1 100. -0.125 0.124023 DISPLAY_IDENTIFIER DELTA_STEP_LAMB_SP_LS_ACT_TEST_1 ECU_ADDRESS 0x3fc544 FORMAT "%7.4" /end MEASUREMENT
/begin MEASUREMENT lam_bank_1.ls_act_chk_pl_inci.bf.lv_inh_chk_ls_up_down "" ULONG _CNV_S_2_RANGE______2_CM 1 100. 0. 1. DISPLAY_IDENTIFIER LV_INH_CHK_LS_UP_DOWN_1 ECU_ADDRESS 0x3fc53c BYTE_ORDER MSB_LAST BIT_MASK 0x40000000 /end MEASUREMENT
/begin MEASUREMENT lam_bank_1.ls_act_chk_pl_inci.bf.lv_inh_chk_ls_up_down_afr "" ULONG _CNV_S_2_RANGE______2_CM 1 100. 0. 1. DISPLAY_IDENTIFIER LV_INH_CHK_LS_UP_DOWN_AFR_1 ECU_ADDRESS 0x3fc53c BYTE_ORDER MSB_LAST BIT_MASK 0x80000000 /end MEASUREMENT
/begin MEASUREMENT lam_bank_1.ls_act_chk_pl_inci.bf.lv_inh_chk_ls_up_down_afl "" ULONG _CNV_S_2_RANGE______2_CM 1 100. 0. 1. DISPLAY_IDENTIFIER LV_INH_CHK_LS_UP_DOWN_AFL_1 ECU_ADDRESS 0x3fc53c BYTE_ORDER MSB_LAST BIT_MASK 0x20000000 /end MEASUREMENT
/begin MEASUREMENT lam_bank_2.ls_act_chk_pl.bf.lv_end_chk_ls_up_down "Boolean flag, end of active check of the oxyen sensors" ULONG _CNV_S_2_RANGE______2_CM 1 100. 0. 1. DISPLAY_IDENTIFIER LV_END_CHK_LS_UP_DOWN_2 ECU_ADDRESS 0x3fc9f8 BYTE_ORDER MSB_LAST BIT_MASK 0x1000000 /end MEASUREMENT
/begin MEASUREMENT lam_bank_2.ls_act_chk_pl.bf.lv_cdn_chk_ls_up_down_afr "Boolean flag, condition to execute AFR active check of the oxygen sensors" ULONG _CNV_S_2_RANGE______2_CM 1 100. 0. 1. DISPLAY_IDENTIFIER LV_CDN_CHK_LS_UP_DOWN_AFR_2 ECU_ADDRESS 0x3fc9f8 BYTE_ORDER MSB_LAST BIT_MASK 0x20000000 /end MEASUREMENT
/begin MEASUREMENT lam_bank_2.ls_act_chk_pl.bf.lv_cdn_chk_ls_up_down_afl "Boolean flag, condition to execute AFL active check of the oxygen sensors" ULONG _CNV_S_2_RANGE______2_CM 1 100. 0. 1. DISPLAY_IDENTIFIER LV_CDN_CHK_LS_UP_DOWN_AFL_2 ECU_ADDRESS 0x3fc9f8 BYTE_ORDER MSB_LAST BIT_MASK 0x10000000 /end MEASUREMENT
/begin MEASUREMENT lam_bank_2.ls_act_chk_pl.bf.lv_set_lamb_sp_act_test_afr "Trigger function to change lambda set point for AFR active plausibility test" ULONG _CNV_S_2_RANGE______2_CM 1 100. 0. 1. DISPLAY_IDENTIFIER LV_SET_LAMB_SP_ACT_TEST_AFR_2 ECU_ADDRESS 0x3fc9f8 BYTE_ORDER MSB_LAST BIT_MASK 0x80000000 /end MEASUREMENT
/begin MEASUREMENT lam_bank_2.ls_act_chk_pl.bf.lv_set_lamb_sp_act_test_afl "Trigger function to change lambda set point for AFL active plausibility test" ULONG _CNV_S_2_RANGE______2_CM 1 100. 0. 1. DISPLAY_IDENTIFIER LV_SET_LAMB_SP_ACT_TEST_AFL_2 ECU_ADDRESS 0x3fc9f8 BYTE_ORDER MSB_LAST BIT_MASK 0x40000000 /end MEASUREMENT
/begin MEASUREMENT lam_bank_2.ls_act_chk_pl.bf.lv_req_lamb_sp_ls_act_test "Lambda coordination request to change set point for active plausibility test" ULONG _CNV_S_2_RANGE______2_CM 1 100. 0. 1. DISPLAY_IDENTIFIER LV_REQ_LAMB_SP_LS_ACT_TEST_2 ECU_ADDRESS 0x3fc9f8 BYTE_ORDER MSB_LAST BIT_MASK 0x2000000 /end MEASUREMENT
/begin MEASUREMENT lam_bank_2.ls_act_chk_pl.bf.lv_sym_chk_ls_up_afr "upstream sensor signal too rich" ULONG _CNV_S_2_RANGE______2_CM 1 100. 0. 1. DISPLAY_IDENTIFIER LV_SYM_CHK_LS_UP_AFR_2 ECU_ADDRESS 0x3fc9f8 BYTE_ORDER MSB_LAST BIT_MASK 0x800000 /end MEASUREMENT
/begin MEASUREMENT lam_bank_2.ls_act_chk_pl.bf.lv_sym_chk_ls_up_afl "upstream sensor signal too lean" ULONG _CNV_S_2_RANGE______2_CM 1 100. 0. 1. DISPLAY_IDENTIFIER LV_SYM_CHK_LS_UP_AFL_2 ECU_ADDRESS 0x3fc9f8 BYTE_ORDER MSB_LAST BIT_MASK 0x400000 /end MEASUREMENT
/begin MEASUREMENT lam_bank_2.ls_act_chk_pl.bf.sym_chk_ls_up_afl "Error symptom in the upstream sensor during lean test" ULONG _CNV_S_2_RANGE______2_CM 1 100. 0. 1. DISPLAY_IDENTIFIER SYM_CHK_LS_UP_AFL_2 ECU_ADDRESS 0x3fc9f8 BYTE_ORDER MSB_LAST BIT_MASK 0x100000 /end MEASUREMENT
/begin MEASUREMENT lam_bank_2.ls_act_chk_pl.bf.sym_chk_ls_up_afr "Error symptom in the upstream sensor during rich test" ULONG _CNV_S_2_RANGE______2_CM 1 100. 0. 1. DISPLAY_IDENTIFIER SYM_CHK_LS_UP_AFR_2 ECU_ADDRESS 0x3fc9f8 BYTE_ORDER MSB_LAST BIT_MASK 0x200000 /end MEASUREMENT
/begin MEASUREMENT lam_bank_2.ls_act_chk_pl.maf_int_chk_ls_up_down "integral of air mass flow while check is active" UWORD _CNV_A_R_LINEAR_____287_CM 1 100. 0. 1820.398 DISPLAY_IDENTIFIER MAF_INT_CHK_LS_UP_DOWN_2 ECU_ADDRESS 0x3fc9fe BYTE_ORDER MSB_LAST FORMAT "%7.2" /end MEASUREMENT
/begin MEASUREMENT lam_bank_2.ls_act_chk_pl.lamb_sp_beg_ls_act_test "Inicial value of lambda set point" UWORD _CNV_A_R_LINEAR_____206_CM 1 100. 0. 31.99902344 DISPLAY_IDENTIFIER LAMB_SP_BEG_LS_ACT_TEST_2 ECU_ADDRESS 0x3fca04 BYTE_ORDER MSB_LAST /end MEASUREMENT
/begin MEASUREMENT lam_bank_2.ls_act_chk_pl.t_chk_ls_up_down_afr "Timer for plausibility test under rich AF conditions" UWORD _CNV_A_R_LINEAR_____24_CM 1 100. 0. 6553.5 DISPLAY_IDENTIFIER T_CHK_LS_UP_DOWN_AFR_2 ECU_ADDRESS 0x3fca02 BYTE_ORDER MSB_LAST FORMAT "%5.1" /end MEASUREMENT
/begin MEASUREMENT lam_bank_2.ls_act_chk_pl.t_chk_ls_up_down_afl "Timer for plausibility test under lean AF conditions" UWORD _CNV_A_R_LINEAR_____24_CM 1 100. 0. 6553.5 DISPLAY_IDENTIFIER T_CHK_LS_UP_DOWN_AFL_2 ECU_ADDRESS 0x3fca00 BYTE_ORDER MSB_LAST FORMAT "%5.1" /end MEASUREMENT
/begin MEASUREMENT lam_bank_2.ls_act_chk_pl.delta_lamb_sp_ls_act_test "Increment of lambda set point" SWORD _CNV_A_R_LINEAR_____319_CM 1 100. -32.00000000125 31.99902343875 DISPLAY_IDENTIFIER DELTA_LAMB_SP_LS_ACT_TEST_2 ECU_ADDRESS 0x3fca06 BYTE_ORDER MSB_LAST /end MEASUREMENT
/begin MEASUREMENT lam_bank_2.ls_act_chk_pl.lamb_sp_ls_act_test "Lambda set point for active plausibility test" UWORD _CNV_A_R_LINEAR_____206_CM 1 100. 0. 31.99902344 DISPLAY_IDENTIFIER LAMB_SP_LS_ACT_TEST_2 ECU_ADDRESS 0x3fca08 BYTE_ORDER MSB_LAST /end MEASUREMENT
/begin MEASUREMENT lam_bank_2.ls_act_chk_pl.state_chk_ls_up_down "State of check of downstream oxygen sensor signal for lambda sensor error manager" UBYTE _CNV_S_4_RANGE_STAT_320_CM 1 100. 0. 3. DISPLAY_IDENTIFIER STATE_CHK_LS_UP_DOWN_2 ECU_ADDRESS 0x3fc9fd /end MEASUREMENT
/begin MEASUREMENT lam_bank_2.ls_act_chk_pl.ctr_sum_rst_chk_ls_up_afr "Counter for reset lean test anti-bounce" UWORD _CNV_A_R_LINEAR_____0_CM 1 100. 0. 65535. DISPLAY_IDENTIFIER CTR_SUM_RST_CHK_LS_UP_AFR_2 ECU_ADDRESS 0x3fca0a BYTE_ORDER MSB_LAST FORMAT "%5.0" /end MEASUREMENT
/begin MEASUREMENT lam_bank_2.ls_act_chk_pl.ctr_sum_rst_chk_ls_up_afl "Counter for reset lean test anti-bounce" UWORD _CNV_A_R_LINEAR_____0_CM 1 100. 0. 65535. DISPLAY_IDENTIFIER CTR_SUM_RST_CHK_LS_UP_AFL_2 ECU_ADDRESS 0x3fca0c BYTE_ORDER MSB_LAST FORMAT "%5.0" /end MEASUREMENT
/begin MEASUREMENT lam_bank_2.ls_act_chk_pl.ctr_chk_ls_up_afl "lean test anti-bounce" UWORD _CNV_A_R_LINEAR_____0_CM 1 100. 0. 65535. DISPLAY_IDENTIFIER CTR_CHK_LS_UP_AFL_2 ECU_ADDRESS 0x3fca10 BYTE_ORDER MSB_LAST FORMAT "%5.0" /end MEASUREMENT
/begin MEASUREMENT lam_bank_2.ls_act_chk_pl.ctr_chk_ls_up_afr "lean test anti-bounce" UWORD _CNV_A_R_LINEAR_____0_CM 1 100. 0. 65535. DISPLAY_IDENTIFIER CTR_CHK_LS_UP_AFR_2 ECU_ADDRESS 0x3fca0e BYTE_ORDER MSB_LAST FORMAT "%5.0" /end MEASUREMENT
/begin MEASUREMENT lam_bank_2.ls_act_chk_pl.delta_step_lamb_sp_ls_act_test "Stepwise increment of lambda set point" SBYTE _CNV_A_R_LINEAR_____290_CM 1 100. -0.125 0.124023 DISPLAY_IDENTIFIER DELTA_STEP_LAMB_SP_LS_ACT_TEST_2 ECU_ADDRESS 0x3fc9fc FORMAT "%7.4" /end MEASUREMENT
/begin MEASUREMENT lam_bank_2.ls_act_chk_pl_inci.bf.lv_inh_chk_ls_up_down "" ULONG _CNV_S_2_RANGE______2_CM 1 100. 0. 1. DISPLAY_IDENTIFIER LV_INH_CHK_LS_UP_DOWN_2 ECU_ADDRESS 0x3fc9f4 BYTE_ORDER MSB_LAST BIT_MASK 0x40000000 /end MEASUREMENT
/begin MEASUREMENT lam_bank_2.ls_act_chk_pl_inci.bf.lv_inh_chk_ls_up_down_afr "" ULONG _CNV_S_2_RANGE______2_CM 1 100. 0. 1. DISPLAY_IDENTIFIER LV_INH_CHK_LS_UP_DOWN_AFR_2 ECU_ADDRESS 0x3fc9f4 BYTE_ORDER MSB_LAST BIT_MASK 0x80000000 /end MEASUREMENT
/begin MEASUREMENT lam_bank_2.ls_act_chk_pl_inci.bf.lv_inh_chk_ls_up_down_afl "" ULONG _CNV_S_2_RANGE______2_CM 1 100. 0. 1. DISPLAY_IDENTIFIER LV_INH_CHK_LS_UP_DOWN_AFL_2 ECU_ADDRESS 0x3fc9f4 BYTE_ORDER MSB_LAST BIT_MASK 0x20000000 /end MEASUREMENT
/begin CHARACTERISTIC c_maf_int_min_chk_ls_up_down "Minimum threshold for MAF integral required to start downstream PUC signal plausibility" VALUE 0xffe41766 _REC_VAL_20_u2 1820.398 _CNV_A_R_LINEAR_____287_CM 0. 1820.398 DISPLAY_IDENTIFIER C_MAF_INT_MIN_CHK_LS_UP_DOWN FORMAT "%7.2" /end CHARACTERISTIC
/begin CHARACTERISTIC c_maf_int_chk_ls_up_down_eol "Initialization of MAF integral to reduce required minimum MAF value to start active test" VALUE 0xffe4174e _REC_VAL_20_u2 1820.398 _CNV_A_R_LINEAR_____287_CM 0. 1820.398 DISPLAY_IDENTIFIER C_MAF_INT_CHK_LS_UP_DOWN_EOL FORMAT "%7.2" /end CHARACTERISTIC
/begin CHARACTERISTIC c_t_max_chk_ls_up_down_afr "Timer threshold for plausibility test under rich AF conditions" VALUE 0xffe41990 _REC_VAL_20_u2 6553.5 _CNV_A_R_LINEAR_____24_CM 0. 6553.5 DISPLAY_IDENTIFIER C_T_MAX_CHK_LS_UP_DOWN_AFR FORMAT "%5.1" /end CHARACTERISTIC
/begin CHARACTERISTIC c_t_max_chk_ls_up_down_afl "Timer threshold for plausibility test under lean AF conditions" VALUE 0xffe4198e _REC_VAL_20_u2 6553.5 _CNV_A_R_LINEAR_____24_CM 0. 6553.5 DISPLAY_IDENTIFIER C_T_MAX_CHK_LS_UP_DOWN_AFL FORMAT "%5.1" /end CHARACTERISTIC
/begin CHARACTERISTIC c_t_chk_ls_up_down_eol "Initialization of timer in case EOL to reduce the required minimum activity test time" VALUE 0xffe418e8 _REC_VAL_20_u2 6553.5 _CNV_A_R_LINEAR_____24_CM 0. 6553.5 DISPLAY_IDENTIFIER C_T_CHK_LS_UP_DOWN_EOL FORMAT "%5.1" /end CHARACTERISTIC
/begin CHARACTERISTIC c_chk_ls_up_afl "Lambda value threshold for lean fault detection (upstream sensor)" VALUE 0xffe41516 _REC_VAL_20_u2 31.99902344 _CNV_A_R_LINEAR_____206_CM 0. 31.99902344 DISPLAY_IDENTIFIER C_CHK_LS_UP_AFL /end CHARACTERISTIC
/begin CHARACTERISTIC c_chk_ls_up_afr "Lambda value threshold for rich fault detection (upstream sensor)" VALUE 0xffe41518 _REC_VAL_20_u2 31.99902344 _CNV_A_R_LINEAR_____206_CM 0. 31.99902344 DISPLAY_IDENTIFIER C_CHK_LS_UP_AFR /end CHARACTERISTIC
/begin CHARACTERISTIC c_chk_ls_down_afr "Lambda value threshold for rich fault detection (downstream sensor)" VALUE 0xffe41514 _REC_VAL_20_u2 4.99511719 _CNV_A_R_LINEAR_____3_CM 0. 4.99511719 DISPLAY_IDENTIFIER C_CHK_LS_DOWN_AFR FORMAT "%5.3" /end CHARACTERISTIC
/begin CHARACTERISTIC c_chk_ls_down_afl "Lambda value threshold for lean fault detection (downstream sensor)" VALUE 0xffe41512 _REC_VAL_20_u2 4.99511719 _CNV_A_R_LINEAR_____3_CM 0. 4.99511719 DISPLAY_IDENTIFIER C_CHK_LS_DOWN_AFL FORMAT "%5.3" /end CHARACTERISTIC
/begin CHARACTERISTIC c_lamb_sp_ls_act_test_afr "Lambda set point for rich fault detection" VALUE 0xffe416e6 _REC_VAL_20_u2 31.99902344 _CNV_A_R_LINEAR_____206_CM 0. 31.99902344 DISPLAY_IDENTIFIER C_LAMB_SP_LS_ACT_TEST_AFR /end CHARACTERISTIC
/begin CHARACTERISTIC c_lamb_sp_ls_act_test_afl "Lambda set point for lean fault detection" VALUE 0xffe416e4 _REC_VAL_20_u2 31.99902344 _CNV_A_R_LINEAR_____206_CM 0. 31.99902344 DISPLAY_IDENTIFIER C_LAMB_SP_LS_ACT_TEST_AFL /end CHARACTERISTIC
/begin CHARACTERISTIC c_lamb_min_ls_act_test_afr "Min. lambda set point for rich fault detection" VALUE 0xffe416c4 _REC_VAL_20_u2 31.99902344 _CNV_A_R_LINEAR_____206_CM 0. 31.99902344 DISPLAY_IDENTIFIER C_LAMB_MIN_LS_ACT_TEST_AFR /end CHARACTERISTIC
/begin CHARACTERISTIC c_lamb_min_ls_act_test_afl "Min. lambda set point for lean fault detection" VALUE 0xffe416c2 _REC_VAL_20_u2 31.99902344 _CNV_A_R_LINEAR_____206_CM 0. 31.99902344 DISPLAY_IDENTIFIER C_LAMB_MIN_LS_ACT_TEST_AFL /end CHARACTERISTIC
/begin CHARACTERISTIC c_lamb_max_ls_act_test_afr "Max. lambda set point for rich fault detection" VALUE 0xffe416c0 _REC_VAL_20_u2 31.99902344 _CNV_A_R_LINEAR_____206_CM 0. 31.99902344 DISPLAY_IDENTIFIER C_LAMB_MAX_LS_ACT_TEST_AFR /end CHARACTERISTIC
/begin CHARACTERISTIC c_lamb_max_ls_act_test_afl "Max. lambda set point for lean fault detection" VALUE 0xffe416be _REC_VAL_20_u2 31.99902344 _CNV_A_R_LINEAR_____206_CM 0. 31.99902344 DISPLAY_IDENTIFIER C_LAMB_MAX_LS_ACT_TEST_AFL /end CHARACTERISTIC
/begin CHARACTERISTIC c_step_lamb_sp_ls_act_test "Number of recurrences to achieve the desired lambda set point" VALUE 0xffe40846 _REC_VAL_20_u1 254. _CNV_A_R_LINEAR_____0_CM 1. 255. DISPLAY_IDENTIFIER C_STEP_LAMB_SP_LS_ACT_TEST FORMAT "%3.0" /end CHARACTERISTIC
/begin CHARACTERISTIC c_abc_inc_chk_ls_up "Anti - bounce counter increment" VALUE 0xffe40564 _REC_VAL_20_u1 255. _CNV_A_R_LINEAR_____0_CM 0. 255. DISPLAY_IDENTIFIER C_ABC_INC_CHK_LS_UP FORMAT "%3.0" /end CHARACTERISTIC
/begin CHARACTERISTIC c_abc_max_chk_ls_up "Maximum value of the anti - bounce counter" VALUE 0xffe414c0 _REC_VAL_20_u2 65535. _CNV_A_R_LINEAR_____0_CM 0. 65535. DISPLAY_IDENTIFIER C_ABC_MAX_CHK_LS_UP FORMAT "%5.0" /end CHARACTERISTIC
/begin CHARACTERISTIC c_ctr_sum_rst_chk_ls_up "Maximum value for restart all counters" VALUE 0xffe4158a _REC_VAL_20_u2 65535. _CNV_A_R_LINEAR_____0_CM 0. 65535. DISPLAY_IDENTIFIER C_CTR_SUM_RST_CHK_LS_UP FORMAT "%5.0" /end CHARACTERISTIC
/begin MEASUREMENT lv_err_chk_ls_down_2 "Debounced failure in the downstream sensor" UBYTE _CNV_S_2_RANGE______1_R_CM 1 100. 0. 255. DISPLAY_IDENTIFIER LV_ERR_CHK_LS_DOWN_2 ECU_ADDRESS 0x3fbb74 /end MEASUREMENT
/begin MEASUREMENT lv_err_chk_ls_down_1 "Debounced failure in the downstream sensor" UBYTE _CNV_S_2_RANGE______1_R_CM 1 100. 0. 255. DISPLAY_IDENTIFIER LV_ERR_CHK_LS_DOWN_1 ECU_ADDRESS 0x3fbb70 /end MEASUREMENT
/begin MEASUREMENT fmy_ram_dyn[0].dtc_cod "" UWORD _CNV_A_R_LINEAR_____22_CM 1 100. 0. 65535. DISPLAY_IDENTIFIER DTC_COD_0 ECU_ADDRESS 0x3fb78c BYTE_ORDER MSB_LAST FORMAT "%6.0" /end MEASUREMENT
/begin MEASUREMENT fmy_ram_dyn[0].err_info_dyn.bit_0_3 "" UWORD _CNV_S_6_RANGE_ERR__337_CM 1 100. 0. 15. DISPLAY_IDENTIFIER ERR_SYM_MEM_0 ECU_ADDRESS 0x3fb790 BYTE_ORDER MSB_LAST BIT_MASK 0xF /end MEASUREMENT
/begin MEASUREMENT fmy_ram_dyn[1].dtc_cod "" UWORD _CNV_A_R_LINEAR_____22_CM 1 100. 0. 65535. DISPLAY_IDENTIFIER DTC_COD_1 ECU_ADDRESS 0x3fb796 BYTE_ORDER MSB_LAST FORMAT "%6.0" /end MEASUREMENT
/begin MEASUREMENT fmy_ram_dyn[1].err_info_dyn.bit_0_3 "" UWORD _CNV_S_6_RANGE_ERR__337_CM 1 100. 0. 15. DISPLAY_IDENTIFIER ERR_SYM_MEM_1 ECU_ADDRESS 0x3fb79a BYTE_ORDER MSB_LAST BIT_MASK 0xF /end MEASUREMENT
/begin MEASUREMENT fmy_ram_dyn[2].dtc_cod "" UWORD _CNV_A_R_LINEAR_____22_CM 1 100. 0. 65535. DISPLAY_IDENTIFIER DTC_COD_2 ECU_ADDRESS 0x3fb7a0 BYTE_ORDER MSB_LAST FORMAT "%6.0" /end MEASUREMENT
/begin MEASUREMENT fmy_ram_dyn[2].err_info_dyn.bit_0_3 "" UWORD _CNV_S_6_RANGE_ERR__337_CM 1 100. 0. 15. DISPLAY_IDENTIFIER ERR_SYM_MEM_2 ECU_ADDRESS 0x3fb7a4 BYTE_ORDER MSB_LAST BIT_MASK 0xF /end MEASUREMENT
/begin MEASUREMENT fmy_ram_dyn[3].dtc_cod "" UWORD _CNV_A_R_LINEAR_____22_CM 1 100. 0. 65535. DISPLAY_IDENTIFIER DTC_COD_3 ECU_ADDRESS 0x3fb7aa BYTE_ORDER MSB_LAST FORMAT "%6.0" /end MEASUREMENT
/begin MEASUREMENT fmy_ram_dyn[3].err_info_dyn.bit_0_3 "" UWORD _CNV_S_6_RANGE_ERR__337_CM 1 100. 0. 15. DISPLAY_IDENTIFIER ERR_SYM_MEM_3 ECU_ADDRESS 0x3fb7ae BYTE_ORDER MSB_LAST BIT_MASK 0xF /end MEASUREMENT
/begin MEASUREMENT fmy_ram_dyn[4].dtc_cod "" UWORD _CNV_A_R_LINEAR_____22_CM 1 100. 0. 65535. DISPLAY_IDENTIFIER DTC_COD_4 ECU_ADDRESS 0x3fb7b4 BYTE_ORDER MSB_LAST FORMAT "%6.0" /end MEASUREMENT
/begin MEASUREMENT fmy_ram_dyn[4].err_info_dyn.bit_0_3 "" UWORD _CNV_S_6_RANGE_ERR__337_CM 1 100. 0. 15. DISPLAY_IDENTIFIER ERR_SYM_MEM_4 ECU_ADDRESS 0x3fb7b8 BYTE_ORDER MSB_LAST BIT_MASK 0xF /end MEASUREMENT
/begin MEASUREMENT fmy_ram_dyn[5].dtc_cod "" UWORD _CNV_A_R_LINEAR_____22_CM 1 100. 0. 65535. DISPLAY_IDENTIFIER DTC_COD_5 ECU_ADDRESS 0x3fb7be BYTE_ORDER MSB_LAST FORMAT "%6.0" /end MEASUREMENT
/begin MEASUREMENT fmy_ram_dyn[5].err_info_dyn.bit_0_3 "" UWORD _CNV_S_6_RANGE_ERR__337_CM 1 100. 0. 15. DISPLAY_IDENTIFIER ERR_SYM_MEM_5 ECU_ADDRESS 0x3fb7c2 BYTE_ORDER MSB_LAST BIT_MASK 0xF /end MEASUREMENT
/begin MEASUREMENT fmy_ram_dyn[6].dtc_cod "" UWORD _CNV_A_R_LINEAR_____22_CM 1 100. 0. 65535. DISPLAY_IDENTIFIER DTC_COD_6 ECU_ADDRESS 0x3fb7c8 BYTE_ORDER MSB_LAST FORMAT "%6.0" /end MEASUREMENT
/begin MEASUREMENT fmy_ram_dyn[6].err_info_dyn.bit_0_3 "" UWORD _CNV_S_6_RANGE_ERR__337_CM 1 100. 0. 15. DISPLAY_IDENTIFIER ERR_SYM_MEM_6 ECU_ADDRESS 0x3fb7cc BYTE_ORDER MSB_LAST BIT_MASK 0xF /end MEASUREMENT
/begin MEASUREMENT fmy_ram_dyn[7].dtc_cod "" UWORD _CNV_A_R_LINEAR_____22_CM 1 100. 0. 65535. DISPLAY_IDENTIFIER DTC_COD_7 ECU_ADDRESS 0x3fb7d2 BYTE_ORDER MSB_LAST FORMAT "%6.0" /end MEASUREMENT
/begin MEASUREMENT fmy_ram_dyn[7].err_info_dyn.bit_0_3 "" UWORD _CNV_S_6_RANGE_ERR__337_CM 1 100. 0. 15. DISPLAY_IDENTIFIER ERR_SYM_MEM_7 ECU_ADDRESS 0x3fb7d6 BYTE_ORDER MSB_LAST BIT_MASK 0xF /end MEASUREMENT
/begin MEASUREMENT fmy_ram_dyn[8].dtc_cod "" UWORD _CNV_A_R_LINEAR_____22_CM 1 100. 0. 65535. DISPLAY_IDENTIFIER DTC_COD_8 ECU_ADDRESS 0x3fb7dc BYTE_ORDER MSB_LAST FORMAT "%6.0" /end MEASUREMENT
/begin MEASUREMENT fmy_ram_dyn[8].err_info_dyn.bit_0_3 "" UWORD _CNV_S_6_RANGE_ERR__337_CM 1 100. 0. 15. DISPLAY_IDENTIFIER ERR_SYM_MEM_8 ECU_ADDRESS 0x3fb7e0 BYTE_ORDER MSB_LAST BIT_MASK 0xF /end MEASUREMENT
/begin MEASUREMENT fmy_ram_dyn[9].dtc_cod "" UWORD _CNV_A_R_LINEAR_____22_CM 1 100. 0. 65535. DISPLAY_IDENTIFIER DTC_COD_9 ECU_ADDRESS 0x3fb7e6 BYTE_ORDER MSB_LAST FORMAT "%6.0" /end MEASUREMENT
/begin MEASUREMENT fmy_ram_dyn[9].err_info_dyn.bit_0_3 "" UWORD _CNV_S_6_RANGE_ERR__337_CM 1 100. 0. 15. DISPLAY_IDENTIFIER ERR_SYM_MEM_9 ECU_ADDRESS 0x3fb7ea BYTE_ORDER MSB_LAST BIT_MASK 0xF /end MEASUREMENT
/begin CHARACTERISTIC id_err_dtc_mis "DTC table declaration for diagnosis misfiring" MAP 0xffe48734 _REC_MAP_20_u2_u2_u2 65535. _CNV_A_R_LINEAR_____0_CM 0. 65535. DISPLAY_IDENTIFIER ID_ERR_DTC_MIS FORMAT "%5.0"
 /begin AXIS_DESCR COM_AXIS online_dummy _CNV_A_R_LINEAR_____0_CM 2 0. 65535. FORMAT "%5.0" AXIS_PTS_REF ldp_1_id_err_dtc_mis /end AXIS_DESCR
 /begin AXIS_DESCR COM_AXIS online_dummy _CNV_A_R_LINEAR_____0_CM 8 0. 65535. FORMAT "%5.0" AXIS_PTS_REF ldp_2_id_err_dtc_mis /end AXIS_DESCR
/end CHARACTERISTIC
/begin AXIS_PTS ldp_2_id_err_dtc_mis "" 0xffe5093a online_dummy _REC_AXS_20_u2 65535. _CNV_A_R_LINEAR_____0_CM 8 0. 65535. DISPLAY_IDENTIFIER LDP_2_ID_ERR_DTC_MIS FORMAT "%5.0" /end AXIS_PTS
/begin AXIS_PTS ldp_1_id_err_dtc_mis "" 0xffe41d08 online_dummy _REC_AXS_20_u2 65535. _CNV_A_R_LINEAR_____0_CM 2 0. 65535. DISPLAY_IDENTIFIER LDP_1_ID_ERR_DTC_MIS FORMAT "%5.0" /end AXIS_PTS
/begin AXIS_PTS ldpm_clas_a_id_clas_fmy "" 0xffe51778 online_dummy _REC_AXS_20_u2 65535. _CNV_A_R_LINEAR_____0_CM 16 0. 65535. DISPLAY_IDENTIFIER LDPM_CLAS_A_ID_CLAS_FMY FORMAT "%5.0" /end AXIS_PTS
/begin AXIS_PTS ldp_clas_b_id_clas_fmy "" 0xffe50aa8 online_dummy _REC_AXS_20_u2 65535. _CNV_A_R_LINEAR_____0_CM 4 0. 65535. DISPLAY_IDENTIFIER LDP_CLAS_B_ID_CLAS_FMY FORMAT "%5.0" /end AXIS_PTS
/begin AXIS_PTS ldp_fmy_dtc "" 0xffe50bd0 online_dummy _REC_AXS_20_u2 5. _CNV_A_R_LINEAR_____22_CM 6 0. 5. DISPLAY_IDENTIFIER LDP_FMY_DTC FORMAT "%2.0" /end AXIS_PTS
/begin COMPU_METHOD _CNV_A_R_LINEAR_____0_CM "" RAT_FUNC "%6.3" "-" COEFFS 0 1. 0. 0 0 1 /end COMPU_METHOD
/begin COMPU_METHOD _CNV_S_2_RANGE______1_R_CM "" TAB_VERB "%6.3" "[-]" COMPU_TAB_REF _CNV_S_2_RANGE______1_R /end COMPU_METHOD
/begin COMPU_VTAB_RANGE _CNV_S_2_RANGE______1_R "" 2 0 0 "0" 1 255 "1" /end COMPU_VTAB_RANGE
/begin COMPU_METHOD _CNV_S_2_RANGE______2_CM "" TAB_VERB "%6.3" "[-]" COMPU_TAB_REF _CNV_S_2_RANGE______2 /end COMPU_METHOD
/begin COMPU_VTAB _CNV_S_2_RANGE______2 "" TAB_VERB 2 0 "0" 1 "1" /end COMPU_VTAB
/begin COMPU_METHOD _CNV_A_R_LINEAR_____3_CM "" RAT_FUNC "%6.3" "V" COEFFS 0 204.7999998974999 0. 0 0 1 /end COMPU_METHOD
/begin COMPU_METHOD _CNV_A_R_LINEAR_____11_CM "" RAT_FUNC "%6.3" "°C" COEFFS 0 1.333333333333333 64. 0 0 1 /end COMPU_METHOD
/begin COMPU_METHOD _CNV_A_R_LINEAR_____22_CM "" RAT_FUNC "%6.3" "[-]" COEFFS 0 1. 0. 0 0 1 /end COMPU_METHOD
/begin COMPU_METHOD _CNV_A_R_LINEAR_____24_CM "" RAT_FUNC "%6.3" "s" COEFFS 0 10. 0. 0 0 1 /end COMPU_METHOD
/begin COMPU_METHOD _CNV_S_2_RANGE______192_CM "" TAB_VERB "%6.3" "[-]" COMPU_TAB_REF _CNV_S_2_RANGE______192 /end COMPU_METHOD
/begin COMPU_VTAB _CNV_S_2_RANGE______192 "" TAB_VERB 2 0 "PASSIVE" 1 "ACTIVE" /end COMPU_VTAB
/begin COMPU_METHOD _CNV_A_R_LINEAR_____206_CM "" RAT_FUNC "%6.3" "-" COEFFS 0 1023.999999919998 0. 0 0 1 /end COMPU_METHOD
/begin COMPU_METHOD _CNV_A_R_LINEAR_____287_CM "" RAT_FUNC "%6.3" "g" COEFFS 0 36.00036915004301 0. 0 0 1 /end COMPU_METHOD
/begin COMPU_METHOD _CNV_A_R_LINEAR_____290_CM "" RAT_FUNC "%6.3" "-" COEFFS 0 1024.001799030612 2.248788264580526e-004 0 0 1 /end COMPU_METHOD
/begin COMPU_METHOD _CNV_A_R_LINEAR_____319_CM "" RAT_FUNC "%6.3" "-" COEFFS 0 1023.999999959999 -1.818989403545857e-011 0 0 1 /end COMPU_METHOD
/begin COMPU_METHOD _CNV_S_4_RANGE_STAT_320_CM "" TAB_VERB "%6.3" "[-]" COMPU_TAB_REF _CNV_S_4_RANGE_STAT_320 /end COMPU_METHOD
/begin COMPU_VTAB _CNV_S_4_RANGE_STAT_320 "" TAB_VERB 4 0 "BEGIN" 1 "RICH CHECK" 2 "LEAN CHECK" 3 "CHECK FINISHED" /end COMPU_VTAB
/begin COMPU_METHOD _CNV_S_6_RANGE_ERR__337_CM "" TAB_VERB "%6.3" "[-]" COMPU_TAB_REF _CNV_S_6_RANGE_ERR__337 /end COMPU_METHOD
/begin COMPU_VTAB _CNV_S_6_RANGE_ERR__337 "" TAB_VERB 6 0 "NO_SYM" 1 "SYM_0" 2 "SYM_1" 4 "SYM_2" 8 "SYM_3" 15 "BENCH_MODE" /end COMPU_VTAB
/begin RECORD_LAYOUT _REC_VAL_20_u1 FNC_VALUES 1 UBYTE COLUMN_DIR DIRECT /end RECORD_LAYOUT
/begin RECORD_LAYOUT _REC_VAL_20_u2 FNC_VALUES 1 UWORD COLUMN_DIR DIRECT /end RECORD_LAYOUT
/begin RECORD_LAYOUT _REC_AXS_20_u2 NO_AXIS_PTS_X 1 UWORD AXIS_PTS_X 2 UWORD INDEX_INCR DIRECT /end RECORD_LAYOUT
/begin RECORD_LAYOUT _REC_CUR_20_u1_u2 FNC_VALUES 1 UBYTE COLUMN_DIR DIRECT /end RECORD_LAYOUT
/begin RECORD_LAYOUT _REC_CUR_20_u2_u2 FNC_VALUES 1 UWORD COLUMN_DIR DIRECT /end RECORD_LAYOUT
/begin RECORD_LAYOUT _REC_MAP_20_u1_u2_u2 FNC_VALUES 1 UBYTE COLUMN_DIR DIRECT /end RECORD_LAYOUT
/begin RECORD_LAYOUT _REC_MAP_20_u2_u2_u2 FNC_VALUES 1 UWORD COLUMN_DIR DIRECT /end RECORD_LAYOUT
/begin FUNCTION OBD_Failure_class "_Failure class"
 /begin DEF_CHARACTERISTIC id_clas_b_fmt id_clas_a_fmt fmy_id_toil.c_err_clas fmy_id_tco_ex.c_err_clas fmy_id_tia.c_err_clas fmy_id_amp.c_err_clas fmy_id_maf.c_err_clas fmy_id_vls_down_max_1.c_err_clas fmy_id_vls_down_max_2.c_err_clas fmy_id_vls_down_min_cold_1.c_err_clas fmy_id_vls_down_min_cold_2.c_err_clas fmy_id_vls_down_min_1.c_err_clas fmy_id_vls_down_min_2.c_err_clas fmy_id_vls_down_oc_1.c_err_clas fmy_id_vls_down_oc_2.c_err_clas fmy_id_iv_0.c_err_clas fmy_id_iv_1.c_err_clas fmy_id_iv_2.c_err_clas fmy_id_iv_3.c_err_clas fmy_id_iv_4.c_err_clas fmy_id_iv_5.c_err_clas fmy_id_lsh_up_1.c_err_clas fmy_id_lsh_up_2.c_err_clas fmy_id_lsh_down_1.c_err_clas fmy_id_lsh_down_2.c_err_clas fmy_id_rly_efp.c_err_clas fmy_id_cps.c_err_clas fmy_id_mec_ivvt_in_1.c_err_clas fmy_id_mec_ivvt_ex_1.c_err_clas fmy_id_ref_ivvt_in_1.c_err_clas fmy_id_ref_ivvt_ex_1.c_err_clas fmy_id_slv_ivvt_in_1.c_err_clas fmy_id_slv_ivvt_ex_1.c_err_clas fmy_id_park_ivvt_in_1.c_err_clas fmy_id_park_ivvt_ex_1.c_err_clas fmy_id_ecu_cks.c_err_clas fmy_id_toil_level.c_err_clas fmy_id_tout_etcu_1.c_err_clas fmy_id_tout_etcu_2.c_err_clas fmy_id_tout_icl_2.c_err_clas fmy_id_tout_icl_3.c_err_clas fmy_id_tout_asr_1.c_err_clas fmy_id_tout_asr_3.c_err_clas fmy_id_tout_asr_4.c_err_clas fmy_id_tout_pste_1.c_err_clas fmy_id_tout_amt_1.c_err_clas fmy_id_vs.c_err_clas fmy_id_knks_1.c_err_clas fmy_id_knks_2.c_err_clas fmy_id_td_igc_cut_0.c_err_clas fmy_id_td_igc_cut_1.c_err_clas fmy_id_td_igc_cut_2.c_err_clas fmy_id_td_igc_cut_3.c_err_clas fmy_id_td_igc_cut_4.c_err_clas fmy_id_td_igc_cut_5.c_err_clas fmy_id_dur_igc_0.c_err_clas fmy_id_dur_igc_1.c_err_clas fmy_id_dur_igc_2.c_err_clas fmy_id_dur_igc_3.c_err_clas fmy_id_dur_igc_4.c_err_clas fmy_id_dur_igc_5.c_err_clas fmy_id_tps_1.c_err_clas fmy_id_tps_2.c_err_clas fmy_id_tps_maf_1.c_err_clas fmy_id_tps_maf_2.c_err_clas fmy_id_v_ref_1.c_err_clas fmy_id_v_ref_2.c_err_clas fmy_id_pvs_1.c_err_clas fmy_id_pvs_2.c_err_clas fmy_id_pvs_ratio.c_err_clas fmy_id_pvs_double.c_err_clas fmy_id_pvs_bls_not_plaus.c_err_clas fmy_id_mtc_dr.c_err_clas fmy_id_mtc_ctl_1.c_err_clas fmy_id_mtc_ctl_2.c_err_clas fmy_id_mtc_ctl_3.c_err_clas fmy_id_tps_ad.c_err_clas fmy_id_tps_ad_bol.c_err_clas fmy_id_tps_st_chk_1.c_err_clas fmy_id_tps_st_chk_2.c_err_clas fmy_id_gen.c_err_clas fmy_id_gen_if.c_err_clas fmy_id_gen_diag.c_err_clas fmy_id_vim.c_err_clas fmy_id_cam_per_0.c_err_clas fmy_id_cam_per_1.c_err_clas fmy_id_cam_psn_0.c_err_clas fmy_id_cam_psn_1.c_err_clas fmy_id_cam_0_not_plaus.c_err_clas fmy_id_cam_1_not_plaus.c_err_clas fmy_id_eng_psn.c_err_clas fmy_id_tooth_per.c_err_clas fmy_id_tpu_syn.c_err_clas fmy_id_crk_not_plaus.c_err_clas fmy_id_tout_txu_1.c_err_clas fmy_id_can_boff.c_err_clas fmy_id_rly_main.c_err_clas fmy_id_rly_main_dly.c_err_clas fmy_id_rly_accout.c_err_clas fmy_id_sap.c_err_clas fmy_id_sav.c_err_clas fmy_id_ecf.c_err_clas fmy_id_tco_plaus.c_err_clas fmy_id_tco_el.c_err_clas fmy_id_tco_grd.c_err_clas fmy_id_tco_stuck.c_err_clas fmy_id_ect_el.c_err_clas fmy_id_ect_mec.c_err_clas fmy_id_isc.c_err_clas fmy_id_im_bls_plaus.c_err_clas fmy_id_im_bts_plaus.c_err_clas fmy_id_msw_tog.c_err_clas fmy_id_msw_2.c_err_clas fmy_id_msw_3.c_err_clas fmy_id_isa_1.c_err_clas fmy_id_isa_2.c_err_clas fmy_id_seg_t_ad.c_err_clas fmy_id_seg_t.c_err_clas fmy_id_mis_0.c_err_clas fmy_id_mis_1.c_err_clas fmy_id_mis_2.c_err_clas fmy_id_mis_3.c_err_clas fmy_id_mis_4.c_err_clas fmy_id_mis_5.c_err_clas fmy_id_mis_low_fuel.c_err_clas fmy_id_mis_mpl.c_err_clas fmy_id_conv_mon_1.c_err_clas fmy_id_n_32_mon_1.c_err_clas fmy_id_pvs_mon_1.c_err_clas fmy_id_maf_tps_mon_1.c_err_clas fmy_id_tq_dif_isc_mon_1.c_err_clas fmy_id_tq_req_mon_1.c_err_clas fmy_id_tq_ext_mon_1.c_err_clas fmy_id_tqi_av_mon_1.c_err_clas fmy_id_tqi_n_max_mon_1.c_err_clas fmy_id_cru_inh_mon_1.c_err_clas fmy_id_tqi_n_max_nvmy_mon.c_err_clas fmy_id_sa_safm.c_err_clas fmy_id_sa_sap.c_err_clas fmy_id_sa_sys.c_err_clas fmy_id_sa_sav.c_err_clas fmy_id_imob_1.c_err_clas fmy_id_imob_2.c_err_clas fmy_id_imob_3.c_err_clas fmy_id_fsd_1.c_err_clas fmy_id_fsd_2.c_err_clas fmy_id_ls_down_swt_1.c_err_clas fmy_id_ls_down_swt_2.c_err_clas fmy_id_ls_down_pue_1.c_err_clas fmy_id_ls_down_pue_2.c_err_clas fmy_id_ef.c_err_clas fmy_id_tecu.c_err_clas fmy_id_ebox_cfa.c_err_clas fmy_id_ecu_ram.c_err_clas fmy_id_tqi_lim.c_err_clas fmy_id_obd2_lsh_down_1.c_err_clas fmy_id_obd2_lsh_down_2.c_err_clas fmy_id_dmtls.c_err_clas fmy_id_dmtl_pump.c_err_clas fmy_id_dmtlm.c_err_clas fmy_id_dmtl_leak.c_err_clas fmy_id_sof.c_err_clas fmy_id_sof_req.c_err_clas fmy_id_rly_st.c_err_clas fmy_id_bsd.c_err_clas fmy_id_poil_swi.c_err_clas fmy_id_tout_efp.c_err_clas fmy_id_diagcps.c_err_clas fmy_id_tq_gs_inc_plaus.c_err_clas fmy_id_dcc.c_err_clas fmy_id_ecras.c_err_clas fmy_id_dmtlh.c_err_clas fmy_id_cs.c_err_clas fmy_id_spi_mps.c_err_clas fmy_id_spi_knk.c_err_clas fmy_id_bn_tq_dcc.c_err_clas fmy_id_bn_tq_pste_2.c_err_clas fmy_id_bn_ars.c_err_clas fmy_id_bn_cas.c_err_clas fmy_id_bn_tq_tcs.c_err_clas fmy_id_bn_vs_tcs.c_err_clas fmy_id_bn_tcs.c_err_clas fmy_id_bn_tq_etcu.c_err_clas fmy_id_bn_etcu.c_err_clas fmy_id_bn_tq_amt.c_err_clas fmy_id_bn_acc.c_err_clas fmy_id_bn_t_icl.c_err_clas fmy_id_bn_veh_mod.c_err_clas fmy_id_bn_km_icl.c_err_clas fmy_id_bn_icl.c_err_clas fmy_id_bn_pow_vb.c_err_clas fmy_id_bn_pow_gen.c_err_clas fmy_id_bn_msw.c_err_clas fmy_id_bn_ang_pste.c_err_clas fmy_id_bn_efp.c_err_clas fmy_id_load_tps_plaus.c_err_clas fmy_id_efp_crash.c_err_clas fmy_id_efp.c_err_clas fmy_id_locan_boff.c_err_clas fmy_id_chg_ls_up.c_err_clas fmy_id_chg_ls_down.c_err_clas fmy_id_qoil_sens.c_err_clas fmy_id_bat_sens.c_err_clas fmy_id_bat_sens_it.c_err_clas fmy_id_bat_sens_it_el.c_err_clas fmy_id_ecu_nvmy.c_err_clas fmy_id_gs.c_err_clas fmy_id_o3_conc.c_err_clas fmy_id_ls_up_shift_afl_1.c_err_clas fmy_id_ls_up_shift_afl_2.c_err_clas fmy_id_ls_up_shift_afr_1.c_err_clas fmy_id_ls_up_shift_afr_2.c_err_clas fmy_id_oc_lsl_1.c_err_clas fmy_id_oc_lsl_2.c_err_clas fmy_id_cat_diag_1.c_err_clas fmy_id_cat_diag_2.c_err_clas fmy_id_el_lsl_1.c_err_clas fmy_id_el_lsl_2.c_err_clas fmy_id_cat_diag_nox_1.c_err_clas fmy_id_cat_diag_nox_2.c_err_clas fmy_id_vls_down_puc_1.c_err_clas fmy_id_vls_down_puc_2.c_err_clas fmy_id_vls_down_fl_1.c_err_clas fmy_id_vls_down_fl_2.c_err_clas fmy_id_chk_ls_down_1.c_err_clas fmy_id_chk_ls_down_2.c_err_clas fmy_id_delta_lamb_i_1.c_err_clas fmy_id_delta_lamb_i_2.c_err_clas fmy_id_o3_up.c_err_clas fmy_id_o3_down.c_err_clas fmy_id_obd2_ttip_ls_up_1.c_err_clas fmy_id_obd2_ttip_ls_up_2.c_err_clas fmy_id_lsh_ls_up_1.c_err_clas fmy_id_lsh_ls_up_2.c_err_clas fmy_id_vls_up_thd_over_1.c_err_clas fmy_id_vls_up_thd_over_2.c_err_clas fmy_id_tout_nox_sens_1.c_err_clas fmy_id_nox_sens_1.c_err_clas fmy_id_tout_nox_sens_2.c_err_clas fmy_id_nox_sens_2.c_err_clas fmy_id_if_lsl_1.c_err_clas fmy_id_if_lsl_2.c_err_clas fmy_id_ls_up_dyn_vld_1.c_err_clas fmy_id_ls_up_dyn_vld_2.c_err_clas fmy_id_ls_up_puc_vld_1.c_err_clas fmy_id_ls_up_puc_vld_2.c_err_clas fmy_id_lsh_up_obd2_vld_1.c_err_clas fmy_id_lsh_up_obd2_vld_2.c_err_clas fmy_id_nox_sens_htp_1.c_err_clas fmy_id_nox_sens_plaus_1.c_err_clas fmy_id_nox_sens_avl_1.c_err_clas fmy_id_nox_sens_dyn_1.c_err_clas fmy_id_nox_sens_ref_air_1.c_err_clas fmy_id_nox_sens_htp_2.c_err_clas fmy_id_nox_sens_plaus_2.c_err_clas fmy_id_nox_sens_avl_2.c_err_clas fmy_id_nox_sens_dyn_2.c_err_clas fmy_id_nox_sens_ref_air_2.c_err_clas /end DEF_CHARACTERISTIC
/end FUNCTION
/begin FUNCTION OBD_Diagnostic_Trouble_Code "_Diagnostic Trouble Code"
 /begin DEF_CHARACTERISTIC fmy_id_toil.dtc fmy_id_tco_ex.dtc fmy_id_tia.dtc fmy_id_amp.dtc fmy_id_maf.dtc fmy_id_vls_down_max_1.dtc fmy_id_vls_down_max_2.dtc fmy_id_vls_down_min_cold_1.dtc fmy_id_vls_down_min_cold_2.dtc fmy_id_vls_down_min_1.dtc fmy_id_vls_down_min_2.dtc fmy_id_vls_down_oc_1.dtc fmy_id_vls_down_oc_2.dtc fmy_id_iv_0.dtc fmy_id_iv_1.dtc fmy_id_iv_2.dtc fmy_id_iv_3.dtc fmy_id_iv_4.dtc fmy_id_iv_5.dtc fmy_id_lsh_up_1.dtc fmy_id_lsh_up_2.dtc fmy_id_lsh_down_1.dtc fmy_id_lsh_down_2.dtc fmy_id_rly_efp.dtc fmy_id_cps.dtc fmy_id_mec_ivvt_in_1.dtc fmy_id_mec_ivvt_ex_1.dtc fmy_id_ref_ivvt_in_1.dtc fmy_id_ref_ivvt_ex_1.dtc fmy_id_slv_ivvt_in_1.dtc fmy_id_slv_ivvt_ex_1.dtc fmy_id_park_ivvt_in_1.dtc fmy_id_park_ivvt_ex_1.dtc fmy_id_ecu_cks.dtc fmy_id_toil_level.dtc fmy_id_tout_etcu_1.dtc fmy_id_tout_etcu_2.dtc fmy_id_tout_icl_2.dtc fmy_id_tout_icl_3.dtc fmy_id_tout_asr_1.dtc fmy_id_tout_asr_3.dtc fmy_id_tout_asr_4.dtc fmy_id_tout_pste_1.dtc fmy_id_tout_amt_1.dtc fmy_id_vs.dtc fmy_id_knks_1.dtc fmy_id_knks_2.dtc fmy_id_td_igc_cut_0.dtc fmy_id_td_igc_cut_1.dtc fmy_id_td_igc_cut_2.dtc fmy_id_td_igc_cut_3.dtc fmy_id_td_igc_cut_4.dtc fmy_id_td_igc_cut_5.dtc fmy_id_dur_igc_0.dtc fmy_id_dur_igc_1.dtc fmy_id_dur_igc_2.dtc fmy_id_dur_igc_3.dtc fmy_id_dur_igc_4.dtc fmy_id_dur_igc_5.dtc fmy_id_tps_1.dtc fmy_id_tps_2.dtc fmy_id_tps_maf_1.dtc fmy_id_tps_maf_2.dtc fmy_id_v_ref_1.dtc fmy_id_v_ref_2.dtc fmy_id_pvs_1.dtc fmy_id_pvs_2.dtc fmy_id_pvs_ratio.dtc fmy_id_pvs_double.dtc fmy_id_pvs_bls_not_plaus.dtc fmy_id_mtc_dr.dtc fmy_id_mtc_ctl_1.dtc fmy_id_mtc_ctl_2.dtc fmy_id_mtc_ctl_3.dtc fmy_id_tps_ad.dtc fmy_id_tps_ad_bol.dtc fmy_id_tps_st_chk_1.dtc fmy_id_tps_st_chk_2.dtc fmy_id_gen.dtc fmy_id_gen_if.dtc fmy_id_gen_diag.dtc fmy_id_vim.dtc fmy_id_cam_per_0.dtc fmy_id_cam_per_1.dtc fmy_id_cam_psn_0.dtc fmy_id_cam_psn_1.dtc fmy_id_cam_0_not_plaus.dtc fmy_id_cam_1_not_plaus.dtc fmy_id_eng_psn.dtc fmy_id_tooth_per.dtc fmy_id_tpu_syn.dtc fmy_id_crk_not_plaus.dtc fmy_id_tout_txu_1.dtc fmy_id_can_boff.dtc fmy_id_rly_main.dtc fmy_id_rly_main_dly.dtc fmy_id_rly_accout.dtc fmy_id_sap.dtc fmy_id_sav.dtc fmy_id_ecf.dtc fmy_id_tco_plaus.dtc fmy_id_tco_el.dtc fmy_id_tco_grd.dtc fmy_id_tco_stuck.dtc fmy_id_ect_el.dtc fmy_id_ect_mec.dtc fmy_id_isc.dtc fmy_id_im_bls_plaus.dtc fmy_id_im_bts_plaus.dtc fmy_id_msw_tog.dtc fmy_id_msw_2.dtc fmy_id_msw_3.dtc fmy_id_isa_1.dtc fmy_id_isa_2.dtc fmy_id_seg_t_ad.dtc fmy_id_seg_t.dtc fmy_id_mis_0.dtc fmy_id_mis_1.dtc fmy_id_mis_2.dtc fmy_id_mis_3.dtc fmy_id_mis_4.dtc fmy_id_mis_5.dtc fmy_id_mis_low_fuel.dtc fmy_id_mis_mpl.dtc fmy_id_conv_mon_1.dtc fmy_id_n_32_mon_1.dtc fmy_id_pvs_mon_1.dtc fmy_id_maf_tps_mon_1.dtc fmy_id_tq_dif_isc_mon_1.dtc fmy_id_tq_req_mon_1.dtc fmy_id_tq_ext_mon_1.dtc fmy_id_tqi_av_mon_1.dtc fmy_id_tqi_n_max_mon_1.dtc fmy_id_cru_inh_mon_1.dtc fmy_id_tqi_n_max_nvmy_mon.dtc fmy_id_sa_safm.dtc fmy_id_sa_sap.dtc fmy_id_sa_sys.dtc fmy_id_sa_sav.dtc fmy_id_imob_1.dtc fmy_id_imob_2.dtc fmy_id_imob_3.dtc fmy_id_fsd_1.dtc fmy_id_fsd_2.dtc fmy_id_ls_down_swt_1.dtc fmy_id_ls_down_swt_2.dtc fmy_id_ls_down_pue_1.dtc fmy_id_ls_down_pue_2.dtc fmy_id_ef.dtc fmy_id_tecu.dtc fmy_id_ebox_cfa.dtc fmy_id_ecu_ram.dtc fmy_id_tqi_lim.dtc fmy_id_obd2_lsh_down_1.dtc fmy_id_obd2_lsh_down_2.dtc fmy_id_dmtls.dtc fmy_id_dmtl_pump.dtc fmy_id_dmtlm.dtc fmy_id_dmtl_leak.dtc fmy_id_sof.dtc fmy_id_sof_req.dtc fmy_id_rly_st.dtc fmy_id_bsd.dtc fmy_id_poil_swi.dtc fmy_id_tout_efp.dtc fmy_id_diagcps.dtc fmy_id_tq_gs_inc_plaus.dtc fmy_id_dcc.dtc fmy_id_ecras.dtc fmy_id_dmtlh.dtc fmy_id_cs.dtc fmy_id_spi_mps.dtc fmy_id_spi_knk.dtc fmy_id_bn_tq_dcc.dtc fmy_id_bn_tq_pste_2.dtc fmy_id_bn_ars.dtc fmy_id_bn_cas.dtc fmy_id_bn_tq_tcs.dtc fmy_id_bn_vs_tcs.dtc fmy_id_bn_tcs.dtc fmy_id_bn_tq_etcu.dtc fmy_id_bn_etcu.dtc fmy_id_bn_tq_amt.dtc fmy_id_bn_acc.dtc fmy_id_bn_t_icl.dtc fmy_id_bn_veh_mod.dtc fmy_id_bn_km_icl.dtc fmy_id_bn_icl.dtc fmy_id_bn_pow_vb.dtc fmy_id_bn_pow_gen.dtc fmy_id_bn_msw.dtc fmy_id_bn_ang_pste.dtc fmy_id_bn_efp.dtc fmy_id_load_tps_plaus.dtc fmy_id_efp_crash.dtc fmy_id_efp.dtc fmy_id_locan_boff.dtc fmy_id_chg_ls_up.dtc fmy_id_chg_ls_down.dtc fmy_id_qoil_sens.dtc fmy_id_bat_sens.dtc fmy_id_bat_sens_it.dtc fmy_id_bat_sens_it_el.dtc fmy_id_ecu_nvmy.dtc fmy_id_gs.dtc fmy_id_o3_conc.dtc fmy_id_ls_up_shift_afl_1.dtc fmy_id_ls_up_shift_afl_2.dtc fmy_id_ls_up_shift_afr_1.dtc fmy_id_ls_up_shift_afr_2.dtc fmy_id_oc_lsl_1.dtc fmy_id_oc_lsl_2.dtc fmy_id_cat_diag_1.dtc fmy_id_cat_diag_2.dtc fmy_id_el_lsl_1.dtc fmy_id_el_lsl_2.dtc fmy_id_cat_diag_nox_1.dtc fmy_id_cat_diag_nox_2.dtc fmy_id_vls_down_puc_1.dtc fmy_id_vls_down_puc_2.dtc fmy_id_vls_down_fl_1.dtc fmy_id_vls_down_fl_2.dtc fmy_id_chk_ls_down_1.dtc fmy_id_chk_ls_down_2.dtc fmy_id_delta_lamb_i_1.dtc fmy_id_delta_lamb_i_2.dtc fmy_id_o3_up.dtc fmy_id_o3_down.dtc fmy_id_obd2_ttip_ls_up_1.dtc fmy_id_obd2_ttip_ls_up_2.dtc fmy_id_lsh_ls_up_1.dtc fmy_id_lsh_ls_up_2.dtc fmy_id_vls_up_thd_over_1.dtc fmy_id_vls_up_thd_over_2.dtc fmy_id_tout_nox_sens_1.dtc fmy_id_nox_sens_1.dtc fmy_id_tout_nox_sens_2.dtc fmy_id_nox_sens_2.dtc fmy_id_if_lsl_1.dtc fmy_id_if_lsl_2.dtc fmy_id_ls_up_dyn_vld_1.dtc fmy_id_ls_up_dyn_vld_2.dtc fmy_id_ls_up_puc_vld_1.dtc fmy_id_ls_up_puc_vld_2.dtc fmy_id_lsh_up_obd2_vld_1.dtc fmy_id_lsh_up_obd2_vld_2.dtc fmy_id_nox_sens_htp_1.dtc fmy_id_nox_sens_plaus_1.dtc fmy_id_nox_sens_avl_1.dtc fmy_id_nox_sens_dyn_1.dtc fmy_id_nox_sens_ref_air_1.dtc fmy_id_nox_sens_htp_2.dtc fmy_id_nox_sens_plaus_2.dtc fmy_id_nox_sens_avl_2.dtc fmy_id_nox_sens_dyn_2.dtc fmy_id_nox_sens_ref_air_2.dtc id_err_dtc_mis /end DEF_CHARACTERISTIC
 /begin OUT_MEASUREMENT fmy_ram_dyn[0].dtc_cod fmy_ram_dyn[0].err_info_dyn.bit_0_3 fmy_ram_dyn[1].dtc_cod fmy_ram_dyn[1].err_info_dyn.bit_0_3 fmy_ram_dyn[2].dtc_cod fmy_ram_dyn[2].err_info_dyn.bit_0_3 fmy_ram_dyn[3].dtc_cod fmy_ram_dyn[3].err_info_dyn.bit_0_3 fmy_ram_dyn[4].dtc_cod fmy_ram_dyn[4].err_info_dyn.bit_0_3 fmy_ram_dyn[5].dtc_cod fmy_ram_dyn[5].err_info_dyn.bit_0_3 fmy_ram_dyn[6].dtc_cod fmy_ram_dyn[6].err_info_dyn.bit_0_3 fmy_ram_dyn[7].dtc_cod fmy_ram_dyn[7].err_info_dyn.bit_0_3 fmy_ram_dyn[8].dtc_cod fmy_ram_dyn[8].err_info_dyn.bit_0_3 fmy_ram_dyn[9].dtc_cod fmy_ram_dyn[9].err_info_dyn.bit_0_3 /end OUT_MEASUREMENT
/end FUNCTION
/begin FUNCTION OBD_Cycle_manager "_Cycle manager" /begin DEF_CHARACTERISTIC c_tco_wup_thd c_tco_wup_inc /end DEF_CHARACTERISTIC /begin OUT_MEASUREMENT lv_dc lv_wup_cyc lv_state_wup /end OUT_MEASUREMENT /end FUNCTION
/begin FUNCTION OBD_Oxygen_Sensor_Active_Plausib "_Oxygen Sensor Active Plausibility Check"
 /begin DEF_CHARACTERISTIC c_maf_int_min_chk_ls_up_down c_maf_int_chk_ls_up_down_eol c_t_max_chk_ls_up_down_afr c_t_max_chk_ls_up_down_afl c_t_chk_ls_up_down_eol c_chk_ls_up_afl c_chk_ls_up_afr c_chk_ls_down_afr c_chk_ls_down_afl c_lamb_sp_ls_act_test_afr c_lamb_sp_ls_act_test_afl c_lamb_min_ls_act_test_afr c_lamb_min_ls_act_test_afl c_lamb_max_ls_act_test_afr c_lamb_max_ls_act_test_afl c_step_lamb_sp_ls_act_test c_abc_inc_chk_ls_up c_abc_max_chk_ls_up c_ctr_sum_rst_chk_ls_up /end DEF_CHARACTERISTIC
 /begin OUT_MEASUREMENT lam_bank_1.ls_act_chk_pl.bf.lv_end_chk_ls_up_down lam_bank_1.ls_act_chk_pl.bf.lv_cdn_chk_ls_up_down_afr lam_bank_1.ls_act_chk_pl.bf.lv_cdn_chk_ls_up_down_afl lam_bank_1.ls_act_chk_pl.bf.lv_set_lamb_sp_act_test_afr lam_bank_1.ls_act_chk_pl.bf.lv_set_lamb_sp_act_test_afl lam_bank_1.ls_act_chk_pl.bf.lv_req_lamb_sp_ls_act_test lam_bank_1.ls_act_chk_pl.bf.lv_sym_chk_ls_up_afr lam_bank_1.ls_act_chk_pl.bf.lv_sym_chk_ls_up_afl lam_bank_1.ls_act_chk_pl.bf.sym_chk_ls_up_afl lam_bank_1.ls_act_chk_pl.bf.sym_chk_ls_up_afr lam_bank_1.ls_act_chk_pl.maf_int_chk_ls_up_down lam_bank_1.ls_act_chk_pl.lamb_sp_beg_ls_act_test lam_bank_1.ls_act_chk_pl.t_chk_ls_up_down_afr lam_bank_1.ls_act_chk_pl.t_chk_ls_up_down_afl lam_bank_1.ls_act_chk_pl.delta_lamb_sp_ls_act_test lam_bank_1.ls_act_chk_pl.lamb_sp_ls_act_test lam_bank_1.ls_act_chk_pl.state_chk_ls_up_down lam_bank_1.ls_act_chk_pl.ctr_sum_rst_chk_ls_up_afr lam_bank_1.ls_act_chk_pl.ctr_sum_rst_chk_ls_up_afl lam_bank_1.ls_act_chk_pl.ctr_chk_ls_up_afl lam_bank_1.ls_act_chk_pl.ctr_chk_ls_up_afr lam_bank_1.ls_act_chk_pl.delta_step_lamb_sp_ls_act_test lam_bank_1.ls_act_chk_pl_inci.bf.lv_inh_chk_ls_up_down lam_bank_1.ls_act_chk_pl_inci.bf.lv_inh_chk_ls_up_down_afr lam_bank_1.ls_act_chk_pl_inci.bf.lv_inh_chk_ls_up_down_afl lam_bank_2.ls_act_chk_pl.bf.lv_end_chk_ls_up_down lam_bank_2.ls_act_chk_pl.bf.lv_cdn_chk_ls_up_down_afr lam_bank_2.ls_act_chk_pl.bf.lv_cdn_chk_ls_up_down_afl lam_bank_2.ls_act_chk_pl.bf.lv_set_lamb_sp_act_test_afr lam_bank_2.ls_act_chk_pl.bf.lv_set_lamb_sp_act_test_afl lam_bank_2.ls_act_chk_pl.bf.lv_req_lamb_sp_ls_act_test lam_bank_2.ls_act_chk_pl.bf.lv_sym_chk_ls_up_afr lam_bank_2.ls_act_chk_pl.bf.lv_sym_chk_ls_up_afl lam_bank_2.ls_act_chk_pl.bf.sym_chk_ls_up_afl lam_bank_2.ls_act_chk_pl.bf.sym_chk_ls_up_afr lam_bank_2.ls_act_chk_pl.maf_int_chk_ls_up_down lam_bank_2.ls_act_chk_pl.lamb_sp_beg_ls_act_test lam_bank_2.ls_act_chk_pl.t_chk_ls_up_down_afr lam_bank_2.ls_act_chk_pl.t_chk_ls_up_down_afl lam_bank_2.ls_act_chk_pl.delta_lamb_sp_ls_act_test lam_bank_2.ls_act_chk_pl.lamb_sp_ls_act_test lam_bank_2.ls_act_chk_pl.state_chk_ls_up_down lam_bank_2.ls_act_chk_pl.ctr_sum_rst_chk_ls_up_afr lam_bank_2.ls_act_chk_pl.ctr_sum_rst_chk_ls_up_afl lam_bank_2.ls_act_chk_pl.ctr_chk_ls_up_afl lam_bank_2.ls_act_chk_pl.ctr_chk_ls_up_afr lam_bank_2.ls_act_chk_pl.delta_step_lamb_sp_ls_act_test lam_bank_2.ls_act_chk_pl_inci.bf.lv_inh_chk_ls_up_down lam_bank_2.ls_act_chk_pl_inci.bf.lv_inh_chk_ls_up_down_afr lam_bank_2.ls_act_chk_pl_inci.bf.lv_inh_chk_ls_up_down_afl lv_err_chk_ls_down_2 lv_err_chk_ls_down_1 /end OUT_MEASUREMENT
/end FUNCTION
/end MODULE
/end PROJECT
