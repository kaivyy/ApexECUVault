ASAP2_VERSION 1 3
/begin PROJECT P390 "BMW DDE6.2 6-Zylinder VR0.1 15.03.2004 CAN11/12H"
/begin HEADER "" VERSION "VR0.1_6Z_CAN11/12H" PROJECT_NO P390 /end HEADER
/begin MODULE DIM ""
/begin MOD_COMMON "" BYTE_ORDER MSB_FIRST ALIGNMENT_BYTE 1 ALIGNMENT_WORD 2 ALIGNMENT_LONG 4 ALIGNMENT_FLOAT32_IEEE 4 /end MOD_COMMON
/begin CHARACTERISTIC BattCD_uSRCMin_C "SRC-Min der Batteriespannung" VALUE 0xC8178 Kw_Ws16 5200.391 Volt 0.00 5200.391 FORMAT "%8.3" EXTENDED_LIMITS -160156.4 160151.5 /end CHARACTERISTIC
/begin CHARACTERISTIC BattCD_uSRCMax_C "SRC-Max der Batteriespannung" VALUE 0xC817A Kw_Ws16 5200.391 Volt 0.00 5200.391 FORMAT "%8.3" EXTENDED_LIMITS -160156.4 160151.5 /end CHARACTERISTIC
/begin CHARACTERISTIC BattCD_uLin_CUR "Linearisierungskennlinie" CURVE 0xC817C Kl_Xs16_Ws16 28602.15 Volt_Batt 0.00 28602.15 FORMAT "%8.2" EXTENDED_LIMITS -640625.6 640606.1
 /begin AXIS_DESCR STD_AXIS BattCD_uRaw Volt 25 0.00 5200.391 FORMAT "%8.3" EXTENDED_LIMITS -160156.4 160151.5 DEPOSIT ABSOLUTE /end AXIS_DESCR
/end CHARACTERISTIC
/begin CHARACTERISTIC BattCD_DebSRCHighDef_C "Entprellzeit für Fehlererkennung des SRC-High-Fehlers der Batteriespannung" VALUE 0xC81E2 Kw_Wu16 655350.0 Time_ms 0.00 655350.0 FORMAT "%8.1" /end CHARACTERISTIC
/begin CHARACTERISTIC BattCD_DebSRCHighOk_C "Entprellzeit für Heilung des SRC-High-Fehlers der Batteriespannung" VALUE 0xC81E4 Kw_Wu16 655350.0 Time_ms 0.00 655350.0 FORMAT "%8.1" /end CHARACTERISTIC
/begin CHARACTERISTIC BattCD_DebSRCLowDef_C "Entprellzeit für Fehlererkennung des SRC-Low-Fehlers der Batteriespannung" VALUE 0xC81E6 Kw_Wu16 655350.0 Time_ms 0.00 655350.0 FORMAT "%8.1" /end CHARACTERISTIC
/begin CHARACTERISTIC BattCD_DebSRCLowOk_C "Entprellzeit für Heilung des SRC-Low-Fehlers der Batteriespannung" VALUE 0xC81E8 Kw_Wu16 655350.0 Time_ms 0.00 655350.0 FORMAT "%8.1" /end CHARACTERISTIC
/begin CHARACTERISTIC BattCD_numAdc_C "#SSD Applikationsparameter" VALUE 0xC81EA Kw_Wu8 46.0000000000 NumPinAdc 0.00 46.0000000000 FORMAT "%13.10" /end CHARACTERISTIC
/begin CHARACTERISTIC BattCD_duRmpSlpUp_C "Rampe Zunahme Batteriespannung negative Steigung" VALUE 0xC81EC Kw_Wu32 1281250244.02 RmpVoltBatt 977.576769459 1281251221.60 FORMAT "%13.2" EXTENDED_LIMITS 0.00 1281251221.60 /end CHARACTERISTIC
/begin CHARACTERISTIC BattCD_duRmpSlpDwn_C "Rampe Zunahme Batteriespannung positive Steigung" VALUE 0xC81F0 Kw_Wu32 1281250244.02 RmpVoltBatt 977.576769459 1281251221.60 FORMAT "%13.2" EXTENDED_LIMITS 0.00 1281251221.60 /end CHARACTERISTIC
/begin CHARACTERISTIC BattCD_stSensIDWord_C "Kennung Batteriespannungserfassung" VALUE 0xC81F4 Kw_Wu16 65535.00 OneToOne 0.00 65535.00 FORMAT "%8.2" /end CHARACTERISTIC
/begin CHARACTERISTIC BattCD_uDfl_C "Vorgabewert Batteriespannung" VALUE 0xC81F6 Kw_Ws16 28602.15 Volt_Batt 0.00 28602.15 FORMAT "%8.2" EXTENDED_LIMITS -640625.6 640606.1 /end CHARACTERISTIC
/begin CHARACTERISTIC Batt_uNrm_C "#SSD Normierte Batteriespannung" VALUE 0xC8174 Kw_Ws16 1281232. Volt_Batt -640625.6 640606.1 FORMAT "%8.1" /end CHARACTERISTIC
/begin CHARACTERISTIC BPACD_ctPwrStgOnMax_C "Maximum der Endstufen aktivierungen im Fahrzyklus bei SCB oder Übertemperatur Fehler" VALUE 0xC81F8 Kw_Wu16 65535.00 OneToOne 0.00 65535.00 FORMAT "%8.2" /end CHARACTERISTIC
/begin CHARACTERISTIC BPACD_tiDebBPADia1Def_C "debounce duration for boost pressure actor diagnosis error detection" VALUE 0xC81FA Kw_Wu16 655350.0 Time_ms 0.00 655350.0 FORMAT "%8.1" /end CHARACTERISTIC
/begin CHARACTERISTIC BPACD_tiDebBPADia1Ok_C "debounce duration for boost pressure actor diagnosis error healing" VALUE 0xC81FC Kw_Wu16 655350.0 Time_ms 0.00 655350.0 FORMAT "%8.1" /end CHARACTERISTIC
/begin CHARACTERISTIC BPACD_tiDebBPADia2Def_C "debounce duration for boost pressure actor diagnosis error detection" VALUE 0xC81FE Kw_Wu16 655350.0 Time_ms 0.00 655350.0 FORMAT "%8.1" /end CHARACTERISTIC
/begin CHARACTERISTIC BPACD_tiDebBPADia2Ok_C "debounce duration for boost pressure actor diagnosis error healing" VALUE 0xC8200 Kw_Wu16 655350.0 Time_ms 0.00 655350.0 FORMAT "%8.1" /end CHARACTERISTIC
/begin CHARACTERISTIC BPACD_tiDebBPADia3Def_C "debounce duration for boost pressure actor diagnosis error detection" VALUE 0xC8202 Kw_Wu16 655350.0 Time_ms 0.00 655350.0 FORMAT "%8.1" /end CHARACTERISTIC
/begin CHARACTERISTIC BPACD_tiDebBPADia3Ok_C "debounce duration for boost pressure actor diagnosis error healing" VALUE 0xC8204 Kw_Wu16 655350.0 Time_ms 0.00 655350.0 FORMAT "%8.1" /end CHARACTERISTIC
/begin CHARACTERISTIC BPACD_DebExcTempDef_C "#SSD Fehlerentprellzeit für Übertemperatur" VALUE 0xC8206 Kw_Wu16 655350.0 Time_ms 0.00 655350.0 FORMAT "%8.1" /end CHARACTERISTIC
/begin CHARACTERISTIC BPACD_DebExcTempOk_C "Heilungsentprellzeit für Übertemperatur" VALUE 0xC8208 Kw_Wu16 655350.0 Time_ms 0.00 655350.0 FORMAT "%8.1" /end CHARACTERISTIC
/begin CHARACTERISTIC BPACD_DebNoLoadDef_C "#SSD Fehlerentprellzeit für Lastabfall" VALUE 0xC820A Kw_Wu16 655350.0 Time_ms 0.00 655350.0 FORMAT "%8.1" /end CHARACTERISTIC
/begin CHARACTERISTIC BPACD_DebNoLoadOk_C "Heilungsentprellzeit für Lastabfall" VALUE 0xC820C Kw_Wu16 655350.0 Time_ms 0.00 655350.0 FORMAT "%8.1" /end CHARACTERISTIC
/begin CHARACTERISTIC BPACD_DebShortCircBatDef_C "#SSD Fehlerentprellzeitzeit für Kurzschluß nach Batteriespannung" VALUE 0xC820E Kw_Wu16 655350.0 Time_ms 0.00 655350.0 FORMAT "%8.1" /end CHARACTERISTIC
/begin CHARACTERISTIC BPACD_DebShortCircBatOk_C "Heilungsentprellzeit für Kurzschluß nach Batteriespannung" VALUE 0xC8210 Kw_Wu16 655350.0 Time_ms 0.00 655350.0 FORMAT "%8.1" /end CHARACTERISTIC
/begin CHARACTERISTIC BPACD_DebShortCircGndDef_C "#SSD Fehlerentprellzeit für Kurzschluß nach Masse" VALUE 0xC8212 Kw_Wu16 655350.0 Time_ms 0.00 655350.0 FORMAT "%8.1" /end CHARACTERISTIC
/begin CHARACTERISTIC BPACD_DebShortCircGndOk_C "Heilungsentprellzeit für Kurzschluß nach Masse" VALUE 0xC8214 Kw_Wu16 655350.0 Time_ms 0.00 655350.0 FORMAT "%8.1" /end CHARACTERISTIC
/begin CHARACTERISTIC BPACD_numDia_C "#SSD Applikationsparameter fuer Diagnose Signal :BP-Steller" VALUE 0xC8216 Kw_Wu8 35.0000000000 NumPinDia 0.00 35.0000000000 FORMAT "%13.10" /end CHARACTERISTIC
/begin CHARACTERISTIC BPACD_numPwmOut_C "#SSD Applikationsparameter fuer Ladedruck-Steller" VALUE 0xC8217 Kw_Wu8 13.0000000000 NumPinPwmOut 0.00 13.0000000000 FORMAT "%13.10" /end CHARACTERISTIC
/begin CHARACTERISTIC BPACD_stInvOut_C "Invertierungsparameter für das Signal der Ladedruckstellerendstufe" VALUE 0xC8218 Kw_Wu8 1.000 OneToOne 0.00 1.000 FORMAT "%5.3" EXTENDED_LIMITS 0.00 255.0 /end CHARACTERISTIC
/begin CHARACTERISTIC BPACD_tiPer_C "Periodendauer Ladedrucksteller." VALUE 0xC821A Kw_Ws16 6553.500 Period -3276.800 3276.700 FORMAT "%8.3" /end CHARACTERISTIC
/begin CHARACTERISTIC BPACD_rCnv_CUR "Kennlinie zur konvertierung von Öffnungsgrad in Tastverhältnis" CURVE 0xC821C Kl_Xs16_Ws16 100.0000 DtyCyc 0.00 100.0000 FORMAT "%8.4" EXTENDED_LIMITS -327.6800 327.6700
 /begin AXIS_DESCR STD_AXIS BPA_rBPACD Prc 25 -100.0000 200.0000 FORMAT "%8.4" EXTENDED_LIMITS -400.0000 399.9878 DEPOSIT ABSOLUTE /end AXIS_DESCR
/end CHARACTERISTIC
/begin CHARACTERISTIC BPACD_rOutMax_C "Maximal auszugebendes Tastverhältnis" VALUE 0xC8282 Kw_Ws16 655.3500 DtyCyc -327.6800 327.6700 FORMAT "%8.4" /end CHARACTERISTIC
/begin CHARACTERISTIC BPACD_rOutMin_C "Minimal auszugebendes Tastverhältnis" VALUE 0xC8284 Kw_Ws16 655.3500 DtyCyc -327.6800 327.6700 FORMAT "%8.4" /end CHARACTERISTIC
/begin CHARACTERISTIC BPACD_stPwrStgActv_C "Aktivierung der Abschaltbedingungen der Endstufe" VALUE 0xC8286 Kw_Wu8 255.0 OneToOne 0.00 255.0 FORMAT "%5.1" /end CHARACTERISTIC
/begin CHARACTERISTIC BPACD_stPwrStgDia_C "#SSD Aktivierung der Abschaltbedingungen der Endstufediagnose" VALUE 0xC8287 Kw_Wu8 255.0 OneToOne 0.00 255.0 FORMAT "%5.1" /end CHARACTERISTIC
/begin CHARACTERISTIC BPACD_stSPICtl_C "Parameter zur Auswahl des Endstufentypes  ( 1 = SPI Endstufe, 0 = Nicht SPI Endstufe )" VALUE 0xC8288 Kw_Wu8 1.000 OneToOne 0.00 1.000 FORMAT "%5.3" EXTENDED_LIMITS 0.00 255.0 /end CHARACTERISTIC
/begin CHARACTERISTIC BPACD_swt_C "Schalter für Batteriespannungskorrektur (0 = AUS, 1 = EIN)" VALUE 0xC8289 Kw_Wu8 255.0 OneToOne 0.00 255.0 FORMAT "%5.1" /end CHARACTERISTIC
/begin CHARACTERISTIC BPACD_tiBtwTst_C "#SSD Zeitabstand, in dem im Fehlerfall die Endstufe getestet wird" VALUE 0xC828A Kw_Wu16 29980.00 Time_ms 20.00000 30000.00 FORMAT "%8.2" EXTENDED_LIMITS 0.00 655350.0 /end CHARACTERISTIC
/begin CHARACTERISTIC BPACD_tiDiag1Max_C "window 1 max. time" VALUE 0xC828C Kw_Wu16 655350.0 Time_ms 0.00 655350.0 FORMAT "%8.1" /end CHARACTERISTIC
/begin CHARACTERISTIC BPACD_tiDiag1Min_C "window 1 min. time" VALUE 0xC828E Kw_Wu16 655350.0 Time_ms 0.00 655350.0 FORMAT "%8.1" /end CHARACTERISTIC
/begin CHARACTERISTIC BPACD_tiDiag2Max_C "window 2 max. time" VALUE 0xC8290 Kw_Wu16 655350.0 Time_ms 0.00 655350.0 FORMAT "%8.1" /end CHARACTERISTIC
/begin CHARACTERISTIC BPACD_tiDiag2Min_C "window 2 min. time" VALUE 0xC8292 Kw_Wu16 655350.0 Time_ms 0.00 655350.0 FORMAT "%8.1" /end CHARACTERISTIC
/begin CHARACTERISTIC BPACD_tiDiag3Max_C "window 3 max. time" VALUE 0xC8294 Kw_Wu16 655350.0 Time_ms 0.00 655350.0 FORMAT "%8.1" /end CHARACTERISTIC
/begin CHARACTERISTIC BPACD_tiDiag3Min_C "window 3 min. time" VALUE 0xC8296 Kw_Wu16 655350.0 Time_ms 0.00 655350.0 FORMAT "%8.1" /end CHARACTERISTIC
/begin CHARACTERISTIC BPACD_tiPwrStgOn_C "Zeit für die die Endstufe eingeschalten wird bei nicht SPI Endstufen" VALUE 0xC8298 Kw_Wu16 655140.0 Time_ms 0.00 655140.0 FORMAT "%8.1" EXTENDED_LIMITS 0.00 655350.0 /end CHARACTERISTIC
/begin CHARACTERISTIC BPA_rBPACD_Vector "#SSD Bypass-Label für BPA_rBPA" VALUE 0xC3084 Kw_Wu8 255.0 OneToOne 0.00 255.0 FORMAT "%5.1" /end CHARACTERISTIC
/begin CHARACTERISTIC BPA_rBPACD_Channel "#SSD Bypass-Label für BPA_rBPA" VALUE 0xC3085 Kw_Wu8 255.0 OneToOne 0.00 255.0 FORMAT "%5.1" /end CHARACTERISTIC
/begin CHARACTERISTIC BPA_rLPACD_Vector "Konfigurationslabel für Bypass Freischnitt" VALUE 0xC3086 Kw_Wu8 255.0 OneToOne 0.00 255.0 FORMAT "%5.1" /end CHARACTERISTIC
/begin CHARACTERISTIC BPA_rLPACD_Channel "Konfigurationslabel für Bypass Freischnitt" VALUE 0xC3087 Kw_Wu8 255.0 OneToOne 0.00 255.0 FORMAT "%5.1" /end CHARACTERISTIC
/begin CHARACTERISTIC BPSCD_uSRCMin_C "#SSD SRC-Min-Wert für Ladedruck." VALUE 0xC829C Kw_Ws16 5200.391 Volt 0.00 5200.391 FORMAT "%8.3" EXTENDED_LIMITS -160156.4 160151.5 /end CHARACTERISTIC
/begin CHARACTERISTIC BPSCD_uSRCMax_C "#SSD SRC-Max-Wert für Ladedruck." VALUE 0xC829E Kw_Ws16 5200.391 Volt 0.00 5200.391 FORMAT "%8.3" EXTENDED_LIMITS -160156.4 160151.5 /end CHARACTERISTIC
/begin CHARACTERISTIC BPSCD_pLin_CUR "Linearisierungskennlinie" CURVE 0xC82A0 Kl_Xs16_Ws16 5000.000 Pres_hPa 0.00 5000.000 FORMAT "%8.3" EXTENDED_LIMITS -32768.00 32767.00
 /begin AXIS_DESCR STD_AXIS BPSCD_uRawVal Volt 25 0.00 5000.000 FORMAT "%8.3" EXTENDED_LIMITS -160156.4 160151.5 DEPOSIT ABSOLUTE /end AXIS_DESCR
/end CHARACTERISTIC
/begin CHARACTERISTIC BPSCD_DebNplDef_C "#SSD Fehlerentprellung Plausbilitätsfehler" VALUE 0xC8306 Kw_Wu16 655350.0 Time_ms 0.00 655350.0 FORMAT "%8.1" /end CHARACTERISTIC
/begin CHARACTERISTIC BPSCD_DebNplOK_C "Heilungsentprellung Plausbilitätsfehler" VALUE 0xC8308 Kw_Wu16 655350.0 Time_ms 0.00 655350.0 FORMAT "%8.1" /end CHARACTERISTIC
/begin CHARACTERISTIC BPSCD_DebSigDef_C "#SSD Defektentprellzeit fuer CAN Signal defekt" VALUE 0xC830A Kw_Wu16 655350.0 Time_ms 0.00 655350.0 FORMAT "%8.1" /end CHARACTERISTIC
/begin CHARACTERISTIC BPSCD_DebSigOK_C "Heilungsentprellzeit fuer CAN Signal defekt" VALUE 0xC830C Kw_Wu16 655350.0 Time_ms 0.00 655350.0 FORMAT "%8.1" /end CHARACTERISTIC
/begin CHARACTERISTIC BPSCD_DebSRCHighDef_C "#SSD Fehlerentprellzeit fuer SRC-High Fehler" VALUE 0xC830E Kw_Wu16 655350.0 Time_ms 0.00 655350.0 FORMAT "%8.1" /end CHARACTERISTIC
/begin CHARACTERISTIC BPSCD_DebSRCHighOK_C "Heilungsentprellzeit fuer SRC-High Fehler" VALUE 0xC8310 Kw_Wu16 655350.0 Time_ms 0.00 655350.0 FORMAT "%8.1" /end CHARACTERISTIC
/begin CHARACTERISTIC BPSCD_DebSRCLowDef_C "#SSD Fehlerentprellzeit fuer SRC-Low Fehler" VALUE 0xC8312 Kw_Wu16 655350.0 Time_ms 0.00 655350.0 FORMAT "%8.1" /end CHARACTERISTIC
/begin CHARACTERISTIC BPSCD_DebSRCLowOK_C "Heilungsentprellzeit fuer SRC-Low Fehler" VALUE 0xC8314 Kw_Wu16 655350.0 Time_ms 0.00 655350.0 FORMAT "%8.1" /end CHARACTERISTIC
/begin CHARACTERISTIC BPSCD_tiDT1_C "Reciprocal of time delay" VALUE 0xC8318 Kw_Wu32 4294.9663 TimeDelay_s 0.0010000001 4294.9673 FORMAT "%9.4" EXTENDED_LIMITS 0.0000010000000 4294.9673 /end CHARACTERISTIC
/begin CHARACTERISTIC BPSCD_dDT1Kd_C "Reciprocal of time delay" VALUE 0xC831C Kw_Ws32 10.0000000000 Kd 0.00 10.0000000000 FORMAT "%13.10" EXTENDED_LIMITS -32768.0000000 32767.9999847 /end CHARACTERISTIC
/begin CHARACTERISTIC BPSCD_tiLPFiltPT1_C "Zeitkonstante Tiefpass fuer Ladedruck_Fuehler" VALUE 0xC0494 Kw_Wu32 4294.9673 TimeDelay_s 0.0000010000000 4294.9673 FORMAT "%9.4" /end CHARACTERISTIC
/begin CHARACTERISTIC BPSCD_nLim_C "Obere Grenze Motordrehzahl." VALUE 0xC8320 Kw_Ws16 6000.000 EngN 0.00 6000.000 FORMAT "%8.3" EXTENDED_LIMITS -32768.00 32767.00 /end CHARACTERISTIC
/begin CHARACTERISTIC BPSCD_numAdc_C "#SSD Applikationsparameter fuer Ladedruck-Steller" VALUE 0xC8322 Kw_Wu8 46.0000000000 NumPinAdc 0.00 46.0000000000 FORMAT "%13.10" /end CHARACTERISTIC
/begin CHARACTERISTIC BPSCD_pDiffLim_C "Grenzwert für absolute Differenz zwischen LD und AD" VALUE 0xC8324 Kw_Ws16 3500.000 Pres_hPa 0.00 3500.000 FORMAT "%8.3" EXTENDED_LIMITS -32768.00 32767.00 /end CHARACTERISTIC
/begin CHARACTERISTIC BPSCD_tiOutValDT1_C "Totzeit für  Ladedruck DT1 filter" VALUE 0xC8328 Kw_Wu32 4294.9673 TimeDelay_s 0.0000010000000 4294.9673 FORMAT "%9.4" /end CHARACTERISTIC
/begin CHARACTERISTIC BPSCD_dDT1KdOutVal_C "Verstärkungskonstante des DT1 filters für  Ladedrucksignal" VALUE 0xC832C Kw_Ws32 32767.9999847 Kd 0.00 32767.9999847 FORMAT "%13.7" EXTENDED_LIMITS -32768.0000000 32767.9999847 /end CHARACTERISTIC
/begin CHARACTERISTIC BPSCD_tiPT1_C "Verzugszeit. (für PT1 Filter )" VALUE 0xC8330 Kw_Wu32 4294.9673 TimeDelay_s 0.0000010000000 4294.9673 FORMAT "%9.4" /end CHARACTERISTIC
/begin CHARACTERISTIC BPSCD_dpRmpSlpUp_C "Rampensteigung bei Heilung/Vorgabewert für LDF" VALUE 0xC8334 Kw_Wu32 65535899.9786 RmpPres_hPa 100.006103516 65535999.9847 FORMAT "%13.4" EXTENDED_LIMITS 0.00 65535999.9847 /end CHARACTERISTIC
/begin CHARACTERISTIC BPSCD_dpRmpSlpDwn_C "Rampensteigung bei Heilung/Vorgabewert für LDF" VALUE 0xC8338 Kw_Wu32 65535899.9786 RmpPres_hPa 100.006103516 65535999.9847 FORMAT "%13.4" EXTENDED_LIMITS 0.00 65535999.9847 /end CHARACTERISTIC
/begin CHARACTERISTIC BPSCD_swtSigVal_C "#SSD Schalter ob Signal ueber CAN/ADC (0 = ADC, 1 = CAN)" VALUE 0xC833C Kw_Wu8 1.000 OneToOne 0.00 1.000 FORMAT "%5.3" EXTENDED_LIMITS 0.00 255.0 /end CHARACTERISTIC
/begin CHARACTERISTIC BPSCD_stSensIDWord_C "Geberkennwort LDF" VALUE 0xC833E Kw_Wu16 65535.00 OneToOne 0.00 65535.00 FORMAT "%8.2" /end CHARACTERISTIC
/begin CHARACTERISTIC BPSCD_pDfl_C "Ladedruck Vorgabewert" VALUE 0xC8340 Kw_Ws16 65535.00 Pres_hPa -32768.00 32767.00 FORMAT "%8.2" /end CHARACTERISTIC
/begin CHARACTERISTIC BrkCD_ctUnPlausDef_C "Defektschwelle dese Unplausibilitätszählers" VALUE 0xC8344 Kw_Wu8 255.0 OneToOne 0.00 255.0 FORMAT "%5.1" /end CHARACTERISTIC
/begin CHARACTERISTIC BrkCD_DebPlaDef_C "#SSD Fehlerentprellzeit Plausibilitätsfehler" VALUE 0xC8346 Kw_Wu16 655350.0 Time_ms 0.00 655350.0 FORMAT "%8.1" /end CHARACTERISTIC
/begin CHARACTERISTIC BrkCD_DebPlaOk_C "#SSD Heilzeit Plausibilitätsfehler" VALUE 0xC8348 Kw_Wu16 655350.0 Time_ms 0.00 655350.0 FORMAT "%8.1" /end CHARACTERISTIC
/begin CHARACTERISTIC BrkCD_DebSigDef_C "Entprellzeit für CAN-Signal Defekterkennung" VALUE 0xC834A Kw_Wu16 655350.0 Time_ms 0.00 655350.0 FORMAT "%8.1" /end CHARACTERISTIC
/begin CHARACTERISTIC BrkCD_DebSigOk_C "Entprellzeit für Heilung des CAN-Signalfehler" VALUE 0xC834C Kw_Wu16 655350.0 Time_ms 0.00 655350.0 FORMAT "%8.1" /end CHARACTERISTIC
/begin CHARACTERISTIC BrkCD_tiMnSwtDebNeg_C "#SSD Entprellzeit Bremskontakt - abfallende Flanke" VALUE 0xC834E Kw_Wu16 655350.0 TimeDeb 0.00 655350.0 FORMAT "%8.1" /end CHARACTERISTIC
/begin CHARACTERISTIC BrkCD_tiMnSwtDebPos_C "#SSD Entprellzeit Bremskontakt - aufsteigende Flanke" VALUE 0xC8350 Kw_Wu16 655350.0 TimeDeb 0.00 655350.0 FORMAT "%8.1" /end CHARACTERISTIC
/begin CHARACTERISTIC BrkCD_numDioInMn_C "#SSD Applikationsparameter fuer Bremspedal" VALUE 0xC8352 Kw_Wu8 14.0000000000 NumPinDioIn 0.00 14.0000000000 FORMAT "%13.10" /end CHARACTERISTIC
/begin CHARACTERISTIC BrkCD_numDioInRed_C "#SSD Apllikationsparameter fuer redundante Bremssignal" VALUE 0xC8353 Kw_Wu8 14.0000000000 NumPinDioIn 0.00 14.0000000000 FORMAT "%13.10" /end CHARACTERISTIC
/begin CHARACTERISTIC BrkCD_tiRedSwtDebNeg_C "#SSD Entprellzeit redundanter Bremskontakt - abfallende Flanke" VALUE 0xC8354 Kw_Wu16 655350.0 TimeDeb 0.00 655350.0 FORMAT "%8.1" /end CHARACTERISTIC
/begin CHARACTERISTIC BrkCD_tiRedSwtDebPos_C "#SSD Entprellzeit redundanter Bremskontakt - aufsteigende Flanke" VALUE 0xC8356 Kw_Wu16 655350.0 TimeDeb 0.00 655350.0 FORMAT "%8.1" /end CHARACTERISTIC
/begin CHARACTERISTIC BrkCD_stDflVal_C "Redundanter Bremskontakt-Vorgabewert" VALUE 0xC8358 Kw_Wu8 3.000 OneToOne 0.00 3.000 FORMAT "%5.3" EXTENDED_LIMITS 0.00 255.0 /end CHARACTERISTIC
/begin CHARACTERISTIC BrkCD_stMnSwtInvIn_C "#SSD Signal Bremskontakt invertiert" VALUE 0xC8359 Kw_Wu8 1.000 OneToOne 0.00 1.000 FORMAT "%5.3" EXTENDED_LIMITS 0.00 255.0 /end CHARACTERISTIC
/begin CHARACTERISTIC BrkCD_stRedSwtInvIn_C "#SSD Signal redundanter Bremskontakt invertiert" VALUE 0xC835A Kw_Wu8 1.000 OneToOne 0.00 1.000 FORMAT "%5.3" EXTENDED_LIMITS 0.00 255.0 /end CHARACTERISTIC
/begin CHARACTERISTIC BrkCD_swtRedSwtPresent_C "#SSD Schalter redundanter Bremskontakt vorhanden (1 = vorhanden, 0 = nicht vorhanden)" VALUE 0xC835B Kw_Wu8 1.000 OneToOne 0.00 1.000 FORMAT "%5.3" EXTENDED_LIMITS 0.00 255.0 /end CHARACTERISTIC
/begin CHARACTERISTIC BrkCD_swtSigVal_C "Schalterwert, Signal von HW DIO/CAN (1=CAN, 0=DIO)" VALUE 0xC835C Kw_Wu8 3.000 OneToOne 0.00 3.000 FORMAT "%5.3" EXTENDED_LIMITS 0.00 255.0 /end CHARACTERISTIC
/begin CHARACTERISTIC BrkCD_tiDebResUnPlaus_C "Entprellzeit zur Erkennung auf Plausibilität" VALUE 0xC835E Kw_Wu16 655350.0 Time_ms 0.00 655350.0 FORMAT "%8.1" /end CHARACTERISTIC
/begin CHARACTERISTIC BrkCD_tiDebUnPlausStat_C "Entprellzeit zur Erkennung auf statische Unplausibilität" VALUE 0xC8360 Kw_Wu16 655350.0 Time_ms 0.00 655350.0 FORMAT "%8.1" /end CHARACTERISTIC
/begin CHARACTERISTIC BrkCD_tiDebUnPlaus_C "Entprellzeit zur Erkennung auf Unplausibilität" VALUE 0xC8362 Kw_Wu16 655350.0 Time_ms 0.00 655350.0 FORMAT "%8.1" /end CHARACTERISTIC
/begin CHARACTERISTIC Bss_tiDebDefect_C "Fehlerentprellzeit bei Kommunikationsfehler im BSS Interface" VALUE 0xC8364 Kw_Wu16 655350.0 Time_ms 0.00 655350.0 FORMAT "%8.1" /end CHARACTERISTIC
/begin CHARACTERISTIC Bss_tiDebOk_C "Heilungsentprellung bei Kommunikationsfehler in BSS Interface" VALUE 0xC8366 Kw_Wu16 655350.0 Time_ms 0.00 655350.0 FORMAT "%8.1" /end CHARACTERISTIC
/begin CHARACTERISTIC BypEtk_dNsyncStimuli64_C "#SSD Bypass, nicht ändern. Anzahl der winkelsynchron übertragenen Acht-Byte-Größen von ASCET zur ECU." VALUE 0xC8368 Kw_Wu8 255.0 OneToOne 0.00 255.0 FORMAT "%5.1" /end CHARACTERISTIC
/begin CHARACTERISTIC BypEtk_dNsyncStimuli32_C "#SSD Bypass, nicht ändern. Anzahl der winkelsynchron übertragenen Vier-Byte-Größen von ASCET zur ECU." VALUE 0xC8369 Kw_Wu8 255.0 OneToOne 0.00 255.0 FORMAT "%5.1" /end CHARACTERISTIC
/begin CHARACTERISTIC BypEtk_dNsyncStimuli16_C "#SSD Bypass, nicht ändern. Anzahl der winkelsynchron übertragenen Zwei-Byte-Größen von ASCET zur ECU." VALUE 0xC836A Kw_Wu8 255.0 OneToOne 0.00 255.0 FORMAT "%5.1" /end CHARACTERISTIC
/begin CHARACTERISTIC BypEtk_dNsyncStimuli8_C "#SSD Bypass, nicht ändern. Anzahl der winkelsynchron übertragenen Ein-Byte-Größen von ASCET zur ECU." VALUE 0xC836B Kw_Wu8 255.0 OneToOne 0.00 255.0 FORMAT "%5.1" /end CHARACTERISTIC
/begin CHARACTERISTIC BypEtk_stAscet_C "#SSD Status ASCET ETK Bypass (0: deaktiviert; 1: ETK-Bypass starten, wenn Wert vorher 0; 2: sofort starten)" VALUE 0xC836C Kw_Wu8 2.000 OneToOne 0.00 2.000 FORMAT "%5.3" EXTENDED_LIMITS 0.00 255.0 /end CHARACTERISTIC
/begin CHARACTERISTIC BypEtk_dTsyncStimuli64_C "#SSD Bypass, nicht ändern. Anzahl der zeitsynchron übertragenen Acht-Byte-Größen von ASCET zur ECU." VALUE 0xC836D Kw_Wu8 255.0 OneToOne 0.00 255.0 FORMAT "%5.1" /end CHARACTERISTIC
/begin CHARACTERISTIC BypEtk_dTsyncStimuli32_C "#SSD Bypass, nicht ändern. Anzahl der zeitsynchron übertragenen Vier-Byte-Größen von ASCET zur ECU." VALUE 0xC836E Kw_Wu8 255.0 OneToOne 0.00 255.0 FORMAT "%5.1" /end CHARACTERISTIC
/begin CHARACTERISTIC BypEtk_dTsyncStimuli16_C "#SSD Bypass, nicht ändern. Anzahl der zeitsynchron übertragenen Zwei-Byte-Größen von ASCET zur ECU." VALUE 0xC836F Kw_Wu8 255.0 OneToOne 0.00 255.0 FORMAT "%5.1" /end CHARACTERISTIC
/begin CHARACTERISTIC BypEtk_dTsyncStimuli8_C "#SSD Bypass, nicht ändern. Anzahl der zeitsynchron übertragenen Ein-Byte-Größen von ASCET zur ECU." VALUE 0xC8370 Kw_Wu8 255.0 OneToOne 0.00 255.0 FORMAT "%5.1" /end CHARACTERISTIC
/begin CHARACTERISTIC BypInt_adFunc_C "#SSD Feld von Funktionszeigern auf interne Bypass Funktionen" VAL_BLK 0xC8374 Kwb_Wu32 4294967295.00 OneToOne 0.00 4294967295.00 FORMAT "%13.2" NUMBER 11 /end CHARACTERISTIC
/begin CHARACTERISTIC BypInt_stAscet_C "#SSD Status interner ASCET Bypass (0: deaktiviert; 1: internen Bypass starten, wenn Wert vorher 0; 2: sofort starten)" VALUE 0xC83A0 Kw_Wu8 2.000 OneToOne 0.00 2.000 FORMAT "%5.3" EXTENDED_LIMITS 0.00 255.0 /end CHARACTERISTIC
/begin CHARACTERISTIC Carb_Mode1PID_CA "Feld von unterstützen Carb Mode $1 PID's" VAL_BLK 0xC0498 Kwb_Wu8 254.0 OneToOne 1.000 255.0 FORMAT "%5.1" EXTENDED_LIMITS 0.00 255.0 NUMBER 9 /end CHARACTERISTIC
/begin CHARACTERISTIC Carb_Mode1Signal_CA "Feld der Signale von Carb Mode $1 welche mit den PID's verbunden sind" VAL_BLK 0xC04A2 Kwb_Wu16 255.000000000 SigName 0.00 255.000000000 FORMAT "%13.9" NUMBER 9 /end CHARACTERISTIC
/begin CHARACTERISTIC Carb_Mode2PID_CA "Feld von unterstützen Carb Mode $2 PID's" VAL_BLK 0xC04B4 Kwb_Wu8 254.0 OneToOne 1.000 255.0 FORMAT "%5.1" EXTENDED_LIMITS 0.00 255.0 NUMBER 9 /end CHARACTERISTIC
/begin CHARACTERISTIC Carb_Mode2Signal_CA "Feld der Signale von Carb Mode $2 welche mit den PID's verbunden sind" VAL_BLK 0xC04BE Kwb_Wu16 255.000000000 SigName 0.00 255.000000000 FORMAT "%13.9" NUMBER 9 /end CHARACTERISTIC
/begin CHARACTERISTIC Carb_Mode3SwtDia_C "Anzeigen der Fehler nur für Carb Mode 3(0) oder für Carb Mode 3 und 7 (1)" VALUE 0xC04D0 Kw_Wu8 255.0 OneToOne 0.00 255.0 FORMAT "%5.1" /end CHARACTERISTIC
/begin CHARACTERISTIC Carb_Mode4RefVal_C "Ist Carb_Mode4SigNum_C größer als dieser Referenzwert erfolgt kein Reset" VALUE 0xC04D4 Kw_Ws32 4294967295.00 OneToOne -2147483648.00 2147483647.00 FORMAT "%13.2" /end CHARACTERISTIC
/begin CHARACTERISTIC Carb_Mode4SigNum_C "Vergleiche Carb_Mode4SigNum_C mit dem Referenzwert Carb_Mode4RefVal_C" VALUE 0xC04D8 Kw_Wu16 65535.00 OneToOne 0.00 65535.00 FORMAT "%8.2" /end CHARACTERISTIC
/begin CHARACTERISTIC Carb_Mode6TstComp_CUR "Komponente des Carb Mode 6 Subtests" VAL_BLK 0xC04DA Kwb_Wu8 255.0 OneToOne 0.00 255.0 FORMAT "%5.1" NUMBER 10 /end CHARACTERISTIC
/begin CHARACTERISTIC Carb_Mode6TstNum_CUR "Test Nummer des Carb Mode 6 Subtests" VAL_BLK 0xC04E4 Kwb_Wu8 254.0 OneToOne 1.000 255.0 FORMAT "%5.1" EXTENDED_LIMITS 0.00 255.0 NUMBER 10 /end CHARACTERISTIC
/begin CHARACTERISTIC Carb_Mode6TstRefMax_CUR "Maximaler Referenzwert des Carb Mode 6 Subtest" VAL_BLK 0xC04EE Kwb_Wu16 65534.00 OneToOne 1.000000 65535.00 FORMAT "%8.2" EXTENDED_LIMITS 0.00 65535.00 NUMBER 10 /end CHARACTERISTIC
/begin CHARACTERISTIC Carb_Mode6TstRefMin_CUR "Minimaler Referenzwert des Carb Mode 6 Subtest" VAL_BLK 0xC0502 Kwb_Wu16 65534.00 OneToOne 1.000000 65535.00 FORMAT "%8.2" EXTENDED_LIMITS 0.00 65535.00 NUMBER 10 /end CHARACTERISTIC
/begin CHARACTERISTIC Carb_Mode6TstTestId_CUR "Test Identifier für OBD über CAN" VAL_BLK 0xC0516 Kwb_Wu8 255.0 OneToOne 0.00 255.0 FORMAT "%5.1" NUMBER 10 /end CHARACTERISTIC
/begin CHARACTERISTIC Carb_Mode6TstUnitId_CUR "Einheits und Skalierungs Identifier der Datenbytes" VAL_BLK 0xC0520 Kwb_Wu8 255.0 OneToOne 0.00 255.0 FORMAT "%5.1" NUMBER 10 /end CHARACTERISTIC
/begin CHARACTERISTIC Carb_Mode6TstVal_CUR "Testwert des Carb Mode 6 Subtests" VAL_BLK 0xC052A Kwb_Wu16 65534.00 OneToOne 1.000000 65535.00 FORMAT "%8.2" EXTENDED_LIMITS 0.00 65535.00 NUMBER 10 /end CHARACTERISTIC
/begin CHARACTERISTIC Carb_Mode9PID0_C "Support-Status des Infotype 0x00. Liefert alle ünterstützten Infotypes ( immer 0 für supported)" VALUE 0xC053E Kw_Wu8 255.0 OneToOne 0.00 255.0 FORMAT "%5.1" /end CHARACTERISTIC
/begin CHARACTERISTIC Carb_Mode9PID1_C "Support-Status des Infotype 0x01 (1 für supported, 0 für nicht supported)" VALUE 0xC053F Kw_Wu8 255.0 OneToOne 0.00 255.0 FORMAT "%5.1" /end CHARACTERISTIC
/begin CHARACTERISTIC Carb_Mode9PID2_C "Support-Status des Infotype 0x02 ""Vehicle Identification"" ( 2 für supported, 0 für nicht supported)" VALUE 0xC0540 Kw_Wu8 255.0 OneToOne 0.00 255.0 FORMAT "%5.1" /end CHARACTERISTIC
/begin CHARACTERISTIC Carb_Mode9PID3_C "Support-Status des Infotype 0x03 ( 3 für supported, 0 für nicht supported)" VALUE 0xC0541 Kw_Wu8 255.0 OneToOne 0.00 255.0 FORMAT "%5.1" /end CHARACTERISTIC
/begin CHARACTERISTIC Carb_Mode9PID4_C "Support-Status des Infotype 0x04 ""Calibration Identification"" ( 4 für supported, 0 für nicht supported)" VALUE 0xC0542 Kw_Wu8 255.0 OneToOne 0.00 255.0 FORMAT "%5.1" /end CHARACTERISTIC
/begin CHARACTERISTIC Carb_Mode9PID5_C "Support-Status des Infotype 0x05 ( 5 für supported, 0 für nicht supported)" VALUE 0xC0543 Kw_Wu8 255.0 OneToOne 0.00 255.0 FORMAT "%5.1" /end CHARACTERISTIC
/begin CHARACTERISTIC Carb_Mode9PID6_C "Support-Status des Infotype 0x06 ""Calibration Verification Number"" ( 6 für supported, 0 für nicht supported)" VALUE 0xC0544 Kw_Wu8 6.000 OneToOne 0.00 6.000 FORMAT "%5.3" EXTENDED_LIMITS 0.00 255.0 /end CHARACTERISTIC
/begin CHARACTERISTIC CaSCD_ctEdgOfs_C "#SSD Anzahl von Nockenwellenflanken mit erkannter CaS/CrS Verdrehung" VALUE 0xC83A4 Kw_Wu8 255.0 default 0.00 255.0 FORMAT "%5.1" /end CHARACTERISTIC
/begin CHARACTERISTIC CaSCD_ctErrSync_C "#SSD maximale Anzahl von Störungen auf dem Phasengebersystem während einer Nockenwellenumdrehung" VALUE 0xC83A5 Kw_Wu8 255.0 default 0.00 255.0 FORMAT "%5.1" /end CHARACTERISTIC
/begin CHARACTERISTIC CaSCD_ctShftSync_C "#SSD Anzahl falscher Nockenwellenflanken bis neue Positionssuche" VALUE 0xC83A6 Kw_Wu8 255.0 default 0.00 255.0 FORMAT "%5.1" /end CHARACTERISTIC
/begin CHARACTERISTIC CaSCD_dSegSeries_C "#SSD Segmentfolge der Phasengebersegmente" VAL_BLK 0xC0545 Kwb_Wu8 31.00 OneToOne 0.00 31.00 FORMAT "%5.2" EXTENDED_LIMITS 0.00 255.0 NUMBER 16 /end CHARACTERISTIC
/begin CHARACTERISTIC CaSCD_facPlausHigh_CUR "#SSD Obere Grenze der Plausibilitätsprüfung des Phasengebersignals" CURVE 0xC83A8 Kl_Xs16_Ws16 19.00000 Fact1 1.000000 20.00000 FORMAT "%8.5" EXTENDED_LIMITS -256.0000 255.9922
 /begin AXIS_DESCR STD_AXIS CaSCD_tiPeriodRev Period_ms 12 0.00 3276.700 FORMAT "%8.3" EXTENDED_LIMITS -3276.800 3276.700 DEPOSIT ABSOLUTE /end AXIS_DESCR
/end CHARACTERISTIC
/begin CHARACTERISTIC CaSCD_facPlausLow_CUR "#SSD Untere Grenze der Plausibilitätsprüfung des Phasengebersignals" CURVE 0xC83DA Kl_Xs16_Ws16 1.000000 Fact1 0.00 1.000000 FORMAT "%8.6" EXTENDED_LIMITS -256.0000 255.9922
 /begin AXIS_DESCR STD_AXIS CaSCD_tiPeriodRevHold Period_ms 12 0.00 3276.700 FORMAT "%8.3" EXTENDED_LIMITS -3276.800 3276.700 DEPOSIT ABSOLUTE /end AXIS_DESCR
/end CHARACTERISTIC
/begin CHARACTERISTIC CaSCD_nMinSpeed_C "#SSD Kleinster Wert für Phasengeberraddrehzahl" VALUE 0xC0556 Kw_Ws16 5960.000 EngN 40.00000 6000.000 FORMAT "%8.3" EXTENDED_LIMITS -32768.00 32767.00 /end CHARACTERISTIC
/begin CHARACTERISTIC CaSCD_phiSegLenTolc_C "#SSD Toleranz für jede Segmentlänge" VAL_BLK 0xC0558 Kwb_Ws16 360.0000 AngleCaS 0.00 360.0000 FORMAT "%8.4" EXTENDED_LIMITS -384.0000 383.9883 NUMBER 16 /end CHARACTERISTIC
/begin CHARACTERISTIC CaSCD_phiSegLen_C "#SSD Länge der Phasensegmente" VAL_BLK 0xC0578 Kwb_Ws16 360.0000 AngleCaS 0.00 360.0000 FORMAT "%8.4" EXTENDED_LIMITS -384.0000 383.9883 NUMBER 16 /end CHARACTERISTIC
/begin CHARACTERISTIC CaSCD_phiSegOfs_C "#SSD Winkel zwischen physikalischer Nulllage und Beginn Referenztabelle" VALUE 0xC0598 Kw_Ws16 360.0000 AngleCaS 0.00 360.0000 FORMAT "%8.4" EXTENDED_LIMITS -384.0000 383.9883 /end CHARACTERISTIC
/begin CHARACTERISTIC CaSCD_phiSpeedCalcTolc_C "#SSD Toleranzwinkel für Segmenterkennung bei der Berechnung der Phasengeberdrehzahl" VALUE 0xC059A Kw_Ws16 360.0000 AngleCaS 0.00 360.0000 FORMAT "%8.4" EXTENDED_LIMITS -384.0000 383.9883 /end CHARACTERISTIC
/begin CHARACTERISTIC CaSCD_phiSpeedSegLen_C "#SSD Winkel einer Segmentlänge zur Berechnung der Phasengeberraddrehzahl" VALUE 0xC059C Kw_Ws16 360.0000 AngleCaS 0.00 360.0000 FORMAT "%8.4" EXTENDED_LIMITS -384.0000 383.9883 /end CHARACTERISTIC
/begin CHARACTERISTIC CaSCD_phiSpeedSegOfs_C "#SSD Winkel zwischen phys. Nullposition und dem Beginn der Segmente zur Phasenraddrehzahlberechnung" VALUE 0xC059E Kw_Ws16 360.0000 AngleCaS 0.00 360.0000 FORMAT "%8.4" EXTENDED_LIMITS -384.0000 383.9883 /end CHARACTERISTIC
/begin CHARACTERISTIC CaSCD_stCalc_C "#SSD Abschalten von unterschiedlichen Funktionen des Phasensystems" VALUE 0xC05A0 Kw_Wu8 255.0 OneToOne 0.00 255.0 FORMAT "%5.1" /end CHARACTERISTIC
/begin CHARACTERISTIC CaSCD_stEdgeTrig_C "#SSD Triggerbedingung für die Phasenflankenerfassung" VALUE 0xC05A1 Kw_Wu8 2.000 OneToOne 1.000 3.000 FORMAT "%5.3" EXTENDED_LIMITS 0.00 255.0 /end CHARACTERISTIC
/begin CHARACTERISTIC CaSCD_stPinState_C "#SSD Signalpegel zur Auswertung der Phasensegmente verwenden" VALUE 0xC05A2 Kw_Wu8 1.000 OneToOne 0.00 1.000 FORMAT "%5.3" EXTENDED_LIMITS 0.00 255.0 /end CHARACTERISTIC
/begin CHARACTERISTIC CaSCD_stTPO_C "#SSD True Power On Funktion des Phasengebersensors" VALUE 0xC05A3 Kw_Wu8 1.000 OneToOne 0.00 1.000 FORMAT "%5.3" EXTENDED_LIMITS 0.00 255.0 /end CHARACTERISTIC
/begin CHARACTERISTIC CaSCD_tiPeriodRev1Max_C "#SSD Max. Zeit der vorletzten Periode einer Phasengeberradumdrehung" VALUE 0xC05A4 Kw_Ws16 3276.700 Period_ms 0.00 3276.700 FORMAT "%8.3" EXTENDED_LIMITS -3276.800 3276.700 /end CHARACTERISTIC
/begin CHARACTERISTIC CaSCD_tiPeriodRev2Max_C "#SSD Max. Zeit der letzten Periode einer Phasengeberradumdrehung" VALUE 0xC05A6 Kw_Ws16 3276.700 Period_ms 0.00 3276.700 FORMAT "%8.3" EXTENDED_LIMITS -3276.800 3276.700 /end CHARACTERISTIC
/begin CHARACTERISTIC CaSCD_tiTimOutOfs_C "#SSD Offset zur Berechnung des Timeout-Wertes der Plausibilitätsprüfung" VALUE 0xC05A8 Kw_Ws16 3276.700 Period_ms 0.00 3276.700 FORMAT "%8.3" EXTENDED_LIMITS -3276.800 3276.700 /end CHARACTERISTIC
/begin CHARACTERISTIC CBACD_ctPwrStgOnMax_C "Maximal Einschalt Anzahl der Endstufe bei SCB oder Übertemperaturfehler" VALUE 0xC840C Kw_Wu16 65535.00 OneToOne 0.00 65535.00 FORMAT "%8.2" /end CHARACTERISTIC
/begin CHARACTERISTIC CBACD_numDia_C "Parameter fuer Hardware Diagnose-Pin Auswahl" VALUE 0xC840E Kw_Wu8 35.0000000000 NumPinDia 0.00 35.0000000000 FORMAT "%13.10" /end CHARACTERISTIC
/begin CHARACTERISTIC CBACD_numDioOut_C "Parameter fuer Hardware Digitalausgang-Pin Auswahl" VALUE 0xC840F Kw_Wu8 11.0000000000 NumPinDioOut 0.00 11.0000000000 FORMAT "%13.10" /end CHARACTERISTIC
/begin CHARACTERISTIC CBACD_stInvOut_C "Invertierung des Digitalausgangs ja/nein" VALUE 0xC8410 Kw_Wu8 1.000 OneToOne 0.00 1.000 FORMAT "%5.3" EXTENDED_LIMITS 0.00 255.0 /end CHARACTERISTIC
/begin CHARACTERISTIC CBACD_stPwrStgActv_C "Spezifikation des Abschaltverhaltens der Endstufe" VALUE 0xC8411 Kw_Wu8 255.0 OneToOne 0.00 255.0 FORMAT "%5.1" /end CHARACTERISTIC
/begin CHARACTERISTIC CBACD_stPwrStgDia_C "Spezifikation des Diagnoseverhaltens der Endstufe" VALUE 0xC8412 Kw_Wu8 255.0 OneToOne 0.00 255.0 FORMAT "%5.1" /end CHARACTERISTIC
/begin CHARACTERISTIC CBACD_stSPICtl_C "Parameter zur Kennzeichnung ob Endstufe SPI oder nicht SPI fähig ( 1 = SPI Endstufe, 0 = Nicht SPI Endstufe )" VALUE 0xC8413 Kw_Wu8 1.000 OneToOne 0.00 1.000 FORMAT "%5.3" EXTENDED_LIMITS 0.00 255.0 /end CHARACTERISTIC
/begin CHARACTERISTIC CBACD_tiBtwTst_C "Zeit zwischen zwei Test wenn Endstufe defekt" VALUE 0xC8414 Kw_Wu16 29980.00 Time_ms 20.00000 30000.00 FORMAT "%8.2" EXTENDED_LIMITS 0.00 655350.0 /end CHARACTERISTIC
/begin CHARACTERISTIC CBACD_tiDebExcTempDef_C "Fehlerentprellzeit Uebertemperatur" VALUE 0xC8416 Kw_Wu16 655350.0 Time_ms 0.00 655350.0 FORMAT "%8.1" /end CHARACTERISTIC
/begin CHARACTERISTIC CBACD_tiDebExcTempOk_C "Heilungsentprellzeit Uebertemperatur" VALUE 0xC8418 Kw_Wu16 655350.0 Time_ms 0.00 655350.0 FORMAT "%8.1" /end CHARACTERISTIC
/begin CHARACTERISTIC CBACD_tiDebNoLoadDef_C "Fehlerentprellzeit keine Last" VALUE 0xC841A Kw_Wu16 655350.0 Time_ms 0.00 655350.0 FORMAT "%8.1" /end CHARACTERISTIC
/begin CHARACTERISTIC CBACD_tiDebNoLoadOk_C "Heilungsentprellzeit keine Last" VALUE 0xC841C Kw_Wu16 655350.0 Time_ms 0.00 655350.0 FORMAT "%8.1" /end CHARACTERISTIC
/begin CHARACTERISTIC CBACD_tiDebShortCircBatDef_C "Fehlerentprellzzeit Kurzschluss nach UBatt" VALUE 0xC841E Kw_Wu16 655350.0 Time_ms 0.00 655350.0 FORMAT "%8.1" /end CHARACTERISTIC
/begin CHARACTERISTIC CBACD_tiDebShortCircBatOk_C "Heilungsentprellzeit Kurzschluss nach UBatt" VALUE 0xC8420 Kw_Wu16 655350.0 Time_ms 0.00 655350.0 FORMAT "%8.1" /end CHARACTERISTIC
/begin CHARACTERISTIC CBACD_tiDebShortCircGndDef_C "Fehlerentprellzeit Kurzschluss nach Masse" VALUE 0xC8422 Kw_Wu16 655350.0 Time_ms 0.00 655350.0 FORMAT "%8.1" /end CHARACTERISTIC
/begin CHARACTERISTIC CBACD_tiDebShortCircGndOk_C "Heilungsentprellzeit Kurzschluss nach Masse" VALUE 0xC8424 Kw_Wu16 655350.0 Time_ms 0.00 655350.0 FORMAT "%8.1" /end CHARACTERISTIC
/begin CHARACTERISTIC CBACD_tiPwrStgOn_C "Zeit für welche die Endstufe eingeschalten wird bei nicht SPI Endstufen" VALUE 0xC8426 Kw_Wu16 655140.0 Time_ms 0.00 655140.0 FORMAT "%8.1" EXTENDED_LIMITS 0.00 655350.0 /end CHARACTERISTIC
/begin CHARACTERISTIC Clg_dtMinDynTst_C "Minimaler Anstieg der Wassertemperatur zur Verifizierung derPlausibilität der Wassertemperatur" VALUE 0xC8428 Kw_Ws16 6553.500 TempDiff_Cels -3276.800 3276.700 FORMAT "%8.3" /end CHARACTERISTIC
/begin CHARACTERISTIC Clg_nMinEnaDynTst_C "Minimale Drehzahl zur Aktivierung des dynamischen Plausibilitätstests" VALUE 0xC842A Kw_Ws16 65535.00 EngN -32768.00 32767.00 FORMAT "%8.2" /end CHARACTERISTIC
/begin CHARACTERISTIC Clg_qMinEnaDynTst_C "Minimale Einspritzmenge zur Aktivierung des dynamischen Plausibilitätstests" VALUE 0xC842C Kw_Ws16 655.3500 InjMass -327.6800 327.6700 FORMAT "%8.4" /end CHARACTERISTIC
/begin CHARACTERISTIC Clg_tiInitTmr_C "Zeitspanne nach Motorstatrt bis die Wassertemperatur erfasst wird" VALUE 0xC842E Kw_Ws16 655.3500 Time_s -327.6800 327.6700 FORMAT "%8.4" /end CHARACTERISTIC
/begin CHARACTERISTIC Clg_tiMaxDynTst_CUR "Kennlinie der maximal zulässigen Testzeit des dynamischen Plausibilitätstest" CURVE 0xC8430 Kl_Xs16_Ws16 167769.6 Time_DynTst -83886.08 83883.52 FORMAT "%8.2"
 /begin AXIS_DESCR STD_AXIS Clg_tClntStrtVal_mp Temp_Cels 10 -50.140 899.860 FORMAT "%8.3" EXTENDED_LIMITS -3549.940 3003.560 DEPOSIT ABSOLUTE /end AXIS_DESCR
/end CHARACTERISTIC
/begin CHARACTERISTIC Clg_tMinClntDynTst_C "Minimale Wassertemperatur zur Verifizierung der Plausibilitäts der Wassertemperatur" VALUE 0xC845A Kw_Ws16 950.000 Temp_Cels -50.140 899.860 FORMAT "%8.3" EXTENDED_LIMITS -3549.940 3003.560 /end CHARACTERISTIC
/begin CHARACTERISTIC CmbChb_nAvrgThrHi_C "maximale Drehzahl fuer Ueberwachung" VALUE 0xC845C Kw_Ws16 6000.000 EngN 0.00 6000.000 FORMAT "%8.3" EXTENDED_LIMITS -32768.00 32767.00 /end CHARACTERISTIC
/begin CHARACTERISTIC CmbChb_nAvrgThrLo_C "minimale Drehzahl fuer Ueberwachung" VALUE 0xC845E Kw_Ws16 6000.000 EngN 0.00 6000.000 FORMAT "%8.3" EXTENDED_LIMITS -32768.00 32767.00 /end CHARACTERISTIC
/begin CHARACTERISTIC CmbChb_qRawThrHi_C "maximale Menge fuer Ueberwachung" VALUE 0xC8460 Kw_Ws16 655.3500 InjMass -327.6800 327.6700 FORMAT "%8.4" /end CHARACTERISTIC
/begin CHARACTERISTIC CmbChb_qRawThrLo_C "minimale Menge fuer Ueberwachung" VALUE 0xC8462 Kw_Ws16 655.3500 InjMass -327.6800 327.6700 FORMAT "%8.4" /end CHARACTERISTIC
/begin CHARACTERISTIC CmbChb_tClntThrLo_C "minimale Wassertemperatur fuer Ueberwachung" VALUE 0xC8464 Kw_Ws16 950.000 Temp_Cels -50.140 899.860 FORMAT "%8.3" EXTENDED_LIMITS -3549.940 3003.560 /end CHARACTERISTIC
/begin CHARACTERISTIC CmbChb_vThrHi_C "maximale Geschwindigkeit fuer Ueberwachung" VALUE 0xC8466 Kw_Ws16 327.6700 Vel 0.00 327.6700 FORMAT "%8.4" EXTENDED_LIMITS -327.6800 327.6700 /end CHARACTERISTIC
/begin CHARACTERISTIC CmbChb_tiDebClutchChng_C "Entprellzeit für die Zustandsänderung des Kupplungssignals" VALUE 0xC8468 Kw_Wu16 655350.0 Time_ms 0.00 655350.0 FORMAT "%8.1" /end CHARACTERISTIC
/begin CHARACTERISTIC CmbChb_tiDlyStr_C "Startausblendezeit" VALUE 0xC846A Kw_Wu16 655350.0 Time_ms 0.00 655350.0 FORMAT "%8.1" /end CHARACTERISTIC
/begin CHARACTERISTIC CmbChb_ctEngRevPerBlk_C "Blockgroesse (UpM) f. Ausbl./Test/Ausw.verz." VALUE 0xC846C Kw_Wu16 65535.00 OneToOne 0.00 65535.00 FORMAT "%8.2" /end CHARACTERISTIC
/begin CHARACTERISTIC CmbChb_ctSegTDC1_C "Offset für internen Segmentzähler in Aussetzererkennung" VALUE 0xC846E Kw_Wu16 0.00 OneToOne 0.00 0.00 FORMAT "%8.2" EXTENDED_LIMITS 0.00 65535.00 /end CHARACTERISTIC
/begin CHARACTERISTIC CmbChb_numBlk_C "Blockanzahl fuer Test" VALUE 0xC8470 Kw_Wu16 65535.00 OneToOne 0.00 65535.00 FORMAT "%8.2" /end CHARACTERISTIC
/begin CHARACTERISTIC CmbChb_dnSegMin_C "Prozentuelle Komponente des durchschnittlichen minimalen Drehzahlanstieges" VALUE 0xC8472 Kw_Ws16 799.9878 Prc -400.0000 399.9878 FORMAT "%8.4" /end CHARACTERISTIC
/begin CHARACTERISTIC CmbChb_ctMisfireMax_C "maximale Anzahl von Aussetzern pro Test" VALUE 0xC8474 Kw_Wu16 65535.00 OneToOne 0.00 65535.00 FORMAT "%8.2" /end CHARACTERISTIC
/begin CHARACTERISTIC CmbChb_swtMonClutchVal_C "DS-Wert für SW-Schalter CmbChb_swtMonClutch, De/Aktivierung Überwachung Zündaussetzererkennung" VALUE 0xC8476 Kw_Wu8 3.000 OneToOne 0.00 3.000 FORMAT "%5.3" EXTENDED_LIMITS 0.00 255.0 /end CHARACTERISTIC
/begin CHARACTERISTIC CmbChb_swtMonClutchType_C "Typ SW-Schalter CmbChb_swtMonClutch (1: EEPROM, 2: DS-Wert CrCCD_swtMonClutchVal_C)" VALUE 0xC8477 Kw_Wu8 1.000 OneToOne 1.000 2.000 FORMAT "%5.3" EXTENDED_LIMITS 0.00 255.0 /end CHARACTERISTIC
/begin CHARACTERISTIC CoDT_tiChkGrpDT1_C "Time delay for DT1 filter" VALUE 0xC8490 Kw_Wu32 4294.9673 TimeDelay_s 0.0000010000000 4294.9673 FORMAT "%9.4" /end CHARACTERISTIC
/begin CHARACTERISTIC CoDT_dChkGrpDT1Kd_C "Kd value for DT1 fliter" VALUE 0xC8494 Kw_Ws32 65535.9999847 Kd -32768.0000000 32767.9999847 FORMAT "%13.7" /end CHARACTERISTIC
/begin CHARACTERISTIC CoDT_tiChkGrpPT1_C "Time delay for PT1 filter" VALUE 0xC8498 Kw_Wu32 4294.9673 TimeDelay_s 0.0000010000000 4294.9673 FORMAT "%9.4" /end CHARACTERISTIC
/begin CHARACTERISTIC CoDT_dOfsGripDet_C "Offset for dn/dt calculation for grip detection" VALUE 0xC849C Kw_Ws16 65535.00 dn_dZfine -32768.00 32767.00 FORMAT "%8.2" /end CHARACTERISTIC
/begin CHARACTERISTIC CoDT_dOfsNoGripDet_C "Offset for dn/dt calculation for no grip detection" VALUE 0xC849E Kw_Ws16 65535.00 dn_dZfine -32768.00 32767.00 FORMAT "%8.2" /end CHARACTERISTIC
/begin CHARACTERISTIC CoDT_dThetaGripDet_C "Theta for dn/dt calculation for grip detection" VALUE 0xC84A0 Kw_Ws16 655.3500 Moment_Inertia -327.6800 327.6700 FORMAT "%8.4" /end CHARACTERISTIC
/begin CHARACTERISTIC CoDT_dThetaNoGripDet_C "Theta for dn/dt calculation for no grip detection" VALUE 0xC84A2 Kw_Ws16 655.3500 Moment_Inertia -327.6800 327.6700 FORMAT "%8.4" /end CHARACTERISTIC
/begin CHARACTERISTIC CoDT_dtrqLimDwnCurr_C "negative Steigung für einen Rampenschalter im Curr-Pfad" VALUE 0xC8478 Kw_Wu32 6553599.99847 RmpTrq 0.00 6553599.99847 FORMAT "%13.5" /end CHARACTERISTIC
/begin CHARACTERISTIC CoDT_dtrqLimDwnLead_C "negative Steigung für einen Rampenschalter im Lead-Pfad" VALUE 0xC847C Kw_Wu32 6553599.99847 RmpTrq 0.00 6553599.99847 FORMAT "%13.5" /end CHARACTERISTIC
/begin CHARACTERISTIC CoDT_dtrqLimUpCurr_C "positive Steigung für einen Rampenschalter im Curr-Pfad" VALUE 0xC8480 Kw_Wu32 6553599.99847 RmpTrq 0.00 6553599.99847 FORMAT "%13.5" /end CHARACTERISTIC
/begin CHARACTERISTIC CoDT_dtrqLimUpLead_C "positive Steigung für Rampenschalter im Lead-Pfad" VALUE 0xC8484 Kw_Wu32 6553599.99847 RmpTrq 0.00 6553599.99847 FORMAT "%13.5" /end CHARACTERISTIC
/begin CHARACTERISTIC CoDT_swtAcsFltEna_C "Schalter um Filterwert zu aktivieren (1 = Filterung, 0 = keine Filterung)" VALUE 0xC84B0 Kw_Wu8 1.000 OneToOne 0.00 1.000 FORMAT "%5.3" EXTENDED_LIMITS 0.00 255.0 /end CHARACTERISTIC
/begin CHARACTERISTIC CoDT_swtCoTypeVal_C "#SSD Sollmoment im Schub über Fahrpedalstellung (0: conventional; 1: mastershift)" VALUE 0xC8488 Kw_Wu8 1.000 OneToOne 0.00 1.000 FORMAT "%5.3" EXTENDED_LIMITS 0.00 255.0 /end CHARACTERISTIC
/begin CHARACTERISTIC CoDT_swtCoTypeType_C "#SSD CoDT_swtCoType 0: bed. Spez. ; 1: form E2PROM; 2: Applikation" VALUE 0xC8489 Kw_Wu8 1.000 OneToOne 1.000 2.000 FORMAT "%5.3" EXTENDED_LIMITS 0.00 255.0 /end CHARACTERISTIC
/begin CHARACTERISTIC CoDT_swtNoGripDet_C "Schalter zur deaktivierung der Kraftschlusserkennung mittels Trägheitsmoment (1 = deaktiviert, 0 = aktiviert)" VALUE 0xC84A4 Kw_Wu8 255.0 OneToOne 0.00 255.0 FORMAT "%5.1" /end CHARACTERISTIC
/begin CHARACTERISTIC CoDT_tiDebGearUnVal_C "Delay time for debouncing neutral condition" VALUE 0xC84A6 Kw_Wu16 655350.0 Time_ms 0.00 655350.0 FORMAT "%8.1" /end CHARACTERISTIC
/begin CHARACTERISTIC CoDT_tiDebNoGrip_C "Delay time for debouncing No Grip" VALUE 0xC84A8 Kw_Wu16 655350.0 Time_ms 0.00 655350.0 FORMAT "%8.1" /end CHARACTERISTIC
/begin CHARACTERISTIC CoDT_tiFltPT1_C "Parameter für Filterung des Momentenbands" VALUE 0xC84B4 Kw_Wu32 4294.9673 TimeDelay_s 0.0000010000000 4294.9673 FORMAT "%9.4" /end CHARACTERISTIC
/begin CHARACTERISTIC CoDT_tiGripDeb_C "Entprellzeit für die Kraftschlußerkennung im Triebstrang" VALUE 0xC84AA Kw_Wu16 655350.0 Time_ms 0.00 655350.0 FORMAT "%8.1" /end CHARACTERISTIC
/begin CHARACTERISTIC CoDT_tiTrqRedMaxCurr_C "Zeitschwelle für ""langen"" Getriebeeingriff im Curr-Pfad" VALUE 0xC848A Kw_Wu16 655350.0 Time_ms 0.00 655350.0 FORMAT "%8.1" /end CHARACTERISTIC
/begin CHARACTERISTIC CoDT_tiTrqRedMaxLead_C "Zeitschwell für ""langen"" Getriebeeingriff im Lead-Pfad" VALUE 0xC848C Kw_Wu16 655350.0 Time_ms 0.00 655350.0 FORMAT "%8.1" /end CHARACTERISTIC
/begin CHARACTERISTIC CoDT_trqMinInit_C "#SSD Initialwert für minimales Vortriebsmoment" VALUE 0xC84B8 Kw_Ws16 11000.00 TrqPrp -5000.000 6000.000 FORMAT "%8.3" EXTENDED_LIMITS -6553.600 6553.400 /end CHARACTERISTIC
/begin CHARACTERISTIC CoDT_vGrip_C "Geschwindigkeitsschwelle für Kraftschlußerkennung im Triebstrang" VALUE 0xC84AC Kw_Ws16 400.0000 Vel -100.0000 300.0000 FORMAT "%8.4" EXTENDED_LIMITS -327.6800 327.6700 /end CHARACTERISTIC
/begin CHARACTERISTIC CoEng_dnOvrFulMin_C "untere Hysteresegrenze für Overfueling Drehzahlgradienten" VALUE 0xC8888 Kw_Ws16 655350.0 dn_dZ20 -327680.0 327670.0 FORMAT "%8.1" /end CHARACTERISTIC
/begin CHARACTERISTIC CoEng_dnOvrFulMax_C "obere Hysteresegrenze für Overfueling Drehzahlgradienten" VALUE 0xC888A Kw_Ws16 655350.0 dn_dZ20 -327680.0 327670.0 FORMAT "%8.1" /end CHARACTERISTIC
/begin CHARACTERISTIC CoEng_stdnOvrFulLow_C "Status für Overfueling Drehzahlgradienten Hysterese aus" VALUE 0xC888C Kw_Ws16 65535.00 OneToOne -32768.00 32767.00 FORMAT "%8.2" READ_ONLY /end CHARACTERISTIC
/begin CHARACTERISTIC CoEng_stdnOvrFulHigh_C "Status für Overfueling Drehzahlgradienten Hysterese ein" VALUE 0xC888E Kw_Ws16 65535.00 OneToOne -32768.00 32767.00 FORMAT "%8.2" READ_ONLY /end CHARACTERISTIC
/begin CHARACTERISTIC CoEng_dqSubsRgnRmpUp_C "Rampensteigung zur Umschaltung" VALUE 0xC84D4 Kw_Wu32 655359.999847 RmpInjMassCyc 0.00 655359.999847 FORMAT "%13.6" /end CHARACTERISTIC
/begin CHARACTERISTIC CoEng_dqSubsRgnRmpDwn_C "Rampensteigung zur Umschaltung" VALUE 0xC84D8 Kw_Wu32 655359.999847 RmpInjMassCyc 0.00 655359.999847 FORMAT "%13.6" /end CHARACTERISTIC
/begin CHARACTERISTIC CoEng_dtrqEngPrtRgnMonUp_C "" VALUE 0xC8890 Kw_Wu32 6553599.99847 RmpTrq 0.00 6553599.99847 FORMAT "%13.5" /end CHARACTERISTIC
/begin CHARACTERISTIC CoEng_dtrqEngPrtRgnMonDwn_C "" VALUE 0xC8894 Kw_Wu32 6553599.99847 RmpTrq 0.00 6553599.99847 FORMAT "%13.5" /end CHARACTERISTIC
/begin CHARACTERISTIC CoEng_dtrqLimUp_C "#SSD pos. Rampenanstieg bei Umschaltung auf Begrenzungsmoment bei Systemfehler" VALUE 0xC8898 Kw_Wu32 6553599.99847 RmpTrq 0.00 6553599.99847 FORMAT "%13.5" /end CHARACTERISTIC
/begin CHARACTERISTIC CoEng_dtrqLimDwn_C "neg. Rampenanstieg bei Rückkehr von dem Begrenzungsmoment bei Systemfehler" VALUE 0xC889C Kw_Wu32 6553599.99847 RmpTrq 0.00 6553599.99847 FORMAT "%13.5" /end CHARACTERISTIC
/begin CHARACTERISTIC CoEng_dtrqLimUp1_C "#SSD positive Rampensteigung für Rampenschalter" VALUE 0xC88A0 Kw_Wu32 6553599.99847 RmpTrq 0.00 6553599.99847 FORMAT "%13.5" /end CHARACTERISTIC
/begin CHARACTERISTIC CoEng_dtrqLimDwn1_C "negative Steigung für einen Rampenschalter" VALUE 0xC88A4 Kw_Wu32 6553599.99847 RmpTrq 0.00 6553599.99847 FORMAT "%13.5" /end CHARACTERISTIC
/begin CHARACTERISTIC CoEng_dtrqLimUp2_C "positive Steigung für Rampenschalter 2" VALUE 0xC88A8 Kw_Wu32 6553599.99847 RmpTrq 0.00 6553599.99847 FORMAT "%13.5" /end CHARACTERISTIC
/begin CHARACTERISTIC CoEng_dtrqLimDwn2_C "negative Steigung für Rampenschalter 2" VALUE 0xC88AC Kw_Wu32 6553599.99847 RmpTrq 0.00 6553599.99847 FORMAT "%13.5" /end CHARACTERISTIC
/begin CHARACTERISTIC CoEng_dtrqLimUp3_C "positive Rampensteigung für Rampenschalter" VALUE 0xC88B0 Kw_Wu32 6553599.99847 RmpTrq 0.00 6553599.99847 FORMAT "%13.5" /end CHARACTERISTIC
/begin CHARACTERISTIC CoEng_dtrqLimDwn3_C "negative Rampensteigung für Rampenschalter" VALUE 0xC88B4 Kw_Wu32 6553599.99847 RmpTrq 0.00 6553599.99847 FORMAT "%13.5" /end CHARACTERISTIC
/begin CHARACTERISTIC CoEng_dtrqLimUp4_C "positive Rampensteigung für Rampenschalter" VALUE 0xC88B8 Kw_Wu32 6553599.99847 RmpTrq 0.00 6553599.99847 FORMAT "%13.5" /end CHARACTERISTIC
/begin CHARACTERISTIC CoEng_dtrqLimDwn4_C "negative Rampensteigung für Rampenschalter" VALUE 0xC88BC Kw_Wu32 6553599.99847 RmpTrq 0.00 6553599.99847 FORMAT "%13.5" /end CHARACTERISTIC
/begin CHARACTERISTIC CoEng_tiOvrFulDT1_C "Zeit für Overfueling DT1" VALUE 0xC88C0 Kw_Wu32 4294.9673 TimeDelay_s 0.0000010000000 4294.9673 FORMAT "%9.4" /end CHARACTERISTIC
/begin CHARACTERISTIC CoEng_facOvrFulDKd_C "Kd für overfueling DT1" VALUE 0xC88C4 Kw_Ws32 32767.9999924 Kd_rpm2dndt -16384.0000000 16383.9999924 FORMAT "%13.7" /end CHARACTERISTIC
/begin CHARACTERISTIC CoEng_ExtWaitMsk2_C "#SSD Bitmaske für externe Ereignisse vor Öffnen des Hauptrelais" VALUE 0xC84C4 Kw_Wu8 255.0 OneToOne 0.00 255.0 FORMAT "%5.1" /end CHARACTERISTIC
/begin CHARACTERISTIC CoEng_ExtWaitMsk_C "#SSD Bitmaske für externe Ereignisse for Schreiben des EEPROM" VALUE 0xC84C5 Kw_Wu8 255.0 OneToOne 0.00 255.0 FORMAT "%5.1" /end CHARACTERISTIC
/begin CHARACTERISTIC CoEng_facAdjDfl_C "Defaultwert für Abgleich Momentenbegrenzung" VALUE 0xC88C8 Kw_Ws16 2.000000 Fact 0.00 2.000000 FORMAT "%8.6" EXTENDED_LIMITS -4.000000 3.999878 /end CHARACTERISTIC
/begin CHARACTERISTIC CoEng_facAdjMax_C "#SSD Maximaler Abgleichwert für Abgleich Momentenbegrenzung" VALUE 0xC88CA Kw_Ws16 7.999878 Fact -4.000000 3.999878 FORMAT "%8.6" /end CHARACTERISTIC
/begin CHARACTERISTIC CoEng_facAdjMin_C "Minimaler Abgleichwert für Abgleich Momentenbegrenzung" VALUE 0xC88CC Kw_Ws16 7.999878 Fact -4.000000 3.999878 FORMAT "%8.6" /end CHARACTERISTIC
/begin CHARACTERISTIC CoEng_facFlConsumAdjDfl_C "Ersatzwert für den Kraftstoffverbrauchsabgleich" VALUE 0xC84DC Kw_Ws16 2.000000 Fact 0.00 2.000000 FORMAT "%8.6" EXTENDED_LIMITS -4.000000 3.999878 /end CHARACTERISTIC
/begin CHARACTERISTIC CoEng_facFlConsumAdjMax_C "Maximalwert des Kraftstoffverbrauch-Abgleichwerts" VALUE 0xC84DE Kw_Ws16 2.000000 Fact 0.00 2.000000 FORMAT "%8.6" EXTENDED_LIMITS -4.000000 3.999878 /end CHARACTERISTIC
/begin CHARACTERISTIC CoEng_facFlConsumAdjMin_C "Minumumwert des Kraftstoffverbrauch-Abgleichwerts" VALUE 0xC84E0 Kw_Ws16 2.000000 Fact 0.00 2.000000 FORMAT "%8.6" EXTENDED_LIMITS -4.000000 3.999878 /end CHARACTERISTIC
/begin CHARACTERISTIC CoEng_lSumFuncPref_C "Schwelle für gefahrene Strecke" VALUE 0xC8790 Kw_Wu32 1000000.00000 Length 0.00 1000000.00000 FORMAT "%13.5" EXTENDED_LIMITS 0.00 4294967295.00 /end CHARACTERISTIC
/begin CHARACTERISTIC CoEng_nActrRelease_C "#SSD Mindestdrehzahl für Stellerfreigabe" VALUE 0xC84BC Kw_Ws16 32727.00 EngN 40.00000 32767.00 FORMAT "%8.2" EXTENDED_LIMITS -32768.00 32767.00 /end CHARACTERISTIC
/begin CHARACTERISTIC CoEng_nOvrFulMin_C "untere Hysteresegrenze für Overfueling Motordrehzahl" VALUE 0xC88CE Kw_Ws16 5960.000 EngN 40.00000 6000.000 FORMAT "%8.3" EXTENDED_LIMITS -32768.00 32767.00 /end CHARACTERISTIC
/begin CHARACTERISTIC CoEng_nOvrFulMax_C "obere Hysteresegrenze für Overfueling Motordrehzahl" VALUE 0xC88D0 Kw_Ws16 5960.000 EngN 40.00000 6000.000 FORMAT "%8.3" EXTENDED_LIMITS -32768.00 32767.00 /end CHARACTERISTIC
/begin CHARACTERISTIC CoEng_stnOvrFulLow_C "Status für Overfueling Motordrehzahl Hysterese aus" VALUE 0xC88D2 Kw_Ws16 65535.00 OneToOne -32768.00 32767.00 FORMAT "%8.2" READ_ONLY /end CHARACTERISTIC
/begin CHARACTERISTIC CoEng_stnOvrFulHigh_C "Status für Overfueling Motordrehzahl Hysterese ein" VALUE 0xC88D4 Kw_Ws16 65535.00 OneToOne -32768.00 32767.00 FORMAT "%8.2" READ_ONLY /end CHARACTERISTIC
/begin CHARACTERISTIC CoEng_nShOffTstMax_C "#SSD maximale Drehzahlschwelle für Abstelltest" VALUE 0xC8820 Kw_Ws16 32767.00 EngN 0.00 32767.00 FORMAT "%8.2" EXTENDED_LIMITS -32768.00 32767.00 /end CHARACTERISTIC
/begin CHARACTERISTIC CoEng_nShOffTstMin_C "#SSD minimale Drehzahlschwelle für Abstelltest" VALUE 0xC8822 Kw_Ws16 32767.00 EngN 0.00 32767.00 FORMAT "%8.2" EXTENDED_LIMITS -32768.00 32767.00 /end CHARACTERISTIC
/begin CHARACTERISTIC CoEng_nSlpLimMin_C "Drehzahlschwelle f. Aktivierung Tuboschubbegrenzung" VALUE 0xC8B6C Kw_Ws16 32767.00 EngN 0.00 32767.00 FORMAT "%8.2" EXTENDED_LIMITS -32768.00 32767.00 /end CHARACTERISTIC
/begin CHARACTERISTIC CoEng_nSoftShOffMax_C "engine speed limit for soft shutoff" VALUE 0xC87C0 Kw_Ws16 32727.00 EngN 40.00000 32767.00 FORMAT "%8.2" EXTENDED_LIMITS -32768.00 32767.00 /end CHARACTERISTIC
/begin CHARACTERISTIC CoEng_nSoftShOffMin_C "minimale Drehzahlschwelle für Komfortabstellung" VALUE 0xC87C2 Kw_Ws16 32727.00 EngN 40.00000 32767.00 FORMAT "%8.2" EXTENDED_LIMITS -32768.00 32767.00 /end CHARACTERISTIC
/begin CHARACTERISTIC CoEng_nThresNrml2Strt_C "Motordrehzahlschwelle für Zustandsübergang von NORMAL nach START" VALUE 0xC8828 Kw_Ws16 8000.000 EngN 0.00 8000.000 FORMAT "%8.3" EXTENDED_LIMITS -32768.00 32767.00 /end CHARACTERISTIC
/begin CHARACTERISTIC CoEng_numSelFuncPref_C "Auswahl Funktion mit uneingeschränkter Priorität" VALUE 0xC8794 Kw_Wu8 7.000 OneToOne 0.00 7.000 FORMAT "%5.3" EXTENDED_LIMITS 0.00 255.0 /end CHARACTERISTIC
/begin CHARACTERISTIC CoEng_facActvFunc2_1_C "Gewichtungsfaktor für Schubphasenzähler für Funktion1" VALUE 0xC8795 Kw_Wu8 10.00 OneToOne 0.00 10.00 FORMAT "%5.2" EXTENDED_LIMITS 0.00 255.0 /end CHARACTERISTIC
/begin CHARACTERISTIC CoEng_facActvFunc2_2_C "Gewichtungsfaktor für Schubphasenzähler für Funktion 2" VALUE 0xC8796 Kw_Wu8 10.00 OneToOne 0.00 10.00 FORMAT "%5.2" EXTENDED_LIMITS 0.00 255.0 /end CHARACTERISTIC
/begin CHARACTERISTIC CoEng_facActvFunc2_3_C "Gewichtungsfaktor für Schubphasenzähler für Funktion 3" VALUE 0xC8797 Kw_Wu8 10.00 OneToOne 0.00 10.00 FORMAT "%5.2" EXTENDED_LIMITS 0.00 255.0 /end CHARACTERISTIC
/begin CHARACTERISTIC CoEng_facActvFunc2_4_C "Gewichtungsfaktor für Schubphasenzähler für Funktion 4" VALUE 0xC8798 Kw_Wu8 10.00 OneToOne 0.00 10.00 FORMAT "%5.2" EXTENDED_LIMITS 0.00 255.0 /end CHARACTERISTIC
/begin CHARACTERISTIC CoEng_facActvFunc2_5_C "Gewichtungsfaktor für Schubphasenzähler für Funktion 5" VALUE 0xC8799 Kw_Wu8 10.00 OneToOne 0.00 10.00 FORMAT "%5.2" EXTENDED_LIMITS 0.00 255.0 /end CHARACTERISTIC
/begin CHARACTERISTIC CoEng_facActvFunc2_6_C "Gewichtungsfaktor für Schubphasenzähler für Funktion 6" VALUE 0xC879A Kw_Wu8 10.00 OneToOne 0.00 10.00 FORMAT "%5.2" EXTENDED_LIMITS 0.00 255.0 /end CHARACTERISTIC
/begin CHARACTERISTIC CoEng_facActvFunc2_7_C "Gewichtungsfaktor für Schubphasenzähler für Funktion 7" VALUE 0xC879B Kw_Wu8 10.00 OneToOne 0.00 10.00 FORMAT "%5.2" EXTENDED_LIMITS 0.00 255.0 /end CHARACTERISTIC
/begin CHARACTERISTIC CoEng_facActvFunc2_8_C "Gewichtungsfaktor für Schubphasenzähler für reservierte Funktion 8" VALUE 0xC879C Kw_Wu8 0.00 OneToOne 0.00 0.00 FORMAT "%5.2" EXTENDED_LIMITS 0.00 255.0 /end CHARACTERISTIC
/begin CHARACTERISTIC CoEng_facActvFunc1_C "Gewichtungsfaktor für Schubphasenzähler für Funktion 1" VALUE 0xC879D Kw_Wu8 10.00 OneToOne 0.00 10.00 FORMAT "%5.2" EXTENDED_LIMITS 0.00 255.0 /end CHARACTERISTIC
/begin CHARACTERISTIC CoEng_facActvFunc2_C "Gewichtungsfaktor für Schubphasenzähler für Funktion 2" VALUE 0xC879E Kw_Wu8 10.00 OneToOne 0.00 10.00 FORMAT "%5.2" EXTENDED_LIMITS 0.00 255.0 /end CHARACTERISTIC
/begin CHARACTERISTIC CoEng_facActvFunc3_C "Gewichtungsfaktor für Schubphasenzähler für Funktion 3" VALUE 0xC879F Kw_Wu8 10.00 OneToOne 0.00 10.00 FORMAT "%5.2" EXTENDED_LIMITS 0.00 255.0 /end CHARACTERISTIC
/begin CHARACTERISTIC CoEng_facActvFunc4_C "Gewichtungsfaktor für Schubphasenzähler für Funktion 4" VALUE 0xC87A0 Kw_Wu8 10.00 OneToOne 0.00 10.00 FORMAT "%5.2" EXTENDED_LIMITS 0.00 255.0 /end CHARACTERISTIC
/begin CHARACTERISTIC CoEng_facActvFunc5_C "Gewichtungsfaktor für Schubphasenzähler für Funktion 5" VALUE 0xC87A1 Kw_Wu8 10.00 OneToOne 0.00 10.00 FORMAT "%5.2" EXTENDED_LIMITS 0.00 255.0 /end CHARACTERISTIC
/begin CHARACTERISTIC CoEng_facActvFunc6_C "Gewichtungsfaktor für Schubphasenzähler für Funktion 6" VALUE 0xC87A2 Kw_Wu8 10.00 OneToOne 0.00 10.00 FORMAT "%5.2" EXTENDED_LIMITS 0.00 255.0 /end CHARACTERISTIC
/begin CHARACTERISTIC CoEng_facActvFunc7_C "Gewichtungsfaktor für Schubphasenzähler für Funktion 7" VALUE 0xC87A3 Kw_Wu8 10.00 OneToOne 0.00 10.00 FORMAT "%5.2" EXTENDED_LIMITS 0.00 255.0 /end CHARACTERISTIC
/begin CHARACTERISTIC CoEng_facActvFunc8_C "Gewichtungsfaktor für Schubphasenzähler für Funktion 8" VALUE 0xC87A4 Kw_Wu8 0.00 OneToOne 0.00 0.00 FORMAT "%5.2" EXTENDED_LIMITS 0.00 255.0 /end CHARACTERISTIC
/begin CHARACTERISTIC CoEng_dtrqRmpUp_C "Rampensteigung aufwärts für Schubabschaltung( nicht applizierbar da nie in Gebrauch)" VALUE 0xC882C Kw_Wu32 6553584.99908 RmpTrq 14.9993896484 6553599.99847 FORMAT "%13.5" EXTENDED_LIMITS 0.00 6553599.99847 READ_ONLY /end CHARACTERISTIC
/begin CHARACTERISTIC CoEng_dtrqRmpDwn_C "Rampensteigung bei Schubabschaltung" VALUE 0xC8830 Kw_Wu32 6553584.99908 RmpTrq 14.9993896484 6553599.99847 FORMAT "%13.5" EXTENDED_LIMITS 0.00 6553599.99847 /end CHARACTERISTIC
/begin CHARACTERISTIC CoEng_tiPFltdVolPT1_C "Filterzeitkonstante für Volumenstrom" VALUE 0xC88D8 Kw_Wu32 4294.9673 TimeDelay_s 0.0000010000000 4294.9673 FORMAT "%9.4" /end CHARACTERISTIC
/begin CHARACTERISTIC CoEng_tiPFltResFlowPT1_C "Filterzeitkonstante für Strömungswiderstand" VALUE 0xC88DC Kw_Wu32 4294.9673 TimeDelay_s 0.0000010000000 4294.9673 FORMAT "%9.4" /end CHARACTERISTIC
/begin CHARACTERISTIC CoEng_qSoftShOffMax_C "injection quantity limit for soft shutoff" VALUE 0xC87C4 Kw_Ws16 327.6700 InjMassCyc 0.00 327.6700 FORMAT "%8.4" EXTENDED_LIMITS -327.6800 327.6700 /end CHARACTERISTIC
/begin CHARACTERISTIC CoEng_qSubs_MAP "Kennfeld für Ersatzmenge im Regenerationsfall" MAP 0xC84E2 Kf_Xs16_Ys16_Ws16 80.00000 InjMassCyc 0.00 80.00000 FORMAT "%8.5" EXTENDED_LIMITS -327.6800 327.6700
 /begin AXIS_DESCR STD_AXIS Eng_nAvrg EngN 16 0.00 8000.000 FORMAT "%8.3" EXTENDED_LIMITS -32768.00 32767.00 DEPOSIT ABSOLUTE /end AXIS_DESCR
 /begin AXIS_DESCR STD_AXIS CoEng_trq Trq 16 0.00 200.0000 FORMAT "%8.4" EXTENDED_LIMITS -3276.800 3276.700 DEPOSIT ABSOLUTE /end AXIS_DESCR
/end CHARACTERISTIC
/begin CHARACTERISTIC CoEng_rhoFuel_C "#SSD Kraftstoffdichte" VALUE 0xC8726 Kw_Ws16 1500.000 RhoFuel 0.00 1500.000 FORMAT "%8.3" EXTENDED_LIMITS -3276.800 3276.700 /end CHARACTERISTIC
/begin CHARACTERISTIC CoEng_dtrqOvrFulUp_C "Steigung des Drehmoments (Nm/s) für Overfueling ramp switch" VALUE 0xC88E0 Kw_Wu32 6553594.99817 RmpTrq 5.00030517578 6553599.99847 FORMAT "%13.5" EXTENDED_LIMITS 0.00 6553599.99847 /end CHARACTERISTIC
/begin CHARACTERISTIC CoEng_dtrqOvrFulDown_C "Steigung des Drehmoments (Nm/s) für Overfueling ramp switch" VALUE 0xC88E4 Kw_Wu32 6553594.99817 RmpTrq 5.00030517578 6553599.99847 FORMAT "%13.5" EXTENDED_LIMITS 0.00 6553599.99847 /end CHARACTERISTIC
/begin CHARACTERISTIC CoEng_rOvrFulMin_C "untere Hysteresegrenze für Overfueling Gaspedalposition" VALUE 0xC88E8 Kw_Ws16 100.0000 Prc 0.00 100.0000 FORMAT "%8.4" EXTENDED_LIMITS -400.0000 399.9878 /end CHARACTERISTIC
/begin CHARACTERISTIC CoEng_rOvrFulMax_C "obere Hysteresegrenze für Overfueling Gaspedalposition" VALUE 0xC88EA Kw_Ws16 100.0000 Prc 0.00 100.0000 FORMAT "%8.4" EXTENDED_LIMITS -400.0000 399.9878 /end CHARACTERISTIC
/begin CHARACTERISTIC CoEng_strOvrFulLow_C "status for overfueling acceleration pedale position hysteresis off" VALUE 0xC88EC Kw_Ws16 65535.00 OneToOne -32768.00 32767.00 FORMAT "%8.2" READ_ONLY /end CHARACTERISTIC
/begin CHARACTERISTIC CoEng_strOvrFulHigh_C "status for overfueling acceleration pedale position hysteresis on" VALUE 0xC88EE Kw_Ws16 65535.00 OneToOne -32768.00 32767.00 FORMAT "%8.2" READ_ONLY /end CHARACTERISTIC
/begin CHARACTERISTIC CoEng_dtrqSlpLimUpdef_C "Anstiegsbegrenzung f. Rauchgrenze ""Turboschubbegrenzung"" bei unbekannter Ganginformation" VALUE 0xC8B70 Kw_Wu32 6553599.99847 RmpTrq 0.00 6553599.99847 FORMAT "%13.5" /end CHARACTERISTIC
/begin CHARACTERISTIC CoEng_dtrqSlpLimDwndef_C "Abwärts-Momentenbegrenzung für Rauchbegrenzung/Turboschubbegrenzung (fest auf maximalem Abstieg) bei unbekannter Ganginformation" VALUE 0xC8B74 Kw_Wu32 6553599.99847 RmpTrq 0.00 6553599.99847 FORMAT "%13.5" READ_ONLY /end CHARACTERISTIC
/begin CHARACTERISTIC CoEng_dtrqSlpLimUp1_C "Anstiegsbegrenzung f. Rauchgrenze ""Turboschubbegrenzung"" bei Gang 1" VALUE 0xC8B78 Kw_Wu32 6553599.99847 RmpTrq 0.00 6553599.99847 FORMAT "%13.5" /end CHARACTERISTIC
/begin CHARACTERISTIC CoEng_dtrqSlpLimDwn1_C "Abwärts-Momentenbegrenzung für Rauchbegrenzung/Turboschubbegrenzung (fest auf maximalem Abstieg) bei Gang 1" VALUE 0xC8B7C Kw_Wu32 6553599.99847 RmpTrq 0.00 6553599.99847 FORMAT "%13.5" READ_ONLY /end CHARACTERISTIC
/begin CHARACTERISTIC CoEng_dtrqSlpLimUp2_C "Anstiegsbegrenzung f. Rauchgrenze ""Turboschubbegrenzung"" bei Gang 2" VALUE 0xC8B80 Kw_Wu32 6553599.99847 RmpTrq 0.00 6553599.99847 FORMAT "%13.5" /end CHARACTERISTIC
/begin CHARACTERISTIC CoEng_dtrqSlpLimDwn2_C "Abwärts-Momentenbegrenzung für Rauchbegrenzung/Turboschubbegrenzung (fest auf maximalem Abstieg) bei Gang 2" VALUE 0xC8B84 Kw_Wu32 6553599.99847 RmpTrq 0.00 6553599.99847 FORMAT "%13.5" READ_ONLY /end CHARACTERISTIC
/begin CHARACTERISTIC CoEng_dtrqSlpLimUp3_C "Anstiegsbegrenzung f. Rauchgrenze ""Turboschubbegrenzung"" bei Gang 3" VALUE 0xC8B88 Kw_Wu32 6553599.99847 RmpTrq 0.00 6553599.99847 FORMAT "%13.5" /end CHARACTERISTIC
/begin CHARACTERISTIC CoEng_dtrqSlpLimDwn3_C "Abwärts-Momentenbegrenzung für Rauchbegrenzung/Turboschubbegrenzung (fest auf maximalem Abstieg) bei Gang 3" VALUE 0xC8B8C Kw_Wu32 6553599.99847 RmpTrq 0.00 6553599.99847 FORMAT "%13.5" READ_ONLY /end CHARACTERISTIC
/begin CHARACTERISTIC CoEng_dtrqSlpLimUp4_C "Anstiegsbegrenzung f. Rauchgrenze ""Turboschubbegrenzung"" bei Gang 4" VALUE 0xC8B90 Kw_Wu32 6553599.99847 RmpTrq 0.00 6553599.99847 FORMAT "%13.5" /end CHARACTERISTIC
/begin CHARACTERISTIC CoEng_dtrqSlpLimDwn4_C "Abwärts-Momentenbegrenzung für Rauchbegrenzung/Turboschubbegrenzung (fest auf maximalem Abstieg) bei Gang 4" VALUE 0xC8B94 Kw_Wu32 6553599.99847 RmpTrq 0.00 6553599.99847 FORMAT "%13.5" READ_ONLY /end CHARACTERISTIC
/begin CHARACTERISTIC CoEng_dtrqSlpLimUp5_C "Anstiegsbegrenzung f. Rauchgrenze ""Turboschubbegrenzung"" bei Gang 5" VALUE 0xC8B98 Kw_Wu32 6553599.99847 RmpTrq 0.00 6553599.99847 FORMAT "%13.5" /end CHARACTERISTIC
/begin CHARACTERISTIC CoEng_dtrqSlpLimDwn5_C "Abwärts-Momentenbegrenzung für Rauchbegrenzung/Turboschubbegrenzung (fest auf maximalem Abstieg) bei Gang 5" VALUE 0xC8B9C Kw_Wu32 6553599.99847 RmpTrq 0.00 6553599.99847 FORMAT "%13.5" READ_ONLY /end CHARACTERISTIC
/begin CHARACTERISTIC CoEng_dtrqSlpLimUp6_C "Anstiegsbegrenzung f. Rauchgrenze ""Turboschubbegrenzung"" bei Gang 6" VALUE 0xC8BA0 Kw_Wu32 6553599.99847 RmpTrq 0.00 6553599.99847 FORMAT "%13.5" /end CHARACTERISTIC
/begin CHARACTERISTIC CoEng_dtrqSlpLimDwn6_C "Abwärts-Momentenbegrenzung für Rauchbegrenzung/Turboschubbegrenzung (fest auf maximalem Abstieg) bei Gang 6" VALUE 0xC8BA4 Kw_Wu32 6553599.99847 RmpTrq 0.00 6553599.99847 FORMAT "%13.5" READ_ONLY /end CHARACTERISTIC
/begin CHARACTERISTIC CoEng_dtrqSlpLimUpREV_C "Anstiegsbegrenzung f. Rauchgrenze ""Turboschubbegrenzung"" bei Rückwärtsgang" VALUE 0xC8BA8 Kw_Wu32 6553599.99847 RmpTrq 0.00 6553599.99847 FORMAT "%13.5" /end CHARACTERISTIC
/begin CHARACTERISTIC CoEng_dtrqSlpLimDwnREV_C "Abwärts-Momentenbegrenzung für Rauchbegrenzung/Turboschubbegrenzung (fest auf maximalem Abstieg) bei Rückwärtsgang" VALUE 0xC8BAC Kw_Wu32 6553599.99847 RmpTrq 0.00 6553599.99847 FORMAT "%13.5" READ_ONLY /end CHARACTERISTIC
/begin CHARACTERISTIC CoEng_stAftRunSel_C "Schalterauswahl für den Nachlauf" VALUE 0xC84C0 Kw_Wu8 255.0 OneToOne 0.00 255.0 FORMAT "%5.1" /end CHARACTERISTIC
/begin CHARACTERISTIC CoEng_stCoopCapbl_C "Kooperationsattribute zu koordinierender Funktionen im Schubkoordinator (bitcodiert)" VALUE 0xC87A5 Kw_Wu8 127.0 OneToOne 0.00 127.0 FORMAT "%5.1" EXTENDED_LIMITS 0.00 255.0 /end CHARACTERISTIC
/begin CHARACTERISTIC CoEng_stIRevShutOff_C "#SSD Maske für irreversible Abschaltursachen" VALUE 0xC872C Kw_Wu32 4294967295.00 OneToOne 0.00 4294967295.00 FORMAT "%13.2" /end CHARACTERISTIC
/begin CHARACTERISTIC CoEng_stOvrRunRgnMsk_C "Maske zur Erkennung der Regenerationsart" VALUE 0xC87A8 Kw_Wu32 4294967295.00 OneToOne 0.00 4294967295.00 FORMAT "%13.2" /end CHARACTERISTIC
/begin CHARACTERISTIC CoEng_stRevShutOff_C "#SSD Maske für reversible Abschaltursachen" VALUE 0xC8730 Kw_Wu32 4294967295.00 OneToOne 0.00 4294967295.00 FORMAT "%13.2" /end CHARACTERISTIC
/begin CHARACTERISTIC CoEng_stShOffAddReqIRev_C "#SSD Abstellpfade für kundenspezifische irreversible Abschaltanforderung" VALUE 0xC8734 Kw_Wu32 4294967295.00 OneToOne 0.00 4294967295.00 FORMAT "%13.2" /end CHARACTERISTIC
/begin CHARACTERISTIC CoEng_stShOffAddReqRev_C "#SSD Abstellpfade für kundenspezifische reversible Abschaltanforderung" VALUE 0xC8738 Kw_Wu32 4294967295.00 OneToOne 0.00 4294967295.00 FORMAT "%13.2" /end CHARACTERISTIC
/begin CHARACTERISTIC CoEng_stShOffAftRun_C "#SSD Abschaltanforderungen im Nachlauf" VALUE 0xC87C8 Kw_Wu32 4294967295.00 OneToOne 0.00 4294967295.00 FORMAT "%13.2" /end CHARACTERISTIC
/begin CHARACTERISTIC CoEng_stShOffAirbFrnt_C "#SSD Abstellpfade für Airbag Frontalaufprall aktiv" VALUE 0xC873C Kw_Wu32 4294967295.00 OneToOne 0.00 4294967295.00 FORMAT "%13.2" /end CHARACTERISTIC
/begin CHARACTERISTIC CoEng_stShOffAirbRear_C "#SSD Abstellpfade für Airbag Heckaufprall aktiv" VALUE 0xC8740 Kw_Wu32 4294967295.00 OneToOne 0.00 4294967295.00 FORMAT "%13.2" /end CHARACTERISTIC
/begin CHARACTERISTIC CoEng_stShOffAirbSide_C "#SSD Abstellpfade für Airbag Seitenaufprall aktiv" VALUE 0xC8744 Kw_Wu32 4294967295.00 OneToOne 0.00 4294967295.00 FORMAT "%13.2" /end CHARACTERISTIC
/begin CHARACTERISTIC CoEng_stShOffCycSigChk_C "Abstellpfad für Fehler bei zyklischem Signaturcheck" VALUE 0xC8748 Kw_Wu32 4294967295.00 OneToOne 0.00 4294967295.00 FORMAT "%13.2" /end CHARACTERISTIC
/begin CHARACTERISTIC CoEng_stShOffDblCtl_C "#SSD Abstellpfade für unzulässigen Hochdruck-Reglerbetrieb (nur 2-Reglerkonzept)" VALUE 0xC874C Kw_Wu32 4294967295.00 OneToOne 0.00 4294967295.00 FORMAT "%13.2" /end CHARACTERISTIC
/begin CHARACTERISTIC CoEng_stShOffDiaReqFI_C "#SSD Abstellantwort von Diagnose-Schnittstelle fuer Kraftstoffzusatz" VALUE 0xC8750 Kw_Wu32 4294967295.00 OneToOne 0.00 4294967295.00 FORMAT "%13.2" /end CHARACTERISTIC
/begin CHARACTERISTIC CoEng_stShOffExtReq_C "#SSD Abstellpfade bei externer Anforderung" VALUE 0xC87CC Kw_Wu32 4294967295.00 OneToOne 0.00 4294967295.00 FORMAT "%13.2" /end CHARACTERISTIC
/begin CHARACTERISTIC CoEng_stShOffFWOscDet_C "#SSD Abschaltpfad für Schwungscheibenschwingung (-Schwungradschwingung)" VALUE 0xC8754 Kw_Wu32 4294967295.00 OneToOne 0.00 4294967295.00 FORMAT "%13.2" /end CHARACTERISTIC
/begin CHARACTERISTIC CoEng_stShOffInit_C "#SSD Abstellpfade, die nach der Initialisierung im Eingriff sind" VALUE 0xC8758 Kw_Wu32 4294967295.00 OneToOne 0.00 4294967295.00 FORMAT "%13.2" /end CHARACTERISTIC
/begin CHARACTERISTIC CoEng_stShOffInjMon_C "#SSD Abstellpfade für mehrfache Injektorlastabfälle" VALUE 0xC875C Kw_Wu32 4294967295.00 OneToOne 0.00 4294967295.00 FORMAT "%13.2" /end CHARACTERISTIC
/begin CHARACTERISTIC CoEng_stShOffInjShCir_C "#SSD Abstellpfade bei Injektorkurzschluss" VALUE 0xC8760 Kw_Wu32 4294967295.00 OneToOne 0.00 4294967295.00 FORMAT "%13.2" /end CHARACTERISTIC
/begin CHARACTERISTIC CoEng_stShOffIRevSys1_C "#SSD Abstellpfade für irreversible Systemfehler 1" VALUE 0xC8764 Kw_Wu32 4294967295.00 OneToOne 0.00 4294967295.00 FORMAT "%13.2" /end CHARACTERISTIC
/begin CHARACTERISTIC CoEng_stShOffIRevSys2_C "#SSD Abstellpfade für irreversible Systemfehler 2" VALUE 0xC8768 Kw_Wu32 4294967295.00 OneToOne 0.00 4294967295.00 FORMAT "%13.2" /end CHARACTERISTIC
/begin CHARACTERISTIC CoEng_stShOffIRevVeh_C "#SSD Abstellpfade für irreversible Fahrzeugfehler" VALUE 0xC876C Kw_Wu32 4294967295.00 OneToOne 0.00 4294967295.00 FORMAT "%13.2" /end CHARACTERISTIC
/begin CHARACTERISTIC CoEng_stShOffIrrCmb_C "#SSD Abstellpfade bei irregulärer Verbrennung" VALUE 0xC8770 Kw_Wu32 4294967295.00 OneToOne 0.00 4294967295.00 FORMAT "%13.2" /end CHARACTERISTIC
/begin CHARACTERISTIC CoEng_stShOffOvrSpd_C "#SSD Abstellpfade aufgrund Überdrehzahl" VALUE 0xC8774 Kw_Wu32 4294967295.00 OneToOne 0.00 4294967295.00 FORMAT "%13.2" /end CHARACTERISTIC
/begin CHARACTERISTIC CoEng_stShOffPresMin_C "#SSD Abstellpfade bei Mindestraildruck unteschritten" VALUE 0xC8778 Kw_Wu32 4294967295.00 OneToOne 0.00 4294967295.00 FORMAT "%13.2" /end CHARACTERISTIC
/begin CHARACTERISTIC CoEng_stShOffRevSys1_C "#SSD Abstellpfade für reversible Systemfehler 1" VALUE 0xC877C Kw_Wu32 4294967295.00 OneToOne 0.00 4294967295.00 FORMAT "%13.2" /end CHARACTERISTIC
/begin CHARACTERISTIC CoEng_stShOffRevSys2_C "#SSD Abstellpfade für reversible Systemfehler 2" VALUE 0xC8780 Kw_Wu32 4294967295.00 OneToOne 0.00 4294967295.00 FORMAT "%13.2" /end CHARACTERISTIC
/begin CHARACTERISTIC CoEng_stShOffRevVeh_C "#SSD Abstellpfade für reversible Fahrzeugfehler" VALUE 0xC8784 Kw_Wu32 4294967295.00 OneToOne 0.00 4294967295.00 FORMAT "%13.2" /end CHARACTERISTIC
/begin CHARACTERISTIC CoEng_stShOffRlOvrBar_C "#SSD Abstellpfade für Überrollbügel aktiv" VALUE 0xC8788 Kw_Wu32 4294967295.00 OneToOne 0.00 4294967295.00 FORMAT "%13.2" /end CHARACTERISTIC
/begin CHARACTERISTIC CoEng_stShOffSV_C "#SSD Abstellpfade aufgrund dauerbestromtem Magnetventil" VALUE 0xC878C Kw_Wu32 4294967295.00 OneToOne 0.00 4294967295.00 FORMAT "%13.2" /end CHARACTERISTIC
/begin CHARACTERISTIC CoEng_stShOffTstSel_C "#SSD Auswahl der möglichen Abstelltests (Bit 0: ESD/PSP, 1:PCV)" VALUE 0xC87D0 Kw_Wu16 65535.00 OneToOne 0.00 65535.00 FORMAT "%8.2" /end CHARACTERISTIC
/begin CHARACTERISTIC CoEng_stSoftShOffAR_C "#SSD Abschaltanforderung im Nachlauf für Komfortabstellung" VALUE 0xC87D4 Kw_Wu32 4294967295.00 OneToOne 0.00 4294967295.00 FORMAT "%13.2" /end CHARACTERISTIC
/begin CHARACTERISTIC CoEng_stSubsRgnMsk_C "Maske für Umschaltung auf Ersatzkennfeld" VALUE 0xC8728 Kw_Wu32 4294967295.00 OneToOne 0.00 4294967295.00 FORMAT "%13.2" /end CHARACTERISTIC
/begin CHARACTERISTIC CoEng_tiActrPrt_C "#SSD maximale Zeit für Stellerbestromung" VALUE 0xC84BE Kw_Wu16 655350.0 Time_ms 0.00 655350.0 FORMAT "%8.1" /end CHARACTERISTIC
/begin CHARACTERISTIC CoEng_tiDlyT15_C "#SSD Zeit für Fehlerausblendung nach Klemme15 Ein (Abwarten der Init-Zeit anderer Steuergeräte)" VALUE 0xC87B4 Kw_Wu16 5000.000 Time_ms 0.00 5000.000 FORMAT "%8.3" EXTENDED_LIMITS 0.00 655350.0 /end CHARACTERISTIC
/begin CHARACTERISTIC CoEng_tiMinAftRun_C "#SSD minimale Nachlaufzeit" VALUE 0xC84C8 Kw_Wu32 42949672950.0 Time_ms 0.00 42949672950.0 FORMAT "%13.1" /end CHARACTERISTIC
/begin CHARACTERISTIC CoEng_tiMRlyShutOffDel_C "delaytime for afterrun" VALUE 0xC84CC Kw_Wu16 655350.0 Time_ms 0.00 655350.0 FORMAT "%8.1" /end CHARACTERISTIC
/begin CHARACTERISTIC CoEng_tiNrml2Strt_C "Entprellzeit für Zustandsübergang von NORMAL nach START" VALUE 0xC882A Kw_Wu16 655350.0 Time_ms 0.00 655350.0 FORMAT "%8.1" /end CHARACTERISTIC
/begin CHARACTERISTIC CoEng_tiOvrRunCoordDebPos_C "#SSD Entprellzeit für den Übergang ""Kein Schub -> Schub"" im Schubkoordinator" VALUE 0xC87AC Kw_Wu16 1000.000 Time_ms 0.00 1000.000 FORMAT "%8.3" EXTENDED_LIMITS 0.00 655350.0 /end CHARACTERISTIC
/begin CHARACTERISTIC CoEng_tiPwrStgDiaRdy_C "#SSD Verzoegerungszeit, um im Nachlauf abgeschaltete Steller zu diagnostizieren" VALUE 0xC84C2 Kw_Wu16 655350.0 Time_ms 0.00 655350.0 FORMAT "%8.1" /end CHARACTERISTIC
/begin CHARACTERISTIC CoEng_tiRepOvrFul_C "Sperrzeit für Overfueling timer" VALUE 0xC88F0 Kw_Wu32 21474836.4700 Time_s 0.00 21474836.4700 FORMAT "%13.4" EXTENDED_LIMITS 0.00 42949672.9500 /end CHARACTERISTIC
/begin CHARACTERISTIC CoEng_tiRmpStrtDfl_C "Default Wartezeit nach Schuberkennung bis Rampe startet" VALUE 0xC8834 Kw_Wu16 655350.0 Time_ms 0.00 655350.0 FORMAT "%8.1" /end CHARACTERISTIC
/begin CHARACTERISTIC CoEng_tiRmpStrt_CUR "Wartezeit nach Schuberkennung bei Grip bis Rampe startet" CURVE 0xC8836 Kl_Xs16_Ws16 10000.00 Time_ms 0.00 10000.00 FORMAT "%8.2" EXTENDED_LIMITS -327680.0 327670.0
 /begin AXIS_DESCR STD_AXIS DrvTrn_rTransDT TransR 7 0.00 10.00000 FORMAT "%8.5" EXTENDED_LIMITS -327.6800 327.6700 DEPOSIT ABSOLUTE /end AXIS_DESCR
/end CHARACTERISTIC
/begin CHARACTERISTIC CoEng_tiShOffTstFlSys_C "Zeit bis Ansteuerdauer == 0 beim Test des niederdruckseitigen Abstellpfades" VALUE 0xC87D8 Kw_Wu16 655350.0 Time_ms 0.00 655350.0 FORMAT "%8.1" /end CHARACTERISTIC
/begin CHARACTERISTIC CoEng_tiSoftShOff_CUR "#SSD Curve to calculate time delay for soft shutoff" CURVE 0xC87DA Kl_Xs16_Ws16 600.0000 Time_ms 0.00 600.0000 FORMAT "%8.4" EXTENDED_LIMITS -327680.0 327670.0
 /begin AXIS_DESCR STD_AXIS Eng_nAvrg EngN 16 0.00 6000.000 FORMAT "%8.3" EXTENDED_LIMITS -32768.00 32767.00 DEPOSIT ABSOLUTE /end AXIS_DESCR
/end CHARACTERISTIC
/begin CHARACTERISTIC CoEng_tiSwtOffDfl_C "Default Wartezeit nach Schuberkennung bis Abschaltung" VALUE 0xC8854 Kw_Wu16 655350.0 Time_ms 0.00 655350.0 FORMAT "%8.1" /end CHARACTERISTIC
/begin CHARACTERISTIC CoEng_tiSwtOff_CUR "Wartezeit nach Schuberkennung bei Grip bis Abschaltung" CURVE 0xC8856 Kl_Xs16_Ws16 10000.00 Time_ms 0.00 10000.00 FORMAT "%8.2" EXTENDED_LIMITS -327680.0 327670.0
 /begin AXIS_DESCR STD_AXIS DrvTrn_rTransDT TransR 7 0.00 10.00000 FORMAT "%8.5" EXTENDED_LIMITS -327.6800 327.6700 DEPOSIT ABSOLUTE /end AXIS_DESCR
/end CHARACTERISTIC
/begin CHARACTERISTIC CoEng_tiThresFuncPref_C "Schwelle für Betriebszeit Motor ein" VALUE 0xC87B0 Kw_Wu32 100000.000000 TimeEngOn 0.00 100000.000000 FORMAT "%13.6" EXTENDED_LIMITS 0.00 4294967295.00 /end CHARACTERISTIC
/begin CHARACTERISTIC CoEng_tiTstMax_C "Maximale Zeit zwischen zwei Testanforderungen" VALUE 0xC8BB0 Kw_Wu16 655350.0 Time_ms 0.00 655350.0 FORMAT "%8.1" /end CHARACTERISTIC
/begin CHARACTERISTIC CoEng_tiWakeUp_C "delaytime for afterrun caused hidden pre glow" VALUE 0xC84D0 Kw_Wu32 42949672950.0 Time_ms 0.00 42949672950.0 FORMAT "%13.1" /end CHARACTERISTIC
/begin CHARACTERISTIC CoEng_trqInrSetLim_CUR "Sollwert des inneren Moments wenn Schub erkannt wurde und die Schubüberwachung aktiv ist" CURVE 0xC8874 Kl_Xs16_Ws16 3276.700 Trq 0.00 3276.700 FORMAT "%8.3" EXTENDED_LIMITS -3276.800 3276.700
 /begin AXIS_DESCR STD_AXIS CoEng_tiOvRMon_mp Time_ms 3 0.00 327670.0 FORMAT "%8.1" EXTENDED_LIMITS -327680.0 327670.0 DEPOSIT ABSOLUTE /end AXIS_DESCR
/end CHARACTERISTIC
/begin CHARACTERISTIC CoEng_trqLimErr1_CUR "Kennlinie für Begrenzungsmoment abhängig von der Drehzahl im Fehlerfall" CURVE 0xC88F4 Kl_Xs16_Ws16 1000.000 Trq 0.00 1000.000 FORMAT "%8.3" EXTENDED_LIMITS -3276.800 3276.700
 /begin AXIS_DESCR STD_AXIS Eng_nAvrg EngN 10 0.00 6000.000 FORMAT "%8.3" EXTENDED_LIMITS -32768.00 32767.00 DEPOSIT ABSOLUTE /end AXIS_DESCR
/end CHARACTERISTIC
/begin CHARACTERISTIC CoEng_trqLimErr2_CUR "Kennlinie für Begrenzungsmoment abhängig von der Drehzahl im Fehlerfall 2" CURVE 0xC891E Kl_Xs16_Ws16 1000.000 Trq 0.00 1000.000 FORMAT "%8.3" EXTENDED_LIMITS -3276.800 3276.700
 /begin AXIS_DESCR STD_AXIS Eng_nAvrg EngN 10 0.00 6000.000 FORMAT "%8.3" EXTENDED_LIMITS -32768.00 32767.00 DEPOSIT ABSOLUTE /end AXIS_DESCR
/end CHARACTERISTIC
/begin CHARACTERISTIC CoEng_trqLimErr3_CUR "Kennlinie für Begrenzungsmoment abhängig von der Drehzahl im Fehlerfall 3" CURVE 0xC8948 Kl_Xs16_Ws16 1000.000 Trq 0.00 1000.000 FORMAT "%8.3" EXTENDED_LIMITS -3276.800 3276.700
 /begin AXIS_DESCR STD_AXIS Eng_nAvrg EngN 10 0.00 6000.000 FORMAT "%8.3" EXTENDED_LIMITS -32768.00 32767.00 DEPOSIT ABSOLUTE /end AXIS_DESCR
/end CHARACTERISTIC
/begin CHARACTERISTIC CoEng_trqLimErr4_CUR "Kennlinie für Begrenzungsmoment abhängig von der Drehzahl im Fehlerfall 4" CURVE 0xC8972 Kl_Xs16_Ws16 1000.000 Trq 0.00 1000.000 FORMAT "%8.3" EXTENDED_LIMITS -3276.800 3276.700
 /begin AXIS_DESCR STD_AXIS Eng_nAvrg EngN 10 0.00 6000.000 FORMAT "%8.3" EXTENDED_LIMITS -32768.00 32767.00 DEPOSIT ABSOLUTE /end AXIS_DESCR
/end CHARACTERISTIC
/begin CHARACTERISTIC CoEng_trqLimErr_CUR "Kennlinie für das Begrenzungsmoment bei Systemfehlern" CURVE 0xC899C Kl_Xs16_Ws16 1000.000 Trq 0.00 1000.000 FORMAT "%8.3" EXTENDED_LIMITS -3276.800 3276.700
 /begin AXIS_DESCR STD_AXIS Eng_nAvrg EngN 10 0.00 6000.000 FORMAT "%8.3" EXTENDED_LIMITS -32768.00 32767.00 DEPOSIT ABSOLUTE /end AXIS_DESCR
/end CHARACTERISTIC
/begin CHARACTERISTIC CoEng_trqLimPDiff1_CUR "Begrenzunsmoment aufgrund abasgegendruck" CURVE 0xC89C6 Kl_Xs16_Ws16 1500.000 Trq -500.0000 1000.000 FORMAT "%8.3" EXTENDED_LIMITS -3276.800 3276.700
 /begin AXIS_DESCR STD_AXIS PFlt_pDiff Pres_hPa 8 0.00 5000.000 FORMAT "%8.3" EXTENDED_LIMITS -32768.00 32767.00 DEPOSIT ABSOLUTE /end AXIS_DESCR
/end CHARACTERISTIC
/begin CHARACTERISTIC CoEng_trqLimPDiffNOffs_CUR "" CURVE 0xC89E8 Kl_Xs16_Ws16 1000.000 Trq 0.00 1000.000 FORMAT "%8.3" EXTENDED_LIMITS -3276.800 3276.700
 /begin AXIS_DESCR STD_AXIS Eng_nAvrg EngN 16 0.00 6000.000 FORMAT "%8.3" EXTENDED_LIMITS -32768.00 32767.00 DEPOSIT ABSOLUTE /end AXIS_DESCR
/end CHARACTERISTIC
/begin CHARACTERISTIC CoEng_trqLimPDiff_MAP "Limit für differentialdruck des Partikelfilters" MAP 0xC8A2A Kf_Xs16_Ys16_Ws16 1500.000 Trq -500.0000 1000.000 FORMAT "%8.3" EXTENDED_LIMITS -3276.800 3276.700
 /begin AXIS_DESCR STD_AXIS CoEng_pDiffPFltPrdc_mp Pres_hPa 16 0.00 3500.000 FORMAT "%8.3" EXTENDED_LIMITS -32768.00 32767.00 DEPOSIT ABSOLUTE /end AXIS_DESCR
 /begin AXIS_DESCR STD_AXIS Eng_nAvrg EngN 8 0.00 6000.000 FORMAT "%8.3" EXTENDED_LIMITS -32768.00 32767.00 DEPOSIT ABSOLUTE /end AXIS_DESCR
/end CHARACTERISTIC
/begin CHARACTERISTIC CoEng_trqOffs_C "Offset auf Begrenzungsmoment, um Arbeitsbereich f. ARDsr zu schaffen" VALUE 0xC8882 Kw_Ws16 100.0000 Trq 0.00 100.0000 FORMAT "%8.4" EXTENDED_LIMITS -3276.800 3276.700 /end CHARACTERISTIC
/begin CHARACTERISTIC CoEng_trqOvrFulMax_C "oberer Wert für Overfueling Rampe" VALUE 0xC8B5E Kw_Ws16 1000.000 Trq 0.00 1000.000 FORMAT "%8.3" EXTENDED_LIMITS -3276.800 3276.700 /end CHARACTERISTIC
/begin CHARACTERISTIC CoEng_trqOvrFulMin_C "unterer Wert für Overfueling Rampe" VALUE 0xC8B60 Kw_Ws16 1000.000 Trq 0.00 1000.000 FORMAT "%8.3" EXTENDED_LIMITS -3276.800 3276.700 /end CHARACTERISTIC
/begin CHARACTERISTIC CoEng_trqOvrRunThres_C "#SSD Momentenschwelle zur Schuberkennung" VALUE 0xC8884 Kw_Ws16 10.00000 Trq 0.00 10.00000 FORMAT "%8.5" EXTENDED_LIMITS -3276.800 3276.700 /end CHARACTERISTIC
/begin CHARACTERISTIC CoEng_trqSlpLim_Vector "#SSD Bypass Label for CoEng_trqSlpLim (nicht verändern !)" VALUE 0xC3088 Kw_Wu8 255.0 OneToOne 0.00 255.0 FORMAT "%5.1" /end CHARACTERISTIC
/begin CHARACTERISTIC CoEng_trqSlpLim_Channel "#SSD Bypass Label für CoEng_trqSlpLim (nicht verändern !)" VALUE 0xC3089 Kw_Wu8 255.0 OneToOne 0.00 255.0 FORMAT "%5.1" /end CHARACTERISTIC
/begin CHARACTERISTIC CoEng_tShOffTstMin_C "minimale Wassertemperaturschwelle für Abstelltests" VALUE 0xC8824 Kw_Ws16 950.000 Temp_Cels -50.140 899.860 FORMAT "%8.3" EXTENDED_LIMITS -3549.940 3003.560 /end CHARACTERISTIC
/begin CHARACTERISTIC CoEng_uHighBattPwrStgHysHi_C "Oberen schwelle der Hysterese für Höhere Grenze der Batteriespannung" VALUE 0xC87B6 Kw_Ws16 20000.00 Volt_Batt 0.00 20000.00 FORMAT "%8.2" EXTENDED_LIMITS -640625.6 640606.1 /end CHARACTERISTIC
/begin CHARACTERISTIC CoEng_uHighBattPwrStgHysLo_C "Unteren schwelle der Hysterese für Höhere Grenze der Batteriespannung" VALUE 0xC87B8 Kw_Ws16 20000.00 Volt_Batt 0.00 20000.00 FORMAT "%8.2" EXTENDED_LIMITS -640625.6 640606.1 /end CHARACTERISTIC
/begin CHARACTERISTIC CoEng_uLowBattPwrStgHysHi_C "Oberen schwelle der Hysterese für Untere Grenze der Batteriespannung" VALUE 0xC87BA Kw_Ws16 15992.18 Volt_Batt 0.00 15992.18 FORMAT "%8.2" EXTENDED_LIMITS -640625.6 640606.1 /end CHARACTERISTIC
/begin CHARACTERISTIC CoEng_uLowBattPwrStgHysLo_C "Unteren schwelle der Hysterese für Untere Grenze der Batteriespannung" VALUE 0xC87BC Kw_Ws16 15992.18 Volt_Batt 0.00 15992.18 FORMAT "%8.2" EXTENDED_LIMITS -640625.6 640606.1 /end CHARACTERISTIC
/begin CHARACTERISTIC CoEng_vOvrFulMin_C "untere Hysteresegrenze für Overfueling Fahrgeschwindigkeit" VALUE 0xC8B62 Kw_Ws16 300.0000 Vel 0.00 300.0000 FORMAT "%8.4" EXTENDED_LIMITS -327.6800 327.6700 /end CHARACTERISTIC
/begin CHARACTERISTIC CoEng_vOvrFulMax_C "obere Hysteresegrenze für Overfueling Fahrgeschwindigkeit" VALUE 0xC8B64 Kw_Ws16 300.0000 Vel 0.00 300.0000 FORMAT "%8.4" EXTENDED_LIMITS -327.6800 327.6700 /end CHARACTERISTIC
/begin CHARACTERISTIC CoEng_stvOvrFulLow_C "Status für Overfueling Fahrgeschwindigkeit Hysterese aus" VALUE 0xC8B66 Kw_Ws16 65535.00 OneToOne -32768.00 32767.00 FORMAT "%8.2" READ_ONLY /end CHARACTERISTIC
/begin CHARACTERISTIC CoEng_stvOvrFulHigh_C "Status für Overfueling Fahrgeschwindigkeit Hysterese ein" VALUE 0xC8B68 Kw_Ws16 65535.00 OneToOne -32768.00 32767.00 FORMAT "%8.2" READ_ONLY /end CHARACTERISTIC
/begin CHARACTERISTIC CoEng_vShOffTstMin_C "minimale Fahrgeschwindigkeits-Schwelle für Abstelltests" VALUE 0xC8826 Kw_Ws16 327.6700 Vel 0.00 327.6700 FORMAT "%8.4" EXTENDED_LIMITS -327.6800 327.6700 /end CHARACTERISTIC
/begin CHARACTERISTIC CoEng_vSoftShOffMax_C "vehicle speed limit for soft shutoff" VALUE 0xC881C Kw_Ws16 327.6700 Vel 0.00 327.6700 FORMAT "%8.4" EXTENDED_LIMITS -327.6800 327.6700 /end CHARACTERISTIC
/begin CHARACTERISTIC ConvCD_DebPlaDef_C "Zählerwert zur Defektentprellung (PLA)" VALUE 0xC8BB2 Kw_Wu16 65535.00 OneToOne 0.00 65535.00 FORMAT "%8.2" /end CHARACTERISTIC
/begin CHARACTERISTIC ConvCD_DebPlaOk_C "Zählerwert zur Heilungsentprellung (PLA)" VALUE 0xC8BB4 Kw_Wu16 65535.00 OneToOne 0.00 65535.00 FORMAT "%8.2" /end CHARACTERISTIC
/begin CHARACTERISTIC ConvCD_tiDebPos_C "Entprellzeit für pos. Flanke des Kupplungssignals" VALUE 0xC8BB6 Kw_Wu16 2000.000 TimeDeb 0.00 2000.000 FORMAT "%8.3" EXTENDED_LIMITS 0.00 655350.0 /end CHARACTERISTIC
/begin CHARACTERISTIC ConvCD_tiDebNeg_C "Entprellzeit für neg. Flanke des Kupplungssignals." VALUE 0xC8BB8 Kw_Wu16 2000.000 TimeDeb 0.00 2000.000 FORMAT "%8.3" EXTENDED_LIMITS 0.00 655350.0 /end CHARACTERISTIC
/begin CHARACTERISTIC ConvCD_DebSigDef_C "Entprellzeit bis CAN-Botschaftsfehler defekt" VALUE 0xC8BBA Kw_Wu16 655350.0 Time_ms 0.00 655350.0 FORMAT "%8.1" /end CHARACTERISTIC
/begin CHARACTERISTIC ConvCD_DebSigOk_C "Entprellzeit bis CAN-Botschaftsfehler geheilt" VALUE 0xC8BBC Kw_Wu16 655350.0 Time_ms 0.00 655350.0 FORMAT "%8.1" /end CHARACTERISTIC
/begin CHARACTERISTIC ConvCD_nNoGearShftDet_C "Grenzwert unter dem die Gangerkennung für die Plausibilitätsprüfung abgeschaltet werden muss" VALUE 0xC8BBE Kw_Ws16 6000.000 EngN 0.00 6000.000 FORMAT "%8.3" EXTENDED_LIMITS -32768.00 32767.00 /end CHARACTERISTIC
/begin CHARACTERISTIC ConvCD_numDioIn_C "#SSD Applikationsparameter für den Pin des Kupplungssignals" VALUE 0xC8BC0 Kw_Wu8 14.0000000000 NumPinDioIn 0.00 14.0000000000 FORMAT "%13.10" /end CHARACTERISTIC
/begin CHARACTERISTIC ConvCD_numStepDef_C "Zählschrittweite für Aufwärtszählen zur Defektentprellung" VALUE 0xC8BC1 Kw_Wu8 3.000 OneToOne 0.00 3.000 FORMAT "%5.3" EXTENDED_LIMITS 0.00 255.0 /end CHARACTERISTIC
/begin CHARACTERISTIC ConvCD_numStepOK_C "Zählschrittweite für Abwärtszählen zur Heilungsentprellung" VALUE 0xC8BC2 Kw_Wu8 3.000 OneToOne 0.00 3.000 FORMAT "%5.3" EXTENDED_LIMITS 0.00 255.0 /end CHARACTERISTIC
/begin CHARACTERISTIC ConvCD_stDflVal_C "Kupplungssignal Vorgabewert" VALUE 0xC8BC3 Kw_Wu8 1.000 OneToOne 0.00 1.000 FORMAT "%5.3" EXTENDED_LIMITS 0.00 255.0 /end CHARACTERISTIC
/begin CHARACTERISTIC ConvCD_stGripCtlAST_C "Vorgabewert für autom. Schaltgetriebe bei fehlendem Kraftschluß (""rutschende Kupplung"")" VALUE 0xC8BC4 Kw_Wu8 1.000 OneToOne 0.00 1.000 FORMAT "%5.3" EXTENDED_LIMITS 0.00 255.0 /end CHARACTERISTIC
/begin CHARACTERISTIC ConvCD_swtInv_C "Schalter zum invertieren  des Kupplungsignals (0=nichtinvertiert,1=invertiert), Einfluss auf Digitaleingang und CAN" VALUE 0xC8BC5 Kw_Wu8 1.000 OneToOne 0.00 1.000 FORMAT "%5.3" EXTENDED_LIMITS 0.00 255.0 /end CHARACTERISTIC
/begin CHARACTERISTIC ConvCD_swtSigVal_C "Schalter für Signalquellenauswahl (0=HW-Eingang, 1=CAN)" VALUE 0xC8BC6 Kw_Wu8 2.000 OneToOne 0.00 2.000 FORMAT "%5.3" EXTENDED_LIMITS 0.00 255.0 /end CHARACTERISTIC
/begin CHARACTERISTIC ConvCD_tiGearShft_C "Zeit für Entprellung zum Gangwechsel Erkennung." VALUE 0xC8BC8 Kw_Wu16 655350.0 Time_ms 0.00 655350.0 FORMAT "%8.1" /end CHARACTERISTIC
/begin CHARACTERISTIC ConvCD_vNoGearShftDet_C "Grenzwert unter dem die Gangerkennung für die Plausibilitätsprüfung abgeschaltet werden muss" VALUE 0xC8BCA Kw_Ws16 300.0000 Vel 0.00 300.0000 FORMAT "%8.4" EXTENDED_LIMITS -327.6800 327.6700 /end CHARACTERISTIC
/begin CHARACTERISTIC CoVeh_dnLI_C "unterer Schwellenwert der Motordrehzahl die zur Leistung/Moment Umrechnung verwendet wird" VALUE 0xC8BCC Kw_Ws16 1000.000 EngN 0.00 1000.000 FORMAT "%8.3" EXTENDED_LIMITS -32768.00 32767.00 /end CHARACTERISTIC
/begin CHARACTERISTIC CoVeh_dtrqLimDwn_C "Rampe für Systemfehler Drehmoment" VALUE 0xC8BCE Kw_Ws16 327660.0 dTrqPrp_20ms 10.00000 327670.0 FORMAT "%8.1" EXTENDED_LIMITS -327680.0 327670.0 /end CHARACTERISTIC
/begin CHARACTERISTIC CoVeh_dtrqLimUp_C "Rampe für Heilung Systemfehler Drehmoment" VALUE 0xC8BD0 Kw_Ws16 327660.0 dTrqPrp_20ms 10.00000 327670.0 FORMAT "%8.1" EXTENDED_LIMITS -327680.0 327670.0 /end CHARACTERISTIC
/begin CHARACTERISTIC CoVeh_trqLim_CUR "Begrenzungswert bei Systemfehler Drehmoment" CURVE 0xC8BD2 Kl_Xs16_Ws16 11000.00 TrqPrp -5000.000 6000.000 FORMAT "%8.3" EXTENDED_LIMITS -6553.600 6553.400
 /begin AXIS_DESCR STD_AXIS Eng_nAvrg EngN 10 0.00 6000.000 FORMAT "%8.3" EXTENDED_LIMITS -32768.00 32767.00 DEPOSIT ABSOLUTE /end AXIS_DESCR
/end CHARACTERISTIC
/begin CHARACTERISTIC CoVeh_trqPrpDes_Vector "#SSD Bypass-Label für CoVeh_trqPrpDes (Nicht verstellen!)" VALUE 0xC308A Kw_Wu8 255.0 OneToOne 0.00 255.0 FORMAT "%5.1" /end CHARACTERISTIC
/begin CHARACTERISTIC CoVeh_trqPrpDes_Channel "#SSD Bypass label, nicht editieren" VALUE 0xC308B Kw_Wu8 255.0 OneToOne 0.00 255.0 FORMAT "%5.1" /end CHARACTERISTIC
/begin CHARACTERISTIC CoVeh_trqPrpLead_Vector "#SSD Bypass label, nicht editieren!" VALUE 0xC308C Kw_Wu8 255.0 OneToOne 0.00 255.0 FORMAT "%5.1" /end CHARACTERISTIC
/begin CHARACTERISTIC CoVeh_trqPrpLead_Channel "#SSD Bypass label, nicht editieren!" VALUE 0xC308D Kw_Wu8 255.0 OneToOne 0.00 255.0 FORMAT "%5.1" /end CHARACTERISTIC
/begin CHARACTERISTIC CoVM_amMAX_C "#SSD Grenzwert zur Erkennung der physikalischen Unplausibilität des MSR (DCS) Eingriffs" VALUE 0xC8BFC Kw_Wu16 327675.0 TrqPrpDT 0.00 327675.0 FORMAT "%8.1" /end CHARACTERISTIC
/begin CHARACTERISTIC CoVM_dtrqLeadCorUp_C "Rampe zum Aufbau ASR-Vorhalt" VALUE 0xC8C04 Kw_Wu32 13107199.9969 RmpTrqPrp 0.00 13107199.9969 FORMAT "%13.4" /end CHARACTERISTIC
/begin CHARACTERISTIC CoVM_dtrqLeadCorDwn_C "Rampe zum Abbau ASR-Vorhalt" VALUE 0xC8C08 Kw_Wu32 13107199.9969 RmpTrqPrp 0.00 13107199.9969 FORMAT "%13.4" /end CHARACTERISTIC
/begin CHARACTERISTIC CoVM_swtIntvPrio_C "Priorisierung der Fahrdynamikeingriffe über die Getriebeeingriffe (1:keine Begrenzung der Getriebeeingriffe, 0: Begrenzung)" VALUE 0xC8C0C Kw_Wu8 1.000 OneToOne 0.00 1.000 FORMAT "%5.3" EXTENDED_LIMITS 0.00 255.0 /end CHARACTERISTIC
/begin CHARACTERISTIC CoVM_swtPlausChkVal_C "#SSD Konfigurationsschalter MSR-Momentenüberschussintegral (1: ein/ 0:aus)." VALUE 0xC8BFE Kw_Wu8 1.000 OneToOne 0.00 1.000 FORMAT "%5.3" EXTENDED_LIMITS 0.00 255.0 /end CHARACTERISTIC
/begin CHARACTERISTIC CoVM_swtPlausChkType_C "#SSD Softwareschalter Type für CoVM_swtSlipCtlVal_C" VALUE 0xC8BFF Kw_Wu8 2.000 OneToOne 0.00 2.000 FORMAT "%5.3" EXTENDED_LIMITS 0.00 255.0 /end CHARACTERISTIC
/begin CHARACTERISTIC CoVM_swtSlipCtlVal_C "Fahrdynamik-Konfiguration (0: ASR aus & MSR aus; 1: ASR an & MSR aus;  2: ASR aus & MSR an;  3: ASR an & MSR an)" VALUE 0xC8C00 Kw_Wu8 3.000 OneToOne 0.00 3.000 FORMAT "%5.3" EXTENDED_LIMITS 0.00 255.0 /end CHARACTERISTIC
/begin CHARACTERISTIC CoVM_swtSlipCtlType_C "Softwareschalter Type für CoVM_swtSlipCtlVal_C" VALUE 0xC8C01 Kw_Wu8 2.000 OneToOne 0.00 2.000 FORMAT "%5.3" EXTENDED_LIMITS 0.00 255.0 /end CHARACTERISTIC
/begin CHARACTERISTIC CoVM_swttrqDVCH_C "Schalter zur Korrektur von CoVM_trqDVCH mit Gearbx_trqFrc (1 = Korrektur, 0 = keine Korrektur)" VALUE 0xC8C0D Kw_Wu8 255.0 OneToOne 0.00 255.0 FORMAT "%5.1" /end CHARACTERISTIC
/begin CHARACTERISTIC CoVM_tiTrqRedMax_C "Zeitschwelle für ""langen"" ASR-Eingriff" VALUE 0xC8C0E Kw_Wu16 655.3500 Time_s 0.00 655.3500 FORMAT "%8.4" /end CHARACTERISTIC
/begin CHARACTERISTIC CoVM_trqDecMax_C "#SSD Maximum replacement value for torque decrement" VALUE 0xC8C10 Kw_Ws16 1000.000 TrqPrp -500.0000 500.0000 FORMAT "%8.4" EXTENDED_LIMITS -6553.600 6553.400 /end CHARACTERISTIC
/begin CHARACTERISTIC CoVM_dtrqLimUpDec_C "torque ramp up at decrease in torque" VALUE 0xC8C14 Kw_Wu32 13107199.9969 RmpTrqPrp 0.00 13107199.9969 FORMAT "%13.4" /end CHARACTERISTIC
/begin CHARACTERISTIC CoVM_dtrqLimDwnDec_C "torque ramp down at decrease in torque" VALUE 0xC8C18 Kw_Wu32 13107199.9969 RmpTrqPrp 0.00 13107199.9969 FORMAT "%13.4" /end CHARACTERISTIC
/begin CHARACTERISTIC CoVM_trqDSCMax_C "Maximale Momentenerhöhung vom DSC Steuergerät" VALUE 0xC8C1C Kw_Ws16 1500.000 Trq -500.0000 1000.000 FORMAT "%8.3" EXTENDED_LIMITS -3276.800 3276.700 /end CHARACTERISTIC
/begin CHARACTERISTIC CoVM_trqIncMin_C "#SSD Replacement value for torque increment" VALUE 0xC8C1E Kw_Ws16 1000.000 TrqPrp -500.0000 500.0000 FORMAT "%8.4" EXTENDED_LIMITS -6553.600 6553.400 /end CHARACTERISTIC
/begin CHARACTERISTIC CoVM_dtrqLimUpInc_C "torque ramp up for increase in torque" VALUE 0xC8C20 Kw_Wu32 13107199.9969 RmpTrqPrp 0.00 13107199.9969 FORMAT "%13.4" /end CHARACTERISTIC
/begin CHARACTERISTIC CoVM_dtrqLimDwnInc_C "torque ramp down increase in torque" VALUE 0xC8C24 Kw_Wu32 13107199.9969 RmpTrqPrp 0.00 13107199.9969 FORMAT "%13.4" /end CHARACTERISTIC
/begin MEASUREMENT ASMod_facTIndAirCor_mp "Korrekturfaktor für Luftaufwand" SWORD RatAirMass 1 100 -32.76800 32.76700 FORMAT "%8.5" ECU_ADDRESS 0x8FE48C /end MEASUREMENT
/begin MEASUREMENT ASMod_facVolEff_mp "Luftaufwand aus Grundkennfeld" SWORD RatAirMass 1 100 -32.76800 32.76700 FORMAT "%8.5" ECU_ADDRESS 0x8FE48E /end MEASUREMENT
/begin MEASUREMENT ASMod_facVSACorVolEff_mp "Korrekturfaktor für Luftaufwand aufgrund aktueller Drallklappenposition" SWORD RatAirMass 1 100 -32.76800 32.76700 FORMAT "%8.5" ECU_ADDRESS 0x8FE490 /end MEASUREMENT
/begin MEASUREMENT ASMod_tIntakeAir_mp "Ansauglufttemperatur" SWORD Temp_Cels 1 100 -50.140 899.860 FORMAT "%8.3" ECU_ADDRESS 0x8FE492 /end MEASUREMENT
/begin MEASUREMENT BattCD_u "Batteriespannung" SWORD Volt_Batt 1 100 -640625.6 640606.1 FORMAT "%8.1" ECU_ADDRESS 0x7F8AEE /end MEASUREMENT
/begin MEASUREMENT BattCD_uLin "Linearisierter Wert der Batteriespannung" SWORD Volt_Batt 1 100 -640625.6 640606.1 FORMAT "%8.1" ECU_ADDRESS 0x7F8AF0 /end MEASUREMENT
/begin MEASUREMENT BattCD_uRaw "Rohwert ADC-Signalspannung für Batteriespannung" SWORD Volt 1 100 -160156.4 160151.5 FORMAT "%8.1" ECU_ADDRESS 0x7F8AF2 /end MEASUREMENT
/begin MEASUREMENT Batt_facCor "Faktor für Batteriespannungskorrektur" SWORD Fact 1 100 -4.000000 3.999878 FORMAT "%8.6" ECU_ADDRESS 0x7F8AF4 /end MEASUREMENT
/begin MEASUREMENT BdInt_nMax "Schutzdrehzahl für Karosserie und Innenraum" SWORD EngN 1 100 -32768.00 32767.00 FORMAT "%8.2" ECU_ADDRESS 0x7F8AF6 /end MEASUREMENT
/begin MEASUREMENT BdInt_nMin "Anforderung Leerlaufdrehzahl durch Karosserie & Innenraum" SWORD EngN 1 100 -32768.00 32767.00 FORMAT "%8.2" ECU_ADDRESS 0x7F8AF8 /end MEASUREMENT
/begin MEASUREMENT BdInt_pwrDes "Leistungsanforderung Wunsch Karosserie & Innenraum" SWORD Pwr 1 100 -308831.1 308821.7 FORMAT "%8.1" ECU_ADDRESS 0x7F8AFA /end MEASUREMENT
/begin MEASUREMENT BdInt_pwrLead "Leistungsanforderung Vorhalt Karosserie & Innenraum" SWORD Pwr 1 100 -308831.1 308821.7 FORMAT "%8.1" ECU_ADDRESS 0x7F8AFC /end MEASUREMENT
/begin MEASUREMENT BPACD_rCnv_mp "Tastverhältnis basierend auf dem Ausgang des Ladedrucksreglers" SWORD DtyCyc 1 100 -327.6800 327.6700 FORMAT "%8.4" ECU_ADDRESS 0x8FE498 /end MEASUREMENT
/begin MEASUREMENT BPACD_rOut "Tastverhältnis zür Endstufenansteuerung" SWORD DtyCyc 1 100 -327.6800 327.6700 FORMAT "%8.4" ECU_ADDRESS 0x7F8AD6 /end MEASUREMENT
/begin MEASUREMENT BPA_rBPAByp_mp "Bypass-Label, Kopie von BPA_rBPA" SWORD Prc 1 100 -400.0000 399.9878 FORMAT "%8.4" ECU_ADDRESS 0x8FE494 /end MEASUREMENT
/begin MEASUREMENT BPA_rBPACD "Stellgröße für Ladedrucksteller (Stellerkoordinatorausgang)" SWORD Prc 1 100 -400.0000 399.9878 FORMAT "%8.4" ECU_ADDRESS 0x7F8ADA /end MEASUREMENT
/begin MEASUREMENT BPA_rLPAByp_mp "LPACD TV rohwert vor ASCET bypass" SWORD Prc 1 100 -400.0000 399.9878 FORMAT "%8.4" ECU_ADDRESS 0x8FE496 /end MEASUREMENT
/begin MEASUREMENT BPA_rLPACD "Sollwert Ladedrucksteller Koordinator Niederdruckstufe" SWORD Prc 1 100 -400.0000 399.9878 FORMAT "%8.4" ECU_ADDRESS 0x7F8ADC /end MEASUREMENT
/begin MEASUREMENT BPSCD_dFltValDT1 "differentiated value of Filtered value of Boost pressure" SWORD dp_dZ10 1 100 -327680.0 327670.0 FORMAT "%8.1" ECU_ADDRESS 0x7F8ADE /end MEASUREMENT
/begin MEASUREMENT BPSCD_dpOutVal "Ladedruckgradient" SWORD dp_dZ10 1 100 -327680.0 327670.0 FORMAT "%8.1" ECU_ADDRESS 0x7F8AE0 /end MEASUREMENT
/begin MEASUREMENT BPSCD_pFltVal "gefilterter Wert des Ladedrucks" SWORD Pres_hPa 1 100 -32768.00 32767.00 FORMAT "%8.2" ECU_ADDRESS 0x7F8AE2 /end MEASUREMENT
/begin MEASUREMENT BPSCD_pIntVal "aktueller Ladedruck" SWORD Pres_hPa 1 100 -32768.00 32767.00 FORMAT "%8.2" ECU_ADDRESS 0x7F8AE4 /end MEASUREMENT
/begin MEASUREMENT BPSCD_pLin "Mittelere Ladedruck-Wert (liniarisiert)" SWORD Pres_hPa 1 100 -32768.00 32767.00 FORMAT "%8.2" ECU_ADDRESS 0x7F8AE6 /end MEASUREMENT
/begin MEASUREMENT BPSCD_pOutVal "Ladedruckwert" SWORD Pres_hPa 1 100 -32768.00 32767.00 FORMAT "%8.2" ECU_ADDRESS 0x7F8AE8 /end MEASUREMENT
/begin MEASUREMENT BPSCD_pPhyVal "Ladedruck in diesem Zyklus" SWORD Pres_hPa 1 100 -32768.00 32767.00 FORMAT "%8.2" ECU_ADDRESS 0x7F8AEA /end MEASUREMENT
/begin MEASUREMENT BPSCD_stErr "Fehlererkennung (falls einer auftritt) des Ladedrucksensors in einem Zyklus" UBYTE OneToOne 1 100 0.00 255.0 FORMAT "%5.1" ECU_ADDRESS 0x7F87D1 /end MEASUREMENT
/begin MEASUREMENT BPSCD_stPlausErr "Plausibilitaetsfehler Status ( zwischen BPSCD und APSCD )" UBYTE OneToOne 1 100 0.00 255.0 FORMAT "%5.1" ECU_ADDRESS 0x7F87D2 /end MEASUREMENT
/begin MEASUREMENT BPSCD_uRawVal "Spannungsrohwert des Ladedrucksensors" SWORD Volt 1 100 -160156.4 160151.5 FORMAT "%8.1" ECU_ADDRESS 0x7F8AEC /end MEASUREMENT
/begin MEASUREMENT BrkCD_ctUnPlaus_mp "Unplausibilitätszähler" UWORD OneToOne 1 100 0.00 65535.00 FORMAT "%8.2" ECU_ADDRESS 0x6F800C /end MEASUREMENT
/begin MEASUREMENT BrkCD_stDeb_mp "Bremskontaktschalter - Status Fehlerentprellung Plausibilitaetspruefung" UBYTE OneToOne 1 100 0.00 255.0 FORMAT "%5.1" ECU_ADDRESS 0x8FE49A /end MEASUREMENT
/begin MEASUREMENT BrkCD_stMnSwtDebVal "Digitalsignal Bremskontakt entprellt" UBYTE OneToOne 1 100 0.00 255.0 FORMAT "%5.1" ECU_ADDRESS 0x7F87F2 /end MEASUREMENT
/begin MEASUREMENT BrkCD_stMnSwtLastDebVal "Letzter logischer Entprellwert vom Bremspedal" UBYTE OneToOne 1 100 0.00 255.0 FORMAT "%5.1" ECU_ADDRESS 0x7F87F3 /end MEASUREMENT
/begin MEASUREMENT BrkCD_stMnSwtLogVal_mp "Digitalsignal redundanter Bremskontakt nicht entprellt" UBYTE OneToOne 1 100 0.00 255.0 FORMAT "%5.1" ECU_ADDRESS 0x8FE49B /end MEASUREMENT
/begin MEASUREMENT BrkCD_stMnSwtRawVal "Rohwert Bremskontakt nicht entprellt" UBYTE OneToOne 1 100 0.00 255.0 FORMAT "%5.1" ECU_ADDRESS 0x7F87F4 /end MEASUREMENT
/begin MEASUREMENT BrkCD_stPressed "Meldung Bremse betätigt" UBYTE OneToOne 1 100 0.00 255.0 FORMAT "%5.1" ECU_ADDRESS 0x7F87F5 /end MEASUREMENT
/begin MEASUREMENT BrkCD_stRedSwtDebVal "Digitalsignal redundanter Bremskontakt entprellt" UBYTE OneToOne 1 100 0.00 255.0 FORMAT "%5.1" ECU_ADDRESS 0x7F87F6 /end MEASUREMENT
/begin MEASUREMENT BrkCD_stRedSwtLastDebVal "Letzter logischer Entprellwert vom redundanten Bremspedal" UBYTE OneToOne 1 100 0.00 255.0 FORMAT "%5.1" ECU_ADDRESS 0x7F87F7 /end MEASUREMENT
/begin MEASUREMENT BrkCD_stRedSwtLogVal_mp "Digitalsignal redundanter Bremskontakt nicht entprellt" UBYTE OneToOne 1 100 0.00 255.0 FORMAT "%5.1" ECU_ADDRESS 0x8FE49C /end MEASUREMENT
/begin MEASUREMENT BrkCD_stRedSwtPresent "Redundanter Bremskontakt Aktivinformation" UBYTE OneToOne 1 100 0.00 255.0 FORMAT "%5.1" ECU_ADDRESS 0x7F87F8 /end MEASUREMENT
/begin MEASUREMENT BrkCD_stRedSwtRawVal "Rohwert redundanter Bremskontakt nicht entprellt" UBYTE OneToOne 1 100 0.00 255.0 FORMAT "%5.1" ECU_ADDRESS 0x7F87F9 /end MEASUREMENT
/begin MEASUREMENT BrkCD_stResUnPlaus_mp "Zustandsbits zum Rücksetzen der Unplausibilität" UBYTE OneToOne 1 100 0.00 255.0 FORMAT "%5.1" ECU_ADDRESS 0x8FE49D /end MEASUREMENT
/begin MEASUREMENT BrkCD_stRun_mp "Laufzeitmesspunkt" UWORD OneToOne 1 100 0.00 65535.00 FORMAT "%8.2" ECU_ADDRESS 0x8FE49E /end MEASUREMENT
/begin MEASUREMENT BrkCD_swtSig "Signalquelle Schalter - DIO/CAN" UBYTE OneToOne 1 100 0.00 255.0 FORMAT "%5.1" ECU_ADDRESS 0x7F87FA /end MEASUREMENT
/begin MEASUREMENT BypEtk_ctStepDelayNsync_u8 "ETK Bypass Schritt drehzahlsynchron" UBYTE OneToOne 1 100 0.00 255.0 FORMAT "%5.1" ECU_ADDRESS 0x802126 /end MEASUREMENT
/begin MEASUREMENT BypEtk_ctStepDelayTsync_u8 "ETK Bypass Schritt zeitsynchron" UBYTE OneToOne 1 100 0.00 255.0 FORMAT "%5.1" ECU_ADDRESS 0x802127 /end MEASUREMENT
/begin MEASUREMENT BypEtk_stEcu_u8 "Status ETK-Bypass in SG (0: inaktiv im SG; 1: aktiv im SG; 2: wartet auf Kommunikation)" UBYTE OneToOne 1 100 0.00 255.0 FORMAT "%5.1" ECU_ADDRESS 0x802125 /end MEASUREMENT
/begin MEASUREMENT BypInt_stEcu_u8 "Status interner Bypass in SG (0: inaktiv im SG; 1: aktiv im SG; 2: wartet auf Kommunikation)" UBYTE OneToOne 1 100 0.00 255.0 FORMAT "%5.1" ECU_ADDRESS 0x802131 /end MEASUREMENT
/begin MEASUREMENT CaSCD_ctEdgCaSRev_mp "Anzahl sämtlicher Phasensignale während einer Nockenwellenumdrehung" UBYTE OneToOne 1 100 0.00 255.0 FORMAT "%5.1" ECU_ADDRESS 0x8FE4A0 /end MEASUREMENT
/begin MEASUREMENT CaSCD_ctEdgOfs_mp "Zähler erkannter Nockenwellenflanken mit Verdrehung" UBYTE OneToOne 1 100 0.00 255.0 FORMAT "%5.1" ECU_ADDRESS 0x8FE4A1 /end MEASUREMENT
/begin MEASUREMENT CaSCD_ctEdgOrd_mp "Zähler erkannter Nockenwellenflanken in korrekter Reihenfolge" UBYTE OneToOne 1 100 0.00 255.0 FORMAT "%5.1" ECU_ADDRESS 0x8FE4A2 /end MEASUREMENT
/begin MEASUREMENT CaSCD_ctErrEdg_mp "Anzahl erkannter Störungen auf einer Nockenwellenumdrehung" UBYTE OneToOne 1 100 0.00 255.0 FORMAT "%5.1" ECU_ADDRESS 0x8FE4A3 /end MEASUREMENT
/begin MEASUREMENT CaSCD_ctPhRevEdges_mp "Zähler der Phasengeberflanken über einer Phasengeberradumdrehung" UBYTE OneToOne 1 100 0.00 255.0 FORMAT "%5.1" ECU_ADDRESS 0x8FE4A4 /end MEASUREMENT
/begin MEASUREMENT CaSCD_ctPhRev_mp "Umdrehungszähler des Phasengeberrades" UBYTE OneToOne 1 100 0.00 255.0 FORMAT "%5.1" ECU_ADDRESS 0x8FE4A5 /end MEASUREMENT
/begin MEASUREMENT CaSCD_ctSegEdg_mp "Anzahl erkannter SEG Flanken" UBYTE OneToOne 1 100 0.00 255.0 FORMAT "%5.1" ECU_ADDRESS 0x8FE4A6 /end MEASUREMENT
/begin MEASUREMENT CaSCD_ctShftPos_mp "Zähler verschobene Nockenwellenflanken" UBYTE OneToOne 1 100 0.00 255.0 FORMAT "%5.1" ECU_ADDRESS 0x8FE4A7 /end MEASUREMENT
/begin MEASUREMENT CaSCD_ctSyncEdg_mp "Anzahl erkannter SYNC Flanken" UBYTE OneToOne 1 100 0.00 255.0 FORMAT "%5.1" ECU_ADDRESS 0x8FE4A8 /end MEASUREMENT
/begin MEASUREMENT CaSCD_nPeriod "Phasengeberraddrehzahl basierent auf einer konstanten Phasengebersegmentlänge" SWORD EngN 1 100 -32768.00 32767.00 FORMAT "%8.2" ECU_ADDRESS 0x7F8B08 /end MEASUREMENT
/begin MEASUREMENT CaSCD_nSeg "Die aktuelle Nockenwellensegmentdrehzahl im BackUp-Modus" SWORD EngN 1 100 -32768.00 32767.00 FORMAT "%8.2" ECU_ADDRESS 0x7F8B0A /end MEASUREMENT
/begin MEASUREMENT CaSCD_numFrstInt_mp "Interruptart bei Start der Verifikation CaS/CrS" UBYTE OneToOne 1 100 0.00 255.0 FORMAT "%5.1" ECU_ADDRESS 0x8FE4A9 /end MEASUREMENT
/begin MEASUREMENT CaSCD_numFrstTDC_mp "Zylinderzählerstand bei Start der Verifikation CaS/CrS" UBYTE OneToOne 1 100 0.00 255.0 FORMAT "%5.1" ECU_ADDRESS 0x8FE4AA /end MEASUREMENT
/begin MEASUREMENT CaSCD_phiCurr_mp "Aktuelle Winkelposition des Phasengebers" SWORD AngleCrS 1 100 -768.0000 767.9766 FORMAT "%8.4" ECU_ADDRESS 0x8FE4AC /end MEASUREMENT
/begin MEASUREMENT CaSCD_phiLstEdge_mp "Position der letzten Phasengeberflanke" SWORD AngleCrS 1 100 -768.0000 767.9766 FORMAT "%8.4" ECU_ADDRESS 0x8FE4AE /end MEASUREMENT
/begin MEASUREMENT CaSCD_stPhaseErr_mp "Fehlerstatus des Phasensystems" UWORD OneToOne 1 100 0.00 65535.00 FORMAT "%8.2" ECU_ADDRESS 0x8FE4B0 /end MEASUREMENT
/begin MEASUREMENT CaSCD_stPhaseSig_mp "Status des Phasengebersignals (Signalgüte)" UWORD OneToOne 1 100 0.00 65535.00 FORMAT "%8.2" ECU_ADDRESS 0x8FE4B2 /end MEASUREMENT
/begin MEASUREMENT CaSCD_stPhaseSync_mp "Status der Phasengebersynchronisation (Signalformerkennung)" UWORD OneToOne 1 100 0.00 65535.00 FORMAT "%8.2" ECU_ADDRESS 0x8FE4B4 /end MEASUREMENT
/begin MEASUREMENT CaSCD_stSegCylEdg_mp "Status erkannter SEG Flanken" UWORD OneToOne 1 100 0.00 65535.00 FORMAT "%8.2" ECU_ADDRESS 0x8FE4B6 /end MEASUREMENT
/begin MEASUREMENT CaSCD_stSyncCylEdg_mp "Status erkannter SYNC Flanken" UWORD OneToOne 1 100 0.00 65535.00 FORMAT "%8.2" ECU_ADDRESS 0x8FE4B8 /end MEASUREMENT
/begin MEASUREMENT CaSCD_tiPeriodRev "Periodendauer einer Umdrehung des Phasengeberrades" SWORD Period_ms 1 100 -3276.800 3276.700 FORMAT "%8.3" ECU_ADDRESS 0x7F8B0C /end MEASUREMENT
/begin MEASUREMENT CaSCD_tiPeriodRevHold "Vorletzte Periodendauer einer Umdrehung des Phasengeberrades" SWORD Period_ms 1 100 -3276.800 3276.700 FORMAT "%8.3" ECU_ADDRESS 0x7F8B0E /end MEASUREMENT
/begin MEASUREMENT CaSCD_tiSeg "aktuelle Segmentzeit der Nockenwelle im Backup Mode" ULONG Per_Dur 1 100 0.00 4294967295.00 FORMAT "%13.2" ECU_ADDRESS 0x7F9164 /end MEASUREMENT
/begin MEASUREMENT CaSCD_tiSigTimOut_mp "Timeoutwert des Phasengebersignals" SWORD Period_ms 1 100 -3276.800 3276.700 FORMAT "%8.3" ECU_ADDRESS 0x8FE4BA /end MEASUREMENT
/begin MEASUREMENT CBACD_stLogicOut_mp "duty-cycle given to the actuator" UBYTE OneToOne 1 100 0.00 255.0 FORMAT "%5.1" ECU_ADDRESS 0x6F800E /end MEASUREMENT
/begin MEASUREMENT Clg_dtDynTst "Ansteig der Wassertemperatur seit start" SWORD TempDiff_Cels 1 100 -3276.800 3276.700 FORMAT "%8.3" ECU_ADDRESS 0x7F8B10 /end MEASUREMENT
/begin MEASUREMENT Clg_dtMinDynTst "Kopie von Clg_dtMinDynTst_C fuer Tester" SWORD TempDiff_Cels 1 100 -3276.800 3276.700 FORMAT "%8.3" ECU_ADDRESS 0x7F8B12 /end MEASUREMENT
/begin MEASUREMENT Clg_tClntStrtVal_mp "Wassertemperatur zu Beginn des dynamischen Plausibilitätstests" SWORD Temp_Cels 1 100 -50.140 899.860 FORMAT "%8.3" ECU_ADDRESS 0x8FE4BC /end MEASUREMENT
/begin MEASUREMENT Clg_tEndDynTst "CTSCD_tClnt am Ende des Tests" SWORD Temp_Cels 1 100 -50.140 899.860 FORMAT "%8.3" ECU_ADDRESS 0x7F8B14 /end MEASUREMENT
/begin MEASUREMENT Clg_tiDynTst "Abgelaufene Zeit, seit der der dynamische plausibilitätstest aktiv ist" ULONG Time_s 1 100 0.00 42949672.9500 FORMAT "%13.4" ECU_ADDRESS 0x7F9168 /end MEASUREMENT
/begin MEASUREMENT Clg_tiMaxDynTst "Maximal zulässige Testzeit des dynamischen Plausibilitätstest" ULONG Time_s 1 100 0.00 42949672.9500 FORMAT "%13.4" ECU_ADDRESS 0x7F916C /end MEASUREMENT
/begin MEASUREMENT Clg_tMinClntDynTst "Kopie von Clg_tMinClntDynTst_C fuer Tester" SWORD Temp_Cels 1 100 -50.140 899.860 FORMAT "%8.3" ECU_ADDRESS 0x7F8B16 /end MEASUREMENT
/begin MEASUREMENT CmbChb_ctEngRevLogBuf1_mp "Meßpunkt für die Anzahl bewerteten Motorumdrehungen der Kurbelwelle des Puffer1" UWORD OneToOne 1 100 0.00 65535.00 FORMAT "%8.2" ECU_ADDRESS 0x8FE4E8 /end MEASUREMENT
/begin MEASUREMENT CmbChb_ctEngRevLogBuf2_mp "Meßpunkt für die Anzahl bewerteten Motorumdrehungen der Kurbelwelle des Puffer2" UWORD OneToOne 1 100 0.00 65535.00 FORMAT "%8.2" ECU_ADDRESS 0x8FE4EA /end MEASUREMENT
/begin MEASUREMENT CmbChb_ctEngRevLogMem_mp "Kurbelwellen-Umdrehungszähler" UWORD OneToOne 1 100 0.00 65535.00 FORMAT "%8.2" ECU_ADDRESS 0x8FE4EC /end MEASUREMENT
/begin MEASUREMENT CmbChb_ctEngRevPerBlk_mp "Meßpunkt für die Anzahl der Blockgroesse für die bewerteten Motorumdrehungen der Kurbelwelle" UWORD OneToOne 1 100 0.00 65535.00 FORMAT "%8.2" ECU_ADDRESS 0x8FE4EE /end MEASUREMENT
/begin MEASUREMENT CmbChb_ctMifBuf1_mp "Meßpunkt für die Erkennung der Fehlzündungen der einzelnen Zylinder, Puffer1" UWORD OneToOne 1 100 0.00 65535.00 FORMAT "%8.2" ARRAY_SIZE 7 ECU_ADDRESS 0x8FE4BE /end MEASUREMENT
/begin MEASUREMENT CmbChb_ctMifBuf2_mp "Meßpunkt für die Erkennung der Fehlzündungen der einzelnen Zylinder, Puffer2" UWORD OneToOne 1 100 0.00 65535.00 FORMAT "%8.2" ARRAY_SIZE 7 ECU_ADDRESS 0x8FE4CC /end MEASUREMENT
/begin MEASUREMENT CmbChb_ctMifMem_mp "Meßpunkt für die Erkennung der Fehlzündungen der einzelnen Zylinder, Logging Speicher" UWORD OneToOne 1 100 0.00 65535.00 FORMAT "%8.2" ARRAY_SIZE 7 ECU_ADDRESS 0x8FE4DA /end MEASUREMENT
/begin MEASUREMENT CmbChb_dnSegMinPerCyl_mp "minimaler Drehzahlanstiege pro Zylinder" SWORD EngN 1 100 -32768.00 32767.00 FORMAT "%8.2" ECU_ADDRESS 0x8FE4F0 /end MEASUREMENT
/begin MEASUREMENT CmbChb_nSegEven_mp "Summe der Drehzahl fuer jede gerade Segmentnummer (von zwei Umdrehungen)" SWORD EngN 1 100 -32768.00 32767.00 FORMAT "%8.2" ECU_ADDRESS 0x8FE4F2 /end MEASUREMENT
/begin MEASUREMENT CmbChb_nSegOdd_mp "Summe der Drehzahl fuer jede ungerade Segmentnummer (von zwei Umdrehungen)" SWORD EngN 1 100 -32768.00 32767.00 FORMAT "%8.2" ECU_ADDRESS 0x8FE4F4 /end MEASUREMENT
/begin MEASUREMENT CmbChb_st "Status der Fehlzündungserkennung" UBYTE OneToOne 1 100 0.00 255.0 FORMAT "%5.1" ECU_ADDRESS 0x7F87FE /end MEASUREMENT
/begin MEASUREMENT CmbChb_swtMonClutch "SW-Schalter Aktivierung/Deaktivierung Überwachung Zündaussetzererkennung" UBYTE OneToOne 1 100 0.00 3.000 FORMAT "%5.3" ECU_ADDRESS 0x7F87FF /end MEASUREMENT
/begin MEASUREMENT CoDT_dnAbsEng_mp "Absolute value of DT1 filtered engine speed" SWORD dn_dZfine 1 100 -32768.00 32767.00 FORMAT "%8.2" ECU_ADDRESS 0x8FE4FC /end MEASUREMENT
/begin MEASUREMENT CoDT_dnEng_mp "DT1 filtered Engine speed" SWORD dn_dZfine 1 100 -32768.00 32767.00 FORMAT "%8.2" ECU_ADDRESS 0x8FE4FE /end MEASUREMENT
/begin MEASUREMENT CoDT_dnGrip_mp "Expected change in torque" SWORD dn_dZfine 1 100 -32768.00 32767.00 FORMAT "%8.2" ECU_ADDRESS 0x8FE500 /end MEASUREMENT
/begin MEASUREMENT CoDT_dnNoGrip_mp "Expected change in engine speed" SWORD dn_dZfine 1 100 -32768.00 32767.00 FORMAT "%8.2" ECU_ADDRESS 0x8FE502 /end MEASUREMENT
/begin MEASUREMENT CoDT_Grip "Kraftschluß innerhalb Antrieb" UBYTE OneToOne 1 100 0.00 255.0 FORMAT "%5.1" ECU_ADDRESS 0x7F8800 /end MEASUREMENT
/begin MEASUREMENT CoDT_nMax "Drehzahlforderung Maximalwert Triebstrangkoordinator" SWORD EngN 1 100 -32768.00 32767.00 FORMAT "%8.2" ECU_ADDRESS 0x7F8B1A /end MEASUREMENT
/begin MEASUREMENT CoDT_nMin "Drehzahlforderung Minimalwert Triebstrangkoordinator" SWORD EngN 1 100 -32768.00 32767.00 FORMAT "%8.2" ECU_ADDRESS 0x7F8B1C /end MEASUREMENT
/begin MEASUREMENT CoDT_stGripDeb "Zustand der Kraftschlußentprellung" UBYTE OneToOne 1 100 0.00 255.0 FORMAT "%5.1" ECU_ADDRESS 0x7F8801 /end MEASUREMENT
/begin MEASUREMENT CoDT_stNoGripDet_mp "Bit coded status message" UBYTE OneToOne 1 100 0.00 255.0 FORMAT "%5.1" ECU_ADDRESS 0x8FE504 /end MEASUREMENT
/begin MEASUREMENT CoDT_stOrd "Randbedingungen für physikalischen Auftrag" UBYTE OneToOne 1 100 0.00 255.0 FORMAT "%5.1" ECU_ADDRESS 0x7F8802 /end MEASUREMENT
/begin MEASUREMENT CoDT_swtCoType "0: conventional; 1: mastershift" UBYTE OneToOne 1 100 0.00 255.0 FORMAT "%5.1" ECU_ADDRESS 0x7F8803 /end MEASUREMENT
/begin MEASUREMENT CoDT_trq "aktuelles Getriebeausgangsmoment" SWORD TrqPrp 1 100 -6553.600 6553.400 FORMAT "%8.3" ECU_ADDRESS 0x7F8B1E /end MEASUREMENT
/begin MEASUREMENT CoDT_trqAbsGbxPT1_mp "Absolute value of delayed gearbox torque input" SWORD Trq 1 100 -3276.800 3276.700 FORMAT "%8.3" ECU_ADDRESS 0x8FE506 /end MEASUREMENT
/begin MEASUREMENT CoDT_trqAcsDes "torque electrical components" SWORD Trq 1 100 -3276.800 3276.700 FORMAT "%8.3" ECU_ADDRESS 0x7F8B20 /end MEASUREMENT
/begin MEASUREMENT CoDT_trqAcsMax_mp "maximales Nebenaggregatmoment" SWORD Trq 1 100 -3276.800 3276.700 FORMAT "%8.3" ECU_ADDRESS 0x8FE50C /end MEASUREMENT
/begin MEASUREMENT CoDT_trqAcsMin "minimaler Momentenbedarf der Nebenaggregate" SWORD Trq 1 100 -3276.800 3276.700 FORMAT "%8.3" ECU_ADDRESS 0x7F8B22 /end MEASUREMENT
/begin MEASUREMENT CoDT_trqAcs_mp "ungefilterter Momentenbedarf der Nebenaggregate" SWORD Trq 1 100 -3276.800 3276.700 FORMAT "%8.3" ECU_ADDRESS 0x8FE50E /end MEASUREMENT
/begin MEASUREMENT CoDT_trqActAcs_mp "aktuelle Momentenanforderung der Nebenaggregate" SWORD Trq 1 100 -3276.800 3276.700 FORMAT "%8.3" ECU_ADDRESS 0x8FE50A /end MEASUREMENT
/begin MEASUREMENT CoDT_trqCurr "Momentenanforderung Triebstrang Vorhaltewert" SWORD Trq 1 100 -3276.800 3276.700 FORMAT "%8.3" ECU_ADDRESS 0x7F8B24 /end MEASUREMENT
/begin MEASUREMENT CoDT_trqCurrLim "Minimum aller Begrenzungen im Getriebeausgangsmoment" SWORD TrqPrp 1 100 -6553.600 6553.400 FORMAT "%8.3" ECU_ADDRESS 0x7F8B26 /end MEASUREMENT
/begin MEASUREMENT CoDT_trqDes "Momentenanforderung Triebstrangkoordinator Wunschwert" SWORD Trq 1 100 -3276.800 3276.700 FORMAT "%8.3" ECU_ADDRESS 0x7F8B2E /end MEASUREMENT
/begin MEASUREMENT CoDT_trqDTInCurr "Momentenanforderung Vorhalt Triebstrangkoordinator (Kupplungseingang) (curr-Pfad)" SWORD Trq 1 100 -3276.800 3276.700 FORMAT "%8.3" ECU_ADDRESS 0x7F8B28 /end MEASUREMENT
/begin MEASUREMENT CoDT_trqDTInDecLead_mp "Momentenanforderung Triebstrang nach reduzierenden Getriebeeingriffen" SWORD Trq 1 100 -3276.800 3276.700 FORMAT "%8.3" ECU_ADDRESS 0x8FE4F6 /end MEASUREMENT
/begin MEASUREMENT CoDT_trqDTInDes "Momentenanforderung Triebstrang (Kupplungseingang) Wunschwert" SWORD Trq 1 100 -3276.800 3276.700 FORMAT "%8.3" ECU_ADDRESS 0x7F8B2A /end MEASUREMENT
/begin MEASUREMENT CoDT_trqDTInIncLead_mp "Momentenanforderung Triebstrang nach erhöhenden Getriebeeingriffen" SWORD Trq 1 100 -3276.800 3276.700 FORMAT "%8.3" ECU_ADDRESS 0x8FE4F8 /end MEASUREMENT
/begin MEASUREMENT CoDT_trqDTInLead "Momentenanforderung Triebstrang (Kupplungseingang) Vorhaltewert" SWORD Trq 1 100 -3276.800 3276.700 FORMAT "%8.3" ECU_ADDRESS 0x7F8B2C /end MEASUREMENT
/begin MEASUREMENT CoDT_trqGbx "aktuelles Eingangsmoment Getriebe" SWORD Trq 1 100 -3276.800 3276.700 FORMAT "%8.3" ECU_ADDRESS 0x7F8B30 /end MEASUREMENT
/begin MEASUREMENT CoDT_trqGbxMax "maximales Getriebeeingangsmoment" SWORD Trq 1 100 -3276.800 3276.700 FORMAT "%8.3" ECU_ADDRESS 0x7F8B32 /end MEASUREMENT
/begin MEASUREMENT CoDT_trqGbxMin "minimales Getriebeeingangsmoment" SWORD Trq 1 100 -3276.800 3276.700 FORMAT "%8.3" ECU_ADDRESS 0x7F8B34 /end MEASUREMENT
/begin MEASUREMENT CoDT_trqGbxPT1_mp "Delayed gearbox torque input" SWORD Trq 1 100 -3276.800 3276.700 FORMAT "%8.3" ECU_ADDRESS 0x8FE508 /end MEASUREMENT
/begin MEASUREMENT CoDT_trqGearbxDes "Getriebeeingangsmoment Fahrerwunsch" SWORD Trq 1 100 -3276.800 3276.700 FORMAT "%8.3" ECU_ADDRESS 0x7F8B36 /end MEASUREMENT
/begin MEASUREMENT CoDT_trqGearbxLead_mp "Getriebeeingangsmoment Vorhaltewert" SWORD Trq 1 100 -3276.800 3276.700 FORMAT "%8.3" ECU_ADDRESS 0x8FE4FA /end MEASUREMENT
/begin MEASUREMENT CoDT_trqLead "Momentenanforderung Vorhaltewert" SWORD Trq 1 100 -3276.800 3276.700 FORMAT "%8.3" ECU_ADDRESS 0x7F8B38 /end MEASUREMENT
/begin MEASUREMENT CoDT_trqMax "maximal mögliches Antriebsmoment (Getriebeausgang)" SWORD TrqPrp 1 100 -6553.600 6553.400 FORMAT "%8.3" ECU_ADDRESS 0x7F8B3A /end MEASUREMENT
/begin MEASUREMENT CoDT_trqMin "minimal mögliches Antriebsmoment (Getriebeausgang)" SWORD TrqPrp 1 100 -6553.600 6553.400 FORMAT "%8.3" ECU_ADDRESS 0x7F8B3C /end MEASUREMENT
/begin MEASUREMENT CoEng_CoordPrioFld_mp "Messpunktarray zur Darstellung der dynamische Priorität" UWORD OneToOne 1 100 0.00 65535.00 FORMAT "%8.2" ARRAY_SIZE 3 ECU_ADDRESS 0x8FE520 /end MEASUREMENT
/begin MEASUREMENT CoEng_dnEngnAvrg_mp "Meßpunkt für Overfueling Drehzahlgradienten" SWORD dn_dZ20 1 100 -327680.0 327670.0 FORMAT "%8.1" ECU_ADDRESS 0x8FE554 /end MEASUREMENT
/begin MEASUREMENT CoEng_dvolFlConsum "Kraftstoffverbrauch" SWORD FlConsum_l_h 1 100 -327.6800 327.6700 FORMAT "%8.4" ECU_ADDRESS 0x7F8B3E /end MEASUREMENT
/begin MEASUREMENT CoEng_dVolFlt_mp "Gefilterter Volumenstrom für Berechnung" SWORD CubMtrPerHr 1 100 -3276.800 3276.700 FORMAT "%8.3" ECU_ADDRESS 0x8FE556 /end MEASUREMENT
/begin MEASUREMENT CoEng_dvolPerStroke_mp "Kraftstoffverbrauch" SWORD InjQnt 1 100 -3276.800 3276.700 FORMAT "%8.3" ECU_ADDRESS 0x8FE512 /end MEASUREMENT
/begin MEASUREMENT CoEng_facAdj "EEPROM Abgleichwert zur Korrektur des Begrenzungsmomentes" SWORD Fact 1 100 -4.000000 3.999878 FORMAT "%8.6" ECU_ADDRESS 0x7F8B40 /end MEASUREMENT
/begin MEASUREMENT CoEng_facFlConsumAdj_mp "Abgleichwert - Krafstoffverbrauchsabgleich" SWORD Fact 1 100 -4.000000 3.999878 FORMAT "%8.6" ECU_ADDRESS 0x8FE514 /end MEASUREMENT
/begin MEASUREMENT CoEng_nMax "Drehzahlintervall Maximum" SWORD EngN 1 100 -32768.00 32767.00 FORMAT "%8.2" ECU_ADDRESS 0x7F8B42 /end MEASUREMENT
/begin MEASUREMENT CoEng_nMin "Drehzahlintervall Minimum" SWORD EngN 1 100 -32768.00 32767.00 FORMAT "%8.2" ECU_ADDRESS 0x7F8B44 /end MEASUREMENT
/begin MEASUREMENT CoEng_numShOffTstNewSel "ausgewählter Abstelltest des gegenwaertigen Fahrzyklus" UBYTE OneToOne 1 100 0.00 255.0 FORMAT "%5.1" ECU_ADDRESS 0x7F8804 /end MEASUREMENT
/begin MEASUREMENT CoEng_pDiffPFltPrdc_mp "Vorhergesagter Differenzdruck über Partikelfilter" SWORD Pres_hPa 1 100 -32768.00 32767.00 FORMAT "%8.2" ECU_ADDRESS 0x8FE558 /end MEASUREMENT
/begin MEASUREMENT CoEng_pRailT15Off "Raildruck bei Klemme 15 aus" SWORD Pres_Rail 1 100 -3276.800 3276.700 FORMAT "%5.3" ECU_ADDRESS 0x7F8B46 /end MEASUREMENT
/begin MEASUREMENT CoEng_qSubs_mp "Ersatzeinspritzmenge für KVA Berechnung" SWORD InjMassCyc 1 100 -327.6800 327.6700 FORMAT "%8.4" ECU_ADDRESS 0x8FE516 /end MEASUREMENT
/begin MEASUREMENT CoEng_qSum_mp "tatsächlicher Kraftstoffverbrauch" SWORD InjMassCyc 1 100 -327.6800 327.6700 FORMAT "%8.4" ECU_ADDRESS 0x8FE518 /end MEASUREMENT
/begin MEASUREMENT CoEng_resFlowFlt_mp "Gefilterter Strömungswiderstand für Berechnung" SWORD Res_hPaHrPerCM 1 100 -32.76800 32.76700 FORMAT "%8.5" ECU_ADDRESS 0x8FE55A /end MEASUREMENT
/begin MEASUREMENT CoEng_rTrq "Verhältnis aktuelles Moment zu Maximalmoment" SWORD Prc 1 100 -400.0000 399.9878 FORMAT "%8.4" ECU_ADDRESS 0x7F8B48 /end MEASUREMENT
/begin MEASUREMENT CoEng_stAftRun "nachlauf-interner Nachlauf-Zustand" UBYTE OneToOne 1 100 0.00 255.0 FORMAT "%5.1" ECU_ADDRESS 0x7F8805 /end MEASUREMENT
/begin MEASUREMENT CoEng_stAftRunPath "Abschaltpfade aufgrund Motorzustand Nachlauf" ULONG OneToOne 1 100 0.00 4294967295.00 FORMAT "%13.2" ECU_ADDRESS 0x7F9170 /end MEASUREMENT
/begin MEASUREMENT CoEng_stCoordFuncFld_mp "Messpunktarray zur Statusanzeige Schubkoordinator" UWORD OneToOne 1 100 0.00 65535.00 FORMAT "%8.2" ARRAY_SIZE 3 ECU_ADDRESS 0x8FE526 /end MEASUREMENT
/begin MEASUREMENT CoEng_stCoordFuncPref_mp "Status Zustand Koordinator" UBYTE OneToOne 1 100 0.00 255.0 FORMAT "%5.1" ECU_ADDRESS 0x8FE52C /end MEASUREMENT
/begin MEASUREMENT CoEng_stCurrLim "Statuswort zur Markierung der niedrigsten Begrenzungsmomente" UWORD OneToOne 1 100 0.00 65535.00 FORMAT "%8.2" ECU_ADDRESS 0x7F8B4A /end MEASUREMENT
/begin MEASUREMENT CoEng_stCurrLimActive "Statusword zur Markierung der wirksamen niedrigsten Begrenzungsmomente" UWORD OneToOne 1 100 0.00 65535.00 FORMAT "%8.2" ECU_ADDRESS 0x7F8B4C /end MEASUREMENT
/begin MEASUREMENT CoEng_stDisable "Status Schubabschaltung: 1: abgeschalten; 0: nicht abgeschalten" UBYTE OneToOne 1 100 0.00 255.0 FORMAT "%5.1" ECU_ADDRESS 0x7F8806 /end MEASUREMENT
/begin MEASUREMENT CoEng_stDlyT15_mp "Status Variable für Verzögerungszeti nach Klemme 15 ein" UBYTE OneToOne 1 100 0.00 255.0 FORMAT "%5.1" ECU_ADDRESS 0x8FE52E /end MEASUREMENT
/begin MEASUREMENT CoEng_stEEPStore_mp "Speicherstatus für EEPROM während Nachlauf" UBYTE OneToOne 1 100 0.00 255.0 FORMAT "%5.1" ECU_ADDRESS 0x8FE510 /end MEASUREMENT
/begin MEASUREMENT CoEng_stEng "aktueller Motorzustand" UBYTE OneToOne 1 100 0.00 255.0 FORMAT "%5.1" ECU_ADDRESS 0x7F8807 /end MEASUREMENT
/begin MEASUREMENT CoEng_stEngOld "Motorstatus vor aktuellem Status" UBYTE OneToOne 1 100 0.00 255.0 FORMAT "%5.1" ECU_ADDRESS 0x7F8808 /end MEASUREMENT
/begin MEASUREMENT CoEng_stExtWait "Zustand ""warten auf externe Ereignisse vor Schreiben des EEPROM""" UBYTE OneToOne 1 100 0.00 255.0 FORMAT "%5.1" ECU_ADDRESS 0x7F8809 /end MEASUREMENT
/begin MEASUREMENT CoEng_stExtWait2 "Zustand ""Warten auf externe Ereignisse vor Öffnen des Hauptrelais""" UBYTE OneToOne 1 100 0.00 255.0 FORMAT "%5.1" ECU_ADDRESS 0x7F880A /end MEASUREMENT
/begin MEASUREMENT CoEng_stIRevShutOff "irreversible Abschaltursachen (nach Maskierung)" ULONG OneToOne 1 100 0.00 4294967295.00 FORMAT "%13.2" ECU_ADDRESS 0x7F9174 /end MEASUREMENT
/begin MEASUREMENT CoEng_stMonActrPrt "Zustand der Steuerung Stellerschutz" UBYTE OneToOne 1 100 0.00 255.0 FORMAT "%5.1" ECU_ADDRESS 0x7F880B /end MEASUREMENT
/begin MEASUREMENT CoEng_stMonShOff "aktueller Zustand der Abstellsteuerung im Nachlauf" UBYTE OneToOne 1 100 0.00 255.0 FORMAT "%5.1" ECU_ADDRESS 0x7F880C /end MEASUREMENT
/begin MEASUREMENT CoEng_stOvrFul_mp "Status Overfueling" UBYTE OneToOne 1 100 0.00 255.0 FORMAT "%5.1" ECU_ADDRESS 0x8FE55C /end MEASUREMENT
/begin MEASUREMENT CoEng_stOvrRun "Zustand Schuberkennung (0: kein Schub, 1: Schub)" UBYTE OneToOne 1 100 0.00 255.0 FORMAT "%5.1" ECU_ADDRESS 0x7F880D /end MEASUREMENT
/begin MEASUREMENT CoEng_stOvrRunCoord "Status Schuberkennung des Schubkoordinators (0: kein Schub; 1: Schub)" UBYTE OneToOne 1 100 0.00 255.0 FORMAT "%5.1" ECU_ADDRESS 0x7F880E /end MEASUREMENT
/begin MEASUREMENT CoEng_stOvrRunEGT_mp "Status Regenerationsanforderung Abgasnachbehandlung im Sinne des Schubkoordinators, 1:keine Freigabe für Funktionen" UBYTE OneToOne 1 100 0.00 255.0 FORMAT "%5.1" ECU_ADDRESS 0x8FE52D /end MEASUREMENT
/begin MEASUREMENT CoEng_stPwrDwn "Status des Diagnose Modus Power-down" UBYTE OneToOne 1 100 0.00 255.0 FORMAT "%5.1" ECU_ADDRESS 0x7F880F /end MEASUREMENT
/begin MEASUREMENT CoEng_stPwrStgEnaCond "Steuergerätestatus, der für die Abschaltung der Endstufe/Endstufenfehlerdiagnose relevant ist" UBYTE OneToOne 1 100 0.00 255.0 FORMAT "%5.1" ECU_ADDRESS 0x7F8810 /end MEASUREMENT
/begin MEASUREMENT CoEng_stRevShutOff "reversible Abschaltursachen (nach Maskierung)" ULONG OneToOne 1 100 0.00 4294967295.00 FORMAT "%13.2" ECU_ADDRESS 0x7F9178 /end MEASUREMENT
/begin MEASUREMENT CoEng_stRmp_mp "Status: Rampe der Schubabschaltung, 0: inaktiv, 1: aktiv" UBYTE OneToOne 1 100 0.00 255.0 FORMAT "%5.1" ECU_ADDRESS 0x8FE536 /end MEASUREMENT
/begin MEASUREMENT CoEng_stShOffAddReqIRev "Kundenspezifische irreversible Abschaltanforderung" UBYTE OneToOne 1 100 0.00 255.0 FORMAT "%5.1" ECU_ADDRESS 0x7F8811 /end MEASUREMENT
/begin MEASUREMENT CoEng_stShOffAddReqRev "Kundenspezifische reversible Abschaltanforderung" UBYTE OneToOne 1 100 0.00 255.0 FORMAT "%5.1" ECU_ADDRESS 0x7F8812 /end MEASUREMENT
/begin MEASUREMENT CoEng_stShOffTst "Status des Abstelltest" UBYTE OneToOne 1 100 0.00 255.0 FORMAT "%5.1" ECU_ADDRESS 0x7F8813 /end MEASUREMENT
/begin MEASUREMENT CoEng_stShOffTstOldRes_mp "Testergebnis des letzten Fahrzyklus" UBYTE OneToOne 1 100 0.00 255.0 FORMAT "%5.1" ECU_ADDRESS 0x8FE52F /end MEASUREMENT
/begin MEASUREMENT CoEng_stShutOff "Typ der wirksamen Abschaltursache (0: Nachlauf; 1: reversibel; 2: irreversibel)" UBYTE OneToOne 1 100 0.00 255.0 FORMAT "%5.1" ECU_ADDRESS 0x7F8814 /end MEASUREMENT
/begin MEASUREMENT CoEng_stShutOffPath "aktive Abstellpfade resultierend aus aktiven reversiblen, irreversiblen und Nachlauf-Abstellpfaden" ULONG OneToOne 1 100 0.00 4294967295.00 FORMAT "%13.2" ECU_ADDRESS 0x7F917C /end MEASUREMENT
/begin MEASUREMENT CoEng_stTrqLimErr "Status Begrenzungsmoment im Systemfehlerfall. Bit0: Begrenzung aktiv; Bit1: Rampe von/zu Begrenzungswert aktiv" UBYTE OneToOne 1 100 0.00 255.0 FORMAT "%5.1" ECU_ADDRESS 0x7F8815 /end MEASUREMENT
/begin MEASUREMENT CoEng_stTrqLimErr1 "Begrenzungsmoment im Fehlerfall" UBYTE OneToOne 1 100 0.00 255.0 FORMAT "%5.1" ECU_ADDRESS 0x7F8816 /end MEASUREMENT
/begin MEASUREMENT CoEng_stTrqLimErr2 "Begrenzungsmoment im Fehlerfall 2" UBYTE OneToOne 1 100 0.00 255.0 FORMAT "%5.1" ECU_ADDRESS 0x7F8817 /end MEASUREMENT
/begin MEASUREMENT CoEng_stTrqLimErr3 "Begrenzungsmoment im Fehlerfall" UBYTE OneToOne 1 100 0.00 255.0 FORMAT "%5.1" ECU_ADDRESS 0x7F8818 /end MEASUREMENT
/begin MEASUREMENT CoEng_stTrqLimErr4 "Begrenzungsmoment im Fehlerfall" UBYTE OneToOne 1 100 0.00 255.0 FORMAT "%5.1" ECU_ADDRESS 0x7F8819 /end MEASUREMENT
/begin MEASUREMENT CoEng_stTrqLimPFltErr "" UBYTE OneToOne 1 100 0.00 255.0 FORMAT "%5.1" ECU_ADDRESS 0x7F881A /end MEASUREMENT
/begin MEASUREMENT CoEng_stTst "Zustand des Motortestkoordinators (= aktiver Testmodus)" UBYTE OneToOne 1 100 0.00 255.0 FORMAT "%5.1" ECU_ADDRESS 0x7F881B /end MEASUREMENT
/begin MEASUREMENT CoEng_stZFCEmissionRoll "Freigabe Status der ZFC am Rollentester" UBYTE OneToOne 1 100 0.00 255.0 FORMAT "%5.1" ECU_ADDRESS 0x7F881C /end MEASUREMENT
/begin MEASUREMENT CoEng_tiAfterrun "Zeit seit Erreichen des Motorzustands Nachlauf (COENG_STAFTERRUN)" ULONG Time_ms 1 100 0.00 42949672950.0 FORMAT "%13.1" ECU_ADDRESS 0x7F9180 /end MEASUREMENT
/begin MEASUREMENT CoEng_tiAfterrunRed "Zeit seit Erreichen des Motorzustands Nachlauf (COENG_STAFTERRUN, 0x30) mit reduzierter Auflösung als KL/KF Eingang" SWORD TimeRed 1 100 -5242.880 5242.720 FORMAT "%8.3" ECU_ADDRESS 0x7F8B4E /end MEASUREMENT
/begin MEASUREMENT CoEng_tiMinAftRun "Minimale Zeitdauer für die Verbindung vom elektronischen Steuergerät zum Hauptrelais" ULONG Time_ms 1 100 0.00 42949672950.0 FORMAT "%13.1" ECU_ADDRESS 0x7F9184 /end MEASUREMENT
/begin MEASUREMENT CoEng_tiNormal "Zeit seit Erreichen des Zustands NORMAL" ULONG Time_ms 1 100 0.00 42949672950.0 FORMAT "%13.1" ECU_ADDRESS 0x7F9188 /end MEASUREMENT
/begin MEASUREMENT CoEng_tiNormalRed "Zeit seit Erreichen Motorzustand NORMAL (0x04), mit reduzierter Auflösung als KL/KF Eingang" SWORD TimeRed 1 100 -5242.880 5242.720 FORMAT "%8.3" ECU_ADDRESS 0x7F8B50 /end MEASUREMENT
/begin MEASUREMENT CoEng_tiOvRMon_mp "Zeit seit Schub erkannt wurde und die Schubüberwachung aktiv ist" SWORD Time_ms 1 100 -327680.0 327670.0 FORMAT "%8.1" ECU_ADDRESS 0x8FE538 /end MEASUREMENT
/begin MEASUREMENT CoEng_tiRmpStrt "Time for Ramp Start" UWORD Time_ms 1 100 0.00 655350.0 FORMAT "%8.1" ECU_ADDRESS 0x7F8B52 /end MEASUREMENT
/begin MEASUREMENT CoEng_tiSoftShOff_mp "time delay for soft shutoff" UWORD Time_ms 1 100 0.00 655350.0 FORMAT "%8.1" ECU_ADDRESS 0x8FE530 /end MEASUREMENT
/begin MEASUREMENT CoEng_tiStart "Zeit seit Erreichen Motorzustand START (0x02)" ULONG Time_ms 1 100 0.00 42949672950.0 FORMAT "%13.1" ECU_ADDRESS 0x7F918C /end MEASUREMENT
/begin MEASUREMENT CoEng_tiStartRed "Zeit seit Erreichen Motorzustand START (0x02), mit reduzierter Auflösung als KL/KF Eingang" SWORD TimeRed 1 100 -5242.880 5242.720 FORMAT "%8.3" ECU_ADDRESS 0x7F8B54 /end MEASUREMENT
/begin MEASUREMENT CoEng_tiSwtOff "Time for Switch Off" UWORD Time_ms 1 100 0.00 655350.0 FORMAT "%8.1" ECU_ADDRESS 0x7F8B56 /end MEASUREMENT
/begin MEASUREMENT CoEng_tiWakeUp "Zeit seit Erreichen Zustand WAKEUP" ULONG Time_ms 1 100 0.00 42949672950.0 FORMAT "%13.1" ECU_ADDRESS 0x7F9190 /end MEASUREMENT
/begin MEASUREMENT CoEng_trq "aktuelles Motorausgangsmoment" SWORD Trq 1 100 -3276.800 3276.700 FORMAT "%8.3" ECU_ADDRESS 0x7F8B58 /end MEASUREMENT
/begin MEASUREMENT CoEng_trqBefRmp_mp "Sollmoment nach zweiter Begrenzung, vor Schubabschaltung in CoEng (als inneres Motormoment)" SWORD Trq 1 100 -3276.800 3276.700 FORMAT "%8.3" ECU_ADDRESS 0x8FE53A /end MEASUREMENT
/begin MEASUREMENT CoEng_trqCurrLim "Minimum aller Begrenzungen als aktuelles Motorausgangsmoment" SWORD Trq 1 100 -3276.800 3276.700 FORMAT "%8.3" ECU_ADDRESS 0x7F8B5A /end MEASUREMENT
/begin MEASUREMENT CoEng_trqInrCurr "inneres Moment aktueller Wert" SWORD Trq 1 100 -3276.800 3276.700 FORMAT "%8.3" ECU_ADDRESS 0x7F8B5C /end MEASUREMENT
/begin MEASUREMENT CoEng_trqInrCurrFast "inneres Wunschmoment (schneller Pfad) erzeugt aus CoDT_trqCurr" SWORD Trq 1 100 -3276.800 3276.700 FORMAT "%8.3" ECU_ADDRESS 0x7F8B5E /end MEASUREMENT
/begin MEASUREMENT CoEng_trqInrCurrFastBase_mp "inneres schnelles Wunschmoment im Curr-Pfad" SWORD Trq 1 100 -3276.800 3276.700 FORMAT "%8.3" ECU_ADDRESS 0x8FE54E /end MEASUREMENT
/begin MEASUREMENT CoEng_trqInrCurrLim "aktuell kleinstes Begrenzungsmoment (inneres Motormoment)" SWORD Trq 1 100 -3276.800 3276.700 FORMAT "%8.3" ECU_ADDRESS 0x7F8B60 /end MEASUREMENT
/begin MEASUREMENT CoEng_trqInrCurrPre_mp "aktuelles inneres Moment ahne Leerlaufreglerstellgrösse" SWORD Trq 1 100 -3276.800 3276.700 FORMAT "%8.3" ECU_ADDRESS 0x8FE53C /end MEASUREMENT
/begin MEASUREMENT CoEng_trqInrDes "Wunschmoment (inneres Motormoment)" SWORD Trq 1 100 -3276.800 3276.700 FORMAT "%8.3" ECU_ADDRESS 0x7F8B62 /end MEASUREMENT
/begin MEASUREMENT CoEng_trqInrDesFast "Wunschmoment (inneres Motormoment) (schneller Pfad) erzeugt aus CoDT_trqLead" SWORD Trq 1 100 -3276.800 3276.700 FORMAT "%8.3" ECU_ADDRESS 0x7F8B64 /end MEASUREMENT
/begin MEASUREMENT CoEng_trqInrDesFastBase_mp "inneres schnelles Wunschmoment ohne Veränderung" SWORD Trq 1 100 -3276.800 3276.700 FORMAT "%8.3" ECU_ADDRESS 0x8FE550 /end MEASUREMENT
/begin MEASUREMENT CoEng_trqInrDesFastUnLim_mp "inneres schnelles Wunschmoment vor Begrenzung" SWORD Trq 1 100 -3276.800 3276.700 FORMAT "%8.3" ECU_ADDRESS 0x8FE552 /end MEASUREMENT
/begin MEASUREMENT CoEng_trqInrDesSlow "inneres Moment Wunschwert (normaler Pfad) erzeugt aus CoDT_trqDes" SWORD Trq 1 100 -3276.800 3276.700 FORMAT "%8.3" ECU_ADDRESS 0x7F8B66 /end MEASUREMENT
/begin MEASUREMENT CoEng_trqInrDesSlowBase_mp "inneres langsames Wunschmoment ohne Veränderung" SWORD Trq 1 100 -3276.800 3276.700 FORMAT "%8.3" ECU_ADDRESS 0x8FE53E /end MEASUREMENT
/begin MEASUREMENT CoEng_trqInrDesSlowUnLim_mp "inneres langsames Wunschmoment vor Begrenzung" SWORD Trq 1 100 -3276.800 3276.700 FORMAT "%8.3" ECU_ADDRESS 0x8FE540 /end MEASUREMENT
/begin MEASUREMENT CoEng_trqInrGearbxInMax_mp "maximales Getriebeeingangsmoment als inneres Motormoment" SWORD Trq 1 100 -3276.800 3276.700 FORMAT "%8.3" ECU_ADDRESS 0x8FE532 /end MEASUREMENT
/begin MEASUREMENT CoEng_trqInrLiDesSlw "Momentenführungswert mit LiGov Ausgngswert beaufschlagt" SWORD Trq 1 100 -3276.800 3276.700 FORMAT "%8.3" ECU_ADDRESS 0x7F8B68 /end MEASUREMENT
/begin MEASUREMENT CoEng_trqInrLim "Begrenzungsmoment (inneres Motormoment)" SWORD Trq 1 100 -3276.800 3276.700 FORMAT "%8.3" ECU_ADDRESS 0x7F8B6A /end MEASUREMENT
/begin MEASUREMENT CoEng_trqInrLimDes "Begrenzungsmoment als inneres Motormoment, korrigiert um Leerlaufreglerstellgröße" SWORD Trq 1 100 -3276.800 3276.700 FORMAT "%8.3" ECU_ADDRESS 0x7F8B6C /end MEASUREMENT
/begin MEASUREMENT CoEng_trqInrLimLead "Begrenzungsmoment mit lang anhaltenden Begrenzungen" SWORD Trq 1 100 -3276.800 3276.700 FORMAT "%8.3" ECU_ADDRESS 0x7F8B6E /end MEASUREMENT
/begin MEASUREMENT CoEng_trqInrLimLead0_mp "Torque lead limitation after error condition #0" SWORD Trq 1 100 -3276.800 3276.700 FORMAT "%8.3" ECU_ADDRESS 0x8FE55E /end MEASUREMENT
/begin MEASUREMENT CoEng_trqInrLimLead1_mp "Torque lead limitation after error condition #1" SWORD Trq 1 100 -3276.800 3276.700 FORMAT "%8.3" ECU_ADDRESS 0x8FE560 /end MEASUREMENT
/begin MEASUREMENT CoEng_trqInrLimLead2_mp "Torque lead limitation after error condition #2" SWORD Trq 1 100 -3276.800 3276.700 FORMAT "%8.3" ECU_ADDRESS 0x8FE562 /end MEASUREMENT
/begin MEASUREMENT CoEng_trqInrLtd "inneres Moment Sollwert nach Begrenzung, vor Eingriff ARD-Störungsregler" SWORD Trq 1 100 -3276.800 3276.700 FORMAT "%8.3" ECU_ADDRESS 0x7F8B70 /end MEASUREMENT
/begin MEASUREMENT CoEng_trqInrPrpLimErr_mp "Begrenzungsmoment für Vortrieb im Falle eines Systemfehlers als inneres Motormoment" SWORD Trq 1 100 -3276.800 3276.700 FORMAT "%8.3" ECU_ADDRESS 0x8FE534 /end MEASUREMENT
/begin MEASUREMENT CoEng_trqInrRaw "inneres Moment Rohwert" SWORD Trq 1 100 -3276.800 3276.700 FORMAT "%8.3" ECU_ADDRESS 0x7F8B72 /end MEASUREMENT
/begin MEASUREMENT CoEng_trqInrRawPre_mp "Rohwet inneres Moment ohne Leerlaufreglerstellgrösse" SWORD Trq 1 100 -3276.800 3276.700 FORMAT "%8.3" ECU_ADDRESS 0x8FE542 /end MEASUREMENT
/begin MEASUREMENT CoEng_trqInrSet "inneres Moment Sollwert (>Mengenberechnung)" SWORD Trq 1 100 -3276.800 3276.700 FORMAT "%8.3" ECU_ADDRESS 0x7F8B74 /end MEASUREMENT
/begin MEASUREMENT CoEng_trqInrSetLim_mp "Begrenzter Sollwert des inneren Moments, wenn Schub erkannt wurde und die Schubüberwachung aktiv ist" SWORD Trq 1 100 -3276.800 3276.700 FORMAT "%8.3" ECU_ADDRESS 0x8FE544 /end MEASUREMENT
/begin MEASUREMENT CoEng_trqInrSetUnLtd_mp "Unbegrenzter Sollwert des inneren Moments bei erkanntem Schub" SWORD Trq 1 100 -3276.800 3276.700 FORMAT "%8.3" ECU_ADDRESS 0x8FE546 /end MEASUREMENT
/begin MEASUREMENT CoEng_trqLiLtd "begrenztes Leerlaufreglermoment" SWORD Trq 1 100 -3276.800 3276.700 FORMAT "%8.3" ECU_ADDRESS 0x7F8B76 /end MEASUREMENT
/begin MEASUREMENT CoEng_trqLimErr "Begrenzungsmoment im Falle eines Systemfehlers" SWORD Trq 1 100 -3276.800 3276.700 FORMAT "%8.3" ECU_ADDRESS 0x7F8B78 /end MEASUREMENT
/begin MEASUREMENT CoEng_trqLimErr1 "Begrenzungsmoment im Falle Systemfehler 1" SWORD Trq 1 100 -3276.800 3276.700 FORMAT "%8.3" ECU_ADDRESS 0x7F8B7A /end MEASUREMENT
/begin MEASUREMENT CoEng_trqLimErr2 "Begrenzungsmoment im Fall Systemfahler 2" SWORD Trq 1 100 -3276.800 3276.700 FORMAT "%8.3" ECU_ADDRESS 0x7F8B7C /end MEASUREMENT
/begin MEASUREMENT CoEng_trqLimErr3 "Begrenzungsmoment im Falle Systemfehler3" SWORD Trq 1 100 -3276.800 3276.700 FORMAT "%8.3" ECU_ADDRESS 0x7F8B7E /end MEASUREMENT
/begin MEASUREMENT CoEng_trqLimErr4 "Begrenzungsmoment im Fall Systemfehler 4" SWORD Trq 1 100 -3276.800 3276.700 FORMAT "%8.3" ECU_ADDRESS 0x7F8B80 /end MEASUREMENT
/begin MEASUREMENT CoEng_trqLimMin1_mp "Minimum von Motormechanikschutz und Rauchbegrenzung" SWORD Trq 1 100 -3276.800 3276.700 FORMAT "%8.3" ECU_ADDRESS 0x8FE564 /end MEASUREMENT
/begin MEASUREMENT CoEng_trqLimMinEEPVal_mp "Stored in EEPROM in case of errors in particle filter" SWORD Trq 1 100 -3276.800 3276.700 FORMAT "%8.3" ECU_ADDRESS 0x8FE566 /end MEASUREMENT
/begin MEASUREMENT CoEng_trqLimMin_mp "Begrenzungsmoment, falls kein momentenbegrenzender Systemfehler vorliegt (Minimum aus Rauchgrenze un Motormech.schutz)" SWORD Trq 1 100 -3276.800 3276.700 FORMAT "%8.3" ECU_ADDRESS 0x6F8010 /end MEASUREMENT
/begin MEASUREMENT CoEng_trqLimOffs "current torque limitation with offset for ASDdc" SWORD Trq 1 100 -3276.800 3276.700 FORMAT "%8.3" ECU_ADDRESS 0x7F8B82 /end MEASUREMENT
/begin MEASUREMENT CoEng_trqLimOffs_mp "aktueller Momentgrenzwert mit Offset f. ARD" SWORD Trq 1 100 -3276.800 3276.700 FORMAT "%8.3" ECU_ADDRESS 0x8FE548 /end MEASUREMENT
/begin MEASUREMENT CoEng_trqLimPDiff "Momentenbegrenzung aufgrund Druckdifferenz über Partikelfilter" SWORD Trq 1 100 -3276.800 3276.700 FORMAT "%8.3" ECU_ADDRESS 0x7F8B84 /end MEASUREMENT
/begin MEASUREMENT CoEng_trqLimPDiffNOffs_mp "" SWORD Trq 1 100 -3276.800 3276.700 FORMAT "%8.3" ECU_ADDRESS 0x8FE568 /end MEASUREMENT
/begin MEASUREMENT CoEng_trqLimPFlt1_mp "Pressure difference conversion to torque" SWORD Trq 1 100 -3276.800 3276.700 FORMAT "%8.3" ECU_ADDRESS 0x8FE56A /end MEASUREMENT
/begin MEASUREMENT CoEng_trqLimSwt "Ausgang des RampSwitch-Block zur Momentbegrenzung im Systemfehlerfall" SWORD Trq 1 100 -3276.800 3276.700 FORMAT "%8.3" ECU_ADDRESS 0x7F8B86 /end MEASUREMENT
/begin MEASUREMENT CoEng_trqLimSwt1_mp "Begrenzungsmoment im Fehlerfall" SWORD Trq 1 100 -3276.800 3276.700 FORMAT "%8.3" ECU_ADDRESS 0x8FE56C /end MEASUREMENT
/begin MEASUREMENT CoEng_trqLimSwt2_mp "Begrenzungsmoment im Fehlerfall 2" SWORD Trq 1 100 -3276.800 3276.700 FORMAT "%8.3" ECU_ADDRESS 0x8FE56E /end MEASUREMENT
/begin MEASUREMENT CoEng_trqLimSwt3_mp "Begrenzungsmoment im Fehlerfall" SWORD Trq 1 100 -3276.800 3276.700 FORMAT "%8.3" ECU_ADDRESS 0x8FE570 /end MEASUREMENT
/begin MEASUREMENT CoEng_trqLimSwt4_mp "Begrenzungsmoment im Fehlerfall" SWORD Trq 1 100 -3276.800 3276.700 FORMAT "%8.3" ECU_ADDRESS 0x8FE572 /end MEASUREMENT
/begin MEASUREMENT CoEng_trqMax "Momentintervall Maximum" SWORD Trq 1 100 -3276.800 3276.700 FORMAT "%8.3" ECU_ADDRESS 0x7F8B88 /end MEASUREMENT
/begin MEASUREMENT CoEng_trqMin "Schleppmoment" SWORD Trq 1 100 -3276.800 3276.700 FORMAT "%8.3" ECU_ADDRESS 0x7F8B8A /end MEASUREMENT
/begin MEASUREMENT CoEng_trqOvrFul "Overfueling Menge nach Rampe" SWORD Trq 1 100 -3276.800 3276.700 FORMAT "%8.3" ECU_ADDRESS 0x7F8B8C /end MEASUREMENT
/begin MEASUREMENT CoEng_trqRmp_mp "Ausgangsmoment Rampe der Schubabschaltung" SWORD Trq 1 100 -3276.800 3276.700 FORMAT "%8.3" ECU_ADDRESS 0x8FE54A /end MEASUREMENT
/begin MEASUREMENT CoEng_trqSetASDdc_mp "Sollmoment nach Eingriff Ruckeldämfer vor zweiter Begrenzung (mit Offset)" SWORD Trq 1 100 -3276.800 3276.700 FORMAT "%8.3" ECU_ADDRESS 0x8FE54C /end MEASUREMENT
/begin MEASUREMENT CoEng_trqSlpLim "Begrenzungsmoment für Rauchbegrenzung nach Turboschubbegrenzung" SWORD Trq 1 100 -3276.800 3276.700 FORMAT "%8.3" ECU_ADDRESS 0x7F8B90 /end MEASUREMENT
/begin MEASUREMENT CoEng_volFlConsum "absoluter Verbrauch" SLONG FlConsum_ul_20ms 1 100 -2147483648.00 2147483647.00 FORMAT "%13.2" ECU_ADDRESS 0x7F9194 /end MEASUREMENT
/begin MEASUREMENT CoEng_volFlConsumAdj_mp "abgeglicher Kraftstoffverbrauch" SLONG FlConsum_ul_20ms 1 100 -2147483648.00 2147483647.00 FORMAT "%13.2" ECU_ADDRESS 0x8FE51C /end MEASUREMENT
/begin MEASUREMENT CoEng_voltotFlConsum "Absoluter Kraftstoffverbrauch" SLONG FlConsum_ul 1 100 -2147483648.00 2147483647.00 FORMAT "%13.2" ECU_ADDRESS 0x7F9198 /end MEASUREMENT
/begin MEASUREMENT ComBas_stDiaReq "Message: Antwort von der Diagnose-Schnittstelle" UBYTE OneToOne 1 100 0.00 255.0 FORMAT "%5.1" ECU_ADDRESS 0x7F8825 /end MEASUREMENT
/begin MEASUREMENT ConvCD_ctClutchDfct_mp "Defektzähler von Plausibitätfehler des Kupplungssignals" UWORD OneToOne 1 100 0.00 65535.00 FORMAT "%8.2" ECU_ADDRESS 0x8FE574 /end MEASUREMENT
/begin MEASUREMENT ConvCD_stClth "Kupplungszustand" UBYTE OneToOne 1 100 0.00 255.0 FORMAT "%5.1" ECU_ADDRESS 0x7F8826 /end MEASUREMENT
/begin MEASUREMENT ConvCD_stClthRaw "Kupplungszustand nicht überwacht" UBYTE OneToOne 1 100 0.00 255.0 FORMAT "%5.1" ECU_ADDRESS 0x7F8827 /end MEASUREMENT
/begin MEASUREMENT ConvCD_stClutchRecord "Message zur Kupplungsstatus Wechsel ( 0 --> 1)" UBYTE OneToOne 1 100 0.00 255.0 FORMAT "%5.1" ECU_ADDRESS 0x7F8828 /end MEASUREMENT
/begin MEASUREMENT ConvCD_stDebVal "entprelltes Kupplungssignal" UBYTE OneToOne 1 100 0.00 255.0 FORMAT "%5.1" ECU_ADDRESS 0x7F8829 /end MEASUREMENT
/begin MEASUREMENT ConvCD_stIntDebVal "Entprellt Kupplung Status zur internen Verwendung" UBYTE OneToOne 1 100 0.00 255.0 FORMAT "%5.1" ECU_ADDRESS 0x7F882A /end MEASUREMENT
/begin MEASUREMENT ConvCD_stLastDebVal "Letzter Kupplungssignalstatus." UBYTE OneToOne 1 100 0.00 255.0 FORMAT "%5.1" ECU_ADDRESS 0x7F882B /end MEASUREMENT
/begin MEASUREMENT ConvCD_stLastGear "Gang von den letzten Zyklus" SBYTE OneToOne 1 100 -128.0 127.0 FORMAT "%5.1" ECU_ADDRESS 0x7F882C /end MEASUREMENT
/begin MEASUREMENT ConvCD_stOldGear "Letzte gültigen Gang" SBYTE OneToOne 1 100 -128.0 127.0 FORMAT "%5.1" ECU_ADDRESS 0x7F882D /end MEASUREMENT
/begin MEASUREMENT ConvCD_stRawVal "Kupplungssignal Rohwert" UBYTE OneToOne 1 100 0.00 255.0 FORMAT "%5.1" ECU_ADDRESS 0x7F882E /end MEASUREMENT
/begin MEASUREMENT ConvCD_swtSig "Schalter für Kupplungssignalquelle (DIO/CAN)." UBYTE OneToOne 1 100 0.00 255.0 FORMAT "%5.1" ECU_ADDRESS 0x7F882F /end MEASUREMENT
/begin MEASUREMENT Conv_rTrans "Übertragungsverhältins Momentenwandler (Kupplung)" SWORD TransR 1 100 -327.6800 327.6700 FORMAT "%8.4" ECU_ADDRESS 0x7F8BBE /end MEASUREMENT
/begin MEASUREMENT CoVeh_nAcsMax "maximale Drehzahl Nebenaggregate" SWORD EngN 1 100 -32768.00 32767.00 FORMAT "%8.2" ECU_ADDRESS 0x7F8BA0 /end MEASUREMENT
/begin MEASUREMENT CoVeh_nAcsMin "minimale Drehzahl Nebenaggregate" SWORD EngN 1 100 -32768.00 32767.00 FORMAT "%8.2" ECU_ADDRESS 0x7F8BA2 /end MEASUREMENT
/begin MEASUREMENT CoVeh_nLimEngSpd "limitierte Motordrehzahl für die Drehmomentenberechnung" SWORD EngN 1 100 -32768.00 32767.00 FORMAT "%8.2" ECU_ADDRESS 0x7F8BA4 /end MEASUREMENT
/begin MEASUREMENT CoVeh_nMax "Auftrag maximale Motordrehzahl" SWORD EngN 1 100 -32768.00 32767.00 FORMAT "%8.2" ECU_ADDRESS 0x7F8BA6 /end MEASUREMENT
/begin MEASUREMENT CoVeh_nMin "Auftrag minimale Motordrehzahl" SWORD EngN 1 100 -32768.00 32767.00 FORMAT "%8.2" ECU_ADDRESS 0x7F8BA8 /end MEASUREMENT
/begin MEASUREMENT CoVeh_pwrAcsDes "Nebenaggregatleistung Auftrag" SWORD Pwr 1 100 -308831.1 308821.7 FORMAT "%8.1" ECU_ADDRESS 0x7F8BAA /end MEASUREMENT
/begin MEASUREMENT CoVeh_pwrAcsLead "Vorhalt Nebenaggregatleistung Auftrag" SWORD Pwr 1 100 -308831.1 308821.7 FORMAT "%8.1" ECU_ADDRESS 0x7F8BAC /end MEASUREMENT
/begin MEASUREMENT CoVeh_pwrAcsTempLim_mp "Power demand for all temporary accessories - limited based on PrpBrk_trqDes" SWORD Pwr 1 100 -308831.1 308821.7 FORMAT "%8.1" ECU_ADDRESS 0x8FE576 /end MEASUREMENT
/begin MEASUREMENT CoVeh_stOrd "Randbedingungen für physikalischen Auftrag" UBYTE OneToOne 1 100 0.00 255.0 FORMAT "%5.1" ECU_ADDRESS 0x7F8823 /end MEASUREMENT
/begin MEASUREMENT CoVeh_trqAcs "Momentenanforderung der Nebenaggregate" SWORD Trq 1 100 -3276.800 3276.700 FORMAT "%8.3" ECU_ADDRESS 0x7F8BAE /end MEASUREMENT
/begin MEASUREMENT CoVeh_trqAcsDes "Momentenanforderung Nebenaggregate Wunschwert" SWORD Trq 1 100 -3276.800 3276.700 FORMAT "%8.3" ECU_ADDRESS 0x7F8BB0 /end MEASUREMENT
/begin MEASUREMENT CoVeh_trqAcsLead "Momentenanforderung Nebenaggregate Vorhaltewert" SWORD Trq 1 100 -3276.800 3276.700 FORMAT "%8.3" ECU_ADDRESS 0x7F8BB2 /end MEASUREMENT
/begin MEASUREMENT CoVeh_trqAcsLimCrSDes_mp "Torque demand" SWORD Trq 1 100 -3276.800 3276.700 FORMAT "%8.3" ECU_ADDRESS 0x8FE578 /end MEASUREMENT
/begin MEASUREMENT CoVeh_trqAcsPerm "Momentenbedarf permanente Nebenaggregate" SWORD Trq 1 100 -3276.800 3276.700 FORMAT "%8.3" ECU_ADDRESS 0x7F8BB4 /end MEASUREMENT
/begin MEASUREMENT CoVeh_trqAcsTemp "Momentenbedarf zuschaltbare Nebenaggregate" SWORD Trq 1 100 -3276.800 3276.700 FORMAT "%8.3" ECU_ADDRESS 0x7F8BB6 /end MEASUREMENT
/begin MEASUREMENT CoVeh_trqPrpDes "Vortriebsmoment Wunschwert" SWORD TrqPrp 1 100 -6553.600 6553.400 FORMAT "%8.3" ECU_ADDRESS 0x7F8BB8 /end MEASUREMENT
/begin MEASUREMENT CoVeh_trqPrpLead "Vortriebsmoment Vorhaltewert" SWORD TrqPrp 1 100 -6553.600 6553.400 FORMAT "%8.3" ECU_ADDRESS 0x7F8BBA /end MEASUREMENT
/begin MEASUREMENT CoVeh_trqPrpLimErr "Begrenzungsmoment für Vortrieb im Falle eines Systemfehlers" SWORD TrqPrp 1 100 -6553.600 6553.400 FORMAT "%8.3" ECU_ADDRESS 0x7F8BBC /end MEASUREMENT
/begin MEASUREMENT CoVM_amAct_mp "Aktueller Integrationswert des  MSR-Momentenüberschußintegrals" SWORD TrqPrpDT 1 100 -163840.0 163835.0 FORMAT "%8.1" ECU_ADDRESS 0x8FE57A /end MEASUREMENT
/begin MEASUREMENT CoVM_stActDem "Status aktiv wirkender Fahrdynamikeingriffe" UBYTE OneToOne 1 100 0.00 255.0 FORMAT "%5.1" ECU_ADDRESS 0x7F881D /end MEASUREMENT
/begin MEASUREMENT CoVM_stDemCheck "Steuerbits der Abschaltsteuerung der Fahrdynamikeingriffe" UBYTE OneToOne 1 100 0.00 255.0 FORMAT "%5.1" ECU_ADDRESS 0x7F881E /end MEASUREMENT
/begin MEASUREMENT CoVM_stDemUnplaus_mp "Status der DCS Überwachung" UBYTE OneToOne 1 100 0.00 255.0 FORMAT "%5.1" ECU_ADDRESS 0x8FE57C /end MEASUREMENT
/begin MEASUREMENT CoVM_stOrd "Randbedingungen für physikalischen Auftrag" UBYTE OneToOne 1 100 0.00 255.0 FORMAT "%5.1" ECU_ADDRESS 0x7F881F /end MEASUREMENT
/begin MEASUREMENT CoVM_stTrqLeadFrz "current status if SW timer running" UBYTE OneToOne 1 100 0.00 255.0 FORMAT "%5.1" ECU_ADDRESS 0x7F8820 /end MEASUREMENT
/begin MEASUREMENT CoVM_swtSlipCtl "Fahrdynamik-Konfiguration (0: ASR aus, MSR aus; 1: ASR an, MSR aus;  2: ASR aus, MSR an;  3: ASR an, MSR an)" UBYTE OneToOne 1 100 0.00 255.0 FORMAT "%5.1" ECU_ADDRESS 0x7F8822 /end MEASUREMENT
/begin MEASUREMENT CoVM_trqDec "Momenteneingriff von ASR" SWORD TrqPrp 1 100 -6553.600 6553.400 FORMAT "%8.3" ECU_ADDRESS 0x7F8B94 /end MEASUREMENT
/begin MEASUREMENT CoVM_trqDecSetVal_mp "decreasing  torque set value wheel-torque" SWORD TrqPrp 1 100 -6553.600 6553.400 FORMAT "%8.3" ECU_ADDRESS 0x8FE584 /end MEASUREMENT
/begin MEASUREMENT CoVM_trqDesIncMax_mp "Messpunkt des Maximumwertes zwischen PrpBrk_trqDes & CoVM_trqInc" SWORD TrqPrp 1 100 -6553.600 6553.400 FORMAT "%8.3" ECU_ADDRESS 0x8FE580 /end MEASUREMENT
/begin MEASUREMENT CoVM_trqDVCH "Fahrerwunschmoment für DSC, EGS" SWORD Trq 1 100 -3276.800 3276.700 FORMAT "%8.3" ECU_ADDRESS 0x7F8B92 /end MEASUREMENT
/begin MEASUREMENT CoVM_trqGearbxMax "Momentbegrenzung reduzierender Getriebeeingriff" SWORD Trq 1 100 -3276.800 3276.700 FORMAT "%8.3" ECU_ADDRESS 0x7F8B96 /end MEASUREMENT
/begin MEASUREMENT CoVM_trqGearbxMin "Momentbegrenzung erhöhender Getriebeeingriff" SWORD Trq 1 100 -3276.800 3276.700 FORMAT "%8.3" ECU_ADDRESS 0x7F8B98 /end MEASUREMENT
/begin MEASUREMENT CoVM_trqInc "Momenteneingriff von MSR" SWORD TrqPrp 1 100 -6553.600 6553.400 FORMAT "%8.3" ECU_ADDRESS 0x7F8B9A /end MEASUREMENT
/begin MEASUREMENT CoVM_trqIncSetVal_mp "increasing  torque set value  of wheel-torque" SWORD TrqPrp 1 100 -6553.600 6553.400 FORMAT "%8.3" ECU_ADDRESS 0x8FE586 /end MEASUREMENT
/begin MEASUREMENT CoVM_trqInt_mp "Aktuelles  Integrationsmoment des MSR-Momentenüberschußintegrals" SWORD TrqPrp 1 100 -6553.600 6553.400 FORMAT "%8.3" ECU_ADDRESS 0x8FE57E /end MEASUREMENT
/begin MEASUREMENT CoVM_trqLeadIncMax_mp "Messpunkt des Maximumwertes zwischen PrpBrk_trqLead & CoVM_trqInc" SWORD TrqPrp 1 100 -6553.600 6553.400 FORMAT "%8.3" ECU_ADDRESS 0x8FE582 /end MEASUREMENT
/begin MEASUREMENT CoVM_trqPrpDes "Wunsch Vortriebsmoment" SWORD TrqPrp 1 100 -6553.600 6553.400 FORMAT "%8.3" ECU_ADDRESS 0x7F8B9C /end MEASUREMENT
/begin MEASUREMENT CoVM_trqPrpLead "Vorhalt Vortriebsmoment" SWORD TrqPrp 1 100 -6553.600 6553.400 FORMAT "%8.3" ECU_ADDRESS 0x7F8B9E /end MEASUREMENT
/begin FUNCTION asmod_voleff_uic ""
 /begin OUT_MEASUREMENT ASMod_facTIndAirCor_mp ASMod_facVolEff_mp ASMod_facVSACorVolEff_mp ASMod_tIntakeAir_mp /end OUT_MEASUREMENT
/end FUNCTION
/begin FUNCTION battcd "Komponententreiber Batteriespannung"
 /begin DEF_CHARACTERISTIC BattCD_uSRCMin_C BattCD_uSRCMax_C BattCD_uLin_CUR BattCD_DebSRCHighDef_C BattCD_DebSRCHighOk_C BattCD_DebSRCLowDef_C BattCD_DebSRCLowOk_C BattCD_numAdc_C BattCD_duRmpSlpUp_C BattCD_duRmpSlpDwn_C BattCD_stSensIDWord_C BattCD_uDfl_C /end DEF_CHARACTERISTIC
 /begin IN_MEASUREMENT BattCD_uRaw /end IN_MEASUREMENT
/end FUNCTION
/begin FUNCTION battcd_msg "" /begin OUT_MEASUREMENT BattCD_u BattCD_uLin BattCD_uRaw /end OUT_MEASUREMENT /end FUNCTION
/begin FUNCTION battcd_uic "" /end FUNCTION
/begin FUNCTION batt_corfac "" /begin DEF_CHARACTERISTIC Batt_uNrm_C /end DEF_CHARACTERISTIC /end FUNCTION
/begin FUNCTION batt_corfac_msg "" /begin OUT_MEASUREMENT Batt_facCor /end OUT_MEASUREMENT /end FUNCTION
/begin FUNCTION bdint "Karosserie und Innenraum" /end FUNCTION
/begin FUNCTION bdint_msg "" /begin OUT_MEASUREMENT BdInt_nMax BdInt_nMin BdInt_pwrDes BdInt_pwrLead /end OUT_MEASUREMENT /end FUNCTION
/begin FUNCTION bpacd "Komponententreiber des Ladedruckstellers"
 /begin DEF_CHARACTERISTIC BPACD_ctPwrStgOnMax_C BPACD_tiDebBPADia1Def_C BPACD_tiDebBPADia1Ok_C BPACD_tiDebBPADia2Def_C BPACD_tiDebBPADia2Ok_C BPACD_tiDebBPADia3Def_C BPACD_tiDebBPADia3Ok_C BPACD_DebExcTempDef_C BPACD_DebExcTempOk_C BPACD_DebNoLoadDef_C BPACD_DebNoLoadOk_C BPACD_DebShortCircBatDef_C BPACD_DebShortCircBatOk_C BPACD_DebShortCircGndDef_C BPACD_DebShortCircGndOk_C BPACD_numDia_C BPACD_numPwmOut_C BPACD_stInvOut_C BPACD_tiPer_C BPACD_rCnv_CUR BPACD_rOutMax_C BPACD_rOutMin_C BPACD_stPwrStgActv_C BPACD_stPwrStgDia_C BPACD_stSPICtl_C BPACD_swt_C BPACD_tiBtwTst_C BPACD_tiDiag1Max_C BPACD_tiDiag1Min_C BPACD_tiDiag2Max_C BPACD_tiDiag2Min_C BPACD_tiDiag3Max_C BPACD_tiDiag3Min_C BPACD_tiPwrStgOn_C /end DEF_CHARACTERISTIC
 /begin IN_MEASUREMENT BPA_rBPACD /end IN_MEASUREMENT
/end FUNCTION
/begin FUNCTION bpacd_msg "" /begin OUT_MEASUREMENT BPACD_rOut /end OUT_MEASUREMENT /end FUNCTION
/begin FUNCTION bpacd_uic "" /begin OUT_MEASUREMENT BPACD_rCnv_mp /end OUT_MEASUREMENT /end FUNCTION
/begin FUNCTION bpa_co "Stellerkoordinator für Ladedrucksteller" /end FUNCTION
/begin FUNCTION bpa_co_msg "" /begin OUT_MEASUREMENT BPA_rBPACD /end OUT_MEASUREMENT /end FUNCTION
/begin FUNCTION bpa_co_uic "" /begin DEF_CHARACTERISTIC BPA_rBPACD_Vector BPA_rBPACD_Channel /end DEF_CHARACTERISTIC /begin OUT_MEASUREMENT BPA_rBPAByp_mp /end OUT_MEASUREMENT /end FUNCTION
/begin FUNCTION bpa_lpco "" /end FUNCTION
/begin FUNCTION bpa_lpco_msg "" /begin OUT_MEASUREMENT BPA_rLPACD /end OUT_MEASUREMENT /end FUNCTION
/begin FUNCTION bpa_lpco_uic "" /begin DEF_CHARACTERISTIC BPA_rLPACD_Vector BPA_rLPACD_Channel /end DEF_CHARACTERISTIC /begin OUT_MEASUREMENT BPA_rLPAByp_mp /end OUT_MEASUREMENT /end FUNCTION
/begin FUNCTION bpscd "Komponententreiber des Ladedruckfühlers"
 /begin DEF_CHARACTERISTIC BPSCD_uSRCMin_C BPSCD_uSRCMax_C BPSCD_pLin_CUR BPSCD_DebNplDef_C BPSCD_DebNplOK_C BPSCD_DebSigDef_C BPSCD_DebSigOK_C BPSCD_DebSRCHighDef_C BPSCD_DebSRCHighOK_C BPSCD_DebSRCLowDef_C BPSCD_DebSRCLowOK_C BPSCD_tiDT1_C BPSCD_dDT1Kd_C BPSCD_tiLPFiltPT1_C BPSCD_nLim_C BPSCD_numAdc_C BPSCD_pDiffLim_C BPSCD_tiOutValDT1_C BPSCD_dDT1KdOutVal_C BPSCD_tiPT1_C BPSCD_dpRmpSlpUp_C BPSCD_dpRmpSlpDwn_C BPSCD_swtSigVal_C BPSCD_stSensIDWord_C BPSCD_pDfl_C /end DEF_CHARACTERISTIC
 /begin IN_MEASUREMENT BPSCD_uRawVal /end IN_MEASUREMENT
/end FUNCTION
/begin FUNCTION bpscd_msg ""
 /begin OUT_MEASUREMENT BPSCD_dFltValDT1 BPSCD_dpOutVal BPSCD_pFltVal BPSCD_pIntVal BPSCD_pLin BPSCD_pOutVal BPSCD_pPhyVal BPSCD_stErr BPSCD_stPlausErr BPSCD_uRawVal /end OUT_MEASUREMENT
/end FUNCTION
/begin FUNCTION bpscd_uic "" /end FUNCTION
/begin FUNCTION brkcd "Komponententreiber zur Erfassung aller Bremssignale"
 /begin DEF_CHARACTERISTIC BrkCD_ctUnPlausDef_C BrkCD_DebPlaDef_C BrkCD_DebPlaOk_C BrkCD_DebSigDef_C BrkCD_DebSigOk_C BrkCD_tiMnSwtDebNeg_C BrkCD_tiMnSwtDebPos_C BrkCD_numDioInMn_C BrkCD_numDioInRed_C BrkCD_tiRedSwtDebNeg_C BrkCD_tiRedSwtDebPos_C BrkCD_stDflVal_C BrkCD_stMnSwtInvIn_C BrkCD_stRedSwtInvIn_C BrkCD_swtRedSwtPresent_C BrkCD_swtSigVal_C BrkCD_tiDebResUnPlaus_C BrkCD_tiDebUnPlausStat_C BrkCD_tiDebUnPlaus_C /end DEF_CHARACTERISTIC
/end FUNCTION
/begin FUNCTION brkcd_msg ""
 /begin OUT_MEASUREMENT BrkCD_stMnSwtDebVal BrkCD_stMnSwtLastDebVal BrkCD_stMnSwtRawVal BrkCD_stPressed BrkCD_stRedSwtDebVal BrkCD_stRedSwtLastDebVal BrkCD_stRedSwtPresent BrkCD_stRedSwtRawVal BrkCD_swtSig /end OUT_MEASUREMENT
/end FUNCTION
/begin FUNCTION brkcd_uic ""
 /begin OUT_MEASUREMENT BrkCD_ctUnPlaus_mp BrkCD_stDeb_mp BrkCD_stMnSwtLogVal_mp BrkCD_stRedSwtLogVal_mp BrkCD_stResUnPlaus_mp BrkCD_stRun_mp /end OUT_MEASUREMENT
/end FUNCTION
/begin FUNCTION bss "Servicetask für Bit Serielle Schnittstelle" /begin DEF_CHARACTERISTIC Bss_tiDebDefect_C Bss_tiDebOk_C /end DEF_CHARACTERISTIC /end FUNCTION
/begin FUNCTION bypetk ""
 /begin DEF_CHARACTERISTIC BypEtk_dNsyncStimuli64_C BypEtk_dNsyncStimuli32_C BypEtk_dNsyncStimuli16_C BypEtk_dNsyncStimuli8_C BypEtk_stAscet_C BypEtk_dTsyncStimuli64_C BypEtk_dTsyncStimuli32_C BypEtk_dTsyncStimuli16_C BypEtk_dTsyncStimuli8_C /end DEF_CHARACTERISTIC
/end FUNCTION
/begin FUNCTION bypetk_msg ""
 /begin OUT_MEASUREMENT BypEtk_ctStepDelayNsync_u8 BypEtk_ctStepDelayTsync_u8 BypEtk_stEcu_u8 /end OUT_MEASUREMENT
/end FUNCTION
/begin FUNCTION bypint "" /begin DEF_CHARACTERISTIC BypInt_adFunc_C BypInt_stAscet_C /end DEF_CHARACTERISTIC /end FUNCTION
/begin FUNCTION bypint_msg "" /begin OUT_MEASUREMENT BypInt_stEcu_u8 /end OUT_MEASUREMENT /end FUNCTION
/begin FUNCTION carb "CARB Einstellungen"
 /begin DEF_CHARACTERISTIC Carb_Mode1PID_CA Carb_Mode1Signal_CA Carb_Mode2PID_CA Carb_Mode2Signal_CA Carb_Mode3SwtDia_C Carb_Mode4RefVal_C Carb_Mode4SigNum_C Carb_Mode6TstComp_CUR Carb_Mode6TstNum_CUR Carb_Mode6TstRefMax_CUR Carb_Mode6TstRefMin_CUR Carb_Mode6TstTestId_CUR Carb_Mode6TstUnitId_CUR Carb_Mode6TstVal_CUR Carb_Mode9PID0_C Carb_Mode9PID1_C Carb_Mode9PID2_C Carb_Mode9PID3_C Carb_Mode9PID4_C Carb_Mode9PID5_C Carb_Mode9PID6_C /end DEF_CHARACTERISTIC
/end FUNCTION
/begin FUNCTION cascd "Komponententreiber Nockenwelle"
 /begin DEF_CHARACTERISTIC CaSCD_ctEdgOfs_C CaSCD_ctErrSync_C CaSCD_ctShftSync_C CaSCD_dSegSeries_C CaSCD_facPlausHigh_CUR CaSCD_facPlausLow_CUR CaSCD_nMinSpeed_C CaSCD_phiSegLenTolc_C CaSCD_phiSegLen_C CaSCD_phiSegOfs_C CaSCD_phiSpeedCalcTolc_C CaSCD_phiSpeedSegLen_C CaSCD_phiSpeedSegOfs_C CaSCD_stCalc_C CaSCD_stEdgeTrig_C CaSCD_stPinState_C CaSCD_stTPO_C CaSCD_tiPeriodRev1Max_C CaSCD_tiPeriodRev2Max_C CaSCD_tiTimOutOfs_C /end DEF_CHARACTERISTIC
 /begin IN_MEASUREMENT CaSCD_tiPeriodRev CaSCD_tiPeriodRevHold /end IN_MEASUREMENT
/end FUNCTION
/begin FUNCTION cascd_backup "" /end FUNCTION
/begin FUNCTION cascd_msg ""
 /begin OUT_MEASUREMENT CaSCD_nPeriod CaSCD_nSeg CaSCD_tiPeriodRev CaSCD_tiPeriodRevHold CaSCD_tiSeg /end OUT_MEASUREMENT
/end FUNCTION
/begin FUNCTION cascd_uic ""
 /begin OUT_MEASUREMENT CaSCD_ctEdgCaSRev_mp CaSCD_ctEdgOfs_mp CaSCD_ctEdgOrd_mp CaSCD_ctErrEdg_mp CaSCD_ctPhRevEdges_mp CaSCD_ctPhRev_mp CaSCD_ctSegEdg_mp CaSCD_ctShftPos_mp CaSCD_ctSyncEdg_mp CaSCD_numFrstInt_mp CaSCD_numFrstTDC_mp CaSCD_phiCurr_mp CaSCD_phiLstEdge_mp CaSCD_stPhaseErr_mp CaSCD_stPhaseSig_mp CaSCD_stPhaseSync_mp CaSCD_stSegCylEdg_mp CaSCD_stSyncCylEdg_mp CaSCD_tiSigTimOut_mp /end OUT_MEASUREMENT
/end FUNCTION
/begin FUNCTION cbacd ""
 /begin DEF_CHARACTERISTIC CBACD_ctPwrStgOnMax_C CBACD_numDia_C CBACD_numDioOut_C CBACD_stInvOut_C CBACD_stPwrStgActv_C CBACD_stPwrStgDia_C CBACD_stSPICtl_C CBACD_tiBtwTst_C CBACD_tiDebExcTempDef_C CBACD_tiDebExcTempOk_C CBACD_tiDebNoLoadDef_C CBACD_tiDebNoLoadOk_C CBACD_tiDebShortCircBatDef_C CBACD_tiDebShortCircBatOk_C CBACD_tiDebShortCircGndDef_C CBACD_tiDebShortCircGndOk_C CBACD_tiPwrStgOn_C /end DEF_CHARACTERISTIC
/end FUNCTION
/begin FUNCTION cbacd_uic "" /begin OUT_MEASUREMENT CBACD_stLogicOut_mp /end OUT_MEASUREMENT /end FUNCTION
/begin FUNCTION clg "Kühlung"
 /begin DEF_CHARACTERISTIC Clg_dtMinDynTst_C Clg_nMinEnaDynTst_C Clg_qMinEnaDynTst_C Clg_tiInitTmr_C Clg_tiMaxDynTst_CUR Clg_tMinClntDynTst_C /end DEF_CHARACTERISTIC
 /begin IN_MEASUREMENT Clg_tClntStrtVal_mp /end IN_MEASUREMENT
/end FUNCTION
/begin FUNCTION clg_msg ""
 /begin OUT_MEASUREMENT Clg_dtDynTst Clg_dtMinDynTst Clg_tEndDynTst Clg_tiDynTst Clg_tiMaxDynTst Clg_tMinClntDynTst /end OUT_MEASUREMENT
/end FUNCTION
/begin FUNCTION clg_uic "" /begin OUT_MEASUREMENT Clg_tClntStrtVal_mp /end OUT_MEASUREMENT /end FUNCTION
/begin FUNCTION cmbchb_misfire "Brennräume Fehlzündungserkennung"
 /begin DEF_CHARACTERISTIC CmbChb_nAvrgThrHi_C CmbChb_nAvrgThrLo_C CmbChb_qRawThrHi_C CmbChb_qRawThrLo_C CmbChb_tClntThrLo_C CmbChb_vThrHi_C CmbChb_tiDebClutchChng_C CmbChb_tiDlyStr_C CmbChb_ctEngRevPerBlk_C CmbChb_ctSegTDC1_C CmbChb_numBlk_C CmbChb_dnSegMin_C CmbChb_ctMisfireMax_C CmbChb_swtMonClutchVal_C CmbChb_swtMonClutchType_C /end DEF_CHARACTERISTIC
 /begin OUT_MEASUREMENT CmbChb_ctMifBuf1_mp CmbChb_ctMifBuf2_mp CmbChb_ctMifMem_mp /end OUT_MEASUREMENT
/end FUNCTION
/begin FUNCTION cmbchb_misfire_msg "" /begin OUT_MEASUREMENT CmbChb_st CmbChb_swtMonClutch /end OUT_MEASUREMENT /end FUNCTION
/begin FUNCTION cmbchb_misfire_uic ""
 /begin OUT_MEASUREMENT CmbChb_ctEngRevLogBuf1_mp CmbChb_ctEngRevLogBuf2_mp CmbChb_ctEngRevLogMem_mp CmbChb_ctEngRevPerBlk_mp CmbChb_dnSegMinPerCyl_mp CmbChb_nSegEven_mp CmbChb_nSegOdd_mp /end OUT_MEASUREMENT
/end FUNCTION
/begin FUNCTION codt_drvtrncord "Antriebs-Koordination"
 /begin DEF_CHARACTERISTIC CoDT_dtrqLimDwnCurr_C CoDT_dtrqLimDwnLead_C CoDT_dtrqLimUpCurr_C CoDT_dtrqLimUpLead_C CoDT_swtCoTypeVal_C CoDT_swtCoTypeType_C CoDT_tiTrqRedMaxCurr_C CoDT_tiTrqRedMaxLead_C /end DEF_CHARACTERISTIC
/end FUNCTION
/begin FUNCTION codt_drvtrncordlead_uic ""
 /begin OUT_MEASUREMENT CoDT_trqDTInDecLead_mp CoDT_trqDTInIncLead_mp CoDT_trqGearbxLead_mp /end OUT_MEASUREMENT
/end FUNCTION
/begin FUNCTION codt_drvtrncord_msg ""
 /begin OUT_MEASUREMENT CoDT_nMax CoDT_nMin CoDT_stOrd CoDT_swtCoType CoDT_trqAcsDes CoDT_trqCurr CoDT_trqDes CoDT_trqDTInCurr CoDT_trqDTInDes CoDT_trqDTInLead CoDT_trqGearbxDes CoDT_trqLead /end OUT_MEASUREMENT
/end FUNCTION
/begin FUNCTION codt_drvtrncord_uic "" /end FUNCTION
/begin FUNCTION codt_grip "Kraftschluß innerhalb Antrieb"
 /begin DEF_CHARACTERISTIC CoDT_tiChkGrpDT1_C CoDT_dChkGrpDT1Kd_C CoDT_tiChkGrpPT1_C CoDT_dOfsGripDet_C CoDT_dOfsNoGripDet_C CoDT_dThetaGripDet_C CoDT_dThetaNoGripDet_C CoDT_swtNoGripDet_C CoDT_tiDebGearUnVal_C CoDT_tiDebNoGrip_C CoDT_tiGripDeb_C CoDT_vGrip_C /end DEF_CHARACTERISTIC
/end FUNCTION
/begin FUNCTION codt_grip_msg "" /begin OUT_MEASUREMENT CoDT_Grip CoDT_stGripDeb /end OUT_MEASUREMENT /end FUNCTION
/begin FUNCTION codt_grip_uic ""
 /begin OUT_MEASUREMENT CoDT_dnAbsEng_mp CoDT_dnEng_mp CoDT_dnGrip_mp CoDT_dnNoGrip_mp CoDT_stNoGripDet_mp CoDT_trqAbsGbxPT1_mp CoDT_trqGbxPT1_mp /end OUT_MEASUREMENT
/end FUNCTION
/begin FUNCTION codt_prptrqcurrcalc "Antriebsmoment-Berechnung" /end FUNCTION
/begin FUNCTION codt_prptrqcurrcalc_msg "" /begin OUT_MEASUREMENT CoDT_trq CoDT_trqCurrLim CoDT_trqGbx /end OUT_MEASUREMENT /end FUNCTION
/begin FUNCTION codt_prptrqcurrcalc_uic "" /begin OUT_MEASUREMENT CoDT_trqActAcs_mp /end OUT_MEASUREMENT /end FUNCTION
/begin FUNCTION codt_prptrqrngcalc "Bereitstellung Momentenintervall" /begin DEF_CHARACTERISTIC CoDT_swtAcsFltEna_C CoDT_tiFltPT1_C CoDT_trqMinInit_C /end DEF_CHARACTERISTIC /end FUNCTION
/begin FUNCTION codt_prptrqrngcalc_msg ""
 /begin OUT_MEASUREMENT CoDT_trqAcsMin CoDT_trqGbxMax CoDT_trqGbxMin CoDT_trqMax CoDT_trqMin /end OUT_MEASUREMENT
/end FUNCTION
/begin FUNCTION codt_prptrqrngcalc_uic "" /begin OUT_MEASUREMENT CoDT_trqAcsMax_mp CoDT_trqAcs_mp /end OUT_MEASUREMENT /end FUNCTION
/begin FUNCTION coeng_actrprt "Steuerung Stellerschutz" /begin DEF_CHARACTERISTIC CoEng_nActrRelease_C CoEng_tiActrPrt_C /end DEF_CHARACTERISTIC /end FUNCTION
/begin FUNCTION coeng_actrprt_uic "" /end FUNCTION
/begin FUNCTION coeng_aftrun "" /begin DEF_CHARACTERISTIC CoEng_stAftRunSel_C CoEng_tiPwrStgDiaRdy_C /end DEF_CHARACTERISTIC /end FUNCTION
/begin FUNCTION coeng_aftrunextwait "Warten auf externe Ereignisse während Nachlauf"
 /begin DEF_CHARACTERISTIC CoEng_ExtWaitMsk2_C CoEng_ExtWaitMsk_C CoEng_tiMinAftRun_C CoEng_tiMRlyShutOffDel_C CoEng_tiWakeUp_C /end DEF_CHARACTERISTIC
/end FUNCTION
/begin FUNCTION coeng_aftrunextwait_msg "" /begin OUT_MEASUREMENT CoEng_stExtWait CoEng_stExtWait2 CoEng_tiMinAftRun /end OUT_MEASUREMENT /end FUNCTION
/begin FUNCTION coeng_aftrunextwait_uic "" /end FUNCTION
/begin FUNCTION coeng_aftrun_msg "" /begin OUT_MEASUREMENT CoEng_stAftRun CoEng_stAftRunPath /end OUT_MEASUREMENT /end FUNCTION
/begin FUNCTION coeng_aftrun_uic "" /begin OUT_MEASUREMENT CoEng_stEEPStore_mp /end OUT_MEASUREMENT /end FUNCTION
/begin FUNCTION coeng_flconsum "Verbrauchsberechnung"
 /begin DEF_CHARACTERISTIC CoEng_dqSubsRgnRmpUp_C CoEng_dqSubsRgnRmpDwn_C CoEng_facFlConsumAdjDfl_C CoEng_facFlConsumAdjMax_C CoEng_facFlConsumAdjMin_C CoEng_qSubs_MAP CoEng_rhoFuel_C CoEng_stSubsRgnMsk_C /end DEF_CHARACTERISTIC
 /begin IN_MEASUREMENT CoEng_trq Eng_nAvrg /end IN_MEASUREMENT
/end FUNCTION
/begin FUNCTION coeng_flconsum_uic ""
 /begin OUT_MEASUREMENT CoEng_dvolPerStroke_mp CoEng_facFlConsumAdj_mp CoEng_qSubs_mp CoEng_qSum_mp CoEng_volFlConsumAdj_mp /end OUT_MEASUREMENT
/end FUNCTION
/begin FUNCTION coeng_flconsum_var "" /end FUNCTION
/begin FUNCTION coeng_flconsum_var_msg "" /end FUNCTION
/begin FUNCTION coeng_mon "Abschaltkoordinator"
 /begin DEF_CHARACTERISTIC CoEng_stIRevShutOff_C CoEng_stRevShutOff_C CoEng_stShOffAddReqIRev_C CoEng_stShOffAddReqRev_C CoEng_stShOffAirbFrnt_C CoEng_stShOffAirbRear_C CoEng_stShOffAirbSide_C CoEng_stShOffCycSigChk_C CoEng_stShOffDblCtl_C CoEng_stShOffDiaReqFI_C CoEng_stShOffFWOscDet_C CoEng_stShOffInit_C CoEng_stShOffInjMon_C CoEng_stShOffInjShCir_C CoEng_stShOffIRevSys1_C CoEng_stShOffIRevSys2_C CoEng_stShOffIRevVeh_C CoEng_stShOffIrrCmb_C CoEng_stShOffOvrSpd_C CoEng_stShOffPresMin_C CoEng_stShOffRevSys1_C CoEng_stShOffRevSys2_C CoEng_stShOffRevVeh_C CoEng_stShOffRlOvrBar_C CoEng_stShOffSV_C /end DEF_CHARACTERISTIC
/end FUNCTION
/begin FUNCTION coeng_monaddreq "Kundenspezifische Abschaltanforderungen an Abschaltkoordinator" /end FUNCTION
/begin FUNCTION coeng_monaddreq_msg "" /begin OUT_MEASUREMENT CoEng_stShOffAddReqIRev CoEng_stShOffAddReqRev /end OUT_MEASUREMENT /end FUNCTION
/begin FUNCTION coeng_monaddreq_uic "" /end FUNCTION
/begin FUNCTION coeng_mon_uic "" /end FUNCTION
/begin FUNCTION coeng_msg ""
 /begin OUT_MEASUREMENT CoEng_dvolFlConsum CoEng_facAdj CoEng_nMax CoEng_nMin CoEng_stDisable CoEng_stIRevShutOff CoEng_stMonActrPrt CoEng_stMonShOff CoEng_stOvrRun CoEng_stPwrDwn CoEng_stPwrStgEnaCond CoEng_stRevShutOff CoEng_stShutOff CoEng_stShutOffPath CoEng_stTrqLimErr CoEng_stTrqLimErr1 CoEng_stTrqLimErr2 CoEng_stTrqLimErr3 CoEng_stTrqLimErr4 CoEng_stTrqLimPFltErr CoEng_tiWakeUp CoEng_trq CoEng_trqCurrLim CoEng_trqInrCurr CoEng_trqInrCurrFast CoEng_trqInrDes CoEng_trqInrDesFast CoEng_trqInrDesSlow CoEng_trqInrLim CoEng_trqInrLimDes CoEng_trqInrLimLead CoEng_trqInrLtd CoEng_trqInrRaw CoEng_trqInrSet CoEng_trqLiLtd CoEng_trqLimErr CoEng_trqLimErr1 CoEng_trqLimErr2 CoEng_trqLimErr3 CoEng_trqLimErr4 CoEng_trqLimPDiff CoEng_trqLimSwt CoEng_trqMax CoEng_trqMin CoEng_trqOvrFul CoEng_trqSlpLim CoEng_volFlConsum CoEng_voltotFlConsum /end OUT_MEASUREMENT
/end FUNCTION
/begin FUNCTION coeng_ovrruncoord "Schubkoordinator"
 /begin DEF_CHARACTERISTIC CoEng_lSumFuncPref_C CoEng_numSelFuncPref_C CoEng_facActvFunc2_1_C CoEng_facActvFunc2_2_C CoEng_facActvFunc2_3_C CoEng_facActvFunc2_4_C CoEng_facActvFunc2_5_C CoEng_facActvFunc2_6_C CoEng_facActvFunc2_7_C CoEng_facActvFunc2_8_C CoEng_facActvFunc1_C CoEng_facActvFunc2_C CoEng_facActvFunc3_C CoEng_facActvFunc4_C CoEng_facActvFunc5_C CoEng_facActvFunc6_C CoEng_facActvFunc7_C CoEng_facActvFunc8_C CoEng_stCoopCapbl_C CoEng_stOvrRunRgnMsk_C CoEng_tiOvrRunCoordDebPos_C CoEng_tiThresFuncPref_C /end DEF_CHARACTERISTIC
/end FUNCTION
/begin FUNCTION coeng_ovrruncoord_msg "" /begin OUT_MEASUREMENT CoEng_stOvrRunCoord CoEng_stZFCEmissionRoll /end OUT_MEASUREMENT /end FUNCTION
/begin FUNCTION coeng_ovrruncoord_uic ""
 /begin OUT_MEASUREMENT CoEng_CoordPrioFld_mp CoEng_stCoordFuncFld_mp CoEng_stCoordFuncPref_mp CoEng_stOvrRunEGT_mp /end OUT_MEASUREMENT
/end FUNCTION
/begin FUNCTION coeng_pwrstgstatecalc "Endstufenkoordinator"
 /begin DEF_CHARACTERISTIC CoEng_tiDlyT15_C CoEng_uHighBattPwrStgHysHi_C CoEng_uHighBattPwrStgHysLo_C CoEng_uLowBattPwrStgHysHi_C CoEng_uLowBattPwrStgHysLo_C /end DEF_CHARACTERISTIC
/end FUNCTION
/begin FUNCTION coeng_pwrstgstatecalc_uic "" /begin OUT_MEASUREMENT CoEng_stDlyT15_mp /end OUT_MEASUREMENT /end FUNCTION
/begin FUNCTION coeng_shoff "Abstellsteuerung im Nachlauf"
 /begin DEF_CHARACTERISTIC CoEng_nSoftShOffMax_C CoEng_nSoftShOffMin_C CoEng_qSoftShOffMax_C CoEng_stShOffAftRun_C CoEng_stShOffExtReq_C CoEng_stShOffTstSel_C CoEng_stSoftShOffAR_C CoEng_tiShOffTstFlSys_C CoEng_tiSoftShOff_CUR CoEng_vSoftShOffMax_C /end DEF_CHARACTERISTIC
 /begin IN_MEASUREMENT Eng_nAvrg /end IN_MEASUREMENT
/end FUNCTION
/begin FUNCTION coeng_shofflib ""
 /begin DEF_CHARACTERISTIC CoEng_nShOffTstMax_C CoEng_nShOffTstMin_C CoEng_tShOffTstMin_C CoEng_vShOffTstMin_C /end DEF_CHARACTERISTIC
/end FUNCTION
/begin FUNCTION coeng_shofflib_uic "" /end FUNCTION
/begin FUNCTION coeng_shoff_msg "" /begin OUT_MEASUREMENT CoEng_numShOffTstNewSel CoEng_pRailT15Off CoEng_stShOffTst /end OUT_MEASUREMENT /end FUNCTION
/begin FUNCTION coeng_shoff_uic "" /begin OUT_MEASUREMENT CoEng_stShOffTstOldRes_mp CoEng_tiSoftShOff_mp /end OUT_MEASUREMENT /end FUNCTION
/begin FUNCTION coeng_steng "aktueller Motorzustand [-]" /begin DEF_CHARACTERISTIC CoEng_nThresNrml2Strt_C CoEng_tiNrml2Strt_C /end DEF_CHARACTERISTIC /end FUNCTION
/begin FUNCTION coeng_steng_msg ""
 /begin OUT_MEASUREMENT CoEng_stEng CoEng_stEngOld CoEng_tiAfterrun CoEng_tiAfterrunRed CoEng_tiNormal CoEng_tiNormalRed CoEng_tiStart CoEng_tiStartRed /end OUT_MEASUREMENT
/end FUNCTION
/begin FUNCTION coeng_steng_uic "" /end FUNCTION
/begin FUNCTION coeng_sttrqlimcalc "" /end FUNCTION
/begin FUNCTION coeng_sttrqlimcalc_msg ""
 /begin OUT_MEASUREMENT CoEng_rTrq CoEng_stCurrLim CoEng_stCurrLimActive CoEng_trqInrCurrLim /end OUT_MEASUREMENT
/end FUNCTION
/begin FUNCTION coeng_sttrqlimcalc_uic "" /begin OUT_MEASUREMENT CoEng_trqInrGearbxInMax_mp CoEng_trqInrPrpLimErr_mp /end OUT_MEASUREMENT /end FUNCTION
/begin FUNCTION coeng_trqcalc "Motormomentenberechnung"
 /begin DEF_CHARACTERISTIC CoEng_dtrqRmpUp_C CoEng_dtrqRmpDwn_C CoEng_tiRmpStrtDfl_C CoEng_tiRmpStrt_CUR CoEng_tiSwtOffDfl_C CoEng_tiSwtOff_CUR CoEng_trqInrSetLim_CUR CoEng_trqOffs_C CoEng_trqOvrRunThres_C /end DEF_CHARACTERISTIC
 /begin IN_MEASUREMENT CoEng_tiOvRMon_mp DrvTrn_rTransDT /end IN_MEASUREMENT
/end FUNCTION
/begin FUNCTION coeng_trqcalclead "" /end FUNCTION
/begin FUNCTION coeng_trqcalclead_uic ""
 /begin OUT_MEASUREMENT CoEng_trqInrCurrFastBase_mp CoEng_trqInrDesFastBase_mp CoEng_trqInrDesFastUnLim_mp /end OUT_MEASUREMENT
/end FUNCTION
/begin FUNCTION coeng_trqcalc_msg ""
 /begin OUT_MEASUREMENT CoEng_tiRmpStrt CoEng_tiSwtOff CoEng_trqInrLiDesSlw CoEng_trqLimOffs /end OUT_MEASUREMENT
/end FUNCTION
/begin FUNCTION coeng_trqcalc_uic ""
 /begin OUT_MEASUREMENT CoEng_stRmp_mp CoEng_tiOvRMon_mp CoEng_trqBefRmp_mp CoEng_trqInrCurrPre_mp CoEng_trqInrDesSlowBase_mp CoEng_trqInrDesSlowUnLim_mp CoEng_trqInrRawPre_mp CoEng_trqInrSetLim_mp CoEng_trqInrSetUnLtd_mp CoEng_trqLimOffs_mp CoEng_trqRmp_mp CoEng_trqSetASDdc_mp /end OUT_MEASUREMENT
/end FUNCTION
/begin FUNCTION coeng_trqcalc_var "" /end FUNCTION
/begin FUNCTION coeng_trqcalc_var_uic "" /end FUNCTION
/begin FUNCTION coeng_trqlim "Momentenbegrenzung als Motormoment"
 /begin DEF_CHARACTERISTIC CoEng_dnOvrFulMin_C CoEng_dnOvrFulMax_C CoEng_stdnOvrFulLow_C CoEng_stdnOvrFulHigh_C CoEng_dtrqEngPrtRgnMonUp_C CoEng_dtrqEngPrtRgnMonDwn_C CoEng_dtrqLimUp_C CoEng_dtrqLimDwn_C CoEng_dtrqLimUp1_C CoEng_dtrqLimDwn1_C CoEng_dtrqLimUp2_C CoEng_dtrqLimDwn2_C CoEng_dtrqLimUp3_C CoEng_dtrqLimDwn3_C CoEng_dtrqLimUp4_C CoEng_dtrqLimDwn4_C CoEng_tiOvrFulDT1_C CoEng_facOvrFulDKd_C CoEng_facAdjDfl_C CoEng_facAdjMax_C CoEng_facAdjMin_C CoEng_nOvrFulMin_C CoEng_nOvrFulMax_C CoEng_stnOvrFulLow_C CoEng_stnOvrFulHigh_C CoEng_tiPFltdVolPT1_C CoEng_tiPFltResFlowPT1_C CoEng_dtrqOvrFulUp_C CoEng_dtrqOvrFulDown_C CoEng_rOvrFulMin_C CoEng_rOvrFulMax_C CoEng_strOvrFulLow_C CoEng_strOvrFulHigh_C CoEng_tiRepOvrFul_C CoEng_trqLimErr1_CUR CoEng_trqLimErr2_CUR CoEng_trqLimErr3_CUR CoEng_trqLimErr4_CUR CoEng_trqLimErr_CUR CoEng_trqLimPDiff1_CUR CoEng_trqLimPDiffNOffs_CUR CoEng_trqLimPDiff_MAP CoEng_trqOvrFulMax_C CoEng_trqOvrFulMin_C CoEng_vOvrFulMin_C CoEng_vOvrFulMax_C CoEng_stvOvrFulLow_C CoEng_stvOvrFulHigh_C /end DEF_CHARACTERISTIC
 /begin IN_MEASUREMENT CoEng_pDiffPFltPrdc_mp Eng_nAvrg PFlt_pDiff /end IN_MEASUREMENT
/end FUNCTION
/begin FUNCTION coeng_trqlim_uic ""
 /begin OUT_MEASUREMENT CoEng_dnEngnAvrg_mp CoEng_dVolFlt_mp CoEng_pDiffPFltPrdc_mp CoEng_resFlowFlt_mp CoEng_stOvrFul_mp CoEng_trqInrLimLead0_mp CoEng_trqInrLimLead1_mp CoEng_trqInrLimLead2_mp CoEng_trqLimMin1_mp CoEng_trqLimMinEEPVal_mp CoEng_trqLimMin_mp CoEng_trqLimPDiffNOffs_mp CoEng_trqLimPFlt1_mp CoEng_trqLimSwt1_mp CoEng_trqLimSwt2_mp CoEng_trqLimSwt3_mp CoEng_trqLimSwt4_mp /end OUT_MEASUREMENT
/end FUNCTION
/begin FUNCTION coeng_trqslplim "Begrenzungsmoment für Rauchbegrenzung nach Turboschubbegrenzung"
 /begin DEF_CHARACTERISTIC CoEng_nSlpLimMin_C CoEng_dtrqSlpLimUpdef_C CoEng_dtrqSlpLimDwndef_C CoEng_dtrqSlpLimUp1_C CoEng_dtrqSlpLimDwn1_C CoEng_dtrqSlpLimUp2_C CoEng_dtrqSlpLimDwn2_C CoEng_dtrqSlpLimUp3_C CoEng_dtrqSlpLimDwn3_C CoEng_dtrqSlpLimUp4_C CoEng_dtrqSlpLimDwn4_C CoEng_dtrqSlpLimUp5_C CoEng_dtrqSlpLimDwn5_C CoEng_dtrqSlpLimUp6_C CoEng_dtrqSlpLimDwn6_C CoEng_dtrqSlpLimUpREV_C CoEng_dtrqSlpLimDwnREV_C /end DEF_CHARACTERISTIC
/end FUNCTION
/begin FUNCTION coeng_trqslplim_uic "" /begin DEF_CHARACTERISTIC CoEng_trqSlpLim_Vector CoEng_trqSlpLim_Channel /end DEF_CHARACTERISTIC /end FUNCTION
/begin FUNCTION coeng_tstco "Motortestkoordinator" /begin DEF_CHARACTERISTIC CoEng_tiTstMax_C /end DEF_CHARACTERISTIC /end FUNCTION
/begin FUNCTION coeng_tstco_msg "" /begin OUT_MEASUREMENT CoEng_stTst /end OUT_MEASUREMENT /end FUNCTION
/begin FUNCTION coeng_var "" /end FUNCTION
/begin FUNCTION coeng_var_ers "" /end FUNCTION
/begin FUNCTION coeng_var_ers_msg "" /end FUNCTION
/begin FUNCTION coeng_var_ers_uic "" /end FUNCTION
/begin FUNCTION combas_msg "" /begin OUT_MEASUREMENT ComBas_stDiaReq /end OUT_MEASUREMENT /end FUNCTION
/begin FUNCTION conf_proj "" /end FUNCTION
/begin FUNCTION convcd_co "Komponententreiber zur Mapping Funktion auf Struktur"
 /begin DEF_CHARACTERISTIC ConvCD_DebPlaDef_C ConvCD_DebPlaOk_C ConvCD_tiDebPos_C ConvCD_tiDebNeg_C ConvCD_DebSigDef_C ConvCD_DebSigOk_C ConvCD_nNoGearShftDet_C ConvCD_numDioIn_C ConvCD_numStepDef_C ConvCD_numStepOK_C ConvCD_stDflVal_C ConvCD_stGripCtlAST_C ConvCD_swtInv_C ConvCD_swtSigVal_C ConvCD_tiGearShft_C ConvCD_vNoGearShftDet_C /end DEF_CHARACTERISTIC
/end FUNCTION
/begin FUNCTION convcd_co_uic "" /begin OUT_MEASUREMENT ConvCD_ctClutchDfct_mp /end OUT_MEASUREMENT /end FUNCTION
/begin FUNCTION convcd_msg ""
 /begin OUT_MEASUREMENT ConvCD_stClth ConvCD_stClthRaw ConvCD_stClutchRecord ConvCD_stDebVal ConvCD_stIntDebVal ConvCD_stLastDebVal ConvCD_stLastGear ConvCD_stOldGear ConvCD_stRawVal ConvCD_swtSig /end OUT_MEASUREMENT
/end FUNCTION
/begin FUNCTION conv_grip "Function to calculate converter amplification factor" /end FUNCTION
/begin FUNCTION conv_grip_msg "" /begin OUT_MEASUREMENT Conv_rTrans /end OUT_MEASUREMENT /end FUNCTION
/begin FUNCTION coveh_acsmng "Koordination Nebenaggregate" /begin DEF_CHARACTERISTIC CoVeh_dnLI_C /end DEF_CHARACTERISTIC /end FUNCTION
/begin FUNCTION coveh_acsmng_msg ""
 /begin OUT_MEASUREMENT CoVeh_nAcsMax CoVeh_nAcsMin CoVeh_nLimEngSpd CoVeh_pwrAcsDes CoVeh_pwrAcsLead CoVeh_trqAcs CoVeh_trqAcsDes CoVeh_trqAcsLead CoVeh_trqAcsPerm CoVeh_trqAcsTemp /end OUT_MEASUREMENT
/end FUNCTION
/begin FUNCTION coveh_acsmng_uic "" /begin OUT_MEASUREMENT CoVeh_pwrAcsTempLim_mp CoVeh_trqAcsLimCrSDes_mp /end OUT_MEASUREMENT /end FUNCTION
/begin FUNCTION coveh_drvtrnord "Auftrag für Antrieb" /begin DEF_CHARACTERISTIC CoVeh_dtrqLimDwn_C CoVeh_dtrqLimUp_C CoVeh_trqLim_CUR /end DEF_CHARACTERISTIC /begin IN_MEASUREMENT Eng_nAvrg /end IN_MEASUREMENT /end FUNCTION
/begin FUNCTION coveh_drvtrnordlead_uic "" /begin DEF_CHARACTERISTIC CoVeh_trqPrpLead_Vector CoVeh_trqPrpLead_Channel /end DEF_CHARACTERISTIC /end FUNCTION
/begin FUNCTION coveh_drvtrnord_msg ""
 /begin OUT_MEASUREMENT CoVeh_nMax CoVeh_nMin CoVeh_stOrd CoVeh_trqPrpDes CoVeh_trqPrpLead CoVeh_trqPrpLimErr /end OUT_MEASUREMENT
/end FUNCTION
/begin FUNCTION coveh_drvtrnord_uic "" /begin DEF_CHARACTERISTIC CoVeh_trqPrpDes_Vector CoVeh_trqPrpDes_Channel /end DEF_CHARACTERISTIC /end FUNCTION
/begin FUNCTION covm_demcheck "Vortriebsstabilisierungsprüfung"
 /begin DEF_CHARACTERISTIC CoVM_amMAX_C CoVM_swtPlausChkVal_C CoVM_swtPlausChkType_C CoVM_swtSlipCtlVal_C CoVM_swtSlipCtlType_C /end DEF_CHARACTERISTIC
/end FUNCTION
/begin FUNCTION covm_demcheck_msg "" /begin OUT_MEASUREMENT CoVM_stDemCheck CoVM_swtSlipCtl /end OUT_MEASUREMENT /end FUNCTION
/begin FUNCTION covm_demcheck_uic "" /begin OUT_MEASUREMENT CoVM_amAct_mp CoVM_stDemUnplaus_mp CoVM_trqInt_mp /end OUT_MEASUREMENT /end FUNCTION
/begin FUNCTION covm_demcord "Anforderungskoordination"
 /begin DEF_CHARACTERISTIC CoVM_dtrqLeadCorUp_C CoVM_dtrqLeadCorDwn_C CoVM_swtIntvPrio_C CoVM_swttrqDVCH_C CoVM_tiTrqRedMax_C /end DEF_CHARACTERISTIC
/end FUNCTION
/begin FUNCTION covm_demcordlead_uic "" /begin OUT_MEASUREMENT CoVM_trqLeadIncMax_mp /end OUT_MEASUREMENT /end FUNCTION
/begin FUNCTION covm_demcord_msg ""
 /begin OUT_MEASUREMENT CoVM_stActDem CoVM_stOrd CoVM_stTrqLeadFrz CoVM_trqDVCH CoVM_trqGearbxMax CoVM_trqGearbxMin CoVM_trqPrpDes CoVM_trqPrpLead /end OUT_MEASUREMENT
/end FUNCTION
/begin FUNCTION covm_demcord_uic "" /begin OUT_MEASUREMENT CoVM_trqDesIncMax_mp /end OUT_MEASUREMENT /end FUNCTION
/begin FUNCTION covm_stabdem "Vortriebsstabilisierung"
 /begin DEF_CHARACTERISTIC CoVM_trqDecMax_C CoVM_dtrqLimUpDec_C CoVM_dtrqLimDwnDec_C CoVM_trqDSCMax_C CoVM_trqIncMin_C CoVM_dtrqLimUpInc_C CoVM_dtrqLimDwnInc_C /end DEF_CHARACTERISTIC
/end FUNCTION
/begin FUNCTION covm_stabdem_msg "" /begin OUT_MEASUREMENT CoVM_trqDec CoVM_trqInc /end OUT_MEASUREMENT /end FUNCTION
/begin FUNCTION covm_stabdem_uic "" /begin OUT_MEASUREMENT CoVM_trqDecSetVal_mp CoVM_trqIncSetVal_mp /end OUT_MEASUREMENT /end FUNCTION
/begin COMPU_METHOD AngleCaS "Winkel Nockenwelle" RAT_FUNC "%6.4" "deg CaS" COEFFS 0 85.3333333333334 0 0 0 1 /end COMPU_METHOD
/begin COMPU_METHOD AngleCrS "Winkel Kurbelwelle" RAT_FUNC "%6.4" "deg CrS" COEFFS 0 42.6666666666667 0 0 0 1 /end COMPU_METHOD
/begin COMPU_METHOD CubMtrPerHr "Volumsstrom in m^3/h" RAT_FUNC "%6.3" "m^3/h" COEFFS 0 10 0 0 0 1 /end COMPU_METHOD
/begin COMPU_METHOD Curr_10mA "Spannung in mA" RAT_FUNC "%6.1" "mA" COEFFS 0 0.1 0 0 0 1 /end COMPU_METHOD
/begin COMPU_METHOD Delta_Volt_PA "Spannungsgradient der Piezo-Aktoren" RAT_FUNC "%7.6" "V/usec" COEFFS 0 10000 0 0 0 1 /end COMPU_METHOD
/begin COMPU_METHOD dFlConsum "Ableitung des Kraftstoffverbrauchs" RAT_FUNC "%6.4" "l/h/s" COEFFS 0 100 0 0 0 1 /end COMPU_METHOD
/begin COMPU_METHOD Dia "Durchmesser des Rades" RAT_FUNC "%7.6" "m" COEFFS 0 10000 0 0 0 1 /end COMPU_METHOD
/begin COMPU_METHOD dn_dZ20 "Motorbeschleunigung pro Zeit (dn/dt) (im 20 ms Raster)" RAT_FUNC "%6.1" "rmp/s" COEFFS 0 0.1 0 0 0 1 /end COMPU_METHOD
/begin COMPU_METHOD dn_dZfine "Engine acceleration per time (dn/dt) fine resolution" RAT_FUNC "%6.2" "rpm/s" COEFFS 0 1 0 0 0 1 /end COMPU_METHOD
/begin COMPU_METHOD dp_dZ10 "boost pressure per time (dp/dt) every 10ms" RAT_FUNC "%6.1" "hPa/s" COEFFS 0 0.1 0 0 0 1 /end COMPU_METHOD
/begin COMPU_METHOD dTrqPrp_20ms "Anstieg Vortriebsmoment im 20 ms Raster" RAT_FUNC "%6.1" "Nm/s" COEFFS 0 0.1 0 0 0 1 /end COMPU_METHOD
/begin COMPU_METHOD DtyCyc "Tastverhaeltnis" RAT_FUNC "%6.4" "%" COEFFS 0 100 0 0 0 1 /end COMPU_METHOD
/begin COMPU_METHOD EngN "Motordrehzahl" RAT_FUNC "%6.2" "rpm" COEFFS 0 1 0 0 0 1 /end COMPU_METHOD
/begin COMPU_METHOD Fact "Faktor mit Auflösung 1 / 8192, hauptsächlich für einen Faktorenbereich 0...1 verwendet" RAT_FUNC "%6.5" "-" COEFFS 0 8192 0 0 0 1 /end COMPU_METHOD
/begin COMPU_METHOD Fact1 "Faktor mit Auflösung 0,01 (100 mal höherer Bereich als Fact)" RAT_FUNC "%6.4" "-" COEFFS 0 128 0 0 0 1 /end COMPU_METHOD
/begin COMPU_METHOD FlConsum_l_h "Kraftstoffverbrauch" RAT_FUNC "%6.4" "l/h" COEFFS 0 100 0 0 0 1 /end COMPU_METHOD
/begin COMPU_METHOD FlConsum_ul "Verbrauchsintegral (in Mikroliter)" RAT_FUNC "%6.2" "ul" COEFFS 0 1 0 0 0 1 /end COMPU_METHOD
/begin COMPU_METHOD FlConsum_ul_20ms "Verbrauchsintegral (in Mikroliter pro 20ms)" RAT_FUNC "%6.2" "ul/20ms" COEFFS 0 1 0 0 0 1 /end COMPU_METHOD
/begin COMPU_METHOD InjMass "Einspritzmenge" RAT_FUNC "%6.4" "mg/hub" COEFFS 0 100 0 0 0 1 /end COMPU_METHOD
/begin COMPU_METHOD InjMassCyc "Einspritzmenge pro Zyklus (mg/Zyklus)" RAT_FUNC "%6.4" "mg/cyc" COEFFS 0 100 0 0 0 1 /end COMPU_METHOD
/begin COMPU_METHOD InjQnt "Einspritzvolumen/Hub" RAT_FUNC "%6.3" "mm^3/hub" COEFFS 0 10 0 0 0 1 /end COMPU_METHOD
/begin COMPU_METHOD Kd "Differentialverstärkung Kd (gleiche Einheit/Umrechnungsformel an Ein- und Ausgang)" RAT_FUNC "%7.6" "1/1" COEFFS 0 65536 0 0 0 1 /end COMPU_METHOD
/begin COMPU_METHOD Kd_rpm2dndt "differential gain(engine speed to rate of change of engine speed)" RAT_FUNC "%8.7" "rmp/sec/rpm" COEFFS 0 131072 0 0 0 1 /end COMPU_METHOD
/begin COMPU_METHOD Length "Länge in Meter" RAT_FUNC "%6.2" "m" COEFFS 0 1 0 0 0 1 /end COMPU_METHOD
/begin COMPU_METHOD Moment_Inertia "Moment of Inertia" RAT_FUNC "%6.4" "kg * m^2" COEFFS 0 100 0 0 0 1 /end COMPU_METHOD
/begin COMPU_METHOD NumPinAdc "verbale Umrechnung für ADC Signale" TAB_VERB "%6.3" "-" COMPU_TAB_REF NumPinAdc /end COMPU_METHOD
/begin COMPU_VTAB NumPinAdc "verbale Umrechnung für ADC Signale" TAB_VERB 47 0 "Water_Temperature_Sensor_182" 1 "Intake_Air_Temperature_Sensor_157" 2 "Charge_Air_Temperature_Sensor_183" 3 "Exhaust_Temperature_Sensor_2_134" 4 "Exhaust_Temperature_Sensor_1_158" 5 "1st_APP_Sensor_252" 6 "2nd_APP_Sensor_239" 7 "ADC_REF" 8 "Boost_Pressure_Sensor_154" 9 "Atmospheric_Pressure_Sensor" 10 "Battery_Voltage_Sensor" 11 "Rail_Pressure_Sensor_156" 12 "Rail_Pressure_Peak_Value_156" 13 "Booster_Voltage_Sensor" 14 "Current_MeUn_Sensor" 15 "Current_PCV_Sensor" 16 "Voltage_Bank_1" 17 "Voltage_Bank_2" 18 "Pressure_Upstream_Particle_Filter_159" 19 "Engine_Oil_Pressure_110" 20 "Temperature_ECU_PCB" 21 "Voltage_Lambda_Ua" 22 "Voltage_Lambda_Ri" 23 "EMCCD_Current_Governor1_124" 24 "EMCCD_Current_Governor2_121" 25 "ADC_DUMMY_A_NOT_USED" 26 "ADC_DUMMY_NOT_USED" 27 "Charge_Actuator_Event_0" 28 "Voltage_Piezo_Actuator_Bank_2_Event_0" 29 "Voltage_Piezo_Actuator_Bank_1_Event_0" 30 "Charge_Actuator_Event_1" 31 "Voltage_Piezo_Actuator_Bank_2_Event_1" 32 "Voltage_Piezo_Actuator_Bank_1_Event_1" 33 "Charge_Actuator_Event_2" 34 "Voltage_Piezo_Actuator_Bank_2_Event_2" 35 "Voltage_Piezo_Actuator_Bank_1_Event_2" 36 "Charge_Actuator_Event_3" 37 "Voltage_Piezo_Actuator_Bank_2_Event_3" 38 "Voltage_Piezo_Actuator_Bank_1_Event_3" 39 "Charge_Actuator_Event_4" 40 "Voltage_Piezo_Actuator_Bank_2_Event_4" 41 "Voltage_Piezo_Actuator_Bank_1_Event_4" 42 "Charge_Actuator_Event_5" 43 "Voltage_Piezo_Actuator_Bank_2_Event_5" 44 "Voltage_Piezo_Actuator_Bank_1_Event_5" 45 "Booster_Voltage_Piezo" 46 "Piezo_Voltage" /end COMPU_VTAB
/begin COMPU_METHOD NumPinDia "Verbale Umrechnung für Diagnose Signale" TAB_VERB "%6.3" "-" COMPU_TAB_REF NumPinDia /end COMPU_METHOD
/begin COMPU_VTAB NumPinDia "Verbale Umrechnung für Diagnose Signale" TAB_VERB 36 0 "CJ945_Diagnostic_Signal" 1 "AC_Compressor_DiaSig" 2 "Fuel_Pump_DiaSig" 3 "Starter_234" 4 "Oil_Pressure_Lamp_Switch_245" 5 "Engine_Bay_Air_Flaps_123" 6 "Glow_Relay_Diagnostic_Signal1" 7 "reserved Glow_Relay_Diagnostic_Signal2" 8 "Ebox_Fan_Actuator_Diagnostic_Signal_219" 9 "Dummy_Actuator_Diagnostic_Signal" 10 "Twostage_TurboLoading_SW_DiaSig" 11 "DIO_OUT_DIAGNOSTIC_DUMMY_NOT_USED" 12 "1st_Pressure_Control_Valve_Diagnostic_Signal_172" 13 "2nd_Pressure_Control_Valve_Diagnostic_Signal_172" 14 "1st_Metering_Unit_Diagnostic_Signal_171" 15 "2nd_Metering_Unit_Diagnostic_Signal_171" 16 "Boost_Pressure_Actuator_Diagnostic_Signal_193" 17 "Boost_Pressure_Actuator_Diagnostic_Signal_193_2" 18 "EGR_Actuator_Diagnostic_Signal_194" 19 "EGR_Actuator_Diagnostic_Signal2" 20 "Variable_Swirl_Actuator_Diagnostic_Signal_195" 21 "Throttle_Valve_Diagnostic_Signal_196" 22 "Throttle_Valve2_Diagnostic_Signal_196" 23 "FAN_240" 24 "Add_On_Heater_244" 25 "EngM_Bearing_Actuator_Diagnostic_Signal_124" 26 "EngM_Bearing_Actuator_Diagnostic_Signal_121" 27 "Low pressure stage BPA_Diagnostic_Signal_117" 28 "Shuttr_Actuator_Diagnostic_Signal_231" 29 "PWM_DIAGNOSTIC_DUMMY_NOT_USED" 30 "1st_Sensor_Supply_Voltage_DiaSig" 31 "2nd_Sensor_Supply_Voltage_DiaSig" 32 "3rd_Sensor_Supply_Voltage_DiaSig" 33 "4th_Sensor_Supply_Voltage_DiaSig" 34 "5th_Sensor_Supply_Voltage_DiaSig" 35 "6th_Sensor_Supply_Voltage_DiaSig" /end COMPU_VTAB
/begin COMPU_METHOD NumPinDioIn "Verbale Umrechnung für Digitaleingang Signale" TAB_VERB "%6.3" "-" COMPU_TAB_REF NumPinDioIn /end COMPU_METHOD
/begin COMPU_VTAB NumPinDioIn "Verbale Umrechnung für Digitaleingang Signale" TAB_VERB 15 0 "Terminal_15_207" 1 "Main_Brake_Switch_236" 2 "Redundant_Brake_Switch_223" 3 "Clutch_Switch" 4 "Terminal_50_224" 5 "ECU_selection_Switch_251" 6 "FlFlt_Switch_211" 7 "Coolant-heater_212" 8 "Redundant_Terminal_15_209(118)" 9 "AC-compressor_overboost_213" 10 "Additive_tank_level_switch_235" 11 "Terminal_61_113" 12 "Lambda_Regeneration" 13 "Oil_Level_sensor_138" 14 "DIO_IN_DUMMY_NOT_USED" /end COMPU_VTAB
/begin COMPU_METHOD NumPinDioOut "Verbale Umrechnung für Digitalausgang Signale" TAB_VERB "%6.3" "-" COMPU_TAB_REF NumPinDioOut /end COMPU_METHOD
/begin COMPU_VTAB NumPinDioOut "Verbale Umrechnung für Digitalausgang Signale" TAB_VERB 12 0 "Main_Relay_220(144)" 1 "AC_Compressor" 2 "Fuel_Pump_232" 3 "Starter_234" 4 "OPS_Lamp_245" 5 "EBAF_123" 6 "Ebox_Fan_Actuator_219" 7 "Shuttr_Actuator_Digital_231" 8 "STATREG_PSOFF_Bit" 9 "Twostage_TurboLoading_120" 10 "TD_Signal_253" 11 "DIO_OUT_DUMMY_NOT_USED" /end COMPU_VTAB
/begin COMPU_METHOD NumPinPwmOut "Verbale Umrechnung für PWM-Ausgang Signale" TAB_VERB "%6.3" "-" COMPU_TAB_REF NumPinPwmOut /end COMPU_METHOD
/begin COMPU_VTAB NumPinPwmOut "Verbale Umrechnung für PWM-Ausgang Signale" TAB_VERB 14 0 "Boost_Pressure_Actuator_193" 1 "EGR_Actuator_194" 2 "PCV_Actuator_172" 3 "MeUn_Actuator_171" 4 "Variable_Swirl_Actuator_195" 5 "Fan_Actuator_240" 6 "Add_On_Heater_244" 7 "EngM_Bearing_Actuator_124" 8 "EngM_Bearing_Actuator_121" 9 "Throttle_Valve_196" 10 "LSU_Heater_PWMOutput" 11 "Low pressure stage BPA_117" 12 "Shuttr_Actuator_PWM_231" 13 "PWM_DUMMY_NOT_USED" /end COMPU_VTAB
/begin COMPU_METHOD OneToOne "eins zu eins (physikalischer Wert ist gleich dem internen Wert)" RAT_FUNC "%6.2" "-" COEFFS 0 1 0 0 0 1 /end COMPU_METHOD
/begin COMPU_METHOD Period "Periodendauer" RAT_FUNC "%6.3" "ms" COEFFS 0 10 0 0 0 1 /end COMPU_METHOD
/begin COMPU_METHOD Period_ms "Periodendauer in ms" RAT_FUNC "%6.3" "ms" COEFFS 0 10 0 0 0 1 /end COMPU_METHOD
/begin COMPU_METHOD Per_Dur "Periodendauer Segmentzeit" RAT_FUNC "%6.2" "usec" COEFFS 0 1 0 0 0 1 /end COMPU_METHOD
/begin COMPU_METHOD Prc "Prozent, gleiche interne Auflösung wie Fact, aber Darstellung in Prozent (0...100%)" RAT_FUNC "%6.4" "%" COEFFS 0 81.92 0 0 0 1 /end COMPU_METHOD
/begin COMPU_METHOD Pres_hPa "Druck (angezeigt in [hPa])" RAT_FUNC "%6.2" "hPa" COEFFS 0 1 0 0 0 1 /end COMPU_METHOD
/begin COMPU_METHOD Pres_Rail "Raildruck in hPa" RAT_FUNC "%4.3" "bar" COEFFS 0 10.000000 0 0 0 1 /end COMPU_METHOD
/begin COMPU_METHOD Pwr "Leistung" RAT_FUNC "%6.2" "W" COEFFS 0 0.10610329539459 0 0 0 1 /end COMPU_METHOD
/begin COMPU_METHOD RatAirMass "Luftmassenverhältnis" RAT_FUNC "%6.5" "-" COEFFS 0 1000 0 0 0 1 /end COMPU_METHOD
/begin COMPU_METHOD Res_hPaHrPerCM "Strömungswiderstand [hPa h/m3]" RAT_FUNC "%6.5" "hPa/(m^3/h)" COEFFS 0 1000 0 0 0 1 /end COMPU_METHOD
/begin COMPU_METHOD RhoFuel "Kraftstoffdichte" RAT_FUNC "%6.3" "kg/m^3" COEFFS 0 10 0 0 0 1 /end COMPU_METHOD
/begin COMPU_METHOD RmpInjMassCyc "DT1 of Injection mass" RAT_FUNC "%6.5" "(mg/cyc)/s" COEFFS 0 6553.6 0 0 0 1 /end COMPU_METHOD
/begin COMPU_METHOD RmpPres_hPa "Rampengradient für Druck angezeigt in [hPa/s]" RAT_FUNC "%6.4" "hPa/s" COEFFS 0 65.536 0 0 0 1 /end COMPU_METHOD
/begin COMPU_METHOD RmpTrq "Rampengradient für Motormoment" RAT_FUNC "%6.4" "Nm/s" COEFFS 0 655.36 0 0 0 1 /end COMPU_METHOD
/begin COMPU_METHOD RmpTrqPrp "Rampenanstieg für Vortriebsmoment [Nm/s]" RAT_FUNC "%6.4" "Nm/s" COEFFS 0 327.68 0 0 0 1 /end COMPU_METHOD
/begin COMPU_METHOD RmpVoltBatt "Rampengradient für Batteriespannung" RAT_FUNC "%6.3" "mV/s" COEFFS 0 3.3521664 0 0 0 1 /end COMPU_METHOD
/begin COMPU_METHOD SigName "Verbale Umrechnung für Signal Referenz Nummern" TAB_VERB "%6.3" "-" COMPU_TAB_REF SigName /end COMPU_METHOD
/begin COMPU_VTAB SigName "Verbale Umrechnung für Signal Referenz Nummern" TAB_VERB 117 0 "Sig_unused" 4 "CoEng_rTrq__Carb_r_DLen1" 5 "CTSCD_tClntLin__Carb_t_DLen1" 11 "BPSCD_pLin__Carb_p_DLen1" 12 "Eng_nAvrg__Carb_n_DLen2" 13 "VSSCD_vSensVal__Carb_v_DLen1" 15 "AFSCD_tAir_mp__Carb_t_DLen1" 16 "AFSCD_dmAirRawPerTime__Carb_mAirTim_DLen2" 28 "Signals_PID0x1C_C__OneToOne_DLen1" 33 "DSMDur_ctDfctDur1__Carb_l_DLen2" 128 "AFSCD_dmAirPerTime__mAirTim_DLen2" 129 "AFSCD_mAirPerCyl__mAirCyl_DLen2" 131 "AFSCD_rAir__dcyc_DLen2" 133 "AOHtCD_rOut_mp__dcyc_DLen2" 134 "APPCD_rFlt__r_DLen2" 137 "APPCD_uRawAPP1__u_DLen2" 138 "APPCD_uRawAPP2__u_DLen2" 139 "APSCD_pVal__p_DLen2" 140 "APSCD_uRaw__u_DLen2" 141 "AirCtl_mDesVal__mAirCyl_DLen2" 142 "AltCD_rAltLoad__r_DLen2" 143 "BPACD_rOut__dcyc_DLen2" 145 "BPSCD_pOutVal__p_DLen2" 146 "BPSCD_uRawVal__u_DLen2" 147 "BattCD_u__uBatt_DLen2" 148 "CBACD_stLogicOut_mp__OneToOne_DLen1" 149 "CTSCD_tClnt__t_DLen2" 150 "CTSCD_uRaw__u_DLen2" 151 "CoEng_trq__trq_DLen2" 152 "EBAFCD_stSigOut__OneToOne_DLen1" 153 "EGRCD_rOut__dcyc_DLen2" 155 "EGT_st__ShftRght0Byte_DLen2" 156 "EngM_stOut__OneToOne_DLen1" 157 "EngM_stSync__OneToOne_DLen1" 158 "Eng_nAvrg__n_DLen2" 159 "FMTC_trqInr__trq_DLen2" 160 "FTSCD_tFuel__t_DLen2" 161 "FTSCD_uRaw__u_DLen2" 162 "FanCD_dcycRaw_mp__dcyc_DLen2" 163 "FlFCD_stFlFltRawVal__OneToOne_DLen1" 164 "FrmMng_nPSP__nPSPSpd_DLen2" 165 "FrmMng_rPSPSetPoint__r_DLen2" 166 "GlwCtl_rPwrOut__OneToOne_DLen1" 167 "GlwCtl_stLampOut__OneToOne_DLen1" 168 "HWEMon_numRecovery__ShftRght0Byte_DLen2" 169 "HWEMon_numRecovery__ShftRght1Byte_DLen2" 170 "HWEMon_recLocLow_mp__ShftRght0Byte_DLen2" 171 "HWEMon_recLocLow_mp__ShftRght1Byte_DLen2" 172 "HWEMon_recLocHigh_mp__ShftRght0Byte_DLen2" 173 "IATSCD_tAir__t_DLen2" 174 "IATSCD_tAirCats__t_DLen2" 176 "IATSCD_uRawCats__u_DLen2" 178 "Tn_abstell__DezUwQ1_DLen2" 179 "U_gen__UUwQ0p1_DLen2" 181 "InjCtl_qCurr__qInjMassCyc_DLen2" 182 "InjCtl_qSetUnBal__qInjMassCyc_DLen2" 183 "LIGov_nSetpoint__n_DLen2" 184 "LIGov_trq__trq_DLen2" 185 "LPACD_rOut__dcyc_DLen2" 186 "LSUCD_rO2Raw[0]__O2_DLen2" 187 "LSUCD_uO2Raw[0]__u_DLen2" 188 "LSU_rLmbd[0]__Lambda_DLen2" 189 "LSU_rO2Adpt[0]__O2_DLen2" 190 "MeUnCD_dcycOut_mp__dcyc_DLen2" 191 "OPSCD_stSigOut__OneToOne_DLen1" 192 "OPSCD_stpOEL__OneToOne_DLen1" 193 "OTSCD_tEngOil__t_DLen2" 194 "OxiCCD_tPre__tExhaustgas_DLen2" 196 "OxiCCD_uRawTempPre__u_DLen2" 198 "PCR_pDesVal__p_DLen2" 199 "PCVCD_dcycOut_mp__dcyc_DLen2" 200 "PFltCD_pPre__p_DLen2" 202 "PFltCD_tPre__tExhaustgas_DLen2" 204 "PFltCD_uRawPresPre_mp__u_DLen2" 206 "PFltCD_uRawTempPre__u_DLen2" 208 "PFlt_dvol__volph_DLen2" 209 "PFlt_lSnceRgnu16_mp__lenrgnu16PFlt_DLen2" 211 "PFlt_mAshOil__mSoot_DLen2" 212 "PFlt_mSot__mSoot_DLen2" 213 "PFlt_mSotSim__mSoot_DLen2" 214 "PFlt_numEngPOp__OneToOne_DLen1" 215 "PFlt_numRgn_mp__OneToOne_DLen1" 216 "PFlt_pDiff__p_DLen2" 217 "PFlt_qFl_mp__FlConPFlt_DLen2" 219 "PFlt_stEngPOp__OneToOne_DLen1" 220 "PFlt_stIntr_mp__OneToOne_DLen1" 221 "PFlt_stLck_mp__OneToOne_DLen1" 222 "PSPCD_dvolOut__FlCon_DLen2" 223 "RailCD_pPeak__pRail_DLen2" 224 "RailCD_uPeakRaw__u_DLen2" 225 "Rail_pSetPoint__pRail_DLen2" 226 "TVACD_rOut__dcyc_DLen2" 228 "VSACD_rOut__dcyc_DLen2" 229 "VSSCD_v__v_DLen2" 230 "VehDa_tiEngOn__timEng_DLen2" 231 "PFlt_pPreCorr_mp__p_DLen2" 232 "PFlt_stPresPlaus_mp__OneToOne_DLen1" 236 "OvRMon_tiTDCAvrg__InjTim_DLen2" 237 "OvRMon_tiOvRMonActive_mp__tims_DLen2" 238 "CoEng_trqInrSet__trq_DLen2" 239 "InjCtl_qSet__qInjMassCyc_DLen2" 240 "Absch_korr__FSwQ0p00153_DLen2" 241 "D_soc__FSwB100_DLen2" 242 "I_batt__IUwQ0p08O200_DLen2" 243 "Oz_oelkm__KmUwQ10_DLen2" 244 "Oz_oelnivkurz__TdUbQ0p5_DLen1" 245 "Oz_oelnivnorm__TdUbQ0p5_DLen1" 246 "Oz_oelnivori__TdUbQ0p5_DLen1" 247 "Pm_klemmstat__DezUbQ1_DLen1" 248 "Stat_sv_reg1__DezUbQ1_DLen1" 249 "Stat_sv_reg2__DezUbQ1_DLen1" 250 "T2histshort__TdUbQ14p9333_DLen1" 251 "T3histshort__TdUbQ14p9333_DLen1" 252 "T4histshort__TdUbQ14p9333_DLen1" 253 "Toel__TSwQ0p1_DLen2" 254 "T_batt__TSwQ0p1_DLen2" 255 "U_batt__UUwQ0p25em3_DLen2" /end COMPU_VTAB
/begin COMPU_METHOD TempDiff_Cels "difference/offset temperature displayed in degree celcius" RAT_FUNC "%6.3" "deg C" COEFFS 0 10 0 0 0 1 /end COMPU_METHOD
/begin COMPU_METHOD Temp_Cels "Temperatur dargestellt in °C (gleiche interne Darstellung wie Temp_Kelv)" RAT_FUNC "%6.1" "deg C" COEFFS 0 10 2731.4 0 0 1 /end COMPU_METHOD
/begin COMPU_METHOD TimeDeb "Entprellzeit in Millisekunden für Libraryfunktion Debounce" RAT_FUNC "%6.1" "ms" COEFFS 0 0.1 0 0 0 1 /end COMPU_METHOD
/begin COMPU_METHOD TimeDelay_s "Zeitkonstante T1 (in s) für PT1, DT1, etc." RAT_FUNC "%9.3" "s" COEFFS 0 0 1 0 0.00023283064365387 0 /end COMPU_METHOD
/begin COMPU_METHOD TimeEngOn "Motorbetriebszeit in Sekunden" RAT_FUNC "%6.2" "s" COEFFS 0 1 0 0 0 1 /end COMPU_METHOD
/begin COMPU_METHOD TimeRed "Zeit in Sekunden mit reduzierter Auflösung für Ein/Ausgänge von KL/KF (sint16)" RAT_FUNC "%6.3" "s" COEFFS 0 6.25 0 0 0 1 /end COMPU_METHOD
/begin COMPU_METHOD Time_DynTst "Zeitumrechung für dynamischen test mit geringerer Auflösung, damit es für KL Ausgang passt" RAT_FUNC "%6.2" "s" COEFFS 0 0.390625 0 0 0 1 /end COMPU_METHOD
/begin COMPU_METHOD Time_ms "Zeit in ms für Fehlerentprellung (DSM) und SW-Timer" RAT_FUNC "%6.1" "ms" COEFFS 0 0.1 0 0 0 1 /end COMPU_METHOD
/begin COMPU_METHOD Time_s "Zeit in s für Fehlerentprellung (DSM) und SW-Timer" RAT_FUNC "%6.4" "s" COEFFS 0 100 0 0 0 1 /end COMPU_METHOD
/begin COMPU_METHOD TransR "Übersetzungsverhältnis (Getriebe etc.)" RAT_FUNC "%6.4" "-" COEFFS 0 100 0 0 0 1 /end COMPU_METHOD
/begin COMPU_METHOD Trq "Motormoment" RAT_FUNC "%6.3" "Nm" COEFFS 0 10 0 0 0 1 /end COMPU_METHOD
/begin COMPU_METHOD TrqPrp "Vortriebsmoment" RAT_FUNC "%6.3" "Nm" COEFFS 0 5 0 0 0 1 /end COMPU_METHOD
/begin COMPU_METHOD TrqPrpDT "zeitlich aufintegriertes Vortriebsmoment" RAT_FUNC "%6.2" "Nm*s" COEFFS 0 0.2 0 0 0 1 /end COMPU_METHOD
/begin COMPU_METHOD Vel "Fahrzeuggeschwindigkeit, gleiche interne Auflösung wie Vel_SI" RAT_FUNC "%6.4" "km/h" COEFFS 0 100 0 0 0 1 /end COMPU_METHOD
/begin COMPU_METHOD Volt "Spannung in V (von ADC)" RAT_FUNC "%6.2" "mV" COEFFS 0 0.2046 0 0 0 1 /end COMPU_METHOD
/begin COMPU_METHOD Volt_Batt "Batteriespannung" RAT_FUNC "%6.1" "mV" COEFFS 0 0.05115 0 0 0 1 /end COMPU_METHOD
/begin COMPU_METHOD default "" RAT_FUNC "%6.2" "-" COEFFS 0 1 0 0 0 1 /end COMPU_METHOD
/begin RECORD_LAYOUT Kf_Xs16_Ys16_Ws16 NO_AXIS_PTS_X 1 SWORD NO_AXIS_PTS_Y 2 SWORD AXIS_PTS_X 3 SWORD INDEX_INCR DIRECT AXIS_PTS_Y 4 SWORD INDEX_INCR DIRECT FNC_VALUES 5 SWORD COLUMN_DIR DIRECT /end RECORD_LAYOUT
/begin RECORD_LAYOUT Kl_Xs16_Ws16 NO_AXIS_PTS_X 1 SWORD AXIS_PTS_X 2 SWORD INDEX_INCR DIRECT FNC_VALUES 3 SWORD COLUMN_DIR DIRECT /end RECORD_LAYOUT
/begin RECORD_LAYOUT Kwb_Ws16 FNC_VALUES 1 SWORD COLUMN_DIR DIRECT /end RECORD_LAYOUT
/begin RECORD_LAYOUT Kwb_Wu16 FNC_VALUES 1 UWORD COLUMN_DIR DIRECT /end RECORD_LAYOUT
/begin RECORD_LAYOUT Kwb_Wu32 FNC_VALUES 1 ULONG COLUMN_DIR DIRECT /end RECORD_LAYOUT
/begin RECORD_LAYOUT Kwb_Wu8 FNC_VALUES 1 UBYTE COLUMN_DIR DIRECT /end RECORD_LAYOUT
/begin RECORD_LAYOUT Kw_Ws16 FNC_VALUES 1 SWORD COLUMN_DIR DIRECT /end RECORD_LAYOUT
/begin RECORD_LAYOUT Kw_Ws32 FNC_VALUES 1 SLONG COLUMN_DIR DIRECT /end RECORD_LAYOUT
/begin RECORD_LAYOUT Kw_Wu16 FNC_VALUES 1 UWORD COLUMN_DIR DIRECT /end RECORD_LAYOUT
/begin RECORD_LAYOUT Kw_Wu32 FNC_VALUES 1 ULONG COLUMN_DIR DIRECT /end RECORD_LAYOUT
/begin RECORD_LAYOUT Kw_Wu8 FNC_VALUES 1 UBYTE COLUMN_DIR DIRECT /end RECORD_LAYOUT
/end MODULE
/end PROJECT
