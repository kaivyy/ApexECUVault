ASAP2_VERSION 1 41
/begin PROJECT MSD70 "Spray Guided DI-System with Piezo Injectors for 6-Cylinder"
/begin HEADER "_default_HeaderComment" PROJECT_NO _0B /end HEADER
/begin MODULE _default_ModuleName "_default_ModuleLongIdentifier"
/begin MOD_COMMON "_default_ModCommonComment" DEPOSIT ABSOLUTE BYTE_ORDER MSB_LAST ALIGNMENT_BYTE 1 ALIGNMENT_WORD 2 ALIGNMENT_LONG 2 ALIGNMENT_FLOAT32_IEEE 2 ALIGNMENT_FLOAT64_IEEE 4 /end MOD_COMMON
/begin CHARACTERISTIC lc_cru_req_swi "Configuration switch between MSW and steering lever" VALUE 0xa1029d13 _REC_VAL_20_u1 1. _CNV_A_R_LINEAR_____0_CM 0. 1. DISPLAY_IDENTIFIER LC_CRU_REQ_SWI FORMAT "%1.0" /end CHARACTERISTIC
/begin CHARACTERISTIC c_t_crus_on "Minimum recognition time on actuating the OFF button" VALUE 0xa1029824 _REC_VAL_20_u1 2550. _CNV_A_R_LINEAR_____18_CM 0. 2550. DISPLAY_IDENTIFIER C_T_CRUS_ON FORMAT "%4.0" /end CHARACTERISTIC
/begin MEASUREMENT state_msw_can "Status of MSW to the CAN Message" UBYTE _CNV_S_8_RANGE_STAT_19_CM 1 100. 0. 7. DISPLAY_IDENTIFIER STATE_MSW_CAN ECU_ADDRESS 0xd0003f4c /end MEASUREMENT
/begin MEASUREMENT lv_cru_main_swi "indicate CRU readiness" UBYTE _CNV_S_2_RANGE__0___1_CM 1 100. 0. 1. DISPLAY_IDENTIFIER LV_CRU_MAIN_SWI ECU_ADDRESS 0xd0003f4e BIT_MASK 0x1 /end MEASUREMENT
/begin MEASUREMENT req_msw "Evaluated Status of MSW request module" UBYTE _CNV_S_10_RANGE_REQ__20_CM 1 100. 0. 9. DISPLAY_IDENTIFIER REQ_MSW ECU_ADDRESS 0xd0003f4d /end MEASUREMENT
/begin CHARACTERISTIC c_t_ready_cru "Delay time after control unit initialization" VALUE 0xa1029950 _REC_VAL_20_u1 1550. _CNV_A_R_LINEAR_____18_CM 1000. 2550. DISPLAY_IDENTIFIER C_T_READY_CRU FORMAT "%5.0" /end CHARACTERISTIC
/begin CHARACTERISTIC c_t_crus "Minimum time between switch on ready and switch off ready" VALUE 0xa1029822 _REC_VAL_20_u1 2550. _CNV_A_R_LINEAR_____18_CM 0. 2550. DISPLAY_IDENTIFIER C_T_CRUS FORMAT "%4.0" /end CHARACTERISTIC
/begin CHARACTERISTIC c_t_crus_off "Minimum recognition time on actuating the OFF button to switch off the display for BN2000" VALUE 0xa1029823 _REC_VAL_20_u1 5100. _CNV_A_R_LINEAR_____22_CM 0. 5100. DISPLAY_IDENTIFIER C_T_CRUS_OFF FORMAT "%5.0" /end CHARACTERISTIC
/begin CHARACTERISTIC c_t_min_msw "time delay of REQ_MSW" VALUE 0xa10298fa _REC_VAL_20_u1 2.54 _CNV_A_R_LINEAR_____3_CM 1.e-002 2.55 DISPLAY_IDENTIFIER C_T_MIN_MSW FORMAT "%4.2" /end CHARACTERISTIC
/begin CHARACTERISTIC c_t_min_tip_msw "Time delay of REQ_MSW TIP detection" VALUE 0xa102990c _REC_VAL_20_u1 2.55 _CNV_A_R_LINEAR_____3_CM 0. 2.55 DISPLAY_IDENTIFIER C_T_MIN_TIP_MSW FORMAT "%4.2" /end CHARACTERISTIC
/begin CHARACTERISTIC lc_crus_off_swi "Configuration switch to switch off the cruise control via MSW" VALUE 0xa1029d14 _REC_VAL_20_u1 1. _CNV_A_R_LINEAR_____0_CM 0. 1. DISPLAY_IDENTIFIER LC_CRUS_OFF_SWI FORMAT "%1.0" /end CHARACTERISTIC
/begin MEASUREMENT lv_var_asr "ASC1 device recognized" UBYTE _CNV_S_2_RANGE__0___1_CM 1 100. 0. 1. DISPLAY_IDENTIFIER LV_VAR_ASR ECU_ADDRESS 0xd0003702 BIT_MASK 0x1 /end MEASUREMENT
/begin MEASUREMENT lv_var_asr_3 "ASC3 device recognized" UBYTE _CNV_S_2_RANGE__0___1_CM 1 100. 0. 1. DISPLAY_IDENTIFIER LV_VAR_ASR_3 ECU_ADDRESS 0xd0003703 BIT_MASK 0x1 /end MEASUREMENT
/begin MEASUREMENT lv_var_asr_4 "ASC4 device recognized" UBYTE _CNV_S_2_RANGE__0___1_CM 1 100. 0. 1. DISPLAY_IDENTIFIER LV_VAR_ASR_4 ECU_ADDRESS 0xd0003704 BIT_MASK 0x1 /end MEASUREMENT
/begin MEASUREMENT lv_at "LV automatic transmission recognized" UBYTE _CNV_S_2_RANGE__0___1_CM 1 100. 0. 1. DISPLAY_IDENTIFIER LV_AT ECU_ADDRESS 0xd0003716 BIT_MASK 0x1 /end MEASUREMENT
/begin MEASUREMENT lv_var_icl "LV CAN-Kombi recognized" UBYTE _CNV_S_2_RANGE__0___1_CM 1 100. 0. 1. DISPLAY_IDENTIFIER LV_VAR_ICL ECU_ADDRESS 0xd0003725 BIT_MASK 0x1 /end MEASUREMENT
/begin CHARACTERISTIC c_t_cru_esp_off "minimum time before cut-off CRU in case of ESP intervention" VALUE 0xa1029820 _REC_VAL_20_u1 25.5 _CNV_A_R_LINEAR_____4_CM 0. 25.5 DISPLAY_IDENTIFIER C_T_CRU_ESP_OFF FORMAT "%4.1" /end CHARACTERISTIC
/begin CHARACTERISTIC c_t_cru_asr_off "minimum time before cut-off CRU in case of ASR intervention" VALUE 0xa102981e _REC_VAL_20_u1 25.5 _CNV_A_R_LINEAR_____4_CM 0. 25.5 DISPLAY_IDENTIFIER C_T_CRU_ASR_OFF FORMAT "%4.1" /end CHARACTERISTIC
/begin CHARACTERISTIC c_t_cru_esp_brake_off "minimum time before cut-off CRU in case of ESP intervention only with brake" VALUE 0xa102981f _REC_VAL_20_u1 25.5 _CNV_A_R_LINEAR_____4_CM 0. 25.5 DISPLAY_IDENTIFIER C_T_CRU_ESP_BRAKE_OFF FORMAT "%4.1" /end CHARACTERISTIC
/begin CHARACTERISTIC c_t_err_vs_can "minimum threshold time for error of vehicle speed from CAN" VALUE 0xa102988e _REC_VAL_20_u1 25.5 _CNV_A_R_LINEAR_____4_CM 0. 25.5 DISPLAY_IDENTIFIER C_T_ERR_VS_CAN FORMAT "%4.1" /end CHARACTERISTIC
/begin MEASUREMENT ac_cru "Vehicle acceleration in CRU" SWORD _CNV_A_R_LINEAR_____86_CM 1 100. -15.719999999972 15.71952 DISPLAY_IDENTIFIER AC_CRU ECU_ADDRESS 0xd00053aa FORMAT "%7.4" /end MEASUREMENT
/begin CHARACTERISTIC c_fac_vs_fil "Filter factor" VALUE 0xa10293cd _REC_VAL_20_u1 255. _CNV_A_R_LINEAR_____0_CM 0. 255. DISPLAY_IDENTIFIER C_FAC_VS_FIL FORMAT "%3.0" /end CHARACTERISTIC
/begin CHARACTERISTIC c_vs_max_diag "Max. allowed deviation between VS_FIL and VS" VALUE 0xa1029ca5 _REC_VAL_20_u1 255. _CNV_A_R_LINEAR_____6_CM 0. 255. DISPLAY_IDENTIFIER C_VS_MAX_DIAG FORMAT "%3.0" /end CHARACTERISTIC
/begin MEASUREMENT lv_vs_diag_not_plaus "VS_FIL not plausible" UBYTE _CNV_S_2_RANGE__0___1_CM 1 100. 0. 1. DISPLAY_IDENTIFIER LV_VS_DIAG_NOT_PLAUS ECU_ADDRESS 0xd0003f28 BIT_MASK 0x1 /end MEASUREMENT
/begin MEASUREMENT lv_cru_off_by_asr_esp_ctl "Soft off condition depending on ASC interventions" UBYTE _CNV_S_2_RANGE__0___1_CM 1 100. 0. 1. DISPLAY_IDENTIFIER LV_CRU_OFF_BY_ASR_ESP_CTL ECU_ADDRESS 0xd0003f29 BIT_MASK 0x1 /end MEASUREMENT
/begin CHARACTERISTIC c_fac_tq_req_driv_mmv "Filtering of driver demand" VALUE 0xa10293be _REC_VAL_20_u2 0.9999847412109381 _CNV_A_R_LINEAR_____68_CM 0. 0.9999847412109381 DISPLAY_IDENTIFIER C_FAC_TQ_REQ_DRIV_MMV FORMAT "%7.5" /end CHARACTERISTIC
/begin MEASUREMENT fac_tq_req_driv_mmv "MMV of driver torque demand" UWORD _CNV_A_R_LINEAR_____8_CM 1 100. 0. 1.99996948242188 DISPLAY_IDENTIFIER FAC_TQ_REQ_DRIV_MMV ECU_ADDRESS 0xd00053b0 FORMAT "%7.5" /end MEASUREMENT
/begin MEASUREMENT n_vs_cru "Ratio between engine speed and vehicle speed" UWORD _CNV_A_R_LINEAR_____87_CM 1 100. 0. 16320. DISPLAY_IDENTIFIER N_VS_CRU ECU_ADDRESS 0xd00053ac FORMAT "%5.0" /end MEASUREMENT
/begin CHARACTERISTIC c_fac_ac_cru_mmv "Filtering AC_CRU" VALUE 0xa1029372 _REC_VAL_20_u2 0.9999847412109381 _CNV_A_R_LINEAR_____68_CM 0. 0.9999847412109381 DISPLAY_IDENTIFIER C_FAC_AC_CRU_MMV FORMAT "%7.5" /end CHARACTERISTIC
/begin CHARACTERISTIC lc_vs_cru_fil "Filter factor activation" VALUE 0xa1029e19 _REC_VAL_20_u1 1. _CNV_A_R_LINEAR_____0_CM 0. 1. DISPLAY_IDENTIFIER LC_VS_CRU_FIL FORMAT "%1.0" /end CHARACTERISTIC
/begin CHARACTERISTIC c_crlc_vs_cru_mmv "Filter factor" VALUE 0xa1029248 _REC_VAL_20_u2 0.9999847412109381 _CNV_A_R_LINEAR_____88_CM 0. 0.9999847412109381 DISPLAY_IDENTIFIER C_CRLC_VS_CRU_MMV FORMAT "%7.5" /end CHARACTERISTIC
/begin MEASUREMENT vs_fil "Filtered vehicle speed" UWORD _CNV_A_R_LINEAR_____66_CM 1 100. 0. 511.99218 DISPLAY_IDENTIFIER VS_FIL ECU_ADDRESS 0xd00053a4 FORMAT "%7.3" /end MEASUREMENT
/begin MEASUREMENT t_err_vs_can "Time to freeze VS_FIL before VS_FIL = 0" UWORD _CNV_A_R_LINEAR_____89_CM 1 100. 0. 65535. DISPLAY_IDENTIFIER T_ERR_VS_CAN ECU_ADDRESS 0xd00053a6 FORMAT "%5.0" /end MEASUREMENT
/begin MEASUREMENT vs_cru "Filtered vehicle speed" UWORD _CNV_A_R_LINEAR_____66_CM 1 100. 0. 511.99218 DISPLAY_IDENTIFIER VS_CRU ECU_ADDRESS 0xd00053a8 FORMAT "%7.3" /end MEASUREMENT
/begin MEASUREMENT vs_dif_icl_tcs "Difference of vehicle speed INSTR and TCS" SWORD _CNV_A_R_LINEAR_____90_CM 1 100. -256. 255.9921875 DISPLAY_IDENTIFIER VS_DIF_ICL_TCS ECU_ADDRESS 0xc000025c FORMAT "%7.3" /end MEASUREMENT
/begin CHARACTERISTIC c_t_vs_diag_not_plaus "debounce time for setting VS_CRU not plausible" VALUE 0xa10299aa _REC_VAL_20_u1 25.5 _CNV_A_R_LINEAR_____4_CM 0. 25.5 DISPLAY_IDENTIFIER C_T_VS_DIAG_NOT_PLAUS FORMAT "%4.1" /end CHARACTERISTIC
/begin MEASUREMENT req_cru "Request of cruise control functionality" UBYTE _CNV_S_8_RANGE_REQ__91_CM 1 100. 0. 7. DISPLAY_IDENTIFIER REQ_CRU ECU_ADDRESS 0xd0003f2c /end MEASUREMENT
/begin MEASUREMENT lv_cru_off_irr "Irreversible cut off conditions for cruise control" UBYTE _CNV_S_2_RANGE__0___1_CM 1 100. 0. 1. DISPLAY_IDENTIFIER LV_CRU_OFF_IRR ECU_ADDRESS 0xd0003f2f BIT_MASK 0x1 /end MEASUREMENT
/begin CHARACTERISTIC c_vs_min_plaus_cru "Vehicle speed condition for VS_FIL" VALUE 0xa1029cbe _REC_VAL_20_u2 511.99218 _CNV_A_R_LINEAR_____66_CM 0. 511.99218 DISPLAY_IDENTIFIER C_VS_MIN_PLAUS_CRU FORMAT "%7.3" /end CHARACTERISTIC
/begin MEASUREMENT t_dly_cru "Time counter overtaking" UWORD _CNV_A_R_LINEAR_____3_CM 1 100. 0. 655.35 DISPLAY_IDENTIFIER T_DLY_CRU ECU_ADDRESS 0xc0000264 FORMAT "%5.2" /end MEASUREMENT
/begin MEASUREMENT lv_cru_over_act "Overtaking function active" UBYTE _CNV_S_2_RANGE__0___1_CM 1 100. 0. 1. DISPLAY_IDENTIFIER LV_CRU_OVER_ACT ECU_ADDRESS 0xd0003f30 BIT_MASK 0x1 /end MEASUREMENT
/begin CHARACTERISTIC c_t_dly_vs_sp_cru_max "Max .time for VS more than  VS max at CRU" VALUE 0xa102987e _REC_VAL_20_u1 255. _CNV_A_R_LINEAR_____35_CM 0. 255. DISPLAY_IDENTIFIER C_T_DLY_VS_SP_CRU_MAX FORMAT "%3.0" /end CHARACTERISTIC
/begin CHARACTERISTIC c_t_dly_max_cru "Delay threshold for start of the restart function" VALUE 0xa1029872 _REC_VAL_20_u2 655.35 _CNV_A_R_LINEAR_____3_CM 0. 655.35 DISPLAY_IDENTIFIER C_T_DLY_MAX_CRU FORMAT "%6.2" /end CHARACTERISTIC
/begin CHARACTERISTIC c_n_vs_max_cru "Threshold value for hard cut-off" VALUE 0xa1029678 _REC_VAL_20_u1 99.609375 _CNV_A_R_LINEAR_____5_CM 0. 99.609375 DISPLAY_IDENTIFIER C_N_VS_MAX_CRU FORMAT "%4.1" /end CHARACTERISTIC
/begin CHARACTERISTIC c_vs_sp_dif_min_cru "Min. deviation between target and actual speed" VALUE 0xa1029cd6 _REC_VAL_20_s2 511.9921875 _CNV_A_R_LINEAR_____90_CM -256. 255.9921875 DISPLAY_IDENTIFIER C_VS_SP_DIF_MIN_CRU FORMAT "%7.3" /end CHARACTERISTIC
/begin CHARACTERISTIC c_vs_sp_dif_max_cru "Max. deviation between target and actual speed" VALUE 0xa1029cd4 _REC_VAL_20_s2 511.9921875 _CNV_A_R_LINEAR_____90_CM -256. 255.9921875 DISPLAY_IDENTIFIER C_VS_SP_DIF_MAX_CRU FORMAT "%7.3" /end CHARACTERISTIC
/begin MEASUREMENT lv_cru_act "Intervention of cruise control" UBYTE _CNV_S_2_RANGE__0___1_CM 1 100. 0. 1. DISPLAY_IDENTIFIER LV_CRU_ACT ECU_ADDRESS 0xd0003f31 BIT_MASK 0x1 /end MEASUREMENT
/begin CHARACTERISTIC c_vs_dif_dly_cru_neg "Max. difference from VS_SP_DRIV_CRU and C_VS_DIF_DLY_CRU" VALUE 0xa1029c6c _REC_VAL_20_u2 255.9921875 _CNV_A_R_LINEAR_____90_CM 0. 255.9921875 DISPLAY_IDENTIFIER C_VS_DIF_DLY_CRU_NEG FORMAT "%7.3" /end CHARACTERISTIC
/begin CHARACTERISTIC c_fac_tq_req_hys_cru "FAC_TQ_REQ hysteresis for start of the restart function" VALUE 0xa10293c4 _REC_VAL_20_u2 1.99996948242188 _CNV_A_R_LINEAR_____8_CM 0. 1.99996948242188 DISPLAY_IDENTIFIER C_FAC_TQ_REQ_HYS_CRU FORMAT "%7.5" /end CHARACTERISTIC
/begin CHARACTERISTIC c_ac_max_cru "Max. acceleration" VALUE 0xa1029166 _REC_VAL_20_u2 15.71952 _CNV_A_R_LINEAR_____92_CM 0. 15.71952 DISPLAY_IDENTIFIER C_AC_MAX_CRU FORMAT "%7.4" /end CHARACTERISTIC
/begin MEASUREMENT state_cru_can "Status of cruise control to the CAN- Message" UBYTE _CNV_S_8_RANGE_STAT_93_CM 1 100. 0. 7. DISPLAY_IDENTIFIER STATE_CRU_CAN ECU_ADDRESS 0xd0003f2d /end MEASUREMENT
/begin MEASUREMENT state_cru_off_rev "Status switch off conditions reversible" UWORD _CNV_A_R_LINEAR_____50_CM 1 100. 0. 65535. DISPLAY_IDENTIFIER STATE_CRU_OFF_REV ECU_ADDRESS 0xd00053b6 FORMAT "%5.0" /end MEASUREMENT
/begin MEASUREMENT state_cru_off_irr "Status switch off conditions irreversible" UWORD _CNV_A_R_LINEAR_____50_CM 1 100. 0. 65535. DISPLAY_IDENTIFIER STATE_CRU_OFF_IRR ECU_ADDRESS 0xd00053b4 FORMAT "%5.0" /end MEASUREMENT
/begin CHARACTERISTIC c_vs_dif_dly_cru_pos "Maximum difference from VS_SP_DRIV_CRU and C_VS_DIF_DLY_CRU" VALUE 0xa1029c6e _REC_VAL_20_s2 255.9922 _CNV_A_R_LINEAR_____94_CM -255.9922 0. DISPLAY_IDENTIFIER C_VS_DIF_DLY_CRU_POS FORMAT "%7.3" /end CHARACTERISTIC
/begin CHARACTERISTIC c_vs_dif_min_cru_over "Vs_dif_cru min value vor finished overtaking function" VALUE 0xa1029c78 _REC_VAL_20_s2 511.9921875 _CNV_A_R_LINEAR_____90_CM -256. 255.9921875 DISPLAY_IDENTIFIER C_VS_DIF_MIN_CRU_OVER FORMAT "%7.3" /end CHARACTERISTIC
/begin CHARACTERISTIC c_vs_min_cru_m "Vehicle speed conditions for vs_cru in case of mile - ICL" VALUE 0xa1029cb4 _REC_VAL_20_u2 511.99218 _CNV_A_R_LINEAR_____66_CM 0. 511.99218 DISPLAY_IDENTIFIER C_VS_MIN_CRU_M FORMAT "%7.3" /end CHARACTERISTIC
/begin CHARACTERISTIC c_vs_min_cru_k "Vehicle speed conditions for vs_cru in case of km - ICL" VALUE 0xa1029cb2 _REC_VAL_20_u2 511.99218 _CNV_A_R_LINEAR_____66_CM 0. 511.99218 DISPLAY_IDENTIFIER C_VS_MIN_CRU_K FORMAT "%7.3" /end CHARACTERISTIC
/begin MEASUREMENT vs_min_cru "Minimal Vehicle speed conditions for VS_CRU" UWORD _CNV_A_R_LINEAR_____66_CM 1 100. 0. 511.99218 DISPLAY_IDENTIFIER VS_MIN_CRU ECU_ADDRESS 0xd00053b8 FORMAT "%7.3" /end MEASUREMENT
/begin MEASUREMENT vs_dif_i_cru "Sum of the control deviations" SWORD _CNV_A_R_LINEAR_____90_CM 1 100. -256. 255.9921875 DISPLAY_IDENTIFIER VS_DIF_I_CRU ECU_ADDRESS 0xc0000276 FORMAT "%7.3" /end MEASUREMENT
/begin MEASUREMENT t_ctl_cru "Time of the controlled acceleration" UBYTE _CNV_A_R_LINEAR_____4_CM 1 100. 0. 25.5 DISPLAY_IDENTIFIER T_CTL_CRU ECU_ADDRESS 0xc000027e FORMAT "%4.1" /end MEASUREMENT
/begin MEASUREMENT vs_sp_cru "Reference input variable of the controller" UWORD _CNV_A_R_LINEAR_____66_CM 1 100. 0. 511.99218 DISPLAY_IDENTIFIER VS_SP_CRU ECU_ADDRESS 0xd00053c2 FORMAT "%7.3" /end MEASUREMENT
/begin MEASUREMENT vs_sp_dif_cru "Target variable/reference input variable difference" SWORD _CNV_A_R_LINEAR_____90_CM 1 100. -256. 255.9921875 DISPLAY_IDENTIFIER VS_SP_DIF_CRU ECU_ADDRESS 0xc0000278 FORMAT "%7.3" /end MEASUREMENT
/begin MEASUREMENT vs_sp_inc_cru "Increment for VS_SP_CRU" UWORD _CNV_A_R_LINEAR_____66_CM 1 100. 0. 511.99218 DISPLAY_IDENTIFIER VS_SP_INC_CRU ECU_ADDRESS 0xc0000274 FORMAT "%7.3" /end MEASUREMENT
/begin MEASUREMENT vs_sp_dec_cru "Decrement for VS_SP_CRU" UWORD _CNV_A_R_LINEAR_____66_CM 1 100. 0. 511.99218 DISPLAY_IDENTIFIER VS_SP_DEC_CRU ECU_ADDRESS 0xc0000272 FORMAT "%7.3" /end MEASUREMENT
/begin MEASUREMENT vs_sp_driv_cru "Driver wish target variable" UWORD _CNV_A_R_LINEAR_____66_CM 1 100. 0. 511.99218 DISPLAY_IDENTIFIER VS_SP_DRIV_CRU ECU_ADDRESS 0xd00053c4 FORMAT "%7.3" /end MEASUREMENT
/begin CHARACTERISTIC c_vs_dif_min_is_cru "Threshold of the control deviation for zero setting of PV_CRU" VALUE 0xa1029c7a _REC_VAL_20_s2 511.9921875 _CNV_A_R_LINEAR_____90_CM -256. 255.9921875 DISPLAY_IDENTIFIER C_VS_DIF_MIN_IS_CRU FORMAT "%7.3" /end CHARACTERISTIC
/begin CHARACTERISTIC c_vs_dif_max_is_cru "Threshold of the control deviation for PUC end" VALUE 0xa1029c74 _REC_VAL_20_s2 511.9921875 _CNV_A_R_LINEAR_____90_CM -256. 255.9921875 DISPLAY_IDENTIFIER C_VS_DIF_MAX_IS_CRU FORMAT "%7.3" /end CHARACTERISTIC
/begin CHARACTERISTIC c_vs_dif_max_ac_cru "Condition for interrupting the incrementation or decrementation" VALUE 0xa1029c70 _REC_VAL_20_s2 511.9921875 _CNV_A_R_LINEAR_____90_CM -256. 255.9921875 DISPLAY_IDENTIFIER C_VS_DIF_MAX_AC_CRU FORMAT "%7.3" /end CHARACTERISTIC
/begin CHARACTERISTIC c_vs_dif_min_ac_cru "Condition for interrupting the incrementation or decrementation" VALUE 0xa1029c76 _REC_VAL_20_s2 511.9921875 _CNV_A_R_LINEAR_____90_CM -256. 255.9921875 DISPLAY_IDENTIFIER C_VS_DIF_MIN_AC_CRU FORMAT "%7.3" /end CHARACTERISTIC
/begin CHARACTERISTIC c_vs_ac_min_cru "Vehicle speed threshold for acceleration valuation" VALUE 0xa1029c5f _REC_VAL_20_u1 255. _CNV_A_R_LINEAR_____6_CM 0. 255. DISPLAY_IDENTIFIER C_VS_AC_MIN_CRU FORMAT "%3.0" /end CHARACTERISTIC
/begin CHARACTERISTIC c_vs_ac_max_cru "Vehicle speed threshold for acceleration valuation" VALUE 0xa1029c5e _REC_VAL_20_u1 255. _CNV_A_R_LINEAR_____6_CM 0. 255. DISPLAY_IDENTIFIER C_VS_AC_MAX_CRU FORMAT "%3.0" /end CHARACTERISTIC
/begin CHARACTERISTIC c_vs_dif_max_cru "Control difference threshold for incrementing VS_SP_CRU" VALUE 0xa1029c72 _REC_VAL_20_u1 31.875 _CNV_A_R_LINEAR_____95_CM 0. 31.875 DISPLAY_IDENTIFIER C_VS_DIF_MAX_CRU /end CHARACTERISTIC
/begin CHARACTERISTIC c_ac_pos_cru_tip "Positive acceleration for Tip-up" VALUE 0xa1029176 _REC_VAL_20_u2 511.9789 _CNV_A_R_LINEAR_____96_CM 0. 511.9789 DISPLAY_IDENTIFIER C_AC_POS_CRU_TIP FORMAT "%6.2" /end CHARACTERISTIC
/begin CHARACTERISTIC c_ac_neg_cru_tip "Negative acceleration for Tip-up" VALUE 0xa102916a _REC_VAL_20_u2 511.9789 _CNV_A_R_LINEAR_____96_CM 0. 511.9789 DISPLAY_IDENTIFIER C_AC_NEG_CRU_TIP FORMAT "%6.2" /end CHARACTERISTIC
/begin CHARACTERISTIC c_ac_neg_cru_deacc "Negative acceleration in deceleration" VALUE 0xa1029168 _REC_VAL_20_u2 511.9789 _CNV_A_R_LINEAR_____96_CM 0. 511.9789 DISPLAY_IDENTIFIER C_AC_NEG_CRU_DEACC FORMAT "%6.2" /end CHARACTERISTIC
/begin CHARACTERISTIC c_ac_pos_cru_deacc "Positive acceleration" VALUE 0xa1029170 _REC_VAL_20_u2 511.9789 _CNV_A_R_LINEAR_____96_CM 0. 511.9789 DISPLAY_IDENTIFIER C_AC_POS_CRU_DEACC FORMAT "%6.2" /end CHARACTERISTIC
/begin CHARACTERISTIC ip_fac_cru_rest__t_ctl_cru "Correction factor of in/decrementing (xx = --, CC; yy = REST, AC, DEACC)" CURVE 0xa1023488 _REC_CUR_20_u1_u1 1.99220002 _CNV_A_R_LINEAR_____97_CM 0. 1.99220002 DISPLAY_IDENTIFIER IP_FAC_CRU_REST__T_CTL_CRU FORMAT "%5.3"
 /begin AXIS_DESCR COM_AXIS t_ctl_cru _CNV_A_R_LINEAR_____4_CM 5 0. 25.5 FORMAT "%4.1" AXIS_PTS_REF ldpm_t_ctl_cru_1 /end AXIS_DESCR
/end CHARACTERISTIC
/begin CHARACTERISTIC ip_fac_cru_ac__t_ctl_cru "Correction factor of in/decrementing (xx = --, CC; yy = REST, AC, DEACC)" CURVE 0xa102347c _REC_CUR_20_u1_u1 1.99220002 _CNV_A_R_LINEAR_____97_CM 0. 1.99220002 DISPLAY_IDENTIFIER IP_FAC_CRU_AC__T_CTL_CRU FORMAT "%5.3"
 /begin AXIS_DESCR COM_AXIS t_ctl_cru _CNV_A_R_LINEAR_____4_CM 5 0. 25.5 FORMAT "%4.1" AXIS_PTS_REF ldpm_t_ctl_cru_1 /end AXIS_DESCR
/end CHARACTERISTIC
/begin CHARACTERISTIC ip_fac_cru_dece__t_ctl_cru "Correction factor of in/decrementing (xx = --, CC; yy = REST, AC, DEACC)" CURVE 0xa1023482 _REC_CUR_20_u1_u1 1.99220002 _CNV_A_R_LINEAR_____97_CM 0. 1.99220002 DISPLAY_IDENTIFIER IP_FAC_CRU_DECE__T_CTL_CRU FORMAT "%5.3"
 /begin AXIS_DESCR COM_AXIS t_ctl_cru _CNV_A_R_LINEAR_____4_CM 5 0. 25.5 FORMAT "%4.1" AXIS_PTS_REF ldpm_t_ctl_cru_1 /end AXIS_DESCR
/end CHARACTERISTIC
/begin CHARACTERISTIC ip_fac_lgrd_cru_rest__vs_sp_dif "Interception factor of the in/decrementing (xx = REST, TIP)" CURVE 0xa1023ae8 _REC_CUR_20_u1_u2 0.99609375 _CNV_A_R_LINEAR_____27_CM 0. 0.99609375 DISPLAY_IDENTIFIER IP_FAC_LGRD_CRU_REST__VS_SP_DIF FORMAT "%5.3"
 /begin AXIS_DESCR COM_AXIS vs_sp_dif_cru _CNV_A_R_LINEAR_____98_CM 5 -256. 255.9921875 FORMAT "%7.3" AXIS_PTS_REF ldpm_vs_sp_dif_cru_1 /end AXIS_DESCR
/end CHARACTERISTIC
/begin CHARACTERISTIC ip_fac_lgrd_cru_tip__vs_sp_dif "Interception factor of the in/decrementing (xx = REST, TIP)" CURVE 0xa1023aee _REC_CUR_20_u1_u2 0.99609375 _CNV_A_R_LINEAR_____27_CM 0. 0.99609375 DISPLAY_IDENTIFIER IP_FAC_LGRD_CRU_TIP__VS_SP_DIF FORMAT "%5.3"
 /begin AXIS_DESCR COM_AXIS vs_sp_dif_cru _CNV_A_R_LINEAR_____98_CM 5 -256. 255.9921875 FORMAT "%7.3" AXIS_PTS_REF ldpm_vs_sp_dif_cru_1 /end AXIS_DESCR
/end CHARACTERISTIC
/begin CHARACTERISTIC c_t_min_cru_con "Time condition for controlled acceleration" VALUE 0xa10298e4 _REC_VAL_20_u1 25.5 _CNV_A_R_LINEAR_____4_CM 0. 25.5 DISPLAY_IDENTIFIER C_T_MIN_CRU_CON FORMAT "%4.1" /end CHARACTERISTIC
/begin CHARACTERISTIC ip_fac_cc_cru_ac__t_ctl_cru "Correction factor of in/decrementing (xx = --, CC; yy = REST, AC, DEACC)" CURVE 0xa102344c _REC_CUR_20_u1_u1 1.99220002 _CNV_A_R_LINEAR_____97_CM 0. 1.99220002 DISPLAY_IDENTIFIER IP_FAC_CC_CRU_AC__T_CTL_CRU FORMAT "%5.3"
 /begin AXIS_DESCR COM_AXIS t_ctl_cru _CNV_A_R_LINEAR_____4_CM 5 0. 25.5 FORMAT "%4.1" AXIS_PTS_REF ldpm_t_ctl_cru_1 /end AXIS_DESCR
/end CHARACTERISTIC
/begin CHARACTERISTIC ip_fac_cc_cru_dece__t_ctl_cru "Correction factor of in/decrementing (xx = --, CC; yy = REST, AC, DEACC)" CURVE 0xa1023452 _REC_CUR_20_u1_u1 1.99220002 _CNV_A_R_LINEAR_____97_CM 0. 1.99220002 DISPLAY_IDENTIFIER IP_FAC_CC_CRU_DECE__T_CTL_CRU FORMAT "%5.3"
 /begin AXIS_DESCR COM_AXIS t_ctl_cru _CNV_A_R_LINEAR_____4_CM 5 0. 25.5 FORMAT "%4.1" AXIS_PTS_REF ldpm_t_ctl_cru_1 /end AXIS_DESCR
/end CHARACTERISTIC
/begin CHARACTERISTIC c_vs_dif_rng_cru "Bandwidth for reducing the control deviation" VALUE 0xa1029c7c _REC_VAL_20_u2 511.99218 _CNV_A_R_LINEAR_____66_CM 0. 511.99218 DISPLAY_IDENTIFIER C_VS_DIF_RNG_CRU FORMAT "%7.3" /end CHARACTERISTIC
/begin MEASUREMENT state_cru "Status of cruise control to the CAN- Message" UBYTE _CNV_S_6_RANGE_STAT_99_CM 1 100. 0. 9. DISPLAY_IDENTIFIER STATE_CRU ECU_ADDRESS 0xd0003f34 /end MEASUREMENT
/begin MEASUREMENT fac_vs_lgrd_cru "Factor for intercepting the reference input variable" UBYTE _CNV_A_R_LINEAR_____17_CM 1 100. 0. 0.99610001 DISPLAY_IDENTIFIER FAC_VS_LGRD_CRU ECU_ADDRESS 0xc000027c FORMAT "%5.3" /end MEASUREMENT
/begin MEASUREMENT fac_vs_ctl_cru "Correction factor for actuating the reference input variable" UBYTE _CNV_A_R_LINEAR_____100_CM 1 100. 0. 1.9921875 DISPLAY_IDENTIFIER FAC_VS_CTL_CRU ECU_ADDRESS 0xc000027d FORMAT "%5.3" /end MEASUREMENT
/begin CHARACTERISTIC c_t_min_puc_cru "Time after entry into controlled constant drive" VALUE 0xa1029906 _REC_VAL_20_u1 25.5 _CNV_A_R_LINEAR_____4_CM 0. 25.5 DISPLAY_IDENTIFIER C_T_MIN_PUC_CRU FORMAT "%4.1" /end CHARACTERISTIC
/begin MEASUREMENT vs_dif_cru "Control deviation" SWORD _CNV_A_R_LINEAR_____90_CM 1 100. -256. 255.9921875 DISPLAY_IDENTIFIER VS_DIF_CRU ECU_ADDRESS 0xd00053c6 FORMAT "%7.3" /end MEASUREMENT
/begin MEASUREMENT fac_tq_cru_ini "CRU control variable initialisation value" UWORD _CNV_A_R_LINEAR_____7_CM 1 100. 0. 99.99847412109381 DISPLAY_IDENTIFIER FAC_TQ_CRU_INI ECU_ADDRESS 0xc000026c /end MEASUREMENT
/begin CHARACTERISTIC ip_fac_prop_cru "Proportional coefficient of the PI controller" MAP 0xa1023c80 _REC_MAP_20_u2_u2_u2 49.999237 _CNV_A_R_LINEAR_____101_CM 0. 49.999237 DISPLAY_IDENTIFIER IP_FAC_PROP_CRU FORMAT "%7.4"
 /begin AXIS_DESCR COM_AXIS vs_sp_cru _CNV_A_R_LINEAR_____66_CM 5 0. 511.99218 FORMAT "%7.3" AXIS_PTS_REF ldpm_vs_sp_cru_1 /end AXIS_DESCR
 /begin AXIS_DESCR COM_AXIS vs_dif_cru _CNV_A_R_LINEAR_____98_CM 4 -256. 255.9921875 FORMAT "%7.3" AXIS_PTS_REF ldp_vs_dif_cru__fac_prop_cru /end AXIS_DESCR
/end CHARACTERISTIC
/begin CHARACTERISTIC ip_fac_tq_cru_ini_add_at "Additive torque based on gear and acceleration" MAP 0xa1024420 _REC_MAP_20_u2_u2_u1 400. _CNV_A_R_LINEAR_____102_CM -200. 200. DISPLAY_IDENTIFIER IP_FAC_TQ_CRU_INI_ADD_AT FORMAT "%8.3"
 /begin AXIS_DESCR COM_AXIS ac_cru _CNV_A_R_LINEAR_____103_CM 6 -15.72 15.71952 FORMAT "%8.4" AXIS_PTS_REF ldpm_ac_cru__fac_tq_cru /end AXIS_DESCR
 /begin AXIS_DESCR COM_AXIS gear _CNV_A_R_LINEAR_____0_CM 12 0. 255. FORMAT "%3.0" AXIS_PTS_REF ldpm_gear__fac_tq_cru /end AXIS_DESCR
/end CHARACTERISTIC
/begin CHARACTERISTIC ip_fac_tq_cru_ini_add_mt "Additive torque based on gear and acceleration" MAP 0xa10244b0 _REC_MAP_20_u2_u2_u1 400. _CNV_A_R_LINEAR_____102_CM -200. 200. DISPLAY_IDENTIFIER IP_FAC_TQ_CRU_INI_ADD_MT FORMAT "%8.3"
 /begin AXIS_DESCR COM_AXIS ac_cru _CNV_A_R_LINEAR_____103_CM 6 -15.72 15.71952 FORMAT "%8.4" AXIS_PTS_REF ldpm_ac_cru__fac_tq_cru /end AXIS_DESCR
 /begin AXIS_DESCR COM_AXIS gear _CNV_A_R_LINEAR_____0_CM 12 0. 255. FORMAT "%3.0" AXIS_PTS_REF ldpm_gear__fac_tq_cru /end AXIS_DESCR
/end CHARACTERISTIC
/begin CHARACTERISTIC c_fac_vs_dif_rng_cru "Reduction factor for the control deviation VS_DIF_CRU" VALUE 0xa10293cc _REC_VAL_20_u1 0.99610001 _CNV_A_R_LINEAR_____17_CM 0. 0.99610001 DISPLAY_IDENTIFIER C_FAC_VS_DIF_RNG_CRU FORMAT "%5.3" /end CHARACTERISTIC
/begin CHARACTERISTIC ip_fac_tq_cru_dec__n_32 "Decrement of the FAC_TQ_CRU" CURVE 0xa1024414 _REC_CUR_20_u2_u1 99.99847412109381 _CNV_A_R_LINEAR_____7_CM 0. 99.99847412109381 DISPLAY_IDENTIFIER IP_FAC_TQ_CRU_DEC__N_32
 /begin AXIS_DESCR COM_AXIS n_32 _CNV_A_R_LINEAR_____9_CM 5 0. 8160. FORMAT "%4.0" AXIS_PTS_REF ldp_n_32__fac_tq_cru /end AXIS_DESCR
/end CHARACTERISTIC
/begin CHARACTERISTIC ip_ac_neg_cru_ac__n__fac_tq_cru "negative acceleration in setting" MAP 0xa1023028 _REC_MAP_20_u2_u1_u2 511.9789 _CNV_A_R_LINEAR_____96_CM 0. 511.9789 DISPLAY_IDENTIFIER IP_AC_NEG_CRU_AC__N__FAC_TQ_CRU FORMAT "%6.2"
 /begin AXIS_DESCR COM_AXIS n_32 _CNV_A_R_LINEAR_____9_CM 3 0. 8160. FORMAT "%4.0" AXIS_PTS_REF ldpm_n_21 /end AXIS_DESCR
 /begin AXIS_DESCR COM_AXIS fac_tq_cru _CNV_A_R_LINEAR_____7_CM 3 0. 99.99847412109381 AXIS_PTS_REF ldpm_fac_tq_cru_1 /end AXIS_DESCR
/end CHARACTERISTIC
/begin CHARACTERISTIC ip_fac_vs_dif_i_cru "Delta VS_SP_CRU correction" MAP 0xa1024924 _REC_MAP_20_u2_u2_u2 0.9999847412109381 _CNV_A_R_LINEAR_____68_CM 0. 0.9999847412109381 DISPLAY_IDENTIFIER IP_FAC_VS_DIF_I_CRU FORMAT "%7.5"
 /begin AXIS_DESCR COM_AXIS vs_sp_cru _CNV_A_R_LINEAR_____66_CM 5 0. 511.99218 FORMAT "%7.3" AXIS_PTS_REF ldpm_vs_sp_cru_1 /end AXIS_DESCR
 /begin AXIS_DESCR COM_AXIS vs_dif_cru _CNV_A_R_LINEAR_____98_CM 4 -256. 255.9921875 FORMAT "%7.3" AXIS_PTS_REF ldp_vs_dif_cru__fac_prop_cru /end AXIS_DESCR
/end CHARACTERISTIC
/begin CHARACTERISTIC ip_fac_vs_sp_dif_i_cru "Delta VS_SP_CRU correction" CURVE 0xa10249c0 _REC_CUR_20_u2_u2 1.99996948242188 _CNV_A_R_LINEAR_____8_CM 0. 1.99996948242188 DISPLAY_IDENTIFIER IP_FAC_VS_SP_DIF_I_CRU FORMAT "%7.5"
 /begin AXIS_DESCR COM_AXIS vs_sp_cru _CNV_A_R_LINEAR_____66_CM 5 0. 511.99218 FORMAT "%7.3" AXIS_PTS_REF ldpm_vs_sp_cru_1 /end AXIS_DESCR
/end CHARACTERISTIC
/begin CHARACTERISTIC c_vs_dif_delta_i "Positive acceleration" VALUE 0xa1029c6b _REC_VAL_20_u1 63.75 _CNV_A_R_LINEAR_____104_CM 0. 63.75 DISPLAY_IDENTIFIER C_VS_DIF_DELTA_I /end CHARACTERISTIC
/begin CHARACTERISTIC c_fac_tq_cru_lgrd "Control variable limitaion gradiant" VALUE 0xa10293ae _REC_VAL_20_u2 99.99847412109381 _CNV_A_R_LINEAR_____105_CM 0. 99.99847412109381 DISPLAY_IDENTIFIER C_FAC_TQ_CRU_LGRD /end CHARACTERISTIC
/begin CHARACTERISTIC c_fac_tq_cru_max "Maximum request of Cruise Control" VALUE 0xa10293b0 _REC_VAL_20_u2 99.99847412109381 _CNV_A_R_LINEAR_____105_CM 0. 99.99847412109381 DISPLAY_IDENTIFIER C_FAC_TQ_CRU_MAX /end CHARACTERISTIC
/begin CHARACTERISTIC c_fac_ac_pos_cru "Maximum reduction of FAC_VS_LGRD_CRU" VALUE 0xa1029374 _REC_VAL_20_u1 0.99609375 _CNV_A_R_LINEAR_____27_CM 0. 0.99609375 DISPLAY_IDENTIFIER C_FAC_AC_POS_CRU FORMAT "%5.3" /end CHARACTERISTIC
/begin CHARACTERISTIC c_fac_ac_pos_cru_rng_l "Maximum reduction of FAC_VS_LGRD_CRU at RNG_L" VALUE 0xa1029375 _REC_VAL_20_u1 0.99609375 _CNV_A_R_LINEAR_____27_CM 0. 0.99609375 DISPLAY_IDENTIFIER C_FAC_AC_POS_CRU_RNG_L FORMAT "%5.3" /end CHARACTERISTIC
/begin CHARACTERISTIC c_ac_pos_cru_resu "Positive acceleration at CRU resume" VALUE 0xa1029172 _REC_VAL_20_u2 511.9789 _CNV_A_R_LINEAR_____96_CM 0. 511.9789 DISPLAY_IDENTIFIER C_AC_POS_CRU_RESU FORMAT "%6.2" /end CHARACTERISTIC
/begin CHARACTERISTIC c_ac_pos_cru_resu_rng_l "Positive acceleration at CRU resume at RNG_L" VALUE 0xa1029174 _REC_VAL_20_u2 511.9789 _CNV_A_R_LINEAR_____96_CM 0. 511.9789 DISPLAY_IDENTIFIER C_AC_POS_CRU_RESU_RNG_L FORMAT "%6.2" /end CHARACTERISTIC
/begin CHARACTERISTIC c_ac_pos_cru_ac "Positive acceleration in setting/acceleration" VALUE 0xa102916c _REC_VAL_20_u2 511.9789 _CNV_A_R_LINEAR_____96_CM 0. 511.9789 DISPLAY_IDENTIFIER C_AC_POS_CRU_AC FORMAT "%6.2" /end CHARACTERISTIC
/begin CHARACTERISTIC c_ac_pos_cru_ac_rng_l "Positive acceleration in setting/acceleration at RNG_L" VALUE 0xa102916e _REC_VAL_20_u2 511.9789 _CNV_A_R_LINEAR_____96_CM 0. 511.9789 DISPLAY_IDENTIFIER C_AC_POS_CRU_AC_RNG_L FORMAT "%6.2" /end CHARACTERISTIC
/begin MEASUREMENT fac_tq_cru "CRU control variable" UWORD _CNV_A_R_LINEAR_____7_CM 1 100. 0. 99.99847412109381 DISPLAY_IDENTIFIER FAC_TQ_CRU ECU_ADDRESS 0xd00053c0 /end MEASUREMENT
/begin MEASUREMENT state_i_cru "Condition of I Share VS_DIF_I_CRU" UBYTE _CNV_S_4_STATE_I_CR_106_CM 1 100. 0. 3. DISPLAY_IDENTIFIER STATE_I_CRU ECU_ADDRESS 0xc000027f /end MEASUREMENT
/begin CHARACTERISTIC ip_ac_neg_cru_resu "negative acceleration at CRU resume" MAP 0xa102303c _REC_MAP_20_u2_u1_u2 511.9789 _CNV_A_R_LINEAR_____96_CM 0. 511.9789 DISPLAY_IDENTIFIER IP_AC_NEG_CRU_RESU FORMAT "%6.2"
 /begin AXIS_DESCR COM_AXIS n_32 _CNV_A_R_LINEAR_____9_CM 3 0. 8160. FORMAT "%4.0" AXIS_PTS_REF ldpm_n_21 /end AXIS_DESCR
 /begin AXIS_DESCR COM_AXIS fac_tq_cru _CNV_A_R_LINEAR_____7_CM 3 0. 99.99847412109381 AXIS_PTS_REF ldpm_fac_tq_cru_1 /end AXIS_DESCR
/end CHARACTERISTIC
/begin AXIS_PTS ldpm_t_ctl_cru_1 "" 0xa10221ee t_ctl_cru _REC_AXS_20_u1 2.55 _CNV_A_R_LINEAR_____4_CM 5 0. 25.5 FORMAT "%4.1" /end AXIS_PTS
/begin AXIS_PTS ldp_vs_dif_cru__fac_prop_cru "" 0xa1021868 vs_dif_cru _REC_AXS_20_u2 511.9921875 _CNV_A_R_LINEAR_____98_CM 4 -256. 255.9921875 FORMAT "%7.3" /end AXIS_PTS
/begin AXIS_PTS ldpm_vs_sp_dif_cru_1 "" 0xa1022410 vs_sp_dif_cru _REC_AXS_20_u2 511.9921875 _CNV_A_R_LINEAR_____98_CM 5 -256. 255.9921875 FORMAT "%7.3" /end AXIS_PTS
/begin AXIS_PTS ldpm_n_21 "" 0xa1021d36 n_32 _REC_AXS_20_u1 8160. _CNV_A_R_LINEAR_____9_CM 3 0. 8160. FORMAT "%4.0" /end AXIS_PTS
/begin AXIS_PTS ldpm_vs_sp_cru_1 "" 0xa1022404 vs_sp_cru _REC_AXS_20_u2 511.99218 _CNV_A_R_LINEAR_____66_CM 5 0. 511.99218 FORMAT "%7.3" /end AXIS_PTS
/begin AXIS_PTS ldpm_ac_cru__fac_tq_cru "" 0xa10218c8 ac_cru _REC_AXS_20_u2 31.43952 _CNV_A_R_LINEAR_____103_CM 6 -15.72 15.71952 FORMAT "%8.4" /end AXIS_PTS
/begin AXIS_PTS ldpm_gear__fac_tq_cru "" 0xa1021ad8 gear _REC_AXS_20_u1 255. _CNV_A_R_LINEAR_____0_CM 12 0. 255. FORMAT "%3.0" /end AXIS_PTS
/begin AXIS_PTS ldp_n_32__fac_tq_cru "" 0xa1020d72 n_32 _REC_AXS_20_u1 816. _CNV_A_R_LINEAR_____9_CM 5 0. 8160. FORMAT "%4.0" /end AXIS_PTS
/begin AXIS_PTS ldpm_fac_tq_cru_1 "" 0xa1021a78 fac_tq_cru _REC_AXS_20_u2 99.99847412109381 _CNV_A_R_LINEAR_____7_CM 3 0. 99.99847412109381 /end AXIS_PTS
/begin MEASUREMENT lv_cru_over_act_ack "Hand shake overtaking function" UBYTE _CNV_S_2_RANGE__0___1_CM 1 100. 0. 1. DISPLAY_IDENTIFIER LV_CRU_OVER_ACT_ACK ECU_ADDRESS 0xd0003f36 BIT_MASK 0x1 /end MEASUREMENT
/begin MEASUREMENT vs_sp_cru_max "Maximum limitation of cruise control" UWORD _CNV_A_R_LINEAR_____66_CM 1 100. 0. 511.99218 DISPLAY_IDENTIFIER VS_SP_CRU_MAX ECU_ADDRESS 0xd00053c8 FORMAT "%7.3" /end MEASUREMENT
/begin CHARACTERISTIC c_vs_sp_cru_max_k "maximum limitation of cruise control in case of KM - ICL" VALUE 0xa1029cd0 _REC_VAL_20_u2 511.99218 _CNV_A_R_LINEAR_____66_CM 0. 511.99218 DISPLAY_IDENTIFIER C_VS_SP_CRU_MAX_K FORMAT "%7.3" /end CHARACTERISTIC
/begin CHARACTERISTIC c_vs_sp_cru_max_m "maximum limitation of cruise control in case of Mile - ICL" VALUE 0xa1029cd2 _REC_VAL_20_u2 511.99218 _CNV_A_R_LINEAR_____66_CM 0. 511.99218 DISPLAY_IDENTIFIER C_VS_SP_CRU_MAX_M FORMAT "%7.3" /end CHARACTERISTIC
/begin CHARACTERISTIC c_vs_dif_tip_m "Km per tip in case of mile - icl" VALUE 0xa1029c8a _REC_VAL_20_u2 511.99218 _CNV_A_R_LINEAR_____66_CM 0. 511.99218 DISPLAY_IDENTIFIER C_VS_DIF_TIP_M FORMAT "%7.3" /end CHARACTERISTIC
/begin CHARACTERISTIC c_vs_dif_tip_k "Km per tip in case of km - icl" VALUE 0xa1029c88 _REC_VAL_20_u2 511.99218 _CNV_A_R_LINEAR_____66_CM 0. 511.99218 DISPLAY_IDENTIFIER C_VS_DIF_TIP_K FORMAT "%7.3" /end CHARACTERISTIC
/begin MEASUREMENT nr_step_on "Current vehicle speed step" UBYTE _CNV_A_R_LINEAR_____0_CM 1 100. 0. 255. DISPLAY_IDENTIFIER NR_STEP_ON ECU_ADDRESS 0xc00002b0 FORMAT "%3.0" /end MEASUREMENT
/begin MEASUREMENT count_vs_step "Number of used vehicle speed steps" UBYTE _CNV_A_R_LINEAR_____0_CM 1 100. 0. 255. DISPLAY_IDENTIFIER COUNT_VS_STEP ECU_ADDRESS 0xd0003f47 FORMAT "%3.0" /end MEASUREMENT
/begin MEASUREMENT vs_dif_step_prog "Differences between steps" UWORD _CNV_A_R_LINEAR_____66_CM 1 100. 0. 511.99218 DISPLAY_IDENTIFIER VS_DIF_STEP_PROG ECU_ADDRESS 0xc0000284 FORMAT "%7.3" /end MEASUREMENT
/begin MEASUREMENT lv_step_on "Step display on" UBYTE _CNV_S_2_RANGE__0___1_CM 1 100. 0. 1. DISPLAY_IDENTIFIER LV_STEP_ON ECU_ADDRESS 0xd0003f49 BIT_MASK 0x1 /end MEASUREMENT
/begin MEASUREMENT vs_sp_driv_step "Active vehicle speed step for the controller" UWORD _CNV_A_R_LINEAR_____66_CM 1 100. 0. 511.99218 DISPLAY_IDENTIFIER VS_SP_DRIV_STEP ECU_ADDRESS 0xd00053ec FORMAT "%7.3" /end MEASUREMENT
/begin MEASUREMENT nr_vs_cru "Cycle number of message IDX_NO" UBYTE _CNV_A_R_LINEAR_____0_CM 1 100. 0. 255. DISPLAY_IDENTIFIER NR_VS_CRU ECU_ADDRESS 0xd0003f48 FORMAT "%3.0" /end MEASUREMENT
/begin MEASUREMENT vs_sp_driv_cru_can "Driver demand cruise control for INSTR" UWORD _CNV_A_R_LINEAR_____66_CM 1 100. 0. 511.99218 DISPLAY_IDENTIFIER VS_SP_DRIV_CRU_CAN ECU_ADDRESS 0xd00053ea FORMAT "%7.3" /end MEASUREMENT
/begin MEASUREMENT vs_step_can_1 "Vehicle speed step to the CAN Nr.1" UWORD _CNV_A_R_LINEAR_____66_CM 1 100. 0. 511.99218 DISPLAY_IDENTIFIER VS_STEP_CAN_1 ECU_ADDRESS 0xd00053ee FORMAT "%7.3" /end MEASUREMENT
/begin MEASUREMENT vs_step_can_2 "Vehicle speed step to the CAN Nr.2" UWORD _CNV_A_R_LINEAR_____66_CM 1 100. 0. 511.99218 DISPLAY_IDENTIFIER VS_STEP_CAN_2 ECU_ADDRESS 0xd00053f0 FORMAT "%7.3" /end MEASUREMENT
/begin MEASUREMENT vs_step_can_3 "Vehicle speed step to the CAN Nr.3" UWORD _CNV_A_R_LINEAR_____66_CM 1 100. 0. 511.99218 DISPLAY_IDENTIFIER VS_STEP_CAN_3 ECU_ADDRESS 0xd00053f2 FORMAT "%7.3" /end MEASUREMENT
/begin CHARACTERISTIC c_vs_dif_step_prog_m "M.p.h step calibration" VALUE 0xa1029c86 _REC_VAL_20_u2 511.99218 _CNV_A_R_LINEAR_____66_CM 0. 511.99218 DISPLAY_IDENTIFIER C_VS_DIF_STEP_PROG_M FORMAT "%7.3" /end CHARACTERISTIC
/begin CHARACTERISTIC c_vs_dif_step_prog_k "Km.p.h step calibration" VALUE 0xa1029c84 _REC_VAL_20_u2 511.99218 _CNV_A_R_LINEAR_____66_CM 0. 511.99218 DISPLAY_IDENTIFIER C_VS_DIF_STEP_PROG_K FORMAT "%7.3" /end CHARACTERISTIC
/begin CHARACTERISTIC c_vs_min_prog "VS_CRU threshold stand programming detection" VALUE 0xa1029cc0 _REC_VAL_20_u2 511.99218 _CNV_A_R_LINEAR_____66_CM 0. 511.99218 DISPLAY_IDENTIFIER C_VS_MIN_PROG FORMAT "%7.3" /end CHARACTERISTIC
/begin CHARACTERISTIC c_max_step "Maximum number of steps" VALUE 0xa1029575 _REC_VAL_20_u1 255. _CNV_A_R_LINEAR_____0_CM 0. 255. DISPLAY_IDENTIFIER C_MAX_STEP FORMAT "%3.0" /end CHARACTERISTIC
/begin CHARACTERISTIC c_t_cru_flash_light "Flash light duration time" VALUE 0xa1029821 _REC_VAL_20_u1 2.55 _CNV_A_R_LINEAR_____3_CM 0. 2.55 DISPLAY_IDENTIFIER C_T_CRU_FLASH_LIGHT FORMAT "%4.2" /end CHARACTERISTIC
/begin CHARACTERISTIC c_t_min_prog "Time for programming detection" VALUE 0xa10298fd _REC_VAL_20_u1 5.1 _CNV_A_R_LINEAR_____107_CM 0. 5.1 DISPLAY_IDENTIFIER C_T_MIN_PROG FORMAT "%4.2" /end CHARACTERISTIC
/begin CHARACTERISTIC c_ctr_cru_flash_light "Counter for flash lights" VALUE 0xa1029256 _REC_VAL_20_u1 254. _CNV_A_R_LINEAR_____0_CM 1. 255. DISPLAY_IDENTIFIER C_CTR_CRU_FLASH_LIGHT FORMAT "%3.0" /end CHARACTERISTIC
/begin MEASUREMENT lv_prog_step_1 "Standing programming on" UBYTE _CNV_S_2_RANGE__0___1_CM 1 100. 0. 1. DISPLAY_IDENTIFIER LV_PROG_STEP_1 ECU_ADDRESS 0xd0003f4a BIT_MASK 0x1 /end MEASUREMENT
/begin MEASUREMENT lv_prog_step_if_act "Step Display on" UBYTE _CNV_S_2_RANGE__0___1_CM 1 100. 0. 1. DISPLAY_IDENTIFIER LV_PROG_STEP_IF_ACT ECU_ADDRESS 0xc00002bf BIT_MASK 0x1 /end MEASUREMENT
/begin CHARACTERISTIC c_t_dly_cru_tip "Time delay for display vehicle speed pointer" VALUE 0xa1029842 _REC_VAL_20_u1 2.55 _CNV_A_R_LINEAR_____3_CM 0. 2.55 DISPLAY_IDENTIFIER C_T_DLY_CRU_TIP FORMAT "%4.2" /end CHARACTERISTIC
/begin CHARACTERISTIC c_t_min_cru_chg "Lock time for events" VALUE 0xa10298e3 _REC_VAL_20_u1 2.55 _CNV_A_R_LINEAR_____3_CM 0. 2.55 DISPLAY_IDENTIFIER C_T_MIN_CRU_CHG FORMAT "%4.2" /end CHARACTERISTIC
/begin CHARACTERISTIC c_vs_dif_step_min_hys "Minimum between steps hysteresis" VALUE 0xa1029c7e _REC_VAL_20_u2 511.99218 _CNV_A_R_LINEAR_____66_CM 0. 511.99218 DISPLAY_IDENTIFIER C_VS_DIF_STEP_MIN_HYS FORMAT "%7.3" /end CHARACTERISTIC
/begin CHARACTERISTIC c_t_prog_step_if_act "Time out for programming mode" VALUE 0xa1029939 _REC_VAL_20_u1 2.55 _CNV_A_R_LINEAR_____3_CM 0. 2.55 DISPLAY_IDENTIFIER C_T_PROG_STEP_IF_ACT FORMAT "%4.2" /end CHARACTERISTIC
/begin CHARACTERISTIC c_vs_dif_step_min_m "Minimum between steps in case of mile ICL" VALUE 0xa1029c82 _REC_VAL_20_u2 511.99218 _CNV_A_R_LINEAR_____66_CM 0. 511.99218 DISPLAY_IDENTIFIER C_VS_DIF_STEP_MIN_M FORMAT "%7.3" /end CHARACTERISTIC
/begin CHARACTERISTIC c_vs_dif_step_min_k "Minimum between steps in case of  Km - ICL" VALUE 0xa1029c80 _REC_VAL_20_u2 511.99218 _CNV_A_R_LINEAR_____66_CM 0. 511.99218 DISPLAY_IDENTIFIER C_VS_DIF_STEP_MIN_K FORMAT "%7.3" /end CHARACTERISTIC
/begin CHARACTERISTIC c_vs_dif_tip_prog_m "Difference between tip steps in case of mile ICL" VALUE 0xa1029c8e _REC_VAL_20_u2 511.99218 _CNV_A_R_LINEAR_____66_CM 0. 511.99218 DISPLAY_IDENTIFIER C_VS_DIF_TIP_PROG_M FORMAT "%7.3" /end CHARACTERISTIC
/begin CHARACTERISTIC c_vs_dif_tip_prog_k "Difference between tip steps in case of Km ICL" VALUE 0xa1029c8c _REC_VAL_20_u2 511.99218 _CNV_A_R_LINEAR_____66_CM 0. 511.99218 DISPLAY_IDENTIFIER C_VS_DIF_TIP_PROG_K FORMAT "%7.3" /end CHARACTERISTIC
/begin MEASUREMENT lv_cyl_bal_lam_sel_ad_hot_dc "Flag for cylinder balancing cylinder selective lambda adaptation (hot) at active driving cycle" UBYTE _CNV_S_2_RANGE__0___1_CM 1 100. 0. 1. DISPLAY_IDENTIFIER LV_CYL_BAL_LAM_SEL_AD_HOT_DC ECU_ADDRESS 0xd0003d8d BIT_MASK 0x1 /end MEASUREMENT
/begin MEASUREMENT state_cyl_bal_ad_dc "State of cylinder balancing adaptation at active driving cycle" UBYTE _CNV_S_3_RANGE_STAT_124_CM 1 100. 0. 2. DISPLAY_IDENTIFIER STATE_CYL_BAL_AD_DC ECU_ADDRESS 0xc0000416 /end MEASUREMENT
/begin MEASUREMENT lv_cyl_bal_ad_hom_req_dc "Flag for homogenous combustion mode for cylinder balancing adaptation requested at active driving cycle" UBYTE _CNV_S_2_RANGE__0___1_CM 1 100. 0. 1. DISPLAY_IDENTIFIER LV_CYL_BAL_AD_HOM_REQ_DC ECU_ADDRESS 0xd0003d8e BIT_MASK 0x1 /end MEASUREMENT
/begin MEASUREMENT lv_state_cyl_bal_dc_chg_req "Flag for cylinder balancing adaptation to state request requested at active driving cycle" UBYTE _CNV_S_2_RANGE__0___1_CM 1 100. 0. 1. DISPLAY_IDENTIFIER LV_STATE_CYL_BAL_DC_CHG_REQ ECU_ADDRESS 0xc0000408 BIT_MASK 0x1 /end MEASUREMENT
/begin MEASUREMENT lv_state_cyl_bal_dc_chg_wait "Flag for cylinder balancing adaptation to state wait requested at active driving cycle" UBYTE _CNV_S_2_RANGE__0___1_CM 1 100. 0. 1. DISPLAY_IDENTIFIER LV_STATE_CYL_BAL_DC_CHG_WAIT ECU_ADDRESS 0xc0000409 BIT_MASK 0x1 /end MEASUREMENT
/begin MEASUREMENT lv_cyl_bal_lam_ad_add_dc[0] "Flag for cylinder balancing lambda adaptation (additive) exhaust bank specific at active driving cycle" UBYTE _CNV_S_2_RANGE__0___1_CM 1 100. 0. 1. DISPLAY_IDENTIFIER LV_CYL_BAL_LAM_AD_ADD_DC[1] ECU_ADDRESS 0xc000040a BIT_MASK 0x1 /end MEASUREMENT
/begin MEASUREMENT lv_cyl_bal_lam_ad_add_dc[1] "Flag for cylinder balancing lambda adaptation (additive) exhaust bank specific at active driving cycle" UBYTE _CNV_S_2_RANGE__0___1_CM 1 100. 0. 1. DISPLAY_IDENTIFIER LV_CYL_BAL_LAM_AD_ADD_DC[2] ECU_ADDRESS 0xc000040b BIT_MASK 0x1 /end MEASUREMENT
/begin MEASUREMENT lv_cyl_bal_lam_ad_fac_l_dc[0] "Flag for cylinder balancing lambda adaptation (multiple low) exhaust bank specific at active driving cycle" UBYTE _CNV_S_2_RANGE__0___1_CM 1 100. 0. 1. DISPLAY_IDENTIFIER LV_CYL_BAL_LAM_AD_FAC_L_DC[1] ECU_ADDRESS 0xc000040c BIT_MASK 0x1 /end MEASUREMENT
/begin MEASUREMENT lv_cyl_bal_lam_ad_fac_l_dc[1] "Flag for cylinder balancing lambda adaptation (multiple low) exhaust bank specific at active driving cycle" UBYTE _CNV_S_2_RANGE__0___1_CM 1 100. 0. 1. DISPLAY_IDENTIFIER LV_CYL_BAL_LAM_AD_FAC_L_DC[2] ECU_ADDRESS 0xc000040d BIT_MASK 0x1 /end MEASUREMENT
/begin MEASUREMENT lv_cyl_bal_lam_ad_fac_h_dc[0] "Flag for cylinder balancing lambda adaptation (multiple high) exhaust bank specific at active driving cycle" UBYTE _CNV_S_2_RANGE__0___1_CM 1 100. 0. 1. DISPLAY_IDENTIFIER LV_CYL_BAL_LAM_AD_FAC_H_DC[1] ECU_ADDRESS 0xc000040e BIT_MASK 0x1 /end MEASUREMENT
/begin MEASUREMENT lv_cyl_bal_lam_ad_fac_h_dc[1] "Flag for cylinder balancing lambda adaptation (multiple high) exhaust bank specific at active driving cycle" UBYTE _CNV_S_2_RANGE__0___1_CM 1 100. 0. 1. DISPLAY_IDENTIFIER LV_CYL_BAL_LAM_AD_FAC_H_DC[2] ECU_ADDRESS 0xc000040f BIT_MASK 0x1 /end MEASUREMENT
/begin MEASUREMENT lv_cyl_bal_lam_sel_ad_nom_dc[0] "flag for cylinder balancing cylinder selective lambda adaptation (hot) bank specific at active driving cycle" UBYTE _CNV_S_2_RANGE__0___1_CM 1 100. 0. 1. DISPLAY_IDENTIFIER LV_CYL_BAL_LAM_SEL_AD_NOM_DC[1] ECU_ADDRESS 0xc0000410 BIT_MASK 0x1 /end MEASUREMENT
/begin MEASUREMENT lv_cyl_bal_lam_sel_ad_nom_dc[1] "flag for cylinder balancing cylinder selective lambda adaptation (hot) bank specific at active driving cycle" UBYTE _CNV_S_2_RANGE__0___1_CM 1 100. 0. 1. DISPLAY_IDENTIFIER LV_CYL_BAL_LAM_SEL_AD_NOM_DC[2] ECU_ADDRESS 0xc0000411 BIT_MASK 0x1 /end MEASUREMENT
/begin MEASUREMENT lv_lam_lim_lam_ad[0] "Flag for immediate lambda adaptation required at active driving cycle" UBYTE _CNV_S_2_RANGE__0___1_CM 1 100. 0. 1. DISPLAY_IDENTIFIER LV_LAM_LIM_LAM_AD[1] ECU_ADDRESS 0xd0003d94 BIT_MASK 0x1 /end MEASUREMENT
/begin MEASUREMENT lv_lam_lim_lam_ad[1] "Flag for immediate lambda adaptation required at active driving cycle" UBYTE _CNV_S_2_RANGE__0___1_CM 1 100. 0. 1. DISPLAY_IDENTIFIER LV_LAM_LIM_LAM_AD[2] ECU_ADDRESS 0xd0003d95 BIT_MASK 0x1 /end MEASUREMENT
/begin MEASUREMENT t_cyl_bal_ad_cdn_dc[0] "Time for cylinder balancing adaptation request at active driving cycle" UWORD _CNV_A_R_LINEAR_____4_CM 1 100. 0. 6553.5 DISPLAY_IDENTIFIER T_CYL_BAL_AD_CDN_DC[1] ECU_ADDRESS 0xc00003fe FORMAT "%6.1" /end MEASUREMENT
/begin MEASUREMENT t_cyl_bal_ad_cdn_dc[1] "Time for cylinder balancing adaptation request at active driving cycle" UWORD _CNV_A_R_LINEAR_____4_CM 1 100. 0. 6553.5 DISPLAY_IDENTIFIER T_CYL_BAL_AD_CDN_DC[2] ECU_ADDRESS 0xc0000400 FORMAT "%6.1" /end MEASUREMENT
/begin MEASUREMENT t_cyl_bal_ad_wait_dc "Time delay after homogenous request for cylinder balancing adaptation at active driving cycle" UWORD _CNV_A_R_LINEAR_____4_CM 1 100. 0. 6553.5 DISPLAY_IDENTIFIER T_CYL_BAL_AD_WAIT_DC ECU_ADDRESS 0xc00003fc FORMAT "%6.1" /end MEASUREMENT
/begin CHARACTERISTIC c_t_min_cyl_bal_ad_cdn_dc "Minimum time for cylinder balancing adaptation conditions within limits at active driving cycle" VALUE 0xa10298e6 _REC_VAL_20_u2 6553.5 _CNV_A_R_LINEAR_____4_CM 0. 6553.5 DISPLAY_IDENTIFIER C_T_MIN_CYL_BAL_AD_CDN_DC FORMAT "%6.1" /end CHARACTERISTIC
/begin CHARACTERISTIC c_t_min_cyl_bal_ad_wait_dc "Minimum waiting time at entry to state adaptation for cylinder balancing adaptation at active driving cycle" VALUE 0xa10298e8 _REC_VAL_20_u2 6553.5 _CNV_A_R_LINEAR_____4_CM 0. 6553.5 DISPLAY_IDENTIFIER C_T_MIN_CYL_BAL_AD_WAIT_DC FORMAT "%6.1" /end CHARACTERISTIC
/begin CHARACTERISTIC lc_lam_ad_ctl_cyl_bal_ad_dc "Manual switch to take lambda adaptation control into consideration for cylinder balancing at active driving cycle" VALUE 0xa1029d6e _REC_VAL_20_u1 1. _CNV_A_R_LINEAR_____0_CM 0. 1. DISPLAY_IDENTIFIER LC_LAM_AD_CTL_CYL_BAL_AD_DC FORMAT "%1.0" /end CHARACTERISTIC
/begin CHARACTERISTIC lc_cyl_bal_cord_dc_stop_man "Logical constant for manual stop (=1) of cylinder balancing coordination at driving cycle" VALUE 0xa1029d18 _REC_VAL_20_u1 1. _CNV_A_R_LINEAR_____0_CM 0. 1. DISPLAY_IDENTIFIER LC_CYL_BAL_CORD_DC_STOP_MAN FORMAT "%1.0" /end CHARACTERISTIC
/begin CHARACTERISTIC lc_cyl_bal_ad_dc_rst "Manual switch for cylinder balancing adaptation reset at active driving cycle" VALUE 0xa1029d15 _REC_VAL_20_u1 1. _CNV_A_R_LINEAR_____0_CM 0. 1. DISPLAY_IDENTIFIER LC_CYL_BAL_AD_DC_RST FORMAT "%1.0" /end CHARACTERISTIC
/begin CHARACTERISTIC c_lamb_delta_cyl_sel_cq_fil_dc "Delta lambda threshold for cylinder balancing cylinder selective lambda adaptation at active driving cycle" VALUE 0xa10294d2 _REC_VAL_20_u2 0.9999847412109381 _CNV_A_R_LINEAR_____68_CM 0. 0.9999847412109381 DISPLAY_IDENTIFIER C_LAMB_DELTA_CYL_SEL_CQ_FIL_DC FORMAT "%7.5" /end CHARACTERISTIC
/begin MEASUREMENT lv_cyl_bal_lam_ad_stop[0] "Flag to indicate stop of lambda adaptation cycle for cylinder balancing at active driving cycle" UBYTE _CNV_S_2_RANGE__0___1_CM 1 100. 0. 1. DISPLAY_IDENTIFIER LV_CYL_BAL_LAM_AD_STOP[1] ECU_ADDRESS 0xd0003d92 BIT_MASK 0x1 /end MEASUREMENT
/begin MEASUREMENT lv_cyl_bal_lam_ad_stop[1] "Flag to indicate stop of lambda adaptation cycle for cylinder balancing at active driving cycle" UBYTE _CNV_S_2_RANGE__0___1_CM 1 100. 0. 1. DISPLAY_IDENTIFIER LV_CYL_BAL_LAM_AD_STOP[2] ECU_ADDRESS 0xd0003d93 BIT_MASK 0x1 /end MEASUREMENT
/begin MEASUREMENT lv_cyl_bal_ad_req_dc[0] "Flag for homogenous combustion mode for cylinder balancing adaptation requested at active driving cycle" UBYTE _CNV_S_2_RANGE__0___1_CM 1 100. 0. 1. DISPLAY_IDENTIFIER LV_CYL_BAL_AD_REQ_DC[1] ECU_ADDRESS 0xc0000412 BIT_MASK 0x1 /end MEASUREMENT
/begin MEASUREMENT lv_cyl_bal_ad_req_dc[1] "Flag for homogenous combustion mode for cylinder balancing adaptation requested at active driving cycle" UBYTE _CNV_S_2_RANGE__0___1_CM 1 100. 0. 1. DISPLAY_IDENTIFIER LV_CYL_BAL_AD_REQ_DC[2] ECU_ADDRESS 0xc0000413 BIT_MASK 0x1 /end MEASUREMENT
/begin MEASUREMENT lv_cyl_bal_ad_wg_open_req[0] "Flag for waste gate open requested for cylinder balancing adaptation " UBYTE _CNV_S_2_RANGE__0___1_CM 1 100. 0. 1. DISPLAY_IDENTIFIER LV_CYL_BAL_AD_WG_OPEN_REQ[1] ECU_ADDRESS 0xd0003d90 BIT_MASK 0x1 /end MEASUREMENT
/begin MEASUREMENT lv_cyl_bal_ad_wg_open_req[1] "Flag for waste gate open requested for cylinder balancing adaptation " UBYTE _CNV_S_2_RANGE__0___1_CM 1 100. 0. 1. DISPLAY_IDENTIFIER LV_CYL_BAL_AD_WG_OPEN_REQ[2] ECU_ADDRESS 0xd0003d91 BIT_MASK 0x1 /end MEASUREMENT
/begin MEASUREMENT lv_cyl_bal_ad_wg_open_req_dc[0] "Flag for waste gate open requested for cylinder balancing adaptation at active driving cycle" UBYTE _CNV_S_2_RANGE__0___1_CM 1 100. 0. 1. DISPLAY_IDENTIFIER LV_CYL_BAL_AD_WG_OPEN_REQ_DC[1] ECU_ADDRESS 0xc0000404 BIT_MASK 0x1 /end MEASUREMENT
/begin MEASUREMENT lv_cyl_bal_ad_wg_open_req_dc[1] "Flag for waste gate open requested for cylinder balancing adaptation at active driving cycle" UBYTE _CNV_S_2_RANGE__0___1_CM 1 100. 0. 1. DISPLAY_IDENTIFIER LV_CYL_BAL_AD_WG_OPEN_REQ_DC[2] ECU_ADDRESS 0xc0000405 BIT_MASK 0x1 /end MEASUREMENT
/begin MEASUREMENT lv_cyl_bal_ad_wg_open_dc[0] "Flag for waste gate open for cylinder balancing adaptation at active driving cycle" UBYTE _CNV_S_2_RANGE__0___1_CM 1 100. 0. 1. DISPLAY_IDENTIFIER LV_CYL_BAL_AD_WG_OPEN_DC[1] ECU_ADDRESS 0xc0000406 BIT_MASK 0x1 /end MEASUREMENT
/begin MEASUREMENT lv_cyl_bal_ad_wg_open_dc[1] "Flag for waste gate open for cylinder balancing adaptation at active driving cycle" UBYTE _CNV_S_2_RANGE__0___1_CM 1 100. 0. 1. DISPLAY_IDENTIFIER LV_CYL_BAL_AD_WG_OPEN_DC[2] ECU_ADDRESS 0xc0000407 BIT_MASK 0x1 /end MEASUREMENT
/begin MEASUREMENT t_cyl_bal_ad_dc "Time for cylinder balancing adaptation request at active driving cycle" UWORD _CNV_A_R_LINEAR_____4_CM 1 100. 0. 6553.5 DISPLAY_IDENTIFIER T_CYL_BAL_AD_DC ECU_ADDRESS 0xc00003f8 FORMAT "%6.1" /end MEASUREMENT
/begin MEASUREMENT t_min_cyl_bal_ad_dc "Minimum time gap between cylinder balancing adaptation requests at active driving cycle" UWORD _CNV_A_R_LINEAR_____4_CM 1 100. 0. 6553.5 DISPLAY_IDENTIFIER T_MIN_CYL_BAL_AD_DC ECU_ADDRESS 0xc00003fa FORMAT "%6.1" /end MEASUREMENT
/begin MEASUREMENT lv_cyl_bal_lam_ad_dc "Flag for cylinder balancing lambda adaptation at active driving cycle" UBYTE _CNV_S_2_RANGE__0___1_CM 1 100. 0. 1. DISPLAY_IDENTIFIER LV_CYL_BAL_LAM_AD_DC ECU_ADDRESS 0xd0003d8c BIT_MASK 0x1 /end MEASUREMENT
/begin MEASUREMENT lv_cyl_bal_lam_ad_tmp "Temporary flag for cylinder balancing lambda adaptation at active driving cycle" UBYTE _CNV_S_2_RANGE__0___1_CM 1 100. 0. 1. DISPLAY_IDENTIFIER LV_CYL_BAL_LAM_AD_TMP ECU_ADDRESS 0xc0000415 BIT_MASK 0x1 /end MEASUREMENT
/begin MEASUREMENT lv_cyl_bal_lam_sel_ad_hot_tmp "Temporary flag for cylinder balancing cylinder selective lambda adaptation (hot) at active driving cycle" UBYTE _CNV_S_2_RANGE__0___1_CM 1 100. 0. 1. DISPLAY_IDENTIFIER LV_CYL_BAL_LAM_SEL_AD_HOT_TMP ECU_ADDRESS 0xc0000414 BIT_MASK 0x1 /end MEASUREMENT
/begin CHARACTERISTIC c_t_max_cyl_bal_ad_dc "Maximum time (time control enabled) for cylinder balancing adaptation at active driving cycle" VALUE 0xa10298b8 _REC_VAL_20_u2 6553.5 _CNV_A_R_LINEAR_____4_CM 0. 6553.5 DISPLAY_IDENTIFIER C_T_MAX_CYL_BAL_AD_DC FORMAT "%6.1" /end CHARACTERISTIC
/begin CHARACTERISTIC c_t_min_slow_cyl_bal_ad_dc "Minimum time (time control enabled slow) for cylinder balancing adaptation at active driving cycle" VALUE 0xa102990a _REC_VAL_20_u2 6553.5 _CNV_A_R_LINEAR_____4_CM 0. 6553.5 DISPLAY_IDENTIFIER C_T_MIN_SLOW_CYL_BAL_AD_DC FORMAT "%6.1" /end CHARACTERISTIC
/begin CHARACTERISTIC c_t_min_fast_cyl_bal_ad_dc "Minimum time (time control enabled fast) for cylinder balancing adaptation at active driving cycle" VALUE 0xa10298f2 _REC_VAL_20_u2 6553.5 _CNV_A_R_LINEAR_____4_CM 0. 6553.5 DISPLAY_IDENTIFIER C_T_MIN_FAST_CYL_BAL_AD_DC FORMAT "%6.1" /end CHARACTERISTIC
/begin CHARACTERISTIC c_fac_mff_lam_adj_cyl_bal_dc "Lambda additive threshold for cylinder balancing lambda adaptation at active driving cycle" VALUE 0xa1029390 _REC_VAL_20_s2 99.99847412109381 _CNV_A_R_LINEAR_____110_CM -50. 49.9984741210938 DISPLAY_IDENTIFIER C_FAC_MFF_LAM_ADJ_CYL_BAL_DC FORMAT "%7.3" /end CHARACTERISTIC
/begin CHARACTERISTIC c_wgpwm_max_cyl_bal_wg_open_dc "Maximum waste gate open signal for cylinder balancing adaptation at active driving cycle" VALUE 0xa1029cdc _REC_VAL_20_u2 99.99847412109381 _CNV_A_R_LINEAR_____7_CM 0. 99.99847412109381 DISPLAY_IDENTIFIER C_WGPWM_MAX_CYL_BAL_WG_OPEN_DC /end CHARACTERISTIC
/begin CHARACTERISTIC c_cyl_bal_ad_dc_rst "Reset of cylinder balancing adaptation readiness flags at active driving cycle" VALUE 0xa10292e8 _REC_VAL_20_u1 3. _CNV_S_4_RANGE_C_CY_125_CM 0. 3. DISPLAY_IDENTIFIER C_CYL_BAL_AD_DC_RST /end CHARACTERISTIC
/begin CHARACTERISTIC c_cyl_bal_ad_wg_open_rst "Reset of waste gate open request flags for cylinder balancing adaptation" VALUE 0xa10292ea _REC_VAL_20_u1 1. _CNV_S_2_RANGE_C_CY_126_CM 0. 1. DISPLAY_IDENTIFIER C_CYL_BAL_AD_WG_OPEN_RST /end CHARACTERISTIC
/begin CHARACTERISTIC lc_t_ctl_cyl_bal_ad_dc "Manual switch for time control of cylinder balancing adaptation at active driving cycle " VALUE 0xa1029de5 _REC_VAL_20_u1 1. _CNV_A_R_LINEAR_____0_CM 0. 1. DISPLAY_IDENTIFIER LC_T_CTL_CYL_BAL_AD_DC FORMAT "%1.0" /end CHARACTERISTIC
/begin CHARACTERISTIC lc_cyl_bal_ad_wg_open_rst "Manual switch for waste gate open reset for cylinder balancing adaptation" VALUE 0xa1029d17 _REC_VAL_20_u1 1. _CNV_A_R_LINEAR_____0_CM 0. 1. DISPLAY_IDENTIFIER LC_CYL_BAL_AD_WG_OPEN_RST FORMAT "%1.0" /end CHARACTERISTIC
/begin CHARACTERISTIC c_fac_l_lam_adj_dif_cyl_bal "lambda factor threshold for cylinder balancing lambda adaptation within limits at end of line" VALUE 0xa1029384 _REC_VAL_20_s2 99.99847412109381 _CNV_A_R_LINEAR_____110_CM -50. 49.9984741210938 DISPLAY_IDENTIFIER C_FAC_L_LAM_ADJ_DIF_CYL_BAL FORMAT "%7.3" /end CHARACTERISTIC
/begin CHARACTERISTIC c_fac_mff_lam_adj_dif_cyl_bal "Lambda additive threshold for cylinder balancing lambda adaptation within limits at end of line" VALUE 0xa1029392 _REC_VAL_20_s2 99.99847412109381 _CNV_A_R_LINEAR_____110_CM -50. 49.9984741210938 DISPLAY_IDENTIFIER C_FAC_MFF_LAM_ADJ_DIF_CYL_BAL FORMAT "%7.3" /end CHARACTERISTIC
/begin CHARACTERISTIC c_t_min_cyl_bal_er_ad_dyn "Minimum time for cylinder balancing engine roughness adaptation within limits at end of line" VALUE 0xa10298ea _REC_VAL_20_u2 6553.5 _CNV_A_R_LINEAR_____4_CM 0. 6553.5 DISPLAY_IDENTIFIER C_T_MIN_CYL_BAL_ER_AD_DYN FORMAT "%6.1" /end CHARACTERISTIC
/begin CHARACTERISTIC c_t_max_cyl_bal_er_ad "maximum time for cylinder balancing engine roughness adaptation at end of line" VALUE 0xa10298ba _REC_VAL_20_u2 6553.5 _CNV_A_R_LINEAR_____4_CM 0. 6553.5 DISPLAY_IDENTIFIER C_T_MAX_CYL_BAL_ER_AD FORMAT "%6.1" /end CHARACTERISTIC
/begin CHARACTERISTIC c_t_dec_cyl_bal_er_ad_dyn "Time decrement value for cylinder balancing engine roughness adaptation within limits at end of line" VALUE 0xa1029834 _REC_VAL_20_u2 6553.5 _CNV_A_R_LINEAR_____4_CM 0. 6553.5 DISPLAY_IDENTIFIER C_T_DEC_CYL_BAL_ER_AD_DYN FORMAT "%6.1" /end CHARACTERISTIC
/begin CHARACTERISTIC c_t_max_cyl_bal_lam_sel_ad "Maximum time for cylinder balancing cylinder selective lambda adaptation at end of line" VALUE 0xa10298be _REC_VAL_20_u2 6553.5 _CNV_A_R_LINEAR_____4_CM 0. 6553.5 DISPLAY_IDENTIFIER C_T_MAX_CYL_BAL_LAM_SEL_AD FORMAT "%6.1" /end CHARACTERISTIC
/begin CHARACTERISTIC c_t_min_cyl_bal_lam_sel_ad_cold "Minimum time for cylinder balancing cylinder selective lambda adaptation (cold) within limits at end of line" VALUE 0xa10298ec _REC_VAL_20_u2 6553.5 _CNV_A_R_LINEAR_____4_CM 0. 6553.5 DISPLAY_IDENTIFIER C_T_MIN_CYL_BAL_LAM_SEL_AD_COLD FORMAT "%6.1" /end CHARACTERISTIC
/begin CHARACTERISTIC c_t_min_cyl_bal_lam_sel_ad_hot "Minimum time for cylinder balancing cylinder selective lambda adaptation (hot) within limits at end of line" VALUE 0xa10298ee _REC_VAL_20_u2 6553.5 _CNV_A_R_LINEAR_____4_CM 0. 6553.5 DISPLAY_IDENTIFIER C_T_MIN_CYL_BAL_LAM_SEL_AD_HOT FORMAT "%6.1" /end CHARACTERISTIC
/begin CHARACTERISTIC c_t_dec_cyl_bal_lam_sel_cbk_ad "Time decrement value for cylinder balancing cylinder selectiv lambda adaptation within limits at end of line" VALUE 0xa1029836 _REC_VAL_20_u2 6553.5 _CNV_A_R_LINEAR_____4_CM 0. 6553.5 DISPLAY_IDENTIFIER C_T_DEC_CYL_BAL_LAM_SEL_CBK_AD FORMAT "%6.1" /end CHARACTERISTIC
/begin CHARACTERISTIC c_t_max_cyl_bal_lam_ad "Maximum time for cylinder balancing lambda adaptation at end of line" VALUE 0xa10298bc _REC_VAL_20_u2 1310.7 _CNV_A_R_LINEAR_____107_CM 0. 1310.7 DISPLAY_IDENTIFIER C_T_MAX_CYL_BAL_LAM_AD FORMAT "%7.2" /end CHARACTERISTIC
/begin CHARACTERISTIC c_ctr_min_cyl_bal_lam_ad_fac "Minimum counter value for cylinder balancing lambda adaptation (multiple) within limits at end of line" VALUE 0xa10292ae _REC_VAL_20_u2 65535. _CNV_A_R_LINEAR_____0_CM 0. 65535. DISPLAY_IDENTIFIER C_CTR_MIN_CYL_BAL_LAM_AD_FAC FORMAT "%5.0" /end CHARACTERISTIC
/begin CHARACTERISTIC c_ctr_min_cyl_bal_lam_ad_add "Minimum counter value for cylinder balancing lambda adaptation (additive) within limits at end of line" VALUE 0xa10292ac _REC_VAL_20_u2 65535. _CNV_A_R_LINEAR_____0_CM 0. 65535. DISPLAY_IDENTIFIER C_CTR_MIN_CYL_BAL_LAM_AD_ADD FORMAT "%5.0" /end CHARACTERISTIC
/begin CHARACTERISTIC c_ctr_dec_cyl_bal_lam_cbk_ad "Counter decrement value for cylinder balancing lambda adaptation within limits at end of line" VALUE 0xa102925c _REC_VAL_20_u2 65535. _CNV_A_R_LINEAR_____0_CM 0. 65535. DISPLAY_IDENTIFIER C_CTR_DEC_CYL_BAL_LAM_CBK_AD FORMAT "%5.0" /end CHARACTERISTIC
/begin CHARACTERISTIC lc_cyl_bal_ad_eol_rst "Manual switch for cylinder balancing adaptation reset at end of line" VALUE 0xa1029d16 _REC_VAL_20_u1 1. _CNV_A_R_LINEAR_____0_CM 0. 1. DISPLAY_IDENTIFIER LC_CYL_BAL_AD_EOL_RST FORMAT "%1.0" /end CHARACTERISTIC
/begin CHARACTERISTIC c_cyl_bal_ad_eol_rst "reset of cylinder balancing adaptation readiness flags at end of line" VALUE 0xa10292e9 _REC_VAL_20_u1 6. _CNV_S_7_RANGE_C_CY_127_CM 0. 6. DISPLAY_IDENTIFIER C_CYL_BAL_AD_EOL_RST /end CHARACTERISTIC
/begin CHARACTERISTIC lc_cyl_bal_cord_eol_stop_man "Logical constant for manual stop (=1) of cylinder balancing coordination at end of line" VALUE 0xa1029d19 _REC_VAL_20_u1 1. _CNV_A_R_LINEAR_____0_CM 0. 1. DISPLAY_IDENTIFIER LC_CYL_BAL_CORD_EOL_STOP_MAN FORMAT "%1.0" /end CHARACTERISTIC
/begin AXIS_PTS ldp_n_32_ip_er_stnd_mmv_dif_dyw "" 0xa1020df8 n_32 _REC_AXS_20_u1 8160. _CNV_A_R_LINEAR_____9_CM 6 0. 8160. FORMAT "%4.0" /end AXIS_PTS
/begin CHARACTERISTIC ip_er_stnd_mmv_dif_bal_dyw "Dynamic window threshold for cylinder balancing engine roughness adaptation within limits at end of line" CURVE 0xa1023400 _REC_CUR_20_u2_u1 651.5500579833979 _CNV_A_R_LINEAR_____128_CM -325.78 325.770057983398 DISPLAY_IDENTIFIER IP_ER_STND_MMV_DIF_BAL_DYW FORMAT "%8.3"
 /begin AXIS_DESCR COM_AXIS n_32 _CNV_A_R_LINEAR_____9_CM 6 0. 8160. FORMAT "%4.0" AXIS_PTS_REF ldp_n_32_ip_er_stnd_mmv_dif_dyw /end AXIS_DESCR
/end CHARACTERISTIC
/begin MEASUREMENT lv_cyl_bal_lam_ad_eol "Flag for cylinder balancing lambda adaptation at end of line finished" UBYTE _CNV_S_2_RANGE__0___1_CM 1 100. 0. 1. DISPLAY_IDENTIFIER LV_CYL_BAL_LAM_AD_EOL ECU_ADDRESS 0xd0003d98 BIT_MASK 0x1 /end MEASUREMENT
/begin MEASUREMENT lv_cyl_bal_er_ad_fac_eol "Flag for cylinder balancing multiple engine roughness adaptation at end of line finished" UBYTE _CNV_S_2_RANGE__0___1_CM 1 100. 0. 1. DISPLAY_IDENTIFIER LV_CYL_BAL_ER_AD_FAC_EOL ECU_ADDRESS 0xd0003d99 BIT_MASK 0x1 /end MEASUREMENT
/begin MEASUREMENT lv_cyl_bal_er_ad_add_eol "Flag for cylinder balancing additive engine roughness adaptation at end of line finished" UBYTE _CNV_S_2_RANGE__0___1_CM 1 100. 0. 1. DISPLAY_IDENTIFIER LV_CYL_BAL_ER_AD_ADD_EOL ECU_ADDRESS 0xd0003d9a BIT_MASK 0x1 /end MEASUREMENT
/begin MEASUREMENT lv_cyl_bal_lam_sel_ad_cold_eol "Flag for cylinder balancing cylinder selective lambda adaptation (cold) at end of line finished" UBYTE _CNV_S_2_RANGE__0___1_CM 1 100. 0. 1. DISPLAY_IDENTIFIER LV_CYL_BAL_LAM_SEL_AD_COLD_EOL ECU_ADDRESS 0xd0003d9b BIT_MASK 0x1 /end MEASUREMENT
/begin MEASUREMENT lv_cyl_bal_lam_sel_ad_hot_eol "Flag for cylinder balancing cylinder selective lambda adaptation (hot) at end of line finished" UBYTE _CNV_S_2_RANGE__0___1_CM 1 100. 0. 1. DISPLAY_IDENTIFIER LV_CYL_BAL_LAM_SEL_AD_HOT_EOL ECU_ADDRESS 0xd0003d9c BIT_MASK 0x1 /end MEASUREMENT
/begin MEASUREMENT state_cyl_bal_er_ad_eol "State of cylinder balancing engine roughness adaptation at end of line" UBYTE _CNV_S_3_RANGE_STAT_129_CM 1 100. 0. 2. DISPLAY_IDENTIFIER STATE_CYL_BAL_ER_AD_EOL ECU_ADDRESS 0xc0000438 /end MEASUREMENT
/begin MEASUREMENT state_cyl_bal_lam_sel_ad_eol "State of cylinder balancing lambda adaptation at end of line" UBYTE _CNV_S_3_RANGE_STAT_129_CM 1 100. 0. 2. DISPLAY_IDENTIFIER STATE_CYL_BAL_LAM_SEL_AD_EOL ECU_ADDRESS 0xc000043a /end MEASUREMENT
/begin MEASUREMENT state_cyl_bal_lam_ad_eol "State of cylinder balancing cylinder selective lamda adaptation at end of line" UBYTE _CNV_S_3_RANGE_STAT_129_CM 1 100. 0. 2. DISPLAY_IDENTIFIER STATE_CYL_BAL_LAM_AD_EOL ECU_ADDRESS 0xc0000439 /end MEASUREMENT
/begin MEASUREMENT t_cyl_bal_er_ad "Time for cylinder balancing engine roughness adaptation at end of line" UWORD _CNV_A_R_LINEAR_____4_CM 1 100. 0. 6553.5 DISPLAY_IDENTIFIER T_CYL_BAL_ER_AD ECU_ADDRESS 0xc0000418 FORMAT "%6.1" /end MEASUREMENT
/begin MEASUREMENT t_cyl_bal_lam_sel_ad "Time for cylinder balancing cylinder selective lambda adaptation at end of line" UWORD _CNV_A_R_LINEAR_____4_CM 1 100. 0. 6553.5 DISPLAY_IDENTIFIER T_CYL_BAL_LAM_SEL_AD ECU_ADDRESS 0xc000041a FORMAT "%6.1" /end MEASUREMENT
/begin MEASUREMENT t_cyl_bal_lam_ad "Time for cylinder balancing lambda adaptation at end of line" UWORD _CNV_A_R_LINEAR_____107_CM 1 100. 0. 1310.7 DISPLAY_IDENTIFIER T_CYL_BAL_LAM_AD ECU_ADDRESS 0xc000041c FORMAT "%7.2" /end MEASUREMENT
/begin MEASUREMENT t_cyl_bal_er_ad_dyw "time for cylinder balancing engine roughness adaptation at end of line within limits" UWORD _CNV_A_R_LINEAR_____4_CM 1 100. 0. 6553.5 DISPLAY_IDENTIFIER T_CYL_BAL_ER_AD_DYW ECU_ADDRESS 0xc000041e FORMAT "%6.1" /end MEASUREMENT
/begin MEASUREMENT er_stnd_mmv_dif_bal_dyw "Dynamic window value for cylinder balancing engine roughness adaptation at end of line" SWORD _CNV_A_R_LINEAR_____130_CM 1 100. -325.78 325.770057983398 DISPLAY_IDENTIFIER ER_STND_MMV_DIF_BAL_DYW ECU_ADDRESS 0xc0000428 FORMAT "%8.3" /end MEASUREMENT
/begin MEASUREMENT er_stnd_mmv_dif_bal_max_dyw "Maximum er_stnd_mmv_bal value for dynamic window calculation at end of line" SWORD _CNV_A_R_LINEAR_____130_CM 1 100. -325.78 325.770057983398 DISPLAY_IDENTIFIER ER_STND_MMV_DIF_BAL_MAX_DYW ECU_ADDRESS 0xc000042a FORMAT "%8.3" /end MEASUREMENT
/begin MEASUREMENT er_stnd_mmv_dif_bal_min_dyw "Minimum er_stnd_mmv_bal value for dynamic window calculation at end of line" SWORD _CNV_A_R_LINEAR_____130_CM 1 100. -325.78 325.770057983398 DISPLAY_IDENTIFIER ER_STND_MMV_DIF_BAL_MIN_DYW ECU_ADDRESS 0xc000042c FORMAT "%8.3" /end MEASUREMENT
/begin MEASUREMENT t_cyl_bal_lam_sel_cbk_ad[0] "Time for cylinder balancing cylinder selective lambda adaptation at end of line within limits" UWORD _CNV_A_R_LINEAR_____4_CM 1 100. 0. 6553.5 DISPLAY_IDENTIFIER T_CYL_BAL_LAM_SEL_CBK_AD[1] ECU_ADDRESS 0xc0000424 FORMAT "%6.1" /end MEASUREMENT
/begin MEASUREMENT t_cyl_bal_lam_sel_cbk_ad[1] "Time for cylinder balancing cylinder selective lambda adaptation at end of line within limits" UWORD _CNV_A_R_LINEAR_____4_CM 1 100. 0. 6553.5 DISPLAY_IDENTIFIER T_CYL_BAL_LAM_SEL_CBK_AD[2] ECU_ADDRESS 0xc0000426 FORMAT "%6.1" /end MEASUREMENT
/begin MEASUREMENT lv_state_cyl_bal_sel_chg_ad "Flag for cylinder balancing cylinder selective lambda adaptation to state adaptation requested" UBYTE _CNV_S_2_RANGE__0___1_CM 1 100. 0. 1. DISPLAY_IDENTIFIER LV_STATE_CYL_BAL_SEL_CHG_AD ECU_ADDRESS 0xc0000430 BIT_MASK 0x1 /end MEASUREMENT
/begin MEASUREMENT lv_state_cyl_bal_sel_chg_wait[0] "Flag for cylinder balancing cylinder selective lambda adaptation to state wait requested" UBYTE _CNV_S_2_RANGE__0___1_CM 1 100. 0. 1. DISPLAY_IDENTIFIER LV_STATE_CYL_BAL_SEL_CHG_WAIT[1] ECU_ADDRESS 0xc0000432 BIT_MASK 0x1 /end MEASUREMENT
/begin MEASUREMENT lv_state_cyl_bal_sel_chg_wait[1] "Flag for cylinder balancing cylinder selective lambda adaptation to state wait requested" UBYTE _CNV_S_2_RANGE__0___1_CM 1 100. 0. 1. DISPLAY_IDENTIFIER LV_STATE_CYL_BAL_SEL_CHG_WAIT[2] ECU_ADDRESS 0xc0000433 BIT_MASK 0x1 /end MEASUREMENT
/begin MEASUREMENT lv_cyl_bal_lam_sel_ad_cold[0] "Flag for cylinder balancing cylinder selective lambda adaptation (cold) exhaust bank specific" UBYTE _CNV_S_2_RANGE__0___1_CM 1 100. 0. 1. DISPLAY_IDENTIFIER LV_CYL_BAL_LAM_SEL_AD_COLD[1] ECU_ADDRESS 0xd0003d9e BIT_MASK 0x1 /end MEASUREMENT
/begin MEASUREMENT lv_cyl_bal_lam_sel_ad_cold[1] "Flag for cylinder balancing cylinder selective lambda adaptation (cold) exhaust bank specific" UBYTE _CNV_S_2_RANGE__0___1_CM 1 100. 0. 1. DISPLAY_IDENTIFIER LV_CYL_BAL_LAM_SEL_AD_COLD[2] ECU_ADDRESS 0xd0003d9f BIT_MASK 0x1 /end MEASUREMENT
/begin MEASUREMENT lv_cyl_bal_lam_sel_ad_hot[0] "Flag for cylinder balancing cylinder selective lambda adaptation (hot) exhaust bank specific" UBYTE _CNV_S_2_RANGE__0___1_CM 1 100. 0. 1. DISPLAY_IDENTIFIER LV_CYL_BAL_LAM_SEL_AD_HOT[1] ECU_ADDRESS 0xd0003da0 BIT_MASK 0x1 /end MEASUREMENT
/begin MEASUREMENT lv_cyl_bal_lam_sel_ad_hot[1] "Flag for cylinder balancing cylinder selective lambda adaptation (hot) exhaust bank specific" UBYTE _CNV_S_2_RANGE__0___1_CM 1 100. 0. 1. DISPLAY_IDENTIFIER LV_CYL_BAL_LAM_SEL_AD_HOT[2] ECU_ADDRESS 0xd0003da1 BIT_MASK 0x1 /end MEASUREMENT
/begin MEASUREMENT ctr_cyl_bal_lam_cbk_ad[0] "Counter for cylinder balancing lambda adaptation at end of line within limits" UWORD _CNV_A_R_LINEAR_____0_CM 1 100. 0. 65535. DISPLAY_IDENTIFIER CTR_CYL_BAL_LAM_CBK_AD[1] ECU_ADDRESS 0xc0000420 FORMAT "%5.0" /end MEASUREMENT
/begin MEASUREMENT ctr_cyl_bal_lam_cbk_ad[1] "Counter for cylinder balancing lambda adaptation at end of line within limits" UWORD _CNV_A_R_LINEAR_____0_CM 1 100. 0. 65535. DISPLAY_IDENTIFIER CTR_CYL_BAL_LAM_CBK_AD[2] ECU_ADDRESS 0xc0000422 FORMAT "%5.0" /end MEASUREMENT
/begin MEASUREMENT lv_state_cyl_bal_lam_chg_ad "Flag for cylinder balancing lambda adaptation to state adaptation requested" UBYTE _CNV_S_2_RANGE__0___1_CM 1 100. 0. 1. DISPLAY_IDENTIFIER LV_STATE_CYL_BAL_LAM_CHG_AD ECU_ADDRESS 0xc0000431 BIT_MASK 0x1 /end MEASUREMENT
/begin MEASUREMENT lv_state_cyl_bal_lam_chg_wait[0] "Flag for cylinder balancing lambda adaptation to state wait requested" UBYTE _CNV_S_2_RANGE__0___1_CM 1 100. 0. 1. DISPLAY_IDENTIFIER LV_STATE_CYL_BAL_LAM_CHG_WAIT[1] ECU_ADDRESS 0xc0000434 BIT_MASK 0x1 /end MEASUREMENT
/begin MEASUREMENT lv_state_cyl_bal_lam_chg_wait[1] "Flag for cylinder balancing lambda adaptation to state wait requested" UBYTE _CNV_S_2_RANGE__0___1_CM 1 100. 0. 1. DISPLAY_IDENTIFIER LV_STATE_CYL_BAL_LAM_CHG_WAIT[2] ECU_ADDRESS 0xc0000435 BIT_MASK 0x1 /end MEASUREMENT
/begin MEASUREMENT lv_cyl_bal_lam_ad_fac[0] "Flag for cylinder balancing lambda adaptation (multiple) exhaust bank specific" UBYTE _CNV_S_2_RANGE__0___1_CM 1 100. 0. 1. DISPLAY_IDENTIFIER LV_CYL_BAL_LAM_AD_FAC[1] ECU_ADDRESS 0xd0003da2 BIT_MASK 0x1 /end MEASUREMENT
/begin MEASUREMENT lv_cyl_bal_lam_ad_fac[1] "Flag for cylinder balancing lambda adaptation (multiple) exhaust bank specific" UBYTE _CNV_S_2_RANGE__0___1_CM 1 100. 0. 1. DISPLAY_IDENTIFIER LV_CYL_BAL_LAM_AD_FAC[2] ECU_ADDRESS 0xd0003da3 BIT_MASK 0x1 /end MEASUREMENT
/begin CHARACTERISTIC c_lamb_delta_cyl_sel_cq_fil "Delta lambda threshold for cylinder balancing cylinder selective lambda adaptation within limits at the end of the line" VALUE 0xa10294d0 _REC_VAL_20_u2 0.9999847412109381 _CNV_A_R_LINEAR_____68_CM 0. 0.9999847412109381 DISPLAY_IDENTIFIER C_LAMB_DELTA_CYL_SEL_CQ_FIL FORMAT "%7.5" /end CHARACTERISTIC
/begin MEASUREMENT lv_cyl_bal_lam_ad_add[0] "flag for cylinder balancing lambda adaptation (additive) exhaust bank specific" UBYTE _CNV_S_2_RANGE__0___1_CM 1 100. 0. 1. DISPLAY_IDENTIFIER LV_CYL_BAL_LAM_AD_ADD[1] ECU_ADDRESS 0xd0003da4 BIT_MASK 0x1 /end MEASUREMENT
/begin MEASUREMENT lv_cyl_bal_lam_ad_add[1] "flag for cylinder balancing lambda adaptation (additive) exhaust bank specific" UBYTE _CNV_S_2_RANGE__0___1_CM 1 100. 0. 1. DISPLAY_IDENTIFIER LV_CYL_BAL_LAM_AD_ADD[2] ECU_ADDRESS 0xd0003da5 BIT_MASK 0x1 /end MEASUREMENT
/begin MEASUREMENT lv_cyl_bal_ad_wg_open_req_eol[0] "Flag for waste gate open requested for cylinder balancing adaptation at end of line" UBYTE _CNV_S_2_RANGE__0___1_CM 1 100. 0. 1. DISPLAY_IDENTIFIER LV_CYL_BAL_AD_WG_OPEN_REQ_EOL[1] ECU_ADDRESS 0xd0003da6 BIT_MASK 0x1 /end MEASUREMENT
/begin MEASUREMENT lv_cyl_bal_ad_wg_open_req_eol[1] "Flag for waste gate open requested for cylinder balancing adaptation at end of line" UBYTE _CNV_S_2_RANGE__0___1_CM 1 100. 0. 1. DISPLAY_IDENTIFIER LV_CYL_BAL_AD_WG_OPEN_REQ_EOL[2] ECU_ADDRESS 0xd0003da7 BIT_MASK 0x1 /end MEASUREMENT
/begin MEASUREMENT fup_efp_sp "Fuel pressure setpoint of electrical fuel pump" UWORD _CNV_A_R_LINEAR_____153_CM 1 100. 0. 173888. DISPLAY_IDENTIFIER FUP_EFP_SP ECU_ADDRESS 0xd0004d50 FORMAT "%8.1" /end MEASUREMENT
/begin MEASUREMENT fup_efp_sp_tmp "Temporary value of fuel pressure setpoint of electrical fuel pump before limitation" UWORD _CNV_A_R_LINEAR_____153_CM 1 100. 0. 173888. DISPLAY_IDENTIFIER FUP_EFP_SP_TMP ECU_ADDRESS 0xc00006ac FORMAT "%8.1" /end MEASUREMENT
/begin CHARACTERISTIC c_fup_efp_sp_man "Manual FUP_EFP_SP" VALUE 0xa1029430 _REC_VAL_20_u2 173888. _CNV_A_R_LINEAR_____153_CM 0. 173888. DISPLAY_IDENTIFIER C_FUP_EFP_SP_MAN FORMAT "%8.1" /end CHARACTERISTIC
/begin CHARACTERISTIC c_fup_efp_sp_ext_req "External FUP_EFP_SP" VALUE 0xa1029428 _REC_VAL_20_u2 173888. _CNV_A_R_LINEAR_____153_CM 0. 173888. DISPLAY_IDENTIFIER C_FUP_EFP_SP_EXT_REQ FORMAT "%8.1" /end CHARACTERISTIC
/begin CHARACTERISTIC c_fup_efp_sp_hpp_lih "Fuel pressure setpoint for high pressure pump limp home " VALUE 0xa102942a _REC_VAL_20_u2 173888. _CNV_A_R_LINEAR_____153_CM 0. 173888. DISPLAY_IDENTIFIER C_FUP_EFP_SP_HPP_LIH FORMAT "%8.1" /end CHARACTERISTIC
/begin CHARACTERISTIC c_fup_efp_sp_lim_inc "Increment for fuel pressure setpoint limitation" VALUE 0xa102942e _REC_VAL_20_u2 173888. _CNV_A_R_LINEAR_____153_CM 0. 173888. DISPLAY_IDENTIFIER C_FUP_EFP_SP_LIM_INC FORMAT "%8.1" /end CHARACTERISTIC
/begin CHARACTERISTIC c_fup_efp_sp_lim_dec "Decrement for fuel pressure setpoint limitation" VALUE 0xa102942c _REC_VAL_20_u2 173888. _CNV_A_R_LINEAR_____153_CM 0. 173888. DISPLAY_IDENTIFIER C_FUP_EFP_SP_LIM_DEC FORMAT "%8.1" /end CHARACTERISTIC
/begin CHARACTERISTIC lc_fup_efp_sp_man_act "Switch for manual FUP_EFP_SP" VALUE 0xa1029d40 _REC_VAL_20_u1 1. _CNV_A_R_LINEAR_____0_CM 0. 1. DISPLAY_IDENTIFIER LC_FUP_EFP_SP_MAN_ACT FORMAT "%1.0" /end CHARACTERISTIC
/begin CHARACTERISTIC c_fup_efp_sp_puc "Low fuel pressure setpoint in PU/PUC" VALUE 0xa1029432 _REC_VAL_20_u2 173888. _CNV_A_R_LINEAR_____153_CM 0. 173888. DISPLAY_IDENTIFIER C_FUP_EFP_SP_PUC FORMAT "%8.1" /end CHARACTERISTIC
/begin CHARACTERISTIC c_fup_efp_sp_pwl "Low fuel pressure setpoint during power latch phase of EFP" VALUE 0xa1029434 _REC_VAL_20_u2 173888. _CNV_A_R_LINEAR_____153_CM 0. 173888. DISPLAY_IDENTIFIER C_FUP_EFP_SP_PWL FORMAT "%8.1" /end CHARACTERISTIC
/begin AXIS_PTS ldp_mff_sp_fup_ctl_ip_efp_sp "" 0xa1020d28 mff_sp_fup_ctl _REC_AXS_20_u2 1389. _CNV_A_R_LINEAR_____108_CM 4 0. 1389. FORMAT "%7.2" /end AXIS_PTS
/begin AXIS_PTS ldp_n_32_ip_fup_efp_sp "" 0xa1020e22 n_32 _REC_AXS_20_u1 8160. _CNV_A_R_LINEAR_____9_CM 4 0. 8160. FORMAT "%4.0" /end AXIS_PTS
/begin CHARACTERISTIC ip_fup_efp_sp "Fuel pressure setpoint of low pressure pump for normal operation" MAP 0xa1024a34 _REC_MAP_20_u2_u2_u1 173888. _CNV_A_R_LINEAR_____153_CM 0. 173888. DISPLAY_IDENTIFIER IP_FUP_EFP_SP FORMAT "%8.1"
 /begin AXIS_DESCR COM_AXIS mff_sp_fup_ctl _CNV_A_R_LINEAR_____108_CM 4 0. 1389. FORMAT "%7.2" AXIS_PTS_REF ldp_mff_sp_fup_ctl_ip_efp_sp /end AXIS_DESCR
 /begin AXIS_DESCR COM_AXIS n_32 _CNV_A_R_LINEAR_____9_CM 4 0. 8160. FORMAT "%4.0" AXIS_PTS_REF ldp_n_32_ip_fup_efp_sp /end AXIS_DESCR
/end CHARACTERISTIC
/begin AXIS_PTS ldp_tfu_ip_fup_efp_sp "" 0xa1021348 online_dummy _REC_AXS_20_u1 190.5 _CNV_A_R_LINEAR_____16_CM 8 -48. 142.5 FORMAT "%6.2" /end AXIS_PTS
/begin CHARACTERISTIC ip_fup_efp_sp_min "Minimum fuel pressure setpoint of low pressure pump" MAP 0xa1024a64 _REC_MAP_20_u2_u2_u1 173888. _CNV_A_R_LINEAR_____153_CM 0. 173888. DISPLAY_IDENTIFIER IP_FUP_EFP_SP_MIN FORMAT "%8.1"
 /begin AXIS_DESCR COM_AXIS mff_sp_fup_ctl _CNV_A_R_LINEAR_____108_CM 8 0. 1389. FORMAT "%7.2" AXIS_PTS_REF ldpm_mff_sp_fup_ctl_fusl /end AXIS_DESCR
 /begin AXIS_DESCR COM_AXIS online_dummy _CNV_A_R_LINEAR_____16_CM 8 -48. 142.5 FORMAT "%6.2" AXIS_PTS_REF ldp_tfu_ip_fup_efp_sp /end AXIS_DESCR
/end CHARACTERISTIC
/begin AXIS_PTS ldpm_mff_sp_fup_ctl_fusl "" 0xa1021cb4 mff_sp_fup_ctl _REC_AXS_20_u2 1389. _CNV_A_R_LINEAR_____108_CM 8 0. 1389. FORMAT "%7.2" /end AXIS_PTS
/begin AXIS_PTS ldp_tco_st_ip_t_fup_efp_sp_hst "" 0xa10212c4 tco_st _REC_AXS_20_u1 190.5 _CNV_A_R_LINEAR_____16_CM 3 -48. 142.5 FORMAT "%6.2" /end AXIS_PTS
/begin CHARACTERISTIC ip_fup_efp_sp_hst "Map with the FUP_EFP setpoint for the hot start" CURVE 0xa1024a54 _REC_CUR_20_u2_u2 173888. _CNV_A_R_LINEAR_____153_CM 0. 173888. DISPLAY_IDENTIFIER IP_FUP_EFP_SP_HST FORMAT "%8.1"
 /begin AXIS_DESCR COM_AXIS mff_sp_fup_ctl _CNV_A_R_LINEAR_____108_CM 8 0. 1389. FORMAT "%7.2" AXIS_PTS_REF ldpm_mff_sp_fup_ctl_fusl /end AXIS_DESCR
/end CHARACTERISTIC
/begin CHARACTERISTIC ip_t_fup_efp_sp_hst "Map with the time for the FUP_EFP setpoint for the hot start" CURVE 0xa1027c50 _REC_CUR_20_u2_u1 655.34 _CNV_A_R_LINEAR_____3_CM 1.e-002 655.35 DISPLAY_IDENTIFIER IP_T_FUP_EFP_SP_HST FORMAT "%6.2"
 /begin AXIS_DESCR COM_AXIS tco_st _CNV_A_R_LINEAR_____16_CM 3 -48. 142.5 FORMAT "%6.2" AXIS_PTS_REF ldp_tco_st_ip_t_fup_efp_sp_hst /end AXIS_DESCR
/end CHARACTERISTIC
/begin MEASUREMENT vff_efp_add "Additive value of the amount of fuel from the pump" UBYTE _CNV_A_R_LINEAR_____154_CM 1 100. 0. 255. DISPLAY_IDENTIFIER VFF_EFP_ADD ECU_ADDRESS 0xd00039f9 FORMAT "%3.0" /end MEASUREMENT
/begin MEASUREMENT state_efp_tran "States of electrical fuel pump function" UBYTE _CNV_S_11_RANGE_STAT_155_CM 1 100. 0. 10. DISPLAY_IDENTIFIER STATE_EFP_TRAN ECU_ADDRESS 0xd00039f8 /end MEASUREMENT
/begin MEASUREMENT t_efp "Time counter for activated EFP" UWORD _CNV_A_R_LINEAR_____3_CM 1 100. 0. 655.35 DISPLAY_IDENTIFIER T_EFP ECU_ADDRESS 0xc00005e0 FORMAT "%6.2" /end MEASUREMENT
/begin MEASUREMENT lv_pump_pre_run_stop "Logical bit indicating pre run of the pump stopped" UBYTE _CNV_S_2_RANGE__0___1_CM 1 100. 0. 1. DISPLAY_IDENTIFIER LV_PUMP_PRE_RUN_STOP ECU_ADDRESS 0xc00005e8 BIT_MASK 0x1 /end MEASUREMENT
/begin MEASUREMENT lv_err_fup_efp_lih "Logical bit indicating limp home of EFP pump requested" UBYTE _CNV_S_2_RANGE__0___1_CM 1 100. 0. 1. DISPLAY_IDENTIFIER LV_ERR_FUP_EFP_LIH ECU_ADDRESS 0xc00005e7 BIT_MASK 0x1 /end MEASUREMENT
/begin MEASUREMENT fup_efp_stop_h "Pressure at observation stop for the pressure increase" UWORD _CNV_A_R_LINEAR_____153_CM 1 100. 0. 173888. DISPLAY_IDENTIFIER FUP_EFP_STOP_H ECU_ADDRESS 0xd0004d64 FORMAT "%8.1" /end MEASUREMENT
/begin MEASUREMENT fup_efp_st_h "Pressure at observation start for the pressure increase" UWORD _CNV_A_R_LINEAR_____153_CM 1 100. 0. 173888. DISPLAY_IDENTIFIER FUP_EFP_ST_H ECU_ADDRESS 0xd0004d66 FORMAT "%8.1" /end MEASUREMENT
/begin MEASUREMENT tco_mem_fup_efp_h "Coolant temperature for the pressure increase" UBYTE _CNV_A_R_LINEAR_____16_CM 1 100. -48. 142.5 DISPLAY_IDENTIFIER TCO_MEM_FUP_EFP_H ECU_ADDRESS 0xd00039fb FORMAT "%6.2" /end MEASUREMENT
/begin MEASUREMENT t_efp_mem_h "Time for the pressure increase" UWORD _CNV_A_R_LINEAR_____3_CM 1 100. 0. 655.35 DISPLAY_IDENTIFIER T_EFP_MEM_H ECU_ADDRESS 0xd0004d68 FORMAT "%6.2" /end MEASUREMENT
/begin MEASUREMENT fup_efp_stop_l "Pressure at observation stop for the pressure decrease" UWORD _CNV_A_R_LINEAR_____153_CM 1 100. 0. 173888. DISPLAY_IDENTIFIER FUP_EFP_STOP_L ECU_ADDRESS 0xd0004d6a FORMAT "%8.1" /end MEASUREMENT
/begin MEASUREMENT fup_efp_tmp_l "Temporary pressure at observation start for the pressure decrease" UWORD _CNV_A_R_LINEAR_____153_CM 1 100. 0. 173888. DISPLAY_IDENTIFIER FUP_EFP_TMP_L ECU_ADDRESS 0xc00005de FORMAT "%8.1" /end MEASUREMENT
/begin MEASUREMENT fup_efp_tmp_h "Temporary pressure at observation start for the pressure increase" UWORD _CNV_A_R_LINEAR_____153_CM 1 100. 0. 173888. DISPLAY_IDENTIFIER FUP_EFP_TMP_H ECU_ADDRESS 0xc00005da FORMAT "%8.1" /end MEASUREMENT
/begin MEASUREMENT fup_efp_st_l "Pressure at observation start for the pressure decrease" UWORD _CNV_A_R_LINEAR_____153_CM 1 100. 0. 173888. DISPLAY_IDENTIFIER FUP_EFP_ST_L ECU_ADDRESS 0xd0004d60 FORMAT "%8.1" /end MEASUREMENT
/begin MEASUREMENT tco_mem_fup_efp_l "Coolant temperature for the pressure decrease" UBYTE _CNV_A_R_LINEAR_____16_CM 1 100. -48. 142.5 DISPLAY_IDENTIFIER TCO_MEM_FUP_EFP_L ECU_ADDRESS 0xd00039fa FORMAT "%6.2" /end MEASUREMENT
/begin MEASUREMENT tco_tmp_l "Temporary coolant temperature for the pressure decrease" UBYTE _CNV_A_R_LINEAR_____16_CM 1 100. -48. 142.5 DISPLAY_IDENTIFIER TCO_TMP_L ECU_ADDRESS 0xc00005e4 FORMAT "%6.2" /end MEASUREMENT
/begin MEASUREMENT tco_tmp_h "Temporary coolant temperature for the pressure increase" UBYTE _CNV_A_R_LINEAR_____16_CM 1 100. -48. 142.5 DISPLAY_IDENTIFIER TCO_TMP_H ECU_ADDRESS 0xc00005e5 FORMAT "%6.2" /end MEASUREMENT
/begin MEASUREMENT t_efp_mem_l "Time for the pressure decrease" UWORD _CNV_A_R_LINEAR_____3_CM 1 100. 0. 655.35 DISPLAY_IDENTIFIER T_EFP_MEM_L ECU_ADDRESS 0xd0004d62 FORMAT "%6.2" /end MEASUREMENT
/begin MEASUREMENT t_efp_act_l "Timer for the pressure decrease" UWORD _CNV_A_R_LINEAR_____3_CM 1 100. 0. 655.35 DISPLAY_IDENTIFIER T_EFP_ACT_L ECU_ADDRESS 0xc00005d8 FORMAT "%6.2" /end MEASUREMENT
/begin MEASUREMENT t_efp_act_h "Timer for the pressure increase" UWORD _CNV_A_R_LINEAR_____3_CM 1 100. 0. 655.35 DISPLAY_IDENTIFIER T_EFP_ACT_H ECU_ADDRESS 0xc00005dc FORMAT "%6.2" /end MEASUREMENT
/begin CHARACTERISTIC c_vff_efp_add "Additive value for the amount of fuel from the pump" VALUE 0xa1029bf2 _REC_VAL_20_u1 255. _CNV_A_R_LINEAR_____154_CM 0. 255. DISPLAY_IDENTIFIER C_VFF_EFP_ADD FORMAT "%3.0" /end CHARACTERISTIC
/begin CHARACTERISTIC lc_efppwm_man_act "Switch for manual EFPPWM" VALUE 0xa1029d21 _REC_VAL_20_u1 1. _CNV_A_R_LINEAR_____0_CM 0. 1. DISPLAY_IDENTIFIER LC_EFPPWM_MAN_ACT FORMAT "%1.0" /end CHARACTERISTIC
/begin CHARACTERISTIC c_fup_efp_st_h_min "Start fuel pressure level to store values for start pressure increase observation in any case" VALUE 0xa1029436 _REC_VAL_20_u2 173888. _CNV_A_R_LINEAR_____153_CM 0. 173888. DISPLAY_IDENTIFIER C_FUP_EFP_ST_H_MIN FORMAT "%8.1" /end CHARACTERISTIC
/begin CHARACTERISTIC c_fup_efp_mem_l_dif "Fuel pressure difference to store values for start pressure decrease observation" VALUE 0xa1029424 _REC_VAL_20_u2 173888. _CNV_A_R_LINEAR_____153_CM 0. 173888. DISPLAY_IDENTIFIER C_FUP_EFP_MEM_L_DIF FORMAT "%8.1" /end CHARACTERISTIC
/begin CHARACTERISTIC c_tco_mem_fup_efp_l_tol "Coolant temperature threshold to start fuel pressure decrease observation" VALUE 0xa10299d8 _REC_VAL_20_u1 190.5 _CNV_A_R_LINEAR_____16_CM -48. 142.5 DISPLAY_IDENTIFIER C_TCO_MEM_FUP_EFP_L_TOL FORMAT "%6.2" /end CHARACTERISTIC
/begin CHARACTERISTIC c_tia_fup_efp_l_hys "Intake temperature hysteresis for fuel pressure decrease observation" VALUE 0xa1029a4b _REC_VAL_20_u1 190.5 _CNV_A_R_LINEAR_____24_CM 0. 190.5 DISPLAY_IDENTIFIER C_TIA_FUP_EFP_L_HYS FORMAT "%6.2" /end CHARACTERISTIC
/begin CHARACTERISTIC c_t_efp "Time counter for activated EFP within power latch" VALUE 0xa1029888 _REC_VAL_20_u2 655.35 _CNV_A_R_LINEAR_____3_CM 0. 655.35 DISPLAY_IDENTIFIER C_T_EFP FORMAT "%6.2" /end CHARACTERISTIC
/begin MEASUREMENT efppwm_min_ad "Minimum pump speed of the electrical fuel pump as PWM signal" UWORD _CNV_A_R_LINEAR_____7_CM 1 100. 0. 99.99847412109381 DISPLAY_IDENTIFIER EFPPWM_MIN_AD ECU_ADDRESS 0xd0004d72 /end MEASUREMENT
/begin MEASUREMENT efppwm_bas "Precontroller value of EFPPWM" UWORD _CNV_A_R_LINEAR_____7_CM 1 100. 0. 99.99847412109381 DISPLAY_IDENTIFIER EFPPWM_BAS ECU_ADDRESS 0xc00005b0 /end MEASUREMENT
/begin MEASUREMENT efppwm_i "I-part of the controller" SWORD _CNV_A_R_LINEAR_____110_CM 1 100. -50. 49.9984741210938 DISPLAY_IDENTIFIER EFPPWM_I ECU_ADDRESS 0xd0004d6e FORMAT "%7.3" /end MEASUREMENT
/begin MEASUREMENT efppwm_i_tmp "Temporary I-part of the controller" SWORD _CNV_A_R_LINEAR_____110_CM 1 100. -50. 49.9984741210938 DISPLAY_IDENTIFIER EFPPWM_I_TMP ECU_ADDRESS 0xc00005bc FORMAT "%7.3" /end MEASUREMENT
/begin MEASUREMENT efppwm_i_ad "Adaptive I-part of the controller" SWORD _CNV_A_R_LINEAR_____110_CM 1 100. -50. 49.9984741210938 DISPLAY_IDENTIFIER EFPPWM_I_AD ECU_ADDRESS 0xd0004d70 FORMAT "%7.3" /end MEASUREMENT
/begin MEASUREMENT efppwm_i_ad_dif "Adaptive I-part difference of the controller" SWORD _CNV_A_R_LINEAR_____110_CM 1 100. -50. 49.9984741210938 DISPLAY_IDENTIFIER EFPPWM_I_AD_DIF ECU_ADDRESS 0xc00005be FORMAT "%7.3" /end MEASUREMENT
/begin MEASUREMENT efppwm_p "P-part of the controller" SWORD _CNV_A_R_LINEAR_____110_CM 1 100. -50. 49.9984741210938 DISPLAY_IDENTIFIER EFPPWM_P ECU_ADDRESS 0xc00005c0 FORMAT "%7.3" /end MEASUREMENT
/begin MEASUREMENT fup_efp_dif "Deviation of the fuel pressure after fuel pump from the setpoint" SWORD _CNV_A_R_LINEAR_____153_CM 1 100. -86945.3266803998 86942.6733196002 DISPLAY_IDENTIFIER FUP_EFP_DIF ECU_ADDRESS 0xc00005ba FORMAT "%9.2" /end MEASUREMENT
/begin MEASUREMENT vff_efp_clc "Calculated requested amount of fuel from the pump" UWORD _CNV_A_R_LINEAR_____156_CM 1 100. 0. 255. DISPLAY_IDENTIFIER VFF_EFP_CLC ECU_ADDRESS 0xc00005b6 FORMAT "%7.3" /end MEASUREMENT
/begin MEASUREMENT fup_efp_grd "Calculated requested amount of fuel from the pump" SWORD _CNV_A_R_LINEAR_____157_CM 1 100. -86945.3266803998 86942.6733196002 DISPLAY_IDENTIFIER FUP_EFP_GRD ECU_ADDRESS 0xc00005b4 FORMAT "%9.2" /end MEASUREMENT
/begin MEASUREMENT lv_efppwm_ctl_stop "Logical variable for I-part freeze" UBYTE _CNV_S_2_RANGE__0___1_CM 1 100. 0. 1. DISPLAY_IDENTIFIER LV_EFPPWM_CTL_STOP ECU_ADDRESS 0xc00005d0 BIT_MASK 0x1 /end MEASUREMENT
/begin MEASUREMENT lv_efppwm_ctl_rst "Logical variable for controller reset" UBYTE _CNV_S_2_RANGE__0___1_CM 1 100. 0. 1. DISPLAY_IDENTIFIER LV_EFPPWM_CTL_RST ECU_ADDRESS 0xc00005d2 BIT_MASK 0x1 /end MEASUREMENT
/begin MEASUREMENT lv_efppwm_ad_stop "Logical variable for adaptation stop" UBYTE _CNV_S_2_RANGE__0___1_CM 1 100. 0. 1. DISPLAY_IDENTIFIER LV_EFPPWM_AD_STOP ECU_ADDRESS 0xd00039fe BIT_MASK 0x1 /end MEASUREMENT
/begin MEASUREMENT lv_efppwm_min_ad_act "Logical variable showing active minimum EFPPWM adaptation" UBYTE _CNV_S_2_RANGE__0___1_CM 1 100. 0. 1. DISPLAY_IDENTIFIER LV_EFPPWM_MIN_AD_ACT ECU_ADDRESS 0xc00005d1 BIT_MASK 0x1 /end MEASUREMENT
/begin MEASUREMENT ctr_seg_efppwm_min_ad "Segment counter before minimum PWM adaptation is allowed" UWORD _CNV_A_R_LINEAR_____0_CM 1 100. 0. 65535. DISPLAY_IDENTIFIER CTR_SEG_EFPPWM_MIN_AD ECU_ADDRESS 0xc00005c2 FORMAT "%5.0" /end MEASUREMENT
/begin MEASUREMENT ctr_seg_efppwm_i_ad "Segment counter before I-part adaptation is allowed" UWORD _CNV_A_R_LINEAR_____0_CM 1 100. 0. 65535. DISPLAY_IDENTIFIER CTR_SEG_EFPPWM_I_AD ECU_ADDRESS 0xc00005b2 FORMAT "%5.0" /end MEASUREMENT
/begin MEASUREMENT lv_efppwm_i_ad_vld "Logical variable showing valid adaptive I-Part of EFPPWM" UBYTE _CNV_S_2_RANGE__0___1_CM 1 100. 0. 1. DISPLAY_IDENTIFIER LV_EFPPWM_I_AD_VLD ECU_ADDRESS 0xd0003a00 BIT_MASK 0x1 /end MEASUREMENT
/begin AXIS_PTS ldp_fup_efp_dif_ip_efppwm_p "" 0xa1020a78 fup_efp_dif _REC_AXS_20_u2 173888. _CNV_A_R_LINEAR_____158_CM 8 -86945.3266803998 86942.6733196002 FORMAT "%9.2" /end AXIS_PTS
/begin AXIS_PTS ldp_fup_efp_dif_ip_efppwm_i "" 0xa1020a64 fup_efp_dif _REC_AXS_20_u2 173888. _CNV_A_R_LINEAR_____158_CM 8 -86945.3266803998 86942.6733196002 FORMAT "%9.2" /end AXIS_PTS
/begin CHARACTERISTIC ip_efppwm_bas_l_pow "Basic value of the EFPPWM for low power version" CURVE 0xa1023340 _REC_CUR_20_u2_u2 99.99847412109381 _CNV_A_R_LINEAR_____7_CM 0. 99.99847412109381 DISPLAY_IDENTIFIER IP_EFPPWM_BAS_L_POW
 /begin AXIS_DESCR COM_AXIS vff_efp_req _CNV_A_R_LINEAR_____156_CM 8 0. 255. FORMAT "%7.3" AXIS_PTS_REF ldp_vff_efp_req_ip_efppwm_bas /end AXIS_DESCR
/end CHARACTERISTIC
/begin CHARACTERISTIC ip_fac_efppwm_bas_l_pow "Correction factor for the basic value of the EFPPWM for low power version" MAP 0xa1023854 _REC_MAP_20_u2_u1_u2 1.99996948242188 _CNV_A_R_LINEAR_____8_CM 0. 1.99996948242188 DISPLAY_IDENTIFIER IP_FAC_EFPPWM_BAS_L_POW FORMAT "%7.5"
 /begin AXIS_DESCR COM_AXIS tfu_efp _CNV_A_R_LINEAR_____16_CM 6 -48. 142.5 FORMAT "%6.2" AXIS_PTS_REF ldp_tfu_efp_ip_fac_efppwm_bas /end AXIS_DESCR
 /begin AXIS_DESCR COM_AXIS fup_efp_sp _CNV_A_R_LINEAR_____153_CM 8 0. 173888. FORMAT "%8.1" AXIS_PTS_REF ldp_fup_efp_sp_ip_fac_efppwm /end AXIS_DESCR
/end CHARACTERISTIC
/begin CHARACTERISTIC ip_efppwm_p "P-part of the controller" CURVE 0xa1023360 _REC_CUR_20_u2_u2 99.99847412 _CNV_A_R_LINEAR_____159_CM -50. 49.99847412 DISPLAY_IDENTIFIER IP_EFPPWM_P FORMAT "%7.3"
 /begin AXIS_DESCR COM_AXIS fup_efp_dif _CNV_A_R_LINEAR_____158_CM 8 -86945.3266803998 86942.6733196002 FORMAT "%9.2" AXIS_PTS_REF ldp_fup_efp_dif_ip_efppwm_p /end AXIS_DESCR
/end CHARACTERISTIC
/begin CHARACTERISTIC ip_efppwm_i "I-part of the controller" CURVE 0xa1023350 _REC_CUR_20_u2_u2 99.99847412 _CNV_A_R_LINEAR_____159_CM -50. 49.99847412 DISPLAY_IDENTIFIER IP_EFPPWM_I FORMAT "%7.3"
 /begin AXIS_DESCR COM_AXIS fup_efp_dif _CNV_A_R_LINEAR_____158_CM 8 -86945.3266803998 86942.6733196002 FORMAT "%9.2" AXIS_PTS_REF ldp_fup_efp_dif_ip_efppwm_i /end AXIS_DESCR
/end CHARACTERISTIC
/begin CHARACTERISTIC c_efppwm_max "Max. electrical fuel pump speed" VALUE 0xa1029340 _REC_VAL_20_u2 99.99847412109381 _CNV_A_R_LINEAR_____7_CM 0. 99.99847412109381 DISPLAY_IDENTIFIER C_EFPPWM_MAX /end CHARACTERISTIC
/begin CHARACTERISTIC c_efppwm_min_1 "Min. electrical fuel pump speed at state EFP_ON" VALUE 0xa1029342 _REC_VAL_20_u2 99.99847412109381 _CNV_A_R_LINEAR_____7_CM 0. 99.99847412109381 DISPLAY_IDENTIFIER C_EFPPWM_MIN_1 /end CHARACTERISTIC
/begin CHARACTERISTIC c_efppwm_min_2 "Min. electrical fuel pump speed at state EFP_OFF" VALUE 0xa1029344 _REC_VAL_20_u2 99.99847412109381 _CNV_A_R_LINEAR_____7_CM 0. 99.99847412109381 DISPLAY_IDENTIFIER C_EFPPWM_MIN_2 /end CHARACTERISTIC
/begin CHARACTERISTIC c_efppwm_crash "Min. electrical fuel pump speed at state EFP_CRASH" VALUE 0xa1029328 _REC_VAL_20_u2 99.99847412109381 _CNV_A_R_LINEAR_____7_CM 0. 99.99847412109381 DISPLAY_IDENTIFIER C_EFPPWM_CRASH /end CHARACTERISTIC
/begin CHARACTERISTIC c_efppwm_i_min "Min. value for the I-part of the controller" VALUE 0xa102933a _REC_VAL_20_s2 99.99847412109381 _CNV_A_R_LINEAR_____110_CM -50. 49.9984741210938 DISPLAY_IDENTIFIER C_EFPPWM_I_MIN FORMAT "%7.3" /end CHARACTERISTIC
/begin CHARACTERISTIC c_efppwm_i_max "Max. value for the I-part of the controller" VALUE 0xa1029338 _REC_VAL_20_s2 99.99847412109381 _CNV_A_R_LINEAR_____110_CM -50. 49.9984741210938 DISPLAY_IDENTIFIER C_EFPPWM_I_MAX FORMAT "%7.3" /end CHARACTERISTIC
/begin CHARACTERISTIC c_efppwm_i_ad_min "Min. value for the adaptive I-part of the controller" VALUE 0xa1029332 _REC_VAL_20_s2 99.99847412109381 _CNV_A_R_LINEAR_____110_CM -50. 49.9984741210938 DISPLAY_IDENTIFIER C_EFPPWM_I_AD_MIN FORMAT "%7.3" /end CHARACTERISTIC
/begin CHARACTERISTIC c_efppwm_i_ad_max "Max. value for the adaptive I-part of the controller" VALUE 0xa1029330 _REC_VAL_20_s2 99.99847412109381 _CNV_A_R_LINEAR_____110_CM -50. 49.9984741210938 DISPLAY_IDENTIFIER C_EFPPWM_I_AD_MAX FORMAT "%7.3" /end CHARACTERISTIC
/begin CHARACTERISTIC c_efppwm_man_act "Manual value for the EFPPWM" VALUE 0xa102933e _REC_VAL_20_u2 99.99847412109381 _CNV_A_R_LINEAR_____7_CM 0. 99.99847412109381 DISPLAY_IDENTIFIER C_EFPPWM_MAN_ACT /end CHARACTERISTIC
/begin CHARACTERISTIC lc_fup_efp_avl "Logical variable indicating \"fuel pressure sensor for low pressure line available\"" VALUE 0xa1029d3f _REC_VAL_20_u1 1. _CNV_A_R_LINEAR_____0_CM 0. 1. DISPLAY_IDENTIFIER LC_FUP_EFP_AVL FORMAT "%1.0" /end CHARACTERISTIC
/begin CHARACTERISTIC lc_efppwm_i_ad_clr "Logical variable to clear the adaptive I-part of the controller" VALUE 0xa1029d1f _REC_VAL_20_u1 1. _CNV_A_R_LINEAR_____0_CM 0. 1. DISPLAY_IDENTIFIER LC_EFPPWM_I_AD_CLR FORMAT "%1.0" /end CHARACTERISTIC
/begin CHARACTERISTIC c_tco_max_efppwm_ad "Maximum coolant temperature for allowing adaptation" VALUE 0xa10299d3 _REC_VAL_20_u1 190.5 _CNV_A_R_LINEAR_____16_CM -48. 142.5 DISPLAY_IDENTIFIER C_TCO_MAX_EFPPWM_AD FORMAT "%6.2" /end CHARACTERISTIC
/begin CHARACTERISTIC c_tco_min_efppwm_ad "Minimum coolant temperature for allowing adaptation" VALUE 0xa10299db _REC_VAL_20_u1 190.5 _CNV_A_R_LINEAR_____16_CM -48. 142.5 DISPLAY_IDENTIFIER C_TCO_MIN_EFPPWM_AD FORMAT "%6.2" /end CHARACTERISTIC
/begin CHARACTERISTIC c_fup_efp_dif_max_efppwm_ad "Maximum deviation of the fuel pressure after fuel pump from the setpoint for adaptation" VALUE 0xa102941e _REC_VAL_20_s2 173888. _CNV_A_R_LINEAR_____153_CM -86945.3266803998 86942.6733196002 DISPLAY_IDENTIFIER C_FUP_EFP_DIF_MAX_EFPPWM_AD FORMAT "%9.2" /end CHARACTERISTIC
/begin CHARACTERISTIC c_efppwm_min_cor "Correction value for the EFPPWM to reach \"zero delivery\"" VALUE 0xa102934e _REC_VAL_20_s2 99.99847412109381 _CNV_A_R_LINEAR_____110_CM -50. 49.9984741210938 DISPLAY_IDENTIFIER C_EFPPWM_MIN_COR FORMAT "%7.3" /end CHARACTERISTIC
/begin CHARACTERISTIC c_crlc_efppwm_i_ad "Correlation constant for I-part adaptation" VALUE 0xa10291e0 _REC_VAL_20_u1 0.99609375 _CNV_A_R_LINEAR_____27_CM 0. 0.99609375 DISPLAY_IDENTIFIER C_CRLC_EFPPWM_I_AD FORMAT "%5.3" /end CHARACTERISTIC
/begin CHARACTERISTIC c_ctr_seg_efppwm_i_ad_max "Maximum segment counter for the I-part adaptation" VALUE 0xa10292be _REC_VAL_20_u2 65535. _CNV_A_R_LINEAR_____0_CM 0. 65535. DISPLAY_IDENTIFIER C_CTR_SEG_EFPPWM_I_AD_MAX FORMAT "%5.0" /end CHARACTERISTIC
/begin CHARACTERISTIC c_mff_sp_max_efppwm_i_ad "Maximum injected fuel mass for allowing I-part adaptation" VALUE 0xa1029588 _REC_VAL_20_u2 1389. _CNV_A_R_LINEAR_____160_CM 0. 1389. DISPLAY_IDENTIFIER C_MFF_SP_MAX_EFPPWM_I_AD FORMAT "%7.2" /end CHARACTERISTIC
/begin CHARACTERISTIC c_mff_sp_min_efppwm_i_ad "Minimum injected fuel mass for allowing I-part adaptation" VALUE 0xa1029594 _REC_VAL_20_u2 1389. _CNV_A_R_LINEAR_____160_CM 0. 1389. DISPLAY_IDENTIFIER C_MFF_SP_MIN_EFPPWM_I_AD FORMAT "%7.2" /end CHARACTERISTIC
/begin CHARACTERISTIC c_mff_sp_max_efppwm_min_ad "Maximum injected fuel mass for allowing minimum EFPPWM adaptation" VALUE 0xa102958a _REC_VAL_20_u2 1389. _CNV_A_R_LINEAR_____160_CM 0. 1389. DISPLAY_IDENTIFIER C_MFF_SP_MAX_EFPPWM_MIN_AD FORMAT "%7.2" /end CHARACTERISTIC
/begin CHARACTERISTIC c_mff_sp_min_efppwm_min_ad "Minimum injected fuel mass for allowing minimum EFPPWM adaptation" VALUE 0xa1029596 _REC_VAL_20_u2 1389. _CNV_A_R_LINEAR_____160_CM 0. 1389. DISPLAY_IDENTIFIER C_MFF_SP_MIN_EFPPWM_MIN_AD FORMAT "%7.2" /end CHARACTERISTIC
/begin CHARACTERISTIC c_n_max_efppwm_i_ad "Maximum engine speed for allowing I-part adaptation" VALUE 0xa1029618 _REC_VAL_20_u1 8160. _CNV_A_R_LINEAR_____9_CM 0. 8160. DISPLAY_IDENTIFIER C_N_MAX_EFPPWM_I_AD FORMAT "%4.0" /end CHARACTERISTIC
/begin CHARACTERISTIC c_n_min_efppwm_i_ad "Minimum engine speed for allowing I-part adaptation" VALUE 0xa1029630 _REC_VAL_20_u1 8160. _CNV_A_R_LINEAR_____9_CM 0. 8160. DISPLAY_IDENTIFIER C_N_MIN_EFPPWM_I_AD FORMAT "%4.0" /end CHARACTERISTIC
/begin CHARACTERISTIC c_n_max_efppwm_min_ad "Maximum engine speed for allowing minimum EFPPWM adaptation" VALUE 0xa1029619 _REC_VAL_20_u1 8160. _CNV_A_R_LINEAR_____9_CM 0. 8160. DISPLAY_IDENTIFIER C_N_MAX_EFPPWM_MIN_AD FORMAT "%4.0" /end CHARACTERISTIC
/begin CHARACTERISTIC c_n_min_efppwm_min_ad "Minimum engine speed for allowing minimum EFPPWM adaptation" VALUE 0xa1029631 _REC_VAL_20_u1 8160. _CNV_A_R_LINEAR_____9_CM 0. 8160. DISPLAY_IDENTIFIER C_N_MIN_EFPPWM_MIN_AD FORMAT "%4.0" /end CHARACTERISTIC
/begin CHARACTERISTIC c_t_ast_efppwm_min_ad "Time after engine start to allow minimum EFPPWM adaptation" VALUE 0xa1029804 _REC_VAL_20_u2 6553.5 _CNV_A_R_LINEAR_____4_CM 0. 6553.5 DISPLAY_IDENTIFIER C_T_AST_EFPPWM_MIN_AD FORMAT "%6.1" /end CHARACTERISTIC
/begin CHARACTERISTIC c_efppwm_min_ad_tol "Maximum value for the EFPPWM_MIN adaptation" VALUE 0xa102934c _REC_VAL_20_u2 99.99847412109381 _CNV_A_R_LINEAR_____7_CM 0. 99.99847412109381 DISPLAY_IDENTIFIER C_EFPPWM_MIN_AD_TOL /end CHARACTERISTIC
/begin CHARACTERISTIC c_efppwm_min_ad_ini "Initial value for the EFPPWM_MIN adaptation" VALUE 0xa102934a _REC_VAL_20_u2 99.99847412109381 _CNV_A_R_LINEAR_____7_CM 0. 99.99847412109381 DISPLAY_IDENTIFIER C_EFPPWM_MIN_AD_INI /end CHARACTERISTIC
/begin CHARACTERISTIC c_efppwm_lih_add "Additive EFPPWM in case of limp home." VALUE 0xa102933c _REC_VAL_20_s2 99.99847412109381 _CNV_A_R_LINEAR_____110_CM -50. 49.9984741210938 DISPLAY_IDENTIFIER C_EFPPWM_LIH_ADD FORMAT "%7.3" /end CHARACTERISTIC
/begin CHARACTERISTIC c_efppwm_deac "Minimum EFPPWM at ACR_TEST" VALUE 0xa102932a _REC_VAL_20_u2 99.99847412109381 _CNV_A_R_LINEAR_____7_CM 0. 99.99847412109381 DISPLAY_IDENTIFIER C_EFPPWM_DEAC /end CHARACTERISTIC
/begin CHARACTERISTIC c_efppwm_acr_test_inc "Increment for the actuator test" VALUE 0xa1029326 _REC_VAL_20_u2 99.99847412109381 _CNV_A_R_LINEAR_____7_CM 0. 99.99847412109381 DISPLAY_IDENTIFIER C_EFPPWM_ACR_TEST_INC /end CHARACTERISTIC
/begin MEASUREMENT efppwm "Pump speed of the electrical fuel pump as PWM signal" UWORD _CNV_A_R_LINEAR_____7_CM 1 100. 0. 99.99847412109381 DISPLAY_IDENTIFIER EFPPWM ECU_ADDRESS 0xd0004d6c /end MEASUREMENT
/begin MEASUREMENT lv_efp "Logical variable for electrical fuel pump active" UBYTE _CNV_S_2_RANGE__0___1_CM 1 100. 0. 1. DISPLAY_IDENTIFIER LV_EFP ECU_ADDRESS 0xd00039fd BIT_MASK 0x1 /end MEASUREMENT
/begin MEASUREMENT state_efp "States of electrical fuel pump function" UBYTE _CNV_S_7_RANGE_STAT_161_CM 1 100. 0. 6. DISPLAY_IDENTIFIER STATE_EFP ECU_ADDRESS 0xd00039fc /end MEASUREMENT
/begin CHARACTERISTIC c_fup_rho_fuel_efp "Densitiy of the fuel" VALUE 0xa1029468 _REC_VAL_20_u2 825.3604943923095 _CNV_A_R_LINEAR_____162_CM 74.6395056076906 900. DISPLAY_IDENTIFIER C_FUP_RHO_FUEL_EFP FORMAT "%7.2" /end CHARACTERISTIC
/begin AXIS_PTS ldp_vff_efp_req_ip_efppwm_bas "" 0xa1021730 vff_efp_req _REC_AXS_20_u2 255. _CNV_A_R_LINEAR_____156_CM 8 0. 255. FORMAT "%7.3" /end AXIS_PTS
/begin AXIS_PTS ldp_tfu_efp_ip_fac_efppwm_bas "" 0xa102132e tfu_efp _REC_AXS_20_u1 190.5 _CNV_A_R_LINEAR_____16_CM 6 -48. 142.5 FORMAT "%6.2" /end AXIS_PTS
/begin AXIS_PTS ldp_fup_efp_sp_ip_fac_efppwm "" 0xa1020a8c fup_efp_sp _REC_AXS_20_u2 173888. _CNV_A_R_LINEAR_____153_CM 8 0. 173888. FORMAT "%8.1" /end AXIS_PTS
/begin MEASUREMENT lv_efppwm_min_vld "Logical variable showing valid minimum of EFPPWM" UBYTE _CNV_S_2_RANGE__0___1_CM 1 100. 0. 1. DISPLAY_IDENTIFIER LV_EFPPWM_MIN_VLD ECU_ADDRESS 0xd00039ff BIT_MASK 0x1 /end MEASUREMENT
/begin MEASUREMENT lv_fup_efp_lim "Logical variable indicating VFF limitation for the EFP" UBYTE _CNV_S_2_RANGE__0___1_CM 1 100. 0. 1. DISPLAY_IDENTIFIER LV_FUP_EFP_LIM ECU_ADDRESS 0xc00005d3 BIT_MASK 0x1 /end MEASUREMENT
/begin MEASUREMENT vff_efp_req "Requested amount of fuel from the pump" UWORD _CNV_A_R_LINEAR_____156_CM 1 100. 0. 255. DISPLAY_IDENTIFIER VFF_EFP_REQ ECU_ADDRESS 0xd0004d74 FORMAT "%7.3" /end MEASUREMENT
/begin MEASUREMENT vff_efp_cor "volume fuel flow for correction of the EFP volume fuel flow" UWORD _CNV_A_R_LINEAR_____156_CM 1 100. 0. 255. DISPLAY_IDENTIFIER VFF_EFP_COR ECU_ADDRESS 0xc00005b8 FORMAT "%7.3" /end MEASUREMENT
/begin CHARACTERISTIC c_ctr_seg_efppwm_min_ad_max "Maximum segment counter for the minimum EFPPWM adaptation" VALUE 0xa10292c0 _REC_VAL_20_u2 65535. _CNV_A_R_LINEAR_____0_CM 0. 65535. DISPLAY_IDENTIFIER C_CTR_SEG_EFPPWM_MIN_AD_MAX FORMAT "%5.0" /end CHARACTERISTIC
/begin CHARACTERISTIC c_ctr_fup_sp_lim_vff_efp_cor "counter for duration of the limitation for VFF_EFP" VALUE 0xa102929c _REC_VAL_20_u2 65535. _CNV_A_R_LINEAR_____0_CM 0. 65535. DISPLAY_IDENTIFIER C_CTR_FUP_SP_LIM_VFF_EFP_COR FORMAT "%5.0" /end CHARACTERISTIC
/begin CHARACTERISTIC c_fup_efp_grd_max "Fuel pressure gradient for freezing EFPPWM during PUC" VALUE 0xa1029420 _REC_VAL_20_s2 173888. _CNV_A_R_LINEAR_____157_CM -86945.3266803998 86942.6733196002 DISPLAY_IDENTIFIER C_FUP_EFP_GRD_MAX FORMAT "%9.2" /end CHARACTERISTIC
/begin CHARACTERISTIC c_fup_sp_dif_lim_vff_efp_cor "Fuel pressure setpoint difference threshold for activation of the VFF_EFP correction" VALUE 0xa1029470 _REC_VAL_20_u2 347776. _CNV_A_R_LINEAR_____152_CM 0. 347776. DISPLAY_IDENTIFIER C_FUP_SP_DIF_LIM_VFF_EFP_COR FORMAT "%6.0" /end CHARACTERISTIC
/begin CHARACTERISTIC c_vff_efp_cor_grd_dec "decrement gradient limitation for VFF_EFP_COR" VALUE 0xa1029bf4 _REC_VAL_20_u2 255. _CNV_A_R_LINEAR_____156_CM 0. 255. DISPLAY_IDENTIFIER C_VFF_EFP_COR_GRD_DEC FORMAT "%7.3" /end CHARACTERISTIC
/begin CHARACTERISTIC c_vff_efp_req_lih "EFP volume fuel flow value for limp home of the fuel low pressure system" VALUE 0xa1029bf6 _REC_VAL_20_u2 255. _CNV_A_R_LINEAR_____156_CM 0. 255. DISPLAY_IDENTIFIER C_VFF_EFP_REQ_LIH FORMAT "%7.3" /end CHARACTERISTIC
/begin CHARACTERISTIC c_vff_dif_lim_vff_efp_cor "constant for manual VFF difference for VFF_EFP correction" VALUE 0xa1029bf0 _REC_VAL_20_u2 255. _CNV_A_R_LINEAR_____156_CM 0. 255. DISPLAY_IDENTIFIER C_VFF_DIF_LIM_VFF_EFP_COR FORMAT "%7.3" /end CHARACTERISTIC
/begin CHARACTERISTIC lc_vff_dif_lim_vff_efp_cor_man "logical constant for switch to manual VFF_DIF for VFF_EFP correction" VALUE 0xa1029e17 _REC_VAL_20_u1 1. _CNV_A_R_LINEAR_____0_CM 0. 1. DISPLAY_IDENTIFIER LC_VFF_DIF_LIM_VFF_EFP_COR_MAN FORMAT "%1.0" /end CHARACTERISTIC
/begin MEASUREMENT iga_av_h_rng_1[0] "Intermediate ignition angle till gradiant limitation after start is terminated" SWORD _CNV_A_R_LINEAR_____166_CM 1 100. -90. 90. DISPLAY_IDENTIFIER IGA_AV_H_RNG_1[0] ECU_ADDRESS 0xd00050fc FORMAT "%8.4" /end MEASUREMENT
/begin MEASUREMENT iga_av_h_rng_1[1] "Intermediate ignition angle till gradiant limitation after start is terminated" SWORD _CNV_A_R_LINEAR_____166_CM 1 100. -90. 90. DISPLAY_IDENTIFIER IGA_AV_H_RNG_1[1] ECU_ADDRESS 0xd00050fe FORMAT "%8.4" /end MEASUREMENT
/begin MEASUREMENT iga_av_h_rng_1[2] "Intermediate ignition angle till gradiant limitation after start is terminated" SWORD _CNV_A_R_LINEAR_____166_CM 1 100. -90. 90. DISPLAY_IDENTIFIER IGA_AV_H_RNG_1[2] ECU_ADDRESS 0xd0005100 FORMAT "%8.4" /end MEASUREMENT
/begin MEASUREMENT iga_av_h_rng_1[3] "Intermediate ignition angle till gradiant limitation after start is terminated" SWORD _CNV_A_R_LINEAR_____166_CM 1 100. -90. 90. DISPLAY_IDENTIFIER IGA_AV_H_RNG_1[3] ECU_ADDRESS 0xd0005102 FORMAT "%8.4" /end MEASUREMENT
/begin MEASUREMENT iga_av_h_rng_1[4] "Intermediate ignition angle till gradiant limitation after start is terminated" SWORD _CNV_A_R_LINEAR_____166_CM 1 100. -90. 90. DISPLAY_IDENTIFIER IGA_AV_H_RNG_1[4] ECU_ADDRESS 0xd0005104 FORMAT "%8.4" /end MEASUREMENT
/begin MEASUREMENT iga_av_h_rng_1[5] "Intermediate ignition angle till gradiant limitation after start is terminated" SWORD _CNV_A_R_LINEAR_____166_CM 1 100. -90. 90. DISPLAY_IDENTIFIER IGA_AV_H_RNG_1[5] ECU_ADDRESS 0xd0005106 FORMAT "%8.4" /end MEASUREMENT
/begin MEASUREMENT iga[0] "Basic ignition angle application correction and knock control included" UBYTE _CNV_A_R_LINEAR_____167_CM 1 100. -35.625 60. DISPLAY_IDENTIFIER IGA[0] ECU_ADDRESS 0xd0003cd4 FORMAT "%5.1" /end MEASUREMENT
/begin MEASUREMENT iga[1] "Basic ignition angle application correction and knock control included" UBYTE _CNV_A_R_LINEAR_____167_CM 1 100. -35.625 60. DISPLAY_IDENTIFIER IGA[1] ECU_ADDRESS 0xd0003cd5 FORMAT "%5.1" /end MEASUREMENT
/begin MEASUREMENT iga[2] "Basic ignition angle application correction and knock control included" UBYTE _CNV_A_R_LINEAR_____167_CM 1 100. -35.625 60. DISPLAY_IDENTIFIER IGA[2] ECU_ADDRESS 0xd0003cd6 FORMAT "%5.1" /end MEASUREMENT
/begin MEASUREMENT iga[3] "Basic ignition angle application correction and knock control included" UBYTE _CNV_A_R_LINEAR_____167_CM 1 100. -35.625 60. DISPLAY_IDENTIFIER IGA[3] ECU_ADDRESS 0xd0003cd7 FORMAT "%5.1" /end MEASUREMENT
/begin MEASUREMENT iga[4] "Basic ignition angle application correction and knock control included" UBYTE _CNV_A_R_LINEAR_____167_CM 1 100. -35.625 60. DISPLAY_IDENTIFIER IGA[4] ECU_ADDRESS 0xd0003cd8 FORMAT "%5.1" /end MEASUREMENT
/begin MEASUREMENT iga[5] "Basic ignition angle application correction and knock control included" UBYTE _CNV_A_R_LINEAR_____167_CM 1 100. -35.625 60. DISPLAY_IDENTIFIER IGA[5] ECU_ADDRESS 0xd0003cd9 FORMAT "%5.1" /end MEASUREMENT
/begin MEASUREMENT iga_min_h_rng "Minimum ignition Angle" SWORD _CNV_A_R_LINEAR_____166_CM 1 100. -90. 90. DISPLAY_IDENTIFIER IGA_MIN_H_RNG ECU_ADDRESS 0xd00050e8 FORMAT "%8.4" /end MEASUREMENT
/begin MEASUREMENT lv_iga_grd_act "FLag for ignition angle gradient limitation out of start active" UBYTE _CNV_S_2_RANGE__0___1_CM 1 100. 0. 1. DISPLAY_IDENTIFIER LV_IGA_GRD_ACT ECU_ADDRESS 0xd0003ce0 BIT_MASK 0x1 /end MEASUREMENT
/begin MEASUREMENT iga_wout_knk[0] "actual ignition angle" UBYTE _CNV_A_R_LINEAR_____167_CM 1 100. -35.625 60. DISPLAY_IDENTIFIER IGA_WOUT_KNK[0] ECU_ADDRESS 0xd0003cda FORMAT "%5.1" /end MEASUREMENT
/begin MEASUREMENT iga_wout_knk[1] "actual ignition angle" UBYTE _CNV_A_R_LINEAR_____167_CM 1 100. -35.625 60. DISPLAY_IDENTIFIER IGA_WOUT_KNK[1] ECU_ADDRESS 0xd0003cdb FORMAT "%5.1" /end MEASUREMENT
/begin MEASUREMENT iga_wout_knk[2] "actual ignition angle" UBYTE _CNV_A_R_LINEAR_____167_CM 1 100. -35.625 60. DISPLAY_IDENTIFIER IGA_WOUT_KNK[2] ECU_ADDRESS 0xd0003cdc FORMAT "%5.1" /end MEASUREMENT
/begin MEASUREMENT iga_wout_knk[3] "actual ignition angle" UBYTE _CNV_A_R_LINEAR_____167_CM 1 100. -35.625 60. DISPLAY_IDENTIFIER IGA_WOUT_KNK[3] ECU_ADDRESS 0xd0003cdd FORMAT "%5.1" /end MEASUREMENT
/begin MEASUREMENT iga_wout_knk[4] "actual ignition angle" UBYTE _CNV_A_R_LINEAR_____167_CM 1 100. -35.625 60. DISPLAY_IDENTIFIER IGA_WOUT_KNK[4] ECU_ADDRESS 0xd0003cde FORMAT "%5.1" /end MEASUREMENT
/begin MEASUREMENT iga_wout_knk[5] "actual ignition angle" UBYTE _CNV_A_R_LINEAR_____167_CM 1 100. -35.625 60. DISPLAY_IDENTIFIER IGA_WOUT_KNK[5] ECU_ADDRESS 0xd0003cdf FORMAT "%5.1" /end MEASUREMENT
/begin CHARACTERISTIC lc_iga_st_ena "Logical constant for seperated start ignition angle" VALUE 0xa1029d45 _REC_VAL_20_u1 1. _CNV_A_R_LINEAR_____0_CM 0. 1. DISPLAY_IDENTIFIER LC_IGA_ST_ENA FORMAT "%1.0" /end CHARACTERISTIC
/begin CHARACTERISTIC ip_iga_lgrd_ast "Gradient limitation IGA after start phase" CURVE 0xa1025498 _REC_CUR_20_u1_u1 95.625 _CNV_A_R_LINEAR_____168_CM 0. 95.625 DISPLAY_IDENTIFIER IP_IGA_LGRD_AST FORMAT "%5.2"
 /begin AXIS_DESCR COM_AXIS tco _CNV_A_R_LINEAR_____16_CM 8 -48. 142.5 FORMAT "%5.1" AXIS_PTS_REF ldpm_tco_1_igsp /end AXIS_DESCR
/end CHARACTERISTIC
/begin MEASUREMENT iga_sp_max_1_h_rng "Maximum ignition angle depending on torque intervention" SWORD _CNV_A_R_LINEAR_____166_CM 1 100. -90. 90. DISPLAY_IDENTIFIER IGA_SP_MAX_1_H_RNG ECU_ADDRESS 0xd00050fa FORMAT "%8.4" /end MEASUREMENT
/begin MEASUREMENT iga_sp_max_1_can_h_rng "Maximum ignition angle depending on torque intervention" SWORD _CNV_A_R_LINEAR_____166_CM 1 100. -90. 90. DISPLAY_IDENTIFIER IGA_SP_MAX_1_CAN_H_RNG ECU_ADDRESS 0xd00050f8 FORMAT "%8.4" /end MEASUREMENT
/begin MEASUREMENT iga_av_mv_can_h_rng "Mean value of actual ignition angle" SWORD _CNV_A_R_LINEAR_____166_CM 1 100. -90. 90. DISPLAY_IDENTIFIER IGA_AV_MV_CAN_H_RNG ECU_ADDRESS 0xd00050d6 FORMAT "%8.4" /end MEASUREMENT
/begin CHARACTERISTIC c_iga_ini_h_rng "Init value for ignition angle" VALUE 0xa10294b0 _REC_VAL_20_s2 180. _CNV_A_R_LINEAR_____166_CM -90. 90. DISPLAY_IDENTIFIER C_IGA_INI_H_RNG FORMAT "%8.4" /end CHARACTERISTIC
/begin CHARACTERISTIC lc_iga_man "Logical constant for stratified mode" VALUE 0xa1029d44 _REC_VAL_20_u1 1. _CNV_A_R_LINEAR_____0_CM 0. 1. DISPLAY_IDENTIFIER LC_IGA_MAN FORMAT "%1.0" /end CHARACTERISTIC
/begin CHARACTERISTIC c_iga_as "Spark retard by application system global" VALUE 0xa10294a1 _REC_VAL_20_s1 95.625 _CNV_A_R_LINEAR_____168_CM -48. 47.625 DISPLAY_IDENTIFIER C_IGA_AS FORMAT "%5.1" /end CHARACTERISTIC
/begin CHARACTERISTIC c_iga_man_h_rng "Constant for stratified mode" VALUE 0xa10294b6 _REC_VAL_20_s2 180. _CNV_A_R_LINEAR_____166_CM -90. 90. DISPLAY_IDENTIFIER C_IGA_MAN_H_RNG FORMAT "%8.4" /end CHARACTERISTIC
/begin CHARACTERISTIC c_iga_as_cyl[0] "Spark retard by application system cylinder" VALUE 0xa10294a2 _REC_VAL_20_s1 4.78125 _CNV_A_R_LINEAR_____168_CM -48. 47.625 DISPLAY_IDENTIFIER C_IGA_AS_CYL[0] FORMAT "%5.1" /end CHARACTERISTIC
/begin CHARACTERISTIC c_iga_as_cyl[1] "Spark retard by application system cylinder" VALUE 0xa10294a3 _REC_VAL_20_s1 4.78125 _CNV_A_R_LINEAR_____168_CM -48. 47.625 DISPLAY_IDENTIFIER C_IGA_AS_CYL[1] FORMAT "%5.1" /end CHARACTERISTIC
/begin CHARACTERISTIC c_iga_as_cyl[2] "Spark retard by application system cylinder" VALUE 0xa10294a4 _REC_VAL_20_s1 4.78125 _CNV_A_R_LINEAR_____168_CM -48. 47.625 DISPLAY_IDENTIFIER C_IGA_AS_CYL[2] FORMAT "%5.1" /end CHARACTERISTIC
/begin CHARACTERISTIC c_iga_as_cyl[3] "Spark retard by application system cylinder" VALUE 0xa10294a5 _REC_VAL_20_s1 4.78125 _CNV_A_R_LINEAR_____168_CM -48. 47.625 DISPLAY_IDENTIFIER C_IGA_AS_CYL[3] FORMAT "%5.1" /end CHARACTERISTIC
/begin CHARACTERISTIC c_iga_as_cyl[4] "Spark retard by application system cylinder" VALUE 0xa10294a6 _REC_VAL_20_s1 4.78125 _CNV_A_R_LINEAR_____168_CM -48. 47.625 DISPLAY_IDENTIFIER C_IGA_AS_CYL[4] FORMAT "%5.1" /end CHARACTERISTIC
/begin CHARACTERISTIC c_iga_as_cyl[5] "Spark retard by application system cylinder" VALUE 0xa10294a7 _REC_VAL_20_s1 4.78125 _CNV_A_R_LINEAR_____168_CM -48. 47.625 DISPLAY_IDENTIFIER C_IGA_AS_CYL[5] FORMAT "%5.1" /end CHARACTERISTIC
/begin AXIS_PTS ldpm_tco_1_igsp "" 0xa102220c tco _REC_AXS_20_u1 190.5 _CNV_A_R_LINEAR_____16_CM 8 -48. 142.5 FORMAT "%5.1" /end AXIS_PTS
/begin CHARACTERISTIC c_iga_min_etc_lih "Absolute possible spark retard at ETC_LIH" VALUE 0xa10294b8 _REC_VAL_20_u1 95.625 _CNV_A_R_LINEAR_____167_CM -35.625 60. DISPLAY_IDENTIFIER C_IGA_MIN_ETC_LIH FORMAT "%5.1" /end CHARACTERISTIC
/begin MEASUREMENT iga_av_h_rng[0] "Homogenous ignition angle applied on cylinder x" SWORD _CNV_A_R_LINEAR_____166_CM 1 100. -90. 90. DISPLAY_IDENTIFIER IGA_AV_H_RNG[0] ECU_ADDRESS 0xd00050dc FORMAT "%8.4" /end MEASUREMENT
/begin MEASUREMENT iga_av_h_rng[1] "Homogenous ignition angle applied on cylinder x" SWORD _CNV_A_R_LINEAR_____166_CM 1 100. -90. 90. DISPLAY_IDENTIFIER IGA_AV_H_RNG[1] ECU_ADDRESS 0xd00050de FORMAT "%8.4" /end MEASUREMENT
/begin MEASUREMENT iga_av_h_rng[2] "Homogenous ignition angle applied on cylinder x" SWORD _CNV_A_R_LINEAR_____166_CM 1 100. -90. 90. DISPLAY_IDENTIFIER IGA_AV_H_RNG[2] ECU_ADDRESS 0xd00050e0 FORMAT "%8.4" /end MEASUREMENT
/begin MEASUREMENT iga_av_h_rng[3] "Homogenous ignition angle applied on cylinder x" SWORD _CNV_A_R_LINEAR_____166_CM 1 100. -90. 90. DISPLAY_IDENTIFIER IGA_AV_H_RNG[3] ECU_ADDRESS 0xd00050e2 FORMAT "%8.4" /end MEASUREMENT
/begin MEASUREMENT iga_av_h_rng[4] "Homogenous ignition angle applied on cylinder x" SWORD _CNV_A_R_LINEAR_____166_CM 1 100. -90. 90. DISPLAY_IDENTIFIER IGA_AV_H_RNG[4] ECU_ADDRESS 0xd00050e4 FORMAT "%8.4" /end MEASUREMENT
/begin MEASUREMENT iga_av_h_rng[5] "Homogenous ignition angle applied on cylinder x" SWORD _CNV_A_R_LINEAR_____166_CM 1 100. -90. 90. DISPLAY_IDENTIFIER IGA_AV_H_RNG[5] ECU_ADDRESS 0xd00050e6 FORMAT "%8.4" /end MEASUREMENT
/begin MEASUREMENT iga_av_mv_h_rng "Mean value of actual ignition angle" SWORD _CNV_A_R_LINEAR_____166_CM 1 100. -90. 90. DISPLAY_IDENTIFIER IGA_AV_MV_H_RNG ECU_ADDRESS 0xd00050d4 FORMAT "%8.4" /end MEASUREMENT
/begin CHARACTERISTIC c_n_max_iga_10ms_clc "Max engine speed threshold above which the 10ms tasks are deactivated" VALUE 0xa1029626 _REC_VAL_20_u2 8160. _CNV_A_R_LINEAR_____13_CM 0. 8160. DISPLAY_IDENTIFIER C_N_MAX_IGA_10MS_CLC FORMAT "%4.0" /end CHARACTERISTIC
/begin MEASUREMENT iga_av_mv_cbk_h_rng[0] "Mean value of actual ignition angle" SWORD _CNV_A_R_LINEAR_____166_CM 1 100. -90. 90. DISPLAY_IDENTIFIER IGA_AV_MV_CBK_H_RNG[0] ECU_ADDRESS 0xd00050d8 FORMAT "%8.4" /end MEASUREMENT
/begin MEASUREMENT iga_av_mv_cbk_h_rng[1] "Mean value of actual ignition angle" SWORD _CNV_A_R_LINEAR_____166_CM 1 100. -90. 90. DISPLAY_IDENTIFIER IGA_AV_MV_CBK_H_RNG[1] ECU_ADDRESS 0xd00050da FORMAT "%8.4" /end MEASUREMENT
/begin MEASUREMENT iga_dif_min_h_rng "Difference of minimum ignition angle to reference ignition angle" UWORD _CNV_A_R_LINEAR_____169_CM 1 100. 0. -180. DISPLAY_IDENTIFIER IGA_DIF_MIN_H_RNG ECU_ADDRESS 0xd0005120 FORMAT "%8.4" /end MEASUREMENT
/begin MEASUREMENT iga_dif_min_delta_h_rng "Extra retard on IGA_DIF_MIN in case of torque intervention" UWORD _CNV_A_R_LINEAR_____169_CM 1 100. 0. -180. DISPLAY_IDENTIFIER IGA_DIF_MIN_DELTA_H_RNG ECU_ADDRESS 0xc000072c FORMAT "%8.4" /end MEASUREMENT
/begin MEASUREMENT lv_iga_dif_min_delta_act "Flag to enable and declare the acting of the extra retard on IGA_DIF_MIN" UBYTE _CNV_S_2_RANGE__0___1_CM 1 100. 0. 1. DISPLAY_IDENTIFIER LV_IGA_DIF_MIN_DELTA_ACT ECU_ADDRESS 0xc0000752 BIT_MASK 0x1 /end MEASUREMENT
/begin MEASUREMENT iga_dif_min_ast_h_rng "Intermediate variable: correction on IGA_DIF_MIN for combustion cycles after start management" SWORD _CNV_A_R_LINEAR_____166_CM 1 100. -90. 90. DISPLAY_IDENTIFIER IGA_DIF_MIN_AST_H_RNG ECU_ADDRESS 0xc000072e FORMAT "%8.4" /end MEASUREMENT
/begin CHARACTERISTIC c_iga_dif_min_delta_temp_ena "Maintaining time of extra retard on IGA_DIF_MIN" VALUE 0xa10294ad _REC_VAL_20_u1 2.55 _CNV_A_R_LINEAR_____3_CM 0. 2.55 DISPLAY_IDENTIFIER C_IGA_DIF_MIN_DELTA_TEMP_ENA FORMAT "%4.2" /end CHARACTERISTIC
/begin CHARACTERISTIC c_iga_dif_min_delta_lgrd_h_rng "Step gradient limitation after extra spark retard on IGA_DIF_MIN" VALUE 0xa10294aa _REC_VAL_20_u2 -180. _CNV_A_R_LINEAR_____169_CM 0. -180. DISPLAY_IDENTIFIER C_IGA_DIF_MIN_DELTA_LGRD_H_RNG FORMAT "%8.4" /end CHARACTERISTIC
/begin CHARACTERISTIC ip_iga_dif_min_tco_h_rng "TCO correction for minimum ignition angle" CURVE 0xa10253ec _REC_CUR_20_u2_u1 180. _CNV_A_R_LINEAR_____170_CM -90. 90. DISPLAY_IDENTIFIER IP_IGA_DIF_MIN_TCO_H_RNG FORMAT "%8.4"
 /begin AXIS_DESCR COM_AXIS tco _CNV_A_R_LINEAR_____16_CM 8 -48. 142.5 FORMAT "%5.1" AXIS_PTS_REF ldpm_tco_1_igsp /end AXIS_DESCR
/end CHARACTERISTIC
/begin CHARACTERISTIC ip_iga_dif_min_delta_h_rng "Extra spark retard on minimum ignition angle in case of torque intervention" MAP 0xa102536c _REC_MAP_20_u2_u1_u1 -180. _CNV_A_R_LINEAR_____169_CM 0. -180. DISPLAY_IDENTIFIER IP_IGA_DIF_MIN_DELTA_H_RNG FORMAT "%8.4"
 /begin AXIS_DESCR COM_AXIS n_32 _CNV_A_R_LINEAR_____9_CM 8 0. 8160. FORMAT "%4.0" AXIS_PTS_REF ldpm_n_32_2_igsp /end AXIS_DESCR
 /begin AXIS_DESCR COM_AXIS maf _CNV_A_R_LINEAR_____14_CM 6 0. 1389. FORMAT "%4.0" AXIS_PTS_REF ldpm_maf_hb_2_igsp /end AXIS_DESCR
/end CHARACTERISTIC
/begin CHARACTERISTIC c_iga_dif_min_delta_temp_dis "Disable time of extra spark retard on IGA_DIF_MIN after end of gradient return" VALUE 0xa10294ac _REC_VAL_20_u1 2.55 _CNV_A_R_LINEAR_____3_CM 0. 2.55 DISPLAY_IDENTIFIER C_IGA_DIF_MIN_DELTA_TEMP_DIS FORMAT "%4.2" /end CHARACTERISTIC
/begin AXIS_PTS ldpm_cyc_cast_ip_iga_dif_min "" 0xa1021984 cyc_cast _REC_AXS_20_u2 65535. _CNV_A_R_LINEAR_____0_CM 8 0. 65535. FORMAT "%5.0" /end AXIS_PTS
/begin AXIS_PTS ldpm_n_32_2_igsp "" 0xa1021db8 n_32 _REC_AXS_20_u1 8160. _CNV_A_R_LINEAR_____9_CM 8 0. 8160. FORMAT "%4.0" /end AXIS_PTS
/begin AXIS_PTS ldpm_maf_hb_2_igsp "" 0xa1021c36 maf _REC_AXS_20_u1 1389. _CNV_A_R_LINEAR_____14_CM 6 0. 1389. FORMAT "%4.0" /end AXIS_PTS
/begin CHARACTERISTIC ip_iga_dif_min_cyc_mt "Correction on minimum ignition angle for combustion cycles after start for automatic transmission" MAP 0xa102532c _REC_MAP_20_u1_u2_u1 95.625 _CNV_A_R_LINEAR_____171_CM -48. 47.625 DISPLAY_IDENTIFIER IP_IGA_DIF_MIN_CYC_MT FORMAT "%5.1"
 /begin AXIS_DESCR COM_AXIS cyc_cast _CNV_A_R_LINEAR_____0_CM 8 0. 65535. FORMAT "%5.0" AXIS_PTS_REF ldpm_cyc_cast_ip_iga_dif_min /end AXIS_DESCR
 /begin AXIS_DESCR COM_AXIS tco _CNV_A_R_LINEAR_____16_CM 8 -48. 142.5 FORMAT "%5.1" AXIS_PTS_REF ldpm_tco_1_igsp /end AXIS_DESCR
/end CHARACTERISTIC
/begin CHARACTERISTIC ip_iga_dif_min_cyc_at "Correction on minimum ignition angle for combustion cycles after start for manual transmission" MAP 0xa10252ec _REC_MAP_20_u1_u2_u1 95.625 _CNV_A_R_LINEAR_____171_CM -48. 47.625 DISPLAY_IDENTIFIER IP_IGA_DIF_MIN_CYC_AT FORMAT "%5.1"
 /begin AXIS_DESCR COM_AXIS cyc_cast _CNV_A_R_LINEAR_____0_CM 8 0. 65535. FORMAT "%5.0" AXIS_PTS_REF ldpm_cyc_cast_ip_iga_dif_min /end AXIS_DESCR
 /begin AXIS_DESCR COM_AXIS tco _CNV_A_R_LINEAR_____16_CM 8 -48. 142.5 FORMAT "%5.1" AXIS_PTS_REF ldpm_tco_1_igsp /end AXIS_DESCR
/end CHARACTERISTIC
/begin AXIS_PTS ldp_amp_ip_iga_dif_min_cyc_amp "" 0xa102086c amp _REC_AXS_20_u2 5434. _CNV_A_R_LINEAR_____26_CM 6 0. 5434. FORMAT "%7.2" /end AXIS_PTS
/begin CHARACTERISTIC ip_iga_dif_min_cyc_amp_at_h_rng "Attitude correction on minimum ignition angle for after start for automatic transmission" MAP 0xa10251fc _REC_MAP_20_u2_u2_u1 180. _CNV_A_R_LINEAR_____170_CM -90. 90. DISPLAY_IDENTIFIER IP_IGA_DIF_MIN_CYC_AMP_AT_H_RNG FORMAT "%8.4"
 /begin AXIS_DESCR COM_AXIS amp _CNV_A_R_LINEAR_____26_CM 6 0. 5434. FORMAT "%7.2" AXIS_PTS_REF ldp_amp_ip_iga_dif_min_cyc_amp /end AXIS_DESCR
 /begin AXIS_DESCR COM_AXIS tco _CNV_A_R_LINEAR_____16_CM 8 -48. 142.5 FORMAT "%5.1" AXIS_PTS_REF ldpm_tco_1_igsp /end AXIS_DESCR
/end CHARACTERISTIC
/begin CHARACTERISTIC ip_iga_dif_min_cyc_amp_mt_h_rng "Attitude correction on minimum ignition angle for after start for manual transmission" MAP 0xa102528c _REC_MAP_20_u2_u2_u1 180. _CNV_A_R_LINEAR_____170_CM -90. 90. DISPLAY_IDENTIFIER IP_IGA_DIF_MIN_CYC_AMP_MT_H_RNG FORMAT "%8.4"
 /begin AXIS_DESCR COM_AXIS amp _CNV_A_R_LINEAR_____26_CM 6 0. 5434. FORMAT "%7.2" AXIS_PTS_REF ldp_amp_ip_iga_dif_min_cyc_amp /end AXIS_DESCR
 /begin AXIS_DESCR COM_AXIS tco _CNV_A_R_LINEAR_____16_CM 8 -48. 142.5 FORMAT "%5.1" AXIS_PTS_REF ldpm_tco_1_igsp /end AXIS_DESCR
/end CHARACTERISTIC
/begin MEASUREMENT lv_iga_min_ext "Flag to enable external IGA_MIN" UBYTE _CNV_S_2_RANGE__0___1_CM 1 100. 0. 1. DISPLAY_IDENTIFIER LV_IGA_MIN_EXT ECU_ADDRESS 0xc0000753 BIT_MASK 0x1 /end MEASUREMENT
/begin MEASUREMENT iga_min_bas_h_rng "Basic minimum ignition angle" SWORD _CNV_A_R_LINEAR_____166_CM 1 100. -90. 90. DISPLAY_IDENTIFIER IGA_MIN_BAS_H_RNG ECU_ADDRESS 0xc000073a FORMAT "%8.4" /end MEASUREMENT
/begin MEASUREMENT iga_min_bas_1_h_rng "Intermediate value: Basic minimum ignition angle" SWORD _CNV_A_R_LINEAR_____166_CM 1 100. -90. 90. DISPLAY_IDENTIFIER IGA_MIN_BAS_1_H_RNG ECU_ADDRESS 0xc0000730 FORMAT "%8.4" /end MEASUREMENT
/begin MEASUREMENT iga_min_bas_ext_h_rng "Intermediate value: Basic minimum ignition angle" SWORD _CNV_A_R_LINEAR_____166_CM 1 100. -90. 90. DISPLAY_IDENTIFIER IGA_MIN_BAS_EXT_H_RNG ECU_ADDRESS 0xc0000734 FORMAT "%8.4" /end MEASUREMENT
/begin MEASUREMENT iga_min_bas_int_h_rng "Intermediate value: Basic minimum ignition angle" SWORD _CNV_A_R_LINEAR_____166_CM 1 100. -90. 90. DISPLAY_IDENTIFIER IGA_MIN_BAS_INT_H_RNG ECU_ADDRESS 0xc0000738 FORMAT "%8.4" /end MEASUREMENT
/begin CHARACTERISTIC ip_iga_min_n_maf_ext_h_rng "Basic minimum ignition angle difference value" MAP 0xa1025590 _REC_MAP_20_u2_u1_u1 180. _CNV_A_R_LINEAR_____170_CM -90. 90. DISPLAY_IDENTIFIER IP_IGA_MIN_N_MAF_EXT_H_RNG FORMAT "%8.4"
 /begin AXIS_DESCR COM_AXIS n_32 _CNV_A_R_LINEAR_____9_CM 8 0. 8160. FORMAT "%4.0" AXIS_PTS_REF ldpm_n_32_2_igsp /end AXIS_DESCR
 /begin AXIS_DESCR COM_AXIS maf _CNV_A_R_LINEAR_____14_CM 6 0. 1389. FORMAT "%4.0" AXIS_PTS_REF ldpm_maf_hb_2_igsp /end AXIS_DESCR
/end CHARACTERISTIC
/begin CHARACTERISTIC ip_iga_dif_min_tco_ext_h_rng "TCO correction for minimum ignition angle" CURVE 0xa10253dc _REC_CUR_20_u2_u1 180. _CNV_A_R_LINEAR_____170_CM -90. 90. DISPLAY_IDENTIFIER IP_IGA_DIF_MIN_TCO_EXT_H_RNG FORMAT "%8.4"
 /begin AXIS_DESCR COM_AXIS tco _CNV_A_R_LINEAR_____16_CM 8 -48. 142.5 FORMAT "%5.1" AXIS_PTS_REF ldpm_tco_1_igsp /end AXIS_DESCR
/end CHARACTERISTIC
/begin CHARACTERISTIC ip_iga_min_n_maf_h_rng "Basic minimum ignition angle difference value" MAP 0xa10255f0 _REC_MAP_20_u2_u1_u1 180. _CNV_A_R_LINEAR_____170_CM -90. 90. DISPLAY_IDENTIFIER IP_IGA_MIN_N_MAF_H_RNG FORMAT "%8.4"
 /begin AXIS_DESCR COM_AXIS n_32 _CNV_A_R_LINEAR_____9_CM 8 0. 8160. FORMAT "%4.0" AXIS_PTS_REF ldpm_n_32_2_igsp /end AXIS_DESCR
 /begin AXIS_DESCR COM_AXIS maf _CNV_A_R_LINEAR_____14_CM 6 0. 1389. FORMAT "%4.0" AXIS_PTS_REF ldpm_maf_hb_2_igsp /end AXIS_DESCR
/end CHARACTERISTIC
/begin CHARACTERISTIC ip_fac_iga_min_tco_ext "Scaling TCO correction for minimum ignition angle" MAP 0xa1023a58 _REC_MAP_20_u1_u1_u1 0.99609375 _CNV_A_R_LINEAR_____71_CM 0. 0.99609375 DISPLAY_IDENTIFIER IP_FAC_IGA_MIN_TCO_EXT FORMAT "%5.3"
 /begin AXIS_DESCR COM_AXIS n_32 _CNV_A_R_LINEAR_____9_CM 8 0. 8160. FORMAT "%4.0" AXIS_PTS_REF ldpm_n_32_2_igsp /end AXIS_DESCR
 /begin AXIS_DESCR COM_AXIS maf _CNV_A_R_LINEAR_____14_CM 6 0. 1389. FORMAT "%4.0" AXIS_PTS_REF ldpm_maf_hb_2_igsp /end AXIS_DESCR
/end CHARACTERISTIC
/begin CHARACTERISTIC ip_fac_iga_dif_ast "Scaling N_DIF correction for minimum ignition angle after start" CURVE 0xa1023a08 _REC_CUR_20_u1_u2 1.9921875 _CNV_A_R_LINEAR_____100_CM 0. 1.9921875 DISPLAY_IDENTIFIER IP_FAC_IGA_DIF_AST FORMAT "%5.3"
 /begin AXIS_DESCR COM_AXIS n_dif _CNV_A_R_LINEAR_____172_CM 8 -32768. 32767. FORMAT "%6.0" AXIS_PTS_REF ldpm_n_dif_igsp /end AXIS_DESCR
/end CHARACTERISTIC
/begin CHARACTERISTIC ip_t_iga_min_puc "Scaling N_32 correction for minimum ignition angle after start" CURVE 0xa1027c58 _REC_CUR_20_u1_u1 2.55 _CNV_A_R_LINEAR_____3_CM 0. 2.55 DISPLAY_IDENTIFIER IP_T_IGA_MIN_PUC FORMAT "%4.2"
 /begin AXIS_DESCR COM_AXIS n_32 _CNV_A_R_LINEAR_____9_CM 8 0. 8160. FORMAT "%4.0" AXIS_PTS_REF ldpm_n_32_2_igsp /end AXIS_DESCR
/end CHARACTERISTIC
/begin CHARACTERISTIC c_iga_dif_min_bas_lgrd_h_rng "Step gradient limitation" VALUE 0xa10294a8 _REC_VAL_20_u2 180. _CNV_A_R_LINEAR_____166_CM 0. 180. DISPLAY_IDENTIFIER C_IGA_DIF_MIN_BAS_LGRD_H_RNG FORMAT "%8.4" /end CHARACTERISTIC
/begin CHARACTERISTIC c_iga_min_puc_lgrd_h_rng "Step gradient limitation" VALUE 0xa10294ba _REC_VAL_20_u2 180. _CNV_A_R_LINEAR_____166_CM 0. 180. DISPLAY_IDENTIFIER C_IGA_MIN_PUC_LGRD_H_RNG FORMAT "%8.4" /end CHARACTERISTIC
/begin MEASUREMENT iga_min_bas_puc_h_rng "Intermediate value: Basic minimum ignition angle" SWORD _CNV_A_R_LINEAR_____166_CM 1 100. -90. 90. DISPLAY_IDENTIFIER IGA_MIN_BAS_PUC_H_RNG ECU_ADDRESS 0xc0000736 FORMAT "%8.4" /end MEASUREMENT
/begin MEASUREMENT iga_min_bas_pu_h_rng "Intermediate value: PU minimum ignition angle" SWORD _CNV_A_R_LINEAR_____166_CM 1 100. -90. 90. DISPLAY_IDENTIFIER IGA_MIN_BAS_PU_H_RNG ECU_ADDRESS 0xc0000732 FORMAT "%8.4" /end MEASUREMENT
/begin CHARACTERISTIC ip_fac_iga_min_tco_pu "Scaling TCO correction for minimum ignition angle" MAP 0xa1023a88 _REC_MAP_20_u1_u1_u1 0.99609375 _CNV_A_R_LINEAR_____71_CM 0. 0.99609375 DISPLAY_IDENTIFIER IP_FAC_IGA_MIN_TCO_PU FORMAT "%5.3"
 /begin AXIS_DESCR COM_AXIS n_32 _CNV_A_R_LINEAR_____9_CM 8 0. 8160. FORMAT "%4.0" AXIS_PTS_REF ldpm_n_32_2_igsp /end AXIS_DESCR
 /begin AXIS_DESCR COM_AXIS maf _CNV_A_R_LINEAR_____14_CM 6 0. 1389. FORMAT "%4.0" AXIS_PTS_REF ldpm_maf_hb_2_igsp /end AXIS_DESCR
/end CHARACTERISTIC
/begin CHARACTERISTIC ip_iga_dif_min_tco_pu_h_rng "TCO correction for minimum ignition angle" CURVE 0xa1025404 _REC_CUR_20_u2_u1 180. _CNV_A_R_LINEAR_____170_CM -90. 90. DISPLAY_IDENTIFIER IP_IGA_DIF_MIN_TCO_PU_H_RNG FORMAT "%8.4"
 /begin AXIS_DESCR COM_AXIS tco _CNV_A_R_LINEAR_____16_CM 8 -48. 142.5 FORMAT "%5.1" AXIS_PTS_REF ldpm_tco_1_igsp /end AXIS_DESCR
/end CHARACTERISTIC
/begin CHARACTERISTIC ip_iga_min_n_maf_pu_h_rng "Basic minimum ignition angle difference value" MAP 0xa1025680 _REC_MAP_20_u2_u1_u1 180. _CNV_A_R_LINEAR_____170_CM -90. 90. DISPLAY_IDENTIFIER IP_IGA_MIN_N_MAF_PU_H_RNG FORMAT "%8.4"
 /begin AXIS_DESCR COM_AXIS n_32 _CNV_A_R_LINEAR_____9_CM 8 0. 8160. FORMAT "%4.0" AXIS_PTS_REF ldpm_n_32_2_igsp /end AXIS_DESCR
 /begin AXIS_DESCR COM_AXIS maf _CNV_A_R_LINEAR_____14_CM 6 0. 1389. FORMAT "%4.0" AXIS_PTS_REF ldpm_maf_hb_2_igsp /end AXIS_DESCR
/end CHARACTERISTIC
/begin AXIS_PTS ldpm_n_dif_igsp "" 0xa1021fc0 n_dif _REC_AXS_20_u2 65535. _CNV_A_R_LINEAR_____172_CM 8 -32768. 32767. FORMAT "%6.0" /end AXIS_PTS
/begin CHARACTERISTIC ip_fac_iga_min_tco "Scaling TCO correction for minimum ignition angle" MAP 0xa1023a28 _REC_MAP_20_u1_u1_u1 0.99609375 _CNV_A_R_LINEAR_____71_CM 0. 0.99609375 DISPLAY_IDENTIFIER IP_FAC_IGA_MIN_TCO FORMAT "%5.3"
 /begin AXIS_DESCR COM_AXIS n_32 _CNV_A_R_LINEAR_____9_CM 8 0. 8160. FORMAT "%4.0" AXIS_PTS_REF ldpm_n_32_2_igsp /end AXIS_DESCR
 /begin AXIS_DESCR COM_AXIS maf _CNV_A_R_LINEAR_____14_CM 6 0. 1389. FORMAT "%4.0" AXIS_PTS_REF ldpm_maf_hb_2_igsp /end AXIS_DESCR
/end CHARACTERISTIC
/begin CHARACTERISTIC ip_fac_iga_dif_min_amp "Scaling TCO correction for minimum ignition angle" CURVE 0xa1023a10 _REC_CUR_20_u1_u2 0.99609375 _CNV_A_R_LINEAR_____71_CM 0. 0.99609375 DISPLAY_IDENTIFIER IP_FAC_IGA_DIF_MIN_AMP FORMAT "%5.3"
 /begin AXIS_DESCR COM_AXIS cyc_cast _CNV_A_R_LINEAR_____0_CM 8 0. 65535. FORMAT "%5.0" AXIS_PTS_REF ldpm_cyc_cast_ip_iga_dif_min /end AXIS_DESCR
/end CHARACTERISTIC
/begin CHARACTERISTIC ip_iga_min_ch_cor_h_rng "Offset on basic minimum ignition angle caused by cat heating" MAP 0xa10254d0 _REC_MAP_20_u2_u1_u1 180. _CNV_A_R_LINEAR_____170_CM -90. 90. DISPLAY_IDENTIFIER IP_IGA_MIN_CH_COR_H_RNG FORMAT "%8.4"
 /begin AXIS_DESCR COM_AXIS n_32 _CNV_A_R_LINEAR_____9_CM 8 0. 8160. FORMAT "%4.0" AXIS_PTS_REF ldpm_n_32_2_igsp /end AXIS_DESCR
 /begin AXIS_DESCR COM_AXIS maf _CNV_A_R_LINEAR_____14_CM 6 0. 1389. FORMAT "%4.0" AXIS_PTS_REF ldpm_maf_hb_2_igsp /end AXIS_DESCR
/end CHARACTERISTIC
/begin CHARACTERISTIC ip_iga_min_opm_cor_h_rng "Offset on basic minimum ignition angle caused by engine throttled mode" MAP 0xa1025710 _REC_MAP_20_u2_u1_u1 180. _CNV_A_R_LINEAR_____170_CM -90. 90. DISPLAY_IDENTIFIER IP_IGA_MIN_OPM_COR_H_RNG FORMAT "%8.4"
 /begin AXIS_DESCR COM_AXIS n_32 _CNV_A_R_LINEAR_____9_CM 8 0. 8160. FORMAT "%4.0" AXIS_PTS_REF ldpm_n_32_2_igsp /end AXIS_DESCR
 /begin AXIS_DESCR COM_AXIS maf _CNV_A_R_LINEAR_____14_CM 6 0. 1389. FORMAT "%4.0" AXIS_PTS_REF ldpm_maf_hb_2_igsp /end AXIS_DESCR
/end CHARACTERISTIC
/begin CHARACTERISTIC id_iga_min_opm_av "Interpretation map for changing actual operation mode dependency" CURVE 0xa10229c4 _REC_CUR_20_u1_u1 7. _CNV_A_R_LINEAR_____0_CM 1. 8. DISPLAY_IDENTIFIER ID_IGA_MIN_OPM_AV FORMAT "%1.0"
 /begin AXIS_DESCR COM_AXIS opm_av _CNV_A_R_LINEAR_____0_CM 8 0. 8. FORMAT "%1.0" AXIS_PTS_REF ldpm_opm_av /end AXIS_DESCR
/end CHARACTERISTIC
/begin CHARACTERISTIC id_iga_min_opm_req "Interpretation map for changing requested operation mode dependency" CURVE 0xa10229cc _REC_CUR_20_u1_u1 7. _CNV_A_R_LINEAR_____0_CM 1. 8. DISPLAY_IDENTIFIER ID_IGA_MIN_OPM_REQ FORMAT "%1.0"
 /begin AXIS_DESCR COM_AXIS opm_req _CNV_A_R_LINEAR_____0_CM 8 0. 8. FORMAT "%1.0" AXIS_PTS_REF ldpm_opm_req /end AXIS_DESCR
/end CHARACTERISTIC
/begin MEASUREMENT iga_min_bas_2_h_rng "Basic minimum ignition angle" SWORD _CNV_A_R_LINEAR_____166_CM 1 100. -90. 90. DISPLAY_IDENTIFIER IGA_MIN_BAS_2_H_RNG ECU_ADDRESS 0xc000073c FORMAT "%8.4" /end MEASUREMENT
/begin MEASUREMENT lv_iga_min_opm_sel_1 "Flag to indicate operation mode 1 is active" UBYTE _CNV_S_2_RANGE__0___1_CM 1 100. 0. 1. DISPLAY_IDENTIFIER LV_IGA_MIN_OPM_SEL_1 ECU_ADDRESS 0xc0000754 BIT_MASK 0x1 /end MEASUREMENT
/begin MEASUREMENT lv_iga_min_opm_sel_2 "Flag to indicate operation mode 2 is active" UBYTE _CNV_S_2_RANGE__0___1_CM 1 100. 0. 1. DISPLAY_IDENTIFIER LV_IGA_MIN_OPM_SEL_2 ECU_ADDRESS 0xc0000755 BIT_MASK 0x1 /end MEASUREMENT
/begin MEASUREMENT lv_iga_min_opm_rls "Flag to indicate operation mode is plausible" UBYTE _CNV_S_2_RANGE__0___1_CM 1 100. 0. 1. DISPLAY_IDENTIFIER LV_IGA_MIN_OPM_RLS ECU_ADDRESS 0xc0000756 BIT_MASK 0x1 /end MEASUREMENT
/begin MEASUREMENT iga_min_bas_opm_h_rng "Basic ignition angle depending on operation mode" UWORD _CNV_A_R_LINEAR_____170_CM 1 100. -90. 90. DISPLAY_IDENTIFIER IGA_MIN_BAS_OPM_H_RNG ECU_ADDRESS 0xc0000742 FORMAT "%8.4" /end MEASUREMENT
/begin MEASUREMENT iga_min_bas_2_opm_1_h_rng "Basic minimum ignition angle regarding cat heating and OPM 1" UWORD _CNV_A_R_LINEAR_____170_CM 1 100. -90. 90. DISPLAY_IDENTIFIER IGA_MIN_BAS_2_OPM_1_H_RNG ECU_ADDRESS 0xc000073e FORMAT "%8.4" /end MEASUREMENT
/begin MEASUREMENT iga_min_bas_2_opm_2_h_rng "Basic minimum ignition angle regarding cat heating and OPM 2" UWORD _CNV_A_R_LINEAR_____170_CM 1 100. -90. 90. DISPLAY_IDENTIFIER IGA_MIN_BAS_2_OPM_2_H_RNG ECU_ADDRESS 0xc0000740 FORMAT "%8.4" /end MEASUREMENT
/begin MEASUREMENT iga_dif_sp_h_rng "Setpoint subtrahend ignition angle" UWORD _CNV_A_R_LINEAR_____169_CM 1 100. 0. -180. DISPLAY_IDENTIFIER IGA_DIF_SP_H_RNG ECU_ADDRESS 0xd0005128 FORMAT "%8.4" /end MEASUREMENT
/begin MEASUREMENT lv_tq_iga_act "Logical variable torque intervention by spark retard is active" UBYTE _CNV_S_2_RANGE__0___1_CM 1 100. 0. 1. DISPLAY_IDENTIFIER LV_TQ_IGA_ACT ECU_ADDRESS 0xd0003cec BIT_MASK 0x1 /end MEASUREMENT
/begin MEASUREMENT lv_tq_iga_req "Logical variable torque intervention by spark retard is request" UBYTE _CNV_S_2_RANGE__0___1_CM 1 100. 0. 1. DISPLAY_IDENTIFIER LV_TQ_IGA_REQ ECU_ADDRESS 0xc000076c BIT_MASK 0x1 /end MEASUREMENT
/begin CHARACTERISTIC lc_tq_iga_inh "Logical constant inhibition torque intervention by spark retard" VALUE 0xa1029dfb _REC_VAL_20_u1 1. _CNV_A_R_LINEAR_____0_CM 0. 1. DISPLAY_IDENTIFIER LC_TQ_IGA_INH FORMAT "%1.0" /end CHARACTERISTIC
/begin CHARACTERISTIC c_eff_iga_thd_1 "Threshold ignition efficiency for deactivation spark retard" VALUE 0xa1029318 _REC_VAL_20_u2 1.99996948242188 _CNV_A_R_LINEAR_____8_CM 0. 1.99996948242188 DISPLAY_IDENTIFIER C_EFF_IGA_THD_1 FORMAT "%7.5" /end CHARACTERISTIC
/begin CHARACTERISTIC c_eff_iga_thd_aj "Threshold ignition efficiency for deactivation spark retard in anti-jerk intervention" VALUE 0xa102931a _REC_VAL_20_u2 1.99996948242188 _CNV_A_R_LINEAR_____8_CM 0. 1.99996948242188 DISPLAY_IDENTIFIER C_EFF_IGA_THD_AJ FORMAT "%7.5" /end CHARACTERISTIC
/begin CHARACTERISTIC c_eff_iga_thd_is "Threshold ignition efficiency for deactivation spark retard" VALUE 0xa102931c _REC_VAL_20_u2 1.99996948242188 _CNV_A_R_LINEAR_____8_CM 0. 1.99996948242188 DISPLAY_IDENTIFIER C_EFF_IGA_THD_IS FORMAT "%7.5" /end CHARACTERISTIC
/begin MEASUREMENT eff_iga_sp_can "Setpoint ignition efficiency for CAN" UWORD _CNV_A_R_LINEAR_____8_CM 1 100. 0. 1.99996948242188 DISPLAY_IDENTIFIER EFF_IGA_SP_CAN ECU_ADDRESS 0xc0000760 FORMAT "%7.5" /end MEASUREMENT
/begin MEASUREMENT eff_iga_sp_1 "Setpoint ignition efficiency" UWORD _CNV_A_R_LINEAR_____8_CM 1 100. 0. 1.99996948242188 DISPLAY_IDENTIFIER EFF_IGA_SP_1 ECU_ADDRESS 0xc000075e FORMAT "%7.5" /end MEASUREMENT
/begin MEASUREMENT eff_iga_sp_1_can "Setpoint ignition efficiency for CAN" UWORD _CNV_A_R_LINEAR_____8_CM 1 100. 0. 1.99996948242188 DISPLAY_IDENTIFIER EFF_IGA_SP_1_CAN ECU_ADDRESS 0xc0000762 FORMAT "%7.5" /end MEASUREMENT
/begin MEASUREMENT iga_sp_h_rng "Setpoint ignition angle from torque management" SWORD _CNV_A_R_LINEAR_____166_CM 1 100. -90. 90. DISPLAY_IDENTIFIER IGA_SP_H_RNG ECU_ADDRESS 0xd0005124 FORMAT "%8.4" /end MEASUREMENT
/begin MEASUREMENT iga_sp_can_h_rng "Setpoint ignition angle from torque management for CAN" SWORD _CNV_A_R_LINEAR_____166_CM 1 100. -90. 90. DISPLAY_IDENTIFIER IGA_SP_CAN_H_RNG ECU_ADDRESS 0xd0005126 FORMAT "%8.4" /end MEASUREMENT
/begin CHARACTERISTIC ip_iga_dif_sp_h_rng "Setpoint spark retard for torque setpoint" CURVE 0xa1025454 _REC_CUR_20_u2_u2 -180. _CNV_A_R_LINEAR_____169_CM 0. -180. DISPLAY_IDENTIFIER IP_IGA_DIF_SP_H_RNG FORMAT "%8.4"
 /begin AXIS_DESCR COM_AXIS eff_iga_inv_cor _CNV_A_R_LINEAR_____173_CM 16 0. 100. FORMAT "%5.3" AXIS_PTS_REF ldp_eff_iga_inv_cor_ip_iga_dif /end AXIS_DESCR
/end CHARACTERISTIC
/begin AXIS_PTS ldp_eff_iga_inv_cor_ip_iga_dif "" 0xa10208d0 eff_iga_inv_cor _REC_AXS_20_u2 100. _CNV_A_R_LINEAR_____173_CM 16 0. 100. FORMAT "%5.3" /end AXIS_PTS
/begin MEASUREMENT eff_iga_sp "Setpoint ignition efficiency" UWORD _CNV_A_R_LINEAR_____8_CM 1 100. 0. 1.99996948242188 DISPLAY_IDENTIFIER EFF_IGA_SP ECU_ADDRESS 0xc000075c FORMAT "%7.5" /end MEASUREMENT
/begin MEASUREMENT eff_iga_inv_cor "Setpoint ignition efficiency: inverted and corrected depending on engine state" UWORD _CNV_A_R_LINEAR_____173_CM 1 100. 0. 100. DISPLAY_IDENTIFIER EFF_IGA_INV_COR ECU_ADDRESS 0xc0000764 FORMAT "%5.3" /end MEASUREMENT
/begin MEASUREMENT eff_iga_inv_cor_can "Setpoint ignition efficiency CAN: inverted and corrected depending on engine state" UWORD _CNV_A_R_LINEAR_____173_CM 1 100. 0. 100. DISPLAY_IDENTIFIER EFF_IGA_INV_COR_CAN ECU_ADDRESS 0xc0000766 FORMAT "%5.3" /end MEASUREMENT
/begin CHARACTERISTIC ip_iga_dif_sp "Setpoint spark retard for torque setpoint" CURVE 0xa1025444 _REC_CUR_20_u1_u2 -95.625 _CNV_A_R_LINEAR_____174_CM 0. -95.625 DISPLAY_IDENTIFIER IP_IGA_DIF_SP FORMAT "%5.1"
 /begin AXIS_DESCR COM_AXIS eff_iga_inv_cor _CNV_A_R_LINEAR_____173_CM 16 0. 100. FORMAT "%5.3" AXIS_PTS_REF ldp_eff_iga_inv_cor_ip_iga_dif /end AXIS_DESCR
/end CHARACTERISTIC
/begin MEASUREMENT iga_sp "Setpoint ignition angle from torque management" UBYTE _CNV_A_R_LINEAR_____167_CM 1 100. -35.625 60. DISPLAY_IDENTIFIER IGA_SP ECU_ADDRESS 0xd0003cf4 FORMAT "%5.1" /end MEASUREMENT
/begin MEASUREMENT iga_dif_sp "Setpoint subtrahend ignition angle" UBYTE _CNV_A_R_LINEAR_____174_CM 1 100. 0. -95.625 DISPLAY_IDENTIFIER IGA_DIF_SP ECU_ADDRESS 0xd0003cf6 FORMAT "%5.1" /end MEASUREMENT
/begin MEASUREMENT iga_sp_can "Setpoint ignition angle from torque management for CAN" UBYTE _CNV_A_R_LINEAR_____167_CM 1 100. -35.625 60. DISPLAY_IDENTIFIER IGA_SP_CAN ECU_ADDRESS 0xd0003cf5 FORMAT "%5.1" /end MEASUREMENT
/begin MEASUREMENT iga_dif_min "Difference of minimum ignition angle to reference ignition angle" UBYTE _CNV_A_R_LINEAR_____174_CM 1 100. 0. -95.625 DISPLAY_IDENTIFIER IGA_DIF_MIN ECU_ADDRESS 0xd0003cf7 FORMAT "%5.1" /end MEASUREMENT
/begin CHARACTERISTIC ip_iga_dif_min_cyc_amp_at "Attitude correction on minimum ignition angle for after start for automatic transmission" MAP 0xa10251cc _REC_MAP_20_u1_u2_u1 95.625 _CNV_A_R_LINEAR_____171_CM -48. 47.625 DISPLAY_IDENTIFIER IP_IGA_DIF_MIN_CYC_AMP_AT FORMAT "%5.1"
 /begin AXIS_DESCR COM_AXIS amp _CNV_A_R_LINEAR_____26_CM 6 0. 5434. FORMAT "%7.2" AXIS_PTS_REF ldp_amp_ip_iga_dif_min_cyc_amp /end AXIS_DESCR
 /begin AXIS_DESCR COM_AXIS tco _CNV_A_R_LINEAR_____16_CM 8 -48. 142.5 FORMAT "%5.1" AXIS_PTS_REF ldpm_tco_1_igsp /end AXIS_DESCR
/end CHARACTERISTIC
/begin CHARACTERISTIC ip_iga_dif_min_cyc_amp_mt "Attitude correction on minimum ignition angle for after start for manual transmission" MAP 0xa102525c _REC_MAP_20_u1_u2_u1 95.625 _CNV_A_R_LINEAR_____171_CM -48. 47.625 DISPLAY_IDENTIFIER IP_IGA_DIF_MIN_CYC_AMP_MT FORMAT "%5.1"
 /begin AXIS_DESCR COM_AXIS amp _CNV_A_R_LINEAR_____26_CM 6 0. 5434. FORMAT "%7.2" AXIS_PTS_REF ldp_amp_ip_iga_dif_min_cyc_amp /end AXIS_DESCR
 /begin AXIS_DESCR COM_AXIS tco _CNV_A_R_LINEAR_____16_CM 8 -48. 142.5 FORMAT "%5.1" AXIS_PTS_REF ldpm_tco_1_igsp /end AXIS_DESCR
/end CHARACTERISTIC
/begin CHARACTERISTIC ip_iga_min_n_maf "Basic minimum ignition angle difference value" MAP 0xa1025530 _REC_MAP_20_u1_u1_u1 95.625 _CNV_A_R_LINEAR_____167_CM -35.625 60. DISPLAY_IDENTIFIER IP_IGA_MIN_N_MAF FORMAT "%5.1"
 /begin AXIS_DESCR COM_AXIS n_32 _CNV_A_R_LINEAR_____9_CM 8 0. 8160. FORMAT "%4.0" AXIS_PTS_REF ldpm_n_32_2_igsp /end AXIS_DESCR
 /begin AXIS_DESCR COM_AXIS maf _CNV_A_R_LINEAR_____14_CM 6 0. 1389. FORMAT "%4.0" AXIS_PTS_REF ldpm_maf_hb_2_igsp /end AXIS_DESCR
/end CHARACTERISTIC
/begin CHARACTERISTIC ip_iga_min_n_maf_pu "Basic minimum ignition angle difference value" MAP 0xa1025650 _REC_MAP_20_u1_u1_u1 95.625 _CNV_A_R_LINEAR_____167_CM -35.625 60. DISPLAY_IDENTIFIER IP_IGA_MIN_N_MAF_PU FORMAT "%5.1"
 /begin AXIS_DESCR COM_AXIS n_32 _CNV_A_R_LINEAR_____9_CM 8 0. 8160. FORMAT "%4.0" AXIS_PTS_REF ldpm_n_32_2_igsp /end AXIS_DESCR
 /begin AXIS_DESCR COM_AXIS maf _CNV_A_R_LINEAR_____14_CM 6 0. 1389. FORMAT "%4.0" AXIS_PTS_REF ldpm_maf_hb_2_igsp /end AXIS_DESCR
/end CHARACTERISTIC
/begin CHARACTERISTIC ip_iga_min_n_maf_ext "Basic minimum ignition angle difference value" MAP 0xa1025560 _REC_MAP_20_u1_u1_u1 95.625 _CNV_A_R_LINEAR_____167_CM -35.625 60. DISPLAY_IDENTIFIER IP_IGA_MIN_N_MAF_EXT FORMAT "%5.1"
 /begin AXIS_DESCR COM_AXIS n_32 _CNV_A_R_LINEAR_____9_CM 8 0. 8160. FORMAT "%4.0" AXIS_PTS_REF ldpm_n_32_2_igsp /end AXIS_DESCR
 /begin AXIS_DESCR COM_AXIS maf _CNV_A_R_LINEAR_____14_CM 6 0. 1389. FORMAT "%4.0" AXIS_PTS_REF ldpm_maf_hb_2_igsp /end AXIS_DESCR
/end CHARACTERISTIC
/begin CHARACTERISTIC ip_iga_dif_min_tco_ext "TCO correction for minimum ignition angle" CURVE 0xa10253d4 _REC_CUR_20_u1_u1 95.625 _CNV_A_R_LINEAR_____171_CM -48. 47.625 DISPLAY_IDENTIFIER IP_IGA_DIF_MIN_TCO_EXT FORMAT "%5.1"
 /begin AXIS_DESCR COM_AXIS tco _CNV_A_R_LINEAR_____16_CM 8 -48. 142.5 FORMAT "%5.1" AXIS_PTS_REF ldpm_tco_1_igsp /end AXIS_DESCR
/end CHARACTERISTIC
/begin CHARACTERISTIC ip_iga_dif_min_tco_pu "TCO correction for minimum ignition angle" CURVE 0xa10253fc _REC_CUR_20_u1_u1 95.625 _CNV_A_R_LINEAR_____171_CM -48. 47.625 DISPLAY_IDENTIFIER IP_IGA_DIF_MIN_TCO_PU FORMAT "%5.1"
 /begin AXIS_DESCR COM_AXIS tco _CNV_A_R_LINEAR_____16_CM 8 -48. 142.5 FORMAT "%5.1" AXIS_PTS_REF ldpm_tco_1_igsp /end AXIS_DESCR
/end CHARACTERISTIC
/begin CHARACTERISTIC ip_iga_dif_min_tco "TCO correction for minimum ignition angle" CURVE 0xa10253cc _REC_CUR_20_u1_u1 95.625 _CNV_A_R_LINEAR_____171_CM -48. 47.625 DISPLAY_IDENTIFIER IP_IGA_DIF_MIN_TCO FORMAT "%5.1"
 /begin AXIS_DESCR COM_AXIS tco _CNV_A_R_LINEAR_____16_CM 8 -48. 142.5 FORMAT "%5.1" AXIS_PTS_REF ldpm_tco_1_igsp /end AXIS_DESCR
/end CHARACTERISTIC
/begin CHARACTERISTIC ip_iga_min_ch_cor "Offset on basic minimum ignition angle caused by cat heating" MAP 0xa10254a0 _REC_MAP_20_u1_u1_u1 95.625 _CNV_A_R_LINEAR_____167_CM -35.625 60. DISPLAY_IDENTIFIER IP_IGA_MIN_CH_COR FORMAT "%5.1"
 /begin AXIS_DESCR COM_AXIS n_32 _CNV_A_R_LINEAR_____9_CM 8 0. 8160. FORMAT "%4.0" AXIS_PTS_REF ldpm_n_32_2_igsp /end AXIS_DESCR
 /begin AXIS_DESCR COM_AXIS maf _CNV_A_R_LINEAR_____14_CM 6 0. 1389. FORMAT "%4.0" AXIS_PTS_REF ldpm_maf_hb_2_igsp /end AXIS_DESCR
/end CHARACTERISTIC
/begin CHARACTERISTIC ip_iga_min_opm_cor "Offset on basic minimum ignition angle caused by engine throttled mode" MAP 0xa10256e0 _REC_MAP_20_u1_u1_u1 95.625 _CNV_A_R_LINEAR_____167_CM -35.625 60. DISPLAY_IDENTIFIER IP_IGA_MIN_OPM_COR FORMAT "%5.1"
 /begin AXIS_DESCR COM_AXIS n_32 _CNV_A_R_LINEAR_____9_CM 8 0. 8160. FORMAT "%4.0" AXIS_PTS_REF ldpm_n_32_2_igsp /end AXIS_DESCR
 /begin AXIS_DESCR COM_AXIS maf _CNV_A_R_LINEAR_____14_CM 6 0. 1389. FORMAT "%4.0" AXIS_PTS_REF ldpm_maf_hb_2_igsp /end AXIS_DESCR
/end CHARACTERISTIC
/begin MEASUREMENT iga_av_mv_can "Mean value of actual ignition angle" UBYTE _CNV_A_R_LINEAR_____167_CM 1 100. -35.625 60. DISPLAY_IDENTIFIER IGA_AV_MV_CAN ECU_ADDRESS 0xd0003cf9 FORMAT "%5.1" /end MEASUREMENT
/begin MEASUREMENT iga_av_mv "Mean value of actual ignition angle" UBYTE _CNV_A_R_LINEAR_____167_CM 1 100. -35.625 60. DISPLAY_IDENTIFIER IGA_AV_MV ECU_ADDRESS 0xd0003cf8 FORMAT "%5.1" /end MEASUREMENT
/begin MEASUREMENT iga_av_mv_cbk[0] "Mean value of actual ignition angle" UBYTE _CNV_A_R_LINEAR_____167_CM 1 100. -35.625 60. DISPLAY_IDENTIFIER IGA_AV_MV_CBK[0] ECU_ADDRESS 0xd0003cfa FORMAT "%5.1" /end MEASUREMENT
/begin MEASUREMENT iga_av_mv_cbk[1] "Mean value of actual ignition angle" UBYTE _CNV_A_R_LINEAR_____167_CM 1 100. -35.625 60. DISPLAY_IDENTIFIER IGA_AV_MV_CBK[1] ECU_ADDRESS 0xd0003cfb FORMAT "%5.1" /end MEASUREMENT
/begin MEASUREMENT iga_igc[0] "Ignition angle applied on cylinder CYL" UBYTE _CNV_A_R_LINEAR_____167_CM 1 100. -35.625 60. DISPLAY_IDENTIFIER IGA_IGC[0] ECU_ADDRESS 0xd0003cfc FORMAT "%5.1" /end MEASUREMENT
/begin MEASUREMENT iga_igc[1] "Ignition angle applied on cylinder CYL" UBYTE _CNV_A_R_LINEAR_____167_CM 1 100. -35.625 60. DISPLAY_IDENTIFIER IGA_IGC[1] ECU_ADDRESS 0xd0003cfd FORMAT "%5.1" /end MEASUREMENT
/begin MEASUREMENT iga_igc[2] "Ignition angle applied on cylinder CYL" UBYTE _CNV_A_R_LINEAR_____167_CM 1 100. -35.625 60. DISPLAY_IDENTIFIER IGA_IGC[2] ECU_ADDRESS 0xd0003cfe FORMAT "%5.1" /end MEASUREMENT
/begin MEASUREMENT iga_igc[3] "Ignition angle applied on cylinder CYL" UBYTE _CNV_A_R_LINEAR_____167_CM 1 100. -35.625 60. DISPLAY_IDENTIFIER IGA_IGC[3] ECU_ADDRESS 0xd0003cff FORMAT "%5.1" /end MEASUREMENT
/begin MEASUREMENT iga_igc[4] "Ignition angle applied on cylinder CYL" UBYTE _CNV_A_R_LINEAR_____167_CM 1 100. -35.625 60. DISPLAY_IDENTIFIER IGA_IGC[4] ECU_ADDRESS 0xd0003d00 FORMAT "%5.1" /end MEASUREMENT
/begin MEASUREMENT iga_igc[5] "Ignition angle applied on cylinder CYL" UBYTE _CNV_A_R_LINEAR_____167_CM 1 100. -35.625 60. DISPLAY_IDENTIFIER IGA_IGC[5] ECU_ADDRESS 0xd0003d01 FORMAT "%5.1" /end MEASUREMENT
/begin MEASUREMENT iga_igc_hom[0] "Homogenous ignition angle applied on cylinder x" UBYTE _CNV_A_R_LINEAR_____167_CM 1 100. -35.625 60. DISPLAY_IDENTIFIER IGA_IGC_HOM[0] ECU_ADDRESS 0xd0003d02 FORMAT "%5.1" /end MEASUREMENT
/begin MEASUREMENT iga_igc_hom[1] "Homogenous ignition angle applied on cylinder x" UBYTE _CNV_A_R_LINEAR_____167_CM 1 100. -35.625 60. DISPLAY_IDENTIFIER IGA_IGC_HOM[1] ECU_ADDRESS 0xd0003d03 FORMAT "%5.1" /end MEASUREMENT
/begin MEASUREMENT iga_igc_hom[2] "Homogenous ignition angle applied on cylinder x" UBYTE _CNV_A_R_LINEAR_____167_CM 1 100. -35.625 60. DISPLAY_IDENTIFIER IGA_IGC_HOM[2] ECU_ADDRESS 0xd0003d04 FORMAT "%5.1" /end MEASUREMENT
/begin MEASUREMENT iga_igc_hom[3] "Homogenous ignition angle applied on cylinder x" UBYTE _CNV_A_R_LINEAR_____167_CM 1 100. -35.625 60. DISPLAY_IDENTIFIER IGA_IGC_HOM[3] ECU_ADDRESS 0xd0003d05 FORMAT "%5.1" /end MEASUREMENT
/begin MEASUREMENT iga_igc_hom[4] "Homogenous ignition angle applied on cylinder x" UBYTE _CNV_A_R_LINEAR_____167_CM 1 100. -35.625 60. DISPLAY_IDENTIFIER IGA_IGC_HOM[4] ECU_ADDRESS 0xd0003d06 FORMAT "%5.1" /end MEASUREMENT
/begin MEASUREMENT iga_igc_hom[5] "Homogenous ignition angle applied on cylinder x" UBYTE _CNV_A_R_LINEAR_____167_CM 1 100. -35.625 60. DISPLAY_IDENTIFIER IGA_IGC_HOM[5] ECU_ADDRESS 0xd0003d07 FORMAT "%5.1" /end MEASUREMENT
/begin MEASUREMENT iga_min "Minimum ignition Angle" UBYTE _CNV_A_R_LINEAR_____167_CM 1 100. -35.625 60. DISPLAY_IDENTIFIER IGA_MIN ECU_ADDRESS 0xd0003d0e FORMAT "%5.1" /end MEASUREMENT
/begin CHARACTERISTIC c_iga_ini "Init value for ignition angle" VALUE 0xa10294af _REC_VAL_20_u1 95.625 _CNV_A_R_LINEAR_____167_CM -35.625 60. DISPLAY_IDENTIFIER C_IGA_INI FORMAT "%5.1" /end CHARACTERISTIC
/begin CHARACTERISTIC c_iga_man "Constant for stratified mode" VALUE 0xa10294b4 _REC_VAL_20_u1 95.625 _CNV_A_R_LINEAR_____167_CM -35.625 60. DISPLAY_IDENTIFIER C_IGA_MAN FORMAT "%5.1" /end CHARACTERISTIC
/begin MEASUREMENT iga_sp_max_1_can "Maximum ignition angle depending on torque intervention" UBYTE _CNV_A_R_LINEAR_____167_CM 1 100. -35.625 60. DISPLAY_IDENTIFIER IGA_SP_MAX_1_CAN ECU_ADDRESS 0xd0003d10 FORMAT "%5.1" /end MEASUREMENT
/begin MEASUREMENT iga_sp_max_1 "Maximum ignition angle depending on torque intervention" UBYTE _CNV_A_R_LINEAR_____167_CM 1 100. -35.625 60. DISPLAY_IDENTIFIER IGA_SP_MAX_1 ECU_ADDRESS 0xd0003d0f FORMAT "%5.1" /end MEASUREMENT
/begin MEASUREMENT iga_av_1[0] "Intermediate ignition angle till gradiant limitation after start is terminated" UBYTE _CNV_A_R_LINEAR_____167_CM 1 100. -35.625 60. DISPLAY_IDENTIFIER IGA_AV_1[0] ECU_ADDRESS 0xd0003d12 FORMAT "%5.1" /end MEASUREMENT
/begin MEASUREMENT iga_av_1[1] "Intermediate ignition angle till gradiant limitation after start is terminated" UBYTE _CNV_A_R_LINEAR_____167_CM 1 100. -35.625 60. DISPLAY_IDENTIFIER IGA_AV_1[1] ECU_ADDRESS 0xd0003d13 FORMAT "%5.1" /end MEASUREMENT
/begin MEASUREMENT iga_av_1[2] "Intermediate ignition angle till gradiant limitation after start is terminated" UBYTE _CNV_A_R_LINEAR_____167_CM 1 100. -35.625 60. DISPLAY_IDENTIFIER IGA_AV_1[2] ECU_ADDRESS 0xd0003d14 FORMAT "%5.1" /end MEASUREMENT
/begin MEASUREMENT iga_av_1[3] "Intermediate ignition angle till gradiant limitation after start is terminated" UBYTE _CNV_A_R_LINEAR_____167_CM 1 100. -35.625 60. DISPLAY_IDENTIFIER IGA_AV_1[3] ECU_ADDRESS 0xd0003d15 FORMAT "%5.1" /end MEASUREMENT
/begin MEASUREMENT iga_av_1[4] "Intermediate ignition angle till gradiant limitation after start is terminated" UBYTE _CNV_A_R_LINEAR_____167_CM 1 100. -35.625 60. DISPLAY_IDENTIFIER IGA_AV_1[4] ECU_ADDRESS 0xd0003d16 FORMAT "%5.1" /end MEASUREMENT
/begin MEASUREMENT iga_av_1[5] "Intermediate ignition angle till gradiant limitation after start is terminated" UBYTE _CNV_A_R_LINEAR_____167_CM 1 100. -35.625 60. DISPLAY_IDENTIFIER IGA_AV_1[5] ECU_ADDRESS 0xd0003d17 FORMAT "%5.1" /end MEASUREMENT
/begin MEASUREMENT iga_av[0] "Ignition angle applied on cylinder CYL" UBYTE _CNV_A_R_LINEAR_____167_CM 1 100. -35.625 60. DISPLAY_IDENTIFIER IGA_AV[0] ECU_ADDRESS 0xd0003d08 FORMAT "%5.1" /end MEASUREMENT
/begin MEASUREMENT iga_av[1] "Ignition angle applied on cylinder CYL" UBYTE _CNV_A_R_LINEAR_____167_CM 1 100. -35.625 60. DISPLAY_IDENTIFIER IGA_AV[1] ECU_ADDRESS 0xd0003d09 FORMAT "%5.1" /end MEASUREMENT
/begin MEASUREMENT iga_av[2] "Ignition angle applied on cylinder CYL" UBYTE _CNV_A_R_LINEAR_____167_CM 1 100. -35.625 60. DISPLAY_IDENTIFIER IGA_AV[2] ECU_ADDRESS 0xd0003d0a FORMAT "%5.1" /end MEASUREMENT
/begin MEASUREMENT iga_av[3] "Ignition angle applied on cylinder CYL" UBYTE _CNV_A_R_LINEAR_____167_CM 1 100. -35.625 60. DISPLAY_IDENTIFIER IGA_AV[3] ECU_ADDRESS 0xd0003d0b FORMAT "%5.1" /end MEASUREMENT
/begin MEASUREMENT iga_av[4] "Ignition angle applied on cylinder CYL" UBYTE _CNV_A_R_LINEAR_____167_CM 1 100. -35.625 60. DISPLAY_IDENTIFIER IGA_AV[4] ECU_ADDRESS 0xd0003d0c FORMAT "%5.1" /end MEASUREMENT
/begin MEASUREMENT iga_av[5] "Ignition angle applied on cylinder CYL" UBYTE _CNV_A_R_LINEAR_____167_CM 1 100. -35.625 60. DISPLAY_IDENTIFIER IGA_AV[5] ECU_ADDRESS 0xd0003d0d FORMAT "%5.1" /end MEASUREMENT
/begin MEASUREMENT lv_mtc_lih_act "LV limp home request main throttle" UBYTE _CNV_S_2_RANGE__0___1_CM 1 100. 0. 1. DISPLAY_IDENTIFIER LV_MTC_LIH_ACT ECU_ADDRESS 0xd0003b57 BIT_MASK 0x1 /end MEASUREMENT
/begin MEASUREMENT lv_ivvt_in_and_ex "LV  IVVT inlet and exhaust cam (0 = inlet cam variable, 1 = inlet & exhaust cam variable) " UBYTE _CNV_S_2_RANGE__0___1_CM 1 100. 0. 1. DISPLAY_IDENTIFIER LV_IVVT_IN_AND_EX ECU_ADDRESS 0xd0003beb BIT_MASK 0x1 /end MEASUREMENT
/begin MEASUREMENT lv_inj_conf "LV injection configuration (0 = intake manifold injection, 1 = direct injection) " UBYTE _CNV_S_2_RANGE__0___1_CM 1 100. 0. 1. DISPLAY_IDENTIFIER LV_INJ_CONF ECU_ADDRESS 0xd0003bec BIT_MASK 0x1 /end MEASUREMENT
/begin MEASUREMENT lv_isa_conf "logical variable idle speed actuator configuration (0=no idle speed actuator, 1=idle speed actuator)" UBYTE _CNV_S_2_RANGE__0___1_CM 1 100. 0. 1. DISPLAY_IDENTIFIER LV_ISA_CONF ECU_ADDRESS 0xd0003bed BIT_MASK 0x1 /end MEASUREMENT
/begin MEASUREMENT eng_conf "state of engine configuration code" UBYTE _CNV_S_1_RANGE_ENG__284_CM 1 100. 0. 0. DISPLAY_IDENTIFIER ENG_CONF ECU_ADDRESS 0xd0003be1 /end MEASUREMENT
/begin MEASUREMENT vim_type "VI)M configuration" UBYTE _CNV_S_2_RANGE_VIM__285_CM 1 100. 0. 1. DISPLAY_IDENTIFIER VIM_TYPE ECU_ADDRESS 0xd0003be2 /end MEASUREMENT
/begin CHARACTERISTIC c_eng_conf "engine configuration code" VALUE 0xa1029358 _REC_VAL_20_u1 0. _CNV_S_1_RANGE_ENG__284_CM 0. 0. DISPLAY_IDENTIFIER C_ENG_CONF /end CHARACTERISTIC
/begin MEASUREMENT lv_var_msw "LV MSW detected" UBYTE _CNV_S_2_RANGE__0___1_CM 1 100. 0. 1. DISPLAY_IDENTIFIER LV_VAR_MSW ECU_ADDRESS 0xd0003bef BIT_MASK 0x1 /end MEASUREMENT
/begin MEASUREMENT lv_var_sof "variant of sound-flap" UBYTE _CNV_S_2_RANGE__0___1_CM 1 100. 0. 1. DISPLAY_IDENTIFIER LV_VAR_SOF ECU_ADDRESS 0xd0003bfa BIT_MASK 0x1 /end MEASUREMENT
/begin MEASUREMENT lv_cbk_mpl "LV  multiple cylinder banks (0 = single bank, 1 = multiple banks) " UBYTE _CNV_S_2_RANGE__0___1_CM 1 100. 0. 1. DISPLAY_IDENTIFIER LV_CBK_MPL ECU_ADDRESS 0xd0003bea BIT_MASK 0x1 /end MEASUREMENT
/begin MEASUREMENT conf_swi_efp_out "configuration of EFP-control" UBYTE _CNV_A_R_LINEAR_____0_CM 1 100. 0. 2. DISPLAY_IDENTIFIER CONF_SWI_EFP_OUT ECU_ADDRESS 0xd0003be3 FORMAT "%2.0" /end MEASUREMENT
/begin CHARACTERISTIC c_conf_swi_efp_out "configuration bit for EFP-control" VALUE 0xa10291c6 _REC_VAL_20_u1 2. _CNV_A_R_LINEAR_____0_CM 0. 2. DISPLAY_IDENTIFIER C_CONF_SWI_EFP_OUT FORMAT "%2.0" /end CHARACTERISTIC
/begin MEASUREMENT conf_oil_level_sens "configuration of EFP-control" UBYTE _CNV_A_R_LINEAR_____0_CM 1 100. 0. 2. DISPLAY_IDENTIFIER CONF_OIL_LEVEL_SENS ECU_ADDRESS 0xd0003be4 FORMAT "%2.0" /end MEASUREMENT
/begin MEASUREMENT lv_var_bn "PT-CAN Variant (0=CAN11h / 1=BN2000 recognized)" UBYTE _CNV_S_2_RANGE__0___1_CM 1 100. 0. 1. DISPLAY_IDENTIFIER LV_VAR_BN ECU_ADDRESS 0xd0003bfb BIT_MASK 0x1 /end MEASUREMENT
/begin MEASUREMENT lv_var_bn_efp "EFP via CAN recognized (BN2000 only)" UBYTE _CNV_S_2_RANGE__0___1_CM 1 100. 0. 1. DISPLAY_IDENTIFIER LV_VAR_BN_EFP ECU_ADDRESS 0xd0003c01 BIT_MASK 0x1 /end MEASUREMENT
/begin CHARACTERISTIC c_conf_dmtl "" VALUE 0xa10291c4 _REC_VAL_20_u1 1. _CNV_A_R_LINEAR_____0_CM 0. 1. DISPLAY_IDENTIFIER C_CONF_DMTL FORMAT "%2.0" /end CHARACTERISTIC
/begin MEASUREMENT lv_conf_dmtl "configuration of DMTL" UBYTE _CNV_S_2_RANGE__0___1_CM 1 100. 0. 1. DISPLAY_IDENTIFIER LV_CONF_DMTL ECU_ADDRESS 0xd0003bf1 BIT_MASK 0x1 /end MEASUREMENT
/begin MEASUREMENT conf_sof_swi "Configuration of sport-switch" UBYTE _CNV_S_3_STATE_CONF_286_CM 1 100. 0. 2. DISPLAY_IDENTIFIER CONF_SOF_SWI ECU_ADDRESS 0xd0003be5 /end MEASUREMENT
/begin MEASUREMENT lv_var_ecras "variant for ECRAS" UBYTE _CNV_S_2_RANGE__0___1_CM 1 100. 0. 1. DISPLAY_IDENTIFIER LV_VAR_ECRAS ECU_ADDRESS 0xd0003bf3 BIT_MASK 0x1 /end MEASUREMENT
/begin CHARACTERISTIC c_conf_oil_level_sens "configuration bit for EFP - control" VALUE 0xa10291c5 _REC_VAL_20_u1 2. _CNV_A_R_LINEAR_____0_CM 0. 2. DISPLAY_IDENTIFIER C_CONF_OIL_LEVEL_SENS FORMAT "%2.0" /end CHARACTERISTIC
/begin CHARACTERISTIC c_conf_cat "configuration bit for CAT/exahaust type" VALUE 0xa10291c3 _REC_VAL_20_u1 2. _CNV_A_R_LINEAR_____0_CM 0. 2. DISPLAY_IDENTIFIER C_CONF_CAT FORMAT "%2.0" /end CHARACTERISTIC
/begin MEASUREMENT lv_var_ef "variant for exhaust flap" UBYTE _CNV_S_2_RANGE__0___1_CM 1 100. 0. 1. DISPLAY_IDENTIFIER LV_VAR_EF ECU_ADDRESS 0xd0003bf4 BIT_MASK 0x1 /end MEASUREMENT
/begin MEASUREMENT lv_var_lsh_up "variant for CAT/exahust type" UBYTE _CNV_S_2_RANGE__0___1_CM 1 100. 0. 1. DISPLAY_IDENTIFIER LV_VAR_LSH_UP ECU_ADDRESS 0xd0003bf7 BIT_MASK 0x1 /end MEASUREMENT
/begin MEASUREMENT lv_var_lsh_down "variant for CAT/exahust type" UBYTE _CNV_S_2_RANGE__0___1_CM 1 100. 0. 1. DISPLAY_IDENTIFIER LV_VAR_LSH_DOWN ECU_ADDRESS 0xd0003bf8 BIT_MASK 0x1 /end MEASUREMENT
/begin MEASUREMENT psn_ls "OBD-communication mode01 PID13, automatic learnig of oxygen sensors" UBYTE _CNV_A_R_LINEAR_____0_CM 1 100. 0. 255. DISPLAY_IDENTIFIER PSN_LS ECU_ADDRESS 0xd0003be6 FORMAT "%3.0" /end MEASUREMENT
/begin MEASUREMENT psn_ls_1 "OBD-communication mode01 PID1D, automatic learnig of oxygen sensors" UBYTE _CNV_A_R_LINEAR_____0_CM 1 100. 0. 255. DISPLAY_IDENTIFIER PSN_LS_1 ECU_ADDRESS 0xd0003be7 FORMAT "%3.0" /end MEASUREMENT
/begin MEASUREMENT lv_var_ebox_cfa "variant for EBOX cooling fan" UBYTE _CNV_S_2_RANGE__0___1_CM 1 100. 0. 1. DISPLAY_IDENTIFIER LV_VAR_EBOX_CFA ECU_ADDRESS 0xd0003bf2 BIT_MASK 0x1 /end MEASUREMENT
/begin MEASUREMENT lv_var_rly_st "variant of starter relay recognized " UBYTE _CNV_S_2_RANGE__0___1_CM 1 100. 0. 1. DISPLAY_IDENTIFIER LV_VAR_RLY_ST ECU_ADDRESS 0xd0003bf6 BIT_MASK 0x1 /end MEASUREMENT
/begin MEASUREMENT lv_var_rly_accout "variant of ACC-relay recognized" UBYTE _CNV_S_2_RANGE__0___1_CM 1 100. 0. 1. DISPLAY_IDENTIFIER LV_VAR_RLY_ACCOUT ECU_ADDRESS 0xd0003bf5 BIT_MASK 0x1 /end MEASUREMENT
/begin MEASUREMENT var_veh "Vehicle Variant" UBYTE _CNV_S_4_RANGE_VAR__287_CM 1 100. 0. 3. DISPLAY_IDENTIFIER VAR_VEH ECU_ADDRESS 0xd0003be8 /end MEASUREMENT
/begin MEASUREMENT lv_var_bn_gear_rev "reverse gear via CAN recognized (BN2000/E60 - MT only)" UBYTE _CNV_S_2_RANGE__0___1_CM 1 100. 0. 1. DISPLAY_IDENTIFIER LV_VAR_BN_GEAR_REV ECU_ADDRESS 0xd0003c03 BIT_MASK 0x1 /end MEASUREMENT
/begin MEASUREMENT lv_var_acin "LV air conditioning recognized" UBYTE _CNV_S_2_RANGE__0___1_CM 1 100. 0. 1. DISPLAY_IDENTIFIER LV_VAR_ACIN ECU_ADDRESS 0xd0003c09 BIT_MASK 0x1 /end MEASUREMENT
/begin MEASUREMENT lv_var_bn_ltg_hdlp_l "Dipped Beam via CAN recognized (BN2000 only)" UBYTE _CNV_S_2_RANGE__0___1_CM 1 100. 0. 1. DISPLAY_IDENTIFIER LV_VAR_BN_LTG_HDLP_L ECU_ADDRESS 0xd0003c04 BIT_MASK 0x1 /end MEASUREMENT
/begin CHARACTERISTIC c_n_var_dis_misf "Switch off threshold" VALUE 0xa102966c _REC_VAL_20_u1 816. _CNV_A_R_LINEAR_____9_CM 0. 8160. DISPLAY_IDENTIFIER C_N_VAR_DIS_MISF FORMAT "%4.0" /end CHARACTERISTIC
/begin CHARACTERISTIC c_n_var_dis_er "Switch off threshold" VALUE 0xa102966a _REC_VAL_20_u1 816. _CNV_A_R_LINEAR_____9_CM 0. 8160. DISPLAY_IDENTIFIER C_N_VAR_DIS_ER FORMAT "%4.0" /end CHARACTERISTIC
/begin CHARACTERISTIC c_n_var_dis_inj "Switch off threshold" VALUE 0xa102966b _REC_VAL_20_u1 816. _CNV_A_R_LINEAR_____9_CM 0. 8160. DISPLAY_IDENTIFIER C_N_VAR_DIS_INJ FORMAT "%4.0" /end CHARACTERISTIC
/begin CHARACTERISTIC lc_var_dis_fsd "switch off function" VALUE 0xa1029e0d _REC_VAL_20_u1 1. _CNV_A_R_LINEAR_____0_CM 0. 1. DISPLAY_IDENTIFIER LC_VAR_DIS_FSD FORMAT "%2.0" /end CHARACTERISTIC
/begin CHARACTERISTIC lc_var_dis_obd_cat "switch off function" VALUE 0xa1029e0f _REC_VAL_20_u1 1. _CNV_A_R_LINEAR_____0_CM 0. 1. DISPLAY_IDENTIFIER LC_VAR_DIS_OBD_CAT FORMAT "%2.0" /end CHARACTERISTIC
/begin CHARACTERISTIC lc_var_dis_nox "switch off function" VALUE 0xa1029e0e _REC_VAL_20_u1 1. _CNV_A_R_LINEAR_____0_CM 0. 1. DISPLAY_IDENTIFIER LC_VAR_DIS_NOX FORMAT "%2.0" /end CHARACTERISTIC
/begin CHARACTERISTIC lc_var_dis_cru "switch off function cruise control" VALUE 0xa1029e0b _REC_VAL_20_u1 1. _CNV_A_R_LINEAR_____0_CM 0. 1. DISPLAY_IDENTIFIER LC_VAR_DIS_CRU FORMAT "%2.0" /end CHARACTERISTIC
/begin CHARACTERISTIC lc_var_dis_tq_loss_ars "switch off function torque loss - anti roll stabilization" VALUE 0xa1029e11 _REC_VAL_20_u1 1. _CNV_A_R_LINEAR_____0_CM 0. 1. DISPLAY_IDENTIFIER LC_VAR_DIS_TQ_LOSS_ARS FORMAT "%2.0" /end CHARACTERISTIC
/begin MEASUREMENT cam_type "CAM type" UBYTE _CNV_S_1_RANGE_CAM__288_CM 1 100. 0. 0. DISPLAY_IDENTIFIER CAM_TYPE ECU_ADDRESS 0xd0003be0 /end MEASUREMENT
/begin CHARACTERISTIC lc_tcha_conf "logical constant for variant turbo charger" VALUE 0xa1029de9 _REC_VAL_20_u1 1. _CNV_A_R_LINEAR_____0_CM 0. 1. DISPLAY_IDENTIFIER LC_TCHA_CONF FORMAT "%2.0" /end CHARACTERISTIC
/begin MEASUREMENT lv_var_tcha "Lambda 1 turbo charger" UBYTE _CNV_S_2_RANGE__0___1_CM 1 100. 0. 1. DISPLAY_IDENTIFIER LV_VAR_TCHA ECU_ADDRESS 0xd0003bf9 BIT_MASK 0x1 /end MEASUREMENT
/begin CHARACTERISTIC c_v_maf_avl "Threshold to learn HFM component" VALUE 0xa1029b68 _REC_VAL_20_u1 4.98046875 _CNV_A_R_LINEAR_____195_CM 0. 4.98046875 DISPLAY_IDENTIFIER C_V_MAF_AVL FORMAT "%4.2" /end CHARACTERISTIC
/begin CHARACTERISTIC c_ctr_avl_maf "Minimum cycle number to learn HFM component" VALUE 0xa102924b _REC_VAL_20_u1 255. _CNV_A_R_LINEAR_____0_CM 0. 255. DISPLAY_IDENTIFIER C_CTR_AVL_MAF FORMAT "%3.0" /end CHARACTERISTIC
/begin MEASUREMENT lv_var_maf "variant mass air flow meter" UBYTE _CNV_S_2_RANGE__0___1_CM 1 100. 0. 1. DISPLAY_IDENTIFIER LV_VAR_MAF ECU_ADDRESS 0xd0003bf0 BIT_MASK 0x1 /end MEASUREMENT
/begin CHARACTERISTIC lc_mafm_det_di "Disable flag for automatically learning of HFM" VALUE 0xa1029d76 _REC_VAL_20_u1 1. _CNV_A_R_LINEAR_____0_CM 0. 1. DISPLAY_IDENTIFIER LC_MAFM_DET_DI FORMAT "%1.0" /end CHARACTERISTIC
/begin MEASUREMENT lv_var_veh "Vehicle Variant with power module (E60/E65) recognized - BN2000 only" UBYTE _CNV_S_2_RANGE__0___1_CM 1 100. 0. 1. DISPLAY_IDENTIFIER LV_VAR_VEH ECU_ADDRESS 0xd0003c08 BIT_MASK 0x1 /end MEASUREMENT
/begin CHARACTERISTIC c_var_veh "Vehicle configuration code" VALUE 0xa1029bc5 _REC_VAL_20_u1 3. _CNV_S_4_RANGE_VAR__287_CM 0. 3. DISPLAY_IDENTIFIER C_VAR_VEH /end CHARACTERISTIC
/begin MEASUREMENT state_var_det_cus_1 "carrier double-word 1 of all learned variants for customer environment" ULONG _CNV_A_R_LINEAR_____50_CM 1 100. 0. 4294967295. DISPLAY_IDENTIFIER STATE_VAR_DET_CUS_1 ECU_ADDRESS 0xd00057cc FORMAT "%11.0" /end MEASUREMENT
/begin MEASUREMENT state_var_det_cus_2 "carrier double-word 2 of all learned variants for customer environment" ULONG _CNV_A_R_LINEAR_____50_CM 1 100. 0. 4294967295. DISPLAY_IDENTIFIER STATE_VAR_DET_CUS_2 ECU_ADDRESS 0xd00057d0 FORMAT "%11.0" /end MEASUREMENT
/begin MEASUREMENT lv_var_bn_ldm "LDM detected (E9x only)" UBYTE _CNV_S_2_RANGE__0___1_CM 1 100. 0. 1. DISPLAY_IDENTIFIER LV_VAR_BN_LDM ECU_ADDRESS 0xd0003c05 BIT_MASK 0x1 /end MEASUREMENT
/begin MEASUREMENT lv_var_bn_trl "TRL detected" UBYTE _CNV_S_2_RANGE__0___1_CM 1 100. 0. 1. DISPLAY_IDENTIFIER LV_VAR_BN_TRL ECU_ADDRESS 0xd0003c06 BIT_MASK 0x1 /end MEASUREMENT
/begin MEASUREMENT lv_var_bn_hiv "HIV-Slave detected" UBYTE _CNV_S_2_RANGE__0___1_CM 1 100. 0. 1. DISPLAY_IDENTIFIER LV_VAR_BN_HIV ECU_ADDRESS 0xd0003c07 BIT_MASK 0x1 /end MEASUREMENT
/begin CHARACTERISTIC c_t_det_var_can "time for learning variants via CAN after ignition key on" VALUE 0xa1029838 _REC_VAL_20_u1 255. _CNV_A_R_LINEAR_____35_CM 0. 255. DISPLAY_IDENTIFIER C_T_DET_VAR_CAN FORMAT "%3.0" /end CHARACTERISTIC
/begin CHARACTERISTIC lc_var_dis_dmtl "switch off tank leakage diagnosis" VALUE 0xa1029e0c _REC_VAL_20_u1 1. _CNV_A_R_LINEAR_____0_CM 0. 1. DISPLAY_IDENTIFIER LC_VAR_DIS_DMTL FORMAT "%2.0" /end CHARACTERISTIC
/begin CHARACTERISTIC lc_var_dis_s_fct "switch off stratified functions" VALUE 0xa1029e10 _REC_VAL_20_u1 1. _CNV_A_R_LINEAR_____0_CM 0. 1. DISPLAY_IDENTIFIER LC_VAR_DIS_S_FCT FORMAT "%2.0" /end CHARACTERISTIC
/begin MEASUREMENT online_dummy "" UWORD _CNV_A_R_LINEAR_____0_CM 1 100. 0. 65535. DISPLAY_IDENTIFIER ONLINE_DUMMY ECU_ADDRESS 0xd000507c FORMAT "%5.0" /end MEASUREMENT
/begin MEASUREMENT eff_iga_ron_98_1 "Ignition efficiency actual ignition angle" UWORD _CNV_A_R_LINEAR_____8_CM 1 100. 0. 1.99996948242188 DISPLAY_IDENTIFIER EFF_IGA_RON_98[1] ECU_ADDRESS 0xd0005116 FORMAT "%7.5" /end MEASUREMENT
/begin MEASUREMENT eff_iga_ron_98_2 "Ignition efficiency actual ignition angle" UWORD _CNV_A_R_LINEAR_____8_CM 1 100. 0. 1.99996948242188 DISPLAY_IDENTIFIER EFF_IGA_RON_98[2] ECU_ADDRESS 0xd000511a FORMAT "%7.5" /end MEASUREMENT
/begin MEASUREMENT eff_iga_av "Ignition efficiency actual ignition angle" UWORD _CNV_A_R_LINEAR_____8_CM 1 100. 0. 1.99996948242188 DISPLAY_IDENTIFIER EFF_IGA_AV ECU_ADDRESS 0xd000510a FORMAT "%7.5" /end MEASUREMENT
/begin MEASUREMENT eff_iga_av_can "Ignition efficiency actual ignition angle for CAN" UWORD _CNV_A_R_LINEAR_____8_CM 1 100. 0. 1.99996948242188 DISPLAY_IDENTIFIER EFF_IGA_AV_CAN ECU_ADDRESS 0xd000510e FORMAT "%7.5" /end MEASUREMENT
/begin MEASUREMENT eff_iga_av_1 "Ignition efficiency actual ignition angle bank selective" UWORD _CNV_A_R_LINEAR_____8_CM 1 100. 0. 1.99996948242188 DISPLAY_IDENTIFIER EFF_IGA_AV_CBK[1] ECU_ADDRESS 0xd0005118 FORMAT "%7.5" /end MEASUREMENT
/begin MEASUREMENT eff_iga_av_2 "Ignition efficiency actual ignition angle bank selective" UWORD _CNV_A_R_LINEAR_____8_CM 1 100. 0. 1.99996948242188 DISPLAY_IDENTIFIER EFF_IGA_AV_CBK[2] ECU_ADDRESS 0xd000511c FORMAT "%7.5" /end MEASUREMENT
/begin MEASUREMENT eff_iga_min "Ignition efficiency minimum ignition angle" UWORD _CNV_A_R_LINEAR_____8_CM 1 100. 0. 1.99996948242188 DISPLAY_IDENTIFIER EFF_IGA_MIN ECU_ADDRESS 0xd0005110 FORMAT "%7.5" /end MEASUREMENT
/begin MEASUREMENT eff_iga_bas_cor_knk_fil "Ignition efficiency referenced to IGA_BAS_COR_KNK_FIL" UWORD _CNV_A_R_LINEAR_____8_CM 1 100. 0. 1.99996948242188 DISPLAY_IDENTIFIER EFF_IGA_BAS_COR_KNK_FIL ECU_ADDRESS 0xd0005112 FORMAT "%7.5" /end MEASUREMENT
/begin MEASUREMENT iga_bas_cor_knk_add "Basic corrected ignition angle knock  mean value IGA_MV_ADJ_KNK included" UBYTE _CNV_A_R_LINEAR_____167_CM 1 100. -35.625 60. DISPLAY_IDENTIFIER IGA_BAS_COR_KNK_ADD ECU_ADDRESS 0xc0000714 FORMAT "%5.1" /end MEASUREMENT
/begin MEASUREMENT iga_dif_bas "Difference of basic ignition angle to reference ignition angle" UBYTE _CNV_A_R_LINEAR_____174_CM 1 100. 0. -95.625 DISPLAY_IDENTIFIER IGA_DIF_BAS ECU_ADDRESS 0xc0000715 FORMAT "%5.1" /end MEASUREMENT
/begin MEASUREMENT iga_dif_av_h_rng "Difference of actual ignition angle to reference ignition angle" UWORD _CNV_A_R_LINEAR_____169_CM 1 100. 0. -180. DISPLAY_IDENTIFIER IGA_DIF_AV_H_RNG ECU_ADDRESS 0xc0000704 FORMAT "%8.4" /end MEASUREMENT
/begin MEASUREMENT iga_dif_av_can_h_rng "Difference of actual ignition angle to reference ignition angle for CAN" UWORD _CNV_A_R_LINEAR_____169_CM 1 100. 0. -180. DISPLAY_IDENTIFIER IGA_DIF_AV_CAN_H_RNG ECU_ADDRESS 0xc0000706 FORMAT "%8.4" /end MEASUREMENT
/begin MEASUREMENT iga_dif_av_cbk_h_rng_1 "Difference of actual ignition angle to reference ignition angle" UWORD _CNV_A_R_LINEAR_____169_CM 1 100. 0. -180. DISPLAY_IDENTIFIER IGA_DIF_AV_CBK_H_RNG[1] ECU_ADDRESS 0xc000070a FORMAT "%8.4" /end MEASUREMENT
/begin MEASUREMENT iga_dif_av_cbk_h_rng_2 "Difference of actual ignition angle to reference ignition angle" UWORD _CNV_A_R_LINEAR_____169_CM 1 100. 0. -180. DISPLAY_IDENTIFIER IGA_DIF_AV_CBK_H_RNG[2] ECU_ADDRESS 0xc000070e FORMAT "%8.4" /end MEASUREMENT
/begin MEASUREMENT iga_dif_ron_98_h_rng_1 "Difference of actual ignition angle to reference ignition angle" UWORD _CNV_A_R_LINEAR_____169_CM 1 100. 0. -180. DISPLAY_IDENTIFIER IGA_DIF_RON_98_H_RNG[1] ECU_ADDRESS 0xc000070c FORMAT "%8.4" /end MEASUREMENT
/begin MEASUREMENT iga_dif_ron_98_h_rng_2 "Difference of actual ignition angle to reference ignition angle" UWORD _CNV_A_R_LINEAR_____169_CM 1 100. 0. -180. DISPLAY_IDENTIFIER IGA_DIF_RON_98_H_RNG[2] ECU_ADDRESS 0xc0000710 FORMAT "%8.4" /end MEASUREMENT
/begin MEASUREMENT iga_mv_knk_fil "Filtered mean knock correction" SBYTE _CNV_A_R_LINEAR_____168_CM 1 100. -48. 47.625 DISPLAY_IDENTIFIER IGA_MV_KNK_FIL ECU_ADDRESS 0xc0000716 FORMAT "%5.1" /end MEASUREMENT
/begin MEASUREMENT iga_bas_cor_knk_fil "Corrected basic ignition angle with mean knock correction" UBYTE _CNV_A_R_LINEAR_____167_CM 1 100. -35.625 60. DISPLAY_IDENTIFIER IGA_BAS_COR_KNK_FIL ECU_ADDRESS 0xc0000717 FORMAT "%5.1" /end MEASUREMENT
/begin MEASUREMENT iga_dif_bas_knk_fil "Difference of IGA_BAS_COR_KNK_FIL to reference ignition angle" UBYTE _CNV_A_R_LINEAR_____174_CM 1 100. 0. -95.625 DISPLAY_IDENTIFIER IGA_DIF_BAS_KNK_FIL ECU_ADDRESS 0xd0003ce4 FORMAT "%5.1" /end MEASUREMENT
/begin MEASUREMENT fac_eff_iga "Factor for basic ignition efficiency correction depending on engine operation mode" UBYTE _CNV_A_R_LINEAR_____467_CM 1 100. 0. 11.22 DISPLAY_IDENTIFIER FAC_EFF_IGA ECU_ADDRESS 0xd0003ce5 FORMAT "%5.2" /end MEASUREMENT
/begin CHARACTERISTIC c_crlc_iga_knk "Correlation constant knock correction filter" VALUE 0xa10291ff _REC_VAL_20_u1 0.99609375 _CNV_A_R_LINEAR_____27_CM 0. 0.99609375 DISPLAY_IDENTIFIER C_CRLC_IGA_KNK FORMAT "%5.3" /end CHARACTERISTIC
/begin CHARACTERISTIC ip_fac_eff_iga_opm_1 "Factor to correct the basic ignition efficiency depending on engine operation mode 1" MAP 0xa1023654 _REC_MAP_20_u1_u1_u2 11.22 _CNV_A_R_LINEAR_____467_CM 0. 11.22 DISPLAY_IDENTIFIER IP_FAC_EFF_IGA_OPM_1 FORMAT "%5.2"
 /begin AXIS_DESCR COM_AXIS n_32 _CNV_A_R_LINEAR_____9_CM 16 0. 8160. FORMAT "%4.0" AXIS_PTS_REF ldpm_n_32_1_tqdr /end AXIS_DESCR
 /begin AXIS_DESCR COM_AXIS fac_maf_rel _CNV_A_R_LINEAR_____468_CM 16 0. 300. FORMAT "%5.1" AXIS_PTS_REF ldpm_fac_maf_rel_3_tqdr /end AXIS_DESCR
/end CHARACTERISTIC
/begin CHARACTERISTIC ip_fac_eff_iga_opm_2 "Factor to correct the basic ignition efficiency depending on engine operation mode 2" MAP 0xa1023754 _REC_MAP_20_u1_u1_u2 11.22 _CNV_A_R_LINEAR_____467_CM 0. 11.22 DISPLAY_IDENTIFIER IP_FAC_EFF_IGA_OPM_2 FORMAT "%5.2"
 /begin AXIS_DESCR COM_AXIS n_32 _CNV_A_R_LINEAR_____9_CM 16 0. 8160. FORMAT "%4.0" AXIS_PTS_REF ldpm_n_32_7_tqdr /end AXIS_DESCR
 /begin AXIS_DESCR COM_AXIS fac_maf_rel _CNV_A_R_LINEAR_____468_CM 16 0. 300. FORMAT "%5.1" AXIS_PTS_REF ldpm_fac_maf_rel_4_tqdr /end AXIS_DESCR
/end CHARACTERISTIC
/begin CHARACTERISTIC id_eff_iga_opm_req "Interpretation map for changing requested operation mode dependency" CURVE 0xa1022454 _REC_CUR_20_u1_u1 7. _CNV_A_R_LINEAR_____0_CM 1. 8. DISPLAY_IDENTIFIER ID_EFF_IGA_OPM_REQ FORMAT "%1.0"
 /begin AXIS_DESCR COM_AXIS opm_req _CNV_A_R_LINEAR_____0_CM 8 0. 8. FORMAT "%1.0" AXIS_PTS_REF ldpm_eff_1_tqdr /end AXIS_DESCR
/end CHARACTERISTIC
/begin MEASUREMENT eff_iga_bas_cor "ignition efficiency basic ignition angle" UWORD _CNV_A_R_LINEAR_____8_CM 1 100. 0. 1.99996948242188 DISPLAY_IDENTIFIER EFF_IGA_BAS_COR ECU_ADDRESS 0xd0005108 FORMAT "%7.5" /end MEASUREMENT
/begin MEASUREMENT eff_iga_min_teg "Ignition efficiency minimum ignition angle with TEG correction" UWORD _CNV_A_R_LINEAR_____8_CM 1 100. 0. 1.99996948242188 DISPLAY_IDENTIFIER EFF_IGA_MIN_TEG ECU_ADDRESS 0xd0005114 FORMAT "%7.5" /end MEASUREMENT
/begin MEASUREMENT eff_iga_seg_av "Ignition efficiency actual ignition angle segment synchronous" UWORD _CNV_A_R_LINEAR_____8_CM 1 100. 0. 1.99996948242188 DISPLAY_IDENTIFIER EFF_IGA_SEG_AV ECU_ADDRESS 0xd000510c FORMAT "%7.5" /end MEASUREMENT
/begin MEASUREMENT iga_dif_seg_av_h_rng "Difference of actual ignition angle to reference ignition angle segment synchronous" UWORD _CNV_A_R_LINEAR_____169_CM 1 100. 0. -180. DISPLAY_IDENTIFIER IGA_DIF_SEG_AV_H_RNG ECU_ADDRESS 0xc0000708 FORMAT "%8.4" /end MEASUREMENT
/begin AXIS_PTS ldpm_opm_req "" 0xa1022198 opm_req _REC_AXS_20_u1 8. _CNV_A_R_LINEAR_____0_CM 8 0. 8. FORMAT "%1.0" /end AXIS_PTS
/begin CHARACTERISTIC ip_fac_eff_iga_ch_cold_opm_1 "Factor for catalyst heating cold engine in normal mode" MAP 0xa10234c4 _REC_MAP_20_u1_u1_u2 11.22 _CNV_A_R_LINEAR_____467_CM 0. 11.22 DISPLAY_IDENTIFIER IP_FAC_EFF_IGA_CH_COLD_OPM_1 FORMAT "%5.2"
 /begin AXIS_DESCR COM_AXIS n_32 _CNV_A_R_LINEAR_____9_CM 10 0. 8160. FORMAT "%4.0" AXIS_PTS_REF ldpm_n_32_5_tqdr /end AXIS_DESCR
 /begin AXIS_DESCR COM_AXIS fac_maf_rel _CNV_A_R_LINEAR_____468_CM 10 0. 300. FORMAT "%5.1" AXIS_PTS_REF ldpm_fac_maf_rel_1_tqdr /end AXIS_DESCR
/end CHARACTERISTIC
/begin CHARACTERISTIC ip_fac_eff_iga_ch_opm_1 "Factor for catalyst heating warm engine in normal mode" MAP 0xa102358c _REC_MAP_20_u1_u1_u2 11.22 _CNV_A_R_LINEAR_____467_CM 0. 11.22 DISPLAY_IDENTIFIER IP_FAC_EFF_IGA_CH_OPM_1 FORMAT "%5.2"
 /begin AXIS_DESCR COM_AXIS n_32 _CNV_A_R_LINEAR_____9_CM 10 0. 8160. FORMAT "%4.0" AXIS_PTS_REF ldpm_n_32_5_tqdr /end AXIS_DESCR
 /begin AXIS_DESCR COM_AXIS fac_maf_rel _CNV_A_R_LINEAR_____468_CM 10 0. 300. FORMAT "%5.1" AXIS_PTS_REF ldpm_fac_maf_rel_1_tqdr /end AXIS_DESCR
/end CHARACTERISTIC
/begin CHARACTERISTIC ip_fac_eff_iga_ch_cold_opm_2 "Factor for catalyst heating cold engine in throttled mode" MAP 0xa1023528 _REC_MAP_20_u1_u1_u2 11.22 _CNV_A_R_LINEAR_____467_CM 0. 11.22 DISPLAY_IDENTIFIER IP_FAC_EFF_IGA_CH_COLD_OPM_2 FORMAT "%5.2"
 /begin AXIS_DESCR COM_AXIS n_32 _CNV_A_R_LINEAR_____9_CM 10 0. 8160. FORMAT "%4.0" AXIS_PTS_REF ldpm_n_32_6_tqdr /end AXIS_DESCR
 /begin AXIS_DESCR COM_AXIS fac_maf_rel _CNV_A_R_LINEAR_____468_CM 10 0. 300. FORMAT "%5.1" AXIS_PTS_REF ldpm_fac_maf_rel_2_tqdr /end AXIS_DESCR
/end CHARACTERISTIC
/begin CHARACTERISTIC ip_fac_eff_iga_ch_opm_2 "Factor for catalyst heating warm engine in throttled mode" MAP 0xa10235f0 _REC_MAP_20_u1_u1_u2 11.22 _CNV_A_R_LINEAR_____467_CM 0. 11.22 DISPLAY_IDENTIFIER IP_FAC_EFF_IGA_CH_OPM_2 FORMAT "%5.2"
 /begin AXIS_DESCR COM_AXIS n_32 _CNV_A_R_LINEAR_____9_CM 10 0. 8160. FORMAT "%4.0" AXIS_PTS_REF ldpm_n_32_6_tqdr /end AXIS_DESCR
 /begin AXIS_DESCR COM_AXIS fac_maf_rel _CNV_A_R_LINEAR_____468_CM 10 0. 300. FORMAT "%5.1" AXIS_PTS_REF ldpm_fac_maf_rel_2_tqdr /end AXIS_DESCR
/end CHARACTERISTIC
/begin AXIS_PTS ldpm_n_32_5_tqdr "" 0xa1021dc4 n_32 _REC_AXS_20_u1 8160. _CNV_A_R_LINEAR_____9_CM 10 0. 8160. FORMAT "%4.0" /end AXIS_PTS
/begin AXIS_PTS ldpm_n_32_6_tqdr "" 0xa1021de4 n_32 _REC_AXS_20_u1 8160. _CNV_A_R_LINEAR_____9_CM 10 0. 8160. FORMAT "%4.0" /end AXIS_PTS
/begin AXIS_PTS ldpm_fac_maf_rel_1_tqdr "" 0xa10219b0 fac_maf_rel _REC_AXS_20_u2 300. _CNV_A_R_LINEAR_____468_CM 10 0. 300. FORMAT "%5.1" /end AXIS_PTS
/begin AXIS_PTS ldpm_fac_maf_rel_2_tqdr "" 0xa10219c8 fac_maf_rel _REC_AXS_20_u2 300. _CNV_A_R_LINEAR_____468_CM 10 0. 300. FORMAT "%5.1" /end AXIS_PTS
/begin AXIS_PTS ldpm_n_32_1_tqdr "" 0xa1021da4 n_32 _REC_AXS_20_u1 8160. _CNV_A_R_LINEAR_____9_CM 16 0. 8160. FORMAT "%4.0" /end AXIS_PTS
/begin AXIS_PTS ldpm_fac_maf_rel_3_tqdr "" 0xa10219e0 fac_maf_rel _REC_AXS_20_u2 300. _CNV_A_R_LINEAR_____468_CM 16 0. 300. FORMAT "%5.1" /end AXIS_PTS
/begin AXIS_PTS ldpm_n_32_7_tqdr "" 0xa1021df0 n_32 _REC_AXS_20_u1 8160. _CNV_A_R_LINEAR_____9_CM 16 0. 8160. FORMAT "%4.0" /end AXIS_PTS
/begin AXIS_PTS ldpm_fac_maf_rel_4_tqdr "" 0xa1021a04 fac_maf_rel _REC_AXS_20_u2 300. _CNV_A_R_LINEAR_____468_CM 16 0. 300. FORMAT "%5.1" /end AXIS_PTS
/begin CHARACTERISTIC id_eff_iga_opm "Interpretation map for changing actual operation mode dependency" CURVE 0xa102244c _REC_CUR_20_u1_u1 7. _CNV_A_R_LINEAR_____0_CM 1. 8. DISPLAY_IDENTIFIER ID_EFF_IGA_OPM FORMAT "%1.0"
 /begin AXIS_DESCR COM_AXIS opm_av _CNV_A_R_LINEAR_____0_CM 8 0. 8. FORMAT "%1.0" AXIS_PTS_REF ldpm_eff_2_tqdr /end AXIS_DESCR
/end CHARACTERISTIC
/begin AXIS_PTS ldpm_opm_av "" 0xa102218c opm_av _REC_AXS_20_u1 8. _CNV_A_R_LINEAR_____0_CM 8 0. 8. FORMAT "%1.0" /end AXIS_PTS
/begin AXIS_PTS ldpm_eff_2_tqdr "" 0xa10219a4 opm_av _REC_AXS_20_u1 8. _CNV_A_R_LINEAR_____0_CM 8 0. 8. FORMAT "%1.0" /end AXIS_PTS
/begin AXIS_PTS ldpm_eff_1_tqdr "" 0xa1021998 opm_req _REC_AXS_20_u1 8. _CNV_A_R_LINEAR_____0_CM 8 0. 8. FORMAT "%1.0" /end AXIS_PTS
/begin CHARACTERISTIC ip_iga_bas_ron_98 "Basic ignition angle for RON 98" MAP 0xa1024f4c _REC_MAP_20_u2_u2_u2 180. _CNV_A_R_LINEAR_____170_CM -90. 90. DISPLAY_IDENTIFIER IP_IGA_BAS_RON_98 FORMAT "%8.4"
 /begin AXIS_DESCR COM_AXIS n _CNV_A_R_LINEAR_____13_CM 20 0. 8160. FORMAT "%4.0" AXIS_PTS_REF ldpm_n_14_tqdr /end AXIS_DESCR
 /begin AXIS_DESCR COM_AXIS maf _CNV_A_R_LINEAR_____108_CM 16 0. 1389. FORMAT "%7.2" AXIS_PTS_REF ldpm_maf_2_tqdr /end AXIS_DESCR
/end CHARACTERISTIC
/begin AXIS_PTS ldpm_n_14_tqdr "" 0xa1021cdc n _REC_AXS_20_u2 8160. _CNV_A_R_LINEAR_____13_CM 20 0. 8160. FORMAT "%4.0" /end AXIS_PTS
/begin AXIS_PTS ldpm_maf_2_tqdr "" 0xa1021bc4 maf _REC_AXS_20_u2 69.45 _CNV_A_R_LINEAR_____108_CM 16 0. 1389. FORMAT "%7.2" /end AXIS_PTS
/begin CHARACTERISTIC ip_eff_iga "Basic Ignition Efficiency" CURVE 0xa10232a0 _REC_CUR_20_u2_u2 100. _CNV_A_R_LINEAR_____469_CM 0. 100. DISPLAY_IDENTIFIER IP_EFF_IGA FORMAT "%5.3"
 /begin AXIS_DESCR COM_AXIS iga_dif_min _CNV_A_R_LINEAR_____169_CM 16 0. -180. FORMAT "%8.4" AXIS_PTS_REF ldp_iga_dif_ip_eff_iga /end AXIS_DESCR
/end CHARACTERISTIC
/begin AXIS_PTS ldp_iga_dif_ip_eff_iga "" 0xa1020bdc iga_dif_min _REC_AXS_20_u2 -180. _CNV_A_R_LINEAR_____169_CM 16 0. -180. FORMAT "%8.4" /end AXIS_PTS
/begin CHARACTERISTIC c_data_id_0 "Dataset identifier, string with 5 calibratable values, only visible in INCA (SAM doesn't support ascii format)" ASCII 0xa100002c _REC_VAL_3_u1 255. _CNV_A_R_LINEAR_____50_CM 0. 255. DISPLAY_IDENTIFIER C_DATA_ID_0 NUMBER 5 /end CHARACTERISTIC
/begin CHARACTERISTIC c_data_id_1 "Dataset identifier, string with 5 calibratable values, only visible in INCA (SAM doesn't support ascii format)" ASCII 0xa100003d _REC_VAL_3_u1 255. _CNV_A_R_LINEAR_____50_CM 0. 255. DISPLAY_IDENTIFIER C_DATA_ID_1 NUMBER 5 /end CHARACTERISTIC
/begin CHARACTERISTIC c_data_id_2 "Dataset identifier, string with 5 calibratable values, only visible in INCA (SAM doesn't support ascii format)" ASCII 0xa100004e _REC_VAL_3_u1 255. _CNV_A_R_LINEAR_____50_CM 0. 255. DISPLAY_IDENTIFIER C_DATA_ID_2 NUMBER 5 /end CHARACTERISTIC
/begin CHARACTERISTIC cal_cks_active "Constant to activate the dataset checksum calculation" VALUE 0xa10000ec _REC_VAL_20_u2 65535. _CNV_A_R_LINEAR_____0_CM 0. 65535. DISPLAY_IDENTIFIER C_CHECK_SUM FORMAT "%5.0" /end CHARACTERISTIC
/begin COMPU_METHOD _CNV_A_R_LINEAR_____0_CM "" RAT_FUNC "%6.3" "-" COEFFS 0 1. 0. 0 0 1 /end COMPU_METHOD
/begin COMPU_METHOD _CNV_S_2_RANGE__0___1_CM "" TAB_VERB "%6.3" "-" COMPU_TAB_REF _CNV_S_2_RANGE__0___1 /end COMPU_METHOD
/begin COMPU_VTAB _CNV_S_2_RANGE__0___1 "" TAB_VERB 2 0 "0" 1 "1" /end COMPU_VTAB
/begin COMPU_METHOD _CNV_A_R_LINEAR_____3_CM "" RAT_FUNC "%6.3" "s" COEFFS 0 100. 0. 0 0 1 /end COMPU_METHOD
/begin COMPU_METHOD _CNV_A_R_LINEAR_____4_CM "" RAT_FUNC "%6.3" "s" COEFFS 0 10. 0. 0 0 1 /end COMPU_METHOD
/begin COMPU_METHOD _CNV_A_R_LINEAR_____5_CM "" RAT_FUNC "%6.3" "%" COEFFS 0 2.56 0. 0 0 1 /end COMPU_METHOD
/begin COMPU_METHOD _CNV_A_R_LINEAR_____6_CM "" RAT_FUNC "%6.3" "km/h" COEFFS 0 1. 0. 0 0 1 /end COMPU_METHOD
/begin COMPU_METHOD _CNV_A_R_LINEAR_____7_CM "" RAT_FUNC "%6.3" "%" COEFFS 0 655.3599999999997 0. 0 0 1 /end COMPU_METHOD
/begin COMPU_METHOD _CNV_A_R_LINEAR_____8_CM "" RAT_FUNC "%6.3" "-" COEFFS 0 32767.99999999992 0. 0 0 1 /end COMPU_METHOD
/begin COMPU_METHOD _CNV_A_R_LINEAR_____9_CM "" RAT_FUNC "%6.3" "rpm" COEFFS 0 3.125e-002 0. 0 0 1 /end COMPU_METHOD
/begin COMPU_METHOD _CNV_A_R_LINEAR_____13_CM "" RAT_FUNC "%6.3" "rpm" COEFFS 0 1. 0. 0 0 1 /end COMPU_METHOD
/begin COMPU_METHOD _CNV_A_R_LINEAR_____14_CM "" RAT_FUNC "%6.3" "mg/stk" COEFFS 0 0.183585313174946 0. 0 0 1 /end COMPU_METHOD
/begin COMPU_METHOD _CNV_A_R_LINEAR_____16_CM "" RAT_FUNC "%6.3" "°C" COEFFS 0 1.333333333333333 64. 0 0 1 /end COMPU_METHOD
/begin COMPU_METHOD _CNV_A_R_LINEAR_____17_CM "" RAT_FUNC "%6.3" "-" COEFFS 0 255.9983911655618 0. 0 0 1 /end COMPU_METHOD
/begin COMPU_METHOD _CNV_A_R_LINEAR_____18_CM "" RAT_FUNC "%6.3" "ms" COEFFS 0 0.1 0. 0 0 1 /end COMPU_METHOD
/begin COMPU_METHOD _CNV_S_8_RANGE_STAT_19_CM "" TAB_VERB "%6.3" "" COMPU_TAB_REF _CNV_S_8_RANGE_STAT_19 /end COMPU_METHOD
/begin COMPU_VTAB _CNV_S_8_RANGE_STAT_19 "" TAB_VERB 8 0 "None" 1 "Set-Acc-TipUp" 2 "Decelerate-TipDown" 3 "Resume" 4 "Off" 5 "-" 6 "-" 7 "Error" /end COMPU_VTAB
/begin COMPU_METHOD _CNV_S_10_RANGE_REQ__20_CM "" TAB_VERB "%6.3" "" COMPU_TAB_REF _CNV_S_10_RANGE_REQ__20 /end COMPU_METHOD
/begin COMPU_VTAB _CNV_S_10_RANGE_REQ__20 "" TAB_VERB 10 0 "Hard_off" 1 "Soft_off" 2 "TIP up" 3 "TIP Down " 4 "Set / Accelerate" 5 "Resume" 6 "Decelerate" 7 "None" 8 "Mark up" 9 "Mark down" /end COMPU_VTAB
/begin COMPU_METHOD _CNV_A_R_LINEAR_____22_CM "" RAT_FUNC "%6.3" "ms" COEFFS 0 5.e-002 0. 0 0 1 /end COMPU_METHOD
/begin COMPU_METHOD _CNV_A_R_LINEAR_____24_CM "" RAT_FUNC "%6.3" "°C" COEFFS 0 1.333333333333333 0. 0 0 1 /end COMPU_METHOD
/begin COMPU_METHOD _CNV_A_R_LINEAR_____26_CM "" RAT_FUNC "%6.3" "hPa" COEFFS 0 12.06017666543982 0. 0 0 1 /end COMPU_METHOD
/begin COMPU_METHOD _CNV_A_R_LINEAR_____27_CM "" RAT_FUNC "%6.3" "-" COEFFS 0 256. 0. 0 0 1 /end COMPU_METHOD
/begin COMPU_METHOD _CNV_A_R_LINEAR_____35_CM "" RAT_FUNC "%6.3" "s" COEFFS 0 1. 0. 0 0 1 /end COMPU_METHOD
/begin COMPU_METHOD _CNV_A_R_LINEAR_____50_CM "" RAT_FUNC "%6.3" "" COEFFS 0 1. 0. 0 0 1 /end COMPU_METHOD
/begin COMPU_METHOD _CNV_A_R_LINEAR_____66_CM "" RAT_FUNC "%6.3" "km/h" COEFFS 0 128.0000018750286 0. 0 0 1 /end COMPU_METHOD
/begin COMPU_METHOD _CNV_A_R_LINEAR_____68_CM "" RAT_FUNC "%6.3" "-" COEFFS 0 65535.99999999996 0. 0 0 1 /end COMPU_METHOD
/begin COMPU_METHOD _CNV_A_R_LINEAR_____71_CM "" RAT_FUNC "%6.3" "" COEFFS 0 256. 0. 0 0 1 /end COMPU_METHOD
/begin COMPU_METHOD _CNV_A_R_LINEAR_____86_CM "" RAT_FUNC "%6.3" "m/s²" COEFFS 0 2084.478388984895 2.74784179055132e-004 0 0 1 /end COMPU_METHOD
/begin COMPU_METHOD _CNV_A_R_LINEAR_____87_CM "" RAT_FUNC "%6.3" "rpm/(km/h)" COEFFS 0 0.5 0. 0 0 1 /end COMPU_METHOD
/begin COMPU_METHOD _CNV_A_R_LINEAR_____88_CM "" RAT_FUNC "%6.3" "km/h" COEFFS 0 65535.99999999996 0. 0 0 1 /end COMPU_METHOD
/begin COMPU_METHOD _CNV_A_R_LINEAR_____89_CM "" RAT_FUNC "%6.3" "ms" COEFFS 0 1. 0. 0 0 1 /end COMPU_METHOD
/begin COMPU_METHOD _CNV_A_R_LINEAR_____90_CM "" RAT_FUNC "%6.3" "km/h" COEFFS 0 128. 0. 0 0 1 /end COMPU_METHOD
/begin COMPU_METHOD _CNV_S_8_RANGE_REQ__91_CM "" TAB_VERB "%6.3" "" COMPU_TAB_REF _CNV_S_8_RANGE_REQ__91 /end COMPU_METHOD
/begin COMPU_VTAB _CNV_S_8_RANGE_REQ__91 "" TAB_VERB 8 0 "Hard_off" 1 "Soft_off" 2 "TIP up" 3 "TIP Down " 4 "Set / Accelerate" 5 "Resume" 6 "Decelerate" 7 "None" /end COMPU_VTAB
/begin COMPU_METHOD _CNV_A_R_LINEAR_____92_CM "" RAT_FUNC "%6.3" "m/s²" COEFFS 0 2084.478406465338 0. 0 0 1 /end COMPU_METHOD
/begin COMPU_METHOD _CNV_S_8_RANGE_STAT_93_CM "" TAB_VERB "%6.3" "" COMPU_TAB_REF _CNV_S_8_RANGE_STAT_93 /end COMPU_METHOD
/begin COMPU_VTAB _CNV_S_8_RANGE_STAT_93 "" TAB_VERB 8 0 "PASSIVE" 1 "CONST/TIP " 2 "-" 3 "RES" 4 "-" 5 "SET_ACC" 6 "-" 7 "DEC" /end COMPU_VTAB
/begin COMPU_METHOD _CNV_A_R_LINEAR_____94_CM "" RAT_FUNC "%6.3" "km/h" COEFFS 0 128.0039001188318 0. 0 0 1 /end COMPU_METHOD
/begin COMPU_METHOD _CNV_A_R_LINEAR_____95_CM "" RAT_FUNC "%6.3" "km/h" COEFFS 0 8. 0. 0 0 1 /end COMPU_METHOD
/begin COMPU_METHOD _CNV_A_R_LINEAR_____96_CM "" RAT_FUNC "%6.3" "m/s²" COEFFS 0 46.08002400098911 0. 0 0 1 /end COMPU_METHOD
/begin COMPU_METHOD _CNV_A_R_LINEAR_____97_CM "" RAT_FUNC "%6.3" "-" COEFFS 0 127.9991955827809 0. 0 0 1 /end COMPU_METHOD
/begin COMPU_METHOD _CNV_A_R_LINEAR_____98_CM "" RAT_FUNC "%6.3" "km/h" COEFFS 0 128. 32768. 0 0 1 /end COMPU_METHOD
/begin COMPU_METHOD _CNV_S_6_RANGE_STAT_99_CM "" TAB_VERB "%6.3" "" COMPU_TAB_REF _CNV_S_6_RANGE_STAT_99 /end COMPU_METHOD
/begin COMPU_VTAB _CNV_S_6_RANGE_STAT_99 "" TAB_VERB 6 0 "PASSIVE" 1 "CONST_DRIVE" 3 "RESUME" 5 "SET_ACC" 7 "RETARD" 9 "TIP" /end COMPU_VTAB
/begin COMPU_METHOD _CNV_A_R_LINEAR_____100_CM "" RAT_FUNC "%6.3" "-" COEFFS 0 128. 0. 0 0 1 /end COMPU_METHOD
/begin COMPU_METHOD _CNV_A_R_LINEAR_____101_CM "" RAT_FUNC "%6.3" "%/(km/h)" COEFFS 0 1310.720001587224 0. 0 0 1 /end COMPU_METHOD
/begin COMPU_METHOD _CNV_A_R_LINEAR_____102_CM "" RAT_FUNC "%6.3" "%/(m/s²)" COEFFS 0 163.8375 32767.5 0 0 1 /end COMPU_METHOD
/begin COMPU_METHOD _CNV_A_R_LINEAR_____103_CM "" RAT_FUNC "%6.3" "%" COEFFS 0 2084.478388983038 32768.00027481336 0 0 1 /end COMPU_METHOD
/begin COMPU_METHOD _CNV_A_R_LINEAR_____104_CM "" RAT_FUNC "%6.3" "km/h" COEFFS 0 4. 0. 0 0 1 /end COMPU_METHOD
/begin COMPU_METHOD _CNV_A_R_LINEAR_____105_CM "" RAT_FUNC "%6.3" "%/100ms" COEFFS 0 655.3599999999997 0. 0 0 1 /end COMPU_METHOD
/begin COMPU_METHOD _CNV_S_4_STATE_I_CR_106_CM "" TAB_VERB "%6.3" "" COMPU_TAB_REF _CNV_S_4_STATE_I_CR_106 /end COMPU_METHOD
/begin COMPU_VTAB _CNV_S_4_STATE_I_CR_106 "" TAB_VERB 4 0 "NO" 1 "LIM" 2 "FREEZE" 3 "NORM" /end COMPU_VTAB
/begin COMPU_METHOD _CNV_A_R_LINEAR_____107_CM "" RAT_FUNC "%6.3" "s" COEFFS 0 50. 0. 0 0 1 /end COMPU_METHOD
/begin COMPU_METHOD _CNV_A_R_LINEAR_____108_CM "" RAT_FUNC "%6.3" "mg/stk" COEFFS 0 47.18142548596112 0. 0 0 1 /end COMPU_METHOD
/begin COMPU_METHOD _CNV_A_R_LINEAR_____110_CM "" RAT_FUNC "%6.3" "%" COEFFS 0 655.3599999999997 -1.455191522836685e-011 0 0 1 /end COMPU_METHOD
/begin COMPU_METHOD _CNV_S_3_RANGE_STAT_124_CM "" TAB_VERB "%6.3" "-" COMPU_TAB_REF _CNV_S_3_RANGE_STAT_124 /end COMPU_METHOD
/begin COMPU_VTAB _CNV_S_3_RANGE_STAT_124 "" TAB_VERB 3 0 "Wait" 1 "Request" 2 "Adaptation" /end COMPU_VTAB
/begin COMPU_METHOD _CNV_S_4_RANGE_C_CY_125_CM "" TAB_VERB "%6.3" "-" COMPU_TAB_REF _CNV_S_4_RANGE_C_CY_125 /end COMPU_METHOD
/begin COMPU_VTAB _CNV_S_4_RANGE_C_CY_125 "" TAB_VERB 4 0 "ZERO" 1 "ON" 2 "LAM_AD" 3 "SEL_HOT" /end COMPU_VTAB
/begin COMPU_METHOD _CNV_S_2_RANGE_C_CY_126_CM "" TAB_VERB "%6.3" "-" COMPU_TAB_REF _CNV_S_2_RANGE_C_CY_126 /end COMPU_METHOD
/begin COMPU_VTAB _CNV_S_2_RANGE_C_CY_126 "" TAB_VERB 2 0 "ZERO" 1 "ON" /end COMPU_VTAB
/begin COMPU_METHOD _CNV_S_7_RANGE_C_CY_127_CM "" TAB_VERB "%6.3" "-" COMPU_TAB_REF _CNV_S_7_RANGE_C_CY_127 /end COMPU_METHOD
/begin COMPU_VTAB _CNV_S_7_RANGE_C_CY_127 "" TAB_VERB 7 0 "ZERO" 1 "ON" 2 "LAM_AD" 3 "SEL_COLD" 4 "SEL_HOT" 5 "ER_FAC" 6 "ER_ADD" /end COMPU_VTAB
/begin COMPU_METHOD _CNV_A_R_LINEAR_____128_CM "" RAT_FUNC "%6.3" "1/s²" COEFFS 0 100.5832156670146 32768.00000000002 0 0 1 /end COMPU_METHOD
/begin COMPU_METHOD _CNV_S_3_RANGE_STAT_129_CM "" TAB_VERB "%6.3" "-" COMPU_TAB_REF _CNV_S_3_RANGE_STAT_129 /end COMPU_METHOD
/begin COMPU_VTAB _CNV_S_3_RANGE_STAT_129 "" TAB_VERB 3 0 "Ready" 1 "Wait" 2 "Adaptation" /end COMPU_VTAB
/begin COMPU_METHOD _CNV_A_R_LINEAR_____130_CM "" RAT_FUNC "%6.3" "1/s²" COEFFS 0 100.5832156670146 2.182787284255028e-011 0 0 1 /end COMPU_METHOD
/begin COMPU_METHOD _CNV_A_R_LINEAR_____152_CM "" RAT_FUNC "%6.3" "hPa" COEFFS 0 0.1884402603974972 0. 0 0 1 /end COMPU_METHOD
/begin COMPU_METHOD _CNV_A_R_LINEAR_____153_CM "" RAT_FUNC "%6.3" "hPa" COEFFS 0 0.3768805207949945 0. 0 0 1 /end COMPU_METHOD
/begin COMPU_METHOD _CNV_A_R_LINEAR_____154_CM "" RAT_FUNC "%6.3" "l/h" COEFFS 0 1. 0. 0 0 1 /end COMPU_METHOD
/begin COMPU_METHOD _CNV_S_11_RANGE_STAT_155_CM "" TAB_VERB "%6.3" "-" COMPU_TAB_REF _CNV_S_11_RANGE_STAT_155 /end COMPU_METHOD
/begin COMPU_VTAB _CNV_S_11_RANGE_STAT_155 "" TAB_VERB 11 0 "OFF_DLY" 1 "ACR_TEST" 2 "LIH" 3 "CRASH2OFF" 4 "ON2OFF_DLY" 5 "ON2EXT_ADJ" 6 "CRASH" 7 "OFF_DLY2ON" 8 "EXT_ADJ2OFF" 9 "OFF_DLY2OFF" 10 "ACR_TEST2OFF" /end COMPU_VTAB
/begin COMPU_METHOD _CNV_A_R_LINEAR_____156_CM "" RAT_FUNC "%6.3" "l/h" COEFFS 0 257. 0. 0 0 1 /end COMPU_METHOD
/begin COMPU_METHOD _CNV_A_R_LINEAR_____157_CM "" RAT_FUNC "%6.3" "hPa/10ms" COEFFS 0 0.3768805207949945 0. 0 0 1 /end COMPU_METHOD
/begin COMPU_METHOD _CNV_A_R_LINEAR_____158_CM "" RAT_FUNC "%6.3" "hPa" COEFFS 0 0.3768805207949945 32768. 0 0 1 /end COMPU_METHOD
/begin COMPU_METHOD _CNV_A_R_LINEAR_____159_CM "" RAT_FUNC "%6.3" "%" COEFFS 0 655.3600000071681 32768.00000035841 0 0 1 /end COMPU_METHOD
/begin COMPU_METHOD _CNV_A_R_LINEAR_____160_CM "" RAT_FUNC "%6.3" "mg" COEFFS 0 47.18142548596112 0. 0 0 1 /end COMPU_METHOD
/begin COMPU_METHOD _CNV_S_7_RANGE_STAT_161_CM "" TAB_VERB "%6.3" "-" COMPU_TAB_REF _CNV_S_7_RANGE_STAT_161 /end COMPU_METHOD
/begin COMPU_VTAB _CNV_S_7_RANGE_STAT_161 "" TAB_VERB 7 0 "EFP_OFF" 1 "EFP_ACR_TEST" 2 "EFP_ON" 3 "EFP_OFF_DLY" 4 "EFP_EXT_ADJ" 5 "EFP_CRASH" 6 "EFF_LIH" /end COMPU_VTAB
/begin COMPU_METHOD _CNV_A_R_LINEAR_____162_CM "" RAT_FUNC "%6.3" "mg/cm³" COEFFS 0 72.81666666666666 -2.728484105318785e-012 0 0 1 /end COMPU_METHOD
/begin COMPU_METHOD _CNV_A_R_LINEAR_____166_CM "" RAT_FUNC "%6.3" "°CRK" COEFFS 0 16. 0. 0 0 1 /end COMPU_METHOD
/begin COMPU_METHOD _CNV_A_R_LINEAR_____167_CM "" RAT_FUNC "%6.3" "°CRK" COEFFS 0 2.666666666666667 95. 0 0 1 /end COMPU_METHOD
/begin COMPU_METHOD _CNV_A_R_LINEAR_____168_CM "" RAT_FUNC "%6.3" "°CRK" COEFFS 0 2.666666666666667 0. 0 0 1 /end COMPU_METHOD
/begin COMPU_METHOD _CNV_A_R_LINEAR_____169_CM "" RAT_FUNC "%6.3" "°CRK" COEFFS 0 -16. 0. 0 0 1 /end COMPU_METHOD
/begin COMPU_METHOD _CNV_A_R_LINEAR_____170_CM "" RAT_FUNC "%6.3" "°CRK" COEFFS 0 16. 1440. 0 0 1 /end COMPU_METHOD
/begin COMPU_METHOD _CNV_A_R_LINEAR_____171_CM "" RAT_FUNC "%6.3" "°CRK" COEFFS 0 2.666666666666667 128. 0 0 1 /end COMPU_METHOD
/begin COMPU_METHOD _CNV_A_R_LINEAR_____172_CM "" RAT_FUNC "%6.3" "rpm" COEFFS 0 1. 32768. 0 0 1 /end COMPU_METHOD
/begin COMPU_METHOD _CNV_A_R_LINEAR_____173_CM "" RAT_FUNC "%6.3" "%" COEFFS 0 200. 0. 0 0 1 /end COMPU_METHOD
/begin COMPU_METHOD _CNV_A_R_LINEAR_____174_CM "" RAT_FUNC "%6.3" "°CRK" COEFFS 0 -2.666666666666667 0. 0 0 1 /end COMPU_METHOD
/begin COMPU_METHOD _CNV_A_R_LINEAR_____195_CM "" RAT_FUNC "%6.3" "V" COEFFS 0 51.2 0. 0 0 1 /end COMPU_METHOD
/begin COMPU_METHOD _CNV_S_1_RANGE_ENG__284_CM "" TAB_VERB "%6.3" "" COMPU_TAB_REF _CNV_S_1_RANGE_ENG__284 /end COMPU_METHOD
/begin COMPU_VTAB _CNV_S_1_RANGE_ENG__284 "" TAB_VERB 1 0 "NG6_GDI_3SEG" /end COMPU_VTAB
/begin COMPU_METHOD _CNV_S_2_RANGE_VIM__285_CM "" TAB_VERB "%6.3" "" COMPU_TAB_REF _CNV_S_2_RANGE_VIM__285 /end COMPU_METHOD
/begin COMPU_VTAB _CNV_S_2_RANGE_VIM__285 "" TAB_VERB 2 0 "closed loop" 1 "switched" /end COMPU_VTAB
/begin COMPU_METHOD _CNV_S_3_STATE_CONF_286_CM "" TAB_VERB "%6.3" "-" COMPU_TAB_REF _CNV_S_3_STATE_CONF_286 /end COMPU_METHOD
/begin COMPU_VTAB _CNV_S_3_STATE_CONF_286 "" TAB_VERB 3 0 "NO_SOF_SWI" 1 "SOF_SWI" 2 "SOF_SWI_AMT" /end COMPU_VTAB
/begin COMPU_METHOD _CNV_S_4_RANGE_VAR__287_CM "" TAB_VERB "%6.3" "" COMPU_TAB_REF _CNV_S_4_RANGE_VAR__287 /end COMPU_METHOD
/begin COMPU_VTAB _CNV_S_4_RANGE_VAR__287 "" TAB_VERB 4 0 "E60" 1 "E65" 2 "PL2" 3 "E83/E85" /end COMPU_VTAB
/begin COMPU_METHOD _CNV_S_1_RANGE_CAM__288_CM "" TAB_VERB "%6.3" "" COMPU_TAB_REF _CNV_S_1_RANGE_CAM__288 /end COMPU_METHOD
/begin COMPU_VTAB _CNV_S_1_RANGE_CAM__288 "" TAB_VERB 1 0 "3 seg" /end COMPU_VTAB
/begin COMPU_METHOD _CNV_A_R_LINEAR_____467_CM "" RAT_FUNC "%6.3" "-" COEFFS 0 22.72727272727273 0. 0 0 1 /end COMPU_METHOD
/begin COMPU_METHOD _CNV_A_R_LINEAR_____468_CM "" RAT_FUNC "%6.3" "%" COEFFS 0 10. 0. 0 0 1 /end COMPU_METHOD
/begin COMPU_METHOD _CNV_A_R_LINEAR_____469_CM "" RAT_FUNC "%6.3" "-" COEFFS 0 200. 0. 0 0 1 /end COMPU_METHOD
/begin RECORD_LAYOUT _REC_VAL_20_u1 FNC_VALUES 1 UBYTE COLUMN_DIR DIRECT /end RECORD_LAYOUT
/begin RECORD_LAYOUT _REC_VAL_20_u2 FNC_VALUES 1 UWORD COLUMN_DIR DIRECT /end RECORD_LAYOUT
/begin RECORD_LAYOUT _REC_AXS_20_u1 NO_AXIS_PTS_X 1 UBYTE AXIS_PTS_X 2 UBYTE INDEX_INCR DIRECT /end RECORD_LAYOUT
/begin RECORD_LAYOUT _REC_MAP_20_u2_u1_u1 FNC_VALUES 1 UWORD COLUMN_DIR DIRECT /end RECORD_LAYOUT
/begin RECORD_LAYOUT _REC_CUR_20_u1_u1 FNC_VALUES 1 UBYTE COLUMN_DIR DIRECT /end RECORD_LAYOUT
/begin RECORD_LAYOUT _REC_VAL_20_s2 FNC_VALUES 1 SWORD COLUMN_DIR DIRECT /end RECORD_LAYOUT
/begin RECORD_LAYOUT _REC_MAP_20_u2_u2_u1 FNC_VALUES 1 UWORD COLUMN_DIR DIRECT /end RECORD_LAYOUT
/begin RECORD_LAYOUT _REC_AXS_20_u2 NO_AXIS_PTS_X 1 UWORD AXIS_PTS_X 2 UWORD INDEX_INCR DIRECT /end RECORD_LAYOUT
/begin RECORD_LAYOUT _REC_CUR_20_u2_u1 FNC_VALUES 1 UWORD COLUMN_DIR DIRECT /end RECORD_LAYOUT
/begin RECORD_LAYOUT _REC_CUR_20_u2_u2 FNC_VALUES 1 UWORD COLUMN_DIR DIRECT /end RECORD_LAYOUT
/begin RECORD_LAYOUT _REC_VAL_20_s1 FNC_VALUES 1 SBYTE COLUMN_DIR DIRECT /end RECORD_LAYOUT
/begin RECORD_LAYOUT _REC_MAP_20_u2_u1_u2 FNC_VALUES 1 UWORD COLUMN_DIR DIRECT /end RECORD_LAYOUT
/begin RECORD_LAYOUT _REC_CUR_20_u1_u2 FNC_VALUES 1 UBYTE COLUMN_DIR DIRECT /end RECORD_LAYOUT
/begin RECORD_LAYOUT _REC_MAP_20_u2_u2_u2 FNC_VALUES 1 UWORD COLUMN_DIR DIRECT /end RECORD_LAYOUT
/begin RECORD_LAYOUT _REC_MAP_20_u1_u1_u1 FNC_VALUES 1 UBYTE COLUMN_DIR DIRECT /end RECORD_LAYOUT
/begin RECORD_LAYOUT _REC_MAP_20_u1_u2_u1 FNC_VALUES 1 UBYTE COLUMN_DIR DIRECT /end RECORD_LAYOUT
/begin RECORD_LAYOUT _REC_MAP_20_u1_u1_u2 FNC_VALUES 1 UBYTE COLUMN_DIR DIRECT /end RECORD_LAYOUT
/begin RECORD_LAYOUT _REC_VAL_3_u1 FNC_VALUES 1 UBYTE COLUMN_DIR DIRECT /end RECORD_LAYOUT
/begin FUNCTION AUX_Electr_fuel_pump_control "_Electr_fuel_pump_control"
 /begin DEF_CHARACTERISTIC ldp_fup_efp_dif_ip_efppwm_p ldp_fup_efp_dif_ip_efppwm_i ip_efppwm_bas_l_pow ip_fac_efppwm_bas_l_pow ip_efppwm_p ip_efppwm_i c_efppwm_max c_efppwm_min_1 c_efppwm_min_2 c_efppwm_crash c_efppwm_i_min c_efppwm_i_max c_efppwm_i_ad_min c_efppwm_i_ad_max c_efppwm_man_act lc_fup_efp_avl lc_efppwm_i_ad_clr c_tco_max_efppwm_ad c_tco_min_efppwm_ad c_fup_efp_dif_max_efppwm_ad c_efppwm_min_cor c_crlc_efppwm_i_ad c_ctr_seg_efppwm_i_ad_max c_mff_sp_max_efppwm_i_ad c_mff_sp_min_efppwm_i_ad c_mff_sp_max_efppwm_min_ad c_mff_sp_min_efppwm_min_ad c_n_max_efppwm_i_ad c_n_min_efppwm_i_ad c_n_max_efppwm_min_ad c_n_min_efppwm_min_ad c_t_ast_efppwm_min_ad c_efppwm_min_ad_tol c_efppwm_min_ad_ini c_efppwm_lih_add c_efppwm_deac c_efppwm_acr_test_inc c_fup_rho_fuel_efp ldp_vff_efp_req_ip_efppwm_bas ldp_tfu_efp_ip_fac_efppwm_bas ldp_fup_efp_sp_ip_fac_efppwm c_ctr_seg_efppwm_min_ad_max c_ctr_fup_sp_lim_vff_efp_cor c_fup_efp_grd_max c_fup_sp_dif_lim_vff_efp_cor c_vff_efp_cor_grd_dec c_vff_efp_req_lih c_vff_dif_lim_vff_efp_cor lc_vff_dif_lim_vff_efp_cor_man /end DEF_CHARACTERISTIC
 /begin OUT_MEASUREMENT efppwm_min_ad efppwm_bas efppwm_i efppwm_i_tmp efppwm_i_ad efppwm_i_ad_dif efppwm_p fup_efp_dif vff_efp_clc fup_efp_grd lv_efppwm_ctl_stop lv_efppwm_ctl_rst lv_efppwm_ad_stop lv_efppwm_min_ad_act ctr_seg_efppwm_min_ad ctr_seg_efppwm_i_ad lv_efppwm_i_ad_vld efppwm lv_efp state_efp lv_efppwm_min_vld lv_fup_efp_lim vff_efp_req vff_efp_cor /end OUT_MEASUREMENT
/end FUNCTION
/begin FUNCTION AUX_Ele_fuel_pump_control_AI "_Ele_fuel_pump_control_AI"
 /begin DEF_CHARACTERISTIC c_vff_efp_add lc_efppwm_man_act c_fup_efp_st_h_min c_fup_efp_mem_l_dif c_tco_mem_fup_efp_l_tol c_tia_fup_efp_l_hys c_t_efp /end DEF_CHARACTERISTIC
 /begin OUT_MEASUREMENT vff_efp_add state_efp_tran t_efp lv_pump_pre_run_stop lv_err_fup_efp_lih fup_efp_stop_h fup_efp_st_h tco_mem_fup_efp_h t_efp_mem_h fup_efp_stop_l fup_efp_tmp_l fup_efp_tmp_h fup_efp_st_l tco_mem_fup_efp_l tco_tmp_l tco_tmp_h t_efp_mem_l t_efp_act_l t_efp_act_h /end OUT_MEASUREMENT
/end FUNCTION
/begin FUNCTION AUX_Fuel_pres_sp_low_pres_pump "_Fuel_pres_sp_low_pres_pump"
 /begin DEF_CHARACTERISTIC c_fup_efp_sp_man c_fup_efp_sp_ext_req c_fup_efp_sp_hpp_lih c_fup_efp_sp_lim_inc c_fup_efp_sp_lim_dec lc_fup_efp_sp_man_act c_fup_efp_sp_puc c_fup_efp_sp_pwl ldp_mff_sp_fup_ctl_ip_efp_sp ldp_n_32_ip_fup_efp_sp ip_fup_efp_sp ldp_tfu_ip_fup_efp_sp ip_fup_efp_sp_min ldpm_mff_sp_fup_ctl_fusl ldp_tco_st_ip_t_fup_efp_sp_hst ip_fup_efp_sp_hst ip_t_fup_efp_sp_hst /end DEF_CHARACTERISTIC
 /begin OUT_MEASUREMENT fup_efp_sp fup_efp_sp_tmp /end OUT_MEASUREMENT
/end FUNCTION
/begin FUNCTION AUX_Cylinder_balancing_cor_DC "_Cylinder_balancing_cor_DC"
 /begin DEF_CHARACTERISTIC c_t_min_cyl_bal_ad_cdn_dc c_t_min_cyl_bal_ad_wait_dc lc_lam_ad_ctl_cyl_bal_ad_dc lc_cyl_bal_cord_dc_stop_man lc_cyl_bal_ad_dc_rst c_lamb_delta_cyl_sel_cq_fil_dc c_t_max_cyl_bal_ad_dc c_t_min_slow_cyl_bal_ad_dc c_t_min_fast_cyl_bal_ad_dc c_fac_mff_lam_adj_cyl_bal_dc c_wgpwm_max_cyl_bal_wg_open_dc c_cyl_bal_ad_dc_rst c_cyl_bal_ad_wg_open_rst lc_t_ctl_cyl_bal_ad_dc lc_cyl_bal_ad_wg_open_rst /end DEF_CHARACTERISTIC
 /begin OUT_MEASUREMENT lv_cyl_bal_lam_sel_ad_hot_dc state_cyl_bal_ad_dc lv_cyl_bal_ad_hom_req_dc lv_state_cyl_bal_dc_chg_req lv_state_cyl_bal_dc_chg_wait lv_cyl_bal_lam_ad_add_dc[0] lv_cyl_bal_lam_ad_add_dc[1] lv_cyl_bal_lam_ad_fac_l_dc[0] lv_cyl_bal_lam_ad_fac_l_dc[1] lv_cyl_bal_lam_ad_fac_h_dc[0] lv_cyl_bal_lam_ad_fac_h_dc[1] lv_cyl_bal_lam_sel_ad_nom_dc[0] lv_cyl_bal_lam_sel_ad_nom_dc[1] lv_lam_lim_lam_ad[0] lv_lam_lim_lam_ad[1] t_cyl_bal_ad_cdn_dc[0] t_cyl_bal_ad_cdn_dc[1] t_cyl_bal_ad_wait_dc lv_cyl_bal_lam_ad_stop[0] lv_cyl_bal_lam_ad_stop[1] lv_cyl_bal_ad_req_dc[0] lv_cyl_bal_ad_req_dc[1] lv_cyl_bal_ad_wg_open_req[0] lv_cyl_bal_ad_wg_open_req[1] lv_cyl_bal_ad_wg_open_req_dc[0] lv_cyl_bal_ad_wg_open_req_dc[1] lv_cyl_bal_ad_wg_open_dc[0] lv_cyl_bal_ad_wg_open_dc[1] t_cyl_bal_ad_dc t_min_cyl_bal_ad_dc lv_cyl_bal_lam_ad_dc lv_cyl_bal_lam_ad_tmp lv_cyl_bal_lam_sel_ad_hot_tmp /end OUT_MEASUREMENT
/end FUNCTION
/begin FUNCTION AUX_Cylinder_balancing_cor_EOL "_Cylinder_balancing_cor_EOL"
 /begin DEF_CHARACTERISTIC c_fac_l_lam_adj_dif_cyl_bal c_fac_mff_lam_adj_dif_cyl_bal c_t_min_cyl_bal_er_ad_dyn c_t_max_cyl_bal_er_ad c_t_dec_cyl_bal_er_ad_dyn c_t_max_cyl_bal_lam_sel_ad c_t_min_cyl_bal_lam_sel_ad_cold c_t_min_cyl_bal_lam_sel_ad_hot c_t_dec_cyl_bal_lam_sel_cbk_ad c_t_max_cyl_bal_lam_ad c_ctr_min_cyl_bal_lam_ad_fac c_ctr_min_cyl_bal_lam_ad_add c_ctr_dec_cyl_bal_lam_cbk_ad lc_cyl_bal_ad_eol_rst c_cyl_bal_ad_eol_rst lc_cyl_bal_cord_eol_stop_man ldp_n_32_ip_er_stnd_mmv_dif_dyw ip_er_stnd_mmv_dif_bal_dyw c_lamb_delta_cyl_sel_cq_fil /end DEF_CHARACTERISTIC
 /begin OUT_MEASUREMENT lv_cyl_bal_lam_ad_eol lv_cyl_bal_er_ad_fac_eol lv_cyl_bal_er_ad_add_eol lv_cyl_bal_lam_sel_ad_cold_eol lv_cyl_bal_lam_sel_ad_hot_eol state_cyl_bal_er_ad_eol state_cyl_bal_lam_sel_ad_eol state_cyl_bal_lam_ad_eol t_cyl_bal_er_ad t_cyl_bal_lam_sel_ad t_cyl_bal_lam_ad t_cyl_bal_er_ad_dyw er_stnd_mmv_dif_bal_dyw er_stnd_mmv_dif_bal_max_dyw er_stnd_mmv_dif_bal_min_dyw t_cyl_bal_lam_sel_cbk_ad[0] t_cyl_bal_lam_sel_cbk_ad[1] lv_state_cyl_bal_sel_chg_ad lv_state_cyl_bal_sel_chg_wait[0] lv_state_cyl_bal_sel_chg_wait[1] lv_cyl_bal_lam_sel_ad_cold[0] lv_cyl_bal_lam_sel_ad_cold[1] lv_cyl_bal_lam_sel_ad_hot[0] lv_cyl_bal_lam_sel_ad_hot[1] ctr_cyl_bal_lam_cbk_ad[0] ctr_cyl_bal_lam_cbk_ad[1] lv_state_cyl_bal_lam_chg_ad lv_state_cyl_bal_lam_chg_wait[0] lv_state_cyl_bal_lam_chg_wait[1] lv_cyl_bal_lam_ad_fac[0] lv_cyl_bal_lam_ad_fac[1] lv_cyl_bal_lam_ad_add[0] lv_cyl_bal_lam_ad_add[1] lv_cyl_bal_ad_wg_open_req_eol[0] lv_cyl_bal_ad_wg_open_req_eol[1] /end OUT_MEASUREMENT
/end FUNCTION
/begin FUNCTION C_G_CRU "C_G_CRU"
 /begin SUB_FUNCTION CRU_General__calculation_of_cruise_control_and_constant_drive CRU_Controlled_acceleration CRU_Actuating_the_reference_input_variable CRU_Intercepting_the_reference_input_variable_target_acceleration CRU_Interventions CRU_Ready_state_and_display CRU_Evaluation_serial_data_line_from_the_MSW CRU_Conditions_for_cruise_control CRU_Additional_functions CRU_Step_cruise_control /end SUB_FUNCTION
/end FUNCTION
/begin FUNCTION CRU_General__calculation_of_cruise_control_and_constant_drive "_General  calculation of cruise control and constant drive"
 /begin DEF_CHARACTERISTIC c_vs_dif_min_is_cru c_vs_dif_max_is_cru c_vs_dif_rng_cru c_t_min_puc_cru ip_fac_prop_cru ip_fac_tq_cru_ini_add_at ip_fac_tq_cru_ini_add_mt c_fac_vs_dif_rng_cru ip_fac_tq_cru_dec__n_32 ip_fac_vs_dif_i_cru ip_fac_vs_sp_dif_i_cru c_fac_tq_cru_lgrd c_fac_tq_cru_max /end DEF_CHARACTERISTIC
 /begin OUT_MEASUREMENT vs_dif_i_cru vs_dif_cru fac_tq_cru_ini fac_tq_cru state_i_cru /end OUT_MEASUREMENT
/end FUNCTION
/begin FUNCTION CRU_Controlled_acceleration "_Controlled acceleration" /begin DEF_CHARACTERISTIC c_vs_dif_max_ac_cru c_vs_dif_min_ac_cru /end DEF_CHARACTERISTIC /begin OUT_MEASUREMENT t_ctl_cru vs_sp_cru vs_sp_dif_cru /end OUT_MEASUREMENT /end FUNCTION
/begin FUNCTION CRU_Actuating_the_reference_input_variable "_Actuating the reference input variable"
 /begin DEF_CHARACTERISTIC ip_fac_cru_rest__t_ctl_cru ip_fac_cru_ac__t_ctl_cru ip_fac_cru_dece__t_ctl_cru ip_fac_cc_cru_ac__t_ctl_cru ip_fac_cc_cru_dece__t_ctl_cru /end DEF_CHARACTERISTIC
 /begin OUT_MEASUREMENT fac_vs_ctl_cru /end OUT_MEASUREMENT
/end FUNCTION
/begin FUNCTION CRU_Intercepting_the_reference_input_variable_target_acceleration "_Intercepting the reference input variable target acceleration"
 /begin DEF_CHARACTERISTIC c_vs_ac_min_cru c_vs_ac_max_cru ip_fac_lgrd_cru_rest__vs_sp_dif ip_fac_lgrd_cru_tip__vs_sp_dif c_fac_ac_pos_cru c_fac_ac_pos_cru_rng_l /end DEF_CHARACTERISTIC
 /begin OUT_MEASUREMENT fac_vs_lgrd_cru /end OUT_MEASUREMENT
/end FUNCTION
/begin FUNCTION CRU_Interventions "_Interventions"
 /begin DEF_CHARACTERISTIC c_vs_dif_max_cru c_ac_pos_cru_tip c_ac_neg_cru_tip c_ac_neg_cru_deacc c_ac_pos_cru_deacc c_t_min_cru_con ip_ac_neg_cru_ac__n__fac_tq_cru c_vs_dif_delta_i c_ac_pos_cru_resu c_ac_pos_cru_resu_rng_l c_ac_pos_cru_ac c_ac_pos_cru_ac_rng_l ip_ac_neg_cru_resu c_vs_sp_cru_max_k c_vs_sp_cru_max_m c_vs_dif_tip_m c_vs_dif_tip_k /end DEF_CHARACTERISTIC
 /begin OUT_MEASUREMENT vs_sp_inc_cru vs_sp_dec_cru vs_sp_driv_cru lv_cru_over_act_ack vs_sp_cru_max /end OUT_MEASUREMENT
/end FUNCTION
/begin FUNCTION CRU_Ready_state_and_display "_Ready state and display"
 /begin DEF_CHARACTERISTIC lc_cru_req_swi c_t_crus_on c_t_ready_cru c_t_crus c_t_crus_off lc_crus_off_swi /end DEF_CHARACTERISTIC
 /begin OUT_MEASUREMENT lv_cru_main_swi /end OUT_MEASUREMENT
/end FUNCTION
/begin FUNCTION CRU_Evaluation_serial_data_line_from_the_MSW "_Evaluation serial data line from the MSW" /begin DEF_CHARACTERISTIC c_t_min_msw c_t_min_tip_msw /end DEF_CHARACTERISTIC /begin OUT_MEASUREMENT state_msw_can req_msw /end OUT_MEASUREMENT /end FUNCTION
/begin FUNCTION CRU_Conditions_for_cruise_control "_Conditions for cruise control"
 /begin DEF_CHARACTERISTIC c_t_cru_esp_off c_t_cru_asr_off c_t_cru_esp_brake_off c_vs_min_plaus_cru c_t_dly_vs_sp_cru_max c_n_vs_max_cru c_ac_max_cru c_vs_min_cru_m c_vs_min_cru_k /end DEF_CHARACTERISTIC
 /begin OUT_MEASUREMENT lv_cru_off_by_asr_esp_ctl req_cru lv_cru_off_irr lv_cru_act state_cru_can state_cru_off_rev state_cru_off_irr vs_min_cru state_cru /end OUT_MEASUREMENT
/end FUNCTION
/begin FUNCTION CRU_Additional_functions "_Additional functions"
 /begin DEF_CHARACTERISTIC c_t_err_vs_can c_fac_vs_fil c_vs_max_diag c_fac_tq_req_driv_mmv c_fac_ac_cru_mmv lc_vs_cru_fil c_crlc_vs_cru_mmv c_t_vs_diag_not_plaus c_t_dly_max_cru c_vs_sp_dif_min_cru c_vs_sp_dif_max_cru c_vs_dif_dly_cru_neg c_fac_tq_req_hys_cru c_vs_dif_dly_cru_pos c_vs_dif_min_cru_over /end DEF_CHARACTERISTIC
 /begin OUT_MEASUREMENT ac_cru lv_vs_diag_not_plaus fac_tq_req_driv_mmv n_vs_cru vs_fil t_err_vs_can vs_cru vs_dif_icl_tcs t_dly_cru lv_cru_over_act /end OUT_MEASUREMENT
/end FUNCTION
/begin FUNCTION CRU_Step_cruise_control "_Step cruise control"
 /begin DEF_CHARACTERISTIC c_vs_dif_step_prog_m c_vs_dif_step_prog_k c_vs_min_prog c_max_step c_t_cru_flash_light c_t_min_prog c_ctr_cru_flash_light c_t_dly_cru_tip c_t_min_cru_chg c_vs_dif_step_min_hys c_t_prog_step_if_act c_vs_dif_step_min_m c_vs_dif_step_min_k c_vs_dif_tip_prog_m c_vs_dif_tip_prog_k /end DEF_CHARACTERISTIC
 /begin OUT_MEASUREMENT nr_step_on count_vs_step vs_dif_step_prog lv_step_on vs_sp_driv_step nr_vs_cru vs_sp_driv_cru_can vs_step_can_1 vs_step_can_2 vs_step_can_3 lv_prog_step_1 lv_prog_step_if_act /end OUT_MEASUREMENT
/end FUNCTION
/begin FUNCTION C_1_GEN "C_1_GEN"
 /begin SUB_FUNCTION GEN_Variant_coding GEN_Initialisation_of_variables_from_non_implemented_functions GEN_Dataset_identification /end SUB_FUNCTION
/end FUNCTION
/begin FUNCTION GEN_Variant_coding "_Variant coding"
 /begin DEF_CHARACTERISTIC c_eng_conf c_conf_swi_efp_out c_conf_dmtl c_conf_oil_level_sens c_conf_cat c_n_var_dis_misf c_n_var_dis_er c_n_var_dis_inj lc_var_dis_fsd lc_var_dis_obd_cat lc_var_dis_nox lc_var_dis_cru lc_var_dis_tq_loss_ars lc_tcha_conf c_v_maf_avl c_ctr_avl_maf lc_mafm_det_di c_var_veh c_t_det_var_can lc_var_dis_dmtl lc_var_dis_s_fct /end DEF_CHARACTERISTIC
 /begin OUT_MEASUREMENT lv_var_asr lv_var_asr_3 lv_var_asr_4 lv_at lv_var_icl lv_ivvt_in_and_ex lv_inj_conf lv_isa_conf eng_conf vim_type lv_var_msw lv_var_sof lv_cbk_mpl conf_swi_efp_out conf_oil_level_sens lv_var_bn lv_var_bn_efp lv_conf_dmtl conf_sof_swi lv_var_ecras lv_var_ef lv_var_lsh_up lv_var_lsh_down psn_ls psn_ls_1 lv_var_ebox_cfa lv_var_rly_st lv_var_rly_accout var_veh lv_var_bn_gear_rev lv_var_acin lv_var_bn_ltg_hdlp_l cam_type lv_var_tcha lv_var_maf lv_var_veh state_var_det_cus_1 state_var_det_cus_2 lv_var_bn_ldm lv_var_bn_trl lv_var_bn_hiv /end OUT_MEASUREMENT
/end FUNCTION
/begin FUNCTION GEN_Initialisation_of_variables_from_non_implemented_functions "_Initialisation of variables from non implemented functions" /begin OUT_MEASUREMENT lv_mtc_lih_act online_dummy /end OUT_MEASUREMENT /end FUNCTION
/begin FUNCTION GEN_Dataset_identification "_Dataset identification" /begin DEF_CHARACTERISTIC c_data_id_0 c_data_id_1 c_data_id_2 cal_cks_active /end DEF_CHARACTERISTIC /end FUNCTION
/begin FUNCTION C_6_IGA "C_6_IGA"
 /begin SUB_FUNCTION IGA_Ignition_angle_general IGA_Dwell_time_control_open_loop IGA_Ignition_with_multiple_spark IGA_Corrected_basic_ignition_angle IGA_Setpoint_ignition_angle IGA_Minimum_ignition_angle IGA_Basic_ignition_angle_at_start IGA_KnockControl IGA_Ignition_angle_correction_due_to_EGR IGA_Minimum_IGA_limitation_for_exhaust_gas_temperature_protection IGA_Load_dynamics_correction /end SUB_FUNCTION
/end FUNCTION
/begin FUNCTION IGA_Ignition_angle_general "_Ignition angle general"
 /begin DEF_CHARACTERISTIC lc_iga_st_ena ip_iga_lgrd_ast c_iga_ini_h_rng lc_iga_man c_iga_as c_iga_man_h_rng c_iga_as_cyl[0] c_iga_as_cyl[1] c_iga_as_cyl[2] c_iga_as_cyl[3] c_iga_as_cyl[4] c_iga_as_cyl[5] c_iga_min_etc_lih c_n_max_iga_10ms_clc c_iga_ini c_iga_man c_crlc_iga_knk ip_fac_eff_iga_opm_1 ip_fac_eff_iga_opm_2 id_eff_iga_opm_req ip_fac_eff_iga_ch_cold_opm_1 ip_fac_eff_iga_ch_opm_1 ip_fac_eff_iga_ch_cold_opm_2 ip_fac_eff_iga_ch_opm_2 id_eff_iga_opm ip_iga_bas_ron_98 ip_eff_iga /end DEF_CHARACTERISTIC
 /begin OUT_MEASUREMENT iga_av_h_rng_1[0] iga_av_h_rng_1[1] iga_av_h_rng_1[2] iga_av_h_rng_1[3] iga_av_h_rng_1[4] iga_av_h_rng_1[5] iga[0] iga[1] iga[2] iga[3] iga[4] iga[5] iga_min_h_rng lv_iga_grd_act iga_wout_knk[0] iga_wout_knk[1] iga_wout_knk[2] iga_wout_knk[3] iga_wout_knk[4] iga_wout_knk[5] iga_sp_max_1_h_rng iga_sp_max_1_can_h_rng iga_av_mv_can_h_rng iga_av_h_rng[0] iga_av_h_rng[1] iga_av_h_rng[2] iga_av_h_rng[3] iga_av_h_rng[4] iga_av_h_rng[5] iga_av_mv_h_rng iga_av_mv_cbk_h_rng[0] iga_av_mv_cbk_h_rng[1] iga_av_mv_can iga_av_mv iga_av_mv_cbk[0] iga_av_mv_cbk[1] iga_igc[0] iga_igc[1] iga_igc[2] iga_igc[3] iga_igc[4] iga_igc[5] iga_igc_hom[0] iga_igc_hom[1] iga_igc_hom[2] iga_igc_hom[3] iga_igc_hom[4] iga_igc_hom[5] iga_min iga_sp_max_1_can iga_sp_max_1 iga_av_1[0] iga_av_1[1] iga_av_1[2] iga_av_1[3] iga_av_1[4] iga_av_1[5] iga_av[0] iga_av[1] iga_av[2] iga_av[3] iga_av[4] iga_av[5] eff_iga_ron_98_1 eff_iga_ron_98_2 eff_iga_av eff_iga_av_can eff_iga_av_1 eff_iga_av_2 eff_iga_min eff_iga_bas_cor_knk_fil iga_bas_cor_knk_add iga_dif_bas iga_dif_av_h_rng iga_dif_av_can_h_rng iga_dif_av_cbk_h_rng_1 iga_dif_av_cbk_h_rng_2 iga_dif_ron_98_h_rng_1 iga_dif_ron_98_h_rng_2 iga_mv_knk_fil iga_bas_cor_knk_fil iga_dif_bas_knk_fil fac_eff_iga eff_iga_bas_cor eff_iga_min_teg eff_iga_seg_av iga_dif_seg_av_h_rng /end OUT_MEASUREMENT
/end FUNCTION
/begin FUNCTION IGA_Dwell_time_control_open_loop "_Dwell time control open loop" /end FUNCTION
/begin FUNCTION IGA_Ignition_with_multiple_spark "_Ignition with multiple spark" /end FUNCTION
/begin FUNCTION IGA_Corrected_basic_ignition_angle "_Corrected basic ignition angle" /end FUNCTION
/begin FUNCTION IGA_Setpoint_ignition_angle "_Setpoint ignition angle"
 /begin DEF_CHARACTERISTIC lc_tq_iga_inh c_eff_iga_thd_1 c_eff_iga_thd_aj c_eff_iga_thd_is ip_iga_dif_sp_h_rng ip_iga_dif_sp /end DEF_CHARACTERISTIC
 /begin OUT_MEASUREMENT iga_dif_sp_h_rng lv_tq_iga_act lv_tq_iga_req eff_iga_sp_can eff_iga_sp_1 eff_iga_sp_1_can iga_sp_h_rng iga_sp_can_h_rng eff_iga_sp eff_iga_inv_cor eff_iga_inv_cor_can iga_sp iga_dif_sp iga_sp_can /end OUT_MEASUREMENT
/end FUNCTION
/begin FUNCTION IGA_Minimum_ignition_angle "_Minimum ignition angle"
 /begin DEF_CHARACTERISTIC c_iga_dif_min_delta_temp_ena c_iga_dif_min_delta_lgrd_h_rng ip_iga_dif_min_tco_h_rng ip_iga_dif_min_delta_h_rng c_iga_dif_min_delta_temp_dis ip_iga_dif_min_cyc_mt ip_iga_dif_min_cyc_at ip_iga_dif_min_cyc_amp_at_h_rng ip_iga_dif_min_cyc_amp_mt_h_rng ip_iga_min_n_maf_ext_h_rng ip_iga_dif_min_tco_ext_h_rng ip_iga_min_n_maf_h_rng ip_fac_iga_min_tco_ext ip_fac_iga_dif_ast ip_t_iga_min_puc c_iga_dif_min_bas_lgrd_h_rng c_iga_min_puc_lgrd_h_rng ip_fac_iga_min_tco_pu ip_iga_dif_min_tco_pu_h_rng ip_iga_min_n_maf_pu_h_rng ip_fac_iga_min_tco ip_fac_iga_dif_min_amp ip_iga_min_ch_cor_h_rng ip_iga_min_opm_cor_h_rng id_iga_min_opm_av id_iga_min_opm_req ip_iga_dif_min_cyc_amp_at ip_iga_dif_min_cyc_amp_mt ip_iga_min_n_maf ip_iga_min_n_maf_pu ip_iga_min_n_maf_ext ip_iga_dif_min_tco_ext ip_iga_dif_min_tco_pu ip_iga_dif_min_tco ip_iga_min_ch_cor ip_iga_min_opm_cor /end DEF_CHARACTERISTIC
 /begin OUT_MEASUREMENT iga_dif_min_h_rng iga_dif_min_delta_h_rng lv_iga_dif_min_delta_act iga_dif_min_ast_h_rng lv_iga_min_ext iga_min_bas_h_rng iga_min_bas_1_h_rng iga_min_bas_ext_h_rng iga_min_bas_int_h_rng iga_min_bas_puc_h_rng iga_min_bas_pu_h_rng iga_min_bas_2_h_rng lv_iga_min_opm_sel_1 lv_iga_min_opm_sel_2 lv_iga_min_opm_rls iga_min_bas_opm_h_rng iga_min_bas_2_opm_1_h_rng iga_min_bas_2_opm_2_h_rng iga_dif_min /end OUT_MEASUREMENT
/end FUNCTION
/end MODULE
/end PROJECT
