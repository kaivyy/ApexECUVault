ASAP2_VERSION 1 3
/begin PROJECT P383 "BMW DDE6.3 8-Zylinder V9E.3 11.10.2004 CAN12H"
/begin HEADER "" VERSION "V9E.3_8Z_CAN12H" PROJECT_NO P383 /end HEADER
/begin MODULE DIM ""
/begin MOD_COMMON "" BYTE_ORDER MSB_FIRST ALIGNMENT_BYTE 1 ALIGNMENT_WORD 2 ALIGNMENT_LONG 4 ALIGNMENT_FLOAT32_IEEE 4 /end MOD_COMMON
/begin CHARACTERISTIC AirCtl_mMaxDvtRgn_MAP "Kennfeld der oberen Grenzen für Erkennung bleibender Regelabweichung" MAP 0xC88C8 Kf_Xs16_Ys16_Ws16 200.0000 AirMassPerCyl 0.00 200.0000 FORMAT "%8.4" EXTENDED_LIMITS -3276.800 3276.700
 /begin AXIS_DESCR STD_AXIS Eng_nAvrg EngN 8 0.00 6000.000 FORMAT "%8.3" EXTENDED_LIMITS -32768.00 32767.00 DEPOSIT ABSOLUTE /end AXIS_DESCR
 /begin AXIS_DESCR STD_AXIS InjCtl_qCurrCor InjMassCyc 4 0.00 200.0000 FORMAT "%8.4" EXTENDED_LIMITS -327.6800 327.6700 DEPOSIT ABSOLUTE /end AXIS_DESCR
/end CHARACTERISTIC
/begin CHARACTERISTIC AirCtl_mMinDvtRgn_MAP "Kennfeld der unteren Grenzen für Erkennung bleibender Re-gelabweichung" MAP 0xC8924 Kf_Xs16_Ys16_Ws16 200.0000 AirMassPerCyl -200.0000 0.00 FORMAT "%8.4" EXTENDED_LIMITS -3276.800 3276.700
 /begin AXIS_DESCR STD_AXIS Eng_nAvrg EngN 8 0.00 6000.000 FORMAT "%8.3" EXTENDED_LIMITS -32768.00 32767.00 DEPOSIT ABSOLUTE /end AXIS_DESCR
 /begin AXIS_DESCR STD_AXIS InjCtl_qCurrCor InjMassCyc 4 0.00 200.0000 FORMAT "%8.4" EXTENDED_LIMITS -327.6800 327.6700 DEPOSIT ABSOLUTE /end AXIS_DESCR
/end CHARACTERISTIC
/begin CHARACTERISTIC AirCtl_qHiRgn_CUR "Kennlinie fuer obere Hysteresegrenze fuer Abschaltung bei grosser Einspritzmenge Regenerationsbetrieb" CURVE 0xC8980 Kl_Xs16_Ws16 327.6700 InjMass 0.00 327.6700 FORMAT "%8.4" EXTENDED_LIMITS -327.6800 327.6700
 /begin AXIS_DESCR STD_AXIS Eng_nAvrg EngN 16 0.00 6000.000 FORMAT "%8.3" EXTENDED_LIMITS -32768.00 32767.00 DEPOSIT ABSOLUTE /end AXIS_DESCR
/end CHARACTERISTIC
/begin CHARACTERISTIC AirCtl_qLoRgn_CUR "Kennlinie fuer Hysteresegrenze fuer Abschaltung bei grosser Einspritzmenge Regenerationsbetrieb" CURVE 0xC89C2 Kl_Xs16_Ws16 327.6700 InjMass 0.00 327.6700 FORMAT "%8.4" EXTENDED_LIMITS -327.6800 327.6700
 /begin AXIS_DESCR STD_AXIS Eng_nAvrg EngN 16 0.00 6000.000 FORMAT "%8.3" EXTENDED_LIMITS -32768.00 32767.00 DEPOSIT ABSOLUTE /end AXIS_DESCR
/end CHARACTERISTIC
/begin CHARACTERISTIC AirCtl_rEGRAdd_Vector "Bypass-Label für additiven Bypass von AirCtl_rEGR (Nicht verstellen!)" VALUE 0xC38CC Kw_Wu8 255.0 OneToOne 0.00 255.0 FORMAT "%5.1" /end CHARACTERISTIC
/begin CHARACTERISTIC AirCtl_rEGRAdd_Channel "Bypass-Label für additiven Bypass von AirCtl_rEGR (Nicht verstellen!)" VALUE 0xC38CD Kw_Wu8 255.0 OneToOne 0.00 255.0 FORMAT "%5.1" /end CHARACTERISTIC
/begin CHARACTERISTIC AirCtl_rEGR_Vector "Bypass-Label für AirCtl_rEGR (Nicht verstellen!)" VALUE 0xC38CE Kw_Wu8 255.0 OneToOne 0.00 255.0 FORMAT "%5.1" /end CHARACTERISTIC
/begin CHARACTERISTIC AirCtl_rEGR_Channel "Bypass-Label für AirCtl_rEGR (Nicht verstellen!)" VALUE 0xC38CF Kw_Wu8 255.0 OneToOne 0.00 255.0 FORMAT "%5.1" /end CHARACTERISTIC
/begin CHARACTERISTIC AirCtl_rTVAAdd_Vector "Bypass-Label für additiven Bypass von AirCtl_rTVA (Nicht verstellen!)" VALUE 0xC38D0 Kw_Wu8 255.0 OneToOne 0.00 255.0 FORMAT "%5.1" /end CHARACTERISTIC
/begin CHARACTERISTIC AirCtl_rTVAAdd_Channel "Bypass-Label für additiven Bypass von AirCtl_rTVA (Nicht verstellen!)" VALUE 0xC38D1 Kw_Wu8 255.0 OneToOne 0.00 255.0 FORMAT "%5.1" /end CHARACTERISTIC
/begin CHARACTERISTIC AirCtl_rTVADflVal7_C "Vorgabewert 7 fuer Stellgroesse der Drosselklappe (Regeneration)" VALUE 0xC8A04 Kw_Ws16 300.0000 Prc -100.0000 200.0000 FORMAT "%8.4" EXTENDED_LIMITS -400.0000 399.9878 /end CHARACTERISTIC
/begin CHARACTERISTIC AirCtl_rTVADflVal8B_C "Vorgabewert 8B wenn TVACD Fehler gesetzt" VALUE 0xC8A06 Kw_Ws16 300.0000 Prc -100.0000 200.0000 FORMAT "%8.4" EXTENDED_LIMITS -400.0000 399.9878 /end CHARACTERISTIC
/begin CHARACTERISTIC AirCtl_rTVA_Vector "Bypass-Label für AirCtl_rTVA (Nicht verstellen!)" VALUE 0xC38D2 Kw_Wu8 255.0 OneToOne 0.00 255.0 FORMAT "%5.1" /end CHARACTERISTIC
/begin CHARACTERISTIC AirCtl_rTVA_Channel "Bypass-Label für AirCtl_rTVA (Nicht verstellen!)" VALUE 0xC38D3 Kw_Wu8 255.0 OneToOne 0.00 255.0 FORMAT "%5.1" /end CHARACTERISTIC
/begin CHARACTERISTIC AirCtl_stMskLoIdl_C "Maskierung zur Verhinderung der Abschaltung der Luftmassenregelung im Leerlauf bei Regenerationsbetrieb" VALUE 0xC8A08 Kw_Wu32 4294967295.00 OneToOne 0.00 4294967295.00 FORMAT "%13.2" /end CHARACTERISTIC
/begin CHARACTERISTIC AirCtl_stMskOvrRun_C "Maskierung zur Verhinderung der Abschaltung der Luftmassenregelung im Regenerationsbetrieb" VALUE 0xC8A0C Kw_Wu32 4294967295.00 OneToOne 0.00 4294967295.00 FORMAT "%13.2" /end CHARACTERISTIC
/begin CHARACTERISTIC AirCtl_stMskQCurRgn_C "Maske für EGT_st zur Umschaltung auf zweite Mengenkurve bei Regeneration" VALUE 0xC8A10 Kw_Wu32 4294967295.00 OneToOne 0.00 4294967295.00 FORMAT "%13.2" /end CHARACTERISTIC
/begin CHARACTERISTIC AirCtl_stMskShOffRgn_C "Maske für EGT_st zur Reglerabschaltung bei Regeneration" VALUE 0xC8A14 Kw_Wu32 4294967295.00 OneToOne 0.00 4294967295.00 FORMAT "%13.2" /end CHARACTERISTIC
/begin CHARACTERISTIC AirCtl_DebGvnrDvtRgnMaxDef2_C "Entprellwert für Defektwert2 maximale regelabweichung bei Regeneration" VALUE 0xC8A18 Kw_Wu16 65540.00 TimeDeb 0.00 65540.00 FORMAT "%8.2" EXTENDED_LIMITS 0.00 655350.0 /end CHARACTERISTIC
/begin CHARACTERISTIC AirCtl_DebGvnrDvtRgnMaxOk2_C "Entprellwert für Heilung maximale regelabweichung bei Regeneration2" VALUE 0xC8A1A Kw_Wu16 65540.00 TimeDeb 0.00 65540.00 FORMAT "%8.2" EXTENDED_LIMITS 0.00 655350.0 /end CHARACTERISTIC
/begin CHARACTERISTIC AirCtl_DebGvnrDvtRgnMaxDef_C "Vorentprellzeit für Erkennung positiver bleibender Regelabweichung in Regeneration" VALUE 0xC8A1C Kw_Wu16 65540.00 TimeDeb 0.00 65540.00 FORMAT "%8.2" EXTENDED_LIMITS 0.00 655350.0 /end CHARACTERISTIC
/begin CHARACTERISTIC AirCtl_DebGvnrDvtRgnMaxOk_C "Vorentprellzeit für Heilung bei positiver bleibender Regelabw." VALUE 0xC8A1E Kw_Wu16 65540.00 TimeDeb 0.00 65540.00 FORMAT "%8.2" EXTENDED_LIMITS 0.00 655350.0 /end CHARACTERISTIC
/begin CHARACTERISTIC AirCtl_DebGvnrDvtRgnMinDef2_C "Entprellwert für Defektwert2 minimale regelabweichung bei Regeneration" VALUE 0xC8A20 Kw_Wu16 65540.00 TimeDeb 0.00 65540.00 FORMAT "%8.2" EXTENDED_LIMITS 0.00 655350.0 /end CHARACTERISTIC
/begin CHARACTERISTIC AirCtl_DebGvnrDvtRgnMinOk2_C "Entprellwert für Heilung minimale regelabweichung bei Regeneration2" VALUE 0xC8A22 Kw_Wu16 65540.00 TimeDeb 0.00 65540.00 FORMAT "%8.2" EXTENDED_LIMITS 0.00 655350.0 /end CHARACTERISTIC
/begin CHARACTERISTIC AirCtl_DebGvnrDvtRgnMinDef_C "Vorentprellzeit für Erkennung negativer bleibender Regelabw." VALUE 0xC8A24 Kw_Wu16 65540.00 TimeDeb 0.00 65540.00 FORMAT "%8.2" EXTENDED_LIMITS 0.00 655350.0 /end CHARACTERISTIC
/begin CHARACTERISTIC AirCtl_DebGvnrDvtRgnMinOk_C "Vorentprellzeit für Heilung bei negativer bleibender Regelabw." VALUE 0xC8A26 Kw_Wu16 65540.00 TimeDeb 0.00 65540.00 FORMAT "%8.2" EXTENDED_LIMITS 0.00 655350.0 /end CHARACTERISTIC
/begin CHARACTERISTIC AirSys_swtOLDAvisible_C "Schalter für Darstellung von entsprechenden Abgas-, Ansaugfluteigenschaften" VALUE 0xC8A28 Kw_Wu8 2.00000000000 numAirSys 0.00 2.00000000000 FORMAT "%13.11" /end CHARACTERISTIC
/begin CHARACTERISTIC AltCD_swtGenTyp_C "1: Liest Generatortyp und Hersteller vom BSS-Client ein, 0: setzt Generatortyp und Hersteller auf einen Vorgabewert" VALUE 0xC8A56 Kw_Wu8 1.000 dez 0.00 1.000 FORMAT "%5.3" EXTENDED_LIMITS 0.00 255.0 /end CHARACTERISTIC
/begin CHARACTERISTIC AltCD_swtLROff_C "Maximale Load Response Time ins Generatorsteuergerät schreiben (Schalter: 1-->Load Response Ausschaltstatus = 1, 0-->0)" VALUE 0xC8A57 Kw_Wu8 1.000 OneToOne 0.00 1.000 FORMAT "%5.3" EXTENDED_LIMITS 0.00 255.0 /end CHARACTERISTIC
/begin CHARACTERISTIC AltCD_tiDebDefect_C "Fehlerentprellzeit, Kommunikationsfehler - BSD Schnittstelle" VALUE 0xC8A58 Kw_Wu16 655350.0 Time_ms 0.00 655350.0 FORMAT "%8.1" /end CHARACTERISTIC
/begin CHARACTERISTIC AltCD_tiDebOk_C "Heilungsentprellzeit, Kommunikationsfehler - BSD Schnittstelle" VALUE 0xC8A5A Kw_Wu16 655350.0 Time_ms 0.00 655350.0 FORMAT "%8.1" /end CHARACTERISTIC
/begin CHARACTERISTIC AltCD_tiLRMax_C "Load Response Time, Maximumwert für SRC" VALUE 0xC8A5C Kw_Wu16 9.000000 Time_s 0.00 9.000000 FORMAT "%8.6" EXTENDED_LIMITS 0.00 655.3500 /end CHARACTERISTIC
/begin CHARACTERISTIC AltCD_tiLRMin_C "Load Response Time, Mimimumwert für SRC" VALUE 0xC8A5E Kw_Wu16 9.000000 Time_s 0.00 9.000000 FORMAT "%8.6" EXTENDED_LIMITS 0.00 655.3500 /end CHARACTERISTIC
/begin CHARACTERISTIC AltCD_tiOutput_C "Zeit zwischen 2 Ausgaben zum Generator mit BSD Schnittstelle" VALUE 0xC8A60 Kw_Wu16 480.0000 Time_ms 20.00000 500.0000 FORMAT "%8.4" EXTENDED_LIMITS 0.00 655350.0 /end CHARACTERISTIC
/begin CHARACTERISTIC AltCD_tiReset_C "Regenerierzeit der BSD Schnittstelle nach einem Kommunikationsfehler mit dem Generator" VALUE 0xC8A62 Kw_Wu16 1980.000 Time_ms 20.00000 2000.000 FORMAT "%8.3" EXTENDED_LIMITS 0.00 655350.0 /end CHARACTERISTIC
/begin CHARACTERISTIC AltCD_uAltMax_C "Maximalwert für Generatorspannungs-Sollwerts" VALUE 0xC8A64 Kw_Ws16 6197.458 Volt_Batt 10694.04 16891.50 FORMAT "%8.2" EXTENDED_LIMITS -640625.6 640606.1 /end CHARACTERISTIC
/begin CHARACTERISTIC AltCD_uAltMin_C "Minimalwert für Generatorspannungs-Sollwerts" VALUE 0xC8A66 Kw_Ws16 6197.458 Volt_Batt 10694.04 16891.50 FORMAT "%8.2" EXTENDED_LIMITS -640625.6 640606.1 /end CHARACTERISTIC
/begin CHARACTERISTIC AltCD_uAltTraModMax_C "Obere Begrenzung auf die Wechselstromerzeugerspannung Standardwert für Energieeinsparung-Transportmodus" VALUE 0xC8A68 Kw_Ws16 6197.458 Volt_Batt 10694.04 16891.50 FORMAT "%8.2" EXTENDED_LIMITS -640625.6 640606.1 /end CHARACTERISTIC
/begin CHARACTERISTIC AltCD_uAltTraModMin_C "unterere Begrenzung auf die Wechselstromerzeugerspannung Standardwert für Energieeinsparung-Transportmodus" VALUE 0xC8A6A Kw_Ws16 6197.458 Volt_Batt 10694.04 16891.50 FORMAT "%8.2" EXTENDED_LIMITS -640625.6 640606.1 /end CHARACTERISTIC
/begin CHARACTERISTIC Alt_facTrans_C "Faktor fuer Kennlinieneingang Berechnung Leistungsbedarf" VALUE 0xC8A2A Kw_Ws16 65.53500 SlopeRes1000 -32.76800 32.76700 FORMAT "%8.5" /end CHARACTERISTIC
/begin CHARACTERISTIC Alt_pwrBas_CUR "Kennlinie Leistungsbedarfberechnung" CURVE 0xC8A2C Kl_Xs16_Ws16 300000.1 Pwr 0.00 300000.1 FORMAT "%8.1" EXTENDED_LIMITS -308831.1 308821.7
 /begin AXIS_DESCR STD_AXIS Alt_n_mp EngN 8 0.00 32767.00 FORMAT "%8.2" EXTENDED_LIMITS -32768.00 32767.00 DEPOSIT ABSOLUTE /end AXIS_DESCR
/end CHARACTERISTIC
/begin CHARACTERISTIC Alt_pwrDes_Vector "Bypass Label, nicht ändern!" VALUE 0xC38D4 Kw_Wu8 255.0 OneToOne 0.00 255.0 FORMAT "%5.1" /end CHARACTERISTIC
/begin CHARACTERISTIC Alt_pwrDes_Channel "Bypass Label, nicht ändern!" VALUE 0xC38D5 Kw_Wu8 255.0 OneToOne 0.00 255.0 FORMAT "%5.1" /end CHARACTERISTIC
/begin CHARACTERISTIC Alt_pwrOffs_C "Offset fuer Leistungsbedarf Generator" VALUE 0xC8A4E Kw_Ws16 300000.1 Pwr 0.00 300000.1 FORMAT "%8.1" EXTENDED_LIMITS -308831.1 308821.7 /end CHARACTERISTIC
/begin CHARACTERISTIC Alt_rAdjValDef_C "Standardwert für Abgleich Leistungsanforderung Generator" VALUE 0xC8A50 Kw_Ws16 0.00 Fact 1.000000 1.000000 FORMAT "%8.6" EXTENDED_LIMITS -4.000000 3.999878 /end CHARACTERISTIC
/begin CHARACTERISTIC Alt_rAdjValMax_C "Maximalwert für Abgleich Leistungsanforderung Generator" VALUE 0xC8A52 Kw_Ws16 3.199951 Fact 0.00 3.199951 FORMAT "%8.6" EXTENDED_LIMITS -4.000000 3.999878 /end CHARACTERISTIC
/begin CHARACTERISTIC Alt_rAdjValMin_C "Minimalwert für Abgleich Leistungsanforderung Generator" VALUE 0xC8A54 Kw_Ws16 3.199951 Fact 0.00 3.199951 FORMAT "%8.6" EXTENDED_LIMITS -4.000000 3.999878 /end CHARACTERISTIC
/begin CHARACTERISTIC AOHtCD_ctPwrStgOnMax_C "Maximaler Zähler für Powerstage On im Fehlerfall" VALUE 0xC8B10 Kw_Wu16 65535.00 OneToOne 0.00 65535.00 FORMAT "%8.2" /end CHARACTERISTIC
/begin CHARACTERISTIC AOHtCD_tiDebAOHtDia1Def_C "Fehlerentprellzeit für Kühlwasserheizungs Diagnose erstes Zeitfenster" VALUE 0xC8B12 Kw_Wu16 655350.0 Time_ms 0.00 655350.0 FORMAT "%8.1" /end CHARACTERISTIC
/begin CHARACTERISTIC AOHtCD_tiDebAOHtDia1Ok_C "Fehlerheilzeit für Kühlwasserheizungs Diagnose erstes Zeitfenster" VALUE 0xC8B14 Kw_Wu16 655350.0 Time_ms 0.00 655350.0 FORMAT "%8.1" /end CHARACTERISTIC
/begin CHARACTERISTIC AOHtCD_tiDebAOHtDia2Def_C "Fehlerentprellzeit für Kühlwasserheizungs Diagnose zweites Zeitfenster" VALUE 0xC8B16 Kw_Wu16 655350.0 Time_ms 0.00 655350.0 FORMAT "%8.1" /end CHARACTERISTIC
/begin CHARACTERISTIC AOHtCD_tiDebAOHtDia2Ok_C "Fehlerheilzeit für Kühlwasserheizungs Diagnose zweites Zeitfenster" VALUE 0xC8B18 Kw_Wu16 655350.0 Time_ms 0.00 655350.0 FORMAT "%8.1" /end CHARACTERISTIC
/begin CHARACTERISTIC AOHtCD_tiDebAOHtDia3Def_C "Fehlerentprellzeit für Kühlwasserheizungs Diagnose drittes Zeitfenster" VALUE 0xC8B1A Kw_Wu16 655350.0 Time_ms 0.00 655350.0 FORMAT "%8.1" /end CHARACTERISTIC
/begin CHARACTERISTIC AOHtCD_tiDebAOHtDia3Ok_C "Fehlerheilzeit für Kühlwasserheizungs Diagnose drittes Zeitfenster" VALUE 0xC8B1C Kw_Wu16 655350.0 Time_ms 0.00 655350.0 FORMAT "%8.1" /end CHARACTERISTIC
/begin CHARACTERISTIC AOHtCD_tiDebExcTempDef_C "Fehlerentprellzeit, Übertemperaturfehler" VALUE 0xC8B1E Kw_Wu16 655350.0 Time_ms 0.00 655350.0 FORMAT "%8.1" /end CHARACTERISTIC
/begin CHARACTERISTIC AOHtCD_tiDebExcTempOk_C "Heilungsentprellzeit, Übertemperaturfehler" VALUE 0xC8B20 Kw_Wu16 655350.0 Time_ms 0.00 655350.0 FORMAT "%8.1" /end CHARACTERISTIC
/begin CHARACTERISTIC AOHtCD_tiDebNoLoadDef_C "Fehlerentprellzeit, Lastabfall" VALUE 0xC8B22 Kw_Wu16 655350.0 Time_ms 0.00 655350.0 FORMAT "%8.1" /end CHARACTERISTIC
/begin CHARACTERISTIC AOHtCD_tiDebNoLoadOk_C "Heilungsentprellzeit, Lastabfall" VALUE 0xC8B24 Kw_Wu16 655350.0 Time_ms 0.00 655350.0 FORMAT "%8.1" /end CHARACTERISTIC
/begin CHARACTERISTIC AOHtCD_tiDebPos_C "Entprellzeit für positive Flanke Eingangssignal 'Zuheizer Aus'" VALUE 0xC8B26 Kw_Wu16 2000.000 TimeDeb 0.00 2000.000 FORMAT "%8.3" EXTENDED_LIMITS 0.00 655350.0 /end CHARACTERISTIC
/begin CHARACTERISTIC AOHtCD_tiDebNeg_C "Entprellzeit für negative Flanke Eingangssignal 'Zuheizer Aus'" VALUE 0xC8B28 Kw_Wu16 2000.000 TimeDeb 0.00 2000.000 FORMAT "%8.3" EXTENDED_LIMITS 0.00 655350.0 /end CHARACTERISTIC
/begin CHARACTERISTIC AOHtCD_tiDebShortCircBatDef_C "Fehlerentprellzeit, Kurzschluß Batterie" VALUE 0xC8B2A Kw_Wu16 655350.0 Time_ms 0.00 655350.0 FORMAT "%8.1" /end CHARACTERISTIC
/begin CHARACTERISTIC AOHtCD_tiDebShortCircBatOk_C "Heilungsentprellzeit, Kurzschluß Batterie" VALUE 0xC8B2C Kw_Wu16 655350.0 Time_ms 0.00 655350.0 FORMAT "%8.1" /end CHARACTERISTIC
/begin CHARACTERISTIC AOHtCD_tiDebShortCircGndDef_C "Fehlerentprellzeit, Kurzschluß nach Masse" VALUE 0xC8B2E Kw_Wu16 655350.0 Time_ms 0.00 655350.0 FORMAT "%8.1" /end CHARACTERISTIC
/begin CHARACTERISTIC AOHtCD_tiDebShortCircGndOk_C "Heilungsentprellzeit, Kurzschluß nach Masse" VALUE 0xC8B30 Kw_Wu16 655350.0 Time_ms 0.00 655350.0 FORMAT "%8.1" /end CHARACTERISTIC
/begin CHARACTERISTIC AOHtCD_numDia_C "Parameter für Hardware Diagnose-Pin Auswahl" VALUE 0xC8B32 Kw_Wu8 33.0000000000 NumPinDia 0.00 33.0000000000 FORMAT "%13.10" /end CHARACTERISTIC
/begin CHARACTERISTIC AOHtCD_numDioIn_C "Applikationsparameter fuer hardware-Pin Auswahl Eingangssignal 'Zuheizer Aus'" VALUE 0xC8B33 Kw_Wu8 12.0000000000 NumPinDioIn 0.00 12.0000000000 FORMAT "%13.10" /end CHARACTERISTIC
/begin CHARACTERISTIC AOHtCD_numPwmOut_C "Parameter für Hardware Endstufen-Pin Auswahl" VALUE 0xC8B34 Kw_Wu8 13.0000000000 NumPinPwmOut 0.00 13.0000000000 FORMAT "%13.10" /end CHARACTERISTIC
/begin CHARACTERISTIC AOHtCD_stInvOut_C "Invertierungsparameter der PWM-Endstufe" VALUE 0xC8B36 Kw_Wu8 1.000 OneToOne 0.00 1.000 FORMAT "%5.3" EXTENDED_LIMITS 0.00 255.0 /end CHARACTERISTIC
/begin CHARACTERISTIC AOHtCD_tiPer_C "Periodendauer der PWM-Endstufe" VALUE 0xC8B38 Kw_Ws16 6553.500 Period -3276.800 3276.700 FORMAT "%8.3" /end CHARACTERISTIC
/begin CHARACTERISTIC AOHtCD_rOutMax_C "Maximum-Wert, Ausgangstastverhältnis" VALUE 0xC8B3A Kw_Ws16 655.3500 DtyCyc -327.6800 327.6700 FORMAT "%8.4" /end CHARACTERISTIC
/begin CHARACTERISTIC AOHtCD_rOutMin_C "Minimumwert des Ausgangstastverhältnisses" VALUE 0xC8B3C Kw_Ws16 655.3500 DtyCyc -327.6800 327.6700 FORMAT "%8.4" /end CHARACTERISTIC
/begin CHARACTERISTIC AOHtCD_rTst_C "Tastverhältnis das im Fehlerfall ausgegeben wird" VALUE 0xC8B3E Kw_Ws16 100.0000 DtyCyc 0.00 100.0000 FORMAT "%8.4" EXTENDED_LIMITS -327.6800 327.6700 /end CHARACTERISTIC
/begin CHARACTERISTIC AOHtCD_stPwrStgActv_C "Statuswort zur Aktivierung der Abschaltbedingung für die Zuheizer Endstufe" VALUE 0xC8B40 Kw_Wu8 255.0 OneToOne 0.00 255.0 FORMAT "%5.1" /end CHARACTERISTIC
/begin CHARACTERISTIC AOHtCD_stPwrStgDia_C "Statuswort zur Aktivierung der Abschaltbedingung der Endstufendiagnose für Zuheizer1" VALUE 0xC8B41 Kw_Wu8 255.0 OneToOne 0.00 255.0 FORMAT "%5.1" /end CHARACTERISTIC
/begin CHARACTERISTIC AOHtCD_stSPICtl_C "Schalter ob Endstufe SPI kontrollierbar = 1 oder nicht SPI kontrollierbar = 0" VALUE 0xC8B42 Kw_Wu8 1.000 OneToOne 0.00 1.000 FORMAT "%5.3" EXTENDED_LIMITS 0.00 255.0 /end CHARACTERISTIC
/begin CHARACTERISTIC AOHtCD_swtBattCorr_C "Zuschaltung der Batteriespannungskorrektur (1: zugeschaltet, 0: abgeschaltet)" VALUE 0xC8B43 Kw_Wu8 255.0 OneToOne 0.00 255.0 FORMAT "%5.1" /end CHARACTERISTIC
/begin CHARACTERISTIC AOHtCD_swtInv_C "Invertierungsparamter des Digitaleingangs (Heizleistungsanforderung) (1: invertieren, 0 : nicht invertieren)" VALUE 0xC8B44 Kw_Wu8 1.000 OneToOne 0.00 1.000 FORMAT "%5.3" EXTENDED_LIMITS 0.00 255.0 /end CHARACTERISTIC
/begin CHARACTERISTIC AOHtCD_tiBtwTst_C "Zeitabstand, in dem die Endstufe im Fehlerfall getestet wird" VALUE 0xC8B46 Kw_Wu16 29980.00 Time_ms 20.00000 30000.00 FORMAT "%8.2" EXTENDED_LIMITS 0.00 655350.0 /end CHARACTERISTIC
/begin CHARACTERISTIC AOHtCD_tiDiag1Max_C "Maximum des ersten Signalfensters für Fehlersignale des Kühlwasserheizung-SG" VALUE 0xC8B48 Kw_Wu16 655350.0 Time_ms 0.00 655350.0 FORMAT "%8.1" /end CHARACTERISTIC
/begin CHARACTERISTIC AOHtCD_tiDiag1Min_C "Minimum des ersten Signalfensters für Fehlersignale des Kühlwasserheizung-SG" VALUE 0xC8B4A Kw_Wu16 655350.0 Time_ms 0.00 655350.0 FORMAT "%8.1" /end CHARACTERISTIC
/begin CHARACTERISTIC AOHtCD_tiDiag2Max_C "Maximum des zweiten Signalfensters für Fehlersignale des Kühlwasserheizung-SG" VALUE 0xC8B4C Kw_Wu16 655350.0 Time_ms 0.00 655350.0 FORMAT "%8.1" /end CHARACTERISTIC
/begin CHARACTERISTIC AOHtCD_tiDiag2Min_C "Minimum des zweiten Signalfensters für Fehlersignale des Kühlwasserheizung-SG" VALUE 0xC8B4E Kw_Wu16 655350.0 Time_ms 0.00 655350.0 FORMAT "%8.1" /end CHARACTERISTIC
/begin CHARACTERISTIC AOHtCD_tiDiag3Max_C "Maximum des dritten Signalfensters für Fehlersignale des Kühlwasserheizung-SG" VALUE 0xC8B50 Kw_Wu16 655350.0 Time_ms 0.00 655350.0 FORMAT "%8.1" /end CHARACTERISTIC
/begin CHARACTERISTIC AOHtCD_tiDiag3Min_C "Minimum des dritten Signalfensters für Fehlersignale des Kühlwasserheizung-SG" VALUE 0xC8B52 Kw_Wu16 655350.0 Time_ms 0.00 655350.0 FORMAT "%8.1" /end CHARACTERISTIC
/begin CHARACTERISTIC AOHtCD_tiPwrStgOn_C "Zeit für welche die Endstufe im Fehlerfall eingeschalten wird (nur nicht SPI kontrolliert)" VALUE 0xC8B54 Kw_Wu16 655140.0 Time_ms 0.00 655140.0 FORMAT "%8.1" EXTENDED_LIMITS 0.00 655350.0 /end CHARACTERISTIC
/begin CHARACTERISTIC AOHt_IKi_C "I-Parameter wenn Reglerabweichung innerhalb der Kleinsignalgrenzen" VALUE 0xC8A6C Kw_Wu32 5.00003807247 Ki 0.00 5.00003807247 FORMAT "%13.11" EXTENDED_LIMITS 0.00 999999.999767 /end CHARACTERISTIC
/begin CHARACTERISTIC AOHt_IKiPos_C "I-Parameter wenn die Regelabweichung über den Kleinsignalgrenzen liegt" VALUE 0xC8A70 Kw_Wu32 5.00003807247 Ki 0.00 5.00003807247 FORMAT "%13.11" EXTENDED_LIMITS 0.00 999999.999767 /end CHARACTERISTIC
/begin CHARACTERISTIC AOHt_IKiNeg_C "I-Parameter wenn die Regelabweichung unter den Kleinsignalgrenzen liegt" VALUE 0xC8A74 Kw_Wu32 5.00003807247 Ki 0.00 5.00003807247 FORMAT "%13.11" EXTENDED_LIMITS 0.00 999999.999767 /end CHARACTERISTIC
/begin CHARACTERISTIC AOHt_rIWinPos_C "positive Fenstergrenze des PI-Reglers" VALUE 0xC8A78 Kw_Ws16 100.0000 DtyCyc 0.00 100.0000 FORMAT "%8.4" EXTENDED_LIMITS -327.6800 327.6700 /end CHARACTERISTIC
/begin CHARACTERISTIC AOHt_rIWinNeg_C "negative Fenstergrenze des PI-Reglers" VALUE 0xC8A7A Kw_Ws16 0.00 DtyCyc 0.00 0.00 FORMAT "%8.2" EXTENDED_LIMITS -327.6800 327.6700 /end CHARACTERISTIC
/begin CHARACTERISTIC AOHt_nAvrgHysMin_C "untere Hysterese-Schwelle für Motordrehzahlhysterese" VALUE 0xC8A7C Kw_Ws16 5960.000 EngN 40.00000 6000.000 FORMAT "%8.3" EXTENDED_LIMITS -32768.00 32767.00 /end CHARACTERISTIC
/begin CHARACTERISTIC AOHt_nAvrgHysMax_C "oberere Hysterese-Schwelle für Motordrehzahlhysterese" VALUE 0xC8A7E Kw_Ws16 5960.000 EngN 40.00000 6000.000 FORMAT "%8.3" EXTENDED_LIMITS -32768.00 32767.00 /end CHARACTERISTIC
/begin CHARACTERISTIC AOHt_stNAvrgShutOffEn_C "Abschaltbedingung wenn untere Drehzahlschwelle unterschritten" VALUE 0xC8A80 Kw_Ws16 65535.00 OneToOne -32768.00 32767.00 FORMAT "%8.2" READ_ONLY /end CHARACTERISTIC
/begin CHARACTERISTIC AOHt_stNAvrgShutOffDis_C "Abschaltbedingung nicht erfuellt" VALUE 0xC8A82 Kw_Ws16 65535.00 OneToOne -32768.00 32767.00 FORMAT "%8.2" READ_ONLY /end CHARACTERISTIC
/begin CHARACTERISTIC AOHt_nMin_C "Leerlaufanhebung bei Zuheizung" VALUE 0xC8A84 Kw_Ws16 500.0000 EngN 0.00 500.0000 FORMAT "%8.4" EXTENDED_LIMITS -32768.00 32767.00 /end CHARACTERISTIC
/begin CHARACTERISTIC AOHt_PKp_C "P-Parameter wenn die Regelabweichung innerhalb der Kleinsignalgrenzen liegt" VALUE 0xC8A88 Kw_Wu32 10.0000000000 Kp 0.00 10.0000000000 FORMAT "%13.10" EXTENDED_LIMITS 0.00 65535.9999847 /end CHARACTERISTIC
/begin CHARACTERISTIC AOHt_PKpPos_C "I-Parameter wenn die Regelabweichung über den Kleinsignalgrenzen liegt" VALUE 0xC8A8C Kw_Wu32 10.0000000000 Kp 0.00 10.0000000000 FORMAT "%13.10" EXTENDED_LIMITS 0.00 65535.9999847 /end CHARACTERISTIC
/begin CHARACTERISTIC AOHt_PKpNeg_C "P-Parameter wenn die Regelabweichung unter den Kleinsignalgrenzen liegt" VALUE 0xC8A90 Kw_Wu32 10.0000000000 Kp 0.00 10.0000000000 FORMAT "%13.10" EXTENDED_LIMITS 0.00 65535.9999847 /end CHARACTERISTIC
/begin CHARACTERISTIC AOHt_rPWinPos_C "positive Fenstergrenzen des PI-Reglers für P-Parameterauswahl" VALUE 0xC8A94 Kw_Ws16 100.0000 DtyCyc 0.00 100.0000 FORMAT "%8.4" EXTENDED_LIMITS -327.6800 327.6700 /end CHARACTERISTIC
/begin CHARACTERISTIC AOHt_rPWinNeg_C "negative Fenstergrenze des PI-Reglers für P-Parameterauswahl" VALUE 0xC8A96 Kw_Ws16 0.00 DtyCyc 0.00 0.00 FORMAT "%8.2" EXTENDED_LIMITS -327.6800 327.6700 /end CHARACTERISTIC
/begin CHARACTERISTIC AOHt_rHtgOutMax_C "Maximal-Tastverhältnis am PI-Regler Ausgang" VALUE 0xC8A98 Kw_Ws16 100.0000 DtyCyc 0.00 100.0000 FORMAT "%8.4" EXTENDED_LIMITS -327.6800 327.6700 /end CHARACTERISTIC
/begin CHARACTERISTIC AOHt_rHtgOutMin_C "Maximal-Tastverhältnis am PI-Regler Ausgang" VALUE 0xC8A9A Kw_Ws16 100.0000 DtyCyc 0.00 100.0000 FORMAT "%8.4" EXTENDED_LIMITS -327.6800 327.6700 /end CHARACTERISTIC
/begin CHARACTERISTIC AOHt_rHtgOut_Vector "Bypass label for additive bypass of AOHt_rHtgOut" VALUE 0xC38D6 Kw_Wu8 255.0 OneToOne 0.00 255.0 FORMAT "%5.1" /end CHARACTERISTIC
/begin CHARACTERISTIC AOHt_rHtgOut_Channel "Bypass label for additive bypass of AOHt_rHtgOut" VALUE 0xC38D7 Kw_Wu8 255.0 OneToOne 0.00 255.0 FORMAT "%5.1" /end CHARACTERISTIC
/begin CHARACTERISTIC AOHt_rIDef_C "Vorgabewert des I-Anteils im Abschaltfall" VALUE 0xC8A9C Kw_Ws16 100.0000 DtyCyc 0.00 100.0000 FORMAT "%8.4" EXTENDED_LIMITS -327.6800 327.6700 /end CHARACTERISTIC
/begin CHARACTERISTIC AOHt_rNAvrg_CUR "Motordrehzahl Umrechungskennlinie" CURVE 0xC8A9E Kl_Xs16_Ws16 100.0000 DtyCyc 0.00 100.0000 FORMAT "%8.4" EXTENDED_LIMITS -327.6800 327.6700
 /begin AXIS_DESCR STD_AXIS Eng_nAvrg EngN 2 0.00 6000.000 FORMAT "%8.3" EXTENDED_LIMITS -32768.00 32767.00 DEPOSIT ABSOLUTE /end AXIS_DESCR
/end CHARACTERISTIC
/begin CHARACTERISTIC AOHt_stACAccPedXLow_C "Unterer Grenzwert für   APPCD_drAPP1UnFlt-hysterese" VALUE 0xC8AA8 Kw_Ws16 39997.56 PrcPerSec -19998.78 19998.78 FORMAT "%8.2" EXTENDED_LIMITS -20000.00 19999.39 /end CHARACTERISTIC
/begin CHARACTERISTIC AOHt_stACAccPedXHigh_C "Oberer Grenzwert für  APPCD_drAPP1UnFlt-Hysterese" VALUE 0xC8AAA Kw_Ws16 39997.56 PrcPerSec -19998.78 19998.78 FORMAT "%8.2" EXTENDED_LIMITS -20000.00 19999.39 /end CHARACTERISTIC
/begin CHARACTERISTIC AOHt_stACAccPedYLow_C "Ausgangswert der Hysterese für kleine Werte von  APPCD_drAPP1UnFlt (0 oder 1)" VALUE 0xC8AAC Kw_Ws16 1.000000 OneToOne 0.00 1.000000 FORMAT "%8.6" EXTENDED_LIMITS -32768.00 32767.00 /end CHARACTERISTIC
/begin CHARACTERISTIC AOHt_stACAccPedYHigh_C "Ausganswert der Hysterese für große Werte von  APPCD_drAPP1UnFlt (0 oder 1)" VALUE 0xC8AAE Kw_Ws16 1.000000 OneToOne 0.00 1.000000 FORMAT "%8.6" EXTENDED_LIMITS -32768.00 32767.00 /end CHARACTERISTIC
/begin CHARACTERISTIC AOHt_stACEngXLow_C "Unterer Grenzwert für Eng_nAvrg - Hysterese" VALUE 0xC8AB0 Kw_Ws16 20000.00 EngN -10000.00 10000.00 FORMAT "%8.2" EXTENDED_LIMITS -32768.00 32767.00 /end CHARACTERISTIC
/begin CHARACTERISTIC AOHt_stACEngXHigh_C "Oberer Grenzwert für Eng_nAvrg - Hysterese" VALUE 0xC8AB2 Kw_Ws16 20000.00 EngN -10000.00 10000.00 FORMAT "%8.2" EXTENDED_LIMITS -32768.00 32767.00 /end CHARACTERISTIC
/begin CHARACTERISTIC AOHt_stACEngYLow_C "Ausgangswert der Hysterese für kleine Werte von Eng_nAvrg" VALUE 0xC8AB4 Kw_Ws16 1.000000 OneToOne 0.00 1.000000 FORMAT "%8.6" EXTENDED_LIMITS -32768.00 32767.00 /end CHARACTERISTIC
/begin CHARACTERISTIC AOHt_stACEngYHigh_C "Ausgangswert der Hysterese für große Werte von Eng_nAvrg (0 oder 1)" VALUE 0xC8AB6 Kw_Ws16 1.000000 OneToOne 0.00 1.000000 FORMAT "%8.6" EXTENDED_LIMITS -32768.00 32767.00 /end CHARACTERISTIC
/begin CHARACTERISTIC AOHt_stACVehXLow_C "unterer Grenzwert für VSSCD_v - Hysterese" VALUE 0xC8AB8 Kw_Ws16 600.0000 Vel -300.0000 300.0000 FORMAT "%8.4" EXTENDED_LIMITS -327.6800 327.6700 /end CHARACTERISTIC
/begin CHARACTERISTIC AOHt_stACVehXHigh_C "Oberer Grenzwert für VSSCD_v - Hysterese" VALUE 0xC8ABA Kw_Ws16 600.0000 Vel -300.0000 300.0000 FORMAT "%8.4" EXTENDED_LIMITS -327.6800 327.6700 /end CHARACTERISTIC
/begin CHARACTERISTIC AOHt_stACVehYLow_C "Ausgangswert der Hysterese für kleine Werte von VSSCD_v (0 oder 1)" VALUE 0xC8ABC Kw_Ws16 1.000000 OneToOne 0.00 1.000000 FORMAT "%8.6" EXTENDED_LIMITS -32768.00 32767.00 /end CHARACTERISTIC
/begin CHARACTERISTIC AOHt_stACVehYHigh_C "Ausgangswert der Hysterese für große Werte von VSSCD_v (0 oder 1)" VALUE 0xC8ABE Kw_Ws16 1.000000 OneToOne 0.00 1.000000 FORMAT "%8.6" EXTENDED_LIMITS -32768.00 32767.00 /end CHARACTERISTIC
/begin CHARACTERISTIC AOHt_stDAAccPedXLow_C "Unterer Grenzwert für APPCD_rFlt - Hysterese" VALUE 0xC8AC0 Kw_Ws16 100.0000 Prc 0.00 100.0000 FORMAT "%8.4" EXTENDED_LIMITS -400.0000 399.9878 /end CHARACTERISTIC
/begin CHARACTERISTIC AOHt_stDAAccPedXHigh_C "Oberer Grenzwert für APPCD_rFlt - Hysterese" VALUE 0xC8AC2 Kw_Ws16 100.0000 Prc 0.00 100.0000 FORMAT "%8.4" EXTENDED_LIMITS -400.0000 399.9878 /end CHARACTERISTIC
/begin CHARACTERISTIC AOHt_stDAAccPedYLow_C "Ausgangswert der Hysterese für kleine Werte von APPCD_rFlt (0 oder 1)" VALUE 0xC8AC4 Kw_Ws16 1.000000 OneToOne 0.00 1.000000 FORMAT "%8.6" EXTENDED_LIMITS -32768.00 32767.00 /end CHARACTERISTIC
/begin CHARACTERISTIC AOHt_stDAAccPedYHigh_C "Ausgangswert der Hysterese für große Werte von APPCD_rFlt (0 oder 1)" VALUE 0xC8AC6 Kw_Ws16 1.000000 OneToOne 0.00 1.000000 FORMAT "%8.6" EXTENDED_LIMITS -32768.00 32767.00 /end CHARACTERISTIC
/begin CHARACTERISTIC AOHt_stDAEngXLow_C "Unterer Grenzwert für Eng_nAvrg - Hysterese" VALUE 0xC8AC8 Kw_Ws16 20000.00 EngN -10000.00 10000.00 FORMAT "%8.2" EXTENDED_LIMITS -32768.00 32767.00 /end CHARACTERISTIC
/begin CHARACTERISTIC AOHt_stDAEngXHigh_C "Oberer Grenzwert für Eng_nAvrg - Hysterese" VALUE 0xC8ACA Kw_Ws16 20000.00 EngN -10000.00 10000.00 FORMAT "%8.2" EXTENDED_LIMITS -32768.00 32767.00 /end CHARACTERISTIC
/begin CHARACTERISTIC AOHt_stDAEngYLow_C "Ausgangswert der Hysterese für kleine Werte von Eng_nAvrg (0 oder 1)" VALUE 0xC8ACC Kw_Ws16 1.000000 OneToOne 0.00 1.000000 FORMAT "%8.6" EXTENDED_LIMITS -32768.00 32767.00 /end CHARACTERISTIC
/begin CHARACTERISTIC AOHt_stDAEngYHigh_C "Ausgangswert der Hysterese für große Werte von Eng_nAvrg (0 oder 1)" VALUE 0xC8ACE Kw_Ws16 1.000000 OneToOne 0.00 1.000000 FORMAT "%8.6" EXTENDED_LIMITS -32768.00 32767.00 /end CHARACTERISTIC
/begin CHARACTERISTIC AOHt_stDAGearXLow_C "Unterer Grenzwert für Gearbx_stGear - Hysterese" VALUE 0xC8AD0 Kw_Ws16 7.000000 OneToOne -1.000000 6.000000 FORMAT "%8.6" EXTENDED_LIMITS -32768.00 32767.00 /end CHARACTERISTIC
/begin CHARACTERISTIC AOHt_stDAGearXHigh_C "Oberer Grenzwert für Gearbx_stGear - Hysterese" VALUE 0xC8AD2 Kw_Ws16 7.000000 OneToOne -1.000000 6.000000 FORMAT "%8.6" EXTENDED_LIMITS -32768.00 32767.00 /end CHARACTERISTIC
/begin CHARACTERISTIC AOHt_stDAGearYLow_C "Ausgangswert der Hysterese für kleine Werte von Gearbx_stGear (0 oder 1)" VALUE 0xC8AD4 Kw_Ws16 1.000000 OneToOne 0.00 1.000000 FORMAT "%8.6" EXTENDED_LIMITS -32768.00 32767.00 /end CHARACTERISTIC
/begin CHARACTERISTIC AOHt_stDAGearYHigh_C "Ausgangswert der Hysterese für große Werte von Gearbx_stGear (0 oder 1)" VALUE 0xC8AD6 Kw_Ws16 1.000000 OneToOne 0.00 1.000000 FORMAT "%8.6" EXTENDED_LIMITS -32768.00 32767.00 /end CHARACTERISTIC
/begin CHARACTERISTIC AOHt_stDAVehXLow_C "Unterer Grenzwert für VSSCD_v - Hysterese" VALUE 0xC8AD8 Kw_Ws16 600.0000 Vel -300.0000 300.0000 FORMAT "%8.4" EXTENDED_LIMITS -327.6800 327.6700 /end CHARACTERISTIC
/begin CHARACTERISTIC AOHt_stDAVehXHigh_C "Oberer Grenzwert für VSSCD_v - Hysterese" VALUE 0xC8ADA Kw_Ws16 600.0000 Vel -300.0000 300.0000 FORMAT "%8.4" EXTENDED_LIMITS -327.6800 327.6700 /end CHARACTERISTIC
/begin CHARACTERISTIC AOHt_stDAVehYLow_C "Ausgang der Hysterese für kleine Werte von VSSCD_v (0 oder 1)" VALUE 0xC8ADC Kw_Ws16 1.000000 OneToOne 0.00 1.000000 FORMAT "%8.6" EXTENDED_LIMITS -32768.00 32767.00 /end CHARACTERISTIC
/begin CHARACTERISTIC AOHt_stDAVehYHigh_C "Ausgangswert der Hysterese für große Werte von VSSCD_v (0 oder 1)" VALUE 0xC8ADE Kw_Ws16 1.000000 OneToOne 0.00 1.000000 FORMAT "%8.6" EXTENDED_LIMITS -32768.00 32767.00 /end CHARACTERISTIC
/begin CHARACTERISTIC AOHt_swtHtgActive_C "Schalter zum aktivieren/deaktivieren des Zuheizers (1: Zuheizer aktiv, 0: Zuheizer inaktiv)" VALUE 0xC8AE0 Kw_Wu8 1.000 OneToOne 0.00 1.000 FORMAT "%5.3" EXTENDED_LIMITS 0.00 255.0 /end CHARACTERISTIC
/begin CHARACTERISTIC AOHt_tEnvHysDelta_C "Delta-Wert für Kühlmitteltemperaturhysterese" VALUE 0xC8AE2 Kw_Ws16 100.0000 TempDiff_Cels 0.00 100.0000 FORMAT "%8.4" EXTENDED_LIMITS -3276.800 3276.700 /end CHARACTERISTIC
/begin CHARACTERISTIC AOHt_tEnv_CUR "Umgebungstemperatur Umrechnungskennlinie" CURVE 0xC8AE4 Kl_Xs16_Ws16 250.0000 Temp_Cels -50.1400 199.8600 FORMAT "%8.4" EXTENDED_LIMITS -3549.940 3003.560
 /begin AXIS_DESCR STD_AXIS IATSCD_tAir Temp_Cels 4 -50.1400 199.8600 FORMAT "%8.4" EXTENDED_LIMITS -3549.940 3003.560 DEPOSIT ABSOLUTE /end AXIS_DESCR
/end CHARACTERISTIC
/begin CHARACTERISTIC AOHt_tiACMin_C "Timer für den Beschleunigungs-Fall" VALUE 0xC8AF6 Kw_Wu16 60000.00 Time_ms 0.00 60000.00 FORMAT "%8.2" EXTENDED_LIMITS 0.00 655350.0 /end CHARACTERISTIC
/begin CHARACTERISTIC AOHt_tiAltPT1_C "PT1 Zeitkonstante für die Generatorlastfilterung" VALUE 0xC8AF8 Kw_Wu32 4294.9673 TimeDelay_s 0.0000010000000 4294.9673 FORMAT "%9.4" /end CHARACTERISTIC
/begin CHARACTERISTIC AOHt_tiDAMin_C "Timer im Wegfahr-Fall" VALUE 0xC8AFC Kw_Wu16 60000.00 Time_ms 0.00 60000.00 FORMAT "%8.2" EXTENDED_LIMITS 0.00 655350.0 /end CHARACTERISTIC
/begin CHARACTERISTIC AOHt_tiNAvrgPT1_C "PT1 Zeitkonstante für Motordrehzahlfilterung" VALUE 0xC8B00 Kw_Wu32 4294.9673 TimeDelay_s 0.0000010000000 4294.9673 FORMAT "%9.4" /end CHARACTERISTIC
/begin CHARACTERISTIC AOHt_tiStrt_C "Startverzoegerung fuer die Heizleistungssteigerung" VALUE 0xC8B04 Kw_Wu16 2000.000 Time_ms 0.00 2000.000 FORMAT "%8.3" EXTENDED_LIMITS 0.00 655350.0 /end CHARACTERISTIC
/begin CHARACTERISTIC AOHt_uBattHysMin_C "untere Hysterese-Schwelle für zu niedrige Batteriespannung" VALUE 0xC8B06 Kw_Ws16 28602.15 Volt_Batt 0.00 28602.15 FORMAT "%8.2" EXTENDED_LIMITS -640625.6 640606.1 /end CHARACTERISTIC
/begin CHARACTERISTIC AOHt_uBattHysMax_C "obere Hysterese-Schwelle für zu niedrige Batteriespannung" VALUE 0xC8B08 Kw_Ws16 28602.15 Volt_Batt 0.00 28602.15 FORMAT "%8.2" EXTENDED_LIMITS -640625.6 640606.1 /end CHARACTERISTIC
/begin CHARACTERISTIC AOHt_stBattShutOffEn_C "Abschaltbedingung erfuellt" VALUE 0xC8B0A Kw_Ws16 65535.00 OneToOne -32768.00 32767.00 FORMAT "%8.2" READ_ONLY /end CHARACTERISTIC
/begin CHARACTERISTIC AOHt_stBattShutOffDis_C "Abschaltbedingung nicht erfuellt" VALUE 0xC8B0C Kw_Ws16 65535.00 OneToOne -32768.00 32767.00 FORMAT "%8.2" READ_ONLY /end CHARACTERISTIC
/begin CHARACTERISTIC APPCD_uAPP1_SRCMin_C "Spannung SRC-low" VALUE 0xC8B58 Kw_Ws16 5200.391 Volt 0.00 5200.391 FORMAT "%8.3" EXTENDED_LIMITS -160156.4 160151.5 /end CHARACTERISTIC
/begin CHARACTERISTIC APPCD_uAPP1_SRCMax_C "Spannung SRC-high" VALUE 0xC8B5A Kw_Ws16 5200.391 Volt 0.00 5200.391 FORMAT "%8.3" EXTENDED_LIMITS -160156.4 160151.5 /end CHARACTERISTIC
/begin CHARACTERISTIC APPCD_uAPP2_SRCMin_C "Spannung SRC-low" VALUE 0xC8B5C Kw_Ws16 5200.391 Volt 0.00 5200.391 FORMAT "%8.3" EXTENDED_LIMITS -160156.4 160151.5 /end CHARACTERISTIC
/begin CHARACTERISTIC APPCD_uAPP2_SRCMax_C "Spannung SRC-high" VALUE 0xC8B5E Kw_Ws16 5200.391 Volt 0.00 5200.391 FORMAT "%8.3" EXTENDED_LIMITS -160156.4 160151.5 /end CHARACTERISTIC
/begin CHARACTERISTIC APPCD_DebSRCHighDef_C "Defektzeit SRC-high" VALUE 0xC8B60 Kw_Wu16 655350.0 Time_ms 0.00 655350.0 FORMAT "%8.1" /end CHARACTERISTIC
/begin CHARACTERISTIC APPCD_DebSRCHighOk_C "Heilungszeit SRC-high" VALUE 0xC8B62 Kw_Wu16 655350.0 Time_ms 0.00 655350.0 FORMAT "%8.1" /end CHARACTERISTIC
/begin CHARACTERISTIC APPCD_DebSRCLowDef_C "Defektzeit SRC-low" VALUE 0xC8B64 Kw_Wu16 655350.0 Time_ms 0.00 655350.0 FORMAT "%8.1" /end CHARACTERISTIC
/begin CHARACTERISTIC APPCD_DebSRCLowOk_C "Heilungszeit SRC-low" VALUE 0xC8B66 Kw_Wu16 655350.0 Time_ms 0.00 655350.0 FORMAT "%8.1" /end CHARACTERISTIC
/begin CHARACTERISTIC APPCD_DebSyncDef_C "Entprellzeit Gleichlauffehler APP1/APP2" VALUE 0xC8B68 Kw_Wu16 655350.0 Time_ms 0.00 655350.0 FORMAT "%8.1" /end CHARACTERISTIC
/begin CHARACTERISTIC APPCD_DebSyncOk_C "Heilzeit Gleichlauffehler APP1/APP2" VALUE 0xC8B6A Kw_Wu16 655350.0 Time_ms 0.00 655350.0 FORMAT "%8.1" /end CHARACTERISTIC
/begin CHARACTERISTIC APPCD_duAPPJit_C "Groesse des Jitters der APP-Rohspannung der unterdrueckt wird" VALUE 0xC8B6C Kw_Ws16 5200.391 Volt 0.00 5200.391 FORMAT "%8.3" EXTENDED_LIMITS -160156.4 160151.5 /end CHARACTERISTIC
/begin CHARACTERISTIC APPCD_facrAPP1APP2_C "Faktor zwischen den Rohspannungen APP1/APP2" VALUE 0xC8B6E Kw_Ws16 7.999878 Fact -4.000000 3.999878 FORMAT "%8.6" /end CHARACTERISTIC
/begin CHARACTERISTIC APPCD_rThrFltFDCLowPos_C "upper threshold for filter parameter ""low_pos""" VALUE 0xC8B70 Kw_Ws16 100.0000 Prc 0.00 100.0000 FORMAT "%8.4" EXTENDED_LIMITS -400.0000 399.9878 /end CHARACTERISTIC
/begin CHARACTERISTIC APPCD_rThrFltFDCMidPos_C "upper threshold for filter parameter ""mid_neg""" VALUE 0xC8B72 Kw_Ws16 100.0000 Prc 0.00 100.0000 FORMAT "%8.4" EXTENDED_LIMITS -400.0000 399.9878 /end CHARACTERISTIC
/begin CHARACTERISTIC APPCD_rThrFltFDCLowNeg_C "upper threshold for filter parameter ""low_neg""" VALUE 0xC8B74 Kw_Ws16 100.0000 Prc 0.00 100.0000 FORMAT "%8.4" EXTENDED_LIMITS -400.0000 399.9878 /end CHARACTERISTIC
/begin CHARACTERISTIC APPCD_rThrFltFDCMidNeg_C "upper threshold for filter parameter ""mid_neg""" VALUE 0xC8B76 Kw_Ws16 100.0000 Prc 0.00 100.0000 FORMAT "%8.4" EXTENDED_LIMITS -400.0000 399.9878 /end CHARACTERISTIC
/begin CHARACTERISTIC APPCD_tiLowNegFDCPT1_C "APP filter time constant neg. slope low range" VALUE 0xC8B78 Kw_Wu32 4294.9673 TimeDelay_s 0.0000010000000 4294.9673 FORMAT "%9.4" /end CHARACTERISTIC
/begin CHARACTERISTIC APPCD_tiLowNegPT1_C "Filterzeit low position, neg. Steig" VALUE 0xC8B7C Kw_Wu32 4294.9673 TimeDelay_s 0.0000010000000 4294.9673 FORMAT "%9.4" /end CHARACTERISTIC
/begin CHARACTERISTIC APPCD_tiLowPosFDCPT1_C "APP filter time constant pos. slope low range" VALUE 0xC8B80 Kw_Wu32 4294.9673 TimeDelay_s 0.0000010000000 4294.9673 FORMAT "%9.4" /end CHARACTERISTIC
/begin CHARACTERISTIC APPCD_tiLowPosPT1_C "Filterzeit low position, pos. Steig." VALUE 0xC8B84 Kw_Wu32 4294.9673 TimeDelay_s 0.0000010000000 4294.9673 FORMAT "%9.4" /end CHARACTERISTIC
/begin CHARACTERISTIC APPCD_tiMidNegFDCPT1_C "APP filter time constant neg. slope mid. range" VALUE 0xC8B88 Kw_Wu32 4294.9673 TimeDelay_s 0.0000010000000 4294.9673 FORMAT "%9.4" /end CHARACTERISTIC
/begin CHARACTERISTIC APPCD_tiMidNegPT1_C "Filterzeit mid. position, neg. Steig." VALUE 0xC8B8C Kw_Wu32 4294.9673 TimeDelay_s 0.0000010000000 4294.9673 FORMAT "%9.4" /end CHARACTERISTIC
/begin CHARACTERISTIC APPCD_tiMidPosFDCPT1_C "APP filter time constant pos. slope mid. range" VALUE 0xC8B90 Kw_Wu32 4294.9673 TimeDelay_s 0.0000010000000 4294.9673 FORMAT "%9.4" /end CHARACTERISTIC
/begin CHARACTERISTIC APPCD_tiMidPosPT1_C "Filterzeit mid. position, pos. Steig." VALUE 0xC8B94 Kw_Wu32 4294.9673 TimeDelay_s 0.0000010000000 4294.9673 FORMAT "%9.4" /end CHARACTERISTIC
/begin CHARACTERISTIC APPCD_tiUppNegFDCPT1_C "APP filter time constant neg. slope upp. range" VALUE 0xC8B98 Kw_Wu32 4294.9673 TimeDelay_s 0.0000010000000 4294.9673 FORMAT "%9.4" /end CHARACTERISTIC
/begin CHARACTERISTIC APPCD_tiUppNegPT1_C "Filterzeit upper position, neg. Steig." VALUE 0xC8B9C Kw_Wu32 4294.9673 TimeDelay_s 0.0000010000000 4294.9673 FORMAT "%9.4" /end CHARACTERISTIC
/begin CHARACTERISTIC APPCD_tiUppPosFDCPT1_C "APP filter time constant pos. slope upp. range" VALUE 0xC8BA0 Kw_Wu32 4294.9673 TimeDelay_s 0.0000010000000 4294.9673 FORMAT "%9.4" /end CHARACTERISTIC
/begin CHARACTERISTIC APPCD_tiUppPosPT1_C "Filterzeit upper position, pos. Steig.:" VALUE 0xC8BA4 Kw_Wu32 4294.9673 TimeDelay_s 0.0000010000000 4294.9673 FORMAT "%9.4" /end CHARACTERISTIC
/begin CHARACTERISTIC APPCD_swtNoFlt_C "Schalter für Filter AUS bei betätigter Kupplung (0 = Filter ein bei betätigter Kupplung, 1 = Filter aus bei betätigter Kupplung)" VALUE 0xC8BA8 Kw_Wu8 1.000 OneToOne 0.00 1.000 FORMAT "%5.3" EXTENDED_LIMITS 0.00 255.0 /end CHARACTERISTIC
/begin CHARACTERISTIC APPCD_rThrFltLowPos_C "Schwelle Filterzeit low position, pos. Steig." VALUE 0xC8BAA Kw_Ws16 100.0000 Prc 0.00 100.0000 FORMAT "%8.4" EXTENDED_LIMITS -400.0000 399.9878 /end CHARACTERISTIC
/begin CHARACTERISTIC APPCD_rThrFltMidPos_C "APPSchwelle Filterzeit mid. position, pos. Steig." VALUE 0xC8BAC Kw_Ws16 100.0000 Prc 0.00 100.0000 FORMAT "%8.4" EXTENDED_LIMITS -400.0000 399.9878 /end CHARACTERISTIC
/begin CHARACTERISTIC APPCD_rThrFltLowNeg_C "Schwelle Filterzeit low position, neg. Steig." VALUE 0xC8BAE Kw_Ws16 100.0000 Prc 0.00 100.0000 FORMAT "%8.4" EXTENDED_LIMITS -400.0000 399.9878 /end CHARACTERISTIC
/begin CHARACTERISTIC APPCD_rThrFltMidNeg_C "Schwelle Filterzeit mid position, neg. Steig." VALUE 0xC8BB0 Kw_Ws16 100.0000 Prc 0.00 100.0000 FORMAT "%8.4" EXTENDED_LIMITS -400.0000 399.9878 /end CHARACTERISTIC
/begin CHARACTERISTIC APPCD_numAdcAPP1_C "Applikationsparameter  fuer den Fahrpedal 1 position -Fuehler" VALUE 0xC8BB2 Kw_Wu8 60.0000000000 NumPinAdc 0.00 60.0000000000 FORMAT "%13.10" /end CHARACTERISTIC
/begin CHARACTERISTIC APPCD_numAdcAPP2_C "Applikationsparameter  fuer den Fahrpedal 2 position -Fuehler" VALUE 0xC8BB3 Kw_Wu8 60.0000000000 NumPinAdc 0.00 60.0000000000 FORMAT "%13.10" /end CHARACTERISTIC
/begin CHARACTERISTIC APPCD_duLimErrPos_C "Rampensteigung der Rohspannung PWG" VALUE 0xC8BB4 Kw_Wu32 320312805.400 RmpVolt 0.00 320312805.400 FORMAT "%13.3" /end CHARACTERISTIC
/begin CHARACTERISTIC APPCD_duLimErrNeg_C "Rampensteigung der Rohspannung PWG" VALUE 0xC8BB8 Kw_Wu32 320312805.400 RmpVolt 0.00 320312805.400 FORMAT "%13.3" /end CHARACTERISTIC
/begin CHARACTERISTIC APPCD_rLinAPP_CUR "Linearisierungskennline für APP" CURVE 0xC8BBC Kl_Xs16_Ws16 100.0000 Prc 0.00 100.0000 FORMAT "%8.4" EXTENDED_LIMITS -400.0000 399.9878
 /begin AXIS_DESCR STD_AXIS APPCD_uRaw_mp Volt 2 0.00 5200.391 FORMAT "%8.3" EXTENDED_LIMITS -160156.4 160151.5 DEPOSIT ABSOLUTE /end AXIS_DESCR
/end CHARACTERISTIC
/begin CHARACTERISTIC APPCD_SSpMonAPP1_C "Auswahl der Sensor-Versorgungs-Spannung für APP1" VALUE 0xC8BC6 Kw_Wu8 2.000 OneToOne 1.000 3.000 FORMAT "%5.3" EXTENDED_LIMITS 0.00 255.0 /end CHARACTERISTIC
/begin CHARACTERISTIC APPCD_SSpMonAPP2_C "Auswahl der Sensor-Versorgungs-Spannung für APP2" VALUE 0xC8BC7 Kw_Wu8 2.000 OneToOne 1.000 3.000 FORMAT "%5.3" EXTENDED_LIMITS 0.00 255.0 /end CHARACTERISTIC
/begin CHARACTERISTIC APPCD_swtEnaUnJit_C "Schalter zur Aktivierung der Entjitterung (1: Entjitterung aktiviert, Entjitterung deaktiviert)" VALUE 0xC8BC8 Kw_Wu8 1.000 OneToOne 0.00 1.000 FORMAT "%5.3" EXTENDED_LIMITS 0.00 255.0 /end CHARACTERISTIC
/begin CHARACTERISTIC APPCD_swtStepLim_C "Schalter um die Schrittbegrentzungsfunktion zu aktivieren (1: aktieviert, 0: deaktiviert)" VALUE 0xC8BC9 Kw_Wu8 1.000 OneToOne 0.00 1.000 FORMAT "%5.3" EXTENDED_LIMITS 0.00 255.0 /end CHARACTERISTIC
/begin CHARACTERISTIC APPCD_uAPPMin_C "Ersatzwert für APP-Rohspannung bei Defekt beider Geber" VALUE 0xC8BCA Kw_Ws16 5200.391 Volt 0.00 5200.391 FORMAT "%8.3" EXTENDED_LIMITS -160156.4 160151.5 /end CHARACTERISTIC
/begin CHARACTERISTIC APPCD_uKickDownHighAPP_C "obere Hys.-Kick-Down-Spg.-Schwelle für APP" VALUE 0xC8BCC Kw_Ws16 5200.391 Volt 0.00 5200.391 FORMAT "%8.3" EXTENDED_LIMITS -160156.4 160151.5 /end CHARACTERISTIC
/begin CHARACTERISTIC APPCD_uKickDownLowAPP_C "untere Hys.-Kick-Down-Spg.-Schwelle für APP" VALUE 0xC8BCE Kw_Ws16 5200.391 Volt 0.00 5200.391 FORMAT "%8.3" EXTENDED_LIMITS -160156.4 160151.5 /end CHARACTERISTIC
/begin CHARACTERISTIC APPCD_uMinSync_C "Minimale Rohspannung zur Freigabe der Gleichlaufprüfung" VALUE 0xC8BD0 Kw_Ws16 5200.391 Volt 0.00 5200.391 FORMAT "%8.3" EXTENDED_LIMITS -160156.4 160151.5 /end CHARACTERISTIC
/begin CHARACTERISTIC APPCD_uRawAPP2dOff_C "Offset für APP2-Rohspannung" VALUE 0xC8BD2 Kw_Ws16 498.5337 Volt 0.00 498.5337 FORMAT "%8.4" EXTENDED_LIMITS -160156.4 160151.5 /end CHARACTERISTIC
/begin CHARACTERISTIC APPCD_uSync_CUR "Kennlinie zur Bestimmung der maximal zulaessigen Abweichung APP1/APP2" CURVE 0xC8BD4 Kl_Xs16_Ws16 5200.391 Volt 0.00 5200.391 FORMAT "%8.3" EXTENDED_LIMITS -160156.4 160151.5
 /begin AXIS_DESCR STD_AXIS APPCD_uRawAPP1 Volt 2 0.00 5200.391 FORMAT "%8.3" EXTENDED_LIMITS -160156.4 160151.5 DEPOSIT ABSOLUTE /end AXIS_DESCR
/end CHARACTERISTIC
/begin CHARACTERISTIC APSCD_uSRCMin_C "Atmosphaerendruckfuehler SRC-Min Fehlerschwelle" VALUE 0xC8BE0 Kw_Ws16 5200.391 Volt 0.00 5200.391 FORMAT "%8.3" EXTENDED_LIMITS -160156.4 160151.5 /end CHARACTERISTIC
/begin CHARACTERISTIC APSCD_uSRCMax_C "Atmosphaerendruckfuehler SRC-Max Fehlerschwelle" VALUE 0xC8BE2 Kw_Ws16 5200.391 Volt 0.00 5200.391 FORMAT "%8.3" EXTENDED_LIMITS -160156.4 160151.5 /end CHARACTERISTIC
/begin CHARACTERISTIC APSCD_pLin_CUR "Atmosphaerendruck Liniarisierungskennlinie" CURVE 0xC8BE4 Kl_Xs16_Ws16 3500.000 Pres_hPa 0.00 3500.000 FORMAT "%8.3" EXTENDED_LIMITS -32768.00 32767.00
 /begin AXIS_DESCR STD_AXIS APSCD_uRaw Volt 2 0.00 5000.000 FORMAT "%8.3" EXTENDED_LIMITS -160156.4 160151.5 DEPOSIT ABSOLUTE /end AXIS_DESCR
/end CHARACTERISTIC
/begin CHARACTERISTIC APSCD_DebNplDef_C "Defektentprellung zur Plausibilitaetsfehler Erkennung ( zur Zeit nicht applizierbar )" VALUE 0xC8BEE Kw_Wu16 65535.00 OneToOne 0.00 65535.00 FORMAT "%8.2" /end CHARACTERISTIC
/begin CHARACTERISTIC APSCD_DebNplOk_C "Heilungsentprellung fuer Plausibilitaetsfehler ( zur Zeit nicht applizierbar )" VALUE 0xC8BF0 Kw_Wu16 65535.00 OneToOne 0.00 65535.00 FORMAT "%8.2" /end CHARACTERISTIC
/begin CHARACTERISTIC APSCD_DebSigDef_C "Entprellzeit defekt für ungültiges CAN-Signal für Atmosphärendruck" VALUE 0xC8BF2 Kw_Wu16 655350.0 Time_ms 0.00 655350.0 FORMAT "%8.1" /end CHARACTERISTIC
/begin CHARACTERISTIC APSCD_DebSigOk_C "Heilungsentprellzeit für ungültiges CAN-Signal Atmosphärendruck" VALUE 0xC8BF4 Kw_Wu16 655350.0 Time_ms 0.00 655350.0 FORMAT "%8.1" /end CHARACTERISTIC
/begin CHARACTERISTIC APSCD_DebSRCDef_C "Entprellzeit fuer SRC Defektzeit" VALUE 0xC8BF6 Kw_Wu16 655350.0 Time_ms 0.00 655350.0 FORMAT "%8.1" /end CHARACTERISTIC
/begin CHARACTERISTIC APSCD_DebSRCOk_C "Entprellzeit fuer SRC-Heilzeit" VALUE 0xC8BF8 Kw_Wu16 655350.0 Time_ms 0.00 655350.0 FORMAT "%8.1" /end CHARACTERISTIC
/begin CHARACTERISTIC APSCD_nLimHigh_C "obere Drehzahlgrenze zur Berechnung des Luftdrucks aus dem Ladedruck" VALUE 0xC8BFA Kw_Ws16 6000.000 EngN 0.00 6000.000 FORMAT "%8.3" EXTENDED_LIMITS -32768.00 32767.00 /end CHARACTERISTIC
/begin CHARACTERISTIC APSCD_numAdc_C "Applikationsparameter fuer Atmosphaerdruck-Fuehler" VALUE 0xC8BFC Kw_Wu8 60.0000000000 NumPinAdc 0.00 60.0000000000 FORMAT "%13.10" /end CHARACTERISTIC
/begin CHARACTERISTIC APSCD_pCor_MAP "Atmosphaerendruck Korrekturkennfeld (Drehzahlabhaengig)" MAP 0xC8BFE Kf_Xs16_Ys16_Ws16 3850.000 Pres_hPa -350.0000 3500.000 FORMAT "%8.3" EXTENDED_LIMITS -32768.00 32767.00
 /begin AXIS_DESCR STD_AXIS Eng_nAvrg EngN 1 0.00 6000.000 FORMAT "%8.3" EXTENDED_LIMITS -32768.00 32767.00 DEPOSIT ABSOLUTE /end AXIS_DESCR
 /begin AXIS_DESCR STD_AXIS Eng_dnAvrg Eng_dN 1 -6000.000 6000.000 FORMAT "%8.3" EXTENDED_LIMITS -32768.00 32767.00 DEPOSIT ABSOLUTE /end AXIS_DESCR
/end CHARACTERISTIC
/begin CHARACTERISTIC APSCD_dpRmpSlpUp_C "positive Atmosphaerendruck - Rampensteigung" VALUE 0xC8C08 Kw_Wu32 65535949.9817 RmpPres_hPa 50.0030517578 65535999.9847 FORMAT "%13.4" EXTENDED_LIMITS 0.00 65535999.9847 /end CHARACTERISTIC
/begin CHARACTERISTIC APSCD_dpRmpSlpDwn_C "negative Atmosphaerendruck - Rampensteigung" VALUE 0xC8C0C Kw_Wu32 65535949.9817 RmpPres_hPa 50.0030517578 65535999.9847 FORMAT "%13.4" EXTENDED_LIMITS 0.00 65535999.9847 /end CHARACTERISTIC
/begin CHARACTERISTIC APSCD_swtInst_C "Atmosphaerendruck Funktionsschalter (1: verbaut, 0: nicht verbaut)" VALUE 0xC8C10 Kw_Wu8 1.000 OneToOne 0.00 1.000 FORMAT "%5.3" EXTENDED_LIMITS 0.00 255.0 /end CHARACTERISTIC
/begin CHARACTERISTIC APSCD_swtSigVal_C "Schalter zur Umschaltung der Signalquelle ADC/CAN (0 = ADC, 1 = CAN)" VALUE 0xC8C11 Kw_Wu8 1.000 OneToOne 0.00 1.000 FORMAT "%5.3" EXTENDED_LIMITS 0.00 255.0 /end CHARACTERISTIC
/begin CHARACTERISTIC APSCD_swtSrcpVal_C "Schalter ob APSCD_pVal aus Ladedruck berechnet wird (1) oder nicht (0)" VALUE 0xC8C12 Kw_Wu8 1.000 OneToOne 0.00 1.000 FORMAT "%5.3" EXTENDED_LIMITS 0.00 255.0 /end CHARACTERISTIC
/begin CHARACTERISTIC APSCD_tiDel_C "Atmosphaerendruck Verzögerungszeit bis Berechnung von Ladedruck beginnt" VALUE 0xC8C14 Kw_Wu16 655350.0 Time_ms 0.00 655350.0 FORMAT "%8.1" /end CHARACTERISTIC
/begin CHARACTERISTIC APSCD_stSensIDWord_C "Atmosphaerendruck Geberkennwort" VALUE 0xC8C16 Kw_Wu16 65535.00 OneToOne 0.00 65535.00 FORMAT "%8.2" /end CHARACTERISTIC
/begin CHARACTERISTIC APSCD_pDfl_C "Atmosphaerendruck Vorgabewert" VALUE 0xC8C18 Kw_Ws16 3500.000 Pres_hPa 0.00 3500.000 FORMAT "%8.3" EXTENDED_LIMITS -32768.00 32767.00 /end CHARACTERISTIC
/begin CHARACTERISTIC ARS_tiDebSigDef_C "Defect time for declaring an error" VALUE 0xC8C1C Kw_Wu16 655350.0 Time_ms 0.00 655350.0 FORMAT "%8.1" /end CHARACTERISTIC
/begin CHARACTERISTIC ARS_tiDebSigOk_C "Time for declaring an error healed" VALUE 0xC8C1E Kw_Wu16 655350.0 Time_ms 0.00 655350.0 FORMAT "%8.1" /end CHARACTERISTIC
/begin CHARACTERISTIC ARS_facDesCor_C "Correction factor for torque correction over setpoint torque" VALUE 0xC8C20 Kw_Ws16 20.00000 Fact1 0.00 20.00000 FORMAT "%8.5" EXTENDED_LIMITS -256.0000 255.9922 /end CHARACTERISTIC
/begin CHARACTERISTIC ARS_facDesOldCor_C "Correction factor for the torque correction over setpoint torque change" VALUE 0xC8C22 Kw_Ws16 20.00000 Fact1 0.00 20.00000 FORMAT "%8.5" EXTENDED_LIMITS -256.0000 255.9922 /end CHARACTERISTIC
/begin CHARACTERISTIC ARS_nDia_C "Engine speed threshold for detecting diagnostic operation" VALUE 0xC8C24 Kw_Ws16 4950.000 EngN 50.00000 5000.000 FORMAT "%8.3" EXTENDED_LIMITS -32768.00 32767.00 /end CHARACTERISTIC
/begin CHARACTERISTIC ARS_rTrans_C "Translation ratio of ARS" VALUE 0xC8C26 Kw_Ws16 200.0000 TransR 0.00 200.0000 FORMAT "%8.4" EXTENDED_LIMITS -327.6800 327.6700 /end CHARACTERISTIC
/begin CHARACTERISTIC ARS_trqCurMax_MAP "Maximum actual torque for plausability monitoring" MAP 0xC8C28 Kf_Xs16_Ys16_Ws16 900.0000 Trq 100.0000 1000.000 FORMAT "%8.3" EXTENDED_LIMITS -3276.800 3276.700
 /begin AXIS_DESCR STD_AXIS VSSCD_v Vel 8 0.00 300.0000 FORMAT "%8.4" EXTENDED_LIMITS -327.6800 327.6700 DEPOSIT ABSOLUTE /end AXIS_DESCR
 /begin AXIS_DESCR STD_AXIS FrmMng_aSide Acc 8 0.00 10.00000 FORMAT "%8.5" EXTENDED_LIMITS -32.76800 32.76700 DEPOSIT ABSOLUTE /end AXIS_DESCR
/end CHARACTERISTIC
/begin CHARACTERISTIC ARS_trqDesMax_MAP "Maximum setpoint torque for plausibility monitoring" MAP 0xC8CCC Kf_Xs16_Ys16_Ws16 900.0000 Trq 100.0000 1000.000 FORMAT "%8.3" EXTENDED_LIMITS -3276.800 3276.700
 /begin AXIS_DESCR STD_AXIS VSSCD_v Vel 8 0.00 300.0000 FORMAT "%8.4" EXTENDED_LIMITS -327.6800 327.6700 DEPOSIT ABSOLUTE /end AXIS_DESCR
 /begin AXIS_DESCR STD_AXIS FrmMng_aSide Acc 8 0.00 10.00000 FORMAT "%8.5" EXTENDED_LIMITS -32.76800 32.76700 DEPOSIT ABSOLUTE /end AXIS_DESCR
/end CHARACTERISTIC
/begin CHARACTERISTIC ARS_trqDiaMaxOfs_C "Diagnostic offset of the maximum value limits" VALUE 0xC8D70 Kw_Ws16 200.0000 Trq -100.0000 100.0000 FORMAT "%8.4" EXTENDED_LIMITS -3276.800 3276.700 /end CHARACTERISTIC
/begin CHARACTERISTIC ARS_trqDiaMax_C "Limitation of maximum values on diagnostics" VALUE 0xC8D72 Kw_Ws16 200.0000 Trq -100.0000 100.0000 FORMAT "%8.4" EXTENDED_LIMITS -3276.800 3276.700 /end CHARACTERISTIC
/begin CHARACTERISTIC ARS_vDia_C "Speed threshold for detection of diagnostic operation" VALUE 0xC8D74 Kw_Ws16 300.0000 Vel 0.00 300.0000 FORMAT "%8.4" EXTENDED_LIMITS -327.6800 327.6700 /end CHARACTERISTIC
/begin CHARACTERISTIC ASDdc_T1Clu_C "ARD Störungsregler T1, ausgekuppelt" VALUE 0xC8D78 Kw_Wr32 1.50000000 ASD_GvrnDT1T1_float 0.00 1.50000000 FORMAT "%10.8" EXTENDED_LIMITS -1.00000000E+37 1.00000000E+37 /end CHARACTERISTIC
/begin CHARACTERISTIC ASDdc_KdClu_C "ARD Störungsregler Kd=sqrt(Td)/T1, ausgekuppelt" VALUE 0xC8D7C Kw_Wr32 5.00000000 ASD_GvrnDT1Kd_float 0.00 5.00000000 FORMAT "%10.8" EXTENDED_LIMITS -1.00000000E+37 1.00000000E+37 /end CHARACTERISTIC
/begin CHARACTERISTIC ASDdc_T1ExtInt_C "ARD Störungsregler T1, externer Eingriff" VALUE 0xC8D80 Kw_Wr32 1.50000000 ASD_GvrnDT1T1_float 0.00 1.50000000 FORMAT "%10.8" EXTENDED_LIMITS -1.00000000E+37 1.00000000E+37 /end CHARACTERISTIC
/begin CHARACTERISTIC ASDdc_KdExtInt_C "ARD Störungsregler Kd=sqrt(Td)/T1, externer Eingriff" VALUE 0xC8D84 Kw_Wr32 5.00000000 ASD_GvrnDT1Kd_float 0.00 5.00000000 FORMAT "%10.8" EXTENDED_LIMITS -1.00000000E+37 1.00000000E+37 /end CHARACTERISTIC
/begin CHARACTERISTIC ASDdc_KdGrip_MAP "Zeitkonstante Kd des ARD-SR (ASDdc) für den Zustand Kraftschluss" MAP 0xC8D88 Kf_Xs16_Ys16_Ws16 1.500000 Kd16_sqr_rpm2Nm 0.00 1.500000 FORMAT "%8.6" EXTENDED_LIMITS -32.00000 31.99902
 /begin AXIS_DESCR STD_AXIS DrvTrn_rTransDT TransR 6 0.00 100.0000 FORMAT "%8.4" EXTENDED_LIMITS -327.6800 327.6700 DEPOSIT ABSOLUTE /end AXIS_DESCR
 /begin AXIS_DESCR STD_AXIS ASDdc_nAvrg_mp EngN 5 -32768.00 32767.00 FORMAT "%8.2" DEPOSIT ABSOLUTE /end AXIS_DESCR
/end CHARACTERISTIC
/begin CHARACTERISTIC ASDdc_KdSlip_MAP "Map for r, n dependent gain for ASDdc" MAP 0xC8E6C Kf_Xs16_Ys16_Ws16 1.500000 Kd16_sqr_rpm2Nm 0.00 1.500000 FORMAT "%8.6" EXTENDED_LIMITS -32.00000 31.99902
 /begin AXIS_DESCR STD_AXIS DrvTrn_rTransDT TransR 6 0.00 100.0000 FORMAT "%8.4" EXTENDED_LIMITS -327.6800 327.6700 DEPOSIT ABSOLUTE /end AXIS_DESCR
 /begin AXIS_DESCR STD_AXIS ASDdc_nAvrg_mp EngN 5 -32768.00 32767.00 FORMAT "%8.2" DEPOSIT ABSOLUTE /end AXIS_DESCR
/end CHARACTERISTIC
/begin CHARACTERISTIC ASDdc_numDefaultState_C "Nummer des Default-Primärzustandes" VALUE 0xC8DDE Kw_Wu16 4.000000 OneToOne 0.00 4.000000 FORMAT "%8.6" EXTENDED_LIMITS 0.00 65535.00 /end CHARACTERISTIC
/begin CHARACTERISTIC ASDdc_numPrio_C "Prioritäten der Primärzustände" VAL_BLK 0xC8EC2 Kwb_Wu8 255.0 OneToOne 0.00 255.0 FORMAT "%5.1" NUMBER 6 /end CHARACTERISTIC
/begin CHARACTERISTIC ASDdc_T1State3_C "ARD Störungsregler T1, Primärzustand 3" VALUE 0xC8DE0 Kw_Wr32 1.50000000 ASD_GvrnDT1T1_float 0.00 1.50000000 FORMAT "%10.8" EXTENDED_LIMITS -1.00000000E+37 1.00000000E+37 /end CHARACTERISTIC
/begin CHARACTERISTIC ASDdc_KdState3_C "ARD Störungsregler Kd, Primärzustand 3" VALUE 0xC8DE4 Kw_Wr32 5.00000000 ASD_GvrnDT1Kd_float 0.00 5.00000000 FORMAT "%10.8" EXTENDED_LIMITS -1.00000000E+37 1.00000000E+37 /end CHARACTERISTIC
/begin CHARACTERISTIC ASDdc_T1State4_C "ARD Störungsregler T1, Primärzustand 4" VALUE 0xC8DE8 Kw_Wr32 1.50000000 ASD_GvrnDT1T1_float 0.00 1.50000000 FORMAT "%10.8" EXTENDED_LIMITS -1.00000000E+37 1.00000000E+37 /end CHARACTERISTIC
/begin CHARACTERISTIC ASDdc_KdState4_C "ARD Störungsregler Kd=sqrt(Td)/T1, Primärzustand 4" VALUE 0xC8DEC Kw_Wr32 5.00000000 ASD_GvrnDT1Kd_float 0.00 5.00000000 FORMAT "%10.8" EXTENDED_LIMITS -1.00000000E+37 1.00000000E+37 /end CHARACTERISTIC
/begin CHARACTERISTIC ASDdc_stConfCluEng_C "Angeforderte Zustände der Eingangsbedingung geschlossene Wandlerkupplung" VALUE 0xC8DF0 Kw_Wu16 65535.00 OneToOne 0.00 65535.00 FORMAT "%8.2" /end CHARACTERISTIC
/begin CHARACTERISTIC ASDdc_stConfCluOff_C "Angeforderte Zustände der Eingangsbedingung offener Wandlerkupplung" VALUE 0xC8DF2 Kw_Wu16 65535.00 OneToOne 0.00 65535.00 FORMAT "%8.2" /end CHARACTERISTIC
/begin CHARACTERISTIC ASDdc_stConfCluSlip_C "Angeforderte Zustände der Eingangsbedingung geregelter Wandlerkupplung" VALUE 0xC8DF4 Kw_Wu16 65535.00 OneToOne 0.00 65535.00 FORMAT "%8.2" /end CHARACTERISTIC
/begin CHARACTERISTIC ASDdc_stConv1_C "Die Eingangsbedingung ist erfüllt, wenn FrmMng_stConv == ASDdc_stConv1_C" VALUE 0xC8DF6 Kw_Wu8 255.0 OneToOne 0.00 255.0 FORMAT "%5.1" /end CHARACTERISTIC
/begin CHARACTERISTIC ASDdc_stConv2_C "Die Eingangsbedingung ist erfüllt, wenn FrmMng_stConv == ASDdc_stConv2_C" VALUE 0xC8DF7 Kw_Wu8 255.0 OneToOne 0.00 255.0 FORMAT "%5.1" /end CHARACTERISTIC
/begin CHARACTERISTIC ASDdc_stConv3_C "Die Eingangsbedingung ist erfüllt, wenn FrmMng_stConv == ASDdc_stConv3_C" VALUE 0xC8DF8 Kw_Wu8 255.0 OneToOne 0.00 255.0 FORMAT "%5.1" /end CHARACTERISTIC
/begin CHARACTERISTIC ASDdc_stExtInt_C "Angeforderte Zustände der Eingangsbedingung ""Externer Eingriff""" VALUE 0xC8DFA Kw_Wu16 65535.00 OneToOne 0.00 65535.00 FORMAT "%8.2" /end CHARACTERISTIC
/begin CHARACTERISTIC ASDdc_stGearswitch_C "Angeforderte Zustände der Eingangangsbedingung Gangumschaltung aktiv" VALUE 0xC8DFC Kw_Wu16 65535.00 OneToOne 0.00 65535.00 FORMAT "%8.2" /end CHARACTERISTIC
/begin CHARACTERISTIC ASDdc_stGripRaw_C "Angeforderte Zustände der Eingangsbedingung ""Kraftschluss""" VALUE 0xC8DFE Kw_Wu16 65535.00 OneToOne 0.00 65535.00 FORMAT "%8.2" /end CHARACTERISTIC
/begin CHARACTERISTIC ASDdc_stGrip_C "Angeforderte Zustände der Eingangsbedingung ""Kraftschluss und Nulldurchgang des Störungsreglers""" VALUE 0xC8E00 Kw_Wu16 65535.00 OneToOne 0.00 65535.00 FORMAT "%8.2" /end CHARACTERISTIC
/begin CHARACTERISTIC ASDdc_swtCalcN_C "Wählt Motorgeschwindigkeit für Parameter- Map. 1: ASDdc_nAvrg_mp = Eng_nAvrg;   0: ASDdc_nAvrg_mp = Eng_nAvrg - LIGov_nSetpoint" VALUE 0xC8E02 Kw_Wu8 255.0 OneToOne 0.00 255.0 FORMAT "%5.1" /end CHARACTERISTIC
/begin CHARACTERISTIC ASDdc_swtInitPS_C "Schalter zur 1: Aktivierung, 0: Deaktivierung der kontinuierlichen Initialisierung aufgrund Parametersatzwechsels" VALUE 0xC8E03 Kw_Wu8 255.0 OneToOne 0.00 255.0 FORMAT "%5.1" /end CHARACTERISTIC
/begin CHARACTERISTIC ASDdc_swtLADFrz_C "Schalter zum Aktivieren der Einfrierung des ASDdc in speziellen Fällen des ASDrf_stLAD (FF = nie einfrieren)" VALUE 0xC8E04 Kw_Wu8 255.0 OneToOne 0.00 255.0 FORMAT "%5.1" /end CHARACTERISTIC
/begin CHARACTERISTIC ASDdc_swtOpr_C "Schalter des Verknüpfungsoperators  (00=OR : 01=AND : 10=NAND : 11=NOR)" VALUE 0xC8E06 Kw_Wu16 65535.00 OneToOne 0.00 65535.00 FORMAT "%8.2" /end CHARACTERISTIC
/begin CHARACTERISTIC ASDdc_T1Grip_MAP "Zeitkonstante T1 des ARD-SR (ASDdc) für den Zustand Kraftschluss" MAP 0xC8E08 Kf_Xs16_Ys16_Ws16 1.498917 TimeDelay_s_Lin_16 0.001068148 1.499985 FORMAT "%8.6" EXTENDED_LIMITS -5.000153 5.000000
 /begin AXIS_DESCR STD_AXIS DrvTrn_rTransDT TransR 6 0.00 100.0000 FORMAT "%8.4" EXTENDED_LIMITS -327.6800 327.6700 DEPOSIT ABSOLUTE /end AXIS_DESCR
 /begin AXIS_DESCR STD_AXIS ASDdc_nAvrg_mp EngN 5 -32768.00 32767.00 FORMAT "%8.2" DEPOSIT ABSOLUTE /end AXIS_DESCR
/end CHARACTERISTIC
/begin CHARACTERISTIC ASDdc_T1Slip_MAP "Map for r, n dependent time constant for ASDdc" MAP 0xC8EC8 Kf_Xs16_Ys16_Ws16 1.498917 TimeDelay_s_Lin_16 0.001068148 1.499985 FORMAT "%8.6" EXTENDED_LIMITS -5.000153 5.000000
 /begin AXIS_DESCR STD_AXIS DrvTrn_rTransDT TransR 6 0.00 100.0000 FORMAT "%8.4" EXTENDED_LIMITS -327.6800 327.6700 DEPOSIT ABSOLUTE /end AXIS_DESCR
 /begin AXIS_DESCR STD_AXIS ASDdc_nAvrg_mp EngN 5 -32768.00 32767.00 FORMAT "%8.2" DEPOSIT ABSOLUTE /end AXIS_DESCR
/end CHARACTERISTIC
/begin CHARACTERISTIC ASDdc_trqLimMax_C "ARD Begrenzung Ausgang Störregler MAX" VALUE 0xC8E60 Kw_Wr32 1500.00000 Trq_float -500.000000 1000.00000 FORMAT "%10.5" EXTENDED_LIMITS -1.00000000E+37 1.00000000E+37 /end CHARACTERISTIC
/begin CHARACTERISTIC ASDdc_trqLimMin_C "ARD Begrenzung Ausgang Störregler MIN" VALUE 0xC8E64 Kw_Wr32 1500.00000 Trq_float -500.000000 1000.00000 FORMAT "%10.5" EXTENDED_LIMITS -1.00000000E+37 1.00000000E+37 /end CHARACTERISTIC
/begin CHARACTERISTIC ASDdc_trq_Vector "Bypass Label, nicht ändern!" VALUE 0xC38D8 Kw_Wu8 255.0 OneToOne 0.00 255.0 FORMAT "%5.1" /end CHARACTERISTIC
/begin CHARACTERISTIC ASDdc_trq_Channel "Bypass Label, nicht ändern!" VALUE 0xC38D9 Kw_Wu8 255.0 OneToOne 0.00 255.0 FORMAT "%5.1" /end CHARACTERISTIC
/begin CHARACTERISTIC ASDdc_vLimIni_C "ARD Geschwindigkeitsschwelle f. Initialisierung Störregler" VALUE 0xC8E68 Kw_Ws16 655.3500 Vel -327.6800 327.6700 FORMAT "%8.4" /end CHARACTERISTIC
/begin CHARACTERISTIC ASDrf_T1CluNeg_C "ARD Führungsformer T1 Kupplung neg. Gradient" VALUE 0xC8F70 Kw_Wu32 4294.9673 TimeDelay_s 0.0000010000000 4294.9673 FORMAT "%9.4" /end CHARACTERISTIC
/begin CHARACTERISTIC ASDrf_KdCluNeg_C "ARD Führungsformer Kd=Td/T1 Kupplung neg. Gradient" VALUE 0xC8F74 Kw_Ws32 32769.0000000 Kd -32768.0000000 1.00000000000 FORMAT "%13.7" EXTENDED_LIMITS -32768.0000000 32767.9999847 /end CHARACTERISTIC
/begin CHARACTERISTIC ASDrf_T1CluPos_C "ARD Führungsformer T1 Kupplung pos. Gradient" VALUE 0xC8F78 Kw_Wu32 4294.9673 TimeDelay_s 0.0000010000000 4294.9673 FORMAT "%9.4" /end CHARACTERISTIC
/begin CHARACTERISTIC ASDrf_KdCluPos_C "ARD Führungsformer Kd=Td/T1 Kupplung Ganggruppe pos. Gradient" VALUE 0xC8F7C Kw_Ws32 32769.0000000 Kd -32768.0000000 1.00000000000 FORMAT "%13.7" EXTENDED_LIMITS -32768.0000000 32767.9999847 /end CHARACTERISTIC
/begin CHARACTERISTIC ASDrf_CoeffADecLim_C "Koeffitient A der Parabel y = a*x^2 + b der Steigungsbegrenzung für Drehmomentabsenkung." VALUE 0xC8F20 Kw_Ws16 159.9951 CoeffA 0.00 159.9951 FORMAT "%8.4" EXTENDED_LIMITS -160.0000 159.9951 /end CHARACTERISTIC
/begin CHARACTERISTIC ASDrf_CoeffAGripLossNeg_CUR "Kennlinie für den Koeffitienten zweiter Ordnung der LSD Steigungsbegrenzung." CURVE 0xC906C Kl_Xs16_Ws16 319.9951 CoeffA -160.0000 159.9951 FORMAT "%8.4"
 /begin AXIS_DESCR STD_AXIS DrvTrn_rTransDT TransR 16 0.00 100.0000 FORMAT "%8.4" EXTENDED_LIMITS -327.6800 327.6700 DEPOSIT ABSOLUTE /end AXIS_DESCR
/end CHARACTERISTIC
/begin CHARACTERISTIC ASDrf_CoeffAGripLossPos_CUR "Kennlinie für den Koeffitienten zweiter Ordnung der LSD Steigungsbegrenzung." CURVE 0xC90AE Kl_Xs16_Ws16 319.9951 CoeffA -160.0000 159.9951 FORMAT "%8.4"
 /begin AXIS_DESCR STD_AXIS DrvTrn_rTransDT TransR 16 0.00 100.0000 FORMAT "%8.4" EXTENDED_LIMITS -327.6800 327.6700 DEPOSIT ABSOLUTE /end AXIS_DESCR
/end CHARACTERISTIC
/begin CHARACTERISTIC ASDrf_CoeffBDecLim_C "Koeffitient B der Parabel y = a*x^2 + b der Steigungsbegrenzung für Drehmomentabsenkung." VALUE 0xC8F22 Kw_Ws16 3276.700 dTrq 0.00 3276.700 FORMAT "%8.3" EXTENDED_LIMITS -3276.800 3276.700 /end CHARACTERISTIC
/begin CHARACTERISTIC ASDrf_CoeffBGripLossNeg_CUR "Kennlinie für den Koeffitienten nullter Ordnung der LSD Steigungsbegrenzung." CURVE 0xC90F0 Kl_Xs16_Ws16 6553.500 dTrq -3276.800 3276.700 FORMAT "%8.3"
 /begin AXIS_DESCR STD_AXIS DrvTrn_rTransDT TransR 16 0.00 100.0000 FORMAT "%8.4" EXTENDED_LIMITS -327.6800 327.6700 DEPOSIT ABSOLUTE /end AXIS_DESCR
/end CHARACTERISTIC
/begin CHARACTERISTIC ASDrf_CoeffBGripLossPos_CUR "Kennlinie für den Koeffitienten nullter Ordnung der LSD Steigungsbegrenzung." CURVE 0xC9132 Kl_Xs16_Ws16 6553.500 dTrq -3276.800 3276.700 FORMAT "%8.3"
 /begin AXIS_DESCR STD_AXIS DrvTrn_rTransDT TransR 16 0.00 100.0000 FORMAT "%8.4" EXTENDED_LIMITS -327.6800 327.6700 DEPOSIT ABSOLUTE /end AXIS_DESCR
/end CHARACTERISTIC
/begin CHARACTERISTIC ASDrf_dtrqIncLimHigh_C "Hysterese Schwelle oben für steile Drehmomentanstiege." VALUE 0xC8F24 Kw_Ws16 3276.700 dTrq 0.00 3276.700 FORMAT "%8.3" EXTENDED_LIMITS -3276.800 3276.700 /end CHARACTERISTIC
/begin CHARACTERISTIC ASDrf_dtrqIncLimLow_C "Hystereseschwelle unten zur Erkennung von nicht steilen Drehmoment Gradienten." VALUE 0xC8F26 Kw_Ws16 3276.700 dTrq 0.00 3276.700 FORMAT "%8.3" EXTENDED_LIMITS -3276.800 3276.700 /end CHARACTERISTIC
/begin CHARACTERISTIC ASDrf_dtrqInrLtdLim_CUR "Kurve zur Begrenzung der zeitl. Ableitung von CoEng_trqInrLtd" CURVE 0xC8F28 Kl_Xs16_Ws16 4000.000 dTrq -2000.000 2000.000 FORMAT "%8.3" EXTENDED_LIMITS -3276.800 3276.700
 /begin AXIS_DESCR STD_AXIS ASDrf_dtrqInrLtd_mp dTrq 7 -2000.000 2000.000 FORMAT "%8.3" EXTENDED_LIMITS -3276.800 3276.700 DEPOSIT ABSOLUTE /end AXIS_DESCR
/end CHARACTERISTIC
/begin CHARACTERISTIC ASDrf_dtrqSteepNeg_C "Obergrenze für Initialisierung bei steilen Eingangssignalgradienten" VALUE 0xC8F46 Kw_Ws16 2000.000 dTrq -2000.000 0.00 FORMAT "%8.3" EXTENDED_LIMITS -3276.800 3276.700 /end CHARACTERISTIC
/begin CHARACTERISTIC ASDrf_dtrqSteepPos_C "Untergrenze für Initialisierung bei steilen Eingangssignalgradienten" VALUE 0xC8F48 Kw_Ws16 2000.000 dTrq 0.00 2000.000 FORMAT "%8.3" EXTENDED_LIMITS -3276.800 3276.700 /end CHARACTERISTIC
/begin CHARACTERISTIC ASDrf_T1ExtInt_C "ARD Führungsformer T1, externer Eingriff" VALUE 0xC8F80 Kw_Wu32 4294.9673 TimeDelay_s 0.0000010000000 4294.9673 FORMAT "%9.4" /end CHARACTERISTIC
/begin CHARACTERISTIC ASDrf_KdExtInt_C "ARD Führungsformer Kd=Td/T1, externer Eingriff" VALUE 0xC8F84 Kw_Ws32 32769.0000000 Kd -32768.0000000 1.00000000000 FORMAT "%13.7" EXTENDED_LIMITS -32768.0000000 32767.9999847 /end CHARACTERISTIC
/begin CHARACTERISTIC ASDrf_T1Flt_C "Zeitkonstante PT1 Glied zur Filterung von CoEng_trqInrLtd vor der Ableitung." VALUE 0xC8F4C Kw_Wu32 4294.9673 TimeDelay_s 0.0000010000000 4294.9673 FORMAT "%9.4" /end CHARACTERISTIC
/begin CHARACTERISTIC ASDrf_KdGripNeg_CUR "Kd bei geschlosenem Antreibsstrang und negativem Gradienten" CURVE 0xC9174 Kl_Xs16_Ws16 1.000000 Kd_Lin_16 0.00 1.000000 FORMAT "%8.6" EXTENDED_LIMITS -1.000031 1.000000
 /begin AXIS_DESCR STD_AXIS DrvTrn_rTransDT TransR 16 0.00 100.0000 FORMAT "%8.4" EXTENDED_LIMITS -327.6800 327.6700 DEPOSIT ABSOLUTE /end AXIS_DESCR
/end CHARACTERISTIC
/begin CHARACTERISTIC ASDrf_KdGripPos_CUR "Kd bei geschlosenem Antreibsstrang und positivem Gradienten" CURVE 0xC91B6 Kl_Xs16_Ws16 1.000000 Kd_Lin_16 0.00 1.000000 FORMAT "%8.6" EXTENDED_LIMITS -1.000031 1.000000
 /begin AXIS_DESCR STD_AXIS DrvTrn_rTransDT TransR 16 0.00 100.0000 FORMAT "%8.4" EXTENDED_LIMITS -327.6800 327.6700 DEPOSIT ABSOLUTE /end AXIS_DESCR
/end CHARACTERISTIC
/begin CHARACTERISTIC ASDrf_numDefaultState_C "Vorgabestatus" VALUE 0xC8F88 Kw_Wu16 4.00000000000 ASDrf_numDefaultState 0.00 4.00000000000 FORMAT "%13.11" /end CHARACTERISTIC
/begin CHARACTERISTIC ASDrf_numPrio_C "Statuspriorität" VAL_BLK 0xC91F8 Kwb_Wu8 255.0 OneToOne 0.00 255.0 FORMAT "%5.1" NUMBER 5 /end CHARACTERISTIC
/begin CHARACTERISTIC ASDrf_CoeffACluLossNeg_C "Kennwert für den Koeffitienten zweiter Ordnung der LSD Steigungsbegrenzung." VALUE 0xC8F8A Kw_Ws16 159.9951 CoeffA 0.00 159.9951 FORMAT "%8.4" EXTENDED_LIMITS -160.0000 159.9951 /end CHARACTERISTIC
/begin CHARACTERISTIC ASDrf_CoeffBCluLossNeg_C "Kennlinie für den Koeffitienten nullter Ordnung der LSD Steigungsbegrenzung." VALUE 0xC8F8C Kw_Ws16 3276.700 dTrq 0.00 3276.700 FORMAT "%8.3" EXTENDED_LIMITS -3276.800 3276.700 /end CHARACTERISTIC
/begin CHARACTERISTIC ASDrf_CoeffACluLossPos_C "Kennwert für den Koeffitienten zweiter Ordnung der LSD Steigungsbegrenzung." VALUE 0xC8F8E Kw_Ws16 159.9951 CoeffA 0.00 159.9951 FORMAT "%8.4" EXTENDED_LIMITS -160.0000 159.9951 /end CHARACTERISTIC
/begin CHARACTERISTIC ASDrf_CoeffBCluLossPos_C "Kennwert für den Koeffitienten nullter Ordnung der LSD Steigungsbegrenzung." VALUE 0xC8F90 Kw_Ws16 3276.700 dTrq 0.00 3276.700 FORMAT "%8.3" EXTENDED_LIMITS -3276.800 3276.700 /end CHARACTERISTIC
/begin CHARACTERISTIC ASDrf_CoeffAExtIntLoss_C "Kennwert für den Koeffitienten zweiter Ordnung der LSD Steigungsbegrenzung." VALUE 0xC8F92 Kw_Ws16 159.9951 CoeffA 0.00 159.9951 FORMAT "%8.4" EXTENDED_LIMITS -160.0000 159.9951 /end CHARACTERISTIC
/begin CHARACTERISTIC ASDrf_CoeffBExtIntLoss_C "Kennwert für den Koeffitienten nullter Ordnung der LSD Steigungsbegrenzung." VALUE 0xC8F94 Kw_Ws16 3276.700 dTrq 0.00 3276.700 FORMAT "%8.3" EXTENDED_LIMITS -3276.800 3276.700 /end CHARACTERISTIC
/begin CHARACTERISTIC ASDrf_CoeffAState3LossNeg_C "Kennwert für den Koeffitienten zweiter Ordnung der LSD Steigungsbegrenzung." VALUE 0xC8F96 Kw_Ws16 159.9951 CoeffA 0.00 159.9951 FORMAT "%8.4" EXTENDED_LIMITS -160.0000 159.9951 /end CHARACTERISTIC
/begin CHARACTERISTIC ASDrf_CoeffBState3LossNeg_C "Kennwert für den Koeffitienten nullter Ordnung der LSD Steigungsbegrenzung." VALUE 0xC8F98 Kw_Ws16 3276.700 dTrq 0.00 3276.700 FORMAT "%8.3" EXTENDED_LIMITS -3276.800 3276.700 /end CHARACTERISTIC
/begin CHARACTERISTIC ASDrf_CoeffAState3LossPos_C "Kennwert für den Koeffitienten zweiter Ordnung der LSD Steigungsbegrenzung." VALUE 0xC8F9A Kw_Ws16 159.9951 CoeffA 0.00 159.9951 FORMAT "%8.4" EXTENDED_LIMITS -160.0000 159.9951 /end CHARACTERISTIC
/begin CHARACTERISTIC ASDrf_CoeffBState3LossPos_C "Kennwert für den Koeffitienten nullter Ordnung der LSD Steigungsbegrenzung." VALUE 0xC8F9C Kw_Ws16 3276.700 dTrq 0.00 3276.700 FORMAT "%8.3" EXTENDED_LIMITS -3276.800 3276.700 /end CHARACTERISTIC
/begin CHARACTERISTIC ASDrf_CoeffAState4LossNeg_C "Kennwert für den Koeffitienten zweiter Ordnung der LSD Steigungsbegrenzung." VALUE 0xC8F9E Kw_Ws16 159.9951 CoeffA 0.00 159.9951 FORMAT "%8.4" EXTENDED_LIMITS -160.0000 159.9951 /end CHARACTERISTIC
/begin CHARACTERISTIC ASDrf_CoeffBState4LossNeg_C "Kennwert für den Koeffitienten nullter Ordnung der LSD Steigungsbegrenzung." VALUE 0xC8FA0 Kw_Ws16 3276.700 dTrq 0.00 3276.700 FORMAT "%8.3" EXTENDED_LIMITS -3276.800 3276.700 /end CHARACTERISTIC
/begin CHARACTERISTIC ASDrf_CoeffAState4LossPos_C "Kennwert für den Koeffitienten zweiter Ordnung der LSD Steigungsbegrenzung." VALUE 0xC8FA2 Kw_Ws16 159.9951 CoeffA 0.00 159.9951 FORMAT "%8.4" EXTENDED_LIMITS -160.0000 159.9951 /end CHARACTERISTIC
/begin CHARACTERISTIC ASDrf_CoeffBState4LossPos_C "Kennwert für den Koeffitienten nullter Ordnung der LSD Steigungsbegrenzung." VALUE 0xC8FA4 Kw_Ws16 3276.700 dTrq 0.00 3276.700 FORMAT "%8.3" EXTENDED_LIMITS -3276.800 3276.700 /end CHARACTERISTIC
/begin CHARACTERISTIC ASDrf_T1State3Neg_C "ARD Führungsformer T1 frei wählbarer Zustand 3 neg. Gradient" VALUE 0xC8FA8 Kw_Wu32 4294.9673 TimeDelay_s 0.0000010000000 4294.9673 FORMAT "%9.4" /end CHARACTERISTIC
/begin CHARACTERISTIC ASDrf_KdState3Neg_C "ARD Führungsformer Kd=Td/T1 frei wählbarer Zustand 3 neg. Gradient" VALUE 0xC8FAC Kw_Ws32 32769.0000000 Kd -32768.0000000 1.00000000000 FORMAT "%13.7" EXTENDED_LIMITS -32768.0000000 32767.9999847 /end CHARACTERISTIC
/begin CHARACTERISTIC ASDrf_T1State3Pos_C "ARD Führungsformer T1 frei wählbarer Zustand 3 pos. Gradient" VALUE 0xC8FB0 Kw_Wu32 4294.9673 TimeDelay_s 0.0000010000000 4294.9673 FORMAT "%9.4" /end CHARACTERISTIC
/begin CHARACTERISTIC ASDrf_KdState3Pos_C "ARD Führungsformer Kd=Td/T1 frei wählbarer Zustand 3 pos. Gradient" VALUE 0xC8FB4 Kw_Ws32 32769.0000000 Kd -32768.0000000 1.00000000000 FORMAT "%13.7" EXTENDED_LIMITS -32768.0000000 32767.9999847 /end CHARACTERISTIC
/begin CHARACTERISTIC ASDrf_T1State4Neg_C "ARD Führungsformer T1 frei wählbarer Zustand 4 neg. Gradient" VALUE 0xC8FB8 Kw_Wu32 4294.9673 TimeDelay_s 0.0000010000000 4294.9673 FORMAT "%9.4" /end CHARACTERISTIC
/begin CHARACTERISTIC ASDrf_KdState4Neg_C "ARD Führungsformer Kd=Td/T1 frei wählbarer Zustand 4 neg. Gradient" VALUE 0xC8FBC Kw_Ws32 32769.0000000 Kd -32768.0000000 1.00000000000 FORMAT "%13.7" EXTENDED_LIMITS -32768.0000000 32767.9999847 /end CHARACTERISTIC
/begin CHARACTERISTIC ASDrf_T1State4Pos_C "ARD Führungsformer T1 frei wählbarer Zustand 4 pos. Gradient" VALUE 0xC8FC0 Kw_Wu32 4294.9673 TimeDelay_s 0.0000010000000 4294.9673 FORMAT "%9.4" /end CHARACTERISTIC
/begin CHARACTERISTIC ASDrf_KdState4Pos_C "ARD Führungsformer Kd=Td/T1 frei wählbarer Zustand 4 pos. Gradient" VALUE 0xC8FC4 Kw_Ws32 32769.0000000 Kd -32768.0000000 1.00000000000 FORMAT "%13.7" EXTENDED_LIMITS -32768.0000000 32767.9999847 /end CHARACTERISTIC
/begin CHARACTERISTIC ASDrf_stConv1_C "Eingangsbedingung ""Wandlerkupplung geschlossen""" VALUE 0xC8FC8 Kw_Wu8 255.0 OneToOne 0.00 255.0 FORMAT "%5.1" /end CHARACTERISTIC
/begin CHARACTERISTIC ASDrf_stConv2_C "Eingangsbedingung ""Wandlerkupplung geöffnet""" VALUE 0xC8FC9 Kw_Wu8 255.0 OneToOne 0.00 255.0 FORMAT "%5.1" /end CHARACTERISTIC
/begin CHARACTERISTIC ASDrf_stConv3_C "Eingangsbedingung ""Wandlerkupplung geregelt""" VALUE 0xC8FCA Kw_Wu8 255.0 OneToOne 0.00 255.0 FORMAT "%5.1" /end CHARACTERISTIC
/begin CHARACTERISTIC ASDrf_stConvCluEng_C "Bitmuster der Eingangsbedingung für ""geschlossene"" Wandlerkupplung." VALUE 0xC8FCC Kw_Wu16 65535.00 OneToOne 0.00 65535.00 FORMAT "%8.2" /end CHARACTERISTIC
/begin CHARACTERISTIC ASDrf_stConvCluOff_C "Bitmuster der Eingangsbedingung für ""geöffnete"" Wandlerkupplung." VALUE 0xC8FCE Kw_Wu16 65535.00 OneToOne 0.00 65535.00 FORMAT "%8.2" /end CHARACTERISTIC
/begin CHARACTERISTIC ASDrf_stConvCluSlip_C "Bitmuster der Eingangsbedingung für ""geregelte"" Wandlerkupplung." VALUE 0xC8FD0 Kw_Wu16 65535.00 OneToOne 0.00 65535.00 FORMAT "%8.2" /end CHARACTERISTIC
/begin CHARACTERISTIC ASDrf_stEntcClu_C "Initialisierungsanforderung beim Eintritt in den Zustand ""offener Antriebsstrang""" VALUE 0xC8FD2 Kw_Wu8 3.000 OneToOne 0.00 3.000 FORMAT "%5.3" EXTENDED_LIMITS 0.00 255.0 /end CHARACTERISTIC
/begin CHARACTERISTIC ASDrf_stEntcExtInt_C "Initialisierungsanforderung beim Eintritt in den Zustand ""externer Momenteneingriff""" VALUE 0xC8FD3 Kw_Wu8 3.000 OneToOne 0.00 3.000 FORMAT "%5.3" EXTENDED_LIMITS 0.00 255.0 /end CHARACTERISTIC
/begin CHARACTERISTIC ASDrf_stEntcGrip_C "Initialisierungsanforderung beim Eintritt in den Zustand ""Vortrieb""" VALUE 0xC8FD4 Kw_Wu8 3.000 OneToOne 0.00 3.000 FORMAT "%5.3" EXTENDED_LIMITS 0.00 255.0 /end CHARACTERISTIC
/begin CHARACTERISTIC ASDrf_stEntcState3_C "Initialisierungsanforderung beim Eintritt in den Zustand 3" VALUE 0xC8FD5 Kw_Wu8 3.000 OneToOne 0.00 3.000 FORMAT "%5.3" EXTENDED_LIMITS 0.00 255.0 /end CHARACTERISTIC
/begin CHARACTERISTIC ASDrf_stEntcState4_C "Initialisierungsanforderung beim Eintritt in den Zustand 4" VALUE 0xC8FD6 Kw_Wu8 3.000 OneToOne 0.00 3.000 FORMAT "%5.3" EXTENDED_LIMITS 0.00 255.0 /end CHARACTERISTIC
/begin CHARACTERISTIC ASDrf_stExClu_C "Initialisierungsanforderung beim Verlassen des Zustands ""offener Antriebsstrang""" VALUE 0xC8FD7 Kw_Wu8 3.000 OneToOne 0.00 3.000 FORMAT "%5.3" EXTENDED_LIMITS 0.00 255.0 /end CHARACTERISTIC
/begin CHARACTERISTIC ASDrf_stExExtInt_C "Initialisierungsanforderung beim Verlassen des Zustands ""externer Momenteneingriff""" VALUE 0xC8FD8 Kw_Wu8 3.000 OneToOne 0.00 3.000 FORMAT "%5.3" EXTENDED_LIMITS 0.00 255.0 /end CHARACTERISTIC
/begin CHARACTERISTIC ASDrf_stExGrip_C "Initialisierungsanforderung beim Verlasssen des Zustands ""Vortrieb""" VALUE 0xC8FD9 Kw_Wu8 3.000 OneToOne 0.00 3.000 FORMAT "%5.3" EXTENDED_LIMITS 0.00 255.0 /end CHARACTERISTIC
/begin CHARACTERISTIC ASDrf_stExState3_C "Initialisierungsanforderung beim Verlassen des Zustands 3" VALUE 0xC8FDA Kw_Wu8 3.000 OneToOne 0.00 3.000 FORMAT "%5.3" EXTENDED_LIMITS 0.00 255.0 /end CHARACTERISTIC
/begin CHARACTERISTIC ASDrf_stExState4_C "Initialisierungsanforderung beim Verlassen des Zustands 4" VALUE 0xC8FDB Kw_Wu8 3.000 OneToOne 0.00 3.000 FORMAT "%5.3" EXTENDED_LIMITS 0.00 255.0 /end CHARACTERISTIC
/begin CHARACTERISTIC ASDrf_stExtInt_C "Konfiguration der Eingangsbedingung ""externer Momenteneingriff""" VALUE 0xC8FDC Kw_Wu16 65535.00 OneToOne 0.00 65535.00 FORMAT "%8.2" /end CHARACTERISTIC
/begin CHARACTERISTIC ASDrf_stGrip_C "Konfiguration der Eingangsbedingung ""offener Antriebsstrang""" VALUE 0xC8FDE Kw_Wu16 65535.00 OneToOne 0.00 65535.00 FORMAT "%8.2" /end CHARACTERISTIC
/begin CHARACTERISTIC ASDrf_stReliablAdpt_C "Flags zur Bestimmung einer vertrauenswürdigen Verlustmomentadaption." VALUE 0xC8FE0 Kw_Wu8 255.0 OneToOne 0.00 255.0 FORMAT "%5.1" /end CHARACTERISTIC
/begin CHARACTERISTIC ASDrf_swtCalcTrq_C "Schalter für die Berechnung des aktuellen ASD Moments (1: berücksichtigt ASDdc Moment, 0: ASDdc Moment nicht berücksichtigt)" VALUE 0xC8F50 Kw_Wu8 1.000 OneToOne 0.00 1.000 FORMAT "%5.3" EXTENDED_LIMITS 0.00 255.0 /end CHARACTERISTIC
/begin CHARACTERISTIC ASDrf_swtFlt_C "Schalter zur Auswahl des Filters für CoEng_trqInrLtd (0  Filterung / >0 keine Filterung)." VALUE 0xC8F51 Kw_Wu8 255.0 OneToOne 0.00 255.0 FORMAT "%5.1" /end CHARACTERISTIC
/begin CHARACTERISTIC ASDrf_swtFrzLoss_C "Schalter für die Berechnung des Verlustmoments bei aktiver Steigungsbegrenzung (1=eingefroren)" VALUE 0xC8F52 Kw_Wu8 1.000 OneToOne 0.00 1.000 FORMAT "%5.3" EXTENDED_LIMITS 0.00 255.0 /end CHARACTERISTIC
/begin CHARACTERISTIC ASDrf_swtInitPS_C "Schalter zur Aktivierung/Deaktivierung der kontinuierlichen Initialisierung aufgrund Parametersatzwechsels (>128: keine init.)" VALUE 0xC8F53 Kw_Wu8 255.0 OneToOne 0.00 255.0 FORMAT "%5.1" /end CHARACTERISTIC
/begin CHARACTERISTIC ASDrf_swtLim_C "Schalter zur Begrenzung von ASDrf_trqIn. (Bit0 gesetzt: verhindere <0, Bit1 gesetzt: verhindere >CoEng_trqInrLim)" VALUE 0xC8F54 Kw_Wu8 3.000 OneToOne 0.00 3.000 FORMAT "%5.3" EXTENDED_LIMITS 0.00 255.0 /end CHARACTERISTIC
/begin CHARACTERISTIC ASDrf_swtLossClcNoRel_C "Verlustmoment wenn keine Verlustmomentadaption. Applikationsdaten als 0: absolut, 1: offset, 2: offset zum angepassten Moment" VALUE 0xC8FE1 Kw_Wu8 2.000 OneToOne 0.00 2.000 FORMAT "%5.3" EXTENDED_LIMITS 0.00 255.0 /end CHARACTERISTIC
/begin CHARACTERISTIC ASDrf_swtLossClcRel_C " Verlustmoment bei Verlustmomentadaption. Verw. Applikationsdaten als 0: absolut, 1: offset, 2: offset zum angepassten Moment" VALUE 0xC8FE2 Kw_Wu8 2.000 OneToOne 0.00 2.000 FORMAT "%5.3" EXTENDED_LIMITS 0.00 255.0 /end CHARACTERISTIC
/begin CHARACTERISTIC ASDrf_swtOpr_C "Auswahl des Operators für die Primärzustände. (00=OR, 01=AND, 10=NAND, 11=NOR)" VALUE 0xC8FE4 Kw_Wu16 65535.00 OneToOne 0.00 65535.00 FORMAT "%8.2" /end CHARACTERISTIC
/begin CHARACTERISTIC ASDrf_T1GripNeg_CUR "T1 bei geshchlosenem Antreibsstrang und negativem Gradienten" CURVE 0xC91FE Kl_Xs16_Ws16 1.499985 TimeDelay_s_Lin_16 0.00 1.499985 FORMAT "%8.6" EXTENDED_LIMITS -5.000153 5.000000
 /begin AXIS_DESCR STD_AXIS DrvTrn_rTransDT TransR 16 0.00 100.0000 FORMAT "%8.4" EXTENDED_LIMITS -327.6800 327.6700 DEPOSIT ABSOLUTE /end AXIS_DESCR
/end CHARACTERISTIC
/begin CHARACTERISTIC ASDrf_T1GripPos_CUR "T1 bei geschlosenem Antriebstrang und positivem Gradienten" CURVE 0xC9240 Kl_Xs16_Ws16 1.499985 TimeDelay_s_Lin_16 0.00 1.499985 FORMAT "%8.6" EXTENDED_LIMITS -5.000153 5.000000
 /begin AXIS_DESCR STD_AXIS DrvTrn_rTransDT TransR 16 0.00 100.0000 FORMAT "%8.4" EXTENDED_LIMITS -327.6800 327.6700 DEPOSIT ABSOLUTE /end AXIS_DESCR
/end CHARACTERISTIC
/begin CHARACTERISTIC ASDrf_tiTrqSty_C "Zeit für die Erkennung des stationären Zustands, wenn das Moment innerhalb des Intervalls liegt." VALUE 0xC8F56 Kw_Wu16 655350.0 Time_ms 0.00 655350.0 FORMAT "%8.1" /end CHARACTERISTIC
/begin CHARACTERISTIC ASDrf_trqDecHigh_C "Offset der oberen Intervallgrenze zur Bestimmung des stationären Zustands." VALUE 0xC8F58 Kw_Ws16 1500.000 Trq -500.0000 1000.000 FORMAT "%8.3" EXTENDED_LIMITS -3276.800 3276.700 /end CHARACTERISTIC
/begin CHARACTERISTIC ASDrf_trqDecLow_C "Offset der unteren Intervallgrenze zur Bestimmung des stationären Zustands." VALUE 0xC8F5A Kw_Ws16 1500.000 Trq -500.0000 1000.000 FORMAT "%8.3" EXTENDED_LIMITS -3276.800 3276.700 /end CHARACTERISTIC
/begin CHARACTERISTIC ASDrf_trqInr_Vector "Bypass Label, nicht ändern!" VALUE 0xC38DA Kw_Wu8 255.0 OneToOne 0.00 255.0 FORMAT "%5.1" /end CHARACTERISTIC
/begin CHARACTERISTIC ASDrf_trqInr_Channel "Bypass Label, nicht ändern!" VALUE 0xC38DB Kw_Wu8 255.0 OneToOne 0.00 255.0 FORMAT "%5.1" /end CHARACTERISTIC
/begin CHARACTERISTIC ASDrf_trqLossNeg_CUR "Drehzahlabhängige Kennlinie der Verlustmomente für negative Eingangsänderungen." CURVE 0xC8FE6 Kl_Xs16_Ws16 1500.000 Trq -500.0000 1000.000 FORMAT "%8.3" EXTENDED_LIMITS -3276.800 3276.700
 /begin AXIS_DESCR STD_AXIS Eng_nAvrg EngN 16 0.00 6000.000 FORMAT "%8.3" EXTENDED_LIMITS -32768.00 32767.00 DEPOSIT ABSOLUTE /end AXIS_DESCR
/end CHARACTERISTIC
/begin CHARACTERISTIC ASDrf_trqLossPos_CUR "Drehzahlabhängige Kennlinie der Verlustmomente für positive Eingangsänderungen." CURVE 0xC9028 Kl_Xs16_Ws16 1500.000 Trq -500.0000 1000.000 FORMAT "%8.3" EXTENDED_LIMITS -3276.800 3276.700
 /begin AXIS_DESCR STD_AXIS Eng_nAvrg EngN 16 0.00 6000.000 FORMAT "%8.3" EXTENDED_LIMITS -32768.00 32767.00 DEPOSIT ABSOLUTE /end AXIS_DESCR
/end CHARACTERISTIC
/begin CHARACTERISTIC ASDrf_trqOfsNegHigh_C "Annäherungsschwelle zum Verlustmoment." VALUE 0xC8F5C Kw_Ws16 1500.000 Trq -500.0000 1000.000 FORMAT "%8.3" EXTENDED_LIMITS -3276.800 3276.700 /end CHARACTERISTIC
/begin CHARACTERISTIC ASDrf_trqOfsNegLow_C "Offset zum Verlustmoment für die Beendigung des Zustands ""Steigungsbegrenzung""." VALUE 0xC8F5E Kw_Ws16 1500.000 Trq -500.0000 1000.000 FORMAT "%8.3" EXTENDED_LIMITS -3276.800 3276.700 /end CHARACTERISTIC
/begin CHARACTERISTIC ASDrf_trqOfsNegMid_C "Offset zum Verslustmoment für die Annäherungserkennung und Aktivierung des Zustands ""Steigungsbegrenzung""" VALUE 0xC8F60 Kw_Ws16 1500.000 Trq -500.0000 1000.000 FORMAT "%8.3" EXTENDED_LIMITS -3276.800 3276.700 /end CHARACTERISTIC
/begin CHARACTERISTIC ASDrf_trqOfsPosHigh_C "Offset zum Verlustmoment für die Beendigung des Zustands ""Steigungsbegrenzung""." VALUE 0xC8F62 Kw_Ws16 1500.000 Trq -500.0000 1000.000 FORMAT "%8.3" EXTENDED_LIMITS -3276.800 3276.700 /end CHARACTERISTIC
/begin CHARACTERISTIC ASDrf_trqOfsPosLow_C "Annäherungsschwelle zum Verlustmoment." VALUE 0xC8F64 Kw_Ws16 1500.000 Trq -500.0000 1000.000 FORMAT "%8.3" EXTENDED_LIMITS -3276.800 3276.700 /end CHARACTERISTIC
/begin CHARACTERISTIC ASDrf_trqOfsPosMid_C "Offset zum Verslustmoment für die Annäherungserkennung und Aktivierung des Zustands ""Steigungsbegrenzung""" VALUE 0xC8F66 Kw_Ws16 1500.000 Trq -500.0000 1000.000 FORMAT "%8.3" EXTENDED_LIMITS -3276.800 3276.700 /end CHARACTERISTIC
/begin CHARACTERISTIC ASDrf_trqThresDecLim_C "Abstand zum Startpunt zur Deaktivierung der Steigungsbegrenzung durch Drehmomentabsenkung." VALUE 0xC8F68 Kw_Ws16 1500.000 Trq -500.0000 1000.000 FORMAT "%8.3" EXTENDED_LIMITS -3276.800 3276.700 /end CHARACTERISTIC
/begin CHARACTERISTIC ASDrf_trqThresNeg_C "ARD Führungsformer Hystereseschwelle Wunschmomentgradient 'neg' alle Ganggrp." VALUE 0xC8F6A Kw_Ws16 1500.000 Trq -500.0000 1000.000 FORMAT "%8.3" EXTENDED_LIMITS -3276.800 3276.700 /end CHARACTERISTIC
/begin CHARACTERISTIC ASDrf_trqThresPos_C "ARD Führungsformer Hystereseschwelle Wunschmomentgradient 'pos' alle Ganggrp." VALUE 0xC8F6C Kw_Ws16 1500.000 Trq -500.0000 1000.000 FORMAT "%8.3" EXTENDED_LIMITS -3276.800 3276.700 /end CHARACTERISTIC
/begin CHARACTERISTIC ASMod_dmIndAirRef_MAP "Referenz des Gasmassenstroms als Funktion der Drehzahl und der verbrannten Kraftstoffmasse" MAP 0xC9282 Kf_Xs16_Ys16_Ws16 1400.000 AirMassPerTime 0.00 1400.000 FORMAT "%8.3" EXTENDED_LIMITS -3276.800 3276.700
 /begin AXIS_DESCR STD_AXIS Eng_nAvrg EngN 8 0.00 6000.000 FORMAT "%8.3" EXTENDED_LIMITS -32768.00 32767.00 DEPOSIT ABSOLUTE /end AXIS_DESCR
 /begin AXIS_DESCR STD_AXIS ASMod_qLmbdCtlCorr_mp InjMass 8 0.00 150.0000 FORMAT "%8.4" EXTENDED_LIMITS -327.6800 327.6700 DEPOSIT ABSOLUTE /end AXIS_DESCR
/end CHARACTERISTIC
/begin CHARACTERISTIC ASMod_facDdTm_C "Faktor zur Berechnung der Gaslaufzeit durch den Motor" VALUE 0xC9326 Kw_Ws16 7.000000 Fact1 1.000000 8.000000 FORMAT "%8.6" EXTENDED_LIMITS -256.0000 255.9922 /end CHARACTERISTIC
/begin CHARACTERISTIC ASMod_facDMCorTDiff_CUR "Korrekturfaktor der Temperaturerhöhung aufgrund des aktuellen Gasmassenstroms" CURVE 0xC9328 Kl_Xs16_Ws16 2.000000 Fact 0.00 2.000000 FORMAT "%8.6" EXTENDED_LIMITS -4.000000 3.999878
 /begin AXIS_DESCR STD_AXIS ASMod_rDMIndAir_mp RatAirMass 8 -1.000000 1.000000 FORMAT "%8.6" EXTENDED_LIMITS -327.6800 327.6700 DEPOSIT ABSOLUTE /end AXIS_DESCR
/end CHARACTERISTIC
/begin CHARACTERISTIC ASMod_facSOICorTDiff_CUR "Korrekturfaktor der Temperaturerhöhung aufgrund des aktuellen Spritzbeginns" CURVE 0xC934A Kl_Xs16_Ws16 2.000000 Fact 0.00 2.000000 FORMAT "%8.6" EXTENDED_LIMITS -4.000000 3.999878
 /begin AXIS_DESCR STD_AXIS InjCrv_phiMI1Des AngleCrS 8 -19.99219 19.99219 FORMAT "%8.5" EXTENDED_LIMITS -768.0000 767.9766 DEPOSIT ABSOLUTE /end AXIS_DESCR
/end CHARACTERISTIC
/begin CHARACTERISTIC ASMod_facTCorVolEff_C "Korrekturfaktor zur Kompensation der Abhängigkeit des Luftaufwands von der Gastemperatur vor Einlass" VALUE 0xC94E0 Kw_Ws16 2.000000 RatAirMass 0.00 2.000000 FORMAT "%8.6" EXTENDED_LIMITS -327.6800 327.6700 /end CHARACTERISTIC
/begin CHARACTERISTIC ASMod_facVolEff_MAP "Luftaufwand des Motors als Funktion von Drehzahl und aktueller Einspritzmenge" MAP 0xC94E2 Kf_Xs16_Ys16_Ws16 1.000000 RatAirMass 0.00 1.000000 FORMAT "%8.6" EXTENDED_LIMITS -327.6800 327.6700
 /begin AXIS_DESCR STD_AXIS Eng_nAvrg EngN 10 0.00 6000.000 FORMAT "%8.3" EXTENDED_LIMITS -32768.00 32767.00 DEPOSIT ABSOLUTE /end AXIS_DESCR
 /begin AXIS_DESCR STD_AXIS InjCtl_qCurr InjMassCyc 10 0.00 327.6700 FORMAT "%8.4" EXTENDED_LIMITS -327.6800 327.6700 DEPOSIT ABSOLUTE /end AXIS_DESCR
/end CHARACTERISTIC
/begin CHARACTERISTIC ASMod_facVSACorVolEff_MAP "Korrekturfaktor für Luftaufwand als Funktion von Drehzahl und relativer Drallklappenposition" MAP 0xC95D6 Kf_Xs16_Ys16_Ws16 2.000000 RatAirMass 0.00 2.000000 FORMAT "%8.6" EXTENDED_LIMITS -327.6800 327.6700
 /begin AXIS_DESCR STD_AXIS Eng_nAvrg EngN 10 0.00 6000.000 FORMAT "%8.3" EXTENDED_LIMITS -32768.00 32767.00 DEPOSIT ABSOLUTE /end AXIS_DESCR
 /begin AXIS_DESCR STD_AXIS ASMod_rRelPosVSA DtyCyc 10 0.00 100.0000 FORMAT "%8.4" EXTENDED_LIMITS -327.6800 327.6700 DEPOSIT ABSOLUTE /end AXIS_DESCR
/end CHARACTERISTIC
/begin CHARACTERISTIC ASMod_phiSOIRef_MAP "Referenz des Spritzbeginns der MI1 als Funktion der Dehzahl und der verbrannten Kraftstoffmenge" MAP 0xC936C Kf_Xs16_Ys16_Ws16 60.00000 AngleCrS -19.99219 40.00781 FORMAT "%8.5" EXTENDED_LIMITS -768.0000 767.9766
 /begin AXIS_DESCR STD_AXIS Eng_nAvrg EngN 8 0.00 6000.000 FORMAT "%8.3" EXTENDED_LIMITS -32768.00 32767.00 DEPOSIT ABSOLUTE /end AXIS_DESCR
 /begin AXIS_DESCR STD_AXIS ASMod_qLmbdCtlCorr_mp InjMass 8 0.00 150.0000 FORMAT "%8.4" EXTENDED_LIMITS -327.6800 327.6700 DEPOSIT ABSOLUTE /end AXIS_DESCR
/end CHARACTERISTIC
/begin CHARACTERISTIC ASMod_swtT_C "Schalter für Lufttemperatursenor (0 = Aufnahme der Lufttemperatur vom HFM6 Sensor, 1 = Lufttemperatur nach Kühler)" VALUE 0xC96CA Kw_Wu8 1.000 OneToOne 0.00 1.000 FORMAT "%5.3" EXTENDED_LIMITS 0.00 255.0 /end CHARACTERISTIC
/begin CHARACTERISTIC ASMod_tDiffEng_MAP "Grundkennfeld der Temperaturerhöhung als Funktion der Drehzahl und der verbrannten Kraftstoffmenge" MAP 0xC9410 Kf_Xs16_Ys16_Ws16 1200.000 TempDiff_Cels -600.0000 600.0000 FORMAT "%8.4" EXTENDED_LIMITS -3276.800 3276.700
 /begin AXIS_DESCR STD_AXIS Eng_nAvrg EngN 8 0.00 6000.000 FORMAT "%8.3" EXTENDED_LIMITS -32768.00 32767.00 DEPOSIT ABSOLUTE /end AXIS_DESCR
 /begin AXIS_DESCR STD_AXIS ASMod_qBurned_mp InjMass 8 0.00 150.0000 FORMAT "%8.4" EXTENDED_LIMITS -327.6800 327.6700 DEPOSIT ABSOLUTE /end AXIS_DESCR
/end CHARACTERISTIC
/begin CHARACTERISTIC ASMod_tEngCorTDiff_CUR "Korrektur der Temperaturerhöhung aufgrund der Motortemperatur" CURVE 0xC94B4 Kl_Xs16_Ws16 950.0000 Temp_Cels -50.1400 899.8600 FORMAT "%8.4" EXTENDED_LIMITS -3549.8000 3003.7000
 /begin AXIS_DESCR STD_AXIS ASMod_tEngCorTDiff_mp TempDiff_Cels 8 -20.00000 120.0000 FORMAT "%8.4" EXTENDED_LIMITS -3276.800 3276.700 DEPOSIT ABSOLUTE /end AXIS_DESCR
/end CHARACTERISTIC
/begin CHARACTERISTIC ASMod_tEngRef_C "Referenz der Motoretemperatur" VALUE 0xC94D6 Kw_Ws16 950.0000 Temp_Cels -50.1400 899.8600 FORMAT "%8.4" EXTENDED_LIMITS -3549.940 3003.560 /end CHARACTERISTIC
/begin CHARACTERISTIC ASMod_tiDT1_C "Zeitkonstante des DT1-Glieds in der Funktion Einlaßvolumen (induction volume)" VALUE 0xC94D8 Kw_Wu32 4.9499617 TimeDelay_s 0.050000201 4.9999619 FORMAT "%9.7" EXTENDED_LIMITS 0.0000010000000 4294.9673 /end CHARACTERISTIC
/begin CHARACTERISTIC ASMod_tIndAirRef_MAP "Referenz der Gastemperatur vor Einlass als Funktion von Drehzahl und aktueller Einspritzmenge" MAP 0xC96CC Kf_Xs16_Ys16_Ws16 250.0000 Temp_Cels -50.1400 199.8600 FORMAT "%8.4" EXTENDED_LIMITS -3549.940 3003.560
 /begin AXIS_DESCR STD_AXIS Eng_nAvrg EngN 10 0.00 6000.000 FORMAT "%8.3" EXTENDED_LIMITS -32768.00 32767.00 DEPOSIT ABSOLUTE /end AXIS_DESCR
 /begin AXIS_DESCR STD_AXIS InjCtl_qCurr InjMassCyc 10 0.00 327.6700 FORMAT "%8.4" EXTENDED_LIMITS -327.6800 327.6700 DEPOSIT ABSOLUTE /end AXIS_DESCR
/end CHARACTERISTIC
/begin CHARACTERISTIC ASMod_volEng_C "Hubvolumen des Motors" VALUE 0xC97C0 Kw_Ws16 20.00000 Vol 0.00 20.00000 FORMAT "%8.5" EXTENDED_LIMITS -327.6800 327.6700 /end CHARACTERISTIC
/begin CHARACTERISTIC ASMod_volIndVol_C "Einlaßvolumen (effektives Volumen zwischen Turbolader und Mischstelle)" VALUE 0xC94DC Kw_Ws16 50.00000 Vol 0.00 50.00000 FORMAT "%8.5" EXTENDED_LIMITS -327.6800 327.6700 /end CHARACTERISTIC
/begin CHARACTERISTIC BattCD_uSRCMin_C "SRC-Min der Batteriespannung" VALUE 0xC97C4 Kw_Ws16 5200.391 Volt 0.00 5200.391 FORMAT "%8.3" EXTENDED_LIMITS -160156.4 160151.5 /end CHARACTERISTIC
/begin CHARACTERISTIC BattCD_uSRCMax_C "SRC-Max der Batteriespannung" VALUE 0xC97C6 Kw_Ws16 5200.391 Volt 0.00 5200.391 FORMAT "%8.3" EXTENDED_LIMITS -160156.4 160151.5 /end CHARACTERISTIC
/begin CHARACTERISTIC BattCD_uLin_CUR "Linearisierungskennlinie" CURVE 0xC97C8 Kl_Xs16_Ws16 28602.15 Volt_Batt 0.00 28602.15 FORMAT "%8.2" EXTENDED_LIMITS -640625.6 640606.1
 /begin AXIS_DESCR STD_AXIS BattCD_uRaw Volt 2 0.00 5200.391 FORMAT "%8.3" EXTENDED_LIMITS -160156.4 160151.5 DEPOSIT ABSOLUTE /end AXIS_DESCR
/end CHARACTERISTIC
/begin CHARACTERISTIC BattCD_DebSRCHighDef_C "Entprellzeit für Fehlererkennung des SRC-High-Fehlers der Batteriespannung" VALUE 0xC97D2 Kw_Wu16 655350.0 Time_ms 0.00 655350.0 FORMAT "%8.1" /end CHARACTERISTIC
/begin CHARACTERISTIC BattCD_DebSRCHighOk_C "Entprellzeit für Heilung des SRC-High-Fehlers der Batteriespannung" VALUE 0xC97D4 Kw_Wu16 655350.0 Time_ms 0.00 655350.0 FORMAT "%8.1" /end CHARACTERISTIC
/begin CHARACTERISTIC BattCD_DebSRCLowDef_C "Entprellzeit für Fehlererkennung des SRC-Low-Fehlers der Batteriespannung" VALUE 0xC97D6 Kw_Wu16 655350.0 Time_ms 0.00 655350.0 FORMAT "%8.1" /end CHARACTERISTIC
/begin CHARACTERISTIC BattCD_DebSRCLowOk_C "Entprellzeit für Heilung des SRC-Low-Fehlers der Batteriespannung" VALUE 0xC97D8 Kw_Wu16 655350.0 Time_ms 0.00 655350.0 FORMAT "%8.1" /end CHARACTERISTIC
/begin CHARACTERISTIC BattCD_numAdc_C "Applikationsparameter" VALUE 0xC97DA Kw_Wu8 60.0000000000 NumPinAdc 0.00 60.0000000000 FORMAT "%13.10" /end CHARACTERISTIC
/begin CHARACTERISTIC BattCD_duRmpSlpUp_C "Rampe Zunahme Batteriespannung negative Steigung" VALUE 0xC97DC Kw_Wu32 1281250244.02 RmpVoltBatt 977.576769459 1281251221.60 FORMAT "%13.2" EXTENDED_LIMITS 0.00 1281251221.60 /end CHARACTERISTIC
/begin CHARACTERISTIC BattCD_duRmpSlpDwn_C "Rampe Zunahme Batteriespannung positive Steigung" VALUE 0xC97E0 Kw_Wu32 1281250244.02 RmpVoltBatt 977.576769459 1281251221.60 FORMAT "%13.2" EXTENDED_LIMITS 0.00 1281251221.60 /end CHARACTERISTIC
/begin CHARACTERISTIC BattCD_stSensIDWord_C "Kennung Batteriespannungserfassung" VALUE 0xC97E4 Kw_Wu16 65535.00 OneToOne 0.00 65535.00 FORMAT "%8.2" /end CHARACTERISTIC
/begin CHARACTERISTIC BattCD_uDfl_C "Vorgabewert Batteriespannung" VALUE 0xC97E6 Kw_Ws16 28602.15 Volt_Batt 0.00 28602.15 FORMAT "%8.2" EXTENDED_LIMITS -640625.6 640606.1 /end CHARACTERISTIC
/begin CHARACTERISTIC Batt_uNrm_C "Normierte Batteriespannung" VALUE 0xC97C2 Kw_Ws16 1281232. Volt_Batt -640625.6 640606.1 FORMAT "%8.1" /end CHARACTERISTIC
/begin CHARACTERISTIC BPACD_ctPwrStgOnMax2_C "Maximum der Endstufe 2 aktivierungen im Fahrzyklus bei SCB oder Übertemperatur Fehler" VALUE 0xC97E8 Kw_Wu16 65535.00 OneToOne 0.00 65535.00 FORMAT "%8.2" /end CHARACTERISTIC
/begin CHARACTERISTIC BPACD_ctPwrStgOnMax_C "Maximum der Endstufen aktivierungen im Fahrzyklus bei SCB oder Übertemperatur Fehler" VALUE 0xC97EA Kw_Wu16 65535.00 OneToOne 0.00 65535.00 FORMAT "%8.2" /end CHARACTERISTIC
/begin CHARACTERISTIC BPACD_tiDebBPADia1v2Def_C " debounce duration for boost pressure actor diagnosis error detection" VALUE 0xC97EC Kw_Wu16 655350.0 Time_ms 0.00 655350.0 FORMAT "%8.1" /end CHARACTERISTIC
/begin CHARACTERISTIC BPACD_tiDebBPADia1v2Ok_C "debounce duration for boost pressure actor diagnosis error healing" VALUE 0xC97EE Kw_Wu16 655350.0 Time_ms 0.00 655350.0 FORMAT "%8.1" /end CHARACTERISTIC
/begin CHARACTERISTIC BPACD_tiDebBPADia1Def_C "debounce duration for boost pressure actor diagnosis error detection" VALUE 0xC97F0 Kw_Wu16 655350.0 Time_ms 0.00 655350.0 FORMAT "%8.1" /end CHARACTERISTIC
/begin CHARACTERISTIC BPACD_tiDebBPADia1Ok_C "debounce duration for boost pressure actor diagnosis error healing" VALUE 0xC97F2 Kw_Wu16 655350.0 Time_ms 0.00 655350.0 FORMAT "%8.1" /end CHARACTERISTIC
/begin CHARACTERISTIC BPACD_tiDebBPADia2v2Def_C "debounce duration for boost pressure actor diagnosis error detection" VALUE 0xC97F4 Kw_Wu16 655350.0 Time_ms 0.00 655350.0 FORMAT "%8.1" /end CHARACTERISTIC
/begin CHARACTERISTIC BPACD_tiDebBPADia2v2Ok_C "debounce duration for boost pressure actor diagnosis error healing" VALUE 0xC97F6 Kw_Wu16 655350.0 Time_ms 0.00 655350.0 FORMAT "%8.1" /end CHARACTERISTIC
/begin CHARACTERISTIC BPACD_tiDebBPADia2Def_C "debounce duration for boost pressure actor diagnosis error detection" VALUE 0xC97F8 Kw_Wu16 655350.0 Time_ms 0.00 655350.0 FORMAT "%8.1" /end CHARACTERISTIC
/begin CHARACTERISTIC BPACD_tiDebBPADia2Ok_C "debounce duration for boost pressure actor diagnosis error healing" VALUE 0xC97FA Kw_Wu16 655350.0 Time_ms 0.00 655350.0 FORMAT "%8.1" /end CHARACTERISTIC
/begin CHARACTERISTIC BPACD_tiDebBPADia3v2Def_C "debounce duration for boost pressure actor diagnosis error detection" VALUE 0xC97FC Kw_Wu16 655350.0 Time_ms 0.00 655350.0 FORMAT "%8.1" /end CHARACTERISTIC
/begin CHARACTERISTIC BPACD_tiDebBPADia3v2Ok_C "debounce duration for boost pressure actor diagnosis error healing" VALUE 0xC97FE Kw_Wu16 655350.0 Time_ms 0.00 655350.0 FORMAT "%8.1" /end CHARACTERISTIC
/begin CHARACTERISTIC BPACD_tiDebBPADia3Def_C "debounce duration for boost pressure actor diagnosis error detection" VALUE 0xC9800 Kw_Wu16 655350.0 Time_ms 0.00 655350.0 FORMAT "%8.1" /end CHARACTERISTIC
/begin CHARACTERISTIC BPACD_tiDebBPADia3Ok_C "debounce duration for boost pressure actor diagnosis error healing" VALUE 0xC9802 Kw_Wu16 655350.0 Time_ms 0.00 655350.0 FORMAT "%8.1" /end CHARACTERISTIC
/begin CHARACTERISTIC BPACD_tiDebBPADia4v2Def_C "Defektentprellzeit für Fensterdiagnose 4 auf v2" VALUE 0xC9804 Kw_Wu16 655350.0 Time_ms 0.00 655350.0 FORMAT "%8.1" /end CHARACTERISTIC
/begin CHARACTERISTIC BPACD_tiDebBPADia4v2Ok_C "Heilentprellzeit für Fensterdiagnose 4" VALUE 0xC9806 Kw_Wu16 655350.0 Time_ms 0.00 655350.0 FORMAT "%8.1" /end CHARACTERISTIC
/begin CHARACTERISTIC BPACD_tiDebBPADia4Def_C "Defektentprellzeit für Fensterdiagnose 4" VALUE 0xC9808 Kw_Wu16 655350.0 Time_ms 0.00 655350.0 FORMAT "%8.1" /end CHARACTERISTIC
/begin CHARACTERISTIC BPACD_tiDebBPADia4Ok_C "Heilentprellzeit für Fensterdiagnose 4" VALUE 0xC980A Kw_Wu16 655350.0 Time_ms 0.00 655350.0 FORMAT "%8.1" /end CHARACTERISTIC
/begin CHARACTERISTIC BPACD_DebExcTemp2Def_C "Fehlerentprellzeit für Übertemperatur 2" VALUE 0xC980C Kw_Wu16 655350.0 Time_ms 0.00 655350.0 FORMAT "%8.1" /end CHARACTERISTIC
/begin CHARACTERISTIC BPACD_DebExcTemp2Ok_C "Heilungsentprellzeit für Übertemperatur 2" VALUE 0xC980E Kw_Wu16 655350.0 Time_ms 0.00 655350.0 FORMAT "%8.1" /end CHARACTERISTIC
/begin CHARACTERISTIC BPACD_DebExcTempDef_C "Fehlerentprellzeit für Übertemperatur" VALUE 0xC9810 Kw_Wu16 655350.0 Time_ms 0.00 655350.0 FORMAT "%8.1" /end CHARACTERISTIC
/begin CHARACTERISTIC BPACD_DebExcTempOk_C "Heilungsentprellzeit für Übertemperatur" VALUE 0xC9812 Kw_Wu16 655350.0 Time_ms 0.00 655350.0 FORMAT "%8.1" /end CHARACTERISTIC
/begin CHARACTERISTIC BPACD_DebNoLoad2Def_C "Fehlerentprellzeit für Lastabfall 2" VALUE 0xC9814 Kw_Wu16 655350.0 Time_ms 0.00 655350.0 FORMAT "%8.1" /end CHARACTERISTIC
/begin CHARACTERISTIC BPACD_DebNoLoad2Ok_C "Heilungsentprellzeit für Lastabfall 2" VALUE 0xC9816 Kw_Wu16 655350.0 Time_ms 0.00 655350.0 FORMAT "%8.1" /end CHARACTERISTIC
/begin CHARACTERISTIC BPACD_DebNoLoadDef_C "Fehlerentprellzeit für Lastabfall" VALUE 0xC9818 Kw_Wu16 655350.0 Time_ms 0.00 655350.0 FORMAT "%8.1" /end CHARACTERISTIC
/begin CHARACTERISTIC BPACD_DebNoLoadOk_C "Heilungsentprellzeit für Lastabfall" VALUE 0xC981A Kw_Wu16 655350.0 Time_ms 0.00 655350.0 FORMAT "%8.1" /end CHARACTERISTIC
/begin CHARACTERISTIC BPACD_DebShortCircBat2Def_C "Fehlerentprellzeitzeit für Kurzschluß nach Batteriespannung 2" VALUE 0xC981C Kw_Wu16 655350.0 Time_ms 0.00 655350.0 FORMAT "%8.1" /end CHARACTERISTIC
/begin CHARACTERISTIC BPACD_DebShortCircBat2Ok_C "Heilungsentprellzeit für Kurzschluß nach Batteriespannung 2" VALUE 0xC981E Kw_Wu16 655350.0 Time_ms 0.00 655350.0 FORMAT "%8.1" /end CHARACTERISTIC
/begin CHARACTERISTIC BPACD_DebShortCircBatDef_C "Fehlerentprellzeitzeit für Kurzschluß nach Batteriespannung" VALUE 0xC9820 Kw_Wu16 655350.0 Time_ms 0.00 655350.0 FORMAT "%8.1" /end CHARACTERISTIC
/begin CHARACTERISTIC BPACD_DebShortCircBatOk_C "Heilungsentprellzeit für Kurzschluß nach Batteriespannung" VALUE 0xC9822 Kw_Wu16 655350.0 Time_ms 0.00 655350.0 FORMAT "%8.1" /end CHARACTERISTIC
/begin CHARACTERISTIC BPACD_DebShortCircGnd2Def_C "Fehlerentprellzeit für Kurzschluß nach Masse 2" VALUE 0xC9824 Kw_Wu16 655350.0 Time_ms 0.00 655350.0 FORMAT "%8.1" /end CHARACTERISTIC
/begin CHARACTERISTIC BPACD_DebShortCircGnd2Ok_C "Heilungsentprellzeit für Kurzschluß nach Masse 2" VALUE 0xC9826 Kw_Wu16 655350.0 Time_ms 0.00 655350.0 FORMAT "%8.1" /end CHARACTERISTIC
/begin CHARACTERISTIC BPACD_DebShortCircGndDef_C "Fehlerentprellzeit für Kurzschluß nach Masse" VALUE 0xC9828 Kw_Wu16 655350.0 Time_ms 0.00 655350.0 FORMAT "%8.1" /end CHARACTERISTIC
/begin CHARACTERISTIC BPACD_DebShortCircGndOk_C "Heilungsentprellzeit für Kurzschluß nach Masse" VALUE 0xC982A Kw_Wu16 655350.0 Time_ms 0.00 655350.0 FORMAT "%8.1" /end CHARACTERISTIC
/begin CHARACTERISTIC BPACD_numDia2_C "Applikationsparameter für Ladedrucksteller 2-Diagnosesignal" VALUE 0xC982C Kw_Wu8 33.0000000000 NumPinDia 0.00 33.0000000000 FORMAT "%13.10" /end CHARACTERISTIC
/begin CHARACTERISTIC BPACD_numDia_C "Applikationsparameter fuer Diagnose Signal :BP-Steller" VALUE 0xC982D Kw_Wu8 33.0000000000 NumPinDia 0.00 33.0000000000 FORMAT "%13.10" /end CHARACTERISTIC
/begin CHARACTERISTIC BPACD_numPwmOut2_C "Applikationsparameter für Ladedrucksteller 2" VALUE 0xC982E Kw_Wu8 13.0000000000 NumPinPwmOut 0.00 13.0000000000 FORMAT "%13.10" /end CHARACTERISTIC
/begin CHARACTERISTIC BPACD_numPwmOut_C "Applikationsparameter fuer Ladedruck-Steller" VALUE 0xC982F Kw_Wu8 13.0000000000 NumPinPwmOut 0.00 13.0000000000 FORMAT "%13.10" /end CHARACTERISTIC
/begin CHARACTERISTIC BPACD_stInvOut2_C "Invertierungsparameter für das Signal 2 der Ladedruckstellerendstufe" VALUE 0xC9830 Kw_Wu8 1.000 OneToOne 0.00 1.000 FORMAT "%5.3" EXTENDED_LIMITS 0.00 255.0 /end CHARACTERISTIC
/begin CHARACTERISTIC BPACD_tiPer2_C "Periodendauer Ladedrucksteller 2." VALUE 0xC9832 Kw_Ws16 10.60000 Period 1.100000 11.70000 FORMAT "%8.5" EXTENDED_LIMITS -3276.800 3276.700 /end CHARACTERISTIC
/begin CHARACTERISTIC BPACD_stInvOut_C "Invertierungsparameter für das Signal der Ladedruckstellerendstufe" VALUE 0xC9834 Kw_Wu8 1.000 OneToOne 0.00 1.000 FORMAT "%5.3" EXTENDED_LIMITS 0.00 255.0 /end CHARACTERISTIC
/begin CHARACTERISTIC BPACD_tiPer_C "Periodendauer Ladedrucksteller." VALUE 0xC9836 Kw_Ws16 10.60000 Period 1.100000 11.70000 FORMAT "%8.5" EXTENDED_LIMITS -3276.800 3276.700 /end CHARACTERISTIC
/begin CHARACTERISTIC BPACD_rCnv2_CUR "Kennlinie zur konvertierung von Öffnungsgrad 2 in Tastverhältnis" CURVE 0xC9838 Kl_Xs16_Ws16 100.0000 DtyCyc 0.00 100.0000 FORMAT "%8.4" EXTENDED_LIMITS -327.6800 327.6700
 /begin AXIS_DESCR STD_AXIS BPA_rBPA2 Prc 25 -100.0000 200.0000 FORMAT "%8.4" EXTENDED_LIMITS -400.0000 399.9878 DEPOSIT ABSOLUTE /end AXIS_DESCR
/end CHARACTERISTIC
/begin CHARACTERISTIC BPACD_rCnv_CUR "Kennlinie zur konvertierung von Öffnungsgrad in Tastverhältnis" CURVE 0xC989E Kl_Xs16_Ws16 100.0000 DtyCyc 0.00 100.0000 FORMAT "%8.4" EXTENDED_LIMITS -327.6800 327.6700
 /begin AXIS_DESCR STD_AXIS BPA_rBPACD Prc 25 -100.0000 200.0000 FORMAT "%8.4" EXTENDED_LIMITS -400.0000 399.9878 DEPOSIT ABSOLUTE /end AXIS_DESCR
/end CHARACTERISTIC
/begin CHARACTERISTIC BPACD_rOutMax2_C "Maximal auszugebendes Tastverhältnis LDS 2" VALUE 0xC9904 Kw_Ws16 655.3500 DtyCyc -327.6800 327.6700 FORMAT "%8.4" /end CHARACTERISTIC
/begin CHARACTERISTIC BPACD_rOutMax_C "Maximal auszugebendes Tastverhältnis" VALUE 0xC9906 Kw_Ws16 655.3500 DtyCyc -327.6800 327.6700 FORMAT "%8.4" /end CHARACTERISTIC
/begin CHARACTERISTIC BPACD_rOutMin2_C "Minimal auszugebendes Tastverhältnis LDS_2" VALUE 0xC9908 Kw_Ws16 655.3500 DtyCyc -327.6800 327.6700 FORMAT "%8.4" /end CHARACTERISTIC
/begin CHARACTERISTIC BPACD_rOutMin_C "Minimal auszugebendes Tastverhältnis" VALUE 0xC990A Kw_Ws16 655.3500 DtyCyc -327.6800 327.6700 FORMAT "%8.4" /end CHARACTERISTIC
/begin CHARACTERISTIC BPACD_rTst2_C "Tastverhältnis 2, dass im Fehlerfall zyklisch ausgegeben wird" VALUE 0xC990C Kw_Ws16 100.0000 DtyCyc 0.00 100.0000 FORMAT "%8.4" EXTENDED_LIMITS -327.6800 327.6700 /end CHARACTERISTIC
/begin CHARACTERISTIC BPACD_rTst_C "Tastverhältnis, dass im Fehlerfall zyklisch ausgegeben wird" VALUE 0xC990E Kw_Ws16 100.0000 DtyCyc 0.00 100.0000 FORMAT "%8.4" EXTENDED_LIMITS -327.6800 327.6700 /end CHARACTERISTIC
/begin CHARACTERISTIC BPACD_stPwrStgActv2_C "Aktivierung der Abschaltbedingungen der Endstufe 2" VALUE 0xC9910 Kw_Wu8 255.0 OneToOne 0.00 255.0 FORMAT "%5.1" /end CHARACTERISTIC
/begin CHARACTERISTIC BPACD_stPwrStgActv_C "Aktivierung der Abschaltbedingungen der Endstufe" VALUE 0xC9911 Kw_Wu8 255.0 OneToOne 0.00 255.0 FORMAT "%5.1" /end CHARACTERISTIC
/begin CHARACTERISTIC BPACD_stPwrStgDia2_C "Aktivierung der Abschaltbedingungen der Endstufediagnose 2" VALUE 0xC9912 Kw_Wu8 255.0 OneToOne 0.00 255.0 FORMAT "%5.1" /end CHARACTERISTIC
/begin CHARACTERISTIC BPACD_stPwrStgDia_C "Aktivierung der Abschaltbedingungen der Endstufediagnose" VALUE 0xC9913 Kw_Wu8 255.0 OneToOne 0.00 255.0 FORMAT "%5.1" /end CHARACTERISTIC
/begin CHARACTERISTIC BPACD_stSPICtl2_C "Parameter zur Auswahl des Endstufentypes  ( 1 = SPI Endstufe, 0 = Nicht SPI Endstufe )" VALUE 0xC9914 Kw_Wu8 1.000 OneToOne 0.00 1.000 FORMAT "%5.3" EXTENDED_LIMITS 0.00 255.0 /end CHARACTERISTIC
/begin CHARACTERISTIC BPACD_stSPICtl_C "Parameter zur Auswahl des Endstufentypes  ( 1 = SPI Endstufe, 0 = Nicht SPI Endstufe )" VALUE 0xC9915 Kw_Wu8 1.000 OneToOne 0.00 1.000 FORMAT "%5.3" EXTENDED_LIMITS 0.00 255.0 /end CHARACTERISTIC
/begin CHARACTERISTIC BPACD_swt2_C "Schalter für Batteriespannungskorrektur 2 (0 = AUS, 1 = EIN)" VALUE 0xC9916 Kw_Wu8 255.0 OneToOne 0.00 255.0 FORMAT "%5.1" /end CHARACTERISTIC
/begin CHARACTERISTIC BPACD_swt_C "Schalter für Batteriespannungskorrektur (0 = AUS, 1 = EIN)" VALUE 0xC9917 Kw_Wu8 255.0 OneToOne 0.00 255.0 FORMAT "%5.1" /end CHARACTERISTIC
/begin CHARACTERISTIC BPACD_tiBtwTst2_C "Zeitabstand, in dem im Fehlerfall die Endstufe 2 getestet wird" VALUE 0xC9918 Kw_Wu16 29980.00 Time_ms 20.00000 30000.00 FORMAT "%8.2" EXTENDED_LIMITS 0.00 655350.0 /end CHARACTERISTIC
/begin CHARACTERISTIC BPACD_tiBtwTst_C "Zeitabstand, in dem im Fehlerfall die Endstufe getestet wird" VALUE 0xC991A Kw_Wu16 29980.00 Time_ms 20.00000 30000.00 FORMAT "%8.2" EXTENDED_LIMITS 0.00 655350.0 /end CHARACTERISTIC
/begin CHARACTERISTIC BPACD_tiDiag1Max2_C "window 1 max. time" VALUE 0xC991C Kw_Wu16 655350.0 Time_ms 0.00 655350.0 FORMAT "%8.1" /end CHARACTERISTIC
/begin CHARACTERISTIC BPACD_tiDiag1Max_C "window 1 max. time" VALUE 0xC991E Kw_Wu16 655350.0 Time_ms 0.00 655350.0 FORMAT "%8.1" /end CHARACTERISTIC
/begin CHARACTERISTIC BPACD_tiDiag1Min2_C "window 1 min. time" VALUE 0xC9920 Kw_Wu16 655350.0 Time_ms 0.00 655350.0 FORMAT "%8.1" /end CHARACTERISTIC
/begin CHARACTERISTIC BPACD_tiDiag1Min_C "window 1 min. time" VALUE 0xC9922 Kw_Wu16 655350.0 Time_ms 0.00 655350.0 FORMAT "%8.1" /end CHARACTERISTIC
/begin CHARACTERISTIC BPACD_tiDiag2Max2_C "window 2 max. time" VALUE 0xC9924 Kw_Wu16 655350.0 Time_ms 0.00 655350.0 FORMAT "%8.1" /end CHARACTERISTIC
/begin CHARACTERISTIC BPACD_tiDiag2Max_C "window 2 max. time" VALUE 0xC9926 Kw_Wu16 655350.0 Time_ms 0.00 655350.0 FORMAT "%8.1" /end CHARACTERISTIC
/begin CHARACTERISTIC BPACD_tiDiag2Min2_C "window 2 min. time" VALUE 0xC9928 Kw_Wu16 655350.0 Time_ms 0.00 655350.0 FORMAT "%8.1" /end CHARACTERISTIC
/begin CHARACTERISTIC BPACD_tiDiag2Min_C "window 2 min. time" VALUE 0xC992A Kw_Wu16 655350.0 Time_ms 0.00 655350.0 FORMAT "%8.1" /end CHARACTERISTIC
/begin CHARACTERISTIC BPACD_tiDiag3Max2_C "window 3 max. time" VALUE 0xC992C Kw_Wu16 655350.0 Time_ms 0.00 655350.0 FORMAT "%8.1" /end CHARACTERISTIC
/begin CHARACTERISTIC BPACD_tiDiag3Max_C "window 3 max. time" VALUE 0xC992E Kw_Wu16 655350.0 Time_ms 0.00 655350.0 FORMAT "%8.1" /end CHARACTERISTIC
/begin CHARACTERISTIC BPACD_tiDiag3Min2_C "window 3 min. time" VALUE 0xC9930 Kw_Wu16 655350.0 Time_ms 0.00 655350.0 FORMAT "%8.1" /end CHARACTERISTIC
/begin CHARACTERISTIC BPACD_tiDiag3Min_C "window 3 min. time" VALUE 0xC9932 Kw_Wu16 655350.0 Time_ms 0.00 655350.0 FORMAT "%8.1" /end CHARACTERISTIC
/begin CHARACTERISTIC BPACD_tiDiag4Max2_C "Maximale Zeit für Fensterdiagnose 4 auf 2" VALUE 0xC9934 Kw_Wu16 655350.0 Time_ms 0.00 655350.0 FORMAT "%8.1" /end CHARACTERISTIC
/begin CHARACTERISTIC BPACD_tiDiag4Max_C "Maximale Zeit für Fensterdiagnose 4" VALUE 0xC9936 Kw_Wu16 655350.0 Time_ms 0.00 655350.0 FORMAT "%8.1" /end CHARACTERISTIC
/begin CHARACTERISTIC BPACD_tiDiag4Min2_C "Minimale Zeit für Fensterdiagnose 4 auf 2" VALUE 0xC9938 Kw_Wu16 655350.0 Time_ms 0.00 655350.0 FORMAT "%8.1" /end CHARACTERISTIC
/begin CHARACTERISTIC BPACD_tiDiag4Min_C "Minimale Zeit für Fensterdiagnose 4" VALUE 0xC993A Kw_Wu16 655350.0 Time_ms 0.00 655350.0 FORMAT "%8.1" /end CHARACTERISTIC
/begin CHARACTERISTIC BPACD_tiPwrStgOn2_C "Zeit für die die Endstufe eingeschalten wird bei nicht SPI Endstufen" VALUE 0xC993C Kw_Wu16 655140.0 Time_ms 0.00 655140.0 FORMAT "%8.1" EXTENDED_LIMITS 0.00 655350.0 /end CHARACTERISTIC
/begin CHARACTERISTIC BPACD_tiPwrStgOn_C "Zeit für die die Endstufe eingeschalten wird bei nicht SPI Endstufen" VALUE 0xC993E Kw_Wu16 655140.0 Time_ms 0.00 655140.0 FORMAT "%8.1" EXTENDED_LIMITS 0.00 655350.0 /end CHARACTERISTIC
/begin CHARACTERISTIC BPA_rBPACD_Vector "Bypass-Label für BPA_rBPA" VALUE 0xC38DC Kw_Wu8 255.0 OneToOne 0.00 255.0 FORMAT "%5.1" /end CHARACTERISTIC
/begin CHARACTERISTIC BPA_rBPACD_Channel "Bypass-Label für BPA_rBPA" VALUE 0xC38DD Kw_Wu8 255.0 OneToOne 0.00 255.0 FORMAT "%5.1" /end CHARACTERISTIC
/begin CHARACTERISTIC BPA_rLPACD_Vector "Konfigurationslabel für Bypass Freischnitt" VALUE 0xC38DE Kw_Wu8 255.0 OneToOne 0.00 255.0 FORMAT "%5.1" /end CHARACTERISTIC
/begin CHARACTERISTIC BPA_rLPACD_Channel "Konfigurationslabel für Bypass Freischnitt" VALUE 0xC38DF Kw_Wu8 255.0 OneToOne 0.00 255.0 FORMAT "%5.1" /end CHARACTERISTIC
/begin CHARACTERISTIC BPSCD_uSRCMin_C "SRC-Min-Wert für Ladedruck." VALUE 0xC9940 Kw_Ws16 5200.391 Volt 0.00 5200.391 FORMAT "%8.3" EXTENDED_LIMITS -160156.4 160151.5 /end CHARACTERISTIC
/begin CHARACTERISTIC BPSCD_uSRCMax_C "SRC-Max-Wert für Ladedruck." VALUE 0xC9942 Kw_Ws16 5200.391 Volt 0.00 5200.391 FORMAT "%8.3" EXTENDED_LIMITS -160156.4 160151.5 /end CHARACTERISTIC
/begin CHARACTERISTIC BPSCD_pLin_CUR "Linearisierungskennlinie" CURVE 0xC9944 Kl_Xs16_Ws16 5000.000 Pres_hPa 0.00 5000.000 FORMAT "%8.3" EXTENDED_LIMITS -32768.00 32767.00
 /begin AXIS_DESCR STD_AXIS BPSCD_uRawVal Volt 4 0.00 5000.000 FORMAT "%8.3" EXTENDED_LIMITS -160156.4 160151.5 DEPOSIT ABSOLUTE /end AXIS_DESCR
/end CHARACTERISTIC
/begin CHARACTERISTIC BPSCD_DebNplDef_C "Fehlerentprellung Plausbilitätsfehler" VALUE 0xC9956 Kw_Wu16 655350.0 Time_ms 0.00 655350.0 FORMAT "%8.1" /end CHARACTERISTIC
/begin CHARACTERISTIC BPSCD_DebNplOK_C "Heilungsentprellung Plausbilitätsfehler" VALUE 0xC9958 Kw_Wu16 655350.0 Time_ms 0.00 655350.0 FORMAT "%8.1" /end CHARACTERISTIC
/begin CHARACTERISTIC BPSCD_DebSigDef_C "Defektentprellzeit fuer CAN Signal defekt" VALUE 0xC995A Kw_Wu16 655350.0 Time_ms 0.00 655350.0 FORMAT "%8.1" /end CHARACTERISTIC
/begin CHARACTERISTIC BPSCD_DebSigOK_C "Heilungsentprellzeit fuer CAN Signal defekt" VALUE 0xC995C Kw_Wu16 655350.0 Time_ms 0.00 655350.0 FORMAT "%8.1" /end CHARACTERISTIC
/begin CHARACTERISTIC BPSCD_DebSRCHighDef_C "Fehlerentprellzeit fuer SRC-High Fehler" VALUE 0xC995E Kw_Wu16 655350.0 Time_ms 0.00 655350.0 FORMAT "%8.1" /end CHARACTERISTIC
/begin CHARACTERISTIC BPSCD_DebSRCHighOK_C "Heilungsentprellzeit fuer SRC-High Fehler" VALUE 0xC9960 Kw_Wu16 655350.0 Time_ms 0.00 655350.0 FORMAT "%8.1" /end CHARACTERISTIC
/begin CHARACTERISTIC BPSCD_DebSRCLowDef_C "Fehlerentprellzeit fuer SRC-Low Fehler" VALUE 0xC9962 Kw_Wu16 655350.0 Time_ms 0.00 655350.0 FORMAT "%8.1" /end CHARACTERISTIC
/begin CHARACTERISTIC BPSCD_DebSRCLowOK_C "Heilungsentprellzeit fuer SRC-Low Fehler" VALUE 0xC9964 Kw_Wu16 655350.0 Time_ms 0.00 655350.0 FORMAT "%8.1" /end CHARACTERISTIC
/begin CHARACTERISTIC BPSCD_tiDT1_C "Reciprocal of time delay" VALUE 0xC9968 Kw_Wu32 4294.9663 TimeDelay_s 0.0010000001 4294.9673 FORMAT "%9.4" EXTENDED_LIMITS 0.0000010000000 4294.9673 /end CHARACTERISTIC
/begin CHARACTERISTIC BPSCD_dDT1Kd_C "Reciprocal of time delay" VALUE 0xC996C Kw_Ws32 10.0000000000 Kd 0.00 10.0000000000 FORMAT "%13.10" EXTENDED_LIMITS -32768.0000000 32767.9999847 /end CHARACTERISTIC
/begin CHARACTERISTIC BPSCD_tiLPFiltPT1_C "Zeitkonstante Tiefpass fuer Ladedruck_Fuehler" VALUE 0xC0494 Kw_Wu32 4294.9673 TimeDelay_s 0.0000010000000 4294.9673 FORMAT "%9.4" /end CHARACTERISTIC
/begin CHARACTERISTIC BPSCD_nLim_C "Obere Grenze Motordrehzahl." VALUE 0xC9970 Kw_Ws16 6000.000 EngN 0.00 6000.000 FORMAT "%8.3" EXTENDED_LIMITS -32768.00 32767.00 /end CHARACTERISTIC
/begin CHARACTERISTIC BPSCD_numAdc_C "Applikationsparameter fuer Ladedruck-Steller" VALUE 0xC9972 Kw_Wu8 60.0000000000 NumPinAdc 0.00 60.0000000000 FORMAT "%13.10" /end CHARACTERISTIC
/begin CHARACTERISTIC BPSCD_pDiffLim_C "Grenzwert für absolute Differenz zwischen LD und AD" VALUE 0xC9974 Kw_Ws16 3500.000 Pres_hPa 0.00 3500.000 FORMAT "%8.3" EXTENDED_LIMITS -32768.00 32767.00 /end CHARACTERISTIC
/begin CHARACTERISTIC BPSCD_tiOutValDT1_C "Totzeit für  Ladedruck DT1 filter" VALUE 0xC9978 Kw_Wu32 4294.9673 TimeDelay_s 0.0000010000000 4294.9673 FORMAT "%9.4" /end CHARACTERISTIC
/begin CHARACTERISTIC BPSCD_dDT1KdOutVal_C "Verstärkungskonstante des DT1 filters für  Ladedrucksignal" VALUE 0xC997C Kw_Ws32 32767.9999847 Kd 0.00 32767.9999847 FORMAT "%13.7" EXTENDED_LIMITS -32768.0000000 32767.9999847 /end CHARACTERISTIC
/begin CHARACTERISTIC BPSCD_tiPT1_C "Verzugszeit. (für PT1 Filter )" VALUE 0xC9980 Kw_Wu32 4294.9673 TimeDelay_s 0.0000010000000 4294.9673 FORMAT "%9.4" /end CHARACTERISTIC
/begin CHARACTERISTIC BPSCD_dpRmpSlpUp_C "Rampensteigung bei Heilung/Vorgabewert für LDF" VALUE 0xC9984 Kw_Wu32 65535899.9786 RmpPres_hPa 100.006103516 65535999.9847 FORMAT "%13.4" EXTENDED_LIMITS 0.00 65535999.9847 /end CHARACTERISTIC
/begin CHARACTERISTIC BPSCD_dpRmpSlpDwn_C "Rampensteigung bei Heilung/Vorgabewert für LDF" VALUE 0xC9988 Kw_Wu32 65535899.9786 RmpPres_hPa 100.006103516 65535999.9847 FORMAT "%13.4" EXTENDED_LIMITS 0.00 65535999.9847 /end CHARACTERISTIC
/begin CHARACTERISTIC BPSCD_swtSigVal_C "Schalter ob Signal ueber CAN/ADC (0 = ADC, 1 = CAN)" VALUE 0xC998C Kw_Wu8 1.000 OneToOne 0.00 1.000 FORMAT "%5.3" EXTENDED_LIMITS 0.00 255.0 /end CHARACTERISTIC
/begin CHARACTERISTIC BPSCD_stSensIDWord_C "Geberkennwort LDF" VALUE 0xC998E Kw_Wu16 65535.00 OneToOne 0.00 65535.00 FORMAT "%8.2" /end CHARACTERISTIC
/begin CHARACTERISTIC BPSCD_pDfl_C "Ladedruck Vorgabewert" VALUE 0xC9990 Kw_Ws16 65535.00 Pres_hPa -32768.00 32767.00 FORMAT "%8.2" /end CHARACTERISTIC
/begin CHARACTERISTIC BrkCD_ctUnPlausDef_C "Defektschwelle dese Unplausibilitätszählers" VALUE 0xC9994 Kw_Wu8 255.0 OneToOne 0.00 255.0 FORMAT "%5.1" /end CHARACTERISTIC
/begin CHARACTERISTIC BrkCD_DebSigDef_C "Entprellzeit für CAN-Signal Defekterkennung" VALUE 0xC9996 Kw_Wu16 655350.0 Time_ms 0.00 655350.0 FORMAT "%8.1" /end CHARACTERISTIC
/begin CHARACTERISTIC BrkCD_DebSigOk_C "Entprellzeit für Heilung des CAN-Signalfehler" VALUE 0xC9998 Kw_Wu16 655350.0 Time_ms 0.00 655350.0 FORMAT "%8.1" /end CHARACTERISTIC
/begin CHARACTERISTIC BrkCD_tiMnSwtDebNeg_C "Entprellzeit Bremskontakt - abfallende Flanke" VALUE 0xC999A Kw_Wu16 655350.0 TimeDeb 0.00 655350.0 FORMAT "%8.1" /end CHARACTERISTIC
/begin CHARACTERISTIC BrkCD_tiMnSwtDebPos_C "Entprellzeit Bremskontakt - aufsteigende Flanke" VALUE 0xC999C Kw_Wu16 655350.0 TimeDeb 0.00 655350.0 FORMAT "%8.1" /end CHARACTERISTIC
/begin CHARACTERISTIC BrkCD_numDioInMn_C "Applikationsparameter fuer Bremspedal" VALUE 0xC999E Kw_Wu8 12.0000000000 NumPinDioIn 0.00 12.0000000000 FORMAT "%13.10" /end CHARACTERISTIC
/begin CHARACTERISTIC BrkCD_numDioInRed_C "Apllikationsparameter fuer redundante Bremssignal" VALUE 0xC999F Kw_Wu8 12.0000000000 NumPinDioIn 0.00 12.0000000000 FORMAT "%13.10" /end CHARACTERISTIC
/begin CHARACTERISTIC BrkCD_tiRedSwtDebNeg_C "Entprellzeit redundanter Bremskontakt - abfallende Flanke" VALUE 0xC99A0 Kw_Wu16 655350.0 TimeDeb 0.00 655350.0 FORMAT "%8.1" /end CHARACTERISTIC
/begin CHARACTERISTIC BrkCD_tiRedSwtDebPos_C "Entprellzeit redundanter Bremskontakt - aufsteigende Flanke" VALUE 0xC99A2 Kw_Wu16 655350.0 TimeDeb 0.00 655350.0 FORMAT "%8.1" /end CHARACTERISTIC
/begin CHARACTERISTIC BrkCD_stDflVal_C "Redundanter Bremskontakt-Vorgabewert" VALUE 0xC99A4 Kw_Wu8 3.000 OneToOne 0.00 3.000 FORMAT "%5.3" EXTENDED_LIMITS 0.00 255.0 /end CHARACTERISTIC
/begin CHARACTERISTIC BrkCD_stMnSwtInvIn_C "Signal Bremskontakt invertiert" VALUE 0xC99A5 Kw_Wu8 1.000 OneToOne 0.00 1.000 FORMAT "%5.3" EXTENDED_LIMITS 0.00 255.0 /end CHARACTERISTIC
/begin CHARACTERISTIC BrkCD_stRedSwtInvIn_C "Signal redundanter Bremskontakt invertiert" VALUE 0xC99A6 Kw_Wu8 1.000 OneToOne 0.00 1.000 FORMAT "%5.3" EXTENDED_LIMITS 0.00 255.0 /end CHARACTERISTIC
/begin CHARACTERISTIC BrkCD_swtRedSwtPresent_C "Schalter redundanter Bremskontakt vorhanden (1 = vorhanden, 0 = nicht vorhanden)" VALUE 0xC99A7 Kw_Wu8 1.000 OneToOne 0.00 1.000 FORMAT "%5.3" EXTENDED_LIMITS 0.00 255.0 /end CHARACTERISTIC
/begin CHARACTERISTIC BrkCD_swtSigVal_C "Schalterwert, Signal von HW DIO/CAN (1=CAN, 0=DIO)" VALUE 0xC99A8 Kw_Wu8 3.000 OneToOne 0.00 3.000 FORMAT "%5.3" EXTENDED_LIMITS 0.00 255.0 /end CHARACTERISTIC
/begin CHARACTERISTIC BrkCD_tiDebResUnPlaus_C "Entprellzeit zur Erkennung auf Plausibilität" VALUE 0xC99AA Kw_Wu16 655350.0 Time_ms 0.00 655350.0 FORMAT "%8.1" /end CHARACTERISTIC
/begin CHARACTERISTIC BrkCD_tiDebUnPlausStat_C "Entprellzeit zur Erkennung auf statische Unplausibilität" VALUE 0xC99AC Kw_Wu16 655350.0 Time_ms 0.00 655350.0 FORMAT "%8.1" /end CHARACTERISTIC
/begin CHARACTERISTIC BrkCD_tiDebUnPlaus_C "Entprellzeit zur Erkennung auf Unplausibilität" VALUE 0xC99AE Kw_Wu16 655350.0 Time_ms 0.00 655350.0 FORMAT "%8.1" /end CHARACTERISTIC
/begin CHARACTERISTIC Bss_tiDebDefect_C "Fehlerentprellzeit bei Kommunikationsfehler im BSS Interface" VALUE 0xC99B0 Kw_Wu16 655350.0 Time_ms 0.00 655350.0 FORMAT "%8.1" /end CHARACTERISTIC
/begin CHARACTERISTIC Bss_tiDebOk_C "Heilungsentprellung bei Kommunikationsfehler in BSS Interface" VALUE 0xC99B2 Kw_Wu16 655350.0 Time_ms 0.00 655350.0 FORMAT "%8.1" /end CHARACTERISTIC
/begin MEASUREMENT AirCtl_dnAvrg_mp "Drehzahlgradient der gefilterten Drehzahlbeschleunigung gegen Laderpumpen" SWORD dn_dZ20 1 100 -327680.0 327670.0 FORMAT "%8.1" ECU_ADDRESS 0x8FD3DE /end MEASUREMENT
/begin MEASUREMENT AirCtl_dnSurgeHigh_mp "Aktuelle obere Grenze für Drehzahlgradienten Hysterese" SWORD dn_dZ20 1 100 -327680.0 327670.0 FORMAT "%8.1" ECU_ADDRESS 0x8FD3E0 /end MEASUREMENT
/begin MEASUREMENT AirCtl_dnSurgeLow_mp "aktuelle untere Grenze für Drehzahlgradienten Hysterese gegen Laderpumpen" SWORD dn_dZ20 1 100 -327680.0 327670.0 FORMAT "%8.1" ECU_ADDRESS 0x8FD3E2 /end MEASUREMENT
/begin MEASUREMENT AirCtl_dqRaw_mp "Value after getting filtered(DT1 Filter) for message InjCtl_qRaw" SWORD InjMassPerSec_20ms 1 100 -16384.00 16383.50 FORMAT "%8.2" ECU_ADDRESS 0x8FD3E4 /end MEASUREMENT
/begin MEASUREMENT AirCtl_mDesMax_mp "Kalkulierte Luftmassenstrom bei geschlossener ARF" SWORD AirMassPerCyl 1 100 -3276.800 3276.700 FORMAT "%8.3" ECU_ADDRESS 0x8FD3E6 /end MEASUREMENT
/begin MEASUREMENT AirCtl_mMaxDvtRgn_mp "Obergrenze für Erkennung einer bleibenden Regelabweichung" SWORD AirMassPerCyl 1 100 -3276.800 3276.700 FORMAT "%8.3" ECU_ADDRESS 0x8FD402 /end MEASUREMENT
/begin MEASUREMENT AirCtl_mMinDvtRgn_mp "Untergrenze für Erkennung einer bleibenden Regelabwei-chung" SWORD AirMassPerCyl 1 100 -3276.800 3276.700 FORMAT "%8.3" ECU_ADDRESS 0x8FD404 /end MEASUREMENT
/begin MEASUREMENT AirCtl_qCurrRmp_mp "Meßpunkt nach Rampung der ungefilterten Einspritzmenge" SWORD InjMass 1 100 -327.6800 327.6700 FORMAT "%8.4" ECU_ADDRESS 0x8FD3E8 /end MEASUREMENT
/begin MEASUREMENT AirCtl_qSurgeHigh_mp "aktuelle obere Grenze für Mengen Hysterese gegen Laderpumpen" SWORD InjMass 1 100 -327.6800 327.6700 FORMAT "%8.4" ECU_ADDRESS 0x8FD3EA /end MEASUREMENT
/begin MEASUREMENT AirCtl_qSurgeLow_mp "aktuelle untere Grenze für Mengen Hysterese gegen Laderpumpen" SWORD InjMass 1 100 -327.6800 327.6700 FORMAT "%8.4" ECU_ADDRESS 0x8FD3EC /end MEASUREMENT
/begin MEASUREMENT AirCtl_rBrkRmp_mp "Rampen Ausgang bei Bremssignal Auswertung" SWORD Prc 1 100 -400.0000 399.9878 FORMAT "%8.4" ECU_ADDRESS 0x8FD3EE /end MEASUREMENT
/begin MEASUREMENT AirCtl_rEGRByp_mp "Bypass-Label, Kopie von AirCtl_rEGR" SWORD Prc 1 100 -400.0000 399.9878 FORMAT "%8.4" ECU_ADDRESS 0x8FD3F0 /end MEASUREMENT
/begin MEASUREMENT AirCtl_rTVAByp_mp "Bypass-Label, Kopie von AirCtl_rTVA" SWORD Prc 1 100 -400.0000 399.9878 FORMAT "%8.4" ECU_ADDRESS 0x8FD3F2 /end MEASUREMENT
/begin MEASUREMENT AirCtl_stAirCtlBits1_mp "AirCtl_stAirCtlBits_mp LowByte (->Signals)" UWORD OneToOne 1 100 0.00 65535.00 FORMAT "%8.2" ECU_ADDRESS 0x6F8002 /end MEASUREMENT
/begin MEASUREMENT AirCtl_stAirCtlBits2_mp "AirCtl_stAirCtlBits_mp HighByte (->Signals)" UWORD OneToOne 1 100 0.00 65535.00 FORMAT "%8.2" ECU_ADDRESS 0x6F8004 /end MEASUREMENT
/begin MEASUREMENT AirCtl_stAirCtlBits_mp "Anzeige der Abschaltursache in der ARF-Überwachung (bitorientiert)" ULONG OneToOne 1 100 0.00 4294967295.00 FORMAT "%13.2" ECU_ADDRESS 0x8FD3F4 /end MEASUREMENT
/begin MEASUREMENT AirCtl_stDebBrkpressed_mp "Status Entprellung Bremsung für Ausblendung ÜW neg. RA" UBYTE OneToOne 1 100 0.00 255.0 FORMAT "%5.1" ECU_ADDRESS 0x8FD3F8 /end MEASUREMENT
/begin MEASUREMENT AirCtl_stDebDefNrm_mp "Status, ob Regelabweichung im Normalbetrieb überwacht" UBYTE OneToOne 1 100 0.00 255.0 FORMAT "%5.1" ECU_ADDRESS 0x8FD406 /end MEASUREMENT
/begin MEASUREMENT AirCtl_stDebDefRgn_mp "Status, ob Regelabweichung Regenerationsbetrieb überwacht" UBYTE OneToOne 1 100 0.00 255.0 FORMAT "%5.1" ECU_ADDRESS 0x8FD407 /end MEASUREMENT
/begin MEASUREMENT AirCtl_stDebDef_mp "Statusangabe, ob Regelabweichung überwacht wird" UBYTE OneToOne 1 100 0.00 255.0 FORMAT "%5.1" ECU_ADDRESS 0x8FD3F9 /end MEASUREMENT
/begin MEASUREMENT AirCtl_stDesChk_mp "Status ob AirCtl_mDesVal Maximum überschreitet" UBYTE OneToOne 1 100 0.00 255.0 FORMAT "%5.1" ECU_ADDRESS 0x8FD3FA /end MEASUREMENT
/begin MEASUREMENT AirCtl_stGearShiftHighLoad_mp "status of gear control" UBYTE OneToOne 1 100 0.00 255.0 FORMAT "%5.1" ECU_ADDRESS 0x8FD3FB /end MEASUREMENT
/begin MEASUREMENT AirCtl_stHealDef_mp "Status, ob Heilung von erkannter bleibender Regelabweichung zulässig" UBYTE OneToOne 1 100 0.00 255.0 FORMAT "%5.1" ECU_ADDRESS 0x8FD3FC /end MEASUREMENT
/begin MEASUREMENT AirCtl_stMonOffNegDev_mp "Ausblendung Überwachung neg. Regelabweichung" UBYTE OneToOne 1 100 0.00 255.0 FORMAT "%5.1" ECU_ADDRESS 0x8FD3FD /end MEASUREMENT
/begin MEASUREMENT AirCtl_stPlateBreak_mp "State for plate break" UBYTE OneToOne 1 100 0.00 255.0 FORMAT "%5.1" ECU_ADDRESS 0x8FD3FE /end MEASUREMENT
/begin MEASUREMENT AirCtl_tiStrtDel_mp "Zeit, in der die Regelung nach Startabwurf abgeschaltet bleibt" UWORD Time_ms 1 100 0.00 655350.0 FORMAT "%8.1" ECU_ADDRESS 0x8FD400 /end MEASUREMENT
/begin MEASUREMENT AirSys_stCmpntActv "Statusvariable für Endstufenabschaltung" UWORD OneToOne 1 100 0.00 65535.00 FORMAT "%8.2" ECU_ADDRESS 0x7F8B30 /end MEASUREMENT
/begin MEASUREMENT AirSys_stTstDem "Statusvariable für Stellertest bei Diagnoseeingriff" UWORD OneToOne 1 100 0.00 65535.00 FORMAT "%8.2" ECU_ADDRESS 0x7F8B32 /end MEASUREMENT
/begin MEASUREMENT AltCD_rAltLoad "Linearisiertes und fehlerentprelltes Generatorlastsignals" SWORD Prc 1 100 -400.0000 399.9878 FORMAT "%8.4" ECU_ADDRESS 0x7F8B34 /end MEASUREMENT
/begin MEASUREMENT AltCD_stAltCtl_mp "Spannungsregelung - Status" UBYTE OneToOne 1 100 0.00 255.0 FORMAT "%5.1" ECU_ADDRESS 0x8FD40E /end MEASUREMENT
/begin MEASUREMENT AltCD_stErrAlt "Generator Fehlerbits" UBYTE OneToOne 1 100 0.00 255.0 FORMAT "%5.1" ECU_ADDRESS 0x7F87DB /end MEASUREMENT
/begin MEASUREMENT AltCD_stGenManuFak "message manufacturer of alternator" UBYTE OneToOne 1 100 0.00 255.0 FORMAT "%5.1" ECU_ADDRESS 0x7F87DC /end MEASUREMENT
/begin MEASUREMENT AltCD_stGenTypKenn "message alternator type" UBYTE OneToOne 1 100 0.00 255.0 FORMAT "%5.1" ECU_ADDRESS 0x7F87DD /end MEASUREMENT
/begin MEASUREMENT AltCD_stLROff_mp "status of load response switch off" UBYTE OneToOne 1 100 0.00 255.0 FORMAT "%5.1" ECU_ADDRESS 0x8FD40F /end MEASUREMENT
/begin MEASUREMENT AltCD_stStrtTraMod_mp "Status der Wechselstromerzeugerspannung Standardwert für Energieeinsparung-Transportmodus" UBYTE OneToOne 1 100 0.00 255.0 FORMAT "%5.1" ECU_ADDRESS 0x8FD410 /end MEASUREMENT
/begin MEASUREMENT AltCD_stT61 "" UBYTE OneToOne 1 100 0.00 255.0 FORMAT "%5.1" ECU_ADDRESS 0x7F87DE /end MEASUREMENT
/begin MEASUREMENT AltCD_tiLR_mp "Load Response Time, vom Generator zurückgelesener Wert" UWORD Time_s 1 100 0.00 655.3500 FORMAT "%8.4" ECU_ADDRESS 0x8FD412 /end MEASUREMENT
/begin MEASUREMENT AltCD_uAlt "Generatorspannungs-Sollwert, vom Generator zurückgelesener Wert" SWORD Volt_Batt 1 100 -640625.6 640606.1 FORMAT "%8.1" ECU_ADDRESS 0x7F8B36 /end MEASUREMENT
/begin MEASUREMENT AltCD_uAltLim_mp "Spannung eingang zu AltCD/BSS vom PwrMng(normal-Modus) oder Spannung eingang zu AltCD/BSS vom Energieeinsparung-Transportmodus" SWORD Volt_Batt 1 100 -640625.6 640606.1 FORMAT "%8.1" ECU_ADDRESS 0x8FD414 /end MEASUREMENT
/begin MEASUREMENT AltCD_uAltTraMod_mp "WechselstromerzeugerSpannung Standardwert für Energieeinsparung-Transportmodus" SWORD Volt_Batt 1 100 -640625.6 640606.1 FORMAT "%8.1" ECU_ADDRESS 0x8FD416 /end MEASUREMENT
/begin MEASUREMENT AltCD_uAlt_mp "Generatorspannungs-Sollwert, vom Generator zurückgelesener Wert" SWORD Volt_Batt 1 100 -640625.6 640606.1 FORMAT "%8.1" ECU_ADDRESS 0x8FD418 /end MEASUREMENT
/begin MEASUREMENT Alt_n_mp "Drehzahl für Leistungsbedarfberechnung Generator" SWORD EngN 1 100 -32768.00 32767.00 FORMAT "%8.2" ECU_ADDRESS 0x8FD408 /end MEASUREMENT
/begin MEASUREMENT Alt_pwrDes "mechanischer Leistungsbedarf des Generators" SWORD Pwr 1 100 -308831.1 308821.7 FORMAT "%8.1" ECU_ADDRESS 0x7F8B38 /end MEASUREMENT
/begin MEASUREMENT Alt_pwrLead "Vorhaltleistung des Generators" SWORD Pwr 1 100 -308831.1 308821.7 FORMAT "%8.1" ECU_ADDRESS 0x7F8B3A /end MEASUREMENT
/begin MEASUREMENT Alt_pwrUnCor_mp "Generator Leistungsbedarf vor Korrektur" SWORD Pwr 1 100 -308831.1 308821.7 FORMAT "%8.1" ECU_ADDRESS 0x8FD40A /end MEASUREMENT
/begin MEASUREMENT Alt_rAdjVal_mp "Abgleichwert" SWORD Fact 1 100 -4.000000 3.999878 FORMAT "%8.6" ECU_ADDRESS 0x8FD40C /end MEASUREMENT
/begin MEASUREMENT AOHtCD_rOut_mp "Meßpunkt fuer korrigiertes Tastverhaeltnis der Zuheizeransteuerung" SWORD DtyCyc 1 100 -327.6800 327.6700 FORMAT "%8.4" ECU_ADDRESS 0x6F8008 /end MEASUREMENT
/begin MEASUREMENT AOHtCD_stHtgReq "Heizleistungsanforderung von Hardware-Pin (Heizungssteuerung)" UBYTE OneToOne 1 100 0.00 255.0 FORMAT "%5.1" ECU_ADDRESS 0x7F87BF /end MEASUREMENT
/begin MEASUREMENT AOHt_nMin "Minimum Leerlaufsolldrehzahlanforderung durch Zuheizer" SWORD EngN 1 100 -32768.00 32767.00 FORMAT "%8.2" ECU_ADDRESS 0x7F8AA0 /end MEASUREMENT
/begin MEASUREMENT AOHt_rAltLd_mp "Ausgang - Generatorlastkennlinie" SWORD DtyCyc 1 100 -327.6800 327.6700 FORMAT "%8.4" ECU_ADDRESS 0x8FD41A /end MEASUREMENT
/begin MEASUREMENT AOHt_rHtgOut "Heizleitungsanforderung, Zuheizer (Tastverhältnis)" SWORD DtyCyc 1 100 -327.6800 327.6700 FORMAT "%8.4" ECU_ADDRESS 0x7F8AA2 /end MEASUREMENT
/begin MEASUREMENT AOHt_rIGov_mp "I-Anteil des PI-Reglers" SWORD DtyCyc 1 100 -327.6800 327.6700 FORMAT "%8.4" ECU_ADDRESS 0x8FD41C /end MEASUREMENT
/begin MEASUREMENT AOHt_rNAvrgDeb_mp "PT1 gefilterter Motordrehzahl-TV-Wert" SWORD DtyCyc 1 100 -327.6800 327.6700 FORMAT "%8.4" ECU_ADDRESS 0x8FD41E /end MEASUREMENT
/begin MEASUREMENT AOHt_rNAvrg_mp "umgerechnete Motordrehzahl (in %-TV) - nach Kennlinie" SWORD DtyCyc 1 100 -327.6800 327.6700 FORMAT "%8.4" ECU_ADDRESS 0x8FD420 /end MEASUREMENT
/begin MEASUREMENT AOHt_rPGov_mp "P-Anteil des PI-Reglers" SWORD DtyCyc 1 100 -327.6800 327.6700 FORMAT "%8.4" ECU_ADDRESS 0x8FD422 /end MEASUREMENT
/begin MEASUREMENT AOHt_rPI_mp "Eingangsgroesse des PI-Reglers (Regelabweichung)" SWORD DtyCyc 1 100 -327.6800 327.6700 FORMAT "%8.4" ECU_ADDRESS 0x8FD424 /end MEASUREMENT
/begin MEASUREMENT AOHt_stAC_mp "States of ACceleration logic" UBYTE OneToOne 1 100 0.00 255.0 FORMAT "%5.1" ECU_ADDRESS 0x8FD426 /end MEASUREMENT
/begin MEASUREMENT AOHt_stDA_mp "States of Drive Away logic" UBYTE OneToOne 1 100 0.00 255.0 FORMAT "%5.1" ECU_ADDRESS 0x8FD427 /end MEASUREMENT
/begin MEASUREMENT AOHt_stHtgUp "Warmlaufzustand des Motors" UBYTE OneToOne 1 100 0.00 255.0 FORMAT "%5.1" ECU_ADDRESS 0x7F87C0 /end MEASUREMENT
/begin MEASUREMENT AOHt_stShutOff_mp "Überblick auf alle Abschaltbedingungen" UWORD OneToOne 1 100 0.00 65535.00 FORMAT "%8.2" ECU_ADDRESS 0x6F8006 /end MEASUREMENT
/begin MEASUREMENT AOHt_tEnvLin_mp "Umgebungstemperatur nach Kennlinie" SWORD Temp_Cels 1 100 -50.140 899.860 FORMAT "%8.3" ECU_ADDRESS 0x8FD428 /end MEASUREMENT
/begin MEASUREMENT APPCD_drAPP1UnFlt "Differenz der Fahrpedal 1 Position ungefilterter Wert" SWORD PrcPerSec 1 100 -20000.00 19999.39 FORMAT "%8.2" ECU_ADDRESS 0x7F8AA4 /end MEASUREMENT
/begin MEASUREMENT APPCD_rAPP1UnFlt "Fahrpedal 1 position ungefilterter Rohwert" SWORD Prc 1 100 -400.0000 399.9878 FORMAT "%8.4" ECU_ADDRESS 0x7F8AA6 /end MEASUREMENT
/begin MEASUREMENT APPCD_rFlt "gefiltertes Pedalwertgebersignal" SWORD Prc 1 100 -400.0000 399.9878 FORMAT "%8.4" ECU_ADDRESS 0x7F8AA8 /end MEASUREMENT
/begin MEASUREMENT APPCD_rFlt_mp "gefilterter PWG Positions Wert ohne PTO Eingriff" SWORD Prc 1 100 -400.0000 399.9878 FORMAT "%8.4" ECU_ADDRESS 0x8FD42A /end MEASUREMENT
/begin MEASUREMENT APPCD_rNextThr "Berechneter Wert des nächsten Schwellwertes" SWORD Prc 1 100 -400.0000 399.9878 FORMAT "%8.4" ECU_ADDRESS 0x7F8AAA /end MEASUREMENT
/begin MEASUREMENT APPCD_rStepLim_mp "Limitierter Stufen-Wert" SWORD Prc 1 100 -400.0000 399.9878 FORMAT "%8.4" ECU_ADDRESS 0x8FD42C /end MEASUREMENT
/begin MEASUREMENT APPCD_stAPP12def_mp "Messpunkt für unentprellten Gleichlauffehler APP1/APP2" UBYTE OneToOne 1 100 0.00 255.0 FORMAT "%5.1" ECU_ADDRESS 0x8FD42E /end MEASUREMENT
/begin MEASUREMENT APPCD_stErr1_mp "Fehlerzustand von APP1/2 Signal" UWORD OneToOne 1 100 0.00 65535.00 FORMAT "%8.2" ECU_ADDRESS 0x8FD430 /end MEASUREMENT
/begin MEASUREMENT APPCD_stKickDown "Kick Down Zustand des Fahrpedals" UBYTE OneToOne 1 100 0.00 255.0 FORMAT "%5.1" ECU_ADDRESS 0x7F87C1 /end MEASUREMENT
/begin MEASUREMENT APPCD_stLimp "Status Notfahrbetrieb APP" UBYTE OneToOne 1 100 0.00 255.0 FORMAT "%5.1" ECU_ADDRESS 0x7F87C2 /end MEASUREMENT
/begin MEASUREMENT APPCD_stPos "Status der PWG Position" UBYTE OneToOne 1 100 0.00 255.0 FORMAT "%5.1" ECU_ADDRESS 0x7F87C3 /end MEASUREMENT
/begin MEASUREMENT APPCD_stSigSrc "Status der ausgewaehlten Signalquelle APP" UBYTE OneToOne 1 100 0.00 255.0 FORMAT "%5.1" ECU_ADDRESS 0x7F87C4 /end MEASUREMENT
/begin MEASUREMENT APPCD_stTempErr_mp "Messpunkt für vorläufigen APP-Fehler" UBYTE OneToOne 1 100 0.00 255.0 FORMAT "%5.1" ECU_ADDRESS 0x8FD432 /end MEASUREMENT
/begin MEASUREMENT APPCD_stTempHeal_mp "Messpunkt für die vorläufig geheilten APP1/APP2 Fehler" UBYTE OneToOne 1 100 0.00 255.0 FORMAT "%5.1" ECU_ADDRESS 0x8FD433 /end MEASUREMENT
/begin MEASUREMENT APPCD_uAPPunJit_mp "Messpunkt der  APP Rohspannung vor Entjitterung" SWORD Volt 1 100 -160156.4 160151.5 FORMAT "%8.1" ECU_ADDRESS 0x8FD434 /end MEASUREMENT
/begin MEASUREMENT APPCD_uDiffMax_mp "Maximal zulässige Differenz der Rohspannungen" SWORD Volt 1 100 -160156.4 160151.5 FORMAT "%8.1" ECU_ADDRESS 0x8FD436 /end MEASUREMENT
/begin MEASUREMENT APPCD_uRawAPP1 "Fahrpedal 1 Position Rohwert" SWORD Volt 1 100 -160156.4 160151.5 FORMAT "%8.1" ECU_ADDRESS 0x7F8AAC /end MEASUREMENT
/begin MEASUREMENT APPCD_uRawAPP1half_mp "Halbierte APP1 Rohspannung" SWORD Volt 1 100 -160156.4 160151.5 FORMAT "%8.1" ECU_ADDRESS 0x8FD438 /end MEASUREMENT
/begin MEASUREMENT APPCD_uRawAPP2 "Fahrpedal 2 Position Rohwert" SWORD Volt 1 100 -160156.4 160151.5 FORMAT "%8.1" ECU_ADDRESS 0x7F8AAE /end MEASUREMENT
/begin MEASUREMENT APPCD_uRawAPP2dbl_mp "Verdoppelte APP2 Rohspannung" SWORD Volt 1 100 -160156.4 160151.5 FORMAT "%8.1" ECU_ADDRESS 0x8FD43A /end MEASUREMENT
/begin MEASUREMENT APPCD_uRawDiff_mp "Betrag der Differenz der Rohspannungen von APP1 und APP2" SWORD Volt 1 100 -160156.4 160151.5 FORMAT "%8.1" ECU_ADDRESS 0x8FD43C /end MEASUREMENT
/begin MEASUREMENT APPCD_uRaw_mp "Messpunkt der ausgewaehlten APP Rohspannung" SWORD Volt 1 100 -160156.4 160151.5 FORMAT "%8.1" ECU_ADDRESS 0x8FD43E /end MEASUREMENT
/begin MEASUREMENT APSCD_BpsAllowed_mp "Wahlschalter - Atmosphaerendruck gemessen (wenn verbaut) od. gerechnet von Ladedrucksensor" UWORD OneToOne 1 100 0.00 65535.00 FORMAT "%8.2" ECU_ADDRESS 0x8FD440 /end MEASUREMENT
/begin MEASUREMENT APSCD_pCorVal_mp "Korrekturwert fuer Atmosphaerendruck von Ladedrucksensor" SWORD Pres_hPa 1 100 -32768.00 32767.00 FORMAT "%8.2" ECU_ADDRESS 0x8FD442 /end MEASUREMENT
/begin MEASUREMENT APSCD_pLinVal "Rohwert Atmosphärendruck über ADC" SWORD Pres_hPa 1 100 -32768.00 32767.00 FORMAT "%8.2" ECU_ADDRESS 0x7F8AB0 /end MEASUREMENT
/begin MEASUREMENT APSCD_pPhyVal_mp "Rohwert Atmosphärendruck über ADC" SWORD Pres_hPa 1 100 -32768.00 32767.00 FORMAT "%8.2" ECU_ADDRESS 0x8FD444 /end MEASUREMENT
/begin MEASUREMENT APSCD_pSensorVal "Atmosphaerendruck Sensorwert" SWORD Pres_hPa 1 100 -32768.00 32767.00 FORMAT "%8.2" ECU_ADDRESS 0x7F8AB2 /end MEASUREMENT
/begin MEASUREMENT APSCD_pVal "Atmosphärendruck" SWORD Pres_hPa 1 100 -32768.00 32767.00 FORMAT "%8.2" ECU_ADDRESS 0x7F8AB4 /end MEASUREMENT
/begin MEASUREMENT APSCD_stSensorInst "Status, ob Atmosphärendrucksensor eingebaut ist (0 == nicht eingebaut)" UBYTE OneToOne 1 100 0.00 255.0 FORMAT "%5.1" ECU_ADDRESS 0x7F87C5 /end MEASUREMENT
/begin MEASUREMENT APSCD_swtSig "Atmosphaerendruck Funktionsschalter - Signalwert von CAN od. ADC" UBYTE OneToOne 1 100 0.00 255.0 FORMAT "%5.1" ECU_ADDRESS 0x7F87C6 /end MEASUREMENT
/begin MEASUREMENT APSCD_uRaw "Rohspannung ADC-Signal Atmosphärendruck" SWORD Volt 1 100 -160156.4 160151.5 FORMAT "%8.1" ECU_ADDRESS 0x7F8AB6 /end MEASUREMENT
/begin MEASUREMENT ARS_pwrDes "Current power requirement of ARS module" SWORD Pwr 1 100 -308831.1 308821.7 FORMAT "%8.1" ECU_ADDRESS 0x7F8AB8 /end MEASUREMENT
/begin MEASUREMENT ARS_pwrLead "Current power requirement of ARS module for monitoring" SWORD Pwr 1 100 -308831.1 308821.7 FORMAT "%8.1" ECU_ADDRESS 0x7F8ABA /end MEASUREMENT
/begin MEASUREMENT ARS_st "Status of power requirement of ARS" UBYTE OneToOne 1 100 0.00 255.0 FORMAT "%5.1" ECU_ADDRESS 0x7F87C7 /end MEASUREMENT
/begin MEASUREMENT ARS_stRecARS "Status of ARS detection" UBYTE OneToOne 1 100 0.00 255.0 FORMAT "%5.1" ECU_ADDRESS 0x7F87C8 /end MEASUREMENT
/begin MEASUREMENT ARS_trqCor_mp "Corrected current torque" SWORD Trq 1 100 -3276.800 3276.700 FORMAT "%8.3" ECU_ADDRESS 0x8FD446 /end MEASUREMENT
/begin MEASUREMENT ARS_trqCurMax_mp "corrected maximum torque" SWORD Trq 1 100 -3276.800 3276.700 FORMAT "%8.3" ECU_ADDRESS 0x8FD448 /end MEASUREMENT
/begin MEASUREMENT ARS_trqDesMax_mp "Maximum desired torque" SWORD Trq 1 100 -3276.800 3276.700 FORMAT "%8.3" ECU_ADDRESS 0x8FD44A /end MEASUREMENT
/begin MEASUREMENT ARS_trqDesOld_mp "Desired torque of previous cycle" SWORD Trq 1 100 -3276.800 3276.700 FORMAT "%8.3" ECU_ADDRESS 0x8FD44C /end MEASUREMENT
/begin MEASUREMENT ARS_trqDes_mp "Desired torque after correction" SWORD Trq 1 100 -3276.800 3276.700 FORMAT "%8.3" ECU_ADDRESS 0x8FD44E /end MEASUREMENT
/begin MEASUREMENT ASDdc_KdCurr_mp "Aktueller Parameter Kd des Störungsreglers" FLOAT32_IEEE ASD_GvrnDT1Kd_float 1 100 -1.00000000 100.000000 FORMAT "%10.6" ECU_ADDRESS 0x8FD450 /end MEASUREMENT
/begin MEASUREMENT ASDdc_nAvrg_mp "Motordrehzahl für die Parametersatzauswahl beim ASDdc" SWORD EngN 1 100 -32768.00 32767.00 FORMAT "%8.2" ECU_ADDRESS 0x8FD458 /end MEASUREMENT
/begin MEASUREMENT ASDdc_stCluPS_mp "Kupplungs PS aktiv/nicht aktiv" UBYTE OneToOne 1 100 0.00 255.0 FORMAT "%5.1" ECU_ADDRESS 0x8FD45A /end MEASUREMENT
/begin MEASUREMENT ASDdc_stCond_mp "Zustand der Eingangsbedingungen" UWORD OneToOne 1 100 0.00 65535.00 FORMAT "%8.2" ECU_ADDRESS 0x8FD45C /end MEASUREMENT
/begin MEASUREMENT ASDdc_stPrioState_mp "Primärzustand mit der höchsten Priorität" UWORD OneToOne 1 100 0.00 65535.00 FORMAT "%8.2" ECU_ADDRESS 0x8FD45E /end MEASUREMENT
/begin MEASUREMENT ASDdc_stREinit_mp "Zustand Reinit (deaktivieren)" UBYTE OneToOne 1 100 0.00 255.0 FORMAT "%5.1" ECU_ADDRESS 0x8FD460 /end MEASUREMENT
/begin MEASUREMENT ASDdc_stSelectState_mp "Ausgewählter Primärzustand" UWORD ASDdcState 1 100 0.00 65535.00 FORMAT "%8.2" ECU_ADDRESS 0x8FD462 /end MEASUREMENT
/begin MEASUREMENT ASDdc_stStates_mp "Zustand der Primärzustände" UWORD OneToOne 1 100 0.00 65535.00 FORMAT "%8.2" ECU_ADDRESS 0x8FD464 /end MEASUREMENT
/begin MEASUREMENT ASDdc_T1Curr_mp "Aktueller Parameter T1 des Störungsreglers" FLOAT32_IEEE ASD_GvrnDT1T1_float 1 100 -1.00000000 100.000000 FORMAT "%10.6" ECU_ADDRESS 0x8FD454 /end MEASUREMENT
/begin MEASUREMENT ASDdc_trq "Momentforderung Aktiver Ruckeldämpfer (Störungsregler)" SWORD Trq 1 100 -3276.800 3276.700 FORMAT "%8.3" ECU_ADDRESS 0x7F8ABC /end MEASUREMENT
/begin MEASUREMENT ASDdc_trqUnLtd_mp "Momentforderung Aktiver Ruckeldämpfer (Störungsregler) vor der Limitierung" FLOAT32_IEEE Trq_float 1 100 -50.0000000 50.0000000 FORMAT "%10.7" ECU_ADDRESS 0x8FD468 /end MEASUREMENT
/begin MEASUREMENT ASDrf_CoeffALossCurr_mp "Aktueller Kennwert für den Koeffitienten zweiter Ordnung der LSD Steigungsbegrenzung." SWORD CoeffA 1 100 -160.0000 159.9951 FORMAT "%8.4" ECU_ADDRESS 0x8FD46C /end MEASUREMENT
/begin MEASUREMENT ASDrf_CoeffBLossCurr_mp "Aktueller Kennwert für den Koeffitienten nullter Ordnung der LSD Steigungsbegrenzung." SWORD dTrq 1 100 -3276.800 3276.700 FORMAT "%8.3" ECU_ADDRESS 0x8FD46E /end MEASUREMENT
/begin MEASUREMENT ASDrf_dtrqDecMax_mp "Max. Drehmomentsteigung aufgrund der Gradientenbegrenzung bei Momentenabsenkung." SWORD dTrq 1 100 -3276.800 3276.700 FORMAT "%8.3" ECU_ADDRESS 0x8FD470 /end MEASUREMENT
/begin MEASUREMENT ASDrf_dtrqDecMin_mp "Min. Drehmomentsteigung aufgrund der Gradientenbegrenzung bei Momentenabsenkung." SWORD dTrq 1 100 -3276.800 3276.700 FORMAT "%8.3" ECU_ADDRESS 0x8FD472 /end MEASUREMENT
/begin MEASUREMENT ASDrf_dtrqInrLtd_mp "zeitliche Ableitung von CoEng_trqInrLtd" SWORD dTrq 1 100 -3276.800 3276.700 FORMAT "%8.3" ECU_ADDRESS 0x8FD474 /end MEASUREMENT
/begin MEASUREMENT ASDrf_dtrqLim_mp "durch ASDrf_dtrqInrLtdLim_CUR begrenzte zeitliche Ableitung von CoEng_trqInrLtd" SLONG dTrq 1 100 -214748364.800 214748364.700 FORMAT "%13.3" ECU_ADDRESS 0x8FD478 /end MEASUREMENT
/begin MEASUREMENT ASDrf_dtrqLossMax_mp "Maximale Drehmomentsteigung der Steigungsbegrenzung um das Verlustmoment." SWORD dTrq 1 100 -3276.800 3276.700 FORMAT "%8.3" ECU_ADDRESS 0x8FD47C /end MEASUREMENT
/begin MEASUREMENT ASDrf_dtrqLossMin_mp "Maximale Drehmomentsteigung der Steigungsbegrenzung um das Verlustmoment." SWORD dTrq 1 100 -3276.800 3276.700 FORMAT "%8.3" ECU_ADDRESS 0x8FD47E /end MEASUREMENT
/begin MEASUREMENT ASDrf_dtrqMax_mp "Max. Drehmomentsteigung in der Umgebung des Verlustmoments oder durch die Begrenzung bei Drehmomentabsenkung." SWORD dTrq 1 100 -3276.800 3276.700 FORMAT "%8.3" ECU_ADDRESS 0x8FD480 /end MEASUREMENT
/begin MEASUREMENT ASDrf_dtrqMin_mp "Min. Drehmomentsteigung in der Umgebung des Verlustmoments oder durch die Begrenzung bei Drehmomentabsenkung." SWORD dTrq 1 100 -3276.800 3276.700 FORMAT "%8.3" ECU_ADDRESS 0x8FD482 /end MEASUREMENT
/begin MEASUREMENT ASDrf_KdCurr_mp "Aktueller Parameter Kd des ARD-FF (ASDrf)" SLONG Kd 1 100 -32768.0000000 32767.9999847 FORMAT "%13.7" ECU_ADDRESS 0x8FD484 /end MEASUREMENT
/begin MEASUREMENT ASDrf_stCond_mp "Status der Eingangsbedingungen" UWORD OneToOne 1 100 0.00 65535.00 FORMAT "%8.2" ECU_ADDRESS 0x8FD4C6 /end MEASUREMENT
/begin MEASUREMENT ASDrf_stDecLimState_mp "Status des Zustandsautomaten für Steigungsbegrenzung bei Momentenabsenkung." UBYTE OneToOne 1 100 0.00 255.0 FORMAT "%5.1" ECU_ADDRESS 0x8FD488 /end MEASUREMENT
/begin MEASUREMENT ASDrf_stIncLim_mp "Aktueller Zustand für flachen(=1) / steilen(=0) Drehmoment Anstieg." SWORD OneToOne 1 100 -32768.00 32767.00 FORMAT "%8.2" ECU_ADDRESS 0x8FD48A /end MEASUREMENT
/begin MEASUREMENT ASDrf_stInit "Initialisierungsanforderungen/Quittierungen an PT1, PDT1-Glieder" UBYTE OneToOne 1 100 0.00 255.0 FORMAT "%5.1" ECU_ADDRESS 0x8FD48C /end MEASUREMENT
/begin MEASUREMENT ASDrf_stInitdtrqSteep_mp "Reinitialisierung bei Parametersatzänderung aktiv/inaktiv" UBYTE OneToOne 1 100 0.00 255.0 FORMAT "%5.1" ECU_ADDRESS 0x8FD48D /end MEASUREMENT
/begin MEASUREMENT ASDrf_stLAD "Zustandsvariable für den Automaten zur LSD Steuerung." UBYTE OneToOne 1 100 0.00 255.0 FORMAT "%5.1" ECU_ADDRESS 0x7F87C9 /end MEASUREMENT
/begin MEASUREMENT ASDrf_stPosNeg_mp "aktueller pos/neg Zustand" UBYTE OneToOne 1 100 0.00 255.0 FORMAT "%5.1" ECU_ADDRESS 0x8FD48E /end MEASUREMENT
/begin MEASUREMENT ASDrf_stPrioState_mp "Aktiver Zustand nach der Priorisierung" UWORD OneToOne 1 100 0.00 65535.00 FORMAT "%8.2" ECU_ADDRESS 0x8FD4C8 /end MEASUREMENT
/begin MEASUREMENT ASDrf_stSelectState_mp "Aktiver Zustand, genau ein Primärzustand ist aktive" UWORD ASDrfState 1 100 0.00 65535.00 FORMAT "%8.2" ECU_ADDRESS 0x8FD4CA /end MEASUREMENT
/begin MEASUREMENT ASDrf_stStates_mp "Auswertung der Primärzustände (konkurrierende Zustände möglich)" UWORD OneToOne 1 100 0.00 65535.00 FORMAT "%8.2" ECU_ADDRESS 0x8FD4CC /end MEASUREMENT
/begin MEASUREMENT ASDrf_stTrqLim_mp "Zustand der Drehmoment Gradientenbegrenzung (0=inaktiv, 1=aktiv)" UBYTE OneToOne 1 100 0.00 255.0 FORMAT "%5.1" ECU_ADDRESS 0x8FD48F /end MEASUREMENT
/begin MEASUREMENT ASDrf_T1Curr_mp "Aktueller Parameter T1 des ARD-FF (ASDrf)" ULONG TimeDelay_s 1 100 0.0000010000000 4294.9673 FORMAT "%9.4" ECU_ADDRESS 0x8FD490 /end MEASUREMENT
/begin MEASUREMENT ASDrf_trqASDSum_mp "Aktuelles ASD Moment (Berechnung abhängig von ASDrf_swtCalcTrq_C)" SWORD Trq 1 100 -3276.800 3276.700 FORMAT "%8.3" ECU_ADDRESS 0x8FD494 /end MEASUREMENT
/begin MEASUREMENT ASDrf_trqCompOfs_mp "Offset auf den PT1 Eingang zur Polkompensation." SLONG Trq 1 100 -214748364.800 214748364.700 FORMAT "%13.3" ECU_ADDRESS 0x8FD498 /end MEASUREMENT
/begin MEASUREMENT ASDrf_trqDecLimStrt_mp "Startpunkt / Scheitelpunkt für die Steigungsbegrenzung bei Drehmomentabsenkung" SWORD Trq 1 100 -3276.800 3276.700 FORMAT "%8.3" ECU_ADDRESS 0x8FD49C /end MEASUREMENT
/begin MEASUREMENT ASDrf_trqInit_mp "berechneter Initialisierungswert für PT1 Zustandsvariable" SWORD Trq 1 100 -3276.800 3276.700 FORMAT "%8.3" ECU_ADDRESS 0x8FD49E /end MEASUREMENT
/begin MEASUREMENT ASDrf_trqInr "ARD Führungsformer Momentausgang (inneres Moment)" SWORD Trq 1 100 -3276.800 3276.700 FORMAT "%8.3" ECU_ADDRESS 0x7F8ABE /end MEASUREMENT
/begin MEASUREMENT ASDrf_trqInrLtdFlt_mp "Gefiltertes Eingangssignal CoEng_trqInrLtd" SWORD Trq 1 100 -3276.800 3276.700 FORMAT "%8.3" ECU_ADDRESS 0x8FD4A0 /end MEASUREMENT
/begin MEASUREMENT ASDrf_trqInrMaxUnLim_mp "Aktuelle Obergrenze für ASDrf_trqInr vor der Begrenzung mit CoEng_trqInrLim (abhängig von ASDrf_swtLim_C)." SLONG Trq32 1 100 -3276.80000000 3276.79999847 FORMAT "%13.8" ECU_ADDRESS 0x8FD4A4 /end MEASUREMENT
/begin MEASUREMENT ASDrf_trqInrMax_mp "Max. zulässiges Moment durch Steigungsbegrenzung." SLONG Trq32 1 100 -3276.80000000 3276.79999847 FORMAT "%13.8" ECU_ADDRESS 0x8FD4A8 /end MEASUREMENT
/begin MEASUREMENT ASDrf_trqInrMinUnLim_mp "Aktuelle Untergrenze für ASDrf_trqInr vor der Begrenzung mit 0 (abhängig von ASDrf_swtLim_C)." SLONG Trq32 1 100 -3276.80000000 3276.79999847 FORMAT "%13.8" ECU_ADDRESS 0x8FD4AC /end MEASUREMENT
/begin MEASUREMENT ASDrf_trqInrMin_mp "Min. zulässiges Moment durch Steigungsbegrenzung." SLONG Trq32 1 100 -3276.80000000 3276.79999847 FORMAT "%13.8" ECU_ADDRESS 0x8FD4B0 /end MEASUREMENT
/begin MEASUREMENT ASDrf_trqInrUnLim_mp "Ausgang des PDT1-Glieds, vor der Steigungsbegrenzung des Führungsformers." SWORD Trq 1 100 -3276.800 3276.700 FORMAT "%8.3" ECU_ADDRESS 0x8FD4B4 /end MEASUREMENT
/begin MEASUREMENT ASDrf_trqLossNeg "Verlustmoment bei negativem Zustand von ASDrf_stPosNeg." SWORD Trq 1 100 -3276.800 3276.700 FORMAT "%8.3" ECU_ADDRESS 0x7F8AC0 /end MEASUREMENT
/begin MEASUREMENT ASDrf_trqLossPos "Verlustmoment bei positivem Zustand von ASDrf_stPosNeg." SWORD Trq 1 100 -3276.800 3276.700 FORMAT "%8.3" ECU_ADDRESS 0x7F8AC2 /end MEASUREMENT
/begin MEASUREMENT ASDrf_trqLoss_mp "Reibmoment inc. Nebenaggregate" SWORD Trq 1 100 -3276.800 3276.700 FORMAT "%8.3" ECU_ADDRESS 0x8FD4B6 /end MEASUREMENT
/begin MEASUREMENT ASDrf_trqPT1In_mp "aktueller PT1 Eingangswert" SLONG Trq 1 100 -214748364.800 214748364.700 FORMAT "%13.3" ECU_ADDRESS 0x8FD4B8 /end MEASUREMENT
/begin MEASUREMENT ASDrf_trqPT1Out_mp "aktueller PT1 Ausgangswert" SWORD Trq 1 100 -3276.800 3276.700 FORMAT "%8.3" ECU_ADDRESS 0x8FD4BC /end MEASUREMENT
/begin MEASUREMENT ASDrf_trqPT1P_mp "Ausgang P-Anteil in PT1 gefiltertem Signal" SWORD Trq 1 100 -3276.800 3276.700 FORMAT "%8.3" ECU_ADDRESS 0x8FD4BE /end MEASUREMENT
/begin MEASUREMENT ASDrf_trqP_mp "Ausgang ASDrf P-Anteil" SWORD Trq 1 100 -3276.800 3276.700 FORMAT "%8.3" ECU_ADDRESS 0x8FD4C0 /end MEASUREMENT
/begin MEASUREMENT ASDrf_trqStyHigh_mp "Obere Grenze des Momentenintervalls für die Erkennung eines stationären Zustands." SWORD Trq 1 100 -3276.800 3276.700 FORMAT "%8.3" ECU_ADDRESS 0x8FD4C2 /end MEASUREMENT
/begin MEASUREMENT ASDrf_trqStyLow_mp "Untere Grenze des Momentenintervalls für die Erkennung eines stationären Zustands." SWORD Trq 1 100 -3276.800 3276.700 FORMAT "%8.3" ECU_ADDRESS 0x8FD4C4 /end MEASUREMENT
/begin MEASUREMENT ASMod_dmAirPerTimeCorr "dynamisch korrigierter Frischluftmassenstrom vor Mischstelle" SWORD AirMassPerTime 1 100 -3276.800 3276.700 FORMAT "%8.3" ECU_ADDRESS 0x7F8AC4 /end MEASUREMENT
/begin MEASUREMENT ASMod_dmEGR_mp "rückgeführter Abgasmassenstrom" SWORD AirMassPerTime 1 100 -3276.800 3276.700 FORMAT "%8.3" ECU_ADDRESS 0x8FD4CE /end MEASUREMENT
/begin MEASUREMENT ASMod_dmEG_mp "Abgasmassenstrom nach Verbrennung" SWORD AirMassPerTime 1 100 -3276.800 3276.700 FORMAT "%8.3" ECU_ADDRESS 0x8FD4D8 /end MEASUREMENT
/begin MEASUREMENT ASMod_dmExhMnfPre "Abgasmassenstrom am Eintritt des Abgaskrümmers" SWORD AirMassPerTime 1 100 -3276.800 3276.700 FORMAT "%8.3" ECU_ADDRESS 0x7F8AC6 /end MEASUREMENT
/begin MEASUREMENT ASMod_dmExhMnfPst "Abgasmassenstrom am Austritt des Abgaskrümmers" SWORD AirMassPerTime 1 100 -3276.800 3276.700 FORMAT "%8.3" ECU_ADDRESS 0x7F8AC8 /end MEASUREMENT
/begin MEASUREMENT ASMod_dmFlBurned_mp "Massenstrom des verbrannten Kraftstoffs" SWORD InjMassPerTime 1 100 -327.6800 327.6700 FORMAT "%8.4" ECU_ADDRESS 0x8FD4DA /end MEASUREMENT
/begin MEASUREMENT ASMod_dmFlPerTime_mp "eingespritzter Kraftstoffmassenstrom" SWORD InjMassPerTime 1 100 -327.6800 327.6700 FORMAT "%8.4" ECU_ADDRESS 0x8FD4DC /end MEASUREMENT
/begin MEASUREMENT ASMod_dmIndAir "Gasmassenstrom in den Motor" SWORD AirMassPerTime 1 100 -3276.800 3276.700 FORMAT "%8.3" ECU_ADDRESS 0x7F8ACA /end MEASUREMENT
/begin MEASUREMENT ASMod_dmIndAirRef "Referenz des Gasmassenstroms in den Motor während geschlossener Abgasrückführung" SWORD AirMassPerTime 1 100 -3276.800 3276.700 FORMAT "%8.3" ECU_ADDRESS 0x7F8ACC /end MEASUREMENT
/begin MEASUREMENT ASMod_dmIndAirRef_mp "Referenz des Gasmassenstroms in den Motor" SWORD AirMassPerTime 1 100 -3276.800 3276.700 FORMAT "%8.3" ECU_ADDRESS 0x8FD4DE /end MEASUREMENT
/begin MEASUREMENT ASMod_dmIndAir_mp "Gasmassenstrom in den Motor" SWORD AirMassPerTime 1 100 -3276.800 3276.700 FORMAT "%8.3" ECU_ADDRESS 0x8FD4D0 /end MEASUREMENT
/begin MEASUREMENT ASMod_dmIndVol_mp "zeitliche Änderung der Gasmasse im Ansaugvolumen" SWORD AirMassPerTime 1 100 -3276.800 3276.700 FORMAT "%8.3" ECU_ADDRESS 0x8FD4FC /end MEASUREMENT
/begin MEASUREMENT ASMod_dmO2EG_mp "Sauerstoffmassenstrom nach Verbrennung" SWORD O2MassPerTime 1 100 -327.6800 327.6700 FORMAT "%8.4" ECU_ADDRESS 0x8FD4E0 /end MEASUREMENT
/begin MEASUREMENT ASMod_dmO2IndAir "Sauerstoffmassenstrom in den Motor" SWORD O2MassPerTime 1 100 -327.6800 327.6700 FORMAT "%8.4" ECU_ADDRESS 0x7F8ACE /end MEASUREMENT
/begin MEASUREMENT ASMod_dvolIndAirRef "Referenz des Gasvolumenstroms in den Motor" SWORD AirVolPerTime 1 100 -3276.800 3276.700 FORMAT "%8.3" ECU_ADDRESS 0x7F8AD0 /end MEASUREMENT
/begin MEASUREMENT ASMod_facAMCor "Korrekturfaktor für Luftmassensignal" SWORD Fact 1 100 -4.000000 3.999878 FORMAT "%8.6" ECU_ADDRESS 0x7F8AD2 /end MEASUREMENT
/begin MEASUREMENT ASMod_facDMCorTDiff_mp "Korrekturfaktor der Temperaturerhöhung aufgrund des aktuellen Gasmassenstroms" SWORD Fact 1 100 -4.000000 3.999878 FORMAT "%8.6" ECU_ADDRESS 0x8FD4E2 /end MEASUREMENT
/begin MEASUREMENT ASMod_facSOICorTDiff_mp "Korrekturfaktor der Temperaturerhöhung aufgrund des aktuellen Spritzbeginns" SWORD Fact 1 100 -4.000000 3.999878 FORMAT "%8.6" ECU_ADDRESS 0x8FD4E4 /end MEASUREMENT
/begin MEASUREMENT ASMod_facTIndAirCor_mp "Korrekturfaktor für Luftaufwand" SWORD RatAirMass 1 100 -327.6800 327.6700 FORMAT "%8.4" ECU_ADDRESS 0x8FD500 /end MEASUREMENT
/begin MEASUREMENT ASMod_facVolEff_mp "Luftaufwand aus Grundkennfeld" SWORD RatAirMass 1 100 -327.6800 327.6700 FORMAT "%8.4" ECU_ADDRESS 0x8FD502 /end MEASUREMENT
/begin MEASUREMENT ASMod_facVSACorVolEff_mp "Korrekturfaktor für Luftaufwand aufgrund aktueller Drallklappenposition" SWORD RatAirMass 1 100 -327.6800 327.6700 FORMAT "%8.4" ECU_ADDRESS 0x8FD504 /end MEASUREMENT
/begin MEASUREMENT ASMod_mAirPerCylCorr "dynamisch korrigierte Luftmasse pro Zylinder vor Mischstelle" SWORD AirMassPerCyl 1 100 -3276.800 3276.700 FORMAT "%8.3" ECU_ADDRESS 0x7F8AD4 /end MEASUREMENT
/begin MEASUREMENT ASMod_mIndVol_mp "Gasmasse im Einlassvolumen" SWORD AirMass 1 100 -327.6800 327.6700 FORMAT "%8.4" ECU_ADDRESS 0x8FD4FE /end MEASUREMENT
/begin MEASUREMENT ASMod_phiSOIRef_mp "Referenz des Spritzbeginns der MI1" SWORD AngleCrS 1 100 -768.0000 767.9766 FORMAT "%8.4" ECU_ADDRESS 0x8FD4E6 /end MEASUREMENT
/begin MEASUREMENT ASMod_qBurned_mp "Menge des verbrannten Kraftstoffes" SWORD InjMass 1 100 -327.6800 327.6700 FORMAT "%8.4" ECU_ADDRESS 0x8FD4E8 /end MEASUREMENT
/begin MEASUREMENT ASMod_qCor "Korrekturmenge für Mengensignal" SWORD InjMass 1 100 -327.6800 327.6700 FORMAT "%8.4" ECU_ADDRESS 0x7F8AD6 /end MEASUREMENT
/begin MEASUREMENT ASMod_qLmbdCtlCorr_mp "korrigierte Lambdakontrollmenge" SWORD InjMass 1 100 -327.6800 327.6700 FORMAT "%8.4" ECU_ADDRESS 0x8FD4EA /end MEASUREMENT
/begin MEASUREMENT ASMod_rDMIndAir_mp "relative Abweichung von der Referenz des Gasmassenstroms" SWORD RatAirMass 1 100 -327.6800 327.6700 FORMAT "%8.4" ECU_ADDRESS 0x8FD4EC /end MEASUREMENT
/begin MEASUREMENT ASMod_rFlBurned_mp "Verhältnis der verbrannten zur eingespritzten Kraftstoffmasse" SWORD RatFuelMass 1 100 -327.6800 327.6700 FORMAT "%8.4" ECU_ADDRESS 0x8FD4EE /end MEASUREMENT
/begin MEASUREMENT ASMod_rLmbdRecEG "schnelles reziprokes Lambda-Signal nach Verbrennung" SWORD lambdaRecVal 1 100 -32.76800 32.76700 FORMAT "%8.5" ECU_ADDRESS 0x7F8AD8 /end MEASUREMENT
/begin MEASUREMENT ASMod_rLmbdRecExhMnfPst "reziprokes Lambdasignal am Ausgang des Abgaskrümmers" SWORD lambdaRecVal 1 100 -32.76800 32.76700 FORMAT "%8.5" ECU_ADDRESS 0x7F8ADA /end MEASUREMENT
/begin MEASUREMENT ASMod_rO2EG_mp "Sauerstoffmassenanteil des Abgases nach Verbrennung" SWORD O2 1 100 -0.3276800 0.3276700 FORMAT "%9.7" ECU_ADDRESS 0x8FD4F0 /end MEASUREMENT
/begin MEASUREMENT ASMod_rO2ExhMnfPre "Sauerstoffmassenanteil des Abgases am Eintritt des Abgaskrümmers" SWORD O2 1 100 -0.3276800 0.3276700 FORMAT "%9.7" ECU_ADDRESS 0x7F8ADC /end MEASUREMENT
/begin MEASUREMENT ASMod_rO2ExhMnfPst_mp "Sauerstoffmassenanteil des Abgases am Austritt des Abgaskrümmers" SWORD O2 1 100 -0.3276800 0.3276700 FORMAT "%9.7" ECU_ADDRESS 0x8FD4D2 /end MEASUREMENT
/begin MEASUREMENT ASMod_rO2IndAir_mp "Sauerstoffmassenanteil des Massenstroms in den Motor" SWORD O2 1 100 -0.3276800 0.3276700 FORMAT "%9.7" ECU_ADDRESS 0x8FD4D4 /end MEASUREMENT
/begin MEASUREMENT ASMod_rRelPosVSA "relative Position der Drallklappe" SWORD DtyCyc 1 100 -327.6800 327.6700 FORMAT "%8.4" ECU_ADDRESS 0x7F8ADE /end MEASUREMENT
/begin MEASUREMENT ASMod_tDiffEG_mp "Temperaturerhöhung des Gasmassenstroms durch Verbrennung" SWORD TempDiff_Cels 1 100 -3276.800 3276.700 FORMAT "%8.3" ECU_ADDRESS 0x8FD4F2 /end MEASUREMENT
/begin MEASUREMENT ASMod_tDiffEng_mp "Temperaturerhöhung des Gasmassenstroms aus dem Grundkennfeld" SWORD TempDiff_Cels 1 100 -3276.800 3276.700 FORMAT "%8.3" ECU_ADDRESS 0x8FD4F4 /end MEASUREMENT
/begin MEASUREMENT ASMod_tEG_mp "Temperatur des Abgases nach Verbrennung" SWORD Temp_Cels 1 100 -50.140 899.860 FORMAT "%8.3" ECU_ADDRESS 0x8FD4F6 /end MEASUREMENT
/begin MEASUREMENT ASMod_tEngCorTDiff_mp "Korrektur der Temperaturerhöhung aufgrund der Motortemperatur" SWORD TempDiff_Cels 1 100 -3276.800 3276.700 FORMAT "%8.3" ECU_ADDRESS 0x8FD4F8 /end MEASUREMENT
/begin MEASUREMENT ASMod_tExhMnfPre "Abgastemperatur am Eintritt des Abgaskrümmers" SWORD Temp_Cels 1 100 -50.140 899.860 FORMAT "%8.3" ECU_ADDRESS 0x7F8AE0 /end MEASUREMENT
/begin MEASUREMENT ASMod_tExhMnfPst_mp "Temperatur des Gasmassenstroms am Austritt des Abgaskrümmers" SWORD Temp_Cels 1 100 -50.140 899.860 FORMAT "%8.3" ECU_ADDRESS 0x8FD4D6 /end MEASUREMENT
/begin MEASUREMENT ASMod_tiDdTm_mp "Gaslaufzeit durch den Motor" SWORD TimeDeb 1 100 -327680.0 327670.0 FORMAT "%8.1" ECU_ADDRESS 0x8FD4FA /end MEASUREMENT
/begin MEASUREMENT ASMod_tIndAir "Temperatur des Gasmassenstroms in den Motor" SWORD Temp_Cels 1 100 -50.140 899.860 FORMAT "%8.3" ECU_ADDRESS 0x7F8AE2 /end MEASUREMENT
/begin MEASUREMENT ASMod_tIndAirRef "Referenz der Gastemperatur vor Einlass" SWORD Temp_Cels 1 100 -50.140 899.860 FORMAT "%8.3" ECU_ADDRESS 0x7F8AE4 /end MEASUREMENT
/begin MEASUREMENT ASMod_tIntakeAir_mp "Ansauglufttemperatur" SWORD Temp_Cels 1 100 -50.140 899.860 FORMAT "%8.3" ECU_ADDRESS 0x8FD506 /end MEASUREMENT
/begin MEASUREMENT BattCD_u "Batteriespannung" SWORD Volt_Batt 1 100 -640625.6 640606.1 FORMAT "%8.1" ECU_ADDRESS 0x7F8B58 /end MEASUREMENT
/begin MEASUREMENT BattCD_uLin "Linearisierter Wert der Batteriespannung" SWORD Volt_Batt 1 100 -640625.6 640606.1 FORMAT "%8.1" ECU_ADDRESS 0x7F8B5A /end MEASUREMENT
/begin MEASUREMENT BattCD_uRaw "Rohwert ADC-Signalspannung für Batteriespannung" SWORD Volt 1 100 -160156.4 160151.5 FORMAT "%8.1" ECU_ADDRESS 0x7F8B5C /end MEASUREMENT
/begin MEASUREMENT Batt_facCor "Faktor für Batteriespannungskorrektur" SWORD Fact 1 100 -4.000000 3.999878 FORMAT "%8.6" ECU_ADDRESS 0x7F8B5E /end MEASUREMENT
/begin MEASUREMENT BdInt_nMax "Schutzdrehzahl für Karosserie und Innenraum" SWORD EngN 1 100 -32768.00 32767.00 FORMAT "%8.2" ECU_ADDRESS 0x7F8B60 /end MEASUREMENT
/begin MEASUREMENT BdInt_nMin "Anforderung Leerlaufdrehzahl durch Karosserie & Innenraum" SWORD EngN 1 100 -32768.00 32767.00 FORMAT "%8.2" ECU_ADDRESS 0x7F8B62 /end MEASUREMENT
/begin MEASUREMENT BdInt_pwrDes "Leistungsanforderung Wunsch Karosserie & Innenraum" SWORD Pwr 1 100 -308831.1 308821.7 FORMAT "%8.1" ECU_ADDRESS 0x7F8B64 /end MEASUREMENT
/begin MEASUREMENT BdInt_pwrLead "Leistungsanforderung Vorhalt Karosserie & Innenraum" SWORD Pwr 1 100 -308831.1 308821.7 FORMAT "%8.1" ECU_ADDRESS 0x7F8B66 /end MEASUREMENT
/begin MEASUREMENT BPACD_rCnv2_mp "Tastverhältnis 2 basierend auf dem Ausgang des Ladedrucksreglers" SWORD DtyCyc 1 100 -327.6800 327.6700 FORMAT "%8.4" ECU_ADDRESS 0x8FD50C /end MEASUREMENT
/begin MEASUREMENT BPACD_rCnv_mp "Tastverhältnis basierend auf dem Ausgang des Ladedrucksreglers" SWORD DtyCyc 1 100 -327.6800 327.6700 FORMAT "%8.4" ECU_ADDRESS 0x8FD50E /end MEASUREMENT
/begin MEASUREMENT BPACD_rOut "Tastverhältnis zür Endstufenansteuerung" SWORD DtyCyc 1 100 -327.6800 327.6700 FORMAT "%8.4" ECU_ADDRESS 0x7F8B3E /end MEASUREMENT
/begin MEASUREMENT BPACD_rOut2 "Tastverhältnis 2 zur Endstufenansteuerung" SWORD DtyCyc 1 100 -327.6800 327.6700 FORMAT "%8.4" ECU_ADDRESS 0x7F8B40 /end MEASUREMENT
/begin MEASUREMENT BPA_rBPA2 "Oeffnungsgrad des Ladedruckstellers 2" SWORD Prc 1 100 -400.0000 399.9878 FORMAT "%8.4" ECU_ADDRESS 0x7F8B42 /end MEASUREMENT
/begin MEASUREMENT BPA_rBPAByp_mp "Bypass-Label, Kopie von BPA_rBPA" SWORD Prc 1 100 -400.0000 399.9878 FORMAT "%8.4" ECU_ADDRESS 0x8FD508 /end MEASUREMENT
/begin MEASUREMENT BPA_rBPACD "Stellgröße für Ladedrucksteller (Stellerkoordinatorausgang)" SWORD Prc 1 100 -400.0000 399.9878 FORMAT "%8.4" ECU_ADDRESS 0x7F8B44 /end MEASUREMENT
/begin MEASUREMENT BPA_rLPAByp_mp "LPACD TV rohwert vor ASCET bypass" SWORD Prc 1 100 -400.0000 399.9878 FORMAT "%8.4" ECU_ADDRESS 0x8FD50A /end MEASUREMENT
/begin MEASUREMENT BPA_rLPACD "Sollwert Ladedrucksteller Koordinator Niederdruckstufe" SWORD Prc 1 100 -400.0000 399.9878 FORMAT "%8.4" ECU_ADDRESS 0x7F8B46 /end MEASUREMENT
/begin MEASUREMENT BPSCD_dFltValDT1 "differentiated value of Filtered value of Boost pressure" SWORD dp_dZ10 1 100 -327680.0 327670.0 FORMAT "%8.1" ECU_ADDRESS 0x7F8B48 /end MEASUREMENT
/begin MEASUREMENT BPSCD_dpOutVal "Ladedruckgradient" SWORD dp_dZ10 1 100 -327680.0 327670.0 FORMAT "%8.1" ECU_ADDRESS 0x7F8B4A /end MEASUREMENT
/begin MEASUREMENT BPSCD_pFltVal "gefilterter Wert des Ladedrucks" SWORD Pres_hPa 1 100 -32768.00 32767.00 FORMAT "%8.2" ECU_ADDRESS 0x7F8B4C /end MEASUREMENT
/begin MEASUREMENT BPSCD_pIntVal "aktueller Ladedruck" SWORD Pres_hPa 1 100 -32768.00 32767.00 FORMAT "%8.2" ECU_ADDRESS 0x7F8B4E /end MEASUREMENT
/begin MEASUREMENT BPSCD_pLin "Mittelere Ladedruck-Wert (liniarisiert)" SWORD Pres_hPa 1 100 -32768.00 32767.00 FORMAT "%8.2" ECU_ADDRESS 0x7F8B50 /end MEASUREMENT
/begin MEASUREMENT BPSCD_pOutVal "Ladedruckwert" SWORD Pres_hPa 1 100 -32768.00 32767.00 FORMAT "%8.2" ECU_ADDRESS 0x7F8B52 /end MEASUREMENT
/begin MEASUREMENT BPSCD_pPhyVal "Ladedruck in diesem Zyklus" SWORD Pres_hPa 1 100 -32768.00 32767.00 FORMAT "%8.2" ECU_ADDRESS 0x7F8B54 /end MEASUREMENT
/begin MEASUREMENT BPSCD_stErr "Fehlererkennung (falls einer auftritt) des Ladedrucksensors in einem Zyklus" UBYTE OneToOne 1 100 0.00 255.0 FORMAT "%5.1" ECU_ADDRESS 0x7F87DF /end MEASUREMENT
/begin MEASUREMENT BPSCD_stPlausErr "Plausibilitaetsfehler Status ( zwischen BPSCD und APSCD )" UBYTE OneToOne 1 100 0.00 255.0 FORMAT "%5.1" ECU_ADDRESS 0x7F87E0 /end MEASUREMENT
/begin MEASUREMENT BPSCD_uRawVal "Spannungsrohwert des Ladedrucksensors" SWORD Volt 1 100 -160156.4 160151.5 FORMAT "%8.1" ECU_ADDRESS 0x7F8B56 /end MEASUREMENT
/begin MEASUREMENT BrkCD_ctUnPlaus_mp "Unplausibilitätszähler" UWORD OneToOne 1 100 0.00 65535.00 FORMAT "%8.2" ECU_ADDRESS 0x6F800A /end MEASUREMENT
/begin MEASUREMENT BrkCD_stDeb_mp "Bremskontaktschalter - Status Fehlerentprellung Plausibilitaetspruefung" UBYTE OneToOne 1 100 0.00 255.0 FORMAT "%5.1" ECU_ADDRESS 0x8FD510 /end MEASUREMENT
/begin MEASUREMENT BrkCD_stMnSwtDebVal "Digitalsignal Bremskontakt entprellt" UBYTE OneToOne 1 100 0.00 255.0 FORMAT "%5.1" ECU_ADDRESS 0x7F8800 /end MEASUREMENT
/begin MEASUREMENT BrkCD_stMnSwtLastDebVal "Letzter logischer Entprellwert vom Bremspedal" UBYTE OneToOne 1 100 0.00 255.0 FORMAT "%5.1" ECU_ADDRESS 0x7F8801 /end MEASUREMENT
/begin MEASUREMENT BrkCD_stMnSwtLogVal_mp "Digitalsignal redundanter Bremskontakt nicht entprellt" UBYTE OneToOne 1 100 0.00 255.0 FORMAT "%5.1" ECU_ADDRESS 0x8FD511 /end MEASUREMENT
/begin MEASUREMENT BrkCD_stMnSwtRawVal "Rohwert Bremskontakt nicht entprellt" UBYTE OneToOne 1 100 0.00 255.0 FORMAT "%5.1" ECU_ADDRESS 0x7F8802 /end MEASUREMENT
/begin MEASUREMENT BrkCD_stPressed "Meldung Bremse betätigt" UBYTE OneToOne 1 100 0.00 255.0 FORMAT "%5.1" ECU_ADDRESS 0x7F8803 /end MEASUREMENT
/begin MEASUREMENT BrkCD_stRedSwtDebVal "Digitalsignal redundanter Bremskontakt entprellt" UBYTE OneToOne 1 100 0.00 255.0 FORMAT "%5.1" ECU_ADDRESS 0x7F8804 /end MEASUREMENT
/begin MEASUREMENT BrkCD_stRedSwtLastDebVal "Letzter logischer Entprellwert vom redundanten Bremspedal" UBYTE OneToOne 1 100 0.00 255.0 FORMAT "%5.1" ECU_ADDRESS 0x7F8805 /end MEASUREMENT
/begin MEASUREMENT BrkCD_stRedSwtLogVal_mp "Digitalsignal redundanter Bremskontakt nicht entprellt" UBYTE OneToOne 1 100 0.00 255.0 FORMAT "%5.1" ECU_ADDRESS 0x8FD512 /end MEASUREMENT
/begin MEASUREMENT BrkCD_stRedSwtPresent "Redundanter Bremskontakt Aktivinformation" UBYTE OneToOne 1 100 0.00 255.0 FORMAT "%5.1" ECU_ADDRESS 0x7F8806 /end MEASUREMENT
/begin MEASUREMENT BrkCD_stRedSwtRawVal "Rohwert redundanter Bremskontakt nicht entprellt" UBYTE OneToOne 1 100 0.00 255.0 FORMAT "%5.1" ECU_ADDRESS 0x7F8807 /end MEASUREMENT
/begin MEASUREMENT BrkCD_stResUnPlaus_mp "Zustandsbits zum Rücksetzen der Unplausibilität" UBYTE OneToOne 1 100 0.00 255.0 FORMAT "%5.1" ECU_ADDRESS 0x8FD513 /end MEASUREMENT
/begin MEASUREMENT BrkCD_stRun_mp "Laufzeitmesspunkt" UWORD OneToOne 1 100 0.00 65535.00 FORMAT "%8.2" ECU_ADDRESS 0x8FD514 /end MEASUREMENT
/begin MEASUREMENT BrkCD_swtSig "Signalquelle Schalter - DIO/CAN" UBYTE OneToOne 1 100 0.00 255.0 FORMAT "%5.1" ECU_ADDRESS 0x7F8808 /end MEASUREMENT
/begin MEASUREMENT BrkCD_tiUnPlausBrkPres_mp "Statische Entprellzeit des Plausibilitäts-Check" UWORD Time_ms 1 100 0.00 655350.0 FORMAT "%8.1" ECU_ADDRESS 0x8FD516 /end MEASUREMENT
/begin FUNCTION airctl_monitor_uic ""
 /begin DEF_CHARACTERISTIC AirCtl_rEGRAdd_Vector AirCtl_rEGRAdd_Channel AirCtl_rEGR_Vector AirCtl_rEGR_Channel AirCtl_rTVAAdd_Vector AirCtl_rTVAAdd_Channel AirCtl_rTVA_Vector AirCtl_rTVA_Channel /end DEF_CHARACTERISTIC
 /begin OUT_MEASUREMENT AirCtl_dnAvrg_mp AirCtl_dnSurgeHigh_mp AirCtl_dnSurgeLow_mp AirCtl_dqRaw_mp AirCtl_mDesMax_mp AirCtl_qCurrRmp_mp AirCtl_qSurgeHigh_mp AirCtl_qSurgeLow_mp AirCtl_rBrkRmp_mp AirCtl_rEGRByp_mp AirCtl_rTVAByp_mp AirCtl_stAirCtlBits1_mp AirCtl_stAirCtlBits2_mp AirCtl_stAirCtlBits_mp AirCtl_stDebBrkpressed_mp AirCtl_stDebDef_mp AirCtl_stDesChk_mp AirCtl_stGearShiftHighLoad_mp AirCtl_stHealDef_mp AirCtl_stMonOffNegDev_mp AirCtl_stPlateBreak_mp AirCtl_tiStrtDel_mp /end OUT_MEASUREMENT
/end FUNCTION
/begin FUNCTION airctl_monitor_var ""
 /begin DEF_CHARACTERISTIC AirCtl_mMaxDvtRgn_MAP AirCtl_mMinDvtRgn_MAP AirCtl_qHiRgn_CUR AirCtl_qLoRgn_CUR AirCtl_rTVADflVal7_C AirCtl_rTVADflVal8B_C AirCtl_stMskLoIdl_C AirCtl_stMskOvrRun_C AirCtl_stMskQCurRgn_C AirCtl_stMskShOffRgn_C AirCtl_DebGvnrDvtRgnMaxDef2_C AirCtl_DebGvnrDvtRgnMaxOk2_C AirCtl_DebGvnrDvtRgnMaxDef_C AirCtl_DebGvnrDvtRgnMaxOk_C AirCtl_DebGvnrDvtRgnMinDef2_C AirCtl_DebGvnrDvtRgnMinOk2_C AirCtl_DebGvnrDvtRgnMinDef_C AirCtl_DebGvnrDvtRgnMinOk_C /end DEF_CHARACTERISTIC
 /begin IN_MEASUREMENT Eng_nAvrg InjCtl_qCurrCor /end IN_MEASUREMENT
/end FUNCTION
/begin FUNCTION airctl_monitor_var_msg "" /end FUNCTION
/begin FUNCTION airctl_monitor_var_uic ""
 /begin OUT_MEASUREMENT AirCtl_mMaxDvtRgn_mp AirCtl_mMinDvtRgn_mp AirCtl_stDebDefNrm_mp AirCtl_stDebDefRgn_mp /end OUT_MEASUREMENT
/end FUNCTION
/begin FUNCTION airsys "Luftsystem" /begin DEF_CHARACTERISTIC AirSys_swtOLDAvisible_C /end DEF_CHARACTERISTIC /end FUNCTION
/begin FUNCTION airsys_cocmpntactv "Endstufenabschaltungskoordinator Luftsystem" /end FUNCTION
/begin FUNCTION airsys_cocmpntactv_msg "" /begin OUT_MEASUREMENT AirSys_stCmpntActv /end OUT_MEASUREMENT /end FUNCTION
/begin FUNCTION airsys_cocmpntactv_uic "" /end FUNCTION
/begin FUNCTION airsys_cotstdem_msg "" /begin OUT_MEASUREMENT AirSys_stTstDem /end OUT_MEASUREMENT /end FUNCTION
/begin FUNCTION airsys_var "" /end FUNCTION
/begin FUNCTION alt "Generator"
 /begin DEF_CHARACTERISTIC Alt_facTrans_C Alt_pwrBas_CUR Alt_pwrOffs_C Alt_rAdjValDef_C Alt_rAdjValMax_C Alt_rAdjValMin_C /end DEF_CHARACTERISTIC
 /begin IN_MEASUREMENT Alt_n_mp /end IN_MEASUREMENT
/end FUNCTION
/begin FUNCTION altcd "Komponententreiber Generator"
 /begin DEF_CHARACTERISTIC AltCD_swtGenTyp_C AltCD_swtLROff_C AltCD_tiDebDefect_C AltCD_tiDebOk_C AltCD_tiLRMax_C AltCD_tiLRMin_C AltCD_tiOutput_C AltCD_tiReset_C AltCD_uAltMax_C AltCD_uAltMin_C AltCD_uAltTraModMax_C AltCD_uAltTraModMin_C /end DEF_CHARACTERISTIC
/end FUNCTION
/begin FUNCTION altcd_msg ""
 /begin OUT_MEASUREMENT AltCD_rAltLoad AltCD_stErrAlt AltCD_stGenManuFak AltCD_stGenTypKenn AltCD_stT61 AltCD_uAlt /end OUT_MEASUREMENT
/end FUNCTION
/begin FUNCTION altcd_uic ""
 /begin OUT_MEASUREMENT AltCD_stAltCtl_mp AltCD_stLROff_mp AltCD_stStrtTraMod_mp AltCD_tiLR_mp AltCD_uAltLim_mp AltCD_uAltTraMod_mp AltCD_uAlt_mp /end OUT_MEASUREMENT
/end FUNCTION
/begin FUNCTION alt_msg "" /begin OUT_MEASUREMENT Alt_pwrDes Alt_pwrLead /end OUT_MEASUREMENT /end FUNCTION
/begin FUNCTION alt_uic "" /begin DEF_CHARACTERISTIC Alt_pwrDes_Vector Alt_pwrDes_Channel /end DEF_CHARACTERISTIC /begin OUT_MEASUREMENT Alt_n_mp Alt_pwrUnCor_mp Alt_rAdjVal_mp /end OUT_MEASUREMENT /end FUNCTION
/begin FUNCTION alt_var "" /end FUNCTION
/begin FUNCTION alt_var_uic "" /end FUNCTION
/begin FUNCTION aoht "Zuheizer"
 /begin DEF_CHARACTERISTIC AOHt_IKi_C AOHt_IKiPos_C AOHt_IKiNeg_C AOHt_rIWinPos_C AOHt_rIWinNeg_C AOHt_nAvrgHysMin_C AOHt_nAvrgHysMax_C AOHt_stNAvrgShutOffEn_C AOHt_stNAvrgShutOffDis_C AOHt_nMin_C AOHt_PKp_C AOHt_PKpPos_C AOHt_PKpNeg_C AOHt_rPWinPos_C AOHt_rPWinNeg_C AOHt_rHtgOutMax_C AOHt_rHtgOutMin_C AOHt_rIDef_C AOHt_rNAvrg_CUR AOHt_stACAccPedXLow_C AOHt_stACAccPedXHigh_C AOHt_stACAccPedYLow_C AOHt_stACAccPedYHigh_C AOHt_stACEngXLow_C AOHt_stACEngXHigh_C AOHt_stACEngYLow_C AOHt_stACEngYHigh_C AOHt_stACVehXLow_C AOHt_stACVehXHigh_C AOHt_stACVehYLow_C AOHt_stACVehYHigh_C AOHt_stDAAccPedXLow_C AOHt_stDAAccPedXHigh_C AOHt_stDAAccPedYLow_C AOHt_stDAAccPedYHigh_C AOHt_stDAEngXLow_C AOHt_stDAEngXHigh_C AOHt_stDAEngYLow_C AOHt_stDAEngYHigh_C AOHt_stDAGearXLow_C AOHt_stDAGearXHigh_C AOHt_stDAGearYLow_C AOHt_stDAGearYHigh_C AOHt_stDAVehXLow_C AOHt_stDAVehXHigh_C AOHt_stDAVehYLow_C AOHt_stDAVehYHigh_C AOHt_swtHtgActive_C AOHt_tEnvHysDelta_C AOHt_tEnv_CUR AOHt_tiACMin_C AOHt_tiAltPT1_C AOHt_tiDAMin_C AOHt_tiNAvrgPT1_C AOHt_tiStrt_C AOHt_uBattHysMin_C AOHt_uBattHysMax_C AOHt_stBattShutOffEn_C AOHt_stBattShutOffDis_C /end DEF_CHARACTERISTIC
 /begin IN_MEASUREMENT Eng_nAvrg IATSCD_tAir /end IN_MEASUREMENT
/end FUNCTION
/begin FUNCTION aohtcd "Zuheizer Komponententreiber"
 /begin DEF_CHARACTERISTIC AOHtCD_ctPwrStgOnMax_C AOHtCD_tiDebAOHtDia1Def_C AOHtCD_tiDebAOHtDia1Ok_C AOHtCD_tiDebAOHtDia2Def_C AOHtCD_tiDebAOHtDia2Ok_C AOHtCD_tiDebAOHtDia3Def_C AOHtCD_tiDebAOHtDia3Ok_C AOHtCD_tiDebExcTempDef_C AOHtCD_tiDebExcTempOk_C AOHtCD_tiDebNoLoadDef_C AOHtCD_tiDebNoLoadOk_C AOHtCD_tiDebPos_C AOHtCD_tiDebNeg_C AOHtCD_tiDebShortCircBatDef_C AOHtCD_tiDebShortCircBatOk_C AOHtCD_tiDebShortCircGndDef_C AOHtCD_tiDebShortCircGndOk_C AOHtCD_numDia_C AOHtCD_numDioIn_C AOHtCD_numPwmOut_C AOHtCD_stInvOut_C AOHtCD_tiPer_C AOHtCD_rOutMax_C AOHtCD_rOutMin_C AOHtCD_rTst_C AOHtCD_stPwrStgActv_C AOHtCD_stPwrStgDia_C AOHtCD_stSPICtl_C AOHtCD_swtBattCorr_C AOHtCD_swtInv_C AOHtCD_tiBtwTst_C AOHtCD_tiDiag1Max_C AOHtCD_tiDiag1Min_C AOHtCD_tiDiag2Max_C AOHtCD_tiDiag2Min_C AOHtCD_tiDiag3Max_C AOHtCD_tiDiag3Min_C AOHtCD_tiPwrStgOn_C /end DEF_CHARACTERISTIC
/end FUNCTION
/begin FUNCTION aohtcd_msg "" /begin OUT_MEASUREMENT AOHtCD_stHtgReq /end OUT_MEASUREMENT /end FUNCTION
/begin FUNCTION aohtcd_uic "" /begin OUT_MEASUREMENT AOHtCD_rOut_mp /end OUT_MEASUREMENT /end FUNCTION
/begin FUNCTION aoht_msg "" /begin OUT_MEASUREMENT AOHt_nMin AOHt_rHtgOut AOHt_stHtgUp /end OUT_MEASUREMENT /end FUNCTION
/begin FUNCTION aoht_uic "" /begin DEF_CHARACTERISTIC AOHt_rHtgOut_Vector AOHt_rHtgOut_Channel /end DEF_CHARACTERISTIC
 /begin OUT_MEASUREMENT AOHt_rAltLd_mp AOHt_rIGov_mp AOHt_rNAvrgDeb_mp AOHt_rNAvrg_mp AOHt_rPGov_mp AOHt_rPI_mp AOHt_stAC_mp AOHt_stDA_mp AOHt_stShutOff_mp AOHt_tEnvLin_mp /end OUT_MEASUREMENT
/end FUNCTION
/begin FUNCTION appcd "Fahrpedal Komponententreiber"
 /begin DEF_CHARACTERISTIC APPCD_uAPP1_SRCMin_C APPCD_uAPP1_SRCMax_C APPCD_uAPP2_SRCMin_C APPCD_uAPP2_SRCMax_C APPCD_DebSRCHighDef_C APPCD_DebSRCHighOk_C APPCD_DebSRCLowDef_C APPCD_DebSRCLowOk_C APPCD_DebSyncDef_C APPCD_DebSyncOk_C APPCD_duAPPJit_C APPCD_facrAPP1APP2_C APPCD_rThrFltFDCLowPos_C APPCD_rThrFltFDCMidPos_C APPCD_rThrFltFDCLowNeg_C APPCD_rThrFltFDCMidNeg_C APPCD_tiLowNegFDCPT1_C APPCD_tiLowNegPT1_C APPCD_tiLowPosFDCPT1_C APPCD_tiLowPosPT1_C APPCD_tiMidNegFDCPT1_C APPCD_tiMidNegPT1_C APPCD_tiMidPosFDCPT1_C APPCD_tiMidPosPT1_C APPCD_tiUppNegFDCPT1_C APPCD_tiUppNegPT1_C APPCD_tiUppPosFDCPT1_C APPCD_tiUppPosPT1_C APPCD_swtNoFlt_C APPCD_rThrFltLowPos_C APPCD_rThrFltMidPos_C APPCD_rThrFltLowNeg_C APPCD_rThrFltMidNeg_C APPCD_numAdcAPP1_C APPCD_numAdcAPP2_C APPCD_duLimErrPos_C APPCD_duLimErrNeg_C APPCD_rLinAPP_CUR APPCD_SSpMonAPP1_C APPCD_SSpMonAPP2_C APPCD_swtEnaUnJit_C APPCD_swtStepLim_C APPCD_uAPPMin_C APPCD_uKickDownHighAPP_C APPCD_uKickDownLowAPP_C APPCD_uMinSync_C APPCD_uRawAPP2dOff_C APPCD_uSync_CUR /end DEF_CHARACTERISTIC
 /begin IN_MEASUREMENT APPCD_uRawAPP1 APPCD_uRaw_mp /end IN_MEASUREMENT
/end FUNCTION
/begin FUNCTION appcd_msg ""
 /begin OUT_MEASUREMENT APPCD_drAPP1UnFlt APPCD_rAPP1UnFlt APPCD_rFlt APPCD_rNextThr APPCD_stKickDown APPCD_stLimp APPCD_stPos APPCD_stSigSrc APPCD_uRawAPP1 APPCD_uRawAPP2 /end OUT_MEASUREMENT
/end FUNCTION
/begin FUNCTION appcd_uic ""
 /begin OUT_MEASUREMENT APPCD_rFlt_mp APPCD_rStepLim_mp APPCD_stAPP12def_mp APPCD_stErr1_mp APPCD_stTempErr_mp APPCD_stTempHeal_mp APPCD_uAPPunJit_mp APPCD_uDiffMax_mp APPCD_uRawAPP1half_mp APPCD_uRawAPP2dbl_mp APPCD_uRawDiff_mp APPCD_uRaw_mp /end OUT_MEASUREMENT
/end FUNCTION
/begin FUNCTION applib "" /end FUNCTION
/begin FUNCTION apscd "Atmosphärendruckfühler Komponententreiber"
 /begin DEF_CHARACTERISTIC APSCD_uSRCMin_C APSCD_uSRCMax_C APSCD_pLin_CUR APSCD_DebNplDef_C APSCD_DebNplOk_C APSCD_DebSigDef_C APSCD_DebSigOk_C APSCD_DebSRCDef_C APSCD_DebSRCOk_C APSCD_nLimHigh_C APSCD_numAdc_C APSCD_pCor_MAP APSCD_dpRmpSlpUp_C APSCD_dpRmpSlpDwn_C APSCD_swtInst_C APSCD_swtSigVal_C APSCD_swtSrcpVal_C APSCD_tiDel_C APSCD_stSensIDWord_C APSCD_pDfl_C /end DEF_CHARACTERISTIC
 /begin IN_MEASUREMENT APSCD_uRaw Eng_dnAvrg Eng_nAvrg /end IN_MEASUREMENT
/end FUNCTION
/begin FUNCTION apscd_msg ""
 /begin OUT_MEASUREMENT APSCD_pLinVal APSCD_pSensorVal APSCD_pVal APSCD_stSensorInst APSCD_swtSig APSCD_uRaw /end OUT_MEASUREMENT
/end FUNCTION
/begin FUNCTION apscd_uic "" /begin OUT_MEASUREMENT APSCD_BpsAllowed_mp APSCD_pCorVal_mp APSCD_pPhyVal_mp /end OUT_MEASUREMENT /end FUNCTION
/begin FUNCTION apscd_variant "" /end FUNCTION
/begin FUNCTION ars_detarspwr "Calculation of desired and the lead power of ARS"
 /begin DEF_CHARACTERISTIC ARS_tiDebSigDef_C ARS_tiDebSigOk_C ARS_facDesCor_C ARS_facDesOldCor_C ARS_nDia_C ARS_rTrans_C ARS_trqCurMax_MAP ARS_trqDesMax_MAP ARS_trqDiaMaxOfs_C ARS_trqDiaMax_C ARS_vDia_C /end DEF_CHARACTERISTIC
 /begin IN_MEASUREMENT FrmMng_aSide VSSCD_v /end IN_MEASUREMENT
/end FUNCTION
/begin FUNCTION ars_detarspwr_msg "" /begin OUT_MEASUREMENT ARS_pwrDes ARS_pwrLead ARS_st ARS_stRecARS /end OUT_MEASUREMENT /end FUNCTION
/begin FUNCTION ars_detarspwr_uic ""
 /begin OUT_MEASUREMENT ARS_trqCor_mp ARS_trqCurMax_mp ARS_trqDesMax_mp ARS_trqDesOld_mp ARS_trqDes_mp /end OUT_MEASUREMENT
/end FUNCTION
/begin FUNCTION asddc "Aktive Ruckeldämpfung Störgrößenregler (ARD)"
 /begin DEF_CHARACTERISTIC ASDdc_T1Clu_C ASDdc_KdClu_C ASDdc_T1ExtInt_C ASDdc_KdExtInt_C ASDdc_KdGrip_MAP ASDdc_numDefaultState_C ASDdc_T1State3_C ASDdc_KdState3_C ASDdc_T1State4_C ASDdc_KdState4_C ASDdc_stConfCluEng_C ASDdc_stConfCluOff_C ASDdc_stConfCluSlip_C ASDdc_stConv1_C ASDdc_stConv2_C ASDdc_stConv3_C ASDdc_stExtInt_C ASDdc_stGearswitch_C ASDdc_stGripRaw_C ASDdc_stGrip_C ASDdc_swtCalcN_C ASDdc_swtInitPS_C ASDdc_swtLADFrz_C ASDdc_swtOpr_C ASDdc_T1Grip_MAP ASDdc_trqLimMax_C ASDdc_trqLimMin_C ASDdc_vLimIni_C /end DEF_CHARACTERISTIC
 /begin IN_MEASUREMENT ASDdc_nAvrg_mp DrvTrn_rTransDT /end IN_MEASUREMENT
 /begin OUT_MEASUREMENT ASDdc_KdCurr_mp ASDdc_T1Curr_mp /end OUT_MEASUREMENT
/end FUNCTION
/begin FUNCTION asddc_msg "" /begin OUT_MEASUREMENT ASDdc_trq /end OUT_MEASUREMENT /end FUNCTION
/begin FUNCTION asddc_uic "" /begin DEF_CHARACTERISTIC ASDdc_trq_Vector ASDdc_trq_Channel /end DEF_CHARACTERISTIC
 /begin OUT_MEASUREMENT ASDdc_nAvrg_mp ASDdc_stCluPS_mp ASDdc_stCond_mp ASDdc_stPrioState_mp ASDdc_stREinit_mp ASDdc_stSelectState_mp ASDdc_stStates_mp ASDdc_trqUnLtd_mp /end OUT_MEASUREMENT
/end FUNCTION
/begin FUNCTION asddc_var "" /begin DEF_CHARACTERISTIC ASDdc_KdSlip_MAP ASDdc_numPrio_C ASDdc_T1Slip_MAP /end DEF_CHARACTERISTIC /begin IN_MEASUREMENT ASDdc_nAvrg_mp DrvTrn_rTransDT /end IN_MEASUREMENT /end FUNCTION
/begin FUNCTION asddc_var_uic "" /end FUNCTION
/begin FUNCTION asdrf_governor "ARD-Regelalgoithmus, Führungsformer"
 /begin DEF_CHARACTERISTIC ASDrf_CoeffADecLim_C ASDrf_CoeffBDecLim_C ASDrf_dtrqIncLimHigh_C ASDrf_dtrqIncLimLow_C ASDrf_dtrqInrLtdLim_CUR ASDrf_dtrqSteepNeg_C ASDrf_dtrqSteepPos_C ASDrf_T1Flt_C ASDrf_swtCalcTrq_C ASDrf_swtFlt_C ASDrf_swtFrzLoss_C ASDrf_swtInitPS_C ASDrf_swtLim_C ASDrf_tiTrqSty_C ASDrf_trqDecHigh_C ASDrf_trqDecLow_C ASDrf_trqOfsNegHigh_C ASDrf_trqOfsNegLow_C ASDrf_trqOfsNegMid_C ASDrf_trqOfsPosHigh_C ASDrf_trqOfsPosLow_C ASDrf_trqOfsPosMid_C ASDrf_trqThresDecLim_C ASDrf_trqThresNeg_C ASDrf_trqThresPos_C /end DEF_CHARACTERISTIC
 /begin IN_MEASUREMENT ASDrf_dtrqInrLtd_mp /end IN_MEASUREMENT
/end FUNCTION
/begin FUNCTION asdrf_governor_msg "" /begin OUT_MEASUREMENT ASDrf_trqInr /end OUT_MEASUREMENT /end FUNCTION
/begin FUNCTION asdrf_governor_uic "" /begin DEF_CHARACTERISTIC ASDrf_trqInr_Vector ASDrf_trqInr_Channel /end DEF_CHARACTERISTIC
 /begin OUT_MEASUREMENT ASDrf_CoeffALossCurr_mp ASDrf_CoeffBLossCurr_mp ASDrf_dtrqDecMax_mp ASDrf_dtrqDecMin_mp ASDrf_dtrqInrLtd_mp ASDrf_dtrqLim_mp ASDrf_dtrqLossMax_mp ASDrf_dtrqLossMin_mp ASDrf_dtrqMax_mp ASDrf_dtrqMin_mp ASDrf_KdCurr_mp ASDrf_stDecLimState_mp ASDrf_stIncLim_mp ASDrf_stInit ASDrf_stInitdtrqSteep_mp ASDrf_stPosNeg_mp ASDrf_stTrqLim_mp ASDrf_T1Curr_mp ASDrf_trqASDSum_mp ASDrf_trqCompOfs_mp ASDrf_trqDecLimStrt_mp ASDrf_trqInit_mp ASDrf_trqInrLtdFlt_mp ASDrf_trqInrMaxUnLim_mp ASDrf_trqInrMax_mp ASDrf_trqInrMinUnLim_mp ASDrf_trqInrMin_mp ASDrf_trqInrUnLim_mp ASDrf_trqLoss_mp ASDrf_trqPT1In_mp ASDrf_trqPT1Out_mp ASDrf_trqPT1P_mp ASDrf_trqP_mp ASDrf_trqStyHigh_mp ASDrf_trqStyLow_mp /end OUT_MEASUREMENT
/end FUNCTION
/begin FUNCTION asdrf_selectparameter "Parametersatzauswahl ARD Führungsformer"
 /begin DEF_CHARACTERISTIC ASDrf_T1CluNeg_C ASDrf_KdCluNeg_C ASDrf_T1CluPos_C ASDrf_KdCluPos_C ASDrf_T1ExtInt_C ASDrf_KdExtInt_C ASDrf_numDefaultState_C ASDrf_CoeffACluLossNeg_C ASDrf_CoeffBCluLossNeg_C ASDrf_CoeffACluLossPos_C ASDrf_CoeffBCluLossPos_C ASDrf_CoeffAExtIntLoss_C ASDrf_CoeffBExtIntLoss_C ASDrf_CoeffAState3LossNeg_C ASDrf_CoeffBState3LossNeg_C ASDrf_CoeffAState3LossPos_C ASDrf_CoeffBState3LossPos_C ASDrf_CoeffAState4LossNeg_C ASDrf_CoeffBState4LossNeg_C ASDrf_CoeffAState4LossPos_C ASDrf_CoeffBState4LossPos_C ASDrf_T1State3Neg_C ASDrf_KdState3Neg_C ASDrf_T1State3Pos_C ASDrf_KdState3Pos_C ASDrf_T1State4Neg_C ASDrf_KdState4Neg_C ASDrf_T1State4Pos_C ASDrf_KdState4Pos_C ASDrf_stConv1_C ASDrf_stConv2_C ASDrf_stConv3_C ASDrf_stConvCluEng_C ASDrf_stConvCluOff_C ASDrf_stConvCluSlip_C ASDrf_stEntcClu_C ASDrf_stEntcExtInt_C ASDrf_stEntcGrip_C ASDrf_stEntcState3_C ASDrf_stEntcState4_C ASDrf_stExClu_C ASDrf_stExExtInt_C ASDrf_stExGrip_C ASDrf_stExState3_C ASDrf_stExState4_C ASDrf_stExtInt_C ASDrf_stGrip_C ASDrf_stReliablAdpt_C ASDrf_swtLossClcNoRel_C ASDrf_swtLossClcRel_C ASDrf_swtOpr_C ASDrf_trqLossNeg_CUR ASDrf_trqLossPos_CUR /end DEF_CHARACTERISTIC
 /begin IN_MEASUREMENT Eng_nAvrg /end IN_MEASUREMENT
/end FUNCTION
/begin FUNCTION asdrf_selectparameter_msg "" /begin OUT_MEASUREMENT ASDrf_stLAD ASDrf_trqLossNeg ASDrf_trqLossPos /end OUT_MEASUREMENT /end FUNCTION
/begin FUNCTION asdrf_selectparameter_uic ""
 /begin OUT_MEASUREMENT ASDrf_stCond_mp ASDrf_stPrioState_mp ASDrf_stSelectState_mp ASDrf_stStates_mp /end OUT_MEASUREMENT
/end FUNCTION
/begin FUNCTION asdrf_selectparameter_var ""
 /begin DEF_CHARACTERISTIC ASDrf_CoeffAGripLossNeg_CUR ASDrf_CoeffAGripLossPos_CUR ASDrf_CoeffBGripLossNeg_CUR ASDrf_CoeffBGripLossPos_CUR ASDrf_KdGripNeg_CUR ASDrf_KdGripPos_CUR ASDrf_numPrio_C ASDrf_T1GripNeg_CUR ASDrf_T1GripPos_CUR /end DEF_CHARACTERISTIC
 /begin IN_MEASUREMENT DrvTrn_rTransDT /end IN_MEASUREMENT
/end FUNCTION
/begin FUNCTION asmod_co "interface coordinator" /end FUNCTION
/begin FUNCTION asmod_co_msg "" /begin OUT_MEASUREMENT ASMod_facAMCor ASMod_qCor ASMod_rRelPosVSA /end OUT_MEASUREMENT /end FUNCTION
/begin FUNCTION asmod_co_uic "" /end FUNCTION
/begin FUNCTION asmod_detcylch "Füllungserfassung" /end FUNCTION
/begin FUNCTION asmod_detcylch_msg ""
 /begin OUT_MEASUREMENT ASMod_dmExhMnfPst ASMod_dmIndAir ASMod_dmO2IndAir ASMod_rLmbdRecExhMnfPst ASMod_tIndAir /end OUT_MEASUREMENT
/end FUNCTION
/begin FUNCTION asmod_detcylch_uic ""
 /begin OUT_MEASUREMENT ASMod_dmEGR_mp ASMod_dmIndAir_mp ASMod_rO2ExhMnfPst_mp ASMod_rO2IndAir_mp ASMod_tExhMnfPst_mp /end OUT_MEASUREMENT
/end FUNCTION
/begin FUNCTION asmod_eng "Motor"
 /begin DEF_CHARACTERISTIC ASMod_dmIndAirRef_MAP ASMod_facDdTm_C ASMod_facDMCorTDiff_CUR ASMod_facSOICorTDiff_CUR ASMod_phiSOIRef_MAP ASMod_tDiffEng_MAP ASMod_tEngCorTDiff_CUR ASMod_tEngRef_C /end DEF_CHARACTERISTIC
 /begin IN_MEASUREMENT ASMod_qBurned_mp ASMod_qLmbdCtlCorr_mp ASMod_rDMIndAir_mp ASMod_tEngCorTDiff_mp Eng_nAvrg InjCrv_phiMI1Des /end IN_MEASUREMENT
/end FUNCTION
/begin FUNCTION asmod_eng_msg ""
 /begin OUT_MEASUREMENT ASMod_dmExhMnfPre ASMod_rLmbdRecEG ASMod_rO2ExhMnfPre ASMod_tExhMnfPre /end OUT_MEASUREMENT
/end FUNCTION
/begin FUNCTION asmod_eng_uic ""
 /begin OUT_MEASUREMENT ASMod_dmEG_mp ASMod_dmFlBurned_mp ASMod_dmFlPerTime_mp ASMod_dmIndAirRef_mp ASMod_dmO2EG_mp ASMod_facDMCorTDiff_mp ASMod_facSOICorTDiff_mp ASMod_phiSOIRef_mp ASMod_qBurned_mp ASMod_qLmbdCtlCorr_mp ASMod_rDMIndAir_mp ASMod_rFlBurned_mp ASMod_rO2EG_mp ASMod_tDiffEG_mp ASMod_tDiffEng_mp ASMod_tEG_mp ASMod_tEngCorTDiff_mp ASMod_tiDdTm_mp /end OUT_MEASUREMENT
/end FUNCTION
/begin FUNCTION asmod_indvol "Modell des Einlaßvolumens" /begin DEF_CHARACTERISTIC ASMod_tiDT1_C ASMod_volIndVol_C /end DEF_CHARACTERISTIC /end FUNCTION
/begin FUNCTION asmod_indvol_msg "" /begin OUT_MEASUREMENT ASMod_dmAirPerTimeCorr ASMod_mAirPerCylCorr /end OUT_MEASUREMENT /end FUNCTION
/begin FUNCTION asmod_indvol_uic "" /begin OUT_MEASUREMENT ASMod_dmIndVol_mp ASMod_mIndVol_mp /end OUT_MEASUREMENT /end FUNCTION
/begin FUNCTION asmod_voleff "Luftaufwand"
 /begin DEF_CHARACTERISTIC ASMod_facTCorVolEff_C ASMod_facVolEff_MAP ASMod_facVSACorVolEff_MAP ASMod_swtT_C ASMod_tIndAirRef_MAP ASMod_volEng_C /end DEF_CHARACTERISTIC
 /begin IN_MEASUREMENT ASMod_rRelPosVSA Eng_nAvrg InjCtl_qCurr /end IN_MEASUREMENT
/end FUNCTION
/begin FUNCTION asmod_voleff_msg "" /begin OUT_MEASUREMENT ASMod_dmIndAirRef ASMod_dvolIndAirRef ASMod_tIndAirRef /end OUT_MEASUREMENT /end FUNCTION
/begin FUNCTION asmod_voleff_uic ""
 /begin OUT_MEASUREMENT ASMod_facTIndAirCor_mp ASMod_facVolEff_mp ASMod_facVSACorVolEff_mp ASMod_tIntakeAir_mp /end OUT_MEASUREMENT
/end FUNCTION
/begin FUNCTION battcd "Komponententreiber Batteriespannung"
 /begin DEF_CHARACTERISTIC BattCD_uSRCMin_C BattCD_uSRCMax_C BattCD_uLin_CUR BattCD_DebSRCHighDef_C BattCD_DebSRCHighOk_C BattCD_DebSRCLowDef_C BattCD_DebSRCLowOk_C BattCD_numAdc_C BattCD_duRmpSlpUp_C BattCD_duRmpSlpDwn_C BattCD_stSensIDWord_C BattCD_uDfl_C /end DEF_CHARACTERISTIC
 /begin IN_MEASUREMENT BattCD_uRaw /end IN_MEASUREMENT
/end FUNCTION
/begin FUNCTION battcd_msg "" /begin OUT_MEASUREMENT BattCD_u BattCD_uLin BattCD_uRaw /end OUT_MEASUREMENT /end FUNCTION
/begin FUNCTION battcd_uic "" /end FUNCTION
/begin FUNCTION batt_corfac "" /begin DEF_CHARACTERISTIC Batt_uNrm_C /end DEF_CHARACTERISTIC /end FUNCTION
/begin FUNCTION batt_corfac_msg "" /begin OUT_MEASUREMENT Batt_facCor /end OUT_MEASUREMENT /end FUNCTION
/begin FUNCTION bdint "Karosserie und Innenraum" /end FUNCTION
/begin FUNCTION bdint_msg "" /begin OUT_MEASUREMENT BdInt_nMax BdInt_nMin BdInt_pwrDes BdInt_pwrLead /end OUT_MEASUREMENT /end FUNCTION
/begin FUNCTION bpacd "Komponententreiber des Ladedruckstellers"
 /begin DEF_CHARACTERISTIC BPACD_ctPwrStgOnMax2_C BPACD_ctPwrStgOnMax_C BPACD_tiDebBPADia1v2Def_C BPACD_tiDebBPADia1v2Ok_C BPACD_tiDebBPADia1Def_C BPACD_tiDebBPADia1Ok_C BPACD_tiDebBPADia2v2Def_C BPACD_tiDebBPADia2v2Ok_C BPACD_tiDebBPADia2Def_C BPACD_tiDebBPADia2Ok_C BPACD_tiDebBPADia3v2Def_C BPACD_tiDebBPADia3v2Ok_C BPACD_tiDebBPADia3Def_C BPACD_tiDebBPADia3Ok_C BPACD_tiDebBPADia4v2Def_C BPACD_tiDebBPADia4v2Ok_C BPACD_tiDebBPADia4Def_C BPACD_tiDebBPADia4Ok_C BPACD_DebExcTemp2Def_C BPACD_DebExcTemp2Ok_C BPACD_DebExcTempDef_C BPACD_DebExcTempOk_C BPACD_DebNoLoad2Def_C BPACD_DebNoLoad2Ok_C BPACD_DebNoLoadDef_C BPACD_DebNoLoadOk_C BPACD_DebShortCircBat2Def_C BPACD_DebShortCircBat2Ok_C BPACD_DebShortCircBatDef_C BPACD_DebShortCircBatOk_C BPACD_DebShortCircGnd2Def_C BPACD_DebShortCircGnd2Ok_C BPACD_DebShortCircGndDef_C BPACD_DebShortCircGndOk_C BPACD_numDia2_C BPACD_numDia_C BPACD_numPwmOut2_C BPACD_numPwmOut_C BPACD_stInvOut2_C BPACD_tiPer2_C BPACD_stInvOut_C BPACD_tiPer_C BPACD_rCnv2_CUR BPACD_rCnv_CUR BPACD_rOutMax2_C BPACD_rOutMax_C BPACD_rOutMin2_C BPACD_rOutMin_C BPACD_rTst2_C BPACD_rTst_C BPACD_stPwrStgActv2_C BPACD_stPwrStgActv_C BPACD_stPwrStgDia2_C BPACD_stPwrStgDia_C BPACD_stSPICtl2_C BPACD_stSPICtl_C BPACD_swt2_C BPACD_swt_C BPACD_tiBtwTst2_C BPACD_tiBtwTst_C BPACD_tiDiag1Max2_C BPACD_tiDiag1Max_C BPACD_tiDiag1Min2_C BPACD_tiDiag1Min_C BPACD_tiDiag2Max2_C BPACD_tiDiag2Max_C BPACD_tiDiag2Min2_C BPACD_tiDiag2Min_C BPACD_tiDiag3Max2_C BPACD_tiDiag3Max_C BPACD_tiDiag3Min2_C BPACD_tiDiag3Min_C BPACD_tiDiag4Max2_C BPACD_tiDiag4Max_C BPACD_tiDiag4Min2_C BPACD_tiDiag4Min_C BPACD_tiPwrStgOn2_C BPACD_tiPwrStgOn_C /end DEF_CHARACTERISTIC
 /begin IN_MEASUREMENT BPA_rBPA2 BPA_rBPACD /end IN_MEASUREMENT
/end FUNCTION
/begin FUNCTION bpacd_msg "" /begin OUT_MEASUREMENT BPACD_rOut BPACD_rOut2 /end OUT_MEASUREMENT /end FUNCTION
/begin FUNCTION bpacd_uic "" /begin OUT_MEASUREMENT BPACD_rCnv2_mp BPACD_rCnv_mp /end OUT_MEASUREMENT /end FUNCTION
/begin FUNCTION bpa_co "Stellerkoordinator für Ladedrucksteller" /end FUNCTION
/begin FUNCTION bpa_co_msg "" /begin OUT_MEASUREMENT BPA_rBPA2 BPA_rBPACD /end OUT_MEASUREMENT /end FUNCTION
/begin FUNCTION bpa_co_uic "" /begin DEF_CHARACTERISTIC BPA_rBPACD_Vector BPA_rBPACD_Channel /end DEF_CHARACTERISTIC /begin OUT_MEASUREMENT BPA_rBPAByp_mp /end OUT_MEASUREMENT /end FUNCTION
/begin FUNCTION bpa_lpco "" /end FUNCTION
/begin FUNCTION bpa_lpco_msg "" /begin OUT_MEASUREMENT BPA_rLPACD /end OUT_MEASUREMENT /end FUNCTION
/begin FUNCTION bpa_lpco_uic "" /begin DEF_CHARACTERISTIC BPA_rLPACD_Vector BPA_rLPACD_Channel /end DEF_CHARACTERISTIC /begin OUT_MEASUREMENT BPA_rLPAByp_mp /end OUT_MEASUREMENT /end FUNCTION
/begin FUNCTION bpscd "Komponententreiber des Ladedruckfühlers"
 /begin DEF_CHARACTERISTIC BPSCD_uSRCMin_C BPSCD_uSRCMax_C BPSCD_pLin_CUR BPSCD_DebNplDef_C BPSCD_DebNplOK_C BPSCD_DebSigDef_C BPSCD_DebSigOK_C BPSCD_DebSRCHighDef_C BPSCD_DebSRCHighOK_C BPSCD_DebSRCLowDef_C BPSCD_DebSRCLowOK_C BPSCD_tiDT1_C BPSCD_dDT1Kd_C BPSCD_tiLPFiltPT1_C BPSCD_nLim_C BPSCD_numAdc_C BPSCD_pDiffLim_C BPSCD_tiOutValDT1_C BPSCD_dDT1KdOutVal_C BPSCD_tiPT1_C BPSCD_dpRmpSlpUp_C BPSCD_dpRmpSlpDwn_C BPSCD_swtSigVal_C BPSCD_stSensIDWord_C BPSCD_pDfl_C /end DEF_CHARACTERISTIC
 /begin IN_MEASUREMENT BPSCD_uRawVal /end IN_MEASUREMENT
/end FUNCTION
/begin FUNCTION bpscd_msg ""
 /begin OUT_MEASUREMENT BPSCD_dFltValDT1 BPSCD_dpOutVal BPSCD_pFltVal BPSCD_pIntVal BPSCD_pLin BPSCD_pOutVal BPSCD_pPhyVal BPSCD_stErr BPSCD_stPlausErr BPSCD_uRawVal /end OUT_MEASUREMENT
/end FUNCTION
/begin FUNCTION bpscd_uic "" /end FUNCTION
/begin FUNCTION brkcd "Komponententreiber zur Erfassung aller Bremssignale"
 /begin DEF_CHARACTERISTIC BrkCD_ctUnPlausDef_C BrkCD_DebSigDef_C BrkCD_DebSigOk_C BrkCD_tiMnSwtDebNeg_C BrkCD_tiMnSwtDebPos_C BrkCD_numDioInMn_C BrkCD_numDioInRed_C BrkCD_tiRedSwtDebNeg_C BrkCD_tiRedSwtDebPos_C BrkCD_stDflVal_C BrkCD_stMnSwtInvIn_C BrkCD_stRedSwtInvIn_C BrkCD_swtRedSwtPresent_C BrkCD_swtSigVal_C BrkCD_tiDebResUnPlaus_C BrkCD_tiDebUnPlausStat_C BrkCD_tiDebUnPlaus_C /end DEF_CHARACTERISTIC
/end FUNCTION
/begin FUNCTION brkcd_msg ""
 /begin OUT_MEASUREMENT BrkCD_stMnSwtDebVal BrkCD_stMnSwtLastDebVal BrkCD_stMnSwtRawVal BrkCD_stPressed BrkCD_stRedSwtDebVal BrkCD_stRedSwtLastDebVal BrkCD_stRedSwtPresent BrkCD_stRedSwtRawVal BrkCD_swtSig /end OUT_MEASUREMENT
/end FUNCTION
/begin FUNCTION brkcd_uic ""
 /begin OUT_MEASUREMENT BrkCD_ctUnPlaus_mp BrkCD_stDeb_mp BrkCD_stMnSwtLogVal_mp BrkCD_stRedSwtLogVal_mp BrkCD_stResUnPlaus_mp BrkCD_stRun_mp BrkCD_tiUnPlausBrkPres_mp /end OUT_MEASUREMENT
/end FUNCTION
/begin FUNCTION bss "Servicetask für Bit Serielle Schnittstelle" /begin DEF_CHARACTERISTIC Bss_tiDebDefect_C Bss_tiDebOk_C /end DEF_CHARACTERISTIC /end FUNCTION
/begin COMPU_METHOD Acc "Fahrzeugbeschleunigung" RAT_FUNC "%6.5" "m/s^2" COEFFS 0 1000 0 0 0 1 /end COMPU_METHOD
/begin COMPU_METHOD AirMass "Luftmasse" RAT_FUNC "%6.4" "g" COEFFS 0 100 0 0 0 1 /end COMPU_METHOD
/begin COMPU_METHOD AirMassPerCyl "Luftmasse pro Zylinder" RAT_FUNC "%6.3" "mg/Hub" COEFFS 0 10 0 0 0 1 /end COMPU_METHOD
/begin COMPU_METHOD AirMassPerTime "Luftmasse pro Zeit" RAT_FUNC "%6.3" "Kg/h" COEFFS 0 10 0 0 0 1 /end COMPU_METHOD
/begin COMPU_METHOD AirVolPerTime "Umrechnungsformel für Luftvolumenstrom" RAT_FUNC "%6.3" "m^3/h" COEFFS 0 10 0 0 0 1 /end COMPU_METHOD
/begin COMPU_METHOD AngleCrS "Winkel Kurbelwelle" RAT_FUNC "%6.4" "deg CrS" COEFFS 0 42.6666666666667 0 0 0 1 /end COMPU_METHOD
/begin COMPU_METHOD ASDrf_numDefaultState "Nummer des Default-Primärzustandes" TAB_VERB "%6.3" "-" COMPU_TAB_REF ASDrf_numDefaultState /end COMPU_METHOD
/begin COMPU_VTAB ASDrf_numDefaultState "Nummer des Default-Primärzustandes" TAB_VERB 5 0 "ExtInt" 1 "Clutch" 2 "Grip" 3 "State3" 4 "State4" /end COMPU_VTAB
/begin COMPU_METHOD ASDdcState "Verbale Umrechnung für ADSdc-Parametersatzwahl" TAB_VERB "%6.3" "-" COMPU_TAB_REF dcState /end COMPU_METHOD
/begin COMPU_VTAB dcState "Verbale Umrechnung für ADSdc-Parametersatzwahl" TAB_VERB 7 1 "GripMAP" 2 "Clutch " 4 "ExtInt " 8 "State3 " 16 "State4 " 32 "SlipMAP" 64 "SportMAP" /end COMPU_VTAB
/begin COMPU_METHOD ASDrfState "Verbale Umrechnung für ADSrf-Parametersatzwahl" TAB_VERB "%6.3" "-" COMPU_TAB_REF rfState /end COMPU_METHOD
/begin COMPU_VTAB rfState "Verbale Umrechnung für ADSrf-Parametersatzwahl" TAB_VERB 5 1 "ExtInt" 2 "Clutch" 4 "Grip  " 8 "State3" 16 "State4" /end COMPU_VTAB
/begin COMPU_METHOD ASD_GvrnDT1Kd_float "Differentialverstärkung Kd (Motordrehzahl EngN zu Motormoment Trq)" RAT_FUNC "%6.2" "(Nm/rpm)^0.5" COEFFS 0 1 0 0 0 1 /end COMPU_METHOD
/begin COMPU_METHOD ASD_GvrnDT1T1_float "Zeitkonstante T1 (in s) für PT1, DT1 beim ARD" RAT_FUNC "%6.2" "s" COEFFS 0 1 0 0 0 1 /end COMPU_METHOD
/begin COMPU_METHOD Can "Umrechnungsfaktor für CAN-bezogene Größen" RAT_FUNC "%6.5" "-" COEFFS 0 1000 0 0 0 1 /end COMPU_METHOD
/begin COMPU_METHOD Can1 "Umsetzungsfaktor fuer CAN verwandte Groeßen" RAT_FUNC "%7.6" "-" COEFFS 0 10000 0 0 0 1 /end COMPU_METHOD
/begin COMPU_METHOD CoeffA "Koeffizient A in der Parabel dTrq = A * Trq^2 + Trq" RAT_FUNC "%6.4" "1/(s*Nm)" COEFFS 0 204.8 0 0 0 1 /end COMPU_METHOD
/begin COMPU_METHOD dez "K3 Umwandlungen" RAT_FUNC "%6.2" "-" COEFFS 0 1 0 0 0 1 /end COMPU_METHOD
/begin COMPU_METHOD dn_dZ20 "Motorbeschleunigung pro Zeit (dn/dt) (im 20 ms Raster)" RAT_FUNC "%6.1" "rpm/s" COEFFS 0 0.1 0 0 0 1 /end COMPU_METHOD
/begin COMPU_METHOD dp_dZ10 "boost pressure per time (dp/dt) every 10ms" RAT_FUNC "%6.1" "hPa/s" COEFFS 0 0.1 0 0 0 1 /end COMPU_METHOD
/begin COMPU_METHOD dTrq "Umrtechnungsformel dTrq/dTime" RAT_FUNC "%6.3" "Nm/s" COEFFS 0 10 0 0 0 1 /end COMPU_METHOD
/begin COMPU_METHOD DtyCyc "Tastverhaeltnis" RAT_FUNC "%6.4" "%" COEFFS 0 100 0 0 0 1 /end COMPU_METHOD
/begin COMPU_METHOD EngN "Motordrehzahl" RAT_FUNC "%6.2" "rpm" COEFFS 0 1 0 0 0 1 /end COMPU_METHOD
/begin COMPU_METHOD Eng_dN "Motorbeschleunigung" RAT_FUNC "%6.2" "rpm/s" COEFFS 0 1 0 0 0 1 /end COMPU_METHOD
/begin COMPU_METHOD Fact "Faktor mit Auflösung 1 / 8192, hauptsächlich für einen Faktorenbereich 0...1 verwendet" RAT_FUNC "%6.5" "-" COEFFS 0 8192 0 0 0 1 /end COMPU_METHOD
/begin COMPU_METHOD Fact1 "Faktor mit Auflösung 0,01 (100 mal höherer Bereich als Fact)" RAT_FUNC "%6.4" "-" COEFFS 0 128 0 0 0 1 /end COMPU_METHOD
/begin COMPU_METHOD InjMass "Einspritzmenge" RAT_FUNC "%6.4" "mg/hub" COEFFS 0 100 0 0 0 1 /end COMPU_METHOD
/begin COMPU_METHOD InjMassCyc "Einspritzmenge pro Zyklus (mg/Zyklus)" RAT_FUNC "%6.4" "mg/cyc" COEFFS 0 100 0 0 0 1 /end COMPU_METHOD
/begin COMPU_METHOD InjMassPerSec_20ms "Einspritzmengenänderung pro Sekunde für 20ms-Tasks" RAT_FUNC "%6.3" "mg/hub/s" COEFFS 0 2 0 0 0 1 /end COMPU_METHOD
/begin COMPU_METHOD InjMassPerTime "Kraftstoffmassenstrom" RAT_FUNC "%6.4" "kg/h" COEFFS 0 100 0 0 0 1 /end COMPU_METHOD
/begin COMPU_METHOD Kd "Differentialverstärkung Kd (gleiche Einheit/Umrechnungsformel an Ein- und Ausgang)" RAT_FUNC "%7.6" "1/1" COEFFS 0 65536 0 0 0 1 /end COMPU_METHOD
/begin COMPU_METHOD Kd16_sqr_rpm2Nm "Wurzeldifferentialverstärkung Kd^0,5 für D2T2 (zweifach DT1), Motordrehzahl EngN zu Motormoment Trq" RAT_FUNC "%6.5" "(Nm/rpm)^0.5" COEFFS 0 1024 0 0 0 1 /end COMPU_METHOD
/begin COMPU_METHOD Kd_Lin_16 "Kd Verstärkung von linearen Kennlinien/-feldern" RAT_FUNC "%7.6" "1/1" COEFFS 0 32767 0 0 0 1 /end COMPU_METHOD
/begin COMPU_METHOD Ki "Integrale Verstärkung Ki (gleiche Einheit/Umrechnungsregel an Ein- und Ausgang)" RAT_FUNC "%6.5" "1/s" COEFFS 0 4294.967296 0 0 0 1 /end COMPU_METHOD
/begin COMPU_METHOD Kp "proportionale Verstärkung Kp (gleiche Einheit/Umrechnungsregel an Ein- und Ausgang)" RAT_FUNC "%7.6" "1/1" COEFFS 0 65536 0 0 0 1 /end COMPU_METHOD
/begin COMPU_METHOD lambdaRecVal "Reziproker Lambda Wert" RAT_FUNC "%6.5" "-" COEFFS 0 1000 0 0 0 1 /end COMPU_METHOD
/begin COMPU_METHOD numAirSys "Menge der separaten Ansaugflutwege im Luftsystem" TAB_VERB "%6.3" "-" COMPU_TAB_REF numAirSys /end COMPU_METHOD
/begin COMPU_VTAB numAirSys "Menge der separaten Ansaugflutwege im Luftsystem" TAB_VERB 3 0 "Mono" 1 "Bank 1" 2 "Bank 2" /end COMPU_VTAB
/begin COMPU_METHOD NumPinAdc "verbale Umrechnung für ADC Signale" TAB_VERB "%6.3" "-" COMPU_TAB_REF NumPinAdc /end COMPU_METHOD
/begin COMPU_VTAB NumPinAdc "verbale Umrechnung für ADC Signale" TAB_VERB 61 0 "ADC_REF" 1 "Voltage_Lambda1_Ua" 2 "Voltage_Lambda1_Ri" 3 "Temperature_ECU_PCB" 4 "Voltage_Bank_1" 5 "Voltage_Bank_2" 6 "ADC_DUMMYA" 7 "1st_APP_Sensor_252" 8 "ADC_Reserve-S1" 9 "2nd_APP_Sensor_239" 10 "ADC_Reserve-S2" 11 "Water_Temperature_Sensor_182" 12 "TKS" 13 "Charge_Air_Temperature_Sensor_183_2" 14 "Exhaust_Temperature_Sensor_1_MASTER_158" 15 "Exhaust_Temperature_Sensor_1_SLAVE_158" 16 "Atmospheric_Pressure_Sensor" 17 "Charge_Air_Temperature_Sensor_183" 18 "ADC_DUMMYB_NOT_USED" 19 "Rail_Pressure_Peak_Value_156" 20 "Rail_Pressure_Peak_Value-DummySlave" 21 "Boost_Pressure_Sensor_154" 22 "Boost_Pressure_Sensor_2" 23 "Booster_Voltage_Sensor" 24 "Rail_Pressure_Sensor_156" 25 "Pressure_Upstream_Particle_Filter_MASTER_159" 26 "Pressure_Upstream_Particle_Filter_SLAVE_159" 27 "Temperature_Upstream_Particle_Filter_MASTER_134" 28 "Temperature_Upstream_Particle_Filter_SLAVE_134" 29 "Current_MeUn_Sensor" 30 "Current_PCV_Sensor" 31 "Engine_Oil_Pressure_110" 32 "Battery_Voltage_Sensor" 33 "ADC_DUMMY_SLAVE_NOT_USED" 34 "ADC_DUMMY_NOT_USED" 35 "Charge_Actuator_Event_0" 36 "Voltage_Piezo_Actuator_Bank_2_Event_0" 37 "Voltage_Piezo_Actuator_Bank_1_Event_0" 38 "Charge_Actuator_Event_1" 39 "Voltage_Piezo_Actuator_Bank_2_Event_1" 40 "Voltage_Piezo_Actuator_Bank_1_Event_1" 41 "Charge_Actuator_Event_2" 42 "Voltage_Piezo_Actuator_Bank_2_Event_2" 43 "Voltage_Piezo_Actuator_Bank_1_Event_2" 44 "Charge_Actuator_Event_3" 45 "Voltage_Piezo_Actuator_Bank_2_Event_3" 46 "Voltage_Piezo_Actuator_Bank_1_Event_3" 47 "Charge_Actuator_Event_4" 48 "Voltage_Piezo_Actuator_Bank_2_Event_4" 49 "Voltage_Piezo_Actuator_Bank_1_Event_4" 50 "Charge_Actuator_Event_5" 51 "Voltage_Piezo_Actuator_Bank_2_Event_5" 52 "Voltage_Piezo_Actuator_Bank_1_Event_5" 53 "Charge_Actuator_Event_6" 54 "Voltage_Piezo_Actuator_Bank_2_Event_6" 55 "Voltage_Piezo_Actuator_Bank_1_Event_6" 56 "Charge_Actuator_Event_7" 57 "Voltage_Piezo_Actuator_Bank_2_Event_7" 58 "Voltage_Piezo_Actuator_Bank_1_Event_7" 59 "Booster_Voltage_Piezo" 60 "Piezo_Voltage" /end COMPU_VTAB
/begin COMPU_METHOD NumPinDia "Verbale Umrechnung für Diagnose Signale" TAB_VERB "%6.3" "-" COMPU_TAB_REF NumPinDia /end COMPU_METHOD
/begin COMPU_VTAB NumPinDia "Verbale Umrechnung für Diagnose Signale" TAB_VERB 34 0 "CJ945_Diagnostic_Signal" 1 "AC_Compressor_DiaSig" 2 "Fuel_Pump_DiaSig" 3 "Starter_234" 4 "Radiator_Blind_Control_Diagnostic_Signal" 5 "Engine_Bay_Air_Flaps/Compressor_Bypass_123" 6 "Glow_Relay_Diagnostic_Signal1" 7 "EngM_Bearing_Actuator_Diagnostic_Signal_124" 8 "reserved Glow_Relay_Diagnostic_Signal2" 9 "Ebox_Fan_Actuator_Diagnostic_Signal_219" 10 "Shutter_Actuator_SW_DiaSig" 11 "Twostage_TurboLoading_SW_DiaSig" 12 "DIO_OUT_DIAGNOSTIC_DUMMY_NOT_USED" 13 "1st_Pressure_Control_Valve_Diagnostic_Signal_172" 14 "2nd_Pressure_Control_Valve_Diagnostic_Signal_172" 15 "1st_Metering_Unit_Diagnostic_Signal_171" 16 "2nd_Metering_Unit_Diagnostic_Signal_171" 17 "Boost_Pressure_Actuator_Diagnostic_Signal_193" 18 "Boost_Pressure_Actuator_Diagnostic_Signal_193_2" 19 "EGR_Actuator_Diagnostic_Signal_194" 20 "EGR_Actuator_Diagnostic_Signal2" 21 "Variable_Swirl_Actuator_Diagnostic_Signal_195" 22 "Throttle_Valve_Diagnostic_Signal_196" 23 "Throttle_Valve2_Diagnostic_Signal_196" 24 "FAN_240" 25 "Add_On_Heater_244" 26 "Low pressure stage BPA_Diagnostic_Signal_117" 27 "PWM_DIAGNOSTIC_DUMMY_NOT_USED" 28 "1st_Sensor_Supply_Voltage_DiaSig" 29 "2nd_Sensor_Supply_Voltage_DiaSig" 30 "3rd_Sensor_Supply_Voltage_DiaSig" 31 "4th_Sensor_Supply_Voltage_DiaSig" 32 "5th_Sensor_Supply_Voltage_DiaSig" 33 "6th_Sensor_Supply_Voltage_DiaSig" /end COMPU_VTAB
/begin COMPU_METHOD NumPinDioIn "Verbale Umrechnung für Digitaleingang Signale" TAB_VERB "%6.3" "-" COMPU_TAB_REF NumPinDioIn /end COMPU_METHOD
/begin COMPU_VTAB NumPinDioIn "Verbale Umrechnung für Digitaleingang Signale" TAB_VERB 13 0 "Terminal_15_207" 1 "Main_Brake_Switch_236" 2 "Redundant_Brake_Switch_223" 3 "Clutch_Switch" 4 "Terminal_50_224" 5 "ECU_selection_Switch_251" 6 "Coolant-heater_212" 7 "Redundant_Terminal_15_209(118)" 8 "AC-compressor_overboost_213" 9 "1st_Lambda_Regeneration" 10 "Oil_Level_sensor_138" 11 "Diagnostic_Pin_VSA_137" 12 "DIO_IN_DUMMY_NOT_USED" /end COMPU_VTAB
/begin COMPU_METHOD NumPinPwmOut "Verbale Umrechnung für PWM-Ausgang Signale" TAB_VERB "%6.3" "-" COMPU_TAB_REF NumPinPwmOut /end COMPU_METHOD
/begin COMPU_VTAB NumPinPwmOut "Verbale Umrechnung für PWM-Ausgang Signale" TAB_VERB 14 0 "PCV_Actuator_172" 1 "MeUn_Actuator_171" 2 "Boost_Pressure_Actuator_193" 3 "Boost_Pressure_Actuator_193_2" 4 "EGR_Actuator_194" 5 "EGR_Actuator_2" 6 "Variable_Swirl_Actuator_195" 7 "Throttle_Valve_196" 8 "Throttle_Valve2_196" 9 "Fan_Actuator_240" 10 "Add_On_Heater_244" 11 "LSU_Heater_PWMOutput" 12 "Low pressure stage BPA_117" 13 "PWM_DUMMY_NOT_USED" /end COMPU_VTAB
/begin COMPU_METHOD O2 "Sauerstoffkonzentration" RAT_FUNC "%8.7" "-" COEFFS 0 100000 0 0 0 1 /end COMPU_METHOD
/begin COMPU_METHOD O2MassPerTime "Sauerstoffmassenstrom" RAT_FUNC "%6.4" "kg/h" COEFFS 0 100 0 0 0 1 /end COMPU_METHOD
/begin COMPU_METHOD OneToOne "eins zu eins (physikalischer Wert ist gleich dem internen Wert)" RAT_FUNC "%6.2" "-" COEFFS 0 1 0 0 0 1 /end COMPU_METHOD
/begin COMPU_METHOD Period "Periodendauer" RAT_FUNC "%6.3" "ms" COEFFS 0 10 0 0 0 1 /end COMPU_METHOD
/begin COMPU_METHOD Prc "Prozent, gleiche interne Auflösung wie Fact, aber Darstellung in Prozent (0...100%)" RAT_FUNC "%6.4" "%" COEFFS 0 81.92 0 0 0 1 /end COMPU_METHOD
/begin COMPU_METHOD PrcPerSec "Prozentänderung pro Sekunde für 20ms-Tasks" RAT_FUNC "%6.3" "%/s" COEFFS 0 1.6384 0 0 0 1 /end COMPU_METHOD
/begin COMPU_METHOD Pres_hPa "Druck (angezeigt in [hPa])" RAT_FUNC "%6.2" "hPa" COEFFS 0 1 0 0 0 1 /end COMPU_METHOD
/begin COMPU_METHOD Pwr "Leistung" RAT_FUNC "%6.2" "W" COEFFS 0 0.10610329539459 0 0 0 1 /end COMPU_METHOD
/begin COMPU_METHOD RatAirMass "Luftmassenverhältnis" RAT_FUNC "%6.4" "-" COEFFS 0 100 0 0 0 1 /end COMPU_METHOD
/begin COMPU_METHOD RatFuelMass "Kraftstoffmassenverhältnis" RAT_FUNC "%6.4" "-" COEFFS 0 100 0 0 0 1 /end COMPU_METHOD
/begin COMPU_METHOD RmpPres_hPa "Rampengradient für Druck angezeigt in [hPa/s]" RAT_FUNC "%6.4" "hPa/s" COEFFS 0 65.536 0 0 0 1 /end COMPU_METHOD
/begin COMPU_METHOD RmpVolt "ADC Spannungsrampengradient" RAT_FUNC "%6.4" "mV/s" COEFFS 0 13.4086656 0 0 0 1 /end COMPU_METHOD
/begin COMPU_METHOD RmpVoltBatt "Rampengradient für Batteriespannung" RAT_FUNC "%6.3" "mV/s" COEFFS 0 3.3521664 0 0 0 1 /end COMPU_METHOD
/begin COMPU_METHOD SlopeRes1000 "Umrechnung für Slope: Slopewert mit Verhältnis 0,001" RAT_FUNC "%6.5" "-" COEFFS 0 1000 0 0 0 1 /end COMPU_METHOD
/begin COMPU_METHOD TempDiff_Cels "difference/offset temperature displayed in degree celcius" RAT_FUNC "%6.3" "deg C" COEFFS 0 10 0 0 0 1 /end COMPU_METHOD
/begin COMPU_METHOD Temp_Cels "Temperatur dargestellt in °C (gleiche interne Darstellung wie Temp_Kelv)" RAT_FUNC "%6.1" "deg C" COEFFS 0 10 2731.4 0 0 1 /end COMPU_METHOD
/begin COMPU_METHOD TimeDeb "Entprellzeit in Millisekunden für Libraryfunktion Debounce" RAT_FUNC "%6.1" "ms" COEFFS 0 0.1 0 0 0 1 /end COMPU_METHOD
/begin COMPU_METHOD TimeDelay_s "Zeitkonstante T1 (in s) für PT1, DT1, etc." RAT_FUNC "%9.3" "s" COEFFS 0 0 1 0 0.00023283064365387 0 /end COMPU_METHOD
/begin COMPU_METHOD TimeDelay_s_Lin_16 "Zeitkonstante T1 (in s) für PT1, DT1, etc. für SINT16, kein Kehrwert" RAT_FUNC "%6.5" "s" COEFFS 0 6553.4 0 0 0 1 /end COMPU_METHOD
/begin COMPU_METHOD Time_ms "Zeit in ms für Fehlerentprellung (DSM) und SW-Timer" RAT_FUNC "%6.1" "ms" COEFFS 0 0.1 0 0 0 1 /end COMPU_METHOD
/begin COMPU_METHOD Time_s "Zeit in s für Fehlerentprellung (DSM) und SW-Timer" RAT_FUNC "%6.4" "s" COEFFS 0 100 0 0 0 1 /end COMPU_METHOD
/begin COMPU_METHOD TransR "Übersetzungsverhältnis (Getriebe etc.)" RAT_FUNC "%6.4" "-" COEFFS 0 100 0 0 0 1 /end COMPU_METHOD
/begin COMPU_METHOD Trq "Motormoment" RAT_FUNC "%6.3" "Nm" COEFFS 0 10 0 0 0 1 /end COMPU_METHOD
/begin COMPU_METHOD Trq32 "Umrechungsformel für inneres Moment in 32bit Zahlendarstellung" RAT_FUNC "%8.7" "Nm" COEFFS 0 655360 0 0 0 1 /end COMPU_METHOD
/begin COMPU_METHOD Trq_float "Motormoment" RAT_FUNC "%6.2" "Nm" COEFFS 0 1 0 0 0 1 /end COMPU_METHOD
/begin COMPU_METHOD Vel "Fahrzeuggeschwindigkeit, gleiche interne Auflösung wie Vel_SI" RAT_FUNC "%6.4" "km/h" COEFFS 0 100 0 0 0 1 /end COMPU_METHOD
/begin COMPU_METHOD Vol "Volumen" RAT_FUNC "%6.4" "l" COEFFS 0 100 0 0 0 1 /end COMPU_METHOD
/begin COMPU_METHOD Volt "Spannung in V (von ADC)" RAT_FUNC "%6.2" "mV" COEFFS 0 0.2046 0 0 0 1 /end COMPU_METHOD
/begin COMPU_METHOD Volt_Batt "Batteriespannung" RAT_FUNC "%6.1" "mV" COEFFS 0 0.05115 0 0 0 1 /end COMPU_METHOD
/begin RECORD_LAYOUT Kf_Xs16_Ys16_Ws16 NO_AXIS_PTS_X 1 SWORD NO_AXIS_PTS_Y 2 SWORD AXIS_PTS_X 3 SWORD INDEX_INCR DIRECT AXIS_PTS_Y 4 SWORD INDEX_INCR DIRECT FNC_VALUES 5 SWORD COLUMN_DIR DIRECT /end RECORD_LAYOUT
/begin RECORD_LAYOUT Kl_Xs16_Ws16 NO_AXIS_PTS_X 1 SWORD AXIS_PTS_X 2 SWORD INDEX_INCR DIRECT FNC_VALUES 3 SWORD COLUMN_DIR DIRECT /end RECORD_LAYOUT
/begin RECORD_LAYOUT Kwb_Wu8 FNC_VALUES 1 UBYTE COLUMN_DIR DIRECT /end RECORD_LAYOUT
/begin RECORD_LAYOUT Kw_Wr32 FNC_VALUES 1 FLOAT32_IEEE COLUMN_DIR DIRECT /end RECORD_LAYOUT
/begin RECORD_LAYOUT Kw_Ws16 FNC_VALUES 1 SWORD COLUMN_DIR DIRECT /end RECORD_LAYOUT
/begin RECORD_LAYOUT Kw_Ws32 FNC_VALUES 1 SLONG COLUMN_DIR DIRECT /end RECORD_LAYOUT
/begin RECORD_LAYOUT Kw_Wu16 FNC_VALUES 1 UWORD COLUMN_DIR DIRECT /end RECORD_LAYOUT
/begin RECORD_LAYOUT Kw_Wu32 FNC_VALUES 1 ULONG COLUMN_DIR DIRECT /end RECORD_LAYOUT
/begin RECORD_LAYOUT Kw_Wu8 FNC_VALUES 1 UBYTE COLUMN_DIR DIRECT /end RECORD_LAYOUT
/end MODULE
/end PROJECT
