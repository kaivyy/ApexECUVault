ASAP2_VERSION 1 30
/begin PROJECT MSS65-ign "Generiert am 14.10.05 um 09:57:47"
/begin HEADER "" VERSION "R341" /end HEADER
/begin MODULE _MSS65-ign "Generiert am 14.10.05 um 09:57:47"
/begin MOD_COMMON "" BYTE_ORDER MSB_FIRST ALIGNMENT_BYTE 1 ALIGNMENT_WORD 2 ALIGNMENT_LONG 4 ALIGNMENT_FLOAT32_IEEE 4 ALIGNMENT_FLOAT64_IEEE 8 /end MOD_COMMON
/begin CHARACTERISTIC K_DATENKENNUNG_1 "Datenkennsatzkennung Nr. 1" VAL_BLK 0x70262 TKW_VV_VV_UB 100.0 FORMULA_0419 0.0 255.0 NUMBER 5 /end CHARACTERISTIC
/begin CHARACTERISTIC K_DATENKENNUNG_2 "Datenkennsatzkennung Nr. 2" VAL_BLK 0x70273 TKW_VV_VV_UB 100.0 FORMULA_0419 0.0 255.0 NUMBER 5 /end CHARACTERISTIC
/begin CHARACTERISTIC K_DATENKENNUNG_3 "Datenkennsatzkennung Nr. 3" VAL_BLK 0x70284 TKW_VV_VV_UB 100.0 FORMULA_0419 0.0 255.0 NUMBER 5 /end CHARACTERISTIC
/begin CHARACTERISTIC K_TUMG_OBD_CFG "Schalter Diagnose-Art" VALUE 0x7A638 TKW_VV_VV_UB 100.0 FORMULA_1021 0.0 255.0 /end CHARACTERISTIC
/begin CHARACTERISTIC K_TUMG_OBD_ML_MAX "max. Luftmassenstrom fuer Modellberechnung" VALUE 0x7A648 TKW_VV_VV_SW 100.0 FORMULA_0103 -100.0 1400.0 FORMAT "%4.1" /end CHARACTERISTIC
/begin CHARACTERISTIC K_TUMG_OBD_ML_MIN "min. Luftmassenstrom fuer Modellberechnung" VALUE 0x7A646 TKW_VV_VV_SW 100.0 FORMULA_0103 -100.0 1400.0 FORMAT "%4.1" /end CHARACTERISTIC
/begin CHARACTERISTIC K_TUMG_OBD_ML_SUM_MIN "min. Integral-ML-Strom seit Start Modellberechung" VALUE 0x7A63C TKW_VV_VV_SW 100.0 FORMULA_0103 -100.0 1400.0 FORMAT "%4.1" /end CHARACTERISTIC
/begin CHARACTERISTIC K_TUMG_OBD_ML_TMOT_ZK "Tau fuer tumg_obd_model_offset1" VALUE 0x7A65A TKW_VV_VV_UW 100.0 FORMULA_0681 0.1000000014901161 6553.5 FORMAT "%5.2" /end CHARACTERISTIC
/begin CHARACTERISTIC K_TUMG_OBD_MODEL_DELTA_MAX "max. Toleranz zwischen tumg und Modelltemperatur" VALUE 0x7A65E TKW_VV_VV_SW 100.0 FORMULA_0074 -1000.0 1000.0 FORMAT "%4.1" /end CHARACTERISTIC
/begin CHARACTERISTIC K_TUMG_OBD_MODEL_DELTA_MIN "min. Toleranz zwischen tumg und Modelltemperatur" VALUE 0x7A65C TKW_VV_VV_SW 100.0 FORMULA_0074 -1000.0 1000.0 FORMAT "%4.1" /end CHARACTERISTIC
/begin CHARACTERISTIC K_TUMG_OBD_MODEL_TAU "Tau fuer tumg_obd_model pt1-Filterung" VALUE 0x7A664 TKW_VV_VV_UW 100.0 FORMULA_0681 0.1000000014901161 6553.5 FORMAT "%5.2" /end CHARACTERISTIC
/begin CHARACTERISTIC K_TUMG_OBD_N_MIN "min. Motordrehzahl fuer Modellberechnung" VALUE 0x7A63E TKW_VV_VV_SW 100.0 FORMULA_0006 0.0 10000.0 /end CHARACTERISTIC
/begin CHARACTERISTIC K_TUMG_OBD_T_POWER_ON "Wartezeit nach Power On" VALUE 0x7A63A TKW_VV_VV_UW 100.0 FORMULA_0021 0.0 655.0 FORMAT "%5.2" /end CHARACTERISTIC
/begin CHARACTERISTIC K_TUMG_OBD_TAN_FAST_TAU "Tau fuer pt1-Filterung von tan" VALUE 0x7A668 TKW_VV_VV_UW 100.0 FORMULA_0681 0.1000000014901161 6553.5 FORMAT "%5.2" /end CHARACTERISTIC
/begin CHARACTERISTIC K_TUMG_OBD_TAN_FIL_DELTA_MAX "max. Delta zwischen tan-Filterwerten" VALUE 0x7A66A TKW_VV_VV_SW 100.0 FORMULA_0074 -1000.0 1000.0 FORMAT "%4.1" /end CHARACTERISTIC
/begin CHARACTERISTIC K_TUMG_OBD_TAN_MAX "max. zulaessige Ansaugtemperatur fuer Modellfreigabe" VALUE 0x7A64A TKW_VV_VV_SW 100.0 FORMULA_0023 -50.0 170.0 FORMAT "%4.1" /end CHARACTERISTIC
/begin CHARACTERISTIC K_TUMG_OBD_TAN_MIN "min. tan fuer Kaltstarterkennung" VALUE 0x7A656 TKW_VV_VV_SW 100.0 FORMULA_0023 -50.0 170.0 FORMAT "%4.1" /end CHARACTERISTIC
/begin CHARACTERISTIC K_TUMG_OBD_TAN_SLOW_TAU "Tau fuer pt1-Filterung von tan" VALUE 0x7A666 TKW_VV_VV_UW 100.0 FORMULA_0681 0.1000000014901161 6553.5 FORMAT "%5.2" /end CHARACTERISTIC
/begin CHARACTERISTIC K_TUMG_OBD_TIME_ML_MIN "min. Motorlaufzeit fuer stabile Bedingungen" VALUE 0x7A64E TKW_VV_VV_UW 100.0 FORMULA_0626 0.0 65535.0 /end CHARACTERISTIC
/begin CHARACTERISTIC K_TUMG_OBD_TIME_MS_MIN "min. Motorstandzeit fuer Kaltstarterkennung" VALUE 0x7A650 TKW_VV_VV_UW 100.0 FORMULA_0620 0.0 1092.25 /end CHARACTERISTIC
/begin CHARACTERISTIC K_TUMG_OBD_TIME_SA_MAX "Zeit seit SA" VALUE 0x7A660 TKW_VV_VV_UL 100.0 FORMULA_0147 0.0 655.0 FORMAT "%5.2" /end CHARACTERISTIC
/begin CHARACTERISTIC K_TUMG_OBD_TKA_MIN "min. Kuehleraustrittstemperatur fuer Modellfreigabe" VALUE 0x7A64C TKW_VV_VV_SW 100.0 FORMULA_0023 -50.0 170.0 FORMAT "%4.1" /end CHARACTERISTIC
/begin CHARACTERISTIC K_TUMG_OBD_TMOT_KALT_MAX "max. Motortemperatur fuer Kaltstarterkennung" VALUE 0x7A658 TKW_VV_VV_SW 100.0 FORMULA_0023 -50.0 170.0 FORMAT "%4.1" /end CHARACTERISTIC
/begin CHARACTERISTIC K_TUMG_OBD_TMOT_MIN "Mindest-Motortemperatur fuer Diagnose" VALUE 0x7A640 TKW_VV_VV_SW 100.0 FORMULA_0023 -50.0 170.0 FORMAT "%4.1" /end CHARACTERISTIC
/begin CHARACTERISTIC K_TUMG_OBD_TMOT_START_MAX "max. Motortemperatur bei Start der Kaltstarterkennung" VALUE 0x7A652 TKW_VV_VV_SW 100.0 FORMULA_0023 -50.0 170.0 FORMAT "%4.1" /end CHARACTERISTIC
/begin CHARACTERISTIC K_TUMG_OBD_TMOT_TAN_DELTA_MAX "max. Differenz zwischen tmot und tan fuer Kaltstart" VALUE 0x7A654 TKW_VV_VV_SW 100.0 FORMULA_0074 -1000.0 1000.0 FORMAT "%4.1" /end CHARACTERISTIC
/begin CHARACTERISTIC K_TUMG_OBD_V_MAX "max. Fahrzeuggeschwindigkeit fuer Modellberechnung" VALUE 0x7A644 TKW_VV_VV_SW 100.0 FORMULA_0076 -80.0 360.0 FORMAT "%4.1" /end CHARACTERISTIC
/begin CHARACTERISTIC K_TUMG_OBD_V_MIN "min. Fahrzeuggeschwindigkeit fuer Modellberechnung" VALUE 0x7A642 TKW_VV_VV_SW 100.0 FORMULA_0076 -80.0 360.0 FORMAT "%4.1" /end CHARACTERISTIC
/begin CHARACTERISTIC K_TZ_ABSCH_CTR "Abchalten der Zuendung nach Anzahl von Segmenten " VALUE 0x7A858 TKW_VV_VV_UB 100.0 FORMULA_1027 0.0 255.0 /end CHARACTERISTIC
/begin CHARACTERISTIC K_TZ_DBGR_ANZ_SEG "Anz. Segmente bis ruecksetzen" VALUE 0x7A85C TKW_VV_VV_UB 100.0 FORMULA_1028 1.0 256.0 /end CHARACTERISTIC
/begin CHARACTERISTIC K_TZ_DBGR_AUFREG "Aufregelrampe Druckbegrenzung" VALUE 0x7A85D TKW_VV_VV_UB 100.0 FORMULA_1029 0.0 25.5 /end CHARACTERISTIC
/begin CHARACTERISTIC K_TZ_DBGR_DR_REL "Triggerschwelle DBGR abh. von dr_rel" VALUE 0x7A85A TKW_VV_VV_SW 100.0 FORMULA_0106 0.0 199.9938049316406 FORMAT "%5.2" /end CHARACTERISTIC
/begin CHARACTERISTIC K_TZ_DBGR_DR_REL_TAU "Druckbegrenzung DR_Rel Filter Tau" VALUE 0x7A859 TKW_VV_VV_UB 100.0 FORMULA_0470 5.100000184029341e-003 1.279999971389771 /end CHARACTERISTIC
/begin CHARACTERISTIC K_TZ_DBGR_TMOT "Schwelle fuer DBGR-Fkt. aktive" VALUE 0x7A86A TKW_VV_VV_SW 100.0 FORMULA_0023 -50.0 170.0 FORMAT "%4.1" /end CHARACTERISTIC
/begin CHARACTERISTIC K_TZ_DIAG_MAX_BESTR_TPU "Schwelle fuer Fehlereintrag Dauerbestromung TPU" VALUE 0x7A826 TKW_VV_VV_UB 100.0 FORMULA_1025 0.0 255.0 /end CHARACTERISTIC
/begin CHARACTERISTIC K_TZ_DLY "Verzoegerungszeit fuer tz_stat" VALUE 0x7A86E TKW_VV_VV_UB 100.0 FORMULA_1031 1.0 3.0 /end CHARACTERISTIC
/begin CHARACTERISTIC K_TZ_DN_ZWB "Drehzahl Hysterese fuer ZWB" VALUE 0x7A83A TKW_VV_VV_SW 100.0 FORMULA_0006 0.0 10000.0 /end CHARACTERISTIC
/begin CHARACTERISTIC K_TZ_GRAD_TAU "Filterkonstante fuer tz_grad" VALUE 0x7A868 TKW_VV_VV_UB 100.0 FORMULA_1030 4.000000189989805e-003 0.9959999918937683 /end CHARACTERISTIC
/begin CHARACTERISTIC K_TZ_I_BEGR "Begrenzter Spulenstrom bei SA oder Zuendaussetzer" VALUE 0x7A864 TKW_VV_VV_SW 100.0 FORMULA_1024 0.0 30.0 FORMAT "%4.1" /end CHARACTERISTIC
/begin CHARACTERISTIC K_TZ_I_SA_DELAY "Delay fuer SA Abschaltung" VALUE 0x7A866 TKW_VV_VV_UW 100.0 FORMULA_0109 0.0 5.0 FORMAT "%5.2" /end CHARACTERISTIC
/begin CHARACTERISTIC K_TZ_KH_RF_ZWB "RF Umschaltschwelle fuer ZWB im KH" VALUE 0x7A838 TKW_VV_VV_SW 100.0 FORMULA_0007 0.0 2.0 FORMAT "%6.3" /end CHARACTERISTIC
/begin CHARACTERISTIC K_TZ_KH_ZWB_B1 "Aenderungsbegrenzung Bereich 1 im KH" VALUE 0x7A830 TKW_VV_VV_SW 100.0 FORMULA_1026 0.0 50.0 FORMAT "%4.1" /end CHARACTERISTIC
/begin CHARACTERISTIC K_TZ_KH_ZWB_B2 "Aenderungsbegrenzung Bereich 2 im KH" VALUE 0x7A832 TKW_VV_VV_SW 100.0 FORMULA_1026 0.0 50.0 FORMAT "%4.1" /end CHARACTERISTIC
/begin CHARACTERISTIC K_TZ_KH_ZWB_B3 "Aenderungsbegrenzung Bereich 3 im KH" VALUE 0x7A834 TKW_VV_VV_SW 100.0 FORMULA_1026 0.0 50.0 FORMAT "%4.1" /end CHARACTERISTIC
/begin CHARACTERISTIC K_TZ_KL15_NACHLAUF "Kl15 Nachlauf der Zuendung" VALUE 0x7A854 TKW_VV_VV_UB 100.0 FORMULA_1027 0.0 255.0 /end CHARACTERISTIC
/begin CHARACTERISTIC K_TZ_MAX "fruehester Zuendwinkel" VALUE 0x7A828 TKW_VV_VV_SW 100.0 FORMULA_0102 -50.0 60.0 FORMAT "%4.1" /end CHARACTERISTIC
/begin CHARACTERISTIC K_TZ_MCS "Zuendwinkelkorrektur ueber MCS" VALUE 0x7A83C TKW_VV_VV_SW 100.0 FORMULA_0102 -50.0 60.0 FORMAT "%4.1" /end CHARACTERISTIC
/begin CHARACTERISTIC K_TZ_MCS_Z_ZYL1 "zyl.selektive Zuendwinkelkorrektur ueber MCS" VALUE 0x7A83E TKW_VV_VV_SW 100.0 FORMULA_0102 -50.0 60.0 FORMAT "%4.1" /end CHARACTERISTIC
/begin CHARACTERISTIC K_TZ_MCS_Z_ZYL10 "zyl.selektive Zuendwinkelkorrektur ueber MCS" VALUE 0x7A850 TKW_VV_VV_SW 100.0 FORMULA_0102 -50.0 60.0 FORMAT "%4.1" /end CHARACTERISTIC
/begin CHARACTERISTIC K_TZ_MCS_Z_ZYL2 "zyl.selektive Zuendwinkelkorrektur ueber MCS" VALUE 0x7A840 TKW_VV_VV_SW 100.0 FORMULA_0102 -50.0 60.0 FORMAT "%4.1" /end CHARACTERISTIC
/begin CHARACTERISTIC K_TZ_MCS_Z_ZYL3 "zyl.selektive Zuendwinkelkorrektur ueber MCS" VALUE 0x7A842 TKW_VV_VV_SW 100.0 FORMULA_0102 -50.0 60.0 FORMAT "%4.1" /end CHARACTERISTIC
/begin CHARACTERISTIC K_TZ_MCS_Z_ZYL4 "zyl.selektive Zuendwinkelkorrektur ueber MCS" VALUE 0x7A844 TKW_VV_VV_SW 100.0 FORMULA_0102 -50.0 60.0 FORMAT "%4.1" /end CHARACTERISTIC
/begin CHARACTERISTIC K_TZ_MCS_Z_ZYL5 "zyl.selektive Zuendwinkelkorrektur ueber MCS" VALUE 0x7A846 TKW_VV_VV_SW 100.0 FORMULA_0102 -50.0 60.0 FORMAT "%4.1" /end CHARACTERISTIC
/begin CHARACTERISTIC K_TZ_MCS_Z_ZYL6 "zyl.selektive Zuendwinkelkorrektur ueber MCS" VALUE 0x7A848 TKW_VV_VV_SW 100.0 FORMULA_0102 -50.0 60.0 FORMAT "%4.1" /end CHARACTERISTIC
/begin CHARACTERISTIC K_TZ_MCS_Z_ZYL7 "zyl.selektive Zuendwinkelkorrektur ueber MCS" VALUE 0x7A84A TKW_VV_VV_SW 100.0 FORMULA_0102 -50.0 60.0 FORMAT "%4.1" /end CHARACTERISTIC
/begin CHARACTERISTIC K_TZ_MCS_Z_ZYL8 "zyl.selektive Zuendwinkelkorrektur ueber MCS" VALUE 0x7A84C TKW_VV_VV_SW 100.0 FORMULA_0102 -50.0 60.0 FORMAT "%4.1" /end CHARACTERISTIC
/begin CHARACTERISTIC K_TZ_MCS_Z_ZYL9 "zyl.selektive Zuendwinkelkorrektur ueber MCS" VALUE 0x7A84E TKW_VV_VV_SW 100.0 FORMULA_0102 -50.0 60.0 FORMAT "%4.1" /end CHARACTERISTIC
/begin CHARACTERISTIC K_TZ_NZ_ANZ_ST "" VALUE 0x7A86F TKW_VV_VV_UB 100.0 FORMULA_0003 0.0 255.0 /end CHARACTERISTIC
/begin CHARACTERISTIC K_TZ_NZ_CHARGE_ST "Schliesszeit der Zuendspulen" VALUE 0x7A872 TKW_VV_VV_SW 100.0 FORMULA_1022 0.1000000014901161 5.0 FORMAT "%5.2" /end CHARACTERISTIC
/begin CHARACTERISTIC K_TZ_NZ_DISCHARGE_ST "Schliesszeit der Zuendspulen" VALUE 0x7A870 TKW_VV_VV_SW 100.0 FORMULA_1022 0.1000000014901161 5.0 FORMAT "%5.2" /end CHARACTERISTIC
/begin CHARACTERISTIC K_TZ_NZ_N_MAX "Maximale Drehzahl bei der noch Nachzuender ausgegeben werden." VALUE 0x7A86C TKW_VV_VV_SW 100.0 FORMULA_0006 0.0 10000.0 /end CHARACTERISTIC
/begin CHARACTERISTIC K_TZ_RF_ZWB "RF Umschaltschwelle fuer ZWB" VALUE 0x7A836 TKW_VV_VV_SW 100.0 FORMULA_0007 0.0 2.0 FORMAT "%6.3" /end CHARACTERISTIC
/begin CHARACTERISTIC K_TZ_SZ_AUSS_DELAY "Delay fuer Abschaltung der Stromanhebung" VALUE 0x7A860 TKW_VV_VV_UW 100.0 FORMULA_0109 0.0 5.0 FORMAT "%5.2" /end CHARACTERISTIC
/begin CHARACTERISTIC K_TZ_SZ_CONTROL "Kontrollbits Bit1 -> Zyl1 (1: ueber K_TZ_SZ_MCS 0: ueber Funktion)" VALUE 0x7A824 TKW_VV_VV_UW 100.0 FORMULA_0080 0.0 65535.0 FORMAT "%5.2" /end CHARACTERISTIC
/begin CHARACTERISTIC K_TZ_SZ_I_VERSCHL_OFFS "SZ-Offset bei Kerzenverschleiss" VALUE 0x7A85E TKW_VV_VV_SW 100.0 FORMULA_1024 0.0 5.0 FORMAT "%4.1" /end CHARACTERISTIC
/begin CHARACTERISTIC K_TZ_SZ_MAX "Spulenstrom bei KH" VALUE 0x7A856 TKW_VV_VV_SW 100.0 FORMULA_1024 0.0 30.0 FORMAT "%4.1" /end CHARACTERISTIC
/begin CHARACTERISTIC K_TZ_SZ_MCS "Festwert fuer Schliesszeit" VALUE 0x7A862 TKW_VV_VV_SW 100.0 FORMULA_1022 0.0 5.0 FORMAT "%5.2" /end CHARACTERISTIC
/begin CHARACTERISTIC K_TZ_UB_ERSATZ "Ub-Ersatzwert fuer Schliesszeitberechnung" VALUE 0x7A852 TKW_VV_VV_SW 100.0 FORMULA_0008 0.0 28.0 FORMAT "%4.1" /end CHARACTERISTIC
/begin CHARACTERISTIC K_TZ_ZWB_B1 "Aenderungsbegrenzung Bereich 1" VALUE 0x7A82A TKW_VV_VV_SW 100.0 FORMULA_1026 0.0 50.0 FORMAT "%4.1" /end CHARACTERISTIC
/begin CHARACTERISTIC K_TZ_ZWB_B2 "Aenderungsbegrenzung Bereich 2" VALUE 0x7A82C TKW_VV_VV_SW 100.0 FORMULA_1026 0.0 50.0 FORMAT "%4.1" /end CHARACTERISTIC
/begin CHARACTERISTIC K_TZ_ZWB_B3 "Aenderungsbegrenzung Bereich 3" VALUE 0x7A82E TKW_VV_VV_SW 100.0 FORMULA_1026 0.0 50.0 FORMAT "%4.1" /end CHARACTERISTIC
/begin CHARACTERISTIC K_UEXT_DIAG_MAX "Obere Grenze Versorgungsspannung" VALUE 0x7AE70 TKW_VV_VV_UW 100.0 FORMULA_1033 5.0 6.0 FORMAT "%5.2" /end CHARACTERISTIC
/begin CHARACTERISTIC K_UEXT_DIAG_MIN "Untere Grenze Versorgungsspannung" VALUE 0x7AE6E TKW_VV_VV_UW 100.0 FORMULA_1033 4.0 5.0 FORMAT "%5.2" /end CHARACTERISTIC
/begin CHARACTERISTIC K_UEXT_ERSATZ "Ersatzwert Versorgungsspannung" VALUE 0x7AE72 TKW_VV_VV_UW 100.0 FORMULA_1033 4.0 6.0 FORMAT "%5.2" /end CHARACTERISTIC
/begin CHARACTERISTIC K_UEXT_TAU "Filterkonstante Versorgungsspannung" VALUE 0x7AE6C TKW_VV_VV_UB 100.0 FORMULA_0470 5.100000184029341e-003 1.279999971389771 /end CHARACTERISTIC
/begin CHARACTERISTIC K_UINTERN_AD_1_8_MAX "Maximaler AD-Wert interne Versorgungsspannung" VALUE 0x7AE74 TKW_VV_VV_SW 100.0 FORMULA_0114 0.0 1023.0 /end CHARACTERISTIC
/begin CHARACTERISTIC K_UINTERN_AD_1_8_MIN "Minimaler AD-Wert interne Versorgungsspannung" VALUE 0x7AE76 TKW_VV_VV_SW 100.0 FORMULA_0114 0.0 1023.0 /end CHARACTERISTIC
/begin CHARACTERISTIC K_UINTERN_AD_2_55_MAX "Maximaler AD-Wert interne Versorgungsspannung" VALUE 0x7AE78 TKW_VV_VV_SW 100.0 FORMULA_0114 0.0 1023.0 /end CHARACTERISTIC
/begin CHARACTERISTIC K_UINTERN_AD_2_55_MIN "Minimaler AD-Wert interne Versorgungsspannung" VALUE 0x7AE7A TKW_VV_VV_SW 100.0 FORMULA_0114 0.0 1023.0 /end CHARACTERISTIC
/begin CHARACTERISTIC K_UINTERN_AD_3_3_MAX "Maximaler AD-Wert interne Versorgungsspannung" VALUE 0x7AE7C TKW_VV_VV_SW 100.0 FORMULA_0114 0.0 1023.0 /end CHARACTERISTIC
/begin CHARACTERISTIC K_UINTERN_AD_3_3_MIN "Minimaler AD-Wert interne Versorgungsspannung" VALUE 0x7AE7E TKW_VV_VV_SW 100.0 FORMULA_0114 0.0 1023.0 /end CHARACTERISTIC
/begin CHARACTERISTIC K_UINTERN_FEHLER_ZAEHLER "Maximalwert des Fehlerfilters" VALUE 0x7AE80 TKW_VV_VV_UW 100.0 FORMULA_0010 0.0 65535.0 /end CHARACTERISTIC
/begin CHARACTERISTIC K_VERS_DATEN "Datenversion" VALUE 0x70254 TKW_VV_VV_UW 100.0 FORMULA_0010 0.0 65535.0 /end CHARACTERISTIC
/begin CHARACTERISTIC K_VERS_NAME "Applikateur" VALUE 0x70253 TKW_VV_VV_UB 100.0 FORMULA_0420 0.0 255.0 /end CHARACTERISTIC
/begin CHARACTERISTIC K_VERS_PROG "Programmversion" VALUE 0x70250 TKW_VV_VV_UW 100.0 FORMULA_0010 0.0 65535.0 /end CHARACTERISTIC
/begin CHARACTERISTIC K_VERS_PROZ "Prozessorkennung" VALUE 0x70252 TKW_VV_VV_UB 100.0 FORMULA_0422 0.0 255.0 /end CHARACTERISTIC
/begin CHARACTERISTIC K_ZOELP_AN "Querbeschleunigungsschwelle fuer OELP an" VALUE 0x7B060 TKW_VV_VV_SW 100.0 FORMULA_0123 -20.0 20.0 FORMAT "%5.2" /end CHARACTERISTIC
/begin CHARACTERISTIC K_ZOELP_CFG "Konfig ZOELP" VALUE 0x7B05E TKW_VV_VV_UB 100.0 FORMULA_1053 0.0 255.0 /end CHARACTERISTIC
/begin CHARACTERISTIC K_ZOELP_DIAG_KABELBRUCH "Pumpenstromschwelle fuer Kabelbruch (Openload)" VALUE 0x7B072 TKW_VV_VV_UB 100.0 FORMULA_0349 0.0 25.0 /end CHARACTERISTIC
/begin CHARACTERISTIC K_ZOELP_DIAG_KLEMMEN "Pumpenstromschwelle fuer Klemmen" VALUE 0x7B071 TKW_VV_VV_UB 100.0 FORMULA_0349 0.0 25.0 /end CHARACTERISTIC
/begin CHARACTERISTIC K_ZOELP_DIAG_KURZSCHLUSS "Pumpenstromschwelle fuer Kurzschluss" VALUE 0x7B070 TKW_VV_VV_UB 100.0 FORMULA_0349 0.0 25.0 /end CHARACTERISTIC
/begin CHARACTERISTIC K_ZOELP_DIAG_TIME_WAIT "Wartezeit der Diagnose nach Pumpe an" VALUE 0x7B06A TKW_VV_VV_UB 100.0 FORMULA_0492 0.0 25.5 /end CHARACTERISTIC
/begin CHARACTERISTIC K_ZOELP_FG_N "Freigaengigkeits Schwelle abh. von n" VALUE 0x7B06E TKW_VV_VV_SW 100.0 FORMULA_0006 0.0 10000.0 /end CHARACTERISTIC
/begin CHARACTERISTIC K_ZOELP_FG_T_AN "Freigaengigkeits Anzeit" VALUE 0x7B067 TKW_VV_VV_UB 100.0 FORMULA_0492 0.0 25.5 /end CHARACTERISTIC
/begin CHARACTERISTIC K_ZOELP_FG_T_AUS "Freigaengigkeits Auszeit" VALUE 0x7B068 TKW_VV_VV_UW 100.0 FORMULA_0071 0.0 6553.5 FORMAT "%4.1" /end CHARACTERISTIC
/begin CHARACTERISTIC K_ZOELP_HYS "Querbeschleunigungshysterese fuer OELP an" VALUE 0x7B062 TKW_VV_VV_SW 100.0 FORMULA_0123 -20.0 20.0 FORMAT "%5.2" /end CHARACTERISTIC
/begin CHARACTERISTIC K_ZOELP_MAN_T_AN "ZOELP an Zeit im manuellem Betrieb" VALUE 0x7B065 TKW_VV_VV_UB 100.0 FORMULA_0492 0.0 25.5 /end CHARACTERISTIC
/begin CHARACTERISTIC K_ZOELP_MAN_T_AUS "ZOELP aus Zeit im manuellem Betrieb" VALUE 0x7B066 TKW_VV_VV_UB 100.0 FORMULA_0492 0.0 25.5 /end CHARACTERISTIC
/begin CHARACTERISTIC K_ZOELP_TOEL "Freigaengigkeits und Diagnose-Schwelle abh. von toel" VALUE 0x7B06C TKW_VV_VV_SW 100.0 FORMULA_0023 -50.0 170.0 FORMAT "%4.1" /end CHARACTERISTIC
/begin CHARACTERISTIC K_ZOELP_UM "Vorzeichenumkehr fuer can_ay" VALUE 0x7B064 TKW_VV_VV_SB 100.0 FORMULA_1054 -128.0 127.0 /end CHARACTERISTIC
/begin CHARACTERISTIC KF_TUMG_OBD_MODEL_UPDATE_T_MIN "zeitliche Entprellung fuer Modellberechnung" MAP 0x7A6A8 TKF_SW_SW_UW 100.0 FORMULA_0071 0.0 6553.5 FORMAT "%4.1"
 /begin AXIS_DESCR STD_AXIS tumg_obd_abs_diff FORMULA_0074 6 -1000.0 1000.0 MAX_GRAD 0.0 FORMAT "%4.1" /end AXIS_DESCR
 /begin AXIS_DESCR STD_AXIS tumg_obd_ml_mw FORMULA_0103 3 -100.0 1400.0 MAX_GRAD 0.0 FORMAT "%4.1" /end AXIS_DESCR
/end CHARACTERISTIC
/begin CHARACTERISTIC KF_TUMG_OBD_TKA_V "tumg_obd-Kennfeld tka-v-Offset" MAP 0x7A770 TKF_SW_SW_SW 100.0 FORMULA_0074 -1000.0 1000.0 FORMAT "%4.1"
 /begin AXIS_DESCR STD_AXIS v_vorne FORMULA_0076 8 -80.0 360.0 MAX_GRAD 0.0 FORMAT "%4.1" /end AXIS_DESCR
 /begin AXIS_DESCR STD_AXIS tka FORMULA_0023 9 -50.0 170.0 MAX_GRAD 0.0 FORMAT "%4.1" /end AXIS_DESCR
/end CHARACTERISTIC
/begin CHARACTERISTIC KF_TUMG_OBD_TMOT_ML "tumg_obd-Kennfeld tmot-ml-Offset" MAP 0x7A6E0 TKF_SW_SW_SW 100.0 FORMULA_0074 -1000.0 1000.0 FORMAT "%4.1"
 /begin AXIS_DESCR STD_AXIS ml_b2 FORMULA_0103 7 -100.0 1400.0 MAX_GRAD 0.0 FORMAT "%4.1" /end AXIS_DESCR
 /begin AXIS_DESCR STD_AXIS tmot FORMULA_0023 8 -50.0 170.0 MAX_GRAD 0.0 FORMAT "%4.1" /end AXIS_DESCR
/end CHARACTERISTIC
/begin CHARACTERISTIC KF_TZ_GRUND "Grundkennfeld Zuendwinkel fuer TL" MAP 0x7A99A TKF_SW_SW_SW 100.0 FORMULA_0102 -50.0 60.0 FORMAT "%4.1" /begin AXIS_DESCR STD_AXIS n FORMULA_0006 18 0.0 10000.0 MAX_GRAD 0.0 /end AXIS_DESCR
 /begin AXIS_DESCR STD_AXIS rf FORMULA_0007 12 0.0 2.0 MAX_GRAD 0.0 FORMAT "%6.3" /end AXIS_DESCR
/end CHARACTERISTIC
/begin CHARACTERISTIC KF_TZ_I "Stromkennfeld fuer die SZ-Berechnung" MAP 0x7AC74 TKF_SW_SW_SW 100.0 FORMULA_1024 0.0 30.0 FORMAT "%4.1" /begin AXIS_DESCR STD_AXIS n FORMULA_0006 5 0.0 10000.0 MAX_GRAD 0.0 /end AXIS_DESCR
 /begin AXIS_DESCR STD_AXIS rf FORMULA_0007 7 0.0 2.0 MAX_GRAD 0.0 FORMAT "%6.3" /end AXIS_DESCR
/end CHARACTERISTIC
/begin CHARACTERISTIC KF_TZ_I_SZ "Schliesszeit Kennfeld" MAP 0x7AD52 TKF_SW_SW_SW 100.0 FORMULA_1022 0.0 26.21360015869141 FORMAT "%5.2"
 /begin AXIS_DESCR STD_AXIS tz_sz_i FORMULA_1024 5 0.0 30.0 MAX_GRAD 0.0 FORMAT "%4.1" /end AXIS_DESCR
 /begin AXIS_DESCR STD_AXIS ub FORMULA_0008 7 0.0 28.0 MAX_GRAD 0.0 FORMAT "%4.1" /end AXIS_DESCR
/end CHARACTERISTIC
/begin CHARACTERISTIC KF_TZ_LL "Leerlauf Zuendwinkel = f{n,rf}" MAP 0x7A92C TKF_SW_SW_SW 100.0 FORMULA_0102 -50.0 60.0 FORMAT "%4.1" /begin AXIS_DESCR STD_AXIS n FORMULA_0006 10 0.0 10000.0 MAX_GRAD 0.0 /end AXIS_DESCR
 /begin AXIS_DESCR STD_AXIS rf_m FORMULA_0007 4 0.0 2.0 MAX_GRAD 0.0 FORMAT "%6.3" /end AXIS_DESCR
/end CHARACTERISTIC
/begin CHARACTERISTIC KF_TZ_MIN "spaetest zulaessiger Zuendwinkel" MAP 0x7ACD4 TKF_SW_SW_SW 100.0 FORMULA_0102 -50.0 60.0 FORMAT "%4.1" /begin AXIS_DESCR STD_AXIS n FORMULA_0006 8 0.0 10000.0 MAX_GRAD 0.0 /end AXIS_DESCR
 /begin AXIS_DESCR STD_AXIS rf FORMULA_0007 6 0.0 2.0 MAX_GRAD 0.0 FORMAT "%6.3" /end AXIS_DESCR
/end CHARACTERISTIC
/begin CHARACTERISTIC KF_TZ_NZ_ANZ "Anzahl der Nachzuendungnen" MAP 0x7ADB2 TKF_SW_SW_UB 100.0 FORMULA_0003 0.0 255.0
 /begin AXIS_DESCR STD_AXIS rf FORMULA_0007 8 0.0 2.0 MAX_GRAD 0.0 FORMAT "%6.3" /end AXIS_DESCR
 /begin AXIS_DESCR STD_AXIS n FORMULA_0006 4 0.0 10000.0 MAX_GRAD 0.0 /end AXIS_DESCR
/end CHARACTERISTIC
/begin CHARACTERISTIC KF_TZ_NZ_CHARGE "Bestromungszeit fuer Nachzuendpulse" MAP 0x7ADEC TKF_SW_SW_SW 100.0 FORMULA_1022 0.1000000014901161 5.0 FORMAT "%5.2"
 /begin AXIS_DESCR STD_AXIS ub FORMULA_0008 4 0.0 28.0 MAX_GRAD 0.0 FORMAT "%4.1" /end AXIS_DESCR
 /begin AXIS_DESCR STD_AXIS n FORMULA_0006 4 0.0 10000.0 MAX_GRAD 0.0 /end AXIS_DESCR
/end CHARACTERISTIC
/begin CHARACTERISTIC KF_TZ_TKORR "Temperaturabh. Zuendwinkelkorrektur uber tmot und rf" MAP 0x7AE1E TKF_SW_SW_SW 100.0 FORMULA_0102 -50.0 60.0 FORMAT "%4.1" /begin AXIS_DESCR STD_AXIS n FORMULA_0006 4 0.0 10000.0 MAX_GRAD 0.0 /end AXIS_DESCR
 /begin AXIS_DESCR STD_AXIS rf_b1 FORMULA_0007 5 0.0 2.0 MAX_GRAD 0.0 FORMAT "%6.3" /end AXIS_DESCR
/end CHARACTERISTIC
/begin CHARACTERISTIC KF_TZ_VL "Vollast Zuendwinkel" MAP 0x7AB88 TKF_SW_SW_SW 100.0 FORMULA_0102 -50.0 60.0 FORMAT "%4.1" /begin AXIS_DESCR STD_AXIS n FORMULA_0006 18 0.0 10000.0 MAX_GRAD 0.0 /end AXIS_DESCR
 /begin AXIS_DESCR STD_AXIS pumg FORMULA_0075 3 400.0 1200.0 MAX_GRAD 0.0 FORMAT "%4.1" /end AXIS_DESCR
/end CHARACTERISTIC
/begin CHARACTERISTIC KL_TUMG_OBD_MAX_ERROR "Zaehler fuer Fehlerentprellung" CURVE 0x7A6A0 TKL_SW_VV_UB 100.0 FORMULA_0003 0.0 255.0
 /begin AXIS_DESCR STD_AXIS tumg_obd_tan_filter_delta FORMULA_0074 2 -1000.0 1000.0 MAX_GRAD 0.0 FORMAT "%4.1" /end AXIS_DESCR
/end CHARACTERISTIC
/begin CHARACTERISTIC KL_TUMG_OBD_MOD_TIME_ML_MIN "min. Motorlaufzeit fuer stabile Bedingungen" CURVE 0x7A68E TKL_SW_VV_UW 100.0 FORMULA_0626 0.0 65535.0
 /begin AXIS_DESCR STD_AXIS zust_tmot_start FORMULA_0023 4 -50.0 170.0 MAX_GRAD 0.0 FORMAT "%4.1" /end AXIS_DESCR
/end CHARACTERISTIC
/begin CHARACTERISTIC KL_TUMG_OBD_V "Tau fuer tumg_obd_model_offset2" CURVE 0x7A66C TKL_SW_VV_UW 100.0 FORMULA_0681 0.1000000014901161 6553.5 FORMAT "%5.2"
 /begin AXIS_DESCR STD_AXIS v_vorne FORMULA_0076 8 -80.0 360.0 MAX_GRAD 0.0 FORMAT "%4.1" /end AXIS_DESCR
/end CHARACTERISTIC
/begin CHARACTERISTIC KL_TZ_DBGR_OFFS "Druckbegrenzungsoffset" CURVE 0x7A8A2 TKL_SW_VV_SW 100.0 FORMULA_0102 -50.0 60.0 FORMAT "%4.1" /begin AXIS_DESCR STD_AXIS n FORMULA_0006 7 0.0 10000.0 MAX_GRAD 0.0 /end AXIS_DESCR /end CHARACTERISTIC
/begin CHARACTERISTIC KL_TZ_DBGR_TRIGGER "Triggerschwelle fuer dr_rel Grad." CURVE 0x7A890 TKL_SW_VV_SW 100.0 FORMULA_0260 -655000.0 655000.0 /begin AXIS_DESCR STD_AXIS n FORMULA_0006 4 0.0 10000.0 MAX_GRAD 0.0 /end AXIS_DESCR /end CHARACTERISTIC
/begin CHARACTERISTIC KL_TZ_MIN_TMOT "Offset spaetest zulaessiger Zuendwinkel" CURVE 0x7AC32 TKL_SW_VV_SW 100.0 FORMULA_0102 -50.0 60.0 FORMAT "%4.1"
 /begin AXIS_DESCR STD_AXIS tmot FORMULA_0023 4 -50.0 170.0 MAX_GRAD 0.0 FORMAT "%4.1" /end AXIS_DESCR
/end CHARACTERISTIC
/begin CHARACTERISTIC KL_TZ_NZ_DISCHARGE "Funkenbrenndauerbegrenzung vor Nachzuendpulsen" CURVE 0x7AC5E TKL_SW_VV_SW 100.0 FORMULA_1022 0.1000000014901161 5.0 FORMAT "%5.2" /begin AXIS_DESCR STD_AXIS n FORMULA_0006 5 0.0 10000.0 MAX_GRAD 0.0 /end AXIS_DESCR /end CHARACTERISTIC
/begin CHARACTERISTIC KL_TZ_PHASE "Zuendwinkel Schaubabschaltern = f{ n }" CURVE 0x7AC20 TKL_SW_VV_SW 100.0 FORMULA_0102 -50.0 60.0 FORMAT "%4.1" /begin AXIS_DESCR STD_AXIS n FORMULA_0006 4 0.0 10000.0 MAX_GRAD 0.0 /end AXIS_DESCR /end CHARACTERISTIC
/begin CHARACTERISTIC KL_TZ_START_N "Start Zuendwinkel = f{ n }" CURVE 0x7A874 TKL_SW_VV_SW 100.0 FORMULA_0102 -50.0 60.0 FORMAT "%4.1" /begin AXIS_DESCR STD_AXIS n FORMULA_0006 3 0.0 10000.0 MAX_GRAD 0.0 /end AXIS_DESCR /end CHARACTERISTIC
/begin CHARACTERISTIC KL_TZ_START_TMOT "Offset Start Zuendwinkel = f{ tmot }" CURVE 0x7A882 TKL_SW_VV_SW 100.0 FORMULA_0102 -50.0 60.0 FORMAT "%4.1"
 /begin AXIS_DESCR STD_AXIS tmot FORMULA_0023 3 -50.0 170.0 MAX_GRAD 0.0 FORMAT "%4.1" /end AXIS_DESCR
/end CHARACTERISTIC
/begin CHARACTERISTIC KL_TZ_SZ_LAM_OFFS "Schliesszeitoffset aus Lambda" CURVE 0x7A8C0 TKL_UW_VV_SW 100.0 FORMULA_1024 0.0 30.0 FORMAT "%4.1"
 /begin AXIS_DESCR STD_AXIS lam_ist_mw_b1 FORMULA_0025 7 0.0 3.999000072479248 MAX_GRAD 0.0 FORMAT "%6.3" /end AXIS_DESCR
/end CHARACTERISTIC
/begin CHARACTERISTIC KL_TZ_SZ_START_OFFS "Schliesszeitoffset aus TMOT" CURVE 0x7A8F8 TKL_SW_VV_SW 100.0 FORMULA_1024 0.0 30.0 FORMAT "%4.1"
 /begin AXIS_DESCR STD_AXIS tmot_start FORMULA_0023 6 -50.0 170.0 MAX_GRAD 0.0 FORMAT "%4.1" /end AXIS_DESCR
/end CHARACTERISTIC
/begin CHARACTERISTIC KL_TZ_SZ_STARTOFFS_TIME "Zeit fuer Schliesszeitoffset im Start" CURVE 0x7A912 TKL_SW_VV_UW 100.0 FORMULA_0021 0.0 655.0 FORMAT "%5.2"
 /begin AXIS_DESCR STD_AXIS tmot_start FORMULA_0023 6 -50.0 170.0 MAX_GRAD 0.0 FORMAT "%4.1" /end AXIS_DESCR
/end CHARACTERISTIC
/begin CHARACTERISTIC KL_TZ_SZ_TMOT_OFFS "Schliesszeitoffset aus TMOT" CURVE 0x7A8DE TKL_SW_VV_SW 100.0 FORMULA_1024 0.0 30.0 FORMAT "%4.1"
 /begin AXIS_DESCR STD_AXIS tmot FORMULA_0023 6 -50.0 170.0 MAX_GRAD 0.0 FORMAT "%4.1" /end AXIS_DESCR
/end CHARACTERISTIC
/begin CHARACTERISTIC KL_TZ_TKORR_F "Regler Korrekturfaktor" CURVE 0x7AC44 TKL_SW_VV_UW 100.0 FORMULA_0073 0.0 4.0 FORMAT "%6.3"
 /begin AXIS_DESCR STD_AXIS tmot FORMULA_0023 6 -50.0 170.0 MAX_GRAD 0.0 FORMAT "%4.1" /end AXIS_DESCR
/end CHARACTERISTIC
/begin MEASUREMENT cana_estat "Error-Status-Register" UWORD FORMULA_USER1 0 0.0 0.0 65535.0 READ_WRITE ECU_ADDRESS 0x3070A0 /end MEASUREMENT
/begin MEASUREMENT canb_estat "Error-Status-Register" UWORD FORMULA_USER1 0 0.0 0.0 65535.0 READ_WRITE ECU_ADDRESS 0x3074A0 /end MEASUREMENT
/begin MEASUREMENT qadca_qasr0 "qadca_qasr0, Statusregister0" UWORD FORMULA_USER1 0 0.0 0.0 65535.0 READ_WRITE ECU_ADDRESS 0x304810 /end MEASUREMENT
/begin MEASUREMENT qadca_qasr1 "qadca_qasr1, Statusregister1" UWORD FORMULA_USER1 0 0.0 0.0 65535.0 READ_WRITE ECU_ADDRESS 0x304812 /end MEASUREMENT
/begin MEASUREMENT qadcb_qasr0 "qadcb_qasr0, Statusregister0" UWORD FORMULA_USER1 0 0.0 0.0 65535.0 READ_WRITE ECU_ADDRESS 0x304C10 /end MEASUREMENT
/begin MEASUREMENT qadcb_qasr1 "qadcb_qasr1, Statusregister1" UWORD FORMULA_USER1 0 0.0 0.0 65535.0 READ_WRITE ECU_ADDRESS 0x304C12 /end MEASUREMENT
/begin MEASUREMENT sys_sypcr "Watchdog-Register" ULONG FORMULA_USER1 0 0.0 0.0 4294967295.0 READ_WRITE ECU_ADDRESS 0x2FC004 /end MEASUREMENT
/begin MEASUREMENT tpu_a_htu "Hight-Time-Updater." UWORD FORMULA_KW9 0 0.0 0.0 2394.403076171875 READ_WRITE ECU_ADDRESS 0x304110 /end MEASUREMENT
/begin MEASUREMENT tpu_a_kw_cnt_720 "720° Zahnzaehler." UWORD FORMULA_KW1 0 0.0 0.0 119.0 READ_WRITE BIT_MASK 0xFF00 ECU_ADDRESS 0x30410C /end MEASUREMENT
/begin MEASUREMENT tpu_a_kw_cnt_cor "Feinaufloesung vom Zahnzaehler." UWORD FORMULA_KW6 0 0.0 0.0 42747.69140625 READ_WRITE BIT_MASK 0xFF00 ECU_ADDRESS 0x30410A /end MEASUREMENT
/begin MEASUREMENT tpu_a_kw_count "Kurbelwellenposition." UWORD FORMULA_KW10 0 0.0 0.0 719.989013671875 READ_WRITE ECU_ADDRESS 0x304112 /end MEASUREMENT
/begin MEASUREMENT tpu_a_kw_irq "Interrupt request." UWORD FORMULA_KW1 0 0.0 0.0 255.0 READ_WRITE BIT_MASK 0xFF00 ECU_ADDRESS 0x304100 /end MEASUREMENT
/begin MEASUREMENT tpu_a_kw_irq_ack "Interruptquittierung." UWORD FORMULA_KW1 0 0.0 0.0 255.0 READ_WRITE BIT_MASK 0xFF00 ECU_ADDRESS 0x304102 /end MEASUREMENT
/begin MEASUREMENT tpu_a_kw_irq_zahn "Interruptzahn." UWORD FORMULA_KW4 0 0.0 0.0 119.0 READ_WRITE BIT_MASK 0xFF ECU_ADDRESS 0x304102 /end MEASUREMENT
/begin MEASUREMENT tpu_a_kw_last_event_time "Zeitpunkt vom letzten Ereignis." ULONG FORMULA_KW8 0 0.0 0.0 2396.745 READ_WRITE BIT_MASK 0xFFFFFF ECU_ADDRESS 0x30411C /end MEASUREMENT
/begin MEASUREMENT tpu_a_kw_last_period_high "8 msb der letzten Periode." UWORD FORMULA_KW12 0 0.0 0.0 255.0 READ_WRITE BIT_MASK 0xFF00 ECU_ADDRESS 0x304116 /end MEASUREMENT
/begin MEASUREMENT tpu_a_kw_last_period_low "16 lsb der letzten Periode." UWORD FORMULA_KW11 0 0.0 0.0 9.362099647521973 READ_WRITE ECU_ADDRESS 0x304114 /end MEASUREMENT
/begin MEASUREMENT tpu_a_kw_last_trans_time "Zeitpunkt letzter Zahnflanke." ULONG FORMULA_KW8 0 0.0 0.0 2396.745 READ_WRITE BIT_MASK 0xFFFFFF ECU_ADDRESS 0x3041DA /end MEASUREMENT
/begin MEASUREMENT tpu_a_kw_link "Link-Vektor." UWORD FORMULA_KW4 0 0.0 0.0 65535.0 READ_WRITE ECU_ADDRESS 0x304106 /end MEASUREMENT
/begin MEASUREMENT tpu_a_kw_max_teeth_unsync "Max Anzahl Flanken zur Lueckensuche." UWORD FORMULA_KW1 0 0.0 0.0 127.0 READ_WRITE BIT_MASK 0xFF00 ECU_ADDRESS 0x30410A /end MEASUREMENT
/begin MEASUREMENT tpu_a_kw_next_segm_tooth "Naechster Segmentzahn." UWORD FORMULA_KW4 0 0.0 0.0 119.0 READ_WRITE BIT_MASK 0xFF ECU_ADDRESS 0x30410A /end MEASUREMENT
/begin MEASUREMENT tpu_a_kw_norm_period "normierte Periode." ULONG FORMULA_KW13 0 0.0 0.0 2396.745 READ_WRITE BIT_MASK 0xFFFFFF00 ECU_ADDRESS 0x30411A /end MEASUREMENT
/begin MEASUREMENT tpu_a_kw_prev_period "Vorhergehende Periode." ULONG FORMULA_KW8 0 0.0 0.0 2396.745 READ_WRITE BIT_MASK 0xFFFFFF ECU_ADDRESS 0x304116 /end MEASUREMENT
/begin MEASUREMENT tpu_a_kw_segm_length "Segmentlaenge." UWORD FORMULA_KW4 0 0.0 0.0 119.0 READ_WRITE BIT_MASK 0xFF ECU_ADDRESS 0x304108 /end MEASUREMENT
/begin MEASUREMENT tpu_a_kw_segm_start "Segmentstart." UWORD FORMULA_KW1 0 0.0 0.0 119.0 READ_WRITE BIT_MASK 0xFF00 ECU_ADDRESS 0x304108 /end MEASUREMENT
/begin MEASUREMENT tpu_a_kw_segm_zeit "Segmentzeitpunkt." ULONG FORMULA_KW8 0 0.0 0.0 2396.745 READ_WRITE BIT_MASK 0xFFFFFF ECU_ADDRESS 0x30410C /end MEASUREMENT
/begin MEASUREMENT tpu_a_kw_state "Zustand." UWORD FORMULA_KW3 0 0.0 0.0 15.0 READ_WRITE BIT_MASK 0xF ECU_ADDRESS 0x304100 /end MEASUREMENT
/begin MEASUREMENT tpu_a_kw_time_out "Unterdrehzahl." UWORD FORMULA_KW5 0 0.0 4.0 10000.0 READ_WRITE ECU_ADDRESS 0x304104 /end MEASUREMENT
/begin MEASUREMENT tpu_a_kw_wait_teeth "Zahnentprellung vor Lueckensuche." UWORD FORMULA_KW4 0 0.0 0.0 127.0 READ_WRITE BIT_MASK 0xFF ECU_ADDRESS 0x30410A /end MEASUREMENT
/begin MEASUREMENT tpu_aa_angle_duration_kis "TPU AA angle duration." UWORD FORMULA_AA1 0 0.0 0.0 719.989013671875 READ_WRITE ECU_ADDRESS 0x3045F2 /end MEASUREMENT
/begin MEASUREMENT tpu_aa_angle_duration_td "TPU AA angle duration." UWORD FORMULA_AA1 0 0.0 0.0 719.989013671875 READ_WRITE ECU_ADDRESS 0x304582 /end MEASUREMENT
/begin MEASUREMENT tpu_aa_angle_period_kis "TPU AA angle period." UWORD FORMULA_AA1 0 0.0 0.0 719.989013671875 READ_WRITE ECU_ADDRESS 0x3045F4 /end MEASUREMENT
/begin MEASUREMENT tpu_aa_angle_period_td "TPU AA angle period." UWORD FORMULA_AA1 0 0.0 0.0 719.989013671875 READ_WRITE ECU_ADDRESS 0x304584 /end MEASUREMENT
/begin MEASUREMENT tpu_aa_angle_start_kis "TPU AA angle start." UWORD FORMULA_AA1 0 0.0 0.0 719.989013671875 READ_WRITE ECU_ADDRESS 0x3045F0 /end MEASUREMENT
/begin MEASUREMENT tpu_aa_angle_start_td "TPU AA angle start." UWORD FORMULA_AA1 0 0.0 0.0 719.989013671875 READ_WRITE ECU_ADDRESS 0x304580 /end MEASUREMENT
/begin MEASUREMENT tpu_aa_max_time_kis "Max Active Time Limit." ULONG FORMULA_AA2 0 0.0 0.0 2396.745 READ_WRITE BIT_MASK 0xFFFFFF ECU_ADDRESS 0x3045F8 /end MEASUREMENT
/begin MEASUREMENT tpu_aa_max_time_td "Max Active Time Limit." ULONG FORMULA_AA2 0 0.0 0.0 2396.745 READ_WRITE BIT_MASK 0xFFFFFF ECU_ADDRESS 0x304588 /end MEASUREMENT
/begin MEASUREMENT tpu_aa_ref_angle_kis "TPU AA reference period." UWORD FORMULA_AA1 0 0.0 0.0 719.989013671875 READ_WRITE ECU_ADDRESS 0x3045FE /end MEASUREMENT
/begin MEASUREMENT tpu_aa_ref_angle_td "TPU AA reference period." UWORD FORMULA_AA1 0 0.0 0.0 719.989013671875 READ_WRITE ECU_ADDRESS 0x30458E /end MEASUREMENT
/begin MEASUREMENT tpu_aa_start_time_high_kis "8 msb start time." UWORD FORMULA_AA4 0 0.0 0.0 255.0 READ_WRITE BIT_MASK 0xFF00 ECU_ADDRESS 0x3045F8 /end MEASUREMENT
/begin MEASUREMENT tpu_aa_start_time_high_td "8 msb start time." UWORD FORMULA_AA4 0 0.0 0.0 255.0 READ_WRITE BIT_MASK 0xFF00 ECU_ADDRESS 0x304588 /end MEASUREMENT
/begin MEASUREMENT tpu_aa_start_time_low_kis "16 lsb start time." UWORD FORMULA_AA3 0 0.0 0.0 9.362099647521973 READ_WRITE ECU_ADDRESS 0x3045F6 /end MEASUREMENT
/begin MEASUREMENT tpu_aa_start_time_low_td "16 lsb start time." UWORD FORMULA_AA3 0 0.0 0.0 9.362099647521973 READ_WRITE ECU_ADDRESS 0x304586 /end MEASUREMENT
/begin MEASUREMENT tpu_aa_temp_angle_kis "TPU AA temp period." UWORD FORMULA_AA1 0 0.0 0.0 719.989013671875 READ_WRITE ECU_ADDRESS 0x3045FC /end MEASUREMENT
/begin MEASUREMENT tpu_aa_temp_angle_td "TPU AA temp period." UWORD FORMULA_AA1 0 0.0 0.0 719.989013671875 READ_WRITE ECU_ADDRESS 0x30458C /end MEASUREMENT
/begin MEASUREMENT tpu_apg_angle_period_b1 "TPU APG angle period." UWORD FORMULA_APG1 0 0.0 0.0 719.989013671875 READ_WRITE ECU_ADDRESS 0x3041E2 /end MEASUREMENT
/begin MEASUREMENT tpu_apg_angle_period_b2 "TPU APG angle period." UWORD FORMULA_APG1 0 0.0 0.0 719.989013671875 READ_WRITE ECU_ADDRESS 0x3041F2 /end MEASUREMENT
/begin MEASUREMENT tpu_apg_channel_b1 "Letzter Zuendkanal." UWORD FORMULA_APG4 0 0.0 0.0 15.0 READ_WRITE BIT_MASK 0x7800 ECU_ADDRESS 0x3041EC /end MEASUREMENT
/begin MEASUREMENT tpu_apg_channel_b2 "Letzter Zuendkanal." UWORD FORMULA_APG4 0 0.0 0.0 15.0 READ_WRITE BIT_MASK 0x7800 ECU_ADDRESS 0x3041FC /end MEASUREMENT
/begin MEASUREMENT tpu_apg_delta_time_cpu_b1 "Delta CPU Zeit." UWORD FORMULA_APG3 0 0.0 0.0 9.362099647521973 READ_WRITE ECU_ADDRESS 0x3041E6 /end MEASUREMENT
/begin MEASUREMENT tpu_apg_delta_time_cpu_b2 "Delta CPU Zeit." UWORD FORMULA_APG3 0 0.0 0.0 9.362099647521973 READ_WRITE ECU_ADDRESS 0x3041F6 /end MEASUREMENT
/begin MEASUREMENT tpu_apg_delta_time_tpu_b1 "Delta TPU Zeit." UWORD FORMULA_APG3 0 0.0 0.0 9.362099647521973 READ_WRITE ECU_ADDRESS 0x3041E8 /end MEASUREMENT
/begin MEASUREMENT tpu_apg_delta_time_tpu_b2 "Delta TPU Zeit." UWORD FORMULA_APG3 0 0.0 0.0 9.362099647521973 READ_WRITE ECU_ADDRESS 0x3041F8 /end MEASUREMENT
/begin MEASUREMENT tpu_apg_ign_time_b1 "Zeitpunkt letzte Zuendung." ULONG FORMULA_APG2 0 0.0 0.0 2396.745 READ_WRITE BIT_MASK 0xFFFFFF ECU_ADDRESS 0x3041EC /end MEASUREMENT
/begin MEASUREMENT tpu_apg_ign_time_b2 "Zeitpunkt letzte Zuendung." ULONG FORMULA_APG2 0 0.0 0.0 2396.745 READ_WRITE BIT_MASK 0xFFFFFF ECU_ADDRESS 0x3041FC /end MEASUREMENT
/begin MEASUREMENT tpu_apg_min_time_b1 "Minimale Pulszeit." UWORD FORMULA_APG3 0 0.0 0.0 9.362099647521973 READ_WRITE ECU_ADDRESS 0x3041E4 /end MEASUREMENT
/begin MEASUREMENT tpu_apg_min_time_b2 "Minimale Pulszeit." UWORD FORMULA_APG3 0 0.0 0.0 9.362099647521973 READ_WRITE ECU_ADDRESS 0x3041F4 /end MEASUREMENT
/begin MEASUREMENT tpu_apg_start_angle_b1 "TPU APG start angle." UWORD FORMULA_APG1 0 0.0 0.0 719.989013671875 READ_WRITE ECU_ADDRESS 0x3041E0 /end MEASUREMENT
/begin MEASUREMENT tpu_apg_start_angle_b2 "TPU APG start angle." UWORD FORMULA_APG1 0 0.0 0.0 719.989013671875 READ_WRITE ECU_ADDRESS 0x3041F0 /end MEASUREMENT
/begin MEASUREMENT tpu_apg_temp_angle_b1 "TPU APG temp angle." UWORD FORMULA_APG1 0 0.0 0.0 719.989013671875 READ_WRITE ECU_ADDRESS 0x3041EA /end MEASUREMENT
/begin MEASUREMENT tpu_apg_temp_angle_b2 "TPU APG temp angle." UWORD FORMULA_APG1 0 0.0 0.0 719.989013671875 READ_WRITE ECU_ADDRESS 0x3041FA /end MEASUREMENT
/begin MEASUREMENT tpu_b_htu "Hight-Time-Updater." UWORD FORMULA_KW9 0 0.0 0.0 2394.403076171875 READ_WRITE ECU_ADDRESS 0x304510 /end MEASUREMENT
/begin MEASUREMENT tpu_b_kw_cnt_720 "720° Zahnzaehler." UWORD FORMULA_KW1 0 0.0 0.0 119.0 READ_WRITE BIT_MASK 0xFF00 ECU_ADDRESS 0x30450C /end MEASUREMENT
/begin MEASUREMENT tpu_b_kw_cnt_cor "Feinaufloesung vom Zahnzaehler." UWORD FORMULA_KW6 0 0.0 0.0 42747.69140625 READ_WRITE BIT_MASK 0xFF00 ECU_ADDRESS 0x30450A /end MEASUREMENT
/begin MEASUREMENT tpu_b_kw_count "Kurbelwellenposition." UWORD FORMULA_KW10 0 0.0 0.0 719.989013671875 READ_WRITE ECU_ADDRESS 0x304512 /end MEASUREMENT
/begin MEASUREMENT tpu_b_kw_irq "Interrupt request." UWORD FORMULA_KW1 0 0.0 0.0 255.0 READ_WRITE BIT_MASK 0xFF00 ECU_ADDRESS 0x304500 /end MEASUREMENT
/begin MEASUREMENT tpu_b_kw_irq_ack "Interruptquittierung." UWORD FORMULA_KW1 0 0.0 0.0 255.0 READ_WRITE BIT_MASK 0xFF00 ECU_ADDRESS 0x304502 /end MEASUREMENT
/begin MEASUREMENT tpu_b_kw_irq_zahn "Interruptzahn." UWORD FORMULA_KW4 0 0.0 0.0 119.0 READ_WRITE BIT_MASK 0xFF ECU_ADDRESS 0x304502 /end MEASUREMENT
/begin MEASUREMENT tpu_b_kw_last_event_time "Zeitpunkt vom letzten Ereignis." ULONG FORMULA_KW8 0 0.0 0.0 2396.745 READ_WRITE BIT_MASK 0xFFFFFF ECU_ADDRESS 0x30451C /end MEASUREMENT
/begin MEASUREMENT tpu_b_kw_last_period_high "8 msb der letzten Periode." UWORD FORMULA_KW12 0 0.0 0.0 255.0 READ_WRITE BIT_MASK 0xFF00 ECU_ADDRESS 0x304516 /end MEASUREMENT
/begin MEASUREMENT tpu_b_kw_last_period_low "16 lsb der letzten Periode." UWORD FORMULA_KW11 0 0.0 0.0 9.362099647521973 READ_WRITE ECU_ADDRESS 0x304514 /end MEASUREMENT
/begin MEASUREMENT tpu_b_kw_last_trans_time "Zeitpunkt letzter Zahnflanke." ULONG FORMULA_KW8 0 0.0 0.0 2396.745 READ_WRITE BIT_MASK 0xFFFFFF ECU_ADDRESS 0x3045DA /end MEASUREMENT
/begin MEASUREMENT tpu_b_kw_link "Link-Vektor." UWORD FORMULA_KW4 0 0.0 0.0 65535.0 READ_WRITE ECU_ADDRESS 0x304506 /end MEASUREMENT
/begin MEASUREMENT tpu_b_kw_max_teeth_unsync "Max Anzahl Flanken zur Lueckensuche." UWORD FORMULA_KW1 0 0.0 0.0 127.0 READ_WRITE BIT_MASK 0xFF00 ECU_ADDRESS 0x30450A /end MEASUREMENT
/begin MEASUREMENT tpu_b_kw_next_segm_tooth "Naechster Segmentzahn." UWORD FORMULA_KW4 0 0.0 0.0 119.0 READ_WRITE BIT_MASK 0xFF ECU_ADDRESS 0x30450A /end MEASUREMENT
/begin MEASUREMENT tpu_b_kw_norm_period "normierte Periode." ULONG FORMULA_KW13 0 0.0 0.0 2396.745 READ_WRITE BIT_MASK 0xFFFFFF00 ECU_ADDRESS 0x30451A /end MEASUREMENT
/begin MEASUREMENT tpu_b_kw_prev_period "Vorhergehende Periode." ULONG FORMULA_KW8 0 0.0 0.0 2396.745 READ_WRITE BIT_MASK 0xFFFFFF ECU_ADDRESS 0x304516 /end MEASUREMENT
/begin MEASUREMENT tpu_b_kw_segm_length "Segmentlaenge." UWORD FORMULA_KW4 0 0.0 0.0 119.0 READ_WRITE BIT_MASK 0xFF ECU_ADDRESS 0x304508 /end MEASUREMENT
/begin MEASUREMENT tpu_b_kw_segm_start "Segmentstart." UWORD FORMULA_KW1 0 0.0 0.0 119.0 READ_WRITE BIT_MASK 0xFF00 ECU_ADDRESS 0x304508 /end MEASUREMENT
/begin MEASUREMENT tpu_b_kw_segm_zeit "Segmentzeitpunkt." ULONG FORMULA_KW8 0 0.0 0.0 2396.745 READ_WRITE BIT_MASK 0xFFFFFF ECU_ADDRESS 0x30450C /end MEASUREMENT
/begin MEASUREMENT tpu_b_kw_state "Zustand." UWORD FORMULA_KW3 0 0.0 0.0 15.0 READ_WRITE BIT_MASK 0xF ECU_ADDRESS 0x304500 /end MEASUREMENT
/begin MEASUREMENT tpu_b_kw_time_out "Unterdrehzahl." UWORD FORMULA_KW5 0 0.0 4.0 10000.0 READ_WRITE ECU_ADDRESS 0x304504 /end MEASUREMENT
/begin MEASUREMENT tpu_b_kw_wait_teeth "Zahnentprellung vor Lueckensuche." UWORD FORMULA_KW4 0 0.0 0.0 127.0 READ_WRITE BIT_MASK 0xFF ECU_ADDRESS 0x30450A /end MEASUREMENT
/begin MEASUREMENT tpu_b_kw_win_length_1 "Laenge Messfenster 1." UWORD FORMULA_KW4 0 0.0 0.0 119.0 READ_WRITE BIT_MASK 0xFF ECU_ADDRESS 0x3041CA /end MEASUREMENT
/begin MEASUREMENT tpu_b_kw_win_length_2 "Laenge Messfenster 2." UWORD FORMULA_KW4 0 0.0 0.0 119.0 READ_WRITE BIT_MASK 0xFF ECU_ADDRESS 0x3045CA /end MEASUREMENT
/begin MEASUREMENT tpu_b_kw_win_period_1 "Periode Messfenster 1." UWORD FORMULA_KW4 0 0.0 0.0 119.0 READ_WRITE BIT_MASK 0xFF ECU_ADDRESS 0x3041DC /end MEASUREMENT
/begin MEASUREMENT tpu_b_kw_win_period_2 "Periode Messfenster 2." UWORD FORMULA_KW4 0 0.0 0.0 119.0 READ_WRITE BIT_MASK 0xFF ECU_ADDRESS 0x3045DC /end MEASUREMENT
/begin MEASUREMENT tpu_b_kw_win_start_1 "Start Messfenster 1." UWORD FORMULA_KW1 0 0.0 0.0 119.0 READ_WRITE BIT_MASK 0xFF00 ECU_ADDRESS 0x3041CA /end MEASUREMENT
/begin MEASUREMENT tpu_b_kw_win_start_2 "Start Messfenster 2." UWORD FORMULA_KW1 0 0.0 0.0 119.0 READ_WRITE BIT_MASK 0xFF00 ECU_ADDRESS 0x3045CA /end MEASUREMENT
/begin MEASUREMENT tpu_b_kw_win_start_time_high_1 "8 MSB Zeitpunkt Start Messfenster 1." UWORD FORMULA_KW12 0 0.0 0.0 255.0 READ_WRITE BIT_MASK 0xFF00 ECU_ADDRESS 0x3041CE /end MEASUREMENT
/begin MEASUREMENT tpu_b_kw_win_start_time_high_2 "8 MSB Zeitpunkt Start Messfenster 2." UWORD FORMULA_KW12 0 0.0 0.0 255.0 READ_WRITE BIT_MASK 0xFF00 ECU_ADDRESS 0x3045CE /end MEASUREMENT
/begin MEASUREMENT tpu_b_kw_win_start_time_low_1 "16 LSB Zeitpunkt Start Messfenster 1." UWORD FORMULA_KW11 0 0.0 0.0 9.362099647521973 READ_WRITE ECU_ADDRESS 0x3041CC /end MEASUREMENT
/begin MEASUREMENT tpu_b_kw_win_start_time_low_2 "16 LSB Zeitpunkt Start Messfenster 2." UWORD FORMULA_KW11 0 0.0 0.0 9.362099647521973 READ_WRITE ECU_ADDRESS 0x3045CC /end MEASUREMENT
/begin MEASUREMENT tpu_b_kw_win_temp_1 "Temp Zahn Messfenster 1." UWORD FORMULA_KW4 0 0.0 0.0 119.0 READ_WRITE BIT_MASK 0xFF ECU_ADDRESS 0x3041CE /end MEASUREMENT
/begin MEASUREMENT tpu_b_kw_win_temp_2 "Temp Zahn Messfenster 2." UWORD FORMULA_KW4 0 0.0 0.0 119.0 READ_WRITE BIT_MASK 0xFF ECU_ADDRESS 0x3045CE /end MEASUREMENT
/begin MEASUREMENT tpu_b_kw_win_time_1 "Zeit Messfenster 1." ULONG FORMULA_KW8 0 0.0 0.0 2396.745 READ_WRITE BIT_MASK 0xFFFFFF ECU_ADDRESS 0x3041DC /end MEASUREMENT
/begin MEASUREMENT tpu_b_kw_win_time_2 "Zeit Messfenster 2." ULONG FORMULA_KW8 0 0.0 0.0 2396.745 READ_WRITE BIT_MASK 0xFFFFFF ECU_ADDRESS 0x3045DC /end MEASUREMENT
/begin MEASUREMENT tpu_dio_config_irq_dsp "TPU DIO config." UWORD FORMULA_DIO1 0 0.0 0.0 511.0 READ_WRITE BIT_MASK 0x1FF ECU_ADDRESS 0x304550 /end MEASUREMENT
/begin MEASUREMENT tpu_dio_irq_cnt_irq_dsp "TPU DIO interrupt counter." UWORD FORMULA_DIO2 0 0.0 0.0 65535.0 READ_WRITE ECU_ADDRESS 0x304552 /end MEASUREMENT
/begin MEASUREMENT tpu_dio_pin_level_irq_dsp "TPU DIO pin level." UWORD FORMULA_DIO2 0 0 0.0 255.0 READ_WRITE BIT_MASK 0x1 ECU_ADDRESS 0x304550 /end MEASUREMENT
/begin MEASUREMENT tpu_dio_pulse_time_irq_dsp "TPU DIO pulse time." UWORD FORMULA_DIO3 0 0.0 0.0 9.362099647521973 READ_WRITE BIT_MASK 0x7FFF ECU_ADDRESS 0x304552 /end MEASUREMENT
/begin MEASUREMENT tpu_fi_no_samples_kw_rot "TPU FI number of samples." UWORD FORMULA_FI2 0 0.0 0.0 255.0 READ_WRITE BIT_MASK 0xFF00 ECU_ADDRESS 0x304532 /end MEASUREMENT
/begin MEASUREMENT tpu_fi_period_kw_rot "TPU FI period." UWORD FORMULA_FI1 0 0.0 0.0 9.362099647521973 READ_WRITE BIT_MASK 0xFFFE ECU_ADDRESS 0x304530 /end MEASUREMENT
/begin MEASUREMENT tpu_fi_pin_level_kw_rot "TPU FI pin level." UWORD FORMULA_FI3 0 0 0.0 255.0 READ_WRITE BIT_MASK 0x1 ECU_ADDRESS 0x304530 /end MEASUREMENT
/begin MEASUREMENT tpu_fi_sample_cnt_kw_rot "TPU FI sample counter." UWORD FORMULA_FI3 0 0.0 0.0 255.0 READ_WRITE BIT_MASK 0xFF ECU_ADDRESS 0x304532 /end MEASUREMENT
/begin MEASUREMENT tpu_ign_double_fire_ctrl "TPU IGN Anforderung Doppelzuendung." UWORD FORMULA_IGN4 0 0 0.0 255.0 READ_WRITE BIT_MASK 0x8000 ECU_ADDRESS 0x30412E /end MEASUREMENT
/begin MEASUREMENT tpu_ign_double_fire_zyl1 "TPU IGN Doppelzuendung." UWORD FORMULA_IGN4 0 0 0.0 255.0 READ_WRITE BIT_MASK 0x8000 ECU_ADDRESS 0x304128 /end MEASUREMENT
/begin MEASUREMENT tpu_ign_double_fire_zyl10 "TPU IGN Doppelzuendung." UWORD FORMULA_IGN4 0 0 0.0 255.0 READ_WRITE BIT_MASK 0x8000 ECU_ADDRESS 0x3041B8 /end MEASUREMENT
/begin MEASUREMENT tpu_ign_double_fire_zyl2 "TPU IGN Doppelzuendung." UWORD FORMULA_IGN4 0 0 0.0 255.0 READ_WRITE BIT_MASK 0x8000 ECU_ADDRESS 0x304138 /end MEASUREMENT
/begin MEASUREMENT tpu_ign_double_fire_zyl3 "TPU IGN Doppelzuendung." UWORD FORMULA_IGN4 0 0 0.0 255.0 READ_WRITE BIT_MASK 0x8000 ECU_ADDRESS 0x304148 /end MEASUREMENT
/begin MEASUREMENT tpu_ign_double_fire_zyl4 "TPU IGN Doppelzuendung." UWORD FORMULA_IGN4 0 0 0.0 255.0 READ_WRITE BIT_MASK 0x8000 ECU_ADDRESS 0x304158 /end MEASUREMENT
/begin MEASUREMENT tpu_ign_double_fire_zyl5 "TPU IGN Doppelzuendung." UWORD FORMULA_IGN4 0 0 0.0 255.0 READ_WRITE BIT_MASK 0x8000 ECU_ADDRESS 0x304168 /end MEASUREMENT
/begin MEASUREMENT tpu_ign_double_fire_zyl6 "TPU IGN Doppelzuendung." UWORD FORMULA_IGN4 0 0 0.0 255.0 READ_WRITE BIT_MASK 0x8000 ECU_ADDRESS 0x304178 /end MEASUREMENT
/begin MEASUREMENT tpu_ign_double_fire_zyl7 "TPU IGN Doppelzuendung." UWORD FORMULA_IGN4 0 0 0.0 255.0 READ_WRITE BIT_MASK 0x8000 ECU_ADDRESS 0x304188 /end MEASUREMENT
/begin MEASUREMENT tpu_ign_double_fire_zyl8 "TPU IGN Doppelzuendung." UWORD FORMULA_IGN4 0 0 0.0 255.0 READ_WRITE BIT_MASK 0x8000 ECU_ADDRESS 0x304198 /end MEASUREMENT
/begin MEASUREMENT tpu_ign_double_fire_zyl9 "TPU IGN Doppelzuendung." UWORD FORMULA_IGN4 0 0 0.0 255.0 READ_WRITE BIT_MASK 0x8000 ECU_ADDRESS 0x3041A8 /end MEASUREMENT
/begin MEASUREMENT tpu_ign_dwell_time_zyl1 "TPU IGN Bestromungszeit." UWORD FORMULA_IGN2 0 0.0 0.0 37.44839859008789 READ_WRITE ECU_ADDRESS 0x304122 /end MEASUREMENT
/begin MEASUREMENT tpu_ign_dwell_time_zyl10 "TPU IGN Bestromungszeit." UWORD FORMULA_IGN2 0 0.0 0.0 37.44839859008789 READ_WRITE ECU_ADDRESS 0x3041B2 /end MEASUREMENT
/begin MEASUREMENT tpu_ign_dwell_time_zyl2 "TPU IGN Bestromungszeit." UWORD FORMULA_IGN2 0 0.0 0.0 37.44839859008789 READ_WRITE ECU_ADDRESS 0x304132 /end MEASUREMENT
/begin MEASUREMENT tpu_ign_dwell_time_zyl3 "TPU IGN Bestromungszeit." UWORD FORMULA_IGN2 0 0.0 0.0 37.44839859008789 READ_WRITE ECU_ADDRESS 0x304142 /end MEASUREMENT
/begin MEASUREMENT tpu_ign_dwell_time_zyl4 "TPU IGN Bestromungszeit." UWORD FORMULA_IGN2 0 0.0 0.0 37.44839859008789 READ_WRITE ECU_ADDRESS 0x304152 /end MEASUREMENT
/begin MEASUREMENT tpu_ign_dwell_time_zyl5 "TPU IGN Bestromungszeit." UWORD FORMULA_IGN2 0 0.0 0.0 37.44839859008789 READ_WRITE ECU_ADDRESS 0x304162 /end MEASUREMENT
/begin MEASUREMENT tpu_ign_dwell_time_zyl6 "TPU IGN Bestromungszeit." UWORD FORMULA_IGN2 0 0.0 0.0 37.44839859008789 READ_WRITE ECU_ADDRESS 0x304172 /end MEASUREMENT
/begin MEASUREMENT tpu_ign_dwell_time_zyl7 "TPU IGN Bestromungszeit." UWORD FORMULA_IGN2 0 0.0 0.0 37.44839859008789 READ_WRITE ECU_ADDRESS 0x304182 /end MEASUREMENT
/begin MEASUREMENT tpu_ign_dwell_time_zyl8 "TPU IGN Bestromungszeit." UWORD FORMULA_IGN2 0 0.0 0.0 37.44839859008789 READ_WRITE ECU_ADDRESS 0x304192 /end MEASUREMENT
/begin MEASUREMENT tpu_ign_dwell_time_zyl9 "TPU IGN Bestromungszeit." UWORD FORMULA_IGN2 0 0.0 0.0 37.44839859008789 READ_WRITE ECU_ADDRESS 0x3041A2 /end MEASUREMENT
/begin MEASUREMENT tpu_ign_err_cnt_zyl1 "TPU IGN MSG Fehlerzaehler." UWORD FORMULA_IGN9 0 0.0 0.0 15.0 READ_WRITE BIT_MASK 0xE00 ECU_ADDRESS 0x304128 /end MEASUREMENT
/begin MEASUREMENT tpu_ign_err_cnt_zyl10 "TPU IGN MSG Fehlerzaehler." UWORD FORMULA_IGN9 0 0.0 0.0 15.0 READ_WRITE BIT_MASK 0xE00 ECU_ADDRESS 0x3041B8 /end MEASUREMENT
/begin MEASUREMENT tpu_ign_err_cnt_zyl2 "TPU IGN MSG Fehlerzaehler." UWORD FORMULA_IGN9 0 0.0 0.0 15.0 READ_WRITE BIT_MASK 0xE00 ECU_ADDRESS 0x304138 /end MEASUREMENT
/begin MEASUREMENT tpu_ign_err_cnt_zyl3 "TPU IGN MSG Fehlerzaehler." UWORD FORMULA_IGN9 0 0.0 0.0 15.0 READ_WRITE BIT_MASK 0xE00 ECU_ADDRESS 0x304148 /end MEASUREMENT
/begin MEASUREMENT tpu_ign_err_cnt_zyl4 "TPU IGN MSG Fehlerzaehler." UWORD FORMULA_IGN9 0 0.0 0.0 15.0 READ_WRITE BIT_MASK 0xE00 ECU_ADDRESS 0x304158 /end MEASUREMENT
/begin MEASUREMENT tpu_ign_err_cnt_zyl5 "TPU IGN MSG Fehlerzaehler." UWORD FORMULA_IGN9 0 0.0 0.0 15.0 READ_WRITE BIT_MASK 0xE00 ECU_ADDRESS 0x304168 /end MEASUREMENT
/begin MEASUREMENT tpu_ign_err_cnt_zyl6 "TPU IGN MSG Fehlerzaehler." UWORD FORMULA_IGN9 0 0.0 0.0 15.0 READ_WRITE BIT_MASK 0xE00 ECU_ADDRESS 0x304178 /end MEASUREMENT
/begin MEASUREMENT tpu_ign_err_cnt_zyl7 "TPU IGN MSG Fehlerzaehler." UWORD FORMULA_IGN9 0 0.0 0.0 15.0 READ_WRITE BIT_MASK 0xE00 ECU_ADDRESS 0x304188 /end MEASUREMENT
/begin MEASUREMENT tpu_ign_err_cnt_zyl8 "TPU IGN MSG Fehlerzaehler." UWORD FORMULA_IGN9 0 0.0 0.0 15.0 READ_WRITE BIT_MASK 0xE00 ECU_ADDRESS 0x304198 /end MEASUREMENT
/begin MEASUREMENT tpu_ign_err_cnt_zyl9 "TPU IGN MSG Fehlerzaehler." UWORD FORMULA_IGN9 0 0.0 0.0 15.0 READ_WRITE BIT_MASK 0xE00 ECU_ADDRESS 0x3041A8 /end MEASUREMENT
/begin MEASUREMENT tpu_ign_glob_temp_1 "TPU IGN globaler Winkel." UWORD FORMULA_IGN1 0 0.0 0.0 719.989013671875 READ_WRITE ECU_ADDRESS 0x30419E /end MEASUREMENT
/begin MEASUREMENT tpu_ign_glob_temp_2 "TPU IGN globaler Zeit." UWORD FORMULA_IGN2 0 0.0 0.0 37.44839859008789 READ_WRITE ECU_ADDRESS 0x3041AE /end MEASUREMENT
/begin MEASUREMENT tpu_ign_max_sparks "TPU IGN max Anzahl Nachzuender." UWORD FORMULA_IGN3 0 0.0 0.0 255.0 READ_WRITE BIT_MASK 0xFF ECU_ADDRESS 0x30415E /end MEASUREMENT
/begin MEASUREMENT tpu_ign_min_msg_pos "TPU IGN min Winkelabstand zur MSG Ausgabe." UWORD FORMULA_IGN1 0 0.0 0.0 719.989013671875 READ_WRITE ECU_ADDRESS 0x30416E /end MEASUREMENT
/begin MEASUREMENT tpu_ign_miss_fire_active_zyl1 "TPU IGN Zuendaussetzer aktiv." UWORD FORMULA_IGN6 0 0 0.0 255.0 READ_WRITE BIT_MASK 0x2000 ECU_ADDRESS 0x304128 /end MEASUREMENT
/begin MEASUREMENT tpu_ign_miss_fire_active_zyl10 "TPU IGN Zuendaussetzer aktiv." UWORD FORMULA_IGN6 0 0 0.0 255.0 READ_WRITE BIT_MASK 0x2000 ECU_ADDRESS 0x3041B8 /end MEASUREMENT
/begin MEASUREMENT tpu_ign_miss_fire_active_zyl2 "TPU IGN Zuendaussetzer aktiv." UWORD FORMULA_IGN6 0 0 0.0 255.0 READ_WRITE BIT_MASK 0x2000 ECU_ADDRESS 0x304138 /end MEASUREMENT
/begin MEASUREMENT tpu_ign_miss_fire_active_zyl3 "TPU IGN Zuendaussetzer aktiv." UWORD FORMULA_IGN6 0 0 0.0 255.0 READ_WRITE BIT_MASK 0x2000 ECU_ADDRESS 0x304148 /end MEASUREMENT
/begin MEASUREMENT tpu_ign_miss_fire_active_zyl4 "TPU IGN Zuendaussetzer aktiv." UWORD FORMULA_IGN6 0 0 0.0 255.0 READ_WRITE BIT_MASK 0x2000 ECU_ADDRESS 0x304158 /end MEASUREMENT
/begin MEASUREMENT tpu_ign_miss_fire_active_zyl5 "TPU IGN Zuendaussetzer aktiv." UWORD FORMULA_IGN6 0 0 0.0 255.0 READ_WRITE BIT_MASK 0x2000 ECU_ADDRESS 0x304168 /end MEASUREMENT
/begin MEASUREMENT tpu_ign_miss_fire_active_zyl6 "TPU IGN Zuendaussetzer aktiv." UWORD FORMULA_IGN6 0 0 0.0 255.0 READ_WRITE BIT_MASK 0x2000 ECU_ADDRESS 0x304178 /end MEASUREMENT
/begin MEASUREMENT tpu_ign_miss_fire_active_zyl7 "TPU IGN Zuendaussetzer aktiv." UWORD FORMULA_IGN6 0 0 0.0 255.0 READ_WRITE BIT_MASK 0x2000 ECU_ADDRESS 0x304188 /end MEASUREMENT
/begin MEASUREMENT tpu_ign_miss_fire_active_zyl8 "TPU IGN Zuendaussetzer aktiv." UWORD FORMULA_IGN6 0 0 0.0 255.0 READ_WRITE BIT_MASK 0x2000 ECU_ADDRESS 0x304198 /end MEASUREMENT
/begin MEASUREMENT tpu_ign_miss_fire_active_zyl9 "TPU IGN Zuendaussetzer aktiv." UWORD FORMULA_IGN6 0 0 0.0 255.0 READ_WRITE BIT_MASK 0x2000 ECU_ADDRESS 0x3041A8 /end MEASUREMENT
/begin MEASUREMENT tpu_ign_miss_fire_request_zyl1 "TPU IGN Anforderung Zuendaussetzer." UWORD FORMULA_IGN5 0 0 0.0 255.0 READ_WRITE BIT_MASK 0x4000 ECU_ADDRESS 0x304128 /end MEASUREMENT
/begin MEASUREMENT tpu_ign_miss_fire_request_zyl10 "TPU IGN Anforderung Zuendaussetzer." UWORD FORMULA_IGN5 0 0 0.0 255.0 READ_WRITE BIT_MASK 0x4000 ECU_ADDRESS 0x3041B8 /end MEASUREMENT
/begin MEASUREMENT tpu_ign_miss_fire_request_zyl2 "TPU IGN Anforderung Zuendaussetzer." UWORD FORMULA_IGN5 0 0 0.0 255.0 READ_WRITE BIT_MASK 0x4000 ECU_ADDRESS 0x304138 /end MEASUREMENT
/begin MEASUREMENT tpu_ign_miss_fire_request_zyl3 "TPU IGN Anforderung Zuendaussetzer." UWORD FORMULA_IGN5 0 0 0.0 255.0 READ_WRITE BIT_MASK 0x4000 ECU_ADDRESS 0x304148 /end MEASUREMENT
/begin MEASUREMENT tpu_ign_miss_fire_request_zyl4 "TPU IGN Anforderung Zuendaussetzer." UWORD FORMULA_IGN5 0 0 0.0 255.0 READ_WRITE BIT_MASK 0x4000 ECU_ADDRESS 0x304158 /end MEASUREMENT
/begin MEASUREMENT tpu_ign_miss_fire_request_zyl5 "TPU IGN Anforderung Zuendaussetzer." UWORD FORMULA_IGN5 0 0 0.0 255.0 READ_WRITE BIT_MASK 0x4000 ECU_ADDRESS 0x304168 /end MEASUREMENT
/begin MEASUREMENT tpu_ign_miss_fire_request_zyl6 "TPU IGN Anforderung Zuendaussetzer." UWORD FORMULA_IGN5 0 0 0.0 255.0 READ_WRITE BIT_MASK 0x4000 ECU_ADDRESS 0x304178 /end MEASUREMENT
/begin MEASUREMENT tpu_ign_miss_fire_request_zyl7 "TPU IGN Anforderung Zuendaussetzer." UWORD FORMULA_IGN5 0 0 0.0 255.0 READ_WRITE BIT_MASK 0x4000 ECU_ADDRESS 0x304188 /end MEASUREMENT
/begin MEASUREMENT tpu_ign_miss_fire_request_zyl8 "TPU IGN Anforderung Zuendaussetzer." UWORD FORMULA_IGN5 0 0 0.0 255.0 READ_WRITE BIT_MASK 0x4000 ECU_ADDRESS 0x304198 /end MEASUREMENT
/begin MEASUREMENT tpu_ign_miss_fire_request_zyl9 "TPU IGN Anforderung Zuendaussetzer." UWORD FORMULA_IGN5 0 0 0.0 255.0 READ_WRITE BIT_MASK 0x4000 ECU_ADDRESS 0x3041A8 /end MEASUREMENT
/begin MEASUREMENT tpu_ign_miss_fire_time "TPU IGN Bestromungszeit Fehlzuendung." UWORD FORMULA_IGN10 0 0.0 0.0 0.2914285957813263 READ_WRITE BIT_MASK 0xFF00 ECU_ADDRESS 0x30415E /end MEASUREMENT
/begin MEASUREMENT tpu_ign_msg_err_zyl1 "TPU IGN MSG Uebertragungsfehler (zu spaet)." UWORD FORMULA_IGN7 0 0 0.0 255.0 READ_WRITE BIT_MASK 0x1000 ECU_ADDRESS 0x304128 /end MEASUREMENT
/begin MEASUREMENT tpu_ign_msg_err_zyl10 "TPU IGN MSG Uebertragungsfehler (zu spaet)." UWORD FORMULA_IGN7 0 0 0.0 255.0 READ_WRITE BIT_MASK 0x1000 ECU_ADDRESS 0x3041B8 /end MEASUREMENT
/begin MEASUREMENT tpu_ign_msg_err_zyl2 "TPU IGN MSG Uebertragungsfehler (zu spaet)." UWORD FORMULA_IGN7 0 0 0.0 255.0 READ_WRITE BIT_MASK 0x1000 ECU_ADDRESS 0x304138 /end MEASUREMENT
/begin MEASUREMENT tpu_ign_msg_err_zyl3 "TPU IGN MSG Uebertragungsfehler (zu spaet)." UWORD FORMULA_IGN7 0 0 0.0 255.0 READ_WRITE BIT_MASK 0x1000 ECU_ADDRESS 0x304148 /end MEASUREMENT
/begin MEASUREMENT tpu_ign_msg_err_zyl4 "TPU IGN MSG Uebertragungsfehler (zu spaet)." UWORD FORMULA_IGN7 0 0 0.0 255.0 READ_WRITE BIT_MASK 0x1000 ECU_ADDRESS 0x304158 /end MEASUREMENT
/begin MEASUREMENT tpu_ign_msg_err_zyl5 "TPU IGN MSG Uebertragungsfehler (zu spaet)." UWORD FORMULA_IGN7 0 0 0.0 255.0 READ_WRITE BIT_MASK 0x1000 ECU_ADDRESS 0x304168 /end MEASUREMENT
/begin MEASUREMENT tpu_ign_msg_err_zyl6 "TPU IGN MSG Uebertragungsfehler (zu spaet)." UWORD FORMULA_IGN7 0 0 0.0 255.0 READ_WRITE BIT_MASK 0x1000 ECU_ADDRESS 0x304178 /end MEASUREMENT
/begin MEASUREMENT tpu_ign_msg_err_zyl7 "TPU IGN MSG Uebertragungsfehler (zu spaet)." UWORD FORMULA_IGN7 0 0 0.0 255.0 READ_WRITE BIT_MASK 0x1000 ECU_ADDRESS 0x304188 /end MEASUREMENT
/begin MEASUREMENT tpu_ign_msg_err_zyl8 "TPU IGN MSG Uebertragungsfehler (zu spaet)." UWORD FORMULA_IGN7 0 0 0.0 255.0 READ_WRITE BIT_MASK 0x1000 ECU_ADDRESS 0x304198 /end MEASUREMENT
/begin MEASUREMENT tpu_ign_msg_err_zyl9 "TPU IGN MSG Uebertragungsfehler (zu spaet)." UWORD FORMULA_IGN7 0 0 0.0 255.0 READ_WRITE BIT_MASK 0x1000 ECU_ADDRESS 0x3041A8 /end MEASUREMENT
/begin MEASUREMENT tpu_ign_msg_start_time "TPU IGN Zeit MSG Startbit." UWORD FORMULA_IGN11 0 0.0 0.0 9.362099647521973 READ_WRITE ECU_ADDRESS 0x30417E /end MEASUREMENT
/begin MEASUREMENT tpu_ign_msg_zero_time "TPU IGN Zeit MSG Nullbit." UWORD FORMULA_IGN11 0 0.0 0.0 9.362099647521973 READ_WRITE ECU_ADDRESS 0x30418E /end MEASUREMENT
/begin MEASUREMENT tpu_ign_msg_zyl1 "TPU IGN IC MSG." UWORD FORMULA_IGN3 0 0.0 0.0 127.0 READ_WRITE ECU_ADDRESS 0x304126 /end MEASUREMENT
/begin MEASUREMENT tpu_ign_msg_zyl10 "TPU IGN IC MSG." UWORD FORMULA_IGN3 0 0.0 0.0 127.0 READ_WRITE ECU_ADDRESS 0x3041B6 /end MEASUREMENT
/begin MEASUREMENT tpu_ign_msg_zyl2 "TPU IGN IC MSG." UWORD FORMULA_IGN3 0 0.0 0.0 127.0 READ_WRITE ECU_ADDRESS 0x304136 /end MEASUREMENT
/begin MEASUREMENT tpu_ign_msg_zyl3 "TPU IGN IC MSG." UWORD FORMULA_IGN3 0 0.0 0.0 127.0 READ_WRITE ECU_ADDRESS 0x304146 /end MEASUREMENT
/begin MEASUREMENT tpu_ign_msg_zyl4 "TPU IGN IC MSG." UWORD FORMULA_IGN3 0 0.0 0.0 127.0 READ_WRITE ECU_ADDRESS 0x304156 /end MEASUREMENT
/begin MEASUREMENT tpu_ign_msg_zyl5 "TPU IGN IC MSG." UWORD FORMULA_IGN3 0 0.0 0.0 127.0 READ_WRITE ECU_ADDRESS 0x304166 /end MEASUREMENT
/begin MEASUREMENT tpu_ign_msg_zyl6 "TPU IGN IC MSG." UWORD FORMULA_IGN3 0 0.0 0.0 127.0 READ_WRITE ECU_ADDRESS 0x304176 /end MEASUREMENT
/begin MEASUREMENT tpu_ign_msg_zyl7 "TPU IGN IC MSG." UWORD FORMULA_IGN3 0 0.0 0.0 127.0 READ_WRITE ECU_ADDRESS 0x304186 /end MEASUREMENT
/begin MEASUREMENT tpu_ign_msg_zyl8 "TPU IGN IC MSG." UWORD FORMULA_IGN3 0 0.0 0.0 127.0 READ_WRITE ECU_ADDRESS 0x304196 /end MEASUREMENT
/begin MEASUREMENT tpu_ign_msg_zyl9 "TPU IGN IC MSG." UWORD FORMULA_IGN3 0 0.0 0.0 127.0 READ_WRITE ECU_ADDRESS 0x3041A6 /end MEASUREMENT
/begin MEASUREMENT tpu_ign_pin_level_zyl1 "TPU IGN Pin Level." UWORD FORMULA_IGN8 0 0 0.0 255.0 READ_WRITE BIT_MASK 0x100 ECU_ADDRESS 0x304128 /end MEASUREMENT
/begin MEASUREMENT tpu_ign_pin_level_zyl10 "TPU IGN Pin Level." UWORD FORMULA_IGN8 0 0 0.0 255.0 READ_WRITE BIT_MASK 0x100 ECU_ADDRESS 0x3041B8 /end MEASUREMENT
/begin MEASUREMENT tpu_ign_pin_level_zyl2 "TPU IGN Pin Level." UWORD FORMULA_IGN8 0 0 0.0 255.0 READ_WRITE BIT_MASK 0x100 ECU_ADDRESS 0x304138 /end MEASUREMENT
/begin MEASUREMENT tpu_ign_pin_level_zyl3 "TPU IGN Pin Level." UWORD FORMULA_IGN8 0 0 0.0 255.0 READ_WRITE BIT_MASK 0x100 ECU_ADDRESS 0x304148 /end MEASUREMENT
/begin MEASUREMENT tpu_ign_pin_level_zyl4 "TPU IGN Pin Level." UWORD FORMULA_IGN8 0 0 0.0 255.0 READ_WRITE BIT_MASK 0x100 ECU_ADDRESS 0x304158 /end MEASUREMENT
/begin MEASUREMENT tpu_ign_pin_level_zyl5 "TPU IGN Pin Level." UWORD FORMULA_IGN8 0 0 0.0 255.0 READ_WRITE BIT_MASK 0x100 ECU_ADDRESS 0x304168 /end MEASUREMENT
/begin MEASUREMENT tpu_ign_pin_level_zyl6 "TPU IGN Pin Level." UWORD FORMULA_IGN8 0 0 0.0 255.0 READ_WRITE BIT_MASK 0x100 ECU_ADDRESS 0x304178 /end MEASUREMENT
/begin MEASUREMENT tpu_ign_pin_level_zyl7 "TPU IGN Pin Level." UWORD FORMULA_IGN8 0 0 0.0 255.0 READ_WRITE BIT_MASK 0x100 ECU_ADDRESS 0x304188 /end MEASUREMENT
/begin MEASUREMENT tpu_ign_pin_level_zyl8 "TPU IGN Pin Level." UWORD FORMULA_IGN8 0 0 0.0 255.0 READ_WRITE BIT_MASK 0x100 ECU_ADDRESS 0x304198 /end MEASUREMENT
/begin MEASUREMENT tpu_ign_pin_level_zyl9 "TPU IGN Pin Level." UWORD FORMULA_IGN8 0 0 0.0 255.0 READ_WRITE BIT_MASK 0x100 ECU_ADDRESS 0x3041A8 /end MEASUREMENT
/begin MEASUREMENT tpu_ign_spark_off_time "TPU IGN Passivzeit Nachzuendpulse." UWORD FORMULA_IGN2 0 0.0 0.0 37.44839859008789 READ_WRITE ECU_ADDRESS 0x30414E /end MEASUREMENT
/begin MEASUREMENT tpu_ign_spark_time "TPU IGN Aktivezeit Nachzuendpulse." UWORD FORMULA_IGN2 0 0.0 0.0 37.44839859008789 READ_WRITE ECU_ADDRESS 0x30413E /end MEASUREMENT
/begin MEASUREMENT tpu_ign_tdc_angle_zyl1 "TPU IGN ZOT Lage." UWORD FORMULA_IGN1 0 0.0 0.0 719.989013671875 READ_WRITE ECU_ADDRESS 0x304124 /end MEASUREMENT
/begin MEASUREMENT tpu_ign_tdc_angle_zyl10 "TPU IGN ZOT Lage." UWORD FORMULA_IGN1 0 0.0 0.0 719.989013671875 READ_WRITE ECU_ADDRESS 0x3041B4 /end MEASUREMENT
/begin MEASUREMENT tpu_ign_tdc_angle_zyl2 "TPU IGN ZOT Lage." UWORD FORMULA_IGN1 0 0.0 0.0 719.989013671875 READ_WRITE ECU_ADDRESS 0x304134 /end MEASUREMENT
/begin MEASUREMENT tpu_ign_tdc_angle_zyl3 "TPU IGN ZOT Lage." UWORD FORMULA_IGN1 0 0.0 0.0 719.989013671875 READ_WRITE ECU_ADDRESS 0x304144 /end MEASUREMENT
/begin MEASUREMENT tpu_ign_tdc_angle_zyl4 "TPU IGN ZOT Lage." UWORD FORMULA_IGN1 0 0.0 0.0 719.989013671875 READ_WRITE ECU_ADDRESS 0x304154 /end MEASUREMENT
/begin MEASUREMENT tpu_ign_tdc_angle_zyl5 "TPU IGN ZOT Lage." UWORD FORMULA_IGN1 0 0.0 0.0 719.989013671875 READ_WRITE ECU_ADDRESS 0x304164 /end MEASUREMENT
/begin MEASUREMENT tpu_ign_tdc_angle_zyl6 "TPU IGN ZOT Lage." UWORD FORMULA_IGN1 0 0.0 0.0 719.989013671875 READ_WRITE ECU_ADDRESS 0x304174 /end MEASUREMENT
/begin MEASUREMENT tpu_ign_tdc_angle_zyl7 "TPU IGN ZOT Lage." UWORD FORMULA_IGN1 0 0.0 0.0 719.989013671875 READ_WRITE ECU_ADDRESS 0x304184 /end MEASUREMENT
/begin MEASUREMENT tpu_ign_tdc_angle_zyl8 "TPU IGN ZOT Lage." UWORD FORMULA_IGN1 0 0.0 0.0 719.989013671875 READ_WRITE ECU_ADDRESS 0x304194 /end MEASUREMENT
/begin MEASUREMENT tpu_ign_tdc_angle_zyl9 "TPU IGN ZOT Lage." UWORD FORMULA_IGN1 0 0.0 0.0 719.989013671875 READ_WRITE ECU_ADDRESS 0x3041A4 /end MEASUREMENT
/begin MEASUREMENT tpu_ign_temp_1_zyl1 "TPU IGN temp 1." UWORD FORMULA_IGN3 0 0.0 0.0 255.0 READ_WRITE BIT_MASK 0xFF ECU_ADDRESS 0x304128 /end MEASUREMENT
/begin MEASUREMENT tpu_ign_temp_1_zyl10 "TPU IGN temp 1." UWORD FORMULA_IGN3 0 0.0 0.0 255.0 READ_WRITE BIT_MASK 0xFF ECU_ADDRESS 0x3041B8 /end MEASUREMENT
/begin MEASUREMENT tpu_ign_temp_1_zyl2 "TPU IGN temp 1." UWORD FORMULA_IGN3 0 0.0 0.0 255.0 READ_WRITE BIT_MASK 0xFF ECU_ADDRESS 0x304138 /end MEASUREMENT
/begin MEASUREMENT tpu_ign_temp_1_zyl3 "TPU IGN temp 1." UWORD FORMULA_IGN3 0 0.0 0.0 255.0 READ_WRITE BIT_MASK 0xFF ECU_ADDRESS 0x304148 /end MEASUREMENT
/begin MEASUREMENT tpu_ign_temp_1_zyl4 "TPU IGN temp 1." UWORD FORMULA_IGN3 0 0.0 0.0 255.0 READ_WRITE BIT_MASK 0xFF ECU_ADDRESS 0x304158 /end MEASUREMENT
/begin MEASUREMENT tpu_ign_temp_1_zyl5 "TPU IGN temp 1." UWORD FORMULA_IGN3 0 0.0 0.0 255.0 READ_WRITE BIT_MASK 0xFF ECU_ADDRESS 0x304168 /end MEASUREMENT
/begin MEASUREMENT tpu_ign_temp_1_zyl6 "TPU IGN temp 1." UWORD FORMULA_IGN3 0 0.0 0.0 255.0 READ_WRITE BIT_MASK 0xFF ECU_ADDRESS 0x304178 /end MEASUREMENT
/begin MEASUREMENT tpu_ign_temp_1_zyl7 "TPU IGN temp 1." UWORD FORMULA_IGN3 0 0.0 0.0 255.0 READ_WRITE BIT_MASK 0xFF ECU_ADDRESS 0x304188 /end MEASUREMENT
/begin MEASUREMENT tpu_ign_temp_1_zyl8 "TPU IGN temp 1." UWORD FORMULA_IGN3 0 0.0 0.0 255.0 READ_WRITE BIT_MASK 0xFF ECU_ADDRESS 0x304198 /end MEASUREMENT
/begin MEASUREMENT tpu_ign_temp_1_zyl9 "TPU IGN temp 1." UWORD FORMULA_IGN3 0 0.0 0.0 255.0 READ_WRITE BIT_MASK 0xFF ECU_ADDRESS 0x3041A8 /end MEASUREMENT
/begin MEASUREMENT tpu_ign_temp_2_zyl1 "TPU IGN temp 2." UWORD FORMULA_IGN3 0 0.0 0.0 65535.0 READ_WRITE ECU_ADDRESS 0x30412A /end MEASUREMENT
/begin MEASUREMENT tpu_ign_temp_2_zyl10 "TPU IGN temp 2." UWORD FORMULA_IGN3 0 0.0 0.0 65535.0 READ_WRITE ECU_ADDRESS 0x3041BA /end MEASUREMENT
/begin MEASUREMENT tpu_ign_temp_2_zyl2 "TPU IGN temp 2." UWORD FORMULA_IGN3 0 0.0 0.0 65535.0 READ_WRITE ECU_ADDRESS 0x30413A /end MEASUREMENT
/begin MEASUREMENT tpu_ign_temp_2_zyl3 "TPU IGN temp 2." UWORD FORMULA_IGN3 0 0.0 0.0 65535.0 READ_WRITE ECU_ADDRESS 0x30414A /end MEASUREMENT
/begin MEASUREMENT tpu_ign_temp_2_zyl4 "TPU IGN temp 2." UWORD FORMULA_IGN3 0 0.0 0.0 65535.0 READ_WRITE ECU_ADDRESS 0x30415A /end MEASUREMENT
/begin MEASUREMENT tpu_ign_temp_2_zyl5 "TPU IGN temp 2." UWORD FORMULA_IGN3 0 0.0 0.0 65535.0 READ_WRITE ECU_ADDRESS 0x30416A /end MEASUREMENT
/begin MEASUREMENT tpu_ign_temp_2_zyl6 "TPU IGN temp 2." UWORD FORMULA_IGN3 0 0.0 0.0 65535.0 READ_WRITE ECU_ADDRESS 0x30417A /end MEASUREMENT
/begin MEASUREMENT tpu_ign_temp_2_zyl7 "TPU IGN temp 2." UWORD FORMULA_IGN3 0 0.0 0.0 65535.0 READ_WRITE ECU_ADDRESS 0x30418A /end MEASUREMENT
/begin MEASUREMENT tpu_ign_temp_2_zyl8 "TPU IGN temp 2." UWORD FORMULA_IGN3 0 0.0 0.0 65535.0 READ_WRITE ECU_ADDRESS 0x30419A /end MEASUREMENT
/begin MEASUREMENT tpu_ign_temp_2_zyl9 "TPU IGN temp 2." UWORD FORMULA_IGN3 0 0.0 0.0 65535.0 READ_WRITE ECU_ADDRESS 0x3041AA /end MEASUREMENT
/begin MEASUREMENT tpu_ign_temp_3_zyl1 "TPU IGN temp 3." UWORD FORMULA_IGN3 0 0.0 0.0 65535.0 READ_WRITE ECU_ADDRESS 0x30412C /end MEASUREMENT
/begin MEASUREMENT tpu_ign_temp_3_zyl10 "TPU IGN temp 3." UWORD FORMULA_IGN3 0 0.0 0.0 65535.0 READ_WRITE ECU_ADDRESS 0x3041BC /end MEASUREMENT
/begin MEASUREMENT tpu_ign_temp_3_zyl2 "TPU IGN temp 3." UWORD FORMULA_IGN3 0 0.0 0.0 65535.0 READ_WRITE ECU_ADDRESS 0x30413C /end MEASUREMENT
/begin MEASUREMENT tpu_ign_temp_3_zyl3 "TPU IGN temp 3." UWORD FORMULA_IGN3 0 0.0 0.0 65535.0 READ_WRITE ECU_ADDRESS 0x30414C /end MEASUREMENT
/begin MEASUREMENT tpu_ign_temp_3_zyl4 "TPU IGN temp 3." UWORD FORMULA_IGN3 0 0.0 0.0 65535.0 READ_WRITE ECU_ADDRESS 0x30415C /end MEASUREMENT
/begin MEASUREMENT tpu_ign_temp_3_zyl5 "TPU IGN temp 3." UWORD FORMULA_IGN3 0 0.0 0.0 65535.0 READ_WRITE ECU_ADDRESS 0x30416C /end MEASUREMENT
/begin MEASUREMENT tpu_ign_temp_3_zyl6 "TPU IGN temp 3." UWORD FORMULA_IGN3 0 0.0 0.0 65535.0 READ_WRITE ECU_ADDRESS 0x30417C /end MEASUREMENT
/begin MEASUREMENT tpu_ign_temp_3_zyl7 "TPU IGN temp 3." UWORD FORMULA_IGN3 0 0.0 0.0 65535.0 READ_WRITE ECU_ADDRESS 0x30418C /end MEASUREMENT
/begin MEASUREMENT tpu_ign_temp_3_zyl8 "TPU IGN temp 3." UWORD FORMULA_IGN3 0 0.0 0.0 65535.0 READ_WRITE ECU_ADDRESS 0x30419C /end MEASUREMENT
/begin MEASUREMENT tpu_ign_temp_3_zyl9 "TPU IGN temp 3." UWORD FORMULA_IGN3 0 0.0 0.0 65535.0 READ_WRITE ECU_ADDRESS 0x3041AC /end MEASUREMENT
/begin MEASUREMENT tpu_ign_tz_zyl1 "TPU IGN Zuendwinkel." UWORD FORMULA_IGN1 0 0.0 0.0 719.989013671875 READ_WRITE ECU_ADDRESS 0x304120 /end MEASUREMENT
/begin MEASUREMENT tpu_ign_tz_zyl10 "TPU IGN Zuendwinkel." UWORD FORMULA_IGN1 0 0.0 0.0 719.989013671875 READ_WRITE ECU_ADDRESS 0x3041B0 /end MEASUREMENT
/begin MEASUREMENT tpu_ign_tz_zyl2 "TPU IGN Zuendwinkel." UWORD FORMULA_IGN1 0 0.0 0.0 719.989013671875 READ_WRITE ECU_ADDRESS 0x304130 /end MEASUREMENT
/begin MEASUREMENT tpu_ign_tz_zyl3 "TPU IGN Zuendwinkel." UWORD FORMULA_IGN1 0 0.0 0.0 719.989013671875 READ_WRITE ECU_ADDRESS 0x304140 /end MEASUREMENT
/begin MEASUREMENT tpu_ign_tz_zyl4 "TPU IGN Zuendwinkel." UWORD FORMULA_IGN1 0 0.0 0.0 719.989013671875 READ_WRITE ECU_ADDRESS 0x304150 /end MEASUREMENT
/begin MEASUREMENT tpu_ign_tz_zyl5 "TPU IGN Zuendwinkel." UWORD FORMULA_IGN1 0 0.0 0.0 719.989013671875 READ_WRITE ECU_ADDRESS 0x304160 /end MEASUREMENT
/begin MEASUREMENT tpu_ign_tz_zyl6 "TPU IGN Zuendwinkel." UWORD FORMULA_IGN1 0 0.0 0.0 719.989013671875 READ_WRITE ECU_ADDRESS 0x304170 /end MEASUREMENT
/begin MEASUREMENT tpu_ign_tz_zyl7 "TPU IGN Zuendwinkel." UWORD FORMULA_IGN1 0 0.0 0.0 719.989013671875 READ_WRITE ECU_ADDRESS 0x304180 /end MEASUREMENT
/begin MEASUREMENT tpu_ign_tz_zyl8 "TPU IGN Zuendwinkel." UWORD FORMULA_IGN1 0 0.0 0.0 719.989013671875 READ_WRITE ECU_ADDRESS 0x304190 /end MEASUREMENT
/begin MEASUREMENT tpu_ign_tz_zyl9 "TPU IGN Zuendwinkel." UWORD FORMULA_IGN1 0 0.0 0.0 719.989013671875 READ_WRITE ECU_ADDRESS 0x3041A0 /end MEASUREMENT
/begin MEASUREMENT tpu_pwm_active_time_llfso "TPU PWM active time." UWORD FORMULA_PWM1 0 0.0 0.0 9.362099647521973 READ_WRITE ECU_ADDRESS 0x3045D0 /end MEASUREMENT
/begin MEASUREMENT tpu_pwm_active_time_llfss "TPU PWM active time." UWORD FORMULA_PWM1 0 0.0 0.0 9.362099647521973 READ_WRITE ECU_ADDRESS 0x3045C0 /end MEASUREMENT
/begin MEASUREMENT tpu_pwm_passive_time_llfso "TPU PWM passive time." UWORD FORMULA_PWM1 0 0.0 0.0 9.362099647521973 READ_WRITE ECU_ADDRESS 0x3045D4 /end MEASUREMENT
/begin MEASUREMENT tpu_pwm_passive_time_llfss "TPU PWM passive time." UWORD FORMULA_PWM1 0 0.0 0.0 9.362099647521973 READ_WRITE ECU_ADDRESS 0x3045C4 /end MEASUREMENT
/begin MEASUREMENT tpu_pwm_period_llfso "TPU PWM period." UWORD FORMULA_PWM1 0 0.0 0.0 9.362099647521973 READ_WRITE ECU_ADDRESS 0x3045D2 /end MEASUREMENT
/begin MEASUREMENT tpu_pwm_period_llfss "TPU PWM period." UWORD FORMULA_PWM1 0 0.0 0.0 9.362099647521973 READ_WRITE ECU_ADDRESS 0x3045C2 /end MEASUREMENT
/begin MEASUREMENT tumg_obd_diag_st "Diagnoseart Modell oder Kaltstart" UBYTE FORMULA_1020 0 0.0 0.0 255.0 READ_WRITE ECU_ADDRESS 0x3FC60E /end MEASUREMENT
/begin MEASUREMENT tumg_obd_error_counter "Zaehler fuer Fehlerentprellung" UBYTE FORMULA_0003 0 0.0 0.0 255.0 READ_WRITE ECU_ADDRESS 0x3FC62C /end MEASUREMENT
/begin MEASUREMENT tumg_obd_freigabe_st "Freigabestatus fuer Modell" UBYTE FORMULA_1019 0 0.0 0.0 255.0 READ_WRITE ECU_ADDRESS 0x3FC609 /end MEASUREMENT
/begin MEASUREMENT tumg_obd_ml_mw "Luftmasse Mittelwert" SWORD FORMULA_0103 0 0.0 -100.0 1400.0 READ_WRITE ECU_ADDRESS 0x3FC60C /end MEASUREMENT
/begin MEASUREMENT tumg_obd_model "tumg Modellwert" SWORD FORMULA_0023 0 0.0 -50.0 170.0 READ_WRITE ECU_ADDRESS 0x3FC620 /end MEASUREMENT
/begin MEASUREMENT tumg_obd_model_delta "Abweichung absolut tumg zu tumg_diag_model" SWORD FORMULA_0074 0 0.0 -1000.0 1000.0 READ_WRITE ECU_ADDRESS 0x3FC628 /end MEASUREMENT
/begin MEASUREMENT tumg_obd_model_offset1 "Offset 1 aus KF_TUMG_OBD_TMOT_ML fuer tumg_obd_model" SWORD FORMULA_0074 0 0.0 -1000.0 1000.0 READ_WRITE ECU_ADDRESS 0x3FC610 /end MEASUREMENT
/begin MEASUREMENT tumg_obd_model_offset2 "Offset 2 aus KF_TUMG_OBD_TKA_V fuer tumg_obd_model" SWORD FORMULA_0074 0 0.0 -1000.0 1000.0 READ_WRITE ECU_ADDRESS 0x3FC618 /end MEASUREMENT
/begin MEASUREMENT tumg_obd_ok_counter "Zaehler fuer ok-Entprellung" UBYTE FORMULA_0003 0 0.0 0.0 255.0 READ_WRITE ECU_ADDRESS 0x3FC62D /end MEASUREMENT
/begin MEASUREMENT tumg_obd_output "tumg nach Diagnose" SWORD FORMULA_0023 0 0.0 -50.0 170.0 READ_WRITE ECU_ADDRESS 0x3FC62A /end MEASUREMENT
/begin MEASUREMENT tumg_obd_st "Steuervariable fuer Diagnose" UBYTE FORMULA_1018 0 0.0 0.0 255.0 READ_WRITE ECU_ADDRESS 0x3FC608 /end MEASUREMENT
/begin MEASUREMENT tumg_obd_tan_abstell "tan bei Start bzw. letzter gueltiger Freigabe" SWORD FORMULA_0023 0 0.0 -50.0 170.0 READ_WRITE ECU_ADDRESS 0x3FC62E /end MEASUREMENT
/begin MEASUREMENT tumg_obd_tan_fast "tan-Filterwert fuer tumg-Modellfreigabe" SWORD FORMULA_0023 0 0.0 -50.0 170.0 READ_WRITE ECU_ADDRESS 0x3FC638 /end MEASUREMENT
/begin MEASUREMENT tumg_obd_tan_slow "tan-Filterwert fuer Delta zu tumg_obd_tan_abstell" SWORD FORMULA_0023 0 0.0 -50.0 170.0 READ_WRITE ECU_ADDRESS 0x3FC630 /end MEASUREMENT
/begin MEASUREMENT tumg_obd_timer "Filterzeit Modellfreigabe" UWORD FORMULA_0071 0 0.0 0.0 6553.5 READ_WRITE ECU_ADDRESS 0x3FC60A /end MEASUREMENT
/begin MEASUREMENT tz_absch_ctr "Zaehler Abschalter der Zuendung" UBYTE FORMULA_0003 0 0.0 0.0 255.0 READ_WRITE ECU_ADDRESS 0x3FC6C6 /end MEASUREMENT
/begin MEASUREMENT tz_dbgr_offs_b1 "Eingerechneter Druckbegrenzungsoffset" SWORD FORMULA_0102 0 0.0 -50.0 60.0 READ_WRITE ECU_ADDRESS 0x3FC6D4 /end MEASUREMENT
/begin MEASUREMENT tz_dbgr_offs_b2 "Eingerechneter Druckbegrenzungsoffset" SWORD FORMULA_0102 0 0.0 -50.0 60.0 READ_WRITE ECU_ADDRESS 0x3FC6D6 /end MEASUREMENT
/begin MEASUREMENT tz_dbgr_roh_b1 "Druckbegrenzungsoffset aus KL" SWORD FORMULA_0102 0 0.0 -50.0 60.0 READ_WRITE ECU_ADDRESS 0x3FC6D0 /end MEASUREMENT
/begin MEASUREMENT tz_dbgr_roh_b2 "Druckbegrenzungsoffset aus KL" SWORD FORMULA_0102 0 0.0 -50.0 60.0 READ_WRITE ECU_ADDRESS 0x3FC6D2 /end MEASUREMENT
/begin MEASUREMENT tz_diag_tpu_ctr_zyl1 "Zaehler fuer Bestromungsueberwachung der TPU" UBYTE FORMULA_1025 0 0.0 0.0 255.0 READ_WRITE ECU_ADDRESS 0x3FC6EC /end MEASUREMENT
/begin MEASUREMENT tz_diag_tpu_ctr_zyl10 "Zaehler fuer Bestromungsueberwachung der TPU" UBYTE FORMULA_1025 0 0.0 0.0 255.0 READ_WRITE ECU_ADDRESS 0x3FC6F5 /end MEASUREMENT
/begin MEASUREMENT tz_diag_tpu_ctr_zyl2 "Zaehler fuer Bestromungsueberwachung der TPU" UBYTE FORMULA_1025 0 0.0 0.0 255.0 READ_WRITE ECU_ADDRESS 0x3FC6ED /end MEASUREMENT
/begin MEASUREMENT tz_diag_tpu_ctr_zyl3 "Zaehler fuer Bestromungsueberwachung der TPU" UBYTE FORMULA_1025 0 0.0 0.0 255.0 READ_WRITE ECU_ADDRESS 0x3FC6EE /end MEASUREMENT
/begin MEASUREMENT tz_diag_tpu_ctr_zyl4 "Zaehler fuer Bestromungsueberwachung der TPU" UBYTE FORMULA_1025 0 0.0 0.0 255.0 READ_WRITE ECU_ADDRESS 0x3FC6EF /end MEASUREMENT
/begin MEASUREMENT tz_diag_tpu_ctr_zyl5 "Zaehler fuer Bestromungsueberwachung der TPU" UBYTE FORMULA_1025 0 0.0 0.0 255.0 READ_WRITE ECU_ADDRESS 0x3FC6F0 /end MEASUREMENT
/begin MEASUREMENT tz_diag_tpu_ctr_zyl6 "Zaehler fuer Bestromungsueberwachung der TPU" UBYTE FORMULA_1025 0 0.0 0.0 255.0 READ_WRITE ECU_ADDRESS 0x3FC6F1 /end MEASUREMENT
/begin MEASUREMENT tz_diag_tpu_ctr_zyl7 "Zaehler fuer Bestromungsueberwachung der TPU" UBYTE FORMULA_1025 0 0.0 0.0 255.0 READ_WRITE ECU_ADDRESS 0x3FC6F2 /end MEASUREMENT
/begin MEASUREMENT tz_diag_tpu_ctr_zyl8 "Zaehler fuer Bestromungsueberwachung der TPU" UBYTE FORMULA_1025 0 0.0 0.0 255.0 READ_WRITE ECU_ADDRESS 0x3FC6F3 /end MEASUREMENT
/begin MEASUREMENT tz_diag_tpu_ctr_zyl9 "Zaehler fuer Bestromungsueberwachung der TPU" UBYTE FORMULA_1025 0 0.0 0.0 255.0 READ_WRITE ECU_ADDRESS 0x3FC6F4 /end MEASUREMENT
/begin MEASUREMENT tz_dr_rel_grad_b1 "Gefilterte Aenderungsgeschwindigkeit dr_rel" SWORD FORMULA_0260 0 0.0 -655000.0 655000.0 READ_WRITE ECU_ADDRESS 0x3FC6CC /end MEASUREMENT
/begin MEASUREMENT tz_dr_rel_grad_b2 "Gefilterte Aenderungsgeschwindigkeit dr_rel" SWORD FORMULA_0260 0 0.0 -655000.0 655000.0 READ_WRITE ECU_ADDRESS 0x3FC6CE /end MEASUREMENT
/begin MEASUREMENT tz_dr_rel_grad_roh_b1 "Rohwert Aenderungsgeschwindigkeit dr_rel" SWORD FORMULA_0260 0 0.0 -655000.0 655000.0 READ_WRITE ECU_ADDRESS 0x3FC6C8 /end MEASUREMENT
/begin MEASUREMENT tz_dr_rel_grad_roh_b2 "Rohwert Aenderungsgeschwindigkeit dr_rel" SWORD FORMULA_0260 0 0.0 -655000.0 655000.0 READ_WRITE ECU_ADDRESS 0x3FC6CA /end MEASUREMENT
/begin MEASUREMENT tz_grund_b1 "Grundzuendwinkel" SWORD FORMULA_0102 0 0.0 -50.0 60.0 READ_WRITE ECU_ADDRESS 0x3FC692 /end MEASUREMENT
/begin MEASUREMENT tz_grund_b2 "Grundzuendwinkel" SWORD FORMULA_0102 0 0.0 -50.0 60.0 READ_WRITE ECU_ADDRESS 0x3FC694 /end MEASUREMENT
/begin MEASUREMENT tz_grund_mw "Grundzuendwinkelmittelwert" SWORD FORMULA_0102 0 0.0 -50.0 60.0 READ_WRITE ECU_ADDRESS 0x3FC696 /end MEASUREMENT
/begin MEASUREMENT tz_kl15aus_count "Kl15 Nachlauf" UBYTE FORMULA_0037 0 0.0 0.0 255.0 READ_WRITE ECU_ADDRESS 0x3FC6C1 /end MEASUREMENT
/begin MEASUREMENT tz_mw_b1 "Mittelwert-Zuendwinkel der Bank" SWORD FORMULA_0102 0 0.0 -50.0 60.0 READ_WRITE ECU_ADDRESS 0x3FC6F6 /end MEASUREMENT
/begin MEASUREMENT tz_mw_b2 "Mittelwert-Zuendwinkel der Bank" SWORD FORMULA_0102 0 0.0 -50.0 60.0 READ_WRITE ECU_ADDRESS 0x3FC6F8 /end MEASUREMENT
/begin MEASUREMENT tz_mw_fil_b1 "Gradient vom Mittelwert-Zuendwinkel der Bank" SWORD FORMULA_0102 0 0.0 -50.0 60.0 READ_WRITE ECU_ADDRESS 0x3FC6FA /end MEASUREMENT
/begin MEASUREMENT tz_mw_fil_b2 "Gradient vom Mittelwert-Zuendwinkel der Bank" SWORD FORMULA_0102 0 0.0 -50.0 60.0 READ_WRITE ECU_ADDRESS 0x3FC6FC /end MEASUREMENT
/begin MEASUREMENT tz_nz_anz "Anzahl Nachzuender" UBYTE FORMULA_0003 0 0.0 0.0 255.0 READ_WRITE ECU_ADDRESS 0x3FC712 /end MEASUREMENT
/begin MEASUREMENT tz_nz_charge "Bestromungszeit fuer Nachzuendpulse" SWORD FORMULA_1022 0 0.0 0.0 26.21360015869141 READ_WRITE ECU_ADDRESS 0x3FC716 /end MEASUREMENT
/begin MEASUREMENT tz_nz_discharge "Funkenbrenndauerbegrenzung vor Nachzuendpulsen" SWORD FORMULA_1022 0 0.0 0.0 26.21360015869141 READ_WRITE ECU_ADDRESS 0x3FC714 /end MEASUREMENT
/begin MEASUREMENT tz_phase "Phasenkorrektur des Induktivgebers" SWORD FORMULA_0102 0 0.0 -50.0 60.0 READ_WRITE ECU_ADDRESS 0x3FC6BE /end MEASUREMENT
/begin MEASUREMENT tz_stat_b1 "stationaer Zuendwinkel" SWORD FORMULA_0102 0 0.0 -50.0 60.0 READ_WRITE ECU_ADDRESS 0x3FC698 /end MEASUREMENT
/begin MEASUREMENT tz_stat_b2 "stationaer Zuendwinkel" SWORD FORMULA_0102 0 0.0 -50.0 60.0 READ_WRITE ECU_ADDRESS 0x3FC69A /end MEASUREMENT
/begin MEASUREMENT tz_stat_dly_b1 "stationaer Zuendwinkel nach Ringpuffer" SWORD FORMULA_0102 0 0.0 -50.0 60.0 READ_WRITE ECU_ADDRESS 0x3FC69C /end MEASUREMENT
/begin MEASUREMENT tz_stat_dly_b2 "stationaer Zuendwinkel nach Ringpuffer" SWORD FORMULA_0102 0 0.0 -50.0 60.0 READ_WRITE ECU_ADDRESS 0x3FC69E /end MEASUREMENT
/begin MEASUREMENT tz_status "Status Zuendung" UBYTE FORMULA_1023 0 0.0 0.0 255.0 READ_WRITE ECU_ADDRESS 0x3FC6C0 /end MEASUREMENT
/begin MEASUREMENT tz_sz_auss_timer "Timer fuer die Stromerhoehung" UWORD FORMULA_0109 0 0.0 0.0 325.0 READ_WRITE ECU_ADDRESS 0x3FC6D8 /end MEASUREMENT
/begin MEASUREMENT tz_sz_i_b1 "Auszugebener Spulenstrom" SWORD FORMULA_1024 0 0.0 0.0 30.0 READ_WRITE ECU_ADDRESS 0x3FC6E8 /end MEASUREMENT
/begin MEASUREMENT tz_sz_i_b2 "Auszugebener Spulenstrom" SWORD FORMULA_1024 0 0.0 0.0 30.0 READ_WRITE ECU_ADDRESS 0x3FC6EA /end MEASUREMENT
/begin MEASUREMENT tz_sz_i_grund_b1 "Spulenstrom aus Grundkennfeld" SWORD FORMULA_1024 0 0.0 0.0 30.0 READ_WRITE ECU_ADDRESS 0x3FC6DA /end MEASUREMENT
/begin MEASUREMENT tz_sz_i_grund_b2 "Spulenstrom aus Grundkennfeld" SWORD FORMULA_1024 0 0.0 0.0 30.0 READ_WRITE ECU_ADDRESS 0x3FC6DC /end MEASUREMENT
/begin MEASUREMENT tz_sz_kerz_verschl_offs "SZ-Offset aus B_KERZ_VERSCHL" SWORD FORMULA_1024 0 0.0 0.0 30.0 READ_WRITE ECU_ADDRESS 0x3FC6E6 /end MEASUREMENT
/begin MEASUREMENT tz_sz_lam_offs_b1 "SZ-Offset aus Lambda" SWORD FORMULA_1024 0 0.0 0.0 30.0 READ_WRITE ECU_ADDRESS 0x3FC6DE /end MEASUREMENT
/begin MEASUREMENT tz_sz_lam_offs_b2 "SZ-Offset aus Lambda" SWORD FORMULA_1024 0 0.0 0.0 30.0 READ_WRITE ECU_ADDRESS 0x3FC6E0 /end MEASUREMENT
/begin MEASUREMENT tz_sz_start_offs "SZ-Offset aus Start-Bedingung" SWORD FORMULA_1024 0 0.0 0.0 30.0 READ_WRITE ECU_ADDRESS 0x3FC6E4 /end MEASUREMENT
/begin MEASUREMENT tz_sz_tmot_offs "SZ-Offset aus tmot" SWORD FORMULA_1024 0 0.0 0.0 30.0 READ_WRITE ECU_ADDRESS 0x3FC6E2 /end MEASUREMENT
/begin MEASUREMENT tz_sz_zyl1 "Schliesszeit der Zuendspulen" SWORD FORMULA_1022 0 0.0 0.0 26.21360015869141 READ_WRITE ECU_ADDRESS 0x3FC6AA /end MEASUREMENT
/begin MEASUREMENT tz_sz_zyl10 "Schliesszeit der Zuendspulen" SWORD FORMULA_1022 0 0.0 0.0 26.21360015869141 READ_WRITE ECU_ADDRESS 0x3FC6BC /end MEASUREMENT
/begin MEASUREMENT tz_sz_zyl2 "Schliesszeit der Zuendspulen" SWORD FORMULA_1022 0 0.0 0.0 26.21360015869141 READ_WRITE ECU_ADDRESS 0x3FC6AC /end MEASUREMENT
/begin MEASUREMENT tz_sz_zyl3 "Schliesszeit der Zuendspulen" SWORD FORMULA_1022 0 0.0 0.0 26.21360015869141 READ_WRITE ECU_ADDRESS 0x3FC6AE /end MEASUREMENT
/begin MEASUREMENT tz_sz_zyl4 "Schliesszeit der Zuendspulen" SWORD FORMULA_1022 0 0.0 0.0 26.21360015869141 READ_WRITE ECU_ADDRESS 0x3FC6B0 /end MEASUREMENT
/begin MEASUREMENT tz_sz_zyl5 "Schliesszeit der Zuendspulen" SWORD FORMULA_1022 0 0.0 0.0 26.21360015869141 READ_WRITE ECU_ADDRESS 0x3FC6B2 /end MEASUREMENT
/begin MEASUREMENT tz_sz_zyl6 "Schliesszeit der Zuendspulen" SWORD FORMULA_1022 0 0.0 0.0 26.21360015869141 READ_WRITE ECU_ADDRESS 0x3FC6B4 /end MEASUREMENT
/begin MEASUREMENT tz_sz_zyl7 "Schliesszeit der Zuendspulen" SWORD FORMULA_1022 0 0.0 0.0 26.21360015869141 READ_WRITE ECU_ADDRESS 0x3FC6B6 /end MEASUREMENT
/begin MEASUREMENT tz_sz_zyl8 "Schliesszeit der Zuendspulen" SWORD FORMULA_1022 0 0.0 0.0 26.21360015869141 READ_WRITE ECU_ADDRESS 0x3FC6B8 /end MEASUREMENT
/begin MEASUREMENT tz_sz_zyl9 "Schliesszeit der Zuendspulen" SWORD FORMULA_1022 0 0.0 0.0 26.21360015869141 READ_WRITE ECU_ADDRESS 0x3FC6BA /end MEASUREMENT
/begin MEASUREMENT tz_tkorr_b1 "Korrekturoffset Temperatureinfluss" SWORD FORMULA_0102 0 0.0 -50.0 60.0 READ_WRITE ECU_ADDRESS 0x3FC6A6 /end MEASUREMENT
/begin MEASUREMENT tz_tkorr_b2 "Korrekturoffset Temperatureinfluss" SWORD FORMULA_0102 0 0.0 -50.0 60.0 READ_WRITE ECU_ADDRESS 0x3FC6A8 /end MEASUREMENT
/begin MEASUREMENT tz_tl_vl_fak "Faktor fuer Offset TL->VL Kennfeld" UWORD FORMULA_0073 0 0.0 0.0 4.0 READ_WRITE ECU_ADDRESS 0x3FC6C2 /end MEASUREMENT
/begin MEASUREMENT tz_ve_zyl1 "Zuendwinkel ohne Momenteneingriff" SWORD FORMULA_0102 0 0.0 -50.0 60.0 READ_WRITE ECU_ADDRESS 0x3FC66A /end MEASUREMENT
/begin MEASUREMENT tz_ve_zyl10 "Zuendwinkel ohne Momenteneingriff" SWORD FORMULA_0102 0 0.0 -50.0 60.0 READ_WRITE ECU_ADDRESS 0x3FC67C /end MEASUREMENT
/begin MEASUREMENT tz_ve_zyl2 "Zuendwinkel ohne Momenteneingriff" SWORD FORMULA_0102 0 0.0 -50.0 60.0 READ_WRITE ECU_ADDRESS 0x3FC66C /end MEASUREMENT
/begin MEASUREMENT tz_ve_zyl3 "Zuendwinkel ohne Momenteneingriff" SWORD FORMULA_0102 0 0.0 -50.0 60.0 READ_WRITE ECU_ADDRESS 0x3FC66E /end MEASUREMENT
/begin MEASUREMENT tz_ve_zyl4 "Zuendwinkel ohne Momenteneingriff" SWORD FORMULA_0102 0 0.0 -50.0 60.0 READ_WRITE ECU_ADDRESS 0x3FC670 /end MEASUREMENT
/begin MEASUREMENT tz_ve_zyl5 "Zuendwinkel ohne Momenteneingriff" SWORD FORMULA_0102 0 0.0 -50.0 60.0 READ_WRITE ECU_ADDRESS 0x3FC672 /end MEASUREMENT
/begin MEASUREMENT tz_ve_zyl6 "Zuendwinkel ohne Momenteneingriff" SWORD FORMULA_0102 0 0.0 -50.0 60.0 READ_WRITE ECU_ADDRESS 0x3FC674 /end MEASUREMENT
/begin MEASUREMENT tz_ve_zyl7 "Zuendwinkel ohne Momenteneingriff" SWORD FORMULA_0102 0 0.0 -50.0 60.0 READ_WRITE ECU_ADDRESS 0x3FC676 /end MEASUREMENT
/begin MEASUREMENT tz_ve_zyl8 "Zuendwinkel ohne Momenteneingriff" SWORD FORMULA_0102 0 0.0 -50.0 60.0 READ_WRITE ECU_ADDRESS 0x3FC678 /end MEASUREMENT
/begin MEASUREMENT tz_ve_zyl9 "Zuendwinkel ohne Momenteneingriff" SWORD FORMULA_0102 0 0.0 -50.0 60.0 READ_WRITE ECU_ADDRESS 0x3FC67A /end MEASUREMENT
/begin MEASUREMENT tz_vekr "tz vor Eingriff KR" SWORD FORMULA_0102 0 0.0 -50.0 60.0 READ_WRITE ARRAY_SIZE 10 ECU_ADDRESS 0x3FC6FE MATRIX_DIM 10 1 1 /end MEASUREMENT
/begin MEASUREMENT tz_vl_offs "Zuendwinkeloffset zum Grundkennfeld" SWORD FORMULA_0102 0 0.0 -50.0 60.0 READ_WRITE ECU_ADDRESS 0x3FC6C4 /end MEASUREMENT
/begin MEASUREMENT tz_zwb_b1 "Zuendwinkel nach ZWB" SWORD FORMULA_0102 0 0.0 -50.0 60.0 READ_WRITE ECU_ADDRESS 0x3FC6A0 /end MEASUREMENT
/begin MEASUREMENT tz_zwb_b2 "Zuendwinkel nach ZWB" SWORD FORMULA_0102 0 0.0 -50.0 60.0 READ_WRITE ECU_ADDRESS 0x3FC6A2 /end MEASUREMENT
/begin MEASUREMENT tz_zwb_incr "Delta Zuendwinkel fuer ZWB" SWORD FORMULA_0102 0 0.0 -50.0 60.0 READ_WRITE ECU_ADDRESS 0x3FC6A4 /end MEASUREMENT
/begin MEASUREMENT tz_zyl1 "Zuendwinkel" SWORD FORMULA_0102 0 0.0 -50.0 60.0 READ_WRITE ECU_ADDRESS 0x3FC656 /end MEASUREMENT
/begin MEASUREMENT tz_zyl10 "Zuendwinkel" SWORD FORMULA_0102 0 0.0 -50.0 60.0 READ_WRITE ECU_ADDRESS 0x3FC668 /end MEASUREMENT
/begin MEASUREMENT tz_zyl2 "Zuendwinkel" SWORD FORMULA_0102 0 0.0 -50.0 60.0 READ_WRITE ECU_ADDRESS 0x3FC658 /end MEASUREMENT
/begin MEASUREMENT tz_zyl3 "Zuendwinkel" SWORD FORMULA_0102 0 0.0 -50.0 60.0 READ_WRITE ECU_ADDRESS 0x3FC65A /end MEASUREMENT
/begin MEASUREMENT tz_zyl4 "Zuendwinkel" SWORD FORMULA_0102 0 0.0 -50.0 60.0 READ_WRITE ECU_ADDRESS 0x3FC65C /end MEASUREMENT
/begin MEASUREMENT tz_zyl5 "Zuendwinkel" SWORD FORMULA_0102 0 0.0 -50.0 60.0 READ_WRITE ECU_ADDRESS 0x3FC65E /end MEASUREMENT
/begin MEASUREMENT tz_zyl6 "Zuendwinkel" SWORD FORMULA_0102 0 0.0 -50.0 60.0 READ_WRITE ECU_ADDRESS 0x3FC660 /end MEASUREMENT
/begin MEASUREMENT tz_zyl7 "Zuendwinkel" SWORD FORMULA_0102 0 0.0 -50.0 60.0 READ_WRITE ECU_ADDRESS 0x3FC662 /end MEASUREMENT
/begin MEASUREMENT tz_zyl8 "Zuendwinkel" SWORD FORMULA_0102 0 0.0 -50.0 60.0 READ_WRITE ECU_ADDRESS 0x3FC664 /end MEASUREMENT
/begin MEASUREMENT tz_zyl9 "Zuendwinkel" SWORD FORMULA_0102 0 0.0 -50.0 60.0 READ_WRITE ECU_ADDRESS 0x3FC666 /end MEASUREMENT
/begin MEASUREMENT uext_ad_pin_111_219_514 "AD-Wert Versorgungsspannungen" SWORD FORMULA_0114 0 0.0 0.0 1023.0 READ_WRITE ECU_ADDRESS 0x3FC722 /end MEASUREMENT
/begin MEASUREMENT uext_ad_pin_124_512 "AD-Wert Versorgungsspannungen" SWORD FORMULA_0114 0 0.0 0.0 1023.0 READ_WRITE ECU_ADDRESS 0x3FC724 /end MEASUREMENT
/begin MEASUREMENT uext_roh_pin_111_219_514 "Roh-Wert d. Versorgungsspannungen" UWORD FORMULA_0247 0 0.0 0.0 6.666500091552734 READ_WRITE ECU_ADDRESS 0x3FC726 /end MEASUREMENT
/begin MEASUREMENT uext_roh_pin_124_512 "Roh-Wert d. Versorgungsspannungen" UWORD FORMULA_0247 0 0.0 0.0 6.666500091552734 READ_WRITE ECU_ADDRESS 0x3FC728 /end MEASUREMENT
/begin MEASUREMENT uintern_ad_1_8 "AD-Wert interne Versorgungsspannung" SWORD FORMULA_0114 0 0.0 0.0 1023.0 READ_WRITE ECU_ADDRESS 0x3FC72A /end MEASUREMENT
/begin MEASUREMENT uintern_ad_2_55 "AD-Wert interne Versorgungsspannung" SWORD FORMULA_0114 0 0.0 0.0 1023.0 READ_WRITE ECU_ADDRESS 0x3FC72C /end MEASUREMENT
/begin MEASUREMENT uintern_ad_3_3 "AD-Wert interne Versorgungsspannung" SWORD FORMULA_0114 0 0.0 0.0 1023.0 READ_WRITE ECU_ADDRESS 0x3FC72E /end MEASUREMENT
/begin MEASUREMENT uintern_fehler_zaehler_1_8 "Fehlerfilter" UWORD FORMULA_0010 0 0.0 0.0 65535.0 READ_WRITE ECU_ADDRESS 0x3FC730 /end MEASUREMENT
/begin MEASUREMENT uintern_fehler_zaehler_2_55 "Fehlerfilter" UWORD FORMULA_0010 0 0.0 0.0 65535.0 READ_WRITE ECU_ADDRESS 0x3FC732 /end MEASUREMENT
/begin MEASUREMENT uintern_fehler_zaehler_3_3 "Fehlerfilter" UWORD FORMULA_0010 0 0.0 0.0 65535.0 READ_WRITE ECU_ADDRESS 0x3FC734 /end MEASUREMENT
/begin MEASUREMENT vers_index "Programmindex" UBYTE FORMULA_0003 0 0.0 0.0 255.0 READ_WRITE ECU_ADDRESS 0x3FC76C /end MEASUREMENT
/begin MEASUREMENT vers_name "Applikateur der Ref-Page" UBYTE FORMULA_0420 0 0.0 0.0 255.0 READ_WRITE ECU_ADDRESS 0x3FC76D /end MEASUREMENT
/begin MEASUREMENT vers_prog "Programmversion" UWORD FORMULA_0010 0 0.0 0.0 65535.0 READ_WRITE ECU_ADDRESS 0x3FC76A /end MEASUREMENT
/begin MEASUREMENT vers_sg "verbautes Steuergeraet" UBYTE FORMULA_0421 0 0.0 0.0 255.0 READ_WRITE ECU_ADDRESS 0x3FC76E /end MEASUREMENT
/begin MEASUREMENT zoelp_exd_timeout "Timer fuer die Tester Ansteuerung" UBYTE FORMULA_0492 0 0.0 0.0 25.5 READ_WRITE ECU_ADDRESS 0x3FC7E4 /end MEASUREMENT
/begin MEASUREMENT zoelp_fg_timer "Timer fuer den Freigraengigkeitsschutz" UWORD FORMULA_0071 0 0.0 0.0 6553.5 READ_WRITE ECU_ADDRESS 0x3FC7DE /end MEASUREMENT
/begin MEASUREMENT zoelp_i_ad_b1 "AD-Wert der Strommessung" SWORD FORMULA_0114 0 0.0 0.0 1023.0 READ_WRITE ECU_ADDRESS 0x3FC7E6 /end MEASUREMENT
/begin MEASUREMENT zoelp_i_ad_b2 "AD-Wert der Strommessung" SWORD FORMULA_0114 0 0.0 0.0 1023.0 READ_WRITE ECU_ADDRESS 0x3FC7E8 /end MEASUREMENT
/begin MEASUREMENT zoelp_i_roh_b1 "Pumpenstrom" UBYTE FORMULA_0349 0 0.0 0.0 25.0 READ_WRITE ECU_ADDRESS 0x3FC7EA /end MEASUREMENT
/begin MEASUREMENT zoelp_i_roh_b2 "Pumpenstrom" UBYTE FORMULA_0349 0 0.0 0.0 25.0 READ_WRITE ECU_ADDRESS 0x3FC7EB /end MEASUREMENT
/begin MEASUREMENT zoelp_st_b1 "Zusatzoelpumpenstatus" UBYTE FORMULA_1052 0 0.0 0.0 255.0 READ_WRITE ECU_ADDRESS 0x3FC7DC /end MEASUREMENT
/begin MEASUREMENT zoelp_st_b2 "Zusatzoelpumpenstatus" UBYTE FORMULA_1052 0 0.0 0.0 255.0 READ_WRITE ECU_ADDRESS 0x3FC7DD /end MEASUREMENT
/begin MEASUREMENT zoelp_time_on "Zeit fuer Pumpe an" UWORD FORMULA_0071 0 0.0 0.0 6553.5 READ_WRITE ARRAY_SIZE 2 ECU_ADDRESS 0x3FC7E0 MATRIX_DIM 2 1 1 /end MEASUREMENT
/begin MEASUREMENT zustand_motor_ign "Betriebszustand der Motorsteuerung" UWORD FORMULA_0019 0 0.0 0.0 65535.0 READ_WRITE ECU_ADDRESS 0x3FC7EC /end MEASUREMENT
/begin COMPU_METHOD DEFAULT_FORMULA "DEFAULT_FORMULA" RAT_FUNC "%7.0" "" COEFFS 0 1 0 0 0 1 /end COMPU_METHOD
/begin COMPU_METHOD FORMULA_0003 "FORMULA_0003" RAT_FUNC "%3.0" "-" COEFFS 0 1 0 0 0 1 /end COMPU_METHOD
/begin COMPU_METHOD FORMULA_0006 "FORMULA_0006" RAT_FUNC "%5.0" "Upm" COEFFS 0 1 0 0 0 1 /end COMPU_METHOD
/begin COMPU_METHOD FORMULA_0007 "FORMULA_0007" RAT_FUNC "%8.3" "-" COEFFS 0 10000.0 0.0 0 0.0 1.0 /end COMPU_METHOD
/begin COMPU_METHOD FORMULA_0008 "FORMULA_0008" RAT_FUNC "%6.1" "V" COEFFS 0 10.0 0.0 0 0.0 1.0 /end COMPU_METHOD
/begin COMPU_METHOD FORMULA_0010 "FORMULA_0010" RAT_FUNC "%5.0" "-" COEFFS 0 1 0 0 0 1 /end COMPU_METHOD
/begin COMPU_METHOD FORMULA_0019 "FORMULA_0019" TAB_VERB "%7.2" "-" COMPU_TAB_REF FORMULA_0019_VTAB /end COMPU_METHOD
/begin COMPU_METHOD FORMULA_0021 "FORMULA_0021" RAT_FUNC "%7.2" "s" COEFFS 0 100.0 0.0 0 0.0 1.0 /end COMPU_METHOD
/begin COMPU_METHOD FORMULA_0023 "FORMULA_0023" RAT_FUNC "%6.1" "°C" COEFFS 0 10.0 2732.0 0 0.0 1.0 /end COMPU_METHOD
/begin COMPU_METHOD FORMULA_0025 "FORMULA_0025" RAT_FUNC "%8.3" "-" COEFFS 0 16384.0 0.0 0 0.0 1.0 /end COMPU_METHOD
/begin COMPU_METHOD FORMULA_0037 "FORMULA_0037" RAT_FUNC "%5.2" "-" COEFFS 0 1 0 0 0 1 /end COMPU_METHOD
/begin COMPU_METHOD FORMULA_0071 "FORMULA_0071" RAT_FUNC "%6.1" "s" COEFFS 0 10.0 0.0 0 0.0 1.0 /end COMPU_METHOD
/begin COMPU_METHOD FORMULA_0073 "FORMULA_0073" RAT_FUNC "%8.3" "-" COEFFS 0 1024.0 0.0 0 0.0 1.0 /end COMPU_METHOD
/begin COMPU_METHOD FORMULA_0074 "FORMULA_0074" RAT_FUNC "%6.1" "Kelvin" COEFFS 0 10.0 0.0 0 0.0 1.0 /end COMPU_METHOD
/begin COMPU_METHOD FORMULA_0075 "FORMULA_0075" RAT_FUNC "%6.1" "mbar" COEFFS 0 16.0 0.0 0 0.0 1.0 /end COMPU_METHOD
/begin COMPU_METHOD FORMULA_0076 "FORMULA_0076" RAT_FUNC "%6.1" "km/h" COEFFS 0 16.0 0.0 0 0.0 1.0 /end COMPU_METHOD
/begin COMPU_METHOD FORMULA_0080 "FORMULA_0080" RAT_FUNC "%7.2" "-" COEFFS 0 1 0 0 0 1 /end COMPU_METHOD
/begin COMPU_METHOD FORMULA_0102 "FORMULA_0102" RAT_FUNC "%6.1" "°KW" COEFFS 0 10.0 0.0 0 0.0 1.0 /end COMPU_METHOD
/begin COMPU_METHOD FORMULA_0103 "FORMULA_0103" RAT_FUNC "%6.1" "kg/h" COEFFS 0 10.0 0.0 0 0.0 1.0 /end COMPU_METHOD
/begin COMPU_METHOD FORMULA_0106 "FORMULA_0106" RAT_FUNC "%7.2" "%" COEFFS 0 163.84 0.0 0 0.0 1.0 /end COMPU_METHOD
/begin COMPU_METHOD FORMULA_0109 "FORMULA_0109" RAT_FUNC "%7.2" "s" COEFFS 0 200.0 0.0 0 0.0 1.0 /end COMPU_METHOD
/begin COMPU_METHOD FORMULA_0114 "FORMULA_0114" RAT_FUNC "%5.0" "digit" COEFFS 0 1 0 0 0 1 /end COMPU_METHOD
/begin COMPU_METHOD FORMULA_0123 "FORMULA_0123" RAT_FUNC "%7.2" "m/(s*s)" COEFFS 0 40.0 0.0 0 0.0 1.0 /end COMPU_METHOD
/begin COMPU_METHOD FORMULA_0147 "FORMULA_0147" RAT_FUNC "%9.2" "s" COEFFS 0 100.0 0.0 0 0.0 1.0 /end COMPU_METHOD
/begin COMPU_METHOD FORMULA_0247 "FORMULA_0247" RAT_FUNC "%7.2" "V" COEFFS 0 9830.4 0.0 0 0.0 1.0 /end COMPU_METHOD
/begin COMPU_METHOD FORMULA_0260 "FORMULA_0260" RAT_FUNC "%5.0" "%/s" COEFFS 0 5.e-002 0.0 0 0.0 1.0 /end COMPU_METHOD
/begin COMPU_METHOD FORMULA_0349 "FORMULA_0349" RAT_FUNC "%4.1" "A" COEFFS 0 10.0 0.0 0 0.0 1.0 /end COMPU_METHOD
/begin COMPU_METHOD FORMULA_0419 "FORMULA_0419" TAB_VERB "%3.0" "-" COMPU_TAB_REF FORMULA_0419_VTAB /end COMPU_METHOD
/begin COMPU_METHOD FORMULA_0420 "FORMULA_0420" TAB_VERB "%5.2" "-" COMPU_TAB_REF FORMULA_0420_VTAB /end COMPU_METHOD
/begin COMPU_METHOD FORMULA_0421 "FORMULA_0421" TAB_VERB "%5.2" "-" COMPU_TAB_REF FORMULA_0421_VTAB /end COMPU_METHOD
/begin COMPU_METHOD FORMULA_0422 "FORMULA_0422" TAB_VERB "%5.2" "-" COMPU_TAB_REF FORMULA_0422_VTAB /end COMPU_METHOD
/begin COMPU_METHOD FORMULA_0470 "FORMULA_0470" RAT_FUNC "%6.3" "s" COEFFS 0 0 1.28 0 1 0 /end COMPU_METHOD
/begin COMPU_METHOD FORMULA_0492 "FORMULA_0492" RAT_FUNC "%4.1" "s" COEFFS 0 10.0 0.0 0 0.0 1.0 /end COMPU_METHOD
/begin COMPU_METHOD FORMULA_0620 "FORMULA_0620" RAT_FUNC "%5.0" "min" COEFFS 0 60.0 0.0 0 0.0 1.0 /end COMPU_METHOD
/begin COMPU_METHOD FORMULA_0626 "FORMULA_0626" RAT_FUNC "%5.0" "s" COEFFS 0 1 0 0 0 1 /end COMPU_METHOD
/begin COMPU_METHOD FORMULA_0681 "FORMULA_0681" RAT_FUNC "%7.2" "s" COEFFS 0 0 6553.5 0 1 0 /end COMPU_METHOD
/begin COMPU_METHOD FORMULA_1018 "FORMULA_1018" TAB_VERB "%5.2" "-" COMPU_TAB_REF FORMULA_1018_VTAB /end COMPU_METHOD
/begin COMPU_METHOD FORMULA_1019 "FORMULA_1019" TAB_VERB "%5.2" "-" COMPU_TAB_REF FORMULA_1019_VTAB /end COMPU_METHOD
/begin COMPU_METHOD FORMULA_1020 "FORMULA_1020" TAB_VERB "%5.2" "-" COMPU_TAB_REF FORMULA_1020_VTAB /end COMPU_METHOD
/begin COMPU_METHOD FORMULA_1021 "FORMULA_1021" TAB_VERB "%3.0" "-" COMPU_TAB_REF FORMULA_1021_VTAB /end COMPU_METHOD
/begin COMPU_METHOD FORMULA_1022 "FORMULA_1022" RAT_FUNC "%7.2" "ms" COEFFS 0 1250.0 0.0 0 0.0 1.0 /end COMPU_METHOD
/begin COMPU_METHOD FORMULA_1023 "FORMULA_1023" TAB_VERB "%3.0" "-" COMPU_TAB_REF FORMULA_1023_VTAB /end COMPU_METHOD
/begin COMPU_METHOD FORMULA_1024 "FORMULA_1024" RAT_FUNC "%6.1" "A" COEFFS 0 1000.0 0.0 0 0.0 1.0 /end COMPU_METHOD
/begin COMPU_METHOD FORMULA_1025 "FORMULA_1025" RAT_FUNC "%3.0" "seg" COEFFS 0 0.5 0.0 0 0.0 1.0 /end COMPU_METHOD
/begin COMPU_METHOD FORMULA_1026 "FORMULA_1026" RAT_FUNC "%6.1" "°/Segment" COEFFS 0 10.0 0.0 0 0.0 1.0 /end COMPU_METHOD
/begin COMPU_METHOD FORMULA_1027 "FORMULA_1027" RAT_FUNC "%3.0" "segm" COEFFS 0 1 0 0 0 1 /end COMPU_METHOD
/begin COMPU_METHOD FORMULA_1028 "FORMULA_1028" RAT_FUNC "%3.0" "seg" COEFFS 0 1.0 -1.0 0 0.0 1.0 /end COMPU_METHOD
/begin COMPU_METHOD FORMULA_1029 "FORMULA_1029" RAT_FUNC "%4.1" "°KW/seg" COEFFS 0 10.0 0.0 0 0.0 1.0 /end COMPU_METHOD
/begin COMPU_METHOD FORMULA_1030 "FORMULA_1030" RAT_FUNC "%5.2" "-/segment" COEFFS 0 256.0 0.0 0 0.0 1.0 /end COMPU_METHOD
/begin COMPU_METHOD FORMULA_1031 "FORMULA_1031" RAT_FUNC "%3.0" "seg" COEFFS 0 1 0 0 0 1 /end COMPU_METHOD
/begin COMPU_METHOD FORMULA_1033 "FORMULA_1033" RAT_FUNC "%7.2" "V" COEFFS 0 153.6 0.0 0 0.0 1.0 /end COMPU_METHOD
/begin COMPU_METHOD FORMULA_1052 "FORMULA_1052" TAB_VERB "%5.2" "-" COMPU_TAB_REF FORMULA_1052_VTAB /end COMPU_METHOD
/begin COMPU_METHOD FORMULA_1053 "FORMULA_1053" TAB_VERB "%5.2" "-" COMPU_TAB_REF FORMULA_1053_VTAB /end COMPU_METHOD
/begin COMPU_METHOD FORMULA_1054 "FORMULA_1054" TAB_VERB "%5.2" "-" COMPU_TAB_REF FORMULA_1054_VTAB /end COMPU_METHOD
/begin COMPU_METHOD FORMULA_AA1 "FORMULA_AA1" RAT_FUNC "%7.2" "°" COEFFS 0 91.0222066877656 0.0 0 0.0 1.0 /end COMPU_METHOD
/begin COMPU_METHOD FORMULA_AA2 "FORMULA_AA2" RAT_FUNC "%9.2" "ms" COEFFS 0 7000.0 0.0 0 0.0 1.0 /end COMPU_METHOD
/begin COMPU_METHOD FORMULA_AA3 "FORMULA_AA3" RAT_FUNC "%7.2" "ms" COEFFS 0 7000.0 0.0 0 0.0 1.0 /end COMPU_METHOD
/begin COMPU_METHOD FORMULA_AA4 "FORMULA_AA4" RAT_FUNC "%9.2" "ms" COEFFS 0 27.34375 0.0 0 0.0 1.0 /end COMPU_METHOD
/begin COMPU_METHOD FORMULA_APG1 "FORMULA_APG1" RAT_FUNC "%7.2" "°" COEFFS 0 91.0222066877656 0.0 0 0.0 1.0 /end COMPU_METHOD
/begin COMPU_METHOD FORMULA_APG2 "FORMULA_APG2" RAT_FUNC "%9.2" "ms" COEFFS 0 7000.0 0.0 0 0.0 1.0 /end COMPU_METHOD
/begin COMPU_METHOD FORMULA_APG3 "FORMULA_APG3" RAT_FUNC "%7.2" "ms" COEFFS 0 7000.0 0.0 0 0.0 1.0 /end COMPU_METHOD
/begin COMPU_METHOD FORMULA_APG4 "FORMULA_APG4" RAT_FUNC "%5.0" "-" COEFFS 0 2048.0 0.0 0 0.0 1.0 /end COMPU_METHOD
/begin COMPU_METHOD FORMULA_DIO1 "FORMULA_DIO1" TAB_VERB "%5.0" "-" COMPU_TAB_REF FORMULA_DIO1_VTAB /end COMPU_METHOD
/begin COMPU_METHOD FORMULA_DIO2 "FORMULA_DIO2" RAT_FUNC "%5.0" "-" COEFFS 0 1 0 0 0 1 /end COMPU_METHOD
/begin COMPU_METHOD FORMULA_DIO3 "FORMULA_DIO3" RAT_FUNC "%7.2" "ms" COEFFS 0 7000.0 0.0 0 0.0 1.0 /end COMPU_METHOD
/begin COMPU_METHOD FORMULA_FI1 "FORMULA_FI1" RAT_FUNC "%7.2" "ms" COEFFS 0 14000.0 0.0 0 0.0 1.0 /end COMPU_METHOD
/begin COMPU_METHOD FORMULA_FI2 "FORMULA_FI2" RAT_FUNC "%5.0" "-" COEFFS 0 256.0 0.0 0 0.0 1.0 /end COMPU_METHOD
/begin COMPU_METHOD FORMULA_FI3 "FORMULA_FI3" RAT_FUNC "%5.0" "-" COEFFS 0 1 0 0 0 1 /end COMPU_METHOD
/begin COMPU_METHOD FORMULA_IGN1 "FORMULA_IGN1" RAT_FUNC "%7.2" "°" COEFFS 0 91.0222066877656 0.0 0 0.0 1.0 /end COMPU_METHOD
/begin COMPU_METHOD FORMULA_IGN10 "FORMULA_IGN10" RAT_FUNC "%7.2" "ms" COEFFS 0 49000.0 0.0 0 0.0 1.0 /end COMPU_METHOD
/begin COMPU_METHOD FORMULA_IGN11 "FORMULA_IGN11" RAT_FUNC "%7.2" "ms" COEFFS 0 7000.0 0.0 0 0.0 1.0 /end COMPU_METHOD
/begin COMPU_METHOD FORMULA_IGN2 "FORMULA_IGN2" RAT_FUNC "%7.2" "ms" COEFFS 0 1750.0 0.0 0 0.0 1.0 /end COMPU_METHOD
/begin COMPU_METHOD FORMULA_IGN3 "FORMULA_IGN3" RAT_FUNC "%5.0" "-" COEFFS 0 1 0 0 0 1 /end COMPU_METHOD
/begin COMPU_METHOD FORMULA_IGN4 "FORMULA_IGN4" RAT_FUNC "%5.0" "-" COEFFS 0 32768.0 0.0 0 0.0 1.0 /end COMPU_METHOD
/begin COMPU_METHOD FORMULA_IGN5 "FORMULA_IGN5" RAT_FUNC "%5.0" "-" COEFFS 0 16384.0 0.0 0 0.0 1.0 /end COMPU_METHOD
/begin COMPU_METHOD FORMULA_IGN6 "FORMULA_IGN6" RAT_FUNC "%5.0" "-" COEFFS 0 8192.0 0.0 0 0.0 1.0 /end COMPU_METHOD
/begin COMPU_METHOD FORMULA_IGN7 "FORMULA_IGN7" RAT_FUNC "%5.0" "-" COEFFS 0 4096.0 0.0 0 0.0 1.0 /end COMPU_METHOD
/begin COMPU_METHOD FORMULA_IGN8 "FORMULA_IGN8" RAT_FUNC "%5.0" "-" COEFFS 0 256.0 0.0 0 0.0 1.0 /end COMPU_METHOD
/begin COMPU_METHOD FORMULA_IGN9 "FORMULA_IGN9" RAT_FUNC "%5.0" "-" COEFFS 0 512.0 0.0 0 0.0 1.0 /end COMPU_METHOD
/begin COMPU_METHOD FORMULA_KW1 "FORMULA_KW1" RAT_FUNC "%5.0" "-" COEFFS 0 256.0 0.0 0 0.0 1.0 /end COMPU_METHOD
/begin COMPU_METHOD FORMULA_KW10 "FORMULA_KW10" RAT_FUNC "%7.2" "°" COEFFS 0 91.0222066877656 0.0 0 0.0 1.0 /end COMPU_METHOD
/begin COMPU_METHOD FORMULA_KW11 "FORMULA_KW11" RAT_FUNC "%7.2" "ms" COEFFS 0 7000.0 0.0 0 0.0 1.0 /end COMPU_METHOD
/begin COMPU_METHOD FORMULA_KW12 "FORMULA_KW12" RAT_FUNC "%9.2" "ms" COEFFS 0 27.34375 0.0 0 0.0 1.0 /end COMPU_METHOD
/begin COMPU_METHOD FORMULA_KW13 "FORMULA_KW13" RAT_FUNC "%12.2" "ms" COEFFS 0 840000.0 0.0 0 0.0 1.0 /end COMPU_METHOD
/begin COMPU_METHOD FORMULA_KW3 "FORMULA_KW3" TAB_VERB "%5.0" "-" COMPU_TAB_REF FORMULA_KW3_VTAB /end COMPU_METHOD
/begin COMPU_METHOD FORMULA_KW4 "FORMULA_KW4" RAT_FUNC "%5.0" "-" COEFFS 0 1 0 0 0 1 /end COMPU_METHOD
/begin COMPU_METHOD FORMULA_KW5 "FORMULA_KW5" RAT_FUNC "%5.0" "Upm" COEFFS 0 0 27344 0 1 0 /end COMPU_METHOD
/begin COMPU_METHOD FORMULA_KW6 "FORMULA_KW6" RAT_FUNC "%6.4" "°" COEFFS 0 23301.68888888889 0.0 0 0.0 1.0 /end COMPU_METHOD
/begin COMPU_METHOD FORMULA_KW8 "FORMULA_KW8" RAT_FUNC "%9.2" "ms" COEFFS 0 7000.0 0.0 0 0.0 1.0 /end COMPU_METHOD
/begin COMPU_METHOD FORMULA_KW9 "FORMULA_KW9" RAT_FUNC "%7.2" "ms" COEFFS 0 0.42724635452048 0.0 0 0.0 1.0 /end COMPU_METHOD
/begin COMPU_METHOD FORMULA_PWM1 "FORMULA_PWM1" RAT_FUNC "%7.2" "ms" COEFFS 0 7000.0 0.0 0 0.0 1.0 /end COMPU_METHOD
/begin COMPU_METHOD FORMULA_USER1 "FORMULA_USER1" RAT_FUNC "%7.0" "-" COEFFS 0 1 0 0 0 1 /end COMPU_METHOD
/begin COMPU_VTAB FORMULA_0019_VTAB "FORMULA_0019_VTAB" TAB_VERB 13 1 "Motor steht" 2 "Motor presync" 4 "Start" 8 "LLOKS" 16 "LLMKS" 32 "TL" 64 "VL" 128 "SA" 256 "NL" 512 "Abgew." 1024 "Kl15 aus" 2048 "Wakeup" 4096 "Schub" DEFAULT_VALUE "undefiniert" /end COMPU_VTAB
/begin COMPU_VTAB FORMULA_0419_VTAB "FORMULA_0419_VTAB" TAB_VERB 63 45 "-" 48 "0" 49 "1" 50 "2" 51 "3" 52 "4" 53 "5" 54 "6" 55 "7" 56 "8" 57 "9" 65 "A" 66 "B" 67 "C" 68 "D" 69 "E" 70 "F" 71 "G" 72 "H" 73 "I" 74 "J" 75 "K" 76 "L" 77 "M" 78 "N" 79 "O" 80 "P" 81 "Q" 82 "R" 83 "S" 84 "T" 85 "U" 86 "V" 87 "W" 88 "X" 89 "Y" 90 "Z" 97 "a" 98 "b" 99 "c" 100 "d" 101 "e" 102 "f" 103 "g" 104 "h" 105 "i" 106 "j" 107 "k" 108 "l" 109 "m" 110 "n" 111 "o" 112 "p" 113 "q" 114 "r" 115 "s" 116 "t" 117 "u" 118 "v" 119 "w" 120 "x" 121 "y" 122 "z" DEFAULT_VALUE "DEZ" /end COMPU_VTAB
/begin COMPU_VTAB FORMULA_0420_VTAB "FORMULA_0420_VTAB" TAB_VERB 29 0 "Labordaten" 1 "ZS-M-57" 2 "Master" 3 "Prerauer" 4 "Gerum" 5 "Heiss" 6 "Lutz" 7 "Maier" 8 "Menn" 9 "Neumann" 10 "Wilke" 11 "Scherer" 12 "Erdoedy" 13 "Fischer" 14 "May" 15 "ECE" 16 "US" 17 "Habermann" 18 "Moesbauer" 19 "Hartke" 20 "Renner" 21 "Stoll" 22 "Schaefer" 23 "Ast" 24 "Schloen" 25 "Biebl" 26 "Betz" 27 "NN2" 28 "NN2" DEFAULT_VALUE "unbekannt" /end COMPU_VTAB
/begin COMPU_VTAB FORMULA_0421_VTAB "FORMULA_0421_VTAB" TAB_VERB 6 177 "B1-Muster" 178 "B2-Muster" 179 "B3-Muster" 193 "C1-Muster" 194 "C2-Muster" 255 "ohne Kennung" /end COMPU_VTAB
/begin COMPU_VTAB FORMULA_0422_VTAB "FORMULA_0422_VTAB" TAB_VERB 2 1 "INJ" 2 "IGN" DEFAULT_VALUE "undefiniert" /end COMPU_VTAB
/begin COMPU_VTAB FORMULA_1018_VTAB "FORMULA_1018_VTAB" TAB_VERB 8 0 "Warte auf Diag.-Bed./CAN" 1 "Diagnose Kaltstart" 2 "Diagnose Modell" 4 "Warte auf Bed. FS-Eintrag" 8 "Diagnosebedingung n.i.O." 16 "Diagnose i. O." 32 "Diagnose n.i.O." 128 "Diagnose gesperrt" DEFAULT_VALUE "undef" /end COMPU_VTAB
/begin COMPU_VTAB FORMULA_1019_VTAB "FORMULA_1019_VTAB" TAB_VERB 8 0 "Initialisierung" 1 "Fahrt" 2 "Aufheizen" 3 "Fahrt Aufheizen" 4 "Dynamik" 5 "Fahrt Dynamik" 6 "Aufheizen Dynamik" 7 "Fahrt Aufheizen Dynamik" DEFAULT_VALUE "undef." /end COMPU_VTAB
/begin COMPU_VTAB FORMULA_1020_VTAB "FORMULA_1020_VTAB" TAB_VERB 3 0 "kein Vergleichswert" 1 "TUMG_OBD_KALTSTART" 2 "TUMG_OBD_MODELL" DEFAULT_VALUE "undef" /end COMPU_VTAB
/begin COMPU_VTAB FORMULA_1021_VTAB "FORMULA_1021_VTAB" TAB_VERB 2 0 "OBD aus" 1 "OBD TUMG-MODELL" /end COMPU_VTAB
/begin COMPU_VTAB FORMULA_1023_VTAB "FORMULA_1023_VTAB" TAB_VERB 2 0 "inaktiv" 1 "aktiv" DEFAULT_VALUE "ungueltig" /end COMPU_VTAB
/begin COMPU_VTAB FORMULA_1052_VTAB "FORMULA_1052_VTAB" TAB_VERB 5 0 "aus" 1 "an" 2 "an manuel" 4 "an FG" 8 "an EXD" DEFAULT_VALUE "ungueltig" /end COMPU_VTAB
/begin COMPU_VTAB FORMULA_1053_VTAB "FORMULA_1053_VTAB" TAB_VERB 4 0 "inaktiv" 1 "aktiv" 5 "B1 aktiv man" 17 "B2 aktiv man" DEFAULT_VALUE "ungueltig" /end COMPU_VTAB
/begin COMPU_VTAB FORMULA_1054_VTAB "FORMULA_1054_VTAB" TAB_VERB 2 1 "normal" -1 "um" DEFAULT_VALUE "ungueltig" /end COMPU_VTAB
/begin COMPU_VTAB FORMULA_DIO1_VTAB "FORMULA_DIO1_VTAB" TAB_VERB 5 4 "in rising edge" 8 "in falling edge" 12 "in both edges" 225 "out pin high" 226 "out pin low" DEFAULT_VALUE "1 undefined" /end COMPU_VTAB
/begin COMPU_VTAB FORMULA_KW3_VTAB "FORMULA_KW3_VTAB" TAB_VERB 13 0 "ini" 1 "1st edge" 2 "second edge" 3 "wait teeth" 4 "search gap" 5 "1st missing required" 6 "last tooth until gap" 7 "1st missing tooth" 8 "2nd missing tooth" 9 "1st tooth after gap" 10 "2nd tooth after gap" 11 "tooth 2..56, 62..116" 12 "gap required" DEFAULT_VALUE "1 undefined" /end COMPU_VTAB
/begin FUNCTION tumg-Diagnose ""
 /begin DEF_CHARACTERISTIC K_TUMG_OBD_CFG K_TUMG_OBD_ML_MAX K_TUMG_OBD_ML_MIN K_TUMG_OBD_ML_SUM_MIN K_TUMG_OBD_ML_TMOT_ZK K_TUMG_OBD_MODEL_DELTA_MAX K_TUMG_OBD_MODEL_DELTA_MIN K_TUMG_OBD_MODEL_TAU K_TUMG_OBD_N_MIN K_TUMG_OBD_T_POWER_ON K_TUMG_OBD_TAN_FAST_TAU K_TUMG_OBD_TAN_FIL_DELTA_MAX K_TUMG_OBD_TAN_MAX K_TUMG_OBD_TAN_MIN K_TUMG_OBD_TAN_SLOW_TAU K_TUMG_OBD_TIME_ML_MIN K_TUMG_OBD_TIME_MS_MIN K_TUMG_OBD_TIME_SA_MAX K_TUMG_OBD_TKA_MIN K_TUMG_OBD_TMOT_KALT_MAX K_TUMG_OBD_TMOT_MIN K_TUMG_OBD_TMOT_START_MAX K_TUMG_OBD_TMOT_TAN_DELTA_MAX K_TUMG_OBD_V_MAX K_TUMG_OBD_V_MIN KF_TUMG_OBD_MODEL_UPDATE_T_MIN KF_TUMG_OBD_TKA_V KF_TUMG_OBD_TMOT_ML KL_TUMG_OBD_MAX_ERROR KL_TUMG_OBD_MOD_TIME_ML_MIN KL_TUMG_OBD_V /end DEF_CHARACTERISTIC
 /begin OUT_MEASUREMENT tumg_obd_diag_st tumg_obd_error_counter tumg_obd_freigabe_st tumg_obd_ml_mw tumg_obd_model tumg_obd_model_delta tumg_obd_model_offset1 tumg_obd_model_offset2 tumg_obd_ok_counter tumg_obd_output tumg_obd_st tumg_obd_tan_abstell tumg_obd_tan_fast tumg_obd_tan_slow tumg_obd_timer /end OUT_MEASUREMENT
/end FUNCTION
/begin FUNCTION Version ""
 /begin DEF_CHARACTERISTIC K_DATENKENNUNG_1 K_DATENKENNUNG_2 K_DATENKENNUNG_3 K_VERS_DATEN K_VERS_NAME K_VERS_PROG K_VERS_PROZ /end DEF_CHARACTERISTIC
 /begin OUT_MEASUREMENT vers_index vers_name vers_prog vers_sg /end OUT_MEASUREMENT
/end FUNCTION
/begin FUNCTION Versorgungsspannungen ""
 /begin DEF_CHARACTERISTIC K_UEXT_DIAG_MAX K_UEXT_DIAG_MIN K_UEXT_ERSATZ K_UEXT_TAU K_UINTERN_AD_1_8_MAX K_UINTERN_AD_1_8_MIN K_UINTERN_AD_2_55_MAX K_UINTERN_AD_2_55_MIN K_UINTERN_AD_3_3_MAX K_UINTERN_AD_3_3_MIN K_UINTERN_FEHLER_ZAEHLER /end DEF_CHARACTERISTIC
 /begin OUT_MEASUREMENT uext_ad_pin_111_219_514 uext_ad_pin_124_512 uext_roh_pin_111_219_514 uext_roh_pin_124_512 uintern_ad_1_8 uintern_ad_2_55 uintern_ad_3_3 uintern_fehler_zaehler_1_8 uintern_fehler_zaehler_2_55 uintern_fehler_zaehler_3_3 /end OUT_MEASUREMENT
/end FUNCTION
/begin FUNCTION zoelp ""
 /begin DEF_CHARACTERISTIC K_ZOELP_AN K_ZOELP_CFG K_ZOELP_DIAG_KABELBRUCH K_ZOELP_DIAG_KLEMMEN K_ZOELP_DIAG_KURZSCHLUSS K_ZOELP_DIAG_TIME_WAIT K_ZOELP_FG_N K_ZOELP_FG_T_AN K_ZOELP_FG_T_AUS K_ZOELP_HYS K_ZOELP_MAN_T_AN K_ZOELP_MAN_T_AUS K_ZOELP_TOEL K_ZOELP_UM /end DEF_CHARACTERISTIC
 /begin OUT_MEASUREMENT zoelp_exd_timeout zoelp_fg_timer zoelp_i_ad_b1 zoelp_i_ad_b2 zoelp_i_roh_b1 zoelp_i_roh_b2 zoelp_st_b1 zoelp_st_b2 zoelp_time_on /end OUT_MEASUREMENT
/end FUNCTION
/begin FUNCTION Zuendung ""
 /begin DEF_CHARACTERISTIC K_TZ_ABSCH_CTR K_TZ_DBGR_ANZ_SEG K_TZ_DBGR_AUFREG K_TZ_DBGR_DR_REL K_TZ_DBGR_DR_REL_TAU K_TZ_DBGR_TMOT K_TZ_DIAG_MAX_BESTR_TPU K_TZ_DLY K_TZ_DN_ZWB K_TZ_GRAD_TAU K_TZ_I_BEGR K_TZ_I_SA_DELAY K_TZ_KH_RF_ZWB K_TZ_KH_ZWB_B1 K_TZ_KH_ZWB_B2 K_TZ_KH_ZWB_B3 K_TZ_KL15_NACHLAUF K_TZ_MAX K_TZ_MCS K_TZ_MCS_Z_ZYL1 K_TZ_MCS_Z_ZYL10 K_TZ_MCS_Z_ZYL2 K_TZ_MCS_Z_ZYL3 K_TZ_MCS_Z_ZYL4 K_TZ_MCS_Z_ZYL5 K_TZ_MCS_Z_ZYL6 K_TZ_MCS_Z_ZYL7 K_TZ_MCS_Z_ZYL8 K_TZ_MCS_Z_ZYL9 K_TZ_NZ_ANZ_ST K_TZ_NZ_CHARGE_ST K_TZ_NZ_DISCHARGE_ST K_TZ_NZ_N_MAX K_TZ_RF_ZWB K_TZ_SZ_AUSS_DELAY K_TZ_SZ_CONTROL K_TZ_SZ_I_VERSCHL_OFFS K_TZ_SZ_MAX K_TZ_SZ_MCS K_TZ_UB_ERSATZ K_TZ_ZWB_B1 K_TZ_ZWB_B2 K_TZ_ZWB_B3 KF_TZ_GRUND KF_TZ_I KF_TZ_I_SZ KF_TZ_LL KF_TZ_MIN KF_TZ_NZ_ANZ KF_TZ_NZ_CHARGE KF_TZ_TKORR KF_TZ_VL KL_TZ_DBGR_OFFS KL_TZ_DBGR_TRIGGER KL_TZ_MIN_TMOT KL_TZ_NZ_DISCHARGE KL_TZ_PHASE KL_TZ_START_N KL_TZ_START_TMOT KL_TZ_SZ_LAM_OFFS KL_TZ_SZ_START_OFFS KL_TZ_SZ_STARTOFFS_TIME KL_TZ_SZ_TMOT_OFFS KL_TZ_TKORR_F /end DEF_CHARACTERISTIC
 /begin OUT_MEASUREMENT tz_absch_ctr tz_dbgr_offs_b1 tz_dbgr_offs_b2 tz_dbgr_roh_b1 tz_dbgr_roh_b2 tz_diag_tpu_ctr_zyl1 tz_diag_tpu_ctr_zyl10 tz_diag_tpu_ctr_zyl2 tz_diag_tpu_ctr_zyl3 tz_diag_tpu_ctr_zyl4 tz_diag_tpu_ctr_zyl5 tz_diag_tpu_ctr_zyl6 tz_diag_tpu_ctr_zyl7 tz_diag_tpu_ctr_zyl8 tz_diag_tpu_ctr_zyl9 tz_dr_rel_grad_b1 tz_dr_rel_grad_b2 tz_dr_rel_grad_roh_b1 tz_dr_rel_grad_roh_b2 tz_grund_b1 tz_grund_b2 tz_grund_mw tz_kl15aus_count tz_mw_b1 tz_mw_b2 tz_mw_fil_b1 tz_mw_fil_b2 tz_nz_anz tz_nz_charge tz_nz_discharge tz_phase tz_stat_b1 tz_stat_b2 tz_stat_dly_b1 tz_stat_dly_b2 tz_status tz_sz_auss_timer tz_sz_i_b1 tz_sz_i_b2 tz_sz_i_grund_b1 tz_sz_i_grund_b2 tz_sz_kerz_verschl_offs tz_sz_lam_offs_b1 tz_sz_lam_offs_b2 tz_sz_start_offs tz_sz_tmot_offs tz_sz_zyl1 tz_sz_zyl10 tz_sz_zyl2 tz_sz_zyl3 tz_sz_zyl4 tz_sz_zyl5 tz_sz_zyl6 tz_sz_zyl7 tz_sz_zyl8 tz_sz_zyl9 tz_tkorr_b1 tz_tkorr_b2 tz_tl_vl_fak tz_ve_zyl1 tz_ve_zyl10 tz_ve_zyl2 tz_ve_zyl3 tz_ve_zyl4 tz_ve_zyl5 tz_ve_zyl6 tz_ve_zyl7 tz_ve_zyl8 tz_ve_zyl9 tz_vekr tz_vl_offs tz_zwb_b1 tz_zwb_b2 tz_zwb_incr tz_zyl1 tz_zyl10 tz_zyl2 tz_zyl3 tz_zyl4 tz_zyl5 tz_zyl6 tz_zyl7 tz_zyl8 tz_zyl9 /end OUT_MEASUREMENT
/end FUNCTION
/begin FUNCTION Zustand "" /begin OUT_MEASUREMENT zustand_motor_ign /end OUT_MEASUREMENT /end FUNCTION
/begin RECORD_LAYOUT TKF_SW_SW_SW FNC_VALUES 5 SWORD COLUMN_DIR DIRECT AXIS_PTS_X 3 SWORD INDEX_INCR DIRECT AXIS_PTS_Y 4 SWORD INDEX_INCR DIRECT NO_AXIS_PTS_X 1 UBYTE NO_AXIS_PTS_Y 2 UBYTE /end RECORD_LAYOUT
/begin RECORD_LAYOUT TKF_SW_SW_UB FNC_VALUES 5 UBYTE COLUMN_DIR DIRECT AXIS_PTS_X 3 SWORD INDEX_INCR DIRECT AXIS_PTS_Y 4 SWORD INDEX_INCR DIRECT NO_AXIS_PTS_X 1 UBYTE NO_AXIS_PTS_Y 2 UBYTE /end RECORD_LAYOUT
/begin RECORD_LAYOUT TKF_SW_SW_UW FNC_VALUES 5 UWORD COLUMN_DIR DIRECT AXIS_PTS_X 3 SWORD INDEX_INCR DIRECT AXIS_PTS_Y 4 SWORD INDEX_INCR DIRECT NO_AXIS_PTS_X 1 UBYTE NO_AXIS_PTS_Y 2 UBYTE /end RECORD_LAYOUT
/begin RECORD_LAYOUT TKL_SW_VV_SW FNC_VALUES 4 SWORD COLUMN_DIR DIRECT AXIS_PTS_X 3 SWORD INDEX_INCR DIRECT NO_AXIS_PTS_X 1 UBYTE RESERVED 2 BYTE /end RECORD_LAYOUT
/begin RECORD_LAYOUT TKL_SW_VV_UB FNC_VALUES 4 UBYTE COLUMN_DIR DIRECT AXIS_PTS_X 3 SWORD INDEX_INCR DIRECT NO_AXIS_PTS_X 1 UBYTE RESERVED 2 BYTE /end RECORD_LAYOUT
/begin RECORD_LAYOUT TKL_SW_VV_UW FNC_VALUES 4 UWORD COLUMN_DIR DIRECT AXIS_PTS_X 3 SWORD INDEX_INCR DIRECT NO_AXIS_PTS_X 1 UBYTE RESERVED 2 BYTE /end RECORD_LAYOUT
/begin RECORD_LAYOUT TKL_UW_VV_SW FNC_VALUES 4 SWORD COLUMN_DIR DIRECT AXIS_PTS_X 3 UWORD INDEX_INCR DIRECT NO_AXIS_PTS_X 1 UBYTE RESERVED 2 BYTE /end RECORD_LAYOUT
/begin RECORD_LAYOUT TKW_VV_VV_SB FNC_VALUES 1 SBYTE COLUMN_DIR DIRECT /end RECORD_LAYOUT
/begin RECORD_LAYOUT TKW_VV_VV_SW FNC_VALUES 1 SWORD COLUMN_DIR DIRECT /end RECORD_LAYOUT
/begin RECORD_LAYOUT TKW_VV_VV_UB FNC_VALUES 1 UBYTE COLUMN_DIR DIRECT /end RECORD_LAYOUT
/begin RECORD_LAYOUT TKW_VV_VV_UL FNC_VALUES 1 ULONG COLUMN_DIR DIRECT /end RECORD_LAYOUT
/begin RECORD_LAYOUT TKW_VV_VV_UW FNC_VALUES 1 UWORD COLUMN_DIR DIRECT /end RECORD_LAYOUT
/end MODULE
/end PROJECT
