ASAP2_VERSION 1 4
/begin PROJECT P_558 "EDC17_CP02"
/begin HEADER "" VERSION "V1C1" PROJECT_NO P_558 /end HEADER
/begin MODULE DIM ""
/begin MOD_COMMON "" BYTE_ORDER MSB_LAST ALIGNMENT_BYTE 1 ALIGNMENT_WORD 2 ALIGNMENT_LONG 4 ALIGNMENT_FLOAT32_IEEE 4 /end MOD_COMMON
/begin CHARACTERISTIC Com_RawMuxValId_C "" VALUE 0x8007A186 Val_Wu8 255.0 OneToOne 0.00 255.0 FORMAT "%5.1" /end CHARACTERISTIC
/begin CHARACTERISTIC Com_RawValIdA_C "" VALUE 0x8007A188 Val_Wu16 65535.00 OneToOne 0.00 65535.00 FORMAT "%8.2" /end CHARACTERISTIC
/begin CHARACTERISTIC Com_RawValIdB_C "" VALUE 0x8007A18A Val_Wu16 65535.00 OneToOne 0.00 65535.00 FORMAT "%8.2" /end CHARACTERISTIC
/begin CHARACTERISTIC Com_RawValIdC_C "" VALUE 0x8007A18C Val_Wu16 65535.00 OneToOne 0.00 65535.00 FORMAT "%8.2" /end CHARACTERISTIC
/begin CHARACTERISTIC Com_RawValIdD_C "" VALUE 0x8007A18E Val_Wu16 65535.00 OneToOne 0.00 65535.00 FORMAT "%8.2" /end CHARACTERISTIC
/begin CHARACTERISTIC Com_SelfRecID_C "" VALUE 0x8007A190 Val_Wu16 65535.00 OneToOne 0.00 65535.00 FORMAT "%8.2" /end CHARACTERISTIC
/begin CHARACTERISTIC Com_stGear_C "" VAL_BLK 0x8004E290 ValA_Wu8 16.00 OneToOne 0.00 16.00 FORMAT "%5.2" EXTENDED_LIMITS 0.00 255.0 NUMBER 16 /end CHARACTERISTIC
/begin CHARACTERISTIC Com_swtGearboxData2_C "" VALUE 0x8004E28C Val_Wu8 255.0 OneToOne 0.00 255.0 FORMAT "%5.1" /end CHARACTERISTIC
/begin CHARACTERISTIC Com_swtGearboxData_C "" VALUE 0x8004E28D Val_Wu8 255.0 OneToOne 0.00 255.0 FORMAT "%5.1" /end CHARACTERISTIC
/begin CHARACTERISTIC Com_swtTrqDemandGbx_C "" VALUE 0x8004E28E Val_Wu8 255.0 OneToOne 0.00 255.0 FORMAT "%5.1" /end CHARACTERISTIC
/begin CHARACTERISTIC Com_trqGbxMaxSubs_C "" VALUE 0x8004E2A0 Val_Ws16 6553.500 Trq -3276.800 3276.700 FORMAT "%8.3" /end CHARACTERISTIC
/begin CHARACTERISTIC Fan_4WinSigDur.tiErr1Min_C "/" VALUE 0x8004DFC4 Kw_Ws16 655350.0 Time_ms -327680.0 327670.0 FORMAT "%8.1" /end CHARACTERISTIC
/begin CHARACTERISTIC Fan_4WinSigDur.tiErr1Max_C "/" VALUE 0x8004DFC6 Kw_Ws16 655350.0 Time_ms -327680.0 327670.0 FORMAT "%8.1" /end CHARACTERISTIC
/begin CHARACTERISTIC Fan_4WinSigDur.tiErr2Min_C "/" VALUE 0x8004DFC8 Kw_Ws16 655350.0 Time_ms -327680.0 327670.0 FORMAT "%8.1" /end CHARACTERISTIC
/begin CHARACTERISTIC Fan_4WinSigDur.tiErr2Max_C "/" VALUE 0x8004DFCA Kw_Ws16 655350.0 Time_ms -327680.0 327670.0 FORMAT "%8.1" /end CHARACTERISTIC
/begin CHARACTERISTIC Fan_4WinSigDur.tiErr3Min_C "/" VALUE 0x8004DFCC Kw_Ws16 655350.0 Time_ms -327680.0 327670.0 FORMAT "%8.1" /end CHARACTERISTIC
/begin CHARACTERISTIC Fan_4WinSigDur.tiErr3Max_C "/" VALUE 0x8004DFCE Kw_Ws16 655350.0 Time_ms -327680.0 327670.0 FORMAT "%8.1" /end CHARACTERISTIC
/begin CHARACTERISTIC Fan_4WinSigDur.tiErr4Min_C "/" VALUE 0x8004DFD0 Kw_Ws16 655350.0 Time_ms -327680.0 327670.0 FORMAT "%8.1" /end CHARACTERISTIC
/begin CHARACTERISTIC Fan_4WinSigDur.tiErr4Max_C "/" VALUE 0x8004DFD2 Kw_Ws16 655350.0 Time_ms -327680.0 327670.0 FORMAT "%8.1" /end CHARACTERISTIC
/begin CHARACTERISTIC Fan_Pwm.tiPer_C "/" VALUE 0x8004DFD4 Kw_Ws16 9.900000 Period 0.1000000 10.00000 FORMAT "%8.5" EXTENDED_LIMITS -3276.800 3276.700 /end CHARACTERISTIC
/begin CHARACTERISTIC Fan_Pwm.stLvl_C "/" VALUE 0x8004DFD6 Kw_Wu8 1.000 OneToOne 0.00 1.000 FORMAT "%5.3" EXTENDED_LIMITS 0.00 255.0 /end CHARACTERISTIC
/begin CHARACTERISTIC Fan_Pwm.rMaxDty_C "/" VALUE 0x8004DFD8 Kw_Ws16 100.0000 DtyCyc 0.00 100.0000 FORMAT "%8.4" EXTENDED_LIMITS -327.6800 327.6700 /end CHARACTERISTIC
/begin CHARACTERISTIC Fan_Pwm.rPerUn_C "/" VALUE 0x8004DFDA Kw_Ws16 3276.700 Period 0.00 3276.700 FORMAT "%8.3" EXTENDED_LIMITS -3276.800 3276.700 /end CHARACTERISTIC
/begin CHARACTERISTIC Fan_Pwm.tiPh_C "/" VALUE 0x8004DFDC Kw_Ws16 65535.00 OneToOne -32768.00 32767.00 FORMAT "%8.2" /end CHARACTERISTIC
/begin CHARACTERISTIC Fan_PwmOut.rMin_C "/" VALUE 0x8004DFDE Kw_Ws16 100.0000 DtyCyc 0.00 100.0000 FORMAT "%8.4" EXTENDED_LIMITS -327.6800 327.6700 /end CHARACTERISTIC
/begin CHARACTERISTIC Fan_PwmOut.rMax_C "/" VALUE 0x8004DFE0 Kw_Ws16 100.0000 DtyCyc 0.00 100.0000 FORMAT "%8.4" EXTENDED_LIMITS -327.6800 327.6700 /end CHARACTERISTIC
/begin CHARACTERISTIC Fan_PwmOut.tiBtwTstSCB_C "/" VALUE 0x8004DFE2 Kw_Ws16 1000.000 Time_ms 0.00 1000.000 FORMAT "%8.3" EXTENDED_LIMITS -327680.0 327670.0 /end CHARACTERISTIC
/begin CHARACTERISTIC Fan_PwmOut.tiBtwTstOT_C "/" VALUE 0x8004DFE4 Kw_Ws16 1000.000 Time_s 0.00 1000.000 FORMAT "%8.3" EXTENDED_LIMITS -327.6800 327.6700 /end CHARACTERISTIC
/begin CHARACTERISTIC Fan_PwmOut.numTstMax_C "/" VALUE 0x8004DFE6 Kw_Wu16 65535.00 OneToOne 0.00 65535.00 FORMAT "%8.2" /end CHARACTERISTIC
/begin CHARACTERISTIC Fan_PwmOut.swtBattCor_C "/" VALUE 0x8004DFE8 Kw_Wu8 1.000 OneToOne 0.00 1.000 FORMAT "%5.3" EXTENDED_LIMITS 0.00 255.0 /end CHARACTERISTIC
/begin CHARACTERISTIC Fan_PwmOut.swtPsInv_C "/" VALUE 0x8004DFE9 Kw_Wu8 255.0 OneToOne 0.00 255.0 FORMAT "%5.1" /end CHARACTERISTIC
/begin CHARACTERISTIC Fan_rCnv_CUR "" CURVE 0x8004DFEA Cur_Xs16Ws16 655.3500 DtyCyc -327.6800 327.6700 FORMAT "%8.4"
 /begin AXIS_DESCR STD_AXIS Fan_r Prc 10 0.00 100.0000 FORMAT "%8.4" EXTENDED_LIMITS -400.0000 399.9878 DEPOSIT ABSOLUTE /end AXIS_DESCR
/end CHARACTERISTIC
/begin CHARACTERISTIC Fan_rPsDisbl_C "" VALUE 0x8004E014 Val_Ws16 100.0000 DtyCyc 0.00 100.0000 FORMAT "%8.4" EXTENDED_LIMITS -327.6800 327.6700 /end CHARACTERISTIC
/begin CHARACTERISTIC Fan_stPsDiaDisbl_C "" VALUE 0x8004E016 Val_Wu8 255.0 OneToOne 0.00 255.0 FORMAT "%5.1" /end CHARACTERISTIC
/begin CHARACTERISTIC Fan_stPsDisbl_C "" VALUE 0x8004E017 Val_Wu8 255.0 OneToOne 0.00 255.0 FORMAT "%5.1" /end CHARACTERISTIC
/begin CHARACTERISTIC Fan_typ4WinDia_C "" VALUE 0x8004E018 Val_Wu8 0.00 Typ4WinDia 0.00 0.00 FORMAT "%13.2" EXTENDED_LIMITS 0.00 3.00000000000 /end CHARACTERISTIC
/begin CHARACTERISTIC FBC_ActESpP_C "=0: 'keine Drehzahlvorverarbeitung', =1: 'mit Drehzahlvorverarbeitung', =2: 'lösche Adaptionsergebnisspeicher (EEPROM)'" VALUE 0x8004DE78 Val_Wu8 2.000 OneToOne 0.00 2.000 FORMAT "%5.3" EXTENDED_LIMITS 0.00 255.0 /end CHARACTERISTIC
/begin CHARACTERISTIC FBC_BPFac.NumLo_CA "Bandpass-Koeffizienten/Zählerkoeffizienten für unteren Drehzahlbereich" VAL_BLK 0x8004DD78 ValA_Wr32 30.0000000 OneToOne -15.0000000 15.0000000 FORMAT "%10.7" EXTENDED_LIMITS -1.00000000E+037 1.00000000E+037 NUMBER 3 /end CHARACTERISTIC
/begin CHARACTERISTIC FBC_BPFac.NumHi_CA "Bandpass-Koeffizienten/Zählerkoeffizienten für den oberen Drehzahlbereich" VAL_BLK 0x8004DD84 ValA_Wr32 30.0000000 OneToOne -15.0000000 15.0000000 FORMAT "%10.7" EXTENDED_LIMITS -1.00000000E+037 1.00000000E+037 NUMBER 3 /end CHARACTERISTIC
/begin CHARACTERISTIC FBC_BPFac.Den1_CA "Bandpass-Koeffizienten/Nennerkoeffizient 1" VAL_BLK 0x8004DD90 ValA_Wr32 20.0000000 OneToOne -10.0000000 10.0000000 FORMAT "%10.7" EXTENDED_LIMITS -1.00000000E+037 1.00000000E+037 NUMBER 3 /end CHARACTERISTIC
/begin CHARACTERISTIC FBC_BPFac.Den2_CA "Bandpass-Koeffizienten/Nennerkoeffizient 2" VAL_BLK 0x8004DD9C ValA_Wr32 20.0000000 OneToOne -10.0000000 10.0000000 FORMAT "%10.7" EXTENDED_LIMITS -1.00000000E+037 1.00000000E+037 NUMBER 3 /end CHARACTERISTIC
/begin CHARACTERISTIC FBC_BPFac1NumG_CUR "übersetzungsabhängige Zählerkoeffizienten (unterschiedliche Bandpass-Verstärkungen)" CURVE 0x8004DDA8 Cur_Xs16Ws16 30.00092 FBC_BPfac -15.00046 15.00046 FORMAT "%8.5" EXTENDED_LIMITS -60.00183 60.00000
 /begin AXIS_DESCR STD_AXIS PT_rTrq TransR 7 -15.00000 15.00000 FORMAT "%8.5" EXTENDED_LIMITS -327.6800 327.6700 DEPOSIT ABSOLUTE /end AXIS_DESCR
/end CHARACTERISTIC
/begin CHARACTERISTIC FBC_ctPhComp_C "Kompensation der Totzeit durch Scheduling für FBC_qSet-Berechnung. 0: keine Totzeit, 1: einSegment Totzeit (z.B. wie EDC16 Master/Slave)" VALUE 0x8004DDC6 Val_Ws8 4.000 OneToOne 0.00 4.000 FORMAT "%5.3" EXTENDED_LIMITS -128.0 127.0 /end CHARACTERISTIC
/begin CHARACTERISTIC FBC_ctSegOffset_C "Abstand zwischen FBC-Berechnung und entsprechendem OT" VALUE 0x8004DDC7 Val_Ws8 1.000 OneToOne 2.000 3.000 FORMAT "%5.3" EXTENDED_LIMITS -128.0 127.0 /end CHARACTERISTIC
/begin CHARACTERISTIC FBC_ctTDCOfs_C "Abstand zwischen OT und Main-Interrupt der zugehörigem Einspritzung" VALUE 0x8004DDC8 Val_Ws8 0.00 OneToOne 1.000 1.000 FORMAT "%5.3" EXTENDED_LIMITS -128.0 127.0 /end CHARACTERISTIC
/begin CHARACTERISTIC FBC_dqThresSurge_C "Schwelle zur Erkennung einer impulsfömigen Mengenänderung" VALUE 0x8004DDCA Val_Ws16 327.6700 InjMass 0.00 327.6700 FORMAT "%8.4" EXTENDED_LIMITS -327.6800 327.6700 /end CHARACTERISTIC
/begin CHARACTERISTIC FBC_dSegNhiCaS_CA "Segmentwert für Epm_nEng > FBC_nThresFbc_C" VAL_BLK 0x8004DDCC ValA_Wu16 10.00000 Per_Ratio 0.00 10.00000 FORMAT "%8.5" EXTENDED_LIMITS 0.00 255.9961 NUMBER 3 /end CHARACTERISTIC
/begin CHARACTERISTIC FBC_dSegNloCaS_CA "Segmentwert für Epm_nEng < FBC_nThresFbc_C" VAL_BLK 0x8004DDD2 ValA_Wu16 10.00000 Per_Ratio 0.00 10.00000 FORMAT "%8.5" EXTENDED_LIMITS 0.00 255.9961 NUMBER 3 /end CHARACTERISTIC
/begin CHARACTERISTIC FBC_dSyn_C "Abstand OT Zyl.1 zu Segmentzählerstand 0 (bezogen auf CrSCD_numSeg)" VALUE 0x8004DDD8 Val_Ws8 1.000 OneToOne 1.000 2.000 FORMAT "%5.3" EXTENDED_LIMITS -128.0 127.0 /end CHARACTERISTIC
/begin CHARACTERISTIC FBC_DXAdapLo_C "untere Schwelle der Adaptionsgüte (Geberradadaption)" VALUE 0x8004DE7C Val_Wr32 1.00000000 Prc_float 0.00 1.00000000 FORMAT "%10.8" EXTENDED_LIMITS -1.00000000E+039 1.00000000E+039 /end CHARACTERISTIC
/begin CHARACTERISTIC FBC_DXAdapUp_C "obere Schwelle der Adaptionsgüte (Geberradadaption)" VALUE 0x8004DE80 Val_Wr32 1.00000000 Prc_float 0.00 1.00000000 FORMAT "%10.8" EXTENDED_LIMITS -1.00000000E+039 1.00000000E+039 /end CHARACTERISTIC
/begin CHARACTERISTIC FBC_DXalf0_C "Startwerte für FBC_DXSfn, FBC_DXSfp" VALUE 0x8004DE84 Val_Wr32 3.00000000 Prc_float 0.00 3.00000000 FORMAT "%10.8" EXTENDED_LIMITS -1.00000000E+039 1.00000000E+039 /end CHARACTERISTIC
/begin CHARACTERISTIC FBC_facBPRedNum_C "Faktor um den die BP-Verstärkungen bei impulsförmigen Mengenanregungen reduziert werden" VALUE 0x8004DDDC Val_Wr32 1.00000000 OneToOne 0.00 1.00000000 FORMAT "%10.8" EXTENDED_LIMITS -1.00000000E+037 1.00000000E+037 /end CHARACTERISTIC
/begin CHARACTERISTIC FBC_fSurge_CUR "übersetzungsabhängige Ruckelfrequenzen" CURVE 0x8004DDE0 Cur_Xs16Ws16 20.00000 FBC_Surge_Frq 0.00 20.00000 FORMAT "%8.5" EXTENDED_LIMITS -273.0667 273.0583
 /begin AXIS_DESCR STD_AXIS PT_rTrq TransR 6 0.00 20.00000 FORMAT "%8.5" EXTENDED_LIMITS -327.6800 327.6700 DEPOSIT ABSOLUTE /end AXIS_DESCR
/end CHARACTERISTIC
/begin CHARACTERISTIC FBC_GvrnI.Ki_C "I-Regler/" VALUE 0x8004DDFC Kw_Wr32 1.00000000 FBC_GvrnIKi_float 0.00 1.00000000 FORMAT "%10.8" EXTENDED_LIMITS -1.00000000E+037 1.00000000E+037 /end CHARACTERISTIC
/begin CHARACTERISTIC FBC_GvrnI.KiPos_C "I-Regler/" VALUE 0x8004DE00 Kw_Wr32 1.00000000 FBC_GvrnIKi_float 0.00 1.00000000 FORMAT "%10.8" EXTENDED_LIMITS -1.00000000E+037 1.00000000E+037 /end CHARACTERISTIC
/begin CHARACTERISTIC FBC_GvrnI.KiNeg_C "I-Regler/" VALUE 0x8004DE04 Kw_Wr32 1.00000000 FBC_GvrnIKi_float 0.00 1.00000000 FORMAT "%10.8" EXTENDED_LIMITS -1.00000000E+037 1.00000000E+037 /end CHARACTERISTIC
/begin CHARACTERISTIC FBC_GvrnI.WinPos_C "I-Regler/" VALUE 0x8004DE08 Kw_Wr32 12200.0000 EngN_float -6100.00000 6100.00000 FORMAT "%10.5" EXTENDED_LIMITS -1.00000000E+037 1.00000000E+037 /end CHARACTERISTIC
/begin CHARACTERISTIC FBC_GvrnI.WinNeg_C "I-Regler/" VALUE 0x8004DE0C Kw_Wr32 12200.0000 EngN_float -6100.00000 6100.00000 FORMAT "%10.5" EXTENDED_LIMITS -1.00000000E+037 1.00000000E+037 /end CHARACTERISTIC
/begin CHARACTERISTIC FBC_GvrnP.Kp_C "P-Regler/" VALUE 0x8004DE10 Kw_Wr32 1.00000000 FBC_GvrnPKp_float 0.00 1.00000000 FORMAT "%10.8" EXTENDED_LIMITS -1.00000000E+037 1.00000000E+037 /end CHARACTERISTIC
/begin CHARACTERISTIC FBC_GvrnP.KpPos_C "P-Regler/" VALUE 0x8004DE14 Kw_Wr32 1.00000000 FBC_GvrnPKp_float 0.00 1.00000000 FORMAT "%10.8" EXTENDED_LIMITS -1.00000000E+037 1.00000000E+037 READ_ONLY /end CHARACTERISTIC
/begin CHARACTERISTIC FBC_GvrnP.KpNeg_C "P-Regler/" VALUE 0x8004DE18 Kw_Wr32 1.00000000 FBC_GvrnPKp_float 0.00 1.00000000 FORMAT "%10.8" EXTENDED_LIMITS -1.00000000E+037 1.00000000E+037 READ_ONLY /end CHARACTERISTIC
/begin CHARACTERISTIC FBC_GvrnP.WinPos_C "P-Regler/" VALUE 0x8004DE1C Kw_Wr32 12200.0000 EngN_float -6100.00000 6100.00000 FORMAT "%10.5" EXTENDED_LIMITS -1.00000000E+037 1.00000000E+037 READ_ONLY /end CHARACTERISTIC
/begin CHARACTERISTIC FBC_GvrnP.WinNeg_C "P-Regler/" VALUE 0x8004DE20 Kw_Wr32 12200.0000 EngN_float -6100.00000 6100.00000 FORMAT "%10.5" EXTENDED_LIMITS -1.00000000E+037 1.00000000E+037 READ_ONLY /end CHARACTERISTIC
/begin CHARACTERISTIC FBC_nCtlOfsMin_C "Offset der unteren drehzahlabhängigen Steuerschwelle zur aktuellen Leerlaufdrehzahl" VALUE 0x8004DE24 Val_Ws16 1000.000 EngN -1000.000 0.00 FORMAT "%8.3" EXTENDED_LIMITS -16384.00 16383.50 /end CHARACTERISTIC
/begin CHARACTERISTIC FBC_nCtlThresMax_C "obere Drehzahlsteuerschwelle" VALUE 0x8004DE26 Val_Ws16 6100.000 EngN 0.00 6100.000 FORMAT "%8.3" EXTENDED_LIMITS -16384.00 16383.50 /end CHARACTERISTIC
/begin CHARACTERISTIC FBC_nGvrnOfsMin_C "Offset der unteren drehzahlabhängigen Regelschwelle zur aktuellen Leerlaufdrehzahl" VALUE 0x8004DE28 Val_Ws16 1000.000 EngN -1000.000 0.00 FORMAT "%8.3" EXTENDED_LIMITS -16384.00 16383.50 /end CHARACTERISTIC
/begin CHARACTERISTIC FBC_nGvrnThresMax_C "obere Drehzahlregelschwelle" VALUE 0x8004DE2A Val_Ws16 6100.000 EngN 0.00 6100.000 FORMAT "%8.3" EXTENDED_LIMITS -16384.00 16383.50 /end CHARACTERISTIC
/begin CHARACTERISTIC FBC_nHyst_C "Drehzahlhysterese" VALUE 0x8004DE2C Val_Ws16 100.0000 EngN 0.00 100.0000 FORMAT "%8.4" EXTENDED_LIMITS -16384.00 16383.50 /end CHARACTERISTIC
/begin CHARACTERISTIC FBC_nLrnThres_CA "Drehzahlschwellen der Lernbereiche der Geberradadaption" VAL_BLK 0x8004DE88 ValA_Ws16 6000.000 EngN 0.00 6000.000 FORMAT "%8.3" EXTENDED_LIMITS -16384.00 16383.50 NUMBER 3 /end CHARACTERISTIC
/begin CHARACTERISTIC FBC_nSurgeOffset_C "pos. Offset zur kritischen Drehzahl, bei der fNW=fRuck gilt." VALUE 0x8004DE2E Val_Ws16 1000.000 EngN 0.00 1000.000 FORMAT "%8.3" EXTENDED_LIMITS -16384.00 16383.50 /end CHARACTERISTIC
/begin CHARACTERISTIC FBC_nThresFbc_C "Drehzahlschwelle für Segmentwert- und Bandpassumschaltung, maximale Drehzahl ohne eingelernte Geberradadaption" VALUE 0x8004DE8E Val_Ws16 2000.000 EngN 0.00 2000.000 FORMAT "%8.3" EXTENDED_LIMITS -16384.00 16383.50 /end CHARACTERISTIC
/begin CHARACTERISTIC FBC_qCtlOfsMax_C "Offset für obere mengenabhängige Steuerschwelle" VALUE 0x8004DE30 Val_Ws16 10.00000 InjMass 0.00 10.00000 FORMAT "%8.5" EXTENDED_LIMITS -327.6800 327.6700 /end CHARACTERISTIC
/begin CHARACTERISTIC FBC_qCtlThresMin_C "untere Mengensteuerschwelle" VALUE 0x8004DE32 Val_Ws16 5.000000 InjMass 0.00 5.000000 FORMAT "%8.6" EXTENDED_LIMITS -327.6800 327.6700 /end CHARACTERISTIC
/begin CHARACTERISTIC FBC_qGvrnThresMax_CUR "obere mengenabhängige Regelschwelle" CURVE 0x8004DE34 Cur_Xs16Ws16 327.6700 InjMass 0.00 327.6700 FORMAT "%8.4" EXTENDED_LIMITS -327.6800 327.6700
 /begin AXIS_DESCR STD_AXIS Epm_nEng EngN 4 0.00 6100.000 FORMAT "%8.3" EXTENDED_LIMITS -16384.00 16383.50 DEPOSIT ABSOLUTE /end AXIS_DESCR
/end CHARACTERISTIC
/begin CHARACTERISTIC FBC_qGvrnThresMin_C "untere Mengenregelschwelle" VALUE 0x8004DE46 Val_Ws16 5.000000 InjMass 0.00 5.000000 FORMAT "%8.6" EXTENDED_LIMITS -327.6800 327.6700 /end CHARACTERISTIC
/begin CHARACTERISTIC FBC_qLimDia_C "Korrekturmengenbegrenzung während Auslesen der FBC-Korrekturmengen mit dem Diagnosetester" VALUE 0x8004DE48 Val_Ws16 20.00000 InjMass 0.00 20.00000 FORMAT "%8.5" EXTENDED_LIMITS -327.6800 327.6700 /end CHARACTERISTIC
/begin CHARACTERISTIC FBC_qLim_CUR "mengenabhängige Korrekturmengenbegrenzung (zur Dekativierung der FBC alle Werte auf 0)" CURVE 0x8004DE4A Cur_Xs16Ws16 327.6700 InjMass 0.00 327.6700 FORMAT "%8.4" EXTENDED_LIMITS -327.6800 327.6700
 /begin AXIS_DESCR STD_AXIS InjCtl_qSetUnBal InjMass 4 0.00 327.6700 FORMAT "%8.4" EXTENDED_LIMITS -327.6800 327.6700 DEPOSIT ABSOLUTE /end AXIS_DESCR
/end CHARACTERISTIC
/begin CHARACTERISTIC FBC_qRCLim_C "Begrenzungsmenge für die additiven Korrekturmengen von FBC_qRC_CA" VALUE 0x8004DE5C Val_Ws16 5.000000 InjMass 0.00 5.000000 FORMAT "%8.6" EXTENDED_LIMITS -327.6800 327.6700 /end CHARACTERISTIC
/begin CHARACTERISTIC FBC_qRC_CA "zylinderindividuelle Korrekturmenge zur Aufprägung eines Mengenmusters am Ausgang der Mengenausgleichsregelung" VAL_BLK 0x8004DE5E ValA_Ws16 5.000000 InjMass 0.00 5.000000 FORMAT "%8.6" EXTENDED_LIMITS -327.6800 327.6700 NUMBER 6 /end CHARACTERISTIC
/begin CHARACTERISTIC FBC_stOpModeFrz_C "Maske für aktuelle Betriebsart (Einfrieren des Ausgangs der FBC)" VALUE 0x8004DE6C Val_Wu32 4294967295.00 OneToOne 0.00 4294967295.00 FORMAT "%13.2" /end CHARACTERISTIC
/begin CHARACTERISTIC FBC_stOpModeInhib_C "Maske für aktuelle Betriebsart (Initialisierung des Ausgangs der FBC mit Null)" VALUE 0x8004DE70 Val_Wu32 4294967295.00 OneToOne 0.00 4294967295.00 FORMAT "%13.2" /end CHARACTERISTIC
/begin CHARACTERISTIC FBC_swtInitI_C "Initialisierung des I-Anteils beim Wechsel in den Zustand 'Regeln': '0' mit eingefrorenen Werten, '1' mit Null" VALUE 0x8004DE74 Val_Wu8 3.000 OneToOne 0.00 3.000 FORMAT "%5.3" EXTENDED_LIMITS 0.00 255.0 /end CHARACTERISTIC
/begin CHARACTERISTIC FBC_swtRC_C "Schalter zur Aktivierung von FBC_qRC_CA (1: 'aktiv'; 0: 'inaktiv')" VALUE 0x8004DE75 Val_Wu8 1.000 OneToOne 0.00 1.000 FORMAT "%5.3" EXTENDED_LIMITS 0.00 255.0 /end CHARACTERISTIC
/begin CHARACTERISTIC FBC_TFConst_C "Filterkoeffizient des Adaptionsfilters" VALUE 0x8004DE90 Val_Wr32 1.00000000 OneToOne 0.00 1.00000000 FORMAT "%10.8" EXTENDED_LIMITS -1.00000000E+037 1.00000000E+037 /end CHARACTERISTIC
/begin CHARACTERISTIC FBC_TFLrnConst_C "Filterkoeffizient des Bewertungsfilters" VALUE 0x8004DE94 Val_Wr32 1.00000000 OneToOne 0.00 1.00000000 FORMAT "%10.8" EXTENDED_LIMITS -1.00000000E+037 1.00000000E+037 /end CHARACTERISTIC
/begin CHARACTERISTIC FBC_ThresDyn_C "Drehzahldynamikgrenzwert um die Adaption zu deaktivieren" VALUE 0x8004DE98 Val_Wr32 1.00000000 OneToOne 0.00 1.00000000 FORMAT "%10.8" EXTENDED_LIMITS -1.00000000E+037 1.00000000E+037 /end CHARACTERISTIC
/begin CHARACTERISTIC FlFlt_Deb.tiHiLo_C "/" VALUE 0x8004E01A Kw_Ws16 655350.0 TimeDeb -327680.0 327670.0 FORMAT "%8.1" /end CHARACTERISTIC
/begin CHARACTERISTIC FlFlt_Deb.tiLoHi_C "/" VALUE 0x8004E01C Kw_Ws16 655350.0 TimeDeb -327680.0 327670.0 FORMAT "%8.1" /end CHARACTERISTIC
/begin CHARACTERISTIC FlFlt_swtSensPrs_C "" VALUE 0x8004E01E Val_Wu8 1.000 OneToOne 0.00 1.000 FORMAT "%5.3" EXTENDED_LIMITS 0.00 255.0 /end CHARACTERISTIC
/begin CHARACTERISTIC FlSys_dqSubsRgn.Pos_C "/" VALUE 0x8004E034 Kw_Ws32 327679.999847 RmpInjMass 0.00 327679.999847 FORMAT "%13.6" EXTENDED_LIMITS -327680.000000 327679.999847 /end CHARACTERISTIC
/begin CHARACTERISTIC FlSys_dqSubsRgn.Neg_C "/" VALUE 0x8004E038 Kw_Ws32 327679.999847 RmpInjMass 0.00 327679.999847 FORMAT "%13.6" EXTENDED_LIMITS -327680.000000 327679.999847 /end CHARACTERISTIC
/begin CHARACTERISTIC FlSys_facFlConsAdjDfl_C "Kraftstoffverbrauchs-Ersatzabgleichwert" VALUE 0x8004E03C Kw_Ws16 2.000000 Fact 0.00 2.000000 FORMAT "%8.6" EXTENDED_LIMITS -4.000000 3.999878 /end CHARACTERISTIC
/begin CHARACTERISTIC FlSys_facFlConsAdjMax_C "Maximalwert zur Begrenzung des Kraftstoffverbrauch-Abgleichwerts" VALUE 0x8004E03E Kw_Ws16 2.000000 Fact 0.00 2.000000 FORMAT "%8.6" EXTENDED_LIMITS -4.000000 3.999878 /end CHARACTERISTIC
/begin CHARACTERISTIC FlSys_facFlConsAdjMin_C "Minimalwert zur Begrenzung des Kraftstoffverbrach-Abgleichwerts" VALUE 0x8004E040 Kw_Ws16 2.000000 Fact 0.00 2.000000 FORMAT "%8.6" EXTENDED_LIMITS -4.000000 3.999878 /end CHARACTERISTIC
/begin CHARACTERISTIC FlSys_nDeflateMax_C "obere Drehzahlschwelle für die Entlüftung Niederdruckkreis" VALUE 0x8004E02C Val_Ws16 16383.50 EngN 0.00 16383.50 FORMAT "%8.2" EXTENDED_LIMITS -16384.00 16383.50 /end CHARACTERISTIC
/begin CHARACTERISTIC FlSys_nDeflateMin_C "untere Drehzahlschwelle für die Entlüftung Niederdruckkreis" VALUE 0x8004E02E Val_Ws16 16383.50 EngN 0.00 16383.50 FORMAT "%8.2" EXTENDED_LIMITS -16384.00 16383.50 /end CHARACTERISTIC
/begin CHARACTERISTIC FlSys_pDeflate_C "Raildruckschwelle für die Entlüftung Niederdruckkreis" VALUE 0x8004E030 Val_Ws16 2000.000 Pres_Rail 0.00 2000.000 FORMAT "%5.3" EXTENDED_LIMITS -3276.800 3276.700 /end CHARACTERISTIC
/begin CHARACTERISTIC FlSys_qSubs_MAP "Kennfeld für Ersatzmenge im Regenerationsfall" MAP 0x8004E042 Kf_Xs16_Ys16_Ws16 80.00000 InjMassCyc 0.00 80.00000 FORMAT "%8.5" EXTENDED_LIMITS -327.6800 327.6700
 /begin AXIS_DESCR STD_AXIS Epm_nEng EngN 16 0.00 8000.000 FORMAT "%8.3" EXTENDED_LIMITS -16384.00 16383.50 DEPOSIT ABSOLUTE /end AXIS_DESCR
 /begin AXIS_DESCR STD_AXIS ActMod_trq Trq 16 0.00 200.0000 FORMAT "%8.4" EXTENDED_LIMITS -3276.800 3276.700 DEPOSIT ABSOLUTE /end AXIS_DESCR
/end CHARACTERISTIC
/begin CHARACTERISTIC FlSys_rhoFl_C "Kraftstoffdichte bei Normtemperatur" VALUE 0x8004E020 Val_Ws16 999.9000 RhoFuel 0.1000000 1000.000 FORMAT "%8.3" EXTENDED_LIMITS -3276.800 3276.700 /end CHARACTERISTIC
/begin CHARACTERISTIC FlSys_rhoFl_CUR "temperaturabhängige Kraftstoffdichte" CURVE 0x8004E022 Cur_Xs16Ws16 999.9000 RhoFuel 0.1000000 1000.000 FORMAT "%8.3" EXTENDED_LIMITS -3276.800 3276.700
 /begin AXIS_DESCR STD_AXIS FuelT_t Temp_Cels 2 -50.14000 149.8600 FORMAT "%8.4" EXTENDED_LIMITS -3549.940 3003.560 DEPOSIT ABSOLUTE /end AXIS_DESCR
/end CHARACTERISTIC
/begin CHARACTERISTIC FlSys_rhoFuel_C "Kraftstoffdichte" VALUE 0x8004E286 Kw_Ws16 1500.000 RhoFuel 0.00 1500.000 FORMAT "%8.3" EXTENDED_LIMITS -3276.800 3276.700 /end CHARACTERISTIC
/begin CHARACTERISTIC FlSys_stSubsRgnMsk_C "Maske für Umschaltung auf Ersatzkennfel" VALUE 0x8004E288 Kw_Wu32 4294967295.00 OneToOne 0.00 4294967295.00 FORMAT "%13.2" /end CHARACTERISTIC
/begin CHARACTERISTIC FlSys_tiDeflateDel_C "Verzögerungszeit für die Entlüftung Niederdruckkreis" VALUE 0x8004E032 Val_Ws16 327670.0 Time_ms 0.00 327670.0 FORMAT "%8.1" EXTENDED_LIMITS -327680.0 327670.0 /end CHARACTERISTIC
/begin CHARACTERISTIC FuelT_RmpSlp.Pos_C "/" VALUE 0x8007A1FC Kw_Ws32 3276798.99750 RmpTemp 1.00097656250 3276799.99847 FORMAT "%13.5" EXTENDED_LIMITS -3276800.00000 3276799.99847 /end CHARACTERISTIC
/begin CHARACTERISTIC FuelT_RmpSlp.Neg_C "/" VALUE 0x8007A200 Kw_Ws32 3276798.99750 RmpTemp 1.00097656250 3276799.99847 FORMAT "%13.5" EXTENDED_LIMITS -3276800.00000 3276799.99847 /end CHARACTERISTIC
/begin CHARACTERISTIC FuelT_SRC.uMin_C "/" VALUE 0x8007A192 Kw_Ws16 200.0000 Volt 0.00 200.0000 FORMAT "%8.4" EXTENDED_LIMITS -6553.600 6553.400 /end CHARACTERISTIC
/begin CHARACTERISTIC FuelT_SRC.uMax_C "/" VALUE 0x8007A194 Kw_Ws16 3200.000 Volt 2000.000 5200.000 FORMAT "%8.3" EXTENDED_LIMITS -6553.600 6553.400 /end CHARACTERISTIC
/begin CHARACTERISTIC FuelT_swtSensPrs_C "Sensorkonfigurationssschalter" VALUE 0x8007A204 Kw_Wu8 255.0 OneToOne 0.00 255.0 FORMAT "%5.1" /end CHARACTERISTIC
/begin CHARACTERISTIC FuelT_swtTempSel_C "Schalter zur Anzeige von dem Vorhandensein des Kraftstofftempertursensors" VALUE 0x8007A205 Kw_Wu8 255.0 OneToOne 0.00 255.0 FORMAT "%5.1" /end CHARACTERISTIC
/begin CHARACTERISTIC FuelT_tDflFlSys_C "Vorgabewert der Kraftstoffsystemtemperatur" VALUE 0x8007A206 Kw_Ws16 6553.500 Temp_Cels -3549.940 3003.560 FORMAT "%8.3" /end CHARACTERISTIC
/begin CHARACTERISTIC FuelT_tiLPFiltPT1_C "" VALUE 0x8007A208 Kw_Ws32 4294.9672940 TimeDelay_s 0.000002000000001 4294.9672960 FORMAT "%12.7" /end CHARACTERISTIC
/begin CHARACTERISTIC FuelT_TransStg.Dfl_C "/" VALUE 0x8007A20C Kw_Ws16 250.0000 Temp_Cels -50.04000 199.9600 FORMAT "%8.4" EXTENDED_LIMITS -3549.940 3003.560 /end CHARACTERISTIC
/begin CHARACTERISTIC FuelT_TransStg.stSensId_C "/" VALUE 0x8007A20E Kw_Wu8 255.0 OneToOne 0.00 255.0 FORMAT "%5.1" /end CHARACTERISTIC
/begin CHARACTERISTIC FuelT_tTransf_CUR "Kennlinie zur Konvertierung der ADC-Spannung in erfasste Temperatur" CURVE 0x8007A196 Cur_Xs16Ws16 250.0000 Temp_Cels -50.04000 199.9600 FORMAT "%8.4" EXTENDED_LIMITS -3549.940 3003.560
 /begin AXIS_DESCR STD_AXIS FuelT_uRaw Volt 25 0.00 5200.000 FORMAT "%8.3" EXTENDED_LIMITS -6553.600 6553.400 DEPOSIT ABSOLUTE /end AXIS_DESCR
/end CHARACTERISTIC
/begin CHARACTERISTIC GbxNPos_dcycPwmInMax_C "" VALUE 0x8004E2A4 Val_Wu16 655.3500 DtyCyc 0.00 655.3500 FORMAT "%8.4" /end CHARACTERISTIC
/begin CHARACTERISTIC GbxNPos_dcycPwmInMin_C "" VALUE 0x8004E2A6 Val_Wu16 655.3500 DtyCyc 0.00 655.3500 FORMAT "%8.4" /end CHARACTERISTIC
/begin CHARACTERISTIC GbxNPos_rTransfNPos_CUR "" CURVE 0x8004E2B8 Cur_Xs16Ws16 655.3500 DtyCyc -327.6800 327.6700 FORMAT "%8.4"
 /begin AXIS_DESCR STD_AXIS GbxNPos_rRawNPos DtyCyc 6 -327.6800 327.6700 FORMAT "%8.4" DEPOSIT ABSOLUTE /end AXIS_DESCR
/end CHARACTERISTIC
/begin CHARACTERISTIC GbxNPos_tiPerMax_C "" VALUE 0x8004E2A8 Val_Ws32 214748364.750 Time_PwmHigh -107374182.400 107374182.350 FORMAT "%13.3" /end CHARACTERISTIC
/begin CHARACTERISTIC GbxNPos_tiPerPwmInMax_C "" VALUE 0x8004E2AC Val_Wu16 3276.750 Time_PwmHigh 0.00 3276.750 FORMAT "%8.3" /end CHARACTERISTIC
/begin CHARACTERISTIC GbxNPos_tiPerPwmInMin_C "" VALUE 0x8004E2AE Val_Wu16 3276.750 Time_PwmHigh 0.00 3276.750 FORMAT "%8.3" /end CHARACTERISTIC
/begin CHARACTERISTIC Gbx_NPosDeb.tiHiLo_C "/" VALUE 0x8004E2B0 Val_Ws16 655350.0 TimeDeb -327680.0 327670.0 FORMAT "%8.1" /end CHARACTERISTIC
/begin CHARACTERISTIC Gbx_NPosDeb.tiLoHi_C "/" VALUE 0x8004E2B2 Val_Ws16 655350.0 TimeDeb -327680.0 327670.0 FORMAT "%8.1" /end CHARACTERISTIC
/begin CHARACTERISTIC Gbx_stNPosDfl_C "" VALUE 0x8004E2D2 Kw_Wu8 255.0 OneToOne 0.00 255.0 FORMAT "%5.1" /end CHARACTERISTIC
/begin CHARACTERISTIC Gbx_swtSigNPos_C "" VALUE 0x8004E2B4 Val_Wu8 255.0 OneToOne 0.00 255.0 FORMAT "%5.1" /end CHARACTERISTIC
/begin CHARACTERISTIC GlbDa_aX_C "" VALUE 0x8007A214 Kw_Ws16 65.53500 Acc -32.76800 32.76700 FORMAT "%8.5" /end CHARACTERISTIC
/begin CHARACTERISTIC GlbDa_facDstCnt_C "" VALUE 0x8007A210 Val_Ws16 7.999878 Fact -4.000000 3.999878 FORMAT "%8.6" /end CHARACTERISTIC
/begin CHARACTERISTIC GlbDa_lDstLim_C "" VALUE 0x8007A212 Val_Ws16 65535.00 Length -32768.00 32767.00 FORMAT "%8.2" /end CHARACTERISTIC
/begin CHARACTERISTIC GlbDa_lWhlCirc_C "" VALUE 0x8007A216 Kw_Ws16 65.53500 Length_fine -32.76800 32.76700 FORMAT "%8.5" /end CHARACTERISTIC
/begin CHARACTERISTIC GlbDa_pEnv_C "" VALUE 0x8007A218 Kw_Ws16 36268.00 Pres_hPa -32768.00 3500.00 FORMAT "%8.2" EXTENDED_LIMITS -32768.00 32767.00 /end CHARACTERISTIC
/begin CHARACTERISTIC GlbDa_stIARlsVeh_C "" VALUE 0x8007A228 Val_Wu8 255.0 OneToOne 0.00 255.0 FORMAT "%5.1" /end CHARACTERISTIC
/begin CHARACTERISTIC GlbDa_stVehLimMin_C "" VALUE 0x8007A229 Val_Wu8 255.0 OneToOne 0.00 255.0 FORMAT "%5.1" /end CHARACTERISTIC
/begin CHARACTERISTIC GlbDa_tEnv_C "" VALUE 0x8007A21A Kw_Ws16 6553.500 Temp_Cels -3549.940 3003.560 FORMAT "%8.3" /end CHARACTERISTIC
/begin CHARACTERISTIC GlbDa_tiFltAX_C "" VALUE 0x8007A21C Kw_Ws32 4294.9672940 TimeDelay_s 0.000002000000001 4294.9672960 FORMAT "%12.7" /end CHARACTERISTIC
/begin CHARACTERISTIC GlbDa_tiFltVX_C "" VALUE 0x8007A220 Kw_Ws32 4294.9672940 TimeDelay_s 0.000002000000001 4294.9672960 FORMAT "%12.7" /end CHARACTERISTIC
/begin CHARACTERISTIC GlbDa_tIndAir_C "" VALUE 0x8007A224 Kw_Ws16 6553.500 Temp_Cels -3549.940 3003.560 FORMAT "%8.3" /end CHARACTERISTIC
/begin CHARACTERISTIC GlbDa_trqVehLimMin_C "" VALUE 0x8007A22A Val_Ws16 6553.500 Trq -3276.800 3276.700 FORMAT "%8.3" /end CHARACTERISTIC
/begin CHARACTERISTIC GlbDa_vX_C "" VALUE 0x8007A226 Kw_Ws16 655.3500 Vel -327.6800 327.6700 FORMAT "%8.4" /end CHARACTERISTIC
/begin CHARACTERISTIC GlwCtl_ctPreGlwErr_C "" VALUE 0x8004E4E4 Val_Wu8 99.00 OneToOne 1.000 100.0 FORMAT "%5.1" EXTENDED_LIMITS 0.00 255.0 /end CHARACTERISTIC
/begin CHARACTERISTIC GlwCtl_ctPreGlw_C "" VALUE 0x8004E4E5 Val_Wu8 255.0 OneToOne 0.00 255.0 FORMAT "%5.1" /end CHARACTERISTIC
/begin CHARACTERISTIC GlwCtl_nEngPre_C "" VALUE 0x8004E4E6 Val_Wu16 5960.000 EngN 40.00000 6000.000 FORMAT "%8.3" EXTENDED_LIMITS 0.00 32767.50 /end CHARACTERISTIC
/begin CHARACTERISTIC GlwCtl_nLamp_C "" VALUE 0x8004E2D4 Val_Ws16 5000.000 EngN 0.00 5000.000 FORMAT "%8.3" EXTENDED_LIMITS -16384.00 16383.50 /end CHARACTERISTIC
/begin CHARACTERISTIC GlwCtl_rLimitClnt_CUR "" CURVE 0x8004E320 Cur_Xs16Ws16 400.0000 OneToOne -200.0000 200.0000 FORMAT "%8.4" EXTENDED_LIMITS -32768.00 32767.00
 /begin AXIS_DESCR STD_AXIS GlwCtl_tClnt Temp_Cels 8 -50.04000 149.9600 FORMAT "%8.4" EXTENDED_LIMITS -3549.940 3003.560 DEPOSIT ABSOLUTE /end AXIS_DESCR
/end CHARACTERISTIC
/begin CHARACTERISTIC GlwCtl_rLimitNM_MAP "" MAP 0x8004E342 Map_Xs16Ys16Ws16 400.0000 OneToOne -200.0000 200.0000 FORMAT "%8.4" EXTENDED_LIMITS -32768.00 32767.00
 /begin AXIS_DESCR STD_AXIS Epm_nEng EngN 6 0.00 6000.000 FORMAT "%8.3" EXTENDED_LIMITS -16384.00 16383.50 DEPOSIT ABSOLUTE /end AXIS_DESCR
 /begin AXIS_DESCR STD_AXIS CoETS_trqInrCurr Trq 8 0.00 999.0000 FORMAT "%8.4" EXTENDED_LIMITS -3276.800 3276.700 DEPOSIT ABSOLUTE /end AXIS_DESCR
/end CHARACTERISTIC
/begin CHARACTERISTIC GlwCtl_rMaxOff_C "" VALUE 0x8004E3C2 Val_Wu8 100.0 OneToOne 0.00 100.0 FORMAT "%5.1" EXTENDED_LIMITS 0.00 255.0 /end CHARACTERISTIC
/begin CHARACTERISTIC GlwCtl_rMaxStdby_C "" VALUE 0x8004E3C3 Val_Wu8 100.0 OneToOne 0.00 100.0 FORMAT "%5.1" EXTENDED_LIMITS 0.00 255.0 /end CHARACTERISTIC
/begin CHARACTERISTIC GlwCtl_rMax_C "" VALUE 0x8004E3C4 Val_Wu8 200.0 OneToOne 0.00 200.0 FORMAT "%5.1" EXTENDED_LIMITS 0.00 255.0 /end CHARACTERISTIC
/begin CHARACTERISTIC GlwCtl_rPwrClnt_CUR "" CURVE 0x8004E3C6 Cur_Xs16Ws16 400.0000 OneToOne -200.0000 200.0000 FORMAT "%8.4" EXTENDED_LIMITS -32768.00 32767.00
 /begin AXIS_DESCR STD_AXIS GlwCtl_tClnt Temp_Cels 8 -50.04000 149.9600 FORMAT "%8.4" EXTENDED_LIMITS -3549.940 3003.560 DEPOSIT ABSOLUTE /end AXIS_DESCR
/end CHARACTERISTIC
/begin CHARACTERISTIC GlwCtl_rPwrNM_MAP "" MAP 0x8004E3E8 Map_Xs16Ys16Ws16 400.0000 OneToOne -200.0000 200.0000 FORMAT "%8.4" EXTENDED_LIMITS -32768.00 32767.00
 /begin AXIS_DESCR STD_AXIS Epm_nEng EngN 8 0.00 6000.000 FORMAT "%8.3" EXTENDED_LIMITS -16384.00 16383.50 DEPOSIT ABSOLUTE /end AXIS_DESCR
 /begin AXIS_DESCR STD_AXIS CoETS_trqInrCurr Trq 8 0.00 999.0000 FORMAT "%8.4" EXTENDED_LIMITS -3276.800 3276.700 DEPOSIT ABSOLUTE /end AXIS_DESCR
/end CHARACTERISTIC
/begin CHARACTERISTIC GlwCtl_rPwrPAir_CUR "" CURVE 0x8004E48C Cur_Xs16Ws16 400.0000 OneToOne -200.0000 200.0000 FORMAT "%8.4" EXTENDED_LIMITS -32768.00 32767.00
 /begin AXIS_DESCR STD_AXIS EnvP_p Pres_hPa 8 0.00 3500.000 FORMAT "%8.3" EXTENDED_LIMITS -32768.00 32767.00 DEPOSIT ABSOLUTE /end AXIS_DESCR
/end CHARACTERISTIC
/begin CHARACTERISTIC GlwCtl_rPwrTAir_CUR "" CURVE 0x8004E4AE Cur_Xs16Ws16 400.0000 OneToOne -200.0000 200.0000 FORMAT "%8.4" EXTENDED_LIMITS -32768.00 32767.00
 /begin AXIS_DESCR STD_AXIS GlwCtl_tAir Temp_Cels 8 -50.04000 149.9600 FORMAT "%8.4" EXTENDED_LIMITS -3549.940 3003.560 DEPOSIT ABSOLUTE /end AXIS_DESCR
/end CHARACTERISTIC
/begin CHARACTERISTIC GlwCtl_rStart_CUR "" CURVE 0x8004E4D0 Cur_Xs16Ws16 99.00000 OneToOne 101.0000 200.0000 FORMAT "%8.4" EXTENDED_LIMITS -32768.00 32767.00
 /begin AXIS_DESCR STD_AXIS GlwCtl_tClnt Temp_Cels 2 -50.04000 149.9600 FORMAT "%8.4" EXTENDED_LIMITS -3549.940 3003.560 DEPOSIT ABSOLUTE /end AXIS_DESCR
/end CHARACTERISTIC
/begin CHARACTERISTIC GlwCtl_rThresGlwOn_C "" VALUE 0x8004E4DA Val_Ws16 100.0000 OneToOne 0.00 100.0000 FORMAT "%8.4" EXTENDED_LIMITS -32768.00 32767.00 /end CHARACTERISTIC
/begin CHARACTERISTIC GlwCtl_rThresOff_C "" VALUE 0x8004E4DC Val_Ws16 100.0000 OneToOne 0.00 100.0000 FORMAT "%8.4" EXTENDED_LIMITS -32768.00 32767.00 /end CHARACTERISTIC
/begin CHARACTERISTIC GlwCtl_stHdnPreGlwMsk1_C "" VALUE 0x8004E4E8 Val_Wu16 255.0000 OneToOne 0.00 255.0000 FORMAT "%8.4" EXTENDED_LIMITS 0.00 65535.00 /end CHARACTERISTIC
/begin CHARACTERISTIC GlwCtl_stHdnPreGlwMsk2_C "" VALUE 0x8004E4EA Val_Wu16 255.0000 OneToOne 0.00 255.0000 FORMAT "%8.4" EXTENDED_LIMITS 0.00 65535.00 /end CHARACTERISTIC
/begin CHARACTERISTIC GlwCtl_stHdnPreGlwMskT1_C "" VALUE 0x8004E4EC Val_Wu16 255.0000 OneToOne 0.00 255.0000 FORMAT "%8.4" EXTENDED_LIMITS 0.00 65535.00 /end CHARACTERISTIC
/begin CHARACTERISTIC GlwCtl_stLampEnaMsk_C "" VALUE 0x8004E4EE Val_Wu16 255.0000 OneToOne 0.00 255.0000 FORMAT "%8.4" EXTENDED_LIMITS 0.00 65535.00 /end CHARACTERISTIC
/begin CHARACTERISTIC GlwCtl_tAirSel_C "" VALUE 0x8004E4DE Val_Wu8 255.0 OneToOne 0.00 255.0 FORMAT "%5.1" /end CHARACTERISTIC
/begin CHARACTERISTIC GlwCtl_tDflClnt_C "" VALUE 0x8004E4F0 Val_Ws16 100.0000 Temp_Cels -50.04000 49.96000 FORMAT "%8.5" EXTENDED_LIMITS -3549.940 3003.560 /end CHARACTERISTIC
/begin CHARACTERISTIC GlwCtl_tEngSel_C "" VALUE 0x8004E4F2 Val_Wu8 255.0 OneToOne 0.00 255.0 FORMAT "%5.1" /end CHARACTERISTIC
/begin CHARACTERISTIC GlwCtl_tiDebConvSig_C "" VALUE 0x8004E4F4 Val_Wu16 65540.00 Time_ms 0.00 65540.00 FORMAT "%8.2" EXTENDED_LIMITS 0.00 655350.0 /end CHARACTERISTIC
/begin CHARACTERISTIC GlwCtl_tiDebEpmPre_C "" VALUE 0x8004E4F6 Val_Wu16 65540.00 Time_ms 0.00 65540.00 FORMAT "%8.2" EXTENDED_LIMITS 0.00 655350.0 /end CHARACTERISTIC
/begin CHARACTERISTIC GlwCtl_tiLampEng_C "" VALUE 0x8004E2D6 Val_Wu16 65000.00 Time_ms 0.00 65000.00 FORMAT "%8.2" EXTENDED_LIMITS 0.00 655350.0 /end CHARACTERISTIC
/begin CHARACTERISTIC GlwCtl_tiLampPAir_CUR "" CURVE 0x8004E2D8 Cur_Xs16Ws16 655140.0 Time_ms 0.00 655140.0 FORMAT "%8.1" EXTENDED_LIMITS -327680.0 327670.0
 /begin AXIS_DESCR STD_AXIS EnvP_p Pres_hPa 4 0.00 3500.000 FORMAT "%8.3" EXTENDED_LIMITS -32768.00 32767.00 DEPOSIT ABSOLUTE /end AXIS_DESCR
/end CHARACTERISTIC
/begin CHARACTERISTIC GlwCtl_tiLamptClnt_CUR "" CURVE 0x8004E2EA Cur_Xs16Ws16 655140.0 Time_ms 0.00 655140.0 FORMAT "%8.1" EXTENDED_LIMITS -327680.0 327670.0
 /begin AXIS_DESCR STD_AXIS GlwCtl_tClnt Temp_Cels 8 -50.14000 149.8600 FORMAT "%8.4" EXTENDED_LIMITS -3549.940 3003.560 DEPOSIT ABSOLUTE /end AXIS_DESCR
/end CHARACTERISTIC
/begin CHARACTERISTIC GlwCtl_tiLampUBatt_CUR "" CURVE 0x8004E30C Cur_Xs16Ws16 655140.0 Time_ms 0.00 655140.0 FORMAT "%8.1" EXTENDED_LIMITS -327680.0 327670.0
 /begin AXIS_DESCR STD_AXIS BattU_u Volt_Batt 4 0.00 20780.00 FORMAT "%8.2" EXTENDED_LIMITS -655360.0 655340.0 DEPOSIT ABSOLUTE /end AXIS_DESCR
/end CHARACTERISTIC
/begin CHARACTERISTIC GlwCtl_tiMaxOn_C "" VALUE 0x8004E4E0 Val_Wu16 180000.0 Time_ms 0.00 180000.0 FORMAT "%8.1" EXTENDED_LIMITS 0.00 655350.0 /end CHARACTERISTIC
/begin CHARACTERISTIC GlwCtl_tiNoEngSpd_C "" VALUE 0x8004E4F8 Val_Wu16 65540.00 Time_ms 0.00 65540.00 FORMAT "%8.2" EXTENDED_LIMITS 0.00 655350.0 /end CHARACTERISTIC
/begin CHARACTERISTIC GlwCtl_tiPre_CUR "" CURVE 0x8004E4FA Cur_Xs16Ws16 655140.0 Time_ms 0.00 655140.0 FORMAT "%8.1" EXTENDED_LIMITS -327680.0 327670.0
 /begin AXIS_DESCR STD_AXIS GlwCtl_tClnt Temp_Cels 8 -50.14000 149.8600 FORMAT "%8.4" EXTENDED_LIMITS -3549.940 3003.560 DEPOSIT ABSOLUTE /end AXIS_DESCR
/end CHARACTERISTIC
/begin CHARACTERISTIC GlwCtl_tiPSync_C "" VALUE 0x8004E31E Val_Wu16 10000.00 Time_ms 0.00 10000.00 FORMAT "%8.2" EXTENDED_LIMITS 0.00 655350.0 /end CHARACTERISTIC
/begin CHARACTERISTIC GlwCtl_tiReady_C "" VALUE 0x8004E51C Val_Wu16 65540.00 Time_ms 0.00 65540.00 FORMAT "%8.2" EXTENDED_LIMITS 0.00 655350.0 /end CHARACTERISTIC
/begin CHARACTERISTIC GlwCtl_tiStdby_C "" VALUE 0x8004E4E2 Val_Wu16 180000.0 Time_ms 0.00 180000.0 FORMAT "%8.1" EXTENDED_LIMITS 0.00 655350.0 /end CHARACTERISTIC
/begin CHARACTERISTIC GlwCtl_tiStrt_C "Dauer Status Startglühen" VALUE 0x8004E51E Val_Wu16 65540.00 Time_ms 0.00 65540.00 FORMAT "%8.2" EXTENDED_LIMITS 0.00 655350.0 /end CHARACTERISTIC
/begin CHARACTERISTIC GlwCtl_tiWaitforTemp_C "" VALUE 0x8004E520 Val_Wu16 65540.00 Time_ms 0.00 65540.00 FORMAT "%8.2" EXTENDED_LIMITS 0.00 655350.0 /end CHARACTERISTIC
/begin CHARACTERISTIC GlwCtl_tLimHigh_C "" VALUE 0x8004E522 Val_Ws16 473.1000 Temp_Cels -273.1400 199.9600 FORMAT "%8.4" EXTENDED_LIMITS -3549.940 3003.560 /end CHARACTERISTIC
/begin CHARACTERISTIC GlwCtl_tLimLow_C "" VALUE 0x8004E524 Val_Ws16 473.1000 Temp_Cels -273.1400 199.9600 FORMAT "%8.4" EXTENDED_LIMITS -3549.940 3003.560 /end CHARACTERISTIC
/begin CHARACTERISTIC GlwCtl_tStrt_C "Oberer Schwellwert der Wassertemperatur für Startglühen" VALUE 0x8004E526 Val_Ws16 100.0000 Temp_Cels -50.04000 49.96000 FORMAT "%8.5" EXTENDED_LIMITS -3549.940 3003.560 /end CHARACTERISTIC
/begin CHARACTERISTIC GlwPlg_numBstMax_C "" VALUE 0x8004E528 Kw_Wu8 62.00 OneToOne 65.00 127.0 FORMAT "%5.1" EXTENDED_LIMITS 0.00 255.0 /end CHARACTERISTIC
/begin CHARACTERISTIC GlwPlg_numItmMax_C "" VALUE 0x8004E529 Kw_Wu8 61.00 OneToOne 2.000 63.00 FORMAT "%5.2" EXTENDED_LIMITS 0.00 255.0 /end CHARACTERISTIC
/begin CHARACTERISTIC GlwPlg_tiNewSt_C "" VALUE 0x8004E52A Val_Ws16 655350.0 Time_ms -327680.0 327670.0 FORMAT "%8.1" /end CHARACTERISTIC
/begin CHARACTERISTIC GlwPlg_tiOut_C "" VALUE 0x8004E52C Val_Ws16 655350.0 Time_ms -327680.0 327670.0 FORMAT "%8.1" /end CHARACTERISTIC
/begin CHARACTERISTIC GlwPlg_tiRst_C "" VALUE 0x8004E52E Val_Ws16 1980.000 Time_ms 20.00000 2000.000 FORMAT "%8.3" EXTENDED_LIMITS -327680.0 327670.0 /end CHARACTERISTIC
/begin CHARACTERISTIC HESrv_swtPOpVis_C "Bankselektion für die Arbeitspunktanzeige bei zweiflutigen Luftsystemen in INCA" VALUE 0x8004E530 Val_Wu8 1.00000000000 HESrv_SwtPOpVis 0.00 1.00000000000 FORMAT "%13.11" /end CHARACTERISTIC
/begin CHARACTERISTIC HESrv_swtScndFlwActv_C "" VALUE 0x8004E531 Val_Wu8 1.000 OneToOne 0.00 1.000 FORMAT "%5.3" EXTENDED_LIMITS 0.00 255.0 /end CHARACTERISTIC
/begin CHARACTERISTIC HLSDem_CldClthdnAccLim_C "Obere Grenze der zulässigen Beschleunigung der Motordrehzahl, Kalter Motor, offene Kupplung" VALUE 0x8004E534 Val_Wr32 12000.0000 ISC_dnEng_float 0.00 12000.0000 FORMAT "%10.4" EXTENDED_LIMITS -1.00000000E+037 1.00000000E+037 /end CHARACTERISTIC
/begin CHARACTERISTIC HLSDem_CldClthdnDeclLim_C "Untere Grenze der zulässigen Verzögerung der Motordrehzahl, Kalter Motor, offene Kupplung" VALUE 0x8004E538 Val_Wr32 12000.0000 ISC_dnEng_float -12000.0000 0.00 FORMAT "%10.4" EXTENDED_LIMITS -1.00000000E+037 1.00000000E+037 /end CHARACTERISTIC
/begin CHARACTERISTIC HLSDem_CldClthILo.Ki_C "I-Parametersatz unterer Drehmomentpfad, kalter Motor und geöffnete Kupplung/Kleinsignal Verstärkungsfaktor (Ki)" VALUE 0x8004E53C Val_Wr32 20.0000000 ISC_Ki_rpm2Nm_float 0.00 20.0000000 FORMAT "%10.7" EXTENDED_LIMITS -1.00000000E+037 1.00000000E+037 /end CHARACTERISTIC
/begin CHARACTERISTIC HLSDem_CldClthILo.KiPos_C "I-Parametersatz unterer Drehmomentpfad, kalter Motor und geöffnete Kupplung/Großsignal Verstärkungsfaktor positiv (Ki)" VALUE 0x8004E540 Val_Wr32 20.0000000 ISC_Ki_rpm2Nm_float 0.00 20.0000000 FORMAT "%10.7" EXTENDED_LIMITS -1.00000000E+037 1.00000000E+037 /end CHARACTERISTIC
/begin CHARACTERISTIC HLSDem_CldClthILo.KiNeg_C "I-Parametersatz unterer Drehmomentpfad, kalter Motor und geöffnete Kupplung/Großsignal Verstärkungsfaktor negativ (Ki)" VALUE 0x8004E544 Val_Wr32 20.0000000 ISC_Ki_rpm2Nm_float 0.00 20.0000000 FORMAT "%10.7" EXTENDED_LIMITS -1.00000000E+037 1.00000000E+037 /end CHARACTERISTIC
/begin CHARACTERISTIC HLSDem_CldClthILo.WinPos_C "I-Parametersatz unterer Drehmomentpfad, kalter Motor und geöffnete Kupplung/Kleinsignal Fensterbreite positiv" VALUE 0x8004E548 Val_Wr32 12000.0000 EngN_float -6000.00000 6000.00000 FORMAT "%10.5" EXTENDED_LIMITS -1.00000000E+037 1.00000000E+037 /end CHARACTERISTIC
/begin CHARACTERISTIC HLSDem_CldClthILo.WinNeg_C "I-Parametersatz unterer Drehmomentpfad, kalter Motor und geöffnete Kupplung/Kleinsignal Fensterbreite negativ" VALUE 0x8004E54C Val_Wr32 12000.0000 EngN_float -6000.00000 6000.00000 FORMAT "%10.5" EXTENDED_LIMITS -1.00000000E+037 1.00000000E+037 /end CHARACTERISTIC
/begin CHARACTERISTIC HLSDem_CldClthInrtDrvTrn_C "Massenträgheitsmoment offener Antriebstrang" VALUE 0x8004E550 Val_Wr32 20.0000000 ISC_Inirtia_float 0.00 20.0000000 FORMAT "%10.7" EXTENDED_LIMITS -1.00000000E+037 1.00000000E+037 /end CHARACTERISTIC
/begin CHARACTERISTIC HLSDem_CldClthInrtEng_C "Massenträgheitsmoment offener Antriebstrang, Kalter Motor" VALUE 0x8004E554 Val_Wr32 20.0000000 ISC_Inirtia_float 0.00 20.0000000 FORMAT "%10.7" EXTENDED_LIMITS -1.00000000E+037 1.00000000E+037 /end CHARACTERISTIC
/begin CHARACTERISTIC HLSDem_CldClthInrtVeh_C "Massenträgheitsmoment offener Antriebstrang, Kalter Motor" VALUE 0x8004E558 Val_Wr32 20.0000000 ISC_Inirtia_float 0.00 20.0000000 FORMAT "%10.7" EXTENDED_LIMITS -1.00000000E+037 1.00000000E+037 /end CHARACTERISTIC
/begin CHARACTERISTIC HLSDem_CldClthPLo.Kp_C "P-Parametersatz unterer Drehmomentpfad, kalter Motor und geöffnete Kupplung/Kleinsignal Verstärkungsfaktor (Kp)" VALUE 0x8004E55C Val_Wr32 20.0000000 ISC_Kp_rpm2Nm_float 0.00 20.0000000 FORMAT "%10.7" EXTENDED_LIMITS -1.00000000E+037 1.00000000E+037 /end CHARACTERISTIC
/begin CHARACTERISTIC HLSDem_CldClthPLo.KpPos_C "P-Parametersatz unterer Drehmomentpfad, kalter Motor und geöffnete Kupplung/Großsignal Verstärkungsfaktor positiv (Kp)" VALUE 0x8004E560 Val_Wr32 20.0000000 ISC_Kp_rpm2Nm_float 0.00 20.0000000 FORMAT "%10.7" EXTENDED_LIMITS -1.00000000E+037 1.00000000E+037 /end CHARACTERISTIC
/begin CHARACTERISTIC HLSDem_CldClthPLo.KpNeg_C "P-Parametersatz unterer Drehmomentpfad, kalter Motor und geöffnete Kupplung/Großsignal Verstärkungsfaktor negativ (Kp)" VALUE 0x8004E564 Val_Wr32 20.0000000 ISC_Kp_rpm2Nm_float 0.00 20.0000000 FORMAT "%10.7" EXTENDED_LIMITS -1.00000000E+037 1.00000000E+037 /end CHARACTERISTIC
/begin CHARACTERISTIC HLSDem_CldClthPLo.WinPos_C "P-Parametersatz unterer Drehmomentpfad, kalter Motor und geöffnete Kupplung/Kleinsignal Fensterbreite positiv" VALUE 0x8004E568 Val_Wr32 12000.0000 EngN_float -6000.00000 6000.00000 FORMAT "%10.5" EXTENDED_LIMITS -1.00000000E+037 1.00000000E+037 /end CHARACTERISTIC
/begin CHARACTERISTIC HLSDem_CldClthPLo.WinNeg_C "P-Parametersatz unterer Drehmomentpfad, kalter Motor und geöffnete Kupplung/Kleinsignal Fensterbreite negativ" VALUE 0x8004E56C Val_Wr32 12000.0000 EngN_float -6000.00000 6000.00000 FORMAT "%10.5" EXTENDED_LIMITS -1.00000000E+037 1.00000000E+037 /end CHARACTERISTIC
/begin CHARACTERISTIC HLSDem_CldClthrnEngvVeh_C "Verhältnis Motordrehzahl zu Fahrzeuggeschwindigkeit, Kalter Motor (offene Kupplung)" VALUE 0x8004E570 Val_Wr32 1000.00000 ISC_rnEng2vVeh_float 0.00 1000.00000 FORMAT "%10.5" EXTENDED_LIMITS -1.00000000E+037 1.00000000E+037 /end CHARACTERISTIC
/begin CHARACTERISTIC HLSDem_CldClthtiFltLosTrqEst_C "Zeitkonstante für die PT1-Glieder der Lastmomentabschätzung, Kalter Motor, offene Kupplung" VALUE 0x8004E574 Val_Wr32 60.0000000 ISC_tiPTsTrqLoss_float 0.00 60.0000000 FORMAT "%10.7" EXTENDED_LIMITS -1.00000000E+037 1.00000000E+037 /end CHARACTERISTIC
/begin CHARACTERISTIC HLSDem_CldClthtiFltnEng_C "Zeitkonstante für die PT2-Filterung der Motordrehzahl, Kalter Motor, Offene Kupplung" VALUE 0x8004E578 Val_Wr32 60.0000000 ISC_tiPT2nEng_float 0.00 60.0000000 FORMAT "%10.7" EXTENDED_LIMITS -1.00000000E+037 1.00000000E+037 /end CHARACTERISTIC
/begin CHARACTERISTIC HLSDem_CldGeardnAccLim_C "Obere Grenze der zulässigen Beschleunigung der Motordrehzahl, Kalter Motor, geschlossene Kupplung" VALUE 0x8004E57C Val_Wr32 12000.0000 ISC_dnEng_float 0.00 12000.0000 FORMAT "%10.4" EXTENDED_LIMITS -1.00000000E+037 1.00000000E+037 /end CHARACTERISTIC
/begin CHARACTERISTIC HLSDem_CldGeardnDeclLim_C "Untere Grenze der zulässigen Verzögerung der Motordrehzahl, Kalter Motor, geschlossene Kupplung" VALUE 0x8004E580 Val_Wr32 12000.0000 ISC_dnEng_float -12000.0000 0.00 FORMAT "%10.4" EXTENDED_LIMITS -1.00000000E+037 1.00000000E+037 /end CHARACTERISTIC
/begin CHARACTERISTIC HLSDem_CldGearInrtDrvTrn_C "Massenträgheitsmoment geschlossener Antriebstrang, Kalter Motor" VALUE 0x8004E584 Val_Wr32 20.0000000 ISC_Inirtia_float 0.00 20.0000000 FORMAT "%10.7" EXTENDED_LIMITS -1.00000000E+037 1.00000000E+037 /end CHARACTERISTIC
/begin CHARACTERISTIC HLSDem_CldGearInrtEng_C "Massenträgheitsmoment offener Antriebstrang" VALUE 0x8004E588 Val_Wr32 20.0000000 ISC_Inirtia_float 0.00 20.0000000 FORMAT "%10.7" EXTENDED_LIMITS -1.00000000E+037 1.00000000E+037 /end CHARACTERISTIC
/begin CHARACTERISTIC HLSDem_CldGearInrtVeh_C "Massenträgheitsmoment offener Antriebstrang, geschlossene Kupplung (kalter Motor)" VALUE 0x8004E58C Val_Wr32 20.0000000 ISC_Inirtia_float 0.00 20.0000000 FORMAT "%10.7" EXTENDED_LIMITS -1.00000000E+037 1.00000000E+037 /end CHARACTERISTIC
/begin CHARACTERISTIC HLSDem_CldGearPLo.Kp_C "P-Parametersatz unterer Drehmomentpfad, kalter Motor und geschlossene Kupplung (eingelegter Gang)/Kleinsignal Verstärkungsfaktor (Kp)" VALUE 0x8004E590 Val_Wr32 20.0000000 ISC_Kp_rpm2Nm_float 0.00 20.0000000 FORMAT "%10.7" EXTENDED_LIMITS -1.00000000E+037 1.00000000E+037 /end CHARACTERISTIC
/begin CHARACTERISTIC HLSDem_CldGearPLo.KpPos_C "P-Parametersatz unterer Drehmomentpfad, kalter Motor und geschlossene Kupplung (eingelegter Gang)/Großsignal Verstärkungsfaktor positiv (Kp)" VALUE 0x8004E594 Val_Wr32 20.0000000 ISC_Kp_rpm2Nm_float 0.00 20.0000000 FORMAT "%10.7" EXTENDED_LIMITS -1.00000000E+037 1.00000000E+037 /end CHARACTERISTIC
/begin CHARACTERISTIC HLSDem_CldGearPLo.KpNeg_C "P-Parametersatz unterer Drehmomentpfad, kalter Motor und geschlossene Kupplung (eingelegter Gang)/Großsignal Verstärkungsfaktor negativ (Kp)" VALUE 0x8004E598 Val_Wr32 20.0000000 ISC_Kp_rpm2Nm_float 0.00 20.0000000 FORMAT "%10.7" EXTENDED_LIMITS -1.00000000E+037 1.00000000E+037 /end CHARACTERISTIC
/begin CHARACTERISTIC HLSDem_CldGearPLo.WinPos_C "P-Parametersatz unterer Drehmomentpfad, kalter Motor und geschlossene Kupplung (eingelegter Gang)/Kleinsignal Fensterbreite positiv" VALUE 0x8004E59C Val_Wr32 12000.0000 EngN_float -6000.00000 6000.00000 FORMAT "%10.5" EXTENDED_LIMITS -1.00000000E+037 1.00000000E+037 /end CHARACTERISTIC
/begin CHARACTERISTIC HLSDem_CldGearPLo.WinNeg_C "P-Parametersatz unterer Drehmomentpfad, kalter Motor und geschlossene Kupplung (eingelegter Gang)/Kleinsignal Fensterbreite negativ" VALUE 0x8004E5A0 Val_Wr32 12000.0000 EngN_float -6000.00000 6000.00000 FORMAT "%10.5" EXTENDED_LIMITS -1.00000000E+037 1.00000000E+037 /end CHARACTERISTIC
/begin CHARACTERISTIC HLSDem_CldGeartiFltLosTrqEst_C "Zeitkonstante für die PT1-Glieder der Lastmomentabschätzung, Kalter Motor, geschlossene Kupplung" VALUE 0x8004E5A4 Val_Wr32 60.0000000 ISC_tiPTsTrqLoss_float 0.00 60.0000000 FORMAT "%10.7" EXTENDED_LIMITS -1.00000000E+037 1.00000000E+037 /end CHARACTERISTIC
/begin CHARACTERISTIC HLSDem_CldGeartiFltnEng_C "Zeitkonstante für die PT2-Filterung der Motordrehzahl, Kalter Motor, geschlossene Kupplung" VALUE 0x8004E5A8 Val_Wr32 60.0000000 ISC_tiPT2nEng_float 0.00 60.0000000 FORMAT "%10.7" EXTENDED_LIMITS -1.00000000E+037 1.00000000E+037 /end CHARACTERISTIC
/begin CHARACTERISTIC HLSDem_dnSetPLoLimHiTrm_C "Obergrenze für den Abgleichswert der unteren Leerlaufsolldrehzahl" VALUE 0x8004E798 Kw_Ws16 32767.50 EngN -16384.00 16383.50 FORMAT "%8.2" /end CHARACTERISTIC
/begin CHARACTERISTIC HLSDem_dnSetPLoLimLoTrm_C "Untergrenze für den Abgleichswert der unteren Leerlaufsolldrehzahl" VALUE 0x8004E79A Kw_Ws16 32767.50 EngN -16384.00 16383.50 FORMAT "%8.2" /end CHARACTERISTIC
/begin CHARACTERISTIC HLSDem_Gear1dnAccLim_C "Obere Grenze der zulässigen Beschleunigung der Motordrehzahl, geschlossene Kupplung (eingelegter Gang 1)" VALUE 0x8004E5AC Val_Wr32 12000.0000 ISC_dnEng_float 0.00 12000.0000 FORMAT "%10.4" EXTENDED_LIMITS -1.00000000E+037 1.00000000E+037 /end CHARACTERISTIC
/begin CHARACTERISTIC HLSDem_Gear1dnDeclLim_C "Untere Grenze der zulässigen Verzögerung der Motordrehzahl, geschlossene Kupplung (eingelegter Gang 1)" VALUE 0x8004E5B0 Val_Wr32 12000.0000 ISC_dnEng_float -12000.0000 0.00 FORMAT "%10.4" EXTENDED_LIMITS -1.00000000E+037 1.00000000E+037 /end CHARACTERISTIC
/begin CHARACTERISTIC HLSDem_Gear1InrtDrvTrn_C "Massenträgheitsmoment geschlossener Antriebstrang, Kalter Motor (eingelegter Gang 1)" VALUE 0x8004E5B4 Val_Wr32 20.0000000 ISC_Inirtia_float 0.00 20.0000000 FORMAT "%10.7" EXTENDED_LIMITS -1.00000000E+037 1.00000000E+037 /end CHARACTERISTIC
/begin CHARACTERISTIC HLSDem_Gear1InrtEng_C "Massenträgheitsmoment offener Antriebstrang" VALUE 0x8004E5B8 Val_Wr32 20.0000000 ISC_Inirtia_float 0.00 20.0000000 FORMAT "%10.7" EXTENDED_LIMITS -1.00000000E+037 1.00000000E+037 /end CHARACTERISTIC
/begin CHARACTERISTIC HLSDem_Gear1InrtVeh_C "Massenträgheitsmoment gesamtes Fahrzeug, geschlossene Kupplung (eingelegter Gang 1)" VALUE 0x8004E5BC Val_Wr32 20.0000000 ISC_Inirtia_float 0.00 20.0000000 FORMAT "%10.7" EXTENDED_LIMITS -1.00000000E+037 1.00000000E+037 /end CHARACTERISTIC
/begin CHARACTERISTIC HLSDem_Gear1PLo.Kp_C "P-Parametersatz unterer Drehmomentpfad, geschlossene Kupplung (eingelegter Gang 1)/Kleinsignal Verstärkungsfaktor (Kp)" VALUE 0x8004E5C0 Val_Wr32 20.0000000 ISC_Kp_rpm2Nm_float 0.00 20.0000000 FORMAT "%10.7" EXTENDED_LIMITS -1.00000000E+037 1.00000000E+037 /end CHARACTERISTIC
/begin CHARACTERISTIC HLSDem_Gear1PLo.KpPos_C "P-Parametersatz unterer Drehmomentpfad, geschlossene Kupplung (eingelegter Gang 1)/Großsignal Verstärkungsfaktor positiv (Kp)" VALUE 0x8004E5C4 Val_Wr32 20.0000000 ISC_Kp_rpm2Nm_float 0.00 20.0000000 FORMAT "%10.7" EXTENDED_LIMITS -1.00000000E+037 1.00000000E+037 /end CHARACTERISTIC
/begin CHARACTERISTIC HLSDem_Gear1PLo.KpNeg_C "P-Parametersatz unterer Drehmomentpfad, geschlossene Kupplung (eingelegter Gang 1)/Großsignal Verstärkungsfaktor negativ (Kp)" VALUE 0x8004E5C8 Val_Wr32 20.0000000 ISC_Kp_rpm2Nm_float 0.00 20.0000000 FORMAT "%10.7" EXTENDED_LIMITS -1.00000000E+037 1.00000000E+037 /end CHARACTERISTIC
/begin CHARACTERISTIC HLSDem_Gear1PLo.WinPos_C "P-Parametersatz unterer Drehmomentpfad, geschlossene Kupplung (eingelegter Gang 1)/Kleinsignal Fensterbreite positiv" VALUE 0x8004E5CC Val_Wr32 12000.0000 EngN_float -6000.00000 6000.00000 FORMAT "%10.5" EXTENDED_LIMITS -1.00000000E+037 1.00000000E+037 /end CHARACTERISTIC
/begin CHARACTERISTIC HLSDem_Gear1PLo.WinNeg_C "P-Parametersatz unterer Drehmomentpfad, geschlossene Kupplung (eingelegter Gang 1)/Kleinsignal Fensterbreite negativ" VALUE 0x8004E5D0 Val_Wr32 12000.0000 EngN_float -6000.00000 6000.00000 FORMAT "%10.5" EXTENDED_LIMITS -1.00000000E+037 1.00000000E+037 /end CHARACTERISTIC
/begin CHARACTERISTIC HLSDem_Gear1rnEngvVeh_C "Verhältnis Motordrehzahl zu Fahrzeuggeschwindigkeit, geschlosse Kupplung(eingelegter Gang 1)" VALUE 0x8004E5D4 Val_Wr32 1000.00000 ISC_rnEng2vVeh_float 0.00 1000.00000 FORMAT "%10.5" EXTENDED_LIMITS -1.00000000E+037 1.00000000E+037 /end CHARACTERISTIC
/begin CHARACTERISTIC HLSDem_Gear1tiFltLosTrqEst_C "Zeitkonstante für die PT1-Glieder der Lastmomentabschätzung, geschlossene Kupplung (eingelegter Gang 1)" VALUE 0x8004E5D8 Val_Wr32 60.0000000 ISC_tiPTsTrqLoss_float 0.00 60.0000000 FORMAT "%10.7" EXTENDED_LIMITS -1.00000000E+037 1.00000000E+037 /end CHARACTERISTIC
/begin CHARACTERISTIC HLSDem_Gear1tiFltnEng_C "Zeitkonstante für die PT2-Filterung der Motordrehzahl, geschlossene Kupplung (eingelegter Gang 1)" VALUE 0x8004E5DC Val_Wr32 60.0000000 ISC_tiPT2nEng_float 0.00 60.0000000 FORMAT "%10.7" EXTENDED_LIMITS -1.00000000E+037 1.00000000E+037 /end CHARACTERISTIC
/begin CHARACTERISTIC HLSDem_Gear2dnAccLim_C "Obere Grenze der zulässigen Beschleunigung der Motordrehzahl, geschlossene Kupplung (eingelegter Gang 2)" VALUE 0x8004E5E0 Val_Wr32 12000.0000 ISC_dnEng_float 0.00 12000.0000 FORMAT "%10.4" EXTENDED_LIMITS -1.00000000E+037 1.00000000E+037 /end CHARACTERISTIC
/begin CHARACTERISTIC HLSDem_Gear2dnDeclLim_C "Untere Grenze der zulässigen Verzögerung der Motordrehzahl, geschlossene Kupplung (eingelegter Gang 2)" VALUE 0x8004E5E4 Val_Wr32 12000.0000 ISC_dnEng_float -12000.0000 0.00 FORMAT "%10.4" EXTENDED_LIMITS -1.00000000E+037 1.00000000E+037 /end CHARACTERISTIC
/begin CHARACTERISTIC HLSDem_Gear2InrtDrvTrn_C "Massenträgheitsmoment geschlossener Antriebstrang, Kalter Motor (eingelegter Gang 2)" VALUE 0x8004E5E8 Val_Wr32 20.0000000 ISC_Inirtia_float 0.00 20.0000000 FORMAT "%10.7" EXTENDED_LIMITS -1.00000000E+037 1.00000000E+037 /end CHARACTERISTIC
/begin CHARACTERISTIC HLSDem_Gear2InrtEng_C "Massenträgheitsmoment offener Antriebstrang" VALUE 0x8004E5EC Val_Wr32 20.0000000 ISC_Inirtia_float 0.00 20.0000000 FORMAT "%10.7" EXTENDED_LIMITS -1.00000000E+037 1.00000000E+037 /end CHARACTERISTIC
/begin CHARACTERISTIC HLSDem_Gear2InrtVeh_C "Massenträgheitsmoment gesamtes Fahrzeug, geschlossene Kupplung (eingelegter Gang 2)" VALUE 0x8004E5F0 Val_Wr32 20.0000000 ISC_Inirtia_float 0.00 20.0000000 FORMAT "%10.7" EXTENDED_LIMITS -1.00000000E+037 1.00000000E+037 /end CHARACTERISTIC
/begin CHARACTERISTIC HLSDem_Gear2PLo.Kp_C "P-Parametersatz unterer Drehmomentpfad, geschlossene Kupplung (eingelegter Gang 2)/Kleinsignal Verstärkungsfaktor (Kp)" VALUE 0x8004E5F4 Val_Wr32 20.0000000 ISC_Kp_rpm2Nm_float 0.00 20.0000000 FORMAT "%10.7" EXTENDED_LIMITS -1.00000000E+037 1.00000000E+037 /end CHARACTERISTIC
/begin CHARACTERISTIC HLSDem_Gear2PLo.KpPos_C "P-Parametersatz unterer Drehmomentpfad, geschlossene Kupplung (eingelegter Gang 2)/Großsignal Verstärkungsfaktor positiv (Kp)" VALUE 0x8004E5F8 Val_Wr32 20.0000000 ISC_Kp_rpm2Nm_float 0.00 20.0000000 FORMAT "%10.7" EXTENDED_LIMITS -1.00000000E+037 1.00000000E+037 /end CHARACTERISTIC
/begin CHARACTERISTIC HLSDem_Gear2PLo.KpNeg_C "P-Parametersatz unterer Drehmomentpfad, geschlossene Kupplung (eingelegter Gang 2)/Großsignal Verstärkungsfaktor negativ (Kp)" VALUE 0x8004E5FC Val_Wr32 20.0000000 ISC_Kp_rpm2Nm_float 0.00 20.0000000 FORMAT "%10.7" EXTENDED_LIMITS -1.00000000E+037 1.00000000E+037 /end CHARACTERISTIC
/begin CHARACTERISTIC HLSDem_Gear2PLo.WinPos_C "P-Parametersatz unterer Drehmomentpfad, geschlossene Kupplung (eingelegter Gang 2)/Kleinsignal Fensterbreite positiv" VALUE 0x8004E600 Val_Wr32 12000.0000 EngN_float -6000.00000 6000.00000 FORMAT "%10.5" EXTENDED_LIMITS -1.00000000E+037 1.00000000E+037 /end CHARACTERISTIC
/begin CHARACTERISTIC HLSDem_Gear2PLo.WinNeg_C "P-Parametersatz unterer Drehmomentpfad, geschlossene Kupplung (eingelegter Gang 2)/Kleinsignal Fensterbreite negativ" VALUE 0x8004E604 Val_Wr32 12000.0000 EngN_float -6000.00000 6000.00000 FORMAT "%10.5" EXTENDED_LIMITS -1.00000000E+037 1.00000000E+037 /end CHARACTERISTIC
/begin CHARACTERISTIC HLSDem_Gear2rnEngvVeh_C "Verhältnis Motordrehzahl zu Fahrzeuggeschwindigkeit, geschlosse Kupplung(eingelegter Gang 2)" VALUE 0x8004E608 Val_Wr32 1000.00000 ISC_rnEng2vVeh_float 0.00 1000.00000 FORMAT "%10.5" EXTENDED_LIMITS -1.00000000E+037 1.00000000E+037 /end CHARACTERISTIC
/begin CHARACTERISTIC HLSDem_Gear2tiFltLosTrqEst_C "Zeitkonstante für die PT1-Glieder der Lastmomentabschätzung, geschlossene Kupplung (eingelegter Gang 2)" VALUE 0x8004E60C Val_Wr32 60.0000000 ISC_tiPTsTrqLoss_float 0.00 60.0000000 FORMAT "%10.7" EXTENDED_LIMITS -1.00000000E+037 1.00000000E+037 /end CHARACTERISTIC
/begin CHARACTERISTIC HLSDem_Gear2tiFltnEng_C "Zeitkonstante für die PT2-Filterung der Motordrehzahl, geschlossene Kupplung (eingelegter Gang 2)" VALUE 0x8004E610 Val_Wr32 60.0000000 ISC_tiPT2nEng_float 0.00 60.0000000 FORMAT "%10.7" EXTENDED_LIMITS -1.00000000E+037 1.00000000E+037 /end CHARACTERISTIC
/begin CHARACTERISTIC HLSDem_Gear3dnAccLim_C "Obere Grenze der zulässigen Beschleunigung der Motordrehzahl, geschlossene Kupplung (eingelegter Gang 3)" VALUE 0x8004E614 Val_Wr32 12000.0000 ISC_dnEng_float 0.00 12000.0000 FORMAT "%10.4" EXTENDED_LIMITS -1.00000000E+037 1.00000000E+037 /end CHARACTERISTIC
/begin CHARACTERISTIC HLSDem_Gear3dnDeclLim_C "Untere Grenze der zulässigen Verzögerung der Motordrehzahl, geschlossene Kupplung (eingelegter Gang 3)" VALUE 0x8004E618 Val_Wr32 12000.0000 ISC_dnEng_float -12000.0000 0.00 FORMAT "%10.4" EXTENDED_LIMITS -1.00000000E+037 1.00000000E+037 /end CHARACTERISTIC
/begin CHARACTERISTIC HLSDem_Gear3InrtDrvTrn_C "Massenträgheitsmoment geschlossener Antriebstrang, Kalter Motor (eingelegter Gang 3)" VALUE 0x8004E61C Val_Wr32 20.0000000 ISC_Inirtia_float 0.00 20.0000000 FORMAT "%10.7" EXTENDED_LIMITS -1.00000000E+037 1.00000000E+037 /end CHARACTERISTIC
/begin CHARACTERISTIC HLSDem_Gear3InrtEng_C "Massenträgheitsmoment offener Antriebstrang" VALUE 0x8004E620 Val_Wr32 20.0000000 ISC_Inirtia_float 0.00 20.0000000 FORMAT "%10.7" EXTENDED_LIMITS -1.00000000E+037 1.00000000E+037 /end CHARACTERISTIC
/begin CHARACTERISTIC HLSDem_Gear3InrtVeh_C "Massenträgheitsmoment gesamtes Fahrzeug, geschlossene Kupplung (eingelegter Gang 3)" VALUE 0x8004E624 Val_Wr32 20.0000000 ISC_Inirtia_float 0.00 20.0000000 FORMAT "%10.7" EXTENDED_LIMITS -1.00000000E+037 1.00000000E+037 /end CHARACTERISTIC
/begin CHARACTERISTIC HLSDem_Gear3PLo.Kp_C "P-Parametersatz unterer Drehmomentpfad, geschlossene Kupplung (eingelegter Gang 3)/Kleinsignal Verstärkungsfaktor (Kp)" VALUE 0x8004E628 Val_Wr32 20.0000000 ISC_Kp_rpm2Nm_float 0.00 20.0000000 FORMAT "%10.7" EXTENDED_LIMITS -1.00000000E+037 1.00000000E+037 /end CHARACTERISTIC
/begin CHARACTERISTIC HLSDem_Gear3PLo.KpPos_C "P-Parametersatz unterer Drehmomentpfad, geschlossene Kupplung (eingelegter Gang 3)/Großsignal Verstärkungsfaktor positiv (Kp)" VALUE 0x8004E62C Val_Wr32 20.0000000 ISC_Kp_rpm2Nm_float 0.00 20.0000000 FORMAT "%10.7" EXTENDED_LIMITS -1.00000000E+037 1.00000000E+037 /end CHARACTERISTIC
/begin CHARACTERISTIC HLSDem_Gear3PLo.KpNeg_C "P-Parametersatz unterer Drehmomentpfad, geschlossene Kupplung (eingelegter Gang 3)/Großsignal Verstärkungsfaktor negativ (Kp)" VALUE 0x8004E630 Val_Wr32 20.0000000 ISC_Kp_rpm2Nm_float 0.00 20.0000000 FORMAT "%10.7" EXTENDED_LIMITS -1.00000000E+037 1.00000000E+037 /end CHARACTERISTIC
/begin CHARACTERISTIC HLSDem_Gear3PLo.WinPos_C "P-Parametersatz unterer Drehmomentpfad, geschlossene Kupplung (eingelegter Gang 3)/Kleinsignal Fensterbreite positiv" VALUE 0x8004E634 Val_Wr32 12000.0000 EngN_float -6000.00000 6000.00000 FORMAT "%10.5" EXTENDED_LIMITS -1.00000000E+037 1.00000000E+037 /end CHARACTERISTIC
/begin CHARACTERISTIC HLSDem_Gear3PLo.WinNeg_C "P-Parametersatz unterer Drehmomentpfad, geschlossene Kupplung (eingelegter Gang 3)/Kleinsignal Fensterbreite negativ" VALUE 0x8004E638 Val_Wr32 12000.0000 EngN_float -6000.00000 6000.00000 FORMAT "%10.5" EXTENDED_LIMITS -1.00000000E+037 1.00000000E+037 /end CHARACTERISTIC
/begin CHARACTERISTIC HLSDem_Gear3rnEngvVeh_C "Verhältnis Motordrehzahl zu Fahrzeuggeschwindigkeit, geschlosse Kupplung(eingelegter Gang 3)" VALUE 0x8004E63C Val_Wr32 1000.00000 ISC_rnEng2vVeh_float 0.00 1000.00000 FORMAT "%10.5" EXTENDED_LIMITS -1.00000000E+037 1.00000000E+037 /end CHARACTERISTIC
/begin CHARACTERISTIC HLSDem_Gear3tiFltLosTrqEst_C "Zeitkonstante für die PT1-Glieder der Lastmomentabschätzung, geschlossene Kupplung (eingelegter Gang 3)" VALUE 0x8004E640 Val_Wr32 60.0000000 ISC_tiPTsTrqLoss_float 0.00 60.0000000 FORMAT "%10.7" EXTENDED_LIMITS -1.00000000E+037 1.00000000E+037 /end CHARACTERISTIC
/begin CHARACTERISTIC HLSDem_Gear3tiFltnEng_C "Zeitkonstante für die PT2-Filterung der Motordrehzahl, geschlossene Kupplung (eingelegter Gang 3)" VALUE 0x8004E644 Val_Wr32 60.0000000 ISC_tiPT2nEng_float 0.00 60.0000000 FORMAT "%10.7" EXTENDED_LIMITS -1.00000000E+037 1.00000000E+037 /end CHARACTERISTIC
/begin CHARACTERISTIC HLSDem_Gear4dnAccLim_C "Obere Grenze der zulässigen Beschleunigung der Motordrehzahl, geschlossene Kupplung (eingelegter Gang 4)" VALUE 0x8004E648 Val_Wr32 12000.0000 ISC_dnEng_float 0.00 12000.0000 FORMAT "%10.4" EXTENDED_LIMITS -1.00000000E+037 1.00000000E+037 /end CHARACTERISTIC
/begin CHARACTERISTIC HLSDem_Gear4dnDeclLim_C "Untere Grenze der zulässigen Verzögerung der Motordrehzahl, geschlossene Kupplung (eingelegter Gang 4)" VALUE 0x8004E64C Val_Wr32 12000.0000 ISC_dnEng_float -12000.0000 0.00 FORMAT "%10.4" EXTENDED_LIMITS -1.00000000E+037 1.00000000E+037 /end CHARACTERISTIC
/begin CHARACTERISTIC HLSDem_Gear4InrtDrvTrn_C "Massenträgheitsmoment geschlossener Antriebstrang, Kalter Motor (eingelegter Gang 4)" VALUE 0x8004E650 Val_Wr32 20.0000000 ISC_Inirtia_float 0.00 20.0000000 FORMAT "%10.7" EXTENDED_LIMITS -1.00000000E+037 1.00000000E+037 /end CHARACTERISTIC
/begin CHARACTERISTIC HLSDem_Gear4InrtEng_C "Massenträgheitsmoment offener Antriebstrang" VALUE 0x8004E654 Val_Wr32 20.0000000 ISC_Inirtia_float 0.00 20.0000000 FORMAT "%10.7" EXTENDED_LIMITS -1.00000000E+037 1.00000000E+037 /end CHARACTERISTIC
/begin CHARACTERISTIC HLSDem_Gear4InrtVeh_C "Massenträgheitsmoment gesamtes Fahrzeug, geschlossene Kupplung (eingelegter Gang 4)" VALUE 0x8004E658 Val_Wr32 20.0000000 ISC_Inirtia_float 0.00 20.0000000 FORMAT "%10.7" EXTENDED_LIMITS -1.00000000E+037 1.00000000E+037 /end CHARACTERISTIC
/begin CHARACTERISTIC HLSDem_Gear4PLo.Kp_C "P-Parametersatz unterer Drehmomentpfad, geschlossene Kupplung (eingelegter Gang 4)/Kleinsignal Verstärkungsfaktor (Kp)" VALUE 0x8004E65C Val_Wr32 20.0000000 ISC_Kp_rpm2Nm_float 0.00 20.0000000 FORMAT "%10.7" EXTENDED_LIMITS -1.00000000E+037 1.00000000E+037 /end CHARACTERISTIC
/begin CHARACTERISTIC HLSDem_Gear4PLo.KpPos_C "P-Parametersatz unterer Drehmomentpfad, geschlossene Kupplung (eingelegter Gang 4)/Großsignal Verstärkungsfaktor positiv (Kp)" VALUE 0x8004E660 Val_Wr32 20.0000000 ISC_Kp_rpm2Nm_float 0.00 20.0000000 FORMAT "%10.7" EXTENDED_LIMITS -1.00000000E+037 1.00000000E+037 /end CHARACTERISTIC
/begin CHARACTERISTIC HLSDem_Gear4PLo.KpNeg_C "P-Parametersatz unterer Drehmomentpfad, geschlossene Kupplung (eingelegter Gang 4)/Großsignal Verstärkungsfaktor negativ (Kp)" VALUE 0x8004E664 Val_Wr32 20.0000000 ISC_Kp_rpm2Nm_float 0.00 20.0000000 FORMAT "%10.7" EXTENDED_LIMITS -1.00000000E+037 1.00000000E+037 /end CHARACTERISTIC
/begin CHARACTERISTIC HLSDem_Gear4PLo.WinPos_C "P-Parametersatz unterer Drehmomentpfad, geschlossene Kupplung (eingelegter Gang 4)/Kleinsignal Fensterbreite positiv" VALUE 0x8004E668 Val_Wr32 12000.0000 EngN_float -6000.00000 6000.00000 FORMAT "%10.5" EXTENDED_LIMITS -1.00000000E+037 1.00000000E+037 /end CHARACTERISTIC
/begin CHARACTERISTIC HLSDem_Gear4PLo.WinNeg_C "P-Parametersatz unterer Drehmomentpfad, geschlossene Kupplung (eingelegter Gang 4)/Kleinsignal Fensterbreite negativ" VALUE 0x8004E66C Val_Wr32 12000.0000 EngN_float -6000.00000 6000.00000 FORMAT "%10.5" EXTENDED_LIMITS -1.00000000E+037 1.00000000E+037 /end CHARACTERISTIC
/begin CHARACTERISTIC HLSDem_Gear4rnEngvVeh_C "Verhältnis Motordrehzahl zu Fahrzeuggeschwindigkeit, geschlosse Kupplung(eingelegter Gang 4)" VALUE 0x8004E670 Val_Wr32 1000.00000 ISC_rnEng2vVeh_float 0.00 1000.00000 FORMAT "%10.5" EXTENDED_LIMITS -1.00000000E+037 1.00000000E+037 /end CHARACTERISTIC
/begin CHARACTERISTIC HLSDem_Gear4tiFltLosTrqEst_C "Zeitkonstante für die PT1-Glieder der Lastmomentabschätzung, geschlossene Kupplung (eingelegter Gang 4)" VALUE 0x8004E674 Val_Wr32 60.0000000 ISC_tiPTsTrqLoss_float 0.00 60.0000000 FORMAT "%10.7" EXTENDED_LIMITS -1.00000000E+037 1.00000000E+037 /end CHARACTERISTIC
/begin CHARACTERISTIC HLSDem_Gear4tiFltnEng_C "Zeitkonstante für die PT2-Filterung der Motordrehzahl, geschlossene Kupplung (eingelegter Gang 4)" VALUE 0x8004E678 Val_Wr32 60.0000000 ISC_tiPT2nEng_float 0.00 60.0000000 FORMAT "%10.7" EXTENDED_LIMITS -1.00000000E+037 1.00000000E+037 /end CHARACTERISTIC
/begin CHARACTERISTIC HLSDem_Gear5dnAccLim_C "Obere Grenze der zulässigen Beschleunigung der Motordrehzahl, geschlossene Kupplung (eingelegter Gang 5)" VALUE 0x8004E67C Val_Wr32 12000.0000 ISC_dnEng_float 0.00 12000.0000 FORMAT "%10.4" EXTENDED_LIMITS -1.00000000E+037 1.00000000E+037 /end CHARACTERISTIC
/begin CHARACTERISTIC HLSDem_Gear5dnDeclLim_C "Untere Grenze der zulässigen Verzögerung der Motordrehzahl, geschlossene Kupplung (eingelegter Gang 5)" VALUE 0x8004E680 Val_Wr32 12000.0000 ISC_dnEng_float -12000.0000 0.00 FORMAT "%10.4" EXTENDED_LIMITS -1.00000000E+037 1.00000000E+037 /end CHARACTERISTIC
/begin CHARACTERISTIC HLSDem_Gear5InrtDrvTrn_C "Massenträgheitsmoment geschlossener Antriebstrang, Kalter Motor (eingelegter Gang 5)" VALUE 0x8004E684 Val_Wr32 20.0000000 ISC_Inirtia_float 0.00 20.0000000 FORMAT "%10.7" EXTENDED_LIMITS -1.00000000E+037 1.00000000E+037 /end CHARACTERISTIC
/begin CHARACTERISTIC HLSDem_Gear5InrtEng_C "Massenträgheitsmoment offener Antriebstrang" VALUE 0x8004E688 Val_Wr32 20.0000000 ISC_Inirtia_float 0.00 20.0000000 FORMAT "%10.7" EXTENDED_LIMITS -1.00000000E+037 1.00000000E+037 /end CHARACTERISTIC
/begin CHARACTERISTIC HLSDem_Gear5InrtVeh_C "Massenträgheitsmoment gesamtes Fahrzeug, geschlossene Kupplung (eingelegter Gang 5)" VALUE 0x8004E68C Val_Wr32 20.0000000 ISC_Inirtia_float 0.00 20.0000000 FORMAT "%10.7" EXTENDED_LIMITS -1.00000000E+037 1.00000000E+037 /end CHARACTERISTIC
/begin CHARACTERISTIC HLSDem_Gear5PLo.Kp_C "P-Parametersatz unterer Drehmomentpfad, geschlossene Kupplung (eingelegter Gang 5)/Kleinsignal Verstärkungsfaktor (Kp)" VALUE 0x8004E690 Val_Wr32 20.0000000 ISC_Kp_rpm2Nm_float 0.00 20.0000000 FORMAT "%10.7" EXTENDED_LIMITS -1.00000000E+037 1.00000000E+037 /end CHARACTERISTIC
/begin CHARACTERISTIC HLSDem_Gear5PLo.KpPos_C "P-Parametersatz unterer Drehmomentpfad, geschlossene Kupplung (eingelegter Gang 5)/Großsignal Verstärkungsfaktor positiv (Kp)" VALUE 0x8004E694 Val_Wr32 20.0000000 ISC_Kp_rpm2Nm_float 0.00 20.0000000 FORMAT "%10.7" EXTENDED_LIMITS -1.00000000E+037 1.00000000E+037 /end CHARACTERISTIC
/begin CHARACTERISTIC HLSDem_Gear5PLo.KpNeg_C "P-Parametersatz unterer Drehmomentpfad, geschlossene Kupplung (eingelegter Gang 5)/Großsignal Verstärkungsfaktor negativ (Kp)" VALUE 0x8004E698 Val_Wr32 20.0000000 ISC_Kp_rpm2Nm_float 0.00 20.0000000 FORMAT "%10.7" EXTENDED_LIMITS -1.00000000E+037 1.00000000E+037 /end CHARACTERISTIC
/begin CHARACTERISTIC HLSDem_Gear5PLo.WinPos_C "P-Parametersatz unterer Drehmomentpfad, geschlossene Kupplung (eingelegter Gang 5)/Kleinsignal Fensterbreite positiv" VALUE 0x8004E69C Val_Wr32 12000.0000 EngN_float -6000.00000 6000.00000 FORMAT "%10.5" EXTENDED_LIMITS -1.00000000E+037 1.00000000E+037 /end CHARACTERISTIC
/begin CHARACTERISTIC HLSDem_Gear5PLo.WinNeg_C "P-Parametersatz unterer Drehmomentpfad, geschlossene Kupplung (eingelegter Gang 5)/Kleinsignal Fensterbreite negativ" VALUE 0x8004E6A0 Val_Wr32 12000.0000 EngN_float -6000.00000 6000.00000 FORMAT "%10.5" EXTENDED_LIMITS -1.00000000E+037 1.00000000E+037 /end CHARACTERISTIC
/begin CHARACTERISTIC HLSDem_Gear5rnEngvVeh_C "Verhältnis Motordrehzahl zu Fahrzeuggeschwindigkeit, geschlosse Kupplung(eingelegter Gang 5)" VALUE 0x8004E6A4 Val_Wr32 1000.00000 ISC_rnEng2vVeh_float 0.00 1000.00000 FORMAT "%10.5" EXTENDED_LIMITS -1.00000000E+037 1.00000000E+037 /end CHARACTERISTIC
/begin CHARACTERISTIC HLSDem_Gear5tiFltLosTrqEst_C "Zeitkonstante für die PT1-Glieder der Lastmomentabschätzung, geschlossene Kupplung (eingelegter Gang 5)" VALUE 0x8004E6A8 Val_Wr32 60.0000000 ISC_tiPTsTrqLoss_float 0.00 60.0000000 FORMAT "%10.7" EXTENDED_LIMITS -1.00000000E+037 1.00000000E+037 /end CHARACTERISTIC
/begin CHARACTERISTIC HLSDem_Gear5tiFltnEng_C "Zeitkonstante für die PT2-Filterung der Motordrehzahl, geschlossene Kupplung (eingelegter Gang 5)" VALUE 0x8004E6AC Val_Wr32 60.0000000 ISC_tiPT2nEng_float 0.00 60.0000000 FORMAT "%10.7" EXTENDED_LIMITS -1.00000000E+037 1.00000000E+037 /end CHARACTERISTIC
/begin CHARACTERISTIC HLSDem_Gear6dnAccLim_C "Obere Grenze der zulässigen Beschleunigung der Motordrehzahl, geschlossene Kupplung (eingelegter Gang 6)" VALUE 0x8004E6B0 Val_Wr32 12000.0000 ISC_dnEng_float 0.00 12000.0000 FORMAT "%10.4" EXTENDED_LIMITS -1.00000000E+037 1.00000000E+037 /end CHARACTERISTIC
/begin CHARACTERISTIC HLSDem_Gear6dnDeclLim_C "Untere Grenze der zulässigen Verzögerung der Motordrehzahl, geschlossene Kupplung (eingelegter Gang 6)" VALUE 0x8004E6B4 Val_Wr32 12000.0000 ISC_dnEng_float -12000.0000 0.00 FORMAT "%10.4" EXTENDED_LIMITS -1.00000000E+037 1.00000000E+037 /end CHARACTERISTIC
/begin CHARACTERISTIC HLSDem_Gear6InrtDrvTrn_C "Massenträgheitsmoment geschlossener Antriebstrang, Kalter Motor (eingelegter Gang 6)" VALUE 0x8004E6B8 Val_Wr32 20.0000000 ISC_Inirtia_float 0.00 20.0000000 FORMAT "%10.7" EXTENDED_LIMITS -1.00000000E+037 1.00000000E+037 /end CHARACTERISTIC
/begin CHARACTERISTIC HLSDem_Gear6InrtEng_C "Massenträgheitsmoment offener Antriebstrang" VALUE 0x8004E6BC Val_Wr32 20.0000000 ISC_Inirtia_float 0.00 20.0000000 FORMAT "%10.7" EXTENDED_LIMITS -1.00000000E+037 1.00000000E+037 /end CHARACTERISTIC
/begin CHARACTERISTIC HLSDem_Gear6InrtVeh_C "Massenträgheitsmoment gesamtes Fahrzeug, geschlossene Kupplung (eingelegter Gang 6)" VALUE 0x8004E6C0 Val_Wr32 20.0000000 ISC_Inirtia_float 0.00 20.0000000 FORMAT "%10.7" EXTENDED_LIMITS -1.00000000E+037 1.00000000E+037 /end CHARACTERISTIC
/begin CHARACTERISTIC HLSDem_Gear6PLo.Kp_C "P-Parametersatz unterer Drehmomentpfad, geschlossene Kupplung (eingelegter Gang 6)/Kleinsignal Verstärkungsfaktor (Kp)" VALUE 0x8004E6C4 Val_Wr32 20.0000000 ISC_Kp_rpm2Nm_float 0.00 20.0000000 FORMAT "%10.7" EXTENDED_LIMITS -1.00000000E+037 1.00000000E+037 /end CHARACTERISTIC
/begin CHARACTERISTIC HLSDem_Gear6PLo.KpPos_C "P-Parametersatz unterer Drehmomentpfad, geschlossene Kupplung (eingelegter Gang 6)/Großsignal Verstärkungsfaktor positiv (Kp)" VALUE 0x8004E6C8 Val_Wr32 20.0000000 ISC_Kp_rpm2Nm_float 0.00 20.0000000 FORMAT "%10.7" EXTENDED_LIMITS -1.00000000E+037 1.00000000E+037 /end CHARACTERISTIC
/begin CHARACTERISTIC HLSDem_Gear6PLo.KpNeg_C "P-Parametersatz unterer Drehmomentpfad, geschlossene Kupplung (eingelegter Gang 6)/Großsignal Verstärkungsfaktor negativ (Kp)" VALUE 0x8004E6CC Val_Wr32 20.0000000 ISC_Kp_rpm2Nm_float 0.00 20.0000000 FORMAT "%10.7" EXTENDED_LIMITS -1.00000000E+037 1.00000000E+037 /end CHARACTERISTIC
/begin CHARACTERISTIC HLSDem_Gear6PLo.WinPos_C "P-Parametersatz unterer Drehmomentpfad, geschlossene Kupplung (eingelegter Gang 6)/Kleinsignal Fensterbreite positiv" VALUE 0x8004E6D0 Val_Wr32 12000.0000 EngN_float -6000.00000 6000.00000 FORMAT "%10.5" EXTENDED_LIMITS -1.00000000E+037 1.00000000E+037 /end CHARACTERISTIC
/begin CHARACTERISTIC HLSDem_Gear6PLo.WinNeg_C "P-Parametersatz unterer Drehmomentpfad, geschlossene Kupplung (eingelegter Gang 6)/Kleinsignal Fensterbreite negativ" VALUE 0x8004E6D4 Val_Wr32 12000.0000 EngN_float -6000.00000 6000.00000 FORMAT "%10.5" EXTENDED_LIMITS -1.00000000E+037 1.00000000E+037 /end CHARACTERISTIC
/begin CHARACTERISTIC HLSDem_Gear6rnEngvVeh_C "Verhältnis Motordrehzahl zu Fahrzeuggeschwindigkeit, geschlosse Kupplung(eingelegter Gang 6)" VALUE 0x8004E6D8 Val_Wr32 1000.00000 ISC_rnEng2vVeh_float 0.00 1000.00000 FORMAT "%10.5" EXTENDED_LIMITS -1.00000000E+037 1.00000000E+037 /end CHARACTERISTIC
/begin CHARACTERISTIC HLSDem_Gear6tiFltLosTrqEst_C "Zeitkonstante für die PT1-Glieder der Lastmomentabschätzung, geschlossene Kupplung (eingelegter Gang 6)" VALUE 0x8004E6DC Val_Wr32 60.0000000 ISC_tiPTsTrqLoss_float 0.00 60.0000000 FORMAT "%10.7" EXTENDED_LIMITS -1.00000000E+037 1.00000000E+037 /end CHARACTERISTIC
/begin CHARACTERISTIC HLSDem_Gear6tiFltnEng_C "Zeitkonstante für die PT2-Filterung der Motordrehzahl, geschlossene Kupplung (eingelegter Gang 6)" VALUE 0x8004E6E0 Val_Wr32 60.0000000 ISC_tiPT2nEng_float 0.00 60.0000000 FORMAT "%10.7" EXTENDED_LIMITS -1.00000000E+037 1.00000000E+037 /end CHARACTERISTIC
/begin CHARACTERISTIC HLSDem_Gear7dnAccLim_C "Obere Grenze der zulässigen Beschleunigung der Motordrehzahl, geschlossene Kupplung (eingelegter Gang 7)" VALUE 0x8004E6E4 Val_Wr32 12000.0000 ISC_dnEng_float 0.00 12000.0000 FORMAT "%10.4" EXTENDED_LIMITS -1.00000000E+037 1.00000000E+037 /end CHARACTERISTIC
/begin CHARACTERISTIC HLSDem_Gear7dnDeclLim_C "Untere Grenze der zulässigen Verzögerung der Motordrehzahl, geschlossene Kupplung (eingelegter Gang 7)" VALUE 0x8004E6E8 Val_Wr32 12000.0000 ISC_dnEng_float -12000.0000 0.00 FORMAT "%10.4" EXTENDED_LIMITS -1.00000000E+037 1.00000000E+037 /end CHARACTERISTIC
/begin CHARACTERISTIC HLSDem_Gear7InrtDrvTrn_C "Massenträgheitsmoment geschlossener Antriebstrang, Kalter Motor (eingelegter Gang 7)" VALUE 0x8004E6EC Val_Wr32 20.0000000 ISC_Inirtia_float 0.00 20.0000000 FORMAT "%10.7" EXTENDED_LIMITS -1.00000000E+037 1.00000000E+037 /end CHARACTERISTIC
/begin CHARACTERISTIC HLSDem_Gear7InrtEng_C "Massenträgheitsmoment offener Antriebstrang" VALUE 0x8004E6F0 Val_Wr32 20.0000000 ISC_Inirtia_float 0.00 20.0000000 FORMAT "%10.7" EXTENDED_LIMITS -1.00000000E+037 1.00000000E+037 /end CHARACTERISTIC
/begin CHARACTERISTIC HLSDem_Gear7InrtVeh_C "Massenträgheitsmoment gesamtes Fahrzeug, geschlossene Kupplung (eingelegter Gang 7)" VALUE 0x8004E6F4 Val_Wr32 20.0000000 ISC_Inirtia_float 0.00 20.0000000 FORMAT "%10.7" EXTENDED_LIMITS -1.00000000E+037 1.00000000E+037 /end CHARACTERISTIC
/begin CHARACTERISTIC HLSDem_Gear7PLo.Kp_C "P-Parametersatz unterer Drehmomentpfad, geschlossene Kupplung (eingelegter Gang 7)/Kleinsignal Verstärkungsfaktor (Kp)" VALUE 0x8004E6F8 Val_Wr32 20.0000000 ISC_Kp_rpm2Nm_float 0.00 20.0000000 FORMAT "%10.7" EXTENDED_LIMITS -1.00000000E+037 1.00000000E+037 /end CHARACTERISTIC
/begin CHARACTERISTIC HLSDem_Gear7PLo.KpPos_C "P-Parametersatz unterer Drehmomentpfad, geschlossene Kupplung (eingelegter Gang 7)/Großsignal Verstärkungsfaktor positiv (Kp)" VALUE 0x8004E6FC Val_Wr32 20.0000000 ISC_Kp_rpm2Nm_float 0.00 20.0000000 FORMAT "%10.7" EXTENDED_LIMITS -1.00000000E+037 1.00000000E+037 /end CHARACTERISTIC
/begin CHARACTERISTIC HLSDem_Gear7PLo.KpNeg_C "P-Parametersatz unterer Drehmomentpfad, geschlossene Kupplung (eingelegter Gang 7)/Großsignal Verstärkungsfaktor negativ (Kp)" VALUE 0x8004E700 Val_Wr32 20.0000000 ISC_Kp_rpm2Nm_float 0.00 20.0000000 FORMAT "%10.7" EXTENDED_LIMITS -1.00000000E+037 1.00000000E+037 /end CHARACTERISTIC
/begin CHARACTERISTIC HLSDem_Gear7PLo.WinPos_C "P-Parametersatz unterer Drehmomentpfad, geschlossene Kupplung (eingelegter Gang 7)/Kleinsignal Fensterbreite positiv" VALUE 0x8004E704 Val_Wr32 12000.0000 EngN_float -6000.00000 6000.00000 FORMAT "%10.5" EXTENDED_LIMITS -1.00000000E+037 1.00000000E+037 /end CHARACTERISTIC
/begin CHARACTERISTIC HLSDem_Gear7PLo.WinNeg_C "P-Parametersatz unterer Drehmomentpfad, geschlossene Kupplung (eingelegter Gang 7)/Kleinsignal Fensterbreite negativ" VALUE 0x8004E708 Val_Wr32 12000.0000 EngN_float -6000.00000 6000.00000 FORMAT "%10.5" EXTENDED_LIMITS -1.00000000E+037 1.00000000E+037 /end CHARACTERISTIC
/begin CHARACTERISTIC HLSDem_Gear7rnEngvVeh_C "Verhältnis Motordrehzahl zu Fahrzeuggeschwindigkeit, geschlosse Kupplung(eingelegter Gang 6)" VALUE 0x8004E70C Val_Wr32 1000.00000 ISC_rnEng2vVeh_float 0.00 1000.00000 FORMAT "%10.5" EXTENDED_LIMITS -1.00000000E+037 1.00000000E+037 /end CHARACTERISTIC
/begin CHARACTERISTIC HLSDem_Gear7tiFltLosTrqEst_C "Zeitkonstante für die PT1-Glieder der Lastmomentabschätzung, geschlossene Kupplung (eingelegter Gang 7)" VALUE 0x8004E710 Val_Wr32 60.0000000 ISC_tiPTsTrqLoss_float 0.00 60.0000000 FORMAT "%10.7" EXTENDED_LIMITS -1.00000000E+037 1.00000000E+037 /end CHARACTERISTIC
/begin CHARACTERISTIC HLSDem_Gear7tiFltnEng_C "Zeitkonstante für die PT2-Filterung der Motordrehzahl, geschlossene Kupplung (eingelegter Gang 7)" VALUE 0x8004E714 Val_Wr32 60.0000000 ISC_tiPT2nEng_float 0.00 60.0000000 FORMAT "%10.7" EXTENDED_LIMITS -1.00000000E+037 1.00000000E+037 /end CHARACTERISTIC
/begin CHARACTERISTIC HLSDem_GearILo.Ki_C "I-Parametersatz unterer Drehmomentpfad, geschlossene Kupplung/Kleinsignal Verstärkungsfaktor (Ki)" VALUE 0x8004E718 Val_Wr32 20.0000000 ISC_Ki_rpm2Nm_float 0.00 20.0000000 FORMAT "%10.7" EXTENDED_LIMITS -1.00000000E+037 1.00000000E+037 /end CHARACTERISTIC
/begin CHARACTERISTIC HLSDem_GearILo.KiPos_C "I-Parametersatz unterer Drehmomentpfad, geschlossene Kupplung/Großsignal Verstärkungsfaktor positiv (Ki)" VALUE 0x8004E71C Val_Wr32 20.0000000 ISC_Ki_rpm2Nm_float 0.00 20.0000000 FORMAT "%10.7" EXTENDED_LIMITS -1.00000000E+037 1.00000000E+037 /end CHARACTERISTIC
/begin CHARACTERISTIC HLSDem_GearILo.KiNeg_C "I-Parametersatz unterer Drehmomentpfad, geschlossene Kupplung/Großsignal Verstärkungsfaktor negativ (Ki)" VALUE 0x8004E720 Val_Wr32 20.0000000 ISC_Ki_rpm2Nm_float 0.00 20.0000000 FORMAT "%10.7" EXTENDED_LIMITS -1.00000000E+037 1.00000000E+037 /end CHARACTERISTIC
/begin CHARACTERISTIC HLSDem_GearILo.WinPos_C "I-Parametersatz unterer Drehmomentpfad, geschlossene Kupplung/Kleinsignal Fensterbreite positiv" VALUE 0x8004E724 Val_Wr32 12000.0000 EngN_float -6000.00000 6000.00000 FORMAT "%10.5" EXTENDED_LIMITS -1.00000000E+037 1.00000000E+037 /end CHARACTERISTIC
/begin CHARACTERISTIC HLSDem_GearILo.WinNeg_C "I-Parametersatz unterer Drehmomentpfad, geschlossene Kupplung/Kleinsignal Fensterbreite negativ" VALUE 0x8004E728 Val_Wr32 12000.0000 EngN_float -6000.00000 6000.00000 FORMAT "%10.5" EXTENDED_LIMITS -1.00000000E+037 1.00000000E+037 /end CHARACTERISTIC
/begin CHARACTERISTIC HLSDem_nDeltaSec_C "" VALUE 0x8004E79C Kw_Ws16 16383.50 EngN 0.00 16383.50 FORMAT "%8.2" EXTENDED_LIMITS -16384.00 16383.50 /end CHARACTERISTIC
/begin CHARACTERISTIC HLSDem_nDiffDelta_C "" VALUE 0x8004E79E Kw_Ws16 16383.50 EngN 0.00 16383.50 FORMAT "%8.2" EXTENDED_LIMITS -16384.00 16383.50 /end CHARACTERISTIC
/begin CHARACTERISTIC HLSDem_nHDC_C "" VALUE 0x8004E7A0 Kw_Ws16 16383.50 EngN 0.00 16383.50 FORMAT "%8.2" EXTENDED_LIMITS -16384.00 16383.50 /end CHARACTERISTIC
/begin CHARACTERISTIC HLSDem_nLimHiOfs_C "" VALUE 0x8004E7A2 Kw_Ws16 32767.50 EngN -16384.00 16383.50 FORMAT "%8.2" /end CHARACTERISTIC
/begin CHARACTERISTIC HLSDem_nLimHiTrmAct_C "" VALUE 0x8004E7A4 Kw_Ws16 32767.50 EngN -16384.00 16383.50 FORMAT "%8.2" /end CHARACTERISTIC
/begin CHARACTERISTIC HLSDem_nLimHi_C "" VALUE 0x8004E7A6 Kw_Ws16 32767.50 EngN -16384.00 16383.50 FORMAT "%8.2" /end CHARACTERISTIC
/begin CHARACTERISTIC HLSDem_nOfsUndrBrk_C "Drehzahloffset für die Erkennung des HLSDem-Zustand ""Unterbremsen""" VALUE 0x8004E72C Val_Ws16 6000.000 EngN 0.00 6000.000 FORMAT "%8.3" EXTENDED_LIMITS -16384.00 16383.50 /end CHARACTERISTIC
/begin CHARACTERISTIC HLSDem_nRmpBaseDwn_C "" VALUE 0x8004E7A8 Kw_Ws16 16383.50 dn_dZfine 0.00 16383.50 FORMAT "%8.2" EXTENDED_LIMITS -16384.00 16383.50 /end CHARACTERISTIC
/begin CHARACTERISTIC HLSDem_nRmpBaseUp_C "" VALUE 0x8004E7AA Kw_Ws16 16383.50 dn_dZfine 0.00 16383.50 FORMAT "%8.2" EXTENDED_LIMITS -16384.00 16383.50 /end CHARACTERISTIC
/begin CHARACTERISTIC HLSDem_nRmpChrgPmpDwn_C "" VALUE 0x8004E7AC Kw_Ws16 16383.50 dn_dZfine 0.00 16383.50 FORMAT "%8.2" EXTENDED_LIMITS -16384.00 16383.50 /end CHARACTERISTIC
/begin CHARACTERISTIC HLSDem_nRmpChrgPmpUp_C "" VALUE 0x8004E7AE Kw_Ws16 16383.50 dn_dZfine 0.00 16383.50 FORMAT "%8.2" EXTENDED_LIMITS -16384.00 16383.50 /end CHARACTERISTIC
/begin CHARACTERISTIC HLSDem_nRmpCoEngDwn_C "" VALUE 0x8004E7B0 Kw_Ws16 16383.50 dn_dZfine 0.00 16383.50 FORMAT "%8.2" EXTENDED_LIMITS -16384.00 16383.50 /end CHARACTERISTIC
/begin CHARACTERISTIC HLSDem_nRmpCoEngUp_C "" VALUE 0x8004E7B2 Kw_Ws16 16383.50 dn_dZfine 0.00 16383.50 FORMAT "%8.2" EXTENDED_LIMITS -16384.00 16383.50 /end CHARACTERISTIC
/begin CHARACTERISTIC HLSDem_nRmpHDCDwn_C "" VALUE 0x8004E7B4 Kw_Ws16 16383.50 dn_dZfine 0.00 16383.50 FORMAT "%8.2" EXTENDED_LIMITS -16384.00 16383.50 /end CHARACTERISTIC
/begin CHARACTERISTIC HLSDem_nRmpHDCUp_C "" VALUE 0x8004E7B6 Kw_Ws16 16383.50 dn_dZfine 0.00 16383.50 FORMAT "%8.2" EXTENDED_LIMITS -16384.00 16383.50 /end CHARACTERISTIC
/begin CHARACTERISTIC HLSDem_nRmpPwrMngDwn_C "" VALUE 0x8004E7B8 Kw_Ws16 16383.50 dn_dZfine 0.00 16383.50 FORMAT "%8.2" EXTENDED_LIMITS -16384.00 16383.50 /end CHARACTERISTIC
/begin CHARACTERISTIC HLSDem_nRmpPwrMngUp_C "" VALUE 0x8004E7BA Kw_Ws16 16383.50 dn_dZfine 0.00 16383.50 FORMAT "%8.2" EXTENDED_LIMITS -16384.00 16383.50 /end CHARACTERISTIC
/begin CHARACTERISTIC HLSDem_nRmpSecDelta_C "" VALUE 0x8004E7BC Kw_Ws16 16383.50 dn_dZfine 0.00 16383.50 FORMAT "%8.2" EXTENDED_LIMITS -16384.00 16383.50 /end CHARACTERISTIC
/begin CHARACTERISTIC HLSDem_nSetPHi_MAP "Kennfeld für die Höchstdrehzahl" MAP 0x8004E7BE Map_Xs16Ys16Ws16 6000.000 EngN 0.00 6000.000 FORMAT "%8.3" EXTENDED_LIMITS -16384.00 16383.50
 /begin AXIS_DESCR STD_AXIS PT_rTrq TransR 8 -327.6800 327.6700 FORMAT "%8.4" DEPOSIT ABSOLUTE /end AXIS_DESCR
 /begin AXIS_DESCR STD_AXIS HLSDem_tSetPHi_mp Temp_Cels 8 -3549.940 3003.560 FORMAT "%8.3" DEPOSIT ABSOLUTE /end AXIS_DESCR
/end CHARACTERISTIC
/begin CHARACTERISTIC HLSDem_nSetPLoDia_C "unterer Solldrehzahlwert des HLSDem über Diagnoseschnittstelle" VALUE 0x8004E862 Kw_Ws16 16383.50 EngN 0.00 16383.50 FORMAT "%8.2" EXTENDED_LIMITS -16384.00 16383.50 /end CHARACTERISTIC
/begin CHARACTERISTIC HLSDem_nSetPLoDrvAwy_C "untere Leerlaufsolldrehzahl für Fahrzeug fährt (Veh_v > 0)" VALUE 0x8004E864 Kw_Ws16 32767.50 EngN -16384.00 16383.50 FORMAT "%8.2" /end CHARACTERISTIC
/begin CHARACTERISTIC HLSDem_nSetPLoInit2_MAP "" MAP 0x8004E866 Kf_Xs16_Ys16_Ws16 6000.000 EngN 0.00 6000.000 FORMAT "%8.3" EXTENDED_LIMITS -16384.00 16383.50
 /begin AXIS_DESCR STD_AXIS CEngDsT_t Temp_Cels 4 -273.1400 149.8600 FORMAT "%8.4" EXTENDED_LIMITS -3549.940 3003.560 DEPOSIT ABSOLUTE /end AXIS_DESCR
 /begin AXIS_DESCR STD_AXIS EnvP_p Pres_hPa 4 0.00 3500.0000 FORMAT "%8.4" EXTENDED_LIMITS -32768.00 32767.00 DEPOSIT ABSOLUTE /end AXIS_DESCR
/end CHARACTERISTIC
/begin CHARACTERISTIC HLSDem_nSetPLoInit_MAP "" MAP 0x8004E89A Kf_Xs16_Ys16_Ws16 6000.000 EngN 0.00 6000.000 FORMAT "%8.3" EXTENDED_LIMITS -16384.00 16383.50
 /begin AXIS_DESCR STD_AXIS CEngDsT_t Temp_Cels 4 -273.1400 149.8600 FORMAT "%8.4" EXTENDED_LIMITS -3549.940 3003.560 DEPOSIT ABSOLUTE /end AXIS_DESCR
 /begin AXIS_DESCR STD_AXIS EnvP_p Pres_hPa 4 0.00 3500.0000 FORMAT "%8.4" EXTENDED_LIMITS -32768.00 32767.00 DEPOSIT ABSOLUTE /end AXIS_DESCR
/end CHARACTERISTIC
/begin CHARACTERISTIC HLSDem_nSetPLoTrmLim_C "" VALUE 0x8004E8CE Kw_Ws16 32767.50 EngN -16384.00 16383.50 FORMAT "%8.2" /end CHARACTERISTIC
/begin CHARACTERISTIC HLSDem_nSetPLoTrm_C "" VALUE 0x8004E8D0 Kw_Ws16 32767.50 EngN -16384.00 16383.50 FORMAT "%8.2" /end CHARACTERISTIC
/begin CHARACTERISTIC HLSDem_nSetPLoWrm_C "untere Leerlaufsolldrehzahl für Fahrzeug steht / warmer Motor" VALUE 0x8004E8D2 Kw_Ws16 32767.50 EngN -16384.00 16383.50 FORMAT "%8.2" /end CHARACTERISTIC
/begin CHARACTERISTIC HLSDem_numCfgISC_C "Konfiguration der 1) Aufschaltstrategie des ISC-Pfads 2) Initialisierunganforderung bei Sollwertänderung" VALUE 0x8004E72E Val_Wu8 3.000 OneToOne 0.00 3.000 FORMAT "%5.3" EXTENDED_LIMITS 0.00 255.0 /end CHARACTERISTIC
/begin CHARACTERISTIC HLSDem_numTempSetPHi_C "Temperaturauswahl für die Berechnung der oberen Motorhöchstdrehzahl" VALUE 0x8004E8D4 Val_Wu8 2.00000000000 EngTempFldSel 0.00 2.00000000000 FORMAT "%13.11" /end CHARACTERISTIC
/begin CHARACTERISTIC HLSDem_numTempTrqReqStrt_C "Temperaturauswahl für die Berechnung des Startdrehmoments am Ausgang des EISGov" VALUE 0x8004E8D5 Val_Wu8 2.00000000000 EngTempFldSel 0.00 2.00000000000 FORMAT "%13.11" /end CHARACTERISTIC
/begin CHARACTERISTIC HLSDem_numTemp_C "Temperaturauswahl für die Ermittlung vom Motorzustand ""warm/kalt""" VALUE 0x8004E72F Val_Wu8 2.00000000000 EngTempFldSel 0.00 2.00000000000 FORMAT "%13.11" /end CHARACTERISTIC
/begin CHARACTERISTIC HLSDem_RmpCutOut.SlopePos_C "/Positive Rampenschrittweite" VALUE 0x8004E8D8 Val_Ws32 6000.00000000 RmpEngN 0.00 6000.00000000 FORMAT "%13.8" EXTENDED_LIMITS -16384000.0000 16383999.9924 /end CHARACTERISTIC
/begin CHARACTERISTIC HLSDem_RmpCutOut.SlopeNeg_C "/Negative Rampenschrittweite" VALUE 0x8004E8DC Val_Ws32 6000.00000000 RmpEngN 0.00 6000.00000000 FORMAT "%13.8" EXTENDED_LIMITS -16384000.0000 16383999.9924 /end CHARACTERISTIC
/begin CHARACTERISTIC HLSDem_SetPHiRmp.SlopePos_C "Rampenschrittweite der oberen Maximaldrehzahl/Positive Rampenschrittweite" VALUE 0x8004E8E0 Val_Ws32 6000.00000000 RmpEngN 0.00 6000.00000000 FORMAT "%13.8" EXTENDED_LIMITS -16384000.0000 16383999.9924 /end CHARACTERISTIC
/begin CHARACTERISTIC HLSDem_SetPHiRmp.SlopeNeg_C "Rampenschrittweite der oberen Maximaldrehzahl/Negative Rampenschrittweite" VALUE 0x8004E8E4 Val_Ws32 6000.00000000 RmpEngN 0.00 6000.00000000 FORMAT "%13.8" EXTENDED_LIMITS -16384000.0000 16383999.9924 /end CHARACTERISTIC
/begin CHARACTERISTIC HLSDem_stActvHDC_C "" VALUE 0x8004E8E8 Kw_Wu8 3.000 OneToOne 0.00 3.000 FORMAT "%5.3" EXTENDED_LIMITS 0.00 255.0 /end CHARACTERISTIC
/begin CHARACTERISTIC HLSDem_stParSetRevGear_C "wählt Parametersatz für den Rückwärtsgang (1 = Parametersatz Gang 1, 2 = Parametersatz Gang 2)" VALUE 0x8004E730 Val_Ws16 1.000000 OneToOne 1.000000 2.000000 FORMAT "%8.6" EXTENDED_LIMITS -32768.00 32767.00 /end CHARACTERISTIC
/begin CHARACTERISTIC HLSDem_stRlsHDC_C "" VALUE 0x8004E8E9 Kw_Wu8 127.0 OneToOne 0.00 127.0 FORMAT "%5.1" EXTENDED_LIMITS 0.00 255.0 /end CHARACTERISTIC
/begin CHARACTERISTIC HLSDem_swtDisblVehIfc_C "" VALUE 0x8004E8EA Val_Ws16 65535.00 OneToOne -32768.00 32767.00 FORMAT "%8.2" /end CHARACTERISTIC
/begin CHARACTERISTIC HLSDem_swtGear_C "" VALUE 0x8004E8EC Kw_Wu8 255.0 OneToOne 0.00 255.0 FORMAT "%5.1" /end CHARACTERISTIC
/begin CHARACTERISTIC HLSDem_tiDelCutOut_C "" VALUE 0x8004E8EE Kw_Wu16 2000.000 Time_ms 0.00 2000.000 FORMAT "%8.3" EXTENDED_LIMITS 0.00 655350.0 /end CHARACTERISTIC
/begin CHARACTERISTIC HLSDem_tiTW_C "" VALUE 0x8004E8F0 Kw_Wu16 655.3500 Time_s 0.00 655.3500 FORMAT "%8.4" /end CHARACTERISTIC
/begin CHARACTERISTIC HLSDem_trqInitI_MAP "" MAP 0x8004E8F2 Kf_Xs16_Ys16_Ws16 400.0000 Trq 0.00 400.0000 FORMAT "%8.4" EXTENDED_LIMITS -3276.800 3276.700
 /begin AXIS_DESCR STD_AXIS CEngDsT_t Temp_Cels 4 -273.1400 199.9600 FORMAT "%8.4" EXTENDED_LIMITS -3549.940 3003.560 DEPOSIT ABSOLUTE /end AXIS_DESCR
 /begin AXIS_DESCR STD_AXIS EnvP_p Pres_hPa 4 0.00 3500.000 FORMAT "%8.3" EXTENDED_LIMITS -32768.00 32767.00 DEPOSIT ABSOLUTE /end AXIS_DESCR
/end CHARACTERISTIC
/begin CHARACTERISTIC HLSDem_trqLoLimMin_C "minimales HLSDem Begrenzungsdrehmoment an den ISC" VALUE 0x8004E732 Val_Ws16 2000.000 Trq -1000.000 1000.000 FORMAT "%8.3" EXTENDED_LIMITS -3276.800 3276.700 /end CHARACTERISTIC
/begin CHARACTERISTIC HLSDem_trqReqStrt_CUR "Kennlinie zur Festlegung der Drehmoment-Initialisierungs-Anforderung an den EISGov bis Startabwurf" CURVE 0x8004E926 Cur_Xs16Ws16 400.0000 Trq 0.00 400.0000 FORMAT "%8.4" EXTENDED_LIMITS -3276.800 3276.700
 /begin AXIS_DESCR STD_AXIS HLSDem_tTrqReqStrt_mp Temp_Cels 25 -3549.940 3003.560 FORMAT "%8.3" DEPOSIT ABSOLUTE /end AXIS_DESCR
/end CHARACTERISTIC
/begin CHARACTERISTIC HLSDem_tTempHysHi_C "obere Temperaturschwelle für die Hysterese zur Zustandsbestimmung ""warm/kalt""" VALUE 0x8004E734 Val_Ws16 200.0000 Temp_Cels -50.14000 149.8600 FORMAT "%8.4" EXTENDED_LIMITS -3549.940 3003.560 /end CHARACTERISTIC
/begin CHARACTERISTIC HLSDem_tTempHysLo_C "untere Temperaturschwelle für die Hysterese zur Zustandsbestimmung ""warm/kalt""" VALUE 0x8004E736 Val_Ws16 200.0000 Temp_Cels -50.14000 149.8600 FORMAT "%8.4" EXTENDED_LIMITS -3549.940 3003.560 /end CHARACTERISTIC
/begin CHARACTERISTIC HLSDem_UndrBrkPLo.Kp_C "P-Parametersatz unterer Drehmomentpfad, Zustand ""Unterbremsen""/Kleinsignal Verstärkungsfaktor (Kp)" VALUE 0x8004E738 Val_Wr32 20.0000000 ISC_Kp_rpm2Nm_float 0.00 20.0000000 FORMAT "%10.7" EXTENDED_LIMITS -1.00000000E+037 1.00000000E+037 /end CHARACTERISTIC
/begin CHARACTERISTIC HLSDem_UndrBrkPLo.KpPos_C "P-Parametersatz unterer Drehmomentpfad, Zustand ""Unterbremsen""/Großsignal Verstärkungsfaktor positiv (Kp)" VALUE 0x8004E73C Val_Wr32 20.0000000 ISC_Kp_rpm2Nm_float 0.00 20.0000000 FORMAT "%10.7" EXTENDED_LIMITS -1.00000000E+037 1.00000000E+037 /end CHARACTERISTIC
/begin CHARACTERISTIC HLSDem_UndrBrkPLo.KpNeg_C "P-Parametersatz unterer Drehmomentpfad, Zustand ""Unterbremsen""/Großsignal Verstärkungsfaktor negativ (Kp)" VALUE 0x8004E740 Val_Wr32 20.0000000 ISC_Kp_rpm2Nm_float 0.00 20.0000000 FORMAT "%10.7" EXTENDED_LIMITS -1.00000000E+037 1.00000000E+037 /end CHARACTERISTIC
/begin CHARACTERISTIC HLSDem_UndrBrkPLo.WinPos_C "P-Parametersatz unterer Drehmomentpfad, Zustand ""Unterbremsen""/Kleinsignal Fensterbreite positiv" VALUE 0x8004E744 Val_Wr32 12000.0000 EngN_float -6000.00000 6000.00000 FORMAT "%10.5" EXTENDED_LIMITS -1.00000000E+037 1.00000000E+037 /end CHARACTERISTIC
/begin CHARACTERISTIC HLSDem_UndrBrkPLo.WinNeg_C "P-Parametersatz unterer Drehmomentpfad, Zustand ""Unterbremsen""/Kleinsignal Fensterbreite negativ" VALUE 0x8004E748 Val_Wr32 12000.0000 EngN_float -6000.00000 6000.00000 FORMAT "%10.5" EXTENDED_LIMITS -1.00000000E+037 1.00000000E+037 /end CHARACTERISTIC
/begin CHARACTERISTIC HLSDem_vThresUndrBrk_C "Schwellgeschwindigkeit für HLSDem Zustand ""Unterbremsen""" VALUE 0x8004E74C Val_Ws16 327.6700 Vel 0.00 327.6700 FORMAT "%8.4" EXTENDED_LIMITS -327.6800 327.6700 /end CHARACTERISTIC
/begin CHARACTERISTIC HLSDem_WrmClthdnAccLim_C "Obere Grenze der zulässigen Beschleunigung der Motordrehzahl, warmer Motor, offene Kupplung" VALUE 0x8004E750 Val_Wr32 12000.0000 ISC_dnEng_float 0.00 12000.0000 FORMAT "%10.4" EXTENDED_LIMITS -1.00000000E+037 1.00000000E+037 /end CHARACTERISTIC
/begin CHARACTERISTIC HLSDem_WrmClthdnDeclLim_C "Untere Grenze der zulässigen Verzögerung der Motordrehzahl, warmer Motor, offene Kupplung" VALUE 0x8004E754 Val_Wr32 12000.0000 ISC_dnEng_float -12000.0000 0.00 FORMAT "%10.4" EXTENDED_LIMITS -1.00000000E+037 1.00000000E+037 /end CHARACTERISTIC
/begin CHARACTERISTIC HLSDem_WrmClthILo.Ki_C "I-Parametersatz unterer Drehmomentpfad, warmer Motor und geöffnete Kupplung/Kleinsignal Verstärkungsfaktor (Ki)" VALUE 0x8004E758 Val_Wr32 20.0000000 ISC_Ki_rpm2Nm_float 0.00 20.0000000 FORMAT "%10.7" EXTENDED_LIMITS -1.00000000E+037 1.00000000E+037 /end CHARACTERISTIC
/begin CHARACTERISTIC HLSDem_WrmClthILo.KiPos_C "I-Parametersatz unterer Drehmomentpfad, warmer Motor und geöffnete Kupplung/Großsignal Verstärkungsfaktor positiv (Ki)" VALUE 0x8004E75C Val_Wr32 20.0000000 ISC_Ki_rpm2Nm_float 0.00 20.0000000 FORMAT "%10.7" EXTENDED_LIMITS -1.00000000E+037 1.00000000E+037 /end CHARACTERISTIC
/begin CHARACTERISTIC HLSDem_WrmClthILo.KiNeg_C "I-Parametersatz unterer Drehmomentpfad, warmer Motor und geöffnete Kupplung/Großsignal Verstärkungsfaktor negativ (Ki)" VALUE 0x8004E760 Val_Wr32 20.0000000 ISC_Ki_rpm2Nm_float 0.00 20.0000000 FORMAT "%10.7" EXTENDED_LIMITS -1.00000000E+037 1.00000000E+037 /end CHARACTERISTIC
/begin CHARACTERISTIC HLSDem_WrmClthILo.WinPos_C "I-Parametersatz unterer Drehmomentpfad, warmer Motor und geöffnete Kupplung/Kleinsignal Fensterbreite positiv" VALUE 0x8004E764 Val_Wr32 12000.0000 EngN_float -6000.00000 6000.00000 FORMAT "%10.5" EXTENDED_LIMITS -1.00000000E+037 1.00000000E+037 /end CHARACTERISTIC
/begin CHARACTERISTIC HLSDem_WrmClthILo.WinNeg_C "I-Parametersatz unterer Drehmomentpfad, warmer Motor und geöffnete Kupplung/Kleinsignal Fensterbreite negativ" VALUE 0x8004E768 Val_Wr32 12000.0000 EngN_float -6000.00000 6000.00000 FORMAT "%10.5" EXTENDED_LIMITS -1.00000000E+037 1.00000000E+037 /end CHARACTERISTIC
/begin CHARACTERISTIC HLSDem_WrmClthInrtDrvTrn_C "Massenträgheitsmoment offener Antriebstrang" VALUE 0x8004E76C Val_Wr32 20.0000000 ISC_Inirtia_float 0.00 20.0000000 FORMAT "%10.7" EXTENDED_LIMITS -1.00000000E+037 1.00000000E+037 /end CHARACTERISTIC
/begin CHARACTERISTIC HLSDem_WrmClthInrtEng_C "Massenträgheitsmoment offener Antriebstrang, warmer Motor" VALUE 0x8004E770 Val_Wr32 20.0000000 ISC_Inirtia_float 0.00 20.0000000 FORMAT "%10.7" EXTENDED_LIMITS -1.00000000E+037 1.00000000E+037 /end CHARACTERISTIC
/begin CHARACTERISTIC HLSDem_WrmClthInrtVeh_C "Massenträgheitsmoment offener Antriebstrang, warmer Motor" VALUE 0x8004E774 Val_Wr32 20.0000000 ISC_Inirtia_float 0.00 20.0000000 FORMAT "%10.7" EXTENDED_LIMITS -1.00000000E+037 1.00000000E+037 /end CHARACTERISTIC
/begin CHARACTERISTIC HLSDem_WrmClthPLo.Kp_C "P-Parametersatz unterer Drehmomentpfad, warmer Motor und geöffnete Kupplung/Kleinsignal Verstärkungsfaktor (Kp)" VALUE 0x8004E778 Val_Wr32 20.0000000 ISC_Kp_rpm2Nm_float 0.00 20.0000000 FORMAT "%10.7" EXTENDED_LIMITS -1.00000000E+037 1.00000000E+037 /end CHARACTERISTIC
/begin CHARACTERISTIC HLSDem_WrmClthPLo.KpPos_C "P-Parametersatz unterer Drehmomentpfad, warmer Motor und geöffnete Kupplung/Großsignal Verstärkungsfaktor positiv (Kp)" VALUE 0x8004E77C Val_Wr32 20.0000000 ISC_Kp_rpm2Nm_float 0.00 20.0000000 FORMAT "%10.7" EXTENDED_LIMITS -1.00000000E+037 1.00000000E+037 /end CHARACTERISTIC
/begin CHARACTERISTIC HLSDem_WrmClthPLo.KpNeg_C "P-Parametersatz unterer Drehmomentpfad, warmer Motor und geöffnete Kupplung/Großsignal Verstärkungsfaktor negativ (Kp)" VALUE 0x8004E780 Val_Wr32 20.0000000 ISC_Kp_rpm2Nm_float 0.00 20.0000000 FORMAT "%10.7" EXTENDED_LIMITS -1.00000000E+037 1.00000000E+037 /end CHARACTERISTIC
/begin CHARACTERISTIC HLSDem_WrmClthPLo.WinPos_C "P-Parametersatz unterer Drehmomentpfad, warmer Motor und geöffnete Kupplung/Kleinsignal Fensterbreite positiv" VALUE 0x8004E784 Val_Wr32 12000.0000 EngN_float -6000.00000 6000.00000 FORMAT "%10.5" EXTENDED_LIMITS -1.00000000E+037 1.00000000E+037 /end CHARACTERISTIC
/begin CHARACTERISTIC HLSDem_WrmClthPLo.WinNeg_C "P-Parametersatz unterer Drehmomentpfad, warmer Motor und geöffnete Kupplung/Kleinsignal Fensterbreite negativ" VALUE 0x8004E788 Val_Wr32 12000.0000 EngN_float -6000.00000 6000.00000 FORMAT "%10.5" EXTENDED_LIMITS -1.00000000E+037 1.00000000E+037 /end CHARACTERISTIC
/begin CHARACTERISTIC HLSDem_WrmClthrnEngvVeh_C "Verhältnis Motordrehzahl zu Fahrzeuggeschwindigkeit, warmer Motor (offene Kupplung)" VALUE 0x8004E78C Val_Wr32 1000.00000 ISC_rnEng2vVeh_float 0.00 1000.00000 FORMAT "%10.5" EXTENDED_LIMITS -1.00000000E+037 1.00000000E+037 /end CHARACTERISTIC
/begin CHARACTERISTIC HLSDem_WrmClthtiFltLosTrqEst_C "Zeitkonstante für die PT1-Glieder der Lastmomentabschätzung, warmer Motor, offene Kupplung" VALUE 0x8004E790 Val_Wr32 60.0000000 ISC_tiPTsTrqLoss_float 0.00 60.0000000 FORMAT "%10.7" EXTENDED_LIMITS -1.00000000E+037 1.00000000E+037 /end CHARACTERISTIC
/begin CHARACTERISTIC HLSDem_WrmClthtiFltnEng_C "Zeitkonstante für die PT2-Filterung der Motordrehzahl, warmer Motor, Offene Kupplung" VALUE 0x8004E794 Val_Wr32 60.0000000 ISC_tiPT2nEng_float 0.00 60.0000000 FORMAT "%10.7" EXTENDED_LIMITS -1.00000000E+037 1.00000000E+037 /end CHARACTERISTIC
/begin CHARACTERISTIC HPUn_dvolMeUnMax_C "maximales Fördervolumen durch die Zumesseinheit" VALUE 0x8004E98C Val_Ws16 50000.00 Qp_mm3_sec 0.00 50000.00 FORMAT "%8.2" EXTENDED_LIMITS -327680.0 327670.0 /end CHARACTERISTIC
/begin CHARACTERISTIC HPUn_etaPmpFlTemp_CUR "Kraftstofftemperaturabhängiger Wirkungsgrad der Hochdruckpumpe" CURVE 0x8004E98E Cur_Xs16Ws16 0.9921875 Eta1 0.007812500 1.000000 FORMAT "%8.6" EXTENDED_LIMITS -256.0000 255.9922
 /begin AXIS_DESCR STD_AXIS FuelT_tFlSys Temp_Cels 6 -50.14000 149.8600 FORMAT "%8.4" EXTENDED_LIMITS -3549.940 3003.560 DEPOSIT ABSOLUTE /end AXIS_DESCR
/end CHARACTERISTIC
/begin CHARACTERISTIC HPUn_etaPmpMaxAged_CUR "Maximaler Wirkungsgrad einer gealterten Hochdruckpumpe" CURVE 0x8004E9A8 Cur_Xs16Ws16 0.9921875 Eta1 0.007812500 1.000000 FORMAT "%8.6" EXTENDED_LIMITS -256.0000 255.9922
 /begin AXIS_DESCR STD_AXIS Epm_nEng EngN 6 0.00 6000.000 FORMAT "%8.3" EXTENDED_LIMITS -16384.00 16383.50 DEPOSIT ABSOLUTE /end AXIS_DESCR
/end CHARACTERISTIC
/begin CHARACTERISTIC HPUn_etaPmpMech_C "mechanischer Wirkungsgrad der Hochdruckpumpe" VALUE 0x8004E9C2 Val_Ws16 0.9921875 Eta1 0.007812500 1.000000 FORMAT "%8.6" EXTENDED_LIMITS -256.0000 255.9922 /end CHARACTERISTIC
/begin CHARACTERISTIC HPUn_nMin_C "Drehzahlschwelle zur Abschaltung der Lastmomentberechnung der Hochdruckpumpe" VALUE 0x8004E9C4 Val_Ws16 6000.000 EngN 0.00 6000.000 FORMAT "%8.3" EXTENDED_LIMITS -16384.00 16383.50 /end CHARACTERISTIC
/begin CHARACTERISTIC HPUn_numInjMin_C "Minimal von der Hochdruckpumpe erlaubte Anzahl an Einspritzungen" VALUE 0x8004EC30 Val_Wu8 6.000 OneToOne 0.00 6.000 FORMAT "%5.3" EXTENDED_LIMITS 0.00 255.0 /end CHARACTERISTIC
/begin CHARACTERISTIC HPUn_pRailDvtOk_C "Maximale Raildruck Regelabweichung für die Mengenbilanzprüfung" VALUE 0x8004EC32 Val_Wu16 2000.000 Pres_Rail 0.00 2000.000 FORMAT "%5.3" EXTENDED_LIMITS 0.00 6553.500 /end CHARACTERISTIC
/begin CHARACTERISTIC HPUn_qBalLim_CUR "Begrenzungsmenge auf Grund der Mengenbilanz der Hochdruckpumpe" CURVE 0x8004E9C6 Cur_Xs16Ws16 327.6700 InjMass 0.00 327.6700 FORMAT "%8.4" EXTENDED_LIMITS -327.6800 327.6700
 /begin AXIS_DESCR STD_AXIS Epm_nEng EngN 8 0.00 6000.000 FORMAT "%8.3" EXTENDED_LIMITS -16384.00 16383.50 DEPOSIT ABSOLUTE /end AXIS_DESCR
/end CHARACTERISTIC
/begin CHARACTERISTIC HPUn_qFlTempLim_MAP "Kennfeld für Begrenzungsmenge abhängig der Kraftstofftemperatur" MAP 0x8004E9E8 Map_Xs16Ys16Ws16 327.6700 InjMass 0.00 327.6700 FORMAT "%8.4" EXTENDED_LIMITS -327.6800 327.6700
 /begin AXIS_DESCR STD_AXIS Epm_nEng EngN 16 0.00 6000.000 FORMAT "%8.3" EXTENDED_LIMITS -16384.00 16383.50 DEPOSIT ABSOLUTE /end AXIS_DESCR
 /begin AXIS_DESCR STD_AXIS FuelT_t Temp_Cels 16 -50.14000 149.8600 FORMAT "%8.4" EXTENDED_LIMITS -3549.940 3003.560 DEPOSIT ABSOLUTE /end AXIS_DESCR
/end CHARACTERISTIC
/begin CHARACTERISTIC HPUn_rTransCrS_C "Übersetzung Hochdruckpumpe zu Kurbelwelle" VALUE 0x8004EC2C Val_Ws16 10.00000 TransR 0.00 10.00000 FORMAT "%8.5" EXTENDED_LIMITS -327.6800 327.6700 /end CHARACTERISTIC
/begin CHARACTERISTIC HPUn_tiPresDvtFlt_C "PT1 Zeitkonstante zur Filterung der Raildruck Regelabweichung" VALUE 0x8004EC34 Val_Ws32 4294.9672940 TimeDelay_s 0.000002000000001 4294.9672960 FORMAT "%12.7" /end CHARACTERISTIC
/begin CHARACTERISTIC HPUn_tiQntBalDel_C "Verzögerungszeit zur Berechnung der Mengenbilanz der Hochdruckpumpe" VALUE 0x8004EC38 Val_Ws16 327670.0 Time_ms 0.00 327670.0 FORMAT "%8.1" EXTENDED_LIMITS -327680.0 327670.0 /end CHARACTERISTIC
/begin CHARACTERISTIC HPUn_volPmp_C "geometrisches Fördervolumen der Hochdruckpumpe pro Pumpenumdrehung" VALUE 0x8004EC2E Val_Ws16 1500.000 PmpQnt 0.00 1500.000 FORMAT "%8.3" EXTENDED_LIMITS -3276.800 3276.700 /end CHARACTERISTIC
/begin CHARACTERISTIC I15031_PID1C_C "OBD Anforderungen für welches das Fahrzeug ausgelegt ist" VALUE 0x8004EC3C Val_Wu16 12.0000000000 I15031_PID1CVerb 1.00000000000 13.0000000000 FORMAT "%13.10" /end CHARACTERISTIC
/begin CHARACTERISTIC I15031_PID1D_C "Ort der Lambda Sonden" VALUE 0x8004EC3E Val_Wu8 7.00000000000 I15031_PID1DVerb 0.00 7.00000000000 FORMAT "%13.11" /end CHARACTERISTIC
/begin CHARACTERISTIC I15031_PID4FA_C "Konfigurationsinformation des externen Testgeräts. Maximaler Wert des Gleichgewichtsverhältinisses" VALUE 0x8004EC3F Val_Wu8 255.0 OneToOne 0.00 255.0 FORMAT "%5.1" /end CHARACTERISTIC
/begin CHARACTERISTIC I15031_PID4FB_C "Konfigurationsinformation des externen Testgeräts. Maximaler Wert der Lambda Sensorspannung" VALUE 0x8004EC40 Val_Wu8 255.0 OneToOne 0.00 255.0 FORMAT "%5.1" /end CHARACTERISTIC
/begin CHARACTERISTIC I15031_PID4FC_C "Konfigurationsinformation des externen Testgeräts. Maximaler Wert des Lambda Sensorstromes" VALUE 0x8004EC41 Val_Wu8 255.0 OneToOne 0.00 255.0 FORMAT "%5.1" /end CHARACTERISTIC
/begin CHARACTERISTIC I15031_srv9PIDTable.PID0_C "Gruppe der konfigurierbaren unterstützten PID's/Unterstützte PIDs" VALUE 0x8004EC42 Val_Wu8 255.0 OneToOne 0.00 255.0 FORMAT "%5.1" /end CHARACTERISTIC
/begin CHARACTERISTIC I15031_srv9PIDTable.PID1_C "Gruppe der konfigurierbaren unterstützten PID's/Anzahl der Botschaften für VIN" VALUE 0x8004EC43 Val_Wu8 255.0 OneToOne 0.00 255.0 FORMAT "%5.1" /end CHARACTERISTIC
/begin CHARACTERISTIC I15031_srv9PIDTable.PID2_C "Gruppe der konfigurierbaren unterstützten PID's/VIN" VALUE 0x8004EC44 Val_Wu8 255.0 OneToOne 0.00 255.0 FORMAT "%5.1" /end CHARACTERISTIC
/begin CHARACTERISTIC I15031_srv9PIDTable.PID3_C "Gruppe der konfigurierbaren unterstützten PID's/Anzahl der Botschaften für CID" VALUE 0x8004EC45 Val_Wu8 255.0 OneToOne 0.00 255.0 FORMAT "%5.1" /end CHARACTERISTIC
/begin CHARACTERISTIC I15031_srv9PIDTable.PID4_C "Gruppe der konfigurierbaren unterstützten PID's/CID" VALUE 0x8004EC46 Val_Wu8 255.0 OneToOne 0.00 255.0 FORMAT "%5.1" /end CHARACTERISTIC
/begin CHARACTERISTIC I15031_srv9PIDTable.PID5_C "Gruppe der konfigurierbaren unterstützten PID's/Anzahl der Botschaften für CVN" VALUE 0x8004EC47 Val_Wu8 255.0 OneToOne 0.00 255.0 FORMAT "%5.1" /end CHARACTERISTIC
/begin CHARACTERISTIC I15031_srv9PIDTable.PID6_C "Gruppe der konfigurierbaren unterstützten PID's/CVN" VALUE 0x8004EC48 Val_Wu8 255.0 OneToOne 0.00 255.0 FORMAT "%5.1" /end CHARACTERISTIC
/begin CHARACTERISTIC I15031_srv9PIDTable.PID7_C "Gruppe der konfigurierbaren unterstützten PID's/Anzahl der Botschaften für IUMPR" VALUE 0x8004EC49 Val_Wu8 255.0 OneToOne 0.00 255.0 FORMAT "%5.1" /end CHARACTERISTIC
/begin CHARACTERISTIC I15031_srv9PIDTable.PID8_C "Gruppe der konfigurierbaren unterstützten PID's/IUMPR" VALUE 0x8004EC4A Val_Wu8 255.0 OneToOne 0.00 255.0 FORMAT "%5.1" /end CHARACTERISTIC
/begin CHARACTERISTIC I15031_stSrv02SuppPid_CA "Unterstützte PIDs für Mode$02" VAL_BLK 0x8007A22C ValA_Wu8 255.0 OneToOne 0.00 255.0 FORMAT "%5.1" NUMBER 20 /end CHARACTERISTIC
/begin CHARACTERISTIC InjCrv_numInjMaxSys_C "Systembedingte maximal erlaubte Anzahl an Einspritzungen" VALUE 0x8004F2E8 Val_Wu8 6.000 OneToOne 0.00 6.000 FORMAT "%5.3" EXTENDED_LIMITS 0.00 255.0 /end CHARACTERISTIC
/begin CHARACTERISTIC InjCrv_numInjRtmLim_CUR "Kennlinie für die Begrenzung der Anzahl der Einspritzungen in Abhängigkeit der Drehzahl" CURVE 0x8004F2EA Cur_Xs16Ws16 4.000000 OneToOne 1.000000 5.000000 FORMAT "%8.6" EXTENDED_LIMITS -32768.00 32767.00
 /begin AXIS_DESCR STD_AXIS Epm_nEng EngN 8 0.00 6000.000 FORMAT "%8.3" EXTENDED_LIMITS -16384.00 16383.50 DEPOSIT ABSOLUTE /end AXIS_DESCR
/end CHARACTERISTIC
/begin CHARACTERISTIC InjCrv_PiIDblCorMap.xVal_C "Bitmaske für Aktivierung des Freigabekennfelds im Regenerationsbetrieb/" VALUE 0x8004F30C Kw_Wu8 1.000 OneToOne 0.00 1.000 FORMAT "%5.3" EXTENDED_LIMITS 0.00 255.0 /end CHARACTERISTIC
/begin CHARACTERISTIC InjCrv_PiIDblCorMap.xTyp_C "Bitmaske für Aktivierung des Freigabekennfelds im Regenerationsbetrieb/" VALUE 0x8004F30D Kw_Wu8 0.00 OneToOne 2.000 2.000 FORMAT "%5.3" EXTENDED_LIMITS 0.00 255.0 /end CHARACTERISTIC
/begin CHARACTERISTIC InjCrv_rPiIRlsEngSpdHys_C "Drehzahl Hystereseschwelle für die Auswahl der Freigabestruktur der Voreinspritzungen" VALUE 0x8004F30E Val_Ws16 50.00000 Prc 0.00 50.00000 FORMAT "%8.5" EXTENDED_LIMITS -400.0000 399.9878 /end CHARACTERISTIC
/begin CHARACTERISTIC InjCrv_rPiIRlsQntHys_C "Mengen-Hystereseschwelle zur Auswahl der Freigabestruktur der Voreinspritzungen" VALUE 0x8004F310 Val_Ws16 50.00000 Prc 0.00 50.00000 FORMAT "%8.5" EXTENDED_LIMITS -400.0000 399.9878 /end CHARACTERISTIC
/begin CHARACTERISTIC InjCrv_rRtmLimEngSpdHys_C "Drehzahl-Hystereseschwelle zur Begrenzung der Anzahl der Einspritzungen bei hohen Drehzahlen" VALUE 0x8004F312 Val_Ws16 50.00000 Prc 0.00 50.00000 FORMAT "%8.5" EXTENDED_LIMITS -400.0000 399.9878 /end CHARACTERISTIC
/begin CHARACTERISTIC InjCrv_stInjCharPrioRgn_C "Prioritätsstatus für die Abschaltung der Voreinspritzungen im Regenerationsbetrieb" VALUE 0x8004F314 Val_Wu32 4294967295.00 OneToOne 0.00 4294967295.00 FORMAT "%13.2" /end CHARACTERISTIC
/begin CHARACTERISTIC InjCrv_stInjCharPrio_C "Prioritätsstatus für die Abschaltung der Voreinspritzungen" VALUE 0x8004F318 Val_Wu32 4294967295.00 OneToOne 0.00 4294967295.00 FORMAT "%13.2" /end CHARACTERISTIC
/begin CHARACTERISTIC InjCrv_stMI1RgnMsk_CA "Bitmaske für die Freigabe der einzelnen Regenerationsstufen" VAL_BLK 0x8004F31C ValA_Wu32 4294967295.00 OneToOne 0.00 4294967295.00 FORMAT "%13.2" NUMBER 2 /end CHARACTERISTIC
/begin CHARACTERISTIC InjCrv_stMI1RmpSel_CA "Matrix für die Faktorisierungskennlinien der Umschaltrampe für MI1" MAP 0x8004F324 Map_Xu8Yu8Wu8 1.000 OneToOne 1.000 2.000 FORMAT "%5.3" EXTENDED_LIMITS 0.00 255.0
 /begin AXIS_DESCR STD_AXIS InjCrv_stActValMI1_mp OneToOne 3 0.00 2.000 FORMAT "%5.3" EXTENDED_LIMITS 0.00 255.0 DEPOSIT ABSOLUTE /end AXIS_DESCR
 /begin AXIS_DESCR STD_AXIS InjCrv_stDesValMI1_mp OneToOne 3 0.00 2.000 FORMAT "%5.3" EXTENDED_LIMITS 0.00 255.0 DEPOSIT ABSOLUTE /end AXIS_DESCR
/end CHARACTERISTIC
/begin CHARACTERISTIC InjCrv_stPiI1RgnMsk_CA "Bitmaske für die Freigabe der einzelnen Regenerationsstufen" VAL_BLK 0x8004F338 ValA_Wu32 4294967295.00 OneToOne 0.00 4294967295.00 FORMAT "%13.2" NUMBER 2 /end CHARACTERISTIC
/begin CHARACTERISTIC InjCrv_stPiI1RmpSel_CA "Matrix für die Faktorisierungskennlinien der Umschaltrampe für PiI1" MAP 0x8004F340 Map_Xu8Yu8Wu8 1.000 OneToOne 1.000 2.000 FORMAT "%5.3" EXTENDED_LIMITS 0.00 255.0
 /begin AXIS_DESCR STD_AXIS InjCrv_stActValPiI1_mp OneToOne 3 0.00 2.000 FORMAT "%5.3" EXTENDED_LIMITS 0.00 255.0 DEPOSIT ABSOLUTE /end AXIS_DESCR
 /begin AXIS_DESCR STD_AXIS InjCrv_stDesValPiI1_mp OneToOne 3 0.00 2.000 FORMAT "%5.3" EXTENDED_LIMITS 0.00 255.0 DEPOSIT ABSOLUTE /end AXIS_DESCR
/end CHARACTERISTIC
/begin CHARACTERISTIC InjCrv_stPiI2RgnMsk_CA "Bitmaske für die Freigabe der einzelnen Regenerationsstufen" VAL_BLK 0x8004F354 ValA_Wu32 4294967295.00 OneToOne 0.00 4294967295.00 FORMAT "%13.2" NUMBER 2 /end CHARACTERISTIC
/begin CHARACTERISTIC InjCrv_stPiI2RmpSel_CA "Matrix für die Faktorisierungskennlinien der Umschaltrampe für PiI2" MAP 0x8004F35C Map_Xu8Yu8Wu8 1.000 OneToOne 1.000 2.000 FORMAT "%5.3" EXTENDED_LIMITS 0.00 255.0
 /begin AXIS_DESCR STD_AXIS InjCrv_stActValPiI2_mp OneToOne 3 0.00 2.000 FORMAT "%5.3" EXTENDED_LIMITS 0.00 255.0 DEPOSIT ABSOLUTE /end AXIS_DESCR
 /begin AXIS_DESCR STD_AXIS InjCrv_stDesValPiI2_mp OneToOne 3 0.00 2.000 FORMAT "%5.3" EXTENDED_LIMITS 0.00 255.0 DEPOSIT ABSOLUTE /end AXIS_DESCR
/end CHARACTERISTIC
/begin CHARACTERISTIC InjCrv_stPiI3RgnMsk_CA "Bitmaske für die Freigabe der einzelnen Regenerationsstufen" VAL_BLK 0x8004F370 ValA_Wu32 4294967295.00 OneToOne 0.00 4294967295.00 FORMAT "%13.2" NUMBER 2 /end CHARACTERISTIC
/begin CHARACTERISTIC InjCrv_stPiIRlsOpRng1_MAP "Freigabekennfeld im Betriebsbereich 1" MAP 0x8004F378 Map_Xs16Ys16Ws16 4.000000 OneToOne 1.000000 5.000000 FORMAT "%8.6" EXTENDED_LIMITS -32768.00 32767.00
 /begin AXIS_DESCR STD_AXIS Epm_nEng EngN 8 0.00 6000.000 FORMAT "%8.3" EXTENDED_LIMITS -16384.00 16383.50 DEPOSIT ABSOLUTE /end AXIS_DESCR
 /begin AXIS_DESCR STD_AXIS InjCtl_qSetUnBal InjMass 8 0.00 327.6700 FORMAT "%8.4" EXTENDED_LIMITS -327.6800 327.6700 DEPOSIT ABSOLUTE /end AXIS_DESCR
/end CHARACTERISTIC
/begin CHARACTERISTIC InjCrv_stPiIRlsOpRng2_MAP "Freigabekennfeld im Betriebsbereich 2" MAP 0x8004F41C Map_Xs16Ys16Ws16 4.000000 OneToOne 1.000000 5.000000 FORMAT "%8.6" EXTENDED_LIMITS -32768.00 32767.00
 /begin AXIS_DESCR STD_AXIS Epm_nEng EngN 8 0.00 6000.000 FORMAT "%8.3" EXTENDED_LIMITS -16384.00 16383.50 DEPOSIT ABSOLUTE /end AXIS_DESCR
 /begin AXIS_DESCR STD_AXIS InjCtl_qSetUnBal InjMass 8 0.00 327.6700 FORMAT "%8.4" EXTENDED_LIMITS -327.6800 327.6700 DEPOSIT ABSOLUTE /end AXIS_DESCR
/end CHARACTERISTIC
/begin CHARACTERISTIC InjCrv_stPiIRlsOpRng3_MAP "Freigabekennfeld im Betriebsbereich 3" MAP 0x8004F4C0 Map_Xs16Ys16Ws16 4.000000 OneToOne 1.000000 5.000000 FORMAT "%8.6" EXTENDED_LIMITS -32768.00 32767.00
 /begin AXIS_DESCR STD_AXIS Epm_nEng EngN 8 0.00 6000.000 FORMAT "%8.3" EXTENDED_LIMITS -16384.00 16383.50 DEPOSIT ABSOLUTE /end AXIS_DESCR
 /begin AXIS_DESCR STD_AXIS InjCtl_qSetUnBal InjMass 8 0.00 327.6700 FORMAT "%8.4" EXTENDED_LIMITS -327.6800 327.6700 DEPOSIT ABSOLUTE /end AXIS_DESCR
/end CHARACTERISTIC
/begin CHARACTERISTIC InjCrv_stPiIRlsOpRng4_MAP "Freigabekennfeld im Betriebsbereich 4" MAP 0x8004F564 Map_Xs16Ys16Ws16 4.000000 OneToOne 1.000000 5.000000 FORMAT "%8.6" EXTENDED_LIMITS -32768.00 32767.00
 /begin AXIS_DESCR STD_AXIS Epm_nEng EngN 8 0.00 6000.000 FORMAT "%8.3" EXTENDED_LIMITS -16384.00 16383.50 DEPOSIT ABSOLUTE /end AXIS_DESCR
 /begin AXIS_DESCR STD_AXIS InjCtl_qSetUnBal InjMass 8 0.00 327.6700 FORMAT "%8.4" EXTENDED_LIMITS -327.6800 327.6700 DEPOSIT ABSOLUTE /end AXIS_DESCR
/end CHARACTERISTIC
/begin CHARACTERISTIC InjCrv_stPiIRlsOpRng5_MAP "Freigabekennfeld im Betriebsbereich 5" MAP 0x8004F608 Map_Xs16Ys16Ws16 4.000000 OneToOne 1.000000 5.000000 FORMAT "%8.6" EXTENDED_LIMITS -32768.00 32767.00
 /begin AXIS_DESCR STD_AXIS Epm_nEng EngN 8 0.00 6000.000 FORMAT "%8.3" EXTENDED_LIMITS -16384.00 16383.50 DEPOSIT ABSOLUTE /end AXIS_DESCR
 /begin AXIS_DESCR STD_AXIS InjCtl_qSetUnBal InjMass 8 0.00 327.6700 FORMAT "%8.4" EXTENDED_LIMITS -327.6800 327.6700 DEPOSIT ABSOLUTE /end AXIS_DESCR
/end CHARACTERISTIC
/begin CHARACTERISTIC InjCrv_stPrioRgnMsk_C "Bitmaske für Aktivierung des Prioritätsstaus im Regenerationsbetrieb" VALUE 0x8004F6AC Val_Wu32 4294967295.00 OneToOne 0.00 4294967295.00 FORMAT "%13.2" /end CHARACTERISTIC
/begin CHARACTERISTIC InjCrv_stRlsRgnMsk_C "Bitmaske für Aktivierung des Freigabekennfelds im Regenerationsbetrieb" VALUE 0x8004F6B0 Val_Wu32 4294967295.00 OneToOne 0.00 4294967295.00 FORMAT "%13.2" /end CHARACTERISTIC
/begin MEASUREMENT Com_dTrqDemandGbxCHK "" UBYTE OneToOne 1 100 0.00 255.0 FORMAT "%5.1" ECU_ADDRESS 0xD0008F7C /end MEASUREMENT
/begin MEASUREMENT Com_dTrqDemandGbxCTR "" UWORD OneToOne 1 100 0.00 65535.00 FORMAT "%8.2" ECU_ADDRESS 0xD0007640 /end MEASUREMENT
/begin MEASUREMENT Com_nTSC "" SWORD EngN 1 100 -16384.00 16383.50 FORMAT "%8.2" ECU_ADDRESS 0xD0006CF2 /end MEASUREMENT
/begin MEASUREMENT Com_RawMuxVal_mp "" UBYTE OneToOne 1 100 0.00 255.0 FORMAT "%5.1" ARRAY_SIZE 8 ECU_ADDRESS 0xC0000B08 /end MEASUREMENT
/begin MEASUREMENT Com_RawValA_mp "" UBYTE OneToOne 1 100 0.00 255.0 FORMAT "%5.1" ARRAY_SIZE 8 ECU_ADDRESS 0xC0000B10 /end MEASUREMENT
/begin MEASUREMENT Com_RawValB_mp "" UBYTE OneToOne 1 100 0.00 255.0 FORMAT "%5.1" ARRAY_SIZE 8 ECU_ADDRESS 0xC0000B18 /end MEASUREMENT
/begin MEASUREMENT Com_RawValC_mp "" UBYTE OneToOne 1 100 0.00 255.0 FORMAT "%5.1" ARRAY_SIZE 8 ECU_ADDRESS 0xC0000B20 /end MEASUREMENT
/begin MEASUREMENT Com_RawValD_mp "" UBYTE OneToOne 1 100 0.00 255.0 FORMAT "%5.1" ARRAY_SIZE 8 ECU_ADDRESS 0xC0000B28 /end MEASUREMENT
/begin MEASUREMENT Com_RawValIdA_mp "" UWORD OneToOne 1 100 0.00 65535.00 FORMAT "%8.2" ECU_ADDRESS 0xC0000B30 /end MEASUREMENT
/begin MEASUREMENT Com_RawValIdB_mp "" UWORD OneToOne 1 100 0.00 65535.00 FORMAT "%8.2" ECU_ADDRESS 0xC0000B32 /end MEASUREMENT
/begin MEASUREMENT Com_RawValIdC_mp "" UWORD OneToOne 1 100 0.00 65535.00 FORMAT "%8.2" ECU_ADDRESS 0xC0000B34 /end MEASUREMENT
/begin MEASUREMENT Com_RawValIdD_mp "" UWORD OneToOne 1 100 0.00 65535.00 FORMAT "%8.2" ECU_ADDRESS 0xC0000B36 /end MEASUREMENT
/begin MEASUREMENT Com_rTrq "" SWORD TransR 1 100 -327.6800 327.6700 FORMAT "%8.4" ECU_ADDRESS 0xD0006D00 /end MEASUREMENT
/begin MEASUREMENT Com_SelfRecCtr_mp "" UBYTE OneToOne 1 100 0.00 255.0 FORMAT "%5.1" ECU_ADDRESS 0xC0000B38 /end MEASUREMENT
/begin MEASUREMENT Com_SelfRecID_mp "" UWORD OneToOne 1 100 0.00 65535.00 FORMAT "%8.2" ECU_ADDRESS 0xC0000B3A /end MEASUREMENT
/begin MEASUREMENT Com_SelfRecSt_mp "" UBYTE OneToOne 1 100 0.00 255.0 FORMAT "%5.1" ECU_ADDRESS 0xC0000B3C /end MEASUREMENT
/begin MEASUREMENT Com_SelfRecTmr_mp "" SWORD Time_ms 1 100 -327680.0 327670.0 FORMAT "%8.1" ECU_ADDRESS 0xC0000B3E /end MEASUREMENT
/begin MEASUREMENT Com_stClth "Kupplungschaltersstatus" UBYTE OneToOne 1 100 0.00 255.0 FORMAT "%5.1" ECU_ADDRESS 0xD0008F85 /end MEASUREMENT
/begin MEASUREMENT Com_stClthRaw "" UBYTE OneToOne 1 100 0.00 255.0 FORMAT "%5.1" ECU_ADDRESS 0xD0008F86 /end MEASUREMENT
/begin MEASUREMENT Com_stCtrPCos "" SWORD OneToOne 1 100 -32768.00 32767.00 FORMAT "%8.2" ECU_ADDRESS 0xD0006D06 /end MEASUREMENT
/begin MEASUREMENT Com_stGbxOBD "" UBYTE OneToOne 1 100 0.00 255.0 FORMAT "%5.1" ECU_ADDRESS 0xD0008F8F /end MEASUREMENT
/begin MEASUREMENT Com_stGear "" UBYTE OneToOne 1 100 0.00 255.0 FORMAT "%5.1" ECU_ADDRESS 0xD0008F90 /end MEASUREMENT
/begin MEASUREMENT Com_stSelfRec "" UWORD OneToOne 1 100 0.00 65535.00 FORMAT "%8.2" ECU_ADDRESS 0xD0007648 /end MEASUREMENT
/begin MEASUREMENT Com_stTrqGbxDes "" UBYTE OneToOne 1 100 0.00 255.0 FORMAT "%5.1" ECU_ADDRESS 0xD0008FA7 /end MEASUREMENT
/begin MEASUREMENT Com_stTrqGbxLim "" UBYTE OneToOne 1 100 0.00 255.0 FORMAT "%5.1" ECU_ADDRESS 0xD0008FA8 /end MEASUREMENT
/begin MEASUREMENT Com_stTSC "" UBYTE OneToOne 1 100 0.00 255.0 FORMAT "%5.1" ECU_ADDRESS 0xD0008FA4 /end MEASUREMENT
/begin MEASUREMENT Com_stTxEvent "" UWORD OneToOne 1 100 0.00 65535.00 FORMAT "%8.2" ECU_ADDRESS 0xD000764A /end MEASUREMENT
/begin MEASUREMENT Com_test1_mp "" SWORD OneToOne 1 100 -32768.00 32767.00 FORMAT "%8.2" ECU_ADDRESS 0xC0000B40 /end MEASUREMENT
/begin MEASUREMENT Com_test2_mp "" SWORD OneToOne 1 100 -32768.00 32767.00 FORMAT "%8.2" ECU_ADDRESS 0xC0000B42 /end MEASUREMENT
/begin MEASUREMENT Com_test3_mp "" SWORD OneToOne 1 100 -32768.00 32767.00 FORMAT "%8.2" ECU_ADDRESS 0xC0000B44 /end MEASUREMENT
/begin MEASUREMENT Com_test4_mp "" SWORD OneToOne 1 100 -32768.00 32767.00 FORMAT "%8.2" ECU_ADDRESS 0xC0000B46 /end MEASUREMENT
/begin MEASUREMENT Com_tGbxOil "Getriebeöltemperatur vom CAN" SWORD Temp_Cels 1 100 -3549.940 3003.560 FORMAT "%8.3" ECU_ADDRESS 0xD0006D10 /end MEASUREMENT
/begin MEASUREMENT Com_trqGbxDes "" SWORD Trq 1 100 -3276.800 3276.700 FORMAT "%8.3" ECU_ADDRESS 0xD0006D20 /end MEASUREMENT
/begin MEASUREMENT Com_trqGbxFrc "" SWORD Trq 1 100 -3276.800 3276.700 FORMAT "%8.3" ECU_ADDRESS 0xD0006D22 /end MEASUREMENT
/begin MEASUREMENT Com_trqGbxMaxRaw "" SWORD Trq 1 100 -3276.800 3276.700 FORMAT "%8.3" ECU_ADDRESS 0xD0006D24 /end MEASUREMENT
/begin MEASUREMENT CoVeh_stIgnLckTerm15 "Status Klemme 15" UBYTE OneToOne 1 100 0.00 255.0 FORMAT "%5.1" ECU_ADDRESS 0xD0008F69 /end MEASUREMENT
/begin MEASUREMENT CoVeh_stIgnLckTerm50 "Status Klemme 50" UBYTE OneToOne 1 100 0.00 255.0 FORMAT "%5.1" ECU_ADDRESS 0xD0008F6A /end MEASUREMENT
/begin MEASUREMENT Fan_r "Tastverhältnis, Lüfter" SWORD Prc 1 100 -400.0000 399.9878 FORMAT "%8.4" ECU_ADDRESS 0xD0006F1C /end MEASUREMENT
/begin MEASUREMENT Fan_rCalc_mp "" SWORD DtyCyc 1 100 -327.6800 327.6700 FORMAT "%8.4" ECU_ADDRESS 0xC00009EA /end MEASUREMENT
/begin MEASUREMENT Fan_rCor_mp "" SWORD DtyCyc 1 100 -327.6800 327.6700 FORMAT "%8.4" ECU_ADDRESS 0xC00009EC /end MEASUREMENT
/begin MEASUREMENT Fan_rPs "" SWORD DtyCyc 1 100 -327.6800 327.6700 FORMAT "%8.4" ECU_ADDRESS 0xD0006F1E /end MEASUREMENT
/begin MEASUREMENT Fan_stErrMsg_mp "" UBYTE OneToOne 1 100 0.00 255.0 FORMAT "%5.1" ECU_ADDRESS 0xC00009EE /end MEASUREMENT
/begin MEASUREMENT FBC_AACoef_mp "Antialiasingfilterkoeffizienten" FLOAT32_IEEE OneToOne 1 100 0.00 1.00000000 FORMAT "%10.8" ARRAY_SIZE 9 ECU_ADDRESS 0xC0000A1C /end MEASUREMENT
/begin MEASUREMENT FBC_AAIn "" FLOAT32_IEEE OneToOne 1 100 -150000000. 150000000. FORMAT "%10.0" ARRAY_SIZE 4 ECU_ADDRESS 0xD0004284 /end MEASUREMENT
/begin MEASUREMENT FBC_AAInSum_mp "Summe der Segmentzeiten der Minisegmente" FLOAT32_IEEE OneToOne 1 100 -150000000. 150000000. FORMAT "%10.0" ECU_ADDRESS 0xC0000A40 /end MEASUREMENT
/begin MEASUREMENT FBC_AAOrd_mp "Filterordnung des Antialiasingfilter" UBYTE OneToOne 1 100 0.00 255.0 FORMAT "%5.1" ECU_ADDRESS 0xC0000A44 /end MEASUREMENT
/begin MEASUREMENT FBC_AAOut_mp "Ausgang des Antialiasingfiler" FLOAT32_IEEE OneToOne 1 100 -150000000. 150000000. FORMAT "%10.0" ECU_ADDRESS 0xC0000A48 /end MEASUREMENT
/begin MEASUREMENT FBC_AAPhiAbs_mp "absoluter Startwinkel des AntiAliasing-Winkels (FBC_AAPhiAbs_mp[0] ist der jüngste Wert)" SWORD OneToOne 1 100 -32768.00 32767.00 FORMAT "%8.2" ARRAY_SIZE 6 ECU_ADDRESS 0xC0000A4C /end MEASUREMENT
/begin MEASUREMENT FBC_AAPhiLen_mp "Länge eines AntiAliasing-Segments (FBC_AAPhiInt_mp[0] ist der aktuellste Werte)" SWORD OneToOne 1 100 -32768.00 32767.00 FORMAT "%8.2" ECU_ADDRESS 0xC0000A58 /end MEASUREMENT
/begin MEASUREMENT FBC_AnglePerSegmentEDC_mp "Länge des letzten EDC-Segmentes" SWORD OneToOne 1 100 -32768.00 32767.00 FORMAT "%8.2" ECU_ADDRESS 0xC0000A5A /end MEASUREMENT
/begin MEASUREMENT FBC_AnglePerSegmentPhys_mp "Länge eines EDC-Segmentes" SWORD OneToOne 1 100 -32768.00 32767.00 FORMAT "%8.2" ECU_ADDRESS 0xC0000A5C /end MEASUREMENT
/begin MEASUREMENT FBC_AngleRes_mp "Auflösung der Winkelumrechnung" SWORD OneToOne 1 100 -32768.00 32767.00 FORMAT "%8.2" ECU_ADDRESS 0xC0000A5E /end MEASUREMENT
/begin MEASUREMENT FBC_Badpt "Adaptionsstatus (Bit1: 'Korrekturwert vorhanden', Bit2: 'Adaption angehalten', Bit3: 'neu eingelernt')" UBYTE OneToOne 1 100 0.00 255.0 FORMAT "%5.1" ECU_ADDRESS 0xD0009010 /end MEASUREMENT
/begin MEASUREMENT FBC_ctSegInt "interner Segmentzähler von FBC" UBYTE OneToOne 1 100 0.00 255.0 FORMAT "%5.1" ECU_ADDRESS 0xD0009012 /end MEASUREMENT
/begin MEASUREMENT FBC_dBPCaS "aktueller Bandpass Zählerkoeffizient f=fNW (gangabhängig)" FLOAT32_IEEE OneToOne 1 100 -5000.00000 5000.00000 FORMAT "%10.5" ARRAY_SIZE 3 ECU_ADDRESS 0xD0004298 /end MEASUREMENT
/begin MEASUREMENT FBC_dBPCaSOld_mp "Array mit zurückliegenden Bandpassausgängen" FLOAT32_IEEE OneToOne 1 100 -5000.00000 5000.00000 FORMAT "%10.5" ARRAY_SIZE 3 ECU_ADDRESS 0xC00009F0 /end MEASUREMENT
/begin MEASUREMENT FBC_dBPSum "FBC Mengenersatzsignal, Eingang PI-Regler" SWORD OneToOne 1 100 -32768.00 32767.00 FORMAT "%8.2" ECU_ADDRESS 0xD0006EEA /end MEASUREMENT
/begin MEASUREMENT FBC_DXAdap_mp "aktuelle Adaptionsgüte" SWORD FBC_Dxs_s16 1 100 -0.8192000 0.8191750 FORMAT "%9.7" ECU_ADDRESS 0xC0000A60 /end MEASUREMENT
/begin MEASUREMENT FBC_DXSfn_mp "Ausgang des negativen Bewertungsfilter" SWORD FBC_Dxs_s16 1 100 -0.8192000 0.8191750 FORMAT "%9.7" ARRAY_SIZE 12 ECU_ADDRESS 0xC0000A62 /end MEASUREMENT
/begin MEASUREMENT FBC_DXSfp_mp "Ausgang des positiven Bewertungsfilter" SWORD FBC_Dxs_s16 1 100 -0.8192000 0.8191750 FORMAT "%9.7" ARRAY_SIZE 12 ECU_ADDRESS 0xC0000A7A /end MEASUREMENT
/begin MEASUREMENT FBC_DXSf_mp "relative,aktuelle gefilterte Zahnteilungsfehler (Adaptionsfilter)" SWORD FBC_Dxs_s16 1 100 -0.8192000 0.8191750 FORMAT "%9.7" ARRAY_SIZE 12 ECU_ADDRESS 0xC0000A92 /end MEASUREMENT
/begin MEASUREMENT FBC_DXSl_mp "relative, gefilterte Zahnteilungsfehler (Adaptionsfilter, eingelernte Werte)" SWORD FBC_Dxs_s16 1 100 -0.8192000 0.8191750 FORMAT "%9.7" ARRAY_SIZE 12 ECU_ADDRESS 0xC0000AAA /end MEASUREMENT
/begin MEASUREMENT FBC_DXS_mp "relative Zahnteilungsfehler (ungefiltert)" SWORD FBC_Dxs_s16 1 100 -0.8192000 0.8191750 FORMAT "%9.7" ARRAY_SIZE 12 ECU_ADDRESS 0xC0000AC2 /end MEASUREMENT
/begin MEASUREMENT FBC_dynSpd_mp "Drehzahldynamikwert" FLOAT32_IEEE OneToOne 1 100 -150000000. 150000000. FORMAT "%10.0" ECU_ADDRESS 0xC0000ADC /end MEASUREMENT
/begin MEASUREMENT FBC_EpmSynPhiInt_mp "=EpmSyn_phiInt" SWORD AngleCrS 1 100 -720.0220 720.0000 FORMAT "%8.4" ECU_ADDRESS 0xC0000AE0 /end MEASUREMENT
/begin MEASUREMENT FBC_facBPNum_mp "aktuell angewendete Bandpassverstärkung" SWORD FBC_BPfac 1 100 -60.00183 60.00000 FORMAT "%8.5" ARRAY_SIZE 3 ECU_ADDRESS 0xC00009FC /end MEASUREMENT
/begin MEASUREMENT FBC_facSegVal_mp "aktuell angewendete Segmentwahl" UWORD Per_Ratio 1 100 0.00 255.9961 FORMAT "%8.4" ARRAY_SIZE 3 ECU_ADDRESS 0xC0000A02 /end MEASUREMENT
/begin MEASUREMENT FBC_nMaxOvrRun_mp "obere Drehzahlgrenze der Bandpassberechnung" SWORD EngN 1 100 -16384.00 16383.50 FORMAT "%8.2" ECU_ADDRESS 0xC0000A08 /end MEASUREMENT
/begin MEASUREMENT FBC_numAASeg "" UBYTE OneToOne 1 100 0.00 255.0 FORMAT "%5.1" ECU_ADDRESS 0xD0009013 /end MEASUREMENT
/begin MEASUREMENT FBC_q "Ausgangsmenge der Mengenausgleichsregelung" SWORD InjMass 1 100 -327.6800 327.6700 FORMAT "%8.4" ECU_ADDRESS 0xD0006EEC /end MEASUREMENT
/begin MEASUREMENT FBC_qArr "Ausgangsmenge der Mengenausgleichsregelung, Schnittstelle zum Einspritzsystem" SWORD InjMass 1 100 -327.6800 327.6700 FORMAT "%8.4" ARRAY_SIZE 6 ECU_ADDRESS 0xD0006EEE /end MEASUREMENT
/begin MEASUREMENT FBC_qDvtCyl "aktuelle zylinderindividuelle Korrekturmenge: I-Anteile in Zündfolge" SWORD InjMass 1 100 -327.6800 327.6700 FORMAT "%8.4" ARRAY_SIZE 6 ECU_ADDRESS 0xD0006F06 /end MEASUREMENT
/begin MEASUREMENT FBC_qDvtCylPhys "aktuelle zylinderindividuelle Korrekturmenge: I-Anteile in geometrischer Reihenfolge" SWORD InjMass 1 100 -327.6800 327.6700 FORMAT "%8.4" ARRAY_SIZE 6 ECU_ADDRESS 0xD0006EFA /end MEASUREMENT
/begin MEASUREMENT FBC_qIntegrator_mp "Ausgangsmenge der Mengenausgleichsregelung, Integratorinhalte" SWORD InjMass 1 100 -327.6800 327.6700 FORMAT "%8.4" ARRAY_SIZE 6 ECU_ADDRESS 0xC0000A0A /end MEASUREMENT
/begin MEASUREMENT FBC_qLimAct "Aktuelle Begrenzungsmenge für FBC_q" SWORD InjMass 1 100 -327.6800 327.6700 FORMAT "%8.4" ECU_ADDRESS 0xD0006F12 /end MEASUREMENT
/begin MEASUREMENT FBC_qLimIncr "Offset für FBC-Begrenzungsmenge" SWORD InjMass 1 100 -327.6800 327.6700 FORMAT "%8.4" ECU_ADDRESS 0xD0006F14 /end MEASUREMENT
/begin MEASUREMENT FBC_qSet "Wunschmenge mit FBC-Korrektur zum Zeitpunkt des jeweiligen MI-Interrupts" SWORD InjMass 1 100 -327.6800 327.6700 FORMAT "%8.4" ECU_ADDRESS 0xD0006F16 /end MEASUREMENT
/begin MEASUREMENT FBC_qSetOld_mp "zurückliegende Wunschmenge mit FBC-Korrektur zum Zeitpunkt des jeweiligen MI-Interrupts" SWORD InjMass 1 100 -327.6800 327.6700 FORMAT "%8.4" ECU_ADDRESS 0xC0000A16 /end MEASUREMENT
/begin MEASUREMENT FBC_RegionChng "signalisiert einen Wechsel der Lernregion in der FBC" UBYTE OneToOne 1 100 0.00 255.0 FORMAT "%5.1" ECU_ADDRESS 0xD0009011 /end MEASUREMENT
/begin MEASUREMENT FBC_stActive "Status FBC-Regler -> '1': Regeln; '0': Steuern" UBYTE OneToOne 1 100 0.00 255.0 FORMAT "%5.1" ECU_ADDRESS 0xD0009014 /end MEASUREMENT
/begin MEASUREMENT FBC_stBPRedNum_mp "Status der Reduzierung der Bandpassverstärkungen (TRUE: 'aktiv' ; FALSE: 'inaktiv')" UBYTE OneToOne 1 100 0.00 255.0 FORMAT "%5.1" ECU_ADDRESS 0xC0000A18 /end MEASUREMENT
/begin MEASUREMENT FBC_stBufSeg_mp "Rückgabewert der Funktion EpmHCrS_GetBufSegFBC für ein EDC-Segment" UBYTE OneToOne 1 100 0.00 255.0 FORMAT "%5.1" ECU_ADDRESS 0xC0000AE2 /end MEASUREMENT
/begin MEASUREMENT FBC_stBufSubSeg_mp "Rückgabewerte der Funktion EpmHCrS_GetBufSegFBC für FBC-Teilsegmente" UBYTE OneToOne 1 100 0.00 255.0 FORMAT "%5.1" ARRAY_SIZE 6 ECU_ADDRESS 0xC0000AE3 /end MEASUREMENT
/begin MEASUREMENT FBC_stEqualInit "Initialisierungsstatus für FBC-Regler (0: 'normaler Betrieb', 1: 'Regler initialisieren')" UBYTE OneToOne 1 100 0.00 255.0 FORMAT "%5.1" ECU_ADDRESS 0xD0009015 /end MEASUREMENT
/begin MEASUREMENT FBC_stLearn "Status der Geberradadaption(Bit1: 'zu große Drehzahldynamik', Bit2: 'kein Schub', Bit3: 'Änderung des Drehzahlbereiches', Bit4: 'kein gültiger Drehzahlbereich')" UWORD OneToOne 1 100 0.00 65535.00 FORMAT "%8.2" ECU_ADDRESS 0xD0007660 /end MEASUREMENT
/begin MEASUREMENT FBC_stRegionESpP_mp "Status der Geberradadaption in Abhängigkeit der Drehzahl" UBYTE OneToOne 1 100 0.00 255.0 FORMAT "%5.1" ECU_ADDRESS 0xC0000AE9 /end MEASUREMENT
/begin MEASUREMENT FBC_stRegionSRCtl_mp "Status Regler in Abhängigkeit von Menge/Drehzahl ('regeln','steuern','inaktiv')" UBYTE OneToOne 1 100 0.00 255.0 FORMAT "%5.1" ECU_ADDRESS 0xC0000A19 /end MEASUREMENT
/begin MEASUREMENT FBC_stStateESpP_mp "Status des Zustandsautomaten der Adaption" UBYTE FBC_StateESpP_st 1 100 1.00000000000 5.00000000000 FORMAT "%13.11" ECU_ADDRESS 0xC0000AEA /end MEASUREMENT
/begin MEASUREMENT FBC_TSmCoef_mp "Koeffizienten für Mittelwertfilter" FLOAT32_IEEE OneToOne 1 100 -11.5000000 12.5000000 FORMAT "%10.7" ARRAY_SIZE 2 ECU_ADDRESS 0xC0000AEC /end MEASUREMENT
/begin MEASUREMENT FBC_WheelLrnOut "Eingangsignal für FBC Bandpässe" FLOAT32_IEEE OneToOne 1 100 -1.00000000E+035 1.00000000E+035 FORMAT "%10.0" ECU_ADDRESS 0xD0004294 /end MEASUREMENT
/begin MEASUREMENT FBC_WheelLrnOutOld_mp "zurückliegendes Eingangsignal für FBC Bandpässe" FLOAT32_IEEE OneToOne 1 100 -1.00000000E+035 1.00000000E+035 FORMAT "%10.0" ECU_ADDRESS 0xC0000AF4 /end MEASUREMENT
/begin MEASUREMENT FlFlt_st "" UBYTE OneToOne 1 100 0.00 255.0 FORMAT "%5.1" ECU_ADDRESS 0xD0009017 /end MEASUREMENT
/begin MEASUREMENT FlFlt_stRaw "" UBYTE OneToOne 1 100 0.00 255.0 FORMAT "%5.1" ECU_ADDRESS 0xD0009018 /end MEASUREMENT
/begin MEASUREMENT FlSys_dvolFlCons "Kraftstoffverbrauch in l/h der momentenrelevanten Einspritzmenge" SWORD FlConsum_l_h 1 100 -327.6800 327.6700 FORMAT "%8.4" ECU_ADDRESS 0xD0006F26 /end MEASUREMENT
/begin MEASUREMENT FlSys_dvolPerStroke_mp "Kraftstoffverbrauch in mm^3/Hub der gesamten Einspritzmenge" SWORD InjQnt 1 100 -3276.800 3276.700 FORMAT "%8.3" ECU_ADDRESS 0xC0000AFA /end MEASUREMENT
/begin MEASUREMENT FlSys_facFlConsAdj_mp "EEPROM Abgleichwert zur Korrektur des Kraftstoffverbrauchs" SWORD Fact 1 100 -4.000000 3.999878 FORMAT "%8.6" ECU_ADDRESS 0xC0000AFC /end MEASUREMENT
/begin MEASUREMENT FlSys_qSubs_mp "Ersatzeinspritzmenge für KVA Berechnung" SWORD InjMassCyc 1 100 -327.6800 327.6700 FORMAT "%8.4" ECU_ADDRESS 0xC0000AFE /end MEASUREMENT
/begin MEASUREMENT FlSys_qSum_mp "tatsächlicher Kraftstoffverbrauch" SWORD InjMassCyc 1 100 -327.6800 327.6700 FORMAT "%8.4" ECU_ADDRESS 0xC0000B00 /end MEASUREMENT
/begin MEASUREMENT FlSys_rhoFl "Koeffizient Kraftstoffdichte" SWORD RhoFuel 1 100 -3276.800 3276.700 FORMAT "%8.3" ECU_ADDRESS 0xD0006F28 /end MEASUREMENT
/begin MEASUREMENT FlSys_stDeflate_mp "Aktivierung der Niederdruckentlüftung" UBYTE OneToOne 1 100 0.00 255.0 FORMAT "%5.1" ECU_ADDRESS 0xC0000AF8 /end MEASUREMENT
/begin MEASUREMENT FlSys_volFlCons "Absoluter Kraftstoffverbrauch in ul/20ms" SLONG FlConsum_ul_20ms 1 100 -2147483648.00 2147483647.00 FORMAT "%13.2" ECU_ADDRESS 0xD0004340 /end MEASUREMENT
/begin MEASUREMENT FlSys_volFlConsAdj_mp "abgeglichener aktueller absoluter Kraftstoffverbrauch in l/20ms für die Aufsummierung" SLONG FlConsum_ul_20ms 1 100 -2147483648.00 2147483647.00 FORMAT "%13.2" ECU_ADDRESS 0xC0000B04 /end MEASUREMENT
/begin MEASUREMENT FlSys_volTotFlCons "" SLONG FlConsum_ul_20ms 1 100 -2147483648.00 2147483647.00 FORMAT "%13.2" ECU_ADDRESS 0xD0004344 /end MEASUREMENT
/begin MEASUREMENT FuelT_t "Kraftstofftemperatur" SWORD Temp_Cels 1 100 -3549.940 3003.560 FORMAT "%8.3" ECU_ADDRESS 0xD0006F48 /end MEASUREMENT
/begin MEASUREMENT FuelT_tFlSys "Kraftstoffsystemtemperatur" SWORD Temp_Cels 1 100 -3549.940 3003.560 FORMAT "%8.3" ECU_ADDRESS 0xD0006F4A /end MEASUREMENT
/begin MEASUREMENT FuelT_tSens "Erfasster Wert der Kraftstofftemperatur" SWORD Temp_Cels 1 100 -3549.940 3003.560 FORMAT "%8.3" ECU_ADDRESS 0xD0006F4C /end MEASUREMENT
/begin MEASUREMENT FuelT_uRaw "Rohspannungswert aus dem ADC für Kraftstofftemperatursensor" SWORD Volt 1 100 -6553.600 6553.400 FORMAT "%8.3" ECU_ADDRESS 0xD0006F4E /end MEASUREMENT
/begin MEASUREMENT GbxNPos_rRawNPos "" SWORD DtyCyc 1 100 -327.6800 327.6700 FORMAT "%8.4" ECU_ADDRESS 0xD0006F50 /end MEASUREMENT
/begin MEASUREMENT GbxNPos_tiPer_mp "" SWORD Time_PwmHigh 1 100 -1638.400 1638.350 FORMAT "%8.3" ECU_ADDRESS 0xC0000B48 /end MEASUREMENT
/begin MEASUREMENT Gbx_dNPos "" SWORD DtyCyc 1 100 -327.6800 327.6700 FORMAT "%8.4" ECU_ADDRESS 0xD0006F56 /end MEASUREMENT
/begin MEASUREMENT Gbx_stNPos "" UBYTE OneToOne 1 100 0.00 255.0 FORMAT "%5.1" ECU_ADDRESS 0xD0009024 /end MEASUREMENT
/begin MEASUREMENT Gbx_stNPosRaw "" UBYTE OneToOne 1 100 0.00 255.0 FORMAT "%5.1" ECU_ADDRESS 0xD0009025 /end MEASUREMENT
/begin MEASUREMENT Gbx_trqPrt "" SWORD Trq 1 100 -3276.800 3276.700 FORMAT "%8.3" ECU_ADDRESS 0xD0006F6C /end MEASUREMENT
/begin MEASUREMENT Gbx_trqTIIDes "" SWORD Trq 1 100 -3276.800 3276.700 FORMAT "%8.3" ECU_ADDRESS 0xD0006F6E /end MEASUREMENT
/begin MEASUREMENT Gbx_trqTSCIntv "" SWORD Trq 1 100 -3276.800 3276.700 FORMAT "%8.3" ECU_ADDRESS 0xD0006F70 /end MEASUREMENT
/begin MEASUREMENT GlbDa_aX "" SWORD Acc 1 100 -32.76800 32.76700 FORMAT "%8.5" ECU_ADDRESS 0xD0006F72 /end MEASUREMENT
/begin MEASUREMENT GlbDa_aXFlt "" SWORD Acc 1 100 -32.76800 32.76700 FORMAT "%8.5" ECU_ADDRESS 0xD0006F74 /end MEASUREMENT
/begin MEASUREMENT GlbDa_lDstLim_mp "" SLONG Length_fine 1 100 -2147483.64800 2147483.64700 FORMAT "%13.5" ECU_ADDRESS 0xC0000B4C /end MEASUREMENT
/begin MEASUREMENT GlbDa_lInt_mp "" SLONG Length_fine 1 100 -2147483.64800 2147483.64700 FORMAT "%13.5" ECU_ADDRESS 0xC0000B50 /end MEASUREMENT
/begin MEASUREMENT GlbDa_lTotDst "" SLONG Length 1 100 -2147483648.00 2147483647.00 FORMAT "%13.2" ECU_ADDRESS 0xD0004280 /end MEASUREMENT
/begin MEASUREMENT GlbDa_lTotDstLoc2_mp "" SLONG Length_fine 1 100 -2147483.64800 2147483.64700 FORMAT "%13.5" ECU_ADDRESS 0xC0000B54 /end MEASUREMENT
/begin MEASUREMENT GlbDa_lWhlCirc "" SWORD Length_fine 1 100 -32.76800 32.76700 FORMAT "%8.5" ECU_ADDRESS 0xD0006F76 /end MEASUREMENT
/begin MEASUREMENT GlbDa_pEnv "" SWORD Pres_hPa 1 100 -32768.00 3500.00 FORMAT "%8.2" ECU_ADDRESS 0xD0006F78 /end MEASUREMENT
/begin MEASUREMENT GlbDa_stIARlsVeh "" UBYTE OneToOne 1 100 0.00 255.0 FORMAT "%5.1" ECU_ADDRESS 0xD0009027 /end MEASUREMENT
/begin MEASUREMENT GlbDa_stTrqDem "" UWORD OneToOne 1 100 0.00 65535.00 FORMAT "%8.2" ECU_ADDRESS 0xD0007662 /end MEASUREMENT
/begin MEASUREMENT GlbDa_stVehLimMin "" UBYTE OneToOne 1 100 0.00 255.0 FORMAT "%5.1" ECU_ADDRESS 0xD0009028 /end MEASUREMENT
/begin MEASUREMENT GlbDa_tEnv "" SWORD Temp_Cels 1 100 -3549.940 3003.560 FORMAT "%8.3" ECU_ADDRESS 0xD0006F7A /end MEASUREMENT
/begin MEASUREMENT GlbDa_tEnvMod "" SWORD Temp_Cels 1 100 -3549.940 3003.560 FORMAT "%8.3" ECU_ADDRESS 0xD0006F7C /end MEASUREMENT
/begin MEASUREMENT GlbDa_tIndAir "" SWORD Temp_Cels 1 100 -3549.940 3003.560 FORMAT "%8.3" ECU_ADDRESS 0xD0006F7E /end MEASUREMENT
/begin MEASUREMENT GlbDa_trqVehLimMin "" SWORD Trq 1 100 -3276.800 3276.700 FORMAT "%8.3" ECU_ADDRESS 0xD0006F80 /end MEASUREMENT
/begin MEASUREMENT GlbDa_vX "" SWORD Vel 1 100 -327.6800 327.6700 FORMAT "%8.4" ECU_ADDRESS 0xD0006F82 /end MEASUREMENT
/begin MEASUREMENT GlbDa_vXFlt "" SWORD Vel 1 100 -327.6800 327.6700 FORMAT "%8.4" ECU_ADDRESS 0xD0006F84 /end MEASUREMENT
/begin MEASUREMENT GlbDa_vXLoc1_mp "" SWORD Vel_SI 1 100 -91.02222 91.01944 FORMAT "%8.5" ECU_ADDRESS 0xC0000B58 /end MEASUREMENT
/begin MEASUREMENT GlwCtl_ctPreGlw_mp "" UBYTE OneToOne 1 100 0.00 255.0 FORMAT "%5.1" ECU_ADDRESS 0xC0000B64 /end MEASUREMENT
/begin MEASUREMENT GlwCtl_rLimitRaw_mp "" UBYTE OneToOne 1 100 0.00 255.0 FORMAT "%5.1" ECU_ADDRESS 0xC0000B5E /end MEASUREMENT
/begin MEASUREMENT GlwCtl_rLimit_mp "" SWORD OneToOne 1 100 -32768.00 32767.00 FORMAT "%8.2" ECU_ADDRESS 0xC0000B60 /end MEASUREMENT
/begin MEASUREMENT GlwCtl_rRaw_mp "" SWORD OneToOne 1 100 -32768.00 32767.00 FORMAT "%8.2" ECU_ADDRESS 0xC0000B62 /end MEASUREMENT
/begin MEASUREMENT GlwCtl_stGlw "Glühzustand aus Zustandsautomat" UWORD OneToOne 1 100 0.00 65535.00 FORMAT "%8.2" ECU_ADDRESS 0xD0007664 /end MEASUREMENT
/begin MEASUREMENT GlwCtl_stHdnPreGlwOld_mp "" SWORD OneToOne 1 100 -32768.00 32767.00 FORMAT "%8.2" ECU_ADDRESS 0xC0000B66 /end MEASUREMENT
/begin MEASUREMENT GlwCtl_stHdnPreGlwTrg_mp "" SWORD OneToOne 1 100 -32768.00 32767.00 FORMAT "%8.2" ECU_ADDRESS 0xC0000B68 /end MEASUREMENT
/begin MEASUREMENT GlwCtl_stHdnPreGlw_mp "" SWORD OneToOne 1 100 -32768.00 32767.00 FORMAT "%8.2" ECU_ADDRESS 0xC0000B6A /end MEASUREMENT
/begin MEASUREMENT GlwCtl_stLampCond_mp "" UBYTE OneToOne 1 100 0.00 255.0 FORMAT "%5.1" ECU_ADDRESS 0xC0000B5A /end MEASUREMENT
/begin MEASUREMENT GlwCtl_stLampEna "" UBYTE OneToOne 1 100 0.00 255.0 FORMAT "%5.1" ECU_ADDRESS 0xD0009029 /end MEASUREMENT
/begin MEASUREMENT GlwCtl_stLogicCond_mp "" UBYTE OneToOne 1 100 0.00 255.0 FORMAT "%5.1" ECU_ADDRESS 0xC0000B6C /end MEASUREMENT
/begin MEASUREMENT GlwCtl_tAir "" SWORD Temp_Cels 1 100 -3549.940 3003.560 FORMAT "%8.3" ECU_ADDRESS 0xD0006F86 /end MEASUREMENT
/begin MEASUREMENT GlwCtl_tClnt "" SWORD Temp_Cels 1 100 -3549.940 3003.560 FORMAT "%8.3" ECU_ADDRESS 0xD0006F88 /end MEASUREMENT
/begin MEASUREMENT GlwCtl_tiClnt_mp "" SWORD Time_ms 1 100 -327680.0 327670.0 FORMAT "%8.1" ECU_ADDRESS 0xC0000B6E /end MEASUREMENT
/begin MEASUREMENT GlwCtl_tiEngPre_mp "" UWORD Time_ms 1 100 0.00 655350.0 FORMAT "%8.1" ECU_ADDRESS 0xC0000B70 /end MEASUREMENT
/begin MEASUREMENT GlwCtl_tiLmp_mp "Ansteuerungszeit der Glühkontrolllampe beim Vorglühen" SWORD Time_ms 1 100 -327680.0 327670.0 FORMAT "%8.1" ECU_ADDRESS 0xC0000B5C /end MEASUREMENT
/begin MEASUREMENT GlwCtl_tiPreGlw_mp "" SWORD Time_ms 1 100 -327680.0 327670.0 FORMAT "%8.1" ECU_ADDRESS 0xC0000B72 /end MEASUREMENT
/begin MEASUREMENT GlwCtl_tiRdyGlw_mp "" SWORD Time_ms 1 100 -327680.0 327670.0 FORMAT "%8.1" ECU_ADDRESS 0xC0000B74 /end MEASUREMENT
/begin MEASUREMENT GlwCtl_tiStrtGlw_mp "" SWORD Time_ms 1 100 -327680.0 327670.0 FORMAT "%8.1" ECU_ADDRESS 0xC0000B76 /end MEASUREMENT
/begin MEASUREMENT GlwPlg_numGlw_mp "" UBYTE OneToOne 1 100 0.00 255.0 FORMAT "%5.1" ECU_ADDRESS 0xC0000B78 /end MEASUREMENT
/begin MEASUREMENT GlwPlg_numPwrOut "" UBYTE OneToOne 1 100 0.00 255.0 FORMAT "%5.1" ECU_ADDRESS 0xD000902B /end MEASUREMENT
/begin MEASUREMENT GlwPlg_pwrGlw "" SWORD Pwr_HiRes 1 100 -32768.00 32767.00 FORMAT "%8.2" ECU_ADDRESS 0xD0006F8A /end MEASUREMENT
/begin MEASUREMENT GlwPlg_stCom_mp "" UBYTE OneToOne 1 100 0.00 255.0 FORMAT "%5.1" ECU_ADDRESS 0xC0000B79 /end MEASUREMENT
/begin MEASUREMENT GlwPlg_stGlw_mp "" UBYTE OneToOne 1 100 0.00 255.0 FORMAT "%5.1" ECU_ADDRESS 0xC0000B7A /end MEASUREMENT
/begin MEASUREMENT HESrv_stMSid "" UBYTE OneToOne 1 100 0.00 255.0 FORMAT "%5.1" ECU_ADDRESS 0xD000902C /end MEASUREMENT
/begin MEASUREMENT HLSDem_dnAccLimCurr_mp "Maximale zulässige Beschleunigung (Motordrehzahl)" FLOAT32_IEEE ISC_dnEng_float 1 100 0.00 12000.0000 FORMAT "%10.4" ECU_ADDRESS 0xC0000B7C /end MEASUREMENT
/begin MEASUREMENT HLSDem_dnDeclLimCurr_mp "Maximale zulässige Verzögerung (Motordrehzahl)" FLOAT32_IEEE ISC_dnEng_float 1 100 -12000.0000 0.00 FORMAT "%10.4" ECU_ADDRESS 0xC0000B80 /end MEASUREMENT
/begin MEASUREMENT HLSDem_InrtDrvTrnCurr_mp "Massenträgheitsmoment von Antriebstarng inkl. Motor" FLOAT32_IEEE ISC_Inirtia_float 1 100 0.00 20.0000000 FORMAT "%10.7" ECU_ADDRESS 0xC0000B84 /end MEASUREMENT
/begin MEASUREMENT HLSDem_InrtEngCurr_mp "Massenträgheitsmoment des Motors" FLOAT32_IEEE ISC_Inirtia_float 1 100 0.00 20.0000000 FORMAT "%10.7" ECU_ADDRESS 0xC0000B88 /end MEASUREMENT
/begin MEASUREMENT HLSDem_InrtVehCurr_mp "Massenträgheitsmoment von gesamt Fahrzeug" FLOAT32_IEEE ISC_Inirtia_float 1 100 0.00 20.0000000 FORMAT "%10.7" ECU_ADDRESS 0xC0000B8C /end MEASUREMENT
/begin MEASUREMENT HLSDem_IWinNegLoCurr_mp "Negatives Fenster für I-Glied unterer Pfad" FLOAT32_IEEE EngN_float 1 100 -6000.00000 6000.00000 FORMAT "%10.5" ECU_ADDRESS 0xC0000B90 /end MEASUREMENT
/begin MEASUREMENT HLSDem_IWinPosLoCurr_mp "positives Fenster für I-Glied unterer Pfad" FLOAT32_IEEE EngN_float 1 100 -6000.00000 6000.00000 FORMAT "%10.5" ECU_ADDRESS 0xC0000B94 /end MEASUREMENT
/begin MEASUREMENT HLSDem_KiLoCurr_mp "Verstärkung I-Glied unterer Pfad" FLOAT32_IEEE ISC_Ki_rpm2Nm_float 1 100 0.00 20.0000000 FORMAT "%10.7" ECU_ADDRESS 0xC0000B98 /end MEASUREMENT
/begin MEASUREMENT HLSDem_KiNegLoCurr_mp "Negative Großsignalverstärkung I-Glied unterer Pfad" FLOAT32_IEEE ISC_Ki_rpm2Nm_float 1 100 0.00 20.0000000 FORMAT "%10.7" ECU_ADDRESS 0xC0000B9C /end MEASUREMENT
/begin MEASUREMENT HLSDem_KiPosLoCurr_mp "aktuelle Großsignalverstärkung (positiv) I-Anteil unterer Pfad" FLOAT32_IEEE ISC_Ki_rpm2Nm_float 1 100 0.00 20.0000000 FORMAT "%10.7" ECU_ADDRESS 0xC0000BA0 /end MEASUREMENT
/begin MEASUREMENT HLSDem_KpHiCurr_mp "Verstärkung P-Glied oberer Pfad" FLOAT32_IEEE ISC_Kp_rpm2Nm_float 1 100 0.00 20.0000000 FORMAT "%10.7" ECU_ADDRESS 0xC0000BA4 /end MEASUREMENT
/begin MEASUREMENT HLSDem_KpLoCurr_mp "Aktuelle Verstärkung P-Glied unterer Pfad" FLOAT32_IEEE ISC_Kp_rpm2Nm_float 1 100 0.00 20.0000000 FORMAT "%10.7" ECU_ADDRESS 0xC0000BA8 /end MEASUREMENT
/begin MEASUREMENT HLSDem_KpNegHiCurr_mp "Negative Großsignalverstärkung P-Glied oberer Pfad" FLOAT32_IEEE ISC_Kp_rpm2Nm_float 1 100 0.00 20.0000000 FORMAT "%10.7" ECU_ADDRESS 0xC0000BAC /end MEASUREMENT
/begin MEASUREMENT HLSDem_KpNegLoCurr_mp "Negative Großsignalverstärkung P-Glied unterer Pfad" FLOAT32_IEEE ISC_Kp_rpm2Nm_float 1 100 0.00 20.0000000 FORMAT "%10.7" ECU_ADDRESS 0xC0000BB0 /end MEASUREMENT
/begin MEASUREMENT HLSDem_KpPosHiCurr_mp "Positive Großsignalverstärkung P-Gllied oberer Pfad" FLOAT32_IEEE ISC_Kp_rpm2Nm_float 1 100 0.00 20.0000000 FORMAT "%10.7" ECU_ADDRESS 0xC0000BB4 /end MEASUREMENT
/begin MEASUREMENT HLSDem_KpPosLoCurr_mp "Positive Großsignalverstärkung P-Glied unterer Pfad" FLOAT32_IEEE ISC_Kp_rpm2Nm_float 1 100 0.00 20.0000000 FORMAT "%10.7" ECU_ADDRESS 0xC0000BB8 /end MEASUREMENT
/begin MEASUREMENT HLSDem_nDiffDelta_mp "" SWORD EngN 1 100 -16384.00 16383.50 FORMAT "%8.2" ECU_ADDRESS 0xC0000BD8 /end MEASUREMENT
/begin MEASUREMENT HLSDem_nHDC_mp "" SWORD EngN 1 100 -16384.00 16383.50 FORMAT "%8.2" ECU_ADDRESS 0xC0000BDA /end MEASUREMENT
/begin MEASUREMENT HLSDem_nLimHi_mp "Anforderung Initialisierungsmoment an den EISGov (bezogen auf den Ausgang)" SWORD EngN 1 100 -16384.00 16383.50 FORMAT "%8.2" ECU_ADDRESS 0xC0000BDC /end MEASUREMENT
/begin MEASUREMENT HLSDem_nMaxTrq "Ausgewählter Temperaturwert für die Berechnung der Höchstdrehzahl" SWORD EngN 1 100 -16384.00 16383.50 FORMAT "%8.2" ECU_ADDRESS 0xD0006F8C /end MEASUREMENT
/begin MEASUREMENT HLSDem_nSetPHi "maximale Motordrehzahl des HLSDem" SWORD EngN 1 100 -16384.00 16383.50 FORMAT "%8.2" ECU_ADDRESS 0xD0006F8E /end MEASUREMENT
/begin MEASUREMENT HLSDem_nSetPHiCo_mp "koordinierte maximale Motordrehzahl" SWORD EngN 1 100 -16384.00 16383.50 FORMAT "%8.2" ECU_ADDRESS 0xC0000BDE /end MEASUREMENT
/begin MEASUREMENT HLSDem_nSetPLo "minimale Motordrehzahl des HLSDem" SWORD EngN 1 100 -16384.00 16383.50 FORMAT "%8.2" ECU_ADDRESS 0xD0006F90 /end MEASUREMENT
/begin MEASUREMENT HLSDem_nSetPLoChrgPmpOld_mp "" SWORD EngN 1 100 -16384.00 16383.50 FORMAT "%8.2" ECU_ADDRESS 0xC0000BE0 /end MEASUREMENT
/begin MEASUREMENT HLSDem_nSetPLoChrgPmp_mp "" SWORD EngN 1 100 -16384.00 16383.50 FORMAT "%8.2" ECU_ADDRESS 0xC0000BE2 /end MEASUREMENT
/begin MEASUREMENT HLSDem_nSetPLoCoEng "Ausgewählter Temperaturwert für die Berechnung der unteren Solldrehzahl" SWORD EngN 1 100 -16384.00 16383.50 FORMAT "%8.2" ECU_ADDRESS 0xD0006F92 /end MEASUREMENT
/begin MEASUREMENT HLSDem_nSetPLoCoEngOld_mp "" SWORD EngN 1 100 -16384.00 16383.50 FORMAT "%8.2" ECU_ADDRESS 0xC0000BE4 /end MEASUREMENT
/begin MEASUREMENT HLSDem_nSetPLoHDCOld_mp "" SWORD EngN 1 100 -16384.00 16383.50 FORMAT "%8.2" ECU_ADDRESS 0xC0000BE6 /end MEASUREMENT
/begin MEASUREMENT HLSDem_nSetPLoHDC_mp "" SWORD EngN 1 100 -16384.00 16383.50 FORMAT "%8.2" ECU_ADDRESS 0xC0000BE8 /end MEASUREMENT
/begin MEASUREMENT HLSDem_nSetPLoLoc0_mp "" SWORD EngN 1 100 -16384.00 16383.50 FORMAT "%8.2" ECU_ADDRESS 0xC0000BEA /end MEASUREMENT
/begin MEASUREMENT HLSDem_nSetPLoLoc2 "Ausgewählter Temperaturwert für die Berechnung des geforderten Ausgangsmoment während des Motorstarts" SWORD EngN 1 100 -16384.00 16383.50 FORMAT "%8.2" ECU_ADDRESS 0xD0006F94 /end MEASUREMENT
/begin MEASUREMENT HLSDem_nSetPLoLocRamp "Koordinierte untere Solldrehzahl" SWORD EngN 1 100 -16384.00 16383.50 FORMAT "%8.2" ECU_ADDRESS 0xD0006F96 /end MEASUREMENT
/begin MEASUREMENT HLSDem_nSetPLoLocRampOld_mp "" SWORD EngN 1 100 -16384.00 16383.50 FORMAT "%8.2" ECU_ADDRESS 0xC0000BEC /end MEASUREMENT
/begin MEASUREMENT HLSDem_nSetPLoOld_mp "" SWORD EngN 1 100 -16384.00 16383.50 FORMAT "%8.2" ECU_ADDRESS 0xC0000BEE /end MEASUREMENT
/begin MEASUREMENT HLSDem_nSetPLoPwrMng "minimale Motordrehzahl des HLSDem" SWORD EngN 1 100 -16384.00 16383.50 FORMAT "%8.2" ECU_ADDRESS 0xD0006F98 /end MEASUREMENT
/begin MEASUREMENT HLSDem_nSetPLoPwrMngOld_mp "" SWORD EngN 1 100 -16384.00 16383.50 FORMAT "%8.2" ECU_ADDRESS 0xC0000BF0 /end MEASUREMENT
/begin MEASUREMENT HLSDem_nSetPLoSec1_mp "" SWORD EngN 1 100 -16384.00 16383.50 FORMAT "%8.2" ECU_ADDRESS 0xC0000BF2 /end MEASUREMENT
/begin MEASUREMENT HLSDem_nSetPLoSec2_mp "" SWORD EngN 1 100 -16384.00 16383.50 FORMAT "%8.2" ECU_ADDRESS 0xC0000BF4 /end MEASUREMENT
/begin MEASUREMENT HLSDem_nSetPLoSec4_mp "" SWORD EngN 1 100 -16384.00 16383.50 FORMAT "%8.2" ECU_ADDRESS 0xC0000BF6 /end MEASUREMENT
/begin MEASUREMENT HLSDem_nSetPLoTemp_mp "untere Leerlaufdrehzahl während der Startphase (t > HLSDem_tiSetPLoWrm)" SWORD EngN 1 100 -16384.00 16383.50 FORMAT "%8.2" ECU_ADDRESS 0xC0000BF8 /end MEASUREMENT
/begin MEASUREMENT HLSDem_nSetPLoTrm "Abgleichswert untere Solldrehzahl" SWORD EngN 1 100 -16384.00 16383.50 FORMAT "%8.2" ECU_ADDRESS 0xD0006F9A /end MEASUREMENT
/begin MEASUREMENT HLSDem_nSetPLoTrm_mp "Abgleich untere Solldrehzahl" SWORD EngN 1 100 -16384.00 16383.50 FORMAT "%8.2" ECU_ADDRESS 0xC0000BFA /end MEASUREMENT
/begin MEASUREMENT HLSDem_PWinNegHiCurr_mp "Negatives Fenster für P-Glied oberer Pfad" FLOAT32_IEEE EngN_float 1 100 -6000.00000 6000.00000 FORMAT "%10.5" ECU_ADDRESS 0xC0000BBC /end MEASUREMENT
/begin MEASUREMENT HLSDem_PWinNegLoCurr_mp "Negatives Fenster für P-Glied für unteren Pfad" FLOAT32_IEEE EngN_float 1 100 -6000.00000 6000.00000 FORMAT "%10.5" ECU_ADDRESS 0xC0000BC0 /end MEASUREMENT
/begin MEASUREMENT HLSDem_PWinPosHiCurr_mp "Postives Fenster für P-Glied oberer Pfad" FLOAT32_IEEE EngN_float 1 100 -6000.00000 6000.00000 FORMAT "%10.5" ECU_ADDRESS 0xC0000BC4 /end MEASUREMENT
/begin MEASUREMENT HLSDem_PWinPosLoCurr_mp "Postives Fenster für P-Glied unterer Pfad" FLOAT32_IEEE EngN_float 1 100 -6000.00000 6000.00000 FORMAT "%10.5" ECU_ADDRESS 0xC0000BC8 /end MEASUREMENT
/begin MEASUREMENT HLSDem_rnEngvVehCurr_mp "Verhältnis Motordrehzahl zu Fahrzeuggeschwindigkeit" FLOAT32_IEEE ISC_rnEng2vVeh_float 1 100 0.00 1000.00000 FORMAT "%10.5" ECU_ADDRESS 0xC0000BCC /end MEASUREMENT
/begin MEASUREMENT HLSDem_stActvHDC "Koordinierte maximale Motordrehzahl" UBYTE OneToOne 1 100 0.00 255.0 FORMAT "%5.1" ECU_ADDRESS 0xD000902D /end MEASUREMENT
/begin MEASUREMENT HLSDem_stSetPHiCo_mp "ausgewählte Drehzahlanforderung für die maximale Motordrehzahl" SWORD HLSDemsSetPHiSel 1 100 1.00000000000 32767.0000000 FORMAT "%13.7" ECU_ADDRESS 0xC0000BFC /end MEASUREMENT
/begin MEASUREMENT HLSDem_stSetPHiFlt_mp "Art der Filterung der maximalen Motordrehzahl" SWORD HLSDemsFltSel 1 100 1.00000000000 32767.0000000 FORMAT "%13.7" ECU_ADDRESS 0xC0000BFE /end MEASUREMENT
/begin MEASUREMENT HLSDem_stSetPLo "Ausgewählte Drehzahlanforderung für die maximale Motordrehzahl" UWORD OneToOne 1 100 0.00 65535.00 FORMAT "%8.2" ECU_ADDRESS 0xD0007666 /end MEASUREMENT
/begin MEASUREMENT HLSDem_stSetPLoTrmActv "Art der Filterung der maximalen Motordrehzahl" UBYTE OneToOne 1 100 0.00 255.0 FORMAT "%5.1" ECU_ADDRESS 0xD000902E /end MEASUREMENT
/begin MEASUREMENT HLSDem_stSetPLoTrmAlw_mp "" UBYTE OneToOne 1 100 0.00 255.0 FORMAT "%5.1" ECU_ADDRESS 0xC0000C00 /end MEASUREMENT
/begin MEASUREMENT HLSDem_tiFltLosTrqEstCurr_mp "Zeitkonstante für die Lastmomentabschätzung (PT1-Glieder)" FLOAT32_IEEE ISC_tiPTsTrqLoss_float 1 100 0.00 60.0000000 FORMAT "%10.7" ECU_ADDRESS 0xC0000BD0 /end MEASUREMENT
/begin MEASUREMENT HLSDem_tiFltnEngCurr_mp "Zeitkonstante für die PT2-Filterung der Motordrehzahl" FLOAT32_IEEE ISC_tiPT2nEng_float 1 100 0.00 60.0000000 FORMAT "%10.7" ECU_ADDRESS 0xC0000BD4 /end MEASUREMENT
/begin MEASUREMENT HLSDem_trqLoLimMax "maximales HLSDem Begrenzungsdrehmoment an den ISC" SWORD Trq 1 100 -3276.800 3276.700 FORMAT "%8.3" ECU_ADDRESS 0xD0006F9E /end MEASUREMENT
/begin MEASUREMENT HLSDem_trqLoLimMin "minimales HLSDem Begrenzungsdrehmoment an den ISC" SWORD Trq 1 100 -3276.800 3276.700 FORMAT "%8.3" ECU_ADDRESS 0xD0006FA0 /end MEASUREMENT
/begin MEASUREMENT HLSDem_trqReq "Anforderung Initialisierungsdrehmoment an den EISGov (bezogen auf den Ausgang)" SWORD Trq 1 100 -3276.800 3276.700 FORMAT "%8.3" ECU_ADDRESS 0xD0006FA2 /end MEASUREMENT
/begin MEASUREMENT HLSDem_trqReqStrt "Anforderung Initialisierungsdrehmoment bis zum Startabwurf an den EISGov (bezogen auf den Ausgang)" SWORD Trq 1 100 -3276.800 3276.700 FORMAT "%8.3" ECU_ADDRESS 0xD0006FA4 /end MEASUREMENT
/begin MEASUREMENT HLSDem_tSetPHi_mp "Ausgewählter Temperaturwert für die Berechnung der Höchstdrehzahl" SWORD Temp_Cels 1 100 -3549.940 3003.560 FORMAT "%8.3" ECU_ADDRESS 0xC0000C02 /end MEASUREMENT
/begin MEASUREMENT HLSDem_tTrqReqStrt_mp "Ausgewählter Temperaturwert für die Berechnung des geforderten Ausgangsdrehmoment während des Motorstarts" SWORD Temp_Cels 1 100 -3549.940 3003.560 FORMAT "%8.3" ECU_ADDRESS 0xC0000C04 /end MEASUREMENT
/begin MEASUREMENT HPUn_dvolPmpMaxCor_mp "Wirkungsgrad korrigiertes physikalisches Maximum des Volumenstroms einer Hochdruckpumpe" SWORD Qp_mm3_sec 1 100 -327680.0 327670.0 FORMAT "%8.1" ECU_ADDRESS 0xC0000C06 /end MEASUREMENT
/begin MEASUREMENT HPUn_dvolPmpMax_mp "Physikalisches Maximum des Volumenstroms einer Hochdruckpumpe" SWORD Qp_mm3_sec 1 100 -327680.0 327670.0 FORMAT "%8.1" ECU_ADDRESS 0xC0000C08 /end MEASUREMENT
/begin MEASUREMENT HPUn_etaPmpFlTemp_mp "Kraftstofftemperaturabhängiger Wirkungsgrad der Hochdruckpumpe" SWORD Eta1 1 100 -256.0000 255.9922 FORMAT "%8.4" ECU_ADDRESS 0xC0000C0A /end MEASUREMENT
/begin MEASUREMENT HPUn_etaPmpMaxAged_mp "maximaler Wirkungsgrad einer gealterten Hochdruckpumpe" SWORD Eta1 1 100 -256.0000 255.9922 FORMAT "%8.4" ECU_ADDRESS 0xC0000C0C /end MEASUREMENT
/begin MEASUREMENT HPUn_numInjQntBal "Maximale Anzahl an Einspritzungen aufgrund der Mengenbilanz der Hochdruckpumpe" UBYTE OneToOne 1 100 0.00 255.0 FORMAT "%5.1" ECU_ADDRESS 0xD000902F /end MEASUREMENT
/begin MEASUREMENT HPUn_pRailDvtFlt_mp "Gefilterte Raildruck Regelabweichung" SWORD Pres_Rail 1 100 -3276.800 2000.000 FORMAT "%5.3" ECU_ADDRESS 0xC0000C14 /end MEASUREMENT
/begin MEASUREMENT HPUn_qBalLim_mp "Begrenzungsmenge auf Grund der Mengenbilanz der Hochdruckpumpe" SWORD InjMass 1 100 -327.6800 327.6700 FORMAT "%8.4" ECU_ADDRESS 0xC0000C0E /end MEASUREMENT
/begin MEASUREMENT HPUn_qFlTempLim_mp "Begrenzungsmenge abhängig der Kraftstofftemperatur" SWORD InjMass 1 100 -327.6800 327.6700 FORMAT "%8.4" ECU_ADDRESS 0xC0000C10 /end MEASUREMENT
/begin MEASUREMENT HPUn_qLim "Begrenzungsmenge der Hochdruckpumpe" SWORD InjMass 1 100 -327.6800 327.6700 FORMAT "%8.4" ECU_ADDRESS 0xD0006FA6 /end MEASUREMENT
/begin MEASUREMENT HPUn_rTransCrS "Übersetzung Hochdruckpumpe zu Kurbelwelle" SWORD TransR 1 100 -327.6800 327.6700 FORMAT "%8.4" ECU_ADDRESS 0xD0006FA8 /end MEASUREMENT
/begin MEASUREMENT HPUn_stNumInjMax_mp "Statusvariable, Mengebilanz der Hochruckpumpe" UBYTE OneToOne 1 100 0.00 255.0 FORMAT "%5.1" ECU_ADDRESS 0xC0000C16 /end MEASUREMENT
/begin MEASUREMENT HPUn_stQntBal_mp "Status der Mengenbilanz der Hochdruckpumpe" UBYTE OneToOne 1 100 0.00 255.0 FORMAT "%5.1" ECU_ADDRESS 0xC0000C12 /end MEASUREMENT
/begin MEASUREMENT HPUn_trqLoss "Momentanforderung der Hochdruckpumpe" SWORD Trq 1 100 -3276.800 3276.700 FORMAT "%8.3" ECU_ADDRESS 0xD0006FAA /end MEASUREMENT
/begin MEASUREMENT I15031_PID1C "OBD Anforderungen für welches das Fahrzeug ausgelegt ist" UWORD OneToOne 1 100 0.00 65535.00 FORMAT "%8.2" ECU_ADDRESS 0xD0007668 /end MEASUREMENT
/begin MEASUREMENT I15031_PID1D "Ort der Lambda Sonden" UBYTE OneToOne 1 100 0.00 255.0 FORMAT "%5.1" ECU_ADDRESS 0xD0009030 /end MEASUREMENT
/begin MEASUREMENT I15031_PID4FA "Konfigurationsinformation des externen Testgeräts. Maximaler Wert des Gleichgewichtsverhältinisses" UBYTE OneToOne 1 100 0.00 255.0 FORMAT "%5.1" ECU_ADDRESS 0xD0009031 /end MEASUREMENT
/begin MEASUREMENT I15031_PID4FB "Konfigurationsinformation des externen Testgeräts. Maximaler Wert der Lambda Sensorspannung" UBYTE OneToOne 1 100 0.00 255.0 FORMAT "%5.1" ECU_ADDRESS 0xD0009032 /end MEASUREMENT
/begin MEASUREMENT I15031_PID4FC "Konfigurationsinformation des externen Testgeräts. Maximaler Wert des Lambda Sensorstromes" UBYTE OneToOne 1 100 0.00 255.0 FORMAT "%5.1" ECU_ADDRESS 0xD0009033 /end MEASUREMENT
/begin MEASUREMENT InjCrv_numInjDes_mp "gewünschte Anzahl an Einspritzungen pro Arbeitsspiel" UBYTE OneToOne 1 100 0.00 255.0 FORMAT "%5.1" ECU_ADDRESS 0xC0000C17 /end MEASUREMENT
/begin MEASUREMENT InjCrv_numInjLim_mp "Erlaubte Anzahl an Einspritzungen" UBYTE OneToOne 1 100 0.00 255.0 FORMAT "%5.1" ECU_ADDRESS 0xC0000C18 /end MEASUREMENT
/begin MEASUREMENT InjCrv_numInjMaxSys "Systembedingte maximal erlaubte Anzahl an Einspritzungen" UBYTE OneToOne 1 100 0.00 255.0 FORMAT "%5.1" ECU_ADDRESS 0xD000908A /end MEASUREMENT
/begin MEASUREMENT InjCrv_numInjRtmLim_mp "Erlaubte Anzahl von Einspritzungen in Abhängigkeit der Drehzahl" UBYTE OneToOne 1 100 0.00 255.0 FORMAT "%5.1" ECU_ADDRESS 0xC0000C19 /end MEASUREMENT
/begin MEASUREMENT InjCrv_stActValMI1_mp "Aktuelle Betriebsart der MI1" UBYTE OneToOne 1 100 0.00 255.0 FORMAT "%5.1" ECU_ADDRESS 0xC0000C1A /end MEASUREMENT
/begin MEASUREMENT InjCrv_stActValPiI1_mp "Aktueller Betriebsmodus der PiI1" UBYTE OneToOne 1 100 0.00 255.0 FORMAT "%5.1" ECU_ADDRESS 0xC0000C1B /end MEASUREMENT
/begin MEASUREMENT InjCrv_stActValPiI2_mp "Aktuelle Betriebsart der PiI2" UBYTE OneToOne 1 100 0.00 255.0 FORMAT "%5.1" ECU_ADDRESS 0xC0000C1C /end MEASUREMENT
/begin MEASUREMENT InjCrv_stDesValMI1_mp "Gewünschter Betriebsmodus der MI1" UBYTE OneToOne 1 100 0.00 255.0 FORMAT "%5.1" ECU_ADDRESS 0xC0000C1D /end MEASUREMENT
/begin MEASUREMENT InjCrv_stDesValPiI1_mp "Gewünschter Betriebsmodus der PiI1" UBYTE OneToOne 1 100 0.00 255.0 FORMAT "%5.1" ECU_ADDRESS 0xC0000C1E /end MEASUREMENT
/begin MEASUREMENT InjCrv_stDesValPiI2_mp "Gewünschter Betriebsmodus der PiI2" UBYTE OneToOne 1 100 0.00 255.0 FORMAT "%5.1" ECU_ADDRESS 0xC0000C1F /end MEASUREMENT
/begin MEASUREMENT InjCrv_stInjCharActVal "Einspritzfreigabestatus" UBYTE OneToOne 1 100 0.00 255.0 FORMAT "%5.1" ECU_ADDRESS 0xD000908B /end MEASUREMENT
/begin MEASUREMENT InjCrv_stInjCharActValPrg "Einspritzfreigabestatus mit Berücksichtigung eines Testereingriffs" UBYTE OneToOne 1 100 0.00 255.0 FORMAT "%5.1" ECU_ADDRESS 0xD000908C /end MEASUREMENT
/begin MEASUREMENT InjCrv_stInjCharDes_mp "Wunscheinspritzverlauf" UBYTE OneToOne 1 100 0.00 255.0 FORMAT "%5.1" ECU_ADDRESS 0xC0000C20 /end MEASUREMENT
/begin MEASUREMENT InjCrv_stInjCharPrio "Prioritätenstatus zur Abschaltung der Einspritzung" ULONG OneToOne 1 100 0.00 4294967295.00 FORMAT "%13.2" ECU_ADDRESS 0xD0004568 /end MEASUREMENT
/begin MEASUREMENT InjCrv_stInjCharPrioTSync "Prioritätenstatus zur Abschaltung von Einspritzungen (t sync)" ULONG OneToOne 1 100 0.00 4294967295.00 FORMAT "%13.2" ECU_ADDRESS 0xD000456C /end MEASUREMENT
/begin MEASUREMENT InjCrv_stInjCharRlsPrgVal "zur Programmierung freigegebene Einspritzungen" UBYTE OneToOne 1 100 0.00 255.0 FORMAT "%5.1" ECU_ADDRESS 0xD000908D /end MEASUREMENT
/begin MEASUREMENT InjCrv_stInjCharSetVal "Einspritzverlauf Sollwert (drehzahlsynchron)" UBYTE OneToOne 1 100 0.00 255.0 FORMAT "%5.1" ECU_ADDRESS 0xD000908E /end MEASUREMENT
/begin MEASUREMENT InjCrv_stInjCharSetValTSync "Einspritzverlauf Sollwert (zeitsynchron)" UBYTE OneToOne 1 100 0.00 255.0 FORMAT "%5.1" ECU_ADDRESS 0xD000908F /end MEASUREMENT
/begin MEASUREMENT InjCrv_stInjCharSetVal_mp "Messpunkt vor dem Ascet Freischnitt" UBYTE OneToOne 1 100 0.00 255.0 FORMAT "%5.1" ECU_ADDRESS 0xC0000C21 /end MEASUREMENT
/begin MEASUREMENT InjCrv_stMI1Rgn "Statusbotschaft für die Freigabe der einzelnen Regenerationsstufen (drehzahlsynchron)" ULONG OneToOne 1 100 0.00 4294967295.00 FORMAT "%13.2" ECU_ADDRESS 0xD0004570 /end MEASUREMENT
/begin MEASUREMENT InjCrv_stMI1RgnTSync "Statusbotschaft für die Freigabe der einzelnen Regenerationsstufen (zeitsynchron)" ULONG OneToOne 1 100 0.00 4294967295.00 FORMAT "%13.2" ECU_ADDRESS 0xD0004574 /end MEASUREMENT
/begin MEASUREMENT InjCrv_stMI1RmpSel "Botschaft für die Auswahl der Faktorisierungskennlinie des Rampenfaktors der MI1" UBYTE OneToOne 1 100 0.00 255.0 FORMAT "%5.1" ECU_ADDRESS 0xD0009090 /end MEASUREMENT
/begin MEASUREMENT InjCrv_stMI1RmpSelTSync "zeitsynchrone Botschaft für die Auswahl der Faktorisirungskennlinie des Rampenfaktors der MI1" UBYTE OneToOne 1 100 0.00 255.0 FORMAT "%5.1" ECU_ADDRESS 0xD0009091 /end MEASUREMENT
/begin MEASUREMENT InjCrv_stPiI1Rgn "Statusbotschaft für die Freigabe der einzelnen Regenerationsstufen (drehzahlsynchron)" ULONG OneToOne 1 100 0.00 4294967295.00 FORMAT "%13.2" ECU_ADDRESS 0xD0004578 /end MEASUREMENT
/begin MEASUREMENT InjCrv_stPiI1RgnTSync "Statusbotschaft für die Freigabe der einzelnen Regenerationsstufen der PiI1" ULONG OneToOne 1 100 0.00 4294967295.00 FORMAT "%13.2" ECU_ADDRESS 0xD000457C /end MEASUREMENT
/begin MEASUREMENT InjCrv_stPiI1RmpSel "Botschaft für die Auswahl der Faktorisierungskennlinie des Rampenfaktors der PiI1" UBYTE OneToOne 1 100 0.00 255.0 FORMAT "%5.1" ECU_ADDRESS 0xD0009092 /end MEASUREMENT
/begin MEASUREMENT InjCrv_stPiI1RmpSelTSync "zeitsynchrone Botschaft für die Auswahl der Faktorisirungskennlinie des Rampenfaktors der PiI1" UBYTE OneToOne 1 100 0.00 255.0 FORMAT "%5.1" ECU_ADDRESS 0xD0009093 /end MEASUREMENT
/begin MEASUREMENT InjCrv_stPiI2Rgn "Statusbotschaft für die Freigabe der einzelnen Regenerationsstufen (drehzahlsynchron)" ULONG OneToOne 1 100 0.00 4294967295.00 FORMAT "%13.2" ECU_ADDRESS 0xD0004580 /end MEASUREMENT
/begin MEASUREMENT InjCrv_stPiI2RgnTSync "Statusbotschaft für die Freigabe der einzelnen Regenerationsstufen der PiI2" ULONG OneToOne 1 100 0.00 4294967295.00 FORMAT "%13.2" ECU_ADDRESS 0xD0004584 /end MEASUREMENT
/begin MEASUREMENT InjCrv_stPiI2RmpSel "Botschaft für die Auswahl der Faktorisierungskennlinie des Rampenfaktors der PiI2" UBYTE OneToOne 1 100 0.00 255.0 FORMAT "%5.1" ECU_ADDRESS 0xD0009094 /end MEASUREMENT
/begin MEASUREMENT InjCrv_stPiI2RmpSelTSync "zeitsynchrone Botschaft für die Auswahl der Faktorisirungskennlinie des Rampenfaktors der PiI2" UBYTE OneToOne 1 100 0.00 255.0 FORMAT "%5.1" ECU_ADDRESS 0xD0009095 /end MEASUREMENT
/begin MEASUREMENT InjCrv_stPiI3Rgn "Statuswort für die Freigabe der einzelnen Regenerationsstufen für die PiI3" ULONG OneToOne 1 100 0.00 4294967295.00 FORMAT "%13.2" ECU_ADDRESS 0xD0004588 /end MEASUREMENT
/begin MEASUREMENT InjCrv_stPiI3RgnTSync "Statusbotschaft für die Freigabe der einzelnen Regenerationsstufen (zeitsynchron)" ULONG OneToOne 1 100 0.00 4294967295.00 FORMAT "%13.2" ECU_ADDRESS 0xD000458C /end MEASUREMENT
/begin MEASUREMENT InjCrv_stPiIRlsRaw_mp "Freigabestruktur der Voreinspritzung vor zusätzlichen Korrekturen" SWORD OneToOne 1 100 -32768.00 32767.00 FORMAT "%8.2" ECU_ADDRESS 0xC0000C22 /end MEASUREMENT
/begin MEASUREMENT InjCrv_stPiIRlsStruct_mp "Freigabestruktur der Voreinspritzungen" UBYTE OneToOne 1 100 0.00 255.0 FORMAT "%5.1" ECU_ADDRESS 0xC0000C24 /end MEASUREMENT
/begin MEASUREMENT InjCrv_stPoI1Rgn "Statusbotschaft für die Freigabe der einzelnen Regenerationsstufen (drehzahlsynchron)" ULONG OneToOne 1 100 0.00 4294967295.00 FORMAT "%13.2" ECU_ADDRESS 0xD0004590 /end MEASUREMENT
/begin MEASUREMENT InjCrv_stPoI1RgnTSync "Statusbotschaft für die Freigabe der einzelnen Regenerationsstufen (zeitsynchron)" ULONG OneToOne 1 100 0.00 4294967295.00 FORMAT "%13.2" ECU_ADDRESS 0xD0004594 /end MEASUREMENT
/begin MEASUREMENT InjCrv_stPoI1RmpSel "Botschaft für die Auswahl der Faktorisierungskennlinie des Rampenfaktors der PoI1" UBYTE OneToOne 1 100 0.00 255.0 FORMAT "%5.1" ECU_ADDRESS 0xD0009096 /end MEASUREMENT
/begin MEASUREMENT InjCrv_stPoI1RmpSelTSync "zeitsynchrone Botschaft für die Auswahl der Faktorisirungskennlinie des Rampenfaktors der PoI1" UBYTE OneToOne 1 100 0.00 255.0 FORMAT "%5.1" ECU_ADDRESS 0xD0009097 /end MEASUREMENT
/begin MEASUREMENT InjCrv_stPoI2NrmMode "Status der betriebpunkabhängigen Freigabe der PoI2 im Normalbetrieb (drehzahlsynchron)" UBYTE OneToOne 1 100 0.00 255.0 FORMAT "%5.1" ECU_ADDRESS 0xD0009099 /end MEASUREMENT
/begin MEASUREMENT InjCrv_stPoI2NrmModeTSync "" UBYTE OneToOne 1 100 0.00 255.0 FORMAT "%5.1" ECU_ADDRESS 0xD000909A /end MEASUREMENT
/begin MEASUREMENT InjCrv_stPoI2Rgn "Statusbotschaft für die Freigabe der einzelnen Regenerationsstufen (drehzahlsynchron)" ULONG OneToOne 1 100 0.00 4294967295.00 FORMAT "%13.2" ECU_ADDRESS 0xD0004598 /end MEASUREMENT
/begin MEASUREMENT InjCrv_stPoI2RgnTSync "Statusbotschaft für die Freigabe der einzelnen Regenerationsstufen (zeitsynchron)" ULONG OneToOne 1 100 0.00 4294967295.00 FORMAT "%13.2" ECU_ADDRESS 0xD000459C /end MEASUREMENT
/begin MEASUREMENT InjCrv_stPoI2RmpSel "Botschaft für die Auswahl der Faktorisierungskennlinie des Rampenfaktors der PoI2" UBYTE OneToOne 1 100 0.00 255.0 FORMAT "%5.1" ECU_ADDRESS 0xD000909B /end MEASUREMENT
/begin MEASUREMENT InjCrv_stPoI2RmpSelTSync "zeitsynchrone Botschaft für die Auswahl der Faktorisirungskennlinie des Rampenfaktors der PoI2" UBYTE OneToOne 1 100 0.00 255.0 FORMAT "%5.1" ECU_ADDRESS 0xD000909C /end MEASUREMENT
/begin MEASUREMENT InjCrv_swtPiIDblCorMap "Schalter für PiI1-Korrekturberechnung mit verdoppeltem Kennfeldsatz" UBYTE OneToOne 1 100 0.00 255.0 FORMAT "%5.1" ECU_ADDRESS 0xD000909D /end MEASUREMENT
/begin FUNCTION Fan_DD ""
 /begin DEF_CHARACTERISTIC Fan_4WinSigDur.tiErr1Min_C Fan_4WinSigDur.tiErr1Max_C Fan_4WinSigDur.tiErr2Min_C Fan_4WinSigDur.tiErr2Max_C Fan_4WinSigDur.tiErr3Min_C Fan_4WinSigDur.tiErr3Max_C Fan_4WinSigDur.tiErr4Min_C Fan_4WinSigDur.tiErr4Max_C Fan_Pwm.tiPer_C Fan_Pwm.stLvl_C Fan_Pwm.rMaxDty_C Fan_Pwm.rPerUn_C Fan_Pwm.tiPh_C Fan_PwmOut.rMin_C Fan_PwmOut.rMax_C Fan_PwmOut.tiBtwTstSCB_C Fan_PwmOut.tiBtwTstOT_C Fan_PwmOut.numTstMax_C Fan_PwmOut.swtBattCor_C Fan_PwmOut.swtPsInv_C Fan_rCnv_CUR Fan_rPsDisbl_C Fan_stPsDiaDisbl_C Fan_stPsDisbl_C Fan_typ4WinDia_C /end DEF_CHARACTERISTIC
 /begin IN_MEASUREMENT BattU_facCor DevLib_stPwrStgEnaCond FanCtl_stAftRun /end IN_MEASUREMENT
 /begin OUT_MEASUREMENT Fan_r Fan_rPs /end OUT_MEASUREMENT
 /begin LOC_MEASUREMENT Fan_rCalc_mp Fan_rCor_mp Fan_stErrMsg_mp /end LOC_MEASUREMENT
/end FUNCTION
/begin FUNCTION FBC_Equal ""
 /begin DEF_CHARACTERISTIC FBC_BPFac.NumLo_CA FBC_BPFac.NumHi_CA FBC_BPFac.Den1_CA FBC_BPFac.Den2_CA FBC_BPFac1NumG_CUR FBC_ctPhComp_C FBC_ctSegOffset_C FBC_ctTDCOfs_C FBC_dqThresSurge_C FBC_dSegNhiCaS_CA FBC_dSegNloCaS_CA FBC_dSyn_C FBC_facBPRedNum_C FBC_fSurge_CUR FBC_GvrnI.Ki_C FBC_GvrnI.KiPos_C FBC_GvrnI.KiNeg_C FBC_GvrnI.WinPos_C FBC_GvrnI.WinNeg_C FBC_GvrnP.Kp_C FBC_GvrnP.KpPos_C FBC_GvrnP.KpNeg_C FBC_GvrnP.WinPos_C FBC_GvrnP.WinNeg_C FBC_nCtlOfsMin_C FBC_nCtlThresMax_C FBC_nGvrnOfsMin_C FBC_nGvrnThresMax_C FBC_nHyst_C FBC_nSurgeOffset_C FBC_qCtlOfsMax_C FBC_qCtlThresMin_C FBC_qGvrnThresMax_CUR FBC_qGvrnThresMin_C FBC_qLimDia_C FBC_qLim_CUR FBC_qRCLim_C FBC_qRC_CA FBC_stOpModeFrz_C FBC_stOpModeInhib_C FBC_swtInitI_C FBC_swtRC_C /end DEF_CHARACTERISTIC
 /begin REF_CHARACTERISTIC FBC_nThresFbc_C /end REF_CHARACTERISTIC
 /begin IN_MEASUREMENT Clth_st CoEng_st CoEng_stTst CoEOM_stOpModeAct EpmCrS_numSeg EpmCrS_tiSeg Epm_nEng Epm_numCyl FBC_WheelLrnOut InjCtl_qSetUnBal PthSet_stOvrRunCoord PT_rTrq PT_stGrip SpdGov_nSetPLo /end IN_MEASUREMENT
 /begin OUT_MEASUREMENT FBC_ctSegInt FBC_dBPSum FBC_qArr FBC_qDvtCyl FBC_qDvtCylPhys FBC_qLimAct FBC_qLimIncr FBC_stActive /end OUT_MEASUREMENT
 /begin LOC_MEASUREMENT FBC_dBPCaS FBC_dBPCaSOld_mp FBC_facBPNum_mp FBC_facSegVal_mp FBC_nMaxOvrRun_mp FBC_q FBC_qIntegrator_mp FBC_qSet FBC_qSetOld_mp FBC_stBPRedNum_mp FBC_stEqualInit FBC_stRegionSRCtl_mp /end LOC_MEASUREMENT
/end FUNCTION
/begin FUNCTION FBC_WheelLrn ""
 /begin DEF_CHARACTERISTIC FBC_ActESpP_C FBC_DXAdapLo_C FBC_DXAdapUp_C FBC_DXalf0_C FBC_nLrnThres_CA FBC_nThresFbc_C FBC_TFConst_C FBC_TFLrnConst_C FBC_ThresDyn_C /end DEF_CHARACTERISTIC
 /begin REF_CHARACTERISTIC FBC_nCtlThresMax_C FBC_nGvrnOfsMin_C FBC_nHyst_C /end REF_CHARACTERISTIC
 /begin IN_MEASUREMENT CoEng_st EpmCrS_numSeg EpmSyn_phiInt Epm_nEng Epm_numCyl FBC_stEqualInit PthSet_stOvrRunCoord SpdGov_nSetPLo /end IN_MEASUREMENT
 /begin OUT_MEASUREMENT FBC_AAIn FBC_Badpt FBC_numAASeg FBC_WheelLrnOut /end OUT_MEASUREMENT
 /begin LOC_MEASUREMENT FBC_AACoef_mp FBC_AAInSum_mp FBC_AAOrd_mp FBC_AAOut_mp FBC_AAPhiAbs_mp FBC_AAPhiLen_mp FBC_AnglePerSegmentEDC_mp FBC_AnglePerSegmentPhys_mp FBC_AngleRes_mp FBC_DXAdap_mp FBC_DXSfn_mp FBC_DXSfp_mp FBC_DXSf_mp FBC_DXSl_mp FBC_DXS_mp FBC_dynSpd_mp FBC_EpmSynPhiInt_mp FBC_RegionChng FBC_stBufSeg_mp FBC_stBufSubSeg_mp FBC_stLearn FBC_stRegionESpP_mp FBC_stStateESpP_mp FBC_TSmCoef_mp FBC_WheelLrnOutOld_mp /end LOC_MEASUREMENT
/end FUNCTION
/begin FUNCTION Flash "" /begin SUB_FUNCTION FlashHndl IfxFlash Stm58Bw016 Amd29bdd160 Amd29bdd320 /end SUB_FUNCTION /end FUNCTION
/begin FUNCTION FlashHndl "" /end FUNCTION
/begin FUNCTION FlFlt_dd "" /begin DEF_CHARACTERISTIC FlFlt_Deb.tiHiLo_C FlFlt_Deb.tiLoHi_C FlFlt_swtSensPrs_C /end DEF_CHARACTERISTIC /begin OUT_MEASUREMENT FlFlt_stRaw /end OUT_MEASUREMENT /end FUNCTION
/begin FUNCTION FlFlt_vd "" /begin IN_MEASUREMENT CoEng_st /end IN_MEASUREMENT /begin OUT_MEASUREMENT FlFlt_st /end OUT_MEASUREMENT /end FUNCTION
/begin FUNCTION FlSys_CalcCnvFac "" /begin DEF_CHARACTERISTIC FlSys_rhoFl_C FlSys_rhoFl_CUR /end DEF_CHARACTERISTIC /begin IN_MEASUREMENT FuelT_t /end IN_MEASUREMENT /begin OUT_MEASUREMENT FlSys_rhoFl /end OUT_MEASUREMENT /end FUNCTION
/begin FUNCTION FlSys_Deflate ""
 /begin DEF_CHARACTERISTIC FlSys_nDeflateMax_C FlSys_nDeflateMin_C FlSys_pDeflate_C FlSys_tiDeflateDel_C /end DEF_CHARACTERISTIC
 /begin LOC_MEASUREMENT FlSys_stDeflate_mp /end LOC_MEASUREMENT
/end FUNCTION
/begin FUNCTION FlSys_FlCons ""
 /begin DEF_CHARACTERISTIC FlSys_dqSubsRgn.Pos_C FlSys_dqSubsRgn.Neg_C FlSys_facFlConsAdjDfl_C FlSys_facFlConsAdjMax_C FlSys_facFlConsAdjMin_C FlSys_qSubs_MAP FlSys_rhoFuel_C FlSys_stSubsRgnMsk_C /end DEF_CHARACTERISTIC
 /begin IN_MEASUREMENT ActMod_trq Epm_nEng /end IN_MEASUREMENT
 /begin OUT_MEASUREMENT FlSys_dvolFlCons FlSys_volFlCons FlSys_volTotFlCons /end OUT_MEASUREMENT
 /begin LOC_MEASUREMENT FlSys_dvolPerStroke_mp FlSys_facFlConsAdj_mp FlSys_qSubs_mp FlSys_qSum_mp FlSys_volFlConsAdj_mp /end LOC_MEASUREMENT
/end FUNCTION
/begin FUNCTION fma_adapt "" /end FUNCTION
/begin FUNCTION frmappl_co ""
 /begin DEF_CHARACTERISTIC Com_RawMuxValId_C Com_RawValIdA_C Com_RawValIdB_C Com_RawValIdC_C Com_RawValIdD_C Com_SelfRecID_C /end DEF_CHARACTERISTIC
 /begin OUT_MEASUREMENT Com_stSelfRec /end OUT_MEASUREMENT
 /begin LOC_MEASUREMENT Com_RawMuxVal_mp Com_RawValA_mp Com_RawValB_mp Com_RawValC_mp Com_RawValD_mp Com_RawValIdA_mp Com_RawValIdB_mp Com_RawValIdC_mp Com_RawValIdD_mp Com_SelfRecCtr_mp Com_SelfRecID_mp Com_SelfRecSt_mp Com_SelfRecTmr_mp Com_stTxEvent Com_test1_mp Com_test2_mp Com_test3_mp Com_test4_mp /end LOC_MEASUREMENT
/end FUNCTION
/begin FUNCTION fuelt_dd "" /begin DEF_CHARACTERISTIC FuelT_SRC.uMin_C FuelT_SRC.uMax_C FuelT_tTransf_CUR /end DEF_CHARACTERISTIC /begin OUT_MEASUREMENT FuelT_tSens FuelT_uRaw /end OUT_MEASUREMENT /end FUNCTION
/begin FUNCTION fuelt_vd ""
 /begin DEF_CHARACTERISTIC FuelT_RmpSlp.Pos_C FuelT_RmpSlp.Neg_C FuelT_swtSensPrs_C FuelT_swtTempSel_C FuelT_tDflFlSys_C FuelT_tiLPFiltPT1_C FuelT_TransStg.Dfl_C FuelT_TransStg.stSensId_C /end DEF_CHARACTERISTIC
 /begin IN_MEASUREMENT CEngDsT_t /end IN_MEASUREMENT
 /begin OUT_MEASUREMENT FuelT_t FuelT_tFlSys /end OUT_MEASUREMENT
/end FUNCTION
/begin FUNCTION GbxECU_Can ""
 /begin DEF_CHARACTERISTIC Com_swtGearboxData2_C Com_swtGearboxData_C Com_swtTrqDemandGbx_C /end DEF_CHARACTERISTIC
/end FUNCTION
/begin FUNCTION GbxECU_co "" /begin DEF_CHARACTERISTIC Com_stGear_C Com_trqGbxMaxSubs_C /end DEF_CHARACTERISTIC
 /begin OUT_MEASUREMENT Com_dTrqDemandGbxCHK Com_dTrqDemandGbxCTR Com_nTSC Com_rTrq Com_stClth Com_stClthRaw Com_stGbxOBD Com_stGear Com_stTrqGbxDes Com_stTrqGbxLim Com_stTSC Com_tGbxOil Com_trqGbxDes Com_trqGbxFrc Gbx_trqTIIDes Gbx_trqTSCIntv /end OUT_MEASUREMENT
 /begin LOC_MEASUREMENT Com_trqGbxMaxRaw Gbx_trqPrt /end LOC_MEASUREMENT
/end FUNCTION
/begin FUNCTION GbxNPos_DD ""
 /begin DEF_CHARACTERISTIC GbxNPos_dcycPwmInMax_C GbxNPos_dcycPwmInMin_C GbxNPos_tiPerMax_C GbxNPos_tiPerPwmInMax_C GbxNPos_tiPerPwmInMin_C Gbx_NPosDeb.tiHiLo_C Gbx_NPosDeb.tiLoHi_C Gbx_swtSigNPos_C /end DEF_CHARACTERISTIC
 /begin OUT_MEASUREMENT Gbx_stNPosRaw /end OUT_MEASUREMENT
 /begin LOC_MEASUREMENT GbxNPos_tiPer_mp /end LOC_MEASUREMENT
/end FUNCTION
/begin FUNCTION GbxNPos_VD "" /begin DEF_CHARACTERISTIC GbxNPos_rTransfNPos_CUR Gbx_stNPosDfl_C /end DEF_CHARACTERISTIC /begin OUT_MEASUREMENT Gbx_dNPos Gbx_stNPos /end OUT_MEASUREMENT /begin LOC_MEASUREMENT GbxNPos_rRawNPos /end LOC_MEASUREMENT /end FUNCTION
/begin FUNCTION glbda_lsum "" /begin DEF_CHARACTERISTIC GlbDa_facDstCnt_C GlbDa_lDstLim_C /end DEF_CHARACTERISTIC /begin IN_MEASUREMENT CoEng_st GlbDa_vX /end IN_MEASUREMENT /begin OUT_MEASUREMENT GlbDa_lTotDst /end OUT_MEASUREMENT
 /begin LOC_MEASUREMENT GlbDa_lDstLim_mp GlbDa_lInt_mp GlbDa_lTotDstLoc2_mp GlbDa_vXLoc1_mp /end LOC_MEASUREMENT
/end FUNCTION
/begin FUNCTION glbda_setdata ""
 /begin DEF_CHARACTERISTIC GlbDa_aX_C GlbDa_lWhlCirc_C GlbDa_pEnv_C GlbDa_tEnv_C GlbDa_tiFltAX_C GlbDa_tiFltVX_C GlbDa_tIndAir_C GlbDa_vX_C /end DEF_CHARACTERISTIC
 /begin IN_MEASUREMENT CACDsT_t EnvP_p EnvT_t EnvT_tMod VehV_a VehV_v /end IN_MEASUREMENT
 /begin OUT_MEASUREMENT GlbDa_aX GlbDa_aXFlt GlbDa_lWhlCirc GlbDa_pEnv GlbDa_tEnv GlbDa_tEnvMod GlbDa_tIndAir GlbDa_vX GlbDa_vXFlt /end OUT_MEASUREMENT
/end FUNCTION
/begin FUNCTION glbda_trqdem ""
 /begin DEF_CHARACTERISTIC GlbDa_stIARlsVeh_C GlbDa_stVehLimMin_C GlbDa_trqVehLimMin_C /end DEF_CHARACTERISTIC
 /begin IN_MEASUREMENT CoPT_stIARls CoVeh_trqPrpLimErr CoVM_stIARls Prp_stIARls PT_rTrq PT_stIARls PT_stTraIntv PT_trqLos PT_trqTraPrt SpdGov_st VehMot_stIARls VehMot_stLimDfftl VehMot_stPrpAccPed VehMot_stPrpCrCtl VehMot_stPrpLLim VehMot_stStabIntv VehMot_trqPrtDfftl /end IN_MEASUREMENT
 /begin OUT_MEASUREMENT GlbDa_stIARlsVeh GlbDa_stTrqDem GlbDa_stVehLimMin GlbDa_trqVehLimMin /end OUT_MEASUREMENT
/end FUNCTION
/begin FUNCTION GlwCtl_ActrCtl ""
 /begin DEF_CHARACTERISTIC GlwCtl_nLamp_C GlwCtl_tiLampEng_C GlwCtl_tiLampPAir_CUR GlwCtl_tiLamptClnt_CUR GlwCtl_tiLampUBatt_CUR GlwCtl_tiPSync_C /end DEF_CHARACTERISTIC
 /begin IN_MEASUREMENT BattU_u EnvP_p Epm_nEng GlwCtl_stGlw GlwCtl_stLampEna GlwCtl_tClnt GlwLmp_st /end IN_MEASUREMENT
 /begin LOC_MEASUREMENT GlwCtl_stLampCond_mp GlwCtl_tiLmp_mp /end LOC_MEASUREMENT
/end FUNCTION
/begin FUNCTION GlwCtl_PwrCtl ""
 /begin DEF_CHARACTERISTIC GlwCtl_rLimitClnt_CUR GlwCtl_rLimitNM_MAP GlwCtl_rMaxOff_C GlwCtl_rMaxStdby_C GlwCtl_rMax_C GlwCtl_rPwrClnt_CUR GlwCtl_rPwrNM_MAP GlwCtl_rPwrPAir_CUR GlwCtl_rPwrTAir_CUR GlwCtl_rStart_CUR GlwCtl_rThresGlwOn_C GlwCtl_rThresOff_C GlwCtl_tAirSel_C GlwCtl_tiMaxOn_C GlwCtl_tiStdby_C /end DEF_CHARACTERISTIC
 /begin IN_MEASUREMENT AirSys_tFld CoETS_trqInrCurr EnvP_p Epm_nEng GlwCtl_tClnt GlwPlg_numPwrOut /end IN_MEASUREMENT
 /begin OUT_MEASUREMENT GlwCtl_tAir /end OUT_MEASUREMENT
 /begin LOC_MEASUREMENT GlwCtl_rLimitRaw_mp GlwCtl_rLimit_mp GlwCtl_rRaw_mp /end LOC_MEASUREMENT
/end FUNCTION
/begin FUNCTION GlwCtl_Stm ""
 /begin DEF_CHARACTERISTIC GlwCtl_ctPreGlwErr_C GlwCtl_ctPreGlw_C GlwCtl_nEngPre_C GlwCtl_stHdnPreGlwMsk1_C GlwCtl_stHdnPreGlwMsk2_C GlwCtl_stHdnPreGlwMskT1_C GlwCtl_stLampEnaMsk_C GlwCtl_tDflClnt_C GlwCtl_tEngSel_C GlwCtl_tiDebConvSig_C GlwCtl_tiDebEpmPre_C GlwCtl_tiNoEngSpd_C GlwCtl_tiPre_CUR GlwCtl_tiReady_C GlwCtl_tiStrt_C GlwCtl_tiWaitforTemp_C GlwCtl_tLimHigh_C GlwCtl_tLimLow_C GlwCtl_tStrt_C /end DEF_CHARACTERISTIC
 /begin IN_MEASUREMENT Brk_st Clth_st CoEng_st Com_stDrWghSeat Com_stKeyVld Com_stTRadio Com_swtDrBltb Epm_nEng T15_st T50_st /end IN_MEASUREMENT
 /begin OUT_MEASUREMENT GlwCtl_stGlw GlwCtl_stLampEna GlwCtl_tClnt /end OUT_MEASUREMENT
 /begin LOC_MEASUREMENT Com_stCtrPCos GlwCtl_ctPreGlw_mp GlwCtl_stHdnPreGlwOld_mp GlwCtl_stHdnPreGlwTrg_mp GlwCtl_stHdnPreGlw_mp GlwCtl_stLogicCond_mp GlwCtl_tiClnt_mp GlwCtl_tiEngPre_mp GlwCtl_tiPreGlw_mp GlwCtl_tiRdyGlw_mp GlwCtl_tiStrtGlw_mp /end LOC_MEASUREMENT
/end FUNCTION
/begin FUNCTION GlwPlg_DD ""
 /begin DEF_CHARACTERISTIC GlwPlg_numBstMax_C GlwPlg_numItmMax_C GlwPlg_tiNewSt_C GlwPlg_tiOut_C GlwPlg_tiRst_C /end DEF_CHARACTERISTIC
 /begin IN_MEASUREMENT Epm_numCyl /end IN_MEASUREMENT
 /begin OUT_MEASUREMENT GlwPlg_numPwrOut GlwPlg_pwrGlw /end OUT_MEASUREMENT
 /begin LOC_MEASUREMENT GlwPlg_numGlw_mp GlwPlg_stCom_mp GlwPlg_stGlw_mp /end LOC_MEASUREMENT
/end FUNCTION
/begin FUNCTION Gpta "" /end FUNCTION
/begin FUNCTION HESrv_Lib "" /begin DEF_CHARACTERISTIC HESrv_swtPOpVis_C HESrv_swtScndFlwActv_C /end DEF_CHARACTERISTIC /begin IN_MEASUREMENT Epm_numCyl /end IN_MEASUREMENT /end FUNCTION
/begin FUNCTION HESrv_MacroDef "" /end FUNCTION
/begin FUNCTION HESrv_MSid "" /begin OUT_MEASUREMENT HESrv_stMSid /end OUT_MEASUREMENT /end FUNCTION
/begin FUNCTION HLSDem_SelectParameter ""
 /begin DEF_CHARACTERISTIC HLSDem_CldClthdnAccLim_C HLSDem_CldClthdnDeclLim_C HLSDem_CldClthILo.Ki_C HLSDem_CldClthILo.KiPos_C HLSDem_CldClthILo.KiNeg_C HLSDem_CldClthILo.WinPos_C HLSDem_CldClthILo.WinNeg_C HLSDem_CldClthInrtDrvTrn_C HLSDem_CldClthInrtEng_C HLSDem_CldClthInrtVeh_C HLSDem_CldClthPLo.Kp_C HLSDem_CldClthPLo.KpPos_C HLSDem_CldClthPLo.KpNeg_C HLSDem_CldClthPLo.WinPos_C HLSDem_CldClthPLo.WinNeg_C HLSDem_CldClthrnEngvVeh_C HLSDem_CldClthtiFltLosTrqEst_C HLSDem_CldClthtiFltnEng_C HLSDem_CldGeardnAccLim_C HLSDem_CldGeardnDeclLim_C HLSDem_CldGearInrtDrvTrn_C HLSDem_CldGearInrtEng_C HLSDem_CldGearInrtVeh_C HLSDem_CldGearPLo.Kp_C HLSDem_CldGearPLo.KpPos_C HLSDem_CldGearPLo.KpNeg_C HLSDem_CldGearPLo.WinPos_C HLSDem_CldGearPLo.WinNeg_C HLSDem_CldGeartiFltLosTrqEst_C HLSDem_CldGeartiFltnEng_C HLSDem_Gear1dnAccLim_C HLSDem_Gear1dnDeclLim_C HLSDem_Gear1InrtDrvTrn_C HLSDem_Gear1InrtEng_C HLSDem_Gear1InrtVeh_C HLSDem_Gear1PLo.Kp_C HLSDem_Gear1PLo.KpPos_C HLSDem_Gear1PLo.KpNeg_C HLSDem_Gear1PLo.WinPos_C HLSDem_Gear1PLo.WinNeg_C HLSDem_Gear1rnEngvVeh_C HLSDem_Gear1tiFltLosTrqEst_C HLSDem_Gear1tiFltnEng_C HLSDem_Gear2dnAccLim_C HLSDem_Gear2dnDeclLim_C HLSDem_Gear2InrtDrvTrn_C HLSDem_Gear2InrtEng_C HLSDem_Gear2InrtVeh_C HLSDem_Gear2PLo.Kp_C HLSDem_Gear2PLo.KpPos_C HLSDem_Gear2PLo.KpNeg_C HLSDem_Gear2PLo.WinPos_C HLSDem_Gear2PLo.WinNeg_C HLSDem_Gear2rnEngvVeh_C HLSDem_Gear2tiFltLosTrqEst_C HLSDem_Gear2tiFltnEng_C HLSDem_Gear3dnAccLim_C HLSDem_Gear3dnDeclLim_C HLSDem_Gear3InrtDrvTrn_C HLSDem_Gear3InrtEng_C HLSDem_Gear3InrtVeh_C HLSDem_Gear3PLo.Kp_C HLSDem_Gear3PLo.KpPos_C HLSDem_Gear3PLo.KpNeg_C HLSDem_Gear3PLo.WinPos_C HLSDem_Gear3PLo.WinNeg_C HLSDem_Gear3rnEngvVeh_C HLSDem_Gear3tiFltLosTrqEst_C HLSDem_Gear3tiFltnEng_C HLSDem_Gear4dnAccLim_C HLSDem_Gear4dnDeclLim_C HLSDem_Gear4InrtDrvTrn_C HLSDem_Gear4InrtEng_C HLSDem_Gear4InrtVeh_C HLSDem_Gear4PLo.Kp_C HLSDem_Gear4PLo.KpPos_C HLSDem_Gear4PLo.KpNeg_C HLSDem_Gear4PLo.WinPos_C HLSDem_Gear4PLo.WinNeg_C HLSDem_Gear4rnEngvVeh_C HLSDem_Gear4tiFltLosTrqEst_C HLSDem_Gear4tiFltnEng_C HLSDem_Gear5dnAccLim_C HLSDem_Gear5dnDeclLim_C HLSDem_Gear5InrtDrvTrn_C HLSDem_Gear5InrtEng_C HLSDem_Gear5InrtVeh_C HLSDem_Gear5PLo.Kp_C HLSDem_Gear5PLo.KpPos_C HLSDem_Gear5PLo.KpNeg_C HLSDem_Gear5PLo.WinPos_C HLSDem_Gear5PLo.WinNeg_C HLSDem_Gear5rnEngvVeh_C HLSDem_Gear5tiFltLosTrqEst_C HLSDem_Gear5tiFltnEng_C HLSDem_Gear6dnAccLim_C HLSDem_Gear6dnDeclLim_C HLSDem_Gear6InrtDrvTrn_C HLSDem_Gear6InrtEng_C HLSDem_Gear6InrtVeh_C HLSDem_Gear6PLo.Kp_C HLSDem_Gear6PLo.KpPos_C HLSDem_Gear6PLo.KpNeg_C HLSDem_Gear6PLo.WinPos_C HLSDem_Gear6PLo.WinNeg_C HLSDem_Gear6rnEngvVeh_C HLSDem_Gear6tiFltLosTrqEst_C HLSDem_Gear6tiFltnEng_C HLSDem_Gear7dnAccLim_C HLSDem_Gear7dnDeclLim_C HLSDem_Gear7InrtDrvTrn_C HLSDem_Gear7InrtEng_C HLSDem_Gear7InrtVeh_C HLSDem_Gear7PLo.Kp_C HLSDem_Gear7PLo.KpPos_C HLSDem_Gear7PLo.KpNeg_C HLSDem_Gear7PLo.WinPos_C HLSDem_Gear7PLo.WinNeg_C HLSDem_Gear7rnEngvVeh_C HLSDem_Gear7tiFltLosTrqEst_C HLSDem_Gear7tiFltnEng_C HLSDem_GearILo.Ki_C HLSDem_GearILo.KiPos_C HLSDem_GearILo.KiNeg_C HLSDem_GearILo.WinPos_C HLSDem_GearILo.WinNeg_C HLSDem_nOfsUndrBrk_C HLSDem_numCfgISC_C HLSDem_numTemp_C HLSDem_stParSetRevGear_C HLSDem_trqLoLimMin_C HLSDem_tTempHysHi_C HLSDem_tTempHysLo_C HLSDem_UndrBrkPLo.Kp_C HLSDem_UndrBrkPLo.KpPos_C HLSDem_UndrBrkPLo.KpNeg_C HLSDem_UndrBrkPLo.WinPos_C HLSDem_UndrBrkPLo.WinNeg_C HLSDem_vThresUndrBrk_C HLSDem_WrmClthdnAccLim_C HLSDem_WrmClthdnDeclLim_C HLSDem_WrmClthILo.Ki_C HLSDem_WrmClthILo.KiPos_C HLSDem_WrmClthILo.KiNeg_C HLSDem_WrmClthILo.WinPos_C HLSDem_WrmClthILo.WinNeg_C HLSDem_WrmClthInrtDrvTrn_C HLSDem_WrmClthInrtEng_C HLSDem_WrmClthInrtVeh_C HLSDem_WrmClthPLo.Kp_C HLSDem_WrmClthPLo.KpPos_C HLSDem_WrmClthPLo.KpNeg_C HLSDem_WrmClthPLo.WinPos_C HLSDem_WrmClthPLo.WinNeg_C HLSDem_WrmClthrnEngvVeh_C HLSDem_WrmClthtiFltLosTrqEst_C HLSDem_WrmClthtiFltnEng_C /end DEF_CHARACTERISTIC
 /begin REF_CHARACTERISTIC PT_numTraGear1_C PT_numTraGear2_C PT_numTraGear3_C PT_numTraGear4_C PT_numTraGear5_C PT_numTraGear6_C PT_numTraGear7_C PT_numTraNoGear_C /end REF_CHARACTERISTIC
 /begin IN_MEASUREMENT Brk_st CoEng_st EngDa_tFld Epm_nEng HLSDem_nSetPLo HLSDem_trqReqStrt ISC_st PT_numTraGear PT_stGrip PT_stTraType VehV_v /end IN_MEASUREMENT
 /begin OUT_MEASUREMENT HLSDem_trqLoLimMax HLSDem_trqLoLimMin HLSDem_trqReq /end OUT_MEASUREMENT
 /begin LOC_MEASUREMENT HLSDem_dnAccLimCurr_mp HLSDem_dnDeclLimCurr_mp HLSDem_InrtDrvTrnCurr_mp HLSDem_InrtEngCurr_mp HLSDem_InrtVehCurr_mp HLSDem_IWinNegLoCurr_mp HLSDem_IWinPosLoCurr_mp HLSDem_KiLoCurr_mp HLSDem_KiNegLoCurr_mp HLSDem_KiPosLoCurr_mp HLSDem_KpHiCurr_mp HLSDem_KpLoCurr_mp HLSDem_KpNegHiCurr_mp HLSDem_KpNegLoCurr_mp HLSDem_KpPosHiCurr_mp HLSDem_KpPosLoCurr_mp HLSDem_PWinNegHiCurr_mp HLSDem_PWinNegLoCurr_mp HLSDem_PWinPosHiCurr_mp HLSDem_PWinPosLoCurr_mp HLSDem_rnEngvVehCurr_mp HLSDem_tiFltLosTrqEstCurr_mp HLSDem_tiFltnEngCurr_mp /end LOC_MEASUREMENT
/end FUNCTION
/begin FUNCTION HLSDem_Setpoint ""
 /begin DEF_CHARACTERISTIC HLSDem_dnSetPLoLimHiTrm_C HLSDem_dnSetPLoLimLoTrm_C HLSDem_nDeltaSec_C HLSDem_nDiffDelta_C HLSDem_nHDC_C HLSDem_nLimHiOfs_C HLSDem_nLimHiTrmAct_C HLSDem_nLimHi_C HLSDem_nRmpBaseDwn_C HLSDem_nRmpBaseUp_C HLSDem_nRmpChrgPmpDwn_C HLSDem_nRmpChrgPmpUp_C HLSDem_nRmpCoEngDwn_C HLSDem_nRmpCoEngUp_C HLSDem_nRmpHDCDwn_C HLSDem_nRmpHDCUp_C HLSDem_nRmpPwrMngDwn_C HLSDem_nRmpPwrMngUp_C HLSDem_nRmpSecDelta_C HLSDem_nSetPHi_MAP HLSDem_nSetPLoDia_C HLSDem_nSetPLoDrvAwy_C HLSDem_nSetPLoInit2_MAP HLSDem_nSetPLoInit_MAP HLSDem_nSetPLoTrmLim_C HLSDem_nSetPLoTrm_C HLSDem_nSetPLoWrm_C HLSDem_numTempSetPHi_C HLSDem_numTempTrqReqStrt_C HLSDem_RmpCutOut.SlopePos_C HLSDem_RmpCutOut.SlopeNeg_C HLSDem_SetPHiRmp.SlopePos_C HLSDem_SetPHiRmp.SlopeNeg_C HLSDem_stActvHDC_C HLSDem_stRlsHDC_C HLSDem_swtDisblVehIfc_C HLSDem_swtGear_C HLSDem_tiDelCutOut_C HLSDem_tiTW_C HLSDem_trqInitI_MAP HLSDem_trqReqStrt_CUR /end DEF_CHARACTERISTIC
 /begin IN_MEASUREMENT CEngDsT_t EnvP_p PT_rTrq TCPrt_nSetPointChrgPmp /end IN_MEASUREMENT
 /begin OUT_MEASUREMENT HLSDem_nMaxTrq HLSDem_nSetPHi HLSDem_nSetPLo HLSDem_nSetPLoCoEng HLSDem_nSetPLoLoc2 HLSDem_nSetPLoLocRamp HLSDem_nSetPLoPwrMng HLSDem_nSetPLoTrm HLSDem_stActvHDC HLSDem_stSetPLo HLSDem_stSetPLoTrmActv HLSDem_trqReqStrt /end OUT_MEASUREMENT
 /begin LOC_MEASUREMENT HLSDem_nDiffDelta_mp HLSDem_nHDC_mp HLSDem_nLimHi_mp HLSDem_nSetPHiCo_mp HLSDem_nSetPLoChrgPmpOld_mp HLSDem_nSetPLoChrgPmp_mp HLSDem_nSetPLoCoEngOld_mp HLSDem_nSetPLoHDCOld_mp HLSDem_nSetPLoHDC_mp HLSDem_nSetPLoLoc0_mp HLSDem_nSetPLoLocRampOld_mp HLSDem_nSetPLoOld_mp HLSDem_nSetPLoPwrMngOld_mp HLSDem_nSetPLoSec1_mp HLSDem_nSetPLoSec2_mp HLSDem_nSetPLoSec4_mp HLSDem_nSetPLoTemp_mp HLSDem_nSetPLoTrm_mp HLSDem_stSetPHiCo_mp HLSDem_stSetPHiFlt_mp HLSDem_stSetPLoTrmAlw_mp HLSDem_tSetPHi_mp HLSDem_tTrqReqStrt_mp /end LOC_MEASUREMENT
 /begin SUB_FUNCTION HLSDem_Setpoint /end SUB_FUNCTION
/end FUNCTION
/begin FUNCTION HPUn_Co ""
 /begin DEF_CHARACTERISTIC HPUn_dvolMeUnMax_C HPUn_etaPmpFlTemp_CUR HPUn_etaPmpMaxAged_CUR HPUn_etaPmpMech_C HPUn_nMin_C HPUn_qBalLim_CUR HPUn_qFlTempLim_MAP HPUn_rTransCrS_C HPUn_volPmp_C /end DEF_CHARACTERISTIC
 /begin IN_MEASUREMENT Epm_nEng FuelT_t FuelT_tFlSys InjCrv_numInjMaxSys MeUn_dvolSet RailP_pFlt Rail_dvolEstAged Rail_pDvt Rail_stCtlLoop /end IN_MEASUREMENT
 /begin OUT_MEASUREMENT HPUn_numInjQntBal HPUn_qLim HPUn_trqLoss /end OUT_MEASUREMENT
 /begin LOC_MEASUREMENT HPUn_dvolPmpMaxCor_mp HPUn_dvolPmpMax_mp HPUn_etaPmpFlTemp_mp HPUn_etaPmpMaxAged_mp HPUn_qBalLim_mp HPUn_qFlTempLim_mp HPUn_rTransCrS HPUn_stQntBal_mp /end LOC_MEASUREMENT
/end FUNCTION
/begin FUNCTION HPUn_QntBalInjLim ""
 /begin DEF_CHARACTERISTIC HPUn_numInjMin_C HPUn_pRailDvtOk_C HPUn_tiPresDvtFlt_C HPUn_tiQntBalDel_C /end DEF_CHARACTERISTIC
 /begin LOC_MEASUREMENT HPUn_pRailDvtFlt_mp HPUn_stNumInjMax_mp /end LOC_MEASUREMENT
/end FUNCTION
/begin FUNCTION HWE ""
 /begin SUB_FUNCTION Adc Can Cj125 Cj230 Cj945 Cpu Cy100 Cy141 Cy320 Dio Dma Eep Flash Gpta Mli Mm Msc Pcp Pmd Port Pwr Reg Spi Tle6232 Uart /end SUB_FUNCTION
/end FUNCTION
/begin FUNCTION I15031_srv1 "" /end FUNCTION
/begin FUNCTION i15031_srv2 "" /begin DEF_CHARACTERISTIC I15031_stSrv02SuppPid_CA /end DEF_CHARACTERISTIC /end FUNCTION
/begin FUNCTION I15031_srv37 "" /end FUNCTION
/begin FUNCTION I15031_srv4 "" /end FUNCTION
/begin FUNCTION I15031_srv6 "" /end FUNCTION
/begin FUNCTION I15031_srv9 ""
 /begin DEF_CHARACTERISTIC I15031_PID1C_C I15031_PID1D_C I15031_PID4FA_C I15031_PID4FB_C I15031_PID4FC_C I15031_srv9PIDTable.PID0_C I15031_srv9PIDTable.PID1_C I15031_srv9PIDTable.PID2_C I15031_srv9PIDTable.PID3_C I15031_srv9PIDTable.PID4_C I15031_srv9PIDTable.PID5_C I15031_srv9PIDTable.PID6_C I15031_srv9PIDTable.PID7_C I15031_srv9PIDTable.PID8_C /end DEF_CHARACTERISTIC
 /begin OUT_MEASUREMENT I15031_PID1C I15031_PID1D I15031_PID4FA I15031_PID4FB I15031_PID4FC /end OUT_MEASUREMENT
/end FUNCTION
/begin FUNCTION IfxFlash "" /end FUNCTION
/begin FUNCTION ignlck_setdata "" /begin IN_MEASUREMENT T15_st T50_st /end IN_MEASUREMENT /begin OUT_MEASUREMENT CoVeh_stIgnLckTerm15 CoVeh_stIgnLckTerm50 /end OUT_MEASUREMENT /end FUNCTION
/begin FUNCTION InjCrv_Co ""
 /begin DEF_CHARACTERISTIC InjCrv_numInjMaxSys_C InjCrv_numInjRtmLim_CUR InjCrv_PiIDblCorMap.xVal_C InjCrv_PiIDblCorMap.xTyp_C InjCrv_rPiIRlsEngSpdHys_C InjCrv_rPiIRlsQntHys_C InjCrv_rRtmLimEngSpdHys_C InjCrv_stInjCharPrioRgn_C InjCrv_stInjCharPrio_C InjCrv_stMI1RgnMsk_CA InjCrv_stMI1RmpSel_CA InjCrv_stPiI1RgnMsk_CA InjCrv_stPiI1RmpSel_CA InjCrv_stPiI2RgnMsk_CA InjCrv_stPiI2RmpSel_CA InjCrv_stPiI3RgnMsk_CA InjCrv_stPiIRlsOpRng1_MAP InjCrv_stPiIRlsOpRng2_MAP InjCrv_stPiIRlsOpRng3_MAP InjCrv_stPiIRlsOpRng4_MAP InjCrv_stPiIRlsOpRng5_MAP InjCrv_stPrioRgnMsk_C InjCrv_stRlsRgnMsk_C /end DEF_CHARACTERISTIC
 /begin IN_MEASUREMENT CoEng_stShutOffPath CoEng_stTst CoEOM_facRmpVal CoEOM_stOpModeActTSync CoEOM_stOpModeLckTSync Epm_ctCyl Epm_nEng Epm_stCmbTestReq Epm_stSync HPUn_numInjQntBal InjCtl_qSetUnBal InjVlv_stInjCharComp InjVlv_stInjRls /end IN_MEASUREMENT
 /begin OUT_MEASUREMENT InjCrv_numInjMaxSys InjCrv_stInjCharActVal InjCrv_stInjCharActValPrg InjCrv_stInjCharRlsPrgVal InjCrv_stInjCharSetVal InjCrv_stMI1Rgn InjCrv_stMI1RgnTSync InjCrv_stMI1RmpSel InjCrv_stPiI1Rgn InjCrv_stPiI1RgnTSync InjCrv_stPiI1RmpSel InjCrv_stPiI2Rgn InjCrv_stPiI2RgnTSync InjCrv_stPiI2RmpSel InjCrv_stPiI3Rgn InjCrv_stPiI3RgnTSync InjCrv_stPoI1Rgn InjCrv_stPoI1RgnTSync InjCrv_stPoI1RmpSel InjCrv_stPoI1RmpSelTSync InjCrv_stPoI2NrmMode InjCrv_stPoI2Rgn InjCrv_stPoI2RgnTSync InjCrv_stPoI2RmpSel InjCrv_stPoI2RmpSelTSync InjCrv_swtPiIDblCorMap /end OUT_MEASUREMENT
 /begin LOC_MEASUREMENT InjCrv_numInjDes_mp InjCrv_numInjLim_mp InjCrv_numInjRtmLim_mp InjCrv_stActValMI1_mp InjCrv_stActValPiI1_mp InjCrv_stActValPiI2_mp InjCrv_stDesValMI1_mp InjCrv_stDesValPiI1_mp InjCrv_stDesValPiI2_mp InjCrv_stInjCharDes_mp InjCrv_stInjCharPrio InjCrv_stInjCharPrioTSync InjCrv_stInjCharSetValTSync InjCrv_stInjCharSetVal_mp InjCrv_stMI1RmpSelTSync InjCrv_stPiI1RmpSelTSync InjCrv_stPiI2RmpSelTSync InjCrv_stPiIRlsRaw_mp InjCrv_stPiIRlsStruct_mp InjCrv_stPoI2NrmModeTSync /end LOC_MEASUREMENT
/end FUNCTION
/begin FUNCTION InjCrv_CoPiIRlsAddCor "" /end FUNCTION
/begin COMPU_METHOD Acc "" RAT_FUNC "%6.5" "m/s^2" COEFFS 0 1000 0 0 0 1 /end COMPU_METHOD
/begin COMPU_METHOD DEFAULT_FORMULA "DEFAULT_FORMULA" RAT_FUNC "%7.0" "" COEFFS 0 1 0 0 0 1 /end COMPU_METHOD
/begin COMPU_METHOD DEFAULT_FORMULA "DEFAULT_FORMULA" RAT_FUNC "%7.0" "" COEFFS 0 1 0 0 0 1 /end COMPU_METHOD
/begin COMPU_METHOD DEFAULT_FORMULA "DEFAULT_FORMULA" RAT_FUNC "%7.0" "" COEFFS 0 1 0 0 0 1 /end COMPU_METHOD
/begin COMPU_METHOD DEFAULT_FORMULA "DEFAULT_FORMULA" RAT_FUNC "%7.0" "" COEFFS 0 1 0 0 0 1 /end COMPU_METHOD
/begin COMPU_METHOD DEFAULT_FORMULA "DEFAULT_FORMULA" RAT_FUNC "%7.0" "" COEFFS 0 1 0 0 0 1 /end COMPU_METHOD
/begin COMPU_METHOD DEFAULT_FORMULA "DEFAULT_FORMULA" RAT_FUNC "%7.0" "" COEFFS 0 1 0 0 0 1 /end COMPU_METHOD
/begin COMPU_METHOD AngleCrS "" RAT_FUNC "%6.4" "deg CrS" COEFFS 0 45.5097222222222 0 0 0 1 /end COMPU_METHOD
/begin COMPU_METHOD dn_dZfine "" RAT_FUNC "%6.3" "rpm/s" COEFFS 0 2 0 0 0 1 /end COMPU_METHOD
/begin COMPU_METHOD DtyCyc "" RAT_FUNC "%6.4" "%" COEFFS 0 100 0 0 0 1 /end COMPU_METHOD
/begin COMPU_METHOD EngN "" RAT_FUNC "%6.3" "rpm" COEFFS 0 2 0 0 0 1 /end COMPU_METHOD
/begin COMPU_METHOD EngN_float "" RAT_FUNC "%6.2" "rpm" COEFFS 0 1 0 0 0 1 /end COMPU_METHOD
/begin COMPU_METHOD EngTempFldSel "" TAB_VERB "%6.3" "-" COMPU_TAB_REF EngTempFldSel /end COMPU_METHOD
/begin COMPU_VTAB EngTempFldSel "" TAB_VERB 3 0 "Coolant_Temperature" 1 "Oil_Temperature" 2 "EngDa_tEng" /end COMPU_VTAB
/begin COMPU_METHOD Eta1 "" RAT_FUNC "%6.4" "-" COEFFS 0 128 0 0 0 1 /end COMPU_METHOD
/begin COMPU_METHOD Fact "" RAT_FUNC "%6.5" "-" COEFFS 0 8192 0 0 0 1 /end COMPU_METHOD
/begin COMPU_METHOD FBC_BPfac "" RAT_FUNC "%6.4" "-" COEFFS 0 546.116666666667 0 0 0 1 /end COMPU_METHOD
/begin COMPU_METHOD FBC_Dxs_s16 "" RAT_FUNC "%7.6" "%" COEFFS 0 40000 0 0 0 1 /end COMPU_METHOD
/begin COMPU_METHOD FBC_GvrnIKi_float "" RAT_FUNC "%6.2" "mg/((1/min^2)*s)" COEFFS 0 1 0 0 0 1 /end COMPU_METHOD
/begin COMPU_METHOD FBC_GvrnPKp_float "" RAT_FUNC "%6.2" "mg/(1/min^2)" COEFFS 0 1 0 0 0 1 /end COMPU_METHOD
/begin COMPU_METHOD FBC_StateESpP_st "" TAB_VERB "%6.3" "-" COMPU_TAB_REF FBC_StateESpP_st /end COMPU_METHOD
/begin COMPU_VTAB FBC_StateESpP_st "" TAB_VERB 5 1 "INIT" 2 "DX_WAIT" 3 "LEARN" 4 "APPLY" 5 "DELAY" /end COMPU_VTAB
/begin COMPU_METHOD FBC_Surge_Frq "" RAT_FUNC "%6.4" "Hz" COEFFS 0 120 0 0 0 1 /end COMPU_METHOD
/begin COMPU_METHOD FlConsum_l_h "" RAT_FUNC "%6.4" "l/h" COEFFS 0 100 0 0 0 1 /end COMPU_METHOD
/begin COMPU_METHOD FlConsum_ul_20ms "" RAT_FUNC "%6.2" "ul/20ms" COEFFS 0 1 0 0 0 1 /end COMPU_METHOD
/begin COMPU_METHOD HESrv_SwtPOpVis "" TAB_VERB "%6.3" "-" COMPU_TAB_REF HESrv_SwtPOpVis /end COMPU_METHOD
/begin COMPU_VTAB HESrv_SwtPOpVis "" TAB_VERB 2 0 "Bank 1" 1 "Bank 2" /end COMPU_VTAB
/begin COMPU_METHOD HLSDemsFltSel "verbale Umrechnungsformel, Auswahl Art der Drehzahlfilterung" TAB_VERB "%6.3" "-" COMPU_TAB_REF HLSDemsFltSel /end COMPU_METHOD
/begin COMPU_VTAB HLSDemsFltSel "verbale Umrechnungsformel, Auswahl Art der Drehzahlfilterung" TAB_VERB 4 1 "tipin" 2 "filtered" 3 "unfiltered" 32767 "ramp" /end COMPU_VTAB
/begin COMPU_METHOD HLSDemsSetPHiSel "verbale Umrechnungsformel Funktionsnamen der aktuellen Maximaldrehzahl" TAB_VERB "%6.3" "-" COMPU_TAB_REF HLSDemsSetPHiSel /end COMPU_METHOD
/begin COMPU_VTAB HLSDemsSetPHiSel "verbale Umrechnungsformel Funktionsnamen der aktuellen Maximaldrehzahl" TAB_VERB 4 1 "CoPT_nMaxAcs" 2 "CoPT_nMaxTra" 3 "CoPT_nMaxSysErr" 32767 "other" /end COMPU_VTAB
/begin COMPU_METHOD I15031_PID1CVerb "" TAB_VERB "%6.3" "-" COMPU_TAB_REF I15031_PID1CVerb /end COMPU_METHOD
/begin COMPU_VTAB I15031_PID1CVerb "" TAB_VERB 13 1 "OBD II" 2 "OBD" 3 "OBD and OBD II" 4 "OBD I" 5 "No OBD" 6 "EOBD" 7 "EOBD and OBD II" 8 "EOBD and OBD" 9 "EOBD, OBD and OBD II" 10 "JOBD" 11 "JOBD and OBD II" 12 "JOBD and EOBD" 13 "JOBD, EOBD and OBD II" /end COMPU_VTAB
/begin COMPU_METHOD I15031_PID1DVerb "" TAB_VERB "%6.3" "-" COMPU_TAB_REF I15031_PID1DVerb /end COMPU_METHOD
/begin COMPU_VTAB I15031_PID1DVerb "" TAB_VERB 8 0 "O2S11" 1 "O2S12" 2 "O2S21" 3 "O2S22" 4 "O2S31" 5 "O2S32" 6 "O2S41" 7 "O2S42" /end COMPU_VTAB
/begin COMPU_METHOD InjMass "" RAT_FUNC "%6.4" "mg/hub" COEFFS 0 100 0 0 0 1 /end COMPU_METHOD
/begin COMPU_METHOD InjMassCyc "" RAT_FUNC "%6.4" "mg/cyc" COEFFS 0 100 0 0 0 1 /end COMPU_METHOD
/begin COMPU_METHOD InjQnt "" RAT_FUNC "%6.3" "mm^3/hub" COEFFS 0 10 0 0 0 1 /end COMPU_METHOD
/begin COMPU_METHOD ISC_dnEng_float "Umrechnung für die Drehzahlbeschleunigung (Float Implementierung)" RAT_FUNC "%6.2" "rpm/s" COEFFS 0 1 0 0 0 1 /end COMPU_METHOD
/begin COMPU_METHOD ISC_Inirtia_float "Umrechnung für Massenträgheitsmoment (Float Implementierung)" RAT_FUNC "%6.2" "Nm/(rpm/s)" COEFFS 0 1 0 0 0 1 /end COMPU_METHOD
/begin COMPU_METHOD ISC_Ki_rpm2Nm_float "Umrechnung für Verstärkung I-Anteil (Float Implementierung)" RAT_FUNC "%6.2" "Nm/(rpm*s)" COEFFS 0 1 0 0 0 1 /end COMPU_METHOD
/begin COMPU_METHOD ISC_Kp_rpm2Nm_float "Umrechnung für Verstärkung P-Anteil (Float Implementierung)" RAT_FUNC "%6.2" "Nm/rpm" COEFFS 0 1 0 0 0 1 /end COMPU_METHOD
/begin COMPU_METHOD ISC_rnEng2vVeh_float "Umrechnung für das Verhältnis Motordrehzahl zu Fahrzeuggeschwindigkeit (Float Implementierung)" RAT_FUNC "%6.2" "rpm/(Km/h)" COEFFS 0 1 0 0 0 1 /end COMPU_METHOD
/begin COMPU_METHOD ISC_tiPT2nEng_float "Umrechnung für Zeitkonstante der PT2-Filterung der Motordrehzahl (Float Implementierung)" RAT_FUNC "%6.2" "s" COEFFS 0 1 0 0 0 1 /end COMPU_METHOD
/begin COMPU_METHOD ISC_tiPTsTrqLoss_float "Umrechnung für die Zeitkonstante für die Filterung bei der Lastmomentabschätzung (Float Implementierung)" RAT_FUNC "%6.2" "s" COEFFS 0 1 0 0 0 1 /end COMPU_METHOD
/begin COMPU_METHOD Length "" RAT_FUNC "%6.2" "m" COEFFS 0 1 0 0 0 1 /end COMPU_METHOD
/begin COMPU_METHOD Length_fine "" RAT_FUNC "%6.5" "m" COEFFS 0 1000 0 0 0 1 /end COMPU_METHOD
/begin COMPU_METHOD OneToOne "" RAT_FUNC "%6.2" "-" COEFFS 0 1 0 0 0 1 /end COMPU_METHOD
/begin COMPU_METHOD Period "" RAT_FUNC "%6.3" "ms" COEFFS 0 10 0 0 0 1 /end COMPU_METHOD
/begin COMPU_METHOD Per_Ratio "" RAT_FUNC "%6.4" "-" COEFFS 0 256 0 0 0 1 /end COMPU_METHOD
/begin COMPU_METHOD PmpQnt "" RAT_FUNC "%6.3" "mm^3/rev" COEFFS 0 10 0 0 0 1 /end COMPU_METHOD
/begin COMPU_METHOD Prc "" RAT_FUNC "%6.4" "%" COEFFS 0 81.92 0 0 0 1 /end COMPU_METHOD
/begin COMPU_METHOD Prc_float "" RAT_FUNC "%6.0" "%" COEFFS 0 0.01 0 0 0 1 /end COMPU_METHOD
/begin COMPU_METHOD Pres_hPa "" RAT_FUNC "%6.2" "hPa" COEFFS 0 1 0 0 0 1 /end COMPU_METHOD
/begin COMPU_METHOD Pres_Rail "" RAT_FUNC "%4.3" "bar" COEFFS 0 10.000000 0 0 0 1 /end COMPU_METHOD
/begin COMPU_METHOD Pwr_HiRes "" RAT_FUNC "%6.2" "W" COEFFS 0 1 0 0 0 1 /end COMPU_METHOD
/begin COMPU_METHOD Qp_mm3_sec "" RAT_FUNC "%6.1" "mm3/s" COEFFS 0 0.1 0 0 0 1 /end COMPU_METHOD
/begin COMPU_METHOD RhoFuel "" RAT_FUNC "%6.3" "kg/m^3" COEFFS 0 10 0 0 0 1 /end COMPU_METHOD
/begin COMPU_METHOD RmpEngN "" RAT_FUNC "%6.4" "rpm/s" COEFFS 0 131.072 0 0 0 1 /end COMPU_METHOD
/begin COMPU_METHOD RmpInjMass "" RAT_FUNC "%6.5" "(mg/stroke)/s" COEFFS 0 6553.6 0 0 0 1 /end COMPU_METHOD
/begin COMPU_METHOD RmpTemp "" RAT_FUNC "%6.4" "K/s" COEFFS 0 655.36 0 0 0 1 /end COMPU_METHOD
/begin COMPU_METHOD Temp_Cels "" RAT_FUNC "%6.1" "deg C" COEFFS 0 10 2731.4 0 0 1 /end COMPU_METHOD
/begin COMPU_METHOD TimeDeb "" RAT_FUNC "%6.1" "ms" COEFFS 0 0.1 0 0 0 1 /end COMPU_METHOD
/begin COMPU_METHOD TimeDelay_s "" RAT_FUNC "%12.4" "s" COEFFS 0 0 1 0 0.00023283064365387 0 /end COMPU_METHOD
/begin COMPU_METHOD Time_ms "" RAT_FUNC "%6.1" "ms" COEFFS 0 0.1 0 0 0 1 /end COMPU_METHOD
/begin COMPU_METHOD Time_PwmHigh "" RAT_FUNC "%6.4" "us" COEFFS 0 20 0 0 0 1 /end COMPU_METHOD
/begin COMPU_METHOD Time_s "" RAT_FUNC "%6.4" "s" COEFFS 0 100 0 0 0 1 /end COMPU_METHOD
/begin COMPU_METHOD TransR "" RAT_FUNC "%6.4" "-" COEFFS 0 100 0 0 0 1 /end COMPU_METHOD
/begin COMPU_METHOD Trq "" RAT_FUNC "%6.3" "Nm" COEFFS 0 10 0 0 0 1 /end COMPU_METHOD
/begin COMPU_METHOD Typ4WinDia "" TAB_VERB "%6.3" "-" COMPU_TAB_REF Typ4WinDia /end COMPU_METHOD
/begin COMPU_VTAB Typ4WinDia "" TAB_VERB 4 0 "4 Window diagnosis over PWM control line" 1 "4 Window diagnosis through Digital input" 2 "4 Window diagnosis over external interface" 3 "No 4 Window diagnosis." /end COMPU_VTAB
/begin COMPU_METHOD Vel "" RAT_FUNC "%6.4" "km/h" COEFFS 0 100 0 0 0 1 /end COMPU_METHOD
/begin COMPU_METHOD Vel_SI "" RAT_FUNC "%6.4" "m/s" COEFFS 0 360 0 0 0 1 /end COMPU_METHOD
/begin COMPU_METHOD Volt "" RAT_FUNC "%6.3" "mV" COEFFS 0 5 0 0 0 1 /end COMPU_METHOD
/begin COMPU_METHOD Volt_Batt "" RAT_FUNC "%6.1" "mV" COEFFS 0 0.05 0 0 0 1 /end COMPU_METHOD
/begin RECORD_LAYOUT Cur_Xs16Ws16 NO_AXIS_PTS_X 1 SWORD AXIS_PTS_X 2 SWORD INDEX_INCR DIRECT FNC_VALUES 3 SWORD COLUMN_DIR DIRECT /end RECORD_LAYOUT
/begin RECORD_LAYOUT Kf_Xs16_Ys16_Ws16 NO_AXIS_PTS_X 1 SWORD NO_AXIS_PTS_Y 2 SWORD AXIS_PTS_X 3 SWORD INDEX_INCR DIRECT AXIS_PTS_Y 4 SWORD INDEX_INCR DIRECT FNC_VALUES 5 SWORD COLUMN_DIR DIRECT /end RECORD_LAYOUT
/begin RECORD_LAYOUT Kw_Wr32 FNC_VALUES 1 FLOAT32_IEEE COLUMN_DIR DIRECT /end RECORD_LAYOUT
/begin RECORD_LAYOUT Kw_Ws16 FNC_VALUES 1 SWORD COLUMN_DIR DIRECT /end RECORD_LAYOUT
/begin RECORD_LAYOUT Kw_Ws32 FNC_VALUES 1 SLONG COLUMN_DIR DIRECT /end RECORD_LAYOUT
/begin RECORD_LAYOUT Kw_Wu16 FNC_VALUES 1 UWORD COLUMN_DIR DIRECT /end RECORD_LAYOUT
/begin RECORD_LAYOUT Kw_Wu32 FNC_VALUES 1 ULONG COLUMN_DIR DIRECT /end RECORD_LAYOUT
/begin RECORD_LAYOUT Kw_Wu8 FNC_VALUES 1 UBYTE COLUMN_DIR DIRECT /end RECORD_LAYOUT
/begin RECORD_LAYOUT Map_Xs16Ys16Ws16 NO_AXIS_PTS_X 1 SWORD NO_AXIS_PTS_Y 2 SWORD AXIS_PTS_X 3 SWORD INDEX_INCR DIRECT AXIS_PTS_Y 4 SWORD INDEX_INCR DIRECT FNC_VALUES 5 SWORD COLUMN_DIR DIRECT /end RECORD_LAYOUT
/begin RECORD_LAYOUT Map_Xu8Yu8Wu8 NO_AXIS_PTS_X 1 UBYTE NO_AXIS_PTS_Y 2 UBYTE AXIS_PTS_X 3 UBYTE INDEX_INCR DIRECT AXIS_PTS_Y 4 UBYTE INDEX_INCR DIRECT FNC_VALUES 5 UBYTE COLUMN_DIR DIRECT /end RECORD_LAYOUT
/begin RECORD_LAYOUT ValA_Wr32 FNC_VALUES 1 FLOAT32_IEEE COLUMN_DIR DIRECT /end RECORD_LAYOUT
/begin RECORD_LAYOUT ValA_Ws16 FNC_VALUES 1 SWORD COLUMN_DIR DIRECT /end RECORD_LAYOUT
/begin RECORD_LAYOUT ValA_Wu16 FNC_VALUES 1 UWORD COLUMN_DIR DIRECT /end RECORD_LAYOUT
/begin RECORD_LAYOUT ValA_Wu32 FNC_VALUES 1 ULONG COLUMN_DIR DIRECT /end RECORD_LAYOUT
/begin RECORD_LAYOUT ValA_Wu8 FNC_VALUES 1 UBYTE COLUMN_DIR DIRECT /end RECORD_LAYOUT
/begin RECORD_LAYOUT Val_Wr32 FNC_VALUES 1 FLOAT32_IEEE COLUMN_DIR DIRECT /end RECORD_LAYOUT
/begin RECORD_LAYOUT Val_Ws16 FNC_VALUES 1 SWORD COLUMN_DIR DIRECT /end RECORD_LAYOUT
/begin RECORD_LAYOUT Val_Ws32 FNC_VALUES 1 SLONG COLUMN_DIR DIRECT /end RECORD_LAYOUT
/begin RECORD_LAYOUT Val_Ws8 FNC_VALUES 1 SBYTE COLUMN_DIR DIRECT /end RECORD_LAYOUT
/begin RECORD_LAYOUT Val_Wu16 FNC_VALUES 1 UWORD COLUMN_DIR DIRECT /end RECORD_LAYOUT
/begin RECORD_LAYOUT Val_Wu32 FNC_VALUES 1 ULONG COLUMN_DIR DIRECT /end RECORD_LAYOUT
/begin RECORD_LAYOUT Val_Wu8 FNC_VALUES 1 UBYTE COLUMN_DIR DIRECT /end RECORD_LAYOUT
/end MODULE
/end PROJECT
