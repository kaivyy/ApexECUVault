ASAP2_VERSION 1 41
/begin PROJECT MSD70 "Spray Guided DI-System with Piezo Injectors for 6-Cylinder"
/begin HEADER "_default_HeaderComment" PROJECT_NO _0B /end HEADER
/begin MODULE _default_ModuleName "_default_ModuleLongIdentifier"
/begin MOD_COMMON "_default_ModCommonComment" DEPOSIT ABSOLUTE BYTE_ORDER MSB_LAST ALIGNMENT_BYTE 1 ALIGNMENT_WORD 2 ALIGNMENT_LONG 2 ALIGNMENT_FLOAT32_IEEE 2 ALIGNMENT_FLOAT64_IEEE 4 /end MOD_COMMON
/begin AXIS_PTS ldpm_n_32_3_evac "" 0xa1005394 n_32 _REC_AXS_20_u1 8160. _CNV_A_R_LINEAR_____9_CM 8 0. 8160. FORMAT "%4.0" /end AXIS_PTS
/begin AXIS_PTS ldpm_maf_cyl_1_evac "" 0xa1005310 maf_cyl _REC_AXS_20_u2 2047.96875 _CNV_A_R_LINEAR_____207_CM 6 0. 2047.96875 FORMAT "%10.5" /end AXIS_PTS
/begin MEASUREMENT n_dyw_cp "N average value for dynamic window" UWORD _CNV_A_R_LINEAR_____13_CM 1 100. 0. 8160. DISPLAY_IDENTIFIER N_DYW_CP ECU_ADDRESS 0xc0001f48 FORMAT "%4.0" /end MEASUREMENT
/begin MEASUREMENT maf_dyw_cp "MAF average value for dynamic window " UWORD _CNV_A_R_LINEAR_____108_CM 1 100. 0. 1389. DISPLAY_IDENTIFIER MAF_DYW_CP ECU_ADDRESS 0xc0001e9c FORMAT "%7.2" /end MEASUREMENT
/begin CHARACTERISTIC c_prs_max_cps "pressure difference limit (environment-intake mainfold) for activation of the canister purge" VALUE 0xa100612c _REC_VAL_20_s2 5434. _CNV_A_R_LINEAR_____297_CM -2717.04145876249 2716.95854123751 DISPLAY_IDENTIFIER C_PRS_MAX_CPS FORMAT "%8.2" /end CHARACTERISTIC
/begin CHARACTERISTIC c_n_cp_tol "maximum speed limit for activation of the RAMP_OPEN operation (homogeneous)" VALUE 0xa100611c _REC_VAL_20_u1 8160. _CNV_A_R_LINEAR_____9_CM 0. 8160. DISPLAY_IDENTIFIER C_N_CP_TOL FORMAT "%4.0" /end CHARACTERISTIC
/begin CHARACTERISTIC c_t_lam_lim_cp "Additional time to stay in MIN_PURGE after lv_fac_lam_lim_xxx[i] activation" VALUE 0xa100616a _REC_VAL_20_u2 6553.5 _CNV_A_R_LINEAR_____4_CM 0. 6553.5 DISPLAY_IDENTIFIER C_T_LAM_LIM_CP FORMAT "%6.1" /end CHARACTERISTIC
/begin CHARACTERISTIC c_n_dyw_cp "N window for limited dynamics in homogeneous" VALUE 0xa100611d _REC_VAL_20_u1 8160. _CNV_A_R_LINEAR_____9_CM 0. 8160. DISPLAY_IDENTIFIER C_N_DYW_CP FORMAT "%4.0" /end CHARACTERISTIC
/begin MEASUREMENT lv_n_max_cp "max engine speed for canister purge calculation limit reached" UBYTE _CNV_S_2_RANGE__0___1_CM 1 100. 0. 1. DISPLAY_IDENTIFIER LV_N_MAX_CP ECU_ADDRESS 0xd0002e9b BIT_MASK 0x1 /end MEASUREMENT
/begin CHARACTERISTIC c_n_cp_bol "minimum speed limit for activation of the RAMP_OPEN operation (homogeneous)" VALUE 0xa100611b _REC_VAL_20_u1 8160. _CNV_A_R_LINEAR_____9_CM 0. 8160. DISPLAY_IDENTIFIER C_N_CP_BOL FORMAT "%4.0" /end CHARACTERISTIC
/begin CHARACTERISTIC c_n_max_cp "Maximum engine speed value for canister purge calculation (CPU load reduction) " VALUE 0xa1006122 _REC_VAL_20_u1 8160. _CNV_A_R_LINEAR_____9_CM 0. 8160. DISPLAY_IDENTIFIER C_N_MAX_CP FORMAT "%4.0" /end CHARACTERISTIC
/begin CHARACTERISTIC c_n_hys_max_cp "hysteresis value for canister purge calculation (CPU load reduction)" VALUE 0xa1006121 _REC_VAL_20_u1 8160. _CNV_A_R_LINEAR_____9_CM 0. 8160. DISPLAY_IDENTIFIER C_N_HYS_MAX_CP FORMAT "%4.0" /end CHARACTERISTIC
/begin MEASUREMENT lv_cp_act "logical value for EVAP-Control active" UBYTE _CNV_S_2_RANGE__0___1_CM 1 100. 0. 1. DISPLAY_IDENTIFIER LV_CP_ACT ECU_ADDRESS 0xd0002e7d BIT_MASK 0x1 /end MEASUREMENT
/begin MEASUREMENT lv_lam_out_cp "lambda controller reached limits (defined in this module)" UBYTE _CNV_S_2_RANGE__0___1_CM 1 100. 0. 1. DISPLAY_IDENTIFIER LV_LAM_OUT_CP ECU_ADDRESS 0xc0001f89 BIT_MASK 0x1 /end MEASUREMENT
/begin MEASUREMENT lv_lam_lim_cp "lambda controller reached limits (defined in lambda controller module)" UBYTE _CNV_S_2_RANGE__0___1_CM 1 100. 0. 1. DISPLAY_IDENTIFIER LV_LAM_LIM_CP ECU_ADDRESS 0xc0001f88 BIT_MASK 0x1 /end MEASUREMENT
/begin CHARACTERISTIC c_tia_min_cp "minimum intake air temperature for closing of the CPS" VALUE 0xa100617d _REC_VAL_20_u1 190.5 _CNV_A_R_LINEAR_____16_CM -48. 142.5 DISPLAY_IDENTIFIER C_TIA_MIN_CP FORMAT "%6.2" /end CHARACTERISTIC
/begin CHARACTERISTIC c_lamb_sp_s_cp_tol "Top limit on lamb_sp_s value" VALUE 0xa100610a _REC_VAL_20_u2 31.9990234375 _CNV_A_R_LINEAR_____122_CM 0. 31.9990234375 DISPLAY_IDENTIFIER C_LAMB_SP_S_CP_TOL FORMAT "%7.4" /end CHARACTERISTIC
/begin CHARACTERISTIC c_lamb_sp_s_dyw_cp "Dynamic window on lamb_sp_s" VALUE 0xa100610c _REC_VAL_20_u2 31.9990234375 _CNV_A_R_LINEAR_____122_CM 0. 31.9990234375 DISPLAY_IDENTIFIER C_LAMB_SP_S_DYW_CP FORMAT "%7.4" /end CHARACTERISTIC
/begin CHARACTERISTIC c_n_2_cp_bol "minimum speed limit for activation of the RAMP_OPEN operation in stratified" VALUE 0xa1006118 _REC_VAL_20_u1 8160. _CNV_A_R_LINEAR_____9_CM 0. 8160. DISPLAY_IDENTIFIER C_N_2_CP_BOL FORMAT "%4.0" /end CHARACTERISTIC
/begin CHARACTERISTIC c_n_2_cp_tol "maximum speed limit for activation of the RAMP_OPEN operation in stratified" VALUE 0xa1006119 _REC_VAL_20_u1 8160. _CNV_A_R_LINEAR_____9_CM 0. 8160. DISPLAY_IDENTIFIER C_N_2_CP_TOL FORMAT "%4.0" /end CHARACTERISTIC
/begin CHARACTERISTIC c_n_2_dyw_cp "N window for limited dynamics in stratified" VALUE 0xa100611a _REC_VAL_20_u1 8160. _CNV_A_R_LINEAR_____9_CM 0. 8160. DISPLAY_IDENTIFIER C_N_2_DYW_CP FORMAT "%4.0" /end CHARACTERISTIC
/begin CHARACTERISTIC c_lamb_sp_s_cp_bol "Bottom limit on lamb_sp_s value" VALUE 0xa1006108 _REC_VAL_20_u2 31.9990234375 _CNV_A_R_LINEAR_____122_CM 0. 31.9990234375 DISPLAY_IDENTIFIER C_LAMB_SP_S_CP_BOL FORMAT "%7.4" /end CHARACTERISTIC
/begin MEASUREMENT lamb_sp_s_dyw_cp "lamb_sp_s average value for dynamic window" UWORD _CNV_A_R_LINEAR_____122_CM 1 100. 0. 31.9990234375 DISPLAY_IDENTIFIER LAMB_SP_S_DYW_CP ECU_ADDRESS 0xc0001e8e FORMAT "%7.4" /end MEASUREMENT
/begin MEASUREMENT lv_cp_close_req "request to close the CPS valve" UBYTE _CNV_S_2_RANGE__0___1_CM 1 100. 0. 1. DISPLAY_IDENTIFIER LV_CP_CLOSE_REQ ECU_ADDRESS 0xd0002e87 BIT_MASK 0x1 /end MEASUREMENT
/begin MEASUREMENT lv_cp_dyw "dynamic window for canister purge" UBYTE _CNV_S_2_RANGE__0___1_CM 1 100. 0. 1. DISPLAY_IDENTIFIER LV_CP_DYW ECU_ADDRESS 0xd0002e89 BIT_MASK 0x1 /end MEASUREMENT
/begin MEASUREMENT lv_cp_win "engine operation within CP window (n & maf)" UBYTE _CNV_S_2_RANGE__0___1_CM 1 100. 0. 1. DISPLAY_IDENTIFIER LV_CP_WIN ECU_ADDRESS 0xc0001f7f BIT_MASK 0x1 /end MEASUREMENT
/begin MEASUREMENT lv_cp_pu "flag to interrupt the purge in PU mode" UBYTE _CNV_S_2_RANGE__0___1_CM 1 100. 0. 1. DISPLAY_IDENTIFIER LV_CP_PU ECU_ADDRESS 0xc0001f7e BIT_MASK 0x1 /end MEASUREMENT
/begin MEASUREMENT lv_cp_cmu_cmb "commutation combustion active" UBYTE _CNV_S_2_RANGE__0___1_CM 1 100. 0. 1. DISPLAY_IDENTIFIER LV_CP_CMU_CMB ECU_ADDRESS 0xd0002e88 BIT_MASK 0x1 /end MEASUREMENT
/begin MEASUREMENT fac_lam_cp_dyw "FAC_LAM_CP average value for dynamic window" SWORD _CNV_A_R_LINEAR_____110_CM 1 100. -50. 49.9984741210938 DISPLAY_IDENTIFIER FAC_LAM_CP_DYW ECU_ADDRESS 0xc0001e72 FORMAT "%7.3" /end MEASUREMENT
/begin CHARACTERISTIC c_fac_lam_cp_bol "limit on fac_lam_cp to start ramp_open" VALUE 0xa10060dc _REC_VAL_20_s2 99.99847412109381 _CNV_A_R_LINEAR_____110_CM -50. 49.9984741210938 DISPLAY_IDENTIFIER C_FAC_LAM_CP_BOL FORMAT "%7.3" /end CHARACTERISTIC
/begin CHARACTERISTIC c_prs_max_cps_2 "pressure difference limit (environment-intake mainfold) for direct switch to NO_PURGE (no ramp)" VALUE 0xa100612e _REC_VAL_20_s2 5434. _CNV_A_R_LINEAR_____297_CM -2717.04145876249 2716.95854123751 DISPLAY_IDENTIFIER C_PRS_MAX_CPS_2 FORMAT "%8.2" /end CHARACTERISTIC
/begin CHARACTERISTIC c_crlc_n_dyw_cp "filter constant for limited dynamics calculation on engine speed" VALUE 0xa10060c5 _REC_VAL_20_u1 0.99609375 _CNV_A_R_LINEAR_____27_CM 0. 0.99609375 DISPLAY_IDENTIFIER C_CRLC_N_DYW_CP FORMAT "%5.3" /end CHARACTERISTIC
/begin CHARACTERISTIC c_crlc_maf_dyw_cp "filter constant for limited dynamics calculation on MAF" VALUE 0xa10060c4 _REC_VAL_20_u1 0.99609375 _CNV_A_R_LINEAR_____27_CM 0. 0.99609375 DISPLAY_IDENTIFIER C_CRLC_MAF_DYW_CP FORMAT "%5.3" /end CHARACTERISTIC
/begin CHARACTERISTIC c_crlc_tqi_dyw_cp "filter constant for limited dynamics calculation on tqi_sp in stratified" VALUE 0xa10060c9 _REC_VAL_20_u1 0.99609375 _CNV_A_R_LINEAR_____27_CM 0. 0.99609375 DISPLAY_IDENTIFIER C_CRLC_TQI_DYW_CP FORMAT "%5.3" /end CHARACTERISTIC
/begin CHARACTERISTIC c_crlc_lam_dyw_cp "filter constant for limited dynamics calculation on lambda controller in non-normal purge" VALUE 0xa10060c2 _REC_VAL_20_u1 0.99609375 _CNV_A_R_LINEAR_____27_CM 0. 0.99609375 DISPLAY_IDENTIFIER C_CRLC_LAM_DYW_CP FORMAT "%5.3" /end CHARACTERISTIC
/begin CHARACTERISTIC c_crlc_lamb_sp_s_dyw_cp "filter constant for limited dynamics calculation on lambda setpoint in stratified" VALUE 0xa10060c3 _REC_VAL_20_u1 0.99609375 _CNV_A_R_LINEAR_____27_CM 0. 0.99609375 DISPLAY_IDENTIFIER C_CRLC_LAMB_SP_S_DYW_CP FORMAT "%5.3" /end CHARACTERISTIC
/begin CHARACTERISTIC lc_cp_cll_s_inh "selection of MIN_PURGE during stratified mode (=1)" VALUE 0xa100619f _REC_VAL_20_u1 1. _CNV_A_R_LINEAR_____0_CM 0. 1. DISPLAY_IDENTIFIER LC_CP_CLL_S_INH FORMAT "%1.0" /end CHARACTERISTIC
/begin CHARACTERISTIC lc_cp_cll_inh_man "switch for deactivation of closed loop canister purge (\"normal purge\")" VALUE 0xa100619e _REC_VAL_20_u1 1. _CNV_A_R_LINEAR_____0_CM 0. 1. DISPLAY_IDENTIFIER LC_CP_CLL_INH_MAN FORMAT "%1.0" /end CHARACTERISTIC
/begin CHARACTERISTIC lc_cp_inh_man "switch for deactivation of  canister purge and force NO_PURGE" VALUE 0xa10061a5 _REC_VAL_20_u1 1. _CNV_A_R_LINEAR_____0_CM 0. 1. DISPLAY_IDENTIFIER LC_CP_INH_MAN FORMAT "%1.0" /end CHARACTERISTIC
/begin CHARACTERISTIC lc_cp_dyw_clc_ena "1: calculation of dynamic window conditions" VALUE 0xa10061a0 _REC_VAL_20_u1 1. _CNV_A_R_LINEAR_____0_CM 0. 1. DISPLAY_IDENTIFIER LC_CP_DYW_CLC_ENA FORMAT "%1.0" /end CHARACTERISTIC
/begin CHARACTERISTIC lc_cp_dyw_lam_ad "1: use the limited dynamics flag of the lambda adaption (common flag lamb ad/cp)" VALUE 0xa10061a2 _REC_VAL_20_u1 1. _CNV_A_R_LINEAR_____0_CM 0. 1. DISPLAY_IDENTIFIER LC_CP_DYW_LAM_AD FORMAT "%1.0" /end CHARACTERISTIC
/begin CHARACTERISTIC lc_cp_dyw_clc_max_ena "1: calculate lim. dynamics / lambda contr. limits etc. also with n_max_cp exceeded" VALUE 0xa10061a1 _REC_VAL_20_u1 1. _CNV_A_R_LINEAR_____0_CM 0. 1. DISPLAY_IDENTIFIER LC_CP_DYW_CLC_MAX_ENA FORMAT "%1.0" /end CHARACTERISTIC
/begin CHARACTERISTIC lc_lam_dyw_cp_ini_deac "1: deactivate dynamic window on lambda control at deactivated normal purge" VALUE 0xa10061b6 _REC_VAL_20_u1 1. _CNV_A_R_LINEAR_____0_CM 0. 1. DISPLAY_IDENTIFIER LC_LAM_DYW_CP_INI_DEAC FORMAT "%1.0" /end CHARACTERISTIC
/begin CHARACTERISTIC c_fac_lam_cp_dyw "" VALUE 0xa10060de _REC_VAL_20_s2 99.99847412109381 _CNV_A_R_LINEAR_____110_CM -50. 49.9984741210938 DISPLAY_IDENTIFIER C_FAC_LAM_CP_DYW FORMAT "%7.3" /end CHARACTERISTIC
/begin CHARACTERISTIC c_state_cdn_cp_man "manual selection of STATE_CDN_CP" VALUE 0xa1006134 _REC_VAL_20_u1 5. _CNV_S_6_STATE_CDN__298_CM 0. 5. DISPLAY_IDENTIFIER C_STATE_CDN_CP_MAN /end CHARACTERISTIC
/begin CHARACTERISTIC c_fac_lam_cp_tol "limit on fac_lam_cp to start ramp_open" VALUE 0xa10060e0 _REC_VAL_20_s2 99.99847412109381 _CNV_A_R_LINEAR_____110_CM -50. 49.9984741210938 DISPLAY_IDENTIFIER C_FAC_LAM_CP_TOL FORMAT "%7.3" /end CHARACTERISTIC
/begin MEASUREMENT lv_cp_cdn_min_purge_fast "flag for usage of CL-model; =1: MIN_PURGE forced, no CL-mdl usage possible" UBYTE _CNV_S_2_RANGE__0___1_CM 1 100. 0. 1. DISPLAY_IDENTIFIER LV_CP_CDN_MIN_PURGE_FAST ECU_ADDRESS 0xd0002e80 BIT_MASK 0x1 /end MEASUREMENT
/begin CHARACTERISTIC lc_state_cdn_cp_man "switch to activate test mode // manual setting of STATE_CDN_CP" VALUE 0xa10061bf _REC_VAL_20_u1 1. _CNV_A_R_LINEAR_____0_CM 0. 1. DISPLAY_IDENTIFIER LC_STATE_CDN_CP_MAN FORMAT "%1.0" /end CHARACTERISTIC
/begin CHARACTERISTIC lc_prs_cps_ext "switch to use externally calculated value for PRS_CPS" VALUE 0xa10061bd _REC_VAL_20_u1 1. _CNV_A_R_LINEAR_____0_CM 0. 1. DISPLAY_IDENTIFIER LC_PRS_CPS_EXT FORMAT "%1.0" /end CHARACTERISTIC
/begin CHARACTERISTIC c_t_dly_pu_cps "time for CPS interruption during PU" VALUE 0xa1006162 _REC_VAL_20_u2 6552.5 _CNV_A_R_LINEAR_____4_CM 1. 6553.5 DISPLAY_IDENTIFIER C_T_DLY_PU_CPS FORMAT "%6.1" /end CHARACTERISTIC
/begin CHARACTERISTIC c_dly_n_maf_dyw_cp "time delay to stabilization condition " VALUE 0xa10060cc _REC_VAL_20_u2 1310.7 _CNV_A_R_LINEAR_____107_CM 0. 1310.7 DISPLAY_IDENTIFIER C_DLY_N_MAF_DYW_CP FORMAT "%7.2" /end CHARACTERISTIC
/begin CHARACTERISTIC c_tqi_cp_bol "tqi_sp_s  minimum value for RAMP_OPEN condition during stratified" VALUE 0xa1006182 _REC_VAL_20_s2 1023.96875 _CNV_A_R_LINEAR_____30_CM 0. 1023.96875 DISPLAY_IDENTIFIER C_TQI_CP_BOL FORMAT "%11.5" /end CHARACTERISTIC
/begin CHARACTERISTIC c_tqi_cp_tol "tqi_sp_s  maximum value for RAMP_OPEN condition during stratified" VALUE 0xa1006184 _REC_VAL_20_s2 1023.96875 _CNV_A_R_LINEAR_____30_CM 0. 1023.96875 DISPLAY_IDENTIFIER C_TQI_CP_TOL FORMAT "%11.5" /end CHARACTERISTIC
/begin CHARACTERISTIC c_tqi_dyw_cp "Dynamic window on tqi_sp_s" VALUE 0xa1006186 _REC_VAL_20_s2 1023.96875 _CNV_A_R_LINEAR_____30_CM 0. 1023.96875 DISPLAY_IDENTIFIER C_TQI_DYW_CP FORMAT "%11.5" /end CHARACTERISTIC
/begin CHARACTERISTIC c_dly_n_tqi_dyw_cp "time delay to stabilization condition " VALUE 0xa10060ce _REC_VAL_20_u2 1310.7 _CNV_A_R_LINEAR_____107_CM 0. 1310.7 DISPLAY_IDENTIFIER C_DLY_N_TQI_DYW_CP FORMAT "%7.2" /end CHARACTERISTIC
/begin CHARACTERISTIC c_t_dly_lam_cp "Delay on lambda control stabilization to restart RAMP_OPEN" VALUE 0xa100615c _REC_VAL_20_u2 65534. _CNV_A_R_LINEAR_____35_CM 1. 65535. DISPLAY_IDENTIFIER C_T_DLY_LAM_CP FORMAT "%5.0" /end CHARACTERISTIC
/begin CHARACTERISTIC c_t_dly_cmu_min_s_cp "Delay to start lamb_ratio_cp computation when min_learn_s is possible" VALUE 0xa1006150 _REC_VAL_20_u2 6552.5 _CNV_A_R_LINEAR_____4_CM 1. 6553.5 DISPLAY_IDENTIFIER C_T_DLY_CMU_MIN_S_CP FORMAT "%6.1" /end CHARACTERISTIC
/begin MEASUREMENT tqi_dyw_cp "tqi_sp_s average value for dynamic window " SWORD _CNV_A_R_LINEAR_____30_CM 1 100. 0. 1023.96875 DISPLAY_IDENTIFIER TQI_DYW_CP ECU_ADDRESS 0xc0001f64 FORMAT "%11.5" /end MEASUREMENT
/begin MEASUREMENT t_dly_dyw_cp "" UWORD _CNV_A_R_LINEAR_____107_CM 1 100. 0. 1310.7 DISPLAY_IDENTIFIER T_DLY_DYW_CP ECU_ADDRESS 0xc0001f5c FORMAT "%7.2" /end MEASUREMENT
/begin CHARACTERISTIC c_state_win_cp_not "state to be forced if engine operation outside CP window" VALUE 0xa1006138 _REC_VAL_20_u1 2. _CNV_S_3_STATE_TRAN_299_CM 0. 2. DISPLAY_IDENTIFIER C_STATE_WIN_CP_NOT /end CHARACTERISTIC
/begin CHARACTERISTIC c_state_lam_lim_cp "state to be forced if engine operation outside CP window" VALUE 0xa1006135 _REC_VAL_20_u1 2. _CNV_S_3_STATE_TRAN_299_CM 0. 2. DISPLAY_IDENTIFIER C_STATE_LAM_LIM_CP /end CHARACTERISTIC
/begin CHARACTERISTIC ip_maf_cp_bol "stabilization delay on lambda regulation after commutation" CURVE 0xa1005c08 _REC_CUR_20_u1_u1 1389. _CNV_A_R_LINEAR_____14_CM 0. 1389. DISPLAY_IDENTIFIER IP_MAF_CP_BOL FORMAT "%4.0"
 /begin AXIS_DESCR COM_AXIS n_32 _CNV_A_R_LINEAR_____9_CM 8 0. 8160. FORMAT "%4.0" AXIS_PTS_REF ldpm_n_32_3_evac /end AXIS_DESCR
/end CHARACTERISTIC
/begin CHARACTERISTIC ip_maf_cp_tol "stabilization delay on lambda regulation after commutation" CURVE 0xa1005c10 _REC_CUR_20_u1_u1 1389. _CNV_A_R_LINEAR_____14_CM 0. 1389. DISPLAY_IDENTIFIER IP_MAF_CP_TOL FORMAT "%4.0"
 /begin AXIS_DESCR COM_AXIS n_32 _CNV_A_R_LINEAR_____9_CM 8 0. 8160. FORMAT "%4.0" AXIS_PTS_REF ldpm_n_32_3_evac /end AXIS_DESCR
/end CHARACTERISTIC
/begin CHARACTERISTIC ip_t_dly_cmu_cps "stabilization delay on lambda regulation after commutation" CURVE 0xa1006030 _REC_CUR_20_u2_u1 6553.5 _CNV_A_R_LINEAR_____4_CM 0. 6553.5 DISPLAY_IDENTIFIER IP_T_DLY_CMU_CPS FORMAT "%6.1"
 /begin AXIS_DESCR COM_AXIS n_32 _CNV_A_R_LINEAR_____9_CM 6 0. 8160. FORMAT "%4.0" AXIS_PTS_REF ldp_n_32_ip_t_dly_cmu_cps /end AXIS_DESCR
/end CHARACTERISTIC
/begin CHARACTERISTIC ip_t_st_ast_tco_st_cps_min "Minimum temperature for EVAP - Control active" CURVE 0xa1006060 _REC_CUR_20_u2_u1 6553.400000000001 _CNV_A_R_LINEAR_____4_CM 0.1 6553.5 DISPLAY_IDENTIFIER IP_T_ST_AST_TCO_ST_CPS_MIN FORMAT "%6.1"
 /begin AXIS_DESCR COM_AXIS tco_st _CNV_A_R_LINEAR_____16_CM 6 -48. 142.5 FORMAT "%6.2" AXIS_PTS_REF ldp_tco_st_ip_t_st /end AXIS_DESCR
/end CHARACTERISTIC
/begin AXIS_PTS ldp_n_32_ip_t_dly_cmu_cps "" 0xa100529c n_32 _REC_AXS_20_u1 8160. _CNV_A_R_LINEAR_____9_CM 6 0. 8160. FORMAT "%4.0" /end AXIS_PTS
/begin AXIS_PTS ldp_tco_st_ip_t_st "" 0xa10052d8 tco_st _REC_AXS_20_u1 190.5 _CNV_A_R_LINEAR_____16_CM 6 -48. 142.5 FORMAT "%6.2" /end AXIS_PTS
/begin CHARACTERISTIC lc_cp_act "central switch for activation / deactivation of canister purge functions" VALUE 0xa100619c _REC_VAL_20_u1 1. _CNV_A_R_LINEAR_____0_CM 0. 1. DISPLAY_IDENTIFIER LC_CP_ACT FORMAT "%1.0" /end CHARACTERISTIC
/begin CHARACTERISTIC c_maf_dyw_cp "mass air flow window for limited dynamics " VALUE 0xa1006112 _REC_VAL_20_u2 1389. _CNV_A_R_LINEAR_____108_CM 0. 1389. DISPLAY_IDENTIFIER C_MAF_DYW_CP FORMAT "%7.2" /end CHARACTERISTIC
/begin MEASUREMENT prs_cps "pressure difference envoroment over  CPS line" SWORD _CNV_A_R_LINEAR_____297_CM 1 100. -2717.04145876249 2716.95854123751 DISPLAY_IDENTIFIER PRS_CPS ECU_ADDRESS 0xd00026ce FORMAT "%8.2" /end MEASUREMENT
/begin CHARACTERISTIC lc_cp_ast_act "switch for lv_ast using to activate canister purge functions" VALUE 0xa100619d _REC_VAL_20_u1 1. _CNV_A_R_LINEAR_____0_CM 0. 1. DISPLAY_IDENTIFIER LC_CP_AST_ACT FORMAT "%1.0" /end CHARACTERISTIC
/begin CHARACTERISTIC c_maf_cp_bol_hys "mass air flow window  limit hysteresis for RO activation" VALUE 0xa100610e _REC_VAL_20_u1 1389. _CNV_A_R_LINEAR_____14_CM 0. 1389. DISPLAY_IDENTIFIER C_MAF_CP_BOL_HYS FORMAT "%4.0" /end CHARACTERISTIC
/begin MEASUREMENT state_cdn_cp "activation conditions for evaporative emission control function" UBYTE _CNV_S_6_STATE_CDN__298_CM 1 100. 0. 5. DISPLAY_IDENTIFIER STATE_CDN_CP ECU_ADDRESS 0xd0002ea7 /end MEASUREMENT
/begin MEASUREMENT cppwm_lih "PWM signal for CPS opening limp home value" UBYTE _CNV_A_R_LINEAR_____5_CM 1 100. 0. 99.609375 DISPLAY_IDENTIFIER CPPWM_LIH ECU_ADDRESS 0xd0002ea1 FORMAT "%9.6" /end MEASUREMENT
/begin CHARACTERISTIC c_cppwm_sub_diag_1 "anti-bounce counter increment for CPS diagnosis" VALUE 0xa10060bb _REC_VAL_20_u1 99.609375 _CNV_A_R_LINEAR_____5_CM 0. 99.609375 DISPLAY_IDENTIFIER C_CPPWM_SUB_DIAG_1 FORMAT "%9.6" /end CHARACTERISTIC
/begin CHARACTERISTIC c_cppwm_sub_diag_2 "anti-bounce counter increment for CPS diagnosis" VALUE 0xa10060bc _REC_VAL_20_u1 99.609375 _CNV_A_R_LINEAR_____5_CM 0. 99.609375 DISPLAY_IDENTIFIER C_CPPWM_SUB_DIAG_2 FORMAT "%9.6" /end CHARACTERISTIC
/begin CHARACTERISTIC c_abc_max_el_cps_diag "anti-bounce counter maximum for CPS diagnosis" VALUE 0xa100607d _REC_VAL_20_u1 255. _CNV_A_R_LINEAR_____0_CM 0. 255. DISPLAY_IDENTIFIER C_ABC_MAX_EL_CPS_DIAG FORMAT "%3.0" /end CHARACTERISTIC
/begin CHARACTERISTIC c_abc_inc_el_cps_diag "anti-bounce counter increment for CPS diagnosis" VALUE 0xa100607c _REC_VAL_20_u1 255. _CNV_A_R_LINEAR_____0_CM 0. 255. DISPLAY_IDENTIFIER C_ABC_INC_EL_CPS_DIAG FORMAT "%3.0" /end CHARACTERISTIC
/begin CHARACTERISTIC c_cppwm_diag_min_scp "Minimum threshold for SCP diagnosis window" VALUE 0xa10060a4 _REC_VAL_20_u1 99.609375 _CNV_A_R_LINEAR_____5_CM 0. 99.609375 DISPLAY_IDENTIFIER C_CPPWM_DIAG_MIN_SCP FORMAT "%9.6" /end CHARACTERISTIC
/begin CHARACTERISTIC c_cppwm_diag_max_scg "Maximum threshold for SCG diagnosis window" VALUE 0xa10060a2 _REC_VAL_20_u1 99.609375 _CNV_A_R_LINEAR_____5_CM 0. 99.609375 DISPLAY_IDENTIFIER C_CPPWM_DIAG_MAX_SCG FORMAT "%9.6" /end CHARACTERISTIC
/begin CHARACTERISTIC c_cppwm_diag_min_oc "Minimum threshold for OC diagnosis window" VALUE 0xa10060a3 _REC_VAL_20_u1 99.609375 _CNV_A_R_LINEAR_____5_CM 0. 99.609375 DISPLAY_IDENTIFIER C_CPPWM_DIAG_MIN_OC FORMAT "%9.6" /end CHARACTERISTIC
/begin MEASUREMENT lv_err_el_cps "Logical value for present electrical canister purge valve failure" UBYTE _CNV_S_2_RANGE__0___1_CM 1 100. 0. 1. DISPLAY_IDENTIFIER LV_ERR_EL_CPS ECU_ADDRESS 0xd00033c7 BIT_MASK 0x1 /end MEASUREMENT
/begin MEASUREMENT tq_add_cp "torque reserve for canister purge at idle" SWORD _CNV_A_R_LINEAR_____30_CM 1 100. -1024. 1023.96875 DISPLAY_IDENTIFIER TQ_ADD_CP ECU_ADDRESS 0xd00026d6 FORMAT "%11.5" /end MEASUREMENT
/begin CHARACTERISTIC c_crlc_tq_add_cp "filter constant" VALUE 0xa10060c8 _REC_VAL_20_u1 0.99609375 _CNV_A_R_LINEAR_____27_CM 0. 0.99609375 DISPLAY_IDENTIFIER C_CRLC_TQ_ADD_CP FORMAT "%5.3" /end CHARACTERISTIC
/begin CHARACTERISTIC lc_tq_add_cp_inh "logical variable for activating/disactivating the torque reserve for canister purge in idle" VALUE 0xa10061c0 _REC_VAL_20_u1 1. _CNV_A_R_LINEAR_____0_CM 0. 1. DISPLAY_IDENTIFIER LC_TQ_ADD_CP_INH FORMAT "%1.0" /end CHARACTERISTIC
/begin AXIS_PTS ldp_cl_mmv_ip_tq_add_cp "" 0xa1005234 cl_mmv _REC_AXS_20_u1 1.9921875 _CNV_A_R_LINEAR_____100_CM 8 0. 1.9921875 FORMAT "%8.6" /end AXIS_PTS
/begin CHARACTERISTIC ip_tq_add_cp "map for determination of TQ_ADD_CP in dependence of CL_MMV" CURVE 0xa100606c _REC_CUR_20_u2_u1 2047.96875 _CNV_A_R_LINEAR_____65_CM -1024. 1023.96875 DISPLAY_IDENTIFIER IP_TQ_ADD_CP FORMAT "%11.5"
 /begin AXIS_DESCR COM_AXIS cl_mmv _CNV_A_R_LINEAR_____100_CM 8 0. 1.9921875 FORMAT "%8.6" AXIS_PTS_REF ldp_cl_mmv_ip_tq_add_cp /end AXIS_DESCR
/end CHARACTERISTIC
/begin MEASUREMENT lv_fac_lam_shift_cp_avl "=1: At least one lambda control shift during RAMP_OPEN done" UBYTE _CNV_S_2_RANGE__0___1_CM 1 100. 0. 1. DISPLAY_IDENTIFIER LV_FAC_LAM_SHIFT_CP_AVL ECU_ADDRESS 0xd0002e92 BIT_MASK 0x1 /end MEASUREMENT
/begin MEASUREMENT lv_cp_afl "copy of (bench-selective) LV_AFL (0: rich; 1: lean)" UBYTE _CNV_S_2_RANGE__0___1_CM 1 100. 0. 1. DISPLAY_IDENTIFIER LV_CP_AFL ECU_ADDRESS 0xd0002e7f BIT_MASK 0x1 /end MEASUREMENT
/begin MEASUREMENT mff_cp "fuel flow from the ACF" UWORD _CNV_A_R_LINEAR_____147_CM 1 100. 0. 7.9998779296875 DISPLAY_IDENTIFIER MFF_CP ECU_ADDRESS 0xd00026c8 FORMAT "%6.4" /end MEASUREMENT
/begin MEASUREMENT mff_add_cp_old "stored value of MFF_ADD_CP_OLD on disabled RAMP_OPEN" UWORD _CNV_A_R_LINEAR_____147_CM 1 100. 0. 7.9998779296875 DISPLAY_IDENTIFIER MFF_ADD_CP_OLD ECU_ADDRESS 0xc0001f40 FORMAT "%6.4" /end MEASUREMENT
/begin MEASUREMENT mff_lam_cp "fuel flow lambda control part from the ACF " SWORD _CNV_A_R_EVAC_LINEA_308_CM 1 100. -4. 4. DISPLAY_IDENTIFIER MFF_LAM_CP ECU_ADDRESS 0xc0001f46 FORMAT "%8.6" /end MEASUREMENT
/begin MEASUREMENT cl "canister load						" UWORD _CNV_A_R_LINEAR_____8_CM 1 100. 0. 1.99996948242188 DISPLAY_IDENTIFIER CL ECU_ADDRESS 0xd0002698 FORMAT "%7.5" /end MEASUREMENT
/begin MEASUREMENT fac_lam_0_cp "start value of the additive mass fuel correction TI_LAM_MMV before the CPS is opened" SWORD _CNV_A_R_LINEAR_____110_CM 1 100. -50. 49.9984741210938 DISPLAY_IDENTIFIER FAC_LAM_0_CP ECU_ADDRESS 0xc0001e70 FORMAT "%7.3" /end MEASUREMENT
/begin MEASUREMENT fac_lam_dif_cp "lambda deviation with active canister purge" SWORD _CNV_A_R_LINEAR_____110_CM 1 100. -50. 49.9984741210938 DISPLAY_IDENTIFIER FAC_LAM_DIF_CP ECU_ADDRESS 0xd00026a8 FORMAT "%7.3" /end MEASUREMENT
/begin MEASUREMENT fac_lam_shift_cp "correction value for lambda control correction during RAMP_OPEN operation" SWORD _CNV_A_R_LINEAR_____110_CM 1 100. -50. 49.9984741210938 DISPLAY_IDENTIFIER FAC_LAM_SHIFT_CP ECU_ADDRESS 0xd00026ac FORMAT "%7.3" /end MEASUREMENT
/begin CHARACTERISTIC ip_crlc_fac_lam_mv_mmv_cp_opl "correlation constant for FAC_LAM_MV_MMV_CP calculation in case of Purge in open loop" CURVE 0xa1005590 _REC_CUR_20_u1_u2 0.99609375 _CNV_A_R_LINEAR_____27_CM 0. 0.99609375 DISPLAY_IDENTIFIER IP_CRLC_FAC_LAM_MV_MMV_CP_OPL FORMAT "%5.3"
 /begin AXIS_DESCR COM_AXIS maf_cyl _CNV_A_R_LINEAR_____207_CM 6 0. 2047.96875 FORMAT "%10.5" AXIS_PTS_REF ldpm_maf_cyl_1_evac /end AXIS_DESCR
/end CHARACTERISTIC
/begin CHARACTERISTIC ip_crlc_fac_lam_mv_mmv_cp_cll "correlation constant for FAC_LAM_MV_MMV_CP calculation in case of Purge in closed loop" CURVE 0xa100558a _REC_CUR_20_u1_u2 0.99609375 _CNV_A_R_LINEAR_____27_CM 0. 0.99609375 DISPLAY_IDENTIFIER IP_CRLC_FAC_LAM_MV_MMV_CP_CLL FORMAT "%5.3"
 /begin AXIS_DESCR COM_AXIS maf_cyl _CNV_A_R_LINEAR_____207_CM 6 0. 2047.96875 FORMAT "%10.5" AXIS_PTS_REF ldpm_maf_cyl_1_evac /end AXIS_DESCR
/end CHARACTERISTIC
/begin CHARACTERISTIC c_raf_clc_cp "stoiciometric fuel constant: ca. 14,7" VALUE 0xa1006132 _REC_VAL_20_u2 255.99609375 _CNV_A_R_LINEAR_____27_CM 0. 255.99609375 DISPLAY_IDENTIFIER C_RAF_CLC_CP FORMAT "%10.6" /end CHARACTERISTIC
/begin CHARACTERISTIC c_cl_fac_lam_dif_max "Upper limit on FAC_LAM_DIF_CP value variation" VALUE 0xa1006082 _REC_VAL_20_s2 99.99847412109381 _CNV_A_R_LINEAR_____110_CM -50. 49.9984741210938 DISPLAY_IDENTIFIER C_CL_FAC_LAM_DIF_MAX FORMAT "%7.3" /end CHARACTERISTIC
/begin CHARACTERISTIC c_cl_fac_lam_dif_min "Lower limit on FAC_LAM_DIF_CP value variation" VALUE 0xa1006084 _REC_VAL_20_s2 99.99847412109381 _CNV_A_R_LINEAR_____110_CM -50. 49.9984741210938 DISPLAY_IDENTIFIER C_CL_FAC_LAM_DIF_MIN FORMAT "%7.3" /end CHARACTERISTIC
/begin CHARACTERISTIC c_cl_st_cp "Initialization value for canister load CL" VALUE 0xa100609c _REC_VAL_20_u2 1.99996948242188 _CNV_A_R_LINEAR_____8_CM 0. 1.99996948242188 DISPLAY_IDENTIFIER C_CL_ST_CP FORMAT "%7.5" /end CHARACTERISTIC
/begin CHARACTERISTIC c_prs_max_2_cps "pressure difference limit (environment-intake mainfold) for cl_mmv calculation" VALUE 0xa100612a _REC_VAL_20_s2 5434. _CNV_A_R_LINEAR_____297_CM -2717.04145876249 2716.95854123751 DISPLAY_IDENTIFIER C_PRS_MAX_2_CPS FORMAT "%8.2" /end CHARACTERISTIC
/begin CHARACTERISTIC ip_cl_crlc_open_fast "Correlation constant for CL-filter during RAMP_OPEN_FAST" CURVE 0xa1005428 _REC_CUR_20_u2_u2 0.9999847412109381 _CNV_A_R_LINEAR_____68_CM 0. 0.9999847412109381 DISPLAY_IDENTIFIER IP_CL_CRLC_OPEN_FAST FORMAT "%7.5"
 /begin AXIS_DESCR COM_AXIS maf_cyl _CNV_A_R_LINEAR_____207_CM 6 0. 2047.96875 FORMAT "%10.5" AXIS_PTS_REF ldpm_maf_cyl_1_evac /end AXIS_DESCR
/end CHARACTERISTIC
/begin CHARACTERISTIC ip_cl_crlc_ramp_open "Correlation constant for CL-filter during RAMP_OPEN" CURVE 0xa1005434 _REC_CUR_20_u2_u2 0.9999847412109381 _CNV_A_R_LINEAR_____68_CM 0. 0.9999847412109381 DISPLAY_IDENTIFIER IP_CL_CRLC_RAMP_OPEN FORMAT "%7.5"
 /begin AXIS_DESCR COM_AXIS maf_cyl _CNV_A_R_LINEAR_____207_CM 6 0. 2047.96875 FORMAT "%10.5" AXIS_PTS_REF ldpm_maf_cyl_1_evac /end AXIS_DESCR
/end CHARACTERISTIC
/begin CHARACTERISTIC c_cl_max_cp "Maximum limit for canister load CL" VALUE 0xa1006086 _REC_VAL_20_u2 1.99996948242188 _CNV_A_R_LINEAR_____8_CM 0. 1.99996948242188 DISPLAY_IDENTIFIER C_CL_MAX_CP FORMAT "%7.5" /end CHARACTERISTIC
/begin CHARACTERISTIC ip_nr_step_cl "Number of step to change of correlation factor value" CURVE 0xa1005c6c _REC_CUR_20_u2_u2 0.9999847412109381 _CNV_A_R_LINEAR_____68_CM 0. 0.9999847412109381 DISPLAY_IDENTIFIER IP_NR_STEP_CL FORMAT "%7.5"
 /begin AXIS_DESCR COM_AXIS cl_mmv _CNV_A_R_LINEAR_____8_CM 3 0. 1.99996948242188 FORMAT "%7.5" AXIS_PTS_REF ldpm_cl_mmv_1_evac /end AXIS_DESCR
/end CHARACTERISTIC
/begin CHARACTERISTIC ip_cl_crlc_ini "Initialization value for correlation factor value" CURVE 0xa1005420 _REC_CUR_20_u2_u2 0.9999847412109381 _CNV_A_R_LINEAR_____68_CM 0. 0.9999847412109381 DISPLAY_IDENTIFIER IP_CL_CRLC_INI FORMAT "%7.5"
 /begin AXIS_DESCR COM_AXIS cl_mmv _CNV_A_R_LINEAR_____8_CM 3 0. 1.99996948242188 FORMAT "%7.5" AXIS_PTS_REF ldpm_cl_mmv_1_evac /end AXIS_DESCR
/end CHARACTERISTIC
/begin MEASUREMENT mff_add_cp_kgh "additive adaptive fuel flow from the ACF for the additive mass fuel correction" UWORD _CNV_A_R_LINEAR_____147_CM 1 100. 0. 7.9998779296875 DISPLAY_IDENTIFIER MFF_ADD_CP_KGH ECU_ADDRESS 0xd00026c2 FORMAT "%6.4" /end MEASUREMENT
/begin MEASUREMENT crlc_cl "temporary variable: correlation constant for CL_MMV calculation" UWORD _CNV_A_R_LINEAR_____68_CM 1 100. 0. 0.9999847412109381 DISPLAY_IDENTIFIER CRLC_CL ECU_ADDRESS 0xc0001e66 FORMAT "%7.5" /end MEASUREMENT
/begin MEASUREMENT cl_mmv_dyw_max "Maximum value of the dynamic window during RAMP_OPEN" UWORD _CNV_A_R_LINEAR_____8_CM 1 100. 0. 1.99996948242188 DISPLAY_IDENTIFIER CL_MMV_DYW_MAX ECU_ADDRESS 0xc0001e5e FORMAT "%7.5" /end MEASUREMENT
/begin MEASUREMENT cl_mmv_dyw_min "Minimum value of the dynamic window during RAMP_OPEN" UWORD _CNV_A_R_LINEAR_____8_CM 1 100. 0. 1.99996948242188 DISPLAY_IDENTIFIER CL_MMV_DYW_MIN ECU_ADDRESS 0xc0001e60 FORMAT "%7.5" /end MEASUREMENT
/begin CHARACTERISTIC c_cppwm_min_cl "minimum valve pwm signal to enable CL calculation" VALUE 0xa10060b8 _REC_VAL_20_u1 99.609375 _CNV_A_R_LINEAR_____5_CM 0. 99.609375 DISPLAY_IDENTIFIER C_CPPWM_MIN_CL FORMAT "%9.6" /end CHARACTERISTIC
/begin CHARACTERISTIC c_cl_mmv_dyw "Dynamic window on CL_MMV value during RAMP_OPEN" VALUE 0xa100608e _REC_VAL_20_u2 1.99996948242188 _CNV_A_R_LINEAR_____8_CM 0. 1.99996948242188 DISPLAY_IDENTIFIER C_CL_MMV_DYW FORMAT "%7.5" /end CHARACTERISTIC
/begin CHARACTERISTIC ip_t_dly_cl_mmv_dyw "Stabilization delay on CL_MMV value during RAMP_OPEN " CURVE 0xa1006024 _REC_CUR_20_u2_u2 6552.5 _CNV_A_R_LINEAR_____4_CM 1. 6553.5 DISPLAY_IDENTIFIER IP_T_DLY_CL_MMV_DYW FORMAT "%6.1"
 /begin AXIS_DESCR COM_AXIS maf_cyl _CNV_A_R_LINEAR_____207_CM 6 0. 2047.96875 FORMAT "%10.5" AXIS_PTS_REF ldpm_maf_cyl_1_evac /end AXIS_DESCR
/end CHARACTERISTIC
/begin CHARACTERISTIC c_fac_lam_dif_cp_as "Application system value to apply a lambda deviation" VALUE 0xa10060e2 _REC_VAL_20_s2 99.99847412109381 _CNV_A_R_LINEAR_____110_CM -50. 49.9984741210938 DISPLAY_IDENTIFIER C_FAC_LAM_DIF_CP_AS FORMAT "%7.3" /end CHARACTERISTIC
/begin MEASUREMENT crlc_fac_lam_mv_mmv_cp "Filter constant for FAC_LAM_MV_MMV_CP calculation" UBYTE _CNV_A_R_LINEAR_____27_CM 1 100. 0. 0.99609375 DISPLAY_IDENTIFIER CRLC_FAC_LAM_MV_MMV_CP ECU_ADDRESS 0xd0002ea2 FORMAT "%5.3" /end MEASUREMENT
/begin MEASUREMENT fac_lam_grd "Gradient of lambda control output" SWORD _CNV_A_R_LINEAR_____110_CM 1 100. -50. 49.9984741210938 DISPLAY_IDENTIFIER FAC_LAM_GRD ECU_ADDRESS 0xc0001e74 FORMAT "%7.3" /end MEASUREMENT
/begin MEASUREMENT fac_lam_cp "lambda control correction value used for canister load calculation" SWORD _CNV_A_R_LINEAR_____110_CM 1 100. -50. 49.9984741210938 DISPLAY_IDENTIFIER FAC_LAM_CP ECU_ADDRESS 0xd00026a6 FORMAT "%7.3" /end MEASUREMENT
/begin MEASUREMENT fac_lam_grd_mmv "Moving mean value of lambda gradient" SWORD _CNV_A_R_LINEAR_____110_CM 1 100. -50. 49.9984741210938 DISPLAY_IDENTIFIER FAC_LAM_GRD_MMV ECU_ADDRESS 0xd00026aa FORMAT "%7.3" /end MEASUREMENT
/begin MEASUREMENT rate_flow_dly "Relative flow delay (FLOW_DLY_CP / MAF_DLY_MMV_CP)" UWORD _CNV_A_R_LINEAR_____68_CM 1 100. 0. 0.9999847412109381 DISPLAY_IDENTIFIER RATE_FLOW_DLY ECU_ADDRESS 0xc0001f4a FORMAT "%7.5" /end MEASUREMENT
/begin MEASUREMENT fac_crlc_cl "Reduction factor at CL filter constant determination" UWORD _CNV_A_R_LINEAR_____68_CM 1 100. 0. 0.9999847412109381 DISPLAY_IDENTIFIER FAC_CRLC_CL ECU_ADDRESS 0xc0001e6c FORMAT "%7.5" /end MEASUREMENT
/begin MEASUREMENT cl_mmv "moving mean value of the canister load CL" UWORD _CNV_A_R_LINEAR_____8_CM 1 100. 0. 1.99996948242188 DISPLAY_IDENTIFIER CL_MMV ECU_ADDRESS 0xd000269c FORMAT "%7.5" /end MEASUREMENT
/begin CHARACTERISTIC ip_cl_crlc "Correlation constant for CL-filter out of RAMP_OPEN" CURVE 0xa1005414 _REC_CUR_20_u2_u2 0.9999847412109381 _CNV_A_R_LINEAR_____68_CM 0. 0.9999847412109381 DISPLAY_IDENTIFIER IP_CL_CRLC FORMAT "%7.5"
 /begin AXIS_DESCR COM_AXIS maf_cyl _CNV_A_R_LINEAR_____207_CM 6 0. 2047.96875 FORMAT "%10.5" AXIS_PTS_REF ldpm_maf_cyl_1_evac /end AXIS_DESCR
/end CHARACTERISTIC
/begin AXIS_PTS ldp_rate_ip_fac_crlc_cl "" 0xa10052c4 rate_flow_dly _REC_AXS_20_u2 0.9999847412109381 _CNV_A_R_LINEAR_____68_CM 6 0. 0.9999847412109381 FORMAT "%7.5" /end AXIS_PTS
/begin CHARACTERISTIC ip_fac_cppwm "Reduction Factor at very low flow rates" CURVE 0xa10055b0 _REC_CUR_20_u2_u1 0.9999847412109381 _CNV_A_R_LINEAR_____68_CM 0. 0.9999847412109381 DISPLAY_IDENTIFIER IP_FAC_CPPWM FORMAT "%7.5"
 /begin AXIS_DESCR COM_AXIS cppwm_cps _CNV_A_R_LINEAR_____5_CM 6 0. 99.609375 FORMAT "%9.6" AXIS_PTS_REF ldp_cppwm_ip_fac_cppwm /end AXIS_DESCR
/end CHARACTERISTIC
/begin AXIS_PTS ldp_cppwm_ip_fac_cppwm "" 0xa100524a cppwm_cps _REC_AXS_20_u1 99.609375 _CNV_A_R_LINEAR_____5_CM 6 0. 99.609375 FORMAT "%9.6" /end AXIS_PTS
/begin AXIS_PTS ldp_fac_ip_fac_lam_grd_mmv "" 0xa1005254 fac_lam_grd_mmv _REC_AXS_20_u2 99.99847412 _CNV_A_R_LINEAR_____159_CM 6 -50. 49.99847412 FORMAT "%7.3" /end AXIS_PTS
/begin CHARACTERISTIC ip_fac_crlc_cl "Reduction Factor at very low flow rates" CURVE 0xa10055bc _REC_CUR_20_u2_u2 0.9999847412109381 _CNV_A_R_LINEAR_____68_CM 0. 0.9999847412109381 DISPLAY_IDENTIFIER IP_FAC_CRLC_CL FORMAT "%7.5"
 /begin AXIS_DESCR COM_AXIS rate_flow_dly _CNV_A_R_LINEAR_____68_CM 6 0. 0.9999847412109381 FORMAT "%7.5" AXIS_PTS_REF ldp_rate_ip_fac_crlc_cl /end AXIS_DESCR
/end CHARACTERISTIC
/begin CHARACTERISTIC c_cl_dyw_max_cp "maximum limit for canister load CL difference" VALUE 0xa1006080 _REC_VAL_20_u2 1.99996948242188 _CNV_A_R_LINEAR_____8_CM 0. 1.99996948242188 DISPLAY_IDENTIFIER C_CL_DYW_MAX_CP FORMAT "%7.5" /end CHARACTERISTIC
/begin CHARACTERISTIC c_crlc_fac_lam_grd "Correlation constant for lambda gradient" VALUE 0xa10060c0 _REC_VAL_20_u2 0.9999847412109381 _CNV_A_R_LINEAR_____68_CM 0. 0.9999847412109381 DISPLAY_IDENTIFIER C_CRLC_FAC_LAM_GRD FORMAT "%7.5" /end CHARACTERISTIC
/begin CHARACTERISTIC c_fac_lam_dif_max_cp "Maximum lambda deviation for injection time correction during RAMP_OPEN" VALUE 0xa10060e4 _REC_VAL_20_s2 99.99847412109381 _CNV_A_R_LINEAR_____110_CM -50. 49.9984741210938 DISPLAY_IDENTIFIER C_FAC_LAM_DIF_MAX_CP FORMAT "%7.3" /end CHARACTERISTIC
/begin CHARACTERISTIC c_fac_lam_thd_cl_mem "Threshold for FAC_LAM_GRD to save the last CL_MMV value" VALUE 0xa10060e8 _REC_VAL_20_s2 99.99847412109381 _CNV_A_R_LINEAR_____110_CM -50. 49.9984741210938 DISPLAY_IDENTIFIER C_FAC_LAM_THD_CL_MEM FORMAT "%7.3" /end CHARACTERISTIC
/begin MEASUREMENT cl_mmv_mem_cl_mdl "Last stored CL_MMV value before FAC_LAM_GRD_MMV exceeds a threshold" UWORD _CNV_A_R_LINEAR_____8_CM 1 100. 0. 1.99996948242188 DISPLAY_IDENTIFIER CL_MMV_MEM_CL_MDL ECU_ADDRESS 0xd00026a0 FORMAT "%7.5" /end MEASUREMENT
/begin MEASUREMENT cl_mmv_mem_cl_mdl_old "Last stored CL_MMV value before FAC_LAM_GRD_MMV exceeds a threshold" UWORD _CNV_A_R_LINEAR_____8_CM 1 100. 0. 1.99996948242188 DISPLAY_IDENTIFIER CL_MMV_MEM_CL_MDL_OLD ECU_ADDRESS 0xd00026a2 FORMAT "%7.5" /end MEASUREMENT
/begin MEASUREMENT lv_cp_new_ramp_open "Exit of normal purge by cl value conformity check requested" UBYTE _CNV_S_2_RANGE__0___1_CM 1 100. 0. 1. DISPLAY_IDENTIFIER LV_CP_NEW_RAMP_OPEN ECU_ADDRESS 0xd0002e8c BIT_MASK 0x1 /end MEASUREMENT
/begin MEASUREMENT lv_cl_mmv_cal_act "condition for CL calcuilation" UBYTE _CNV_S_2_RANGE__0___1_CM 1 100. 0. 1. DISPLAY_IDENTIFIER LV_CL_MMV_CAL_ACT ECU_ADDRESS 0xd0002e7c BIT_MASK 0x1 /end MEASUREMENT
/begin CHARACTERISTIC c_flow_min_cps "Limit on FLOW_CPS value for CL_MMV calculation" VALUE 0xa1006100 _REC_VAL_20_u2 7.9998779296875 _CNV_A_R_LINEAR_____147_CM 0. 7.9998779296875 DISPLAY_IDENTIFIER C_FLOW_MIN_CPS FORMAT "%6.4" /end CHARACTERISTIC
/begin CHARACTERISTIC c_flow_min_cps_ro "Limit on FLOW_CPS value for CL_MMV calculation" VALUE 0xa1006102 _REC_VAL_20_u2 7.9998779296875 _CNV_A_R_LINEAR_____147_CM 0. 7.9998779296875 DISPLAY_IDENTIFIER C_FLOW_MIN_CPS_RO FORMAT "%6.4" /end CHARACTERISTIC
/begin CHARACTERISTIC lc_cl_fil_ini_tra_deac_cll "Correlation factor calculation in case of NO_PURGE -> MAX_PURGE transition" VALUE 0xa1006199 _REC_VAL_20_u1 1. _CNV_A_R_LINEAR_____0_CM 0. 1. DISPLAY_IDENTIFIER LC_CL_FIL_INI_TRA_DEAC_CLL FORMAT "%1.0" /end CHARACTERISTIC
/begin CHARACTERISTIC lc_init_cl_crlc_ramp_open_fast "switch to force hom1 operation if cps valve short circuit to ground error present" VALUE 0xa10061b4 _REC_VAL_20_u1 1. _CNV_A_R_LINEAR_____0_CM 0. 1. DISPLAY_IDENTIFIER LC_INIT_CL_CRLC_RAMP_OPEN_FAST FORMAT "%1.0" /end CHARACTERISTIC
/begin MEASUREMENT lv_fac_lam_shift_cp "logical value for lambda control correction during RAMP_OPEN operation" UBYTE _CNV_S_2_RANGE__0___1_CM 1 100. 0. 1. DISPLAY_IDENTIFIER LV_FAC_LAM_SHIFT_CP ECU_ADDRESS 0xd0002e91 BIT_MASK 0x1 /end MEASUREMENT
/begin MEASUREMENT t_ramp_open_stab "time counter for CL stabilisation during RAMP_OPEN" UWORD _CNV_A_R_LINEAR_____4_CM 1 100. 0. 6553.5 DISPLAY_IDENTIFIER T_RAMP_OPEN_STAB ECU_ADDRESS 0xd00026d4 FORMAT "%6.1" /end MEASUREMENT
/begin CHARACTERISTIC c_fac_lam_0_max "Application system value to apply a lambda deviation" VALUE 0xa10060d8 _REC_VAL_20_s2 99.99847412109381 _CNV_A_R_LINEAR_____110_CM -50. 49.9984741210938 DISPLAY_IDENTIFIER C_FAC_LAM_0_MAX FORMAT "%7.3" /end CHARACTERISTIC
/begin CHARACTERISTIC c_fac_lam_0_min "Application system value to apply a lambda deviation" VALUE 0xa10060da _REC_VAL_20_s2 99.99847412109381 _CNV_A_R_LINEAR_____110_CM -50. 49.9984741210938 DISPLAY_IDENTIFIER C_FAC_LAM_0_MIN FORMAT "%7.3" /end CHARACTERISTIC
/begin AXIS_PTS ldpm_cl_mmv_1_evac "" 0xa10052f8 cl_mmv _REC_AXS_20_u2 1.99996948242188 _CNV_A_R_LINEAR_____8_CM 3 0. 1.99996948242188 FORMAT "%7.5" /end AXIS_PTS
/begin CHARACTERISTIC ip_fac_lam_grd_mmv "Reduction Factor at very low flow rates" CURVE 0xa10055d4 _REC_CUR_20_u2_u2 0.9999847412109381 _CNV_A_R_LINEAR_____68_CM 0. 0.9999847412109381 DISPLAY_IDENTIFIER IP_FAC_LAM_GRD_MMV FORMAT "%7.5"
 /begin AXIS_DESCR COM_AXIS fac_lam_grd_mmv _CNV_A_R_LINEAR_____159_CM 6 -50. 49.99847412 FORMAT "%7.3" AXIS_PTS_REF ldp_fac_ip_fac_lam_grd_mmv /end AXIS_DESCR
/end CHARACTERISTIC
/begin CHARACTERISTIC c_t_dly_max_ramp_open "Time out value during RAMP_OPEN operation" VALUE 0xa1006160 _REC_VAL_20_u2 6552.5 _CNV_A_R_LINEAR_____4_CM 1. 6553.5 DISPLAY_IDENTIFIER C_T_DLY_MAX_RAMP_OPEN FORMAT "%6.1" /end CHARACTERISTIC
/begin CHARACTERISTIC lc_lam_cbk_cps "lambda controler bank  selection " VALUE 0xa10061b5 _REC_VAL_20_u1 1. _CNV_A_R_LINEAR_____0_CM 0. 1. DISPLAY_IDENTIFIER LC_LAM_CBK_CPS FORMAT "%1.0" /end CHARACTERISTIC
/begin MEASUREMENT lamb_mmv_cp "Filtered value of Lambda for canister purge" UWORD _CNV_A_R_LINEAR_____122_CM 1 100. 0. 31.9990234375 DISPLAY_IDENTIFIER LAMB_MMV_CP ECU_ADDRESS 0xc0001e8c FORMAT "%7.4" /end MEASUREMENT
/begin MEASUREMENT lamb_lpf_cp "Low pass flter Lambda for canister purge" UWORD _CNV_A_R_LINEAR_____122_CM 1 100. 0. 31.9990234375 DISPLAY_IDENTIFIER LAMB_LPF_CP ECU_ADDRESS 0xc0001e8a FORMAT "%7.4" /end MEASUREMENT
/begin AXIS_PTS ldp_lamb_mmv_cp_ip_crlc_mmv_cp "" 0xa1005288 lamb_mmv_cp _REC_AXS_20_u2 31.9990234375 _CNV_A_R_LINEAR_____122_CM 6 0. 31.9990234375 FORMAT "%7.4" /end AXIS_PTS
/begin MEASUREMENT lv_lamb_afs_cp "Homogeneous lambda 1 combustion request" UBYTE _CNV_S_2_RANGE__0___1_CM 1 100. 0. 1. DISPLAY_IDENTIFIER LV_LAMB_AFS_CP ECU_ADDRESS 0xd0002e9a BIT_MASK 0x1 /end MEASUREMENT
/begin CHARACTERISTIC c_cl_mmv_hom_cp "limit on canister load CL value to stay in Homogeneous" VALUE 0xa1006090 _REC_VAL_20_u2 1.99996948242188 _CNV_A_R_LINEAR_____8_CM 0. 1.99996948242188 DISPLAY_IDENTIFIER C_CL_MMV_HOM_CP FORMAT "%7.5" /end CHARACTERISTIC
/begin CHARACTERISTIC c_cl_mmv_chk "CL_MMV limit value to go back in stratified mode" VALUE 0xa100608c _REC_VAL_20_u2 1.99996948242188 _CNV_A_R_LINEAR_____8_CM 0. 1.99996948242188 DISPLAY_IDENTIFIER C_CL_MMV_CHK FORMAT "%7.5" /end CHARACTERISTIC
/begin CHARACTERISTIC ip_crlc_lamb_lpf_cp "Correlation constant for LAMB_MMV_CP calculation" CURVE 0xa1005596 _REC_CUR_20_u1_u2 0.99609375 _CNV_A_R_LINEAR_____27_CM 0. 0.99609375 DISPLAY_IDENTIFIER IP_CRLC_LAMB_LPF_CP FORMAT "%5.3"
 /begin AXIS_DESCR COM_AXIS maf_cyl _CNV_A_R_LINEAR_____207_CM 6 0. 2047.96875 FORMAT "%10.5" AXIS_PTS_REF ldpm_maf_cyl_1_evac /end AXIS_DESCR
/end CHARACTERISTIC
/begin CHARACTERISTIC lc_lamb_afs_cp_cps_scg "switch to force hom1 operation if cps valve short circuit to ground error present" VALUE 0xa10061b9 _REC_VAL_20_u1 1. _CNV_A_R_LINEAR_____0_CM 0. 1. DISPLAY_IDENTIFIER LC_LAMB_AFS_CP_CPS_SCG FORMAT "%1.0" /end CHARACTERISTIC
/begin CHARACTERISTIC ip_crlc_mmv_cp "Correlation constant for LAMB_MMV_CP calculation" CURVE 0xa10055a2 _REC_CUR_20_u1_u2 0.99609375 _CNV_A_R_LINEAR_____27_CM 0. 0.99609375 DISPLAY_IDENTIFIER IP_CRLC_MMV_CP FORMAT "%5.3"
 /begin AXIS_DESCR COM_AXIS lamb_mmv_cp _CNV_A_R_LINEAR_____122_CM 6 0. 31.9990234375 FORMAT "%7.4" AXIS_PTS_REF ldp_lamb_mmv_cp_ip_crlc_mmv_cp /end AXIS_DESCR
/end CHARACTERISTIC
/begin MEASUREMENT lv_inh_diag_el_cps "Inhibition flag for canister purge valve diagnosis" UBYTE _CNV_S_2_RANGE__0___1_CM 1 100. 0. 1. DISPLAY_IDENTIFIER LV_INH_DIAG_EL_CPS ECU_ADDRESS 0xd0002e97 BIT_MASK 0x1 /end MEASUREMENT
/begin MEASUREMENT lv_cl_mdl_act "CL model active" UBYTE _CNV_S_2_RANGE__0___1_CM 1 100. 0. 1. DISPLAY_IDENTIFIER LV_CL_MDL_ACT ECU_ADDRESS 0xd0002e7a BIT_MASK 0x1 /end MEASUREMENT
/begin MEASUREMENT cl_mdl "Value of canister load model" UWORD _CNV_A_R_LINEAR_____8_CM 1 100. 0. 1.99996948242188 DISPLAY_IDENTIFIER CL_MDL ECU_ADDRESS 0xd000269a FORMAT "%7.5" /end MEASUREMENT
/begin MEASUREMENT cl_mdl_slop_int "Integral of CL_MDL_SLOP" UWORD _CNV_A_R_LINEAR_____8_CM 1 100. 0. 1.99996948242188 DISPLAY_IDENTIFIER CL_MDL_SLOP_INT ECU_ADDRESS 0xc0001e5c FORMAT "%7.5" /end MEASUREMENT
/begin MEASUREMENT state_cl_mdl "State of the CL model, if switched on" UBYTE _CNV_S_3_STATE_CL_M_311_CM 1 100. 0. 2. DISPLAY_IDENTIFIER STATE_CL_MDL ECU_ADDRESS 0xd0002ea8 /end MEASUREMENT
/begin MEASUREMENT state_cl_mdl_0 "Global state of the CL model" UBYTE _CNV_S_2_STATE_CL_M_312_CM 1 100. 0. 1. DISPLAY_IDENTIFIER STATE_CL_MDL_0 ECU_ADDRESS 0xd0002ea9 /end MEASUREMENT
/begin MEASUREMENT t_cl_mdl_cll_ena "Time counter in CP closed loop operation to enable canister load model usage" UWORD _CNV_A_R_LINEAR_____4_CM 1 100. 0. 6553.5 DISPLAY_IDENTIFIER T_CL_MDL_CLL_ENA ECU_ADDRESS 0xc0001f8e FORMAT "%6.1" /end MEASUREMENT
/begin MEASUREMENT t_cl_mdl_act "Time counter for canister load usage time" UWORD _CNV_A_R_LINEAR_____4_CM 1 100. 0. 6553.5 DISPLAY_IDENTIFIER T_CL_MDL_ACT ECU_ADDRESS 0xc0001f50 FORMAT "%6.1" /end MEASUREMENT
/begin MEASUREMENT cl_mdl_slop_fac "Final CL model correction factor on CL_MMV" UWORD _CNV_A_R_LINEAR_____68_CM 1 100. 0. 0.9999847412109381 DISPLAY_IDENTIFIER CL_MDL_SLOP_FAC ECU_ADDRESS 0xc0001e5a FORMAT "%7.5" /end MEASUREMENT
/begin CHARACTERISTIC c_t_cl_mdl_cll_ena "Minimum time in CP closed loop operation to enable CL model usage" VALUE 0xa1006142 _REC_VAL_20_u2 6553.5 _CNV_A_R_LINEAR_____4_CM 0. 6553.5 DISPLAY_IDENTIFIER C_T_CL_MDL_CLL_ENA FORMAT "%6.1" /end CHARACTERISTIC
/begin CHARACTERISTIC c_t_cl_mdl_cll_ena_inc "Increment for enable time counter if not in CP closed loop" VALUE 0xa1006144 _REC_VAL_20_u2 6553.5 _CNV_A_R_LINEAR_____4_CM 0. 6553.5 DISPLAY_IDENTIFIER C_T_CL_MDL_CLL_ENA_INC FORMAT "%6.1" /end CHARACTERISTIC
/begin CHARACTERISTIC c_t_cl_mdl_act_max "Maximum time of CL model usage" VALUE 0xa100613e _REC_VAL_20_u2 6553.5 _CNV_A_R_LINEAR_____4_CM 0. 6553.5 DISPLAY_IDENTIFIER C_T_CL_MDL_ACT_MAX FORMAT "%6.1" /end CHARACTERISTIC
/begin CHARACTERISTIC c_t_cl_mdl_act_ofs "Offset for re-init of time counter in CP closed loop operation after regular leaving of active mode" VALUE 0xa1006140 _REC_VAL_20_u2 6553.5 _CNV_A_R_LINEAR_____4_CM 0. 6553.5 DISPLAY_IDENTIFIER C_T_CL_MDL_ACT_OFS FORMAT "%6.1" /end CHARACTERISTIC
/begin CHARACTERISTIC c_fac_t_cl_mdl_act "Correction factor for re-init of time counter in CP closed loop operation after regular leaving of active mode" VALUE 0xa10060ee _REC_VAL_20_u2 3.99993896484375 _CNV_A_R_LINEAR_____23_CM 0. 3.99993896484375 DISPLAY_IDENTIFIER C_FAC_T_CL_MDL_ACT FORMAT "%7.5" /end CHARACTERISTIC
/begin CHARACTERISTIC ip_cl_mdl_slop "Timeshape over CL_MDL_SLOP" CURVE 0xa1005440 _REC_CUR_20_u2_u2 1.99996948242188 _CNV_A_R_LINEAR_____8_CM 0. 1.99996948242188 DISPLAY_IDENTIFIER IP_CL_MDL_SLOP FORMAT "%7.5"
 /begin AXIS_DESCR COM_AXIS NO_INPUT_QUANTITY _CNV_A_R_LINEAR_____8_CM 8 0. 1.99996948242188 FORMAT "%7.5" AXIS_PTS_REF ldp_cl_mdl_slop_0_ip_cl_slop /end AXIS_DESCR
/end CHARACTERISTIC
/begin CHARACTERISTIC ip_cl_mdl_value "" CURVE 0xa1005450 _REC_CUR_20_u2_u2 0.9999847412109381 _CNV_A_R_LINEAR_____68_CM 0. 0.9999847412109381 DISPLAY_IDENTIFIER IP_CL_MDL_VALUE FORMAT "%7.5"
 /begin AXIS_DESCR COM_AXIS cl_mdl_slop_int _CNV_A_R_LINEAR_____8_CM 6 0. 1.99996948242188 FORMAT "%7.5" AXIS_PTS_REF ldp_cl_mdl_slop_int_ip_cl_value /end AXIS_DESCR
/end CHARACTERISTIC
/begin AXIS_PTS ldp_cl_mdl_slop_0_ip_cl_slop "" 0xa10051f0 NO_INPUT_QUANTITY _REC_AXS_20_u2 1.99996948242188 _CNV_A_R_LINEAR_____8_CM 8 0. 1.99996948242188 FORMAT "%7.5" /end AXIS_PTS
/begin AXIS_PTS ldp_cl_mdl_slop_int_ip_cl_value "" 0xa1005204 cl_mdl_slop_int _REC_AXS_20_u2 1.99996948242188 _CNV_A_R_LINEAR_____8_CM 6 0. 1.99996948242188 FORMAT "%7.5" /end AXIS_PTS
/begin CHARACTERISTIC lc_cl_mdl_ena "Switch for enabling CL model usage" VALUE 0xa100619b _REC_VAL_20_u1 1. _CNV_A_R_LINEAR_____0_CM 0. 1. DISPLAY_IDENTIFIER LC_CL_MDL_ENA FORMAT "%1.0" /end CHARACTERISTIC
/begin MEASUREMENT cl_mdl_slop "Difference between two successive moving mean values of the canister load CL" UWORD _CNV_A_R_LINEAR_____8_CM 1 100. 0. 1.99996948242188 DISPLAY_IDENTIFIER CL_MDL_SLOP ECU_ADDRESS 0xc0001e58 FORMAT "%7.5" /end MEASUREMENT
/begin MEASUREMENT cl_mmv_mem_mdl "" UWORD _CNV_A_R_LINEAR_____8_CM 1 100. 0. 1.99996948242188 DISPLAY_IDENTIFIER CL_MMV_MEM_MDL ECU_ADDRESS 0xc0001e62 FORMAT "%7.5" /end MEASUREMENT
/begin MEASUREMENT lv_cl_mdl_ena "Activation of the CL model enabled" UBYTE _CNV_S_2_RANGE__0___1_CM 1 100. 0. 1. DISPLAY_IDENTIFIER LV_CL_MDL_ENA ECU_ADDRESS 0xd0002e7b BIT_MASK 0x1 /end MEASUREMENT
/begin CHARACTERISTIC c_crlc_cl_mdl "Correlation constant for CL_MDL filtering" VALUE 0xa10060be _REC_VAL_20_u2 0.9999847412109381 _CNV_A_R_LINEAR_____68_CM 0. 0.9999847412109381 DISPLAY_IDENTIFIER C_CRLC_CL_MDL FORMAT "%7.5" /end CHARACTERISTIC
/begin CHARACTERISTIC c_fac_lam_thd "Upper threshold for lambda control output gradient" VALUE 0xa10060e6 _REC_VAL_20_s2 99.99847412109381 _CNV_A_R_LINEAR_____110_CM -50. 49.9984741210938 DISPLAY_IDENTIFIER C_FAC_LAM_THD FORMAT "%7.3" /end CHARACTERISTIC
/begin MEASUREMENT lv_lam_thd "Lambda gradient exceeds threshold" UBYTE _CNV_S_2_RANGE__0___1_CM 1 100. 0. 1. DISPLAY_IDENTIFIER LV_LAM_THD ECU_ADDRESS 0xc0001f8a BIT_MASK 0x1 /end MEASUREMENT
/begin MEASUREMENT lv_first_lam_thd "Lamda gradient exceeds threshold for first initialisation" UBYTE _CNV_S_2_RANGE__0___1_CM 1 100. 0. 1. DISPLAY_IDENTIFIER LV_FIRST_LAM_THD ECU_ADDRESS 0xc0001f86 BIT_MASK 0x1 /end MEASUREMENT
/begin CHARACTERISTIC lc_cl_mdl_act "Switch for activation of CL model calculation" VALUE 0xa100619a _REC_VAL_20_u1 1. _CNV_A_R_LINEAR_____0_CM 0. 1. DISPLAY_IDENTIFIER LC_CL_MDL_ACT FORMAT "%1.0" /end CHARACTERISTIC
/begin CHARACTERISTIC lc_fac_lam_grd "Switch for enabling gradient check" VALUE 0xa10061b1 _REC_VAL_20_u1 1. _CNV_A_R_LINEAR_____0_CM 0. 1. DISPLAY_IDENTIFIER LC_FAC_LAM_GRD FORMAT "%1.0" /end CHARACTERISTIC
/begin MEASUREMENT cppwm_add_ad_mem "" UWORD _CNV_A_R_LINEAR_____7_CM 1 100. 0. 99.99847412109381 DISPLAY_IDENTIFIER CPPWM_ADD_AD_MEM ECU_ADDRESS 0xc0001e64 /end MEASUREMENT
/begin MEASUREMENT frq_cps_ad "CPS output frequency" UBYTE _CNV_A_R_LINEAR_____305_CM 1 100. 0. 255. DISPLAY_IDENTIFIER FRQ_CPS_AD ECU_ADDRESS 0xd0002ea5 FORMAT "%3.0" /end MEASUREMENT
/begin MEASUREMENT ctr_cycnr_cps_ad "CPS output frequency" UBYTE _CNV_A_R_LINEAR_____0_CM 1 100. 0. 255. DISPLAY_IDENTIFIER CTR_CYCNR_CPS_AD ECU_ADDRESS 0xc0001f72 FORMAT "%3.0" /end MEASUREMENT
/begin MEASUREMENT lv_cps_ad_act "" UBYTE _CNV_S_2_RANGE__0___1_CM 1 100. 0. 1. DISPLAY_IDENTIFIER LV_CPS_AD_ACT ECU_ADDRESS 0xd0002e8e BIT_MASK 0x1 /end MEASUREMENT
/begin MEASUREMENT state_cps_ad "State of evaporative emission control function" UBYTE _CNV_S_6_STATE_CPS__313_CM 1 100. 0. 6. DISPLAY_IDENTIFIER STATE_CPS_AD ECU_ADDRESS 0xc0001f79 /end MEASUREMENT
/begin MEASUREMENT state_cps_ad_req "State of evaporative emission control function" UBYTE _CNV_S_6_STATE_CPS__313_CM 1 100. 0. 6. DISPLAY_IDENTIFIER STATE_CPS_AD_REQ ECU_ADDRESS 0xc0001f7a /end MEASUREMENT
/begin CHARACTERISTIC c_cycnr_cps_ad "" VALUE 0xa10060ca _REC_VAL_20_u1 255. _CNV_A_R_LINEAR_____0_CM 0. 255. DISPLAY_IDENTIFIER C_CYCNR_CPS_AD FORMAT "%3.0" /end CHARACTERISTIC
/begin CHARACTERISTIC c_cppwm_ad_ratio "" VALUE 0xa100609e _REC_VAL_20_u1 0.99609375 _CNV_A_R_LINEAR_____27_CM 0. 0.99609375 DISPLAY_IDENTIFIER C_CPPWM_AD_RATIO FORMAT "%5.3" /end CHARACTERISTIC
/begin CHARACTERISTIC c_frq_max_mec_cps "" VALUE 0xa1006106 _REC_VAL_20_u1 255. _CNV_A_R_LINEAR_____305_CM 0. 255. DISPLAY_IDENTIFIER C_FRQ_MAX_MEC_CPS FORMAT "%3.0" /end CHARACTERISTIC
/begin CHARACTERISTIC c_cppwm_max_ad "" VALUE 0xa10060b2 _REC_VAL_20_u2 99.99847412109381 _CNV_A_R_LINEAR_____7_CM 0. 99.99847412109381 DISPLAY_IDENTIFIER C_CPPWM_MAX_AD /end CHARACTERISTIC
/begin CHARACTERISTIC c_fac_lamb_max_cps_ad "" VALUE 0xa10060ec _REC_VAL_20_s2 99.99847412109381 _CNV_A_R_LINEAR_____110_CM -50. 49.9984741210938 DISPLAY_IDENTIFIER C_FAC_LAMB_MAX_CPS_AD FORMAT "%7.3" /end CHARACTERISTIC
/begin CHARACTERISTIC c_fac_lamb_delta_min_cps_ad "" VALUE 0xa10060ea _REC_VAL_20_s2 99.99847412109381 _CNV_A_R_LINEAR_____110_CM -50. 49.9984741210938 DISPLAY_IDENTIFIER C_FAC_LAMB_DELTA_MIN_CPS_AD FORMAT "%7.3" /end CHARACTERISTIC
/begin CHARACTERISTIC c_n_min_cps_ad "" VALUE 0xa1006126 _REC_VAL_20_u2 8160. _CNV_A_R_LINEAR_____13_CM 0. 8160. DISPLAY_IDENTIFIER C_N_MIN_CPS_AD FORMAT "%4.0" /end CHARACTERISTIC
/begin CHARACTERISTIC c_n_max_cps_ad "" VALUE 0xa1006124 _REC_VAL_20_u2 8160. _CNV_A_R_LINEAR_____13_CM 0. 8160. DISPLAY_IDENTIFIER C_N_MAX_CPS_AD FORMAT "%4.0" /end CHARACTERISTIC
/begin CHARACTERISTIC c_tqi_av_max_cps_ad "" VALUE 0xa100617e _REC_VAL_20_s2 2047.96875 _CNV_A_R_LINEAR_____30_CM -1024. 1023.96875 DISPLAY_IDENTIFIER C_TQI_AV_MAX_CPS_AD FORMAT "%11.5" /end CHARACTERISTIC
/begin CHARACTERISTIC c_tqi_av_min_cps_ad "" VALUE 0xa1006180 _REC_VAL_20_s2 2047.96875 _CNV_A_R_LINEAR_____30_CM -1024. 1023.96875 DISPLAY_IDENTIFIER C_TQI_AV_MIN_CPS_AD FORMAT "%11.5" /end CHARACTERISTIC
/begin CHARACTERISTIC c_cppwm_delta_ad "" VALUE 0xa10060a0 _REC_VAL_20_u2 99.99847412109381 _CNV_A_R_LINEAR_____7_CM 0. 99.99847412109381 DISPLAY_IDENTIFIER C_CPPWM_DELTA_AD /end CHARACTERISTIC
/begin CHARACTERISTIC c_cppwm_inc_ad "" VALUE 0xa10060ae _REC_VAL_20_u2 99.99847412109381 _CNV_A_R_LINEAR_____7_CM 0. 99.99847412109381 DISPLAY_IDENTIFIER C_CPPWM_INC_AD /end CHARACTERISTIC
/begin CHARACTERISTIC c_cppwm_inc_stop_ad "" VALUE 0xa10060b0 _REC_VAL_20_u2 99.99847412109381 _CNV_A_R_LINEAR_____7_CM 0. 99.99847412109381 DISPLAY_IDENTIFIER C_CPPWM_INC_STOP_AD /end CHARACTERISTIC
/begin CHARACTERISTIC c_t_max_cps_ad "" VALUE 0xa100616e _REC_VAL_20_u2 1310.7 _CNV_A_R_LINEAR_____107_CM 0. 1310.7 DISPLAY_IDENTIFIER C_T_MAX_CPS_AD FORMAT "%7.2" /end CHARACTERISTIC
/begin CHARACTERISTIC c_t_dly_fac_lamb_cppwm_ad "" VALUE 0xa100615a _REC_VAL_20_u2 1310.7 _CNV_A_R_LINEAR_____107_CM 0. 1310.7 DISPLAY_IDENTIFIER C_T_DLY_FAC_LAMB_CPPWM_AD FORMAT "%7.2" /end CHARACTERISTIC
/begin CHARACTERISTIC c_t_inc_cps_close "" VALUE 0xa1006168 _REC_VAL_20_u2 1310.7 _CNV_A_R_LINEAR_____107_CM 0. 1310.7 DISPLAY_IDENTIFIER C_T_INC_CPS_CLOSE FORMAT "%7.2" /end CHARACTERISTIC
/begin CHARACTERISTIC c_t_wait_cps_ad "" VALUE 0xa1006178 _REC_VAL_20_u2 1310.7 _CNV_A_R_LINEAR_____107_CM 0. 1310.7 DISPLAY_IDENTIFIER C_T_WAIT_CPS_AD FORMAT "%7.2" /end CHARACTERISTIC
/begin CHARACTERISTIC c_t_wait_lamb_rgn "" VALUE 0xa100617a _REC_VAL_20_u2 1310.7 _CNV_A_R_LINEAR_____107_CM 0. 1310.7 DISPLAY_IDENTIFIER C_T_WAIT_LAMB_RGN FORMAT "%7.2" /end CHARACTERISTIC
/begin CHARACTERISTIC c_frq_min_cps_ad "" VALUE 0xa1006107 _REC_VAL_20_u1 254. _CNV_A_R_LINEAR_____305_CM 1. 255. DISPLAY_IDENTIFIER C_FRQ_MIN_CPS_AD FORMAT "%3.0" /end CHARACTERISTIC
/begin MEASUREMENT cppwm_add_ad "" UWORD _CNV_A_R_LINEAR_____7_CM 1 100. 0. 99.99847412109381 DISPLAY_IDENTIFIER CPPWM_ADD_AD ECU_ADDRESS 0xd00026a4 /end MEASUREMENT
/begin MEASUREMENT ratio_frq "" UBYTE _CNV_A_R_EVAC_LINEA_314_CM 1 100. 0. 15.9375 DISPLAY_IDENTIFIER RATIO_FRQ ECU_ADDRESS 0xc0001f78 /end MEASUREMENT
/begin CHARACTERISTIC c_cppwm_min_ad "" VALUE 0xa10060b6 _REC_VAL_20_u2 99.99847412109381 _CNV_A_R_LINEAR_____7_CM 0. 99.99847412109381 DISPLAY_IDENTIFIER C_CPPWM_MIN_AD /end CHARACTERISTIC
/begin CHARACTERISTIC c_cppwm_dly_lam "" VALUE 0xa10060a6 _REC_VAL_20_u2 99.99847412109381 _CNV_A_R_LINEAR_____7_CM 0. 99.99847412109381 DISPLAY_IDENTIFIER C_CPPWM_DLY_LAM /end CHARACTERISTIC
/begin MEASUREMENT ctr_1_cps_ad "" UWORD _CNV_A_R_LINEAR_____107_CM 1 100. 0. 1310.7 DISPLAY_IDENTIFIER CTR_1_CPS_AD ECU_ADDRESS 0xc0001e68 FORMAT "%7.2" /end MEASUREMENT
/begin MEASUREMENT ctr_2_cps_ad "" UWORD _CNV_A_R_LINEAR_____107_CM 1 100. 0. 1310.7 DISPLAY_IDENTIFIER CTR_2_CPS_AD ECU_ADDRESS 0xc0001e6a FORMAT "%7.2" /end MEASUREMENT
/begin CHARACTERISTIC c_t_st_cps_ad "" VALUE 0xa1006174 _REC_VAL_20_u2 6553.5 _CNV_A_R_LINEAR_____4_CM 0. 6553.5 DISPLAY_IDENTIFIER C_T_ST_CPS_AD FORMAT "%6.1" /end CHARACTERISTIC
/begin CHARACTERISTIC c_t_ast_deac_cps_ad "" VALUE 0xa100613c _REC_VAL_20_u2 6553.5 _CNV_A_R_LINEAR_____4_CM 0. 6553.5 DISPLAY_IDENTIFIER C_T_AST_DEAC_CPS_AD FORMAT "%6.1" /end CHARACTERISTIC
/begin CHARACTERISTIC lc_cps_ad_chk "switch to enable end of CP phase when reaching low canister load" VALUE 0xa10061af _REC_VAL_20_u1 1. _CNV_A_R_LINEAR_____0_CM 0. 1. DISPLAY_IDENTIFIER LC_CPS_AD_CHK FORMAT "%1.0" /end CHARACTERISTIC
/begin MEASUREMENT lv_cps_ad_run_cdn_ok "" UBYTE _CNV_S_2_RANGE__0___1_CM 1 100. 0. 1. DISPLAY_IDENTIFIER LV_CPS_AD_RUN_CDN_OK ECU_ADDRESS 0xd0002e90 BIT_MASK 0x1 /end MEASUREMENT
/begin MEASUREMENT lv_err_cps_ad "" UBYTE _CNV_S_2_RANGE__0___1_CM 1 100. 0. 1. DISPLAY_IDENTIFIER LV_ERR_CPS_AD ECU_ADDRESS 0xc0001f85 BIT_MASK 0x1 /end MEASUREMENT
/begin MEASUREMENT lv_cl_ok_cps_ad "" UBYTE _CNV_S_2_RANGE__0___1_CM 1 100. 0. 1. DISPLAY_IDENTIFIER LV_CL_OK_CPS_AD ECU_ADDRESS 0xc0001f7c BIT_MASK 0x1 /end MEASUREMENT
/begin MEASUREMENT lv_ctr_ok_cps_ad "" UBYTE _CNV_S_2_RANGE__0___1_CM 1 100. 0. 1. DISPLAY_IDENTIFIER LV_CTR_OK_CPS_AD ECU_ADDRESS 0xc0001f82 BIT_MASK 0x1 /end MEASUREMENT
/begin MEASUREMENT lv_cps_ad_st_cdn_ok "" UBYTE _CNV_S_2_RANGE__0___1_CM 1 100. 0. 1. DISPLAY_IDENTIFIER LV_CPS_AD_ST_CDN_OK ECU_ADDRESS 0xc0001f80 BIT_MASK 0x1 /end MEASUREMENT
/begin MEASUREMENT lv_cps_ok_cps_ad "" UBYTE _CNV_S_2_RANGE__0___1_CM 1 100. 0. 1. DISPLAY_IDENTIFIER LV_CPS_OK_CPS_AD ECU_ADDRESS 0xc0001f81 BIT_MASK 0x1 /end MEASUREMENT
/begin MEASUREMENT lv_eng_ok_cps_ad "" UBYTE _CNV_S_2_RANGE__0___1_CM 1 100. 0. 1. DISPLAY_IDENTIFIER LV_ENG_OK_CPS_AD ECU_ADDRESS 0xc0001f84 BIT_MASK 0x1 /end MEASUREMENT
/begin MEASUREMENT lv_t_ok_cps_ad "" UBYTE _CNV_S_2_RANGE__0___1_CM 1 100. 0. 1. DISPLAY_IDENTIFIER LV_T_OK_CPS_AD ECU_ADDRESS 0xc0001f8c BIT_MASK 0x1 /end MEASUREMENT
/begin CHARACTERISTIC c_frq_clc_1_cps_ad "" VALUE 0xa1006104 _REC_VAL_20_u1 255. _CNV_A_R_LINEAR_____305_CM 0. 255. DISPLAY_IDENTIFIER C_FRQ_CLC_1_CPS_AD FORMAT "%3.0" /end CHARACTERISTIC
/begin CHARACTERISTIC c_frq_clc_2_cps_ad "" VALUE 0xa1006105 _REC_VAL_20_s1 255. _CNV_A_R_LINEAR_____305_CM -128. 127. DISPLAY_IDENTIFIER C_FRQ_CLC_2_CPS_AD FORMAT "%3.0" /end CHARACTERISTIC
/begin CHARACTERISTIC c_cl_min_cps_ad "" VALUE 0xa100608a _REC_VAL_20_u2 1.99996948242188 _CNV_A_R_LINEAR_____8_CM 0. 1.99996948242188 DISPLAY_IDENTIFIER C_CL_MIN_CPS_AD FORMAT "%7.5" /end CHARACTERISTIC
/begin CHARACTERISTIC c_flow_clc_dif_cps_ad "" VALUE 0xa10060f0 _REC_VAL_20_u2 7.9998779296875 _CNV_A_R_LINEAR_____147_CM 0. 7.9998779296875 DISPLAY_IDENTIFIER C_FLOW_CLC_DIF_CPS_AD FORMAT "%6.4" /end CHARACTERISTIC
/begin CHARACTERISTIC c_prs_cps_max_cps_ad "" VALUE 0xa1006128 _REC_VAL_20_s2 5434. _CNV_A_R_LINEAR_____309_CM -2717.04 2716.96 DISPLAY_IDENTIFIER C_PRS_CPS_MAX_CPS_AD FORMAT "%8.2" /end CHARACTERISTIC
/begin CHARACTERISTIC c_flow_clc_max_cps_ad "" VALUE 0xa10060f2 _REC_VAL_20_u2 7.9998779296875 _CNV_A_R_LINEAR_____147_CM 0. 7.9998779296875 DISPLAY_IDENTIFIER C_FLOW_CLC_MAX_CPS_AD FORMAT "%6.4" /end CHARACTERISTIC
/begin CHARACTERISTIC c_pwm_clc_max_cps_ad "" VALUE 0xa1006131 _REC_VAL_20_u1 99.609375 _CNV_A_R_LINEAR_____5_CM 0. 99.609375 DISPLAY_IDENTIFIER C_PWM_CLC_MAX_CPS_AD FORMAT "%9.6" /end CHARACTERISTIC
/begin CHARACTERISTIC c_pwm_clc_dif_cps_ad "" VALUE 0xa1006130 _REC_VAL_20_u1 99.609375 _CNV_A_R_LINEAR_____5_CM 0. 99.609375 DISPLAY_IDENTIFIER C_PWM_CLC_DIF_CPS_AD FORMAT "%9.6" /end CHARACTERISTIC
/begin AXIS_PTS ldp_prs_cps_ip_cppwm_open_cps "" 0xa10052a4 prs_cps _REC_AXS_20_u2 5434. _CNV_A_R_EVAC_LINEA_294_CM 6 -2717.04 2716.96 FORMAT "%8.2" /end AXIS_PTS
/begin CHARACTERISTIC ip_cppwm_open_cps "" CURVE 0xa1005564 _REC_CUR_20_u1_u2 1.9921875 _CNV_A_R_LINEAR_____100_CM 0. 1.9921875 DISPLAY_IDENTIFIER IP_CPPWM_OPEN_CPS FORMAT "%8.6"
 /begin AXIS_DESCR COM_AXIS prs_cps _CNV_A_R_EVAC_LINEA_294_CM 6 -2717.04 2716.96 FORMAT "%8.2" AXIS_PTS_REF ldp_prs_cps_ip_cppwm_open_cps /end AXIS_DESCR
/end CHARACTERISTIC
/begin MEASUREMENT fac_lamb_start_cps_ad "" SWORD _CNV_A_R_LINEAR_____110_CM 1 100. -50. 49.9984741210938 DISPLAY_IDENTIFIER FAC_LAMB_START_CPS_AD ECU_ADDRESS 0xc0001e76 FORMAT "%7.3" /end MEASUREMENT
/begin MEASUREMENT fac_flow_cps_ad "" UBYTE _CNV_A_R_LINEAR_____27_CM 1 100. 0. 0.99609375 DISPLAY_IDENTIFIER FAC_FLOW_CPS_AD ECU_ADDRESS 0xc0001f74 FORMAT "%5.3" /end MEASUREMENT
/begin MEASUREMENT fac_prs_cps_ad "" UBYTE _CNV_A_R_LINEAR_____100_CM 1 100. 0. 1.9921875 DISPLAY_IDENTIFIER FAC_PRS_CPS_AD ECU_ADDRESS 0xc0001f75 FORMAT "%8.6" /end MEASUREMENT
/begin MEASUREMENT fac_pwm_cps_ad "" UBYTE _CNV_A_R_LINEAR_____27_CM 1 100. 0. 0.99609375 DISPLAY_IDENTIFIER FAC_PWM_CPS_AD ECU_ADDRESS 0xc0001f76 FORMAT "%5.3" /end MEASUREMENT
/begin AXIS_PTS ldpm_temp_ini_ls_up_1_egcp "" 0xa1001b3c online_dummy _REC_AXS_20_u2 4095.9375 _CNV_A_R_EGCP_LINEA_315_CM 6 -2048. 2047.9375 FORMAT "%10.4" /end AXIS_PTS
/begin AXIS_PTS ldpm_temp_ini_ls_down_1_egcp "" 0xa1001b2c online_dummy _REC_AXS_20_u2 4095.9375 _CNV_A_R_EGCP_LINEA_315_CM 6 -2048. 2047.9375 FORMAT "%10.4" /end AXIS_PTS
/begin AXIS_PTS ldpm_n_32_3_egcp "" 0xa1001ad6 n_32 _REC_AXS_20_u1 8160. _CNV_A_R_LINEAR_____9_CM 6 0. 8160. FORMAT "%4.0" /end AXIS_PTS
/begin AXIS_PTS ldpm_vs_1_egcp "" 0xa1001b4a online_dummy _REC_AXS_20_u1 255. _CNV_A_R_LINEAR_____6_CM 6 0. 255. FORMAT "%3.0" /end AXIS_PTS
/begin AXIS_PTS ldpm_n_32_1_egcp "" 0xa1001ace n_32 _REC_AXS_20_u1 8160. _CNV_A_R_LINEAR_____9_CM 6 0. 8160. FORMAT "%4.0" /end AXIS_PTS
/begin AXIS_PTS ldpm_n_32_ls_up_dyn "" 0xa1001ae0 n_32 _REC_AXS_20_u1 8160. _CNV_A_R_LINEAR_____9_CM 8 0. 8160. FORMAT "%4.0" /end AXIS_PTS
/begin AXIS_PTS ldpm_maf_hb_ls_up_dyn "" 0xa1001a94 NO_INPUT_QUANTITY _REC_AXS_20_u1 1389. _CNV_A_R_LINEAR_____14_CM 8 0. 1389. FORMAT "%4.0" /end AXIS_PTS
/begin AXIS_PTS ldpm_teg_dyn_ls_down_1_egcp "" 0xa1001b0c online_dummy _REC_AXS_20_u2 2047.9375 _CNV_A_R_LINEAR_____204_CM 6 -273.15 1774.7875 FORMAT "%9.4" /end AXIS_PTS
/begin AXIS_PTS ldpm_teg_dyn_ls_up_1_egcp "" 0xa1001b1c online_dummy _REC_AXS_20_u2 2047.9375 _CNV_A_R_LINEAR_____204_CM 6 -273.15 1774.7875 FORMAT "%9.4" /end AXIS_PTS
/begin CHARACTERISTIC ip_fac_neg_ctl_p_lsh_up "Closed loop controller P-term factor for temperature too high; decrease heater voltage" MAP 0xa1001c8c _REC_MAP_20_u1_u1_u2 0.255 _CNV_A_R_EGCP_LINEA_319_CM 0. 0.255 DISPLAY_IDENTIFIER IP_FAC_NEG_CTL_P_LSH_UP FORMAT "%5.3"
 /begin AXIS_DESCR COM_AXIS n_32 _CNV_A_R_LINEAR_____9_CM 6 0. 8160. FORMAT "%4.0" AXIS_PTS_REF ldpm_n_32_1_egcp /end AXIS_DESCR
 /begin AXIS_DESCR COM_AXIS online_dummy _CNV_A_R_LINEAR_____204_CM 6 -273.15 1774.7875 FORMAT "%9.4" AXIS_PTS_REF ldpm_teg_dyn_ls_up_1_egcp /end AXIS_DESCR
/end CHARACTERISTIC
/begin CHARACTERISTIC ip_fac_pos_ctl_p_lsh_up "Closed loop controller P-term factor for temperature too low; increase heater voltage" MAP 0xa1001cd4 _REC_MAP_20_u1_u1_u2 0.255 _CNV_A_R_EGCP_LINEA_319_CM 0. 0.255 DISPLAY_IDENTIFIER IP_FAC_POS_CTL_P_LSH_UP FORMAT "%5.3"
 /begin AXIS_DESCR COM_AXIS n_32 _CNV_A_R_LINEAR_____9_CM 6 0. 8160. FORMAT "%4.0" AXIS_PTS_REF ldpm_n_32_1_egcp /end AXIS_DESCR
 /begin AXIS_DESCR COM_AXIS online_dummy _CNV_A_R_LINEAR_____204_CM 6 -273.15 1774.7875 FORMAT "%9.4" AXIS_PTS_REF ldpm_teg_dyn_ls_up_1_egcp /end AXIS_DESCR
/end CHARACTERISTIC
/begin CHARACTERISTIC ip_fac_pos_ctl_i_lsh_up "Closed loop controller I-term factor for temperature too low; increase heater voltage" MAP 0xa1001cb0 _REC_MAP_20_u1_u1_u2 0.255 _CNV_A_R_EGCP_LINEA_319_CM 0. 0.255 DISPLAY_IDENTIFIER IP_FAC_POS_CTL_I_LSH_UP FORMAT "%5.3"
 /begin AXIS_DESCR COM_AXIS n_32 _CNV_A_R_LINEAR_____9_CM 6 0. 8160. FORMAT "%4.0" AXIS_PTS_REF ldpm_n_32_1_egcp /end AXIS_DESCR
 /begin AXIS_DESCR COM_AXIS online_dummy _CNV_A_R_LINEAR_____204_CM 6 -273.15 1774.7875 FORMAT "%9.4" AXIS_PTS_REF ldpm_teg_dyn_ls_up_1_egcp /end AXIS_DESCR
/end CHARACTERISTIC
/begin CHARACTERISTIC c_ttip_dif_min_ctl_p_ls_up "Minimum required temperature difference in order to calculate P term of controller" VALUE 0xa100223c _REC_VAL_20_u2 2047.9375 _CNV_A_R_LINEAR_____123_CM 0. 2047.9375 DISPLAY_IDENTIFIER C_TTIP_DIF_MIN_CTL_P_LS_UP FORMAT "%7.2" /end CHARACTERISTIC
/begin CHARACTERISTIC c_fac_ctl_p_lsh_up "Multiplicative scaling factor for closed loop P-term" VALUE 0xa100207d _REC_VAL_20_u1 6.348 _CNV_A_R_EGCP_LINEA_320_CM 0. 6.348 DISPLAY_IDENTIFIER C_FAC_CTL_P_LSH_UP FORMAT "%5.3" /end CHARACTERISTIC
/begin CHARACTERISTIC ip_v_efc_ini_lsh_up "Initial effective heater voltage" CURVE 0xa100200e _REC_CUR_20_u1_u2 25.8984375 _CNV_A_R_LINEAR_____289_CM 0. 25.8984375 DISPLAY_IDENTIFIER IP_V_EFC_INI_LSH_UP FORMAT "%9.6"
 /begin AXIS_DESCR COM_AXIS online_dummy _CNV_A_R_EGCP_LINEA_315_CM 6 -2048. 2047.9375 FORMAT "%10.4" AXIS_PTS_REF ldpm_temp_ini_ls_up_1_egcp /end AXIS_DESCR
/end CHARACTERISTIC
/begin CHARACTERISTIC ip_v_efc_ctl_lsh_up "Open loop control effective heater voltage" MAP 0xa1001fe4 _REC_MAP_20_u1_u1_u2 25.8984375 _CNV_A_R_LINEAR_____289_CM 0. 25.8984375 DISPLAY_IDENTIFIER IP_V_EFC_CTL_LSH_UP FORMAT "%9.6"
 /begin AXIS_DESCR COM_AXIS n_32 _CNV_A_R_LINEAR_____9_CM 6 0. 8160. FORMAT "%4.0" AXIS_PTS_REF ldpm_n_32_1_egcp /end AXIS_DESCR
 /begin AXIS_DESCR COM_AXIS online_dummy _CNV_A_R_LINEAR_____204_CM 6 -273.15 1774.7875 FORMAT "%9.4" AXIS_PTS_REF ldpm_teg_dyn_ls_up_1_egcp /end AXIS_DESCR
/end CHARACTERISTIC
/begin CHARACTERISTIC ip_t_temp_thd_lsh_up "Duration until critical water splash sensor temperature reached" CURVE 0xa1001f98 _REC_CUR_20_u1_u2 25.5 _CNV_A_R_LINEAR_____4_CM 0. 25.5 DISPLAY_IDENTIFIER IP_T_TEMP_THD_LSH_UP FORMAT "%4.1"
 /begin AXIS_DESCR COM_AXIS online_dummy _CNV_A_R_EGCP_LINEA_315_CM 6 -2048. 2047.9375 FORMAT "%10.4" AXIS_PTS_REF ldpm_temp_ini_ls_up_1_egcp /end AXIS_DESCR
/end CHARACTERISTIC
/begin CHARACTERISTIC ip_fac_v_efc_teg_lsh_up "Factor for the heat transfer rate, bank 2 only" CURVE 0xa1001d0e _REC_CUR_20_u1_u1 3.984375 _CNV_A_R_LINEAR_____283_CM 0. 3.984375 DISPLAY_IDENTIFIER IP_FAC_V_EFC_TEG_LSH_UP FORMAT "%8.6"
 /begin AXIS_DESCR COM_AXIS online_dummy _CNV_A_R_LINEAR_____6_CM 6 0. 255. FORMAT "%3.0" AXIS_PTS_REF ldp_vs_ip_fac_v_efc_teg_lsh_up /end AXIS_DESCR
/end CHARACTERISTIC
/begin CHARACTERISTIC c_v_efc_inc_lsh_up "Effective heater voltage increment to raise temperature" VALUE 0xa1002259 _REC_VAL_20_u1 1.625 _CNV_A_R_EGCP_LINEA_321_CM 0. 1.625 DISPLAY_IDENTIFIER C_V_EFC_INC_LSH_UP FORMAT "%5.3" /end CHARACTERISTIC
/begin CHARACTERISTIC c_v_efc_dec_lsh_up "Effective heater voltage decrement to lower temperature" VALUE 0xa1002257 _REC_VAL_20_u1 1.625 _CNV_A_R_EGCP_LINEA_321_CM 0. 1.625 DISPLAY_IDENTIFIER C_V_EFC_DEC_LSH_UP FORMAT "%5.3" /end CHARACTERISTIC
/begin CHARACTERISTIC c_v_efc_red_lsh_up "Reduced effective heater voltage during danger of water splash damage" VALUE 0xa1002269 _REC_VAL_20_u1 25.8984375 _CNV_A_R_LINEAR_____289_CM 0. 25.8984375 DISPLAY_IDENTIFIER C_V_EFC_RED_LSH_UP FORMAT "%9.6" /end CHARACTERISTIC
/begin CHARACTERISTIC c_v_efc_step_lsh_up "Additional effective heater voltage step on transition from LSH_POW_RED to LSH_POW_RISE" VALUE 0xa100226b _REC_VAL_20_s1 25.898438 _CNV_A_R_EGCP_LINEA_322_CM -13. 12.898438 DISPLAY_IDENTIFIER C_V_EFC_STEP_LSH_UP FORMAT "%5.1" /end CHARACTERISTIC
/begin CHARACTERISTIC c_t_max_v_efc_tol_lsh_up "Maximum permitted duration where excessive effective heater voltage tolerated" VALUE 0xa10021e9 _REC_VAL_20_u1 25.5 _CNV_A_R_LINEAR_____4_CM 0. 25.5 DISPLAY_IDENTIFIER C_T_MAX_V_EFC_TOL_LSH_UP FORMAT "%4.1" /end CHARACTERISTIC
/begin CHARACTERISTIC c_t_max_v_efc_lim_lsh_up "Maximum duration of effective heater voltage limiting" VALUE 0xa10021e5 _REC_VAL_20_u1 25.5 _CNV_A_R_LINEAR_____4_CM 0. 25.5 DISPLAY_IDENTIFIER C_T_MAX_V_EFC_LIM_LSH_UP FORMAT "%4.1" /end CHARACTERISTIC
/begin CHARACTERISTIC c_t_max_v_efc_max_st_lsh_up "Time after start at which step in max. effective heater voltage applied" VALUE 0xa10021e7 _REC_VAL_20_u1 25.5 _CNV_A_R_LINEAR_____4_CM 0. 25.5 DISPLAY_IDENTIFIER C_T_MAX_V_EFC_MAX_ST_LSH_UP FORMAT "%4.1" /end CHARACTERISTIC
/begin CHARACTERISTIC c_t_ast_max_lsh_up "Time after start at which step in max. effective heater voltage applied" VALUE 0xa1002180 _REC_VAL_20_u2 6553.5 _CNV_A_R_LINEAR_____4_CM 0. 6553.5 DISPLAY_IDENTIFIER C_T_AST_MAX_LSH_UP FORMAT "%6.1" /end CHARACTERISTIC
/begin CHARACTERISTIC c_v_efc_tol_lsh_up "Effective heater voltage threshold above which voltage limiting may occur if threshold persistently exceeded" VALUE 0xa100226d _REC_VAL_20_u1 25.8984375 _CNV_A_R_LINEAR_____289_CM 0. 25.8984375 DISPLAY_IDENTIFIER C_V_EFC_TOL_LSH_UP FORMAT "%9.6" /end CHARACTERISTIC
/begin CHARACTERISTIC c_v_efc_lim_lsh_up "Effective heater voltage limit under persistent excessive heater voltage condition" VALUE 0xa100225d _REC_VAL_20_u1 25.8984375 _CNV_A_R_LINEAR_____289_CM 0. 25.8984375 DISPLAY_IDENTIFIER C_V_EFC_LIM_LSH_UP FORMAT "%9.6" /end CHARACTERISTIC
/begin CHARACTERISTIC c_vb_max_prot_lsh_up "Maximum permitted battery voltage threshold, over which overvoltage detected" VALUE 0xa1002272 _REC_VAL_20_u1 25.8984375 _CNV_A_R_LINEAR_____289_CM 0. 25.8984375 DISPLAY_IDENTIFIER C_VB_MAX_PROT_LSH_UP FORMAT "%9.6" /end CHARACTERISTIC
/begin CHARACTERISTIC c_v_efc_prot_vb_lsh_up "Effective heater voltage in the case of battery voltage overvoltage condition" VALUE 0xa1002267 _REC_VAL_20_u1 25.8984375 _CNV_A_R_LINEAR_____289_CM 0. 25.8984375 DISPLAY_IDENTIFIER C_V_EFC_PROT_VB_LSH_UP FORMAT "%9.6" /end CHARACTERISTIC
/begin CHARACTERISTIC c_v_efc_max_lsh_up "Absolute maximum permitted effective heater voltage after initial phase; threshold & limit " VALUE 0xa1002260 _REC_VAL_20_u1 25.8984375 _CNV_A_R_LINEAR_____289_CM 0. 25.8984375 DISPLAY_IDENTIFIER C_V_EFC_MAX_LSH_UP FORMAT "%9.6" /end CHARACTERISTIC
/begin CHARACTERISTIC c_v_efc_max_st_lsh_up "Absolute maximum permitted effective heater voltage during initial phase; threshold & limit " VALUE 0xa1002265 _REC_VAL_20_u1 25.8984375 _CNV_A_R_LINEAR_____289_CM 0. 25.8984375 DISPLAY_IDENTIFIER C_V_EFC_MAX_ST_LSH_UP FORMAT "%9.6" /end CHARACTERISTIC
/begin CHARACTERISTIC c_v_efc_as_lsh_up "Effective heater voltage calibration system additive factor" VALUE 0xa1002255 _REC_VAL_20_s1 25.898438 _CNV_A_R_EGCP_LINEA_322_CM -13. 12.898438 DISPLAY_IDENTIFIER C_V_EFC_AS_LSH_UP FORMAT "%5.1" /end CHARACTERISTIC
/begin CHARACTERISTIC c_fac_ctl_i_lsh_up "Multiplicative scaling factor for closed loop I-term" VALUE 0xa100207c _REC_VAL_20_u1 6.348 _CNV_A_R_EGCP_LINEA_320_CM 0. 6.348 DISPLAY_IDENTIFIER C_FAC_CTL_I_LSH_UP FORMAT "%5.3" /end CHARACTERISTIC
/begin CHARACTERISTIC c_ttip_sp_ls_up[0] "Oxygen sensor set temperature for closed loop control" VALUE 0xa1002248 _REC_VAL_20_s2 4095.9375 _CNV_A_R_LINEAR_____123_CM -2048. 2047.9375 DISPLAY_IDENTIFIER C_TTIP_SP_LS_UP[1] FORMAT "%10.4" /end CHARACTERISTIC
/begin CHARACTERISTIC c_ttip_sp_ls_up[1] "Oxygen sensor set temperature for closed loop control" VALUE 0xa100224a _REC_VAL_20_s2 4095.9375 _CNV_A_R_LINEAR_____123_CM -2048. 2047.9375 DISPLAY_IDENTIFIER C_TTIP_SP_LS_UP[2] FORMAT "%10.4" /end CHARACTERISTIC
/begin AXIS_PTS ldp_vs_ip_fac_v_efc_teg_lsh_up "" 0xa1001a8a online_dummy _REC_AXS_20_u1 255. _CNV_A_R_LINEAR_____6_CM 6 0. 255. FORMAT "%3.0" /end AXIS_PTS
/begin AXIS_PTS ldp_t_pow_rise_lsh_up_id_ttip "" 0xa10019e4 online_dummy _REC_AXS_20_u2 6553.5 _CNV_A_R_LINEAR_____4_CM 4 0. 6553.5 FORMAT "%6.1" /end AXIS_PTS
/begin CHARACTERISTIC ip_fac_neg_ctl_i_lsh_up "Closed loop controller I-term factor for temperature too high; decrease heater voltage" MAP 0xa1001c68 _REC_MAP_20_u1_u1_u2 0.255 _CNV_A_R_EGCP_LINEA_319_CM 0. 0.255 DISPLAY_IDENTIFIER IP_FAC_NEG_CTL_I_LSH_UP FORMAT "%5.3"
 /begin AXIS_DESCR COM_AXIS n_32 _CNV_A_R_LINEAR_____9_CM 6 0. 8160. FORMAT "%4.0" AXIS_PTS_REF ldpm_n_32_1_egcp /end AXIS_DESCR
 /begin AXIS_DESCR COM_AXIS online_dummy _CNV_A_R_LINEAR_____204_CM 6 -273.15 1774.7875 FORMAT "%9.4" AXIS_PTS_REF ldpm_teg_dyn_ls_up_1_egcp /end AXIS_DESCR
/end CHARACTERISTIC
/begin CHARACTERISTIC id_ttip_sp_dif_lsh_up "Reducing value for TTIP threshold of transition conditions LSH_POW_RISE to LSH_POW_CTL" CURVE 0xa1001bb0 _REC_CUR_20_s2_u2 4095.9375 _CNV_A_R_LINEAR_____123_CM -2048. 2047.9375 DISPLAY_IDENTIFIER ID_TTIP_SP_DIF_LSH_UP FORMAT "%10.4"
 /begin AXIS_DESCR COM_AXIS online_dummy _CNV_A_R_LINEAR_____4_CM 4 0. 6553.5 FORMAT "%6.1" AXIS_PTS_REF ldp_t_pow_rise_lsh_up_id_ttip /end AXIS_DESCR
/end CHARACTERISTIC
/begin CHARACTERISTIC c_teg_dyn_max_lsh_up "Maximum permitted exhaust gas temperature above which LSH switched off" VALUE 0xa100221e _REC_VAL_20_u2 2047.9375 _CNV_A_R_LINEAR_____204_CM -273.15 1774.7875 DISPLAY_IDENTIFIER C_TEG_DYN_MAX_LSH_UP FORMAT "%9.4" /end CHARACTERISTIC
/begin CHARACTERISTIC lc_lsh_ctl_cll_inh_lsh_up[0] "Boolean constant to permit suspension of closed loop heater control" VALUE 0xa10022fa _REC_VAL_20_u1 1. _CNV_A_R_LINEAR_____0_CM 0. 1. DISPLAY_IDENTIFIER LC_LSH_CTL_CLL_INH_LSH_UP[1] FORMAT "%1.0" /end CHARACTERISTIC
/begin CHARACTERISTIC lc_lsh_ctl_cll_inh_lsh_up[1] "Boolean constant to permit suspension of closed loop heater control" VALUE 0xa10022fb _REC_VAL_20_u1 1. _CNV_A_R_LINEAR_____0_CM 0. 1. DISPLAY_IDENTIFIER LC_LSH_CTL_CLL_INH_LSH_UP[2] FORMAT "%1.0" /end CHARACTERISTIC
/begin CHARACTERISTIC lc_lsh_up_man_act[0] "Boolean constant to permit forced lambda sensor heating before engine start" VALUE 0xa1002302 _REC_VAL_20_u1 1. _CNV_A_R_LINEAR_____0_CM 0. 1. DISPLAY_IDENTIFIER LC_LSH_UP_MAN_ACT[1] FORMAT "%1.0" /end CHARACTERISTIC
/begin CHARACTERISTIC lc_lsh_up_man_act[1] "Boolean constant to permit forced lambda sensor heating before engine start" VALUE 0xa1002303 _REC_VAL_20_u1 1. _CNV_A_R_LINEAR_____0_CM 0. 1. DISPLAY_IDENTIFIER LC_LSH_UP_MAN_ACT[2] FORMAT "%1.0" /end CHARACTERISTIC
/begin CHARACTERISTIC c_fac_v_efc_as_lsh_up "Multiplicative correction factor to effective heater voltage" VALUE 0xa100209f _REC_VAL_20_u1 1.9921875 _CNV_A_R_LINEAR_____100_CM 0. 1.9921875 DISPLAY_IDENTIFIER C_FAC_V_EFC_AS_LSH_UP FORMAT "%8.6" /end CHARACTERISTIC
/begin CHARACTERISTIC c_fac_v_efc_lsh_up_man_act "Multiplicative correction factor to effective heater voltage with activated forced heating before engine start" VALUE 0xa10020a0 _REC_VAL_20_u1 1.9921875 _CNV_A_R_LINEAR_____100_CM 0. 1.9921875 DISPLAY_IDENTIFIER C_FAC_V_EFC_LSH_UP_MAN_ACT FORMAT "%8.6" /end CHARACTERISTIC
/begin CHARACTERISTIC c_v_efc_ini_lsh_up_man_act "Initial effective heater voltage when forced heating before engine start activated" VALUE 0xa100225a _REC_VAL_20_u2 25.999603 _CNV_A_R_LINEAR_____142_CM 0. 25.999603 DISPLAY_IDENTIFIER C_V_EFC_INI_LSH_UP_MAN_ACT FORMAT "%7.4" /end CHARACTERISTIC
/begin CHARACTERISTIC c_v_efc_max_lsh_up_man_act "Absolute maximum permitted effective voltage during forced heating  phase before engine start" VALUE 0xa1002262 _REC_VAL_20_u2 25.999603 _CNV_A_R_LINEAR_____142_CM 0. 25.999603 DISPLAY_IDENTIFIER C_V_EFC_MAX_LSH_UP_MAN_ACT FORMAT "%7.4" /end CHARACTERISTIC
/begin CHARACTERISTIC c_t_max_pow_rise_lsh_up "Duration of open loop pre-heating in LSH_POW_RISE from dew-point to set-point temperature" VALUE 0xa10021e2 _REC_VAL_20_u2 6553.5 _CNV_A_R_LINEAR_____4_CM 0. 6553.5 DISPLAY_IDENTIFIER C_T_MAX_POW_RISE_LSH_UP FORMAT "%6.1" /end CHARACTERISTIC
/begin CHARACTERISTIC c_t_max_cdn_lsh_up_man_act "Time threshold for transition from state POW_RISE to POW_CTL with activated forced heating before engine start" VALUE 0xa10021d6 _REC_VAL_20_u2 6553.5 _CNV_A_R_LINEAR_____4_CM 0. 6553.5 DISPLAY_IDENTIFIER C_T_MAX_CDN_LSH_UP_MAN_ACT FORMAT "%6.1" /end CHARACTERISTIC
/begin CHARACTERISTIC ip_v_efc_ini_lsh_down "Initial effective heater voltage" CURVE 0xa1002008 _REC_CUR_20_u1_u2 25.8984375 _CNV_A_R_LINEAR_____289_CM 0. 25.8984375 DISPLAY_IDENTIFIER IP_V_EFC_INI_LSH_DOWN FORMAT "%9.6"
 /begin AXIS_DESCR COM_AXIS online_dummy _CNV_A_R_EGCP_LINEA_315_CM 6 -2048. 2047.9375 FORMAT "%10.4" AXIS_PTS_REF ldpm_temp_ini_ls_down_1_egcp /end AXIS_DESCR
/end CHARACTERISTIC
/begin CHARACTERISTIC ip_v_efc_ctl_lsh_down "Open loop control effective heater voltage" MAP 0xa1001fc0 _REC_MAP_20_u1_u1_u2 25.8984375 _CNV_A_R_LINEAR_____289_CM 0. 25.8984375 DISPLAY_IDENTIFIER IP_V_EFC_CTL_LSH_DOWN FORMAT "%9.6"
 /begin AXIS_DESCR COM_AXIS n_32 _CNV_A_R_LINEAR_____9_CM 6 0. 8160. FORMAT "%4.0" AXIS_PTS_REF ldpm_n_32_3_egcp /end AXIS_DESCR
 /begin AXIS_DESCR COM_AXIS online_dummy _CNV_A_R_LINEAR_____204_CM 6 -273.15 1774.7875 FORMAT "%9.4" AXIS_PTS_REF ldpm_teg_dyn_ls_down_1_egcp /end AXIS_DESCR
/end CHARACTERISTIC
/begin CHARACTERISTIC ip_t_temp_thd_lsh_down "Duration until critical water splash sensor temperature reached" CURVE 0xa1001f8c _REC_CUR_20_u2_u2 6553.5 _CNV_A_R_LINEAR_____4_CM 0. 6553.5 DISPLAY_IDENTIFIER IP_T_TEMP_THD_LSH_DOWN FORMAT "%6.1"
 /begin AXIS_DESCR COM_AXIS online_dummy _CNV_A_R_EGCP_LINEA_315_CM 6 -2048. 2047.9375 FORMAT "%10.4" AXIS_PTS_REF ldpm_temp_ini_ls_down_1_egcp /end AXIS_DESCR
/end CHARACTERISTIC
/begin CHARACTERISTIC ip_fac_v_efc_teg_lsh_down "Factor for the heat transfer rate, bank 2 only" CURVE 0xa1001d08 _REC_CUR_20_u1_u1 3.984375 _CNV_A_R_LINEAR_____283_CM 0. 3.984375 DISPLAY_IDENTIFIER IP_FAC_V_EFC_TEG_LSH_DOWN FORMAT "%8.6"
 /begin AXIS_DESCR COM_AXIS online_dummy _CNV_A_R_LINEAR_____6_CM 6 0. 255. FORMAT "%3.0" AXIS_PTS_REF ldpm_vs_1_egcp /end AXIS_DESCR
/end CHARACTERISTIC
/begin CHARACTERISTIC c_v_efc_inc_lsh_down "Effective heater voltage increment to raise temperature" VALUE 0xa1002258 _REC_VAL_20_u1 1.625 _CNV_A_R_EGCP_LINEA_321_CM 0. 1.625 DISPLAY_IDENTIFIER C_V_EFC_INC_LSH_DOWN FORMAT "%5.3" /end CHARACTERISTIC
/begin CHARACTERISTIC c_v_efc_dec_lsh_down "Effective heater voltage decrement to lower temperature" VALUE 0xa1002256 _REC_VAL_20_u1 1.625 _CNV_A_R_EGCP_LINEA_321_CM 0. 1.625 DISPLAY_IDENTIFIER C_V_EFC_DEC_LSH_DOWN FORMAT "%5.3" /end CHARACTERISTIC
/begin CHARACTERISTIC c_v_efc_red_lsh_down "Reduced effective heater voltage during danger of water splash damage" VALUE 0xa1002268 _REC_VAL_20_u1 25.8984375 _CNV_A_R_LINEAR_____289_CM 0. 25.8984375 DISPLAY_IDENTIFIER C_V_EFC_RED_LSH_DOWN FORMAT "%9.6" /end CHARACTERISTIC
/begin CHARACTERISTIC c_v_efc_step_lsh_down "Additional effective heater voltage step on transition from LSH_POW_RED to LSH_POW_RISE" VALUE 0xa100226a _REC_VAL_20_s1 25.898438 _CNV_A_R_EGCP_LINEA_322_CM -13. 12.898438 DISPLAY_IDENTIFIER C_V_EFC_STEP_LSH_DOWN FORMAT "%5.1" /end CHARACTERISTIC
/begin CHARACTERISTIC c_t_max_pow_rise_lsh_down "Duration of open loop pre-heating in LSH_POW_RISE from dew-point to set-point temperature" VALUE 0xa10021e0 _REC_VAL_20_u2 6553.5 _CNV_A_R_LINEAR_____4_CM 0. 6553.5 DISPLAY_IDENTIFIER C_T_MAX_POW_RISE_LSH_DOWN FORMAT "%6.1" /end CHARACTERISTIC
/begin CHARACTERISTIC c_t_max_v_efc_tol_lsh_down "Maximum permitted duration where excessive effective heater voltage tolerated" VALUE 0xa10021e8 _REC_VAL_20_u1 25.5 _CNV_A_R_LINEAR_____4_CM 0. 25.5 DISPLAY_IDENTIFIER C_T_MAX_V_EFC_TOL_LSH_DOWN FORMAT "%4.1" /end CHARACTERISTIC
/begin CHARACTERISTIC c_t_max_v_efc_lim_lsh_down "Maximum duration of effective heater voltage limiting" VALUE 0xa10021e4 _REC_VAL_20_u1 25.5 _CNV_A_R_LINEAR_____4_CM 0. 25.5 DISPLAY_IDENTIFIER C_T_MAX_V_EFC_LIM_LSH_DOWN FORMAT "%4.1" /end CHARACTERISTIC
/begin CHARACTERISTIC c_t_max_v_efc_max_st_lsh_down "Time after start at which step in max. effective heater voltage applied" VALUE 0xa10021e6 _REC_VAL_20_u1 25.5 _CNV_A_R_LINEAR_____4_CM 0. 25.5 DISPLAY_IDENTIFIER C_T_MAX_V_EFC_MAX_ST_LSH_DOWN FORMAT "%4.1" /end CHARACTERISTIC
/begin CHARACTERISTIC c_t_ast_max_lsh_down "Time after start at which step in max. effective heater voltage applied" VALUE 0xa100217e _REC_VAL_20_u2 6553.5 _CNV_A_R_LINEAR_____4_CM 0. 6553.5 DISPLAY_IDENTIFIER C_T_AST_MAX_LSH_DOWN FORMAT "%6.1" /end CHARACTERISTIC
/begin CHARACTERISTIC c_v_efc_tol_lsh_down "Effective heater voltage threshold above which voltage limiting may occur if threshold persistently exceeded" VALUE 0xa100226c _REC_VAL_20_u1 25.8984375 _CNV_A_R_LINEAR_____289_CM 0. 25.8984375 DISPLAY_IDENTIFIER C_V_EFC_TOL_LSH_DOWN FORMAT "%9.6" /end CHARACTERISTIC
/begin CHARACTERISTIC c_v_efc_lim_lsh_down "Effective heater voltage limit under persistent excessive heater voltage condition" VALUE 0xa100225c _REC_VAL_20_u1 25.8984375 _CNV_A_R_LINEAR_____289_CM 0. 25.8984375 DISPLAY_IDENTIFIER C_V_EFC_LIM_LSH_DOWN FORMAT "%9.6" /end CHARACTERISTIC
/begin CHARACTERISTIC c_vb_max_prot_lsh_down "Maximum permitted battery voltage threshold, over which overvoltage detected" VALUE 0xa1002271 _REC_VAL_20_u1 25.8984375 _CNV_A_R_LINEAR_____289_CM 0. 25.8984375 DISPLAY_IDENTIFIER C_VB_MAX_PROT_LSH_DOWN FORMAT "%9.6" /end CHARACTERISTIC
/begin CHARACTERISTIC c_v_efc_prot_vb_lsh_down "Effective heater voltage in the case of battery voltage overvoltage condition" VALUE 0xa1002266 _REC_VAL_20_u1 25.8984375 _CNV_A_R_LINEAR_____289_CM 0. 25.8984375 DISPLAY_IDENTIFIER C_V_EFC_PROT_VB_LSH_DOWN FORMAT "%9.6" /end CHARACTERISTIC
/begin CHARACTERISTIC c_v_efc_max_lsh_down "Absolute maximum permitted effective heater voltage after initial phase; threshold & limit " VALUE 0xa100225f _REC_VAL_20_u1 25.8984375 _CNV_A_R_LINEAR_____289_CM 0. 25.8984375 DISPLAY_IDENTIFIER C_V_EFC_MAX_LSH_DOWN FORMAT "%9.6" /end CHARACTERISTIC
/begin CHARACTERISTIC c_v_efc_max_st_lsh_down "Absolute maximum permitted effective heater voltage during initial phase; threshold & limit " VALUE 0xa1002264 _REC_VAL_20_u1 25.8984375 _CNV_A_R_LINEAR_____289_CM 0. 25.8984375 DISPLAY_IDENTIFIER C_V_EFC_MAX_ST_LSH_DOWN FORMAT "%9.6" /end CHARACTERISTIC
/begin CHARACTERISTIC c_v_efc_as_lsh_down "Effective heater voltage calibration system additive factor" VALUE 0xa1002254 _REC_VAL_20_s1 25.898438 _CNV_A_R_EGCP_LINEA_322_CM -13. 12.898438 DISPLAY_IDENTIFIER C_V_EFC_AS_LSH_DOWN FORMAT "%5.1" /end CHARACTERISTIC
/begin CHARACTERISTIC c_teg_dyn_max_lsh_down "Maximum permitted exhaust gas temperature above which LSH switched off" VALUE 0xa100221c _REC_VAL_20_u2 2047.9375 _CNV_A_R_LINEAR_____204_CM -273.15 1774.7875 DISPLAY_IDENTIFIER C_TEG_DYN_MAX_LSH_DOWN FORMAT "%9.4" /end CHARACTERISTIC
/begin CHARACTERISTIC c_fac_v_efc_as_lsh_down "Multiplicative correction factor to effective heater voltage" VALUE 0xa100209e _REC_VAL_20_u1 1.9921875 _CNV_A_R_LINEAR_____100_CM 0. 1.9921875 DISPLAY_IDENTIFIER C_FAC_V_EFC_AS_LSH_DOWN FORMAT "%8.6" /end CHARACTERISTIC
/begin CHARACTERISTIC c_lamb_ls_up_min_ofs_adj "Minimum lambda threshold for the offset calculation  " VALUE 0xa10020e2 _REC_VAL_20_u2 31.9990234375 _CNV_A_R_LINEAR_____122_CM 0. 31.9990234375 DISPLAY_IDENTIFIER C_LAMB_LS_UP_MIN_OFS_ADJ FORMAT "%7.4" /end CHARACTERISTIC
/begin CHARACTERISTIC c_vls_ofs_sp_lsl "Nominal lambda sensor voltage ( valid for Ip = 0 or LAMB = 1)" VALUE 0xa10022b6 _REC_VAL_20_u2 4.999847 _CNV_A_R_EGCP_LINEA_323_CM 0. 4.999847 DISPLAY_IDENTIFIER C_VLS_OFS_SP_LSL FORMAT "%6.4" /end CHARACTERISTIC
/begin CHARACTERISTIC c_t_dly_lamb_sti_off_ofs_adj "Delay time for the offset calculation after switching off forced lambda stimulation" VALUE 0xa10021ae _REC_VAL_20_u2 655.35 _CNV_A_R_LINEAR_____3_CM 0. 655.35 DISPLAY_IDENTIFIER C_T_DLY_LAMB_STI_OFF_OFS_ADJ FORMAT "%6.2" /end CHARACTERISTIC
/begin CHARACTERISTIC c_iplsl_gain "Total gain of WRAF sensor interface circuit  ( Ip / ( V_LMBD_IP - C_VLS_OFS_SP_LSL  )) for Ip gain16" VALUE 0xa10020ac _REC_VAL_20_u2 5.038331 _CNV_A_R_EGCP_LINEA_324_CM 0. 5.038331 DISPLAY_IDENTIFIER C_IPLSL_GAIN FORMAT "%7.5" /end CHARACTERISTIC
/begin MEASUREMENT lamb_ls_up_mv "Mean value lambda in multiple-branched exhaust gas lines" UWORD _CNV_A_R_LINEAR_____122_CM 1 100. 0. 31.9990234375 DISPLAY_IDENTIFIER LAMB_LS_UP_MV ECU_ADDRESS 0xd0002532 FORMAT "%7.4" /end MEASUREMENT
/begin MEASUREMENT lamb_ls_up_min "Minimum lambda in multiple-branched exhaust gas lines" UWORD _CNV_A_R_LINEAR_____122_CM 1 100. 0. 31.9990234375 DISPLAY_IDENTIFIER LAMB_LS_UP_MIN ECU_ADDRESS 0xd0002530 FORMAT "%7.4" /end MEASUREMENT
/begin CHARACTERISTIC c_t_dly_lsl_ofs_adj "Delay time for the offset calculation after activating offset adjustment" VALUE 0xa10021b2 _REC_VAL_20_u1 2.55 _CNV_A_R_LINEAR_____3_CM 0. 2.55 DISPLAY_IDENTIFIER C_T_DLY_LSL_OFS_ADJ FORMAT "%4.2" /end CHARACTERISTIC
/begin CHARACTERISTIC c_t_dly_lsl_ofs_adj_is "Delay time for activation of offset adjustment upon entering state idle speed" VALUE 0xa10021b3 _REC_VAL_20_u1 2.55 _CNV_A_R_LINEAR_____3_CM 0. 2.55 DISPLAY_IDENTIFIER C_T_DLY_LSL_OFS_ADJ_IS FORMAT "%4.2" /end CHARACTERISTIC
/begin AXIS_PTS ldp_vls_cor_mv_ip_lamb_ls_up "" 0xa1001a68 online_dummy _REC_AXS_20_u2 4.999847 _CNV_A_R_EGCP_LINEA_323_CM 16 0. 4.999847 FORMAT "%6.4" /end AXIS_PTS
/begin AXIS_PTS ldp_vls_cor_mv_ip_lamb_l_gain "" 0xa1001a44 online_dummy _REC_AXS_20_u2 4.999847 _CNV_A_R_EGCP_LINEA_323_CM 16 0. 4.999847 FORMAT "%6.4" /end AXIS_PTS
/begin CHARACTERISTIC ip_lamb_ls_up "Characteristic curve of the lambda sensor (lambda vs. corrected VLS_UP)" CURVE 0xa1001d94 _REC_CUR_20_u2_u2 31.9990234375 _CNV_A_R_LINEAR_____122_CM 0. 31.9990234375 DISPLAY_IDENTIFIER IP_LAMB_LS_UP FORMAT "%7.4"
 /begin AXIS_DESCR COM_AXIS online_dummy _CNV_A_R_EGCP_LINEA_323_CM 16 0. 4.999847 FORMAT "%6.4" AXIS_PTS_REF ldp_vls_cor_mv_ip_lamb_ls_up /end AXIS_DESCR
/end CHARACTERISTIC
/begin CHARACTERISTIC ip_lamb_ls_up_l_gain "Characteristic curve of the lambda sensor (lambda vs. corrected VLS_UP)for Ip gain 8" CURVE 0xa1001db4 _REC_CUR_20_u2_u2 31.9990234375 _CNV_A_R_LINEAR_____122_CM 0. 31.9990234375 DISPLAY_IDENTIFIER IP_LAMB_LS_UP_L_GAIN FORMAT "%7.4"
 /begin AXIS_DESCR COM_AXIS online_dummy _CNV_A_R_EGCP_LINEA_323_CM 16 0. 4.999847 FORMAT "%6.4" AXIS_PTS_REF ldp_vls_cor_mv_ip_lamb_l_gain /end AXIS_DESCR
/end CHARACTERISTIC
/begin CHARACTERISTIC c_t_wait_lsl_ofs_adj "Lock time after an offset calculation prior to the next calculation for warm engine" VALUE 0xa1002206 _REC_VAL_20_u2 655.35 _CNV_A_R_LINEAR_____3_CM 0. 655.35 DISPLAY_IDENTIFIER C_T_WAIT_LSL_OFS_ADJ FORMAT "%6.2" /end CHARACTERISTIC
/begin CHARACTERISTIC c_t_wait_lsl_ofs_adj_red "Lock time after an offset calculation prior to the next calculation during engine warm-up" VALUE 0xa1002208 _REC_VAL_20_u2 655.35 _CNV_A_R_LINEAR_____3_CM 0. 655.35 DISPLAY_IDENTIFIER C_T_WAIT_LSL_OFS_ADJ_RED FORMAT "%6.2" /end CHARACTERISTIC
/begin CHARACTERISTIC c_nr_cyc_t_wait_lsl_ofs_adj_red "Number of cycles for application of reduced repetition rate for offset adjustment during engine warm-up" VALUE 0xa1002164 _REC_VAL_20_u1 255. _CNV_A_R_LINEAR_____0_CM 0. 255. DISPLAY_IDENTIFIER C_NR_CYC_T_WAIT_LSL_OFS_ADJ_RED FORMAT "%3.0" /end CHARACTERISTIC
/begin CHARACTERISTIC c_crlc_vls_up_ofs_adj "Correlation constant for filtering of mean value of WRAF sensor lambda signal for Ip gain16" VALUE 0xa1002042 _REC_VAL_20_u2 0.9999847412109381 _CNV_A_R_LINEAR_____68_CM 0. 0.9999847412109381 DISPLAY_IDENTIFIER C_CRLC_VLS_UP_OFS_ADJ FORMAT "%7.5" /end CHARACTERISTIC
/begin CHARACTERISTIC c_crlc_vls_up_ofs_adj_l_gain "Correlation constant for filtering of mean value of WRAF sensor lambda signal for Ip gain8" VALUE 0xa1002044 _REC_VAL_20_u2 0.9999847412109381 _CNV_A_R_LINEAR_____68_CM 0. 0.9999847412109381 DISPLAY_IDENTIFIER C_CRLC_VLS_UP_OFS_ADJ_L_GAIN FORMAT "%7.5" /end CHARACTERISTIC
/begin CHARACTERISTIC c_vls_ofs_dif_ok_lsl "Maximum permitted deviation of two successive offset values for Ip gain16" VALUE 0xa10022ae _REC_VAL_20_u2 4.999847 _CNV_A_R_EGCP_LINEA_323_CM 0. 4.999847 DISPLAY_IDENTIFIER C_VLS_OFS_DIF_OK_LSL FORMAT "%6.4" /end CHARACTERISTIC
/begin CHARACTERISTIC c_vls_ofs_dif_ok_lsl_l_gain "Maximum permitted deviation of two successive offset values for Ip gain8" VALUE 0xa10022b0 _REC_VAL_20_u2 4.999847 _CNV_A_R_EGCP_LINEA_323_CM 0. 4.999847 DISPLAY_IDENTIFIER C_VLS_OFS_DIF_OK_LSL_L_GAIN FORMAT "%6.4" /end CHARACTERISTIC
/begin CHARACTERISTIC c_vls_ofs_max_absv_lsl "Limit value for the offset as a maximum value (absolute value) for Ip gain16" VALUE 0xa10022b2 _REC_VAL_20_u2 4.999847 _CNV_A_R_EGCP_LINEA_323_CM 0. 4.999847 DISPLAY_IDENTIFIER C_VLS_OFS_MAX_ABSV_LSL FORMAT "%6.4" /end CHARACTERISTIC
/begin CHARACTERISTIC c_vls_ofs_max_absv_lsl_l_gain "Limit value for the offset as a maximum value (absolute value) for Ip gain8" VALUE 0xa10022b4 _REC_VAL_20_u2 4.999847 _CNV_A_R_EGCP_LINEA_323_CM 0. 4.999847 DISPLAY_IDENTIFIER C_VLS_OFS_MAX_ABSV_LSL_L_GAIN FORMAT "%6.4" /end CHARACTERISTIC
/begin CHARACTERISTIC lc_lsl_ofs_adj_ena "Switch to enable offset adjustment in every engine state" VALUE 0xa100230a _REC_VAL_20_u1 1. _CNV_A_R_LINEAR_____0_CM 0. 1. DISPLAY_IDENTIFIER LC_LSL_OFS_ADJ_ENA FORMAT "%1.0" /end CHARACTERISTIC
/begin CHARACTERISTIC lc_cat_diag_act_wait "Switch to grant catalyst diagnosis priority to be completed without interruption by OA" VALUE 0xa10022d3 _REC_VAL_20_u1 1. _CNV_A_R_LINEAR_____0_CM 0. 1. DISPLAY_IDENTIFIER LC_CAT_DIAG_ACT_WAIT FORMAT "%1.0" /end CHARACTERISTIC
/begin CHARACTERISTIC lc_lamb_pls_act_neut "Switch to perform OA regardless of current status of forced lambda stimulation" VALUE 0xa10022e8 _REC_VAL_20_u1 1. _CNV_A_R_LINEAR_____0_CM 0. 1. DISPLAY_IDENTIFIER LC_LAMB_PLS_ACT_NEUT FORMAT "%1.0" /end CHARACTERISTIC
/begin CHARACTERISTIC lc_ctr_err_lsl_if_save_man_inc "Switch enabling simulation of SPI communication error with WRAF controller " VALUE 0xa10022d4 _REC_VAL_20_u1 1. _CNV_A_R_LINEAR_____0_CM 0. 1. DISPLAY_IDENTIFIER LC_CTR_ERR_LSL_IF_SAVE_MAN_INC FORMAT "%1.0" /end CHARACTERISTIC
/begin CHARACTERISTIC c_lamb_ls_up_max_ofs_adj "Maximum lambda threshold for the offset calculation  " VALUE 0xa10020e0 _REC_VAL_20_u2 31.9990234375 _CNV_A_R_LINEAR_____122_CM 0. 31.9990234375 DISPLAY_IDENTIFIER C_LAMB_LS_UP_MAX_OFS_ADJ FORMAT "%7.4" /end CHARACTERISTIC
/begin CHARACTERISTIC c_lamb_ls_up_gain_swi_min "Rich lambda threshold for switching of Ip gain16 -> gain8 " VALUE 0xa10020de _REC_VAL_20_u2 31.9990234375 _CNV_A_R_LINEAR_____122_CM 0. 31.9990234375 DISPLAY_IDENTIFIER C_LAMB_LS_UP_GAIN_SWI_MIN FORMAT "%7.4" /end CHARACTERISTIC
/begin CHARACTERISTIC c_lamb_ls_up_gain_swi_max "Lean lambda threshold for switching of Ip gain16 -> gain8" VALUE 0xa10020dc _REC_VAL_20_u2 31.9990234375 _CNV_A_R_LINEAR_____122_CM 0. 31.9990234375 DISPLAY_IDENTIFIER C_LAMB_LS_UP_GAIN_SWI_MAX FORMAT "%7.4" /end CHARACTERISTIC
/begin CHARACTERISTIC c_lamb_ls_up_vls_up_h_gain_min "Bottom limit of 'Ip gain16' band in terms of lambda" VALUE 0xa10020e6 _REC_VAL_20_u2 31.9990234375 _CNV_A_R_LINEAR_____122_CM 0. 31.9990234375 DISPLAY_IDENTIFIER C_LAMB_LS_UP_VLS_UP_H_GAIN_MIN FORMAT "%7.4" /end CHARACTERISTIC
/begin CHARACTERISTIC c_lamb_ls_up_vls_up_h_gain_max "Upper limit of 'Ip gain16' band in terms of lambda " VALUE 0xa10020e4 _REC_VAL_20_u2 31.9990234375 _CNV_A_R_LINEAR_____122_CM 0. 31.9990234375 DISPLAY_IDENTIFIER C_LAMB_LS_UP_VLS_UP_H_GAIN_MAX FORMAT "%7.4" /end CHARACTERISTIC
/begin CHARACTERISTIC lc_vls_cor_mv_lsl_act "Switch for (de)activation of averaging of VLS_COR_H_RES_LSL[i] prior to conversion" VALUE 0xa100231a _REC_VAL_20_u1 1. _CNV_A_R_LINEAR_____0_CM 0. 1. DISPLAY_IDENTIFIER LC_VLS_COR_MV_LSL_ACT FORMAT "%1.0" /end CHARACTERISTIC
/begin CHARACTERISTIC lc_lsl_ofs_adj_h_l_gain "Switch to enable offset adjustment in both Ip measurement ranges" VALUE 0xa100230c _REC_VAL_20_u1 1. _CNV_A_R_LINEAR_____0_CM 0. 1. DISPLAY_IDENTIFIER LC_LSL_OFS_ADJ_H_L_GAIN FORMAT "%1.0" /end CHARACTERISTIC
/begin CHARACTERISTIC lc_lsl_ofs_adj_gain_sel "Switch to choose Ip measurement range in which singular offset adjustment shall be performed " VALUE 0xa100230b _REC_VAL_20_u1 1. _CNV_A_R_LINEAR_____0_CM 0. 1. DISPLAY_IDENTIFIER LC_LSL_OFS_ADJ_GAIN_SEL FORMAT "%1.0" /end CHARACTERISTIC
/begin CHARACTERISTIC lc_iplsl_gain_swi_act "Switch to enable gain switching for measurement of pumping current" VALUE 0xa10022e6 _REC_VAL_20_u1 1. _CNV_A_R_LINEAR_____0_CM 0. 1. DISPLAY_IDENTIFIER LC_IPLSL_GAIN_SWI_ACT FORMAT "%1.0" /end CHARACTERISTIC
/begin AXIS_PTS ldpm_prs_ex_ip_fac_cor_iplsl "" 0xa1001aec online_dummy _REC_AXS_20_u2 5434. _CNV_A_R_LINEAR_____26_CM 8 0. 5434. FORMAT "%7.2" /end AXIS_PTS
/begin CHARACTERISTIC ip_fac_cor_iplsl_prs_ex "Factor for exhaust gas pressure correction at lean conditions" CURVE 0xa1001c28 _REC_CUR_20_u2_u2 1.99996948242188 _CNV_A_R_LINEAR_____8_CM 0. 1.99996948242188 DISPLAY_IDENTIFIER IP_FAC_COR_IPLSL_PRS_EX FORMAT "%7.5"
 /begin AXIS_DESCR COM_AXIS online_dummy _CNV_A_R_LINEAR_____26_CM 8 0. 5434. FORMAT "%7.2" AXIS_PTS_REF ldpm_prs_ex_ip_fac_cor_iplsl /end AXIS_DESCR
/end CHARACTERISTIC
/begin CHARACTERISTIC ip_fac_cor_iplsl_afr_prs_ex "Factor for exhaust gas pressure correction at rich conditions" CURVE 0xa1001bc0 _REC_CUR_20_u2_u2 1.99996948242188 _CNV_A_R_LINEAR_____8_CM 0. 1.99996948242188 DISPLAY_IDENTIFIER IP_FAC_COR_IPLSL_AFR_PRS_EX FORMAT "%7.5"
 /begin AXIS_DESCR COM_AXIS online_dummy _CNV_A_R_LINEAR_____26_CM 8 0. 5434. FORMAT "%7.2" AXIS_PTS_REF ldpm_prs_ex_ip_fac_cor_iplsl /end AXIS_DESCR
/end CHARACTERISTIC
/begin CHARACTERISTIC ip_fac_cor_iplsl_ttip_ls_up "Factor for correction of tip temperature influence" CURVE 0xa1001c38 _REC_CUR_20_u2_u2 1.99996948242188 _CNV_A_R_LINEAR_____8_CM 0. 1.99996948242188 DISPLAY_IDENTIFIER IP_FAC_COR_IPLSL_TTIP_LS_UP FORMAT "%7.5"
 /begin AXIS_DESCR COM_AXIS online_dummy _CNV_A_R_EGCP_LINEA_315_CM 8 -2048. 2047.9375 FORMAT "%10.4" AXIS_PTS_REF ldp_ttip_ls_up_ip_fac_cor_iplsl /end AXIS_DESCR
/end CHARACTERISTIC
/begin AXIS_PTS ldp_ttip_ls_up_ip_fac_cor_iplsl "" 0xa1001a08 online_dummy _REC_AXS_20_u2 4095.9375 _CNV_A_R_EGCP_LINEA_315_CM 8 -2048. 2047.9375 FORMAT "%10.4" /end AXIS_PTS
/begin CHARACTERISTIC c_t_dly_lsl_ofs_adj_puc_end "Delay time for activation of offset adjustment after leaving fuel cut-off phase" VALUE 0xa10021b4 _REC_VAL_20_u2 655.35 _CNV_A_R_LINEAR_____3_CM 0. 655.35 DISPLAY_IDENTIFIER C_T_DLY_LSL_OFS_ADJ_PUC_END FORMAT "%6.2" /end CHARACTERISTIC
/begin CHARACTERISTIC c_vls_down_afl_thd_ready "Lean VLS_DOWN[i] threshold for operative readiness detection" VALUE 0xa1002284 _REC_VAL_20_u2 4.9951171875 _CNV_A_R_LINEAR_____2_CM 0. 4.9951171875 DISPLAY_IDENTIFIER C_VLS_DOWN_AFL_THD_READY FORMAT "%5.3" /end CHARACTERISTIC
/begin CHARACTERISTIC c_vls_down_afr_thd_ready "Rich VLS_DOWN[i] threshold for operative readiness detection" VALUE 0xa1002288 _REC_VAL_20_u2 4.9951171875 _CNV_A_R_LINEAR_____2_CM 0. 4.9951171875 DISPLAY_IDENTIFIER C_VLS_DOWN_AFR_THD_READY FORMAT "%5.3" /end CHARACTERISTIC
/begin CHARACTERISTIC c_maf_int_puc_max_down_ls_ready "Maximum MAF integral during PUC for operability reset" VALUE 0xa100212e _REC_VAL_20_u2 2912.666666666671 _CNV_A_R_LINEAR_____329_CM 0. 2912.66666666667 DISPLAY_IDENTIFIER C_MAF_INT_PUC_MAX_DOWN_LS_READY FORMAT "%7.2" /end CHARACTERISTIC
/begin CHARACTERISTIC c_teg_dyn_min_ls_down_ready "Temperature threshold above which O2 sensor recognised as operatively ready" VALUE 0xa1002228 _REC_VAL_20_u2 2047.9375 _CNV_A_R_LINEAR_____204_CM -273.15 1774.7875 DISPLAY_IDENTIFIER C_TEG_DYN_MIN_LS_DOWN_READY FORMAT "%9.4" /end CHARACTERISTIC
/begin CHARACTERISTIC c_t_min_temp_dew_ls_down "Minimum time threshold after dew point recognition for lambda probe readiness detection" VALUE 0xa10021ee _REC_VAL_20_u2 6553.5 _CNV_A_R_LINEAR_____4_CM 0. 6553.5 DISPLAY_IDENTIFIER C_T_MIN_TEMP_DEW_LS_DOWN FORMAT "%6.1" /end CHARACTERISTIC
/begin CHARACTERISTIC c_crlc_lamb_ls_up_ready "Correlation constant for mean value calculation of lambda sensor output signal" VALUE 0xa1002034 _REC_VAL_20_u1 0.99609375 _CNV_A_R_LINEAR_____27_CM 0. 0.99609375 DISPLAY_IDENTIFIER C_CRLC_LAMB_LS_UP_READY FORMAT "%5.3" /end CHARACTERISTIC
/begin CHARACTERISTIC c_lamb_de_int_thd_ls_up_ready "Sensor signal dispersion threshold for readiness detection" VALUE 0xa10020d2 _REC_VAL_20_u2 63.999023 _CNV_A_R_EGCP_LINEA_330_CM 0. 63.999023 DISPLAY_IDENTIFIER C_LAMB_DE_INT_THD_LS_UP_READY FORMAT "%7.4" /end CHARACTERISTIC
/begin CHARACTERISTIC c_ttip_min_ls_up_ready "Minimum oxygen sensor ceramic temperature for save operation" VALUE 0xa1002242 _REC_VAL_20_s2 4095.9375 _CNV_A_R_LINEAR_____123_CM -2048. 2047.9375 DISPLAY_IDENTIFIER C_TTIP_MIN_LS_UP_READY FORMAT "%10.4" /end CHARACTERISTIC
/begin CHARACTERISTIC c_lamb_thd_max_ls_up_ready "Upper threshold of sensor signal for readiness detection" VALUE 0xa1002102 _REC_VAL_20_u2 1.999018 _CNV_A_R_EGCP_LINEA_331_CM 0. 1.999018 DISPLAY_IDENTIFIER C_LAMB_THD_MAX_LS_UP_READY FORMAT "%6.4" /end CHARACTERISTIC
/begin CHARACTERISTIC c_lamb_thd_min_ls_up_ready "Lower threshold of sensor signal for readiness detection" VALUE 0xa1002108 _REC_VAL_20_u2 1.999018 _CNV_A_R_EGCP_LINEA_331_CM 0. 1.999018 DISPLAY_IDENTIFIER C_LAMB_THD_MIN_LS_UP_READY FORMAT "%6.4" /end CHARACTERISTIC
/begin CHARACTERISTIC c_t_lamb_de_int_rst "Time for sensor dispersion calculation up to reset" VALUE 0xa10021d4 _REC_VAL_20_u2 1310.7 _CNV_A_R_LINEAR_____107_CM 0. 1310.7 DISPLAY_IDENTIFIER C_T_LAMB_DE_INT_RST FORMAT "%7.2" /end CHARACTERISTIC
/begin CHARACTERISTIC c_maf_int_puc_max_ls_up_ready "Maximum MAF integral value during PUC used for reset of operability" VALUE 0xa1002130 _REC_VAL_20_u2 2912.666666666671 _CNV_A_R_LINEAR_____329_CM 0. 2912.66666666667 DISPLAY_IDENTIFIER C_MAF_INT_PUC_MAX_LS_UP_READY FORMAT "%7.2" /end CHARACTERISTIC
/begin AXIS_PTS ldp_tco_st_id_t_dly_chk_ls_up "" 0xa10019f0 tco_st _REC_AXS_20_u1 190.5 _CNV_A_R_LINEAR_____16_CM 8 -48. 142.5 FORMAT "%6.2" /end AXIS_PTS
/begin AXIS_PTS ldp_tco_st_id_t_tout_ls_up "" 0xa10019fa tco_st _REC_AXS_20_u1 190.5 _CNV_A_R_LINEAR_____16_CM 4 -48. 142.5 FORMAT "%6.2" /end AXIS_PTS
/begin CHARACTERISTIC id_t_dly_chk_ls_up_ready "Delay time for begin of readiness detection after engine start" CURVE 0xa1001b98 _REC_CUR_20_u2_u1 1310.7 _CNV_A_R_LINEAR_____107_CM 0. 1310.7 DISPLAY_IDENTIFIER ID_T_DLY_CHK_LS_UP_READY FORMAT "%7.2"
 /begin AXIS_DESCR COM_AXIS tco_st _CNV_A_R_LINEAR_____16_CM 8 -48. 142.5 FORMAT "%6.2" AXIS_PTS_REF ldp_tco_st_id_t_dly_chk_ls_up /end AXIS_DESCR
/end CHARACTERISTIC
/begin CHARACTERISTIC id_t_tout_ls_up_ready "Time-out constant for readiness detection -> forced readiness detection" CURVE 0xa1001ba8 _REC_CUR_20_u2_u1 1310.7 _CNV_A_R_LINEAR_____107_CM 0. 1310.7 DISPLAY_IDENTIFIER ID_T_TOUT_LS_UP_READY FORMAT "%7.2"
 /begin AXIS_DESCR COM_AXIS tco_st _CNV_A_R_LINEAR_____16_CM 4 -48. 142.5 FORMAT "%6.2" AXIS_PTS_REF ldp_tco_st_id_t_tout_ls_up /end AXIS_DESCR
/end CHARACTERISTIC
/begin CHARACTERISTIC c_t_dly_ls_up_ready_teg_min "Threshold of delay time after dew point detection prior to forced sensor activation" VALUE 0xa10021b0 _REC_VAL_20_u2 1310.7 _CNV_A_R_LINEAR_____107_CM 0. 1310.7 DISPLAY_IDENTIFIER C_T_DLY_LS_UP_READY_TEG_MIN FORMAT "%7.2" /end CHARACTERISTIC
/begin CHARACTERISTIC lc_teg_min_thd_deac_test "Test switch to check function behaviour at revocation of dew point" VALUE 0xa1002317 _REC_VAL_20_u1 1. _CNV_A_R_LINEAR_____0_CM 0. 1. DISPLAY_IDENTIFIER LC_TEG_MIN_THD_DEAC_TEST FORMAT "%1.0" /end CHARACTERISTIC
/begin CHARACTERISTIC lc_teg_min_deac "Test switch to disable dependance of readiness detection on dew point detection" VALUE 0xa1002316 _REC_VAL_20_u1 1. _CNV_A_R_LINEAR_____0_CM 0. 1. DISPLAY_IDENTIFIER LC_TEG_MIN_DEAC FORMAT "%1.0" /end CHARACTERISTIC
/begin MEASUREMENT egcp[0].egcp_struct_acctllshd0.t_pow_rise_lsh_down "Timer indicating the duration of  the pre-heating and post dew point heating phases " UWORD _CNV_A_R_LINEAR_____4_CM 1 100. 0. 6553.5 DISPLAY_IDENTIFIER T_POW_RISE_LSH_DOWN[1] ECU_ADDRESS 0xd0001924 FORMAT "%6.1" /end MEASUREMENT
/begin MEASUREMENT egcp[0].egcp_struct_acctllshd0.v_efc_clc_lsh_down "Effective calculated heater voltage value prior to overvoltage protection" UWORD _CNV_A_R_LINEAR_____142_CM 1 100. 0. 25.999603 DISPLAY_IDENTIFIER V_EFC_CLC_LSH_DOWN[1] ECU_ADDRESS 0xd0001926 FORMAT "%7.4" /end MEASUREMENT
/begin MEASUREMENT egcp[0].egcp_struct_acctllshd0.v_efc_lsh_down "Effective final output value of heater voltage" UBYTE _CNV_A_R_LINEAR_____289_CM 1 100. 0. 25.8984375 DISPLAY_IDENTIFIER V_EFC_LSH_DOWN[1] ECU_ADDRESS 0xd0001928 FORMAT "%9.6" /end MEASUREMENT
/begin MEASUREMENT egcp[0].egcp_struct_acctllshd0.lshpwm_down "Heater driver PWM duty cycle; acquired also by BSW" UBYTE _CNV_A_R_LINEAR_____5_CM 1 100. 0. 99.609375 DISPLAY_IDENTIFIER LSHPWM_DOWN[1] ECU_ADDRESS 0xd0001929 FORMAT "%9.6" /end MEASUREMENT
/begin MEASUREMENT egcp[0].egcp_struct_acctllshd0.t_v_efc_tol_lsh_down "Timer indicating permitted effective heater voltage overvoltage duration" UBYTE _CNV_A_R_LINEAR_____4_CM 1 100. 0. 25.5 DISPLAY_IDENTIFIER T_V_EFC_TOL_LSH_DOWN[1] ECU_ADDRESS 0xd000192a FORMAT "%4.1" /end MEASUREMENT
/begin MEASUREMENT egcp[0].egcp_struct_acctllshd0.lv_v_efc_lim_bol_lsh_down "Boolean flag indicating effective heater voltage limited due to sum of voltage components falling below zero." UBYTE _CNV_S_2_RANGE__0___1_CM 1 100. 0. 1. DISPLAY_IDENTIFIER LV_V_EFC_LIM_BOL_LSH_DOWN[1] ECU_ADDRESS 0xd000192b BIT_MASK 0x1 /end MEASUREMENT
/begin MEASUREMENT egcp[0].egcp_struct_acctllshd0.t_v_efc_lim_lsh_down "Timer indicating the duration of the effective heater voltage limitation preventing overvoltage" UBYTE _CNV_A_R_LINEAR_____4_CM 1 100. 0. 25.5 DISPLAY_IDENTIFIER T_V_EFC_LIM_LSH_DOWN[1] ECU_ADDRESS 0xd000192c FORMAT "%4.1" /end MEASUREMENT
/begin MEASUREMENT egcp[0].egcp_struct_acctllshd0.state_lsh_down "Present heater state" UBYTE _CNV_S_7_EGCP_RANGE_335_CM 1 100. 0. 6. DISPLAY_IDENTIFIER STATE_LSH_DOWN[1] ECU_ADDRESS 0xd000192d /end MEASUREMENT
/begin MEASUREMENT egcp[0].egcp_struct_acctllshd0.lv_v_efc_lim_tol_lsh_down "Boolean flag indicating effective heater voltage limited due to exceeding threshold for period of time." UBYTE _CNV_S_2_RANGE__0___1_CM 1 100. 0. 1. DISPLAY_IDENTIFIER LV_V_EFC_LIM_TOL_LSH_DOWN[1] ECU_ADDRESS 0xd000192e BIT_MASK 0x1 /end MEASUREMENT
/begin MEASUREMENT egcp[0].egcp_struct_acctllshd0.lv_v_efc_lim_max_lsh_down "Boolean flag indicating effective heater voltage limited due to exceeding absolute maximum voltage spec." UBYTE _CNV_S_2_RANGE__0___1_CM 1 100. 0. 1. DISPLAY_IDENTIFIER LV_V_EFC_LIM_MAX_LSH_DOWN[1] ECU_ADDRESS 0xd000192f BIT_MASK 0x1 /end MEASUREMENT
/begin MEASUREMENT egcp[0].egcp_struct_acctllshd0.lv_v_efc_lim_prot_vb_lsh_down "Boolean flag indicating effective heater voltage limited due to excessive battery voltage level" UBYTE _CNV_S_2_RANGE__0___1_CM 1 100. 0. 1. DISPLAY_IDENTIFIER LV_V_EFC_LIM_PROT_VB_LSH_DOWN[1] ECU_ADDRESS 0xd0001930 BIT_MASK 0x1 /end MEASUREMENT
/begin MEASUREMENT egcp[0].egcp_struct_adcprlsl1.vls_delta_tmp_lsl "Controller setpoint  free, gain and exhaust pressure corrected output signal" SLONG _CNV_A_R_EGCP_LINEA_336_CM 1 100. -327680. 327679.999847412 DISPLAY_IDENTIFIER VLS_DELTA_TMP_LSL[1] ECU_ADDRESS 0xd000193c FORMAT "%12.3" /end MEASUREMENT
/begin MEASUREMENT egcp[0].egcp_struct_adcprlsl1.vls_ofs_tmp_lsl "Intermediate storage variable for calculated offset value for Ip gain16" SWORD _CNV_A_R_EGCP_LINEA_337_CM 1 100. -5. 4.999847 DISPLAY_IDENTIFIER VLS_OFS_TMP_LSL[1] ECU_ADDRESS 0xd0001940 FORMAT "%7.4" /end MEASUREMENT
/begin MEASUREMENT egcp[0].egcp_struct_adcprlsl1.vls_ofs_tmp_old_lsl "Storage variable for calculated offset value for Ip gain16" SWORD _CNV_A_R_EGCP_LINEA_337_CM 1 100. -5. 4.999847 DISPLAY_IDENTIFIER VLS_OFS_TMP_OLD_LSL[1] ECU_ADDRESS 0xd0001942 FORMAT "%7.4" /end MEASUREMENT
/begin MEASUREMENT egcp[0].egcp_struct_adcprlsl1.vls_ofs_lsl_l_gain "Output signal offset of linear lambda sensor for Ip gain8" SWORD _CNV_A_R_EGCP_LINEA_337_CM 1 100. -5. 4.999847 DISPLAY_IDENTIFIER VLS_OFS_LSL_L_GAIN[1] ECU_ADDRESS 0xd0001944 FORMAT "%7.4" /end MEASUREMENT
/begin MEASUREMENT egcp[0].egcp_struct_adcprlsl1.vls_ofs_tmp_old_lsl_l_gain "Storage variable for calculated offset value for Ip gain8" SWORD _CNV_A_R_EGCP_LINEA_337_CM 1 100. -5. 4.999847 DISPLAY_IDENTIFIER VLS_OFS_TMP_OLD_LSL_L_GAIN[1] ECU_ADDRESS 0xd0001946 FORMAT "%7.4" /end MEASUREMENT
/begin MEASUREMENT egcp[0].egcp_struct_adcprlsl1.vls_ofs_lsl "Output signal offset of linear lambda sensor for Ip gain16" SWORD _CNV_A_R_EGCP_LINEA_337_CM 1 100. -5. 4.999847 DISPLAY_IDENTIFIER VLS_OFS_LSL[1] ECU_ADDRESS 0xd0001948 FORMAT "%7.4" /end MEASUREMENT
/begin MEASUREMENT egcp[0].egcp_struct_adcprlsl1.vls_up_diag "Offset and exhaust pressure compensated VLS_UP[i] which is used for sensor diagnoses" SWORD _CNV_A_R_LINEAR_____2_CM 1 100. -160. 159.9951171875 DISPLAY_IDENTIFIER VLS_UP_DIAG[1] ECU_ADDRESS 0xd000194a FORMAT "%8.3" /end MEASUREMENT
/begin MEASUREMENT egcp[0].egcp_struct_adcprlsl1.iplsl_cor "Compensated nominal pumping current ( after sensor / sensor dispersion compensation for new  / aged sensor)" SWORD _CNV_A_R_LINEAR_____328_CM 1 100. -12.596 12.595 DISPLAY_IDENTIFIER IPLSL_COR[1] ECU_ADDRESS 0xd000194c FORMAT "%8.4" /end MEASUREMENT
/begin MEASUREMENT egcp[0].egcp_struct_adcprlsl1.vls_mv_lsl_buf "Buffer for mean value calculation " UWORD _CNV_A_R_EGCP_LINEA_194_CM 1 100. 0. 319.995117 DISPLAY_IDENTIFIER VLS_MV_LSL_BUF[1] ECU_ADDRESS 0xd000194e FORMAT "%7.3" /end MEASUREMENT
/begin MEASUREMENT egcp[0].egcp_struct_adcprlsl1.t_wait_lsl_ofs_adj "Wait timer to define minimum interval between two subsequent offset adjustment cycles" UWORD _CNV_A_R_LINEAR_____3_CM 1 100. 0. 655.35 DISPLAY_IDENTIFIER T_WAIT_LSL_OFS_ADJ[1] ECU_ADDRESS 0xd0001950 FORMAT "%6.2" /end MEASUREMENT
/begin MEASUREMENT egcp[0].egcp_struct_adcprlsl1.t_dly_lamb_sti_off_ofs_adj "Wait timer to allow for lambda signal settling upon deactivation of forced stimulation" UWORD _CNV_A_R_LINEAR_____3_CM 1 100. 0. 655.35 DISPLAY_IDENTIFIER T_DLY_LAMB_STI_OFF_OFS_ADJ[1] ECU_ADDRESS 0xd0001952 FORMAT "%6.2" /end MEASUREMENT
/begin MEASUREMENT egcp[0].egcp_struct_adcprlsl1.vls_cor_h_res_lsl "Corrected output signal of  lambda sensor with extended resolution" UWORD _CNV_A_R_EGCP_LINEA_323_CM 1 100. 0. 4.999847 DISPLAY_IDENTIFIER VLS_COR_H_RES_LSL[1] ECU_ADDRESS 0xd0001954 FORMAT "%6.4" /end MEASUREMENT
/begin MEASUREMENT egcp[0].egcp_struct_adcprlsl1.vls_mv_lsl "Mean value of output signal of linear lambda sensor" UWORD _CNV_A_R_EGCP_LINEA_323_CM 1 100. 0. 4.999847 DISPLAY_IDENTIFIER VLS_MV_LSL[1] ECU_ADDRESS 0xd0001956 FORMAT "%6.4" /end MEASUREMENT
/begin MEASUREMENT egcp[0].egcp_struct_adcprlsl1.vls_mmv_lsl "Moving mean value of output signal of linear lambda sensor for Ip gain16" UWORD _CNV_A_R_EGCP_LINEA_323_CM 1 100. 0. 4.999847 DISPLAY_IDENTIFIER VLS_MMV_LSL[1] ECU_ADDRESS 0xd0001958 FORMAT "%6.4" /end MEASUREMENT
/begin MEASUREMENT egcp[0].egcp_struct_adcprlsl1.vls_mmv_lsl_l_gain "Moving mean value of output signal of linear lambda sensor for Ip gain8" UWORD _CNV_A_R_EGCP_LINEA_323_CM 1 100. 0. 4.999847 DISPLAY_IDENTIFIER VLS_MMV_LSL_L_GAIN[1] ECU_ADDRESS 0xd000195a FORMAT "%6.4" /end MEASUREMENT
/begin MEASUREMENT egcp[0].egcp_struct_adcprlsl1.vls_cor_mv_lsl "Corrected output signal of the lambda sensor" UWORD _CNV_A_R_EGCP_LINEA_323_CM 1 100. 0. 4.999847 DISPLAY_IDENTIFIER VLS_COR_MV_LSL[1] ECU_ADDRESS 0xd000195c FORMAT "%6.4" /end MEASUREMENT
/begin MEASUREMENT egcp[0].egcp_struct_adcprlsl1.vls_cor_tmp_lsl "Corrected output signal of the lambda sensor" UWORD _CNV_A_R_EGCP_LINEA_323_CM 1 100. 0. 4.999847 DISPLAY_IDENTIFIER VLS_COR_TMP_LSL[1] ECU_ADDRESS 0xd000195e FORMAT "%6.4" /end MEASUREMENT
/begin MEASUREMENT egcp[0].egcp_struct_adcprlsl1.lamb_ls_up "Lambda signal value of the WRAF sensor" UWORD _CNV_A_R_LINEAR_____122_CM 1 100. 0. 31.9990234375 DISPLAY_IDENTIFIER LAMB_LS_UP[1] ECU_ADDRESS 0xd0001960 FORMAT "%7.4" /end MEASUREMENT
/begin MEASUREMENT egcp[0].egcp_struct_adcprlsl1.vls_cor_lsl "Corrected output signal of  lambda sensor" UWORD _CNV_A_R_LINEAR_____2_CM 1 100. 0. 4.9951171875 DISPLAY_IDENTIFIER VLS_COR_LSL[1] ECU_ADDRESS 0xd0001962 FORMAT "%5.3" /end MEASUREMENT
/begin MEASUREMENT egcp[0].egcp_struct_adcprlsl1.vls_cor_lsl_h_gain "Ip gain16 equivalent  of corrected output signal of  lambda sensor" UWORD _CNV_A_R_LINEAR_____2_CM 1 100. 0. 4.9951171875 DISPLAY_IDENTIFIER VLS_COR_LSL_H_GAIN[1] ECU_ADDRESS 0xd0001964 FORMAT "%5.3" /end MEASUREMENT
/begin MEASUREMENT egcp[0].egcp_struct_adcprlsl1.t_dly_lsl_ofs_adj_puc_end "Wait timer to delay activation of offset adjustment after leaving fuel cut-off phase" UWORD _CNV_A_R_LINEAR_____3_CM 1 100. 0. 655.35 DISPLAY_IDENTIFIER T_DLY_LSL_OFS_ADJ_PUC_END[1] ECU_ADDRESS 0xd0001966 FORMAT "%6.2" /end MEASUREMENT
/begin MEASUREMENT egcp[0].egcp_struct_adcprlsl1.ctr_vls_mv_lsl_nr_sample "Sample counter for mean value calculation " UBYTE _CNV_A_R_LINEAR_____0_CM 1 100. 0. 255. DISPLAY_IDENTIFIER CTR_VLS_MV_LSL_NR_SAMPLE[1] ECU_ADDRESS 0xd0001968 FORMAT "%3.0" /end MEASUREMENT
/begin MEASUREMENT egcp[0].egcp_struct_adcprlsl1.ctr_cyc_t_wait_ofs_adj_red "Counter of cycles for application of reduced repetition rate for offset adjustment during engine warm-up" UBYTE _CNV_A_R_LINEAR_____0_CM 1 100. 0. 255. DISPLAY_IDENTIFIER CTR_CYC_T_WAIT_OFS_ADJ_RED[1] ECU_ADDRESS 0xd0001969 FORMAT "%3.0" /end MEASUREMENT
/begin MEASUREMENT egcp[0].egcp_struct_adcprlsl1.ctr_err_lsl_if_spi_ofs_adj_save "Storage variable for SPI communication error counter value of WRAF controller " UBYTE _CNV_A_R_LINEAR_____0_CM 1 100. 0. 255. DISPLAY_IDENTIFIER CTR_ERR_LSL_IF_SPI_OFS_ADJ_SAVE[1] ECU_ADDRESS 0xd000196a FORMAT "%3.0" /end MEASUREMENT
/begin MEASUREMENT egcp[0].egcp_struct_adcprlsl1.state_lsl_ofs_adj "State of  WRAF controller lambda output  voltage offset adjustment" UBYTE _CNV_S_5_EGCP_RANGE_338_CM 1 100. 0. 4. DISPLAY_IDENTIFIER STATE_LSL_OFS_ADJ[1] ECU_ADDRESS 0xd000196b /end MEASUREMENT
/begin MEASUREMENT egcp[0].egcp_struct_adcprlsl1.t_dly_lsl_ofs_adj "Wait timer to delay acquisition of measurement  values upon activation of adjustment" UBYTE _CNV_A_R_LINEAR_____3_CM 1 100. 0. 2.55 DISPLAY_IDENTIFIER T_DLY_LSL_OFS_ADJ[1] ECU_ADDRESS 0xd000196c FORMAT "%4.2" /end MEASUREMENT
/begin MEASUREMENT egcp[0].egcp_struct_adcprlsl1.t_dly_lsl_ofs_adj_is "Wait timer to delay activation of offset adjustment upon entering engine state idle speed" UBYTE _CNV_A_R_LINEAR_____3_CM 1 100. 0. 2.55 DISPLAY_IDENTIFIER T_DLY_LSL_OFS_ADJ_IS[1] ECU_ADDRESS 0xd000196d FORMAT "%4.2" /end MEASUREMENT
/begin MEASUREMENT egcp[0].egcp_struct_adcprlsl1.lv_lsl_ofs_adj_act "State of the offset measurement (active / not active)" UBYTE _CNV_S_2_RANGE__0___1_CM 1 100. 0. 1. DISPLAY_IDENTIFIER LV_LSL_OFS_ADJ_ACT[1] ECU_ADDRESS 0xd000196e BIT_MASK 0x1 /end MEASUREMENT
/begin MEASUREMENT egcp[0].egcp_struct_adcprlsl1.lv_lsl_ofs_act_ast "Switch to chose activation conditions directly after engine start" UBYTE _CNV_S_2_RANGE__0___1_CM 1 100. 0. 1. DISPLAY_IDENTIFIER LV_LSL_OFS_ACT_AST[1] ECU_ADDRESS 0xd000196f BIT_MASK 0x1 /end MEASUREMENT
/begin MEASUREMENT egcp[0].egcp_struct_adcprlsl1.lv_lamb_sti_off_lsl_ofs_adj "Request for disabling of forced lambda stimulation" UBYTE _CNV_S_2_RANGE__0___1_CM 1 100. 0. 1. DISPLAY_IDENTIFIER LV_LAMB_STI_OFF_LSL_OFS_ADJ[1] ECU_ADDRESS 0xd0001970 BIT_MASK 0x1 /end MEASUREMENT
/begin MEASUREMENT egcp[0].egcp_struct_adcprlsl1.lv_lsl_ofs_adj_is "Offset measurement carried out during current idle phase" UBYTE _CNV_S_2_RANGE__0___1_CM 1 100. 0. 1. DISPLAY_IDENTIFIER LV_LSL_OFS_ADJ_IS[1] ECU_ADDRESS 0xd0001971 BIT_MASK 0x1 /end MEASUREMENT
/begin MEASUREMENT egcp[0].egcp_struct_adcprlsl1.lv_vls_ofs_lim_lsl "Boolean flag indicating limitation of  output voltage offset adjustment value for Ip gain16" UBYTE _CNV_S_2_RANGE__0___1_CM 1 100. 0. 1. DISPLAY_IDENTIFIER LV_VLS_OFS_LIM_LSL[1] ECU_ADDRESS 0xd0001972 BIT_MASK 0x1 /end MEASUREMENT
/begin MEASUREMENT egcp[0].egcp_struct_adcprlsl1.lv_vls_ofs_adj_ena_lsl_if "Boolean flag requesting enabling offset adjustment  mode of WRAF sensor interface for lambda signal output voltage " UBYTE _CNV_S_2_RANGE__0___1_CM 1 100. 0. 1. DISPLAY_IDENTIFIER LV_VLS_OFS_ADJ_ENA_LSL_IF[1] ECU_ADDRESS 0xd0001973 BIT_MASK 0x1 /end MEASUREMENT
/begin MEASUREMENT egcp[0].egcp_struct_adcprlsl1.lv_lamb_pls_swi_off "Indicator for need to switch off forced lambda stimulation" UBYTE _CNV_S_2_RANGE__0___1_CM 1 100. 0. 1. DISPLAY_IDENTIFIER LV_LAMB_PLS_SWI_OFF[1] ECU_ADDRESS 0xd0001974 BIT_MASK 0x1 /end MEASUREMENT
/begin MEASUREMENT egcp[0].egcp_struct_adcprlsl1.lv_swi_clc_lsl_ofs_adj "Logical variable for switching of lambda calculation routines" UBYTE _CNV_S_2_RANGE__0___1_CM 1 100. 0. 1. DISPLAY_IDENTIFIER LV_SWI_CLC_LSL_OFS_ADJ[1] ECU_ADDRESS 0xd0001975 BIT_MASK 0x1 /end MEASUREMENT
/begin MEASUREMENT egcp[0].egcp_struct_adcprlsl1.lv_vls_ofs_lim_lsl_l_gain "Boolean flag indicating limitation of  output voltage offset adjustment value for Ip gain8" UBYTE _CNV_S_2_RANGE__0___1_CM 1 100. 0. 1. DISPLAY_IDENTIFIER LV_VLS_OFS_LIM_LSL_L_GAIN[1] ECU_ADDRESS 0xd0001976 BIT_MASK 0x1 /end MEASUREMENT
/begin MEASUREMENT egcp[0].egcp_struct_adcprlsl1.lv_swi_gain_lsl_if "Boolean flag configuring the WRAF sensor interface gain-selection for Ip measurement ( '0' = g8, '1' = g16 )" UBYTE _CNV_S_2_RANGE__0___1_CM 1 100. 0. 1. DISPLAY_IDENTIFIER LV_SWI_GAIN_LSL_IF[1] ECU_ADDRESS 0xd0001977 BIT_MASK 0x1 /end MEASUREMENT
/begin MEASUREMENT egcp[0].egcp_struct_dtsyslsd0.t_temp_dew_ls_down "Time after dew point detection for downstream lambda probe" UWORD _CNV_A_R_LINEAR_____4_CM 1 100. 0. 6553.5 DISPLAY_IDENTIFIER T_TEMP_DEW_LS_DOWN[1] ECU_ADDRESS 0xd000199e FORMAT "%6.1" /end MEASUREMENT
/begin MEASUREMENT egcp[0].egcp_struct_dtsyslsd0.lv_ls_down_ready "Logical variable for operative readiness of downstream oxygen sensor(s)" UBYTE _CNV_S_2_RANGE__0___1_CM 1 100. 0. 1. DISPLAY_IDENTIFIER LV_LS_DOWN_READY[1] ECU_ADDRESS 0xd00019a0 BIT_MASK 0x1 /end MEASUREMENT
/begin MEASUREMENT egcp[0].egcp_struct_dtsyslsl0.lamb_de_int_ls_up_ready "Value as a measure of the sensor signal variation vs. time" UWORD _CNV_A_R_EGCP_LINEA_330_CM 1 100. 0. 63.999023 DISPLAY_IDENTIFIER LAMB_DE_INT_LS_UP_READY[1] ECU_ADDRESS 0xd00019a4 FORMAT "%7.4" /end MEASUREMENT
/begin MEASUREMENT egcp[0].egcp_struct_dtsyslsl0.t_tout_ls_up_ready "Timer for forced activation of linear lambda sensor" UWORD _CNV_A_R_LINEAR_____107_CM 1 100. 0. 1310.7 DISPLAY_IDENTIFIER T_TOUT_LS_UP_READY[1] ECU_ADDRESS 0xd00019a6 FORMAT "%7.2" /end MEASUREMENT
/begin MEASUREMENT egcp[0].egcp_struct_dtsyslsl0.t_dly_chk_ls_up_ready "Delay timer for start of readiness detection after engine start" UWORD _CNV_A_R_LINEAR_____107_CM 1 100. 0. 1310.7 DISPLAY_IDENTIFIER T_DLY_CHK_LS_UP_READY[1] ECU_ADDRESS 0xd00019a8 FORMAT "%7.2" /end MEASUREMENT
/begin MEASUREMENT egcp[0].egcp_struct_dtsyslsl0.t_lamb_de_int_rst "Timer for duration of summation of sensor signal dispersion up to reset thereof" UWORD _CNV_A_R_LINEAR_____107_CM 1 100. 0. 1310.7 DISPLAY_IDENTIFIER T_LAMB_DE_INT_RST[1] ECU_ADDRESS 0xd00019aa FORMAT "%7.2" /end MEASUREMENT
/begin MEASUREMENT egcp[0].egcp_struct_dtsyslsl0.lamb_mv_ls_up_ready "Mean value of the converted upstream oxygen sensor signal in terms of A/F-ratio" UWORD _CNV_A_R_LINEAR_____122_CM 1 100. 0. 31.9990234375 DISPLAY_IDENTIFIER LAMB_MV_LS_UP_READY[1] ECU_ADDRESS 0xd00019ac FORMAT "%7.4" /end MEASUREMENT
/begin MEASUREMENT egcp[0].egcp_struct_dtsyslsl0.t_dly_ls_up_ready_teg_min "Delay time after dew point detection prior to forced sensor activation" UWORD _CNV_A_R_LINEAR_____107_CM 1 100. 0. 1310.7 DISPLAY_IDENTIFIER T_DLY_LS_UP_READY_TEG_MIN[1] ECU_ADDRESS 0xd00019ae FORMAT "%7.2" /end MEASUREMENT
/begin MEASUREMENT egcp[0].egcp_struct_dtsyslsl0.lv_ls_up_ready "Logical variable for operative readiness of upstream oxygen sensor" UBYTE _CNV_S_2_RANGE__0___1_CM 1 100. 0. 1. DISPLAY_IDENTIFIER LV_LS_UP_READY[1] ECU_ADDRESS 0xd00019b0 BIT_MASK 0x1 /end MEASUREMENT
/begin MEASUREMENT egcp[0].egcp_struct_dtsyslsl0.lv_ls_up_ready_cdn "Logical variable for forced operative readiness of upstream oxygen sensor" UBYTE _CNV_S_2_RANGE__0___1_CM 1 100. 0. 1. DISPLAY_IDENTIFIER LV_LS_UP_READY_CDN[1] ECU_ADDRESS 0xd00019b1 BIT_MASK 0x1 /end MEASUREMENT
/begin MEASUREMENT egcp[0].egcp_struct_dtsyslsl0.lv_ls_up_ready_raw "Logical variable for raw operative readiness of upstream oxygen sensor" UBYTE _CNV_S_2_RANGE__0___1_CM 1 100. 0. 1. DISPLAY_IDENTIFIER LV_LS_UP_READY_RAW[1] ECU_ADDRESS 0xd00019b2 BIT_MASK 0x1 /end MEASUREMENT
/begin MEASUREMENT egcp[0].egcp_struct_dtsyslsl0.lv_teg_min_dly "Logical variable indicating sufficient delay after dew point detection prior to forced sensor activation" UBYTE _CNV_S_2_RANGE__0___1_CM 1 100. 0. 1. DISPLAY_IDENTIFIER LV_TEG_MIN_DLY[1] ECU_ADDRESS 0xd00019b3 BIT_MASK 0x1 /end MEASUREMENT
/begin MEASUREMENT egcp[0].egcp_struct_sigcvlsd0.vls_down_drv1_mmv "Mean of buffer containing 1st derivative of VLS_DOWN[i] signal" SWORD _CNV_A_R_EGCP_LINEA_344_CM 1 100. -2.5 2.499924 DISPLAY_IDENTIFIER VLS_DOWN_DRV1_MMV[1] ECU_ADDRESS 0xd00019f4 FORMAT "%8.5" /end MEASUREMENT
/begin MEASUREMENT egcp[0].egcp_struct_sigcvlsd0.vls_down_drv1_mmv_min "Minimum value of mean of buffer containing 1st derivative of VLS_DOWN[i] signal in lean phase" SWORD _CNV_A_R_EGCP_LINEA_344_CM 1 100. -2.5 2.499924 DISPLAY_IDENTIFIER VLS_DOWN_DRV1_MMV_MIN[1] ECU_ADDRESS 0xd00019f6 FORMAT "%8.5" /end MEASUREMENT
/begin MEASUREMENT egcp[0].egcp_struct_sigcvlsd0.vls_down_drv1_abs_max "Absolute maximum value within buffer containing 1st derivative of VLS_DOWN[i] signal" UWORD _CNV_A_R_EGCP_LINEA_345_CM 1 100. 0. 4.99992370605469 DISPLAY_IDENTIFIER VLS_DOWN_DRV1_ABS_MAX[1] ECU_ADDRESS 0xd00019f8 FORMAT "%7.5" /end MEASUREMENT
/begin MEASUREMENT egcp[0].egcp_struct_sigcvlsd0.vls_down_mmv_min "Mean oxygen sensor lean voltage" UWORD _CNV_A_R_EGCP_LINEA_346_CM 1 100. 0. 4.99992370605469 DISPLAY_IDENTIFIER VLS_DOWN_MMV_MIN[1] ECU_ADDRESS 0xd00019fa FORMAT "%7.5" /end MEASUREMENT
/begin MEASUREMENT egcp[0].egcp_struct_sigcvlsd0.vls_down_mmv_max "Mean oxygen sensor rich voltage" UWORD _CNV_A_R_EGCP_LINEA_346_CM 1 100. 0. 4.99992370605469 DISPLAY_IDENTIFIER VLS_DOWN_MMV_MAX[1] ECU_ADDRESS 0xd00019fc FORMAT "%7.5" /end MEASUREMENT
/begin MEASUREMENT egcp[0].egcp_struct_sigcvlsd0.vls_down_bol "Variable switching threshold for calculation of VLS_DOWN_MMV_MIN[i]" UWORD _CNV_A_R_LINEAR_____2_CM 1 100. 0. 4.9951171875 DISPLAY_IDENTIFIER VLS_DOWN_BOL[1] ECU_ADDRESS 0xd00019fe FORMAT "%5.3" /end MEASUREMENT
/begin MEASUREMENT egcp[0].egcp_struct_sigcvlsd0.vls_down_tol "Variable switching threshold for calculation of VLS_DOWN_MMV_MAX[i]" UWORD _CNV_A_R_LINEAR_____2_CM 1 100. 0. 4.9951171875 DISPLAY_IDENTIFIER VLS_DOWN_TOL[1] ECU_ADDRESS 0xd0001a00 FORMAT "%5.3" /end MEASUREMENT
/begin MEASUREMENT egcp[0].egcp_struct_sigcvlsd0.vls_down_mmv_hys "Variable hysteresis used to determine switching thresholds" UWORD _CNV_A_R_EGCP_LINEA_347_CM 1 100. 0. 0.999924 DISPLAY_IDENTIFIER VLS_DOWN_MMV_HYS[1] ECU_ADDRESS 0xd0001a02 FORMAT "%7.5" /end MEASUREMENT
/begin MEASUREMENT egcp[0].egcp_struct_sigcvlsd0.lv_vls_down_mmv_lim "Boolean flag indicating VLS_DOWN_MMV_xxx[i] signals being limited when set" UBYTE _CNV_S_2_RANGE__0___1_CM 1 100. 0. 1. DISPLAY_IDENTIFIER LV_VLS_DOWN_MMV_LIM[1] ECU_ADDRESS 0xd0001a04 BIT_MASK 0x1 /end MEASUREMENT
/begin MEASUREMENT egcp[0].egcp_struct_acctllsh0.v_efc_ctl_p_lsh_up "additive effective heater voltage from closed loop controller, P term" SWORD _CNV_A_R_EGCP_LINEA_368_CM 1 100. -13. 12.999603 DISPLAY_IDENTIFIER V_EFC_CTL_P_LSH_UP[1] ECU_ADDRESS 0xd0001ba8 FORMAT "%10.4" /end MEASUREMENT
/begin MEASUREMENT egcp[0].egcp_struct_acctllsh0.v_efc_ctl_i_lsh_up "additive effective heater voltage from closed loop controller, I term" SWORD _CNV_A_R_EGCP_LINEA_368_CM 1 100. -13. 12.999603 DISPLAY_IDENTIFIER V_EFC_CTL_I_LSH_UP[1] ECU_ADDRESS 0xd0001baa FORMAT "%10.4" /end MEASUREMENT
/begin MEASUREMENT egcp[0].egcp_struct_acctllsh0.ttip_mes_dif_ls_up "Difference between actual and set oxygen sensor tip temperature" SWORD _CNV_A_R_LINEAR_____123_CM 1 100. -2048. 2047.9375 DISPLAY_IDENTIFIER TTIP_MES_DIF_LS_UP[1] ECU_ADDRESS 0xd0001bac FORMAT "%10.4" /end MEASUREMENT
/begin MEASUREMENT egcp[0].egcp_struct_acctllsh0.t_pow_rise_lsh_up "Timer indicating the duration of  the pre-heating and post dew point heating phases " UWORD _CNV_A_R_LINEAR_____4_CM 1 100. 0. 6553.5 DISPLAY_IDENTIFIER T_POW_RISE_LSH_UP[1] ECU_ADDRESS 0xd0001bae FORMAT "%6.1" /end MEASUREMENT
/begin MEASUREMENT egcp[0].egcp_struct_acctllsh0.v_efc_clc_lsh_up "Effective calculated heater voltage value prior to overvoltage protection" UWORD _CNV_A_R_LINEAR_____142_CM 1 100. 0. 25.999603 DISPLAY_IDENTIFIER V_EFC_CLC_LSH_UP[1] ECU_ADDRESS 0xd0001bb0 FORMAT "%7.4" /end MEASUREMENT
/begin MEASUREMENT egcp[0].egcp_struct_acctllsh0.v_efc_ctl_add_lsh_up "additive effective heater voltage from closed loop controller" SBYTE _CNV_A_R_EGCP_LINEA_322_CM 1 100. -13. 12.898438 DISPLAY_IDENTIFIER V_EFC_CTL_ADD_LSH_UP[1] ECU_ADDRESS 0xd0001bb2 FORMAT "%5.1" /end MEASUREMENT
/begin MEASUREMENT egcp[0].egcp_struct_acctllsh0.lshpwm_up "Heater driver PWM duty cycle; acquired also by BSW" UBYTE _CNV_A_R_LINEAR_____5_CM 1 100. 0. 99.609375 DISPLAY_IDENTIFIER LSHPWM_UP[1] ECU_ADDRESS 0xd0001bb3 FORMAT "%9.6" /end MEASUREMENT
/begin MEASUREMENT egcp[0].egcp_struct_acctllsh0.v_efc_lsh_up "Effective final output value of heater voltage" UBYTE _CNV_A_R_LINEAR_____289_CM 1 100. 0. 25.8984375 DISPLAY_IDENTIFIER V_EFC_LSH_UP[1] ECU_ADDRESS 0xd0001bb4 FORMAT "%9.6" /end MEASUREMENT
/begin MEASUREMENT egcp[0].egcp_struct_acctllsh0.t_v_efc_tol_lsh_up "Timer indicating permitted effective heater voltage overvoltage duration" UBYTE _CNV_A_R_LINEAR_____4_CM 1 100. 0. 25.5 DISPLAY_IDENTIFIER T_V_EFC_TOL_LSH_UP[1] ECU_ADDRESS 0xd0001bb5 FORMAT "%4.1" /end MEASUREMENT
/begin MEASUREMENT egcp[0].egcp_struct_acctllsh0.t_v_efc_lim_lsh_up "Timer indicating the duration of the effective heater voltage limitation preventing overvoltage" UBYTE _CNV_A_R_LINEAR_____4_CM 1 100. 0. 25.5 DISPLAY_IDENTIFIER T_V_EFC_LIM_LSH_UP[1] ECU_ADDRESS 0xd0001bb6 FORMAT "%4.1" /end MEASUREMENT
/begin MEASUREMENT egcp[0].egcp_struct_acctllsh0.state_lsh_up "Present heater state" UBYTE _CNV_S_7_EGCP_RANGE_335_CM 1 100. 0. 6. DISPLAY_IDENTIFIER STATE_LSH_UP[1] ECU_ADDRESS 0xd0001bb7 /end MEASUREMENT
/begin MEASUREMENT egcp[0].egcp_struct_acctllsh0.lv_lsh_ctl_cll_lsh_up "Boolean variable indicating closed loop control mode active" UBYTE _CNV_S_2_RANGE__0___1_CM 1 100. 0. 1. DISPLAY_IDENTIFIER LV_LSH_CTL_CLL_LSH_UP[1] ECU_ADDRESS 0xd0001bb8 BIT_MASK 0x1 /end MEASUREMENT
/begin MEASUREMENT egcp[0].egcp_struct_acctllsh0.lv_v_efc_lim_bol_lsh_up "Boolean flag indicating effective heater voltage limited due to sum of voltage components falling below zero." UBYTE _CNV_S_2_RANGE__0___1_CM 1 100. 0. 1. DISPLAY_IDENTIFIER LV_V_EFC_LIM_BOL_LSH_UP[1] ECU_ADDRESS 0xd0001bb9 BIT_MASK 0x1 /end MEASUREMENT
/begin MEASUREMENT egcp[0].egcp_struct_acctllsh0.lv_v_efc_lim_tol_lsh_up "Boolean flag indicating effective heater voltage limited due to exceeding threshold for period of time." UBYTE _CNV_S_2_RANGE__0___1_CM 1 100. 0. 1. DISPLAY_IDENTIFIER LV_V_EFC_LIM_TOL_LSH_UP[1] ECU_ADDRESS 0xd0001bba BIT_MASK 0x1 /end MEASUREMENT
/begin MEASUREMENT egcp[0].egcp_struct_acctllsh0.lv_v_efc_lim_max_lsh_up "Boolean flag indicating effective heater voltage limited due to exceeding absolute maximum voltage spec." UBYTE _CNV_S_2_RANGE__0___1_CM 1 100. 0. 1. DISPLAY_IDENTIFIER LV_V_EFC_LIM_MAX_LSH_UP[1] ECU_ADDRESS 0xd0001bbb BIT_MASK 0x1 /end MEASUREMENT
/begin MEASUREMENT egcp[0].egcp_struct_acctllsh0.lv_v_efc_lim_prot_vb_lsh_up "Boolean flag indicating effective heater voltage limited due to excessive battery voltage level" UBYTE _CNV_S_2_RANGE__0___1_CM 1 100. 0. 1. DISPLAY_IDENTIFIER LV_V_EFC_LIM_PROT_VB_LSH_UP[1] ECU_ADDRESS 0xd0001bbc BIT_MASK 0x1 /end MEASUREMENT
/begin MEASUREMENT egcp[0].egcp_struct_acctllsh0.lv_lsh_up_man_act "Boolean variable indicating that forced lambda probe heating before engine start is active" UBYTE _CNV_S_2_RANGE__0___1_CM 1 100. 0. 1. DISPLAY_IDENTIFIER LV_LSH_UP_MAN_ACT[1] ECU_ADDRESS 0xd0001bbd BIT_MASK 0x1 /end MEASUREMENT
/begin MEASUREMENT egcp[1].egcp_struct_acctllshd0.t_pow_rise_lsh_down "Timer indicating the duration of  the pre-heating and post dew point heating phases " UWORD _CNV_A_R_LINEAR_____4_CM 1 100. 0. 6553.5 DISPLAY_IDENTIFIER T_POW_RISE_LSH_DOWN[2] ECU_ADDRESS 0xd0001c14 FORMAT "%6.1" /end MEASUREMENT
/begin MEASUREMENT egcp[1].egcp_struct_acctllshd0.v_efc_clc_lsh_down "Effective calculated heater voltage value prior to overvoltage protection" UWORD _CNV_A_R_LINEAR_____142_CM 1 100. 0. 25.999603 DISPLAY_IDENTIFIER V_EFC_CLC_LSH_DOWN[2] ECU_ADDRESS 0xd0001c16 FORMAT "%7.4" /end MEASUREMENT
/begin MEASUREMENT egcp[1].egcp_struct_acctllshd0.v_efc_lsh_down "Effective final output value of heater voltage" UBYTE _CNV_A_R_LINEAR_____289_CM 1 100. 0. 25.8984375 DISPLAY_IDENTIFIER V_EFC_LSH_DOWN[2] ECU_ADDRESS 0xd0001c18 FORMAT "%9.6" /end MEASUREMENT
/begin MEASUREMENT egcp[1].egcp_struct_acctllshd0.lshpwm_down "Heater driver PWM duty cycle; acquired also by BSW" UBYTE _CNV_A_R_LINEAR_____5_CM 1 100. 0. 99.609375 DISPLAY_IDENTIFIER LSHPWM_DOWN[2] ECU_ADDRESS 0xd0001c19 FORMAT "%9.6" /end MEASUREMENT
/begin MEASUREMENT egcp[1].egcp_struct_acctllshd0.t_v_efc_tol_lsh_down "Timer indicating permitted effective heater voltage overvoltage duration" UBYTE _CNV_A_R_LINEAR_____4_CM 1 100. 0. 25.5 DISPLAY_IDENTIFIER T_V_EFC_TOL_LSH_DOWN[2] ECU_ADDRESS 0xd0001c1a FORMAT "%4.1" /end MEASUREMENT
/begin MEASUREMENT egcp[1].egcp_struct_acctllshd0.lv_v_efc_lim_bol_lsh_down "Boolean flag indicating effective heater voltage limited due to sum of voltage components falling below zero." UBYTE _CNV_S_2_RANGE__0___1_CM 1 100. 0. 1. DISPLAY_IDENTIFIER LV_V_EFC_LIM_BOL_LSH_DOWN[2] ECU_ADDRESS 0xd0001c1b BIT_MASK 0x1 /end MEASUREMENT
/begin MEASUREMENT egcp[1].egcp_struct_acctllshd0.t_v_efc_lim_lsh_down "Timer indicating the duration of the effective heater voltage limitation preventing overvoltage" UBYTE _CNV_A_R_LINEAR_____4_CM 1 100. 0. 25.5 DISPLAY_IDENTIFIER T_V_EFC_LIM_LSH_DOWN[2] ECU_ADDRESS 0xd0001c1c FORMAT "%4.1" /end MEASUREMENT
/begin MEASUREMENT egcp[1].egcp_struct_acctllshd0.state_lsh_down "Present heater state" UBYTE _CNV_S_7_EGCP_RANGE_335_CM 1 100. 0. 6. DISPLAY_IDENTIFIER STATE_LSH_DOWN[2] ECU_ADDRESS 0xd0001c1d /end MEASUREMENT
/begin MEASUREMENT egcp[1].egcp_struct_acctllshd0.lv_v_efc_lim_tol_lsh_down "Boolean flag indicating effective heater voltage limited due to exceeding threshold for period of time." UBYTE _CNV_S_2_RANGE__0___1_CM 1 100. 0. 1. DISPLAY_IDENTIFIER LV_V_EFC_LIM_TOL_LSH_DOWN[2] ECU_ADDRESS 0xd0001c1e BIT_MASK 0x1 /end MEASUREMENT
/begin MEASUREMENT egcp[1].egcp_struct_acctllshd0.lv_v_efc_lim_max_lsh_down "Boolean flag indicating effective heater voltage limited due to exceeding absolute maximum voltage spec." UBYTE _CNV_S_2_RANGE__0___1_CM 1 100. 0. 1. DISPLAY_IDENTIFIER LV_V_EFC_LIM_MAX_LSH_DOWN[2] ECU_ADDRESS 0xd0001c1f BIT_MASK 0x1 /end MEASUREMENT
/begin MEASUREMENT egcp[1].egcp_struct_acctllshd0.lv_v_efc_lim_prot_vb_lsh_down "Boolean flag indicating effective heater voltage limited due to excessive battery voltage level" UBYTE _CNV_S_2_RANGE__0___1_CM 1 100. 0. 1. DISPLAY_IDENTIFIER LV_V_EFC_LIM_PROT_VB_LSH_DOWN[2] ECU_ADDRESS 0xd0001c20 BIT_MASK 0x1 /end MEASUREMENT
/begin MEASUREMENT egcp[1].egcp_struct_adcprlsl1.vls_delta_tmp_lsl "Controller setpoint  free, gain and exhaust pressure corrected output signal" SLONG _CNV_A_R_EGCP_LINEA_336_CM 1 100. -327680. 327679.999847412 DISPLAY_IDENTIFIER VLS_DELTA_TMP_LSL[2] ECU_ADDRESS 0xd0001c2c FORMAT "%12.3" /end MEASUREMENT
/begin MEASUREMENT egcp[1].egcp_struct_adcprlsl1.vls_ofs_tmp_lsl "Intermediate storage variable for calculated offset value for Ip gain16" SWORD _CNV_A_R_EGCP_LINEA_337_CM 1 100. -5. 4.999847 DISPLAY_IDENTIFIER VLS_OFS_TMP_LSL[2] ECU_ADDRESS 0xd0001c30 FORMAT "%7.4" /end MEASUREMENT
/begin MEASUREMENT egcp[1].egcp_struct_adcprlsl1.vls_ofs_tmp_old_lsl "Storage variable for calculated offset value for Ip gain16" SWORD _CNV_A_R_EGCP_LINEA_337_CM 1 100. -5. 4.999847 DISPLAY_IDENTIFIER VLS_OFS_TMP_OLD_LSL[2] ECU_ADDRESS 0xd0001c32 FORMAT "%7.4" /end MEASUREMENT
/begin MEASUREMENT egcp[1].egcp_struct_adcprlsl1.vls_ofs_lsl_l_gain "Output signal offset of linear lambda sensor for Ip gain8" SWORD _CNV_A_R_EGCP_LINEA_337_CM 1 100. -5. 4.999847 DISPLAY_IDENTIFIER VLS_OFS_LSL_L_GAIN[2] ECU_ADDRESS 0xd0001c34 FORMAT "%7.4" /end MEASUREMENT
/begin MEASUREMENT egcp[1].egcp_struct_adcprlsl1.vls_ofs_tmp_old_lsl_l_gain "Storage variable for calculated offset value for Ip gain8" SWORD _CNV_A_R_EGCP_LINEA_337_CM 1 100. -5. 4.999847 DISPLAY_IDENTIFIER VLS_OFS_TMP_OLD_LSL_L_GAIN[2] ECU_ADDRESS 0xd0001c36 FORMAT "%7.4" /end MEASUREMENT
/begin MEASUREMENT egcp[1].egcp_struct_adcprlsl1.vls_ofs_lsl "Output signal offset of linear lambda sensor for Ip gain16" SWORD _CNV_A_R_EGCP_LINEA_337_CM 1 100. -5. 4.999847 DISPLAY_IDENTIFIER VLS_OFS_LSL[2] ECU_ADDRESS 0xd0001c38 FORMAT "%7.4" /end MEASUREMENT
/begin MEASUREMENT egcp[1].egcp_struct_adcprlsl1.vls_up_diag "Offset and exhaust pressure compensated VLS_UP[i] which is used for sensor diagnoses" SWORD _CNV_A_R_LINEAR_____2_CM 1 100. -160. 159.9951171875 DISPLAY_IDENTIFIER VLS_UP_DIAG[2] ECU_ADDRESS 0xd0001c3a FORMAT "%8.3" /end MEASUREMENT
/begin MEASUREMENT egcp[1].egcp_struct_adcprlsl1.iplsl_cor "Compensated nominal pumping current ( after sensor / sensor dispersion compensation for new  / aged sensor)" SWORD _CNV_A_R_LINEAR_____328_CM 1 100. -12.596 12.595 DISPLAY_IDENTIFIER IPLSL_COR[2] ECU_ADDRESS 0xd0001c3c FORMAT "%8.4" /end MEASUREMENT
/begin MEASUREMENT egcp[1].egcp_struct_adcprlsl1.vls_mv_lsl_buf "Buffer for mean value calculation " UWORD _CNV_A_R_EGCP_LINEA_194_CM 1 100. 0. 319.995117 DISPLAY_IDENTIFIER VLS_MV_LSL_BUF[2] ECU_ADDRESS 0xd0001c3e FORMAT "%7.3" /end MEASUREMENT
/begin MEASUREMENT egcp[1].egcp_struct_adcprlsl1.t_wait_lsl_ofs_adj "Wait timer to define minimum interval between two subsequent offset adjustment cycles" UWORD _CNV_A_R_LINEAR_____3_CM 1 100. 0. 655.35 DISPLAY_IDENTIFIER T_WAIT_LSL_OFS_ADJ[2] ECU_ADDRESS 0xd0001c40 FORMAT "%6.2" /end MEASUREMENT
/begin MEASUREMENT egcp[1].egcp_struct_adcprlsl1.t_dly_lamb_sti_off_ofs_adj "Wait timer to allow for lambda signal settling upon deactivation of forced stimulation" UWORD _CNV_A_R_LINEAR_____3_CM 1 100. 0. 655.35 DISPLAY_IDENTIFIER T_DLY_LAMB_STI_OFF_OFS_ADJ[2] ECU_ADDRESS 0xd0001c42 FORMAT "%6.2" /end MEASUREMENT
/begin MEASUREMENT egcp[1].egcp_struct_adcprlsl1.vls_cor_h_res_lsl "Corrected output signal of  lambda sensor with extended resolution" UWORD _CNV_A_R_EGCP_LINEA_323_CM 1 100. 0. 4.999847 DISPLAY_IDENTIFIER VLS_COR_H_RES_LSL[2] ECU_ADDRESS 0xd0001c44 FORMAT "%6.4" /end MEASUREMENT
/begin MEASUREMENT egcp[1].egcp_struct_adcprlsl1.vls_mv_lsl "Mean value of output signal of linear lambda sensor" UWORD _CNV_A_R_EGCP_LINEA_323_CM 1 100. 0. 4.999847 DISPLAY_IDENTIFIER VLS_MV_LSL[2] ECU_ADDRESS 0xd0001c46 FORMAT "%6.4" /end MEASUREMENT
/begin MEASUREMENT egcp[1].egcp_struct_adcprlsl1.vls_mmv_lsl "Moving mean value of output signal of linear lambda sensor for Ip gain16" UWORD _CNV_A_R_EGCP_LINEA_323_CM 1 100. 0. 4.999847 DISPLAY_IDENTIFIER VLS_MMV_LSL[2] ECU_ADDRESS 0xd0001c48 FORMAT "%6.4" /end MEASUREMENT
/begin MEASUREMENT egcp[1].egcp_struct_adcprlsl1.vls_mmv_lsl_l_gain "Moving mean value of output signal of linear lambda sensor for Ip gain8" UWORD _CNV_A_R_EGCP_LINEA_323_CM 1 100. 0. 4.999847 DISPLAY_IDENTIFIER VLS_MMV_LSL_L_GAIN[2] ECU_ADDRESS 0xd0001c4a FORMAT "%6.4" /end MEASUREMENT
/begin MEASUREMENT egcp[1].egcp_struct_adcprlsl1.vls_cor_mv_lsl "Corrected output signal of the lambda sensor" UWORD _CNV_A_R_EGCP_LINEA_323_CM 1 100. 0. 4.999847 DISPLAY_IDENTIFIER VLS_COR_MV_LSL[2] ECU_ADDRESS 0xd0001c4c FORMAT "%6.4" /end MEASUREMENT
/begin MEASUREMENT egcp[1].egcp_struct_adcprlsl1.vls_cor_tmp_lsl "Corrected output signal of the lambda sensor" UWORD _CNV_A_R_EGCP_LINEA_323_CM 1 100. 0. 4.999847 DISPLAY_IDENTIFIER VLS_COR_TMP_LSL[2] ECU_ADDRESS 0xd0001c4e FORMAT "%6.4" /end MEASUREMENT
/begin MEASUREMENT egcp[1].egcp_struct_adcprlsl1.lamb_ls_up "Lambda signal value of the WRAF sensor" UWORD _CNV_A_R_LINEAR_____122_CM 1 100. 0. 31.9990234375 DISPLAY_IDENTIFIER LAMB_LS_UP[2] ECU_ADDRESS 0xd0001c50 FORMAT "%7.4" /end MEASUREMENT
/begin MEASUREMENT egcp[1].egcp_struct_adcprlsl1.vls_cor_lsl "Corrected output signal of  lambda sensor" UWORD _CNV_A_R_LINEAR_____2_CM 1 100. 0. 4.9951171875 DISPLAY_IDENTIFIER VLS_COR_LSL[2] ECU_ADDRESS 0xd0001c52 FORMAT "%5.3" /end MEASUREMENT
/begin MEASUREMENT egcp[1].egcp_struct_adcprlsl1.vls_cor_lsl_h_gain "Ip gain16 equivalent  of corrected output signal of  lambda sensor" UWORD _CNV_A_R_LINEAR_____2_CM 1 100. 0. 4.9951171875 DISPLAY_IDENTIFIER VLS_COR_LSL_H_GAIN[2] ECU_ADDRESS 0xd0001c54 FORMAT "%5.3" /end MEASUREMENT
/begin MEASUREMENT egcp[1].egcp_struct_adcprlsl1.t_dly_lsl_ofs_adj_puc_end "Wait timer to delay activation of offset adjustment after leaving fuel cut-off phase" UWORD _CNV_A_R_LINEAR_____3_CM 1 100. 0. 655.35 DISPLAY_IDENTIFIER T_DLY_LSL_OFS_ADJ_PUC_END[2] ECU_ADDRESS 0xd0001c56 FORMAT "%6.2" /end MEASUREMENT
/begin MEASUREMENT egcp[1].egcp_struct_adcprlsl1.ctr_vls_mv_lsl_nr_sample "Sample counter for mean value calculation " UBYTE _CNV_A_R_LINEAR_____0_CM 1 100. 0. 255. DISPLAY_IDENTIFIER CTR_VLS_MV_LSL_NR_SAMPLE[2] ECU_ADDRESS 0xd0001c58 FORMAT "%3.0" /end MEASUREMENT
/begin MEASUREMENT egcp[1].egcp_struct_adcprlsl1.ctr_cyc_t_wait_ofs_adj_red "Counter of cycles for application of reduced repetition rate for offset adjustment during engine warm-up" UBYTE _CNV_A_R_LINEAR_____0_CM 1 100. 0. 255. DISPLAY_IDENTIFIER CTR_CYC_T_WAIT_OFS_ADJ_RED[2] ECU_ADDRESS 0xd0001c59 FORMAT "%3.0" /end MEASUREMENT
/begin MEASUREMENT egcp[1].egcp_struct_adcprlsl1.ctr_err_lsl_if_spi_ofs_adj_save "Storage variable for SPI communication error counter value of WRAF controller " UBYTE _CNV_A_R_LINEAR_____0_CM 1 100. 0. 255. DISPLAY_IDENTIFIER CTR_ERR_LSL_IF_SPI_OFS_ADJ_SAVE[2] ECU_ADDRESS 0xd0001c5a FORMAT "%3.0" /end MEASUREMENT
/begin MEASUREMENT egcp[1].egcp_struct_adcprlsl1.state_lsl_ofs_adj "State of  WRAF controller lambda output  voltage offset adjustment" UBYTE _CNV_S_5_EGCP_RANGE_338_CM 1 100. 0. 4. DISPLAY_IDENTIFIER STATE_LSL_OFS_ADJ[2] ECU_ADDRESS 0xd0001c5b /end MEASUREMENT
/begin MEASUREMENT egcp[1].egcp_struct_adcprlsl1.t_dly_lsl_ofs_adj "Wait timer to delay acquisition of measurement  values upon activation of adjustment" UBYTE _CNV_A_R_LINEAR_____3_CM 1 100. 0. 2.55 DISPLAY_IDENTIFIER T_DLY_LSL_OFS_ADJ[2] ECU_ADDRESS 0xd0001c5c FORMAT "%4.2" /end MEASUREMENT
/begin MEASUREMENT egcp[1].egcp_struct_adcprlsl1.t_dly_lsl_ofs_adj_is "Wait timer to delay activation of offset adjustment upon entering engine state idle speed" UBYTE _CNV_A_R_LINEAR_____3_CM 1 100. 0. 2.55 DISPLAY_IDENTIFIER T_DLY_LSL_OFS_ADJ_IS[2] ECU_ADDRESS 0xd0001c5d FORMAT "%4.2" /end MEASUREMENT
/begin MEASUREMENT egcp[1].egcp_struct_adcprlsl1.lv_lsl_ofs_adj_act "State of the offset measurement (active / not active)" UBYTE _CNV_S_2_RANGE__0___1_CM 1 100. 0. 1. DISPLAY_IDENTIFIER LV_LSL_OFS_ADJ_ACT[2] ECU_ADDRESS 0xd0001c5e BIT_MASK 0x1 /end MEASUREMENT
/begin MEASUREMENT egcp[1].egcp_struct_adcprlsl1.lv_lsl_ofs_act_ast "Switch to chose activation conditions directly after engine start" UBYTE _CNV_S_2_RANGE__0___1_CM 1 100. 0. 1. DISPLAY_IDENTIFIER LV_LSL_OFS_ACT_AST[2] ECU_ADDRESS 0xd0001c5f BIT_MASK 0x1 /end MEASUREMENT
/begin MEASUREMENT egcp[1].egcp_struct_adcprlsl1.lv_lamb_sti_off_lsl_ofs_adj "Request for disabling of forced lambda stimulation" UBYTE _CNV_S_2_RANGE__0___1_CM 1 100. 0. 1. DISPLAY_IDENTIFIER LV_LAMB_STI_OFF_LSL_OFS_ADJ[2] ECU_ADDRESS 0xd0001c60 BIT_MASK 0x1 /end MEASUREMENT
/begin MEASUREMENT egcp[1].egcp_struct_adcprlsl1.lv_lsl_ofs_adj_is "Offset measurement carried out during current idle phase" UBYTE _CNV_S_2_RANGE__0___1_CM 1 100. 0. 1. DISPLAY_IDENTIFIER LV_LSL_OFS_ADJ_IS[2] ECU_ADDRESS 0xd0001c61 BIT_MASK 0x1 /end MEASUREMENT
/begin MEASUREMENT egcp[1].egcp_struct_adcprlsl1.lv_vls_ofs_lim_lsl "Boolean flag indicating limitation of  output voltage offset adjustment value for Ip gain16" UBYTE _CNV_S_2_RANGE__0___1_CM 1 100. 0. 1. DISPLAY_IDENTIFIER LV_VLS_OFS_LIM_LSL[2] ECU_ADDRESS 0xd0001c62 BIT_MASK 0x1 /end MEASUREMENT
/begin MEASUREMENT egcp[1].egcp_struct_adcprlsl1.lv_vls_ofs_adj_ena_lsl_if "Boolean flag requesting enabling offset adjustment  mode of WRAF sensor interface for lambda signal output voltage " UBYTE _CNV_S_2_RANGE__0___1_CM 1 100. 0. 1. DISPLAY_IDENTIFIER LV_VLS_OFS_ADJ_ENA_LSL_IF[2] ECU_ADDRESS 0xd0001c63 BIT_MASK 0x1 /end MEASUREMENT
/begin MEASUREMENT egcp[1].egcp_struct_adcprlsl1.lv_lamb_pls_swi_off "Indicator for need to switch off forced lambda stimulation" UBYTE _CNV_S_2_RANGE__0___1_CM 1 100. 0. 1. DISPLAY_IDENTIFIER LV_LAMB_PLS_SWI_OFF[2] ECU_ADDRESS 0xd0001c64 BIT_MASK 0x1 /end MEASUREMENT
/begin MEASUREMENT egcp[1].egcp_struct_adcprlsl1.lv_swi_clc_lsl_ofs_adj "Logical variable for switching of lambda calculation routines" UBYTE _CNV_S_2_RANGE__0___1_CM 1 100. 0. 1. DISPLAY_IDENTIFIER LV_SWI_CLC_LSL_OFS_ADJ[2] ECU_ADDRESS 0xd0001c65 BIT_MASK 0x1 /end MEASUREMENT
/begin MEASUREMENT egcp[1].egcp_struct_adcprlsl1.lv_vls_ofs_lim_lsl_l_gain "Boolean flag indicating limitation of  output voltage offset adjustment value for Ip gain8" UBYTE _CNV_S_2_RANGE__0___1_CM 1 100. 0. 1. DISPLAY_IDENTIFIER LV_VLS_OFS_LIM_LSL_L_GAIN[2] ECU_ADDRESS 0xd0001c66 BIT_MASK 0x1 /end MEASUREMENT
/begin MEASUREMENT egcp[1].egcp_struct_adcprlsl1.lv_swi_gain_lsl_if "Boolean flag configuring the WRAF sensor interface gain-selection for Ip measurement ( '0' = g8, '1' = g16 )" UBYTE _CNV_S_2_RANGE__0___1_CM 1 100. 0. 1. DISPLAY_IDENTIFIER LV_SWI_GAIN_LSL_IF[2] ECU_ADDRESS 0xd0001c67 BIT_MASK 0x1 /end MEASUREMENT
/begin MEASUREMENT egcp[1].egcp_struct_dtsyslsd0.t_temp_dew_ls_down "Time after dew point detection for downstream lambda probe" UWORD _CNV_A_R_LINEAR_____4_CM 1 100. 0. 6553.5 DISPLAY_IDENTIFIER T_TEMP_DEW_LS_DOWN[2] ECU_ADDRESS 0xd0001c8e FORMAT "%6.1" /end MEASUREMENT
/begin MEASUREMENT egcp[1].egcp_struct_dtsyslsd0.lv_ls_down_ready "Logical variable for operative readiness of downstream oxygen sensor(s)" UBYTE _CNV_S_2_RANGE__0___1_CM 1 100. 0. 1. DISPLAY_IDENTIFIER LV_LS_DOWN_READY[2] ECU_ADDRESS 0xd0001c90 BIT_MASK 0x1 /end MEASUREMENT
/begin MEASUREMENT egcp[1].egcp_struct_dtsyslsl0.lamb_de_int_ls_up_ready "Value as a measure of the sensor signal variation vs. time" UWORD _CNV_A_R_EGCP_LINEA_330_CM 1 100. 0. 63.999023 DISPLAY_IDENTIFIER LAMB_DE_INT_LS_UP_READY[2] ECU_ADDRESS 0xd0001c94 FORMAT "%7.4" /end MEASUREMENT
/begin MEASUREMENT egcp[1].egcp_struct_dtsyslsl0.t_tout_ls_up_ready "Timer for forced activation of linear lambda sensor" UWORD _CNV_A_R_LINEAR_____107_CM 1 100. 0. 1310.7 DISPLAY_IDENTIFIER T_TOUT_LS_UP_READY[2] ECU_ADDRESS 0xd0001c96 FORMAT "%7.2" /end MEASUREMENT
/begin MEASUREMENT egcp[1].egcp_struct_dtsyslsl0.t_dly_chk_ls_up_ready "Delay timer for start of readiness detection after engine start" UWORD _CNV_A_R_LINEAR_____107_CM 1 100. 0. 1310.7 DISPLAY_IDENTIFIER T_DLY_CHK_LS_UP_READY[2] ECU_ADDRESS 0xd0001c98 FORMAT "%7.2" /end MEASUREMENT
/begin MEASUREMENT egcp[1].egcp_struct_dtsyslsl0.t_lamb_de_int_rst "Timer for duration of summation of sensor signal dispersion up to reset thereof" UWORD _CNV_A_R_LINEAR_____107_CM 1 100. 0. 1310.7 DISPLAY_IDENTIFIER T_LAMB_DE_INT_RST[2] ECU_ADDRESS 0xd0001c9a FORMAT "%7.2" /end MEASUREMENT
/begin MEASUREMENT egcp[1].egcp_struct_dtsyslsl0.lamb_mv_ls_up_ready "Mean value of the converted upstream oxygen sensor signal in terms of A/F-ratio" UWORD _CNV_A_R_LINEAR_____122_CM 1 100. 0. 31.9990234375 DISPLAY_IDENTIFIER LAMB_MV_LS_UP_READY[2] ECU_ADDRESS 0xd0001c9c FORMAT "%7.4" /end MEASUREMENT
/begin MEASUREMENT egcp[1].egcp_struct_dtsyslsl0.t_dly_ls_up_ready_teg_min "Delay time after dew point detection prior to forced sensor activation" UWORD _CNV_A_R_LINEAR_____107_CM 1 100. 0. 1310.7 DISPLAY_IDENTIFIER T_DLY_LS_UP_READY_TEG_MIN[2] ECU_ADDRESS 0xd0001c9e FORMAT "%7.2" /end MEASUREMENT
/begin MEASUREMENT egcp[1].egcp_struct_dtsyslsl0.lv_ls_up_ready "Logical variable for operative readiness of upstream oxygen sensor" UBYTE _CNV_S_2_RANGE__0___1_CM 1 100. 0. 1. DISPLAY_IDENTIFIER LV_LS_UP_READY[2] ECU_ADDRESS 0xd0001ca0 BIT_MASK 0x1 /end MEASUREMENT
/begin MEASUREMENT egcp[1].egcp_struct_dtsyslsl0.lv_ls_up_ready_cdn "Logical variable for forced operative readiness of upstream oxygen sensor" UBYTE _CNV_S_2_RANGE__0___1_CM 1 100. 0. 1. DISPLAY_IDENTIFIER LV_LS_UP_READY_CDN[2] ECU_ADDRESS 0xd0001ca1 BIT_MASK 0x1 /end MEASUREMENT
/begin MEASUREMENT egcp[1].egcp_struct_dtsyslsl0.lv_ls_up_ready_raw "Logical variable for raw operative readiness of upstream oxygen sensor" UBYTE _CNV_S_2_RANGE__0___1_CM 1 100. 0. 1. DISPLAY_IDENTIFIER LV_LS_UP_READY_RAW[2] ECU_ADDRESS 0xd0001ca2 BIT_MASK 0x1 /end MEASUREMENT
/begin MEASUREMENT egcp[1].egcp_struct_dtsyslsl0.lv_teg_min_dly "Logical variable indicating sufficient delay after dew point detection prior to forced sensor activation" UBYTE _CNV_S_2_RANGE__0___1_CM 1 100. 0. 1. DISPLAY_IDENTIFIER LV_TEG_MIN_DLY[2] ECU_ADDRESS 0xd0001ca3 BIT_MASK 0x1 /end MEASUREMENT
/begin MEASUREMENT egcp[1].egcp_struct_sigcvlsd0.vls_down_drv1_mmv "Mean of buffer containing 1st derivative of VLS_DOWN[i] signal" SWORD _CNV_A_R_EGCP_LINEA_344_CM 1 100. -2.5 2.499924 DISPLAY_IDENTIFIER VLS_DOWN_DRV1_MMV[2] ECU_ADDRESS 0xd0001ce4 FORMAT "%8.5" /end MEASUREMENT
/begin MEASUREMENT egcp[1].egcp_struct_sigcvlsd0.vls_down_drv1_mmv_min "Minimum value of mean of buffer containing 1st derivative of VLS_DOWN[i] signal in lean phase" SWORD _CNV_A_R_EGCP_LINEA_344_CM 1 100. -2.5 2.499924 DISPLAY_IDENTIFIER VLS_DOWN_DRV1_MMV_MIN[2] ECU_ADDRESS 0xd0001ce6 FORMAT "%8.5" /end MEASUREMENT
/begin MEASUREMENT egcp[1].egcp_struct_sigcvlsd0.vls_down_drv1_abs_max "Absolute maximum value within buffer containing 1st derivative of VLS_DOWN[i] signal" UWORD _CNV_A_R_EGCP_LINEA_345_CM 1 100. 0. 4.99992370605469 DISPLAY_IDENTIFIER VLS_DOWN_DRV1_ABS_MAX[2] ECU_ADDRESS 0xd0001ce8 FORMAT "%7.5" /end MEASUREMENT
/begin MEASUREMENT egcp[1].egcp_struct_sigcvlsd0.vls_down_mmv_min "Mean oxygen sensor lean voltage" UWORD _CNV_A_R_EGCP_LINEA_346_CM 1 100. 0. 4.99992370605469 DISPLAY_IDENTIFIER VLS_DOWN_MMV_MIN[2] ECU_ADDRESS 0xd0001cea FORMAT "%7.5" /end MEASUREMENT
/begin MEASUREMENT egcp[1].egcp_struct_sigcvlsd0.vls_down_mmv_max "Mean oxygen sensor rich voltage" UWORD _CNV_A_R_EGCP_LINEA_346_CM 1 100. 0. 4.99992370605469 DISPLAY_IDENTIFIER VLS_DOWN_MMV_MAX[2] ECU_ADDRESS 0xd0001cec FORMAT "%7.5" /end MEASUREMENT
/begin MEASUREMENT egcp[1].egcp_struct_sigcvlsd0.vls_down_bol "Variable switching threshold for calculation of VLS_DOWN_MMV_MIN[i]" UWORD _CNV_A_R_LINEAR_____2_CM 1 100. 0. 4.9951171875 DISPLAY_IDENTIFIER VLS_DOWN_BOL[2] ECU_ADDRESS 0xd0001cee FORMAT "%5.3" /end MEASUREMENT
/begin MEASUREMENT egcp[1].egcp_struct_sigcvlsd0.vls_down_tol "Variable switching threshold for calculation of VLS_DOWN_MMV_MAX[i]" UWORD _CNV_A_R_LINEAR_____2_CM 1 100. 0. 4.9951171875 DISPLAY_IDENTIFIER VLS_DOWN_TOL[2] ECU_ADDRESS 0xd0001cf0 FORMAT "%5.3" /end MEASUREMENT
/begin MEASUREMENT egcp[1].egcp_struct_sigcvlsd0.vls_down_mmv_hys "Variable hysteresis used to determine switching thresholds" UWORD _CNV_A_R_EGCP_LINEA_347_CM 1 100. 0. 0.999924 DISPLAY_IDENTIFIER VLS_DOWN_MMV_HYS[2] ECU_ADDRESS 0xd0001cf2 FORMAT "%7.5" /end MEASUREMENT
/begin MEASUREMENT egcp[1].egcp_struct_sigcvlsd0.lv_vls_down_mmv_lim "Boolean flag indicating VLS_DOWN_MMV_xxx[i] signals being limited when set" UBYTE _CNV_S_2_RANGE__0___1_CM 1 100. 0. 1. DISPLAY_IDENTIFIER LV_VLS_DOWN_MMV_LIM[2] ECU_ADDRESS 0xd0001cf4 BIT_MASK 0x1 /end MEASUREMENT
/begin MEASUREMENT egcp[1].egcp_struct_acctllsh0.v_efc_ctl_p_lsh_up "additive effective heater voltage from closed loop controller, P term" SWORD _CNV_A_R_EGCP_LINEA_368_CM 1 100. -13. 12.999603 DISPLAY_IDENTIFIER V_EFC_CTL_P_LSH_UP[2] ECU_ADDRESS 0xd0001e98 FORMAT "%10.4" /end MEASUREMENT
/begin MEASUREMENT egcp[1].egcp_struct_acctllsh0.v_efc_ctl_i_lsh_up "additive effective heater voltage from closed loop controller, I term" SWORD _CNV_A_R_EGCP_LINEA_368_CM 1 100. -13. 12.999603 DISPLAY_IDENTIFIER V_EFC_CTL_I_LSH_UP[2] ECU_ADDRESS 0xd0001e9a FORMAT "%10.4" /end MEASUREMENT
/begin MEASUREMENT egcp[1].egcp_struct_acctllsh0.ttip_mes_dif_ls_up "Difference between actual and set oxygen sensor tip temperature" SWORD _CNV_A_R_LINEAR_____123_CM 1 100. -2048. 2047.9375 DISPLAY_IDENTIFIER TTIP_MES_DIF_LS_UP[2] ECU_ADDRESS 0xd0001e9c FORMAT "%10.4" /end MEASUREMENT
/begin MEASUREMENT egcp[1].egcp_struct_acctllsh0.t_pow_rise_lsh_up "Timer indicating the duration of  the pre-heating and post dew point heating phases " UWORD _CNV_A_R_LINEAR_____4_CM 1 100. 0. 6553.5 DISPLAY_IDENTIFIER T_POW_RISE_LSH_UP[2] ECU_ADDRESS 0xd0001e9e FORMAT "%6.1" /end MEASUREMENT
/begin MEASUREMENT egcp[1].egcp_struct_acctllsh0.v_efc_clc_lsh_up "Effective calculated heater voltage value prior to overvoltage protection" UWORD _CNV_A_R_LINEAR_____142_CM 1 100. 0. 25.999603 DISPLAY_IDENTIFIER V_EFC_CLC_LSH_UP[2] ECU_ADDRESS 0xd0001ea0 FORMAT "%7.4" /end MEASUREMENT
/begin MEASUREMENT egcp[1].egcp_struct_acctllsh0.v_efc_ctl_add_lsh_up "additive effective heater voltage from closed loop controller" SBYTE _CNV_A_R_EGCP_LINEA_322_CM 1 100. -13. 12.898438 DISPLAY_IDENTIFIER V_EFC_CTL_ADD_LSH_UP[2] ECU_ADDRESS 0xd0001ea2 FORMAT "%5.1" /end MEASUREMENT
/begin MEASUREMENT egcp[1].egcp_struct_acctllsh0.lshpwm_up "Heater driver PWM duty cycle; acquired also by BSW" UBYTE _CNV_A_R_LINEAR_____5_CM 1 100. 0. 99.609375 DISPLAY_IDENTIFIER LSHPWM_UP[2] ECU_ADDRESS 0xd0001ea3 FORMAT "%9.6" /end MEASUREMENT
/begin MEASUREMENT egcp[1].egcp_struct_acctllsh0.v_efc_lsh_up "Effective final output value of heater voltage" UBYTE _CNV_A_R_LINEAR_____289_CM 1 100. 0. 25.8984375 DISPLAY_IDENTIFIER V_EFC_LSH_UP[2] ECU_ADDRESS 0xd0001ea4 FORMAT "%9.6" /end MEASUREMENT
/begin MEASUREMENT egcp[1].egcp_struct_acctllsh0.t_v_efc_tol_lsh_up "Timer indicating permitted effective heater voltage overvoltage duration" UBYTE _CNV_A_R_LINEAR_____4_CM 1 100. 0. 25.5 DISPLAY_IDENTIFIER T_V_EFC_TOL_LSH_UP[2] ECU_ADDRESS 0xd0001ea5 FORMAT "%4.1" /end MEASUREMENT
/begin MEASUREMENT egcp[1].egcp_struct_acctllsh0.t_v_efc_lim_lsh_up "Timer indicating the duration of the effective heater voltage limitation preventing overvoltage" UBYTE _CNV_A_R_LINEAR_____4_CM 1 100. 0. 25.5 DISPLAY_IDENTIFIER T_V_EFC_LIM_LSH_UP[2] ECU_ADDRESS 0xd0001ea6 FORMAT "%4.1" /end MEASUREMENT
/begin MEASUREMENT egcp[1].egcp_struct_acctllsh0.state_lsh_up "Present heater state" UBYTE _CNV_S_7_EGCP_RANGE_335_CM 1 100. 0. 6. DISPLAY_IDENTIFIER STATE_LSH_UP[2] ECU_ADDRESS 0xd0001ea7 /end MEASUREMENT
/begin MEASUREMENT egcp[1].egcp_struct_acctllsh0.lv_lsh_ctl_cll_lsh_up "Boolean variable indicating closed loop control mode active" UBYTE _CNV_S_2_RANGE__0___1_CM 1 100. 0. 1. DISPLAY_IDENTIFIER LV_LSH_CTL_CLL_LSH_UP[2] ECU_ADDRESS 0xd0001ea8 BIT_MASK 0x1 /end MEASUREMENT
/begin MEASUREMENT egcp[1].egcp_struct_acctllsh0.lv_v_efc_lim_bol_lsh_up "Boolean flag indicating effective heater voltage limited due to sum of voltage components falling below zero." UBYTE _CNV_S_2_RANGE__0___1_CM 1 100. 0. 1. DISPLAY_IDENTIFIER LV_V_EFC_LIM_BOL_LSH_UP[2] ECU_ADDRESS 0xd0001ea9 BIT_MASK 0x1 /end MEASUREMENT
/begin MEASUREMENT egcp[1].egcp_struct_acctllsh0.lv_v_efc_lim_tol_lsh_up "Boolean flag indicating effective heater voltage limited due to exceeding threshold for period of time." UBYTE _CNV_S_2_RANGE__0___1_CM 1 100. 0. 1. DISPLAY_IDENTIFIER LV_V_EFC_LIM_TOL_LSH_UP[2] ECU_ADDRESS 0xd0001eaa BIT_MASK 0x1 /end MEASUREMENT
/begin MEASUREMENT egcp[1].egcp_struct_acctllsh0.lv_v_efc_lim_max_lsh_up "Boolean flag indicating effective heater voltage limited due to exceeding absolute maximum voltage spec." UBYTE _CNV_S_2_RANGE__0___1_CM 1 100. 0. 1. DISPLAY_IDENTIFIER LV_V_EFC_LIM_MAX_LSH_UP[2] ECU_ADDRESS 0xd0001eab BIT_MASK 0x1 /end MEASUREMENT
/begin MEASUREMENT egcp[1].egcp_struct_acctllsh0.lv_v_efc_lim_prot_vb_lsh_up "Boolean flag indicating effective heater voltage limited due to excessive battery voltage level" UBYTE _CNV_S_2_RANGE__0___1_CM 1 100. 0. 1. DISPLAY_IDENTIFIER LV_V_EFC_LIM_PROT_VB_LSH_UP[2] ECU_ADDRESS 0xd0001eac BIT_MASK 0x1 /end MEASUREMENT
/begin MEASUREMENT egcp[1].egcp_struct_acctllsh0.lv_lsh_up_man_act "Boolean variable indicating that forced lambda probe heating before engine start is active" UBYTE _CNV_S_2_RANGE__0___1_CM 1 100. 0. 1. DISPLAY_IDENTIFIER LV_LSH_UP_MAN_ACT[2] ECU_ADDRESS 0xd0001ead BIT_MASK 0x1 /end MEASUREMENT
/begin MEASUREMENT lv_vls_down_mmv_act "Boolean flag indicating calibrateable delay since PUC deactivation passed" UBYTE _CNV_S_2_RANGE__0___1_CM 1 100. 0. 1. DISPLAY_IDENTIFIER LV_VLS_DOWN_MMV_ACT ECU_ADDRESS 0xd0002da8 BIT_MASK 0x1 /end MEASUREMENT
/begin CHARACTERISTIC c_t_dly_puc_end_vls_down "Delay between completion of engine state PUC and computation of VLS_DOWN_MMV_xxx[i]" VALUE 0xa10021bc _REC_VAL_20_u2 655.35 _CNV_A_R_LINEAR_____3_CM 0. 655.35 DISPLAY_IDENTIFIER C_T_DLY_PUC_END_VLS_DOWN FORMAT "%6.2" /end CHARACTERISTIC
/begin CHARACTERISTIC c_fac_vls_down_mmv_hys "Multiplicative factor governing amplitude of hysteresis" VALUE 0xa10020a3 _REC_VAL_20_u1 0.99609375 _CNV_A_R_LINEAR_____27_CM 0. 0.99609375 DISPLAY_IDENTIFIER C_FAC_VLS_DOWN_MMV_HYS FORMAT "%5.3" /end CHARACTERISTIC
/begin CHARACTERISTIC c_vls_down_mmv_hys_min "Minimum hysteresis for the computation of the thresholds VLS_DOWN_TOL[i] and VLS_DOWN_BOL[i]" VALUE 0xa100229c _REC_VAL_20_u2 0.999924 _CNV_A_R_EGCP_LINEA_347_CM 0. 0.999924 DISPLAY_IDENTIFIER C_VLS_DOWN_MMV_HYS_MIN FORMAT "%7.5" /end CHARACTERISTIC
/begin CHARACTERISTIC c_vls_down_ini_min "Lower initialisation value for VLS_DOWN_TOL[i]. VLS_DOWN_MMV_MIN[i]" VALUE 0xa1002290 _REC_VAL_20_u2 4.9951171875 _CNV_A_R_LINEAR_____2_CM 0. 4.9951171875 DISPLAY_IDENTIFIER C_VLS_DOWN_INI_MIN FORMAT "%5.3" /end CHARACTERISTIC
/begin CHARACTERISTIC c_vls_down_ini_max "Upper initialisation value for VLS_DOWN_BOL[i]. VLS_DOWN_MMV_MAX[i]" VALUE 0xa100228e _REC_VAL_20_u2 4.9951171875 _CNV_A_R_LINEAR_____2_CM 0. 4.9951171875 DISPLAY_IDENTIFIER C_VLS_DOWN_INI_MAX FORMAT "%5.3" /end CHARACTERISTIC
/begin CHARACTERISTIC c_crlc_vls_down "Filter constant for determination of VLS_DOWN_MMV_xxx[i] values when respective threshold passed" VALUE 0xa100203e _REC_VAL_20_u2 0.9999847412109381 _CNV_A_R_LINEAR_____68_CM 0. 0.9999847412109381 DISPLAY_IDENTIFIER C_CRLC_VLS_DOWN FORMAT "%7.5" /end CHARACTERISTIC
/begin CHARACTERISTIC c_crlc_vls_down_off "Filter constant for determination of VLS_DOWN_MMV_xxx[i] values when respective threshold not passed" VALUE 0xa1002040 _REC_VAL_20_u2 0.9999847412109381 _CNV_A_R_LINEAR_____68_CM 0. 0.9999847412109381 DISPLAY_IDENTIFIER C_CRLC_VLS_DOWN_OFF FORMAT "%7.5" /end CHARACTERISTIC
/begin COMPU_METHOD _CNV_A_R_LINEAR_____0_CM "" RAT_FUNC "%6.3" "-" COEFFS 0 1. 0. 0 0 1 /end COMPU_METHOD
/begin COMPU_METHOD _CNV_S_2_RANGE__0___1_CM "" TAB_VERB "%6.3" "-" COMPU_TAB_REF _CNV_S_2_RANGE__0___1 /end COMPU_METHOD
/begin COMPU_VTAB _CNV_S_2_RANGE__0___1 "" TAB_VERB 2 0 "0" 1 "1" /end COMPU_VTAB
/begin COMPU_METHOD _CNV_A_R_LINEAR_____2_CM "" RAT_FUNC "%6.3" "V" COEFFS 0 204.8 0. 0 0 1 /end COMPU_METHOD
/begin COMPU_METHOD _CNV_A_R_LINEAR_____3_CM "" RAT_FUNC "%6.3" "s" COEFFS 0 100. 0. 0 0 1 /end COMPU_METHOD
/begin COMPU_METHOD _CNV_A_R_LINEAR_____4_CM "" RAT_FUNC "%6.3" "s" COEFFS 0 10. 0. 0 0 1 /end COMPU_METHOD
/begin COMPU_METHOD _CNV_A_R_LINEAR_____5_CM "" RAT_FUNC "%6.3" "%" COEFFS 0 2.56 0. 0 0 1 /end COMPU_METHOD
/begin COMPU_METHOD _CNV_A_R_LINEAR_____6_CM "" RAT_FUNC "%6.3" "km/h" COEFFS 0 1. 0. 0 0 1 /end COMPU_METHOD
/begin COMPU_METHOD _CNV_A_R_LINEAR_____7_CM "" RAT_FUNC "%6.3" "%" COEFFS 0 655.3599999999997 0. 0 0 1 /end COMPU_METHOD
/begin COMPU_METHOD _CNV_A_R_LINEAR_____8_CM "" RAT_FUNC "%6.3" "-" COEFFS 0 32767.99999999992 0. 0 0 1 /end COMPU_METHOD
/begin COMPU_METHOD _CNV_A_R_LINEAR_____9_CM "" RAT_FUNC "%6.3" "rpm" COEFFS 0 3.125e-002 0. 0 0 1 /end COMPU_METHOD
/begin COMPU_METHOD _CNV_A_R_LINEAR_____13_CM "" RAT_FUNC "%6.3" "rpm" COEFFS 0 1. 0. 0 0 1 /end COMPU_METHOD
/begin COMPU_METHOD _CNV_A_R_LINEAR_____14_CM "" RAT_FUNC "%6.3" "mg/stk" COEFFS 0 0.183585313174946 0. 0 0 1 /end COMPU_METHOD
/begin COMPU_METHOD _CNV_A_R_LINEAR_____16_CM "" RAT_FUNC "%6.3" "°C" COEFFS 0 1.333333333333333 64. 0 0 1 /end COMPU_METHOD
/begin COMPU_METHOD _CNV_A_R_LINEAR_____23_CM "" RAT_FUNC "%6.3" "-" COEFFS 0 16384. 0. 0 0 1 /end COMPU_METHOD
/begin COMPU_METHOD _CNV_A_R_LINEAR_____26_CM "" RAT_FUNC "%6.3" "hPa" COEFFS 0 12.06017666543982 0. 0 0 1 /end COMPU_METHOD
/begin COMPU_METHOD _CNV_A_R_LINEAR_____27_CM "" RAT_FUNC "%6.3" "-" COEFFS 0 256. 0. 0 0 1 /end COMPU_METHOD
/begin COMPU_METHOD _CNV_A_R_LINEAR_____30_CM "" RAT_FUNC "%6.3" "Nm" COEFFS 0 32. 0. 0 0 1 /end COMPU_METHOD
/begin COMPU_METHOD _CNV_A_R_LINEAR_____35_CM "" RAT_FUNC "%6.3" "s" COEFFS 0 1. 0. 0 0 1 /end COMPU_METHOD
/begin COMPU_METHOD _CNV_A_R_LINEAR_____65_CM "" RAT_FUNC "%6.3" "Nm" COEFFS 0 32. 32768. 0 0 1 /end COMPU_METHOD
/begin COMPU_METHOD _CNV_A_R_LINEAR_____68_CM "" RAT_FUNC "%6.3" "-" COEFFS 0 65535.99999999996 0. 0 0 1 /end COMPU_METHOD
/begin COMPU_METHOD _CNV_A_R_LINEAR_____100_CM "" RAT_FUNC "%6.3" "-" COEFFS 0 128. 0. 0 0 1 /end COMPU_METHOD
/begin COMPU_METHOD _CNV_A_R_LINEAR_____107_CM "" RAT_FUNC "%6.3" "s" COEFFS 0 50. 0. 0 0 1 /end COMPU_METHOD
/begin COMPU_METHOD _CNV_A_R_LINEAR_____108_CM "" RAT_FUNC "%6.3" "mg/stk" COEFFS 0 47.18142548596112 0. 0 0 1 /end COMPU_METHOD
/begin COMPU_METHOD _CNV_A_R_LINEAR_____110_CM "" RAT_FUNC "%6.3" "%" COEFFS 0 655.3599999999997 -1.455191522836685e-011 0 0 1 /end COMPU_METHOD
/begin COMPU_METHOD _CNV_A_R_LINEAR_____122_CM "" RAT_FUNC "%6.3" "-" COEFFS 0 1024. 0. 0 0 1 /end COMPU_METHOD
/begin COMPU_METHOD _CNV_A_R_LINEAR_____123_CM "" RAT_FUNC "%6.3" "°C" COEFFS 0 16. 0. 0 0 1 /end COMPU_METHOD
/begin COMPU_METHOD _CNV_A_R_LINEAR_____142_CM "" RAT_FUNC "%6.3" "V" COEFFS 0 2520.615410935313 0. 0 0 1 /end COMPU_METHOD
/begin COMPU_METHOD _CNV_A_R_LINEAR_____147_CM "" RAT_FUNC "%6.3" "kg/h" COEFFS 0 8192. 0. 0 0 1 /end COMPU_METHOD
/begin COMPU_METHOD _CNV_A_R_LINEAR_____159_CM "" RAT_FUNC "%6.3" "%" COEFFS 0 655.3600000071681 32768.00000035841 0 0 1 /end COMPU_METHOD
/begin COMPU_METHOD _CNV_A_R_EGCP_LINEA_194_CM "" RAT_FUNC "%6.3" "V" COEFFS 0 204.8000001200018 0. 0 0 1 /end COMPU_METHOD
/begin COMPU_METHOD _CNV_A_R_LINEAR_____204_CM "" RAT_FUNC "%6.3" "°C" COEFFS 0 16. 4370.4 0 0 1 /end COMPU_METHOD
/begin COMPU_METHOD _CNV_A_R_LINEAR_____207_CM "" RAT_FUNC "%6.3" "kg/h" COEFFS 0 32. 0. 0 0 1 /end COMPU_METHOD
/begin COMPU_METHOD _CNV_A_R_LINEAR_____283_CM "" RAT_FUNC "%6.3" "-" COEFFS 0 64. 0. 0 0 1 /end COMPU_METHOD
/begin COMPU_METHOD _CNV_A_R_LINEAR_____289_CM "Battery voltage" RAT_FUNC "%6.3" "V" COEFFS 0 9.846153846153847 0. 0 0 1 /end COMPU_METHOD
/begin COMPU_METHOD _CNV_A_R_EVAC_LINEA_294_CM "" RAT_FUNC "%6.3" "hPa" COEFFS 0 12.06017666543982 32767.98240706662 0 0 1 /end COMPU_METHOD
/begin COMPU_METHOD _CNV_A_R_LINEAR_____297_CM "" RAT_FUNC "%6.3" "hPa" COEFFS 0 12.06017666543982 -4.001776687800884e-011 0 0 1 /end COMPU_METHOD
/begin COMPU_METHOD _CNV_S_6_STATE_CDN__298_CM "" TAB_VERB "%6.3" "-" COMPU_TAB_REF _CNV_S_6_STATE_CDN__298 /end COMPU_METHOD
/begin COMPU_VTAB _CNV_S_6_STATE_CDN__298 "" TAB_VERB 6 0 "NO_CDN" 1 "CDN_NO_PURGE" 2 "CDN_MIN_PURGE" 3 "CDN_RAMP_OPEN" 4 "CDN_RAMP_FAST" 5 "CDN_NO_FAST" /end COMPU_VTAB
/begin COMPU_METHOD _CNV_S_3_STATE_TRAN_299_CM "" TAB_VERB "%6.3" "-" COMPU_TAB_REF _CNV_S_3_STATE_TRAN_299 /end COMPU_METHOD
/begin COMPU_VTAB _CNV_S_3_STATE_TRAN_299 "" TAB_VERB 3 0 "NONE" 1 "NO_PURGE" 2 "MIN_PURGE" /end COMPU_VTAB
/begin COMPU_METHOD _CNV_A_R_LINEAR_____305_CM "" RAT_FUNC "%6.3" "Hz" COEFFS 0 1. 0. 0 0 1 /end COMPU_METHOD
/begin COMPU_METHOD _CNV_A_R_EVAC_LINEA_308_CM "" RAT_FUNC "%6.3" "kg/h" COEFFS 0 8191.875 -0.5 0 0 1 /end COMPU_METHOD
/begin COMPU_METHOD _CNV_A_R_LINEAR_____309_CM "" RAT_FUNC "%6.3" "hPa" COEFFS 0 12.06017666543982 -1.759293338545831e-002 0 0 1 /end COMPU_METHOD
/begin COMPU_METHOD _CNV_S_3_STATE_CL_M_311_CM "" TAB_VERB "%6.3" "-" COMPU_TAB_REF _CNV_S_3_STATE_CL_M_311 /end COMPU_METHOD
/begin COMPU_VTAB _CNV_S_3_STATE_CL_M_311 "" TAB_VERB 3 0 "CL_MDL_DISABLED" 1 "CL_MDL_ENABLED" 2 "CL_MDL_ACTIVE" /end COMPU_VTAB
/begin COMPU_METHOD _CNV_S_2_STATE_CL_M_312_CM "" TAB_VERB "%6.3" "-" COMPU_TAB_REF _CNV_S_2_STATE_CL_M_312 /end COMPU_METHOD
/begin COMPU_VTAB _CNV_S_2_STATE_CL_M_312 "" TAB_VERB 2 0 "CL_MDL_OFF" 1 "CL_MDL_ON" /end COMPU_VTAB
/begin COMPU_METHOD _CNV_S_6_STATE_CPS__313_CM "" TAB_VERB "%6.3" "-" COMPU_TAB_REF _CNV_S_6_STATE_CPS__313 /end COMPU_METHOD
/begin COMPU_VTAB _CNV_S_6_STATE_CPS__313 "" TAB_VERB 6 0 "INACTIVE" 1 "WAITING" 2 "LEARNING" 4 "INTERRUPTED" 5 "FAILED" 6 "FINISHED" /end COMPU_VTAB
/begin COMPU_METHOD _CNV_A_R_EVAC_LINEA_314_CM "" RAT_FUNC "%6.3" "-" COEFFS 0 16. 0. 0 0 1 /end COMPU_METHOD
/begin COMPU_METHOD _CNV_A_R_EGCP_LINEA_315_CM "Battery voltage" RAT_FUNC "%6.3" "°C" COEFFS 0 16. 32768. 0 0 1 /end COMPU_METHOD
/begin COMPU_METHOD _CNV_A_R_EGCP_LINEA_319_CM "" RAT_FUNC "%6.3" "V/K" COEFFS 0 1000. 0. 0 0 1 /end COMPU_METHOD
/begin COMPU_METHOD _CNV_A_R_EGCP_LINEA_320_CM "" RAT_FUNC "%6.3" "-" COEFFS 0 40.17013232514178 0. 0 0 1 /end COMPU_METHOD
/begin COMPU_METHOD _CNV_A_R_EGCP_LINEA_321_CM "Battery voltage" RAT_FUNC "%6.3" "V/100ms" COEFFS 0 156.9230769230769 0. 0 0 1 /end COMPU_METHOD
/begin COMPU_METHOD _CNV_A_R_EGCP_LINEA_322_CM "Battery voltage" RAT_FUNC "%6.3" "V" COEFFS 0 9.846153656062192 -2.471191493214064e-006 0 0 1 /end COMPU_METHOD
/begin COMPU_METHOD _CNV_A_R_EGCP_LINEA_323_CM "" RAT_FUNC "%6.3" "V" COEFFS 0 6553.60054017653 0. 0 0 1 /end COMPU_METHOD
/begin COMPU_METHOD _CNV_A_R_EGCP_LINEA_324_CM "" RAT_FUNC "%6.3" "mA/V" COEFFS 0 13007.28356275124 0. 0 0 1 /end COMPU_METHOD
/begin COMPU_METHOD _CNV_A_R_LINEAR_____328_CM "" RAT_FUNC "%6.3" "mA" COEFFS 0 2601.524353935929 0.8007621769647813 0 0 1 /end COMPU_METHOD
/begin COMPU_METHOD _CNV_A_R_LINEAR_____329_CM "" RAT_FUNC "%6.3" "g" COEFFS 0 22.49999999999997 0. 0 0 1 /end COMPU_METHOD
/begin COMPU_METHOD _CNV_A_R_EGCP_LINEA_330_CM "Battery voltage" RAT_FUNC "%6.3" "-" COEFFS 0 1024.000007000107 0. 0 0 1 /end COMPU_METHOD
/begin COMPU_METHOD _CNV_A_R_EGCP_LINEA_331_CM "" RAT_FUNC "%6.3" "-" COEFFS 0 1024.002785367616 0. 0 0 1 /end COMPU_METHOD
/begin COMPU_METHOD _CNV_S_7_EGCP_RANGE_335_CM "" TAB_VERB "%6.3" "-" COMPU_TAB_REF _CNV_S_7_EGCP_RANGE_335 /end COMPU_METHOD
/begin COMPU_VTAB _CNV_S_7_EGCP_RANGE_335 "" TAB_VERB 7 0 "LSH_OFF" 1 "LSH_POW_RISE" 2 "LSH_POW_RED" 3 "LSH_POW_FALL" 4 "LSH_POW_CTL" 5 "LSH_VB_PROT" 6 "LSH_TEMP_PROT" /end COMPU_VTAB
/begin COMPU_METHOD _CNV_A_R_EGCP_LINEA_336_CM "" RAT_FUNC "%6.3" "V" COEFFS 0 6553.600000000001 4.76837158203125e-007 0 0 1 /end COMPU_METHOD
/begin COMPU_METHOD _CNV_A_R_EGCP_LINEA_337_CM "Battery voltage" RAT_FUNC "%6.3" "V" COEFFS 0 6553.600270084133 1.350420665403362e-003 0 0 1 /end COMPU_METHOD
/begin COMPU_METHOD _CNV_S_5_EGCP_RANGE_338_CM "" TAB_VERB "%6.3" "-" COMPU_TAB_REF _CNV_S_5_EGCP_RANGE_338 /end COMPU_METHOD
/begin COMPU_VTAB _CNV_S_5_EGCP_RANGE_338 "" TAB_VERB 5 0 "0: WAIT" 1 "1: PREPARE" 2 "2: ADJUST_H" 3 "3: ADJUST_L" 4 "4: RETURN" /end COMPU_VTAB
/begin COMPU_METHOD _CNV_A_R_EGCP_LINEA_344_CM "Battery voltage" RAT_FUNC "%6.3" "V/10ms" COEFFS 0 13107.19922942829 -1.926429285958875e-003 0 0 1 /end COMPU_METHOD
/begin COMPU_METHOD _CNV_A_R_EGCP_LINEA_345_CM "Battery voltage" RAT_FUNC "%6.3" "V/10ms" COEFFS 0 13107.19999999999 0. 0 0 1 /end COMPU_METHOD
/begin COMPU_METHOD _CNV_A_R_EGCP_LINEA_346_CM "Battery voltage" RAT_FUNC "%6.3" "V" COEFFS 0 13107.19999999999 0. 0 0 1 /end COMPU_METHOD
/begin COMPU_METHOD _CNV_A_R_EGCP_LINEA_347_CM "Battery voltage" RAT_FUNC "%6.3" "V" COEFFS 0 13107.99620771179 0. 0 0 1 /end COMPU_METHOD
/begin COMPU_METHOD _CNV_A_R_EGCP_LINEA_368_CM "Battery voltage" RAT_FUNC "%6.3" "V" COEFFS 0 2520.615410935313 3.42159066349268e-004 0 0 1 /end COMPU_METHOD
/begin RECORD_LAYOUT _REC_VAL_20_u1 FNC_VALUES 1 UBYTE COLUMN_DIR DIRECT /end RECORD_LAYOUT
/begin RECORD_LAYOUT _REC_VAL_20_u2 FNC_VALUES 1 UWORD COLUMN_DIR DIRECT /end RECORD_LAYOUT
/begin RECORD_LAYOUT _REC_AXS_20_u1 NO_AXIS_PTS_X 1 UBYTE AXIS_PTS_X 2 UBYTE INDEX_INCR DIRECT /end RECORD_LAYOUT
/begin RECORD_LAYOUT _REC_CUR_20_u1_u1 FNC_VALUES 1 UBYTE COLUMN_DIR DIRECT /end RECORD_LAYOUT
/begin RECORD_LAYOUT _REC_VAL_20_s2 FNC_VALUES 1 SWORD COLUMN_DIR DIRECT /end RECORD_LAYOUT
/begin RECORD_LAYOUT _REC_AXS_20_u2 NO_AXIS_PTS_X 1 UWORD AXIS_PTS_X 2 UWORD INDEX_INCR DIRECT /end RECORD_LAYOUT
/begin RECORD_LAYOUT _REC_CUR_20_u2_u1 FNC_VALUES 1 UWORD COLUMN_DIR DIRECT /end RECORD_LAYOUT
/begin RECORD_LAYOUT _REC_CUR_20_u2_u2 FNC_VALUES 1 UWORD COLUMN_DIR DIRECT /end RECORD_LAYOUT
/begin RECORD_LAYOUT _REC_VAL_20_s1 FNC_VALUES 1 SBYTE COLUMN_DIR DIRECT /end RECORD_LAYOUT
/begin RECORD_LAYOUT _REC_CUR_20_u1_u2 FNC_VALUES 1 UBYTE COLUMN_DIR DIRECT /end RECORD_LAYOUT
/begin RECORD_LAYOUT _REC_MAP_20_u1_u1_u2 FNC_VALUES 1 UBYTE COLUMN_DIR DIRECT /end RECORD_LAYOUT
/begin RECORD_LAYOUT _REC_CUR_20_s2_u2 FNC_VALUES 1 SWORD COLUMN_DIR DIRECT /end RECORD_LAYOUT
/begin FUNCTION EVAC_lambda_CL_calculation ""
 /begin DEF_CHARACTERISTIC ip_crlc_fac_lam_mv_mmv_cp_opl ip_crlc_fac_lam_mv_mmv_cp_cll c_raf_clc_cp c_cl_fac_lam_dif_max c_cl_fac_lam_dif_min c_cl_st_cp c_prs_max_2_cps ip_cl_crlc_open_fast ip_cl_crlc_ramp_open c_cl_max_cp ip_nr_step_cl ip_cl_crlc_ini c_cppwm_min_cl c_cl_mmv_dyw ip_t_dly_cl_mmv_dyw c_fac_lam_dif_cp_as ip_cl_crlc ldp_rate_ip_fac_crlc_cl ip_fac_cppwm ldp_cppwm_ip_fac_cppwm ldp_fac_ip_fac_lam_grd_mmv ip_fac_crlc_cl c_cl_dyw_max_cp c_crlc_fac_lam_grd c_fac_lam_dif_max_cp c_fac_lam_thd_cl_mem c_flow_min_cps c_flow_min_cps_ro lc_cl_fil_ini_tra_deac_cll lc_init_cl_crlc_ramp_open_fast c_fac_lam_0_max c_fac_lam_0_min ldpm_cl_mmv_1_evac ip_fac_lam_grd_mmv c_t_dly_max_ramp_open lc_lam_cbk_cps ldp_lamb_mmv_cp_ip_crlc_mmv_cp c_cl_mmv_hom_cp c_cl_mmv_chk ip_crlc_lamb_lpf_cp lc_lamb_afs_cp_cps_scg ip_crlc_mmv_cp /end DEF_CHARACTERISTIC
 /begin OUT_MEASUREMENT lv_fac_lam_shift_cp_avl lv_cp_afl mff_cp mff_add_cp_old mff_lam_cp cl fac_lam_0_cp fac_lam_dif_cp fac_lam_shift_cp mff_add_cp_kgh crlc_cl cl_mmv_dyw_max cl_mmv_dyw_min crlc_fac_lam_mv_mmv_cp fac_lam_grd fac_lam_cp fac_lam_grd_mmv rate_flow_dly fac_crlc_cl cl_mmv cl_mmv_mem_cl_mdl cl_mmv_mem_cl_mdl_old lv_cp_new_ramp_open lv_cl_mmv_cal_act lv_fac_lam_shift_cp t_ramp_open_stab lamb_mmv_cp lamb_lpf_cp lv_lamb_afs_cp /end OUT_MEASUREMENT
/end FUNCTION
/begin FUNCTION EVAC_Canister_Load_Model "Canister_Load_Model"
 /begin DEF_CHARACTERISTIC c_t_cl_mdl_cll_ena c_t_cl_mdl_cll_ena_inc c_t_cl_mdl_act_max c_t_cl_mdl_act_ofs c_fac_t_cl_mdl_act ip_cl_mdl_slop ip_cl_mdl_value lc_cl_mdl_ena c_crlc_cl_mdl c_fac_lam_thd lc_cl_mdl_act lc_fac_lam_grd /end DEF_CHARACTERISTIC
 /begin OUT_MEASUREMENT lv_cl_mdl_act cl_mdl cl_mdl_slop_int state_cl_mdl state_cl_mdl_0 t_cl_mdl_cll_ena t_cl_mdl_act cl_mdl_slop_fac cl_mdl_slop cl_mmv_mem_mdl lv_cl_mdl_ena lv_lam_thd lv_first_lam_thd /end OUT_MEASUREMENT
/end FUNCTION
/begin FUNCTION EVAC_CP_valve_adaptation "Canister_purge_valve_adaptation"
 /begin DEF_CHARACTERISTIC c_cycnr_cps_ad c_cppwm_ad_ratio c_frq_max_mec_cps c_cppwm_max_ad c_fac_lamb_max_cps_ad c_fac_lamb_delta_min_cps_ad c_n_min_cps_ad c_n_max_cps_ad c_tqi_av_max_cps_ad c_tqi_av_min_cps_ad c_cppwm_delta_ad c_cppwm_inc_ad c_cppwm_inc_stop_ad c_t_max_cps_ad c_t_dly_fac_lamb_cppwm_ad c_t_inc_cps_close c_t_wait_cps_ad c_t_wait_lamb_rgn c_frq_min_cps_ad c_cppwm_min_ad c_cppwm_dly_lam c_t_st_cps_ad c_t_ast_deac_cps_ad lc_cps_ad_chk c_frq_clc_1_cps_ad c_frq_clc_2_cps_ad c_cl_min_cps_ad c_flow_clc_dif_cps_ad c_prs_cps_max_cps_ad c_flow_clc_max_cps_ad c_pwm_clc_max_cps_ad c_pwm_clc_dif_cps_ad ldp_prs_cps_ip_cppwm_open_cps ip_cppwm_open_cps /end DEF_CHARACTERISTIC
 /begin OUT_MEASUREMENT cppwm_add_ad_mem frq_cps_ad ctr_cycnr_cps_ad lv_cps_ad_act state_cps_ad state_cps_ad_req cppwm_add_ad ratio_frq ctr_1_cps_ad ctr_2_cps_ad lv_cps_ad_run_cdn_ok lv_err_cps_ad lv_cl_ok_cps_ad lv_ctr_ok_cps_ad lv_cps_ad_st_cdn_ok lv_cps_ok_cps_ad lv_eng_ok_cps_ad lv_t_ok_cps_ad fac_lamb_start_cps_ad fac_flow_cps_ad fac_prs_cps_ad fac_pwm_cps_ad /end OUT_MEASUREMENT
/end FUNCTION
/begin FUNCTION C_8_EVAC "C_8_EVAC" /begin SUB_FUNCTION EVAC_Torque_reserve_for_CP /end SUB_FUNCTION /end FUNCTION
/begin FUNCTION EVAC_Torque_reserve_for_CP "Torque_reserve_for_canister_purge_at_idle"
 /begin DEF_CHARACTERISTIC c_crlc_tq_add_cp lc_tq_add_cp_inh ldp_cl_mmv_ip_tq_add_cp ip_tq_add_cp /end DEF_CHARACTERISTIC
 /begin OUT_MEASUREMENT tq_add_cp /end OUT_MEASUREMENT
/end FUNCTION
/begin FUNCTION C_4_EVAC "C_4_EVAC" /begin SUB_FUNCTION EVAC_emission_control_variables /end SUB_FUNCTION /end FUNCTION
/begin FUNCTION EVAC_emission_control_variables "Evaporative_emission_control_conditions"
 /begin DEF_CHARACTERISTIC c_prs_max_cps c_n_cp_tol c_t_lam_lim_cp c_n_dyw_cp c_n_cp_bol c_n_max_cp c_n_hys_max_cp c_tia_min_cp c_lamb_sp_s_cp_tol c_lamb_sp_s_dyw_cp c_n_2_cp_bol c_n_2_cp_tol c_n_2_dyw_cp c_lamb_sp_s_cp_bol c_fac_lam_cp_bol c_prs_max_cps_2 c_crlc_n_dyw_cp c_crlc_maf_dyw_cp c_crlc_tqi_dyw_cp c_crlc_lam_dyw_cp c_crlc_lamb_sp_s_dyw_cp lc_cp_cll_s_inh lc_cp_cll_inh_man lc_cp_inh_man lc_cp_dyw_clc_ena lc_cp_dyw_lam_ad lc_cp_dyw_clc_max_ena lc_lam_dyw_cp_ini_deac c_fac_lam_cp_dyw c_state_cdn_cp_man c_fac_lam_cp_tol lc_state_cdn_cp_man lc_prs_cps_ext c_t_dly_pu_cps c_dly_n_maf_dyw_cp c_tqi_cp_bol c_tqi_cp_tol c_tqi_dyw_cp c_dly_n_tqi_dyw_cp c_t_dly_lam_cp c_t_dly_cmu_min_s_cp c_state_win_cp_not c_state_lam_lim_cp ip_maf_cp_bol ip_maf_cp_tol ip_t_dly_cmu_cps ip_t_st_ast_tco_st_cps_min ldp_n_32_ip_t_dly_cmu_cps ldp_tco_st_ip_t_st lc_cp_act c_maf_dyw_cp lc_cp_ast_act c_maf_cp_bol_hys /end DEF_CHARACTERISTIC
 /begin OUT_MEASUREMENT n_dyw_cp maf_dyw_cp lv_n_max_cp lv_cp_act lv_lam_out_cp lv_lam_lim_cp lamb_sp_s_dyw_cp lv_cp_close_req lv_cp_dyw lv_cp_win lv_cp_pu lv_cp_cmu_cmb fac_lam_cp_dyw lv_cp_cdn_min_purge_fast tqi_dyw_cp t_dly_dyw_cp prs_cps state_cdn_cp /end OUT_MEASUREMENT
/end FUNCTION
/begin FUNCTION C_A_EVAC "C_A_EVAC" /begin SUB_FUNCTION EVAC_CP_diagnosis EVAC_CP_diagnosis_A_I /end SUB_FUNCTION /end FUNCTION
/begin FUNCTION EVAC_CP_diagnosis "Canister_purge_diagnosis"
 /begin DEF_CHARACTERISTIC c_cppwm_sub_diag_1 c_cppwm_sub_diag_2 c_abc_max_el_cps_diag c_abc_inc_el_cps_diag c_cppwm_diag_min_scp c_cppwm_diag_max_scg c_cppwm_diag_min_oc /end DEF_CHARACTERISTIC
 /begin OUT_MEASUREMENT cppwm_lih lv_err_el_cps /end OUT_MEASUREMENT
/end FUNCTION
/begin FUNCTION EVAC_CP_diagnosis_A_I "Application_Incidence_for_canister_purge_diagnosis" /begin OUT_MEASUREMENT lv_inh_diag_el_cps /end OUT_MEASUREMENT /end FUNCTION
/begin FUNCTION C_7_EGCP "C_7_EGCP"
 /begin DEF_CHARACTERISTIC ldpm_temp_ini_ls_up_1_egcp ldpm_temp_ini_ls_down_1_egcp ldpm_n_32_3_egcp ldpm_vs_1_egcp ldpm_n_32_1_egcp ldpm_n_32_ls_up_dyn ldpm_maf_hb_ls_up_dyn ldpm_teg_dyn_ls_down_1_egcp ldpm_teg_dyn_ls_up_1_egcp /end DEF_CHARACTERISTIC
 /begin SUB_FUNCTION EGCP_Upstream_ls_heat_mng EGCP_Downstream_ls_heat_mng EGCP_Downstream_ls_sig_V EGCP_Downstream_ls_read_det EGCP_ACQ_compensation_WRAF_ls EGCP_Operability_detection_lsl EGCP_WRAF_sensor_control EGCP_WRAF_GAIN_AD_fuel_cut_off EGCP_Air_fuel_cycle_evaluation EGCP_WRAF_GAIN_AD_fuel_cutoff_AI EGCP_A_I_upstream_ls_heater_mng EGCP_A_I_downstream_ls_heat_mng EGCP_Offset_adj_oxygen_sens__AI /end SUB_FUNCTION
/end FUNCTION
/begin FUNCTION EGCP_Upstream_ls_heat_mng "_Upstream_ls_heat_mng"
 /begin DEF_CHARACTERISTIC ip_fac_neg_ctl_p_lsh_up ip_fac_pos_ctl_p_lsh_up ip_fac_pos_ctl_i_lsh_up c_ttip_dif_min_ctl_p_ls_up c_fac_ctl_p_lsh_up ip_v_efc_ini_lsh_up ip_v_efc_ctl_lsh_up ip_t_temp_thd_lsh_up ip_fac_v_efc_teg_lsh_up c_v_efc_inc_lsh_up c_v_efc_dec_lsh_up c_v_efc_red_lsh_up c_v_efc_step_lsh_up c_t_max_v_efc_tol_lsh_up c_t_max_v_efc_lim_lsh_up c_t_max_v_efc_max_st_lsh_up c_t_ast_max_lsh_up c_v_efc_tol_lsh_up c_v_efc_lim_lsh_up c_vb_max_prot_lsh_up c_v_efc_prot_vb_lsh_up c_v_efc_max_lsh_up c_v_efc_max_st_lsh_up c_v_efc_as_lsh_up c_fac_ctl_i_lsh_up c_ttip_sp_ls_up[0] c_ttip_sp_ls_up[1] ldp_vs_ip_fac_v_efc_teg_lsh_up ldp_t_pow_rise_lsh_up_id_ttip ip_fac_neg_ctl_i_lsh_up id_ttip_sp_dif_lsh_up c_teg_dyn_max_lsh_up lc_lsh_ctl_cll_inh_lsh_up[0] lc_lsh_ctl_cll_inh_lsh_up[1] lc_lsh_up_man_act[0] lc_lsh_up_man_act[1] c_fac_v_efc_as_lsh_up c_fac_v_efc_lsh_up_man_act c_v_efc_ini_lsh_up_man_act c_v_efc_max_lsh_up_man_act c_t_max_pow_rise_lsh_up c_t_max_cdn_lsh_up_man_act /end DEF_CHARACTERISTIC
 /begin OUT_MEASUREMENT egcp[0].egcp_struct_acctllsh0.v_efc_ctl_p_lsh_up egcp[0].egcp_struct_acctllsh0.v_efc_ctl_i_lsh_up egcp[0].egcp_struct_acctllsh0.ttip_mes_dif_ls_up egcp[0].egcp_struct_acctllsh0.t_pow_rise_lsh_up egcp[0].egcp_struct_acctllsh0.v_efc_clc_lsh_up egcp[0].egcp_struct_acctllsh0.v_efc_ctl_add_lsh_up egcp[0].egcp_struct_acctllsh0.lshpwm_up egcp[0].egcp_struct_acctllsh0.v_efc_lsh_up egcp[0].egcp_struct_acctllsh0.t_v_efc_tol_lsh_up egcp[0].egcp_struct_acctllsh0.t_v_efc_lim_lsh_up egcp[0].egcp_struct_acctllsh0.state_lsh_up egcp[0].egcp_struct_acctllsh0.lv_lsh_ctl_cll_lsh_up egcp[0].egcp_struct_acctllsh0.lv_v_efc_lim_bol_lsh_up egcp[0].egcp_struct_acctllsh0.lv_v_efc_lim_tol_lsh_up egcp[0].egcp_struct_acctllsh0.lv_v_efc_lim_max_lsh_up egcp[0].egcp_struct_acctllsh0.lv_v_efc_lim_prot_vb_lsh_up egcp[0].egcp_struct_acctllsh0.lv_lsh_up_man_act egcp[1].egcp_struct_acctllsh0.v_efc_ctl_p_lsh_up egcp[1].egcp_struct_acctllsh0.v_efc_ctl_i_lsh_up egcp[1].egcp_struct_acctllsh0.ttip_mes_dif_ls_up egcp[1].egcp_struct_acctllsh0.t_pow_rise_lsh_up egcp[1].egcp_struct_acctllsh0.v_efc_clc_lsh_up egcp[1].egcp_struct_acctllsh0.v_efc_ctl_add_lsh_up egcp[1].egcp_struct_acctllsh0.lshpwm_up egcp[1].egcp_struct_acctllsh0.v_efc_lsh_up egcp[1].egcp_struct_acctllsh0.t_v_efc_tol_lsh_up egcp[1].egcp_struct_acctllsh0.t_v_efc_lim_lsh_up egcp[1].egcp_struct_acctllsh0.state_lsh_up egcp[1].egcp_struct_acctllsh0.lv_lsh_ctl_cll_lsh_up egcp[1].egcp_struct_acctllsh0.lv_v_efc_lim_bol_lsh_up egcp[1].egcp_struct_acctllsh0.lv_v_efc_lim_tol_lsh_up egcp[1].egcp_struct_acctllsh0.lv_v_efc_lim_max_lsh_up egcp[1].egcp_struct_acctllsh0.lv_v_efc_lim_prot_vb_lsh_up egcp[1].egcp_struct_acctllsh0.lv_lsh_up_man_act /end OUT_MEASUREMENT
/end FUNCTION
/begin FUNCTION EGCP_Downstream_ls_heat_mng "_Downstream_ls_heat_mng"
 /begin DEF_CHARACTERISTIC ip_v_efc_ini_lsh_down ip_v_efc_ctl_lsh_down ip_t_temp_thd_lsh_down ip_fac_v_efc_teg_lsh_down c_v_efc_inc_lsh_down c_v_efc_dec_lsh_down c_v_efc_red_lsh_down c_v_efc_step_lsh_down c_t_max_pow_rise_lsh_down c_t_max_v_efc_tol_lsh_down c_t_max_v_efc_lim_lsh_down c_t_max_v_efc_max_st_lsh_down c_t_ast_max_lsh_down c_v_efc_tol_lsh_down c_v_efc_lim_lsh_down c_vb_max_prot_lsh_down c_v_efc_prot_vb_lsh_down c_v_efc_max_lsh_down c_v_efc_max_st_lsh_down c_v_efc_as_lsh_down c_teg_dyn_max_lsh_down c_fac_v_efc_as_lsh_down /end DEF_CHARACTERISTIC
 /begin OUT_MEASUREMENT egcp[0].egcp_struct_acctllshd0.t_pow_rise_lsh_down egcp[0].egcp_struct_acctllshd0.v_efc_clc_lsh_down egcp[0].egcp_struct_acctllshd0.v_efc_lsh_down egcp[0].egcp_struct_acctllshd0.lshpwm_down egcp[0].egcp_struct_acctllshd0.t_v_efc_tol_lsh_down egcp[0].egcp_struct_acctllshd0.lv_v_efc_lim_bol_lsh_down egcp[0].egcp_struct_acctllshd0.t_v_efc_lim_lsh_down egcp[0].egcp_struct_acctllshd0.state_lsh_down egcp[0].egcp_struct_acctllshd0.lv_v_efc_lim_tol_lsh_down egcp[0].egcp_struct_acctllshd0.lv_v_efc_lim_max_lsh_down egcp[0].egcp_struct_acctllshd0.lv_v_efc_lim_prot_vb_lsh_down egcp[1].egcp_struct_acctllshd0.t_pow_rise_lsh_down egcp[1].egcp_struct_acctllshd0.v_efc_clc_lsh_down egcp[1].egcp_struct_acctllshd0.v_efc_lsh_down egcp[1].egcp_struct_acctllshd0.lshpwm_down egcp[1].egcp_struct_acctllshd0.t_v_efc_tol_lsh_down egcp[1].egcp_struct_acctllshd0.lv_v_efc_lim_bol_lsh_down egcp[1].egcp_struct_acctllshd0.t_v_efc_lim_lsh_down egcp[1].egcp_struct_acctllshd0.state_lsh_down egcp[1].egcp_struct_acctllshd0.lv_v_efc_lim_tol_lsh_down egcp[1].egcp_struct_acctllshd0.lv_v_efc_lim_max_lsh_down egcp[1].egcp_struct_acctllshd0.lv_v_efc_lim_prot_vb_lsh_down /end OUT_MEASUREMENT
/end FUNCTION
/begin FUNCTION EGCP_Downstream_ls_sig_V "_Downstream_ls_sig_V"
 /begin DEF_CHARACTERISTIC c_t_dly_puc_end_vls_down c_fac_vls_down_mmv_hys c_vls_down_mmv_hys_min c_vls_down_ini_min c_vls_down_ini_max c_crlc_vls_down c_crlc_vls_down_off /end DEF_CHARACTERISTIC
 /begin OUT_MEASUREMENT egcp[0].egcp_struct_sigcvlsd0.vls_down_drv1_mmv egcp[0].egcp_struct_sigcvlsd0.vls_down_drv1_mmv_min egcp[0].egcp_struct_sigcvlsd0.vls_down_drv1_abs_max egcp[0].egcp_struct_sigcvlsd0.vls_down_mmv_min egcp[0].egcp_struct_sigcvlsd0.vls_down_mmv_max egcp[0].egcp_struct_sigcvlsd0.vls_down_bol egcp[0].egcp_struct_sigcvlsd0.vls_down_tol egcp[0].egcp_struct_sigcvlsd0.vls_down_mmv_hys egcp[0].egcp_struct_sigcvlsd0.lv_vls_down_mmv_lim egcp[1].egcp_struct_sigcvlsd0.vls_down_drv1_mmv egcp[1].egcp_struct_sigcvlsd0.vls_down_drv1_mmv_min egcp[1].egcp_struct_sigcvlsd0.vls_down_drv1_abs_max egcp[1].egcp_struct_sigcvlsd0.vls_down_mmv_min egcp[1].egcp_struct_sigcvlsd0.vls_down_mmv_max egcp[1].egcp_struct_sigcvlsd0.vls_down_bol egcp[1].egcp_struct_sigcvlsd0.vls_down_tol egcp[1].egcp_struct_sigcvlsd0.vls_down_mmv_hys egcp[1].egcp_struct_sigcvlsd0.lv_vls_down_mmv_lim lv_vls_down_mmv_act /end OUT_MEASUREMENT
/end FUNCTION
/begin FUNCTION EGCP_Downstream_ls_read_det "_Downstream_ls_read_det"
 /begin DEF_CHARACTERISTIC c_vls_down_afl_thd_ready c_vls_down_afr_thd_ready c_maf_int_puc_max_down_ls_ready c_teg_dyn_min_ls_down_ready c_t_min_temp_dew_ls_down /end DEF_CHARACTERISTIC
 /begin OUT_MEASUREMENT egcp[0].egcp_struct_dtsyslsd0.t_temp_dew_ls_down egcp[0].egcp_struct_dtsyslsd0.lv_ls_down_ready egcp[1].egcp_struct_dtsyslsd0.t_temp_dew_ls_down egcp[1].egcp_struct_dtsyslsd0.lv_ls_down_ready /end OUT_MEASUREMENT
/end FUNCTION
/begin FUNCTION EGCP_ACQ_compensation_WRAF_ls "_ACQ_compensation_WRAF_ls"
 /begin DEF_CHARACTERISTIC c_lamb_ls_up_min_ofs_adj c_vls_ofs_sp_lsl c_t_dly_lamb_sti_off_ofs_adj c_iplsl_gain c_t_dly_lsl_ofs_adj c_t_dly_lsl_ofs_adj_is ldp_vls_cor_mv_ip_lamb_ls_up ldp_vls_cor_mv_ip_lamb_l_gain ip_lamb_ls_up ip_lamb_ls_up_l_gain c_t_wait_lsl_ofs_adj c_t_wait_lsl_ofs_adj_red c_nr_cyc_t_wait_lsl_ofs_adj_red c_crlc_vls_up_ofs_adj c_crlc_vls_up_ofs_adj_l_gain c_vls_ofs_dif_ok_lsl c_vls_ofs_dif_ok_lsl_l_gain c_vls_ofs_max_absv_lsl c_vls_ofs_max_absv_lsl_l_gain lc_lsl_ofs_adj_ena lc_cat_diag_act_wait lc_lamb_pls_act_neut lc_ctr_err_lsl_if_save_man_inc c_lamb_ls_up_max_ofs_adj c_lamb_ls_up_gain_swi_min c_lamb_ls_up_gain_swi_max c_lamb_ls_up_vls_up_h_gain_min c_lamb_ls_up_vls_up_h_gain_max lc_vls_cor_mv_lsl_act lc_lsl_ofs_adj_h_l_gain lc_lsl_ofs_adj_gain_sel lc_iplsl_gain_swi_act ldpm_prs_ex_ip_fac_cor_iplsl ip_fac_cor_iplsl_prs_ex ip_fac_cor_iplsl_afr_prs_ex ip_fac_cor_iplsl_ttip_ls_up ldp_ttip_ls_up_ip_fac_cor_iplsl c_t_dly_lsl_ofs_adj_puc_end /end DEF_CHARACTERISTIC
 /begin OUT_MEASUREMENT lamb_ls_up_mv lamb_ls_up_min egcp[0].egcp_struct_adcprlsl1.vls_delta_tmp_lsl egcp[0].egcp_struct_adcprlsl1.vls_ofs_tmp_lsl egcp[0].egcp_struct_adcprlsl1.vls_ofs_tmp_old_lsl egcp[0].egcp_struct_adcprlsl1.vls_ofs_lsl_l_gain egcp[0].egcp_struct_adcprlsl1.vls_ofs_tmp_old_lsl_l_gain egcp[0].egcp_struct_adcprlsl1.vls_ofs_lsl egcp[0].egcp_struct_adcprlsl1.vls_up_diag egcp[0].egcp_struct_adcprlsl1.iplsl_cor egcp[0].egcp_struct_adcprlsl1.vls_mv_lsl_buf egcp[0].egcp_struct_adcprlsl1.t_wait_lsl_ofs_adj egcp[0].egcp_struct_adcprlsl1.t_dly_lamb_sti_off_ofs_adj egcp[0].egcp_struct_adcprlsl1.vls_cor_h_res_lsl egcp[0].egcp_struct_adcprlsl1.vls_mv_lsl egcp[0].egcp_struct_adcprlsl1.vls_mmv_lsl egcp[0].egcp_struct_adcprlsl1.vls_mmv_lsl_l_gain egcp[0].egcp_struct_adcprlsl1.vls_cor_mv_lsl egcp[0].egcp_struct_adcprlsl1.vls_cor_tmp_lsl egcp[0].egcp_struct_adcprlsl1.lamb_ls_up egcp[0].egcp_struct_adcprlsl1.vls_cor_lsl egcp[0].egcp_struct_adcprlsl1.vls_cor_lsl_h_gain egcp[0].egcp_struct_adcprlsl1.t_dly_lsl_ofs_adj_puc_end egcp[0].egcp_struct_adcprlsl1.ctr_vls_mv_lsl_nr_sample egcp[0].egcp_struct_adcprlsl1.ctr_cyc_t_wait_ofs_adj_red egcp[0].egcp_struct_adcprlsl1.ctr_err_lsl_if_spi_ofs_adj_save egcp[0].egcp_struct_adcprlsl1.state_lsl_ofs_adj egcp[0].egcp_struct_adcprlsl1.t_dly_lsl_ofs_adj egcp[0].egcp_struct_adcprlsl1.t_dly_lsl_ofs_adj_is egcp[0].egcp_struct_adcprlsl1.lv_lsl_ofs_adj_act egcp[0].egcp_struct_adcprlsl1.lv_lsl_ofs_act_ast egcp[0].egcp_struct_adcprlsl1.lv_lamb_sti_off_lsl_ofs_adj egcp[0].egcp_struct_adcprlsl1.lv_lsl_ofs_adj_is egcp[0].egcp_struct_adcprlsl1.lv_vls_ofs_lim_lsl egcp[0].egcp_struct_adcprlsl1.lv_vls_ofs_adj_ena_lsl_if egcp[0].egcp_struct_adcprlsl1.lv_lamb_pls_swi_off egcp[0].egcp_struct_adcprlsl1.lv_swi_clc_lsl_ofs_adj egcp[0].egcp_struct_adcprlsl1.lv_vls_ofs_lim_lsl_l_gain egcp[0].egcp_struct_adcprlsl1.lv_swi_gain_lsl_if egcp[1].egcp_struct_adcprlsl1.vls_delta_tmp_lsl egcp[1].egcp_struct_adcprlsl1.vls_ofs_tmp_lsl egcp[1].egcp_struct_adcprlsl1.vls_ofs_tmp_old_lsl egcp[1].egcp_struct_adcprlsl1.vls_ofs_lsl_l_gain egcp[1].egcp_struct_adcprlsl1.vls_ofs_tmp_old_lsl_l_gain egcp[1].egcp_struct_adcprlsl1.vls_ofs_lsl egcp[1].egcp_struct_adcprlsl1.vls_up_diag egcp[1].egcp_struct_adcprlsl1.iplsl_cor egcp[1].egcp_struct_adcprlsl1.vls_mv_lsl_buf egcp[1].egcp_struct_adcprlsl1.t_wait_lsl_ofs_adj egcp[1].egcp_struct_adcprlsl1.t_dly_lamb_sti_off_ofs_adj egcp[1].egcp_struct_adcprlsl1.vls_cor_h_res_lsl egcp[1].egcp_struct_adcprlsl1.vls_mv_lsl egcp[1].egcp_struct_adcprlsl1.vls_mmv_lsl egcp[1].egcp_struct_adcprlsl1.vls_mmv_lsl_l_gain egcp[1].egcp_struct_adcprlsl1.vls_cor_mv_lsl egcp[1].egcp_struct_adcprlsl1.vls_cor_tmp_lsl egcp[1].egcp_struct_adcprlsl1.lamb_ls_up egcp[1].egcp_struct_adcprlsl1.vls_cor_lsl egcp[1].egcp_struct_adcprlsl1.vls_cor_lsl_h_gain egcp[1].egcp_struct_adcprlsl1.t_dly_lsl_ofs_adj_puc_end egcp[1].egcp_struct_adcprlsl1.ctr_vls_mv_lsl_nr_sample egcp[1].egcp_struct_adcprlsl1.ctr_cyc_t_wait_ofs_adj_red egcp[1].egcp_struct_adcprlsl1.ctr_err_lsl_if_spi_ofs_adj_save egcp[1].egcp_struct_adcprlsl1.state_lsl_ofs_adj egcp[1].egcp_struct_adcprlsl1.t_dly_lsl_ofs_adj egcp[1].egcp_struct_adcprlsl1.t_dly_lsl_ofs_adj_is egcp[1].egcp_struct_adcprlsl1.lv_lsl_ofs_adj_act egcp[1].egcp_struct_adcprlsl1.lv_lsl_ofs_act_ast egcp[1].egcp_struct_adcprlsl1.lv_lamb_sti_off_lsl_ofs_adj egcp[1].egcp_struct_adcprlsl1.lv_lsl_ofs_adj_is egcp[1].egcp_struct_adcprlsl1.lv_vls_ofs_lim_lsl egcp[1].egcp_struct_adcprlsl1.lv_vls_ofs_adj_ena_lsl_if egcp[1].egcp_struct_adcprlsl1.lv_lamb_pls_swi_off egcp[1].egcp_struct_adcprlsl1.lv_swi_clc_lsl_ofs_adj egcp[1].egcp_struct_adcprlsl1.lv_vls_ofs_lim_lsl_l_gain egcp[1].egcp_struct_adcprlsl1.lv_swi_gain_lsl_if /end OUT_MEASUREMENT
/end FUNCTION
/begin FUNCTION EGCP_Operability_detection_lsl "_Operability_detection_lsl"
 /begin DEF_CHARACTERISTIC c_crlc_lamb_ls_up_ready c_lamb_de_int_thd_ls_up_ready c_ttip_min_ls_up_ready c_lamb_thd_max_ls_up_ready c_lamb_thd_min_ls_up_ready c_t_lamb_de_int_rst c_maf_int_puc_max_ls_up_ready ldp_tco_st_id_t_dly_chk_ls_up ldp_tco_st_id_t_tout_ls_up id_t_dly_chk_ls_up_ready id_t_tout_ls_up_ready c_t_dly_ls_up_ready_teg_min lc_teg_min_thd_deac_test lc_teg_min_deac /end DEF_CHARACTERISTIC
 /begin OUT_MEASUREMENT egcp[0].egcp_struct_dtsyslsl0.lamb_de_int_ls_up_ready egcp[0].egcp_struct_dtsyslsl0.t_tout_ls_up_ready egcp[0].egcp_struct_dtsyslsl0.t_dly_chk_ls_up_ready egcp[0].egcp_struct_dtsyslsl0.t_lamb_de_int_rst egcp[0].egcp_struct_dtsyslsl0.lamb_mv_ls_up_ready egcp[0].egcp_struct_dtsyslsl0.t_dly_ls_up_ready_teg_min egcp[0].egcp_struct_dtsyslsl0.lv_ls_up_ready egcp[0].egcp_struct_dtsyslsl0.lv_ls_up_ready_cdn egcp[0].egcp_struct_dtsyslsl0.lv_ls_up_ready_raw egcp[0].egcp_struct_dtsyslsl0.lv_teg_min_dly egcp[1].egcp_struct_dtsyslsl0.lamb_de_int_ls_up_ready egcp[1].egcp_struct_dtsyslsl0.t_tout_ls_up_ready egcp[1].egcp_struct_dtsyslsl0.t_dly_chk_ls_up_ready egcp[1].egcp_struct_dtsyslsl0.t_lamb_de_int_rst egcp[1].egcp_struct_dtsyslsl0.lamb_mv_ls_up_ready egcp[1].egcp_struct_dtsyslsl0.t_dly_ls_up_ready_teg_min egcp[1].egcp_struct_dtsyslsl0.lv_ls_up_ready egcp[1].egcp_struct_dtsyslsl0.lv_ls_up_ready_cdn egcp[1].egcp_struct_dtsyslsl0.lv_ls_up_ready_raw egcp[1].egcp_struct_dtsyslsl0.lv_teg_min_dly /end OUT_MEASUREMENT
/end FUNCTION
/end MODULE
/end PROJECT
