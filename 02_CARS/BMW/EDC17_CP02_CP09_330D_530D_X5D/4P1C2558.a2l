ASAP2_VERSION 1 4
/begin PROJECT P_558 "EDC17_CP02"
/begin HEADER "" VERSION "V1C1" PROJECT_NO P_558 /end HEADER
/begin MODULE DIM ""
/begin MOD_COMMON "" BYTE_ORDER MSB_LAST ALIGNMENT_BYTE 1 ALIGNMENT_WORD 2 ALIGNMENT_LONG 4 ALIGNMENT_FLOAT32_IEEE 4 /end MOD_COMMON
/begin CHARACTERISTIC DFC_DisblMsk.DFC_AirCtlGovDvtEOMMax_C "/" VALUE 0x80071A00 Val_Wu16 65535.00 DFES_OneToOne 0.00 65535.00 FORMAT "%8.2" /end CHARACTERISTIC
/begin CHARACTERISTIC DFC_DisblMsk.DFC_AirCtlGovDvtEOMMin_C "/" VALUE 0x80071A02 Val_Wu16 65535.00 DFES_OneToOne 0.00 65535.00 FORMAT "%8.2" /end CHARACTERISTIC
/begin CHARACTERISTIC DFC_DisblMsk.DFC_AirCtlGovDvtMax_C "/" VALUE 0x80071A04 Val_Wu16 65535.00 DFES_OneToOne 0.00 65535.00 FORMAT "%8.2" /end CHARACTERISTIC
/begin CHARACTERISTIC DFC_DisblMsk.DFC_AirCtlGovDvtMin_C "/" VALUE 0x80071A06 Val_Wu16 65535.00 DFES_OneToOne 0.00 65535.00 FORMAT "%8.2" /end CHARACTERISTIC
/begin CHARACTERISTIC DFC_DisblMsk.DFC_Cj945SpiCom1_C "/" VALUE 0x80071A08 Val_Wu16 65535.00 DFES_OneToOne 0.00 65535.00 FORMAT "%8.2" /end CHARACTERISTIC
/begin CHARACTERISTIC DFC_DisblMsk.DFC_ComButtonMSASig_C "/" VALUE 0x80071A0A Val_Wu16 65535.00 DFES_OneToOne 0.00 65535.00 FORMAT "%8.2" /end CHARACTERISTIC
/begin CHARACTERISTIC DFC_DisblMsk.DFC_ComButtonMSATo_C "/" VALUE 0x80071A0C Val_Wu16 65535.00 DFES_OneToOne 0.00 65535.00 FORMAT "%8.2" /end CHARACTERISTIC
/begin CHARACTERISTIC DFC_DisblMsk.DFC_ComGearboxData2Sig_C "/" VALUE 0x80071A0E Val_Wu16 65535.00 DFES_OneToOne 0.00 65535.00 FORMAT "%8.2" /end CHARACTERISTIC
/begin CHARACTERISTIC DFC_DisblMsk.DFC_ComGearboxData2To_C "/" VALUE 0x80071A10 Val_Wu16 65535.00 DFES_OneToOne 0.00 65535.00 FORMAT "%8.2" /end CHARACTERISTIC
/begin CHARACTERISTIC DFC_DisblMsk.DFC_ComGearboxDataSig_C "/" VALUE 0x80071A12 Val_Wu16 65535.00 DFES_OneToOne 0.00 65535.00 FORMAT "%8.2" /end CHARACTERISTIC
/begin CHARACTERISTIC DFC_DisblMsk.DFC_ComGearboxDataTo_C "/" VALUE 0x80071A14 Val_Wu16 65535.00 DFES_OneToOne 0.00 65535.00 FORMAT "%8.2" /end CHARACTERISTIC
/begin CHARACTERISTIC DFC_DisblMsk.DFC_ComHeatACSig_C "/" VALUE 0x80071A16 Val_Wu16 65535.00 DFES_OneToOne 0.00 65535.00 FORMAT "%8.2" /end CHARACTERISTIC
/begin CHARACTERISTIC DFC_DisblMsk.DFC_ComHeatACTo_C "/" VALUE 0x80071A18 Val_Wu16 65535.00 DFES_OneToOne 0.00 65535.00 FORMAT "%8.2" /end CHARACTERISTIC
/begin CHARACTERISTIC DFC_DisblMsk.DFC_ComLenkradwinkelSig_C "/" VALUE 0x80071A1A Val_Wu16 65535.00 DFES_OneToOne 0.00 65535.00 FORMAT "%8.2" /end CHARACTERISTIC
/begin CHARACTERISTIC DFC_DisblMsk.DFC_ComLenkradwinkelTo_C "/" VALUE 0x80071A1C Val_Wu16 65535.00 DFES_OneToOne 0.00 65535.00 FORMAT "%8.2" /end CHARACTERISTIC
/begin CHARACTERISTIC DFC_DisblMsk.DFC_ComMileageRangeSig_C "/" VALUE 0x80071A1E Val_Wu16 65535.00 DFES_OneToOne 0.00 65535.00 FORMAT "%8.2" /end CHARACTERISTIC
/begin CHARACTERISTIC DFC_DisblMsk.DFC_ComMileageRangeTo_C "/" VALUE 0x80071A20 Val_Wu16 65535.00 DFES_OneToOne 0.00 65535.00 FORMAT "%8.2" /end CHARACTERISTIC
/begin CHARACTERISTIC DFC_DisblMsk.DFC_ComPspSig_C "/" VALUE 0x80071A22 Val_Wu16 65535.00 DFES_OneToOne 0.00 65535.00 FORMAT "%8.2" /end CHARACTERISTIC
/begin CHARACTERISTIC DFC_DisblMsk.DFC_ComPspTo_C "/" VALUE 0x80071A24 Val_Wu16 65535.00 DFES_OneToOne 0.00 65535.00 FORMAT "%8.2" /end CHARACTERISTIC
/begin CHARACTERISTIC DFC_DisblMsk.DFC_ComShutOffPSPSig_C "/" VALUE 0x80071A26 Val_Wu16 65535.00 DFES_OneToOne 0.00 65535.00 FORMAT "%8.2" /end CHARACTERISTIC
/begin CHARACTERISTIC DFC_DisblMsk.DFC_ComShutOffPSPTo_C "/" VALUE 0x80071A28 Val_Wu16 65535.00 DFES_OneToOne 0.00 65535.00 FORMAT "%8.2" /end CHARACTERISTIC
/begin CHARACTERISTIC DFC_DisblMsk.DFC_ComStKombiCtr_C "/" VALUE 0x80071A2A Val_Wu16 65535.00 DFES_OneToOne 0.00 65535.00 FORMAT "%8.2" /end CHARACTERISTIC
/begin CHARACTERISTIC DFC_DisblMsk.DFC_ComStKombiSig_C "/" VALUE 0x80071A2C Val_Wu16 65535.00 DFES_OneToOne 0.00 65535.00 FORMAT "%8.2" /end CHARACTERISTIC
/begin CHARACTERISTIC DFC_DisblMsk.DFC_ComStKombiTo_C "/" VALUE 0x80071A2E Val_Wu16 65535.00 DFES_OneToOne 0.00 65535.00 FORMAT "%8.2" /end CHARACTERISTIC
/begin CHARACTERISTIC DFC_DisblMsk.DFC_ComStateARSCtr_C "/" VALUE 0x80071A30 Val_Wu16 65535.00 DFES_OneToOne 0.00 65535.00 FORMAT "%8.2" /end CHARACTERISTIC
/begin CHARACTERISTIC DFC_DisblMsk.DFC_ComStateARSSig_C "/" VALUE 0x80071A32 Val_Wu16 65535.00 DFES_OneToOne 0.00 65535.00 FORMAT "%8.2" /end CHARACTERISTIC
/begin CHARACTERISTIC DFC_DisblMsk.DFC_ComStateARSTo_C "/" VALUE 0x80071A34 Val_Wu16 65535.00 DFES_OneToOne 0.00 65535.00 FORMAT "%8.2" /end CHARACTERISTIC
/begin CHARACTERISTIC DFC_DisblMsk.DFC_ComStateDscSig_C "/" VALUE 0x80071A36 Val_Wu16 65535.00 DFES_OneToOne 0.00 65535.00 FORMAT "%8.2" /end CHARACTERISTIC
/begin CHARACTERISTIC DFC_DisblMsk.DFC_ComStateDscTo_C "/" VALUE 0x80071A38 Val_Wu16 65535.00 DFES_OneToOne 0.00 65535.00 FORMAT "%8.2" /end CHARACTERISTIC
/begin CHARACTERISTIC DFC_DisblMsk.DFC_ComStateSeatSig_C "/" VALUE 0x80071A3A Val_Wu16 65535.00 DFES_OneToOne 0.00 65535.00 FORMAT "%8.2" /end CHARACTERISTIC
/begin CHARACTERISTIC DFC_DisblMsk.DFC_ComStateSeatTo_C "/" VALUE 0x80071A3C Val_Wu16 65535.00 DFES_OneToOne 0.00 65535.00 FORMAT "%8.2" /end CHARACTERISTIC
/begin CHARACTERISTIC DFC_DisblMsk.DFC_ComTempRelTimeSig_C "/" VALUE 0x80071A3E Val_Wu16 65535.00 DFES_OneToOne 0.00 65535.00 FORMAT "%8.2" /end CHARACTERISTIC
/begin CHARACTERISTIC DFC_DisblMsk.DFC_ComTempRelTimeTo_C "/" VALUE 0x80071A40 Val_Wu16 65535.00 DFES_OneToOne 0.00 65535.00 FORMAT "%8.2" /end CHARACTERISTIC
/begin CHARACTERISTIC DFC_DisblMsk.DFC_ComTerminalChk_C "/" VALUE 0x80071A42 Val_Wu16 65535.00 DFES_OneToOne 0.00 65535.00 FORMAT "%8.2" /end CHARACTERISTIC
/begin CHARACTERISTIC DFC_DisblMsk.DFC_ComTerminalCtr_C "/" VALUE 0x80071A44 Val_Wu16 65535.00 DFES_OneToOne 0.00 65535.00 FORMAT "%8.2" /end CHARACTERISTIC
/begin CHARACTERISTIC DFC_DisblMsk.DFC_ComTerminalSig_C "/" VALUE 0x80071A46 Val_Wu16 65535.00 DFES_OneToOne 0.00 65535.00 FORMAT "%8.2" /end CHARACTERISTIC
/begin CHARACTERISTIC DFC_DisblMsk.DFC_ComTerminalTo_C "/" VALUE 0x80071A48 Val_Wu16 65535.00 DFES_OneToOne 0.00 65535.00 FORMAT "%8.2" /end CHARACTERISTIC
/begin CHARACTERISTIC DFC_DisblMsk.DFC_ComTimeDateSig_C "/" VALUE 0x80071A4A Val_Wu16 65535.00 DFES_OneToOne 0.00 65535.00 FORMAT "%8.2" /end CHARACTERISTIC
/begin CHARACTERISTIC DFC_DisblMsk.DFC_ComTimeDateTo_C "/" VALUE 0x80071A4C Val_Wu16 65535.00 DFES_OneToOne 0.00 65535.00 FORMAT "%8.2" /end CHARACTERISTIC
/begin CHARACTERISTIC DFC_DisblMsk.DFC_ComTrailerSig_C "/" VALUE 0x80071A4E Val_Wu16 65535.00 DFES_OneToOne 0.00 65535.00 FORMAT "%8.2" /end CHARACTERISTIC
/begin CHARACTERISTIC DFC_DisblMsk.DFC_ComTrailerTo_C "/" VALUE 0x80071A50 Val_Wu16 65535.00 DFES_OneToOne 0.00 65535.00 FORMAT "%8.2" /end CHARACTERISTIC
/begin CHARACTERISTIC DFC_DisblMsk.DFC_ComTrqDemandAfsChk_C "/" VALUE 0x80071A52 Val_Wu16 65535.00 DFES_OneToOne 0.00 65535.00 FORMAT "%8.2" /end CHARACTERISTIC
/begin CHARACTERISTIC DFC_DisblMsk.DFC_ComTrqDemandAfsCtr_C "/" VALUE 0x80071A54 Val_Wu16 65535.00 DFES_OneToOne 0.00 65535.00 FORMAT "%8.2" /end CHARACTERISTIC
/begin CHARACTERISTIC DFC_DisblMsk.DFC_ComTrqDemandAfsSig_C "/" VALUE 0x80071A56 Val_Wu16 65535.00 DFES_OneToOne 0.00 65535.00 FORMAT "%8.2" /end CHARACTERISTIC
/begin CHARACTERISTIC DFC_DisblMsk.DFC_ComTrqDemandAfsTo_C "/" VALUE 0x80071A58 Val_Wu16 65535.00 DFES_OneToOne 0.00 65535.00 FORMAT "%8.2" /end CHARACTERISTIC
/begin CHARACTERISTIC DFC_DisblMsk.DFC_ComTrqDemandDscChk_C "/" VALUE 0x80071A5A Val_Wu16 65535.00 DFES_OneToOne 0.00 65535.00 FORMAT "%8.2" /end CHARACTERISTIC
/begin CHARACTERISTIC DFC_DisblMsk.DFC_ComTrqDemandDscCtr_C "/" VALUE 0x80071A5C Val_Wu16 65535.00 DFES_OneToOne 0.00 65535.00 FORMAT "%8.2" /end CHARACTERISTIC
/begin CHARACTERISTIC DFC_DisblMsk.DFC_ComTrqDemandDscSig_C "/" VALUE 0x80071A5E Val_Wu16 65535.00 DFES_OneToOne 0.00 65535.00 FORMAT "%8.2" /end CHARACTERISTIC
/begin CHARACTERISTIC DFC_DisblMsk.DFC_ComTrqDemandDscTo_C "/" VALUE 0x80071A60 Val_Wu16 65535.00 DFES_OneToOne 0.00 65535.00 FORMAT "%8.2" /end CHARACTERISTIC
/begin CHARACTERISTIC DFC_DisblMsk.DFC_ComTrqDemandGbxChk_C "/" VALUE 0x80071A62 Val_Wu16 65535.00 DFES_OneToOne 0.00 65535.00 FORMAT "%8.2" /end CHARACTERISTIC
/begin CHARACTERISTIC DFC_DisblMsk.DFC_ComTrqDemandGbxCtr_C "/" VALUE 0x80071A64 Val_Wu16 65535.00 DFES_OneToOne 0.00 65535.00 FORMAT "%8.2" /end CHARACTERISTIC
/begin CHARACTERISTIC DFC_DisblMsk.DFC_ComTrqDemandGbxSig_C "/" VALUE 0x80071A66 Val_Wu16 65535.00 DFES_OneToOne 0.00 65535.00 FORMAT "%8.2" /end CHARACTERISTIC
/begin CHARACTERISTIC DFC_DisblMsk.DFC_ComTrqDemandGbxTo_C "/" VALUE 0x80071A68 Val_Wu16 65535.00 DFES_OneToOne 0.00 65535.00 FORMAT "%8.2" /end CHARACTERISTIC
/begin CHARACTERISTIC DFC_DisblMsk.DFC_ComVelocitySig_C "/" VALUE 0x80071A6A Val_Wu16 65535.00 DFES_OneToOne 0.00 65535.00 FORMAT "%8.2" /end CHARACTERISTIC
/begin CHARACTERISTIC DFC_DisblMsk.DFC_ComVelocityTo_C "/" VALUE 0x80071A6C Val_Wu16 65535.00 DFES_OneToOne 0.00 65535.00 FORMAT "%8.2" /end CHARACTERISTIC
/begin CHARACTERISTIC DFC_DisblMsk.DFC_ComWheelSpeedSig_C "/" VALUE 0x80071A6E Val_Wu16 65535.00 DFES_OneToOne 0.00 65535.00 FORMAT "%8.2" /end CHARACTERISTIC
/begin CHARACTERISTIC DFC_DisblMsk.DFC_ComWheelSpeedTo_C "/" VALUE 0x80071A70 Val_Wu16 65535.00 DFES_OneToOne 0.00 65535.00 FORMAT "%8.2" /end CHARACTERISTIC
/begin CHARACTERISTIC DFC_DisblMsk.DFC_ComZvKlappenSig_C "/" VALUE 0x80071A72 Val_Wu16 65535.00 DFES_OneToOne 0.00 65535.00 FORMAT "%8.2" /end CHARACTERISTIC
/begin CHARACTERISTIC DFC_DisblMsk.DFC_ComZvKlappenTo_C "/" VALUE 0x80071A74 Val_Wu16 65535.00 DFES_OneToOne 0.00 65535.00 FORMAT "%8.2" /end CHARACTERISTIC
/begin CHARACTERISTIC DFC_DisblMsk.DFC_Cy150SpiCom_C "/" VALUE 0x80071A76 Val_Wu16 65535.00 DFES_OneToOne 0.00 65535.00 FORMAT "%8.2" /end CHARACTERISTIC
/begin CHARACTERISTIC DFC_DisblMsk.DFC_Cy320SpiCom_C "/" VALUE 0x80071A78 Val_Wu16 65535.00 DFES_OneToOne 0.00 65535.00 FORMAT "%8.2" /end CHARACTERISTIC
/begin CHARACTERISTIC DFC_DisblMsk.DFC_ETCtlDvtInrMax_C "/" VALUE 0x80071A7A Val_Wu16 65535.00 DFES_OneToOne 0.00 65535.00 FORMAT "%8.2" /end CHARACTERISTIC
/begin CHARACTERISTIC DFC_DisblMsk.DFC_ETCtlDvtInrMin_C "/" VALUE 0x80071A7C Val_Wu16 65535.00 DFES_OneToOne 0.00 65535.00 FORMAT "%8.2" /end CHARACTERISTIC
/begin CHARACTERISTIC DFC_DisblMsk.DFC_ETCtlDvtOutrMax_C "/" VALUE 0x80071A7E Val_Wu16 65535.00 DFES_OneToOne 0.00 65535.00 FORMAT "%8.2" /end CHARACTERISTIC
/begin CHARACTERISTIC DFC_DisblMsk.DFC_ETCtlDvtOutrMin_C "/" VALUE 0x80071A80 Val_Wu16 65535.00 DFES_OneToOne 0.00 65535.00 FORMAT "%8.2" /end CHARACTERISTIC
/begin CHARACTERISTIC DFC_DisblMsk.DFC_Fan4WinErr1_C "/" VALUE 0x80071A82 Val_Wu16 65535.00 DFES_OneToOne 0.00 65535.00 FORMAT "%8.2" /end CHARACTERISTIC
/begin CHARACTERISTIC DFC_DisblMsk.DFC_Fan4WinErr2_C "/" VALUE 0x80071A84 Val_Wu16 65535.00 DFES_OneToOne 0.00 65535.00 FORMAT "%8.2" /end CHARACTERISTIC
/begin CHARACTERISTIC DFC_DisblMsk.DFC_Fan4WinErr3_C "/" VALUE 0x80071A86 Val_Wu16 65535.00 DFES_OneToOne 0.00 65535.00 FORMAT "%8.2" /end CHARACTERISTIC
/begin CHARACTERISTIC DFC_DisblMsk.DFC_Fan4WinErr4_C "/" VALUE 0x80071A88 Val_Wu16 65535.00 DFES_OneToOne 0.00 65535.00 FORMAT "%8.2" /end CHARACTERISTIC
/begin CHARACTERISTIC DFC_DisblMsk.DFC_FanSCG_C "/" VALUE 0x80071A8A Val_Wu16 65535.00 DFES_OneToOne 0.00 65535.00 FORMAT "%8.2" /end CHARACTERISTIC
/begin CHARACTERISTIC DFC_DisblMsk.DFC_PCRGovDvtLPMax_C "/" VALUE 0x80071A8C Val_Wu16 65535.00 DFES_OneToOne 0.00 65535.00 FORMAT "%8.2" /end CHARACTERISTIC
/begin CHARACTERISTIC DFC_DisblMsk.DFC_PCRGovDvtLPMin_C "/" VALUE 0x80071A8E Val_Wu16 65535.00 DFES_OneToOne 0.00 65535.00 FORMAT "%8.2" /end CHARACTERISTIC
/begin CHARACTERISTIC DFC_DisblMsk.DFC_PCRGovDvtMax_C "/" VALUE 0x80071A90 Val_Wu16 65535.00 DFES_OneToOne 0.00 65535.00 FORMAT "%8.2" /end CHARACTERISTIC
/begin CHARACTERISTIC DFC_DisblMsk.DFC_PCRGovDvtMin_C "/" VALUE 0x80071A92 Val_Wu16 65535.00 DFES_OneToOne 0.00 65535.00 FORMAT "%8.2" /end CHARACTERISTIC
/begin CHARACTERISTIC DFC_DisblMsk.DFC_RailCPC1_C "/" VALUE 0x80071A94 Val_Wu16 65535.00 DFES_OneToOne 0.00 65535.00 FORMAT "%8.2" /end CHARACTERISTIC
/begin CHARACTERISTIC DFC_DisblMsk.DFC_RailCPC3_C "/" VALUE 0x80071A96 Val_Wu16 65535.00 DFES_OneToOne 0.00 65535.00 FORMAT "%8.2" /end CHARACTERISTIC
/begin CHARACTERISTIC DFC_DisblMsk.DFC_RailCPC4_C "/" VALUE 0x80071A98 Val_Wu16 65535.00 DFES_OneToOne 0.00 65535.00 FORMAT "%8.2" /end CHARACTERISTIC
/begin CHARACTERISTIC DFC_DisblMsk.DFC_RailMeUn0_C "/" VALUE 0x80071A9A Val_Wu16 65535.00 DFES_OneToOne 0.00 65535.00 FORMAT "%8.2" /end CHARACTERISTIC
/begin CHARACTERISTIC DFC_DisblMsk.DFC_RailMeUn1_C "/" VALUE 0x80071A9C Val_Wu16 65535.00 DFES_OneToOne 0.00 65535.00 FORMAT "%8.2" /end CHARACTERISTIC
/begin CHARACTERISTIC DFC_DisblMsk.DFC_RailMeUn2_C "/" VALUE 0x80071A9E Val_Wu16 65535.00 DFES_OneToOne 0.00 65535.00 FORMAT "%8.2" /end CHARACTERISTIC
/begin CHARACTERISTIC DFC_DisblMsk.DFC_RailMeUn3_C "/" VALUE 0x80071AA0 Val_Wu16 65535.00 DFES_OneToOne 0.00 65535.00 FORMAT "%8.2" /end CHARACTERISTIC
/begin CHARACTERISTIC DFC_DisblMsk.DFC_RailMeUn4_C "/" VALUE 0x80071AA2 Val_Wu16 65535.00 DFES_OneToOne 0.00 65535.00 FORMAT "%8.2" /end CHARACTERISTIC
/begin CHARACTERISTIC DFC_DisblMsk.DFC_RailPCV0_C "/" VALUE 0x80071AA4 Val_Wu16 65535.00 DFES_OneToOne 0.00 65535.00 FORMAT "%8.2" /end CHARACTERISTIC
/begin CHARACTERISTIC DFC_DisblMsk.DFC_RailPCV1_C "/" VALUE 0x80071AA6 Val_Wu16 65535.00 DFES_OneToOne 0.00 65535.00 FORMAT "%8.2" /end CHARACTERISTIC
/begin CHARACTERISTIC DFC_DisblMsk.DFC_RailPCV2_C "/" VALUE 0x80071AA8 Val_Wu16 65535.00 DFES_OneToOne 0.00 65535.00 FORMAT "%8.2" /end CHARACTERISTIC
/begin CHARACTERISTIC DFC_DisblMsk.DFC_RailPCV3_C "/" VALUE 0x80071AAA Val_Wu16 65535.00 DFES_OneToOne 0.00 65535.00 FORMAT "%8.2" /end CHARACTERISTIC
/begin CHARACTERISTIC DFC_DisblMsk.DFC_RailPCV4_C "/" VALUE 0x80071AAC Val_Wu16 65535.00 DFES_OneToOne 0.00 65535.00 FORMAT "%8.2" /end CHARACTERISTIC
/begin CHARACTERISTIC DFC_DisblMsk.DFC_RailPMonStrt_C "/" VALUE 0x80071AAE Val_Wu16 65535.00 DFES_OneToOne 0.00 65535.00 FORMAT "%8.2" /end CHARACTERISTIC
/begin CHARACTERISTIC DFC_DisblMsk.DFC_SSpMon1_C "/" VALUE 0x80071AB0 Val_Wu16 65535.00 DFES_OneToOne 0.00 65535.00 FORMAT "%8.2" /end CHARACTERISTIC
/begin CHARACTERISTIC DFC_DisblMsk.DFC_SSpMon2_C "/" VALUE 0x80071AB2 Val_Wu16 65535.00 DFES_OneToOne 0.00 65535.00 FORMAT "%8.2" /end CHARACTERISTIC
/begin CHARACTERISTIC DFC_DisblMsk.DFC_SSpMon3_C "/" VALUE 0x80071AB4 Val_Wu16 65535.00 DFES_OneToOne 0.00 65535.00 FORMAT "%8.2" /end CHARACTERISTIC
/begin CHARACTERISTIC DFC_DisblMsk.DFC_Sia_E1_C "/" VALUE 0x80071AB6 Val_Wu16 65535.00 DFES_OneToOne 0.00 65535.00 FORMAT "%8.2" /end CHARACTERISTIC
/begin CHARACTERISTIC DFC_DisblMsk.DFC_Sia_E10_C "/" VALUE 0x80071AB8 Val_Wu16 65535.00 DFES_OneToOne 0.00 65535.00 FORMAT "%8.2" /end CHARACTERISTIC
/begin CHARACTERISTIC DFC_DisblMsk.DFC_Sia_E11_C "/" VALUE 0x80071ABA Val_Wu16 65535.00 DFES_OneToOne 0.00 65535.00 FORMAT "%8.2" /end CHARACTERISTIC
/begin CHARACTERISTIC DFC_DisblMsk.DFC_Sia_E12_C "/" VALUE 0x80071ABC Val_Wu16 65535.00 DFES_OneToOne 0.00 65535.00 FORMAT "%8.2" /end CHARACTERISTIC
/begin CHARACTERISTIC DFC_DisblMsk.DFC_Sia_E13_C "/" VALUE 0x80071ABE Val_Wu16 65535.00 DFES_OneToOne 0.00 65535.00 FORMAT "%8.2" /end CHARACTERISTIC
/begin CHARACTERISTIC DFC_DisblMsk.DFC_Sia_E14_C "/" VALUE 0x80071AC0 Val_Wu16 65535.00 DFES_OneToOne 0.00 65535.00 FORMAT "%8.2" /end CHARACTERISTIC
/begin CHARACTERISTIC DFC_DisblMsk.DFC_Sia_E15_C "/" VALUE 0x80071AC2 Val_Wu16 65535.00 DFES_OneToOne 0.00 65535.00 FORMAT "%8.2" /end CHARACTERISTIC
/begin CHARACTERISTIC DFC_DisblMsk.DFC_Sia_E2_C "/" VALUE 0x80071AC4 Val_Wu16 65535.00 DFES_OneToOne 0.00 65535.00 FORMAT "%8.2" /end CHARACTERISTIC
/begin CHARACTERISTIC DFC_DisblMsk.DFC_Sia_E3_C "/" VALUE 0x80071AC6 Val_Wu16 65535.00 DFES_OneToOne 0.00 65535.00 FORMAT "%8.2" /end CHARACTERISTIC
/begin CHARACTERISTIC DFC_DisblMsk.DFC_Sia_E4_C "/" VALUE 0x80071AC8 Val_Wu16 65535.00 DFES_OneToOne 0.00 65535.00 FORMAT "%8.2" /end CHARACTERISTIC
/begin CHARACTERISTIC DFC_DisblMsk.DFC_Sia_E5_C "/" VALUE 0x80071ACA Val_Wu16 65535.00 DFES_OneToOne 0.00 65535.00 FORMAT "%8.2" /end CHARACTERISTIC
/begin CHARACTERISTIC DFC_DisblMsk.DFC_Sia_E6_C "/" VALUE 0x80071ACC Val_Wu16 65535.00 DFES_OneToOne 0.00 65535.00 FORMAT "%8.2" /end CHARACTERISTIC
/begin CHARACTERISTIC DFC_DisblMsk.DFC_Sia_E7_C "/" VALUE 0x80071ACE Val_Wu16 65535.00 DFES_OneToOne 0.00 65535.00 FORMAT "%8.2" /end CHARACTERISTIC
/begin CHARACTERISTIC DFC_DisblMsk.DFC_Sia_E8_C "/" VALUE 0x80071AD0 Val_Wu16 65535.00 DFES_OneToOne 0.00 65535.00 FORMAT "%8.2" /end CHARACTERISTIC
/begin CHARACTERISTIC DFC_DisblMsk.DFC_Sia_E9_C "/" VALUE 0x80071AD2 Val_Wu16 65535.00 DFES_OneToOne 0.00 65535.00 FORMAT "%8.2" /end CHARACTERISTIC
/begin CHARACTERISTIC DFC_DisblMsk.DFC_ThrVlv4WinErr1_C "/" VALUE 0x80071AD4 Val_Wu16 65535.00 DFES_OneToOne 0.00 65535.00 FORMAT "%8.2" /end CHARACTERISTIC
/begin CHARACTERISTIC DFC_DisblMsk.DFC_ThrVlv4WinErr2_C "/" VALUE 0x80071AD6 Val_Wu16 65535.00 DFES_OneToOne 0.00 65535.00 FORMAT "%8.2" /end CHARACTERISTIC
/begin CHARACTERISTIC DFC_DisblMsk.DFC_ThrVlv4WinErr3_C "/" VALUE 0x80071AD8 Val_Wu16 65535.00 DFES_OneToOne 0.00 65535.00 FORMAT "%8.2" /end CHARACTERISTIC
/begin CHARACTERISTIC DFC_DisblMsk.DFC_ThrVlv4WinErr4_C "/" VALUE 0x80071ADA Val_Wu16 65535.00 DFES_OneToOne 0.00 65535.00 FORMAT "%8.2" /end CHARACTERISTIC
/begin CHARACTERISTIC DFC_DisblMsk.DFC_ThrVlvSCG_C "/" VALUE 0x80071ADC Val_Wu16 65535.00 DFES_OneToOne 0.00 65535.00 FORMAT "%8.2" /end CHARACTERISTIC
/begin CHARACTERISTIC DFC_DisblMsk.DFC_TrbCh4WinErr1_C "/" VALUE 0x80071ADE Val_Wu16 65535.00 DFES_OneToOne 0.00 65535.00 FORMAT "%8.2" /end CHARACTERISTIC
/begin CHARACTERISTIC DFC_DisblMsk.DFC_TrbCh4WinErr2_C "/" VALUE 0x80071AE0 Val_Wu16 65535.00 DFES_OneToOne 0.00 65535.00 FORMAT "%8.2" /end CHARACTERISTIC
/begin CHARACTERISTIC DFC_DisblMsk.DFC_TrbCh4WinErr3_C "/" VALUE 0x80071AE2 Val_Wu16 65535.00 DFES_OneToOne 0.00 65535.00 FORMAT "%8.2" /end CHARACTERISTIC
/begin CHARACTERISTIC DFC_DisblMsk.DFC_TrbCh4WinErr4_C "/" VALUE 0x80071AE4 Val_Wu16 65535.00 DFES_OneToOne 0.00 65535.00 FORMAT "%8.2" /end CHARACTERISTIC
/begin CHARACTERISTIC DFC_DisblMsk.DFC_TrbChSCG_C "/" VALUE 0x80071AE6 Val_Wu16 65535.00 DFES_OneToOne 0.00 65535.00 FORMAT "%8.2" /end CHARACTERISTIC
/begin CHARACTERISTIC DFC_DisblMsk.DFC_TrbChSRCMax_C "/" VALUE 0x80071AE8 Val_Wu16 65535.00 DFES_OneToOne 0.00 65535.00 FORMAT "%8.2" /end CHARACTERISTIC
/begin CHARACTERISTIC DFC_DisblMsk.DFC_TrbChSRCMin_C "/" VALUE 0x80071AEA Val_Wu16 65535.00 DFES_OneToOne 0.00 65535.00 FORMAT "%8.2" /end CHARACTERISTIC
/begin CHARACTERISTIC DFC_DisblMsk.DFC_WaHtEl4WinErr1_C "/" VALUE 0x80071AEC Val_Wu16 65535.00 DFES_OneToOne 0.00 65535.00 FORMAT "%8.2" /end CHARACTERISTIC
/begin CHARACTERISTIC DFC_DisblMsk.DFC_WaHtEl4WinErr2_C "/" VALUE 0x80071AEE Val_Wu16 65535.00 DFES_OneToOne 0.00 65535.00 FORMAT "%8.2" /end CHARACTERISTIC
/begin CHARACTERISTIC DFC_DisblMsk.DFC_WaHtEl4WinErr3_C "/" VALUE 0x80071AF0 Val_Wu16 65535.00 DFES_OneToOne 0.00 65535.00 FORMAT "%8.2" /end CHARACTERISTIC
/begin CHARACTERISTIC DFC_DisblMsk.DFC_WaHtEl4WinErr4_C "/" VALUE 0x80071AF2 Val_Wu16 65535.00 DFES_OneToOne 0.00 65535.00 FORMAT "%8.2" /end CHARACTERISTIC
/begin CHARACTERISTIC DFC_DisblMsk.DFC_WaHtElSCG_C "/" VALUE 0x80071AF4 Val_Wu16 65535.00 DFES_OneToOne 0.00 65535.00 FORMAT "%8.2" /end CHARACTERISTIC
/begin CHARACTERISTIC DFC_DisblMsk.DFC_ETClbETFltMax_C "/" VALUE 0x80071AF6 Val_Wu16 65535.00 DFES_OneToOne 0.00 65535.00 FORMAT "%8.2" /end CHARACTERISTIC
/begin CHARACTERISTIC DFC_DisblMsk.DFC_ETClbETFltMin_C "/" VALUE 0x80071AF8 Val_Wu16 65535.00 DFES_OneToOne 0.00 65535.00 FORMAT "%8.2" /end CHARACTERISTIC
/begin CHARACTERISTIC DFC_DisblMsk.DFC_InjCrvInjLimChrgBal_C "/" VALUE 0x80071AFA Val_Wu16 65535.00 DFES_OneToOne 0.00 65535.00 FORMAT "%8.2" /end CHARACTERISTIC
/begin CHARACTERISTIC DFC_DisblMsk.DFC_InjCrvInjLimQntBal_C "/" VALUE 0x80071AFC Val_Wu16 65535.00 DFES_OneToOne 0.00 65535.00 FORMAT "%8.2" /end CHARACTERISTIC
/begin CHARACTERISTIC DFC_DisblMsk.DFC_InjCrvInjLimSys_C "/" VALUE 0x80071AFE Val_Wu16 65535.00 DFES_OneToOne 0.00 65535.00 FORMAT "%8.2" /end CHARACTERISTIC
/begin CHARACTERISTIC DFC_DisblMsk.DFC_InjCrvNumInjRtmLim_C "/" VALUE 0x80071B00 Val_Wu16 65535.00 DFES_OneToOne 0.00 65535.00 FORMAT "%8.2" /end CHARACTERISTIC
/begin CHARACTERISTIC DFC_DisblMsk.DFC_LSUHtCoupSig_0_C "/" VALUE 0x80071B02 Val_Wu16 65535.00 DFES_OneToOne 0.00 65535.00 FORMAT "%8.2" /end CHARACTERISTIC
/begin CHARACTERISTIC DFC_DisblMsk.DFC_LSUHtCoupSig_1_C "/" VALUE 0x80071B04 Val_Wu16 65535.00 DFES_OneToOne 0.00 65535.00 FORMAT "%8.2" /end CHARACTERISTIC
/begin CHARACTERISTIC DFC_DisblMsk.DFC_LSUHtCoupSig_2_C "/" VALUE 0x80071B06 Val_Wu16 65535.00 DFES_OneToOne 0.00 65535.00 FORMAT "%8.2" /end CHARACTERISTIC
/begin CHARACTERISTIC DFC_DisblMsk.DFC_LSUHtCoupSig_3_C "/" VALUE 0x80071B08 Val_Wu16 65535.00 DFES_OneToOne 0.00 65535.00 FORMAT "%8.2" /end CHARACTERISTIC
/begin CHARACTERISTIC DFC_DisblMsk.DFC_CtT_C "/" VALUE 0x80071B0A Val_Wu16 65535.00 DFES_OneToOne 0.00 65535.00 FORMAT "%8.2" /end CHARACTERISTIC
/begin CHARACTERISTIC DFC_DisblMsk.DFC_DSMDummy_C "/" VALUE 0x80071B0C Val_Wu16 65535.00 DFES_OneToOne 0.00 65535.00 FORMAT "%8.2" /end CHARACTERISTIC
/begin CHARACTERISTIC DFC_DisblMsk.DFC_MeUnOL_C "/" VALUE 0x80071B0E Val_Wu16 65535.00 DFES_OneToOne 0.00 65535.00 FORMAT "%8.2" /end CHARACTERISTIC
/begin CHARACTERISTIC DFC_DisblMsk.DFC_MeUnSCB_C "/" VALUE 0x80071B10 Val_Wu16 65535.00 DFES_OneToOne 0.00 65535.00 FORMAT "%8.2" /end CHARACTERISTIC
/begin CHARACTERISTIC DFC_DisblMsk.DFC_MeUnSRCMax_C "/" VALUE 0x80071B12 Val_Wu16 65535.00 DFES_OneToOne 0.00 65535.00 FORMAT "%8.2" /end CHARACTERISTIC
/begin CHARACTERISTIC DFC_DisblMsk.DFC_MeUnSRCMin_C "/" VALUE 0x80071B14 Val_Wu16 65535.00 DFES_OneToOne 0.00 65535.00 FORMAT "%8.2" /end CHARACTERISTIC
/begin CHARACTERISTIC DFC_DisblMsk.DFC_PCVOL_C "/" VALUE 0x80071B16 Val_Wu16 65535.00 DFES_OneToOne 0.00 65535.00 FORMAT "%8.2" /end CHARACTERISTIC
/begin CHARACTERISTIC DFC_DisblMsk.DFC_PCVSCB_C "/" VALUE 0x80071B18 Val_Wu16 65535.00 DFES_OneToOne 0.00 65535.00 FORMAT "%8.2" /end CHARACTERISTIC
/begin CHARACTERISTIC DFC_DisblMsk.DFC_PCVSRCMax_C "/" VALUE 0x80071B1A Val_Wu16 65535.00 DFES_OneToOne 0.00 65535.00 FORMAT "%8.2" /end CHARACTERISTIC
/begin CHARACTERISTIC DFC_DisblMsk.DFC_PCVSRCMin_C "/" VALUE 0x80071B1C Val_Wu16 65535.00 DFES_OneToOne 0.00 65535.00 FORMAT "%8.2" /end CHARACTERISTIC
/begin CHARACTERISTIC DFC_DisblMsk.DFC_RailPSRCMax_C "/" VALUE 0x80071B1E Val_Wu16 65535.00 DFES_OneToOne 0.00 65535.00 FORMAT "%8.2" /end CHARACTERISTIC
/begin CHARACTERISTIC DFC_DisblMsk.DFC_RailPSRCMin_C "/" VALUE 0x80071B20 Val_Wu16 65535.00 DFES_OneToOne 0.00 65535.00 FORMAT "%8.2" /end CHARACTERISTIC
/begin CHARACTERISTIC DFC_DisblMsk.DFC_IVActrVltgSRCMax_C "/" VALUE 0x80071B22 Val_Wu16 65535.00 DFES_OneToOne 0.00 65535.00 FORMAT "%8.2" /end CHARACTERISTIC
/begin CHARACTERISTIC DFC_DisblMsk.DFC_IVActrVltgSRCMin_C "/" VALUE 0x80071B24 Val_Wu16 65535.00 DFES_OneToOne 0.00 65535.00 FORMAT "%8.2" /end CHARACTERISTIC
/begin CHARACTERISTIC DFC_DisblMsk.DFC_IVPSplyDCDC_C "/" VALUE 0x80071B26 Val_Wu16 65535.00 DFES_OneToOne 0.00 65535.00 FORMAT "%8.2" /end CHARACTERISTIC
/begin CHARACTERISTIC DFC_DisblMsk.DFC_IVPSplyVltgSRCMax_C "/" VALUE 0x80071B28 Val_Wu16 65535.00 DFES_OneToOne 0.00 65535.00 FORMAT "%8.2" /end CHARACTERISTIC
/begin CHARACTERISTIC DFC_DisblMsk.DFC_IVPSplyVltgSRCMin_C "/" VALUE 0x80071B2A Val_Wu16 65535.00 DFES_OneToOne 0.00 65535.00 FORMAT "%8.2" /end CHARACTERISTIC
/begin CHARACTERISTIC DFC_DisblMsk.DFC_AFSOffsDrftMax_C "/" VALUE 0x80071B2C Val_Wu16 65535.00 DFES_OneToOne 0.00 65535.00 FORMAT "%8.2" /end CHARACTERISTIC
/begin CHARACTERISTIC DFC_DisblMsk.DFC_AFSOffsDrftMin_C "/" VALUE 0x80071B2E Val_Wu16 65535.00 DFES_OneToOne 0.00 65535.00 FORMAT "%8.2" /end CHARACTERISTIC
/begin CHARACTERISTIC DFC_DisblMsk.DFC_AFSSRCCorMax_C "/" VALUE 0x80071B30 Val_Wu16 65535.00 DFES_OneToOne 0.00 65535.00 FORMAT "%8.2" /end CHARACTERISTIC
/begin CHARACTERISTIC DFC_DisblMsk.DFC_AFSSRCCorMin_C "/" VALUE 0x80071B32 Val_Wu16 65535.00 DFES_OneToOne 0.00 65535.00 FORMAT "%8.2" /end CHARACTERISTIC
/begin CHARACTERISTIC DFC_DisblMsk.DFC_AFSSRCRawMax_C "/" VALUE 0x80071B34 Val_Wu16 65535.00 DFES_OneToOne 0.00 65535.00 FORMAT "%8.2" /end CHARACTERISTIC
/begin CHARACTERISTIC DFC_DisblMsk.DFC_AFSSRCRawMin_C "/" VALUE 0x80071B36 Val_Wu16 65535.00 DFES_OneToOne 0.00 65535.00 FORMAT "%8.2" /end CHARACTERISTIC
/begin CHARACTERISTIC DFC_DisblMsk.DFC_AFSSetyDrftMax_C "/" VALUE 0x80071B38 Val_Wu16 65535.00 DFES_OneToOne 0.00 65535.00 FORMAT "%8.2" /end CHARACTERISTIC
/begin CHARACTERISTIC DFC_DisblMsk.DFC_AFSSetyDrftMin_C "/" VALUE 0x80071B3A Val_Wu16 65535.00 DFES_OneToOne 0.00 65535.00 FORMAT "%8.2" /end CHARACTERISTIC
/begin CHARACTERISTIC DFC_DisblMsk.DFC_AirCClntPAnaSRCMax_C "/" VALUE 0x80071B3C Val_Wu16 65535.00 DFES_OneToOne 0.00 65535.00 FORMAT "%8.2" /end CHARACTERISTIC
/begin CHARACTERISTIC DFC_DisblMsk.DFC_AirCClntPAnaSRCMin_C "/" VALUE 0x80071B3E Val_Wu16 65535.00 DFES_OneToOne 0.00 65535.00 FORMAT "%8.2" /end CHARACTERISTIC
/begin CHARACTERISTIC DFC_DisblMsk.DFC_AirCClntPPerSRCMax_C "/" VALUE 0x80071B40 Val_Wu16 65535.00 DFES_OneToOne 0.00 65535.00 FORMAT "%8.2" /end CHARACTERISTIC
/begin CHARACTERISTIC DFC_DisblMsk.DFC_AirCClntPPerSRCMin_C "/" VALUE 0x80071B42 Val_Wu16 65535.00 DFES_OneToOne 0.00 65535.00 FORMAT "%8.2" /end CHARACTERISTIC
/begin CHARACTERISTIC DFC_DisblMsk.DFC_AirCClntPdcycSRCMax_C "/" VALUE 0x80071B44 Val_Wu16 65535.00 DFES_OneToOne 0.00 65535.00 FORMAT "%8.2" /end CHARACTERISTIC
/begin CHARACTERISTIC DFC_DisblMsk.DFC_AirCClntPdcycSRCMin_C "/" VALUE 0x80071B46 Val_Wu16 65535.00 DFES_OneToOne 0.00 65535.00 FORMAT "%8.2" /end CHARACTERISTIC
/begin CHARACTERISTIC DFC_DisblMsk.DFC_AirCCmprOL_C "/" VALUE 0x80071B48 Val_Wu16 65535.00 DFES_OneToOne 0.00 65535.00 FORMAT "%8.2" /end CHARACTERISTIC
/begin CHARACTERISTIC DFC_DisblMsk.DFC_AirCCmprRedTrqOL_C "/" VALUE 0x80071B4A Val_Wu16 65535.00 DFES_OneToOne 0.00 65535.00 FORMAT "%8.2" /end CHARACTERISTIC
/begin CHARACTERISTIC DFC_DisblMsk.DFC_AirCCmprRedTrqSCB_C "/" VALUE 0x80071B4C Val_Wu16 65535.00 DFES_OneToOne 0.00 65535.00 FORMAT "%8.2" /end CHARACTERISTIC
/begin CHARACTERISTIC DFC_DisblMsk.DFC_AirCCmprRedTrqSCG_C "/" VALUE 0x80071B4E Val_Wu16 65535.00 DFES_OneToOne 0.00 65535.00 FORMAT "%8.2" /end CHARACTERISTIC
/begin CHARACTERISTIC DFC_DisblMsk.DFC_AirCCmprSCB_C "/" VALUE 0x80071B50 Val_Wu16 65535.00 DFES_OneToOne 0.00 65535.00 FORMAT "%8.2" /end CHARACTERISTIC
/begin CHARACTERISTIC DFC_DisblMsk.DFC_AirCCmprSCG_C "/" VALUE 0x80071B52 Val_Wu16 65535.00 DFES_OneToOne 0.00 65535.00 FORMAT "%8.2" /end CHARACTERISTIC
/begin CHARACTERISTIC DFC_DisblMsk.DFC_AirCSwtNpl_C "/" VALUE 0x80071B54 Val_Wu16 65535.00 DFES_OneToOne 0.00 65535.00 FORMAT "%8.2" /end CHARACTERISTIC
/begin CHARACTERISTIC DFC_DisblMsk.DFC_AirCSwtSig_C "/" VALUE 0x80071B56 Val_Wu16 65535.00 DFES_OneToOne 0.00 65535.00 FORMAT "%8.2" /end CHARACTERISTIC
/begin CHARACTERISTIC DFC_DisblMsk.DFC_BattUSRCMax_C "/" VALUE 0x80071B58 Val_Wu16 65535.00 DFES_OneToOne 0.00 65535.00 FORMAT "%8.2" /end CHARACTERISTIC
/begin CHARACTERISTIC DFC_DisblMsk.DFC_BattUSRCMin_C "/" VALUE 0x80071B5A Val_Wu16 65535.00 DFES_OneToOne 0.00 65535.00 FORMAT "%8.2" /end CHARACTERISTIC
/begin CHARACTERISTIC DFC_DisblMsk.DFC_BrkNpl_C "/" VALUE 0x80071B5C Val_Wu16 65535.00 DFES_OneToOne 0.00 65535.00 FORMAT "%8.2" /end CHARACTERISTIC
/begin CHARACTERISTIC DFC_DisblMsk.DFC_BrkPSRCMax_C "/" VALUE 0x80071B5E Val_Wu16 65535.00 DFES_OneToOne 0.00 65535.00 FORMAT "%8.2" /end CHARACTERISTIC
/begin CHARACTERISTIC DFC_DisblMsk.DFC_BrkPSRCMin_C "/" VALUE 0x80071B60 Val_Wu16 65535.00 DFES_OneToOne 0.00 65535.00 FORMAT "%8.2" /end CHARACTERISTIC
/begin CHARACTERISTIC DFC_DisblMsk.DFC_BrkSig_C "/" VALUE 0x80071B62 Val_Wu16 65535.00 DFES_OneToOne 0.00 65535.00 FORMAT "%8.2" /end CHARACTERISTIC
/begin CHARACTERISTIC DFC_DisblMsk.DFC_CByVlvOL_C "/" VALUE 0x80071B64 Val_Wu16 65535.00 DFES_OneToOne 0.00 65535.00 FORMAT "%8.2" /end CHARACTERISTIC
/begin CHARACTERISTIC DFC_DisblMsk.DFC_CByVlvSCB_C "/" VALUE 0x80071B66 Val_Wu16 65535.00 DFES_OneToOne 0.00 65535.00 FORMAT "%8.2" /end CHARACTERISTIC
/begin CHARACTERISTIC DFC_DisblMsk.DFC_CByVlvSCG_C "/" VALUE 0x80071B68 Val_Wu16 65535.00 DFES_OneToOne 0.00 65535.00 FORMAT "%8.2" /end CHARACTERISTIC
/begin CHARACTERISTIC DFC_DisblMsk.DFC_CEngDsTSRCMax_C "/" VALUE 0x80071B6A Val_Wu16 65535.00 DFES_OneToOne 0.00 65535.00 FORMAT "%8.2" /end CHARACTERISTIC
/begin CHARACTERISTIC DFC_DisblMsk.DFC_CEngDsTSRCMin_C "/" VALUE 0x80071B6C Val_Wu16 65535.00 DFES_OneToOne 0.00 65535.00 FORMAT "%8.2" /end CHARACTERISTIC
/begin CHARACTERISTIC DFC_DisblMsk.DFC_CEngDsTSig_C "/" VALUE 0x80071B6E Val_Wu16 65535.00 DFES_OneToOne 0.00 65535.00 FORMAT "%8.2" /end CHARACTERISTIC
/begin CHARACTERISTIC DFC_DisblMsk.DFC_CEngUsTSRCMax_C "/" VALUE 0x80071B70 Val_Wu16 65535.00 DFES_OneToOne 0.00 65535.00 FORMAT "%8.2" /end CHARACTERISTIC
/begin CHARACTERISTIC DFC_DisblMsk.DFC_CEngUsTSRCMin_C "/" VALUE 0x80071B72 Val_Wu16 65535.00 DFES_OneToOne 0.00 65535.00 FORMAT "%8.2" /end CHARACTERISTIC
/begin CHARACTERISTIC DFC_DisblMsk.DFC_CThmstOL_C "/" VALUE 0x80071B74 Val_Wu16 65535.00 DFES_OneToOne 0.00 65535.00 FORMAT "%8.2" /end CHARACTERISTIC
/begin CHARACTERISTIC DFC_DisblMsk.DFC_CThmstSCB_C "/" VALUE 0x80071B76 Val_Wu16 65535.00 DFES_OneToOne 0.00 65535.00 FORMAT "%8.2" /end CHARACTERISTIC
/begin CHARACTERISTIC DFC_DisblMsk.DFC_CThmstSCG_C "/" VALUE 0x80071B78 Val_Wu16 65535.00 DFES_OneToOne 0.00 65535.00 FORMAT "%8.2" /end CHARACTERISTIC
/begin CHARACTERISTIC DFC_DisblMsk.DFC_ClthSig_C "/" VALUE 0x80071B7A Val_Wu16 65535.00 DFES_OneToOne 0.00 65535.00 FORMAT "%8.2" /end CHARACTERISTIC
/begin CHARACTERISTIC DFC_DisblMsk.DFC_ECBVlvOL_C "/" VALUE 0x80071B7C Val_Wu16 65535.00 DFES_OneToOne 0.00 65535.00 FORMAT "%8.2" /end CHARACTERISTIC
/begin CHARACTERISTIC DFC_DisblMsk.DFC_ECBVlvSCB_C "/" VALUE 0x80071B7E Val_Wu16 65535.00 DFES_OneToOne 0.00 65535.00 FORMAT "%8.2" /end CHARACTERISTIC
/begin CHARACTERISTIC DFC_DisblMsk.DFC_ECBVlvSCG_C "/" VALUE 0x80071B80 Val_Wu16 65535.00 DFES_OneToOne 0.00 65535.00 FORMAT "%8.2" /end CHARACTERISTIC
/begin CHARACTERISTIC DFC_DisblMsk.DFC_ECBVlvSRCMax_C "/" VALUE 0x80071B82 Val_Wu16 65535.00 DFES_OneToOne 0.00 65535.00 FORMAT "%8.2" /end CHARACTERISTIC
/begin CHARACTERISTIC DFC_DisblMsk.DFC_ECBVlvSRCMin_C "/" VALUE 0x80071B84 Val_Wu16 65535.00 DFES_OneToOne 0.00 65535.00 FORMAT "%8.2" /end CHARACTERISTIC
/begin CHARACTERISTIC DFC_DisblMsk.DFC_EGRVlvGovDvtMax_C "/" VALUE 0x80071B86 Val_Wu16 65535.00 DFES_OneToOne 0.00 65535.00 FORMAT "%8.2" /end CHARACTERISTIC
/begin CHARACTERISTIC DFC_DisblMsk.DFC_EGRVlvGovDvtMin_C "/" VALUE 0x80071B88 Val_Wu16 65535.00 DFES_OneToOne 0.00 65535.00 FORMAT "%8.2" /end CHARACTERISTIC
/begin CHARACTERISTIC DFC_DisblMsk.DFC_EGRVlvOL_C "/" VALUE 0x80071B8A Val_Wu16 65535.00 DFES_OneToOne 0.00 65535.00 FORMAT "%8.2" /end CHARACTERISTIC
/begin CHARACTERISTIC DFC_DisblMsk.DFC_EGRVlvSCB_C "/" VALUE 0x80071B8C Val_Wu16 65535.00 DFES_OneToOne 0.00 65535.00 FORMAT "%8.2" /end CHARACTERISTIC
/begin CHARACTERISTIC DFC_DisblMsk.DFC_EGRVlvSCG_C "/" VALUE 0x80071B8E Val_Wu16 65535.00 DFES_OneToOne 0.00 65535.00 FORMAT "%8.2" /end CHARACTERISTIC
/begin CHARACTERISTIC DFC_DisblMsk.DFC_EGRVlvSRCMax_C "/" VALUE 0x80071B90 Val_Wu16 65535.00 DFES_OneToOne 0.00 65535.00 FORMAT "%8.2" /end CHARACTERISTIC
/begin CHARACTERISTIC DFC_DisblMsk.DFC_EGRVlvSRCMin_C "/" VALUE 0x80071B92 Val_Wu16 65535.00 DFES_OneToOne 0.00 65535.00 FORMAT "%8.2" /end CHARACTERISTIC
/begin CHARACTERISTIC DFC_DisblMsk.DFC_EMDmpOL_0_C "/" VALUE 0x80071B94 Val_Wu16 65535.00 DFES_OneToOne 0.00 65535.00 FORMAT "%8.2" /end CHARACTERISTIC
/begin CHARACTERISTIC DFC_DisblMsk.DFC_EMDmpOL_1_C "/" VALUE 0x80071B96 Val_Wu16 65535.00 DFES_OneToOne 0.00 65535.00 FORMAT "%8.2" /end CHARACTERISTIC
/begin CHARACTERISTIC DFC_DisblMsk.DFC_EMDmpSCB_0_C "/" VALUE 0x80071B98 Val_Wu16 65535.00 DFES_OneToOne 0.00 65535.00 FORMAT "%8.2" /end CHARACTERISTIC
/begin CHARACTERISTIC DFC_DisblMsk.DFC_EMDmpSCB_1_C "/" VALUE 0x80071B9A Val_Wu16 65535.00 DFES_OneToOne 0.00 65535.00 FORMAT "%8.2" /end CHARACTERISTIC
/begin CHARACTERISTIC DFC_DisblMsk.DFC_EMDmpSCG_0_C "/" VALUE 0x80071B9C Val_Wu16 65535.00 DFES_OneToOne 0.00 65535.00 FORMAT "%8.2" /end CHARACTERISTIC
/begin CHARACTERISTIC DFC_DisblMsk.DFC_EMDmpSCG_1_C "/" VALUE 0x80071B9E Val_Wu16 65535.00 DFES_OneToOne 0.00 65535.00 FORMAT "%8.2" /end CHARACTERISTIC
/begin CHARACTERISTIC DFC_DisblMsk.DFC_EngStAOL_C "/" VALUE 0x80071BA0 Val_Wu16 65535.00 DFES_OneToOne 0.00 65535.00 FORMAT "%8.2" /end CHARACTERISTIC
/begin CHARACTERISTIC DFC_DisblMsk.DFC_EngStASCB_C "/" VALUE 0x80071BA2 Val_Wu16 65535.00 DFES_OneToOne 0.00 65535.00 FORMAT "%8.2" /end CHARACTERISTIC
/begin CHARACTERISTIC DFC_DisblMsk.DFC_EngStASCG_C "/" VALUE 0x80071BA4 Val_Wu16 65535.00 DFES_OneToOne 0.00 65535.00 FORMAT "%8.2" /end CHARACTERISTIC
/begin CHARACTERISTIC DFC_DisblMsk.DFC_EnvPSRCMax_C "/" VALUE 0x80071BA6 Val_Wu16 65535.00 DFES_OneToOne 0.00 65535.00 FORMAT "%8.2" /end CHARACTERISTIC
/begin CHARACTERISTIC DFC_DisblMsk.DFC_EnvPSRCMin_C "/" VALUE 0x80071BA8 Val_Wu16 65535.00 DFES_OneToOne 0.00 65535.00 FORMAT "%8.2" /end CHARACTERISTIC
/begin CHARACTERISTIC DFC_DisblMsk.DFC_EnvPSig_C "/" VALUE 0x80071BAA Val_Wu16 65535.00 DFES_OneToOne 0.00 65535.00 FORMAT "%8.2" /end CHARACTERISTIC
/begin CHARACTERISTIC DFC_DisblMsk.DFC_EnvTSRCMax_C "/" VALUE 0x80071BAC Val_Wu16 65535.00 DFES_OneToOne 0.00 65535.00 FORMAT "%8.2" /end CHARACTERISTIC
/begin CHARACTERISTIC DFC_DisblMsk.DFC_EnvTSRCMin_C "/" VALUE 0x80071BAE Val_Wu16 65535.00 DFES_OneToOne 0.00 65535.00 FORMAT "%8.2" /end CHARACTERISTIC
/begin CHARACTERISTIC DFC_DisblMsk.DFC_FanOL_C "/" VALUE 0x80071BB0 Val_Wu16 65535.00 DFES_OneToOne 0.00 65535.00 FORMAT "%8.2" /end CHARACTERISTIC
/begin CHARACTERISTIC DFC_DisblMsk.DFC_FanSCB_C "/" VALUE 0x80071BB2 Val_Wu16 65535.00 DFES_OneToOne 0.00 65535.00 FORMAT "%8.2" /end CHARACTERISTIC
/begin CHARACTERISTIC DFC_DisblMsk.DFC_FlFltSig_C "/" VALUE 0x80071BB4 Val_Wu16 65535.00 DFES_OneToOne 0.00 65535.00 FORMAT "%8.2" /end CHARACTERISTIC
/begin CHARACTERISTIC DFC_DisblMsk.DFC_FuelTSRCMax_C "/" VALUE 0x80071BB6 Val_Wu16 65535.00 DFES_OneToOne 0.00 65535.00 FORMAT "%8.2" /end CHARACTERISTIC
/begin CHARACTERISTIC DFC_DisblMsk.DFC_FuelTSRCMin_C "/" VALUE 0x80071BB8 Val_Wu16 65535.00 DFES_OneToOne 0.00 65535.00 FORMAT "%8.2" /end CHARACTERISTIC
/begin CHARACTERISTIC DFC_DisblMsk.DFC_GbxNPosPPerSRCMax_C "/" VALUE 0x80071BBA Val_Wu16 65535.00 DFES_OneToOne 0.00 65535.00 FORMAT "%8.2" /end CHARACTERISTIC
/begin CHARACTERISTIC DFC_DisblMsk.DFC_GbxNPosPPerSRCMin_C "/" VALUE 0x80071BBC Val_Wu16 65535.00 DFES_OneToOne 0.00 65535.00 FORMAT "%8.2" /end CHARACTERISTIC
/begin CHARACTERISTIC DFC_DisblMsk.DFC_GbxNPosPdcycSRCMax_C "/" VALUE 0x80071BBE Val_Wu16 65535.00 DFES_OneToOne 0.00 65535.00 FORMAT "%8.2" /end CHARACTERISTIC
/begin CHARACTERISTIC DFC_DisblMsk.DFC_GbxNPosPdcycSRCMin_C "/" VALUE 0x80071BC0 Val_Wu16 65535.00 DFES_OneToOne 0.00 65535.00 FORMAT "%8.2" /end CHARACTERISTIC
/begin CHARACTERISTIC DFC_DisblMsk.DFC_GbxNPosSig_C "/" VALUE 0x80071BC2 Val_Wu16 65535.00 DFES_OneToOne 0.00 65535.00 FORMAT "%8.2" /end CHARACTERISTIC
/begin CHARACTERISTIC DFC_DisblMsk.DFC_GlwPlgBSDOL_0_C "/" VALUE 0x80071BC4 Val_Wu16 65535.00 DFES_OneToOne 0.00 65535.00 FORMAT "%8.2" /end CHARACTERISTIC
/begin CHARACTERISTIC DFC_DisblMsk.DFC_GlwPlgBSDOL_1_C "/" VALUE 0x80071BC6 Val_Wu16 65535.00 DFES_OneToOne 0.00 65535.00 FORMAT "%8.2" /end CHARACTERISTIC
/begin CHARACTERISTIC DFC_DisblMsk.DFC_GlwPlgBSDOL_2_C "/" VALUE 0x80071BC8 Val_Wu16 65535.00 DFES_OneToOne 0.00 65535.00 FORMAT "%8.2" /end CHARACTERISTIC
/begin CHARACTERISTIC DFC_DisblMsk.DFC_GlwPlgBSDOL_3_C "/" VALUE 0x80071BCA Val_Wu16 65535.00 DFES_OneToOne 0.00 65535.00 FORMAT "%8.2" /end CHARACTERISTIC
/begin CHARACTERISTIC DFC_DisblMsk.DFC_GlwPlgBSDOL_4_C "/" VALUE 0x80071BCC Val_Wu16 65535.00 DFES_OneToOne 0.00 65535.00 FORMAT "%8.2" /end CHARACTERISTIC
/begin CHARACTERISTIC DFC_DisblMsk.DFC_GlwPlgBSDOL_5_C "/" VALUE 0x80071BCE Val_Wu16 65535.00 DFES_OneToOne 0.00 65535.00 FORMAT "%8.2" /end CHARACTERISTIC
/begin CHARACTERISTIC DFC_DisblMsk.DFC_GlwPlgBSDOL_6_C "/" VALUE 0x80071BD0 Val_Wu16 65535.00 DFES_OneToOne 0.00 65535.00 FORMAT "%8.2" /end CHARACTERISTIC
/begin CHARACTERISTIC DFC_DisblMsk.DFC_GlwPlgBSDOL_7_C "/" VALUE 0x80071BD2 Val_Wu16 65535.00 DFES_OneToOne 0.00 65535.00 FORMAT "%8.2" /end CHARACTERISTIC
/begin CHARACTERISTIC DFC_DisblMsk.DFC_GlwPlgBSDOT_0_C "/" VALUE 0x80071BD4 Val_Wu16 65535.00 DFES_OneToOne 0.00 65535.00 FORMAT "%8.2" /end CHARACTERISTIC
/begin CHARACTERISTIC DFC_DisblMsk.DFC_GlwPlgBSDOT_1_C "/" VALUE 0x80071BD6 Val_Wu16 65535.00 DFES_OneToOne 0.00 65535.00 FORMAT "%8.2" /end CHARACTERISTIC
/begin CHARACTERISTIC DFC_DisblMsk.DFC_GlwPlgBSDOT_2_C "/" VALUE 0x80071BD8 Val_Wu16 65535.00 DFES_OneToOne 0.00 65535.00 FORMAT "%8.2" /end CHARACTERISTIC
/begin CHARACTERISTIC DFC_DisblMsk.DFC_GlwPlgBSDOT_3_C "/" VALUE 0x80071BDA Val_Wu16 65535.00 DFES_OneToOne 0.00 65535.00 FORMAT "%8.2" /end CHARACTERISTIC
/begin CHARACTERISTIC DFC_DisblMsk.DFC_GlwPlgBSDOT_4_C "/" VALUE 0x80071BDC Val_Wu16 65535.00 DFES_OneToOne 0.00 65535.00 FORMAT "%8.2" /end CHARACTERISTIC
/begin CHARACTERISTIC DFC_DisblMsk.DFC_GlwPlgBSDOT_5_C "/" VALUE 0x80071BDE Val_Wu16 65535.00 DFES_OneToOne 0.00 65535.00 FORMAT "%8.2" /end CHARACTERISTIC
/begin CHARACTERISTIC DFC_DisblMsk.DFC_GlwPlgBSDOT_6_C "/" VALUE 0x80071BE0 Val_Wu16 65535.00 DFES_OneToOne 0.00 65535.00 FORMAT "%8.2" /end CHARACTERISTIC
/begin CHARACTERISTIC DFC_DisblMsk.DFC_GlwPlgBSDOT_7_C "/" VALUE 0x80071BE2 Val_Wu16 65535.00 DFES_OneToOne 0.00 65535.00 FORMAT "%8.2" /end CHARACTERISTIC
/begin CHARACTERISTIC DFC_DisblMsk.DFC_GlwPlgBSDSC_0_C "/" VALUE 0x80071BE4 Val_Wu16 65535.00 DFES_OneToOne 0.00 65535.00 FORMAT "%8.2" /end CHARACTERISTIC
/begin CHARACTERISTIC DFC_DisblMsk.DFC_GlwPlgBSDSC_1_C "/" VALUE 0x80071BE6 Val_Wu16 65535.00 DFES_OneToOne 0.00 65535.00 FORMAT "%8.2" /end CHARACTERISTIC
/begin CHARACTERISTIC DFC_DisblMsk.DFC_GlwPlgBSDSC_2_C "/" VALUE 0x80071BE8 Val_Wu16 65535.00 DFES_OneToOne 0.00 65535.00 FORMAT "%8.2" /end CHARACTERISTIC
/begin CHARACTERISTIC DFC_DisblMsk.DFC_GlwPlgBSDSC_3_C "/" VALUE 0x80071BEA Val_Wu16 65535.00 DFES_OneToOne 0.00 65535.00 FORMAT "%8.2" /end CHARACTERISTIC
/begin CHARACTERISTIC DFC_DisblMsk.DFC_GlwPlgBSDSC_4_C "/" VALUE 0x80071BEC Val_Wu16 65535.00 DFES_OneToOne 0.00 65535.00 FORMAT "%8.2" /end CHARACTERISTIC
/begin CHARACTERISTIC DFC_DisblMsk.DFC_GlwPlgBSDSC_5_C "/" VALUE 0x80071BEE Val_Wu16 65535.00 DFES_OneToOne 0.00 65535.00 FORMAT "%8.2" /end CHARACTERISTIC
/begin CHARACTERISTIC DFC_DisblMsk.DFC_GlwPlgBSDSC_6_C "/" VALUE 0x80071BF0 Val_Wu16 65535.00 DFES_OneToOne 0.00 65535.00 FORMAT "%8.2" /end CHARACTERISTIC
/begin CHARACTERISTIC DFC_DisblMsk.DFC_GlwPlgBSDSC_7_C "/" VALUE 0x80071BF2 Val_Wu16 65535.00 DFES_OneToOne 0.00 65535.00 FORMAT "%8.2" /end CHARACTERISTIC
/begin CHARACTERISTIC DFC_DisblMsk.DFC_GlwPlgComErr_C "/" VALUE 0x80071BF4 Val_Wu16 65535.00 DFES_OneToOne 0.00 65535.00 FORMAT "%8.2" /end CHARACTERISTIC
/begin CHARACTERISTIC DFC_DisblMsk.DFC_InjVlvPresMin_C "/" VALUE 0x80071BF6 Val_Wu16 65535.00 DFES_OneToOne 0.00 65535.00 FORMAT "%8.2" /end CHARACTERISTIC
/begin CHARACTERISTIC DFC_DisblMsk.DFC_LSUCircNernstMax_0_C "/" VALUE 0x80071BF8 Val_Wu16 65535.00 DFES_OneToOne 0.00 65535.00 FORMAT "%8.2" /end CHARACTERISTIC
/begin CHARACTERISTIC DFC_DisblMsk.DFC_LSUCircNernstMax_1_C "/" VALUE 0x80071BFA Val_Wu16 65535.00 DFES_OneToOne 0.00 65535.00 FORMAT "%8.2" /end CHARACTERISTIC
/begin CHARACTERISTIC DFC_DisblMsk.DFC_LSUCircNernstMax_2_C "/" VALUE 0x80071BFC Val_Wu16 65535.00 DFES_OneToOne 0.00 65535.00 FORMAT "%8.2" /end CHARACTERISTIC
/begin CHARACTERISTIC DFC_DisblMsk.DFC_LSUCircNernstMax_3_C "/" VALUE 0x80071BFE Val_Wu16 65535.00 DFES_OneToOne 0.00 65535.00 FORMAT "%8.2" /end CHARACTERISTIC
/begin CHARACTERISTIC DFC_DisblMsk.DFC_LSUCircNernstMin_0_C "/" VALUE 0x80071C00 Val_Wu16 65535.00 DFES_OneToOne 0.00 65535.00 FORMAT "%8.2" /end CHARACTERISTIC
/begin CHARACTERISTIC DFC_DisblMsk.DFC_LSUCircNernstMin_1_C "/" VALUE 0x80071C02 Val_Wu16 65535.00 DFES_OneToOne 0.00 65535.00 FORMAT "%8.2" /end CHARACTERISTIC
/begin CHARACTERISTIC DFC_DisblMsk.DFC_LSUCircNernstMin_2_C "/" VALUE 0x80071C04 Val_Wu16 65535.00 DFES_OneToOne 0.00 65535.00 FORMAT "%8.2" /end CHARACTERISTIC
/begin CHARACTERISTIC DFC_DisblMsk.DFC_LSUCircNernstMin_3_C "/" VALUE 0x80071C06 Val_Wu16 65535.00 DFES_OneToOne 0.00 65535.00 FORMAT "%8.2" /end CHARACTERISTIC
/begin CHARACTERISTIC DFC_DisblMsk.DFC_LSUCircNernstSig_0_C "/" VALUE 0x80071C08 Val_Wu16 65535.00 DFES_OneToOne 0.00 65535.00 FORMAT "%8.2" /end CHARACTERISTIC
/begin CHARACTERISTIC DFC_DisblMsk.DFC_LSUCircNernstSig_1_C "/" VALUE 0x80071C0A Val_Wu16 65535.00 DFES_OneToOne 0.00 65535.00 FORMAT "%8.2" /end CHARACTERISTIC
/begin CHARACTERISTIC DFC_DisblMsk.DFC_LSUCircNernstSig_2_C "/" VALUE 0x80071C0C Val_Wu16 65535.00 DFES_OneToOne 0.00 65535.00 FORMAT "%8.2" /end CHARACTERISTIC
/begin CHARACTERISTIC DFC_DisblMsk.DFC_LSUCircNernstSig_3_C "/" VALUE 0x80071C0E Val_Wu16 65535.00 DFES_OneToOne 0.00 65535.00 FORMAT "%8.2" /end CHARACTERISTIC
/begin CHARACTERISTIC DFC_DisblMsk.DFC_LSUCircPmpCurMax_0_C "/" VALUE 0x80071C10 Val_Wu16 65535.00 DFES_OneToOne 0.00 65535.00 FORMAT "%8.2" /end CHARACTERISTIC
/begin CHARACTERISTIC DFC_DisblMsk.DFC_LSUCircPmpCurMax_1_C "/" VALUE 0x80071C12 Val_Wu16 65535.00 DFES_OneToOne 0.00 65535.00 FORMAT "%8.2" /end CHARACTERISTIC
/begin CHARACTERISTIC DFC_DisblMsk.DFC_LSUCircPmpCurMax_2_C "/" VALUE 0x80071C14 Val_Wu16 65535.00 DFES_OneToOne 0.00 65535.00 FORMAT "%8.2" /end CHARACTERISTIC
/begin CHARACTERISTIC DFC_DisblMsk.DFC_LSUCircPmpCurMax_3_C "/" VALUE 0x80071C16 Val_Wu16 65535.00 DFES_OneToOne 0.00 65535.00 FORMAT "%8.2" /end CHARACTERISTIC
/begin CHARACTERISTIC DFC_DisblMsk.DFC_LSUCircPmpCurMin_0_C "/" VALUE 0x80071C18 Val_Wu16 65535.00 DFES_OneToOne 0.00 65535.00 FORMAT "%8.2" /end CHARACTERISTIC
/begin CHARACTERISTIC DFC_DisblMsk.DFC_LSUCircPmpCurMin_1_C "/" VALUE 0x80071C1A Val_Wu16 65535.00 DFES_OneToOne 0.00 65535.00 FORMAT "%8.2" /end CHARACTERISTIC
/begin CHARACTERISTIC DFC_DisblMsk.DFC_LSUCircPmpCurMin_2_C "/" VALUE 0x80071C1C Val_Wu16 65535.00 DFES_OneToOne 0.00 65535.00 FORMAT "%8.2" /end CHARACTERISTIC
/begin CHARACTERISTIC DFC_DisblMsk.DFC_LSUCircPmpCurMin_3_C "/" VALUE 0x80071C1E Val_Wu16 65535.00 DFES_OneToOne 0.00 65535.00 FORMAT "%8.2" /end CHARACTERISTIC
/begin CHARACTERISTIC DFC_DisblMsk.DFC_LSUCircPmpCurSig_0_C "/" VALUE 0x80071C20 Val_Wu16 65535.00 DFES_OneToOne 0.00 65535.00 FORMAT "%8.2" /end CHARACTERISTIC
/begin CHARACTERISTIC DFC_DisblMsk.DFC_LSUCircPmpCurSig_1_C "/" VALUE 0x80071C22 Val_Wu16 65535.00 DFES_OneToOne 0.00 65535.00 FORMAT "%8.2" /end CHARACTERISTIC
/begin CHARACTERISTIC DFC_DisblMsk.DFC_LSUCircPmpCurSig_2_C "/" VALUE 0x80071C24 Val_Wu16 65535.00 DFES_OneToOne 0.00 65535.00 FORMAT "%8.2" /end CHARACTERISTIC
/begin CHARACTERISTIC DFC_DisblMsk.DFC_LSUCircPmpCurSig_3_C "/" VALUE 0x80071C26 Val_Wu16 65535.00 DFES_OneToOne 0.00 65535.00 FORMAT "%8.2" /end CHARACTERISTIC
/begin CHARACTERISTIC DFC_DisblMsk.DFC_LSUCircVirtGndMax_0_C "/" VALUE 0x80071C28 Val_Wu16 65535.00 DFES_OneToOne 0.00 65535.00 FORMAT "%8.2" /end CHARACTERISTIC
/begin CHARACTERISTIC DFC_DisblMsk.DFC_LSUCircVirtGndMax_1_C "/" VALUE 0x80071C2A Val_Wu16 65535.00 DFES_OneToOne 0.00 65535.00 FORMAT "%8.2" /end CHARACTERISTIC
/begin CHARACTERISTIC DFC_DisblMsk.DFC_LSUCircVirtGndMax_2_C "/" VALUE 0x80071C2C Val_Wu16 65535.00 DFES_OneToOne 0.00 65535.00 FORMAT "%8.2" /end CHARACTERISTIC
/begin CHARACTERISTIC DFC_DisblMsk.DFC_LSUCircVirtGndMax_3_C "/" VALUE 0x80071C2E Val_Wu16 65535.00 DFES_OneToOne 0.00 65535.00 FORMAT "%8.2" /end CHARACTERISTIC
/begin CHARACTERISTIC DFC_DisblMsk.DFC_LSUCircVirtGndMin_0_C "/" VALUE 0x80071C30 Val_Wu16 65535.00 DFES_OneToOne 0.00 65535.00 FORMAT "%8.2" /end CHARACTERISTIC
/begin CHARACTERISTIC DFC_DisblMsk.DFC_LSUCircVirtGndMin_1_C "/" VALUE 0x80071C32 Val_Wu16 65535.00 DFES_OneToOne 0.00 65535.00 FORMAT "%8.2" /end CHARACTERISTIC
/begin CHARACTERISTIC DFC_DisblMsk.DFC_LSUCircVirtGndMin_2_C "/" VALUE 0x80071C34 Val_Wu16 65535.00 DFES_OneToOne 0.00 65535.00 FORMAT "%8.2" /end CHARACTERISTIC
/begin CHARACTERISTIC DFC_DisblMsk.DFC_LSUCircVirtGndMin_3_C "/" VALUE 0x80071C36 Val_Wu16 65535.00 DFES_OneToOne 0.00 65535.00 FORMAT "%8.2" /end CHARACTERISTIC
/begin CHARACTERISTIC DFC_DisblMsk.DFC_LSUCircVirtGndSig_0_C "/" VALUE 0x80071C38 Val_Wu16 65535.00 DFES_OneToOne 0.00 65535.00 FORMAT "%8.2" /end CHARACTERISTIC
/begin CHARACTERISTIC DFC_DisblMsk.DFC_LSUCircVirtGndSig_1_C "/" VALUE 0x80071C3A Val_Wu16 65535.00 DFES_OneToOne 0.00 65535.00 FORMAT "%8.2" /end CHARACTERISTIC
/begin CHARACTERISTIC DFC_DisblMsk.DFC_LSUCircVirtGndSig_2_C "/" VALUE 0x80071C3C Val_Wu16 65535.00 DFES_OneToOne 0.00 65535.00 FORMAT "%8.2" /end CHARACTERISTIC
/begin CHARACTERISTIC DFC_DisblMsk.DFC_LSUCircVirtGndSig_3_C "/" VALUE 0x80071C3E Val_Wu16 65535.00 DFES_OneToOne 0.00 65535.00 FORMAT "%8.2" /end CHARACTERISTIC
/begin CHARACTERISTIC DFC_DisblMsk.DFC_LSUHtrMax_0_C "/" VALUE 0x80071C40 Val_Wu16 65535.00 DFES_OneToOne 0.00 65535.00 FORMAT "%8.2" /end CHARACTERISTIC
/begin CHARACTERISTIC DFC_DisblMsk.DFC_LSUHtrMax_1_C "/" VALUE 0x80071C42 Val_Wu16 65535.00 DFES_OneToOne 0.00 65535.00 FORMAT "%8.2" /end CHARACTERISTIC
/begin CHARACTERISTIC DFC_DisblMsk.DFC_LSUHtrMax_2_C "/" VALUE 0x80071C44 Val_Wu16 65535.00 DFES_OneToOne 0.00 65535.00 FORMAT "%8.2" /end CHARACTERISTIC
/begin CHARACTERISTIC DFC_DisblMsk.DFC_LSUHtrMax_3_C "/" VALUE 0x80071C46 Val_Wu16 65535.00 DFES_OneToOne 0.00 65535.00 FORMAT "%8.2" /end CHARACTERISTIC
/begin CHARACTERISTIC DFC_DisblMsk.DFC_LSUHtrMin_0_C "/" VALUE 0x80071C48 Val_Wu16 65535.00 DFES_OneToOne 0.00 65535.00 FORMAT "%8.2" /end CHARACTERISTIC
/begin CHARACTERISTIC DFC_DisblMsk.DFC_LSUHtrMin_1_C "/" VALUE 0x80071C4A Val_Wu16 65535.00 DFES_OneToOne 0.00 65535.00 FORMAT "%8.2" /end CHARACTERISTIC
/begin CHARACTERISTIC DFC_DisblMsk.DFC_LSUHtrMin_2_C "/" VALUE 0x80071C4C Val_Wu16 65535.00 DFES_OneToOne 0.00 65535.00 FORMAT "%8.2" /end CHARACTERISTIC
/begin CHARACTERISTIC DFC_DisblMsk.DFC_LSUHtrMin_3_C "/" VALUE 0x80071C4E Val_Wu16 65535.00 DFES_OneToOne 0.00 65535.00 FORMAT "%8.2" /end CHARACTERISTIC
/begin CHARACTERISTIC DFC_DisblMsk.DFC_LSUHtrSig_0_C "/" VALUE 0x80071C50 Val_Wu16 65535.00 DFES_OneToOne 0.00 65535.00 FORMAT "%8.2" /end CHARACTERISTIC
/begin CHARACTERISTIC DFC_DisblMsk.DFC_LSUHtrSig_1_C "/" VALUE 0x80071C52 Val_Wu16 65535.00 DFES_OneToOne 0.00 65535.00 FORMAT "%8.2" /end CHARACTERISTIC
/begin CHARACTERISTIC DFC_DisblMsk.DFC_LSUHtrSig_2_C "/" VALUE 0x80071C54 Val_Wu16 65535.00 DFES_OneToOne 0.00 65535.00 FORMAT "%8.2" /end CHARACTERISTIC
/begin CHARACTERISTIC DFC_DisblMsk.DFC_LSUHtrSig_3_C "/" VALUE 0x80071C56 Val_Wu16 65535.00 DFES_OneToOne 0.00 65535.00 FORMAT "%8.2" /end CHARACTERISTIC
/begin CHARACTERISTIC DFC_DisblMsk.DFC_LSUO2Max_0_C "/" VALUE 0x80071C58 Val_Wu16 65535.00 DFES_OneToOne 0.00 65535.00 FORMAT "%8.2" /end CHARACTERISTIC
/begin CHARACTERISTIC DFC_DisblMsk.DFC_LSUO2Max_1_C "/" VALUE 0x80071C5A Val_Wu16 65535.00 DFES_OneToOne 0.00 65535.00 FORMAT "%8.2" /end CHARACTERISTIC
/begin CHARACTERISTIC DFC_DisblMsk.DFC_LSUO2Max_2_C "/" VALUE 0x80071C5C Val_Wu16 65535.00 DFES_OneToOne 0.00 65535.00 FORMAT "%8.2" /end CHARACTERISTIC
/begin CHARACTERISTIC DFC_DisblMsk.DFC_LSUO2Max_3_C "/" VALUE 0x80071C5E Val_Wu16 65535.00 DFES_OneToOne 0.00 65535.00 FORMAT "%8.2" /end CHARACTERISTIC
/begin CHARACTERISTIC DFC_DisblMsk.DFC_LSUO2Min_0_C "/" VALUE 0x80071C60 Val_Wu16 65535.00 DFES_OneToOne 0.00 65535.00 FORMAT "%8.2" /end CHARACTERISTIC
/begin CHARACTERISTIC DFC_DisblMsk.DFC_LSUO2Min_1_C "/" VALUE 0x80071C62 Val_Wu16 65535.00 DFES_OneToOne 0.00 65535.00 FORMAT "%8.2" /end CHARACTERISTIC
/begin CHARACTERISTIC DFC_DisblMsk.DFC_LSUO2Min_2_C "/" VALUE 0x80071C64 Val_Wu16 65535.00 DFES_OneToOne 0.00 65535.00 FORMAT "%8.2" /end CHARACTERISTIC
/begin CHARACTERISTIC DFC_DisblMsk.DFC_LSUO2Min_3_C "/" VALUE 0x80071C66 Val_Wu16 65535.00 DFES_OneToOne 0.00 65535.00 FORMAT "%8.2" /end CHARACTERISTIC
/begin CHARACTERISTIC DFC_DisblMsk.DFC_LSUSPIBattLowMin_0_C "/" VALUE 0x80071C68 Val_Wu16 65535.00 DFES_OneToOne 0.00 65535.00 FORMAT "%8.2" /end CHARACTERISTIC
/begin CHARACTERISTIC DFC_DisblMsk.DFC_LSUSPIBattLowMin_1_C "/" VALUE 0x80071C6A Val_Wu16 65535.00 DFES_OneToOne 0.00 65535.00 FORMAT "%8.2" /end CHARACTERISTIC
/begin CHARACTERISTIC DFC_DisblMsk.DFC_LSUSPIBattLowMin_2_C "/" VALUE 0x80071C6C Val_Wu16 65535.00 DFES_OneToOne 0.00 65535.00 FORMAT "%8.2" /end CHARACTERISTIC
/begin CHARACTERISTIC DFC_DisblMsk.DFC_LSUSPIBattLowMin_3_C "/" VALUE 0x80071C6E Val_Wu16 65535.00 DFES_OneToOne 0.00 65535.00 FORMAT "%8.2" /end CHARACTERISTIC
/begin CHARACTERISTIC DFC_DisblMsk.DFC_LSUSPISig_0_C "/" VALUE 0x80071C70 Val_Wu16 65535.00 DFES_OneToOne 0.00 65535.00 FORMAT "%8.2" /end CHARACTERISTIC
/begin CHARACTERISTIC DFC_DisblMsk.DFC_LSUSPISig_1_C "/" VALUE 0x80071C72 Val_Wu16 65535.00 DFES_OneToOne 0.00 65535.00 FORMAT "%8.2" /end CHARACTERISTIC
/begin CHARACTERISTIC DFC_DisblMsk.DFC_LSUSPISig_2_C "/" VALUE 0x80071C74 Val_Wu16 65535.00 DFES_OneToOne 0.00 65535.00 FORMAT "%8.2" /end CHARACTERISTIC
/begin CHARACTERISTIC DFC_DisblMsk.DFC_LSUSPISig_3_C "/" VALUE 0x80071C76 Val_Wu16 65535.00 DFES_OneToOne 0.00 65535.00 FORMAT "%8.2" /end CHARACTERISTIC
/begin CHARACTERISTIC DFC_DisblMsk.DFC_LSUtExcMax_0_C "/" VALUE 0x80071C78 Val_Wu16 65535.00 DFES_OneToOne 0.00 65535.00 FORMAT "%8.2" /end CHARACTERISTIC
/begin CHARACTERISTIC DFC_DisblMsk.DFC_LSUtExcMax_1_C "/" VALUE 0x80071C7A Val_Wu16 65535.00 DFES_OneToOne 0.00 65535.00 FORMAT "%8.2" /end CHARACTERISTIC
/begin CHARACTERISTIC DFC_DisblMsk.DFC_LSUtExcMax_2_C "/" VALUE 0x80071C7C Val_Wu16 65535.00 DFES_OneToOne 0.00 65535.00 FORMAT "%8.2" /end CHARACTERISTIC
/begin CHARACTERISTIC DFC_DisblMsk.DFC_LSUtExcMax_3_C "/" VALUE 0x80071C7E Val_Wu16 65535.00 DFES_OneToOne 0.00 65535.00 FORMAT "%8.2" /end CHARACTERISTIC
/begin CHARACTERISTIC DFC_DisblMsk.DFC_LSUtExcMin_0_C "/" VALUE 0x80071C80 Val_Wu16 65535.00 DFES_OneToOne 0.00 65535.00 FORMAT "%8.2" /end CHARACTERISTIC
/begin CHARACTERISTIC DFC_DisblMsk.DFC_LSUtExcMin_1_C "/" VALUE 0x80071C82 Val_Wu16 65535.00 DFES_OneToOne 0.00 65535.00 FORMAT "%8.2" /end CHARACTERISTIC
/begin CHARACTERISTIC DFC_DisblMsk.DFC_LSUtExcMin_2_C "/" VALUE 0x80071C84 Val_Wu16 65535.00 DFES_OneToOne 0.00 65535.00 FORMAT "%8.2" /end CHARACTERISTIC
/begin CHARACTERISTIC DFC_DisblMsk.DFC_LSUtExcMin_3_C "/" VALUE 0x80071C86 Val_Wu16 65535.00 DFES_OneToOne 0.00 65535.00 FORMAT "%8.2" /end CHARACTERISTIC
/begin CHARACTERISTIC DFC_DisblMsk.DFC_MILOL_C "/" VALUE 0x80071C88 Val_Wu16 65535.00 DFES_OneToOne 0.00 65535.00 FORMAT "%8.2" /end CHARACTERISTIC
/begin CHARACTERISTIC DFC_DisblMsk.DFC_MILSCB_C "/" VALUE 0x80071C8A Val_Wu16 65535.00 DFES_OneToOne 0.00 65535.00 FORMAT "%8.2" /end CHARACTERISTIC
/begin CHARACTERISTIC DFC_DisblMsk.DFC_MILSCG_C "/" VALUE 0x80071C8C Val_Wu16 65535.00 DFES_OneToOne 0.00 65535.00 FORMAT "%8.2" /end CHARACTERISTIC
/begin CHARACTERISTIC DFC_DisblMsk.DFC_MeUnSCG_C "/" VALUE 0x80071C8E Val_Wu16 65535.00 DFES_OneToOne 0.00 65535.00 FORMAT "%8.2" /end CHARACTERISTIC
/begin CHARACTERISTIC DFC_DisblMsk.DFC_NplHsChngPPFltDiff_C "/" VALUE 0x80071C90 Val_Wu16 65535.00 DFES_OneToOne 0.00 65535.00 FORMAT "%8.2" /end CHARACTERISTIC
/begin CHARACTERISTIC DFC_DisblMsk.DFC_NplPAirFltDs_C "/" VALUE 0x80071C92 Val_Wu16 65535.00 DFES_OneToOne 0.00 65535.00 FORMAT "%8.2" /end CHARACTERISTIC
/begin CHARACTERISTIC DFC_DisblMsk.DFC_NplTPFltUs_C "/" VALUE 0x80071C94 Val_Wu16 65535.00 DFES_OneToOne 0.00 65535.00 FORMAT "%8.2" /end CHARACTERISTIC
/begin CHARACTERISTIC DFC_DisblMsk.DFC_OilComErr_C "/" VALUE 0x80071C96 Val_Wu16 65535.00 DFES_OneToOne 0.00 65535.00 FORMAT "%8.2" /end CHARACTERISTIC
/begin CHARACTERISTIC DFC_DisblMsk.DFC_OilPLmpOL_C "/" VALUE 0x80071C98 Val_Wu16 65535.00 DFES_OneToOne 0.00 65535.00 FORMAT "%8.2" /end CHARACTERISTIC
/begin CHARACTERISTIC DFC_DisblMsk.DFC_OilPLmpSCB_C "/" VALUE 0x80071C9A Val_Wu16 65535.00 DFES_OneToOne 0.00 65535.00 FORMAT "%8.2" /end CHARACTERISTIC
/begin CHARACTERISTIC DFC_DisblMsk.DFC_OilPLmpSCG_C "/" VALUE 0x80071C9C Val_Wu16 65535.00 DFES_OneToOne 0.00 65535.00 FORMAT "%8.2" /end CHARACTERISTIC
/begin CHARACTERISTIC DFC_DisblMsk.DFC_OilPNpl_C "/" VALUE 0x80071C9E Val_Wu16 65535.00 DFES_OneToOne 0.00 65535.00 FORMAT "%8.2" /end CHARACTERISTIC
/begin CHARACTERISTIC DFC_DisblMsk.DFC_OilTNpl_C "/" VALUE 0x80071CA0 Val_Wu16 65535.00 DFES_OneToOne 0.00 65535.00 FORMAT "%8.2" /end CHARACTERISTIC
/begin CHARACTERISTIC DFC_DisblMsk.DFC_OilTSRCMax_C "/" VALUE 0x80071CA2 Val_Wu16 65535.00 DFES_OneToOne 0.00 65535.00 FORMAT "%8.2" /end CHARACTERISTIC
/begin CHARACTERISTIC DFC_DisblMsk.DFC_OilTSRCMin_C "/" VALUE 0x80071CA4 Val_Wu16 65535.00 DFES_OneToOne 0.00 65535.00 FORMAT "%8.2" /end CHARACTERISTIC
/begin CHARACTERISTIC DFC_DisblMsk.DFC_PCACDsEnvPPls_C "/" VALUE 0x80071CA6 Val_Wu16 65535.00 DFES_OneToOne 0.00 65535.00 FORMAT "%8.2" /end CHARACTERISTIC
/begin CHARACTERISTIC DFC_DisblMsk.DFC_PCACDsSRCMax_C "/" VALUE 0x80071CA8 Val_Wu16 65535.00 DFES_OneToOne 0.00 65535.00 FORMAT "%8.2" /end CHARACTERISTIC
/begin CHARACTERISTIC DFC_DisblMsk.DFC_PCACDsSRCMin_C "/" VALUE 0x80071CAA Val_Wu16 65535.00 DFES_OneToOne 0.00 65535.00 FORMAT "%8.2" /end CHARACTERISTIC
/begin CHARACTERISTIC DFC_DisblMsk.DFC_PCVSCG_C "/" VALUE 0x80071CAC Val_Wu16 65535.00 DFES_OneToOne 0.00 65535.00 FORMAT "%8.2" /end CHARACTERISTIC
/begin CHARACTERISTIC DFC_DisblMsk.DFC_PFltCharPDiffMin_C "/" VALUE 0x80071CAE Val_Wu16 65535.00 DFES_OneToOne 0.00 65535.00 FORMAT "%8.2" /end CHARACTERISTIC
/begin CHARACTERISTIC DFC_DisblMsk.DFC_PFltDstrMin_C "/" VALUE 0x80071CB0 Val_Wu16 65535.00 DFES_OneToOne 0.00 65535.00 FORMAT "%8.2" /end CHARACTERISTIC
/begin CHARACTERISTIC DFC_DisblMsk.DFC_PFltEngPrt_C "/" VALUE 0x80071CB2 Val_Wu16 65535.00 DFES_OneToOne 0.00 65535.00 FORMAT "%8.2" /end CHARACTERISTIC
/begin CHARACTERISTIC DFC_DisblMsk.DFC_PFltLmpOL_C "/" VALUE 0x80071CB4 Val_Wu16 65535.00 DFES_OneToOne 0.00 65535.00 FORMAT "%8.2" /end CHARACTERISTIC
/begin CHARACTERISTIC DFC_DisblMsk.DFC_PFltLmpSCB_C "/" VALUE 0x80071CB6 Val_Wu16 65535.00 DFES_OneToOne 0.00 65535.00 FORMAT "%8.2" /end CHARACTERISTIC
/begin CHARACTERISTIC DFC_DisblMsk.DFC_PFltLmpSCG_C "/" VALUE 0x80071CB8 Val_Wu16 65535.00 DFES_OneToOne 0.00 65535.00 FORMAT "%8.2" /end CHARACTERISTIC
/begin CHARACTERISTIC DFC_DisblMsk.DFC_PFltRgnPerm_C "/" VALUE 0x80071CBA Val_Wu16 65535.00 DFES_OneToOne 0.00 65535.00 FORMAT "%8.2" /end CHARACTERISTIC
/begin CHARACTERISTIC DFC_DisblMsk.DFC_PFltSRCMaxFlwRstn_C "/" VALUE 0x80071CBC Val_Wu16 65535.00 DFES_OneToOne 0.00 65535.00 FORMAT "%8.2" /end CHARACTERISTIC
/begin CHARACTERISTIC DFC_DisblMsk.DFC_PFltSRCMinFlwRstn_C "/" VALUE 0x80071CBE Val_Wu16 65535.00 DFES_OneToOne 0.00 65535.00 FORMAT "%8.2" /end CHARACTERISTIC
/begin CHARACTERISTIC DFC_DisblMsk.DFC_PFltSotMsDvtMax_C "/" VALUE 0x80071CC0 Val_Wu16 65535.00 DFES_OneToOne 0.00 65535.00 FORMAT "%8.2" /end CHARACTERISTIC
/begin CHARACTERISTIC DFC_DisblMsk.DFC_PFltSotMsDvtMin_C "/" VALUE 0x80071CC2 Val_Wu16 65535.00 DFES_OneToOne 0.00 65535.00 FORMAT "%8.2" /end CHARACTERISTIC
/begin CHARACTERISTIC DFC_DisblMsk.DFC_PFltSotMsMax_C "/" VALUE 0x80071CC4 Val_Wu16 65535.00 DFES_OneToOne 0.00 65535.00 FORMAT "%8.2" /end CHARACTERISTIC
/begin CHARACTERISTIC DFC_DisblMsk.DFC_PSPOL_C "/" VALUE 0x80071CC6 Val_Wu16 65535.00 DFES_OneToOne 0.00 65535.00 FORMAT "%8.2" /end CHARACTERISTIC
/begin CHARACTERISTIC DFC_DisblMsk.DFC_PSPSCB_C "/" VALUE 0x80071CC8 Val_Wu16 65535.00 DFES_OneToOne 0.00 65535.00 FORMAT "%8.2" /end CHARACTERISTIC
/begin CHARACTERISTIC DFC_DisblMsk.DFC_PSPSCG_C "/" VALUE 0x80071CCA Val_Wu16 65535.00 DFES_OneToOne 0.00 65535.00 FORMAT "%8.2" /end CHARACTERISTIC
/begin CHARACTERISTIC DFC_DisblMsk.DFC_SRCHighAPP1_C "/" VALUE 0x80071CCC Val_Wu16 65535.00 DFES_OneToOne 0.00 65535.00 FORMAT "%8.2" /end CHARACTERISTIC
/begin CHARACTERISTIC DFC_DisblMsk.DFC_SRCHighAPP2_C "/" VALUE 0x80071CCE Val_Wu16 65535.00 DFES_OneToOne 0.00 65535.00 FORMAT "%8.2" /end CHARACTERISTIC
/begin CHARACTERISTIC DFC_DisblMsk.DFC_SRCLowAPP1_C "/" VALUE 0x80071CD0 Val_Wu16 65535.00 DFES_OneToOne 0.00 65535.00 FORMAT "%8.2" /end CHARACTERISTIC
/begin CHARACTERISTIC DFC_DisblMsk.DFC_SRCLowAPP2_C "/" VALUE 0x80071CD2 Val_Wu16 65535.00 DFES_OneToOne 0.00 65535.00 FORMAT "%8.2" /end CHARACTERISTIC
/begin CHARACTERISTIC DFC_DisblMsk.DFC_SRCMaxPAirFltDs_C "/" VALUE 0x80071CD4 Val_Wu16 65535.00 DFES_OneToOne 0.00 65535.00 FORMAT "%8.2" /end CHARACTERISTIC
/begin CHARACTERISTIC DFC_DisblMsk.DFC_SRCMaxPPFltUs_C "/" VALUE 0x80071CD6 Val_Wu16 65535.00 DFES_OneToOne 0.00 65535.00 FORMAT "%8.2" /end CHARACTERISTIC
/begin CHARACTERISTIC DFC_DisblMsk.DFC_SRCMaxTECU_C "/" VALUE 0x80071CD8 Val_Wu16 65535.00 DFES_OneToOne 0.00 65535.00 FORMAT "%8.2" /end CHARACTERISTIC
/begin CHARACTERISTIC DFC_DisblMsk.DFC_SRCMaxTOxiCatUs_C "/" VALUE 0x80071CDA Val_Wu16 65535.00 DFES_OneToOne 0.00 65535.00 FORMAT "%8.2" /end CHARACTERISTIC
/begin CHARACTERISTIC DFC_DisblMsk.DFC_SRCMaxTPFltUs_C "/" VALUE 0x80071CDC Val_Wu16 65535.00 DFES_OneToOne 0.00 65535.00 FORMAT "%8.2" /end CHARACTERISTIC
/begin CHARACTERISTIC DFC_DisblMsk.DFC_SRCMinPAirFltDs_C "/" VALUE 0x80071CDE Val_Wu16 65535.00 DFES_OneToOne 0.00 65535.00 FORMAT "%8.2" /end CHARACTERISTIC
/begin CHARACTERISTIC DFC_DisblMsk.DFC_SRCMinPPFltUs_C "/" VALUE 0x80071CE0 Val_Wu16 65535.00 DFES_OneToOne 0.00 65535.00 FORMAT "%8.2" /end CHARACTERISTIC
/begin CHARACTERISTIC DFC_DisblMsk.DFC_SRCMinTECU_C "/" VALUE 0x80071CE2 Val_Wu16 65535.00 DFES_OneToOne 0.00 65535.00 FORMAT "%8.2" /end CHARACTERISTIC
/begin CHARACTERISTIC DFC_DisblMsk.DFC_SRCMinTOxiCatUs_C "/" VALUE 0x80071CE4 Val_Wu16 65535.00 DFES_OneToOne 0.00 65535.00 FORMAT "%8.2" /end CHARACTERISTIC
/begin CHARACTERISTIC DFC_DisblMsk.DFC_SRCMinTPFltUs_C "/" VALUE 0x80071CE6 Val_Wu16 65535.00 DFES_OneToOne 0.00 65535.00 FORMAT "%8.2" /end CHARACTERISTIC
/begin CHARACTERISTIC DFC_DisblMsk.DFC_SVSOL_C "/" VALUE 0x80071CE8 Val_Wu16 65535.00 DFES_OneToOne 0.00 65535.00 FORMAT "%8.2" /end CHARACTERISTIC
/begin CHARACTERISTIC DFC_DisblMsk.DFC_SVSSCB_C "/" VALUE 0x80071CEA Val_Wu16 65535.00 DFES_OneToOne 0.00 65535.00 FORMAT "%8.2" /end CHARACTERISTIC
/begin CHARACTERISTIC DFC_DisblMsk.DFC_SVSSCG_C "/" VALUE 0x80071CEC Val_Wu16 65535.00 DFES_OneToOne 0.00 65535.00 FORMAT "%8.2" /end CHARACTERISTIC
/begin CHARACTERISTIC DFC_DisblMsk.DFC_StrtOL_C "/" VALUE 0x80071CEE Val_Wu16 65535.00 DFES_OneToOne 0.00 65535.00 FORMAT "%8.2" /end CHARACTERISTIC
/begin CHARACTERISTIC DFC_DisblMsk.DFC_StrtSCB_C "/" VALUE 0x80071CF0 Val_Wu16 65535.00 DFES_OneToOne 0.00 65535.00 FORMAT "%8.2" /end CHARACTERISTIC
/begin CHARACTERISTIC DFC_DisblMsk.DFC_StrtSCG_C "/" VALUE 0x80071CF2 Val_Wu16 65535.00 DFES_OneToOne 0.00 65535.00 FORMAT "%8.2" /end CHARACTERISTIC
/begin CHARACTERISTIC DFC_DisblMsk.DFC_SyncAPP_C "/" VALUE 0x80071CF4 Val_Wu16 65535.00 DFES_OneToOne 0.00 65535.00 FORMAT "%8.2" /end CHARACTERISTIC
/begin CHARACTERISTIC DFC_DisblMsk.DFC_T15Npl_C "/" VALUE 0x80071CF6 Val_Wu16 65535.00 DFES_OneToOne 0.00 65535.00 FORMAT "%8.2" /end CHARACTERISTIC
/begin CHARACTERISTIC DFC_DisblMsk.DFC_TAFSDtyCycHi_C "/" VALUE 0x80071CF8 Val_Wu16 65535.00 DFES_OneToOne 0.00 65535.00 FORMAT "%8.2" /end CHARACTERISTIC
/begin CHARACTERISTIC DFC_DisblMsk.DFC_TAFSDtyCycLo_C "/" VALUE 0x80071CFA Val_Wu16 65535.00 DFES_OneToOne 0.00 65535.00 FORMAT "%8.2" /end CHARACTERISTIC
/begin CHARACTERISTIC DFC_DisblMsk.DFC_TAFSPerHi_C "/" VALUE 0x80071CFC Val_Wu16 65535.00 DFES_OneToOne 0.00 65535.00 FORMAT "%8.2" /end CHARACTERISTIC
/begin CHARACTERISTIC DFC_DisblMsk.DFC_TAFSPerLo_C "/" VALUE 0x80071CFE Val_Wu16 65535.00 DFES_OneToOne 0.00 65535.00 FORMAT "%8.2" /end CHARACTERISTIC
/begin CHARACTERISTIC DFC_DisblMsk.DFC_TCACDsSRCMax_C "/" VALUE 0x80071D00 Val_Wu16 65535.00 DFES_OneToOne 0.00 65535.00 FORMAT "%8.2" /end CHARACTERISTIC
/begin CHARACTERISTIC DFC_DisblMsk.DFC_TCACDsSRCMin_C "/" VALUE 0x80071D02 Val_Wu16 65535.00 DFES_OneToOne 0.00 65535.00 FORMAT "%8.2" /end CHARACTERISTIC
/begin CHARACTERISTIC DFC_DisblMsk.DFC_ThrVlvOL_C "/" VALUE 0x80071D04 Val_Wu16 65535.00 DFES_OneToOne 0.00 65535.00 FORMAT "%8.2" /end CHARACTERISTIC
/begin CHARACTERISTIC DFC_DisblMsk.DFC_ThrVlvSCB_C "/" VALUE 0x80071D06 Val_Wu16 65535.00 DFES_OneToOne 0.00 65535.00 FORMAT "%8.2" /end CHARACTERISTIC
/begin CHARACTERISTIC DFC_DisblMsk.DFC_ThrVlvSRCMax_C "/" VALUE 0x80071D08 Val_Wu16 65535.00 DFES_OneToOne 0.00 65535.00 FORMAT "%8.2" /end CHARACTERISTIC
/begin CHARACTERISTIC DFC_DisblMsk.DFC_ThrVlvSRCMin_C "/" VALUE 0x80071D0A Val_Wu16 65535.00 DFES_OneToOne 0.00 65535.00 FORMAT "%8.2" /end CHARACTERISTIC
/begin CHARACTERISTIC DFC_DisblMsk.DFC_TrbChLPOL_C "/" VALUE 0x80071D0C Val_Wu16 65535.00 DFES_OneToOne 0.00 65535.00 FORMAT "%8.2" /end CHARACTERISTIC
/begin CHARACTERISTIC DFC_DisblMsk.DFC_TrbChLPSCB_C "/" VALUE 0x80071D0E Val_Wu16 65535.00 DFES_OneToOne 0.00 65535.00 FORMAT "%8.2" /end CHARACTERISTIC
/begin CHARACTERISTIC DFC_DisblMsk.DFC_TrbChLPSCG_C "/" VALUE 0x80071D10 Val_Wu16 65535.00 DFES_OneToOne 0.00 65535.00 FORMAT "%8.2" /end CHARACTERISTIC
/begin CHARACTERISTIC DFC_DisblMsk.DFC_TrbChOL_C "/" VALUE 0x80071D12 Val_Wu16 65535.00 DFES_OneToOne 0.00 65535.00 FORMAT "%8.2" /end CHARACTERISTIC
/begin CHARACTERISTIC DFC_DisblMsk.DFC_TrbChSCB_C "/" VALUE 0x80071D14 Val_Wu16 65535.00 DFES_OneToOne 0.00 65535.00 FORMAT "%8.2" /end CHARACTERISTIC
/begin CHARACTERISTIC DFC_DisblMsk.DFC_VSwVlvGovDvtMax_C "/" VALUE 0x80071D16 Val_Wu16 65535.00 DFES_OneToOne 0.00 65535.00 FORMAT "%8.2" /end CHARACTERISTIC
/begin CHARACTERISTIC DFC_DisblMsk.DFC_VSwVlvGovDvtMin_C "/" VALUE 0x80071D18 Val_Wu16 65535.00 DFES_OneToOne 0.00 65535.00 FORMAT "%8.2" /end CHARACTERISTIC
/begin CHARACTERISTIC DFC_DisblMsk.DFC_VSwVlvOL_C "/" VALUE 0x80071D1A Val_Wu16 65535.00 DFES_OneToOne 0.00 65535.00 FORMAT "%8.2" /end CHARACTERISTIC
/begin CHARACTERISTIC DFC_DisblMsk.DFC_VSwVlvSCB_C "/" VALUE 0x80071D1C Val_Wu16 65535.00 DFES_OneToOne 0.00 65535.00 FORMAT "%8.2" /end CHARACTERISTIC
/begin CHARACTERISTIC DFC_DisblMsk.DFC_VSwVlvSCG_C "/" VALUE 0x80071D1E Val_Wu16 65535.00 DFES_OneToOne 0.00 65535.00 FORMAT "%8.2" /end CHARACTERISTIC
/begin CHARACTERISTIC DFC_DisblMsk.DFC_VSwVlvSRCMax_C "/" VALUE 0x80071D20 Val_Wu16 65535.00 DFES_OneToOne 0.00 65535.00 FORMAT "%8.2" /end CHARACTERISTIC
/begin CHARACTERISTIC DFC_DisblMsk.DFC_VSwVlvSRCMin_C "/" VALUE 0x80071D22 Val_Wu16 65535.00 DFES_OneToOne 0.00 65535.00 FORMAT "%8.2" /end CHARACTERISTIC
/begin CHARACTERISTIC DFC_DisblMsk.DFC_VehVHW_C "/" VALUE 0x80071D24 Val_Wu16 65535.00 DFES_OneToOne 0.00 65535.00 FORMAT "%8.2" /end CHARACTERISTIC
/begin CHARACTERISTIC DFC_DisblMsk.DFC_VehVMax_C "/" VALUE 0x80071D26 Val_Wu16 65535.00 DFES_OneToOne 0.00 65535.00 FORMAT "%8.2" /end CHARACTERISTIC
/begin CHARACTERISTIC DFC_DisblMsk.DFC_VehVPlaus_C "/" VALUE 0x80071D28 Val_Wu16 65535.00 DFES_OneToOne 0.00 65535.00 FORMAT "%8.2" /end CHARACTERISTIC
/begin CHARACTERISTIC DFC_DisblMsk.DFC_VehVSig_C "/" VALUE 0x80071D2A Val_Wu16 65535.00 DFES_OneToOne 0.00 65535.00 FORMAT "%8.2" /end CHARACTERISTIC
/begin CHARACTERISTIC DFC_DisblMsk.DFC_WaHtElOL_C "/" VALUE 0x80071D2C Val_Wu16 65535.00 DFES_OneToOne 0.00 65535.00 FORMAT "%8.2" /end CHARACTERISTIC
/begin CHARACTERISTIC DFC_DisblMsk.DFC_WaHtElSCB_C "/" VALUE 0x80071D2E Val_Wu16 65535.00 DFES_OneToOne 0.00 65535.00 FORMAT "%8.2" /end CHARACTERISTIC
/begin CHARACTERISTIC DFC_DisblMsk.DFC_ClthNpl_C "/" VALUE 0x80071D30 Val_Wu16 65535.00 DFES_OneToOne 0.00 65535.00 FORMAT "%8.2" /end CHARACTERISTIC
/begin CHARACTERISTIC DFC_DisblMsk.DFC_ETClbETMax_0_C "/" VALUE 0x80071D32 Val_Wu16 65535.00 DFES_OneToOne 0.00 65535.00 FORMAT "%8.2" /end CHARACTERISTIC
/begin CHARACTERISTIC DFC_DisblMsk.DFC_ETClbETMax_1_C "/" VALUE 0x80071D34 Val_Wu16 65535.00 DFES_OneToOne 0.00 65535.00 FORMAT "%8.2" /end CHARACTERISTIC
/begin CHARACTERISTIC DFC_DisblMsk.DFC_ETClbETMax_2_C "/" VALUE 0x80071D36 Val_Wu16 65535.00 DFES_OneToOne 0.00 65535.00 FORMAT "%8.2" /end CHARACTERISTIC
/begin CHARACTERISTIC DFC_DisblMsk.DFC_ETClbETMax_3_C "/" VALUE 0x80071D38 Val_Wu16 65535.00 DFES_OneToOne 0.00 65535.00 FORMAT "%8.2" /end CHARACTERISTIC
/begin CHARACTERISTIC DFC_DisblMsk.DFC_ETClbETMax_4_C "/" VALUE 0x80071D3A Val_Wu16 65535.00 DFES_OneToOne 0.00 65535.00 FORMAT "%8.2" /end CHARACTERISTIC
/begin CHARACTERISTIC DFC_DisblMsk.DFC_ETClbETMax_5_C "/" VALUE 0x80071D3C Val_Wu16 65535.00 DFES_OneToOne 0.00 65535.00 FORMAT "%8.2" /end CHARACTERISTIC
/begin CHARACTERISTIC DFC_DisblMsk.DFC_ETClbETMin_0_C "/" VALUE 0x80071D3E Val_Wu16 65535.00 DFES_OneToOne 0.00 65535.00 FORMAT "%8.2" /end CHARACTERISTIC
/begin CHARACTERISTIC DFC_DisblMsk.DFC_ETClbETMin_1_C "/" VALUE 0x80071D40 Val_Wu16 65535.00 DFES_OneToOne 0.00 65535.00 FORMAT "%8.2" /end CHARACTERISTIC
/begin CHARACTERISTIC DFC_DisblMsk.DFC_ETClbETMin_2_C "/" VALUE 0x80071D42 Val_Wu16 65535.00 DFES_OneToOne 0.00 65535.00 FORMAT "%8.2" /end CHARACTERISTIC
/begin CHARACTERISTIC DFC_DisblMsk.DFC_ETClbETMin_3_C "/" VALUE 0x80071D44 Val_Wu16 65535.00 DFES_OneToOne 0.00 65535.00 FORMAT "%8.2" /end CHARACTERISTIC
/begin CHARACTERISTIC DFC_DisblMsk.DFC_ETClbETMin_4_C "/" VALUE 0x80071D46 Val_Wu16 65535.00 DFES_OneToOne 0.00 65535.00 FORMAT "%8.2" /end CHARACTERISTIC
/begin CHARACTERISTIC DFC_DisblMsk.DFC_ETClbETMin_5_C "/" VALUE 0x80071D48 Val_Wu16 65535.00 DFES_OneToOne 0.00 65535.00 FORMAT "%8.2" /end CHARACTERISTIC
/begin CHARACTERISTIC DFC_DisblMsk.DFC_IVDiaBnkShCirBSH_0_C "/" VALUE 0x80071D4A Val_Wu16 65535.00 DFES_OneToOne 0.00 65535.00 FORMAT "%8.2" /end CHARACTERISTIC
/begin CHARACTERISTIC DFC_DisblMsk.DFC_IVDiaBnkShCirBSH_1_C "/" VALUE 0x80071D4C Val_Wu16 65535.00 DFES_OneToOne 0.00 65535.00 FORMAT "%8.2" /end CHARACTERISTIC
/begin CHARACTERISTIC DFC_DisblMsk.DFC_IVDiaBnkShCirChSwt_0_C "/" VALUE 0x80071D4E Val_Wu16 65535.00 DFES_OneToOne 0.00 65535.00 FORMAT "%8.2" /end CHARACTERISTIC
/begin CHARACTERISTIC DFC_DisblMsk.DFC_IVDiaBnkShCirChSwt_1_C "/" VALUE 0x80071D50 Val_Wu16 65535.00 DFES_OneToOne 0.00 65535.00 FORMAT "%8.2" /end CHARACTERISTIC
/begin CHARACTERISTIC DFC_DisblMsk.DFC_IVDiaBnkShCirHSBatt_0_C "/" VALUE 0x80071D52 Val_Wu16 65535.00 DFES_OneToOne 0.00 65535.00 FORMAT "%8.2" /end CHARACTERISTIC
/begin CHARACTERISTIC DFC_DisblMsk.DFC_IVDiaBnkShCirHSBatt_1_C "/" VALUE 0x80071D54 Val_Wu16 65535.00 DFES_OneToOne 0.00 65535.00 FORMAT "%8.2" /end CHARACTERISTIC
/begin CHARACTERISTIC DFC_DisblMsk.DFC_IVDiaBnkShCirHiRstnc_0_C "/" VALUE 0x80071D56 Val_Wu16 65535.00 DFES_OneToOne 0.00 65535.00 FORMAT "%8.2" /end CHARACTERISTIC
/begin CHARACTERISTIC DFC_DisblMsk.DFC_IVDiaBnkShCirHiRstnc_1_C "/" VALUE 0x80071D58 Val_Wu16 65535.00 DFES_OneToOne 0.00 65535.00 FORMAT "%8.2" /end CHARACTERISTIC
/begin CHARACTERISTIC DFC_DisblMsk.DFC_IVDiaBnkShCirLSHSGnd_0_C "/" VALUE 0x80071D5A Val_Wu16 65535.00 DFES_OneToOne 0.00 65535.00 FORMAT "%8.2" /end CHARACTERISTIC
/begin CHARACTERISTIC DFC_DisblMsk.DFC_IVDiaBnkShCirLSHSGnd_1_C "/" VALUE 0x80071D5C Val_Wu16 65535.00 DFES_OneToOne 0.00 65535.00 FORMAT "%8.2" /end CHARACTERISTIC
/begin CHARACTERISTIC DFC_DisblMsk.DFC_IVDiaBnkShCirTransfer_0_C "/" VALUE 0x80071D5E Val_Wu16 65535.00 DFES_OneToOne 0.00 65535.00 FORMAT "%8.2" /end CHARACTERISTIC
/begin CHARACTERISTIC DFC_DisblMsk.DFC_IVDiaBnkShCirTransfer_1_C "/" VALUE 0x80071D60 Val_Wu16 65535.00 DFES_OneToOne 0.00 65535.00 FORMAT "%8.2" /end CHARACTERISTIC
/begin CHARACTERISTIC DFC_DisblMsk.DFC_IVDiaCylNoCls_0_C "/" VALUE 0x80071D62 Val_Wu16 65535.00 DFES_OneToOne 0.00 65535.00 FORMAT "%8.2" /end CHARACTERISTIC
/begin CHARACTERISTIC DFC_DisblMsk.DFC_IVDiaCylNoCls_1_C "/" VALUE 0x80071D64 Val_Wu16 65535.00 DFES_OneToOne 0.00 65535.00 FORMAT "%8.2" /end CHARACTERISTIC
/begin CHARACTERISTIC DFC_DisblMsk.DFC_IVDiaCylNoCls_2_C "/" VALUE 0x80071D66 Val_Wu16 65535.00 DFES_OneToOne 0.00 65535.00 FORMAT "%8.2" /end CHARACTERISTIC
/begin CHARACTERISTIC DFC_DisblMsk.DFC_IVDiaCylNoCls_3_C "/" VALUE 0x80071D68 Val_Wu16 65535.00 DFES_OneToOne 0.00 65535.00 FORMAT "%8.2" /end CHARACTERISTIC
/begin CHARACTERISTIC DFC_DisblMsk.DFC_IVDiaCylNoCls_4_C "/" VALUE 0x80071D6A Val_Wu16 65535.00 DFES_OneToOne 0.00 65535.00 FORMAT "%8.2" /end CHARACTERISTIC
/begin CHARACTERISTIC DFC_DisblMsk.DFC_IVDiaCylNoCls_5_C "/" VALUE 0x80071D6C Val_Wu16 65535.00 DFES_OneToOne 0.00 65535.00 FORMAT "%8.2" /end CHARACTERISTIC
/begin CHARACTERISTIC DFC_DisblMsk.DFC_IVDiaCylNoLd_0_C "/" VALUE 0x80071D6E Val_Wu16 65535.00 DFES_OneToOne 0.00 65535.00 FORMAT "%8.2" /end CHARACTERISTIC
/begin CHARACTERISTIC DFC_DisblMsk.DFC_IVDiaCylNoLd_1_C "/" VALUE 0x80071D70 Val_Wu16 65535.00 DFES_OneToOne 0.00 65535.00 FORMAT "%8.2" /end CHARACTERISTIC
/begin CHARACTERISTIC DFC_DisblMsk.DFC_IVDiaCylNoLd_2_C "/" VALUE 0x80071D72 Val_Wu16 65535.00 DFES_OneToOne 0.00 65535.00 FORMAT "%8.2" /end CHARACTERISTIC
/begin CHARACTERISTIC DFC_DisblMsk.DFC_IVDiaCylNoLd_3_C "/" VALUE 0x80071D74 Val_Wu16 65535.00 DFES_OneToOne 0.00 65535.00 FORMAT "%8.2" /end CHARACTERISTIC
/begin CHARACTERISTIC DFC_DisblMsk.DFC_IVDiaCylNoLd_4_C "/" VALUE 0x80071D76 Val_Wu16 65535.00 DFES_OneToOne 0.00 65535.00 FORMAT "%8.2" /end CHARACTERISTIC
/begin CHARACTERISTIC DFC_DisblMsk.DFC_IVDiaCylNoLd_5_C "/" VALUE 0x80071D78 Val_Wu16 65535.00 DFES_OneToOne 0.00 65535.00 FORMAT "%8.2" /end CHARACTERISTIC
/begin CHARACTERISTIC DFC_DisblMsk.DFC_IVDiaCylShCirHiRstnc_0_C "/" VALUE 0x80071D7A Val_Wu16 65535.00 DFES_OneToOne 0.00 65535.00 FORMAT "%8.2" /end CHARACTERISTIC
/begin CHARACTERISTIC DFC_DisblMsk.DFC_IVDiaCylShCirHiRstnc_1_C "/" VALUE 0x80071D7C Val_Wu16 65535.00 DFES_OneToOne 0.00 65535.00 FORMAT "%8.2" /end CHARACTERISTIC
/begin CHARACTERISTIC DFC_DisblMsk.DFC_IVDiaCylShCirHiRstnc_2_C "/" VALUE 0x80071D7E Val_Wu16 65535.00 DFES_OneToOne 0.00 65535.00 FORMAT "%8.2" /end CHARACTERISTIC
/begin CHARACTERISTIC DFC_DisblMsk.DFC_IVDiaCylShCirHiRstnc_3_C "/" VALUE 0x80071D80 Val_Wu16 65535.00 DFES_OneToOne 0.00 65535.00 FORMAT "%8.2" /end CHARACTERISTIC
/begin CHARACTERISTIC DFC_DisblMsk.DFC_IVDiaCylShCirHiRstnc_4_C "/" VALUE 0x80071D82 Val_Wu16 65535.00 DFES_OneToOne 0.00 65535.00 FORMAT "%8.2" /end CHARACTERISTIC
/begin CHARACTERISTIC DFC_DisblMsk.DFC_IVDiaCylShCirHiRstnc_5_C "/" VALUE 0x80071D84 Val_Wu16 65535.00 DFES_OneToOne 0.00 65535.00 FORMAT "%8.2" /end CHARACTERISTIC
/begin CHARACTERISTIC DFC_DisblMsk.DFC_IVDiaCylShCirLSBatt_0_C "/" VALUE 0x80071D86 Val_Wu16 65535.00 DFES_OneToOne 0.00 65535.00 FORMAT "%8.2" /end CHARACTERISTIC
/begin CHARACTERISTIC DFC_DisblMsk.DFC_IVDiaCylShCirLSBatt_1_C "/" VALUE 0x80071D88 Val_Wu16 65535.00 DFES_OneToOne 0.00 65535.00 FORMAT "%8.2" /end CHARACTERISTIC
/begin CHARACTERISTIC DFC_DisblMsk.DFC_IVDiaCylShCirLSBatt_2_C "/" VALUE 0x80071D8A Val_Wu16 65535.00 DFES_OneToOne 0.00 65535.00 FORMAT "%8.2" /end CHARACTERISTIC
/begin CHARACTERISTIC DFC_DisblMsk.DFC_IVDiaCylShCirLSBatt_3_C "/" VALUE 0x80071D8C Val_Wu16 65535.00 DFES_OneToOne 0.00 65535.00 FORMAT "%8.2" /end CHARACTERISTIC
/begin CHARACTERISTIC DFC_DisblMsk.DFC_IVDiaCylShCirLSBatt_4_C "/" VALUE 0x80071D8E Val_Wu16 65535.00 DFES_OneToOne 0.00 65535.00 FORMAT "%8.2" /end CHARACTERISTIC
/begin CHARACTERISTIC DFC_DisblMsk.DFC_IVDiaCylShCirLSBatt_5_C "/" VALUE 0x80071D90 Val_Wu16 65535.00 DFES_OneToOne 0.00 65535.00 FORMAT "%8.2" /end CHARACTERISTIC
/begin CHARACTERISTIC DFC_DisblMsk.DFC_IVDiaCylShCirLSHS_0_C "/" VALUE 0x80071D92 Val_Wu16 65535.00 DFES_OneToOne 0.00 65535.00 FORMAT "%8.2" /end CHARACTERISTIC
/begin CHARACTERISTIC DFC_DisblMsk.DFC_IVDiaCylShCirLSHS_1_C "/" VALUE 0x80071D94 Val_Wu16 65535.00 DFES_OneToOne 0.00 65535.00 FORMAT "%8.2" /end CHARACTERISTIC
/begin CHARACTERISTIC DFC_DisblMsk.DFC_IVDiaCylShCirLSHS_2_C "/" VALUE 0x80071D96 Val_Wu16 65535.00 DFES_OneToOne 0.00 65535.00 FORMAT "%8.2" /end CHARACTERISTIC
/begin CHARACTERISTIC DFC_DisblMsk.DFC_IVDiaCylShCirLSHS_3_C "/" VALUE 0x80071D98 Val_Wu16 65535.00 DFES_OneToOne 0.00 65535.00 FORMAT "%8.2" /end CHARACTERISTIC
/begin CHARACTERISTIC DFC_DisblMsk.DFC_IVDiaCylShCirLSHS_4_C "/" VALUE 0x80071D9A Val_Wu16 65535.00 DFES_OneToOne 0.00 65535.00 FORMAT "%8.2" /end CHARACTERISTIC
/begin CHARACTERISTIC DFC_DisblMsk.DFC_IVDiaCylShCirLSHS_5_C "/" VALUE 0x80071D9C Val_Wu16 65535.00 DFES_OneToOne 0.00 65535.00 FORMAT "%8.2" /end CHARACTERISTIC
/begin CHARACTERISTIC DFC_DisblMsk.DFC_IVDiaCylShCirLsLs_0_C "/" VALUE 0x80071D9E Val_Wu16 65535.00 DFES_OneToOne 0.00 65535.00 FORMAT "%8.2" /end CHARACTERISTIC
/begin CHARACTERISTIC DFC_DisblMsk.DFC_IVDiaCylShCirLsLs_1_C "/" VALUE 0x80071DA0 Val_Wu16 65535.00 DFES_OneToOne 0.00 65535.00 FORMAT "%8.2" /end CHARACTERISTIC
/begin CHARACTERISTIC DFC_DisblMsk.DFC_IVDiaCylShCirLsLs_2_C "/" VALUE 0x80071DA2 Val_Wu16 65535.00 DFES_OneToOne 0.00 65535.00 FORMAT "%8.2" /end CHARACTERISTIC
/begin CHARACTERISTIC DFC_DisblMsk.DFC_IVDiaCylShCirLsLs_3_C "/" VALUE 0x80071DA4 Val_Wu16 65535.00 DFES_OneToOne 0.00 65535.00 FORMAT "%8.2" /end CHARACTERISTIC
/begin CHARACTERISTIC DFC_DisblMsk.DFC_IVDiaCylShCirLsLs_4_C "/" VALUE 0x80071DA6 Val_Wu16 65535.00 DFES_OneToOne 0.00 65535.00 FORMAT "%8.2" /end CHARACTERISTIC
/begin CHARACTERISTIC DFC_DisblMsk.DFC_IVDiaCylShCirLsLs_5_C "/" VALUE 0x80071DA8 Val_Wu16 65535.00 DFES_OneToOne 0.00 65535.00 FORMAT "%8.2" /end CHARACTERISTIC
/begin CHARACTERISTIC DFC_DisblMsk.DFC_IVDiaSPICfg_C "/" VALUE 0x80071DAA Val_Wu16 65535.00 DFES_OneToOne 0.00 65535.00 FORMAT "%8.2" /end CHARACTERISTIC
/begin CHARACTERISTIC DFC_DisblMsk.DFC_IVDiaSPIColl_C "/" VALUE 0x80071DAC Val_Wu16 65535.00 DFES_OneToOne 0.00 65535.00 FORMAT "%8.2" /end CHARACTERISTIC
/begin CHARACTERISTIC DFC_DisblMsk.DFC_IVDiaSPICtrl_C "/" VALUE 0x80071DAE Val_Wu16 65535.00 DFES_OneToOne 0.00 65535.00 FORMAT "%8.2" /end CHARACTERISTIC
/begin CHARACTERISTIC DFC_DisblMsk.DFC_IVDiaSPIRam_C "/" VALUE 0x80071DB0 Val_Wu16 65535.00 DFES_OneToOne 0.00 65535.00 FORMAT "%8.2" /end CHARACTERISTIC
/begin CHARACTERISTIC DFC_DisblMsk.DFC_IVDiaSPITrans_C "/" VALUE 0x80071DB2 Val_Wu16 65535.00 DFES_OneToOne 0.00 65535.00 FORMAT "%8.2" /end CHARACTERISTIC
/begin CHARACTERISTIC DFC_DisblMsk.DFC_LSUCmpChk_0_C "/" VALUE 0x80071DB4 Val_Wu16 65535.00 DFES_OneToOne 0.00 65535.00 FORMAT "%8.2" /end CHARACTERISTIC
/begin CHARACTERISTIC DFC_DisblMsk.DFC_LSUCmpChk_1_C "/" VALUE 0x80071DB6 Val_Wu16 65535.00 DFES_OneToOne 0.00 65535.00 FORMAT "%8.2" /end CHARACTERISTIC
/begin CHARACTERISTIC DFC_DisblMsk.DFC_LSUCmpChk_2_C "/" VALUE 0x80071DB8 Val_Wu16 65535.00 DFES_OneToOne 0.00 65535.00 FORMAT "%8.2" /end CHARACTERISTIC
/begin CHARACTERISTIC DFC_DisblMsk.DFC_LSUCmpChk_3_C "/" VALUE 0x80071DBA Val_Wu16 65535.00 DFES_OneToOne 0.00 65535.00 FORMAT "%8.2" /end CHARACTERISTIC
/begin CHARACTERISTIC DFC_DisblMsk.DFC_LSUCmpChk_4_C "/" VALUE 0x80071DBC Val_Wu16 65535.00 DFES_OneToOne 0.00 65535.00 FORMAT "%8.2" /end CHARACTERISTIC
/begin CHARACTERISTIC DFC_DisblMsk.DFC_LSUCmpChk_5_C "/" VALUE 0x80071DBE Val_Wu16 65535.00 DFES_OneToOne 0.00 65535.00 FORMAT "%8.2" /end CHARACTERISTIC
/begin CHARACTERISTIC DFC_DisblMsk.DFC_LSUDynChk_0_C "/" VALUE 0x80071DC0 Val_Wu16 65535.00 DFES_OneToOne 0.00 65535.00 FORMAT "%8.2" /end CHARACTERISTIC
/begin CHARACTERISTIC DFC_DisblMsk.DFC_LSUDynChk_1_C "/" VALUE 0x80071DC2 Val_Wu16 65535.00 DFES_OneToOne 0.00 65535.00 FORMAT "%8.2" /end CHARACTERISTIC
/begin CHARACTERISTIC DFC_DisblMsk.DFC_LSUDynChk_2_C "/" VALUE 0x80071DC4 Val_Wu16 65535.00 DFES_OneToOne 0.00 65535.00 FORMAT "%8.2" /end CHARACTERISTIC
/begin CHARACTERISTIC DFC_DisblMsk.DFC_LSUDynChk_3_C "/" VALUE 0x80071DC6 Val_Wu16 65535.00 DFES_OneToOne 0.00 65535.00 FORMAT "%8.2" /end CHARACTERISTIC
/begin CHARACTERISTIC DFC_DisblMsk.DFC_LSUO2ClbMax_0_C "/" VALUE 0x80071DC8 Val_Wu16 65535.00 DFES_OneToOne 0.00 65535.00 FORMAT "%8.2" /end CHARACTERISTIC
/begin CHARACTERISTIC DFC_DisblMsk.DFC_LSUO2ClbMax_1_C "/" VALUE 0x80071DCA Val_Wu16 65535.00 DFES_OneToOne 0.00 65535.00 FORMAT "%8.2" /end CHARACTERISTIC
/begin CHARACTERISTIC DFC_DisblMsk.DFC_LSUO2ClbMax_2_C "/" VALUE 0x80071DCC Val_Wu16 65535.00 DFES_OneToOne 0.00 65535.00 FORMAT "%8.2" /end CHARACTERISTIC
/begin CHARACTERISTIC DFC_DisblMsk.DFC_LSUO2ClbMax_3_C "/" VALUE 0x80071DCE Val_Wu16 65535.00 DFES_OneToOne 0.00 65535.00 FORMAT "%8.2" /end CHARACTERISTIC
/begin CHARACTERISTIC DFC_DisblMsk.DFC_LSUO2ClbMin_0_C "/" VALUE 0x80071DD0 Val_Wu16 65535.00 DFES_OneToOne 0.00 65535.00 FORMAT "%8.2" /end CHARACTERISTIC
/begin CHARACTERISTIC DFC_DisblMsk.DFC_LSUO2ClbMin_1_C "/" VALUE 0x80071DD2 Val_Wu16 65535.00 DFES_OneToOne 0.00 65535.00 FORMAT "%8.2" /end CHARACTERISTIC
/begin CHARACTERISTIC DFC_DisblMsk.DFC_LSUO2ClbMin_2_C "/" VALUE 0x80071DD4 Val_Wu16 65535.00 DFES_OneToOne 0.00 65535.00 FORMAT "%8.2" /end CHARACTERISTIC
/begin CHARACTERISTIC DFC_DisblMsk.DFC_LSUO2ClbMin_3_C "/" VALUE 0x80071DD6 Val_Wu16 65535.00 DFES_OneToOne 0.00 65535.00 FORMAT "%8.2" /end CHARACTERISTIC
/begin CHARACTERISTIC DFC_DisblMsk.DFC_LSUO2PlausMax_0_C "/" VALUE 0x80071DD8 Val_Wu16 65535.00 DFES_OneToOne 0.00 65535.00 FORMAT "%8.2" /end CHARACTERISTIC
/begin CHARACTERISTIC DFC_DisblMsk.DFC_LSUO2PlausMax_1_C "/" VALUE 0x80071DDA Val_Wu16 65535.00 DFES_OneToOne 0.00 65535.00 FORMAT "%8.2" /end CHARACTERISTIC
/begin CHARACTERISTIC DFC_DisblMsk.DFC_LSUO2PlausMax_2_C "/" VALUE 0x80071DDC Val_Wu16 65535.00 DFES_OneToOne 0.00 65535.00 FORMAT "%8.2" /end CHARACTERISTIC
/begin CHARACTERISTIC DFC_DisblMsk.DFC_LSUO2PlausMax_3_C "/" VALUE 0x80071DDE Val_Wu16 65535.00 DFES_OneToOne 0.00 65535.00 FORMAT "%8.2" /end CHARACTERISTIC
/begin CHARACTERISTIC DFC_DisblMsk.DFC_LSUO2PlausMin_0_C "/" VALUE 0x80071DE0 Val_Wu16 65535.00 DFES_OneToOne 0.00 65535.00 FORMAT "%8.2" /end CHARACTERISTIC
/begin CHARACTERISTIC DFC_DisblMsk.DFC_LSUO2PlausMin_1_C "/" VALUE 0x80071DE2 Val_Wu16 65535.00 DFES_OneToOne 0.00 65535.00 FORMAT "%8.2" /end CHARACTERISTIC
/begin CHARACTERISTIC DFC_DisblMsk.DFC_LSUO2PlausMin_2_C "/" VALUE 0x80071DE4 Val_Wu16 65535.00 DFES_OneToOne 0.00 65535.00 FORMAT "%8.2" /end CHARACTERISTIC
/begin CHARACTERISTIC DFC_DisblMsk.DFC_LSUO2PlausMin_3_C "/" VALUE 0x80071DE6 Val_Wu16 65535.00 DFES_OneToOne 0.00 65535.00 FORMAT "%8.2" /end CHARACTERISTIC
/begin CHARACTERISTIC DFC_DisblMsk.DFC_LSURiClbMax_0_C "/" VALUE 0x80071DE8 Val_Wu16 65535.00 DFES_OneToOne 0.00 65535.00 FORMAT "%8.2" /end CHARACTERISTIC
/begin CHARACTERISTIC DFC_DisblMsk.DFC_LSURiClbMax_1_C "/" VALUE 0x80071DEA Val_Wu16 65535.00 DFES_OneToOne 0.00 65535.00 FORMAT "%8.2" /end CHARACTERISTIC
/begin CHARACTERISTIC DFC_DisblMsk.DFC_LSURiClbMax_2_C "/" VALUE 0x80071DEC Val_Wu16 65535.00 DFES_OneToOne 0.00 65535.00 FORMAT "%8.2" /end CHARACTERISTIC
/begin CHARACTERISTIC DFC_DisblMsk.DFC_LSURiClbMax_3_C "/" VALUE 0x80071DEE Val_Wu16 65535.00 DFES_OneToOne 0.00 65535.00 FORMAT "%8.2" /end CHARACTERISTIC
/begin CHARACTERISTIC DFC_DisblMsk.DFC_LSURiClbMin_0_C "/" VALUE 0x80071DF0 Val_Wu16 65535.00 DFES_OneToOne 0.00 65535.00 FORMAT "%8.2" /end CHARACTERISTIC
/begin CHARACTERISTIC DFC_DisblMsk.DFC_LSURiClbMin_1_C "/" VALUE 0x80071DF2 Val_Wu16 65535.00 DFES_OneToOne 0.00 65535.00 FORMAT "%8.2" /end CHARACTERISTIC
/begin CHARACTERISTIC DFC_DisblMsk.DFC_LSURiClbMin_2_C "/" VALUE 0x80071DF4 Val_Wu16 65535.00 DFES_OneToOne 0.00 65535.00 FORMAT "%8.2" /end CHARACTERISTIC
/begin CHARACTERISTIC DFC_DisblMsk.DFC_LSURiClbMin_3_C "/" VALUE 0x80071DF6 Val_Wu16 65535.00 DFES_OneToOne 0.00 65535.00 FORMAT "%8.2" /end CHARACTERISTIC
/begin CHARACTERISTIC DFC_DisblMsk.DFC_LSUWireIPSig_0_C "/" VALUE 0x80071DF8 Val_Wu16 65535.00 DFES_OneToOne 0.00 65535.00 FORMAT "%8.2" /end CHARACTERISTIC
/begin CHARACTERISTIC DFC_DisblMsk.DFC_LSUWireIPSig_1_C "/" VALUE 0x80071DFA Val_Wu16 65535.00 DFES_OneToOne 0.00 65535.00 FORMAT "%8.2" /end CHARACTERISTIC
/begin CHARACTERISTIC DFC_DisblMsk.DFC_LSUWireIPSig_2_C "/" VALUE 0x80071DFC Val_Wu16 65535.00 DFES_OneToOne 0.00 65535.00 FORMAT "%8.2" /end CHARACTERISTIC
/begin CHARACTERISTIC DFC_DisblMsk.DFC_LSUWireIPSig_3_C "/" VALUE 0x80071DFE Val_Wu16 65535.00 DFES_OneToOne 0.00 65535.00 FORMAT "%8.2" /end CHARACTERISTIC
/begin CHARACTERISTIC DFC_DisblMsk.DFC_AFSDrftIdlAdjVal_C "/" VALUE 0x80071E00 Val_Wu16 65535.00 DFES_OneToOne 0.00 65535.00 FORMAT "%8.2" /end CHARACTERISTIC
/begin CHARACTERISTIC DFC_DisblMsk.DFC_AFSDrftLdAdjVal_C "/" VALUE 0x80071E02 Val_Wu16 65535.00 DFES_OneToOne 0.00 65535.00 FORMAT "%8.2" /end CHARACTERISTIC
/begin CHARACTERISTIC DFC_DisblMsk.DFC_AdcI_ADC0_Cal_C "/" VALUE 0x80071E04 Val_Wu16 65535.00 DFES_OneToOne 0.00 65535.00 FORMAT "%8.2" /end CHARACTERISTIC
/begin CHARACTERISTIC DFC_DisblMsk.DFC_AdcI_ADC0_Conv_C "/" VALUE 0x80071E06 Val_Wu16 65535.00 DFES_OneToOne 0.00 65535.00 FORMAT "%8.2" /end CHARACTERISTIC
/begin CHARACTERISTIC DFC_DisblMsk.DFC_CmbChbMisfireMax_0_C "/" VALUE 0x80071E08 Val_Wu16 65535.00 DFES_OneToOne 0.00 65535.00 FORMAT "%8.2" /end CHARACTERISTIC
/begin CHARACTERISTIC DFC_DisblMsk.DFC_CmbChbMisfireMax_1_C "/" VALUE 0x80071E0A Val_Wu16 65535.00 DFES_OneToOne 0.00 65535.00 FORMAT "%8.2" /end CHARACTERISTIC
/begin CHARACTERISTIC DFC_DisblMsk.DFC_CmbChbMisfireMax_2_C "/" VALUE 0x80071E0C Val_Wu16 65535.00 DFES_OneToOne 0.00 65535.00 FORMAT "%8.2" /end CHARACTERISTIC
/begin CHARACTERISTIC DFC_DisblMsk.DFC_CmbChbMisfireMax_3_C "/" VALUE 0x80071E0E Val_Wu16 65535.00 DFES_OneToOne 0.00 65535.00 FORMAT "%8.2" /end CHARACTERISTIC
/begin CHARACTERISTIC DFC_DisblMsk.DFC_CmbChbMisfireMax_4_C "/" VALUE 0x80071E10 Val_Wu16 65535.00 DFES_OneToOne 0.00 65535.00 FORMAT "%8.2" /end CHARACTERISTIC
/begin CHARACTERISTIC DFC_DisblMsk.DFC_CmbChbMisfireMax_5_C "/" VALUE 0x80071E12 Val_Wu16 65535.00 DFES_OneToOne 0.00 65535.00 FORMAT "%8.2" /end CHARACTERISTIC
/begin CHARACTERISTIC DFC_DisblMsk.DFC_CmbChbMisfireMul_C "/" VALUE 0x80071E14 Val_Wu16 65535.00 DFES_OneToOne 0.00 65535.00 FORMAT "%8.2" /end CHARACTERISTIC
/begin CHARACTERISTIC DFC_DisblMsk.DFC_INJVLVBUSY_C "/" VALUE 0x80071E16 Val_Wu16 65535.00 DFES_OneToOne 0.00 65535.00 FORMAT "%8.2" /end CHARACTERISTIC
/begin CHARACTERISTIC DFC_DisblMsk.DFC_IVAdjIVA_0_C "/" VALUE 0x80071E18 Val_Wu16 65535.00 DFES_OneToOne 0.00 65535.00 FORMAT "%8.2" /end CHARACTERISTIC
/begin CHARACTERISTIC DFC_DisblMsk.DFC_IVAdjIVA_1_C "/" VALUE 0x80071E1A Val_Wu16 65535.00 DFES_OneToOne 0.00 65535.00 FORMAT "%8.2" /end CHARACTERISTIC
/begin CHARACTERISTIC DFC_DisblMsk.DFC_IVAdjIVA_2_C "/" VALUE 0x80071E1C Val_Wu16 65535.00 DFES_OneToOne 0.00 65535.00 FORMAT "%8.2" /end CHARACTERISTIC
/begin CHARACTERISTIC DFC_DisblMsk.DFC_IVAdjIVA_3_C "/" VALUE 0x80071E1E Val_Wu16 65535.00 DFES_OneToOne 0.00 65535.00 FORMAT "%8.2" /end CHARACTERISTIC
/begin CHARACTERISTIC DFC_DisblMsk.DFC_IVAdjIVA_4_C "/" VALUE 0x80071E20 Val_Wu16 65535.00 DFES_OneToOne 0.00 65535.00 FORMAT "%8.2" /end CHARACTERISTIC
/begin CHARACTERISTIC DFC_DisblMsk.DFC_IVAdjIVA_5_C "/" VALUE 0x80071E22 Val_Wu16 65535.00 DFES_OneToOne 0.00 65535.00 FORMAT "%8.2" /end CHARACTERISTIC
/begin CHARACTERISTIC DFC_DisblMsk.DFC_InjCtlAdjQntEEPCS_C "/" VALUE 0x80071E24 Val_Wu16 65535.00 DFES_OneToOne 0.00 65535.00 FORMAT "%8.2" /end CHARACTERISTIC
/begin CHARACTERISTIC DFC_DisblMsk.DFC_InjCtlDriftEEPCS_C "/" VALUE 0x80071E26 Val_Wu16 65535.00 DFES_OneToOne 0.00 65535.00 FORMAT "%8.2" /end CHARACTERISTIC
/begin CHARACTERISTIC DFC_DisblMsk.DFC_MRlyErlyOpng_C "/" VALUE 0x80071E28 Val_Wu16 65535.00 DFES_OneToOne 0.00 65535.00 FORMAT "%8.2" /end CHARACTERISTIC
/begin CHARACTERISTIC DFC_DisblMsk.DFC_MRlyStk_C "/" VALUE 0x80071E2A Val_Wu16 65535.00 DFES_OneToOne 0.00 65535.00 FORMAT "%8.2" /end CHARACTERISTIC
/begin CHARACTERISTIC DFC_DisblMsk.DFC_SensFrzPPFltUs_C "/" VALUE 0x80071E2C Val_Wu16 65535.00 DFES_OneToOne 0.00 65535.00 FORMAT "%8.2" /end CHARACTERISTIC
/begin CHARACTERISTIC DFC_DisblMsk.DFC_T15Sig_C "/" VALUE 0x80071E2E Val_Wu16 65535.00 DFES_OneToOne 0.00 65535.00 FORMAT "%8.2" /end CHARACTERISTIC
/begin CHARACTERISTIC DFC_DisblMsk.DFC_AirCtlRmpTOut_C "/" VALUE 0x80071E30 Val_Wu16 65535.00 DFES_OneToOne 0.00 65535.00 FORMAT "%8.2" /end CHARACTERISTIC
/begin CHARACTERISTIC DFC_DisblMsk.DFC_CEngDsTDynTst_C "/" VALUE 0x80071E32 Val_Wu16 65535.00 DFES_OneToOne 0.00 65535.00 FORMAT "%8.2" /end CHARACTERISTIC
/begin CHARACTERISTIC DFC_DisblMsk.DFC_EGRVlvJamVlvClsd_C "/" VALUE 0x80071E34 Val_Wu16 65535.00 DFES_OneToOne 0.00 65535.00 FORMAT "%8.2" /end CHARACTERISTIC
/begin CHARACTERISTIC DFC_DisblMsk.DFC_EGRVlvJamVlvOpn_C "/" VALUE 0x80071E36 Val_Wu16 65535.00 DFES_OneToOne 0.00 65535.00 FORMAT "%8.2" /end CHARACTERISTIC
/begin CHARACTERISTIC DFC_DisblMsk.DFC_EGRVlvLgTDrft_C "/" VALUE 0x80071E38 Val_Wu16 65535.00 DFES_OneToOne 0.00 65535.00 FORMAT "%8.2" /end CHARACTERISTIC
/begin CHARACTERISTIC DFC_DisblMsk.DFC_EGRVlvOfsLrnJamVlv_C "/" VALUE 0x80071E3A Val_Wu16 65535.00 DFES_OneToOne 0.00 65535.00 FORMAT "%8.2" /end CHARACTERISTIC
/begin CHARACTERISTIC DFC_DisblMsk.DFC_EGRVlvShTDrft_C "/" VALUE 0x80071E3C Val_Wu16 65535.00 DFES_OneToOne 0.00 65535.00 FORMAT "%8.2" /end CHARACTERISTIC
/begin CHARACTERISTIC DFC_DisblMsk.DFC_EGTRgnOilDilMax_C "/" VALUE 0x80071E3E Val_Wu16 65535.00 DFES_OneToOne 0.00 65535.00 FORMAT "%8.2" /end CHARACTERISTIC
/begin CHARACTERISTIC DFC_DisblMsk.DFC_EngICO_C "/" VALUE 0x80071E40 Val_Wu16 65535.00 DFES_OneToOne 0.00 65535.00 FORMAT "%8.2" /end CHARACTERISTIC
/begin CHARACTERISTIC DFC_DisblMsk.DFC_EpmCaSI1ErrSig_C "/" VALUE 0x80071E42 Val_Wu16 65535.00 DFES_OneToOne 0.00 65535.00 FORMAT "%8.2" /end CHARACTERISTIC
/begin CHARACTERISTIC DFC_DisblMsk.DFC_EpmCaSI1NoSig_C "/" VALUE 0x80071E44 Val_Wu16 65535.00 DFES_OneToOne 0.00 65535.00 FORMAT "%8.2" /end CHARACTERISTIC
/begin CHARACTERISTIC DFC_DisblMsk.DFC_EpmCaSI1OfsErr_C "/" VALUE 0x80071E46 Val_Wu16 65535.00 DFES_OneToOne 0.00 65535.00 FORMAT "%8.2" /end CHARACTERISTIC
/begin CHARACTERISTIC DFC_DisblMsk.DFC_EpmCrSErrSig_C "/" VALUE 0x80071E48 Val_Wu16 65535.00 DFES_OneToOne 0.00 65535.00 FORMAT "%8.2" /end CHARACTERISTIC
/begin CHARACTERISTIC DFC_DisblMsk.DFC_EpmCrSNoSig_C "/" VALUE 0x80071E4A Val_Wu16 65535.00 DFES_OneToOne 0.00 65535.00 FORMAT "%8.2" /end CHARACTERISTIC
/begin CHARACTERISTIC DFC_DisblMsk.DFC_MoCADCCmp_C "/" VALUE 0x80071E4C Val_Wu16 65535.00 DFES_OneToOne 0.00 65535.00 FORMAT "%8.2" /end CHARACTERISTIC
/begin CHARACTERISTIC DFC_DisblMsk.DFC_MoCADCTst_C "/" VALUE 0x80071E4E Val_Wu16 65535.00 DFES_OneToOne 0.00 65535.00 FORMAT "%8.2" /end CHARACTERISTIC
/begin CHARACTERISTIC DFC_DisblMsk.DFC_MoCADCVltgRatio_C "/" VALUE 0x80071E50 Val_Wu16 65535.00 DFES_OneToOne 0.00 65535.00 FORMAT "%8.2" /end CHARACTERISTIC
/begin CHARACTERISTIC DFC_DisblMsk.DFC_MoCSOPLoLi_C "/" VALUE 0x80071E52 Val_Wu16 65535.00 DFES_OneToOne 0.00 65535.00 FORMAT "%8.2" /end CHARACTERISTIC
/begin CHARACTERISTIC DFC_DisblMsk.DFC_MoCSOPMM_C "/" VALUE 0x80071E54 Val_Wu16 65535.00 DFES_OneToOne 0.00 65535.00 FORMAT "%8.2" /end CHARACTERISTIC
/begin CHARACTERISTIC DFC_DisblMsk.DFC_MoCSOPTimeOut_C "/" VALUE 0x80071E56 Val_Wu16 65535.00 DFES_OneToOne 0.00 65535.00 FORMAT "%8.2" /end CHARACTERISTIC
/begin CHARACTERISTIC DFC_DisblMsk.DFC_MoCSOPUpLi_C "/" VALUE 0x80071E58 Val_Wu16 65535.00 DFES_OneToOne 0.00 65535.00 FORMAT "%8.2" /end CHARACTERISTIC
/begin CHARACTERISTIC DFC_DisblMsk.DFC_MoFAPP_C "/" VALUE 0x80071E5A Val_Wu16 65535.00 DFES_OneToOne 0.00 65535.00 FORMAT "%8.2" /end CHARACTERISTIC
/begin CHARACTERISTIC DFC_DisblMsk.DFC_MoFESpd_C "/" VALUE 0x80071E5C Val_Wu16 65535.00 DFES_OneToOne 0.00 65535.00 FORMAT "%8.2" /end CHARACTERISTIC
/begin CHARACTERISTIC DFC_DisblMsk.DFC_MoFInjDatPhi_C "/" VALUE 0x80071E5E Val_Wu16 65535.00 DFES_OneToOne 0.00 65535.00 FORMAT "%8.2" /end CHARACTERISTIC
/begin CHARACTERISTIC DFC_DisblMsk.DFC_MoFInjDatQnt_C "/" VALUE 0x80071E60 Val_Wu16 65535.00 DFES_OneToOne 0.00 65535.00 FORMAT "%8.2" /end CHARACTERISTIC
/begin CHARACTERISTIC DFC_DisblMsk.DFC_MoFInjQnt_C "/" VALUE 0x80071E62 Val_Wu16 65535.00 DFES_OneToOne 0.00 65535.00 FORMAT "%8.2" /end CHARACTERISTIC
/begin CHARACTERISTIC DFC_DisblMsk.DFC_MoFOvR_C "/" VALUE 0x80071E64 Val_Wu16 65535.00 DFES_OneToOne 0.00 65535.00 FORMAT "%8.2" /end CHARACTERISTIC
/begin CHARACTERISTIC DFC_DisblMsk.DFC_MoFQntCor_C "/" VALUE 0x80071E66 Val_Wu16 65535.00 DFES_OneToOne 0.00 65535.00 FORMAT "%8.2" /end CHARACTERISTIC
/begin CHARACTERISTIC DFC_DisblMsk.DFC_MoFTrqCmp_C "/" VALUE 0x80071E68 Val_Wu16 65535.00 DFES_OneToOne 0.00 65535.00 FORMAT "%8.2" /end CHARACTERISTIC
/begin CHARACTERISTIC DFC_DisblMsk.DFC_NplTOxiCatUs_C "/" VALUE 0x80071E6A Val_Wu16 65535.00 DFES_OneToOne 0.00 65535.00 FORMAT "%8.2" /end CHARACTERISTIC
/begin CHARACTERISTIC DFC_DisblMsk.DFC_PhyModNonMonMapNpl_C "/" VALUE 0x80071E6C Val_Wu16 65535.00 DFES_OneToOne 0.00 65535.00 FORMAT "%8.2" /end CHARACTERISTIC
/begin CHARACTERISTIC DFC_DisblMsk.DFC_RailPOfsTstMax_C "/" VALUE 0x80071E6E Val_Wu16 65535.00 DFES_OneToOne 0.00 65535.00 FORMAT "%8.2" /end CHARACTERISTIC
/begin CHARACTERISTIC DFC_DisblMsk.DFC_RailPOfsTstMin_C "/" VALUE 0x80071E70 Val_Wu16 65535.00 DFES_OneToOne 0.00 65535.00 FORMAT "%8.2" /end CHARACTERISTIC
/begin CHARACTERISTIC DFC_DisblMsk.DFC_SWReset_0_C "/" VALUE 0x80071E72 Val_Wu16 65535.00 DFES_OneToOne 0.00 65535.00 FORMAT "%8.2" /end CHARACTERISTIC
/begin CHARACTERISTIC DFC_DisblMsk.DFC_SWReset_1_C "/" VALUE 0x80071E74 Val_Wu16 65535.00 DFES_OneToOne 0.00 65535.00 FORMAT "%8.2" /end CHARACTERISTIC
/begin CHARACTERISTIC DFC_DisblMsk.DFC_SWReset_2_C "/" VALUE 0x80071E76 Val_Wu16 65535.00 DFES_OneToOne 0.00 65535.00 FORMAT "%8.2" /end CHARACTERISTIC
/begin CHARACTERISTIC DFC_DisblMsk.DFC_VSwVlvJamVlv_C "/" VALUE 0x80071E78 Val_Wu16 65535.00 DFES_OneToOne 0.00 65535.00 FORMAT "%8.2" /end CHARACTERISTIC
/begin CHARACTERISTIC DFC_DisblMsk.DFC_VSwVlvLgTDrft_C "/" VALUE 0x80071E7A Val_Wu16 65535.00 DFES_OneToOne 0.00 65535.00 FORMAT "%8.2" /end CHARACTERISTIC
/begin CHARACTERISTIC DFC_DisblMsk.DFC_VSwVlvOfsLrnJamVlv_C "/" VALUE 0x80071E7C Val_Wu16 65535.00 DFES_OneToOne 0.00 65535.00 FORMAT "%8.2" /end CHARACTERISTIC
/begin CHARACTERISTIC DFC_DisblMsk.DFC_VSwVlvShTDrft_C "/" VALUE 0x80071E7E Val_Wu16 65535.00 DFES_OneToOne 0.00 65535.00 FORMAT "%8.2" /end CHARACTERISTIC
/begin CHARACTERISTIC DFES_ThresSimCond.t_C "Schwellwert für Similar Condition Erkennung/" VALUE 0x8004B84E Val_Wu8 255.0 DFES_tPID05 -40.00 215.0 FORMAT "%5.1" /end CHARACTERISTIC
/begin CHARACTERISTIC DFES_ThresSimCond.r_C "Schwellwert für Similar Condition Erkennung/" VALUE 0x8004B84F Val_Wu8 100.0 DFES_rPID04 0.00 100.0 FORMAT "%5.1" /end CHARACTERISTIC
/begin CHARACTERISTIC DFES_ThresSimCond.n_C "Schwellwert für Similar Condition Erkennung/" VALUE 0x8004B850 Val_Wu16 16383.75 DFES_nPID0C 0.00 16383.75 FORMAT "%8.2" /end CHARACTERISTIC
/begin CHARACTERISTIC DFES_xStPrio_CA "" VAL_BLK 0x8004B852 ValA_Wu8 255.0 OneToOne 0.00 255.0 FORMAT "%5.1" NUMBER 16 /end CHARACTERISTIC
/begin MEASUREMENT DFES_ctEntry "Anzahl der belegten Fehlerspeichereintraege" UBYTE DFES_OneToOne 1 100 0.00 255.0 FORMAT "%5.1" ECU_ADDRESS 0xD000954A /end MEASUREMENT
/begin MEASUREMENT DFES_ctMIL "Anzahl der MIL ansteuernden Fehlerspeichereintraege" UBYTE DFES_OneToOne 1 100 0.00 255.0 FORMAT "%5.1" ECU_ADDRESS 0xD0009548 /end MEASUREMENT
/begin MEASUREMENT DFES_ctOBD "Anzahl der in Mode 3 sichtbaren Fehlerspeichereintraege" UBYTE DFES_OneToOne 1 100 0.00 255.0 FORMAT "%5.1" ECU_ADDRESS 0xD0009546 /end MEASUREMENT
/begin MEASUREMENT DFES_ctOBDPend "Anzahl der in Mode 7 (pending) sichtbaren Fehlerspeichereintraege" UBYTE DFES_OneToOne 1 100 0.00 255.0 FORMAT "%5.1" ECU_ADDRESS 0xD0009547 /end MEASUREMENT
/begin MEASUREMENT DFES_ctSrv "Anzahl der für einen Service Tester sichtbaren Fehlerspeichereintraege" UBYTE DFES_OneToOne 1 100 0.00 255.0 FORMAT "%5.1" ECU_ADDRESS 0xD0009549 /end MEASUREMENT
/begin MEASUREMENT DFES_numEntryAvl "Anzahl der möglichen Fehlerspeichereintraege" UBYTE DFES_OneToOne 1 100 0.00 255.0 FORMAT "%5.1" ECU_ADDRESS 0xD000954B /end MEASUREMENT
/begin MEASUREMENT DFES_numEnvSize "Anzahl der Bytes in einem Umweltdatenblock" UBYTE DFES_OneToOne 1 100 0.00 255.0 FORMAT "%5.1" ECU_ADDRESS 0xD000954D /end MEASUREMENT
/begin MEASUREMENT DFES_numExtdFrzFrmSize "" UBYTE DFES_OneToOne 1 100 0.00 255.0 FORMAT "%5.1" ECU_ADDRESS 0xD0009554 /end MEASUREMENT
/begin MEASUREMENT DFES_numFrzFrmSize "Anzahl der Bytes im Freeze Frame" UBYTE DFES_OneToOne 1 100 0.00 255.0 FORMAT "%5.1" ECU_ADDRESS 0xD000954C /end MEASUREMENT
/begin MEASUREMENT DFES_stErrDia "" UBYTE DFES_OneToOne 1 100 0.00 255.0 FORMAT "%5.1" ECU_ADDRESS 0xD0009545 /end MEASUREMENT
/begin MEASUREMENT DFES_stErrLamp "DFES Lampenstatus" UBYTE DFES_OneToOne 1 100 0.00 255.0 FORMAT "%5.1" ECU_ADDRESS 0xD0009544 /end MEASUREMENT
/begin MEASUREMENT DFES_stOutstate "" UBYTE DFES_OneToOne 1 100 0.00 255.0 FORMAT "%5.1" ECU_ADDRESS 0xD000954E /end MEASUREMENT
/begin FUNCTION dfc_disbl_msk_auto ""
 /begin DEF_CHARACTERISTIC DFC_DisblMsk.DFC_AirCtlGovDvtEOMMax_C DFC_DisblMsk.DFC_AirCtlGovDvtEOMMin_C DFC_DisblMsk.DFC_AirCtlGovDvtMax_C DFC_DisblMsk.DFC_AirCtlGovDvtMin_C DFC_DisblMsk.DFC_Cj945SpiCom1_C DFC_DisblMsk.DFC_ComButtonMSASig_C DFC_DisblMsk.DFC_ComButtonMSATo_C DFC_DisblMsk.DFC_ComGearboxData2Sig_C DFC_DisblMsk.DFC_ComGearboxData2To_C DFC_DisblMsk.DFC_ComGearboxDataSig_C DFC_DisblMsk.DFC_ComGearboxDataTo_C DFC_DisblMsk.DFC_ComHeatACSig_C DFC_DisblMsk.DFC_ComHeatACTo_C DFC_DisblMsk.DFC_ComLenkradwinkelSig_C DFC_DisblMsk.DFC_ComLenkradwinkelTo_C DFC_DisblMsk.DFC_ComMileageRangeSig_C DFC_DisblMsk.DFC_ComMileageRangeTo_C DFC_DisblMsk.DFC_ComPspSig_C DFC_DisblMsk.DFC_ComPspTo_C DFC_DisblMsk.DFC_ComShutOffPSPSig_C DFC_DisblMsk.DFC_ComShutOffPSPTo_C DFC_DisblMsk.DFC_ComStKombiCtr_C DFC_DisblMsk.DFC_ComStKombiSig_C DFC_DisblMsk.DFC_ComStKombiTo_C DFC_DisblMsk.DFC_ComStateARSCtr_C DFC_DisblMsk.DFC_ComStateARSSig_C DFC_DisblMsk.DFC_ComStateARSTo_C DFC_DisblMsk.DFC_ComStateDscSig_C DFC_DisblMsk.DFC_ComStateDscTo_C DFC_DisblMsk.DFC_ComStateSeatSig_C DFC_DisblMsk.DFC_ComStateSeatTo_C DFC_DisblMsk.DFC_ComTempRelTimeSig_C DFC_DisblMsk.DFC_ComTempRelTimeTo_C DFC_DisblMsk.DFC_ComTerminalChk_C DFC_DisblMsk.DFC_ComTerminalCtr_C DFC_DisblMsk.DFC_ComTerminalSig_C DFC_DisblMsk.DFC_ComTerminalTo_C DFC_DisblMsk.DFC_ComTimeDateSig_C DFC_DisblMsk.DFC_ComTimeDateTo_C DFC_DisblMsk.DFC_ComTrailerSig_C DFC_DisblMsk.DFC_ComTrailerTo_C DFC_DisblMsk.DFC_ComTrqDemandAfsChk_C DFC_DisblMsk.DFC_ComTrqDemandAfsCtr_C DFC_DisblMsk.DFC_ComTrqDemandAfsSig_C DFC_DisblMsk.DFC_ComTrqDemandAfsTo_C DFC_DisblMsk.DFC_ComTrqDemandDscChk_C DFC_DisblMsk.DFC_ComTrqDemandDscCtr_C DFC_DisblMsk.DFC_ComTrqDemandDscSig_C DFC_DisblMsk.DFC_ComTrqDemandDscTo_C DFC_DisblMsk.DFC_ComTrqDemandGbxChk_C DFC_DisblMsk.DFC_ComTrqDemandGbxCtr_C DFC_DisblMsk.DFC_ComTrqDemandGbxSig_C DFC_DisblMsk.DFC_ComTrqDemandGbxTo_C DFC_DisblMsk.DFC_ComVelocitySig_C DFC_DisblMsk.DFC_ComVelocityTo_C DFC_DisblMsk.DFC_ComWheelSpeedSig_C DFC_DisblMsk.DFC_ComWheelSpeedTo_C DFC_DisblMsk.DFC_ComZvKlappenSig_C DFC_DisblMsk.DFC_ComZvKlappenTo_C DFC_DisblMsk.DFC_Cy150SpiCom_C DFC_DisblMsk.DFC_Cy320SpiCom_C DFC_DisblMsk.DFC_ETCtlDvtInrMax_C DFC_DisblMsk.DFC_ETCtlDvtInrMin_C DFC_DisblMsk.DFC_ETCtlDvtOutrMax_C DFC_DisblMsk.DFC_ETCtlDvtOutrMin_C DFC_DisblMsk.DFC_Fan4WinErr1_C DFC_DisblMsk.DFC_Fan4WinErr2_C DFC_DisblMsk.DFC_Fan4WinErr3_C DFC_DisblMsk.DFC_Fan4WinErr4_C DFC_DisblMsk.DFC_FanSCG_C DFC_DisblMsk.DFC_PCRGovDvtLPMax_C DFC_DisblMsk.DFC_PCRGovDvtLPMin_C DFC_DisblMsk.DFC_PCRGovDvtMax_C DFC_DisblMsk.DFC_PCRGovDvtMin_C DFC_DisblMsk.DFC_RailCPC1_C DFC_DisblMsk.DFC_RailCPC3_C DFC_DisblMsk.DFC_RailCPC4_C DFC_DisblMsk.DFC_RailMeUn0_C DFC_DisblMsk.DFC_RailMeUn1_C DFC_DisblMsk.DFC_RailMeUn2_C DFC_DisblMsk.DFC_RailMeUn3_C DFC_DisblMsk.DFC_RailMeUn4_C DFC_DisblMsk.DFC_RailPCV0_C DFC_DisblMsk.DFC_RailPCV1_C DFC_DisblMsk.DFC_RailPCV2_C DFC_DisblMsk.DFC_RailPCV3_C DFC_DisblMsk.DFC_RailPCV4_C DFC_DisblMsk.DFC_RailPMonStrt_C DFC_DisblMsk.DFC_SSpMon1_C DFC_DisblMsk.DFC_SSpMon2_C DFC_DisblMsk.DFC_SSpMon3_C DFC_DisblMsk.DFC_Sia_E1_C DFC_DisblMsk.DFC_Sia_E10_C DFC_DisblMsk.DFC_Sia_E11_C DFC_DisblMsk.DFC_Sia_E12_C DFC_DisblMsk.DFC_Sia_E13_C DFC_DisblMsk.DFC_Sia_E14_C DFC_DisblMsk.DFC_Sia_E15_C DFC_DisblMsk.DFC_Sia_E2_C DFC_DisblMsk.DFC_Sia_E3_C DFC_DisblMsk.DFC_Sia_E4_C DFC_DisblMsk.DFC_Sia_E5_C DFC_DisblMsk.DFC_Sia_E6_C DFC_DisblMsk.DFC_Sia_E7_C DFC_DisblMsk.DFC_Sia_E8_C DFC_DisblMsk.DFC_Sia_E9_C DFC_DisblMsk.DFC_ThrVlv4WinErr1_C DFC_DisblMsk.DFC_ThrVlv4WinErr2_C DFC_DisblMsk.DFC_ThrVlv4WinErr3_C DFC_DisblMsk.DFC_ThrVlv4WinErr4_C DFC_DisblMsk.DFC_ThrVlvSCG_C DFC_DisblMsk.DFC_TrbCh4WinErr1_C DFC_DisblMsk.DFC_TrbCh4WinErr2_C DFC_DisblMsk.DFC_TrbCh4WinErr3_C DFC_DisblMsk.DFC_TrbCh4WinErr4_C DFC_DisblMsk.DFC_TrbChSCG_C DFC_DisblMsk.DFC_TrbChSRCMax_C DFC_DisblMsk.DFC_TrbChSRCMin_C DFC_DisblMsk.DFC_WaHtEl4WinErr1_C DFC_DisblMsk.DFC_WaHtEl4WinErr2_C DFC_DisblMsk.DFC_WaHtEl4WinErr3_C DFC_DisblMsk.DFC_WaHtEl4WinErr4_C DFC_DisblMsk.DFC_WaHtElSCG_C DFC_DisblMsk.DFC_ETClbETFltMax_C DFC_DisblMsk.DFC_ETClbETFltMin_C DFC_DisblMsk.DFC_InjCrvInjLimChrgBal_C DFC_DisblMsk.DFC_InjCrvInjLimQntBal_C DFC_DisblMsk.DFC_InjCrvInjLimSys_C DFC_DisblMsk.DFC_InjCrvNumInjRtmLim_C DFC_DisblMsk.DFC_LSUHtCoupSig_0_C DFC_DisblMsk.DFC_LSUHtCoupSig_1_C DFC_DisblMsk.DFC_LSUHtCoupSig_2_C DFC_DisblMsk.DFC_LSUHtCoupSig_3_C DFC_DisblMsk.DFC_CtT_C DFC_DisblMsk.DFC_DSMDummy_C DFC_DisblMsk.DFC_MeUnOL_C DFC_DisblMsk.DFC_MeUnSCB_C DFC_DisblMsk.DFC_MeUnSRCMax_C DFC_DisblMsk.DFC_MeUnSRCMin_C DFC_DisblMsk.DFC_PCVOL_C DFC_DisblMsk.DFC_PCVSCB_C DFC_DisblMsk.DFC_PCVSRCMax_C DFC_DisblMsk.DFC_PCVSRCMin_C DFC_DisblMsk.DFC_RailPSRCMax_C DFC_DisblMsk.DFC_RailPSRCMin_C DFC_DisblMsk.DFC_IVActrVltgSRCMax_C DFC_DisblMsk.DFC_IVActrVltgSRCMin_C DFC_DisblMsk.DFC_IVPSplyDCDC_C DFC_DisblMsk.DFC_IVPSplyVltgSRCMax_C DFC_DisblMsk.DFC_IVPSplyVltgSRCMin_C DFC_DisblMsk.DFC_AFSOffsDrftMax_C DFC_DisblMsk.DFC_AFSOffsDrftMin_C DFC_DisblMsk.DFC_AFSSRCCorMax_C DFC_DisblMsk.DFC_AFSSRCCorMin_C DFC_DisblMsk.DFC_AFSSRCRawMax_C DFC_DisblMsk.DFC_AFSSRCRawMin_C DFC_DisblMsk.DFC_AFSSetyDrftMax_C DFC_DisblMsk.DFC_AFSSetyDrftMin_C DFC_DisblMsk.DFC_AirCClntPAnaSRCMax_C DFC_DisblMsk.DFC_AirCClntPAnaSRCMin_C DFC_DisblMsk.DFC_AirCClntPPerSRCMax_C DFC_DisblMsk.DFC_AirCClntPPerSRCMin_C DFC_DisblMsk.DFC_AirCClntPdcycSRCMax_C DFC_DisblMsk.DFC_AirCClntPdcycSRCMin_C DFC_DisblMsk.DFC_AirCCmprOL_C DFC_DisblMsk.DFC_AirCCmprRedTrqOL_C DFC_DisblMsk.DFC_AirCCmprRedTrqSCB_C DFC_DisblMsk.DFC_AirCCmprRedTrqSCG_C DFC_DisblMsk.DFC_AirCCmprSCB_C DFC_DisblMsk.DFC_AirCCmprSCG_C DFC_DisblMsk.DFC_AirCSwtNpl_C DFC_DisblMsk.DFC_AirCSwtSig_C DFC_DisblMsk.DFC_BattUSRCMax_C DFC_DisblMsk.DFC_BattUSRCMin_C DFC_DisblMsk.DFC_BrkNpl_C DFC_DisblMsk.DFC_BrkPSRCMax_C DFC_DisblMsk.DFC_BrkPSRCMin_C DFC_DisblMsk.DFC_BrkSig_C DFC_DisblMsk.DFC_CByVlvOL_C DFC_DisblMsk.DFC_CByVlvSCB_C DFC_DisblMsk.DFC_CByVlvSCG_C DFC_DisblMsk.DFC_CEngDsTSRCMax_C DFC_DisblMsk.DFC_CEngDsTSRCMin_C DFC_DisblMsk.DFC_CEngDsTSig_C DFC_DisblMsk.DFC_CEngUsTSRCMax_C DFC_DisblMsk.DFC_CEngUsTSRCMin_C DFC_DisblMsk.DFC_CThmstOL_C DFC_DisblMsk.DFC_CThmstSCB_C DFC_DisblMsk.DFC_CThmstSCG_C DFC_DisblMsk.DFC_ClthSig_C DFC_DisblMsk.DFC_ECBVlvOL_C DFC_DisblMsk.DFC_ECBVlvSCB_C DFC_DisblMsk.DFC_ECBVlvSCG_C DFC_DisblMsk.DFC_ECBVlvSRCMax_C DFC_DisblMsk.DFC_ECBVlvSRCMin_C DFC_DisblMsk.DFC_EGRVlvGovDvtMax_C DFC_DisblMsk.DFC_EGRVlvGovDvtMin_C DFC_DisblMsk.DFC_EGRVlvOL_C DFC_DisblMsk.DFC_EGRVlvSCB_C DFC_DisblMsk.DFC_EGRVlvSCG_C DFC_DisblMsk.DFC_EGRVlvSRCMax_C DFC_DisblMsk.DFC_EGRVlvSRCMin_C DFC_DisblMsk.DFC_EMDmpOL_0_C DFC_DisblMsk.DFC_EMDmpOL_1_C DFC_DisblMsk.DFC_EMDmpSCB_0_C DFC_DisblMsk.DFC_EMDmpSCB_1_C DFC_DisblMsk.DFC_EMDmpSCG_0_C DFC_DisblMsk.DFC_EMDmpSCG_1_C DFC_DisblMsk.DFC_EngStAOL_C DFC_DisblMsk.DFC_EngStASCB_C DFC_DisblMsk.DFC_EngStASCG_C DFC_DisblMsk.DFC_EnvPSRCMax_C DFC_DisblMsk.DFC_EnvPSRCMin_C DFC_DisblMsk.DFC_EnvPSig_C DFC_DisblMsk.DFC_EnvTSRCMax_C DFC_DisblMsk.DFC_EnvTSRCMin_C DFC_DisblMsk.DFC_FanOL_C DFC_DisblMsk.DFC_FanSCB_C DFC_DisblMsk.DFC_FlFltSig_C DFC_DisblMsk.DFC_FuelTSRCMax_C DFC_DisblMsk.DFC_FuelTSRCMin_C DFC_DisblMsk.DFC_GbxNPosPPerSRCMax_C DFC_DisblMsk.DFC_GbxNPosPPerSRCMin_C DFC_DisblMsk.DFC_GbxNPosPdcycSRCMax_C DFC_DisblMsk.DFC_GbxNPosPdcycSRCMin_C DFC_DisblMsk.DFC_GbxNPosSig_C DFC_DisblMsk.DFC_GlwPlgBSDOL_0_C DFC_DisblMsk.DFC_GlwPlgBSDOL_1_C DFC_DisblMsk.DFC_GlwPlgBSDOL_2_C DFC_DisblMsk.DFC_GlwPlgBSDOL_3_C DFC_DisblMsk.DFC_GlwPlgBSDOL_4_C DFC_DisblMsk.DFC_GlwPlgBSDOL_5_C DFC_DisblMsk.DFC_GlwPlgBSDOL_6_C DFC_DisblMsk.DFC_GlwPlgBSDOL_7_C DFC_DisblMsk.DFC_GlwPlgBSDOT_0_C DFC_DisblMsk.DFC_GlwPlgBSDOT_1_C DFC_DisblMsk.DFC_GlwPlgBSDOT_2_C DFC_DisblMsk.DFC_GlwPlgBSDOT_3_C DFC_DisblMsk.DFC_GlwPlgBSDOT_4_C DFC_DisblMsk.DFC_GlwPlgBSDOT_5_C DFC_DisblMsk.DFC_GlwPlgBSDOT_6_C DFC_DisblMsk.DFC_GlwPlgBSDOT_7_C DFC_DisblMsk.DFC_GlwPlgBSDSC_0_C DFC_DisblMsk.DFC_GlwPlgBSDSC_1_C DFC_DisblMsk.DFC_GlwPlgBSDSC_2_C DFC_DisblMsk.DFC_GlwPlgBSDSC_3_C DFC_DisblMsk.DFC_GlwPlgBSDSC_4_C DFC_DisblMsk.DFC_GlwPlgBSDSC_5_C DFC_DisblMsk.DFC_GlwPlgBSDSC_6_C DFC_DisblMsk.DFC_GlwPlgBSDSC_7_C DFC_DisblMsk.DFC_GlwPlgComErr_C DFC_DisblMsk.DFC_InjVlvPresMin_C DFC_DisblMsk.DFC_LSUCircNernstMax_0_C DFC_DisblMsk.DFC_LSUCircNernstMax_1_C DFC_DisblMsk.DFC_LSUCircNernstMax_2_C DFC_DisblMsk.DFC_LSUCircNernstMax_3_C DFC_DisblMsk.DFC_LSUCircNernstMin_0_C DFC_DisblMsk.DFC_LSUCircNernstMin_1_C DFC_DisblMsk.DFC_LSUCircNernstMin_2_C DFC_DisblMsk.DFC_LSUCircNernstMin_3_C DFC_DisblMsk.DFC_LSUCircNernstSig_0_C DFC_DisblMsk.DFC_LSUCircNernstSig_1_C DFC_DisblMsk.DFC_LSUCircNernstSig_2_C DFC_DisblMsk.DFC_LSUCircNernstSig_3_C DFC_DisblMsk.DFC_LSUCircPmpCurMax_0_C DFC_DisblMsk.DFC_LSUCircPmpCurMax_1_C DFC_DisblMsk.DFC_LSUCircPmpCurMax_2_C DFC_DisblMsk.DFC_LSUCircPmpCurMax_3_C DFC_DisblMsk.DFC_LSUCircPmpCurMin_0_C DFC_DisblMsk.DFC_LSUCircPmpCurMin_1_C DFC_DisblMsk.DFC_LSUCircPmpCurMin_2_C DFC_DisblMsk.DFC_LSUCircPmpCurMin_3_C DFC_DisblMsk.DFC_LSUCircPmpCurSig_0_C DFC_DisblMsk.DFC_LSUCircPmpCurSig_1_C DFC_DisblMsk.DFC_LSUCircPmpCurSig_2_C DFC_DisblMsk.DFC_LSUCircPmpCurSig_3_C DFC_DisblMsk.DFC_LSUCircVirtGndMax_0_C DFC_DisblMsk.DFC_LSUCircVirtGndMax_1_C DFC_DisblMsk.DFC_LSUCircVirtGndMax_2_C DFC_DisblMsk.DFC_LSUCircVirtGndMax_3_C DFC_DisblMsk.DFC_LSUCircVirtGndMin_0_C DFC_DisblMsk.DFC_LSUCircVirtGndMin_1_C DFC_DisblMsk.DFC_LSUCircVirtGndMin_2_C DFC_DisblMsk.DFC_LSUCircVirtGndMin_3_C DFC_DisblMsk.DFC_LSUCircVirtGndSig_0_C DFC_DisblMsk.DFC_LSUCircVirtGndSig_1_C DFC_DisblMsk.DFC_LSUCircVirtGndSig_2_C DFC_DisblMsk.DFC_LSUCircVirtGndSig_3_C DFC_DisblMsk.DFC_LSUHtrMax_0_C DFC_DisblMsk.DFC_LSUHtrMax_1_C DFC_DisblMsk.DFC_LSUHtrMax_2_C DFC_DisblMsk.DFC_LSUHtrMax_3_C DFC_DisblMsk.DFC_LSUHtrMin_0_C DFC_DisblMsk.DFC_LSUHtrMin_1_C DFC_DisblMsk.DFC_LSUHtrMin_2_C DFC_DisblMsk.DFC_LSUHtrMin_3_C DFC_DisblMsk.DFC_LSUHtrSig_0_C DFC_DisblMsk.DFC_LSUHtrSig_1_C DFC_DisblMsk.DFC_LSUHtrSig_2_C DFC_DisblMsk.DFC_LSUHtrSig_3_C DFC_DisblMsk.DFC_LSUO2Max_0_C DFC_DisblMsk.DFC_LSUO2Max_1_C DFC_DisblMsk.DFC_LSUO2Max_2_C DFC_DisblMsk.DFC_LSUO2Max_3_C DFC_DisblMsk.DFC_LSUO2Min_0_C DFC_DisblMsk.DFC_LSUO2Min_1_C DFC_DisblMsk.DFC_LSUO2Min_2_C DFC_DisblMsk.DFC_LSUO2Min_3_C DFC_DisblMsk.DFC_LSUSPIBattLowMin_0_C DFC_DisblMsk.DFC_LSUSPIBattLowMin_1_C DFC_DisblMsk.DFC_LSUSPIBattLowMin_2_C DFC_DisblMsk.DFC_LSUSPIBattLowMin_3_C DFC_DisblMsk.DFC_LSUSPISig_0_C DFC_DisblMsk.DFC_LSUSPISig_1_C DFC_DisblMsk.DFC_LSUSPISig_2_C DFC_DisblMsk.DFC_LSUSPISig_3_C DFC_DisblMsk.DFC_LSUtExcMax_0_C DFC_DisblMsk.DFC_LSUtExcMax_1_C DFC_DisblMsk.DFC_LSUtExcMax_2_C DFC_DisblMsk.DFC_LSUtExcMax_3_C DFC_DisblMsk.DFC_LSUtExcMin_0_C DFC_DisblMsk.DFC_LSUtExcMin_1_C DFC_DisblMsk.DFC_LSUtExcMin_2_C DFC_DisblMsk.DFC_LSUtExcMin_3_C DFC_DisblMsk.DFC_MILOL_C DFC_DisblMsk.DFC_MILSCB_C DFC_DisblMsk.DFC_MILSCG_C DFC_DisblMsk.DFC_MeUnSCG_C DFC_DisblMsk.DFC_NplHsChngPPFltDiff_C DFC_DisblMsk.DFC_NplPAirFltDs_C DFC_DisblMsk.DFC_NplTPFltUs_C DFC_DisblMsk.DFC_OilComErr_C DFC_DisblMsk.DFC_OilPLmpOL_C DFC_DisblMsk.DFC_OilPLmpSCB_C DFC_DisblMsk.DFC_OilPLmpSCG_C DFC_DisblMsk.DFC_OilPNpl_C DFC_DisblMsk.DFC_OilTNpl_C DFC_DisblMsk.DFC_OilTSRCMax_C DFC_DisblMsk.DFC_OilTSRCMin_C DFC_DisblMsk.DFC_PCACDsEnvPPls_C DFC_DisblMsk.DFC_PCACDsSRCMax_C DFC_DisblMsk.DFC_PCACDsSRCMin_C DFC_DisblMsk.DFC_PCVSCG_C DFC_DisblMsk.DFC_PFltCharPDiffMin_C DFC_DisblMsk.DFC_PFltDstrMin_C DFC_DisblMsk.DFC_PFltEngPrt_C DFC_DisblMsk.DFC_PFltLmpOL_C DFC_DisblMsk.DFC_PFltLmpSCB_C DFC_DisblMsk.DFC_PFltLmpSCG_C DFC_DisblMsk.DFC_PFltRgnPerm_C DFC_DisblMsk.DFC_PFltSRCMaxFlwRstn_C DFC_DisblMsk.DFC_PFltSRCMinFlwRstn_C DFC_DisblMsk.DFC_PFltSotMsDvtMax_C DFC_DisblMsk.DFC_PFltSotMsDvtMin_C DFC_DisblMsk.DFC_PFltSotMsMax_C DFC_DisblMsk.DFC_PSPOL_C DFC_DisblMsk.DFC_PSPSCB_C DFC_DisblMsk.DFC_PSPSCG_C DFC_DisblMsk.DFC_SRCHighAPP1_C DFC_DisblMsk.DFC_SRCHighAPP2_C DFC_DisblMsk.DFC_SRCLowAPP1_C DFC_DisblMsk.DFC_SRCLowAPP2_C DFC_DisblMsk.DFC_SRCMaxPAirFltDs_C DFC_DisblMsk.DFC_SRCMaxPPFltUs_C DFC_DisblMsk.DFC_SRCMaxTECU_C DFC_DisblMsk.DFC_SRCMaxTOxiCatUs_C DFC_DisblMsk.DFC_SRCMaxTPFltUs_C DFC_DisblMsk.DFC_SRCMinPAirFltDs_C DFC_DisblMsk.DFC_SRCMinPPFltUs_C DFC_DisblMsk.DFC_SRCMinTECU_C DFC_DisblMsk.DFC_SRCMinTOxiCatUs_C DFC_DisblMsk.DFC_SRCMinTPFltUs_C DFC_DisblMsk.DFC_SVSOL_C DFC_DisblMsk.DFC_SVSSCB_C DFC_DisblMsk.DFC_SVSSCG_C DFC_DisblMsk.DFC_StrtOL_C DFC_DisblMsk.DFC_StrtSCB_C DFC_DisblMsk.DFC_StrtSCG_C DFC_DisblMsk.DFC_SyncAPP_C DFC_DisblMsk.DFC_T15Npl_C DFC_DisblMsk.DFC_TAFSDtyCycHi_C DFC_DisblMsk.DFC_TAFSDtyCycLo_C DFC_DisblMsk.DFC_TAFSPerHi_C DFC_DisblMsk.DFC_TAFSPerLo_C DFC_DisblMsk.DFC_TCACDsSRCMax_C DFC_DisblMsk.DFC_TCACDsSRCMin_C DFC_DisblMsk.DFC_ThrVlvOL_C DFC_DisblMsk.DFC_ThrVlvSCB_C DFC_DisblMsk.DFC_ThrVlvSRCMax_C DFC_DisblMsk.DFC_ThrVlvSRCMin_C DFC_DisblMsk.DFC_TrbChLPOL_C DFC_DisblMsk.DFC_TrbChLPSCB_C DFC_DisblMsk.DFC_TrbChLPSCG_C DFC_DisblMsk.DFC_TrbChOL_C DFC_DisblMsk.DFC_TrbChSCB_C DFC_DisblMsk.DFC_VSwVlvGovDvtMax_C DFC_DisblMsk.DFC_VSwVlvGovDvtMin_C DFC_DisblMsk.DFC_VSwVlvOL_C DFC_DisblMsk.DFC_VSwVlvSCB_C DFC_DisblMsk.DFC_VSwVlvSCG_C DFC_DisblMsk.DFC_VSwVlvSRCMax_C DFC_DisblMsk.DFC_VSwVlvSRCMin_C DFC_DisblMsk.DFC_VehVHW_C DFC_DisblMsk.DFC_VehVMax_C DFC_DisblMsk.DFC_VehVPlaus_C DFC_DisblMsk.DFC_VehVSig_C DFC_DisblMsk.DFC_WaHtElOL_C DFC_DisblMsk.DFC_WaHtElSCB_C DFC_DisblMsk.DFC_ClthNpl_C DFC_DisblMsk.DFC_ETClbETMax_0_C DFC_DisblMsk.DFC_ETClbETMax_1_C DFC_DisblMsk.DFC_ETClbETMax_2_C DFC_DisblMsk.DFC_ETClbETMax_3_C DFC_DisblMsk.DFC_ETClbETMax_4_C DFC_DisblMsk.DFC_ETClbETMax_5_C DFC_DisblMsk.DFC_ETClbETMin_0_C DFC_DisblMsk.DFC_ETClbETMin_1_C DFC_DisblMsk.DFC_ETClbETMin_2_C DFC_DisblMsk.DFC_ETClbETMin_3_C DFC_DisblMsk.DFC_ETClbETMin_4_C DFC_DisblMsk.DFC_ETClbETMin_5_C DFC_DisblMsk.DFC_IVDiaBnkShCirBSH_0_C DFC_DisblMsk.DFC_IVDiaBnkShCirBSH_1_C DFC_DisblMsk.DFC_IVDiaBnkShCirChSwt_0_C DFC_DisblMsk.DFC_IVDiaBnkShCirChSwt_1_C DFC_DisblMsk.DFC_IVDiaBnkShCirHSBatt_0_C DFC_DisblMsk.DFC_IVDiaBnkShCirHSBatt_1_C DFC_DisblMsk.DFC_IVDiaBnkShCirHiRstnc_0_C DFC_DisblMsk.DFC_IVDiaBnkShCirHiRstnc_1_C DFC_DisblMsk.DFC_IVDiaBnkShCirLSHSGnd_0_C DFC_DisblMsk.DFC_IVDiaBnkShCirLSHSGnd_1_C DFC_DisblMsk.DFC_IVDiaBnkShCirTransfer_0_C DFC_DisblMsk.DFC_IVDiaBnkShCirTransfer_1_C DFC_DisblMsk.DFC_IVDiaCylNoCls_0_C DFC_DisblMsk.DFC_IVDiaCylNoCls_1_C DFC_DisblMsk.DFC_IVDiaCylNoCls_2_C DFC_DisblMsk.DFC_IVDiaCylNoCls_3_C DFC_DisblMsk.DFC_IVDiaCylNoCls_4_C DFC_DisblMsk.DFC_IVDiaCylNoCls_5_C DFC_DisblMsk.DFC_IVDiaCylNoLd_0_C DFC_DisblMsk.DFC_IVDiaCylNoLd_1_C DFC_DisblMsk.DFC_IVDiaCylNoLd_2_C DFC_DisblMsk.DFC_IVDiaCylNoLd_3_C DFC_DisblMsk.DFC_IVDiaCylNoLd_4_C DFC_DisblMsk.DFC_IVDiaCylNoLd_5_C DFC_DisblMsk.DFC_IVDiaCylShCirHiRstnc_0_C DFC_DisblMsk.DFC_IVDiaCylShCirHiRstnc_1_C DFC_DisblMsk.DFC_IVDiaCylShCirHiRstnc_2_C DFC_DisblMsk.DFC_IVDiaCylShCirHiRstnc_3_C DFC_DisblMsk.DFC_IVDiaCylShCirHiRstnc_4_C DFC_DisblMsk.DFC_IVDiaCylShCirHiRstnc_5_C DFC_DisblMsk.DFC_IVDiaCylShCirLSBatt_0_C DFC_DisblMsk.DFC_IVDiaCylShCirLSBatt_1_C DFC_DisblMsk.DFC_IVDiaCylShCirLSBatt_2_C DFC_DisblMsk.DFC_IVDiaCylShCirLSBatt_3_C DFC_DisblMsk.DFC_IVDiaCylShCirLSBatt_4_C DFC_DisblMsk.DFC_IVDiaCylShCirLSBatt_5_C DFC_DisblMsk.DFC_IVDiaCylShCirLSHS_0_C DFC_DisblMsk.DFC_IVDiaCylShCirLSHS_1_C DFC_DisblMsk.DFC_IVDiaCylShCirLSHS_2_C DFC_DisblMsk.DFC_IVDiaCylShCirLSHS_3_C DFC_DisblMsk.DFC_IVDiaCylShCirLSHS_4_C DFC_DisblMsk.DFC_IVDiaCylShCirLSHS_5_C DFC_DisblMsk.DFC_IVDiaCylShCirLsLs_0_C DFC_DisblMsk.DFC_IVDiaCylShCirLsLs_1_C DFC_DisblMsk.DFC_IVDiaCylShCirLsLs_2_C DFC_DisblMsk.DFC_IVDiaCylShCirLsLs_3_C DFC_DisblMsk.DFC_IVDiaCylShCirLsLs_4_C DFC_DisblMsk.DFC_IVDiaCylShCirLsLs_5_C DFC_DisblMsk.DFC_IVDiaSPICfg_C DFC_DisblMsk.DFC_IVDiaSPIColl_C DFC_DisblMsk.DFC_IVDiaSPICtrl_C DFC_DisblMsk.DFC_IVDiaSPIRam_C DFC_DisblMsk.DFC_IVDiaSPITrans_C DFC_DisblMsk.DFC_LSUCmpChk_0_C DFC_DisblMsk.DFC_LSUCmpChk_1_C DFC_DisblMsk.DFC_LSUCmpChk_2_C DFC_DisblMsk.DFC_LSUCmpChk_3_C DFC_DisblMsk.DFC_LSUCmpChk_4_C DFC_DisblMsk.DFC_LSUCmpChk_5_C DFC_DisblMsk.DFC_LSUDynChk_0_C DFC_DisblMsk.DFC_LSUDynChk_1_C DFC_DisblMsk.DFC_LSUDynChk_2_C DFC_DisblMsk.DFC_LSUDynChk_3_C DFC_DisblMsk.DFC_LSUO2ClbMax_0_C DFC_DisblMsk.DFC_LSUO2ClbMax_1_C DFC_DisblMsk.DFC_LSUO2ClbMax_2_C DFC_DisblMsk.DFC_LSUO2ClbMax_3_C DFC_DisblMsk.DFC_LSUO2ClbMin_0_C DFC_DisblMsk.DFC_LSUO2ClbMin_1_C DFC_DisblMsk.DFC_LSUO2ClbMin_2_C DFC_DisblMsk.DFC_LSUO2ClbMin_3_C DFC_DisblMsk.DFC_LSUO2PlausMax_0_C DFC_DisblMsk.DFC_LSUO2PlausMax_1_C DFC_DisblMsk.DFC_LSUO2PlausMax_2_C DFC_DisblMsk.DFC_LSUO2PlausMax_3_C DFC_DisblMsk.DFC_LSUO2PlausMin_0_C DFC_DisblMsk.DFC_LSUO2PlausMin_1_C DFC_DisblMsk.DFC_LSUO2PlausMin_2_C DFC_DisblMsk.DFC_LSUO2PlausMin_3_C DFC_DisblMsk.DFC_LSURiClbMax_0_C DFC_DisblMsk.DFC_LSURiClbMax_1_C DFC_DisblMsk.DFC_LSURiClbMax_2_C DFC_DisblMsk.DFC_LSURiClbMax_3_C DFC_DisblMsk.DFC_LSURiClbMin_0_C DFC_DisblMsk.DFC_LSURiClbMin_1_C DFC_DisblMsk.DFC_LSURiClbMin_2_C DFC_DisblMsk.DFC_LSURiClbMin_3_C DFC_DisblMsk.DFC_LSUWireIPSig_0_C DFC_DisblMsk.DFC_LSUWireIPSig_1_C DFC_DisblMsk.DFC_LSUWireIPSig_2_C DFC_DisblMsk.DFC_LSUWireIPSig_3_C DFC_DisblMsk.DFC_AFSDrftIdlAdjVal_C DFC_DisblMsk.DFC_AFSDrftLdAdjVal_C DFC_DisblMsk.DFC_AdcI_ADC0_Cal_C DFC_DisblMsk.DFC_AdcI_ADC0_Conv_C DFC_DisblMsk.DFC_CmbChbMisfireMax_0_C DFC_DisblMsk.DFC_CmbChbMisfireMax_1_C DFC_DisblMsk.DFC_CmbChbMisfireMax_2_C DFC_DisblMsk.DFC_CmbChbMisfireMax_3_C DFC_DisblMsk.DFC_CmbChbMisfireMax_4_C DFC_DisblMsk.DFC_CmbChbMisfireMax_5_C DFC_DisblMsk.DFC_CmbChbMisfireMul_C DFC_DisblMsk.DFC_INJVLVBUSY_C DFC_DisblMsk.DFC_IVAdjIVA_0_C DFC_DisblMsk.DFC_IVAdjIVA_1_C DFC_DisblMsk.DFC_IVAdjIVA_2_C DFC_DisblMsk.DFC_IVAdjIVA_3_C DFC_DisblMsk.DFC_IVAdjIVA_4_C DFC_DisblMsk.DFC_IVAdjIVA_5_C DFC_DisblMsk.DFC_InjCtlAdjQntEEPCS_C DFC_DisblMsk.DFC_InjCtlDriftEEPCS_C DFC_DisblMsk.DFC_MRlyErlyOpng_C DFC_DisblMsk.DFC_MRlyStk_C DFC_DisblMsk.DFC_SensFrzPPFltUs_C DFC_DisblMsk.DFC_T15Sig_C DFC_DisblMsk.DFC_AirCtlRmpTOut_C DFC_DisblMsk.DFC_CEngDsTDynTst_C DFC_DisblMsk.DFC_EGRVlvJamVlvClsd_C DFC_DisblMsk.DFC_EGRVlvJamVlvOpn_C DFC_DisblMsk.DFC_EGRVlvLgTDrft_C DFC_DisblMsk.DFC_EGRVlvOfsLrnJamVlv_C DFC_DisblMsk.DFC_EGRVlvShTDrft_C DFC_DisblMsk.DFC_EGTRgnOilDilMax_C DFC_DisblMsk.DFC_EngICO_C DFC_DisblMsk.DFC_EpmCaSI1ErrSig_C DFC_DisblMsk.DFC_EpmCaSI1NoSig_C DFC_DisblMsk.DFC_EpmCaSI1OfsErr_C DFC_DisblMsk.DFC_EpmCrSErrSig_C DFC_DisblMsk.DFC_EpmCrSNoSig_C DFC_DisblMsk.DFC_MoCADCCmp_C DFC_DisblMsk.DFC_MoCADCTst_C DFC_DisblMsk.DFC_MoCADCVltgRatio_C DFC_DisblMsk.DFC_MoCSOPLoLi_C DFC_DisblMsk.DFC_MoCSOPMM_C DFC_DisblMsk.DFC_MoCSOPTimeOut_C DFC_DisblMsk.DFC_MoCSOPUpLi_C DFC_DisblMsk.DFC_MoFAPP_C DFC_DisblMsk.DFC_MoFESpd_C DFC_DisblMsk.DFC_MoFInjDatPhi_C DFC_DisblMsk.DFC_MoFInjDatQnt_C DFC_DisblMsk.DFC_MoFInjQnt_C DFC_DisblMsk.DFC_MoFOvR_C DFC_DisblMsk.DFC_MoFQntCor_C DFC_DisblMsk.DFC_MoFTrqCmp_C DFC_DisblMsk.DFC_NplTOxiCatUs_C DFC_DisblMsk.DFC_PhyModNonMonMapNpl_C DFC_DisblMsk.DFC_RailPOfsTstMax_C DFC_DisblMsk.DFC_RailPOfsTstMin_C DFC_DisblMsk.DFC_SWReset_0_C DFC_DisblMsk.DFC_SWReset_1_C DFC_DisblMsk.DFC_SWReset_2_C DFC_DisblMsk.DFC_VSwVlvJamVlv_C DFC_DisblMsk.DFC_VSwVlvLgTDrft_C DFC_DisblMsk.DFC_VSwVlvOfsLrnJamVlv_C DFC_DisblMsk.DFC_VSwVlvShTDrft_C /end DEF_CHARACTERISTIC
/end FUNCTION
/begin FUNCTION DFES ""
 /begin DEF_CHARACTERISTIC DFES_ThresSimCond.t_C DFES_ThresSimCond.r_C DFES_ThresSimCond.n_C DFES_xStPrio_CA /end DEF_CHARACTERISTIC
 /begin OUT_MEASUREMENT DFES_ctEntry DFES_ctMIL DFES_ctOBD DFES_ctOBDPend DFES_ctSrv DFES_numEntryAvl DFES_numEnvSize DFES_numExtdFrzFrmSize DFES_numFrzFrmSize DFES_stErrDia DFES_stErrLamp DFES_stOutstate /end OUT_MEASUREMENT
/end FUNCTION
/begin COMPU_METHOD CylFltPrm "" RAT_FUNC "%7.6" "-" COEFFS 0 32767 0 0 0 1 /end COMPU_METHOD
/begin COMPU_METHOD DFES_nPID0C "" RAT_FUNC "%6.3" "rpm" COEFFS 0 4 0 0 0 1 /end COMPU_METHOD
/begin COMPU_METHOD DFES_OneToOne "" RAT_FUNC "%6.2" "-" COEFFS 0 1 0 0 0 1 /end COMPU_METHOD
/begin COMPU_METHOD DFES_rPID04 "" RAT_FUNC "%6.3" "%" COEFFS 0 2.55 0 0 0 1 /end COMPU_METHOD
/begin COMPU_METHOD DFES_tPID05 "" RAT_FUNC "%6.2" "deg C" COEFFS 0 1 40 0 0 1 /end COMPU_METHOD
/begin COMPU_METHOD OneToOne "" RAT_FUNC "%6.2" "-" COEFFS 0 1 0 0 0 1 /end COMPU_METHOD
/begin RECORD_LAYOUT ValA_Wu8 FNC_VALUES 1 UBYTE COLUMN_DIR DIRECT /end RECORD_LAYOUT
/begin RECORD_LAYOUT Val_Wu16 FNC_VALUES 1 UWORD COLUMN_DIR DIRECT /end RECORD_LAYOUT
/begin RECORD_LAYOUT Val_Wu8 FNC_VALUES 1 UBYTE COLUMN_DIR DIRECT /end RECORD_LAYOUT
/end MODULE
/end PROJECT
