ASAP2_VERSION 1 31
/begin PROJECT MS45 "BMW Motorsteuerung R6"
/begin HEADER "_default_HeaderComment" PROJECT_NO _56 /end HEADER
/begin MODULE _default_ModuleName "_default_ModuleLongIdentifier"
/begin MOD_COMMON "_default_ModCommonComment" DEPOSIT ABSOLUTE BYTE_ORDER MSB_FIRST ALIGNMENT_BYTE 1 ALIGNMENT_WORD 2 ALIGNMENT_LONG 4 ALIGNMENT_FLOAT32_IEEE 4 ALIGNMENT_FLOAT64_IEEE 8 /end MOD_COMMON
/begin CHARACTERISTIC lc_cru_req_swi "Configuration switch between MSW and steering lever" VALUE 0x00f0e _REC_VAL_20_u1 1. _CNV_A_R_LINEAR_____22_CM 0. 1. DISPLAY_IDENTIFIER LC_CRU_REQ_SWI FORMAT "%1.0" /end CHARACTERISTIC
/begin CHARACTERISTIC c_t_crus_on "Minimum recognition time on actuating the OFF button" VALUE 0x007e1 _REC_VAL_20_u1 2550. _CNV_A_R_LINEAR_____31_CM 0. 2550. DISPLAY_IDENTIFIER C_T_CRUS_ON FORMAT "%4.0" /end CHARACTERISTIC
/begin MEASUREMENT state_msw_can "Status of MSW to the CAN Message" UBYTE _CNV_S_8_RANGE_STAT_32_CM 1 100. 0. 7. DISPLAY_IDENTIFIER STATE_MSW_CAN ECU_ADDRESS 0x3fe732 /end MEASUREMENT
/begin MEASUREMENT lv_cru_main_swi "indicate CRU readiness" UBYTE _CNV_S_2_RANGE______5_CM 1 100. 0. 1. DISPLAY_IDENTIFIER LV_CRU_MAIN_SWI_ ECU_ADDRESS 0x3fe734 /end MEASUREMENT
/begin MEASUREMENT req_msw "Evaluated Status of MSW request module" UBYTE _CNV_S_10_RANGE_REQ__33_CM 1 100. 0. 9. DISPLAY_IDENTIFIER REQ_MSW ECU_ADDRESS 0x3fe733 /end MEASUREMENT
/begin CHARACTERISTIC c_t_min_msw "time delay of REQ_MSW" VALUE 0x0082a _REC_VAL_20_u1 2.54 _CNV_A_R_LINEAR_____4_CM 1.e-002 2.55 DISPLAY_IDENTIFIER C_T_MIN_MSW FORMAT "%4.2" /end CHARACTERISTIC
/begin CHARACTERISTIC c_t_ready_cru "Delay time after control unit initialization" VALUE 0x0083a _REC_VAL_20_u1 1550. _CNV_A_R_LINEAR_____31_CM 1000. 2550. DISPLAY_IDENTIFIER C_T_READY_CRU FORMAT "%5.0" /end CHARACTERISTIC
/begin CHARACTERISTIC c_t_crus "Minimum time between switch on ready and switch off ready" VALUE 0x007df _REC_VAL_20_u1 2550. _CNV_A_R_LINEAR_____31_CM 0. 2550. DISPLAY_IDENTIFIER C_T_CRUS FORMAT "%4.0" /end CHARACTERISTIC
/begin CHARACTERISTIC c_t_crus_off "Minimum recognition time on actuating the OFF button to switch off the display for BN2000" VALUE 0x007e0 _REC_VAL_20_u1 2550. _CNV_A_R_LINEAR_____31_CM 0. 2550. DISPLAY_IDENTIFIER C_T_CRUS_OFF FORMAT "%4.0" /end CHARACTERISTIC
/begin MEASUREMENT lv_byp_on "" UBYTE _CNV_S_2_RANGE______5_CM 1 100. 0. 1. DISPLAY_IDENTIFIER LV_BYP_ON ECU_ADDRESS 0x3fa489 /end MEASUREMENT
/begin CHARACTERISTIC c_byp_lih_cnt_max_A "" VALUE 0x005e6 _REC_VAL_20_u1 255. _CNV_A_R_LINEAR_____1_CM 0. 255. DISPLAY_IDENTIFIER C_BYP_LIH_CNT_MAX_A FORMAT "%3.0" /end CHARACTERISTIC
/begin CHARACTERISTIC c_byp_lih_cnt_max_B "" VALUE 0x005e7 _REC_VAL_20_u1 255. _CNV_A_R_LINEAR_____1_CM 0. 255. DISPLAY_IDENTIFIER C_BYP_LIH_CNT_MAX_B FORMAT "%3.0" /end CHARACTERISTIC
/begin CHARACTERISTIC c_byp_on "" VALUE 0x005e8 _REC_VAL_20_u1 255. _CNV_A_R_LINEAR_____1_CM 0. 255. DISPLAY_IDENTIFIER C_BYP_ON FORMAT "%3.0" /end CHARACTERISTIC
/begin MEASUREMENT byp_cnt_A "" UBYTE _CNV_A_R_LINEAR_____1_CM 1 100. 0. 255. DISPLAY_IDENTIFIER BYP_CNT_A ECU_ADDRESS 0x3fa486 FORMAT "%3.0" /end MEASUREMENT
/begin MEASUREMENT byp_cnt_B "" UBYTE _CNV_A_R_LINEAR_____1_CM 1 100. 0. 255. DISPLAY_IDENTIFIER BYP_CNT_B ECU_ADDRESS 0x3fa487 FORMAT "%3.0" /end MEASUREMENT
/begin MEASUREMENT byp_error "" UBYTE _CNV_A_R_LINEAR_____1_CM 1 100. 0. 255. DISPLAY_IDENTIFIER BYP_ERROR ECU_ADDRESS 0x3fa488 FORMAT "%3.0" /end MEASUREMENT
/begin CHARACTERISTIC c_byp_func_A "" VALUE 0x0149c _REC_VAL_20_u2 65535. _CNV_A_R_LINEAR_____1_CM 0. 65535. DISPLAY_IDENTIFIER C_BYP_FUNC_A FORMAT "%5.0" /end CHARACTERISTIC
/begin CHARACTERISTIC c_byp_func_B "" VALUE 0x01440 _REC_VAL_20_u4 4294967295. _CNV_A_R_LINEAR_____1_CM 0. 4294967295. DISPLAY_IDENTIFIER C_BYP_FUNC_B FORMAT "%10.0" /end CHARACTERISTIC
/begin MEASUREMENT lv_asr_plaus "Logical variable plausibility ASR" UBYTE _CNV_S_2_RANGE______0_CM 1 100. 0. 1. DISPLAY_IDENTIFIER LV_ASR_PLAUS ECU_ADDRESS 0x3fde08 BIT_MASK 0x1 /end MEASUREMENT
/begin MEASUREMENT lv_msr_plaus "Logical variable plausibility MSR" UBYTE _CNV_S_2_RANGE______0_CM 1 100. 0. 1. DISPLAY_IDENTIFIER LV_MSR_PLAUS ECU_ADDRESS 0x3fde09 BIT_MASK 0x1 /end MEASUREMENT
/begin MEASUREMENT lv_var_asr "ASC1 device recognized" UBYTE _CNV_S_2_RANGE______5_CM 1 100. 0. 1. DISPLAY_IDENTIFIER LV_VAR_ASR ECU_ADDRESS 0x3fde0a BIT_MASK 0x1 /end MEASUREMENT
/begin MEASUREMENT lv_var_asr_3 "ASC3 device recognized" UBYTE _CNV_S_2_RANGE______5_CM 1 100. 0. 1. DISPLAY_IDENTIFIER LV_VAR_ASR_3 ECU_ADDRESS 0x3fde0b BIT_MASK 0x1 /end MEASUREMENT
/begin MEASUREMENT lv_at "LV automatic transmission recognized" UBYTE _CNV_S_2_RANGE______5_CM 1 100. 0. 1. DISPLAY_IDENTIFIER LV_AT ECU_ADDRESS 0x3fde3c BIT_MASK 0x1 /end MEASUREMENT
/begin MEASUREMENT lv_var_icl "LV CAN-Kombi recognized" UBYTE _CNV_S_2_RANGE______5_CM 1 100. 0. 1. DISPLAY_IDENTIFIER LV_VAR_ICL ECU_ADDRESS 0x3fde4b BIT_MASK 0x1 /end MEASUREMENT
/begin MEASUREMENT lv_var_acin "LV air conditioning recognized" UBYTE _CNV_S_2_RANGE______5_CM 1 100. 0. 1. DISPLAY_IDENTIFIER LV_VAR_ACIN ECU_ADDRESS 0x3fde4c BIT_MASK 0x1 /end MEASUREMENT
/begin MEASUREMENT lv_var_txu "TXU device recognized" UBYTE _CNV_S_2_RANGE______5_CM 1 100. 0. 1. DISPLAY_IDENTIFIER LV_VAR_TXU ECU_ADDRESS 0x3fde7a BIT_MASK 0x1 /end MEASUREMENT
/begin CHARACTERISTIC c_t_cru_esp_off "minimum time before cut-off CRU in case of ESP intervention" VALUE 0x007dd _REC_VAL_20_u1 25.5 _CNV_A_R_LINEAR_____24_CM 0. 25.5 DISPLAY_IDENTIFIER C_T_CRU_ESP_OFF FORMAT "%4.1" /end CHARACTERISTIC
/begin CHARACTERISTIC c_t_cru_asr_off "minimum time before cut-off CRU in case of ASR intervention" VALUE 0x007db _REC_VAL_20_u1 25.5 _CNV_A_R_LINEAR_____24_CM 0. 25.5 DISPLAY_IDENTIFIER C_T_CRU_ASR_OFF FORMAT "%4.1" /end CHARACTERISTIC
/begin CHARACTERISTIC c_t_cru_esp_brake_off "minimum time before cut-off CRU in case of ESP intervention only with brake" VALUE 0x007dc _REC_VAL_20_u1 25.5 _CNV_A_R_LINEAR_____24_CM 0. 25.5 DISPLAY_IDENTIFIER C_T_CRU_ESP_BRAKE_OFF FORMAT "%4.1" /end CHARACTERISTIC
/begin CHARACTERISTIC c_t_err_vs_can "minimum threshold time for error of vehicle speed from CAN" VALUE 0x0080f _REC_VAL_20_u1 25.5 _CNV_A_R_LINEAR_____24_CM 0. 25.5 DISPLAY_IDENTIFIER C_T_ERR_VS_CAN FORMAT "%4.1" /end CHARACTERISTIC
/begin MEASUREMENT ac_cru "Vehicle acceleration in CRU" SWORD _CNV_A_R_LINEAR_____137_CM 1 100. -15.719999999972 15.71952 DISPLAY_IDENTIFIER AC_CRU ECU_ADDRESS 0x3fdab4 BYTE_ORDER MSB_LAST FORMAT "%7.4" /end MEASUREMENT
/begin CHARACTERISTIC c_fac_vs_fil "Filter factor" VALUE 0x006e9 _REC_VAL_20_u1 255. _CNV_A_R_LINEAR_____1_CM 0. 255. DISPLAY_IDENTIFIER C_FAC_VS_FIL FORMAT "%3.0" /end CHARACTERISTIC
/begin CHARACTERISTIC c_vs_max_diag "Max. allowed deviation between VS_FIL and VS" VALUE 0x0094c _REC_VAL_20_u1 255. _CNV_A_R_LINEAR_____23_CM 0. 255. DISPLAY_IDENTIFIER C_VS_MAX_DIAG FORMAT "%3.0" /end CHARACTERISTIC
/begin MEASUREMENT lv_vs_diag_not_plaus "VS_FIL not plausible" UBYTE _CNV_S_2_RANGE______5_CM 1 100. 0. 1. DISPLAY_IDENTIFIER LV_VS_DIAG_NOT_PLAUS ECU_ADDRESS 0x3fe6fd /end MEASUREMENT
/begin MEASUREMENT lv_cru_off_by_asr_esp_ctl "Soft off condition depending on ASC interventions" UBYTE _CNV_S_2_RANGE______5_CM 1 100. 0. 1. DISPLAY_IDENTIFIER LV_CRU_OFF_BY_ASR_ESP_CTL ECU_ADDRESS 0x3fe6fe /end MEASUREMENT
/begin CHARACTERISTIC c_fac_tq_req_driv_mmv "Filtering of driver demand" VALUE 0x015aa _REC_VAL_20_u2 0.99998474 _CNV_A_R_LINEAR_____37_CM 0. 0.99998474 DISPLAY_IDENTIFIER C_FAC_TQ_REQ_DRIV_MMV FORMAT "%7.5" /end CHARACTERISTIC
/begin MEASUREMENT fac_tq_req_driv_mmv "MMV of driver torque demand" UWORD _CNV_A_R_LINEAR_____21_CM 1 100. 0. 1.99996948 DISPLAY_IDENTIFIER FAC_TQ_REQ_DRIV_MMV ECU_ADDRESS 0x3fdaba BYTE_ORDER MSB_LAST FORMAT "%7.5" /end MEASUREMENT
/begin MEASUREMENT n_vs_cru "Ratio between engine speed and vehicle speed" UWORD _CNV_A_R_LINEAR_____138_CM 1 100. 0. 16320. DISPLAY_IDENTIFIER N_VS_CRU ECU_ADDRESS 0x3fdab6 BYTE_ORDER MSB_LAST FORMAT "%5.0" /end MEASUREMENT
/begin CHARACTERISTIC c_fac_ac_cru_mmv "Filtering AC_CRU" VALUE 0x0155a _REC_VAL_20_u2 0.99998474 _CNV_A_R_LINEAR_____37_CM 0. 0.99998474 DISPLAY_IDENTIFIER C_FAC_AC_CRU_MMV FORMAT "%7.5" /end CHARACTERISTIC
/begin CHARACTERISTIC lc_vs_cru_fil "Filter factor activation" VALUE 0x00fa1 _REC_VAL_20_u1 1. _CNV_A_R_LINEAR_____22_CM 0. 1. DISPLAY_IDENTIFIER LC_VS_CRU_FIL FORMAT "%1.0" /end CHARACTERISTIC
/begin CHARACTERISTIC c_crlc_vs_cru_mmv "Filter factor" VALUE 0x014f8 _REC_VAL_20_u2 0.99998474 _CNV_A_R_LINEAR_____139_CM 0. 0.99998474 DISPLAY_IDENTIFIER C_CRLC_VS_CRU_MMV FORMAT "%7.5" /end CHARACTERISTIC
/begin MEASUREMENT vs_fil "Filtered vehicle speed" UWORD _CNV_A_R_LINEAR_____85_CM 1 100. 0. 511.99218 DISPLAY_IDENTIFIER VS_FIL ECU_ADDRESS 0x3fdaae BYTE_ORDER MSB_LAST FORMAT "%7.3" /end MEASUREMENT
/begin MEASUREMENT t_err_vs_can "Time to freeze VS_FIL before VS_FIL = 0" UWORD _CNV_A_R_LINEAR_____140_CM 1 100. 0. 65535. DISPLAY_IDENTIFIER T_ERR_VS_CAN ECU_ADDRESS 0x3fdab0 BYTE_ORDER MSB_LAST FORMAT "%5.0" /end MEASUREMENT
/begin MEASUREMENT vs_cru "Filtered vehicle speed" UWORD _CNV_A_R_LINEAR_____85_CM 1 100. 0. 511.99218 DISPLAY_IDENTIFIER VS_CRU ECU_ADDRESS 0x3fdab2 BYTE_ORDER MSB_LAST FORMAT "%7.3" /end MEASUREMENT
/begin MEASUREMENT vs_dif_icl_tcs "Difference of vehicle speed INSTR and TCS" SWORD _CNV_A_R_LINEAR_____141_CM 1 100. -256. 255.9921875 DISPLAY_IDENTIFIER VS_DIF_ICL_TCS ECU_ADDRESS 0x3fdac4 BYTE_ORDER MSB_LAST FORMAT "%7.3" /end MEASUREMENT
/begin MEASUREMENT req_cru "Request of cruise control functionality" UBYTE _CNV_S_8_RANGE_REQ__142_CM 1 100. 0. 7. DISPLAY_IDENTIFIER REQ_CRU ECU_ADDRESS 0x3fe701 /end MEASUREMENT
/begin MEASUREMENT lv_cru_off_irr "Irreversible cut off conditions for cruise control" UBYTE _CNV_S_2_RANGE______5_CM 1 100. 0. 1. DISPLAY_IDENTIFIER LV_CRU_OFF_IRR ECU_ADDRESS 0x3fe705 /end MEASUREMENT
/begin CHARACTERISTIC c_vs_min_plaus_cru "Vehicle speed condition for VS_FIL" VALUE 0x01a50 _REC_VAL_20_u2 511.99218 _CNV_A_R_LINEAR_____85_CM 0. 511.99218 DISPLAY_IDENTIFIER C_VS_MIN_PLAUS_CRU FORMAT "%7.3" /end CHARACTERISTIC
/begin MEASUREMENT t_dly_cru "Time counter overtaking" UWORD _CNV_A_R_LINEAR_____4_CM 1 100. 0. 655.35 DISPLAY_IDENTIFIER T_DLY_CRU ECU_ADDRESS 0x3fdaca BYTE_ORDER MSB_LAST FORMAT "%5.2" /end MEASUREMENT
/begin MEASUREMENT lv_cru_over_act "Overtaking function active" UBYTE _CNV_S_2_RANGE______5_CM 1 100. 0. 1. DISPLAY_IDENTIFIER LV_CRU_OVER_ACT ECU_ADDRESS 0x3fe706 /end MEASUREMENT
/begin CHARACTERISTIC c_t_dly_vs_sp_cru_max "Max .time for VS more than  VS max at CRU" VALUE 0x0080b _REC_VAL_20_u1 255. _CNV_A_R_LINEAR_____30_CM 0. 255. DISPLAY_IDENTIFIER C_T_DLY_VS_SP_CRU_MAX FORMAT "%3.0" /end CHARACTERISTIC
/begin CHARACTERISTIC c_t_dly_max_cru "Delay threshold for start of the restart function" VALUE 0x01802 _REC_VAL_20_u2 655.35 _CNV_A_R_LINEAR_____4_CM 0. 655.35 DISPLAY_IDENTIFIER C_T_DLY_MAX_CRU FORMAT "%6.2" /end CHARACTERISTIC
/begin CHARACTERISTIC c_n_vs_max_cru "Threshold value for hard cut-off" VALUE 0x00791 _REC_VAL_20_u1 99.609375 _CNV_A_R_LINEAR_____10_CM 0. 99.609375 DISPLAY_IDENTIFIER C_N_VS_MAX_CRU FORMAT "%4.1" /end CHARACTERISTIC
/begin CHARACTERISTIC c_vs_sp_dif_min_cru "Min. deviation between target and actual speed" VALUE 0x004e4 _REC_VAL_20_s2 511.9921875 _CNV_A_R_LINEAR_____141_CM -256. 255.9921875 DISPLAY_IDENTIFIER C_VS_SP_DIF_MIN_CRU FORMAT "%7.3" /end CHARACTERISTIC
/begin CHARACTERISTIC c_vs_sp_dif_max_cru "Max. deviation between target and actual speed" VALUE 0x004e2 _REC_VAL_20_s2 511.9921875 _CNV_A_R_LINEAR_____141_CM -256. 255.9921875 DISPLAY_IDENTIFIER C_VS_SP_DIF_MAX_CRU FORMAT "%7.3" /end CHARACTERISTIC
/begin MEASUREMENT lv_cru_act "Intervention of cruise control" UBYTE _CNV_S_2_RANGE______5_CM 1 100. 0. 1. DISPLAY_IDENTIFIER LV_CRU_ACT ECU_ADDRESS 0x3fe707 /end MEASUREMENT
/begin CHARACTERISTIC c_vs_dif_dly_cru_neg "Max. difference from VS_SP_DRIV_CRU and C_VS_DIF_DLY_CRU" VALUE 0x01a3c _REC_VAL_20_u2 255.9921875 _CNV_A_R_LINEAR_____141_CM 0. 255.9921875 DISPLAY_IDENTIFIER C_VS_DIF_DLY_CRU_NEG FORMAT "%7.3" /end CHARACTERISTIC
/begin CHARACTERISTIC c_fac_tq_req_hys_cru "FAC_TQ_REQ hysteresis for start of the restart function" VALUE 0x015ae _REC_VAL_20_u2 1.99996948 _CNV_A_R_LINEAR_____21_CM 0. 1.99996948 DISPLAY_IDENTIFIER C_FAC_TQ_REQ_HYS_CRU FORMAT "%7.5" /end CHARACTERISTIC
/begin CHARACTERISTIC c_ac_max_cru "Max. acceleration" VALUE 0x01458 _REC_VAL_20_u2 15.71952 _CNV_A_R_LINEAR_____143_CM 0. 15.71952 DISPLAY_IDENTIFIER C_AC_MAX_CRU FORMAT "%7.4" /end CHARACTERISTIC
/begin MEASUREMENT state_cru_can "Status of cruise control to the CAN- Message" UBYTE _CNV_S_8_RANGE_STAT_144_CM 1 100. 0. 7. DISPLAY_IDENTIFIER STATE_CRU_CAN ECU_ADDRESS 0x3fe702 /end MEASUREMENT
/begin MEASUREMENT state_cru_off_rev "Status switch off conditions reversible" UWORD _CNV_A_R_LINEAR_____22_CM 1 100. 0. 65535. DISPLAY_IDENTIFIER STATE_CRU_OFF_REV ECU_ADDRESS 0x3fdac8 BYTE_ORDER MSB_LAST FORMAT "%5.0" /end MEASUREMENT
/begin MEASUREMENT state_cru_off_irr "Status switch off conditions irreversible" UWORD _CNV_A_R_LINEAR_____22_CM 1 100. 0. 65535. DISPLAY_IDENTIFIER STATE_CRU_OFF_IRR ECU_ADDRESS 0x3fdac6 BYTE_ORDER MSB_LAST FORMAT "%5.0" /end MEASUREMENT
/begin CHARACTERISTIC c_vs_dif_dly_cru_pos "Maximum difference from VS_SP_DRIV_CRU and C_VS_DIF_DLY_CRU" VALUE 0x004d6 _REC_VAL_20_s2 255.9922 _CNV_A_R_LINEAR_____145_CM -255.9922 0. DISPLAY_IDENTIFIER C_VS_DIF_DLY_CRU_POS FORMAT "%7.3" /end CHARACTERISTIC
/begin CHARACTERISTIC c_vs_dif_min_cru_over "Vs_dif_cru min value vor finished overtaking function" VALUE 0x004de _REC_VAL_20_s2 511.9921875 _CNV_A_R_LINEAR_____141_CM -256. 255.9921875 DISPLAY_IDENTIFIER C_VS_DIF_MIN_CRU_OVER FORMAT "%7.3" /end CHARACTERISTIC
/begin CHARACTERISTIC c_vs_min_cru "lower limitation for C_VS_MIN_CRU" VALUE 0x01a4e _REC_VAL_20_u2 511.99218 _CNV_A_R_LINEAR_____85_CM 0. 511.99218 DISPLAY_IDENTIFIER C_VS_MIN_CRU FORMAT "%7.3" /end CHARACTERISTIC
/begin MEASUREMENT vs_dif_i_cru "Sum of the control deviations" SWORD _CNV_A_R_LINEAR_____141_CM 1 100. -256. 255.9921875 DISPLAY_IDENTIFIER VS_DIF_I_CRU ECU_ADDRESS 0x3fdae2 BYTE_ORDER MSB_LAST FORMAT "%7.3" /end MEASUREMENT
/begin MEASUREMENT t_ctl_cru "Time of the controlled acceleration" UBYTE _CNV_A_R_LINEAR_____24_CM 1 100. 0. 25.5 DISPLAY_IDENTIFIER T_CTL_CRU ECU_ADDRESS 0x3fe70d FORMAT "%4.1" /end MEASUREMENT
/begin MEASUREMENT vs_sp_cru "Reference input variable of the controller" UWORD _CNV_A_R_LINEAR_____85_CM 1 100. 0. 511.99218 DISPLAY_IDENTIFIER VS_SP_CRU ECU_ADDRESS 0x3fdad0 BYTE_ORDER MSB_LAST FORMAT "%7.3" /end MEASUREMENT
/begin MEASUREMENT vs_sp_dif_cru "Target variable/reference input variable difference" SWORD _CNV_A_R_LINEAR_____141_CM 1 100. -256. 255.9921875 DISPLAY_IDENTIFIER VS_SP_DIF_CRU ECU_ADDRESS 0x3fdae4 BYTE_ORDER MSB_LAST FORMAT "%7.3" /end MEASUREMENT
/begin MEASUREMENT vs_sp_inc_cru "Increment for VS_SP_CRU" UWORD _CNV_A_R_LINEAR_____85_CM 1 100. 0. 511.99218 DISPLAY_IDENTIFIER VS_SP_INC_CRU ECU_ADDRESS 0x3fdae0 BYTE_ORDER MSB_LAST FORMAT "%7.3" /end MEASUREMENT
/begin MEASUREMENT vs_sp_dec_cru "Decrement for VS_SP_CRU" UWORD _CNV_A_R_LINEAR_____85_CM 1 100. 0. 511.99218 DISPLAY_IDENTIFIER VS_SP_DEC_CRU ECU_ADDRESS 0x3fdade BYTE_ORDER MSB_LAST FORMAT "%7.3" /end MEASUREMENT
/begin MEASUREMENT vs_sp_driv_cru "Driver wish target variable" UWORD _CNV_A_R_LINEAR_____85_CM 1 100. 0. 511.99218 DISPLAY_IDENTIFIER VS_SP_DRIV_CRU_ ECU_ADDRESS 0x3fdad2 BYTE_ORDER MSB_LAST FORMAT "%7.3" /end MEASUREMENT
/begin CHARACTERISTIC c_vs_dif_min_is_cru "Threshold of the control deviation for zero setting of PV_CRU" VALUE 0x004e0 _REC_VAL_20_s2 511.9921875 _CNV_A_R_LINEAR_____141_CM -256. 255.9921875 DISPLAY_IDENTIFIER C_VS_DIF_MIN_IS_CRU FORMAT "%7.3" /end CHARACTERISTIC
/begin CHARACTERISTIC c_vs_dif_max_is_cru "Threshold of the control deviation for PUC end" VALUE 0x004da _REC_VAL_20_s2 511.9921875 _CNV_A_R_LINEAR_____141_CM -256. 255.9921875 DISPLAY_IDENTIFIER C_VS_DIF_MAX_IS_CRU FORMAT "%7.3" /end CHARACTERISTIC
/begin CHARACTERISTIC c_vs_dif_max_ac_cru "Condition for interrupting the incrementation or decrementation" VALUE 0x004d8 _REC_VAL_20_s2 511.9921875 _CNV_A_R_LINEAR_____141_CM -256. 255.9921875 DISPLAY_IDENTIFIER C_VS_DIF_MAX_AC_CRU FORMAT "%7.3" /end CHARACTERISTIC
/begin CHARACTERISTIC c_vs_dif_min_ac_cru "Condition for interrupting the incrementation or decrementation" VALUE 0x004dc _REC_VAL_20_s2 511.9921875 _CNV_A_R_LINEAR_____141_CM -256. 255.9921875 DISPLAY_IDENTIFIER C_VS_DIF_MIN_AC_CRU FORMAT "%7.3" /end CHARACTERISTIC
/begin CHARACTERISTIC c_vs_ac_min_cru "Vehicle speed threshold for acceleration valuation" VALUE 0x0093c _REC_VAL_20_u1 255. _CNV_A_R_LINEAR_____23_CM 0. 255. DISPLAY_IDENTIFIER C_VS_AC_MIN_CRU FORMAT "%3.0" /end CHARACTERISTIC
/begin CHARACTERISTIC c_vs_ac_max_cru "Vehicle speed threshold for acceleration valuation" VALUE 0x0093b _REC_VAL_20_u1 255. _CNV_A_R_LINEAR_____23_CM 0. 255. DISPLAY_IDENTIFIER C_VS_AC_MAX_CRU FORMAT "%3.0" /end CHARACTERISTIC
/begin CHARACTERISTIC c_vs_dif_max_cru "Control difference threshold for incrementing VS_SP_CRU" VALUE 0x0093f _REC_VAL_20_u1 31.875 _CNV_A_R_LINEAR_____146_CM 0. 31.875 DISPLAY_IDENTIFIER C_VS_DIF_MAX_CRU /end CHARACTERISTIC
/begin CHARACTERISTIC c_ac_pos_cru_tip "Positive acceleration for Tip-up" VALUE 0x01468 _REC_VAL_20_u2 511.9789 _CNV_A_R_LINEAR_____147_CM 0. 511.9789 DISPLAY_IDENTIFIER C_AC_POS_CRU_TIP FORMAT "%6.2" /end CHARACTERISTIC
/begin CHARACTERISTIC c_ac_neg_cru_tip "Negative acceleration for Tip-up" VALUE 0x0145c _REC_VAL_20_u2 511.9789 _CNV_A_R_LINEAR_____147_CM 0. 511.9789 DISPLAY_IDENTIFIER C_AC_NEG_CRU_TIP FORMAT "%6.2" /end CHARACTERISTIC
/begin CHARACTERISTIC c_ac_neg_cru_deacc "Negative acceleration in deceleration" VALUE 0x0145a _REC_VAL_20_u2 511.9789 _CNV_A_R_LINEAR_____147_CM 0. 511.9789 DISPLAY_IDENTIFIER C_AC_NEG_CRU_DEACC FORMAT "%6.2" /end CHARACTERISTIC
/begin CHARACTERISTIC c_ac_pos_cru_deacc "Positive acceleration" VALUE 0x01462 _REC_VAL_20_u2 511.9789 _CNV_A_R_LINEAR_____147_CM 0. 511.9789 DISPLAY_IDENTIFIER C_AC_POS_CRU_DEACC FORMAT "%6.2" /end CHARACTERISTIC
/begin CHARACTERISTIC ip_fac_cru_rest__t_ctl_cru "Correction factor of in/decrementing (xx = --, CC; yy = REST, AC, DEACC)" CURVE 0x00ad0 _REC_CUR_20_u1_u1 1.99220002 _CNV_A_R_LINEAR_____39_CM 0. 1.99220002 DISPLAY_IDENTIFIER IP_FAC_CRU_REST__T_CTL_CRU FORMAT "%5.3"
 /begin AXIS_DESCR COM_AXIS t_ctl_cru _CNV_A_R_LINEAR_____24_CM 5 0. 25.5 FORMAT "%4.1" AXIS_PTS_REF ldpm_t_ctl_cru_1 /end AXIS_DESCR
/end CHARACTERISTIC
/begin CHARACTERISTIC ip_fac_cru_ac__t_ctl_cru "Correction factor of in/decrementing (xx = --, CC; yy = REST, AC, DEACC)" CURVE 0x00ac6 _REC_CUR_20_u1_u1 1.99220002 _CNV_A_R_LINEAR_____39_CM 0. 1.99220002 DISPLAY_IDENTIFIER IP_FAC_CRU_AC__T_CTL_CRU FORMAT "%5.3"
 /begin AXIS_DESCR COM_AXIS t_ctl_cru _CNV_A_R_LINEAR_____24_CM 5 0. 25.5 FORMAT "%4.1" AXIS_PTS_REF ldpm_t_ctl_cru_1 /end AXIS_DESCR
/end CHARACTERISTIC
/begin CHARACTERISTIC ip_fac_cru_dece__t_ctl_cru "Correction factor of in/decrementing (xx = --, CC; yy = REST, AC, DEACC)" CURVE 0x00acb _REC_CUR_20_u1_u1 1.99220002 _CNV_A_R_LINEAR_____39_CM 0. 1.99220002 DISPLAY_IDENTIFIER IP_FAC_CRU_DECE__T_CTL_CRU FORMAT "%5.3"
 /begin AXIS_DESCR COM_AXIS t_ctl_cru _CNV_A_R_LINEAR_____24_CM 5 0. 25.5 FORMAT "%4.1" AXIS_PTS_REF ldpm_t_ctl_cru_1 /end AXIS_DESCR
/end CHARACTERISTIC
/begin CHARACTERISTIC ip_fac_lgrd_cru_rest__vs_sp_dif "Interception factor of the in/decrementing (xx = REST, TIP)" CURVE 0x00b26 _REC_CUR_20_u1_u2 0.9960940000000002 _CNV_A_R_LINEAR_____50_CM 0. 0.996094 DISPLAY_IDENTIFIER IP_FAC_LGRD_CRU_REST__VS_SP_DIF FORMAT "%5.3"
 /begin AXIS_DESCR COM_AXIS vs_sp_dif_cru _CNV_A_R_LINEAR_____148_CM 5 -256. 255.9921875 FORMAT "%7.3" AXIS_PTS_REF ldpm_vs_sp_dif_cru_1 /end AXIS_DESCR
/end CHARACTERISTIC
/begin CHARACTERISTIC ip_fac_lgrd_cru_tip__vs_sp_dif "Interception factor of the in/decrementing (xx = REST, TIP)" CURVE 0x00b2b _REC_CUR_20_u1_u2 0.9960940000000002 _CNV_A_R_LINEAR_____50_CM 0. 0.996094 DISPLAY_IDENTIFIER IP_FAC_LGRD_CRU_TIP__VS_SP_DIF FORMAT "%5.3"
 /begin AXIS_DESCR COM_AXIS vs_sp_dif_cru _CNV_A_R_LINEAR_____148_CM 5 -256. 255.9921875 FORMAT "%7.3" AXIS_PTS_REF ldpm_vs_sp_dif_cru_1 /end AXIS_DESCR
/end CHARACTERISTIC
/begin CHARACTERISTIC c_t_min_cru_con "Time condition for controlled acceleration" VALUE 0x00828 _REC_VAL_20_u1 25.5 _CNV_A_R_LINEAR_____24_CM 0. 25.5 DISPLAY_IDENTIFIER C_T_MIN_CRU_CON FORMAT "%4.1" /end CHARACTERISTIC
/begin CHARACTERISTIC ip_fac_cc_cru_ac__t_ctl_cru "Correction factor of in/decrementing (xx = --, CC; yy = REST, AC, DEACC)" CURVE 0x00abc _REC_CUR_20_u1_u1 1.99220002 _CNV_A_R_LINEAR_____39_CM 0. 1.99220002 DISPLAY_IDENTIFIER IP_FAC_CC_CRU_AC__T_CTL_CRU FORMAT "%5.3"
 /begin AXIS_DESCR COM_AXIS t_ctl_cru _CNV_A_R_LINEAR_____24_CM 5 0. 25.5 FORMAT "%4.1" AXIS_PTS_REF ldpm_t_ctl_cru_1 /end AXIS_DESCR
/end CHARACTERISTIC
/begin CHARACTERISTIC ip_fac_cc_cru_dece__t_ctl_cru "Correction factor of in/decrementing (xx = --, CC; yy = REST, AC, DEACC)" CURVE 0x00ac1 _REC_CUR_20_u1_u1 1.99220002 _CNV_A_R_LINEAR_____39_CM 0. 1.99220002 DISPLAY_IDENTIFIER IP_FAC_CC_CRU_DECE__T_CTL_CRU FORMAT "%5.3"
 /begin AXIS_DESCR COM_AXIS t_ctl_cru _CNV_A_R_LINEAR_____24_CM 5 0. 25.5 FORMAT "%4.1" AXIS_PTS_REF ldpm_t_ctl_cru_1 /end AXIS_DESCR
/end CHARACTERISTIC
/begin CHARACTERISTIC c_vs_dif_rng_cru "Bandwidth for reducing the control deviation" VALUE 0x01a3e _REC_VAL_20_u2 511.99218 _CNV_A_R_LINEAR_____85_CM 0. 511.99218 DISPLAY_IDENTIFIER C_VS_DIF_RNG_CRU FORMAT "%7.3" /end CHARACTERISTIC
/begin MEASUREMENT state_cru "Status of cruise control to the CAN- Message" UBYTE _CNV_S_6_RANGE_STAT_149_CM 1 100. 0. 9. DISPLAY_IDENTIFIER STATE_CRU ECU_ADDRESS 0x3fe708 /end MEASUREMENT
/begin MEASUREMENT fac_vs_lgrd_cru "Factor for intercepting the reference input variable" UBYTE _CNV_A_R_LINEAR_____29_CM 1 100. 0. 0.99610001 DISPLAY_IDENTIFIER FAC_VS_LGRD_CRU ECU_ADDRESS 0x3fe70b FORMAT "%5.3" /end MEASUREMENT
/begin MEASUREMENT fac_vs_ctl_cru "Correction factor for actuating the reference input variable" UBYTE _CNV_A_R_LINEAR_____115_CM 1 100. 0. 1.9921875 DISPLAY_IDENTIFIER FAC_VS_CTL_CRU ECU_ADDRESS 0x3fe70c FORMAT "%5.3" /end MEASUREMENT
/begin CHARACTERISTIC c_t_min_puc_cru "Time after entry into controlled constant drive" VALUE 0x0082d _REC_VAL_20_u1 25.5 _CNV_A_R_LINEAR_____24_CM 0. 25.5 DISPLAY_IDENTIFIER C_T_MIN_PUC_CRU FORMAT "%4.1" /end CHARACTERISTIC
/begin MEASUREMENT vs_dif_cru "Control deviation" SWORD _CNV_A_R_LINEAR_____141_CM 1 100. -256. 255.9921875 DISPLAY_IDENTIFIER VS_DIF_CRU ECU_ADDRESS 0x3fdad4 BYTE_ORDER MSB_LAST FORMAT "%7.3" /end MEASUREMENT
/begin MEASUREMENT fac_tq_cru_ini "CRU control variable initialisation value" UWORD _CNV_A_R_LINEAR_____9_CM 1 100. 0. 99.99847412 DISPLAY_IDENTIFIER FAC_TQ_CRU_INI ECU_ADDRESS 0x3fdada BYTE_ORDER MSB_LAST /end MEASUREMENT
/begin CHARACTERISTIC ip_fac_prop_cru "Proportional coefficient of the PI controller" MAP 0x0ad7a _REC_MAP_20_u2_u2_u2 49.999237 _CNV_A_R_LINEAR_____150_CM 0. 49.999237 DISPLAY_IDENTIFIER IP_FAC_PROP_CRU FORMAT "%7.4"
 /begin AXIS_DESCR COM_AXIS vs_sp_cru _CNV_A_R_LINEAR_____85_CM 5 0. 511.99218 FORMAT "%7.3" AXIS_PTS_REF ldpm_vs_sp_cru_1 /end AXIS_DESCR
 /begin AXIS_DESCR COM_AXIS vs_dif_cru _CNV_A_R_LINEAR_____148_CM 4 -256. 255.9921875 FORMAT "%7.3" AXIS_PTS_REF ldp_vs_dif_cru__fac_prop_cru /end AXIS_DESCR
/end CHARACTERISTIC
/begin CHARACTERISTIC ip_fac_tq_cru_ini_add_at "Additive torque based on gear and acceleration" MAP 0x0b3b8 _REC_MAP_20_u2_u2_u1 400. _CNV_A_R_LINEAR_____151_CM -200. 200. DISPLAY_IDENTIFIER IP_FAC_TQ_CRU_INI_ADD_AT FORMAT "%8.3"
 /begin AXIS_DESCR COM_AXIS ac_cru _CNV_A_R_LINEAR_____152_CM 6 -15.72 15.71952 FORMAT "%8.4" AXIS_PTS_REF ldpm_ac_cru__fac_tq_cru /end AXIS_DESCR
 /begin AXIS_DESCR COM_AXIS gear _CNV_A_R_LINEAR_____1_CM 12 0. 255. FORMAT "%3.0" AXIS_PTS_REF ldpm_gear__fac_tq_cru /end AXIS_DESCR
/end CHARACTERISTIC
/begin CHARACTERISTIC ip_fac_tq_cru_ini_add_mt "Additive torque based on gear and acceleration" MAP 0x0b448 _REC_MAP_20_u2_u2_u1 400. _CNV_A_R_LINEAR_____151_CM -200. 200. DISPLAY_IDENTIFIER IP_FAC_TQ_CRU_INI_ADD_MT FORMAT "%8.3"
 /begin AXIS_DESCR COM_AXIS ac_cru _CNV_A_R_LINEAR_____152_CM 6 -15.72 15.71952 FORMAT "%8.4" AXIS_PTS_REF ldpm_ac_cru__fac_tq_cru /end AXIS_DESCR
 /begin AXIS_DESCR COM_AXIS gear _CNV_A_R_LINEAR_____1_CM 12 0. 255. FORMAT "%3.0" AXIS_PTS_REF ldpm_gear__fac_tq_cru /end AXIS_DESCR
/end CHARACTERISTIC
/begin CHARACTERISTIC c_fac_vs_dif_rng_cru "Reduction factor for the control deviation VS_DIF_CRU" VALUE 0x006e8 _REC_VAL_20_u1 0.99610001 _CNV_A_R_LINEAR_____29_CM 0. 0.99610001 DISPLAY_IDENTIFIER C_FAC_VS_DIF_RNG_CRU FORMAT "%5.3" /end CHARACTERISTIC
/begin CHARACTERISTIC ip_fac_tq_cru_dec__n_32 "Decrement of the FAC_TQ_CRU" CURVE 0x0b3ae _REC_CUR_20_u2_u1 99.99847412 _CNV_A_R_LINEAR_____9_CM 0. 99.99847412 DISPLAY_IDENTIFIER IP_FAC_TQ_CRU_DEC__N_32
 /begin AXIS_DESCR COM_AXIS n_32 _CNV_A_R_LINEAR_____16_CM 5 0. 8160. FORMAT "%4.0" AXIS_PTS_REF ldp_n_32__fac_tq_cru /end AXIS_DESCR
/end CHARACTERISTIC
/begin CHARACTERISTIC ip_ac_neg_cru_ac__n__fac_tq_cru "negative acceleration in setting" MAP 0x08ac0 _REC_MAP_20_u2_u1_u2 511.9789 _CNV_A_R_LINEAR_____147_CM 0. 511.9789 DISPLAY_IDENTIFIER IP_AC_NEG_CRU_AC__N__FAC_TQ_CRU FORMAT "%6.2"
 /begin AXIS_DESCR COM_AXIS n_32 _CNV_A_R_LINEAR_____16_CM 3 0. 8160. FORMAT "%4.0" AXIS_PTS_REF ldpm_n_21 /end AXIS_DESCR
 /begin AXIS_DESCR COM_AXIS fac_tq_cru _CNV_A_R_LINEAR_____9_CM 3 0. 99.99847412 AXIS_PTS_REF ldpm_fac_tq_cru_1 /end AXIS_DESCR
/end CHARACTERISTIC
/begin CHARACTERISTIC ip_fac_vs_dif_i_cru "Delta VS_SP_CRU correction" MAP 0x0b724 _REC_MAP_20_u2_u2_u2 0.99998474 _CNV_A_R_LINEAR_____37_CM 0. 0.99998474 DISPLAY_IDENTIFIER IP_FAC_VS_DIF_I_CRU FORMAT "%7.5"
 /begin AXIS_DESCR COM_AXIS vs_sp_cru _CNV_A_R_LINEAR_____85_CM 5 0. 511.99218 FORMAT "%7.3" AXIS_PTS_REF ldpm_vs_sp_cru_1 /end AXIS_DESCR
 /begin AXIS_DESCR COM_AXIS vs_dif_cru _CNV_A_R_LINEAR_____148_CM 4 -256. 255.9921875 FORMAT "%7.3" AXIS_PTS_REF ldp_vs_dif_cru__fac_prop_cru /end AXIS_DESCR
/end CHARACTERISTIC
/begin CHARACTERISTIC ip_fac_vs_sp_dif_i_cru "Delta VS_SP_CRU correction" CURVE 0x0b79c _REC_CUR_20_u2_u2 1.99996948 _CNV_A_R_LINEAR_____21_CM 0. 1.99996948 DISPLAY_IDENTIFIER IP_FAC_VS_SP_DIF_I_CRU FORMAT "%7.5"
 /begin AXIS_DESCR COM_AXIS vs_sp_cru _CNV_A_R_LINEAR_____85_CM 5 0. 511.99218 FORMAT "%7.3" AXIS_PTS_REF ldpm_vs_sp_cru_1 /end AXIS_DESCR
/end CHARACTERISTIC
/begin CHARACTERISTIC c_vs_dif_delta_i "Positive acceleration" VALUE 0x0093e _REC_VAL_20_u1 63.75 _CNV_A_R_LINEAR_____153_CM 0. 63.75 DISPLAY_IDENTIFIER C_VS_DIF_DELTA_I /end CHARACTERISTIC
/begin CHARACTERISTIC c_fac_tq_cru_lgrd "Control variable limitaion gradiant" VALUE 0x01596 _REC_VAL_20_u2 99.99847412 _CNV_A_R_LINEAR_____154_CM 0. 99.99847412 DISPLAY_IDENTIFIER C_FAC_TQ_CRU_LGRD /end CHARACTERISTIC
/begin CHARACTERISTIC c_fac_tq_cru_max "Maximum request of Cruise Control" VALUE 0x01598 _REC_VAL_20_u2 99.99847412 _CNV_A_R_LINEAR_____154_CM 0. 99.99847412 DISPLAY_IDENTIFIER C_FAC_TQ_CRU_MAX /end CHARACTERISTIC
/begin CHARACTERISTIC c_fac_ac_pos_cru "Maximum reduction of FAC_VS_LGRD_CRU" VALUE 0x006bc _REC_VAL_20_u1 0.9960940000000002 _CNV_A_R_LINEAR_____50_CM 0. 0.996094 DISPLAY_IDENTIFIER C_FAC_AC_POS_CRU FORMAT "%5.3" /end CHARACTERISTIC
/begin CHARACTERISTIC c_fac_ac_pos_cru_rng_l "Maximum reduction of FAC_VS_LGRD_CRU at RNG_L" VALUE 0x006bd _REC_VAL_20_u1 0.9960940000000002 _CNV_A_R_LINEAR_____50_CM 0. 0.996094 DISPLAY_IDENTIFIER C_FAC_AC_POS_CRU_RNG_L FORMAT "%5.3" /end CHARACTERISTIC
/begin CHARACTERISTIC c_ac_pos_cru_resu "Positive acceleration at CRU resume" VALUE 0x01464 _REC_VAL_20_u2 511.9789 _CNV_A_R_LINEAR_____147_CM 0. 511.9789 DISPLAY_IDENTIFIER C_AC_POS_CRU_RESU FORMAT "%6.2" /end CHARACTERISTIC
/begin CHARACTERISTIC c_ac_pos_cru_resu_rng_l "Positive acceleration at CRU resume at RNG_L" VALUE 0x01466 _REC_VAL_20_u2 511.9789 _CNV_A_R_LINEAR_____147_CM 0. 511.9789 DISPLAY_IDENTIFIER C_AC_POS_CRU_RESU_RNG_L FORMAT "%6.2" /end CHARACTERISTIC
/begin CHARACTERISTIC c_ac_pos_cru_ac "Positive acceleration in setting/acceleration" VALUE 0x0145e _REC_VAL_20_u2 511.9789 _CNV_A_R_LINEAR_____147_CM 0. 511.9789 DISPLAY_IDENTIFIER C_AC_POS_CRU_AC FORMAT "%6.2" /end CHARACTERISTIC
/begin CHARACTERISTIC c_ac_pos_cru_ac_rng_l "Positive acceleration in setting/acceleration at RNG_L" VALUE 0x01460 _REC_VAL_20_u2 511.9789 _CNV_A_R_LINEAR_____147_CM 0. 511.9789 DISPLAY_IDENTIFIER C_AC_POS_CRU_AC_RNG_L FORMAT "%6.2" /end CHARACTERISTIC
/begin MEASUREMENT fac_tq_cru "CRU control variable" UWORD _CNV_A_R_LINEAR_____9_CM 1 100. 0. 99.99847412 DISPLAY_IDENTIFIER FAC_TQ_CRU ECU_ADDRESS 0x3fdace BYTE_ORDER MSB_LAST /end MEASUREMENT
/begin MEASUREMENT state_i_cru "Condition of I Share VS_DIF_I_CRU" UBYTE _CNV_S_4_STATE_I_CR_155_CM 1 100. 0. 3. DISPLAY_IDENTIFIER STATE_I_CRU ECU_ADDRESS 0x3fe70e /end MEASUREMENT
/begin CHARACTERISTIC ip_ac_neg_cru_resu "negative acceleration at CRU resume" MAP 0x08ad2 _REC_MAP_20_u2_u1_u2 511.9789 _CNV_A_R_LINEAR_____147_CM 0. 511.9789 DISPLAY_IDENTIFIER IP_AC_NEG_CRU_RESU FORMAT "%6.2"
 /begin AXIS_DESCR COM_AXIS n_32 _CNV_A_R_LINEAR_____16_CM 3 0. 8160. FORMAT "%4.0" AXIS_PTS_REF ldpm_n_21 /end AXIS_DESCR
 /begin AXIS_DESCR COM_AXIS fac_tq_cru _CNV_A_R_LINEAR_____9_CM 3 0. 99.99847412 AXIS_PTS_REF ldpm_fac_tq_cru_1 /end AXIS_DESCR
/end CHARACTERISTIC
/begin AXIS_PTS ldpm_t_ctl_cru_1 "" 0x013a2 t_ctl_cru _REC_AXS_20_u1 2.55 _CNV_A_R_LINEAR_____24_CM 5 0. 25.5 DISPLAY_IDENTIFIER LDPM_T_CTL_CRU_1 FORMAT "%4.1" /end AXIS_PTS
/begin AXIS_PTS ldp_vs_dif_cru__fac_prop_cru "" 0x11524 vs_dif_cru _REC_AXS_20_u2 511.9921875 _CNV_A_R_LINEAR_____148_CM 4 -256. 255.9921875 DISPLAY_IDENTIFIER LDP_VS_DIF_CRU__FAC_PROP_CRU FORMAT "%7.3" /end AXIS_PTS
/begin AXIS_PTS ldpm_vs_sp_dif_cru_1 "" 0x11d12 vs_sp_dif_cru _REC_AXS_20_u2 511.9921875 _CNV_A_R_LINEAR_____148_CM 5 -256. 255.9921875 DISPLAY_IDENTIFIER LDPM_VS_SP_DIF_CRU_1 FORMAT "%7.3" /end AXIS_PTS
/begin AXIS_PTS ldpm_n_21 "" 0x0130b n_32 _REC_AXS_20_u1 8160. _CNV_A_R_LINEAR_____16_CM 3 0. 8160. DISPLAY_IDENTIFIER LDPM_N_21 FORMAT "%4.0" /end AXIS_PTS
/begin AXIS_PTS ldpm_vs_sp_cru_1 "" 0x11d06 vs_sp_cru _REC_AXS_20_u2 511.99218 _CNV_A_R_LINEAR_____85_CM 5 0. 511.99218 DISPLAY_IDENTIFIER LDPM_VS_SP_CRU_1 FORMAT "%7.3" /end AXIS_PTS
/begin AXIS_PTS ldpm_ac_cru__fac_tq_cru "" 0x1154a ac_cru _REC_AXS_20_u2 31.43952 _CNV_A_R_LINEAR_____152_CM 6 -15.72 15.71952 DISPLAY_IDENTIFIER LDPM_AC_CRU__FAC_TQ_CRU FORMAT "%8.4" /end AXIS_PTS
/begin AXIS_PTS ldpm_gear__fac_tq_cru "" 0x07f23 gear _REC_AXS_20_u1 255. _CNV_A_R_LINEAR_____1_CM 12 0. 255. DISPLAY_IDENTIFIER LDPM_GEAR__FAC_TQ_CRU FORMAT "%3.0" /end AXIS_PTS
/begin AXIS_PTS ldp_n_32__fac_tq_cru "" 0x01024 n_32 _REC_AXS_20_u1 816. _CNV_A_R_LINEAR_____16_CM 5 0. 8160. DISPLAY_IDENTIFIER LDP_N_32__FAC_TQ_CRU FORMAT "%4.0" /end AXIS_PTS
/begin AXIS_PTS ldpm_fac_tq_cru_1 "" 0x01bae fac_tq_cru _REC_AXS_20_u2 99.99847412 _CNV_A_R_LINEAR_____9_CM 3 0. 99.99847412 DISPLAY_IDENTIFIER LDPM_FAC_TQ_CRU_1 /end AXIS_PTS
/begin CHARACTERISTIC c_vs_sp_cru_max "maximum limitation of cruise control" VALUE 0x01a56 _REC_VAL_20_u2 511.99218 _CNV_A_R_LINEAR_____85_CM 0. 511.99218 DISPLAY_IDENTIFIER C_VS_SP_CRU_MAX FORMAT "%7.3" /end CHARACTERISTIC
/begin MEASUREMENT lv_cru_over_act_ack "Hand shake overtaking function" UBYTE _CNV_S_2_RANGE______5_CM 1 100. 0. 1. DISPLAY_IDENTIFIER LV_CRU_OVER_ACT_ACK ECU_ADDRESS 0x3fe70a /end MEASUREMENT
/begin MEASUREMENT nr_step_on "Current vehicle speed step" UBYTE _CNV_A_R_LINEAR_____1_CM 1 100. 0. 255. DISPLAY_IDENTIFIER NR_STEP_ON ECU_ADDRESS 0x3fe717 FORMAT "%3.0" /end MEASUREMENT
/begin MEASUREMENT count_vs_step "Number of used vehicle speed steps" UBYTE _CNV_A_R_LINEAR_____1_CM 1 100. 0. 255. DISPLAY_IDENTIFIER COUNT_VS_STEP ECU_ADDRESS 0x3fe718 FORMAT "%3.0" /end MEASUREMENT
/begin MEASUREMENT vs_dif_step_prog "Differences between steps" UWORD _CNV_A_R_LINEAR_____68_CM 1 100. 0. 409.4 DISPLAY_IDENTIFIER VS_DIF_STEP_PROG ECU_ADDRESS 0x3fdb10 BYTE_ORDER MSB_LAST FORMAT "%5.1" /end MEASUREMENT
/begin MEASUREMENT lv_prog_step_1 "Standing programming on" UBYTE _CNV_S_2_RANGE______0_CM 1 100. 0. 1. DISPLAY_IDENTIFIER LV_PROG_STEP_1 ECU_ADDRESS 0x3fe715 /end MEASUREMENT
/begin MEASUREMENT lv_step_on "Step display on" UBYTE _CNV_S_2_RANGE______0_CM 1 100. 0. 1. DISPLAY_IDENTIFIER LV_STEP_ON ECU_ADDRESS 0x3fe714 /end MEASUREMENT
/begin MEASUREMENT vs_sp_driv_step "Active vehicle speed step for the controller" UWORD _CNV_A_R_LINEAR_____85_CM 1 100. 0. 511.99218 DISPLAY_IDENTIFIER VS_SP_DRIV_STEP ECU_ADDRESS 0x3fdb08 BYTE_ORDER MSB_LAST FORMAT "%7.3" /end MEASUREMENT
/begin MEASUREMENT nr_vs_cru "Cycle number of message IDX_NO" UBYTE _CNV_A_R_LINEAR_____1_CM 1 100. 0. 255. DISPLAY_IDENTIFIER NR_VS_CRU ECU_ADDRESS 0x3fe713 FORMAT "%3.0" /end MEASUREMENT
/begin MEASUREMENT vs_sp_driv_cru_can "Driver demand cruise control for INSTR" UWORD _CNV_A_R_LINEAR_____68_CM 1 100. 0. 409.4 DISPLAY_IDENTIFIER VS_SP_DRIV_CRU_CAN ECU_ADDRESS 0x3fdb06 BYTE_ORDER MSB_LAST FORMAT "%5.1" /end MEASUREMENT
/begin MEASUREMENT vs_step_can_1 "Vehicle speed step to the CAN Nr.1" UWORD _CNV_A_R_LINEAR_____68_CM 1 100. 0. 409.4 DISPLAY_IDENTIFIER VS_STEP_CAN_1 ECU_ADDRESS 0x3fdb0a BYTE_ORDER MSB_LAST FORMAT "%5.1" /end MEASUREMENT
/begin MEASUREMENT vs_step_can_2 "Vehicle speed step to the CAN Nr.2" UWORD _CNV_A_R_LINEAR_____68_CM 1 100. 0. 409.4 DISPLAY_IDENTIFIER VS_STEP_CAN_2 ECU_ADDRESS 0x3fdb0c BYTE_ORDER MSB_LAST FORMAT "%5.1" /end MEASUREMENT
/begin MEASUREMENT vs_step_can_3 "Vehicle speed step to the CAN Nr.3" UWORD _CNV_A_R_LINEAR_____68_CM 1 100. 0. 409.4 DISPLAY_IDENTIFIER VS_STEP_CAN_3 ECU_ADDRESS 0x3fdb0e BYTE_ORDER MSB_LAST FORMAT "%5.1" /end MEASUREMENT
/begin CHARACTERISTIC c_vs_dif_step_prog_m "M.p.h step calibration" VALUE 0x01a44 _REC_VAL_20_u2 409.4 _CNV_A_R_LINEAR_____68_CM 0. 409.4 DISPLAY_IDENTIFIER C_VS_DIF_STEP_PROG_M FORMAT "%5.1" /end CHARACTERISTIC
/begin CHARACTERISTIC c_vs_dif_step_prog_k "Km.p.h step calibration" VALUE 0x01a42 _REC_VAL_20_u2 409.4 _CNV_A_R_LINEAR_____68_CM 0. 409.4 DISPLAY_IDENTIFIER C_VS_DIF_STEP_PROG_K FORMAT "%5.1" /end CHARACTERISTIC
/begin CHARACTERISTIC c_vs_dif_step_min "Minimum between steps" VALUE 0x01a40 _REC_VAL_20_u2 409.4 _CNV_A_R_LINEAR_____68_CM 0. 409.4 DISPLAY_IDENTIFIER C_VS_DIF_STEP_MIN FORMAT "%5.1" /end CHARACTERISTIC
/begin CHARACTERISTIC c_vs_dif_tip_prog "Difference between tip steps" VALUE 0x01a46 _REC_VAL_20_u2 409.4 _CNV_A_R_LINEAR_____68_CM 0. 409.4 DISPLAY_IDENTIFIER C_VS_DIF_TIP_PROG FORMAT "%5.1" /end CHARACTERISTIC
/begin CHARACTERISTIC c_vs_min_prog "VS_CRU threshold stand programming detection" VALUE 0x01a52 _REC_VAL_20_u2 511.99218 _CNV_A_R_LINEAR_____85_CM 0. 511.99218 DISPLAY_IDENTIFIER C_VS_MIN_PROG FORMAT "%7.3" /end CHARACTERISTIC
/begin CHARACTERISTIC c_max_step "Maximum number of steps" VALUE 0x0072c _REC_VAL_20_u1 255. _CNV_A_R_LINEAR_____1_CM 0. 255. DISPLAY_IDENTIFIER C_MAX_STEP FORMAT "%3.0" /end CHARACTERISTIC
/begin CHARACTERISTIC c_t_cru_flash_light "Flash light duration time" VALUE 0x007de _REC_VAL_20_u1 2.55 _CNV_A_R_LINEAR_____4_CM 0. 2.55 DISPLAY_IDENTIFIER C_T_CRU_FLASH_LIGHT FORMAT "%4.2" /end CHARACTERISTIC
/begin CHARACTERISTIC c_t_dly_cru_tip "Time delay for display vehicle speed pointer" VALUE 0x007f1 _REC_VAL_20_u1 2.55 _CNV_A_R_LINEAR_____4_CM 0. 2.55 DISPLAY_IDENTIFIER C_T_DLY_CRU_TIP FORMAT "%4.2" /end CHARACTERISTIC
/begin CHARACTERISTIC c_t_min_prog "Time for programming detection" VALUE 0x0082c _REC_VAL_20_u1 2.55 _CNV_A_R_LINEAR_____4_CM 0. 2.55 DISPLAY_IDENTIFIER C_T_MIN_PROG FORMAT "%4.2" /end CHARACTERISTIC
/begin CHARACTERISTIC c_mod_1_pid_2_diag "Calibration byte which defines the PIDs supported by mode 01 (09h -10h)" VALUE 0x00732 _REC_VAL_20_u1 255. _CNV_A_R_LINEAR_____1_CM 0. 255. DISPLAY_IDENTIFIER C_MOD_1_PID_2_DIAG FORMAT "%3.0" /end CHARACTERISTIC
/begin CHARACTERISTIC c_mod_1_pid_3_diag "Calibration byte which defines the PIDs supported by mode 01 (11h -18h)" VALUE 0x00733 _REC_VAL_20_u1 255. _CNV_A_R_LINEAR_____1_CM 0. 255. DISPLAY_IDENTIFIER C_MOD_1_PID_3_DIAG FORMAT "%3.0" /end CHARACTERISTIC
/begin CHARACTERISTIC c_mod_1_pid_4_diag "Calibration byte which defines the PIDs supported by mode 01 (19h -20h)" VALUE 0x00734 _REC_VAL_20_u1 255. _CNV_A_R_LINEAR_____1_CM 0. 255. DISPLAY_IDENTIFIER C_MOD_1_PID_4_DIAG FORMAT "%3.0" /end CHARACTERISTIC
/begin CHARACTERISTIC c_mod_1_pid_5_diag "Calibration byte which defines the PIDs supported by mode 01 (21h -28h)" VALUE 0x00735 _REC_VAL_20_u1 255. _CNV_A_R_LINEAR_____1_CM 0. 255. DISPLAY_IDENTIFIER C_MOD_1_PID_5_DIAG FORMAT "%3.0" /end CHARACTERISTIC
/begin CHARACTERISTIC c_mod_1_pid_6_diag "Calibration byte which defines the PIDs supported by mode 01 (29h -30h)" VALUE 0x00736 _REC_VAL_20_u1 255. _CNV_A_R_LINEAR_____1_CM 0. 255. DISPLAY_IDENTIFIER C_MOD_1_PID_6_DIAG FORMAT "%3.0" /end CHARACTERISTIC
/begin CHARACTERISTIC c_mod_1_pid_7_diag "Calibration byte which defines the PIDs supported by mode 01 (31h -38h)" VALUE 0x00737 _REC_VAL_20_u1 255. _CNV_A_R_LINEAR_____1_CM 0. 255. DISPLAY_IDENTIFIER C_MOD_1_PID_7_DIAG FORMAT "%3.0" /end CHARACTERISTIC
/begin CHARACTERISTIC c_mod_1_pid_8_diag "Calibration byte which defines the PIDs supported by mode 01 (39h -40h)" VALUE 0x00738 _REC_VAL_20_u1 255. _CNV_A_R_LINEAR_____1_CM 0. 255. DISPLAY_IDENTIFIER C_MOD_1_PID_8_DIAG FORMAT "%3.0" /end CHARACTERISTIC
/begin CHARACTERISTIC c_mod_2_pid_1_diag "Calibration byte which defines the PIDs supported by mode 02 (01h -08h)" VALUE 0x00739 _REC_VAL_20_u1 255. _CNV_A_R_LINEAR_____1_CM 0. 255. DISPLAY_IDENTIFIER C_MOD_2_PID_1_DIAG FORMAT "%3.0" /end CHARACTERISTIC
/begin CHARACTERISTIC c_mod_2_pid_2_diag "Calibration byte which defines the PIDs supported by mode 02 (09h -10h)" VALUE 0x0073a _REC_VAL_20_u1 255. _CNV_A_R_LINEAR_____1_CM 0. 255. DISPLAY_IDENTIFIER C_MOD_2_PID_2_DIAG FORMAT "%3.0" /end CHARACTERISTIC
/begin CHARACTERISTIC c_mod_2_pid_3_diag "Calibration byte which defines the PIDs supported by mode 02 (11h -18h)" VALUE 0x0073b _REC_VAL_20_u1 255. _CNV_A_R_LINEAR_____1_CM 0. 255. DISPLAY_IDENTIFIER C_MOD_2_PID_3_DIAG FORMAT "%3.0" /end CHARACTERISTIC
/begin CHARACTERISTIC c_mod_2_pid_4_diag "Calibration byte which defines the PIDs supported by mode 02 (19h -20h)" VALUE 0x0073c _REC_VAL_20_u1 255. _CNV_A_R_LINEAR_____1_CM 0. 255. DISPLAY_IDENTIFIER C_MOD_2_PID_4_DIAG FORMAT "%3.0" /end CHARACTERISTIC
/begin CHARACTERISTIC c_obd_req "byte wich indicates the OBD requirements" VALUE 0x0079d _REC_VAL_20_u1 255. _CNV_A_R_LINEAR_____1_CM 0. 255. DISPLAY_IDENTIFIER C_OBD_REQ FORMAT "%3.0" /end CHARACTERISTIC
/begin CHARACTERISTIC c_mod_1_pid_1_diag "Calibration byte which defines the PIDs supported by mode 01 (01h -08h)" VALUE 0x00731 _REC_VAL_20_u1 255. _CNV_A_R_LINEAR_____1_CM 0. 255. DISPLAY_IDENTIFIER C_MOD_1_PID_1_DIAG FORMAT "%3.0" /end CHARACTERISTIC
/begin CHARACTERISTIC c_mod_6_tid_2_diag "Calibration byte which defines the PIDs supported by mode 02 (19h -20h)" VALUE 0x00743 _REC_VAL_20_u1 255. _CNV_A_R_LINEAR_____1_CM 0. 255. DISPLAY_IDENTIFIER C_MOD_6_TID_2_DIAG FORMAT "%3.0" /end CHARACTERISTIC
/begin CHARACTERISTIC c_mod_6_tid_3_diag "Calibration byte which defines the PIDs supported by mode 02 (19h -20h)" VALUE 0x00744 _REC_VAL_20_u1 255. _CNV_A_R_LINEAR_____1_CM 0. 255. DISPLAY_IDENTIFIER C_MOD_6_TID_3_DIAG FORMAT "%3.0" /end CHARACTERISTIC
/begin CHARACTERISTIC c_mod_6_tid_4_diag "Calibration byte which defines the PIDs supported by mode 02 (19h -20h)" VALUE 0x00745 _REC_VAL_20_u1 255. _CNV_A_R_LINEAR_____1_CM 0. 255. DISPLAY_IDENTIFIER C_MOD_6_TID_4_DIAG FORMAT "%3.0" /end CHARACTERISTIC
/begin CHARACTERISTIC c_mod_6_tid_1_diag "Calibration byte which defines the PIDs supported by mode 02 (19h -20h)" VALUE 0x00742 _REC_VAL_20_u1 255. _CNV_A_R_LINEAR_____1_CM 0. 255. DISPLAY_IDENTIFIER C_MOD_6_TID_1_DIAG FORMAT "%3.0" /end CHARACTERISTIC
/begin CHARACTERISTIC c_mod_9_vit_2_diag "Calibration byte which defines the PIDs supported by mode 02 (19h -20h)" VALUE 0x0074b _REC_VAL_20_u1 255. _CNV_A_R_LINEAR_____1_CM 0. 255. DISPLAY_IDENTIFIER C_MOD_9_VIT_2_DIAG FORMAT "%3.0" /end CHARACTERISTIC
/begin CHARACTERISTIC c_mod_9_vit_3_diag "Calibration byte which defines the PIDs supported by mode 02 (19h -20h)" VALUE 0x0074c _REC_VAL_20_u1 255. _CNV_A_R_LINEAR_____1_CM 0. 255. DISPLAY_IDENTIFIER C_MOD_9_VIT_3_DIAG FORMAT "%3.0" /end CHARACTERISTIC
/begin CHARACTERISTIC c_mod_9_vit_4_diag "Calibration byte which defines the PIDs supported by mode 02 (19h -20h)" VALUE 0x0074d _REC_VAL_20_u1 255. _CNV_A_R_LINEAR_____1_CM 0. 255. DISPLAY_IDENTIFIER C_MOD_9_VIT_4_DIAG FORMAT "%3.0" /end CHARACTERISTIC
/begin CHARACTERISTIC c_mod_9_vit_1_diag "Calibration byte which defines the PIDs supported by mode 02 (19h -20h)" VALUE 0x0074a _REC_VAL_20_u1 255. _CNV_A_R_LINEAR_____1_CM 0. 255. DISPLAY_IDENTIFIER C_MOD_9_VIT_1_DIAG FORMAT "%3.0" /end CHARACTERISTIC
/begin CHARACTERISTIC c_mod_8_tid_2_diag "Calibration byte which defines the PIDs supported by mode 02 (19h -20h)" VALUE 0x00747 _REC_VAL_20_u1 255. _CNV_A_R_LINEAR_____1_CM 0. 255. DISPLAY_IDENTIFIER C_MOD_8_TID_2_DIAG FORMAT "%3.0" /end CHARACTERISTIC
/begin CHARACTERISTIC c_mod_8_tid_3_diag "Calibration byte which defines the PIDs supported by mode 02 (19h -20h)" VALUE 0x00748 _REC_VAL_20_u1 255. _CNV_A_R_LINEAR_____1_CM 0. 255. DISPLAY_IDENTIFIER C_MOD_8_TID_3_DIAG FORMAT "%3.0" /end CHARACTERISTIC
/begin CHARACTERISTIC c_mod_8_tid_1_diag "Calibration byte which defines the PIDs supported by mode 02 (19h -20h)" VALUE 0x00746 _REC_VAL_20_u1 255. _CNV_A_R_LINEAR_____1_CM 0. 255. DISPLAY_IDENTIFIER C_MOD_8_TID_1_DIAG FORMAT "%3.0" /end CHARACTERISTIC
/begin CHARACTERISTIC c_mod_8_tid_4_diag "Calibration byte which defines the PIDs supported by mode 02 (19h -20h)" VALUE 0x00749 _REC_VAL_20_u1 255. _CNV_A_R_LINEAR_____1_CM 0. 255. DISPLAY_IDENTIFIER C_MOD_8_TID_4_DIAG FORMAT "%3.0" /end CHARACTERISTIC
/begin CHARACTERISTIC c_mod_5_tid_2_diag "" VALUE 0x0073e _REC_VAL_20_u1 255. _CNV_A_R_LINEAR_____1_CM 0. 255. DISPLAY_IDENTIFIER C_MOD_5_TID_2_DIAG FORMAT "%3.0" /end CHARACTERISTIC
/begin CHARACTERISTIC c_mod_5_tid_3_diag "" VALUE 0x0073f _REC_VAL_20_u1 255. _CNV_A_R_LINEAR_____1_CM 0. 255. DISPLAY_IDENTIFIER C_MOD_5_TID_3_DIAG FORMAT "%3.0" /end CHARACTERISTIC
/begin CHARACTERISTIC c_mod_5_tid_4_diag "" VALUE 0x00740 _REC_VAL_20_u1 255. _CNV_A_R_LINEAR_____1_CM 0. 255. DISPLAY_IDENTIFIER C_MOD_5_TID_4_DIAG FORMAT "%3.0" /end CHARACTERISTIC
/begin CHARACTERISTIC c_mod_5_tid_1_diag "" VALUE 0x0073d _REC_VAL_20_u1 255. _CNV_A_R_LINEAR_____1_CM 0. 255. DISPLAY_IDENTIFIER C_MOD_5_TID_1_DIAG FORMAT "%3.0" /end CHARACTERISTIC
/begin CHARACTERISTIC c_mod_5_tid_5_diag "" VALUE 0x00741 _REC_VAL_20_u1 255. _CNV_A_R_LINEAR_____1_CM 0. 255. DISPLAY_IDENTIFIER C_MOD_5_TID_5_DIAG FORMAT "%3.0" /end CHARACTERISTIC
/begin MEASUREMENT rls_mpl_value_prog "Release of multiple start value programming" UBYTE _CNV_A_R_LINEAR_____1_CM 1 100. 0. 255. DISPLAY_IDENTIFIER RLS_MPL_VALUE_PROG ECU_ADDRESS 0x3fe74c FORMAT "%3.0" /end MEASUREMENT
/begin MEASUREMENT state_imob "State of the immobilizer" UBYTE _CNV_A_R_LINEAR_____1_CM 1 100. 0. 255. DISPLAY_IDENTIFIER STATE_IMOB ECU_ADDRESS 0x3fe74d FORMAT "%3.0" /end MEASUREMENT
/begin MEASUREMENT nr_free_startvalues "Number of free startvalues bit codet and a release bit" UBYTE _CNV_A_R_LINEAR_____1_CM 1 100. 0. 255. DISPLAY_IDENTIFIER NR_FREE_STARTVALUES ECU_ADDRESS 0x3fe74b FORMAT "%3.0" /end MEASUREMENT
/begin MEASUREMENT lv_err_isc "error at idle speed control diagnosis" UBYTE _CNV_S_2_RANGE______5_CM 1 100. 0. 1. DISPLAY_IDENTIFIER LV_ERR_ISC ECU_ADDRESS 0x3fb9b4 /end MEASUREMENT
/begin CHARACTERISTIC c_maf_max_diag_isc "Minimum mass air flow to perform idle speed valve Plausibility check" VALUE 0x00724 _REC_VAL_20_u1 1389. _CNV_A_R_LINEAR_____27_CM 0. 1389. DISPLAY_IDENTIFIER C_MAF_MAX_DIAG_ISC FORMAT "%4.0" /end CHARACTERISTIC
/begin CHARACTERISTIC c_n_dif_max_diag_isc "Maximum deviation above nominal idle speed" VALUE 0x016e0 _REC_VAL_20_u2 8160. _CNV_A_R_LINEAR_____11_CM 0. 8160. DISPLAY_IDENTIFIER C_N_DIF_MAX_DIAG_ISC FORMAT "%4.0" /end CHARACTERISTIC
/begin CHARACTERISTIC c_n_dif_min_diag_isc "Minimum deviation above nominal idle speed" VALUE 0x016e2 _REC_VAL_20_u2 8160. _CNV_A_R_LINEAR_____11_CM 0. 8160. DISPLAY_IDENTIFIER C_N_DIF_MIN_DIAG_ISC FORMAT "%4.0" /end CHARACTERISTIC
/begin CHARACTERISTIC c_t_dly_isc_diag "Time delay for diagnosis activation" VALUE 0x017f8 _REC_VAL_20_u2 6553.5 _CNV_A_R_LINEAR_____24_CM 0. 6553.5 DISPLAY_IDENTIFIER C_T_DLY_ISC_DIAG FORMAT "%6.1" /end CHARACTERISTIC
/begin MEASUREMENT t_isc_diag "Time delay for diagnosis activation" UWORD _CNV_A_R_LINEAR_____24_CM 1 100. 0. 6553.5 DISPLAY_IDENTIFIER T_ISC_DIAG ECU_ADDRESS 0x3fd5f8 BYTE_ORDER MSB_LAST FORMAT "%6.1" /end MEASUREMENT
/begin CHARACTERISTIC c_abc_inc_isc "Anti-bounce counter increment for idle speed Plausibility check" VALUE 0x00539 _REC_VAL_20_u1 255. _CNV_A_R_LINEAR_____1_CM 0. 255. DISPLAY_IDENTIFIER C_ABC_INC_ISC FORMAT "%3.0" /end CHARACTERISTIC
/begin CHARACTERISTIC c_abc_dec_isc "Anti-bounce counter decrement for idle speed Plausibility check" VALUE 0x0050c _REC_VAL_20_u1 255. _CNV_A_R_LINEAR_____1_CM 0. 255. DISPLAY_IDENTIFIER C_ABC_DEC_ISC FORMAT "%3.0" /end CHARACTERISTIC
/begin CHARACTERISTIC c_flow_cps_max_diag_isc "maximum canister purge fuel flow from CPS to cylinder to perform idle speed plausibility check" VALUE 0x015be _REC_VAL_20_u2 7.99987793 _CNV_A_R_LINEAR_____111_CM 0. 7.99987793 DISPLAY_IDENTIFIER C_FLOW_CPS_MAX_DIAG_ISC FORMAT "%7.4" /end CHARACTERISTIC
/begin CHARACTERISTIC c_abc_max_isc "Maximum value of the anti-bounce counter for idle speed Plausibility check" VALUE 0x005a3 _REC_VAL_20_u1 254. _CNV_A_R_LINEAR_____1_CM 1. 255. DISPLAY_IDENTIFIER C_ABC_MAX_ISC FORMAT "%3.0" /end CHARACTERISTIC
/begin CHARACTERISTIC lc_inh_diag_isc_man "Manual inhibition of ISC diagnosis" VALUE 0x00f2c _REC_VAL_20_u1 1. _CNV_A_R_LINEAR_____22_CM 0. 1. DISPLAY_IDENTIFIER LC_INH_DIAG_ISC_MAN FORMAT "%1.0" /end CHARACTERISTIC
/begin MEASUREMENT lamb_sp_tqi "Lambda setpoint torque based" UWORD _CNV_A_R_LINEAR_____164_CM 1 100. 0. 31.99902344 DISPLAY_IDENTIFIER LAMB_SP_TQI ECU_ADDRESS 0x3fd06c BYTE_ORDER MSB_LAST FORMAT "%7.4" /end MEASUREMENT
/begin MEASUREMENT lv_tq_lamb_act "Logical variable torque based lambda output is active" UBYTE _CNV_S_2_RANGE______5_CM 1 100. 0. 1. DISPLAY_IDENTIFIER LV_TQ_LAMB_ACT ECU_ADDRESS 0x3fdfe4 /end MEASUREMENT
/begin MEASUREMENT eff_lamb_sp "Lambda efficiency setpoint torque based" UWORD _CNV_A_R_LINEAR_____21_CM 1 100. 0. 1.99996948 DISPLAY_IDENTIFIER EFF_LAMB_SP ECU_ADDRESS 0x3fd06e BYTE_ORDER MSB_LAST FORMAT "%7.5" /end MEASUREMENT
/begin MEASUREMENT eff_lamb_sp_1 "Unlimited lambda efficiency setpoint torque based" UWORD _CNV_A_R_LINEAR_____21_CM 1 100. 0. 1.99996948 DISPLAY_IDENTIFIER EFF_LAMB_SP_1 ECU_ADDRESS 0x3fd070 BYTE_ORDER MSB_LAST FORMAT "%7.5" /end MEASUREMENT
/begin MEASUREMENT tqi_fast_lamb "Fast torque setpoint for torque based lambda setpoint calculation" SWORD _CNV_A_R_LINEAR_____55_CM 1 100. -1024. 1023.96875 DISPLAY_IDENTIFIER TQI_FAST_LAMB ECU_ADDRESS 0x3fd072 BYTE_ORDER MSB_LAST FORMAT "%8.2" /end MEASUREMENT
/begin MEASUREMENT lamb_dif_sp "Setpoint lambda difference to corrected reference lambda for LAMB_SP_TQI calculation" SWORD _CNV_A_R_LINEAR_____306_CM 1 100. -32.00000000125 31.99902343875 DISPLAY_IDENTIFIER LAMB_DIF_SP ECU_ADDRESS 0x3fd074 BYTE_ORDER MSB_LAST /end MEASUREMENT
/begin CHARACTERISTIC ip_lamb_dif_sp "Setpoiont difference lambda applied on LAMB_REF_COR" CURVE 0x0bfe6 _REC_CUR_20_u2_u2 63.99902344 _CNV_A_R_LINEAR_____266_CM -32. 31.99902344 DISPLAY_IDENTIFIER IP_LAMB_DIF_SP FORMAT "%8.4"
 /begin AXIS_DESCR COM_AXIS eff_lamb_sp _CNV_A_R_LINEAR_____21_CM 16 0. 1.99996948 FORMAT "%7.5" AXIS_PTS_REF ldp_eff_lamb_sp__lamb_dif_sp /end AXIS_DESCR
/end CHARACTERISTIC
/begin CHARACTERISTIC c_eff_lamb_sp_max "Maximum allowable efficiency lambda setpoint value" VALUE 0x0153a _REC_VAL_20_u2 1.99996948 _CNV_A_R_LINEAR_____21_CM 0. 1.99996948 DISPLAY_IDENTIFIER C_EFF_LAMB_SP_MAX FORMAT "%7.5" /end CHARACTERISTIC
/begin CHARACTERISTIC lc_tq_lamb_inh_man "Manual inihibition of torque based lambda setpoint calculation" VALUE 0x00f8b _REC_VAL_20_u1 1. _CNV_A_R_LINEAR_____1_CM 0. 1. DISPLAY_IDENTIFIER LC_TQ_LAMB_INH_MAN FORMAT "%2.0" /end CHARACTERISTIC
/begin CHARACTERISTIC lc_tq_lamb_ena_man "Manual switching on of torque based lamba setpoint calculation" VALUE 0x00f8a _REC_VAL_20_u1 1. _CNV_A_R_LINEAR_____1_CM 0. 1. DISPLAY_IDENTIFIER LC_TQ_LAMB_ENA_MAN FORMAT "%2.0" /end CHARACTERISTIC
/begin AXIS_PTS ldp_eff_lamb_sp__lamb_dif_sp "" 0x10a32 eff_lamb_sp _REC_AXS_20_u2 0.199996948 _CNV_A_R_LINEAR_____21_CM 16 0. 1.99996948 DISPLAY_IDENTIFIER LDP_EFF_LAMB_SP__LAMB_DIF_SP FORMAT "%7.5" /end AXIS_PTS
/begin MEASUREMENT state_vls_eol "Status of lambda sensor EOL diagnosis confused wired" UBYTE _CNV_S_12_STATE_VLS__319_CM 1 100. 0. 24. DISPLAY_IDENTIFIER STATE_VLS_EOL ECU_ADDRESS 0x3fe761 /end MEASUREMENT
/begin MEASUREMENT lamb_sp_vls_eol_2 "Lambda setpoint for lambda sensor EOL diagnosis confused wired" UWORD _CNV_A_R_LINEAR_____164_CM 1 100. 0. 31.99902344 DISPLAY_IDENTIFIER LAMB_SP_VLS_EOL_2 ECU_ADDRESS 0x3fdb1e BYTE_ORDER MSB_LAST FORMAT "%7.4" /end MEASUREMENT
/begin CHARACTERISTIC c_tco_min_vls_eol "TCO threshold for VLS EOL diagnosis" VALUE 0x00892 _REC_VAL_20_u1 190.5 _CNV_A_R_LINEAR_____12_CM -48. 142.5 DISPLAY_IDENTIFIER C_TCO_MIN_VLS_EOL FORMAT "%5.1" /end CHARACTERISTIC
/begin CHARACTERISTIC c_teg_cat_down_eol "TEG_CAT_DOWN threshold for VLS EOL diagnosis" VALUE 0x018d4 _REC_VAL_20_u2 1507.3 _CNV_A_R_LINEAR_____262_CM -48. 1459.3 DISPLAY_IDENTIFIER C_TEG_CAT_DOWN_EOL FORMAT "%7.2" /end CHARACTERISTIC
/begin CHARACTERISTIC c_maf_int_min_vls_eol "MAF integral threshold for lambda sensor EOL diagnos confused wired" VALUE 0x0166a _REC_VAL_20_u2 1820.4167 _CNV_A_R_LINEAR_____320_CM 0. 1820.4167 DISPLAY_IDENTIFIER C_MAF_INT_MIN_VLS_EOL FORMAT "%9.4" /end CHARACTERISTIC
/begin CHARACTERISTIC c_lamb_sp_vls_eol_afr "Lambda setpoint AFR for lambda sensor EOL diagnos confused wired" VALUE 0x01618 _REC_VAL_20_u2 31.99902344 _CNV_A_R_LINEAR_____164_CM 0. 31.99902344 DISPLAY_IDENTIFIER C_LAMB_SP_VLS_EOL_AFR FORMAT "%7.4" /end CHARACTERISTIC
/begin CHARACTERISTIC c_lamb_sp_vls_eol_afl "Lambda setpoint AFL for lambda sensor EOL diagnos confused wired" VALUE 0x01616 _REC_VAL_20_u2 31.99902344 _CNV_A_R_LINEAR_____164_CM 0. 31.99902344 DISPLAY_IDENTIFIER C_LAMB_SP_VLS_EOL_AFL FORMAT "%7.4" /end CHARACTERISTIC
/begin CHARACTERISTIC c_vls_afr_eol "Rich VLS threshold for lambda sensor EOL diagnosis" VALUE 0x019f0 _REC_VAL_20_u2 4.995 _CNV_A_R_LINEAR_____316_CM 0. 4.995 DISPLAY_IDENTIFIER C_VLS_AFR_EOL FORMAT "%5.3" /end CHARACTERISTIC
/begin CHARACTERISTIC c_vls_afl_eol "Lean VLS threshold for lambda sensor EOL diagnosis" VALUE 0x019e6 _REC_VAL_20_u2 4.995 _CNV_A_R_LINEAR_____316_CM 0. 4.995 DISPLAY_IDENTIFIER C_VLS_AFL_EOL FORMAT "%5.3" /end CHARACTERISTIC
/begin MEASUREMENT lamb_sp_vls_eol_1 "Lambda setpoint for lambda sensor EOL diagnosis confused wired" UWORD _CNV_A_R_LINEAR_____164_CM 1 100. 0. 31.99902344 DISPLAY_IDENTIFIER LAMB_SP_VLS_EOL_1 ECU_ADDRESS 0x3fdb1c BYTE_ORDER MSB_LAST FORMAT "%7.4" /end MEASUREMENT
/begin MEASUREMENT maf_int_min_vls_eol "MAF integral for Lambda sensor EOL diagnosis confused wrong wired" UWORD _CNV_A_R_LINEAR_____320_CM 1 100. 0. 1820.4167 DISPLAY_IDENTIFIER MAF_INT_MIN_VLS_EOL ECU_ADDRESS 0x3fdb20 BYTE_ORDER MSB_LAST FORMAT "%9.4" /end MEASUREMENT
/begin MEASUREMENT vls_up_afr_1_eol "Frozen VLS value for Lambda sensor EOL diagnosis confused wrong wired" UWORD _CNV_A_R_LINEAR_____316_CM 1 100. 0. 4.995 DISPLAY_IDENTIFIER VLS_UP_AFR_1_EOL ECU_ADDRESS 0x3fdb22 BYTE_ORDER MSB_LAST FORMAT "%5.3" /end MEASUREMENT
/begin MEASUREMENT vls_up_afr_2_eol "Frozen VLS value for Lambda sensor EOL diagnosis confused wrong wired" UWORD _CNV_A_R_LINEAR_____316_CM 1 100. 0. 4.995 DISPLAY_IDENTIFIER VLS_UP_AFR_2_EOL ECU_ADDRESS 0x3fdb24 BYTE_ORDER MSB_LAST FORMAT "%5.3" /end MEASUREMENT
/begin MEASUREMENT vls_up_afl_2_eol "Frozen VLS value for Lambda sensor EOL diagnosis confused wrong wired" UWORD _CNV_A_R_LINEAR_____316_CM 1 100. 0. 4.995 DISPLAY_IDENTIFIER VLS_UP_AFL_2_EOL ECU_ADDRESS 0x3fdb28 BYTE_ORDER MSB_LAST FORMAT "%5.3" /end MEASUREMENT
/begin MEASUREMENT vls_up_afl_1_eol "Frozen VLS value for Lambda sensor EOL diagnosis confused wrong wired" UWORD _CNV_A_R_LINEAR_____316_CM 1 100. 0. 4.995 DISPLAY_IDENTIFIER VLS_UP_AFL_1_EOL ECU_ADDRESS 0x3fdb26 BYTE_ORDER MSB_LAST FORMAT "%5.3" /end MEASUREMENT
/begin MEASUREMENT vls_down_afl_1_eol "Frozen VLS value for Lambda sensor EOL diagnosis confused wrong wired" UWORD _CNV_A_R_LINEAR_____316_CM 1 100. 0. 4.995 DISPLAY_IDENTIFIER VLS_DOWN_AFL_1_EOL ECU_ADDRESS 0x3fdb2e BYTE_ORDER MSB_LAST FORMAT "%5.3" /end MEASUREMENT
/begin MEASUREMENT vls_down_afl_2_eol "Frozen VLS value for Lambda sensor EOL diagnosis confused wrong wired" UWORD _CNV_A_R_LINEAR_____316_CM 1 100. 0. 4.995 DISPLAY_IDENTIFIER VLS_DOWN_AFL_2_EOL ECU_ADDRESS 0x3fdb30 BYTE_ORDER MSB_LAST FORMAT "%5.3" /end MEASUREMENT
/begin MEASUREMENT vls_down_afr_1_eol "Frozen VLS value for Lambda sensor EOL diagnosis confused wrong wired" UWORD _CNV_A_R_LINEAR_____316_CM 1 100. 0. 4.995 DISPLAY_IDENTIFIER VLS_DOWN_AFR_1_EOL ECU_ADDRESS 0x3fdb2a BYTE_ORDER MSB_LAST FORMAT "%5.3" /end MEASUREMENT
/begin MEASUREMENT vls_down_afr_2_eol "Frozen VLS value for Lambda sensor EOL diagnosis confused wrong wired" UWORD _CNV_A_R_LINEAR_____316_CM 1 100. 0. 4.995 DISPLAY_IDENTIFIER VLS_DOWN_AFR_2_EOL ECU_ADDRESS 0x3fdb2c BYTE_ORDER MSB_LAST FORMAT "%5.3" /end MEASUREMENT
/begin MEASUREMENT lv_act_vls_eol "Activation bit for lambda sensor EOL diagnos confused wired" UBYTE _CNV_S_2_RANGE______0_CM 1 100. 0. 1. DISPLAY_IDENTIFIER LV_ACT_VLS_EOL ECU_ADDRESS 0x3fe762 /end MEASUREMENT
/begin MEASUREMENT lamb_sp_ext_adj_1 "bank selective external lambda setpoint (EOL test)" UWORD _CNV_A_R_LINEAR_____164_CM 1 100. 0. 31.99902344 DISPLAY_IDENTIFIER LAMB_SP_EXT_ADJ_1 ECU_ADDRESS 0x3fdb32 BYTE_ORDER MSB_LAST FORMAT "%7.4" /end MEASUREMENT
/begin MEASUREMENT lamb_sp_ext_adj_2 "bank selective external lambda setpoint (EOL test)" UWORD _CNV_A_R_LINEAR_____164_CM 1 100. 0. 31.99902344 DISPLAY_IDENTIFIER LAMB_SP_EXT_ADJ_2 ECU_ADDRESS 0x3fdb34 BYTE_ORDER MSB_LAST FORMAT "%7.4" /end MEASUREMENT
/begin MEASUREMENT lv_lamb_sp_ext_adj_1 "FL<g to activate bank selective external lambda setpoint (EOL test)" UBYTE _CNV_S_2_RANGE______0_CM 1 100. 0. 1. DISPLAY_IDENTIFIER LV_LAMB_SP_EXT_ADJ_1 ECU_ADDRESS 0x3fe766 /end MEASUREMENT
/begin MEASUREMENT lv_lamb_sp_ext_adj_2 "FL<g to activate bank selective external lambda setpoint (EOL test)" UBYTE _CNV_S_2_RANGE______0_CM 1 100. 0. 1. DISPLAY_IDENTIFIER LV_LAMB_SP_EXT_ADJ_2 ECU_ADDRESS 0x3fe767 /end MEASUREMENT
/begin CHARACTERISTIC c_n_ofs_acc_dri_min "idle speed setpoint offset minimum threshold at LV_ACIN = 1 and LV_DRI = 1" VALUE 0x00392 _REC_VAL_20_s1 510. _CNV_A_R_LINEAR_____374_CM -256. 254. DISPLAY_IDENTIFIER C_N_OFS_ACC_DRI_MIN FORMAT "%4.0" /end CHARACTERISTIC
/begin CHARACTERISTIC c_n_ofs_dri_max "idle speed setpoint offset maximum threshold at LV_ACIN = 0 and LV_DRI = 1" VALUE 0x00395 _REC_VAL_20_s1 510. _CNV_A_R_LINEAR_____374_CM -256. 254. DISPLAY_IDENTIFIER C_N_OFS_DRI_MAX FORMAT "%4.0" /end CHARACTERISTIC
/begin CHARACTERISTIC c_n_ofs_dri_min "idle speed setpoint offset minimum threshold at LV_ACIN = 0 and LV_DRI = 1" VALUE 0x00396 _REC_VAL_20_s1 510. _CNV_A_R_LINEAR_____374_CM -256. 254. DISPLAY_IDENTIFIER C_N_OFS_DRI_MIN FORMAT "%4.0" /end CHARACTERISTIC
/begin CHARACTERISTIC c_n_ofs_max "idle speed setpoint offset maximum threshold at LV_ACIN = 0 and LV_DRI = 0" VALUE 0x00397 _REC_VAL_20_s1 510. _CNV_A_R_LINEAR_____374_CM -256. 254. DISPLAY_IDENTIFIER C_N_OFS_MAX FORMAT "%4.0" /end CHARACTERISTIC
/begin CHARACTERISTIC c_n_ofs_min "idle speed setpoint offset minimum threshold at LV_ACIN = 0 and LV_DRI = 0" VALUE 0x00398 _REC_VAL_20_s1 510. _CNV_A_R_LINEAR_____374_CM -256. 254. DISPLAY_IDENTIFIER C_N_OFS_MIN FORMAT "%4.0" /end CHARACTERISTIC
/begin CHARACTERISTIC c_n_ofs_acc_max "idle speed setpoint offset maximum threshold at LV_ACIN = 1 and LV_DRI = 0" VALUE 0x00393 _REC_VAL_20_s1 510. _CNV_A_R_LINEAR_____374_CM -256. 254. DISPLAY_IDENTIFIER C_N_OFS_ACC_MAX FORMAT "%4.0" /end CHARACTERISTIC
/begin CHARACTERISTIC c_n_ofs_acc_min "idle speed setpoint offset minimum threshold at LV_ACIN = 1 and LV_DRI = 0" VALUE 0x00394 _REC_VAL_20_s1 510. _CNV_A_R_LINEAR_____374_CM -256. 254. DISPLAY_IDENTIFIER C_N_OFS_ACC_MIN FORMAT "%4.0" /end CHARACTERISTIC
/begin CHARACTERISTIC c_n_ofs_vb_max "idle speed setpoint offset maximum threshold at battery charging is active" VALUE 0x00399 _REC_VAL_20_s1 510. _CNV_A_R_LINEAR_____374_CM -256. 254. DISPLAY_IDENTIFIER C_N_OFS_VB_MAX FORMAT "%4.0" /end CHARACTERISTIC
/begin MEASUREMENT n_kwp_ofs_acc "idle speed setpoint offset at LV_ACIN = 1 and LV_DRI = 0" SBYTE _CNV_A_R_LINEAR_____374_CM 1 100. -256. 254. DISPLAY_IDENTIFIER N_KWP_OFS_ACC ECU_ADDRESS 0x3fe759 FORMAT "%4.0" /end MEASUREMENT
/begin MEASUREMENT n_kwp_ofs "idle speed setpoint offset at LV_ACIN = 0 and LV_DRI = 0" SBYTE _CNV_A_R_LINEAR_____374_CM 1 100. -256. 254. DISPLAY_IDENTIFIER N_KWP_OFS ECU_ADDRESS 0x3fe758 FORMAT "%4.0" /end MEASUREMENT
/begin MEASUREMENT n_kwp_ofs_vb_nvmy "idle speed setpoint offset at battery charging is active stored in non volatile memory" SBYTE _CNV_A_R_LINEAR_____374_CM 1 100. -256. 254. DISPLAY_IDENTIFIER N_KWP_OFS_VB_NVMY_ ECU_ADDRESS 0x3fe755 FORMAT "%4.0" /end MEASUREMENT
/begin MEASUREMENT n_kwp_ofs_acc_nvmy "idle speed setpoint offset at LV_ACIN = 1 and LV_DRI = 0 stored in non volatile memory" SBYTE _CNV_A_R_LINEAR_____374_CM 1 100. -256. 254. DISPLAY_IDENTIFIER N_KWP_OFS_ACC_NVMY_ ECU_ADDRESS 0x3fe754 FORMAT "%4.0" /end MEASUREMENT
/begin MEASUREMENT n_kwp_ofs_nvmy "idle speed setpoint offset at LV_ACIN = 0 and LV_DRI = 0 stored in non volatile memory" SBYTE _CNV_A_R_LINEAR_____374_CM 1 100. -256. 254. DISPLAY_IDENTIFIER N_KWP_OFS_NVMY_ ECU_ADDRESS 0x3fe753 FORMAT "%4.0" /end MEASUREMENT
/begin MEASUREMENT n_kwp_ofs_dri_nvmy "idle speed setpoint offset at LV_ACIN = 0 and LV_DRI = 1 stored in non volatile memory" SBYTE _CNV_A_R_LINEAR_____374_CM 1 100. -256. 254. DISPLAY_IDENTIFIER N_KWP_OFS_DRI_NVMY_ ECU_ADDRESS 0x3fe752 FORMAT "%4.0" /end MEASUREMENT
/begin MEASUREMENT n_kwp_ofs_acc_dri_nvmy "idle speed setpoint offset at LV_ACIN = 1 and LV_DRI = 1 stored in non volatile memory" SBYTE _CNV_A_R_LINEAR_____374_CM 1 100. -256. 254. DISPLAY_IDENTIFIER N_KWP_OFS_ACC_DRI_NVMY ECU_ADDRESS 0x3fe751 FORMAT "%4.0" /end MEASUREMENT
/begin CHARACTERISTIC c_n_ofs_vb_min "idle speed setpoint offset minimum threshold at battery charging is active" VALUE 0x0039a _REC_VAL_20_s1 510. _CNV_A_R_LINEAR_____374_CM -256. 254. DISPLAY_IDENTIFIER C_N_OFS_VB_MIN FORMAT "%4.0" /end CHARACTERISTIC
/begin CHARACTERISTIC c_tco_min_n_ofs_kwp "minimum TCO threshold for idle speed setpoint offset by tester" VALUE 0x0088b _REC_VAL_20_u1 190.5 _CNV_A_R_LINEAR_____12_CM -48. 142.5 DISPLAY_IDENTIFIER C_TCO_MIN_N_OFS_KWP FORMAT "%5.1" /end CHARACTERISTIC
/begin CHARACTERISTIC lc_n_ofs_kwp_disable "disable bit for idle speed setpoint offset by tester" VALUE 0x00f62 _REC_VAL_20_u1 1. _CNV_A_R_LINEAR_____1_CM 0. 1. DISPLAY_IDENTIFIER LC_N_OFS_KWP_DISABLE FORMAT "%2.0" /end CHARACTERISTIC
/begin CHARACTERISTIC c_cha_cdn_bat_kwp_min "minimum threshold for active battery charging due to enable conditions of idle speed offset by tester" VALUE 0x00606 _REC_VAL_20_u1 127. _CNV_A_R_LINEAR_____375_CM 0. 127. DISPLAY_IDENTIFIER C_CHA_CDN_BAT_KWP_MIN FORMAT "%5.1" /end CHARACTERISTIC
/begin CHARACTERISTIC c_n_ofs_acc_dri_max "idle speed setpoint offset maximum threshold at LV_ACIN = 1 and LV_DRI = 1" VALUE 0x00391 _REC_VAL_20_s1 510. _CNV_A_R_LINEAR_____374_CM -256. 254. DISPLAY_IDENTIFIER C_N_OFS_ACC_DRI_MAX FORMAT "%4.0" /end CHARACTERISTIC
/begin MEASUREMENT lv_kwp_ena "logical variable for idle speed setpoint offset by tester enabled" UBYTE _CNV_S_2_RANGE______0_CM 1 100. 0. 1. DISPLAY_IDENTIFIER LV_KWP_ENA ECU_ADDRESS 0x3fe75c /end MEASUREMENT
/begin MEASUREMENT n_sp_ofs_kwp "idle speed setpoint offset by tester" SBYTE _CNV_A_R_LINEAR_____374_CM 1 100. -256. 254. DISPLAY_IDENTIFIER N_SP_OFS_KWP ECU_ADDRESS 0x3fe75b FORMAT "%4.0" /end MEASUREMENT
/begin MEASUREMENT n_kwp_ofs_acc_dri "idle speed setpoint offset at LV_ACIN = 1 and LV_DRI = 1" SBYTE _CNV_A_R_LINEAR_____374_CM 1 100. -256. 254. DISPLAY_IDENTIFIER N_KWP_OFS_ACC_DRI ECU_ADDRESS 0x3fe756 FORMAT "%4.0" /end MEASUREMENT
/begin MEASUREMENT n_kwp_ofs_dri "idle speed setpoint offset at LV_ACIN = 0 and LV_DRI = 1" SBYTE _CNV_A_R_LINEAR_____374_CM 1 100. -256. 254. DISPLAY_IDENTIFIER N_KWP_OFS_DRI ECU_ADDRESS 0x3fe757 FORMAT "%4.0" /end MEASUREMENT
/begin MEASUREMENT n_kwp_ofs_vb "idle speed setpoint offset at battery charging is active" SBYTE _CNV_A_R_LINEAR_____374_CM 1 100. -256. 254. DISPLAY_IDENTIFIER N_KWP_OFS_VB ECU_ADDRESS 0x3fe75a FORMAT "%4.0" /end MEASUREMENT
/begin MEASUREMENT state_sav_diag "status of secondary air monitoring" ULONG _CNV_S_8_RANGE_STAT_382_CM 1 100. 0. 7. DISPLAY_IDENTIFIER STATE_SAV_DIAG ECU_ADDRESS 0x3fcc6c BYTE_ORDER MSB_LAST /end MEASUREMENT
/begin CHARACTERISTIC lc_ad_clr_knk "Logical constant for initializing KNK nvmy data" VALUE 0x00eea _REC_VAL_20_u1 1. _CNV_A_R_LINEAR_____1_CM 0. 1. DISPLAY_IDENTIFIER LC_AD_CLR_KNK FORMAT "%2.0" /end CHARACTERISTIC
/begin CHARACTERISTIC lc_ad_clr_lam "Logical constant for initializing LAMBDA nvmy data" VALUE 0x00eeb _REC_VAL_20_u1 1. _CNV_A_R_LINEAR_____1_CM 0. 1. DISPLAY_IDENTIFIER LC_AD_CLR_LAM FORMAT "%2.0" /end CHARACTERISTIC
/begin CHARACTERISTIC lc_ad_clr_tco "Logical constant for initializing TCO nvmy data" VALUE 0x00ef5 _REC_VAL_20_u1 1. _CNV_A_R_LINEAR_____1_CM 0. 1. DISPLAY_IDENTIFIER LC_AD_CLR_TCO FORMAT "%2.0" /end CHARACTERISTIC
/begin CHARACTERISTIC lc_ad_clr_tps "Logical constant for initializing TPS nvmy data" VALUE 0x00ef9 _REC_VAL_20_u1 1. _CNV_A_R_LINEAR_____1_CM 0. 1. DISPLAY_IDENTIFIER LC_AD_CLR_TPS FORMAT "%2.0" /end CHARACTERISTIC
/begin CHARACTERISTIC lc_ad_clr_mis "Logical constant for initializing MISFIRE nvmy data" VALUE 0x00eed _REC_VAL_20_u1 1. _CNV_A_R_LINEAR_____1_CM 0. 1. DISPLAY_IDENTIFIER LC_AD_CLR_MIS FORMAT "%2.0" /end CHARACTERISTIC
/begin CHARACTERISTIC lc_ad_clr_ivvt "Logical constant for initializing IVVT nvmy data" VALUE 0x00ee9 _REC_VAL_20_u1 1. _CNV_A_R_LINEAR_____1_CM 0. 1. DISPLAY_IDENTIFIER LC_AD_CLR_IVVT FORMAT "%2.0" /end CHARACTERISTIC
/begin CHARACTERISTIC lc_ad_clr_imm "Logical constant for initializing IMM nvmy data" VALUE 0x00ee8 _REC_VAL_20_u1 1. _CNV_A_R_LINEAR_____1_CM 0. 1. DISPLAY_IDENTIFIER LC_AD_CLR_IMM FORMAT "%2.0" /end CHARACTERISTIC
/begin CHARACTERISTIC lc_ad_clr_idle "Logical constant for initializing IDLE nvmy data" VALUE 0x00ee7 _REC_VAL_20_u1 1. _CNV_A_R_LINEAR_____1_CM 0. 1. DISPLAY_IDENTIFIER LC_AD_CLR_IDLE FORMAT "%2.0" /end CHARACTERISTIC
/begin CHARACTERISTIC lc_ad_clr_ati "Logical constant for initializing ATI nvmy data" VALUE 0x00ee2 _REC_VAL_20_u1 1. _CNV_A_R_LINEAR_____1_CM 0. 1. DISPLAY_IDENTIFIER LC_AD_CLR_ATI FORMAT "%2.0" /end CHARACTERISTIC
/begin CHARACTERISTIC lc_ad_clr_toil "Logical constant for initializing TOIL nvmy data" VALUE 0x00ef8 _REC_VAL_20_u1 1. _CNV_A_R_LINEAR_____1_CM 0. 1. DISPLAY_IDENTIFIER LC_AD_CLR_TOIL FORMAT "%2.0" /end CHARACTERISTIC
/begin CHARACTERISTIC lc_ad_clr_ecf "Logical constant for initializing ECF nvmy data" VALUE 0x00ee6 _REC_VAL_20_u1 1. _CNV_A_R_LINEAR_____1_CM 0. 1. DISPLAY_IDENTIFIER LC_AD_CLR_ECF FORMAT "%2.0" /end CHARACTERISTIC
/begin CHARACTERISTIC lc_ad_clr_sa "Logical constant for initializing SA nvmy data" VALUE 0x00ef3 _REC_VAL_20_u1 1. _CNV_A_R_LINEAR_____1_CM 0. 1. DISPLAY_IDENTIFIER LC_AD_CLR_SA FORMAT "%2.0" /end CHARACTERISTIC
/begin CHARACTERISTIC lc_ad_clr_n_sp_is "Logical constant for initializing N_SP_IS nvmy data" VALUE 0x00eef _REC_VAL_20_u1 1. _CNV_A_R_LINEAR_____1_CM 0. 1. DISPLAY_IDENTIFIER LC_AD_CLR_N_SP_IS FORMAT "%2.0" /end CHARACTERISTIC
/begin CHARACTERISTIC lc_ad_clr_ron "Logical constant for initializing RON nvmy data" VALUE 0x00ef2 _REC_VAL_20_u1 1. _CNV_A_R_LINEAR_____1_CM 0. 1. DISPLAY_IDENTIFIER LC_AD_CLR_RON FORMAT "%2.0" /end CHARACTERISTIC
/begin CHARACTERISTIC lc_ad_clr_tecu "Logical constant for initializing TECU nvmy data" VALUE 0x00ef6 _REC_VAL_20_u1 1. _CNV_A_R_LINEAR_____1_CM 0. 1. DISPLAY_IDENTIFIER LC_AD_CLR_TECU FORMAT "%2.0" /end CHARACTERISTIC
/begin CHARACTERISTIC lc_ad_clr_var "Logical constant for initializing VAR nvmy data" VALUE 0x00efb _REC_VAL_20_u1 1. _CNV_A_R_LINEAR_____1_CM 0. 1. DISPLAY_IDENTIFIER LC_AD_CLR_VAR FORMAT "%2.0" /end CHARACTERISTIC
/begin CHARACTERISTIC lc_ad_clr_dmtl "Logical constant for initializing DMTL nvmy data" VALUE 0x00ee5 _REC_VAL_20_u1 1. _CNV_A_R_LINEAR_____1_CM 0. 1. DISPLAY_IDENTIFIER LC_AD_CLR_DMTL FORMAT "%2.0" /end CHARACTERISTIC
/begin CHARACTERISTIC lc_ad_clr_sof "Logical constant for initializing the sound flap / sport switch" VALUE 0x00ef4 _REC_VAL_20_u1 1. _CNV_A_R_LINEAR_____1_CM 0. 1. DISPLAY_IDENTIFIER LC_AD_CLR_SOF FORMAT "%2.0" /end CHARACTERISTIC
/begin CHARACTERISTIC lc_ad_clr_n_max "Logical constant for initializing the N_MAX nvmy data" VALUE 0x00eee _REC_VAL_20_u1 1. _CNV_A_R_LINEAR_____1_CM 0. 1. DISPLAY_IDENTIFIER LC_AD_CLR_N_MAX FORMAT "%2.0" /end CHARACTERISTIC
/begin CHARACTERISTIC lc_ad_clr_lif "Logical constant for initializing LIF" VALUE 0x00eec _REC_VAL_20_u1 1. _CNV_A_R_LINEAR_____1_CM 0. 1. DISPLAY_IDENTIFIER LC_AD_CLR_LIF FORMAT "%2.0" /end CHARACTERISTIC
/begin CHARACTERISTIC lc_ad_clr_oz "Logical constant for initializing OZ" VALUE 0x00ef1 _REC_VAL_20_u1 1. _CNV_A_R_LINEAR_____1_CM 0. 1. DISPLAY_IDENTIFIER LC_AD_CLR_OZ FORMAT "%2.0" /end CHARACTERISTIC
/begin CHARACTERISTIC lc_ad_clr_tqi_lim "Logical constant for initializing TQI_LIM" VALUE 0x00efa _REC_VAL_20_u1 1. _CNV_A_R_LINEAR_____1_CM 0. 1. DISPLAY_IDENTIFIER LC_AD_CLR_TQI_LIM FORMAT "%2.0" /end CHARACTERISTIC
/begin CHARACTERISTIC lc_ad_clr_teg "Logical constant for initializing TEG" VALUE 0x00ef7 _REC_VAL_20_u1 1. _CNV_A_R_LINEAR_____1_CM 0. 1. DISPLAY_IDENTIFIER LC_AD_CLR_TEG FORMAT "%2.0" /end CHARACTERISTIC
/begin CHARACTERISTIC lc_ad_clr "Logical constant for initializing AD" VALUE 0x00ee1 _REC_VAL_20_u1 1. _CNV_A_R_LINEAR_____1_CM 0. 1. DISPLAY_IDENTIFIER LC_AD_CLR FORMAT "%2.0" /end CHARACTERISTIC
/begin CHARACTERISTIC lc_ad_clr_obd2 "Logical constant for initializing OBDII" VALUE 0x00ef0 _REC_VAL_20_u1 1. _CNV_A_R_LINEAR_____1_CM 0. 1. DISPLAY_IDENTIFIER LC_AD_CLR_OBD2 FORMAT "%2.0" /end CHARACTERISTIC
/begin CHARACTERISTIC lc_ad_clr_cru "Logical constant for initializing CRU" VALUE 0x00ee4 _REC_VAL_20_u1 1. _CNV_A_R_LINEAR_____1_CM 0. 1. DISPLAY_IDENTIFIER LC_AD_CLR_CRU FORMAT "%2.0" /end CHARACTERISTIC
/begin CHARACTERISTIC c_nvmy_inst_chk "Address of instance" VALUE 0x00799 _REC_VAL_20_u1 255. _CNV_A_R_LINEAR_____1_CM 0. 255. DISPLAY_IDENTIFIER C_NVMY_INST_CHK FORMAT "%3.0" /end CHARACTERISTIC
/begin MEASUREMENT lv_nvmy_rd_failed "Reading from NVMY failed due to TRL or CHK error" UBYTE _CNV_S_2_RANGE______5_CM 1 100. 0. 1. DISPLAY_IDENTIFIER LV_NVMY_RD_FAILED ECU_ADDRESS 0x3fe156 BIT_MASK 0x1 /end MEASUREMENT
/begin MEASUREMENT lv_nvmy_wr_failed "Writing to  NVMY failed due to TRL or CHK error" UBYTE _CNV_S_2_RANGE______0_CM 1 100. 0. 1. DISPLAY_IDENTIFIER LV_NVMY_WR_FAILED ECU_ADDRESS 0x3fe157 BIT_MASK 0x1 /end MEASUREMENT
/begin MEASUREMENT nvmy_e2p_address "Address of instance" UWORD _CNV_A_R_LINEAR_____1_CM 1 100. 0. 65535. DISPLAY_IDENTIFIER NVMY_E2P_ADDRESS ECU_ADDRESS 0x3fd33c BYTE_ORDER MSB_LAST FORMAT "%5.0" /end MEASUREMENT
/begin CHARACTERISTIC lc_ad_clr_can "Logical constant for initializing CAN nvmy data" VALUE 0x00ee3 _REC_VAL_20_u1 1. _CNV_A_R_LINEAR_____1_CM 0. 1. DISPLAY_IDENTIFIER LC_AD_CLR_CAN FORMAT "%2.0" /end CHARACTERISTIC
/begin MEASUREMENT lv_err_vs "Error currently present on vehicle speed signal" UBYTE _CNV_S_2_RANGE______2_R_CM 1 100. 0. 255. DISPLAY_IDENTIFIER LV_ERR_VS ECU_ADDRESS 0x3fb8bc /end MEASUREMENT
/begin MEASUREMENT lv_mtc_lih_act "LV limp home request main throttle" UBYTE _CNV_S_2_RANGE______0_CM 1 100. 0. 1. DISPLAY_IDENTIFIER LV_MTC_LIH_ACT ECU_ADDRESS 0x3fe0ba BIT_MASK 0x1 /end MEASUREMENT
/begin MEASUREMENT ti_ext_adj[0] "Injection Time" UBYTE _CNV_A_R_LINEAR_____444_CM 1 100. 0. 4.08 DISPLAY_IDENTIFIER TI_EXT_ADJ_1 ECU_ADDRESS 0x3fe7ec FORMAT "%4.2" /end MEASUREMENT
/begin MEASUREMENT ti_ext_adj[1] "Injection Time" UBYTE _CNV_A_R_LINEAR_____444_CM 1 100. 0. 4.08 DISPLAY_IDENTIFIER TI_EXT_ADJ_2 ECU_ADDRESS 0x3fe7ed FORMAT "%4.2" /end MEASUREMENT
/begin MEASUREMENT ti_ext_adj[2] "Injection Time" UBYTE _CNV_A_R_LINEAR_____444_CM 1 100. 0. 4.08 DISPLAY_IDENTIFIER TI_EXT_ADJ_3 ECU_ADDRESS 0x3fe7ee FORMAT "%4.2" /end MEASUREMENT
/begin MEASUREMENT ti_ext_adj[3] "Injection Time" UBYTE _CNV_A_R_LINEAR_____444_CM 1 100. 0. 4.08 DISPLAY_IDENTIFIER TI_EXT_ADJ_4 ECU_ADDRESS 0x3fe7ef FORMAT "%4.2" /end MEASUREMENT
/begin MEASUREMENT ti_ext_adj[4] "Injection Time" UBYTE _CNV_A_R_LINEAR_____444_CM 1 100. 0. 4.08 DISPLAY_IDENTIFIER TI_EXT_ADJ_5 ECU_ADDRESS 0x3fe7f0 FORMAT "%4.2" /end MEASUREMENT
/begin MEASUREMENT ti_ext_adj[5] "Injection Time" UBYTE _CNV_A_R_LINEAR_____444_CM 1 100. 0. 4.08 DISPLAY_IDENTIFIER TI_EXT_ADJ_6 ECU_ADDRESS 0x3fe7f1 FORMAT "%4.2" /end MEASUREMENT
/begin MEASUREMENT ti_per_ext_adj[0] "Injection Time Period" UBYTE _CNV_A_R_LINEAR_____31_CM 1 100. 0. 2550. DISPLAY_IDENTIFIER TI_PER_EXT_ADJ_1 ECU_ADDRESS 0x3fe7f4 FORMAT "%4.0" /end MEASUREMENT
/begin MEASUREMENT ti_per_ext_adj[1] "Injection Time Period" UBYTE _CNV_A_R_LINEAR_____31_CM 1 100. 0. 2550. DISPLAY_IDENTIFIER TI_PER_EXT_ADJ_2 ECU_ADDRESS 0x3fe7f5 FORMAT "%4.0" /end MEASUREMENT
/begin MEASUREMENT ti_per_ext_adj[2] "Injection Time Period" UBYTE _CNV_A_R_LINEAR_____31_CM 1 100. 0. 2550. DISPLAY_IDENTIFIER TI_PER_EXT_ADJ_3 ECU_ADDRESS 0x3fe7f6 FORMAT "%4.0" /end MEASUREMENT
/begin MEASUREMENT ti_per_ext_adj[3] "Injection Time Period" UBYTE _CNV_A_R_LINEAR_____31_CM 1 100. 0. 2550. DISPLAY_IDENTIFIER TI_PER_EXT_ADJ_4 ECU_ADDRESS 0x3fe7f7 FORMAT "%4.0" /end MEASUREMENT
/begin MEASUREMENT ti_per_ext_adj[4] "Injection Time Period" UBYTE _CNV_A_R_LINEAR_____31_CM 1 100. 0. 2550. DISPLAY_IDENTIFIER TI_PER_EXT_ADJ_5 ECU_ADDRESS 0x3fe7f8 FORMAT "%4.0" /end MEASUREMENT
/begin MEASUREMENT ti_per_ext_adj[5] "Injection Time Period" UBYTE _CNV_A_R_LINEAR_____31_CM 1 100. 0. 2550. DISPLAY_IDENTIFIER TI_PER_EXT_ADJ_6 ECU_ADDRESS 0x3fe7f9 FORMAT "%4.0" /end MEASUREMENT
/begin MEASUREMENT lv_ti_ext_adj[0] "Flag to activate the injector test mode" UBYTE _CNV_S_2_RANGE______0_CM 1 100. 0. 1. DISPLAY_IDENTIFIER LV_TI_EXT_ADJ_1 ECU_ADDRESS 0x3fe7fc /end MEASUREMENT
/begin MEASUREMENT lv_ti_ext_adj[1] "Flag to activate the injector test mode" UBYTE _CNV_S_2_RANGE______0_CM 1 100. 0. 1. DISPLAY_IDENTIFIER LV_TI_EXT_ADJ_2 ECU_ADDRESS 0x3fe7fd /end MEASUREMENT
/begin MEASUREMENT lv_ti_ext_adj[2] "Flag to activate the injector test mode" UBYTE _CNV_S_2_RANGE______0_CM 1 100. 0. 1. DISPLAY_IDENTIFIER LV_TI_EXT_ADJ_3 ECU_ADDRESS 0x3fe7fe /end MEASUREMENT
/begin MEASUREMENT lv_ti_ext_adj[3] "Flag to activate the injector test mode" UBYTE _CNV_S_2_RANGE______0_CM 1 100. 0. 1. DISPLAY_IDENTIFIER LV_TI_EXT_ADJ_4 ECU_ADDRESS 0x3fe7ff /end MEASUREMENT
/begin MEASUREMENT lv_ti_ext_adj[4] "Flag to activate the injector test mode" UBYTE _CNV_S_2_RANGE______0_CM 1 100. 0. 1. DISPLAY_IDENTIFIER LV_TI_EXT_ADJ_5 ECU_ADDRESS 0x3fe800 /end MEASUREMENT
/begin MEASUREMENT lv_ti_ext_adj[5] "Flag to activate the injector test mode" UBYTE _CNV_S_2_RANGE______0_CM 1 100. 0. 1. DISPLAY_IDENTIFIER LV_TI_EXT_ADJ_6 ECU_ADDRESS 0x3fe801 /end MEASUREMENT
/begin CHARACTERISTIC c_ti_ext_adj_min "Minimum injection time to accept a external adjustment - equal for all cylinders" VALUE 0x008c5 _REC_VAL_20_u1 4.08 _CNV_A_R_LINEAR_____444_CM 0. 4.08 DISPLAY_IDENTIFIER C_TI_EXT_ADJ_MIN FORMAT "%4.2" /end CHARACTERISTIC
/begin CHARACTERISTIC c_ti_ext_adj_max "Maximum injection time to accept a external adjustment - equal for all cylinders" VALUE 0x008c4 _REC_VAL_20_u1 4.08 _CNV_A_R_LINEAR_____444_CM 0. 4.08 DISPLAY_IDENTIFIER C_TI_EXT_ADJ_MAX FORMAT "%4.2" /end CHARACTERISTIC
/begin CHARACTERISTIC c_ti_per_ext_adj_max "Maximum injection time period to accept a external adjustment - equal for all cylinders" VALUE 0x008c6 _REC_VAL_20_u1 2550. _CNV_A_R_LINEAR_____31_CM 0. 2550. DISPLAY_IDENTIFIER C_TI_PER_EXT_ADJ_MAX FORMAT "%4.0" /end CHARACTERISTIC
/begin CHARACTERISTIC c_ti_per_ext_adj_min "Minimum injection time period to accept a external adjustment - equal for all cylinders" VALUE 0x008c7 _REC_VAL_20_u1 2550. _CNV_A_R_LINEAR_____31_CM 0. 2550. DISPLAY_IDENTIFIER C_TI_PER_EXT_ADJ_MIN FORMAT "%4.0" /end CHARACTERISTIC
/begin CHARACTERISTIC c_n_dif_aj_ac_1 "Engine speed difference threshold for acitvation anti jerk function at acceleration - first wave trigger" VALUE 0x0043a _REC_VAL_20_s2 65535. _CNV_A_R_LINEAR_____11_CM -32768. 32767. DISPLAY_IDENTIFIER C_N_DIF_AJ_AC_1 FORMAT "%6.0" /end CHARACTERISTIC
/begin CHARACTERISTIC c_n_dif_aj_ac_2 "Engine speed difference threshold for acitvation anti jerk function at acceleration - second wave trigger" VALUE 0x0043c _REC_VAL_20_s2 65535. _CNV_A_R_LINEAR_____11_CM -32768. 32767. DISPLAY_IDENTIFIER C_N_DIF_AJ_AC_2 FORMAT "%6.0" /end CHARACTERISTIC
/begin CHARACTERISTIC c_n_dif_aj_deacc_1 "Engine speed difference threshold for acitvation anti jerk function at deacceleration - first wave trigger" VALUE 0x0043e _REC_VAL_20_s2 65535. _CNV_A_R_LINEAR_____11_CM -32768. 32767. DISPLAY_IDENTIFIER C_N_DIF_AJ_DEACC_1 FORMAT "%6.0" /end CHARACTERISTIC
/begin CHARACTERISTIC c_n_dif_aj_deacc_2 "Engine speed difference threshold for acitvation anti jerk function at deacceleration - second wave trigger" VALUE 0x00440 _REC_VAL_20_s2 65535. _CNV_A_R_LINEAR_____11_CM -32768. 32767. DISPLAY_IDENTIFIER C_N_DIF_AJ_DEACC_2 FORMAT "%6.0" /end CHARACTERISTIC
/begin CHARACTERISTIC c_n_thd_max_aj "Maximum engine speed threshold for anti jerk function" VALUE 0x01724 _REC_VAL_20_u2 8160. _CNV_A_R_LINEAR_____11_CM 0. 8160. DISPLAY_IDENTIFIER C_N_THD_MAX_AJ FORMAT "%4.0" /end CHARACTERISTIC
/begin CHARACTERISTIC c_n_thd_min_aj "Minimum engine speed threshold for anti jerk function" VALUE 0x01726 _REC_VAL_20_u2 8160. _CNV_A_R_LINEAR_____11_CM 0. 8160. DISPLAY_IDENTIFIER C_N_THD_MIN_AJ FORMAT "%4.0" /end CHARACTERISTIC
/begin CHARACTERISTIC c_t_act_max_aj "Maximum active time of anti jerk function after activation" VALUE 0x007d5 _REC_VAL_20_u1 25.5 _CNV_A_R_LINEAR_____24_CM 0. 25.5 DISPLAY_IDENTIFIER C_T_ACT_MAX_AJ FORMAT "%3.1" /end CHARACTERISTIC
/begin MEASUREMENT lv_pas_aj "LV anti-jerk function passive" UBYTE _CNV_S_2_RANGE______0_CM 1 100. 0. 1. DISPLAY_IDENTIFIER LV_PAS_AJ ECU_ADDRESS 0x3fe56c BIT_MASK 0x1 /end MEASUREMENT
/begin MEASUREMENT lv_req_aj "LV anti-jerk function requested" UBYTE _CNV_S_2_RANGE______0_CM 1 100. 0. 1. DISPLAY_IDENTIFIER LV_REQ_AJ ECU_ADDRESS 0x3fe56b BIT_MASK 0x1 /end MEASUREMENT
/begin CHARACTERISTIC lc_aj_inh_at "Logical constant for anti jerk function to inhibit the AT influence on the activation conditions" VALUE 0x00efe _REC_VAL_20_u1 1. _CNV_A_R_LINEAR_____1_CM 0. 1. DISPLAY_IDENTIFIER LC_AJ_INH_AT FORMAT "%2.0" /end CHARACTERISTIC
/begin CHARACTERISTIC lc_aj_deacc "Logical constant for AJ trigger at deacceleration" VALUE 0x00efd _REC_VAL_20_u1 1. _CNV_A_R_LINEAR_____22_CM 0. 1. DISPLAY_IDENTIFIER LC_AJ_DEACC FORMAT "%1.0" /end CHARACTERISTIC
/begin MEASUREMENT lv_ini_aj "LV initialisation anti jerk controller requested" UBYTE _CNV_S_2_RANGE______0_CM 1 100. 0. 1. DISPLAY_IDENTIFIER LV_INI_AJ ECU_ADDRESS 0x3fe566 BIT_MASK 0x1 /end MEASUREMENT
/begin CHARACTERISTIC lc_aj_ac "Logical constant for AJ trigger at acceleration" VALUE 0x00efc _REC_VAL_20_u1 1. _CNV_A_R_LINEAR_____22_CM 0. 1. DISPLAY_IDENTIFIER LC_AJ_AC FORMAT "%1.0" /end CHARACTERISTIC
/begin MEASUREMENT lv_act_aj "LV anti-jerk function active" UBYTE _CNV_S_2_RANGE______0_CM 1 100. 0. 1. DISPLAY_IDENTIFIER LV_ACT_AJ ECU_ADDRESS 0x3fe565 BIT_MASK 0x1 /end MEASUREMENT
/begin MEASUREMENT state_cc_aj "Status of allowed or not allowed AJ (CC)" UBYTE _CNV_S_2_RANGE______0_CM 1 100. 0. 1. DISPLAY_IDENTIFIER STATE_CC_AJ ECU_ADDRESS 0x3fe569 BIT_MASK 0x1 /end MEASUREMENT
/begin MEASUREMENT state_clu_amt_aj "Status of allowed or not allowed AJ (AMT)" UBYTE _CNV_S_2_RANGE______0_CM 1 100. 0. 1. DISPLAY_IDENTIFIER STATE_CLU_AMT_AJ ECU_ADDRESS 0x3fe56a BIT_MASK 0x1 /end MEASUREMENT
/begin CHARACTERISTIC lc_aj_inh_dt "Logical constant for anti jerk function to inhibit theDT influence on the activation conditions" VALUE 0x00eff _REC_VAL_20_u1 1. _CNV_A_R_LINEAR_____1_CM 0. 1. DISPLAY_IDENTIFIER LC_AJ_INH_DT FORMAT "%2.0" /end CHARACTERISTIC
/begin CHARACTERISTIC lc_state_cc_open "Logical constant for AJ allowed or not at CC open" VALUE 0x00f73 _REC_VAL_20_u1 1. _CNV_A_R_LINEAR_____1_CM 0. 1. DISPLAY_IDENTIFIER LC_STATE_CC_OPEN FORMAT "%2.0" /end CHARACTERISTIC
/begin CHARACTERISTIC lc_state_cc_controlled "Logical constant for AJ allowed or not at CC controlled" VALUE 0x00f71 _REC_VAL_20_u1 1. _CNV_A_R_LINEAR_____1_CM 0. 1. DISPLAY_IDENTIFIER LC_STATE_CC_CONTROLLED FORMAT "%2.0" /end CHARACTERISTIC
/begin CHARACTERISTIC lc_state_cc_dft "Logical constant for AJ allowed or not at CC status not defined" VALUE 0x00f72 _REC_VAL_20_u1 1. _CNV_A_R_LINEAR_____1_CM 0. 1. DISPLAY_IDENTIFIER LC_STATE_CC_DFT FORMAT "%2.0" /end CHARACTERISTIC
/begin CHARACTERISTIC lc_state_cc_close "Logical constant for AJ allowed or not at CC closed" VALUE 0x00f70 _REC_VAL_20_u1 1. _CNV_A_R_LINEAR_____1_CM 0. 1. DISPLAY_IDENTIFIER LC_STATE_CC_CLOSE FORMAT "%2.0" /end CHARACTERISTIC
/begin CHARACTERISTIC lc_state_clu_amt_open "Logical constant for AJ allowed or not at STATE_CLU_AMT open" VALUE 0x00f78 _REC_VAL_20_u1 1. _CNV_A_R_LINEAR_____1_CM 0. 1. DISPLAY_IDENTIFIER LC_STATE_CLU_AMT_OPEN FORMAT "%2.0" /end CHARACTERISTIC
/begin CHARACTERISTIC lc_state_clu_amt_creeping "Logical constant for AJ allowed or not at STATE_CLU_AMT creeping" VALUE 0x00f75 _REC_VAL_20_u1 1. _CNV_A_R_LINEAR_____1_CM 0. 1. DISPLAY_IDENTIFIER LC_STATE_CLU_AMT_CREEPING FORMAT "%2.0" /end CHARACTERISTIC
/begin CHARACTERISTIC lc_state_clu_amt_drive_off "Logical constant for AJ allowed or not at STATE_CLU_AMT drive off" VALUE 0x00f77 _REC_VAL_20_u1 1. _CNV_A_R_LINEAR_____1_CM 0. 1. DISPLAY_IDENTIFIER LC_STATE_CLU_AMT_DRIVE_OFF FORMAT "%2.0" /end CHARACTERISTIC
/begin CHARACTERISTIC lc_state_clu_amt_closed "Logical constant for AJ allowed or not at STATE_CLU_AMT closed" VALUE 0x00f74 _REC_VAL_20_u1 1. _CNV_A_R_LINEAR_____1_CM 0. 1. DISPLAY_IDENTIFIER LC_STATE_CLU_AMT_CLOSED FORMAT "%2.0" /end CHARACTERISTIC
/begin CHARACTERISTIC lc_state_clu_amt_dft "Logical constant for AJ allowed or not at STATE_CLU_AMT default" VALUE 0x00f76 _REC_VAL_20_u1 1. _CNV_A_R_LINEAR_____1_CM 0. 1. DISPLAY_IDENTIFIER LC_STATE_CLU_AMT_DFT FORMAT "%2.0" /end CHARACTERISTIC
/begin MEASUREMENT lv_amt_disable "logical variable for disabling AMT intervention due to EMS error" UBYTE _CNV_S_2_RANGE______5_CM 1 100. 0. 1. DISPLAY_IDENTIFIER LV_AMT_DISABLE ECU_ADDRESS 0x3fe5a2 /end MEASUREMENT
/begin MEASUREMENT lv_amt_disable_can "logical variable for disabling GS intervention due to CAN error" UBYTE _CNV_S_2_RANGE______5_CM 1 100. 0. 1. DISPLAY_IDENTIFIER LV_AMT_DISABLE_CAN ECU_ADDRESS 0x3fe5a3 /end MEASUREMENT
/begin MEASUREMENT lv_amt_ena_dec "logical variable for decreased torque intervention due to gear shift" UBYTE _CNV_S_2_RANGE______5_CM 1 100. 0. 1. DISPLAY_IDENTIFIER LV_AMT_ENA_DEC ECU_ADDRESS 0x3fe5a4 /end MEASUREMENT
/begin MEASUREMENT lv_amt_ena_inc "logical variable for increased torque intervention due to gear shift" UBYTE _CNV_S_2_RANGE______5_CM 1 100. 0. 1. DISPLAY_IDENTIFIER LV_AMT_ENA_INC ECU_ADDRESS 0x3fe5a5 /end MEASUREMENT
/begin MEASUREMENT lv_amt_ena "logical variable for gear shift intervention enabling" UBYTE _CNV_S_2_RANGE______5_CM 1 100. 0. 1. DISPLAY_IDENTIFIER LV_AMT_ENA ECU_ADDRESS 0x3fe5ab /end MEASUREMENT
/begin MEASUREMENT tqi_amt_fast_dec_req "torque decrement for fast torque intervention during gear shift" SWORD _CNV_A_R_LINEAR_____55_CM 1 100. -1024. 1023.96875 DISPLAY_IDENTIFIER TQI_AMT_FAST_DEC_REQ ECU_ADDRESS 0x3fd998 BYTE_ORDER MSB_LAST FORMAT "%8.2" /end MEASUREMENT
/begin MEASUREMENT tqi_amt_fast_dec_req_1 "Torque decrement for fast torque intervention during gear shift" SWORD _CNV_A_R_LINEAR_____55_CM 1 100. -1024. 1023.96875 DISPLAY_IDENTIFIER TQI_AMT_FAST_DEC_REQ_1 ECU_ADDRESS 0x3fd9a0 BYTE_ORDER MSB_LAST FORMAT "%8.2" /end MEASUREMENT
/begin MEASUREMENT tqi_amt_slow_dec_req "torque decrement for slow torque intervention during gear shift" SWORD _CNV_A_R_LINEAR_____55_CM 1 100. -1024. 1023.96875 DISPLAY_IDENTIFIER TQI_AMT_SLOW_DEC_REQ ECU_ADDRESS 0x3fd99a BYTE_ORDER MSB_LAST FORMAT "%8.2" /end MEASUREMENT
/begin MEASUREMENT tqi_amt_slow_dec_req_1 "torque decrement for slow torque intervention during gear shift" SWORD _CNV_A_R_LINEAR_____55_CM 1 100. -1024. 1023.96875 DISPLAY_IDENTIFIER TQI_AMT_SLOW_DEC_REQ_1 ECU_ADDRESS 0x3fd9a2 BYTE_ORDER MSB_LAST FORMAT "%8.2" /end MEASUREMENT
/begin MEASUREMENT tqi_amt_fast_inc_req "torque increase for fast torque intervention during gear shift" SWORD _CNV_A_R_LINEAR_____55_CM 1 100. -1024. 1023.96875 DISPLAY_IDENTIFIER TQI_AMT_FAST_INC_REQ ECU_ADDRESS 0x3fd99c BYTE_ORDER MSB_LAST FORMAT "%8.2" /end MEASUREMENT
/begin MEASUREMENT tqi_amt_fast_inc_req_1 "Torque increase for fast torque intervention during gear shift" SWORD _CNV_A_R_LINEAR_____55_CM 1 100. -1024. 1023.96875 DISPLAY_IDENTIFIER TQI_AMT_FAST_INC_REQ_1 ECU_ADDRESS 0x3fd9a4 BYTE_ORDER MSB_LAST FORMAT "%8.2" /end MEASUREMENT
/begin MEASUREMENT tqi_amt_slow_inc_req "torque increase for slow torque intervention during gear shift" SWORD _CNV_A_R_LINEAR_____55_CM 1 100. -1024. 1023.96875 DISPLAY_IDENTIFIER TQI_AMT_SLOW_INC_REQ ECU_ADDRESS 0x3fd99e BYTE_ORDER MSB_LAST FORMAT "%8.2" /end MEASUREMENT
/begin MEASUREMENT tqi_amt_slow_inc_req_1 "Torque increase for slow torque intervention during gear shift" SWORD _CNV_A_R_LINEAR_____55_CM 1 100. -1024. 1023.96875 DISPLAY_IDENTIFIER TQI_AMT_SLOW_INC_REQ_1 ECU_ADDRESS 0x3fd9a6 BYTE_ORDER MSB_LAST FORMAT "%8.2" /end MEASUREMENT
/begin MEASUREMENT tqi_amt_fast_dec "torque decrement for fast torque intervention during gear shift" SWORD _CNV_A_R_LINEAR_____55_CM 1 100. -1024. 1023.96875 DISPLAY_IDENTIFIER TQI_AMT_FAST_DEC ECU_ADDRESS 0x3fd9a8 BYTE_ORDER MSB_LAST FORMAT "%8.2" /end MEASUREMENT
/begin MEASUREMENT tqi_amt_slow_dec "torque decrement for slow torque intervention during gear shift" SWORD _CNV_A_R_LINEAR_____55_CM 1 100. -1024. 1023.96875 DISPLAY_IDENTIFIER TQI_AMT_SLOW_DEC ECU_ADDRESS 0x3fd9aa BYTE_ORDER MSB_LAST FORMAT "%8.2" /end MEASUREMENT
/begin MEASUREMENT lv_amt_dec_act "logical variable for torque intervention due to gear shift" UBYTE _CNV_S_2_RANGE______0_CM 1 100. 0. 1. DISPLAY_IDENTIFIER LV_AMT_DEC_ACT ECU_ADDRESS 0x3fe5a6 /end MEASUREMENT
/begin MEASUREMENT tqi_amt_fast_inc "torque increase for fast torque intervention during gear shift" SWORD _CNV_A_R_LINEAR_____55_CM 1 100. -1024. 1023.96875 DISPLAY_IDENTIFIER TQI_AMT_FAST_INC ECU_ADDRESS 0x3fd9ac BYTE_ORDER MSB_LAST FORMAT "%8.2" /end MEASUREMENT
/begin MEASUREMENT tqi_amt_slow_inc "torque increase for slow torque intervention during gear shift" SWORD _CNV_A_R_LINEAR_____55_CM 1 100. -1024. 1023.96875 DISPLAY_IDENTIFIER TQI_AMT_SLOW_INC ECU_ADDRESS 0x3fd9ae BYTE_ORDER MSB_LAST FORMAT "%8.2" /end MEASUREMENT
/begin MEASUREMENT lv_amt_dec_lih "logical variable for torque intervention LIH due to gear shift" UBYTE _CNV_S_2_RANGE______0_CM 1 100. 0. 1. DISPLAY_IDENTIFIER LV_AMT_DEC_LIH ECU_ADDRESS 0x3fe5ac /end MEASUREMENT
/begin MEASUREMENT lv_amt_inc_act "logical variable for torque intervention due to gear shift" UBYTE _CNV_S_2_RANGE______0_CM 1 100. 0. 1. DISPLAY_IDENTIFIER LV_AMT_INC_ACT ECU_ADDRESS 0x3fe5a7 /end MEASUREMENT
/begin MEASUREMENT lv_amt_inc_lih "logical variable for torque intervention LIH due to gear shift" UBYTE _CNV_S_2_RANGE______0_CM 1 100. 0. 1. DISPLAY_IDENTIFIER LV_AMT_INC_LIH ECU_ADDRESS 0x3fe5a8 /end MEASUREMENT
/begin CHARACTERISTIC c_lgrd_lih_amt_dec "limiting gradient for AMT emergency ramp function (default  0.6 Nm/10ms)" VALUE 0x01628 _REC_VAL_20_u2 1023.96875 _CNV_A_R_LINEAR_____202_CM 0. 1023.96875 DISPLAY_IDENTIFIER C_LGRD_LIH_AMT_DEC FORMAT "%7.2" /end CHARACTERISTIC
/begin CHARACTERISTIC c_lgrd_lih_amt_inc "limiting gradient for AMT emergency ramp function (default  0.6 Nm/10ms)" VALUE 0x0162a _REC_VAL_20_u2 1023.96875 _CNV_A_R_LINEAR_____202_CM 0. 1023.96875 DISPLAY_IDENTIFIER C_LGRD_LIH_AMT_INC FORMAT "%7.2" /end CHARACTERISTIC
/begin CHARACTERISTIC c_t_dly_lih_amt_dec "delay time for activation of AMT emergency ramp function (default 0s)" VALUE 0x007f9 _REC_VAL_20_u1 2.55 _CNV_A_R_LINEAR_____4_CM 0. 2.55 DISPLAY_IDENTIFIER C_T_DLY_LIH_AMT_DEC FORMAT "%4.2" /end CHARACTERISTIC
/begin CHARACTERISTIC c_t_dly_lih_amt_inc "delay time for activation of AMT emergency ramp function (default 0s)" VALUE 0x007fa _REC_VAL_20_u1 2.55 _CNV_A_R_LINEAR_____4_CM 0. 2.55 DISPLAY_IDENTIFIER C_T_DLY_LIH_AMT_INC FORMAT "%4.2" /end CHARACTERISTIC
/begin CHARACTERISTIC c_amt_ena_inc_dec "Enable switch AMT intervention" VALUE 0x005e2 _REC_VAL_20_u1 3. _CNV_S_4_STATE_AMT__201_CM 0. 3. DISPLAY_IDENTIFIER C_AMT_ENA_INC_DEC /end CHARACTERISTIC
/begin MEASUREMENT lv_ars_disable "logical variable for disabling ARS intervention due to EMS error" UBYTE _CNV_S_2_RANGE______0_CM 1 100. 0. 1. DISPLAY_IDENTIFIER LV_ARS_DISABLE ECU_ADDRESS 0x3fe59e /end MEASUREMENT
/begin MEASUREMENT lv_ars_disable_can "logical variable for disabling ARS intervention due to CAN error" UBYTE _CNV_S_2_RANGE______0_CM 1 100. 0. 1. DISPLAY_IDENTIFIER LV_ARS_DISABLE_CAN ECU_ADDRESS 0x3fe59f /end MEASUREMENT
/begin MEASUREMENT lv_ars_ena "logical variable for ASR intervention enabling" UBYTE _CNV_S_2_RANGE______0_CM 1 100. 0. 1. DISPLAY_IDENTIFIER LV_ARS_ENA ECU_ADDRESS 0x3fe5a0 /end MEASUREMENT
/begin MEASUREMENT lv_tq_max_ars "logical variable indicating maximum torque request - ARS" UBYTE _CNV_S_2_RANGE______0_CM 1 100. 0. 1. DISPLAY_IDENTIFIER LV_TQ_MAX_ARS ECU_ADDRESS 0x3fe5a1 /end MEASUREMENT
/begin MEASUREMENT tq_loss_ars_sp_max "ARS target torque loss - maximum (considering offset)" SWORD _CNV_A_R_LINEAR_____55_CM 1 100. -1024. 1023.96875 DISPLAY_IDENTIFIER TQ_LOSS_ARS_SP_MAX ECU_ADDRESS 0x3fd98a BYTE_ORDER MSB_LAST FORMAT "%8.2" /end MEASUREMENT
/begin MEASUREMENT tq_loss_ars_sp_max_1 "ARS target torque loss - maximum" SWORD _CNV_A_R_LINEAR_____55_CM 1 100. -1024. 1023.96875 DISPLAY_IDENTIFIER TQ_LOSS_ARS_SP_MAX_1 ECU_ADDRESS 0x3fd988 BYTE_ORDER MSB_LAST FORMAT "%8.2" /end MEASUREMENT
/begin MEASUREMENT tq_loss_ars_av_max_1 "ARS actual value of torque loss - maximum" SWORD _CNV_A_R_LINEAR_____55_CM 1 100. -1024. 1023.96875 DISPLAY_IDENTIFIER TQ_LOSS_ARS_AV_MAX_1 ECU_ADDRESS 0x3fd98c BYTE_ORDER MSB_LAST FORMAT "%8.2" /end MEASUREMENT
/begin MEASUREMENT t_dly_tq_max_ars "Delay time for activation of LV_TQ_MAX_ARS" UWORD _CNV_A_R_LINEAR_____4_CM 1 100. 0. 655.35 DISPLAY_IDENTIFIER T_DLY_TQ_MAX_ARS ECU_ADDRESS 0x3fd986 BYTE_ORDER MSB_LAST FORMAT "%6.2" /end MEASUREMENT
/begin MEASUREMENT tq_loss_ars "torque loss ARS for torque loss calculation" SWORD _CNV_A_R_LINEAR_____55_CM 1 100. -1024. 1023.96875 DISPLAY_IDENTIFIER TQ_LOSS_ARS ECU_ADDRESS 0x3fd990 BYTE_ORDER MSB_LAST FORMAT "%8.2" /end MEASUREMENT
/begin MEASUREMENT tq_loss_ars_av_max "ARS actual value of torque loss - maximum (considering offset)" SWORD _CNV_A_R_LINEAR_____55_CM 1 100. -1024. 1023.96875 DISPLAY_IDENTIFIER TQ_LOSS_ARS_AV_MAX ECU_ADDRESS 0x3fd98e BYTE_ORDER MSB_LAST FORMAT "%8.2" /end MEASUREMENT
/begin MEASUREMENT tq_loss_ars_grd "Torque loss gradient - ARS" SWORD _CNV_A_R_LINEAR_____55_CM 1 100. -1024. 1023.96875 DISPLAY_IDENTIFIER TQ_LOSS_ARS_GRD ECU_ADDRESS 0x3fd994 BYTE_ORDER MSB_LAST FORMAT "%8.2" /end MEASUREMENT
/begin MEASUREMENT tq_loss_ars_dif "Difference torque loss TQ_LOSS_ARS_SP_CAN - TQ_LOSS_ARS_AV_CAN" SWORD _CNV_A_R_LINEAR_____55_CM 1 100. -1024. 1023.96875 DISPLAY_IDENTIFIER TQ_LOSS_ARS_DIF ECU_ADDRESS 0x3fd996 BYTE_ORDER MSB_LAST FORMAT "%8.2" /end MEASUREMENT
/begin CHARACTERISTIC ip_tq_loss_ars_sp_max "ARS target torque loss - maximum" MAP 0x0fe3a _REC_MAP_20_u2_u2_u2 2047.96875 _CNV_A_R_LINEAR_____186_CM -1024. 1023.96875 DISPLAY_IDENTIFIER IP_TQ_LOSS_ARS_SP_MAX FORMAT "%6.2"
 /begin AXIS_DESCR COM_AXIS ac_veh_trv_tcs _CNV_A_R_LINEAR_____103_CM 8 -51.175 51.175 FORMAT "%7.4" AXIS_PTS_REF ldpm_ac_veh_trv_tcs /end AXIS_DESCR
 /begin AXIS_DESCR COM_AXIS vs_fil _CNV_A_R_LINEAR_____85_CM 8 0. 511.99218 FORMAT "%7.3" AXIS_PTS_REF ldpm_vs_fil /end AXIS_DESCR
/end CHARACTERISTIC
/begin CHARACTERISTIC ip_tq_loss_ars_av_max "ARS Actual value of torque loss - maximum" MAP 0x0fd3a _REC_MAP_20_u2_u2_u2 2047.96875 _CNV_A_R_LINEAR_____186_CM -1024. 1023.96875 DISPLAY_IDENTIFIER IP_TQ_LOSS_ARS_AV_MAX FORMAT "%6.2"
 /begin AXIS_DESCR COM_AXIS ac_veh_trv_tcs _CNV_A_R_LINEAR_____103_CM 8 -51.175 51.175 FORMAT "%7.4" AXIS_PTS_REF ldpm_ac_veh_trv_tcs /end AXIS_DESCR
 /begin AXIS_DESCR COM_AXIS vs_fil _CNV_A_R_LINEAR_____85_CM 8 0. 511.99218 FORMAT "%7.3" AXIS_PTS_REF ldpm_vs_fil /end AXIS_DESCR
/end CHARACTERISTIC
/begin CHARACTERISTIC ip_tq_loss_ars_sp_can_max "ARS torque loss depending on torque loss (SP) via CAN and engine speed" MAP 0x0fdba _REC_MAP_20_u2_u2_u1 2047.96875 _CNV_A_R_LINEAR_____186_CM -1024. 1023.96875 DISPLAY_IDENTIFIER IP_TQ_LOSS_ARS_SP_CAN_MAX FORMAT "%6.2"
 /begin AXIS_DESCR COM_AXIS tq_loss_ars_sp_can _CNV_A_R_LINEAR_____186_CM 8 -1024. 1023.96875 FORMAT "%6.2" AXIS_PTS_REF ldp_tq_loss_ars_sp_can_max /end AXIS_DESCR
 /begin AXIS_DESCR COM_AXIS n_32 _CNV_A_R_LINEAR_____16_CM 8 0. 8160. FORMAT "%4.0" AXIS_PTS_REF ldpm_n_32__tq_loss_ars /end AXIS_DESCR
/end CHARACTERISTIC
/begin CHARACTERISTIC ip_tq_loss_ars_av_can_max "ARS torque loss depending on torque loss (AV) via CAN and engine speed" MAP 0x0fcba _REC_MAP_20_u2_u2_u1 2047.96875 _CNV_A_R_LINEAR_____186_CM -1024. 1023.96875 DISPLAY_IDENTIFIER IP_TQ_LOSS_ARS_AV_CAN_MAX FORMAT "%6.2"
 /begin AXIS_DESCR COM_AXIS tq_loss_ars_av_can _CNV_A_R_LINEAR_____186_CM 8 -1024. 1023.96875 FORMAT "%6.2" AXIS_PTS_REF ldp_tq_loss_ars_av_can_max /end AXIS_DESCR
 /begin AXIS_DESCR COM_AXIS n_32 _CNV_A_R_LINEAR_____16_CM 8 0. 8160. FORMAT "%4.0" AXIS_PTS_REF ldpm_n_32__tq_loss_ars /end AXIS_DESCR
/end CHARACTERISTIC
/begin CHARACTERISTIC c_fac_tq_loss_ars_grd "ARS torque loss gradient - correction factor" VALUE 0x015a6 _REC_VAL_20_u2 0.99998474 _CNV_A_R_LINEAR_____37_CM 0. 0.99998474 DISPLAY_IDENTIFIER C_FAC_TQ_LOSS_ARS_GRD FORMAT "%7.6" /end CHARACTERISTIC
/begin CHARACTERISTIC c_fac_tq_loss_ars_dif "ARS torque loss actual value - correction factor" VALUE 0x015a4 _REC_VAL_20_u2 0.99998474 _CNV_A_R_LINEAR_____37_CM 0. 0.99998474 DISPLAY_IDENTIFIER C_FAC_TQ_LOSS_ARS_DIF FORMAT "%7.6" /end CHARACTERISTIC
/begin CHARACTERISTIC c_t_dly_tq_max_ars "Time delay for activating LV_TQ_MAX_ARS" VALUE 0x01816 _REC_VAL_20_u2 655.35 _CNV_A_R_LINEAR_____4_CM 0. 655.35 DISPLAY_IDENTIFIER C_T_DLY_TQ_MAX_ARS FORMAT "%6.2" /end CHARACTERISTIC
/begin CHARACTERISTIC c_tq_loss_ars_sp_ofs "Offset for TQ_LOSS_ARS_SP" VALUE 0x004a4 _REC_VAL_20_s2 2047.96875 _CNV_A_R_LINEAR_____55_CM -1024. 1023.96875 DISPLAY_IDENTIFIER C_TQ_LOSS_ARS_SP_OFS FORMAT "%8.2" /end CHARACTERISTIC
/begin CHARACTERISTIC c_tq_loss_ars_av_ofs "Offset for TQ_LOSS_ARS_AV" VALUE 0x004a2 _REC_VAL_20_s2 2047.96875 _CNV_A_R_LINEAR_____55_CM -1024. 1023.96875 DISPLAY_IDENTIFIER C_TQ_LOSS_ARS_AV_OFS FORMAT "%8.2" /end CHARACTERISTIC
/begin CHARACTERISTIC c_v_max_ars_diag "filtered vehicle speed threshold for diagnosis" VALUE 0x0199e _REC_VAL_20_u2 511.99218 _CNV_A_R_LINEAR_____85_CM 0. 511.99218 DISPLAY_IDENTIFIER C_V_MAX_ARS_DIAG FORMAT "%7.3" /end CHARACTERISTIC
/begin CHARACTERISTIC c_n_max_ars_diag "engine speed threshold for diagnosis" VALUE 0x0076f _REC_VAL_20_u1 8160. _CNV_A_R_LINEAR_____16_CM 0. 8160. DISPLAY_IDENTIFIER C_N_MAX_ARS_DIAG FORMAT "%4.0" /end CHARACTERISTIC
/begin AXIS_PTS ldpm_ac_veh_trv_tcs "" 0x11558 ac_veh_trv_tcs _REC_AXS_20_u2 102.35 _CNV_A_R_LINEAR_____103_CM 8 -51.175 51.175 DISPLAY_IDENTIFIER LDPM_AC_VEH_TRV_TCS FORMAT "%7.4" /end AXIS_PTS
/begin AXIS_PTS ldpm_vs_fil "" 0x11cd4 vs_fil _REC_AXS_20_u2 511.99218 _CNV_A_R_LINEAR_____85_CM 8 0. 511.99218 DISPLAY_IDENTIFIER LDPM_VS_FIL FORMAT "%7.3" /end AXIS_PTS
/begin AXIS_PTS ldpm_n_32__tq_loss_ars "" 0x080ad n_32 _REC_AXS_20_u1 8160. _CNV_A_R_LINEAR_____16_CM 8 0. 8160. DISPLAY_IDENTIFIER LDPM_N_32__TQ_LOSS_ARS FORMAT "%4.0" /end AXIS_PTS
/begin AXIS_PTS ldp_tq_loss_ars_sp_can_max "" 0x1134c tq_loss_ars_sp_can _REC_AXS_20_u2 2047.96875 _CNV_A_R_LINEAR_____186_CM 8 -1024. 1023.96875 DISPLAY_IDENTIFIER LDP_TQ_LOSS_ARS_SP_CAN_MAX FORMAT "%6.2" /end AXIS_PTS
/begin AXIS_PTS ldp_tq_loss_ars_av_can_max "" 0x1132c tq_loss_ars_av_can _REC_AXS_20_u2 2047.96875 _CNV_A_R_LINEAR_____186_CM 8 -1024. 1023.96875 DISPLAY_IDENTIFIER LDP_TQ_LOSS_ARS_AV_CAN_MAX FORMAT "%6.2" /end AXIS_PTS
/begin MEASUREMENT tq_clu_amt "converter torque" SWORD _CNV_A_R_LINEAR_____55_CM 1 100. -1024. 1023.96875 DISPLAY_IDENTIFIER TQ_CLU_AMT ECU_ADDRESS 0x3fd904 BYTE_ORDER MSB_LAST FORMAT "%8.2" /end MEASUREMENT
/begin MEASUREMENT lv_amt_crawl_on "Active AMT clutch torque" UBYTE _CNV_S_2_RANGE______0_CM 1 100. 0. 1. DISPLAY_IDENTIFIER LV_AMT_CRAWL_ON ECU_ADDRESS 0x3fe574 /end MEASUREMENT
/begin CHARACTERISTIC ip_tq_amt "AMT torque offset" CURVE 0x0faae _REC_CUR_20_u2_u1 2047.96875 _CNV_A_R_LINEAR_____186_CM -1024. 1023.96875 DISPLAY_IDENTIFIER IP_TQ_AMT FORMAT "%6.2"
 /begin AXIS_DESCR COM_AXIS tco _CNV_A_R_LINEAR_____12_CM 6 -48. 142.5 FORMAT "%5.1" AXIS_PTS_REF ldp_tco__tq_clu_amt /end AXIS_DESCR
/end CHARACTERISTIC
/begin CHARACTERISTIC ip_tq_vs_fil_amt "AMT torque offset by VS and N_DIF" MAP 0x100ce _REC_MAP_20_u2_u2_u2 2047.96875 _CNV_A_R_LINEAR_____186_CM -1024. 1023.96875 DISPLAY_IDENTIFIER IP_TQ_VS_FIL_AMT FORMAT "%6.2"
 /begin AXIS_DESCR COM_AXIS vs_fil _CNV_A_R_LINEAR_____85_CM 6 0. 511.99218 FORMAT "%7.3" AXIS_PTS_REF ldp_vs_fil__tq_clu_amt /end AXIS_DESCR
 /begin AXIS_DESCR COM_AXIS n_dif _CNV_A_R_LINEAR_____206_CM 6 -32768. 32767. FORMAT "%6.0" AXIS_PTS_REF ldp_n_dif__tq_clu_amt /end AXIS_DESCR
/end CHARACTERISTIC
/begin MEASUREMENT tq_add_amt "Torque reserve for switching AMT Torque" SWORD _CNV_A_R_LINEAR_____55_CM 1 100. -1024. 1023.96875 DISPLAY_IDENTIFIER TQ_ADD_AMT ECU_ADDRESS 0x3fd906 BYTE_ORDER MSB_LAST FORMAT "%8.2" /end MEASUREMENT
/begin MEASUREMENT lv_tout_amt "logical variable to start deactivation of torque reserve and condition for switch off AMT calculation" UBYTE _CNV_S_2_RANGE______0_CM 1 100. 0. 1. DISPLAY_IDENTIFIER LV_TOUT_AMT ECU_ADDRESS 0x3fe575 /end MEASUREMENT
/begin MEASUREMENT t_amt "timer for duration of transient TQ_LOSS_AMT correction" UWORD _CNV_A_R_LINEAR_____4_CM 1 100. 0. 5.1 DISPLAY_IDENTIFIER T_AMT ECU_ADDRESS 0x3fd90a BYTE_ORDER MSB_LAST FORMAT "%4.2" /end MEASUREMENT
/begin CHARACTERISTIC ip_tq_add_amt "Torque reserve for switching on AMT" CURVE 0x0f8aa _REC_CUR_20_u2_u1 2047.96875 _CNV_A_R_LINEAR_____186_CM -1024. 1023.96875 DISPLAY_IDENTIFIER IP_TQ_ADD_AMT FORMAT "%6.2"
 /begin AXIS_DESCR COM_AXIS n_32 _CNV_A_R_LINEAR_____16_CM 6 0. 8160. FORMAT "%4.0" AXIS_PTS_REF ldp_n_32_ip_tq_add_amt /end AXIS_DESCR
/end CHARACTERISTIC
/begin CHARACTERISTIC c_tq_thd_amt_isc "Threshold look  ISC" VALUE 0x01984 _REC_VAL_20_u2 1023.96875 _CNV_A_R_LINEAR_____55_CM 0. 1023.96875 DISPLAY_IDENTIFIER C_TQ_THD_AMT_ISC FORMAT "%7.2" /end CHARACTERISTIC
/begin CHARACTERISTIC c_tq_add_amt_lgrd "Limitation gradient for TQ_ADD_AMT decrease after deactivation" VALUE 0x01972 _REC_VAL_20_u2 1023.96875 _CNV_A_R_LINEAR_____55_CM 0. 1023.96875 DISPLAY_IDENTIFIER C_TQ_ADD_AMT_LGRD FORMAT "%7.2" /end CHARACTERISTIC
/begin CHARACTERISTIC c_tq_lgrd_crawl_inc "????" VALUE 0x01980 _REC_VAL_20_u2 1023.96875 _CNV_A_R_LINEAR_____55_CM 0. 1023.96875 DISPLAY_IDENTIFIER C_TQ_LGRD_CRAWL_INC FORMAT "%7.2" /end CHARACTERISTIC
/begin CHARACTERISTIC c_tq_lgrd_crawl_dec "????" VALUE 0x0197e _REC_VAL_20_u2 1023.96875 _CNV_A_R_LINEAR_____55_CM 0. 1023.96875 DISPLAY_IDENTIFIER C_TQ_LGRD_CRAWL_DEC FORMAT "%7.2" /end CHARACTERISTIC
/begin AXIS_PTS ldp_tco__tq_clu_amt "" 0x01189 tco _REC_AXS_20_u1 190.5 _CNV_A_R_LINEAR_____12_CM 6 -48. 142.5 DISPLAY_IDENTIFIER LDP_TCO__TQ_CLU_AMT FORMAT "%5.1" /end AXIS_PTS
/begin AXIS_PTS ldp_n_dif__tq_clu_amt "" 0x10f22 n_dif _REC_AXS_20_u2 65535. _CNV_A_R_LINEAR_____206_CM 6 -32768. 32767. DISPLAY_IDENTIFIER LDP_N_DIF__TQ_CLU_AMT FORMAT "%6.0" /end AXIS_PTS
/begin AXIS_PTS ldp_n_32_ip_tq_add_amt "" 0x01098 n_32 _REC_AXS_20_u1 8160. _CNV_A_R_LINEAR_____16_CM 6 0. 8160. DISPLAY_IDENTIFIER LDP_N_32_IP_TQ_ADD_AMT FORMAT "%4.0" /end AXIS_PTS
/begin AXIS_PTS ldp_vs_fil__tq_clu_amt "" 0x1152e vs_fil _REC_AXS_20_u2 511.99218 _CNV_A_R_LINEAR_____85_CM 6 0. 511.99218 DISPLAY_IDENTIFIER LDP_VS_FIL__TQ_CLU_AMT FORMAT "%7.3" /end AXIS_PTS
/begin MEASUREMENT lv_dcc_disable_can "logical variable for disabling DCC intervention due to CAN error" UBYTE _CNV_S_2_RANGE______0_CM 1 100. 0. 1. DISPLAY_IDENTIFIER LV_DCC_DISABLE_CAN ECU_ADDRESS 0x3fe599 /end MEASUREMENT
/begin MEASUREMENT tqi_dcc_fast_inc_req "torque increase for fast torque intervention during DCC" SWORD _CNV_A_R_LINEAR_____55_CM 1 100. -1024. 1023.96875 DISPLAY_IDENTIFIER TQI_DCC_FAST_INC_REQ ECU_ADDRESS 0x3fd97a BYTE_ORDER MSB_LAST FORMAT "%8.2" /end MEASUREMENT
/begin MEASUREMENT tqi_dcc_fast_inc_req_1 "Torque increase for fast torque intervention during DCC" SWORD _CNV_A_R_LINEAR_____55_CM 1 100. -1024. 1023.96875 DISPLAY_IDENTIFIER TQI_DCC_FAST_INC_REQ_1 ECU_ADDRESS 0x3fd97e BYTE_ORDER MSB_LAST FORMAT "%8.2" /end MEASUREMENT
/begin MEASUREMENT tqi_dcc_slow_inc_req "torque increase for slow torque intervention during DCC" SWORD _CNV_A_R_LINEAR_____55_CM 1 100. -1024. 1023.96875 DISPLAY_IDENTIFIER TQI_DCC_SLOW_INC_REQ ECU_ADDRESS 0x3fd97c BYTE_ORDER MSB_LAST FORMAT "%8.2" /end MEASUREMENT
/begin MEASUREMENT tqi_dcc_slow_inc_req_1 "Torque increase for slow torque intervention during DCC" SWORD _CNV_A_R_LINEAR_____55_CM 1 100. -1024. 1023.96875 DISPLAY_IDENTIFIER TQI_DCC_SLOW_INC_REQ_1 ECU_ADDRESS 0x3fd980 BYTE_ORDER MSB_LAST FORMAT "%8.2" /end MEASUREMENT
/begin MEASUREMENT tqi_dcc_fast_inc "torque increase for fast torque intervention during DCC" SWORD _CNV_A_R_LINEAR_____55_CM 1 100. -1024. 1023.96875 DISPLAY_IDENTIFIER TQI_DCC_FAST_INC ECU_ADDRESS 0x3fd982 BYTE_ORDER MSB_LAST FORMAT "%8.2" /end MEASUREMENT
/begin MEASUREMENT lv_dcc_ena_inc "logical variable for increased torque intervention due to DCC" UBYTE _CNV_S_2_RANGE______0_CM 1 100. 0. 1. DISPLAY_IDENTIFIER LV_DCC_ENA_INC ECU_ADDRESS 0x3fe59a /end MEASUREMENT
/begin MEASUREMENT lv_dcc_inc_act "logical variable for torque intervention due to DCC" UBYTE _CNV_S_2_RANGE______0_CM 1 100. 0. 1. DISPLAY_IDENTIFIER LV_DCC_INC_ACT ECU_ADDRESS 0x3fe59b /end MEASUREMENT
/begin CHARACTERISTIC c_lgrd_lih_dcc_inc "limiting gradient for DCC emergency ramp function (default  0.6 Nm/10ms)" VALUE 0x0162e _REC_VAL_20_u2 1023.96875 _CNV_A_R_LINEAR_____202_CM 0. 1023.96875 DISPLAY_IDENTIFIER C_LGRD_LIH_DCC_INC FORMAT "%7.2" /end CHARACTERISTIC
/begin CHARACTERISTIC c_t_dly_lih_dcc_inc "delay time for activation of DCC emergency ramp function (default 0s)" VALUE 0x007fc _REC_VAL_20_u1 2.55 _CNV_A_R_LINEAR_____4_CM 0. 2.55 DISPLAY_IDENTIFIER C_T_DLY_LIH_DCC_INC FORMAT "%4.2" /end CHARACTERISTIC
/begin MEASUREMENT tqi_dcc_slow_inc "torque increase for slow torque intervention during DCC" SWORD _CNV_A_R_LINEAR_____55_CM 1 100. -1024. 1023.96875 DISPLAY_IDENTIFIER TQI_DCC_SLOW_INC ECU_ADDRESS 0x3fd984 BYTE_ORDER MSB_LAST FORMAT "%8.2" /end MEASUREMENT
/begin MEASUREMENT lv_dcc_inc_lih "logical variable for torque intervention LIH due to DCC" UBYTE _CNV_S_2_RANGE______0_CM 1 100. 0. 1. DISPLAY_IDENTIFIER LV_DCC_INC_LIH ECU_ADDRESS 0x3fe59c /end MEASUREMENT
/begin MEASUREMENT t_dcc_lih_ctr "time counter delay time" UBYTE _CNV_A_R_LINEAR_____4_CM 1 100. 0. 2.55 DISPLAY_IDENTIFIER T_DCC_LIH_CTR ECU_ADDRESS 0x3fe59d FORMAT "%4.2" /end MEASUREMENT
/begin MEASUREMENT lv_tq_fast_ena "Logical output to switch to fast torque mode" UBYTE _CNV_S_2_RANGE______5_CM 1 100. 0. 1. DISPLAY_IDENTIFIER LV_TQ_FAST_ENA ECU_ADDRESS 0x3fe57e /end MEASUREMENT
/begin MEASUREMENT lv_tq_iga_ena "Logical output to switch to IGA intervention mode" UBYTE _CNV_S_2_RANGE______5_CM 1 100. 0. 1. DISPLAY_IDENTIFIER LV_TQ_IGA_ENA ECU_ADDRESS 0x3fe57f /end MEASUREMENT
/begin MEASUREMENT state_tq_dyn_iga "Actual state of the torque dynamic state machine IGA intervention" UBYTE _CNV_S_4_STATE_TQ_D_462_CM 1 100. 0. 3. DISPLAY_IDENTIFIER STATE_TQ_DYN_IGA ECU_ADDRESS 0x3fe581 /end MEASUREMENT
/begin MEASUREMENT lv_lamb_tq_ctl "Logical output to switch to lambda calculation torque controlled  (if equal to 1)" UBYTE _CNV_S_2_RANGE______5_CM 1 100. 0. 1. DISPLAY_IDENTIFIER LV_LAMB_TQ_CTL ECU_ADDRESS 0x3fe57b /end MEASUREMENT
/begin MEASUREMENT lv_tq_lamb_inh "Logical output to inhibit torque based lambda setpoint calculation" UBYTE _CNV_S_2_RANGE______5_CM 1 100. 0. 1. DISPLAY_IDENTIFIER LV_TQ_LAMB_INH ECU_ADDRESS 0x3fe57c /end MEASUREMENT
/begin MEASUREMENT lv_tq_lamb_ena "Logical output to switch on torque based lambda setpoint calculation" UBYTE _CNV_S_2_RANGE______5_CM 1 100. 0. 1. DISPLAY_IDENTIFIER LV_TQ_LAMB_ENA ECU_ADDRESS 0x3fe57d BIT_MASK 0x1 /end MEASUREMENT
/begin MEASUREMENT tqi_req_fast_dtm "Indicated torque request fast" SWORD _CNV_A_R_LINEAR_____55_CM 1 100. -1024. 1023.96875 DISPLAY_IDENTIFIER TQI_REQ_FAST_DTM ECU_ADDRESS 0x3fd912 BYTE_ORDER MSB_LAST FORMAT "%8.2" /end MEASUREMENT
/begin MEASUREMENT tqi_req_fast_dtm_can "Indicated torque request fast for torque calculation CAN" SWORD _CNV_A_R_LINEAR_____55_CM 1 100. -1024. 1023.96875 DISPLAY_IDENTIFIER TQI_REQ_FAST_DTM_CAN ECU_ADDRESS 0x3fd914 BYTE_ORDER MSB_LAST FORMAT "%8.2" /end MEASUREMENT
/begin MEASUREMENT tqi_req_slow_dtm "Indicated torque request slow" SWORD _CNV_A_R_LINEAR_____55_CM 1 100. -1024. 1023.96875 DISPLAY_IDENTIFIER TQI_REQ_SLOW_DTM ECU_ADDRESS 0x3fd916 BYTE_ORDER MSB_LAST FORMAT "%8.2" /end MEASUREMENT
/begin CHARACTERISTIC c_tq_delta_eco_mod "Maximum torque difference before transition to state 'economy_mode'" VALUE 0x01978 _REC_VAL_20_u2 1023.96875 _CNV_A_R_LINEAR_____55_CM 0. 1023.96875 DISPLAY_IDENTIFIER C_TQ_DELTA_ECO_MOD FORMAT "%7.2" /end CHARACTERISTIC
/begin CHARACTERISTIC c_tq_delta_max_comp "Maximum torque delta for compensation in state 'conditional_transition_mode'" VALUE 0x0197a _REC_VAL_20_u2 1023.96875 _CNV_A_R_LINEAR_____55_CM 0. 1023.96875 DISPLAY_IDENTIFIER C_TQ_DELTA_MAX_COMP FORMAT "%7.2" /end CHARACTERISTIC
/begin MEASUREMENT state_tq_dyn_lamb "State dynamic torque manager lambda intervention" UBYTE _CNV_A_R_LINEAR_____1_CM 1 100. 0. 255. DISPLAY_IDENTIFIER STATE_TQ_DYN_LAMB ECU_ADDRESS 0x3fe580 FORMAT "%3.0" /end MEASUREMENT
/begin CHARACTERISTIC c_state_tq_dyn_lamb "Manual setting of state dynamic torque manager lambda intervention" VALUE 0x007bf _REC_VAL_20_u1 255. _CNV_A_R_LINEAR_____1_CM 0. 255. DISPLAY_IDENTIFIER C_STATE_TQ_DYN_LAMB FORMAT "%3.0" /end CHARACTERISTIC
/begin MEASUREMENT tqi_req_tra_slow "Requested indicated torque for slow path" SWORD _CNV_A_R_LINEAR_____55_CM 1 100. -1024. 1023.96875 DISPLAY_IDENTIFIER TQI_REQ_TRA_SLOW ECU_ADDRESS 0x3fd934 BYTE_ORDER MSB_LAST FORMAT "%8.2" /end MEASUREMENT
/begin MEASUREMENT tq_req_tra_slow "Requested torque at clutch for slow path" SWORD _CNV_A_R_LINEAR_____55_CM 1 100. -1024. 1023.96875 DISPLAY_IDENTIFIER TQ_REQ_TRA_SLOW ECU_ADDRESS 0x3fd93a BYTE_ORDER MSB_LAST FORMAT "%8.2" /end MEASUREMENT
/begin MEASUREMENT tq_req_tra_fast "Requested torque at clutch for fast path" SWORD _CNV_A_R_LINEAR_____55_CM 1 100. -1024. 1023.96875 DISPLAY_IDENTIFIER TQ_REQ_TRA_FAST ECU_ADDRESS 0x3fd93c BYTE_ORDER MSB_LAST FORMAT "%8.2" /end MEASUREMENT
/begin MEASUREMENT tqi_req_tra_fast "Requested indicated torque for fast path" SWORD _CNV_A_R_LINEAR_____55_CM 1 100. -1024. 1023.96875 DISPLAY_IDENTIFIER TQI_REQ_TRA_FAST ECU_ADDRESS 0x3fd936 BYTE_ORDER MSB_LAST FORMAT "%8.2" /end MEASUREMENT
/begin MEASUREMENT tqi_req_tra_1 "Intermediate value requested indicated torque after torque transient " SWORD _CNV_A_R_LINEAR_____55_CM 1 100. -1024. 1023.96875 DISPLAY_IDENTIFIER TQI_REQ_TRA_1 ECU_ADDRESS 0x3fd93e BYTE_ORDER MSB_LAST FORMAT "%8.2" /end MEASUREMENT
/begin MEASUREMENT tqi_req_driv "Driver requested indicated torque not filtered by torque transient" SWORD _CNV_A_R_LINEAR_____55_CM 1 100. -1024. 1023.96875 DISPLAY_IDENTIFIER TQI_REQ_DRIV ECU_ADDRESS 0x3fd940 BYTE_ORDER MSB_LAST FORMAT "%8.2" /end MEASUREMENT
/begin MEASUREMENT fac_dyn_driv "Converging Factor" UWORD _CNV_A_R_LINEAR_____190_CM 1 100. 0. 1. DISPLAY_IDENTIFIER FAC_DYN_DRIV ECU_ADDRESS 0x3fd938 BYTE_ORDER MSB_LAST FORMAT "%7.5" /end MEASUREMENT
/begin CHARACTERISTIC c_fac_dyn_driv_ct "Integrator decrement for converging factor in case of Closed Throttle" VALUE 0x01572 _REC_VAL_20_u2 0.99998474 _CNV_A_R_LINEAR_____37_CM 0. 0.99998474 DISPLAY_IDENTIFIER C_FAC_DYN_DRIV_CT FORMAT "%7.6" /end CHARACTERISTIC
/begin CHARACTERISTIC c_fac_dyn_driv "Integrator decrement for converging factor" VALUE 0x01570 _REC_VAL_20_u2 0.99998474 _CNV_A_R_LINEAR_____37_CM 0. 0.99998474 DISPLAY_IDENTIFIER C_FAC_DYN_DRIV FORMAT "%7.6" /end CHARACTERISTIC
/begin CHARACTERISTIC lc_tqi_req_tra_slow_sel "Switch for slow path setpoint selection 0:scaling factor  1:control loop" VALUE 0x00f96 _REC_VAL_20_u1 1. _CNV_A_R_LINEAR_____1_CM 0. 1. DISPLAY_IDENTIFIER LC_TQI_REQ_TRA_SLOW_SEL FORMAT "%2.0" /end CHARACTERISTIC
/begin CHARACTERISTIC lc_tqi_req_tra_fast_tran_inh "Switch for disabling transition function for fast path torque request" VALUE 0x00f95 _REC_VAL_20_u1 1. _CNV_A_R_LINEAR_____1_CM 0. 1. DISPLAY_IDENTIFIER LC_TQI_REQ_TRA_FAST_TRAN_INH FORMAT "%2.0" /end CHARACTERISTIC
/begin CHARACTERISTIC c_fac_tqi_req_tra_hpf "Gain of HPF for TQI_BAS delay adjust " VALUE 0x015b2 _REC_VAL_20_u2 255.996094 _CNV_A_R_LINEAR_____123_CM 0. 255.996094 DISPLAY_IDENTIFIER C_FAC_TQI_REQ_TRA_HPF FORMAT "%7.3" /end CHARACTERISTIC
/begin CHARACTERISTIC c_fac_tqi_req_tra_slow "Scaling factor for torque transient ramp for slow path" VALUE 0x015b4 _REC_VAL_20_u2 1.99996948 _CNV_A_R_LINEAR_____21_CM 0. 1.99996948 DISPLAY_IDENTIFIER C_FAC_TQI_REQ_TRA_SLOW FORMAT "%7.5" /end CHARACTERISTIC
/begin CHARACTERISTIC c_fac_dyn_driv_dt "Integrator decrement for converging factor in case of Closed Throttle and drive train" VALUE 0x01574 _REC_VAL_20_u2 0.99998474 _CNV_A_R_LINEAR_____37_CM 0. 0.99998474 DISPLAY_IDENTIFIER C_FAC_DYN_DRIV_DT FORMAT "%7.6" /end CHARACTERISTIC
/begin CHARACTERISTIC c_maf_dif_min_fcut_fast "min. load decrease fast fuel cut-off" VALUE 0x0164a _REC_VAL_20_u2 1389. _CNV_A_R_LINEAR_____106_CM 0. 1389. DISPLAY_IDENTIFIER C_MAF_DIF_MIN_FCUT_FAST FORMAT "%7.2" /end CHARACTERISTIC
/begin CHARACTERISTIC c_t_max_fcut_fast "max. time cllutch switch observation fast fuel cut-off" VALUE 0x0081d _REC_VAL_20_u1 2.55 _CNV_A_R_LINEAR_____4_CM 0. 2.55 DISPLAY_IDENTIFIER C_T_MAX_FCUT_FAST FORMAT "%4.2" /end CHARACTERISTIC
/begin CHARACTERISTIC c_tco_min_fcut_fast "min. coolant temperature fast fuel cut-off" VALUE 0x00886 _REC_VAL_20_u1 190.5 _CNV_A_R_LINEAR_____12_CM -48. 142.5 DISPLAY_IDENTIFIER C_TCO_MIN_FCUT_FAST FORMAT "%5.1" /end CHARACTERISTIC
/begin MEASUREMENT lv_cs_chg "Logical variable" UBYTE _CNV_S_2_RANGE______5_CM 1 100. 0. 1. DISPLAY_IDENTIFIER LV_CS_CHG ECU_ADDRESS 0x3fe58b /end MEASUREMENT
/begin MEASUREMENT lv_fcut_fast "Logical variable for authorizing fuel cut off pattern" UBYTE _CNV_S_2_RANGE______5_CM 1 100. 0. 1. DISPLAY_IDENTIFIER LV_FCUT_FAST ECU_ADDRESS 0x3fe586 BIT_MASK 0x1 /end MEASUREMENT
/begin MEASUREMENT lv_ct_chg "Logical variable" UBYTE _CNV_S_2_RANGE______5_CM 1 100. 0. 1. DISPLAY_IDENTIFIER LV_CT_CHG ECU_ADDRESS 0x3fe58a /end MEASUREMENT
/begin MEASUREMENT lv_asr_ena "Logical variable for ASR intervention enabling" UBYTE _CNV_S_2_RANGE______0_CM 1 100. 0. 1. DISPLAY_IDENTIFIER LV_ASR_ENA ECU_ADDRESS 0x3fe593 BIT_MASK 0x1 /end MEASUREMENT
/begin MEASUREMENT lv_msr_ena "Logical variable for MSR intervention enabling" UBYTE _CNV_S_2_RANGE______0_CM 1 100. 0. 1. DISPLAY_IDENTIFIER LV_MSR_ENA ECU_ADDRESS 0x3fe594 BIT_MASK 0x1 /end MEASUREMENT
/begin MEASUREMENT tqi_msr_fast_req "fast torque intervention due to MSR previous limp home check" SWORD _CNV_A_R_LINEAR_____55_CM 1 100. -1024. 1023.96875 DISPLAY_IDENTIFIER TQI_MSR_FAST_REQ ECU_ADDRESS 0x3fd966 BYTE_ORDER MSB_LAST FORMAT "%8.2" /end MEASUREMENT
/begin MEASUREMENT tqi_msr_slow_req "slow torque intervention due to MSR previous limp home check" SWORD _CNV_A_R_LINEAR_____55_CM 1 100. -1024. 1023.96875 DISPLAY_IDENTIFIER TQI_MSR_SLOW_REQ ECU_ADDRESS 0x3fd968 BYTE_ORDER MSB_LAST FORMAT "%8.2" /end MEASUREMENT
/begin MEASUREMENT sf_tqd "Status flag driving toque at clutch" UBYTE _CNV_A_R_LINEAR_____1_CM 1 100. 0. 3. DISPLAY_IDENTIFIER SF_TQD ECU_ADDRESS 0x3fe58d FORMAT "%2.0" /end MEASUREMENT
/begin MEASUREMENT lv_tcs_disable "Logical variable for disabling TCS intervention due to EMS error" UBYTE _CNV_S_2_RANGE______0_CM 1 100. 0. 1. DISPLAY_IDENTIFIER LV_TCS_DISABLE ECU_ADDRESS 0x3fe591 BIT_MASK 0x1 /end MEASUREMENT
/begin MEASUREMENT tqi_asr_slow "torque decrement for slow torque intervention during TCS" SWORD _CNV_A_R_LINEAR_____55_CM 1 100. -1024. 1023.96875 DISPLAY_IDENTIFIER TQI_ASR_SLOW ECU_ADDRESS 0x3fd974 BYTE_ORDER MSB_LAST FORMAT "%8.2" /end MEASUREMENT
/begin CHARACTERISTIC c_lgrd_lih_asr "Limiting gradient for ASR emergency ramp function (default 0.6 Nm/10ms)" VALUE 0x0162c _REC_VAL_20_u2 1023.96875 _CNV_A_R_LINEAR_____202_CM 0. 1023.96875 DISPLAY_IDENTIFIER C_LGRD_LIH_ASR FORMAT "%7.2" /end CHARACTERISTIC
/begin CHARACTERISTIC c_t_dly_lih_asr "Delay time for activation of ASR emergency ramp function (default 0 s)" VALUE 0x007fb _REC_VAL_20_u1 2.55 _CNV_A_R_LINEAR_____4_CM 0. 2.55 DISPLAY_IDENTIFIER C_T_DLY_LIH_ASR FORMAT "%4.2" /end CHARACTERISTIC
/begin MEASUREMENT tqi_asr_fast_req "fast torque intervention due to ASR" SWORD _CNV_A_R_LINEAR_____55_CM 1 100. -1024. 1023.96875 DISPLAY_IDENTIFIER TQI_ASR_FAST_REQ ECU_ADDRESS 0x3fd962 BYTE_ORDER MSB_LAST FORMAT "%8.2" /end MEASUREMENT
/begin MEASUREMENT tqi_asr_fast_req_1 "Torque decrement for fast torque intervention during TCS" SWORD _CNV_A_R_LINEAR_____55_CM 1 100. -1024. 1023.96875 DISPLAY_IDENTIFIER TQI_ASR_FAST_REQ_1 ECU_ADDRESS 0x3fd96a BYTE_ORDER MSB_LAST FORMAT "%8.2" /end MEASUREMENT
/begin MEASUREMENT tqi_asr_slow_req "slow torque intervention due to ASR" SWORD _CNV_A_R_LINEAR_____55_CM 1 100. -1024. 1023.96875 DISPLAY_IDENTIFIER TQI_ASR_SLOW_REQ ECU_ADDRESS 0x3fd964 BYTE_ORDER MSB_LAST FORMAT "%8.2" /end MEASUREMENT
/begin MEASUREMENT tqi_msr_fast_req_1 "Torque increase for fast torque intervention during TCS" SWORD _CNV_A_R_LINEAR_____55_CM 1 100. -1024. 1023.96875 DISPLAY_IDENTIFIER TQI_MSR_FAST_REQ_1 ECU_ADDRESS 0x3fd96e BYTE_ORDER MSB_LAST FORMAT "%8.2" /end MEASUREMENT
/begin MEASUREMENT tqi_asr_slow_req_1 "torque decrement for slow torque intervention during TCS" SWORD _CNV_A_R_LINEAR_____55_CM 1 100. -1024. 1023.96875 DISPLAY_IDENTIFIER TQI_ASR_SLOW_REQ_1 ECU_ADDRESS 0x3fd96c BYTE_ORDER MSB_LAST FORMAT "%8.2" /end MEASUREMENT
/begin MEASUREMENT tqi_msr_slow_req_1 "Torque increase for slow torque intervention during gear shift" SWORD _CNV_A_R_LINEAR_____55_CM 1 100. -1024. 1023.96875 DISPLAY_IDENTIFIER TQI_MSR_SLOW_REQ_1 ECU_ADDRESS 0x3fd970 BYTE_ORDER MSB_LAST FORMAT "%8.2" /end MEASUREMENT
/begin MEASUREMENT tqi_asr_fast "torque decrement for fast torque intervention during TCS" SWORD _CNV_A_R_LINEAR_____55_CM 1 100. -1024. 1023.96875 DISPLAY_IDENTIFIER TQI_ASR_FAST ECU_ADDRESS 0x3fd972 BYTE_ORDER MSB_LAST FORMAT "%8.2" /end MEASUREMENT
/begin MEASUREMENT tqi_msr_fast "fast torque intervention due to MSR" SWORD _CNV_A_R_LINEAR_____55_CM 1 100. -1024. 1023.96875 DISPLAY_IDENTIFIER TQI_MSR_FAST ECU_ADDRESS 0x3fd976 BYTE_ORDER MSB_LAST FORMAT "%8.2" /end MEASUREMENT
/begin MEASUREMENT tqi_msr_slow "slow torque intervention due to MSR" SWORD _CNV_A_R_LINEAR_____55_CM 1 100. -1024. 1023.96875 DISPLAY_IDENTIFIER TQI_MSR_SLOW ECU_ADDRESS 0x3fd978 BYTE_ORDER MSB_LAST FORMAT "%8.2" /end MEASUREMENT
/begin MEASUREMENT lv_msr_lih "Logical variable fortorque intervention limp home due toMSR" UBYTE _CNV_S_2_RANGE______0_CM 1 100. 0. 1. DISPLAY_IDENTIFIER LV_MSR_LIH ECU_ADDRESS 0x3fe590 BIT_MASK 0x1 /end MEASUREMENT
/begin MEASUREMENT lv_msr_act "Logical variable fortorque intervention due to MSR" UBYTE _CNV_S_2_RANGE______0_CM 1 100. 0. 1. DISPLAY_IDENTIFIER LV_MSR_ACT ECU_ADDRESS 0x3fe58f BIT_MASK 0x1 /end MEASUREMENT
/begin CHARACTERISTIC c_t_dly_lih_msr "Delay time for activation of MSR emergency ramp function (default 0 s)" VALUE 0x007ff _REC_VAL_20_u1 2.55 _CNV_A_R_LINEAR_____4_CM 0. 2.55 DISPLAY_IDENTIFIER C_T_DLY_LIH_MSR FORMAT "%4.2" /end CHARACTERISTIC
/begin MEASUREMENT lv_asr_act "Logical variable fortorque intervention due to ASR" UBYTE _CNV_S_2_RANGE______0_CM 1 100. 0. 1. DISPLAY_IDENTIFIER LV_ASR_ACT ECU_ADDRESS 0x3fe58e BIT_MASK 0x1 /end MEASUREMENT
/begin CHARACTERISTIC lc_msr_disable "logical constant to disable MSR interventions" VALUE 0x00f5f _REC_VAL_20_u1 1. _CNV_S_2_RANGE______0_CM 0. 1. DISPLAY_IDENTIFIER LC_MSR_DISABLE /end CHARACTERISTIC
/begin MEASUREMENT lv_tcs_ena "Logical variable for basically TCS intervention enabling" UBYTE _CNV_S_2_RANGE______0_CM 1 100. 0. 1. DISPLAY_IDENTIFIER LV_TCS_ENA ECU_ADDRESS 0x3fe597 BIT_MASK 0x1 /end MEASUREMENT
/begin MEASUREMENT lv_tcs_disable_can "logical variable for disabling TCS intervention due to EMS CAN error" UBYTE _CNV_S_2_RANGE______0_CM 1 100. 0. 1. DISPLAY_IDENTIFIER LV_TCS_DISABLE_CAN ECU_ADDRESS 0x3fe592 /end MEASUREMENT
/begin MEASUREMENT lv_asr_lih "logical variable for torque intervention LIH due to TCS" UBYTE _CNV_S_2_RANGE______0_CM 1 100. 0. 1. DISPLAY_IDENTIFIER LV_ASR_LIH ECU_ADDRESS 0x3fe598 BIT_MASK 0x1 /end MEASUREMENT
/begin MEASUREMENT t_asr_lih_ctr "Delay time" UBYTE _CNV_A_R_LINEAR_____4_CM 1 100. 0. 2.55 DISPLAY_IDENTIFIER T_ASR_LIH_CTR ECU_ADDRESS 0x3fe595 FORMAT "%4.2" /end MEASUREMENT
/begin MEASUREMENT t_msr_lih_ctr "Delay time" UBYTE _CNV_A_R_LINEAR_____4_CM 1 100. 0. 2.55 DISPLAY_IDENTIFIER T_MSR_LIH_CTR ECU_ADDRESS 0x3fe596 FORMAT "%4.2" /end MEASUREMENT
/begin CHARACTERISTIC c_lgrd_lih_msr "Limiting gradient for MSR emergency ramp function (default 0.6 Nm/10ms)" VALUE 0x01634 _REC_VAL_20_u2 1023.96875 _CNV_A_R_LINEAR_____202_CM 0. 1023.96875 DISPLAY_IDENTIFIER C_LGRD_LIH_MSR FORMAT "%7.2" /end CHARACTERISTIC
/begin CHARACTERISTIC c_tq_max_msr "limiting torque for MSR" VALUE 0x01982 _REC_VAL_20_u2 2047.96875 _CNV_A_R_LINEAR_____186_CM -1024. 1023.96875 DISPLAY_IDENTIFIER C_TQ_MAX_MSR FORMAT "%6.2" /end CHARACTERISTIC
/begin CHARACTERISTIC lc_asr_disable "logical constant to disable ASR interventions" VALUE 0x00f05 _REC_VAL_20_u1 1. _CNV_S_2_RANGE______0_CM 0. 1. DISPLAY_IDENTIFIER LC_ASR_DISABLE /end CHARACTERISTIC
/begin MEASUREMENT tq_loss_add "additional torque losses" SWORD _CNV_A_R_LINEAR_____55_CM 1 100. -1024. 1023.96875 DISPLAY_IDENTIFIER TQ_LOSS_ADD ECU_ADDRESS 0x3fd83a BYTE_ORDER MSB_LAST FORMAT "%6.2" /end MEASUREMENT
/begin MEASUREMENT ntl "NOX trap absolute loading" UWORD _CNV_A_R_LINEAR_____308_CM 1 100. 0. 10485.6 DISPLAY_IDENTIFIER NTL ECU_ADDRESS 0x3fd9d2 BYTE_ORDER MSB_LAST FORMAT "%7.1" /end MEASUREMENT
/begin MEASUREMENT lv_tq_dyn_1_req "Coordinated Dynamic control bit general" UBYTE _CNV_S_2_RANGE______0_CM 1 100. 0. 1. DISPLAY_IDENTIFIER LV_TQ_DYN_1_REQ ECU_ADDRESS 0x3fe54d /end MEASUREMENT
/begin MEASUREMENT lv_tq_dyn_0_driv "Coordinated Dynamic control bit (Driver)" UBYTE _CNV_S_2_RANGE______0_CM 1 100. 0. 1. DISPLAY_IDENTIFIER LV_TQ_DYN_0_DRIV ECU_ADDRESS 0x3fe54e /end MEASUREMENT
/begin MEASUREMENT lv_tq_dyn_1_driv "Coordinated Dynamic control bit (Driver)" UBYTE _CNV_S_2_RANGE______0_CM 1 100. 0. 1. DISPLAY_IDENTIFIER LV_TQ_DYN_1_DRIV ECU_ADDRESS 0x3fe54f /end MEASUREMENT
/begin MEASUREMENT lv_tq_dyn_driv "Coordinated Dynamic control bit (Driver)" UBYTE _CNV_S_2_RANGE______0_CM 1 100. 0. 1. DISPLAY_IDENTIFIER LV_TQ_DYN_DRIV ECU_ADDRESS 0x3fe54b /end MEASUREMENT
/begin CHARACTERISTIC lc_tq_dyn_driv "Manual switch for fast torque request enabled" VALUE 0x00f84 _REC_VAL_20_u1 1. _CNV_A_R_LINEAR_____1_CM 0. 1. DISPLAY_IDENTIFIER LC_TQ_DYN_DRIV FORMAT "%2.0" /end CHARACTERISTIC
/begin CHARACTERISTIC lc_tq_dyn_driv_inh "Manual switch for disabling high dynamic request from driver" VALUE 0x00f85 _REC_VAL_20_u1 1. _CNV_A_R_LINEAR_____1_CM 0. 1. DISPLAY_IDENTIFIER LC_TQ_DYN_DRIV_INH FORMAT "%2.0" /end CHARACTERISTIC
/begin CHARACTERISTIC lc_tq_dyn_req_man "Manual switch for adjusting Dynamic Torque intervention Manager mode" VALUE 0x00f86 _REC_VAL_20_u1 1. _CNV_A_R_LINEAR_____1_CM 0. 1. DISPLAY_IDENTIFIER LC_TQ_DYN_REQ_MAN FORMAT "%2.0" /end CHARACTERISTIC
/begin CHARACTERISTIC lc_tq_dyn_0_req "Request bit for adjusting Dynamic Torque intervention Manager mode" VALUE 0x00f82 _REC_VAL_20_u1 1. _CNV_A_R_LINEAR_____1_CM 0. 1. DISPLAY_IDENTIFIER LC_TQ_DYN_0_REQ FORMAT "%2.0" /end CHARACTERISTIC
/begin CHARACTERISTIC lc_tq_dyn_1_req "Request bit for adjusting Dynamic Torque intervention Manager mode" VALUE 0x00f83 _REC_VAL_20_u1 1. _CNV_A_R_LINEAR_____1_CM 0. 1. DISPLAY_IDENTIFIER LC_TQ_DYN_1_REQ FORMAT "%2.0" /end CHARACTERISTIC
/begin MEASUREMENT lv_tq_dyn_0_req "Coordinated Dynamic control bit general" UBYTE _CNV_S_2_RANGE______0_CM 1 100. 0. 1. DISPLAY_IDENTIFIER LV_TQ_DYN_0_REQ ECU_ADDRESS 0x3fe54c /end MEASUREMENT
/begin CHARACTERISTIC c_vs_min_dt_fast "Minimum vehicle speed for fast torque mode at open drive train" VALUE 0x00956 _REC_VAL_20_u1 255. _CNV_A_R_LINEAR_____23_CM 0. 255. DISPLAY_IDENTIFIER C_VS_MIN_DT_FAST FORMAT "%3.0" /end CHARACTERISTIC
/begin CHARACTERISTIC c_vs_max_fast "Maximum vehicle speed for fast torque mode" VALUE 0x0094e _REC_VAL_20_u1 255. _CNV_A_R_LINEAR_____23_CM 0. 255. DISPLAY_IDENTIFIER C_VS_MAX_FAST FORMAT "%3.0" /end CHARACTERISTIC
/begin MEASUREMENT tqi_min_pu "Indicated engine torque minimum value at trailing throttle conditons" SWORD _CNV_A_R_LINEAR_____55_CM 1 100. -1024. 1023.96875 DISPLAY_IDENTIFIER TQI_MIN_PU ECU_ADDRESS 0x3fd880 BYTE_ORDER MSB_LAST FORMAT "%6.2" /end MEASUREMENT
/begin MEASUREMENT lv_tqi_bol_set "Logical variable it is set if  TQI_SP  falls below TQI_BOL" UBYTE _CNV_S_2_RANGE______0_CM 1 100. 0. 1. DISPLAY_IDENTIFIER LV_TQI_BOL_SET ECU_ADDRESS 0x3fe552 BIT_MASK 0x1 /end MEASUREMENT
/begin CHARACTERISTIC c_tqi_bol_set_hys "Hysteresis for recognition bottom level indicated engine torque" VALUE 0x0198c _REC_VAL_20_u2 1023.96875 _CNV_A_R_LINEAR_____55_CM 0. 1023.96875 DISPLAY_IDENTIFIER C_TQI_BOL_SET_HYS FORMAT "%7.2" /end CHARACTERISTIC
/begin CHARACTERISTIC c_dip_max "Maximum allowed manifold differential pressure" VALUE 0x01526 _REC_VAL_20_u2 5434. _CNV_A_R_LINEAR_____49_CM 0. 5434. DISPLAY_IDENTIFIER C_DIP_MAX FORMAT "%7.2" /end CHARACTERISTIC
/begin AXIS_PTS ldpm_n_32__maf_min_pu "" 0x0807c n_32 _REC_AXS_20_u1 8160. _CNV_A_R_LINEAR_____16_CM 12 0. 8160. DISPLAY_IDENTIFIER LDPM_N_32__MAF_MIN_PU FORMAT "%4.0" /end AXIS_PTS
/begin AXIS_PTS ldpm_tco__maf_min_pu "" 0x013d5 tco _REC_AXS_20_u1 190.5 _CNV_A_R_LINEAR_____12_CM 4 -48. 142.5 DISPLAY_IDENTIFIER LDPM_TCO__MAF_MIN_PU FORMAT "%5.1" /end AXIS_PTS
/begin CHARACTERISTIC ip_maf_min_pu "Indicated engine torque minimum level at trailing conditions" MAP 0x0c6c6 _REC_MAP_20_u2_u1_u1 694.5 _CNV_A_R_LINEAR_____332_CM 0. 694.5 DISPLAY_IDENTIFIER IP_MAF_MIN_PU FORMAT "%6.2"
 /begin AXIS_DESCR COM_AXIS n_32 _CNV_A_R_LINEAR_____16_CM 12 0. 8160. FORMAT "%4.0" AXIS_PTS_REF ldpm_n_32__maf_min_pu /end AXIS_DESCR
 /begin AXIS_DESCR COM_AXIS tco _CNV_A_R_LINEAR_____12_CM 4 -48. 142.5 FORMAT "%5.1" AXIS_PTS_REF ldpm_tco__maf_min_pu /end AXIS_DESCR
/end CHARACTERISTIC
/begin CHARACTERISTIC ip_maf_min_pu_rng_l "Indicated engine torque minimum level at trailing conditions at low range mode" MAP 0x0c726 _REC_MAP_20_u2_u1_u1 694.5 _CNV_A_R_LINEAR_____332_CM 0. 694.5 DISPLAY_IDENTIFIER IP_MAF_MIN_PU_RNG_L FORMAT "%6.2"
 /begin AXIS_DESCR COM_AXIS n_32 _CNV_A_R_LINEAR_____16_CM 12 0. 8160. FORMAT "%4.0" AXIS_PTS_REF ldpm_n_32__maf_min_pu /end AXIS_DESCR
 /begin AXIS_DESCR COM_AXIS tco _CNV_A_R_LINEAR_____12_CM 4 -48. 142.5 FORMAT "%5.1" AXIS_PTS_REF ldpm_tco__maf_min_pu /end AXIS_DESCR
/end CHARACTERISTIC
/begin CHARACTERISTIC ip_maf_add_puc "Minimumloaded limitation on indicated torque level during PUC" CURVE 0x0c622 _REC_CUR_20_u2_u1 1389. _CNV_A_R_LINEAR_____350_CM -694.5 694.5 DISPLAY_IDENTIFIER IP_MAF_ADD_PUC FORMAT "%7.2"
 /begin AXIS_DESCR COM_AXIS n_32 _CNV_A_R_LINEAR_____16_CM 12 0. 8160. FORMAT "%4.0" AXIS_PTS_REF ldpm_n_32__maf_min_pu /end AXIS_DESCR
/end CHARACTERISTIC
/begin CHARACTERISTIC ip_maf_add_puc_rng_l "Minimumloaded limitation on indicated torque level during PUC at low range mode" CURVE 0x0c63a _REC_CUR_20_u2_u1 1389. _CNV_A_R_LINEAR_____350_CM -694.5 694.5 DISPLAY_IDENTIFIER IP_MAF_ADD_PUC_RNG_L FORMAT "%7.2"
 /begin AXIS_DESCR COM_AXIS n_32 _CNV_A_R_LINEAR_____16_CM 12 0. 8160. FORMAT "%4.0" AXIS_PTS_REF ldpm_n_32__maf_min_pu /end AXIS_DESCR
/end CHARACTERISTIC
/begin MEASUREMENT tqi_bol "Indicated engine torque bottom level at minimum load and maximum spark retard for engine run free of misfire " SWORD _CNV_A_R_LINEAR_____55_CM 1 100. -1024. 1023.96875 DISPLAY_IDENTIFIER TQI_BOL ECU_ADDRESS 0x3fd882 BYTE_ORDER MSB_LAST FORMAT "%8.2" /end MEASUREMENT
/begin MEASUREMENT maf_min_pu_1 "minimum mass air flow calibrated for trailing throttle conditions" UWORD _CNV_A_R_LINEAR_____106_CM 1 100. 0. 1389. DISPLAY_IDENTIFIER MAF_MIN_PU_1 ECU_ADDRESS 0x3fd884 BYTE_ORDER MSB_LAST FORMAT "%7.2" /end MEASUREMENT
/begin MEASUREMENT maf_min_pu_2 "minimum mass air flow calculated from maximum differential pressure" UWORD _CNV_A_R_LINEAR_____106_CM 1 100. 0. 1389. DISPLAY_IDENTIFIER MAF_MIN_PU_2 ECU_ADDRESS 0x3fd886 BYTE_ORDER MSB_LAST FORMAT "%7.2" /end MEASUREMENT
/begin MEASUREMENT maf_min_pu "Resulting minimummass air flow" UWORD _CNV_A_R_LINEAR_____106_CM 1 100. 0. 1389. DISPLAY_IDENTIFIER MAF_MIN_PU ECU_ADDRESS 0x3fd888 BYTE_ORDER MSB_LAST FORMAT "%7.2" /end MEASUREMENT
/begin MEASUREMENT map_min "minimum allowed manifold pressure" UWORD _CNV_A_R_LINEAR_____49_CM 1 100. 0. 5434. DISPLAY_IDENTIFIER MAP_MIN ECU_ADDRESS 0x3fd88a BYTE_ORDER MSB_LAST FORMAT "%7.2" /end MEASUREMENT
/begin CHARACTERISTIC lc_maf_min_pu_dri "Configuration switch" VALUE 0x00f56 _REC_VAL_20_u1 1. _CNV_S_2_RANGE______5_CM 0. 1. DISPLAY_IDENTIFIER LC_MAF_MIN_PU_DRI /end CHARACTERISTIC
/begin CHARACTERISTIC lc_tq_lim_inh "logical constant inhibition torque intervetion for safety in general" VALUE 0x11fda _REC_VAL_20_u1 1. _CNV_A_R_LINEAR_____1_CM 0. 1. DISPLAY_IDENTIFIER LC_TQ_LIM_INH FORMAT "%2.0" /end CHARACTERISTIC
/begin CHARACTERISTIC lc_tq_lim_inh_fast "logical constant inhibition torque intervetion for safety for fast path" VALUE 0x11fdb _REC_VAL_20_u1 1. _CNV_A_R_LINEAR_____1_CM 0. 1. DISPLAY_IDENTIFIER LC_TQ_LIM_INH_FAST FORMAT "%2.0" /end CHARACTERISTIC
/begin CHARACTERISTIC lc_tq_lim_inh_slow "logical constant inhibition torque intervetion for safety for slow path" VALUE 0x11fdc _REC_VAL_20_u1 1. _CNV_A_R_LINEAR_____1_CM 0. 1. DISPLAY_IDENTIFIER LC_TQ_LIM_INH_SLOW FORMAT "%2.0" /end CHARACTERISTIC
/begin CHARACTERISTIC c_tqi_req_lim_pas "Maximum positive gradient of the requested torque TQI_REQ_LIM" VALUE 0x120ee _REC_VAL_20_u2 1023.96875 _CNV_A_R_LINEAR_____55_CM 0. 1023.96875 DISPLAY_IDENTIFIER C_TQI_REQ_LIM_PAS FORMAT "%7.2" /end CHARACTERISTIC
/begin CHARACTERISTIC c_tq_lim_inc "Maximum positive gradient of the requested torque TQI_REQ_LIM" VALUE 0x120ea _REC_VAL_20_u2 1023.96875 _CNV_A_R_LINEAR_____55_CM 0. 1023.96875 DISPLAY_IDENTIFIER C_TQ_LIM_INC FORMAT "%7.2" /end CHARACTERISTIC
/begin CHARACTERISTIC c_tq_lim_dec "Maximum negative gradient of the requested torque TQI_REQ_LIM" VALUE 0x120e8 _REC_VAL_20_u2 1023.96875 _CNV_A_R_LINEAR_____55_CM 0. 1023.96875 DISPLAY_IDENTIFIER C_TQ_LIM_DEC FORMAT "%7.2" /end CHARACTERISTIC
/begin CHARACTERISTIC c_t_tq_lim_intv "Time after active torque intervention to reset LV_TQ_LIM_INTV" VALUE 0x120e6 _REC_VAL_20_u2 2621.4 _CNV_A_R_LINEAR_____41_CM 0. 2621.4 DISPLAY_IDENTIFIER C_T_TQ_LIM_INTV FORMAT "%7.2" /end CHARACTERISTIC
/begin CHARACTERISTIC ip_tqi_dif_lim "Torque after torque interventionj to reset LV_TQ_LIM_INTV" MAP 0x1219a _REC_MAP_20_u2_u1_u1 2047.96875 _CNV_A_R_LINEAR_____186_CM -1024. 1023.96875 DISPLAY_IDENTIFIER IP_TQI_DIF_LIM FORMAT "%6.2"
 /begin AXIS_DESCR COM_AXIS n_32 _CNV_A_R_LINEAR_____16_CM 4 0. 8160. FORMAT "%4.0" AXIS_PTS_REF ldp_n_32__tqi_dif_lim /end AXIS_DESCR
 /begin AXIS_DESCR COM_AXIS tqi_sp_mon _CNV_A_R_LINEAR_____101_CM 4 0. 510. FORMAT "%3.0" AXIS_PTS_REF ldp_tqi_sp_mon__tqi_dif_lim /end AXIS_DESCR
/end CHARACTERISTIC
/begin AXIS_PTS ldp_n_32__tqi_dif_lim "" 0x1202a n_32 _REC_AXS_20_u1 8160. _CNV_A_R_LINEAR_____16_CM 4 0. 8160. DISPLAY_IDENTIFIER LDP_N_32__TQI_DIF_LIM FORMAT "%4.0" /end AXIS_PTS
/begin AXIS_PTS ldp_tqi_sp_mon__tqi_dif_lim "" 0x120c9 tqi_sp_mon _REC_AXS_20_u1 510. _CNV_A_R_LINEAR_____101_CM 4 0. 510. DISPLAY_IDENTIFIER LDP_TQI_SP_MON__TQI_DIF_LIM FORMAT "%3.0" /end AXIS_PTS
/begin MEASUREMENT t_tq_lim_intv "Time counter after transition LV_TQ_INTV_ACT 1-->0 to set LV_TQ_LIM_INTV = 0" UWORD _CNV_A_R_LINEAR_____41_CM 1 100. 0. 2621.4 DISPLAY_IDENTIFIER T_TQ_LIM_INTV ECU_ADDRESS 0x3fd9fa BYTE_ORDER MSB_LAST FORMAT "%7.2" /end MEASUREMENT
/begin MEASUREMENT sum_tqi_req_lim "Event counter of active torque limitations" UWORD _CNV_A_R_LINEAR_____1_CM 1 100. 0. 65535. DISPLAY_IDENTIFIER SUM_TQI_REQ_LIM ECU_ADDRESS 0x3fd9f0 BYTE_ORDER MSB_LAST FORMAT "%5.0" /end MEASUREMENT
/begin MEASUREMENT tqi_req_lim_4 "Intermediate value 4 for requested torque for safety" SWORD _CNV_A_R_LINEAR_____55_CM 1 100. -1024. 1023.96875 DISPLAY_IDENTIFIER TQI_REQ_LIM_4 ECU_ADDRESS 0x3fda06 BYTE_ORDER MSB_LAST FORMAT "%6.2" /end MEASUREMENT
/begin MEASUREMENT tqi_req_lim_slow "???" SWORD _CNV_A_R_LINEAR_____55_CM 1 100. -1024. 1023.96875 DISPLAY_IDENTIFIER TQI_REQ_LIM_SLOW ECU_ADDRESS 0x3fd9f8 BYTE_ORDER MSB_LAST FORMAT "%8.2" /end MEASUREMENT
/begin MEASUREMENT tqi_req_lim_3 "Intermediate value 3 for requested torque for safety" SWORD _CNV_A_R_LINEAR_____55_CM 1 100. -1024. 1023.96875 DISPLAY_IDENTIFIER TQI_REQ_LIM_3 ECU_ADDRESS 0x3fda04 BYTE_ORDER MSB_LAST FORMAT "%6.2" /end MEASUREMENT
/begin MEASUREMENT lv_tq_lim_intv "Bit for torque intervention for safety active" UBYTE _CNV_S_2_RANGE______5_CM 1 100. 0. 1. DISPLAY_IDENTIFIER LV_TQ_LIM_INTV ECU_ADDRESS 0x3fe5cb BIT_MASK 0x1 /end MEASUREMENT
/begin MEASUREMENT tqi_req_lim_1 "Intermediate value 1 for requested torque for safety" SWORD _CNV_A_R_LINEAR_____55_CM 1 100. -1024. 1023.96875 DISPLAY_IDENTIFIER TQI_REQ_LIM_1 ECU_ADDRESS 0x3fda00 BYTE_ORDER MSB_LAST FORMAT "%6.2" /end MEASUREMENT
/begin MEASUREMENT tqi_req_lim_2 "Intermediate value 2 for requested torque for safety" SWORD _CNV_A_R_LINEAR_____55_CM 1 100. -1024. 1023.96875 DISPLAY_IDENTIFIER TQI_REQ_LIM_2 ECU_ADDRESS 0x3fda02 BYTE_ORDER MSB_LAST FORMAT "%6.2" /end MEASUREMENT
/begin MEASUREMENT tqi_dif_lim "Torque offset for regnition torque intervention active" SWORD _CNV_A_R_LINEAR_____55_CM 1 100. -1024. 1023.96875 DISPLAY_IDENTIFIER TQI_DIF_LIM ECU_ADDRESS 0x3fd9fe BYTE_ORDER MSB_LAST FORMAT "%6.2" /end MEASUREMENT
/begin MEASUREMENT t_tqi_req_lim "incremented time counter after transition LV_TQ_LIM_INTV_\" 0 -> 1 to set LV_TQ_LIM_INTV = 0" UWORD _CNV_A_R_LINEAR_____41_CM 1 100. 0. 2621.4 DISPLAY_IDENTIFIER T_TQI_REQ_LIM ECU_ADDRESS 0x3fd9fc BYTE_ORDER MSB_LAST FORMAT "%7.2" /end MEASUREMENT
/begin MEASUREMENT t_tqi_req_lim_max "max time counter after transition LV_TQ_LIM_INTV_\" 0 -> 1 to set LV_TQ_LIM_INTV = 0" UWORD _CNV_A_R_LINEAR_____41_CM 1 100. 0. 2621.4 DISPLAY_IDENTIFIER T_TQI_REQ_LIM_MAX ECU_ADDRESS 0x3fd9f2 BYTE_ORDER MSB_LAST FORMAT "%7.2" /end MEASUREMENT
/begin MEASUREMENT tqi_req_lim_fast "???" SWORD _CNV_A_R_LINEAR_____55_CM 1 100. -1024. 1023.96875 DISPLAY_IDENTIFIER TQI_REQ_LIM_FAST ECU_ADDRESS 0x3fd9f6 BYTE_ORDER MSB_LAST FORMAT "%8.2" /end MEASUREMENT
/begin MEASUREMENT tqi_req_lim_dif "difference of torque request for safety" SWORD _CNV_A_R_LINEAR_____55_CM 1 100. -1024. 1023.96875 DISPLAY_IDENTIFIER TQI_REQ_LIM_DIF ECU_ADDRESS 0x3fda08 BYTE_ORDER MSB_LAST FORMAT "%8.2" /end MEASUREMENT
/begin MEASUREMENT tqi_req_lim_dif_max "max. difference of torque request for safety" SWORD _CNV_A_R_LINEAR_____55_CM 1 100. -1024. 1023.96875 DISPLAY_IDENTIFIER TQI_REQ_LIM_DIF_MAX ECU_ADDRESS 0x3fd9f4 BYTE_ORDER MSB_LAST FORMAT "%8.2" /end MEASUREMENT
/begin MEASUREMENT lv_tq_lim_intv_1 "Result for TQI_AV > TQI_SP_MON" UBYTE _CNV_S_2_RANGE______5_CM 1 100. 0. 1. DISPLAY_IDENTIFIER LV_TQ_LIM_INTV_1 ECU_ADDRESS 0x3fe5cd BIT_MASK 0x1 /end MEASUREMENT
/begin MEASUREMENT lv_tq_lim_intv_2 "ON-Delayed (40 ms) result for TQI_AV > TQI_SP_MON" UBYTE _CNV_S_2_RANGE______5_CM 1 100. 0. 1. DISPLAY_IDENTIFIER LV_TQ_LIM_INTV_2 ECU_ADDRESS 0x3fe5cf BIT_MASK 0x1 /end MEASUREMENT
/begin MEASUREMENT tqi_req_lim_dif_ofs "Permitted deviation offset" UWORD _CNV_A_R_LINEAR_____55_CM 1 100. 0. 255. DISPLAY_IDENTIFIER TQI_REQ_LIM_DIF_OFS ECU_ADDRESS 0x3fda0a BYTE_ORDER MSB_LAST FORMAT "%7.3" /end MEASUREMENT
/begin CHARACTERISTIC c_tqi_dif_lim_max_ofs "Offset after start condition" VALUE 0x120ec _REC_VAL_20_u2 255. _CNV_A_R_LINEAR_____55_CM 0. 255. DISPLAY_IDENTIFIER C_TQI_DIF_LIM_MAX_OFS FORMAT "%7.3" /end CHARACTERISTIC
/begin CHARACTERISTIC c_dec_tqi_lim_dif_max "Decrement after start condition" VALUE 0x120d4 _REC_VAL_20_u2 254. _CNV_A_R_LINEAR_____55_CM 1. 255. DISPLAY_IDENTIFIER C_DEC_TQI_LIM_DIF_MAX FORMAT "%7.3" /end CHARACTERISTIC
/begin MEASUREMENT tq_add_tra_1 "Torque lead output from map IP_TQ_ADD_TRA for transient torque" SWORD _CNV_A_R_LINEAR_____55_CM 1 100. -1024. 1023.96875 DISPLAY_IDENTIFIER TQ_ADD_TRA_1 ECU_ADDRESS 0x3fd8d8 BYTE_ORDER MSB_LAST FORMAT "%6.2" /end MEASUREMENT
/begin MEASUREMENT tq_add_tra_2 "Torque reserve output from map IP_FAC_TQ_REQ_DIF_TRA  for transient torque" SWORD _CNV_A_R_LINEAR_____55_CM 1 100. -1024. 1023.96875 DISPLAY_IDENTIFIER TQ_ADD_TRA_2 ECU_ADDRESS 0x3fd8da BYTE_ORDER MSB_LAST FORMAT "%6.2" /end MEASUREMENT
/begin MEASUREMENT fac_tq_tra "Weighting factor for TQ_REQ_DIF_TRA" UWORD _CNV_A_R_LINEAR_____378_CM 1 100. 0. 31.99951171875 DISPLAY_IDENTIFIER FAC_TQ_TRA ECU_ADDRESS 0x3fd8d6 BYTE_ORDER MSB_LAST FORMAT "%7.4" /end MEASUREMENT
/begin CHARACTERISTIC ip_tq_add_tra__n_32 "Torque lead at transient torque conditions" CURVE 0x0fa9e _REC_CUR_20_u2_u1 1023.96875 _CNV_A_R_LINEAR_____55_CM 0. 1023.96875 DISPLAY_IDENTIFIER IP_TQ_ADD_TRA__N_32 FORMAT "%7.2"
 /begin AXIS_DESCR COM_AXIS n_32 _CNV_A_R_LINEAR_____16_CM 8 0. 8160. FORMAT "%4.0" AXIS_PTS_REF ldp_n_32_tq_add_tra /end AXIS_DESCR
/end CHARACTERISTIC
/begin CHARACTERISTIC ip_fac_tq_tra__tq_req_dif_tra "Torque reserve at transient torque conditions" CURVE 0x0b718 _REC_CUR_20_u2_u2 31.99951171875 _CNV_A_R_LINEAR_____378_CM 0. 31.99951171875 DISPLAY_IDENTIFIER IP_FAC_TQ_TRA__TQ_REQ_DIF_TRA FORMAT "%7.4"
 /begin AXIS_DESCR COM_AXIS tq_req_dif_tra _CNV_A_R_LINEAR_____55_CM 6 0. 1023.96875 FORMAT "%7.2" AXIS_PTS_REF ldp_tq_req_dif_tra_fac_tq_tra /end AXIS_DESCR
/end CHARACTERISTIC
/begin MEASUREMENT tq_add_tra "Torque lead for transient trorque" SWORD _CNV_A_R_LINEAR_____55_CM 1 100. -1024. 1023.96875 DISPLAY_IDENTIFIER TQ_ADD_TRA ECU_ADDRESS 0x3fd8d4 BYTE_ORDER MSB_LAST FORMAT "%6.2" /end MEASUREMENT
/begin AXIS_PTS ldp_n_32_tq_add_tra "" 0x07ca3 n_32 _REC_AXS_20_u1 8160. _CNV_A_R_LINEAR_____16_CM 8 0. 8160. DISPLAY_IDENTIFIER LDP_N_32_TQ_ADD_TRA FORMAT "%4.0" /end AXIS_PTS
/begin AXIS_PTS ldp_tq_req_dif_tra_fac_tq_tra "" 0x1135e tq_req_dif_tra _REC_AXS_20_u2 1023.96875 _CNV_A_R_LINEAR_____55_CM 6 0. 1023.96875 DISPLAY_IDENTIFIER LDP_TQ_REQ_DIF_TRA_FAC_TQ_TRA FORMAT "%7.2" /end AXIS_PTS
/begin MEASUREMENT tq_loss_pste "Summary Engine Torque losses power steering" SWORD _CNV_A_R_LINEAR_____55_CM 1 100. -1024. 1023.96875 DISPLAY_IDENTIFIER TQ_LOSS_PSTE ECU_ADDRESS 0x3fd8dc BYTE_ORDER MSB_LAST FORMAT "%8.2" /end MEASUREMENT
/begin MEASUREMENT lv_pste_disable "LV for disabling PSTE intervention due to EMS error" UBYTE _CNV_S_2_RANGE______0_CM 1 100. 0. 1. DISPLAY_IDENTIFIER LV_PSTE_DISABLE ECU_ADDRESS 0x3fe55a /end MEASUREMENT
/begin MEASUREMENT lv_pste_disable_can "LV for disabling PSTE intervention due to CAN error" UBYTE _CNV_S_2_RANGE______0_CM 1 100. 0. 1. DISPLAY_IDENTIFIER LV_PSTE_DISABLE_CAN ECU_ADDRESS 0x3fe559 /end MEASUREMENT
/begin MEASUREMENT lv_pste_ena "LV for enabling PSTE intervention" UBYTE _CNV_S_2_RANGE______0_CM 1 100. 0. 1. DISPLAY_IDENTIFIER LV_PSTE_ENA ECU_ADDRESS 0x3fe55b /end MEASUREMENT
/begin CHARACTERISTIC lc_pste_ena "Logical constant for enabling of power steering" VALUE 0x00f68 _REC_VAL_20_u1 1. _CNV_A_R_LINEAR_____22_CM 0. 1. DISPLAY_IDENTIFIER LC_PSTE_ENA FORMAT "%1.0" /end CHARACTERISTIC
/begin MEASUREMENT tq_add_pste "Engine torque reserve for power steering" SWORD _CNV_A_R_LINEAR_____55_CM 1 100. -1024. 1023.96875 DISPLAY_IDENTIFIER TQ_ADD_PSTE ECU_ADDRESS 0x3fd8de BYTE_ORDER MSB_LAST FORMAT "%8.2" /end MEASUREMENT
/begin CHARACTERISTIC ip_tq_loss_pste "Power steering torque loss versus engine-speed" MAP 0x0ff02 _REC_MAP_20_u2_u2_u2 2047.96875 _CNV_A_R_LINEAR_____186_CM -1024. 1023.96875 DISPLAY_IDENTIFIER IP_TQ_LOSS_PSTE FORMAT "%6.2"
 /begin AXIS_DESCR COM_AXIS ang_pste _CNV_A_R_LINEAR_____476_CM 8 -1439.98976 1439.945815 FORMAT "%8.2" AXIS_PTS_REF ldp_ang_pste__tq_loss_pste /end AXIS_DESCR
 /begin AXIS_DESCR COM_AXIS vel_ang_pste _CNV_A_R_LINEAR_____477_CM 8 -1439.98976 1439.945815 FORMAT "%8.2" AXIS_PTS_REF ldp_vel_ang_pste__tq_loss_pste /end AXIS_DESCR
/end CHARACTERISTIC
/begin CHARACTERISTIC ip_tq_add_pste "Power steering torque reserve depending on engine-speed" CURVE 0x0fa4e _REC_CUR_20_u2_u2 1023.96875 _CNV_A_R_LINEAR_____55_CM 0. 1023.96875 DISPLAY_IDENTIFIER IP_TQ_ADD_PSTE FORMAT "%7.2"
 /begin AXIS_DESCR COM_AXIS ang_pste _CNV_A_R_LINEAR_____476_CM 8 -1439.98976 1439.945815 FORMAT "%8.2" AXIS_PTS_REF ldp_ang_pste__tq_add_pste /end AXIS_DESCR
/end CHARACTERISTIC
/begin CHARACTERISTIC ip_fac_tq_loss_pste "Factor weighting the torque request" CURVE 0x00bf4 _REC_CUR_20_u1_u2 3.984375 _CNV_A_R_LINEAR_____127_CM 0. 3.984375 DISPLAY_IDENTIFIER IP_FAC_TQ_LOSS_PSTE FORMAT "%4.2"
 /begin AXIS_DESCR COM_AXIS n _CNV_A_R_LINEAR_____11_CM 8 0. 8160. FORMAT "%4.0" AXIS_PTS_REF ldp_n__fac_tq_add_pste /end AXIS_DESCR
/end CHARACTERISTIC
/begin AXIS_PTS ldp_ang_pste__tq_loss_pste "" 0x1091a ang_pste _REC_AXS_20_u2 2879.935575 _CNV_A_R_LINEAR_____476_CM 8 -1439.98976 1439.945815 DISPLAY_IDENTIFIER LDP_ANG_PSTE__TQ_LOSS_PSTE FORMAT "%8.2" /end AXIS_PTS
/begin AXIS_PTS ldp_vel_ang_pste__tq_loss_pste "" 0x114d2 vel_ang_pste _REC_AXS_20_u2 2879.935575 _CNV_A_R_LINEAR_____477_CM 8 -1439.98976 1439.945815 DISPLAY_IDENTIFIER LDP_VEL_ANG_PSTE__TQ_LOSS_PSTE FORMAT "%8.2" /end AXIS_PTS
/begin AXIS_PTS ldp_ang_pste__tq_add_pste "" 0x10908 ang_pste _REC_AXS_20_u2 2879.935575 _CNV_A_R_LINEAR_____476_CM 8 -1439.98976 1439.945815 DISPLAY_IDENTIFIER LDP_ANG_PSTE__TQ_ADD_PSTE FORMAT "%8.2" /end AXIS_PTS
/begin AXIS_PTS ldp_n__fac_tq_add_pste "" 0x10e94 n _REC_AXS_20_u2 8160. _CNV_A_R_LINEAR_____11_CM 8 0. 8160. DISPLAY_IDENTIFIER LDP_N__FAC_TQ_ADD_PSTE FORMAT "%4.0" /end AXIS_PTS
/begin MEASUREMENT tq_loss_pste_1 "Engine Torque losses power steering" SWORD _CNV_A_R_LINEAR_____55_CM 1 100. -1024. 1023.96875 DISPLAY_IDENTIFIER TQ_LOSS_PSTE_1 ECU_ADDRESS 0x3fd8e0 BYTE_ORDER MSB_LAST FORMAT "%8.2" /end MEASUREMENT
/begin MEASUREMENT lv_pste_2_disable "LV for disabling PSTE_2 intervention due to EMS error" UBYTE _CNV_S_2_RANGE______0_CM 1 100. 0. 1. DISPLAY_IDENTIFIER LV_PSTE_2_DISABLE ECU_ADDRESS 0x3fe55d /end MEASUREMENT
/begin MEASUREMENT lv_pste_2_disable_can "LV for disabling PSTE_2 intervention due to CAN error" UBYTE _CNV_S_2_RANGE______0_CM 1 100. 0. 1. DISPLAY_IDENTIFIER LV_PSTE_2_DISABLE_CAN ECU_ADDRESS 0x3fe55c /end MEASUREMENT
/begin MEASUREMENT lv_pste_2_ena "LV for enabling PSTE_2 intervention" UBYTE _CNV_S_2_RANGE______0_CM 1 100. 0. 1. DISPLAY_IDENTIFIER LV_PSTE_2_ENA ECU_ADDRESS 0x3fe55e /end MEASUREMENT
/begin MEASUREMENT tq_loss_pste_2_av "Engine Torque losses active front steering active value" SWORD _CNV_A_R_LINEAR_____55_CM 1 100. -1024. 1023.96875 DISPLAY_IDENTIFIER TQ_LOSS_PSTE_2_AV ECU_ADDRESS 0x3fd8e6 BYTE_ORDER MSB_LAST FORMAT "%8.2" /end MEASUREMENT
/begin MEASUREMENT tq_loss_pste_2_sp "Engine Torque losses active front steering set point" SWORD _CNV_A_R_LINEAR_____55_CM 1 100. -1024. 1023.96875 DISPLAY_IDENTIFIER TQ_LOSS_PSTE_2_SP ECU_ADDRESS 0x3fd8e4 BYTE_ORDER MSB_LAST FORMAT "%8.2" /end MEASUREMENT
/begin MEASUREMENT tq_loss_pste_2_dif "Engine Torque losses active front steering difference" SWORD _CNV_A_R_LINEAR_____55_CM 1 100. -1024. 1023.96875 DISPLAY_IDENTIFIER TQ_LOSS_PSTE_2_DIF ECU_ADDRESS 0x3fd8e8 BYTE_ORDER MSB_LAST FORMAT "%8.2" /end MEASUREMENT
/begin MEASUREMENT tq_loss_pste_2_grd "Engine Torque losses active front steering gradient" SWORD _CNV_A_R_LINEAR_____202_CM 1 100. -1024. 1023.96875 DISPLAY_IDENTIFIER TQ_LOSS_PSTE_2_GRD ECU_ADDRESS 0x3fd8ea BYTE_ORDER MSB_LAST FORMAT "%8.2" /end MEASUREMENT
/begin MEASUREMENT tq_loss_pste_2 "Engine Torque losses active front steering" SWORD _CNV_A_R_LINEAR_____55_CM 1 100. -1024. 1023.96875 DISPLAY_IDENTIFIER TQ_LOSS_PSTE_2 ECU_ADDRESS 0x3fd8e2 BYTE_ORDER MSB_LAST FORMAT "%8.2" /end MEASUREMENT
/begin MEASUREMENT t_pste_2 "SP AV Timer PSTE_2" UBYTE _CNV_A_R_LINEAR_____4_CM 1 100. 0. 2.55 DISPLAY_IDENTIFIER T_PSTE_2 ECU_ADDRESS 0x3fe55f FORMAT "%4.2" /end MEASUREMENT
/begin CHARACTERISTIC lc_pste_2_ena "Logical constant for inhibitation of active power steering" VALUE 0x00f67 _REC_VAL_20_u1 1. _CNV_A_R_LINEAR_____22_CM 0. 1. DISPLAY_IDENTIFIER LC_PSTE_2_ENA FORMAT "%1.0" /end CHARACTERISTIC
/begin AXIS_PTS ldpm_n_32__pste_2 "" 0x08089 n_32 _REC_AXS_20_u1 8160. _CNV_A_R_LINEAR_____16_CM 8 0. 8160. DISPLAY_IDENTIFIER LDPM_N_32__PSTE_2 FORMAT "%4.0" /end AXIS_PTS
/begin AXIS_PTS ldpm_t_pste_2__pste_2 "" 0x08178 t_pste_2 _REC_AXS_20_u1 2.55 _CNV_A_R_LINEAR_____4_CM 8 0. 2.55 DISPLAY_IDENTIFIER LDPM_T_PSTE_2__PSTE_2 FORMAT "%4.2" /end AXIS_PTS
/begin CHARACTERISTIC ip_fac_tq_loss_pste_2_sp "Active power steering torque loss correction SP" MAP 0x0562c _REC_MAP_20_u1_u1_u1 3.984375 _CNV_A_R_LINEAR_____478_CM -2. 1.984375 DISPLAY_IDENTIFIER IP_FAC_TQ_LOSS_PSTE_2_SP FORMAT "%5.2"
 /begin AXIS_DESCR COM_AXIS n_32 _CNV_A_R_LINEAR_____16_CM 8 0. 8160. FORMAT "%4.0" AXIS_PTS_REF ldpm_n_32__pste_2 /end AXIS_DESCR
 /begin AXIS_DESCR COM_AXIS t_pste_2 _CNV_A_R_LINEAR_____4_CM 8 0. 2.55 FORMAT "%4.2" AXIS_PTS_REF ldpm_t_pste_2__pste_2 /end AXIS_DESCR
/end CHARACTERISTIC
/begin CHARACTERISTIC ip_fac_tq_loss_pste_2_av "Active power steering torque loss correction AV" MAP 0x055ec _REC_MAP_20_u1_u1_u1 3.984375 _CNV_A_R_LINEAR_____478_CM -2. 1.984375 DISPLAY_IDENTIFIER IP_FAC_TQ_LOSS_PSTE_2_AV FORMAT "%5.2"
 /begin AXIS_DESCR COM_AXIS n_32 _CNV_A_R_LINEAR_____16_CM 8 0. 8160. FORMAT "%4.0" AXIS_PTS_REF ldpm_n_32__pste_2 /end AXIS_DESCR
 /begin AXIS_DESCR COM_AXIS t_pste_2 _CNV_A_R_LINEAR_____4_CM 8 0. 2.55 FORMAT "%4.2" AXIS_PTS_REF ldpm_t_pste_2__pste_2 /end AXIS_DESCR
/end CHARACTERISTIC
/begin CHARACTERISTIC c_fac_tq_loss_pste_2_grd "Correction value gradient" VALUE 0x006df _REC_VAL_20_u1 0.159375 _CNV_A_R_LINEAR_____478_CM -2. 1.984375 DISPLAY_IDENTIFIER C_FAC_TQ_LOSS_PSTE_2_GRD FORMAT "%5.2" /end CHARACTERISTIC
/begin CHARACTERISTIC c_fac_tq_loss_pste_2_dif "Correction value differences" VALUE 0x006de _REC_VAL_20_u1 0.159375 _CNV_A_R_LINEAR_____478_CM -2. 1.984375 DISPLAY_IDENTIFIER C_FAC_TQ_LOSS_PSTE_2_DIF FORMAT "%5.2" /end CHARACTERISTIC
/begin CHARACTERISTIC c_tq_loss_pste_2_sp_min "Min torque threshold for timer reset" VALUE 0x004a8 _REC_VAL_20_s2 81.91875 _CNV_A_R_LINEAR_____55_CM -1024. 1023.96875 DISPLAY_IDENTIFIER C_TQ_LOSS_PSTE_2_SP_MIN FORMAT "%8.2" /end CHARACTERISTIC
/begin MEASUREMENT lv_ivvt_in_and_ex "LV  IVVT inlet and exhaust cam (0 = inlet cam variable, 1 = inlet & exhaust cam variable) " UBYTE _CNV_S_2_RANGE______0_CM 1 100. 0. 1. DISPLAY_IDENTIFIER LV_IVVT_IN_AND_EX ECU_ADDRESS 0x3fe1a0 /end MEASUREMENT
/begin MEASUREMENT cam_type "CAM type" UBYTE _CNV_S_3_RANGE_CAM__480_CM 1 100. 0. 2. DISPLAY_IDENTIFIER CAM_TYPE ECU_ADDRESS 0x3fe199 /end MEASUREMENT
/begin MEASUREMENT lv_inj_conf "LV injection configuration (0 = intake manifold injection, 1 = direct injection) " UBYTE _CNV_S_2_RANGE______5_CM 1 100. 0. 1. DISPLAY_IDENTIFIER LV_INJ_CONF ECU_ADDRESS 0x3fe1a1 /end MEASUREMENT
/begin MEASUREMENT lv_isa_conf "logical variable idle speed actuator configuration (0=no idle speed actuator, 1=idle speed actuator)" UBYTE _CNV_S_2_RANGE______5_CM 1 100. 0. 1. DISPLAY_IDENTIFIER LV_ISA_CONF ECU_ADDRESS 0x3fe1a2 /end MEASUREMENT
/begin MEASUREMENT lv_var_st "variant of starting mode" UBYTE _CNV_S_2_RANGE______5_CM 1 100. 0. 1. DISPLAY_IDENTIFIER LV_VAR_ST ECU_ADDRESS 0x3fe1a5 BIT_MASK 0x1 /end MEASUREMENT
/begin CHARACTERISTIC c_var_st "variant for EBOX cooling fan" VALUE 0x0091d _REC_VAL_20_u1 1. _CNV_A_R_LINEAR_____1_CM 0. 1. DISPLAY_IDENTIFIER C_VAR_ST FORMAT "%2.0" /end CHARACTERISTIC
/begin MEASUREMENT eng_conf "state of engine configuration code" UBYTE _CNV_S_3_RANGE_ENG__481_CM 1 100. 0. 2. DISPLAY_IDENTIFIER ENG_CONF ECU_ADDRESS 0x3fe19a /end MEASUREMENT
/begin MEASUREMENT vim_type "VI)M configuration" UBYTE _CNV_S_2_RANGE_VIM__482_CM 1 100. 0. 1. DISPLAY_IDENTIFIER VIM_TYPE ECU_ADDRESS 0x3fe19b /end MEASUREMENT
/begin CHARACTERISTIC c_eng_conf "engine configuration code" VALUE 0x006b7 _REC_VAL_20_u1 2. _CNV_S_3_RANGE_ENG__481_CM 0. 2. DISPLAY_IDENTIFIER C_ENG_CONF /end CHARACTERISTIC
/begin MEASUREMENT lv_var_msw "LV MSW detected" UBYTE _CNV_S_2_RANGE______5_CM 1 100. 0. 1. DISPLAY_IDENTIFIER LV_VAR_MSW ECU_ADDRESS 0x3fe1a4 BIT_MASK 0x1 /end MEASUREMENT
/begin MEASUREMENT lv_var_sof "variant of sound-flap" UBYTE _CNV_S_2_RANGE______5_CM 1 100. 0. 1. DISPLAY_IDENTIFIER LV_VAR_SOF ECU_ADDRESS 0x3fe1b0 BIT_MASK 0x1 /end MEASUREMENT
/begin MEASUREMENT lv_cbk_mpl "LV  multiple cylinder banks (0 = single bank, 1 = multiple banks) " UBYTE _CNV_S_2_RANGE______5_CM 1 100. 0. 1. DISPLAY_IDENTIFIER LV_CBK_MPL ECU_ADDRESS 0x3fe19f /end MEASUREMENT
/begin CHARACTERISTIC c_conf_swi_efp_out "configuration bit for EFP-control" VALUE 0x0060e _REC_VAL_20_u1 2. _CNV_A_R_LINEAR_____1_CM 0. 2. DISPLAY_IDENTIFIER C_CONF_SWI_EFP_OUT FORMAT "%2.0" /end CHARACTERISTIC
/begin MEASUREMENT conf_oil_level_sens "configuration of EFP-control" UBYTE _CNV_A_R_LINEAR_____1_CM 1 100. 0. 2. DISPLAY_IDENTIFIER CONF_OIL_LEVEL_SENS ECU_ADDRESS 0x3fe19d FORMAT "%2.0" /end MEASUREMENT
/begin CHARACTERISTIC c_conf_dmtl "" VALUE 0x0060b _REC_VAL_20_u1 1. _CNV_A_R_LINEAR_____1_CM 0. 1. DISPLAY_IDENTIFIER C_CONF_DMTL FORMAT "%2.0" /end CHARACTERISTIC
/begin MEASUREMENT lv_conf_dmtl "configuration of DMTL" UBYTE _CNV_S_2_RANGE______5_CM 1 100. 0. 1. DISPLAY_IDENTIFIER LV_CONF_DMTL ECU_ADDRESS 0x3fe1aa BIT_MASK 0x1 /end MEASUREMENT
/begin MEASUREMENT lv_sof_conf "logical variable idle speed actuator" UBYTE _CNV_S_2_RANGE______5_CM 1 100. 0. 1. DISPLAY_IDENTIFIER LV_SOF_CONF ECU_ADDRESS 0x3fe1a3 /end MEASUREMENT
/begin MEASUREMENT conf_sof_swi "Configuration of sport-switch" UBYTE _CNV_S_3_STATE_CONF_483_CM 1 100. 0. 2. DISPLAY_IDENTIFIER CONF_SOF_SWI ECU_ADDRESS 0x3fe19e /end MEASUREMENT
/begin CHARACTERISTIC c_v_var_amp_thd_min "Minimum voltage threshold for enquiry of pressure sensor detecting component configuration" VALUE 0x019ce _REC_VAL_20_u2 4.99511719 _CNV_A_R_LINEAR_____3_CM 0. 4.99511719 DISPLAY_IDENTIFIER C_V_VAR_AMP_THD_MIN FORMAT "%5.3" /end CHARACTERISTIC
/begin CHARACTERISTIC c_v_var_amp_thd_max "Maximum voltage threshold for enquiry of pressure sensor detecting component configuration" VALUE 0x019cc _REC_VAL_20_u2 4.99511719 _CNV_A_R_LINEAR_____3_CM 0. 4.99511719 DISPLAY_IDENTIFIER C_V_VAR_AMP_THD_MAX FORMAT "%5.3" /end CHARACTERISTIC
/begin MEASUREMENT lv_var_ecras "variant for ECRAS" UBYTE _CNV_S_2_RANGE______5_CM 1 100. 0. 1. DISPLAY_IDENTIFIER LV_VAR_ECRAS ECU_ADDRESS 0x3fe1a7 BIT_MASK 0x1 /end MEASUREMENT
/begin MEASUREMENT lv_var_sap "variant for secondary air pump" UBYTE _CNV_S_2_RANGE______5_CM 1 100. 0. 1. DISPLAY_IDENTIFIER LV_VAR_SAP ECU_ADDRESS 0x3fe1a8 BIT_MASK 0x1 /end MEASUREMENT
/begin CHARACTERISTIC c_conf_oil_level_sens "configuration bit for EFP - control" VALUE 0x0060d _REC_VAL_20_u1 2. _CNV_A_R_LINEAR_____1_CM 0. 2. DISPLAY_IDENTIFIER C_CONF_OIL_LEVEL_SENS FORMAT "%2.0" /end CHARACTERISTIC
/begin CHARACTERISTIC c_conf_cat "configuration bit for CAT/exahaust type" VALUE 0x00609 _REC_VAL_20_u1 2. _CNV_A_R_LINEAR_____1_CM 0. 2. DISPLAY_IDENTIFIER C_CONF_CAT FORMAT "%2.0" /end CHARACTERISTIC
/begin MEASUREMENT lv_var_ef "variant for exhaust flap" UBYTE _CNV_S_2_RANGE______5_CM 1 100. 0. 1. DISPLAY_IDENTIFIER LV_VAR_EF ECU_ADDRESS 0x3fe1a9 BIT_MASK 0x1 /end MEASUREMENT
/begin MEASUREMENT lv_var_lsh_up "variant for CAT/exahust type" UBYTE _CNV_S_2_RANGE______5_CM 1 100. 0. 1. DISPLAY_IDENTIFIER LV_VAR_LSH_UP ECU_ADDRESS 0x3fe1ae BIT_MASK 0x1 /end MEASUREMENT
/begin MEASUREMENT lv_var_lsh_down "variant for CAT/exahust type" UBYTE _CNV_S_2_RANGE______5_CM 1 100. 0. 1. DISPLAY_IDENTIFIER LV_VAR_LSH_DOWN ECU_ADDRESS 0x3fe1af BIT_MASK 0x1 /end MEASUREMENT
/begin MEASUREMENT psn_ls "OBD-communication mode01 PID13, automatic learnig of oxygen sensors" UBYTE _CNV_A_R_LINEAR_____1_CM 1 100. 0. 255. DISPLAY_IDENTIFIER PSN_LS ECU_ADDRESS 0x3fe197 FORMAT "%3.0" /end MEASUREMENT
/begin MEASUREMENT psn_ls_1 "OBD-communication mode01 PID1D, automatic learnig of oxygen sensors" UBYTE _CNV_A_R_LINEAR_____1_CM 1 100. 0. 255. DISPLAY_IDENTIFIER PSN_LS_1 ECU_ADDRESS 0x3fe198 FORMAT "%3.0" /end MEASUREMENT
/begin MEASUREMENT lv_var_ebox_cfa "variant for EBOX cooling fan" UBYTE _CNV_S_2_RANGE______5_CM 1 100. 0. 1. DISPLAY_IDENTIFIER LV_VAR_EBOX_CFA ECU_ADDRESS 0x3fe1a6 BIT_MASK 0x1 /end MEASUREMENT
/begin MEASUREMENT lv_var_rly_st "variant of starter relay recognized " UBYTE _CNV_S_2_RANGE______5_CM 1 100. 0. 1. DISPLAY_IDENTIFIER LV_VAR_RLY_ST ECU_ADDRESS 0x3fe1ac BIT_MASK 0x1 /end MEASUREMENT
/begin MEASUREMENT lv_var_sav "variant of SAV recognized" UBYTE _CNV_S_2_RANGE______5_CM 1 100. 0. 1. DISPLAY_IDENTIFIER LV_VAR_SAV ECU_ADDRESS 0x3fe1ad BIT_MASK 0x1 /end MEASUREMENT
/begin MEASUREMENT lv_var_rly_accout "variant of ACC-relay recognized" UBYTE _CNV_S_2_RANGE______5_CM 1 100. 0. 1. DISPLAY_IDENTIFIER LV_VAR_RLY_ACCOUT ECU_ADDRESS 0x3fe1ab BIT_MASK 0x1 /end MEASUREMENT
/begin MEASUREMENT B_doibdig1 "Anforderung Eintrag od. Heilung Ort 1" UBYTE _CNV_A_R_LINEAR_____22_CM 1 100. 0. 255. DISPLAY_IDENTIFIER B_DOIBDIG1 ECU_ADDRESS 0x3fab91 BIT_MASK 0x1 /end MEASUREMENT
/begin MEASUREMENT B_doibdig2 "Anforderung Eintrag od. Heilung Ort 2" UBYTE _CNV_A_R_LINEAR_____22_CM 1 100. 0. 255. DISPLAY_IDENTIFIER B_DOIBDIG2 ECU_ADDRESS 0x3fab92 BIT_MASK 0x1 /end MEASUREMENT
/begin MEASUREMENT B_doibdig3 "Anforderung Eintrag od. Heilung Ort 3" UBYTE _CNV_A_R_LINEAR_____22_CM 1 100. 0. 255. DISPLAY_IDENTIFIER B_DOIBDIG3 ECU_ADDRESS 0x3fab93 BIT_MASK 0x1 /end MEASUREMENT
/begin MEASUREMENT diberrctr1 "Entprellzaehler BSD Fehler" UBYTE _CNV_R_R_t100msxs_u_500_CM 1 100. 0. 25.5 DISPLAY_IDENTIFIER DIBERRCTR1 ECU_ADDRESS 0x3fab9c FORMAT "%8.4" /end MEASUREMENT
/begin MEASUREMENT diberrctr2 "Entprellzaehler EBSD" UBYTE _CNV_R_R_t100msxs_u_500_CM 1 100. 0. 25.5 DISPLAY_IDENTIFIER DIBERRCTR2 ECU_ADDRESS 0x3fab9d FORMAT "%8.4" /end MEASUREMENT
/begin MEASUREMENT diberrctr3 "Entprellzaehler IBS SW Fehler" UBYTE _CNV_R_R_t100msxs_u_500_CM 1 100. 0. 25.5 DISPLAY_IDENTIFIER DIBERRCTR3 ECU_ADDRESS 0x3fab9e FORMAT "%8.4" /end MEASUREMENT
/begin MEASUREMENT diberrctr4 "Entprellzaehler Stromfehler" UBYTE _CNV_R_R_t100msxs_u_500_CM 1 100. 0. 25.5 DISPLAY_IDENTIFIER DIBERRCTR4 ECU_ADDRESS 0x3fab9f FORMAT "%8.4" /end MEASUREMENT
/begin MEASUREMENT diberrctr5 "Entprellzaehler Spannungsfehler" UBYTE _CNV_R_R_t100msxs_u_500_CM 1 100. 0. 25.5 DISPLAY_IDENTIFIER DIBERRCTR5 ECU_ADDRESS 0x3faba0 FORMAT "%8.4" /end MEASUREMENT
/begin MEASUREMENT diberrctr6 "Entprellzaehler Temp.fehler" UBYTE _CNV_R_R_t100msxs_u_500_CM 1 100. 0. 25.5 DISPLAY_IDENTIFIER DIBERRCTR6 ECU_ADDRESS 0x3faba1 FORMAT "%8.4" /end MEASUREMENT
/begin MEASUREMENT diberrctr7 "Entprellzaehler IBS Systemfehler" UBYTE _CNV_R_R_t100msxs_u_500_CM 1 100. 0. 25.5 DISPLAY_IDENTIFIER DIBERRCTR7 ECU_ADDRESS 0x3faba2 FORMAT "%8.4" /end MEASUREMENT
/begin MEASUREMENT diberrctr8 "Entprellzaehler IBS KL20wu Fehler" UBYTE _CNV_R_R_t100msxs_u_500_CM 1 100. 0. 25.5 DISPLAY_IDENTIFIER DIBERRCTR8 ECU_ADDRESS 0x3faba3 FORMAT "%8.4" /end MEASUREMENT
/begin MEASUREMENT dibhealct1 "Entprellzaehler Fehlerheilung Ort 1" UBYTE _CNV_R_R_t100msxs_u_500_CM 1 100. 0. 25.5 DISPLAY_IDENTIFIER DIBHEALCT1 ECU_ADDRESS 0x3faba4 FORMAT "%8.4" /end MEASUREMENT
/begin MEASUREMENT dibhealct2 "Entprellzaehler Fehlerheilung Ort 2" UBYTE _CNV_R_R_t100msxs_u_500_CM 1 100. 0. 25.5 DISPLAY_IDENTIFIER DIBHEALCT2 ECU_ADDRESS 0x3faba5 FORMAT "%8.4" /end MEASUREMENT
/begin MEASUREMENT dibhealct3 "Entprellzaehler Fehlerheilung Ort 3" UBYTE _CNV_R_R_t100msxs_u_500_CM 1 100. 0. 25.5 DISPLAY_IDENTIFIER DIBHEALCT3 ECU_ADDRESS 0x3faba6 FORMAT "%8.4" /end MEASUREMENT
/begin MEASUREMENT ibfehlin1 "lokale Kopie Fehlerinput 1" UBYTE _CNV_A_R_LINEAR_____22_CM 1 100. 0. 255. DISPLAY_IDENTIFIER IBFEHLIN1 ECU_ADDRESS 0x3fab94 BIT_MASK 0x1 /end MEASUREMENT
/begin MEASUREMENT ibfehlin2 "lokale Kopie Fehlerinput 2" UBYTE _CNV_A_R_LINEAR_____22_CM 1 100. 0. 255. DISPLAY_IDENTIFIER IBFEHLIN2 ECU_ADDRESS 0x3fab95 BIT_MASK 0x1 /end MEASUREMENT
/begin MEASUREMENT ibfehlin3 "lokale Kopie Fehlerinput 3" UBYTE _CNV_A_R_LINEAR_____22_CM 1 100. 0. 255. DISPLAY_IDENTIFIER IBFEHLIN3 ECU_ADDRESS 0x3fab96 BIT_MASK 0x1 /end MEASUREMENT
/begin MEASUREMENT ibfehlin4 "lokale Kopie Fehlerinput 4" UBYTE _CNV_A_R_LINEAR_____22_CM 1 100. 0. 255. DISPLAY_IDENTIFIER IBFEHLIN4 ECU_ADDRESS 0x3fab97 BIT_MASK 0x1 /end MEASUREMENT
/begin MEASUREMENT ibfehlin5 "lokale Kopie Fehlerinput 5" UBYTE _CNV_A_R_LINEAR_____22_CM 1 100. 0. 255. DISPLAY_IDENTIFIER IBFEHLIN5 ECU_ADDRESS 0x3fab98 BIT_MASK 0x1 /end MEASUREMENT
/begin MEASUREMENT ibfehlin6 "lokale Kopie Fehlerinput 6" UBYTE _CNV_A_R_LINEAR_____22_CM 1 100. 0. 255. DISPLAY_IDENTIFIER IBFEHLIN6 ECU_ADDRESS 0x3fab99 BIT_MASK 0x1 /end MEASUREMENT
/begin MEASUREMENT ibfehlin7 "lokale Kopie Fehlerinput 7" UBYTE _CNV_A_R_LINEAR_____22_CM 1 100. 0. 255. DISPLAY_IDENTIFIER IBFEHLIN7 ECU_ADDRESS 0x3fab9a BIT_MASK 0x1 /end MEASUREMENT
/begin MEASUREMENT ibfehlin8 "lokale Kopie Fehlerinput 8" UBYTE _CNV_A_R_LINEAR_____22_CM 1 100. 0. 255. DISPLAY_IDENTIFIER IBFEHLIN8 ECU_ADDRESS 0x3fab9b BIT_MASK 0x1 /end MEASUREMENT
/begin MEASUREMENT ibsderrs1 "Test Fehlerzaehler BSD" UBYTE _CNV_R_R_dez_498_CM 1 100. 0. 255. DISPLAY_IDENTIFIER IBSDERRS1 ECU_ADDRESS 0x3facc3 FORMAT "%8.4" /end MEASUREMENT
/begin MEASUREMENT ibsderrs2 "Test Fehlerzaehler EBSD" UBYTE _CNV_R_R_dez_498_CM 1 100. 0. 255. DISPLAY_IDENTIFIER IBSDERRS2 ECU_ADDRESS 0x3facc4 FORMAT "%8.4" /end MEASUREMENT
/begin MEASUREMENT ibserstat1 "Fehlerstatus Ort 1" UBYTE _CNV_R_R_dez_498_CM 1 100. 0. 255. DISPLAY_IDENTIFIER IBSERSTAT1 ECU_ADDRESS 0x3faba7 FORMAT "%8.4" /end MEASUREMENT
/begin MEASUREMENT ibserstat2 "Fehlerstatus Ort 2" UBYTE _CNV_R_R_dez_498_CM 1 100. 0. 255. DISPLAY_IDENTIFIER IBSERSTAT2 ECU_ADDRESS 0x3faba8 FORMAT "%8.4" /end MEASUREMENT
/begin MEASUREMENT ibserstat3 "Fehlerstatus Ort 3" UBYTE _CNV_R_R_dez_498_CM 1 100. 0. 255. DISPLAY_IDENTIFIER IBSERSTAT3 ECU_ADDRESS 0x3faba9 FORMAT "%8.4" /end MEASUREMENT
/begin MEASUREMENT locerr0 "Loc.Fehler0 Flankenerkennung" UBYTE _CNV_A_R_LINEAR_____22_CM 1 100. 0. 255. DISPLAY_IDENTIFIER LOCERR0 ECU_ADDRESS 0x3facc1 BIT_MASK 0x1 /end MEASUREMENT
/begin MEASUREMENT locerr1 "Loc.Fehler1 Flankenerkennung" UBYTE _CNV_A_R_LINEAR_____22_CM 1 100. 0. 255. DISPLAY_IDENTIFIER LOCERR1 ECU_ADDRESS 0x3facc2 BIT_MASK 0x1 /end MEASUREMENT
/begin CHARACTERISTIC IBBSTERR1 "Entprellzeit Fehlereintrag f. keine Kommunikation" VALUE 0x1b84c _REC_VAL_20_u1 0. _CNV_R_R_t100msxs_u_500_CM 0.1 25.5 FORMAT "%8.4" /end CHARACTERISTIC
/begin CHARACTERISTIC IBBSTERR2 "Entprellzeit Fehlereintrag f. EBSD" VALUE 0x1b84d _REC_VAL_20_u1 0. _CNV_R_R_t100msxs_u_500_CM 0.1 25.5 FORMAT "%8.4" /end CHARACTERISTIC
/begin CHARACTERISTIC IBBSTERR3 "Entprellzeit Fehlereintrag IBS unplausibel" VALUE 0x1b84e _REC_VAL_20_u1 0. _CNV_R_R_t100msxs_u_500_CM 0.1 25.5 FORMAT "%8.4" /end CHARACTERISTIC
/begin CHARACTERISTIC IBBSTERR4 "Entprellzeit Fehlereintrag f.Stromfehler" VALUE 0x1b84f _REC_VAL_20_u1 0. _CNV_R_R_t100msxs_u_500_CM 0.1 25.5 FORMAT "%8.4" /end CHARACTERISTIC
/begin CHARACTERISTIC IBBSTERR5 "Entprellzeit Fehlereintrag f. Spannungsfehler" VALUE 0x1b850 _REC_VAL_20_u1 0. _CNV_R_R_t100msxs_u_500_CM 0.1 25.5 FORMAT "%8.4" /end CHARACTERISTIC
/begin CHARACTERISTIC IBBSTERR6 "Entprellzeit Fehlereintrag f. Temp.Fehler" VALUE 0x1b851 _REC_VAL_20_u1 0. _CNV_R_R_t100msxs_u_500_CM 0.1 25.5 FORMAT "%8.4" /end CHARACTERISTIC
/begin CHARACTERISTIC IBBSTERR7 "Entprellzeit Fehlereintrag f. IBS Systemfehler" VALUE 0x1b852 _REC_VAL_20_u1 0. _CNV_R_R_t100msxs_u_500_CM 0.1 25.5 FORMAT "%8.4" /end CHARACTERISTIC
/begin CHARACTERISTIC IBBSTERR8 "Entprellzeit Fehlereintrag f. KL15wu Stoerung" VALUE 0x1b853 _REC_VAL_20_u1 0. _CNV_R_R_t100msxs_u_500_CM 0.1 25.5 FORMAT "%8.4" /end CHARACTERISTIC
/begin CHARACTERISTIC IBBSTHEAL "Entprellzeit Fehlerheilung " VALUE 0x1b854 _REC_VAL_20_u1 0. _CNV_R_R_t100msxs_u_500_CM 0.1 25.5 FORMAT "%8.4" /end CHARACTERISTIC
/begin CHARACTERISTIC MSKIBSDFP "Bitmaske Generator Fehler-> DFP" VALUE 0x1b855 _REC_VAL_20_u1 0. _CNV_R_R_dez_498_CM 0. 255. FORMAT "%8.4" /end CHARACTERISTIC
/begin CHARACTERISTIC MSKIBSDIAG "Test AK disable Diagnose" VALUE 0x1b856 _REC_VAL_20_u1 0. _CNV_R_R_dez_498_CM 0. 255. FORMAT "%8.4" /end CHARACTERISTIC
/begin MEASUREMENT online_dummy "" UWORD _CNV_A_R_LINEAR_____1_CM 1 100. 0. 65535. DISPLAY_IDENTIFIER ONLINE_DUMMY ECU_ADDRESS 0x3fd350 BYTE_ORDER MSB_LAST FORMAT "%5.0" /end MEASUREMENT
/begin MEASUREMENT fac_fco_kwp "correction factor for consumption" SBYTE _CNV_A_R_LINEAR_____564_CM 1 100. -0.128 0.127 DISPLAY_IDENTIFIER FAC_FCO_KWP ECU_ADDRESS 0x3fe7d7 FORMAT "%5.3" /end MEASUREMENT
/begin MEASUREMENT eol_ram[0] "State variable for EOL CPS_CHECK" UBYTE _CNV_S_10_STATE_EOL__565_CM 1 100. 0. 9. DISPLAY_IDENTIFIER STATE_EOL_KWP_CPS ECU_ADDRESS 0x3fe858 /end MEASUREMENT
/begin MEASUREMENT eol_ram[1] "State variable for EOL - DMTL" UBYTE _CNV_S_10_STATE_EOL__565_CM 1 100. 0. 9. DISPLAY_IDENTIFIER STATE_EOL_KWP_DMTL ECU_ADDRESS 0x3fe859 /end MEASUREMENT
/begin MEASUREMENT eol_ram[2] "State variable for EOL - lambda sensors wrong wired/confused" UBYTE _CNV_S_10_STATE_EOL__565_CM 1 100. 0. 9. DISPLAY_IDENTIFIER STATE_EOL_KWP_VLS ECU_ADDRESS 0x3fe85a /end MEASUREMENT
/begin MEASUREMENT eol_ram[3] "state variable for displace N_SP_IS" UBYTE _CNV_S_10_STATE_EOL__565_CM 1 100. 0. 9. DISPLAY_IDENTIFIER STATE_EOL_KWP_N_SP_IS ECU_ADDRESS 0x3fe85b /end MEASUREMENT
/begin MEASUREMENT eol_ram[4] "status of SA EOL diagnosis" UBYTE _CNV_S_10_STATE_EOL__565_CM 1 100. 0. 9. DISPLAY_IDENTIFIER STATE_EOL_KWP_SA ECU_ADDRESS 0x3fe85c /end MEASUREMENT
/begin CHARACTERISTIC c_n_max_kwp "max engine speed for accepting a KWP2000(*) service" VALUE 0x01702 _REC_VAL_20_u2 8160. _CNV_A_R_LINEAR_____11_CM 0. 8160. DISPLAY_IDENTIFIER C_N_MAX_KWP FORMAT "%4.0" /end CHARACTERISTIC
/begin CHARACTERISTIC c_vs_max_kwp "maximum vehicle speed for accepting the service" VALUE 0x00950 _REC_VAL_20_u1 255. _CNV_A_R_LINEAR_____23_CM 0. 255. DISPLAY_IDENTIFIER C_VS_MAX_KWP FORMAT "%3.0" /end CHARACTERISTIC
/begin MEASUREMENT n_sp_is_ext_adj "idle speed setpoint from the tester" UWORD _CNV_A_R_LINEAR_____11_CM 1 100. 0. 8160. DISPLAY_IDENTIFIER N_SP_IS_EXT_ADJ ECU_ADDRESS 0x3fdb58 BYTE_ORDER MSB_LAST FORMAT "%4.0" /end MEASUREMENT
/begin MEASUREMENT lv_act_n_sp_is_ext_adj "LV for displace N_SP_IS" UBYTE _CNV_S_2_RANGE______0_CM 1 100. 0. 1. DISPLAY_IDENTIFIER LV_ACT_N_SP_IS_EXT_ADJ ECU_ADDRESS 0x3fe854 /end MEASUREMENT
/begin MEASUREMENT lv_eol_cps "LV for the end of line test CPS" UBYTE _CNV_S_2_RANGE______0_CM 1 100. 0. 1. DISPLAY_IDENTIFIER LV_EOL_CPS ECU_ADDRESS 0x3fe855 /end MEASUREMENT
/begin MEASUREMENT lv_act_vls_eol_ext_adj "Activation bit for lambda sensor EOL diagnos confused wired" UBYTE _CNV_S_2_RANGE______0_CM 1 100. 0. 1. DISPLAY_IDENTIFIER LV_ACT_VLS_EOL_EXT_ADJ ECU_ADDRESS 0x3fe856 /end MEASUREMENT
/begin MEASUREMENT tq_loss_alter "Torque losses due to the alternator" SWORD _CNV_A_R_LINEAR_____55_CM 1 100. -1024. 1023.96875 DISPLAY_IDENTIFIER TQ_LOSS_ALTER ECU_ADDRESS 0x3fcefa BYTE_ORDER MSB_LAST FORMAT "%6.2" /end MEASUREMENT
/begin CHARACTERISTIC ip_tq_loss_alter "Corrected TQ_LOSS_ALTER of power management request" MAP 0x0fc72 _REC_MAP_20_u2_u2_u1 2047.96875 _CNV_A_R_LINEAR_____186_CM -1024. 1023.96875 DISPLAY_IDENTIFIER IP_TQ_LOSS_ALTER FORMAT "%6.2"
 /begin AXIS_DESCR COM_AXIS tq_loss_alter_1 _CNV_A_R_LINEAR_____186_CM 6 -1024. 1023.96875 FORMAT "%6.2" AXIS_PTS_REF ldp_tq_loss_alter_1__tq_alter /end AXIS_DESCR
 /begin AXIS_DESCR COM_AXIS n_32 _CNV_A_R_LINEAR_____16_CM 6 0. 8160. FORMAT "%4.0" AXIS_PTS_REF ldp_n_32__tq_alter /end AXIS_DESCR
/end CHARACTERISTIC
/begin AXIS_PTS ldp_tq_loss_alter_1__tq_alter "" 0x1131e tq_loss_alter_1 _REC_AXS_20_u2 2047.96875 _CNV_A_R_LINEAR_____186_CM 6 -1024. 1023.96875 DISPLAY_IDENTIFIER LDP_TQ_LOSS_ALTER_1__TQ_ALTER FORMAT "%6.2" /end AXIS_PTS
/begin AXIS_PTS ldp_n_32__tq_alter "" 0x0105e n_32 _REC_AXS_20_u1 816. _CNV_A_R_LINEAR_____16_CM 6 0. 8160. DISPLAY_IDENTIFIER LDP_N_32__TQ_ALTER FORMAT "%4.0" /end AXIS_PTS
/begin MEASUREMENT lv_act_n_sp_is_bas_ext_adj "switch off idle speed uplift - function active = 1" UBYTE _CNV_S_2_RANGE______0_CM 1 100. 0. 1. DISPLAY_IDENTIFIER LV_ACT_N_SP_IS_BAS_EXT_ADJ ECU_ADDRESS 0x3fe75d /end MEASUREMENT
/begin MEASUREMENT ti_co_is_perc "idle CO-Adjustment value from the tester" UBYTE _CNV_A_R_LINEAR_____130_CM 1 100. -50. 49.609375 DISPLAY_IDENTIFIER TI_CO_IS_PERC ECU_ADDRESS 0x3fe75e FORMAT "%6.2" /end MEASUREMENT
/begin MEASUREMENT lv_act_sa_eol "Activation bit for secondary air EOL test" UBYTE _CNV_S_2_RANGE______0_CM 1 100. 0. 1. DISPLAY_IDENTIFIER LV_ACT_SA_EOL ECU_ADDRESS 0x3fe768 /end MEASUREMENT
/begin CHARACTERISTIC c_tco_min_sa_eol "TCO threshold for EOL activation" VALUE 0x00890 _REC_VAL_20_u1 190.5 _CNV_A_R_LINEAR_____12_CM -48. 142.5 DISPLAY_IDENTIFIER C_TCO_MIN_SA_EOL FORMAT "%5.1" /end CHARACTERISTIC
/begin MEASUREMENT lv_inh_lam_kwp "switch off condition for lambda control via KWP2000 / 01=disabled 00=enabled" UBYTE _CNV_S_2_RANGE______0_CM 1 100. 0. 1. DISPLAY_IDENTIFIER LV_INH_LAM_KWP ECU_ADDRESS 0x3fe850 /end MEASUREMENT
/begin COMPU_METHOD _CNV_S_2_RANGE______0_CM "" TAB_VERB "%6.3" "[-]" COMPU_TAB_REF _CNV_S_2_RANGE______0 /end COMPU_METHOD
/begin COMPU_VTAB _CNV_S_2_RANGE______0 "" TAB_VERB 2 0 "0" 1 "1" /end COMPU_VTAB
/begin COMPU_METHOD _CNV_A_R_LINEAR_____1_CM "" RAT_FUNC "%6.3" "-" COEFFS 0 1. 0. 0 0 1 /end COMPU_METHOD
/begin COMPU_METHOD _CNV_S_2_RANGE______2_R_CM "" TAB_VERB "%6.3" "[-]" COMPU_TAB_REF _CNV_S_2_RANGE______2_R /end COMPU_METHOD
/begin COMPU_VTAB_RANGE _CNV_S_2_RANGE______2_R "" 2 0 0 "0" 1 255 "1" /end COMPU_VTAB_RANGE
/begin COMPU_METHOD _CNV_A_R_LINEAR_____3_CM "" RAT_FUNC "%6.3" "V" COEFFS 0 204.7999998974999 0. 0 0 1 /end COMPU_METHOD
/begin COMPU_METHOD _CNV_A_R_LINEAR_____4_CM "" RAT_FUNC "%6.3" "s" COEFFS 0 100. 0. 0 0 1 /end COMPU_METHOD
/begin COMPU_METHOD _CNV_S_2_RANGE______5_CM "" TAB_VERB "%6.3" "-" COMPU_TAB_REF _CNV_S_2_RANGE______5 /end COMPU_METHOD
/begin COMPU_VTAB _CNV_S_2_RANGE______5 "" TAB_VERB 2 0 "0" 1 "1" /end COMPU_VTAB
/begin COMPU_METHOD _CNV_A_R_LINEAR_____9_CM "" RAT_FUNC "%6.3" "%" COEFFS 0 655.3600000071681 0. 0 0 1 /end COMPU_METHOD
/begin COMPU_METHOD _CNV_A_R_LINEAR_____10_CM "" RAT_FUNC "%6.3" "%" COEFFS 0 2.56 0. 0 0 1 /end COMPU_METHOD
/begin COMPU_METHOD _CNV_A_R_LINEAR_____11_CM "" RAT_FUNC "%6.3" "rpm" COEFFS 0 1. 0. 0 0 1 /end COMPU_METHOD
/begin COMPU_METHOD _CNV_A_R_LINEAR_____12_CM "" RAT_FUNC "%6.3" "°C" COEFFS 0 1.333333333333333 64. 0 0 1 /end COMPU_METHOD
/begin COMPU_METHOD _CNV_A_R_LINEAR_____16_CM "" RAT_FUNC "%6.3" "rpm" COEFFS 0 3.125e-002 0. 0 0 1 /end COMPU_METHOD
/begin COMPU_METHOD _CNV_A_R_LINEAR_____21_CM "" RAT_FUNC "%6.3" "-" COEFFS 0 32768.00003968061 0. 0 0 1 /end COMPU_METHOD
/begin COMPU_METHOD _CNV_A_R_LINEAR_____22_CM "" RAT_FUNC "%6.3" "[-]" COEFFS 0 1. 0. 0 0 1 /end COMPU_METHOD
/begin COMPU_METHOD _CNV_A_R_LINEAR_____23_CM "" RAT_FUNC "%6.3" "km/h" COEFFS 0 1. 0. 0 0 1 /end COMPU_METHOD
/begin COMPU_METHOD _CNV_A_R_LINEAR_____24_CM "" RAT_FUNC "%6.3" "s" COEFFS 0 10. 0. 0 0 1 /end COMPU_METHOD
/begin COMPU_METHOD _CNV_A_R_LINEAR_____27_CM "" RAT_FUNC "%6.3" "mg/stk" COEFFS 0 0.183585313174946 0. 0 0 1 /end COMPU_METHOD
/begin COMPU_METHOD _CNV_A_R_LINEAR_____29_CM "" RAT_FUNC "%6.3" "-" COEFFS 0 255.9983911655618 0. 0 0 1 /end COMPU_METHOD
/begin COMPU_METHOD _CNV_A_R_LINEAR_____30_CM "" RAT_FUNC "%6.3" "s" COEFFS 0 1. 0. 0 0 1 /end COMPU_METHOD
/begin COMPU_METHOD _CNV_A_R_LINEAR_____31_CM "" RAT_FUNC "%6.3" "ms" COEFFS 0 0.1 0. 0 0 1 /end COMPU_METHOD
/begin COMPU_METHOD _CNV_S_8_RANGE_STAT_32_CM "" TAB_VERB "%6.3" "[-]" COMPU_TAB_REF _CNV_S_8_RANGE_STAT_32 /end COMPU_METHOD
/begin COMPU_VTAB _CNV_S_8_RANGE_STAT_32 "" TAB_VERB 8 0 "None" 1 "Set-Acc-TipUp" 2 "Decelerate-TipDown" 3 "Resume" 4 "Off" 5 "-" 6 "-" 7 "Error" /end COMPU_VTAB
/begin COMPU_METHOD _CNV_S_10_RANGE_REQ__33_CM "" TAB_VERB "%6.3" "[-]" COMPU_TAB_REF _CNV_S_10_RANGE_REQ__33 /end COMPU_METHOD
/begin COMPU_VTAB _CNV_S_10_RANGE_REQ__33 "" TAB_VERB 10 0 "Hard_off" 1 "Soft_off" 2 "TIP up" 3 "TIP Down " 4 "Set / Accelerate" 5 "Resume" 6 "Decelerate" 7 "None" 8 "Mark up" 9 "Mark down" /end COMPU_VTAB
/begin COMPU_METHOD _CNV_A_R_LINEAR_____37_CM "" RAT_FUNC "%6.3" "-" COEFFS 0 65536.00007936121 0. 0 0 1 /end COMPU_METHOD
/begin COMPU_METHOD _CNV_A_R_LINEAR_____39_CM "" RAT_FUNC "%6.3" "-" COEFFS 0 127.9991955827809 0. 0 0 1 /end COMPU_METHOD
/begin COMPU_METHOD _CNV_A_R_LINEAR_____41_CM "" RAT_FUNC "%6.3" "s" COEFFS 0 25. 0. 0 0 1 /end COMPU_METHOD
/begin COMPU_METHOD _CNV_A_R_LINEAR_____49_CM "" RAT_FUNC "%6.3" "hPa" COEFFS 0 12.06017666543982 0. 0 0 1 /end COMPU_METHOD
/begin COMPU_METHOD _CNV_A_R_LINEAR_____50_CM "" RAT_FUNC "%6.3" "[-]" COEFFS 0 255.9999357490357 0. 0 0 1 /end COMPU_METHOD
/begin COMPU_METHOD _CNV_A_R_LINEAR_____55_CM "" RAT_FUNC "%6.3" "Nm" COEFFS 0 32. 0. 0 0 1 /end COMPU_METHOD
/begin COMPU_METHOD _CNV_A_R_LINEAR_____68_CM "" RAT_FUNC "%6.3" "km/h" COEFFS 0 10. 0. 0 0 1 /end COMPU_METHOD
/begin COMPU_METHOD _CNV_A_R_LINEAR_____85_CM "" RAT_FUNC "%6.3" "km/h" COEFFS 0 128.0000018750286 0. 0 0 1 /end COMPU_METHOD
/begin COMPU_METHOD _CNV_A_R_LINEAR_____101_CM "" RAT_FUNC "%6.3" "Nm" COEFFS 0 0.5 0. 0 0 1 /end COMPU_METHOD
/begin COMPU_METHOD _CNV_A_R_LINEAR_____103_CM "" RAT_FUNC "%6.3" "m/s²" COEFFS 0 640. 32768. 0 0 1 /end COMPU_METHOD
/begin COMPU_METHOD _CNV_A_R_LINEAR_____106_CM "" RAT_FUNC "%6.3" "mg/stk" COEFFS 0 47.18142548596112 0. 0 0 1 /end COMPU_METHOD
/begin COMPU_METHOD _CNV_A_R_LINEAR_____111_CM "" RAT_FUNC "%6.3" "kg/h" COEFFS 0 8191.999999679995 0. 0 0 1 /end COMPU_METHOD
/begin COMPU_METHOD _CNV_A_R_LINEAR_____115_CM "" RAT_FUNC "%6.3" "-" COEFFS 0 128. 0. 0 0 1 /end COMPU_METHOD
/begin COMPU_METHOD _CNV_A_R_LINEAR_____123_CM "" RAT_FUNC "%6.3" "-" COEFFS 0 255.9999997499962 0. 0 0 1 /end COMPU_METHOD
/begin COMPU_METHOD _CNV_A_R_LINEAR_____127_CM "" RAT_FUNC "%6.3" "[-]" COEFFS 0 64. 0. 0 0 1 /end COMPU_METHOD
/begin COMPU_METHOD _CNV_A_R_LINEAR_____130_CM "" RAT_FUNC "%6.3" "%" COEFFS 0 2.56 128. 0 0 1 /end COMPU_METHOD
/begin COMPU_METHOD _CNV_A_R_LINEAR_____137_CM "" RAT_FUNC "%6.3" "m/s²" COEFFS 0 2084.478388984895 2.74784179055132e-004 0 0 1 /end COMPU_METHOD
/begin COMPU_METHOD _CNV_A_R_LINEAR_____138_CM "" RAT_FUNC "%6.3" "rpm/(km/h)" COEFFS 0 0.5 0. 0 0 1 /end COMPU_METHOD
/begin COMPU_METHOD _CNV_A_R_LINEAR_____139_CM "" RAT_FUNC "%6.3" "km/h" COEFFS 0 65536.00007936121 0. 0 0 1 /end COMPU_METHOD
/begin COMPU_METHOD _CNV_A_R_LINEAR_____140_CM "" RAT_FUNC "%6.3" "ms" COEFFS 0 1. 0. 0 0 1 /end COMPU_METHOD
/begin COMPU_METHOD _CNV_A_R_LINEAR_____141_CM "" RAT_FUNC "%6.3" "km/h" COEFFS 0 128. 0. 0 0 1 /end COMPU_METHOD
/begin COMPU_METHOD _CNV_S_8_RANGE_REQ__142_CM "" TAB_VERB "%6.3" "[-]" COMPU_TAB_REF _CNV_S_8_RANGE_REQ__142 /end COMPU_METHOD
/begin COMPU_VTAB _CNV_S_8_RANGE_REQ__142 "" TAB_VERB 8 0 "Hard_off" 1 "Soft_off" 2 "TIP up" 3 "TIP Down " 4 "Set / Accelerate" 5 "Resume" 6 "Decelerate" 7 "None" /end COMPU_VTAB
/begin COMPU_METHOD _CNV_A_R_LINEAR_____143_CM "" RAT_FUNC "%6.3" "m/s²" COEFFS 0 2084.478406465338 0. 0 0 1 /end COMPU_METHOD
/begin COMPU_METHOD _CNV_S_8_RANGE_STAT_144_CM "" TAB_VERB "%6.3" "[-]" COMPU_TAB_REF _CNV_S_8_RANGE_STAT_144 /end COMPU_METHOD
/begin COMPU_VTAB _CNV_S_8_RANGE_STAT_144 "" TAB_VERB 8 0 "PASSIVE" 1 "CONST/TIP " 2 "-" 3 "RES" 4 "-" 5 "SET_ACC" 6 "-" 7 "DEC" /end COMPU_VTAB
/begin COMPU_METHOD _CNV_A_R_LINEAR_____145_CM "" RAT_FUNC "%6.3" "km/h" COEFFS 0 128.0039001188318 0. 0 0 1 /end COMPU_METHOD
/begin COMPU_METHOD _CNV_A_R_LINEAR_____146_CM "" RAT_FUNC "%6.3" "km/h" COEFFS 0 8. 0. 0 0 1 /end COMPU_METHOD
/begin COMPU_METHOD _CNV_A_R_LINEAR_____147_CM "" RAT_FUNC "%6.3" "m/s²" COEFFS 0 46.08002400098911 0. 0 0 1 /end COMPU_METHOD
/begin COMPU_METHOD _CNV_A_R_LINEAR_____148_CM "" RAT_FUNC "%6.3" "km/h" COEFFS 0 128. 32768. 0 0 1 /end COMPU_METHOD
/begin COMPU_METHOD _CNV_S_6_RANGE_STAT_149_CM "" TAB_VERB "%6.3" "[-]" COMPU_TAB_REF _CNV_S_6_RANGE_STAT_149 /end COMPU_METHOD
/begin COMPU_VTAB _CNV_S_6_RANGE_STAT_149 "" TAB_VERB 6 0 "PASSIVE" 1 "CONST_DRIVE" 3 "RESUME" 5 "SET_ACC" 7 "RETARD" 9 "TIP" /end COMPU_VTAB
/begin COMPU_METHOD _CNV_A_R_LINEAR_____150_CM "" RAT_FUNC "%6.3" "%/(km/h)" COEFFS 0 1310.720001587224 0. 0 0 1 /end COMPU_METHOD
/begin COMPU_METHOD _CNV_A_R_LINEAR_____151_CM "" RAT_FUNC "%6.3" "%/(m/s²)" COEFFS 0 163.8375 32767.5 0 0 1 /end COMPU_METHOD
/begin COMPU_METHOD _CNV_A_R_LINEAR_____152_CM "" RAT_FUNC "%6.3" "%" COEFFS 0 2084.478388983038 32768.00027481336 0 0 1 /end COMPU_METHOD
/begin COMPU_METHOD _CNV_A_R_LINEAR_____153_CM "" RAT_FUNC "%6.3" "km/h" COEFFS 0 4. 0. 0 0 1 /end COMPU_METHOD
/begin COMPU_METHOD _CNV_A_R_LINEAR_____154_CM "" RAT_FUNC "%6.3" "%/100ms" COEFFS 0 655.3600000071681 0. 0 0 1 /end COMPU_METHOD
/begin COMPU_METHOD _CNV_S_4_STATE_I_CR_155_CM "" TAB_VERB "%6.3" "[-]" COMPU_TAB_REF _CNV_S_4_STATE_I_CR_155 /end COMPU_METHOD
/begin COMPU_VTAB _CNV_S_4_STATE_I_CR_155 "" TAB_VERB 4 0 "NO" 1 "LIM" 2 "FREEZE" 3 "NORM" /end COMPU_VTAB
/begin COMPU_METHOD _CNV_A_R_LINEAR_____164_CM "" RAT_FUNC "%6.3" "-" COEFFS 0 1023.999999919998 0. 0 0 1 /end COMPU_METHOD
/begin COMPU_METHOD _CNV_A_R_LINEAR_____186_CM "" RAT_FUNC "%6.3" "Nm" COEFFS 0 32. 32768. 0 0 1 /end COMPU_METHOD
/begin COMPU_METHOD _CNV_A_R_LINEAR_____190_CM "" RAT_FUNC "%6.3" "-" COEFFS 0 65535. 0. 0 0 1 /end COMPU_METHOD
/begin COMPU_METHOD _CNV_S_4_STATE_AMT__201_CM "" TAB_VERB "%6.3" "[-]" COMPU_TAB_REF _CNV_S_4_STATE_AMT__201 /end COMPU_METHOD
/begin COMPU_VTAB _CNV_S_4_STATE_AMT__201 "" TAB_VERB 4 0 "NO" 1 "DEC" 2 "INC" 3 "DEC_INC" /end COMPU_VTAB
/begin COMPU_METHOD _CNV_A_R_LINEAR_____202_CM "" RAT_FUNC "%6.3" "Nm/10ms" COEFFS 0 32. 0. 0 0 1 /end COMPU_METHOD
/begin COMPU_METHOD _CNV_A_R_LINEAR_____206_CM "" RAT_FUNC "%6.3" "rpm" COEFFS 0 1. 32768. 0 0 1 /end COMPU_METHOD
/begin COMPU_METHOD _CNV_A_R_LINEAR_____262_CM "" RAT_FUNC "%6.3" "°C" COEFFS 0 43.47840509520334 2086.96344456976 0 0 1 /end COMPU_METHOD
/begin COMPU_METHOD _CNV_A_R_LINEAR_____266_CM "" RAT_FUNC "%6.3" "[-]" COEFFS 0 1023.999999959999 32767.99999871998 0 0 1 /end COMPU_METHOD
/begin COMPU_METHOD _CNV_A_R_LINEAR_____306_CM "" RAT_FUNC "%6.3" "-" COEFFS 0 1023.999999959999 -1.818989403545857e-011 0 0 1 /end COMPU_METHOD
/begin COMPU_METHOD _CNV_A_R_LINEAR_____308_CM "" RAT_FUNC "%6.3" "mg" COEFFS 0 6.25 0. 0 0 1 /end COMPU_METHOD
/begin COMPU_METHOD _CNV_A_R_LINEAR_____316_CM "" RAT_FUNC "%6.3" "V" COEFFS 0 204.8048048048048 0. 0 0 1 /end COMPU_METHOD
/begin COMPU_METHOD _CNV_S_12_STATE_VLS__319_CM "" TAB_VERB "%6.3" "[-]" COMPU_TAB_REF _CNV_S_12_STATE_VLS__319 /end COMPU_METHOD
/begin COMPU_VTAB _CNV_S_12_STATE_VLS__319 "" TAB_VERB 12 0 "OFF" 1 "STEP_1" 2 "STEP_2" 16 "FINISHED" 17 "ERR_UP" 18 "ERR_DOWN" 19 "ERR_UP_DOWN" 20 "ERR_UP_1" 21 "ERR_UP_2" 22 "ERR_DOWN_1" 23 "ERR_DOWN_2" 24 "NO_RESULT" /end COMPU_VTAB
/begin COMPU_METHOD _CNV_A_R_LINEAR_____320_CM "" RAT_FUNC "%6.3" "g" COEFFS 0 35.99999934081027 0. 0 0 1 /end COMPU_METHOD
/begin COMPU_METHOD _CNV_A_R_LINEAR_____332_CM "" RAT_FUNC "%6.3" "mg/stk" COEFFS 0 47.18070554355651 0. 0 0 1 /end COMPU_METHOD
/begin COMPU_METHOD _CNV_A_R_LINEAR_____350_CM "" RAT_FUNC "%6.3" "mg/stk" COEFFS 0 47.18142548596112 32767.5 0 0 1 /end COMPU_METHOD
/begin COMPU_METHOD _CNV_A_R_LINEAR_____374_CM "" RAT_FUNC "%6.3" "rpm" COEFFS 0 0.5 0. 0 0 1 /end COMPU_METHOD
/begin COMPU_METHOD _CNV_A_R_LINEAR_____375_CM "" RAT_FUNC "%6.3" "Ah" COEFFS 0 2.007874015748032 0. 0 0 1 /end COMPU_METHOD
/begin COMPU_METHOD _CNV_A_R_LINEAR_____378_CM "" RAT_FUNC "%6.3" "-" COEFFS 0 2048. 0. 0 0 1 /end COMPU_METHOD
/begin COMPU_METHOD _CNV_S_8_RANGE_STAT_382_CM "" TAB_VERB "%6.3" "[-]" COMPU_TAB_REF _CNV_S_8_RANGE_STAT_382 /end COMPU_METHOD
/begin COMPU_VTAB _CNV_S_8_RANGE_STAT_382 "" TAB_VERB 8 0 "SAV_DIAG_NOT_ACTIVE" 1 "SAV_DIAG_DISABLED" 2 "SAV_DIAG_ABORTED" 3 "SAV_DIAG_FIN_NO_ERR_1" 4 "SAV_DIAG_FIN_NO_ERR_2" 5 "SAV_DIAG_FIN_ERR_SAV" 6 "SAV_DIAG_ACTIVE" 7 "SAV_DIAG_VERIFY" /end COMPU_VTAB
/begin COMPU_METHOD _CNV_A_R_LINEAR_____444_CM "" RAT_FUNC "%6.3" "ms" COEFFS 0 62.5 0. 0 0 1 /end COMPU_METHOD
/begin COMPU_METHOD _CNV_S_4_STATE_TQ_D_462_CM "" TAB_VERB "%6.3" "[-]" COMPU_TAB_REF _CNV_S_4_STATE_TQ_D_462 /end COMPU_METHOD
/begin COMPU_VTAB _CNV_S_4_STATE_TQ_D_462 "" TAB_VERB 4 0 "\"economy\"" 1 "\"high_dynamic\"" 2 "\"transition\"" 3 "\"tq_reserve\"" /end COMPU_VTAB
/begin COMPU_METHOD _CNV_A_R_LINEAR_____476_CM "" RAT_FUNC "%6.3" "°STW" COEFFS 0 22.75571737399022 32768. 0 0 1 /end COMPU_METHOD
/begin COMPU_METHOD _CNV_A_R_LINEAR_____477_CM "" RAT_FUNC "%6.3" "°STW/s" COEFFS 0 22.75571737399022 32768. 0 0 1 /end COMPU_METHOD
/begin COMPU_METHOD _CNV_A_R_LINEAR_____478_CM "" RAT_FUNC "%6.3" "-" COEFFS 0 64. 128. 0 0 1 /end COMPU_METHOD
/begin COMPU_METHOD _CNV_S_3_RANGE_CAM__480_CM "" TAB_VERB "%6.3" "[-]" COMPU_TAB_REF _CNV_S_3_RANGE_CAM__480 /end COMPU_METHOD
/begin COMPU_VTAB _CNV_S_3_RANGE_CAM__480 "" TAB_VERB 3 0 "two seg. disc" 1 "four seg. disc synchronous" 2 "four seg. disc asynchronous" /end COMPU_VTAB
/begin COMPU_METHOD _CNV_S_3_RANGE_ENG__481_CM "" TAB_VERB "%6.3" "[-]" COMPU_TAB_REF _CNV_S_3_RANGE_ENG__481 /end COMPU_METHOD
/begin COMPU_VTAB _CNV_S_3_RANGE_ENG__481 "" TAB_VERB 3 0 "NG6_MPI" 1 "M54/56" 2 "NG6_GDI" /end COMPU_VTAB
/begin COMPU_METHOD _CNV_S_2_RANGE_VIM__482_CM "" TAB_VERB "%6.3" "[-]" COMPU_TAB_REF _CNV_S_2_RANGE_VIM__482 /end COMPU_METHOD
/begin COMPU_VTAB _CNV_S_2_RANGE_VIM__482 "" TAB_VERB 2 0 "closed loop" 1 "switched" /end COMPU_VTAB
/begin COMPU_METHOD _CNV_S_3_STATE_CONF_483_CM "" TAB_VERB "%6.3" "-" COMPU_TAB_REF _CNV_S_3_STATE_CONF_483 /end COMPU_METHOD
/begin COMPU_VTAB _CNV_S_3_STATE_CONF_483 "" TAB_VERB 3 0 "NO_SOF_SWI" 1 "SOF_SWI" 2 "SOF_SWI_AMT" /end COMPU_VTAB
/begin COMPU_METHOD _CNV_R_R_dez_498_CM "" RAT_FUNC "%6.3" "[-]" COEFFS 0. 1. 0. 0. 0. 1. /end COMPU_METHOD
/begin COMPU_METHOD _CNV_R_R_t100msxs_u_500_CM "" RAT_FUNC "%6.3" "[-]" COEFFS 0. 1. 0. 0. 0. 0.1 /end COMPU_METHOD
/begin COMPU_METHOD _CNV_A_R_LINEAR_____564_CM "" RAT_FUNC "%6.3" "-" COEFFS 0 1000. 0. 0 0 1 /end COMPU_METHOD
/begin COMPU_METHOD _CNV_S_10_STATE_EOL__565_CM "" TAB_VERB "%6.3" "[-]" COMPU_TAB_REF _CNV_S_10_STATE_EOL__565 /end COMPU_METHOD
/begin COMPU_VTAB _CNV_S_10_STATE_EOL__565 "" TAB_VERB 10 0 "EOL_TEST_ACT" 1 "EOL_TEST_ST_INH" 2 "EOL_TEST_PAR_NOT_PLAUS" 3 "EOL_TEST_WAIT_REL" 4 "EOL_TEST_UNDEF" 5 "EOL_TEST_NOT_ST" 6 "EOL_TEST_END_WOUT_RESULT" 7 "EOL_TEST_ABORTED" 8 "EOL_TEST_END_WOUT_ERR" 9 "EOL_TEST_END_WITH_ERR" /end COMPU_VTAB
/begin RECORD_LAYOUT _REC_VAL_20_u1 FNC_VALUES 1 UBYTE COLUMN_DIR DIRECT /end RECORD_LAYOUT
/begin RECORD_LAYOUT _REC_VAL_20_u2 FNC_VALUES 1 UWORD COLUMN_DIR DIRECT /end RECORD_LAYOUT
/begin RECORD_LAYOUT _REC_CUR_20_u2_u1 FNC_VALUES 1 UWORD COLUMN_DIR DIRECT /end RECORD_LAYOUT
/begin RECORD_LAYOUT _REC_AXS_20_u1 NO_AXIS_PTS_X 1 UBYTE AXIS_PTS_X 2 UBYTE INDEX_INCR DIRECT /end RECORD_LAYOUT
/begin RECORD_LAYOUT _REC_MAP_20_u1_u1_u1 FNC_VALUES 1 UBYTE COLUMN_DIR DIRECT /end RECORD_LAYOUT
/begin RECORD_LAYOUT _REC_CUR_20_u1_u1 FNC_VALUES 1 UBYTE COLUMN_DIR DIRECT /end RECORD_LAYOUT
/begin RECORD_LAYOUT _REC_AXS_20_u2 NO_AXIS_PTS_X 1 UWORD AXIS_PTS_X 2 UWORD INDEX_INCR DIRECT /end RECORD_LAYOUT
/begin RECORD_LAYOUT _REC_MAP_20_u2_u2_u1 FNC_VALUES 1 UWORD COLUMN_DIR DIRECT /end RECORD_LAYOUT
/begin RECORD_LAYOUT _REC_CUR_20_u1_u2 FNC_VALUES 1 UBYTE COLUMN_DIR DIRECT /end RECORD_LAYOUT
/begin RECORD_LAYOUT _REC_MAP_20_u2_u1_u1 FNC_VALUES 1 UWORD COLUMN_DIR DIRECT /end RECORD_LAYOUT
/begin RECORD_LAYOUT _REC_CUR_20_u2_u2 FNC_VALUES 1 UWORD COLUMN_DIR DIRECT /end RECORD_LAYOUT
/begin RECORD_LAYOUT _REC_VAL_20_s1 FNC_VALUES 1 SBYTE COLUMN_DIR DIRECT /end RECORD_LAYOUT
/begin RECORD_LAYOUT _REC_VAL_20_u4 FNC_VALUES 1 ULONG COLUMN_DIR DIRECT /end RECORD_LAYOUT
/begin RECORD_LAYOUT _REC_VAL_20_s2 FNC_VALUES 1 SWORD COLUMN_DIR DIRECT /end RECORD_LAYOUT
/begin RECORD_LAYOUT _REC_MAP_20_u2_u1_u2 FNC_VALUES 1 UWORD COLUMN_DIR DIRECT /end RECORD_LAYOUT
/begin RECORD_LAYOUT _REC_MAP_20_u2_u2_u2 FNC_VALUES 1 UWORD COLUMN_DIR DIRECT /end RECORD_LAYOUT
/begin FUNCTION TQM_Torque_Request_for_safety "_Torque Request for safety"
 /begin DEF_CHARACTERISTIC lc_tq_lim_inh lc_tq_lim_inh_fast lc_tq_lim_inh_slow c_tqi_req_lim_pas c_tq_lim_inc c_tq_lim_dec c_t_tq_lim_intv ip_tqi_dif_lim c_tqi_dif_lim_max_ofs c_dec_tqi_lim_dif_max /end DEF_CHARACTERISTIC
 /begin OUT_MEASUREMENT t_tq_lim_intv sum_tqi_req_lim tqi_req_lim_4 tqi_req_lim_slow tqi_req_lim_3 lv_tq_lim_intv tqi_req_lim_1 tqi_req_lim_2 tqi_dif_lim t_tqi_req_lim t_tqi_req_lim_max tqi_req_lim_fast tqi_req_lim_dif tqi_req_lim_dif_max lv_tq_lim_intv_1 lv_tq_lim_intv_2 tqi_req_lim_dif_ofs /end OUT_MEASUREMENT
/end FUNCTION
/begin FUNCTION TQM_Torque_based_lambda_setpoint "_Torque based lambda setpoint calculation"
 /begin DEF_CHARACTERISTIC ip_lamb_dif_sp c_eff_lamb_sp_max lc_tq_lamb_inh_man lc_tq_lamb_ena_man /end DEF_CHARACTERISTIC
 /begin OUT_MEASUREMENT lamb_sp_tqi lv_tq_lamb_act eff_lamb_sp eff_lamb_sp_1 tqi_fast_lamb lamb_dif_sp /end OUT_MEASUREMENT
/end FUNCTION
/begin FUNCTION TQM_Dynamic_torque_intervention_ "_Dynamic torque intervention manager" /begin DEF_CHARACTERISTIC c_tq_delta_eco_mod c_tq_delta_max_comp c_state_tq_dyn_lamb /end DEF_CHARACTERISTIC
 /begin OUT_MEASUREMENT lv_tq_fast_ena lv_tq_iga_ena state_tq_dyn_iga lv_lamb_tq_ctl lv_tq_lamb_inh lv_tq_lamb_ena tqi_req_fast_dtm tqi_req_fast_dtm_can tqi_req_slow_dtm state_tq_dyn_lamb /end OUT_MEASUREMENT
/end FUNCTION
/begin FUNCTION TQM_Torque_loss_for_power_steeri "_Torque loss for power steering"
 /begin DEF_CHARACTERISTIC lc_pste_ena ip_tq_loss_pste ip_tq_add_pste ip_fac_tq_loss_pste lc_pste_2_ena ldpm_n_32__pste_2 ldpm_t_pste_2__pste_2 ip_fac_tq_loss_pste_2_sp ip_fac_tq_loss_pste_2_av c_fac_tq_loss_pste_2_grd c_fac_tq_loss_pste_2_dif c_tq_loss_pste_2_sp_min /end DEF_CHARACTERISTIC
 /begin OUT_MEASUREMENT tq_loss_pste lv_pste_disable lv_pste_disable_can lv_pste_ena tq_add_pste tq_loss_pste_1 lv_pste_2_disable lv_pste_2_disable_can lv_pste_2_ena tq_loss_pste_2_av tq_loss_pste_2_sp tq_loss_pste_2_dif tq_loss_pste_2_grd tq_loss_pste_2 t_pste_2 /end OUT_MEASUREMENT
/end FUNCTION
/begin FUNCTION TQM_Appl_IncTorque_loss_and_rese "_Appl IncTorque loss and reserve for ACC" /end FUNCTION
/begin FUNCTION TQM_Application_incidences_for_t "_Application incidences for torque based pattern calculation"
 /begin DEF_CHARACTERISTIC c_maf_dif_min_fcut_fast c_t_max_fcut_fast c_tco_min_fcut_fast /end DEF_CHARACTERISTIC
 /begin OUT_MEASUREMENT lv_cs_chg lv_fcut_fast lv_ct_chg /end OUT_MEASUREMENT
/end FUNCTION
/begin FUNCTION TQM_Torque_Reserve_for_Torque_Tr "_Torque Reserve for Torque Transient" /begin DEF_CHARACTERISTIC ip_tq_add_tra__n_32 ip_fac_tq_tra__tq_req_dif_tra /end DEF_CHARACTERISTIC /begin OUT_MEASUREMENT tq_add_tra_1 tq_add_tra_2 fac_tq_tra tq_add_tra /end OUT_MEASUREMENT /end FUNCTION
/begin FUNCTION TQM_Dynamic_Torque_request_coord "_Dynamic Torque request coordination"
 /begin DEF_CHARACTERISTIC lc_tq_dyn_driv lc_tq_dyn_driv_inh lc_tq_dyn_req_man lc_tq_dyn_0_req lc_tq_dyn_1_req c_vs_min_dt_fast c_vs_max_fast /end DEF_CHARACTERISTIC
 /begin OUT_MEASUREMENT lv_tq_dyn_1_req lv_tq_dyn_0_driv lv_tq_dyn_1_driv lv_tq_dyn_driv lv_tq_dyn_0_req /end OUT_MEASUREMENT
/end FUNCTION
/begin FUNCTION TQM_Separation_for_slow_and_fast "_Separation for slow and fast path torque request"
 /begin DEF_CHARACTERISTIC c_fac_dyn_driv_ct c_fac_dyn_driv lc_tqi_req_tra_slow_sel lc_tqi_req_tra_fast_tran_inh c_fac_tqi_req_tra_hpf c_fac_tqi_req_tra_slow c_fac_dyn_driv_dt /end DEF_CHARACTERISTIC
 /begin OUT_MEASUREMENT tqi_req_tra_slow tq_req_tra_slow tq_req_tra_fast tqi_req_tra_fast tqi_req_tra_1 tqi_req_driv fac_dyn_driv /end OUT_MEASUREMENT
/end FUNCTION
/begin FUNCTION TQM_Anti_Jerk_Controller_Activat "_Anti Jerk Controller Activation Conditions"
 /begin DEF_CHARACTERISTIC c_n_dif_aj_ac_1 c_n_dif_aj_ac_2 c_n_dif_aj_deacc_1 c_n_dif_aj_deacc_2 c_n_thd_max_aj c_n_thd_min_aj c_t_act_max_aj lc_aj_inh_at lc_aj_deacc lc_aj_ac lc_aj_inh_dt lc_state_cc_open lc_state_cc_controlled lc_state_cc_dft lc_state_cc_close lc_state_clu_amt_open lc_state_clu_amt_creeping lc_state_clu_amt_drive_off lc_state_clu_amt_closed lc_state_clu_amt_dft /end DEF_CHARACTERISTIC
 /begin OUT_MEASUREMENT lv_pas_aj lv_req_aj lv_ini_aj lv_act_aj state_cc_aj state_clu_amt_aj /end OUT_MEASUREMENT
/end FUNCTION
/begin FUNCTION TQM_Minimum_indicated_engine_tor "_Minimum indicated engine torque at trailing throttle"
 /begin DEF_CHARACTERISTIC c_tqi_bol_set_hys c_dip_max ip_maf_min_pu ip_maf_min_pu_rng_l ip_maf_add_puc ip_maf_add_puc_rng_l lc_maf_min_pu_dri /end DEF_CHARACTERISTIC
 /begin OUT_MEASUREMENT tqi_min_pu lv_tqi_bol_set tqi_bol maf_min_pu_1 maf_min_pu_2 maf_min_pu map_min /end OUT_MEASUREMENT
/end FUNCTION
/begin FUNCTION TQM_Coordination_of_additional_t "_Coordination of additional torque losses" /begin OUT_MEASUREMENT tq_loss_add /end OUT_MEASUREMENT /end FUNCTION
/begin FUNCTION TQM_Torque_request_for_AMT_inter "_Torque request for AMT intervention"
 /begin DEF_CHARACTERISTIC c_lgrd_lih_amt_dec c_lgrd_lih_amt_inc c_t_dly_lih_amt_dec c_t_dly_lih_amt_inc c_amt_ena_inc_dec /end DEF_CHARACTERISTIC
 /begin OUT_MEASUREMENT lv_amt_disable lv_amt_disable_can lv_amt_ena_dec lv_amt_ena_inc lv_amt_ena tqi_amt_fast_dec_req tqi_amt_fast_dec_req_1 tqi_amt_slow_dec_req tqi_amt_slow_dec_req_1 tqi_amt_fast_inc_req tqi_amt_fast_inc_req_1 tqi_amt_slow_inc_req tqi_amt_slow_inc_req_1 tqi_amt_fast_dec tqi_amt_slow_dec lv_amt_dec_act tqi_amt_fast_inc tqi_amt_slow_inc lv_amt_dec_lih lv_amt_inc_act lv_amt_inc_lih /end OUT_MEASUREMENT
/end FUNCTION
/begin FUNCTION TQM_AMT_Clutch_torque "_AMT Clutch torque"
 /begin DEF_CHARACTERISTIC ip_tq_amt ip_tq_vs_fil_amt ip_tq_add_amt c_tq_thd_amt_isc c_tq_add_amt_lgrd c_tq_lgrd_crawl_inc c_tq_lgrd_crawl_dec /end DEF_CHARACTERISTIC
 /begin OUT_MEASUREMENT tq_clu_amt lv_amt_crawl_on tq_add_amt lv_tout_amt t_amt /end OUT_MEASUREMENT
/end FUNCTION
/begin FUNCTION TQM_Torque_request_for_distance_ "_Torque request for distance cruise control" /begin DEF_CHARACTERISTIC c_lgrd_lih_dcc_inc c_t_dly_lih_dcc_inc /end DEF_CHARACTERISTIC
 /begin OUT_MEASUREMENT lv_dcc_disable_can tqi_dcc_fast_inc_req tqi_dcc_fast_inc_req_1 tqi_dcc_slow_inc_req tqi_dcc_slow_inc_req_1 tqi_dcc_fast_inc lv_dcc_ena_inc lv_dcc_inc_act tqi_dcc_slow_inc lv_dcc_inc_lih t_dcc_lih_ctr /end OUT_MEASUREMENT
/end FUNCTION
/begin FUNCTION TQM_Torque_Request_for_Traction_ "_Torque Request for Traction Control TCS"
 /begin DEF_CHARACTERISTIC c_lgrd_lih_asr c_t_dly_lih_asr c_t_dly_lih_msr lc_msr_disable c_lgrd_lih_msr c_tq_max_msr lc_asr_disable /end DEF_CHARACTERISTIC
 /begin OUT_MEASUREMENT lv_asr_plaus lv_msr_plaus lv_asr_ena lv_msr_ena tqi_msr_fast_req tqi_msr_slow_req sf_tqd lv_tcs_disable tqi_asr_slow tqi_asr_fast_req tqi_asr_fast_req_1 tqi_asr_slow_req tqi_msr_fast_req_1 tqi_asr_slow_req_1 tqi_msr_slow_req_1 tqi_asr_fast tqi_msr_fast tqi_msr_slow lv_msr_lih lv_msr_act lv_asr_act lv_tcs_ena lv_tcs_disable_can lv_asr_lih t_asr_lih_ctr t_msr_lih_ctr /end OUT_MEASUREMENT
/end FUNCTION
/begin FUNCTION TQM_Torque_Loss___Anti_Roll_Stab "_Torque Loss - Anti-Roll-Stabilisation"
 /begin DEF_CHARACTERISTIC ip_tq_loss_ars_sp_max ip_tq_loss_ars_av_max ip_tq_loss_ars_sp_can_max ip_tq_loss_ars_av_can_max c_fac_tq_loss_ars_grd c_fac_tq_loss_ars_dif c_t_dly_tq_max_ars c_tq_loss_ars_sp_ofs c_tq_loss_ars_av_ofs c_v_max_ars_diag c_n_max_ars_diag /end DEF_CHARACTERISTIC
 /begin OUT_MEASUREMENT lv_ars_disable lv_ars_disable_can lv_ars_ena lv_tq_max_ars tq_loss_ars_sp_max tq_loss_ars_sp_max_1 tq_loss_ars_av_max_1 t_dly_tq_max_ars tq_loss_ars tq_loss_ars_av_max tq_loss_ars_grd tq_loss_ars_dif /end OUT_MEASUREMENT
/end FUNCTION
/begin FUNCTION TQM_Alternator_torque_losses "_Alternator torque losses" /begin DEF_CHARACTERISTIC ip_tq_loss_alter /end DEF_CHARACTERISTIC /begin OUT_MEASUREMENT tq_loss_alter /end OUT_MEASUREMENT /end FUNCTION
/begin FUNCTION GEN_General "GEN" /begin SUB_FUNCTION GEN_Variant_coding GEN_Initialisation_of_variables_ /end SUB_FUNCTION /end FUNCTION
/begin FUNCTION GEN_Variant_coding "_Variant coding"
 /begin DEF_CHARACTERISTIC c_var_st c_eng_conf c_conf_swi_efp_out c_conf_dmtl c_v_var_amp_thd_min c_v_var_amp_thd_max c_conf_oil_level_sens c_conf_cat /end DEF_CHARACTERISTIC
 /begin OUT_MEASUREMENT lv_var_asr lv_var_asr_3 lv_at lv_var_icl lv_var_acin lv_var_txu lv_ivvt_in_and_ex cam_type lv_inj_conf lv_isa_conf lv_var_st eng_conf vim_type lv_var_msw lv_var_sof lv_cbk_mpl conf_oil_level_sens lv_conf_dmtl lv_sof_conf conf_sof_swi lv_var_ecras lv_var_sap lv_var_ef lv_var_lsh_up lv_var_lsh_down psn_ls psn_ls_1 lv_var_ebox_cfa lv_var_rly_st lv_var_sav lv_var_rly_accout /end OUT_MEASUREMENT
/end FUNCTION
/begin FUNCTION GEN_Initialisation_of_variables_ "_Initialisation of variables from non implemented functions" /begin OUT_MEASUREMENT state_sav_diag lv_err_vs lv_mtc_lih_act ntl online_dummy /end OUT_MEASUREMENT /end FUNCTION
/begin FUNCTION SEC_Serial_Communication "SEC"
 /begin SUB_FUNCTION SEC_Idle_Speed_Setpoint_offset_b SEC_Input_Output_Control SEC_Constants_for_EOBD SEC_Immobilizer SEC_Actuator_Diagnosis_Fuel_Inje SEC_Idle_CO__Adjustment SEC_Start_routine_by_local_ident /end SUB_FUNCTION
/end FUNCTION
/begin FUNCTION SEC_Idle_Speed_Setpoint_offset_b "_Idle Speed Setpoint offset by tester (KWP)"
 /begin DEF_CHARACTERISTIC c_n_ofs_acc_dri_min c_n_ofs_dri_max c_n_ofs_dri_min c_n_ofs_max c_n_ofs_min c_n_ofs_acc_max c_n_ofs_acc_min c_n_ofs_vb_max c_n_ofs_vb_min c_tco_min_n_ofs_kwp lc_n_ofs_kwp_disable c_cha_cdn_bat_kwp_min c_n_ofs_acc_dri_max /end DEF_CHARACTERISTIC
 /begin OUT_MEASUREMENT n_kwp_ofs_acc n_kwp_ofs n_kwp_ofs_vb_nvmy n_kwp_ofs_acc_nvmy n_kwp_ofs_nvmy n_kwp_ofs_dri_nvmy n_kwp_ofs_acc_dri_nvmy lv_kwp_ena n_sp_ofs_kwp n_kwp_ofs_acc_dri n_kwp_ofs_dri n_kwp_ofs_vb lv_act_n_sp_is_bas_ext_adj /end OUT_MEASUREMENT
/end FUNCTION
/begin FUNCTION SEC_Input_Output_Control "_Input Output Control" /begin DEF_CHARACTERISTIC c_n_max_kwp c_vs_max_kwp /end DEF_CHARACTERISTIC
 /begin OUT_MEASUREMENT fac_fco_kwp eol_ram[0] eol_ram[1] eol_ram[2] eol_ram[3] eol_ram[4] n_sp_is_ext_adj lv_act_n_sp_is_ext_adj lv_eol_cps lv_act_vls_eol_ext_adj /end OUT_MEASUREMENT
/end FUNCTION
/begin FUNCTION SEC_Constants_for_EOBD "_Constants for EOBD"
 /begin DEF_CHARACTERISTIC c_mod_1_pid_2_diag c_mod_1_pid_3_diag c_mod_1_pid_4_diag c_mod_1_pid_5_diag c_mod_1_pid_6_diag c_mod_1_pid_7_diag c_mod_1_pid_8_diag c_mod_2_pid_1_diag c_mod_2_pid_2_diag c_mod_2_pid_3_diag c_mod_2_pid_4_diag c_obd_req c_mod_1_pid_1_diag c_mod_6_tid_2_diag c_mod_6_tid_3_diag c_mod_6_tid_4_diag c_mod_6_tid_1_diag c_mod_9_vit_2_diag c_mod_9_vit_3_diag c_mod_9_vit_4_diag c_mod_9_vit_1_diag c_mod_8_tid_2_diag c_mod_8_tid_3_diag c_mod_8_tid_1_diag c_mod_8_tid_4_diag c_mod_5_tid_2_diag c_mod_5_tid_3_diag c_mod_5_tid_4_diag c_mod_5_tid_1_diag c_mod_5_tid_5_diag /end DEF_CHARACTERISTIC
/end FUNCTION
/begin FUNCTION SEC_Immobilizer "_Immobilizer" /begin OUT_MEASUREMENT rls_mpl_value_prog state_imob nr_free_startvalues /end OUT_MEASUREMENT /end FUNCTION
/begin FUNCTION SEC_Actuator_Diagnosis_Fuel_Inje "_Actuator Diagnosis Fuel Injectors"
 /begin DEF_CHARACTERISTIC c_ti_ext_adj_min c_ti_ext_adj_max c_ti_per_ext_adj_max c_ti_per_ext_adj_min /end DEF_CHARACTERISTIC
 /begin OUT_MEASUREMENT ti_ext_adj[0] ti_ext_adj[1] ti_ext_adj[2] ti_ext_adj[3] ti_ext_adj[4] ti_ext_adj[5] ti_per_ext_adj[0] ti_per_ext_adj[1] ti_per_ext_adj[2] ti_per_ext_adj[3] ti_per_ext_adj[4] ti_per_ext_adj[5] lv_ti_ext_adj[0] lv_ti_ext_adj[1] lv_ti_ext_adj[2] lv_ti_ext_adj[3] lv_ti_ext_adj[4] lv_ti_ext_adj[5] /end OUT_MEASUREMENT
/end FUNCTION
/begin FUNCTION SEC_Idle_CO__Adjustment "_Idle CO- Adjustment" /begin OUT_MEASUREMENT ti_co_is_perc /end OUT_MEASUREMENT /end FUNCTION
/begin FUNCTION SEC_Start_routine_by_local_ident "_Start routine by local identifier service" /begin OUT_MEASUREMENT lv_inh_lam_kwp /end OUT_MEASUREMENT /end FUNCTION
/begin FUNCTION CRU_Cruise_control "CRU"
 /begin SUB_FUNCTION CRU_General__calculation_of_crui CRU_Controlled_acceleration CRU_Actuating_the_reference_inpu CRU_Intercepting_the_reference_i CRU_Interventions CRU_Ready_state_and_display CRU_Evaluation_serial_data_line_ CRU_Conditions_for_cruise_contro CRU_Additional_functions CRU_Step_cruise_control /end SUB_FUNCTION
/end FUNCTION
/begin FUNCTION CRU_General__calculation_of_crui "_General  calculation of cruise control and constant drive"
 /begin DEF_CHARACTERISTIC c_vs_dif_min_is_cru c_vs_dif_max_is_cru c_vs_dif_rng_cru c_t_min_puc_cru ip_fac_prop_cru ip_fac_tq_cru_ini_add_at ip_fac_tq_cru_ini_add_mt c_fac_vs_dif_rng_cru ip_fac_tq_cru_dec__n_32 ip_fac_vs_dif_i_cru ip_fac_vs_sp_dif_i_cru c_fac_tq_cru_lgrd c_fac_tq_cru_max /end DEF_CHARACTERISTIC
 /begin OUT_MEASUREMENT vs_dif_i_cru vs_dif_cru fac_tq_cru_ini fac_tq_cru state_i_cru /end OUT_MEASUREMENT
/end FUNCTION
/begin FUNCTION CRU_Controlled_acceleration "_Controlled acceleration" /begin DEF_CHARACTERISTIC c_vs_dif_max_ac_cru c_vs_dif_min_ac_cru /end DEF_CHARACTERISTIC /begin OUT_MEASUREMENT t_ctl_cru vs_sp_cru vs_sp_dif_cru /end OUT_MEASUREMENT /end FUNCTION
/begin FUNCTION CRU_Actuating_the_reference_inpu "_Actuating the reference input variable"
 /begin DEF_CHARACTERISTIC ip_fac_cru_rest__t_ctl_cru ip_fac_cru_ac__t_ctl_cru ip_fac_cru_dece__t_ctl_cru ip_fac_cc_cru_ac__t_ctl_cru ip_fac_cc_cru_dece__t_ctl_cru /end DEF_CHARACTERISTIC
 /begin OUT_MEASUREMENT fac_vs_ctl_cru /end OUT_MEASUREMENT
/end FUNCTION
/begin FUNCTION CRU_Intercepting_the_reference_i "_Intercepting the reference input variable target acceleration"
 /begin DEF_CHARACTERISTIC c_vs_ac_min_cru c_vs_ac_max_cru ip_fac_lgrd_cru_rest__vs_sp_dif ip_fac_lgrd_cru_tip__vs_sp_dif c_fac_ac_pos_cru c_fac_ac_pos_cru_rng_l /end DEF_CHARACTERISTIC
 /begin OUT_MEASUREMENT fac_vs_lgrd_cru /end OUT_MEASUREMENT
/end FUNCTION
/begin FUNCTION CRU_Interventions "_Interventions"
 /begin DEF_CHARACTERISTIC c_vs_dif_max_cru c_ac_pos_cru_tip c_ac_neg_cru_tip c_ac_neg_cru_deacc c_ac_pos_cru_deacc c_t_min_cru_con ip_ac_neg_cru_ac__n__fac_tq_cru c_vs_dif_delta_i c_ac_pos_cru_resu c_ac_pos_cru_resu_rng_l c_ac_pos_cru_ac c_ac_pos_cru_ac_rng_l ip_ac_neg_cru_resu c_vs_sp_cru_max /end DEF_CHARACTERISTIC
 /begin OUT_MEASUREMENT vs_sp_inc_cru vs_sp_dec_cru vs_sp_driv_cru lv_cru_over_act_ack /end OUT_MEASUREMENT
/end FUNCTION
/begin FUNCTION CRU_Ready_state_and_display "_Ready state and display"
 /begin DEF_CHARACTERISTIC lc_cru_req_swi c_t_crus_on c_t_ready_cru c_t_crus c_t_crus_off /end DEF_CHARACTERISTIC
 /begin OUT_MEASUREMENT lv_cru_main_swi /end OUT_MEASUREMENT
/end FUNCTION
/begin FUNCTION CRU_Evaluation_serial_data_line_ "_Evaluation serial data line from the MSW" /begin DEF_CHARACTERISTIC c_t_min_msw /end DEF_CHARACTERISTIC /begin OUT_MEASUREMENT state_msw_can req_msw /end OUT_MEASUREMENT /end FUNCTION
/begin FUNCTION CRU_Conditions_for_cruise_contro "_Conditions for cruise control"
 /begin DEF_CHARACTERISTIC c_t_cru_esp_off c_t_cru_asr_off c_t_cru_esp_brake_off c_vs_min_plaus_cru c_t_dly_vs_sp_cru_max c_n_vs_max_cru c_ac_max_cru c_vs_min_cru /end DEF_CHARACTERISTIC
 /begin OUT_MEASUREMENT lv_cru_off_by_asr_esp_ctl req_cru lv_cru_off_irr lv_cru_act state_cru_can state_cru_off_rev state_cru_off_irr state_cru /end OUT_MEASUREMENT
/end FUNCTION
/begin FUNCTION CRU_Additional_functions "_Additional functions"
 /begin DEF_CHARACTERISTIC c_t_err_vs_can c_fac_vs_fil c_vs_max_diag c_fac_tq_req_driv_mmv c_fac_ac_cru_mmv lc_vs_cru_fil c_crlc_vs_cru_mmv c_t_dly_max_cru c_vs_sp_dif_min_cru c_vs_sp_dif_max_cru c_vs_dif_dly_cru_neg c_fac_tq_req_hys_cru c_vs_dif_dly_cru_pos c_vs_dif_min_cru_over /end DEF_CHARACTERISTIC
 /begin OUT_MEASUREMENT ac_cru lv_vs_diag_not_plaus fac_tq_req_driv_mmv n_vs_cru vs_fil t_err_vs_can vs_cru vs_dif_icl_tcs t_dly_cru lv_cru_over_act /end OUT_MEASUREMENT
/end FUNCTION
/begin FUNCTION CRU_Step_cruise_control "_Step cruise control"
 /begin DEF_CHARACTERISTIC c_vs_dif_step_prog_m c_vs_dif_step_prog_k c_vs_dif_step_min c_vs_dif_tip_prog c_vs_min_prog c_max_step c_t_cru_flash_light c_t_dly_cru_tip c_t_min_prog /end DEF_CHARACTERISTIC
 /begin OUT_MEASUREMENT nr_step_on count_vs_step vs_dif_step_prog lv_prog_step_1 lv_step_on vs_sp_driv_step nr_vs_cru vs_sp_driv_cru_can vs_step_can_1 vs_step_can_2 vs_step_can_3 /end OUT_MEASUREMENT
/end FUNCTION
/begin FUNCTION BGO_Basic_SW_General_Operation "BGO" /begin SUB_FUNCTION BGO_Non_volatile_datas /end SUB_FUNCTION /end FUNCTION
/begin FUNCTION BGO_Non_volatile_datas "_Non volatile datas"
 /begin DEF_CHARACTERISTIC lc_ad_clr_knk lc_ad_clr_lam lc_ad_clr_tco lc_ad_clr_tps lc_ad_clr_mis lc_ad_clr_ivvt lc_ad_clr_imm lc_ad_clr_idle lc_ad_clr_ati lc_ad_clr_toil lc_ad_clr_ecf lc_ad_clr_sa lc_ad_clr_n_sp_is lc_ad_clr_ron lc_ad_clr_tecu lc_ad_clr_var lc_ad_clr_dmtl lc_ad_clr_sof lc_ad_clr_n_max lc_ad_clr_lif lc_ad_clr_oz lc_ad_clr_tqi_lim lc_ad_clr_teg lc_ad_clr lc_ad_clr_obd2 lc_ad_clr_cru c_nvmy_inst_chk lc_ad_clr_can /end DEF_CHARACTERISTIC
 /begin OUT_MEASUREMENT lv_nvmy_rd_failed lv_nvmy_wr_failed nvmy_e2p_address /end OUT_MEASUREMENT
/end FUNCTION
/begin FUNCTION EOL_End_of_line_test ""
 /begin SUB_FUNCTION EOL_End_of_line_test_Lambda_sens EOL_Lambda_setpoint_for_external EOL_SA_System_test /end SUB_FUNCTION
/end FUNCTION
/begin FUNCTION EOL_End_of_line_test_Lambda_sens "_End of line test Lambda sensors confused wrong wired"
 /begin DEF_CHARACTERISTIC c_tco_min_vls_eol c_teg_cat_down_eol c_maf_int_min_vls_eol c_lamb_sp_vls_eol_afr c_lamb_sp_vls_eol_afl c_vls_afr_eol c_vls_afl_eol /end DEF_CHARACTERISTIC
 /begin OUT_MEASUREMENT state_vls_eol lamb_sp_vls_eol_2 lamb_sp_vls_eol_1 maf_int_min_vls_eol vls_up_afr_1_eol vls_up_afr_2_eol vls_up_afl_2_eol vls_up_afl_1_eol vls_down_afl_1_eol vls_down_afl_2_eol vls_down_afr_1_eol vls_down_afr_2_eol lv_act_vls_eol /end OUT_MEASUREMENT
/end FUNCTION
/begin FUNCTION EOL_Lambda_setpoint_for_external "_Lambda setpoint for external adjustment"
 /begin OUT_MEASUREMENT lamb_sp_ext_adj_1 lamb_sp_ext_adj_2 lv_lamb_sp_ext_adj_1 lv_lamb_sp_ext_adj_2 /end OUT_MEASUREMENT
/end FUNCTION
/begin FUNCTION EOL_SA_System_test "_SA System test" /begin DEF_CHARACTERISTIC c_tco_min_sa_eol /end DEF_CHARACTERISTIC /begin OUT_MEASUREMENT lv_act_sa_eol /end OUT_MEASUREMENT /end FUNCTION
/begin FUNCTION C_Y_Byp_Sim "" /begin SUB_FUNCTION Bypass_Simulation /end SUB_FUNCTION /end FUNCTION
/begin FUNCTION Bypass_Simulation "Bypass_Simulation"
 /begin DEF_CHARACTERISTIC c_byp_lih_cnt_max_A c_byp_lih_cnt_max_B c_byp_on c_byp_func_A c_byp_func_B /end DEF_CHARACTERISTIC
 /begin OUT_MEASUREMENT lv_byp_on byp_cnt_A byp_cnt_B byp_error /end OUT_MEASUREMENT
/end FUNCTION
/begin FUNCTION C_A_DIA "" /begin SUB_FUNCTION DIA_IS_Control_Diag DIA_IS_Control_Diag__AI /end SUB_FUNCTION /end FUNCTION
/begin FUNCTION DIA_IS_Control_Diag "_IS_Control_Diag"
 /begin DEF_CHARACTERISTIC c_maf_max_diag_isc c_n_dif_max_diag_isc c_n_dif_min_diag_isc c_t_dly_isc_diag c_abc_inc_isc c_abc_dec_isc c_flow_cps_max_diag_isc c_abc_max_isc lc_inh_diag_isc_man /end DEF_CHARACTERISTIC
 /begin OUT_MEASUREMENT t_isc_diag /end OUT_MEASUREMENT
/end FUNCTION
/begin FUNCTION DIA_IS_Control_Diag__AI "_IS_Control_Diag__AI" /begin OUT_MEASUREMENT lv_err_isc /end OUT_MEASUREMENT /end FUNCTION
/begin FUNCTION DIBS ""
 /begin DEF_CHARACTERISTIC IBBSTERR1 IBBSTERR2 IBBSTERR3 IBBSTERR4 IBBSTERR5 IBBSTERR6 IBBSTERR7 IBBSTERR8 IBBSTHEAL MSKIBSDFP MSKIBSDIAG /end DEF_CHARACTERISTIC
 /begin OUT_MEASUREMENT B_doibdig1 B_doibdig2 B_doibdig3 diberrctr1 diberrctr2 diberrctr3 diberrctr4 diberrctr5 diberrctr6 diberrctr7 diberrctr8 dibhealct1 dibhealct2 dibhealct3 ibfehlin1 ibfehlin2 ibfehlin3 ibfehlin4 ibfehlin5 ibfehlin6 ibfehlin7 ibfehlin8 ibsderrs1 ibsderrs2 ibserstat1 ibserstat2 ibserstat3 locerr0 locerr1 /end OUT_MEASUREMENT
/end FUNCTION
/begin FUNCTION ENRD "" /begin SUB_FUNCTION ENRD_Calculation ENRD_Calculation_Appli_Inci /end SUB_FUNCTION /end FUNCTION
/end MODULE
/end PROJECT
