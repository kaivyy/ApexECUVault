ASAP2_VERSION 1 3
/begin PROJECT P411 "BMW DDE6.0 6-Zylinder V66.1 07.01.2004 CAN12H"
/begin HEADER "" VERSION "V571_6Z_CAN12H" PROJECT_NO P411 /end HEADER
/begin MODULE DIM ""
/begin MOD_COMMON "" BYTE_ORDER MSB_FIRST ALIGNMENT_BYTE 1 ALIGNMENT_WORD 2 ALIGNMENT_LONG 4 ALIGNMENT_FLOAT32_IEEE 4 /end MOD_COMMON
/begin CHARACTERISTIC DSM_EnvDfp_Layer_TANS_C "Fehlerpfad spezifische Umweltbedingungen fuer Fehlerpfad Dfp_Layer_TANS" VAL_BLK 0xCA694 Kwb_Wu8 255.000000000 SigName 0.00 255.000000000 FORMAT "%13.9" NUMBER 10 /end CHARACTERISTIC
/begin CHARACTERISTIC DSM_EnvDfp_ACCDCmpr_C "Fehlerpfad spezifische Umweltbedingungen fuer Fehlerpfad Dfp_ACCDCmpr" VAL_BLK 0xCA69E Kwb_Wu8 255.000000000 SigName 0.00 255.000000000 FORMAT "%13.9" NUMBER 10 /end CHARACTERISTIC
/begin CHARACTERISTIC DSM_EnvDfp_ACCDPres_C "Fehlerpfad spezifische Umweltbedingungen fuer Fehlerpfad Dfp_ACCDPres" VAL_BLK 0xCA6A8 Kwb_Wu8 255.000000000 SigName 0.00 255.000000000 FORMAT "%13.9" NUMBER 10 /end CHARACTERISTIC
/begin CHARACTERISTIC DSM_EnvDfp_ACCDPres1_C "Fehlerpfad spezifische Umweltbedingungen fuer Fehlerpfad Dfp_ACCDPres1" VAL_BLK 0xCA6B2 Kwb_Wu8 255.000000000 SigName 0.00 255.000000000 FORMAT "%13.9" NUMBER 10 /end CHARACTERISTIC
/begin CHARACTERISTIC DSM_EnvDfp_ACCDPresAna_C "Fehlerpfad spezifische Umweltbedingungen fuer Fehlerpfad Dfp_ACCDPresAna" VAL_BLK 0xCA6BC Kwb_Wu8 255.000000000 SigName 0.00 255.000000000 FORMAT "%13.9" NUMBER 10 /end CHARACTERISTIC
/begin CHARACTERISTIC DSM_EnvDfp_ACCDSwtin_C "Fehlerpfad spezifische Umweltbedingungen fuer Fehlerpfad Dfp_ACCDSwtin" VAL_BLK 0xCA6C6 Kwb_Wu8 255.000000000 SigName 0.00 255.000000000 FORMAT "%13.9" NUMBER 10 /end CHARACTERISTIC
/begin CHARACTERISTIC DSM_EnvDfp_ACC_PlausTrqDes_C "Fehlerpfad spezifische Umweltbedingungen fuer Fehlerpfad Dfp_ACC_PlausTrqDes" VAL_BLK 0xCA6D0 Kwb_Wu8 255.000000000 SigName 0.00 255.000000000 FORMAT "%13.9" NUMBER 10 /end CHARACTERISTIC
/begin CHARACTERISTIC DSM_EnvDfp_ACC_trqInr_C "Fehlerpfad spezifische Umweltbedingungen fuer Fehlerpfad Dfp_ACC_trqInr" VAL_BLK 0xCA6DA Kwb_Wu8 255.000000000 SigName 0.00 255.000000000 FORMAT "%13.9" NUMBER 10 /end CHARACTERISTIC
/begin CHARACTERISTIC DSM_EnvDfp_ACTrq_C "Fehlerpfad spezifische Umweltbedingungen fuer Fehlerpfad Dfp_ACTrq" VAL_BLK 0xCA6E4 Kwb_Wu8 255.000000000 SigName 0.00 255.000000000 FORMAT "%13.9" NUMBER 10 /end CHARACTERISTIC
/begin CHARACTERISTIC DSM_EnvDfp_ADCMon_C "Fehlerpfad spezifische Umweltbedingungen fuer Fehlerpfad Dfp_ADCMon" VAL_BLK 0xCA6EE Kwb_Wu8 255.000000000 SigName 0.00 255.000000000 FORMAT "%13.9" NUMBER 10 /end CHARACTERISTIC
/begin CHARACTERISTIC DSM_EnvDfp_AFSCDIdlAdjVal_C "Fehlerpfad spezifische Umweltbedingungen fuer Fehlerpfad Dfp_AFSCDIdlAdjVal" VAL_BLK 0xCA6F8 Kwb_Wu8 255.000000000 SigName 0.00 255.000000000 FORMAT "%13.9" NUMBER 10 /end CHARACTERISTIC
/begin CHARACTERISTIC DSM_EnvDfp_AFSCDLdAdjVal_C "Fehlerpfad spezifische Umweltbedingungen fuer Fehlerpfad Dfp_AFSCDLdAdjVal" VAL_BLK 0xCA702 Kwb_Wu8 255.000000000 SigName 0.00 255.000000000 FORMAT "%13.9" NUMBER 10 /end CHARACTERISTIC
/begin CHARACTERISTIC DSM_EnvDfp_AFSCD_AirTempDcyc_C "Fehlerpfad spezifische Umweltbedingungen fuer Fehlerpfad Dfp_AFSCD_AirTempDcyc" VAL_BLK 0xCA70C Kwb_Wu8 255.000000000 SigName 0.00 255.000000000 FORMAT "%13.9" NUMBER 10 /end CHARACTERISTIC
/begin CHARACTERISTIC DSM_EnvDfp_AFSCD_PlOffsDrft_C "Fehlerpfad spezifische Umweltbedingungen fuer Fehlerpfad Dfp_AFSCD_PlOffsDrft" VAL_BLK 0xCA716 Kwb_Wu8 255.000000000 SigName 0.00 255.000000000 FORMAT "%13.9" NUMBER 10 /end CHARACTERISTIC
/begin CHARACTERISTIC DSM_EnvDfp_AFSCD_PlSetyDrft_C "Fehlerpfad spezifische Umweltbedingungen fuer Fehlerpfad Dfp_AFSCD_PlSetyDrft" VAL_BLK 0xCA720 Kwb_Wu8 255.000000000 SigName 0.00 255.000000000 FORMAT "%13.9" NUMBER 10 /end CHARACTERISTIC
/begin CHARACTERISTIC DSM_EnvDfp_AFSCD_SRCAirTemp_C "Fehlerpfad spezifische Umweltbedingungen fuer Fehlerpfad Dfp_AFSCD_SRCAirTemp" VAL_BLK 0xCA72A Kwb_Wu8 255.000000000 SigName 0.00 255.000000000 FORMAT "%13.9" NUMBER 10 /end CHARACTERISTIC
/begin CHARACTERISTIC DSM_EnvDfp_AFSCD_SRCBatt_C "Fehlerpfad spezifische Umweltbedingungen fuer Fehlerpfad Dfp_AFSCD_SRCBatt" VAL_BLK 0xCA734 Kwb_Wu8 255.000000000 SigName 0.00 255.000000000 FORMAT "%13.9" NUMBER 10 /end CHARACTERISTIC
/begin CHARACTERISTIC DSM_EnvDfp_AFSCD_SRCCorrAirm_C "Fehlerpfad spezifische Umweltbedingungen fuer Fehlerpfad Dfp_AFSCD_SRCCorrAirm" VAL_BLK 0xCA73E Kwb_Wu8 255.000000000 SigName 0.00 255.000000000 FORMAT "%13.9" NUMBER 10 /end CHARACTERISTIC
/begin CHARACTERISTIC DSM_EnvDfp_AFSCD_SRCRawAirm_C "Fehlerpfad spezifische Umweltbedingungen fuer Fehlerpfad Dfp_AFSCD_SRCRawAirm" VAL_BLK 0xCA748 Kwb_Wu8 255.000000000 SigName 0.00 255.000000000 FORMAT "%13.9" NUMBER 10 /end CHARACTERISTIC
/begin CHARACTERISTIC DSM_EnvDfp_Layer_TUMG_C "Fehlerpfad spezifische Umweltbedingungen fuer Fehlerpfad Dfp_Layer_TUMG" VAL_BLK 0xCA752 Kwb_Wu8 255.000000000 SigName 0.00 255.000000000 FORMAT "%13.9" NUMBER 10 /end CHARACTERISTIC
/begin CHARACTERISTIC DSM_EnvDfp_AFSCD_SRCRefSigPer_C "Fehlerpfad spezifische Umweltbedingungen fuer Fehlerpfad Dfp_AFSCD_SRCRefSigPer" VAL_BLK 0xCA75C Kwb_Wu8 255.000000000 SigName 0.00 255.000000000 FORMAT "%13.9" NUMBER 10 /end CHARACTERISTIC
/begin CHARACTERISTIC DSM_EnvDfp_AOHtCD_C "Fehlerpfad spezifische Umweltbedingungen fuer Fehlerpfad Dfp_AOHtCD" VAL_BLK 0xCA766 Kwb_Wu8 255.000000000 SigName 0.00 255.000000000 FORMAT "%13.9" NUMBER 10 /end CHARACTERISTIC
/begin CHARACTERISTIC DSM_EnvDfp_Layer_GEN_C "Fehlerpfad spezifische Umweltbedingungen fuer Fehlerpfad Dfp_Layer_GEN" VAL_BLK 0xCA770 Kwb_Wu8 255.000000000 SigName 0.00 255.000000000 FORMAT "%13.9" NUMBER 10 /end CHARACTERISTIC
/begin CHARACTERISTIC DSM_EnvDfp_Layer_BSD_C "Fehlerpfad spezifische Umweltbedingungen fuer Fehlerpfad Dfp_Layer_BSD" VAL_BLK 0xCA77A Kwb_Wu8 255.000000000 SigName 0.00 255.000000000 FORMAT "%13.9" NUMBER 10 /end CHARACTERISTIC
/begin CHARACTERISTIC DSM_EnvDfp_AOHtCD_AOHtDia1_C "Fehlerpfad spezifische Umweltbedingungen fuer Fehlerpfad Dfp_AOHtCD_AOHtDia1" VAL_BLK 0xCA784 Kwb_Wu8 255.000000000 SigName 0.00 255.000000000 FORMAT "%13.9" NUMBER 10 /end CHARACTERISTIC
/begin CHARACTERISTIC DSM_EnvDfp_AOHtCD_AOHtDia2_C "Fehlerpfad spezifische Umweltbedingungen fuer Fehlerpfad Dfp_AOHtCD_AOHtDia2" VAL_BLK 0xCA78E Kwb_Wu8 255.000000000 SigName 0.00 255.000000000 FORMAT "%13.9" NUMBER 10 /end CHARACTERISTIC
/begin CHARACTERISTIC DSM_EnvDfp_AOHtCD_AOHtDia3_C "Fehlerpfad spezifische Umweltbedingungen fuer Fehlerpfad Dfp_AOHtCD_AOHtDia3" VAL_BLK 0xCA798 Kwb_Wu8 255.000000000 SigName 0.00 255.000000000 FORMAT "%13.9" NUMBER 10 /end CHARACTERISTIC
/begin CHARACTERISTIC DSM_EnvDfp_APP1_C "Fehlerpfad spezifische Umweltbedingungen fuer Fehlerpfad Dfp_APP1" VAL_BLK 0xCA7A2 Kwb_Wu8 255.000000000 SigName 0.00 255.000000000 FORMAT "%13.9" NUMBER 10 /end CHARACTERISTIC
/begin CHARACTERISTIC DSM_EnvDfp_APP2_C "Fehlerpfad spezifische Umweltbedingungen fuer Fehlerpfad Dfp_APP2" VAL_BLK 0xCA7AC Kwb_Wu8 255.000000000 SigName 0.00 255.000000000 FORMAT "%13.9" NUMBER 10 /end CHARACTERISTIC
/begin CHARACTERISTIC DSM_EnvDfp_APPSync_C "Fehlerpfad spezifische Umweltbedingungen fuer Fehlerpfad Dfp_APPSync" VAL_BLK 0xCA7B6 Kwb_Wu8 255.000000000 SigName 0.00 255.000000000 FORMAT "%13.9" NUMBER 10 /end CHARACTERISTIC
/begin CHARACTERISTIC DSM_EnvDfp_APSCD_C "Fehlerpfad spezifische Umweltbedingungen fuer Fehlerpfad Dfp_APSCD" VAL_BLK 0xCA7C0 Kwb_Wu8 255.000000000 SigName 0.00 255.000000000 FORMAT "%13.9" NUMBER 10 /end CHARACTERISTIC
/begin CHARACTERISTIC DSM_EnvDfp_ARS_C "Fehlerpfad spezifische Umweltbedingungen fuer Fehlerpfad Dfp_ARS" VAL_BLK 0xCA7CA Kwb_Wu8 255.000000000 SigName 0.00 255.000000000 FORMAT "%13.9" NUMBER 10 /end CHARACTERISTIC
/begin CHARACTERISTIC DSM_EnvDfp_AccPedPlausBrk_C "Fehlerpfad spezifische Umweltbedingungen fuer Fehlerpfad Dfp_AccPedPlausBrk" VAL_BLK 0xCA7D4 Kwb_Wu8 255.000000000 SigName 0.00 255.000000000 FORMAT "%13.9" NUMBER 10 /end CHARACTERISTIC
/begin CHARACTERISTIC DSM_EnvDfp_AirCtlPlateBreak_C "DSM variable for Dfp_AirCtlPlateBreak_mp" VAL_BLK 0xCA7DE Kwb_Wu8 255.000000000 SigName 0.00 255.000000000 FORMAT "%13.9" NUMBER 10 /end CHARACTERISTIC
/begin CHARACTERISTIC DSM_EnvDfp_Layer_QLT_C "Fehlerpfad spezifische Umweltbedingungen fuer Fehlerpfad Dfp_Layer_QLT" VAL_BLK 0xCA7E8 Kwb_Wu8 255.000000000 SigName 0.00 255.000000000 FORMAT "%13.9" NUMBER 10 /end CHARACTERISTIC
/begin CHARACTERISTIC DSM_EnvDfp_AirCtl_GovNegDev_C "Fehlerpfad spezifische Umweltbedingungen fuer Fehlerpfad Dfp_AirCtl_GovNegDev" VAL_BLK 0xCA7F2 Kwb_Wu8 255.000000000 SigName 0.00 255.000000000 FORMAT "%13.9" NUMBER 10 /end CHARACTERISTIC
/begin CHARACTERISTIC DSM_EnvDfp_Layer_IBS1_C "Fehlerpfad spezifische Umweltbedingungen fuer Fehlerpfad Dfp_Layer_IBS1" VAL_BLK 0xCA7FC Kwb_Wu8 255.000000000 SigName 0.00 255.000000000 FORMAT "%13.9" NUMBER 10 /end CHARACTERISTIC
/begin CHARACTERISTIC DSM_EnvDfp_Layer_IBS2_C "Fehlerpfad spezifische Umweltbedingungen fuer Fehlerpfad Dfp_Layer_IBS2" VAL_BLK 0xCA806 Kwb_Wu8 255.000000000 SigName 0.00 255.000000000 FORMAT "%13.9" NUMBER 10 /end CHARACTERISTIC
/begin CHARACTERISTIC DSM_EnvDfp_Layer_IBS3_C "Fehlerpfad spezifische Umweltbedingungen fuer Fehlerpfad Dfp_Layer_IBS3" VAL_BLK 0xCA810 Kwb_Wu8 255.000000000 SigName 0.00 255.000000000 FORMAT "%13.9" NUMBER 10 /end CHARACTERISTIC
/begin CHARACTERISTIC DSM_EnvDfp_Layer_PMBN_C "Fehlerpfad spezifische Umweltbedingungen fuer Fehlerpfad Dfp_Layer_PMBN" VAL_BLK 0xCA81A Kwb_Wu8 255.000000000 SigName 0.00 255.000000000 FORMAT "%13.9" NUMBER 10 /end CHARACTERISTIC
/begin CHARACTERISTIC DSM_EnvDfp_Layer_PMBATT_C "Fehlerpfad spezifische Umweltbedingungen fuer Fehlerpfad Dfp_Layer_PMBATT" VAL_BLK 0xCA824 Kwb_Wu8 255.000000000 SigName 0.00 255.000000000 FORMAT "%13.9" NUMBER 10 /end CHARACTERISTIC
/begin CHARACTERISTIC DSM_EnvDfp_AirCtl_GovNegDev2_C "Fehlerpfad spezifische Umweltbedingungen fuer Fehlerpfad Dfp_AirCtl_GovNegDev2" VAL_BLK 0xCA82E Kwb_Wu8 255.000000000 SigName 0.00 255.000000000 FORMAT "%13.9" NUMBER 10 /end CHARACTERISTIC
/begin CHARACTERISTIC DSM_EnvDfp_AirCtl_GovPosDev_C "Fehlerpfad spezifische Umweltbedingungen fuer Fehlerpfad Dfp_AirCtl_GovPosDev" VAL_BLK 0xCA838 Kwb_Wu8 255.000000000 SigName 0.00 255.000000000 FORMAT "%13.9" NUMBER 10 /end CHARACTERISTIC
/begin CHARACTERISTIC DSM_EnvDfp_AirCtl_GovPosDev2_C "Fehlerpfad spezifische Umweltbedingungen fuer Fehlerpfad Dfp_AirCtl_GovPosDev2" VAL_BLK 0xCA842 Kwb_Wu8 255.000000000 SigName 0.00 255.000000000 FORMAT "%13.9" NUMBER 10 /end CHARACTERISTIC
/begin CHARACTERISTIC DSM_EnvDfp_AltCD_C "Fehlerpfad spezifische Umweltbedingungen fuer Fehlerpfad Dfp_AltCD" VAL_BLK 0xCA84C Kwb_Wu8 255.000000000 SigName 0.00 255.000000000 FORMAT "%13.9" NUMBER 10 /end CHARACTERISTIC
/begin CHARACTERISTIC DSM_EnvDfp_AltCD_Load_C "Fehlerpfad spezifische Umweltbedingungen fuer Fehlerpfad Dfp_AltCD_Load" VAL_BLK 0xCA856 Kwb_Wu8 255.000000000 SigName 0.00 255.000000000 FORMAT "%13.9" NUMBER 10 /end CHARACTERISTIC
/begin CHARACTERISTIC DSM_EnvDfp_BPACD_BPADia1_C "Fehlerpfad spezifische Umweltbedingungen fuer Fehlerpfad Dfp_BPACD_BPADia1" VAL_BLK 0xCA860 Kwb_Wu8 255.000000000 SigName 0.00 255.000000000 FORMAT "%13.9" NUMBER 10 /end CHARACTERISTIC
/begin CHARACTERISTIC DSM_EnvDfp_BPACD_BPADia2_C "Fehlerpfad spezifische Umweltbedingungen fuer Fehlerpfad Dfp_BPACD_BPADia2" VAL_BLK 0xCA86A Kwb_Wu8 255.000000000 SigName 0.00 255.000000000 FORMAT "%13.9" NUMBER 10 /end CHARACTERISTIC
/begin CHARACTERISTIC DSM_EnvDfp_BPACD_BPADia3_C "Fehlerpfad spezifische Umweltbedingungen fuer Fehlerpfad Dfp_BPACD_BPADia3" VAL_BLK 0xCA874 Kwb_Wu8 255.000000000 SigName 0.00 255.000000000 FORMAT "%13.9" NUMBER 10 /end CHARACTERISTIC
/begin CHARACTERISTIC DSM_EnvDfp_BPACD_Max_C "Fehlerpfad spezifische Umweltbedingungen fuer Fehlerpfad Dfp_BPACD_Max" VAL_BLK 0xCA87E Kwb_Wu8 255.000000000 SigName 0.00 255.000000000 FORMAT "%13.9" NUMBER 10 /end CHARACTERISTIC
/begin CHARACTERISTIC DSM_EnvDfp_BPACD_Min_C "Fehlerpfad spezifische Umweltbedingungen fuer Fehlerpfad Dfp_BPACD_Min" VAL_BLK 0xCA888 Kwb_Wu8 255.000000000 SigName 0.00 255.000000000 FORMAT "%13.9" NUMBER 10 /end CHARACTERISTIC
/begin CHARACTERISTIC DSM_EnvDfp_BPACD_SigNpl_C "Fehlerpfad spezifische Umweltbedingungen fuer Fehlerpfad Dfp_BPACD_SigNpl" VAL_BLK 0xCA892 Kwb_Wu8 255.000000000 SigName 0.00 255.000000000 FORMAT "%13.9" NUMBER 10 /end CHARACTERISTIC
/begin CHARACTERISTIC DSM_EnvDfp_BPSCD_C "Fehlerpfad spezifische Umweltbedingungen fuer Fehlerpfad Dfp_BPSCD" VAL_BLK 0xCA89C Kwb_Wu8 255.000000000 SigName 0.00 255.000000000 FORMAT "%13.9" NUMBER 10 /end CHARACTERISTIC
/begin CHARACTERISTIC DSM_EnvDfp_BattCD_C "Fehlerpfad spezifische Umweltbedingungen fuer Fehlerpfad Dfp_BattCD" VAL_BLK 0xCA8A6 Kwb_Wu8 255.000000000 SigName 0.00 255.000000000 FORMAT "%13.9" NUMBER 10 /end CHARACTERISTIC
/begin CHARACTERISTIC DSM_EnvDfp_BrkCD_C "Fehlerpfad spezifische Umweltbedingungen fuer Fehlerpfad Dfp_BrkCD" VAL_BLK 0xCA8B0 Kwb_Wu8 255.000000000 SigName 0.00 255.000000000 FORMAT "%13.9" NUMBER 10 /end CHARACTERISTIC
/begin CHARACTERISTIC DSM_EnvDfp_Bss_C "Fehlerpfad spezifische Umweltbedingungen fuer Fehlerpfad Dfp_Bss" VAL_BLK 0xCA8BA Kwb_Wu8 255.000000000 SigName 0.00 255.000000000 FORMAT "%13.9" NUMBER 10 /end CHARACTERISTIC
/begin CHARACTERISTIC DSM_EnvDfp_CBACD_C "Fehlerpfad spezifische Umweltbedingungen fuer Fehlerpfad Dfp_CBACD" VAL_BLK 0xCA8C4 Kwb_Wu8 255.000000000 SigName 0.00 255.000000000 FORMAT "%13.9" NUMBER 10 /end CHARACTERISTIC
/begin CHARACTERISTIC DSM_EnvDfp_CTSCD_C "Fehlerpfad spezifische Umweltbedingungen fuer Fehlerpfad Dfp_CTSCD" VAL_BLK 0xCA8CE Kwb_Wu8 255.000000000 SigName 0.00 255.000000000 FORMAT "%13.9" NUMBER 10 /end CHARACTERISTIC
/begin CHARACTERISTIC DSM_EnvDfp_Clg_DynTst_C "Fehlerpfad spezifische Umweltbedingungen fuer Fehlerpfad Dfp_Clg_DynTst" VAL_BLK 0xCA8D8 Kwb_Wu8 255.000000000 SigName 0.00 255.000000000 FORMAT "%13.9" NUMBER 10 /end CHARACTERISTIC
/begin CHARACTERISTIC DSM_EnvDfp_CmbChbMisfire1_C "Fehlerpfad spezifische Umweltbedingungen fuer Fehlerpfad Dfp_CmbChbMisfire1" VAL_BLK 0xCA8E2 Kwb_Wu8 255.000000000 SigName 0.00 255.000000000 FORMAT "%13.9" NUMBER 10 /end CHARACTERISTIC
/begin CHARACTERISTIC DSM_EnvDfp_CmbChbMisfire2_C "Fehlerpfad spezifische Umweltbedingungen fuer Fehlerpfad Dfp_CmbChbMisfire2" VAL_BLK 0xCA8EC Kwb_Wu8 255.000000000 SigName 0.00 255.000000000 FORMAT "%13.9" NUMBER 10 /end CHARACTERISTIC
/begin CHARACTERISTIC DSM_EnvDfp_CmbChbMisfire3_C "Fehlerpfad spezifische Umweltbedingungen fuer Fehlerpfad Dfp_CmbChbMisfire3" VAL_BLK 0xCA8F6 Kwb_Wu8 255.000000000 SigName 0.00 255.000000000 FORMAT "%13.9" NUMBER 10 /end CHARACTERISTIC
/begin CHARACTERISTIC DSM_EnvDfp_CmbChbMisfire4_C "Fehlerpfad spezifische Umweltbedingungen fuer Fehlerpfad Dfp_CmbChbMisfire4" VAL_BLK 0xCA900 Kwb_Wu8 255.000000000 SigName 0.00 255.000000000 FORMAT "%13.9" NUMBER 10 /end CHARACTERISTIC
/begin CHARACTERISTIC DSM_EnvDfp_CmbChbMisfire5_C "Fehlerpfad spezifische Umweltbedingungen fuer Fehlerpfad Dfp_CmbChbMisfire5" VAL_BLK 0xCA90A Kwb_Wu8 255.000000000 SigName 0.00 255.000000000 FORMAT "%13.9" NUMBER 10 /end CHARACTERISTIC
/begin CHARACTERISTIC DSM_EnvDfp_CmbChbMisfire6_C "Fehlerpfad spezifische Umweltbedingungen fuer Fehlerpfad Dfp_CmbChbMisfire6" VAL_BLK 0xCA914 Kwb_Wu8 255.000000000 SigName 0.00 255.000000000 FORMAT "%13.9" NUMBER 10 /end CHARACTERISTIC
/begin CHARACTERISTIC DSM_EnvDfp_CmbChbMisfireMul_C "Fehlerpfad spezifische Umweltbedingungen fuer Fehlerpfad Dfp_CmbChbMisfireMul" VAL_BLK 0xCA91E Kwb_Wu8 255.000000000 SigName 0.00 255.000000000 FORMAT "%13.9" NUMBER 10 /end CHARACTERISTIC
/begin CHARACTERISTIC DSM_EnvDfp_CoVMDCSh_C "Fehlerpfad spezifische Umweltbedingungen fuer Fehlerpfad Dfp_CoVMDCSh" VAL_BLK 0xCA928 Kwb_Wu8 255.000000000 SigName 0.00 255.000000000 FORMAT "%13.9" NUMBER 10 /end CHARACTERISTIC
/begin CHARACTERISTIC DSM_EnvDfp_ConvCD_C "Fehlerpfad spezifische Umweltbedingungen fuer Fehlerpfad Dfp_ConvCD" VAL_BLK 0xCA932 Kwb_Wu8 255.000000000 SigName 0.00 255.000000000 FORMAT "%13.9" NUMBER 10 /end CHARACTERISTIC
/begin CHARACTERISTIC DSM_EnvDfp_CrCCDMFL_C "Fehlerpfad spezifische Umweltbedingungen fuer Fehlerpfad Dfp_CrCCDMFL" VAL_BLK 0xCA93C Kwb_Wu8 255.000000000 SigName 0.00 255.000000000 FORMAT "%13.9" NUMBER 10 /end CHARACTERISTIC
/begin CHARACTERISTIC DSM_EnvDfp_CrCtl_vCrCtl_C "Fehlerpfad spezifische Umweltbedingungen fuer Fehlerpfad Dfp_CrCtl_vCrCtl" VAL_BLK 0xCA946 Kwb_Wu8 255.000000000 SigName 0.00 255.000000000 FORMAT "%13.9" NUMBER 10 /end CHARACTERISTIC
/begin CHARACTERISTIC DSM_EnvDfp_Dummy1_C "Fehlerpfad spezifische Umweltbedingungen fuer Fehlerpfad Dfp_Dummy1" VAL_BLK 0xCA950 Kwb_Wu8 255.000000000 SigName 0.00 255.000000000 FORMAT "%13.9" NUMBER 10 /end CHARACTERISTIC
/begin CHARACTERISTIC DSM_EnvDfp_EATSCD_C "Fehlerpfad spezifische Umweltbedingungen fuer Fehlerpfad Dfp_EATSCD" VAL_BLK 0xCA95A Kwb_Wu8 255.000000000 SigName 0.00 255.000000000 FORMAT "%13.9" NUMBER 10 /end CHARACTERISTIC
/begin CHARACTERISTIC DSM_EnvDfp_EBAFCD_C "Fehlerpfad spezifische Umweltbedingungen fuer Fehlerpfad Dfp_EBAFCD" VAL_BLK 0xCA964 Kwb_Wu8 255.000000000 SigName 0.00 255.000000000 FORMAT "%13.9" NUMBER 10 /end CHARACTERISTIC
/begin CHARACTERISTIC DSM_EnvDfp_Layer_PMRUHVERL_C "Fehlerpfad spezifische Umweltbedingungen fuer Fehlerpfad Dfp_Layer_PMRUHVERL" VAL_BLK 0xCA96E Kwb_Wu8 255.000000000 SigName 0.00 255.000000000 FORMAT "%13.9" NUMBER 10 /end CHARACTERISTIC
/begin CHARACTERISTIC DSM_EnvDfp_EBFCD_C "Fehlerpfad spezifische Umweltbedingungen fuer Fehlerpfad Dfp_EBFCD" VAL_BLK 0xCA978 Kwb_Wu8 255.000000000 SigName 0.00 255.000000000 FORMAT "%13.9" NUMBER 10 /end CHARACTERISTIC
/begin CHARACTERISTIC DSM_EnvDfp_EBTSCD_C "Fehlerpfad spezifische Umweltbedingungen fuer Fehlerpfad Dfp_EBTSCD" VAL_BLK 0xCA982 Kwb_Wu8 255.000000000 SigName 0.00 255.000000000 FORMAT "%13.9" NUMBER 10 /end CHARACTERISTIC
/begin CHARACTERISTIC DSM_EnvDfp_EBTSCD_OvrTemp_C "Fehlerpfad spezifische Umweltbedingungen fuer Fehlerpfad Dfp_EBTSCD_OvrTemp" VAL_BLK 0xCA98C Kwb_Wu8 255.000000000 SigName 0.00 255.000000000 FORMAT "%13.9" NUMBER 10 /end CHARACTERISTIC
/begin CHARACTERISTIC DSM_EnvDfp_EEPCDVarMng_C "Fehlerpfad spezifische Umweltbedingungen fuer Fehlerpfad Dfp_EEPCDVarMng" VAL_BLK 0xCA996 Kwb_Wu8 255.000000000 SigName 0.00 255.000000000 FORMAT "%13.9" NUMBER 10 /end CHARACTERISTIC
/begin CHARACTERISTIC DSM_EnvDfp_Layer_TOENS_C "Fehlerpfad spezifische Umweltbedingungen fuer Fehlerpfad Dfp_Layer_TOENS" VAL_BLK 0xCA9A0 Kwb_Wu8 255.000000000 SigName 0.00 255.000000000 FORMAT "%13.9" NUMBER 10 /end CHARACTERISTIC
/begin CHARACTERISTIC DSM_EnvDfp_Layer_MANHYDR_C "Fehlerpfad spezifische Umweltbedingungen fuer Fehlerpfad Dfp_Layer_MANHYDR" VAL_BLK 0xCA9AA Kwb_Wu8 255.000000000 SigName 0.00 255.000000000 FORMAT "%13.9" NUMBER 10 /end CHARACTERISTIC
/begin CHARACTERISTIC DSM_EnvDfp_Layer_MANLUFT_C "Fehlerpfad spezifische Umweltbedingungen fuer Fehlerpfad Dfp_Layer_MANLUFT" VAL_BLK 0xCA9B4 Kwb_Wu8 255.000000000 SigName 0.00 255.000000000 FORMAT "%13.9" NUMBER 10 /end CHARACTERISTIC
/begin CHARACTERISTIC DSM_EnvDfp_EGPpCD_C "Fehlerpfad spezifische Umweltbedingungen fuer Fehlerpfad Dfp_EGPpCD" VAL_BLK 0xCA9BE Kwb_Wu8 255.000000000 SigName 0.00 255.000000000 FORMAT "%13.9" NUMBER 10 /end CHARACTERISTIC
/begin CHARACTERISTIC DSM_EnvDfp_EGPpCDTPreTrbn_C "Fehlerpfad spezifische Umweltbedingungen fuer Fehlerpfad Dfp_EgPpCDTPreTrbn" VAL_BLK 0xCA9C8 Kwb_Wu8 255.000000000 SigName 0.00 255.000000000 FORMAT "%13.9" NUMBER 10 /end CHARACTERISTIC
/begin CHARACTERISTIC DSM_EnvDfp_EGRCD_Max_C "Fehlerpfad spezifische Umweltbedingungen fuer Fehlerpfad Dfp_EGRCD_Max" VAL_BLK 0xCA9D2 Kwb_Wu8 255.000000000 SigName 0.00 255.000000000 FORMAT "%13.9" NUMBER 10 /end CHARACTERISTIC
/begin CHARACTERISTIC DSM_EnvDfp_EGRCD_Min_C "Fehlerpfad spezifische Umweltbedingungen fuer Fehlerpfad Dfp_EGRCD_Min" VAL_BLK 0xCA9DC Kwb_Wu8 255.000000000 SigName 0.00 255.000000000 FORMAT "%13.9" NUMBER 10 /end CHARACTERISTIC
/begin CHARACTERISTIC DSM_EnvDfp_EGRCD_SigNpl_C "Fehlerpfad spezifische Umweltbedingungen fuer Fehlerpfad Dfp_EGRCD_SigNpl" VAL_BLK 0xCA9E6 Kwb_Wu8 255.000000000 SigName 0.00 255.000000000 FORMAT "%13.9" NUMBER 10 /end CHARACTERISTIC
/begin CHARACTERISTIC DSM_EnvDfp_EGTRgnOilDil_C "Fehlerpfad spezifische Umweltbedingungen fuer Fehlerpfad Dfp_EGTRgnOilDil" VAL_BLK 0xCA9F0 Kwb_Wu8 255.000000000 SigName 0.00 255.000000000 FORMAT "%13.9" NUMBER 10 /end CHARACTERISTIC
/begin CHARACTERISTIC DSM_EnvDfp_EMCCDNoLoad1_C "" VAL_BLK 0xCA9FA Kwb_Wu8 255.000000000 SigName 0.00 255.000000000 FORMAT "%13.9" NUMBER 10 /end CHARACTERISTIC
/begin CHARACTERISTIC DSM_EnvDfp_EMCCDNoLoad2_C "" VAL_BLK 0xCAA04 Kwb_Wu8 255.000000000 SigName 0.00 255.000000000 FORMAT "%13.9" NUMBER 10 /end CHARACTERISTIC
/begin CHARACTERISTIC DSM_EnvDfp_EMCCDSCBat1_C "" VAL_BLK 0xCAA0E Kwb_Wu8 255.000000000 SigName 0.00 255.000000000 FORMAT "%13.9" NUMBER 10 /end CHARACTERISTIC
/begin CHARACTERISTIC DSM_EnvDfp_EMCCDSCBat2_C "" VAL_BLK 0xCAA18 Kwb_Wu8 255.000000000 SigName 0.00 255.000000000 FORMAT "%13.9" NUMBER 10 /end CHARACTERISTIC
/begin CHARACTERISTIC DSM_EnvDfp_EMCCDSCGnd1_C "" VAL_BLK 0xCAA22 Kwb_Wu8 255.000000000 SigName 0.00 255.000000000 FORMAT "%13.9" NUMBER 10 /end CHARACTERISTIC
/begin CHARACTERISTIC DSM_EnvDfp_EMCCDSCGnd2_C "" VAL_BLK 0xCAA2C Kwb_Wu8 255.000000000 SigName 0.00 255.000000000 FORMAT "%13.9" NUMBER 10 /end CHARACTERISTIC
/begin CHARACTERISTIC DSM_EnvDfp_EMCCD_ADC1_C "" VAL_BLK 0xCAA36 Kwb_Wu8 255.000000000 SigName 0.00 255.000000000 FORMAT "%13.9" NUMBER 10 /end CHARACTERISTIC
/begin CHARACTERISTIC DSM_EnvDfp_EMCCD_ADC2_C "" VAL_BLK 0xCAA40 Kwb_Wu8 255.000000000 SigName 0.00 255.000000000 FORMAT "%13.9" NUMBER 10 /end CHARACTERISTIC
/begin CHARACTERISTIC DSM_EnvDfp_ETClbETFltInj1_C "Fehlerpfad spezifische Umweltbedingungen fuer Fehlerpfad Dfp_ETClbETFltInj1" VAL_BLK 0xCAA4A Kwb_Wu8 255.000000000 SigName 0.00 255.000000000 FORMAT "%13.9" NUMBER 10 /end CHARACTERISTIC
/begin CHARACTERISTIC DSM_EnvDfp_ETClbETFltInj2_C "Fehlerpfad spezifische Umweltbedingungen fuer Fehlerpfad Dfp_ETClbETFltInj2" VAL_BLK 0xCAA54 Kwb_Wu8 255.000000000 SigName 0.00 255.000000000 FORMAT "%13.9" NUMBER 10 /end CHARACTERISTIC
/begin CHARACTERISTIC DSM_EnvDfp_ETClbETFltInj3_C "Fehlerpfad spezifische Umweltbedingungen fuer Fehlerpfad Dfp_ETClbETFltInj3" VAL_BLK 0xCAA5E Kwb_Wu8 255.000000000 SigName 0.00 255.000000000 FORMAT "%13.9" NUMBER 10 /end CHARACTERISTIC
/begin CHARACTERISTIC DSM_EnvDfp_ETClbETFltInj4_C "Fehlerpfad spezifische Umweltbedingungen fuer Fehlerpfad Dfp_ETClbETFltInj4" VAL_BLK 0xCAA68 Kwb_Wu8 255.000000000 SigName 0.00 255.000000000 FORMAT "%13.9" NUMBER 10 /end CHARACTERISTIC
/begin CHARACTERISTIC DSM_EnvDfp_ETClbETFltInj5_C "Fehlerpfad spezifische Umweltbedingungen fuer Fehlerpfad Dfp_ETClbETFltInj5" VAL_BLK 0xCAA72 Kwb_Wu8 255.000000000 SigName 0.00 255.000000000 FORMAT "%13.9" NUMBER 10 /end CHARACTERISTIC
/begin CHARACTERISTIC DSM_EnvDfp_ETClbETFltInj6_C "Fehlerpfad spezifische Umweltbedingungen fuer Fehlerpfad Dfp_ETClbETFltInj6" VAL_BLK 0xCAA7C Kwb_Wu8 255.000000000 SigName 0.00 255.000000000 FORMAT "%13.9" NUMBER 10 /end CHARACTERISTIC
/begin CHARACTERISTIC DSM_EnvDfp_ETClbInj1_C "Fehlerpfad spezifische Umweltbedingungen fuer Fehlerpfad Dfp_ETClbInj1" VAL_BLK 0xCAA86 Kwb_Wu8 255.000000000 SigName 0.00 255.000000000 FORMAT "%13.9" NUMBER 10 /end CHARACTERISTIC
/begin CHARACTERISTIC DSM_EnvDfp_ETClbInj2_C "Fehlerpfad spezifische Umweltbedingungen fuer Fehlerpfad Dfp_ETClbInj2" VAL_BLK 0xCAA90 Kwb_Wu8 255.000000000 SigName 0.00 255.000000000 FORMAT "%13.9" NUMBER 10 /end CHARACTERISTIC
/begin CHARACTERISTIC DSM_EnvDfp_ETClbInj3_C "Fehlerpfad spezifische Umweltbedingungen fuer Fehlerpfad Dfp_ETClbInj3" VAL_BLK 0xCAA9A Kwb_Wu8 255.000000000 SigName 0.00 255.000000000 FORMAT "%13.9" NUMBER 10 /end CHARACTERISTIC
/begin CHARACTERISTIC DSM_EnvDfp_ETClbInj4_C "Fehlerpfad spezifische Umweltbedingungen fuer Fehlerpfad Dfp_ETClbInj4" VAL_BLK 0xCAAA4 Kwb_Wu8 255.000000000 SigName 0.00 255.000000000 FORMAT "%13.9" NUMBER 10 /end CHARACTERISTIC
/begin CHARACTERISTIC DSM_EnvDfp_ETClbInj5_C "Fehlerpfad spezifische Umweltbedingungen fuer Fehlerpfad Dfp_ETClbInj5" VAL_BLK 0xCAAAE Kwb_Wu8 255.000000000 SigName 0.00 255.000000000 FORMAT "%13.9" NUMBER 10 /end CHARACTERISTIC
/begin CHARACTERISTIC DSM_EnvDfp_ETClbInj6_C "Fehlerpfad spezifische Umweltbedingungen fuer Fehlerpfad Dfp_ETClbInj6" VAL_BLK 0xCAAB8 Kwb_Wu8 255.000000000 SigName 0.00 255.000000000 FORMAT "%13.9" NUMBER 10 /end CHARACTERISTIC
/begin CHARACTERISTIC DSM_EnvDfp_EngMCaS1_C "Fehlerpfad spezifische Umweltbedingungen fuer Fehlerpfad Dfp_EngMCaS1" VAL_BLK 0xCAAC2 Kwb_Wu8 255.000000000 SigName 0.00 255.000000000 FORMAT "%13.9" NUMBER 10 /end CHARACTERISTIC
/begin CHARACTERISTIC DSM_EnvDfp_EngMCrS1_C "Fehlerpfad spezifische Umweltbedingungen fuer Fehlerpfad Dfp_EngMCrS1" VAL_BLK 0xCAACC Kwb_Wu8 255.000000000 SigName 0.00 255.000000000 FORMAT "%13.9" NUMBER 10 /end CHARACTERISTIC
/begin CHARACTERISTIC DSM_EnvDfp_EngMOfsCaSCrS_C "Fehlerpfad spezifische Umweltbedingungen fuer Fehlerpfad Dfp_EngMOfsCaSCrS" VAL_BLK 0xCAAD6 Kwb_Wu8 255.000000000 SigName 0.00 255.000000000 FORMAT "%13.9" NUMBER 10 /end CHARACTERISTIC
/begin CHARACTERISTIC DSM_EnvDfp_EngPrtFWODet_C "Fehlerpfad spezifische Umweltbedingungen fuer Fehlerpfad Dfp_EngPrtFWODet" VAL_BLK 0xCAAE0 Kwb_Wu8 255.000000000 SigName 0.00 255.000000000 FORMAT "%13.9" NUMBER 10 /end CHARACTERISTIC
/begin CHARACTERISTIC DSM_EnvDfp_FBCqDvt_C "Fehlerpfad spezifische Umweltbedingungen fuer Fehlerpfad Dfp_FBCqDvt" VAL_BLK 0xCAAEA Kwb_Wu8 255.000000000 SigName 0.00 255.000000000 FORMAT "%13.9" NUMBER 10 /end CHARACTERISTIC
/begin CHARACTERISTIC DSM_EnvDfp_FMTC_NonMonotonMap_C "Fehlerpfad spezifische Umweltbedingungen fuer Fehlerpfad Dfp_FMTC_NonMonotonMap" VAL_BLK 0xCAAF4 Kwb_Wu8 255.000000000 SigName 0.00 255.000000000 FORMAT "%13.9" NUMBER 10 /end CHARACTERISTIC
/begin CHARACTERISTIC DSM_EnvDfp_FTSCD_C "Fehlerpfad spezifische Umweltbedingungen fuer Fehlerpfad Dfp_FTSCD" VAL_BLK 0xCAAFE Kwb_Wu8 255.000000000 SigName 0.00 255.000000000 FORMAT "%13.9" NUMBER 10 /end CHARACTERISTIC
/begin CHARACTERISTIC DSM_EnvDfp_FanCD_C "Fehlerpfad spezifische Umweltbedingungen fuer Fehlerpfad Dfp_FanCD" VAL_BLK 0xCAB08 Kwb_Wu8 255.000000000 SigName 0.00 255.000000000 FORMAT "%13.9" NUMBER 10 /end CHARACTERISTIC
/begin CHARACTERISTIC DSM_EnvDfp_FanCD_FanCtlr1_C "Fehlerpfad spezifische Umweltbedingungen fuer Fehlerpfad Dfp_FanCD_FanCtlr1" VAL_BLK 0xCAB12 Kwb_Wu8 255.000000000 SigName 0.00 255.000000000 FORMAT "%13.9" NUMBER 10 /end CHARACTERISTIC
/begin CHARACTERISTIC DSM_EnvDfp_FanCD_FanCtlr2_C "Fehlerpfad spezifische Umweltbedingungen fuer Fehlerpfad Dfp_FanCD_FanCtlr2" VAL_BLK 0xCAB1C Kwb_Wu8 255.000000000 SigName 0.00 255.000000000 FORMAT "%13.9" NUMBER 10 /end CHARACTERISTIC
/begin CHARACTERISTIC DSM_EnvDfp_FanCD_FanCtlr3_C "Fehlerpfad spezifische Umweltbedingungen fuer Fehlerpfad Dfp_FanCD_FanCtlr3" VAL_BLK 0xCAB26 Kwb_Wu8 255.000000000 SigName 0.00 255.000000000 FORMAT "%13.9" NUMBER 10 /end CHARACTERISTIC
/begin CHARACTERISTIC DSM_EnvDfp_FlFCD_C "Fehlerpfad spezifische Umweltbedingungen fuer Fehlerpfad Dfp_FlFCD" VAL_BLK 0xCAB30 Kwb_Wu8 255.000000000 SigName 0.00 255.000000000 FORMAT "%13.9" NUMBER 10 /end CHARACTERISTIC
/begin CHARACTERISTIC DSM_EnvDfp_FlMngSmkDefect_C "Fehlerpfad spezifische Umweltbedingungen fuer Fehlerpfad Dfp_FlMngSmkDefect" VAL_BLK 0xCAB3A Kwb_Wu8 255.000000000 SigName 0.00 255.000000000 FORMAT "%13.9" NUMBER 10 /end CHARACTERISTIC
/begin CHARACTERISTIC DSM_EnvDfp_FrmMngASC1_C "Fehlerpfad spezifische Umweltbedingungen fuer Fehlerpfad Dfp_FrmMngASC1" VAL_BLK 0xCAB44 Kwb_Wu8 255.000000000 SigName 0.00 255.000000000 FORMAT "%13.9" NUMBER 10 /end CHARACTERISTIC
/begin CHARACTERISTIC DSM_EnvDfp_FrmMngASC2_C "Fehlerpfad spezifische Umweltbedingungen fuer Fehlerpfad Dfp_FrmMngASC2" VAL_BLK 0xCAB4E Kwb_Wu8 255.000000000 SigName 0.00 255.000000000 FORMAT "%13.9" NUMBER 10 /end CHARACTERISTIC
/begin CHARACTERISTIC DSM_EnvDfp_FrmMngASC3_C "Fehlerpfad spezifische Umweltbedingungen fuer Fehlerpfad Dfp_FrmMngASC3" VAL_BLK 0xCAB58 Kwb_Wu8 255.000000000 SigName 0.00 255.000000000 FORMAT "%13.9" NUMBER 10 /end CHARACTERISTIC
/begin CHARACTERISTIC DSM_EnvDfp_FrmMngASC4_C "Fehlerpfad spezifische Umweltbedingungen fuer Fehlerpfad Dfp_FrmMngASC4" VAL_BLK 0xCAB62 Kwb_Wu8 255.000000000 SigName 0.00 255.000000000 FORMAT "%13.9" NUMBER 10 /end CHARACTERISTIC
/begin CHARACTERISTIC DSM_EnvDfp_FrmMngBOS_RESET_C "Fehlerpfad spezifische Umweltbedingungen fuer Fehlerpfad Dfp_FrmMngBOS_RESET" VAL_BLK 0xCAB6C Kwb_Wu8 255.000000000 SigName 0.00 255.000000000 FORMAT "%13.9" NUMBER 10 /end CHARACTERISTIC
/begin CHARACTERISTIC DSM_EnvDfp_FrmMngBOS_RESET_2_C "" VAL_BLK 0xCAB76 Kwb_Wu8 255.000000000 SigName 0.00 255.000000000 FORMAT "%13.9" NUMBER 10 /end CHARACTERISTIC
/begin CHARACTERISTIC DSM_EnvDfp_FrmMngDMANFAFS_C "Fehlerpfad spezifische Umweltbedingungen fuer Fehlerpfad Dfp_FrmMngDMANFAFS" VAL_BLK 0xCAB80 Kwb_Wu8 255.000000000 SigName 0.00 255.000000000 FORMAT "%13.9" NUMBER 10 /end CHARACTERISTIC
/begin CHARACTERISTIC DSM_EnvDfp_FrmMngDRMANFSSG_C "Fehlerpfad spezifische Umweltbedingungen fuer Fehlerpfad Dfp_FrmMngDRMANFSSG" VAL_BLK 0xCAB8A Kwb_Wu8 255.000000000 SigName 0.00 255.000000000 FORMAT "%13.9" NUMBER 10 /end CHARACTERISTIC
/begin CHARACTERISTIC DSM_EnvDfp_FrmMngEGS1_C "Fehlerpfad spezifische Umweltbedingungen fuer Fehlerpfad Dfp_FrmMngEGS1" VAL_BLK 0xCAB94 Kwb_Wu8 255.000000000 SigName 0.00 255.000000000 FORMAT "%13.9" NUMBER 10 /end CHARACTERISTIC
/begin CHARACTERISTIC DSM_EnvDfp_FrmMngEGS2_C "Fehlerpfad spezifische Umweltbedingungen fuer Fehlerpfad Dfp_FrmMngEGS2" VAL_BLK 0xCAB9E Kwb_Wu8 255.000000000 SigName 0.00 255.000000000 FORMAT "%13.9" NUMBER 10 /end CHARACTERISTIC
/begin CHARACTERISTIC DSM_EnvDfp_FrmMngGEARBX_DATA_C "environment conditions (customerspecific) for path" VAL_BLK 0xCABA8 Kwb_Wu8 255.000000000 SigName 0.00 255.000000000 FORMAT "%13.9" NUMBER 10 /end CHARACTERISTIC
/begin CHARACTERISTIC DSM_EnvDfp_FrmMngGEARBX_DATA2_C "Fehlerpfad spezifische Umweltbedingungen fuer Fehlerpfad Dfp_FrmMngGEARBX_DATA2" VAL_BLK 0xCABB2 Kwb_Wu8 255.000000000 SigName 0.00 255.000000000 FORMAT "%13.9" NUMBER 10 /end CHARACTERISTIC
/begin CHARACTERISTIC DSM_EnvDfp_FrmMngHEAT_AC_C "environment conditions (customerspecific) for path" VAL_BLK 0xCABBC Kwb_Wu8 255.000000000 SigName 0.00 255.000000000 FORMAT "%13.9" NUMBER 10 /end CHARACTERISTIC
/begin CHARACTERISTIC DSM_EnvDfp_FrmMngINSTR2_C "Fehlerpfad spezifische Umweltbedingungen fuer Fehlerpfad Dfp_FrmMngINSTR2" VAL_BLK 0xCABC6 Kwb_Wu8 255.000000000 SigName 0.00 255.000000000 FORMAT "%13.9" NUMBER 10 /end CHARACTERISTIC
/begin CHARACTERISTIC DSM_EnvDfp_FrmMngINSTR3_C "Fehlerpfad spezifische Umweltbedingungen fuer Fehlerpfad Dfp_FrmMngINSTR3" VAL_BLK 0xCABD0 Kwb_Wu8 255.000000000 SigName 0.00 255.000000000 FORMAT "%13.9" NUMBER 10 /end CHARACTERISTIC
/begin CHARACTERISTIC DSM_EnvDfp_FrmMngLENKRADWINKEL_C "Fehlerpfad spezifische Umweltbedingungen fuer Fehlerpfad Dfp_FrmMngLENKRADWINKEL" VAL_BLK 0xCABDA Kwb_Wu8 255.000000000 SigName 0.00 255.000000000 FORMAT "%13.9" NUMBER 10 /end CHARACTERISTIC
/begin CHARACTERISTIC DSM_EnvDfp_FrmMngMILEAGE_RANGE_C "Fehlerpfad spezifische Umweltbedingungen fuer Fehlerpfad Dfp_FrmMngMILEAGE_RANGE" VAL_BLK 0xCABE4 Kwb_Wu8 255.000000000 SigName 0.00 255.000000000 FORMAT "%13.9" NUMBER 10 /end CHARACTERISTIC
/begin CHARACTERISTIC DSM_EnvDfp_FrmMngOPCRCTLACC_C "Fehlerpfad spezifische Umweltbedingungen fuer Fehlerpfad Dfp_FrmMngOPCRCTLACC" VAL_BLK 0xCABEE Kwb_Wu8 255.000000000 SigName 0.00 255.000000000 FORMAT "%13.9" NUMBER 10 /end CHARACTERISTIC
/begin CHARACTERISTIC DSM_EnvDfp_FrmMngPRGG_CCTR_C "Fehlerpfad spezifische Umweltbedingungen fuer Fehlerpfad Dfp_FrmMngPRGG_CCTR" VAL_BLK 0xCABF8 Kwb_Wu8 255.000000000 SigName 0.00 255.000000000 FORMAT "%13.9" NUMBER 10 /end CHARACTERISTIC
/begin CHARACTERISTIC DSM_EnvDfp_FrmMngPWRMNG_LOADV_C "Fehlerpfad spezifische Umweltbedingungen fuer Fehlerpfad Dfp_FrmMngPWRMNG_LOADV" VAL_BLK 0xCAC02 Kwb_Wu8 255.000000000 SigName 0.00 255.000000000 FORMAT "%13.9" NUMBER 10 /end CHARACTERISTIC
/begin CHARACTERISTIC DSM_EnvDfp_FrmMngParkConsumer_C "Fehlerpfad spezifische Umweltbedinungen fuer Fehlerpfad Dfp_FrmMngParkConsumer" VAL_BLK 0xCAC0C Kwb_Wu8 255.000000000 SigName 0.00 255.000000000 FORMAT "%13.9" NUMBER 10 /end CHARACTERISTIC
/begin CHARACTERISTIC DSM_EnvDfp_FrmMngRQSTGEFAN_C "RQ_STG_EFAN - CAN-message related errors" VAL_BLK 0xCAC16 Kwb_Wu8 255.000000000 SigName 0.00 255.000000000 FORMAT "%13.9" NUMBER 10 /end CHARACTERISTIC
/begin CHARACTERISTIC DSM_EnvDfp_FrmMngSSGErr_C "Fehlerpfad spezifische Umweltbedingungen fuer Fehlerpfad Dfp_FrmMngSSGErr" VAL_BLK 0xCAC20 Kwb_Wu8 255.000000000 SigName 0.00 255.000000000 FORMAT "%13.9" NUMBER 10 /end CHARACTERISTIC
/begin CHARACTERISTIC DSM_EnvDfp_FrmMngSSGShOff_C "Fehlerpfad spezifische Umweltbedingungen fuer Fehlerpfad Dfp_FrmMngSSGShOff" VAL_BLK 0xCAC2A Kwb_Wu8 255.000000000 SigName 0.00 255.000000000 FORMAT "%13.9" NUMBER 10 /end CHARACTERISTIC
/begin CHARACTERISTIC DSM_EnvDfp_FrmMngSTAT_ANH_C "Fehlerpfad spezifische Umweltbedingungen fuer Fehlerpfad Dfp_FrmMngSTAT_ANH" VAL_BLK 0xCAC34 Kwb_Wu8 255.000000000 SigName 0.00 255.000000000 FORMAT "%13.9" NUMBER 10 /end CHARACTERISTIC
/begin CHARACTERISTIC DSM_EnvDfp_FrmMngSTAT_ARS_C "environment conditions (customerspecific) for path" VAL_BLK 0xCAC3E Kwb_Wu8 255.000000000 SigName 0.00 255.000000000 FORMAT "%13.9" NUMBER 10 /end CHARACTERISTIC
/begin CHARACTERISTIC DSM_EnvDfp_FrmMngSTAT_DSC_C "environment conditions (customerspecific) for path" VAL_BLK 0xCAC48 Kwb_Wu8 255.000000000 SigName 0.00 255.000000000 FORMAT "%13.9" NUMBER 10 /end CHARACTERISTIC
/begin CHARACTERISTIC DSM_EnvDfp_FrmMngSTAT_EKP_C "Fehlerpfad spezifische Umweltbedingungen fuer Fehlerpfad Dfp_FrmMngSTAT_EKP" VAL_BLK 0xCAC52 Kwb_Wu8 255.000000000 SigName 0.00 255.000000000 FORMAT "%13.9" NUMBER 10 /end CHARACTERISTIC
/begin CHARACTERISTIC DSM_EnvDfp_FrmMngSTAT_KOMBI_C "Fehlerpfad spezifische Umweltbedingungen fuer Fehlerpfad Dfp_FrmMngSTAT_KOMBI" VAL_BLK 0xCAC5C Kwb_Wu8 255.000000000 SigName 0.00 255.000000000 FORMAT "%13.9" NUMBER 10 /end CHARACTERISTIC
/begin CHARACTERISTIC DSM_EnvDfp_FrmMngSTAT_SITZ_C "Fehlerpfad spezifische Umweltbedingungen fuer Fehlerpfad  Dfp_FrmMngSTAT_SITZ" VAL_BLK 0xCAC66 Kwb_Wu8 255.000000000 SigName 0.00 255.000000000 FORMAT "%13.9" NUMBER 10 /end CHARACTERISTIC
/begin CHARACTERISTIC DSM_EnvDfp_FrmMngStOBDGbxMilOf_C "Fehlerpfad spezifische Umweltbedingungen fuer Fehlerpfad Dfp_FrmMngStOBDGbxMilOf" VAL_BLK 0xCAC70 Kwb_Wu8 255.000000000 SigName 0.00 255.000000000 FORMAT "%13.9" NUMBER 10 /end CHARACTERISTIC
/begin CHARACTERISTIC DSM_EnvDfp_FrmMngStOBDGbxMilOn_C "Fehlerpfad spezifische Umweltbedingungen fuer Fehlerpfad Dfp_FrmMngStOBDGbxMilOn" VAL_BLK 0xCAC7A Kwb_Wu8 255.000000000 SigName 0.00 255.000000000 FORMAT "%13.9" NUMBER 10 /end CHARACTERISTIC
/begin CHARACTERISTIC DSM_EnvDfp_FrmMngTEMPRELTIME_C "Fehlerpfad spezifische Umweltbedingungen fuer Fehlerpfad Dfp_FrmMngTEMPRELTIME" VAL_BLK 0xCAC84 Kwb_Wu8 255.000000000 SigName 0.00 255.000000000 FORMAT "%13.9" NUMBER 10 /end CHARACTERISTIC
/begin CHARACTERISTIC DSM_EnvDfp_FrmMngTERMINAL_C "environment conditions (customerspecific) for path" VAL_BLK 0xCAC8E Kwb_Wu8 255.000000000 SigName 0.00 255.000000000 FORMAT "%13.9" NUMBER 10 /end CHARACTERISTIC
/begin CHARACTERISTIC DSM_EnvDfp_FrmMngTIME_DATE_C "Fehlerpfad spezifische Umweltbedingungen fuer Fehlerpfad Dfp_FrmMngTIME_DATE" VAL_BLK 0xCAC98 Kwb_Wu8 255.000000000 SigName 0.00 255.000000000 FORMAT "%13.9" NUMBER 10 /end CHARACTERISTIC
/begin CHARACTERISTIC DSM_EnvDfp_FrmMngTORQUE_DSC_C "environment conditions (customerspecific) for path" VAL_BLK 0xCACA2 Kwb_Wu8 255.000000000 SigName 0.00 255.000000000 FORMAT "%13.9" NUMBER 10 /end CHARACTERISTIC
/begin CHARACTERISTIC DSM_EnvDfp_FrmMngTORQUE_GEARBX_C "environment conditions (customerspecific) for path" VAL_BLK 0xCACAC Kwb_Wu8 255.000000000 SigName 0.00 255.000000000 FORMAT "%13.9" NUMBER 10 /end CHARACTERISTIC
/begin CHARACTERISTIC DSM_EnvDfp_FrmMngTrq_ReqACC_C "Fehlerpfad spezifische Umweltbedingungen fuer Fehlerpfad Dfp_FrmMngTrq_ReqACC" VAL_BLK 0xCACB6 Kwb_Wu8 255.000000000 SigName 0.00 255.000000000 FORMAT "%13.9" NUMBER 10 /end CHARACTERISTIC
/begin CHARACTERISTIC DSM_EnvDfp_FrmMngVEH_MOD_C "VEH_MOD - CAN-message related errors" VAL_BLK 0xCACC0 Kwb_Wu8 255.000000000 SigName 0.00 255.000000000 FORMAT "%13.9" NUMBER 10 /end CHARACTERISTIC
/begin CHARACTERISTIC DSM_EnvDfp_FrmMngVELOCITY_C "environment conditions (customerspecific) for path" VAL_BLK 0xCACCA Kwb_Wu8 255.000000000 SigName 0.00 255.000000000 FORMAT "%13.9" NUMBER 10 /end CHARACTERISTIC
/begin CHARACTERISTIC DSM_EnvDfp_FrmMngWHEEL_SPEED_C "Fehlerpfad spezifische Umweltbedingungen fuer Fehlerpfad Dfp_FrmMngWHEEL_SPEED" VAL_BLK 0xCACD4 Kwb_Wu8 255.000000000 SigName 0.00 255.000000000 FORMAT "%13.9" NUMBER 10 /end CHARACTERISTIC
/begin CHARACTERISTIC DSM_EnvDfp_FrmMngstCurr_C "Umweltbedingung für Dfp_FrmMngstCurr" VAL_BLK 0xCACDE Kwb_Wu8 255.000000000 SigName 0.00 255.000000000 FORMAT "%13.9" NUMBER 10 /end CHARACTERISTIC
/begin CHARACTERISTIC DSM_EnvDfp_FrmMngswtPSPOff_C "Umweltbedingung für Dfp_FrmMngswtPSPOff" VAL_BLK 0xCACE8 Kwb_Wu8 255.000000000 SigName 0.00 255.000000000 FORMAT "%13.9" NUMBER 10 /end CHARACTERISTIC
/begin CHARACTERISTIC DSM_EnvDfp_GearbxIncMax_C "Fehlerpfad spezifische Umweltbedingungen fuer Fehlerpfad Dfp_GearbxIncMax" VAL_BLK 0xCACF2 Kwb_Wu8 255.000000000 SigName 0.00 255.000000000 FORMAT "%13.9" NUMBER 10 /end CHARACTERISTIC
/begin CHARACTERISTIC DSM_EnvDfp_GlwCD_C "Fehlerpfad spezifische Umweltbedingungen fuer Fehlerpfad Dfp_GlwCD" VAL_BLK 0xCACFC Kwb_Wu8 255.000000000 SigName 0.00 255.000000000 FORMAT "%13.9" NUMBER 10 /end CHARACTERISTIC
/begin CHARACTERISTIC DSM_EnvDfp_GlwCDGlwCirc1_C "Fehlerpfad spezifische Umweltbedingungen fuer Fehlerpfad Dfp_GlwCDGlwCirc1" VAL_BLK 0xCAD06 Kwb_Wu8 255.000000000 SigName 0.00 255.000000000 FORMAT "%13.9" NUMBER 10 /end CHARACTERISTIC
/begin CHARACTERISTIC DSM_EnvDfp_GlwCDGlwCirc2_C "Fehlerpfad spezifische Umweltbedingungen fuer Fehlerpfad Dfp_GlwCDGlwCirc2" VAL_BLK 0xCAD10 Kwb_Wu8 255.000000000 SigName 0.00 255.000000000 FORMAT "%13.9" NUMBER 10 /end CHARACTERISTIC
/begin CHARACTERISTIC DSM_EnvDfp_GlwCDGlwCirc3_C "Fehlerpfad spezifische Umweltbedingungen fuer Fehlerpfad Dfp_GlwCDGlwCirc3" VAL_BLK 0xCAD1A Kwb_Wu8 255.000000000 SigName 0.00 255.000000000 FORMAT "%13.9" NUMBER 10 /end CHARACTERISTIC
/begin CHARACTERISTIC DSM_EnvDfp_GlwCDGlwCirc4_C "Fehlerpfad spezifische Umweltbedingungen fuer Fehlerpfad Dfp_GlwCDGlwCirc4" VAL_BLK 0xCAD24 Kwb_Wu8 255.000000000 SigName 0.00 255.000000000 FORMAT "%13.9" NUMBER 10 /end CHARACTERISTIC
/begin CHARACTERISTIC DSM_EnvDfp_GlwCDGlwCirc5_C "Fehlerpfad spezifische Umweltbedingungen fuer Fehlerpfad Dfp_GlwCDGlwCirc5" VAL_BLK 0xCAD2E Kwb_Wu8 255.000000000 SigName 0.00 255.000000000 FORMAT "%13.9" NUMBER 10 /end CHARACTERISTIC
/begin CHARACTERISTIC DSM_EnvDfp_GlwCDGlwCirc6_C "Fehlerpfad spezifische Umweltbedingungen fuer Fehlerpfad Dfp_GlwCDGlwCirc6" VAL_BLK 0xCAD38 Kwb_Wu8 255.000000000 SigName 0.00 255.000000000 FORMAT "%13.9" NUMBER 10 /end CHARACTERISTIC
/begin CHARACTERISTIC DSM_EnvDfp_GlwCDGlwCirc7_C "Fehlerpfad spezifische Umweltbedingungen fuer Fehlerpfad Dfp_GlwCDGlwCirc7" VAL_BLK 0xCAD42 Kwb_Wu8 255.000000000 SigName 0.00 255.000000000 FORMAT "%13.9" NUMBER 10 /end CHARACTERISTIC
/begin CHARACTERISTIC DSM_EnvDfp_GlwCDGlwCirc8_C "Fehlerpfad spezifische Umweltbedingungen fuer Fehlerpfad Dfp_GlwCDGlwCirc8" VAL_BLK 0xCAD4C Kwb_Wu8 255.000000000 SigName 0.00 255.000000000 FORMAT "%13.9" NUMBER 10 /end CHARACTERISTIC
/begin CHARACTERISTIC DSM_EnvDfp_GlwCtl_C "Fehlerpfad spezifische Umweltbedingungen fuer Fehlerpfad Dfp_GlwCtl" VAL_BLK 0xCAD56 Kwb_Wu8 255.000000000 SigName 0.00 255.000000000 FORMAT "%13.9" NUMBER 10 /end CHARACTERISTIC
/begin CHARACTERISTIC DSM_EnvDfp_HWEMonCom_C "Fehlerpfad spezifische Umweltbedingungen fuer Fehlerpfad Dfp_HWEMonCom" VAL_BLK 0xCAD60 Kwb_Wu8 255.000000000 SigName 0.00 255.000000000 FORMAT "%13.9" NUMBER 10 /end CHARACTERISTIC
/begin CHARACTERISTIC DSM_EnvDfp_HWEMonEEPROM_C "Fehlerpfad spezifische Umweltbedingungen fuer Fehlerpfad Dfp_HWEMonEEPROM" VAL_BLK 0xCAD6A Kwb_Wu8 255.000000000 SigName 0.00 255.000000000 FORMAT "%13.9" NUMBER 10 /end CHARACTERISTIC
/begin CHARACTERISTIC DSM_EnvDfp_HWEMonRcyLocked_C "Fehlerpfad spezifische Umweltbedingungen fuer Fehlerpfad Dfp_HWEMonRcyLocked" VAL_BLK 0xCAD74 Kwb_Wu8 255.000000000 SigName 0.00 255.000000000 FORMAT "%13.9" NUMBER 10 /end CHARACTERISTIC
/begin CHARACTERISTIC DSM_EnvDfp_HWEMonRcySuppressed_C "Fehlerpfad spezifische Umweltbedingungen fuer Fehlerpfad Dfp_HWEMonRcySuppressed" VAL_BLK 0xCAD7E Kwb_Wu8 255.000000000 SigName 0.00 255.000000000 FORMAT "%13.9" NUMBER 10 /end CHARACTERISTIC
/begin CHARACTERISTIC DSM_EnvDfp_HWEMonRcyVisible_C "Fehlerpfad spezifische Umweltbedingungen fuer Fehlerpfad Dfp_HWEMonRcyVisible" VAL_BLK 0xCAD88 Kwb_Wu8 255.000000000 SigName 0.00 255.000000000 FORMAT "%13.9" NUMBER 10 /end CHARACTERISTIC
/begin CHARACTERISTIC DSM_EnvDfp_HWEMonUMaxSupply_C "Fehlerpfad spezifische Umweltbedingungen fuer Fehlerpfad Dfp_HWEMonUMaxSupply" VAL_BLK 0xCAD92 Kwb_Wu8 255.000000000 SigName 0.00 255.000000000 FORMAT "%13.9" NUMBER 10 /end CHARACTERISTIC
/begin CHARACTERISTIC DSM_EnvDfp_HWEMonUMinSupply_C "Fehlerpfad spezifische Umweltbedingungen fuer Fehlerpfad Dfp_HWEMonUMinSupply" VAL_BLK 0xCAD9C Kwb_Wu8 255.000000000 SigName 0.00 255.000000000 FORMAT "%13.9" NUMBER 10 /end CHARACTERISTIC
/begin CHARACTERISTIC DSM_EnvDfp_IATSCD_C "Fehlerpfad spezifische Umweltbedingungen fuer Fehlerpfad Dfp_IATSCD" VAL_BLK 0xCADA6 Kwb_Wu8 255.000000000 SigName 0.00 255.000000000 FORMAT "%13.9" NUMBER 10 /end CHARACTERISTIC
/begin CHARACTERISTIC DSM_EnvDfp_IATSCD_CATS_C "Fehlerpfad spezifische Umweltbedingungen fuer Fehlerpfad Dfp_IATSCD_CATS" VAL_BLK 0xCADB0 Kwb_Wu8 255.000000000 SigName 0.00 255.000000000 FORMAT "%13.9" NUMBER 10 /end CHARACTERISTIC
/begin CHARACTERISTIC DSM_EnvDfp_ImmCtlImmCD_C "Fehlerpfad spezifische Umweltbedingungen fuer Fehlerpfad Dfp_ImmCtlImmCD" VAL_BLK 0xCADBA Kwb_Wu8 255.000000000 SigName 0.00 255.000000000 FORMAT "%13.9" NUMBER 10 /end CHARACTERISTIC
/begin CHARACTERISTIC DSM_EnvDfp_ImmCtlImmEep_C "Fehlerpfad spezifische Umweltbedingungen fuer Fehlerpfad Dfp_ImmCtlImmEep" VAL_BLK 0xCADC4 Kwb_Wu8 255.000000000 SigName 0.00 255.000000000 FORMAT "%13.9" NUMBER 10 /end CHARACTERISTIC
/begin CHARACTERISTIC DSM_EnvDfp_ImmCtlMpl_C "Fehlerpfad spezifische Umweltbedingungen fuer Fehlerpfad Dfp_ImmCtlMpl" VAL_BLK 0xCADCE Kwb_Wu8 255.000000000 SigName 0.00 255.000000000 FORMAT "%13.9" NUMBER 10 /end CHARACTERISTIC
/begin CHARACTERISTIC DSM_EnvDfp_IndSys1_C "Fehlerpfad spezifische Umweltbedingungen fuer Fehlerpfad Dfp_IndSys1" VAL_BLK 0xCADD8 Kwb_Wu8 255.000000000 SigName 0.00 255.000000000 FORMAT "%13.9" NUMBER 10 /end CHARACTERISTIC
/begin CHARACTERISTIC DSM_EnvDfp_IndSys2_C "Fehlerpfad spezifische Umweltbedingungen fuer Fehlerpfad Dfp_IndSys2" VAL_BLK 0xCADE2 Kwb_Wu8 255.000000000 SigName 0.00 255.000000000 FORMAT "%13.9" NUMBER 10 /end CHARACTERISTIC
/begin CHARACTERISTIC DSM_EnvDfp_InjCrv_InjLim_C "Fehlerpfad spezifische Umweltbedingungen fuer Fehlerpfad Dfp_InjCrv_InjLim" VAL_BLK 0xCADEC Kwb_Wu8 255.000000000 SigName 0.00 255.000000000 FORMAT "%13.9" NUMBER 10 /end CHARACTERISTIC
/begin CHARACTERISTIC DSM_EnvDfp_InjCtlAdjQnt_C "Fehlerpfad spezifische Umweltbedingungen fuer Fehlerpfad Dfp_InjCtlAdjQnt" VAL_BLK 0xCADF6 Kwb_Wu8 255.000000000 SigName 0.00 255.000000000 FORMAT "%13.9" NUMBER 10 /end CHARACTERISTIC
/begin CHARACTERISTIC DSM_EnvDfp_InjCtlDrift_C "Fehlerpfad spezifische Umweltbedingungen fuer Fehlerpfad Dfp_InjCtlDrift" VAL_BLK 0xCAE00 Kwb_Wu8 255.000000000 SigName 0.00 255.000000000 FORMAT "%13.9" NUMBER 10 /end CHARACTERISTIC
/begin CHARACTERISTIC DSM_EnvDfp_InjVlvBnk1A_C "Fehlerpfad spezifische Umweltbedingungen fuer Fehlerpfad Dfp_InjVlvBnk1A" VAL_BLK 0xCAE0A Kwb_Wu8 255.000000000 SigName 0.00 255.000000000 FORMAT "%13.9" NUMBER 10 /end CHARACTERISTIC
/begin CHARACTERISTIC DSM_EnvDfp_InjVlvBnk1B_C "Fehlerpfad spezifische Umweltbedingungen fuer Fehlerpfad Dfp_InjVlvBnk1B" VAL_BLK 0xCAE14 Kwb_Wu8 255.000000000 SigName 0.00 255.000000000 FORMAT "%13.9" NUMBER 10 /end CHARACTERISTIC
/begin CHARACTERISTIC DSM_EnvDfp_InjVlvBnk2A_C "Fehlerpfad spezifische Umweltbedingungen fuer Fehlerpfad Dfp_InjVlvBnk2A" VAL_BLK 0xCAE1E Kwb_Wu8 255.000000000 SigName 0.00 255.000000000 FORMAT "%13.9" NUMBER 10 /end CHARACTERISTIC
/begin CHARACTERISTIC DSM_EnvDfp_InjVlvBnk2B_C "Fehlerpfad spezifische Umweltbedingungen fuer Fehlerpfad Dfp_InjVlvBnk2B" VAL_BLK 0xCAE28 Kwb_Wu8 255.000000000 SigName 0.00 255.000000000 FORMAT "%13.9" NUMBER 10 /end CHARACTERISTIC
/begin CHARACTERISTIC DSM_EnvDfp_InjVlvChipA_C "Fehlerpfad spezifische Umweltbedingungen fuer Fehlerpfad Dfp_InjVlvChipA" VAL_BLK 0xCAE32 Kwb_Wu8 255.000000000 SigName 0.00 255.000000000 FORMAT "%13.9" NUMBER 10 /end CHARACTERISTIC
/begin CHARACTERISTIC DSM_EnvDfp_InjVlvChipB_C "Fehlerpfad spezifische Umweltbedingungen fuer Fehlerpfad Dfp_InjVlvChipB" VAL_BLK 0xCAE3C Kwb_Wu8 255.000000000 SigName 0.00 255.000000000 FORMAT "%13.9" NUMBER 10 /end CHARACTERISTIC
/begin CHARACTERISTIC DSM_EnvDfp_InjVlvCyl1A_C "Fehlerpfad spezifische Umweltbedingungen fuer Fehlerpfad Dfp_InjVlvCyl1A" VAL_BLK 0xCAE46 Kwb_Wu8 255.000000000 SigName 0.00 255.000000000 FORMAT "%13.9" NUMBER 10 /end CHARACTERISTIC
/begin CHARACTERISTIC DSM_EnvDfp_InjVlvCyl1B_C "Fehlerpfad spezifische Umweltbedingungen fuer Fehlerpfad Dfp_InjVlvCyl1B" VAL_BLK 0xCAE50 Kwb_Wu8 255.000000000 SigName 0.00 255.000000000 FORMAT "%13.9" NUMBER 10 /end CHARACTERISTIC
/begin CHARACTERISTIC DSM_EnvDfp_InjVlvCyl2A_C "Fehlerpfad spezifische Umweltbedingungen fuer Fehlerpfad Dfp_InjVlvCyl2A" VAL_BLK 0xCAE5A Kwb_Wu8 255.000000000 SigName 0.00 255.000000000 FORMAT "%13.9" NUMBER 10 /end CHARACTERISTIC
/begin CHARACTERISTIC DSM_EnvDfp_InjVlvCyl2B_C "Fehlerpfad spezifische Umweltbedingungen fuer Fehlerpfad Dfp_InjVlvCyl2B" VAL_BLK 0xCAE64 Kwb_Wu8 255.000000000 SigName 0.00 255.000000000 FORMAT "%13.9" NUMBER 10 /end CHARACTERISTIC
/begin CHARACTERISTIC DSM_EnvDfp_InjVlvCyl3A_C "Fehlerpfad spezifische Umweltbedingungen fuer Fehlerpfad Dfp_InjVlvCyl3A" VAL_BLK 0xCAE6E Kwb_Wu8 255.000000000 SigName 0.00 255.000000000 FORMAT "%13.9" NUMBER 10 /end CHARACTERISTIC
/begin CHARACTERISTIC DSM_EnvDfp_InjVlvCyl3B_C "Fehlerpfad spezifische Umweltbedingungen fuer Fehlerpfad Dfp_InjVlvCyl3B" VAL_BLK 0xCAE78 Kwb_Wu8 255.000000000 SigName 0.00 255.000000000 FORMAT "%13.9" NUMBER 10 /end CHARACTERISTIC
/begin CHARACTERISTIC DSM_EnvDfp_InjVlvCyl4A_C "Fehlerpfad spezifische Umweltbedingungen fuer Fehlerpfad Dfp_InjVlvCyl4A" VAL_BLK 0xCAE82 Kwb_Wu8 255.000000000 SigName 0.00 255.000000000 FORMAT "%13.9" NUMBER 10 /end CHARACTERISTIC
/begin CHARACTERISTIC DSM_EnvDfp_InjVlvCyl4B_C "Fehlerpfad spezifische Umweltbedingungen fuer Fehlerpfad Dfp_InjVlvCyl4B" VAL_BLK 0xCAE8C Kwb_Wu8 255.000000000 SigName 0.00 255.000000000 FORMAT "%13.9" NUMBER 10 /end CHARACTERISTIC
/begin CHARACTERISTIC DSM_EnvDfp_InjVlvCyl5A_C "Fehlerpfad spezifische Umweltbedingungen fuer Fehlerpfad Dfp_InjVlvCyl5A" VAL_BLK 0xCAE96 Kwb_Wu8 255.000000000 SigName 0.00 255.000000000 FORMAT "%13.9" NUMBER 10 /end CHARACTERISTIC
/begin CHARACTERISTIC DSM_EnvDfp_InjVlvCyl5B_C "Fehlerpfad spezifische Umweltbedingungen fuer Fehlerpfad Dfp_InjVlvCyl5B" VAL_BLK 0xCAEA0 Kwb_Wu8 255.000000000 SigName 0.00 255.000000000 FORMAT "%13.9" NUMBER 10 /end CHARACTERISTIC
/begin CHARACTERISTIC DSM_EnvDfp_InjVlvCyl6A_C "Fehlerpfad spezifische Umweltbedingungen fuer Fehlerpfad Dfp_InjVlvCyl6A" VAL_BLK 0xCAEAA Kwb_Wu8 255.000000000 SigName 0.00 255.000000000 FORMAT "%13.9" NUMBER 10 /end CHARACTERISTIC
/begin CHARACTERISTIC DSM_EnvDfp_InjVlvCyl6B_C "Fehlerpfad spezifische Umweltbedingungen fuer Fehlerpfad Dfp_InjVlvCyl6B" VAL_BLK 0xCAEB4 Kwb_Wu8 255.000000000 SigName 0.00 255.000000000 FORMAT "%13.9" NUMBER 10 /end CHARACTERISTIC
/begin CHARACTERISTIC DSM_EnvDfp_LPACD_Max_C "Fehlerpfad spezifische Umweltbedingungen fuer Fehlerpfad Dfp_LPACD_Max" VAL_BLK 0xCAEBE Kwb_Wu8 255.000000000 SigName 0.00 255.000000000 FORMAT "%13.9" NUMBER 10 /end CHARACTERISTIC
/begin CHARACTERISTIC DSM_EnvDfp_LPACD_Min_C "Fehlerpfad spezifische Umweltbedingungen fuer Fehlerpfad Dfp_LPACD_Min" VAL_BLK 0xCAEC8 Kwb_Wu8 255.000000000 SigName 0.00 255.000000000 FORMAT "%13.9" NUMBER 10 /end CHARACTERISTIC
/begin CHARACTERISTIC DSM_EnvDfp_LPACD_SigNpl_C "Fehlerpfad spezifische Umweltbedingungen fuer Fehlerpfad Dfp_LPACD_SigNpl" VAL_BLK 0xCAED2 Kwb_Wu8 255.000000000 SigName 0.00 255.000000000 FORMAT "%13.9" NUMBER 10 /end CHARACTERISTIC
/begin CHARACTERISTIC DSM_EnvDfp_LSUCDCircNernst0_C "Fehlerpfad spezifische Umweltbedingungen fuer Fehlerpfad Dfp_LSUCDCircNernst0" VAL_BLK 0xCAEDC Kwb_Wu8 255.000000000 SigName 0.00 255.000000000 FORMAT "%13.9" NUMBER 10 /end CHARACTERISTIC
/begin CHARACTERISTIC DSM_EnvDfp_LSUCDCircPumpCur0_C "Fehlerpfad spezifische Umweltbedingungen fuer Fehlerpfad Dfp_LSUCDCircPumpCur0" VAL_BLK 0xCAEE6 Kwb_Wu8 255.000000000 SigName 0.00 255.000000000 FORMAT "%13.9" NUMBER 10 /end CHARACTERISTIC
/begin CHARACTERISTIC DSM_EnvDfp_LSUCDCircVirtGnd0_C "Fehlerpfad spezifische Umweltbedingungen fuer Fehlerpfad Dfp_LSUCDCircVirtGnd0" VAL_BLK 0xCAEF0 Kwb_Wu8 255.000000000 SigName 0.00 255.000000000 FORMAT "%13.9" NUMBER 10 /end CHARACTERISTIC
/begin CHARACTERISTIC DSM_EnvDfp_LSUCDHeater0_C "Fehlerpfad spezifische Umweltbedingungen fuer Fehlerpfad Dfp_LSUCDHeater0" VAL_BLK 0xCAEFA Kwb_Wu8 255.000000000 SigName 0.00 255.000000000 FORMAT "%13.9" NUMBER 10 /end CHARACTERISTIC
/begin CHARACTERISTIC DSM_EnvDfp_LSUCDHtCoup0_C "Fehlerpfad spezifische Umweltbedingungen fuer Fehlerpfad Dfp_LSUCDHtCoup0" VAL_BLK 0xCAF04 Kwb_Wu8 255.000000000 SigName 0.00 255.000000000 FORMAT "%13.9" NUMBER 10 /end CHARACTERISTIC
/begin CHARACTERISTIC DSM_EnvDfp_LSUCDO20_C "Fehlerpfad spezifische Umweltbedingungen fuer Fehlerpfad Dfp_LSUCDO20" VAL_BLK 0xCAF0E Kwb_Wu8 255.000000000 SigName 0.00 255.000000000 FORMAT "%13.9" NUMBER 10 /end CHARACTERISTIC
/begin CHARACTERISTIC DSM_EnvDfp_LSUCDO2Clb0_C "Fehlerpfad spezifische Umweltbedingungen fuer Fehlerpfad Dfp_LSUCDO2Clb0" VAL_BLK 0xCAF18 Kwb_Wu8 255.000000000 SigName 0.00 255.000000000 FORMAT "%13.9" NUMBER 10 /end CHARACTERISTIC
/begin CHARACTERISTIC DSM_EnvDfp_LSUCDRiClb0_C "Fehlerpfad spezifische Umweltbedingungen fuer Fehlerpfad Dfp_LSUCDRiClb0" VAL_BLK 0xCAF22 Kwb_Wu8 255.000000000 SigName 0.00 255.000000000 FORMAT "%13.9" NUMBER 10 /end CHARACTERISTIC
/begin CHARACTERISTIC DSM_EnvDfp_LSUCDSPI0_C "Fehlerpfad spezifische Umweltbedingungen fuer Fehlerpfad Dfp_LSUCDSPI0" VAL_BLK 0xCAF2C Kwb_Wu8 255.000000000 SigName 0.00 255.000000000 FORMAT "%13.9" NUMBER 10 /end CHARACTERISTIC
/begin CHARACTERISTIC DSM_EnvDfp_LSUCDSPIBattLow0_C "Fehlerpfad spezifische Umweltbedingungen fuer Fehlerpfad Dfp_LSUCDSPIBattLow0" VAL_BLK 0xCAF36 Kwb_Wu8 255.000000000 SigName 0.00 255.000000000 FORMAT "%13.9" NUMBER 10 /end CHARACTERISTIC
/begin CHARACTERISTIC DSM_EnvDfp_LSUCDWireIP0_C "Fehlerpfad spezifische Umweltbedingungen fuer Fehlerpfad Dfp_LSUCDWireIP0" VAL_BLK 0xCAF40 Kwb_Wu8 255.000000000 SigName 0.00 255.000000000 FORMAT "%13.9" NUMBER 10 /end CHARACTERISTIC
/begin CHARACTERISTIC DSM_EnvDfp_LSUCtlRiExc0_C "Fehlerpfad spezifische Umweltbedingungen fuer Fehlerpfad Dfp_LSUCtlRiExc0" VAL_BLK 0xCAF4A Kwb_Wu8 255.000000000 SigName 0.00 255.000000000 FORMAT "%13.9" NUMBER 10 /end CHARACTERISTIC
/begin CHARACTERISTIC DSM_EnvDfp_LSUMon1Sens_C "Fehlerpfad spezifische Umweltbedingungen fuer Fehlerpfad Dfp_LSUMon1Sens" VAL_BLK 0xCAF54 Kwb_Wu8 255.000000000 SigName 0.00 255.000000000 FORMAT "%13.9" NUMBER 10 /end CHARACTERISTIC
/begin CHARACTERISTIC DSM_EnvDfp_LSUMon2Sens_C "Fehlerpfad spezifische Umweltbedingungen fuer Fehlerpfad Dfp_LSUMon2Sens" VAL_BLK 0xCAF5E Kwb_Wu8 255.000000000 SigName 0.00 255.000000000 FORMAT "%13.9" NUMBER 10 /end CHARACTERISTIC
/begin CHARACTERISTIC DSM_EnvDfp_LubCD_C "Fehlerpfad spezifische Umweltbedingungen fuer Fehlerpfad Dfp_LubCD" VAL_BLK 0xCAF68 Kwb_Wu8 255.000000000 SigName 0.00 255.000000000 FORMAT "%13.9" NUMBER 10 /end CHARACTERISTIC
/begin CHARACTERISTIC DSM_EnvDfp_MIL_C "Fehlerpfad spezifische Umweltbedingungen fuer Fehlerpfad Dfp_MIL" VAL_BLK 0xCAF72 Kwb_Wu8 255.000000000 SigName 0.00 255.000000000 FORMAT "%13.9" NUMBER 10 /end CHARACTERISTIC
/begin CHARACTERISTIC DSM_EnvDfp_MRlyCD_C "Fehlerpfad spezifische Umweltbedingungen fuer Fehlerpfad Dfp_MRlyCD" VAL_BLK 0xCAF7C Kwb_Wu8 255.000000000 SigName 0.00 255.000000000 FORMAT "%13.9" NUMBER 10 /end CHARACTERISTIC
/begin CHARACTERISTIC DSM_EnvDfp_MSidCD_Comm_C "Fehlerpfad spezifische Umweltbedingungen fuer Fehlerpfad Dfp_MSidCD_Comm" VAL_BLK 0xCAF86 Kwb_Wu8 255.000000000 SigName 0.00 255.000000000 FORMAT "%13.9" NUMBER 10 /end CHARACTERISTIC
/begin CHARACTERISTIC DSM_EnvDfp_MSidCD_Pin_C "Fehlerpfad spezifische Umweltbedingungen fuer Fehlerpfad Dfp_MSidCD_Pin" VAL_BLK 0xCAF90 Kwb_Wu8 255.000000000 SigName 0.00 255.000000000 FORMAT "%13.9" NUMBER 10 /end CHARACTERISTIC
/begin CHARACTERISTIC DSM_EnvDfp_MSidCD_Sel_INI_C "Fehlerpfad spezifische Umweltbedingungen fuer Fehlerpfad Dfp_MSidCD_Sel_INI" VAL_BLK 0xCAF9A Kwb_Wu8 255.000000000 SigName 0.00 255.000000000 FORMAT "%13.9" NUMBER 10 /end CHARACTERISTIC
/begin CHARACTERISTIC DSM_EnvDfp_MSidCD_Select_C "Fehlerpfad spezifische Umweltbedingungen fuer Fehlerpfad Dfp_MSidCD_Select" VAL_BLK 0xCAFA4 Kwb_Wu8 255.000000000 SigName 0.00 255.000000000 FORMAT "%13.9" NUMBER 10 /end CHARACTERISTIC
/begin CHARACTERISTIC DSM_EnvDfp_MeUnCDNoLoad_C "Fehlerpfad spezifische Umweltbedingungen fuer Fehlerpfad Dfp_MeUnCDNoLoad" VAL_BLK 0xCAFAE Kwb_Wu8 255.000000000 SigName 0.00 255.000000000 FORMAT "%13.9" NUMBER 10 /end CHARACTERISTIC
/begin CHARACTERISTIC DSM_EnvDfp_MeUnCDSCBat_C "Fehlerpfad spezifische Umweltbedingungen fuer Fehlerpfad Dfp_MeUnCDSCBat" VAL_BLK 0xCAFB8 Kwb_Wu8 255.000000000 SigName 0.00 255.000000000 FORMAT "%13.9" NUMBER 10 /end CHARACTERISTIC
/begin CHARACTERISTIC DSM_EnvDfp_MeUnCDSCGnd_C "Fehlerpfad spezifische Umweltbedingungen fuer Fehlerpfad Dfp_MeUnCDSCGnd" VAL_BLK 0xCAFC2 Kwb_Wu8 255.000000000 SigName 0.00 255.000000000 FORMAT "%13.9" NUMBER 10 /end CHARACTERISTIC
/begin CHARACTERISTIC DSM_EnvDfp_MeUnCD_ADC_C "Fehlerpfad spezifische Umweltbedingungen fuer Fehlerpfad Dfp_MeUnCD_ADC" VAL_BLK 0xCAFCC Kwb_Wu8 255.000000000 SigName 0.00 255.000000000 FORMAT "%13.9" NUMBER 10 /end CHARACTERISTIC
/begin CHARACTERISTIC DSM_EnvDfp_MeUnCD_SigTst_C "Fehlerpfad spezifische Umweltbedingungen fuer Fehlerpfad Dfp_MeUnCD_SigTst" VAL_BLK 0xCAFD6 Kwb_Wu8 255.000000000 SigName 0.00 255.000000000 FORMAT "%13.9" NUMBER 10 /end CHARACTERISTIC
/begin CHARACTERISTIC DSM_EnvDfp_Montr_C "Fehlerpfad spezifische Umweltbedingungen fuer Fehlerpfad Dfp_Montr" VAL_BLK 0xCAFE0 Kwb_Wu8 255.000000000 SigName 0.00 255.000000000 FORMAT "%13.9" NUMBER 10 /end CHARACTERISTIC
/begin CHARACTERISTIC DSM_EnvDfp_NetMngDeviceA_C "Fehlerpfad spezifische Umweltbedingungen fuer Fehlerpfad Dfp_NetMngDeviceA" VAL_BLK 0xCAFEA Kwb_Wu8 255.000000000 SigName 0.00 255.000000000 FORMAT "%13.9" NUMBER 10 /end CHARACTERISTIC
/begin CHARACTERISTIC DSM_EnvDfp_NetMngDeviceB_C "Fehlerpfad spezifische Umweltbedingungen fuer Fehlerpfad Dfp_NetMngDeviceB" VAL_BLK 0xCAFF4 Kwb_Wu8 255.000000000 SigName 0.00 255.000000000 FORMAT "%13.9" NUMBER 10 /end CHARACTERISTIC
/begin CHARACTERISTIC DSM_EnvDfp_NetMngDeviceC_C "Fehlerpfad spezifische Umweltbedingungen fuer Fehlerpfad Dfp_NetMngDeviceC" VAL_BLK 0xCAFFE Kwb_Wu8 255.000000000 SigName 0.00 255.000000000 FORMAT "%13.9" NUMBER 10 /end CHARACTERISTIC
/begin CHARACTERISTIC DSM_EnvDfp_OPSCD_Lamp_C "Fehlerpfad spezifische Umweltbedingungen fuer Fehlerpfad Dfp_OPSCD_Lamp" VAL_BLK 0xCB008 Kwb_Wu8 255.000000000 SigName 0.00 255.000000000 FORMAT "%13.9" NUMBER 10 /end CHARACTERISTIC
/begin CHARACTERISTIC DSM_EnvDfp_OPSCD_anain_C "Fehlerpfad spezifische Umweltbedingungen fuer Fehlerpfad Dfp_OPSCD_anain" VAL_BLK 0xCB012 Kwb_Wu8 255.000000000 SigName 0.00 255.000000000 FORMAT "%13.9" NUMBER 10 /end CHARACTERISTIC
/begin CHARACTERISTIC DSM_EnvDfp_OTSCD_C "Fehlerpfad spezifische Umweltbedingungen fuer Fehlerpfad Dfp_OTSCD" VAL_BLK 0xCB01C Kwb_Wu8 255.000000000 SigName 0.00 255.000000000 FORMAT "%13.9" NUMBER 10 /end CHARACTERISTIC
/begin CHARACTERISTIC DSM_EnvDfp_OvRMon_C "Fehlerpfad spezifische Umweltbedingungen fuer Fehlerpfad Dfp_OvRMon" VAL_BLK 0xCB026 Kwb_Wu8 255.000000000 SigName 0.00 255.000000000 FORMAT "%13.9" NUMBER 10 /end CHARACTERISTIC
/begin CHARACTERISTIC DSM_EnvDfp_OvRMonBrk_C "path specific environment  condition for fault path Dfp_OvRMonBrk" VAL_BLK 0xCB030 Kwb_Wu8 255.000000000 SigName 0.00 255.000000000 FORMAT "%13.9" NUMBER 10 /end CHARACTERISTIC
/begin CHARACTERISTIC DSM_EnvDfp_OvRMonSigA_C "Fehlerpfad spezifische Umweltbedingungen fuer Fehlerpfad Dfp_OvRMonSigA" VAL_BLK 0xCB03A Kwb_Wu8 255.000000000 SigName 0.00 255.000000000 FORMAT "%13.9" NUMBER 10 /end CHARACTERISTIC
/begin CHARACTERISTIC DSM_EnvDfp_OxiCCDTPre_C "Fehlerpfad spezifische Umweltbedingungen fuer Fehlerpfad Dfp_OxiCCDTPre" VAL_BLK 0xCB044 Kwb_Wu8 255.000000000 SigName 0.00 255.000000000 FORMAT "%13.9" NUMBER 10 /end CHARACTERISTIC
/begin CHARACTERISTIC DSM_EnvDfp_PCR_GovDevNeg_C "Fehlerpfad spezifische Umweltbedingungen fuer Fehlerpfad Dfp_PCR_GovDevNeg" VAL_BLK 0xCB04E Kwb_Wu8 255.000000000 SigName 0.00 255.000000000 FORMAT "%13.9" NUMBER 10 /end CHARACTERISTIC
/begin CHARACTERISTIC DSM_EnvDfp_PCR_GovDevPos_C "Fehlerpfad spezifische Umweltbedingungen fuer Fehlerpfad Dfp_PCR_GovDevPos" VAL_BLK 0xCB058 Kwb_Wu8 255.000000000 SigName 0.00 255.000000000 FORMAT "%13.9" NUMBER 10 /end CHARACTERISTIC
/begin CHARACTERISTIC DSM_EnvDfp_PCVCDNoLoad_C "Fehlerpfad spezifische Umweltbedingungen fuer Fehlerpfad Dfp_PCVCDNoLoad" VAL_BLK 0xCB062 Kwb_Wu8 255.000000000 SigName 0.00 255.000000000 FORMAT "%13.9" NUMBER 10 /end CHARACTERISTIC
/begin CHARACTERISTIC DSM_EnvDfp_PCVCDSCBat_C "Fehlerpfad spezifische Umweltbedingungen fuer Fehlerpfad Dfp_PCVCDSCBat" VAL_BLK 0xCB06C Kwb_Wu8 255.000000000 SigName 0.00 255.000000000 FORMAT "%13.9" NUMBER 10 /end CHARACTERISTIC
/begin CHARACTERISTIC DSM_EnvDfp_PCVCDSCGnd_C "Fehlerpfad spezifische Umweltbedingungen fuer Fehlerpfad Dfp_PCVCDSCGnd" VAL_BLK 0xCB076 Kwb_Wu8 255.000000000 SigName 0.00 255.000000000 FORMAT "%13.9" NUMBER 10 /end CHARACTERISTIC
/begin CHARACTERISTIC DSM_EnvDfp_PCVCD_ADC_C "Fehlerpfad spezifische Umweltbedingungen fuer Fehlerpfad Dfp_PCVCD_ADC" VAL_BLK 0xCB080 Kwb_Wu8 255.000000000 SigName 0.00 255.000000000 FORMAT "%13.9" NUMBER 10 /end CHARACTERISTIC
/begin CHARACTERISTIC DSM_EnvDfp_PCVCD_SigTst_C "Fehlerpfad spezifische Umweltbedingungen fuer Fehlerpfad Dfp_PCVCD_SigTst" VAL_BLK 0xCB08A Kwb_Wu8 255.000000000 SigName 0.00 255.000000000 FORMAT "%13.9" NUMBER 10 /end CHARACTERISTIC
/begin CHARACTERISTIC DSM_EnvDfp_PFltAPSens_C "Fehlerpfad spezifische Umweltbedingungen fuer Fehlerpfad Dfp_PFltAPSens" VAL_BLK 0xCB094 Kwb_Wu8 255.000000000 SigName 0.00 255.000000000 FORMAT "%13.9" NUMBER 10 /end CHARACTERISTIC
/begin CHARACTERISTIC DSM_EnvDfp_PFltCDPPre_C "Fehlerpfad spezifische Umweltbedingungen fuer Fehlerpfad Dfp_PFltCDPPre" VAL_BLK 0xCB09E Kwb_Wu8 255.000000000 SigName 0.00 255.000000000 FORMAT "%13.9" NUMBER 10 /end CHARACTERISTIC
/begin CHARACTERISTIC DSM_EnvDfp_PFltCDTempPre_C "Fehlerpfad spezifische Umweltbedingungen fuer Fehlerpfad Dfp_PFltCDTempPre" VAL_BLK 0xCB0A8 Kwb_Wu8 255.000000000 SigName 0.00 255.000000000 FORMAT "%13.9" NUMBER 10 /end CHARACTERISTIC
/begin CHARACTERISTIC DSM_EnvDfp_PFltChar_C "Fehlerpfad spezifische Umweltbedingungen fuer Fehlerpfad Dfp_PFltChar" VAL_BLK 0xCB0B2 Kwb_Wu8 255.000000000 SigName 0.00 255.000000000 FORMAT "%13.9" NUMBER 10 /end CHARACTERISTIC
/begin CHARACTERISTIC DSM_EnvDfp_PFltEngPrt_C "Fehlerpfad spezifische Umweltbedingungen fuer Fehlerpfad Dfp_PFltEngPrt" VAL_BLK 0xCB0BC Kwb_Wu8 255.000000000 SigName 0.00 255.000000000 FORMAT "%13.9" NUMBER 10 /end CHARACTERISTIC
/begin CHARACTERISTIC DSM_EnvDfp_PFltPresDynPlaus_C "Fehlerpfad spezifische Umweltbedingungen fuer Fehlerpfad Dfp_PFltPresDynPlaus" VAL_BLK 0xCB0C6 Kwb_Wu8 255.000000000 SigName 0.00 255.000000000 FORMAT "%13.9" NUMBER 10 /end CHARACTERISTIC
/begin CHARACTERISTIC DSM_EnvDfp_PFltPresSens_C "Fehlerpfad spezifische Umweltbedingungen fuer Fehlerpfad Dfp_PFltPresSens" VAL_BLK 0xCB0D0 Kwb_Wu8 255.000000000 SigName 0.00 255.000000000 FORMAT "%13.9" NUMBER 10 /end CHARACTERISTIC
/begin CHARACTERISTIC DSM_EnvDfp_PFltPresSensFrz_C "Fehlerpfad spezifische Umweltbedingungen fuer Fehlerpfad Dfp_PFltPresSensFrz" VAL_BLK 0xCB0DA Kwb_Wu8 255.000000000 SigName 0.00 255.000000000 FORMAT "%13.9" NUMBER 10 /end CHARACTERISTIC
/begin CHARACTERISTIC DSM_EnvDfp_PFltPresSensHsLn_C "Fehlerpfad spezifische Umweltbedingungen fuer Fehlerpfad Dfp_PFltPresSensHsLn" VAL_BLK 0xCB0E4 Kwb_Wu8 255.000000000 SigName 0.00 255.000000000 FORMAT "%13.9" NUMBER 10 /end CHARACTERISTIC
/begin CHARACTERISTIC DSM_EnvDfp_PFltPresSensSot_C "Fehlerpfad spezifische Umweltbedingungen fuer Fehlerpfad Dfp_PFltPresSensSot" VAL_BLK 0xCB0EE Kwb_Wu8 255.000000000 SigName 0.00 255.000000000 FORMAT "%13.9" NUMBER 10 /end CHARACTERISTIC
/begin CHARACTERISTIC DSM_EnvDfp_PFltRgnPerm_C "Fehlerpfad spezifische Umweltbedingungen fuer Fehlerpfad Dfp_PFltRgnPerm" VAL_BLK 0xCB0F8 Kwb_Wu8 255.000000000 SigName 0.00 255.000000000 FORMAT "%13.9" NUMBER 10 /end CHARACTERISTIC
/begin CHARACTERISTIC DSM_EnvDfp_PFltTempDwnStrm_C "Fehlerpfad spezifische Umweltbedingungen fuer Fehlerpfad Dfp_PFltTempDwnStrm" VAL_BLK 0xCB102 Kwb_Wu8 255.000000000 SigName 0.00 255.000000000 FORMAT "%13.9" NUMBER 10 /end CHARACTERISTIC
/begin CHARACTERISTIC DSM_EnvDfp_PFltTempSens_C "Fehlerpfad spezifische Umweltbedingungen fuer Fehlerpfad Dfp_PFltTempSens" VAL_BLK 0xCB10C Kwb_Wu8 255.000000000 SigName 0.00 255.000000000 FORMAT "%13.9" NUMBER 10 /end CHARACTERISTIC
/begin CHARACTERISTIC DSM_EnvDfp_PFltTempUpStrm_C "Fehlerpfad spezifische Umweltbedingungen fuer Fehlerpfad Dfp_PFltTempUpStrm" VAL_BLK 0xCB116 Kwb_Wu8 255.000000000 SigName 0.00 255.000000000 FORMAT "%13.9" NUMBER 10 /end CHARACTERISTIC
/begin CHARACTERISTIC DSM_EnvDfp_PFltmSotDiffMax_C "Fehlerpfad spezifische Umweltbedingungen fuer Fehlerpfad Dfp_PFltmSotDiffMax" VAL_BLK 0xCB120 Kwb_Wu8 255.000000000 SigName 0.00 255.000000000 FORMAT "%13.9" NUMBER 10 /end CHARACTERISTIC
/begin CHARACTERISTIC DSM_EnvDfp_PSPCD_Actr_C "Fehlerpfad spezifische Umweltbedingungen fuer Fehlerpfad Dfp_PSPCD_Actr" VAL_BLK 0xCB12A Kwb_Wu8 255.000000000 SigName 0.00 255.000000000 FORMAT "%13.9" NUMBER 10 /end CHARACTERISTIC
/begin CHARACTERISTIC DSM_EnvDfp_QLTCD_C "Fehlerpfad spezifische Umweltbedingungen fuer Fehlerpfad Dfp_QLTCD" VAL_BLK 0xCB134 Kwb_Wu8 255.000000000 SigName 0.00 255.000000000 FORMAT "%13.9" NUMBER 10 /end CHARACTERISTIC
/begin CHARACTERISTIC DSM_EnvDfp_RailCD_C "Fehlerpfad spezifische Umweltbedingungen fuer Fehlerpfad Dfp_RailCD" VAL_BLK 0xCB13E Kwb_Wu8 255.000000000 SigName 0.00 255.000000000 FORMAT "%13.9" NUMBER 10 /end CHARACTERISTIC
/begin CHARACTERISTIC DSM_EnvDfp_RailCDOfsTst_C "Fehlerpfad spezifische Umweltbedingungen fuer Fehlerpfad Dfp_RailCDOfsTst" VAL_BLK 0xCB148 Kwb_Wu8 255.000000000 SigName 0.00 255.000000000 FORMAT "%13.9" NUMBER 10 /end CHARACTERISTIC
/begin CHARACTERISTIC DSM_EnvDfp_RailCD_PMonStrt_C "Fehlerpfad spezifische Umweltbedingungen fuer Fehlerpfad Dfp_RailCD_PMonStrt" VAL_BLK 0xCB152 Kwb_Wu8 255.000000000 SigName 0.00 255.000000000 FORMAT "%13.9" NUMBER 10 /end CHARACTERISTIC
/begin CHARACTERISTIC DSM_EnvDfp_RailCtlModeMeUnDiag_C "Fehlerpfad spezifische Umweltbedingungen fuer Fehlerpfad Dfp_RailCtlModeMeUnDiag" VAL_BLK 0xCB15C Kwb_Wu8 255.000000000 SigName 0.00 255.000000000 FORMAT "%13.9" NUMBER 10 /end CHARACTERISTIC
/begin CHARACTERISTIC DSM_EnvDfp_RailCtlModePCVDiag_C "Fehlerpfad spezifische Umweltbedingungen fuer Fehlerpfad Dfp_RailCtlModePCVDiag" VAL_BLK 0xCB166 Kwb_Wu8 255.000000000 SigName 0.00 255.000000000 FORMAT "%13.9" NUMBER 10 /end CHARACTERISTIC
/begin CHARACTERISTIC DSM_EnvDfp_RailMeUn0_C "Fehlerpfad spezifische Umweltbedingungen fuer Fehlerpfad Dfp_RailMeUn0" VAL_BLK 0xCB170 Kwb_Wu8 255.000000000 SigName 0.00 255.000000000 FORMAT "%13.9" NUMBER 10 /end CHARACTERISTIC
/begin CHARACTERISTIC DSM_EnvDfp_RailMeUn1_C "Fehlerpfad spezifische Umweltbedingungen fuer Fehlerpfad Dfp_RailMeUn1" VAL_BLK 0xCB17A Kwb_Wu8 255.000000000 SigName 0.00 255.000000000 FORMAT "%13.9" NUMBER 10 /end CHARACTERISTIC
/begin CHARACTERISTIC DSM_EnvDfp_RailMeUn2_C "Fehlerpfad spezifische Umweltbedingungen fuer Fehlerpfad Dfp_RailMeUn2" VAL_BLK 0xCB184 Kwb_Wu8 255.000000000 SigName 0.00 255.000000000 FORMAT "%13.9" NUMBER 10 /end CHARACTERISTIC
/begin CHARACTERISTIC DSM_EnvDfp_RailMeUn3_C "Fehlerpfad spezifische Umweltbedingungen fuer Fehlerpfad Dfp_RailMeUn3" VAL_BLK 0xCB18E Kwb_Wu8 255.000000000 SigName 0.00 255.000000000 FORMAT "%13.9" NUMBER 10 /end CHARACTERISTIC
/begin CHARACTERISTIC DSM_EnvDfp_RailMeUn4_C "Fehlerpfad spezifische Umweltbedingungen fuer Fehlerpfad Dfp_RailMeUn4" VAL_BLK 0xCB198 Kwb_Wu8 255.000000000 SigName 0.00 255.000000000 FORMAT "%13.9" NUMBER 10 /end CHARACTERISTIC
/begin CHARACTERISTIC DSM_EnvDfp_RailPCV0_C "Fehlerpfad spezifische Umweltbedingungen fuer Fehlerpfad Dfp_RailPCV0" VAL_BLK 0xCB1A2 Kwb_Wu8 255.000000000 SigName 0.00 255.000000000 FORMAT "%13.9" NUMBER 10 /end CHARACTERISTIC
/begin CHARACTERISTIC DSM_EnvDfp_RailPCV1_C "Fehlerpfad spezifische Umweltbedingungen fuer Fehlerpfad Dfp_RailPCV1" VAL_BLK 0xCB1AC Kwb_Wu8 255.000000000 SigName 0.00 255.000000000 FORMAT "%13.9" NUMBER 10 /end CHARACTERISTIC
/begin CHARACTERISTIC DSM_EnvDfp_RailPCV2_C "Fehlerpfad spezifische Umweltbedingungen fuer Fehlerpfad Dfp_RailPCV2" VAL_BLK 0xCB1B6 Kwb_Wu8 255.000000000 SigName 0.00 255.000000000 FORMAT "%13.9" NUMBER 10 /end CHARACTERISTIC
/begin CHARACTERISTIC DSM_EnvDfp_RailPCV3_C "Fehlerpfad spezifische Umweltbedingungen fuer Fehlerpfad Dfp_RailPCV3" VAL_BLK 0xCB1C0 Kwb_Wu8 255.000000000 SigName 0.00 255.000000000 FORMAT "%13.9" NUMBER 10 /end CHARACTERISTIC
/begin CHARACTERISTIC DSM_EnvDfp_RailPCV4_C "Fehlerpfad spezifische Umweltbedingungen fuer Fehlerpfad Dfp_RailPCV4" VAL_BLK 0xCB1CA Kwb_Wu8 255.000000000 SigName 0.00 255.000000000 FORMAT "%13.9" NUMBER 10 /end CHARACTERISTIC
/begin CHARACTERISTIC DSM_EnvDfp_RailPCV5_C "Fehlerpfad spezifische Umweltbedingungen fuer Fehlerpfad Dfp_RailPCV5" VAL_BLK 0xCB1D4 Kwb_Wu8 255.000000000 SigName 0.00 255.000000000 FORMAT "%13.9" NUMBER 10 /end CHARACTERISTIC
/begin CHARACTERISTIC DSM_EnvDfp_SOPTst_C "Fehlerpfad spezifische Umweltbedingungen fuer Fehlerpfad Dfp_SOPTst" VAL_BLK 0xCB1DE Kwb_Wu8 255.000000000 SigName 0.00 255.000000000 FORMAT "%13.9" NUMBER 10 /end CHARACTERISTIC
/begin CHARACTERISTIC DSM_EnvDfp_SSpMon1_C "Fehlerpfad spezifische Umweltbedingungen fuer Fehlerpfad Dfp_SSpMon1" VAL_BLK 0xCB1E8 Kwb_Wu8 255.000000000 SigName 0.00 255.000000000 FORMAT "%13.9" NUMBER 10 /end CHARACTERISTIC
/begin CHARACTERISTIC DSM_EnvDfp_SSpMon2_C "Fehlerpfad spezifische Umweltbedingungen fuer Fehlerpfad Dfp_SSpMon2" VAL_BLK 0xCB1F2 Kwb_Wu8 255.000000000 SigName 0.00 255.000000000 FORMAT "%13.9" NUMBER 10 /end CHARACTERISTIC
/begin CHARACTERISTIC DSM_EnvDfp_SSpMon3_C "Fehlerpfad spezifische Umweltbedingungen fuer Fehlerpfad Dfp_SSpMon3" VAL_BLK 0xCB1FC Kwb_Wu8 255.000000000 SigName 0.00 255.000000000 FORMAT "%13.9" NUMBER 10 /end CHARACTERISTIC
/begin CHARACTERISTIC DSM_EnvDfp_SWChk_CycSigChkDat_C "Fehlerpfad spezifische Umweltbedingungen fuer Fehlerpfad Dfp_SWChk_CycSigChkDat" VAL_BLK 0xCB206 Kwb_Wu8 255.000000000 SigName 0.00 255.000000000 FORMAT "%13.9" NUMBER 10 /end CHARACTERISTIC
/begin CHARACTERISTIC DSM_EnvDfp_SWChk_CycSigChkPrg_C "Fehlerpfad spezifische Umweltbedingungen fuer Fehlerpfad Dfp_SWChk_CycSigChkPrg" VAL_BLK 0xCB210 Kwb_Wu8 255.000000000 SigName 0.00 255.000000000 FORMAT "%13.9" NUMBER 10 /end CHARACTERISTIC
/begin CHARACTERISTIC DSM_EnvDfp_ShutCD_C "Fehlerpfad spezifische Umweltbedingungen fuer Fehlerpfad Dfp_ShutCD" VAL_BLK 0xCB21A Kwb_Wu8 255.000000000 SigName 0.00 255.000000000 FORMAT "%13.9" NUMBER 10 /end CHARACTERISTIC
/begin CHARACTERISTIC DSM_EnvDfp_StSysTrqShutOff_C "Fehlerpfad spezifische Umweltbedingungen fuer Fehlerpfad Dfp_StSysTrqShutOff" VAL_BLK 0xCB224 Kwb_Wu8 255.000000000 SigName 0.00 255.000000000 FORMAT "%13.9" NUMBER 10 /end CHARACTERISTIC
/begin CHARACTERISTIC DSM_EnvDfp_StrtCD_Actr_C "Fehlerpfad spezifische Umweltbedingungen fuer Fehlerpfad Dfp_StrtCD_Actr" VAL_BLK 0xCB22E Kwb_Wu8 255.000000000 SigName 0.00 255.000000000 FORMAT "%13.9" NUMBER 10 /end CHARACTERISTIC
/begin CHARACTERISTIC DSM_EnvDfp_SysLamp_C "Fehlerpfad spezifische Umweltbedingungen fuer Fehlerpfad Dfp_SysLamp" VAL_BLK 0xCB238 Kwb_Wu8 255.000000000 SigName 0.00 255.000000000 FORMAT "%13.9" NUMBER 10 /end CHARACTERISTIC
/begin CHARACTERISTIC DSM_EnvDfp_T15CD_C "Fehlerpfad spezifische Umweltbedingungen fuer Fehlerpfad Dfp_T15CD" VAL_BLK 0xCB242 Kwb_Wu8 255.000000000 SigName 0.00 255.000000000 FORMAT "%13.9" NUMBER 10 /end CHARACTERISTIC
/begin CHARACTERISTIC DSM_EnvDfp_TGearbx_C "Fehlerpfad spezifische Umweltbedingungen fuer Fehlerpfad Dfp_TGearbx" VAL_BLK 0xCB24C Kwb_Wu8 255.000000000 SigName 0.00 255.000000000 FORMAT "%13.9" NUMBER 10 /end CHARACTERISTIC
/begin CHARACTERISTIC DSM_EnvDfp_TPUMon_C "Fehlerpfad spezifische Umweltbedingungen fuer Fehlerpfad Dfp_TPUMon" VAL_BLK 0xCB256 Kwb_Wu8 255.000000000 SigName 0.00 255.000000000 FORMAT "%13.9" NUMBER 10 /end CHARACTERISTIC
/begin CHARACTERISTIC DSM_EnvDfp_TVACD_Max_C "Fehlerpfad spezifische Umweltbedingungen fuer Fehlerpfad Dfp_TVACD_Max" VAL_BLK 0xCB260 Kwb_Wu8 255.000000000 SigName 0.00 255.000000000 FORMAT "%13.9" NUMBER 10 /end CHARACTERISTIC
/begin CHARACTERISTIC DSM_EnvDfp_TVACD_Min_C "Fehlerpfad spezifische Umweltbedingungen fuer Fehlerpfad Dfp_TVACD_Min" VAL_BLK 0xCB26A Kwb_Wu8 255.000000000 SigName 0.00 255.000000000 FORMAT "%13.9" NUMBER 10 /end CHARACTERISTIC
/begin CHARACTERISTIC DSM_EnvDfp_TVACD_SigNpl_C "Fehlerpfad spezifische Umweltbedingungen fuer Fehlerpfad Dfp_TVACD_SigNpl" VAL_BLK 0xCB274 Kwb_Wu8 255.000000000 SigName 0.00 255.000000000 FORMAT "%13.9" NUMBER 10 /end CHARACTERISTIC
/begin CHARACTERISTIC DSM_EnvDfp_TVACD_TVADia1_C "Fehlerpfad spezifische Umweltbedingungen fuer Fehlerpfad Dfp_TVACD_TVADia1" VAL_BLK 0xCB27E Kwb_Wu8 255.000000000 SigName 0.00 255.000000000 FORMAT "%13.9" NUMBER 10 /end CHARACTERISTIC
/begin CHARACTERISTIC DSM_EnvDfp_TVACD_TVADia2_C "Fehlerpfad spezifische Umweltbedingungen fuer Fehlerpfad Dfp_TVACD_TVADia2" VAL_BLK 0xCB288 Kwb_Wu8 255.000000000 SigName 0.00 255.000000000 FORMAT "%13.9" NUMBER 10 /end CHARACTERISTIC
/begin CHARACTERISTIC DSM_EnvDfp_TVACD_TVADia3_C "Fehlerpfad spezifische Umweltbedingungen fuer Fehlerpfad Dfp_TVACD_TVADia3" VAL_BLK 0xCB292 Kwb_Wu8 255.000000000 SigName 0.00 255.000000000 FORMAT "%13.9" NUMBER 10 /end CHARACTERISTIC
/begin CHARACTERISTIC DSM_EnvDfp_TVACD_TVADia4_C "Fehlerpfad spezifische Umweltbedingungen fuer Fehlerpfad Dfp_TVACD_TVADia4" VAL_BLK 0xCB29C Kwb_Wu8 255.000000000 SigName 0.00 255.000000000 FORMAT "%13.9" NUMBER 10 /end CHARACTERISTIC
/begin CHARACTERISTIC DSM_EnvDfp_VSACD_DioInDia1_C "Fehlerpfad spezifische Umweltbedingungen fuer Fehlerpfad Dfp_VSACD_DioInDia1" VAL_BLK 0xCB2A6 Kwb_Wu8 255.000000000 SigName 0.00 255.000000000 FORMAT "%13.9" NUMBER 10 /end CHARACTERISTIC
/begin CHARACTERISTIC DSM_EnvDfp_VSACD_DioInDia2_C "Fehlerpfad spezifische Umweltbedingungen fuer Fehlerpfad Dfp_VSACD_DioInDia2" VAL_BLK 0xCB2B0 Kwb_Wu8 255.000000000 SigName 0.00 255.000000000 FORMAT "%13.9" NUMBER 10 /end CHARACTERISTIC
/begin CHARACTERISTIC DSM_EnvDfp_VSACD_DioInDia3_C "Fehlerpfad spezifische Umweltbedingungen fuer Fehlerpfad Dfp_VSACD_DioInDia3" VAL_BLK 0xCB2BA Kwb_Wu8 255.000000000 SigName 0.00 255.000000000 FORMAT "%13.9" NUMBER 10 /end CHARACTERISTIC
/begin CHARACTERISTIC DSM_EnvDfp_VSACD_DioInDia4_C "Fehlerpfad spezifische Umweltbedingungen fuer Fehlerpfad Dfp_VSACD_DioInDia4" VAL_BLK 0xCB2C4 Kwb_Wu8 255.000000000 SigName 0.00 255.000000000 FORMAT "%13.9" NUMBER 10 /end CHARACTERISTIC
/begin CHARACTERISTIC DSM_EnvDfp_VSACD_DioInMin_C "Fehlerpfad spezifische Umweltbedingungen fuer Fehlerpfad Dfp_VSACD_DioInMin" VAL_BLK 0xCB2CE Kwb_Wu8 255.000000000 SigName 0.00 255.000000000 FORMAT "%13.9" NUMBER 10 /end CHARACTERISTIC
/begin CHARACTERISTIC DSM_EnvDfp_VSACD_Max_C "Fehlerpfad spezifische Umweltbedingungen fuer Fehlerpfad Dfp_VSACD_Max" VAL_BLK 0xCB2D8 Kwb_Wu8 255.000000000 SigName 0.00 255.000000000 FORMAT "%13.9" NUMBER 10 /end CHARACTERISTIC
/begin CHARACTERISTIC DSM_EnvDfp_VSACD_Min_C "Fehlerpfad spezifische Umweltbedingungen fuer Fehlerpfad Dfp_VSACD_Min" VAL_BLK 0xCB2E2 Kwb_Wu8 255.000000000 SigName 0.00 255.000000000 FORMAT "%13.9" NUMBER 10 /end CHARACTERISTIC
/begin CHARACTERISTIC DSM_EnvDfp_VSACD_SigNpl_C "Fehlerpfad spezifische Umweltbedingungen fuer Fehlerpfad Dfp_VSACD_SigNpl" VAL_BLK 0xCB2EC Kwb_Wu8 255.000000000 SigName 0.00 255.000000000 FORMAT "%13.9" NUMBER 10 /end CHARACTERISTIC
/begin CHARACTERISTIC DSM_EnvDfp_VSACD_VSADia1_C "Fehlerpfad spezifische Umweltbedingungen fuer Fehlerpfad Dfp_VSACD_VSADia1" VAL_BLK 0xCB2F6 Kwb_Wu8 255.000000000 SigName 0.00 255.000000000 FORMAT "%13.9" NUMBER 10 /end CHARACTERISTIC
/begin CHARACTERISTIC DSM_EnvDfp_VSACD_VSADia2_C "Fehlerpfad spezifische Umweltbedingungen fuer Fehlerpfad Dfp_VSACD_VSADia2" VAL_BLK 0xCB300 Kwb_Wu8 255.000000000 SigName 0.00 255.000000000 FORMAT "%13.9" NUMBER 10 /end CHARACTERISTIC
/begin CHARACTERISTIC DSM_EnvDfp_VSACD_VSADia3_C "Fehlerpfad spezifische Umweltbedingungen fuer Fehlerpfad Dfp_VSACD_VSADia3" VAL_BLK 0xCB30A Kwb_Wu8 255.000000000 SigName 0.00 255.000000000 FORMAT "%13.9" NUMBER 10 /end CHARACTERISTIC
/begin CHARACTERISTIC DSM_EnvDfp_VSACD_VSADia4_C "Fehlerpfad spezifische Umweltbedingungen fuer Fehlerpfad Dfp_VSACD_VSADia4" VAL_BLK 0xCB314 Kwb_Wu8 255.000000000 SigName 0.00 255.000000000 FORMAT "%13.9" NUMBER 10 /end CHARACTERISTIC
/begin CHARACTERISTIC DSM_EnvDfp_VSSCD1_C "Fehlerpfad spezifische Umweltbedingungen fuer Fehlerpfad Dfp_VSSCD1" VAL_BLK 0xCB31E Kwb_Wu8 255.000000000 SigName 0.00 255.000000000 FORMAT "%13.9" NUMBER 10 /end CHARACTERISTIC
/begin CHARACTERISTIC DSM_EnvDfp_VSSCD2_C "Fehlerpfad spezifische Umweltbedingungen fuer Fehlerpfad Dfp_VSSCD2" VAL_BLK 0xCB328 Kwb_Wu8 255.000000000 SigName 0.00 255.000000000 FORMAT "%13.9" NUMBER 10 /end CHARACTERISTIC
/begin CHARACTERISTIC DSM_EnvDfp_WdCom_C "Fehlerpfad spezifische Umweltbedingungen fuer Fehlerpfad Dfp_WdCom" VAL_BLK 0xCB332 Kwb_Wu8 255.000000000 SigName 0.00 255.000000000 FORMAT "%13.9" NUMBER 10 /end CHARACTERISTIC
/begin FUNCTION dsm_auto_env8 ""
 /begin DEF_CHARACTERISTIC DSM_EnvDfp_Layer_TANS_C DSM_EnvDfp_ACCDCmpr_C DSM_EnvDfp_ACCDPres_C DSM_EnvDfp_ACCDPres1_C DSM_EnvDfp_ACCDPresAna_C DSM_EnvDfp_ACCDSwtin_C DSM_EnvDfp_ACC_PlausTrqDes_C DSM_EnvDfp_ACC_trqInr_C DSM_EnvDfp_ACTrq_C DSM_EnvDfp_ADCMon_C DSM_EnvDfp_AFSCDIdlAdjVal_C DSM_EnvDfp_AFSCDLdAdjVal_C DSM_EnvDfp_AFSCD_AirTempDcyc_C DSM_EnvDfp_AFSCD_PlOffsDrft_C DSM_EnvDfp_AFSCD_PlSetyDrft_C DSM_EnvDfp_AFSCD_SRCAirTemp_C DSM_EnvDfp_AFSCD_SRCBatt_C DSM_EnvDfp_AFSCD_SRCCorrAirm_C DSM_EnvDfp_AFSCD_SRCRawAirm_C DSM_EnvDfp_Layer_TUMG_C DSM_EnvDfp_AFSCD_SRCRefSigPer_C DSM_EnvDfp_AOHtCD_C DSM_EnvDfp_Layer_GEN_C DSM_EnvDfp_Layer_BSD_C DSM_EnvDfp_AOHtCD_AOHtDia1_C DSM_EnvDfp_AOHtCD_AOHtDia2_C DSM_EnvDfp_AOHtCD_AOHtDia3_C DSM_EnvDfp_APP1_C DSM_EnvDfp_APP2_C DSM_EnvDfp_APPSync_C DSM_EnvDfp_APSCD_C DSM_EnvDfp_ARS_C DSM_EnvDfp_AccPedPlausBrk_C DSM_EnvDfp_AirCtlPlateBreak_C DSM_EnvDfp_Layer_QLT_C DSM_EnvDfp_AirCtl_GovNegDev_C DSM_EnvDfp_Layer_IBS1_C DSM_EnvDfp_Layer_IBS2_C DSM_EnvDfp_Layer_IBS3_C DSM_EnvDfp_Layer_PMBN_C DSM_EnvDfp_Layer_PMBATT_C DSM_EnvDfp_AirCtl_GovNegDev2_C DSM_EnvDfp_AirCtl_GovPosDev_C DSM_EnvDfp_AirCtl_GovPosDev2_C DSM_EnvDfp_AltCD_C DSM_EnvDfp_AltCD_Load_C DSM_EnvDfp_BPACD_BPADia1_C DSM_EnvDfp_BPACD_BPADia2_C DSM_EnvDfp_BPACD_BPADia3_C DSM_EnvDfp_BPACD_Max_C DSM_EnvDfp_BPACD_Min_C DSM_EnvDfp_BPACD_SigNpl_C DSM_EnvDfp_BPSCD_C DSM_EnvDfp_BattCD_C DSM_EnvDfp_BrkCD_C DSM_EnvDfp_Bss_C DSM_EnvDfp_CBACD_C DSM_EnvDfp_CTSCD_C DSM_EnvDfp_Clg_DynTst_C DSM_EnvDfp_CmbChbMisfire1_C DSM_EnvDfp_CmbChbMisfire2_C DSM_EnvDfp_CmbChbMisfire3_C DSM_EnvDfp_CmbChbMisfire4_C DSM_EnvDfp_CmbChbMisfire5_C DSM_EnvDfp_CmbChbMisfire6_C DSM_EnvDfp_CmbChbMisfireMul_C DSM_EnvDfp_CoVMDCSh_C DSM_EnvDfp_ConvCD_C DSM_EnvDfp_CrCCDMFL_C DSM_EnvDfp_CrCtl_vCrCtl_C DSM_EnvDfp_Dummy1_C DSM_EnvDfp_EATSCD_C DSM_EnvDfp_EBAFCD_C DSM_EnvDfp_Layer_PMRUHVERL_C DSM_EnvDfp_EBFCD_C DSM_EnvDfp_EBTSCD_C DSM_EnvDfp_EBTSCD_OvrTemp_C DSM_EnvDfp_EEPCDVarMng_C DSM_EnvDfp_Layer_TOENS_C DSM_EnvDfp_Layer_MANHYDR_C DSM_EnvDfp_Layer_MANLUFT_C DSM_EnvDfp_EGPpCD_C DSM_EnvDfp_EGPpCDTPreTrbn_C DSM_EnvDfp_EGRCD_Max_C DSM_EnvDfp_EGRCD_Min_C DSM_EnvDfp_EGRCD_SigNpl_C DSM_EnvDfp_EGTRgnOilDil_C DSM_EnvDfp_EMCCDNoLoad1_C DSM_EnvDfp_EMCCDNoLoad2_C DSM_EnvDfp_EMCCDSCBat1_C DSM_EnvDfp_EMCCDSCBat2_C DSM_EnvDfp_EMCCDSCGnd1_C DSM_EnvDfp_EMCCDSCGnd2_C DSM_EnvDfp_EMCCD_ADC1_C DSM_EnvDfp_EMCCD_ADC2_C DSM_EnvDfp_ETClbETFltInj1_C DSM_EnvDfp_ETClbETFltInj2_C DSM_EnvDfp_ETClbETFltInj3_C DSM_EnvDfp_ETClbETFltInj4_C DSM_EnvDfp_ETClbETFltInj5_C DSM_EnvDfp_ETClbETFltInj6_C DSM_EnvDfp_ETClbInj1_C DSM_EnvDfp_ETClbInj2_C DSM_EnvDfp_ETClbInj3_C DSM_EnvDfp_ETClbInj4_C DSM_EnvDfp_ETClbInj5_C DSM_EnvDfp_ETClbInj6_C DSM_EnvDfp_EngMCaS1_C DSM_EnvDfp_EngMCrS1_C DSM_EnvDfp_EngMOfsCaSCrS_C DSM_EnvDfp_EngPrtFWODet_C DSM_EnvDfp_FBCqDvt_C DSM_EnvDfp_FMTC_NonMonotonMap_C DSM_EnvDfp_FTSCD_C DSM_EnvDfp_FanCD_C DSM_EnvDfp_FanCD_FanCtlr1_C DSM_EnvDfp_FanCD_FanCtlr2_C DSM_EnvDfp_FanCD_FanCtlr3_C DSM_EnvDfp_FlFCD_C DSM_EnvDfp_FlMngSmkDefect_C DSM_EnvDfp_FrmMngASC1_C DSM_EnvDfp_FrmMngASC2_C DSM_EnvDfp_FrmMngASC3_C DSM_EnvDfp_FrmMngASC4_C DSM_EnvDfp_FrmMngBOS_RESET_C DSM_EnvDfp_FrmMngBOS_RESET_2_C DSM_EnvDfp_FrmMngDMANFAFS_C DSM_EnvDfp_FrmMngDRMANFSSG_C DSM_EnvDfp_FrmMngEGS1_C DSM_EnvDfp_FrmMngEGS2_C DSM_EnvDfp_FrmMngGEARBX_DATA_C DSM_EnvDfp_FrmMngGEARBX_DATA2_C DSM_EnvDfp_FrmMngHEAT_AC_C DSM_EnvDfp_FrmMngINSTR2_C DSM_EnvDfp_FrmMngINSTR3_C DSM_EnvDfp_FrmMngLENKRADWINKEL_C DSM_EnvDfp_FrmMngMILEAGE_RANGE_C DSM_EnvDfp_FrmMngOPCRCTLACC_C DSM_EnvDfp_FrmMngPRGG_CCTR_C DSM_EnvDfp_FrmMngPWRMNG_LOADV_C DSM_EnvDfp_FrmMngParkConsumer_C DSM_EnvDfp_FrmMngRQSTGEFAN_C DSM_EnvDfp_FrmMngSSGErr_C DSM_EnvDfp_FrmMngSSGShOff_C DSM_EnvDfp_FrmMngSTAT_ANH_C DSM_EnvDfp_FrmMngSTAT_ARS_C DSM_EnvDfp_FrmMngSTAT_DSC_C DSM_EnvDfp_FrmMngSTAT_EKP_C DSM_EnvDfp_FrmMngSTAT_KOMBI_C DSM_EnvDfp_FrmMngSTAT_SITZ_C DSM_EnvDfp_FrmMngStOBDGbxMilOf_C DSM_EnvDfp_FrmMngStOBDGbxMilOn_C DSM_EnvDfp_FrmMngTEMPRELTIME_C DSM_EnvDfp_FrmMngTERMINAL_C DSM_EnvDfp_FrmMngTIME_DATE_C DSM_EnvDfp_FrmMngTORQUE_DSC_C DSM_EnvDfp_FrmMngTORQUE_GEARBX_C DSM_EnvDfp_FrmMngTrq_ReqACC_C DSM_EnvDfp_FrmMngVEH_MOD_C DSM_EnvDfp_FrmMngVELOCITY_C DSM_EnvDfp_FrmMngWHEEL_SPEED_C DSM_EnvDfp_FrmMngstCurr_C DSM_EnvDfp_FrmMngswtPSPOff_C DSM_EnvDfp_GearbxIncMax_C DSM_EnvDfp_GlwCD_C DSM_EnvDfp_GlwCDGlwCirc1_C DSM_EnvDfp_GlwCDGlwCirc2_C DSM_EnvDfp_GlwCDGlwCirc3_C DSM_EnvDfp_GlwCDGlwCirc4_C DSM_EnvDfp_GlwCDGlwCirc5_C DSM_EnvDfp_GlwCDGlwCirc6_C DSM_EnvDfp_GlwCDGlwCirc7_C DSM_EnvDfp_GlwCDGlwCirc8_C DSM_EnvDfp_GlwCtl_C DSM_EnvDfp_HWEMonCom_C DSM_EnvDfp_HWEMonEEPROM_C DSM_EnvDfp_HWEMonRcyLocked_C DSM_EnvDfp_HWEMonRcySuppressed_C DSM_EnvDfp_HWEMonRcyVisible_C DSM_EnvDfp_HWEMonUMaxSupply_C DSM_EnvDfp_HWEMonUMinSupply_C DSM_EnvDfp_IATSCD_C DSM_EnvDfp_IATSCD_CATS_C DSM_EnvDfp_ImmCtlImmCD_C DSM_EnvDfp_ImmCtlImmEep_C DSM_EnvDfp_ImmCtlMpl_C DSM_EnvDfp_IndSys1_C DSM_EnvDfp_IndSys2_C DSM_EnvDfp_InjCrv_InjLim_C DSM_EnvDfp_InjCtlAdjQnt_C DSM_EnvDfp_InjCtlDrift_C DSM_EnvDfp_InjVlvBnk1A_C DSM_EnvDfp_InjVlvBnk1B_C DSM_EnvDfp_InjVlvBnk2A_C DSM_EnvDfp_InjVlvBnk2B_C DSM_EnvDfp_InjVlvChipA_C DSM_EnvDfp_InjVlvChipB_C DSM_EnvDfp_InjVlvCyl1A_C DSM_EnvDfp_InjVlvCyl1B_C DSM_EnvDfp_InjVlvCyl2A_C DSM_EnvDfp_InjVlvCyl2B_C DSM_EnvDfp_InjVlvCyl3A_C DSM_EnvDfp_InjVlvCyl3B_C DSM_EnvDfp_InjVlvCyl4A_C DSM_EnvDfp_InjVlvCyl4B_C DSM_EnvDfp_InjVlvCyl5A_C DSM_EnvDfp_InjVlvCyl5B_C DSM_EnvDfp_InjVlvCyl6A_C DSM_EnvDfp_InjVlvCyl6B_C DSM_EnvDfp_LPACD_Max_C DSM_EnvDfp_LPACD_Min_C DSM_EnvDfp_LPACD_SigNpl_C DSM_EnvDfp_LSUCDCircNernst0_C DSM_EnvDfp_LSUCDCircPumpCur0_C DSM_EnvDfp_LSUCDCircVirtGnd0_C DSM_EnvDfp_LSUCDHeater0_C DSM_EnvDfp_LSUCDHtCoup0_C DSM_EnvDfp_LSUCDO20_C DSM_EnvDfp_LSUCDO2Clb0_C DSM_EnvDfp_LSUCDRiClb0_C DSM_EnvDfp_LSUCDSPI0_C DSM_EnvDfp_LSUCDSPIBattLow0_C DSM_EnvDfp_LSUCDWireIP0_C DSM_EnvDfp_LSUCtlRiExc0_C DSM_EnvDfp_LSUMon1Sens_C DSM_EnvDfp_LSUMon2Sens_C DSM_EnvDfp_LubCD_C DSM_EnvDfp_MIL_C DSM_EnvDfp_MRlyCD_C DSM_EnvDfp_MSidCD_Comm_C DSM_EnvDfp_MSidCD_Pin_C DSM_EnvDfp_MSidCD_Sel_INI_C DSM_EnvDfp_MSidCD_Select_C DSM_EnvDfp_MeUnCDNoLoad_C DSM_EnvDfp_MeUnCDSCBat_C DSM_EnvDfp_MeUnCDSCGnd_C DSM_EnvDfp_MeUnCD_ADC_C DSM_EnvDfp_MeUnCD_SigTst_C DSM_EnvDfp_Montr_C DSM_EnvDfp_NetMngDeviceA_C DSM_EnvDfp_NetMngDeviceB_C DSM_EnvDfp_NetMngDeviceC_C DSM_EnvDfp_OPSCD_Lamp_C DSM_EnvDfp_OPSCD_anain_C DSM_EnvDfp_OTSCD_C DSM_EnvDfp_OvRMon_C DSM_EnvDfp_OvRMonBrk_C DSM_EnvDfp_OvRMonSigA_C DSM_EnvDfp_OxiCCDTPre_C DSM_EnvDfp_PCR_GovDevNeg_C DSM_EnvDfp_PCR_GovDevPos_C DSM_EnvDfp_PCVCDNoLoad_C DSM_EnvDfp_PCVCDSCBat_C DSM_EnvDfp_PCVCDSCGnd_C DSM_EnvDfp_PCVCD_ADC_C DSM_EnvDfp_PCVCD_SigTst_C DSM_EnvDfp_PFltAPSens_C DSM_EnvDfp_PFltCDPPre_C DSM_EnvDfp_PFltCDTempPre_C DSM_EnvDfp_PFltChar_C DSM_EnvDfp_PFltEngPrt_C DSM_EnvDfp_PFltPresDynPlaus_C DSM_EnvDfp_PFltPresSens_C DSM_EnvDfp_PFltPresSensFrz_C DSM_EnvDfp_PFltPresSensHsLn_C DSM_EnvDfp_PFltPresSensSot_C DSM_EnvDfp_PFltRgnPerm_C DSM_EnvDfp_PFltTempDwnStrm_C DSM_EnvDfp_PFltTempSens_C DSM_EnvDfp_PFltTempUpStrm_C DSM_EnvDfp_PFltmSotDiffMax_C DSM_EnvDfp_PSPCD_Actr_C DSM_EnvDfp_QLTCD_C DSM_EnvDfp_RailCD_C DSM_EnvDfp_RailCDOfsTst_C DSM_EnvDfp_RailCD_PMonStrt_C DSM_EnvDfp_RailCtlModeMeUnDiag_C DSM_EnvDfp_RailCtlModePCVDiag_C DSM_EnvDfp_RailMeUn0_C DSM_EnvDfp_RailMeUn1_C DSM_EnvDfp_RailMeUn2_C DSM_EnvDfp_RailMeUn3_C DSM_EnvDfp_RailMeUn4_C DSM_EnvDfp_RailPCV0_C DSM_EnvDfp_RailPCV1_C DSM_EnvDfp_RailPCV2_C DSM_EnvDfp_RailPCV3_C DSM_EnvDfp_RailPCV4_C DSM_EnvDfp_RailPCV5_C DSM_EnvDfp_SOPTst_C DSM_EnvDfp_SSpMon1_C DSM_EnvDfp_SSpMon2_C DSM_EnvDfp_SSpMon3_C DSM_EnvDfp_SWChk_CycSigChkDat_C DSM_EnvDfp_SWChk_CycSigChkPrg_C DSM_EnvDfp_ShutCD_C DSM_EnvDfp_StSysTrqShutOff_C DSM_EnvDfp_StrtCD_Actr_C DSM_EnvDfp_SysLamp_C DSM_EnvDfp_T15CD_C DSM_EnvDfp_TGearbx_C DSM_EnvDfp_TPUMon_C DSM_EnvDfp_TVACD_Max_C DSM_EnvDfp_TVACD_Min_C DSM_EnvDfp_TVACD_SigNpl_C DSM_EnvDfp_TVACD_TVADia1_C DSM_EnvDfp_TVACD_TVADia2_C DSM_EnvDfp_TVACD_TVADia3_C DSM_EnvDfp_TVACD_TVADia4_C DSM_EnvDfp_VSACD_DioInDia1_C DSM_EnvDfp_VSACD_DioInDia2_C DSM_EnvDfp_VSACD_DioInDia3_C DSM_EnvDfp_VSACD_DioInDia4_C DSM_EnvDfp_VSACD_DioInMin_C DSM_EnvDfp_VSACD_Max_C DSM_EnvDfp_VSACD_Min_C DSM_EnvDfp_VSACD_SigNpl_C DSM_EnvDfp_VSACD_VSADia1_C DSM_EnvDfp_VSACD_VSADia2_C DSM_EnvDfp_VSACD_VSADia3_C DSM_EnvDfp_VSACD_VSADia4_C DSM_EnvDfp_VSSCD1_C DSM_EnvDfp_VSSCD2_C DSM_EnvDfp_WdCom_C /end DEF_CHARACTERISTIC
/end FUNCTION
/begin FUNCTION dsm_auto_fid_scd "" /end FUNCTION
/begin FUNCTION dsm_auto_fid_scd_msg "" /end FUNCTION
/begin COMPU_METHOD SigName "Verbale Umrechnung für Signal Referenz Nummern" TAB_VERB "%6.3" "-" COMPU_TAB_REF SigName /end COMPU_METHOD
/begin COMPU_VTAB SigName "Verbale Umrechnung für Signal Referenz Nummern" TAB_VERB 109 0 "Sig_unused" 4 "CoEng_rTrq__Carb_r_DLen1" 5 "CTSCD_tClntLin__Carb_t_DLen1" 11 "BPSCD_pLin__Carb_p_DLen1" 12 "Eng_nAvrg__Carb_n_DLen2" 13 "VSSCD_vSensVal__Carb_v_DLen1" 15 "AFSCD_tAir_mp__Carb_t_DLen1" 16 "AFSCD_dmAirRawPerTime__Carb_mAirTim_DLen2" 28 "Signals_PID0x1C_C__OneToOne_DLen1" 33 "DSMDur_ctDfctDur1__Carb_l_DLen2" 128 "AFSCD_dmAirPerTime__mAirTim_DLen2" 129 "AFSCD_mAirPerCyl__mAirCyl_DLen2" 131 "AFSCD_rAir__dcyc_DLen2" 133 "AOHtCD_rOut_mp__dcyc_DLen2" 134 "APPCD_rFlt__r_DLen2" 137 "APPCD_uRawAPP1__u_DLen2" 138 "APPCD_uRawAPP2__u_DLen2" 139 "APSCD_pVal__p_DLen2" 140 "APSCD_uRaw__u_DLen2" 141 "AirCtl_mDesVal__mAirCyl_DLen2" 142 "AltCD_rAltLoad__r_DLen2" 143 "BPACD_rOut__dcyc_DLen2" 145 "BPSCD_pOutVal__p_DLen2" 146 "BPSCD_uRawVal__u_DLen2" 147 "BattCD_u__uBatt_DLen2" 148 "CBACD_stLogicOut_mp__OneToOne_DLen1" 149 "CTSCD_tClnt__t_DLen2" 150 "CTSCD_uRaw__u_DLen2" 151 "CoEng_trq__trq_DLen2" 152 "EBAFCD_stSigOut__OneToOne_DLen1" 153 "EGRCD_rOut__dcyc_DLen2" 155 "EGT_st__ShftRght0Byte_DLen2" 156 "EngM_stOut__OneToOne_DLen1" 157 "EngM_stSync__OneToOne_DLen1" 158 "Eng_nAvrg__n_DLen2" 159 "FMTC_trqInr__trq_DLen2" 160 "FTSCD_tFuel__t_DLen2" 161 "FTSCD_uRaw__u_DLen2" 162 "FanCD_dcycRaw_mp__dcyc_DLen2" 163 "FlFCD_stFlFltRawVal__OneToOne_DLen1" 164 "FrmMng_nPSP__nPSPSpd_DLen2" 165 "FrmMng_rPSPSetPoint__r_DLen2" 166 "GlwCtl_rPwrOut__OneToOne_DLen1" 167 "GlwCtl_stLampOut__OneToOne_DLen1" 168 "HWEMon_numRecovery__ShftRght0Byte_DLen2" 169 "HWEMon_numRecovery__ShftRght1Byte_DLen2" 170 "HWEMon_recLocLow_mp__ShftRght0Byte_DLen2" 171 "HWEMon_recLocLow_mp__ShftRght1Byte_DLen2" 172 "HWEMon_recLocHigh_mp__ShftRght0Byte_DLen2" 173 "IATSCD_tAir__t_DLen2" 174 "IATSCD_tAirCats__t_DLen2" 176 "IATSCD_uRawCats__u_DLen2" 181 "InjCtl_qCurr__qInjMassCyc_DLen2" 182 "InjCtl_qSetUnBal__qInjMassCyc_DLen2" 183 "LIGov_nSetpoint__n_DLen2" 184 "LIGov_trq__trq_DLen2" 185 "LPACD_rOut__dcyc_DLen2" 186 "LSUCD_rO2Raw[0]__O2_DLen2" 187 "LSUCD_uO2Raw[0]__u_DLen2" 188 "LSU_rLmbd[0]__Lambda_DLen2" 189 "LSU_rO2Adpt[0]__O2_DLen2" 190 "MeUnCD_dcycOut_mp__dcyc_DLen2" 191 "OPSCD_stSigOut__OneToOne_DLen1" 192 "OPSCD_stpOEL__OneToOne_DLen1" 193 "OTSCD_tEngOil__t_DLen2" 194 "OxiCCD_tPre__tExhaustgas_DLen2" 196 "OxiCCD_uRawTempPre__u_DLen2" 198 "PCR_pDesVal__p_DLen2" 199 "PCVCD_dcycOut_mp__dcyc_DLen2" 200 "PFltCD_pPre__p_DLen2" 202 "PFltCD_tPre__tExhaustgas_DLen2" 204 "PFltCD_uRawPresPre_mp__u_DLen2" 206 "PFltCD_uRawTempPre__u_DLen2" 208 "PFlt_dvol__volph_DLen2" 209 "PFlt_lSnceRgnu16_mp__lenrgnu16PFlt_DLen2" 211 "PFlt_mAshOil__mSoot_DLen2" 212 "PFlt_mSot__mSoot_DLen2" 213 "PFlt_mSotSim__mSoot_DLen2" 214 "PFlt_numEngPOp__OneToOne_DLen1" 215 "PFlt_numRgn_mp__OneToOne_DLen1" 216 "PFlt_pDiff__p_DLen2" 217 "PFlt_qFl_mp__FlConPFlt_DLen2" 219 "PFlt_stEngPOp__OneToOne_DLen1" 220 "PFlt_stIntr_mp__OneToOne_DLen1" 221 "PFlt_stLck_mp__OneToOne_DLen1" 222 "PSPCD_dvolOut__FlCon_DLen2" 223 "RailCD_pPeak__pRail_DLen2" 224 "RailCD_uPeakRaw__u_DLen2" 225 "Rail_pSetPoint__pRail_DLen2" 226 "TVACD_rOut__dcyc_DLen2" 228 "VSACD_rOut__dcyc_DLen2" 229 "VSSCD_v__v_DLen2" 230 "VehDa_tiEngOn__timEng_DLen2" 240 "Absch_korr__FSwQ0p00153_DLen2" 241 "D_soc__FSwB100_DLen2" 242 "I_batt__IUwQ0p08O200_DLen2" 243 "Oz_oelkm__KmUwQ10_DLen2" 244 "Oz_oelnivkurz__TdUbQ0p5_DLen1" 245 "Oz_oelnivnorm__TdUbQ0p5_DLen1" 246 "Oz_oelnivori__TdUbQ0p5_DLen1" 247 "Pm_klemmstat__DezUbQ1_DLen1" 248 "Stat_sv_reg1__DezUbQ1_DLen1" 249 "Stat_sv_reg2__DezUbQ1_DLen1" 250 "T2histshort__TdUbQ14p9333_DLen1" 251 "T3histshort__TdUbQ14p9333_DLen1" 252 "T4histshort__TdUbQ14p9333_DLen1" 253 "Toel__TSwQ0p1_DLen2" 254 "T_batt__TSwQ0p1_DLen2" 255 "U_batt__UUwQ0p25em3_DLen2" /end COMPU_VTAB
/begin RECORD_LAYOUT Kwb_Wu8 FNC_VALUES 1 UBYTE COLUMN_DIR DIRECT /end RECORD_LAYOUT
/end MODULE
/end PROJECT
