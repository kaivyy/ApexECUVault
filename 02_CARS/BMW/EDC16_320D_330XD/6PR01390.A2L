ASAP2_VERSION 1 3
/begin PROJECT P390 "BMW DDE6.2 6-Zylinder VR0.1 15.03.2004 CAN11/12H"
/begin HEADER "" VERSION "VR0.1_6Z_CAN11/12H" PROJECT_NO P390 /end HEADER
/begin MODULE DIM ""
/begin MOD_COMMON "" BYTE_ORDER MSB_FIRST ALIGNMENT_BYTE 1 ALIGNMENT_WORD 2 ALIGNMENT_LONG 4 ALIGNMENT_FLOAT32_IEEE 4 /end MOD_COMMON
/begin CHARACTERISTIC DSM_CDCDfp_Layer_TANS_C "CARB spezifischer Fehlercode fuer Fehlerpfad Dfp_Layer_TANS" VAL_BLK 0xC99CA Kwb_Wu16 65535.00 OneToOne 0.00 65535.00 FORMAT "%8.2" NUMBER 4 /end CHARACTERISTIC
/begin CHARACTERISTIC DSM_CDCDfp_ACCDCmpr_C "CARB spezifischer Fehlercode fuer Fehlerpfad Dfp_ACCDCmpr" VAL_BLK 0xC99D2 Kwb_Wu16 65535.00 OneToOne 0.00 65535.00 FORMAT "%8.2" NUMBER 4 /end CHARACTERISTIC
/begin CHARACTERISTIC DSM_CDCDfp_ACCDPres_C "CARB spezifischer Fehlercode fuer Fehlerpfad Dfp_ACCDPres" VAL_BLK 0xC99DA Kwb_Wu16 65535.00 OneToOne 0.00 65535.00 FORMAT "%8.2" NUMBER 4 /end CHARACTERISTIC
/begin CHARACTERISTIC DSM_CDCDfp_ACCDPres1_C "CARB spezifischer Fehlercode fuer Fehlerpfad Dfp_ACCDPres1" VAL_BLK 0xC99E2 Kwb_Wu16 65535.00 OneToOne 0.00 65535.00 FORMAT "%8.2" NUMBER 4 /end CHARACTERISTIC
/begin CHARACTERISTIC DSM_CDCDfp_ACCDPresAna_C "CARB spezifischer Fehlercode fuer Fehlerpfad Dfp_ACCDPresAna" VAL_BLK 0xC99EA Kwb_Wu16 65535.00 OneToOne 0.00 65535.00 FORMAT "%8.2" NUMBER 4 /end CHARACTERISTIC
/begin CHARACTERISTIC DSM_CDCDfp_ACCDSwtin_C "CARB spezifischer Fehlercode fuer Fehlerpfad Dfp_ACCDSwtin" VAL_BLK 0xC99F2 Kwb_Wu16 65535.00 OneToOne 0.00 65535.00 FORMAT "%8.2" NUMBER 4 /end CHARACTERISTIC
/begin CHARACTERISTIC DSM_CDCDfp_ACC_PlausTrqDes_C "CARB spezifischer Fehlercode fuer Fehlerpfad Dfp_ACC_PlausTrqDes" VAL_BLK 0xC99FA Kwb_Wu16 65535.00 OneToOne 0.00 65535.00 FORMAT "%8.2" NUMBER 4 /end CHARACTERISTIC
/begin CHARACTERISTIC DSM_CDCDfp_ACC_trqInr_C "CARB spezifischer Fehlercode fuer Fehlerpfad Dfp_ACC_trqInr" VAL_BLK 0xC9A02 Kwb_Wu16 65535.00 OneToOne 0.00 65535.00 FORMAT "%8.2" NUMBER 4 /end CHARACTERISTIC
/begin CHARACTERISTIC DSM_CDCDfp_ACTrq_C "CARB spezifischer Fehlercode fuer Fehlerpfad Dfp_ACTrq" VAL_BLK 0xC9A0A Kwb_Wu16 65535.00 OneToOne 0.00 65535.00 FORMAT "%8.2" NUMBER 4 /end CHARACTERISTIC
/begin CHARACTERISTIC DSM_CDCDfp_ADCMon_C "CARB spezifischer Fehlercode fuer Fehlerpfad Dfp_ADCMon" VAL_BLK 0xC9A12 Kwb_Wu16 65535.00 OneToOne 0.00 65535.00 FORMAT "%8.2" NUMBER 4 /end CHARACTERISTIC
/begin CHARACTERISTIC DSM_CDCDfp_AFSCDIdlAdjVal_C "CARB spezifischer Fehlercode fuer Fehlerpfad Dfp_AFSCDIdlAdjVal" VAL_BLK 0xC9A1A Kwb_Wu16 65535.00 OneToOne 0.00 65535.00 FORMAT "%8.2" NUMBER 4 /end CHARACTERISTIC
/begin CHARACTERISTIC DSM_CDCDfp_AFSCDLdAdjVal_C "CARB spezifischer Fehlercode fuer Fehlerpfad Dfp_AFSCDLdAdjVal" VAL_BLK 0xC9A22 Kwb_Wu16 65535.00 OneToOne 0.00 65535.00 FORMAT "%8.2" NUMBER 4 /end CHARACTERISTIC
/begin CHARACTERISTIC DSM_CDCDfp_AFSCD_AirTempDcyc_C "CARB spezifischer Fehlercode fuer Fehlerpfad Dfp_AFSCD_AirTempDcyc" VAL_BLK 0xC9A2A Kwb_Wu16 65535.00 OneToOne 0.00 65535.00 FORMAT "%8.2" NUMBER 4 /end CHARACTERISTIC
/begin CHARACTERISTIC DSM_CDCDfp_AFSCD_PlOffsDrft_C "CARB spezifischer Fehlercode fuer Fehlerpfad Dfp_AFSCD_PlOffsDrft" VAL_BLK 0xC9A32 Kwb_Wu16 65535.00 OneToOne 0.00 65535.00 FORMAT "%8.2" NUMBER 4 /end CHARACTERISTIC
/begin CHARACTERISTIC DSM_CDCDfp_AFSCD_PlSetyDrft_C "CARB spezifischer Fehlercode fuer Fehlerpfad Dfp_AFSCD_PlSetyDrft" VAL_BLK 0xC9A3A Kwb_Wu16 65535.00 OneToOne 0.00 65535.00 FORMAT "%8.2" NUMBER 4 /end CHARACTERISTIC
/begin CHARACTERISTIC DSM_CDCDfp_AFSCD_SRCAirTemp_C "CARB spezifischer Fehlercode fuer Fehlerpfad Dfp_AFSCD_SRCAirTemp" VAL_BLK 0xC9A42 Kwb_Wu16 65535.00 OneToOne 0.00 65535.00 FORMAT "%8.2" NUMBER 4 /end CHARACTERISTIC
/begin CHARACTERISTIC DSM_CDCDfp_AFSCD_SRCBatt_C "CARB spezifischer Fehlercode fuer Fehlerpfad Dfp_AFSCD_SRCBatt" VAL_BLK 0xC9A4A Kwb_Wu16 65535.00 OneToOne 0.00 65535.00 FORMAT "%8.2" NUMBER 4 /end CHARACTERISTIC
/begin CHARACTERISTIC DSM_CDCDfp_AFSCD_SRCCorrAirm_C "CARB spezifischer Fehlercode fuer Fehlerpfad Dfp_AFSCD_SRCCorrAirm" VAL_BLK 0xC9A52 Kwb_Wu16 65535.00 OneToOne 0.00 65535.00 FORMAT "%8.2" NUMBER 4 /end CHARACTERISTIC
/begin CHARACTERISTIC DSM_CDCDfp_AFSCD_SRCRawAirm_C "CARB spezifischer Fehlercode fuer Fehlerpfad Dfp_AFSCD_SRCRawAirm" VAL_BLK 0xC9A5A Kwb_Wu16 65535.00 OneToOne 0.00 65535.00 FORMAT "%8.2" NUMBER 4 /end CHARACTERISTIC
/begin CHARACTERISTIC DSM_CDCDfp_Layer_TUMG_C "CARB spezifischer Fehlercode fuer Fehlerpfad Dfp_Layer_TUMG" VAL_BLK 0xC9A62 Kwb_Wu16 65535.00 OneToOne 0.00 65535.00 FORMAT "%8.2" NUMBER 4 /end CHARACTERISTIC
/begin CHARACTERISTIC DSM_CDCDfp_AFSCD_SRCRefSigPer_C "CARB spezifischer Fehlercode fuer Fehlerpfad Dfp_AFSCD_SRCRefSigPer" VAL_BLK 0xC9A6A Kwb_Wu16 65535.00 OneToOne 0.00 65535.00 FORMAT "%8.2" NUMBER 4 /end CHARACTERISTIC
/begin CHARACTERISTIC DSM_CDCDfp_AOHtCD_C "CARB spezifischer Fehlercode fuer Fehlerpfad Dfp_AOHtCD" VAL_BLK 0xC9A72 Kwb_Wu16 65535.00 OneToOne 0.00 65535.00 FORMAT "%8.2" NUMBER 4 /end CHARACTERISTIC
/begin CHARACTERISTIC DSM_CDCDfp_Layer_GEN_C "CARB spezifischer Fehlercode fuer Fehlerpfad Dfp_Layer_GEN" VAL_BLK 0xC9A7A Kwb_Wu16 65535.00 OneToOne 0.00 65535.00 FORMAT "%8.2" NUMBER 4 /end CHARACTERISTIC
/begin CHARACTERISTIC DSM_CDCDfp_Layer_BSD_C "CARB spezifischer Fehlercode fuer Fehlerpfad Dfp_Layer_BSD" VAL_BLK 0xC9A82 Kwb_Wu16 65535.00 OneToOne 0.00 65535.00 FORMAT "%8.2" NUMBER 4 /end CHARACTERISTIC
/begin CHARACTERISTIC DSM_CDCDfp_AOHtCD_AOHtDia1_C "CARB spezifischer Fehlercode fuer Fehlerpfad Dfp_AOHtCD_AOHtDia1" VAL_BLK 0xC9A8A Kwb_Wu16 65535.00 OneToOne 0.00 65535.00 FORMAT "%8.2" NUMBER 4 /end CHARACTERISTIC
/begin CHARACTERISTIC DSM_CDCDfp_AOHtCD_AOHtDia2_C "CARB spezifischer Fehlercode fuer Fehlerpfad Dfp_AOHtCD_AOHtDia2" VAL_BLK 0xC9A92 Kwb_Wu16 65535.00 OneToOne 0.00 65535.00 FORMAT "%8.2" NUMBER 4 /end CHARACTERISTIC
/begin CHARACTERISTIC DSM_CDCDfp_AOHtCD_AOHtDia3_C "CARB spezifischer Fehlercode fuer Fehlerpfad Dfp_AOHtCD_AOHtDia3" VAL_BLK 0xC9A9A Kwb_Wu16 65535.00 OneToOne 0.00 65535.00 FORMAT "%8.2" NUMBER 4 /end CHARACTERISTIC
/begin CHARACTERISTIC DSM_CDCDfp_APP1_C "CARB spezifischer Fehlercode fuer Fehlerpfad Dfp_APP1" VAL_BLK 0xC9AA2 Kwb_Wu16 65535.00 OneToOne 0.00 65535.00 FORMAT "%8.2" NUMBER 4 /end CHARACTERISTIC
/begin CHARACTERISTIC DSM_CDCDfp_APP2_C "CARB spezifischer Fehlercode fuer Fehlerpfad Dfp_APP2" VAL_BLK 0xC9AAA Kwb_Wu16 65535.00 OneToOne 0.00 65535.00 FORMAT "%8.2" NUMBER 4 /end CHARACTERISTIC
/begin CHARACTERISTIC DSM_CDCDfp_APPSync_C "CARB spezifischer Fehlercode fuer Fehlerpfad Dfp_APPSync" VAL_BLK 0xC9AB2 Kwb_Wu16 65535.00 OneToOne 0.00 65535.00 FORMAT "%8.2" NUMBER 4 /end CHARACTERISTIC
/begin CHARACTERISTIC DSM_CDCDfp_APSCD_C "CARB spezifischer Fehlercode fuer Fehlerpfad Dfp_APSCD" VAL_BLK 0xC9ABA Kwb_Wu16 65535.00 OneToOne 0.00 65535.00 FORMAT "%8.2" NUMBER 4 /end CHARACTERISTIC
/begin CHARACTERISTIC DSM_CDCDfp_ARS_C "CARB spezifischer Fehlercode fuer Fehlerpfad Dfp_ARS" VAL_BLK 0xC9AC2 Kwb_Wu16 65535.00 OneToOne 0.00 65535.00 FORMAT "%8.2" NUMBER 4 /end CHARACTERISTIC
/begin CHARACTERISTIC DSM_CDCDfp_AccPedPlausBrk_C "CARB spezifischer Fehlercode fuer Fehlerpfad Dfp_AccPedPlausBrk" VAL_BLK 0xC9ACA Kwb_Wu16 65535.00 OneToOne 0.00 65535.00 FORMAT "%8.2" NUMBER 4 /end CHARACTERISTIC
/begin CHARACTERISTIC DSM_CDCDfp_AirCtlGvnrDvtRgnMax_C "CARB spezifischer Fehlercode fuer Fehlerpfad Dfp_AirCtlGvnrDvtRgnMax" VAL_BLK 0xC9AD2 Kwb_Wu16 65535.00 OneToOne 0.00 65535.00 FORMAT "%8.2" NUMBER 4 /end CHARACTERISTIC
/begin CHARACTERISTIC DSM_CDCDfp_Layer_QLT_C "CARB spezifischer Fehlercode fuer Fehlerpfad Dfp_Layer_QLT" VAL_BLK 0xC9ADA Kwb_Wu16 65535.00 OneToOne 0.00 65535.00 FORMAT "%8.2" NUMBER 4 /end CHARACTERISTIC
/begin CHARACTERISTIC DSM_CDCDfp_AirCtlGvnrDvtRgnMax2_C "" VAL_BLK 0xC9AE2 Kwb_Wu16 65535.00 OneToOne 0.00 65535.00 FORMAT "%8.2" NUMBER 4 /end CHARACTERISTIC
/begin CHARACTERISTIC DSM_CDCDfp_Layer_IBS1_C "CARB spezifischer Fehlercode fuer Fehlerpfad Dfp_Layer_IBS1" VAL_BLK 0xC9AEA Kwb_Wu16 65535.00 OneToOne 0.00 65535.00 FORMAT "%8.2" NUMBER 4 /end CHARACTERISTIC
/begin CHARACTERISTIC DSM_CDCDfp_Layer_IBS2_C "CARB spezifischer Fehlercode fuer Fehlerpfad Dfp_Layer_IBS2" VAL_BLK 0xC9AF2 Kwb_Wu16 65535.00 OneToOne 0.00 65535.00 FORMAT "%8.2" NUMBER 4 /end CHARACTERISTIC
/begin CHARACTERISTIC DSM_CDCDfp_Layer_IBS3_C "CARB spezifischer Fehlercode fuer Fehlerpfad Dfp_Layer_IBS3" VAL_BLK 0xC9AFA Kwb_Wu16 65535.00 OneToOne 0.00 65535.00 FORMAT "%8.2" NUMBER 4 /end CHARACTERISTIC
/begin CHARACTERISTIC DSM_CDCDfp_Layer_PMBN_C "CARB spezifischer Fehlercode fuer Fehlerpfad Dfp_Layer_PMBN" VAL_BLK 0xC9B02 Kwb_Wu16 65535.00 OneToOne 0.00 65535.00 FORMAT "%8.2" NUMBER 4 /end CHARACTERISTIC
/begin CHARACTERISTIC DSM_CDCDfp_Layer_PMBATT_C "CARB spezifischer Fehlercode fuer Fehlerpfad Dfp_Layer_PMBATT" VAL_BLK 0xC9B0A Kwb_Wu16 65535.00 OneToOne 0.00 65535.00 FORMAT "%8.2" NUMBER 4 /end CHARACTERISTIC
/begin CHARACTERISTIC DSM_CDCDfp_AirCtlGvnrDvtRgnMin_C "CARB spezifischer Fehlercode fuer Fehlerpfad Dfp_AirCtlGvnrDvtRgnMin" VAL_BLK 0xC9B12 Kwb_Wu16 65535.00 OneToOne 0.00 65535.00 FORMAT "%8.2" NUMBER 4 /end CHARACTERISTIC
/begin CHARACTERISTIC DSM_CDCDfp_AirCtlGvnrDvtRgnMin2_C "" VAL_BLK 0xC9B1A Kwb_Wu16 65535.00 OneToOne 0.00 65535.00 FORMAT "%8.2" NUMBER 4 /end CHARACTERISTIC
/begin CHARACTERISTIC DSM_CDCDfp_AirCtlPlateBreak_C "DSM variable for Dfp_AirCtlPlateBreak_mp" VAL_BLK 0xC9B22 Kwb_Wu16 65535.00 OneToOne 0.00 65535.00 FORMAT "%8.2" NUMBER 4 /end CHARACTERISTIC
/begin CHARACTERISTIC DSM_CDCDfp_AirCtlRmpTO_C "CARB spezifischer Fehlercode fuer Fehlerpfad Dfp_AirCtlRmpTO" VAL_BLK 0xC9B2A Kwb_Wu16 65535.00 OneToOne 0.00 65535.00 FORMAT "%8.2" NUMBER 4 /end CHARACTERISTIC
/begin CHARACTERISTIC DSM_CDCDfp_AirCtl_GovNegDev_C "CARB spezifischer Fehlercode fuer Fehlerpfad Dfp_AirCtl_GovNegDev" VAL_BLK 0xC9B32 Kwb_Wu16 65535.00 OneToOne 0.00 65535.00 FORMAT "%8.2" NUMBER 4 /end CHARACTERISTIC
/begin CHARACTERISTIC DSM_CDCDfp_AirCtl_GovNegDev2_C "CARB spezifischer Fehlercode fuer Fehlerpfad Dfp_AirCtl_GovNegDev2" VAL_BLK 0xC9B3A Kwb_Wu16 65535.00 OneToOne 0.00 65535.00 FORMAT "%8.2" NUMBER 4 /end CHARACTERISTIC
/begin CHARACTERISTIC DSM_CDCDfp_AirCtl_GovPosDev_C "CARB spezifischer Fehlercode fuer Fehlerpfad Dfp_AirCtl_GovPosDev" VAL_BLK 0xC9B42 Kwb_Wu16 65535.00 OneToOne 0.00 65535.00 FORMAT "%8.2" NUMBER 4 /end CHARACTERISTIC
/begin CHARACTERISTIC DSM_CDCDfp_AirCtl_GovPosDev2_C "CARB spezifischer Fehlercode fuer Fehlerpfad Dfp_AirCtl_GovPosDev2" VAL_BLK 0xC9B4A Kwb_Wu16 65535.00 OneToOne 0.00 65535.00 FORMAT "%8.2" NUMBER 4 /end CHARACTERISTIC
/begin CHARACTERISTIC DSM_CDCDfp_AltCD_C "CARB spezifischer Fehlercode fuer Fehlerpfad Dfp_AltCD" VAL_BLK 0xC9B52 Kwb_Wu16 65535.00 OneToOne 0.00 65535.00 FORMAT "%8.2" NUMBER 4 /end CHARACTERISTIC
/begin CHARACTERISTIC DSM_CDCDfp_AltCD_Load_C "CARB spezifischer Fehlercode fuer Fehlerpfad Dfp_AltCD_Load" VAL_BLK 0xC9B5A Kwb_Wu16 65535.00 OneToOne 0.00 65535.00 FORMAT "%8.2" NUMBER 4 /end CHARACTERISTIC
/begin CHARACTERISTIC DSM_CDCDfp_BPACD_BPADia1_C "CARB spezifischer Fehlercode fuer Fehlerpfad Dfp_BPACD_BPADia1" VAL_BLK 0xC9B62 Kwb_Wu16 65535.00 OneToOne 0.00 65535.00 FORMAT "%8.2" NUMBER 4 /end CHARACTERISTIC
/begin CHARACTERISTIC DSM_CDCDfp_BPACD_BPADia2_C "CARB spezifischer Fehlercode fuer Fehlerpfad Dfp_BPACD_BPADia2" VAL_BLK 0xC9B6A Kwb_Wu16 65535.00 OneToOne 0.00 65535.00 FORMAT "%8.2" NUMBER 4 /end CHARACTERISTIC
/begin CHARACTERISTIC DSM_CDCDfp_BPACD_BPADia3_C "CARB spezifischer Fehlercode fuer Fehlerpfad Dfp_BPACD_BPADia3" VAL_BLK 0xC9B72 Kwb_Wu16 65535.00 OneToOne 0.00 65535.00 FORMAT "%8.2" NUMBER 4 /end CHARACTERISTIC
/begin CHARACTERISTIC DSM_CDCDfp_BPACD_Max_C "CARB spezifischer Fehlercode fuer Fehlerpfad Dfp_BPACD_Max" VAL_BLK 0xC9B7A Kwb_Wu16 65535.00 OneToOne 0.00 65535.00 FORMAT "%8.2" NUMBER 4 /end CHARACTERISTIC
/begin CHARACTERISTIC DSM_CDCDfp_BPACD_Min_C "CARB spezifischer Fehlercode fuer Fehlerpfad Dfp_BPACD_Min" VAL_BLK 0xC9B82 Kwb_Wu16 65535.00 OneToOne 0.00 65535.00 FORMAT "%8.2" NUMBER 4 /end CHARACTERISTIC
/begin CHARACTERISTIC DSM_CDCDfp_BPACD_SigNpl_C "CARB spezifischer Fehlercode fuer Fehlerpfad Dfp_BPACD_SigNpl" VAL_BLK 0xC9B8A Kwb_Wu16 65535.00 OneToOne 0.00 65535.00 FORMAT "%8.2" NUMBER 4 /end CHARACTERISTIC
/begin CHARACTERISTIC DSM_CDCDfp_BPSCD_C "CARB spezifischer Fehlercode fuer Fehlerpfad Dfp_BPSCD" VAL_BLK 0xC9B92 Kwb_Wu16 65535.00 OneToOne 0.00 65535.00 FORMAT "%8.2" NUMBER 4 /end CHARACTERISTIC
/begin CHARACTERISTIC DSM_CDCDfp_BattCD_C "CARB spezifischer Fehlercode fuer Fehlerpfad Dfp_BattCD" VAL_BLK 0xC9B9A Kwb_Wu16 65535.00 OneToOne 0.00 65535.00 FORMAT "%8.2" NUMBER 4 /end CHARACTERISTIC
/begin CHARACTERISTIC DSM_CDCDfp_BrkCD_C "CARB spezifischer Fehlercode fuer Fehlerpfad Dfp_BrkCD" VAL_BLK 0xC9BA2 Kwb_Wu16 65535.00 OneToOne 0.00 65535.00 FORMAT "%8.2" NUMBER 4 /end CHARACTERISTIC
/begin CHARACTERISTIC DSM_CDCDfp_Bss_C "CARB spezifischer Fehlercode fuer Fehlerpfad Dfp_Bss" VAL_BLK 0xC9BAA Kwb_Wu16 65535.00 OneToOne 0.00 65535.00 FORMAT "%8.2" NUMBER 4 /end CHARACTERISTIC
/begin CHARACTERISTIC DSM_CDCDfp_CBACD_C "CARB spezifischer Fehlercode fuer Fehlerpfad Dfp_CBACD" VAL_BLK 0xC9BB2 Kwb_Wu16 65535.00 OneToOne 0.00 65535.00 FORMAT "%8.2" NUMBER 4 /end CHARACTERISTIC
/begin CHARACTERISTIC DSM_CDCDfp_CTSCD_C "CARB spezifischer Fehlercode fuer Fehlerpfad Dfp_CTSCD" VAL_BLK 0xC9BBA Kwb_Wu16 65535.00 OneToOne 0.00 65535.00 FORMAT "%8.2" NUMBER 4 /end CHARACTERISTIC
/begin CHARACTERISTIC DSM_CDCDfp_Clg_DynTst_C "CARB spezifischer Fehlercode fuer Fehlerpfad Dfp_Clg_DynTst" VAL_BLK 0xC9BC2 Kwb_Wu16 65535.00 OneToOne 0.00 65535.00 FORMAT "%8.2" NUMBER 4 /end CHARACTERISTIC
/begin CHARACTERISTIC DSM_CDCDfp_CmbChbMisfire1_C "CARB spezifischer Fehlercode fuer Fehlerpfad Dfp_CmbChbMisfire1" VAL_BLK 0xC9BCA Kwb_Wu16 65535.00 OneToOne 0.00 65535.00 FORMAT "%8.2" NUMBER 4 /end CHARACTERISTIC
/begin CHARACTERISTIC DSM_CDCDfp_CmbChbMisfire2_C "CARB spezifischer Fehlercode fuer Fehlerpfad Dfp_CmbChbMisfire2" VAL_BLK 0xC9BD2 Kwb_Wu16 65535.00 OneToOne 0.00 65535.00 FORMAT "%8.2" NUMBER 4 /end CHARACTERISTIC
/begin CHARACTERISTIC DSM_CDCDfp_CmbChbMisfire3_C "CARB spezifischer Fehlercode fuer Fehlerpfad Dfp_CmbChbMisfire3" VAL_BLK 0xC9BDA Kwb_Wu16 65535.00 OneToOne 0.00 65535.00 FORMAT "%8.2" NUMBER 4 /end CHARACTERISTIC
/begin CHARACTERISTIC DSM_CDCDfp_CmbChbMisfire4_C "CARB spezifischer Fehlercode fuer Fehlerpfad Dfp_CmbChbMisfire4" VAL_BLK 0xC9BE2 Kwb_Wu16 65535.00 OneToOne 0.00 65535.00 FORMAT "%8.2" NUMBER 4 /end CHARACTERISTIC
/begin CHARACTERISTIC DSM_CDCDfp_CmbChbMisfire5_C "CARB spezifischer Fehlercode fuer Fehlerpfad Dfp_CmbChbMisfire5" VAL_BLK 0xC9BEA Kwb_Wu16 65535.00 OneToOne 0.00 65535.00 FORMAT "%8.2" NUMBER 4 /end CHARACTERISTIC
/begin CHARACTERISTIC DSM_CDCDfp_CmbChbMisfire6_C "CARB spezifischer Fehlercode fuer Fehlerpfad Dfp_CmbChbMisfire6" VAL_BLK 0xC9BF2 Kwb_Wu16 65535.00 OneToOne 0.00 65535.00 FORMAT "%8.2" NUMBER 4 /end CHARACTERISTIC
/begin CHARACTERISTIC DSM_CDCDfp_CmbChbMisfireMul_C "CARB spezifischer Fehlercode fuer Fehlerpfad Dfp_CmbChbMisfireMul" VAL_BLK 0xC9BFA Kwb_Wu16 65535.00 OneToOne 0.00 65535.00 FORMAT "%8.2" NUMBER 4 /end CHARACTERISTIC
/begin CHARACTERISTIC DSM_CDCDfp_CoVMDCSh_C "CARB spezifischer Fehlercode fuer Fehlerpfad Dfp_CoVMDCSh" VAL_BLK 0xC9C02 Kwb_Wu16 65535.00 OneToOne 0.00 65535.00 FORMAT "%8.2" NUMBER 4 /end CHARACTERISTIC
/begin CHARACTERISTIC DSM_CDCDfp_ConvCD_C "CARB spezifischer Fehlercode fuer Fehlerpfad Dfp_ConvCD" VAL_BLK 0xC9C0A Kwb_Wu16 65535.00 OneToOne 0.00 65535.00 FORMAT "%8.2" NUMBER 4 /end CHARACTERISTIC
/begin CHARACTERISTIC DSM_CDCDfp_Layer_PMRUHVERL_C "CARB spezifischer Fehlercode fuer Fehlerpfad Dfp_Layer_PMRUHVERL" VAL_BLK 0xC9C12 Kwb_Wu16 65535.00 OneToOne 0.00 65535.00 FORMAT "%8.2" NUMBER 4 /end CHARACTERISTIC
/begin CHARACTERISTIC DSM_CDCDfp_CrCCDMFL_C "CARB spezifischer Fehlercode fuer Fehlerpfad Dfp_CrCCDMFL" VAL_BLK 0xC9C1A Kwb_Wu16 65535.00 OneToOne 0.00 65535.00 FORMAT "%8.2" NUMBER 4 /end CHARACTERISTIC
/begin CHARACTERISTIC DSM_CDCDfp_CrCtl_vCrCtl_C "CARB spezifischer Fehlercode fuer Fehlerpfad Dfp_CrCtl_vCrCtl" VAL_BLK 0xC9C22 Kwb_Wu16 65535.00 OneToOne 0.00 65535.00 FORMAT "%8.2" NUMBER 4 /end CHARACTERISTIC
/begin CHARACTERISTIC DSM_CDCDfp_DCC_PlausTrqDes_C "CARB spezifischer Fehlercode fuer Fehlerpfad Dfp_DCC_PlausTrqDes" VAL_BLK 0xC9C2A Kwb_Wu16 65535.00 OneToOne 0.00 65535.00 FORMAT "%8.2" NUMBER 4 /end CHARACTERISTIC
/begin CHARACTERISTIC DSM_CDCDfp_Dummy1_C "CARB spezifischer Fehlercode fuer Fehlerpfad Dfp_Dummy1" VAL_BLK 0xC9C32 Kwb_Wu16 65535.00 OneToOne 0.00 65535.00 FORMAT "%8.2" NUMBER 4 /end CHARACTERISTIC
/begin CHARACTERISTIC DSM_CDCDfp_Layer_TOENS_C "CARB spezifischer Fehlercode fuer Fehlerpfad Dfp_Layer_TOENS" VAL_BLK 0xC9C3A Kwb_Wu16 65535.00 OneToOne 0.00 65535.00 FORMAT "%8.2" NUMBER 4 /end CHARACTERISTIC
/begin CHARACTERISTIC DSM_CDCDfp_Layer_MANHYDR_C "CARB spezifischer Fehlercode fuer Fehlerpfad Dfp_Layer_MANHYDR" VAL_BLK 0xC9C42 Kwb_Wu16 65535.00 OneToOne 0.00 65535.00 FORMAT "%8.2" NUMBER 4 /end CHARACTERISTIC
/begin CHARACTERISTIC DSM_CDCDfp_Layer_MANLUFT_C "CARB spezifischer Fehlercode fuer Fehlerpfad Dfp_Layer_MANLUFT" VAL_BLK 0xC9C4A Kwb_Wu16 65535.00 OneToOne 0.00 65535.00 FORMAT "%8.2" NUMBER 4 /end CHARACTERISTIC
/begin CHARACTERISTIC DSM_CDCDfp_EATSCD_C "CARB spezifischer Fehlercode fuer Fehlerpfad Dfp_EATSCD" VAL_BLK 0xC9C52 Kwb_Wu16 65535.00 OneToOne 0.00 65535.00 FORMAT "%8.2" NUMBER 4 /end CHARACTERISTIC
/begin CHARACTERISTIC DSM_CDCDfp_EBAFCD_C "CARB spezifischer Fehlercode fuer Fehlerpfad Dfp_EBAFCD" VAL_BLK 0xC9C5A Kwb_Wu16 65535.00 OneToOne 0.00 65535.00 FORMAT "%8.2" NUMBER 4 /end CHARACTERISTIC
/begin CHARACTERISTIC DSM_CDCDfp_EBFCD_C "CARB spezifischer Fehlercode fuer Fehlerpfad Dfp_EBFCD" VAL_BLK 0xC9C62 Kwb_Wu16 65535.00 OneToOne 0.00 65535.00 FORMAT "%8.2" NUMBER 4 /end CHARACTERISTIC
/begin CHARACTERISTIC DSM_CDCDfp_EBTSCD_C "CARB spezifischer Fehlercode fuer Fehlerpfad Dfp_EBTSCD" VAL_BLK 0xC9C6A Kwb_Wu16 65535.00 OneToOne 0.00 65535.00 FORMAT "%8.2" NUMBER 4 /end CHARACTERISTIC
/begin CHARACTERISTIC DSM_CDCDfp_EBTSCD_OvrTemp_C "CARB spezifischer Fehlercode fuer Fehlerpfad Dfp_EBTSCD_OvrTemp" VAL_BLK 0xC9C72 Kwb_Wu16 65535.00 OneToOne 0.00 65535.00 FORMAT "%8.2" NUMBER 4 /end CHARACTERISTIC
/begin CHARACTERISTIC DSM_CDCDfp_EEPCDVarMng_C "CARB spezifischer Fehlercode fuer Fehlerpfad Dfp_EEPCDVarMng" VAL_BLK 0xC9C7A Kwb_Wu16 65535.00 OneToOne 0.00 65535.00 FORMAT "%8.2" NUMBER 4 /end CHARACTERISTIC
/begin CHARACTERISTIC DSM_CDCDfp_EGPpCD_C "CARB spezifischer Fehlercode fuer Fehlerpfad Dfp_EGPpCD" VAL_BLK 0xC9C82 Kwb_Wu16 65535.00 OneToOne 0.00 65535.00 FORMAT "%8.2" NUMBER 4 /end CHARACTERISTIC
/begin CHARACTERISTIC DSM_CDCDfp_EGPpCDTPreTrbn_C "CARB spezifischer Fehlercode fuer Fehlerpfad Dfp_EgPpCDTPreTrbn" VAL_BLK 0xC9C8A Kwb_Wu16 65535.00 OneToOne 0.00 65535.00 FORMAT "%8.2" NUMBER 4 /end CHARACTERISTIC
/begin CHARACTERISTIC DSM_CDCDfp_EGRCD_Max_C "CARB spezifischer Fehlercode fuer Fehlerpfad Dfp_EGRCD_Max" VAL_BLK 0xC9C92 Kwb_Wu16 65535.00 OneToOne 0.00 65535.00 FORMAT "%8.2" NUMBER 4 /end CHARACTERISTIC
/begin CHARACTERISTIC DSM_CDCDfp_EGRCD_Min_C "CARB spezifischer Fehlercode fuer Fehlerpfad Dfp_EGRCD_Min" VAL_BLK 0xC9C9A Kwb_Wu16 65535.00 OneToOne 0.00 65535.00 FORMAT "%8.2" NUMBER 4 /end CHARACTERISTIC
/begin CHARACTERISTIC DSM_CDCDfp_EGRCD_SigNpl_C "CARB spezifischer Fehlercode fuer Fehlerpfad Dfp_EGRCD_SigNpl" VAL_BLK 0xC9CA2 Kwb_Wu16 65535.00 OneToOne 0.00 65535.00 FORMAT "%8.2" NUMBER 4 /end CHARACTERISTIC
/begin CHARACTERISTIC DSM_CDCDfp_EGTRgnOilDil_C "CARB spezifischer Fehlercode fuer Fehlerpfad Dfp_EGTRgnOilDil" VAL_BLK 0xC9CAA Kwb_Wu16 65535.00 OneToOne 0.00 65535.00 FORMAT "%8.2" NUMBER 4 /end CHARACTERISTIC
/begin CHARACTERISTIC DSM_CDCDfp_EMCCDNoLoad1_C "CARB spezifischer Fehlercode fuer Fehlerpfad Dfp_EMCCDNoLoad1" VAL_BLK 0xC9CB2 Kwb_Wu16 65535.00 OneToOne 0.00 65535.00 FORMAT "%8.2" NUMBER 4 /end CHARACTERISTIC
/begin CHARACTERISTIC DSM_CDCDfp_EMCCDNoLoad2_C "CARB spezifischer Fehlercode fuer Fehlerpfad Dfp_EMCCDNoLoad2" VAL_BLK 0xC9CBA Kwb_Wu16 65535.00 OneToOne 0.00 65535.00 FORMAT "%8.2" NUMBER 4 /end CHARACTERISTIC
/begin CHARACTERISTIC DSM_CDCDfp_EMCCDSCBat1_C "CARB spezifischer Fehlercode fuer Fehlerpfad Dfp_EMCCDSCBat1" VAL_BLK 0xC9CC2 Kwb_Wu16 65535.00 OneToOne 0.00 65535.00 FORMAT "%8.2" NUMBER 4 /end CHARACTERISTIC
/begin CHARACTERISTIC DSM_CDCDfp_EMCCDSCBat2_C "CARB spezifischer Fehlercode fuer Fehlerpfad Dfp_EMCCDSCBat2" VAL_BLK 0xC9CCA Kwb_Wu16 65535.00 OneToOne 0.00 65535.00 FORMAT "%8.2" NUMBER 4 /end CHARACTERISTIC
/begin CHARACTERISTIC DSM_CDCDfp_EMCCDSCGnd1_C "CARB spezifischer Fehlercode fuer Fehlerpfad Dfp_EMCCDSCGnd1" VAL_BLK 0xC9CD2 Kwb_Wu16 65535.00 OneToOne 0.00 65535.00 FORMAT "%8.2" NUMBER 4 /end CHARACTERISTIC
/begin CHARACTERISTIC DSM_CDCDfp_EMCCDSCGnd2_C "CARB spezifischer Fehlercode fuer Fehlerpfad Dfp_EMCCDSCGnd2" VAL_BLK 0xC9CDA Kwb_Wu16 65535.00 OneToOne 0.00 65535.00 FORMAT "%8.2" NUMBER 4 /end CHARACTERISTIC
/begin CHARACTERISTIC DSM_CDCDfp_EMCCD_ADC1_C "CARB spezifischer Fehlercode fuer Fehlerpfad Dfp_EMCCD_ADC1" VAL_BLK 0xC9CE2 Kwb_Wu16 65535.00 OneToOne 0.00 65535.00 FORMAT "%8.2" NUMBER 4 /end CHARACTERISTIC
/begin CHARACTERISTIC DSM_CDCDfp_EMCCD_ADC2_C "CARB spezifischer Fehlercode fuer Fehlerpfad Dfp_EMCCD_ADC2" VAL_BLK 0xC9CEA Kwb_Wu16 65535.00 OneToOne 0.00 65535.00 FORMAT "%8.2" NUMBER 4 /end CHARACTERISTIC
/begin CHARACTERISTIC DSM_CDCDfp_ETClbETFltInj1_C "CARB spezifischer Fehlercode fuer Fehlerpfad Dfp_ETClbETFltInj1" VAL_BLK 0xC9CF2 Kwb_Wu16 65535.00 OneToOne 0.00 65535.00 FORMAT "%8.2" NUMBER 4 /end CHARACTERISTIC
/begin CHARACTERISTIC DSM_CDCDfp_ETClbETFltInj2_C "CARB spezifischer Fehlercode fuer Fehlerpfad Dfp_ETClbETFltInj2" VAL_BLK 0xC9CFA Kwb_Wu16 65535.00 OneToOne 0.00 65535.00 FORMAT "%8.2" NUMBER 4 /end CHARACTERISTIC
/begin CHARACTERISTIC DSM_CDCDfp_ETClbETFltInj3_C "CARB spezifischer Fehlercode fuer Fehlerpfad Dfp_ETClbETFltInj3" VAL_BLK 0xC9D02 Kwb_Wu16 65535.00 OneToOne 0.00 65535.00 FORMAT "%8.2" NUMBER 4 /end CHARACTERISTIC
/begin CHARACTERISTIC DSM_CDCDfp_ETClbETFltInj4_C "CARB spezifischer Fehlercode fuer Fehlerpfad Dfp_ETClbETFltInj4" VAL_BLK 0xC9D0A Kwb_Wu16 65535.00 OneToOne 0.00 65535.00 FORMAT "%8.2" NUMBER 4 /end CHARACTERISTIC
/begin CHARACTERISTIC DSM_CDCDfp_ETClbETFltInj5_C "CARB spezifischer Fehlercode fuer Fehlerpfad Dfp_ETClbETFltInj5" VAL_BLK 0xC9D12 Kwb_Wu16 65535.00 OneToOne 0.00 65535.00 FORMAT "%8.2" NUMBER 4 /end CHARACTERISTIC
/begin CHARACTERISTIC DSM_CDCDfp_ETClbETFltInj6_C "CARB spezifischer Fehlercode fuer Fehlerpfad Dfp_ETClbETFltInj6" VAL_BLK 0xC9D1A Kwb_Wu16 65535.00 OneToOne 0.00 65535.00 FORMAT "%8.2" NUMBER 4 /end CHARACTERISTIC
/begin CHARACTERISTIC DSM_CDCDfp_ETClbInj1_C "CARB spezifischer Fehlercode fuer Fehlerpfad Dfp_ETClbInj1" VAL_BLK 0xC9D22 Kwb_Wu16 65535.00 OneToOne 0.00 65535.00 FORMAT "%8.2" NUMBER 4 /end CHARACTERISTIC
/begin CHARACTERISTIC DSM_CDCDfp_ETClbInj2_C "CARB spezifischer Fehlercode fuer Fehlerpfad Dfp_ETClbInj2" VAL_BLK 0xC9D2A Kwb_Wu16 65535.00 OneToOne 0.00 65535.00 FORMAT "%8.2" NUMBER 4 /end CHARACTERISTIC
/begin CHARACTERISTIC DSM_CDCDfp_ETClbInj3_C "CARB spezifischer Fehlercode fuer Fehlerpfad Dfp_ETClbInj3" VAL_BLK 0xC9D32 Kwb_Wu16 65535.00 OneToOne 0.00 65535.00 FORMAT "%8.2" NUMBER 4 /end CHARACTERISTIC
/begin CHARACTERISTIC DSM_CDCDfp_ETClbInj4_C "CARB spezifischer Fehlercode fuer Fehlerpfad Dfp_ETClbInj4" VAL_BLK 0xC9D3A Kwb_Wu16 65535.00 OneToOne 0.00 65535.00 FORMAT "%8.2" NUMBER 4 /end CHARACTERISTIC
/begin CHARACTERISTIC DSM_CDCDfp_ETClbInj5_C "CARB spezifischer Fehlercode fuer Fehlerpfad Dfp_ETClbInj5" VAL_BLK 0xC9D42 Kwb_Wu16 65535.00 OneToOne 0.00 65535.00 FORMAT "%8.2" NUMBER 4 /end CHARACTERISTIC
/begin CHARACTERISTIC DSM_CDCDfp_ETClbInj6_C "CARB spezifischer Fehlercode fuer Fehlerpfad Dfp_ETClbInj6" VAL_BLK 0xC9D4A Kwb_Wu16 65535.00 OneToOne 0.00 65535.00 FORMAT "%8.2" NUMBER 4 /end CHARACTERISTIC
/begin CHARACTERISTIC DSM_CDCDfp_EngMCaS1_C "CARB spezifischer Fehlercode fuer Fehlerpfad Dfp_EngMCaS1" VAL_BLK 0xC9D52 Kwb_Wu16 65535.00 OneToOne 0.00 65535.00 FORMAT "%8.2" NUMBER 4 /end CHARACTERISTIC
/begin CHARACTERISTIC DSM_CDCDfp_EngMCrS1_C "CARB spezifischer Fehlercode fuer Fehlerpfad Dfp_EngMCrS1" VAL_BLK 0xC9D5A Kwb_Wu16 65535.00 OneToOne 0.00 65535.00 FORMAT "%8.2" NUMBER 4 /end CHARACTERISTIC
/begin CHARACTERISTIC DSM_CDCDfp_EngMOfsCaSCrS_C "CARB spezifischer Fehlercode fuer Fehlerpfad Dfp_EngMOfsCaSCrS" VAL_BLK 0xC9D62 Kwb_Wu16 65535.00 OneToOne 0.00 65535.00 FORMAT "%8.2" NUMBER 4 /end CHARACTERISTIC
/begin CHARACTERISTIC DSM_CDCDfp_EngPrtFWODet_C "CARB spezifischer Fehlercode fuer Fehlerpfad Dfp_EngPrtFWODet" VAL_BLK 0xC9D6A Kwb_Wu16 65535.00 OneToOne 0.00 65535.00 FORMAT "%8.2" NUMBER 4 /end CHARACTERISTIC
/begin CHARACTERISTIC DSM_CDCDfp_FBCqDvt_C "CARB spezifischer Fehlercode fuer Fehlerpfad Dfp_FBCqDvt" VAL_BLK 0xC9D72 Kwb_Wu16 65535.00 OneToOne 0.00 65535.00 FORMAT "%8.2" NUMBER 4 /end CHARACTERISTIC
/begin CHARACTERISTIC DSM_CDCDfp_FMTC_NonMonotonMap_C "CARB spezifischer Fehlercode fuer Fehlerpfad Dfp_FMTC_NonMonotonMap" VAL_BLK 0xC9D7A Kwb_Wu16 65535.00 OneToOne 0.00 65535.00 FORMAT "%8.2" NUMBER 4 /end CHARACTERISTIC
/begin CHARACTERISTIC DSM_CDCDfp_FTSCD_C "CARB spezifischer Fehlercode fuer Fehlerpfad Dfp_FTSCD" VAL_BLK 0xC9D82 Kwb_Wu16 65535.00 OneToOne 0.00 65535.00 FORMAT "%8.2" NUMBER 4 /end CHARACTERISTIC
/begin CHARACTERISTIC DSM_CDCDfp_FanCD_C "CARB spezifischer Fehlercode fuer Fehlerpfad Dfp_FanCD" VAL_BLK 0xC9D8A Kwb_Wu16 65535.00 OneToOne 0.00 65535.00 FORMAT "%8.2" NUMBER 4 /end CHARACTERISTIC
/begin CHARACTERISTIC DSM_CDCDfp_FanCD_FanCtlr1_C "CARB spezifischer Fehlercode fuer Fehlerpfad Dfp_FanCD_FanCtlr1" VAL_BLK 0xC9D92 Kwb_Wu16 65535.00 OneToOne 0.00 65535.00 FORMAT "%8.2" NUMBER 4 /end CHARACTERISTIC
/begin CHARACTERISTIC DSM_CDCDfp_FanCD_FanCtlr2_C "CARB spezifischer Fehlercode fuer Fehlerpfad Dfp_FanCD_FanCtlr2" VAL_BLK 0xC9D9A Kwb_Wu16 65535.00 OneToOne 0.00 65535.00 FORMAT "%8.2" NUMBER 4 /end CHARACTERISTIC
/begin CHARACTERISTIC DSM_CDCDfp_FanCD_FanCtlr3_C "CARB spezifischer Fehlercode fuer Fehlerpfad Dfp_FanCD_FanCtlr3" VAL_BLK 0xC9DA2 Kwb_Wu16 65535.00 OneToOne 0.00 65535.00 FORMAT "%8.2" NUMBER 4 /end CHARACTERISTIC
/begin CHARACTERISTIC DSM_CDCDfp_FlFCD_C "CARB spezifischer Fehlercode fuer Fehlerpfad Dfp_FlFCD" VAL_BLK 0xC9DAA Kwb_Wu16 65535.00 OneToOne 0.00 65535.00 FORMAT "%8.2" NUMBER 4 /end CHARACTERISTIC
/begin CHARACTERISTIC DSM_CDCDfp_FlMngSmkDefect_C "CARB spezifischer Fehlercode fuer Fehlerpfad Dfp_FlMngSmkDefect" VAL_BLK 0xC9DB2 Kwb_Wu16 65535.00 OneToOne 0.00 65535.00 FORMAT "%8.2" NUMBER 4 /end CHARACTERISTIC
/begin CHARACTERISTIC DSM_CDCDfp_FrmMngANFRADMOMPT_C "CARB spezifischer Fehlercode fuer Fehlerpfad Dfp_FrmMngANFRADMOMPT" VAL_BLK 0xC9DBA Kwb_Wu16 65535.00 OneToOne 0.00 65535.00 FORMAT "%8.2" NUMBER 4 /end CHARACTERISTIC
/begin CHARACTERISTIC DSM_CDCDfp_FrmMngASC1_C "CARB spezifischer Fehlercode fuer Fehlerpfad Dfp_FrmMngASC1" VAL_BLK 0xC9DC2 Kwb_Wu16 65535.00 OneToOne 0.00 65535.00 FORMAT "%8.2" NUMBER 4 /end CHARACTERISTIC
/begin CHARACTERISTIC DSM_CDCDfp_FrmMngASC2_C "CARB spezifischer Fehlercode fuer Fehlerpfad Dfp_FrmMngASC2" VAL_BLK 0xC9DCA Kwb_Wu16 65535.00 OneToOne 0.00 65535.00 FORMAT "%8.2" NUMBER 4 /end CHARACTERISTIC
/begin CHARACTERISTIC DSM_CDCDfp_FrmMngASC3_C "CARB spezifischer Fehlercode fuer Fehlerpfad Dfp_FrmMngASC3" VAL_BLK 0xC9DD2 Kwb_Wu16 65535.00 OneToOne 0.00 65535.00 FORMAT "%8.2" NUMBER 4 /end CHARACTERISTIC
/begin CHARACTERISTIC DSM_CDCDfp_FrmMngASC4_C "CARB spezifischer Fehlercode fuer Fehlerpfad Dfp_FrmMngASC4" VAL_BLK 0xC9DDA Kwb_Wu16 65535.00 OneToOne 0.00 65535.00 FORMAT "%8.2" NUMBER 4 /end CHARACTERISTIC
/begin CHARACTERISTIC DSM_CDCDfp_FrmMngBOS_RESET_C "CARB spezifischer Fehlercode fuer Fehlerpfad Dfp_FrmMngBOS_RESET" VAL_BLK 0xC9DE2 Kwb_Wu16 65535.00 OneToOne 0.00 65535.00 FORMAT "%8.2" NUMBER 4 /end CHARACTERISTIC
/begin CHARACTERISTIC DSM_CDCDfp_FrmMngBOS_RESET_2_C "" VAL_BLK 0xC9DEA Kwb_Wu16 65535.00 OneToOne 0.00 65535.00 FORMAT "%8.2" NUMBER 4 /end CHARACTERISTIC
/begin CHARACTERISTIC DSM_CDCDfp_FrmMngDMANFAFS_C "CARB spezifischer Fehlercode fuer Fehlerpfad Dfp_FrmMngDMANFAFS" VAL_BLK 0xC9DF2 Kwb_Wu16 65535.00 OneToOne 0.00 65535.00 FORMAT "%8.2" NUMBER 4 /end CHARACTERISTIC
/begin CHARACTERISTIC DSM_CDCDfp_FrmMngDRMANFSSG_C "CARB spezifischer Fehlercode fuer Fehlerpfad Dfp_FrmMngDRMANFSSG" VAL_BLK 0xC9DFA Kwb_Wu16 65535.00 OneToOne 0.00 65535.00 FORMAT "%8.2" NUMBER 4 /end CHARACTERISTIC
/begin CHARACTERISTIC DSM_CDCDfp_FrmMngEGS1_C "CARB spezifischer Fehlercode fuer Fehlerpfad Dfp_FrmMngEGS1" VAL_BLK 0xC9E02 Kwb_Wu16 65535.00 OneToOne 0.00 65535.00 FORMAT "%8.2" NUMBER 4 /end CHARACTERISTIC
/begin CHARACTERISTIC DSM_CDCDfp_FrmMngEGS2_C "CARB spezifischer Fehlercode fuer Fehlerpfad Dfp_FrmMngEGS2" VAL_BLK 0xC9E0A Kwb_Wu16 65535.00 OneToOne 0.00 65535.00 FORMAT "%8.2" NUMBER 4 /end CHARACTERISTIC
/begin CHARACTERISTIC DSM_CDCDfp_FrmMngGEARBX_DATA_C "P-Code (CARB) for faults in path" VAL_BLK 0xC9E12 Kwb_Wu16 65535.00 OneToOne 0.00 65535.00 FORMAT "%8.2" NUMBER 4 /end CHARACTERISTIC
/begin CHARACTERISTIC DSM_CDCDfp_FrmMngGEARBX_DATA2_C "CARB spezifischer Fehlercode fuer Fehlerpfad Dfp_FrmMngGEARBX_DATA2" VAL_BLK 0xC9E1A Kwb_Wu16 65535.00 OneToOne 0.00 65535.00 FORMAT "%8.2" NUMBER 4 /end CHARACTERISTIC
/begin CHARACTERISTIC DSM_CDCDfp_FrmMngHEAT_AC_C "P-Code (CARB) for faults in path" VAL_BLK 0xC9E22 Kwb_Wu16 65535.00 OneToOne 0.00 65535.00 FORMAT "%8.2" NUMBER 4 /end CHARACTERISTIC
/begin CHARACTERISTIC DSM_CDCDfp_FrmMngINSTR2_C "CARB spezifischer Fehlercode fuer Fehlerpfad Dfp_FrmMngINSTR2" VAL_BLK 0xC9E2A Kwb_Wu16 65535.00 OneToOne 0.00 65535.00 FORMAT "%8.2" NUMBER 4 /end CHARACTERISTIC
/begin CHARACTERISTIC DSM_CDCDfp_FrmMngINSTR3_C "CARB spezifischer Fehlercode fuer Fehlerpfad Dfp_FrmMngINSTR3" VAL_BLK 0xC9E32 Kwb_Wu16 65535.00 OneToOne 0.00 65535.00 FORMAT "%8.2" NUMBER 4 /end CHARACTERISTIC
/begin CHARACTERISTIC DSM_CDCDfp_FrmMngLENKRADWINKEL_C "CARB spezifischer Fehlercode fuer Fehlerpfad Dfp_FrmMngLENKRADWINKEL" VAL_BLK 0xC9E3A Kwb_Wu16 65535.00 OneToOne 0.00 65535.00 FORMAT "%8.2" NUMBER 4 /end CHARACTERISTIC
/begin CHARACTERISTIC DSM_CDCDfp_FrmMngMILEAGE_RANGE_C "CARB spezifischer Fehlercode fuer Fehlerpfad Dfp_FrmMngMILEAGE_RANGE" VAL_BLK 0xC9E42 Kwb_Wu16 65535.00 OneToOne 0.00 65535.00 FORMAT "%8.2" NUMBER 4 /end CHARACTERISTIC
/begin CHARACTERISTIC DSM_CDCDfp_FrmMngOPCRCTLACC_C "CARB spezifischer Fehlercode fuer Fehlerpfad Dfp_FrmMngOPCRCTLACC" VAL_BLK 0xC9E4A Kwb_Wu16 65535.00 OneToOne 0.00 65535.00 FORMAT "%8.2" NUMBER 4 /end CHARACTERISTIC
/begin CHARACTERISTIC DSM_CDCDfp_FrmMngPRGG_CCTR_C "CARB spezifischer Fehlercode fuer Fehlerpfad Dfp_FrmMngPRGG_CCTR" VAL_BLK 0xC9E52 Kwb_Wu16 65535.00 OneToOne 0.00 65535.00 FORMAT "%8.2" NUMBER 4 /end CHARACTERISTIC
/begin CHARACTERISTIC DSM_CDCDfp_FrmMngPWRMNG_LOADV_C "CARB spezifischer Fehlercode fuer Fehlerpfad Dfp_FrmMngPWRMNG_LOADV" VAL_BLK 0xC9E5A Kwb_Wu16 65535.00 OneToOne 0.00 65535.00 FORMAT "%8.2" NUMBER 4 /end CHARACTERISTIC
/begin CHARACTERISTIC DSM_CDCDfp_FrmMngParkConsumer_C "CARB spezifischer Fehlercode fuer Fehlerpfad Dfp_FrmMngParkConsumer" VAL_BLK 0xC9E62 Kwb_Wu16 65535.00 OneToOne 0.00 65535.00 FORMAT "%8.2" NUMBER 4 /end CHARACTERISTIC
/begin CHARACTERISTIC DSM_CDCDfp_FrmMngRQSTGEFAN_C "RQ_STG_EFAN - CAN-message related errors" VAL_BLK 0xC9E6A Kwb_Wu16 65535.00 OneToOne 0.00 65535.00 FORMAT "%8.2" NUMBER 4 /end CHARACTERISTIC
/begin CHARACTERISTIC DSM_CDCDfp_FrmMngSSGErr_C "CARB spezifischer Fehlercode fuer Fehlerpfad Dfp_FrmMngSSGErr" VAL_BLK 0xC9E72 Kwb_Wu16 65535.00 OneToOne 0.00 65535.00 FORMAT "%8.2" NUMBER 4 /end CHARACTERISTIC
/begin CHARACTERISTIC DSM_CDCDfp_FrmMngSSGShOff_C "CARB spezifischer Fehlercode fuer Fehlerpfad Dfp_FrmMngSSGShOff" VAL_BLK 0xC9E7A Kwb_Wu16 65535.00 OneToOne 0.00 65535.00 FORMAT "%8.2" NUMBER 4 /end CHARACTERISTIC
/begin CHARACTERISTIC DSM_CDCDfp_FrmMngSTAT_ANH_C "CARB spezifischer Fehlercode fuer Fehlerpfad Dfp_FrmMngSTAT_ANH" VAL_BLK 0xC9E82 Kwb_Wu16 65535.00 OneToOne 0.00 65535.00 FORMAT "%8.2" NUMBER 4 /end CHARACTERISTIC
/begin CHARACTERISTIC DSM_CDCDfp_FrmMngSTAT_ARS_C "P-Code (CARB) for faults in path" VAL_BLK 0xC9E8A Kwb_Wu16 65535.00 OneToOne 0.00 65535.00 FORMAT "%8.2" NUMBER 4 /end CHARACTERISTIC
/begin CHARACTERISTIC DSM_CDCDfp_FrmMngSTAT_DSC_C "P-Code (CARB) for faults in path" VAL_BLK 0xC9E92 Kwb_Wu16 65535.00 OneToOne 0.00 65535.00 FORMAT "%8.2" NUMBER 4 /end CHARACTERISTIC
/begin CHARACTERISTIC DSM_CDCDfp_FrmMngSTAT_EKP_C "CARB spezifischer Fehlercode fuer Fehlerpfad Dfp_FrmMngSTAT_EKP" VAL_BLK 0xC9E9A Kwb_Wu16 65535.00 OneToOne 0.00 65535.00 FORMAT "%8.2" NUMBER 4 /end CHARACTERISTIC
/begin CHARACTERISTIC DSM_CDCDfp_FrmMngSTAT_KOMBI_C "CARB spezifischer Fehlercode fuer Fehlerpfad Dfp_FrmMngSTAT_KOMBI" VAL_BLK 0xC9EA2 Kwb_Wu16 65535.00 OneToOne 0.00 65535.00 FORMAT "%8.2" NUMBER 4 /end CHARACTERISTIC
/begin CHARACTERISTIC DSM_CDCDfp_FrmMngSTAT_SITZ_C "CARB spezifischer Fehlercode fuer Fehlerpfad Dfp_FrmMngSTAT_SITZ" VAL_BLK 0xC9EAA Kwb_Wu16 65535.00 OneToOne 0.00 65535.00 FORMAT "%8.2" NUMBER 4 /end CHARACTERISTIC
/begin CHARACTERISTIC DSM_CDCDfp_FrmMngStOBDGbxMilOf_C "CARB spezifischer Fehlercode fuer Fehlerpfad Dfp_FrmMngStOBDGbxMilOf" VAL_BLK 0xC9EB2 Kwb_Wu16 65535.00 OneToOne 0.00 65535.00 FORMAT "%8.2" NUMBER 4 /end CHARACTERISTIC
/begin CHARACTERISTIC DSM_CDCDfp_FrmMngStOBDGbxMilOn_C "CARB spezifischer Fehlercode fuer Fehlerpfad Dfp_FrmMngStOBDGbxMilOn" VAL_BLK 0xC9EBA Kwb_Wu16 65535.00 OneToOne 0.00 65535.00 FORMAT "%8.2" NUMBER 4 /end CHARACTERISTIC
/begin CHARACTERISTIC DSM_CDCDfp_FrmMngTEMPRELTIME_C "CARB spezifischer Fehlercode fuer Fehlerpfad Dfp_FrmMngTEMPRELTIME" VAL_BLK 0xC9EC2 Kwb_Wu16 65535.00 OneToOne 0.00 65535.00 FORMAT "%8.2" NUMBER 4 /end CHARACTERISTIC
/begin CHARACTERISTIC DSM_CDCDfp_FrmMngTERMINAL_C "P-Code (CARB) for faults in path" VAL_BLK 0xC9ECA Kwb_Wu16 65535.00 OneToOne 0.00 65535.00 FORMAT "%8.2" NUMBER 4 /end CHARACTERISTIC
/begin CHARACTERISTIC DSM_CDCDfp_FrmMngTIME_DATE_C "CARB spezifischer Fehlercode fuer Fehlerpfad Dfp_FrmMngTIME_DATE" VAL_BLK 0xC9ED2 Kwb_Wu16 65535.00 OneToOne 0.00 65535.00 FORMAT "%8.2" NUMBER 4 /end CHARACTERISTIC
/begin CHARACTERISTIC DSM_CDCDfp_FrmMngTORQUE_DSC_C "P-Code (CARB) for faults in path" VAL_BLK 0xC9EDA Kwb_Wu16 65535.00 OneToOne 0.00 65535.00 FORMAT "%8.2" NUMBER 4 /end CHARACTERISTIC
/begin CHARACTERISTIC DSM_CDCDfp_FrmMngTORQUE_GEARBX_C "P-Code (CARB) for faults in path" VAL_BLK 0xC9EE2 Kwb_Wu16 65535.00 OneToOne 0.00 65535.00 FORMAT "%8.2" NUMBER 4 /end CHARACTERISTIC
/begin CHARACTERISTIC DSM_CDCDfp_FrmMngTrq_ReqACC_C "CARB spezifischer Fehlercode fuer Fehlerpfad Dfp_FrmMngTrq_ReqACC" VAL_BLK 0xC9EEA Kwb_Wu16 65535.00 OneToOne 0.00 65535.00 FORMAT "%8.2" NUMBER 4 /end CHARACTERISTIC
/begin CHARACTERISTIC DSM_CDCDfp_FrmMngVEH_MOD_C "VEH_MOD - CAN-message related errors" VAL_BLK 0xC9EF2 Kwb_Wu16 65535.00 OneToOne 0.00 65535.00 FORMAT "%8.2" NUMBER 4 /end CHARACTERISTIC
/begin CHARACTERISTIC DSM_CDCDfp_FrmMngVELOCITY_C "P-Code (CARB) for faults in path" VAL_BLK 0xC9EFA Kwb_Wu16 65535.00 OneToOne 0.00 65535.00 FORMAT "%8.2" NUMBER 4 /end CHARACTERISTIC
/begin CHARACTERISTIC DSM_CDCDfp_FrmMngWHEEL_SPEED_C "CARB spezifischer Fehlercode fuer Fehlerpfad Dfp_FrmMngWHEEL_SPEED" VAL_BLK 0xC9F02 Kwb_Wu16 65535.00 OneToOne 0.00 65535.00 FORMAT "%8.2" NUMBER 4 /end CHARACTERISTIC
/begin CHARACTERISTIC DSM_CDCDfp_FrmMngstCurr_C "Fehlercode Feld für Dfp_FrmMngstCurr" VAL_BLK 0xC9F0A Kwb_Wu16 65535.00 OneToOne 0.00 65535.00 FORMAT "%8.2" NUMBER 4 /end CHARACTERISTIC
/begin CHARACTERISTIC DSM_CDCDfp_FrmMngswtPSPOff_C "Fehlercode Feld für Dfp_FrmMngswtPSP" VAL_BLK 0xC9F12 Kwb_Wu16 65535.00 OneToOne 0.00 65535.00 FORMAT "%8.2" NUMBER 4 /end CHARACTERISTIC
/begin CHARACTERISTIC DSM_CDCDfp_GearbxIncMax_C "CARB spezifischer Fehlercode fuer Fehlerpfad Dfp_GearbxIncMax" VAL_BLK 0xC9F1A Kwb_Wu16 65535.00 OneToOne 0.00 65535.00 FORMAT "%8.2" NUMBER 4 /end CHARACTERISTIC
/begin CHARACTERISTIC DSM_CDCDfp_GlwCD_C "CARB spezifischer Fehlercode fuer Fehlerpfad Dfp_GlwCD" VAL_BLK 0xC9F22 Kwb_Wu16 65535.00 OneToOne 0.00 65535.00 FORMAT "%8.2" NUMBER 4 /end CHARACTERISTIC
/begin CHARACTERISTIC DSM_CDCDfp_GlwCDGlwCirc1_C "CARB spezifischer Fehlercode fuer Fehlerpfad Dfp_GlwCDGlwCirc1" VAL_BLK 0xC9F2A Kwb_Wu16 65535.00 OneToOne 0.00 65535.00 FORMAT "%8.2" NUMBER 4 /end CHARACTERISTIC
/begin CHARACTERISTIC DSM_CDCDfp_GlwCDGlwCirc2_C "CARB spezifischer Fehlercode fuer Fehlerpfad Dfp_GlwCDGlwCirc2" VAL_BLK 0xC9F32 Kwb_Wu16 65535.00 OneToOne 0.00 65535.00 FORMAT "%8.2" NUMBER 4 /end CHARACTERISTIC
/begin CHARACTERISTIC DSM_CDCDfp_GlwCDGlwCirc3_C "CARB spezifischer Fehlercode fuer Fehlerpfad Dfp_GlwCDGlwCirc3" VAL_BLK 0xC9F3A Kwb_Wu16 65535.00 OneToOne 0.00 65535.00 FORMAT "%8.2" NUMBER 4 /end CHARACTERISTIC
/begin CHARACTERISTIC DSM_CDCDfp_GlwCDGlwCirc4_C "CARB spezifischer Fehlercode fuer Fehlerpfad Dfp_GlwCDGlwCirc4" VAL_BLK 0xC9F42 Kwb_Wu16 65535.00 OneToOne 0.00 65535.00 FORMAT "%8.2" NUMBER 4 /end CHARACTERISTIC
/begin CHARACTERISTIC DSM_CDCDfp_GlwCDGlwCirc5_C "CARB spezifischer Fehlercode fuer Fehlerpfad Dfp_GlwCDGlwCirc5" VAL_BLK 0xC9F4A Kwb_Wu16 65535.00 OneToOne 0.00 65535.00 FORMAT "%8.2" NUMBER 4 /end CHARACTERISTIC
/begin CHARACTERISTIC DSM_CDCDfp_GlwCDGlwCirc6_C "CARB spezifischer Fehlercode fuer Fehlerpfad Dfp_GlwCDGlwCirc6" VAL_BLK 0xC9F52 Kwb_Wu16 65535.00 OneToOne 0.00 65535.00 FORMAT "%8.2" NUMBER 4 /end CHARACTERISTIC
/begin CHARACTERISTIC DSM_CDCDfp_GlwCDGlwCirc7_C "CARB spezifischer Fehlercode fuer Fehlerpfad Dfp_GlwCDGlwCirc7" VAL_BLK 0xC9F5A Kwb_Wu16 65535.00 OneToOne 0.00 65535.00 FORMAT "%8.2" NUMBER 4 /end CHARACTERISTIC
/begin CHARACTERISTIC DSM_CDCDfp_GlwCDGlwCirc8_C "CARB spezifischer Fehlercode fuer Fehlerpfad Dfp_GlwCDGlwCirc8" VAL_BLK 0xC9F62 Kwb_Wu16 65535.00 OneToOne 0.00 65535.00 FORMAT "%8.2" NUMBER 4 /end CHARACTERISTIC
/begin CHARACTERISTIC DSM_CDCDfp_GlwCtl_C "CARB spezifischer Fehlercode fuer Fehlerpfad Dfp_GlwCtl" VAL_BLK 0xC9F6A Kwb_Wu16 65535.00 OneToOne 0.00 65535.00 FORMAT "%8.2" NUMBER 4 /end CHARACTERISTIC
/begin CHARACTERISTIC DSM_CDCDfp_HWEMonCom_C "CARB spezifischer Fehlercode fuer Fehlerpfad Dfp_HWEMonCom" VAL_BLK 0xC9F72 Kwb_Wu16 65535.00 OneToOne 0.00 65535.00 FORMAT "%8.2" NUMBER 4 /end CHARACTERISTIC
/begin CHARACTERISTIC DSM_CDCDfp_HWEMonEEPROM_C "CARB spezifischer Fehlercode fuer Fehlerpfad Dfp_HWEMonEEPROM" VAL_BLK 0xC9F7A Kwb_Wu16 65535.00 OneToOne 0.00 65535.00 FORMAT "%8.2" NUMBER 4 /end CHARACTERISTIC
/begin CHARACTERISTIC DSM_CDCDfp_HWEMonRcyLocked_C "CARB spezifischer Fehlercode fuer Fehlerpfad Dfp_HWEMonRcyLocked" VAL_BLK 0xC9F82 Kwb_Wu16 65535.00 OneToOne 0.00 65535.00 FORMAT "%8.2" NUMBER 4 /end CHARACTERISTIC
/begin CHARACTERISTIC DSM_CDCDfp_HWEMonRcySuppressed_C "CARB spezifischer Fehlercode fuer Fehlerpfad Dfp_HWEMonRcySuppressed" VAL_BLK 0xC9F8A Kwb_Wu16 65535.00 OneToOne 0.00 65535.00 FORMAT "%8.2" NUMBER 4 /end CHARACTERISTIC
/begin CHARACTERISTIC DSM_CDCDfp_HWEMonRcyVisible_C "CARB spezifischer Fehlercode fuer Fehlerpfad Dfp_HWEMonRcyVisible" VAL_BLK 0xC9F92 Kwb_Wu16 65535.00 OneToOne 0.00 65535.00 FORMAT "%8.2" NUMBER 4 /end CHARACTERISTIC
/begin CHARACTERISTIC DSM_CDCDfp_HWEMonUMaxSupply_C "CARB spezifischer Fehlercode fuer Fehlerpfad Dfp_HWEMonUMaxSupply" VAL_BLK 0xC9F9A Kwb_Wu16 65535.00 OneToOne 0.00 65535.00 FORMAT "%8.2" NUMBER 4 /end CHARACTERISTIC
/begin CHARACTERISTIC DSM_CDCDfp_HWEMonUMinSupply_C "CARB spezifischer Fehlercode fuer Fehlerpfad Dfp_HWEMonUMinSupply" VAL_BLK 0xC9FA2 Kwb_Wu16 65535.00 OneToOne 0.00 65535.00 FORMAT "%8.2" NUMBER 4 /end CHARACTERISTIC
/begin CHARACTERISTIC DSM_CDCDfp_IATSCD_C "CARB spezifischer Fehlercode fuer Fehlerpfad Dfp_IATSCD" VAL_BLK 0xC9FAA Kwb_Wu16 65535.00 OneToOne 0.00 65535.00 FORMAT "%8.2" NUMBER 4 /end CHARACTERISTIC
/begin CHARACTERISTIC DSM_CDCDfp_IATSCD_CATS_C "CARB spezifischer Fehlercode fuer Fehlerpfad Dfp_IATSCD_CATS" VAL_BLK 0xC9FB2 Kwb_Wu16 65535.00 OneToOne 0.00 65535.00 FORMAT "%8.2" NUMBER 4 /end CHARACTERISTIC
/begin CHARACTERISTIC DSM_CDCDfp_ImmCtlImmCD_C "CARB spezifischer Fehlercode fuer Fehlerpfad Dfp_ImmCtlImmCD" VAL_BLK 0xC9FBA Kwb_Wu16 65535.00 OneToOne 0.00 65535.00 FORMAT "%8.2" NUMBER 4 /end CHARACTERISTIC
/begin CHARACTERISTIC DSM_CDCDfp_ImmCtlImmEep_C "CARB spezifischer Fehlercode fuer Fehlerpfad Dfp_ImmCtlImmEep" VAL_BLK 0xC9FC2 Kwb_Wu16 65535.00 OneToOne 0.00 65535.00 FORMAT "%8.2" NUMBER 4 /end CHARACTERISTIC
/begin CHARACTERISTIC DSM_CDCDfp_ImmCtlMpl_C "CARB spezifischer Fehlercode fuer Fehlerpfad Dfp_ImmCtlMpl" VAL_BLK 0xC9FCA Kwb_Wu16 65535.00 OneToOne 0.00 65535.00 FORMAT "%8.2" NUMBER 4 /end CHARACTERISTIC
/begin CHARACTERISTIC DSM_CDCDfp_IndSys1_C "CARB spezifischer Fehlercode fuer Fehlerpfad Dfp_IndSys1" VAL_BLK 0xC9FD2 Kwb_Wu16 65535.00 OneToOne 0.00 65535.00 FORMAT "%8.2" NUMBER 4 /end CHARACTERISTIC
/begin CHARACTERISTIC DSM_CDCDfp_IndSys2_C "CARB spezifischer Fehlercode fuer Fehlerpfad Dfp_IndSys2" VAL_BLK 0xC9FDA Kwb_Wu16 65535.00 OneToOne 0.00 65535.00 FORMAT "%8.2" NUMBER 4 /end CHARACTERISTIC
/begin CHARACTERISTIC DSM_CDCDfp_InjCrv_InjLim_C "CARB spezifischer Fehlercode fuer Fehlerpfad Dfp_InjCrv_InjLim" VAL_BLK 0xC9FE2 Kwb_Wu16 65535.00 OneToOne 0.00 65535.00 FORMAT "%8.2" NUMBER 4 /end CHARACTERISTIC
/begin CHARACTERISTIC DSM_CDCDfp_InjCtlAdjQnt_C "CARB spezifischer Fehlercode fuer Fehlerpfad Dfp_InjCtlAdjQnt" VAL_BLK 0xC9FEA Kwb_Wu16 65535.00 OneToOne 0.00 65535.00 FORMAT "%8.2" NUMBER 4 /end CHARACTERISTIC
/begin CHARACTERISTIC DSM_CDCDfp_InjCtlDrift_C "CARB spezifischer Fehlercode fuer Fehlerpfad Dfp_InjCtlDrift" VAL_BLK 0xC9FF2 Kwb_Wu16 65535.00 OneToOne 0.00 65535.00 FORMAT "%8.2" NUMBER 4 /end CHARACTERISTIC
/begin CHARACTERISTIC DSM_CDCDfp_InjVCDActrChrg_C "CARB spezifischer Fehlercode fuer Fehlerpfad Dfp_InjVCDActrChrg" VAL_BLK 0xC9FFA Kwb_Wu16 65535.00 OneToOne 0.00 65535.00 FORMAT "%8.2" NUMBER 4 /end CHARACTERISTIC
/begin CHARACTERISTIC DSM_CDCDfp_InjVCDActrEnrg1_C "CARB spezifischer Fehlercode fuer Fehlerpfad Dfp_InjVCDActrEnrg1" VAL_BLK 0xCA002 Kwb_Wu16 65535.00 OneToOne 0.00 65535.00 FORMAT "%8.2" NUMBER 4 /end CHARACTERISTIC
/begin CHARACTERISTIC DSM_CDCDfp_InjVCDActrEnrg2_C "CARB spezifischer Fehlercode fuer Fehlerpfad Dfp_InjVCDActrEnrg2" VAL_BLK 0xCA00A Kwb_Wu16 65535.00 OneToOne 0.00 65535.00 FORMAT "%8.2" NUMBER 4 /end CHARACTERISTIC
/begin CHARACTERISTIC DSM_CDCDfp_InjVCDActrEnrg3_C "CARB spezifischer Fehlercode fuer Fehlerpfad Dfp_InjVCDActrEnrg3" VAL_BLK 0xCA012 Kwb_Wu16 65535.00 OneToOne 0.00 65535.00 FORMAT "%8.2" NUMBER 4 /end CHARACTERISTIC
/begin CHARACTERISTIC DSM_CDCDfp_InjVCDActrEnrg4_C "CARB spezifischer Fehlercode fuer Fehlerpfad Dfp_InjVCDActrEnrg4" VAL_BLK 0xCA01A Kwb_Wu16 65535.00 OneToOne 0.00 65535.00 FORMAT "%8.2" NUMBER 4 /end CHARACTERISTIC
/begin CHARACTERISTIC DSM_CDCDfp_InjVCDActrEnrg5_C "CARB spezifischer Fehlercode fuer Fehlerpfad Dfp_InjVCDActrEnrg5" VAL_BLK 0xCA022 Kwb_Wu16 65535.00 OneToOne 0.00 65535.00 FORMAT "%8.2" NUMBER 4 /end CHARACTERISTIC
/begin CHARACTERISTIC DSM_CDCDfp_InjVCDActrEnrg6_C "CARB spezifischer Fehlercode fuer Fehlerpfad Dfp_InjVCDActrEnrg6" VAL_BLK 0xCA02A Kwb_Wu16 65535.00 OneToOne 0.00 65535.00 FORMAT "%8.2" NUMBER 4 /end CHARACTERISTIC
/begin CHARACTERISTIC DSM_CDCDfp_InjVCDActrEnrg7_C "CARB spezifischer Fehlercode fuer Fehlerpfad Dfp_InjVCDActrEnrg7" VAL_BLK 0xCA032 Kwb_Wu16 65535.00 OneToOne 0.00 65535.00 FORMAT "%8.2" NUMBER 4 /end CHARACTERISTIC
/begin CHARACTERISTIC DSM_CDCDfp_InjVCDActrEnrg8_C "CARB spezifischer Fehlercode fuer Fehlerpfad Dfp_InjVCDActrEnrg8" VAL_BLK 0xCA03A Kwb_Wu16 65535.00 OneToOne 0.00 65535.00 FORMAT "%8.2" NUMBER 4 /end CHARACTERISTIC
/begin CHARACTERISTIC DSM_CDCDfp_InjVCDActrVolt_C "CARB spezifischer Fehlercode fuer Fehlerpfad Dfp_InjVCDActrVolt" VAL_BLK 0xCA042 Kwb_Wu16 65535.00 OneToOne 0.00 65535.00 FORMAT "%8.2" NUMBER 4 /end CHARACTERISTIC
/begin CHARACTERISTIC DSM_CDCDfp_InjVCDClsBank1_C "CARB spezifischer Fehlercode fuer Fehlerpfad Dfp_InjVCDClsBank1" VAL_BLK 0xCA04A Kwb_Wu16 65535.00 OneToOne 0.00 65535.00 FORMAT "%8.2" NUMBER 4 /end CHARACTERISTIC
/begin CHARACTERISTIC DSM_CDCDfp_InjVCDClsBank2_C "CARB spezifischer Fehlercode fuer Fehlerpfad Dfp_InjVCDClsBank2" VAL_BLK 0xCA052 Kwb_Wu16 65535.00 OneToOne 0.00 65535.00 FORMAT "%8.2" NUMBER 4 /end CHARACTERISTIC
/begin CHARACTERISTIC DSM_CDCDfp_InjVCDMonCab_C "CARB spezifischer Fehlercode fuer Fehlerpfad Dfp_InjVCDMonCab" VAL_BLK 0xCA05A Kwb_Wu16 65535.00 OneToOne 0.00 65535.00 FORMAT "%8.2" NUMBER 4 /end CHARACTERISTIC
/begin CHARACTERISTIC DSM_CDCDfp_InjVCDMonSwt_C "CARB spezifischer Fehlercode fuer Fehlerpfad Dfp_InjVCDMonSwt" VAL_BLK 0xCA062 Kwb_Wu16 65535.00 OneToOne 0.00 65535.00 FORMAT "%8.2" NUMBER 4 /end CHARACTERISTIC
/begin CHARACTERISTIC DSM_CDCDfp_InjVCDShOffDCDC_C "CARB spezifischer Fehlercode fuer Fehlerpfad Dfp_InjVCDShOffDCDC" VAL_BLK 0xCA06A Kwb_Wu16 65535.00 OneToOne 0.00 65535.00 FORMAT "%8.2" NUMBER 4 /end CHARACTERISTIC
/begin CHARACTERISTIC DSM_CDCDfp_InjVCDUBuf_C "CARB spezifischer Fehlercode fuer Fehlerpfad Dfp_InjVCDUBuf" VAL_BLK 0xCA072 Kwb_Wu16 65535.00 OneToOne 0.00 65535.00 FORMAT "%8.2" NUMBER 4 /end CHARACTERISTIC
/begin CHARACTERISTIC DSM_CDCDfp_InjVCD_CY370Ampl_C "CARB spezifischer Fehlercode fuer Fehlerpfad Dfp_InjVCD_CY370Ampl" VAL_BLK 0xCA07A Kwb_Wu16 65535.00 OneToOne 0.00 65535.00 FORMAT "%8.2" NUMBER 4 /end CHARACTERISTIC
/begin CHARACTERISTIC DSM_CDCDfp_InjVlvBnk1A_C "CARB spezifischer Fehlercode fuer Fehlerpfad Dfp_InjVlvBnk1A" VAL_BLK 0xCA082 Kwb_Wu16 65535.00 OneToOne 0.00 65535.00 FORMAT "%8.2" NUMBER 4 /end CHARACTERISTIC
/begin CHARACTERISTIC DSM_CDCDfp_InjVlvBnk1B_C "CARB spezifischer Fehlercode fuer Fehlerpfad Dfp_InjVlvBnk1B" VAL_BLK 0xCA08A Kwb_Wu16 65535.00 OneToOne 0.00 65535.00 FORMAT "%8.2" NUMBER 4 /end CHARACTERISTIC
/begin CHARACTERISTIC DSM_CDCDfp_InjVlvBnk2A_C "CARB spezifischer Fehlercode fuer Fehlerpfad Dfp_InjVlvBnk2A" VAL_BLK 0xCA092 Kwb_Wu16 65535.00 OneToOne 0.00 65535.00 FORMAT "%8.2" NUMBER 4 /end CHARACTERISTIC
/begin CHARACTERISTIC DSM_CDCDfp_InjVlvBnk2B_C "CARB spezifischer Fehlercode fuer Fehlerpfad Dfp_InjVlvBnk2B" VAL_BLK 0xCA09A Kwb_Wu16 65535.00 OneToOne 0.00 65535.00 FORMAT "%8.2" NUMBER 4 /end CHARACTERISTIC
/begin CHARACTERISTIC DSM_CDCDfp_InjVlvChipA_C "CARB spezifischer Fehlercode fuer Fehlerpfad Dfp_InjVlvChipA" VAL_BLK 0xCA0A2 Kwb_Wu16 65535.00 OneToOne 0.00 65535.00 FORMAT "%8.2" NUMBER 4 /end CHARACTERISTIC
/begin CHARACTERISTIC DSM_CDCDfp_InjVlvChipB_C "CARB spezifischer Fehlercode fuer Fehlerpfad Dfp_InjVlvChipB" VAL_BLK 0xCA0AA Kwb_Wu16 65535.00 OneToOne 0.00 65535.00 FORMAT "%8.2" NUMBER 4 /end CHARACTERISTIC
/begin CHARACTERISTIC DSM_CDCDfp_InjVlvCyl1A_C "CARB spezifischer Fehlercode fuer Fehlerpfad Dfp_InjVlvCyl1A" VAL_BLK 0xCA0B2 Kwb_Wu16 65535.00 OneToOne 0.00 65535.00 FORMAT "%8.2" NUMBER 4 /end CHARACTERISTIC
/begin CHARACTERISTIC DSM_CDCDfp_InjVlvCyl1B_C "CARB spezifischer Fehlercode fuer Fehlerpfad Dfp_InjVlvCyl1B" VAL_BLK 0xCA0BA Kwb_Wu16 65535.00 OneToOne 0.00 65535.00 FORMAT "%8.2" NUMBER 4 /end CHARACTERISTIC
/begin CHARACTERISTIC DSM_CDCDfp_InjVlvCyl1C_C "CARB spezifischer Fehlercode fuer Fehlerpfad Dfp_InjVlvCyl1C" VAL_BLK 0xCA0C2 Kwb_Wu16 65535.00 OneToOne 0.00 65535.00 FORMAT "%8.2" NUMBER 4 /end CHARACTERISTIC
/begin CHARACTERISTIC DSM_CDCDfp_InjVlvCyl2A_C "CARB spezifischer Fehlercode fuer Fehlerpfad Dfp_InjVlvCyl2A" VAL_BLK 0xCA0CA Kwb_Wu16 65535.00 OneToOne 0.00 65535.00 FORMAT "%8.2" NUMBER 4 /end CHARACTERISTIC
/begin CHARACTERISTIC DSM_CDCDfp_InjVlvCyl2B_C "CARB spezifischer Fehlercode fuer Fehlerpfad Dfp_InjVlvCyl2B" VAL_BLK 0xCA0D2 Kwb_Wu16 65535.00 OneToOne 0.00 65535.00 FORMAT "%8.2" NUMBER 4 /end CHARACTERISTIC
/begin CHARACTERISTIC DSM_CDCDfp_InjVlvCyl2C_C "CARB spezifischer Fehlercode fuer Fehlerpfad Dfp_InjVlvCyl2C" VAL_BLK 0xCA0DA Kwb_Wu16 65535.00 OneToOne 0.00 65535.00 FORMAT "%8.2" NUMBER 4 /end CHARACTERISTIC
/begin CHARACTERISTIC DSM_CDCDfp_InjVlvCyl3A_C "CARB spezifischer Fehlercode fuer Fehlerpfad Dfp_InjVlvCyl3A" VAL_BLK 0xCA0E2 Kwb_Wu16 65535.00 OneToOne 0.00 65535.00 FORMAT "%8.2" NUMBER 4 /end CHARACTERISTIC
/begin CHARACTERISTIC DSM_CDCDfp_InjVlvCyl3B_C "CARB spezifischer Fehlercode fuer Fehlerpfad Dfp_InjVlvCyl3B" VAL_BLK 0xCA0EA Kwb_Wu16 65535.00 OneToOne 0.00 65535.00 FORMAT "%8.2" NUMBER 4 /end CHARACTERISTIC
/begin CHARACTERISTIC DSM_CDCDfp_InjVlvCyl3C_C "CARB spezifischer Fehlercode fuer Fehlerpfad Dfp_InjVlvCyl3C" VAL_BLK 0xCA0F2 Kwb_Wu16 65535.00 OneToOne 0.00 65535.00 FORMAT "%8.2" NUMBER 4 /end CHARACTERISTIC
/begin CHARACTERISTIC DSM_CDCDfp_InjVlvCyl4A_C "CARB spezifischer Fehlercode fuer Fehlerpfad Dfp_InjVlvCyl4A" VAL_BLK 0xCA0FA Kwb_Wu16 65535.00 OneToOne 0.00 65535.00 FORMAT "%8.2" NUMBER 4 /end CHARACTERISTIC
/begin CHARACTERISTIC DSM_CDCDfp_InjVlvCyl4B_C "CARB spezifischer Fehlercode fuer Fehlerpfad Dfp_InjVlvCyl4B" VAL_BLK 0xCA102 Kwb_Wu16 65535.00 OneToOne 0.00 65535.00 FORMAT "%8.2" NUMBER 4 /end CHARACTERISTIC
/begin CHARACTERISTIC DSM_CDCDfp_InjVlvCyl4C_C "CARB spezifischer Fehlercode fuer Fehlerpfad Dfp_InjVlvCyl4C" VAL_BLK 0xCA10A Kwb_Wu16 65535.00 OneToOne 0.00 65535.00 FORMAT "%8.2" NUMBER 4 /end CHARACTERISTIC
/begin CHARACTERISTIC DSM_CDCDfp_InjVlvCyl5A_C "CARB spezifischer Fehlercode fuer Fehlerpfad Dfp_InjVlvCyl5A" VAL_BLK 0xCA112 Kwb_Wu16 65535.00 OneToOne 0.00 65535.00 FORMAT "%8.2" NUMBER 4 /end CHARACTERISTIC
/begin CHARACTERISTIC DSM_CDCDfp_InjVlvCyl5B_C "CARB spezifischer Fehlercode fuer Fehlerpfad Dfp_InjVlvCyl5B" VAL_BLK 0xCA11A Kwb_Wu16 65535.00 OneToOne 0.00 65535.00 FORMAT "%8.2" NUMBER 4 /end CHARACTERISTIC
/begin CHARACTERISTIC DSM_CDCDfp_InjVlvCyl5C_C "CARB spezifischer Fehlercode fuer Fehlerpfad Dfp_InjVlvCyl5C" VAL_BLK 0xCA122 Kwb_Wu16 65535.00 OneToOne 0.00 65535.00 FORMAT "%8.2" NUMBER 4 /end CHARACTERISTIC
/begin CHARACTERISTIC DSM_CDCDfp_InjVlvCyl6A_C "CARB spezifischer Fehlercode fuer Fehlerpfad Dfp_InjVlvCyl6A" VAL_BLK 0xCA12A Kwb_Wu16 65535.00 OneToOne 0.00 65535.00 FORMAT "%8.2" NUMBER 4 /end CHARACTERISTIC
/begin CHARACTERISTIC DSM_CDCDfp_InjVlvCyl6B_C "CARB spezifischer Fehlercode fuer Fehlerpfad Dfp_InjVlvCyl6B" VAL_BLK 0xCA132 Kwb_Wu16 65535.00 OneToOne 0.00 65535.00 FORMAT "%8.2" NUMBER 4 /end CHARACTERISTIC
/begin CHARACTERISTIC DSM_CDCDfp_InjVlvCyl6C_C "CARB spezifischer Fehlercode fuer Fehlerpfad Dfp_InjVlvCyl6C" VAL_BLK 0xCA13A Kwb_Wu16 65535.00 OneToOne 0.00 65535.00 FORMAT "%8.2" NUMBER 4 /end CHARACTERISTIC
/begin CHARACTERISTIC DSM_CDCDfp_InjVlvCyl7A_C "CARB spezifischer Fehlercode fuer Fehlerpfad Dfp_InjVlvCyl7A" VAL_BLK 0xCA142 Kwb_Wu16 65535.00 OneToOne 0.00 65535.00 FORMAT "%8.2" NUMBER 4 /end CHARACTERISTIC
/begin CHARACTERISTIC DSM_CDCDfp_InjVlvCyl7B_C "CARB spezifischer Fehlercode fuer Fehlerpfad Dfp_InjVlvCyl7B" VAL_BLK 0xCA14A Kwb_Wu16 65535.00 OneToOne 0.00 65535.00 FORMAT "%8.2" NUMBER 4 /end CHARACTERISTIC
/begin CHARACTERISTIC DSM_CDCDfp_InjVlvCyl7C_C "CARB spezifischer Fehlercode fuer Fehlerpfad Dfp_InjVlvCyl7C" VAL_BLK 0xCA152 Kwb_Wu16 65535.00 OneToOne 0.00 65535.00 FORMAT "%8.2" NUMBER 4 /end CHARACTERISTIC
/begin CHARACTERISTIC DSM_CDCDfp_InjVlvCyl8A_C "CARB spezifischer Fehlercode fuer Fehlerpfad Dfp_InjVlvCyl8A" VAL_BLK 0xCA15A Kwb_Wu16 65535.00 OneToOne 0.00 65535.00 FORMAT "%8.2" NUMBER 4 /end CHARACTERISTIC
/begin CHARACTERISTIC DSM_CDCDfp_InjVlvCyl8B_C "CARB spezifischer Fehlercode fuer Fehlerpfad Dfp_InjVlvCyl8B" VAL_BLK 0xCA162 Kwb_Wu16 65535.00 OneToOne 0.00 65535.00 FORMAT "%8.2" NUMBER 4 /end CHARACTERISTIC
/begin CHARACTERISTIC DSM_CDCDfp_InjVlvCyl8C_C "CARB spezifischer Fehlercode fuer Fehlerpfad Dfp_InjVlvCyl8C" VAL_BLK 0xCA16A Kwb_Wu16 65535.00 OneToOne 0.00 65535.00 FORMAT "%8.2" NUMBER 4 /end CHARACTERISTIC
/begin CHARACTERISTIC DSM_CDCDfp_InjVlvNVC1_C "CARB spezifischer Fehlercode fuer Fehlerpfad Dfp_InjVlvNVC1" VAL_BLK 0xCA172 Kwb_Wu16 65535.00 OneToOne 0.00 65535.00 FORMAT "%8.2" NUMBER 4 /end CHARACTERISTIC
/begin CHARACTERISTIC DSM_CDCDfp_InjVlvNVC2_C "CARB spezifischer Fehlercode fuer Fehlerpfad Dfp_InjVlvNVC2" VAL_BLK 0xCA17A Kwb_Wu16 65535.00 OneToOne 0.00 65535.00 FORMAT "%8.2" NUMBER 4 /end CHARACTERISTIC
/begin CHARACTERISTIC DSM_CDCDfp_InjVlvNVC3_C "CARB spezifischer Fehlercode fuer Fehlerpfad Dfp_InjVlvNVC3" VAL_BLK 0xCA182 Kwb_Wu16 65535.00 OneToOne 0.00 65535.00 FORMAT "%8.2" NUMBER 4 /end CHARACTERISTIC
/begin CHARACTERISTIC DSM_CDCDfp_InjVlvNVC4_C "CARB spezifischer Fehlercode fuer Fehlerpfad Dfp_InjVlvNVC4" VAL_BLK 0xCA18A Kwb_Wu16 65535.00 OneToOne 0.00 65535.00 FORMAT "%8.2" NUMBER 4 /end CHARACTERISTIC
/begin CHARACTERISTIC DSM_CDCDfp_InjVlvNVC5_C "CARB spezifischer Fehlercode fuer Fehlerpfad Dfp_InjVlvNVC5" VAL_BLK 0xCA192 Kwb_Wu16 65535.00 OneToOne 0.00 65535.00 FORMAT "%8.2" NUMBER 4 /end CHARACTERISTIC
/begin CHARACTERISTIC DSM_CDCDfp_InjVlvNVC6_C "CARB spezifischer Fehlercode fuer Fehlerpfad Dfp_InjVlvNVC6" VAL_BLK 0xCA19A Kwb_Wu16 65535.00 OneToOne 0.00 65535.00 FORMAT "%8.2" NUMBER 4 /end CHARACTERISTIC
/begin CHARACTERISTIC DSM_CDCDfp_InjVlvNVC7_C "CARB spezifischer Fehlercode fuer Fehlerpfad Dfp_InjVlvNVC7" VAL_BLK 0xCA1A2 Kwb_Wu16 65535.00 OneToOne 0.00 65535.00 FORMAT "%8.2" NUMBER 4 /end CHARACTERISTIC
/begin CHARACTERISTIC DSM_CDCDfp_InjVlvNVC8_C "CARB spezifischer Fehlercode fuer Fehlerpfad Dfp_InjVlvNVC8" VAL_BLK 0xCA1AA Kwb_Wu16 65535.00 OneToOne 0.00 65535.00 FORMAT "%8.2" NUMBER 4 /end CHARACTERISTIC
/begin CHARACTERISTIC DSM_CDCDfp_LPACD_Max_C "CARB spezifischer Fehlercode fuer Fehlerpfad Dfp_LPACD_Max" VAL_BLK 0xCA1B2 Kwb_Wu16 65535.00 OneToOne 0.00 65535.00 FORMAT "%8.2" NUMBER 4 /end CHARACTERISTIC
/begin CHARACTERISTIC DSM_CDCDfp_LPACD_Min_C "CARB spezifischer Fehlercode fuer Fehlerpfad Dfp_LPACD_Min" VAL_BLK 0xCA1BA Kwb_Wu16 65535.00 OneToOne 0.00 65535.00 FORMAT "%8.2" NUMBER 4 /end CHARACTERISTIC
/begin CHARACTERISTIC DSM_CDCDfp_LPACD_SigNpl_C "CARB spezifischer Fehlercode fuer Fehlerpfad Dfp_LPACD_SigNpl" VAL_BLK 0xCA1C2 Kwb_Wu16 65535.00 OneToOne 0.00 65535.00 FORMAT "%8.2" NUMBER 4 /end CHARACTERISTIC
/begin CHARACTERISTIC DSM_CDCDfp_LSUCDCircNernst0_C "CARB spezifischer Fehlercode fuer Fehlerpfad Dfp_LSUCDCircNernst0" VAL_BLK 0xCA1CA Kwb_Wu16 65535.00 OneToOne 0.00 65535.00 FORMAT "%8.2" NUMBER 4 /end CHARACTERISTIC
/begin CHARACTERISTIC DSM_CDCDfp_LSUCDCircPumpCur0_C "CARB spezifischer Fehlercode fuer Fehlerpfad Dfp_LSUCDCircPumpCur0" VAL_BLK 0xCA1D2 Kwb_Wu16 65535.00 OneToOne 0.00 65535.00 FORMAT "%8.2" NUMBER 4 /end CHARACTERISTIC
/begin CHARACTERISTIC DSM_CDCDfp_LSUCDCircVirtGnd0_C "CARB spezifischer Fehlercode fuer Fehlerpfad Dfp_LSUCDCircVirtGnd0" VAL_BLK 0xCA1DA Kwb_Wu16 65535.00 OneToOne 0.00 65535.00 FORMAT "%8.2" NUMBER 4 /end CHARACTERISTIC
/begin CHARACTERISTIC DSM_CDCDfp_LSUCDHeater0_C "CARB spezifischer Fehlercode fuer Fehlerpfad Dfp_LSUCDHeater0" VAL_BLK 0xCA1E2 Kwb_Wu16 65535.00 OneToOne 0.00 65535.00 FORMAT "%8.2" NUMBER 4 /end CHARACTERISTIC
/begin CHARACTERISTIC DSM_CDCDfp_LSUCDHtCoup0_C "CARB spezifischer Fehlercode fuer Fehlerpfad Dfp_LSUCDHtCoup0" VAL_BLK 0xCA1EA Kwb_Wu16 65535.00 OneToOne 0.00 65535.00 FORMAT "%8.2" NUMBER 4 /end CHARACTERISTIC
/begin CHARACTERISTIC DSM_CDCDfp_LSUCDO20_C "CARB spezifischer Fehlercode fuer Fehlerpfad Dfp_LSUCDO20" VAL_BLK 0xCA1F2 Kwb_Wu16 65535.00 OneToOne 0.00 65535.00 FORMAT "%8.2" NUMBER 4 /end CHARACTERISTIC
/begin CHARACTERISTIC DSM_CDCDfp_LSUCDO2Clb0_C "CARB spezifischer Fehlercode fuer Fehlerpfad Dfp_LSUCDO2Clb0" VAL_BLK 0xCA1FA Kwb_Wu16 65535.00 OneToOne 0.00 65535.00 FORMAT "%8.2" NUMBER 4 /end CHARACTERISTIC
/begin CHARACTERISTIC DSM_CDCDfp_LSUCDRiClb0_C "CARB spezifischer Fehlercode fuer Fehlerpfad Dfp_LSUCDRiClb0" VAL_BLK 0xCA202 Kwb_Wu16 65535.00 OneToOne 0.00 65535.00 FORMAT "%8.2" NUMBER 4 /end CHARACTERISTIC
/begin CHARACTERISTIC DSM_CDCDfp_LSUCDSPI0_C "CARB spezifischer Fehlercode fuer Fehlerpfad Dfp_LSUCDSPI0" VAL_BLK 0xCA20A Kwb_Wu16 65535.00 OneToOne 0.00 65535.00 FORMAT "%8.2" NUMBER 4 /end CHARACTERISTIC
/begin CHARACTERISTIC DSM_CDCDfp_LSUCDSPIBattLow0_C "CARB spezifischer Fehlercode fuer Fehlerpfad Dfp_LSUCDSPIBattLow0" VAL_BLK 0xCA212 Kwb_Wu16 65535.00 OneToOne 0.00 65535.00 FORMAT "%8.2" NUMBER 4 /end CHARACTERISTIC
/begin CHARACTERISTIC DSM_CDCDfp_LSUCDWireIP0_C "CARB spezifischer Fehlercode fuer Fehlerpfad Dfp_LSUCDWireIP0" VAL_BLK 0xCA21A Kwb_Wu16 65535.00 OneToOne 0.00 65535.00 FORMAT "%8.2" NUMBER 4 /end CHARACTERISTIC
/begin CHARACTERISTIC DSM_CDCDfp_LSUCtlRiExc0_C "CARB spezifischer Fehlercode fuer Fehlerpfad Dfp_LSUCtlRiExc0" VAL_BLK 0xCA222 Kwb_Wu16 65535.00 OneToOne 0.00 65535.00 FORMAT "%8.2" NUMBER 4 /end CHARACTERISTIC
/begin CHARACTERISTIC DSM_CDCDfp_LSUMon1Sens_C "CARB spezifischer Fehlercode fuer Fehlerpfad Dfp_LSUMon1Sens" VAL_BLK 0xCA22A Kwb_Wu16 65535.00 OneToOne 0.00 65535.00 FORMAT "%8.2" NUMBER 4 /end CHARACTERISTIC
/begin CHARACTERISTIC DSM_CDCDfp_LSUMon2Sens_C "CARB spezifischer Fehlercode fuer Fehlerpfad Dfp_LSUMon2Sens" VAL_BLK 0xCA232 Kwb_Wu16 65535.00 OneToOne 0.00 65535.00 FORMAT "%8.2" NUMBER 4 /end CHARACTERISTIC
/begin CHARACTERISTIC DSM_CDCDfp_MIL_C "CARB spezifischer Fehlercode fuer Fehlerpfad Dfp_MIL" VAL_BLK 0xCA23A Kwb_Wu16 65535.00 OneToOne 0.00 65535.00 FORMAT "%8.2" NUMBER 4 /end CHARACTERISTIC
/begin CHARACTERISTIC DSM_CDCDfp_MRlyCD_C "CARB spezifischer Fehlercode fuer Fehlerpfad Dfp_MRlyCD" VAL_BLK 0xCA242 Kwb_Wu16 65535.00 OneToOne 0.00 65535.00 FORMAT "%8.2" NUMBER 4 /end CHARACTERISTIC
/begin CHARACTERISTIC DSM_CDCDfp_MSidCD_Comm_C "CARB spezifischer Fehlercode fuer Fehlerpfad Dfp_MSidCD_Comm" VAL_BLK 0xCA24A Kwb_Wu16 65535.00 OneToOne 0.00 65535.00 FORMAT "%8.2" NUMBER 4 /end CHARACTERISTIC
/begin CHARACTERISTIC DSM_CDCDfp_MSidCD_Pin_C "CARB spezifischer Fehlercode fuer Fehlerpfad Dfp_MSidCD_Pin" VAL_BLK 0xCA252 Kwb_Wu16 65535.00 OneToOne 0.00 65535.00 FORMAT "%8.2" NUMBER 4 /end CHARACTERISTIC
/begin CHARACTERISTIC DSM_CDCDfp_MSidCD_Sel_INI_C "CARB spezifischer Fehlercode fuer Fehlerpfad Dfp_MSidCD_Sel_INI" VAL_BLK 0xCA25A Kwb_Wu16 65535.00 OneToOne 0.00 65535.00 FORMAT "%8.2" NUMBER 4 /end CHARACTERISTIC
/begin CHARACTERISTIC DSM_CDCDfp_MSidCD_Select_C "CARB spezifischer Fehlercode fuer Fehlerpfad Dfp_MSidCD_Select" VAL_BLK 0xCA262 Kwb_Wu16 65535.00 OneToOne 0.00 65535.00 FORMAT "%8.2" NUMBER 4 /end CHARACTERISTIC
/begin CHARACTERISTIC DSM_CDCDfp_MeUnCDNoLoad_C "CARB spezifischer Fehlercode fuer Fehlerpfad Dfp_MeUnCDNoLoad" VAL_BLK 0xCA26A Kwb_Wu16 65535.00 OneToOne 0.00 65535.00 FORMAT "%8.2" NUMBER 4 /end CHARACTERISTIC
/begin CHARACTERISTIC DSM_CDCDfp_MeUnCDSCBat_C "CARB spezifischer Fehlercode fuer Fehlerpfad Dfp_MeUnCDSCBat" VAL_BLK 0xCA272 Kwb_Wu16 65535.00 OneToOne 0.00 65535.00 FORMAT "%8.2" NUMBER 4 /end CHARACTERISTIC
/begin CHARACTERISTIC DSM_CDCDfp_MeUnCDSCGnd_C "CARB spezifischer Fehlercode fuer Fehlerpfad Dfp_MeUnCDSCGnd" VAL_BLK 0xCA27A Kwb_Wu16 65535.00 OneToOne 0.00 65535.00 FORMAT "%8.2" NUMBER 4 /end CHARACTERISTIC
/begin CHARACTERISTIC DSM_CDCDfp_MeUnCD_ADC_C "CARB spezifischer Fehlercode fuer Fehlerpfad Dfp_MeUnCD_ADC" VAL_BLK 0xCA282 Kwb_Wu16 65535.00 OneToOne 0.00 65535.00 FORMAT "%8.2" NUMBER 4 /end CHARACTERISTIC
/begin CHARACTERISTIC DSM_CDCDfp_MeUnCD_SigTst_C "CARB spezifischer Fehlercode fuer Fehlerpfad Dfp_MeUnCD_SigTst" VAL_BLK 0xCA28A Kwb_Wu16 65535.00 OneToOne 0.00 65535.00 FORMAT "%8.2" NUMBER 4 /end CHARACTERISTIC
/begin CHARACTERISTIC DSM_CDCDfp_Montr_C "CARB spezifischer Fehlercode fuer Fehlerpfad Dfp_Montr" VAL_BLK 0xCA292 Kwb_Wu16 65535.00 OneToOne 0.00 65535.00 FORMAT "%8.2" NUMBER 4 /end CHARACTERISTIC
/begin CHARACTERISTIC DSM_CDCDfp_NetMngDeviceA_C "CARB spezifischer Fehlercode fuer Fehlerpfad Dfp_NetMngDeviceA" VAL_BLK 0xCA29A Kwb_Wu16 65535.00 OneToOne 0.00 65535.00 FORMAT "%8.2" NUMBER 4 /end CHARACTERISTIC
/begin CHARACTERISTIC DSM_CDCDfp_NetMngDeviceB_C "CARB spezifischer Fehlercode fuer Fehlerpfad Dfp_NetMngDeviceB" VAL_BLK 0xCA2A2 Kwb_Wu16 65535.00 OneToOne 0.00 65535.00 FORMAT "%8.2" NUMBER 4 /end CHARACTERISTIC
/begin CHARACTERISTIC DSM_CDCDfp_NetMngDeviceC_C "CARB spezifischer Fehlercode fuer Fehlerpfad Dfp_NetMngDeviceC" VAL_BLK 0xCA2AA Kwb_Wu16 65535.00 OneToOne 0.00 65535.00 FORMAT "%8.2" NUMBER 4 /end CHARACTERISTIC
/begin CHARACTERISTIC DSM_CDCDfp_OPSCD_Lamp_C "CARB spezifischer Fehlercode fuer Fehlerpfad Dfp_OPSCD_Lamp" VAL_BLK 0xCA2B2 Kwb_Wu16 65535.00 OneToOne 0.00 65535.00 FORMAT "%8.2" NUMBER 4 /end CHARACTERISTIC
/begin CHARACTERISTIC DSM_CDCDfp_OPSCD_anain_C "CARB spezifischer Fehlercode fuer Fehlerpfad Dfp_OPSCD_anain" VAL_BLK 0xCA2BA Kwb_Wu16 65535.00 OneToOne 0.00 65535.00 FORMAT "%8.2" NUMBER 4 /end CHARACTERISTIC
/begin CHARACTERISTIC DSM_CDCDfp_OTSCD_C "CARB spezifischer Fehlercode fuer Fehlerpfad Dfp_OTSCD" VAL_BLK 0xCA2C2 Kwb_Wu16 65535.00 OneToOne 0.00 65535.00 FORMAT "%8.2" NUMBER 4 /end CHARACTERISTIC
/begin CHARACTERISTIC DSM_CDCDfp_OvRMon_C "CARB spezifischer Fehlercode fuer Fehlerpfad Dfp_OvRMon" VAL_BLK 0xCA2CA Kwb_Wu16 65535.00 OneToOne 0.00 65535.00 FORMAT "%8.2" NUMBER 4 /end CHARACTERISTIC
/begin CHARACTERISTIC DSM_CDCDfp_OvRMonBrk_C "CARB specific fault code for fault path Dfp_OvRMonBrk" VAL_BLK 0xCA2D2 Kwb_Wu16 65535.00 OneToOne 0.00 65535.00 FORMAT "%8.2" NUMBER 4 /end CHARACTERISTIC
/begin CHARACTERISTIC DSM_CDCDfp_OvRMonSigA_C "CARB spezifischer Fehlercode fuer Fehlerpfad Dfp_OvRMonSigA" VAL_BLK 0xCA2DA Kwb_Wu16 65535.00 OneToOne 0.00 65535.00 FORMAT "%8.2" NUMBER 4 /end CHARACTERISTIC
/begin CHARACTERISTIC DSM_CDCDfp_OxiCCDTPre_C "CARB spezifischer Fehlercode fuer Fehlerpfad Dfp_OxiCCDTPre" VAL_BLK 0xCA2E2 Kwb_Wu16 65535.00 OneToOne 0.00 65535.00 FORMAT "%8.2" NUMBER 4 /end CHARACTERISTIC
/begin CHARACTERISTIC DSM_CDCDfp_PCR_GovDevNeg_C "CARB spezifischer Fehlercode fuer Fehlerpfad Dfp_PCR_GovDevNeg" VAL_BLK 0xCA2EA Kwb_Wu16 65535.00 OneToOne 0.00 65535.00 FORMAT "%8.2" NUMBER 4 /end CHARACTERISTIC
/begin CHARACTERISTIC DSM_CDCDfp_PCR_GovDevPos_C "CARB spezifischer Fehlercode fuer Fehlerpfad Dfp_PCR_GovDevPos" VAL_BLK 0xCA2F2 Kwb_Wu16 65535.00 OneToOne 0.00 65535.00 FORMAT "%8.2" NUMBER 4 /end CHARACTERISTIC
/begin CHARACTERISTIC DSM_CDCDfp_PCR_LPGvnrDvtNeg_C "CARB spezifischer Fehlercode fuer Fehlerpfad Dfp_PCR_LPGvnrDvtNeg" VAL_BLK 0xCA2FA Kwb_Wu16 65535.00 OneToOne 0.00 65535.00 FORMAT "%8.2" NUMBER 4 /end CHARACTERISTIC
/begin CHARACTERISTIC DSM_CDCDfp_PCR_LPGvnrDvtPos_C "CARB spezifischer Fehlercode fuer Fehlerpfad Dfp_PCR_LPGvnrDvtPos" VAL_BLK 0xCA302 Kwb_Wu16 65535.00 OneToOne 0.00 65535.00 FORMAT "%8.2" NUMBER 4 /end CHARACTERISTIC
/begin CHARACTERISTIC DSM_CDCDfp_PCVCDNoLoad_C "CARB spezifischer Fehlercode fuer Fehlerpfad Dfp_PCVCDNoLoad" VAL_BLK 0xCA30A Kwb_Wu16 65535.00 OneToOne 0.00 65535.00 FORMAT "%8.2" NUMBER 4 /end CHARACTERISTIC
/begin CHARACTERISTIC DSM_CDCDfp_PCVCDSCBat_C "CARB spezifischer Fehlercode fuer Fehlerpfad Dfp_PCVCDSCBat" VAL_BLK 0xCA312 Kwb_Wu16 65535.00 OneToOne 0.00 65535.00 FORMAT "%8.2" NUMBER 4 /end CHARACTERISTIC
/begin CHARACTERISTIC DSM_CDCDfp_PCVCDSCGnd_C "CARB spezifischer Fehlercode fuer Fehlerpfad Dfp_PCVCDSCGnd" VAL_BLK 0xCA31A Kwb_Wu16 65535.00 OneToOne 0.00 65535.00 FORMAT "%8.2" NUMBER 4 /end CHARACTERISTIC
/begin CHARACTERISTIC DSM_CDCDfp_PCVCD_ADC_C "CARB spezifischer Fehlercode fuer Fehlerpfad Dfp_PCVCD_ADC" VAL_BLK 0xCA322 Kwb_Wu16 65535.00 OneToOne 0.00 65535.00 FORMAT "%8.2" NUMBER 4 /end CHARACTERISTIC
/begin CHARACTERISTIC DSM_CDCDfp_PCVCD_SigTst_C "CARB spezifischer Fehlercode fuer Fehlerpfad Dfp_PCVCD_SigTst" VAL_BLK 0xCA32A Kwb_Wu16 65535.00 OneToOne 0.00 65535.00 FORMAT "%8.2" NUMBER 4 /end CHARACTERISTIC
/begin CHARACTERISTIC DSM_CDCDfp_PFltAPSPlaus_C "CARB spezifischer Fehlercode fuer Fehlerpfad Dfp_PFltAPSPlaus" VAL_BLK 0xCA332 Kwb_Wu16 65535.00 OneToOne 0.00 65535.00 FORMAT "%8.2" NUMBER 4 /end CHARACTERISTIC
/begin CHARACTERISTIC DSM_CDCDfp_PFltAPSens_C "CARB spezifischer Fehlercode fuer Fehlerpfad Dfp_PFltAPSens" VAL_BLK 0xCA33A Kwb_Wu16 65535.00 OneToOne 0.00 65535.00 FORMAT "%8.2" NUMBER 4 /end CHARACTERISTIC
/begin CHARACTERISTIC DSM_CDCDfp_PFltBPSPlaus_C "CARB spezifischer Fehlercode fuer Fehlerpfad Dfp_PFltBPSPlaus" VAL_BLK 0xCA342 Kwb_Wu16 65535.00 OneToOne 0.00 65535.00 FORMAT "%8.2" NUMBER 4 /end CHARACTERISTIC
/begin CHARACTERISTIC DSM_CDCDfp_PFltCDPPre_C "CARB spezifischer Fehlercode fuer Fehlerpfad Dfp_PFltCDPPre" VAL_BLK 0xCA34A Kwb_Wu16 65535.00 OneToOne 0.00 65535.00 FORMAT "%8.2" NUMBER 4 /end CHARACTERISTIC
/begin CHARACTERISTIC DSM_CDCDfp_PFltCDTempPre_C "CARB spezifischer Fehlercode fuer Fehlerpfad Dfp_PFltCDTempPre" VAL_BLK 0xCA352 Kwb_Wu16 65535.00 OneToOne 0.00 65535.00 FORMAT "%8.2" NUMBER 4 /end CHARACTERISTIC
/begin CHARACTERISTIC DSM_CDCDfp_PFltChar_C "CARB spezifischer Fehlercode fuer Fehlerpfad Dfp_PFltChar" VAL_BLK 0xCA35A Kwb_Wu16 65535.00 OneToOne 0.00 65535.00 FORMAT "%8.2" NUMBER 4 /end CHARACTERISTIC
/begin CHARACTERISTIC DSM_CDCDfp_PFltEngPrt_C "CARB spezifischer Fehlercode fuer Fehlerpfad Dfp_PFltEngPrt" VAL_BLK 0xCA362 Kwb_Wu16 65535.00 OneToOne 0.00 65535.00 FORMAT "%8.2" NUMBER 4 /end CHARACTERISTIC
/begin CHARACTERISTIC DSM_CDCDfp_PFltPresDynPlaus_C "CARB spezifischer Fehlercode fuer Fehlerpfad Dfp_PFltPresDynPlaus" VAL_BLK 0xCA36A Kwb_Wu16 65535.00 OneToOne 0.00 65535.00 FORMAT "%8.2" NUMBER 4 /end CHARACTERISTIC
/begin CHARACTERISTIC DSM_CDCDfp_PFltPresPlaus_C "CARB spezifischer Fehlercode fuer Fehlerpfad Dfp_PFltPresPlaus" VAL_BLK 0xCA372 Kwb_Wu16 65535.00 OneToOne 0.00 65535.00 FORMAT "%8.2" NUMBER 4 /end CHARACTERISTIC
/begin CHARACTERISTIC DSM_CDCDfp_PFltPresSens_C "CARB spezifischer Fehlercode fuer Fehlerpfad Dfp_PFltPresSens" VAL_BLK 0xCA37A Kwb_Wu16 65535.00 OneToOne 0.00 65535.00 FORMAT "%8.2" NUMBER 4 /end CHARACTERISTIC
/begin CHARACTERISTIC DSM_CDCDfp_PFltPresSensFrz_C "CARB spezifischer Fehlercode fuer Fehlerpfad Dfp_PFltPresSensFrz" VAL_BLK 0xCA382 Kwb_Wu16 65535.00 OneToOne 0.00 65535.00 FORMAT "%8.2" NUMBER 4 /end CHARACTERISTIC
/begin CHARACTERISTIC DSM_CDCDfp_PFltPresSensHsLn_C "CARB spezifischer Fehlercode fuer Fehlerpfad Dfp_PFltPresSensHsLn" VAL_BLK 0xCA38A Kwb_Wu16 65535.00 OneToOne 0.00 65535.00 FORMAT "%8.2" NUMBER 4 /end CHARACTERISTIC
/begin CHARACTERISTIC DSM_CDCDfp_PFltPresSensSot_C "CARB spezifischer Fehlercode fuer Fehlerpfad Dfp_PFltPresSensSot" VAL_BLK 0xCA392 Kwb_Wu16 65535.00 OneToOne 0.00 65535.00 FORMAT "%8.2" NUMBER 4 /end CHARACTERISTIC
/begin CHARACTERISTIC DSM_CDCDfp_PFltRgnPerm_C "CARB spezifischer Fehlercode fuer Fehlerpfad Dfp_PFltRgnPerm" VAL_BLK 0xCA39A Kwb_Wu16 65535.00 OneToOne 0.00 65535.00 FORMAT "%8.2" NUMBER 4 /end CHARACTERISTIC
/begin CHARACTERISTIC DSM_CDCDfp_PFltTempDwnStrm_C "CARB spezifischer Fehlercode fuer Fehlerpfad Dfp_PFltTempDwnStrm" VAL_BLK 0xCA3A2 Kwb_Wu16 65535.00 OneToOne 0.00 65535.00 FORMAT "%8.2" NUMBER 4 /end CHARACTERISTIC
/begin CHARACTERISTIC DSM_CDCDfp_PFltTempSens_C "CARB spezifischer Fehlercode fuer Fehlerpfad Dfp_PFltTempSens" VAL_BLK 0xCA3AA Kwb_Wu16 65535.00 OneToOne 0.00 65535.00 FORMAT "%8.2" NUMBER 4 /end CHARACTERISTIC
/begin CHARACTERISTIC DSM_CDCDfp_PFltTempUpStrm_C "CARB spezifischer Fehlercode fuer Fehlerpfad Dfp_PFltTempUpStrm" VAL_BLK 0xCA3B2 Kwb_Wu16 65535.00 OneToOne 0.00 65535.00 FORMAT "%8.2" NUMBER 4 /end CHARACTERISTIC
/begin CHARACTERISTIC DSM_CDCDfp_PFltmSotDiffMax_C "CARB spezifischer Fehlercode fuer Fehlerpfad Dfp_PFltmSotDiffMax" VAL_BLK 0xCA3BA Kwb_Wu16 65535.00 OneToOne 0.00 65535.00 FORMAT "%8.2" NUMBER 4 /end CHARACTERISTIC
/begin CHARACTERISTIC DSM_CDCDfp_PSPCD_Actr_C "CARB spezifischer Fehlercode fuer Fehlerpfad Dfp_PSPCD_Actr" VAL_BLK 0xCA3C2 Kwb_Wu16 65535.00 OneToOne 0.00 65535.00 FORMAT "%8.2" NUMBER 4 /end CHARACTERISTIC
/begin CHARACTERISTIC DSM_CDCDfp_PresPlausDblDef_C "CARB spezifischer Fehlercode fuer Fehlerpfad Dfp_PresPlausDblDef" VAL_BLK 0xCA3CA Kwb_Wu16 65535.00 OneToOne 0.00 65535.00 FORMAT "%8.2" NUMBER 4 /end CHARACTERISTIC
/begin CHARACTERISTIC DSM_CDCDfp_QLTCD_C "CARB spezifischer Fehlercode fuer Fehlerpfad Dfp_QLTCD" VAL_BLK 0xCA3D2 Kwb_Wu16 65535.00 OneToOne 0.00 65535.00 FORMAT "%8.2" NUMBER 4 /end CHARACTERISTIC
/begin CHARACTERISTIC DSM_CDCDfp_RailCD_C "CARB spezifischer Fehlercode fuer Fehlerpfad Dfp_RailCD" VAL_BLK 0xCA3DA Kwb_Wu16 65535.00 OneToOne 0.00 65535.00 FORMAT "%8.2" NUMBER 4 /end CHARACTERISTIC
/begin CHARACTERISTIC DSM_CDCDfp_RailCDOfsTst_C "CARB spezifischer Fehlercode fuer Fehlerpfad Dfp_RailCDOfsTst" VAL_BLK 0xCA3E2 Kwb_Wu16 65535.00 OneToOne 0.00 65535.00 FORMAT "%8.2" NUMBER 4 /end CHARACTERISTIC
/begin CHARACTERISTIC DSM_CDCDfp_RailCD_PMonStrt_C "CARB spezifischer Fehlercode fuer Fehlerpfad Dfp_RailCD_PMonStrt" VAL_BLK 0xCA3EA Kwb_Wu16 65535.00 OneToOne 0.00 65535.00 FORMAT "%8.2" NUMBER 4 /end CHARACTERISTIC
/begin CHARACTERISTIC DSM_CDCDfp_RailCtlModeMeUnDiag_C "CARB spezifischer Fehlercode fuer Fehlerpfad Dfp_RailCtlModeMeUnDiag" VAL_BLK 0xCA3F2 Kwb_Wu16 65535.00 OneToOne 0.00 65535.00 FORMAT "%8.2" NUMBER 4 /end CHARACTERISTIC
/begin CHARACTERISTIC DSM_CDCDfp_RailCtlModePCVDiag_C "CARB spezifischer Fehlercode fuer Fehlerpfad Dfp_RailCtlModePCVDiag" VAL_BLK 0xCA3FA Kwb_Wu16 65535.00 OneToOne 0.00 65535.00 FORMAT "%8.2" NUMBER 4 /end CHARACTERISTIC
/begin CHARACTERISTIC DSM_CDCDfp_RailMeUn0_C "CARB spezifischer Fehlercode fuer Fehlerpfad Dfp_RailMeUn0" VAL_BLK 0xCA402 Kwb_Wu16 65535.00 OneToOne 0.00 65535.00 FORMAT "%8.2" NUMBER 4 /end CHARACTERISTIC
/begin CHARACTERISTIC DSM_CDCDfp_RailMeUn1_C "CARB spezifischer Fehlercode fuer Fehlerpfad Dfp_RailMeUn1" VAL_BLK 0xCA40A Kwb_Wu16 65535.00 OneToOne 0.00 65535.00 FORMAT "%8.2" NUMBER 4 /end CHARACTERISTIC
/begin CHARACTERISTIC DSM_CDCDfp_RailMeUn2_C "CARB spezifischer Fehlercode fuer Fehlerpfad Dfp_RailMeUn2" VAL_BLK 0xCA412 Kwb_Wu16 65535.00 OneToOne 0.00 65535.00 FORMAT "%8.2" NUMBER 4 /end CHARACTERISTIC
/begin CHARACTERISTIC DSM_CDCDfp_RailMeUn3_C "CARB spezifischer Fehlercode fuer Fehlerpfad Dfp_RailMeUn3" VAL_BLK 0xCA41A Kwb_Wu16 65535.00 OneToOne 0.00 65535.00 FORMAT "%8.2" NUMBER 4 /end CHARACTERISTIC
/begin CHARACTERISTIC DSM_CDCDfp_RailMeUn4_C "CARB spezifischer Fehlercode fuer Fehlerpfad Dfp_RailMeUn4" VAL_BLK 0xCA422 Kwb_Wu16 65535.00 OneToOne 0.00 65535.00 FORMAT "%8.2" NUMBER 4 /end CHARACTERISTIC
/begin CHARACTERISTIC DSM_CDCDfp_RailPCV0_C "CARB spezifischer Fehlercode fuer Fehlerpfad Dfp_RailPCV0" VAL_BLK 0xCA42A Kwb_Wu16 65535.00 OneToOne 0.00 65535.00 FORMAT "%8.2" NUMBER 4 /end CHARACTERISTIC
/begin CHARACTERISTIC DSM_CDCDfp_RailPCV1_C "CARB spezifischer Fehlercode fuer Fehlerpfad Dfp_RailPCV1" VAL_BLK 0xCA432 Kwb_Wu16 65535.00 OneToOne 0.00 65535.00 FORMAT "%8.2" NUMBER 4 /end CHARACTERISTIC
/begin CHARACTERISTIC DSM_CDCDfp_RailPCV2_C "CARB spezifischer Fehlercode fuer Fehlerpfad Dfp_RailPCV2" VAL_BLK 0xCA43A Kwb_Wu16 65535.00 OneToOne 0.00 65535.00 FORMAT "%8.2" NUMBER 4 /end CHARACTERISTIC
/begin CHARACTERISTIC DSM_CDCDfp_RailPCV3_C "CARB spezifischer Fehlercode fuer Fehlerpfad Dfp_RailPCV3" VAL_BLK 0xCA442 Kwb_Wu16 65535.00 OneToOne 0.00 65535.00 FORMAT "%8.2" NUMBER 4 /end CHARACTERISTIC
/begin CHARACTERISTIC DSM_CDCDfp_RailPCV4_C "CARB spezifischer Fehlercode fuer Fehlerpfad Dfp_RailPCV4" VAL_BLK 0xCA44A Kwb_Wu16 65535.00 OneToOne 0.00 65535.00 FORMAT "%8.2" NUMBER 4 /end CHARACTERISTIC
/begin CHARACTERISTIC DSM_CDCDfp_RailPCV5_C "CARB spezifischer Fehlercode fuer Fehlerpfad Dfp_RailPCV5" VAL_BLK 0xCA452 Kwb_Wu16 65535.00 OneToOne 0.00 65535.00 FORMAT "%8.2" NUMBER 4 /end CHARACTERISTIC
/begin CHARACTERISTIC DSM_CDCDfp_SOPTst_C "CARB spezifischer Fehlercode fuer Fehlerpfad Dfp_SOPTst" VAL_BLK 0xCA45A Kwb_Wu16 65535.00 OneToOne 0.00 65535.00 FORMAT "%8.2" NUMBER 4 /end CHARACTERISTIC
/begin CHARACTERISTIC DSM_CDCDfp_SSpMon1_C "CARB spezifischer Fehlercode fuer Fehlerpfad Dfp_SSpMon1" VAL_BLK 0xCA462 Kwb_Wu16 65535.00 OneToOne 0.00 65535.00 FORMAT "%8.2" NUMBER 4 /end CHARACTERISTIC
/begin CHARACTERISTIC DSM_CDCDfp_SSpMon2_C "CARB spezifischer Fehlercode fuer Fehlerpfad Dfp_SSpMon2" VAL_BLK 0xCA46A Kwb_Wu16 65535.00 OneToOne 0.00 65535.00 FORMAT "%8.2" NUMBER 4 /end CHARACTERISTIC
/begin CHARACTERISTIC DSM_CDCDfp_SSpMon3_C "CARB spezifischer Fehlercode fuer Fehlerpfad Dfp_SSpMon3" VAL_BLK 0xCA472 Kwb_Wu16 65535.00 OneToOne 0.00 65535.00 FORMAT "%8.2" NUMBER 4 /end CHARACTERISTIC
/begin CHARACTERISTIC DSM_CDCDfp_SWChk_CycSigChkDat_C "CARB spezifischer Fehlercode fuer Fehlerpfad Dfp_SWChk_CycSigChkDat" VAL_BLK 0xCA47A Kwb_Wu16 65535.00 OneToOne 0.00 65535.00 FORMAT "%8.2" NUMBER 4 /end CHARACTERISTIC
/begin CHARACTERISTIC DSM_CDCDfp_SWChk_CycSigChkPrg_C "CARB spezifischer Fehlercode fuer Fehlerpfad Dfp_SWChk_CycSigChkPrg" VAL_BLK 0xCA482 Kwb_Wu16 65535.00 OneToOne 0.00 65535.00 FORMAT "%8.2" NUMBER 4 /end CHARACTERISTIC
/begin CHARACTERISTIC DSM_CDCDfp_ShutCD_C "CARB spezifischer Fehlercode fuer Fehlerpfad Dfp_ShutCD" VAL_BLK 0xCA48A Kwb_Wu16 65535.00 OneToOne 0.00 65535.00 FORMAT "%8.2" NUMBER 4 /end CHARACTERISTIC
/begin CHARACTERISTIC DSM_CDCDfp_StSysTrqShutOff_C "CARB spezifischer Fehlercode fuer Fehlerpfad Dfp_StSysTrqShutOff" VAL_BLK 0xCA492 Kwb_Wu16 65535.00 OneToOne 0.00 65535.00 FORMAT "%8.2" NUMBER 4 /end CHARACTERISTIC
/begin CHARACTERISTIC DSM_CDCDfp_StrtCD_Actr_C "CARB spezifischer Fehlercode fuer Fehlerpfad Dfp_StrtCD_Actr" VAL_BLK 0xCA49A Kwb_Wu16 65535.00 OneToOne 0.00 65535.00 FORMAT "%8.2" NUMBER 4 /end CHARACTERISTIC
/begin CHARACTERISTIC DSM_CDCDfp_SysLamp_C "CARB spezifischer Fehlercode fuer Fehlerpfad Dfp_SysLamp" VAL_BLK 0xCA4A2 Kwb_Wu16 65535.00 OneToOne 0.00 65535.00 FORMAT "%8.2" NUMBER 4 /end CHARACTERISTIC
/begin CHARACTERISTIC DSM_CDCDfp_T15CD_C "CARB spezifischer Fehlercode fuer Fehlerpfad Dfp_T15CD" VAL_BLK 0xCA4AA Kwb_Wu16 65535.00 OneToOne 0.00 65535.00 FORMAT "%8.2" NUMBER 4 /end CHARACTERISTIC
/begin CHARACTERISTIC DSM_CDCDfp_TGearbx_C "CARB spezifischer Fehlercode fuer Fehlerpfad Dfp_TGearbx" VAL_BLK 0xCA4B2 Kwb_Wu16 65535.00 OneToOne 0.00 65535.00 FORMAT "%8.2" NUMBER 4 /end CHARACTERISTIC
/begin CHARACTERISTIC DSM_CDCDfp_TPUMon_C "CARB spezifischer Fehlercode fuer Fehlerpfad Dfp_TPUMon" VAL_BLK 0xCA4BA Kwb_Wu16 65535.00 OneToOne 0.00 65535.00 FORMAT "%8.2" NUMBER 4 /end CHARACTERISTIC
/begin CHARACTERISTIC DSM_CDCDfp_TVACD_Max_C "CARB spezifischer Fehlercode fuer Fehlerpfad Dfp_TVACD_Max" VAL_BLK 0xCA4C2 Kwb_Wu16 65535.00 OneToOne 0.00 65535.00 FORMAT "%8.2" NUMBER 4 /end CHARACTERISTIC
/begin CHARACTERISTIC DSM_CDCDfp_TVACD_Min_C "CARB spezifischer Fehlercode fuer Fehlerpfad Dfp_TVACD_Min" VAL_BLK 0xCA4CA Kwb_Wu16 65535.00 OneToOne 0.00 65535.00 FORMAT "%8.2" NUMBER 4 /end CHARACTERISTIC
/begin CHARACTERISTIC DSM_CDCDfp_TVACD_SigNpl_C "CARB spezifischer Fehlercode fuer Fehlerpfad Dfp_TVACD_SigNpl" VAL_BLK 0xCA4D2 Kwb_Wu16 65535.00 OneToOne 0.00 65535.00 FORMAT "%8.2" NUMBER 4 /end CHARACTERISTIC
/begin CHARACTERISTIC DSM_CDCDfp_TVACD_TVADia1_C "CARB spezifischer Fehlercode fuer Fehlerpfad Dfp_TVACD_TVADia1" VAL_BLK 0xCA4DA Kwb_Wu16 65535.00 OneToOne 0.00 65535.00 FORMAT "%8.2" NUMBER 4 /end CHARACTERISTIC
/begin CHARACTERISTIC DSM_CDCDfp_TVACD_TVADia2_C "CARB spezifischer Fehlercode fuer Fehlerpfad Dfp_TVACD_TVADia2" VAL_BLK 0xCA4E2 Kwb_Wu16 65535.00 OneToOne 0.00 65535.00 FORMAT "%8.2" NUMBER 4 /end CHARACTERISTIC
/begin CHARACTERISTIC DSM_CDCDfp_TVACD_TVADia3_C "CARB spezifischer Fehlercode fuer Fehlerpfad Dfp_TVACD_TVADia3" VAL_BLK 0xCA4EA Kwb_Wu16 65535.00 OneToOne 0.00 65535.00 FORMAT "%8.2" NUMBER 4 /end CHARACTERISTIC
/begin CHARACTERISTIC DSM_CDCDfp_TVACD_TVADia4_C "CARB spezifischer Fehlercode fuer Fehlerpfad Dfp_TVACD_TVADia4" VAL_BLK 0xCA4F2 Kwb_Wu16 65535.00 OneToOne 0.00 65535.00 FORMAT "%8.2" NUMBER 4 /end CHARACTERISTIC
/begin CHARACTERISTIC DSM_CDCDfp_VSACD_DioInDia1_C "CARB spezifischer Fehlercode fuer Fehlerpfad Dfp_VSACD_DioInDia1" VAL_BLK 0xCA4FA Kwb_Wu16 65535.00 OneToOne 0.00 65535.00 FORMAT "%8.2" NUMBER 4 /end CHARACTERISTIC
/begin CHARACTERISTIC DSM_CDCDfp_VSACD_DioInDia2_C "CARB spezifischer Fehlercode fuer Fehlerpfad Dfp_VSACD_DioInDia2" VAL_BLK 0xCA502 Kwb_Wu16 65535.00 OneToOne 0.00 65535.00 FORMAT "%8.2" NUMBER 4 /end CHARACTERISTIC
/begin CHARACTERISTIC DSM_CDCDfp_VSACD_DioInDia3_C "CARB spezifischer Fehlercode fuer Fehlerpfad Dfp_VSACD_DioInDia3" VAL_BLK 0xCA50A Kwb_Wu16 65535.00 OneToOne 0.00 65535.00 FORMAT "%8.2" NUMBER 4 /end CHARACTERISTIC
/begin CHARACTERISTIC DSM_CDCDfp_VSACD_DioInDia4_C "CARB spezifischer Fehlercode fuer Fehlerpfad Dfp_VSACD_DioInDia4" VAL_BLK 0xCA512 Kwb_Wu16 65535.00 OneToOne 0.00 65535.00 FORMAT "%8.2" NUMBER 4 /end CHARACTERISTIC
/begin CHARACTERISTIC DSM_CDCDfp_VSACD_DioInMin_C "CARB spezifischer Fehlercode fuer Fehlerpfad Dfp_VSACD_DioInMin" VAL_BLK 0xCA51A Kwb_Wu16 65535.00 OneToOne 0.00 65535.00 FORMAT "%8.2" NUMBER 4 /end CHARACTERISTIC
/begin CHARACTERISTIC DSM_CDCDfp_VSACD_Max_C "CARB spezifischer Fehlercode fuer Fehlerpfad Dfp_VSACD_Max" VAL_BLK 0xCA522 Kwb_Wu16 65535.00 OneToOne 0.00 65535.00 FORMAT "%8.2" NUMBER 4 /end CHARACTERISTIC
/begin CHARACTERISTIC DSM_CDCDfp_VSACD_Min_C "CARB spezifischer Fehlercode fuer Fehlerpfad Dfp_VSACD_Min" VAL_BLK 0xCA52A Kwb_Wu16 65535.00 OneToOne 0.00 65535.00 FORMAT "%8.2" NUMBER 4 /end CHARACTERISTIC
/begin CHARACTERISTIC DSM_CDCDfp_VSACD_SigNpl_C "CARB spezifischer Fehlercode fuer Fehlerpfad Dfp_VSACD_SigNpl" VAL_BLK 0xCA532 Kwb_Wu16 65535.00 OneToOne 0.00 65535.00 FORMAT "%8.2" NUMBER 4 /end CHARACTERISTIC
/begin CHARACTERISTIC DSM_CDCDfp_VSACD_VSADia1_C "CARB spezifischer Fehlercode fuer Fehlerpfad Dfp_VSACD_VSADia1" VAL_BLK 0xCA53A Kwb_Wu16 65535.00 OneToOne 0.00 65535.00 FORMAT "%8.2" NUMBER 4 /end CHARACTERISTIC
/begin CHARACTERISTIC DSM_CDCDfp_VSACD_VSADia2_C "CARB spezifischer Fehlercode fuer Fehlerpfad Dfp_VSACD_VSADia2" VAL_BLK 0xCA542 Kwb_Wu16 65535.00 OneToOne 0.00 65535.00 FORMAT "%8.2" NUMBER 4 /end CHARACTERISTIC
/begin CHARACTERISTIC DSM_CDCDfp_VSACD_VSADia3_C "CARB spezifischer Fehlercode fuer Fehlerpfad Dfp_VSACD_VSADia3" VAL_BLK 0xCA54A Kwb_Wu16 65535.00 OneToOne 0.00 65535.00 FORMAT "%8.2" NUMBER 4 /end CHARACTERISTIC
/begin CHARACTERISTIC DSM_CDCDfp_VSACD_VSADia4_C "CARB spezifischer Fehlercode fuer Fehlerpfad Dfp_VSACD_VSADia4" VAL_BLK 0xCA552 Kwb_Wu16 65535.00 OneToOne 0.00 65535.00 FORMAT "%8.2" NUMBER 4 /end CHARACTERISTIC
/begin CHARACTERISTIC DSM_CDCDfp_VSSCD1_C "CARB spezifischer Fehlercode fuer Fehlerpfad Dfp_VSSCD1" VAL_BLK 0xCA55A Kwb_Wu16 65535.00 OneToOne 0.00 65535.00 FORMAT "%8.2" NUMBER 4 /end CHARACTERISTIC
/begin CHARACTERISTIC DSM_CDCDfp_VSSCD2_C "CARB spezifischer Fehlercode fuer Fehlerpfad Dfp_VSSCD2" VAL_BLK 0xCA562 Kwb_Wu16 65535.00 OneToOne 0.00 65535.00 FORMAT "%8.2" NUMBER 4 /end CHARACTERISTIC
/begin CHARACTERISTIC DSM_CDCDfp_WdCom_C "CARB spezifischer Fehlercode fuer Fehlerpfad Dfp_WdCom" VAL_BLK 0xCA56A Kwb_Wu16 65535.00 OneToOne 0.00 65535.00 FORMAT "%8.2" NUMBER 4 /end CHARACTERISTIC
/begin CHARACTERISTIC DSM_FMKDfp_Layer_TANS_C "Ausblendbedingungen fuer Fehlerpfad Dfp_Layer_TANS" VALUE 0xC9854 Kw_Wu8 255.0 OneToOne 0.00 255.0 FORMAT "%5.1" /end CHARACTERISTIC
/begin CHARACTERISTIC DSM_FMKDfp_ACCDCmpr_C "Ausblendbedingungen fuer Fehlerpfad Dfp_ACCDCmpr" VALUE 0xC9855 Kw_Wu8 255.0 OneToOne 0.00 255.0 FORMAT "%5.1" /end CHARACTERISTIC
/begin CHARACTERISTIC DSM_FMKDfp_ACCDPres_C "Ausblendbedingungen fuer Fehlerpfad Dfp_ACCDPres" VALUE 0xC9856 Kw_Wu8 255.0 OneToOne 0.00 255.0 FORMAT "%5.1" /end CHARACTERISTIC
/begin CHARACTERISTIC DSM_FMKDfp_ACCDPres1_C "Ausblendbedingungen fuer Fehlerpfad Dfp_ACCDPres1" VALUE 0xC9857 Kw_Wu8 255.0 OneToOne 0.00 255.0 FORMAT "%5.1" /end CHARACTERISTIC
/begin CHARACTERISTIC DSM_FMKDfp_ACCDPresAna_C "Ausblendbedingungen fuer Fehlerpfad Dfp_ACCDPresAna" VALUE 0xC9858 Kw_Wu8 255.0 OneToOne 0.00 255.0 FORMAT "%5.1" /end CHARACTERISTIC
/begin CHARACTERISTIC DSM_FMKDfp_ACCDSwtin_C "Ausblendbedingungen fuer Fehlerpfad Dfp_ACCDSwtin" VALUE 0xC9859 Kw_Wu8 255.0 OneToOne 0.00 255.0 FORMAT "%5.1" /end CHARACTERISTIC
/begin CHARACTERISTIC DSM_FMKDfp_ACC_PlausTrqDes_C "Ausblendbedingungen fuer Fehlerpfad Dfp_ACC_PlausTrqDes" VALUE 0xC985A Kw_Wu8 255.0 OneToOne 0.00 255.0 FORMAT "%5.1" /end CHARACTERISTIC
/begin CHARACTERISTIC DSM_FMKDfp_ACC_trqInr_C "Ausblendbedingungen fuer Fehlerpfad Dfp_ACC_trqInr" VALUE 0xC985B Kw_Wu8 255.0 OneToOne 0.00 255.0 FORMAT "%5.1" /end CHARACTERISTIC
/begin CHARACTERISTIC DSM_FMKDfp_ACTrq_C "Ausblendbedingungen fuer Fehlerpfad Dfp_ACTrq" VALUE 0xC985C Kw_Wu8 255.0 OneToOne 0.00 255.0 FORMAT "%5.1" /end CHARACTERISTIC
/begin CHARACTERISTIC DSM_FMKDfp_ADCMon_C "Ausblendbedingungen fuer Fehlerpfad Dfp_ADCMon" VALUE 0xC985D Kw_Wu8 255.0 OneToOne 0.00 255.0 FORMAT "%5.1" /end CHARACTERISTIC
/begin CHARACTERISTIC DSM_FMKDfp_AFSCDIdlAdjVal_C "Ausblendbedingungen fuer Fehlerpfad Dfp_AFSCDIdlAdjVal" VALUE 0xC985E Kw_Wu8 255.0 OneToOne 0.00 255.0 FORMAT "%5.1" /end CHARACTERISTIC
/begin CHARACTERISTIC DSM_FMKDfp_AFSCDLdAdjVal_C "Ausblendbedingungen fuer Fehlerpfad Dfp_AFSCDLdAdjVal" VALUE 0xC985F Kw_Wu8 255.0 OneToOne 0.00 255.0 FORMAT "%5.1" /end CHARACTERISTIC
/begin CHARACTERISTIC DSM_FMKDfp_AFSCD_AirTempDcyc_C "Ausblendbedingungen fuer Fehlerpfad Dfp_AFSCD_AirTempDcyc" VALUE 0xC9860 Kw_Wu8 255.0 OneToOne 0.00 255.0 FORMAT "%5.1" /end CHARACTERISTIC
/begin CHARACTERISTIC DSM_FMKDfp_AFSCD_PlOffsDrft_C "Ausblendbedingungen fuer Fehlerpfad Dfp_AFSCD_PlOffsDrft" VALUE 0xC9861 Kw_Wu8 255.0 OneToOne 0.00 255.0 FORMAT "%5.1" /end CHARACTERISTIC
/begin CHARACTERISTIC DSM_FMKDfp_AFSCD_PlSetyDrft_C "Ausblendbedingungen fuer Fehlerpfad Dfp_AFSCD_PlSetyDrft" VALUE 0xC9862 Kw_Wu8 255.0 OneToOne 0.00 255.0 FORMAT "%5.1" /end CHARACTERISTIC
/begin CHARACTERISTIC DSM_FMKDfp_AFSCD_SRCAirTemp_C "Ausblendbedingungen fuer Fehlerpfad Dfp_AFSCD_SRCAirTemp" VALUE 0xC9863 Kw_Wu8 255.0 OneToOne 0.00 255.0 FORMAT "%5.1" /end CHARACTERISTIC
/begin CHARACTERISTIC DSM_FMKDfp_AFSCD_SRCBatt_C "Ausblendbedingungen fuer Fehlerpfad Dfp_AFSCD_SRCBatt" VALUE 0xC9864 Kw_Wu8 255.0 OneToOne 0.00 255.0 FORMAT "%5.1" /end CHARACTERISTIC
/begin CHARACTERISTIC DSM_FMKDfp_AFSCD_SRCCorrAirm_C "Ausblendbedingungen fuer Fehlerpfad Dfp_AFSCD_SRCCorrAirm" VALUE 0xC9865 Kw_Wu8 255.0 OneToOne 0.00 255.0 FORMAT "%5.1" /end CHARACTERISTIC
/begin CHARACTERISTIC DSM_FMKDfp_AFSCD_SRCRawAirm_C "Ausblendbedingungen fuer Fehlerpfad Dfp_AFSCD_SRCRawAirm" VALUE 0xC9866 Kw_Wu8 255.0 OneToOne 0.00 255.0 FORMAT "%5.1" /end CHARACTERISTIC
/begin CHARACTERISTIC DSM_FMKDfp_Layer_TUMG_C "Ausblendbedingungen fuer Fehlerpfad Dfp_Layer_TUMG" VALUE 0xC9867 Kw_Wu8 255.0 OneToOne 0.00 255.0 FORMAT "%5.1" /end CHARACTERISTIC
/begin CHARACTERISTIC DSM_FMKDfp_AFSCD_SRCRefSigPer_C "Ausblendbedingungen fuer Fehlerpfad Dfp_AFSCD_SRCRefSigPer" VALUE 0xC9868 Kw_Wu8 255.0 OneToOne 0.00 255.0 FORMAT "%5.1" /end CHARACTERISTIC
/begin CHARACTERISTIC DSM_FMKDfp_AOHtCD_C "Ausblendbedingungen fuer Fehlerpfad Dfp_AOHtCD" VALUE 0xC9869 Kw_Wu8 255.0 OneToOne 0.00 255.0 FORMAT "%5.1" /end CHARACTERISTIC
/begin CHARACTERISTIC DSM_FMKDfp_Layer_GEN_C "Ausblendbedingungen fuer Fehlerpfad Dfp_Layer_GEN" VALUE 0xC986A Kw_Wu8 255.0 OneToOne 0.00 255.0 FORMAT "%5.1" /end CHARACTERISTIC
/begin CHARACTERISTIC DSM_FMKDfp_Layer_BSD_C "Ausblendbedingungen fuer Fehlerpfad Dfp_Layer_BSD" VALUE 0xC986B Kw_Wu8 255.0 OneToOne 0.00 255.0 FORMAT "%5.1" /end CHARACTERISTIC
/begin CHARACTERISTIC DSM_FMKDfp_AOHtCD_AOHtDia1_C "Ausblendbedingungen fuer Fehlerpfad Dfp_AOHtCD_AOHtDia1" VALUE 0xC986C Kw_Wu8 255.0 OneToOne 0.00 255.0 FORMAT "%5.1" /end CHARACTERISTIC
/begin CHARACTERISTIC DSM_FMKDfp_AOHtCD_AOHtDia2_C "Ausblendbedingungen fuer Fehlerpfad Dfp_AOHtCD_AOHtDia2" VALUE 0xC986D Kw_Wu8 255.0 OneToOne 0.00 255.0 FORMAT "%5.1" /end CHARACTERISTIC
/begin CHARACTERISTIC DSM_FMKDfp_AOHtCD_AOHtDia3_C "Ausblendbedingungen fuer Fehlerpfad Dfp_AOHtCD_AOHtDia3" VALUE 0xC986E Kw_Wu8 255.0 OneToOne 0.00 255.0 FORMAT "%5.1" /end CHARACTERISTIC
/begin CHARACTERISTIC DSM_FMKDfp_APP1_C "Ausblendbedingungen fuer Fehlerpfad Dfp_APP1" VALUE 0xC986F Kw_Wu8 255.0 OneToOne 0.00 255.0 FORMAT "%5.1" /end CHARACTERISTIC
/begin CHARACTERISTIC DSM_FMKDfp_APP2_C "Ausblendbedingungen fuer Fehlerpfad Dfp_APP2" VALUE 0xC9870 Kw_Wu8 255.0 OneToOne 0.00 255.0 FORMAT "%5.1" /end CHARACTERISTIC
/begin CHARACTERISTIC DSM_FMKDfp_APPSync_C "Ausblendbedingungen fuer Fehlerpfad Dfp_APPSync" VALUE 0xC9871 Kw_Wu8 255.0 OneToOne 0.00 255.0 FORMAT "%5.1" /end CHARACTERISTIC
/begin CHARACTERISTIC DSM_FMKDfp_APSCD_C "Ausblendbedingungen fuer Fehlerpfad Dfp_APSCD" VALUE 0xC9872 Kw_Wu8 255.0 OneToOne 0.00 255.0 FORMAT "%5.1" /end CHARACTERISTIC
/begin CHARACTERISTIC DSM_FMKDfp_ARS_C "Ausblendbedingungen fuer Fehlerpfad Dfp_ARS" VALUE 0xC9873 Kw_Wu8 255.0 OneToOne 0.00 255.0 FORMAT "%5.1" /end CHARACTERISTIC
/begin CHARACTERISTIC DSM_FMKDfp_AccPedPlausBrk_C "Ausblendbedingungen fuer Fehlerpfad Dfp_AccPedPlausBrk" VALUE 0xC9874 Kw_Wu8 255.0 OneToOne 0.00 255.0 FORMAT "%5.1" /end CHARACTERISTIC
/begin CHARACTERISTIC DSM_FMKDfp_AirCtlGvnrDvtRgnMax_C "Ausblendbedingungen fuer Fehlerpfad Dfp_AirCtlGvnrDvtRgnMax" VALUE 0xC9875 Kw_Wu8 255.0 OneToOne 0.00 255.0 FORMAT "%5.1" /end CHARACTERISTIC
/begin CHARACTERISTIC DSM_FMKDfp_Layer_QLT_C "Ausblendbedingungen fuer Fehlerpfad Dfp_Layer_QLT" VALUE 0xC9876 Kw_Wu8 255.0 OneToOne 0.00 255.0 FORMAT "%5.1" /end CHARACTERISTIC
/begin CHARACTERISTIC DSM_FMKDfp_AirCtlGvnrDvtRgnMax2_C "" VALUE 0xC9877 Kw_Wu8 255.0 OneToOne 0.00 255.0 FORMAT "%5.1" /end CHARACTERISTIC
/begin CHARACTERISTIC DSM_FMKDfp_Layer_IBS1_C "Ausblendbedingungen fuer Fehlerpfad Dfp_Layer_IBS1" VALUE 0xC9878 Kw_Wu8 255.0 OneToOne 0.00 255.0 FORMAT "%5.1" /end CHARACTERISTIC
/begin CHARACTERISTIC DSM_FMKDfp_Layer_IBS2_C "Ausblendbedingungen fuer Fehlerpfad Dfp_Layer_IBS2" VALUE 0xC9879 Kw_Wu8 255.0 OneToOne 0.00 255.0 FORMAT "%5.1" /end CHARACTERISTIC
/begin CHARACTERISTIC DSM_FMKDfp_Layer_IBS3_C "Ausblendbedingungen fuer Fehlerpfad Dfp_Layer_IBS3" VALUE 0xC987A Kw_Wu8 255.0 OneToOne 0.00 255.0 FORMAT "%5.1" /end CHARACTERISTIC
/begin CHARACTERISTIC DSM_FMKDfp_Layer_PMBN_C "Ausblendbedingungen fuer Fehlerpfad Dfp_Layer_PMBN" VALUE 0xC987B Kw_Wu8 255.0 OneToOne 0.00 255.0 FORMAT "%5.1" /end CHARACTERISTIC
/begin CHARACTERISTIC DSM_FMKDfp_Layer_PMBATT_C "Ausblendbedingungen fuer Fehlerpfad Dfp_Layer_PMBATT" VALUE 0xC987C Kw_Wu8 255.0 OneToOne 0.00 255.0 FORMAT "%5.1" /end CHARACTERISTIC
/begin CHARACTERISTIC DSM_FMKDfp_AirCtlGvnrDvtRgnMin_C "Ausblendbedingungen fuer Fehlerpfad Dfp_AirCtlGvnrDvtRgnMin" VALUE 0xC987D Kw_Wu8 255.0 OneToOne 0.00 255.0 FORMAT "%5.1" /end CHARACTERISTIC
/begin CHARACTERISTIC DSM_FMKDfp_AirCtlGvnrDvtRgnMin2_C "" VALUE 0xC987E Kw_Wu8 255.0 OneToOne 0.00 255.0 FORMAT "%5.1" /end CHARACTERISTIC
/begin CHARACTERISTIC DSM_FMKDfp_AirCtlPlateBreak_C "DSM variable for Dfp_AirCtlPlateBreak_mp" VALUE 0xC987F Kw_Wu8 255.0 OneToOne 0.00 255.0 FORMAT "%5.1" /end CHARACTERISTIC
/begin CHARACTERISTIC DSM_FMKDfp_AirCtlRmpTO_C "Ausblendbedingungen fuer Fehlerpfad Dfp_AirCtlRmpTO" VALUE 0xC9880 Kw_Wu8 255.0 OneToOne 0.00 255.0 FORMAT "%5.1" /end CHARACTERISTIC
/begin CHARACTERISTIC DSM_FMKDfp_AirCtl_GovNegDev_C "Ausblendbedingungen fuer Fehlerpfad Dfp_AirCtl_GovNegDev" VALUE 0xC9881 Kw_Wu8 255.0 OneToOne 0.00 255.0 FORMAT "%5.1" /end CHARACTERISTIC
/begin CHARACTERISTIC DSM_FMKDfp_AirCtl_GovNegDev2_C "Ausblendbedingungen fuer Fehlerpfad Dfp_AirCtl_GovNegDev2" VALUE 0xC9882 Kw_Wu8 255.0 OneToOne 0.00 255.0 FORMAT "%5.1" /end CHARACTERISTIC
/begin CHARACTERISTIC DSM_FMKDfp_AirCtl_GovPosDev_C "Ausblendbedingungen fuer Fehlerpfad Dfp_AirCtl_GovPosDev" VALUE 0xC9883 Kw_Wu8 255.0 OneToOne 0.00 255.0 FORMAT "%5.1" /end CHARACTERISTIC
/begin CHARACTERISTIC DSM_FMKDfp_AirCtl_GovPosDev2_C "Ausblendbedingungen fuer Fehlerpfad Dfp_AirCtl_GovPosDev2" VALUE 0xC9884 Kw_Wu8 255.0 OneToOne 0.00 255.0 FORMAT "%5.1" /end CHARACTERISTIC
/begin CHARACTERISTIC DSM_FMKDfp_AltCD_C "Ausblendbedingungen fuer Fehlerpfad Dfp_AltCD" VALUE 0xC9885 Kw_Wu8 255.0 OneToOne 0.00 255.0 FORMAT "%5.1" /end CHARACTERISTIC
/begin CHARACTERISTIC DSM_FMKDfp_AltCD_Load_C "Ausblendbedingungen fuer Fehlerpfad Dfp_AltCD_Load" VALUE 0xC9886 Kw_Wu8 255.0 OneToOne 0.00 255.0 FORMAT "%5.1" /end CHARACTERISTIC
/begin CHARACTERISTIC DSM_FMKDfp_BPACD_BPADia1_C "Ausblendbedingungen fuer Fehlerpfad Dfp_BPACD_BPADia1" VALUE 0xC9887 Kw_Wu8 255.0 OneToOne 0.00 255.0 FORMAT "%5.1" /end CHARACTERISTIC
/begin CHARACTERISTIC DSM_FMKDfp_BPACD_BPADia2_C "Ausblendbedingungen fuer Fehlerpfad Dfp_BPACD_BPADia2" VALUE 0xC9888 Kw_Wu8 255.0 OneToOne 0.00 255.0 FORMAT "%5.1" /end CHARACTERISTIC
/begin CHARACTERISTIC DSM_FMKDfp_BPACD_BPADia3_C "Ausblendbedingungen fuer Fehlerpfad Dfp_BPACD_BPADia3" VALUE 0xC9889 Kw_Wu8 255.0 OneToOne 0.00 255.0 FORMAT "%5.1" /end CHARACTERISTIC
/begin CHARACTERISTIC DSM_FMKDfp_BPACD_Max_C "Ausblendbedingungen fuer Fehlerpfad Dfp_BPACD_Max" VALUE 0xC988A Kw_Wu8 255.0 OneToOne 0.00 255.0 FORMAT "%5.1" /end CHARACTERISTIC
/begin CHARACTERISTIC DSM_FMKDfp_BPACD_Min_C "Ausblendbedingungen fuer Fehlerpfad Dfp_BPACD_Min" VALUE 0xC988B Kw_Wu8 255.0 OneToOne 0.00 255.0 FORMAT "%5.1" /end CHARACTERISTIC
/begin CHARACTERISTIC DSM_FMKDfp_BPACD_SigNpl_C "Ausblendbedingungen fuer Fehlerpfad Dfp_BPACD_SigNpl" VALUE 0xC988C Kw_Wu8 255.0 OneToOne 0.00 255.0 FORMAT "%5.1" /end CHARACTERISTIC
/begin CHARACTERISTIC DSM_FMKDfp_BPSCD_C "Ausblendbedingungen fuer Fehlerpfad Dfp_BPSCD" VALUE 0xC988D Kw_Wu8 255.0 OneToOne 0.00 255.0 FORMAT "%5.1" /end CHARACTERISTIC
/begin CHARACTERISTIC DSM_FMKDfp_BattCD_C "Ausblendbedingungen fuer Fehlerpfad Dfp_BattCD" VALUE 0xC988E Kw_Wu8 255.0 OneToOne 0.00 255.0 FORMAT "%5.1" /end CHARACTERISTIC
/begin CHARACTERISTIC DSM_FMKDfp_BrkCD_C "Ausblendbedingungen fuer Fehlerpfad Dfp_BrkCD" VALUE 0xC988F Kw_Wu8 255.0 OneToOne 0.00 255.0 FORMAT "%5.1" /end CHARACTERISTIC
/begin CHARACTERISTIC DSM_FMKDfp_Bss_C "Ausblendbedingungen fuer Fehlerpfad Dfp_Bss" VALUE 0xC9890 Kw_Wu8 255.0 OneToOne 0.00 255.0 FORMAT "%5.1" /end CHARACTERISTIC
/begin CHARACTERISTIC DSM_FMKDfp_CBACD_C "Ausblendbedingungen fuer Fehlerpfad Dfp_CBACD" VALUE 0xC9891 Kw_Wu8 255.0 OneToOne 0.00 255.0 FORMAT "%5.1" /end CHARACTERISTIC
/begin CHARACTERISTIC DSM_FMKDfp_CTSCD_C "Ausblendbedingungen fuer Fehlerpfad Dfp_CTSCD" VALUE 0xC9892 Kw_Wu8 255.0 OneToOne 0.00 255.0 FORMAT "%5.1" /end CHARACTERISTIC
/begin CHARACTERISTIC DSM_FMKDfp_Clg_DynTst_C "Ausblendbedingungen fuer Fehlerpfad Dfp_Clg_DynTst" VALUE 0xC9893 Kw_Wu8 255.0 OneToOne 0.00 255.0 FORMAT "%5.1" /end CHARACTERISTIC
/begin CHARACTERISTIC DSM_FMKDfp_CmbChbMisfire1_C "Ausblendbedingungen fuer Fehlerpfad Dfp_CmbChbMisfire1" VALUE 0xC9894 Kw_Wu8 255.0 OneToOne 0.00 255.0 FORMAT "%5.1" /end CHARACTERISTIC
/begin CHARACTERISTIC DSM_FMKDfp_CmbChbMisfire2_C "Ausblendbedingungen fuer Fehlerpfad Dfp_CmbChbMisfire2" VALUE 0xC9895 Kw_Wu8 255.0 OneToOne 0.00 255.0 FORMAT "%5.1" /end CHARACTERISTIC
/begin CHARACTERISTIC DSM_FMKDfp_CmbChbMisfire3_C "Ausblendbedingungen fuer Fehlerpfad Dfp_CmbChbMisfire3" VALUE 0xC9896 Kw_Wu8 255.0 OneToOne 0.00 255.0 FORMAT "%5.1" /end CHARACTERISTIC
/begin CHARACTERISTIC DSM_FMKDfp_CmbChbMisfire4_C "Ausblendbedingungen fuer Fehlerpfad Dfp_CmbChbMisfire4" VALUE 0xC9897 Kw_Wu8 255.0 OneToOne 0.00 255.0 FORMAT "%5.1" /end CHARACTERISTIC
/begin CHARACTERISTIC DSM_FMKDfp_CmbChbMisfire5_C "Ausblendbedingungen fuer Fehlerpfad Dfp_CmbChbMisfire5" VALUE 0xC9898 Kw_Wu8 255.0 OneToOne 0.00 255.0 FORMAT "%5.1" /end CHARACTERISTIC
/begin CHARACTERISTIC DSM_FMKDfp_CmbChbMisfire6_C "Ausblendbedingungen fuer Fehlerpfad Dfp_CmbChbMisfire6" VALUE 0xC9899 Kw_Wu8 255.0 OneToOne 0.00 255.0 FORMAT "%5.1" /end CHARACTERISTIC
/begin CHARACTERISTIC DSM_FMKDfp_CmbChbMisfireMul_C "Ausblendbedingungen fuer Fehlerpfad Dfp_CmbChbMisfireMul" VALUE 0xC989A Kw_Wu8 255.0 OneToOne 0.00 255.0 FORMAT "%5.1" /end CHARACTERISTIC
/begin CHARACTERISTIC DSM_FMKDfp_CoVMDCSh_C "Ausblendbedingungen fuer Fehlerpfad Dfp_CoVMDCSh" VALUE 0xC989B Kw_Wu8 255.0 OneToOne 0.00 255.0 FORMAT "%5.1" /end CHARACTERISTIC
/begin CHARACTERISTIC DSM_FMKDfp_ConvCD_C "Ausblendbedingungen fuer Fehlerpfad Dfp_ConvCD" VALUE 0xC989C Kw_Wu8 255.0 OneToOne 0.00 255.0 FORMAT "%5.1" /end CHARACTERISTIC
/begin CHARACTERISTIC DSM_FMKDfp_Layer_PMRUHVERL_C "Ausblendbedingungen fuer Fehlerpfad Dfp_Layer_PMRUHVERL" VALUE 0xC989D Kw_Wu8 255.0 OneToOne 0.00 255.0 FORMAT "%5.1" /end CHARACTERISTIC
/begin CHARACTERISTIC DSM_FMKDfp_CrCCDMFL_C "Ausblendbedingungen fuer Fehlerpfad Dfp_CrCCDMFL" VALUE 0xC989E Kw_Wu8 255.0 OneToOne 0.00 255.0 FORMAT "%5.1" /end CHARACTERISTIC
/begin CHARACTERISTIC DSM_FMKDfp_CrCtl_vCrCtl_C "Ausblendbedingungen fuer Fehlerpfad Dfp_CrCtl_vCrCtl" VALUE 0xC989F Kw_Wu8 255.0 OneToOne 0.00 255.0 FORMAT "%5.1" /end CHARACTERISTIC
/begin CHARACTERISTIC DSM_FMKDfp_DCC_PlausTrqDes_C "Ausblendbedingungen fuer Fehlerpfad Dfp_DCC_PlausTrqDes" VALUE 0xC98A0 Kw_Wu8 255.0 OneToOne 0.00 255.0 FORMAT "%5.1" /end CHARACTERISTIC
/begin CHARACTERISTIC DSM_FMKDfp_Dummy1_C "Ausblendbedingungen fuer Fehlerpfad Dfp_Dummy1" VALUE 0xC98A1 Kw_Wu8 255.0 OneToOne 0.00 255.0 FORMAT "%5.1" /end CHARACTERISTIC
/begin CHARACTERISTIC DSM_FMKDfp_Layer_TOENS_C "Ausblendbedingungen fuer Fehlerpfad Dfp_Layer_TOENS" VALUE 0xC98A2 Kw_Wu8 255.0 OneToOne 0.00 255.0 FORMAT "%5.1" /end CHARACTERISTIC
/begin CHARACTERISTIC DSM_FMKDfp_Layer_MANHYDR_C "Ausblendbedingungen fuer Fehlerpfad Dfp_Layer_MANHYDR" VALUE 0xC98A3 Kw_Wu8 255.0 OneToOne 0.00 255.0 FORMAT "%5.1" /end CHARACTERISTIC
/begin CHARACTERISTIC DSM_FMKDfp_Layer_MANLUFT_C "Ausblendbedingungen fuer Fehlerpfad Dfp_Layer_MANLUFT" VALUE 0xC98A4 Kw_Wu8 255.0 OneToOne 0.00 255.0 FORMAT "%5.1" /end CHARACTERISTIC
/begin CHARACTERISTIC DSM_FMKDfp_EATSCD_C "Ausblendbedingungen fuer Fehlerpfad Dfp_EATSCD" VALUE 0xC98A5 Kw_Wu8 255.0 OneToOne 0.00 255.0 FORMAT "%5.1" /end CHARACTERISTIC
/begin CHARACTERISTIC DSM_FMKDfp_EBAFCD_C "Ausblendbedingungen fuer Fehlerpfad Dfp_EBAFCD" VALUE 0xC98A6 Kw_Wu8 255.0 OneToOne 0.00 255.0 FORMAT "%5.1" /end CHARACTERISTIC
/begin CHARACTERISTIC DSM_FMKDfp_EBFCD_C "Ausblendbedingungen fuer Fehlerpfad Dfp_EBFCD" VALUE 0xC98A7 Kw_Wu8 255.0 OneToOne 0.00 255.0 FORMAT "%5.1" /end CHARACTERISTIC
/begin CHARACTERISTIC DSM_FMKDfp_EBTSCD_C "Ausblendbedingungen fuer Fehlerpfad Dfp_EBTSCD" VALUE 0xC98A8 Kw_Wu8 255.0 OneToOne 0.00 255.0 FORMAT "%5.1" /end CHARACTERISTIC
/begin CHARACTERISTIC DSM_FMKDfp_EBTSCD_OvrTemp_C "Ausblendbedingungen fuer Fehlerpfad Dfp_EBTSCD_OvrTemp" VALUE 0xC98A9 Kw_Wu8 255.0 OneToOne 0.00 255.0 FORMAT "%5.1" /end CHARACTERISTIC
/begin CHARACTERISTIC DSM_FMKDfp_EEPCDVarMng_C "Ausblendbedingungen fuer Fehlerpfad Dfp_EEPCDVarMng" VALUE 0xC98AA Kw_Wu8 255.0 OneToOne 0.00 255.0 FORMAT "%5.1" /end CHARACTERISTIC
/begin CHARACTERISTIC DSM_FMKDfp_EGPpCD_C "Ausblendbedingungen fuer Fehlerpfad Dfp_EGPpCD" VALUE 0xC98AB Kw_Wu8 255.0 OneToOne 0.00 255.0 FORMAT "%5.1" /end CHARACTERISTIC
/begin CHARACTERISTIC DSM_FMKDfp_EGPpCDTPreTrbn_C "Ausblendbedingungen fuer Fehlerpfad Dfp_EgPpCDTPreTrbn" VALUE 0xC98AC Kw_Wu8 255.0 OneToOne 0.00 255.0 FORMAT "%5.1" /end CHARACTERISTIC
/begin CHARACTERISTIC DSM_FMKDfp_EGRCD_Max_C "Ausblendbedingungen fuer Fehlerpfad Dfp_EGRCD_Max" VALUE 0xC98AD Kw_Wu8 255.0 OneToOne 0.00 255.0 FORMAT "%5.1" /end CHARACTERISTIC
/begin CHARACTERISTIC DSM_FMKDfp_EGRCD_Min_C "Ausblendbedingungen fuer Fehlerpfad Dfp_EGRCD_Min" VALUE 0xC98AE Kw_Wu8 255.0 OneToOne 0.00 255.0 FORMAT "%5.1" /end CHARACTERISTIC
/begin CHARACTERISTIC DSM_FMKDfp_EGRCD_SigNpl_C "Ausblendbedingungen fuer Fehlerpfad Dfp_EGRCD_SigNpl" VALUE 0xC98AF Kw_Wu8 255.0 OneToOne 0.00 255.0 FORMAT "%5.1" /end CHARACTERISTIC
/begin CHARACTERISTIC DSM_FMKDfp_EGTRgnOilDil_C "Ausblendbedingungen fuer Fehlerpfad Dfp_EGTRgnOilDil" VALUE 0xC98B0 Kw_Wu8 255.0 OneToOne 0.00 255.0 FORMAT "%5.1" /end CHARACTERISTIC
/begin CHARACTERISTIC DSM_FMKDfp_EMCCDNoLoad1_C "Ausblendbedingungen fuer Fehlerpfad Dfp_EMCCDNoLoad1" VALUE 0xC98B1 Kw_Wu8 255.0 OneToOne 0.00 255.0 FORMAT "%5.1" /end CHARACTERISTIC
/begin CHARACTERISTIC DSM_FMKDfp_EMCCDNoLoad2_C "Ausblendbedingungen fuer Fehlerpfad Dfp_EMCCDNoLoad2" VALUE 0xC98B2 Kw_Wu8 255.0 OneToOne 0.00 255.0 FORMAT "%5.1" /end CHARACTERISTIC
/begin CHARACTERISTIC DSM_FMKDfp_EMCCDSCBat1_C "Ausblendbedingungen fuer Fehlerpfad Dfp_EMCCDSCBat1" VALUE 0xC98B3 Kw_Wu8 255.0 OneToOne 0.00 255.0 FORMAT "%5.1" /end CHARACTERISTIC
/begin CHARACTERISTIC DSM_FMKDfp_EMCCDSCBat2_C "Ausblendbedingungen fuer Fehlerpfad Dfp_EMCCDSCBat2" VALUE 0xC98B4 Kw_Wu8 255.0 OneToOne 0.00 255.0 FORMAT "%5.1" /end CHARACTERISTIC
/begin CHARACTERISTIC DSM_FMKDfp_EMCCDSCGnd1_C "Ausblendbedingungen fuer Fehlerpfad Dfp_EMCCDSCGnd1" VALUE 0xC98B5 Kw_Wu8 255.0 OneToOne 0.00 255.0 FORMAT "%5.1" /end CHARACTERISTIC
/begin CHARACTERISTIC DSM_FMKDfp_EMCCDSCGnd2_C "Ausblendbedingungen fuer Fehlerpfad Dfp_EMCCDSCGnd2" VALUE 0xC98B6 Kw_Wu8 255.0 OneToOne 0.00 255.0 FORMAT "%5.1" /end CHARACTERISTIC
/begin CHARACTERISTIC DSM_FMKDfp_EMCCD_ADC1_C "Ausblendbedingungen fuer Fehlerpfad Dfp_EMCCD_ADC1" VALUE 0xC98B7 Kw_Wu8 255.0 OneToOne 0.00 255.0 FORMAT "%5.1" /end CHARACTERISTIC
/begin CHARACTERISTIC DSM_FMKDfp_EMCCD_ADC2_C "Ausblendbedingungen fuer Fehlerpfad Dfp_EMCCD_ADC2" VALUE 0xC98B8 Kw_Wu8 255.0 OneToOne 0.00 255.0 FORMAT "%5.1" /end CHARACTERISTIC
/begin CHARACTERISTIC DSM_FMKDfp_ETClbETFltInj1_C "Ausblendbedingungen fuer Fehlerpfad Dfp_ETClbETFltInj1" VALUE 0xC98B9 Kw_Wu8 255.0 OneToOne 0.00 255.0 FORMAT "%5.1" /end CHARACTERISTIC
/begin CHARACTERISTIC DSM_FMKDfp_ETClbETFltInj2_C "Ausblendbedingungen fuer Fehlerpfad Dfp_ETClbETFltInj2" VALUE 0xC98BA Kw_Wu8 255.0 OneToOne 0.00 255.0 FORMAT "%5.1" /end CHARACTERISTIC
/begin CHARACTERISTIC DSM_FMKDfp_ETClbETFltInj3_C "Ausblendbedingungen fuer Fehlerpfad Dfp_ETClbETFltInj3" VALUE 0xC98BB Kw_Wu8 255.0 OneToOne 0.00 255.0 FORMAT "%5.1" /end CHARACTERISTIC
/begin CHARACTERISTIC DSM_FMKDfp_ETClbETFltInj4_C "Ausblendbedingungen fuer Fehlerpfad Dfp_ETClbETFltInj4" VALUE 0xC98BC Kw_Wu8 255.0 OneToOne 0.00 255.0 FORMAT "%5.1" /end CHARACTERISTIC
/begin CHARACTERISTIC DSM_FMKDfp_ETClbETFltInj5_C "Ausblendbedingungen fuer Fehlerpfad Dfp_ETClbETFltInj5" VALUE 0xC98BD Kw_Wu8 255.0 OneToOne 0.00 255.0 FORMAT "%5.1" /end CHARACTERISTIC
/begin CHARACTERISTIC DSM_FMKDfp_ETClbETFltInj6_C "Ausblendbedingungen fuer Fehlerpfad Dfp_ETClbETFltInj6" VALUE 0xC98BE Kw_Wu8 255.0 OneToOne 0.00 255.0 FORMAT "%5.1" /end CHARACTERISTIC
/begin CHARACTERISTIC DSM_FMKDfp_ETClbInj1_C "Ausblendbedingungen fuer Fehlerpfad Dfp_ETClbInj1" VALUE 0xC98BF Kw_Wu8 255.0 OneToOne 0.00 255.0 FORMAT "%5.1" /end CHARACTERISTIC
/begin CHARACTERISTIC DSM_FMKDfp_ETClbInj2_C "Ausblendbedingungen fuer Fehlerpfad Dfp_ETClbInj2" VALUE 0xC98C0 Kw_Wu8 255.0 OneToOne 0.00 255.0 FORMAT "%5.1" /end CHARACTERISTIC
/begin CHARACTERISTIC DSM_FMKDfp_ETClbInj3_C "Ausblendbedingungen fuer Fehlerpfad Dfp_ETClbInj3" VALUE 0xC98C1 Kw_Wu8 255.0 OneToOne 0.00 255.0 FORMAT "%5.1" /end CHARACTERISTIC
/begin CHARACTERISTIC DSM_FMKDfp_ETClbInj4_C "Ausblendbedingungen fuer Fehlerpfad Dfp_ETClbInj4" VALUE 0xC98C2 Kw_Wu8 255.0 OneToOne 0.00 255.0 FORMAT "%5.1" /end CHARACTERISTIC
/begin CHARACTERISTIC DSM_FMKDfp_ETClbInj5_C "Ausblendbedingungen fuer Fehlerpfad Dfp_ETClbInj5" VALUE 0xC98C3 Kw_Wu8 255.0 OneToOne 0.00 255.0 FORMAT "%5.1" /end CHARACTERISTIC
/begin CHARACTERISTIC DSM_FMKDfp_ETClbInj6_C "Ausblendbedingungen fuer Fehlerpfad Dfp_ETClbInj6" VALUE 0xC98C4 Kw_Wu8 255.0 OneToOne 0.00 255.0 FORMAT "%5.1" /end CHARACTERISTIC
/begin CHARACTERISTIC DSM_FMKDfp_EngMCaS1_C "Ausblendbedingungen fuer Fehlerpfad Dfp_EngMCaS1" VALUE 0xC98C5 Kw_Wu8 255.0 OneToOne 0.00 255.0 FORMAT "%5.1" /end CHARACTERISTIC
/begin CHARACTERISTIC DSM_FMKDfp_EngMCrS1_C "Ausblendbedingungen fuer Fehlerpfad Dfp_EngMCrS1" VALUE 0xC98C6 Kw_Wu8 255.0 OneToOne 0.00 255.0 FORMAT "%5.1" /end CHARACTERISTIC
/begin CHARACTERISTIC DSM_FMKDfp_EngMOfsCaSCrS_C "Ausblendbedingungen fuer Fehlerpfad Dfp_EngMOfsCaSCrS" VALUE 0xC98C7 Kw_Wu8 255.0 OneToOne 0.00 255.0 FORMAT "%5.1" /end CHARACTERISTIC
/begin CHARACTERISTIC DSM_FMKDfp_EngPrtFWODet_C "Ausblendbedingungen fuer Fehlerpfad Dfp_EngPrtFWODet" VALUE 0xC98C8 Kw_Wu8 255.0 OneToOne 0.00 255.0 FORMAT "%5.1" /end CHARACTERISTIC
/begin CHARACTERISTIC DSM_FMKDfp_FBCqDvt_C "Ausblendbedingungen fuer Fehlerpfad Dfp_FBCqDvt" VALUE 0xC98C9 Kw_Wu8 255.0 OneToOne 0.00 255.0 FORMAT "%5.1" /end CHARACTERISTIC
/begin CHARACTERISTIC DSM_FMKDfp_FMTC_NonMonotonMap_C "Ausblendbedingungen fuer Fehlerpfad Dfp_FMTC_NonMonotonMap" VALUE 0xC98CA Kw_Wu8 255.0 OneToOne 0.00 255.0 FORMAT "%5.1" /end CHARACTERISTIC
/begin CHARACTERISTIC DSM_FMKDfp_FTSCD_C "Ausblendbedingungen fuer Fehlerpfad Dfp_FTSCD" VALUE 0xC98CB Kw_Wu8 255.0 OneToOne 0.00 255.0 FORMAT "%5.1" /end CHARACTERISTIC
/begin CHARACTERISTIC DSM_FMKDfp_FanCD_C "Ausblendbedingungen fuer Fehlerpfad Dfp_FanCD" VALUE 0xC98CC Kw_Wu8 255.0 OneToOne 0.00 255.0 FORMAT "%5.1" /end CHARACTERISTIC
/begin CHARACTERISTIC DSM_FMKDfp_FanCD_FanCtlr1_C "Ausblendbedingungen fuer Fehlerpfad Dfp_FanCD_FanCtlr1" VALUE 0xC98CD Kw_Wu8 255.0 OneToOne 0.00 255.0 FORMAT "%5.1" /end CHARACTERISTIC
/begin CHARACTERISTIC DSM_FMKDfp_FanCD_FanCtlr2_C "Ausblendbedingungen fuer Fehlerpfad Dfp_FanCD_FanCtlr2" VALUE 0xC98CE Kw_Wu8 255.0 OneToOne 0.00 255.0 FORMAT "%5.1" /end CHARACTERISTIC
/begin CHARACTERISTIC DSM_FMKDfp_FanCD_FanCtlr3_C "Ausblendbedingungen fuer Fehlerpfad Dfp_FanCD_FanCtlr3" VALUE 0xC98CF Kw_Wu8 255.0 OneToOne 0.00 255.0 FORMAT "%5.1" /end CHARACTERISTIC
/begin CHARACTERISTIC DSM_FMKDfp_FlFCD_C "Ausblendbedingungen fuer Fehlerpfad Dfp_FlFCD" VALUE 0xC98D0 Kw_Wu8 255.0 OneToOne 0.00 255.0 FORMAT "%5.1" /end CHARACTERISTIC
/begin CHARACTERISTIC DSM_FMKDfp_FlMngSmkDefect_C "Ausblendbedingungen fuer Fehlerpfad Dfp_FlMngSmkDefect" VALUE 0xC98D1 Kw_Wu8 255.0 OneToOne 0.00 255.0 FORMAT "%5.1" /end CHARACTERISTIC
/begin CHARACTERISTIC DSM_FMKDfp_FrmMngANFRADMOMPT_C "Ausblendbedingungen fuer Fehlerpfad Dfp_FrmMngANFRADMOMPT" VALUE 0xC98D2 Kw_Wu8 255.0 OneToOne 0.00 255.0 FORMAT "%5.1" /end CHARACTERISTIC
/begin CHARACTERISTIC DSM_FMKDfp_FrmMngASC1_C "Ausblendbedingungen fuer Fehlerpfad Dfp_FrmMngASC1" VALUE 0xC98D3 Kw_Wu8 255.0 OneToOne 0.00 255.0 FORMAT "%5.1" /end CHARACTERISTIC
/begin CHARACTERISTIC DSM_FMKDfp_FrmMngASC2_C "Ausblendbedingungen fuer Fehlerpfad Dfp_FrmMngASC2" VALUE 0xC98D4 Kw_Wu8 255.0 OneToOne 0.00 255.0 FORMAT "%5.1" /end CHARACTERISTIC
/begin CHARACTERISTIC DSM_FMKDfp_FrmMngASC3_C "Ausblendbedingungen fuer Fehlerpfad Dfp_FrmMngASC3" VALUE 0xC98D5 Kw_Wu8 255.0 OneToOne 0.00 255.0 FORMAT "%5.1" /end CHARACTERISTIC
/begin CHARACTERISTIC DSM_FMKDfp_FrmMngASC4_C "Ausblendbedingungen fuer Fehlerpfad Dfp_FrmMngASC4" VALUE 0xC98D6 Kw_Wu8 255.0 OneToOne 0.00 255.0 FORMAT "%5.1" /end CHARACTERISTIC
/begin CHARACTERISTIC DSM_FMKDfp_FrmMngBOS_RESET_C "Ausblendbedingungen fuer Fehlerpfad Dfp_FrmMngBOS_RESET" VALUE 0xC98D7 Kw_Wu8 255.0 OneToOne 0.00 255.0 FORMAT "%5.1" /end CHARACTERISTIC
/begin CHARACTERISTIC DSM_FMKDfp_FrmMngBOS_RESET_2_C "" VALUE 0xC98D8 Kw_Wu8 255.0 OneToOne 0.00 255.0 FORMAT "%5.1" /end CHARACTERISTIC
/begin CHARACTERISTIC DSM_FMKDfp_FrmMngDMANFAFS_C "Ausblendbedingungen fuer Fehlerpfad Dfp_FrmMngDMANFAFS" VALUE 0xC98D9 Kw_Wu8 255.0 OneToOne 0.00 255.0 FORMAT "%5.1" /end CHARACTERISTIC
/begin CHARACTERISTIC DSM_FMKDfp_FrmMngDRMANFSSG_C "Ausblendbedingungen fuer Fehlerpfad Dfp_FrmMngDRMANFSSG" VALUE 0xC98DA Kw_Wu8 255.0 OneToOne 0.00 255.0 FORMAT "%5.1" /end CHARACTERISTIC
/begin CHARACTERISTIC DSM_FMKDfp_FrmMngEGS1_C "Ausblendbedingungen fuer Fehlerpfad Dfp_FrmMngEGS1" VALUE 0xC98DB Kw_Wu8 255.0 OneToOne 0.00 255.0 FORMAT "%5.1" /end CHARACTERISTIC
/begin CHARACTERISTIC DSM_FMKDfp_FrmMngEGS2_C "Ausblendbedingungen fuer Fehlerpfad Dfp_FrmMngEGS2" VALUE 0xC98DC Kw_Wu8 255.0 OneToOne 0.00 255.0 FORMAT "%5.1" /end CHARACTERISTIC
/begin CHARACTERISTIC DSM_FMKDfp_FrmMngGEARBX_DATA_C "Ausblendbedingungen fuer Fehlerpfad Dfp_FrmMngGEARBX_DATA" VALUE 0xC98DD Kw_Wu8 255.0 OneToOne 0.00 255.0 FORMAT "%5.1" /end CHARACTERISTIC
/begin CHARACTERISTIC DSM_FMKDfp_FrmMngGEARBX_DATA2_C "Ausblendbedingungen fuer Fehlerpfad Dfp_FrmMngGEARBX_DATA2" VALUE 0xC98DE Kw_Wu8 255.0 OneToOne 0.00 255.0 FORMAT "%5.1" /end CHARACTERISTIC
/begin CHARACTERISTIC DSM_FMKDfp_FrmMngHEAT_AC_C "Ausblendbedingungen fuer Fehlerpfad Dfp_FrmMngHEAT_AC" VALUE 0xC98DF Kw_Wu8 255.0 OneToOne 0.00 255.0 FORMAT "%5.1" /end CHARACTERISTIC
/begin CHARACTERISTIC DSM_FMKDfp_FrmMngINSTR2_C "Ausblendbedingungen fuer Fehlerpfad Dfp_FrmMngINSTR2" VALUE 0xC98E0 Kw_Wu8 255.0 OneToOne 0.00 255.0 FORMAT "%5.1" /end CHARACTERISTIC
/begin CHARACTERISTIC DSM_FMKDfp_FrmMngINSTR3_C "Ausblendbedingungen fuer Fehlerpfad Dfp_FrmMngINSTR3" VALUE 0xC98E1 Kw_Wu8 255.0 OneToOne 0.00 255.0 FORMAT "%5.1" /end CHARACTERISTIC
/begin CHARACTERISTIC DSM_FMKDfp_FrmMngLENKRADWINKEL_C "Ausblendbedingungen fuer Fehlerpfad Dfp_FrmMngLENKRADWINKEL" VALUE 0xC98E2 Kw_Wu8 255.0 OneToOne 0.00 255.0 FORMAT "%5.1" /end CHARACTERISTIC
/begin CHARACTERISTIC DSM_FMKDfp_FrmMngMILEAGE_RANGE_C "Ausblendbedingungen fuer Fehlerpfad Dfp_FrmMngMILEAGE_RANGE" VALUE 0xC98E3 Kw_Wu8 255.0 OneToOne 0.00 255.0 FORMAT "%5.1" /end CHARACTERISTIC
/begin CHARACTERISTIC DSM_FMKDfp_FrmMngOPCRCTLACC_C "Ausblendbedingungen fuer Fehlerpfad Dfp_FrmMngOPCRCTLACC" VALUE 0xC98E4 Kw_Wu8 255.0 OneToOne 0.00 255.0 FORMAT "%5.1" /end CHARACTERISTIC
/begin CHARACTERISTIC DSM_FMKDfp_FrmMngPRGG_CCTR_C "Ausblendbedingungen fuer Fehlerpfad Dfp_FrmMngPRGG_CCTR" VALUE 0xC98E5 Kw_Wu8 255.0 OneToOne 0.00 255.0 FORMAT "%5.1" /end CHARACTERISTIC
/begin CHARACTERISTIC DSM_FMKDfp_FrmMngPWRMNG_LOADV_C "Ausblendbedingungen fuer Fehlerpfad Dfp_FrmMngPWRMNG_LOADV" VALUE 0xC98E6 Kw_Wu8 255.0 OneToOne 0.00 255.0 FORMAT "%5.1" /end CHARACTERISTIC
/begin CHARACTERISTIC DSM_FMKDfp_FrmMngParkConsumer_C "Ausblendbedingungen fuer Fehlerpfad Dfp_FrmMngParkConsumer" VALUE 0xC98E7 Kw_Wu8 255.0 OneToOne 0.00 255.0 FORMAT "%5.1" /end CHARACTERISTIC
/begin CHARACTERISTIC DSM_FMKDfp_FrmMngRQSTGEFAN_C "RQ_STG_EFAN - CAN-message related errors" VALUE 0xC98E8 Kw_Wu8 255.0 OneToOne 0.00 255.0 FORMAT "%5.1" /end CHARACTERISTIC
/begin CHARACTERISTIC DSM_FMKDfp_FrmMngSSGErr_C "Ausblendbedingungen fuer Fehlerpfad Dfp_FrmMngSSGErr" VALUE 0xC98E9 Kw_Wu8 255.0 OneToOne 0.00 255.0 FORMAT "%5.1" /end CHARACTERISTIC
/begin CHARACTERISTIC DSM_FMKDfp_FrmMngSSGShOff_C "Ausblendbedingungen fuer Fehlerpfad Dfp_FrmMngSSGShOff" VALUE 0xC98EA Kw_Wu8 255.0 OneToOne 0.00 255.0 FORMAT "%5.1" /end CHARACTERISTIC
/begin CHARACTERISTIC DSM_FMKDfp_FrmMngSTAT_ANH_C "Ausblendbedingungen fuer Fehlerpfad Dfp_FrmMngSTAT_ANH" VALUE 0xC98EB Kw_Wu8 255.0 OneToOne 0.00 255.0 FORMAT "%5.1" /end CHARACTERISTIC
/begin CHARACTERISTIC DSM_FMKDfp_FrmMngSTAT_ARS_C "Ausblendbedingungen fuer Fehlerpfad Dfp_FrmMngSTAT_ARS" VALUE 0xC98EC Kw_Wu8 255.0 OneToOne 0.00 255.0 FORMAT "%5.1" /end CHARACTERISTIC
/begin CHARACTERISTIC DSM_FMKDfp_FrmMngSTAT_DSC_C "Ausblendbedingungen fuer Fehlerpfad Dfp_FrmMngSTAT_DSC" VALUE 0xC98ED Kw_Wu8 255.0 OneToOne 0.00 255.0 FORMAT "%5.1" /end CHARACTERISTIC
/begin CHARACTERISTIC DSM_FMKDfp_FrmMngSTAT_EKP_C "Ausblendbedingungen fuer Fehlerpfad Dfp_FrmMngSTAT_EKP" VALUE 0xC98EE Kw_Wu8 255.0 OneToOne 0.00 255.0 FORMAT "%5.1" /end CHARACTERISTIC
/begin CHARACTERISTIC DSM_FMKDfp_FrmMngSTAT_KOMBI_C "Ausblendbedingungen fuer Fehlerpfad Dfp_FrmMngSTAT_KOMBI" VALUE 0xC98EF Kw_Wu8 255.0 OneToOne 0.00 255.0 FORMAT "%5.1" /end CHARACTERISTIC
/begin CHARACTERISTIC DSM_FMKDfp_FrmMngSTAT_SITZ_C "Ausblendbedingungen fuer Fehlerpfad  Dfp_FrmMngSTAT_SITZ" VALUE 0xC98F0 Kw_Wu8 255.0 OneToOne 0.00 255.0 FORMAT "%5.1" /end CHARACTERISTIC
/begin CHARACTERISTIC DSM_FMKDfp_FrmMngStOBDGbxMilOf_C "Ausblendbedingungen fuer Fehlerpfad Dfp_FrmMngStOBDGbxMilOf" VALUE 0xC98F1 Kw_Wu8 255.0 OneToOne 0.00 255.0 FORMAT "%5.1" /end CHARACTERISTIC
/begin CHARACTERISTIC DSM_FMKDfp_FrmMngStOBDGbxMilOn_C "Ausblendbedingungen fuer Fehlerpfad Dfp_FrmMngStOBDGbxMilOn" VALUE 0xC98F2 Kw_Wu8 255.0 OneToOne 0.00 255.0 FORMAT "%5.1" /end CHARACTERISTIC
/begin CHARACTERISTIC DSM_FMKDfp_FrmMngTEMPRELTIME_C "Ausblendbedingungen fuer Fehlerpfad Dfp_FrmMngTEMPRELTIME" VALUE 0xC98F3 Kw_Wu8 255.0 OneToOne 0.00 255.0 FORMAT "%5.1" /end CHARACTERISTIC
/begin CHARACTERISTIC DSM_FMKDfp_FrmMngTERMINAL_C "Ausblendbedingungen fuer Fehlerpfad Dfp_FrmMngTERMINAL" VALUE 0xC98F4 Kw_Wu8 255.0 OneToOne 0.00 255.0 FORMAT "%5.1" /end CHARACTERISTIC
/begin CHARACTERISTIC DSM_FMKDfp_FrmMngTIME_DATE_C "Ausblendbedingungen fuer Fehlerpfad Dfp_FrmMngTIME_DATE" VALUE 0xC98F5 Kw_Wu8 255.0 OneToOne 0.00 255.0 FORMAT "%5.1" /end CHARACTERISTIC
/begin CHARACTERISTIC DSM_FMKDfp_FrmMngTORQUE_DSC_C "Ausblendbedingungen fuer Fehlerpfad Dfp_FrmMngTORQUE_DSC" VALUE 0xC98F6 Kw_Wu8 255.0 OneToOne 0.00 255.0 FORMAT "%5.1" /end CHARACTERISTIC
/begin CHARACTERISTIC DSM_FMKDfp_FrmMngTORQUE_GEARBX_C "Ausblendbedingungen fuer Fehlerpfad Dfp_FrmMngTORQUE_GEARBX" VALUE 0xC98F7 Kw_Wu8 255.0 OneToOne 0.00 255.0 FORMAT "%5.1" /end CHARACTERISTIC
/begin CHARACTERISTIC DSM_FMKDfp_FrmMngTrq_ReqACC_C "Ausblendbedingungen fuer Fehlerpfad Dfp_FrmMngTrq_ReqACC" VALUE 0xC98F8 Kw_Wu8 255.0 OneToOne 0.00 255.0 FORMAT "%5.1" /end CHARACTERISTIC
/begin CHARACTERISTIC DSM_FMKDfp_FrmMngVEH_MOD_C "VEH_MOD - CAN-message related errors" VALUE 0xC98F9 Kw_Wu8 255.0 OneToOne 0.00 255.0 FORMAT "%5.1" /end CHARACTERISTIC
/begin CHARACTERISTIC DSM_FMKDfp_FrmMngVELOCITY_C "Ausblendbedingungen fuer Fehlerpfad Dfp_FrmMngVELOCITY" VALUE 0xC98FA Kw_Wu8 255.0 OneToOne 0.00 255.0 FORMAT "%5.1" /end CHARACTERISTIC
/begin CHARACTERISTIC DSM_FMKDfp_FrmMngWHEEL_SPEED_C "Ausblendbedingungen fuer Fehlerpfad Dfp_FrmMngWHEEL_SPEED" VALUE 0xC98FB Kw_Wu8 255.0 OneToOne 0.00 255.0 FORMAT "%5.1" /end CHARACTERISTIC
/begin CHARACTERISTIC DSM_FMKDfp_FrmMngstCurr_C "Maskenlabel für Dfp_FrmMngstCurr" VALUE 0xC98FC Kw_Wu8 255.0 OneToOne 0.00 255.0 FORMAT "%5.1" /end CHARACTERISTIC
/begin CHARACTERISTIC DSM_FMKDfp_FrmMngswtPSPOff_C "Maskenlabel für Dfp_FrmMngswtPSPOff" VALUE 0xC98FD Kw_Wu8 255.0 OneToOne 0.00 255.0 FORMAT "%5.1" /end CHARACTERISTIC
/begin CHARACTERISTIC DSM_FMKDfp_GearbxIncMax_C "Ausblendbedingungen fuer Fehlerpfad Dfp_GearbxIncMax" VALUE 0xC98FE Kw_Wu8 255.0 OneToOne 0.00 255.0 FORMAT "%5.1" /end CHARACTERISTIC
/begin CHARACTERISTIC DSM_FMKDfp_GlwCD_C "Ausblendbedingungen fuer Fehlerpfad Dfp_GlwCD" VALUE 0xC98FF Kw_Wu8 255.0 OneToOne 0.00 255.0 FORMAT "%5.1" /end CHARACTERISTIC
/begin CHARACTERISTIC DSM_FMKDfp_GlwCDGlwCirc1_C "Ausblendbedingungen fuer Fehlerpfad Dfp_GlwCDGlwCirc1" VALUE 0xC9900 Kw_Wu8 255.0 OneToOne 0.00 255.0 FORMAT "%5.1" /end CHARACTERISTIC
/begin CHARACTERISTIC DSM_FMKDfp_GlwCDGlwCirc2_C "Ausblendbedingungen fuer Fehlerpfad Dfp_GlwCDGlwCirc2" VALUE 0xC9901 Kw_Wu8 255.0 OneToOne 0.00 255.0 FORMAT "%5.1" /end CHARACTERISTIC
/begin CHARACTERISTIC DSM_FMKDfp_GlwCDGlwCirc3_C "Ausblendbedingungen fuer Fehlerpfad Dfp_GlwCDGlwCirc3" VALUE 0xC9902 Kw_Wu8 255.0 OneToOne 0.00 255.0 FORMAT "%5.1" /end CHARACTERISTIC
/begin CHARACTERISTIC DSM_FMKDfp_GlwCDGlwCirc4_C "Ausblendbedingungen fuer Fehlerpfad Dfp_GlwCDGlwCirc4" VALUE 0xC9903 Kw_Wu8 255.0 OneToOne 0.00 255.0 FORMAT "%5.1" /end CHARACTERISTIC
/begin CHARACTERISTIC DSM_FMKDfp_GlwCDGlwCirc5_C "Ausblendbedingungen fuer Fehlerpfad Dfp_GlwCDGlwCirc5" VALUE 0xC9904 Kw_Wu8 255.0 OneToOne 0.00 255.0 FORMAT "%5.1" /end CHARACTERISTIC
/begin CHARACTERISTIC DSM_FMKDfp_GlwCDGlwCirc6_C "Ausblendbedingungen fuer Fehlerpfad Dfp_GlwCDGlwCirc6" VALUE 0xC9905 Kw_Wu8 255.0 OneToOne 0.00 255.0 FORMAT "%5.1" /end CHARACTERISTIC
/begin CHARACTERISTIC DSM_FMKDfp_GlwCDGlwCirc7_C "Ausblendbedingungen fuer Fehlerpfad Dfp_GlwCDGlwCirc7" VALUE 0xC9906 Kw_Wu8 255.0 OneToOne 0.00 255.0 FORMAT "%5.1" /end CHARACTERISTIC
/begin CHARACTERISTIC DSM_FMKDfp_GlwCDGlwCirc8_C "Ausblendbedingungen fuer Fehlerpfad Dfp_GlwCDGlwCirc8" VALUE 0xC9907 Kw_Wu8 255.0 OneToOne 0.00 255.0 FORMAT "%5.1" /end CHARACTERISTIC
/begin CHARACTERISTIC DSM_FMKDfp_GlwCtl_C "Ausblendbedingungen fuer Fehlerpfad Dfp_GlwCtl" VALUE 0xC9908 Kw_Wu8 255.0 OneToOne 0.00 255.0 FORMAT "%5.1" /end CHARACTERISTIC
/begin CHARACTERISTIC DSM_FMKDfp_HWEMonCom_C "Ausblendbedingungen fuer Fehlerpfad Dfp_HWEMonCom" VALUE 0xC9909 Kw_Wu8 255.0 OneToOne 0.00 255.0 FORMAT "%5.1" /end CHARACTERISTIC
/begin CHARACTERISTIC DSM_FMKDfp_HWEMonEEPROM_C "Ausblendbedingungen fuer Fehlerpfad Dfp_HWEMonEEPROM" VALUE 0xC990A Kw_Wu8 255.0 OneToOne 0.00 255.0 FORMAT "%5.1" /end CHARACTERISTIC
/begin CHARACTERISTIC DSM_FMKDfp_HWEMonRcyLocked_C "Ausblendbedingungen fuer Fehlerpfad Dfp_HWEMonRcyLocked" VALUE 0xC990B Kw_Wu8 255.0 OneToOne 0.00 255.0 FORMAT "%5.1" /end CHARACTERISTIC
/begin CHARACTERISTIC DSM_FMKDfp_HWEMonRcySuppressed_C "Ausblendbedingungen fuer Fehlerpfad Dfp_HWEMonRcySuppressed" VALUE 0xC990C Kw_Wu8 255.0 OneToOne 0.00 255.0 FORMAT "%5.1" /end CHARACTERISTIC
/begin CHARACTERISTIC DSM_FMKDfp_HWEMonRcyVisible_C "Ausblendbedingungen fuer Fehlerpfad Dfp_HWEMonRcyVisible" VALUE 0xC990D Kw_Wu8 255.0 OneToOne 0.00 255.0 FORMAT "%5.1" /end CHARACTERISTIC
/begin CHARACTERISTIC DSM_FMKDfp_HWEMonUMaxSupply_C "Ausblendbedingungen fuer Fehlerpfad Dfp_HWEMonUMaxSupply" VALUE 0xC990E Kw_Wu8 255.0 OneToOne 0.00 255.0 FORMAT "%5.1" /end CHARACTERISTIC
/begin CHARACTERISTIC DSM_FMKDfp_HWEMonUMinSupply_C "Ausblendbedingungen fuer Fehlerpfad Dfp_HWEMonUMinSupply" VALUE 0xC990F Kw_Wu8 255.0 OneToOne 0.00 255.0 FORMAT "%5.1" /end CHARACTERISTIC
/begin CHARACTERISTIC DSM_FMKDfp_IATSCD_C "Ausblendbedingungen fuer Fehlerpfad Dfp_IATSCD" VALUE 0xC9910 Kw_Wu8 255.0 OneToOne 0.00 255.0 FORMAT "%5.1" /end CHARACTERISTIC
/begin CHARACTERISTIC DSM_FMKDfp_IATSCD_CATS_C "Ausblendbedingungen fuer Fehlerpfad Dfp_IATSCD_CATS" VALUE 0xC9911 Kw_Wu8 255.0 OneToOne 0.00 255.0 FORMAT "%5.1" /end CHARACTERISTIC
/begin CHARACTERISTIC DSM_FMKDfp_ImmCtlImmCD_C "Ausblendbedingungen fuer Fehlerpfad Dfp_ImmCtlImmCD" VALUE 0xC9912 Kw_Wu8 255.0 OneToOne 0.00 255.0 FORMAT "%5.1" /end CHARACTERISTIC
/begin CHARACTERISTIC DSM_FMKDfp_ImmCtlImmEep_C "Ausblendbedingungen fuer Fehlerpfad Dfp_ImmCtlImmEep" VALUE 0xC9913 Kw_Wu8 255.0 OneToOne 0.00 255.0 FORMAT "%5.1" /end CHARACTERISTIC
/begin CHARACTERISTIC DSM_FMKDfp_ImmCtlMpl_C "Ausblendbedingungen fuer Fehlerpfad Dfp_ImmCtlMpl" VALUE 0xC9914 Kw_Wu8 255.0 OneToOne 0.00 255.0 FORMAT "%5.1" /end CHARACTERISTIC
/begin CHARACTERISTIC DSM_FMKDfp_IndSys1_C "Ausblendbedingungen fuer Fehlerpfad Dfp_IndSys1" VALUE 0xC9915 Kw_Wu8 255.0 OneToOne 0.00 255.0 FORMAT "%5.1" /end CHARACTERISTIC
/begin CHARACTERISTIC DSM_FMKDfp_IndSys2_C "Ausblendbedingungen fuer Fehlerpfad Dfp_IndSys2" VALUE 0xC9916 Kw_Wu8 255.0 OneToOne 0.00 255.0 FORMAT "%5.1" /end CHARACTERISTIC
/begin CHARACTERISTIC DSM_FMKDfp_InjCrv_InjLim_C "Ausblendbedingungen fuer Fehlerpfad Dfp_InjCrv_InjLim" VALUE 0xC9917 Kw_Wu8 255.0 OneToOne 0.00 255.0 FORMAT "%5.1" /end CHARACTERISTIC
/begin CHARACTERISTIC DSM_FMKDfp_InjCtlAdjQnt_C "Ausblendbedingungen fuer Fehlerpfad Dfp_InjCtlAdjQnt" VALUE 0xC9918 Kw_Wu8 255.0 OneToOne 0.00 255.0 FORMAT "%5.1" /end CHARACTERISTIC
/begin CHARACTERISTIC DSM_FMKDfp_InjCtlDrift_C "Ausblendbedingungen fuer Fehlerpfad Dfp_InjCtlDrift" VALUE 0xC9919 Kw_Wu8 255.0 OneToOne 0.00 255.0 FORMAT "%5.1" /end CHARACTERISTIC
/begin CHARACTERISTIC DSM_FMKDfp_InjVCDActrChrg_C "Ausblendbedingungen fuer Fehlerpfad Dfp_InjVCDActrChrg" VALUE 0xC991A Kw_Wu8 255.0 OneToOne 0.00 255.0 FORMAT "%5.1" /end CHARACTERISTIC
/begin CHARACTERISTIC DSM_FMKDfp_InjVCDActrEnrg1_C "Ausblendbedingungen fuer Fehlerpfad Dfp_InjVCDActrEnrg1" VALUE 0xC991B Kw_Wu8 255.0 OneToOne 0.00 255.0 FORMAT "%5.1" /end CHARACTERISTIC
/begin CHARACTERISTIC DSM_FMKDfp_InjVCDActrEnrg2_C "Ausblendbedingungen fuer Fehlerpfad Dfp_InjVCDActrEnrg2" VALUE 0xC991C Kw_Wu8 255.0 OneToOne 0.00 255.0 FORMAT "%5.1" /end CHARACTERISTIC
/begin CHARACTERISTIC DSM_FMKDfp_InjVCDActrEnrg3_C "Ausblendbedingungen fuer Fehlerpfad Dfp_InjVCDActrEnrg3" VALUE 0xC991D Kw_Wu8 255.0 OneToOne 0.00 255.0 FORMAT "%5.1" /end CHARACTERISTIC
/begin CHARACTERISTIC DSM_FMKDfp_InjVCDActrEnrg4_C "Ausblendbedingungen fuer Fehlerpfad Dfp_InjVCDActrEnrg4" VALUE 0xC991E Kw_Wu8 255.0 OneToOne 0.00 255.0 FORMAT "%5.1" /end CHARACTERISTIC
/begin CHARACTERISTIC DSM_FMKDfp_InjVCDActrEnrg5_C "Ausblendbedingungen fuer Fehlerpfad Dfp_InjVCDActrEnrg5" VALUE 0xC991F Kw_Wu8 255.0 OneToOne 0.00 255.0 FORMAT "%5.1" /end CHARACTERISTIC
/begin CHARACTERISTIC DSM_FMKDfp_InjVCDActrEnrg6_C "Ausblendbedingungen fuer Fehlerpfad Dfp_InjVCDActrEnrg6" VALUE 0xC9920 Kw_Wu8 255.0 OneToOne 0.00 255.0 FORMAT "%5.1" /end CHARACTERISTIC
/begin CHARACTERISTIC DSM_FMKDfp_InjVCDActrEnrg7_C "Ausblendbedingungen fuer Fehlerpfad Dfp_InjVCDActrEnrg7" VALUE 0xC9921 Kw_Wu8 255.0 OneToOne 0.00 255.0 FORMAT "%5.1" /end CHARACTERISTIC
/begin CHARACTERISTIC DSM_FMKDfp_InjVCDActrEnrg8_C "Ausblendbedingungen fuer Fehlerpfad Dfp_InjVCDActrEnrg8" VALUE 0xC9922 Kw_Wu8 255.0 OneToOne 0.00 255.0 FORMAT "%5.1" /end CHARACTERISTIC
/begin CHARACTERISTIC DSM_FMKDfp_InjVCDActrVolt_C "Ausblendbedingungen fuer Fehlerpfad Dfp_InjVCDActrVolt" VALUE 0xC9923 Kw_Wu8 255.0 OneToOne 0.00 255.0 FORMAT "%5.1" /end CHARACTERISTIC
/begin CHARACTERISTIC DSM_FMKDfp_InjVCDClsBank1_C "Ausblendbedingungen fuer Fehlerpfad Dfp_InjVCDClsBank1" VALUE 0xC9924 Kw_Wu8 255.0 OneToOne 0.00 255.0 FORMAT "%5.1" /end CHARACTERISTIC
/begin CHARACTERISTIC DSM_FMKDfp_InjVCDClsBank2_C "Ausblendbedingungen fuer Fehlerpfad Dfp_InjVCDClsBank2" VALUE 0xC9925 Kw_Wu8 255.0 OneToOne 0.00 255.0 FORMAT "%5.1" /end CHARACTERISTIC
/begin CHARACTERISTIC DSM_FMKDfp_InjVCDMonCab_C "Ausblendbedingungen fuer Fehlerpfad Dfp_InjVCDMonCab" VALUE 0xC9926 Kw_Wu8 255.0 OneToOne 0.00 255.0 FORMAT "%5.1" /end CHARACTERISTIC
/begin CHARACTERISTIC DSM_FMKDfp_InjVCDMonSwt_C "Ausblendbedingungen fuer Fehlerpfad Dfp_InjVCDMonSwt" VALUE 0xC9927 Kw_Wu8 255.0 OneToOne 0.00 255.0 FORMAT "%5.1" /end CHARACTERISTIC
/begin CHARACTERISTIC DSM_FMKDfp_InjVCDShOffDCDC_C "Ausblendbedingungen fuer Fehlerpfad Dfp_InjVCDShOffDCDC" VALUE 0xC9928 Kw_Wu8 255.0 OneToOne 0.00 255.0 FORMAT "%5.1" /end CHARACTERISTIC
/begin CHARACTERISTIC DSM_FMKDfp_InjVCDUBuf_C "Ausblendbedingungen fuer Fehlerpfad Dfp_InjVCDUBuf" VALUE 0xC9929 Kw_Wu8 255.0 OneToOne 0.00 255.0 FORMAT "%5.1" /end CHARACTERISTIC
/begin CHARACTERISTIC DSM_FMKDfp_InjVCD_CY370Ampl_C "Ausblendbedingungen fuer Fehlerpfad Dfp_InjVCD_CY370Ampl" VALUE 0xC992A Kw_Wu8 255.0 OneToOne 0.00 255.0 FORMAT "%5.1" /end CHARACTERISTIC
/begin CHARACTERISTIC DSM_FMKDfp_InjVlvBnk1A_C "Ausblendbedingungen fuer Fehlerpfad Dfp_InjVlvBnk1A" VALUE 0xC992B Kw_Wu8 255.0 OneToOne 0.00 255.0 FORMAT "%5.1" /end CHARACTERISTIC
/begin CHARACTERISTIC DSM_FMKDfp_InjVlvBnk1B_C "Ausblendbedingungen fuer Fehlerpfad Dfp_InjVlvBnk1B" VALUE 0xC992C Kw_Wu8 255.0 OneToOne 0.00 255.0 FORMAT "%5.1" /end CHARACTERISTIC
/begin CHARACTERISTIC DSM_FMKDfp_InjVlvBnk2A_C "Ausblendbedingungen fuer Fehlerpfad Dfp_InjVlvBnk2A" VALUE 0xC992D Kw_Wu8 255.0 OneToOne 0.00 255.0 FORMAT "%5.1" /end CHARACTERISTIC
/begin CHARACTERISTIC DSM_FMKDfp_InjVlvBnk2B_C "Ausblendbedingungen fuer Fehlerpfad Dfp_InjVlvBnk2B" VALUE 0xC992E Kw_Wu8 255.0 OneToOne 0.00 255.0 FORMAT "%5.1" /end CHARACTERISTIC
/begin CHARACTERISTIC DSM_FMKDfp_InjVlvChipA_C "Ausblendbedingungen fuer Fehlerpfad Dfp_InjVlvChipA" VALUE 0xC992F Kw_Wu8 255.0 OneToOne 0.00 255.0 FORMAT "%5.1" /end CHARACTERISTIC
/begin CHARACTERISTIC DSM_FMKDfp_InjVlvChipB_C "Ausblendbedingungen fuer Fehlerpfad Dfp_InjVlvChipB" VALUE 0xC9930 Kw_Wu8 255.0 OneToOne 0.00 255.0 FORMAT "%5.1" /end CHARACTERISTIC
/begin CHARACTERISTIC DSM_FMKDfp_InjVlvCyl1A_C "Ausblendbedingungen fuer Fehlerpfad Dfp_InjVlvCyl1A" VALUE 0xC9931 Kw_Wu8 255.0 OneToOne 0.00 255.0 FORMAT "%5.1" /end CHARACTERISTIC
/begin CHARACTERISTIC DSM_FMKDfp_InjVlvCyl1B_C "Ausblendbedingungen fuer Fehlerpfad Dfp_InjVlvCyl1B" VALUE 0xC9932 Kw_Wu8 255.0 OneToOne 0.00 255.0 FORMAT "%5.1" /end CHARACTERISTIC
/begin CHARACTERISTIC DSM_FMKDfp_InjVlvCyl1C_C "Ausblendbedingungen fuer Fehlerpfad Dfp_InjVlvCyl1C" VALUE 0xC9933 Kw_Wu8 255.0 OneToOne 0.00 255.0 FORMAT "%5.1" /end CHARACTERISTIC
/begin CHARACTERISTIC DSM_FMKDfp_InjVlvCyl2A_C "Ausblendbedingungen fuer Fehlerpfad Dfp_InjVlvCyl2A" VALUE 0xC9934 Kw_Wu8 255.0 OneToOne 0.00 255.0 FORMAT "%5.1" /end CHARACTERISTIC
/begin CHARACTERISTIC DSM_FMKDfp_InjVlvCyl2B_C "Ausblendbedingungen fuer Fehlerpfad Dfp_InjVlvCyl2B" VALUE 0xC9935 Kw_Wu8 255.0 OneToOne 0.00 255.0 FORMAT "%5.1" /end CHARACTERISTIC
/begin CHARACTERISTIC DSM_FMKDfp_InjVlvCyl2C_C "Ausblendbedingungen fuer Fehlerpfad Dfp_InjVlvCyl2C" VALUE 0xC9936 Kw_Wu8 255.0 OneToOne 0.00 255.0 FORMAT "%5.1" /end CHARACTERISTIC
/begin CHARACTERISTIC DSM_FMKDfp_InjVlvCyl3A_C "Ausblendbedingungen fuer Fehlerpfad Dfp_InjVlvCyl3A" VALUE 0xC9937 Kw_Wu8 255.0 OneToOne 0.00 255.0 FORMAT "%5.1" /end CHARACTERISTIC
/begin CHARACTERISTIC DSM_FMKDfp_InjVlvCyl3B_C "Ausblendbedingungen fuer Fehlerpfad Dfp_InjVlvCyl3B" VALUE 0xC9938 Kw_Wu8 255.0 OneToOne 0.00 255.0 FORMAT "%5.1" /end CHARACTERISTIC
/begin CHARACTERISTIC DSM_FMKDfp_InjVlvCyl3C_C "Ausblendbedingungen fuer Fehlerpfad Dfp_InjVlvCyl3C" VALUE 0xC9939 Kw_Wu8 255.0 OneToOne 0.00 255.0 FORMAT "%5.1" /end CHARACTERISTIC
/begin CHARACTERISTIC DSM_FMKDfp_InjVlvCyl4A_C "Ausblendbedingungen fuer Fehlerpfad Dfp_InjVlvCyl4A" VALUE 0xC993A Kw_Wu8 255.0 OneToOne 0.00 255.0 FORMAT "%5.1" /end CHARACTERISTIC
/begin CHARACTERISTIC DSM_FMKDfp_InjVlvCyl4B_C "Ausblendbedingungen fuer Fehlerpfad Dfp_InjVlvCyl4B" VALUE 0xC993B Kw_Wu8 255.0 OneToOne 0.00 255.0 FORMAT "%5.1" /end CHARACTERISTIC
/begin CHARACTERISTIC DSM_FMKDfp_InjVlvCyl4C_C "Ausblendbedingungen fuer Fehlerpfad Dfp_InjVlvCyl4C" VALUE 0xC993C Kw_Wu8 255.0 OneToOne 0.00 255.0 FORMAT "%5.1" /end CHARACTERISTIC
/begin CHARACTERISTIC DSM_FMKDfp_InjVlvCyl5A_C "Ausblendbedingungen fuer Fehlerpfad Dfp_InjVlvCyl5A" VALUE 0xC993D Kw_Wu8 255.0 OneToOne 0.00 255.0 FORMAT "%5.1" /end CHARACTERISTIC
/begin CHARACTERISTIC DSM_FMKDfp_InjVlvCyl5B_C "Ausblendbedingungen fuer Fehlerpfad Dfp_InjVlvCyl5B" VALUE 0xC993E Kw_Wu8 255.0 OneToOne 0.00 255.0 FORMAT "%5.1" /end CHARACTERISTIC
/begin CHARACTERISTIC DSM_FMKDfp_InjVlvCyl5C_C "Ausblendbedingungen fuer Fehlerpfad Dfp_InjVlvCyl5C" VALUE 0xC993F Kw_Wu8 255.0 OneToOne 0.00 255.0 FORMAT "%5.1" /end CHARACTERISTIC
/begin CHARACTERISTIC DSM_FMKDfp_InjVlvCyl6A_C "Ausblendbedingungen fuer Fehlerpfad Dfp_InjVlvCyl6A" VALUE 0xC9940 Kw_Wu8 255.0 OneToOne 0.00 255.0 FORMAT "%5.1" /end CHARACTERISTIC
/begin CHARACTERISTIC DSM_FMKDfp_InjVlvCyl6B_C "Ausblendbedingungen fuer Fehlerpfad Dfp_InjVlvCyl6B" VALUE 0xC9941 Kw_Wu8 255.0 OneToOne 0.00 255.0 FORMAT "%5.1" /end CHARACTERISTIC
/begin CHARACTERISTIC DSM_FMKDfp_InjVlvCyl6C_C "Ausblendbedingungen fuer Fehlerpfad Dfp_InjVlvCyl6C" VALUE 0xC9942 Kw_Wu8 255.0 OneToOne 0.00 255.0 FORMAT "%5.1" /end CHARACTERISTIC
/begin CHARACTERISTIC DSM_FMKDfp_InjVlvCyl7A_C "Ausblendbedingungen fuer Fehlerpfad Dfp_InjVlvCyl7A" VALUE 0xC9943 Kw_Wu8 255.0 OneToOne 0.00 255.0 FORMAT "%5.1" /end CHARACTERISTIC
/begin CHARACTERISTIC DSM_FMKDfp_InjVlvCyl7B_C "Ausblendbedingungen fuer Fehlerpfad Dfp_InjVlvCyl7B" VALUE 0xC9944 Kw_Wu8 255.0 OneToOne 0.00 255.0 FORMAT "%5.1" /end CHARACTERISTIC
/begin CHARACTERISTIC DSM_FMKDfp_InjVlvCyl7C_C "Ausblendbedingungen fuer Fehlerpfad Dfp_InjVlvCyl7C" VALUE 0xC9945 Kw_Wu8 255.0 OneToOne 0.00 255.0 FORMAT "%5.1" /end CHARACTERISTIC
/begin CHARACTERISTIC DSM_FMKDfp_InjVlvCyl8A_C "Ausblendbedingungen fuer Fehlerpfad Dfp_InjVlvCyl8A" VALUE 0xC9946 Kw_Wu8 255.0 OneToOne 0.00 255.0 FORMAT "%5.1" /end CHARACTERISTIC
/begin CHARACTERISTIC DSM_FMKDfp_InjVlvCyl8B_C "Ausblendbedingungen fuer Fehlerpfad Dfp_InjVlvCyl8B" VALUE 0xC9947 Kw_Wu8 255.0 OneToOne 0.00 255.0 FORMAT "%5.1" /end CHARACTERISTIC
/begin CHARACTERISTIC DSM_FMKDfp_InjVlvCyl8C_C "Ausblendbedingungen fuer Fehlerpfad Dfp_InjVlvCyl8C" VALUE 0xC9948 Kw_Wu8 255.0 OneToOne 0.00 255.0 FORMAT "%5.1" /end CHARACTERISTIC
/begin CHARACTERISTIC DSM_FMKDfp_InjVlvNVC1_C "Ausblendbedingungen fuer Fehlerpfad Dfp_InjVlvNVC1" VALUE 0xC9949 Kw_Wu8 255.0 OneToOne 0.00 255.0 FORMAT "%5.1" /end CHARACTERISTIC
/begin CHARACTERISTIC DSM_FMKDfp_InjVlvNVC2_C "Ausblendbedingungen fuer Fehlerpfad Dfp_InjVlvNVC2" VALUE 0xC994A Kw_Wu8 255.0 OneToOne 0.00 255.0 FORMAT "%5.1" /end CHARACTERISTIC
/begin CHARACTERISTIC DSM_FMKDfp_InjVlvNVC3_C "Ausblendbedingungen fuer Fehlerpfad Dfp_InjVlvNVC3" VALUE 0xC994B Kw_Wu8 255.0 OneToOne 0.00 255.0 FORMAT "%5.1" /end CHARACTERISTIC
/begin CHARACTERISTIC DSM_FMKDfp_InjVlvNVC4_C "Ausblendbedingungen fuer Fehlerpfad Dfp_InjVlvNVC4" VALUE 0xC994C Kw_Wu8 255.0 OneToOne 0.00 255.0 FORMAT "%5.1" /end CHARACTERISTIC
/begin CHARACTERISTIC DSM_FMKDfp_InjVlvNVC5_C "Ausblendbedingungen fuer Fehlerpfad Dfp_InjVlvNVC5" VALUE 0xC994D Kw_Wu8 255.0 OneToOne 0.00 255.0 FORMAT "%5.1" /end CHARACTERISTIC
/begin CHARACTERISTIC DSM_FMKDfp_InjVlvNVC6_C "Ausblendbedingungen fuer Fehlerpfad Dfp_InjVlvNVC6" VALUE 0xC994E Kw_Wu8 255.0 OneToOne 0.00 255.0 FORMAT "%5.1" /end CHARACTERISTIC
/begin CHARACTERISTIC DSM_FMKDfp_InjVlvNVC7_C "Ausblendbedingungen fuer Fehlerpfad Dfp_InjVlvNVC7" VALUE 0xC994F Kw_Wu8 255.0 OneToOne 0.00 255.0 FORMAT "%5.1" /end CHARACTERISTIC
/begin CHARACTERISTIC DSM_FMKDfp_InjVlvNVC8_C "Ausblendbedingungen fuer Fehlerpfad Dfp_InjVlvNVC8" VALUE 0xC9950 Kw_Wu8 255.0 OneToOne 0.00 255.0 FORMAT "%5.1" /end CHARACTERISTIC
/begin CHARACTERISTIC DSM_FMKDfp_LPACD_Max_C "Ausblendbedingungen fuer Fehlerpfad Dfp_LPACD_Max" VALUE 0xC9951 Kw_Wu8 255.0 OneToOne 0.00 255.0 FORMAT "%5.1" /end CHARACTERISTIC
/begin CHARACTERISTIC DSM_FMKDfp_LPACD_Min_C "Ausblendbedingungen fuer Fehlerpfad Dfp_LPACD_Min" VALUE 0xC9952 Kw_Wu8 255.0 OneToOne 0.00 255.0 FORMAT "%5.1" /end CHARACTERISTIC
/begin CHARACTERISTIC DSM_FMKDfp_LPACD_SigNpl_C "Ausblendbedingungen fuer Fehlerpfad Dfp_LPACD_SigNpl" VALUE 0xC9953 Kw_Wu8 255.0 OneToOne 0.00 255.0 FORMAT "%5.1" /end CHARACTERISTIC
/begin CHARACTERISTIC DSM_FMKDfp_LSUCDCircNernst0_C "Ausblendbedingungen fuer Fehlerpfad Dfp_LSUCDCircNernst0" VALUE 0xC9954 Kw_Wu8 255.0 OneToOne 0.00 255.0 FORMAT "%5.1" /end CHARACTERISTIC
/begin CHARACTERISTIC DSM_FMKDfp_LSUCDCircPumpCur0_C "Ausblendbedingungen fuer Fehlerpfad Dfp_LSUCDCircPumpCur0" VALUE 0xC9955 Kw_Wu8 255.0 OneToOne 0.00 255.0 FORMAT "%5.1" /end CHARACTERISTIC
/begin CHARACTERISTIC DSM_FMKDfp_LSUCDCircVirtGnd0_C "Ausblendbedingungen fuer Fehlerpfad Dfp_LSUCDCircVirtGnd0" VALUE 0xC9956 Kw_Wu8 255.0 OneToOne 0.00 255.0 FORMAT "%5.1" /end CHARACTERISTIC
/begin CHARACTERISTIC DSM_FMKDfp_LSUCDHeater0_C "Ausblendbedingungen fuer Fehlerpfad Dfp_LSUCDHeater0" VALUE 0xC9957 Kw_Wu8 255.0 OneToOne 0.00 255.0 FORMAT "%5.1" /end CHARACTERISTIC
/begin CHARACTERISTIC DSM_FMKDfp_LSUCDHtCoup0_C "Ausblendbedingungen fuer Fehlerpfad Dfp_LSUCDHtCoup0" VALUE 0xC9958 Kw_Wu8 255.0 OneToOne 0.00 255.0 FORMAT "%5.1" /end CHARACTERISTIC
/begin CHARACTERISTIC DSM_FMKDfp_LSUCDO20_C "Ausblendbedingungen fuer Fehlerpfad Dfp_LSUCDO20" VALUE 0xC9959 Kw_Wu8 255.0 OneToOne 0.00 255.0 FORMAT "%5.1" /end CHARACTERISTIC
/begin CHARACTERISTIC DSM_FMKDfp_LSUCDO2Clb0_C "Ausblendbedingungen fuer Fehlerpfad Dfp_LSUCDO2Clb0" VALUE 0xC995A Kw_Wu8 255.0 OneToOne 0.00 255.0 FORMAT "%5.1" /end CHARACTERISTIC
/begin CHARACTERISTIC DSM_FMKDfp_LSUCDRiClb0_C "Ausblendbedingungen fuer Fehlerpfad Dfp_LSUCDRiClb0" VALUE 0xC995B Kw_Wu8 255.0 OneToOne 0.00 255.0 FORMAT "%5.1" /end CHARACTERISTIC
/begin CHARACTERISTIC DSM_FMKDfp_LSUCDSPI0_C "Ausblendbedingungen fuer Fehlerpfad Dfp_LSUCDSPI0" VALUE 0xC995C Kw_Wu8 255.0 OneToOne 0.00 255.0 FORMAT "%5.1" /end CHARACTERISTIC
/begin CHARACTERISTIC DSM_FMKDfp_LSUCDSPIBattLow0_C "Ausblendbedingungen fuer Fehlerpfad Dfp_LSUCDSPIBattLow0" VALUE 0xC995D Kw_Wu8 255.0 OneToOne 0.00 255.0 FORMAT "%5.1" /end CHARACTERISTIC
/begin CHARACTERISTIC DSM_FMKDfp_LSUCDWireIP0_C "Ausblendbedingungen fuer Fehlerpfad Dfp_LSUCDWireIP0" VALUE 0xC995E Kw_Wu8 255.0 OneToOne 0.00 255.0 FORMAT "%5.1" /end CHARACTERISTIC
/begin CHARACTERISTIC DSM_FMKDfp_LSUCtlRiExc0_C "Ausblendbedingungen fuer Fehlerpfad Dfp_LSUCtlRiExc0" VALUE 0xC995F Kw_Wu8 255.0 OneToOne 0.00 255.0 FORMAT "%5.1" /end CHARACTERISTIC
/begin CHARACTERISTIC DSM_FMKDfp_LSUMon1Sens_C "Ausblendbedingungen fuer Fehlerpfad Dfp_LSUMon1Sens" VALUE 0xC9960 Kw_Wu8 255.0 OneToOne 0.00 255.0 FORMAT "%5.1" /end CHARACTERISTIC
/begin CHARACTERISTIC DSM_FMKDfp_LSUMon2Sens_C "Ausblendbedingungen fuer Fehlerpfad Dfp_LSUMon2Sens" VALUE 0xC9961 Kw_Wu8 255.0 OneToOne 0.00 255.0 FORMAT "%5.1" /end CHARACTERISTIC
/begin CHARACTERISTIC DSM_FMKDfp_MIL_C "Ausblendbedingungen fuer Fehlerpfad Dfp_MIL" VALUE 0xC9962 Kw_Wu8 255.0 OneToOne 0.00 255.0 FORMAT "%5.1" /end CHARACTERISTIC
/begin CHARACTERISTIC DSM_FMKDfp_MRlyCD_C "Ausblendbedingungen fuer Fehlerpfad Dfp_MRlyCD" VALUE 0xC9963 Kw_Wu8 255.0 OneToOne 0.00 255.0 FORMAT "%5.1" /end CHARACTERISTIC
/begin CHARACTERISTIC DSM_FMKDfp_MSidCD_Comm_C "Ausblendbedingungen fuer Fehlerpfad Dfp_MSidCD_Comm" VALUE 0xC9964 Kw_Wu8 255.0 OneToOne 0.00 255.0 FORMAT "%5.1" /end CHARACTERISTIC
/begin CHARACTERISTIC DSM_FMKDfp_MSidCD_Pin_C "Ausblendbedingungen fuer Fehlerpfad Dfp_MSidCD_Pin" VALUE 0xC9965 Kw_Wu8 255.0 OneToOne 0.00 255.0 FORMAT "%5.1" /end CHARACTERISTIC
/begin CHARACTERISTIC DSM_FMKDfp_MSidCD_Sel_INI_C "Ausblendbedingungen fuer Fehlerpfad Dfp_MSidCD_Sel_INI" VALUE 0xC9966 Kw_Wu8 255.0 OneToOne 0.00 255.0 FORMAT "%5.1" /end CHARACTERISTIC
/begin CHARACTERISTIC DSM_FMKDfp_MSidCD_Select_C "Ausblendbedingungen fuer Fehlerpfad Dfp_MSidCD_Select" VALUE 0xC9967 Kw_Wu8 255.0 OneToOne 0.00 255.0 FORMAT "%5.1" /end CHARACTERISTIC
/begin CHARACTERISTIC DSM_FMKDfp_MeUnCDNoLoad_C "Ausblendbedingungen fuer Fehlerpfad Dfp_MeUnCDNoLoad" VALUE 0xC9968 Kw_Wu8 255.0 OneToOne 0.00 255.0 FORMAT "%5.1" /end CHARACTERISTIC
/begin CHARACTERISTIC DSM_FMKDfp_MeUnCDSCBat_C "Ausblendbedingungen fuer Fehlerpfad Dfp_MeUnCDSCBat" VALUE 0xC9969 Kw_Wu8 255.0 OneToOne 0.00 255.0 FORMAT "%5.1" /end CHARACTERISTIC
/begin CHARACTERISTIC DSM_FMKDfp_MeUnCDSCGnd_C "Ausblendbedingungen fuer Fehlerpfad Dfp_MeUnCDSCGnd" VALUE 0xC996A Kw_Wu8 255.0 OneToOne 0.00 255.0 FORMAT "%5.1" /end CHARACTERISTIC
/begin CHARACTERISTIC DSM_FMKDfp_MeUnCD_ADC_C "Ausblendbedingungen fuer Fehlerpfad Dfp_MeUnCD_ADC" VALUE 0xC996B Kw_Wu8 255.0 OneToOne 0.00 255.0 FORMAT "%5.1" /end CHARACTERISTIC
/begin CHARACTERISTIC DSM_FMKDfp_MeUnCD_SigTst_C "Ausblendbedingungen fuer Fehlerpfad Dfp_MeUnCD_SigTst" VALUE 0xC996C Kw_Wu8 255.0 OneToOne 0.00 255.0 FORMAT "%5.1" /end CHARACTERISTIC
/begin CHARACTERISTIC DSM_FMKDfp_Montr_C "Ausblendbedingungen fuer Fehlerpfad Dfp_Montr" VALUE 0xC996D Kw_Wu8 255.0 OneToOne 0.00 255.0 FORMAT "%5.1" /end CHARACTERISTIC
/begin CHARACTERISTIC DSM_FMKDfp_NetMngDeviceA_C "Ausblendbedingungen fuer Fehlerpfad Dfp_NetMngDeviceA" VALUE 0xC996E Kw_Wu8 255.0 OneToOne 0.00 255.0 FORMAT "%5.1" /end CHARACTERISTIC
/begin CHARACTERISTIC DSM_FMKDfp_NetMngDeviceB_C "Ausblendbedingungen fuer Fehlerpfad Dfp_NetMngDeviceB" VALUE 0xC996F Kw_Wu8 255.0 OneToOne 0.00 255.0 FORMAT "%5.1" /end CHARACTERISTIC
/begin CHARACTERISTIC DSM_FMKDfp_NetMngDeviceC_C "Ausblendbedingungen fuer Fehlerpfad Dfp_NetMngDeviceC" VALUE 0xC9970 Kw_Wu8 255.0 OneToOne 0.00 255.0 FORMAT "%5.1" /end CHARACTERISTIC
/begin CHARACTERISTIC DSM_FMKDfp_OPSCD_Lamp_C "Ausblendbedingungen fuer Fehlerpfad Dfp_OPSCD_Lamp" VALUE 0xC9971 Kw_Wu8 255.0 OneToOne 0.00 255.0 FORMAT "%5.1" /end CHARACTERISTIC
/begin CHARACTERISTIC DSM_FMKDfp_OPSCD_anain_C "Ausblendbedingungen fuer Fehlerpfad Dfp_OPSCD_anain" VALUE 0xC9972 Kw_Wu8 255.0 OneToOne 0.00 255.0 FORMAT "%5.1" /end CHARACTERISTIC
/begin CHARACTERISTIC DSM_FMKDfp_OTSCD_C "Ausblendbedingungen fuer Fehlerpfad Dfp_OTSCD" VALUE 0xC9973 Kw_Wu8 255.0 OneToOne 0.00 255.0 FORMAT "%5.1" /end CHARACTERISTIC
/begin CHARACTERISTIC DSM_FMKDfp_OvRMon_C "Ausblendbedingungen fuer Fehlerpfad Dfp_OvRMon" VALUE 0xC9974 Kw_Wu8 255.0 OneToOne 0.00 255.0 FORMAT "%5.1" /end CHARACTERISTIC
/begin CHARACTERISTIC DSM_FMKDfp_OvRMonBrk_C "Ausblendbedingungen fuer Fehlerpfad Dfp_OvRMonBrk" VALUE 0xC9975 Kw_Wu8 255.0 OneToOne 0.00 255.0 FORMAT "%5.1" /end CHARACTERISTIC
/begin CHARACTERISTIC DSM_FMKDfp_OvRMonSigA_C "Ausblendbedingungen fuer Fehlerpfad Dfp_OvRMonSigA" VALUE 0xC9976 Kw_Wu8 255.0 OneToOne 0.00 255.0 FORMAT "%5.1" /end CHARACTERISTIC
/begin CHARACTERISTIC DSM_FMKDfp_OxiCCDTPre_C "Ausblendbedingungen fuer Fehlerpfad Dfp_OxiCCDTPre" VALUE 0xC9977 Kw_Wu8 255.0 OneToOne 0.00 255.0 FORMAT "%5.1" /end CHARACTERISTIC
/begin CHARACTERISTIC DSM_FMKDfp_PCR_GovDevNeg_C "Ausblendbedingungen fuer Fehlerpfad Dfp_PCR_GovDevNeg" VALUE 0xC9978 Kw_Wu8 255.0 OneToOne 0.00 255.0 FORMAT "%5.1" /end CHARACTERISTIC
/begin CHARACTERISTIC DSM_FMKDfp_PCR_GovDevPos_C "Ausblendbedingungen fuer Fehlerpfad Dfp_PCR_GovDevPos" VALUE 0xC9979 Kw_Wu8 255.0 OneToOne 0.00 255.0 FORMAT "%5.1" /end CHARACTERISTIC
/begin CHARACTERISTIC DSM_FMKDfp_PCR_LPGvnrDvtNeg_C "Ausblendbedingungen fuer Fehlerpfad Dfp_PCR_LPGvnrDvtNeg" VALUE 0xC997A Kw_Wu8 255.0 OneToOne 0.00 255.0 FORMAT "%5.1" /end CHARACTERISTIC
/begin CHARACTERISTIC DSM_FMKDfp_PCR_LPGvnrDvtPos_C "Ausblendbedingungen fuer Fehlerpfad Dfp_PCR_LPGvnrDvtPos" VALUE 0xC997B Kw_Wu8 255.0 OneToOne 0.00 255.0 FORMAT "%5.1" /end CHARACTERISTIC
/begin CHARACTERISTIC DSM_FMKDfp_PCVCDNoLoad_C "Ausblendbedingungen fuer Fehlerpfad Dfp_PCVCDNoLoad" VALUE 0xC997C Kw_Wu8 255.0 OneToOne 0.00 255.0 FORMAT "%5.1" /end CHARACTERISTIC
/begin CHARACTERISTIC DSM_FMKDfp_PCVCDSCBat_C "Ausblendbedingungen fuer Fehlerpfad Dfp_PCVCDSCBat" VALUE 0xC997D Kw_Wu8 255.0 OneToOne 0.00 255.0 FORMAT "%5.1" /end CHARACTERISTIC
/begin CHARACTERISTIC DSM_FMKDfp_PCVCDSCGnd_C "Ausblendbedingungen fuer Fehlerpfad Dfp_PCVCDSCGnd" VALUE 0xC997E Kw_Wu8 255.0 OneToOne 0.00 255.0 FORMAT "%5.1" /end CHARACTERISTIC
/begin CHARACTERISTIC DSM_FMKDfp_PCVCD_ADC_C "Ausblendbedingungen fuer Fehlerpfad Dfp_PCVCD_ADC" VALUE 0xC997F Kw_Wu8 255.0 OneToOne 0.00 255.0 FORMAT "%5.1" /end CHARACTERISTIC
/begin CHARACTERISTIC DSM_FMKDfp_PCVCD_SigTst_C "Ausblendbedingungen fuer Fehlerpfad Dfp_PCVCD_SigTst" VALUE 0xC9980 Kw_Wu8 255.0 OneToOne 0.00 255.0 FORMAT "%5.1" /end CHARACTERISTIC
/begin CHARACTERISTIC DSM_FMKDfp_PFltAPSPlaus_C "Ausblendbedingungen fuer Fehlerpfad Dfp_PFltAPSPlaus" VALUE 0xC9981 Kw_Wu8 255.0 OneToOne 0.00 255.0 FORMAT "%5.1" /end CHARACTERISTIC
/begin CHARACTERISTIC DSM_FMKDfp_PFltAPSens_C "Ausblendbedingungen fuer Fehlerpfad Dfp_PFltAPSens" VALUE 0xC9982 Kw_Wu8 255.0 OneToOne 0.00 255.0 FORMAT "%5.1" /end CHARACTERISTIC
/begin CHARACTERISTIC DSM_FMKDfp_PFltBPSPlaus_C "Ausblendbedingungen fuer Fehlerpfad Dfp_PFltBPSPlaus" VALUE 0xC9983 Kw_Wu8 255.0 OneToOne 0.00 255.0 FORMAT "%5.1" /end CHARACTERISTIC
/begin CHARACTERISTIC DSM_FMKDfp_PFltCDPPre_C "Ausblendbedingungen fuer Fehlerpfad Dfp_PFltCDPPre" VALUE 0xC9984 Kw_Wu8 255.0 OneToOne 0.00 255.0 FORMAT "%5.1" /end CHARACTERISTIC
/begin CHARACTERISTIC DSM_FMKDfp_PFltCDTempPre_C "Ausblendbedingungen fuer Fehlerpfad Dfp_PFltCDTempPre" VALUE 0xC9985 Kw_Wu8 255.0 OneToOne 0.00 255.0 FORMAT "%5.1" /end CHARACTERISTIC
/begin CHARACTERISTIC DSM_FMKDfp_PFltChar_C "Ausblendbedingungen fuer Fehlerpfad Dfp_PFltChar" VALUE 0xC9986 Kw_Wu8 255.0 OneToOne 0.00 255.0 FORMAT "%5.1" /end CHARACTERISTIC
/begin CHARACTERISTIC DSM_FMKDfp_PFltEngPrt_C "Ausblendbedingungen fuer Fehlerpfad Dfp_PFltEngPrt" VALUE 0xC9987 Kw_Wu8 255.0 OneToOne 0.00 255.0 FORMAT "%5.1" /end CHARACTERISTIC
/begin CHARACTERISTIC DSM_FMKDfp_PFltPresDynPlaus_C "Ausblendbedingungen fuer Fehlerpfad Dfp_PFltPresDynPlaus" VALUE 0xC9988 Kw_Wu8 255.0 OneToOne 0.00 255.0 FORMAT "%5.1" /end CHARACTERISTIC
/begin CHARACTERISTIC DSM_FMKDfp_PFltPresPlaus_C "Ausblendbedingungen fuer Fehlerpfad Dfp_PFltPresPlaus" VALUE 0xC9989 Kw_Wu8 255.0 OneToOne 0.00 255.0 FORMAT "%5.1" /end CHARACTERISTIC
/begin CHARACTERISTIC DSM_FMKDfp_PFltPresSens_C "Ausblendbedingungen fuer Fehlerpfad Dfp_PFltPresSens" VALUE 0xC998A Kw_Wu8 255.0 OneToOne 0.00 255.0 FORMAT "%5.1" /end CHARACTERISTIC
/begin CHARACTERISTIC DSM_FMKDfp_PFltPresSensFrz_C "Ausblendbedingungen fuer Fehlerpfad Dfp_PFltPresSensFrz" VALUE 0xC998B Kw_Wu8 255.0 OneToOne 0.00 255.0 FORMAT "%5.1" /end CHARACTERISTIC
/begin CHARACTERISTIC DSM_FMKDfp_PFltPresSensHsLn_C "Ausblendbedingungen fuer Fehlerpfad Dfp_PFltPresSensHsLn" VALUE 0xC998C Kw_Wu8 255.0 OneToOne 0.00 255.0 FORMAT "%5.1" /end CHARACTERISTIC
/begin CHARACTERISTIC DSM_FMKDfp_PFltPresSensSot_C "Ausblendbedingungen fuer Fehlerpfad Dfp_PFltPresSensSot" VALUE 0xC998D Kw_Wu8 255.0 OneToOne 0.00 255.0 FORMAT "%5.1" /end CHARACTERISTIC
/begin CHARACTERISTIC DSM_FMKDfp_PFltRgnPerm_C "Ausblendbedingungen fuer Fehlerpfad Dfp_PFltRgnPerm" VALUE 0xC998E Kw_Wu8 255.0 OneToOne 0.00 255.0 FORMAT "%5.1" /end CHARACTERISTIC
/begin CHARACTERISTIC DSM_FMKDfp_PFltTempDwnStrm_C "Ausblendbedingungen fuer Fehlerpfad Dfp_PFltTempDwnStrm" VALUE 0xC998F Kw_Wu8 255.0 OneToOne 0.00 255.0 FORMAT "%5.1" /end CHARACTERISTIC
/begin CHARACTERISTIC DSM_FMKDfp_PFltTempSens_C "Ausblendbedingungen fuer Fehlerpfad Dfp_PFltTempSens" VALUE 0xC9990 Kw_Wu8 255.0 OneToOne 0.00 255.0 FORMAT "%5.1" /end CHARACTERISTIC
/begin CHARACTERISTIC DSM_FMKDfp_PFltTempUpStrm_C "Ausblendbedingungen fuer Fehlerpfad Dfp_PFltTempUpStrm" VALUE 0xC9991 Kw_Wu8 255.0 OneToOne 0.00 255.0 FORMAT "%5.1" /end CHARACTERISTIC
/begin CHARACTERISTIC DSM_FMKDfp_PFltmSotDiffMax_C "Ausblendbedingungen fuer Fehlerpfad Dfp_PFltmSotDiffMax" VALUE 0xC9992 Kw_Wu8 255.0 OneToOne 0.00 255.0 FORMAT "%5.1" /end CHARACTERISTIC
/begin CHARACTERISTIC DSM_FMKDfp_PSPCD_Actr_C "Ausblendbedingungen fuer Fehlerpfad Dfp_PSPCD_Actr" VALUE 0xC9993 Kw_Wu8 255.0 OneToOne 0.00 255.0 FORMAT "%5.1" /end CHARACTERISTIC
/begin CHARACTERISTIC DSM_FMKDfp_PresPlausDblDef_C "Ausblendbedingungen fuer Fehlerpfad Dfp_PresPlausDblDef" VALUE 0xC9994 Kw_Wu8 255.0 OneToOne 0.00 255.0 FORMAT "%5.1" /end CHARACTERISTIC
/begin CHARACTERISTIC DSM_FMKDfp_QLTCD_C "Ausblendbedingungen fuer Fehlerpfad Dfp_QLTCD" VALUE 0xC9995 Kw_Wu8 255.0 OneToOne 0.00 255.0 FORMAT "%5.1" /end CHARACTERISTIC
/begin CHARACTERISTIC DSM_FMKDfp_RailCD_C "Ausblendbedingungen fuer Fehlerpfad Dfp_RailCD" VALUE 0xC9996 Kw_Wu8 255.0 OneToOne 0.00 255.0 FORMAT "%5.1" /end CHARACTERISTIC
/begin CHARACTERISTIC DSM_FMKDfp_RailCDOfsTst_C "Ausblendbedingungen fuer Fehlerpfad Dfp_RailCDOfsTst" VALUE 0xC9997 Kw_Wu8 255.0 OneToOne 0.00 255.0 FORMAT "%5.1" /end CHARACTERISTIC
/begin CHARACTERISTIC DSM_FMKDfp_RailCD_PMonStrt_C "Ausblendbedingungen fuer Fehlerpfad Dfp_RailCD_PMonStrt" VALUE 0xC9998 Kw_Wu8 255.0 OneToOne 0.00 255.0 FORMAT "%5.1" /end CHARACTERISTIC
/begin CHARACTERISTIC DSM_FMKDfp_RailCtlModeMeUnDiag_C "Ausblendbedingungen fuer Fehlerpfad Dfp_RailCtlModeMeUnDiag" VALUE 0xC9999 Kw_Wu8 255.0 OneToOne 0.00 255.0 FORMAT "%5.1" /end CHARACTERISTIC
/begin CHARACTERISTIC DSM_FMKDfp_RailCtlModePCVDiag_C "Ausblendbedingungen fuer Fehlerpfad Dfp_RailCtlModePCVDiag" VALUE 0xC999A Kw_Wu8 255.0 OneToOne 0.00 255.0 FORMAT "%5.1" /end CHARACTERISTIC
/begin CHARACTERISTIC DSM_FMKDfp_RailMeUn0_C "Ausblendbedingungen fuer Fehlerpfad Dfp_RailMeUn0" VALUE 0xC999B Kw_Wu8 255.0 OneToOne 0.00 255.0 FORMAT "%5.1" /end CHARACTERISTIC
/begin CHARACTERISTIC DSM_FMKDfp_RailMeUn1_C "Ausblendbedingungen fuer Fehlerpfad Dfp_RailMeUn1" VALUE 0xC999C Kw_Wu8 255.0 OneToOne 0.00 255.0 FORMAT "%5.1" /end CHARACTERISTIC
/begin CHARACTERISTIC DSM_FMKDfp_RailMeUn2_C "Ausblendbedingungen fuer Fehlerpfad Dfp_RailMeUn2" VALUE 0xC999D Kw_Wu8 255.0 OneToOne 0.00 255.0 FORMAT "%5.1" /end CHARACTERISTIC
/begin CHARACTERISTIC DSM_FMKDfp_RailMeUn3_C "Ausblendbedingungen fuer Fehlerpfad Dfp_RailMeUn3" VALUE 0xC999E Kw_Wu8 255.0 OneToOne 0.00 255.0 FORMAT "%5.1" /end CHARACTERISTIC
/begin CHARACTERISTIC DSM_FMKDfp_RailMeUn4_C "Ausblendbedingungen fuer Fehlerpfad Dfp_RailMeUn4" VALUE 0xC999F Kw_Wu8 255.0 OneToOne 0.00 255.0 FORMAT "%5.1" /end CHARACTERISTIC
/begin CHARACTERISTIC DSM_FMKDfp_RailPCV0_C "Ausblendbedingungen fuer Fehlerpfad Dfp_RailPCV0" VALUE 0xC99A0 Kw_Wu8 255.0 OneToOne 0.00 255.0 FORMAT "%5.1" /end CHARACTERISTIC
/begin CHARACTERISTIC DSM_FMKDfp_RailPCV1_C "Ausblendbedingungen fuer Fehlerpfad Dfp_RailPCV1" VALUE 0xC99A1 Kw_Wu8 255.0 OneToOne 0.00 255.0 FORMAT "%5.1" /end CHARACTERISTIC
/begin CHARACTERISTIC DSM_FMKDfp_RailPCV2_C "Ausblendbedingungen fuer Fehlerpfad Dfp_RailPCV2" VALUE 0xC99A2 Kw_Wu8 255.0 OneToOne 0.00 255.0 FORMAT "%5.1" /end CHARACTERISTIC
/begin CHARACTERISTIC DSM_FMKDfp_RailPCV3_C "Ausblendbedingungen fuer Fehlerpfad Dfp_RailPCV3" VALUE 0xC99A3 Kw_Wu8 255.0 OneToOne 0.00 255.0 FORMAT "%5.1" /end CHARACTERISTIC
/begin CHARACTERISTIC DSM_FMKDfp_RailPCV4_C "Ausblendbedingungen fuer Fehlerpfad Dfp_RailPCV4" VALUE 0xC99A4 Kw_Wu8 255.0 OneToOne 0.00 255.0 FORMAT "%5.1" /end CHARACTERISTIC
/begin CHARACTERISTIC DSM_FMKDfp_RailPCV5_C "Ausblendbedingungen fuer Fehlerpfad Dfp_RailPCV5" VALUE 0xC99A5 Kw_Wu8 255.0 OneToOne 0.00 255.0 FORMAT "%5.1" /end CHARACTERISTIC
/begin CHARACTERISTIC DSM_FMKDfp_SOPTst_C "Ausblendbedingungen fuer Fehlerpfad Dfp_SOPTst" VALUE 0xC99A6 Kw_Wu8 255.0 OneToOne 0.00 255.0 FORMAT "%5.1" /end CHARACTERISTIC
/begin CHARACTERISTIC DSM_FMKDfp_SSpMon1_C "Ausblendbedingungen fuer Fehlerpfad Dfp_SSpMon1" VALUE 0xC99A7 Kw_Wu8 255.0 OneToOne 0.00 255.0 FORMAT "%5.1" /end CHARACTERISTIC
/begin CHARACTERISTIC DSM_FMKDfp_SSpMon2_C "Ausblendbedingungen fuer Fehlerpfad Dfp_SSpMon2" VALUE 0xC99A8 Kw_Wu8 255.0 OneToOne 0.00 255.0 FORMAT "%5.1" /end CHARACTERISTIC
/begin CHARACTERISTIC DSM_FMKDfp_SSpMon3_C "Ausblendbedingungen fuer Fehlerpfad Dfp_SSpMon3" VALUE 0xC99A9 Kw_Wu8 255.0 OneToOne 0.00 255.0 FORMAT "%5.1" /end CHARACTERISTIC
/begin CHARACTERISTIC DSM_FMKDfp_SWChk_CycSigChkDat_C "Ausblendbedingungen fuer Fehlerpfad Dfp_SWChk_CycSigChkDat" VALUE 0xC99AA Kw_Wu8 255.0 OneToOne 0.00 255.0 FORMAT "%5.1" /end CHARACTERISTIC
/begin CHARACTERISTIC DSM_FMKDfp_SWChk_CycSigChkPrg_C "Ausblendbedingungen fuer Fehlerpfad Dfp_SWChk_CycSigChkPrg" VALUE 0xC99AB Kw_Wu8 255.0 OneToOne 0.00 255.0 FORMAT "%5.1" /end CHARACTERISTIC
/begin CHARACTERISTIC DSM_FMKDfp_ShutCD_C "Ausblendbedingungen fuer Fehlerpfad Dfp_ShutCD" VALUE 0xC99AC Kw_Wu8 255.0 OneToOne 0.00 255.0 FORMAT "%5.1" /end CHARACTERISTIC
/begin CHARACTERISTIC DSM_FMKDfp_StSysTrqShutOff_C "Ausblendbedingungen fuer Fehlerpfad Dfp_StSysTrqShutOff" VALUE 0xC99AD Kw_Wu8 255.0 OneToOne 0.00 255.0 FORMAT "%5.1" /end CHARACTERISTIC
/begin CHARACTERISTIC DSM_FMKDfp_StrtCD_Actr_C "Ausblendbedingungen fuer Fehlerpfad Dfp_StrtCD_Actr" VALUE 0xC99AE Kw_Wu8 255.0 OneToOne 0.00 255.0 FORMAT "%5.1" /end CHARACTERISTIC
/begin CHARACTERISTIC DSM_FMKDfp_SysLamp_C "Ausblendbedingungen fuer Fehlerpfad Dfp_SysLamp" VALUE 0xC99AF Kw_Wu8 255.0 OneToOne 0.00 255.0 FORMAT "%5.1" /end CHARACTERISTIC
/begin CHARACTERISTIC DSM_FMKDfp_T15CD_C "Ausblendbedingungen fuer Fehlerpfad Dfp_T15CD" VALUE 0xC99B0 Kw_Wu8 255.0 OneToOne 0.00 255.0 FORMAT "%5.1" /end CHARACTERISTIC
/begin CHARACTERISTIC DSM_FMKDfp_TGearbx_C "Ausblendbedingungen fuer Fehlerpfad Dfp_TGearbx" VALUE 0xC99B1 Kw_Wu8 255.0 OneToOne 0.00 255.0 FORMAT "%5.1" /end CHARACTERISTIC
/begin CHARACTERISTIC DSM_FMKDfp_TPUMon_C "Ausblendbedingungen fuer Fehlerpfad Dfp_TPUMon" VALUE 0xC99B2 Kw_Wu8 255.0 OneToOne 0.00 255.0 FORMAT "%5.1" /end CHARACTERISTIC
/begin CHARACTERISTIC DSM_FMKDfp_TVACD_Max_C "Ausblendbedingungen fuer Fehlerpfad Dfp_TVACD_Max" VALUE 0xC99B3 Kw_Wu8 255.0 OneToOne 0.00 255.0 FORMAT "%5.1" /end CHARACTERISTIC
/begin CHARACTERISTIC DSM_FMKDfp_TVACD_Min_C "Ausblendbedingungen fuer Fehlerpfad Dfp_TVACD_Min" VALUE 0xC99B4 Kw_Wu8 255.0 OneToOne 0.00 255.0 FORMAT "%5.1" /end CHARACTERISTIC
/begin CHARACTERISTIC DSM_FMKDfp_TVACD_SigNpl_C "Ausblendbedingungen fuer Fehlerpfad Dfp_TVACD_SigNpl" VALUE 0xC99B5 Kw_Wu8 255.0 OneToOne 0.00 255.0 FORMAT "%5.1" /end CHARACTERISTIC
/begin CHARACTERISTIC DSM_FMKDfp_TVACD_TVADia1_C "Ausblendbedingungen fuer Fehlerpfad Dfp_TVACD_TVADia1" VALUE 0xC99B6 Kw_Wu8 255.0 OneToOne 0.00 255.0 FORMAT "%5.1" /end CHARACTERISTIC
/begin CHARACTERISTIC DSM_FMKDfp_TVACD_TVADia2_C "Ausblendbedingungen fuer Fehlerpfad Dfp_TVACD_TVADia2" VALUE 0xC99B7 Kw_Wu8 255.0 OneToOne 0.00 255.0 FORMAT "%5.1" /end CHARACTERISTIC
/begin CHARACTERISTIC DSM_FMKDfp_TVACD_TVADia3_C "Ausblendbedingungen fuer Fehlerpfad Dfp_TVACD_TVADia3" VALUE 0xC99B8 Kw_Wu8 255.0 OneToOne 0.00 255.0 FORMAT "%5.1" /end CHARACTERISTIC
/begin CHARACTERISTIC DSM_FMKDfp_TVACD_TVADia4_C "Ausblendbedingungen fuer Fehlerpfad Dfp_TVACD_TVADia4" VALUE 0xC99B9 Kw_Wu8 255.0 OneToOne 0.00 255.0 FORMAT "%5.1" /end CHARACTERISTIC
/begin CHARACTERISTIC DSM_FMKDfp_VSACD_DioInDia1_C "Ausblendbedingungen fuer Fehlerpfad Dfp_VSACD_DioInDia1" VALUE 0xC99BA Kw_Wu8 255.0 OneToOne 0.00 255.0 FORMAT "%5.1" /end CHARACTERISTIC
/begin CHARACTERISTIC DSM_FMKDfp_VSACD_DioInDia2_C "Ausblendbedingungen fuer Fehlerpfad Dfp_VSACD_DioInDia2" VALUE 0xC99BB Kw_Wu8 255.0 OneToOne 0.00 255.0 FORMAT "%5.1" /end CHARACTERISTIC
/begin CHARACTERISTIC DSM_FMKDfp_VSACD_DioInDia3_C "Ausblendbedingungen fuer Fehlerpfad Dfp_VSACD_DioInDia3" VALUE 0xC99BC Kw_Wu8 255.0 OneToOne 0.00 255.0 FORMAT "%5.1" /end CHARACTERISTIC
/begin CHARACTERISTIC DSM_FMKDfp_VSACD_DioInDia4_C "Ausblendbedingungen fuer Fehlerpfad Dfp_VSACD_DioInDia4" VALUE 0xC99BD Kw_Wu8 255.0 OneToOne 0.00 255.0 FORMAT "%5.1" /end CHARACTERISTIC
/begin CHARACTERISTIC DSM_FMKDfp_VSACD_DioInMin_C "Ausblendbedingungen fuer Fehlerpfad Dfp_VSACD_DioInMin" VALUE 0xC99BE Kw_Wu8 255.0 OneToOne 0.00 255.0 FORMAT "%5.1" /end CHARACTERISTIC
/begin CHARACTERISTIC DSM_FMKDfp_VSACD_Max_C "Ausblendbedingungen fuer Fehlerpfad Dfp_VSACD_Max" VALUE 0xC99BF Kw_Wu8 255.0 OneToOne 0.00 255.0 FORMAT "%5.1" /end CHARACTERISTIC
/begin CHARACTERISTIC DSM_FMKDfp_VSACD_Min_C "Ausblendbedingungen fuer Fehlerpfad Dfp_VSACD_Min" VALUE 0xC99C0 Kw_Wu8 255.0 OneToOne 0.00 255.0 FORMAT "%5.1" /end CHARACTERISTIC
/begin CHARACTERISTIC DSM_FMKDfp_VSACD_SigNpl_C "Ausblendbedingungen fuer Fehlerpfad Dfp_VSACD_SigNpl" VALUE 0xC99C1 Kw_Wu8 255.0 OneToOne 0.00 255.0 FORMAT "%5.1" /end CHARACTERISTIC
/begin CHARACTERISTIC DSM_FMKDfp_VSACD_VSADia1_C "Ausblendbedingungen fuer Fehlerpfad Dfp_VSACD_VSADia1" VALUE 0xC99C2 Kw_Wu8 255.0 OneToOne 0.00 255.0 FORMAT "%5.1" /end CHARACTERISTIC
/begin CHARACTERISTIC DSM_FMKDfp_VSACD_VSADia2_C "Ausblendbedingungen fuer Fehlerpfad Dfp_VSACD_VSADia2" VALUE 0xC99C3 Kw_Wu8 255.0 OneToOne 0.00 255.0 FORMAT "%5.1" /end CHARACTERISTIC
/begin CHARACTERISTIC DSM_FMKDfp_VSACD_VSADia3_C "Ausblendbedingungen fuer Fehlerpfad Dfp_VSACD_VSADia3" VALUE 0xC99C4 Kw_Wu8 255.0 OneToOne 0.00 255.0 FORMAT "%5.1" /end CHARACTERISTIC
/begin CHARACTERISTIC DSM_FMKDfp_VSACD_VSADia4_C "Ausblendbedingungen fuer Fehlerpfad Dfp_VSACD_VSADia4" VALUE 0xC99C5 Kw_Wu8 255.0 OneToOne 0.00 255.0 FORMAT "%5.1" /end CHARACTERISTIC
/begin CHARACTERISTIC DSM_FMKDfp_VSSCD1_C "Ausblendbedingungen fuer Fehlerpfad Dfp_VSSCD1" VALUE 0xC99C6 Kw_Wu8 255.0 OneToOne 0.00 255.0 FORMAT "%5.1" /end CHARACTERISTIC
/begin CHARACTERISTIC DSM_FMKDfp_VSSCD2_C "Ausblendbedingungen fuer Fehlerpfad Dfp_VSSCD2" VALUE 0xC99C7 Kw_Wu8 255.0 OneToOne 0.00 255.0 FORMAT "%5.1" /end CHARACTERISTIC
/begin CHARACTERISTIC DSM_FMKDfp_WdCom_C "Ausblendbedingungen fuer Fehlerpfad Dfp_WdCom" VALUE 0xC99C8 Kw_Wu8 255.0 OneToOne 0.00 255.0 FORMAT "%5.1" /end CHARACTERISTIC
/begin FUNCTION dsm_auto_blk ""
 /begin DEF_CHARACTERISTIC DSM_FMKDfp_Layer_TANS_C DSM_FMKDfp_ACCDCmpr_C DSM_FMKDfp_ACCDPres_C DSM_FMKDfp_ACCDPres1_C DSM_FMKDfp_ACCDPresAna_C DSM_FMKDfp_ACCDSwtin_C DSM_FMKDfp_ACC_PlausTrqDes_C DSM_FMKDfp_ACC_trqInr_C DSM_FMKDfp_ACTrq_C DSM_FMKDfp_ADCMon_C DSM_FMKDfp_AFSCDIdlAdjVal_C DSM_FMKDfp_AFSCDLdAdjVal_C DSM_FMKDfp_AFSCD_AirTempDcyc_C DSM_FMKDfp_AFSCD_PlOffsDrft_C DSM_FMKDfp_AFSCD_PlSetyDrft_C DSM_FMKDfp_AFSCD_SRCAirTemp_C DSM_FMKDfp_AFSCD_SRCBatt_C DSM_FMKDfp_AFSCD_SRCCorrAirm_C DSM_FMKDfp_AFSCD_SRCRawAirm_C DSM_FMKDfp_Layer_TUMG_C DSM_FMKDfp_AFSCD_SRCRefSigPer_C DSM_FMKDfp_AOHtCD_C DSM_FMKDfp_Layer_GEN_C DSM_FMKDfp_Layer_BSD_C DSM_FMKDfp_AOHtCD_AOHtDia1_C DSM_FMKDfp_AOHtCD_AOHtDia2_C DSM_FMKDfp_AOHtCD_AOHtDia3_C DSM_FMKDfp_APP1_C DSM_FMKDfp_APP2_C DSM_FMKDfp_APPSync_C DSM_FMKDfp_APSCD_C DSM_FMKDfp_ARS_C DSM_FMKDfp_AccPedPlausBrk_C DSM_FMKDfp_AirCtlGvnrDvtRgnMax_C DSM_FMKDfp_Layer_QLT_C DSM_FMKDfp_AirCtlGvnrDvtRgnMax2_C DSM_FMKDfp_Layer_IBS1_C DSM_FMKDfp_Layer_IBS2_C DSM_FMKDfp_Layer_IBS3_C DSM_FMKDfp_Layer_PMBN_C DSM_FMKDfp_Layer_PMBATT_C DSM_FMKDfp_AirCtlGvnrDvtRgnMin_C DSM_FMKDfp_AirCtlGvnrDvtRgnMin2_C DSM_FMKDfp_AirCtlPlateBreak_C DSM_FMKDfp_AirCtlRmpTO_C DSM_FMKDfp_AirCtl_GovNegDev_C DSM_FMKDfp_AirCtl_GovNegDev2_C DSM_FMKDfp_AirCtl_GovPosDev_C DSM_FMKDfp_AirCtl_GovPosDev2_C DSM_FMKDfp_AltCD_C DSM_FMKDfp_AltCD_Load_C DSM_FMKDfp_BPACD_BPADia1_C DSM_FMKDfp_BPACD_BPADia2_C DSM_FMKDfp_BPACD_BPADia3_C DSM_FMKDfp_BPACD_Max_C DSM_FMKDfp_BPACD_Min_C DSM_FMKDfp_BPACD_SigNpl_C DSM_FMKDfp_BPSCD_C DSM_FMKDfp_BattCD_C DSM_FMKDfp_BrkCD_C DSM_FMKDfp_Bss_C DSM_FMKDfp_CBACD_C DSM_FMKDfp_CTSCD_C DSM_FMKDfp_Clg_DynTst_C DSM_FMKDfp_CmbChbMisfire1_C DSM_FMKDfp_CmbChbMisfire2_C DSM_FMKDfp_CmbChbMisfire3_C DSM_FMKDfp_CmbChbMisfire4_C DSM_FMKDfp_CmbChbMisfire5_C DSM_FMKDfp_CmbChbMisfire6_C DSM_FMKDfp_CmbChbMisfireMul_C DSM_FMKDfp_CoVMDCSh_C DSM_FMKDfp_ConvCD_C DSM_FMKDfp_Layer_PMRUHVERL_C DSM_FMKDfp_CrCCDMFL_C DSM_FMKDfp_CrCtl_vCrCtl_C DSM_FMKDfp_DCC_PlausTrqDes_C DSM_FMKDfp_Dummy1_C DSM_FMKDfp_Layer_TOENS_C DSM_FMKDfp_Layer_MANHYDR_C DSM_FMKDfp_Layer_MANLUFT_C DSM_FMKDfp_EATSCD_C DSM_FMKDfp_EBAFCD_C DSM_FMKDfp_EBFCD_C DSM_FMKDfp_EBTSCD_C DSM_FMKDfp_EBTSCD_OvrTemp_C DSM_FMKDfp_EEPCDVarMng_C DSM_FMKDfp_EGPpCD_C DSM_FMKDfp_EGPpCDTPreTrbn_C DSM_FMKDfp_EGRCD_Max_C DSM_FMKDfp_EGRCD_Min_C DSM_FMKDfp_EGRCD_SigNpl_C DSM_FMKDfp_EGTRgnOilDil_C DSM_FMKDfp_EMCCDNoLoad1_C DSM_FMKDfp_EMCCDNoLoad2_C DSM_FMKDfp_EMCCDSCBat1_C DSM_FMKDfp_EMCCDSCBat2_C DSM_FMKDfp_EMCCDSCGnd1_C DSM_FMKDfp_EMCCDSCGnd2_C DSM_FMKDfp_EMCCD_ADC1_C DSM_FMKDfp_EMCCD_ADC2_C DSM_FMKDfp_ETClbETFltInj1_C DSM_FMKDfp_ETClbETFltInj2_C DSM_FMKDfp_ETClbETFltInj3_C DSM_FMKDfp_ETClbETFltInj4_C DSM_FMKDfp_ETClbETFltInj5_C DSM_FMKDfp_ETClbETFltInj6_C DSM_FMKDfp_ETClbInj1_C DSM_FMKDfp_ETClbInj2_C DSM_FMKDfp_ETClbInj3_C DSM_FMKDfp_ETClbInj4_C DSM_FMKDfp_ETClbInj5_C DSM_FMKDfp_ETClbInj6_C DSM_FMKDfp_EngMCaS1_C DSM_FMKDfp_EngMCrS1_C DSM_FMKDfp_EngMOfsCaSCrS_C DSM_FMKDfp_EngPrtFWODet_C DSM_FMKDfp_FBCqDvt_C DSM_FMKDfp_FMTC_NonMonotonMap_C DSM_FMKDfp_FTSCD_C DSM_FMKDfp_FanCD_C DSM_FMKDfp_FanCD_FanCtlr1_C DSM_FMKDfp_FanCD_FanCtlr2_C DSM_FMKDfp_FanCD_FanCtlr3_C DSM_FMKDfp_FlFCD_C DSM_FMKDfp_FlMngSmkDefect_C DSM_FMKDfp_FrmMngANFRADMOMPT_C DSM_FMKDfp_FrmMngASC1_C DSM_FMKDfp_FrmMngASC2_C DSM_FMKDfp_FrmMngASC3_C DSM_FMKDfp_FrmMngASC4_C DSM_FMKDfp_FrmMngBOS_RESET_C DSM_FMKDfp_FrmMngBOS_RESET_2_C DSM_FMKDfp_FrmMngDMANFAFS_C DSM_FMKDfp_FrmMngDRMANFSSG_C DSM_FMKDfp_FrmMngEGS1_C DSM_FMKDfp_FrmMngEGS2_C DSM_FMKDfp_FrmMngGEARBX_DATA_C DSM_FMKDfp_FrmMngGEARBX_DATA2_C DSM_FMKDfp_FrmMngHEAT_AC_C DSM_FMKDfp_FrmMngINSTR2_C DSM_FMKDfp_FrmMngINSTR3_C DSM_FMKDfp_FrmMngLENKRADWINKEL_C DSM_FMKDfp_FrmMngMILEAGE_RANGE_C DSM_FMKDfp_FrmMngOPCRCTLACC_C DSM_FMKDfp_FrmMngPRGG_CCTR_C DSM_FMKDfp_FrmMngPWRMNG_LOADV_C DSM_FMKDfp_FrmMngParkConsumer_C DSM_FMKDfp_FrmMngRQSTGEFAN_C DSM_FMKDfp_FrmMngSSGErr_C DSM_FMKDfp_FrmMngSSGShOff_C DSM_FMKDfp_FrmMngSTAT_ANH_C DSM_FMKDfp_FrmMngSTAT_ARS_C DSM_FMKDfp_FrmMngSTAT_DSC_C DSM_FMKDfp_FrmMngSTAT_EKP_C DSM_FMKDfp_FrmMngSTAT_KOMBI_C DSM_FMKDfp_FrmMngSTAT_SITZ_C DSM_FMKDfp_FrmMngStOBDGbxMilOf_C DSM_FMKDfp_FrmMngStOBDGbxMilOn_C DSM_FMKDfp_FrmMngTEMPRELTIME_C DSM_FMKDfp_FrmMngTERMINAL_C DSM_FMKDfp_FrmMngTIME_DATE_C DSM_FMKDfp_FrmMngTORQUE_DSC_C DSM_FMKDfp_FrmMngTORQUE_GEARBX_C DSM_FMKDfp_FrmMngTrq_ReqACC_C DSM_FMKDfp_FrmMngVEH_MOD_C DSM_FMKDfp_FrmMngVELOCITY_C DSM_FMKDfp_FrmMngWHEEL_SPEED_C DSM_FMKDfp_FrmMngstCurr_C DSM_FMKDfp_FrmMngswtPSPOff_C DSM_FMKDfp_GearbxIncMax_C DSM_FMKDfp_GlwCD_C DSM_FMKDfp_GlwCDGlwCirc1_C DSM_FMKDfp_GlwCDGlwCirc2_C DSM_FMKDfp_GlwCDGlwCirc3_C DSM_FMKDfp_GlwCDGlwCirc4_C DSM_FMKDfp_GlwCDGlwCirc5_C DSM_FMKDfp_GlwCDGlwCirc6_C DSM_FMKDfp_GlwCDGlwCirc7_C DSM_FMKDfp_GlwCDGlwCirc8_C DSM_FMKDfp_GlwCtl_C DSM_FMKDfp_HWEMonCom_C DSM_FMKDfp_HWEMonEEPROM_C DSM_FMKDfp_HWEMonRcyLocked_C DSM_FMKDfp_HWEMonRcySuppressed_C DSM_FMKDfp_HWEMonRcyVisible_C DSM_FMKDfp_HWEMonUMaxSupply_C DSM_FMKDfp_HWEMonUMinSupply_C DSM_FMKDfp_IATSCD_C DSM_FMKDfp_IATSCD_CATS_C DSM_FMKDfp_ImmCtlImmCD_C DSM_FMKDfp_ImmCtlImmEep_C DSM_FMKDfp_ImmCtlMpl_C DSM_FMKDfp_IndSys1_C DSM_FMKDfp_IndSys2_C DSM_FMKDfp_InjCrv_InjLim_C DSM_FMKDfp_InjCtlAdjQnt_C DSM_FMKDfp_InjCtlDrift_C DSM_FMKDfp_InjVCDActrChrg_C DSM_FMKDfp_InjVCDActrEnrg1_C DSM_FMKDfp_InjVCDActrEnrg2_C DSM_FMKDfp_InjVCDActrEnrg3_C DSM_FMKDfp_InjVCDActrEnrg4_C DSM_FMKDfp_InjVCDActrEnrg5_C DSM_FMKDfp_InjVCDActrEnrg6_C DSM_FMKDfp_InjVCDActrEnrg7_C DSM_FMKDfp_InjVCDActrEnrg8_C DSM_FMKDfp_InjVCDActrVolt_C DSM_FMKDfp_InjVCDClsBank1_C DSM_FMKDfp_InjVCDClsBank2_C DSM_FMKDfp_InjVCDMonCab_C DSM_FMKDfp_InjVCDMonSwt_C DSM_FMKDfp_InjVCDShOffDCDC_C DSM_FMKDfp_InjVCDUBuf_C DSM_FMKDfp_InjVCD_CY370Ampl_C DSM_FMKDfp_InjVlvBnk1A_C DSM_FMKDfp_InjVlvBnk1B_C DSM_FMKDfp_InjVlvBnk2A_C DSM_FMKDfp_InjVlvBnk2B_C DSM_FMKDfp_InjVlvChipA_C DSM_FMKDfp_InjVlvChipB_C DSM_FMKDfp_InjVlvCyl1A_C DSM_FMKDfp_InjVlvCyl1B_C DSM_FMKDfp_InjVlvCyl1C_C DSM_FMKDfp_InjVlvCyl2A_C DSM_FMKDfp_InjVlvCyl2B_C DSM_FMKDfp_InjVlvCyl2C_C DSM_FMKDfp_InjVlvCyl3A_C DSM_FMKDfp_InjVlvCyl3B_C DSM_FMKDfp_InjVlvCyl3C_C DSM_FMKDfp_InjVlvCyl4A_C DSM_FMKDfp_InjVlvCyl4B_C DSM_FMKDfp_InjVlvCyl4C_C DSM_FMKDfp_InjVlvCyl5A_C DSM_FMKDfp_InjVlvCyl5B_C DSM_FMKDfp_InjVlvCyl5C_C DSM_FMKDfp_InjVlvCyl6A_C DSM_FMKDfp_InjVlvCyl6B_C DSM_FMKDfp_InjVlvCyl6C_C DSM_FMKDfp_InjVlvCyl7A_C DSM_FMKDfp_InjVlvCyl7B_C DSM_FMKDfp_InjVlvCyl7C_C DSM_FMKDfp_InjVlvCyl8A_C DSM_FMKDfp_InjVlvCyl8B_C DSM_FMKDfp_InjVlvCyl8C_C DSM_FMKDfp_InjVlvNVC1_C DSM_FMKDfp_InjVlvNVC2_C DSM_FMKDfp_InjVlvNVC3_C DSM_FMKDfp_InjVlvNVC4_C DSM_FMKDfp_InjVlvNVC5_C DSM_FMKDfp_InjVlvNVC6_C DSM_FMKDfp_InjVlvNVC7_C DSM_FMKDfp_InjVlvNVC8_C DSM_FMKDfp_LPACD_Max_C DSM_FMKDfp_LPACD_Min_C DSM_FMKDfp_LPACD_SigNpl_C DSM_FMKDfp_LSUCDCircNernst0_C DSM_FMKDfp_LSUCDCircPumpCur0_C DSM_FMKDfp_LSUCDCircVirtGnd0_C DSM_FMKDfp_LSUCDHeater0_C DSM_FMKDfp_LSUCDHtCoup0_C DSM_FMKDfp_LSUCDO20_C DSM_FMKDfp_LSUCDO2Clb0_C DSM_FMKDfp_LSUCDRiClb0_C DSM_FMKDfp_LSUCDSPI0_C DSM_FMKDfp_LSUCDSPIBattLow0_C DSM_FMKDfp_LSUCDWireIP0_C DSM_FMKDfp_LSUCtlRiExc0_C DSM_FMKDfp_LSUMon1Sens_C DSM_FMKDfp_LSUMon2Sens_C DSM_FMKDfp_MIL_C DSM_FMKDfp_MRlyCD_C DSM_FMKDfp_MSidCD_Comm_C DSM_FMKDfp_MSidCD_Pin_C DSM_FMKDfp_MSidCD_Sel_INI_C DSM_FMKDfp_MSidCD_Select_C DSM_FMKDfp_MeUnCDNoLoad_C DSM_FMKDfp_MeUnCDSCBat_C DSM_FMKDfp_MeUnCDSCGnd_C DSM_FMKDfp_MeUnCD_ADC_C DSM_FMKDfp_MeUnCD_SigTst_C DSM_FMKDfp_Montr_C DSM_FMKDfp_NetMngDeviceA_C DSM_FMKDfp_NetMngDeviceB_C DSM_FMKDfp_NetMngDeviceC_C DSM_FMKDfp_OPSCD_Lamp_C DSM_FMKDfp_OPSCD_anain_C DSM_FMKDfp_OTSCD_C DSM_FMKDfp_OvRMon_C DSM_FMKDfp_OvRMonBrk_C DSM_FMKDfp_OvRMonSigA_C DSM_FMKDfp_OxiCCDTPre_C DSM_FMKDfp_PCR_GovDevNeg_C DSM_FMKDfp_PCR_GovDevPos_C DSM_FMKDfp_PCR_LPGvnrDvtNeg_C DSM_FMKDfp_PCR_LPGvnrDvtPos_C DSM_FMKDfp_PCVCDNoLoad_C DSM_FMKDfp_PCVCDSCBat_C DSM_FMKDfp_PCVCDSCGnd_C DSM_FMKDfp_PCVCD_ADC_C DSM_FMKDfp_PCVCD_SigTst_C DSM_FMKDfp_PFltAPSPlaus_C DSM_FMKDfp_PFltAPSens_C DSM_FMKDfp_PFltBPSPlaus_C DSM_FMKDfp_PFltCDPPre_C DSM_FMKDfp_PFltCDTempPre_C DSM_FMKDfp_PFltChar_C DSM_FMKDfp_PFltEngPrt_C DSM_FMKDfp_PFltPresDynPlaus_C DSM_FMKDfp_PFltPresPlaus_C DSM_FMKDfp_PFltPresSens_C DSM_FMKDfp_PFltPresSensFrz_C DSM_FMKDfp_PFltPresSensHsLn_C DSM_FMKDfp_PFltPresSensSot_C DSM_FMKDfp_PFltRgnPerm_C DSM_FMKDfp_PFltTempDwnStrm_C DSM_FMKDfp_PFltTempSens_C DSM_FMKDfp_PFltTempUpStrm_C DSM_FMKDfp_PFltmSotDiffMax_C DSM_FMKDfp_PSPCD_Actr_C DSM_FMKDfp_PresPlausDblDef_C DSM_FMKDfp_QLTCD_C DSM_FMKDfp_RailCD_C DSM_FMKDfp_RailCDOfsTst_C DSM_FMKDfp_RailCD_PMonStrt_C DSM_FMKDfp_RailCtlModeMeUnDiag_C DSM_FMKDfp_RailCtlModePCVDiag_C DSM_FMKDfp_RailMeUn0_C DSM_FMKDfp_RailMeUn1_C DSM_FMKDfp_RailMeUn2_C DSM_FMKDfp_RailMeUn3_C DSM_FMKDfp_RailMeUn4_C DSM_FMKDfp_RailPCV0_C DSM_FMKDfp_RailPCV1_C DSM_FMKDfp_RailPCV2_C DSM_FMKDfp_RailPCV3_C DSM_FMKDfp_RailPCV4_C DSM_FMKDfp_RailPCV5_C DSM_FMKDfp_SOPTst_C DSM_FMKDfp_SSpMon1_C DSM_FMKDfp_SSpMon2_C DSM_FMKDfp_SSpMon3_C DSM_FMKDfp_SWChk_CycSigChkDat_C DSM_FMKDfp_SWChk_CycSigChkPrg_C DSM_FMKDfp_ShutCD_C DSM_FMKDfp_StSysTrqShutOff_C DSM_FMKDfp_StrtCD_Actr_C DSM_FMKDfp_SysLamp_C DSM_FMKDfp_T15CD_C DSM_FMKDfp_TGearbx_C DSM_FMKDfp_TPUMon_C DSM_FMKDfp_TVACD_Max_C DSM_FMKDfp_TVACD_Min_C DSM_FMKDfp_TVACD_SigNpl_C DSM_FMKDfp_TVACD_TVADia1_C DSM_FMKDfp_TVACD_TVADia2_C DSM_FMKDfp_TVACD_TVADia3_C DSM_FMKDfp_TVACD_TVADia4_C DSM_FMKDfp_VSACD_DioInDia1_C DSM_FMKDfp_VSACD_DioInDia2_C DSM_FMKDfp_VSACD_DioInDia3_C DSM_FMKDfp_VSACD_DioInDia4_C DSM_FMKDfp_VSACD_DioInMin_C DSM_FMKDfp_VSACD_Max_C DSM_FMKDfp_VSACD_Min_C DSM_FMKDfp_VSACD_SigNpl_C DSM_FMKDfp_VSACD_VSADia1_C DSM_FMKDfp_VSACD_VSADia2_C DSM_FMKDfp_VSACD_VSADia3_C DSM_FMKDfp_VSACD_VSADia4_C DSM_FMKDfp_VSSCD1_C DSM_FMKDfp_VSSCD2_C DSM_FMKDfp_WdCom_C /end DEF_CHARACTERISTIC
/end FUNCTION
/begin FUNCTION dsm_auto_cdc ""
 /begin DEF_CHARACTERISTIC DSM_CDCDfp_Layer_TANS_C DSM_CDCDfp_ACCDCmpr_C DSM_CDCDfp_ACCDPres_C DSM_CDCDfp_ACCDPres1_C DSM_CDCDfp_ACCDPresAna_C DSM_CDCDfp_ACCDSwtin_C DSM_CDCDfp_ACC_PlausTrqDes_C DSM_CDCDfp_ACC_trqInr_C DSM_CDCDfp_ACTrq_C DSM_CDCDfp_ADCMon_C DSM_CDCDfp_AFSCDIdlAdjVal_C DSM_CDCDfp_AFSCDLdAdjVal_C DSM_CDCDfp_AFSCD_AirTempDcyc_C DSM_CDCDfp_AFSCD_PlOffsDrft_C DSM_CDCDfp_AFSCD_PlSetyDrft_C DSM_CDCDfp_AFSCD_SRCAirTemp_C DSM_CDCDfp_AFSCD_SRCBatt_C DSM_CDCDfp_AFSCD_SRCCorrAirm_C DSM_CDCDfp_AFSCD_SRCRawAirm_C DSM_CDCDfp_Layer_TUMG_C DSM_CDCDfp_AFSCD_SRCRefSigPer_C DSM_CDCDfp_AOHtCD_C DSM_CDCDfp_Layer_GEN_C DSM_CDCDfp_Layer_BSD_C DSM_CDCDfp_AOHtCD_AOHtDia1_C DSM_CDCDfp_AOHtCD_AOHtDia2_C DSM_CDCDfp_AOHtCD_AOHtDia3_C DSM_CDCDfp_APP1_C DSM_CDCDfp_APP2_C DSM_CDCDfp_APPSync_C DSM_CDCDfp_APSCD_C DSM_CDCDfp_ARS_C DSM_CDCDfp_AccPedPlausBrk_C DSM_CDCDfp_AirCtlGvnrDvtRgnMax_C DSM_CDCDfp_Layer_QLT_C DSM_CDCDfp_AirCtlGvnrDvtRgnMax2_C DSM_CDCDfp_Layer_IBS1_C DSM_CDCDfp_Layer_IBS2_C DSM_CDCDfp_Layer_IBS3_C DSM_CDCDfp_Layer_PMBN_C DSM_CDCDfp_Layer_PMBATT_C DSM_CDCDfp_AirCtlGvnrDvtRgnMin_C DSM_CDCDfp_AirCtlGvnrDvtRgnMin2_C DSM_CDCDfp_AirCtlPlateBreak_C DSM_CDCDfp_AirCtlRmpTO_C DSM_CDCDfp_AirCtl_GovNegDev_C DSM_CDCDfp_AirCtl_GovNegDev2_C DSM_CDCDfp_AirCtl_GovPosDev_C DSM_CDCDfp_AirCtl_GovPosDev2_C DSM_CDCDfp_AltCD_C DSM_CDCDfp_AltCD_Load_C DSM_CDCDfp_BPACD_BPADia1_C DSM_CDCDfp_BPACD_BPADia2_C DSM_CDCDfp_BPACD_BPADia3_C DSM_CDCDfp_BPACD_Max_C DSM_CDCDfp_BPACD_Min_C DSM_CDCDfp_BPACD_SigNpl_C DSM_CDCDfp_BPSCD_C DSM_CDCDfp_BattCD_C DSM_CDCDfp_BrkCD_C DSM_CDCDfp_Bss_C DSM_CDCDfp_CBACD_C DSM_CDCDfp_CTSCD_C DSM_CDCDfp_Clg_DynTst_C DSM_CDCDfp_CmbChbMisfire1_C DSM_CDCDfp_CmbChbMisfire2_C DSM_CDCDfp_CmbChbMisfire3_C DSM_CDCDfp_CmbChbMisfire4_C DSM_CDCDfp_CmbChbMisfire5_C DSM_CDCDfp_CmbChbMisfire6_C DSM_CDCDfp_CmbChbMisfireMul_C DSM_CDCDfp_CoVMDCSh_C DSM_CDCDfp_ConvCD_C DSM_CDCDfp_Layer_PMRUHVERL_C DSM_CDCDfp_CrCCDMFL_C DSM_CDCDfp_CrCtl_vCrCtl_C DSM_CDCDfp_DCC_PlausTrqDes_C DSM_CDCDfp_Dummy1_C DSM_CDCDfp_Layer_TOENS_C DSM_CDCDfp_Layer_MANHYDR_C DSM_CDCDfp_Layer_MANLUFT_C DSM_CDCDfp_EATSCD_C DSM_CDCDfp_EBAFCD_C DSM_CDCDfp_EBFCD_C DSM_CDCDfp_EBTSCD_C DSM_CDCDfp_EBTSCD_OvrTemp_C DSM_CDCDfp_EEPCDVarMng_C DSM_CDCDfp_EGPpCD_C DSM_CDCDfp_EGPpCDTPreTrbn_C DSM_CDCDfp_EGRCD_Max_C DSM_CDCDfp_EGRCD_Min_C DSM_CDCDfp_EGRCD_SigNpl_C DSM_CDCDfp_EGTRgnOilDil_C DSM_CDCDfp_EMCCDNoLoad1_C DSM_CDCDfp_EMCCDNoLoad2_C DSM_CDCDfp_EMCCDSCBat1_C DSM_CDCDfp_EMCCDSCBat2_C DSM_CDCDfp_EMCCDSCGnd1_C DSM_CDCDfp_EMCCDSCGnd2_C DSM_CDCDfp_EMCCD_ADC1_C DSM_CDCDfp_EMCCD_ADC2_C DSM_CDCDfp_ETClbETFltInj1_C DSM_CDCDfp_ETClbETFltInj2_C DSM_CDCDfp_ETClbETFltInj3_C DSM_CDCDfp_ETClbETFltInj4_C DSM_CDCDfp_ETClbETFltInj5_C DSM_CDCDfp_ETClbETFltInj6_C DSM_CDCDfp_ETClbInj1_C DSM_CDCDfp_ETClbInj2_C DSM_CDCDfp_ETClbInj3_C DSM_CDCDfp_ETClbInj4_C DSM_CDCDfp_ETClbInj5_C DSM_CDCDfp_ETClbInj6_C DSM_CDCDfp_EngMCaS1_C DSM_CDCDfp_EngMCrS1_C DSM_CDCDfp_EngMOfsCaSCrS_C DSM_CDCDfp_EngPrtFWODet_C DSM_CDCDfp_FBCqDvt_C DSM_CDCDfp_FMTC_NonMonotonMap_C DSM_CDCDfp_FTSCD_C DSM_CDCDfp_FanCD_C DSM_CDCDfp_FanCD_FanCtlr1_C DSM_CDCDfp_FanCD_FanCtlr2_C DSM_CDCDfp_FanCD_FanCtlr3_C DSM_CDCDfp_FlFCD_C DSM_CDCDfp_FlMngSmkDefect_C DSM_CDCDfp_FrmMngANFRADMOMPT_C DSM_CDCDfp_FrmMngASC1_C DSM_CDCDfp_FrmMngASC2_C DSM_CDCDfp_FrmMngASC3_C DSM_CDCDfp_FrmMngASC4_C DSM_CDCDfp_FrmMngBOS_RESET_C DSM_CDCDfp_FrmMngBOS_RESET_2_C DSM_CDCDfp_FrmMngDMANFAFS_C DSM_CDCDfp_FrmMngDRMANFSSG_C DSM_CDCDfp_FrmMngEGS1_C DSM_CDCDfp_FrmMngEGS2_C DSM_CDCDfp_FrmMngGEARBX_DATA_C DSM_CDCDfp_FrmMngGEARBX_DATA2_C DSM_CDCDfp_FrmMngHEAT_AC_C DSM_CDCDfp_FrmMngINSTR2_C DSM_CDCDfp_FrmMngINSTR3_C DSM_CDCDfp_FrmMngLENKRADWINKEL_C DSM_CDCDfp_FrmMngMILEAGE_RANGE_C DSM_CDCDfp_FrmMngOPCRCTLACC_C DSM_CDCDfp_FrmMngPRGG_CCTR_C DSM_CDCDfp_FrmMngPWRMNG_LOADV_C DSM_CDCDfp_FrmMngParkConsumer_C DSM_CDCDfp_FrmMngRQSTGEFAN_C DSM_CDCDfp_FrmMngSSGErr_C DSM_CDCDfp_FrmMngSSGShOff_C DSM_CDCDfp_FrmMngSTAT_ANH_C DSM_CDCDfp_FrmMngSTAT_ARS_C DSM_CDCDfp_FrmMngSTAT_DSC_C DSM_CDCDfp_FrmMngSTAT_EKP_C DSM_CDCDfp_FrmMngSTAT_KOMBI_C DSM_CDCDfp_FrmMngSTAT_SITZ_C DSM_CDCDfp_FrmMngStOBDGbxMilOf_C DSM_CDCDfp_FrmMngStOBDGbxMilOn_C DSM_CDCDfp_FrmMngTEMPRELTIME_C DSM_CDCDfp_FrmMngTERMINAL_C DSM_CDCDfp_FrmMngTIME_DATE_C DSM_CDCDfp_FrmMngTORQUE_DSC_C DSM_CDCDfp_FrmMngTORQUE_GEARBX_C DSM_CDCDfp_FrmMngTrq_ReqACC_C DSM_CDCDfp_FrmMngVEH_MOD_C DSM_CDCDfp_FrmMngVELOCITY_C DSM_CDCDfp_FrmMngWHEEL_SPEED_C DSM_CDCDfp_FrmMngstCurr_C DSM_CDCDfp_FrmMngswtPSPOff_C DSM_CDCDfp_GearbxIncMax_C DSM_CDCDfp_GlwCD_C DSM_CDCDfp_GlwCDGlwCirc1_C DSM_CDCDfp_GlwCDGlwCirc2_C DSM_CDCDfp_GlwCDGlwCirc3_C DSM_CDCDfp_GlwCDGlwCirc4_C DSM_CDCDfp_GlwCDGlwCirc5_C DSM_CDCDfp_GlwCDGlwCirc6_C DSM_CDCDfp_GlwCDGlwCirc7_C DSM_CDCDfp_GlwCDGlwCirc8_C DSM_CDCDfp_GlwCtl_C DSM_CDCDfp_HWEMonCom_C DSM_CDCDfp_HWEMonEEPROM_C DSM_CDCDfp_HWEMonRcyLocked_C DSM_CDCDfp_HWEMonRcySuppressed_C DSM_CDCDfp_HWEMonRcyVisible_C DSM_CDCDfp_HWEMonUMaxSupply_C DSM_CDCDfp_HWEMonUMinSupply_C DSM_CDCDfp_IATSCD_C DSM_CDCDfp_IATSCD_CATS_C DSM_CDCDfp_ImmCtlImmCD_C DSM_CDCDfp_ImmCtlImmEep_C DSM_CDCDfp_ImmCtlMpl_C DSM_CDCDfp_IndSys1_C DSM_CDCDfp_IndSys2_C DSM_CDCDfp_InjCrv_InjLim_C DSM_CDCDfp_InjCtlAdjQnt_C DSM_CDCDfp_InjCtlDrift_C DSM_CDCDfp_InjVCDActrChrg_C DSM_CDCDfp_InjVCDActrEnrg1_C DSM_CDCDfp_InjVCDActrEnrg2_C DSM_CDCDfp_InjVCDActrEnrg3_C DSM_CDCDfp_InjVCDActrEnrg4_C DSM_CDCDfp_InjVCDActrEnrg5_C DSM_CDCDfp_InjVCDActrEnrg6_C DSM_CDCDfp_InjVCDActrEnrg7_C DSM_CDCDfp_InjVCDActrEnrg8_C DSM_CDCDfp_InjVCDActrVolt_C DSM_CDCDfp_InjVCDClsBank1_C DSM_CDCDfp_InjVCDClsBank2_C DSM_CDCDfp_InjVCDMonCab_C DSM_CDCDfp_InjVCDMonSwt_C DSM_CDCDfp_InjVCDShOffDCDC_C DSM_CDCDfp_InjVCDUBuf_C DSM_CDCDfp_InjVCD_CY370Ampl_C DSM_CDCDfp_InjVlvBnk1A_C DSM_CDCDfp_InjVlvBnk1B_C DSM_CDCDfp_InjVlvBnk2A_C DSM_CDCDfp_InjVlvBnk2B_C DSM_CDCDfp_InjVlvChipA_C DSM_CDCDfp_InjVlvChipB_C DSM_CDCDfp_InjVlvCyl1A_C DSM_CDCDfp_InjVlvCyl1B_C DSM_CDCDfp_InjVlvCyl1C_C DSM_CDCDfp_InjVlvCyl2A_C DSM_CDCDfp_InjVlvCyl2B_C DSM_CDCDfp_InjVlvCyl2C_C DSM_CDCDfp_InjVlvCyl3A_C DSM_CDCDfp_InjVlvCyl3B_C DSM_CDCDfp_InjVlvCyl3C_C DSM_CDCDfp_InjVlvCyl4A_C DSM_CDCDfp_InjVlvCyl4B_C DSM_CDCDfp_InjVlvCyl4C_C DSM_CDCDfp_InjVlvCyl5A_C DSM_CDCDfp_InjVlvCyl5B_C DSM_CDCDfp_InjVlvCyl5C_C DSM_CDCDfp_InjVlvCyl6A_C DSM_CDCDfp_InjVlvCyl6B_C DSM_CDCDfp_InjVlvCyl6C_C DSM_CDCDfp_InjVlvCyl7A_C DSM_CDCDfp_InjVlvCyl7B_C DSM_CDCDfp_InjVlvCyl7C_C DSM_CDCDfp_InjVlvCyl8A_C DSM_CDCDfp_InjVlvCyl8B_C DSM_CDCDfp_InjVlvCyl8C_C DSM_CDCDfp_InjVlvNVC1_C DSM_CDCDfp_InjVlvNVC2_C DSM_CDCDfp_InjVlvNVC3_C DSM_CDCDfp_InjVlvNVC4_C DSM_CDCDfp_InjVlvNVC5_C DSM_CDCDfp_InjVlvNVC6_C DSM_CDCDfp_InjVlvNVC7_C DSM_CDCDfp_InjVlvNVC8_C DSM_CDCDfp_LPACD_Max_C DSM_CDCDfp_LPACD_Min_C DSM_CDCDfp_LPACD_SigNpl_C DSM_CDCDfp_LSUCDCircNernst0_C DSM_CDCDfp_LSUCDCircPumpCur0_C DSM_CDCDfp_LSUCDCircVirtGnd0_C DSM_CDCDfp_LSUCDHeater0_C DSM_CDCDfp_LSUCDHtCoup0_C DSM_CDCDfp_LSUCDO20_C DSM_CDCDfp_LSUCDO2Clb0_C DSM_CDCDfp_LSUCDRiClb0_C DSM_CDCDfp_LSUCDSPI0_C DSM_CDCDfp_LSUCDSPIBattLow0_C DSM_CDCDfp_LSUCDWireIP0_C DSM_CDCDfp_LSUCtlRiExc0_C DSM_CDCDfp_LSUMon1Sens_C DSM_CDCDfp_LSUMon2Sens_C DSM_CDCDfp_MIL_C DSM_CDCDfp_MRlyCD_C DSM_CDCDfp_MSidCD_Comm_C DSM_CDCDfp_MSidCD_Pin_C DSM_CDCDfp_MSidCD_Sel_INI_C DSM_CDCDfp_MSidCD_Select_C DSM_CDCDfp_MeUnCDNoLoad_C DSM_CDCDfp_MeUnCDSCBat_C DSM_CDCDfp_MeUnCDSCGnd_C DSM_CDCDfp_MeUnCD_ADC_C DSM_CDCDfp_MeUnCD_SigTst_C DSM_CDCDfp_Montr_C DSM_CDCDfp_NetMngDeviceA_C DSM_CDCDfp_NetMngDeviceB_C DSM_CDCDfp_NetMngDeviceC_C DSM_CDCDfp_OPSCD_Lamp_C DSM_CDCDfp_OPSCD_anain_C DSM_CDCDfp_OTSCD_C DSM_CDCDfp_OvRMon_C DSM_CDCDfp_OvRMonBrk_C DSM_CDCDfp_OvRMonSigA_C DSM_CDCDfp_OxiCCDTPre_C DSM_CDCDfp_PCR_GovDevNeg_C DSM_CDCDfp_PCR_GovDevPos_C DSM_CDCDfp_PCR_LPGvnrDvtNeg_C DSM_CDCDfp_PCR_LPGvnrDvtPos_C DSM_CDCDfp_PCVCDNoLoad_C DSM_CDCDfp_PCVCDSCBat_C DSM_CDCDfp_PCVCDSCGnd_C DSM_CDCDfp_PCVCD_ADC_C DSM_CDCDfp_PCVCD_SigTst_C DSM_CDCDfp_PFltAPSPlaus_C DSM_CDCDfp_PFltAPSens_C DSM_CDCDfp_PFltBPSPlaus_C DSM_CDCDfp_PFltCDPPre_C DSM_CDCDfp_PFltCDTempPre_C DSM_CDCDfp_PFltChar_C DSM_CDCDfp_PFltEngPrt_C DSM_CDCDfp_PFltPresDynPlaus_C DSM_CDCDfp_PFltPresPlaus_C DSM_CDCDfp_PFltPresSens_C DSM_CDCDfp_PFltPresSensFrz_C DSM_CDCDfp_PFltPresSensHsLn_C DSM_CDCDfp_PFltPresSensSot_C DSM_CDCDfp_PFltRgnPerm_C DSM_CDCDfp_PFltTempDwnStrm_C DSM_CDCDfp_PFltTempSens_C DSM_CDCDfp_PFltTempUpStrm_C DSM_CDCDfp_PFltmSotDiffMax_C DSM_CDCDfp_PSPCD_Actr_C DSM_CDCDfp_PresPlausDblDef_C DSM_CDCDfp_QLTCD_C DSM_CDCDfp_RailCD_C DSM_CDCDfp_RailCDOfsTst_C DSM_CDCDfp_RailCD_PMonStrt_C DSM_CDCDfp_RailCtlModeMeUnDiag_C DSM_CDCDfp_RailCtlModePCVDiag_C DSM_CDCDfp_RailMeUn0_C DSM_CDCDfp_RailMeUn1_C DSM_CDCDfp_RailMeUn2_C DSM_CDCDfp_RailMeUn3_C DSM_CDCDfp_RailMeUn4_C DSM_CDCDfp_RailPCV0_C DSM_CDCDfp_RailPCV1_C DSM_CDCDfp_RailPCV2_C DSM_CDCDfp_RailPCV3_C DSM_CDCDfp_RailPCV4_C DSM_CDCDfp_RailPCV5_C DSM_CDCDfp_SOPTst_C DSM_CDCDfp_SSpMon1_C DSM_CDCDfp_SSpMon2_C DSM_CDCDfp_SSpMon3_C DSM_CDCDfp_SWChk_CycSigChkDat_C DSM_CDCDfp_SWChk_CycSigChkPrg_C DSM_CDCDfp_ShutCD_C DSM_CDCDfp_StSysTrqShutOff_C DSM_CDCDfp_StrtCD_Actr_C DSM_CDCDfp_SysLamp_C DSM_CDCDfp_T15CD_C DSM_CDCDfp_TGearbx_C DSM_CDCDfp_TPUMon_C DSM_CDCDfp_TVACD_Max_C DSM_CDCDfp_TVACD_Min_C DSM_CDCDfp_TVACD_SigNpl_C DSM_CDCDfp_TVACD_TVADia1_C DSM_CDCDfp_TVACD_TVADia2_C DSM_CDCDfp_TVACD_TVADia3_C DSM_CDCDfp_TVACD_TVADia4_C DSM_CDCDfp_VSACD_DioInDia1_C DSM_CDCDfp_VSACD_DioInDia2_C DSM_CDCDfp_VSACD_DioInDia3_C DSM_CDCDfp_VSACD_DioInDia4_C DSM_CDCDfp_VSACD_DioInMin_C DSM_CDCDfp_VSACD_Max_C DSM_CDCDfp_VSACD_Min_C DSM_CDCDfp_VSACD_SigNpl_C DSM_CDCDfp_VSACD_VSADia1_C DSM_CDCDfp_VSACD_VSADia2_C DSM_CDCDfp_VSACD_VSADia3_C DSM_CDCDfp_VSACD_VSADia4_C DSM_CDCDfp_VSSCD1_C DSM_CDCDfp_VSSCD2_C DSM_CDCDfp_WdCom_C /end DEF_CHARACTERISTIC
/end FUNCTION
/begin COMPU_METHOD OneToOne "eins zu eins (physikalischer Wert ist gleich dem internen Wert)" RAT_FUNC "%6.2" "-" COEFFS 0 1 0 0 0 1 /end COMPU_METHOD
/begin RECORD_LAYOUT Kwb_Wu16 FNC_VALUES 1 UWORD COLUMN_DIR DIRECT /end RECORD_LAYOUT
/begin RECORD_LAYOUT Kw_Wu8 FNC_VALUES 1 UBYTE COLUMN_DIR DIRECT /end RECORD_LAYOUT
/end MODULE
/end PROJECT
