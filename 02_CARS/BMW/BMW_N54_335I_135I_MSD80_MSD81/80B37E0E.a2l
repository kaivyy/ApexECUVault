ASAP2_VERSION 1 41
/begin PROJECT MSD70 "Spray Guided DI-System with Piezo Injectors for 6-Cylinder"
/begin HEADER "_default_HeaderComment" PROJECT_NO _0B /end HEADER
/begin MODULE _default_ModuleName "_default_ModuleLongIdentifier"
/begin MOD_COMMON "_default_ModCommonComment" DEPOSIT ABSOLUTE BYTE_ORDER MSB_LAST ALIGNMENT_BYTE 1 ALIGNMENT_WORD 2 ALIGNMENT_LONG 2 ALIGNMENT_FLOAT32_IEEE 2 ALIGNMENT_FLOAT64_IEEE 4 /end MOD_COMMON
/begin CHARACTERISTIC fmy_id_imob_1.c_err_clas "Failure class number for failure XX" VALUE 0xa1004324 _REC_VAL_20_u1 255. _CNV_A_R_LINEAR_____0_CM 0. 255. DISPLAY_IDENTIFIER C_ERR_CLAS_IMOB_1 FORMAT "%3.0" /end CHARACTERISTIC
/begin CHARACTERISTIC fmy_id_imob_2.c_err_clas "Failure class number for failure XX" VALUE 0xa1004338 _REC_VAL_20_u1 255. _CNV_A_R_LINEAR_____0_CM 0. 255. DISPLAY_IDENTIFIER C_ERR_CLAS_IMOB_2 FORMAT "%3.0" /end CHARACTERISTIC
/begin CHARACTERISTIC fmy_id_imob_3.c_err_clas "Failure class number for failure XX" VALUE 0xa100434c _REC_VAL_20_u1 255. _CNV_A_R_LINEAR_____0_CM 0. 255. DISPLAY_IDENTIFIER C_ERR_CLAS_IMOB_3 FORMAT "%3.0" /end CHARACTERISTIC
/begin CHARACTERISTIC fmy_id_tco_el.c_err_clas "Failure class number for failure XX" VALUE 0xa1004cd4 _REC_VAL_20_u1 255. _CNV_A_R_LINEAR_____0_CM 0. 255. DISPLAY_IDENTIFIER C_ERR_CLAS_TCO_EL FORMAT "%3.0" /end CHARACTERISTIC
/begin CHARACTERISTIC fmy_id_tco_grd.c_err_clas "Failure class number for failure XX" VALUE 0xa1004ce8 _REC_VAL_20_u1 255. _CNV_A_R_LINEAR_____0_CM 0. 255. DISPLAY_IDENTIFIER C_ERR_CLAS_TCO_GRD FORMAT "%3.0" /end CHARACTERISTIC
/begin CHARACTERISTIC fmy_id_tco_stuck.c_err_clas "Failure class number for failure XX" VALUE 0xa1004d10 _REC_VAL_20_u1 255. _CNV_A_R_LINEAR_____0_CM 0. 255. DISPLAY_IDENTIFIER C_ERR_CLAS_TCO_STUCK FORMAT "%3.0" /end CHARACTERISTIC
/begin CHARACTERISTIC fmy_id_tco_plaus.c_err_clas "Failure class number for failure XX" VALUE 0xa1004cfc _REC_VAL_20_u1 255. _CNV_A_R_LINEAR_____0_CM 0. 255. DISPLAY_IDENTIFIER C_ERR_CLAS_TCO_PLAUS FORMAT "%3.0" /end CHARACTERISTIC
/begin CHARACTERISTIC fmy_id_tco_2_el.c_err_clas "Failure class number for failure XX" VALUE 0xa1004c98 _REC_VAL_20_u1 255. _CNV_A_R_LINEAR_____0_CM 0. 255. DISPLAY_IDENTIFIER C_ERR_CLAS_TCO_2_EL FORMAT "%3.0" /end CHARACTERISTIC
/begin CHARACTERISTIC fmy_id_tco_2_grd.c_err_clas "Failure class number for failure XX" VALUE 0xa1004cac _REC_VAL_20_u1 255. _CNV_A_R_LINEAR_____0_CM 0. 255. DISPLAY_IDENTIFIER C_ERR_CLAS_TCO_2_GRD FORMAT "%3.0" /end CHARACTERISTIC
/begin CHARACTERISTIC fmy_id_tco_2_plaus.c_err_clas "Failure class number for failure XX" VALUE 0xa1004cc0 _REC_VAL_20_u1 255. _CNV_A_R_LINEAR_____0_CM 0. 255. DISPLAY_IDENTIFIER C_ERR_CLAS_TCO_2_PLAUS FORMAT "%3.0" /end CHARACTERISTIC
/begin CHARACTERISTIC fmy_id_ect_el.c_err_clas "Failure class number for failure XX" VALUE 0xa1003f8c _REC_VAL_20_u1 255. _CNV_A_R_LINEAR_____0_CM 0. 255. DISPLAY_IDENTIFIER C_ERR_CLAS_ECT_EL FORMAT "%3.0" /end CHARACTERISTIC
/begin CHARACTERISTIC fmy_id_ecf_el_1.c_err_clas "Failure class number for failure XX" VALUE 0xa1003f3c _REC_VAL_20_u1 255. _CNV_A_R_LINEAR_____0_CM 0. 255. DISPLAY_IDENTIFIER C_ERR_CLAS_ECF_EL_1 FORMAT "%3.0" /end CHARACTERISTIC
/begin CHARACTERISTIC fmy_id_ecfpwm_fb_1.c_err_clas "Failure class number for failure XX" VALUE 0xa1003f50 _REC_VAL_20_u1 255. _CNV_A_R_LINEAR_____0_CM 0. 255. DISPLAY_IDENTIFIER C_ERR_CLAS_ECFPWM_FB_1 FORMAT "%3.0" /end CHARACTERISTIC
/begin CHARACTERISTIC fmy_id_th.c_err_clas "Failure class number for failure XX" VALUE 0xa1004d60 _REC_VAL_20_u1 255. _CNV_A_R_LINEAR_____0_CM 0. 255. DISPLAY_IDENTIFIER C_ERR_CLAS_TH FORMAT "%3.0" /end CHARACTERISTIC
/begin CHARACTERISTIC fmy_id_ftl_min.c_err_clas "Failure class number for failure XX" VALUE 0xa10040e0 _REC_VAL_20_u1 255. _CNV_A_R_LINEAR_____0_CM 0. 255. DISPLAY_IDENTIFIER C_ERR_CLAS_FTL_MIN FORMAT "%3.0" /end CHARACTERISTIC
/begin CHARACTERISTIC fmy_id_tia_el.c_err_clas "Failure class number for failure XX" VALUE 0xa1004d74 _REC_VAL_20_u1 255. _CNV_A_R_LINEAR_____0_CM 0. 255. DISPLAY_IDENTIFIER C_ERR_CLAS_TIA_EL FORMAT "%3.0" /end CHARACTERISTIC
/begin CHARACTERISTIC fmy_id_amp.c_err_clas "Failure class number for failure XX" VALUE 0xa100399c _REC_VAL_20_u1 255. _CNV_A_R_LINEAR_____0_CM 0. 255. DISPLAY_IDENTIFIER C_ERR_CLAS_AMP FORMAT "%3.0" /end CHARACTERISTIC
/begin CHARACTERISTIC fmy_id_amp_plaus.c_err_clas "Failure class number for failure XX" VALUE 0xa10039b0 _REC_VAL_20_u1 255. _CNV_A_R_LINEAR_____0_CM 0. 255. DISPLAY_IDENTIFIER C_ERR_CLAS_AMP_PLAUS FORMAT "%3.0" /end CHARACTERISTIC
/begin CHARACTERISTIC fmy_id_maf.c_err_clas "Failure class number for failure XX" VALUE 0xa1004504 _REC_VAL_20_u1 255. _CNV_A_R_LINEAR_____0_CM 0. 255. DISPLAY_IDENTIFIER C_ERR_CLAS_MAF FORMAT "%3.0" /end CHARACTERISTIC
/begin CHARACTERISTIC fmy_id_iv_0.c_err_clas "Failure class number for failure XX" VALUE 0xa1004374 _REC_VAL_20_u1 255. _CNV_A_R_LINEAR_____0_CM 0. 255. DISPLAY_IDENTIFIER C_ERR_CLAS_IV_0 FORMAT "%3.0" /end CHARACTERISTIC
/begin CHARACTERISTIC fmy_id_iv_1.c_err_clas "Failure class number for failure XX" VALUE 0xa1004388 _REC_VAL_20_u1 255. _CNV_A_R_LINEAR_____0_CM 0. 255. DISPLAY_IDENTIFIER C_ERR_CLAS_IV_1 FORMAT "%3.0" /end CHARACTERISTIC
/begin CHARACTERISTIC fmy_id_iv_2.c_err_clas "Failure class number for failure XX" VALUE 0xa100439c _REC_VAL_20_u1 255. _CNV_A_R_LINEAR_____0_CM 0. 255. DISPLAY_IDENTIFIER C_ERR_CLAS_IV_2 FORMAT "%3.0" /end CHARACTERISTIC
/begin CHARACTERISTIC fmy_id_iv_3.c_err_clas "Failure class number for failure XX" VALUE 0xa10043b0 _REC_VAL_20_u1 255. _CNV_A_R_LINEAR_____0_CM 0. 255. DISPLAY_IDENTIFIER C_ERR_CLAS_IV_3 FORMAT "%3.0" /end CHARACTERISTIC
/begin CHARACTERISTIC fmy_id_iv_4.c_err_clas "Failure class number for failure XX" VALUE 0xa10043c4 _REC_VAL_20_u1 255. _CNV_A_R_LINEAR_____0_CM 0. 255. DISPLAY_IDENTIFIER C_ERR_CLAS_IV_4 FORMAT "%3.0" /end CHARACTERISTIC
/begin CHARACTERISTIC fmy_id_iv_5.c_err_clas "Failure class number for failure XX" VALUE 0xa10043d8 _REC_VAL_20_u1 255. _CNV_A_R_LINEAR_____0_CM 0. 255. DISPLAY_IDENTIFIER C_ERR_CLAS_IV_5 FORMAT "%3.0" /end CHARACTERISTIC
/begin CHARACTERISTIC fmy_id_rly_efp.c_err_clas "Failure class number for failure XX" VALUE 0xa10049f0 _REC_VAL_20_u1 255. _CNV_A_R_LINEAR_____0_CM 0. 255. DISPLAY_IDENTIFIER C_ERR_CLAS_RLY_EFP FORMAT "%3.0" /end CHARACTERISTIC
/begin CHARACTERISTIC fmy_id_el_cps.c_err_clas "Failure class number for failure XX" VALUE 0xa1004040 _REC_VAL_20_u1 255. _CNV_A_R_LINEAR_____0_CM 0. 255. DISPLAY_IDENTIFIER C_ERR_CLAS_EL_CPS FORMAT "%3.0" /end CHARACTERISTIC
/begin CHARACTERISTIC fmy_id_slv_ivvt_in.c_err_clas "Failure class number for failure XX" VALUE 0xa1004b58 _REC_VAL_20_u1 255. _CNV_A_R_LINEAR_____0_CM 0. 255. DISPLAY_IDENTIFIER C_ERR_CLAS_SLV_IVVT_IN FORMAT "%3.0" /end CHARACTERISTIC
/begin CHARACTERISTIC fmy_id_slv_ivvt_ex.c_err_clas "Failure class number for failure XX" VALUE 0xa1004b44 _REC_VAL_20_u1 255. _CNV_A_R_LINEAR_____0_CM 0. 255. DISPLAY_IDENTIFIER C_ERR_CLAS_SLV_IVVT_EX FORMAT "%3.0" /end CHARACTERISTIC
/begin CHARACTERISTIC fmy_id_ecu_cks.c_err_clas "Failure class number for failure XX" VALUE 0xa1003fa0 _REC_VAL_20_u1 255. _CNV_A_R_LINEAR_____0_CM 0. 255. DISPLAY_IDENTIFIER C_ERR_CLAS_ECU_CKS FORMAT "%3.0" /end CHARACTERISTIC
/begin CHARACTERISTIC fmy_id_tout_etcu_1.c_err_clas "Failure class number for failure XX" VALUE 0xa1004e14 _REC_VAL_20_u1 255. _CNV_A_R_LINEAR_____0_CM 0. 255. DISPLAY_IDENTIFIER C_ERR_CLAS_TOUT_ETCU_1 FORMAT "%3.0" /end CHARACTERISTIC
/begin CHARACTERISTIC fmy_id_tout_etcu_2.c_err_clas "Failure class number for failure XX" VALUE 0xa1004e28 _REC_VAL_20_u1 255. _CNV_A_R_LINEAR_____0_CM 0. 255. DISPLAY_IDENTIFIER C_ERR_CLAS_TOUT_ETCU_2 FORMAT "%3.0" /end CHARACTERISTIC
/begin CHARACTERISTIC fmy_id_tout_icl_2.c_err_clas "Failure class number for failure XX" VALUE 0xa1004e3c _REC_VAL_20_u1 255. _CNV_A_R_LINEAR_____0_CM 0. 255. DISPLAY_IDENTIFIER C_ERR_CLAS_TOUT_ICL_2 FORMAT "%3.0" /end CHARACTERISTIC
/begin CHARACTERISTIC fmy_id_tout_icl_3.c_err_clas "Failure class number for failure XX" VALUE 0xa1004e50 _REC_VAL_20_u1 255. _CNV_A_R_LINEAR_____0_CM 0. 255. DISPLAY_IDENTIFIER C_ERR_CLAS_TOUT_ICL_3 FORMAT "%3.0" /end CHARACTERISTIC
/begin CHARACTERISTIC fmy_id_tout_asr_1.c_err_clas "Failure class number for failure XX" VALUE 0xa1004dc4 _REC_VAL_20_u1 255. _CNV_A_R_LINEAR_____0_CM 0. 255. DISPLAY_IDENTIFIER C_ERR_CLAS_TOUT_ASR_1 FORMAT "%3.0" /end CHARACTERISTIC
/begin CHARACTERISTIC fmy_id_tout_asr_3.c_err_clas "Failure class number for failure XX" VALUE 0xa1004dd8 _REC_VAL_20_u1 255. _CNV_A_R_LINEAR_____0_CM 0. 255. DISPLAY_IDENTIFIER C_ERR_CLAS_TOUT_ASR_3 FORMAT "%3.0" /end CHARACTERISTIC
/begin CHARACTERISTIC fmy_id_tout_asr_4.c_err_clas "Failure class number for failure XX" VALUE 0xa1004dec _REC_VAL_20_u1 255. _CNV_A_R_LINEAR_____0_CM 0. 255. DISPLAY_IDENTIFIER C_ERR_CLAS_TOUT_ASR_4 FORMAT "%3.0" /end CHARACTERISTIC
/begin CHARACTERISTIC fmy_id_tout_pste_1.c_err_clas "Failure class number for failure XX" VALUE 0xa1004e8c _REC_VAL_20_u1 255. _CNV_A_R_LINEAR_____0_CM 0. 255. DISPLAY_IDENTIFIER C_ERR_CLAS_TOUT_PSTE_1 FORMAT "%3.0" /end CHARACTERISTIC
/begin CHARACTERISTIC fmy_id_tout_amt_1.c_err_clas "Failure class number for failure XX" VALUE 0xa1004db0 _REC_VAL_20_u1 255. _CNV_A_R_LINEAR_____0_CM 0. 255. DISPLAY_IDENTIFIER C_ERR_CLAS_TOUT_AMT_1 FORMAT "%3.0" /end CHARACTERISTIC
/begin CHARACTERISTIC fmy_id_vs.c_err_clas "Failure class number for failure XX" VALUE 0xa10050e4 _REC_VAL_20_u1 255. _CNV_A_R_LINEAR_____0_CM 0. 255. DISPLAY_IDENTIFIER C_ERR_CLAS_VS FORMAT "%3.0" /end CHARACTERISTIC
/begin CHARACTERISTIC fmy_id_knks_1.c_err_clas "Failure class number for failure XX" VALUE 0xa10043ec _REC_VAL_20_u1 255. _CNV_A_R_LINEAR_____0_CM 0. 255. DISPLAY_IDENTIFIER C_ERR_CLAS_KNKS_1 FORMAT "%3.0" /end CHARACTERISTIC
/begin CHARACTERISTIC fmy_id_knks_2.c_err_clas "Failure class number for failure XX" VALUE 0xa1004400 _REC_VAL_20_u1 255. _CNV_A_R_LINEAR_____0_CM 0. 255. DISPLAY_IDENTIFIER C_ERR_CLAS_KNKS_2 FORMAT "%3.0" /end CHARACTERISTIC
/begin CHARACTERISTIC fmy_id_igc_scp_0.c_err_clas "Failure class number for failure XX" VALUE 0xa1004284 _REC_VAL_20_u1 255. _CNV_A_R_LINEAR_____0_CM 0. 255. DISPLAY_IDENTIFIER C_ERR_CLAS_IGC_SCP_0 FORMAT "%3.0" /end CHARACTERISTIC
/begin CHARACTERISTIC fmy_id_igc_scp_1.c_err_clas "Failure class number for failure XX" VALUE 0xa1004298 _REC_VAL_20_u1 255. _CNV_A_R_LINEAR_____0_CM 0. 255. DISPLAY_IDENTIFIER C_ERR_CLAS_IGC_SCP_1 FORMAT "%3.0" /end CHARACTERISTIC
/begin CHARACTERISTIC fmy_id_igc_scp_2.c_err_clas "Failure class number for failure XX" VALUE 0xa10042ac _REC_VAL_20_u1 255. _CNV_A_R_LINEAR_____0_CM 0. 255. DISPLAY_IDENTIFIER C_ERR_CLAS_IGC_SCP_2 FORMAT "%3.0" /end CHARACTERISTIC
/begin CHARACTERISTIC fmy_id_igc_scp_3.c_err_clas "Failure class number for failure XX" VALUE 0xa10042c0 _REC_VAL_20_u1 255. _CNV_A_R_LINEAR_____0_CM 0. 255. DISPLAY_IDENTIFIER C_ERR_CLAS_IGC_SCP_3 FORMAT "%3.0" /end CHARACTERISTIC
/begin CHARACTERISTIC fmy_id_igc_scp_4.c_err_clas "Failure class number for failure XX" VALUE 0xa10042d4 _REC_VAL_20_u1 255. _CNV_A_R_LINEAR_____0_CM 0. 255. DISPLAY_IDENTIFIER C_ERR_CLAS_IGC_SCP_4 FORMAT "%3.0" /end CHARACTERISTIC
/begin CHARACTERISTIC fmy_id_igc_scp_5.c_err_clas "Failure class number for failure XX" VALUE 0xa10042e8 _REC_VAL_20_u1 255. _CNV_A_R_LINEAR_____0_CM 0. 255. DISPLAY_IDENTIFIER C_ERR_CLAS_IGC_SCP_5 FORMAT "%3.0" /end CHARACTERISTIC
/begin CHARACTERISTIC fmy_id_igc_scg_0.c_err_clas "Failure class number for failure XX" VALUE 0xa100420c _REC_VAL_20_u1 255. _CNV_A_R_LINEAR_____0_CM 0. 255. DISPLAY_IDENTIFIER C_ERR_CLAS_IGC_SCG_0 FORMAT "%3.0" /end CHARACTERISTIC
/begin CHARACTERISTIC fmy_id_igc_scg_1.c_err_clas "Failure class number for failure XX" VALUE 0xa1004220 _REC_VAL_20_u1 255. _CNV_A_R_LINEAR_____0_CM 0. 255. DISPLAY_IDENTIFIER C_ERR_CLAS_IGC_SCG_1 FORMAT "%3.0" /end CHARACTERISTIC
/begin CHARACTERISTIC fmy_id_igc_scg_2.c_err_clas "Failure class number for failure XX" VALUE 0xa1004234 _REC_VAL_20_u1 255. _CNV_A_R_LINEAR_____0_CM 0. 255. DISPLAY_IDENTIFIER C_ERR_CLAS_IGC_SCG_2 FORMAT "%3.0" /end CHARACTERISTIC
/begin CHARACTERISTIC fmy_id_igc_scg_3.c_err_clas "Failure class number for failure XX" VALUE 0xa1004248 _REC_VAL_20_u1 255. _CNV_A_R_LINEAR_____0_CM 0. 255. DISPLAY_IDENTIFIER C_ERR_CLAS_IGC_SCG_3 FORMAT "%3.0" /end CHARACTERISTIC
/begin CHARACTERISTIC fmy_id_igc_scg_4.c_err_clas "Failure class number for failure XX" VALUE 0xa100425c _REC_VAL_20_u1 255. _CNV_A_R_LINEAR_____0_CM 0. 255. DISPLAY_IDENTIFIER C_ERR_CLAS_IGC_SCG_4 FORMAT "%3.0" /end CHARACTERISTIC
/begin CHARACTERISTIC fmy_id_igc_scg_5.c_err_clas "Failure class number for failure XX" VALUE 0xa1004270 _REC_VAL_20_u1 255. _CNV_A_R_LINEAR_____0_CM 0. 255. DISPLAY_IDENTIFIER C_ERR_CLAS_IGC_SCG_5 FORMAT "%3.0" /end CHARACTERISTIC
/begin CHARACTERISTIC fmy_id_igc_ol_0.c_err_clas "Failure class number for failure XX" VALUE 0xa1004194 _REC_VAL_20_u1 255. _CNV_A_R_LINEAR_____0_CM 0. 255. DISPLAY_IDENTIFIER C_ERR_CLAS_IGC_OL_0 FORMAT "%3.0" /end CHARACTERISTIC
/begin CHARACTERISTIC fmy_id_igc_ol_1.c_err_clas "Failure class number for failure XX" VALUE 0xa10041a8 _REC_VAL_20_u1 255. _CNV_A_R_LINEAR_____0_CM 0. 255. DISPLAY_IDENTIFIER C_ERR_CLAS_IGC_OL_1 FORMAT "%3.0" /end CHARACTERISTIC
/begin CHARACTERISTIC fmy_id_igc_ol_2.c_err_clas "Failure class number for failure XX" VALUE 0xa10041bc _REC_VAL_20_u1 255. _CNV_A_R_LINEAR_____0_CM 0. 255. DISPLAY_IDENTIFIER C_ERR_CLAS_IGC_OL_2 FORMAT "%3.0" /end CHARACTERISTIC
/begin CHARACTERISTIC fmy_id_igc_ol_3.c_err_clas "Failure class number for failure XX" VALUE 0xa10041d0 _REC_VAL_20_u1 255. _CNV_A_R_LINEAR_____0_CM 0. 255. DISPLAY_IDENTIFIER C_ERR_CLAS_IGC_OL_3 FORMAT "%3.0" /end CHARACTERISTIC
/begin CHARACTERISTIC fmy_id_igc_ol_4.c_err_clas "Failure class number for failure XX" VALUE 0xa10041e4 _REC_VAL_20_u1 255. _CNV_A_R_LINEAR_____0_CM 0. 255. DISPLAY_IDENTIFIER C_ERR_CLAS_IGC_OL_4 FORMAT "%3.0" /end CHARACTERISTIC
/begin CHARACTERISTIC fmy_id_igc_ol_5.c_err_clas "Failure class number for failure XX" VALUE 0xa10041f8 _REC_VAL_20_u1 255. _CNV_A_R_LINEAR_____0_CM 0. 255. DISPLAY_IDENTIFIER C_ERR_CLAS_IGC_OL_5 FORMAT "%3.0" /end CHARACTERISTIC
/begin CHARACTERISTIC fmy_id_tps_1.c_err_clas "Failure class number for failure XX" VALUE 0xa1004ea0 _REC_VAL_20_u1 255. _CNV_A_R_LINEAR_____0_CM 0. 255. DISPLAY_IDENTIFIER C_ERR_CLAS_TPS_1 FORMAT "%3.0" /end CHARACTERISTIC
/begin CHARACTERISTIC fmy_id_tps_2.c_err_clas "Failure class number for failure XX" VALUE 0xa1004eb4 _REC_VAL_20_u1 255. _CNV_A_R_LINEAR_____0_CM 0. 255. DISPLAY_IDENTIFIER C_ERR_CLAS_TPS_2 FORMAT "%3.0" /end CHARACTERISTIC
/begin CHARACTERISTIC fmy_id_tps_maf_1.c_err_clas "Failure class number for failure XX" VALUE 0xa1004ef0 _REC_VAL_20_u1 255. _CNV_A_R_LINEAR_____0_CM 0. 255. DISPLAY_IDENTIFIER C_ERR_CLAS_TPS_MAF_1 FORMAT "%3.0" /end CHARACTERISTIC
/begin CHARACTERISTIC fmy_id_tps_maf_2.c_err_clas "Failure class number for failure XX" VALUE 0xa1004f04 _REC_VAL_20_u1 255. _CNV_A_R_LINEAR_____0_CM 0. 255. DISPLAY_IDENTIFIER C_ERR_CLAS_TPS_MAF_2 FORMAT "%3.0" /end CHARACTERISTIC
/begin CHARACTERISTIC fmy_id_tps_ratio.c_err_clas "Failure class number for failure XX" VALUE 0xa1004f18 _REC_VAL_20_u1 255. _CNV_A_R_LINEAR_____0_CM 0. 255. DISPLAY_IDENTIFIER C_ERR_CLAS_TPS_RATIO FORMAT "%3.0" /end CHARACTERISTIC
/begin CHARACTERISTIC fmy_id_v_ref_1.c_err_clas "Failure class number for failure XX" VALUE 0xa1004fe0 _REC_VAL_20_u1 255. _CNV_A_R_LINEAR_____0_CM 0. 255. DISPLAY_IDENTIFIER C_ERR_CLAS_V_REF_1 FORMAT "%3.0" /end CHARACTERISTIC
/begin CHARACTERISTIC fmy_id_v_ref_2.c_err_clas "Failure class number for failure XX" VALUE 0xa1004ff4 _REC_VAL_20_u1 255. _CNV_A_R_LINEAR_____0_CM 0. 255. DISPLAY_IDENTIFIER C_ERR_CLAS_V_REF_2 FORMAT "%3.0" /end CHARACTERISTIC
/begin CHARACTERISTIC fmy_id_pvs_1.c_err_clas "Failure class number for failure XX" VALUE 0xa10048d8 _REC_VAL_20_u1 255. _CNV_A_R_LINEAR_____0_CM 0. 255. DISPLAY_IDENTIFIER C_ERR_CLAS_PVS_1 FORMAT "%3.0" /end CHARACTERISTIC
/begin CHARACTERISTIC fmy_id_pvs_2.c_err_clas "Failure class number for failure XX" VALUE 0xa10048ec _REC_VAL_20_u1 255. _CNV_A_R_LINEAR_____0_CM 0. 255. DISPLAY_IDENTIFIER C_ERR_CLAS_PVS_2 FORMAT "%3.0" /end CHARACTERISTIC
/begin CHARACTERISTIC fmy_id_pvs_ratio.c_err_clas "Failure class number for failure XX" VALUE 0xa100493c _REC_VAL_20_u1 255. _CNV_A_R_LINEAR_____0_CM 0. 255. DISPLAY_IDENTIFIER C_ERR_CLAS_PVS_RATIO FORMAT "%3.0" /end CHARACTERISTIC
/begin CHARACTERISTIC fmy_id_pvs_double.c_err_clas "Failure class number for failure XX" VALUE 0xa1004914 _REC_VAL_20_u1 255. _CNV_A_R_LINEAR_____0_CM 0. 255. DISPLAY_IDENTIFIER C_ERR_CLAS_PVS_DOUBLE FORMAT "%3.0" /end CHARACTERISTIC
/begin CHARACTERISTIC fmy_id_pvs_bls_not_plaus.c_err_clas "Failure class number for failure XX" VALUE 0xa1004900 _REC_VAL_20_u1 255. _CNV_A_R_LINEAR_____0_CM 0. 255. DISPLAY_IDENTIFIER C_ERR_CLAS_PVS_BLS_NOT_PLAUS FORMAT "%3.0" /end CHARACTERISTIC
/begin CHARACTERISTIC fmy_id_mtc_dr.c_err_clas "Failure class number for failure XX" VALUE 0xa10046a8 _REC_VAL_20_u1 255. _CNV_A_R_LINEAR_____0_CM 0. 255. DISPLAY_IDENTIFIER C_ERR_CLAS_MTC_DR FORMAT "%3.0" /end CHARACTERISTIC
/begin CHARACTERISTIC fmy_id_mtc_ctl_1.c_err_clas "Failure class number for failure XX" VALUE 0xa100466c _REC_VAL_20_u1 255. _CNV_A_R_LINEAR_____0_CM 0. 255. DISPLAY_IDENTIFIER C_ERR_CLAS_MTC_CTL_1 FORMAT "%3.0" /end CHARACTERISTIC
/begin CHARACTERISTIC fmy_id_mtc_ctl_2.c_err_clas "Failure class number for failure XX" VALUE 0xa1004680 _REC_VAL_20_u1 255. _CNV_A_R_LINEAR_____0_CM 0. 255. DISPLAY_IDENTIFIER C_ERR_CLAS_MTC_CTL_2 FORMAT "%3.0" /end CHARACTERISTIC
/begin CHARACTERISTIC fmy_id_mtc_ctl_3.c_err_clas "Failure class number for failure XX" VALUE 0xa1004694 _REC_VAL_20_u1 255. _CNV_A_R_LINEAR_____0_CM 0. 255. DISPLAY_IDENTIFIER C_ERR_CLAS_MTC_CTL_3 FORMAT "%3.0" /end CHARACTERISTIC
/begin CHARACTERISTIC fmy_id_tps_ad.c_err_clas "Failure class number for failure XX" VALUE 0xa1004ec8 _REC_VAL_20_u1 255. _CNV_A_R_LINEAR_____0_CM 0. 255. DISPLAY_IDENTIFIER C_ERR_CLAS_TPS_AD FORMAT "%3.0" /end CHARACTERISTIC
/begin CHARACTERISTIC fmy_id_tps_ad_bol.c_err_clas "Failure class number for failure XX" VALUE 0xa1004edc _REC_VAL_20_u1 255. _CNV_A_R_LINEAR_____0_CM 0. 255. DISPLAY_IDENTIFIER C_ERR_CLAS_TPS_AD_BOL FORMAT "%3.0" /end CHARACTERISTIC
/begin CHARACTERISTIC fmy_id_tps_st_chk_1.c_err_clas "Failure class number for failure XX" VALUE 0xa1004f2c _REC_VAL_20_u1 255. _CNV_A_R_LINEAR_____0_CM 0. 255. DISPLAY_IDENTIFIER C_ERR_CLAS_TPS_ST_CHK_1 FORMAT "%3.0" /end CHARACTERISTIC
/begin CHARACTERISTIC fmy_id_tps_st_chk_2.c_err_clas "Failure class number for failure XX" VALUE 0xa1004f40 _REC_VAL_20_u1 255. _CNV_A_R_LINEAR_____0_CM 0. 255. DISPLAY_IDENTIFIER C_ERR_CLAS_TPS_ST_CHK_2 FORMAT "%3.0" /end CHARACTERISTIC
/begin CHARACTERISTIC fmy_id_gen.c_err_clas "Failure class number for failure XX" VALUE 0xa1004144 _REC_VAL_20_u1 255. _CNV_A_R_LINEAR_____0_CM 0. 255. DISPLAY_IDENTIFIER C_ERR_CLAS_GEN FORMAT "%3.0" /end CHARACTERISTIC
/begin CHARACTERISTIC fmy_id_gen_diag.c_err_clas "Failure class number for failure XX" VALUE 0xa1004158 _REC_VAL_20_u1 255. _CNV_A_R_LINEAR_____0_CM 0. 255. DISPLAY_IDENTIFIER C_ERR_CLAS_GEN_DIAG FORMAT "%3.0" /end CHARACTERISTIC
/begin CHARACTERISTIC fmy_id_alter_bn.c_err_clas "Failure class number for failure XX" VALUE 0xa100394c _REC_VAL_20_u1 255. _CNV_A_R_LINEAR_____0_CM 0. 255. DISPLAY_IDENTIFIER C_ERR_CLAS_ALTER_BN FORMAT "%3.0" /end CHARACTERISTIC
/begin CHARACTERISTIC fmy_id_alter_bn_bat.c_err_clas "Failure class number for failure XX" VALUE 0xa1003960 _REC_VAL_20_u1 255. _CNV_A_R_LINEAR_____0_CM 0. 255. DISPLAY_IDENTIFIER C_ERR_CLAS_ALTER_BN_BAT FORMAT "%3.0" /end CHARACTERISTIC
/begin CHARACTERISTIC fmy_id_vim_1_el.c_err_clas "Failure class number for failure XX" VALUE 0xa1005058 _REC_VAL_20_u1 255. _CNV_A_R_LINEAR_____0_CM 0. 255. DISPLAY_IDENTIFIER C_ERR_CLAS_VIM_1_EL FORMAT "%3.0" /end CHARACTERISTIC
/begin CHARACTERISTIC fmy_id_vim_2_el.c_err_clas "Failure class number for failure XX" VALUE 0xa100506c _REC_VAL_20_u1 255. _CNV_A_R_LINEAR_____0_CM 0. 255. DISPLAY_IDENTIFIER C_ERR_CLAS_VIM_2_EL FORMAT "%3.0" /end CHARACTERISTIC
/begin CHARACTERISTIC fmy_id_vimpwm_1_fb.c_err_clas "Failure class number for failure XX" VALUE 0xa1005094 _REC_VAL_20_u1 255. _CNV_A_R_LINEAR_____0_CM 0. 255. DISPLAY_IDENTIFIER C_ERR_CLAS_VIMPWM_1_FB FORMAT "%3.0" /end CHARACTERISTIC
/begin CHARACTERISTIC fmy_id_vimpwm_2_fb.c_err_clas "Failure class number for failure XX" VALUE 0xa10050a8 _REC_VAL_20_u1 255. _CNV_A_R_LINEAR_____0_CM 0. 255. DISPLAY_IDENTIFIER C_ERR_CLAS_VIMPWM_2_FB FORMAT "%3.0" /end CHARACTERISTIC
/begin CHARACTERISTIC fmy_id_t_es.c_err_clas "Failure class number for failure XX" VALUE 0xa1004c48 _REC_VAL_20_u1 255. _CNV_A_R_LINEAR_____0_CM 0. 255. DISPLAY_IDENTIFIER C_ERR_CLAS_T_ES FORMAT "%3.0" /end CHARACTERISTIC
/begin CHARACTERISTIC fmy_id_map_dip_plaus.c_err_clas "Failure class number for failure XX" VALUE 0xa1004518 _REC_VAL_20_u1 255. _CNV_A_R_LINEAR_____0_CM 0. 255. DISPLAY_IDENTIFIER C_ERR_CLAS_MAP_DIP_PLAUS FORMAT "%3.0" /end CHARACTERISTIC
/begin CHARACTERISTIC fmy_id_toil_level.c_err_clas "Failure class number for failure XX" VALUE 0xa1004d9c _REC_VAL_20_u1 255. _CNV_A_R_LINEAR_____0_CM 0. 255. DISPLAY_IDENTIFIER C_ERR_CLAS_TOIL_LEVEL FORMAT "%3.0" /end CHARACTERISTIC
/begin CHARACTERISTIC fmy_id_vim_plaus.c_err_clas "Failure class number for failure XX" VALUE 0xa1005080 _REC_VAL_20_u1 255. _CNV_A_R_LINEAR_____0_CM 0. 255. DISPLAY_IDENTIFIER C_ERR_CLAS_VIM_PLAUS FORMAT "%3.0" /end CHARACTERISTIC
/begin CHARACTERISTIC fmy_id_alter_bn_rgn.c_err_clas "Failure class number for failure XX" VALUE 0xa1003974 _REC_VAL_20_u1 255. _CNV_A_R_LINEAR_____0_CM 0. 255. DISPLAY_IDENTIFIER C_ERR_CLAS_ALTER_BN_RGN FORMAT "%3.0" /end CHARACTERISTIC
/begin CHARACTERISTIC fmy_id_per_cam_in_1.c_err_clas "Failure class number for failure XX" VALUE 0xa10047fc _REC_VAL_20_u1 255. _CNV_A_R_LINEAR_____0_CM 0. 255. DISPLAY_IDENTIFIER C_ERR_CLAS_PER_CAM_IN_1 FORMAT "%3.0" /end CHARACTERISTIC
/begin CHARACTERISTIC fmy_id_per_cam_ex_1.c_err_clas "Failure class number for failure XX" VALUE 0xa10047e8 _REC_VAL_20_u1 255. _CNV_A_R_LINEAR_____0_CM 0. 255. DISPLAY_IDENTIFIER C_ERR_CLAS_PER_CAM_EX_1 FORMAT "%3.0" /end CHARACTERISTIC
/begin CHARACTERISTIC fmy_id_syn_cam_in_1.c_err_clas "Failure class number for failure XX" VALUE 0xa1004c0c _REC_VAL_20_u1 255. _CNV_A_R_LINEAR_____0_CM 0. 255. DISPLAY_IDENTIFIER C_ERR_CLAS_SYN_CAM_IN_1 FORMAT "%3.0" /end CHARACTERISTIC
/begin CHARACTERISTIC fmy_id_syn_cam_ex_1.c_err_clas "Failure class number for failure XX" VALUE 0xa1004bf8 _REC_VAL_20_u1 255. _CNV_A_R_LINEAR_____0_CM 0. 255. DISPLAY_IDENTIFIER C_ERR_CLAS_SYN_CAM_EX_1 FORMAT "%3.0" /end CHARACTERISTIC
/begin CHARACTERISTIC fmy_id_ref_crk_cam_in_1.c_err_clas "Failure class number for failure XX" VALUE 0xa100498c _REC_VAL_20_u1 255. _CNV_A_R_LINEAR_____0_CM 0. 255. DISPLAY_IDENTIFIER C_ERR_CLAS_REF_CRK_CAM_IN_1 FORMAT "%3.0" /end CHARACTERISTIC
/begin CHARACTERISTIC fmy_id_ref_crk_cam_ex_1.c_err_clas "Failure class number for failure XX" VALUE 0xa1004978 _REC_VAL_20_u1 255. _CNV_A_R_LINEAR_____0_CM 0. 255. DISPLAY_IDENTIFIER C_ERR_CLAS_REF_CRK_CAM_EX_1 FORMAT "%3.0" /end CHARACTERISTIC
/begin CHARACTERISTIC fmy_id_crk_tooth.c_err_clas "Failure class number for failure XX" VALUE 0xa1003d84 _REC_VAL_20_u1 255. _CNV_A_R_LINEAR_____0_CM 0. 255. DISPLAY_IDENTIFIER C_ERR_CLAS_CRK_TOOTH FORMAT "%3.0" /end CHARACTERISTIC
/begin CHARACTERISTIC fmy_id_crk_tooth_per.c_err_clas "Failure class number for failure XX" VALUE 0xa1003d98 _REC_VAL_20_u1 255. _CNV_A_R_LINEAR_____0_CM 0. 255. DISPLAY_IDENTIFIER C_ERR_CLAS_CRK_TOOTH_PER FORMAT "%3.0" /end CHARACTERISTIC
/begin CHARACTERISTIC fmy_id_crk_syn.c_err_clas "Failure class number for failure XX" VALUE 0xa1003d70 _REC_VAL_20_u1 255. _CNV_A_R_LINEAR_____0_CM 0. 255. DISPLAY_IDENTIFIER C_ERR_CLAS_CRK_SYN FORMAT "%3.0" /end CHARACTERISTIC
/begin CHARACTERISTIC fmy_id_crk_plaus.c_err_clas "Failure class number for failure XX" VALUE 0xa1003d5c _REC_VAL_20_u1 255. _CNV_A_R_LINEAR_____0_CM 0. 255. DISPLAY_IDENTIFIER C_ERR_CLAS_CRK_PLAUS FORMAT "%3.0" /end CHARACTERISTIC
/begin CHARACTERISTIC fmy_id_plaus_cam_in_1.c_err_clas "Failure class number for failure XX" VALUE 0xa1004824 _REC_VAL_20_u1 255. _CNV_A_R_LINEAR_____0_CM 0. 255. DISPLAY_IDENTIFIER C_ERR_CLAS_PLAUS_CAM_IN_1 FORMAT "%3.0" /end CHARACTERISTIC
/begin CHARACTERISTIC fmy_id_plaus_cam_ex_1.c_err_clas "Failure class number for failure XX" VALUE 0xa1004810 _REC_VAL_20_u1 255. _CNV_A_R_LINEAR_____0_CM 0. 255. DISPLAY_IDENTIFIER C_ERR_CLAS_PLAUS_CAM_EX_1 FORMAT "%3.0" /end CHARACTERISTIC
/begin CHARACTERISTIC fmy_id_syn_crk_cam_in_1.c_err_clas "Failure class number for failure XX" VALUE 0xa1004c34 _REC_VAL_20_u1 255. _CNV_A_R_LINEAR_____0_CM 0. 255. DISPLAY_IDENTIFIER C_ERR_CLAS_SYN_CRK_CAM_IN_1 FORMAT "%3.0" /end CHARACTERISTIC
/begin CHARACTERISTIC fmy_id_syn_crk_cam_ex_1.c_err_clas "Failure class number for failure XX" VALUE 0xa1004c20 _REC_VAL_20_u1 255. _CNV_A_R_LINEAR_____0_CM 0. 255. DISPLAY_IDENTIFIER C_ERR_CLAS_SYN_CRK_CAM_EX_1 FORMAT "%3.0" /end CHARACTERISTIC
/begin CHARACTERISTIC fmy_id_can_boff_B.c_err_clas "Failure class number for failure XX" VALUE 0xa1003c58 _REC_VAL_20_u1 255. _CNV_A_R_LINEAR_____0_CM 0. 255. DISPLAY_IDENTIFIER C_ERR_CLAS_CAN_BOFF_B FORMAT "%3.0" /end CHARACTERISTIC
/begin CHARACTERISTIC fmy_id_can_boff_C.c_err_clas "Failure class number for failure XX" VALUE 0xa1003c6c _REC_VAL_20_u1 255. _CNV_A_R_LINEAR_____0_CM 0. 255. DISPLAY_IDENTIFIER C_ERR_CLAS_CAN_BOFF_C FORMAT "%3.0" /end CHARACTERISTIC
/begin CHARACTERISTIC fmy_id_rly_main.c_err_clas "Failure class number for failure XX" VALUE 0xa1004a04 _REC_VAL_20_u1 255. _CNV_A_R_LINEAR_____0_CM 0. 255. DISPLAY_IDENTIFIER C_ERR_CLAS_RLY_MAIN FORMAT "%3.0" /end CHARACTERISTIC
/begin CHARACTERISTIC fmy_id_rly_main_dly.c_err_clas "Failure class number for failure XX" VALUE 0xa1004a18 _REC_VAL_20_u1 255. _CNV_A_R_LINEAR_____0_CM 0. 255. DISPLAY_IDENTIFIER C_ERR_CLAS_RLY_MAIN_DLY FORMAT "%3.0" /end CHARACTERISTIC
/begin CHARACTERISTIC fmy_id_rly_accout.c_err_clas "Failure class number for failure XX" VALUE 0xa10049c8 _REC_VAL_20_u1 255. _CNV_A_R_LINEAR_____0_CM 0. 255. DISPLAY_IDENTIFIER C_ERR_CLAS_RLY_ACCOUT FORMAT "%3.0" /end CHARACTERISTIC
/begin CHARACTERISTIC fmy_id_isc.c_err_clas "Failure class number for failure XX" VALUE 0xa1004360 _REC_VAL_20_u1 255. _CNV_A_R_LINEAR_____0_CM 0. 255. DISPLAY_IDENTIFIER C_ERR_CLAS_ISC FORMAT "%3.0" /end CHARACTERISTIC
/begin CHARACTERISTIC fmy_id_im_bls_plaus.c_err_clas "Failure class number for failure XX" VALUE 0xa10042fc _REC_VAL_20_u1 255. _CNV_A_R_LINEAR_____0_CM 0. 255. DISPLAY_IDENTIFIER C_ERR_CLAS_IM_BLS_PLAUS FORMAT "%3.0" /end CHARACTERISTIC
/begin CHARACTERISTIC fmy_id_im_bts_plaus.c_err_clas "Failure class number for failure XX" VALUE 0xa1004310 _REC_VAL_20_u1 255. _CNV_A_R_LINEAR_____0_CM 0. 255. DISPLAY_IDENTIFIER C_ERR_CLAS_IM_BTS_PLAUS FORMAT "%3.0" /end CHARACTERISTIC
/begin CHARACTERISTIC fmy_id_msw_tog.c_err_clas "Failure class number for failure XX" VALUE 0xa1004658 _REC_VAL_20_u1 255. _CNV_A_R_LINEAR_____0_CM 0. 255. DISPLAY_IDENTIFIER C_ERR_CLAS_MSW_TOG FORMAT "%3.0" /end CHARACTERISTIC
/begin CHARACTERISTIC fmy_id_msw_2.c_err_clas "Failure class number for failure XX" VALUE 0xa1004630 _REC_VAL_20_u1 255. _CNV_A_R_LINEAR_____0_CM 0. 255. DISPLAY_IDENTIFIER C_ERR_CLAS_MSW_2 FORMAT "%3.0" /end CHARACTERISTIC
/begin CHARACTERISTIC fmy_id_msw_3.c_err_clas "Failure class number for failure XX" VALUE 0xa1004644 _REC_VAL_20_u1 255. _CNV_A_R_LINEAR_____0_CM 0. 255. DISPLAY_IDENTIFIER C_ERR_CLAS_MSW_3 FORMAT "%3.0" /end CHARACTERISTIC
/begin CHARACTERISTIC fmy_id_mis_0.c_err_clas "Failure class number for failure XX" VALUE 0xa1004590 _REC_VAL_20_u1 255. _CNV_A_R_LINEAR_____0_CM 0. 255. DISPLAY_IDENTIFIER C_ERR_CLAS_MIS_0 FORMAT "%3.0" /end CHARACTERISTIC
/begin CHARACTERISTIC fmy_id_mis_1.c_err_clas "Failure class number for failure XX" VALUE 0xa10045a4 _REC_VAL_20_u1 255. _CNV_A_R_LINEAR_____0_CM 0. 255. DISPLAY_IDENTIFIER C_ERR_CLAS_MIS_1 FORMAT "%3.0" /end CHARACTERISTIC
/begin CHARACTERISTIC fmy_id_mis_2.c_err_clas "Failure class number for failure XX" VALUE 0xa10045b8 _REC_VAL_20_u1 255. _CNV_A_R_LINEAR_____0_CM 0. 255. DISPLAY_IDENTIFIER C_ERR_CLAS_MIS_2 FORMAT "%3.0" /end CHARACTERISTIC
/begin CHARACTERISTIC fmy_id_mis_3.c_err_clas "Failure class number for failure XX" VALUE 0xa10045cc _REC_VAL_20_u1 255. _CNV_A_R_LINEAR_____0_CM 0. 255. DISPLAY_IDENTIFIER C_ERR_CLAS_MIS_3 FORMAT "%3.0" /end CHARACTERISTIC
/begin CHARACTERISTIC fmy_id_mis_4.c_err_clas "Failure class number for failure XX" VALUE 0xa10045e0 _REC_VAL_20_u1 255. _CNV_A_R_LINEAR_____0_CM 0. 255. DISPLAY_IDENTIFIER C_ERR_CLAS_MIS_4 FORMAT "%3.0" /end CHARACTERISTIC
/begin CHARACTERISTIC fmy_id_mis_5.c_err_clas "Failure class number for failure XX" VALUE 0xa10045f4 _REC_VAL_20_u1 255. _CNV_A_R_LINEAR_____0_CM 0. 255. DISPLAY_IDENTIFIER C_ERR_CLAS_MIS_5 FORMAT "%3.0" /end CHARACTERISTIC
/begin CHARACTERISTIC fmy_id_mis_mpl.c_err_clas "Failure class number for failure XX" VALUE 0xa100461c _REC_VAL_20_u1 255. _CNV_A_R_LINEAR_____0_CM 0. 255. DISPLAY_IDENTIFIER C_ERR_CLAS_MIS_MPL FORMAT "%3.0" /end CHARACTERISTIC
/begin CHARACTERISTIC fmy_id_mis_ftl_l.c_err_clas "Failure class number for failure XX" VALUE 0xa1004608 _REC_VAL_20_u1 255. _CNV_A_R_LINEAR_____0_CM 0. 255. DISPLAY_IDENTIFIER C_ERR_CLAS_MIS_FTL_L FORMAT "%3.0" /end CHARACTERISTIC
/begin CHARACTERISTIC fmy_id_fsd_1.c_err_clas "Failure class number for failure XX" VALUE 0xa10040a4 _REC_VAL_20_u1 255. _CNV_A_R_LINEAR_____0_CM 0. 255. DISPLAY_IDENTIFIER C_ERR_CLAS_FSD_1 FORMAT "%3.0" /end CHARACTERISTIC
/begin CHARACTERISTIC fmy_id_fsd_2.c_err_clas "Failure class number for failure XX" VALUE 0xa10040b8 _REC_VAL_20_u1 255. _CNV_A_R_LINEAR_____0_CM 0. 255. DISPLAY_IDENTIFIER C_ERR_CLAS_FSD_2 FORMAT "%3.0" /end CHARACTERISTIC
/begin CHARACTERISTIC fmy_id_ef.c_err_clas "Failure class number for failure XX" VALUE 0xa1003fdc _REC_VAL_20_u1 255. _CNV_A_R_LINEAR_____0_CM 0. 255. DISPLAY_IDENTIFIER C_ERR_CLAS_EF FORMAT "%3.0" /end CHARACTERISTIC
/begin CHARACTERISTIC fmy_id_tecu.c_err_clas "Failure class number for failure XX" VALUE 0xa1004d24 _REC_VAL_20_u1 255. _CNV_A_R_LINEAR_____0_CM 0. 255. DISPLAY_IDENTIFIER C_ERR_CLAS_TECU FORMAT "%3.0" /end CHARACTERISTIC
/begin CHARACTERISTIC fmy_id_ebox_cfa.c_err_clas "Failure class number for failure XX" VALUE 0xa1003f28 _REC_VAL_20_u1 255. _CNV_A_R_LINEAR_____0_CM 0. 255. DISPLAY_IDENTIFIER C_ERR_CLAS_EBOX_CFA FORMAT "%3.0" /end CHARACTERISTIC
/begin CHARACTERISTIC fmy_id_ecu_ram.c_err_clas "Failure class number for failure XX" VALUE 0xa1003fc8 _REC_VAL_20_u1 255. _CNV_A_R_LINEAR_____0_CM 0. 255. DISPLAY_IDENTIFIER C_ERR_CLAS_ECU_RAM FORMAT "%3.0" /end CHARACTERISTIC
/begin CHARACTERISTIC fmy_id_tqi_lim.c_err_clas "Failure class number for failure XX" VALUE 0xa1004fb8 _REC_VAL_20_u1 255. _CNV_A_R_LINEAR_____0_CM 0. 255. DISPLAY_IDENTIFIER C_ERR_CLAS_TQI_LIM FORMAT "%3.0" /end CHARACTERISTIC
/begin CHARACTERISTIC fmy_id_obd2_lsh_down_1.c_err_clas "Failure class number for failure XX" VALUE 0xa100470c _REC_VAL_20_u1 255. _CNV_A_R_LINEAR_____0_CM 0. 255. DISPLAY_IDENTIFIER C_ERR_CLAS_OBD2_LSH_DOWN_1 FORMAT "%3.0" /end CHARACTERISTIC
/begin CHARACTERISTIC fmy_id_obd2_lsh_down_2.c_err_clas "Failure class number for failure XX" VALUE 0xa1004720 _REC_VAL_20_u1 255. _CNV_A_R_LINEAR_____0_CM 0. 255. DISPLAY_IDENTIFIER C_ERR_CLAS_OBD2_LSH_DOWN_2 FORMAT "%3.0" /end CHARACTERISTIC
/begin CHARACTERISTIC fmy_id_dmtls.c_err_clas "Failure class number for failure XX" VALUE 0xa1003ed8 _REC_VAL_20_u1 255. _CNV_A_R_LINEAR_____0_CM 0. 255. DISPLAY_IDENTIFIER C_ERR_CLAS_DMTLS FORMAT "%3.0" /end CHARACTERISTIC
/begin CHARACTERISTIC fmy_id_dmtl_pump.c_err_clas "Failure class number for failure XX" VALUE 0xa1003e9c _REC_VAL_20_u1 255. _CNV_A_R_LINEAR_____0_CM 0. 255. DISPLAY_IDENTIFIER C_ERR_CLAS_DMTL_PUMP FORMAT "%3.0" /end CHARACTERISTIC
/begin CHARACTERISTIC fmy_id_dmtlm.c_err_clas "Failure class number for failure XX" VALUE 0xa1003ec4 _REC_VAL_20_u1 255. _CNV_A_R_LINEAR_____0_CM 0. 255. DISPLAY_IDENTIFIER C_ERR_CLAS_DMTLM FORMAT "%3.0" /end CHARACTERISTIC
/begin CHARACTERISTIC fmy_id_rough_leak.c_err_clas "Failure class number for failure XX" VALUE 0xa1004a54 _REC_VAL_20_u1 255. _CNV_A_R_LINEAR_____0_CM 0. 255. DISPLAY_IDENTIFIER C_ERR_CLAS_ROUGH_LEAK FORMAT "%3.0" /end CHARACTERISTIC
/begin CHARACTERISTIC fmy_id_small_leak.c_err_clas "Failure class number for failure XX" VALUE 0xa1004b6c _REC_VAL_20_u1 255. _CNV_A_R_LINEAR_____0_CM 0. 255. DISPLAY_IDENTIFIER C_ERR_CLAS_SMALL_LEAK FORMAT "%3.0" /end CHARACTERISTIC
/begin CHARACTERISTIC fmy_id_chk_fuc.c_err_clas "Failure class number for failure XX" VALUE 0xa1003cf8 _REC_VAL_20_u1 255. _CNV_A_R_LINEAR_____0_CM 0. 255. DISPLAY_IDENTIFIER C_ERR_CLAS_CHK_FUC FORMAT "%3.0" /end CHARACTERISTIC
/begin CHARACTERISTIC fmy_id_sof.c_err_clas "Failure class number for failure XX" VALUE 0xa1004b80 _REC_VAL_20_u1 255. _CNV_A_R_LINEAR_____0_CM 0. 255. DISPLAY_IDENTIFIER C_ERR_CLAS_SOF FORMAT "%3.0" /end CHARACTERISTIC
/begin CHARACTERISTIC fmy_id_sof_req.c_err_clas "Failure class number for failure XX" VALUE 0xa1004b94 _REC_VAL_20_u1 255. _CNV_A_R_LINEAR_____0_CM 0. 255. DISPLAY_IDENTIFIER C_ERR_CLAS_SOF_REQ FORMAT "%3.0" /end CHARACTERISTIC
/begin CHARACTERISTIC fmy_id_rly_crcv_heat.c_err_clas "Failure class number for failure XX" VALUE 0xa10049dc _REC_VAL_20_u1 255. _CNV_A_R_LINEAR_____0_CM 0. 255. DISPLAY_IDENTIFIER C_ERR_CLAS_RLY_CRCV_HEAT FORMAT "%3.0" /end CHARACTERISTIC
/begin CHARACTERISTIC fmy_id_rly_st.c_err_clas "Failure class number for failure XX" VALUE 0xa1004a2c _REC_VAL_20_u1 255. _CNV_A_R_LINEAR_____0_CM 0. 255. DISPLAY_IDENTIFIER C_ERR_CLAS_RLY_ST FORMAT "%3.0" /end CHARACTERISTIC
/begin CHARACTERISTIC fmy_id_bsd.c_err_clas "Failure class number for failure XX" VALUE 0xa1003c44 _REC_VAL_20_u1 255. _CNV_A_R_LINEAR_____0_CM 0. 255. DISPLAY_IDENTIFIER C_ERR_CLAS_BSD FORMAT "%3.0" /end CHARACTERISTIC
/begin CHARACTERISTIC fmy_id_poil_swi.c_err_clas "Failure class number for failure XX" VALUE 0xa100484c _REC_VAL_20_u1 255. _CNV_A_R_LINEAR_____0_CM 0. 255. DISPLAY_IDENTIFIER C_ERR_CLAS_POIL_SWI FORMAT "%3.0" /end CHARACTERISTIC
/begin CHARACTERISTIC fmy_id_tout_efp_can.c_err_clas "Failure class number for failure XX" VALUE 0xa1004e00 _REC_VAL_20_u1 255. _CNV_A_R_LINEAR_____0_CM 0. 255. DISPLAY_IDENTIFIER C_ERR_CLAS_TOUT_EFP_CAN FORMAT "%3.0" /end CHARACTERISTIC
/begin CHARACTERISTIC fmy_id_diagcps.c_err_clas "Failure class number for failure XX" VALUE 0xa1003e88 _REC_VAL_20_u1 255. _CNV_A_R_LINEAR_____0_CM 0. 255. DISPLAY_IDENTIFIER C_ERR_CLAS_DIAGCPS FORMAT "%3.0" /end CHARACTERISTIC
/begin CHARACTERISTIC fmy_id_dcc.c_err_clas "Failure class number for failure XX" VALUE 0xa1003e4c _REC_VAL_20_u1 255. _CNV_A_R_LINEAR_____0_CM 0. 255. DISPLAY_IDENTIFIER C_ERR_CLAS_DCC FORMAT "%3.0" /end CHARACTERISTIC
/begin CHARACTERISTIC fmy_id_ldm.c_err_clas "Failure class number for failure XX" VALUE 0xa1004428 _REC_VAL_20_u1 255. _CNV_A_R_LINEAR_____0_CM 0. 255. DISPLAY_IDENTIFIER C_ERR_CLAS_LDM FORMAT "%3.0" /end CHARACTERISTIC
/begin CHARACTERISTIC fmy_id_dmtlh.c_err_clas "Failure class number for failure XX" VALUE 0xa1003eb0 _REC_VAL_20_u1 255. _CNV_A_R_LINEAR_____0_CM 0. 255. DISPLAY_IDENTIFIER C_ERR_CLAS_DMTLH FORMAT "%3.0" /end CHARACTERISTIC
/begin CHARACTERISTIC fmy_id_cs.c_err_clas "Failure class number for failure XX" VALUE 0xa1003dc0 _REC_VAL_20_u1 255. _CNV_A_R_LINEAR_____0_CM 0. 255. DISPLAY_IDENTIFIER C_ERR_CLAS_CS FORMAT "%3.0" /end CHARACTERISTIC
/begin CHARACTERISTIC fmy_id_spi_mps.c_err_clas "Failure class number for failure XX" VALUE 0xa1004bbc _REC_VAL_20_u1 255. _CNV_A_R_LINEAR_____0_CM 0. 255. DISPLAY_IDENTIFIER C_ERR_CLAS_SPI_MPS FORMAT "%3.0" /end CHARACTERISTIC
/begin CHARACTERISTIC fmy_id_spi_knk.c_err_clas "Failure class number for failure XX" VALUE 0xa1004ba8 _REC_VAL_20_u1 255. _CNV_A_R_LINEAR_____0_CM 0. 255. DISPLAY_IDENTIFIER C_ERR_CLAS_SPI_KNK FORMAT "%3.0" /end CHARACTERISTIC
/begin CHARACTERISTIC fmy_id_bn_tq_dcc.c_err_clas "Failure class number for failure XX" VALUE 0xa1003bb8 _REC_VAL_20_u1 255. _CNV_A_R_LINEAR_____0_CM 0. 255. DISPLAY_IDENTIFIER C_ERR_CLAS_BN_TQ_DCC FORMAT "%3.0" /end CHARACTERISTIC
/begin CHARACTERISTIC fmy_id_bn_tq_pste_2.c_err_clas "Failure class number for failure XX" VALUE 0xa1003be0 _REC_VAL_20_u1 255. _CNV_A_R_LINEAR_____0_CM 0. 255. DISPLAY_IDENTIFIER C_ERR_CLAS_BN_TQ_PSTE_2 FORMAT "%3.0" /end CHARACTERISTIC
/begin CHARACTERISTIC fmy_id_bn_ars.c_err_clas "Failure class number for failure XX" VALUE 0xa1003a28 _REC_VAL_20_u1 255. _CNV_A_R_LINEAR_____0_CM 0. 255. DISPLAY_IDENTIFIER C_ERR_CLAS_BN_ARS FORMAT "%3.0" /end CHARACTERISTIC
/begin CHARACTERISTIC fmy_id_bn_cas.c_err_clas "Failure class number for failure XX" VALUE 0xa1003a3c _REC_VAL_20_u1 255. _CNV_A_R_LINEAR_____0_CM 0. 255. DISPLAY_IDENTIFIER C_ERR_CLAS_BN_CAS FORMAT "%3.0" /end CHARACTERISTIC
/begin CHARACTERISTIC fmy_id_bn_tq_tcs.c_err_clas "Failure class number for failure XX" VALUE 0xa1003bf4 _REC_VAL_20_u1 255. _CNV_A_R_LINEAR_____0_CM 0. 255. DISPLAY_IDENTIFIER C_ERR_CLAS_BN_TQ_TCS FORMAT "%3.0" /end CHARACTERISTIC
/begin CHARACTERISTIC fmy_id_bn_vs_tcs.c_err_clas "Failure class number for failure XX" VALUE 0xa1003c30 _REC_VAL_20_u1 255. _CNV_A_R_LINEAR_____0_CM 0. 255. DISPLAY_IDENTIFIER C_ERR_CLAS_BN_VS_TCS FORMAT "%3.0" /end CHARACTERISTIC
/begin CHARACTERISTIC fmy_id_bn_tcs.c_err_clas "Failure class number for failure XX" VALUE 0xa1003b90 _REC_VAL_20_u1 255. _CNV_A_R_LINEAR_____0_CM 0. 255. DISPLAY_IDENTIFIER C_ERR_CLAS_BN_TCS FORMAT "%3.0" /end CHARACTERISTIC
/begin CHARACTERISTIC fmy_id_bn_tq_etcu.c_err_clas "Failure class number for failure XX" VALUE 0xa1003bcc _REC_VAL_20_u1 255. _CNV_A_R_LINEAR_____0_CM 0. 255. DISPLAY_IDENTIFIER C_ERR_CLAS_BN_TQ_ETCU FORMAT "%3.0" /end CHARACTERISTIC
/begin CHARACTERISTIC fmy_id_bn_etcu.c_err_clas "Failure class number for failure XX" VALUE 0xa1003a78 _REC_VAL_20_u1 255. _CNV_A_R_LINEAR_____0_CM 0. 255. DISPLAY_IDENTIFIER C_ERR_CLAS_BN_ETCU FORMAT "%3.0" /end CHARACTERISTIC
/begin CHARACTERISTIC fmy_id_bn_etcu_2.c_err_clas "Failure class number for failure XX" VALUE 0xa1003a8c _REC_VAL_20_u1 255. _CNV_A_R_LINEAR_____0_CM 0. 255. DISPLAY_IDENTIFIER C_ERR_CLAS_BN_ETCU_2 FORMAT "%3.0" /end CHARACTERISTIC
/begin CHARACTERISTIC fmy_id_bn_etcu_disp.c_err_clas "Failure class number for failure XX" VALUE 0xa1003aa0 _REC_VAL_20_u1 255. _CNV_A_R_LINEAR_____0_CM 0. 255. DISPLAY_IDENTIFIER C_ERR_CLAS_BN_ETCU_DISP FORMAT "%3.0" /end CHARACTERISTIC
/begin CHARACTERISTIC fmy_id_bn_tq_amt.c_err_clas "Failure class number for failure XX" VALUE 0xa1003ba4 _REC_VAL_20_u1 255. _CNV_A_R_LINEAR_____0_CM 0. 255. DISPLAY_IDENTIFIER C_ERR_CLAS_BN_TQ_AMT FORMAT "%3.0" /end CHARACTERISTIC
/begin CHARACTERISTIC fmy_id_bn_acc.c_err_clas "Failure class number for failure XX" VALUE 0xa1003a00 _REC_VAL_20_u1 255. _CNV_A_R_LINEAR_____0_CM 0. 255. DISPLAY_IDENTIFIER C_ERR_CLAS_BN_ACC FORMAT "%3.0" /end CHARACTERISTIC
/begin CHARACTERISTIC fmy_id_bn_t_icl.c_err_clas "Failure class number for failure XX" VALUE 0xa1003b7c _REC_VAL_20_u1 255. _CNV_A_R_LINEAR_____0_CM 0. 255. DISPLAY_IDENTIFIER C_ERR_CLAS_BN_T_ICL FORMAT "%3.0" /end CHARACTERISTIC
/begin CHARACTERISTIC fmy_id_bn_veh_mod.c_err_clas "Failure class number for failure XX" VALUE 0xa1003c1c _REC_VAL_20_u1 255. _CNV_A_R_LINEAR_____0_CM 0. 255. DISPLAY_IDENTIFIER C_ERR_CLAS_BN_VEH_MOD FORMAT "%3.0" /end CHARACTERISTIC
/begin CHARACTERISTIC fmy_id_bn_km_icl.c_err_clas "Failure class number for failure XX" VALUE 0xa1003af0 _REC_VAL_20_u1 255. _CNV_A_R_LINEAR_____0_CM 0. 255. DISPLAY_IDENTIFIER C_ERR_CLAS_BN_KM_ICL FORMAT "%3.0" /end CHARACTERISTIC
/begin CHARACTERISTIC fmy_id_bn_icl.c_err_clas "Failure class number for failure XX" VALUE 0xa1003adc _REC_VAL_20_u1 255. _CNV_A_R_LINEAR_____0_CM 0. 255. DISPLAY_IDENTIFIER C_ERR_CLAS_BN_ICL FORMAT "%3.0" /end CHARACTERISTIC
/begin CHARACTERISTIC fmy_id_bn_pow_vb.c_err_clas "Failure class number for failure XX" VALUE 0xa1003b54 _REC_VAL_20_u1 255. _CNV_A_R_LINEAR_____0_CM 0. 255. DISPLAY_IDENTIFIER C_ERR_CLAS_BN_POW_VB FORMAT "%3.0" /end CHARACTERISTIC
/begin CHARACTERISTIC fmy_id_bn_pow_gen.c_err_clas "Failure class number for failure XX" VALUE 0xa1003b40 _REC_VAL_20_u1 255. _CNV_A_R_LINEAR_____0_CM 0. 255. DISPLAY_IDENTIFIER C_ERR_CLAS_BN_POW_GEN FORMAT "%3.0" /end CHARACTERISTIC
/begin CHARACTERISTIC fmy_id_bn_msw.c_err_clas "Failure class number for failure XX" VALUE 0xa1003b2c _REC_VAL_20_u1 255. _CNV_A_R_LINEAR_____0_CM 0. 255. DISPLAY_IDENTIFIER C_ERR_CLAS_BN_MSW FORMAT "%3.0" /end CHARACTERISTIC
/begin CHARACTERISTIC fmy_id_bn_ang_pste.c_err_clas "Failure class number for failure XX" VALUE 0xa1003a14 _REC_VAL_20_u1 255. _CNV_A_R_LINEAR_____0_CM 0. 255. DISPLAY_IDENTIFIER C_ERR_CLAS_BN_ANG_PSTE FORMAT "%3.0" /end CHARACTERISTIC
/begin CHARACTERISTIC fmy_id_bn_gear_rev.c_err_clas "Failure class number for failure XX" VALUE 0xa1003ab4 _REC_VAL_20_u1 255. _CNV_A_R_LINEAR_____0_CM 0. 255. DISPLAY_IDENTIFIER C_ERR_CLAS_BN_GEAR_REV FORMAT "%3.0" /end CHARACTERISTIC
/begin CHARACTERISTIC fmy_id_bn_ltg_hdlp_l.c_err_clas "Failure class number for failure XX" VALUE 0xa1003b18 _REC_VAL_20_u1 255. _CNV_A_R_LINEAR_____0_CM 0. 255. DISPLAY_IDENTIFIER C_ERR_CLAS_BN_LTG_HDLP_L FORMAT "%3.0" /end CHARACTERISTIC
/begin CHARACTERISTIC fmy_id_bn_ldm.c_err_clas "Failure class number for failure XX" VALUE 0xa1003b04 _REC_VAL_20_u1 255. _CNV_A_R_LINEAR_____0_CM 0. 255. DISPLAY_IDENTIFIER C_ERR_CLAS_BN_LDM FORMAT "%3.0" /end CHARACTERISTIC
/begin CHARACTERISTIC fmy_id_bn_trl.c_err_clas "Failure class number for failure XX" VALUE 0xa1003c08 _REC_VAL_20_u1 255. _CNV_A_R_LINEAR_____0_CM 0. 255. DISPLAY_IDENTIFIER C_ERR_CLAS_BN_TRL FORMAT "%3.0" /end CHARACTERISTIC
/begin CHARACTERISTIC fmy_id_bn_hiv.c_err_clas "Failure class number for failure XX" VALUE 0xa1003ac8 _REC_VAL_20_u1 255. _CNV_A_R_LINEAR_____0_CM 0. 255. DISPLAY_IDENTIFIER C_ERR_CLAS_BN_HIV FORMAT "%3.0" /end CHARACTERISTIC
/begin CHARACTERISTIC fmy_id_bn_t_clk.c_err_clas "Failure class number for failure XX" VALUE 0xa1003b68 _REC_VAL_20_u1 255. _CNV_A_R_LINEAR_____0_CM 0. 255. DISPLAY_IDENTIFIER C_ERR_CLAS_BN_T_CLK FORMAT "%3.0" /end CHARACTERISTIC
/begin CHARACTERISTIC fmy_id_bn_efp_crash.c_err_clas "Failure class number for failure XX" VALUE 0xa1003a64 _REC_VAL_20_u1 255. _CNV_A_R_LINEAR_____0_CM 0. 255. DISPLAY_IDENTIFIER C_ERR_CLAS_BN_EFP_CRASH FORMAT "%3.0" /end CHARACTERISTIC
/begin CHARACTERISTIC fmy_id_bn_efp.c_err_clas "Failure class number for failure XX" VALUE 0xa1003a50 _REC_VAL_20_u1 255. _CNV_A_R_LINEAR_____0_CM 0. 255. DISPLAY_IDENTIFIER C_ERR_CLAS_BN_EFP FORMAT "%3.0" /end CHARACTERISTIC
/begin CHARACTERISTIC fmy_id_load_tps_plaus.c_err_clas "Failure class number for failure XX" VALUE 0xa100443c _REC_VAL_20_u1 255. _CNV_A_R_LINEAR_____0_CM 0. 255. DISPLAY_IDENTIFIER C_ERR_CLAS_LOAD_TPS_PLAUS FORMAT "%3.0" /end CHARACTERISTIC
/begin CHARACTERISTIC fmy_id_egy_min.c_err_clas "Failure class number for failure XX" VALUE 0xa100402c _REC_VAL_20_u1 255. _CNV_A_R_LINEAR_____0_CM 0. 255. DISPLAY_IDENTIFIER C_ERR_CLAS_EGY_MIN FORMAT "%3.0" /end CHARACTERISTIC
/begin CHARACTERISTIC fmy_id_efp_crash.c_err_clas "Failure class number for failure XX" VALUE 0xa1004004 _REC_VAL_20_u1 255. _CNV_A_R_LINEAR_____0_CM 0. 255. DISPLAY_IDENTIFIER C_ERR_CLAS_EFP_CRASH FORMAT "%3.0" /end CHARACTERISTIC
/begin CHARACTERISTIC fmy_id_efp.c_err_clas "Failure class number for failure XX" VALUE 0xa1003ff0 _REC_VAL_20_u1 255. _CNV_A_R_LINEAR_____0_CM 0. 255. DISPLAY_IDENTIFIER C_ERR_CLAS_EFP FORMAT "%3.0" /end CHARACTERISTIC
/begin CHARACTERISTIC fmy_id_locan_boff.c_err_clas "Failure class number for failure XX" VALUE 0xa1004450 _REC_VAL_20_u1 255. _CNV_A_R_LINEAR_____0_CM 0. 255. DISPLAY_IDENTIFIER C_ERR_CLAS_LOCAN_BOFF FORMAT "%3.0" /end CHARACTERISTIC
/begin CHARACTERISTIC fmy_id_cwp_plaus.c_err_clas "Failure class number for failure XX" VALUE 0xa1003e24 _REC_VAL_20_u1 255. _CNV_A_R_LINEAR_____0_CM 0. 255. DISPLAY_IDENTIFIER C_ERR_CLAS_CWP_PLAUS FORMAT "%3.0" /end CHARACTERISTIC
/begin CHARACTERISTIC fmy_id_cwp_int_off.c_err_clas "Failure class number for failure XX" VALUE 0xa1003e10 _REC_VAL_20_u1 255. _CNV_A_R_LINEAR_____0_CM 0. 255. DISPLAY_IDENTIFIER C_ERR_CLAS_CWP_INT_OFF FORMAT "%3.0" /end CHARACTERISTIC
/begin CHARACTERISTIC fmy_id_cwp_pwr.c_err_clas "Failure class number for failure XX" VALUE 0xa1003e38 _REC_VAL_20_u1 255. _CNV_A_R_LINEAR_____0_CM 0. 255. DISPLAY_IDENTIFIER C_ERR_CLAS_CWP_PWR FORMAT "%3.0" /end CHARACTERISTIC
/begin CHARACTERISTIC fmy_id_cwp_com_plaus.c_err_clas "Failure class number for failure XX" VALUE 0xa1003dfc _REC_VAL_20_u1 255. _CNV_A_R_LINEAR_____0_CM 0. 255. DISPLAY_IDENTIFIER C_ERR_CLAS_CWP_COM_PLAUS FORMAT "%3.0" /end CHARACTERISTIC
/begin CHARACTERISTIC fmy_id_qoil_sens.c_err_clas "Failure class number for failure XX" VALUE 0xa1004964 _REC_VAL_20_u1 255. _CNV_A_R_LINEAR_____0_CM 0. 255. DISPLAY_IDENTIFIER C_ERR_CLAS_QOIL_SENS FORMAT "%3.0" /end CHARACTERISTIC
/begin CHARACTERISTIC fmy_id_bat_sens.c_err_clas "Failure class number for failure XX" VALUE 0xa10039c4 _REC_VAL_20_u1 255. _CNV_A_R_LINEAR_____0_CM 0. 255. DISPLAY_IDENTIFIER C_ERR_CLAS_BAT_SENS FORMAT "%3.0" /end CHARACTERISTIC
/begin CHARACTERISTIC fmy_id_bat_sens_it.c_err_clas "Failure class number for failure XX" VALUE 0xa10039d8 _REC_VAL_20_u1 255. _CNV_A_R_LINEAR_____0_CM 0. 255. DISPLAY_IDENTIFIER C_ERR_CLAS_BAT_SENS_IT FORMAT "%3.0" /end CHARACTERISTIC
/begin CHARACTERISTIC fmy_id_bat_sens_it_el.c_err_clas "Failure class number for failure XX" VALUE 0xa10039ec _REC_VAL_20_u1 255. _CNV_A_R_LINEAR_____0_CM 0. 255. DISPLAY_IDENTIFIER C_ERR_CLAS_BAT_SENS_IT_EL FORMAT "%3.0" /end CHARACTERISTIC
/begin CHARACTERISTIC fmy_id_ecu_nvmy.c_err_clas "Failure class number for failure XX" VALUE 0xa1003fb4 _REC_VAL_20_u1 255. _CNV_A_R_LINEAR_____0_CM 0. 255. DISPLAY_IDENTIFIER C_ERR_CLAS_ECU_NVMY FORMAT "%3.0" /end CHARACTERISTIC
/begin CHARACTERISTIC fmy_id_gs.c_err_clas "Failure class number for failure XX" VALUE 0xa100416c _REC_VAL_20_u1 255. _CNV_A_R_LINEAR_____0_CM 0. 255. DISPLAY_IDENTIFIER C_ERR_CLAS_GS FORMAT "%3.0" /end CHARACTERISTIC
/begin CHARACTERISTIC fmy_id_plaus_igk_bn.c_err_clas "Failure class number for failure XX" VALUE 0xa1004838 _REC_VAL_20_u1 255. _CNV_A_R_LINEAR_____0_CM 0. 255. DISPLAY_IDENTIFIER C_ERR_CLAS_PLAUS_IGK_BN FORMAT "%3.0" /end CHARACTERISTIC
/begin CHARACTERISTIC fmy_id_tq_req_can.c_err_clas "Failure class number for failure XX" VALUE 0xa1004f7c _REC_VAL_20_u1 255. _CNV_A_R_LINEAR_____0_CM 0. 255. DISPLAY_IDENTIFIER C_ERR_CLAS_TQ_REQ_CAN FORMAT "%3.0" /end CHARACTERISTIC
/begin CHARACTERISTIC fmy_id_map_dip_sens.c_err_clas "Failure class number for failure XX" VALUE 0xa100452c _REC_VAL_20_u1 255. _CNV_A_R_LINEAR_____0_CM 0. 255. DISPLAY_IDENTIFIER C_ERR_CLAS_MAP_DIP_SENS FORMAT "%3.0" /end CHARACTERISTIC
/begin CHARACTERISTIC fmy_id_mec_ivvt_in.c_err_clas "Failure class number for failure XX" VALUE 0xa1004568 _REC_VAL_20_u1 255. _CNV_A_R_LINEAR_____0_CM 0. 255. DISPLAY_IDENTIFIER C_ERR_CLAS_MEC_IVVT_IN FORMAT "%3.0" /end CHARACTERISTIC
/begin CHARACTERISTIC fmy_id_mec_ivvt_ex.c_err_clas "Failure class number for failure XX" VALUE 0xa1004554 _REC_VAL_20_u1 255. _CNV_A_R_LINEAR_____0_CM 0. 255. DISPLAY_IDENTIFIER C_ERR_CLAS_MEC_IVVT_EX FORMAT "%3.0" /end CHARACTERISTIC
/begin CHARACTERISTIC fmy_id_tout_nox_sens_1.c_err_clas "Failure class number for failure XX" VALUE 0xa1004e64 _REC_VAL_20_u1 255. _CNV_A_R_LINEAR_____0_CM 0. 255. DISPLAY_IDENTIFIER C_ERR_CLAS_TOUT_NOX_SENS_1 FORMAT "%3.0" /end CHARACTERISTIC
/begin CHARACTERISTIC fmy_id_tout_nox_sens_2.c_err_clas "Failure class number for failure XX" VALUE 0xa1004e78 _REC_VAL_20_u1 255. _CNV_A_R_LINEAR_____0_CM 0. 255. DISPLAY_IDENTIFIER C_ERR_CLAS_TOUT_NOX_SENS_2 FORMAT "%3.0" /end CHARACTERISTIC
/begin CHARACTERISTIC fmy_id_vvl_rot.c_err_clas "Failure class number for failure XX" VALUE 0xa100510c _REC_VAL_20_u1 255. _CNV_A_R_LINEAR_____0_CM 0. 255. DISPLAY_IDENTIFIER C_ERR_CLAS_VVL_ROT FORMAT "%3.0" /end CHARACTERISTIC
/begin CHARACTERISTIC fmy_id_rly_vvl.c_err_clas "Failure class number for failure XX" VALUE 0xa1004a40 _REC_VAL_20_u1 255. _CNV_A_R_LINEAR_____0_CM 0. 255. DISPLAY_IDENTIFIER C_ERR_CLAS_RLY_VVL FORMAT "%3.0" /end CHARACTERISTIC
/begin CHARACTERISTIC fmy_id_nox_sens_1.c_err_clas "Failure class number for failure XX" VALUE 0xa10046e4 _REC_VAL_20_u1 255. _CNV_A_R_LINEAR_____0_CM 0. 255. DISPLAY_IDENTIFIER C_ERR_CLAS_NOX_SENS_1 FORMAT "%3.0" /end CHARACTERISTIC
/begin CHARACTERISTIC fmy_id_ovl_ecu_vvl.c_err_clas "Failure class number for failure XX" VALUE 0xa10047d4 _REC_VAL_20_u1 255. _CNV_A_R_LINEAR_____0_CM 0. 255. DISPLAY_IDENTIFIER C_ERR_CLAS_OVL_ECU_VVL FORMAT "%3.0" /end CHARACTERISTIC
/begin CHARACTERISTIC fmy_id_dr_sc_vvl.c_err_clas "Failure class number for failure XX" VALUE 0xa1003eec _REC_VAL_20_u1 255. _CNV_A_R_LINEAR_____0_CM 0. 255. DISPLAY_IDENTIFIER C_ERR_CLAS_DR_SC_VVL FORMAT "%3.0" /end CHARACTERISTIC
/begin CHARACTERISTIC fmy_id_crit_ovl_ecu_vvl.c_err_clas "Failure class number for failure XX" VALUE 0xa1003d48 _REC_VAL_20_u1 255. _CNV_A_R_LINEAR_____0_CM 0. 255. DISPLAY_IDENTIFIER C_ERR_CLAS_CRIT_OVL_ECU_VVL FORMAT "%3.0" /end CHARACTERISTIC
/begin CHARACTERISTIC fmy_id_nox_sens_2.c_err_clas "Failure class number for failure XX" VALUE 0xa10046f8 _REC_VAL_20_u1 255. _CNV_A_R_LINEAR_____0_CM 0. 255. DISPLAY_IDENTIFIER C_ERR_CLAS_NOX_SENS_2 FORMAT "%3.0" /end CHARACTERISTIC
/begin CHARACTERISTIC fmy_id_cur_h_vvl.c_err_clas "Failure class number for failure XX" VALUE 0xa1003dd4 _REC_VAL_20_u1 255. _CNV_A_R_LINEAR_____0_CM 0. 255. DISPLAY_IDENTIFIER C_ERR_CLAS_CUR_H_VVL FORMAT "%3.0" /end CHARACTERISTIC
/begin CHARACTERISTIC fmy_id_teg_pcat_down_1.c_err_clas "Failure class number for failure XX" VALUE 0xa1004d38 _REC_VAL_20_u1 255. _CNV_A_R_LINEAR_____0_CM 0. 255. DISPLAY_IDENTIFIER C_ERR_CLAS_TEG_PCAT_DOWN_1 FORMAT "%3.0" /end CHARACTERISTIC
/begin CHARACTERISTIC fmy_id_teg_pcat_down_2.c_err_clas "Failure class number for failure XX" VALUE 0xa1004d4c _REC_VAL_20_u1 255. _CNV_A_R_LINEAR_____0_CM 0. 255. DISPLAY_IDENTIFIER C_ERR_CLAS_TEG_PCAT_DOWN_2 FORMAT "%3.0" /end CHARACTERISTIC
/begin CHARACTERISTIC fmy_id_t_seg_er.c_err_clas "Failure class number for failure XX" VALUE 0xa1004c5c _REC_VAL_20_u1 255. _CNV_A_R_LINEAR_____0_CM 0. 255. DISPLAY_IDENTIFIER C_ERR_CLAS_T_SEG_ER FORMAT "%3.0" /end CHARACTERISTIC
/begin CHARACTERISTIC fmy_id_seg_ad_er.c_err_clas "Failure class number for failure XX" VALUE 0xa1004ab8 _REC_VAL_20_u1 255. _CNV_A_R_LINEAR_____0_CM 0. 255. DISPLAY_IDENTIFIER C_ERR_CLAS_SEG_AD_ER FORMAT "%3.0" /end CHARACTERISTIC
/begin CHARACTERISTIC fmy_id_vs_plaus.c_err_clas "Failure class number for failure XX" VALUE 0xa10050f8 _REC_VAL_20_u1 255. _CNV_A_R_LINEAR_____0_CM 0. 255. DISPLAY_IDENTIFIER C_ERR_CLAS_VS_PLAUS FORMAT "%3.0" /end CHARACTERISTIC
/begin CHARACTERISTIC fmy_id_ftl_obd.c_err_clas "Failure class number for failure XX" VALUE 0xa10040f4 _REC_VAL_20_u1 255. _CNV_A_R_LINEAR_____0_CM 0. 255. DISPLAY_IDENTIFIER C_ERR_CLAS_FTL_OBD FORMAT "%3.0" /end CHARACTERISTIC
/begin CHARACTERISTIC fmy_id_ftl_can.c_err_clas "Failure class number for failure XX" VALUE 0xa10040cc _REC_VAL_20_u1 255. _CNV_A_R_LINEAR_____0_CM 0. 255. DISPLAY_IDENTIFIER C_ERR_CLAS_FTL_CAN FORMAT "%3.0" /end CHARACTERISTIC
/begin CHARACTERISTIC fmy_id_tia_plaus.c_err_clas "Failure class number for failure XX" VALUE 0xa1004d88 _REC_VAL_20_u1 255. _CNV_A_R_LINEAR_____0_CM 0. 255. DISPLAY_IDENTIFIER C_ERR_CLAS_TIA_PLAUS FORMAT "%3.0" /end CHARACTERISTIC
/begin CHARACTERISTIC fmy_id_tam_can.c_err_clas "Failure class number for failure XX" VALUE 0xa1004c70 _REC_VAL_20_u1 255. _CNV_A_R_LINEAR_____0_CM 0. 255. DISPLAY_IDENTIFIER C_ERR_CLAS_TAM_CAN FORMAT "%3.0" /end CHARACTERISTIC
/begin CHARACTERISTIC fmy_id_tam_plaus.c_err_clas "Failure class number for failure XX" VALUE 0xa1004c84 _REC_VAL_20_u1 255. _CNV_A_R_LINEAR_____0_CM 0. 255. DISPLAY_IDENTIFIER C_ERR_CLAS_TAM_PLAUS FORMAT "%3.0" /end CHARACTERISTIC
/begin CHARACTERISTIC fmy_id_map_dip_shift.c_err_clas "Failure class number for failure XX" VALUE 0xa1004540 _REC_VAL_20_u1 255. _CNV_A_R_LINEAR_____0_CM 0. 255. DISPLAY_IDENTIFIER C_ERR_CLAS_MAP_DIP_SHIFT FORMAT "%3.0" /end CHARACTERISTIC
/begin CHARACTERISTIC fmy_id_cat_diag_1.c_err_clas "Failure class number for failure XX" VALUE 0xa1003c80 _REC_VAL_20_u1 255. _CNV_A_R_LINEAR_____0_CM 0. 255. DISPLAY_IDENTIFIER C_ERR_CLAS_CAT_DIAG_1 FORMAT "%3.0" /end CHARACTERISTIC
/begin CHARACTERISTIC fmy_id_cat_diag_2.c_err_clas "Failure class number for failure XX" VALUE 0xa1003c94 _REC_VAL_20_u1 255. _CNV_A_R_LINEAR_____0_CM 0. 255. DISPLAY_IDENTIFIER C_ERR_CLAS_CAT_DIAG_2 FORMAT "%3.0" /end CHARACTERISTIC
/begin CHARACTERISTIC fmy_id_cat_diag_afl_1.c_err_clas "Failure class number for failure XX" VALUE 0xa1003ca8 _REC_VAL_20_u1 255. _CNV_A_R_LINEAR_____0_CM 0. 255. DISPLAY_IDENTIFIER C_ERR_CLAS_CAT_DIAG_AFL_1 FORMAT "%3.0" /end CHARACTERISTIC
/begin CHARACTERISTIC fmy_id_cat_diag_afl_2.c_err_clas "Failure class number for failure XX" VALUE 0xa1003cbc _REC_VAL_20_u1 255. _CNV_A_R_LINEAR_____0_CM 0. 255. DISPLAY_IDENTIFIER C_ERR_CLAS_CAT_DIAG_AFL_2 FORMAT "%3.0" /end CHARACTERISTIC
/begin CHARACTERISTIC fmy_id_scg_ls_down_1.c_err_clas "Failure class number for failure XX" VALUE 0xa1004a68 _REC_VAL_20_u1 255. _CNV_A_R_LINEAR_____0_CM 0. 255. DISPLAY_IDENTIFIER C_ERR_CLAS_SCG_LS_DOWN_1 FORMAT "%3.0" /end CHARACTERISTIC
/begin CHARACTERISTIC fmy_id_scp_ls_down_1.c_err_clas "Failure class number for failure XX" VALUE 0xa1004a90 _REC_VAL_20_u1 255. _CNV_A_R_LINEAR_____0_CM 0. 255. DISPLAY_IDENTIFIER C_ERR_CLAS_SCP_LS_DOWN_1 FORMAT "%3.0" /end CHARACTERISTIC
/begin CHARACTERISTIC fmy_id_oc_ls_down_1.c_err_clas "Failure class number for failure XX" VALUE 0xa1004784 _REC_VAL_20_u1 255. _CNV_A_R_LINEAR_____0_CM 0. 255. DISPLAY_IDENTIFIER C_ERR_CLAS_OC_LS_DOWN_1 FORMAT "%3.0" /end CHARACTERISTIC
/begin CHARACTERISTIC fmy_id_puc_ls_down_1.c_err_clas "Failure class number for failure XX" VALUE 0xa1004860 _REC_VAL_20_u1 255. _CNV_A_R_LINEAR_____0_CM 0. 255. DISPLAY_IDENTIFIER C_ERR_CLAS_PUC_LS_DOWN_1 FORMAT "%3.0" /end CHARACTERISTIC
/begin CHARACTERISTIC fmy_id_fl_ls_down_1.c_err_clas "Failure class number for failure XX" VALUE 0xa100407c _REC_VAL_20_u1 255. _CNV_A_R_LINEAR_____0_CM 0. 255. DISPLAY_IDENTIFIER C_ERR_CLAS_FL_LS_DOWN_1 FORMAT "%3.0" /end CHARACTERISTIC
/begin CHARACTERISTIC fmy_id_lsl_up_if_1.c_err_clas "Failure class number for failure XX" VALUE 0xa10044dc _REC_VAL_20_u1 255. _CNV_A_R_LINEAR_____0_CM 0. 255. DISPLAY_IDENTIFIER C_ERR_CLAS_LSL_UP_IF_1 FORMAT "%3.0" /end CHARACTERISTIC
/begin CHARACTERISTIC fmy_id_el_lsl_up_1.c_err_clas "Failure class number for failure XX" VALUE 0xa1004054 _REC_VAL_20_u1 255. _CNV_A_R_LINEAR_____0_CM 0. 255. DISPLAY_IDENTIFIER C_ERR_CLAS_EL_LSL_UP_1 FORMAT "%3.0" /end CHARACTERISTIC
/begin CHARACTERISTIC fmy_id_lsh_up_1.c_err_clas "Failure class number for failure XX" VALUE 0xa10044b4 _REC_VAL_20_u1 255. _CNV_A_R_LINEAR_____0_CM 0. 255. DISPLAY_IDENTIFIER C_ERR_CLAS_LSH_UP_1 FORMAT "%3.0" /end CHARACTERISTIC
/begin CHARACTERISTIC fmy_id_lsh_down_1.c_err_clas "Failure class number for failure XX" VALUE 0xa1004464 _REC_VAL_20_u1 255. _CNV_A_R_LINEAR_____0_CM 0. 255. DISPLAY_IDENTIFIER C_ERR_CLAS_LSH_DOWN_1 FORMAT "%3.0" /end CHARACTERISTIC
/begin CHARACTERISTIC fmy_id_vls_down_dif_1.c_err_clas "Failure class number for failure XX" VALUE 0xa10050bc _REC_VAL_20_u1 255. _CNV_A_R_LINEAR_____0_CM 0. 255. DISPLAY_IDENTIFIER C_ERR_CLAS_VLS_DOWN_DIF_1 FORMAT "%3.0" /end CHARACTERISTIC
/begin CHARACTERISTIC fmy_id_lsh_lsl_up_1.c_err_clas "Failure class number for failure XX" VALUE 0xa100448c _REC_VAL_20_u1 255. _CNV_A_R_LINEAR_____0_CM 0. 255. DISPLAY_IDENTIFIER C_ERR_CLAS_LSH_LSL_UP_1 FORMAT "%3.0" /end CHARACTERISTIC
/begin CHARACTERISTIC fmy_id_air_lsl_up_1.c_err_clas "Failure class number for failure XX" VALUE 0xa1003924 _REC_VAL_20_u1 255. _CNV_A_R_LINEAR_____0_CM 0. 255. DISPLAY_IDENTIFIER C_ERR_CLAS_AIR_LSL_UP_1 FORMAT "%3.0" /end CHARACTERISTIC
/begin CHARACTERISTIC fmy_id_pue_ls_down_1.c_err_clas "Failure class number for failure XX" VALUE 0xa10048b0 _REC_VAL_20_u1 255. _CNV_A_R_LINEAR_____0_CM 0. 255. DISPLAY_IDENTIFIER C_ERR_CLAS_PUE_LS_DOWN_1 FORMAT "%3.0" /end CHARACTERISTIC
/begin CHARACTERISTIC fmy_id_swt_ls_down_1.c_err_clas "Failure class number for failure XX" VALUE 0xa1004bd0 _REC_VAL_20_u1 255. _CNV_A_R_LINEAR_____0_CM 0. 255. DISPLAY_IDENTIFIER C_ERR_CLAS_SWT_LS_DOWN_1 FORMAT "%3.0" /end CHARACTERISTIC
/begin CHARACTERISTIC fmy_id_obd_lsh_down_1.c_err_clas "Failure class number for failure XX" VALUE 0xa1004734 _REC_VAL_20_u1 255. _CNV_A_R_LINEAR_____0_CM 0. 255. DISPLAY_IDENTIFIER C_ERR_CLAS_OBD_LSH_DOWN_1 FORMAT "%3.0" /end CHARACTERISTIC
/begin CHARACTERISTIC fmy_id_dyn_vld_ls_up_1.c_err_clas "Failure class number for failure XX" VALUE 0xa1003f00 _REC_VAL_20_u1 255. _CNV_A_R_LINEAR_____0_CM 0. 255. DISPLAY_IDENTIFIER C_ERR_CLAS_DYN_VLD_LS_UP_1 FORMAT "%3.0" /end CHARACTERISTIC
/begin CHARACTERISTIC fmy_id_puc_vld_ls_up_1.c_err_clas "Failure class number for failure XX" VALUE 0xa1004888 _REC_VAL_20_u1 255. _CNV_A_R_LINEAR_____0_CM 0. 255. DISPLAY_IDENTIFIER C_ERR_CLAS_PUC_VLD_LS_UP_1 FORMAT "%3.0" /end CHARACTERISTIC
/begin CHARACTERISTIC fmy_id_obd_vld_lsh_up_1.c_err_clas "Failure class number for failure XX" VALUE 0xa100475c _REC_VAL_20_u1 255. _CNV_A_R_LINEAR_____0_CM 0. 255. DISPLAY_IDENTIFIER C_ERR_CLAS_OBD_VLD_LSH_UP_1 FORMAT "%3.0" /end CHARACTERISTIC
/begin CHARACTERISTIC fmy_id_chk_ls_down_1.c_err_clas "Failure class number for failure XX" VALUE 0xa1003d0c _REC_VAL_20_u1 255. _CNV_A_R_LINEAR_____0_CM 0. 255. DISPLAY_IDENTIFIER C_ERR_CLAS_CHK_LS_DOWN_1 FORMAT "%3.0" /end CHARACTERISTIC
/begin CHARACTERISTIC fmy_id_shift_afl_lsl_up_1.c_err_clas "Failure class number for failure XX" VALUE 0xa1004af4 _REC_VAL_20_u1 255. _CNV_A_R_LINEAR_____0_CM 0. 255. DISPLAY_IDENTIFIER C_ERR_CLAS_SHIFT_AFL_LSL_UP_1 FORMAT "%3.0" /end CHARACTERISTIC
/begin CHARACTERISTIC fmy_id_shift_afr_lsl_up_1.c_err_clas "Failure class number for failure XX" VALUE 0xa1004b1c _REC_VAL_20_u1 255. _CNV_A_R_LINEAR_____0_CM 0. 255. DISPLAY_IDENTIFIER C_ERR_CLAS_SHIFT_AFR_LSL_UP_1 FORMAT "%3.0" /end CHARACTERISTIC
/begin CHARACTERISTIC fmy_id_oc_lsl_up_1.c_err_clas "Failure class number for failure XX" VALUE 0xa10047ac _REC_VAL_20_u1 255. _CNV_A_R_LINEAR_____0_CM 0. 255. DISPLAY_IDENTIFIER C_ERR_CLAS_OC_LSL_UP_1 FORMAT "%3.0" /end CHARACTERISTIC
/begin CHARACTERISTIC fmy_id_delta_i_lam_1.c_err_clas "Failure class number for failure XX" VALUE 0xa1003e60 _REC_VAL_20_u1 255. _CNV_A_R_LINEAR_____0_CM 0. 255. DISPLAY_IDENTIFIER C_ERR_CLAS_DELTA_I_LAM_1 FORMAT "%3.0" /end CHARACTERISTIC
/begin CHARACTERISTIC fmy_id_rgn_nt_ls_down_1.c_err_clas "Failure class number for failure XX" VALUE 0xa10049a0 _REC_VAL_20_u1 255. _CNV_A_R_LINEAR_____0_CM 0. 255. DISPLAY_IDENTIFIER C_ERR_CLAS_RGN_NT_LS_DOWN_1 FORMAT "%3.0" /end CHARACTERISTIC
/begin CHARACTERISTIC fmy_id_chg_ls_down.c_err_clas "Failure class number for failure XX" VALUE 0xa1003cd0 _REC_VAL_20_u1 255. _CNV_A_R_LINEAR_____0_CM 0. 255. DISPLAY_IDENTIFIER C_ERR_CLAS_CHG_LS_DOWN FORMAT "%3.0" /end CHARACTERISTIC
/begin CHARACTERISTIC fmy_id_scg_ls_down_2.c_err_clas "Failure class number for failure XX" VALUE 0xa1004a7c _REC_VAL_20_u1 255. _CNV_A_R_LINEAR_____0_CM 0. 255. DISPLAY_IDENTIFIER C_ERR_CLAS_SCG_LS_DOWN_2 FORMAT "%3.0" /end CHARACTERISTIC
/begin CHARACTERISTIC fmy_id_scp_ls_down_2.c_err_clas "Failure class number for failure XX" VALUE 0xa1004aa4 _REC_VAL_20_u1 255. _CNV_A_R_LINEAR_____0_CM 0. 255. DISPLAY_IDENTIFIER C_ERR_CLAS_SCP_LS_DOWN_2 FORMAT "%3.0" /end CHARACTERISTIC
/begin CHARACTERISTIC fmy_id_oc_ls_down_2.c_err_clas "Failure class number for failure XX" VALUE 0xa1004798 _REC_VAL_20_u1 255. _CNV_A_R_LINEAR_____0_CM 0. 255. DISPLAY_IDENTIFIER C_ERR_CLAS_OC_LS_DOWN_2 FORMAT "%3.0" /end CHARACTERISTIC
/begin CHARACTERISTIC fmy_id_puc_ls_down_2.c_err_clas "Failure class number for failure XX" VALUE 0xa1004874 _REC_VAL_20_u1 255. _CNV_A_R_LINEAR_____0_CM 0. 255. DISPLAY_IDENTIFIER C_ERR_CLAS_PUC_LS_DOWN_2 FORMAT "%3.0" /end CHARACTERISTIC
/begin CHARACTERISTIC fmy_id_fl_ls_down_2.c_err_clas "Failure class number for failure XX" VALUE 0xa1004090 _REC_VAL_20_u1 255. _CNV_A_R_LINEAR_____0_CM 0. 255. DISPLAY_IDENTIFIER C_ERR_CLAS_FL_LS_DOWN_2 FORMAT "%3.0" /end CHARACTERISTIC
/begin CHARACTERISTIC fmy_id_lsl_up_if_2.c_err_clas "Failure class number for failure XX" VALUE 0xa10044f0 _REC_VAL_20_u1 255. _CNV_A_R_LINEAR_____0_CM 0. 255. DISPLAY_IDENTIFIER C_ERR_CLAS_LSL_UP_IF_2 FORMAT "%3.0" /end CHARACTERISTIC
/begin CHARACTERISTIC fmy_id_el_lsl_up_2.c_err_clas "Failure class number for failure XX" VALUE 0xa1004068 _REC_VAL_20_u1 255. _CNV_A_R_LINEAR_____0_CM 0. 255. DISPLAY_IDENTIFIER C_ERR_CLAS_EL_LSL_UP_2 FORMAT "%3.0" /end CHARACTERISTIC
/begin CHARACTERISTIC fmy_id_lsh_up_2.c_err_clas "Failure class number for failure XX" VALUE 0xa10044c8 _REC_VAL_20_u1 255. _CNV_A_R_LINEAR_____0_CM 0. 255. DISPLAY_IDENTIFIER C_ERR_CLAS_LSH_UP_2 FORMAT "%3.0" /end CHARACTERISTIC
/begin CHARACTERISTIC fmy_id_lsh_down_2.c_err_clas "Failure class number for failure XX" VALUE 0xa1004478 _REC_VAL_20_u1 255. _CNV_A_R_LINEAR_____0_CM 0. 255. DISPLAY_IDENTIFIER C_ERR_CLAS_LSH_DOWN_2 FORMAT "%3.0" /end CHARACTERISTIC
/begin CHARACTERISTIC fmy_id_vls_down_dif_2.c_err_clas "Failure class number for failure XX" VALUE 0xa10050d0 _REC_VAL_20_u1 255. _CNV_A_R_LINEAR_____0_CM 0. 255. DISPLAY_IDENTIFIER C_ERR_CLAS_VLS_DOWN_DIF_2 FORMAT "%3.0" /end CHARACTERISTIC
/begin CHARACTERISTIC fmy_id_lsh_lsl_up_2.c_err_clas "Failure class number for failure XX" VALUE 0xa10044a0 _REC_VAL_20_u1 255. _CNV_A_R_LINEAR_____0_CM 0. 255. DISPLAY_IDENTIFIER C_ERR_CLAS_LSH_LSL_UP_2 FORMAT "%3.0" /end CHARACTERISTIC
/begin CHARACTERISTIC fmy_id_air_lsl_up_2.c_err_clas "Failure class number for failure XX" VALUE 0xa1003938 _REC_VAL_20_u1 255. _CNV_A_R_LINEAR_____0_CM 0. 255. DISPLAY_IDENTIFIER C_ERR_CLAS_AIR_LSL_UP_2 FORMAT "%3.0" /end CHARACTERISTIC
/begin CHARACTERISTIC fmy_id_pue_ls_down_2.c_err_clas "Failure class number for failure XX" VALUE 0xa10048c4 _REC_VAL_20_u1 255. _CNV_A_R_LINEAR_____0_CM 0. 255. DISPLAY_IDENTIFIER C_ERR_CLAS_PUE_LS_DOWN_2 FORMAT "%3.0" /end CHARACTERISTIC
/begin CHARACTERISTIC fmy_id_swt_ls_down_2.c_err_clas "Failure class number for failure XX" VALUE 0xa1004be4 _REC_VAL_20_u1 255. _CNV_A_R_LINEAR_____0_CM 0. 255. DISPLAY_IDENTIFIER C_ERR_CLAS_SWT_LS_DOWN_2 FORMAT "%3.0" /end CHARACTERISTIC
/begin CHARACTERISTIC fmy_id_obd_lsh_down_2.c_err_clas "Failure class number for failure XX" VALUE 0xa1004748 _REC_VAL_20_u1 255. _CNV_A_R_LINEAR_____0_CM 0. 255. DISPLAY_IDENTIFIER C_ERR_CLAS_OBD_LSH_DOWN_2 FORMAT "%3.0" /end CHARACTERISTIC
/begin CHARACTERISTIC fmy_id_dyn_vld_ls_up_2.c_err_clas "Failure class number for failure XX" VALUE 0xa1003f14 _REC_VAL_20_u1 255. _CNV_A_R_LINEAR_____0_CM 0. 255. DISPLAY_IDENTIFIER C_ERR_CLAS_DYN_VLD_LS_UP_2 FORMAT "%3.0" /end CHARACTERISTIC
/begin CHARACTERISTIC fmy_id_puc_vld_ls_up_2.c_err_clas "Failure class number for failure XX" VALUE 0xa100489c _REC_VAL_20_u1 255. _CNV_A_R_LINEAR_____0_CM 0. 255. DISPLAY_IDENTIFIER C_ERR_CLAS_PUC_VLD_LS_UP_2 FORMAT "%3.0" /end CHARACTERISTIC
/begin CHARACTERISTIC fmy_id_obd_vld_lsh_up_2.c_err_clas "Failure class number for failure XX" VALUE 0xa1004770 _REC_VAL_20_u1 255. _CNV_A_R_LINEAR_____0_CM 0. 255. DISPLAY_IDENTIFIER C_ERR_CLAS_OBD_VLD_LSH_UP_2 FORMAT "%3.0" /end CHARACTERISTIC
/begin CHARACTERISTIC fmy_id_chk_ls_down_2.c_err_clas "Failure class number for failure XX" VALUE 0xa1003d20 _REC_VAL_20_u1 255. _CNV_A_R_LINEAR_____0_CM 0. 255. DISPLAY_IDENTIFIER C_ERR_CLAS_CHK_LS_DOWN_2 FORMAT "%3.0" /end CHARACTERISTIC
/begin CHARACTERISTIC fmy_id_shift_afl_lsl_up_2.c_err_clas "Failure class number for failure XX" VALUE 0xa1004b08 _REC_VAL_20_u1 255. _CNV_A_R_LINEAR_____0_CM 0. 255. DISPLAY_IDENTIFIER C_ERR_CLAS_SHIFT_AFL_LSL_UP_2 FORMAT "%3.0" /end CHARACTERISTIC
/begin CHARACTERISTIC fmy_id_shift_afr_lsl_up_2.c_err_clas "Failure class number for failure XX" VALUE 0xa1004b30 _REC_VAL_20_u1 255. _CNV_A_R_LINEAR_____0_CM 0. 255. DISPLAY_IDENTIFIER C_ERR_CLAS_SHIFT_AFR_LSL_UP_2 FORMAT "%3.0" /end CHARACTERISTIC
/begin CHARACTERISTIC fmy_id_oc_lsl_up_2.c_err_clas "Failure class number for failure XX" VALUE 0xa10047c0 _REC_VAL_20_u1 255. _CNV_A_R_LINEAR_____0_CM 0. 255. DISPLAY_IDENTIFIER C_ERR_CLAS_OC_LSL_UP_2 FORMAT "%3.0" /end CHARACTERISTIC
/begin CHARACTERISTIC fmy_id_delta_i_lam_2.c_err_clas "Failure class number for failure XX" VALUE 0xa1003e74 _REC_VAL_20_u1 255. _CNV_A_R_LINEAR_____0_CM 0. 255. DISPLAY_IDENTIFIER C_ERR_CLAS_DELTA_I_LAM_2 FORMAT "%3.0" /end CHARACTERISTIC
/begin MEASUREMENT fmy_stat_delta_i_lam_2.err_info_stat.lv_ready "Readiness flag related to diagnosis XX" UWORD _CNV_S_2_RANGE__0___1_CM 1 100. 0. 1. DISPLAY_IDENTIFIER LV_READY_DELTA_I_LAM_2 ECU_ADDRESS 0xd00042aa BIT_MASK 0x10 /end MEASUREMENT
/begin MEASUREMENT fmy_stat_delta_i_lam_2.err_info_stat.lv_end_diag "End of diagnosis XX" UWORD _CNV_S_2_RANGE__0___1_CM 1 100. 0. 1. DISPLAY_IDENTIFIER LV_END_DIAG_DELTA_I_LAM_2 ECU_ADDRESS 0xd00042aa BIT_MASK 0x20 /end MEASUREMENT
/begin MEASUREMENT fmy_stat_delta_i_lam_2.err_info_stat.lv_cdn_diag "Diagnosis condition to start symptom detection (set to 1 when condition is fulfilled)" UWORD _CNV_S_2_RANGE__0___1_CM 1 100. 0. 1. DISPLAY_IDENTIFIER LV_CDN_DIAG_DELTA_I_LAM_2 ECU_ADDRESS 0xd00042aa BIT_MASK 0x40 /end MEASUREMENT
/begin MEASUREMENT fmy_stat_delta_i_lam_2.err_info_stat.err_sym "For each symptom: status of failure (set to 1 when failure symptom is detected)" UWORD _CNV_S_16_RANGE_ERR__485_CM 1 100. 0. 15. DISPLAY_IDENTIFIER ERR_SYM_DELTA_I_LAM_2 ECU_ADDRESS 0xd00042aa BIT_MASK 0x780 /end MEASUREMENT
/begin CHARACTERISTIC fmy_id_rgn_nt_ls_down_2.c_err_clas "Failure class number for failure XX" VALUE 0xa10049b4 _REC_VAL_20_u1 255. _CNV_A_R_LINEAR_____0_CM 0. 255. DISPLAY_IDENTIFIER C_ERR_CLAS_RGN_NT_LS_DOWN_2 FORMAT "%3.0" /end CHARACTERISTIC
/begin MEASUREMENT fmy_stat_rgn_nt_ls_down_2.ctr_abc "anti-bounce counter for diagnosis XX" UBYTE _CNV_A_R_LINEAR_____0_CM 1 100. 0. 255. DISPLAY_IDENTIFIER CTR_ABC_RGN_NT_LS_DOWN_2 ECU_ADDRESS 0xd00044e8 FORMAT "%3.0" /end MEASUREMENT
/begin MEASUREMENT fmy_stat_rgn_nt_ls_down_2.ctr_end_diag "Counter for the end of diagnosis XX generation" UBYTE _CNV_A_R_LINEAR_____0_CM 1 100. 0. 255. DISPLAY_IDENTIFIER CTR_ABC_END_DIAG_RGN_NT_LS_DOWN_2 ECU_ADDRESS 0xd00044e9 FORMAT "%3.0" /end MEASUREMENT
/begin MEASUREMENT fmy_stat_rgn_nt_ls_down_2.err_info_stat.lv_err_mem "Failure is stored in dynamic memory (2nd layer)" UWORD _CNV_S_2_RANGE__0___1_CM 1 100. 0. 1. DISPLAY_IDENTIFIER LV_ERR_MEM_RGN_NT_LS_DOWN_2 ECU_ADDRESS 0xd00044ea BIT_MASK 0x8 /end MEASUREMENT
/begin MEASUREMENT fmy_stat_rgn_nt_ls_down_2.err_info_stat.lv_ready "Readiness flag related to diagnosis XX" UWORD _CNV_S_2_RANGE__0___1_CM 1 100. 0. 1. DISPLAY_IDENTIFIER LV_READY_RGN_NT_LS_DOWN_2 ECU_ADDRESS 0xd00044ea BIT_MASK 0x10 /end MEASUREMENT
/begin MEASUREMENT fmy_stat_rgn_nt_ls_down_2.err_info_stat.lv_end_diag "End of diagnosis XX" UWORD _CNV_S_2_RANGE__0___1_CM 1 100. 0. 1. DISPLAY_IDENTIFIER LV_END_DIAG_RGN_NT_LS_DOWN_2 ECU_ADDRESS 0xd00044ea BIT_MASK 0x20 /end MEASUREMENT
/begin MEASUREMENT fmy_stat_rgn_nt_ls_down_2.err_info_stat.lv_cdn_diag "Diagnosis condition to start symptom detection (set to 1 when condition is fulfilled)" UWORD _CNV_S_2_RANGE__0___1_CM 1 100. 0. 1. DISPLAY_IDENTIFIER LV_CDN_DIAG_RGN_NT_LS_DOWN_2 ECU_ADDRESS 0xd00044ea BIT_MASK 0x40 /end MEASUREMENT
/begin MEASUREMENT fmy_stat_rgn_nt_ls_down_2.err_info_stat.err_sym "For each symptom: status of failure (set to 1 when failure symptom is detected)" UWORD _CNV_S_16_RANGE_ERR__485_CM 1 100. 0. 15. DISPLAY_IDENTIFIER ERR_SYM_RGN_NT_LS_DOWN_2 ECU_ADDRESS 0xd00044ea BIT_MASK 0x780 /end MEASUREMENT
/begin CHARACTERISTIC fmy_id_chg_ls_up.c_err_clas "Failure class number for failure XX" VALUE 0xa1003ce4 _REC_VAL_20_u1 255. _CNV_A_R_LINEAR_____0_CM 0. 255. DISPLAY_IDENTIFIER C_ERR_CLAS_CHG_LS_UP FORMAT "%3.0" /end CHARACTERISTIC
/begin MEASUREMENT fmy_stat_chg_ls_up.ctr_abc "anti-bounce counter for diagnosis XX" UBYTE _CNV_A_R_LINEAR_____0_CM 1 100. 0. 255. DISPLAY_IDENTIFIER CTR_ABC_CHG_LS_UP ECU_ADDRESS 0xd0004258 FORMAT "%3.0" /end MEASUREMENT
/begin MEASUREMENT fmy_stat_chg_ls_up.ctr_end_diag "Counter for the end of diagnosis XX generation" UBYTE _CNV_A_R_LINEAR_____0_CM 1 100. 0. 255. DISPLAY_IDENTIFIER CTR_ABC_END_DIAG_CHG_LS_UP ECU_ADDRESS 0xd0004259 FORMAT "%3.0" /end MEASUREMENT
/begin MEASUREMENT fmy_stat_chg_ls_up.err_info_stat.lv_err_mem "Failure is stored in dynamic memory (2nd layer)" UWORD _CNV_S_2_RANGE__0___1_CM 1 100. 0. 1. DISPLAY_IDENTIFIER LV_ERR_MEM_CHG_LS_UP ECU_ADDRESS 0xd000425a BIT_MASK 0x8 /end MEASUREMENT
/begin MEASUREMENT fmy_stat_chg_ls_up.err_info_stat.lv_ready "Readiness flag related to diagnosis XX" UWORD _CNV_S_2_RANGE__0___1_CM 1 100. 0. 1. DISPLAY_IDENTIFIER LV_READY_CHG_LS_UP ECU_ADDRESS 0xd000425a BIT_MASK 0x10 /end MEASUREMENT
/begin MEASUREMENT fmy_stat_chg_ls_up.err_info_stat.lv_end_diag "End of diagnosis XX" UWORD _CNV_S_2_RANGE__0___1_CM 1 100. 0. 1. DISPLAY_IDENTIFIER LV_END_DIAG_CHG_LS_UP ECU_ADDRESS 0xd000425a BIT_MASK 0x20 /end MEASUREMENT
/begin MEASUREMENT fmy_stat_chg_ls_up.err_info_stat.lv_cdn_diag "Diagnosis condition to start symptom detection (set to 1 when condition is fulfilled)" UWORD _CNV_S_2_RANGE__0___1_CM 1 100. 0. 1. DISPLAY_IDENTIFIER LV_CDN_DIAG_CHG_LS_UP ECU_ADDRESS 0xd000425a BIT_MASK 0x40 /end MEASUREMENT
/begin MEASUREMENT fmy_stat_chg_ls_up.err_info_stat.err_sym "For each symptom: status of failure (set to 1 when failure symptom is detected)" UWORD _CNV_S_16_RANGE_ERR__485_CM 1 100. 0. 15. DISPLAY_IDENTIFIER ERR_SYM_CHG_LS_UP ECU_ADDRESS 0xd000425a BIT_MASK 0x780 /end MEASUREMENT
/begin CHARACTERISTIC fmy_id_alter_com.c_err_clas "Failure class number for failure XX" VALUE 0xa1003988 _REC_VAL_20_u1 255. _CNV_A_R_LINEAR_____0_CM 0. 255. DISPLAY_IDENTIFIER C_ERR_CLAS_ALTER_COM FORMAT "%3.0" /end CHARACTERISTIC
/begin MEASUREMENT fmy_stat_alter_com.err_info_stat.lv_err_mem "Failure is stored in dynamic memory (2nd layer)" UWORD _CNV_S_2_RANGE__0___1_CM 1 100. 0. 1. DISPLAY_IDENTIFIER LV_ERR_MEM_ALTER_COM ECU_ADDRESS 0xd00041ae BIT_MASK 0x8 /end MEASUREMENT
/begin MEASUREMENT fmy_stat_alter_com.err_info_stat.lv_ready "Readiness flag related to diagnosis XX" UWORD _CNV_S_2_RANGE__0___1_CM 1 100. 0. 1. DISPLAY_IDENTIFIER LV_READY_ALTER_COM ECU_ADDRESS 0xd00041ae BIT_MASK 0x10 /end MEASUREMENT
/begin MEASUREMENT fmy_stat_alter_com.err_info_stat.lv_end_diag "End of diagnosis XX" UWORD _CNV_S_2_RANGE__0___1_CM 1 100. 0. 1. DISPLAY_IDENTIFIER LV_END_DIAG_ALTER_COM ECU_ADDRESS 0xd00041ae BIT_MASK 0x20 /end MEASUREMENT
/begin MEASUREMENT fmy_stat_alter_com.err_info_stat.lv_cdn_diag "Diagnosis condition to start symptom detection (set to 1 when condition is fulfilled)" UWORD _CNV_S_2_RANGE__0___1_CM 1 100. 0. 1. DISPLAY_IDENTIFIER LV_CDN_DIAG_ALTER_COM ECU_ADDRESS 0xd00041ae BIT_MASK 0x40 /end MEASUREMENT
/begin MEASUREMENT fmy_stat_alter_com.err_info_stat.err_sym "For each symptom: status of failure (set to 1 when failure symptom is detected)" UWORD _CNV_S_16_RANGE_ERR__485_CM 1 100. 0. 15. DISPLAY_IDENTIFIER ERR_SYM_ALTER_COM ECU_ADDRESS 0xd00041ae BIT_MASK 0x780 /end MEASUREMENT
/begin CHARACTERISTIC fmy_id_cwp_com.c_err_clas "Failure class number for failure XX" VALUE 0xa1003de8 _REC_VAL_20_u1 255. _CNV_A_R_LINEAR_____0_CM 0. 255. DISPLAY_IDENTIFIER C_ERR_CLAS_CWP_COM FORMAT "%3.0" /end CHARACTERISTIC
/begin MEASUREMENT fmy_stat_cwp_com.err_info_stat.lv_err_mem "Failure is stored in dynamic memory (2nd layer)" UWORD _CNV_S_2_RANGE__0___1_CM 1 100. 0. 1. DISPLAY_IDENTIFIER LV_ERR_MEM_CWP_COM ECU_ADDRESS 0xd000428e BIT_MASK 0x8 /end MEASUREMENT
/begin MEASUREMENT fmy_stat_cwp_com.err_info_stat.lv_ready "Readiness flag related to diagnosis XX" UWORD _CNV_S_2_RANGE__0___1_CM 1 100. 0. 1. DISPLAY_IDENTIFIER LV_READY_CWP_COM ECU_ADDRESS 0xd000428e BIT_MASK 0x10 /end MEASUREMENT
/begin MEASUREMENT fmy_stat_cwp_com.err_info_stat.lv_end_diag "End of diagnosis XX" UWORD _CNV_S_2_RANGE__0___1_CM 1 100. 0. 1. DISPLAY_IDENTIFIER LV_END_DIAG_CWP_COM ECU_ADDRESS 0xd000428e BIT_MASK 0x20 /end MEASUREMENT
/begin MEASUREMENT fmy_stat_cwp_com.err_info_stat.lv_cdn_diag "Diagnosis condition to start symptom detection (set to 1 when condition is fulfilled)" UWORD _CNV_S_2_RANGE__0___1_CM 1 100. 0. 1. DISPLAY_IDENTIFIER LV_CDN_DIAG_CWP_COM ECU_ADDRESS 0xd000428e BIT_MASK 0x40 /end MEASUREMENT
/begin MEASUREMENT fmy_stat_cwp_com.err_info_stat.err_sym "For each symptom: status of failure (set to 1 when failure symptom is detected)" UWORD _CNV_S_16_RANGE_ERR__485_CM 1 100. 0. 15. DISPLAY_IDENTIFIER ERR_SYM_CWP_COM ECU_ADDRESS 0xd000428e BIT_MASK 0x780 /end MEASUREMENT
/begin CHARACTERISTIC fmy_id_qoil_com.c_err_clas "Failure class number for failure XX" VALUE 0xa1004950 _REC_VAL_20_u1 255. _CNV_A_R_LINEAR_____0_CM 0. 255. DISPLAY_IDENTIFIER C_ERR_CLAS_QOIL_COM FORMAT "%3.0" /end CHARACTERISTIC
/begin MEASUREMENT fmy_stat_qoil_com.err_info_stat.lv_err_mem "Failure is stored in dynamic memory (2nd layer)" UWORD _CNV_S_2_RANGE__0___1_CM 1 100. 0. 1. DISPLAY_IDENTIFIER LV_ERR_MEM_QOIL_COM ECU_ADDRESS 0xd00044d6 BIT_MASK 0x8 /end MEASUREMENT
/begin MEASUREMENT fmy_stat_qoil_com.err_info_stat.lv_ready "Readiness flag related to diagnosis XX" UWORD _CNV_S_2_RANGE__0___1_CM 1 100. 0. 1. DISPLAY_IDENTIFIER LV_READY_QOIL_COM ECU_ADDRESS 0xd00044d6 BIT_MASK 0x10 /end MEASUREMENT
/begin MEASUREMENT fmy_stat_qoil_com.err_info_stat.lv_end_diag "End of diagnosis XX" UWORD _CNV_S_2_RANGE__0___1_CM 1 100. 0. 1. DISPLAY_IDENTIFIER LV_END_DIAG_QOIL_COM ECU_ADDRESS 0xd00044d6 BIT_MASK 0x20 /end MEASUREMENT
/begin MEASUREMENT fmy_stat_qoil_com.err_info_stat.lv_cdn_diag "Diagnosis condition to start symptom detection (set to 1 when condition is fulfilled)" UWORD _CNV_S_2_RANGE__0___1_CM 1 100. 0. 1. DISPLAY_IDENTIFIER LV_CDN_DIAG_QOIL_COM ECU_ADDRESS 0xd00044d6 BIT_MASK 0x40 /end MEASUREMENT
/begin MEASUREMENT fmy_stat_qoil_com.err_info_stat.err_sym "For each symptom: status of failure (set to 1 when failure symptom is detected)" UWORD _CNV_S_16_RANGE_ERR__485_CM 1 100. 0. 15. DISPLAY_IDENTIFIER ERR_SYM_QOIL_COM ECU_ADDRESS 0xd00044d6 BIT_MASK 0x780 /end MEASUREMENT
/begin CHARACTERISTIC fmy_id_sens_bat_smt_com.c_err_clas "Failure class number for failure XX" VALUE 0xa1004ae0 _REC_VAL_20_u1 255. _CNV_A_R_LINEAR_____0_CM 0. 255. DISPLAY_IDENTIFIER C_ERR_CLAS_SENS_BAT_SMT_COM FORMAT "%3.0" /end CHARACTERISTIC
/begin MEASUREMENT fmy_stat_sens_bat_smt_com.err_info_stat.lv_err_mem "Failure is stored in dynamic memory (2nd layer)" UWORD _CNV_S_2_RANGE__0___1_CM 1 100. 0. 1. DISPLAY_IDENTIFIER LV_ERR_MEM_SENS_BAT_SMT_COM ECU_ADDRESS 0xd0004526 BIT_MASK 0x8 /end MEASUREMENT
/begin MEASUREMENT fmy_stat_sens_bat_smt_com.err_info_stat.lv_ready "Readiness flag related to diagnosis XX" UWORD _CNV_S_2_RANGE__0___1_CM 1 100. 0. 1. DISPLAY_IDENTIFIER LV_READY_SENS_BAT_SMT_COM ECU_ADDRESS 0xd0004526 BIT_MASK 0x10 /end MEASUREMENT
/begin MEASUREMENT fmy_stat_sens_bat_smt_com.err_info_stat.lv_end_diag "End of diagnosis XX" UWORD _CNV_S_2_RANGE__0___1_CM 1 100. 0. 1. DISPLAY_IDENTIFIER LV_END_DIAG_SENS_BAT_SMT_COM ECU_ADDRESS 0xd0004526 BIT_MASK 0x20 /end MEASUREMENT
/begin MEASUREMENT fmy_stat_sens_bat_smt_com.err_info_stat.lv_cdn_diag "Diagnosis condition to start symptom detection (set to 1 when condition is fulfilled)" UWORD _CNV_S_2_RANGE__0___1_CM 1 100. 0. 1. DISPLAY_IDENTIFIER LV_CDN_DIAG_SENS_BAT_SMT_COM ECU_ADDRESS 0xd0004526 BIT_MASK 0x40 /end MEASUREMENT
/begin MEASUREMENT fmy_stat_sens_bat_smt_com.err_info_stat.err_sym "For each symptom: status of failure (set to 1 when failure symptom is detected)" UWORD _CNV_S_16_RANGE_ERR__485_CM 1 100. 0. 15. DISPLAY_IDENTIFIER ERR_SYM_SENS_BAT_SMT_COM ECU_ADDRESS 0xd0004526 BIT_MASK 0x780 /end MEASUREMENT
/begin CHARACTERISTIC fmy_id_ecraspwm_fb.c_err_clas "Failure class number for failure XX" VALUE 0xa1003f78 _REC_VAL_20_u1 255. _CNV_A_R_LINEAR_____0_CM 0. 255. DISPLAY_IDENTIFIER C_ERR_CLAS_ECRASPWM_FB FORMAT "%3.0" /end CHARACTERISTIC
/begin MEASUREMENT fmy_stat_ecraspwm_fb.ctr_abc "anti-bounce counter for diagnosis XX" UBYTE _CNV_A_R_LINEAR_____0_CM 1 100. 0. 255. DISPLAY_IDENTIFIER CTR_ABC_ECRASPWM_FB ECU_ADDRESS 0xd00042dc FORMAT "%3.0" /end MEASUREMENT
/begin MEASUREMENT fmy_stat_ecraspwm_fb.ctr_end_diag "Counter for the end of diagnosis XX generation" UBYTE _CNV_A_R_LINEAR_____0_CM 1 100. 0. 255. DISPLAY_IDENTIFIER CTR_ABC_END_DIAG_ECRASPWM_FB ECU_ADDRESS 0xd00042dd FORMAT "%3.0" /end MEASUREMENT
/begin MEASUREMENT fmy_stat_ecraspwm_fb.err_info_stat.lv_err_mem "Failure is stored in dynamic memory (2nd layer)" UWORD _CNV_S_2_RANGE__0___1_CM 1 100. 0. 1. DISPLAY_IDENTIFIER LV_ERR_MEM_ECRASPWM_FB ECU_ADDRESS 0xd00042de BIT_MASK 0x8 /end MEASUREMENT
/begin MEASUREMENT fmy_stat_ecraspwm_fb.err_info_stat.lv_ready "Readiness flag related to diagnosis XX" UWORD _CNV_S_2_RANGE__0___1_CM 1 100. 0. 1. DISPLAY_IDENTIFIER LV_READY_ECRASPWM_FB ECU_ADDRESS 0xd00042de BIT_MASK 0x10 /end MEASUREMENT
/begin MEASUREMENT fmy_stat_ecraspwm_fb.err_info_stat.lv_end_diag "End of diagnosis XX" UWORD _CNV_S_2_RANGE__0___1_CM 1 100. 0. 1. DISPLAY_IDENTIFIER LV_END_DIAG_ECRASPWM_FB ECU_ADDRESS 0xd00042de BIT_MASK 0x20 /end MEASUREMENT
/begin MEASUREMENT fmy_stat_ecraspwm_fb.err_info_stat.lv_cdn_diag "Diagnosis condition to start symptom detection (set to 1 when condition is fulfilled)" UWORD _CNV_S_2_RANGE__0___1_CM 1 100. 0. 1. DISPLAY_IDENTIFIER LV_CDN_DIAG_ECRASPWM_FB ECU_ADDRESS 0xd00042de BIT_MASK 0x40 /end MEASUREMENT
/begin MEASUREMENT fmy_stat_ecraspwm_fb.err_info_stat.err_sym "For each symptom: status of failure (set to 1 when failure symptom is detected)" UWORD _CNV_S_16_RANGE_ERR__485_CM 1 100. 0. 15. DISPLAY_IDENTIFIER ERR_SYM_ECRASPWM_FB ECU_ADDRESS 0xd00042de BIT_MASK 0x780 /end MEASUREMENT
/begin CHARACTERISTIC fmy_id_ecras_el.c_err_clas "Failure class number for failure XX" VALUE 0xa1003f64 _REC_VAL_20_u1 255. _CNV_A_R_LINEAR_____0_CM 0. 255. DISPLAY_IDENTIFIER C_ERR_CLAS_ECRAS_EL FORMAT "%3.0" /end CHARACTERISTIC
/begin MEASUREMENT fmy_stat_ecras_el.ctr_abc "anti-bounce counter for diagnosis XX" UBYTE _CNV_A_R_LINEAR_____0_CM 1 100. 0. 255. DISPLAY_IDENTIFIER CTR_ABC_ECRAS_EL ECU_ADDRESS 0xd00042d8 FORMAT "%3.0" /end MEASUREMENT
/begin MEASUREMENT fmy_stat_ecras_el.ctr_end_diag "Counter for the end of diagnosis XX generation" UBYTE _CNV_A_R_LINEAR_____0_CM 1 100. 0. 255. DISPLAY_IDENTIFIER CTR_ABC_END_DIAG_ECRAS_EL ECU_ADDRESS 0xd00042d9 FORMAT "%3.0" /end MEASUREMENT
/begin MEASUREMENT fmy_stat_ecras_el.err_info_stat.lv_err_mem "Failure is stored in dynamic memory (2nd layer)" UWORD _CNV_S_2_RANGE__0___1_CM 1 100. 0. 1. DISPLAY_IDENTIFIER LV_ERR_MEM_ECRAS_EL ECU_ADDRESS 0xd00042da BIT_MASK 0x8 /end MEASUREMENT
/begin MEASUREMENT fmy_stat_ecras_el.err_info_stat.lv_ready "Readiness flag related to diagnosis XX" UWORD _CNV_S_2_RANGE__0___1_CM 1 100. 0. 1. DISPLAY_IDENTIFIER LV_READY_ECRAS_EL ECU_ADDRESS 0xd00042da BIT_MASK 0x10 /end MEASUREMENT
/begin MEASUREMENT fmy_stat_ecras_el.err_info_stat.lv_end_diag "End of diagnosis XX" UWORD _CNV_S_2_RANGE__0___1_CM 1 100. 0. 1. DISPLAY_IDENTIFIER LV_END_DIAG_ECRAS_EL ECU_ADDRESS 0xd00042da BIT_MASK 0x20 /end MEASUREMENT
/begin MEASUREMENT fmy_stat_ecras_el.err_info_stat.lv_cdn_diag "Diagnosis condition to start symptom detection (set to 1 when condition is fulfilled)" UWORD _CNV_S_2_RANGE__0___1_CM 1 100. 0. 1. DISPLAY_IDENTIFIER LV_CDN_DIAG_ECRAS_EL ECU_ADDRESS 0xd00042da BIT_MASK 0x40 /end MEASUREMENT
/begin MEASUREMENT fmy_stat_ecras_el.err_info_stat.err_sym "For each symptom: status of failure (set to 1 when failure symptom is detected)" UWORD _CNV_S_16_RANGE_ERR__485_CM 1 100. 0. 15. DISPLAY_IDENTIFIER ERR_SYM_ECRAS_EL ECU_ADDRESS 0xd00042da BIT_MASK 0x780 /end MEASUREMENT
/begin CHARACTERISTIC fmy_id_warm_rst.c_err_clas "Failure class number for failure XX" VALUE 0xa1005120 _REC_VAL_20_u1 255. _CNV_A_R_LINEAR_____0_CM 0. 255. DISPLAY_IDENTIFIER C_ERR_CLAS_WARM_RST FORMAT "%3.0" /end CHARACTERISTIC
/begin MEASUREMENT fmy_stat_warm_rst.ctr_abc "anti-bounce counter for diagnosis XX" UBYTE _CNV_A_R_LINEAR_____0_CM 1 100. 0. 255. DISPLAY_IDENTIFIER CTR_ABC_WARM_RST ECU_ADDRESS 0xd0004664 FORMAT "%3.0" /end MEASUREMENT
/begin MEASUREMENT fmy_stat_warm_rst.ctr_end_diag "Counter for the end of diagnosis XX generation" UBYTE _CNV_A_R_LINEAR_____0_CM 1 100. 0. 255. DISPLAY_IDENTIFIER CTR_ABC_END_DIAG_WARM_RST ECU_ADDRESS 0xd0004665 FORMAT "%3.0" /end MEASUREMENT
/begin MEASUREMENT fmy_stat_warm_rst.err_info_stat.lv_err_mem "Failure is stored in dynamic memory (2nd layer)" UWORD _CNV_S_2_RANGE__0___1_CM 1 100. 0. 1. DISPLAY_IDENTIFIER LV_ERR_MEM_WARM_RST ECU_ADDRESS 0xd0004666 BIT_MASK 0x8 /end MEASUREMENT
/begin MEASUREMENT fmy_stat_warm_rst.err_info_stat.lv_ready "Readiness flag related to diagnosis XX" UWORD _CNV_S_2_RANGE__0___1_CM 1 100. 0. 1. DISPLAY_IDENTIFIER LV_READY_WARM_RST ECU_ADDRESS 0xd0004666 BIT_MASK 0x10 /end MEASUREMENT
/begin MEASUREMENT fmy_stat_warm_rst.err_info_stat.lv_end_diag "End of diagnosis XX" UWORD _CNV_S_2_RANGE__0___1_CM 1 100. 0. 1. DISPLAY_IDENTIFIER LV_END_DIAG_WARM_RST ECU_ADDRESS 0xd0004666 BIT_MASK 0x20 /end MEASUREMENT
/begin MEASUREMENT fmy_stat_warm_rst.err_info_stat.lv_cdn_diag "Diagnosis condition to start symptom detection (set to 1 when condition is fulfilled)" UWORD _CNV_S_2_RANGE__0___1_CM 1 100. 0. 1. DISPLAY_IDENTIFIER LV_CDN_DIAG_WARM_RST ECU_ADDRESS 0xd0004666 BIT_MASK 0x40 /end MEASUREMENT
/begin MEASUREMENT fmy_stat_warm_rst.err_info_stat.err_sym "For each symptom: status of failure (set to 1 when failure symptom is detected)" UWORD _CNV_S_16_RANGE_ERR__485_CM 1 100. 0. 15. DISPLAY_IDENTIFIER ERR_SYM_WARM_RST ECU_ADDRESS 0xd0004666 BIT_MASK 0x780 /end MEASUREMENT
/begin CHARACTERISTIC fmy_id_acr_ad.c_err_clas "Failure class number for failure XX" VALUE 0xa10038e8 _REC_VAL_20_u1 255. _CNV_A_R_LINEAR_____0_CM 0. 255. DISPLAY_IDENTIFIER C_ERR_CLAS_ACR_AD FORMAT "%3.0" /end CHARACTERISTIC
/begin MEASUREMENT fmy_stat_acr_ad.ctr_abc "anti-bounce counter for diagnosis XX" UBYTE _CNV_A_R_LINEAR_____0_CM 1 100. 0. 255. DISPLAY_IDENTIFIER CTR_ABC_ACR_AD ECU_ADDRESS 0xd000418c FORMAT "%3.0" /end MEASUREMENT
/begin MEASUREMENT fmy_stat_acr_ad.ctr_end_diag "Counter for the end of diagnosis XX generation" UBYTE _CNV_A_R_LINEAR_____0_CM 1 100. 0. 255. DISPLAY_IDENTIFIER CTR_ABC_END_DIAG_ACR_AD ECU_ADDRESS 0xd000418d FORMAT "%3.0" /end MEASUREMENT
/begin MEASUREMENT fmy_stat_acr_ad.err_info_stat.lv_err_mem "Failure is stored in dynamic memory (2nd layer)" UWORD _CNV_S_2_RANGE__0___1_CM 1 100. 0. 1. DISPLAY_IDENTIFIER LV_ERR_MEM_ACR_AD ECU_ADDRESS 0xd000418e BIT_MASK 0x8 /end MEASUREMENT
/begin MEASUREMENT fmy_stat_acr_ad.err_info_stat.lv_ready "Readiness flag related to diagnosis XX" UWORD _CNV_S_2_RANGE__0___1_CM 1 100. 0. 1. DISPLAY_IDENTIFIER LV_READY_ACR_AD ECU_ADDRESS 0xd000418e BIT_MASK 0x10 /end MEASUREMENT
/begin MEASUREMENT fmy_stat_acr_ad.err_info_stat.lv_end_diag "End of diagnosis XX" UWORD _CNV_S_2_RANGE__0___1_CM 1 100. 0. 1. DISPLAY_IDENTIFIER LV_END_DIAG_ACR_AD ECU_ADDRESS 0xd000418e BIT_MASK 0x20 /end MEASUREMENT
/begin MEASUREMENT fmy_stat_acr_ad.err_info_stat.lv_cdn_diag "Diagnosis condition to start symptom detection (set to 1 when condition is fulfilled)" UWORD _CNV_S_2_RANGE__0___1_CM 1 100. 0. 1. DISPLAY_IDENTIFIER LV_CDN_DIAG_ACR_AD ECU_ADDRESS 0xd000418e BIT_MASK 0x40 /end MEASUREMENT
/begin MEASUREMENT fmy_stat_acr_ad.err_info_stat.err_sym "For each symptom: status of failure (set to 1 when failure symptom is detected)" UWORD _CNV_S_16_RANGE_ERR__485_CM 1 100. 0. 15. DISPLAY_IDENTIFIER ERR_SYM_ACR_AD ECU_ADDRESS 0xd000418e BIT_MASK 0x780 /end MEASUREMENT
/begin CHARACTERISTIC fmy_id_sens_acr.c_err_clas "Failure class number for failure XX" VALUE 0xa1004acc _REC_VAL_20_u1 255. _CNV_A_R_LINEAR_____0_CM 0. 255. DISPLAY_IDENTIFIER C_ERR_CLAS_SENS_ACR FORMAT "%3.0" /end CHARACTERISTIC
/begin MEASUREMENT fmy_stat_sens_acr.ctr_abc "anti-bounce counter for diagnosis XX" UBYTE _CNV_A_R_LINEAR_____0_CM 1 100. 0. 255. DISPLAY_IDENTIFIER CTR_ABC_SENS_ACR ECU_ADDRESS 0xd0004520 FORMAT "%3.0" /end MEASUREMENT
/begin MEASUREMENT fmy_stat_sens_acr.ctr_end_diag "Counter for the end of diagnosis XX generation" UBYTE _CNV_A_R_LINEAR_____0_CM 1 100. 0. 255. DISPLAY_IDENTIFIER CTR_ABC_END_DIAG_SENS_ACR ECU_ADDRESS 0xd0004521 FORMAT "%3.0" /end MEASUREMENT
/begin MEASUREMENT fmy_stat_sens_acr.err_info_stat.lv_err_mem "Failure is stored in dynamic memory (2nd layer)" UWORD _CNV_S_2_RANGE__0___1_CM 1 100. 0. 1. DISPLAY_IDENTIFIER LV_ERR_MEM_SENS_ACR ECU_ADDRESS 0xd0004522 BIT_MASK 0x8 /end MEASUREMENT
/begin MEASUREMENT fmy_stat_sens_acr.err_info_stat.lv_ready "Readiness flag related to diagnosis XX" UWORD _CNV_S_2_RANGE__0___1_CM 1 100. 0. 1. DISPLAY_IDENTIFIER LV_READY_SENS_ACR ECU_ADDRESS 0xd0004522 BIT_MASK 0x10 /end MEASUREMENT
/begin MEASUREMENT fmy_stat_sens_acr.err_info_stat.lv_end_diag "End of diagnosis XX" UWORD _CNV_S_2_RANGE__0___1_CM 1 100. 0. 1. DISPLAY_IDENTIFIER LV_END_DIAG_SENS_ACR ECU_ADDRESS 0xd0004522 BIT_MASK 0x20 /end MEASUREMENT
/begin MEASUREMENT fmy_stat_sens_acr.err_info_stat.lv_cdn_diag "Diagnosis condition to start symptom detection (set to 1 when condition is fulfilled)" UWORD _CNV_S_2_RANGE__0___1_CM 1 100. 0. 1. DISPLAY_IDENTIFIER LV_CDN_DIAG_SENS_ACR ECU_ADDRESS 0xd0004522 BIT_MASK 0x40 /end MEASUREMENT
/begin MEASUREMENT fmy_stat_sens_acr.err_info_stat.err_sym "For each symptom: status of failure (set to 1 when failure symptom is detected)" UWORD _CNV_S_16_RANGE_ERR__485_CM 1 100. 0. 15. DISPLAY_IDENTIFIER ERR_SYM_SENS_ACR ECU_ADDRESS 0xd0004522 BIT_MASK 0x780 /end MEASUREMENT
/begin CHARACTERISTIC fmy_id_acr_ctl.c_err_clas "Failure class number for failure XX" VALUE 0xa10038fc _REC_VAL_20_u1 255. _CNV_A_R_LINEAR_____0_CM 0. 255. DISPLAY_IDENTIFIER C_ERR_CLAS_ACR_CTL FORMAT "%3.0" /end CHARACTERISTIC
/begin MEASUREMENT fmy_stat_acr_ctl.ctr_abc "anti-bounce counter for diagnosis XX" UBYTE _CNV_A_R_LINEAR_____0_CM 1 100. 0. 255. DISPLAY_IDENTIFIER CTR_ABC_ACR_CTL ECU_ADDRESS 0xd0004190 FORMAT "%3.0" /end MEASUREMENT
/begin MEASUREMENT fmy_stat_acr_ctl.ctr_end_diag "Counter for the end of diagnosis XX generation" UBYTE _CNV_A_R_LINEAR_____0_CM 1 100. 0. 255. DISPLAY_IDENTIFIER CTR_ABC_END_DIAG_ACR_CTL ECU_ADDRESS 0xd0004191 FORMAT "%3.0" /end MEASUREMENT
/begin MEASUREMENT fmy_stat_acr_ctl.err_info_stat.lv_err_mem "Failure is stored in dynamic memory (2nd layer)" UWORD _CNV_S_2_RANGE__0___1_CM 1 100. 0. 1. DISPLAY_IDENTIFIER LV_ERR_MEM_ACR_CTL ECU_ADDRESS 0xd0004192 BIT_MASK 0x8 /end MEASUREMENT
/begin MEASUREMENT fmy_stat_acr_ctl.err_info_stat.lv_ready "Readiness flag related to diagnosis XX" UWORD _CNV_S_2_RANGE__0___1_CM 1 100. 0. 1. DISPLAY_IDENTIFIER LV_READY_ACR_CTL ECU_ADDRESS 0xd0004192 BIT_MASK 0x10 /end MEASUREMENT
/begin MEASUREMENT fmy_stat_acr_ctl.err_info_stat.lv_end_diag "End of diagnosis XX" UWORD _CNV_S_2_RANGE__0___1_CM 1 100. 0. 1. DISPLAY_IDENTIFIER LV_END_DIAG_ACR_CTL ECU_ADDRESS 0xd0004192 BIT_MASK 0x20 /end MEASUREMENT
/begin MEASUREMENT fmy_stat_acr_ctl.err_info_stat.lv_cdn_diag "Diagnosis condition to start symptom detection (set to 1 when condition is fulfilled)" UWORD _CNV_S_2_RANGE__0___1_CM 1 100. 0. 1. DISPLAY_IDENTIFIER LV_CDN_DIAG_ACR_CTL ECU_ADDRESS 0xd0004192 BIT_MASK 0x40 /end MEASUREMENT
/begin MEASUREMENT fmy_stat_acr_ctl.err_info_stat.err_sym "For each symptom: status of failure (set to 1 when failure symptom is detected)" UWORD _CNV_S_16_RANGE_ERR__485_CM 1 100. 0. 15. DISPLAY_IDENTIFIER ERR_SYM_ACR_CTL ECU_ADDRESS 0xd0004192 BIT_MASK 0x780 /end MEASUREMENT
/begin CHARACTERISTIC fmy_id_acr_dr.c_err_clas "Failure class number for failure XX" VALUE 0xa1003910 _REC_VAL_20_u1 255. _CNV_A_R_LINEAR_____0_CM 0. 255. DISPLAY_IDENTIFIER C_ERR_CLAS_ACR_DR FORMAT "%3.0" /end CHARACTERISTIC
/begin MEASUREMENT fmy_stat_acr_dr.ctr_abc "anti-bounce counter for diagnosis XX" UBYTE _CNV_A_R_LINEAR_____0_CM 1 100. 0. 255. DISPLAY_IDENTIFIER CTR_ABC_ACR_DR ECU_ADDRESS 0xd0004194 FORMAT "%3.0" /end MEASUREMENT
/begin MEASUREMENT fmy_stat_acr_dr.ctr_end_diag "Counter for the end of diagnosis XX generation" UBYTE _CNV_A_R_LINEAR_____0_CM 1 100. 0. 255. DISPLAY_IDENTIFIER CTR_ABC_END_DIAG_ACR_DR ECU_ADDRESS 0xd0004195 FORMAT "%3.0" /end MEASUREMENT
/begin MEASUREMENT fmy_stat_acr_dr.err_info_stat.lv_err_mem "Failure is stored in dynamic memory (2nd layer)" UWORD _CNV_S_2_RANGE__0___1_CM 1 100. 0. 1. DISPLAY_IDENTIFIER LV_ERR_MEM_ACR_DR ECU_ADDRESS 0xd0004196 BIT_MASK 0x8 /end MEASUREMENT
/begin MEASUREMENT fmy_stat_acr_dr.err_info_stat.lv_ready "Readiness flag related to diagnosis XX" UWORD _CNV_S_2_RANGE__0___1_CM 1 100. 0. 1. DISPLAY_IDENTIFIER LV_READY_ACR_DR ECU_ADDRESS 0xd0004196 BIT_MASK 0x10 /end MEASUREMENT
/begin MEASUREMENT fmy_stat_acr_dr.err_info_stat.lv_end_diag "End of diagnosis XX" UWORD _CNV_S_2_RANGE__0___1_CM 1 100. 0. 1. DISPLAY_IDENTIFIER LV_END_DIAG_ACR_DR ECU_ADDRESS 0xd0004196 BIT_MASK 0x20 /end MEASUREMENT
/begin MEASUREMENT fmy_stat_acr_dr.err_info_stat.lv_cdn_diag "Diagnosis condition to start symptom detection (set to 1 when condition is fulfilled)" UWORD _CNV_S_2_RANGE__0___1_CM 1 100. 0. 1. DISPLAY_IDENTIFIER LV_CDN_DIAG_ACR_DR ECU_ADDRESS 0xd0004196 BIT_MASK 0x40 /end MEASUREMENT
/begin MEASUREMENT fmy_stat_acr_dr.err_info_stat.err_sym "For each symptom: status of failure (set to 1 when failure symptom is detected)" UWORD _CNV_S_16_RANGE_ERR__485_CM 1 100. 0. 15. DISPLAY_IDENTIFIER ERR_SYM_ACR_DR ECU_ADDRESS 0xd0004196 BIT_MASK 0x780 /end MEASUREMENT
/begin CHARACTERISTIC fmy_id_var_cod.c_err_clas "Failure class number for failure XX" VALUE 0xa1005008 _REC_VAL_20_u1 255. _CNV_A_R_LINEAR_____0_CM 0. 255. DISPLAY_IDENTIFIER C_ERR_CLAS_VAR_COD FORMAT "%3.0" /end CHARACTERISTIC
/begin MEASUREMENT fmy_stat_var_cod.ctr_abc "anti-bounce counter for diagnosis XX" UBYTE _CNV_A_R_LINEAR_____0_CM 1 100. 0. 255. DISPLAY_IDENTIFIER CTR_ABC_VAR_COD ECU_ADDRESS 0xd000462c FORMAT "%3.0" /end MEASUREMENT
/begin MEASUREMENT fmy_stat_var_cod.ctr_end_diag "Counter for the end of diagnosis XX generation" UBYTE _CNV_A_R_LINEAR_____0_CM 1 100. 0. 255. DISPLAY_IDENTIFIER CTR_ABC_END_DIAG_VAR_COD ECU_ADDRESS 0xd000462d FORMAT "%3.0" /end MEASUREMENT
/begin MEASUREMENT fmy_stat_var_cod.err_info_stat.lv_err_mem "Failure is stored in dynamic memory (2nd layer)" UWORD _CNV_S_2_RANGE__0___1_CM 1 100. 0. 1. DISPLAY_IDENTIFIER LV_ERR_MEM_VAR_COD ECU_ADDRESS 0xd000462e BIT_MASK 0x8 /end MEASUREMENT
/begin MEASUREMENT fmy_stat_var_cod.err_info_stat.lv_ready "Readiness flag related to diagnosis XX" UWORD _CNV_S_2_RANGE__0___1_CM 1 100. 0. 1. DISPLAY_IDENTIFIER LV_READY_VAR_COD ECU_ADDRESS 0xd000462e BIT_MASK 0x10 /end MEASUREMENT
/begin MEASUREMENT fmy_stat_var_cod.err_info_stat.lv_end_diag "End of diagnosis XX" UWORD _CNV_S_2_RANGE__0___1_CM 1 100. 0. 1. DISPLAY_IDENTIFIER LV_END_DIAG_VAR_COD ECU_ADDRESS 0xd000462e BIT_MASK 0x20 /end MEASUREMENT
/begin MEASUREMENT fmy_stat_var_cod.err_info_stat.lv_cdn_diag "Diagnosis condition to start symptom detection (set to 1 when condition is fulfilled)" UWORD _CNV_S_2_RANGE__0___1_CM 1 100. 0. 1. DISPLAY_IDENTIFIER LV_CDN_DIAG_VAR_COD ECU_ADDRESS 0xd000462e BIT_MASK 0x40 /end MEASUREMENT
/begin MEASUREMENT fmy_stat_var_cod.err_info_stat.err_sym "For each symptom: status of failure (set to 1 when failure symptom is detected)" UWORD _CNV_S_16_RANGE_ERR__485_CM 1 100. 0. 15. DISPLAY_IDENTIFIER ERR_SYM_VAR_COD ECU_ADDRESS 0xd000462e BIT_MASK 0x780 /end MEASUREMENT
/begin CHARACTERISTIC fmy_id_veh_pow_var.c_err_clas "Failure class number for failure XX" VALUE 0xa1005044 _REC_VAL_20_u1 255. _CNV_A_R_LINEAR_____0_CM 0. 255. DISPLAY_IDENTIFIER C_ERR_CLAS_VEH_POW_VAR FORMAT "%3.0" /end CHARACTERISTIC
/begin MEASUREMENT fmy_stat_veh_pow_var.ctr_abc "anti-bounce counter for diagnosis XX" UBYTE _CNV_A_R_LINEAR_____0_CM 1 100. 0. 255. DISPLAY_IDENTIFIER CTR_ABC_VEH_POW_VAR ECU_ADDRESS 0xd0004638 FORMAT "%3.0" /end MEASUREMENT
/begin MEASUREMENT fmy_stat_veh_pow_var.ctr_end_diag "Counter for the end of diagnosis XX generation" UBYTE _CNV_A_R_LINEAR_____0_CM 1 100. 0. 255. DISPLAY_IDENTIFIER CTR_ABC_END_DIAG_VEH_POW_VAR ECU_ADDRESS 0xd0004639 FORMAT "%3.0" /end MEASUREMENT
/begin MEASUREMENT fmy_stat_veh_pow_var.err_info_stat.lv_err_mem "Failure is stored in dynamic memory (2nd layer)" UWORD _CNV_S_2_RANGE__0___1_CM 1 100. 0. 1. DISPLAY_IDENTIFIER LV_ERR_MEM_VEH_POW_VAR ECU_ADDRESS 0xd000463a BIT_MASK 0x8 /end MEASUREMENT
/begin MEASUREMENT fmy_stat_veh_pow_var.err_info_stat.lv_ready "Readiness flag related to diagnosis XX" UWORD _CNV_S_2_RANGE__0___1_CM 1 100. 0. 1. DISPLAY_IDENTIFIER LV_READY_VEH_POW_VAR ECU_ADDRESS 0xd000463a BIT_MASK 0x10 /end MEASUREMENT
/begin MEASUREMENT fmy_stat_veh_pow_var.err_info_stat.lv_end_diag "End of diagnosis XX" UWORD _CNV_S_2_RANGE__0___1_CM 1 100. 0. 1. DISPLAY_IDENTIFIER LV_END_DIAG_VEH_POW_VAR ECU_ADDRESS 0xd000463a BIT_MASK 0x20 /end MEASUREMENT
/begin MEASUREMENT fmy_stat_veh_pow_var.err_info_stat.lv_cdn_diag "Diagnosis condition to start symptom detection (set to 1 when condition is fulfilled)" UWORD _CNV_S_2_RANGE__0___1_CM 1 100. 0. 1. DISPLAY_IDENTIFIER LV_CDN_DIAG_VEH_POW_VAR ECU_ADDRESS 0xd000463a BIT_MASK 0x40 /end MEASUREMENT
/begin MEASUREMENT fmy_stat_veh_pow_var.err_info_stat.err_sym "For each symptom: status of failure (set to 1 when failure symptom is detected)" UWORD _CNV_S_16_RANGE_ERR__485_CM 1 100. 0. 15. DISPLAY_IDENTIFIER ERR_SYM_VEH_POW_VAR ECU_ADDRESS 0xd000463a BIT_MASK 0x780 /end MEASUREMENT
/begin CHARACTERISTIC fmy_id_fup_mfp_plaus.c_err_clas "Failure class number for failure XX" VALUE 0xa1004130 _REC_VAL_20_u1 255. _CNV_A_R_LINEAR_____0_CM 0. 255. DISPLAY_IDENTIFIER C_ERR_CLAS_FUP_MFP_PLAUS FORMAT "%3.0" /end CHARACTERISTIC
/begin MEASUREMENT fmy_stat_fup_mfp_plaus.ctr_abc "anti-bounce counter for diagnosis XX" UBYTE _CNV_A_R_LINEAR_____0_CM 1 100. 0. 255. DISPLAY_IDENTIFIER CTR_ABC_FUP_MFP_PLAUS ECU_ADDRESS 0xd0004334 FORMAT "%3.0" /end MEASUREMENT
/begin MEASUREMENT fmy_stat_fup_mfp_plaus.ctr_end_diag "Counter for the end of diagnosis XX generation" UBYTE _CNV_A_R_LINEAR_____0_CM 1 100. 0. 255. DISPLAY_IDENTIFIER CTR_ABC_END_DIAG_FUP_MFP_PLAUS ECU_ADDRESS 0xd0004335 FORMAT "%3.0" /end MEASUREMENT
/begin MEASUREMENT fmy_stat_fup_mfp_plaus.err_info_stat.lv_err_mem "Failure is stored in dynamic memory (2nd layer)" UWORD _CNV_S_2_RANGE__0___1_CM 1 100. 0. 1. DISPLAY_IDENTIFIER LV_ERR_MEM_FUP_MFP_PLAUS ECU_ADDRESS 0xd0004336 BIT_MASK 0x8 /end MEASUREMENT
/begin MEASUREMENT fmy_stat_fup_mfp_plaus.err_info_stat.lv_ready "Readiness flag related to diagnosis XX" UWORD _CNV_S_2_RANGE__0___1_CM 1 100. 0. 1. DISPLAY_IDENTIFIER LV_READY_FUP_MFP_PLAUS ECU_ADDRESS 0xd0004336 BIT_MASK 0x10 /end MEASUREMENT
/begin MEASUREMENT fmy_stat_fup_mfp_plaus.err_info_stat.lv_end_diag "End of diagnosis XX" UWORD _CNV_S_2_RANGE__0___1_CM 1 100. 0. 1. DISPLAY_IDENTIFIER LV_END_DIAG_FUP_MFP_PLAUS ECU_ADDRESS 0xd0004336 BIT_MASK 0x20 /end MEASUREMENT
/begin MEASUREMENT fmy_stat_fup_mfp_plaus.err_info_stat.lv_cdn_diag "Diagnosis condition to start symptom detection (set to 1 when condition is fulfilled)" UWORD _CNV_S_2_RANGE__0___1_CM 1 100. 0. 1. DISPLAY_IDENTIFIER LV_CDN_DIAG_FUP_MFP_PLAUS ECU_ADDRESS 0xd0004336 BIT_MASK 0x40 /end MEASUREMENT
/begin MEASUREMENT fmy_stat_fup_mfp_plaus.err_info_stat.err_sym "For each symptom: status of failure (set to 1 when failure symptom is detected)" UWORD _CNV_S_16_RANGE_ERR__485_CM 1 100. 0. 15. DISPLAY_IDENTIFIER ERR_SYM_FUP_MFP_PLAUS ECU_ADDRESS 0xd0004336 BIT_MASK 0x780 /end MEASUREMENT
/begin CHARACTERISTIC fmy_id_h_prs_sys.c_err_clas "Failure class number for failure XX" VALUE 0xa1004180 _REC_VAL_20_u1 255. _CNV_A_R_LINEAR_____0_CM 0. 255. DISPLAY_IDENTIFIER C_ERR_CLAS_H_PRS_SYS FORMAT "%3.0" /end CHARACTERISTIC
/begin MEASUREMENT fmy_stat_h_prs_sys.ctr_abc "anti-bounce counter for diagnosis XX" UBYTE _CNV_A_R_LINEAR_____0_CM 1 100. 0. 255. DISPLAY_IDENTIFIER CTR_ABC_H_PRS_SYS ECU_ADDRESS 0xd0004344 FORMAT "%3.0" /end MEASUREMENT
/begin MEASUREMENT fmy_stat_h_prs_sys.ctr_end_diag "Counter for the end of diagnosis XX generation" UBYTE _CNV_A_R_LINEAR_____0_CM 1 100. 0. 255. DISPLAY_IDENTIFIER CTR_ABC_END_DIAG_H_PRS_SYS ECU_ADDRESS 0xd0004345 FORMAT "%3.0" /end MEASUREMENT
/begin MEASUREMENT fmy_stat_h_prs_sys.err_info_stat.lv_err_mem "Failure is stored in dynamic memory (2nd layer)" UWORD _CNV_S_2_RANGE__0___1_CM 1 100. 0. 1. DISPLAY_IDENTIFIER LV_ERR_MEM_H_PRS_SYS ECU_ADDRESS 0xd0004346 BIT_MASK 0x8 /end MEASUREMENT
/begin MEASUREMENT fmy_stat_h_prs_sys.err_info_stat.lv_ready "Readiness flag related to diagnosis XX" UWORD _CNV_S_2_RANGE__0___1_CM 1 100. 0. 1. DISPLAY_IDENTIFIER LV_READY_H_PRS_SYS ECU_ADDRESS 0xd0004346 BIT_MASK 0x10 /end MEASUREMENT
/begin MEASUREMENT fmy_stat_h_prs_sys.err_info_stat.lv_end_diag "End of diagnosis XX" UWORD _CNV_S_2_RANGE__0___1_CM 1 100. 0. 1. DISPLAY_IDENTIFIER LV_END_DIAG_H_PRS_SYS ECU_ADDRESS 0xd0004346 BIT_MASK 0x20 /end MEASUREMENT
/begin MEASUREMENT fmy_stat_h_prs_sys.err_info_stat.lv_cdn_diag "Diagnosis condition to start symptom detection (set to 1 when condition is fulfilled)" UWORD _CNV_S_2_RANGE__0___1_CM 1 100. 0. 1. DISPLAY_IDENTIFIER LV_CDN_DIAG_H_PRS_SYS ECU_ADDRESS 0xd0004346 BIT_MASK 0x40 /end MEASUREMENT
/begin MEASUREMENT fmy_stat_h_prs_sys.err_info_stat.err_sym "For each symptom: status of failure (set to 1 when failure symptom is detected)" UWORD _CNV_S_16_RANGE_ERR__485_CM 1 100. 0. 15. DISPLAY_IDENTIFIER ERR_SYM_H_PRS_SYS ECU_ADDRESS 0xd0004346 BIT_MASK 0x780 /end MEASUREMENT
/begin CHARACTERISTIC fmy_id_vcv_plaus.c_err_clas "Failure class number for failure XX" VALUE 0xa1005030 _REC_VAL_20_u1 255. _CNV_A_R_LINEAR_____0_CM 0. 255. DISPLAY_IDENTIFIER C_ERR_CLAS_VCV_PLAUS FORMAT "%3.0" /end CHARACTERISTIC
/begin MEASUREMENT fmy_stat_vcv_plaus.ctr_abc "anti-bounce counter for diagnosis XX" UBYTE _CNV_A_R_LINEAR_____0_CM 1 100. 0. 255. DISPLAY_IDENTIFIER CTR_ABC_VCV_PLAUS ECU_ADDRESS 0xd0004634 FORMAT "%3.0" /end MEASUREMENT
/begin MEASUREMENT fmy_stat_vcv_plaus.ctr_end_diag "Counter for the end of diagnosis XX generation" UBYTE _CNV_A_R_LINEAR_____0_CM 1 100. 0. 255. DISPLAY_IDENTIFIER CTR_ABC_END_DIAG_VCV_PLAUS ECU_ADDRESS 0xd0004635 FORMAT "%3.0" /end MEASUREMENT
/begin MEASUREMENT fmy_stat_vcv_plaus.err_info_stat.lv_err_mem "Failure is stored in dynamic memory (2nd layer)" UWORD _CNV_S_2_RANGE__0___1_CM 1 100. 0. 1. DISPLAY_IDENTIFIER LV_ERR_MEM_VCV_PLAUS ECU_ADDRESS 0xd0004636 BIT_MASK 0x8 /end MEASUREMENT
/begin MEASUREMENT fmy_stat_vcv_plaus.err_info_stat.lv_ready "Readiness flag related to diagnosis XX" UWORD _CNV_S_2_RANGE__0___1_CM 1 100. 0. 1. DISPLAY_IDENTIFIER LV_READY_VCV_PLAUS ECU_ADDRESS 0xd0004636 BIT_MASK 0x10 /end MEASUREMENT
/begin MEASUREMENT fmy_stat_vcv_plaus.err_info_stat.lv_end_diag "End of diagnosis XX" UWORD _CNV_S_2_RANGE__0___1_CM 1 100. 0. 1. DISPLAY_IDENTIFIER LV_END_DIAG_VCV_PLAUS ECU_ADDRESS 0xd0004636 BIT_MASK 0x20 /end MEASUREMENT
/begin MEASUREMENT fmy_stat_vcv_plaus.err_info_stat.lv_cdn_diag "Diagnosis condition to start symptom detection (set to 1 when condition is fulfilled)" UWORD _CNV_S_2_RANGE__0___1_CM 1 100. 0. 1. DISPLAY_IDENTIFIER LV_CDN_DIAG_VCV_PLAUS ECU_ADDRESS 0xd0004636 BIT_MASK 0x40 /end MEASUREMENT
/begin MEASUREMENT fmy_stat_vcv_plaus.err_info_stat.err_sym "For each symptom: status of failure (set to 1 when failure symptom is detected)" UWORD _CNV_S_16_RANGE_ERR__485_CM 1 100. 0. 15. DISPLAY_IDENTIFIER ERR_SYM_VCV_PLAUS ECU_ADDRESS 0xd0004636 BIT_MASK 0x780 /end MEASUREMENT
/begin CHARACTERISTIC fmy_id_fup.c_err_clas "Failure class number for failure XX" VALUE 0xa1004108 _REC_VAL_20_u1 255. _CNV_A_R_LINEAR_____0_CM 0. 255. DISPLAY_IDENTIFIER C_ERR_CLAS_FUP FORMAT "%3.0" /end CHARACTERISTIC
/begin MEASUREMENT fmy_stat_fup.ctr_abc "anti-bounce counter for diagnosis XX" UBYTE _CNV_A_R_LINEAR_____0_CM 1 100. 0. 255. DISPLAY_IDENTIFIER CTR_ABC_FUP ECU_ADDRESS 0xd000432c FORMAT "%3.0" /end MEASUREMENT
/begin MEASUREMENT fmy_stat_fup.ctr_end_diag "Counter for the end of diagnosis XX generation" UBYTE _CNV_A_R_LINEAR_____0_CM 1 100. 0. 255. DISPLAY_IDENTIFIER CTR_ABC_END_DIAG_FUP ECU_ADDRESS 0xd000432d FORMAT "%3.0" /end MEASUREMENT
/begin MEASUREMENT fmy_stat_fup.err_info_stat.lv_err_mem "Failure is stored in dynamic memory (2nd layer)" UWORD _CNV_S_2_RANGE__0___1_CM 1 100. 0. 1. DISPLAY_IDENTIFIER LV_ERR_MEM_FUP ECU_ADDRESS 0xd000432e BIT_MASK 0x8 /end MEASUREMENT
/begin MEASUREMENT fmy_stat_fup.err_info_stat.lv_ready "Readiness flag related to diagnosis XX" UWORD _CNV_S_2_RANGE__0___1_CM 1 100. 0. 1. DISPLAY_IDENTIFIER LV_READY_FUP ECU_ADDRESS 0xd000432e BIT_MASK 0x10 /end MEASUREMENT
/begin MEASUREMENT fmy_stat_fup.err_info_stat.lv_end_diag "End of diagnosis XX" UWORD _CNV_S_2_RANGE__0___1_CM 1 100. 0. 1. DISPLAY_IDENTIFIER LV_END_DIAG_FUP ECU_ADDRESS 0xd000432e BIT_MASK 0x20 /end MEASUREMENT
/begin MEASUREMENT fmy_stat_fup.err_info_stat.lv_cdn_diag "Diagnosis condition to start symptom detection (set to 1 when condition is fulfilled)" UWORD _CNV_S_2_RANGE__0___1_CM 1 100. 0. 1. DISPLAY_IDENTIFIER LV_CDN_DIAG_FUP ECU_ADDRESS 0xd000432e BIT_MASK 0x40 /end MEASUREMENT
/begin MEASUREMENT fmy_stat_fup.err_info_stat.err_sym "For each symptom: status of failure (set to 1 when failure symptom is detected)" UWORD _CNV_S_16_RANGE_ERR__485_CM 1 100. 0. 15. DISPLAY_IDENTIFIER ERR_SYM_FUP ECU_ADDRESS 0xd000432e BIT_MASK 0x780 /end MEASUREMENT
/begin CHARACTERISTIC fmy_id_vcv.c_err_clas "Failure class number for failure XX" VALUE 0xa100501c _REC_VAL_20_u1 255. _CNV_A_R_LINEAR_____0_CM 0. 255. DISPLAY_IDENTIFIER C_ERR_CLAS_VCV FORMAT "%3.0" /end CHARACTERISTIC
/begin MEASUREMENT fmy_stat_vcv.ctr_abc "anti-bounce counter for diagnosis XX" UBYTE _CNV_A_R_LINEAR_____0_CM 1 100. 0. 255. DISPLAY_IDENTIFIER CTR_ABC_VCV ECU_ADDRESS 0xd0004630 FORMAT "%3.0" /end MEASUREMENT
/begin MEASUREMENT fmy_stat_vcv.ctr_end_diag "Counter for the end of diagnosis XX generation" UBYTE _CNV_A_R_LINEAR_____0_CM 1 100. 0. 255. DISPLAY_IDENTIFIER CTR_ABC_END_DIAG_VCV ECU_ADDRESS 0xd0004631 FORMAT "%3.0" /end MEASUREMENT
/begin MEASUREMENT fmy_stat_vcv.err_info_stat.lv_err_mem "Failure is stored in dynamic memory (2nd layer)" UWORD _CNV_S_2_RANGE__0___1_CM 1 100. 0. 1. DISPLAY_IDENTIFIER LV_ERR_MEM_VCV ECU_ADDRESS 0xd0004632 BIT_MASK 0x8 /end MEASUREMENT
/begin MEASUREMENT fmy_stat_vcv.err_info_stat.lv_ready "Readiness flag related to diagnosis XX" UWORD _CNV_S_2_RANGE__0___1_CM 1 100. 0. 1. DISPLAY_IDENTIFIER LV_READY_VCV ECU_ADDRESS 0xd0004632 BIT_MASK 0x10 /end MEASUREMENT
/begin MEASUREMENT fmy_stat_vcv.err_info_stat.lv_end_diag "End of diagnosis XX" UWORD _CNV_S_2_RANGE__0___1_CM 1 100. 0. 1. DISPLAY_IDENTIFIER LV_END_DIAG_VCV ECU_ADDRESS 0xd0004632 BIT_MASK 0x20 /end MEASUREMENT
/begin MEASUREMENT fmy_stat_vcv.err_info_stat.lv_cdn_diag "Diagnosis condition to start symptom detection (set to 1 when condition is fulfilled)" UWORD _CNV_S_2_RANGE__0___1_CM 1 100. 0. 1. DISPLAY_IDENTIFIER LV_CDN_DIAG_VCV ECU_ADDRESS 0xd0004632 BIT_MASK 0x40 /end MEASUREMENT
/begin MEASUREMENT fmy_stat_vcv.err_info_stat.err_sym "For each symptom: status of failure (set to 1 when failure symptom is detected)" UWORD _CNV_S_16_RANGE_ERR__485_CM 1 100. 0. 15. DISPLAY_IDENTIFIER ERR_SYM_VCV ECU_ADDRESS 0xd0004632 BIT_MASK 0x780 /end MEASUREMENT
/begin CHARACTERISTIC fmy_id_fup_efp.c_err_clas "Failure class number for failure XX" VALUE 0xa100411c _REC_VAL_20_u1 255. _CNV_A_R_LINEAR_____0_CM 0. 255. DISPLAY_IDENTIFIER C_ERR_CLAS_FUP_EFP FORMAT "%3.0" /end CHARACTERISTIC
/begin MEASUREMENT fmy_stat_fup_efp.ctr_abc "anti-bounce counter for diagnosis XX" UBYTE _CNV_A_R_LINEAR_____0_CM 1 100. 0. 255. DISPLAY_IDENTIFIER CTR_ABC_FUP_EFP ECU_ADDRESS 0xd0004330 FORMAT "%3.0" /end MEASUREMENT
/begin MEASUREMENT fmy_stat_fup_efp.ctr_end_diag "Counter for the end of diagnosis XX generation" UBYTE _CNV_A_R_LINEAR_____0_CM 1 100. 0. 255. DISPLAY_IDENTIFIER CTR_ABC_END_DIAG_FUP_EFP ECU_ADDRESS 0xd0004331 FORMAT "%3.0" /end MEASUREMENT
/begin MEASUREMENT fmy_stat_fup_efp.err_info_stat.lv_err_mem "Failure is stored in dynamic memory (2nd layer)" UWORD _CNV_S_2_RANGE__0___1_CM 1 100. 0. 1. DISPLAY_IDENTIFIER LV_ERR_MEM_FUP_EFP ECU_ADDRESS 0xd0004332 BIT_MASK 0x8 /end MEASUREMENT
/begin MEASUREMENT fmy_stat_fup_efp.err_info_stat.lv_ready "Readiness flag related to diagnosis XX" UWORD _CNV_S_2_RANGE__0___1_CM 1 100. 0. 1. DISPLAY_IDENTIFIER LV_READY_FUP_EFP ECU_ADDRESS 0xd0004332 BIT_MASK 0x10 /end MEASUREMENT
/begin MEASUREMENT fmy_stat_fup_efp.err_info_stat.lv_end_diag "End of diagnosis XX" UWORD _CNV_S_2_RANGE__0___1_CM 1 100. 0. 1. DISPLAY_IDENTIFIER LV_END_DIAG_FUP_EFP ECU_ADDRESS 0xd0004332 BIT_MASK 0x20 /end MEASUREMENT
/begin MEASUREMENT fmy_stat_fup_efp.err_info_stat.lv_cdn_diag "Diagnosis condition to start symptom detection (set to 1 when condition is fulfilled)" UWORD _CNV_S_2_RANGE__0___1_CM 1 100. 0. 1. DISPLAY_IDENTIFIER LV_CDN_DIAG_FUP_EFP ECU_ADDRESS 0xd0004332 BIT_MASK 0x40 /end MEASUREMENT
/begin MEASUREMENT fmy_stat_fup_efp.err_info_stat.err_sym "For each symptom: status of failure (set to 1 when failure symptom is detected)" UWORD _CNV_S_16_RANGE_ERR__485_CM 1 100. 0. 15. DISPLAY_IDENTIFIER ERR_SYM_FUP_EFP ECU_ADDRESS 0xd0004332 BIT_MASK 0x780 /end MEASUREMENT
/begin CHARACTERISTIC fmy_id_efppwm_plaus.c_err_clas "Failure class number for failure XX" VALUE 0xa1004018 _REC_VAL_20_u1 255. _CNV_A_R_LINEAR_____0_CM 0. 255. DISPLAY_IDENTIFIER C_ERR_CLAS_EFPPWM_PLAUS FORMAT "%3.0" /end CHARACTERISTIC
/begin MEASUREMENT fmy_stat_efppwm_plaus.ctr_abc "anti-bounce counter for diagnosis XX" UBYTE _CNV_A_R_LINEAR_____0_CM 1 100. 0. 255. DISPLAY_IDENTIFIER CTR_ABC_EFPPWM_PLAUS ECU_ADDRESS 0xd00042fc FORMAT "%3.0" /end MEASUREMENT
/begin MEASUREMENT fmy_stat_efppwm_plaus.ctr_end_diag "Counter for the end of diagnosis XX generation" UBYTE _CNV_A_R_LINEAR_____0_CM 1 100. 0. 255. DISPLAY_IDENTIFIER CTR_ABC_END_DIAG_EFPPWM_PLAUS ECU_ADDRESS 0xd00042fd FORMAT "%3.0" /end MEASUREMENT
/begin MEASUREMENT fmy_stat_efppwm_plaus.err_info_stat.lv_err_mem "Failure is stored in dynamic memory (2nd layer)" UWORD _CNV_S_2_RANGE__0___1_CM 1 100. 0. 1. DISPLAY_IDENTIFIER LV_ERR_MEM_EFPPWM_PLAUS ECU_ADDRESS 0xd00042fe BIT_MASK 0x8 /end MEASUREMENT
/begin MEASUREMENT fmy_stat_efppwm_plaus.err_info_stat.lv_ready "Readiness flag related to diagnosis XX" UWORD _CNV_S_2_RANGE__0___1_CM 1 100. 0. 1. DISPLAY_IDENTIFIER LV_READY_EFPPWM_PLAUS ECU_ADDRESS 0xd00042fe BIT_MASK 0x10 /end MEASUREMENT
/begin MEASUREMENT fmy_stat_efppwm_plaus.err_info_stat.lv_end_diag "End of diagnosis XX" UWORD _CNV_S_2_RANGE__0___1_CM 1 100. 0. 1. DISPLAY_IDENTIFIER LV_END_DIAG_EFPPWM_PLAUS ECU_ADDRESS 0xd00042fe BIT_MASK 0x20 /end MEASUREMENT
/begin MEASUREMENT fmy_stat_efppwm_plaus.err_info_stat.lv_cdn_diag "Diagnosis condition to start symptom detection (set to 1 when condition is fulfilled)" UWORD _CNV_S_2_RANGE__0___1_CM 1 100. 0. 1. DISPLAY_IDENTIFIER LV_CDN_DIAG_EFPPWM_PLAUS ECU_ADDRESS 0xd00042fe BIT_MASK 0x40 /end MEASUREMENT
/begin MEASUREMENT fmy_stat_efppwm_plaus.err_info_stat.err_sym "For each symptom: status of failure (set to 1 when failure symptom is detected)" UWORD _CNV_S_16_RANGE_ERR__485_CM 1 100. 0. 15. DISPLAY_IDENTIFIER ERR_SYM_EFPPWM_PLAUS ECU_ADDRESS 0xd00042fe BIT_MASK 0x780 /end MEASUREMENT
/begin CHARACTERISTIC fmy_id_l_prs_sys.c_err_clas "Failure class number for failure XX" VALUE 0xa1004414 _REC_VAL_20_u1 255. _CNV_A_R_LINEAR_____0_CM 0. 255. DISPLAY_IDENTIFIER C_ERR_CLAS_L_PRS_SYS FORMAT "%3.0" /end CHARACTERISTIC
/begin MEASUREMENT fmy_stat_l_prs_sys.ctr_abc "anti-bounce counter for diagnosis XX" UBYTE _CNV_A_R_LINEAR_____0_CM 1 100. 0. 255. DISPLAY_IDENTIFIER CTR_ABC_L_PRS_SYS ECU_ADDRESS 0xd00043c8 FORMAT "%3.0" /end MEASUREMENT
/begin MEASUREMENT fmy_stat_l_prs_sys.ctr_end_diag "Counter for the end of diagnosis XX generation" UBYTE _CNV_A_R_LINEAR_____0_CM 1 100. 0. 255. DISPLAY_IDENTIFIER CTR_ABC_END_DIAG_L_PRS_SYS ECU_ADDRESS 0xd00043c9 FORMAT "%3.0" /end MEASUREMENT
/begin MEASUREMENT fmy_stat_l_prs_sys.err_info_stat.lv_err_mem "Failure is stored in dynamic memory (2nd layer)" UWORD _CNV_S_2_RANGE__0___1_CM 1 100. 0. 1. DISPLAY_IDENTIFIER LV_ERR_MEM_L_PRS_SYS ECU_ADDRESS 0xd00043ca BIT_MASK 0x8 /end MEASUREMENT
/begin MEASUREMENT fmy_stat_l_prs_sys.err_info_stat.lv_ready "Readiness flag related to diagnosis XX" UWORD _CNV_S_2_RANGE__0___1_CM 1 100. 0. 1. DISPLAY_IDENTIFIER LV_READY_L_PRS_SYS ECU_ADDRESS 0xd00043ca BIT_MASK 0x10 /end MEASUREMENT
/begin MEASUREMENT fmy_stat_l_prs_sys.err_info_stat.lv_end_diag "End of diagnosis XX" UWORD _CNV_S_2_RANGE__0___1_CM 1 100. 0. 1. DISPLAY_IDENTIFIER LV_END_DIAG_L_PRS_SYS ECU_ADDRESS 0xd00043ca BIT_MASK 0x20 /end MEASUREMENT
/begin MEASUREMENT fmy_stat_l_prs_sys.err_info_stat.lv_cdn_diag "Diagnosis condition to start symptom detection (set to 1 when condition is fulfilled)" UWORD _CNV_S_2_RANGE__0___1_CM 1 100. 0. 1. DISPLAY_IDENTIFIER LV_CDN_DIAG_L_PRS_SYS ECU_ADDRESS 0xd00043ca BIT_MASK 0x40 /end MEASUREMENT
/begin MEASUREMENT fmy_stat_l_prs_sys.err_info_stat.err_sym "For each symptom: status of failure (set to 1 when failure symptom is detected)" UWORD _CNV_S_16_RANGE_ERR__485_CM 1 100. 0. 15. DISPLAY_IDENTIFIER ERR_SYM_L_PRS_SYS ECU_ADDRESS 0xd00043ca BIT_MASK 0x780 /end MEASUREMENT
/begin CHARACTERISTIC fmy_id_conv_mon_1.c_err_clas "Failure class number for failure XX" VALUE 0xa1003d34 _REC_VAL_20_u1 255. _CNV_A_R_LINEAR_____0_CM 0. 255. DISPLAY_IDENTIFIER C_ERR_CLAS_CONV_MON_1 FORMAT "%3.0" /end CHARACTERISTIC
/begin MEASUREMENT fmy_stat_conv_mon_1.ctr_abc "anti-bounce counter for diagnosis XX" UBYTE _CNV_A_R_LINEAR_____0_CM 1 100. 0. 255. DISPLAY_IDENTIFIER CTR_ABC_CONV_MON_1 ECU_ADDRESS 0xd0004268 FORMAT "%3.0" /end MEASUREMENT
/begin MEASUREMENT fmy_stat_conv_mon_1.ctr_end_diag "Counter for the end of diagnosis XX generation" UBYTE _CNV_A_R_LINEAR_____0_CM 1 100. 0. 255. DISPLAY_IDENTIFIER CTR_ABC_END_DIAG_CONV_MON_1 ECU_ADDRESS 0xd0004269 FORMAT "%3.0" /end MEASUREMENT
/begin MEASUREMENT fmy_stat_conv_mon_1.err_info_stat.lv_err_mem "Failure is stored in dynamic memory (2nd layer)" UWORD _CNV_S_2_RANGE__0___1_CM 1 100. 0. 1. DISPLAY_IDENTIFIER LV_ERR_MEM_CONV_MON_1 ECU_ADDRESS 0xd000426a BIT_MASK 0x8 /end MEASUREMENT
/begin MEASUREMENT fmy_stat_conv_mon_1.err_info_stat.lv_ready "Readiness flag related to diagnosis XX" UWORD _CNV_S_2_RANGE__0___1_CM 1 100. 0. 1. DISPLAY_IDENTIFIER LV_READY_CONV_MON_1 ECU_ADDRESS 0xd000426a BIT_MASK 0x10 /end MEASUREMENT
/begin MEASUREMENT fmy_stat_conv_mon_1.err_info_stat.lv_end_diag "End of diagnosis XX" UWORD _CNV_S_2_RANGE__0___1_CM 1 100. 0. 1. DISPLAY_IDENTIFIER LV_END_DIAG_CONV_MON_1 ECU_ADDRESS 0xd000426a BIT_MASK 0x20 /end MEASUREMENT
/begin MEASUREMENT fmy_stat_conv_mon_1.err_info_stat.lv_cdn_diag "Diagnosis condition to start symptom detection (set to 1 when condition is fulfilled)" UWORD _CNV_S_2_RANGE__0___1_CM 1 100. 0. 1. DISPLAY_IDENTIFIER LV_CDN_DIAG_CONV_MON_1 ECU_ADDRESS 0xd000426a BIT_MASK 0x40 /end MEASUREMENT
/begin MEASUREMENT fmy_stat_conv_mon_1.err_info_stat.err_sym "For each symptom: status of failure (set to 1 when failure symptom is detected)" UWORD _CNV_S_16_RANGE_ERR__485_CM 1 100. 0. 15. DISPLAY_IDENTIFIER ERR_SYM_CONV_MON_1 ECU_ADDRESS 0xd000426a BIT_MASK 0x780 /end MEASUREMENT
/begin CHARACTERISTIC fmy_id_n_32_mon_1.c_err_clas "Failure class number for failure XX" VALUE 0xa10046bc _REC_VAL_20_u1 255. _CNV_A_R_LINEAR_____0_CM 0. 255. DISPLAY_IDENTIFIER C_ERR_CLAS_N_32_MON_1 FORMAT "%3.0" /end CHARACTERISTIC
/begin MEASUREMENT fmy_stat_n_32_mon_1.ctr_abc "anti-bounce counter for diagnosis XX" UBYTE _CNV_A_R_LINEAR_____0_CM 1 100. 0. 255. DISPLAY_IDENTIFIER CTR_ABC_N_32_MON_1 ECU_ADDRESS 0xd0004450 FORMAT "%3.0" /end MEASUREMENT
/begin MEASUREMENT fmy_stat_n_32_mon_1.ctr_end_diag "Counter for the end of diagnosis XX generation" UBYTE _CNV_A_R_LINEAR_____0_CM 1 100. 0. 255. DISPLAY_IDENTIFIER CTR_ABC_END_DIAG_N_32_MON_1 ECU_ADDRESS 0xd0004451 FORMAT "%3.0" /end MEASUREMENT
/begin MEASUREMENT fmy_stat_n_32_mon_1.err_info_stat.lv_err_mem "Failure is stored in dynamic memory (2nd layer)" UWORD _CNV_S_2_RANGE__0___1_CM 1 100. 0. 1. DISPLAY_IDENTIFIER LV_ERR_MEM_N_32_MON_1 ECU_ADDRESS 0xd0004452 BIT_MASK 0x8 /end MEASUREMENT
/begin MEASUREMENT fmy_stat_n_32_mon_1.err_info_stat.lv_ready "Readiness flag related to diagnosis XX" UWORD _CNV_S_2_RANGE__0___1_CM 1 100. 0. 1. DISPLAY_IDENTIFIER LV_READY_N_32_MON_1 ECU_ADDRESS 0xd0004452 BIT_MASK 0x10 /end MEASUREMENT
/begin MEASUREMENT fmy_stat_n_32_mon_1.err_info_stat.lv_end_diag "End of diagnosis XX" UWORD _CNV_S_2_RANGE__0___1_CM 1 100. 0. 1. DISPLAY_IDENTIFIER LV_END_DIAG_N_32_MON_1 ECU_ADDRESS 0xd0004452 BIT_MASK 0x20 /end MEASUREMENT
/begin MEASUREMENT fmy_stat_n_32_mon_1.err_info_stat.lv_cdn_diag "Diagnosis condition to start symptom detection (set to 1 when condition is fulfilled)" UWORD _CNV_S_2_RANGE__0___1_CM 1 100. 0. 1. DISPLAY_IDENTIFIER LV_CDN_DIAG_N_32_MON_1 ECU_ADDRESS 0xd0004452 BIT_MASK 0x40 /end MEASUREMENT
/begin MEASUREMENT fmy_stat_n_32_mon_1.err_info_stat.err_sym "For each symptom: status of failure (set to 1 when failure symptom is detected)" UWORD _CNV_S_16_RANGE_ERR__485_CM 1 100. 0. 15. DISPLAY_IDENTIFIER ERR_SYM_N_32_MON_1 ECU_ADDRESS 0xd0004452 BIT_MASK 0x780 /end MEASUREMENT
/begin CHARACTERISTIC fmy_id_pvs_mon_1.c_err_clas "Failure class number for failure XX" VALUE 0xa1004928 _REC_VAL_20_u1 255. _CNV_A_R_LINEAR_____0_CM 0. 255. DISPLAY_IDENTIFIER C_ERR_CLAS_PVS_MON_1 FORMAT "%3.0" /end CHARACTERISTIC
/begin MEASUREMENT fmy_stat_pvs_mon_1.ctr_abc "anti-bounce counter for diagnosis XX" UBYTE _CNV_A_R_LINEAR_____0_CM 1 100. 0. 255. DISPLAY_IDENTIFIER CTR_ABC_PVS_MON_1 ECU_ADDRESS 0xd00044cc FORMAT "%3.0" /end MEASUREMENT
/begin MEASUREMENT fmy_stat_pvs_mon_1.ctr_end_diag "Counter for the end of diagnosis XX generation" UBYTE _CNV_A_R_LINEAR_____0_CM 1 100. 0. 255. DISPLAY_IDENTIFIER CTR_ABC_END_DIAG_PVS_MON_1 ECU_ADDRESS 0xd00044cd FORMAT "%3.0" /end MEASUREMENT
/begin MEASUREMENT fmy_stat_pvs_mon_1.err_info_stat.lv_err_mem "Failure is stored in dynamic memory (2nd layer)" UWORD _CNV_S_2_RANGE__0___1_CM 1 100. 0. 1. DISPLAY_IDENTIFIER LV_ERR_MEM_PVS_MON_1 ECU_ADDRESS 0xd00044ce BIT_MASK 0x8 /end MEASUREMENT
/begin MEASUREMENT fmy_stat_pvs_mon_1.err_info_stat.lv_ready "Readiness flag related to diagnosis XX" UWORD _CNV_S_2_RANGE__0___1_CM 1 100. 0. 1. DISPLAY_IDENTIFIER LV_READY_PVS_MON_1 ECU_ADDRESS 0xd00044ce BIT_MASK 0x10 /end MEASUREMENT
/begin MEASUREMENT fmy_stat_pvs_mon_1.err_info_stat.lv_end_diag "End of diagnosis XX" UWORD _CNV_S_2_RANGE__0___1_CM 1 100. 0. 1. DISPLAY_IDENTIFIER LV_END_DIAG_PVS_MON_1 ECU_ADDRESS 0xd00044ce BIT_MASK 0x20 /end MEASUREMENT
/begin MEASUREMENT fmy_stat_pvs_mon_1.err_info_stat.lv_cdn_diag "Diagnosis condition to start symptom detection (set to 1 when condition is fulfilled)" UWORD _CNV_S_2_RANGE__0___1_CM 1 100. 0. 1. DISPLAY_IDENTIFIER LV_CDN_DIAG_PVS_MON_1 ECU_ADDRESS 0xd00044ce BIT_MASK 0x40 /end MEASUREMENT
/begin MEASUREMENT fmy_stat_pvs_mon_1.err_info_stat.err_sym "For each symptom: status of failure (set to 1 when failure symptom is detected)" UWORD _CNV_S_16_RANGE_ERR__485_CM 1 100. 0. 15. DISPLAY_IDENTIFIER ERR_SYM_PVS_MON_1 ECU_ADDRESS 0xd00044ce BIT_MASK 0x780 /end MEASUREMENT
/begin CHARACTERISTIC fmy_id_tq_dif_isc_mon_1.c_err_clas "Failure class number for failure XX" VALUE 0xa1004f54 _REC_VAL_20_u1 255. _CNV_A_R_LINEAR_____0_CM 0. 255. DISPLAY_IDENTIFIER C_ERR_CLAS_TQ_DIF_ISC_MON_1 FORMAT "%3.0" /end CHARACTERISTIC
/begin MEASUREMENT fmy_stat_tq_dif_isc_mon_1.ctr_abc "anti-bounce counter for diagnosis XX" UBYTE _CNV_A_R_LINEAR_____0_CM 1 100. 0. 255. DISPLAY_IDENTIFIER CTR_ABC_TQ_DIF_ISC_MON_1 ECU_ADDRESS 0xd0004608 FORMAT "%3.0" /end MEASUREMENT
/begin MEASUREMENT fmy_stat_tq_dif_isc_mon_1.ctr_end_diag "Counter for the end of diagnosis XX generation" UBYTE _CNV_A_R_LINEAR_____0_CM 1 100. 0. 255. DISPLAY_IDENTIFIER CTR_ABC_END_DIAG_TQ_DIF_ISC_MON_1 ECU_ADDRESS 0xd0004609 FORMAT "%3.0" /end MEASUREMENT
/begin MEASUREMENT fmy_stat_tq_dif_isc_mon_1.err_info_stat.lv_err_mem "Failure is stored in dynamic memory (2nd layer)" UWORD _CNV_S_2_RANGE__0___1_CM 1 100. 0. 1. DISPLAY_IDENTIFIER LV_ERR_MEM_TQ_DIF_ISC_MON_1 ECU_ADDRESS 0xd000460a BIT_MASK 0x8 /end MEASUREMENT
/begin MEASUREMENT fmy_stat_tq_dif_isc_mon_1.err_info_stat.lv_ready "Readiness flag related to diagnosis XX" UWORD _CNV_S_2_RANGE__0___1_CM 1 100. 0. 1. DISPLAY_IDENTIFIER LV_READY_TQ_DIF_ISC_MON_1 ECU_ADDRESS 0xd000460a BIT_MASK 0x10 /end MEASUREMENT
/begin MEASUREMENT fmy_stat_tq_dif_isc_mon_1.err_info_stat.lv_end_diag "End of diagnosis XX" UWORD _CNV_S_2_RANGE__0___1_CM 1 100. 0. 1. DISPLAY_IDENTIFIER LV_END_DIAG_TQ_DIF_ISC_MON_1 ECU_ADDRESS 0xd000460a BIT_MASK 0x20 /end MEASUREMENT
/begin MEASUREMENT fmy_stat_tq_dif_isc_mon_1.err_info_stat.lv_cdn_diag "Diagnosis condition to start symptom detection (set to 1 when condition is fulfilled)" UWORD _CNV_S_2_RANGE__0___1_CM 1 100. 0. 1. DISPLAY_IDENTIFIER LV_CDN_DIAG_TQ_DIF_ISC_MON_1 ECU_ADDRESS 0xd000460a BIT_MASK 0x40 /end MEASUREMENT
/begin MEASUREMENT fmy_stat_tq_dif_isc_mon_1.err_info_stat.err_sym "For each symptom: status of failure (set to 1 when failure symptom is detected)" UWORD _CNV_S_16_RANGE_ERR__485_CM 1 100. 0. 15. DISPLAY_IDENTIFIER ERR_SYM_TQ_DIF_ISC_MON_1 ECU_ADDRESS 0xd000460a BIT_MASK 0x780 /end MEASUREMENT
/begin CHARACTERISTIC fmy_id_tq_req_mon_1.c_err_clas "Failure class number for failure XX" VALUE 0xa1004f90 _REC_VAL_20_u1 255. _CNV_A_R_LINEAR_____0_CM 0. 255. DISPLAY_IDENTIFIER C_ERR_CLAS_TQ_REQ_MON_1 FORMAT "%3.0" /end CHARACTERISTIC
/begin MEASUREMENT fmy_stat_tq_req_mon_1.ctr_abc "anti-bounce counter for diagnosis XX" UBYTE _CNV_A_R_LINEAR_____0_CM 1 100. 0. 255. DISPLAY_IDENTIFIER CTR_ABC_TQ_REQ_MON_1 ECU_ADDRESS 0xd0004614 FORMAT "%3.0" /end MEASUREMENT
/begin MEASUREMENT fmy_stat_tq_req_mon_1.ctr_end_diag "Counter for the end of diagnosis XX generation" UBYTE _CNV_A_R_LINEAR_____0_CM 1 100. 0. 255. DISPLAY_IDENTIFIER CTR_ABC_END_DIAG_TQ_REQ_MON_1 ECU_ADDRESS 0xd0004615 FORMAT "%3.0" /end MEASUREMENT
/begin MEASUREMENT fmy_stat_tq_req_mon_1.err_info_stat.lv_err_mem "Failure is stored in dynamic memory (2nd layer)" UWORD _CNV_S_2_RANGE__0___1_CM 1 100. 0. 1. DISPLAY_IDENTIFIER LV_ERR_MEM_TQ_REQ_MON_1 ECU_ADDRESS 0xd0004616 BIT_MASK 0x8 /end MEASUREMENT
/begin MEASUREMENT fmy_stat_tq_req_mon_1.err_info_stat.lv_ready "Readiness flag related to diagnosis XX" UWORD _CNV_S_2_RANGE__0___1_CM 1 100. 0. 1. DISPLAY_IDENTIFIER LV_READY_TQ_REQ_MON_1 ECU_ADDRESS 0xd0004616 BIT_MASK 0x10 /end MEASUREMENT
/begin MEASUREMENT fmy_stat_tq_req_mon_1.err_info_stat.lv_end_diag "End of diagnosis XX" UWORD _CNV_S_2_RANGE__0___1_CM 1 100. 0. 1. DISPLAY_IDENTIFIER LV_END_DIAG_TQ_REQ_MON_1 ECU_ADDRESS 0xd0004616 BIT_MASK 0x20 /end MEASUREMENT
/begin MEASUREMENT fmy_stat_tq_req_mon_1.err_info_stat.lv_cdn_diag "Diagnosis condition to start symptom detection (set to 1 when condition is fulfilled)" UWORD _CNV_S_2_RANGE__0___1_CM 1 100. 0. 1. DISPLAY_IDENTIFIER LV_CDN_DIAG_TQ_REQ_MON_1 ECU_ADDRESS 0xd0004616 BIT_MASK 0x40 /end MEASUREMENT
/begin MEASUREMENT fmy_stat_tq_req_mon_1.err_info_stat.err_sym "For each symptom: status of failure (set to 1 when failure symptom is detected)" UWORD _CNV_S_16_RANGE_ERR__485_CM 1 100. 0. 15. DISPLAY_IDENTIFIER ERR_SYM_TQ_REQ_MON_1 ECU_ADDRESS 0xd0004616 BIT_MASK 0x780 /end MEASUREMENT
/begin CHARACTERISTIC fmy_id_tq_ext_mon_1.c_err_clas "Failure class number for failure XX" VALUE 0xa1004f68 _REC_VAL_20_u1 255. _CNV_A_R_LINEAR_____0_CM 0. 255. DISPLAY_IDENTIFIER C_ERR_CLAS_TQ_EXT_MON_1 FORMAT "%3.0" /end CHARACTERISTIC
/begin MEASUREMENT fmy_stat_tq_ext_mon_1.ctr_abc "anti-bounce counter for diagnosis XX" UBYTE _CNV_A_R_LINEAR_____0_CM 1 100. 0. 255. DISPLAY_IDENTIFIER CTR_ABC_TQ_EXT_MON_1 ECU_ADDRESS 0xd000460c FORMAT "%3.0" /end MEASUREMENT
/begin MEASUREMENT fmy_stat_tq_ext_mon_1.ctr_end_diag "Counter for the end of diagnosis XX generation" UBYTE _CNV_A_R_LINEAR_____0_CM 1 100. 0. 255. DISPLAY_IDENTIFIER CTR_ABC_END_DIAG_TQ_EXT_MON_1 ECU_ADDRESS 0xd000460d FORMAT "%3.0" /end MEASUREMENT
/begin MEASUREMENT fmy_stat_tq_ext_mon_1.err_info_stat.lv_err_mem "Failure is stored in dynamic memory (2nd layer)" UWORD _CNV_S_2_RANGE__0___1_CM 1 100. 0. 1. DISPLAY_IDENTIFIER LV_ERR_MEM_TQ_EXT_MON_1 ECU_ADDRESS 0xd000460e BIT_MASK 0x8 /end MEASUREMENT
/begin MEASUREMENT fmy_stat_tq_ext_mon_1.err_info_stat.lv_ready "Readiness flag related to diagnosis XX" UWORD _CNV_S_2_RANGE__0___1_CM 1 100. 0. 1. DISPLAY_IDENTIFIER LV_READY_TQ_EXT_MON_1 ECU_ADDRESS 0xd000460e BIT_MASK 0x10 /end MEASUREMENT
/begin MEASUREMENT fmy_stat_tq_ext_mon_1.err_info_stat.lv_end_diag "End of diagnosis XX" UWORD _CNV_S_2_RANGE__0___1_CM 1 100. 0. 1. DISPLAY_IDENTIFIER LV_END_DIAG_TQ_EXT_MON_1 ECU_ADDRESS 0xd000460e BIT_MASK 0x20 /end MEASUREMENT
/begin MEASUREMENT fmy_stat_tq_ext_mon_1.err_info_stat.lv_cdn_diag "Diagnosis condition to start symptom detection (set to 1 when condition is fulfilled)" UWORD _CNV_S_2_RANGE__0___1_CM 1 100. 0. 1. DISPLAY_IDENTIFIER LV_CDN_DIAG_TQ_EXT_MON_1 ECU_ADDRESS 0xd000460e BIT_MASK 0x40 /end MEASUREMENT
/begin MEASUREMENT fmy_stat_tq_ext_mon_1.err_info_stat.err_sym "For each symptom: status of failure (set to 1 when failure symptom is detected)" UWORD _CNV_S_16_RANGE_ERR__485_CM 1 100. 0. 15. DISPLAY_IDENTIFIER ERR_SYM_TQ_EXT_MON_1 ECU_ADDRESS 0xd000460e BIT_MASK 0x780 /end MEASUREMENT
/begin CHARACTERISTIC fmy_id_tqi_av_mon_1.c_err_clas "Failure class number for failure XX" VALUE 0xa1004fa4 _REC_VAL_20_u1 255. _CNV_A_R_LINEAR_____0_CM 0. 255. DISPLAY_IDENTIFIER C_ERR_CLAS_TQI_AV_MON_1 FORMAT "%3.0" /end CHARACTERISTIC
/begin MEASUREMENT fmy_stat_tqi_av_mon_1.ctr_abc "anti-bounce counter for diagnosis XX" UBYTE _CNV_A_R_LINEAR_____0_CM 1 100. 0. 255. DISPLAY_IDENTIFIER CTR_ABC_TQI_AV_MON_1 ECU_ADDRESS 0xd0004618 FORMAT "%3.0" /end MEASUREMENT
/begin MEASUREMENT fmy_stat_tqi_av_mon_1.ctr_end_diag "Counter for the end of diagnosis XX generation" UBYTE _CNV_A_R_LINEAR_____0_CM 1 100. 0. 255. DISPLAY_IDENTIFIER CTR_ABC_END_DIAG_TQI_AV_MON_1 ECU_ADDRESS 0xd0004619 FORMAT "%3.0" /end MEASUREMENT
/begin MEASUREMENT fmy_stat_tqi_av_mon_1.err_info_stat.lv_err_mem "Failure is stored in dynamic memory (2nd layer)" UWORD _CNV_S_2_RANGE__0___1_CM 1 100. 0. 1. DISPLAY_IDENTIFIER LV_ERR_MEM_TQI_AV_MON_1 ECU_ADDRESS 0xd000461a BIT_MASK 0x8 /end MEASUREMENT
/begin MEASUREMENT fmy_stat_tqi_av_mon_1.err_info_stat.lv_ready "Readiness flag related to diagnosis XX" UWORD _CNV_S_2_RANGE__0___1_CM 1 100. 0. 1. DISPLAY_IDENTIFIER LV_READY_TQI_AV_MON_1 ECU_ADDRESS 0xd000461a BIT_MASK 0x10 /end MEASUREMENT
/begin MEASUREMENT fmy_stat_tqi_av_mon_1.err_info_stat.lv_end_diag "End of diagnosis XX" UWORD _CNV_S_2_RANGE__0___1_CM 1 100. 0. 1. DISPLAY_IDENTIFIER LV_END_DIAG_TQI_AV_MON_1 ECU_ADDRESS 0xd000461a BIT_MASK 0x20 /end MEASUREMENT
/begin MEASUREMENT fmy_stat_tqi_av_mon_1.err_info_stat.lv_cdn_diag "Diagnosis condition to start symptom detection (set to 1 when condition is fulfilled)" UWORD _CNV_S_2_RANGE__0___1_CM 1 100. 0. 1. DISPLAY_IDENTIFIER LV_CDN_DIAG_TQI_AV_MON_1 ECU_ADDRESS 0xd000461a BIT_MASK 0x40 /end MEASUREMENT
/begin MEASUREMENT fmy_stat_tqi_av_mon_1.err_info_stat.err_sym "For each symptom: status of failure (set to 1 when failure symptom is detected)" UWORD _CNV_S_16_RANGE_ERR__485_CM 1 100. 0. 15. DISPLAY_IDENTIFIER ERR_SYM_TQI_AV_MON_1 ECU_ADDRESS 0xd000461a BIT_MASK 0x780 /end MEASUREMENT
/begin CHARACTERISTIC fmy_id_tqi_n_max_mon_1.c_err_clas "Failure class number for failure XX" VALUE 0xa1004fcc _REC_VAL_20_u1 255. _CNV_A_R_LINEAR_____0_CM 0. 255. DISPLAY_IDENTIFIER C_ERR_CLAS_TQI_N_MAX_MON_1 FORMAT "%3.0" /end CHARACTERISTIC
/begin MEASUREMENT fmy_stat_tqi_n_max_mon_1.ctr_abc "anti-bounce counter for diagnosis XX" UBYTE _CNV_A_R_LINEAR_____0_CM 1 100. 0. 255. DISPLAY_IDENTIFIER CTR_ABC_TQI_N_MAX_MON_1 ECU_ADDRESS 0xd0004620 FORMAT "%3.0" /end MEASUREMENT
/begin MEASUREMENT fmy_stat_tqi_n_max_mon_1.ctr_end_diag "Counter for the end of diagnosis XX generation" UBYTE _CNV_A_R_LINEAR_____0_CM 1 100. 0. 255. DISPLAY_IDENTIFIER CTR_ABC_END_DIAG_TQI_N_MAX_MON_1 ECU_ADDRESS 0xd0004621 FORMAT "%3.0" /end MEASUREMENT
/begin MEASUREMENT fmy_stat_tqi_n_max_mon_1.err_info_stat.lv_err_mem "Failure is stored in dynamic memory (2nd layer)" UWORD _CNV_S_2_RANGE__0___1_CM 1 100. 0. 1. DISPLAY_IDENTIFIER LV_ERR_MEM_TQI_N_MAX_MON_1 ECU_ADDRESS 0xd0004622 BIT_MASK 0x8 /end MEASUREMENT
/begin MEASUREMENT fmy_stat_tqi_n_max_mon_1.err_info_stat.lv_ready "Readiness flag related to diagnosis XX" UWORD _CNV_S_2_RANGE__0___1_CM 1 100. 0. 1. DISPLAY_IDENTIFIER LV_READY_TQI_N_MAX_MON_1 ECU_ADDRESS 0xd0004622 BIT_MASK 0x10 /end MEASUREMENT
/begin MEASUREMENT fmy_stat_tqi_n_max_mon_1.err_info_stat.lv_end_diag "End of diagnosis XX" UWORD _CNV_S_2_RANGE__0___1_CM 1 100. 0. 1. DISPLAY_IDENTIFIER LV_END_DIAG_TQI_N_MAX_MON_1 ECU_ADDRESS 0xd0004622 BIT_MASK 0x20 /end MEASUREMENT
/begin MEASUREMENT fmy_stat_tqi_n_max_mon_1.err_info_stat.lv_cdn_diag "Diagnosis condition to start symptom detection (set to 1 when condition is fulfilled)" UWORD _CNV_S_2_RANGE__0___1_CM 1 100. 0. 1. DISPLAY_IDENTIFIER LV_CDN_DIAG_TQI_N_MAX_MON_1 ECU_ADDRESS 0xd0004622 BIT_MASK 0x40 /end MEASUREMENT
/begin MEASUREMENT fmy_stat_tqi_n_max_mon_1.err_info_stat.err_sym "For each symptom: status of failure (set to 1 when failure symptom is detected)" UWORD _CNV_S_16_RANGE_ERR__485_CM 1 100. 0. 15. DISPLAY_IDENTIFIER ERR_SYM_TQI_N_MAX_MON_1 ECU_ADDRESS 0xd0004622 BIT_MASK 0x780 /end MEASUREMENT
/begin CHARACTERISTIC fmy_id_mff_mon_1.c_err_clas "Failure class number for failure XX" VALUE 0xa100457c _REC_VAL_20_u1 255. _CNV_A_R_LINEAR_____0_CM 0. 255. DISPLAY_IDENTIFIER C_ERR_CLAS_MFF_MON_1 FORMAT "%3.0" /end CHARACTERISTIC
/begin MEASUREMENT fmy_stat_mff_mon_1.ctr_abc "anti-bounce counter for diagnosis XX" UBYTE _CNV_A_R_LINEAR_____0_CM 1 100. 0. 255. DISPLAY_IDENTIFIER CTR_ABC_MFF_MON_1 ECU_ADDRESS 0xd0004410 FORMAT "%3.0" /end MEASUREMENT
/begin MEASUREMENT fmy_stat_mff_mon_1.ctr_end_diag "Counter for the end of diagnosis XX generation" UBYTE _CNV_A_R_LINEAR_____0_CM 1 100. 0. 255. DISPLAY_IDENTIFIER CTR_ABC_END_DIAG_MFF_MON_1 ECU_ADDRESS 0xd0004411 FORMAT "%3.0" /end MEASUREMENT
/begin MEASUREMENT fmy_stat_mff_mon_1.err_info_stat.lv_err_mem "Failure is stored in dynamic memory (2nd layer)" UWORD _CNV_S_2_RANGE__0___1_CM 1 100. 0. 1. DISPLAY_IDENTIFIER LV_ERR_MEM_MFF_MON_1 ECU_ADDRESS 0xd0004412 BIT_MASK 0x8 /end MEASUREMENT
/begin MEASUREMENT fmy_stat_mff_mon_1.err_info_stat.lv_ready "Readiness flag related to diagnosis XX" UWORD _CNV_S_2_RANGE__0___1_CM 1 100. 0. 1. DISPLAY_IDENTIFIER LV_READY_MFF_MON_1 ECU_ADDRESS 0xd0004412 BIT_MASK 0x10 /end MEASUREMENT
/begin MEASUREMENT fmy_stat_mff_mon_1.err_info_stat.lv_end_diag "End of diagnosis XX" UWORD _CNV_S_2_RANGE__0___1_CM 1 100. 0. 1. DISPLAY_IDENTIFIER LV_END_DIAG_MFF_MON_1 ECU_ADDRESS 0xd0004412 BIT_MASK 0x20 /end MEASUREMENT
/begin MEASUREMENT fmy_stat_mff_mon_1.err_info_stat.lv_cdn_diag "Diagnosis condition to start symptom detection (set to 1 when condition is fulfilled)" UWORD _CNV_S_2_RANGE__0___1_CM 1 100. 0. 1. DISPLAY_IDENTIFIER LV_CDN_DIAG_MFF_MON_1 ECU_ADDRESS 0xd0004412 BIT_MASK 0x40 /end MEASUREMENT
/begin MEASUREMENT fmy_stat_mff_mon_1.err_info_stat.err_sym "For each symptom: status of failure (set to 1 when failure symptom is detected)" UWORD _CNV_S_16_RANGE_ERR__485_CM 1 100. 0. 15. DISPLAY_IDENTIFIER ERR_SYM_MFF_MON_1 ECU_ADDRESS 0xd0004412 BIT_MASK 0x780 /end MEASUREMENT
/begin CHARACTERISTIC fmy_id_cru_mon_1.c_err_clas "Failure class number for failure XX" VALUE 0xa1003dac _REC_VAL_20_u1 255. _CNV_A_R_LINEAR_____0_CM 0. 255. DISPLAY_IDENTIFIER C_ERR_CLAS_CRU_MON_1 FORMAT "%3.0" /end CHARACTERISTIC
/begin MEASUREMENT fmy_stat_cru_mon_1.ctr_abc "anti-bounce counter for diagnosis XX" UBYTE _CNV_A_R_LINEAR_____0_CM 1 100. 0. 255. DISPLAY_IDENTIFIER CTR_ABC_CRU_MON_1 ECU_ADDRESS 0xd0004280 FORMAT "%3.0" /end MEASUREMENT
/begin MEASUREMENT fmy_stat_cru_mon_1.ctr_end_diag "Counter for the end of diagnosis XX generation" UBYTE _CNV_A_R_LINEAR_____0_CM 1 100. 0. 255. DISPLAY_IDENTIFIER CTR_ABC_END_DIAG_CRU_MON_1 ECU_ADDRESS 0xd0004281 FORMAT "%3.0" /end MEASUREMENT
/begin MEASUREMENT fmy_stat_cru_mon_1.err_info_stat.lv_err_mem "Failure is stored in dynamic memory (2nd layer)" UWORD _CNV_S_2_RANGE__0___1_CM 1 100. 0. 1. DISPLAY_IDENTIFIER LV_ERR_MEM_CRU_MON_1 ECU_ADDRESS 0xd0004282 BIT_MASK 0x8 /end MEASUREMENT
/begin MEASUREMENT fmy_stat_cru_mon_1.err_info_stat.lv_ready "Readiness flag related to diagnosis XX" UWORD _CNV_S_2_RANGE__0___1_CM 1 100. 0. 1. DISPLAY_IDENTIFIER LV_READY_CRU_MON_1 ECU_ADDRESS 0xd0004282 BIT_MASK 0x10 /end MEASUREMENT
/begin MEASUREMENT fmy_stat_cru_mon_1.err_info_stat.lv_end_diag "End of diagnosis XX" UWORD _CNV_S_2_RANGE__0___1_CM 1 100. 0. 1. DISPLAY_IDENTIFIER LV_END_DIAG_CRU_MON_1 ECU_ADDRESS 0xd0004282 BIT_MASK 0x20 /end MEASUREMENT
/begin MEASUREMENT fmy_stat_cru_mon_1.err_info_stat.lv_cdn_diag "Diagnosis condition to start symptom detection (set to 1 when condition is fulfilled)" UWORD _CNV_S_2_RANGE__0___1_CM 1 100. 0. 1. DISPLAY_IDENTIFIER LV_CDN_DIAG_CRU_MON_1 ECU_ADDRESS 0xd0004282 BIT_MASK 0x40 /end MEASUREMENT
/begin MEASUREMENT fmy_stat_cru_mon_1.err_info_stat.err_sym "For each symptom: status of failure (set to 1 when failure symptom is detected)" UWORD _CNV_S_16_RANGE_ERR__485_CM 1 100. 0. 15. DISPLAY_IDENTIFIER ERR_SYM_CRU_MON_1 ECU_ADDRESS 0xd0004282 BIT_MASK 0x780 /end MEASUREMENT
/begin MEASUREMENT cdn_diag_prev_ecras_el "Diagnostic condition of last failure symptom" UBYTE _CNV_A_R_LINEAR_____0_CM 1 100. 0. 255. DISPLAY_IDENTIFIER CDN_DIAG_PREV_ECRAS_EL ECU_ADDRESS 0xc0001e2c /end MEASUREMENT
/begin MEASUREMENT cdn_diag_prev_dmtlh "Diagnostic condition of last failure symptom" UBYTE _CNV_A_R_LINEAR_____0_CM 1 100. 0. 255. DISPLAY_IDENTIFIER CDN_DIAG_PREV_DMTLH ECU_ADDRESS 0xc0001e2d /end MEASUREMENT
/begin MEASUREMENT cdn_diag_prev_rly_accout "Diagnostic condition of last failure symptom" UBYTE _CNV_A_R_LINEAR_____0_CM 1 100. 0. 255. DISPLAY_IDENTIFIER CDN_DIAG_PREV_RLY_ACCOUT ECU_ADDRESS 0xc0001e2e /end MEASUREMENT
/begin MEASUREMENT cdn_diag_prev_dmtls "Diagnostic condition of last failure symptom" UBYTE _CNV_A_R_LINEAR_____0_CM 1 100. 0. 255. DISPLAY_IDENTIFIER CDN_DIAG_PREV_DMTLS ECU_ADDRESS 0xc0001e2f /end MEASUREMENT
/begin MEASUREMENT cdn_diag_prev_dmtl_pump "Diagnostic condition of last failure symptom" UBYTE _CNV_A_R_LINEAR_____0_CM 1 100. 0. 255. DISPLAY_IDENTIFIER CDN_DIAG_PREV_DMTL_PUMP ECU_ADDRESS 0xc0001e30 /end MEASUREMENT
/begin MEASUREMENT cdn_diag_prev_ebox_cfa "Diagnostic condition of last failure symptom" UBYTE _CNV_A_R_LINEAR_____0_CM 1 100. 0. 255. DISPLAY_IDENTIFIER CDN_DIAG_PREV_EBOX_CFA ECU_ADDRESS 0xc0001e31 /end MEASUREMENT
/begin MEASUREMENT cdn_diag_prev_ef "Diagnostic condition of last failure symptom" UBYTE _CNV_A_R_LINEAR_____0_CM 1 100. 0. 255. DISPLAY_IDENTIFIER CDN_DIAG_PREV_EF ECU_ADDRESS 0xc0001e32 /end MEASUREMENT
/begin MEASUREMENT cdn_diag_prev_rly_st "Diagnostic condition of last failure symptom" UBYTE _CNV_A_R_LINEAR_____0_CM 1 100. 0. 255. DISPLAY_IDENTIFIER CDN_DIAG_PREV_RLY_ST ECU_ADDRESS 0xc0001e33 /end MEASUREMENT
/begin MEASUREMENT cdn_diag_prev_lsh_up_1 "Diagnostic condition of last failure symptom" UBYTE _CNV_A_R_LINEAR_____0_CM 1 100. 0. 255. DISPLAY_IDENTIFIER CDN_DIAG_PREV_LSH_UP_1 ECU_ADDRESS 0xc0001e34 /end MEASUREMENT
/begin MEASUREMENT cdn_diag_prev_sof "Diagnostic condition of last failure symptom" UBYTE _CNV_A_R_LINEAR_____0_CM 1 100. 0. 255. DISPLAY_IDENTIFIER CDN_DIAG_PREV_SOF ECU_ADDRESS 0xc0001e35 /end MEASUREMENT
/begin MEASUREMENT cdn_diag_prev_rly_crcv_heat "Diagnostic condition of last failure symptom" UBYTE _CNV_A_R_LINEAR_____0_CM 1 100. 0. 255. DISPLAY_IDENTIFIER CDN_DIAG_PREV_RLY_CRCV_HEAT ECU_ADDRESS 0xc0001e36 /end MEASUREMENT
/begin MEASUREMENT cdn_diag_prev_lsh_up_2 "Diagnostic condition of last failure symptom" UBYTE _CNV_A_R_LINEAR_____0_CM 1 100. 0. 255. DISPLAY_IDENTIFIER CDN_DIAG_PREV_LSH_UP_2 ECU_ADDRESS 0xc0001e37 /end MEASUREMENT
/begin MEASUREMENT cdn_diag_prev_lsh_down_1 "Diagnostic condition of last failure symptom" UBYTE _CNV_A_R_LINEAR_____0_CM 1 100. 0. 255. DISPLAY_IDENTIFIER CDN_DIAG_PREV_LSH_DOWN_1 ECU_ADDRESS 0xc0001e38 /end MEASUREMENT
/begin MEASUREMENT cdn_diag_prev_lsh_down_2 "Diagnostic condition of last failure symptom" UBYTE _CNV_A_R_LINEAR_____0_CM 1 100. 0. 255. DISPLAY_IDENTIFIER CDN_DIAG_PREV_LSH_DOWN_2 ECU_ADDRESS 0xc0001e39 /end MEASUREMENT
/begin MEASUREMENT cdn_diag_prev_el_cps "Diagnostic condition of last failure symptom" UBYTE _CNV_A_R_LINEAR_____0_CM 1 100. 0. 255. DISPLAY_IDENTIFIER CDN_DIAG_PREV_EL_CPS ECU_ADDRESS 0xc0001e3a /end MEASUREMENT
/begin MEASUREMENT cdn_diag_prev_ect_el "Diagnostic condition of last failure symptom" UBYTE _CNV_A_R_LINEAR_____0_CM 1 100. 0. 255. DISPLAY_IDENTIFIER CDN_DIAG_PREV_ECT_EL ECU_ADDRESS 0xc0001e3b /end MEASUREMENT
/begin MEASUREMENT cdn_diag_prev_vim_1_el "Diagnostic condition of last failure symptom" UBYTE _CNV_A_R_LINEAR_____0_CM 1 100. 0. 255. DISPLAY_IDENTIFIER CDN_DIAG_PREV_VIM_1_EL ECU_ADDRESS 0xc0001e3c /end MEASUREMENT
/begin MEASUREMENT cdn_diag_prev_vim_2_el "Diagnostic condition of last failure symptom" UBYTE _CNV_A_R_LINEAR_____0_CM 1 100. 0. 255. DISPLAY_IDENTIFIER CDN_DIAG_PREV_VIM_2_EL ECU_ADDRESS 0xc0001e3d /end MEASUREMENT
/begin MEASUREMENT cdn_diag_prev_slv_ivvt_in "Diagnostic condition of last failure symptom" UBYTE _CNV_A_R_LINEAR_____0_CM 1 100. 0. 255. DISPLAY_IDENTIFIER CDN_DIAG_PREV_SLV_IVVT_IN ECU_ADDRESS 0xc0001e3e /end MEASUREMENT
/begin MEASUREMENT cdn_diag_prev_slv_ivvt_ex "Diagnostic condition of last failure symptom" UBYTE _CNV_A_R_LINEAR_____0_CM 1 100. 0. 255. DISPLAY_IDENTIFIER CDN_DIAG_PREV_SLV_IVVT_EX ECU_ADDRESS 0xc0001e3f /end MEASUREMENT
/begin MEASUREMENT cdn_diag_prev_ecf_el_1 "Diagnostic condition of last failure symptom" UBYTE _CNV_A_R_LINEAR_____0_CM 1 100. 0. 255. DISPLAY_IDENTIFIER CDN_DIAG_PREV_ECF_EL_1 ECU_ADDRESS 0xc0001e40 /end MEASUREMENT
/begin MEASUREMENT cdn_diag_prev_rly_efp "Diagnostic condition of last failure symptom" UBYTE _CNV_A_R_LINEAR_____0_CM 1 100. 0. 255. DISPLAY_IDENTIFIER CDN_DIAG_PREV_RLY_EFP ECU_ADDRESS 0xc0001e41 /end MEASUREMENT
/begin MEASUREMENT cdn_diag_prev_vcv "Diagnostic condition of last failure symptom" UBYTE _CNV_A_R_LINEAR_____0_CM 1 100. 0. 255. DISPLAY_IDENTIFIER CDN_DIAG_PREV_VCV ECU_ADDRESS 0xc0001e42 /end MEASUREMENT
/begin MEASUREMENT cdn_diag_prev_iv_0 "Diagnostic condition of last failure symptom" UBYTE _CNV_A_R_LINEAR_____0_CM 1 100. 0. 255. DISPLAY_IDENTIFIER CDN_DIAG_PREV_IV_0 ECU_ADDRESS 0xc0001e43 /end MEASUREMENT
/begin MEASUREMENT cdn_diag_prev_iv_1 "Diagnostic condition of last failure symptom" UBYTE _CNV_A_R_LINEAR_____0_CM 1 100. 0. 255. DISPLAY_IDENTIFIER CDN_DIAG_PREV_IV_1 ECU_ADDRESS 0xc0001e44 /end MEASUREMENT
/begin MEASUREMENT cdn_diag_prev_iv_2 "Diagnostic condition of last failure symptom" UBYTE _CNV_A_R_LINEAR_____0_CM 1 100. 0. 255. DISPLAY_IDENTIFIER CDN_DIAG_PREV_IV_2 ECU_ADDRESS 0xc0001e45 /end MEASUREMENT
/begin MEASUREMENT cdn_diag_prev_iv_3 "Diagnostic condition of last failure symptom" UBYTE _CNV_A_R_LINEAR_____0_CM 1 100. 0. 255. DISPLAY_IDENTIFIER CDN_DIAG_PREV_IV_3 ECU_ADDRESS 0xc0001e46 /end MEASUREMENT
/begin MEASUREMENT cdn_diag_prev_iv_4 "Diagnostic condition of last failure symptom" UBYTE _CNV_A_R_LINEAR_____0_CM 1 100. 0. 255. DISPLAY_IDENTIFIER CDN_DIAG_PREV_IV_4 ECU_ADDRESS 0xc0001e47 /end MEASUREMENT
/begin MEASUREMENT cdn_diag_prev_iv_5 "Diagnostic condition of last failure symptom" UBYTE _CNV_A_R_LINEAR_____0_CM 1 100. 0. 255. DISPLAY_IDENTIFIER CDN_DIAG_PREV_IV_5 ECU_ADDRESS 0xc0001e48 /end MEASUREMENT
/begin MEASUREMENT ctr_err_intm_nr "Number of failures stored in intermittent failures array" UBYTE _CNV_A_R_LINEAR_____0_CM 1 100. 0. 255. DISPLAY_IDENTIFIER CTR_ERR_INTM_NR ECU_ADDRESS 0xd0002e60 FORMAT "%3.0" /end MEASUREMENT
/begin CHARACTERISTIC lc_err_intm_clr "Reset array of intermittent failures" VALUE 0xa10051d8 _REC_VAL_20_u1 1. _CNV_A_R_LINEAR_____0_CM 0. 1. DISPLAY_IDENTIFIER LC_ERR_INTM_CLR FORMAT "%1.0" /end CHARACTERISTIC
/begin MEASUREMENT err_intm_ctr_frc[0] "Frequency of reappearence of failure stored in ERR_INTM_DIAG_INST[NC_NR_ERR_INTM]" UBYTE _CNV_A_R_LINEAR_____0_CM 1 100. 0. 255. DISPLAY_IDENTIFIER ERR_INTM_CTR_FRC[0] ECU_ADDRESS 0xd0002e64 FORMAT "%3.0" /end MEASUREMENT
/begin MEASUREMENT err_intm_ctr_frc[1] "Frequency of reappearence of failure stored in ERR_INTM_DIAG_INST[NC_NR_ERR_INTM]" UBYTE _CNV_A_R_LINEAR_____0_CM 1 100. 0. 255. DISPLAY_IDENTIFIER ERR_INTM_CTR_FRC[1] ECU_ADDRESS 0xd0002e65 FORMAT "%3.0" /end MEASUREMENT
/begin MEASUREMENT err_intm_ctr_frc[2] "Frequency of reappearence of failure stored in ERR_INTM_DIAG_INST[NC_NR_ERR_INTM]" UBYTE _CNV_A_R_LINEAR_____0_CM 1 100. 0. 255. DISPLAY_IDENTIFIER ERR_INTM_CTR_FRC[2] ECU_ADDRESS 0xd0002e66 FORMAT "%3.0" /end MEASUREMENT
/begin MEASUREMENT err_intm_ctr_frc[3] "Frequency of reappearence of failure stored in ERR_INTM_DIAG_INST[NC_NR_ERR_INTM]" UBYTE _CNV_A_R_LINEAR_____0_CM 1 100. 0. 255. DISPLAY_IDENTIFIER ERR_INTM_CTR_FRC[3] ECU_ADDRESS 0xd0002e67 FORMAT "%3.0" /end MEASUREMENT
/begin MEASUREMENT err_intm_ctr_frc[4] "Frequency of reappearence of failure stored in ERR_INTM_DIAG_INST[NC_NR_ERR_INTM]" UBYTE _CNV_A_R_LINEAR_____0_CM 1 100. 0. 255. DISPLAY_IDENTIFIER ERR_INTM_CTR_FRC[4] ECU_ADDRESS 0xd0002e68 FORMAT "%3.0" /end MEASUREMENT
/begin MEASUREMENT err_intm_ctr_frc[5] "Frequency of reappearence of failure stored in ERR_INTM_DIAG_INST[NC_NR_ERR_INTM]" UBYTE _CNV_A_R_LINEAR_____0_CM 1 100. 0. 255. DISPLAY_IDENTIFIER ERR_INTM_CTR_FRC[5] ECU_ADDRESS 0xd0002e69 FORMAT "%3.0" /end MEASUREMENT
/begin MEASUREMENT err_intm_ctr_frc[6] "Frequency of reappearence of failure stored in ERR_INTM_DIAG_INST[NC_NR_ERR_INTM]" UBYTE _CNV_A_R_LINEAR_____0_CM 1 100. 0. 255. DISPLAY_IDENTIFIER ERR_INTM_CTR_FRC[6] ECU_ADDRESS 0xd0002e6a FORMAT "%3.0" /end MEASUREMENT
/begin MEASUREMENT err_intm_ctr_frc[7] "Frequency of reappearence of failure stored in ERR_INTM_DIAG_INST[NC_NR_ERR_INTM]" UBYTE _CNV_A_R_LINEAR_____0_CM 1 100. 0. 255. DISPLAY_IDENTIFIER ERR_INTM_CTR_FRC[7] ECU_ADDRESS 0xd0002e6b FORMAT "%3.0" /end MEASUREMENT
/begin MEASUREMENT err_intm_ctr_frc[8] "Frequency of reappearence of failure stored in ERR_INTM_DIAG_INST[NC_NR_ERR_INTM]" UBYTE _CNV_A_R_LINEAR_____0_CM 1 100. 0. 255. DISPLAY_IDENTIFIER ERR_INTM_CTR_FRC[8] ECU_ADDRESS 0xd0002e6c FORMAT "%3.0" /end MEASUREMENT
/begin MEASUREMENT err_intm_ctr_frc[9] "Frequency of reappearence of failure stored in ERR_INTM_DIAG_INST[NC_NR_ERR_INTM]" UBYTE _CNV_A_R_LINEAR_____0_CM 1 100. 0. 255. DISPLAY_IDENTIFIER ERR_INTM_CTR_FRC[9] ECU_ADDRESS 0xd0002e6d FORMAT "%3.0" /end MEASUREMENT
/begin MEASUREMENT err_intm_diag_inst[0] "Array of diagnosis instances with intermittent failure" UWORD _CNV_S_311_ERRM_RANGE_486_CM 1 100. 0. 310. DISPLAY_IDENTIFIER ERR_INTM_DIAG_INST[0] ECU_ADDRESS 0xd00025f4 /end MEASUREMENT
/begin MEASUREMENT err_intm_diag_inst[1] "Array of diagnosis instances with intermittent failure" UWORD _CNV_S_311_ERRM_RANGE_486_CM 1 100. 0. 310. DISPLAY_IDENTIFIER ERR_INTM_DIAG_INST[1] ECU_ADDRESS 0xd00025f6 /end MEASUREMENT
/begin MEASUREMENT err_intm_diag_inst[2] "Array of diagnosis instances with intermittent failure" UWORD _CNV_S_311_ERRM_RANGE_486_CM 1 100. 0. 310. DISPLAY_IDENTIFIER ERR_INTM_DIAG_INST[2] ECU_ADDRESS 0xd00025f8 /end MEASUREMENT
/begin MEASUREMENT err_intm_diag_inst[3] "Array of diagnosis instances with intermittent failure" UWORD _CNV_S_311_ERRM_RANGE_486_CM 1 100. 0. 310. DISPLAY_IDENTIFIER ERR_INTM_DIAG_INST[3] ECU_ADDRESS 0xd00025fa /end MEASUREMENT
/begin MEASUREMENT err_intm_diag_inst[4] "Array of diagnosis instances with intermittent failure" UWORD _CNV_S_311_ERRM_RANGE_486_CM 1 100. 0. 310. DISPLAY_IDENTIFIER ERR_INTM_DIAG_INST[4] ECU_ADDRESS 0xd00025fc /end MEASUREMENT
/begin MEASUREMENT err_intm_diag_inst[5] "Array of diagnosis instances with intermittent failure" UWORD _CNV_S_311_ERRM_RANGE_486_CM 1 100. 0. 310. DISPLAY_IDENTIFIER ERR_INTM_DIAG_INST[5] ECU_ADDRESS 0xd00025fe /end MEASUREMENT
/begin MEASUREMENT err_intm_diag_inst[6] "Array of diagnosis instances with intermittent failure" UWORD _CNV_S_311_ERRM_RANGE_486_CM 1 100. 0. 310. DISPLAY_IDENTIFIER ERR_INTM_DIAG_INST[6] ECU_ADDRESS 0xd0002600 /end MEASUREMENT
/begin MEASUREMENT err_intm_diag_inst[7] "Array of diagnosis instances with intermittent failure" UWORD _CNV_S_311_ERRM_RANGE_486_CM 1 100. 0. 310. DISPLAY_IDENTIFIER ERR_INTM_DIAG_INST[7] ECU_ADDRESS 0xd0002602 /end MEASUREMENT
/begin MEASUREMENT err_intm_diag_inst[8] "Array of diagnosis instances with intermittent failure" UWORD _CNV_S_311_ERRM_RANGE_486_CM 1 100. 0. 310. DISPLAY_IDENTIFIER ERR_INTM_DIAG_INST[8] ECU_ADDRESS 0xd0002604 /end MEASUREMENT
/begin MEASUREMENT err_intm_diag_inst[9] "Array of diagnosis instances with intermittent failure" UWORD _CNV_S_311_ERRM_RANGE_486_CM 1 100. 0. 310. DISPLAY_IDENTIFIER ERR_INTM_DIAG_INST[9] ECU_ADDRESS 0xd0002606 /end MEASUREMENT
/begin CHARACTERISTIC c_err_intm_clr_ini "Control of different init possibilities of array of intermittent failures" VALUE 0xa10051c5 _REC_VAL_20_u1 7. _CNV_A_R_LINEAR_____0_CM 0. 7. DISPLAY_IDENTIFIER C_ERR_INTM_CLR_INI FORMAT "%3.0" /end CHARACTERISTIC
/begin CHARACTERISTIC c_state_ready_obd_1 "Status configuration for readiness code (continuous tests)" VALUE 0xa10051c6 _REC_VAL_20_u1 255. _CNV_A_R_LINEAR_____0_CM 0. 255. DISPLAY_IDENTIFIER C_STATE_READY_OBD_1 FORMAT "%3.0" /end CHARACTERISTIC
/begin CHARACTERISTIC c_state_ready_obd_2 "Status configuration for readiness code (non continuous tests)" VALUE 0xa10051c7 _REC_VAL_20_u1 255. _CNV_A_R_LINEAR_____0_CM 0. 255. DISPLAY_IDENTIFIER C_STATE_READY_OBD_2 FORMAT "%3.0" /end CHARACTERISTIC
/begin MEASUREMENT idx_tmp_rbm "temporary current position of the monitor with the lowest ratio" UBYTE _CNV_A_R_LINEAR_____0_CM 1 100. 0. 255. DISPLAY_IDENTIFIER IDX_TMP_RBM ECU_ADDRESS 0xc0001dfb FORMAT "%3.0" /end MEASUREMENT
/begin MEASUREMENT ratio_tmp_rbm "temporary variable used to store lowest Numerator/Denominator ratio" UWORD _CNV_A_R_LINEAR_____113_CM 1 100. 0. 7.9998779296875 DISPLAY_IDENTIFIER RATIO_TMP_RBM ECU_ADDRESS 0xc0001de2 FORMAT "%6.4" /end MEASUREMENT
/begin MEASUREMENT state_mil "State of MIL illumination commanded by error management (ON(1), OFF(0), MIL_FLL(2))" UBYTE _CNV_S_3_ERRM_RANGE_487_CM 1 100. 0. 2. DISPLAY_IDENTIFIER STATE_MIL ECU_ADDRESS 0xd0003545 /end MEASUREMENT
/begin MEASUREMENT lv_wal_2 "Boolean indicating WAL_2 physical output (0 : off / 1 : on)" UBYTE _CNV_S_2_RANGE__0___1_CM 1 100. 0. 1. DISPLAY_IDENTIFIER LV_WAL_2 ECU_ADDRESS 0xd0003552 BIT_MASK 0x1 /end MEASUREMENT
/begin MEASUREMENT state_wal_1 "State of WAL_1 illumination commanded by error management (ON(1), OFF(0))" UBYTE _CNV_S_3_ERRM_RANGE_487_CM 1 100. 0. 2. DISPLAY_IDENTIFIER STATE_WAL_1 ECU_ADDRESS 0xd0003548 /end MEASUREMENT
/begin MEASUREMENT state_wal_2 "State of WAL_2 illumination commanded by error management (ON(1), OFF(0))" UBYTE _CNV_S_3_ERRM_RANGE_487_CM 1 100. 0. 2. DISPLAY_IDENTIFIER STATE_WAL_2 ECU_ADDRESS 0xd0003549 /end MEASUREMENT
/begin CHARACTERISTIC c_conf_mil "Configuration of MIL" VALUE 0xa10051bc _REC_VAL_20_u1 255. _CNV_A_R_LINEAR_____0_CM 0. 255. DISPLAY_IDENTIFIER C_CONF_MIL FORMAT "%3.0" /end CHARACTERISTIC
/begin CHARACTERISTIC c_conf_wal_1 "Configuration of warning lamp 1 (WAL_1)" VALUE 0xa10051bd _REC_VAL_20_u1 255. _CNV_A_R_LINEAR_____0_CM 0. 255. DISPLAY_IDENTIFIER C_CONF_WAL_1 FORMAT "%3.0" /end CHARACTERISTIC
/begin CHARACTERISTIC c_conf_wal_2 "Configuration of warning lamp 2 (WAL_2)" VALUE 0xa10051be _REC_VAL_20_u1 255. _CNV_A_R_LINEAR_____0_CM 0. 255. DISPLAY_IDENTIFIER C_CONF_WAL_2 FORMAT "%3.0" /end CHARACTERISTIC
/begin CHARACTERISTIC lc_inh_wal_st "Bolean to inhibit illumination of all lamps during pre-drive check mode" VALUE 0xa10051d9 _REC_VAL_20_u1 1. _CNV_A_R_LINEAR_____0_CM 0. 1. DISPLAY_IDENTIFIER LC_INH_WAL_ST FORMAT "%1.0" /end CHARACTERISTIC
/begin CHARACTERISTIC c_dly_inh_iv_mis "Delay for MIL blinking in case of misfiring present failure with cylinder cut off" VALUE 0xa10051c2 _REC_VAL_20_u1 25.5 _CNV_A_R_LINEAR_____4_CM 0. 25.5 DISPLAY_IDENTIFIER C_DLY_INH_IV_MIS FORMAT "%4.1" /end CHARACTERISTIC
/begin MEASUREMENT lv_wal_1 "Boolean indicating WAL_1 physical output (0 : off / 1 : on)" UBYTE _CNV_S_2_RANGE__0___1_CM 1 100. 0. 1. DISPLAY_IDENTIFIER LV_WAL_1 ECU_ADDRESS 0xd0003551 BIT_MASK 0x1 /end MEASUREMENT
/begin MEASUREMENT lv_wal_st "Boolean indicating Pre-drive check mode (0 : off / 1 : on)" UBYTE _CNV_S_2_RANGE__0___1_CM 1 100. 0. 1. DISPLAY_IDENTIFIER LV_WAL_ST ECU_ADDRESS 0xd0003553 BIT_MASK 0x1 /end MEASUREMENT
/begin MEASUREMENT dly_mil_ready "Delay time to enable MIL blinking during pre-drive check mode" UWORD _CNV_A_R_LINEAR_____253_CM 1 100. 0. 32767.5 DISPLAY_IDENTIFIER DLY_MIL_READY ECU_ADDRESS 0xc0001de0 FORMAT "%8.1" /end MEASUREMENT
/begin CHARACTERISTIC c_dly_mil_ready_2 "MIL blink duration for readiness display during pre-drive check" VALUE 0xa10051c4 _REC_VAL_20_u1 127.5 _CNV_A_R_LINEAR_____253_CM 0. 127.5 DISPLAY_IDENTIFIER C_DLY_MIL_READY_2 FORMAT "%5.1" /end CHARACTERISTIC
/begin CHARACTERISTIC c_dly_mil_ready_1 "Delay to start MIL blinking for readiness display during pre-drive check" VALUE 0xa10051c3 _REC_VAL_20_u1 127.5 _CNV_A_R_LINEAR_____253_CM 0. 127.5 DISPLAY_IDENTIFIER C_DLY_MIL_READY_1 FORMAT "%5.1" /end CHARACTERISTIC
/begin MEASUREMENT lv_mil "Boolean indicating MIL physical output (0 : off / 1 : on)" UBYTE _CNV_S_2_RANGE__0___1_CM 1 100. 0. 1. DISPLAY_IDENTIFIER LV_MIL ECU_ADDRESS 0xd000354e BIT_MASK 0x1 /end MEASUREMENT
/begin MEASUREMENT lv_mil_wup "Flag that indicate a MIL activation during the current WUP" UBYTE _CNV_S_2_RANGE__0___1_CM 1 100. 0. 1. DISPLAY_IDENTIFIER LV_MIL_WUP ECU_ADDRESS 0xc0001e02 BIT_MASK 0x1 /end MEASUREMENT
/begin MEASUREMENT lv_wal_1_wup "Flag that indicate a WAL_1 activation during the current WUP" UBYTE _CNV_S_2_RANGE__0___1_CM 1 100. 0. 1. DISPLAY_IDENTIFIER LV_WAL_1_WUP ECU_ADDRESS 0xc0001e03 BIT_MASK 0x1 /end MEASUREMENT
/begin MEASUREMENT lv_wal_2_wup "Flag that indicate a WAL_2 activation during the current WUP" UBYTE _CNV_S_2_RANGE__0___1_CM 1 100. 0. 1. DISPLAY_IDENTIFIER LV_WAL_2_WUP ECU_ADDRESS 0xc0001e04 BIT_MASK 0x1 /end MEASUREMENT
/begin MEASUREMENT lv_mil_fll_ready "" UBYTE _CNV_S_2_RANGE__0___1_CM 1 100. 0. 1. DISPLAY_IDENTIFIER LV_MIL_FLL_READY ECU_ADDRESS 0xc0001e01 BIT_MASK 0x1 /end MEASUREMENT
/begin CHARACTERISTIC lc_ena_scdn "Boolean to indicate if similar conditions are inhibited (0) or not (1)" VALUE 0xa10051d5 _REC_VAL_20_u1 1. _CNV_A_R_LINEAR_____0_CM 0. 1. DISPLAY_IDENTIFIER LC_ENA_SCDN FORMAT "%1.0" /end CHARACTERISTIC
/begin CHARACTERISTIC c_ctr_scdn_equ_dc_max "Maximum value of the driving cycle counter for similar conditions erase" VALUE 0xa10051dc _REC_VAL_20_u1 255. _CNV_A_R_LINEAR_____0_CM 0. 255. DISPLAY_IDENTIFIER C_CTR_SCDN_EQU_DC_MAX FORMAT "%3.0" /end CHARACTERISTIC
/begin CHARACTERISTIC c_n_scdn_equ "engine speed threshold for similar conditions detection (375 rpm)" VALUE 0xa10051de _REC_VAL_20_u2 8160. _CNV_A_R_LINEAR_____13_CM 0. 8160. DISPLAY_IDENTIFIER C_N_SCDN_EQU FORMAT "%4.0" /end CHARACTERISTIC
/begin CHARACTERISTIC c_load_scdn_equ "LOAD value for similar conditions detection (typical 20%)" VALUE 0xa10051dd _REC_VAL_20_u1 99.609375 _CNV_A_R_LINEAR_____5_CM 0. 99.609375 DISPLAY_IDENTIFIER C_LOAD_SCDN_EQU FORMAT "%9.6" /end CHARACTERISTIC
/begin MEASUREMENT dist_act_mil "Global distance traveled while the MIL is illuminated" UWORD _CNV_A_R_LINEAR_____52_CM 1 100. 0. 65535. DISPLAY_IDENTIFIER DIST_ACT_MIL ECU_ADDRESS 0xd0004a20 FORMAT "%5.0" /end MEASUREMENT
/begin MEASUREMENT dist_dtc_clr "Distance since DTC cleared up to 65535 Kms max" UWORD _CNV_A_R_LINEAR_____52_CM 1 100. 0. 65535. DISPLAY_IDENTIFIER DIST_DTC_CLR ECU_ADDRESS 0xd0004a26 FORMAT "%5.0" /end MEASUREMENT
/begin MEASUREMENT dist_rel_dtc_clr "Distance at event DTC cleared up to 65535 Kms max" ULONG _CNV_A_R_LINEAR_____52_CM 1 100. 0. 4294967295. DISPLAY_IDENTIFIER DIST_REL_DTC_CLR ECU_ADDRESS 0xc0001df4 FORMAT "%11.1" /end MEASUREMENT
/begin MEASUREMENT ctr_wup_dtc_clr "Number of WUP since DTC cleared" UBYTE _CNV_A_R_LINEAR_____0_CM 1 100. 0. 255. DISPLAY_IDENTIFIER CTR_WUP_DTC_CLR ECU_ADDRESS 0xd0003542 FORMAT "%3.0" /end MEASUREMENT
/begin MEASUREMENT dist_act_wal_2 "Global distance traveled while the WAL_2 is illuminated" UWORD _CNV_A_R_LINEAR_____52_CM 1 100. 0. 65535. DISPLAY_IDENTIFIER DIST_ACT_WAL_2 ECU_ADDRESS 0xd0004a24 FORMAT "%5.0" /end MEASUREMENT
/begin MEASUREMENT dist_act_wal_1 "Global distance traveled while the WAL_1 is illuminated" UWORD _CNV_A_R_LINEAR_____52_CM 1 100. 0. 65535. DISPLAY_IDENTIFIER DIST_ACT_WAL_1 ECU_ADDRESS 0xd0004a22 FORMAT "%5.0" /end MEASUREMENT
/begin MEASUREMENT lv_dc "driving cycle status flag" UBYTE _CNV_S_2_RANGE__0___1_CM 1 100. 0. 1. DISPLAY_IDENTIFIER LV_DC ECU_ADDRESS 0xd000354c BIT_MASK 0x1 /end MEASUREMENT
/begin MEASUREMENT lv_wup_cyc "warm-up cycle status flag" UBYTE _CNV_S_2_RANGE__0___1_CM 1 100. 0. 1. DISPLAY_IDENTIFIER LV_WUP_CYC ECU_ADDRESS 0xd0003554 BIT_MASK 0x1 /end MEASUREMENT
/begin MEASUREMENT lv_state_wup "tco state for exceeding the warm-up cycle tco threshold" UBYTE _CNV_S_2_RANGE__0___1_CM 1 100. 0. 1. DISPLAY_IDENTIFIER LV_STATE_WUP ECU_ADDRESS 0xd0003550 BIT_MASK 0x1 /end MEASUREMENT
/begin CHARACTERISTIC c_tco_wup_thd "minimum vlaue for warm-up cycle detection." VALUE 0xa10051d0 _REC_VAL_20_u1 190.5 _CNV_A_R_LINEAR_____16_CM -48. 142.5 DISPLAY_IDENTIFIER C_TCO_WUP_THD FORMAT "%6.2" /end CHARACTERISTIC
/begin CHARACTERISTIC c_tco_wup_inc "minimum increase of the coolant temperature for warm-up cycle detection." VALUE 0xa10051cf _REC_VAL_20_u1 190.5 _CNV_A_R_LINEAR_____16_CM -48. 142.5 DISPLAY_IDENTIFIER C_TCO_WUP_INC FORMAT "%6.2" /end CHARACTERISTIC
/begin CHARACTERISTIC id_clas_a_fmt "Sub Class A definition" CURVE 0xa1005124 _REC_CUR_20_u1_u2 255. _CNV_A_R_LINEAR_____0_CM 0. 255. DISPLAY_IDENTIFIER ID_CLAS_A_FMT FORMAT "%3.0"
 /begin AXIS_DESCR COM_AXIS errm_online_dummy _CNV_A_R_LINEAR_____0_CM 16 0. 65535. FORMAT "%5.0" AXIS_PTS_REF ldpm_clas_a_id_clas_fmy /end AXIS_DESCR
/end CHARACTERISTIC
/begin CHARACTERISTIC id_clas_b_fmt "Sub Class B definition" MAP 0xa1005134 _REC_MAP_20_u1_u2_u2 255. _CNV_A_R_LINEAR_____0_CM 0. 255. DISPLAY_IDENTIFIER ID_CLAS_B_FMT FORMAT "%3.0"
 /begin AXIS_DESCR COM_AXIS errm_online_dummy _CNV_A_R_LINEAR_____0_CM 16 0. 65535. FORMAT "%5.0" AXIS_PTS_REF ldpm_clas_a_id_clas_fmy /end AXIS_DESCR
 /begin AXIS_DESCR COM_AXIS errm_online_dummy _CNV_A_R_LINEAR_____0_CM 4 0. 65535. FORMAT "%5.0" AXIS_PTS_REF ldp_clas_b_id_clas_fmy /end AXIS_DESCR
/end CHARACTERISTIC
/begin AXIS_PTS ldpm_clas_a_id_clas_fmy "" 0xa10038b0 errm_online_dummy _REC_AXS_20_u2 65535. _CNV_A_R_LINEAR_____0_CM 16 0. 65535. FORMAT "%5.0" /end AXIS_PTS
/begin AXIS_PTS ldp_clas_b_id_clas_fmy "" 0xa1003870 errm_online_dummy _REC_AXS_20_u2 65535. _CNV_A_R_LINEAR_____0_CM 4 0. 65535. FORMAT "%5.0" /end AXIS_PTS
/begin CHARACTERISTIC lc_abc_bench "logical constant to manage the anti-bounce bench mode" VALUE 0xa10051d3 _REC_VAL_20_u1 1. _CNV_A_R_LINEAR_____0_CM 0. 1. DISPLAY_IDENTIFIER LC_ABC_BENCH FORMAT "%1.0" /end CHARACTERISTIC
/begin CHARACTERISTIC lc_err_det_upd "Logical constant to manage the visualisation of the sporadic error" VALUE 0xa10051d6 _REC_VAL_20_u1 1. _CNV_A_R_LINEAR_____0_CM 0. 1. DISPLAY_IDENTIFIER LC_ERR_DET_UPD FORMAT "%1.0" /end CHARACTERISTIC
/begin CHARACTERISTIC lc_clr_his_fmy "Set this calibration to 1 for clearing the history memory" VALUE 0xa10051d4 _REC_VAL_20_u1 1. _CNV_A_R_LINEAR_____0_CM 0. 1. DISPLAY_IDENTIFIER LC_CLR_HIS_FMY FORMAT "%1.0" /end CHARACTERISTIC
/begin MEASUREMENT ctr_err_his_nr "Number of failures stored in the history memory" UBYTE _CNV_A_R_LINEAR_____0_CM 1 100. 0. 255. DISPLAY_IDENTIFIER CTR_ERR_HIS_NR ECU_ADDRESS 0xd0003541 FORMAT "%3.0" /end MEASUREMENT
/begin MEASUREMENT fmy_his_cod[0] "DTC of failure in history memory" UWORD _CNV_A_R_LINEAR_____0_CM 1 100. 0. 65535. DISPLAY_IDENTIFIER HIS_COD[1] ECU_ADDRESS 0xd0004a2c FORMAT "%5.0" /end MEASUREMENT
/begin MEASUREMENT fmy_his_cod[1] "DTC of failure in history memory" UWORD _CNV_A_R_LINEAR_____0_CM 1 100. 0. 65535. DISPLAY_IDENTIFIER HIS_COD[2] ECU_ADDRESS 0xd0004a2e FORMAT "%5.0" /end MEASUREMENT
/begin MEASUREMENT fmy_his_cod[2] "DTC of failure in history memory" UWORD _CNV_A_R_LINEAR_____0_CM 1 100. 0. 65535. DISPLAY_IDENTIFIER HIS_COD[3] ECU_ADDRESS 0xd0004a30 FORMAT "%5.0" /end MEASUREMENT
/begin MEASUREMENT fmy_his_cod[3] "DTC of failure in history memory" UWORD _CNV_A_R_LINEAR_____0_CM 1 100. 0. 65535. DISPLAY_IDENTIFIER HIS_COD[4] ECU_ADDRESS 0xd0004a32 FORMAT "%5.0" /end MEASUREMENT
/begin MEASUREMENT fmy_his_cod[4] "DTC of failure in history memory" UWORD _CNV_A_R_LINEAR_____0_CM 1 100. 0. 65535. DISPLAY_IDENTIFIER HIS_COD[5] ECU_ADDRESS 0xd0004a34 FORMAT "%5.0" /end MEASUREMENT
/begin MEASUREMENT fmy_his_cod[5] "DTC of failure in history memory" UWORD _CNV_A_R_LINEAR_____0_CM 1 100. 0. 65535. DISPLAY_IDENTIFIER HIS_COD[6] ECU_ADDRESS 0xd0004a36 FORMAT "%5.0" /end MEASUREMENT
/begin MEASUREMENT fmy_his_cod[6] "DTC of failure in history memory" UWORD _CNV_A_R_LINEAR_____0_CM 1 100. 0. 65535. DISPLAY_IDENTIFIER HIS_COD[7] ECU_ADDRESS 0xd0004a38 FORMAT "%5.0" /end MEASUREMENT
/begin MEASUREMENT fmy_his_cod[7] "DTC of failure in history memory" UWORD _CNV_A_R_LINEAR_____0_CM 1 100. 0. 65535. DISPLAY_IDENTIFIER HIS_COD[8] ECU_ADDRESS 0xd0004a3a FORMAT "%5.0" /end MEASUREMENT
/begin MEASUREMENT fmy_his_cod[8] "DTC of failure in history memory" UWORD _CNV_A_R_LINEAR_____0_CM 1 100. 0. 65535. DISPLAY_IDENTIFIER HIS_COD[9] ECU_ADDRESS 0xd0004a3c FORMAT "%5.0" /end MEASUREMENT
/begin MEASUREMENT fmy_his_cod[9] "DTC of failure in history memory" UWORD _CNV_A_R_LINEAR_____0_CM 1 100. 0. 65535. DISPLAY_IDENTIFIER HIS_COD[10] ECU_ADDRESS 0xd0004a3e FORMAT "%5.0" /end MEASUREMENT
/begin COMPU_METHOD _CNV_A_R_LINEAR_____0_CM "" RAT_FUNC "%6.3" "-" COEFFS 0 1. 0. 0 0 1 /end COMPU_METHOD
/begin COMPU_METHOD _CNV_S_2_RANGE__0___1_CM "" TAB_VERB "%6.3" "-" COMPU_TAB_REF _CNV_S_2_RANGE__0___1 /end COMPU_METHOD
/begin COMPU_VTAB _CNV_S_2_RANGE__0___1 "" TAB_VERB 2 0 "0" 1 "1" /end COMPU_VTAB
/begin COMPU_METHOD _CNV_A_R_LINEAR_____4_CM "" RAT_FUNC "%6.3" "s" COEFFS 0 10. 0. 0 0 1 /end COMPU_METHOD
/begin COMPU_METHOD _CNV_A_R_LINEAR_____5_CM "" RAT_FUNC "%6.3" "%" COEFFS 0 2.56 0. 0 0 1 /end COMPU_METHOD
/begin COMPU_METHOD _CNV_A_R_LINEAR_____13_CM "" RAT_FUNC "%6.3" "rpm" COEFFS 0 1. 0. 0 0 1 /end COMPU_METHOD
/begin COMPU_METHOD _CNV_A_R_LINEAR_____16_CM "" RAT_FUNC "%6.3" "°C" COEFFS 0 1.333333333333333 64. 0 0 1 /end COMPU_METHOD
/begin COMPU_METHOD _CNV_A_R_LINEAR_____52_CM "" RAT_FUNC "%6.3" "km" COEFFS 0 1. 0. 0 0 1 /end COMPU_METHOD
/begin COMPU_METHOD _CNV_A_R_LINEAR_____113_CM "" RAT_FUNC "%6.3" "-" COEFFS 0 8192. 0. 0 0 1 /end COMPU_METHOD
/begin COMPU_METHOD _CNV_A_R_LINEAR_____253_CM "" RAT_FUNC "%6.3" "s" COEFFS 0 2. 0. 0 0 1 /end COMPU_METHOD
/begin COMPU_METHOD _CNV_S_16_RANGE_ERR__485_CM "" TAB_VERB "%6.3" "-" COMPU_TAB_REF _CNV_S_16_RANGE_ERR__485 /end COMPU_METHOD
/begin COMPU_VTAB _CNV_S_16_RANGE_ERR__485 "" TAB_VERB 16 0 "NO_SYM" 1 "SYM_0" 2 "SYM_1" 3 "SYM_0, SYM_1" 4 "SYM_2" 5 "SYM_0, SYM_2" 6 "SYM_1, SYM_2" 7 "SYM_0, SYM_1, SYM_2" 8 "SYM_3" 9 "SYM_0, SYM_3" 10 "SYM_1, SYM_3" 11 "SYM_0, SYM_1,SYM_3" 12 "SYM_2, SYM_3" 13 "SYM_0, SYM_2, SYM_3" 14 "SYM_1, SYM_2, SYM_3" 15 "SYM_0, SYM_1, SYM_2, SYM_3" /end COMPU_VTAB
/begin COMPU_METHOD _CNV_S_311_ERRM_RANGE_486_CM "" TAB_VERB "%6.3" "" COMPU_TAB_REF _CNV_S_311_ERRM_RANGE_486 /end COMPU_METHOD
/begin COMPU_VTAB _CNV_S_311_ERRM_RANGE_486 "" TAB_VERB 311 0 "NO_ERROR" 1 "IMOB_1" 2 "IMOB_2" 3 "IMOB_3" 4 "TCO_EL" 5 "TCO_GRD" 6 "TCO_STUCK" 7 "TCO_PLAUS" 8 "TCO_2_EL" 9 "TCO_2_GRD" 10 "TCO_2_PLAUS" 11 "ECT_EL" 12 "ECF_EL_1" 13 "ECFPWM_FB_1" 14 "TH" 15 "FTL_MIN" 16 "TIA_EL" 17 "AMP" 18 "AMP_PLAUS" 19 "MAF" 20 "IV_0" 21 "IV_1" 22 "IV_2" 23 "IV_3" 24 "IV_4" 25 "IV_5" 26 "RLY_EFP" 27 "EL_CPS" 28 "SLV_IVVT_IN" 29 "SLV_IVVT_EX" 30 "ECU_CKS" 31 "TOUT_ETCU_1" 32 "TOUT_ETCU_2" 33 "TOUT_ICL_2" 34 "TOUT_ICL_3" 35 "TOUT_ASR_1" 36 "TOUT_ASR_3" 37 "TOUT_ASR_4" 38 "TOUT_PSTE_1" 39 "TOUT_AMT_1" 40 "VS" 41 "KNKS_1" 42 "KNKS_2" 43 "IGC_SCP_0" 44 "IGC_SCP_1" 45 "IGC_SCP_2" 46 "IGC_SCP_3" 47 "IGC_SCP_4" 48 "IGC_SCP_5" 49 "IGC_SCG_0" 50 "IGC_SCG_1" 51 "IGC_SCG_2" 52 "IGC_SCG_3" 53 "IGC_SCG_4" 54 "IGC_SCG_5" 55 "IGC_OL_0" 56 "IGC_OL_1" 57 "IGC_OL_2" 58 "IGC_OL_3" 59 "IGC_OL_4" 60 "IGC_OL_5" 61 "TPS_1" 62 "TPS_2" 63 "TPS_MAF_1" 64 "TPS_MAF_2" 65 "TPS_RATIO" 66 "V_REF_1" 67 "V_REF_2" 68 "PVS_1" 69 "PVS_2" 70 "PVS_RATIO" 71 "PVS_DOUBLE" 72 "PVS_BLS_NOT_PLAUS" 73 "MTC_DR" 74 "MTC_CTL_1" 75 "MTC_CTL_2" 76 "MTC_CTL_3" 77 "TPS_AD" 78 "TPS_AD_BOL" 79 "TPS_ST_CHK_1" 80 "TPS_ST_CHK_2" 81 "GEN" 82 "GEN_DIAG" 83 "ALTER_BN" 84 "ALTER_BN_BAT" 85 "VIM_1_EL" 86 "VIM_2_EL" 87 "VIMPWM_1_FB" 88 "VIMPWM_2_FB" 89 "T_ES" 90 "MAP_DIP_PLAUS" 91 "TOIL_LEVEL" 92 "VIM_PLAUS" 93 "ALTER_BN_RGN" 94 "PER_CAM_IN_1" 95 "PER_CAM_EX_1" 96 "SYN_CAM_IN_1" 97 "SYN_CAM_EX_1" 98 "REF_CRK_CAM_IN_1" 99 "REF_CRK_CAM_EX_1" 100 "CRK_TOOTH" 101 "CRK_TOOTH_PER" 102 "CRK_SYN" 103 "CRK_PLAUS" 104 "PLAUS_CAM_IN_1" 105 "PLAUS_CAM_EX_1" 106 "SYN_CRK_CAM_IN_1" 107 "SYN_CRK_CAM_EX_1" 108 "CAN_BOFF_B" 109 "CAN_BOFF_C" 110 "RLY_MAIN" 111 "RLY_MAIN_DLY" 112 "RLY_ACCOUT" 113 "ISC" 114 "IM_BLS_PLAUS" 115 "IM_BTS_PLAUS" 116 "MSW_TOG" 117 "MSW_2" 118 "MSW_3" 119 "MIS_0" 120 "MIS_1" 121 "MIS_2" 122 "MIS_3" 123 "MIS_4" 124 "MIS_5" 125 "MIS_MPL" 126 "MIS_FTL_L" 127 "FSD_1" 128 "FSD_2" 129 "EF" 130 "TECU" 131 "EBOX_CFA" 132 "ECU_RAM" 133 "TQI_LIM" 134 "OBD2_LSH_DOWN_1" 135 "OBD2_LSH_DOWN_2" 136 "DMTLS" 137 "DMTL_PUMP" 138 "DMTLM" 139 "ROUGH_LEAK" 140 "SMALL_LEAK" 141 "CHK_FUC" 142 "SOF" 143 "SOF_REQ" 144 "RLY_CRCV_HEAT" 145 "RLY_ST" 146 "BSD" 147 "POIL_SWI" 148 "TOUT_EFP_CAN" 149 "DIAGCPS" 150 "DCC" 151 "LDM" 152 "DMTLH" 153 "CS" 154 "SPI_MPS" 155 "SPI_KNK" 156 "BN_TQ_DCC" 157 "BN_TQ_PSTE_2" 158 "BN_ARS" 159 "BN_CAS" 160 "BN_TQ_TCS" 161 "BN_VS_TCS" 162 "BN_TCS" 163 "BN_TQ_ETCU" 164 "BN_ETCU" 165 "BN_ETCU_2" 166 "BN_ETCU_DISP" 167 "BN_TQ_AMT" 168 "BN_ACC" 169 "BN_T_ICL" 170 "BN_VEH_MOD" 171 "BN_KM_ICL" 172 "BN_ICL" 173 "BN_POW_VB" 174 "BN_POW_GEN" 175 "BN_MSW" 176 "BN_ANG_PSTE" 177 "BN_GEAR_REV" 178 "BN_LTG_HDLP_L" 179 "BN_LDM" 180 "BN_TRL" 181 "BN_HIV" 182 "BN_T_CLK" 183 "BN_EFP_CRASH" 184 "BN_EFP" 185 "LOAD_TPS_PLAUS" 186 "EGY_MIN" 187 "EFP_CRASH" 188 "EFP" 189 "LOCAN_BOFF" 190 "CWP_PLAUS" 191 "CWP_INT_OFF" 192 "CWP_PWR" 193 "CWP_COM_PLAUS" 194 "QOIL_SENS" 195 "BAT_SENS" 196 "BAT_SENS_IT" 197 "BAT_SENS_IT_EL" 198 "ECU_NVMY" 199 "GS" 200 "PLAUS_IGK_BN" 201 "TQ_REQ_CAN" 202 "MAP_DIP_SENS" 203 "MEC_IVVT_IN" 204 "MEC_IVVT_EX" 205 "TOUT_NOX_SENS_1" 206 "TOUT_NOX_SENS_2" 207 "VVL_ROT" 208 "RLY_VVL" 209 "NOX_SENS_1" 210 "OVL_ECU_VVL" 211 "DR_SC_VVL" 212 "CRIT_OVL_ECU_VVL" 213 "NOX_SENS_2" 214 "CUR_H_VVL" 215 "TEG_PCAT_DOWN_1" 216 "TEG_PCAT_DOWN_2" 217 "T_SEG_ER" 218 "SEG_AD_ER" 219 "VS_PLAUS" 220 "FTL_OBD" 221 "FTL_CAN" 222 "TIA_PLAUS" 223 "TAM_CAN" 224 "TAM_PLAUS" 225 "MAP_DIP_SHIFT" 226 "CAT_DIAG_1" 227 "CAT_DIAG_2" 228 "CAT_DIAG_AFL_1" 229 "CAT_DIAG_AFL_2" 230 "SCG_LS_DOWN_1" 231 "SCP_LS_DOWN_1" 232 "OC_LS_DOWN_1" 233 "PUC_LS_DOWN_1" 234 "FL_LS_DOWN_1" 235 "LSL_UP_IF_1" 236 "EL_LSL_UP_1" 237 "LSH_UP_1" 238 "LSH_DOWN_1" 239 "VLS_DOWN_DIF_1" 240 "LSH_LSL_UP_1" 241 "AIR_LSL_UP_1" 242 "PUE_LS_DOWN_1" 243 "SWT_LS_DOWN_1" 244 "OBD_LSH_DOWN_1" 245 "DYN_VLD_LS_UP_1" 246 "PUC_VLD_LS_UP_1" 247 "OBD_VLD_LSH_UP_1" 248 "CHK_LS_DOWN_1" 249 "SHIFT_AFL_LSL_UP_1" 250 "SHIFT_AFR_LSL_UP_1" 251 "OC_LSL_UP_1" 252 "DELTA_I_LAM_1" 253 "RGN_NT_LS_DOWN_1" 254 "CHG_LS_DOWN" 255 "SCG_LS_DOWN_2" 256 "SCP_LS_DOWN_2" 257 "OC_LS_DOWN_2" 258 "PUC_LS_DOWN_2" 259 "FL_LS_DOWN_2" 260 "LSL_UP_IF_2" 261 "EL_LSL_UP_2" 262 "LSH_UP_2" 263 "LSH_DOWN_2" 264 "VLS_DOWN_DIF_2" 265 "LSH_LSL_UP_2" 266 "AIR_LSL_UP_2" 267 "PUE_LS_DOWN_2" 268 "SWT_LS_DOWN_2" 269 "OBD_LSH_DOWN_2" 270 "DYN_VLD_LS_UP_2" 271 "PUC_VLD_LS_UP_2" 272 "OBD_VLD_LSH_UP_2" 273 "CHK_LS_DOWN_2" 274 "SHIFT_AFL_LSL_UP_2" 275 "SHIFT_AFR_LSL_UP_2" 276 "OC_LSL_UP_2" 277 "DELTA_I_LAM_2" 278 "RGN_NT_LS_DOWN_2" 279 "CHG_LS_UP" 280 "ALTER_COM" 281 "CWP_COM" 282 "QOIL_COM" 283 "SENS_BAT_SMT_COM" 284 "ECRASPWM_FB" 285 "ECRAS_EL" 286 "WARM_RST" 287 "ACR_AD" 288 "SENS_ACR" 289 "ACR_CTL" 290 "ACR_DR" 291 "VAR_COD" 292 "VEH_POW_VAR" 293 "FUP_MFP_PLAUS" 294 "H_PRS_SYS" 295 "VCV_PLAUS" 296 "FUP" 297 "VCV" 298 "FUP_EFP" 299 "EFPPWM_PLAUS" 300 "L_PRS_SYS" 301 "CONV_MON_1" 302 "N_32_MON_1" 303 "PVS_MON_1" 304 "TQ_DIF_ISC_MON_1" 305 "TQ_REQ_MON_1" 306 "TQ_EXT_MON_1" 307 "TQI_AV_MON_1" 308 "TQI_N_MAX_MON_1" 309 "MFF_MON_1" 310 "CRU_MON_1" /end COMPU_VTAB
/begin COMPU_METHOD _CNV_S_3_ERRM_RANGE_487_CM "" TAB_VERB "%6.3" "-" COMPU_TAB_REF _CNV_S_3_ERRM_RANGE_487 /end COMPU_METHOD
/begin COMPU_VTAB _CNV_S_3_ERRM_RANGE_487 "" TAB_VERB 3 0 "OFF" 1 "ON" 2 "LAMP BLINKING" /end COMPU_VTAB
/begin RECORD_LAYOUT _REC_VAL_20_u1 FNC_VALUES 1 UBYTE COLUMN_DIR DIRECT /end RECORD_LAYOUT
/begin RECORD_LAYOUT _REC_VAL_20_u2 FNC_VALUES 1 UWORD COLUMN_DIR DIRECT /end RECORD_LAYOUT
/begin RECORD_LAYOUT _REC_AXS_20_u2 NO_AXIS_PTS_X 1 UWORD AXIS_PTS_X 2 UWORD INDEX_INCR DIRECT /end RECORD_LAYOUT
/begin RECORD_LAYOUT _REC_CUR_20_u1_u2 FNC_VALUES 1 UBYTE COLUMN_DIR DIRECT /end RECORD_LAYOUT
/begin RECORD_LAYOUT _REC_MAP_20_u1_u2_u2 FNC_VALUES 1 UBYTE COLUMN_DIR DIRECT /end RECORD_LAYOUT
/begin FUNCTION ERRM_Table_of_Failures "Table_of_Failures"
 /begin OUT_MEASUREMENT fmy_stat_delta_i_lam_2.err_info_stat.lv_ready fmy_stat_delta_i_lam_2.err_info_stat.lv_end_diag fmy_stat_delta_i_lam_2.err_info_stat.lv_cdn_diag fmy_stat_delta_i_lam_2.err_info_stat.err_sym fmy_stat_rgn_nt_ls_down_2.ctr_abc fmy_stat_rgn_nt_ls_down_2.ctr_end_diag fmy_stat_rgn_nt_ls_down_2.err_info_stat.lv_err_mem fmy_stat_rgn_nt_ls_down_2.err_info_stat.lv_ready fmy_stat_rgn_nt_ls_down_2.err_info_stat.lv_end_diag fmy_stat_rgn_nt_ls_down_2.err_info_stat.lv_cdn_diag fmy_stat_rgn_nt_ls_down_2.err_info_stat.err_sym fmy_stat_chg_ls_up.ctr_abc fmy_stat_chg_ls_up.ctr_end_diag fmy_stat_chg_ls_up.err_info_stat.lv_err_mem fmy_stat_chg_ls_up.err_info_stat.lv_ready fmy_stat_chg_ls_up.err_info_stat.lv_end_diag fmy_stat_chg_ls_up.err_info_stat.lv_cdn_diag fmy_stat_chg_ls_up.err_info_stat.err_sym fmy_stat_alter_com.err_info_stat.lv_err_mem fmy_stat_alter_com.err_info_stat.lv_ready fmy_stat_alter_com.err_info_stat.lv_end_diag fmy_stat_alter_com.err_info_stat.lv_cdn_diag fmy_stat_alter_com.err_info_stat.err_sym fmy_stat_cwp_com.err_info_stat.lv_err_mem fmy_stat_cwp_com.err_info_stat.lv_ready fmy_stat_cwp_com.err_info_stat.lv_end_diag fmy_stat_cwp_com.err_info_stat.lv_cdn_diag fmy_stat_cwp_com.err_info_stat.err_sym fmy_stat_qoil_com.err_info_stat.lv_err_mem fmy_stat_qoil_com.err_info_stat.lv_ready fmy_stat_qoil_com.err_info_stat.lv_end_diag fmy_stat_qoil_com.err_info_stat.lv_cdn_diag fmy_stat_qoil_com.err_info_stat.err_sym fmy_stat_sens_bat_smt_com.err_info_stat.lv_err_mem fmy_stat_sens_bat_smt_com.err_info_stat.lv_ready fmy_stat_sens_bat_smt_com.err_info_stat.lv_end_diag fmy_stat_sens_bat_smt_com.err_info_stat.lv_cdn_diag fmy_stat_sens_bat_smt_com.err_info_stat.err_sym fmy_stat_ecraspwm_fb.ctr_abc fmy_stat_ecraspwm_fb.ctr_end_diag fmy_stat_ecraspwm_fb.err_info_stat.lv_err_mem fmy_stat_ecraspwm_fb.err_info_stat.lv_ready fmy_stat_ecraspwm_fb.err_info_stat.lv_end_diag fmy_stat_ecraspwm_fb.err_info_stat.lv_cdn_diag fmy_stat_ecraspwm_fb.err_info_stat.err_sym fmy_stat_ecras_el.ctr_abc fmy_stat_ecras_el.ctr_end_diag fmy_stat_ecras_el.err_info_stat.lv_err_mem fmy_stat_ecras_el.err_info_stat.lv_ready fmy_stat_ecras_el.err_info_stat.lv_end_diag fmy_stat_ecras_el.err_info_stat.lv_cdn_diag fmy_stat_ecras_el.err_info_stat.err_sym fmy_stat_warm_rst.ctr_abc fmy_stat_warm_rst.ctr_end_diag fmy_stat_warm_rst.err_info_stat.lv_err_mem fmy_stat_warm_rst.err_info_stat.lv_ready fmy_stat_warm_rst.err_info_stat.lv_end_diag fmy_stat_warm_rst.err_info_stat.lv_cdn_diag fmy_stat_warm_rst.err_info_stat.err_sym fmy_stat_acr_ad.ctr_abc fmy_stat_acr_ad.ctr_end_diag fmy_stat_acr_ad.err_info_stat.lv_err_mem fmy_stat_acr_ad.err_info_stat.lv_ready fmy_stat_acr_ad.err_info_stat.lv_end_diag fmy_stat_acr_ad.err_info_stat.lv_cdn_diag fmy_stat_acr_ad.err_info_stat.err_sym fmy_stat_sens_acr.ctr_abc fmy_stat_sens_acr.ctr_end_diag fmy_stat_sens_acr.err_info_stat.lv_err_mem fmy_stat_sens_acr.err_info_stat.lv_ready fmy_stat_sens_acr.err_info_stat.lv_end_diag fmy_stat_sens_acr.err_info_stat.lv_cdn_diag fmy_stat_sens_acr.err_info_stat.err_sym fmy_stat_acr_ctl.ctr_abc fmy_stat_acr_ctl.ctr_end_diag fmy_stat_acr_ctl.err_info_stat.lv_err_mem fmy_stat_acr_ctl.err_info_stat.lv_ready fmy_stat_acr_ctl.err_info_stat.lv_end_diag fmy_stat_acr_ctl.err_info_stat.lv_cdn_diag fmy_stat_acr_ctl.err_info_stat.err_sym fmy_stat_acr_dr.ctr_abc fmy_stat_acr_dr.ctr_end_diag fmy_stat_acr_dr.err_info_stat.lv_err_mem fmy_stat_acr_dr.err_info_stat.lv_ready fmy_stat_acr_dr.err_info_stat.lv_end_diag fmy_stat_acr_dr.err_info_stat.lv_cdn_diag fmy_stat_acr_dr.err_info_stat.err_sym fmy_stat_var_cod.ctr_abc fmy_stat_var_cod.ctr_end_diag fmy_stat_var_cod.err_info_stat.lv_err_mem fmy_stat_var_cod.err_info_stat.lv_ready fmy_stat_var_cod.err_info_stat.lv_end_diag fmy_stat_var_cod.err_info_stat.lv_cdn_diag fmy_stat_var_cod.err_info_stat.err_sym fmy_stat_veh_pow_var.ctr_abc fmy_stat_veh_pow_var.ctr_end_diag fmy_stat_veh_pow_var.err_info_stat.lv_err_mem fmy_stat_veh_pow_var.err_info_stat.lv_ready fmy_stat_veh_pow_var.err_info_stat.lv_end_diag fmy_stat_veh_pow_var.err_info_stat.lv_cdn_diag fmy_stat_veh_pow_var.err_info_stat.err_sym fmy_stat_fup_mfp_plaus.ctr_abc fmy_stat_fup_mfp_plaus.ctr_end_diag fmy_stat_fup_mfp_plaus.err_info_stat.lv_err_mem fmy_stat_fup_mfp_plaus.err_info_stat.lv_ready fmy_stat_fup_mfp_plaus.err_info_stat.lv_end_diag fmy_stat_fup_mfp_plaus.err_info_stat.lv_cdn_diag fmy_stat_fup_mfp_plaus.err_info_stat.err_sym fmy_stat_h_prs_sys.ctr_abc fmy_stat_h_prs_sys.ctr_end_diag fmy_stat_h_prs_sys.err_info_stat.lv_err_mem fmy_stat_h_prs_sys.err_info_stat.lv_ready fmy_stat_h_prs_sys.err_info_stat.lv_end_diag fmy_stat_h_prs_sys.err_info_stat.lv_cdn_diag fmy_stat_h_prs_sys.err_info_stat.err_sym fmy_stat_vcv_plaus.ctr_abc fmy_stat_vcv_plaus.ctr_end_diag fmy_stat_vcv_plaus.err_info_stat.lv_err_mem fmy_stat_vcv_plaus.err_info_stat.lv_ready fmy_stat_vcv_plaus.err_info_stat.lv_end_diag fmy_stat_vcv_plaus.err_info_stat.lv_cdn_diag fmy_stat_vcv_plaus.err_info_stat.err_sym fmy_stat_fup.ctr_abc fmy_stat_fup.ctr_end_diag fmy_stat_fup.err_info_stat.lv_err_mem fmy_stat_fup.err_info_stat.lv_ready fmy_stat_fup.err_info_stat.lv_end_diag fmy_stat_fup.err_info_stat.lv_cdn_diag fmy_stat_fup.err_info_stat.err_sym fmy_stat_vcv.ctr_abc fmy_stat_vcv.ctr_end_diag fmy_stat_vcv.err_info_stat.lv_err_mem fmy_stat_vcv.err_info_stat.lv_ready fmy_stat_vcv.err_info_stat.lv_end_diag fmy_stat_vcv.err_info_stat.lv_cdn_diag fmy_stat_vcv.err_info_stat.err_sym fmy_stat_fup_efp.ctr_abc fmy_stat_fup_efp.ctr_end_diag fmy_stat_fup_efp.err_info_stat.lv_err_mem fmy_stat_fup_efp.err_info_stat.lv_ready fmy_stat_fup_efp.err_info_stat.lv_end_diag fmy_stat_fup_efp.err_info_stat.lv_cdn_diag fmy_stat_fup_efp.err_info_stat.err_sym fmy_stat_efppwm_plaus.ctr_abc fmy_stat_efppwm_plaus.ctr_end_diag fmy_stat_efppwm_plaus.err_info_stat.lv_err_mem fmy_stat_efppwm_plaus.err_info_stat.lv_ready fmy_stat_efppwm_plaus.err_info_stat.lv_end_diag fmy_stat_efppwm_plaus.err_info_stat.lv_cdn_diag fmy_stat_efppwm_plaus.err_info_stat.err_sym fmy_stat_l_prs_sys.ctr_abc fmy_stat_l_prs_sys.ctr_end_diag fmy_stat_l_prs_sys.err_info_stat.lv_err_mem fmy_stat_l_prs_sys.err_info_stat.lv_ready fmy_stat_l_prs_sys.err_info_stat.lv_end_diag fmy_stat_l_prs_sys.err_info_stat.lv_cdn_diag fmy_stat_l_prs_sys.err_info_stat.err_sym fmy_stat_conv_mon_1.ctr_abc fmy_stat_conv_mon_1.ctr_end_diag fmy_stat_conv_mon_1.err_info_stat.lv_err_mem fmy_stat_conv_mon_1.err_info_stat.lv_ready fmy_stat_conv_mon_1.err_info_stat.lv_end_diag fmy_stat_conv_mon_1.err_info_stat.lv_cdn_diag fmy_stat_conv_mon_1.err_info_stat.err_sym fmy_stat_n_32_mon_1.ctr_abc fmy_stat_n_32_mon_1.ctr_end_diag fmy_stat_n_32_mon_1.err_info_stat.lv_err_mem fmy_stat_n_32_mon_1.err_info_stat.lv_ready fmy_stat_n_32_mon_1.err_info_stat.lv_end_diag fmy_stat_n_32_mon_1.err_info_stat.lv_cdn_diag fmy_stat_n_32_mon_1.err_info_stat.err_sym fmy_stat_pvs_mon_1.ctr_abc fmy_stat_pvs_mon_1.ctr_end_diag fmy_stat_pvs_mon_1.err_info_stat.lv_err_mem fmy_stat_pvs_mon_1.err_info_stat.lv_ready fmy_stat_pvs_mon_1.err_info_stat.lv_end_diag fmy_stat_pvs_mon_1.err_info_stat.lv_cdn_diag fmy_stat_pvs_mon_1.err_info_stat.err_sym fmy_stat_tq_dif_isc_mon_1.ctr_abc fmy_stat_tq_dif_isc_mon_1.ctr_end_diag fmy_stat_tq_dif_isc_mon_1.err_info_stat.lv_err_mem fmy_stat_tq_dif_isc_mon_1.err_info_stat.lv_ready fmy_stat_tq_dif_isc_mon_1.err_info_stat.lv_end_diag fmy_stat_tq_dif_isc_mon_1.err_info_stat.lv_cdn_diag fmy_stat_tq_dif_isc_mon_1.err_info_stat.err_sym fmy_stat_tq_req_mon_1.ctr_abc fmy_stat_tq_req_mon_1.ctr_end_diag fmy_stat_tq_req_mon_1.err_info_stat.lv_err_mem fmy_stat_tq_req_mon_1.err_info_stat.lv_ready fmy_stat_tq_req_mon_1.err_info_stat.lv_end_diag fmy_stat_tq_req_mon_1.err_info_stat.lv_cdn_diag fmy_stat_tq_req_mon_1.err_info_stat.err_sym fmy_stat_tq_ext_mon_1.ctr_abc fmy_stat_tq_ext_mon_1.ctr_end_diag fmy_stat_tq_ext_mon_1.err_info_stat.lv_err_mem fmy_stat_tq_ext_mon_1.err_info_stat.lv_ready fmy_stat_tq_ext_mon_1.err_info_stat.lv_end_diag fmy_stat_tq_ext_mon_1.err_info_stat.lv_cdn_diag fmy_stat_tq_ext_mon_1.err_info_stat.err_sym fmy_stat_tqi_av_mon_1.ctr_abc fmy_stat_tqi_av_mon_1.ctr_end_diag fmy_stat_tqi_av_mon_1.err_info_stat.lv_err_mem fmy_stat_tqi_av_mon_1.err_info_stat.lv_ready fmy_stat_tqi_av_mon_1.err_info_stat.lv_end_diag fmy_stat_tqi_av_mon_1.err_info_stat.lv_cdn_diag fmy_stat_tqi_av_mon_1.err_info_stat.err_sym fmy_stat_tqi_n_max_mon_1.ctr_abc fmy_stat_tqi_n_max_mon_1.ctr_end_diag fmy_stat_tqi_n_max_mon_1.err_info_stat.lv_err_mem fmy_stat_tqi_n_max_mon_1.err_info_stat.lv_ready fmy_stat_tqi_n_max_mon_1.err_info_stat.lv_end_diag fmy_stat_tqi_n_max_mon_1.err_info_stat.lv_cdn_diag fmy_stat_tqi_n_max_mon_1.err_info_stat.err_sym fmy_stat_mff_mon_1.ctr_abc fmy_stat_mff_mon_1.ctr_end_diag fmy_stat_mff_mon_1.err_info_stat.lv_err_mem fmy_stat_mff_mon_1.err_info_stat.lv_ready fmy_stat_mff_mon_1.err_info_stat.lv_end_diag fmy_stat_mff_mon_1.err_info_stat.lv_cdn_diag fmy_stat_mff_mon_1.err_info_stat.err_sym fmy_stat_cru_mon_1.ctr_abc fmy_stat_cru_mon_1.ctr_end_diag fmy_stat_cru_mon_1.err_info_stat.lv_err_mem fmy_stat_cru_mon_1.err_info_stat.lv_ready fmy_stat_cru_mon_1.err_info_stat.lv_end_diag fmy_stat_cru_mon_1.err_info_stat.lv_cdn_diag fmy_stat_cru_mon_1.err_info_stat.err_sym cdn_diag_prev_ecras_el cdn_diag_prev_dmtlh cdn_diag_prev_rly_accout cdn_diag_prev_dmtls cdn_diag_prev_dmtl_pump cdn_diag_prev_ebox_cfa cdn_diag_prev_ef cdn_diag_prev_rly_st cdn_diag_prev_lsh_up_1 cdn_diag_prev_sof cdn_diag_prev_rly_crcv_heat cdn_diag_prev_lsh_up_2 cdn_diag_prev_lsh_down_1 cdn_diag_prev_lsh_down_2 cdn_diag_prev_el_cps cdn_diag_prev_ect_el cdn_diag_prev_vim_1_el cdn_diag_prev_vim_2_el cdn_diag_prev_slv_ivvt_in cdn_diag_prev_slv_ivvt_ex cdn_diag_prev_ecf_el_1 cdn_diag_prev_rly_efp cdn_diag_prev_vcv cdn_diag_prev_iv_0 cdn_diag_prev_iv_1 cdn_diag_prev_iv_2 cdn_diag_prev_iv_3 cdn_diag_prev_iv_4 cdn_diag_prev_iv_5 /end OUT_MEASUREMENT
/end FUNCTION
/begin FUNCTION ERRM_Anti_bounce_Algorithm "Anti_bounce_Algorithm" /begin DEF_CHARACTERISTIC lc_abc_bench lc_err_det_upd /end DEF_CHARACTERISTIC /end FUNCTION
/begin FUNCTION ERRM_Debounce_algorithm_Appl_Inc "Debounce_Algorithm_Appl_Inc" /begin DEF_CHARACTERISTIC lc_err_intm_clr c_err_intm_clr_ini /end DEF_CHARACTERISTIC
 /begin OUT_MEASUREMENT ctr_err_intm_nr err_intm_ctr_frc[0] err_intm_ctr_frc[1] err_intm_ctr_frc[2] err_intm_ctr_frc[3] err_intm_ctr_frc[4] err_intm_ctr_frc[5] err_intm_ctr_frc[6] err_intm_ctr_frc[7] err_intm_ctr_frc[8] err_intm_ctr_frc[9] err_intm_diag_inst[0] err_intm_diag_inst[1] err_intm_diag_inst[2] err_intm_diag_inst[3] err_intm_diag_inst[4] err_intm_diag_inst[5] err_intm_diag_inst[6] err_intm_diag_inst[7] err_intm_diag_inst[8] err_intm_diag_inst[9] /end OUT_MEASUREMENT
/end FUNCTION
/begin FUNCTION C_B_ERRM "C_B_ERRM"
 /begin SUB_FUNCTION ERRM_Cycle_Manager ERRM_Similar_Conditions ERRM_Communication_Interface ERRM_History_Memory ERRM_Lamp_Management ERRM_Failure_Classes ERRM_Com_Interface_Appl_Inc ERRM_Configuration_Module ERRM_Diagnosis_Trouble_Code_Mngt ERRM_Similar_Conditions_Appl_Inc ERRM_Environmental_data_Appl_Inc ERRM_Dyn_Error_Management ERRM_Readiness_Codes ERRM_Environmental_data ERRM_Statistical_Data ERRM_Rate_Base_Monitoring ERRM_Dyn_Error_Managmt_Appl_Inc /end SUB_FUNCTION
/end FUNCTION
/begin FUNCTION ERRM_Cycle_Manager "Cycle_Manager" /begin DEF_CHARACTERISTIC c_tco_wup_thd c_tco_wup_inc /end DEF_CHARACTERISTIC /begin OUT_MEASUREMENT lv_dc lv_wup_cyc lv_state_wup /end OUT_MEASUREMENT /end FUNCTION
/begin FUNCTION ERRM_Similar_Conditions "Similar_Conditions"
 /begin DEF_CHARACTERISTIC lc_ena_scdn c_ctr_scdn_equ_dc_max c_n_scdn_equ c_load_scdn_equ /end DEF_CHARACTERISTIC
/end FUNCTION
/begin FUNCTION ERRM_Communication_Interface "Communication_Interface" /begin DEF_CHARACTERISTIC c_state_ready_obd_1 c_state_ready_obd_2 /end DEF_CHARACTERISTIC /begin OUT_MEASUREMENT idx_tmp_rbm ratio_tmp_rbm /end OUT_MEASUREMENT /end FUNCTION
/begin FUNCTION ERRM_History_Memory "History_Memory" /begin DEF_CHARACTERISTIC lc_clr_his_fmy /end DEF_CHARACTERISTIC
 /begin OUT_MEASUREMENT ctr_err_his_nr fmy_his_cod[0] fmy_his_cod[1] fmy_his_cod[2] fmy_his_cod[3] fmy_his_cod[4] fmy_his_cod[5] fmy_his_cod[6] fmy_his_cod[7] fmy_his_cod[8] fmy_his_cod[9] /end OUT_MEASUREMENT
/end FUNCTION
/begin FUNCTION ERRM_Lamp_Management "Lamp_Management"
 /begin DEF_CHARACTERISTIC c_conf_mil c_conf_wal_1 c_conf_wal_2 lc_inh_wal_st c_dly_inh_iv_mis c_dly_mil_ready_2 c_dly_mil_ready_1 /end DEF_CHARACTERISTIC
 /begin OUT_MEASUREMENT state_mil lv_wal_2 state_wal_1 state_wal_2 lv_wal_1 lv_wal_st dly_mil_ready lv_mil lv_mil_wup lv_wal_1_wup lv_wal_2_wup lv_mil_fll_ready dist_act_mil dist_dtc_clr dist_rel_dtc_clr ctr_wup_dtc_clr dist_act_wal_2 dist_act_wal_1 /end OUT_MEASUREMENT
/end FUNCTION
/begin FUNCTION ERRM_Failure_Classes "Failure_Classes"
 /begin DEF_CHARACTERISTIC fmy_id_imob_1.c_err_clas fmy_id_imob_2.c_err_clas fmy_id_imob_3.c_err_clas fmy_id_tco_el.c_err_clas fmy_id_tco_grd.c_err_clas fmy_id_tco_stuck.c_err_clas fmy_id_tco_plaus.c_err_clas fmy_id_tco_2_el.c_err_clas fmy_id_tco_2_grd.c_err_clas fmy_id_tco_2_plaus.c_err_clas fmy_id_ect_el.c_err_clas fmy_id_ecf_el_1.c_err_clas fmy_id_ecfpwm_fb_1.c_err_clas fmy_id_th.c_err_clas fmy_id_ftl_min.c_err_clas fmy_id_tia_el.c_err_clas fmy_id_amp.c_err_clas fmy_id_amp_plaus.c_err_clas fmy_id_maf.c_err_clas fmy_id_iv_0.c_err_clas fmy_id_iv_1.c_err_clas fmy_id_iv_2.c_err_clas fmy_id_iv_3.c_err_clas fmy_id_iv_4.c_err_clas fmy_id_iv_5.c_err_clas fmy_id_rly_efp.c_err_clas fmy_id_el_cps.c_err_clas fmy_id_slv_ivvt_in.c_err_clas fmy_id_slv_ivvt_ex.c_err_clas fmy_id_ecu_cks.c_err_clas fmy_id_tout_etcu_1.c_err_clas fmy_id_tout_etcu_2.c_err_clas fmy_id_tout_icl_2.c_err_clas fmy_id_tout_icl_3.c_err_clas fmy_id_tout_asr_1.c_err_clas fmy_id_tout_asr_3.c_err_clas fmy_id_tout_asr_4.c_err_clas fmy_id_tout_pste_1.c_err_clas fmy_id_tout_amt_1.c_err_clas fmy_id_vs.c_err_clas fmy_id_knks_1.c_err_clas fmy_id_knks_2.c_err_clas fmy_id_igc_scp_0.c_err_clas fmy_id_igc_scp_1.c_err_clas fmy_id_igc_scp_2.c_err_clas fmy_id_igc_scp_3.c_err_clas fmy_id_igc_scp_4.c_err_clas fmy_id_igc_scp_5.c_err_clas fmy_id_igc_scg_0.c_err_clas fmy_id_igc_scg_1.c_err_clas fmy_id_igc_scg_2.c_err_clas fmy_id_igc_scg_3.c_err_clas fmy_id_igc_scg_4.c_err_clas fmy_id_igc_scg_5.c_err_clas fmy_id_igc_ol_0.c_err_clas fmy_id_igc_ol_1.c_err_clas fmy_id_igc_ol_2.c_err_clas fmy_id_igc_ol_3.c_err_clas fmy_id_igc_ol_4.c_err_clas fmy_id_igc_ol_5.c_err_clas fmy_id_tps_1.c_err_clas fmy_id_tps_2.c_err_clas fmy_id_tps_maf_1.c_err_clas fmy_id_tps_maf_2.c_err_clas fmy_id_tps_ratio.c_err_clas fmy_id_v_ref_1.c_err_clas fmy_id_v_ref_2.c_err_clas fmy_id_pvs_1.c_err_clas fmy_id_pvs_2.c_err_clas fmy_id_pvs_ratio.c_err_clas fmy_id_pvs_double.c_err_clas fmy_id_pvs_bls_not_plaus.c_err_clas fmy_id_mtc_dr.c_err_clas fmy_id_mtc_ctl_1.c_err_clas fmy_id_mtc_ctl_2.c_err_clas fmy_id_mtc_ctl_3.c_err_clas fmy_id_tps_ad.c_err_clas fmy_id_tps_ad_bol.c_err_clas fmy_id_tps_st_chk_1.c_err_clas fmy_id_tps_st_chk_2.c_err_clas fmy_id_gen.c_err_clas fmy_id_gen_diag.c_err_clas fmy_id_alter_bn.c_err_clas fmy_id_alter_bn_bat.c_err_clas fmy_id_vim_1_el.c_err_clas fmy_id_vim_2_el.c_err_clas fmy_id_vimpwm_1_fb.c_err_clas fmy_id_vimpwm_2_fb.c_err_clas fmy_id_t_es.c_err_clas fmy_id_map_dip_plaus.c_err_clas fmy_id_toil_level.c_err_clas fmy_id_vim_plaus.c_err_clas fmy_id_alter_bn_rgn.c_err_clas fmy_id_per_cam_in_1.c_err_clas fmy_id_per_cam_ex_1.c_err_clas fmy_id_syn_cam_in_1.c_err_clas fmy_id_syn_cam_ex_1.c_err_clas fmy_id_ref_crk_cam_in_1.c_err_clas fmy_id_ref_crk_cam_ex_1.c_err_clas fmy_id_crk_tooth.c_err_clas fmy_id_crk_tooth_per.c_err_clas fmy_id_crk_syn.c_err_clas fmy_id_crk_plaus.c_err_clas fmy_id_plaus_cam_in_1.c_err_clas fmy_id_plaus_cam_ex_1.c_err_clas fmy_id_syn_crk_cam_in_1.c_err_clas fmy_id_syn_crk_cam_ex_1.c_err_clas fmy_id_can_boff_B.c_err_clas fmy_id_can_boff_C.c_err_clas fmy_id_rly_main.c_err_clas fmy_id_rly_main_dly.c_err_clas fmy_id_rly_accout.c_err_clas fmy_id_isc.c_err_clas fmy_id_im_bls_plaus.c_err_clas fmy_id_im_bts_plaus.c_err_clas fmy_id_msw_tog.c_err_clas fmy_id_msw_2.c_err_clas fmy_id_msw_3.c_err_clas fmy_id_mis_0.c_err_clas fmy_id_mis_1.c_err_clas fmy_id_mis_2.c_err_clas fmy_id_mis_3.c_err_clas fmy_id_mis_4.c_err_clas fmy_id_mis_5.c_err_clas fmy_id_mis_mpl.c_err_clas fmy_id_mis_ftl_l.c_err_clas fmy_id_fsd_1.c_err_clas fmy_id_fsd_2.c_err_clas fmy_id_ef.c_err_clas fmy_id_tecu.c_err_clas fmy_id_ebox_cfa.c_err_clas fmy_id_ecu_ram.c_err_clas fmy_id_tqi_lim.c_err_clas fmy_id_obd2_lsh_down_1.c_err_clas fmy_id_obd2_lsh_down_2.c_err_clas fmy_id_dmtls.c_err_clas fmy_id_dmtl_pump.c_err_clas fmy_id_dmtlm.c_err_clas fmy_id_rough_leak.c_err_clas fmy_id_small_leak.c_err_clas fmy_id_chk_fuc.c_err_clas fmy_id_sof.c_err_clas fmy_id_sof_req.c_err_clas fmy_id_rly_crcv_heat.c_err_clas fmy_id_rly_st.c_err_clas fmy_id_bsd.c_err_clas fmy_id_poil_swi.c_err_clas fmy_id_tout_efp_can.c_err_clas fmy_id_diagcps.c_err_clas fmy_id_dcc.c_err_clas fmy_id_ldm.c_err_clas fmy_id_dmtlh.c_err_clas fmy_id_cs.c_err_clas fmy_id_spi_mps.c_err_clas fmy_id_spi_knk.c_err_clas fmy_id_bn_tq_dcc.c_err_clas fmy_id_bn_tq_pste_2.c_err_clas fmy_id_bn_ars.c_err_clas fmy_id_bn_cas.c_err_clas fmy_id_bn_tq_tcs.c_err_clas fmy_id_bn_vs_tcs.c_err_clas fmy_id_bn_tcs.c_err_clas fmy_id_bn_tq_etcu.c_err_clas fmy_id_bn_etcu.c_err_clas fmy_id_bn_etcu_2.c_err_clas fmy_id_bn_etcu_disp.c_err_clas fmy_id_bn_tq_amt.c_err_clas fmy_id_bn_acc.c_err_clas fmy_id_bn_t_icl.c_err_clas fmy_id_bn_veh_mod.c_err_clas fmy_id_bn_km_icl.c_err_clas fmy_id_bn_icl.c_err_clas fmy_id_bn_pow_vb.c_err_clas fmy_id_bn_pow_gen.c_err_clas fmy_id_bn_msw.c_err_clas fmy_id_bn_ang_pste.c_err_clas fmy_id_bn_gear_rev.c_err_clas fmy_id_bn_ltg_hdlp_l.c_err_clas fmy_id_bn_ldm.c_err_clas fmy_id_bn_trl.c_err_clas fmy_id_bn_hiv.c_err_clas fmy_id_bn_t_clk.c_err_clas fmy_id_bn_efp_crash.c_err_clas fmy_id_bn_efp.c_err_clas fmy_id_load_tps_plaus.c_err_clas fmy_id_egy_min.c_err_clas fmy_id_efp_crash.c_err_clas fmy_id_efp.c_err_clas fmy_id_locan_boff.c_err_clas fmy_id_cwp_plaus.c_err_clas fmy_id_cwp_int_off.c_err_clas fmy_id_cwp_pwr.c_err_clas fmy_id_cwp_com_plaus.c_err_clas fmy_id_qoil_sens.c_err_clas fmy_id_bat_sens.c_err_clas fmy_id_bat_sens_it.c_err_clas fmy_id_bat_sens_it_el.c_err_clas fmy_id_ecu_nvmy.c_err_clas fmy_id_gs.c_err_clas fmy_id_plaus_igk_bn.c_err_clas fmy_id_tq_req_can.c_err_clas fmy_id_map_dip_sens.c_err_clas fmy_id_mec_ivvt_in.c_err_clas fmy_id_mec_ivvt_ex.c_err_clas fmy_id_tout_nox_sens_1.c_err_clas fmy_id_tout_nox_sens_2.c_err_clas fmy_id_vvl_rot.c_err_clas fmy_id_rly_vvl.c_err_clas fmy_id_nox_sens_1.c_err_clas fmy_id_ovl_ecu_vvl.c_err_clas fmy_id_dr_sc_vvl.c_err_clas fmy_id_crit_ovl_ecu_vvl.c_err_clas fmy_id_nox_sens_2.c_err_clas fmy_id_cur_h_vvl.c_err_clas fmy_id_teg_pcat_down_1.c_err_clas fmy_id_teg_pcat_down_2.c_err_clas fmy_id_t_seg_er.c_err_clas fmy_id_seg_ad_er.c_err_clas fmy_id_vs_plaus.c_err_clas fmy_id_ftl_obd.c_err_clas fmy_id_ftl_can.c_err_clas fmy_id_tia_plaus.c_err_clas fmy_id_tam_can.c_err_clas fmy_id_tam_plaus.c_err_clas fmy_id_map_dip_shift.c_err_clas fmy_id_cat_diag_1.c_err_clas fmy_id_cat_diag_2.c_err_clas fmy_id_cat_diag_afl_1.c_err_clas fmy_id_cat_diag_afl_2.c_err_clas fmy_id_scg_ls_down_1.c_err_clas fmy_id_scp_ls_down_1.c_err_clas fmy_id_oc_ls_down_1.c_err_clas fmy_id_puc_ls_down_1.c_err_clas fmy_id_fl_ls_down_1.c_err_clas fmy_id_lsl_up_if_1.c_err_clas fmy_id_el_lsl_up_1.c_err_clas fmy_id_lsh_up_1.c_err_clas fmy_id_lsh_down_1.c_err_clas fmy_id_vls_down_dif_1.c_err_clas fmy_id_lsh_lsl_up_1.c_err_clas fmy_id_air_lsl_up_1.c_err_clas fmy_id_pue_ls_down_1.c_err_clas fmy_id_swt_ls_down_1.c_err_clas fmy_id_obd_lsh_down_1.c_err_clas fmy_id_dyn_vld_ls_up_1.c_err_clas fmy_id_puc_vld_ls_up_1.c_err_clas fmy_id_obd_vld_lsh_up_1.c_err_clas fmy_id_chk_ls_down_1.c_err_clas fmy_id_shift_afl_lsl_up_1.c_err_clas fmy_id_shift_afr_lsl_up_1.c_err_clas fmy_id_oc_lsl_up_1.c_err_clas fmy_id_delta_i_lam_1.c_err_clas fmy_id_rgn_nt_ls_down_1.c_err_clas fmy_id_chg_ls_down.c_err_clas fmy_id_scg_ls_down_2.c_err_clas fmy_id_scp_ls_down_2.c_err_clas fmy_id_oc_ls_down_2.c_err_clas fmy_id_puc_ls_down_2.c_err_clas fmy_id_fl_ls_down_2.c_err_clas fmy_id_lsl_up_if_2.c_err_clas fmy_id_el_lsl_up_2.c_err_clas fmy_id_lsh_up_2.c_err_clas fmy_id_lsh_down_2.c_err_clas fmy_id_vls_down_dif_2.c_err_clas fmy_id_lsh_lsl_up_2.c_err_clas fmy_id_air_lsl_up_2.c_err_clas fmy_id_pue_ls_down_2.c_err_clas fmy_id_swt_ls_down_2.c_err_clas fmy_id_obd_lsh_down_2.c_err_clas fmy_id_dyn_vld_ls_up_2.c_err_clas fmy_id_puc_vld_ls_up_2.c_err_clas fmy_id_obd_vld_lsh_up_2.c_err_clas fmy_id_chk_ls_down_2.c_err_clas fmy_id_shift_afl_lsl_up_2.c_err_clas fmy_id_shift_afr_lsl_up_2.c_err_clas fmy_id_oc_lsl_up_2.c_err_clas fmy_id_delta_i_lam_2.c_err_clas fmy_id_rgn_nt_ls_down_2.c_err_clas fmy_id_chg_ls_up.c_err_clas fmy_id_alter_com.c_err_clas fmy_id_cwp_com.c_err_clas fmy_id_qoil_com.c_err_clas fmy_id_sens_bat_smt_com.c_err_clas fmy_id_ecraspwm_fb.c_err_clas fmy_id_ecras_el.c_err_clas fmy_id_warm_rst.c_err_clas fmy_id_acr_ad.c_err_clas fmy_id_sens_acr.c_err_clas fmy_id_acr_ctl.c_err_clas fmy_id_acr_dr.c_err_clas fmy_id_var_cod.c_err_clas fmy_id_veh_pow_var.c_err_clas fmy_id_fup_mfp_plaus.c_err_clas fmy_id_h_prs_sys.c_err_clas fmy_id_vcv_plaus.c_err_clas fmy_id_fup.c_err_clas fmy_id_vcv.c_err_clas fmy_id_fup_efp.c_err_clas fmy_id_efppwm_plaus.c_err_clas fmy_id_l_prs_sys.c_err_clas fmy_id_conv_mon_1.c_err_clas fmy_id_n_32_mon_1.c_err_clas fmy_id_pvs_mon_1.c_err_clas fmy_id_tq_dif_isc_mon_1.c_err_clas fmy_id_tq_req_mon_1.c_err_clas fmy_id_tq_ext_mon_1.c_err_clas fmy_id_tqi_av_mon_1.c_err_clas fmy_id_tqi_n_max_mon_1.c_err_clas fmy_id_mff_mon_1.c_err_clas fmy_id_cru_mon_1.c_err_clas id_clas_a_fmt id_clas_b_fmt ldpm_clas_a_id_clas_fmy ldp_clas_b_id_clas_fmy /end DEF_CHARACTERISTIC
/end FUNCTION
/begin FUNCTION ERRM_Com_Interface_Appl_Inc "Com_Interface_Appl_Inc" /end FUNCTION
/begin FUNCTION ERRM_Configuration_Module "Configuration_Module" /end FUNCTION
/end MODULE
/end PROJECT
