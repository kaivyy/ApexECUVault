ASAP2_VERSION 1 2
/begin PROJECT Z432 "430"
/begin HEADER "" VERSION "055.01" PROJECT_NO Z430 /end HEADER
/begin MODULE BMW-EASY ""
/begin MOD_COMMON "common attributes" DEPOSIT ABSOLUT BYTE_ORDER BIG_ENDIAN /end MOD_COMMON
/begin MEASUREMENT LV_R_LS_UP_AFR_MES_1 "lv_r_ls_up_afr_mes_1" UWORD RANGE________0___0H__0H____1___1 2 2.0 0 65535 BIT_MASK 0x40 FUNCTION_LIST R_LS_CALC ECU_ADDRESS 0x40c30 /end MEASUREMENT
/begin MEASUREMENT LV_R_LS_UP_AFR_MES_2 "lv_r_ls_up_afr_mes_2" UWORD RANGE________0___0H__0H____1___1 2 2.0 0 65535 BIT_MASK 0x40 FUNCTION_LIST R_LS_CALC ECU_ADDRESS 0x40d8e /end MEASUREMENT
/begin MEASUREMENT LV_R_UP_LS_MES_VLD_1 "lv_r_up_ls_mes_vld_1" UWORD RANGE________0___0H__0H____1___1 2 2.0 0 65535 BIT_MASK 0x4 FUNCTION_LIST R_LS_CALC ECU_ADDRESS 0x40c30 /end MEASUREMENT
/begin MEASUREMENT LV_R_UP_LS_MES_VLD_2 "lv_r_up_ls_mes_vld_2" UWORD RANGE________0___0H__0H____1___1 2 2.0 0 65535 BIT_MASK 0x4 FUNCTION_LIST R_LS_CALC ECU_ADDRESS 0x40d8e /end MEASUREMENT
/begin MEASUREMENT LV_RD_FTL "lv_rd_ftl" UBYTE RANGE________0___0H__0H____1_818 2 2.0 0 255 BIT_MASK 0x80 FUNCTION_LIST DMTL ECU_ADDRESS 0xfd5c /end MEASUREMENT
/begin MEASUREMENT LV_REF_LEAK_ROUGH_LEAK_SUSP "lv_ref_leak_rough_leak_susp" UBYTE RANGE________0___0H__0H____1_818 2 2.0 0 255 BIT_MASK 0x80 ECU_ADDRESS 0xfd5d /end MEASUREMENT
/begin MEASUREMENT LV_REFU "lv_refu" UBYTE RANGE________0___0H__0H____1_818 2 2.0 0 255 BIT_MASK 0x1 FUNCTION_LIST DMTL ECU_ADDRESS 0xfd5e /end MEASUREMENT
/begin MEASUREMENT LV_REFU_1 "lv_refu_1" UBYTE RANGE________0___0H__0H____1_818 2 2.0 0 255 BIT_MASK 0x2 FUNCTION_LIST DMTL ECU_ADDRESS 0xfd5e /end MEASUREMENT
/begin MEASUREMENT LV_REFU_DMTL "lv_refu_dmtl" UBYTE RANGE________0___0H__0H____1_818 2 2.0 0 255 BIT_MASK 0x4 FUNCTION_LIST DMTL ECU_ADDRESS 0xfd5e /end MEASUREMENT
/begin MEASUREMENT LV_REFU_END "lv_refu_end" UBYTE RANGE________0___0H__0H____1_818 2 2.0 0 255 BIT_MASK 0x8 FUNCTION_LIST DMTL ECU_ADDRESS 0xfd5e /end MEASUREMENT
/begin MEASUREMENT LV_REFU_RLS_DIAG "lv_refu_rls_diag" UBYTE RANGE________0___0H__0H____1_818 2 2.0 0 255 BIT_MASK 0x20 FUNCTION_LIST DMTL ECU_ADDRESS 0xfd5e /end MEASUREMENT
/begin MEASUREMENT LV_REFU_VAL "lv_refu_val" UBYTE RANGE________0___0H__0H____1_818 2 2.0 0 255 BIT_MASK 0x40 FUNCTION_LIST DMTL ECU_ADDRESS 0xfd5e /end MEASUREMENT
/begin MEASUREMENT LV_REFU_VAL_1 "lv_refu_val_1" UBYTE RANGE________0___0H__0H____1_818 2 2.0 0 255 BIT_MASK 0x80 FUNCTION_LIST DMTL ECU_ADDRESS 0xfd5e /end MEASUREMENT
/begin MEASUREMENT LV_REQ_CPS_CLOSE_ROUGH "lv_req_cps_close_rough" UBYTE RANGE________0___0H__0H____1_818 2 2.0 0 255 BIT_MASK 0x2 FUNCTION_LIST DMTL ECU_ADDRESS 0xfd5f /end MEASUREMENT
/begin MEASUREMENT LV_REQ_ENA_ROUGH_LEAK "lv_req_ena_rough_leak" UBYTE RANGE________0___0H__0H____1_823 2 2.0 0 255 BIT_MASK 0x8 FUNCTION_LIST JOHE_OD ECU_ADDRESS 0xfd5f /end MEASUREMENT
/begin MEASUREMENT LV_REQ_HEAT "lv_req_heat" UBYTE RANGE________0___0H__0H____1_818 2 2.0 0 255 BIT_MASK 0x80 ECU_ADDRESS 0xfd1d /end MEASUREMENT
/begin MEASUREMENT LV_REQ_OBD_DIAG "lv_req_obd_diag" UBYTE RANGE________0___0H__0H____1_823 2 2.0 0 255 BIT_MASK 0x20 FUNCTION_LIST JOHE_OD ECU_ADDRESS 0xfd65 /end MEASUREMENT
/begin MEASUREMENT LV_REQ_PWL_DMTL "lv_req_pwl_dmtl" UBYTE RANGE________0___0H__0H____1_823 2 2.0 0 255 BIT_MASK 0x80 FUNCTION_LIST JOHE_OD ECU_ADDRESS 0xfd50 /end MEASUREMENT
/begin MEASUREMENT LV_REQ_PWL_ROUGH_LEAK "lv_req_pwl_rough_leak" UBYTE RANGE________0___0H__0H____1_823 2 2.0 0 255 BIT_MASK 0x10 FUNCTION_LIST JOHE_OD ECU_ADDRESS 0xfd5f /end MEASUREMENT
/begin MEASUREMENT LV_REQ_PWL_SMALL_LEAK "lv_req_pwl_small_leak" UBYTE RANGE________0___0H__0H____1_823 2 2.0 0 255 BIT_MASK 0x20 FUNCTION_LIST JOHE_OD ECU_ADDRESS 0xfd5f /end MEASUREMENT
/begin MEASUREMENT LV_REQ_ROUGH_LEAK "lv_req_rough_leak" UBYTE RANGE________0___0H__0H____1_818 2 2.0 0 255 BIT_MASK 0x8 FUNCTION_LIST DMTL ECU_ADDRESS 0xfd65 /end MEASUREMENT
/begin MEASUREMENT LV_REST "lv_rest" UBYTE RANGE________0___0H__0H____1_823 2 2.0 0 255 BIT_MASK 0x80 FUNCTION_LIST ETM ECU_ADDRESS 0xfd4a /end MEASUREMENT
/begin MEASUREMENT LV_RLY_ACC_TRIG_VL "lv_rly_acc_trig_vl" UBYTE RANGE________0___0H__0H____1_823 2 2.0 0 255 BIT_MASK 0x8 ECU_ADDRESS 0xfd42 /end MEASUREMENT
/begin MEASUREMENT LV_RON_LOW "lv_ron_low" UBYTE RANGE________0___0H__0H____1_823 2 2.0 0 255 BIT_MASK 0x8 ECU_ADDRESS 0xfd3a /end MEASUREMENT
/begin MEASUREMENT LV_ROUGH_LEAK_MES_LEN "lv_rough_leak_mes_len" UBYTE RANGE________0___0H__0H____1_818 2 2.0 0 255 BIT_MASK 0x4 FUNCTION_LIST DMTL ECU_ADDRESS 0xfd63 /end MEASUREMENT
/begin MEASUREMENT LV_ROUGH_LEAK_SUSP "lv_rough_leak_susp" UBYTE RANGE________0___0H__0H____1_818 2 2.0 0 255 BIT_MASK 0x40 FUNCTION_LIST DMTL ECU_ADDRESS 0xfd5f /end MEASUREMENT
/begin MEASUREMENT LV_ROUGH_LEAK_SUSP_1 "lv_rough_leak_susp_1" UBYTE RANGE________0___0H__0H____1_818 2 2.0 0 255 BIT_MASK 0x80 FUNCTION_LIST DMTL ECU_ADDRESS 0xfd5f /end MEASUREMENT
/begin MEASUREMENT LV_ROUGH_LEAK_SUSP_2 "lv_rough_leak_susp_2" UBYTE RANGE________0___0H__0H____1_818 2 2.0 0 255 BIT_MASK 0x2 FUNCTION_LIST DMTL ECU_ADDRESS 0xfd60 /end MEASUREMENT
/begin MEASUREMENT LV_ROUGH_LEAK_SUSP_3 "lv_rough_leak_susp_3" UBYTE RANGE________0___0H__0H____1_818 2 2.0 0 255 BIT_MASK 0x4 FUNCTION_LIST DMTL ECU_ADDRESS 0xfd60 /end MEASUREMENT
/begin MEASUREMENT LV_ROUGH_LEAK_SUSP_4 "lv_rough_leak_susp_4" UBYTE RANGE________0___0H__0H____1_818 2 2.0 0 255 BIT_MASK 0x8 FUNCTION_LIST DMTL ECU_ADDRESS 0xfd60 /end MEASUREMENT
/begin MEASUREMENT LV_ROUGH_LEAK_SUSP_SET "lv_rough_leak_susp_set" UBYTE RANGE________0___0H__0H____1_818 2 2.0 0 255 BIT_MASK 0x10 FUNCTION_LIST DMTL ECU_ADDRESS 0xfd60 /end MEASUREMENT
/begin MEASUREMENT LV_SA_DIAG_CDN "lv_sa_diag_cdn" UWORD RANGE________0___0H__0H____1___1 2 2.0 0 65535 BIT_MASK 0x200 ECU_ADDRESS 0xfda4 /end MEASUREMENT
/begin MEASUREMENT LV_SA_DIAG_END "lv_sa_diag_end" UWORD RANGE________0___0H__0H____1___1 2 2.0 0 65535 BIT_MASK 0x800 ECU_ADDRESS 0xfda4 /end MEASUREMENT
/begin MEASUREMENT LV_SA_DIAG_GLOB_ERR "lv_sa_diag_glob_err" UBYTE RANGE________0___0H__0H____1_823 2 2.0 0 255 BIT_MASK 0x2 ECU_ADDRESS 0xfd12 /end MEASUREMENT
/begin MEASUREMENT LV_SA_DIAG_PROLONG "lv_sa_diag_prolong" UWORD RANGE________0___0H__0H____1___1 2 2.0 0 65535 BIT_MASK 0x100 ECU_ADDRESS 0xfda4 /end MEASUREMENT
/begin MEASUREMENT LV_SA_LOCK_LAM "lv_sa_lock_lam" UWORD RANGE________0___0H__0H____1___1 2 2.0 0 65535 BIT_MASK 0x4 ECU_ADDRESS 0xfda4 /end MEASUREMENT
/begin MEASUREMENT LV_SA_SAP_ACT "lv_sa_sap_act" UWORD RANGE________0___0H__0H____1___1 2 2.0 0 65535 BIT_MASK 0x2 ECU_ADDRESS 0xfda4 /end MEASUREMENT
/begin MEASUREMENT LV_SA_SAV_ACT "lv_sa_sav_act" UWORD RANGE________0___0H__0H____1___1 2 2.0 0 65535 BIT_MASK 0x1 ECU_ADDRESS 0xfda4 /end MEASUREMENT
/begin MEASUREMENT LV_SA_T_DIAG_START "lv_sa_t_diag_start" UBYTE RANGE________0___0H__0H____1_823 2 2.0 0 255 BIT_MASK 0x4 FUNCTION_LIST JOHE_OD ECU_ADDRESS 0xfd12 /end MEASUREMENT
/begin MEASUREMENT LV_SAP_ACT_SAV_DIAG "lv_sap_act_sav_diag" UBYTE RANGE________0___0H__0H____1_823 2 2.0 0 255 BIT_MASK 0x2000 FUNCTION_LIST JOHE_OD ECU_ADDRESS 0xfda4 /end MEASUREMENT
/begin MEASUREMENT LV_SAP_SAV_ACT "lv_sap_sav_act" UBYTE RANGE________0___0H__0H____1_823 2 2.0 0 255 BIT_MASK 0x8 FUNCTION_LIST JOHE_OD ECU_ADDRESS 0xfd12 /end MEASUREMENT
/begin MEASUREMENT LV_SAV_DIAG_CNL "lv_sav_diag_cnl" UBYTE RANGE________0___0H__0H____1_823 2 2.0 0 255 BIT_MASK 0x8000 FUNCTION_LIST JOHE_OD ECU_ADDRESS 0xfda4 /end MEASUREMENT
/begin MEASUREMENT LV_SAV_DIAG_END "lv_sav_diag_end" UBYTE RANGE________0___0H__0H____1_823 2 2.0 0 255 BIT_MASK 0x1000 FUNCTION_LIST JOHE_OD ECU_ADDRESS 0xfda4 /end MEASUREMENT
/begin MEASUREMENT LV_SAV_DIAG_THD "lv_sav_diag_thd" UBYTE RANGE________0___0H__0H____1_823 2 2.0 0 255 BIT_MASK 0x2000 FUNCTION_LIST JOHE_OD ECU_ADDRESS 0xfda4 /end MEASUREMENT
/begin MEASUREMENT LV_SDR_DMTL "lv_sdr_dmtl" UBYTE RANGE________0___0H__0H____1_818 2 2.0 0 255 BIT_MASK 0x20 FUNCTION_LIST DMTL ECU_ADDRESS 0xfd60 /end MEASUREMENT
/begin MEASUREMENT LV_SEG_AD_ACT_STATE "lv_seg_ad_act_state" UBYTE RANGE________0___0H__0H____1_818 2 2.0 0 255 BIT_MASK 0x4 ECU_ADDRESS 0xfd2a /end MEASUREMENT
/begin MEASUREMENT LV_SEG_AD_STATE "lv_seg_ad_state" UBYTE RANGE________YES___1H__1H____NO_ 2 2.0 0 255 BIT_MASK 0x80 ECU_ADDRESS 0xfd29 /end MEASUREMENT
/begin MEASUREMENT LV_SMALL_LEAK_MES_LEN "lv_small_leak_mes_len" UBYTE RANGE________0___0H__0H____1_818 2 2.0 0 255 BIT_MASK 0x8 FUNCTION_LIST DMTL ECU_ADDRESS 0xfd63 /end MEASUREMENT
/begin MEASUREMENT LV_ST_MON2 "lv_st_mon2" UWORD RANGE________0___0H__0H____1___1 2 2.0 0 65535 BIT_MASK 0x8000 ECU_ADDRESS 0xfd80 /end MEASUREMENT
/begin MEASUREMENT STATE_CC_AJ "lv_state_cc_aj" UBYTE RANGE________0___0H__0H____1_823 2 2.0 0 255 BIT_MASK 0x4 ECU_ADDRESS 0xfd1f /end MEASUREMENT
/begin MEASUREMENT LV_STATE_RR "lv_state_rr" UBYTE RANGE________active___1H__1H_821 2 2.0 0 255 BIT_MASK 0x4 ECU_ADDRESS 0xfd45 /end MEASUREMENT
/begin MEASUREMENT LV_SUPP_ST_ACT "lv_supp_st_act" UBYTE RANGE________0___0H__0H____1_823 2 2.0 0 255 BIT_MASK 0x40 ECU_ADDRESS 0xfd4d /end MEASUREMENT
/begin MEASUREMENT LV_SWI_WUP "lv_swi_wup" UBYTE RANGE________0___0H__0H____1_823 2 2.0 0 255 BIT_MASK 0x4 ECU_ADDRESS 0xfd20 /end MEASUREMENT
/begin MEASUREMENT LV_T_COP_STEP2_1 "lv_t_cop_step2_1" UBYTE RANGE________0___0H__0H____1_818 2 2.0 0 255 BIT_MASK 0x40 ECU_ADDRESS 0xfd49 /end MEASUREMENT
/begin MEASUREMENT LV_T_COP_STEP2_2 "lv_t_cop_step2_2" UBYTE RANGE________0___0H__0H____1_818 2 2.0 0 255 BIT_MASK 0x80 ECU_ADDRESS 0xfd49 /end MEASUREMENT
/begin MEASUREMENT LV_T_DIAG_SA "lv_t_diag_sa" UWORD RANGE________0___0H__0H____1___1 2 2.0 0 65535 BIT_MASK 0x400 ECU_ADDRESS 0xfda4 /end MEASUREMENT
/begin MEASUREMENT LV_T_DLY_DMTL_PWL "lv_t_dly_dmtl_pwl" UBYTE RANGE________0___0H__0H____1_818 2 2.0 0 255 BIT_MASK 0x2 FUNCTION_LIST DMTL ECU_ADDRESS 0xfd61 /end MEASUREMENT
/begin MEASUREMENT LV_T_REL_CAN_REC "lv_t_rel_can_rec" UBYTE RANGE________0___0H__0H____1_823 2 2.0 0 255 BIT_MASK 0x8 ECU_ADDRESS 0xfd1f /end MEASUREMENT
/begin MEASUREMENT LV_T_SEG_AD_ERR "lv_t_seg_ad_err" UBYTE RANGE________0___0H__0H____1_818 2 2.0 0 255 BIT_MASK 0x10 ECU_ADDRESS 0xfd2a /end MEASUREMENT
/begin MEASUREMENT LV_T_SEG_TOOTH_ERR "lv_t_seg_tooth_err" UBYTE RANGE________0___0H__0H____1_818 2 2.0 0 255 BIT_MASK 0x8 ECU_ADDRESS 0xfd2a /end MEASUREMENT
/begin MEASUREMENT LV_TAM_REC "lv_tam_rec" UBYTE RANGE________0___0H__0H____1_818 2 2.0 0 255 BIT_MASK 0x20 FUNCTION_LIST ETM ECU_ADDRESS 0xfd1f /end MEASUREMENT
/begin MEASUREMENT LV_TEG_DOWN_MES_GRD_MAX_2 "lv_teg_down_mes_grd_max_2" UBYTE RANGE________0___0H__0H____1_823 2 2.0 0 255 BIT_MASK 0x2 ECU_ADDRESS 0xfd13 /end MEASUREMENT
/begin MEASUREMENT LV_TEG_UP_MES_GRD_MAX_1 "lv_teg_up_mes_grd_max_1" UBYTE RANGE________0___0H__0H____1_823 2 2.0 0 255 BIT_MASK 0x80 ECU_ADDRESS 0xfd12 /end MEASUREMENT
/begin MEASUREMENT LV_TEG_UP_MES_GRD_MAX_2 "lv_teg_up_mes_grd_max_2" UBYTE RANGE________0___0H__0H____1_823 2 2.0 0 255 BIT_MASK 0x1 ECU_ADDRESS 0xfd13 /end MEASUREMENT
/begin MEASUREMENT LV_TEMP_DEW_MIN_DOWN "lv_temp_dew_min_down" UBYTE RANGE________0___0H__0H____1_823 2 2.0 0 255 BIT_MASK 0x20 FUNCTION_LIST DPM ECU_ADDRESS 0xfd12 /end MEASUREMENT
/begin MEASUREMENT LV_TEMP_DEW_MIN_UP "lv_temp_dew_min_up" UBYTE RANGE________0___0H__0H____1_823 2 2.0 0 255 BIT_MASK 0x40 FUNCTION_LIST DPM ECU_ADDRESS 0xfd12 /end MEASUREMENT
/begin MEASUREMENT LV_THD_CUR_DMTL_DIF_MES "lv_thd_cur_dmtl_dif_mes" UBYTE RANGE________0___0H__0H____1_823 2 2.0 0 255 BIT_MASK 0x4 FUNCTION_LIST JOHE_OD ECU_ADDRESS 0xfd61 /end MEASUREMENT
/begin MEASUREMENT LV_TI_CH "lv_ti_ch" UBYTE RANGE________0___0H__0H____1_818 2 2.0 0 255 BIT_MASK 0x2 ECU_ADDRESS 0xfd50 /end MEASUREMENT
/begin MEASUREMENT LV_TPS_AD_CUR_OFF "lv_tps_ad_cur_off" UBYTE RANGE____________0H__0H____TPS_A 2 2.0 0 255 BIT_MASK 0x20 ECU_ADDRESS 0xfd14 /end MEASUREMENT
/begin MEASUREMENT LV_TPS_AD_DIAG_CUR_OFF "lv_tps_ad_diag_cur_off" UBYTE RANGE____________0H__0H____TP825 2 2.0 0 255 BIT_MASK 0x40 ECU_ADDRESS 0xfd14 /end MEASUREMENT
/begin MEASUREMENT LV_TPS_AD_MEC_BOL "lv_tps_ad_mec_bol" UBYTE RANGE________0___0H__0H____1_818 2 2.0 0 255 BIT_MASK 0x10 ECU_ADDRESS 0xfd0d /end MEASUREMENT
/begin MEASUREMENT LV_TPS_AD_REQ "lv_tps_ad_req" UBYTE RANGE____________0H__0H____TP826 2 2.0 0 255 BIT_MASK 0x8 ECU_ADDRESS 0xfd14 /end MEASUREMENT
/begin MEASUREMENT LV_TPS_CHG_POS "lv_tps_chg_pos" UBYTE RANGE________0___0H__0H____1_823 2 2.0 0 255 BIT_MASK 0x8 FUNCTION_LIST JOHE_OD ECU_ADDRESS 0xfd0e /end MEASUREMENT
/begin MEASUREMENT LV_TPS_CLOSE_DIR "lv_tps_close_dir" UBYTE RANGE________0___0H__0H____1_818 2 2.0 0 255 BIT_MASK 0x10 ECU_ADDRESS 0xfd17 /end MEASUREMENT
/begin MEASUREMENT LV_TPS_DIAG_CUR_OFF "lv_tps_diag_cur_off" UBYTE RANGE____________0H__0H____TPS_D 2 2.0 0 255 BIT_MASK 0x2 ECU_ADDRESS 0xfd16 /end MEASUREMENT
/begin MEASUREMENT LV_TPS_ERR "lv_tps_err" UBYTE RANGE________0___0H__0H____1_818 2 2.0 0 255 BIT_MASK 0x8 ECU_ADDRESS 0xfd15 /end MEASUREMENT
/begin MEASUREMENT LV_TPS_ERR_1 "lv_tps_err_1" UBYTE RANGE____________0H__0H____TPS_E 2 2.0 0 255 BIT_MASK 0x10 ECU_ADDRESS 0xfd15 /end MEASUREMENT
/begin MEASUREMENT LV_TPS_ERR_2 "lv_tps_err_2" UBYTE RANGE____________0H__0H____TP827 2 2.0 0 255 BIT_MASK 0x20 ECU_ADDRESS 0xfd15 /end MEASUREMENT
/begin MEASUREMENT LV_TPS_LIH_1_ACT "lv_tps_lih_1_act" UBYTE RANGE________0___0H__0H____1_818 2 2.0 0 255 BIT_MASK 0x8 ECU_ADDRESS 0xfd27 /end MEASUREMENT
/begin MEASUREMENT LV_TPS_LIH_2_ACT "lv_tps_lih_2_act" UBYTE RANGE________0___0H__0H____1_818 2 2.0 0 255 BIT_MASK 0x10 ECU_ADDRESS 0xfd27 /end MEASUREMENT
/begin MEASUREMENT LV_TPS_MAF_ERR_1 "lv_tps_maf_err_1" UBYTE RANGE____________0H__0H____TPS_M 2 2.0 0 255 BIT_MASK 0x40 ECU_ADDRESS 0xfd15 /end MEASUREMENT
/begin MEASUREMENT LV_TPS_MAF_ERR_2 "lv_tps_maf_err_2" UBYTE RANGE____________0H__0H____TP828 2 2.0 0 255 BIT_MASK 0x80 ECU_ADDRESS 0xfd15 /end MEASUREMENT
/begin MEASUREMENT LV_TPS_RATIO_ERR "lv_tps_ratio_err" UBYTE RANGE________0___0H__0H____1_823 2 2.0 0 255 BIT_MASK 0x1 FUNCTION_LIST JOHE_OD ECU_ADDRESS 0xfd16 /end MEASUREMENT
/begin MEASUREMENT LV_TPS_SP_POS "lv_tps_sp_pos" UBYTE RANGE________0___0H__0H____1_823 2 2.0 0 255 BIT_MASK 0x2 FUNCTION_LIST JOHE_OD ECU_ADDRESS 0xfd0e /end MEASUREMENT
/begin MEASUREMENT LV_TQI_LIM "lv_tqi_lim" UBYTE RANGE________0___0H__0H____1_823 2 2.0 0 255 BIT_MASK 0x40 FUNCTION_LIST JOHE_OD ECU_ADDRESS 0xfd09 /end MEASUREMENT
/begin MEASUREMENT LV_TQI_LIM_ACT "lv_tqi_lim_act" UBYTE RANGE________0___0H__0H____1_823 2 2.0 0 255 BIT_MASK 0x4 FUNCTION_LIST JOHE_OD ECU_ADDRESS 0xfd0a /end MEASUREMENT
/begin MEASUREMENT LV_TQI_MON_ACT_MON "lv_tqi_mon_act_mon" UBYTE RANGE________0___0H__0H____1_823 2 2.0 0 255 BIT_MASK 0x20 ECU_ADDRESS 0xfd0b /end MEASUREMENT
/begin MEASUREMENT LV_TQI_MON_ACT_MON2 "lv_tqi_mon_act_mon2" UWORD RANGE________0___0H__0H____1___1 2 2.0 0 65535 BIT_MASK 0x1 ECU_ADDRESS 0xfd80 /end MEASUREMENT
/begin MEASUREMENT LV_TQR_IGA_ACT "lv_tqr_iga_act" UBYTE RANGE________0___0H__0H____1_823 2 2.0 0 255 BIT_MASK 0x2 FUNCTION_LIST JOHE_OD ECU_ADDRESS 0xfd0a /end MEASUREMENT
/begin MEASUREMENT LV_TRA_IGA "lv_tra_iga" UBYTE RANGE________0___0H__0H____1_823 2 2.0 0 255 BIT_MASK 0x4 FUNCTION_LIST JOHE_OD ECU_ADDRESS 0xfd2f /end MEASUREMENT
/begin MEASUREMENT LV_TRA_KNK "lv_tra_knk" UBYTE RANGE________0___0H__0H____1_823 2 2.0 0 255 BIT_MASK 0x10 FUNCTION_LIST JOHE_OD ECU_ADDRESS 0xfd3a /end MEASUREMENT
/begin MEASUREMENT LV_VAR_SAFM "lv_var_safm" UBYTE RANGE________0___0H__0H____1_823 2 2.0 0 255 BIT_MASK 0x40 FUNCTION_LIST JOHE_OD ECU_ADDRESS 0xfd1c /end MEASUREMENT
/begin MEASUREMENT LV_VAR_SAP "lv_var_sap" UBYTE RANGE________0___0H__0H____1_823 2 2.0 0 255 BIT_MASK 0x4 FUNCTION_LIST JOHE_OD ECU_ADDRESS 0xfd1d /end MEASUREMENT
/begin MEASUREMENT LV_VB_DIF_MAX "lv_vb_dif_max" UBYTE RANGE________0___0H__0H____1_823 2 2.0 0 255 BIT_MASK 0x8 FUNCTION_LIST JOHE_OD ECU_ADDRESS 0xfd61 /end MEASUREMENT
/begin MEASUREMENT LV_VB_DMTL_FIL "lv_vb_dmtl_fil" UBYTE RANGE________0___0H__0H____1_818 2 2.0 0 255 BIT_MASK 0x10 FUNCTION_LIST DMTL ECU_ADDRESS 0xfd61 /end MEASUREMENT
/begin MEASUREMENT LV_VB_RANGE_DMTL "lv_vb_range_dmtl" UBYTE RANGE________0___0H__0H____1_818 2 2.0 0 255 BIT_MASK 0x20 ECU_ADDRESS 0xfd61 /end MEASUREMENT
/begin MEASUREMENT LV_VLS_DOWN_AFL_1 "lv_vls_down_afl_1" UBYTE RANGE________0___0H__0H____1_823 2 2.0 0 255 BIT_MASK 0x2 ECU_ADDRESS 0xfd3b /end MEASUREMENT
/begin MEASUREMENT LV_VLS_DOWN_AFL_2 "lv_vls_down_afl_2" UBYTE RANGE________0___0H__0H____1_823 2 2.0 0 255 BIT_MASK 0x4 ECU_ADDRESS 0xfd3b /end MEASUREMENT
/begin MEASUREMENT LV_VLS_DOWN_AFR_1 "lv_vls_down_afr_1" UBYTE RANGE________0___0H__0H____1_823 2 2.0 0 255 BIT_MASK 0x8 ECU_ADDRESS 0xfd3b /end MEASUREMENT
/begin MEASUREMENT LV_VLS_DOWN_AFR_2 "lv_vls_down_afr_2" UBYTE RANGE________0___0H__0H____1_823 2 2.0 0 255 BIT_MASK 0x10 ECU_ADDRESS 0xfd3b /end MEASUREMENT
/begin MEASUREMENT LV_VLS_DOWN_MAF_INT "lv_vls_down_maf_int" UBYTE RANGE________0___0H__0H____1_823 2 2.0 0 255 BIT_MASK 0x40 ECU_ADDRESS 0xfd3b /end MEASUREMENT
/begin MEASUREMENT LV_VLS_DOWN_MAF_INT_PUC "lv_vls_down_maf_int_puc" UBYTE RANGE________0___0H__0H____1_823 2 2.0 0 255 BIT_MASK 0x20 ECU_ADDRESS 0xfd3b /end MEASUREMENT
/begin MEASUREMENT MAF "maf" UWORD LINEAR______0_000000__0H___13818 2 2.0 0.0 1389.0 BIT_MASK 0xffffffff ECU_ADDRESS 0xe338 /end MEASUREMENT
/begin MEASUREMENT MAF_ADD "maf_add" SWORD LINEAR_______694_680000__FFFF800 2 2.0 -694.68 694.66 BIT_MASK 0xffffffff ECU_ADDRESS 0x40f6c /end MEASUREMENT
/begin MEASUREMENT MAF_ADD_ISA_SUB_DIAG "maf_add_isa_sub_diag" UWORD LINEAR______0_000000__0H___13818 2 2.0 0.0 1389.0 BIT_MASK 0xffffffff ECU_ADDRESS 0xe330 /end MEASUREMENT
/begin MEASUREMENT MAF_ADD_ISA_SUB_DIAG_MON "maf_add_isa_sub_diag_mon" UWORD LINEAR______0_000000__0H___13818 2 2.0 0.0 1389.0 BIT_MASK 0xffffffff ECU_ADDRESS 0x404d2 /end MEASUREMENT
/begin MEASUREMENT MAF_COR "maf_cor" UBYTE LINEAR______0_000000__0H___1389_ 2 2.0 0.0 1389.0 BIT_MASK 0xffffffff ECU_ADDRESS 0x403f9 /end MEASUREMENT
/begin MEASUREMENT MAF_CYL "maf_cyl" UWORD LINEAR______0_000000__0H___16383 2 2.0 0.0 16383.75 BIT_MASK 0xffffffff ECU_ADDRESS 0xe144 /end MEASUREMENT
/begin MEASUREMENT MAF_DIAGCPS "maf_diagcps" UWORD LINEAR______0_000000__0H___13818 2 2.0 0.0 1389.0 BIT_MASK 0xffffffff ECU_ADDRESS 0x40716 /end MEASUREMENT
/begin MEASUREMENT MAF_DYN_DLY "MAF_DYN_DLY" UWORD RANGE________0___0H__0H____1___1 2 2.0 0 65535 BIT_MASK 0x200 ECU_ADDRESS 0xfda2 /end MEASUREMENT
/begin MEASUREMENT MAF_IGA "maf_iga" UWORD LINEAR______0_000000__0H___13818 2 2.0 0.0 1389.0 BIT_MASK 0xffffffff ECU_ADDRESS 0xe32a /end MEASUREMENT
/begin MEASUREMENT MAF_IGN "maf_ign" UWORD LINEAR______0_000000__0H___13818 2 2.0 0.0 1389.0 BIT_MASK 0xffffffff ECU_ADDRESS 0xe328 /end MEASUREMENT
/begin MEASUREMENT MAF_INT_DIAG_AFL "maf_int_diag_afl" UWORD LINEAR______0_000000__0H___1820_ 2 2.0 0.0 1820.42 BIT_MASK 0xffffffff ECU_ADDRESS 0x40bea /end MEASUREMENT
/begin MEASUREMENT MAF_INT_DIAG_AFR "maf_int_diag_afr" UWORD LINEAR______0_000000__0H___1820_ 2 2.0 0.0 1820.42 BIT_MASK 0xffffffff ECU_ADDRESS 0x40bec /end MEASUREMENT
/begin MEASUREMENT MAF_INT_DLY_HST "maf_int_dly_hst" UWORD LINEAR______0_000000__0H___1820_ 2 2.0 0.0 1820.42 BIT_MASK 0xffffffff ECU_ADDRESS 0x40bf6 /end MEASUREMENT
/begin MEASUREMENT MAF_INT_DLY_PUC "maf_int_dly_puc" UWORD LINEAR______0_000000__0H___1820_ 2 2.0 0.0 1820.42 BIT_MASK 0xffffffff ECU_ADDRESS 0x40bf8 /end MEASUREMENT
/begin MEASUREMENT MAF_INT_DLY_SAP_CH "maf_int_dly_sap_ch" UWORD LINEAR______0_000000__0H___1820_ 2 2.0 0.0 1820.42 BIT_MASK 0xffffffff ECU_ADDRESS 0x40bfa /end MEASUREMENT
/begin MEASUREMENT MAF_INT_DOWN_PUC "maf_int_down_puc" UWORD LINEAR______0_000000__0H___1820_ 2 2.0 0.0 1820.42 BIT_MASK 0xffffffff ECU_ADDRESS 0x40f70 /end MEASUREMENT
/begin MEASUREMENT MAF_INT_DOWN_PUC_POST "maf_int_down_puc_post" UWORD LINEAR______0_000000__0H___1820_ 2 2.0 0.0 1820.42 BIT_MASK 0xffffffff ECU_ADDRESS 0x40f72 /end MEASUREMENT
/begin MEASUREMENT MAF_INT_MIN_VLS_EOL "maf_int_min_vls_eol" UWORD LINEAR______0_000000__0H___1820_ 2 2.0 0.0 1820.42 BIT_MASK 0xffffffff ECU_ADDRESS 0x40bf0 /end MEASUREMENT
/begin MEASUREMENT MAF_INT_PUC "maf_int_puc" UWORD LINEAR______0_000000__0H___1820_ 2 2.0 0.0 1820.42 BIT_MASK 0xffffffff ECU_ADDRESS 0x40bf4 /end MEASUREMENT
/begin MEASUREMENT MAF_INT_PUC_TEMP_SUB "maf_int_puc_temp_sub" UWORD LINEAR______0_000000__0H___36400 2 2.0 0.0 36400.0 BIT_MASK 0xffffffff FUNCTION_LIST ETM ECU_ADDRESS 0x40644 /end MEASUREMENT
/begin MEASUREMENT MAF_INT_PUC_VLS_DOWN "maf_int_puc_vls_down" UWORD LINEAR______0_000000__0H___1820_ 2 2.0 0.0 1820.42 BIT_MASK 0xffffffff ECU_ADDRESS 0x40be6 /end MEASUREMENT
/begin MEASUREMENT MAF_INT_TEMP_DOWN "maf_int_temp_down" UWORD LINEAR______0_000000__0H___36400 2 2.0 0.0 36400.0 BIT_MASK 0xffffffff ECU_ADDRESS 0x40646 /end MEASUREMENT
/begin MEASUREMENT MAF_INT_VLS_DOWN "maf_int_vls_down" UWORD LINEAR______0_000000__0H___1820_ 2 2.0 0.0 1820.42 BIT_MASK 0xffffffff ECU_ADDRESS 0x40be8 /end MEASUREMENT
/begin MEASUREMENT MAF_IVVT "maf_ivvt" UWORD LINEAR______0_000000__0H___13818 2 2.0 0.0 1389.0 BIT_MASK 0xffffffff ECU_ADDRESS 0xe326 /end MEASUREMENT
/begin MEASUREMENT MAF_KGH "maf_kgh" UWORD LINEAR______0_000000__0H___16383 2 2.0 0.0 16383.75 BIT_MASK 0xffffffff ECU_ADDRESS 0xe322 /end MEASUREMENT
/begin MEASUREMENT MAF_KGH_DIAG "maf_kgh_diag" UWORD LINEAR______0_000000__0H___16383 2 2.0 0.0 16383.75 BIT_MASK 0xffffffff ECU_ADDRESS 0xe324 /end MEASUREMENT
/begin MEASUREMENT MAF_KNK "maf_knk" UBYTE LINEAR______0_000000__0H___1389_ 2 2.0 0.0 1389.0 BIT_MASK 0xffffffff ECU_ADDRESS 0x403a9 /end MEASUREMENT
/begin MEASUREMENT MAF_MES "maf_mes" UWORD LINEAR______0_000000__0H___13818 2 2.0 0.0 1389.0 BIT_MASK 0xffffffff ECU_ADDRESS 0xe31c /end MEASUREMENT
/begin MEASUREMENT MAF_MMV "maf_mmv" UWORD LINEAR______0_000000__0H___13818 2 2.0 0.0 1389.0 BIT_MASK 0xffffffff ECU_ADDRESS 0xe31e /end MEASUREMENT
/begin MEASUREMENT MAF_MMV_CAT "maf_mmv_catvwordC1D" UWORD LINEAR______0_000000__0H___13829 2 2.0 0.0 1389.0 BIT_MASK 0xffffffff ECU_ADDRESS 0xe1c2 /end MEASUREMENT
/begin MEASUREMENT MAF_MMV_DIF "maf_mmv_dif" UWORD LINEAR______0_000000__0H___13818 2 2.0 0.0 1389.0 BIT_MASK 0xffffffff ECU_ADDRESS 0xe320 /end MEASUREMENT
/begin MEASUREMENT MAF_MON "maf_mon" UBYTE LINEAR______0_000000__0H___1389_ 2 2.0 0.0 1389.0 BIT_MASK 0xffffffff ECU_ADDRESS 0x40059 /end MEASUREMENT
/begin MEASUREMENT MAF_MON2 "maf_mon2" UBYTE LINEAR______0_000000__0H___1389_ 2 2.0 0.0 1389.0 BIT_MASK 0xffffffff FUNCTION_LIST MON2 ECU_ADDRESS 0x4006b /end MEASUREMENT
/begin MEASUREMENT MAF_SUB_1 "maf_sub_1" UWORD LINEAR______0_000000__0H___13818 2 2.0 0.0 1389.0 BIT_MASK 0xffffffff ECU_ADDRESS 0xe184 /end MEASUREMENT
/begin MEASUREMENT MAF_SUB_2 "maf_sub_2" UWORD LINEAR______0_000000__0H___13818 2 2.0 0.0 1389.0 BIT_MASK 0xffffffff ECU_ADDRESS 0xe186 /end MEASUREMENT
/begin MEASUREMENT MAF_SUB_DIAG "maf_sub_diag" UWORD LINEAR______0_000000__0H___13818 2 2.0 0.0 1389.0 BIT_MASK 0xffffffff ECU_ADDRESS 0xe332 /end MEASUREMENT
/begin MEASUREMENT MAF_SUB_DIAG_IVVT "maf_sub_diag_ivvt" UWORD LINEAR______0_000000__0H___13818 2 2.0 0.0 1389.0 BIT_MASK 0xffffffff ECU_ADDRESS 0xe336 /end MEASUREMENT
/begin MEASUREMENT MAF_SUB_DIAG_REF "maf_sub_diag_ref" UWORD LINEAR______0_000000__0H___13818 2 2.0 0.0 1389.0 BIT_MASK 0xffffffff ECU_ADDRESS 0xe334 /end MEASUREMENT
/begin MEASUREMENT MAF_SUB_IVVT "maf_sub_ivvt" UBYTE LINEAR______0_000000__0H___0_996 2 2.0 0.0 0.99609375 BIT_MASK 0xffffffff ECU_ADDRESS 0x403f8 /end MEASUREMENT
/begin MEASUREMENT MAF_SUB_MMV_MON "maf_sub_mmv_mon" UWORD LINEAR______0_000000__0H___13818 2 2.0 0.0 1389.0 BIT_MASK 0xffffffff ECU_ADDRESS 0x404cc /end MEASUREMENT
/begin MEASUREMENT MAF_SUB_MON "maf_sub_mon" UWORD LINEAR______0_000000__0H___13818 2 2.0 0.0 1389.0 BIT_MASK 0xffffffff ECU_ADDRESS 0x404ce /end MEASUREMENT
/begin MEASUREMENT MAF_SUB_TPS_MON "maf_sub_tps_mon" UBYTE LINEAR______0_000000__0H___1389_ 2 2.0 0.0 1389.0 BIT_MASK 0xffffffff ECU_ADDRESS 0x4005f /end MEASUREMENT
/begin MEASUREMENT MAP_ "map" UWORD LINEAR______0_000000__0H___5434_ 2 2.0 0.0 5434.2598 BIT_MASK 0xffffffff ECU_ADDRESS 0x40f5c /end MEASUREMENT
/begin MEASUREMENT MAP_GRD "map_grd" SWORD LINEAR_______5434_259766__FFF830 2 2.0 -5434.2598 5434.1768 BIT_MASK 0xffffffff ECU_ADDRESS 0x40f5e /end MEASUREMENT
/begin MEASUREMENT MIS_A_1 "mis_aC0D" UWORD LINEAR______0_000000__0H___65775 2 2.0 0.0 65535.0 BIT_MASK 0xffffffff ECU_ADDRESS 0xe284 /end MEASUREMENT
/begin MEASUREMENT MIS_A_5 "mis_aC1D" UWORD LINEAR______0_000000__0H___65775 2 2.0 0.0 65535.0 BIT_MASK 0xffffffff ECU_ADDRESS 0xe286 /end MEASUREMENT
/begin MEASUREMENT MIS_A_3 "mis_aC2D" UWORD LINEAR______0_000000__0H___65775 2 2.0 0.0 65535.0 BIT_MASK 0xffffffff ECU_ADDRESS 0xe288 /end MEASUREMENT
/begin MEASUREMENT MIS_A_6 "mis_aC3D" UWORD LINEAR______0_000000__0H___65775 2 2.0 0.0 65535.0 BIT_MASK 0xffffffff ECU_ADDRESS 0xe28a /end MEASUREMENT
/begin MEASUREMENT MIS_A_2 "mis_aC4D" UWORD LINEAR______0_000000__0H___65775 2 2.0 0.0 65535.0 BIT_MASK 0xffffffff ECU_ADDRESS 0xe28c /end MEASUREMENT
/begin MEASUREMENT MIS_A_4 "mis_aC5D" UWORD LINEAR______0_000000__0H___65775 2 2.0 0.0 65535.0 BIT_MASK 0xffffffff ECU_ADDRESS 0xe28e /end MEASUREMENT
/begin MEASUREMENT MIS_A_INSIDE_FTP "mis_a_inside_ftp" UBYTE LINEAR______0_000000__0H___255_0 2 2.0 0.0 255.0 BIT_MASK 0xffffffff ECU_ADDRESS 0x407ba /end MEASUREMENT
/begin MEASUREMENT MIS_A_OBD_CTR "mis_a_obd_ctr" UBYTE LINEAR______0_000000__0H___255_0 2 2.0 0.0 255.0 BIT_MASK 0xffffffff ECU_ADDRESS 0x4018d /end MEASUREMENT
/begin MEASUREMENT MIS_A_WIN_MAF_BOL "mis_a_winvmaf_bol" UBYTE LINEAR______0_000000__0H___1389_ 2 2.0 0.0 1389.0 BIT_MASK 0xffffffff ECU_ADDRESS 0xe1e5 /end MEASUREMENT
/begin MEASUREMENT MIS_A_WIN_MAF_TOL "mis_a_winvmaf_tol" UBYTE LINEAR______0_000000__0H___1389_ 2 2.0 0.0 1389.0 BIT_MASK 0xffffffff ECU_ADDRESS 0xe1e7 /end MEASUREMENT
/begin MEASUREMENT MIS_A_WIN_N_32_BOL "mis_a_winvn_32_bol" UBYTE ES_8_RES 2 2.0 0.0 8160.0 BIT_MASK 0xffffffff ECU_ADDRESS 0xe1e4 /end MEASUREMENT
/begin MEASUREMENT MIS_A_WIN_N_32_TOL "mis_a_winvn_32_tol" UBYTE ES_8_RES 2 2.0 0.0 8160.0 BIT_MASK 0xffffffff ECU_ADDRESS 0xe1e6 /end MEASUREMENT
/begin MEASUREMENT MIS_B_1 "mis_bC0D" UWORD LINEAR______0_000000__0H___65775 2 2.0 0.0 65535.0 BIT_MASK 0xffffffff ECU_ADDRESS 0xe290 /end MEASUREMENT
/begin MEASUREMENT MIS_B_5 "mis_bC1D" UWORD LINEAR______0_000000__0H___65775 2 2.0 0.0 65535.0 BIT_MASK 0xffffffff ECU_ADDRESS 0xe292 /end MEASUREMENT
/begin MEASUREMENT MIS_B_3 "mis_bC2D" UWORD LINEAR______0_000000__0H___65775 2 2.0 0.0 65535.0 BIT_MASK 0xffffffff ECU_ADDRESS 0xe294 /end MEASUREMENT
/begin MEASUREMENT MIS_B_6 "mis_bC3D" UWORD LINEAR______0_000000__0H___65775 2 2.0 0.0 65535.0 BIT_MASK 0xffffffff ECU_ADDRESS 0xe296 /end MEASUREMENT
/begin MEASUREMENT MIS_B_2 "mis_bC4D" UWORD LINEAR______0_000000__0H___65775 2 2.0 0.0 65535.0 BIT_MASK 0xffffffff ECU_ADDRESS 0xe298 /end MEASUREMENT
/begin MEASUREMENT MIS_B_4 "mis_bC5D" UWORD LINEAR______0_000000__0H___65775 2 2.0 0.0 65535.0 BIT_MASK 0xffffffff ECU_ADDRESS 0xe29a /end MEASUREMENT
/begin MEASUREMENT MIS_B_WIN_MAF_BOL "mis_b_winvmaf_bol" UBYTE LINEAR______0_000000__0H___1389_ 2 2.0 0.0 1389.0 BIT_MASK 0xffffffff ECU_ADDRESS 0xe1e9 /end MEASUREMENT
/begin MEASUREMENT MIS_B_WIN_MAF_TOL "mis_b_winvmaf_tol" UBYTE LINEAR______0_000000__0H___1389_ 2 2.0 0.0 1389.0 BIT_MASK 0xffffffff ECU_ADDRESS 0xe1eb /end MEASUREMENT
/begin MEASUREMENT MIS_B_WIN_N_32_BOL "mis_b_winvn_32_bol" UBYTE ES_8_RES 2 2.0 0.0 8160.0 BIT_MASK 0xffffffff ECU_ADDRESS 0xe1e8 /end MEASUREMENT
/begin MEASUREMENT MIS_B_WIN_N_32_TOL "mis_b_winvn_32_tol" UBYTE ES_8_RES 2 2.0 0.0 8160.0 BIT_MASK 0xffffffff ECU_ADDRESS 0xe1ea /end MEASUREMENT
/begin MEASUREMENT MIS_B4_OBD_CTR "mis_b4_obd_ctr" UBYTE LINEAR______0_000000__0H___255_0 2 2.0 0.0 255.0 BIT_MASK 0xffffffff ECU_ADDRESS 0x4018e /end MEASUREMENT
/begin MEASUREMENT MIS_DET "mis_detvlongword" ULONG UNSIGNED_LONG831 2 2.0 0.0 4.2949673e+009 BIT_MASK 0xffffffff ECU_ADDRESS 0xe1e0 /end MEASUREMENT
/begin MEASUREMENT MIS_NR_OFF_IV "mis_nr_off_iv" UBYTE LINEAR______0_000000__0H___255_0 2 2.0 0.0 255.0 BIT_MASK 0xffffffff ECU_ADDRESS 0x4018f /end MEASUREMENT
/begin MEASUREMENT MIS_NR_PUC "mis_nr_puc" UBYTE LINEAR______0_000000__0H___255_0 2 2.0 0.0 255.0 BIT_MASK 0xffffffff ECU_ADDRESS 0x40196 /end MEASUREMENT
/begin MEASUREMENT MIS_NR_TDC_A "mis_nr_tdc_a" UWORD LINEAR______0_000000__0H___65535 2 2.0 0.0 65535.0 BIT_MASK 0xffffffff ECU_ADDRESS 0xe26a /end MEASUREMENT
/begin MEASUREMENT MIS_NR_TDC_B "mis_nr_tdc_b" UWORD LINEAR______0_000000__0H___65535 2 2.0 0.0 65535.0 BIT_MASK 0xffffffff ECU_ADDRESS 0xe26c /end MEASUREMENT
/begin MEASUREMENT STATE_MIS_ER "mis_state_er" UBYTE LINEAR______0_000000__0H___1_832 2 2.0 0.0 1.0 BIT_MASK 0xffffffff ECU_ADDRESS 0x40180 /end MEASUREMENT
/begin MEASUREMENT MIS_SUM_B "mis_sum_b" UWORD LINEAR______0_000000__0H___65535 2 2.0 0.0 65535.0 BIT_MASK 0xffffffff ECU_ADDRESS 0xe26e /end MEASUREMENT
/begin MEASUREMENT MIS_SUM_CARB_1 "mis_sum_carbC0D" UWORD LINEAR______0_000000__0H___65775 2 2.0 0.0 65535.0 BIT_MASK 0xffffffff ECU_ADDRESS 0xe20e /end MEASUREMENT
/begin MEASUREMENT MIS_SUM_CARB_5 "mis_sum_carbC1D" UWORD LINEAR______0_000000__0H___65775 2 2.0 0.0 65535.0 BIT_MASK 0xffffffff ECU_ADDRESS 0xe210 /end MEASUREMENT
/begin MEASUREMENT MIS_SUM_CARB_3 "mis_sum_carbC2D" UWORD LINEAR______0_000000__0H___65775 2 2.0 0.0 65535.0 BIT_MASK 0xffffffff ECU_ADDRESS 0xe212 /end MEASUREMENT
/begin MEASUREMENT MIS_SUM_CARB_6 "mis_sum_carbC3D" UWORD LINEAR______0_000000__0H___65775 2 2.0 0.0 65535.0 BIT_MASK 0xffffffff ECU_ADDRESS 0xe214 /end MEASUREMENT
/begin MEASUREMENT MIS_SUM_CARB_2 "mis_sum_carbC4D" UWORD LINEAR______0_000000__0H___65775 2 2.0 0.0 65535.0 BIT_MASK 0xffffffff ECU_ADDRESS 0xe216 /end MEASUREMENT
/begin MEASUREMENT MIS_SUM_CARB_4 "mis_sum_carbC5D" UWORD LINEAR______0_000000__0H___65775 2 2.0 0.0 65535.0 BIT_MASK 0xffffffff ECU_ADDRESS 0xe218 /end MEASUREMENT
/begin MEASUREMENT ID_MIS_1 "mis_sum_erC0D" UWORD LINEAR______0_000000__0H___65775 2 2.0 0.0 65535.0 BIT_MASK 0xffffffff ECU_ADDRESS 0xe202 /end MEASUREMENT
/begin MEASUREMENT ID_MIS_5 "mis_sum_erC1D" UWORD LINEAR______0_000000__0H___65775 2 2.0 0.0 65535.0 BIT_MASK 0xffffffff ECU_ADDRESS 0xe204 /end MEASUREMENT
/begin MEASUREMENT ID_MIS_3 "mis_sum_erC2D" UWORD LINEAR______0_000000__0H___65775 2 2.0 0.0 65535.0 BIT_MASK 0xffffffff ECU_ADDRESS 0xe206 /end MEASUREMENT
/begin MEASUREMENT ID_MIS_6 "mis_sum_erC3D" UWORD LINEAR______0_000000__0H___65775 2 2.0 0.0 65535.0 BIT_MASK 0xffffffff ECU_ADDRESS 0xe208 /end MEASUREMENT
/begin MEASUREMENT ID_MIS_2 "mis_sum_erC4D" UWORD LINEAR______0_000000__0H___65775 2 2.0 0.0 65535.0 BIT_MASK 0xffffffff ECU_ADDRESS 0xe20a /end MEASUREMENT
/begin MEASUREMENT ID_MIS_4 "mis_sum_erC5D" UWORD LINEAR______0_000000__0H___65775 2 2.0 0.0 65535.0 BIT_MASK 0xffffffff ECU_ADDRESS 0xe20c /end MEASUREMENT
/begin MEASUREMENT STATE_ENGINE_1 "mot_zust_1" UWORD LINEAR______0_000000__0H___65762 2 2.0 0.0 65535.0 BIT_MASK 0xffffffff ECU_ADDRESS 0xfd94 /end MEASUREMENT
/begin MEASUREMENT STATE_ENGINE_2 "mot_zust_2" UWORD LINEAR______0_000000__0H___65762 2 2.0 0.0 65535.0 BIT_MASK 0xffffffff ECU_ADDRESS 0xfd96 /end MEASUREMENT
/begin MEASUREMENT STATE_ENGINE_4 "mot_zust_4" UWORD LINEAR______0_000000__0H___65762 2 2.0 0.0 65535.0 BIT_MASK 0xffffffff ECU_ADDRESS 0xfd98 /end MEASUREMENT
/begin MEASUREMENT MTCPWM "mtcpwm" SWORD LINEAR_______100_000000__FFFF833 2 2.0 -100.0 99.996948 BIT_MASK 0xffffffff ECU_ADDRESS 0xe0c8 /end MEASUREMENT
/begin MEASUREMENT MTCPWM_ADD "mtcpwm_add" SWORD LINEAR_______100_000000__FFFF834 2 2.0 -100.0 99.996948 BIT_MASK 0xffffffff ECU_ADDRESS 0xe0d4 /end MEASUREMENT
/begin MEASUREMENT MTCPWM_CTL "mtcpwm_ctl" SLONG LINEAR_______400_000000__FFFE000 2 2.0 -400.0 399.99695 BIT_MASK 0xffffffff ECU_ADDRESS 0xe0d0 /end MEASUREMENT
/begin MEASUREMENT MTCPWM_D "mtcpwm_d" SWORD LINEAR_______400_000000__FFFF800 2 2.0 -400.0 399.98779 BIT_MASK 0xffffffff ECU_ADDRESS 0xe0ce /end MEASUREMENT
/begin MEASUREMENT MTCPWM_I "mtcpwm_i" SWORD LINEAR_______100_000000__FFFF834 2 2.0 -100.0 99.996948 BIT_MASK 0xffffffff ECU_ADDRESS 0xe0c6 /end MEASUREMENT
/begin MEASUREMENT MTCPWM_I_ADD "mtcpwm_i_add" SWORD LINEAR_______100_000000__FFFF834 2 2.0 -100.0 99.996948 BIT_MASK 0xffffffff ECU_ADDRESS 0xe0d6 /end MEASUREMENT
/begin MEASUREMENT MTCPWM_P "mtcpwm_p" SWORD LINEAR_______400_000000__FFFF800 2 2.0 -400.0 399.98779 BIT_MASK 0xffffffff ECU_ADDRESS 0xe0c4 /end MEASUREMENT
/begin MEASUREMENT LV_LAM_AD_FAC_RGL_1 "mult_adap_1_eingeschwungen" UBYTE RANGE________YES___1H__1H____NO_ 2 2.0 0 255 BIT_MASK 0x40 ECU_ADDRESS 0x40c36 /end MEASUREMENT
/begin MEASUREMENT LV_LAM_AD_FAC_RGL_2 "mult_adap_2_eingeschwungen" UBYTE RANGE________YES___1H__1H____NO_ 2 2.0 0 255 BIT_MASK 0x40 ECU_ADDRESS 0x40d94 /end MEASUREMENT
/begin MEASUREMENT N "n" UWORD LINEAR______0_000000__0H___81612 2 2.0 0.0 8160.0 BIT_MASK 0xffffffff ECU_ADDRESS 0xe0e4 /end MEASUREMENT
/begin MEASUREMENT N_32 "n_32" UBYTE LINEAR______0_000000__0H___8160_ 2 2.0 0.0 8160.0 BIT_MASK 0xffffffff ECU_ADDRESS 0x4007f /end MEASUREMENT
/begin MEASUREMENT N_32_MON "n_32_mon" UBYTE LINEAR______0_000000__0H___8160_ 2 2.0 0.0 8160.0 BIT_MASK 0xffffffff ECU_ADDRESS 0x40004 /end MEASUREMENT
/begin MEASUREMENT N_32_MON2 "n_32_mon2" UBYTE LINEAR______0_000000__0H___8160_ 2 2.0 0.0 8160.0 BIT_MASK 0xffffffff FUNCTION_LIST MON2 ECU_ADDRESS 0x40066 /end MEASUREMENT
/begin MEASUREMENT N_32_SUB_MON "n_32_sub_mon" UBYTE LINEAR______0_000000__0H___8160_ 2 2.0 0.0 8160.0 BIT_MASK 0xffffffff ECU_ADDRESS 0x40006 /end MEASUREMENT
/begin MEASUREMENT LV_N_MAX "n_beg" UWORD RANGE________N_BEG___1H__1H_____ 2 2.0 0 65535 BIT_MASK 0x8000 ECU_ADDRESS 0xfd94 /end MEASUREMENT
/begin MEASUREMENT N_DIAGCPS "n_diagcps" UWORD LINEAR______0_000000__0H___81612 2 2.0 0.0 8160.0 BIT_MASK 0xffffffff ECU_ADDRESS 0x40714 /end MEASUREMENT
/begin MEASUREMENT N_DIF "n_dif" SWORD LINEAR_______32768_000000__FFFF8 2 2.0 -32768.0 32767.0 BIT_MASK 0xffffffff ECU_ADDRESS 0x4089a /end MEASUREMENT
/begin MEASUREMENT N_DIF_CH_2 "n_dif_ch_2" UWORD LINEAR______0_000000__0H___81605 2 2.0 0.0 8160.0 BIT_MASK 0xffffffff ECU_ADDRESS 0x40838 /end MEASUREMENT
/begin MEASUREMENT N_DIF_CLRC_CALC "n_dif_clrc_calc" UBYTE LINEAR______0_000000__0H___0_996 2 2.0 0.0 0.99609375 BIT_MASK 0xffffffff ECU_ADDRESS 0x401ea /end MEASUREMENT
/begin MEASUREMENT N_DIF_COR "n_dif_cor" SWORD LINEAR_______32768_000000__FFFF8 2 2.0 -32768.0 32767.0 BIT_MASK 0xffffffff ECU_ADDRESS 0x408a4 /end MEASUREMENT
/begin MEASUREMENT N_DIF_MMV "n_dif_mmv" SWORD LINEAR_______32768_000000__FFFF8 2 2.0 -32768.0 32767.0 BIT_MASK 0xffffffff ECU_ADDRESS 0x408a2 /end MEASUREMENT
/begin MEASUREMENT N_DYN_DLY "N_DYN_DLY" UWORD RANGE________0___0H__0H____1___1 2 2.0 0 65535 BIT_MASK 0x4 ECU_ADDRESS 0xfda2 /end MEASUREMENT
/begin MEASUREMENT N_ECF "n_ecf" UBYTE LINEAR______0_000000__0H___15100 2 2.0 0.0 15.0 BIT_MASK 0xffffffff ECU_ADDRESS 0x40118 /end MEASUREMENT
/begin MEASUREMENT N_ECF_COR_FIL "n_ecf_cor_fil" UBYTE LINEAR______0_000000__0H___15_94 2 2.0 0.0 15.94 BIT_MASK 0xffffffff ECU_ADDRESS 0x40120 /end MEASUREMENT
/begin MEASUREMENT N_END_IS "n_end_is" UWORD LINEAR______0_000000__0H___81612 2 2.0 0.0 8160.0 BIT_MASK 0xffffffff ECU_ADDRESS 0x408a6 /end MEASUREMENT
/begin MEASUREMENT N_GRD "n_grd" SBYTE LINEAR_______4096_000000__FFF129 2 2.0 -4096.0 4064.0 BIT_MASK 0xffffffff ECU_ADDRESS 0x40082 /end MEASUREMENT
/begin MEASUREMENT N_HYS_MIN_PUC "n_hys_min_puc" UBYTE LINEAR______0_000000__0H___8160_ 2 2.0 0.0 8160.0 BIT_MASK 0xffffffff ECU_ADDRESS 0x4019e /end MEASUREMENT
/begin MEASUREMENT N_HYS_PUC "n_hys_puc" UBYTE LINEAR______0_000000__0H___8160_ 2 2.0 0.0 8160.0 BIT_MASK 0xffffffff ECU_ADDRESS 0x4019f /end MEASUREMENT
/begin MEASUREMENT N_KNK "n_knk" UBYTE LINEAR______0_000000__0H___8160_ 2 2.0 0.0 8160.0 BIT_MASK 0xffffffff ECU_ADDRESS 0x403aa /end MEASUREMENT
/begin MEASUREMENT N_MAX "n_max" UBYTE LINEAR______0_000000__0H___8160_ 2 2.0 0.0 8160.0 BIT_MASK 0xffffffff ECU_ADDRESS 0x403df /end MEASUREMENT
/begin MEASUREMENT N_MAX_AMT "n_max_amt" UBYTE LINEAR______0_000000__0H___8160_ 2 2.0 0.0 8160.0 BIT_MASK 0xffffffff FUNCTION_LIST Z1S1 ECU_ADDRESS 0xfb60 /end MEASUREMENT
/begin MEASUREMENT N_MAX_AV "n_max_av" UBYTE LINEAR______0_000000__0H___8160_ 2 2.0 0.0 8160.0 BIT_MASK 0xffffffff ECU_ADDRESS 0x403dc /end MEASUREMENT
/begin MEASUREMENT N_MAX_DIAG "n_max_diag" UWORD LINEAR______0_000000__0H___81835 2 2.0 0.0 8191.875 BIT_MASK 0xffffffff ECU_ADDRESS 0xe316 /end MEASUREMENT
/begin MEASUREMENT N_MAX_DIAG_TAR "n_max_diag_tar" UBYTE LINEAR______0_000000__0H___8160_ 2 2.0 0.0 8160.0 BIT_MASK 0xffffffff ECU_ADDRESS 0x403e4 /end MEASUREMENT
/begin MEASUREMENT N_MAX_MAX "n_max_max" UBYTE LINEAR______0_000000__0H___8160_ 2 2.0 0.0 8160.0 BIT_MASK 0xffffffff ECU_ADDRESS 0x403e0 /end MEASUREMENT
/begin MEASUREMENT N_MAX_TOL_ST "n_max_tol_st" UBYTE LINEAR______0_000000__0H___8160_ 2 2.0 0.0 8160.0 BIT_MASK 0xffffffff ECU_ADDRESS 0x4019b /end MEASUREMENT
/begin MEASUREMENT N_MIN_ER "n_min_er" UWORD LINEAR______0_000000__0H___81612 2 2.0 0.0 8160.0 BIT_MASK 0xffffffff ECU_ADDRESS 0xe29c /end MEASUREMENT
/begin MEASUREMENT N_MIN_PUC "n_min_puc" UBYTE LINEAR______0_000000__0H___8160_ 2 2.0 0.0 8160.0 BIT_MASK 0xffffffff ECU_ADDRESS 0x401a1 /end MEASUREMENT
/begin MEASUREMENT N_MMV_CAT "n_mmv_catvwordC1D" UWORD IS_13_RES 2 2.0 0.0 8160.0 BIT_MASK 0xffffffff ECU_ADDRESS 0xe1c6 /end MEASUREMENT
/begin MEASUREMENT N_PERC "n_perc" UBYTE LINEAR______0_000000__0H___99_60 2 2.0 0.0 99.609375 BIT_MASK 0xffffffff ECU_ADDRESS 0x40122 /end MEASUREMENT
/begin MEASUREMENT N_PERC_ECF "n_perc_ecf" UBYTE LINEAR______0_000000__0H___99_60 2 2.0 0.0 99.609375 BIT_MASK 0xffffffff ECU_ADDRESS 0x40123 /end MEASUREMENT
/begin MEASUREMENT N_SP_ADD_BAS "n_sp_add_bas" UWORD LINEAR______0_000000__0H___81605 2 2.0 0.0 8160.0 BIT_MASK 0xffffffff ECU_ADDRESS 0x408c0 /end MEASUREMENT
/begin MEASUREMENT N_SP_ADD_SIF "n_sp_add_sif" SWORD LINEAR_______8192_000000__FFFF80 2 2.0 -8192.0 8191.75 BIT_MASK 0xffffffff ECU_ADDRESS 0x408ac /end MEASUREMENT
/begin MEASUREMENT N_SP_DIF_BAT "n_sp_dif_bat" UWORD LINEAR______0_000000__0H___81605 2 2.0 0.0 8160.0 BIT_MASK 0xffffffff ECU_ADDRESS 0x408aa /end MEASUREMENT
/begin MEASUREMENT N_SP_DIF_VB "n_sp_dif_vb" UWORD LINEAR______0_000000__0H___1000_ 2 2.0 0.0 1000.0 BIT_MASK 0xffffffff ECU_ADDRESS 0x4083a /end MEASUREMENT
/begin MEASUREMENT N_SP_IS "n_sp_is" UWORD LINEAR______0_000000__0H___81612 2 2.0 0.0 8160.0 BIT_MASK 0xffffffff ECU_ADDRESS 0x4083e /end MEASUREMENT
/begin MEASUREMENT N_SP_IS_SIF "n_sp_is_sif" UBYTE LINEAR_______256_000000__0H___81 2 2.0 -256.0 254.0 BIT_MASK 0xffffffff ECU_ADDRESS 0x401df /end MEASUREMENT
/begin MEASUREMENT N_VS_CRU "n_vs_cru" UWORD LINEAR______0_000000__0H___81608 2 2.0 0.0 8160.0 BIT_MASK 0xffffffff ECU_ADDRESS 0x40680 /end MEASUREMENT
/begin MEASUREMENT N_VS_CRU_GRD "n_vs_cru_grd" SWORD LINEAR_______8160_000000__FFFFE0 2 2.0 -8160.0 8160.0 BIT_MASK 0xffffffff ECU_ADDRESS 0x407f6 /end MEASUREMENT
/begin MEASUREMENT NL_1 "nlC0D" UWORD LINEAR______0_000000__0H___5_133 2 2.0 0.0 5.1 BIT_MASK 0xffffffff ECU_ADDRESS 0xe2f6 /end MEASUREMENT
/begin MEASUREMENT NL_5 "nlC1D" UWORD LINEAR______0_000000__0H___5_133 2 2.0 0.0 5.1 BIT_MASK 0xffffffff ECU_ADDRESS 0xe2f8 /end MEASUREMENT
/begin MEASUREMENT NL_3 "nlC2D" UWORD LINEAR______0_000000__0H___5_133 2 2.0 0.0 5.1 BIT_MASK 0xffffffff ECU_ADDRESS 0xe2fa /end MEASUREMENT
/begin MEASUREMENT NL_6 "nlC3D" UWORD LINEAR______0_000000__0H___5_133 2 2.0 0.0 5.1 BIT_MASK 0xffffffff ECU_ADDRESS 0xe2fc /end MEASUREMENT
/begin MEASUREMENT NL_2 "nlC4D" UWORD LINEAR______0_000000__0H___5_133 2 2.0 0.0 5.1 BIT_MASK 0xffffffff ECU_ADDRESS 0xe2fe /end MEASUREMENT
/begin MEASUREMENT NL_4 "nlC5D" UWORD LINEAR______0_000000__0H___5_133 2 2.0 0.0 5.1 BIT_MASK 0xffffffff ECU_ADDRESS 0xe300 /end MEASUREMENT
/begin MEASUREMENT NL_1...6 "nl_1_6" UWORD LINEAR______0_000000__0H___5_133 2 2.0 0.0 5.1 BIT_MASK 0xffffffff ECU_ADDRESS 0xe38e /end MEASUREMENT
/begin MEASUREMENT NL_FAC_MMV "nl_fac_mmv" UWORD LINEAR______0_000000__0H___2_054 2 2.0 0.0 2.0 BIT_MASK 0xffffffff ECU_ADDRESS 0xe304 /end MEASUREMENT
/begin MEASUREMENT NR_IP_TI_COP_1 "nr_ip_ti_cop_1" UWORD LINEAR______1_000000__100H___5_0 2 2.0 1.0 5.0 BIT_MASK 0xffffffff ECU_ADDRESS 0x410f0 /end MEASUREMENT
/begin MEASUREMENT NR_IP_TI_COP_2 "nr_ip_ti_cop_2" UWORD LINEAR______1_000000__100H___5_0 2 2.0 1.0 5.0 BIT_MASK 0xffffffff ECU_ADDRESS 0x410f2 /end MEASUREMENT
/begin MEASUREMENT LV_AST "ns" UWORD RANGE________AST___1H__1H_______ 2 2.0 0 65535 BIT_MASK 0x8 ECU_ADDRESS 0xfd94 /end MEASUREMENT
/begin MEASUREMENT OV_FAC_IGA_CH_2_IS "ov_fac_iga_ch_2_isvbyteC1D" UBYTE LINEAR______0_000000__0H___0_996 2 2.0 0.0 0.99609375 BIT_MASK 0xffffffff ECU_ADDRESS 0xe381 /end MEASUREMENT
/begin MEASUREMENT OV_FAC_RAMP_CP "ov_fac_ramp_cp" UBYTE LINEAR______0_000000__0H___15_94 2 2.0 0.0 15.94 BIT_MASK 0xffffffff ECU_ADDRESS 0x40126 /end MEASUREMENT
/begin MEASUREMENT OV_FAC_THD_ER "ov_fac_thd_er" UWORD LINEAR______1_000000__100H___1_9 2 2.0 1.0 1.9961 BIT_MASK 0xffffffff ECU_ADDRESS 0xe1ee /end MEASUREMENT
/begin MEASUREMENT OV_FAC_TIA_TCO "ov_fac_tia_tco" UBYTE LINEAR______0_000000__0H___0_996 2 2.0 0.0 0.99609375 BIT_MASK 0xffffffff ECU_ADDRESS 0x401b5 /end MEASUREMENT
/begin MEASUREMENT OV_FAC_TIA_TCO_IS "ov_fac_tia_tco_is" UBYTE LINEAR______0_000000__0H___0_996 2 2.0 0.0 0.99609375 BIT_MASK 0xffffffff ECU_ADDRESS 0x40420 /end MEASUREMENT
/begin MEASUREMENT OV_IGA_FAC_IS "ov_iga_fac_is" UBYTE LINEAR______0_000000__0H___0_996 2 2.0 0.0 0.99609375 BIT_MASK 0xffffffff ECU_ADDRESS 0x401d0 /end MEASUREMENT
/begin MEASUREMENT OV_IGA_TCO_CH "ov_iga_tco_chvbyteC1D" UBYTE LINEAR______0_000000__0H___0_996 2 2.0 0.0 0.99609375 BIT_MASK 0xffffffff ECU_ADDRESS 0xe37d /end MEASUREMENT
/begin MEASUREMENT OV_IGA_TCO_CH_IS "ov_iga_tco_ch_isvbyteC1D" UBYTE LINEAR______0_000000__0H___0_996 2 2.0 0.0 0.99609375 BIT_MASK 0xffffffff ECU_ADDRESS 0xe37f /end MEASUREMENT
/begin MEASUREMENT OV_IGA_TCO_IS "ov_iga_tco_is" UBYTE LINEAR_______48_000000__0H___47_ 2 2.0 -48.0 47.625 BIT_MASK 0xffffffff ECU_ADDRESS 0x40422 /end MEASUREMENT
/begin MEASUREMENT OV_IGA_TCO_ST "ov_iga_tco_st" UBYTE LINEAR_______48_000000__0H___47_ 2 2.0 -48.0 47.625 BIT_MASK 0xffffffff ECU_ADDRESS 0x401c9 /end MEASUREMENT
/begin MEASUREMENT OV_IGAB_ADC "ov_igab_adc" UBYTE LINEAR_______23_625000__0H___72_ 2 2.0 -23.625 72.0 BIT_MASK 0xffffffff ECU_ADDRESS 0x401b6 /end MEASUREMENT
/begin MEASUREMENT OV_ISAPWM "ov_isapwm" SWORD LINEAR_______50_000000__FFFF8000 2 2.0 -50.0 49.9985 BIT_MASK 0xffffffff ECU_ADDRESS 0x4082c /end MEASUREMENT
/begin MEASUREMENT OV_ISAPWM_ACIN "ov_isapwm_acin" UWORD LINEAR______0_000000__0H___399_9 2 2.0 0.0 399.9938 BIT_MASK 0xffffffff ECU_ADDRESS 0x4082e /end MEASUREMENT
/begin MEASUREMENT OV_ISAPWM_ADD_AT "ov_isapwm_add_at" UWORD LINEAR______0_000000__0H___399_9 2 2.0 0.0 399.9938 BIT_MASK 0xffffffff ECU_ADDRESS 0x4088e /end MEASUREMENT
/begin MEASUREMENT OV_ISAPWM_ADD_TQ_CONV "ov_isapwm_add_tq_conv" UWORD LINEAR______0_000000__0H___399_9 2 2.0 0.0 399.9938 BIT_MASK 0xffffffff ECU_ADDRESS 0x40890 /end MEASUREMENT
/begin MEASUREMENT OV_ISAPWM_DRI "ov_isapwm_dri" UWORD LINEAR______0_000000__0H___399_9 2 2.0 0.0 399.9938 BIT_MASK 0xffffffff ECU_ADDRESS 0x40830 /end MEASUREMENT
/begin MEASUREMENT OV_ISAPWM_DRI_ACIN__TCO "ov_isapwm_dri_acin__tco" UWORD LINEAR______0_000000__0H___399_9 2 2.0 0.0 399.9938 BIT_MASK 0xffffffff ECU_ADDRESS 0x40832 /end MEASUREMENT
/begin MEASUREMENT OV_ISAPWM_DRI_LGRD_DEC "ov_isapwm_dri_lgrd_dec" UWORD LINEAR______0_006100__1H___24_99 2 2.0 0.0061 24.9938 BIT_MASK 0xffffffff ECU_ADDRESS 0x40840 /end MEASUREMENT
/begin MEASUREMENT OV_ISAPWM_DRI_LGRD_INC "ov_isapwm_dri_lgrd_inc" UWORD LINEAR______0_006100__1H___24_99 2 2.0 0.0061 24.9938 BIT_MASK 0xffffffff ECU_ADDRESS 0x40842 /end MEASUREMENT
/begin MEASUREMENT OV_ISAPWM_INI_I_ST "ov_isapwm_ini_i_st" SWORD LINEAR_______50_000000__FFFF8000 2 2.0 -50.0 49.9985 BIT_MASK 0xffffffff ECU_ADDRESS 0x408ae /end MEASUREMENT
/begin MEASUREMENT OV_ISAPWM_TCO_FAC_IS "ov_isapwm_tco_fac_is" UBYTE LINEAR______0_000000__0H___1_992 2 2.0 0.0 1.9921875 BIT_MASK 0xffffffff ECU_ADDRESS 0x401dc /end MEASUREMENT
/begin MEASUREMENT OV_ISAPWM_TIA_FAC "ov_isapwm_tia_fac" UWORD LINEAR______0_000000__0H___1_999 2 2.0 0.0 1.99997 BIT_MASK 0xffffffff ECU_ADDRESS 0x40844 /end MEASUREMENT
/begin MEASUREMENT OV_PVS_MIN_EF "ov_pvs_min_ef" UBYTE LINEAR______0_000000__0H___11942 2 2.0 0.0 119.53125 BIT_MASK 0xffffffff ECU_ADDRESS 0x4017b /end MEASUREMENT
/begin MEASUREMENT OV_T_DLY_TCO_1_1 "ov_t_dly_tco_1_1" UWORD LINEAR_______1_279900__0H___1_66 2 2.0 -1.2799 1.2798 BIT_MASK 0xffffffff ECU_ADDRESS 0x40c0e /end MEASUREMENT
/begin MEASUREMENT OV_T_DLY_TCO_1_2 "ov_t_dly_tco_1_2" UWORD LINEAR_______1_279900__0H___1_66 2 2.0 -1.2799 1.2798 BIT_MASK 0xffffffff ECU_ADDRESS 0x40c10 /end MEASUREMENT
/begin MEASUREMENT OV_T_DLY_TCO_1_IS_1 "ov_t_dly_tco_1_is_1" UWORD LINEAR_______1_279900__0H___1_66 2 2.0 -1.2799 1.2798 BIT_MASK 0xffffffff ECU_ADDRESS 0x40c06 /end MEASUREMENT
/begin MEASUREMENT OV_T_DLY_TCO_1_IS_2 "ov_t_dly_tco_1_is_2" UWORD LINEAR_______1_279900__0H___1_66 2 2.0 -1.2799 1.2798 BIT_MASK 0xffffffff ECU_ADDRESS 0x40c08 /end MEASUREMENT
/begin MEASUREMENT OV_T_DLY_TCO_2_1 "ov_t_dly_tco_2_1" UWORD LINEAR_______1_279900__0H___1_66 2 2.0 -1.2799 1.2798 BIT_MASK 0xffffffff ECU_ADDRESS 0x40c12 /end MEASUREMENT
/begin MEASUREMENT OV_T_DLY_TCO_2_2 "ov_t_dly_tco_2_2" UWORD LINEAR_______1_279900__0H___1_66 2 2.0 -1.2799 1.2798 BIT_MASK 0xffffffff ECU_ADDRESS 0x40c14 /end MEASUREMENT
/begin MEASUREMENT OV_T_DLY_TCO_2_IS_1 "ov_t_dly_tco_2_is_1" UWORD LINEAR_______1_279900__0H___1_66 2 2.0 -1.2799 1.2798 BIT_MASK 0xffffffff ECU_ADDRESS 0x40c0a /end MEASUREMENT
/begin MEASUREMENT OV_T_DLY_TCO_2_IS_2 "ov_t_dly_tco_2_is_2" UWORD LINEAR_______1_279900__0H___1_66 2 2.0 -1.2799 1.2798 BIT_MASK 0xffffffff ECU_ADDRESS 0x40c0c /end MEASUREMENT
/begin MEASUREMENT OV_TI_AMP_COR "ov_ti_amp_cor" UWORD LINEAR______0_000000__0H___2_054 2 2.0 0.0 2.0 BIT_MASK 0xffffffff ECU_ADDRESS 0x410e2 /end MEASUREMENT
/begin MEASUREMENT OV_TI_CAST "ov_ti_cast" UBYTE LINEAR______0_000000__0H___3_984 2 2.0 0.0 3.984375 BIT_MASK 0xffffffff ECU_ADDRESS 0x4044d /end MEASUREMENT
/begin MEASUREMENT OV_TI_CAST_REST "ov_ti_cast_rest" UBYTE LINEAR______0_000000__0H___0_996 2 2.0 0.0 0.99609375 BIT_MASK 0xffffffff ECU_ADDRESS 0x4044f /end MEASUREMENT
/begin MEASUREMENT OV_TI_COP_1 "ov_ti_cop_1" UWORD LINEAR______0_000000__0H___16799 2 2.0 0.0 16.0 BIT_MASK 0xffffffff ECU_ADDRESS 0x410de /end MEASUREMENT
/begin MEASUREMENT OV_TI_COP_2 "ov_ti_cop_2" UWORD LINEAR______0_000000__0H___16799 2 2.0 0.0 16.0 BIT_MASK 0xffffffff ECU_ADDRESS 0x410e0 /end MEASUREMENT
/begin MEASUREMENT OV_TI_COP_STEP_2_ADD "ov_ti_cop_step_2_add" UWORD LINEAR______0_000000__0H___16799 2 2.0 0.0 16.0 BIT_MASK 0xffffffff ECU_ADDRESS 0x410f4 /end MEASUREMENT
/begin MEASUREMENT OV_TI_CR_CST "ov_ti_cr_cst" UBYTE LINEAR______0_000000__0H___0_836 2 2.0 0.0 0.99609375 BIT_MASK 0xffffffff ECU_ADDRESS 0x40450 /end MEASUREMENT
/begin MEASUREMENT OV_TI_FAC_CH "ov_ti_fac_ch" UWORD LINEAR______0_000000__0H___16799 2 2.0 0.0 16.0 BIT_MASK 0xffffffff ECU_ADDRESS 0x41106 /end MEASUREMENT
/begin MEASUREMENT OV_TI_FAC_SAWUP "ov_ti_fac_sawup" UWORD LINEAR______0_000000__0H___16799 2 2.0 0.0 16.0 BIT_MASK 0xffffffff ECU_ADDRESS 0x41108 /end MEASUREMENT
/begin MEASUREMENT OV_TI_TCO_CH "ov_ti_tco_ch" UBYTE LINEAR______0_000000__0H___1_992 2 2.0 0.0 1.9921875 BIT_MASK 0xffffffff ECU_ADDRESS 0x40443 /end MEASUREMENT
/begin MEASUREMENT OV_TI_TCO_CH_IS "ov_ti_tco_ch_is" UBYTE LINEAR______0_000000__0H___1_992 2 2.0 0.0 1.9921875 BIT_MASK 0xffffffff ECU_ADDRESS 0x40444 /end MEASUREMENT
/begin MEASUREMENT OV_TI_TCO_SAWUP "ov_ti_tco_sawup" UBYTE LINEAR______0_000000__0H___1_992 2 2.0 0.0 1.9921875 BIT_MASK 0xffffffff ECU_ADDRESS 0x40445 /end MEASUREMENT
/begin MEASUREMENT OV_TI_TCO_SAWUP_IS "ov_ti_tco_sawup_is" UBYTE LINEAR______0_000000__0H___1_992 2 2.0 0.0 1.9921875 BIT_MASK 0xffffffff ECU_ADDRESS 0x40446 /end MEASUREMENT
/begin MEASUREMENT OV_TI_TCO_WUP "ov_ti_tco_wup" UBYTE LINEAR______0_000000__0H___1_992 2 2.0 0.0 1.9921875 BIT_MASK 0xffffffff ECU_ADDRESS 0x40447 /end MEASUREMENT
/begin MEASUREMENT WHEEL_GRD_MMV_THD_RR "ov_wheel_grd_mmv_thd_rr" UWORD LINEAR______0_000000__0H___25837 2 2.0 0.0 255.0 BIT_MASK 0xffffffff ECU_ADDRESS 0x410b8 /end MEASUREMENT
/begin MEASUREMENT PQ_MAIN_COL "pq_main_col" UBYTE LINEAR______0_000000__0H___0_996 2 2.0 0.0 0.99609375 BIT_MASK 0xffffffff ECU_ADDRESS 0x403f6 /end MEASUREMENT
/begin MEASUREMENT PQ_TURB_SYS "pq_turb_sys" UBYTE LINEAR______0_000000__0H___0_996 2 2.0 0.0 0.99609375 BIT_MASK 0xffffffff ECU_ADDRESS 0x403f7 /end MEASUREMENT
/begin MEASUREMENT PQ_TURB_SYS_MON "pq_turb_sys_mon" UBYTE LINEAR______0_000000__0H___0_996 2 2.0 0.0 0.99609375 BIT_MASK 0xffffffff ECU_ADDRESS 0x40062 /end MEASUREMENT
/begin MEASUREMENT PV_AV_MON "pv_av_mon" UBYTE LINEAR______0_000000__0H___99_60 2 2.0 0.0 99.609375 BIT_MASK 0xffffffff ECU_ADDRESS 0x40009 /end MEASUREMENT
/begin MEASUREMENT PVS "pvs" UWORD LINEAR______0_000000__0H___119_9 2 2.0 0.0 119.99817 BIT_MASK 0xffffffff ECU_ADDRESS 0xe348 /end MEASUREMENT
/begin MEASUREMENT PVS_AV "pvs_av" UWORD LINEAR______0_000000__0H___119_9 2 2.0 0.0 119.99817 BIT_MASK 0xffffffff ECU_ADDRESS 0xe0fe /end MEASUREMENT
/begin MEASUREMENT PVS_AV_1 "pvs_av_1" UWORD LINEAR______0_000000__0H___119_9 2 2.0 0.0 119.99817 BIT_MASK 0xffffffff ECU_ADDRESS 0xe100 /end MEASUREMENT
/begin MEASUREMENT PVS_AV_2 "pvs_av_2" UWORD LINEAR______0_000000__0H___119_9 2 2.0 0.0 119.99817 BIT_MASK 0xffffffff ECU_ADDRESS 0xe102 /end MEASUREMENT
/begin MEASUREMENT PVS_AV_COR "pvs_av_cor" UWORD LINEAR______0_000000__0H___119_9 2 2.0 0.0 119.99817 BIT_MASK 0xffffffff ECU_ADDRESS 0x40f8c /end MEASUREMENT
/begin MEASUREMENT PVS_AV_GRD "pvs_av_grd" SWORD LINEAR_______60_000000__FFFF8000 2 2.0 -60.0 59.998169 BIT_MASK 0xffffffff ECU_ADDRESS 0x40fb2 /end MEASUREMENT
/begin MEASUREMENT PVS_AV_MON "pvs_av_mon" UBYTE LINEAR______0_000000__0H___11942 2 2.0 0.0 119.53125 BIT_MASK 0xffffffff ECU_ADDRESS 0x4007d /end MEASUREMENT
/begin MEASUREMENT PVS_AV_MON2 "pvs_av_mon2" UBYTE LINEAR______0_000000__0H___11942 2 2.0 0.0 119.53125 BIT_MASK 0xffffffff FUNCTION_LIST MON2 ECU_ADDRESS 0x40064 /end MEASUREMENT
/begin MEASUREMENT PVS_COR "pvs_cor" UWORD LINEAR______0_000000__0H___119_9 2 2.0 0.0 119.99817 BIT_MASK 0xffffffff ECU_ADDRESS 0x40f7c /end MEASUREMENT
/begin MEASUREMENT PVS_COR_RPL "pvs_cor_rpl" UWORD LINEAR______0_000000__0H___119_9 2 2.0 0.0 119.99817 BIT_MASK 0xffffffff ECU_ADDRESS 0x40f8e /end MEASUREMENT
/begin MEASUREMENT PVS_CRU "pvs_cru" UWORD LINEAR______0_000000__0H___119_9 2 2.0 0.0 119.99817 BIT_MASK 0xffffffff ECU_ADDRESS 0x40f7a /end MEASUREMENT
/begin MEASUREMENT PVS_CRU_MON "pvs_cru_mon" UBYTE LINEAR______0_000000__0H___11942 2 2.0 0.0 119.53125 BIT_MASK 0xffffffff ECU_ADDRESS 0x4004c /end MEASUREMENT
/begin MEASUREMENT PVS_CRU_MON2 "pvs_cru_mon2" UBYTE LINEAR______0_000000__0H___11942 2 2.0 0.0 119.53125 BIT_MASK 0xffffffff FUNCTION_LIST MON2 ECU_ADDRESS 0x40065 /end MEASUREMENT
/begin MEASUREMENT PVS_CRU_OVERTAKE "pvs_cru_overtake" UWORD LINEAR______0_000000__0H___11140 2 2.0 0.0 119.9982 BIT_MASK 0xffffffff ECU_ADDRESS 0x40690 /end MEASUREMENT
/begin MEASUREMENT PVS_DIF "pvs_dif" SWORD PVS_NORM_2co_16_RES 2 2.0 -59.8 59.8 BIT_MASK 0xffffffff ECU_ADDRESS 0x40f8a /end MEASUREMENT
/begin MEASUREMENT PVS_DRIV "pvs_driv" UWORD LINEAR______0_000000__0H___11960 2 2.0 0.0 119.9982 BIT_MASK 0xffffffff ECU_ADDRESS 0x40f76 /end MEASUREMENT
/begin MEASUREMENT PVS_DRIV_MAX "pvs_driv_max" UWORD LINEAR______0_000000__0H___11960 2 2.0 0.0 119.9982 BIT_MASK 0xffffffff ECU_ADDRESS 0x40f84 /end MEASUREMENT
/begin MEASUREMENT PVS_FAC_COR "pvs_fac_cor" UBYTE LINEAR______0_000000__0H___0_996 2 2.0 0.0 0.99609375 BIT_MASK 0xffffffff ECU_ADDRESS 0x403fe /end MEASUREMENT
/begin MEASUREMENT PVS_FAC_CS "pvs_fac_cs" UBYTE LINEAR______0_000000__0H___0_996 2 2.0 0.0 0.99609375 BIT_MASK 0xffffffff ECU_ADDRESS 0x40400 /end MEASUREMENT
/begin MEASUREMENT PVS_FAC_GEN "pvs_fac_gen" UBYTE LINEAR______0_000000__0H___0_996 2 2.0 0.0 0.99609375 BIT_MASK 0xffffffff ECU_ADDRESS 0x40401 /end MEASUREMENT
/begin MEASUREMENT PVS_FAC_SHIFT "pvs_fac_shift" UBYTE LINEAR______0_000000__0H___0_996 2 2.0 0.0 0.99609375 BIT_MASK 0xffffffff ECU_ADDRESS 0x403ff /end MEASUREMENT
/begin MEASUREMENT PVS_GRD "pvs_grd" UWORD LINEAR______0_000000__0H___29838 2 2.0 0.0 2988.0 BIT_MASK 0xffffffff ECU_ADDRESS 0xe346 /end MEASUREMENT
/begin MEASUREMENT PVS_ISA "pvs_isa" UWORD LINEAR______0_000000__0H___119_9 2 2.0 0.0 119.99817 BIT_MASK 0xffffffff ECU_ADDRESS 0x40f7e /end MEASUREMENT
/begin MEASUREMENT PVS_ISA_1 "pvs_isa_1" UWORD LINEAR______0_000000__0H___119_9 2 2.0 0.0 119.99817 BIT_MASK 0xffffffff ECU_ADDRESS 0x4088c /end MEASUREMENT
/begin MEASUREMENT PVS_MAX "pvs_max" UWORD LINEAR______0_000000__0H___119_9 2 2.0 0.0 119.99817 BIT_MASK 0xffffffff ECU_ADDRESS 0xe34a /end MEASUREMENT
/begin MEASUREMENT PVS_MAX_MON2 "pvs_max_mon2" UBYTE LINEAR______0_000000__0H___11942 2 2.0 0.0 119.53125 BIT_MASK 0xffffffff FUNCTION_LIST MON2 ECU_ADDRESS 0x40070 /end MEASUREMENT
/begin MEASUREMENT PVS_TQI "pvs_tqi" UWORD LINEAR______0_000000__0H___119_9 2 2.0 0.0 119.99817 BIT_MASK 0xffffffff ECU_ADDRESS 0x40f80 /end MEASUREMENT
/begin MEASUREMENT REQ_CRU "req_cru" UBYTE CRU_RANGE 2 2.0 0 255 BIT_MASK 0xffffffff ECU_ADDRESS 0x400c2 /end MEASUREMENT
/begin MEASUREMENT REQ_MSW "req_msw" UBYTE CRU_RANGE 2 2.0 0 255 BIT_MASK 0xffffffff ECU_ADDRESS 0x400b6 /end MEASUREMENT
/begin MEASUREMENT LV_IVVT_AD_T_EX "rv_ad_t_a" UWORD RANGE________0___0H__0H____1___1 2 2.0 0 65535 BIT_MASK 0x80 ECU_ADDRESS 0xfd9e /end MEASUREMENT
/begin MEASUREMENT LV_IVVT_AD_T_IN "rv_ad_t_e" UWORD RANGE________0___0H__0H____1___1 2 2.0 0 65535 BIT_MASK 0x80 ECU_ADDRESS 0xfd9c /end MEASUREMENT
/begin MEASUREMENT LV_IVVT_AD_ENA_EX "rv_adapt_ena_a" UWORD RANGE________0___0H__0H____1___1 2 2.0 0 65535 BIT_MASK 0x400 ECU_ADDRESS 0xfd9e /end MEASUREMENT
/begin MEASUREMENT LV_IVVT_AD_ENA_IN "rv_adapt_ena_e" UWORD RANGE________0___0H__0H____1___1 2 2.0 0 65535 BIT_MASK 0x400 ECU_ADDRESS 0xfd9c /end MEASUREMENT
/begin MEASUREMENT LV_IVVT_NEW_SP_EX "rv_neuer_soll_a" UWORD RANGE________0___0H__0H____1___1 2 2.0 0 65535 BIT_MASK 0x8 ECU_ADDRESS 0xfd9e /end MEASUREMENT
/begin MEASUREMENT LV_IVVT_NEW_SP_IN "rv_neuer_soll_e" UWORD RANGE________0___0H__0H____1___1 2 2.0 0 65535 BIT_MASK 0x8 ECU_ADDRESS 0xfd9c /end MEASUREMENT
/begin MEASUREMENT LV_CAM_GRD_EX "rv_nw_grd_kl_a" UWORD RANGE________0___0H__0H____1___1 2 2.0 0 65535 BIT_MASK 0x10 ECU_ADDRESS 0xfd9e /end MEASUREMENT
/begin MEASUREMENT LV_CAM_GRD_IN "rv_nw_grd_kl_e" UWORD RANGE________0___0H__0H____1___1 2 2.0 0 65535 BIT_MASK 0x10 ECU_ADDRESS 0xfd9c /end MEASUREMENT
/begin MEASUREMENT LV_IVVT_NEW_DIR_EX "rv_vzw_nw_dif_a" UWORD RANGE________0___0H__0H____1___1 2 2.0 0 65535 BIT_MASK 0x100 ECU_ADDRESS 0xfd9e /end MEASUREMENT
/begin MEASUREMENT LV_IVVT_NEW_DIR_IN "rv_vzw_nw_dif_e" UWORD RANGE________0___0H__0H____1___1 2 2.0 0 65535 BIT_MASK 0x100 ECU_ADDRESS 0xfd9c /end MEASUREMENT
/begin MEASUREMENT SA_DIAG_CND "sa_diag_cnd" UBYTE SA_DIAG_CND_RANGE 2 2.0 0 255 BIT_MASK 0xffffffff ECU_ADDRESS 0x4040e /end MEASUREMENT
/begin MEASUREMENT SA_FLAGS "sa_flags" UWORD LINEAR______0_000000__0H___65762 2 2.0 0.0 65535.0 BIT_MASK 0xffffffff ECU_ADDRESS 0xfda4 /end MEASUREMENT
/begin MEASUREMENT SAF_DIAG_MAX "saf_diag_max" UWORD LINEAR______0_000000__0H___25144 2 2.0 0.0 255.0 BIT_MASK 0xffffffff ECU_ADDRESS 0xe114 /end MEASUREMENT
/begin MEASUREMENT SAF_DIAG_MIN "saf_diag_min" UWORD LINEAR______0_000000__0H___25144 2 2.0 0.0 255.0 BIT_MASK 0xffffffff ECU_ADDRESS 0xe112 /end MEASUREMENT
/begin MEASUREMENT SAF_DIAG_QUO_MAX "saf_diag_quo_max" UWORD LINEAR______0_000000__0H___25144 2 2.0 0.0 255.0 BIT_MASK 0xffffffff ECU_ADDRESS 0xe120 /end MEASUREMENT
/begin MEASUREMENT SAF_DIAG_QUO_MIN "saf_diag_quo_min" UWORD LINEAR______0_000000__0H___25144 2 2.0 0.0 255.0 BIT_MASK 0xffffffff ECU_ADDRESS 0xe122 /end MEASUREMENT
/begin MEASUREMENT SAF_KGH "saf_kgh" UWORD LINEAR______0_000000__0H___10269 2 2.0 0.0 1023.9844 BIT_MASK 0xffffffff ECU_ADDRESS 0xe13a /end MEASUREMENT
/begin MEASUREMENT SAF_KGH_DIAG "saf_kgh_diag" SWORD LINEAR_______512_000000__FFFF800 2 2.0 -512.0 511.98438 BIT_MASK 0xffffffff ECU_ADDRESS 0xe11c /end MEASUREMENT
/begin MEASUREMENT SAF_KGH_DIF "saf_kgh_dif" UWORD LINEAR______0_000000__0H___10269 2 2.0 0.0 1023.9844 BIT_MASK 0xffffffff ECU_ADDRESS 0xe124 /end MEASUREMENT
/begin MEASUREMENT SAF_KGH_DIF_SAV_DIAG "saf_kgh_dif_sav_diag" UWORD LINEAR______0_000000__0H___10269 2 2.0 0.0 1023.9844 BIT_MASK 0xffffffff ECU_ADDRESS 0xe126 /end MEASUREMENT
/begin MEASUREMENT SAF_KGH_MAX_DIAG "saf_kgh_max_diag" UWORD LINEAR______0_000000__0H___10269 2 2.0 0.0 1023.9844 BIT_MASK 0xffffffff ECU_ADDRESS 0xe128 /end MEASUREMENT
/begin MEASUREMENT SAF_KGH_MIN_DIAG "saf_kgh_min_diag" UWORD LINEAR______0_000000__0H___10269 2 2.0 0.0 1023.9844 BIT_MASK 0xffffffff ECU_ADDRESS 0xe12a /end MEASUREMENT
/begin MEASUREMENT SAF_MDL "saf_mdl" UWORD LINEAR______0_000000__0H___10269 2 2.0 0.0 1023.9844 BIT_MASK 0xffffffff ECU_ADDRESS 0xe140 /end MEASUREMENT
/begin MEASUREMENT SAF_MDL_CLC "saf_mdl_clc" UWORD LINEAR______0_000000__0H___10269 2 2.0 0.0 1023.9844 BIT_MASK 0xffffffff ECU_ADDRESS 0xe142 /end MEASUREMENT
/begin MEASUREMENT SAF_MES "saf_mes" UWORD LINEAR______0_000000__0H___10269 2 2.0 0.0 1023.9844 BIT_MASK 0xffffffff ECU_ADDRESS 0xe138 /end MEASUREMENT
/begin MEASUREMENT SAV_DIAG_CND "sav_diag_cnd" UBYTE SAV_DIAG_CND_RANGE 2 2.0 0 255 BIT_MASK 0xffffffff ECU_ADDRESS 0x4040f /end MEASUREMENT
/begin MEASUREMENT LV_SAWUP "sawup" UWORD RANGE________SAWUP___1H__1H_____ 2 2.0 0 65535 BIT_MASK 0x80 ECU_ADDRESS 0xfd94 /end MEASUREMENT
/begin MEASUREMENT SEG_AD_1 "seg_adC0D" SWORD LINEAR_______7_812500__FFFF8040H 2 2.0 -7.8125 7.8125 BIT_MASK 0xffffffff ECU_ADDRESS 0xe236 /end MEASUREMENT
/begin MEASUREMENT SEG_AD_5 "seg_adC1D" SWORD LINEAR_______7_812500__FFFF8040H 2 2.0 -7.8125 7.8125 BIT_MASK 0xffffffff ECU_ADDRESS 0xe238 /end MEASUREMENT
/begin MEASUREMENT SEG_AD_3 "seg_adC2D" SWORD LINEAR_______7_812500__FFFF8040H 2 2.0 -7.8125 7.8125 BIT_MASK 0xffffffff ECU_ADDRESS 0xe23a /end MEASUREMENT
/begin MEASUREMENT SEG_AD_6 "seg_adC3D" SWORD LINEAR_______7_812500__FFFF8040H 2 2.0 -7.8125 7.8125 BIT_MASK 0xffffffff ECU_ADDRESS 0xe23c /end MEASUREMENT
/begin MEASUREMENT SEG_AD_2 "seg_adC4D" SWORD LINEAR_______7_812500__FFFF8040H 2 2.0 -7.8125 7.8125 BIT_MASK 0xffffffff ECU_ADDRESS 0xe23e /end MEASUREMENT
/begin MEASUREMENT SEG_AD_4 "seg_adC5D" SWORD LINEAR_______7_812500__FFFF8040H 2 2.0 -7.8125 7.8125 BIT_MASK 0xffffffff ECU_ADDRESS 0xe240 /end MEASUREMENT
/begin MEASUREMENT SEG_AD_DIF_0_3 "seg_ad_dif_0_3" SWORD LINEAR_______7_812500__FFFF8040H 2 2.0 -7.8125 7.8125 BIT_MASK 0xffffffff ECU_ADDRESS 0xe270 /end MEASUREMENT
/begin MEASUREMENT SEG_AD_DIF_1_4 "seg_ad_dif_1_4" SWORD LINEAR_______7_812500__FFFF8040H 2 2.0 -7.8125 7.8125 BIT_MASK 0xffffffff ECU_ADDRESS 0xe272 /end MEASUREMENT
/begin MEASUREMENT SEG_AD_DIF_2_5 "seg_ad_dif_2_5" SWORD LINEAR_______7_812500__FFFF8040H 2 2.0 -7.8125 7.8125 BIT_MASK 0xffffffff ECU_ADDRESS 0xe274 /end MEASUREMENT
/begin MEASUREMENT SEG_AD_RAW_1 "seg_ad_rawC0D" SWORD LINEAR_______7_812500__FFFF8040H 2 2.0 -7.8125 7.8125 BIT_MASK 0xffffffff ECU_ADDRESS 0xe242 /end MEASUREMENT
/begin MEASUREMENT SEG_AD_RAW_5 "seg_ad_rawC1D" SWORD LINEAR_______7_812500__FFFF8040H 2 2.0 -7.8125 7.8125 BIT_MASK 0xffffffff ECU_ADDRESS 0xe244 /end MEASUREMENT
/begin MEASUREMENT SEG_AD_RAW_3 "seg_ad_rawC2D" SWORD LINEAR_______7_812500__FFFF8040H 2 2.0 -7.8125 7.8125 BIT_MASK 0xffffffff ECU_ADDRESS 0xe246 /end MEASUREMENT
/begin MEASUREMENT SEG_AD_RAW_6 "seg_ad_rawC3D" SWORD LINEAR_______7_812500__FFFF8040H 2 2.0 -7.8125 7.8125 BIT_MASK 0xffffffff ECU_ADDRESS 0xe248 /end MEASUREMENT
/begin MEASUREMENT SEG_AD_RAW_2 "seg_ad_rawC4D" SWORD LINEAR_______7_812500__FFFF8040H 2 2.0 -7.8125 7.8125 BIT_MASK 0xffffffff ECU_ADDRESS 0xe24a /end MEASUREMENT
/begin MEASUREMENT SEG_AD_RAW_4 "seg_ad_rawC5D" SWORD LINEAR_______7_812500__FFFF8040H 2 2.0 -7.8125 7.8125 BIT_MASK 0xffffffff ECU_ADDRESS 0xe24c /end MEASUREMENT
/begin MEASUREMENT SF_1_MON2 "sf_1_mon2" UWORD LINEAR______0_000000__0H___65535 2 2.0 0.0 65535.0 BIT_MASK 0xffffffff FUNCTION_LIST MON2 ECU_ADDRESS 0xfd80 /end MEASUREMENT
/begin MEASUREMENT SF_2_MON2 "sf_2_mon2" UWORD LINEAR______0_000000__0H___65535 2 2.0 0.0 65535.0 BIT_MASK 0xffffffff FUNCTION_LIST MON2 ECU_ADDRESS 0xfd82 /end MEASUREMENT
/begin MEASUREMENT SF_TQD "sf_tqd" UBYTE STATE_TQD_RANGE 2 2.0 0 255 BIT_MASK 0xffffffff ECU_ADDRESS 0x40113 /end MEASUREMENT
/begin MEASUREMENT SOI "soi" UBYTE LINEAR_______180_000000__0H___50 2 2.0 -180.0 504.0 BIT_MASK 0xffffffff ECU_ADDRESS 0xfb96 /end MEASUREMENT
/begin MEASUREMENT STATE_AMT "state_amt" UBYTE LINEAR______0_000000__0H___3_000 2 2.0 0.0 3.0 BIT_MASK 0xffffffff FUNCTION_LIST Z1S1 ECU_ADDRESS 0xfb58 /end MEASUREMENT
/begin MEASUREMENT STATE_AMT_OLD "state_amt_old" UBYTE LINEAR______0_000000__0H___3_000 2 2.0 0.0 3.0 BIT_MASK 0xffffffff FUNCTION_LIST Z1S1 ECU_ADDRESS 0xfb63 /end MEASUREMENT
/begin MEASUREMENT STATE_CC "state_cc" UBYTE S_CC_RANGE 2 2.0 0 255 BIT_MASK 0xffffffff ECU_ADDRESS 0x400fc /end MEASUREMENT
/begin MEASUREMENT STATE_CLU_AMT "state_clu_amt" UBYTE STATE_CLU_AMT_RANGE 2 2.0 0 255 BIT_MASK 0xffffffff FUNCTION_LIST Z1S1 ECU_ADDRESS 0xfb57 /end MEASUREMENT
/begin MEASUREMENT STATE_CONF_CAT "state_conf_cat" UBYTE LINEAR______0_000000__0H___255_0 2 2.0 0.0 255.0 BIT_MASK 0xffffffff ECU_ADDRESS 0x400f6 /end MEASUREMENT
/begin MEASUREMENT STATE_CP "state_cp" UBYTE STATE_CP_RANGE 2 2.0 0 255 BIT_MASK 0xffffffff ECU_ADDRESS 0x40132 /end MEASUREMENT
/begin MEASUREMENT STATE_CP_TRA "state_cp_tra" UBYTE STATE_CP_TRA_RANGE 2 2.0 0 255 BIT_MASK 0xffffffff ECU_ADDRESS 0x40133 /end MEASUREMENT
/begin MEASUREMENT STATE_CRU "state_cru" UBYTE STATE_CRU_RANGE 2 2.0 0 255 BIT_MASK 0xffffffff ECU_ADDRESS 0x400b7 /end MEASUREMENT
/begin MEASUREMENT STATE_CS_DIAG "state_cs_diag" UBYTE RANGE_STATE_CS_DIAG 2 2.0 0 255 BIT_MASK 0xffffffff ECU_ADDRESS 0x40158 /end MEASUREMENT
/begin MEASUREMENT STATE_DMTL "state_dmtl" UBYTE STATE_DMTL_RANGE 2 2.0 0 255 BIT_MASK 0xffffffff FUNCTION_LIST DMTL ECU_ADDRESS 0x40482 /end MEASUREMENT
/begin MEASUREMENT STATE_DMTL_EOL "state_dmtl_eol" UBYTE STATE_DMTL_EOL_RANGE 2 2.0 0 255 BIT_MASK 0xffffffff ECU_ADDRESS 0x40481 /end MEASUREMENT
/begin MEASUREMENT STATE_EFP_CRASH "state_efp_crash" UBYTE STATE_EFP_CRASH_RANGE 2 2.0 0 255 BIT_MASK 0x3 ECU_ADDRESS 0x400fd /end MEASUREMENT
/begin MEASUREMENT STATE_ENG "state_eng" UWORD RANGE_____00000017 2 2.0 0 65535 BIT_MASK 0x7 ECU_ADDRESS 0xfd94 /end MEASUREMENT
/begin MEASUREMENT STATE_ERR_AMT "state_err_amt" UBYTE LINEAR______0_000000__0H___255_0 2 2.0 0.0 255.0 BIT_MASK 0xffffffff FUNCTION_LIST Z1S1 ECU_ADDRESS 0xfb59 /end MEASUREMENT
/begin MEASUREMENT STATE_ERR_AMT_MON "state_err_amt_mon" UBYTE LINEAR______0_000000__0H___255_0 2 2.0 0.0 255.0 BIT_MASK 0xffffffff FUNCTION_LIST Z1S1 ECU_ADDRESS 0x40030 /end MEASUREMENT
/begin MEASUREMENT STATE_GEAR_REQ_LTC "state_gear_req_ltc" UBYTE LINEAR______0_000000__0H___2_000 2 2.0 0.0 2.0 BIT_MASK 0xffffffff ECU_ADDRESS 0xfb68 /end MEASUREMENT
/begin MEASUREMENT STATE_IV_MON2 "state_iv_mon2" UWORD LINEAR______0_000000__0H___65535 2 2.0 0.0 65535.0 BIT_MASK 0xffffffff FUNCTION_LIST MON2 ECU_ADDRESS 0xfd84 /end MEASUREMENT
/begin MEASUREMENT STATE_IVVT_DUMMY "state_ivvt" UBYTE LINEAR______0_000000__0H___25753 2 2.0 0.0 255.0 BIT_MASK 0xffffffff ECU_ADDRESS 0x401ff /end MEASUREMENT
/begin MEASUREMENT STATE_IVVT "state_ivvt_sams" UBYTE STATE_IVVT 2 2.0 0 255 BIT_MASK 0x3 ECU_ADDRESS 0x401ff /end MEASUREMENT
/begin MEASUREMENT STATE_LDC_LAM "state_ldc_lam" UBYTE LINEAR______0_000000__0H___255_0 2 2.0 0.0 255.0 BIT_MASK 0xffffffff ECU_ADDRESS 0x40119 /end MEASUREMENT
/begin MEASUREMENT STATE_LRN_AMP "state_lrn_amp" UBYTE STATE_LRN_AMP_RANGE 2 2.0 0 255 BIT_MASK 0xffffffff ECU_ADDRESS 0x4001a /end MEASUREMENT
/begin MEASUREMENT STATE_LRN_AMP_PRED "state_lrn_amp_pred" UBYTE STATE_LRN_AMP_RANGE 2 2.0 0 255 BIT_MASK 0xffffffff ECU_ADDRESS 0x4001b /end MEASUREMENT
/begin MEASUREMENT STATE_MSW_CAN "state_msw_can" UBYTE STATE_MSW_CAN_RANGE 2 2.0 0 255 BIT_MASK 0xffffffff ECU_ADDRESS 0x40100 /end MEASUREMENT
/begin MEASUREMENT STATE_N_SP_OFS "state_n_sp_ofs" UBYTE STATE_N_SP_OFS_RANGE 2 2.0 0 255 BIT_MASK 0xffffffff ECU_ADDRESS 0x401e8 /end MEASUREMENT
/begin MEASUREMENT STATE_PVS_DIAG "state_pvs_diag" UBYTE PVS_DIAG 2 2.0 0 255 BIT_MASK 0xffffffff ECU_ADDRESS 0xfb42 /end MEASUREMENT
/begin MEASUREMENT STATE_SA_DIAG "state_sa_diag" UWORD RANGE_____00000019 2 2.0 0 65535 BIT_MASK 0xffffffff ECU_ADDRESS 0xe110 /end MEASUREMENT
/begin MEASUREMENT STATE_SA_DIAG_ERR "state_sa_diag_err" UWORD RANGE_____00000018 2 2.0 0 65535 BIT_MASK 0xffffffff ECU_ADDRESS 0xe10e /end MEASUREMENT
/begin MEASUREMENT STATE_T_SDL_CP "state_t_sdl_cp" UBYTE STATE_T_SDL_CP_RANGE 2 2.0 0 255 BIT_MASK 0xffffffff ECU_ADDRESS 0x40131 /end MEASUREMENT
/begin MEASUREMENT STATE_TPS_DIAG "state_tps_diag" UBYTE TPS_DIAG 2 2.0 0 255 BIT_MASK 0xffffffff ECU_ADDRESS 0xfb49 /end MEASUREMENT
/begin MEASUREMENT STATE_TQ_INTV "state_tq_intv" UBYTE STATE_TQ_INTV 2 2.0 0 255 BIT_MASK 0xffffffff ECU_ADDRESS 0x40023 /end MEASUREMENT
/begin MEASUREMENT STATE_VAR "state_var" UWORD STATE_VARIANTEN 2 2.0 0 65535 BIT_MASK 0x3f ECU_ADDRESS 0xfd96 /end MEASUREMENT
/begin MEASUREMENT SUM_CAM_AD_EX "sum_cam_ad_ex" UBYTE LINEAR______0_000000__0H___255_0 2 2.0 0.0 255.0 BIT_MASK 0xffffffff ECU_ADDRESS 0x4020b /end MEASUREMENT
/begin MEASUREMENT SUM_CAM_AD_IN "sum_cam_ad_in" UBYTE LINEAR______0_000000__0H___255_0 2 2.0 0.0 255.0 BIT_MASK 0xffffffff ECU_ADDRESS 0x4020c /end MEASUREMENT
/begin MEASUREMENT SUM_CPPWM_DIAGCPS "sum_cppwm_diagcps" UBYTE LINEAR______0_000000__0H___25147 2 2.0 0.0 255.0 BIT_MASK 0xffffffff ECU_ADDRESS 0x40134 /end MEASUREMENT
/begin MEASUREMENT SUM_DIAG_DIAGCPS "sum_diag_diagcps" UBYTE LINEAR______0_000000__0H___255_0 2 2.0 0.0 255.0 BIT_MASK 0xffffffff ECU_ADDRESS 0x40136 /end MEASUREMENT
/begin MEASUREMENT SUM_ERR_FMY "sum_err_fmy" UBYTE LINEAR______0_000000__0H___255_0 2 2.0 0.0 255.0 BIT_MASK 0xffffffff ECU_ADDRESS 0x401ae /end MEASUREMENT
/begin MEASUREMENT SUM_HFM "sum_hfm" UBYTE LINEAR______0_000000__0H___25514 2 2.0 0.0 255.0 BIT_MASK 0xffffffff ECU_ADDRESS 0x403fb /end MEASUREMENT
/begin MEASUREMENT SUM_HFM_DIAG "sum_hfm_diag" UBYTE LINEAR______0_000000__0H___25514 2 2.0 0.0 255.0 BIT_MASK 0xffffffff ECU_ADDRESS 0x403fc /end MEASUREMENT
/begin MEASUREMENT SUM_LAM_TI_1 "sum_lam_ti_1" UWORD LINEAR_______31_250000__3000H___ 2 2.0 -31.25 31.25 BIT_MASK 0xffffffff ECU_ADDRESS 0x40c1e /end MEASUREMENT
/begin MEASUREMENT SUM_LAM_TI_2 "sum_lam_ti_2" UWORD LINEAR_______31_250000__3000H___ 2 2.0 -31.25 31.25 BIT_MASK 0xffffffff ECU_ADDRESS 0x40c20 /end MEASUREMENT
/begin MEASUREMENT CTR_SA_DIAG_1 "sum_obd_diag_ramvctr_sa_diag_1" UBYTE LINEAR______0_000000__0H___25788 2 2.0 0.0 255.0 BIT_MASK 0xffffffff ECU_ADDRESS 0x4105a /end MEASUREMENT
/begin MEASUREMENT CTR_SA_DIAG_2 "sum_obd_diag_ramvctr_sa_diag_2" UBYTE LINEAR______0_000000__0H___25788 2 2.0 0.0 255.0 BIT_MASK 0xffffffff ECU_ADDRESS 0x4105b /end MEASUREMENT
/begin MEASUREMENT MIS_NR_B "sum_obd_diag_ramvmis_nr_b" UBYTE LINEAR______0_000000__0H___25788 2 2.0 0.0 255.0 BIT_MASK 0xffffffff ECU_ADDRESS 0x4105d /end MEASUREMENT
/begin MEASUREMENT SUM_P_DIAG_SAV "sum_p_diag_sav" UBYTE LINEAR______0_000000__0H___255_0 2 2.0 0.0 255.0 BIT_MASK 0xffffffff ECU_ADDRESS 0x4040d /end MEASUREMENT
/begin MEASUREMENT SUM_RR "sum_rr" UWORD LINEAR______0_000000__0H___65535 2 2.0 0.0 65535.0 BIT_MASK 0xffffffff ECU_ADDRESS 0x410b6 /end MEASUREMENT
/begin MEASUREMENT SUM_SAF_DIAG_MAX "sum_saf_diag_max" UWORD LINEAR______0_000000__0H___65592 2 2.0 0.0 65534.0 BIT_MASK 0xffffffff ECU_ADDRESS 0xe12c /end MEASUREMENT
/begin MEASUREMENT SUM_SAF_DIAG_MIN "sum_saf_diag_min" UWORD LINEAR______0_000000__0H___65592 2 2.0 0.0 65534.0 BIT_MASK 0xffffffff ECU_ADDRESS 0xe12e /end MEASUREMENT
/begin MEASUREMENT SUM_SAF_DIAG_QUO_MAX "sum_saf_diag_quo_max" ULONG LINEAR______0_000000__0H___16711 2 2.0 0.0 16711170.0 BIT_MASK 0xffffffff ECU_ADDRESS 0xe130 /end MEASUREMENT
/begin MEASUREMENT SUM_SAF_DIAG_QUO_MIN "sum_saf_diag_quo_min" ULONG LINEAR______0_000000__0H___16711 2 2.0 0.0 16711170.0 BIT_MASK 0xffffffff ECU_ADDRESS 0xe134 /end MEASUREMENT
/begin MEASUREMENT T_ACC "t_acc" UBYTE LINEAR______0_000000__0H___2_544 2 2.0 0.0 2.55 BIT_MASK 0xffffffff ECU_ADDRESS 0x40026 /end MEASUREMENT
/begin MEASUREMENT T_ACT_CUR_DMTL_STAT "t_act_cur_dmtl_stat" UWORD LINEAR______0_000000__0H___6553_ 2 2.0 0.0 6553.5 BIT_MASK 0xffffffff FUNCTION_LIST DMTL ECU_ADDRESS 0x41a36 /end MEASUREMENT
/begin MEASUREMENT T_ACT_LEAK_MES "t_act_leak_mes" UWORD LINEAR______0_000000__0H___6553_ 2 2.0 0.0 6553.5 BIT_MASK 0xffffffff FUNCTION_LIST DMTL ECU_ADDRESS 0x41a08 /end MEASUREMENT
/begin MEASUREMENT T_ACT_REF_LEAK_MES "t_act_ref_leak_mes" UWORD LINEAR______0_000000__0H___6553_ 2 2.0 0.0 6553.5 BIT_MASK 0xffffffff FUNCTION_LIST DMTL ECU_ADDRESS 0x41a38 /end MEASUREMENT
/begin MEASUREMENT T_AMT_INH_MON "t_amt_inh_mon" UBYTE LINEAR______0_000000__0H___10_20 2 2.0 0.0 10.2 BIT_MASK 0xffffffff FUNCTION_LIST Z1S1 ECU_ADDRESS 0x40040 /end MEASUREMENT
/begin MEASUREMENT T_AST "t_ast" UWORD LINEAR______0_000000__0H___6553_ 2 2.0 0.0 6553.5 BIT_MASK 0xffffffff ECU_ADDRESS 0xe29e /end MEASUREMENT
/begin MEASUREMENT T_AST_REST "t_ast_rest" UWORD LINEAR______0_000000__0H___6553_ 2 2.0 0.0 6553.5 BIT_MASK 0xffffffff ECU_ADDRESS 0xe2a0 /end MEASUREMENT
/begin MEASUREMENT T_MAX_FL "t_ba_hl_t3" UWORD LINEAR______0_000000__0H___65152 2 2.0 0.0 65535.0 BIT_MASK 0xffffffff ECU_ADDRESS 0xe41c /end MEASUREMENT
/begin MEASUREMENT T_BTS_PLAUS "t_bts_plaus_ctr" UBYTE LINEAR______0_000000__0H___25_50 2 2.0 0.0 25.5 BIT_MASK 0xffffffff ECU_ADDRESS 0x40157 /end MEASUREMENT
/begin MEASUREMENT T_COP_NOT_ACT_BANK1 "t_cop_not_act_bank1" UBYTE LINEAR______0_000000__0H___25514 2 2.0 0.0 255.0 BIT_MASK 0xffffffff ECU_ADDRESS 0x4044a /end MEASUREMENT
/begin MEASUREMENT T_COP_NOT_ACT_BANK2 "t_cop_not_act_bank2" UBYTE LINEAR______0_000000__0H___25514 2 2.0 0.0 255.0 BIT_MASK 0xffffffff ECU_ADDRESS 0x4044b /end MEASUREMENT
/begin MEASUREMENT T_CP "t_cp" UWORD LINEAR______0_000000__0H___6553_ 2 2.0 0.0 6553.5 BIT_MASK 0xffffffff ECU_ADDRESS 0x4070a /end MEASUREMENT
/begin MEASUREMENT T_CRU_INH_MON "t_cru_inh_mon" UBYTE LINEAR______0_000000__0H___10_20 2 2.0 0.0 10.2 BIT_MASK 0xffffffff ECU_ADDRESS 0x4004d /end MEASUREMENT
/begin MEASUREMENT T_CTL_CRU "t_ctl_cru" UBYTE LINEAR______0_000000__0H___25_50 2 2.0 0.0 25.5 BIT_MASK 0xffffffff ECU_ADDRESS 0x400c3 /end MEASUREMENT
/begin MEASUREMENT T_DIAG_SA "t_diag_sa" UWORD LINEAR______0_000000__0H___1310_ 2 2.0 0.0 1310.7 BIT_MASK 0xffffffff ECU_ADDRESS 0x410c6 /end MEASUREMENT
/begin MEASUREMENT T_DLY_DET_REFU "t_dly_det_refu" UWORD LINEAR______0_000000__0H___655_3 2 2.0 0.0 655.35 BIT_MASK 0xffffffff FUNCTION_LIST DMTL ECU_ADDRESS 0x41a3e /end MEASUREMENT
/begin MEASUREMENT T_DLY_DMTL_PWL "t_dly_dmtl_pwl" UBYTE LINEAR______0_000000__0H___25_50 2 2.0 0.0 25.5 BIT_MASK 0xffffffff FUNCTION_LIST DMTL ECU_ADDRESS 0x4048b /end MEASUREMENT
/begin MEASUREMENT T_DLY_DMTLS "t_dly_dmtls" UBYTE LINEAR______0_000000__0H___25_50 2 2.0 0.0 25.5 BIT_MASK 0xffffffff FUNCTION_LIST DMTL ECU_ADDRESS 0x4048c /end MEASUREMENT
/begin MEASUREMENT T_DLY_ENA_DR_DMTL "t_dly_ena_dr_dmtl" UWORD LINEAR______0_000000__0H___6553_ 2 2.0 0.0 6553.5 BIT_MASK 0xffffffff FUNCTION_LIST DMTL ECU_ADDRESS 0x41a0a /end MEASUREMENT
/begin MEASUREMENT T_DLY_REQ_PWL_DMTL "t_dly_req_pwl_dmtl" UBYTE LINEAR______0_000000__0H___25_50 2 2.0 0.0 25.5 BIT_MASK 0xffffffff FUNCTION_LIST DMTL ECU_ADDRESS 0x4048d /end MEASUREMENT
/begin MEASUREMENT T_DLY_SA_DIAG "t_dly_sa_diag" UWORD LINEAR______0_000000__0H___1310_ 2 2.0 0.0 1310.7 BIT_MASK 0xffffffff ECU_ADDRESS 0x410c8 /end MEASUREMENT
/begin MEASUREMENT T_DLY_STOP_REFU "t_dly_stop_refu" UWORD LINEAR______0_000000__0H___65152 2 2.0 0.0 65535.0 BIT_MASK 0xffffffff FUNCTION_LIST THKO_DMTL ECU_ADDRESS 0x41a40 /end MEASUREMENT
/begin MEASUREMENT T_ES "t_es" UWORD LINEAR______0_000000__0H___65563 2 2.0 0.0 65535.0 BIT_MASK 0xffffffff FUNCTION_LIST DPM ECU_ADDRESS 0x406ca /end MEASUREMENT
/begin MEASUREMENT T_ES_DEW "t_es_dew" UWORD LINEAR______0_000000__0H___65563 2 2.0 0.0 65535.0 BIT_MASK 0xffffffff FUNCTION_LIST ETM ECU_ADDRESS 0x4065c /end MEASUREMENT
/begin MEASUREMENT T_ES_DMTL "t_es_dmtl" UWORD LINEAR______0_000000__0H___65563 2 2.0 0.0 65535.0 BIT_MASK 0xffffffff FUNCTION_LIST DMTL ECU_ADDRESS 0x41a42 /end MEASUREMENT
/begin MEASUREMENT T_IGA_CH_MON "t_iga_ch_mon" UWORD LINEAR______0_000000__0H___26156 2 2.0 0.0 2621.4 BIT_MASK 0xffffffff ECU_ADDRESS 0x4049a /end MEASUREMENT
/begin MEASUREMENT T_IGA_CH_MON2 "t_iga_ch_mon2" UWORD LINEAR______0_000000__0H___26156 2 2.0 0.0 2621.4 BIT_MASK 0xffffffff FUNCTION_LIST MON2 ECU_ADDRESS 0x404d4 /end MEASUREMENT
/begin MEASUREMENT T_IGA_INC_AJ "t_iga_inc_aj" UBYTE LINEAR______0_000000__0H___2550_ 2 2.0 0.0 2550.0 BIT_MASK 0xffffffff ECU_ADDRESS 0x400da /end MEASUREMENT
/begin MEASUREMENT T_IGA_INC_AJ_RESI "t_iga_inc_aj_resi" UWORD LINEAR______0_000000__0H___27839 2 2.0 0.0 2796.16 BIT_MASK 0xffffffff ECU_ADDRESS 0x406ba /end MEASUREMENT
/begin MEASUREMENT T_LSH_DEW "t_lsh_dew" UBYTE LINEAR______0_000000__0H___25514 2 2.0 0.0 255.0 BIT_MASK 0xffffffff FUNCTION_LIST DPM ECU_ADDRESS 0x403ef /end MEASUREMENT
/begin MEASUREMENT T_MSR_INH_MON "t_msr_inh_mon" UBYTE LINEAR______0_000000__0H___10_20 2 2.0 0.0 10.2 BIT_MASK 0xffffffff ECU_ADDRESS 0x40036 /end MEASUREMENT
/begin MEASUREMENT T_MTCPWM_CLOSE_ACT "t_mtcpwm_close_act" UWORD LINEAR______0_000000__0H___5_840 2 2.0 0.0 5.0 BIT_MASK 0xffffffff ECU_ADDRESS 0xe0de /end MEASUREMENT
/begin MEASUREMENT T_PUC_CAT_PURGE "t_puc_cat_purge" UBYTE LINEAR______0_000000__0H___25_50 2 2.0 0.0 25.5 BIT_MASK 0xffffffff ECU_ADDRESS 0x403da /end MEASUREMENT
/begin MEASUREMENT T_PUC_INT_ECT_DIAG "t_puc_int_ect_diag" UWORD LINEAR______0_000000__0H___6553_ 2 2.0 0.0 6553.5 BIT_MASK 0xffffffff ECU_ADDRESS 0xe356 /end MEASUREMENT
/begin MEASUREMENT T_PUC_RESI "t_puc_resi" UWORD LINEAR______0_000000__0H___11_18 2 2.0 0.0 11.18464 BIT_MASK 0xffffffff ECU_ADDRESS 0xe2c4 /end MEASUREMENT
/begin MEASUREMENT T_REL_CAN_ES "t_rel_can_es" UWORD LINEAR______0_000000__0H___65535 2 2.0 0.0 65535.0 BIT_MASK 0xffffffff ECU_ADDRESS 0x406d2 /end MEASUREMENT
/begin MEASUREMENT T_REL_CAN_ST "t_rel_can_st" UWORD LINEAR______0_000000__0H___65535 2 2.0 0.0 65535.0 BIT_MASK 0xffffffff ECU_ADDRESS 0x406d0 /end MEASUREMENT
/begin MEASUREMENT T_SEG_COR_1_6 "t_seg_cor_1_6" UWORD LINEAR______0_000000__0H___43690 2 2.0 0.0 43690.0 BIT_MASK 0xffffffff ECU_ADDRESS 0xe38c /end MEASUREMENT
/begin MEASUREMENT T_SEG_GRD "t_seg_grd" SWORD LINEAR_______0_125000__FFFF8000H 2 2.0 -0.125 0.12499 BIT_MASK 0xffffffff ECU_ADDRESS 0x406bc /end MEASUREMENT
/begin MEASUREMENT T_SEG_GRD_END_THD "t_seg_grd_end_thd" SWORD LINEAR_______0_125000__FFFF8000H 2 2.0 -0.125 0.12499 BIT_MASK 0xffffffff ECU_ADDRESS 0x406be /end MEASUREMENT
/begin MEASUREMENT T_SEG_GRD_ST_THD "t_seg_grd_st_thd" SWORD LINEAR_______0_125000__FFFF8000H 2 2.0 -0.125 0.12499 BIT_MASK 0xffffffff ECU_ADDRESS 0x406c0 /end MEASUREMENT
/begin MEASUREMENT T_SEG_MES_0_RR "t_seg_mes_0_rr" UWORD LINEAR______0_000000__0H___349_5 2 2.0 0.0 349.52 BIT_MASK 0xffffffff ECU_ADDRESS 0x410b2 /end MEASUREMENT
/begin MEASUREMENT T_SEG_MES_1_RR "t_seg_mes_1_rr" UWORD LINEAR______0_000000__0H___349_5 2 2.0 0.0 349.52 BIT_MASK 0xffffffff ECU_ADDRESS 0x410b4 /end MEASUREMENT
/begin MEASUREMENT T_SA_DUR "t_sl_prolong" UWORD LINEAR______0_000000__0H___6553_ 2 2.0 0.0 6553.5 BIT_MASK 0xffffffff ECU_ADDRESS 0x410cc /end MEASUREMENT
/begin MEASUREMENT T_STATE_AMT_1_DIAG "t_state_amt_1_diag" UWORD LINEAR______0_000000__0H___655_3 2 2.0 0.0 655.35 BIT_MASK 0xffffffff FUNCTION_LIST Z1S1 ECU_ADDRESS 0xe1ae /end MEASUREMENT
/begin MEASUREMENT T_STATE_AMT_2_DIAG "t_state_amt_2_diag" UWORD LINEAR______0_000000__0H___655_3 2 2.0 0.0 655.35 BIT_MASK 0xffffffff FUNCTION_LIST Z1S1 ECU_ADDRESS 0xe1b0 /end MEASUREMENT
/begin MEASUREMENT T_STATE_AMT_3_DIAG "t_state_amt_3_diag" UWORD LINEAR______0_000000__0H___655_3 2 2.0 0.0 655.35 BIT_MASK 0xffffffff FUNCTION_LIST Z1S1 ECU_ADDRESS 0xe1b2 /end MEASUREMENT
/begin MEASUREMENT T_STATE_CLU_AMT_DIAG "t_state_clu_amt_diag" UWORD LINEAR______0_000000__0H___655_3 2 2.0 0.0 655.35 BIT_MASK 0xffffffff FUNCTION_LIST Z1S1 ECU_ADDRESS 0xe1b4 /end MEASUREMENT
/begin MEASUREMENT T_SUM_RST_FSD_1 "t_sum_rst_fsd_1" UWORD LINEAR______0_000000__0H___65152 2 2.0 0.0 65535.0 BIT_MASK 0xffffffff ECU_ADDRESS 0x40802 /end MEASUREMENT
/begin MEASUREMENT T_SUM_RST_FSD_2 "t_sum_rst_fsd_2" UWORD LINEAR______0_000000__0H___65152 2 2.0 0.0 65535.0 BIT_MASK 0xffffffff ECU_ADDRESS 0x40804 /end MEASUREMENT
/begin MEASUREMENT T_TCO_GRD_MON "t_tco_grd_mon" UBYTE LINEAR______0_000000__0H___10_20 2 2.0 0.0 10.2 BIT_MASK 0xffffffff ECU_ADDRESS 0x40010 /end MEASUREMENT
/begin MEASUREMENT T_TQI_AMT_DIAG "t_tqi_amt_diag" UWORD LINEAR______0_000000__0H___655_3 2 2.0 0.0 655.35 BIT_MASK 0xffffffff FUNCTION_LIST Z1S1 ECU_ADDRESS 0xe1b6 /end MEASUREMENT
/begin MEASUREMENT T_TQI_LIM_ACT "t_tqi_lim_act" UWORD LINEAR______0_000000__0H___655_3 2 2.0 0.0 655.35 BIT_MASK 0xffffffff ECU_ADDRESS 0xe0b2 /end MEASUREMENT
/begin MEASUREMENT T_TQI_LIM_MAX_SAVE "t_tqi_lim_max_save" UWORD LINEAR______0_000000__0H___655_3 2 2.0 0.0 655.35 BIT_MASK 0xffffffff ECU_ADDRESS 0xe092 /end MEASUREMENT
/begin MEASUREMENT T_TQI_MON2 "t_tqi_mon2" UBYTE LINEAR______0_000000__0H___10_20 2 2.0 0.0 10.2 BIT_MASK 0xffffffff FUNCTION_LIST MON2 ECU_ADDRESS 0x40069 /end MEASUREMENT
/begin MEASUREMENT T_VB_DLY_DMTL "t_vb_dly_dmtl" UWORD LINEAR______0_000000__0H___6553_ 2 2.0 0.0 6553.5 BIT_MASK 0xffffffff FUNCTION_LIST DMTL ECU_ADDRESS 0x41a46 /end MEASUREMENT
/begin MEASUREMENT TI_1 "tab_ti_samC0D" UWORD LINEAR______0_000000__0H___349_5 2 2.0 0.0 349.52 BIT_MASK 0xffffffff ECU_ADDRESS 0x41114 /end MEASUREMENT
/begin MEASUREMENT TI_5 "tab_ti_samC1D" UWORD LINEAR______0_000000__0H___349_5 2 2.0 0.0 349.52 BIT_MASK 0xffffffff ECU_ADDRESS 0x41116 /end MEASUREMENT
/begin MEASUREMENT TI_3 "tab_ti_samC2D" UWORD LINEAR______0_000000__0H___349_5 2 2.0 0.0 349.52 BIT_MASK 0xffffffff ECU_ADDRESS 0x41118 /end MEASUREMENT
/begin MEASUREMENT TI_6 "tab_ti_samC3D" UWORD LINEAR______0_000000__0H___349_5 2 2.0 0.0 349.52 BIT_MASK 0xffffffff ECU_ADDRESS 0x4111a /end MEASUREMENT
/begin MEASUREMENT TI_2 "tab_ti_samC4D" UWORD LINEAR______0_000000__0H___349_5 2 2.0 0.0 349.52 BIT_MASK 0xffffffff ECU_ADDRESS 0x4111c /end MEASUREMENT
/begin MEASUREMENT TI_4 "tab_ti_samC5D" UWORD LINEAR______0_000000__0H___349_5 2 2.0 0.0 349.52 BIT_MASK 0xffffffff ECU_ADDRESS 0x4111e /end MEASUREMENT
/begin MEASUREMENT TAM "tam" SBYTE LINEAR_______128_000000__FFFF143 2 2.0 -128.0 127.0 BIT_MASK 0xffffffff ECU_ADDRESS 0x40101 /end MEASUREMENT
/begin MEASUREMENT TAM_DEW "tam_dew" SBYTE LINEAR_______128_000000__FFFF143 2 2.0 -128.0 127.0 BIT_MASK 0xffffffff ECU_ADDRESS 0x400a8 /end MEASUREMENT
/begin MEASUREMENT TAM_MON_SA "tam_mon_sa" SBYTE LINEAR_______128_000000__FFFF143 2 2.0 -128.0 127.0 BIT_MASK 0xffffffff ECU_ADDRESS 0x401a7 /end MEASUREMENT
/begin MEASUREMENT TCO "tco" UBYTE LINEAR_______48_000000__0H___142 2 2.0 -48.0 142.5 BIT_MASK 0xffffffff ECU_ADDRESS 0x4041e /end MEASUREMENT
/begin MEASUREMENT TCO_AST "tco_ast" UBYTE LINEAR_______48_000000__0H___142 2 2.0 -48.0 142.5 BIT_MASK 0xffffffff ECU_ADDRESS 0x40459 /end MEASUREMENT
/begin MEASUREMENT TCO_CAN "tco_can" UBYTE LINEAR_______48_000000__0H___142 2 2.0 -48.0 142.5 BIT_MASK 0xffffffff ECU_ADDRESS 0x400ff /end MEASUREMENT
/begin MEASUREMENT TCO_EX "tco_ex" UBYTE LINEAR_______48_000000__0H___142 2 2.0 -48.0 142.5 BIT_MASK 0xffffffff ECU_ADDRESS 0x40424 /end MEASUREMENT
/begin MEASUREMENT TCO_EX_ST "tco_ex_st" UBYTE LINEAR_______48_000000__0H___142 2 2.0 -48.0 142.5 BIT_MASK 0xffffffff ECU_ADDRESS 0x40425 /end MEASUREMENT
/begin MEASUREMENT TCO_MON "tco_mon" UBYTE LINEAR_______48_000000__0H___142 2 2.0 -48.0 142.5 BIT_MASK 0xffffffff ECU_ADDRESS 0x4000f /end MEASUREMENT
/begin MEASUREMENT TCO_MON2 "tco_mon2" UBYTE LINEAR_______48_000000__0H___142 2 2.0 -48.0 142.5 BIT_MASK 0xffffffff FUNCTION_LIST MON2 ECU_ADDRESS 0x4006a /end MEASUREMENT
/begin MEASUREMENT TCO_RAW "tco_raw" UBYTE LINEAR_______48_000000__0H___142 2 2.0 -48.0 142.5 BIT_MASK 0xffffffff ECU_ADDRESS 0x40436 /end MEASUREMENT
/begin MEASUREMENT TCO_SP "tco_sp" UBYTE LINEAR_______48_000000__0H___142 2 2.0 -48.0 142.5 BIT_MASK 0xffffffff ECU_ADDRESS 0x4017a /end MEASUREMENT
/begin MEASUREMENT TCO_ST "tco_st" UBYTE LINEAR_______48_000000__0H___142 2 2.0 -48.0 142.5 BIT_MASK 0xffffffff ECU_ADDRESS 0x4042f /end MEASUREMENT
/begin MEASUREMENT TCO_STOP "tco_stop" UBYTE LINEAR_______48_000000__0H___841 2 2.0 -48.0 142.5 BIT_MASK 0xffffffff ECU_ADDRESS 0x40433 /end MEASUREMENT
/begin MEASUREMENT TCO_SUB "tco_sub" UBYTE LINEAR_______48_000000__0H___142 2 2.0 -48.0 142.5 BIT_MASK 0xffffffff ECU_ADDRESS 0x4042d /end MEASUREMENT
/begin MEASUREMENT TD "td" UWORD LINEAR______0_000000__0H___349_5 2 2.0 0.0 349.52 BIT_MASK 0xffffffff ECU_ADDRESS 0xe4ae /end MEASUREMENT
/begin MEASUREMENT TD_CTL_FAC_1 "td_ctl_facC0D" UWORD LINEAR______0_000000__0H___1_999 2 2.0 0.0 1.99997 BIT_MASK 0xffffffff ECU_ADDRESS 0xe4c2 /end MEASUREMENT
/begin MEASUREMENT TD_CTL_FAC_5 "td_ctl_facC1D" UWORD LINEAR______0_000000__0H___1_999 2 2.0 0.0 1.99997 BIT_MASK 0xffffffff ECU_ADDRESS 0xe4c4 /end MEASUREMENT
/begin MEASUREMENT TD_CTL_FAC_3 "td_ctl_facC2D" UWORD LINEAR______0_000000__0H___1_999 2 2.0 0.0 1.99997 BIT_MASK 0xffffffff ECU_ADDRESS 0xe4c6 /end MEASUREMENT
/begin MEASUREMENT TD_CTL_FAC_6 "td_ctl_facC3D" UWORD LINEAR______0_000000__0H___1_999 2 2.0 0.0 1.99997 BIT_MASK 0xffffffff ECU_ADDRESS 0xe4c8 /end MEASUREMENT
/begin MEASUREMENT TD_CTL_FAC_2 "td_ctl_facC4D" UWORD LINEAR______0_000000__0H___1_999 2 2.0 0.0 1.99997 BIT_MASK 0xffffffff ECU_ADDRESS 0xe4ca /end MEASUREMENT
/begin MEASUREMENT TD_CTL_FAC_4 "td_ctl_facC5D" UWORD LINEAR______0_000000__0H___1_999 2 2.0 0.0 1.99997 BIT_MASK 0xffffffff ECU_ADDRESS 0xe4cc /end MEASUREMENT
/begin MEASUREMENT TD_MPL "td_mpl" UWORD LINEAR______0_000000__0H___349_5 2 2.0 0.0 349.52 BIT_MASK 0xffffffff ECU_ADDRESS 0xe4b2 /end MEASUREMENT
/begin MEASUREMENT TEG "teg" UWORD LINEAR______0_000000__0H___10253 2 2.0 0.0 1023.9844 BIT_MASK 0xffffffff ECU_ADDRESS 0xe148 /end MEASUREMENT
/begin MEASUREMENT TEG_DOWN_MES_2 "teg_down_mes_2" UWORD LINEAR______0_000000__0H___10253 2 2.0 0.0 1023.9844 BIT_MASK 0xffffffff ECU_ADDRESS 0x40578 /end MEASUREMENT
/begin MEASUREMENT TEG_UP_MES_1 "teg_up_mes_1" UWORD LINEAR______0_000000__0H___10253 2 2.0 0.0 1023.9844 BIT_MASK 0xffffffff ECU_ADDRESS 0x4057a /end MEASUREMENT
/begin MEASUREMENT TEG_UP_MES_2 "teg_up_mes_2" UWORD LINEAR______0_000000__0H___10253 2 2.0 0.0 1023.9844 BIT_MASK 0xffffffff ECU_ADDRESS 0x4057c /end MEASUREMENT
/begin MEASUREMENT TEMP_DIF_TCO "temp_dif_tco" SWORD LINEAR_______64_000000__FFFF8000 2 2.0 -64.0 63.998047 BIT_MASK 0xffffffff FUNCTION_LIST ETM ECU_ADDRESS 0x405a0 /end MEASUREMENT
/begin MEASUREMENT TEMP_DIF_TOIL "temp_dif_toil" SWORD LINEAR_______64_000000__FFFF8000 2 2.0 -64.0 63.998047 BIT_MASK 0xffffffff FUNCTION_LIST ETM ECU_ADDRESS 0x405a2 /end MEASUREMENT
/begin MEASUREMENT TEMP_FAC_DEC_WALL_DOWN "temp_fac_dec_wall_down" UBYTE LINEAR______0_000000__0H___0_996 2 2.0 0.0 0.99609375 BIT_MASK 0xffffffff FUNCTION_LIST DPM ECU_ADDRESS 0x400a9 /end MEASUREMENT
/begin MEASUREMENT TEMP_FAC_DEC_WALL_UP "temp_fac_dec_wall_up" UBYTE LINEAR______0_000000__0H___0_996 2 2.0 0.0 0.99609375 BIT_MASK 0xffffffff FUNCTION_LIST DPM ECU_ADDRESS 0x400aa /end MEASUREMENT
/begin MEASUREMENT TEMP_FAC_MAF_FAC_TI_DIF "temp_fac_maf_fac_ti_dif" UBYTE LINEAR______0_000000__0H___1_992 2 2.0 0.0 1.9921875 BIT_MASK 0xffffffff FUNCTION_LIST ETM ECU_ADDRESS 0x400a0 /end MEASUREMENT
/begin MEASUREMENT TEMP_FAC_MAF_IGA_DIF "temp_fac_maf_iga_dif" UBYTE LINEAR______0_000000__0H___1_992 2 2.0 0.0 1.9921875 BIT_MASK 0xffffffff FUNCTION_LIST ETM ECU_ADDRESS 0x400a1 /end MEASUREMENT
/begin MEASUREMENT TEMP_FAC_TOIL "temp_fac_toil" UBYTE LINEAR______0_000000__0H___1_992 2 2.0 0.0 1.9921875 BIT_MASK 0xffffffff FUNCTION_LIST ETM ECU_ADDRESS 0x400a3 /end MEASUREMENT
/begin MEASUREMENT TEMP_MMV_SUB_CAT "temp_mmv_sub_cat" UWORD LINEAR_______33_000000__0H___991 2 2.0 -33.0 991.0 BIT_MASK 0xffffffff ECU_ADDRESS 0xe14a /end MEASUREMENT
/begin MEASUREMENT TEMP_MMV_SUB_CAT_ECF "temp_mmv_sub_cat_ecfvbyteC1D" UBYTE LINEAR_______33_000000__0H___842 2 2.0 -33.0 987.0 BIT_MASK 0xffffffff ECU_ADDRESS 0x406dd /end MEASUREMENT
/begin MEASUREMENT TEMP_MMV_SUB_CAT_ECF_STOP "temp_mmv_sub_cat_ecf_stop" UBYTE LINEAR_______33_000000__0H___842 2 2.0 -33.0 987.0 BIT_MASK 0xffffffff ECU_ADDRESS 0x4011d /end MEASUREMENT
/begin MEASUREMENT TEMP_MMV_SUB_EX_DOWN_1 "temp_mmv_sub_ex_down_1" UWORD LINEAR_______33_000000__0H___989 2 2.0 -33.0 989.9844 BIT_MASK 0xffffffff FUNCTION_LIST ETM ECU_ADDRESS 0x4057e /end MEASUREMENT
/begin MEASUREMENT TEMP_MMV_SUB_EX_DOWN_2 "temp_mmv_sub_ex_down_2" UWORD LINEAR_______33_000000__0H___989 2 2.0 -33.0 989.9844 BIT_MASK 0xffffffff FUNCTION_LIST ETM ECU_ADDRESS 0x40580 /end MEASUREMENT
/begin MEASUREMENT TEMP_MMV_SUB_EX_STOP_DOWN "temp_mmv_sub_ex_stop_down" UWORD LINEAR_______33_000000__0H___989 2 2.0 -33.0 989.9844 BIT_MASK 0xffffffff FUNCTION_LIST ETM ECU_ADDRESS 0x40584 /end MEASUREMENT
/begin MEASUREMENT TEMP_MMV_SUB_EX_STOP_UP "temp_mmv_sub_ex_stop_up" UWORD LINEAR_______33_000000__0H___989 2 2.0 -33.0 989.9844 BIT_MASK 0xffffffff FUNCTION_LIST ETM ECU_ADDRESS 0x40582 /end MEASUREMENT
/begin MEASUREMENT TEMP_MMV_SUB_EX_UP_1 "temp_mmv_sub_ex_up_1" UWORD LINEAR_______33_000000__0H___989 2 2.0 -33.0 989.9844 BIT_MASK 0xffffffff FUNCTION_LIST ETM ECU_ADDRESS 0x40586 /end MEASUREMENT
/begin MEASUREMENT TEMP_MMV_SUB_EX_UP_2 "temp_mmv_sub_ex_up_2" UWORD LINEAR_______33_000000__0H___989 2 2.0 -33.0 989.9844 BIT_MASK 0xffffffff FUNCTION_LIST ETM ECU_ADDRESS 0x40588 /end MEASUREMENT
/begin MEASUREMENT TEMP_MMV_SUB_WALL_DOWN_1 "temp_mmv_sub_wall_down_1" UWORD LINEAR_______33_000000__0H___989 2 2.0 -33.0 989.9844 BIT_MASK 0xffffffff FUNCTION_LIST ETM ECU_ADDRESS 0x4058a /end MEASUREMENT
/begin MEASUREMENT TEMP_MMV_SUB_WALL_DOWN_2 "temp_mmv_sub_wall_down_2" UWORD LINEAR_______33_000000__0H___989 2 2.0 -33.0 989.9844 BIT_MASK 0xffffffff FUNCTION_LIST ETM ECU_ADDRESS 0x4058c /end MEASUREMENT
/begin MEASUREMENT TEMP_MMV_SUB_WALL_UP_1 "temp_mmv_sub_wall_up_1" UWORD LINEAR_______33_000000__0H___989 2 2.0 -33.0 989.9844 BIT_MASK 0xffffffff FUNCTION_LIST ETM ECU_ADDRESS 0x4058e /end MEASUREMENT
/begin MEASUREMENT TEMP_MMV_SUB_WALL_UP_2 "temp_mmv_sub_wall_up_2" UWORD LINEAR_______33_000000__0H___989 2 2.0 -33.0 989.9844 BIT_MASK 0xffffffff FUNCTION_LIST ETM ECU_ADDRESS 0x40590 /end MEASUREMENT
/begin MEASUREMENT TEMP_MMV_WALL_STOP_DOWN "temp_mmv_wall_stop_down" UWORD LINEAR_______33_000000__0H___989 2 2.0 -33.0 989.9844 BIT_MASK 0xffffffff FUNCTION_LIST ETM ECU_ADDRESS 0x40592 /end MEASUREMENT
/begin MEASUREMENT TEMP_MMV_WALL_STOP_UP "temp_mmv_wall_stop_up" UWORD LINEAR_______33_000000__0H___989 2 2.0 -33.0 989.9844 BIT_MASK 0xffffffff FUNCTION_LIST ETM ECU_ADDRESS 0x40594 /end MEASUREMENT
/begin MEASUREMENT TEMP_SUB_DOWN_1 "temp_sub_down_1" UWORD LINEAR_______33_000000__0H___989 2 2.0 -33.0 989.9844 BIT_MASK 0xffffffff FUNCTION_LIST ETM ECU_ADDRESS 0x405fc /end MEASUREMENT
/begin MEASUREMENT TEMP_SUB_DOWN_2 "temp_sub_down_2" UWORD LINEAR_______33_000000__0H___989 2 2.0 -33.0 989.9844 BIT_MASK 0xffffffff FUNCTION_LIST ETM ECU_ADDRESS 0x405fe /end MEASUREMENT
/begin MEASUREMENT TEMP_SUB_ECF_DOWN_1 "temp_sub_ecf_down_1" SWORD LINEAR_______1024_000000__FFFF80 2 2.0 -1024.0 1023.9688 BIT_MASK 0xffffffff FUNCTION_LIST ETM ECU_ADDRESS 0x405bc /end MEASUREMENT
/begin MEASUREMENT TEMP_SUB_ECF_DOWN_2 "temp_sub_ecf_down_2" SWORD LINEAR_______1024_000000__FFFF80 2 2.0 -1024.0 1023.9688 BIT_MASK 0xffffffff FUNCTION_LIST ETM ECU_ADDRESS 0x405be /end MEASUREMENT
/begin MEASUREMENT TEMP_SUB_ECF_UP_1 "temp_sub_ecf_up_1" SWORD LINEAR_______1024_000000__FFFF80 2 2.0 -1024.0 1023.9688 BIT_MASK 0xffffffff FUNCTION_LIST ETM ECU_ADDRESS 0x405c0 /end MEASUREMENT
/begin MEASUREMENT TEMP_SUB_ECF_UP_2 "temp_sub_ecf_up_2" SWORD LINEAR_______1024_000000__FFFF80 2 2.0 -1024.0 1023.9688 BIT_MASK 0xffffffff FUNCTION_LIST ETM ECU_ADDRESS 0x405c2 /end MEASUREMENT
/begin MEASUREMENT TEMP_SUB_EX_DIF_DOWN_1 "temp_sub_ex_dif_down_1" UWORD LINEAR______0_000000__0H___7_999 2 2.0 0.0 7.999878 BIT_MASK 0xffffffff FUNCTION_LIST ETM ECU_ADDRESS 0x40600 /end MEASUREMENT
/begin MEASUREMENT TEMP_SUB_EX_DIF_DOWN_2 "temp_sub_ex_dif_down_2" UWORD LINEAR______0_000000__0H___7_999 2 2.0 0.0 7.999878 BIT_MASK 0xffffffff FUNCTION_LIST ETM ECU_ADDRESS 0x40602 /end MEASUREMENT
/begin MEASUREMENT TEMP_SUB_EX_DIF_UP_1 "temp_sub_ex_dif_up_1" UWORD LINEAR______0_000000__0H___7_999 2 2.0 0.0 7.999878 BIT_MASK 0xffffffff FUNCTION_LIST ETM ECU_ADDRESS 0x40604 /end MEASUREMENT
/begin MEASUREMENT TEMP_SUB_EX_DIF_UP_2 "temp_sub_ex_dif_up_2" UWORD LINEAR______0_000000__0H___7_999 2 2.0 0.0 7.999878 BIT_MASK 0xffffffff FUNCTION_LIST ETM ECU_ADDRESS 0x40606 /end MEASUREMENT
/begin MEASUREMENT TEMP_SUB_EX_DOWN_1 "temp_sub_ex_down_1" UWORD LINEAR_______33_000000__0H___989 2 2.0 -33.0 989.9844 BIT_MASK 0xffffffff FUNCTION_LIST ETM ECU_ADDRESS 0x40608 /end MEASUREMENT
/begin MEASUREMENT TEMP_SUB_EX_DOWN_2 "temp_sub_ex_down_2" UWORD LINEAR_______33_000000__0H___989 2 2.0 -33.0 989.9844 BIT_MASK 0xffffffff FUNCTION_LIST ETM ECU_ADDRESS 0x4060a /end MEASUREMENT
/begin MEASUREMENT TEMP_SUB_EX_UP_1 "temp_sub_ex_up_1" UWORD LINEAR_______33_000000__0H___989 2 2.0 -33.0 989.9844 BIT_MASK 0xffffffff FUNCTION_LIST ETM ECU_ADDRESS 0x40596 /end MEASUREMENT
/begin MEASUREMENT TEMP_SUB_EX_UP_2 "temp_sub_ex_up_2" UWORD LINEAR_______33_000000__0H___989 2 2.0 -33.0 989.9844 BIT_MASK 0xffffffff FUNCTION_LIST ETM ECU_ADDRESS 0x40598 /end MEASUREMENT
/begin MEASUREMENT TEMP_SUB_FAC_TI_DIF_DOWN_1 "temp_sub_fac_ti_dif_down_1" SWORD LINEAR_______512_000000__FFFF801 2 2.0 -512.0 511.98438 BIT_MASK 0xffffffff FUNCTION_LIST ETM ECU_ADDRESS 0x405c4 /end MEASUREMENT
/begin MEASUREMENT TEMP_SUB_FAC_TI_DIF_DOWN_2 "temp_sub_fac_ti_dif_down_2" SWORD LINEAR_______512_000000__FFFF801 2 2.0 -512.0 511.98438 BIT_MASK 0xffffffff FUNCTION_LIST ETM ECU_ADDRESS 0x405c6 /end MEASUREMENT
/begin MEASUREMENT TEMP_SUB_FAC_TI_DIF_UP_1 "temp_sub_fac_ti_dif_up_1" SWORD LINEAR_______512_000000__FFFF801 2 2.0 -512.0 511.98438 BIT_MASK 0xffffffff FUNCTION_LIST ETM ECU_ADDRESS 0x405c8 /end MEASUREMENT
/begin MEASUREMENT TEMP_SUB_FAC_TI_DIF_UP_2 "temp_sub_fac_ti_dif_up_2" SWORD LINEAR_______512_000000__FFFF801 2 2.0 -512.0 511.98438 BIT_MASK 0xffffffff FUNCTION_LIST ETM ECU_ADDRESS 0x405ca /end MEASUREMENT
/begin MEASUREMENT TEMP_SUB_IGA_DIF_DOWN_1 "temp_sub_iga_dif_down_1" UWORD LINEAR______0_000000__0H___10253 2 2.0 0.0 1023.9844 BIT_MASK 0xffffffff FUNCTION_LIST ETM ECU_ADDRESS 0x4060c /end MEASUREMENT
/begin MEASUREMENT TEMP_SUB_IGA_DIF_DOWN_2 "temp_sub_iga_dif_down_2" UWORD LINEAR______0_000000__0H___10253 2 2.0 0.0 1023.9844 BIT_MASK 0xffffffff FUNCTION_LIST ETM ECU_ADDRESS 0x4060e /end MEASUREMENT
/begin MEASUREMENT TEMP_SUB_IGA_DIF_UP_1 "temp_sub_iga_dif_up_1" UWORD LINEAR______0_000000__0H___10253 2 2.0 0.0 1023.9844 BIT_MASK 0xffffffff FUNCTION_LIST ETM ECU_ADDRESS 0x40610 /end MEASUREMENT
/begin MEASUREMENT TEMP_SUB_IGA_DIF_UP_2 "temp_sub_iga_dif_up_2" UWORD LINEAR______0_000000__0H___10253 2 2.0 0.0 1023.9844 BIT_MASK 0xffffffff FUNCTION_LIST ETM ECU_ADDRESS 0x40612 /end MEASUREMENT
/begin MEASUREMENT TEMP_SUB_LEVEL "temp_sub_level" UWORD LINEAR______0_000000__0H___7_999 2 2.0 0.0 7.999878 BIT_MASK 0xffffffff FUNCTION_LIST ETM ECU_ADDRESS 0x40614 /end MEASUREMENT
/begin MEASUREMENT TEMP_SUB_LEVEL_REZI "temp_sub_level_rezi" UWORD LINEAR______0_000000__0H___7_999 2 2.0 0.0 7.999878 BIT_MASK 0xffffffff FUNCTION_LIST ETM ECU_ADDRESS 0x40616 /end MEASUREMENT
/begin MEASUREMENT TEMP_SUB_PUC_DOWN_1 "temp_sub_puc_down_1" UWORD LINEAR_______33_000000__0H___989 2 2.0 -33.0 989.9844 BIT_MASK 0xffffffff FUNCTION_LIST ETM ECU_ADDRESS 0x40618 /end MEASUREMENT
/begin MEASUREMENT TEMP_SUB_PUC_DOWN_2 "temp_sub_puc_down_2" UWORD LINEAR_______33_000000__0H___989 2 2.0 -33.0 989.9844 BIT_MASK 0xffffffff FUNCTION_LIST ETM ECU_ADDRESS 0x4061a /end MEASUREMENT
/begin MEASUREMENT TEMP_SUB_PUC_UP_1 "temp_sub_puc_up_1" UWORD LINEAR_______33_000000__0H___989 2 2.0 -33.0 989.9844 BIT_MASK 0xffffffff FUNCTION_LIST ETM ECU_ADDRESS 0x4061c /end MEASUREMENT
/begin MEASUREMENT TEMP_SUB_PUC_UP_2 "temp_sub_puc_up_2" UWORD LINEAR_______33_000000__0H___989 2 2.0 -33.0 989.9844 BIT_MASK 0xffffffff FUNCTION_LIST ETM ECU_ADDRESS 0x4061e /end MEASUREMENT
/begin MEASUREMENT TEMP_SUB_SAP_DOWN "temp_sub_sap_down" UWORD LINEAR_______1023_984375__FFF843 2 2.0 -1023.9847 0.0 BIT_MASK 0xffffffff FUNCTION_LIST ETM ECU_ADDRESS 0x4062c /end MEASUREMENT
/begin MEASUREMENT TEMP_SUB_SAP_UP "temp_sub_sap_up" UWORD LINEAR_______1023_984375__FFF843 2 2.0 -1023.9847 0.0 BIT_MASK 0xffffffff FUNCTION_LIST ETM ECU_ADDRESS 0x4062e /end MEASUREMENT
/begin MEASUREMENT TEMP_SUB_UP_1 "temp_sub_up_1" UWORD LINEAR_______33_000000__0H___989 2 2.0 -33.0 989.9844 BIT_MASK 0xffffffff FUNCTION_LIST ETM ECU_ADDRESS 0x40620 /end MEASUREMENT
/begin MEASUREMENT TEMP_SUB_UP_2 "temp_sub_up_2" UWORD LINEAR_______33_000000__0H___989 2 2.0 -33.0 989.9844 BIT_MASK 0xffffffff FUNCTION_LIST ETM ECU_ADDRESS 0x40622 /end MEASUREMENT
/begin MEASUREMENT TEMP_SUB_VS_DOWN_1 "temp_sub_vs_down_1" SWORD LINEAR_______512_000000__FFFF801 2 2.0 -512.0 511.98438 BIT_MASK 0xffffffff FUNCTION_LIST ETM ECU_ADDRESS 0x405a8 /end MEASUREMENT
/begin MEASUREMENT TEMP_SUB_VS_DOWN_2 "temp_sub_vs_down_2" SWORD LINEAR_______512_000000__FFFF801 2 2.0 -512.0 511.98438 BIT_MASK 0xffffffff FUNCTION_LIST ETM ECU_ADDRESS 0x405aa /end MEASUREMENT
/begin MEASUREMENT TEMP_SUB_VS_UP_1 "temp_sub_vs_up_1" SWORD LINEAR_______512_000000__FFFF801 2 2.0 -512.0 511.98438 BIT_MASK 0xffffffff FUNCTION_LIST ETM ECU_ADDRESS 0x405a4 /end MEASUREMENT
/begin MEASUREMENT TEMP_SUB_VS_UP_2 "temp_sub_vs_up_2" SWORD LINEAR_______512_000000__FFFF801 2 2.0 -512.0 511.98438 BIT_MASK 0xffffffff FUNCTION_LIST ETM ECU_ADDRESS 0x405a6 /end MEASUREMENT
/begin MEASUREMENT TEMP_SUB_WALL_DOWN_1 "temp_sub_wall_down_1" UWORD LINEAR_______33_000000__0H___989 2 2.0 -33.0 989.9844 BIT_MASK 0xffffffff FUNCTION_LIST ETM ECU_ADDRESS 0x40624 /end MEASUREMENT
/begin MEASUREMENT TEMP_SUB_WALL_DOWN_2 "temp_sub_wall_down_2" UWORD LINEAR_______33_000000__0H___989 2 2.0 -33.0 989.9844 BIT_MASK 0xffffffff FUNCTION_LIST ETM ECU_ADDRESS 0x40626 /end MEASUREMENT
/begin MEASUREMENT TEMP_SUB_WALL_ECF_DOWN_1 "temp_sub_wall_ecf_down_1" SWORD LINEAR_______1024_000000__FFFF80 2 2.0 -1024.0 1023.9688 BIT_MASK 0xffffffff FUNCTION_LIST ETM ECU_ADDRESS 0x405cc /end MEASUREMENT
/begin MEASUREMENT TEMP_SUB_WALL_ECF_DOWN_2 "temp_sub_wall_ecf_down_2" SWORD LINEAR_______1024_000000__FFFF80 2 2.0 -1024.0 1023.9688 BIT_MASK 0xffffffff FUNCTION_LIST ETM ECU_ADDRESS 0x405ce /end MEASUREMENT
/begin MEASUREMENT TEMP_SUB_WALL_ECF_UP_1 "temp_sub_wall_ecf_up_1" SWORD LINEAR_______1024_000000__FFFF80 2 2.0 -1024.0 1023.9688 BIT_MASK 0xffffffff FUNCTION_LIST ETM ECU_ADDRESS 0x405d0 /end MEASUREMENT
/begin MEASUREMENT TEMP_SUB_WALL_ECF_UP_2 "temp_sub_wall_ecf_up_2" SWORD LINEAR_______1024_000000__FFFF80 2 2.0 -1024.0 1023.9688 BIT_MASK 0xffffffff FUNCTION_LIST ETM ECU_ADDRESS 0x405d2 /end MEASUREMENT
/begin MEASUREMENT TEMP_SUB_WALL_FAC_TI_DIF_DOWN_1 "temp_sub_wall_fac_ti_dif_down_1" SWORD LINEAR_______512_000000__FFFF801 2 2.0 -512.0 511.98438 BIT_MASK 0xffffffff FUNCTION_LIST ETM ECU_ADDRESS 0x405d4 /end MEASUREMENT
/begin MEASUREMENT TEMP_SUB_WALL_FAC_TI_DIF_DOWN_2 "temp_sub_wall_fac_ti_dif_down_2" SWORD LINEAR_______512_000000__FFFF801 2 2.0 -512.0 511.98438 BIT_MASK 0xffffffff FUNCTION_LIST ETM ECU_ADDRESS 0x405d6 /end MEASUREMENT
/begin MEASUREMENT TEMP_SUB_WALL_FAC_TI_DIF_UP_1 "temp_sub_wall_fac_ti_dif_up_1" SWORD LINEAR_______512_000000__FFFF801 2 2.0 -512.0 511.98438 BIT_MASK 0xffffffff FUNCTION_LIST ETM ECU_ADDRESS 0x405d8 /end MEASUREMENT
/begin MEASUREMENT TEMP_SUB_WALL_FAC_TI_DIF_UP_2 "temp_sub_wall_fac_ti_dif_up_2" SWORD LINEAR_______512_000000__FFFF801 2 2.0 -512.0 511.98438 BIT_MASK 0xffffffff FUNCTION_LIST ETM ECU_ADDRESS 0x405da /end MEASUREMENT
/begin MEASUREMENT TEMP_SUB_WALL_IGA_DIF_DOWN_1 "temp_sub_wall_iga_dif_down_1" UWORD LINEAR______0_000000__0H___10253 2 2.0 0.0 1023.9844 BIT_MASK 0xffffffff FUNCTION_LIST ETM ECU_ADDRESS 0x40630 /end MEASUREMENT
/begin MEASUREMENT TEMP_SUB_WALL_IGA_DIF_DOWN_2 "temp_sub_wall_iga_dif_down_2" UWORD LINEAR______0_000000__0H___10253 2 2.0 0.0 1023.9844 BIT_MASK 0xffffffff FUNCTION_LIST ETM ECU_ADDRESS 0x40632 /end MEASUREMENT
/begin MEASUREMENT TEMP_SUB_WALL_IGA_DIF_UP_1 "temp_sub_wall_iga_dif_up_1" UWORD LINEAR______0_000000__0H___10253 2 2.0 0.0 1023.9844 BIT_MASK 0xffffffff FUNCTION_LIST ETM ECU_ADDRESS 0x40634 /end MEASUREMENT
/begin MEASUREMENT TEMP_SUB_WALL_IGA_DIF_UP_2 "temp_sub_wall_iga_dif_up_2" UWORD LINEAR______0_000000__0H___10253 2 2.0 0.0 1023.9844 BIT_MASK 0xffffffff FUNCTION_LIST ETM ECU_ADDRESS 0x40636 /end MEASUREMENT
/begin MEASUREMENT TEMP_SUB_WALL_PUC_DOWN_1 "temp_sub_wall_puc_down_1" UWORD LINEAR_______33_000000__0H___989 2 2.0 -33.0 989.9844 BIT_MASK 0xffffffff FUNCTION_LIST ETM ECU_ADDRESS 0x40638 /end MEASUREMENT
/begin MEASUREMENT TEMP_SUB_WALL_PUC_DOWN_2 "temp_sub_wall_puc_down_2" UWORD LINEAR_______33_000000__0H___989 2 2.0 -33.0 989.9844 BIT_MASK 0xffffffff FUNCTION_LIST ETM ECU_ADDRESS 0x4063a /end MEASUREMENT
/begin MEASUREMENT TEMP_SUB_WALL_PUC_UP_1 "temp_sub_wall_puc_up_1" UWORD LINEAR_______33_000000__0H___989 2 2.0 -33.0 989.9844 BIT_MASK 0xffffffff FUNCTION_LIST ETM ECU_ADDRESS 0x4063c /end MEASUREMENT
/begin MEASUREMENT TEMP_SUB_WALL_PUC_UP_2 "temp_sub_wall_puc_up_2" UWORD LINEAR_______33_000000__0H___989 2 2.0 -33.0 989.9844 BIT_MASK 0xffffffff FUNCTION_LIST ETM ECU_ADDRESS 0x4063e /end MEASUREMENT
/begin MEASUREMENT TEMP_SUB_WALL_SAP_DOWN "temp_sub_wall_sap_down" UWORD LINEAR_______1023_984375__FFF843 2 2.0 -1023.9847 0.0 BIT_MASK 0xffffffff FUNCTION_LIST ETM ECU_ADDRESS 0x40640 /end MEASUREMENT
/begin MEASUREMENT TEMP_SUB_WALL_SAP_UP "temp_sub_wall_sap_up" UWORD LINEAR_______1023_984375__FFF843 2 2.0 -1023.9847 0.0 BIT_MASK 0xffffffff FUNCTION_LIST ETM ECU_ADDRESS 0x40642 /end MEASUREMENT
/begin MEASUREMENT TEMP_SUB_WALL_UP_1 "temp_sub_wall_up_1" UWORD LINEAR_______33_000000__0H___989 2 2.0 -33.0 989.9844 BIT_MASK 0xffffffff FUNCTION_LIST ETM ECU_ADDRESS 0x40628 /end MEASUREMENT
/begin MEASUREMENT TEMP_SUB_WALL_UP_2 "temp_sub_wall_up_2" UWORD LINEAR_______33_000000__0H___989 2 2.0 -33.0 989.9844 BIT_MASK 0xffffffff FUNCTION_LIST ETM ECU_ADDRESS 0x4062a /end MEASUREMENT
/begin MEASUREMENT TEMP_SUB_WALL_VS_DOWN_1 "temp_sub_wall_vs_down_1" SWORD LINEAR_______512_000000__FFFF801 2 2.0 -512.0 511.98438 BIT_MASK 0xffffffff FUNCTION_LIST ETM ECU_ADDRESS 0x405b0 /end MEASUREMENT
/begin MEASUREMENT TEMP_SUB_WALL_VS_DOWN_2 "temp_sub_wall_vs_down_2" SWORD LINEAR_______512_000000__FFFF801 2 2.0 -512.0 511.98438 BIT_MASK 0xffffffff FUNCTION_LIST ETM ECU_ADDRESS 0x405b2 /end MEASUREMENT
/begin MEASUREMENT TEMP_SUB_WALL_VS_UP_1 "temp_sub_wall_vs_up_1" SWORD LINEAR_______512_000000__FFFF801 2 2.0 -512.0 511.98438 BIT_MASK 0xffffffff FUNCTION_LIST ETM ECU_ADDRESS 0x405ac /end MEASUREMENT
/begin MEASUREMENT TEMP_SUB_WALL_VS_UP_2 "temp_sub_wall_vs_up_2" SWORD LINEAR_______512_000000__FFFF801 2 2.0 -512.0 511.98438 BIT_MASK 0xffffffff FUNCTION_LIST ETM ECU_ADDRESS 0x405ae /end MEASUREMENT
/begin MEASUREMENT TEMP_WALL_DOWN_1 "temp_wall_down_1" UWORD LINEAR_______33_000000__0H___989 2 2.0 -33.0 989.9844 BIT_MASK 0xffffffff FUNCTION_LIST ETM ECU_ADDRESS 0x4064a /end MEASUREMENT
/begin MEASUREMENT TEMP_WALL_DOWN_2 "temp_wall_down_2" UWORD LINEAR_______33_000000__0H___989 2 2.0 -33.0 989.9844 BIT_MASK 0xffffffff FUNCTION_LIST ETM ECU_ADDRESS 0x4064c /end MEASUREMENT
/begin MEASUREMENT TEMP_WALL_FAC_TOIL "temp_wall_fac_toil" UBYTE LINEAR______0_000000__0H___1_992 2 2.0 0.0 1.9921875 BIT_MASK 0xffffffff FUNCTION_LIST ETM ECU_ADDRESS 0x400a7 /end MEASUREMENT
/begin MEASUREMENT TEMP_WALL_UP_1 "temp_wall_up_1" UWORD LINEAR_______33_000000__0H___989 2 2.0 -33.0 989.9844 BIT_MASK 0xffffffff FUNCTION_LIST ETM ECU_ADDRESS 0x4064e /end MEASUREMENT
/begin MEASUREMENT TEMP_WALL_UP_2 "temp_wall_up_2" UWORD LINEAR_______33_000000__0H___989 2 2.0 -33.0 989.9844 BIT_MASK 0xffffffff FUNCTION_LIST ETM ECU_ADDRESS 0x40650 /end MEASUREMENT
/begin MEASUREMENT CPS_FLAGS "tev_flags" UWORD LINEAR______0_000000__0H___65535 2 2.0 0.0 65535.0 BIT_MASK 0xffffffff ECU_ADDRESS 0xfd8e /end MEASUREMENT
/begin MEASUREMENT THD_ER_1 "thd_erC0D" SWORD LINEAR_______21845_000000__FFFF8 2 2.0 -21845.0 21844.333 BIT_MASK 0xffffffff ECU_ADDRESS 0xe24e /end MEASUREMENT
/begin MEASUREMENT THD_ER_5 "thd_erC1D" SWORD LINEAR_______21845_000000__FFFF8 2 2.0 -21845.0 21844.333 BIT_MASK 0xffffffff ECU_ADDRESS 0xe250 /end MEASUREMENT
/begin MEASUREMENT THD_ER_3 "thd_erC2D" SWORD LINEAR_______21845_000000__FFFF8 2 2.0 -21845.0 21844.333 BIT_MASK 0xffffffff ECU_ADDRESS 0xe252 /end MEASUREMENT
/begin MEASUREMENT THD_ER_6 "thd_erC3D" SWORD LINEAR_______21845_000000__FFFF8 2 2.0 -21845.0 21844.333 BIT_MASK 0xffffffff ECU_ADDRESS 0xe254 /end MEASUREMENT
/begin MEASUREMENT THD_ER_2 "thd_erC4D" SWORD LINEAR_______21845_000000__FFFF8 2 2.0 -21845.0 21844.333 BIT_MASK 0xffffffff ECU_ADDRESS 0xe256 /end MEASUREMENT
/begin MEASUREMENT THD_ER_4 "thd_erC5D" SWORD LINEAR_______21845_000000__FFFF8 2 2.0 -21845.0 21844.333 BIT_MASK 0xffffffff ECU_ADDRESS 0xe258 /end MEASUREMENT
/begin MEASUREMENT THD_ER_AD "thd_er_ad" UWORD LINEAR______0_000000__0H___0_999 2 2.0 0.0 0.99998474 BIT_MASK 0xffffffff ECU_ADDRESS 0xe1f4 /end MEASUREMENT
/begin MEASUREMENT THR "thr" UBYTE LINEAR______0_000000__0H___11913 2 2.0 0.0 119.5 BIT_MASK 0xffffffff ECU_ADDRESS 0x403fd /end MEASUREMENT
/begin MEASUREMENT TI_1_6 "ti_1_6" UWORD LINEAR______0_000000__0H___349_5 2 2.0 0.0 349.52 BIT_MASK 0xffffffff ECU_ADDRESS 0x41122 /end MEASUREMENT
/begin MEASUREMENT TI_AD_CYL_LAM_1_1 "ti_ad_cyl_lamC0D" UWORD LINEAR_______50_000000__0H___440 2 2.0 -50.0 49.998471 BIT_MASK 0xffffffff FUNCTION_LIST CSCM ECU_ADDRESS 0x40726 /end MEASUREMENT
/begin MEASUREMENT TI_AD_CYL_LAM_2_5 "ti_ad_cyl_lamC1D" UWORD LINEAR_______50_000000__0H___440 2 2.0 -50.0 49.998471 BIT_MASK 0xffffffff FUNCTION_LIST CSCM ECU_ADDRESS 0x40728 /end MEASUREMENT
/begin MEASUREMENT TI_AD_CYL_LAM_1_3 "ti_ad_cyl_lamC2D" UWORD LINEAR_______50_000000__0H___440 2 2.0 -50.0 49.998471 BIT_MASK 0xffffffff FUNCTION_LIST CSCM ECU_ADDRESS 0x4072a /end MEASUREMENT
/begin MEASUREMENT TI_AD_CYL_LAM_2_6 "ti_ad_cyl_lamC3D" UWORD LINEAR_______50_000000__0H___440 2 2.0 -50.0 49.998471 BIT_MASK 0xffffffff FUNCTION_LIST CSCM ECU_ADDRESS 0x4072c /end MEASUREMENT
/begin MEASUREMENT TI_AD_CYL_LAM_1_2 "ti_ad_cyl_lamC4D" UWORD LINEAR_______50_000000__0H___440 2 2.0 -50.0 49.998471 BIT_MASK 0xffffffff FUNCTION_LIST CSCM ECU_ADDRESS 0x4072e /end MEASUREMENT
/begin MEASUREMENT TI_AD_CYL_LAM_2_4 "ti_ad_cyl_lamC5D" UWORD LINEAR_______50_000000__0H___440 2 2.0 -50.0 49.998471 BIT_MASK 0xffffffff FUNCTION_LIST CSCM ECU_ADDRESS 0x40730 /end MEASUREMENT
/begin MEASUREMENT TI_ADD_DLY "ti_add_dly" UWORD LINEAR______0_000000__0H___10844 2 2.0 0.0 10.88 BIT_MASK 0xffffffff ECU_ADDRESS 0xe472 /end MEASUREMENT
/begin MEASUREMENT TI_ADD_REAC_SCC_1 "ti_add_reac_sccC0D" SWORD LINEAR_______174_762666__FFFF845 2 2.0 -174.76267 174.75733 BIT_MASK 0xffffffff ECU_ADDRESS 0xe480 /end MEASUREMENT
/begin MEASUREMENT TI_ADD_REAC_SCC_5 "ti_add_reac_sccC1D" SWORD LINEAR_______174_762666__FFFF845 2 2.0 -174.76267 174.75733 BIT_MASK 0xffffffff ECU_ADDRESS 0xe482 /end MEASUREMENT
/begin MEASUREMENT TI_ADD_REAC_SCC_3 "ti_add_reac_sccC2D" SWORD LINEAR_______174_762666__FFFF845 2 2.0 -174.76267 174.75733 BIT_MASK 0xffffffff ECU_ADDRESS 0xe484 /end MEASUREMENT
/begin MEASUREMENT TI_ADD_REAC_SCC_6 "ti_add_reac_sccC3D" SWORD LINEAR_______174_762666__FFFF845 2 2.0 -174.76267 174.75733 BIT_MASK 0xffffffff ECU_ADDRESS 0xe486 /end MEASUREMENT
/begin MEASUREMENT TI_ADD_REAC_SCC_2 "ti_add_reac_sccC4D" SWORD LINEAR_______174_762666__FFFF845 2 2.0 -174.76267 174.75733 BIT_MASK 0xffffffff ECU_ADDRESS 0xe488 /end MEASUREMENT
/begin MEASUREMENT TI_ADD_REAC_SCC_4 "ti_add_reac_sccC5D" SWORD LINEAR_______174_762666__FFFF845 2 2.0 -174.76267 174.75733 BIT_MASK 0xffffffff ECU_ADDRESS 0xe48a /end MEASUREMENT
/begin MEASUREMENT TI_ADD_WF "ti_add_wf" SWORD LINEAR_______174_762666__FFFF800 2 2.0 -174.76267 0.0 BIT_MASK 0xffffffff ECU_ADDRESS 0x410e4 /end MEASUREMENT
/begin MEASUREMENT TI_AST "ti_ast" UWORD LINEAR______0_000000__0H___16799 2 2.0 0.0 16.0 BIT_MASK 0xffffffff ECU_ADDRESS 0x4110a /end MEASUREMENT
/begin MEASUREMENT TI_COP_1 "ti_cop_1" UWORD LINEAR______0_000000__0H___16799 2 2.0 0.0 16.0 BIT_MASK 0xffffffff ECU_ADDRESS 0x410ea /end MEASUREMENT
/begin MEASUREMENT TI_COP_2 "ti_cop_2" UWORD LINEAR______0_000000__0H___16799 2 2.0 0.0 16.0 BIT_MASK 0xffffffff ECU_ADDRESS 0x410ec /end MEASUREMENT
/begin MEASUREMENT TI_COP_STEP_2_ADD_1 "ti_cop_step_2_add_1" UWORD LINEAR______0_000000__0H___16799 2 2.0 0.0 16.0 BIT_MASK 0xffffffff ECU_ADDRESS 0x410e6 /end MEASUREMENT
/begin MEASUREMENT TI_COP_STEP_2_ADD_2 "ti_cop_step_2_add_2" UWORD LINEAR______0_000000__0H___16799 2 2.0 0.0 16.0 BIT_MASK 0xffffffff ECU_ADDRESS 0x410e8 /end MEASUREMENT
/begin MEASUREMENT TI_CYL_LAM_1_1 "ti_cyl_lamC0D" UWORD LINEAR_______50_000000__0H___440 2 2.0 -50.0 49.998471 BIT_MASK 0xffffffff FUNCTION_LIST CSCM ECU_ADDRESS 0x4071a /end MEASUREMENT
/begin MEASUREMENT TI_CYL_LAM_2_5 "ti_cyl_lamC1D" UWORD LINEAR_______50_000000__0H___440 2 2.0 -50.0 49.998471 BIT_MASK 0xffffffff FUNCTION_LIST CSCM ECU_ADDRESS 0x4071c /end MEASUREMENT
/begin MEASUREMENT TI_CYL_LAM_1_3 "ti_cyl_lamC2D" UWORD LINEAR_______50_000000__0H___440 2 2.0 -50.0 49.998471 BIT_MASK 0xffffffff FUNCTION_LIST CSCM ECU_ADDRESS 0x4071e /end MEASUREMENT
/begin MEASUREMENT TI_CYL_LAM_2_6 "ti_cyl_lamC3D" UWORD LINEAR_______50_000000__0H___440 2 2.0 -50.0 49.998471 BIT_MASK 0xffffffff FUNCTION_LIST CSCM ECU_ADDRESS 0x40720 /end MEASUREMENT
/begin MEASUREMENT TI_CYL_LAM_1_2 "ti_cyl_lamC4D" UWORD LINEAR_______50_000000__0H___440 2 2.0 -50.0 49.998471 BIT_MASK 0xffffffff FUNCTION_LIST CSCM ECU_ADDRESS 0x40722 /end MEASUREMENT
/begin MEASUREMENT TI_CYL_LAM_2_4 "ti_cyl_lamC5D" UWORD LINEAR_______50_000000__0H___440 2 2.0 -50.0 49.998471 BIT_MASK 0xffffffff FUNCTION_LIST CSCM ECU_ADDRESS 0x40724 /end MEASUREMENT
/begin MEASUREMENT TI_DIF_1 "ti_dif_1" SWORD LINEAR_______174_762666__FFFF846 2 2.0 -174.76267 174.75733 BIT_MASK 0xffffffff FUNCTION_LIST DPM ECU_ADDRESS 0x405b4 /end MEASUREMENT
/begin MEASUREMENT TI_DIF_2 "ti_dif_2" SWORD LINEAR_______174_762666__FFFF845 2 2.0 -174.76267 174.75733 BIT_MASK 0xffffffff FUNCTION_LIST DPM ECU_ADDRESS 0x405b6 /end MEASUREMENT
/begin MEASUREMENT TI_DIF_PVS_WF "ti_dif_pvs_wf" SWORD LINEAR_______174_762666__FFFF845 2 2.0 -174.76267 174.75733 BIT_MASK 0xffffffff ECU_ADDRESS 0x410f8 /end MEASUREMENT
/begin MEASUREMENT TI_DIF "ti_dif_sav" SWORD LINEAR_______174_762666__FFFF845 2 2.0 -174.76267 174.75733 BIT_MASK 0xffffffff ECU_ADDRESS 0x410f6 /end MEASUREMENT
/begin MEASUREMENT TI_DIF_WF "ti_dif_wf" SWORD LINEAR_______174_762666__FFFF845 2 2.0 -174.76267 174.75733 BIT_MASK 0xffffffff ECU_ADDRESS 0x41100 /end MEASUREMENT
/begin MEASUREMENT TI_FAC_REST "ti_fac_rest" UBYTE LINEAR______0_000000__0H___0_996 2 2.0 0.0 0.99609375 BIT_MASK 0xffffffff ECU_ADDRESS 0x4044e /end MEASUREMENT
/begin MEASUREMENT TI_FAC_TEMP_TOT "ti_fac_temp_tot" UWORD LINEAR______0_000000__0H___1_999 2 2.0 0.0 1.99997 BIT_MASK 0xffffffff ECU_ADDRESS 0xe36a /end MEASUREMENT
/begin MEASUREMENT TI_FAST_WF "ti_fast_wf" SWORD LINEAR_______174_762666__FFFF845 2 2.0 -174.76267 174.75733 BIT_MASK 0xffffffff ECU_ADDRESS 0x410fe /end MEASUREMENT
/begin MEASUREMENT TI_FL "ti_fl" SWORD LINEAR_______0_500000__FFFFF800H 2 2.0 -0.5 0.49961 BIT_MASK 0xffffffff ECU_ADDRESS 0x41110 /end MEASUREMENT
/begin MEASUREMENT TI_PVS_WF "ti_pvs_wf" SWORD LINEAR_______174_762666__FFFF845 2 2.0 -174.76267 174.75733 BIT_MASK 0xffffffff ECU_ADDRESS 0x410fa /end MEASUREMENT
/begin MEASUREMENT TI_SLOW_WF "ti_slow_wf" SWORD LINEAR_______174_762666__FFFF845 2 2.0 -174.76267 174.75733 BIT_MASK 0xffffffff ECU_ADDRESS 0x410fc /end MEASUREMENT
/begin MEASUREMENT TI_TOT "ti_tot" UWORD LINEAR______0_000000__0H___349_5 2 2.0 0.0 349.52 BIT_MASK 0xffffffff ECU_ADDRESS 0x41124 /end MEASUREMENT
/begin MEASUREMENT TI_WITHOUT_TRA_1 "ti_without_tra_1" SWORD LINEAR_______174_762666__FFFF845 2 2.0 -174.76267 174.75733 BIT_MASK 0xffffffff FUNCTION_LIST DPM ECU_ADDRESS 0x405b8 /end MEASUREMENT
/begin MEASUREMENT TI_WITHOUT_TRA_2 "ti_without_tra_2" SWORD LINEAR_______174_762666__FFFF845 2 2.0 -174.76267 174.75733 BIT_MASK 0xffffffff FUNCTION_LIST DPM ECU_ADDRESS 0x405ba /end MEASUREMENT
/begin MEASUREMENT TI_WUP "ti_wup" UWORD LINEAR______0_000000__0H___16799 2 2.0 0.0 16.0 BIT_MASK 0xffffffff ECU_ADDRESS 0x41112 /end MEASUREMENT
/begin MEASUREMENT TIA "tia" UBYTE LINEAR_______48_000000__0H___142 2 2.0 -48.0 142.5 BIT_MASK 0xffffffff ECU_ADDRESS 0x4041d /end MEASUREMENT
/begin MEASUREMENT TIA_ST_PREV "tia_st_prev" UBYTE LINEAR_______48_000000__0H___142 2 2.0 -48.0 142.5 BIT_MASK 0xffffffff FUNCTION_LIST ETM ECU_ADDRESS 0x4042a /end MEASUREMENT
/begin MEASUREMENT TIPR_CST "tipr" UWORD LINEAR______0_000000__0H___349_5 2 2.0 0.0 349.52 BIT_MASK 0xffffffff ECU_ADDRESS 0xe464 /end MEASUREMENT
/begin MEASUREMENT TMAG "tmag" UBYTE LINEAR_______48_000000__0H___155 2 2.0 -48.0 155.0 BIT_MASK 0xffffffff ECU_ADDRESS 0x40200 /end MEASUREMENT
/begin MEASUREMENT TOIL "toil" UBYTE LINEAR_______48_000000__0H___155 2 2.0 -48.0 155.0 BIT_MASK 0xffffffff ECU_ADDRESS 0x4041a /end MEASUREMENT
/begin MEASUREMENT TEMP_SP_TOIL_DIF "toil_dif" SWORD LINEAR_______203_000000__FFFFFF0 2 2.0 -203.0 203.0 BIT_MASK 0xffffffff FUNCTION_LIST ETM ECU_ADDRESS 0x40652 /end MEASUREMENT
/begin MEASUREMENT TOIL_MAX "toil_max" UBYTE LINEAR_______48_000000__0H___155 2 2.0 -48.0 155.0 BIT_MASK 0xffffffff ECU_ADDRESS 0x40430 /end MEASUREMENT
/begin MEASUREMENT TOIL_ST "toil_st" UBYTE LINEAR_______48_000000__0H___155 2 2.0 -48.0 155.0 BIT_MASK 0xffffffff ECU_ADDRESS 0x4041b /end MEASUREMENT
/begin MEASUREMENT TOIL_STOP "toil_stop" UBYTE LINEAR_______48_000000__0H___847 2 2.0 -48.0 155.0 BIT_MASK 0xffffffff ECU_ADDRESS 0x40427 /end MEASUREMENT
/begin MEASUREMENT TORS_ER "tors_er" SWORD LINEAR_______21845_000000__FFFF8 2 2.0 -21845.0 21844.333 BIT_MASK 0xffffffff ECU_ADDRESS 0xe226 /end MEASUREMENT
/begin MEASUREMENT TPS_AD_STATE "tps_ad_state" UWORD STATE_TPS_AD 2 2.0 0 65535 BIT_MASK 0xffffffff ECU_ADDRESS 0xe17a /end MEASUREMENT
/begin MEASUREMENT TPS_AD_STEP "tps_ad_step" UBYTE LINEAR______0_000000__0H___255_0 2 2.0 0.0 255.0 BIT_MASK 0xffffffff ECU_ADDRESS 0xfb50 /end MEASUREMENT
/begin MEASUREMENT TPS_AD_T_STEP "tps_ad_t_step" UBYTE LINEAR______0_000000__0H___1_153 2 2.0 0.0 1.275 BIT_MASK 0xffffffff ECU_ADDRESS 0xfb4d /end MEASUREMENT
/begin MEASUREMENT TPS_AV "tps_av" UWORD LINEAR______0_000000__0H___11975 2 2.0 0.0 119.5 BIT_MASK 0xffffffff ECU_ADDRESS 0xe14c /end MEASUREMENT
/begin MEASUREMENT TPS_AV_1 "tps_av_1" UWORD LINEAR______0_000000__0H___11975 2 2.0 0.0 119.5 BIT_MASK 0xffffffff ECU_ADDRESS 0xe156 /end MEASUREMENT
/begin MEASUREMENT TPS_AV_2 "tps_av_2" UWORD LINEAR______0_000000__0H___11975 2 2.0 0.0 119.5 BIT_MASK 0xffffffff ECU_ADDRESS 0xe158 /end MEASUREMENT
/begin MEASUREMENT TPS_AV_CTL "tps_av_ctl" SWORD LINEAR_______119_500000__FFFF848 2 2.0 -119.5 119.5 BIT_MASK 0xffffffff ECU_ADDRESS 0xe160 /end MEASUREMENT
/begin MEASUREMENT TPS_AV_LIH_DIF "tps_av_lih_dif" UWORD LINEAR______0_000000__0H___10126 2 2.0 0.0 100.0 BIT_MASK 0xffffffff ECU_ADDRESS 0xe0da /end MEASUREMENT
/begin MEASUREMENT TPS_AV_MON "tps_av_mon" UBYTE LINEAR______0_000000__0H___11942 2 2.0 0.0 119.53125 BIT_MASK 0xffffffff ECU_ADDRESS 0x40060 /end MEASUREMENT
/begin MEASUREMENT TPS_AV_PRJ "tps_av_prj" UWORD LINEAR______0_000000__0H___119_9 2 2.0 0.0 119.99817 BIT_MASK 0xffffffff ECU_ADDRESS 0xe15e /end MEASUREMENT
/begin MEASUREMENT TPS_DIF "tps_dif" UWORD LINEAR_______119_500000__0H___11 2 2.0 -119.5 119.5 BIT_MASK 0xffffffff ECU_ADDRESS 0xe0ca /end MEASUREMENT
/begin MEASUREMENT TPS_DIF_GRD "tps_dif_grd" UWORD LINEAR_______119_500000__0H__849 2 2.0 -119.5 119.5 BIT_MASK 0xffffffff ECU_ADDRESS 0xe0cc /end MEASUREMENT
/begin MEASUREMENT TPS_GRD "tps_grd" UBYTE LINEAR______0_000000__0H___2987_ 2 2.0 0.0 2987.5 BIT_MASK 0xffffffff ECU_ADDRESS 0xfb48 /end MEASUREMENT
/begin MEASUREMENT TPS_LIH "tps_lih" UWORD LINEAR______0_000000__0H___11975 2 2.0 0.0 119.5 BIT_MASK 0xffffffff ECU_ADDRESS 0xe150 /end MEASUREMENT
/begin MEASUREMENT TPS_LIH_1 "tps_lih_1" UWORD LINEAR______0_000000__0H___11975 2 2.0 0.0 119.5 BIT_MASK 0xffffffff ECU_ADDRESS 0xe152 /end MEASUREMENT
/begin MEASUREMENT TPS_LIH_2 "tps_lih_2" UWORD LINEAR______0_000000__0H___11975 2 2.0 0.0 119.5 BIT_MASK 0xffffffff ECU_ADDRESS 0xe154 /end MEASUREMENT
/begin MEASUREMENT TPS_LIH_DIF "tps_lih_dif" UWORD LINEAR_______119_500000__0H___11 2 2.0 -119.5 119.5 BIT_MASK 0xffffffff ECU_ADDRESS 0xe0d8 /end MEASUREMENT
/begin MEASUREMENT TPS_MAF_DIF_1 "tps_maf_dif_1" UWORD LINEAR______0_000000__0H___1398_ 2 2.0 0.0 1398.0 BIT_MASK 0xffffffff ECU_ADDRESS 0xe180 /end MEASUREMENT
/begin MEASUREMENT TPS_MAF_DIF_2 "tps_maf_dif_2" UWORD LINEAR______0_000000__0H___1398_ 2 2.0 0.0 1398.0 BIT_MASK 0xffffffff ECU_ADDRESS 0xe182 /end MEASUREMENT
/begin MEASUREMENT TPS_MAF_DIF_INT_1 "tps_maf_dif_int_1" UWORD LINEAR______0_000000__0H___1398_ 2 2.0 0.0 1398.0 BIT_MASK 0xffffffff ECU_ADDRESS 0xe188 /end MEASUREMENT
/begin MEASUREMENT TPS_MAF_DIF_INT_2 "tps_maf_dif_int_2" UWORD LINEAR______0_000000__0H___1398_ 2 2.0 0.0 1398.0 BIT_MASK 0xffffffff ECU_ADDRESS 0xe18a /end MEASUREMENT
/begin MEASUREMENT TPS_MAF_DIF_MMV_1 "tps_maf_dif_mmv_1" UWORD LINEAR______0_000000__0H___1398_ 2 2.0 0.0 1398.0 BIT_MASK 0xffffffff ECU_ADDRESS 0xe18c /end MEASUREMENT
/begin MEASUREMENT TPS_MAF_DIF_MMV_2 "tps_maf_dif_mmv_2" UWORD LINEAR______0_000000__0H___1398_ 2 2.0 0.0 1398.0 BIT_MASK 0xffffffff ECU_ADDRESS 0xe18e /end MEASUREMENT
/begin MEASUREMENT TPS_REQ "tps_req" UWORD LINEAR______0_000000__0H___11975 2 2.0 0.0 119.5 BIT_MASK 0xffffffff ECU_ADDRESS 0xe162 /end MEASUREMENT
/begin MEASUREMENT TPS_REQ_LTC "tps_req_ltc" UWORD LINEAR______0_000000__0H___11975 2 2.0 0.0 119.5 BIT_MASK 0xffffffff ECU_ADDRESS 0xe164 /end MEASUREMENT
/begin MEASUREMENT TPS_SP "tps_sp" UWORD LINEAR______0_000000__0H___11975 2 2.0 0.0 119.5 BIT_MASK 0xffffffff ECU_ADDRESS 0xe14e /end MEASUREMENT
/begin MEASUREMENT TPS_SP_AD "tps_sp_ad" UWORD LINEAR______0_000000__0H___11975 2 2.0 0.0 119.5 BIT_MASK 0xffffffff ECU_ADDRESS 0x4066e /end MEASUREMENT
/begin MEASUREMENT TPS_SP_CTL "tps_sp_ctl" SWORD LINEAR_______119_500000__FFFF848 2 2.0 -119.5 119.5 BIT_MASK 0xffffffff ECU_ADDRESS 0xe0e0 /end MEASUREMENT
/begin MEASUREMENT TPS_SP_LIH_DIF "tps_sp_lih_dif" UWORD LINEAR______0_000000__0H___10126 2 2.0 0.0 100.0 BIT_MASK 0xffffffff ECU_ADDRESS 0xe0dc /end MEASUREMENT
/begin MEASUREMENT TPS_SP_PVS "tps_sp_pvs" UWORD LINEAR______0_000000__0H___119_9 2 2.0 0.0 119.99817 BIT_MASK 0xffffffff ECU_ADDRESS 0x40674 /end MEASUREMENT
/begin MEASUREMENT TPS_SP_PVS_ADD_LOW_N "tps_sp_pvs_add_low_n" UWORD LINEAR______0_000000__0H___119_9 2 2.0 0.0 119.99817 BIT_MASK 0xffffffff FUNCTION_LIST Z10I ECU_ADDRESS 0xe194 /end MEASUREMENT
/begin MEASUREMENT TPS_SP_ST "tps_sp_st" UWORD LINEAR______0_000000__0H___11975 2 2.0 0.0 119.5 BIT_MASK 0xffffffff ECU_ADDRESS 0xe16c /end MEASUREMENT
/begin MEASUREMENT TPS_SUM_AV "tps_sum_av" UWORD LINEAR______0_000000__0H___119_9 2 2.0 0.0 119.99817 BIT_MASK 0xffffffff ECU_ADDRESS 0x40676 /end MEASUREMENT
/begin MEASUREMENT TPS_SUM_AV_MON "tps_sum_av_mon" UBYTE LINEAR______0_000000__0H___11913 2 2.0 0.0 119.5 BIT_MASK 0xffffffff ECU_ADDRESS 0x40061 /end MEASUREMENT
/begin MEASUREMENT TPS_SUM_SP "tps_sum_sp" UWORD LINEAR______0_000000__0H___119_9 2 2.0 0.0 119.99817 BIT_MASK 0xffffffff ECU_ADDRESS 0x40678 /end MEASUREMENT
/begin MEASUREMENT TQ_ACCIN_CAN "tq_accin_can" UBYTE LINEAR______0_000000__0H___31_00 2 2.0 0.0 31.0 BIT_MASK 0xffffffff ECU_ADDRESS 0x401dd /end MEASUREMENT
/begin MEASUREMENT TQ_CONV_CAN "tq_conv_can" UBYTE LINEAR______0_000000__0H___99_60 2 2.0 0.0 99.609375 BIT_MASK 0xffffffff ECU_ADDRESS 0x40117 /end MEASUREMENT
/begin MEASUREMENT TQ_LOSS "tq_loss" UWORD LINEAR______0_000000__0H___1022_ 2 2.0 0.0 1022.9688 BIT_MASK 0xffffffff ECU_ADDRESS 0xe0a8 /end MEASUREMENT
/begin MEASUREMENT TQ_LOSS_ACC "tq_loss_acc" UWORD LINEAR______0_000000__0H___1022_ 2 2.0 0.0 1022.9688 BIT_MASK 0xffffffff ECU_ADDRESS 0xe0aa /end MEASUREMENT
/begin MEASUREMENT TQ_LOSS_ECF "tq_loss_ecf" UWORD LINEAR______0_000000__0H___1022_ 2 2.0 0.0 1022.9688 BIT_MASK 0xffffffff ECU_ADDRESS 0xe0ae /end MEASUREMENT
/begin MEASUREMENT TQD_FAC "tqd_fac" UWORD LINEAR______0_000000__0H___6400_ 2 2.0 0.0 6400.0 BIT_MASK 0xffffffff ECU_ADDRESS 0xe07a /end MEASUREMENT
/begin MEASUREMENT TQFR "tqfr" UWORD LINEAR______0_000000__0H___1022_ 2 2.0 0.0 1022.9688 BIT_MASK 0xffffffff ECU_ADDRESS 0xe0a4 /end MEASUREMENT
/begin MEASUREMENT TQFR_ADD "tqfr_add" UWORD LINEAR______0_000000__0H___1022_ 2 2.0 0.0 1022.9688 BIT_MASK 0xffffffff ECU_ADDRESS 0xe0b0 /end MEASUREMENT
/begin MEASUREMENT TQFR_ST "tqfr_st" UWORD LINEAR______0_000000__0H___1022_ 2 2.0 0.0 1022.9688 BIT_MASK 0xffffffff ECU_ADDRESS 0xe0a6 /end MEASUREMENT
/begin MEASUREMENT TQI "tqi" UWORD LINEAR______0_000000__0H___1023_ 2 2.0 0.0 1023.0 BIT_MASK 0xffffffff ECU_ADDRESS 0xe032 /end MEASUREMENT
/begin MEASUREMENT TQI_AMT "tqi_amt" UWORD LINEAR______0_000000__0H___1023_ 2 2.0 0.0 1023.0 BIT_MASK 0xffffffff FUNCTION_LIST Z1S1 ECU_ADDRESS 0xe0ba /end MEASUREMENT
/begin MEASUREMENT TQI_AMT_CAN "tqi_amt_can" UBYTE LINEAR______0_000000__0H___99_60 2 2.0 0.0 99.609375 BIT_MASK 0xffffffff FUNCTION_LIST Z1S1 ECU_ADDRESS 0xfb5a /end MEASUREMENT
/begin MEASUREMENT TQI_AMT_MON "tqi_amt_mon" UBYTE LINEAR______0_000000__0H___510_0 2 2.0 0.0 510.0 BIT_MASK 0xffffffff FUNCTION_LIST Z1S1 ECU_ADDRESS 0x4002c /end MEASUREMENT
/begin MEASUREMENT TQI_AMT_MON2 "tqi_amt_mon2" UBYTE LINEAR______0_000000__0H___510_0 2 2.0 0.0 510.0 BIT_MASK 0xffffffff FUNCTION_LIST MON2 ECU_ADDRESS 0x40068 /end MEASUREMENT
/begin MEASUREMENT TQI_ASR "tqi_asr" UWORD LINEAR______0_000000__0H___1023_ 2 2.0 0.0 1023.0 BIT_MASK 0xffffffff ECU_ADDRESS 0xe05e /end MEASUREMENT
/begin MEASUREMENT TQI_ASR_CAN "tqi_asr_can" UBYTE LINEAR______0_000000__0H___100_0 2 2.0 0.0 100.0 BIT_MASK 0xffffffff ECU_ADDRESS 0x40114 /end MEASUREMENT
/begin MEASUREMENT TQI_AV_MON "tqi_av_mon" UBYTE LINEAR______0_000000__0H___510_0 2 2.0 0.0 510.0 BIT_MASK 0xffffffff ECU_ADDRESS 0x40013 /end MEASUREMENT
/begin MEASUREMENT TQI_AV_MON2 "tqi_av_mon2" UBYTE LINEAR______0_000000__0H___510_0 2 2.0 0.0 510.0 BIT_MASK 0xffffffff FUNCTION_LIST MON2 ECU_ADDRESS 0x40072 /end MEASUREMENT
/begin MEASUREMENT TQI_COR_AMT "tqi_cor_amt" UWORD LINEAR______0_000000__0H___1023_ 2 2.0 0.0 1023.0 BIT_MASK 0xffffffff FUNCTION_LIST Z1S1 ECU_ADDRESS 0xe0be /end MEASUREMENT
/begin MEASUREMENT TQI_COR_ASR "tqi_cor_asr" UWORD LINEAR______0_000000__0H___1023_ 2 2.0 0.0 1023.0 BIT_MASK 0xffffffff ECU_ADDRESS 0xe034 /end MEASUREMENT
/begin MEASUREMENT TQI_COR_GEAR "tqi_cor_gear" UWORD LINEAR______0_000000__0H___1023_ 2 2.0 0.0 1023.0 BIT_MASK 0xffffffff ECU_ADDRESS 0xe04a /end MEASUREMENT
/begin MEASUREMENT TQI_COR_MSR "tqi_cor_msr" UWORD LINEAR______0_000000__0H___1023_ 2 2.0 0.0 1023.0 BIT_MASK 0xffffffff ECU_ADDRESS 0xe064 /end MEASUREMENT
/begin MEASUREMENT TQI_CTL_DIF "tqi_ctl_dif" SWORD LINEAR_______1023_000000__FFFF80 2 2.0 -1023.0 1022.9688 BIT_MASK 0xffffffff ECU_ADDRESS 0xe084 /end MEASUREMENT
/begin MEASUREMENT TQI_CTL_DIF_I "tqi_ctl_dif_i" SWORD LINEAR_______1023_000000__FFFF80 2 2.0 -1023.0 1022.9688 BIT_MASK 0xffffffff ECU_ADDRESS 0xe082 /end MEASUREMENT
/begin MEASUREMENT TQI_CTL_DIF_LIM "tqi_ctl_dif_lim" SWORD LINEAR_______1023_000000__FFFF80 2 2.0 -1023.0 1022.9688 BIT_MASK 0xffffffff ECU_ADDRESS 0xe086 /end MEASUREMENT
/begin MEASUREMENT TQI_CTL_DIF_MMV "tqi_ctl_dif_mmv" SWORD LINEAR_______1023_000000__FFFF80 2 2.0 -1023.0 1022.9688 BIT_MASK 0xffffffff ECU_ADDRESS 0x40886 /end MEASUREMENT
/begin MEASUREMENT TQI_CTL_DIF_P "tqi_ctl_dif_p" SWORD LINEAR_______1023_000000__FFFF80 2 2.0 -1023.0 1022.9688 BIT_MASK 0xffffffff ECU_ADDRESS 0xe080 /end MEASUREMENT
/begin MEASUREMENT TQI_DIF "tqi_dif" SWORD LINEAR_______1023_000000__FFFF80 2 2.0 -1023.0 1022.9688 BIT_MASK 0xffffffff ECU_ADDRESS 0xe07e /end MEASUREMENT
/begin MEASUREMENT TQI_DIF_MAX_MON "tqi_dif_max_mon" UBYTE LINEAR______0_000000__0H___510_0 2 2.0 0.0 510.0 BIT_MASK 0xffffffff ECU_ADDRESS 0x40016 /end MEASUREMENT
/begin MEASUREMENT TQI_DIF_MAX_MON2 "tqi_dif_max_mon2" UBYTE LINEAR______0_000000__0H___510_0 2 2.0 0.0 510.0 BIT_MASK 0xffffffff FUNCTION_LIST MON2 ECU_ADDRESS 0x40074 /end MEASUREMENT
/begin MEASUREMENT TQI_DIF_MON "tqi_dif_mon" UBYTE LINEAR______0_000000__0H___510_0 2 2.0 0.0 510.0 BIT_MASK 0xffffffff ECU_ADDRESS 0x40015 /end MEASUREMENT
/begin MEASUREMENT TQI_DIF_MON2 "tqi_dif_mon2" UBYTE LINEAR______0_000000__0H___510_0 2 2.0 0.0 510.0 BIT_MASK 0xffffffff FUNCTION_LIST MON2 ECU_ADDRESS 0x40073 /end MEASUREMENT
/begin MEASUREMENT TQI_ETCU "tqi_etcu" UWORD LINEAR______0_000000__0H___1023_ 2 2.0 0.0 1023.0 BIT_MASK 0xffffffff ECU_ADDRESS 0xe060 /end MEASUREMENT
/begin MEASUREMENT TQI_ETCU_CAN "tqi_etcu_can" UBYTE LINEAR______0_000000__0H___100_0 2 2.0 0.0 100.0 BIT_MASK 0xffffffff ECU_ADDRESS 0x40112 /end MEASUREMENT
/begin MEASUREMENT TQI_GEAR "tqi_gear" UWORD LINEAR______0_000000__0H___1023_ 2 2.0 0.0 1023.0 BIT_MASK 0xffffffff ECU_ADDRESS 0xe048 /end MEASUREMENT
/begin MEASUREMENT TQI_LIM "tqi_lim" UWORD LINEAR______0_000000__0H___1023_ 2 2.0 0.0 1023.0 BIT_MASK 0xffffffff ECU_ADDRESS 0xe042 /end MEASUREMENT
/begin MEASUREMENT TQI_LIM_CTR "tqi_lim_ctr" UWORD LINEAR______0_000000__0H___65535 2 2.0 0.0 65535.0 BIT_MASK 0xffffffff ECU_ADDRESS 0xe094 /end MEASUREMENT
/begin MEASUREMENT TQI_LIM_DIF "tqi_lim_dif" SWORD LINEAR_______1023_000000__FFFF80 2 2.0 -1023.0 1022.9688 BIT_MASK 0xffffffff ECU_ADDRESS 0xe096 /end MEASUREMENT
/begin MEASUREMENT TQI_LIM_DIF_CTL "tqi_lim_dif_ctl" SWORD LINEAR_______1024_000000__FFFFFC 2 2.0 -1024.0 1023.0 BIT_MASK 0xffffffff ECU_ADDRESS 0xe09c /end MEASUREMENT
/begin MEASUREMENT TQI_LIM_DIF_CTL_ACT "tqi_lim_dif_ctl_act" UWORD LINEAR______0_000000__0H___10850 2 2.0 0.0 1023.0 BIT_MASK 0xffffffff ECU_ADDRESS 0xe09e /end MEASUREMENT
/begin MEASUREMENT TQI_LIM_DIF_CTL_ACT_MAX "tqi_lim_dif_ctl_act_max" UWORD LINEAR______0_000000__0H___10851 2 2.0 0.0 1023.0 BIT_MASK 0xffffffff ECU_ADDRESS 0xe0a2 /end MEASUREMENT
/begin MEASUREMENT TQI_LIM_DIF_CTL_ACT_REF "tqi_lim_dif_ctl_act_ref" SWORD LINEAR_______1024_000000__FFFFFC 2 2.0 -1024.0 1023.0 BIT_MASK 0xffffffff ECU_ADDRESS 0xe0a0 /end MEASUREMENT
/begin MEASUREMENT TQI_LIM_DIF_I "tqi_lim_dif_i" SWORD LINEAR_______1023_000000__FFFF80 2 2.0 -1023.0 1022.9688 BIT_MASK 0xffffffff ECU_ADDRESS 0xe09a /end MEASUREMENT
/begin MEASUREMENT TQI_LIM_DIF_P "tqi_lim_dif_p" SWORD LINEAR_______1023_000000__FFFF80 2 2.0 -1023.0 1022.9688 BIT_MASK 0xffffffff ECU_ADDRESS 0xe098 /end MEASUREMENT
/begin MEASUREMENT TQI_LIM_MAX "tqi_lim_max" UWORD LINEAR______0_000000__0H___1023_ 2 2.0 0.0 1023.0 BIT_MASK 0xffffffff ECU_ADDRESS 0xe046 /end MEASUREMENT
/begin MEASUREMENT TQI_LIM_MAX_1 "tqi_lim_max_1" UWORD LINEAR______0_000000__0H___1023_ 2 2.0 0.0 1023.0 BIT_MASK 0xffffffff ECU_ADDRESS 0xe08a /end MEASUREMENT
/begin MEASUREMENT TQI_MAF_AMT "tqi_maf_amt" UWORD LINEAR______0_000000__0H___1023_ 2 2.0 0.0 1023.0 BIT_MASK 0xffffffff FUNCTION_LIST Z1S1 ECU_ADDRESS 0xe0bc /end MEASUREMENT
/begin MEASUREMENT TQI_MAF_AMT_CAN "tqi_maf_amt_can" UBYTE LINEAR______0_000000__0H___99_60 2 2.0 0.0 99.609375 BIT_MASK 0xffffffff FUNCTION_LIST Z1S1 ECU_ADDRESS 0xfb5d /end MEASUREMENT
/begin MEASUREMENT TQI_MAF_ASR_CAN "tqi_maf_asr_can" UBYTE LINEAR______0_000000__0H___100_0 2 2.0 0.0 100.0 BIT_MASK 0xffffffff ECU_ADDRESS 0x40115 /end MEASUREMENT
/begin MEASUREMENT TQI_MAF_COR_AMT "tqi_maf_cor_amt" UWORD LINEAR______0_000000__0H___1023_ 2 2.0 0.0 1023.0 BIT_MASK 0xffffffff FUNCTION_LIST Z1S1 ECU_ADDRESS 0xe0c0 /end MEASUREMENT
/begin MEASUREMENT TQI_MAF_COR_ASR "tqi_maf_cor_asr" UWORD LINEAR______0_000000__0H___1023_ 2 2.0 0.0 1023.0 BIT_MASK 0xffffffff ECU_ADDRESS 0xe036 /end MEASUREMENT
/begin MEASUREMENT TQI_MAX_ISA_DIAG "tqi_max_isa_diag" SWORD LINEAR_______1023_000000__FFFF80 2 2.0 -1023.0 1022.9688 BIT_MASK 0xffffffff ECU_ADDRESS 0x4088a /end MEASUREMENT
/begin MEASUREMENT TQI_MAX_MON "tqi_max_mon" UBYTE LINEAR______0_000000__0H___510_0 2 2.0 0.0 510.0 BIT_MASK 0xffffffff FUNCTION_LIST Z1S1 ECU_ADDRESS 0x400b3 /end MEASUREMENT
/begin MEASUREMENT TQI_MIN_ISA_DIAG "tqi_min_isa_diag" SWORD LINEAR_______1023_000000__FFFF80 2 2.0 -1023.0 1022.9688 BIT_MASK 0xffffffff ECU_ADDRESS 0x40888 /end MEASUREMENT
/begin MEASUREMENT TQI_MSR "tqi_msr" UWORD LINEAR______0_000000__0H___1023_ 2 2.0 0.0 1023.0 BIT_MASK 0xffffffff ECU_ADDRESS 0xe062 /end MEASUREMENT
/begin MEASUREMENT TQI_MSR_CAN "tqi_msr_can" UBYTE LINEAR______0_000000__0H___100_0 2 2.0 0.0 100.0 BIT_MASK 0xffffffff ECU_ADDRESS 0x40116 /end MEASUREMENT
/begin MEASUREMENT TQI_MSR_MON "tqi_msr_mon" UBYTE LINEAR______0_000000__0H___51182 2 2.0 0.0 510.0 BIT_MASK 0xffffffff ECU_ADDRESS 0x4002a /end MEASUREMENT
/begin MEASUREMENT TQI_MSR_MON2 "tqi_msr_mon2" UBYTE LINEAR______0_000000__0H___510_0 2 2.0 0.0 510.0 BIT_MASK 0xffffffff FUNCTION_LIST MON2 ECU_ADDRESS 0x40067 /end MEASUREMENT
/begin MEASUREMENT TQI_PVS_COR "tqi_pvs_cor" UWORD LINEAR______0_000000__0H___1023_ 2 2.0 0.0 1023.0 BIT_MASK 0xffffffff ECU_ADDRESS 0xe068 /end MEASUREMENT
/begin MEASUREMENT TQI_PVS_REF "tqi_pvs_ref" UWORD LINEAR______0_000000__0H___1023_ 2 2.0 0.0 1023.0 BIT_MASK 0xffffffff ECU_ADDRESS 0xe06a /end MEASUREMENT
/begin MEASUREMENT TQI_REQ_TOT_MON "tqi_req_tot_mon" UBYTE LINEAR______0_000000__0H___510_0 2 2.0 0.0 510.0 BIT_MASK 0xffffffff ECU_ADDRESS 0x400b0 /end MEASUREMENT
/begin MEASUREMENT TQI_REQ_TOT_MON2 "tqi_req_tot_mon2" UBYTE LINEAR______0_000000__0H___510_0 2 2.0 0.0 510.0 BIT_MASK 0xffffffff FUNCTION_LIST MON2 ECU_ADDRESS 0x40071 /end MEASUREMENT
/begin MEASUREMENT TQI_SP_MON "tqi_sp_mon" UWORD LINEAR______0_000000__0H___51852 2 2.0 0.0 510.0 BIT_MASK 0xffffffff ECU_ADDRESS 0x4067c /end MEASUREMENT
/begin MEASUREMENT TQI_SP_MON2 "tqi_sp_mon2" UBYTE LINEAR______0_000000__0H___510_0 2 2.0 0.0 510.0 BIT_MASK 0xffffffff FUNCTION_LIST MON2 ECU_ADDRESS 0x404d6 /end MEASUREMENT
/begin MEASUREMENT TQI_TPS_AV "tqi_tps_av" UWORD LINEAR______0_000000__0H___1023_ 2 2.0 0.0 1023.0 BIT_MASK 0xffffffff ECU_ADDRESS 0xe06c /end MEASUREMENT
/begin MEASUREMENT TQI_TPS_AV_COR "tqi_tps_av_cor" UWORD LINEAR______0_000000__0H___1022_ 2 2.0 0.0 1022.9688 BIT_MASK 0xffffffff ECU_ADDRESS 0xe044 /end MEASUREMENT
/begin MEASUREMENT TQI_TPS_AV_MMV "tqi_tps_av_mmv" UWORD LINEAR______0_000000__0H___1023_ 2 2.0 0.0 1023.0 BIT_MASK 0xffffffff ECU_ADDRESS 0xe03a /end MEASUREMENT
/begin MEASUREMENT TQI_TPS_AV_MMV_COR "tqi_tps_av_mmv_cor" UWORD LINEAR______0_000000__0H___1023_ 2 2.0 0.0 1023.0 BIT_MASK 0xffffffff ECU_ADDRESS 0xe074 /end MEASUREMENT
/begin MEASUREMENT TQI_TPS_AV_REF "tqi_tps_av_ref" UWORD LINEAR______0_000000__0H___1023_ 2 2.0 0.0 1023.0 BIT_MASK 0xffffffff ECU_ADDRESS 0xe06e /end MEASUREMENT
/begin MEASUREMENT TQI_TPS_AV_REF_MMV "tqi_tps_av_ref_mmv" UWORD LINEAR______0_000000__0H___1023_ 2 2.0 0.0 1023.0 BIT_MASK 0xffffffff ECU_ADDRESS 0xe070 /end MEASUREMENT
/begin MEASUREMENT TQI_TPS_MAF "tqi_tps_maf" UWORD LINEAR______0_000000__0H___1023_ 2 2.0 0.0 1023.0 BIT_MASK 0xffffffff ECU_ADDRESS 0xe03c /end MEASUREMENT
/begin MEASUREMENT TQI_TPS_MAF_COR "tqi_tps_maf_cor" UWORD LINEAR______0_000000__0H___1023_ 2 2.0 0.0 1023.0 BIT_MASK 0xffffffff ECU_ADDRESS 0xe076 /end MEASUREMENT
/begin MEASUREMENT TQI_TPS_MAF_IGA_COR "tqi_tps_maf_iga_cor" UWORD LINEAR______0_000000__0H___1023_ 2 2.0 0.0 1023.0 BIT_MASK 0xffffffff ECU_ADDRESS 0xe078 /end MEASUREMENT
/begin MEASUREMENT TQI_TPS_SP "tqi_tps_sp" UWORD LINEAR______0_000000__0H___1023_ 2 2.0 0.0 1023.0 BIT_MASK 0xffffffff ECU_ADDRESS 0xe03e /end MEASUREMENT
/begin MEASUREMENT TQI_TQR "tqi_tqr" UWORD LINEAR______0_000000__0H___1023_ 2 2.0 0.0 1023.0 BIT_MASK 0xffffffff ECU_ADDRESS 0xe038 /end MEASUREMENT
/begin MEASUREMENT TRT "trt" UWORD LINEAR______0_000000__0H___65183 2 2.0 0.0 6553.5 BIT_MASK 0xffffffff ECU_ADDRESS 0x407ee /end MEASUREMENT
/begin MEASUREMENT TST_REC_IDX_MON2 "tst_rec_idx_mon2" UBYTE LINEAR______0_000000__0H___9_000 2 2.0 0.0 9.0 BIT_MASK 0xffffffff ECU_ADDRESS 0xe00d /end MEASUREMENT
/begin MEASUREMENT V_AMP "v_amp" UWORD LINEAR______0_000000__0H___4_995 2 2.0 0.0 4.9951172 BIT_MASK 0xffffffff ECU_ADDRESS 0x404a8 /end MEASUREMENT
/begin MEASUREMENT V_CUR_IGC_1 "v_curr_igcC0D" UBYTE LINEAR______0_000000__0H___131_0 2 2.0 0.0 131.0 BIT_MASK 0xffffffff ECU_ADDRESS 0xfbb1 /end MEASUREMENT
/begin MEASUREMENT V_CUR_IGC_5 "v_curr_igcC1D" UBYTE LINEAR______0_000000__0H___131_0 2 2.0 0.0 131.0 BIT_MASK 0xffffffff ECU_ADDRESS 0xfbb2 /end MEASUREMENT
/begin MEASUREMENT V_CUR_IGC_3 "v_curr_igcC2D" UBYTE LINEAR______0_000000__0H___131_0 2 2.0 0.0 131.0 BIT_MASK 0xffffffff ECU_ADDRESS 0xfbb3 /end MEASUREMENT
/begin MEASUREMENT V_CUR_IGC_6 "v_curr_igcC3D" UBYTE LINEAR______0_000000__0H___131_0 2 2.0 0.0 131.0 BIT_MASK 0xffffffff ECU_ADDRESS 0xfbb4 /end MEASUREMENT
/begin MEASUREMENT V_CUR_IGC_2 "v_curr_igcC4D" UBYTE LINEAR______0_000000__0H___131_0 2 2.0 0.0 131.0 BIT_MASK 0xffffffff ECU_ADDRESS 0xfbb5 /end MEASUREMENT
/begin MEASUREMENT V_CUR_IGC_4 "v_curr_igcC5D" UBYTE LINEAR______0_000000__0H___131_0 2 2.0 0.0 131.0 BIT_MASK 0xffffffff ECU_ADDRESS 0xfbb6 /end MEASUREMENT
/begin MEASUREMENT V_DMTL "v_dmtl" UWORD LINEAR______0_000000__0H___5_184 2 2.0 0.0 5.0 BIT_MASK 0xffffffff FUNCTION_LIST DMTL ECU_ADDRESS 0x41a4a /end MEASUREMENT
/begin MEASUREMENT T_IGCFB_1 "v_dur_igcC0D" UWORD LINEAR______0_000000__0H___174_7 2 2.0 0.0 174.75733 BIT_MASK 0xffffffff ECU_ADDRESS 0xe4b6 /end MEASUREMENT
/begin MEASUREMENT T_IGCFB_5 "v_dur_igcC1D" UWORD LINEAR______0_000000__0H___174_7 2 2.0 0.0 174.75733 BIT_MASK 0xffffffff ECU_ADDRESS 0xe4b8 /end MEASUREMENT
/begin MEASUREMENT T_IGCFB_3 "v_dur_igcC2D" UWORD LINEAR______0_000000__0H___174_7 2 2.0 0.0 174.75733 BIT_MASK 0xffffffff ECU_ADDRESS 0xe4ba /end MEASUREMENT
/begin MEASUREMENT T_IGCFB_6 "v_dur_igcC3D" UWORD LINEAR______0_000000__0H___174_7 2 2.0 0.0 174.75733 BIT_MASK 0xffffffff ECU_ADDRESS 0xe4bc /end MEASUREMENT
/begin MEASUREMENT T_IGCFB_2 "v_dur_igcC4D" UWORD LINEAR______0_000000__0H___174_7 2 2.0 0.0 174.75733 BIT_MASK 0xffffffff ECU_ADDRESS 0xe4be /end MEASUREMENT
/begin MEASUREMENT T_IGCFB_4 "v_dur_igcC5D" UWORD LINEAR______0_000000__0H___174_7 2 2.0 0.0 174.75733 BIT_MASK 0xffffffff ECU_ADDRESS 0xe4c0 /end MEASUREMENT
/begin MEASUREMENT V_IGK "v_igk" UBYTE LINEAR______0_000000__0H___26_00 2 2.0 0.0 26.0 BIT_MASK 0xffffffff ECU_ADDRESS 0xfbd6 /end MEASUREMENT
/begin MEASUREMENT V_PVS_1 "v_pvs_1" UWORD LINEAR______0_000000__0H___4_995 2 2.0 0.0 4.9951172 BIT_MASK 0xffffffff ECU_ADDRESS 0xe0fa /end MEASUREMENT
/begin MEASUREMENT V_PVS_2 "v_pvs_2" UWORD LINEAR______0_000000__0H___4_995 2 2.0 0.0 4.9951172 BIT_MASK 0xffffffff ECU_ADDRESS 0xe0fc /end MEASUREMENT
/begin MEASUREMENT V_PVS_FIL_1 "v_pvs_fil_1" UWORD LINEAR______0_000000__0H___4_995 2 2.0 0.0 4.9951172 BIT_MASK 0xffffffff ECU_ADDRESS 0xe106 /end MEASUREMENT
/begin MEASUREMENT V_PVS_FIL_2 "v_pvs_fil_2" UWORD LINEAR______0_000000__0H___4_995 2 2.0 0.0 4.9951172 BIT_MASK 0xffffffff ECU_ADDRESS 0xe108 /end MEASUREMENT
/begin MEASUREMENT V_REF_1 "v_ref_1" UBYTE LINEAR______0_000000__0H___10187 2 2.0 0.0 10.0 BIT_MASK 0xffffffff ECU_ADDRESS 0x4008a /end MEASUREMENT
/begin MEASUREMENT V_REF_2 "v_ref_2" UBYTE LINEAR______0_000000__0H___10187 2 2.0 0.0 10.0 BIT_MASK 0xffffffff ECU_ADDRESS 0x4008b /end MEASUREMENT
/begin MEASUREMENT V_TEG_DOWN_MES_2 "v_teg_down_mes_2" UWORD LINEAR______0_000000__0H___4_995 2 2.0 0.0 4.9951172 BIT_MASK 0xffffffff ECU_ADDRESS 0x4059e /end MEASUREMENT
/begin MEASUREMENT V_TEG_UP_MES_1 "v_teg_up_mes_1" UWORD LINEAR______0_000000__0H___4_995 2 2.0 0.0 4.9951172 BIT_MASK 0xffffffff ECU_ADDRESS 0x4059a /end MEASUREMENT
/begin MEASUREMENT V_TEG_UP_MES_2 "v_teg_up_mes_2" UWORD LINEAR______0_000000__0H___4_995 2 2.0 0.0 4.9951172 BIT_MASK 0xffffffff ECU_ADDRESS 0x4059c /end MEASUREMENT
/begin MEASUREMENT V_TPS_1 "v_tps_1" UWORD LINEAR______0_000000__0H___4_995 2 2.0 0.0 4.9951172 BIT_MASK 0xffffffff ECU_ADDRESS 0xe15a /end MEASUREMENT
/begin MEASUREMENT V_TPS_1_MON "v_tps_1_mon" UBYTE LINEAR______0_000000__0H___4_980 2 2.0 0.0 4.9804688 BIT_MASK 0xffffffff ECU_ADDRESS 0x40057 /end MEASUREMENT
/begin MEASUREMENT V_TPS_2 "v_tps_2" UWORD LINEAR______0_000000__0H___4_995 2 2.0 0.0 4.9951172 BIT_MASK 0xffffffff ECU_ADDRESS 0xe15c /end MEASUREMENT
/begin MEASUREMENT V_TPS_2_MON "v_tps_2_mon" UBYTE LINEAR______0_000000__0H___4_980 2 2.0 0.0 4.9804688 BIT_MASK 0xffffffff ECU_ADDRESS 0x40058 /end MEASUREMENT
/begin MEASUREMENT V_TPS_AD_BOL_1 "v_tps_ad_bol_1" UWORD LINEAR______0_000000__0H___4_995 2 2.0 0.0 4.9951172 BIT_MASK 0xffffffff ECU_ADDRESS 0xe176 /end MEASUREMENT
/begin MEASUREMENT V_TPS_AD_BOL_2 "v_tps_ad_bol_2" UWORD LINEAR______0_000000__0H___4_995 2 2.0 0.0 4.9951172 BIT_MASK 0xffffffff ECU_ADDRESS 0xe178 /end MEASUREMENT
/begin MEASUREMENT V_TPS_AD_EL_BOL_1 "v_tps_ad_el_bol_1" UWORD LINEAR______0_000000__0H___4_995 2 2.0 0.0 4.9951172 BIT_MASK 0xffffffff ECU_ADDRESS 0x40670 /end MEASUREMENT
/begin MEASUREMENT V_TPS_AD_EL_BOL_2 "v_tps_ad_el_bol_2" UWORD LINEAR______0_000000__0H___4_995 2 2.0 0.0 4.9951172 BIT_MASK 0xffffffff ECU_ADDRESS 0x40672 /end MEASUREMENT
/begin MEASUREMENT V_TPS_AD_LIH_1 "v_tps_ad_lih_1" UWORD LINEAR______0_000000__0H___4_995 2 2.0 0.0 4.9951172 BIT_MASK 0xffffffff ECU_ADDRESS 0xe172 /end MEASUREMENT
/begin MEASUREMENT V_TPS_AD_LIH_2 "v_tps_ad_lih_2" UWORD LINEAR______0_000000__0H___4_995 2 2.0 0.0 4.9951172 BIT_MASK 0xffffffff ECU_ADDRESS 0xe174 /end MEASUREMENT
/begin MEASUREMENT VB "vb" UBYTE LINEAR______0_000000__0H___26_00 2 2.0 0.0 26.0 BIT_MASK 0xffffffff ECU_ADDRESS 0xfbd5 /end MEASUREMENT
/begin MEASUREMENT VB_DMTL_FIL "vb_dmtl_filvwordC1D" UWORD LINEAR______0_000000__0H___26_30 2 2.0 0.0 26.0 BIT_MASK 0xffffffff FUNCTION_LIST DMTL ECU_ADDRESS 0x41a60 /end MEASUREMENT
/begin MEASUREMENT VB_DMTL_REF "vb_dmtl_ref" UWORD LINEAR______0_000000__0H___26_30 2 2.0 0.0 26.0 BIT_MASK 0xffffffff FUNCTION_LIST DMTL ECU_ADDRESS 0x41a4c /end MEASUREMENT
/begin MEASUREMENT VB_MMV "vb_mmv" UWORD LINEAR______0_000000__0H___26_30 2 2.0 0.0 26.0 BIT_MASK 0xffffffff ECU_ADDRESS 0x408be /end MEASUREMENT
/begin MEASUREMENT LV_FL "vl" UWORD RANGE________FL___1H__1H________ 2 2.0 0 65535 BIT_MASK 0x400 ECU_ADDRESS 0xfd94 /end MEASUREMENT
/begin MEASUREMENT VLS_1_1 "vlsC0D" UBYTE LINEAR______0_000000__0H___1_275 2 2.0 0.0 1.275 BIT_MASK 0xffffffff FUNCTION_LIST CSCM ECU_ADDRESS 0x40138 /end MEASUREMENT
/begin MEASUREMENT VLS_2_5 "vlsC1D" UBYTE LINEAR______0_000000__0H___1_275 2 2.0 0.0 1.275 BIT_MASK 0xffffffff FUNCTION_LIST CSCM ECU_ADDRESS 0x40139 /end MEASUREMENT
/begin MEASUREMENT VLS_1_3 "vlsC2D" UBYTE LINEAR______0_000000__0H___1_275 2 2.0 0.0 1.275 BIT_MASK 0xffffffff FUNCTION_LIST CSCM ECU_ADDRESS 0x4013a /end MEASUREMENT
/begin MEASUREMENT VLS_2_6 "vlsC3D" UBYTE LINEAR______0_000000__0H___1_275 2 2.0 0.0 1.275 BIT_MASK 0xffffffff FUNCTION_LIST CSCM ECU_ADDRESS 0x4013b /end MEASUREMENT
/begin MEASUREMENT VLS_1_2 "vlsC4D" UBYTE LINEAR______0_000000__0H___1_275 2 2.0 0.0 1.275 BIT_MASK 0xffffffff FUNCTION_LIST CSCM ECU_ADDRESS 0x4013c /end MEASUREMENT
/begin MEASUREMENT VLS_2_4 "vlsC5D" UBYTE LINEAR______0_000000__0H___1_275 2 2.0 0.0 1.275 BIT_MASK 0xffffffff FUNCTION_LIST CSCM ECU_ADDRESS 0x4013d /end MEASUREMENT
/begin MEASUREMENT VLS_CYC_RATIO_MV_1 "vls_cyc_ratio_mv_1" UWORD LINEAR______0_000000__0H___255_9 2 2.0 0.0 255.9961 BIT_MASK 0xffffffff FUNCTION_LIST CSCM ECU_ADDRESS 0xe1d4 /end MEASUREMENT
/begin MEASUREMENT VLS_CYC_RATIO_MV_2 "vls_cyc_ratio_mv_2" UWORD LINEAR______0_000000__0H___255_9 2 2.0 0.0 255.9961 BIT_MASK 0xffffffff FUNCTION_LIST CSCM ECU_ADDRESS 0xe1d6 /end MEASUREMENT
/begin MEASUREMENT VLS_DIF_VAL_1_1 "vls_dif_val_1_1" SWORD LINEAR_______0_637500__FFFF8000H 2 2.0 -0.6375 0.6375 BIT_MASK 0xffffffff FUNCTION_LIST CSCM ECU_ADDRESS 0xe1c8 /end MEASUREMENT
/begin MEASUREMENT VLS_DIF_VAL_1_2 "vls_dif_val_1_2" SWORD LINEAR_______0_637500__FFFF80853 2 2.0 -0.6375 0.6375 BIT_MASK 0xffffffff FUNCTION_LIST CSCM ECU_ADDRESS 0xe1ca /end MEASUREMENT
/begin MEASUREMENT VLS_DIF_VAL_1_3 "vls_dif_val_1_3" SWORD LINEAR_______0_637500__FFFF8000H 2 2.0 -0.6375 0.6375 BIT_MASK 0xffffffff FUNCTION_LIST CSCM ECU_ADDRESS 0xe1cc /end MEASUREMENT
/begin MEASUREMENT VLS_DIF_VAL_2_4 "vls_dif_val_2_4" SWORD LINEAR_______0_637500__FFFF8000H 2 2.0 -0.6375 0.6375 BIT_MASK 0xffffffff FUNCTION_LIST CSCM ECU_ADDRESS 0xe1ce /end MEASUREMENT
/begin MEASUREMENT VLS_DIF_VAL_2_5 "vls_dif_val_2_5" SWORD LINEAR_______0_637500__FFFF8000H 2 2.0 -0.6375 0.6375 BIT_MASK 0xffffffff FUNCTION_LIST CSCM ECU_ADDRESS 0xe1d0 /end MEASUREMENT
/begin MEASUREMENT VLS_DIF_VAL_2_6 "vls_dif_val_2_6" SWORD LINEAR_______0_637500__FFFF8000H 2 2.0 -0.6375 0.6375 BIT_MASK 0xffffffff FUNCTION_LIST CSCM ECU_ADDRESS 0xe1d2 /end MEASUREMENT
/begin MEASUREMENT VLS_MIX_DIAG_EOL "vls_mix_diag_eol" UBYTE STATE_VLS_MIX 2 2.0 0 255 BIT_MASK 0xffffffff ECU_ADDRESS 0x403cb /end MEASUREMENT
/begin MEASUREMENT VLS_UP_1_6 "vls_up_1_6" UBYTE LINEAR______0_000000__0H___1_275 2 2.0 0.0 1.275 BIT_MASK 0xffffffff ECU_ADDRESS 0x4014a /end MEASUREMENT
/begin MEASUREMENT VLS_FRQ_DIAG_END_1 "vls_up_freq_diag_end_1" UWORD RANGE________YES___1H__1H____744 2 2.0 0 65535 BIT_MASK 0x400 ECU_ADDRESS 0x40c5a /end MEASUREMENT
/begin MEASUREMENT VLS_FRQ_DIAG_END_2 "vls_up_freq_diag_end_2" UWORD RANGE________YES___1H__1H____744 2 2.0 0 65535 BIT_MASK 0x400 ECU_ADDRESS 0x40db8 /end MEASUREMENT
/begin MEASUREMENT VLS_JUMP_DIAG_END_1 "vls_up_sprung_diag_end_1" UWORD RANGE________YES___1H__1H____744 2 2.0 0 65535 BIT_MASK 0x200 ECU_ADDRESS 0x40c5a /end MEASUREMENT
/begin MEASUREMENT VLS_JUMP_DIAG_END_2 "vls_up_sprung_diag_end_2" UWORD RANGE________YES___1H__1H____744 2 2.0 0 65535 BIT_MASK 0x200 ECU_ADDRESS 0x40db8 /end MEASUREMENT
/begin MEASUREMENT VO "vo" UWORD LINEAR______0_000000__0H___150_7 2 2.0 0.0 150.70979 BIT_MASK 0xffffffff ECU_ADDRESS 0x40bce /end MEASUREMENT
/begin MEASUREMENT VO_SP "vo_sp" UWORD LINEAR______0_000000__0H___150_7 2 2.0 0.0 150.70979 BIT_MASK 0xffffffff ECU_ADDRESS 0x40bd4 /end MEASUREMENT
/begin MEASUREMENT VS "vs" UBYTE LINEAR______0_000000__0H___25511 2 2.0 0.0 255.0 BIT_MASK 0xffffffff ECU_ADDRESS 0x4045e /end MEASUREMENT
/begin MEASUREMENT VS_DIF_CRU "vs_dif_cru" SWORD LINEAR_______256_000000__FFFF191 2 2.0 -256.0 255.99218 BIT_MASK 0xffffffff ECU_ADDRESS 0x40692 /end MEASUREMENT
/begin MEASUREMENT VS_DIF_I_CRU "vs_dif_i_cru" SWORD LINEAR_______4096_000000__FFFF80 2 2.0 -4096.0 4095.875 BIT_MASK 0xffffffff ECU_ADDRESS 0x40694 /end MEASUREMENT
/begin MEASUREMENT VS_FIL "vs_fil" UWORD LINEAR______0_000000__0H___51151 2 2.0 0.0 511.99218 BIT_MASK 0xffffffff ECU_ADDRESS 0xe36c /end MEASUREMENT
/begin MEASUREMENT VS_MES "vs_pulse_cnt" UWORD LINEAR______0_000000__0H___65854 2 2.0 0.0 65535.0 BIT_MASK 0xffffffff ECU_ADDRESS 0x41136 /end MEASUREMENT
/begin MEASUREMENT VS_SP_CRU "vs_sp_cru" UWORD LINEAR______0_000000__0H___51151 2 2.0 0.0 511.99218 BIT_MASK 0xffffffff ECU_ADDRESS 0x410d0 /end MEASUREMENT
/begin MEASUREMENT VS_SP_CRU_MAX "vs_sp_cru_max" UWORD LINEAR______0_000000__0H___51151 2 2.0 0.0 511.99218 BIT_MASK 0xffffffff ECU_ADDRESS 0x406a2 /end MEASUREMENT
/begin MEASUREMENT VS_SP_DIF_CRU "vs_sp_dif_cru" SWORD LINEAR_______256_000000__FFFF191 2 2.0 -256.0 255.99218 BIT_MASK 0xffffffff ECU_ADDRESS 0x40698 /end MEASUREMENT
/begin MEASUREMENT VS_SP_DRIV_CRU "vs_sp_driv_cru" UWORD LINEAR______0_000000__0H___51151 2 2.0 0.0 511.99218 BIT_MASK 0xffffffff ECU_ADDRESS 0x40696 /end MEASUREMENT
/begin MEASUREMENT LV_REAC "we" UWORD RANGE________REAC___1H__1H______ 2 2.0 0 65535 BIT_MASK 0x1000 ECU_ADDRESS 0xfd94 /end MEASUREMENT
/begin MEASUREMENT WHEEL "wheel" UWORD LINEAR______0_000000__0H___51151 2 2.0 0.0 511.99218 BIT_MASK 0xffffffff ECU_ADDRESS 0x406c4 /end MEASUREMENT
/begin MEASUREMENT WHEEL_GRD_MMV "wheel_grd_mmv" UWORD LINEAR______0_000000__0H___25578 2 2.0 0.0 255.0 BIT_MASK 0xffffffff ECU_ADDRESS 0x410b0 /end MEASUREMENT
/begin MEASUREMENT LV_WUP "wl" UWORD RANGE________WUP___1H__1H_______ 2 2.0 0 65535 BIT_MASK 0x10 ECU_ADDRESS 0xfd94 /end MEASUREMENT
/begin MEASUREMENT CUR_DMTL_COR_FIL_REFU_FIL "cur_dmtl_cor_fil_refu_filvwordC1" UWORD LINEAR______0_000000__0H___400_0 2 2.0 0.0 400.0 BIT_MASK 0xffffffff FUNCTION_LIST DMTL ECU_ADDRESS 0x41a58 /end MEASUREMENT
/begin MEASUREMENT CTR_CAT_EFF_DIAG_1 "sum_obd_diag_ramvctr_cat_eff_dia" UBYTE LINEAR______0_000000__0H___25788 2 2.0 0.0 255.0 BIT_MASK 0xffffffff ECU_ADDRESS 0x41058 /end MEASUREMENT
/begin MEASUREMENT CTR_CAT_EFF_DIAG_2 "sum_obd_diag_ramvctr_cat_eff_di1" UWORD LINEAR______0_000000__0H___25855 2 2.0 0.0 255.0 BIT_MASK 0xffffffff ECU_ADDRESS 0x41059 /end MEASUREMENT
/begin COMPU_METHOD LINEAR______0_000000__0H___255_0 "" FORM "%3.0" "-" FORMULA "1.0*X" FORMULA_INV "1.0*X" /end COMPU_METHOD
/begin COMPU_METHOD LINEAR______0_000000__0H___9_000 "" FORM "%2.0" "-" FORMULA "1.0*X" FORMULA_INV "1.0*X" /end COMPU_METHOD
/begin COMPU_METHOD LINEAR______0_000000__0H___8160_ "" FORM "%4.0" "rpm" FORMULA "32.0*X" FORMULA_INV "0.03125*X" /end COMPU_METHOD
/begin COMPU_METHOD LINEAR______0_000000__0H___65535 "" FORM "%5.0" "-" FORMULA "1.0*X" FORMULA_INV "1.0*X" /end COMPU_METHOD
/begin COMPU_METHOD LINEAR______0_000000__0H___0_996 "" FORM "%5.3" "-" FORMULA "0.00390625*X" FORMULA_INV "256.0*X" /end COMPU_METHOD
/begin COMPU_METHOD LINEAR_______48_000000__0H___155 "" FORM "%5.1" "°C" FORMULA "0.79607843*X-48.0" FORMULA_INV "1.2561576*X+60.295567" /end COMPU_METHOD
/begin COMPU_METHOD LINEAR______0_000000__0H___81605 "" FORM "%4.0" "rpm" FORMULA "0.25*X" FORMULA_INV "4.0*X" /end COMPU_METHOD
/begin COMPU_METHOD LINEAR______0_000000__0H___26_00 "" FORM "%4.1" "V" FORMULA "0.10196078*X" FORMULA_INV "9.8076923*X" /end COMPU_METHOD
/begin COMPU_METHOD LINEAR______0_000000__0H___99_60 "" FORM "%4.1" "%" FORMULA "0.390625*X" FORMULA_INV "2.56*X" /end COMPU_METHOD
/begin COMPU_METHOD LINEAR_______48_000000__0H___142 "" FORM "%5.1" "°C" FORMULA "0.75*X-48.0" FORMULA_INV "1.3333333*X+64.0" /end COMPU_METHOD
/begin COMPU_METHOD LINEAR______0_000000__0H___1_992 "" FORM "%5.3" "-" FORMULA "0.0078125*X" FORMULA_INV "128.0*X" /end COMPU_METHOD
/begin COMPU_METHOD LINEAR______0_000000__0H___81608 "" FORM "%4.0" "rpm/(km/h)" FORMULA "1.0*X" FORMULA_INV "1.0*X" /end COMPU_METHOD
/begin COMPU_METHOD LINEAR_______48_000000__0H___47_ "" FORM "%6.2" "°CRK" FORMULA "0.375*X-48.0" FORMULA_INV "2.6666667*X+128.0" /end COMPU_METHOD
/begin COMPU_METHOD LINEAR_______23_625000__0H___72_ "" FORM "%5.1" "°CRK" FORMULA "0.375*X-23.625" FORMULA_INV "2.6666667*X+63.0" /end COMPU_METHOD
/begin COMPU_METHOD LINEAR______0_000000__0H___399_9 "" FORM "%7.3" "%" FORMULA "0.0061035142*X" FORMULA_INV "163.84004*X" /end COMPU_METHOD
/begin COMPU_METHOD LINEAR______0_000000__0H___1389_ "" FORM "%4.0" "mg/stk" FORMULA "5.4470588*X" FORMULA_INV "0.18358531*X" /end COMPU_METHOD
/begin COMPU_METHOD LINEAR______0_000000__0H___2_000 "" FORM "%2.0" "-" FORMULA "1.0*X" FORMULA_INV "1.0*X" /end COMPU_METHOD
/begin COMPU_METHOD LINEAR_______33_000000__0H___991 "" FORM "%6.2" "°C" FORMULA "0.015625238*X-33.0" FORMULA_INV "63.999023*X+2111.9678" /end COMPU_METHOD
/begin COMPU_METHOD LINEAR______0_000000__0H___15_94 "" FORM "%5.2" "-" FORMULA "0.062509802*X" FORMULA_INV "15.997491*X" /end COMPU_METHOD
/begin COMPU_METHOD LINEAR______0_000000__0H___25511 "" FORM "%3.0" "km/h" FORMULA "1.0*X" FORMULA_INV "1.0*X" /end COMPU_METHOD
/begin COMPU_METHOD LINEAR______0_000000__0H___81612 "" FORM "%4.0" "rpm" FORMULA "1.0*X" FORMULA_INV "1.0*X" /end COMPU_METHOD
/begin COMPU_METHOD LINEAR______0_000000__0H___11913 "" FORM "%5.1" "°TPS" FORMULA "0.46862745*X" FORMULA_INV "2.1338912*X" /end COMPU_METHOD
/begin COMPU_METHOD LINEAR______0_000000__0H___6553_ "" FORM "%6.1" "s" FORMULA "0.1*X" FORMULA_INV "10.0*X" /end COMPU_METHOD
/begin COMPU_METHOD LINEAR______0_000000__0H___349_5 "" FORM "%7.3" "ms" FORMULA "0.0053333333*X" FORMULA_INV "187.5*X" /end COMPU_METHOD
/begin COMPU_METHOD LINEAR______0_000000__0H___25514 "" FORM "%3.0" "s" FORMULA "1.0*X" FORMULA_INV "1.0*X" /end COMPU_METHOD
/begin COMPU_METHOD LINEAR______0_000000__0H___10_20 "" FORM "%5.2" "s" FORMULA "0.04*X" FORMULA_INV "25.0*X" /end COMPU_METHOD
/begin COMPU_METHOD LINEAR______0_000000__0H___3_984 "" FORM "%4.2" "-" FORMULA "0.015625*X" FORMULA_INV "64.0*X" /end COMPU_METHOD
/begin COMPU_METHOD LINEAR______0_000000__0H___510_0 "" FORM "%3.0" "Nm" FORMULA "2.0*X" FORMULA_INV "0.5*X" /end COMPU_METHOD
/begin COMPU_METHOD LINEAR______0_000000__0H___13818 "" FORM "%5.1" "mg/stk" FORMULA "0.021194781*X" FORMULA_INV "47.181425*X" /end COMPU_METHOD
/begin COMPU_METHOD LINEAR______0_000000__0H___16383 "" FORM "%8.2" "kg/h" FORMULA "0.25*X" FORMULA_INV "4.0*X" /end COMPU_METHOD
/begin COMPU_METHOD LINEAR______0_000000__0H___1000_ "" FORM "%7.2" "rpm" FORMULA "0.25*X" FORMULA_INV "4.0*X" /end COMPU_METHOD
/begin COMPU_METHOD LINEAR______0_000000__0H___31_00 "" FORM "%3.0" "Nm" FORMULA "1.0*X" FORMULA_INV "1.0*X" /end COMPU_METHOD
/begin COMPU_METHOD LINEAR______0_000000__0H___5434_ "" FORM "%7.2" "hPa" FORMULA "0.082921489*X" FORMULA_INV "12.0596*X" /end COMPU_METHOD
/begin COMPU_METHOD LINEAR______0_000000__0H___4_995 "" FORM "%5.3" "V" FORMULA "0.0048828125*X" FORMULA_INV "204.8*X" /end COMPU_METHOD
/begin COMPU_METHOD LINEAR______0_000000__0H___0_999 "" FORM "%7.5" "-" FORMULA "1.5258789e-005*X" FORMULA_INV "65536.0*X" /end COMPU_METHOD
/begin COMPU_METHOD LINEAR_______33_000000__0H___989 "" FORM "%6.2" "°C" FORMULA "0.015609741*X-33.0" FORMULA_INV "64.06256*X+2114.0645" /end COMPU_METHOD
/begin COMPU_METHOD LINEAR______0_000000__0H___2550_ "" FORM "%4.0" "ms" FORMULA "10.0*X" FORMULA_INV "0.1*X" /end COMPU_METHOD
/begin COMPU_METHOD LINEAR______0_000000__0H___25_50 "" FORM "%4.1" "s" FORMULA "0.1*X" FORMULA_INV "10.0*X" /end COMPU_METHOD
/begin COMPU_METHOD LINEAR______0_000000__0H___26_30 "" FORM "%7.4" "V" FORMULA "0.00039828431*X" FORMULA_INV "2510.7692*X" /end COMPU_METHOD
/begin COMPU_METHOD LINEAR______0_000000__0H___1_999 "" FORM "%7.5" "-" FORMULA "3.0517585e-005*X" FORMULA_INV "32767.992*X" /end COMPU_METHOD
/begin COMPU_METHOD LINEAR______0_000000__0H___7_999 "" FORM "%6.4" "-" FORMULA "0.00012207031*X" FORMULA_INV "8191.9999*X" /end COMPU_METHOD
/begin COMPU_METHOD LINEAR_______50_000000__0H___440 "" FORM "%7.3" "%" FORMULA "0.0015258789*X-50.0" FORMULA_INV "655.36002*X+32768.001" /end COMPU_METHOD
/begin COMPU_METHOD LINEAR______1_000000__100H___1_9 "" FORM "%5.3" "-" FORMULA "0.0039062743*X-6.2243137e-006" FORMULA_INV "255.99841*X+0.0015934144" /end COMPU_METHOD
/begin COMPU_METHOD LINEAR______0_000000__0H___119_9 "" FORM "%7.3" "°TPS" FORMULA "0.0018310547*X" FORMULA_INV "546.13333*X" /end COMPU_METHOD
/begin COMPU_METHOD LINEAR______0_000000__0H___11942 "" FORM "%5.1" "°TPS" FORMULA "0.46875*X" FORMULA_INV "2.1333333*X" /end COMPU_METHOD
/begin COMPU_METHOD LINEAR______0_000000__0H___2_544 "" FORM "%4.2" "s" FORMULA "0.0099999998*X" FORMULA_INV "100.0*X" /end COMPU_METHOD
/begin COMPU_METHOD LINEAR______0_000000__0H___100_0 "" FORM "%5.1" "%" FORMULA "0.39215686*X" FORMULA_INV "2.55*X" /end COMPU_METHOD
/begin COMPU_METHOD LINEAR______0_000000__0H___1023_ "" FORM "%4.0" "Nm" FORMULA "1.0*X" FORMULA_INV "1.0*X" /end COMPU_METHOD
/begin COMPU_METHOD LINEAR______0_006100__1H___24_99 "" FORM "%6.3" "%/10ms" FORMULA "0.0061034929*X-3.4929165e-006" FORMULA_INV "163.84061*X+0.00057228156" /end COMPU_METHOD
/begin COMPU_METHOD LINEAR______0_000000__0H___51151 "" FORM "%7.3" "km/h" FORMULA "0.0078124999*X" FORMULA_INV "128.0*X" /end COMPU_METHOD
/begin COMPU_METHOD LINEAR______0_000000__0H___10253 "" FORM "%7.2" "°C" FORMULA "0.015625*X" FORMULA_INV "64.0*X" /end COMPU_METHOD
/begin COMPU_METHOD LINEAR______0_000000__0H___1820_ "" FORM "%7.2" "g" FORMULA "0.027777829*X" FORMULA_INV "35.999934*X" /end COMPU_METHOD
/begin COMPU_METHOD LINEAR______0_000000__0H___36400 "" FORM "%7.1" "g" FORMULA "0.5554284*X" FORMULA_INV "1.8004121*X" /end COMPU_METHOD
/begin COMPU_METHOD LINEAR______0_000000__0H___2_054 "" FORM "%7.5" "-" FORMULA "3.0518044e-005*X" FORMULA_INV "32767.5*X" /end COMPU_METHOD
/begin COMPU_METHOD LINEAR_______119_500000__0H___11 "" FORM "%8.3" "°TPS" FORMULA "0.0072941464*X-119.5" FORMULA_INV "137.09623*X+16383.0" /end COMPU_METHOD
/begin COMPU_METHOD LINEAR______1_000000__100H___5_0 "" FORM "%5.3" "-" FORMULA "0.00390625*X" FORMULA_INV "256.0*X" /end COMPU_METHOD
/begin COMPU_METHOD LINEAR______0_000000__0H___1_275 "" FORM "%5.3" "V" FORMULA "0.005*X" FORMULA_INV "200.0*X" /end COMPU_METHOD
/begin COMPU_METHOD LINEAR______0_000000__0H___4_980 "" FORM "%5.3" "V" FORMULA "0.01953125*X" FORMULA_INV "51.2*X" /end COMPU_METHOD
/begin COMPU_METHOD LINEAR______0_000000__0H___11960 "" FORM "%7.3" "°PVS" FORMULA "0.0018310552*X" FORMULA_INV "546.13319*X" /end COMPU_METHOD
/begin COMPU_METHOD LINEAR______0_000000__0H___65563 "" FORM "%5.0" "min" FORMULA "1.0*X" FORMULA_INV "1.0*X" /end COMPU_METHOD
/begin COMPU_METHOD LINEAR_______180_000000__0H___50 "" FORM "%4.0" "°CRK" FORMULA "6.0*X-180.0" FORMULA_INV "0.16666667*X+30.0" /end COMPU_METHOD
/begin COMPU_METHOD LINEAR_______1_279900__0H___1_66 "" FORM "%8.5" "s" FORMULA "7.8120613e-005*X-1.2799" FORMULA_INV "12800.719*X+16383.64" /end COMPU_METHOD
/begin COMPU_METHOD LINEAR______0_000000__0H___11_18 "" FORM "%7.4" "s" FORMULA "0.00017066667*X" FORMULA_INV "5859.375*X" /end COMPU_METHOD
/begin COMPU_METHOD LINEAR______0_000000__0H___655_3 "" FORM "%6.2" "s" FORMULA "0.01*X" FORMULA_INV "100.0*X" /end COMPU_METHOD
/begin COMPU_METHOD LINEAR______0_000000__0H___10269 "" FORM "%7.2" "kg/h" FORMULA "0.015625*X" FORMULA_INV "64.0*X" /end COMPU_METHOD
/begin COMPU_METHOD LINEAR_______31_250000__3000H___ "" FORM "%7.3" "%" FORMULA "0.0015258789*X-50.0" FORMULA_INV "655.36*X+32768.0" /end COMPU_METHOD
/begin COMPU_METHOD LINEAR______0_000000__0H___11975 "" FORM "%7.3" "°TPS" FORMULA "0.0072941464*X" FORMULA_INV "137.09623*X" /end COMPU_METHOD
/begin COMPU_METHOD LINEAR______0_000000__0H___1022_ "" FORM "%7.2" "Nm" FORMULA "0.031219482*X" FORMULA_INV "32.031281*X" /end COMPU_METHOD
/begin COMPU_METHOD LINEAR______0_000000__0H___25578 "" FORM "%6.2" "%" FORMULA "0.015203911*X" FORMULA_INV "65.772549*X" /end COMPU_METHOD
/begin COMPU_METHOD LINEAR_______256_000000__0H___81 "" FORM "%4.0" "rpm" FORMULA "2.0*X-256.0" FORMULA_INV "0.5*X+128.0" /end COMPU_METHOD
/begin COMPU_METHOD LINEAR______0_000000__0H___400_0 "" FORM "%7.3" "mA" FORMULA "0.0061036088*X" FORMULA_INV "163.8375*X" /end COMPU_METHOD
/begin COMPU_METHOD LINEAR______0_000000__0H___255_9 "" FORM "%7.3" "-" FORMULA "0.0039062501*X" FORMULA_INV "255.99999*X" /end COMPU_METHOD
/begin COMPU_METHOD LINEAR______0_000000__0H___3_000 "" FORM "%2.0" "-" FORMULA "1.0*X" FORMULA_INV "1.0*X" /end COMPU_METHOD
/begin COMPU_METHOD LINEAR______0_000000__0H___65592 "" FORM "%5.0" "-" FORMULA "1.0*X" FORMULA_INV "1.0*X" /end COMPU_METHOD
/begin COMPU_METHOD LINEAR______0_000000__0H___15100 "" FORM "%2.0" "-" FORMULA "1.0*X" FORMULA_INV "1.0*X" /end COMPU_METHOD
/begin COMPU_METHOD LINEAR_______50_000000__FFFF8000 "" FORM "%7.3" "%" FORMULA "0.0015258793*X+1.2939651e-005" FORMULA_INV "655.35983*X-0.0084801272" /end COMPU_METHOD
/begin COMPU_METHOD LINEAR______0_000000__0H___10126 "" FORM "%7.3" "%" FORMULA "0.0030518509*X" FORMULA_INV "327.67*X" /end COMPU_METHOD
/begin COMPU_METHOD LINEAR_______32768_000000__FFFF8 "" FORM "%6.0" "rpm" FORMULA "1.0*X" FORMULA_INV "1.0*X" /end COMPU_METHOD
/begin COMPU_METHOD LINEAR_______4096_000000__FFF129 "" FORM "%5.0" "rpm/s" FORMULA "32.0*X" FORMULA_INV "0.03125*X" /end COMPU_METHOD
/begin COMPU_METHOD LINEAR______0_000000__0H___5_133 "" FORM "%7.5" "V" FORMULA "7.7821012e-005*X" FORMULA_INV "12850.0*X" /end COMPU_METHOD
/begin COMPU_METHOD LINEAR______0_000000__0H___11140 "" FORM "%7.3" "°TPS" FORMULA "0.0018310552*X" FORMULA_INV "546.13319*X" /end COMPU_METHOD
/begin COMPU_METHOD LINEAR_______128_000000__FFFF143 "" FORM "%4.0" "°C" FORMULA "1.0*X" FORMULA_INV "1.0*X" /end COMPU_METHOD
/begin COMPU_METHOD LINEAR______0_000000__0H___25144 "" FORM "%7.3" "kg/h" FORMULA "0.00390625*X" FORMULA_INV "256.0*X" /end COMPU_METHOD
/begin COMPU_METHOD LINEAR_______512_000000__FFFF800 "" FORM "%7.2" "kg/h" FORMULA "0.015625*X" FORMULA_INV "64.0*X" /end COMPU_METHOD
/begin COMPU_METHOD LINEAR______0_000000__0H___25147 "" FORM "%3.0" "cyc" FORMULA "1.0*X" FORMULA_INV "1.0*X" /end COMPU_METHOD
/begin COMPU_METHOD LINEAR______0_000000__0H___65152 "" FORM "%5.0" "s" FORMULA "1.0*X" FORMULA_INV "1.0*X" /end COMPU_METHOD
/begin COMPU_METHOD LINEAR______0_000000__0H___1_153 "" FORM "%4.3" "s" FORMULA "0.005*X" FORMULA_INV "200.0*X" /end COMPU_METHOD
/begin COMPU_METHOD LINEAR______0_000000__0H___26156 "" FORM "%7.2" "s" FORMULA "0.04*X" FORMULA_INV "25.0*X" /end COMPU_METHOD
/begin COMPU_METHOD LINEAR______0_000000__0H___1310_ "" FORM "%7.2" "s" FORMULA "0.019999999*X" FORMULA_INV "50.000002*X" /end COMPU_METHOD
/begin COMPU_METHOD LINEAR______0_000000__0H___174_7 "" FORM "%7.3" "ms" FORMULA "0.0053333333*X" FORMULA_INV "187.5*X" /end COMPU_METHOD
/begin COMPU_METHOD LINEAR_______174_762666__FFFF800 "" FORM "%7.2" "ms" FORMULA "0.0053333333*X" FORMULA_INV "187.5*X" /end COMPU_METHOD
/begin COMPU_METHOD LINEAR______0_000000__0H___1398_ "" FORM "%7.2" "-" FORMULA "0.021332113*X" FORMULA_INV "46.877682*X" /end COMPU_METHOD
/begin COMPU_METHOD LINEAR_______1023_000000__FFFF80 "" FORM "%8.2" "Nm" FORMULA "0.031219482*X+2.4121459e-007" FORMULA_INV "32.031281*X-7.7264123e-006" /end COMPU_METHOD
/begin COMPU_METHOD LINEAR______0_000000__0H___51182 "" FORM "%4.0" "Nm" FORMULA "2.0*X" FORMULA_INV "0.5*X" /end COMPU_METHOD
/begin COMPU_METHOD LINEAR______0_000000__0H___65183 "" FORM "%6.1" "h" FORMULA "0.1*X" FORMULA_INV "10.0*X" /end COMPU_METHOD
/begin COMPU_METHOD LINEAR______0_000000__0H___5_184 "" FORM "%5.3" "V" FORMULA "0.0048875855*X" FORMULA_INV "204.6*X" /end COMPU_METHOD
/begin COMPU_METHOD LINEAR______0_000000__0H___10187 "" FORM "%4.1" "V" FORMULA "0.039215686*X" FORMULA_INV "25.5*X" /end COMPU_METHOD
/begin COMPU_METHOD LINEAR_______256_000000__FFFF191 "" FORM "%6.2" "km/h" FORMULA "0.0078124999*X-3.7500572e-006" FORMULA_INV "128.0*X+0.00048000733" /end COMPU_METHOD
/begin COMPU_METHOD RANGE________YES___1H__1H____NO_ "" TAB_VERB "%8.4" "-" COMPU_TAB_REF RANGE________YES___1H__1H____NO_ /end COMPU_METHOD
/begin COMPU_METHOD RANGE________YES___1H__1H____744 "" TAB_VERB "%8.4" "" COMPU_TAB_REF RANGE________YES___1H__1H____744 /end COMPU_METHOD
/begin COMPU_METHOD RANGE________0___0H__0H____1___1 "" TAB_VERB "%8.4" "-" COMPU_TAB_REF RANGE________0___0H__0H____1___1 /end COMPU_METHOD
/begin COMPU_METHOD LINEAR______0_000000__0H___25753 "" FORM "%3.0" "hex" FORMULA "1.0*X" FORMULA_INV "1.0*X" /end COMPU_METHOD
/begin COMPU_METHOD LINEAR_______21845_000000__FFFF8 "" FORM "%6.0" "us" FORMULA "0.66665649*X-5.0863564e-006" FORMULA_INV "1.5000229*X+7.629651e-006" /end COMPU_METHOD
/begin COMPU_METHOD LINEAR______0_000000__0H___6400_ "" FORM "%7.2" "%" FORMULA "0.097751711*X" FORMULA_INV "10.23*X" /end COMPU_METHOD
/begin COMPU_METHOD LINEAR______0_000000__0H___65762 "" FORM "%8.4" "hex" FORMULA "1.0*X" FORMULA_INV "1.0*X" /end COMPU_METHOD
/begin COMPU_METHOD LINEAR______0_000000__0H___65775 "" FORM "%5.0" "-" FORMULA "1.0*X" FORMULA_INV "1.0*X" /end COMPU_METHOD
/begin COMPU_METHOD LINEAR______0_000000__0H___25788 "" FORM "%3.0" "-" FORMULA "1.0*X" FORMULA_INV "1.0*X" /end COMPU_METHOD
/begin COMPU_METHOD LINEAR______0_000000__0H___16799 "" FORM "%7.4" "-" FORMULA "0.00024414435*X" FORMULA_INV "4095.9375*X" /end COMPU_METHOD
/begin COMPU_METHOD LINEAR_______512_000000__FFFF801 "" FORM "%7.2" "°C" FORMULA "0.015625*X" FORMULA_INV "64.0*X" /end COMPU_METHOD
/begin COMPU_METHOD RANGE________0___0H__0H____1_818 "" TAB_VERB "%8.4" "" COMPU_TAB_REF RANGE________0___0H__0H____1_818 /end COMPU_METHOD
/begin COMPU_METHOD RANGE________active___1H__1H_821 "" TAB_VERB "%8.4" "-" COMPU_TAB_REF RANGE________active___1H__1H_821 /end COMPU_METHOD
/begin COMPU_METHOD RANGE________0___0H__0H____1_823 "" TAB_VERB "%8.4" "-" COMPU_TAB_REF RANGE________0___0H__0H____1_823 /end COMPU_METHOD
/begin COMPU_METHOD RANGE____________0H__0H____TPS_A "" TAB_VERB "%8.4" "" COMPU_TAB_REF RANGE____________0H__0H____TPS_A /end COMPU_METHOD
/begin COMPU_METHOD RANGE____________0H__0H____TP825 "" TAB_VERB "%8.4" "" COMPU_TAB_REF RANGE____________0H__0H____TP825 /end COMPU_METHOD
/begin COMPU_METHOD RANGE____________0H__0H____TP826 "" TAB_VERB "%8.4" "" COMPU_TAB_REF RANGE____________0H__0H____TP826 /end COMPU_METHOD
/begin COMPU_METHOD RANGE____________0H__0H____TPS_D "" TAB_VERB "%8.4" "" COMPU_TAB_REF RANGE____________0H__0H____TPS_D /end COMPU_METHOD
/begin COMPU_METHOD RANGE____________0H__0H____TPS_E "" TAB_VERB "%8.4" "" COMPU_TAB_REF RANGE____________0H__0H____TPS_E /end COMPU_METHOD
/begin COMPU_METHOD RANGE____________0H__0H____TP827 "" TAB_VERB "%8.4" "" COMPU_TAB_REF RANGE____________0H__0H____TP827 /end COMPU_METHOD
/begin COMPU_METHOD RANGE____________0H__0H____TPS_M "" TAB_VERB "%8.4" "" COMPU_TAB_REF RANGE____________0H__0H____TPS_M /end COMPU_METHOD
/begin COMPU_METHOD RANGE____________0H__0H____TP828 "" TAB_VERB "%8.4" "" COMPU_TAB_REF RANGE____________0H__0H____TP828 /end COMPU_METHOD
/begin COMPU_METHOD LINEAR_______694_680000__FFFF800 "" FORM "%7.2" "mg/stk" FORMULA "0.021199969*X+0.00059998474" FORMULA_INV "47.169879*X-0.028301208" /end COMPU_METHOD
/begin COMPU_METHOD LINEAR______0_000000__0H___13829 "" FORM "%4.0" "mg/stk" FORMULA "0.021194781*X" FORMULA_INV "47.181425*X" /end COMPU_METHOD
/begin COMPU_METHOD LINEAR_______5434_259766__FFF830 "" FORM "%7.2" "hPa/4*seg" FORMULA "0.16584171*X+0.041460356" FORMULA_INV "6.0298461*X-0.24999957" /end COMPU_METHOD
/begin COMPU_METHOD ES_8_RES "" FORM "%4.0" "rpm" FORMULA "32.0*X" FORMULA_INV "0.03125*X" /end COMPU_METHOD
/begin COMPU_METHOD UNSIGNED_LONG831 "" FORM "%10.0" "-" FORMULA "1.0*X" FORMULA_INV "1.0*X" /end COMPU_METHOD
/begin COMPU_METHOD LINEAR______0_000000__0H___1_832 "" FORM "%8.4" "hex" FORMULA "1.0*X" FORMULA_INV "1.0*X" /end COMPU_METHOD
/begin COMPU_METHOD LINEAR_______100_000000__FFFF833 "" FORM "%7.3" "%" FORMULA "0.0030517578*X-1.0937669e-009" FORMULA_INV "327.68*X+3.5840552e-007" /end COMPU_METHOD
/begin COMPU_METHOD LINEAR_______100_000000__FFFF834 "" FORM "%7.3" "%" FORMULA "0.0030517578*X-1.0937669e-009" FORMULA_INV "327.68*X+3.5840552e-007" /end COMPU_METHOD
/begin COMPU_METHOD LINEAR_______400_000000__FFFE000 "" FORM "%8.3" "%" FORMULA "0.0030517578*X+8.7890959e-007" FORMULA_INV "327.68*X-0.00028800109" /end COMPU_METHOD
/begin COMPU_METHOD LINEAR_______400_000000__FFFF800 "" FORM "%8.3" "%" FORMULA "0.012207031*X+1.5625233e-008" FORMULA_INV "81.92*X-1.2800191e-006" /end COMPU_METHOD
/begin COMPU_METHOD RANGE________N_BEG___1H__1H_____ "" TAB_VERB "%8.4" "-" COMPU_TAB_REF RANGE________N_BEG___1H__1H_____ /end COMPU_METHOD
/begin COMPU_METHOD LINEAR______0_000000__0H___81835 "" FORM "%8.3" "rpm" FORMULA "0.125*X" FORMULA_INV "8.0*X" /end COMPU_METHOD
/begin COMPU_METHOD IS_13_RES "" FORM "%4.0" "rpm" FORMULA "1.0*X" FORMULA_INV "1.0*X" /end COMPU_METHOD
/begin COMPU_METHOD LINEAR_______8192_000000__FFFF80 "" FORM "%7.2" "rpm" FORMULA "0.25*X" FORMULA_INV "4.0*X" /end COMPU_METHOD
/begin COMPU_METHOD LINEAR_______8160_000000__FFFFE0 "" FORM "%4.0" "rpm/(km/h)" FORMULA "1.0*X" FORMULA_INV "1.0*X" /end COMPU_METHOD
/begin COMPU_METHOD RANGE________AST___1H__1H_______ "" TAB_VERB "%8.4" "-" COMPU_TAB_REF RANGE________AST___1H__1H_______ /end COMPU_METHOD
/begin COMPU_METHOD LINEAR______0_000000__0H___0_836 "" FORM "%5.3" "ms" FORMULA "0.00390625*X" FORMULA_INV "256.0*X" /end COMPU_METHOD
/begin COMPU_METHOD LINEAR______0_000000__0H___25837 "" FORM "%6.2" "%." FORMULA "0.015203911*X" FORMULA_INV "65.772549*X" /end COMPU_METHOD
/begin COMPU_METHOD LINEAR_______60_000000__FFFF8000 "" FORM "%7.3" "°TPS" FORMULA "0.0018310547*X+2.7344164e-008" FORMULA_INV "546.13333*X-1.493356e-005" /end COMPU_METHOD
/begin COMPU_METHOD PVS_NORM_2co_16_RES "" FORM "%6.2" "°TPS" FORMULA "0.001824979*X+0.00091248951" FORMULA_INV "547.95151*X-0.5" /end COMPU_METHOD
/begin COMPU_METHOD LINEAR______0_000000__0H___29838 "" FORM "%7.2" "°TPS/s" FORMULA "0.045593957*X" FORMULA_INV "21.932731*X" /end COMPU_METHOD
/begin COMPU_METHOD CRU_RANGE "" TAB_VERB "%8.4" "-" COMPU_TAB_REF CRU_RANGE_TAB_NAME /end COMPU_METHOD
/begin COMPU_METHOD SA_DIAG_CND_RANGE "" TAB_VERB "%8.4" "" COMPU_TAB_REF SA_DIAG_CND_RANGE_TAB_NAME /end COMPU_METHOD
/begin COMPU_METHOD SAV_DIAG_CND_RANGE "" TAB_VERB "%8.4" "" COMPU_TAB_REF SAV_DIAG_CND_RANGE_TAB_NAME /end COMPU_METHOD
/begin COMPU_METHOD RANGE________SAWUP___1H__1H_____ "" TAB_VERB "%8.4" "-" COMPU_TAB_REF RANGE________SAWUP___1H__1H_____ /end COMPU_METHOD
/begin COMPU_METHOD LINEAR_______7_812500__FFFF8040H "" FORM "%7.4" "%." FORMULA "0.00023888515*X" FORMULA_INV "4186.112*X" /end COMPU_METHOD
/begin COMPU_METHOD STATE_TQD_RANGE "" TAB_VERB "%8.4" "-" COMPU_TAB_REF STATE_TQD_RANGE_TAB_NAME /end COMPU_METHOD
/begin COMPU_METHOD S_CC_RANGE "" TAB_VERB "%8.4" "-" COMPU_TAB_REF S_CC_RANGE_TAB_NAME /end COMPU_METHOD
/begin COMPU_METHOD STATE_CLU_AMT_RANGE "" TAB_VERB "%8.4" "-" COMPU_TAB_REF STATE_CLU_AMT_RANGE_TAB_NAME /end COMPU_METHOD
/begin COMPU_METHOD STATE_CP_RANGE "" TAB_VERB "%8.4" "-" COMPU_TAB_REF STATE_CP_RANGE_TAB_NAME /end COMPU_METHOD
/begin COMPU_METHOD STATE_CP_TRA_RANGE "" TAB_VERB "%8.4" "-" COMPU_TAB_REF STATE_CP_TRA_RANGE_TAB_NAME /end COMPU_METHOD
/begin COMPU_METHOD STATE_CRU_RANGE "" TAB_VERB "%8.4" "" COMPU_TAB_REF STATE_CRU_RANGE_TAB_NAME /end COMPU_METHOD
/begin COMPU_METHOD RANGE_STATE_CS_DIAG "" TAB_VERB "%8.4" "-" COMPU_TAB_REF RANGE_STATE_CS_DIAG_TAB_NAME /end COMPU_METHOD
/begin COMPU_METHOD STATE_DMTL_RANGE "" TAB_VERB "%8.4" "-" COMPU_TAB_REF STATE_DMTL_RANGE_TAB_NAME /end COMPU_METHOD
/begin COMPU_METHOD STATE_DMTL_EOL_RANGE "" TAB_VERB "%8.4" "-" COMPU_TAB_REF STATE_DMTL_EOL_RANGE_TAB_NAME /end COMPU_METHOD
/begin COMPU_METHOD STATE_EFP_CRASH_RANGE "" TAB_VERB "%8.4" "-" COMPU_TAB_REF STATE_EFP_CRASH_RANGE_TAB_NAME /end COMPU_METHOD
/begin COMPU_METHOD RANGE_____00000017 "" TAB_VERB "%8.4" "-" COMPU_TAB_REF RANGE_____00000017_TAB_NAME /end COMPU_METHOD
/begin COMPU_METHOD STATE_IVVT "" TAB_VERB "%8.4" "" COMPU_TAB_REF STATE_IVVT_TAB_NAME /end COMPU_METHOD
/begin COMPU_METHOD STATE_LRN_AMP_RANGE "" TAB_VERB "%8.4" "-" COMPU_TAB_REF STATE_LRN_AMP_RANGE_TAB_NAME /end COMPU_METHOD
/begin COMPU_METHOD STATE_MSW_CAN_RANGE "" TAB_VERB "%8.4" "" COMPU_TAB_REF STATE_MSW_CAN_RANGE_TAB_NAME /end COMPU_METHOD
/begin COMPU_METHOD STATE_N_SP_OFS_RANGE "" TAB_VERB "%8.4" "-" COMPU_TAB_REF STATE_N_SP_OFS_RANGE_TAB_NAME /end COMPU_METHOD
/begin COMPU_METHOD PVS_DIAG "" TAB_VERB "%8.4" "" COMPU_TAB_REF PVS_DIAG_TAB_NAME /end COMPU_METHOD
/begin COMPU_METHOD RANGE_____00000019 "" TAB_VERB "%8.4" "" COMPU_TAB_REF RANGE_____00000019_TAB_NAME /end COMPU_METHOD
/begin COMPU_METHOD RANGE_____00000018 "" TAB_VERB "%8.4" "" COMPU_TAB_REF RANGE_____00000018_TAB_NAME /end COMPU_METHOD
/begin COMPU_METHOD STATE_T_SDL_CP_RANGE "" TAB_VERB "%8.4" "-" COMPU_TAB_REF STATE_T_SDL_CP_RANGE_TAB_NAME /end COMPU_METHOD
/begin COMPU_METHOD TPS_DIAG "" TAB_VERB "%8.4" "" COMPU_TAB_REF TPS_DIAG_TAB_NAME /end COMPU_METHOD
/begin COMPU_METHOD STATE_TQ_INTV "" TAB_VERB "%8.4" "-" COMPU_TAB_REF STATE_TQ_INTV_TAB_NAME /end COMPU_METHOD
/begin COMPU_METHOD STATE_VARIANTEN "" TAB_VERB "%8.4" "-" COMPU_TAB_REF STATE_VARIANTEN_TAB_NAME /end COMPU_METHOD
/begin COMPU_METHOD LINEAR______0_000000__0H___16711 "" FORM "%12.3" "kg/h" FORMULA "0.00390625*X" FORMULA_INV "256.0*X" /end COMPU_METHOD
/begin COMPU_METHOD LINEAR______0_000000__0H___27839 "" FORM "%7.2" "ms" FORMULA "0.042666667*X" FORMULA_INV "23.4375*X" /end COMPU_METHOD
/begin COMPU_METHOD LINEAR______0_000000__0H___5_840 "" FORM "%5.3" "s" FORMULA "0.005*X" FORMULA_INV "200.0*X" /end COMPU_METHOD
/begin COMPU_METHOD LINEAR______0_000000__0H___43690 "" FORM "%7.1" "us" FORMULA "0.66666667*X" FORMULA_INV "1.5*X" /end COMPU_METHOD
/begin COMPU_METHOD LINEAR_______0_125000__FFFF8000H "" FORM "%8.6" "-" FORMULA "3.8146029e-006*X-3.0926986e-006" FORMULA_INV "262150.49*X+0.81075243" /end COMPU_METHOD
/begin COMPU_METHOD LINEAR_______48_000000__0H___841 "" FORM "%3.0" "°C" FORMULA "0.75*X-48.0" FORMULA_INV "1.3333333*X+64.0" /end COMPU_METHOD
/begin COMPU_METHOD LINEAR_______64_000000__FFFF8000 "" FORM "%7.3" "-" FORMULA "0.001953125*X+6.2500959e-008" FORMULA_INV "512.0*X-3.2000491e-005" /end COMPU_METHOD
/begin COMPU_METHOD LINEAR_______33_000000__0H___842 "" FORM "%5.1" "°C" FORMULA "4.0*X-33.0" FORMULA_INV "0.25*X+8.25" /end COMPU_METHOD
/begin COMPU_METHOD LINEAR_______1024_000000__FFFF80 "" FORM "%8.2" "°C" FORMULA "0.03125*X+1.5500236e-005" FORMULA_INV "32.0*X-0.00049600756" /end COMPU_METHOD
/begin COMPU_METHOD LINEAR_______1023_984375__FFF843 "" FORM "%7.2" "°C" FORMULA "-0.015625005*X" FORMULA_INV "-63.999977*X" /end COMPU_METHOD
/begin COMPU_METHOD LINEAR______0_000000__0H___10844 "" FORM "%6.3" "ms" FORMULA "0.0053333333*X" FORMULA_INV "187.5*X" /end COMPU_METHOD
/begin COMPU_METHOD LINEAR_______174_762666__FFFF845 "" FORM "%8.3" "ms" FORMULA "0.0053333333*X-2.8421709e-014" FORMULA_INV "187.5*X+5.3290705e-012" /end COMPU_METHOD
/begin COMPU_METHOD LINEAR_______174_762666__FFFF846 "" FORM "%7.3" "ms" FORMULA "0.0053333333*X-2.8421709e-014" FORMULA_INV "187.5*X+5.3290705e-012" /end COMPU_METHOD
/begin COMPU_METHOD LINEAR_______0_500000__FFFFF800H "" FORM "%5.3" "-" FORMULA "0.00024410501*X-7.2947497e-005" FORMULA_INV "4096.5977*X+0.29883655" /end COMPU_METHOD
/begin COMPU_METHOD LINEAR_______203_000000__FFFFFF0 "" FORM "%6.1" "°C" FORMULA "0.79607843*X" FORMULA_INV "1.2561576*X" /end COMPU_METHOD
/begin COMPU_METHOD LINEAR_______48_000000__0H___847 "" FORM "%3.0" "°C" FORMULA "0.79607843*X-48.0" FORMULA_INV "1.2561576*X+60.295567" /end COMPU_METHOD
/begin COMPU_METHOD STATE_TPS_AD "" TAB_VERB "%8.4" "" COMPU_TAB_REF STATE_TPS_AD_TAB_NAME /end COMPU_METHOD
/begin COMPU_METHOD LINEAR_______119_500000__FFFF848 "" FORM "%7.3" "°TPS" FORMULA "0.0072941464*X" FORMULA_INV "137.09623*X" /end COMPU_METHOD
/begin COMPU_METHOD LINEAR_______119_500000__0H__849 "" FORM "%6.3" "°TPS/5ms" FORMULA "0.0072941464*X-119.5" FORMULA_INV "137.09623*X+16383.0" /end COMPU_METHOD
/begin COMPU_METHOD LINEAR______0_000000__0H___2987_ "" FORM "%4.0" "°TPS/s" FORMULA "11.715686*X" FORMULA_INV "0.085355649*X" /end COMPU_METHOD
/begin COMPU_METHOD LINEAR_______1024_000000__FFFFFC "" FORM "%5.0" "Nm" FORMULA "1.0*X" FORMULA_INV "1.0*X" /end COMPU_METHOD
/begin COMPU_METHOD LINEAR______0_000000__0H___10850 "" FORM "%5.0" "Nm" FORMULA "1.0*X" FORMULA_INV "1.0*X" /end COMPU_METHOD
/begin COMPU_METHOD LINEAR______0_000000__0H___10851 "" FORM "%7.2" "Nm" FORMULA "0.015609979*X" FORMULA_INV "64.061584*X" /end COMPU_METHOD
/begin COMPU_METHOD LINEAR______0_000000__0H___51852 "" FORM "%3.0" "Nm" FORMULA "0.0078125*X" FORMULA_INV "128.0*X" /end COMPU_METHOD
/begin COMPU_METHOD LINEAR______0_000000__0H___131_0 "" FORM "%5.1" "mA" FORMULA "0.51372549*X" FORMULA_INV "1.9465649*X" /end COMPU_METHOD
/begin COMPU_METHOD RANGE________FL___1H__1H________ "" TAB_VERB "%8.4" "-" COMPU_TAB_REF RANGE________FL___1H__1H________ /end COMPU_METHOD
/begin COMPU_METHOD LINEAR_______0_637500__FFFF8000H "" FORM "%8.5" "V" FORMULA "1.9455253e-005*X+9.7276265e-006" FORMULA_INV "51400.0*X-0.5" /end COMPU_METHOD
/begin COMPU_METHOD LINEAR_______0_637500__FFFF80853 "" FORM "%7.5" "V" FORMULA "1.9455253e-005*X+9.7276265e-006" FORMULA_INV "51400.0*X-0.5" /end COMPU_METHOD
/begin COMPU_METHOD STATE_VLS_MIX "" TAB_VERB "%8.4" "-" COMPU_TAB_REF STATE_VLS_MIX_TAB_NAME /end COMPU_METHOD
/begin COMPU_METHOD LINEAR______0_000000__0H___150_7 "" FORM "%5.1" "°CRK" FORMULA "0.37489998*X" FORMULA_INV "2.6673781*X" /end COMPU_METHOD
/begin COMPU_METHOD LINEAR_______4096_000000__FFFF80 "" FORM "%7.1" "km/h" FORMULA "0.125*X" FORMULA_INV "8.0*X" /end COMPU_METHOD
/begin COMPU_METHOD LINEAR______0_000000__0H___65854 "" FORM "%5.0" "p/s" FORMULA "1.0*X" FORMULA_INV "1.0*X" /end COMPU_METHOD
/begin COMPU_METHOD RANGE________REAC___1H__1H______ "" TAB_VERB "%8.4" "-" COMPU_TAB_REF RANGE________REAC___1H__1H______ /end COMPU_METHOD
/begin COMPU_METHOD RANGE________WUP___1H__1H_______ "" TAB_VERB "%8.4" "-" COMPU_TAB_REF RANGE________WUP___1H__1H_______ /end COMPU_METHOD
/begin COMPU_METHOD LINEAR______0_000000__0H___25855 "" FORM "%3.0" "-" FORMULA "1.0*X" FORMULA_INV "1.0*X" /end COMPU_METHOD
/begin COMPU_VTAB RANGE________YES___1H__1H____NO_ "" TAB_VERB 2 0x0 "NO" 0x1 "YES" /end COMPU_VTAB
/begin COMPU_VTAB RANGE________YES___1H__1H____744 "" TAB_VERB 2 0x0 "NO" 0x1 "YES" /end COMPU_VTAB
/begin COMPU_VTAB RANGE________0___0H__0H____1___1 "" TAB_VERB 2 0x0 "0" 0x1 "1" /end COMPU_VTAB
/begin COMPU_VTAB RANGE________0___0H__0H____1_818 "" TAB_VERB 2 0x0 "0" 0x1 "1" /end COMPU_VTAB
/begin COMPU_VTAB RANGE________active___1H__1H_821 "" TAB_VERB 2 0x0 " passive" 0x1 "active" /end COMPU_VTAB
/begin COMPU_VTAB RANGE________0___0H__0H____1_823 "" TAB_VERB 2 0x0 "0" 0x1 "1" /end COMPU_VTAB
/begin COMPU_VTAB RANGE____________0H__0H____TPS_A "" TAB_VERB 2 0x0 "" 0x1 "TPS_AD_CUR_OFF" /end COMPU_VTAB
/begin COMPU_VTAB RANGE____________0H__0H____TP825 "" TAB_VERB 2 0x0 "" 0x1 "TPS_AD_DIAG_CUR_OFF" /end COMPU_VTAB
/begin COMPU_VTAB RANGE____________0H__0H____TP826 "" TAB_VERB 2 0x0 "" 0x1 "TPS_AD_REQ" /end COMPU_VTAB
/begin COMPU_VTAB RANGE____________0H__0H____TPS_D "" TAB_VERB 2 0x0 "" 0x1 "TPS_DIAG_CUR_OFF" /end COMPU_VTAB
/begin COMPU_VTAB RANGE____________0H__0H____TPS_E "" TAB_VERB 2 0x0 "" 0x1 "TPS_ERR_1" /end COMPU_VTAB
/begin COMPU_VTAB RANGE____________0H__0H____TP827 "" TAB_VERB 2 0x0 "" 0x1 "TPS_ERR_2" /end COMPU_VTAB
/begin COMPU_VTAB RANGE____________0H__0H____TPS_M "" TAB_VERB 2 0x0 "" 0x1 "TPS_MAF_ERR_1" /end COMPU_VTAB
/begin COMPU_VTAB RANGE____________0H__0H____TP828 "" TAB_VERB 2 0x0 "" 0x1 "TPS_MAF_ERR_2" /end COMPU_VTAB
/begin COMPU_VTAB RANGE________N_BEG___1H__1H_____ "" TAB_VERB 2 0x0 "" 0x1 "N_BEG" /end COMPU_VTAB
/begin COMPU_VTAB RANGE________AST___1H__1H_______ "" TAB_VERB 2 0x0 "" 0x1 "AST" /end COMPU_VTAB
/begin COMPU_VTAB CRU_RANGE_TAB_NAME "" TAB_VERB 9 0x0 "HARD OFF" 0x1 "SOFT OFF" 0x2 "TIP UP" 0x3 "TIP DOWN" 0x4 "SET/AC" 0x5 "REST" 0x6 "DECE" 0x7 "IDLE" 0x8 "" /end COMPU_VTAB
/begin COMPU_VTAB SA_DIAG_CND_RANGE_TAB_NAME "" TAB_VERB 16 0x0 "ACTIVE" 0x1 "SAWUP" 0x2 "T_WAIT" 0x3 "T_DIAG_SA" 0x4 "TCO_MAX" 0x5 "SAP" 0x6 "N_MAX" 0x7 "IP_N_MIN" 0x8 "IP_MAF_KGH_MAX" 0x9 "IP_MAF_MIN" 0xa "TI_ADD_WF_MAX" 0xb "TI_ADD_WF_MIN" 0xc "IP_MAF_MAX" 0xd "VLS_UP_READY" 0xe "VLS_DOWN_READY" 0xf "UNDEFINED" /end COMPU_VTAB
/begin COMPU_VTAB SAV_DIAG_CND_RANGE_TAB_NAME "" TAB_VERB 8 0x0 "ACTIVE" 0x1 "IS_PL" 0x2 "N_MAX" 0x3 "IP_MAF_KGH_MAX" 0x4 "TI_ADD_WF_MAX" 0x5 "TI_ADD_WF_MIN" 0x6 "EOLT_IS" 0x7 "TCO_TI_AD_MIN" /end COMPU_VTAB
/begin COMPU_VTAB RANGE________SAWUP___1H__1H_____ "" TAB_VERB 2 0x0 "" 0x1 "SAWUP" /end COMPU_VTAB
/begin COMPU_VTAB STATE_TQD_RANGE_TAB_NAME "" TAB_VERB 4 0x0 "0" 0x1 "1" 0x2 "2" 0x3 "3" /end COMPU_VTAB
/begin COMPU_VTAB S_CC_RANGE_TAB_NAME "" TAB_VERB 10 0x0 "0" 0x1 "1" 0x2 "2" 0x3 "3" 0x4 "3" 0x5 "3" 0x6 "3" 0x7 "3" 0x8 "3" 0x9 "3" /end COMPU_VTAB
/begin COMPU_VTAB STATE_CLU_AMT_RANGE_TAB_NAME "" TAB_VERB 4 0x0 "OFFEN" 0x1 "KRIECHEN" 0x2 "ANFAHRT" 0x3 "GESCHLOSSEN" /end COMPU_VTAB
/begin COMPU_VTAB STATE_CP_RANGE_TAB_NAME "" TAB_VERB 5 0x0 "CPS_CLOSED" 0x1 "MIN_PURGE" 0x2 "NORM_PURGE" 0x3 "RAMP_OPEN" 0x4 "RAMP_CLOSE" /end COMPU_VTAB
/begin COMPU_VTAB STATE_CP_TRA_RANGE_TAB_NAME "" TAB_VERB 9 0x0 "NO_TRANSITION" 0x1 "MIN_TO_CLOSED" 0x2 "NORM_TO_CLOSED" 0x3 "NORM_TO_MIN" 0x4 "CLOSED_TO_MIN" 0x5 "CLOSED_TO_LD" 0x6 "LD" 0x7 "LD_INTR" 0x8 "LD_TO_MIN" /end COMPU_VTAB
/begin COMPU_VTAB STATE_CRU_RANGE_TAB_NAME "" TAB_VERB 6 0x0 "PASSIV" 0x1 "CONST_DRIVING" 0x2 "TIP" 0x3 "SET/AC" 0x4 "REST" 0x5 "DECE" /end COMPU_VTAB
/begin COMPU_VTAB RANGE_STATE_CS_DIAG_TAB_NAME "" TAB_VERB 8 0x0 "CS_DIAG_START" 0x1 "CS_DIAG_WAIT_MAF" 0x2 "CS_DIAG_WAIT_N" 0x3 "CS_DIAG_WAIT_T_DIAG" 0x4 "CS_DIAG_WAIT_NOT_N_MAF" 0x5 "CS_DIAG_WAIT_NOT_MAF" 0x6 "CS_DIAG_WAIT_NOT_N" 0x7 "CS_DIAG_END" /end COMPU_VTAB
/begin COMPU_VTAB STATE_DMTL_RANGE_TAB_NAME "" TAB_VERB 13 0x0 "START" 0x1 "REF_LEAK_MES" 0x2 "ROUGH_LEAK_MES" 0x3 "ROUGH_LEAK_MES_LEN" 0x4 "ROUGH_LEAK_MES_END" 0x5 "SMALL_LEAK_MES" 0x6 "SMALL_LEAK_MES_LEN" 0x7 "2.REF_LEAK_MES" 0x8 "TANK_PROOFED" 0x9 "SMALL_LEAK" 0xa "ROUGH_LEAK" 0xb "MODULE_ERROR" 0xc "END" /end COMPU_VTAB
/begin COMPU_VTAB STATE_DMTL_EOL_RANGE_TAB_NAME "" TAB_VERB 19 0x0 "START" 0x1 "REF_LEAK_MES" 0x2 "ROUGH_LEAK_MES" 0x3 "ROUGH_LEAK_MES_LEN" 0x4 "ROUGH_LEAK_MES_END" 0x5 "SMALL_LEAK_MES" 0x6 "SMALL_LEAK_MES_LEN" 0x7 "2.REF_LEAK_MES" 0x8 "TANK_PROOFED" 0x9 "SMALL_LEAK" 0xa "ROUGH_LEAK" 0xb "MODULE_ERROR" 0xc "END" 0x11 "VB nicht im gültigen Bereich" 0x12 "VS >= c_vs_dmtl_max" 0x13 "elektrischer Fehler" 0x14 "max. Diagnosezeit überschritten" 0x21 "Betankung erkannt" 0x23 "Schwankung VB zu gross" /end COMPU_VTAB
/begin COMPU_VTAB STATE_EFP_CRASH_RANGE_TAB_NAME "" TAB_VERB 3 0x0 "INactive" 0x1 "ARMING" 0x2 "EFP-SWITCH_OFF" /end COMPU_VTAB
/begin COMPU_VTAB RANGE_____00000017_TAB_NAME "" TAB_VERB 8 0x0 "ES" 0x1 "ST" 0x2 "IS" 0x3 "PL" 0x4 "PU" 0x5 "PUC" 0x6 "" 0x7 "" /end COMPU_VTAB
/begin COMPU_VTAB STATE_IVVT_TAB_NAME "" TAB_VERB 4 0x0 "IVVT-PASSIVE" 0x1 "IVVT-READY" 0x2 "IVVT-ACTIVE" 0x3 "IVVT-LIMP_HOME" /end COMPU_VTAB
/begin COMPU_VTAB STATE_LRN_AMP_RANGE_TAB_NAME "" TAB_VERB 5 0x0 "Unbekannte Variante" 0x11 "Lernen aktiv" 0x22 "Lernen fehlgeschlagen" 0x55 "Motorola Drucksensor" 0xaa "KP120 Drucksensor" /end COMPU_VTAB
/begin COMPU_VTAB STATE_MSW_CAN_RANGE_TAB_NAME "" TAB_VERB 8 0x0 "IDLE" 0x1 "TIP_UP" 0x2 "TIP_DOWN" 0x3 "RESUME" 0x4 "SOFT_OFF" 0x5 "NOT_DEFINED" 0x6 "NOT_DEFINED" 0x7 "ERROR" /end COMPU_VTAB
/begin COMPU_VTAB STATE_N_SP_OFS_RANGE_TAB_NAME "" TAB_VERB 10 0x0 "-" 0x1 "CH_2" 0x2 "CS" 0x3 "HEAT" 0x4 "PVS" 0x5 "BAT" 0x6 "VB" 0x7 "IVVT" 0x8 "ACRDG" 0x9 "PSTE" /end COMPU_VTAB
/begin COMPU_VTAB PVS_DIAG_TAB_NAME "" TAB_VERB 9 0x0 "PVS-NO ERROR" 0x1 "PVS-LIH_PRED" 0x2 "PVS-LIH_1" 0x4 "PVS-LIH_2" 0x8 "PVS-LIH_MIN" 0x10 "PVS-DBL ERROR" 0x20 "PVS_LIH_BLS" 0x40 "PVS-LIH_1_PRE" 0x80 "PVS-LIH_2_PRE" /end COMPU_VTAB
/begin COMPU_VTAB RANGE_____00000019_TAB_NAME "" TAB_VERB 7 0x0 "SA_DIAG_START" 0x1 "SA_SAFM_MONIT" 0x2 "SA_MIN_DIAG" 0x3 "SA_WAIT_SAV_DIAG" 0x4 "SA_SAV_DIAG" 0x5 "SA_DIAG_END" 0x6 "SA_DIAG_CNL" /end COMPU_VTAB
/begin COMPU_VTAB RANGE_____00000018_TAB_NAME "" TAB_VERB 7 0x0 "NO_ERR" 0x1 "SAFM_ERR" 0x2 "SAP_SAFM_ERR" 0x3 "SAV_SAFM_ERR" 0x4 "MIN_SAF_ERR" 0x5 "SA_CONF_ERR" 0x6 "SAV_1_SAFM_ERR" /end COMPU_VTAB
/begin COMPU_VTAB STATE_T_SDL_CP_RANGE_TAB_NAME "" TAB_VERB 5 0x0 "T_CP_NOT_ACTIVE" 0x1 "T_CP_1_ACTIVE" 0x2 "T_CP_2_ACTIVE" 0x3 "T_CP_3_ACTIVE" 0x4 "T_TI_AD_ACTIVE" /end COMPU_VTAB
/begin COMPU_VTAB TPS_DIAG_TAB_NAME "" TAB_VERB 5 0x0 "TPS-NO ERROR" 0x1 "TPS-LIH_1" 0x2 "TPS-LIH_2" 0x4 "TPS-LIH_MAX" 0x8 "TPS-DBL ERROR" /end COMPU_VTAB
/begin COMPU_VTAB STATE_TQ_INTV_TAB_NAME "" TAB_VERB 6 0x0 "no intervention" 0x1 "ASR" 0x2 "MSR" 0x3 "LIM" 0x4 "GEAR" 0x5 "AMT" /end COMPU_VTAB
/begin COMPU_VTAB STATE_VARIANTEN_TAB_NAME "" TAB_VERB 64 0x0 "............................................" 0x1 ".......................................EGS" 0x2 "............................KOMBI......." 0x3 "............................KOMBI.EGS" 0x4 "........................ASC................." 0x5 "........................ASC............EGS" 0x6 "........................ASC.KOMBI......." 0x7 "........................ASC.KOMBI.EGS" 0x8 "..............KAT........................" 0x9 "..............KAT...................EGS" 0xa "..............KAT........KOMBI......." 0xb "..............KAT........KOMBI.EGS" 0xc "..............KAT....ASC................." 0xd "..............KAT....ASC............EGS" 0xe "..............KAT....ASC.KOMBI......." 0xf "..............KAT....ASC.KOMBI.EGS" 0x10 ".......ACC..............................." 0x11 ".......ACC..........................EGS" 0x12 ".......ACC...............KOMBI......." 0x13 ".......ACC...............KOMBI.EGS" 0x14 ".......ACC...........ASC................." 0x15 ".......ACC...........ASC............EGS" 0x16 ".......ACC...........ASC.KOMBI......." 0x17 ".......ACC...........ASC.KOMBI.EGS" 0x18 ".......ACC.KAT........................" 0x19 ".......ACC.KAT...................EGS" 0x1a ".......ACC.KAT........KOMBI......." 0x1b ".......ACC.KAT........KOMBI.EGS" 0x1c ".......ACC.KAT....ASC................." 0x1d ".......ACC.KAT....ASC............EGS" 0x1e ".......ACC.KAT....ASC.KOMBI......." 0x1f ".......ACC.KAT....ASC.KOMBI.EGS" 0x20 "MFL......................................" 0x21 "MFL.................................EGS" 0x22 "MFL......................KOMBI......." 0x23 "MFL......................KOMBI.EGS" 0x24 "MFL..................ASC................." 0x25 "MFL..................ASC............EGS" 0x26 "MFL..................ASC.KOMBI......." 0x27 "MFL..................ASC.KOMBI.EGS" 0x28 "MFL........KAT........................" 0x29 "MFL........KAT...................EGS" 0x2a "MFL........KAT........KOMBI......." 0x2b "MFL........KAT........KOMBI.EGS" 0x2c "MFL........KAT....ASC................." 0x2d "MFL........KAT....ASC............EGS" 0x2e "MFL........KAT....ASC.KOMBI......." 0x2f "MFL........KAT....ASC.KOMBI.EGS" 0x30 "MFL.ACC.............................." 0x31 "MFL.ACC...........................EGS" 0x32 "MFL.ACC...............KOMBI......." 0x33 "MFL.ACC...............KOMBI.EGS" 0x34 "MFL.ACC...........ASC................." 0x35 "MFL.ACC...........ASC............EGS" 0x36 "MFL.ACC...........ASC.KOMBI......." 0x37 "MFL.ACC...........ASC.KOMBI.EGS" 0x38 "MFL.ACC.KAT........................." 0x39 "MFL.ACC.KAT...................EGS" 0x3a "MFL.ACC.KAT........KOMBI......." 0x3b "MFL.ACC.KAT........KOMBI.EGS" 0x3c "MFL.ACC.KAT....ASC.................." 0x3d "MFL.ACC.KAT....ASC............EGS" 0x3e "MFL.ACC.KAT....ASC.KOMBI......." 0x3f "MFL.ACC.KAT....ASC.KOMBI.EGS" /end COMPU_VTAB
/begin COMPU_VTAB STATE_TPS_AD_TAB_NAME "" TAB_VERB 13 0x0 "CHK_LIH" 0x1 "AD_LIH" 0x2 "GO_UPPER_POS" 0x3 "CHK_LIH_SPRING_1" 0x4 "GO_LOWER_STOP" 0x5 "AD_MIN" 0x6 "CHK_LIH_SPRING_2" 0x7 "AD_END" 0x8 "GO_UPPER_POS_BAS" 0x9 "GO_LIH" 0xa "CHK_LIH_ST" 0xb "GO_UPPER_POS_ST" 0xc "CHK_LIH_SPRING_ST" /end COMPU_VTAB
/begin COMPU_VTAB RANGE________FL___1H__1H________ "" TAB_VERB 2 0x0 "" 0x1 "FL" /end COMPU_VTAB
/begin COMPU_VTAB STATE_VLS_MIX_TAB_NAME "" TAB_VERB 12 0x0 "CHK_NOT_START" 0x1 "CHK_1_NOT_FINISHED" 0x2 "CHK_2_NOT_FINISHED" 0x3 "CHK_OK" 0x4 "LS_UP_EXCHANGED" 0x5 "LS_DOWN_EXCHANGED" 0x6 "LS_UPDOWN_EXCHANGED" 0x7 "LS_UP_1_NOT_PLAUS" 0x8 "LS_UP_2_NOT_PLAUS" 0x9 "LS_DOWN_1_NOT_PLAUS" 0xa "LS_DOWN_2_NOT_PLAUS" 0xb "LS_NOT_PLAUS" /end COMPU_VTAB
/begin COMPU_VTAB RANGE________REAC___1H__1H______ "" TAB_VERB 2 0x0 "" 0x1 "REAC" /end COMPU_VTAB
/begin COMPU_VTAB RANGE________WUP___1H__1H_______ "" TAB_VERB 2 0x0 "" 0x1 "WUP" /end COMPU_VTAB
/end MODULE
/end PROJECT
