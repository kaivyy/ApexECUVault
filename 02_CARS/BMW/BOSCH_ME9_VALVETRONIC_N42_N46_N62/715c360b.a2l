ASAP2_VERSION 1 3
/begin PROJECT _715C360B "basisme9"
/begin HEADER "" VERSION "_715C360B" PROJECT_NO _715C360B /end HEADER
/begin MODULE DIM ""
/begin MOD_COMMON "" BYTE_ORDER MSB_FIRST ALIGNMENT_BYTE 1 ALIGNMENT_WORD 2 ALIGNMENT_LONG 2 ALIGNMENT_FLOAT32_IEEE 4 /end MOD_COMMON
/begin CHARACTERISTIC ANZSLPMX "" VALUE 0xFD0584 KwUb 255.0 dez 0.00 255.0 FORMAT "%5.1" /end CHARACTERISTIC
/begin CHARACTERISTIC APPTSOLETR "" VALUE 0xFCFACA KwUb 191.3 temp_ub_q0p75_o48 -48.00 143.3 FORMAT "%5.1" /end CHARACTERISTIC
/begin CHARACTERISTIC ASPRNOTL "" VALUE 0xFCB008 KwWU8 204.0 sprzi_q0p8 0.00 204.0 FORMAT "%5.1" /end CHARACTERISTIC
/begin CHARACTERISTIC ASPSAN "" CURVE 0xFCAF48 KlAxU8SstxU16WS16 52428.00 sprzi_q0p8 -26214.40 26213.60 FORMAT "%8.2"
 /begin AXIS_DESCR STD_AXIS nmot_w nmot_uw_q0p25 5 0.00 10000.00 FORMAT "%8.2" DEPOSIT ABSOLUTE /end AXIS_DESCR
/end CHARACTERISTIC
/begin CHARACTERISTIC CDAGR "Codewort DAGR abschalten (EURO-Codierung), CD..=0 -> keine Diagnose" VALUE 0xFC9AA0 KwUb 255.0 dez 0.00 255.0 FORMAT "%5.1" /end CHARACTERISTIC
/begin CHARACTERISTIC CDBKVP "Codewort zur Freigabe der Diagnose Bremskraftverst‰rker-Pumpe DBKVP" VALUE 0xFC9AA1 KwUb 255.0 dez 0.00 255.0 FORMAT "%5.1" /end CHARACTERISTIC
/begin CHARACTERISTIC CDDMTL "Codewort DMTL-Diagnose einschalten (EURO-Codierung), CD..=0 -> keine Dia" VALUE 0xFC9AA2 KwUb 255.0 dez 0.00 255.0 FORMAT "%5.1" /end CHARACTERISTIC
/begin CHARACTERISTIC CDDSBKV "Codewort f¸r %DDSBKV" VALUE 0xFC9AA3 KwUb 255.0 dez 0.00 255.0 FORMAT "%5.1" /end CHARACTERISTIC
/begin CHARACTERISTIC CDEFST "Codewort DFSTT abschalten (EURO-Codierung), CD..=0 -> keine Diagnose" VALUE 0xFC9AA4 KwUb 255.0 dez 0.00 255.0 FORMAT "%5.1" /end CHARACTERISTIC
/begin CHARACTERISTIC CDHSH "Codewort Heizerdiagnose hinter Kat (CDHSH = 0  => keine Diagnose)" VALUE 0xFC9AA5 KwUb 255.0 dez 0.00 255.0 FORMAT "%5.1" /end CHARACTERISTIC
/begin CHARACTERISTIC CDHSV "Codewort Heizerdiagnose vor Kat im (CDHSV = 0  => keine Diagnose)" VALUE 0xFC9AA6 KwUb 255.0 dez 0.00 255.0 FORMAT "%5.1" /end CHARACTERISTIC
/begin CHARACTERISTIC CDHSVSA "Codewort Heizerdiagnose vor Kat im Schub (CDHSVsa = 0  => keine Diagnose)" VALUE 0xFC9A8D KwWU8 255.0 dez 0.00 255.0 FORMAT "%5.1" /end CHARACTERISTIC
/begin CHARACTERISTIC CDKAT "Codewort Katalysator-Diagnose im OBDII-Mode (invers: Europa-Mode)" VALUE 0xFC9AA7 KwUb 255.0 dez 0.00 255.0 FORMAT "%5.1" /end CHARACTERISTIC
/begin CHARACTERISTIC CDKATSP "Codewort Katalysator-Diagnose im OBDII-Mode (invers: Europa-Mode)" VALUE 0xFC9A8E KwWU8 255.0 dez 0.00 255.0 FORMAT "%5.1" /end CHARACTERISTIC
/begin CHARACTERISTIC CDKVS "Codeword DKVS aktiv/inaktiv, CD..=0 -> keine Diagnose" VALUE 0xFC9AA8 KwUb 255.0 dez 0.00 255.0 FORMAT "%5.1" /end CHARACTERISTIC
/begin CHARACTERISTIC CDLASH "Codewort Lambdasondenalterungsdiagnose (SHK) im OBDII-Mode (invers: Europa-Mode)" VALUE 0xFC9AA9 KwUb 255.0 dez 0.00 255.0 FORMAT "%5.1" /end CHARACTERISTIC
/begin CHARACTERISTIC CDLATP "Codewort Lambdasondenalterungsdiagnose (TP) im OBDII-Mode (invers: Europa-Mode)" VALUE 0xFC9AAA KwUb 255.0 dez 0.00 255.0 FORMAT "%5.1" /end CHARACTERISTIC
/begin CHARACTERISTIC CDLATV "Codewort Lambdasondenalterungsdiagnose (tv) im OBDII-Mode (invers: Europa-Mode)" VALUE 0xFC9AAB KwUb 255.0 dez 0.00 255.0 FORMAT "%5.1" /end CHARACTERISTIC
/begin CHARACTERISTIC CDLDP "Codewort LDP-Diagnose im OBDII-Modus (invers: Europa-Modus), CD..=0 -> keine Dia" VALUE 0xFC9AAC KwUb 255.0 dez 0.00 255.0 FORMAT "%5.1" /end CHARACTERISTIC
/begin CHARACTERISTIC CDLLR "Codewort DLLR abschalten (EURO-Codierung), CD..=0 -> keine Diagnose" VALUE 0xFC9AAD KwUb 255.0 dez 0.00 255.0 FORMAT "%5.1" /end CHARACTERISTIC
/begin CHARACTERISTIC CDLSH "Codewort Sondendiagnose hinter Kat im OBDII-Mode (invers: Europa-Mode)" VALUE 0xFC9AAE KwUb 255.0 dez 0.00 255.0 FORMAT "%5.1" /end CHARACTERISTIC
/begin CHARACTERISTIC CDLSV "Codewort Sondendiagnose vor KAT im OBDII-Mode" VALUE 0xFC9AAF KwUb 255.0 dez 0.00 255.0 FORMAT "%5.1" /end CHARACTERISTIC
/begin CHARACTERISTIC CDLSVV "Codewort Diagnose vertauschte Sonden vor Kat im OBDII-Mode (invers: Europa-Mode)" VALUE 0xFC9AB0 KwUb 255.0 dez 0.00 255.0 FORMAT "%5.1" /end CHARACTERISTIC
/begin CHARACTERISTIC CDMD "Codewort DMD abschalten (EURO-Codierung), CD..=0 -> keine Diagnose" VALUE 0xFC9AB1 KwUb 255.0 dez 0.00 255.0 FORMAT "%5.1" /end CHARACTERISTIC
/begin CHARACTERISTIC CDNWS "Codewort DNWS abschalten (EURO-Codierung), CD..=0 -> keine Diagnose" VALUE 0xFC9A8F KwWU8 255.0 dez 0.00 255.0 FORMAT "%5.1" /end CHARACTERISTIC
/begin CHARACTERISTIC CDSLS "Euro-Byte f¸r Diagnose Sekund‰rluft-System" VALUE 0xFC9AB2 KwUb 255.0 dez 0.00 255.0 FORMAT "%5.1" /end CHARACTERISTIC
/begin CHARACTERISTIC CDSLSFZ "Codewort Fahrzeug mit Sekund‰rluftsystem" VALUE 0xFC9ABC KwUb 255.0 dez 0.00 255.0 FORMAT "%5.1" /end CHARACTERISTIC
/begin CHARACTERISTIC CDSWE "Codewort DSWE abschalten (EURO-Codierung), CD..=0 -> keine Diagnose" VALUE 0xFC9AB3 KwUb 255.0 dez 0.00 255.0 FORMAT "%5.1" /end CHARACTERISTIC
/begin CHARACTERISTIC CDTANKL "Codewort DTANKL abschalten (EURO-Codierung), CD..=0 -> keine Diagnose" VALUE 0xFC9AB4 KwUb 255.0 dez 0.00 255.0 FORMAT "%5.1" /end CHARACTERISTIC
/begin CHARACTERISTIC CDTES "Codewort Tankentl¸ftungsdiagnose abschalten (EURO-Codierung), CD..=0 ->keine Dia" VALUE 0xFC9AB5 KwUb 255.0 dez 0.00 255.0 FORMAT "%5.1" /end CHARACTERISTIC
/begin CHARACTERISTIC CODINDEX "Codierindex" VALUE 0xFCFAC9 KwUb 255.0 dez 0.00 255.0 FORMAT "%5.1" /end CHARACTERISTIC
/begin CHARACTERISTIC CWALE "Auslauferkennung aktiv" VALUE 0xFC9A90 KwWU8 255.0 dez 0.00 255.0 FORMAT "%5.1" /end CHARACTERISTIC
/begin CHARACTERISTIC CWDDISA "Codewort Diagnose Disa" VALUE 0xFC9A91 KwWU8 255.0 dez 0.00 255.0 FORMAT "%5.1" /end CHARACTERISTIC
/begin CHARACTERISTIC CWDSLSAD "" VALUE 0xFCFACB KwUb 255.0 dez 0.00 255.0 FORMAT "%5.1" /end CHARACTERISTIC
/begin CHARACTERISTIC CWERFIL "Codewort zur Auswahl Filtervar. f¸r die Ausgabe von AS.-Fehler an das Scan Tool" VALUE 0xFC9A92 KwWU8 255.0 dez 0.00 255.0 FORMAT "%5.1" /end CHARACTERISTIC
/begin CHARACTERISTIC CWFASL "Codewort: Testereingriff Sekund‰rluftdiagnose" VALUE 0xFD0585 KwUb 255.0 dez 0.00 255.0 FORMAT "%5.1" /end CHARACTERISTIC
/begin CHARACTERISTIC CWGEN1 "Codewort: kein Einfluss des Generatormomentes auf mdverl" VALUE 0xFC9A93 KwWU8 255.0 dez 0.00 255.0 FORMAT "%5.1" /end CHARACTERISTIC
/begin CHARACTERISTIC CWGEN2 "Codewort: kein Einfluss des Generatormomentes auf mimin" VALUE 0xFC9A94 KwWU8 255.0 dez 0.00 255.0 FORMAT "%5.1" /end CHARACTERISTIC
/begin CHARACTERISTIC CWKMMILSCT "Ausgabe ""Km bei MIL on""  f¸r Scan Tool abschalten (0 = keine Ausgabe in PID $21)" VALUE 0xFC9A95 KwWU8 255.0 dez 0.00 255.0 FORMAT "%5.1" /end CHARACTERISTIC
/begin CHARACTERISTIC CWKONABG "Codewort f¸r Konfiguration Abgasbehandlung" VALUE 0xFCFAC4 KwUb 255.0 dez 0.00 255.0 FORMAT "%5.1" /end CHARACTERISTIC
/begin CHARACTERISTIC CWKONFLS "Beschreibung der Lambdasondenposition hinter Katalysator im Abgasstrang" VALUE 0xFC9A96 KwWU8 255.0 dez 0.00 255.0 FORMAT "%5.1" /end CHARACTERISTIC
/begin CHARACTERISTIC CWKONLS "Codewort f¸r Konfiguration Lambda Sonden" VALUE 0xFC9A97 KwWU8 255.0 dez 0.00 255.0 FORMAT "%5.1" /end CHARACTERISTIC
/begin CHARACTERISTIC CWLROFF "Drehzahlschwelle f¸r Loadresp-Funktion des Generators ausschalten" VALUE 0xFC9ABD KwUb 255.0 dez 0.00 255.0 FORMAT "%5.1" /end CHARACTERISTIC
/begin CHARACTERISTIC CWLSHA "Codewort f¸r Lambdasonden hinter KAT Alterung in %DLSAHK" VALUE 0xFC9A98 KwWU8 255.0 dez 0.00 255.0 FORMAT "%5.1" /end CHARACTERISTIC
/begin CHARACTERISTIC CWMDAPP "Codewort Applikation ohne Drehmomentfunktionen" VALUE 0xFC9A99 KwWU8 255.0 dez 0.00 255.0 FORMAT "%5.1" /end CHARACTERISTIC
/begin CHARACTERISTIC CWNSABG "Codewort Einstellen Leerlauf-Solldrehzahl mit Diagnosetester" VALUE 0xFCFAC5 KwUb 255.0 dez 0.00 255.0 FORMAT "%5.1" /end CHARACTERISTIC
/begin CHARACTERISTIC CWOBD "Codewort f¸r Konfiguration OBD Zertifikationsnachweis" VALUE 0xFC9AB6 KwUb 255.0 dez 0.00 255.0 FORMAT "%5.1" /end CHARACTERISTIC
/begin CHARACTERISTIC CWPKAPP "Codewort Applikation Druckreferenz f¸r Kraftstoffdruckregler" VALUE 0xFC5618 KwWU8 255.0 dez 0.00 255.0 FORMAT "%5.1" /end CHARACTERISTIC
/begin CHARACTERISTIC CWPSGER "Codewort Umschaltung Saugrohrdruck von modelliertem auf gerechneten" VALUE 0xFC9A9A KwWU8 255.0 dez 0.00 255.0 FORMAT "%5.1" /end CHARACTERISTIC
/begin CHARACTERISTIC CWPWF "Codewort Powerfail" VALUE 0xFC9A9B KwWU8 255.0 dez 0.00 255.0 FORMAT "%5.1" /end CHARACTERISTIC
/begin CHARACTERISTIC CWRESTKH "" VALUE 0xFCB009 KwWU8 1.000 DEZ 0.00 1.000 FORMAT "%5.3" /end CHARACTERISTIC
/begin CHARACTERISTIC CWSCTMDE "Codewort zum abschalten bestimmter Scan Tool Modes/Services (Bit=0 ->  Mode aus)" VALUE 0xFC9A9C KwWU8 255.0 dez 0.00 255.0 FORMAT "%5.1" /end CHARACTERISTIC
/begin CHARACTERISTIC CWSLS "Codewort f¸r Sekund‰rluftsystem" VALUE 0xFC9AB7 KwUb 255.0 dez 0.00 255.0 FORMAT "%5.1" /end CHARACTERISTIC
/begin CHARACTERISTIC CWSLS2 "" VALUE 0xFC9AB8 KwUb 255.0 dez 0.00 255.0 FORMAT "%5.1" /end CHARACTERISTIC
/begin CHARACTERISTIC CWTF "Codewort f¸r Konfiguration Temperaturf¸hler" VALUE 0xFC9A9D KwWU8 255.0 dez 0.00 255.0 FORMAT "%5.1" /end CHARACTERISTIC
/begin CHARACTERISTIC CWUHR "Codewort f¸r Uhr" VALUE 0xFC9A9E KwWU8 255.0 dez 0.00 255.0 FORMAT "%5.1" /end CHARACTERISTIC
/begin CHARACTERISTIC CWVL "Erkennung Vollast ¸ber relativen Fahrerwunsch (CWVL=1)" VALUE 0xFC9A9F KwWU8 255.0 dez 0.00 255.0 FORMAT "%5.1" /end CHARACTERISTIC
/begin CHARACTERISTIC CW_RUNTIME "" VALUE 0xFC9AB9 KwWU8 255.0 default 0.00 255.0 FORMAT "%5.1" /end CHARACTERISTIC
/begin CHARACTERISTIC dataID "" ASCII 0xFC0210 KwbWU8 255.0 KennText 0.00 255.0 FORMAT "%5.1" NUMBER 51 /end CHARACTERISTIC
/begin CHARACTERISTIC DHUBMX "Maximalwert Hub Offset bei B_GDVHUB" VALUE 0xFC9ABA KwWU16 12.00000 hub_uw_q0p001 0.00 12.00000 FORMAT "%8.5" /end CHARACTERISTIC
/begin CHARACTERISTIC DNMOTGLUE "" VALUE 0xFCB00A KwWU8 10200. nmot_ub_q40 0.00 10200. FORMAT "%5.0" /end CHARACTERISTIC
/begin CHARACTERISTIC DPSLV "minimale Druckdifferenz Sekund‰rluftventi" VALUE 0xFD0586 KwUb 1275. p_ub_q5 0.00 1275. FORMAT "%5.0" /end CHARACTERISTIC
/begin CHARACTERISTIC DTEMN "Min-Schwelle f¸r delta effekt. Einspritzzeit" VALUE 0xFC5610 KwWU16 65.53500 t1p0usxms 0.00 65.53500 FORMAT "%8.5" /end CHARACTERISTIC
/begin CHARACTERISTIC DTMSPR "Temperaturhysterese f¸r Verstellung Ein- und Auslasspreizung" VALUE 0xFCB00B KwWU8 191.3 temp_ub_q0p75_o48 -48.00 143.3 FORMAT "%5.1" /end CHARACTERISTIC
/begin CHARACTERISTIC DWKRMGLUE "" VALUE 0xFCB00C KwWU8 191.3 zw_ub_q0p75 0.00 191.3 FORMAT "%5.1" /end CHARACTERISTIC
/begin CHARACTERISTIC ESPRNOTL "" VALUE 0xFCB00D KwWU8 204.0 sprzi_q0p8 0.00 204.0 FORMAT "%5.1" /end CHARACTERISTIC
/begin CHARACTERISTIC ESPSAN "" CURVE 0xFCAF5E KlAxU8SstxU16WS16 52428.00 sprzi_q0p8 -26214.40 26213.60 FORMAT "%8.2"
 /begin AXIS_DESCR STD_AXIS nmot_w nmot_uw_q0p25 5 0.00 10000.00 FORMAT "%8.2" DEPOSIT ABSOLUTE /end AXIS_DESCR
/end CHARACTERISTIC
/begin CHARACTERISTIC FASTW "Faktor Auslass teilgedrosselt warm" CURVE 0xFCAF88 KlAxU8SstxU8WU8 0.9961 fakspr_q0p0039 0.00 0.9961
 /begin AXIS_DESCR STD_AXIS tmot temp_ub_q0p75_o48 6 -48.00 143.3 FORMAT "%5.1" DEPOSIT ABSOLUTE /end AXIS_DESCR
/end CHARACTERISTIC
/begin CHARACTERISTIC FASW "Faktor Auslass ungedrosselt warm" CURVE 0xFCAF98 KlAxU8SstxU8WU8 0.9961 fakspr_q0p0039 0.00 0.9961
 /begin AXIS_DESCR STD_AXIS tmot temp_ub_q0p75_o48 6 -48.00 143.3 FORMAT "%5.1" DEPOSIT ABSOLUTE /end AXIS_DESCR
/end CHARACTERISTIC
/begin CHARACTERISTIC FASWLL "Wichtung Differenz Auslassspreizung kalt - warm im Leerlauf" CURVE 0xFCAFA8 KlAxU8SstxU8WU8 0.9961 fakspr_q0p0039 0.00 0.9961
 /begin AXIS_DESCR STD_AXIS tmot temp_ub_q0p75_o48 6 -48.00 143.3 FORMAT "%5.1" DEPOSIT ABSOLUTE /end AXIS_DESCR
/end CHARACTERISTIC
/begin CHARACTERISTIC FESTW "Faktor Einlass teilgedrosselt warm" CURVE 0xFCAFB8 KlAxU8SstxU8WU8 0.9961 fakspr_q0p0039 0.00 0.9961
 /begin AXIS_DESCR STD_AXIS tmot temp_ub_q0p75_o48 6 -48.00 143.3 FORMAT "%5.1" DEPOSIT ABSOLUTE /end AXIS_DESCR
/end CHARACTERISTIC
/begin CHARACTERISTIC FESW "Faktor Einlass ungedrosselt warm" CURVE 0xFCAFC8 KlAxU8SstxU8WU8 0.9961 fakspr_q0p0039 0.00 0.9961
 /begin AXIS_DESCR STD_AXIS tmot temp_ub_q0p75_o48 6 -48.00 143.3 FORMAT "%5.1" DEPOSIT ABSOLUTE /end AXIS_DESCR
/end CHARACTERISTIC
/begin CHARACTERISTIC FESWLL "Wichtung Differenz Einlassspreizung kalt - warm im Leerlauf" CURVE 0xFCAFD8 KlAxU8SstxU8WU8 0.9961 fakspr_q0p0039 0.00 0.9961
 /begin AXIS_DESCR STD_AXIS tmot temp_ub_q0p75_o48 6 -48.00 143.3 FORMAT "%5.1" DEPOSIT ABSOLUTE /end AXIS_DESCR
/end CHARACTERISTIC
/begin CHARACTERISTIC FKKVS "Korrekturfaktor Kraftstoffversorgungssystem" MAP 0xFC5488 KfAxU8AyU8SstxU16SstyU16WU16 2.000000 fak_uw_b16 0.00 2.000000 FORMAT "%8.6"
 /begin AXIS_DESCR STD_AXIS nmot nmot_ub_q40 10 0.00 10200. FORMAT "%5.0" DEPOSIT ABSOLUTE /end AXIS_DESCR
 /begin AXIS_DESCR STD_AXIS tevfa2_w t16p0usxms 10 0.00 524.2880 FORMAT "%8.4" DEPOSIT ABSOLUTE /end AXIS_DESCR
/end CHARACTERISTIC
/begin CHARACTERISTIC FMSL "Faktor Korrektur Sekund‰rluftmasse" VALUE 0xFD0587 KwUb 1.992 fak_ub_b2 0.00 1.992 FORMAT "%5.3" /end CHARACTERISTIC
/begin CHARACTERISTIC FMSLOFF "Schwelle Ausr‰umen der Sekund‰rluft beendet" VALUE 0xFD0588 KwUb 0.9961 fak_ub_b1 0.00 0.9961 /end CHARACTERISTIC
/begin CHARACTERISTIC FMSRHOL "Dichtekorrektur der Sekund‰rluftmasse" CURVE 0xFD0608 KlAUwSstUwWUw 1.999969 fak_uw_b2 0.00 1.999969 FORMAT "%8.6"
 /begin AXIS_DESCR STD_AXIS frhol_w fak_uw_b2 4 0.00 1.999969 FORMAT "%8.6" DEPOSIT ABSOLUTE /end AXIS_DESCR
/end CHARACTERISTIC
/begin CHARACTERISTIC FMSTMOT "tmot- Korrektur der Sekund‰rluftmasse" CURVE 0xFD058C KlAUbSstUbWUb 1.992 fak_ub_b2 0.00 1.992 FORMAT "%5.3"
 /begin AXIS_DESCR STD_AXIS tmot temp_ub_q0p75_o48 8 -48.00 143.3 FORMAT "%5.1" DEPOSIT ABSOLUTE /end AXIS_DESCR
/end CHARACTERISTIC
/begin CHARACTERISTIC FRHOKRSTTE "Einspritzkorrekutr bei hoher Kraftstofftemperatur" CURVE 0xFC557C KlAxU8SstxU16WS16 1.999969 fak_sw_b2x 0.00 1.999969 FORMAT "%8.6"
 /begin AXIS_DESCR STD_AXIS tkrst temp_ub_q0p75_o48 6 -48.00 143.3 FORMAT "%5.1" DEPOSIT ABSOLUTE /end AXIS_DESCR
/end CHARACTERISTIC
/begin CHARACTERISTIC FRLFSDP "Einspritzkorrektur bei RLFS" CURVE 0xFC5596 KlAxU8SstxS16WS16 1.999969 fak_sw_b2x 0.00 1.999969 FORMAT "%8.6"
 /begin AXIS_DESCR STD_AXIS dpus_w p_q0p039 11 -1280.000 1279.961 FORMAT "%8.3" DEPOSIT ABSOLUTE /end AXIS_DESCR
/end CHARACTERISTIC
/begin CHARACTERISTIC FZG_ON "Betrieb im Fahrzeug" VALUE 0xFCFAC6 KwUb 255.0 dez 0.00 255.0 FORMAT "%5.1" /end CHARACTERISTIC
/begin CHARACTERISTIC IMLSLMN "min. Verh‰ltnisfaktor psum_w/mlsu f¸r Einschaltung SLS" VALUE 0xFD059D KwUb 0.9961 fak_ub_b1 0.00 0.9961 /end CHARACTERISTIC
/begin CHARACTERISTIC IMLSLMX "max. Verh‰ltnisfaktor psum_w/mlsu f¸r Einschaltung SLS" VALUE 0xFD059E KwUb 0.9961 fak_ub_b1 0.00 0.9961 /end CHARACTERISTIC
/begin CHARACTERISTIC IMLSLSA "Schwelle Luftmassenintegral f¸r Anfang Sekund‰rluft im Abgas" VALUE 0xFD061A KwUw 4660.267 m_uw_b4660 0.00 4660.267 FORMAT "%8.3" /end CHARACTERISTIC
/begin CHARACTERISTIC IMLSLSE "Schwelle Luftmassenintegral f¸r Ende Sekund‰rluft im Abgas" VALUE 0xFD061C KwUw 4660.267 m_uw_b4660 0.00 4660.267 FORMAT "%8.3" /end CHARACTERISTIC
/begin CHARACTERISTIC KFALLW "Leerlauf Auslasspreizung gedrosselt warm" MAP 0xFC9D1C GkfWU8 204.0 sprzi_q0p8 0.00 204.0 FORMAT "%5.1"
 /begin AXIS_DESCR COM_AXIS nmot_w nmot_uw_q0p25 12 0.00 16383.75 FORMAT "%8.2" AXIS_PTS_REF RESTNMOT_W /end AXIS_DESCR
 /begin AXIS_DESCR COM_AXIS rlvwrstg_w rel_uw_q0p0234 12 0.00 1535.977 FORMAT "%8.3" AXIS_PTS_REF RESTRLVW_W /end AXIS_DESCR
/end CHARACTERISTIC
/begin CHARACTERISTIC KFASPGLUE "" MAP 0xFCA87C KfAxU8AyU8SstxU16SstyU16WU16 52428.00 sprzi_q0p8 0.00 52428.00 FORMAT "%8.2"
 /begin AXIS_DESCR STD_AXIS nmot_w nmot_uw_q0p25 4 0.00 16383.75 FORMAT "%8.2" DEPOSIT ABSOLUTE /end AXIS_DESCR
 /begin AXIS_DESCR STD_AXIS rl_w rel_uw_q0p0234 4 0.00 1535.977 FORMAT "%8.3" DEPOSIT ABSOLUTE /end AXIS_DESCR
/end CHARACTERISTIC
/begin CHARACTERISTIC KFDASTD "" MAP 0xFCFF82 KfAxUwAyUwSstxUwSstyUwWSw 52428.00 sprzi_q0p8 -26214.40 26213.60 FORMAT "%8.2"
 /begin AXIS_DESCR STD_AXIS minhub_w hub_uw_q0p001 8 0.00 65.53500 FORMAT "%8.5" DEPOSIT ABSOLUTE /end AXIS_DESCR
 /begin AXIS_DESCR STD_AXIS dpssol_uw p_q0p039 8 0.00 2559.961 FORMAT "%8.3" DEPOSIT ABSOLUTE /end AXIS_DESCR
/end CHARACTERISTIC
/begin CHARACTERISTIC KFDASTDLL "" MAP 0xFD0026 KfAxUwAyUwSstxUwSstyUwWSw 52428.00 sprzi_q0p8 -26214.40 26213.60 FORMAT "%8.2"
 /begin AXIS_DESCR STD_AXIS minhub_w hub_uw_q0p001 8 0.00 65.53500 FORMAT "%8.5" DEPOSIT ABSOLUTE /end AXIS_DESCR
 /begin AXIS_DESCR STD_AXIS dpssol_uw p_q0p039 8 0.00 2559.961 FORMAT "%8.3" DEPOSIT ABSOLUTE /end AXIS_DESCR
/end CHARACTERISTIC
/begin CHARACTERISTIC KFDESTD "" MAP 0xFD00CA KfAxUwAyUwSstxUwSstyUwWSw 52428.00 sprzi_q0p8 -26214.40 26213.60 FORMAT "%8.2"
 /begin AXIS_DESCR STD_AXIS minhub_w hub_uw_q0p001 8 0.00 65.53500 FORMAT "%8.5" DEPOSIT ABSOLUTE /end AXIS_DESCR
 /begin AXIS_DESCR STD_AXIS dpssol_uw p_q0p039 8 0.00 2559.961 FORMAT "%8.3" DEPOSIT ABSOLUTE /end AXIS_DESCR
/end CHARACTERISTIC
/begin CHARACTERISTIC KFDESTDLL "" MAP 0xFD016E KfAxUwAyUwSstxUwSstyUwWSw 52428.00 sprzi_q0p8 -26214.40 26213.60 FORMAT "%8.2"
 /begin AXIS_DESCR STD_AXIS minhub_w hub_uw_q0p001 8 0.00 65.53500 FORMAT "%8.5" DEPOSIT ABSOLUTE /end AXIS_DESCR
 /begin AXIS_DESCR STD_AXIS dpssol_uw p_q0p039 8 0.00 2559.961 FORMAT "%8.3" DEPOSIT ABSOLUTE /end AXIS_DESCR
/end CHARACTERISTIC
/begin CHARACTERISTIC KFELLW "Leerlauf Einlasspreizung gedrosselt warm" MAP 0xFC9DAC GkfWU8 204.0 sprzi_q0p8 0.00 204.0 FORMAT "%5.1"
 /begin AXIS_DESCR COM_AXIS nmot_w nmot_uw_q0p25 12 0.00 16383.75 FORMAT "%8.2" AXIS_PTS_REF RESTNMOT_W /end AXIS_DESCR
 /begin AXIS_DESCR COM_AXIS rlvwrstg_w rel_uw_q0p0234 12 0.00 1535.977 FORMAT "%8.3" AXIS_PTS_REF RESTRLVW_W /end AXIS_DESCR
/end CHARACTERISTIC
/begin CHARACTERISTIC KFESPGLUE "" MAP 0xFCA8B0 KfAxU8AyU8SstxU16SstyU16WU16 52428.00 sprzi_q0p8 0.00 52428.00 FORMAT "%8.2"
 /begin AXIS_DESCR STD_AXIS nmot_w nmot_uw_q0p25 4 0.00 16383.75 FORMAT "%8.2" DEPOSIT ABSOLUTE /end AXIS_DESCR
 /begin AXIS_DESCR STD_AXIS rl_w rel_uw_q0p0234 4 0.00 1535.977 FORMAT "%8.3" DEPOSIT ABSOLUTE /end AXIS_DESCR
/end CHARACTERISTIC
/begin CHARACTERISTIC KFFMSML "Abgasgegendruckkorrektur der Sekund‰rluftmasse" MAP 0xFD05A0 KfAxUbAyUbSstxUbSstyUbWUb 1.992 fak_ub_b2 0.00 1.992 FORMAT "%5.3"
 /begin AXIS_DESCR STD_AXIS nmot nmot_ub_q40 8 0.00 10200. FORMAT "%5.0" DEPOSIT ABSOLUTE /end AXIS_DESCR
 /begin AXIS_DESCR STD_AXIS rl rel_ub_q0p75 8 0.00 191.3 FORMAT "%5.1" DEPOSIT ABSOLUTE /end AXIS_DESCR
/end CHARACTERISTIC
/begin CHARACTERISTIC KFKALLW "Leerlauf Auslasspreizung gedrosselt kalt zum Katheizen" MAP 0xFC9E3C GkfWU8 204.0 sprzi_q0p8 0.00 204.0 FORMAT "%5.1"
 /begin AXIS_DESCR COM_AXIS nmot_w nmot_uw_q0p25 12 0.00 16383.75 FORMAT "%8.2" AXIS_PTS_REF RESTNMOT_W /end AXIS_DESCR
 /begin AXIS_DESCR COM_AXIS rlvwrstg_w rel_uw_q0p0234 12 0.00 1535.977 FORMAT "%8.3" AXIS_PTS_REF RESTRLVW_W /end AXIS_DESCR
/end CHARACTERISTIC
/begin CHARACTERISTIC KFKASLL "Auslassspreizung kalt ungedrosselt im Leerlauf" MAP 0xFCA8E4 KfAxUbAyUbSstxUwSstyUwWUw 204.0000 sprzi_q0p8 0.00 204.0000 FORMAT "%8.4"
 /begin AXIS_DESCR STD_AXIS nmot_w nmot_uw_q0p25 12 0.00 16383.75 FORMAT "%8.2" DEPOSIT ABSOLUTE /end AXIS_DESCR
 /begin AXIS_DESCR STD_AXIS rlvwrstg_w rel_uw_q0p0234 5 0.00 1535.977 FORMAT "%8.3" DEPOSIT ABSOLUTE /end AXIS_DESCR
/end CHARACTERISTIC
/begin CHARACTERISTIC KFKASOPT "optimale Auslasspreizung kalt teilgedrosselt" MAP 0xFC9ECC GkfWU8 204.0 sprzi_q0p8 0.00 204.0 FORMAT "%5.1"
 /begin AXIS_DESCR COM_AXIS nmot_w nmot_uw_q0p25 16 0.00 16383.75 FORMAT "%8.2" AXIS_PTS_REF RESTNMOT16T /end AXIS_DESCR
 /begin AXIS_DESCR COM_AXIS rlvwrstg_w rel_uw_q0p0234 16 0.00 1535.977 FORMAT "%8.3" AXIS_PTS_REF RESTRLVW16 /end AXIS_DESCR
/end CHARACTERISTIC
/begin CHARACTERISTIC KFKASOPU "optimale Auslasspreizung kalt ungedrosselt" MAP 0xFC9FCC GkfWU8 204.0 sprzi_q0p8 0.00 204.0 FORMAT "%5.1"
 /begin AXIS_DESCR COM_AXIS nmot_w nmot_uw_q0p25 16 0.00 16383.75 FORMAT "%8.2" AXIS_PTS_REF RESTNMOT16 /end AXIS_DESCR
 /begin AXIS_DESCR COM_AXIS rlvwrstg_w rel_uw_q0p0234 16 0.00 1535.977 FORMAT "%8.3" AXIS_PTS_REF RESTRLVW16 /end AXIS_DESCR
/end CHARACTERISTIC
/begin CHARACTERISTIC KFKASVL "" MAP 0xFCA982 KfAxU8AyU8SstxU16SstyU16WU16 204.0000 sprzi_q0p8 0.00 204.0000 FORMAT "%8.4"
 /begin AXIS_DESCR STD_AXIS nmot_w nmot_uw_q0p25 16 0.00 16383.75 FORMAT "%8.2" DEPOSIT ABSOLUTE /end AXIS_DESCR
 /begin AXIS_DESCR STD_AXIS wkrm zw_ub_qn0p75 2 -191.3 0.00 FORMAT "%5.1" DEPOSIT ABSOLUTE /end AXIS_DESCR
/end CHARACTERISTIC
/begin CHARACTERISTIC KFKASVLT "" MAP 0xFCA9EA KfAxU8AyU8SstxU16SstyU16WU16 204.0000 sprzi_q0p8 0.00 204.0000 FORMAT "%8.4"
 /begin AXIS_DESCR STD_AXIS nmot_w nmot_uw_q0p25 16 0.00 16383.75 FORMAT "%8.2" DEPOSIT ABSOLUTE /end AXIS_DESCR
 /begin AXIS_DESCR STD_AXIS wkrm zw_ub_qn0p75 2 -191.3 0.00 FORMAT "%5.1" DEPOSIT ABSOLUTE /end AXIS_DESCR
/end CHARACTERISTIC
/begin CHARACTERISTIC KFKELLW "Leerlauf Einlasspreizung gedrosselt kalt zum Katheizen" MAP 0xFCA0CC GkfWU8 204.0 sprzi_q0p8 0.00 204.0 FORMAT "%5.1"
 /begin AXIS_DESCR COM_AXIS nmot_w nmot_uw_q0p25 12 0.00 16383.75 FORMAT "%8.2" AXIS_PTS_REF RESTNMOT_W /end AXIS_DESCR
 /begin AXIS_DESCR COM_AXIS rlvwrstg_w rel_uw_q0p0234 12 0.00 1535.977 FORMAT "%8.3" AXIS_PTS_REF RESTRLVW_W /end AXIS_DESCR
/end CHARACTERISTIC
/begin CHARACTERISTIC KFKESLL "Einlassspreizung kalt ungedrosselt im Leerlauf" MAP 0xFCAA52 KfAxUbAyUbSstxUwSstyUwWUw 204.0000 sprzi_q0p8 0.00 204.0000 FORMAT "%8.4"
 /begin AXIS_DESCR STD_AXIS nmot_w nmot_uw_q0p25 12 0.00 16383.75 FORMAT "%8.2" DEPOSIT ABSOLUTE /end AXIS_DESCR
 /begin AXIS_DESCR STD_AXIS rlvwrstg_w rel_uw_q0p0234 5 0.00 1535.977 FORMAT "%8.3" DEPOSIT ABSOLUTE /end AXIS_DESCR
/end CHARACTERISTIC
/begin CHARACTERISTIC KFKESOPT "optimale Einlasspreizung kalt teilgedrosselt" MAP 0xFCA15C GkfWU8 204.0 sprzi_q0p8 0.00 204.0 FORMAT "%5.1"
 /begin AXIS_DESCR COM_AXIS nmot_w nmot_uw_q0p25 16 0.00 16383.75 FORMAT "%8.2" AXIS_PTS_REF RESTNMOT16T /end AXIS_DESCR
 /begin AXIS_DESCR COM_AXIS rlvwrstg_w rel_uw_q0p0234 16 0.00 1535.977 FORMAT "%8.3" AXIS_PTS_REF RESTRLVW16 /end AXIS_DESCR
/end CHARACTERISTIC
/begin CHARACTERISTIC KFKESOPU "optimale Einlasspreizung kalt ungedrosselt" MAP 0xFCA25C GkfWU8 204.0 sprzi_q0p8 0.00 204.0 FORMAT "%5.1"
 /begin AXIS_DESCR COM_AXIS nmot_w nmot_uw_q0p25 16 0.00 16383.75 FORMAT "%8.2" AXIS_PTS_REF RESTNMOT16 /end AXIS_DESCR
 /begin AXIS_DESCR COM_AXIS rlvwrstg_w rel_uw_q0p0234 16 0.00 1535.977 FORMAT "%8.3" AXIS_PTS_REF RESTRLVW16 /end AXIS_DESCR
/end CHARACTERISTIC
/begin CHARACTERISTIC KFKESVL "" MAP 0xFCAAF0 KfAxU8AyU8SstxU16SstyU16WU16 204.0000 sprzi_q0p8 0.00 204.0000 FORMAT "%8.4"
 /begin AXIS_DESCR STD_AXIS nmot_w nmot_uw_q0p25 16 0.00 16383.75 FORMAT "%8.2" DEPOSIT ABSOLUTE /end AXIS_DESCR
 /begin AXIS_DESCR STD_AXIS wkrm zw_ub_qn0p75 2 -191.3 0.00 FORMAT "%5.1" DEPOSIT ABSOLUTE /end AXIS_DESCR
/end CHARACTERISTIC
/begin CHARACTERISTIC KFKESVLT "" MAP 0xFCAB58 KfAxU8AyU8SstxU16SstyU16WU16 204.0000 sprzi_q0p8 0.00 204.0000 FORMAT "%8.4"
 /begin AXIS_DESCR STD_AXIS nmot_w nmot_uw_q0p25 16 0.00 16383.75 FORMAT "%8.2" DEPOSIT ABSOLUTE /end AXIS_DESCR
 /begin AXIS_DESCR STD_AXIS wkrm zw_ub_qn0p75 2 -191.3 0.00 FORMAT "%5.1" DEPOSIT ABSOLUTE /end AXIS_DESCR
/end CHARACTERISTIC
/begin CHARACTERISTIC KFMDST "Startmoment" MAP 0xFC70E2 KfAxUbAyUbSstxUbSstyUwWUw 199.9969 rel_uw_b200 0.00 199.9969 FORMAT "%8.4"
 /begin AXIS_DESCR STD_AXIS tmot temp_ub_q0p75_o48 8 -48.00 143.3 FORMAT "%5.1" DEPOSIT ABSOLUTE /end AXIS_DESCR
 /begin AXIS_DESCR STD_AXIS qnst_w fak_uw_b2 8 0.00 1.999969 FORMAT "%8.6" DEPOSIT ABSOLUTE /end AXIS_DESCR
/end CHARACTERISTIC
/begin CHARACTERISTIC KFWALLW "Leerlauf Auslasspreizung gedrosselt warm zum Katheizen""" MAP 0xFCA35C GkfWU8 204.0 sprzi_q0p8 0.00 204.0 FORMAT "%5.1"
 /begin AXIS_DESCR COM_AXIS nmot_w nmot_uw_q0p25 12 0.00 16383.75 FORMAT "%8.2" AXIS_PTS_REF RESTNMOT_W /end AXIS_DESCR
 /begin AXIS_DESCR COM_AXIS rlvwrstg_w rel_uw_q0p0234 12 0.00 1535.977 FORMAT "%8.3" AXIS_PTS_REF RESTRLVW_W /end AXIS_DESCR
/end CHARACTERISTIC
/begin CHARACTERISTIC KFWASLL "" MAP 0xFCABC0 KfAxUbAyUbSstxUwSstyUwWUw 204.0000 sprzi_q0p8 0.00 204.0000 FORMAT "%8.4"
 /begin AXIS_DESCR STD_AXIS nmot_w nmot_uw_q0p25 12 0.00 16383.75 FORMAT "%8.2" DEPOSIT ABSOLUTE /end AXIS_DESCR
 /begin AXIS_DESCR STD_AXIS rlvwrstg_w rel_uw_q0p0234 5 0.00 1535.977 FORMAT "%8.3" DEPOSIT ABSOLUTE /end AXIS_DESCR
/end CHARACTERISTIC
/begin CHARACTERISTIC KFWASOPT "optimale Auslasspreizung warm teilgedrosselt" MAP 0xFCA3EC GkfWU8 204.0 sprzi_q0p8 0.00 204.0 FORMAT "%5.1"
 /begin AXIS_DESCR COM_AXIS nmot_w nmot_uw_q0p25 16 0.00 16383.75 FORMAT "%8.2" AXIS_PTS_REF RESTNMOT16T /end AXIS_DESCR
 /begin AXIS_DESCR COM_AXIS rlvwrstg_w rel_uw_q0p0234 16 0.00 1535.977 FORMAT "%8.3" AXIS_PTS_REF RESTRLVW16 /end AXIS_DESCR
/end CHARACTERISTIC
/begin CHARACTERISTIC KFWASOPU "optimale Auslasspreizung warm ungedrosselt" MAP 0xFCA4EC GkfWU8 204.0 sprzi_q0p8 0.00 204.0 FORMAT "%5.1"
 /begin AXIS_DESCR COM_AXIS nmot_w nmot_uw_q0p25 16 0.00 16383.75 FORMAT "%8.2" AXIS_PTS_REF RESTNMOT16 /end AXIS_DESCR
 /begin AXIS_DESCR COM_AXIS rlvwrstg_w rel_uw_q0p0234 16 0.00 1535.977 FORMAT "%8.3" AXIS_PTS_REF RESTRLVW16 /end AXIS_DESCR
/end CHARACTERISTIC
/begin CHARACTERISTIC KFWASVL "Auslasspreizung Vollast abh‰ngig von Drehzahl und Klopfst‰rke" MAP 0xFCAC5E KfAxU8AyU8SstxU16SstyU16WU16 204.0000 sprzi_q0p8 0.00 204.0000 FORMAT "%8.4"
 /begin AXIS_DESCR STD_AXIS nmot_w nmot_uw_q0p25 16 0.00 16383.75 FORMAT "%8.2" DEPOSIT ABSOLUTE /end AXIS_DESCR
 /begin AXIS_DESCR STD_AXIS wkrm zw_ub_qn0p75 2 -191.3 0.00 FORMAT "%5.1" DEPOSIT ABSOLUTE /end AXIS_DESCR
/end CHARACTERISTIC
/begin CHARACTERISTIC KFWASVLT "Kennfeld Vollastspreizung gedrosselt (Auslaﬂseite)" MAP 0xFCACC6 KfAxU8AyU8SstxU16SstyU16WU16 204.0000 sprzi_q0p8 0.00 204.0000 FORMAT "%8.4"
 /begin AXIS_DESCR STD_AXIS nmot_w nmot_uw_q0p25 16 0.00 16383.75 FORMAT "%8.2" DEPOSIT ABSOLUTE /end AXIS_DESCR
 /begin AXIS_DESCR STD_AXIS wkrm zw_ub_qn0p75 2 -191.3 0.00 FORMAT "%5.1" DEPOSIT ABSOLUTE /end AXIS_DESCR
/end CHARACTERISTIC
/begin CHARACTERISTIC KFWELLW "Leerlauf Einlasspreizung gedrosselt warm zum Katheizen" MAP 0xFCA5EC GkfWU8 204.0 sprzi_q0p8 0.00 204.0 FORMAT "%5.1"
 /begin AXIS_DESCR COM_AXIS nmot_w nmot_uw_q0p25 12 0.00 16383.75 FORMAT "%8.2" AXIS_PTS_REF RESTNMOT_W /end AXIS_DESCR
 /begin AXIS_DESCR COM_AXIS rlvwrstg_w rel_uw_q0p0234 12 0.00 1535.977 FORMAT "%8.3" AXIS_PTS_REF RESTRLVW_W /end AXIS_DESCR
/end CHARACTERISTIC
/begin CHARACTERISTIC KFWESLL "" MAP 0xFCAD2E KfAxUbAyUbSstxUwSstyUwWUw 204.0000 sprzi_q0p8 0.00 204.0000 FORMAT "%8.4"
 /begin AXIS_DESCR STD_AXIS nmot_w nmot_uw_q0p25 12 0.00 16383.75 FORMAT "%8.2" DEPOSIT ABSOLUTE /end AXIS_DESCR
 /begin AXIS_DESCR STD_AXIS rlvwrstg_w rel_uw_q0p0234 5 0.00 1535.977 FORMAT "%8.3" DEPOSIT ABSOLUTE /end AXIS_DESCR
/end CHARACTERISTIC
/begin CHARACTERISTIC KFWESOPT "optimale Einlasspreizung warm teilgedrosselt" MAP 0xFCA67C GkfWU8 204.0 sprzi_q0p8 0.00 204.0 FORMAT "%5.1"
 /begin AXIS_DESCR COM_AXIS nmot_w nmot_uw_q0p25 16 0.00 16383.75 FORMAT "%8.2" AXIS_PTS_REF RESTNMOT16T /end AXIS_DESCR
 /begin AXIS_DESCR COM_AXIS rlvwrstg_w rel_uw_q0p0234 16 0.00 1535.977 FORMAT "%8.3" AXIS_PTS_REF RESTRLVW16 /end AXIS_DESCR
/end CHARACTERISTIC
/begin CHARACTERISTIC KFWESOPU "optimale Einlasspreizung warm ungedrosselt" MAP 0xFCA77C GkfWU8 204.0 sprzi_q0p8 0.00 204.0 FORMAT "%5.1"
 /begin AXIS_DESCR COM_AXIS nmot_w nmot_uw_q0p25 16 0.00 16383.75 FORMAT "%8.2" AXIS_PTS_REF RESTNMOT16 /end AXIS_DESCR
 /begin AXIS_DESCR COM_AXIS rlvwrstg_w rel_uw_q0p0234 16 0.00 1535.977 FORMAT "%8.3" AXIS_PTS_REF RESTRLVW16 /end AXIS_DESCR
/end CHARACTERISTIC
/begin CHARACTERISTIC KFWESVL "Einlasspreizung Vollast abh‰ngig von Drehzahl und Klopfst‰rke" MAP 0xFCADCC KfAxU8AyU8SstxU16SstyU16WU16 204.0000 sprzi_q0p8 0.00 204.0000 FORMAT "%8.4"
 /begin AXIS_DESCR STD_AXIS nmot_w nmot_uw_q0p25 16 0.00 16383.75 FORMAT "%8.2" DEPOSIT ABSOLUTE /end AXIS_DESCR
 /begin AXIS_DESCR STD_AXIS wkrm zw_ub_qn0p75 2 -191.3 0.00 FORMAT "%5.1" DEPOSIT ABSOLUTE /end AXIS_DESCR
/end CHARACTERISTIC
/begin CHARACTERISTIC KFWESVLT "Kennfeld Vollastspreizung gedrosselt (Einlaﬂseite)" MAP 0xFCAE34 KfAxU8AyU8SstxU16SstyU16WU16 204.0000 sprzi_q0p8 0.00 204.0000 FORMAT "%8.4"
 /begin AXIS_DESCR STD_AXIS nmot_w nmot_uw_q0p25 16 0.00 16383.75 FORMAT "%8.2" DEPOSIT ABSOLUTE /end AXIS_DESCR
 /begin AXIS_DESCR STD_AXIS wkrm zw_ub_qn0p75 2 -191.3 0.00 FORMAT "%5.1" DEPOSIT ABSOLUTE /end AXIS_DESCR
/end CHARACTERISTIC
/begin CHARACTERISTIC KFWNWLL "Wichtungsfaktor zur Ausw. der LL KF im Normalbetr. oder zum Katheizen" MAP 0xFCAE9C KfAxU8AyU8SstxU16SstyU16WU16 0.9960938 fakspr_q0p0039 0.00 0.9960938 FORMAT "%9.7"
 /begin AXIS_DESCR STD_AXIS tmot temp_ub_q0p75_o48 4 -48.00 143.3 FORMAT "%5.1" DEPOSIT ABSOLUTE /end AXIS_DESCR
 /begin AXIS_DESCR STD_AXIS tnst_w t10msxs_uw_b655p35 6 0.00 655.3500 FORMAT "%8.4" DEPOSIT ABSOLUTE /end AXIS_DESCR
/end CHARACTERISTIC
/begin CHARACTERISTIC KFWNWLLKH "Wichtungsfaktor zur Ausw. der LL Kennfelder zum Katheizen kalt/warm" MAP 0xFCAEE4 KfAxU8AyU8SstxU16SstyU16WU16 0.9960938 fakspr_q0p0039 0.00 0.9960938 FORMAT "%9.7"
 /begin AXIS_DESCR STD_AXIS tmot temp_ub_q0p75_o48 6 -48.00 143.3 FORMAT "%5.1" DEPOSIT ABSOLUTE /end AXIS_DESCR
 /begin AXIS_DESCR STD_AXIS tnst_w t10msxs_uw_b655p35 6 0.00 655.3500 FORMAT "%8.4" DEPOSIT ABSOLUTE /end AXIS_DESCR
/end CHARACTERISTIC
/begin CHARACTERISTIC KLASPVZ "Einschaltverzˆgerung Auslass abh‰ngig von tmot" CURVE 0xFCAFE8 KlAxU8SstxU8WU8 255.0 dez 0.00 255.0 FORMAT "%5.1"
 /begin AXIS_DESCR STD_AXIS tmot temp_ub_q0p75_o48 5 -48.00 143.3 FORMAT "%5.1" DEPOSIT ABSOLUTE /end AXIS_DESCR
/end CHARACTERISTIC
/begin CHARACTERISTIC KLESPVZ "Einschaltverzˆgerung Einlass abh‰ngig von tmot""" CURVE 0xFCAFF4 KlAxU8SstxU8WU8 255.0 DEZ 0.00 255.0 FORMAT "%5.1"
 /begin AXIS_DESCR STD_AXIS tmot temp_ub_q0p75_o48 5 -48.00 143.3 FORMAT "%5.1" DEPOSIT ABSOLUTE /end AXIS_DESCR
/end CHARACTERISTIC
/begin CHARACTERISTIC KLKRKTE "Kennlinie f¸r Umrechnung rel. Kraftstoffmasse in eff. Einspritzzeit" CURVE 0xFC55C4 KlAxU8SstxU16WU16 0.5000000 rkt_uw_b0p5 0.00 0.5000000 FORMAT "%9.7"
 /begin AXIS_DESCR STD_AXIS rk_w rel_uw_b3072 12 0.00 3071.953 FORMAT "%8.3" DEPOSIT ABSOLUTE /end AXIS_DESCR
/end CHARACTERISTIC
/begin CHARACTERISTIC KLRLSLSMX "" CURVE 0xFD061E KlAUbSstUbWUw 1535.977 rel_uw_q0p0234 0.00 1535.977 FORMAT "%8.3"
 /begin AXIS_DESCR STD_AXIS nmot nmot_ub_q40 5 0.00 10200. FORMAT "%5.0" DEPOSIT ABSOLUTE /end AXIS_DESCR
/end CHARACTERISTIC
/begin CHARACTERISTIC KLTSLMX "BMW" CURVE 0xFD062E KlAUbSstUbWUw 655.3500 t10msxs_uw_b655p35 0.00 655.3500 FORMAT "%8.4"
 /begin AXIS_DESCR STD_AXIS tmst temp_ub_q0p75_o48 8 -48.00 143.3 FORMAT "%5.1" DEPOSIT ABSOLUTE /end AXIS_DESCR
/end CHARACTERISTIC
/begin CHARACTERISTIC MDAPPAS "Schalter Applikation Auslass" VALUE 0xFCB00E KwWU8 255.0 dez 0.00 255.0 FORMAT "%5.1" /end CHARACTERISTIC
/begin CHARACTERISTIC MDAPPES "Schalter Applikation Einlass" VALUE 0xFCB00F KwWU8 255.0 dez 0.00 255.0 FORMAT "%5.1" /end CHARACTERISTIC
/begin CHARACTERISTIC MLSLMX "max. Motor-Luftmasse f¸r Sekund‰rlufteinblasung" VALUE 0xFD0648 KwUw 6553.500 m_q0p1 0.00 6553.500 FORMAT "%8.3" /end CHARACTERISTIC
/begin CHARACTERISTIC MSLUB "Sekund‰rluftmasse abh‰ngig von der Batteriespannung" CURVE 0xFD064A KlAUwSstUwWUw 102.3984 m_uw_b102p4 0.00 102.3984 FORMAT "%8.4"
 /begin AXIS_DESCR STD_AXIS ubsqf_w spg_q0p00039 8 0.00 25.59961 FORMAT "%8.5" DEPOSIT ABSOLUTE /end AXIS_DESCR
/end CHARACTERISTIC
/begin CHARACTERISTIC NMOTGLUE "" VALUE 0xFCB010 KwWU8 10200. nmot_ub_q40 0.00 10200. FORMAT "%5.0" /end CHARACTERISTIC
/begin CHARACTERISTIC NSWO "Drehzahlschwelle Umschaltg. zur Rechenzeitersparnis" VALUE 0xFCFAC7 KwUb 10200. nmot_ub_q40 0.00 10200. FORMAT "%5.0" /end CHARACTERISTIC
/begin CHARACTERISTIC NSWO1 "Drehzahlschwelle 1 Umschaltg. zur Rechenzeitersparnis" VALUE 0xFCFAC8 KwUb 10200. nmot_ub_q40 0.00 10200. FORMAT "%5.0" /end CHARACTERISTIC
/begin CHARACTERISTIC OFASPRAP "Offset Applikation Auslass" VALUE 0xFCB000 KwWS16 360.0000 sprzi_q0p8 -180.0000 180.0000 FORMAT "%8.4" /end CHARACTERISTIC
/begin CHARACTERISTIC OFESPRAP "Offset Applikation Einlass" VALUE 0xFCB002 KwWS16 360.0000 sprzi_q0p8 -180.0000 180.0000 FORMAT "%8.4" /end CHARACTERISTIC
/begin CHARACTERISTIC PSAPES "Saugrohrdruck f¸r Applikation Einspritzung" VALUE 0xFC5612 KwWU16 2559.961 p_q0p039 0.00 2559.961 FORMAT "%8.3" /end CHARACTERISTIC
/begin CHARACTERISTIC PT1SPR "" VALUE 0xFCB011 KwWU8 0.9961 fak_ub_b1 0.00 0.9961 /end CHARACTERISTIC
/begin AXIS_PTS RESTNMOT16 "" 0xFCB01A nmot_w SstAU8SstU16 16383.75 nmot_uw_q0p25 16 0.00 16383.75 FORMAT "%8.2" DEPOSIT ABSOLUTE /end AXIS_PTS
/begin AXIS_PTS RESTNMOT16T "" 0xFCB03C nmot_w SstAU8SstU16 16383.75 nmot_uw_q0p25 16 0.00 16383.75 FORMAT "%8.2" DEPOSIT ABSOLUTE /end AXIS_PTS
/begin AXIS_PTS RESTNMOT_W "" 0xFCB05E nmot_w SstAU8SstU16 16383.75 nmot_uw_q0p25 12 0.00 16383.75 FORMAT "%8.2" DEPOSIT ABSOLUTE /end AXIS_PTS
/begin AXIS_PTS RESTRLVW16 "" 0xFCB078 rlvwrstg_w SstAU8SstU16 1535.977 rel_uw_q0p0234 16 0.00 1535.977 FORMAT "%8.3" DEPOSIT ABSOLUTE /end AXIS_PTS
/begin AXIS_PTS RESTRLVW_W "" 0xFCB09A rlvwrstg_w SstAU8SstU16 1535.977 rel_uw_q0p0234 12 0.00 1535.977 FORMAT "%8.3" DEPOSIT ABSOLUTE /end AXIS_PTS
/begin AXIS_PTS SAN12ESUW "SST-Verteilung f¸r den begrenzten Einspritzz‰hler anztib_w" 0xFC1122 anztib_w SstAUwSstUw 65535.00 dez 12 0.00 65535.00 FORMAT "%8.2" DEPOSIT ABSOLUTE /end AXIS_PTS
/begin AXIS_PTS SEH06KRUW "St¸tzstellenverteilung evhubi_w, 6 Sst." 0xFCC8DA evhubi_w SstASwSstSw 65.53500 hub_uw_q0p001 6 0.00 65.53500 FORMAT "%8.5" DEPOSIT ABSOLUTE /end AXIS_PTS
/begin AXIS_PTS SEZ06TMUB "St¸tzstellenverteilung, Z¸ndwinkelwirkungsgrad" 0xFCC7DC etazwimt SstAUbSstUb 127.5 rel_ub_b127p5 6 0.00 127.5 FORMAT "%5.1" DEPOSIT ABSOLUTE /end AXIS_PTS
/begin AXIS_PTS SFR04BBUW "" 0xFC0ED4 frhol_w SstAU8SstU16 1.999969 fak_uw_b2 4 0.00 1.999969 FORMAT "%8.6" DEPOSIT ABSOLUTE /end AXIS_PTS
/begin AXIS_PTS SFR08TEUB "" 0xFCC7E4 frmit SstAUbSstUb 1.992 fak_ub_b2 8 0.00 1.992 FORMAT "%5.3" DEPOSIT ABSOLUTE /end AXIS_PTS
/begin AXIS_PTS SGA07MDUB "Gruppenst¸tzstelle Gangabh‰ngig" 0xFC0F64 gangi SstAUbSstUb 255.0 dez 7 0.00 255.0 FORMAT "%5.1" DEPOSIT ABSOLUTE /end AXIS_PTS
/begin AXIS_PTS SGA08MDUB "St¸tzstellenverteilung Ist Gang 8 Sst." 0xFC0F6C gangi SstAUbSstUb 255.0 dez 8 0.00 255.0 FORMAT "%5.1" DEPOSIT ABSOLUTE /end AXIS_PTS
/begin AXIS_PTS SKS06ESUB "SST-Verteilung f¸r den Startadaptionsfaktor kstaa" 0xFC0F78 kstaa SstAUbSstUb 1.992 fak_ub_b2 6 0.00 1.992 FORMAT "%5.3" DEPOSIT ABSOLUTE /end AXIS_PTS
/begin AXIS_PTS SLX06TMUW "St¸tzstellenverteilung, Lambdasoll" 0xFCC8E8 lamsons_w SstAUwSstUw 15.99976 fak_uw_b16 6 0.00 15.99976 FORMAT "%8.5" DEPOSIT ABSOLUTE /end AXIS_PTS
/begin AXIS_PTS SML05DKUB "St¸tzstellenvert. Luftmasse" 0xFC0F80 ml SstAUbSstUb 1020. m_ub_b1020 5 0.00 1020. FORMAT "%5.0" DEPOSIT ABSOLUTE /end AXIS_PTS
/begin AXIS_PTS SML05LKUB "5 St¸tzstellen f¸r ?" 0xFC0F88 ml SstAUbSstUb 1020. m_ub_b1020 5 0.00 1020. FORMAT "%5.0" DEPOSIT ABSOLUTE /end AXIS_PTS
/begin AXIS_PTS SML06TMUW "St¸tzstellenverteilung, Luftmasse, 6 St¸tzstellen" 0xFCC8F6 ml_w SstAUwSstUw 6553.500 m_uw_b6553p5 6 0.00 6553.500 FORMAT "%8.3" DEPOSIT ABSOLUTE /end AXIS_PTS
/begin AXIS_PTS SML07TMUW "St¸tzstellenverteilung, Luftmasse, 7 St¸tzstellen" 0xFCC904 ml_w SstAUwSstUw 6553.500 m_uw_b6553p5 7 0.00 6553.500 FORMAT "%8.3" DEPOSIT ABSOLUTE /end AXIS_PTS
/begin AXIS_PTS SML08LHUB "ml abh‰ngige St¸tzstellen (Anzahl 8)" 0xFCC7F0 ml SstAUbSstUb 1020. m_ub_b1020 8 0.00 1020. FORMAT "%5.0" DEPOSIT ABSOLUTE /end AXIS_PTS
/begin AXIS_PTS SML08TEUB "" 0xFCC7FC ml SstAUbSstUb 1020. m_ub_b1020 8 0.00 1020. FORMAT "%5.0" DEPOSIT ABSOLUTE /end AXIS_PTS
/begin AXIS_PTS SN16KR1UB "" 0xFC0F18 nmot SstAU8SstU8 10200. nmot_ub_q40 16 0.00 10200. FORMAT "%5.0" DEPOSIT ABSOLUTE /end AXIS_PTS
/begin AXIS_PTS SN16KR2UB "" 0xFC0F2C nmot SstAU8SstU8 10200. nmot_ub_q40 16 0.00 10200. FORMAT "%5.0" DEPOSIT ABSOLUTE /end AXIS_PTS
/begin AXIS_PTS SNG06LLSB "St¸tzstellenverteilung Drehzahlgradient, 6 Sst." 0xFC0F90 ngfil SstAUbSstSb 25500. nmotg_sb_q100 6 -12800. 12700. FORMAT "%5.0" DEPOSIT ABSOLUTE /end AXIS_PTS
/begin AXIS_PTS SNG06LLTSB "" 0xFC0F98 ngfil SstAUbSstSb 25500. nmotg_sb_q100 6 -12800. 12700. FORMAT "%5.0" DEPOSIT ABSOLUTE /end AXIS_PTS
/begin AXIS_PTS SNM04DMUW1 "Drehzahlst¸tzstellen" 0xFC0EDE nmot_w SstAU8SstU16 16383.75 nmot_uw_q0p25 4 0.00 16383.75 FORMAT "%8.2" DEPOSIT ABSOLUTE /end AXIS_PTS
/begin AXIS_PTS SNM04DMUW2 "Drehzahlst¸tzstellen" 0xFC0EE8 nmot_w SstAU8SstU16 16383.75 nmot_uw_q0p25 4 0.00 16383.75 FORMAT "%8.2" DEPOSIT ABSOLUTE /end AXIS_PTS
/begin AXIS_PTS SNM05DKUB "St¸tzstellenvert. nmot" 0xFC0FA0 nmot SstAUbSstUb 10200. nmot_ub_q40 5 0.00 10200. FORMAT "%5.0" DEPOSIT ABSOLUTE /end AXIS_PTS
/begin AXIS_PTS SNM06LHUB "6 St¸tzstellen Drehzahl f¸r ?" 0xFCC808 nmot SstAUbSstUb 10200. nmot_ub_q40 6 0.00 10200. FORMAT "%5.0" DEPOSIT ABSOLUTE /end AXIS_PTS
/begin AXIS_PTS SNM06LLUB "S¸tzstellenverteilung f¸r Motordrehzahl" 0xFC0FA8 nmot SstAUbSstUb 10200. nmot_ub_q40 6 0.00 10200. FORMAT "%5.0" DEPOSIT ABSOLUTE /end AXIS_PTS
/begin AXIS_PTS SNM06MDUW "Rover" 0xFCC914 nmot_w SstAUwSstUw 16383.75 nmot_uw_q0p25 6 0.00 16383.75 FORMAT "%8.2" DEPOSIT ABSOLUTE /end AXIS_PTS
/begin AXIS_PTS SNM07ESUB "St¸tzstellenverteilung Drehzahl, 7 Sst." 0xFCC810 nmot SstAUbSstUb 10200. nmot_ub_q40 7 0.00 10200. FORMAT "%5.0" DEPOSIT ABSOLUTE /end AXIS_PTS
/begin AXIS_PTS SNM07LRUB "7 Drehzahlst¸tzstellen f¸r ?" 0xFC0FB0 nmot SstAUbSstUb 10200. nmot_ub_q40 7 0.00 10200. FORMAT "%5.0" DEPOSIT ABSOLUTE /end AXIS_PTS
/begin AXIS_PTS SNM08DMUB "SST-Verteilung in DMD, 8 Drehzahl-SST" 0xFC0FB8 nmot SstAUbSstUb 10200. nmot_ub_q40 8 0.00 10200. FORMAT "%5.0" DEPOSIT ABSOLUTE /end AXIS_PTS
/begin AXIS_PTS SNM08DMUW1 "St¸tzstellen KF Fuel-on-Adaption" 0xFC0EF2 nmot_w SstAU8SstU16 16383.75 nmot_uw_q0p25 8 0.00 16383.75 FORMAT "%8.2" DEPOSIT ABSOLUTE /end AXIS_PTS
/begin AXIS_PTS SNM08DMUW2 "St¸tzstellen KF Fuel-on-Adaption" 0xFC0F04 nmot_w SstAU8SstU16 16383.75 nmot_uw_q0p25 8 0.00 16383.75 FORMAT "%8.2" DEPOSIT ABSOLUTE /end AXIS_PTS
/begin AXIS_PTS SNM08FEUB "St¸tzstellenverteilung Drehzahl, 08 Sst., F¸llungseingriffe" 0xFC0FC4 nmot SstAUbSstUb 10200. nmot_ub_q40 8 0.00 10200. FORMAT "%5.0" DEPOSIT ABSOLUTE /end AXIS_PTS
/begin AXIS_PTS SNM08GKUB "St¸tzstellenverteilung Gemischkontrolle 8 nmot St¸tzstellen" 0xFC0F40 nmot SstAU8SstU8 10200. nmot_ub_q40 8 0.00 10200. FORMAT "%5.0" DEPOSIT ABSOLUTE /end AXIS_PTS
/begin AXIS_PTS SNM08LHUB "nmot abh‰ngige St¸tzstellen (Anzahl 8)" 0xFCC818 nmot SstAUbSstUb 10200. nmot_ub_q40 8 0.00 10200. FORMAT "%5.0" DEPOSIT ABSOLUTE /end AXIS_PTS
/begin AXIS_PTS SNM08OPUB "St¸tzstellenverteilung f¸r Motordrehzahl nmot" 0xFC0FD0 nmot SstAUbSstUb 10200. nmot_ub_q40 8 0.00 10200. FORMAT "%5.0" DEPOSIT ABSOLUTE /end AXIS_PTS
/begin AXIS_PTS SNM08ZUUB "St¸tzstellenverteilung Drehzahl, 8 Sst." 0xFC0FDC nmot SstAUbSstUb 10200. nmot_ub_q40 8 0.00 10200. FORMAT "%5.0" DEPOSIT ABSOLUTE /end AXIS_PTS
/begin AXIS_PTS SNM08__UB "St¸tzstellenverteilung Drehzahl, 8 Sst." 0xFC0FE8 nmot SstAUbSstUb 10200. nmot_ub_q40 8 0.00 10200. FORMAT "%5.0" DEPOSIT ABSOLUTE /end AXIS_PTS
/begin AXIS_PTS SNM12ESUB "SST-Verteilung f¸r die Motordrehzahl nmot" 0xFC0FF4 nmot SstAUbSstUb 10200. nmot_ub_q40 12 0.00 10200. FORMAT "%5.0" DEPOSIT ABSOLUTE /end AXIS_PTS
/begin AXIS_PTS SNM12FEUB "St¸tzstellen f¸r WDKSMX, WDKUGDN" 0xFC1004 nmot SstAUbSstUb 10200. nmot_ub_q40 12 0.00 10200. FORMAT "%5.0" DEPOSIT ABSOLUTE /end AXIS_PTS
/begin AXIS_PTS SNM12KRUW "" 0xFCC922 nmot_w SstAUwSstUw 16383.75 nmot_uw_q0p25 12 0.00 16383.75 FORMAT "%8.2" DEPOSIT ABSOLUTE /end AXIS_PTS
/begin AXIS_PTS SNM16GKUB "St¸tzstellenverteilung Gemischkontrolle 16 nmot St¸tzstellen" 0xFCC824 nmot SstAUbSstUb 10200. nmot_ub_q40 16 0.00 10200. FORMAT "%5.0" DEPOSIT ABSOLUTE /end AXIS_PTS
/begin AXIS_PTS SNM16KRUB "St¸tzstellenverteilung Drehzahl, 16 Sst." 0xFCC838 nmot SstAUbSstUb 10200. nmot_ub_q40 16 0.00 10200. FORMAT "%5.0" DEPOSIT ABSOLUTE /end AXIS_PTS
/begin AXIS_PTS SNM16OPUW "St¸tzstellenverteilung Drehzahl" 0xFC113C nmot_w SstAUwSstUw 16383.75 nmot_uw_q0p25 16 0.00 16383.75 FORMAT "%8.2" DEPOSIT ABSOLUTE /end AXIS_PTS
/begin AXIS_PTS SNM16ZUUB "St¸tzstellenverteilung Drehzahl, 16 Sst." 0xFC1014 nmot SstAUbSstUb 10200. nmot_ub_q40 16 0.00 10200. FORMAT "%5.0" DEPOSIT ABSOLUTE /end AXIS_PTS
/begin AXIS_PTS SNM24ZUUB "St¸tzstellenverteilung Drehzahl, 24 Sst." 0xFC1028 nmot SstAUbSstUb 10200. nmot_ub_q40 24 0.00 10200. FORMAT "%5.0" DEPOSIT ABSOLUTE /end AXIS_PTS
/begin AXIS_PTS SNM24ZUUB1 "St¸tzstellenverteilung Drehzahl, 24 Sst." 0xFC1044 nmot SstAUbSstUb 10200. nmot_ub_q40 24 0.00 10200. FORMAT "%5.0" DEPOSIT ABSOLUTE /end AXIS_PTS
/begin AXIS_PTS SNM24ZUUB2 "St¸tzstellenverteilung Drehzahl, 24 Sst." 0xFC1060 nmot SstAUbSstUb 10200. nmot_ub_q40 24 0.00 10200. FORMAT "%5.0" DEPOSIT ABSOLUTE /end AXIS_PTS
/begin AXIS_PTS SQM05TEUB "Luftmassenquotient-abh‰ngige St¸tzstellen (Anzahl =5)" 0xFC107C qmsdyn SstAUbSstUb 15.94 fak_ub_b16 5 0.00 15.94 FORMAT "%5.2" DEPOSIT ABSOLUTE /end AXIS_PTS
/begin AXIS_PTS SRL03ZUUB "St¸tzstellenverteilung relative F¸llung, 3 Sst." 0xFC1084 rl SstAUbSstUb 191.3 rel_ub_q0p75 3 0.00 191.3 FORMAT "%5.1" DEPOSIT ABSOLUTE /end AXIS_PTS
/begin AXIS_PTS SRL04KRUB "St¸tzstellenverteilung relative F¸llung, 4 Sst." 0xFCC84C rl SstAUbSstUb 191.3 rel_ub_q0p75 4 0.00 191.3 FORMAT "%5.1" DEPOSIT ABSOLUTE /end AXIS_PTS
/begin AXIS_PTS SRL06LHUB "6 F¸llungsst¸tzstellen f¸r ?" 0xFC1088 rl SstAUbSstUb 191.3 rel_ub_q0p75 6 0.00 191.3 FORMAT "%5.1" DEPOSIT ABSOLUTE /end AXIS_PTS
/begin AXIS_PTS SRL06LRUB "6 F¸llungsst¸tzstellen f¸r ?" 0xFC1090 rl SstAUbSstUb 191.3 rel_ub_q0p75 6 0.00 191.3 FORMAT "%5.1" DEPOSIT ABSOLUTE /end AXIS_PTS
/begin AXIS_PTS SRL08DMUB "SST-Verteilung in DMD, 8 Last-SST" 0xFC1098 rl SstAUbSstUb 191.3 rel_ub_q0p75 8 0.00 191.3 FORMAT "%5.1" DEPOSIT ABSOLUTE /end AXIS_PTS
/begin AXIS_PTS SRL08DYUB "" 0xFC10A4 rl SstAUbSstUb 191.3 rel_ub_q0p75 8 0.00 191.3 FORMAT "%5.1" DEPOSIT ABSOLUTE /end AXIS_PTS
/begin AXIS_PTS SRL08GKUB "St¸tzstellenverteilung Gemischkontrolle 8 rl St¸tzstellen" 0xFC0F4C rl SstAU8SstU8 191.3 rel_ub_q0p75 8 0.00 191.3 FORMAT "%5.1" DEPOSIT ABSOLUTE /end AXIS_PTS
/begin AXIS_PTS SRL08ZUUB "St¸tzstellenverteilung relative F¸llung, 8 Sst." 0xFC10B0 rl SstAUbSstUb 191.3 rel_ub_q0p75 8 0.00 191.3 FORMAT "%5.1" DEPOSIT ABSOLUTE /end AXIS_PTS
/begin AXIS_PTS SRL12ESUB "Sst-Verteilung f¸r die relative F¸llung rl" 0xFC10BC rl SstAUbSstUb 191.3 rel_ub_q0p75 12 0.00 191.3 FORMAT "%5.1" DEPOSIT ABSOLUTE /end AXIS_PTS
/begin AXIS_PTS SRL12GKUB "12 F¸llungsst¸tzstellen f¸r ?" 0xFCC854 rl SstAUbSstUb 191.3 rel_ub_q0p75 12 0.00 191.3 FORMAT "%5.1" DEPOSIT ABSOLUTE /end AXIS_PTS
/begin AXIS_PTS SRL12ZUUB "St¸tzstellenverteilung relative Luftf¸llung, 12 St." 0xFC10CC rl SstAUbSstUb 191.3 rel_ub_q0p75 12 0.00 191.3 FORMAT "%5.1" DEPOSIT ABSOLUTE /end AXIS_PTS
/begin AXIS_PTS SRL16ZUUB "St¸tzstellenverteilung relative F¸llung, 16 Sst." 0xFC10DC rl SstAUbSstUb 191.3 rel_ub_q0p75 16 0.00 191.3 FORMAT "%5.1" DEPOSIT ABSOLUTE /end AXIS_PTS
/begin AXIS_PTS ST107TMUB "St¸tzstellenverteilung, Starttemperatur an Sonde vorne" 0xFCC864 tabgmst SstAUbSstUb 1275. temp_ub_q5_o50 7 -50.00 1225. FORMAT "%5.0" DEPOSIT ABSOLUTE /end AXIS_PTS
/begin AXIS_PTS ST307TMUB "St¸tzstellenverteilung, Starttemperatur an Sonde hinten" 0xFCC86C tkatmst SstAUbSstUb 1275. temp_ub_q5_o50 7 -50.00 1225. FORMAT "%5.0" DEPOSIT ABSOLUTE /end AXIS_PTS
/begin AXIS_PTS STA04SAUB "" 0xFC10F0 tans SstAUbSstUb 191.3 temp_ub_q0p75_o48 4 -48.00 143.3 FORMAT "%5.1" DEPOSIT ABSOLUTE /end AXIS_PTS
/begin AXIS_PTS STA06ESUB "SST-Verteilung f¸r die Ansauglufttemperatur" 0xFCC874 tans SstAUbSstUb 191.3 temp_ub_q0p75_o48 6 -48.00 143.3 FORMAT "%5.1" DEPOSIT ABSOLUTE /end AXIS_PTS
/begin AXIS_PTS STM04FEUB "St¸tzstellenverteilung Motortemperatur" 0xFC10F8 tmot SstAUbSstUb 191.3 temp_ub_q0p75_o48 4 -48.00 143.3 FORMAT "%5.1" DEPOSIT ABSOLUTE /end AXIS_PTS
/begin AXIS_PTS STM04SAUB "St¸tzstellenverteilung Motortemperatur, 4 Sst." 0xFC1100 tmot SstAUbSstUb 191.3 temp_ub_q0p75_o48 4 -48.00 143.3 FORMAT "%5.1" DEPOSIT ABSOLUTE /end AXIS_PTS
/begin AXIS_PTS STM05SAUB "St¸tzstellenverteilung" 0xFCC87C tmot SstAUbSstUb 191.3 temp_ub_q0p75_o48 5 -48.00 143.3 FORMAT "%5.1" DEPOSIT ABSOLUTE /end AXIS_PTS
/begin AXIS_PTS STM05TMUB "St¸tzstellenverteilung, Motorstarttemperatur" 0xFCC93C tmst SstAUwSstUw 191.3 temp_ub_q0p75_o48 5 -48.00 143.3 FORMAT "%5.1" DEPOSIT ABSOLUTE /end AXIS_PTS
/begin AXIS_PTS STM06LLTUB "" 0xFCC884 tmot SstAUbSstUb 191.3 temp_ub_q0p75_o48 6 -48.00 143.3 FORMAT "%5.1" DEPOSIT ABSOLUTE /end AXIS_PTS
/begin AXIS_PTS STM06LLUB "St¸tzstellenverteilung Motortemperatur, 6 Sst." 0xFCC88C tmot SstAUbSstUb 191.3 temp_ub_q0p75_o48 6 -48.00 143.3 FORMAT "%5.1" DEPOSIT ABSOLUTE /end AXIS_PTS
/begin AXIS_PTS STM06__UB "St¸tzstellenverteilung Motortemperatur, 6 Sst." 0xFCC894 tmot SstAUbSstUb 191.3 temp_ub_q0p75_o48 6 -48.00 143.3 FORMAT "%5.1" DEPOSIT ABSOLUTE /end AXIS_PTS
/begin AXIS_PTS STM08BBUB "" 0xFC0F58 tmot SstAU8SstU8 191.3 temp_ub_q0p75_o48 8 -48.00 143.3 FORMAT "%5.1" DEPOSIT ABSOLUTE /end AXIS_PTS
/begin AXIS_PTS STM08DMUB "8 Motortemperaturst¸tzstellen f¸r DMD" 0xFCC89C tmot SstAUbSstUb 191.3 temp_ub_q0p75_o48 8 -48.00 143.3 FORMAT "%5.1" DEPOSIT ABSOLUTE /end AXIS_PTS
/begin AXIS_PTS STM08LEUB "8 Motortemperaturst¸tzstellen f¸r ?" 0xFCC8A8 tmot SstAUbSstUb 191.3 temp_ub_q0p75_o48 8 -48.00 143.3 FORMAT "%5.1" DEPOSIT ABSOLUTE /end AXIS_PTS
/begin AXIS_PTS STM08MDUB "St¸tzstellenverteilung: tmot f¸r Drehmomentwandler" 0xFCC8B4 tmot SstAUbSstUb 191.3 temp_ub_q0p75_o48 8 -48.00 143.3 FORMAT "%5.1" DEPOSIT ABSOLUTE /end AXIS_PTS
/begin AXIS_PTS STM09ESUB "St¸tzstellenverteilung Motortemperatur, 9 Sst." 0xFCC8C0 tmot SstAUbSstUb 191.3 temp_ub_q0p75_o48 9 -48.00 143.3 FORMAT "%5.1" DEPOSIT ABSOLUTE /end AXIS_PTS
/begin AXIS_PTS STM12ESUB "SST-Verteilung f¸r die Motortemperatur tmot" 0xFCC8CC tmot SstAUbSstUb 191.3 temp_ub_q0p75_o48 12 -48.00 143.3 FORMAT "%5.1" DEPOSIT ABSOLUTE /end AXIS_PTS
/begin AXIS_PTS STS12ESUB "SST-Verteilung f¸r Motorstarttemperatur" 0xFC1108 tmst SstAUbSstUb 191.3 temp_ub_q0p75_o48 12 -48.00 143.3 FORMAT "%5.1" DEPOSIT ABSOLUTE /end AXIS_PTS
/begin AXIS_PTS SVA07FEUW "" 0xFC115E Vsa_spri SstAUwSstUw 6554. sprzi_q0p1 7 0.00 6554. FORMAT "%4.0" DEPOSIT ABSOLUTE /end AXIS_PTS
/begin AXIS_PTS SVE07FEUW "" 0xFC116E Vse_spri SstAUwSstUw 6554. sprzi_q0p1 7 0.00 6554. FORMAT "%4.0" DEPOSIT ABSOLUTE /end AXIS_PTS
/begin AXIS_PTS SWP08OPUB "St¸tzstellenverteilung f¸r Pedalstellung wped" 0xFC1118 wped SstAUbSstUb 100.0 relPED_ub_b100 8 0.00 100.0 FORMAT "%5.1" DEPOSIT ABSOLUTE /end AXIS_PTS
/begin CHARACTERISTIC S_ASPSATRU "App. Schalter f¸r dauerhafte zus. Auslassspreizung" VALUE 0xFCB012 KwWU8 1.000 dez 0.00 1.000 FORMAT "%5.3" /end CHARACTERISTIC
/begin CHARACTERISTIC S_ESPSATRU "App. Schalter f¸r dauerhafte zus. Einlassspreizung" VALUE 0xFCB013 KwWU8 1.000 dez 0.00 1.000 FORMAT "%5.3" /end CHARACTERISTIC
/begin CHARACTERISTIC S_TDKF "Schalter Vorgabe minhub im LL der TL" VALUE 0xFC9ABE KwUb 255.0 dez 0.00 255.0 FORMAT "%5.1" /end CHARACTERISTIC
/begin CHARACTERISTIC S_WDKADOF "Schalter Drosselklappenwinkel Adaption ausgeschaltet" VALUE 0xFC9ABF KwUb 255.0 dez 0.00 255.0 FORMAT "%5.1" /end CHARACTERISTIC
/begin CHARACTERISTIC S_ZNDRLP "" VALUE 0xFC9AC0 KwUb 255.0 dez 0.00 255.0 FORMAT "%5.1" /end CHARACTERISTIC
/begin CHARACTERISTIC TADHMNH "untere Temperaturschwelle f¸r die Heizerdiagnose hinter Kat" VALUE 0xFCFACC KwUw 1535.977 temp_q0p0234_o273 -273.1500 1262.827 FORMAT "%8.3" /end CHARACTERISTIC
/begin CHARACTERISTIC TADHMXH "obere Temperaturschwelle f¸r die Heizerdiagnose hinter Kat" VALUE 0xFCFACE KwUw 1535.977 temp_q0p0234_o273 -273.1500 1262.827 FORMAT "%8.3" /end CHARACTERISTIC
/begin CHARACTERISTIC TASLSO "obere Ansauglufttemperaturschwelle f¸r Sekund‰rluftsystem" VALUE 0xFD05F2 KwUb 191.3 temp_ub_q0p75_o48 -48.00 143.3 FORMAT "%5.1" /end CHARACTERISTIC
/begin CHARACTERISTIC TASLSU "untere Ansauglufttemperaturschwelle f¸r Sekund‰rluftsystem" VALUE 0xFD05F3 KwUb 191.3 temp_ub_q0p75_o48 -48.00 143.3 FORMAT "%5.1" /end CHARACTERISTIC
/begin CHARACTERISTIC TDDSLA "Dauer Sekund‰rlufteinblasung f¸r Adaptionsphase" VALUE 0xFD05F4 KwUb 25.50 t100msxs_ub_b25p5 0.00 25.50 FORMAT "%5.2" /end CHARACTERISTIC
/begin CHARACTERISTIC TDSLKT "Dauer Kurztest Sekund‰rluftdiagnose f¸r Massenmessung" VALUE 0xFD05F5 KwUb 25.50 t100msxs_ub_b25p5 0.00 25.50 FORMAT "%5.2" /end CHARACTERISTIC
/begin CHARACTERISTIC TDWHSLPKH "" VALUE 0xFD05F6 KwUb 25.50 t100msxs_ub_b25p5 0.00 25.50 FORMAT "%5.2" /end CHARACTERISTIC
/begin CHARACTERISTIC TEMIN "minimales TE" VALUE 0xFC5614 KwWU32 540.000000000 t1p0usxms 0.00 540.000000000 FORMAT "%13.9" /end CHARACTERISTIC
/begin CHARACTERISTIC TFASLAMN "Mindestzeit nach Katheizen f¸r Testeranforderung Sekund‰rluftdiagnose" VALUE 0xFD066C KwUw 6553.500 t100msxs_uw_b6553p6 0.00 6553.500 FORMAT "%8.3" /end CHARACTERISTIC
/begin CHARACTERISTIC TLMSSLAB "Entprellzeit f¸r Abbruch Sekund‰rluftanfettung" VALUE 0xFD05F7 KwUb 25.40 t100msxs_ub_b25p5 0.1000 25.50 FORMAT "%5.2" /end CHARACTERISTIC
/begin CHARACTERISTIC TLMSSLMX "Maximale Zeit f¸r Sekund‰rluftanfettung im Leerlauf" VALUE 0xFD05F8 KwUb 255.0 t100msxs_ub_b255 0.00 255.0 FORMAT "%5.1" /end CHARACTERISTIC
/begin CHARACTERISTIC TMASPR "Temperaturschwelle f¸r Verstellung Auslasspreizung" VALUE 0xFCB014 KwWU8 191.3 temp_ub_q0p75_o48 -48.00 143.3 FORMAT "%5.1" /end CHARACTERISTIC
/begin CHARACTERISTIC TMESPR "Temperaturschwelle f¸r Verstellung Einlasspreizung" VALUE 0xFCB015 KwWU8 191.3 temp_ub_q0p75_o48 -48.00 143.3 FORMAT "%5.1" /end CHARACTERISTIC
/begin CHARACTERISTIC TMFASLMN "Motortemperaturschwelle Testeranforderung Sekund‰rluftdiagnose" VALUE 0xFD05F9 KwUb 191.3 temp_ub_q0p75_o48 -48.00 143.3 FORMAT "%5.1" /end CHARACTERISTIC
/begin CHARACTERISTIC TMSSLO "obere Starttemperaturschwelle f¸r Sekund‰rluft" VALUE 0xFD05FA KwUb 191.3 temp_ub_q0p75_o48 -48.00 143.3 FORMAT "%5.1" /end CHARACTERISTIC
/begin CHARACTERISTIC TMSSLSTO "obere Temperaturschwelle f¸r Sekund‰rluft im Start" VALUE 0xFD05FB KwUb 191.3 temp_ub_q0p75_o48 -48.00 143.3 FORMAT "%5.1" /end CHARACTERISTIC
/begin CHARACTERISTIC TMSSLSTU "untere Temperaturschwelle f¸r Sekund‰rluft im Start" VALUE 0xFD05FC KwUb 191.3 temp_ub_q0p75_o48 -48.00 143.3 FORMAT "%5.1" /end CHARACTERISTIC
/begin CHARACTERISTIC TMSSLU "untere Starttemperaturschwelle f¸r Sekund‰rluft" VALUE 0xFD05FD KwUb 191.3 temp_ub_q0p75_o48 -48.00 143.3 FORMAT "%5.1" /end CHARACTERISTIC
/begin CHARACTERISTIC TSLABB "Verweilzeit f¸r Sekund‰rluft- Abbruchbedingung" VALUE 0xFD05FE KwUb 25.40 t100msxs_ub_b25p5 0.1000 25.50 FORMAT "%5.2" /end CHARACTERISTIC
/begin CHARACTERISTIC TSLPMN "Mindesteinschaltdauer der Sekund‰rluftpumpe" VALUE 0xFD05FF KwUb 25.40 t100msxs_ub_b25p5 0.1000 25.50 FORMAT "%5.2" /end CHARACTERISTIC
/begin CHARACTERISTIC TSLUBST "Entprellzeit f¸r Sekund‰rluft ein im Start bei UBSLSTMN" VALUE 0xFD0600 KwUb 25.50 t100msxs_ub_b25p5 0.00 25.50 FORMAT "%5.2" /end CHARACTERISTIC
/begin CHARACTERISTIC TSPSAON "Startwert f¸r Timer f¸r zus. Ein- bzw /Auslassspreizung bei Schubabschaltung" VALUE 0xFD0212 KwUw 655.3500 t10msxs_uw_b655p35 0.00 655.3500 FORMAT "%8.4" /end CHARACTERISTIC
/begin CHARACTERISTIC TVASPSA "Startwert f¸r TurnOnDelay Timer f¸r zus. Auslassspreizung bei Schubabschaltung" VALUE 0xFD0214 KwUw 655.3500 t10msxs_uw_b655p35 0.00 655.3500 FORMAT "%8.4" /end CHARACTERISTIC
/begin CHARACTERISTIC TVDSLOFF "Zeitverzˆgerung Schlieﬂen Sekund‰rluftventil bei Adaption/Kurztrip" VALUE 0xFD0601 KwUb 25.50 t100msxs_ub_b25p5 0.00 25.50 FORMAT "%5.2" /end CHARACTERISTIC
/begin CHARACTERISTIC TVESPSA "Startwert f¸r TurnOnDelay Timer f¸r zus. Einlassspreizung bei Schubabschaltung" VALUE 0xFD0216 KwUw 655.3500 t10msxs_uw_b655p35 0.00 655.3500 FORMAT "%8.4" /end CHARACTERISTIC
/begin CHARACTERISTIC TVSLVOFF "Zeitverzˆgerung Schlieﬂen Sekund‰rluftventil" VALUE 0xFD0602 KwUb 25.50 t100msxs_ub_b25p5 0.00 25.50 FORMAT "%5.2" /end CHARACTERISTIC
/begin CHARACTERISTIC TVSLVON "Zeitverzˆgerung ÷ffnen Sekund‰rluftventil" VALUE 0xFD0603 KwUb 25.40 t100msxs_ub_b25p5 0.1000 25.50 FORMAT "%5.2" /end CHARACTERISTIC
/begin CHARACTERISTIC TVUB "Spannungskorrektur" CURVE 0xFC55F6 KlAxU8SstxU16WU16 65.53500 t1p0usxms 0.00 65.53500 FORMAT "%8.5"
 /begin AXIS_DESCR STD_AXIS ub spg_ubatt 6 0.00 24.02 FORMAT "%5.2" DEPOSIT ABSOLUTE /end AXIS_DESCR
/end CHARACTERISTIC
/begin CHARACTERISTIC TWSLPENA "" VALUE 0xFD066E KwUw 1535.977 temp_q0p0234_o273 -273.1500 1262.827 FORMAT "%8.3" /end CHARACTERISTIC
/begin CHARACTERISTIC TWSLPFA "" VALUE 0xFD0670 KwUw 1535.977 temp_q0p0234_o273 -273.1500 1262.827 FORMAT "%8.3" /end CHARACTERISTIC
/begin CHARACTERISTIC TWSLPOFF "" VALUE 0xFD0672 KwUw 1535.977 temp_q0p0234_o273 -273.1500 1262.827 FORMAT "%8.3" /end CHARACTERISTIC
/begin CHARACTERISTIC UBSLMN "min. Spannung f¸r Sekund‰rluft ein" VALUE 0xFD0674 KwUw 25.59961 spg_q0p00039 0.00 25.59961 FORMAT "%8.5" /end CHARACTERISTIC
/begin CHARACTERISTIC UBSLMX "max. Spannung f¸r Sekund‰rluft ein" VALUE 0xFD0676 KwUw 25.59961 spg_q0p00039 0.00 25.59961 FORMAT "%8.5" /end CHARACTERISTIC
/begin CHARACTERISTIC UBSLSTMN "min.Spannung f¸r Sekund‰rluft ein im Start" VALUE 0xFD0678 KwUw 25.59961 spg_q0p00039 0.00 25.59961 FORMAT "%8.5" /end CHARACTERISTIC
/begin CHARACTERISTIC VNS_VZD "" VALUE 0xFCB016 KwWU8 25.5 sprzi_q0p1 0.00 25.5 FORMAT "%4.1" /end CHARACTERISTIC
/begin CHARACTERISTIC VNS_VZZMX "Maximale Anzahl an Nachtriggerungen" VALUE 0xFCB017 KwWU8 255.0 DEZ 0.00 255.0 FORMAT "%5.1" /end CHARACTERISTIC
/begin CHARACTERISTIC VNS_WTZ "Wartezeit" VALUE 0xFCB018 KwWU8 255.0 default 0.00 255.0 FORMAT "%5.1" /end CHARACTERISTIC
/begin CHARACTERISTIC VSLS "Schwelle Fahrzeuggeschwindigkeit f¸r SLS ein" VALUE 0xFD0604 KwUb 318.8 vfzg_ub_q1p25 0.00 318.8 FORMAT "%5.1" /end CHARACTERISTIC
/begin CHARACTERISTIC WKRMGLUE "" VALUE 0xFCB019 KwWU8 191.3 zw_ub_qn0p75 -191.3 0.00 FORMAT "%5.1" /end CHARACTERISTIC
/begin CHARACTERISTIC WNWAIMN "Minimalwert der individuelle NW-Sp‰tanschlagsadaption" VALUE 0xFCB004 KwWU16 180. sprzi_q0p1 0.00 180. FORMAT "%4.0" /end CHARACTERISTIC
/begin CHARACTERISTIC WNWMN "minimaler Nockenwellensollwinkel" VALUE 0xFCB006 KwWU16 180. sprzi_q0p1 0.00 180. FORMAT "%4.0" /end CHARACTERISTIC
/begin CHARACTERISTIC ZFLMSSL "Zeitkonstante Gemischanteil Sekund‰rluft" VALUE 0xFD0605 KwUb 25.4996 zk100msxs_ub_b25p5 0.100392 25.6000 FORMAT "%7.4" /end CHARACTERISTIC
/begin CHARACTERISTIC ZKSLPOFF "Zeitkonstante Runterlauf Sekund‰rluftgebl‰se" VALUE 0xFD0606 KwUb 25.4996 zk100msxs_ub_b25p5 0.100392 25.6000 FORMAT "%7.4" /end CHARACTERISTIC
/begin CHARACTERISTIC ZKSLPON "Zeitkonstante Hochlauf Sekund‰rluftgebl‰se" VALUE 0xFD0607 KwUb 25.4996 zk100msxs_ub_b25p5 0.100392 25.6000 FORMAT "%7.4" /end CHARACTERISTIC
/begin CHARACTERISTIC ZKSLSOFML "Zeitkonstante Ausr‰umen der Sekund‰rluft nach Ventil schlieﬂen" CURVE 0xFD067A KlAUwSstUwWUw 6553.50000 zk100msxs_uw_b6553 0.100001526 6553.60000 FORMAT "%10.5"
 /begin AXIS_DESCR STD_AXIS ml_w m_uw_b6553p5 4 0.00 6553.500 FORMAT "%8.3" DEPOSIT ABSOLUTE /end AXIS_DESCR
/end CHARACTERISTIC
/begin CHARACTERISTIC ZKSLSONML "Zeitkonstante Einbringen der Sekund‰rluft nach Ventil ˆffnen" CURVE 0xFD068C KlAUwSstUwWUw 6553.50000 zk100msxs_uw_b6553 0.100001526 6553.60000 FORMAT "%10.5"
 /begin AXIS_DESCR STD_AXIS ml_w m_uw_b6553p5 4 0.00 6553.500 FORMAT "%8.3" DEPOSIT ABSOLUTE /end AXIS_DESCR
/end CHARACTERISTIC
/begin CHARACTERISTIC ZWNLL "Zeitkonstante f¸r TP Sollwertbed‰mpfung (Ein- und Auslass) nach Motorstart" CURVE 0xFCAF74 KlAxU8SstxU16WU16 0.9960938 fak_ub_b1 0.00 0.9960938 FORMAT "%9.7"
 /begin AXIS_DESCR STD_AXIS tnst_w t10msxs_uw_b655p35 4 0.00 655.3500 FORMAT "%8.4" DEPOSIT ABSOLUTE /end AXIS_DESCR
/end CHARACTERISTIC
/begin MEASUREMENT address "Adresse des Generators oder anderer Komponente an bitsynchr. Schnittstelle" UBYTE dez 1 100 0 255 FORMAT "%5.1" ECU_ADDRESS 0x5B8CC0 /end MEASUREMENT
/begin MEASUREMENT agrs "Sollposition AGR-Ventil Vorsteuerung" UBYTE rel_ub_b99p6 1 100 0 99.6094 FORMAT "%5.2" ECU_ADDRESS 0x5B8CC1 /end MEASUREMENT
/begin MEASUREMENT Allk "Leerlauf Auslasspreizung gedrosselt kalt zum Katheizen" UBYTE sprzi_q0p8 1 100 0 204 FORMAT "%5.1" ECU_ADDRESS 0x5B8CE0 /end MEASUREMENT
/begin MEASUREMENT Allw "Leerlauf Auslasspreizung gedrosselt warm zum Katheizen" UBYTE sprzi_q0p8 1 100 0 204 FORMAT "%5.1" ECU_ADDRESS 0x5B8CE1 /end MEASUREMENT
/begin MEASUREMENT anzeausb "Anzahl der auszublendenen Einspritzungen; begrenzt zwischen 4 und 7" UBYTE dez 1 100 0 255 FORMAT "%5.1" ECU_ADDRESS 0x5B8CC2 /end MEASUREMENT
/begin MEASUREMENT anzslp "" UBYTE dez 1 100 0 255 FORMAT "%5.1" ECU_ADDRESS 0x5B8AC0 /end MEASUREMENT
/begin MEASUREMENT Ask "optimale Auslasspreizung kalt ungedrosselt" UBYTE sprzi_q0p8 1 100 0 204 FORMAT "%5.1" ECU_ADDRESS 0x5B8CE2 /end MEASUREMENT
/begin MEASUREMENT Aspr "Sollwert Auslasspreizung" UBYTE sprzi_q0p8 1 100 0 204 FORMAT "%5.1" ECU_ADDRESS 0x5B8CE3 /end MEASUREMENT
/begin MEASUREMENT Asprimx "Max der ist Auslassspreizung" UWORD sprzi_q0p1 1 100 0 6553.5 FORMAT "%4.0" ECU_ADDRESS 0x5B8A7C /end MEASUREMENT
/begin MEASUREMENT Asprl "Auslasspreizung im Leerlauf gedrosselt" UBYTE sprzi_q0p8 1 100 0 204 FORMAT "%5.1" ECU_ADDRESS 0x5B8CE4 /end MEASUREMENT
/begin MEASUREMENT Asprlu "Auslasspreizung im Leerlauf ungedrosselt" UBYTE sprzi_q0p8 1 100 0 204 FORMAT "%5.1" ECU_ADDRESS 0x5B8CE5 /end MEASUREMENT
/begin MEASUREMENT Asprt "Auslasspreizung teilgedrosselt" UBYTE sprzi_q0p8 1 100 0 204 FORMAT "%5.1" ECU_ADDRESS 0x5B8CE6 /end MEASUREMENT
/begin MEASUREMENT Aspru "Auslasspreizung ungedrosselt" UBYTE sprzi_q0p8 1 100 0 204 FORMAT "%5.1" ECU_ADDRESS 0x5B8CE7 /end MEASUREMENT
/begin MEASUREMENT Astk "optimale Auslasspreizung kalt teilgedrosselt" UBYTE sprzi_q0p8 1 100 0 204 FORMAT "%5.1" ECU_ADDRESS 0x5B8CE8 /end MEASUREMENT
/begin MEASUREMENT Astw "optimale Auslasspreizung warm teilgedrosselt" UBYTE sprzi_q0p8 1 100 0 204 FORMAT "%5.1" ECU_ADDRESS 0x5B8CE9 /end MEASUREMENT
/begin MEASUREMENT Asw "optimale Auslasspreizung warm ungedrosselt" UBYTE sprzi_q0p8 1 100 0 204 FORMAT "%5.1" ECU_ADDRESS 0x5B8CEA /end MEASUREMENT
/begin MEASUREMENT Aswll "" UBYTE sprzi_q0p8 1 100 0 204 FORMAT "%5.1" ECU_ADDRESS 0x5B8CEB /end MEASUREMENT
/begin MEASUREMENT AS_elue3 "" UBYTE B_TRUE 1 100 0 1 BIT_MASK 0x1 FORMAT "%13.11" ECU_ADDRESS 0x3FBF55 /end MEASUREMENT
/begin MEASUREMENT AS_epee "" UBYTE B_TRUE 1 100 0 1 BIT_MASK 0x1 FORMAT "%13.11" ECU_ADDRESS 0x3FBF56 /end MEASUREMENT
/begin MEASUREMENT AS_mar "" UBYTE B_TRUE 1 100 0 1 BIT_MASK 0x1 FORMAT "%13.11" ECU_ADDRESS 0x3FBF57 /end MEASUREMENT
/begin MEASUREMENT AS_spv "" UBYTE B_TRUE 1 100 0 1 BIT_MASK 0x1 FORMAT "%13.11" ECU_ADDRESS 0x3FBF58 /end MEASUREMENT
/begin MEASUREMENT atveekpt "Bauteileansteuerung; Ansteuervariable Elektrokraftstoffpumpe" UBYTE rel_ub_b100 1 100 0 100 FORMAT "%5.1" ECU_ADDRESS 0x5B8880 /end MEASUREMENT
/begin MEASUREMENT batt_anz "" UBYTE B_TRUE 1 100 0 1 BIT_MASK 0x1 FORMAT "%13.11" ECU_ADDRESS 0x3FBF59 /end MEASUREMENT
/begin MEASUREMENT B_abstnl "Bedingung Abstellzeitermittlung ¸ber SG-Nachlauf" UBYTE B_TRUE 1 100 0 1 BIT_MASK 0x1 FORMAT "%13.11" ECU_ADDRESS 0x3FBF36 /end MEASUREMENT
/begin MEASUREMENT B_acc "Bedingung: ACC-Steuerger‰t vorhanden" UBYTE B_TRUE 1 100 0 1 BIT_MASK 0x1 FORMAT "%13.11" ECU_ADDRESS 0x3FBF5A /end MEASUREMENT
/begin MEASUREMENT B_accdme "Bedingung Quittierung der ACC-Anforderung" UBYTE B_TRUE 1 100 0 1 BIT_MASK 0x1 FORMAT "%13.11" ECU_ADDRESS 0x3FBF5B /end MEASUREMENT
/begin MEASUREMENT B_agr "Bedingung AGR ein" UBYTE B_TRUE 1 100 0 1 BIT_MASK 0x1 FORMAT "%13.11" ECU_ADDRESS 0x3FBF5C /end MEASUREMENT
/begin MEASUREMENT B_akr "Bedingung Abgasklappe mit Resonator" UBYTE B_TRUE 1 100 0 1 BIT_MASK 0x1 FORMAT "%13.11" ECU_ADDRESS 0x3FBF5D /end MEASUREMENT
/begin MEASUREMENT B_akrfz "Bedingung Abgasklappe vorhanden" UBYTE B_TRUE 1 100 0 1 BIT_MASK 0x1 FORMAT "%13.11" ECU_ADDRESS 0x3FBF5E /end MEASUREMENT
/begin MEASUREMENT B_anzslpmx "" UWORD B_TRUE 1 100 0 1 BIT_MASK 0x400 FORMAT "%13.11" ECU_ADDRESS 0x5B8AD0 /end MEASUREMENT
/begin MEASUREMENT B_aspan "" UBYTE B_TRUE 1 100 0 1 FORMAT "%13.11" ECU_ADDRESS 0x5B8A72 /end MEASUREMENT
/begin MEASUREMENT B_auakt "Bedingung Abgasuntersuchung aktiv" UBYTE B_TRUE 1 100 0 1 BIT_MASK 0x1 FORMAT "%13.11" ECU_ADDRESS 0x3FBF37 /end MEASUREMENT
/begin MEASUREMENT B_avset "" UBYTE B_TRUE 1 100 0 1 BIT_MASK 0x1 FORMAT "%13.11" ECU_ADDRESS 0x3FBE5C /end MEASUREMENT
/begin MEASUREMENT B_bkva "Bedingung BKV angesteuert" UBYTE B_TRUE 1 100 0 1 BIT_MASK 0x1 FORMAT "%13.11" ECU_ADDRESS 0x3FBF5F /end MEASUREMENT
/begin MEASUREMENT B_bkvv "Bedingung BKV verbaut (f¸r Auswertung Bremse)" UBYTE B_TRUE 1 100 0 1 BIT_MASK 0x1 FORMAT "%13.11" ECU_ADDRESS 0x3FBF60 /end MEASUREMENT
/begin MEASUREMENT B_bt "Bedingung Bauteileansteuerung  allgemein" UBYTE B_TRUE 1 100 0 1 BIT_MASK 0x1 FORMAT "%13.11" ECU_ADDRESS 0x3FBE5D /end MEASUREMENT
/begin MEASUREMENT B_btavs "" UBYTE B_TRUE 1 100 0 1 BIT_MASK 0x1 FORMAT "%13.11" ECU_ADDRESS 0x3FBE5E /end MEASUREMENT
/begin MEASUREMENT B_btdisa "Bedingung Bauteileansteuerung;  geregelte Saugrohrumschaltung" UBYTE B_TRUE 1 100 0 1 BIT_MASK 0x1 FORMAT "%13.11" ECU_ADDRESS 0x3FBE5F /end MEASUREMENT
/begin MEASUREMENT B_btebl "Bedingung Bauteileansteuerung; elektr. E-Box L¸fter" UBYTE B_TRUE 1 100 0 1 BIT_MASK 0x1 FORMAT "%13.11" ECU_ADDRESS 0x3FBE60 /end MEASUREMENT
/begin MEASUREMENT B_bteekp "Bedingung Bauteileansteuerung; Elektrokraftstoffpumpe (enable)" UBYTE B_TRUE 1 100 0 1 BIT_MASK 0x1 FORMAT "%13.11" ECU_ADDRESS 0x3FBE61 /end MEASUREMENT
/begin MEASUREMENT B_bteepcl "Bedingung Bauteileansteuerung;  EML-Lampe (enable)" UBYTE B_TRUE 1 100 0 1 BIT_MASK 0x1 FORMAT "%13.11" ECU_ADDRESS 0x3FBE62 /end MEASUREMENT
/begin MEASUREMENT B_btefgr "Bedingung Bauteileansteuerung;  Bereitschaftsanzeige FGR-Mainswitch" UBYTE B_TRUE 1 100 0 1 BIT_MASK 0x1 FORMAT "%13.11" ECU_ADDRESS 0x3FBE63 /end MEASUREMENT
/begin MEASUREMENT B_btekp "Bedingung Bauteileansteuerung; Elektrokraftstoffpumpe" UBYTE B_TRUE 1 100 0 1 BIT_MASK 0x1 FORMAT "%13.11" ECU_ADDRESS 0x3FBE64 /end MEASUREMENT
/begin MEASUREMENT B_btemil "Bedingung Bauteileansteuerung;  Fehlerlampe (MIL)" UBYTE B_TRUE 1 100 0 1 BIT_MASK 0x1 FORMAT "%13.11" ECU_ADDRESS 0x3FBE65 /end MEASUREMENT
/begin MEASUREMENT B_btepcl "Bedingung Bauteileansteuerung;  EML-Lampe" UBYTE B_TRUE 1 100 0 1 BIT_MASK 0x1 FORMAT "%13.11" ECU_ADDRESS 0x3FBE66 /end MEASUREMENT
/begin MEASUREMENT B_btev1 "" UBYTE B_TRUE 1 100 0 1 BIT_MASK 0x1 FORMAT "%13.11" ECU_ADDRESS 0x3FBE67 /end MEASUREMENT
/begin MEASUREMENT B_btev2 "" UBYTE B_TRUE 1 100 0 1 BIT_MASK 0x1 FORMAT "%13.11" ECU_ADDRESS 0x3FBE68 /end MEASUREMENT
/begin MEASUREMENT B_btev3 "" UBYTE B_TRUE 1 100 0 1 BIT_MASK 0x1 FORMAT "%13.11" ECU_ADDRESS 0x3FBE69 /end MEASUREMENT
/begin MEASUREMENT B_btev4 "" UBYTE B_TRUE 1 100 0 1 BIT_MASK 0x1 FORMAT "%13.11" ECU_ADDRESS 0x3FBE6A /end MEASUREMENT
/begin MEASUREMENT B_btfgr "Bedingung Bauteileansteuerung;  Bereitschaftsanzeige FGR-Mainswitch" UBYTE B_TRUE 1 100 0 1 BIT_MASK 0x1 FORMAT "%13.11" ECU_ADDRESS 0x3FBE6B /end MEASUREMENT
/begin MEASUREMENT B_bthsh "Bedingung Bauteileansteuerung; LS-Heizung hinter Kat." UBYTE B_TRUE 1 100 0 1 BIT_MASK 0x1 FORMAT "%13.11" ECU_ADDRESS 0x3FBE6C /end MEASUREMENT
/begin MEASUREMENT B_bthsv "Bedingung Bauteileansteuerung; LS-Heizung vor Kat." UBYTE B_TRUE 1 100 0 1 BIT_MASK 0x1 FORMAT "%13.11" ECU_ADDRESS 0x3FBE6D /end MEASUREMENT
/begin MEASUREMENT B_btkos "Bedingung Bauteileansteuerung; Klimakompressor" UBYTE B_TRUE 1 100 0 1 BIT_MASK 0x1 FORMAT "%13.11" ECU_ADDRESS 0x3FBE6E /end MEASUREMENT
/begin MEASUREMENT B_btmil "Bedingung Bauteileansteuerung;  Fehlerlampe (MIL)" UBYTE B_TRUE 1 100 0 1 BIT_MASK 0x1 FORMAT "%13.11" ECU_ADDRESS 0x3FBE6F /end MEASUREMENT
/begin MEASUREMENT B_btmls3 "Bedingung Bauteileansteuerung;  Motorl¸fter 3" UBYTE B_TRUE 1 100 0 1 BIT_MASK 0x1 FORMAT "%13.11" ECU_ADDRESS 0x3FBE70 /end MEASUREMENT
/begin MEASUREMENT B_btslp "Bedingung Bauteileansteuerung; Sekund‰rluftpumpe" UBYTE B_TRUE 1 100 0 1 BIT_MASK 0x1 FORMAT "%13.11" ECU_ADDRESS 0x3FBE71 /end MEASUREMENT
/begin MEASUREMENT B_btslv "Bedingung Bauteileansteuerung; Sekund‰rluftventil" UBYTE B_TRUE 1 100 0 1 BIT_MASK 0x1 FORMAT "%13.11" ECU_ADDRESS 0x3FBE72 /end MEASUREMENT
/begin MEASUREMENT B_btsslv "Bedingung Bauteileansteuerung; Schaltventil SLV" UBYTE B_TRUE 1 100 0 1 BIT_MASK 0x1 FORMAT "%13.11" ECU_ADDRESS 0x3FBE73 /end MEASUREMENT
/begin MEASUREMENT B_btsta "Bedingung Bauteileansteuerung; Startrelais" UBYTE B_TRUE 1 100 0 1 BIT_MASK 0x1 FORMAT "%13.11" ECU_ADDRESS 0x3FBE74 /end MEASUREMENT
/begin MEASUREMENT B_bttev "Bedingung Bauteileansteuerung; Tankentl¸ftungsventil" UBYTE B_TRUE 1 100 0 1 BIT_MASK 0x1 FORMAT "%13.11" ECU_ADDRESS 0x3FBE75 /end MEASUREMENT
/begin MEASUREMENT B_btvsa "Bedingung Bauteileansteuerung; NW-Verstellung Auslass-Ventil" UBYTE B_TRUE 1 100 0 1 BIT_MASK 0x1 FORMAT "%13.11" ECU_ADDRESS 0x3FBE76 /end MEASUREMENT
/begin MEASUREMENT B_btvsa2 "Bedingung Bauteileansteuerung; NW-Verstellung Auslass-Ventil, Bank 2" UBYTE B_TRUE 1 100 0 1 BIT_MASK 0x1 FORMAT "%13.11" ECU_ADDRESS 0x3FBE77 /end MEASUREMENT
/begin MEASUREMENT B_btvse "Bedingung Bauteileansteuerung; NW-Verstellung Einlass-Ventil" UBYTE B_TRUE 1 100 0 1 BIT_MASK 0x1 FORMAT "%13.11" ECU_ADDRESS 0x3FBE78 /end MEASUREMENT
/begin MEASUREMENT B_btvse2 "Bedingung Bauteileansteuerung; NW-Verstellung Einlass-Ventil, Bank2" UBYTE B_TRUE 1 100 0 1 BIT_MASK 0x1 FORMAT "%13.11" ECU_ADDRESS 0x3FBE79 /end MEASUREMENT
/begin MEASUREMENT B_cdagr "Funktion ¸ber Codewort CDAGR freigegeben" UWORD B_TRUE 1 100 0 1 BIT_MASK 0x1 FORMAT "%13.11" ECU_ADDRESS 0x5B9424 /end MEASUREMENT
/begin MEASUREMENT B_cdanws "Funktion ¸ber Codewort CDNWS freigegeben (Auslaﬂ)" UWORD B_TRUE 1 100 0 1 BIT_MASK 0x4 FORMAT "%13.11" ECU_ADDRESS 0x5B9424 /end MEASUREMENT
/begin MEASUREMENT B_cdbkvp "Funktion ¸ber Codewort CDBKVP freigegeben" UWORD B_TRUE 1 100 0 1 BIT_MASK 0x2 FORMAT "%13.11" ECU_ADDRESS 0x5B9424 /end MEASUREMENT
/begin MEASUREMENT B_cddmtl "Funktionfreigabe per Codewort" UWORD B_TRUE 1 100 0 1 BIT_MASK 0x8 FORMAT "%13.11" ECU_ADDRESS 0x5B9424 /end MEASUREMENT
/begin MEASUREMENT B_cddsbkv "Funktion ¸ber Codewort CDDSBKV freigegeben" UWORD B_TRUE 1 100 0 1 BIT_MASK 0x10 FORMAT "%13.11" ECU_ADDRESS 0x5B9424 /end MEASUREMENT
/begin MEASUREMENT B_cdenws "Funktion ¸ber Codewort CDNWS freigegeben (Einlaﬂ)" UWORD B_TRUE 1 100 0 1 BIT_MASK 0x20 FORMAT "%13.11" ECU_ADDRESS 0x5B9424 /end MEASUREMENT
/begin MEASUREMENT B_cdfst "F¸llstandsgeberdiagnose ¸ber Euro-Codewort CDEFST freigeben" UWORD B_TRUE 1 100 0 1 BIT_MASK 0x40 FORMAT "%13.11" ECU_ADDRESS 0x5B9424 /end MEASUREMENT
/begin MEASUREMENT B_cdhsh "Funktion ¸ber Codewort CDHSH freigegeben" UWORD B_TRUE 1 100 0 1 BIT_MASK 0x80 FORMAT "%13.11" ECU_ADDRESS 0x5B9424 /end MEASUREMENT
/begin MEASUREMENT B_cdhsv "Funktion ¸ber Codewort CDHSV freigegeben" UWORD B_TRUE 1 100 0 1 BIT_MASK 0x100 FORMAT "%13.11" ECU_ADDRESS 0x5B9424 /end MEASUREMENT
/begin MEASUREMENT B_cdhsvsa "Funktion ¸ber Codewort CDHSVSA freigegeben" UWORD B_TRUE 1 100 0 1 BIT_MASK 0x200 FORMAT "%13.11" ECU_ADDRESS 0x5B9424 /end MEASUREMENT
/begin MEASUREMENT B_cdkat "Funktion ¸ber Codewort CDKAT freigegeben" UWORD B_TRUE 1 100 0 1 BIT_MASK 0x400 FORMAT "%13.11" ECU_ADDRESS 0x5B9424 /end MEASUREMENT
/begin MEASUREMENT B_cdkatsp "Funktion ¸ber Codewort CDKATSP freigegeben" UWORD B_TRUE 1 100 0 1 BIT_MASK 0x800 FORMAT "%13.11" ECU_ADDRESS 0x5B9424 /end MEASUREMENT
/begin MEASUREMENT B_cdkvs "Funktion ¸ber Codewort CDKVS freigegeben" UWORD B_TRUE 1 100 0 1 BIT_MASK 0x1000 FORMAT "%13.11" ECU_ADDRESS 0x5B9424 /end MEASUREMENT
/begin MEASUREMENT B_cdlash "Funktion ¸ber Codewort CDLASH freigegeben" UWORD B_TRUE 1 100 0 1 BIT_MASK 0x2000 FORMAT "%13.11" ECU_ADDRESS 0x5B9424 /end MEASUREMENT
/begin MEASUREMENT B_cdlatp "Funktion ¸ber Codewort CDLATP freigegeben" UWORD B_TRUE 1 100 0 1 BIT_MASK 0x4000 FORMAT "%13.11" ECU_ADDRESS 0x5B9424 /end MEASUREMENT
/begin MEASUREMENT B_cdlatv "Funktion ¸ber Codewort CDLATV freigeben" UWORD B_TRUE 1 100 0 1 BIT_MASK 0x8000 FORMAT "%13.11" ECU_ADDRESS 0x5B9424 /end MEASUREMENT
/begin MEASUREMENT B_cdldp "Funktion ¸ber Codewort CDLDP freigegeben" UWORD B_TRUE 1 100 0 1 BIT_MASK 0x1 FORMAT "%13.11" ECU_ADDRESS 0x5B9426 /end MEASUREMENT
/begin MEASUREMENT B_cdllr "Funktion ¸ber Codewort CDLLR freigegeben" UWORD B_TRUE 1 100 0 1 BIT_MASK 0x2 FORMAT "%13.11" ECU_ADDRESS 0x5B9426 /end MEASUREMENT
/begin MEASUREMENT B_cdlsh "Funktion ¸ber Codewort CDLSH freigegeben" UWORD B_TRUE 1 100 0 1 BIT_MASK 0x4 FORMAT "%13.11" ECU_ADDRESS 0x5B9426 /end MEASUREMENT
/begin MEASUREMENT B_cdlsv "Funktion ¸ber Codewort CDLSV freigegeben" UWORD B_TRUE 1 100 0 1 BIT_MASK 0x8 FORMAT "%13.11" ECU_ADDRESS 0x5B9426 /end MEASUREMENT
/begin MEASUREMENT B_cdlsvv "Funktion ¸ber Codewort CDLSVV freigegeben" UWORD B_TRUE 1 100 0 1 BIT_MASK 0x10 FORMAT "%13.11" ECU_ADDRESS 0x5B9426 /end MEASUREMENT
/begin MEASUREMENT B_cdmd "Funktion ¸ber Codewort CDMD freigegeben" UWORD B_TRUE 1 100 0 1 BIT_MASK 0x20 FORMAT "%13.11" ECU_ADDRESS 0x5B9426 /end MEASUREMENT
/begin MEASUREMENT B_cdsls "Funktion ¸ber Codewort CDSLS freigegeben" UWORD B_TRUE 1 100 0 1 BIT_MASK 0x40 FORMAT "%13.11" ECU_ADDRESS 0x5B9426 /end MEASUREMENT
/begin MEASUREMENT B_cdswe "Funktion ¸ber Codewort CDSWE freigegeben" UWORD B_TRUE 1 100 0 1 BIT_MASK 0x80 FORMAT "%13.11" ECU_ADDRESS 0x5B9426 /end MEASUREMENT
/begin MEASUREMENT B_cdtankl "Funktion ¸ber Codewort CDTANKL freigegeben" UWORD B_TRUE 1 100 0 1 BIT_MASK 0x100 FORMAT "%13.11" ECU_ADDRESS 0x5B9426 /end MEASUREMENT
/begin MEASUREMENT B_cdtes "Funktion ¸ber Codewort CDTES freigegeben" UWORD B_TRUE 1 100 0 1 BIT_MASK 0x200 FORMAT "%13.11" ECU_ADDRESS 0x5B9426 /end MEASUREMENT
/begin MEASUREMENT B_clradbbo "Bedingung: Adaptionswerte Bereichserk. Benzin im Oel selektiv loeschen" UBYTE B_TRUE 1 100 0 1 BIT_MASK 0x1 FORMAT "%13.11" ECU_ADDRESS 0x3FBF61 /end MEASUREMENT
/begin MEASUREMENT B_clradkr "Bedingung: Adaptionswerte Klopfregelung selektiv loeschen" UBYTE B_TRUE 1 100 0 1 BIT_MASK 0x1 FORMAT "%13.11" ECU_ADDRESS 0x3FBF62 /end MEASUREMENT
/begin MEASUREMENT B_clradkrd "Bedingung: Adaptionswerte Dynamikvorhalt  selektiv loeschen" UBYTE B_TRUE 1 100 0 1 BIT_MASK 0x1 FORMAT "%13.11" ECU_ADDRESS 0x3FBF63 /end MEASUREMENT
/begin MEASUREMENT B_clradlr "Bedingung: Adaptionswerte Lamdbaregelung selektiv loeschen" UBYTE B_TRUE 1 100 0 1 BIT_MASK 0x1 FORMAT "%13.11" ECU_ADDRESS 0x3FBF64 /end MEASUREMENT
/begin MEASUREMENT B_clradlra "Bedingung: Adaptionswerte Lambdasondenalterung selektiv loeschen" UBYTE B_TRUE 1 100 0 1 BIT_MASK 0x1 FORMAT "%13.11" ECU_ADDRESS 0x3FBF65 /end MEASUREMENT
/begin MEASUREMENT B_clradlrh "Bedingung: Adaptionswerte Lambdaregelung h.KAT selektiv loeschen" UBYTE B_TRUE 1 100 0 1 BIT_MASK 0x1 FORMAT "%13.11" ECU_ADDRESS 0x5B8B6C /end MEASUREMENT
/begin MEASUREMENT B_clradmhb "Bedingung: Adaptionswerte Min.-Hub VVT selektiv loeschen" UBYTE B_TRUE 1 100 0 1 BIT_MASK 0x1 FORMAT "%13.11" ECU_ADDRESS 0x3FBF66 /end MEASUREMENT
/begin MEASUREMENT B_clradmsz "Bedingung: Adaptionswerte Massenstrom zum Saugrohr selektiv loeschen" UBYTE B_TRUE 1 100 0 1 BIT_MASK 0x1 FORMAT "%13.11" ECU_ADDRESS 0x3FBF67 /end MEASUREMENT
/begin MEASUREMENT B_clradvvt "Bedingung: Adaptionswerte VVT selektiv loeschen" UBYTE B_TRUE 1 100 0 1 BIT_MASK 0x1 FORMAT "%13.11" ECU_ADDRESS 0x3FBF68 /end MEASUREMENT
/begin MEASUREMENT B_craus "Ausgewertet durch LREB: Werkstattbit zum Stillegen LR" UBYTE DEZ 1 100 0 1 BIT_MASK 0x1 FORMAT "%5.3" ECU_ADDRESS 0x3FBF69 /end MEASUREMENT
/begin MEASUREMENT B_cvt "Bedingung continuously variable transmission" UBYTE B_TRUE 1 100 0 1 BIT_MASK 0x1 FORMAT "%13.11" ECU_ADDRESS 0x3FBF6A /end MEASUREMENT
/begin MEASUREMENT B_cwlshdyn "Beding. Abschaltung f¸r Teilfunktion Dynamikpr¸fung Sonde hinter KAT in %DLSAHK" UBYTE B_TRUE 1 100 0 1 BIT_MASK 0x1 FORMAT "%13.11" ECU_ADDRESS 0x3FBF38 /end MEASUREMENT
/begin MEASUREMENT B_cwlshsch "Bedingung Abschaltung f¸r Teilfunktion im Schub Sonde hinter KAT in %DLSAHK" UBYTE B_TRUE 1 100 0 1 BIT_MASK 0x1 FORMAT "%13.11" ECU_ADDRESS 0x3FBF39 /end MEASUREMENT
/begin MEASUREMENT B_cwlshvl "Bed. Abschaltung f¸r Teilfunktion im Vollastbetrieb Sonde hinter KAT in %DLSAHK" UBYTE B_TRUE 1 100 0 1 BIT_MASK 0x1 FORMAT "%13.11" ECU_ADDRESS 0x3FBF3A /end MEASUREMENT
/begin MEASUREMENT B_dknolu "Bedingung Drosselklappensteller stromlos" UBYTE B_TRUE 1 100 0 1 BIT_MASK 0x1 FORMAT "%13.11" ECU_ADDRESS 0x3FBC7C /end MEASUREMENT
/begin MEASUREMENT B_dknot "Bedingung DK-Poti-Notfahren aktiv" UBYTE B_TRUE 1 100 0 1 BIT_MASK 0x1 FORMAT "%13.11" ECU_ADDRESS 0x3FBC7D /end MEASUREMENT
/begin MEASUREMENT B_dkpiu "Bedingung: irreversible SKA" UBYTE B_TRUE 1 100 0 1 BIT_MASK 0x1 FORMAT "%13.11" ECU_ADDRESS 0x3FBC7E /end MEASUREMENT
/begin MEASUREMENT B_dkpru "Bedingung: reversible SKA" UBYTE B_TRUE 1 100 0 1 BIT_MASK 0x1 FORMAT "%13.11" ECU_ADDRESS 0x3FBC7F /end MEASUREMENT
/begin MEASUREMENT B_dkpu "Bedingung Sicherheitskraftstoffabschaltung (SKA)" UBYTE B_TRUE 1 100 0 1 BIT_MASK 0x1 FORMAT "%13.11" ECU_ADDRESS 0x3FBC80 /end MEASUREMENT
/begin MEASUREMENT B_dktb "Bedingung: Beginn der Katdiagnose" UBYTE B_TRUE 1 100 0 1 BIT_MASK 0x1 FORMAT "%13.11" ECU_ADDRESS 0x3FBF6B /end MEASUREMENT
/begin MEASUREMENT B_dktsbs "Bankspezifische Stoppbedingung" UBYTE B_TRUE 1 100 0 1 BIT_MASK 0x1 FORMAT "%13.11" ECU_ADDRESS 0x3FBF6C /end MEASUREMENT
/begin MEASUREMENT B_dkunb "Bedingung: Drosselklappenposition unbekannt" UBYTE B_TRUE 1 100 0 1 BIT_MASK 0x1 FORMAT "%13.11" ECU_ADDRESS 0x3FBC81 /end MEASUREMENT
/begin MEASUREMENT B_dldpte "Anforderung TEV schlieﬂen aus Tankentl¸ftungsdiagnose" UBYTE B_TRUE 1 100 0 1 BIT_MASK 0x1 FORMAT "%13.11" ECU_ADDRESS 0x3FBF6D /end MEASUREMENT
/begin MEASUREMENT B_dmmtev "TEV-schlieﬂen wegen Bedingung Endstufentest DMTL-Magnetventil" UBYTE B_TRUE 1 100 0 1 BIT_MASK 0x1 FORMAT "%13.11" ECU_ADDRESS 0x3FBF6E /end MEASUREMENT
/begin MEASUREMENT B_dmtltz "Bedingung TEV soll geschlossen werden" UBYTE B_TRUE 1 100 0 1 BIT_MASK 0x1 FORMAT "%13.11" ECU_ADDRESS 0x3FBF6F /end MEASUREMENT
/begin MEASUREMENT B_druck "Bedingung Drucklospr¸fung erf¸llt, System drucklos" UBYTE B_TRUE 1 100 0 1 BIT_MASK 0x1 FORMAT "%13.11" ECU_ADDRESS 0x3FBF70 /end MEASUREMENT
/begin MEASUREMENT B_dslreset "Bedingung: Zur¸cksetzen Sekund‰rluftadaption/Kurztest" UWORD B_TRUE 1 100 0 1 BIT_MASK 0x2 FORMAT "%13.11" ECU_ADDRESS 0x5B8AD0 /end MEASUREMENT
/begin MEASUREMENT B_dslset "Bedingung: Setzen Sekund‰rluftadaption/Kurztest" UWORD B_TRUE 1 100 0 1 BIT_MASK 0x1 FORMAT "%13.11" ECU_ADDRESS 0x5B8AD0 /end MEASUREMENT
/begin MEASUREMENT B_dslsk "Bedingung Diagnose Sekund‰rluftsystem f¸r Kurztest" UBYTE B_TRUE 1 100 0 1 BIT_MASK 0x1 FORMAT "%13.11" ECU_ADDRESS 0x3FBF71 /end MEASUREMENT
/begin MEASUREMENT B_dtefrr "Bedingung Lambdareglerreset bei Tankentl¸ftungsdiagnose" UBYTE B_TRUE 1 100 0 1 BIT_MASK 0x1 FORMAT "%13.11" ECU_ADDRESS 0x3FBF72 /end MEASUREMENT
/begin MEASUREMENT B_dwg "Bedingung f¸r Diagnose Waste- Gate" UBYTE B_TRUE 1 100 0 1 BIT_MASK 0x1 FORMAT "%13.11" ECU_ADDRESS 0x3FBF73 /end MEASUREMENT
/begin MEASUREMENT B_dylsu "Dynamik LSU gepr¸ft" UBYTE B_TRUE 1 100 0 1 BIT_MASK 0x1 FORMAT "%13.11" ECU_ADDRESS 0x3FBF74 /end MEASUREMENT
/begin MEASUREMENT B_dylsuav "Dynamik¸berwachung LSU aktiv" UBYTE B_TRUE 1 100 0 1 BIT_MASK 0x1 FORMAT "%13.11" ECU_ADDRESS 0x3FBF75 /end MEASUREMENT
/begin MEASUREMENT B_eblet "Stellglieddiagnose E-Box L¸ftersteuerung: Eingriff Tester" UBYTE B_TRUE 1 100 0 1 BIT_MASK 0x1 FORMAT "%13.11" ECU_ADDRESS 0x3FBE7A /end MEASUREMENT
/begin MEASUREMENT B_edkvs2 "Bedingung Adaptionsfehlerschwellen Bank 2 aktuell ¸berschritten" UBYTE B_TRUE 1 100 0 1 BIT_MASK 0x1 FORMAT "%13.11" ECU_ADDRESS 0x3FBF76 /end MEASUREMENT
/begin MEASUREMENT B_ekpet "Stellglieddiagnose EKP: Eingriff Tester" UBYTE B_TRUE 1 100 0 1 BIT_MASK 0x1 FORMAT "%13.11" ECU_ADDRESS 0x3FBE7B /end MEASUREMENT
/begin MEASUREMENT B_elsu "Bedingung Fehler oder Fehler-Vormerkung LSU (keine Betriebsbereitschaft)" UBYTE B_TRUE 1 100 0 1 BIT_MASK 0x1 FORMAT "%13.11" ECU_ADDRESS 0x3FBF77 /end MEASUREMENT
/begin MEASUREMENT B_elsuv "Bedingung Fehler LSU vertauscht rechts/links (keine Betriebsbereitschaft)" UBYTE B_TRUE 1 100 0 1 BIT_MASK 0x1 FORMAT "%13.11" ECU_ADDRESS 0x3FBF78 /end MEASUREMENT
/begin MEASUREMENT B_esnws "Bedingung Gemischfaktor bei Nockenwellenverstellung" UBYTE B_TRUE 1 100 0 1 BIT_MASK 0x1 FORMAT "%13.11" ECU_ADDRESS 0x3FBF79 /end MEASUREMENT
/begin MEASUREMENT B_espan "" UBYTE B_TRUE 1 100 0 1 FORMAT "%13.11" ECU_ADDRESS 0x5B8A73 /end MEASUREMENT
/begin MEASUREMENT B_estart "Bedingung KL 50 ein" UBYTE B_TRUE 1 100 0 1 BIT_MASK 0x1 FORMAT "%13.11" ECU_ADDRESS 0x3FBF7A /end MEASUREMENT
/begin MEASUREMENT B_etol "Bedingung Fehler in ÷ltemperatur" UBYTE B_TRUE 1 100 0 1 BIT_MASK 0x1 FORMAT "%13.11" ECU_ADDRESS 0x3FBF3B /end MEASUREMENT
/begin MEASUREMENT B_etr "Bedingung elektrische Thermostatregelung" UBYTE B_TRUE 1 100 0 1 BIT_MASK 0x1 FORMAT "%13.11" ECU_ADDRESS 0x3FBF7B /end MEASUREMENT
/begin MEASUREMENT B_etret "Bedingung elektr. Thermostatregelung ein ¸ber Tester" UBYTE B_TRUE 1 100 0 1 BIT_MASK 0x1 FORMAT "%13.11" ECU_ADDRESS 0x3FBE7C /end MEASUREMENT
/begin MEASUREMENT B_ez "Verbot des gesamten Motorlaufs (MOTRONIC bleibt in Zahnentprellphase" UBYTE B_TRUE 1 100 0 1 BIT_MASK 0x1 FORMAT "%13.11" ECU_ADDRESS 0x3FBF7C /end MEASUREMENT
/begin MEASUREMENT B_fa "Bedingung Funktionsanforderung allgemein" UBYTE B_TRUE 1 100 0 1 BIT_MASK 0x1 FORMAT "%13.11" ECU_ADDRESS 0x3FBE7D /end MEASUREMENT
/begin MEASUREMENT B_faatm "Bedingung Funktionsanforderung kurze Taupunktendezeiten" UBYTE B_TRUE 1 100 0 1 BIT_MASK 0x1 FORMAT "%13.11" ECU_ADDRESS 0x3FBF7D /end MEASUREMENT
/begin MEASUREMENT B_faavr "" UBYTE B_TRUE 1 100 0 1 BIT_MASK 0x1 FORMAT "%13.11" ECU_ADDRESS 0x3FBE7E /end MEASUREMENT
/begin MEASUREMENT B_fabr "Bedingung Fahrer bremst aus CAN-Botschaft" UBYTE B_TRUE 1 100 0 1 BIT_MASK 0x1 FORMAT "%13.11" ECU_ADDRESS 0x3FBF7E /end MEASUREMENT
/begin MEASUREMENT B_fadisa "" UBYTE B_TRUE 1 100 0 1 BIT_MASK 0x1 FORMAT "%13.11" ECU_ADDRESS 0x3FBE7F /end MEASUREMENT
/begin MEASUREMENT B_fadk "Kompressionstest mit VVT u. konst. DK-Wink" UBYTE B_TRUE 1 100 0 1 BIT_MASK 0x1 FORMAT "%13.11" ECU_ADDRESS 0x3FBE80 /end MEASUREMENT
/begin MEASUREMENT B_fadka "" UBYTE B_TRUE 1 100 0 1 BIT_MASK 0x1 FORMAT "%13.11" ECU_ADDRESS 0x3FBE81 /end MEASUREMENT
/begin MEASUREMENT B_faetr "Bedingung Funktionsanforderung elektr. Thermostatregelung" UBYTE B_TRUE 1 100 0 1 BIT_MASK 0x1 FORMAT "%13.11" ECU_ADDRESS 0x3FBE82 /end MEASUREMENT
/begin MEASUREMENT B_faevz "Bedingung Zylinderausblendung durch Tester" UBYTE B_TRUE 1 100 0 1 BIT_MASK 0x1 FORMAT "%13.11" ECU_ADDRESS 0x3FBE83 /end MEASUREMENT
/begin MEASUREMENT B_faglf "Bedingung Funktionsanforderung: gesteuerte Luftf¸hrung" UBYTE B_TRUE 1 100 0 1 BIT_MASK 0x1 FORMAT "%13.11" ECU_ADDRESS 0x3FBE84 /end MEASUREMENT
/begin MEASUREMENT B_fakat "Bedingung Funktionsanforderung Katalysator¸berwachung" UBYTE B_TRUE 1 100 0 1 BIT_MASK 0x1 FORMAT "%13.11" ECU_ADDRESS 0x3FBE85 /end MEASUREMENT
/begin MEASUREMENT B_fakvs "Funktionsaufforderung Diagnose Kraftstoffsystem f¸r Schnelltest" UBYTE B_TRUE 1 100 0 1 BIT_MASK 0x1 FORMAT "%13.11" ECU_ADDRESS 0x3FBF7F /end MEASUREMENT
/begin MEASUREMENT B_fallas "Bedingung Testeransteuerung Leerlaufadaption sperren" UBYTE B_TRUE 1 100 0 1 BIT_MASK 0x1 FORMAT "%13.11" ECU_ADDRESS 0x3FBE86 /end MEASUREMENT
/begin MEASUREMENT B_falls "Bedingung: Funktionsanforderung Drehzahl‰nderung durch Tester" UBYTE B_TRUE 1 100 0 1 BIT_MASK 0x1 FORMAT "%13.11" ECU_ADDRESS 0x3FBE87 /end MEASUREMENT
/begin MEASUREMENT B_falr "Bedingung: Funktionsanforderung Lambdaregelung aus" UBYTE B_TRUE 1 100 0 1 BIT_MASK 0x1 FORMAT "%13.11" ECU_ADDRESS 0x3FBE88 /end MEASUREMENT
/begin MEASUREMENT B_falra "Bedingung: Funktionsanforderung Lambdaregelung-Adaption" UBYTE B_TRUE 1 100 0 1 BIT_MASK 0x1 FORMAT "%13.11" ECU_ADDRESS 0x3FBE89 /end MEASUREMENT
/begin MEASUREMENT B_falsh "Bedingung Funktionsanforderung Lambda-Sonde hinter KAT" UBYTE B_TRUE 1 100 0 1 BIT_MASK 0x1 FORMAT "%13.11" ECU_ADDRESS 0x3FBE8A /end MEASUREMENT
/begin MEASUREMENT B_falsh2 "Bedingung Funktionsanforderung Lambda-Sonde hinter KAT Bank2" UBYTE B_TRUE 1 100 0 1 BIT_MASK 0x1 FORMAT "%13.11" ECU_ADDRESS 0x3FBF80 /end MEASUREMENT
/begin MEASUREMENT B_falsv "Bedingung Funktionsanforderung Lambda-Sonde vor KAT" UBYTE B_TRUE 1 100 0 1 BIT_MASK 0x1 FORMAT "%13.11" ECU_ADDRESS 0x3FBE8B /end MEASUREMENT
/begin MEASUREMENT B_falsv2 "Bedingung Funktionsanforderung Lambda-Sonde vor KAT Bank2" UBYTE B_TRUE 1 100 0 1 BIT_MASK 0x1 FORMAT "%13.11" ECU_ADDRESS 0x3FBE8C /end MEASUREMENT
/begin MEASUREMENT B_famls "Bedingung Funktionsanforderung Motorl¸fter" UBYTE B_TRUE 1 100 0 1 BIT_MASK 0x1 FORMAT "%13.11" ECU_ADDRESS 0x3FBE8D /end MEASUREMENT
/begin MEASUREMENT B_fanws "Bedingung Funktionsanforderung Diagnose Nockenwellensteuerung" UBYTE B_TRUE 1 100 0 1 BIT_MASK 0x1 FORMAT "%13.11" ECU_ADDRESS 0x3FBE8E /end MEASUREMENT
/begin MEASUREMENT B_fanwsaa "Bedingung Funktionsanforderung Diagnose NWS aktiv (Auslaﬂ)" UBYTE B_TRUE 1 100 0 1 BIT_MASK 0x1 FORMAT "%13.11" ECU_ADDRESS 0x3FBF81 /end MEASUREMENT
/begin MEASUREMENT B_fanwsd "Bedingung Funktionsanforderung Nockenwellenregelung Dichtheit" UBYTE B_TRUE 1 100 0 1 BIT_MASK 0x1 FORMAT "%13.11" ECU_ADDRESS 0x3FBE8F /end MEASUREMENT
/begin MEASUREMENT B_fanwsea "Bedingung Funktionsanforderung Diagnose NWS aktiv (Einlaﬂ)" UBYTE B_TRUE 1 100 0 1 BIT_MASK 0x1 FORMAT "%13.11" ECU_ADDRESS 0x3FBF82 /end MEASUREMENT
/begin MEASUREMENT B_fash "Bedingung Funktionsanforderung Schwingungspr¸fung" UBYTE B_TRUE 1 100 0 1 BIT_MASK 0x1 FORMAT "%13.11" ECU_ADDRESS 0x3FBF83 /end MEASUREMENT
/begin MEASUREMENT B_fasla "Bedingung: externe Anforderung an Sekund‰rluft aktiv" UBYTE B_TRUE 1 100 0 1 BIT_MASK 0x1 FORMAT "%13.11" ECU_ADDRESS 0x3FC01A /end MEASUREMENT
/begin MEASUREMENT B_fasls "Bedingung Funktionsanforderung Sekund‰rluftsystem" UBYTE B_TRUE 1 100 0 1 BIT_MASK 0x1 FORMAT "%13.11" ECU_ADDRESS 0x3FBE90 /end MEASUREMENT
/begin MEASUREMENT B_fates "Bedingung Funktionsanforderung Tankentl¸ftungssystem" UBYTE B_TRUE 1 100 0 1 BIT_MASK 0x1 FORMAT "%13.11" ECU_ADDRESS 0x3FBE91 /end MEASUREMENT
/begin MEASUREMENT B_fatp "Bedingung Funktionsanforderung TP-‹berwachung" UBYTE B_TRUE 1 100 0 1 BIT_MASK 0x1 FORMAT "%13.11" ECU_ADDRESS 0x3FBF84 /end MEASUREMENT
/begin MEASUREMENT B_fatp2 "Bedingung Funktionsanforderung TP-‹berwachung Bank2" UBYTE B_TRUE 1 100 0 1 BIT_MASK 0x1 FORMAT "%13.11" ECU_ADDRESS 0x3FBF85 /end MEASUREMENT
/begin MEASUREMENT B_fatv "Bedingung Funktionsanforderung TV-‹berwachung" UBYTE B_TRUE 1 100 0 1 BIT_MASK 0x1 FORMAT "%13.11" ECU_ADDRESS 0x3FBF86 /end MEASUREMENT
/begin MEASUREMENT B_fatv2 "Bedingung Funktionsanforderung TV-‹berwachung Bank2" UBYTE B_TRUE 1 100 0 1 BIT_MASK 0x1 FORMAT "%13.11" ECU_ADDRESS 0x3FBF87 /end MEASUREMENT
/begin MEASUREMENT B_fedkb "Bedingung F¸llungserfassung drosselklappenbasiert" UBYTE B_TRUE 1 100 0 1 BIT_MASK 0x1 FORMAT "%13.11" ECU_ADDRESS 0x3FBF88 /end MEASUREMENT
/begin MEASUREMENT B_fhz "Bedingung Frontscheibenheizung" UBYTE B_TRUE 1 100 0 1 BIT_MASK 0x1 FORMAT "%13.11" ECU_ADDRESS 0x3FBF89 /end MEASUREMENT
/begin MEASUREMENT B_fonresv "Anforderung Reset der Fuel-On Adaption durchf¸hren (VVT-Fehler)" UBYTE B_TRUE 1 100 0 1 BIT_MASK 0x1 FORMAT "%13.11" ECU_ADDRESS 0x3FBF8A /end MEASUREMENT
/begin MEASUREMENT B_fphubap "Bedingung Hubsteuerung direkt ¸ber Fahrpedal" UBYTE B_TRUE 1 100 0 1 BIT_MASK 0x1 FORMAT "%13.11" ECU_ADDRESS 0x3FBF3C /end MEASUREMENT
/begin MEASUREMENT B_fpwdkap "DK-Steuerung direkt ¸ber Fahrpedal" UBYTE B_TRUE 1 100 0 1 BIT_MASK 0x1 FORMAT "%13.11" ECU_ADDRESS 0x3FBF3D /end MEASUREMENT
/begin MEASUREMENT B_ftedab "Bedingung Sp¸lrate f¸r Diagnose zusteuern" UBYTE B_TRUE 1 100 0 1 BIT_MASK 0x1 FORMAT "%13.11" ECU_ADDRESS 0x3FBF8B /end MEASUREMENT
/begin MEASUREMENT B_fzg_on "Bedingung Betrieb im Fahrzeug aktiviert" UBYTE B_TRUE 1 100 0 1 BIT_MASK 0x1 FORMAT "%13.11" ECU_ADDRESS 0x3FBF3E /end MEASUREMENT
/begin MEASUREMENT B_gen1 "Bedingung kein Einfluss des Generatormomentes auf mdverl" UBYTE B_TRUE 1 100 0 1 BIT_MASK 0x1 FORMAT "%13.11" ECU_ADDRESS 0x3FBF3F /end MEASUREMENT
/begin MEASUREMENT B_gen2 "Bedingung kein Einfluss des Generatormomentes auf mimin" UBYTE B_TRUE 1 100 0 1 BIT_MASK 0x1 FORMAT "%13.11" ECU_ADDRESS 0x3FBF40 /end MEASUREMENT
/begin MEASUREMENT B_glfet "Bedingung gesteuerte Luftf¸hrung Testeranforderung" UBYTE B_TRUE 1 100 0 1 BIT_MASK 0x1 FORMAT "%13.11" ECU_ADDRESS 0x3FBE92 /end MEASUREMENT
/begin MEASUREMENT B_glue "" UBYTE B_TRUE 1 100 0 1 FORMAT "%13.11" ECU_ADDRESS 0x5B8A74 /end MEASUREMENT
/begin MEASUREMENT B_grdst "Bedingung Grundeinstellung" UBYTE B_TRUE 1 100 0 1 BIT_MASK 0x1 FORMAT "%13.11" ECU_ADDRESS 0x3FBE93 /end MEASUREMENT
/begin MEASUREMENT B_gsaf "Bedingung Getriebe-Schalteingriff-Anforderung" UBYTE B_TRUE 1 100 0 1 BIT_MASK 0x1 FORMAT "%13.11" ECU_ADDRESS 0x3FBF8C /end MEASUREMENT
/begin MEASUREMENT B_hdc "Bedingung Hill Desent Control aktiv" UBYTE B_TRUE 1 100 0 1 BIT_MASK 0x1 FORMAT "%13.11" ECU_ADDRESS 0x3FBF8D /end MEASUREMENT
/begin MEASUREMENT B_HLSKW "Bedingung Heizleistungsteigerung" UBYTE B_TRUE 1 100 0 1 BIT_MASK 0x1 FORMAT "%13.11" ECU_ADDRESS 0x3FBF8E /end MEASUREMENT
/begin MEASUREMENT B_hshet "" UBYTE B_TRUE 1 100 0 1 BIT_MASK 0x1 FORMAT "%13.11" ECU_ADDRESS 0x3FBE94 /end MEASUREMENT
/begin MEASUREMENT B_hsvet "" UBYTE B_TRUE 1 100 0 1 BIT_MASK 0x1 FORMAT "%13.11" ECU_ADDRESS 0x3FBE95 /end MEASUREMENT
/begin MEASUREMENT B_hubap "Bedingung Hubsteuerung ¸ber Festwert" UBYTE B_TRUE 1 100 0 1 BIT_MASK 0x1 FORMAT "%13.11" ECU_ADDRESS 0x3FBF41 /end MEASUREMENT
/begin MEASUREMENT B_i_ska_fr "FR-Fehlerreaktion irreversible SKA (Sicherheits-Kraftstoff-Abschaltung)" UBYTE B_TRUE 1 100 0 1 BIT_MASK 0x1 FORMAT "%13.11" ECU_ADDRESS 0x3FBC82 /end MEASUREMENT
/begin MEASUREMENT B_katfz "Bedingung Kat in Fahrzeug eingebaut" UBYTE B_TRUE 1 100 0 1 BIT_MASK 0x1 FORMAT "%13.11" ECU_ADDRESS 0x3FBF42 /end MEASUREMENT
/begin MEASUREMENT B_kftkr "" UBYTE B_TRUE 1 100 0 1 BIT_MASK 0x1 FORMAT "%13.11" ECU_ADDRESS 0x3FBF8F /end MEASUREMENT
/begin MEASUREMENT B_kftvar "Variantenbit f¸r Kennfeldthermostat vorhanden" UBYTE B_TRUE 1 100 0 1 BIT_MASK 0x1 FORMAT "%13.11" ECU_ADDRESS 0x3FBF90 /end MEASUREMENT
/begin MEASUREMENT B_kmmilsct "Ausgabe ""km bei MIL on"" f¸r Scan Tool abschalten (0 = keine Ausgabe in PID $21)" UBYTE B_TRUE 1 100 0 1 BIT_MASK 0x1 FORMAT "%13.11" ECU_ADDRESS 0x3FBF43 /end MEASUREMENT
/begin MEASUREMENT B_koger "Bedingung geregelter/ungeregelter Klimakompressor" UBYTE B_TRUE 1 100 0 1 BIT_MASK 0x1 FORMAT "%13.11" ECU_ADDRESS 0x3FBF91 /end MEASUREMENT
/begin MEASUREMENT B_koset "Stellglieddiagnose Klimakompressor-Relais: Eingriff Tester" UBYTE B_TRUE 1 100 0 1 BIT_MASK 0x1 FORMAT "%13.11" ECU_ADDRESS 0x3FBE96 /end MEASUREMENT
/begin MEASUREMENT B_kse "Bedingung Anfettung bei Klopfschutz" UBYTE B_TRUE 1 100 0 1 BIT_MASK 0x1 FORMAT "%13.11" ECU_ADDRESS 0x3FBF92 /end MEASUREMENT
/begin MEASUREMENT B_kvta "Bedingung verbrauchter Kraftstoff groesser max. Tankinhalt" UBYTE B_TRUE 1 100 0 1 BIT_MASK 0x1 FORMAT "%13.11" ECU_ADDRESS 0x3FBF93 /end MEASUREMENT
/begin MEASUREMENT B_lamdkt "Lambdasoll Eingriff f¸r Katdiagnose aktiv" UBYTE B_TRUE 1 100 0 1 FORMAT "%13.11" ECU_ADDRESS 0x5B89FC /end MEASUREMENT
/begin MEASUREMENT B_llk "Bedingung nwe unterschritten (hysteresebehaftet)" UBYTE dez 1 100 0 255 FORMAT "%5.1" ECU_ADDRESS 0x5B8B6D /end MEASUREMENT
/begin MEASUREMENT B_lmsslof "Bedingung Lambda-Motor-Soll-Sekund‰rluftanteil, Aus" UBYTE B_TRUE 1 100 0 1 BIT_MASK 0x1 FORMAT "%13.11" ECU_ADDRESS 0x3FC01B /end MEASUREMENT
/begin MEASUREMENT B_lowra "Bedingung Zwischengelege f¸r Low Range zugeschaltet" UBYTE B_TRUE 1 100 0 1 BIT_MASK 0x1 FORMAT "%13.11" ECU_ADDRESS 0x3FBF94 /end MEASUREMENT
/begin MEASUREMENT B_lrat "Bedingung Gemischadaption temperaturabh‰ngig freigegeben" UBYTE B_TRUE 1 100 0 1 BIT_MASK 0x1 FORMAT "%13.11" ECU_ADDRESS 0x3FBF95 /end MEASUREMENT
/begin MEASUREMENT B_lrndia "Bedingung: DV-E-Adaption und Pr¸fungen per Diagnose-Tester aktivieren" UBYTE B_TRUE 1 100 0 1 BIT_MASK 0x1 FORMAT "%13.11" ECU_ADDRESS 0x3FBF96 /end MEASUREMENT
/begin MEASUREMENT B_lroff "Bedingung: Drehzahlschwelle f¸r Loadresponse-Funktion des Generators ausschalten" UBYTE B_TRUE 1 100 0 1 BIT_MASK 0x1 FORMAT "%13.11" ECU_ADDRESS 0x3FBF97 /end MEASUREMENT
/begin MEASUREMENT B_lrs "LRSEB: Bedingung Lambdaregelung intern(vor Kat); (Bank 1)" UBYTE B_TRUE 1 100 0 1 BIT_MASK 0x1 FORMAT "%13.11" ECU_ADDRESS 0x3FBF98 /end MEASUREMENT
/begin MEASUREMENT B_lrssa "LRSEB: Einschaltbed. f¸r Lambdareg. nach Schub bei langsamer Sonde" UBYTE B_TRUE 1 100 0 1 BIT_MASK 0x1 FORMAT "%13.11" ECU_ADDRESS 0x3FBF99 /end MEASUREMENT
/begin MEASUREMENT B_lsh "Bedingung Lambda-Sonde hinter Kat verbaut" UBYTE B_TRUE 1 100 0 1 BIT_MASK 0x1 FORMAT "%13.11" ECU_ADDRESS 0x3FBF44 /end MEASUREMENT
/begin MEASUREMENT B_lsh2 "Bedingung Lambda-Sonde hinter Kat verbaut (Bank2)" UBYTE B_TRUE 1 100 0 1 BIT_MASK 0x1 FORMAT "%13.11" ECU_ADDRESS 0x3FBF45 /end MEASUREMENT
/begin MEASUREMENT B_lsv "Bedingung Lambda-Sonde vor Kat verbaut, 1. Sonde nach Auslaﬂ (Bank1)" UBYTE B_TRUE 1 100 0 1 BIT_MASK 0x1 FORMAT "%13.11" ECU_ADDRESS 0x3FBF46 /end MEASUREMENT
/begin MEASUREMENT B_lsv2 "Bedingung Lambda-Sonde vor Kat verbaut, 1. Sonde nach Auslaﬂ (Bank2)" UBYTE B_TRUE 1 100 0 1 BIT_MASK 0x1 FORMAT "%13.11" ECU_ADDRESS 0x3FBF47 /end MEASUREMENT
/begin MEASUREMENT B_lsvvsp "Bedingung Vertauschte Lambda-Sonden, Regelung sperren" UBYTE B_TRUE 1 100 0 1 BIT_MASK 0x1 FORMAT "%13.11" ECU_ADDRESS 0x3FBF9A /end MEASUREMENT
/begin MEASUREMENT B_m8te "Bedingung Fkt-Anforderung Tankentl¸ftung nach SAE J1979 Mode 8 TID $01" UBYTE B_TRUE 1 100 0 1 BIT_MASK 0x1 FORMAT "%13.11" ECU_ADDRESS 0x3FBF9B /end MEASUREMENT
/begin MEASUREMENT B_m9cvn "Bedingung zur Berechnung der Checksumme (CVN) nach SAE/ISO Mode/Service $09" UBYTE B_TRUE 1 100 0 1 BIT_MASK 0x1 FORMAT "%13.11" ECU_ADDRESS 0x3FBEA1 /end MEASUREMENT
/begin MEASUREMENT B_m9cvnTmp "" UBYTE B_TRUE 1 100 0 1 BIT_MASK 0x1 FORMAT "%13.11" ECU_ADDRESS 0x3FBEA2 /end MEASUREMENT
/begin MEASUREMENT B_masterhw "Bedingung Master-SG gem‰ﬂ Codier-Pin (plausibilisiert)" UBYTE B_TRUE 1 100 0 1 BIT_MASK 0x1 FORMAT "%13.11" ECU_ADDRESS 0x3FBF9C /end MEASUREMENT
/begin MEASUREMENT B_mde8e "Bedingung Mode $08 erlaubt" UBYTE B_TRUE 1 100 0 1 BIT_MASK 0x1 FORMAT "%13.11" ECU_ADDRESS 0x3FBF48 /end MEASUREMENT
/begin MEASUREMENT B_mde9e "Bedingung Mode $09 erlaubt" UBYTE B_TRUE 1 100 0 1 BIT_MASK 0x1 FORMAT "%13.11" ECU_ADDRESS 0x3FBF49 /end MEASUREMENT
/begin MEASUREMENT B_mdwaner "Bedingung Fehler auf mdwan_w" UBYTE B_TRUE 1 100 0 1 BIT_MASK 0x1 FORMAT "%13.11" ECU_ADDRESS 0x3FBF9D /end MEASUREMENT
/begin MEASUREMENT B_mls3et "Bedingung Bauteileansteuerung;  Motorl¸fter 3 (enable)" UBYTE B_TRUE 1 100 0 1 BIT_MASK 0x1 FORMAT "%13.11" ECU_ADDRESS 0x3FBE97 /end MEASUREMENT
/begin MEASUREMENT B_mrfavl "Vollasterkennung ¸ber relativen Fahrerwunsch" UBYTE B_TRUE 1 100 0 1 BIT_MASK 0x1 FORMAT "%13.11" ECU_ADDRESS 0x3FBF4A /end MEASUREMENT
/begin MEASUREMENT B_msloff "Sekund‰rluftmasse ausger‰umt nach Sekund‰rluftphase" UBYTE B_TRUE 1 100 0 1 BIT_MASK 0x1 FORMAT "%13.11" ECU_ADDRESS 0x3FC01C /end MEASUREMENT
/begin MEASUREMENT B_mslon "Sekund‰rluftmasse eingeschwungen nach Start der Sekund‰rluft" UBYTE B_TRUE 1 100 0 1 BIT_MASK 0x1 FORMAT "%13.11" ECU_ADDRESS 0x3FC01D /end MEASUREMENT
/begin MEASUREMENT B_ndsav "Bedingung EEPROM-Emulation aktiv" UBYTE B_TRUE 1 100 0 1 BIT_MASK 0x1 FORMAT "%13.11" ECU_ADDRESS 0x3FBF4B /end MEASUREMENT
/begin MEASUREMENT B_nnot "Bedingung Drehzahlanhebung im Notlauf" UBYTE DEZ 1 100 0 1 BIT_MASK 0x1 FORMAT "%5.3" ECU_ADDRESS 0x3FBF9E /end MEASUREMENT
/begin MEASUREMENT B_notlu_fr "Anforderung Notluftfahren vom Funktionsrechner" UBYTE B_TRUE 1 100 0 1 BIT_MASK 0x1 FORMAT "%13.11" ECU_ADDRESS 0x3FBC83 /end MEASUREMENT
/begin MEASUREMENT B_nstabk "" UBYTE B_TRUE 1 100 0 1 BIT_MASK 0x1 FORMAT "%13.11" ECU_ADDRESS 0x3FBF9F /end MEASUREMENT
/begin MEASUREMENT B_nswo1 "Bedingung Drehzahl > NSWO1" UBYTE B_TRUE 1 100 0 1 BIT_MASK 0x1 FORMAT "%13.11" ECU_ADDRESS 0x3FBF4C /end MEASUREMENT
/begin MEASUREMENT B_nswo2 "Bedingung Drehzahl > NSWO2" UBYTE B_TRUE 1 100 0 1 BIT_MASK 0x1 FORMAT "%13.11" ECU_ADDRESS 0x3FBF4D /end MEASUREMENT
/begin MEASUREMENT B_nws "Bedingung Nockenwellensteuerung" UBYTE B_TRUE 1 100 0 1 BIT_MASK 0x1 FORMAT "%13.11" ECU_ADDRESS 0x3FBFA0 /end MEASUREMENT
/begin MEASUREMENT B_phsnl "Bedingung Phasensuche w‰hrend PG-Notlauf" UBYTE B_TRUE 1 100 0 1 BIT_MASK 0x1 FORMAT "%13.11" ECU_ADDRESS 0x3FBFA1 /end MEASUREMENT
/begin MEASUREMENT B_phsnlinv "Bedingung Phaselage invertieren" UBYTE B_TRUE 1 100 0 1 BIT_MASK 0x1 FORMAT "%13.11" ECU_ADDRESS 0x3FBFA2 /end MEASUREMENT
/begin MEASUREMENT B_psapp "Bedingung delta Saugrohrdruck Vorsteuerung f¸r Applikation" UBYTE B_TRUE 1 100 0 1 BIT_MASK 0x1 FORMAT "%13.11" ECU_ADDRESS 0x3FBF4E /end MEASUREMENT
/begin MEASUREMENT B_psger "Bedingung Umschaltung Saugrohrdruck auf gerechnetem" UBYTE B_TRUE 1 100 0 1 BIT_MASK 0x1 FORMAT "%13.11" ECU_ADDRESS 0x3FBF4F /end MEASUREMENT
/begin MEASUREMENT B_rlh "Bedingung Saugrohrmodell mit PS-Modell" UBYTE B_TRUE 1 100 0 1 BIT_MASK 0x1 FORMAT "%13.11" ECU_ADDRESS 0x3FBFA3 /end MEASUREMENT
/begin MEASUREMENT B_sacvt "Bedingung Schubabschaltunterst¸tzung f¸r CVT-Getriebe" UBYTE B_TRUE 1 100 0 1 BIT_MASK 0x1 FORMAT "%13.11" ECU_ADDRESS 0x3FBFA4 /end MEASUREMENT
/begin MEASUREMENT B_savacc "Bedingung: Schubabschalteverbot von ACC" UBYTE B_TRUE 1 100 0 1 BIT_MASK 0x1 FORMAT "%13.11" ECU_ADDRESS 0x3FBFA5 /end MEASUREMENT
/begin MEASUREMENT B_sch "BDE-Betriebsart schicht" UBYTE B_TRUE 1 100 0 1 BIT_MASK 0x1 FORMAT "%13.11" ECU_ADDRESS 0x3FBFA6 /end MEASUREMENT
/begin MEASUREMENT B_sgs "Bedingung: Momenteingriff zur Drehzahlsynchronisation bei Getriebeschaltung" UBYTE B_TRUE 1 100 0 1 BIT_MASK 0x1 FORMAT "%13.11" ECU_ADDRESS 0x3FBFA7 /end MEASUREMENT
/begin MEASUREMENT B_sl "Bedingung Servo-Lenkung" UBYTE B_TRUE 1 100 0 1 BIT_MASK 0x1 FORMAT "%13.11" ECU_ADDRESS 0x3FBFA8 /end MEASUREMENT
/begin MEASUREMENT B_sldsl4 "Bedingung: Freigabe Sekund‰rluft f¸r Diagnosephase 4" UWORD B_TRUE 1 100 0 1 BIT_MASK 0x4 FORMAT "%13.11" ECU_ADDRESS 0x5B8AD0 /end MEASUREMENT
/begin MEASUREMENT B_slkhof "Bedingung Abschalten der Sekund‰rluftpumpe durch imlpr-Schwelle" UBYTE B_TRUE 1 100 0 1 BIT_MASK 0x1 FORMAT "%13.11" ECU_ADDRESS 0x3FC01E /end MEASUREMENT
/begin MEASUREMENT B_slkt "Bedingung: Freigabe Sekund‰rluft f¸r Kurztest" UWORD B_TRUE 1 100 0 1 BIT_MASK 0x8 FORMAT "%13.11" ECU_ADDRESS 0x5B8AD0 /end MEASUREMENT
/begin MEASUREMENT B_slp "Bedingung f¸r Sekund‰rluftpumpe" UBYTE B_TRUE 1 100 0 1 BIT_MASK 0x1 FORMAT "%13.11" ECU_ADDRESS 0x3FC01F /end MEASUREMENT
/begin MEASUREMENT B_slpena "Bedingung Einschalten der Sekund‰rluftpumpe" UWORD B_TRUE 1 100 0 1 BIT_MASK 0x10 FORMAT "%13.11" ECU_ADDRESS 0x5B8AD0 /end MEASUREMENT
/begin MEASUREMENT B_slpet "Stellglieddiagnose SLP: Eingriff Tester" UBYTE B_TRUE 1 100 0 1 BIT_MASK 0x1 FORMAT "%13.11" ECU_ADDRESS 0x3FBE98 /end MEASUREMENT
/begin MEASUREMENT B_slpmn "Mindestbetriebszeit der Sekund‰rluftpumpe" UBYTE B_TRUE 1 100 0 1 BIT_MASK 0x1 FORMAT "%13.11" ECU_ADDRESS 0x3FC020 /end MEASUREMENT
/begin MEASUREMENT B_slpoff "Sekund‰rluftpumpe abgeschaltet" UBYTE B_TRUE 1 100 0 1 BIT_MASK 0x1 FORMAT "%13.11" ECU_ADDRESS 0x3FC021 /end MEASUREMENT
/begin MEASUREMENT B_slpofst "Bedingung f¸r Setzen Flip Flop  B_slpoff" UWORD B_TRUE 1 100 0 1 BIT_MASK 0x20 FORMAT "%13.11" ECU_ADDRESS 0x5B8AD0 /end MEASUREMENT
/begin MEASUREMENT B_sls "Bedingung Sekund‰rluft aktiv" UBYTE B_TRUE 1 100 0 1 BIT_MASK 0x1 FORMAT "%13.11" ECU_ADDRESS 0x3FC022 /end MEASUREMENT
/begin MEASUREMENT B_slsadap "Bedingung: Sekund‰rluftmassenadaption" UBYTE B_TRUE 1 100 0 1 BIT_MASK 0x1 FORMAT "%13.11" ECU_ADDRESS 0x3FC023 /end MEASUREMENT
/begin MEASUREMENT B_slsdis "Bedingung f¸r  Abschalten der Sekund‰rluftpumpe" UWORD B_TRUE 1 100 0 1 BIT_MASK 0x80 FORMAT "%13.11" ECU_ADDRESS 0x5B8AD0 /end MEASUREMENT
/begin MEASUREMENT B_slserr "Bedingungen sperren Einschalten der Sekund‰rluftpumpe" UWORD B_TRUE 1 100 0 1 BIT_MASK 0x100 FORMAT "%13.11" ECU_ADDRESS 0x5B8AD0 /end MEASUREMENT
/begin MEASUREMENT B_slsfz "Bedingung SLS in Fahrzeug eingebaut" UBYTE B_TRUE 1 100 0 1 BIT_MASK 0x1 FORMAT "%13.11" ECU_ADDRESS 0x3FBFA9 /end MEASUREMENT
/begin MEASUREMENT B_slsoab "Bedingung SLS ohne Abbruchkriterium durchgef¸hrt" UWORD B_TRUE 1 100 0 1 BIT_MASK 0x200 FORMAT "%13.11" ECU_ADDRESS 0x5B8AD0 /end MEASUREMENT
/begin MEASUREMENT B_slsoff "Sekund‰rlufteinblasung nach Ausr‰umen der Sekund‰rluft beendet" UBYTE B_TRUE 1 100 0 1 BIT_MASK 0x1 FORMAT "%13.11" ECU_ADDRESS 0x3FC024 /end MEASUREMENT
/begin MEASUREMENT B_slv "Bedingung f¸r Sekund‰rluftventil" UBYTE B_TRUE 1 100 0 1 BIT_MASK 0x1 FORMAT "%13.11" ECU_ADDRESS 0x3FC025 /end MEASUREMENT
/begin MEASUREMENT B_slvet "Stellglieddiagnose SLV: Eingriff Tester" UBYTE B_TRUE 1 100 0 1 BIT_MASK 0x1 FORMAT "%13.11" ECU_ADDRESS 0x3FBE99 /end MEASUREMENT
/begin MEASUREMENT B_sslvet "Stellglieddiagnose Schaltventil SLV: Eingriff Tester" UBYTE B_TRUE 1 100 0 1 BIT_MASK 0x1 FORMAT "%13.11" ECU_ADDRESS 0x3FBE9A /end MEASUREMENT
/begin MEASUREMENT B_sta "Bedingung automatischer Start" UBYTE B_TRUE 1 100 0 1 BIT_MASK 0x1 FORMAT "%13.11" ECU_ADDRESS 0x3FBFAA /end MEASUREMENT
/begin MEASUREMENT B_staa "Bedingung Startadaption aktiv im Nachstart" UBYTE B_TRUE 1 100 0 1 BIT_MASK 0x1 FORMAT "%13.11" ECU_ADDRESS 0x3FBFAB /end MEASUREMENT
/begin MEASUREMENT B_staet "Stellglieddiagnose Startrelais: Eingriff Tester" UBYTE B_TRUE 1 100 0 1 BIT_MASK 0x1 FORMAT "%13.11" ECU_ADDRESS 0x3FBE9B /end MEASUREMENT
/begin MEASUREMENT B_tankd "Ansteuerung Lampe Check-Filler-Cap" UBYTE B_TRUE 1 100 0 1 BIT_MASK 0x1 FORMAT "%13.11" ECU_ADDRESS 0x3FBFAC /end MEASUREMENT
/begin MEASUREMENT B_temin "Bedingung TEMIN-Begrenzung aktiv, Bank 1" UBYTE B_TRUE 1 100 0 1 BIT_MASK 0x1 FORMAT "%13.11" ECU_ADDRESS 0x5B8B47 /end MEASUREMENT
/begin MEASUREMENT B_temin2 "Bedingung TEMIN-Begrenzung aktiv, Bank 2" UBYTE B_TRUE 1 100 0 1 BIT_MASK 0x1 FORMAT "%13.11" ECU_ADDRESS 0x5B8B48 /end MEASUREMENT
/begin MEASUREMENT B_temxon "RL Begrenzung aktiv" UBYTE B_TRUE 1 100 0 1 BIT_MASK 0x1 FORMAT "%13.11" ECU_ADDRESS 0x3FBFAD /end MEASUREMENT
/begin MEASUREMENT B_tevcheck "" UBYTE B_TRUE 1 100 0 1 BIT_MASK 0x1 FORMAT "%13.11" ECU_ADDRESS 0x3FBFAE /end MEASUREMENT
/begin MEASUREMENT B_tevet "Condition purge valve on by tester" UBYTE B_TRUE 1 100 0 1 BIT_MASK 0x1 FORMAT "%13.11" ECU_ADDRESS 0x3FBE9C /end MEASUREMENT
/begin MEASUREMENT B_teza "Bedingung Tankentl¸ftung zwangsaktiv" UBYTE B_TRUE 1 100 0 1 BIT_MASK 0x1 FORMAT "%13.11" ECU_ADDRESS 0x3FBFAF /end MEASUREMENT
/begin MEASUREMENT B_tfst2ok "CAN: Fuellstandssignal Geber 2 okay" UBYTE B_TRUE 1 100 0 1 BIT_MASK 0x1 FORMAT "%13.11" ECU_ADDRESS 0x3FBFB0 /end MEASUREMENT
/begin MEASUREMENT B_tfstok "CAN: Fuellstandssignal Geber 1 okay" UBYTE B_TRUE 1 100 0 1 BIT_MASK 0x1 FORMAT "%13.11" ECU_ADDRESS 0x3FBFB1 /end MEASUREMENT
/begin MEASUREMENT B_tfu "Bedingung Temperaturf¸hler Umgebung vorhanden" UBYTE B_TRUE 1 100 0 1 BIT_MASK 0x1 FORMAT "%13.11" ECU_ADDRESS 0x3FBF50 /end MEASUREMENT
/begin MEASUREMENT B_uhrrmin "Bedingung Uhr mit relativem Minutenz‰hler" UBYTE B_TRUE 1 100 0 1 BIT_MASK 0x1 FORMAT "%13.11" ECU_ADDRESS 0x3FBF51 /end MEASUREMENT
/begin MEASUREMENT B_uhrrsec "Bedingung Uhr mit relativem Sekundenz‰hler" UBYTE B_TRUE 1 100 0 1 BIT_MASK 0x1 FORMAT "%13.11" ECU_ADDRESS 0x3FBF52 /end MEASUREMENT
/begin MEASUREMENT B_vlsumrb "Bedingung: LSU hat Kennlinienverschiebung nach mager (zeigt zu mager an)" UBYTE B_TRUE 1 100 0 1 BIT_MASK 0x1 FORMAT "%13.11" ECU_ADDRESS 0x3FBFB2 /end MEASUREMENT
/begin MEASUREMENT B_vsast "" UBYTE B_TRUE 1 100 0 1 FORMAT "%13.11" ECU_ADDRESS 0x5B8A75 /end MEASUREMENT
/begin MEASUREMENT B_vsest "" UBYTE B_TRUE 1 100 0 1 FORMAT "%13.11" ECU_ADDRESS 0x5B8A76 /end MEASUREMENT
/begin MEASUREMENT B_vvtnotl "Bedingung VVT-Notlauf" UBYTE B_TRUE 1 100 0 1 BIT_MASK 0x1 FORMAT "%13.11" ECU_ADDRESS 0x3FBFB3 /end MEASUREMENT
/begin MEASUREMENT B_vzare "" UBYTE B_TRUE 1 100 0 1 FORMAT "%13.11" ECU_ADDRESS 0x5B8A77 /end MEASUREMENT
/begin MEASUREMENT B_vzere "" UBYTE B_TRUE 1 100 0 1 FORMAT "%13.11" ECU_ADDRESS 0x5B8A78 /end MEASUREMENT
/begin MEASUREMENT B_wdksap "DK-Steuerung ¸ber Festwert, Bit 1 hat Priorit‰t" UBYTE B_TRUE 1 100 0 1 BIT_MASK 0x1 FORMAT "%13.11" ECU_ADDRESS 0x3FBE9D /end MEASUREMENT
/begin MEASUREMENT B_wdksapcw "DK-Steuerung ¸ber Festwert, Bit 1 hat Priorit‰t" UBYTE B_TRUE 1 100 0 1 BIT_MASK 0x1 FORMAT "%13.11" ECU_ADDRESS 0x3FBF53 /end MEASUREMENT
/begin MEASUREMENT B_whslpkh "" UWORD B_TRUE 1 100 0 1 BIT_MASK 0x800 FORMAT "%13.11" ECU_ADDRESS 0x5B8AD0 /end MEASUREMENT
/begin MEASUREMENT B_wnwmnbe "minimaler Adaptionsgrenzwert erreicht, Sollwertbegrenzung aktiv" UBYTE B_TRUE 1 100 0 1 FORMAT "%13.11" ECU_ADDRESS 0x5B8A79 /end MEASUREMENT
/begin MEASUREMENT B_zwappl "Bedingung Z¸ndwinkelapplikation ohne Drehmomenteingriffe" UBYTE B_TRUE 1 100 0 1 BIT_MASK 0x1 FORMAT "%13.11" ECU_ADDRESS 0x3FBF54 /end MEASUREMENT
/begin MEASUREMENT cd_bits1_w "" UWORD dez 1 100 0 65535 FORMAT "%8.2" ECU_ADDRESS 0x5B9424 /end MEASUREMENT
/begin MEASUREMENT cd_bits2_w "" UWORD dez 1 100 0 65535 FORMAT "%8.2" ECU_ADDRESS 0x5B9426 /end MEASUREMENT
/begin MEASUREMENT common_rt "" ULONG dez 1 100 0 4.29497e+009 FORMAT "%13.2" ECU_ADDRESS 0x5B9B24 /end MEASUREMENT
/begin MEASUREMENT cw_erfil "Status Codewort Filtervariante f¸r Ausgabe der AS-Fehler an GST" UBYTE dez 1 100 0 255 FORMAT "%5.1" ECU_ADDRESS 0x5B8FBD /end MEASUREMENT
/begin MEASUREMENT dastd "" SWORD sprzi_q0p8 1 100 -26214.4 26213.6 FORMAT "%8.2" ECU_ADDRESS 0x5B97C2 /end MEASUREMENT
/begin MEASUREMENT dastdll "" SWORD sprzi_q0p8 1 100 -26214.4 26213.6 FORMAT "%8.2" ECU_ADDRESS 0x5B97C4 /end MEASUREMENT
/begin MEASUREMENT destd "" SWORD sprzi_q0p8 1 100 -26214.4 26213.6 FORMAT "%8.2" ECU_ADDRESS 0x5B97C6 /end MEASUREMENT
/begin MEASUREMENT destdll "" SWORD sprzi_q0p8 1 100 -26214.4 26213.6 FORMAT "%8.2" ECU_ADDRESS 0x5B97C8 /end MEASUREMENT
/begin MEASUREMENT devhubi_w "Delta Istwert Hubverstellung" SWORD hub_uw_q0p001 1 100 -32.768 32.767 FORMAT "%8.5" ECU_ADDRESS 0x5B9428 /end MEASUREMENT
/begin MEASUREMENT dhubra_w "Hubrampe f¸r ‹bergang auf Vollhub" UWORD hub_uw_q0p001 1 100 0 12 FORMAT "%8.5" ECU_ADDRESS 0x5B9782 /end MEASUREMENT
/begin MEASUREMENT disatst "Testersollwert bei geregelter Saugrohrumschaltung (DISA)" UBYTE rel_ub_b100 1 100 0 100 FORMAT "%5.1" ECU_ADDRESS 0x5B8881 /end MEASUREMENT
/begin MEASUREMENT disa_sta "" UBYTE dez 1 100 0 255 FORMAT "%5.1" ECU_ADDRESS 0x5B8CC3 /end MEASUREMENT
/begin MEASUREMENT dkatstat "Funktionsstatus DKATSP bei Anforderung Systemcheck" UBYTE DEZ 1 100 0 255 FORMAT "%5.1" ECU_ADDRESS 0x5B8A1A /end MEASUREMENT
/begin MEASUREMENT dlahi_w "I-Anteil der stetigen LRHK" SWORD fak_sw_b1 1 100 -1 0.999969 FORMAT "%8.6" ECU_ADDRESS 0x5B9784 /end MEASUREMENT
/begin MEASUREMENT dmrlsv_w "Momenten-Reserve f¸r Sondendiagnose vor Kat" UWORD rel_uw_b100 1 100 0 99.9985 FORMAT "%8.5" ECU_ADDRESS 0x5B8A0E /end MEASUREMENT
/begin MEASUREMENT dpsad_w "delta-Saugrohrdruck f¸r Adaption" SWORD p_sw_q0p039 1 100 -1280 1279.96 FORMAT "%8.3" ECU_ADDRESS 0x5B9786 /end MEASUREMENT
/begin MEASUREMENT dpsddss_w "delta Saugrohrdruck gemessen mit Differenzdrucksensor Saugrohr" SWORD p_sw_q0p039 1 100 -1280 1279.96 FORMAT "%8.3" ECU_ADDRESS 0x5B9788 /end MEASUREMENT
/begin MEASUREMENT dpsdpsad_w "Differenzdruck Saugrohr aus Adaption" SWORD p_q0p039 1 100 -1280 1279.96 FORMAT "%8.3" ECU_ADDRESS 0x5B978A /end MEASUREMENT
/begin MEASUREMENT dpsraus_i "Differenzdruck Saugrohr Adaption I-Anteil" UWORD p_q0p039s32768 1 100 -1280 1279.96 FORMAT "%7.2" ECU_ADDRESS 0x5B978C /end MEASUREMENT
/begin MEASUREMENT dps_w "delta-Saugrohrdruck" SWORD p_sw_q0p039 1 100 -1280 1279.96 FORMAT "%8.3" ECU_ADDRESS 0x5B978E /end MEASUREMENT
/begin MEASUREMENT dpus_w "Delta Druck Umgebung Saugrohr" SWORD p_q0p039 1 100 -1280 1279.96 FORMAT "%8.3" ECU_ADDRESS 0x5B966A /end MEASUREMENT
/begin MEASUREMENT dr_reg_resetBuffer "" ULONG default 1 100 0 4.29497e+009 FORMAT "%13.2" ARRAY_SIZE 60 ECU_ADDRESS 0x3FC770 /end MEASUREMENT
/begin MEASUREMENT dr_reg_resetBuffer_cnt "" UWORD default 1 100 0 65535 FORMAT "%8.2" ECU_ADDRESS 0x3FC868 /end MEASUREMENT
/begin MEASUREMENT dr_reg_resetBuffer_idx "" UWORD default 1 100 0 65535 FORMAT "%8.2" ECU_ADDRESS 0x3FC864 /end MEASUREMENT
/begin MEASUREMENT dr_reg_resetTimestampBuffer "" ULONG default 1 100 0 4.29497e+009 FORMAT "%13.2" ARRAY_SIZE 10 ECU_ADDRESS 0x3FC870 /end MEASUREMENT
/begin MEASUREMENT dr_reg_resetTimestampBuffer_idx "" UWORD default 1 100 0 65535 FORMAT "%8.2" ECU_ADDRESS 0x3FC89C /end MEASUREMENT
/begin MEASUREMENT dynlsu_w "Dynamikwert der LSU" UWORD fak_uw_b16 1 100 0 15.9998 FORMAT "%8.5" ECU_ADDRESS 0x3FDCB4 /end MEASUREMENT
/begin MEASUREMENT Ellk "Leerlauf Einlasspreizung gedrosselt kalt zum Katheizen" UBYTE sprzi_q0p8 1 100 0 204 FORMAT "%5.1" ECU_ADDRESS 0x5B8CEC /end MEASUREMENT
/begin MEASUREMENT Ellw "Leerlauf Einlasspreizung gedrosselt warm zum Katheizen" UBYTE sprzi_q0p8 1 100 0 204 FORMAT "%5.1" ECU_ADDRESS 0x5B8CED /end MEASUREMENT
/begin MEASUREMENT errorCntTcsort "" UBYTE dez 1 100 0 255 FORMAT "%5.1" ECU_ADDRESS 0x5B851E /end MEASUREMENT
/begin MEASUREMENT Esk "optimale Einlasspreizung kalt ungedrosselt" UBYTE sprzi_q0p8 1 100 0 204 FORMAT "%5.1" ECU_ADDRESS 0x5B8CEE /end MEASUREMENT
/begin MEASUREMENT Espr "Sollwert Einlasspreizung" UBYTE sprzi_q0p8 1 100 0 204 FORMAT "%5.1" ECU_ADDRESS 0x5B8CEF /end MEASUREMENT
/begin MEASUREMENT Esprimx "Max der ist Einlassspreizung" UWORD sprzi_q0p1 1 100 0 6553.5 FORMAT "%4.0" ECU_ADDRESS 0x5B8A7E /end MEASUREMENT
/begin MEASUREMENT Esprl "Leerlauf Einlasspreizung gedrosselt" UBYTE sprzi_q0p8 1 100 0 204 FORMAT "%5.1" ECU_ADDRESS 0x5B8CF0 /end MEASUREMENT
/begin MEASUREMENT Esprlu "Leerlauf Einlasspreizung ungedrosselt" UBYTE sprzi_q0p8 1 100 0 204 FORMAT "%5.1" ECU_ADDRESS 0x5B8CF1 /end MEASUREMENT
/begin MEASUREMENT Esprt "Einlasspreizung teilgedrosselt" UBYTE sprzi_q0p8 1 100 0 204 FORMAT "%5.1" ECU_ADDRESS 0x5B8CF2 /end MEASUREMENT
/begin MEASUREMENT Espru "Einlasspreizung ungedrosselt" UBYTE sprzi_q0p8 1 100 0 204 FORMAT "%5.1" ECU_ADDRESS 0x5B8CF3 /end MEASUREMENT
/begin MEASUREMENT esst_san12esuw "" ULONG dez 1 100 0 4.29497e+009 FORMAT "%13.2" ECU_ADDRESS 0x5B983C /end MEASUREMENT
/begin MEASUREMENT esst_seh06kruw "" ULONG dez 1 100 0 4.29497e+009 FORMAT "%13.2" ECU_ADDRESS 0x5B9840 /end MEASUREMENT
/begin MEASUREMENT esst_sez06tmub "" ULONG dez 1 100 0 4.29497e+009 FORMAT "%13.2" ECU_ADDRESS 0x5B9844 /end MEASUREMENT
/begin MEASUREMENT esst_sfr04bbuw "" ULONG dez 1 100 0 4.29497e+009 FORMAT "%13.2" ECU_ADDRESS 0x5B9848 /end MEASUREMENT
/begin MEASUREMENT esst_sfr08teub "" ULONG dez 1 100 0 4.29497e+009 FORMAT "%13.2" ECU_ADDRESS 0x5B984C /end MEASUREMENT
/begin MEASUREMENT esst_sga07mdub "" ULONG dez 1 100 0 4.29497e+009 FORMAT "%13.2" ECU_ADDRESS 0x5B9850 /end MEASUREMENT
/begin MEASUREMENT esst_sga08mdub "" ULONG dez 1 100 0 4.29497e+009 FORMAT "%13.2" ECU_ADDRESS 0x5B9854 /end MEASUREMENT
/begin MEASUREMENT esst_sks06esub "" ULONG dez 1 100 0 4.29497e+009 FORMAT "%13.2" ECU_ADDRESS 0x5B9858 /end MEASUREMENT
/begin MEASUREMENT esst_slx06tmuw "" ULONG dez 1 100 0 4.29497e+009 FORMAT "%13.2" ECU_ADDRESS 0x5B985C /end MEASUREMENT
/begin MEASUREMENT esst_smi08khub "" ULONG dez 1 100 0 4.29497e+009 FORMAT "%13.2" ECU_ADDRESS 0x5B9860 /end MEASUREMENT
/begin MEASUREMENT esst_sml05dkub "" ULONG dez 1 100 0 4.29497e+009 FORMAT "%13.2" ECU_ADDRESS 0x5B9864 /end MEASUREMENT
/begin MEASUREMENT esst_sml05lkub "" ULONG dez 1 100 0 4.29497e+009 FORMAT "%13.2" ECU_ADDRESS 0x5B9868 /end MEASUREMENT
/begin MEASUREMENT esst_sml06tmuw "" ULONG dez 1 100 0 4.29497e+009 FORMAT "%13.2" ECU_ADDRESS 0x5B986C /end MEASUREMENT
/begin MEASUREMENT esst_sml07tmuw "" ULONG dez 1 100 0 4.29497e+009 FORMAT "%13.2" ECU_ADDRESS 0x5B9870 /end MEASUREMENT
/begin MEASUREMENT esst_sml08lhub "" ULONG dez 1 100 0 4.29497e+009 FORMAT "%13.2" ECU_ADDRESS 0x5B9874 /end MEASUREMENT
/begin MEASUREMENT esst_sml08teub "" ULONG dez 1 100 0 4.29497e+009 FORMAT "%13.2" ECU_ADDRESS 0x5B9878 /end MEASUREMENT
/begin MEASUREMENT esst_sn16kr1ub "" ULONG dez 1 100 0 4.29497e+009 FORMAT "%13.2" ECU_ADDRESS 0x5B987C /end MEASUREMENT
/begin MEASUREMENT esst_sn16kr2ub "" ULONG dez 1 100 0 4.29497e+009 FORMAT "%13.2" ECU_ADDRESS 0x5B9880 /end MEASUREMENT
/begin MEASUREMENT esst_sng04sasb "" ULONG dez 1 100 0 4.29497e+009 FORMAT "%13.2" ECU_ADDRESS 0x5B9884 /end MEASUREMENT
/begin MEASUREMENT esst_sng06llsb "" ULONG dez 1 100 0 4.29497e+009 FORMAT "%13.2" ECU_ADDRESS 0x5B9888 /end MEASUREMENT
/begin MEASUREMENT esst_sng06lltsb "" ULONG dez 1 100 0 4.29497e+009 FORMAT "%13.2" ECU_ADDRESS 0x5B988C /end MEASUREMENT
/begin MEASUREMENT esst_snm04dmuw1 "" ULONG dez 1 100 0 4.29497e+009 FORMAT "%13.2" ECU_ADDRESS 0x5B9890 /end MEASUREMENT
/begin MEASUREMENT esst_snm04dmuw2 "" ULONG dez 1 100 0 4.29497e+009 FORMAT "%13.2" ECU_ADDRESS 0x5B9894 /end MEASUREMENT
/begin MEASUREMENT esst_snm05dkub "" ULONG dez 1 100 0 4.29497e+009 FORMAT "%13.2" ECU_ADDRESS 0x5B9898 /end MEASUREMENT
/begin MEASUREMENT esst_snm06lhub "" ULONG dez 1 100 0 4.29497e+009 FORMAT "%13.2" ECU_ADDRESS 0x5B989C /end MEASUREMENT
/begin MEASUREMENT esst_snm06llub "" ULONG dez 1 100 0 4.29497e+009 FORMAT "%13.2" ECU_ADDRESS 0x5B98A0 /end MEASUREMENT
/begin MEASUREMENT esst_snm06mduw "" ULONG dez 1 100 0 4.29497e+009 FORMAT "%13.2" ECU_ADDRESS 0x5B98A4 /end MEASUREMENT
/begin MEASUREMENT esst_snm07esub "" ULONG dez 1 100 0 4.29497e+009 FORMAT "%13.2" ECU_ADDRESS 0x5B98A8 /end MEASUREMENT
/begin MEASUREMENT esst_snm07lrub "" ULONG dez 1 100 0 4.29497e+009 FORMAT "%13.2" ECU_ADDRESS 0x5B98AC /end MEASUREMENT
/begin MEASUREMENT esst_snm08dmub "" ULONG dez 1 100 0 4.29497e+009 FORMAT "%13.2" ECU_ADDRESS 0x5B98B0 /end MEASUREMENT
/begin MEASUREMENT esst_snm08dmuw1 "" ULONG dez 1 100 0 4.29497e+009 FORMAT "%13.2" ECU_ADDRESS 0x5B98B4 /end MEASUREMENT
/begin MEASUREMENT esst_snm08dmuw2 "" ULONG dez 1 100 0 4.29497e+009 FORMAT "%13.2" ECU_ADDRESS 0x5B98B8 /end MEASUREMENT
/begin MEASUREMENT esst_snm08feub "" ULONG dez 1 100 0 4.29497e+009 FORMAT "%13.2" ECU_ADDRESS 0x5B98BC /end MEASUREMENT
/begin MEASUREMENT esst_snm08gkub "" ULONG dez 1 100 0 4.29497e+009 FORMAT "%13.2" ECU_ADDRESS 0x5B98C0 /end MEASUREMENT
/begin MEASUREMENT esst_snm08khub "" ULONG dez 1 100 0 4.29497e+009 FORMAT "%13.2" ECU_ADDRESS 0x5B98C4 /end MEASUREMENT
/begin MEASUREMENT esst_snm08lhub "" ULONG dez 1 100 0 4.29497e+009 FORMAT "%13.2" ECU_ADDRESS 0x5B98C8 /end MEASUREMENT
/begin MEASUREMENT esst_snm08opub "" ULONG dez 1 100 0 4.29497e+009 FORMAT "%13.2" ECU_ADDRESS 0x5B98CC /end MEASUREMENT
/begin MEASUREMENT esst_snm08stub "" ULONG dez 1 100 0 4.29497e+009 FORMAT "%13.2" ECU_ADDRESS 0x5B98D0 /end MEASUREMENT
/begin MEASUREMENT esst_snm08zuub "" ULONG dez 1 100 0 4.29497e+009 FORMAT "%13.2" ECU_ADDRESS 0x5B98D4 /end MEASUREMENT
/begin MEASUREMENT esst_snm08__ub "" ULONG dez 1 100 0 4.29497e+009 FORMAT "%13.2" ECU_ADDRESS 0x5B98D8 /end MEASUREMENT
/begin MEASUREMENT esst_snm12esub "" ULONG dez 1 100 0 4.29497e+009 FORMAT "%13.2" ECU_ADDRESS 0x5B98DC /end MEASUREMENT
/begin MEASUREMENT esst_snm12feub "" ULONG dez 1 100 0 4.29497e+009 FORMAT "%13.2" ECU_ADDRESS 0x5B98E0 /end MEASUREMENT
/begin MEASUREMENT esst_snm12kruw "" ULONG dez 1 100 0 4.29497e+009 FORMAT "%13.2" ECU_ADDRESS 0x5B98E4 /end MEASUREMENT
/begin MEASUREMENT esst_snm16gkub "" ULONG dez 1 100 0 4.29497e+009 FORMAT "%13.2" ECU_ADDRESS 0x5B98E8 /end MEASUREMENT
/begin MEASUREMENT esst_snm16krub "" ULONG dez 1 100 0 4.29497e+009 FORMAT "%13.2" ECU_ADDRESS 0x5B98EC /end MEASUREMENT
/begin MEASUREMENT esst_snm16opuw "" ULONG dez 1 100 0 4.29497e+009 FORMAT "%13.2" ECU_ADDRESS 0x5B98F0 /end MEASUREMENT
/begin MEASUREMENT esst_snm16zuub "" ULONG dez 1 100 0 4.29497e+009 FORMAT "%13.2" ECU_ADDRESS 0x5B98F4 /end MEASUREMENT
/begin MEASUREMENT esst_snm24zuub "" ULONG dez 1 100 0 4.29497e+009 FORMAT "%13.2" ECU_ADDRESS 0x5B98F8 /end MEASUREMENT
/begin MEASUREMENT esst_snm24zuub1 "" ULONG dez 1 100 0 4.29497e+009 FORMAT "%13.2" ECU_ADDRESS 0x5B98FC /end MEASUREMENT
/begin MEASUREMENT esst_snm24zuub2 "" ULONG dez 1 100 0 4.29497e+009 FORMAT "%13.2" ECU_ADDRESS 0x5B9900 /end MEASUREMENT
/begin MEASUREMENT esst_sqm05teub "" ULONG dez 1 100 0 4.29497e+009 FORMAT "%13.2" ECU_ADDRESS 0x5B9904 /end MEASUREMENT
/begin MEASUREMENT esst_srl03zuub "" ULONG dez 1 100 0 4.29497e+009 FORMAT "%13.2" ECU_ADDRESS 0x5B9908 /end MEASUREMENT
/begin MEASUREMENT esst_srl04krub "" ULONG dez 1 100 0 4.29497e+009 FORMAT "%13.2" ECU_ADDRESS 0x5B990C /end MEASUREMENT
/begin MEASUREMENT esst_srl06lhub "" ULONG dez 1 100 0 4.29497e+009 FORMAT "%13.2" ECU_ADDRESS 0x5B9910 /end MEASUREMENT
/begin MEASUREMENT esst_srl06lrub "" ULONG dez 1 100 0 4.29497e+009 FORMAT "%13.2" ECU_ADDRESS 0x5B9914 /end MEASUREMENT
/begin MEASUREMENT esst_srl08dmub "" ULONG dez 1 100 0 4.29497e+009 FORMAT "%13.2" ECU_ADDRESS 0x5B9918 /end MEASUREMENT
/begin MEASUREMENT esst_srl08dyub "" ULONG dez 1 100 0 4.29497e+009 FORMAT "%13.2" ECU_ADDRESS 0x5B991C /end MEASUREMENT
/begin MEASUREMENT esst_srl08gkub "" ULONG dez 1 100 0 4.29497e+009 FORMAT "%13.2" ECU_ADDRESS 0x5B9920 /end MEASUREMENT
/begin MEASUREMENT esst_srl08zuub "" ULONG dez 1 100 0 4.29497e+009 FORMAT "%13.2" ECU_ADDRESS 0x5B9924 /end MEASUREMENT
/begin MEASUREMENT esst_srl12esub "" ULONG dez 1 100 0 4.29497e+009 FORMAT "%13.2" ECU_ADDRESS 0x5B9928 /end MEASUREMENT
/begin MEASUREMENT esst_srl12gkub "" ULONG dez 1 100 0 4.29497e+009 FORMAT "%13.2" ECU_ADDRESS 0x5B992C /end MEASUREMENT
/begin MEASUREMENT esst_srl12zuub "" ULONG dez 1 100 0 4.29497e+009 FORMAT "%13.2" ECU_ADDRESS 0x5B9930 /end MEASUREMENT
/begin MEASUREMENT esst_srl16zuub "" ULONG dez 1 100 0 4.29497e+009 FORMAT "%13.2" ECU_ADDRESS 0x5B9934 /end MEASUREMENT
/begin MEASUREMENT esst_sst_restgas12_nmot_w "" ULONG dez 1 100 0 4.29497e+009 FORMAT "%13.2" ECU_ADDRESS 0x5B9B54 /end MEASUREMENT
/begin MEASUREMENT esst_sst_restgas12_rlvw_w "" ULONG dez 1 100 0 4.29497e+009 FORMAT "%13.2" ECU_ADDRESS 0x5B9B58 /end MEASUREMENT
/begin MEASUREMENT esst_sst_restgas16t_nmot_w "" ULONG dez 1 100 0 4.29497e+009 FORMAT "%13.2" ECU_ADDRESS 0x5B9B5C /end MEASUREMENT
/begin MEASUREMENT esst_sst_restgas16_nmot_w "" ULONG dez 1 100 0 4.29497e+009 FORMAT "%13.2" ECU_ADDRESS 0x5B9B60 /end MEASUREMENT
/begin MEASUREMENT esst_sst_restgas16_rlvw_w "" ULONG dez 1 100 0 4.29497e+009 FORMAT "%13.2" ECU_ADDRESS 0x5B9B64 /end MEASUREMENT
/begin MEASUREMENT esst_st107tmub "" ULONG dez 1 100 0 4.29497e+009 FORMAT "%13.2" ECU_ADDRESS 0x5B9938 /end MEASUREMENT
/begin MEASUREMENT esst_st307tmub "" ULONG dez 1 100 0 4.29497e+009 FORMAT "%13.2" ECU_ADDRESS 0x5B993C /end MEASUREMENT
/begin MEASUREMENT esst_sta04saub "" ULONG dez 1 100 0 4.29497e+009 FORMAT "%13.2" ECU_ADDRESS 0x5B9940 /end MEASUREMENT
/begin MEASUREMENT esst_sta06esub "" ULONG dez 1 100 0 4.29497e+009 FORMAT "%13.2" ECU_ADDRESS 0x5B9944 /end MEASUREMENT
/begin MEASUREMENT esst_stm04feub "" ULONG dez 1 100 0 4.29497e+009 FORMAT "%13.2" ECU_ADDRESS 0x5B9948 /end MEASUREMENT
/begin MEASUREMENT esst_stm04saub "" ULONG dez 1 100 0 4.29497e+009 FORMAT "%13.2" ECU_ADDRESS 0x5B994C /end MEASUREMENT
/begin MEASUREMENT esst_stm05saub "" ULONG dez 1 100 0 4.29497e+009 FORMAT "%13.2" ECU_ADDRESS 0x5B9950 /end MEASUREMENT
/begin MEASUREMENT esst_stm05tmub "" ULONG dez 1 100 0 4.29497e+009 FORMAT "%13.2" ECU_ADDRESS 0x5B9954 /end MEASUREMENT
/begin MEASUREMENT esst_stm06lltub "" ULONG dez 1 100 0 4.29497e+009 FORMAT "%13.2" ECU_ADDRESS 0x5B9958 /end MEASUREMENT
/begin MEASUREMENT esst_stm06llub "" ULONG dez 1 100 0 4.29497e+009 FORMAT "%13.2" ECU_ADDRESS 0x5B995C /end MEASUREMENT
/begin MEASUREMENT esst_stm06__ub "" ULONG dez 1 100 0 4.29497e+009 FORMAT "%13.2" ECU_ADDRESS 0x5B9960 /end MEASUREMENT
/begin MEASUREMENT esst_stm08bbub "" ULONG dez 1 100 0 4.29497e+009 FORMAT "%13.2" ECU_ADDRESS 0x5B9964 /end MEASUREMENT
/begin MEASUREMENT esst_stm08dmub "" ULONG dez 1 100 0 4.29497e+009 FORMAT "%13.2" ECU_ADDRESS 0x5B9968 /end MEASUREMENT
/begin MEASUREMENT esst_stm08leub "" ULONG dez 1 100 0 4.29497e+009 FORMAT "%13.2" ECU_ADDRESS 0x5B996C /end MEASUREMENT
/begin MEASUREMENT esst_stm08mdub "" ULONG dez 1 100 0 4.29497e+009 FORMAT "%13.2" ECU_ADDRESS 0x5B9970 /end MEASUREMENT
/begin MEASUREMENT esst_stm09esub "" ULONG dez 1 100 0 4.29497e+009 FORMAT "%13.2" ECU_ADDRESS 0x5B9974 /end MEASUREMENT
/begin MEASUREMENT esst_stm12esub "" ULONG dez 1 100 0 4.29497e+009 FORMAT "%13.2" ECU_ADDRESS 0x5B9978 /end MEASUREMENT
/begin MEASUREMENT esst_stm16wlub "" ULONG dez 1 100 0 4.29497e+009 FORMAT "%13.2" ECU_ADDRESS 0x5B997C /end MEASUREMENT
/begin MEASUREMENT esst_sts12esub "" ULONG dez 1 100 0 4.29497e+009 FORMAT "%13.2" ECU_ADDRESS 0x5B9980 /end MEASUREMENT
/begin MEASUREMENT esst_sva07feuw "" ULONG dez 1 100 0 4.29497e+009 FORMAT "%13.2" ECU_ADDRESS 0x5B9984 /end MEASUREMENT
/begin MEASUREMENT esst_sve07feuw "" ULONG dez 1 100 0 4.29497e+009 FORMAT "%13.2" ECU_ADDRESS 0x5B9988 /end MEASUREMENT
/begin MEASUREMENT esst_swp08opub "" ULONG dez 1 100 0 4.29497e+009 FORMAT "%13.2" ECU_ADDRESS 0x5B998C /end MEASUREMENT
/begin MEASUREMENT Estk "optimale Einlasspreizung kalt teilgedrosselt" UBYTE sprzi_q0p8 1 100 0 204 FORMAT "%5.1" ECU_ADDRESS 0x5B8CF4 /end MEASUREMENT
/begin MEASUREMENT Estw "optimale Einlasspreizung warm teilgedrosselt" UBYTE sprzi_q0p8 1 100 0 204 FORMAT "%5.1" ECU_ADDRESS 0x5B8CF5 /end MEASUREMENT
/begin MEASUREMENT Esw "optimale Einlasspreizung warm ungedrosselt" UBYTE sprzi_q0p8 1 100 0 204 FORMAT "%5.1" ECU_ADDRESS 0x5B8CF6 /end MEASUREMENT
/begin MEASUREMENT Eswll "optimale Einlasspreizung warm ungedrosselt im Leerlauf" UBYTE sprzi_q0p8 1 100 0 204 FORMAT "%5.1" ECU_ADDRESS 0x5B8CF7 /end MEASUREMENT
/begin MEASUREMENT evhubi2_w "Istwert Hubverstellung Bank 2" UWORD hub_uw_q0p001 1 100 0 12 FORMAT "%8.5" ECU_ADDRESS 0x5B9790 /end MEASUREMENT
/begin MEASUREMENT evhubi_w "Istwert Hubverstellung" UWORD hub_uw_q0p001 1 100 0 12 FORMAT "%8.5" ECU_ADDRESS 0x5B9792 /end MEASUREMENT
/begin MEASUREMENT evhubs_kf "" UWORD hub_uw_q0p001 1 100 0 65.535 FORMAT "%8.5" ECU_ADDRESS 0x5B9794 /end MEASUREMENT
/begin MEASUREMENT evhubs_w "Sollwert Hubverstellung" UWORD hub_uw_q0p001 1 100 0 12 FORMAT "%8.5" ECU_ADDRESS 0x5B9796 /end MEASUREMENT
/begin MEASUREMENT exwinks_w "Sollwert Exzenterwinkel VVT" UWORD wink_uw_q0p1 1 100 0 230 FORMAT "%8.4" ECU_ADDRESS 0x5B9798 /end MEASUREMENT
/begin MEASUREMENT exwnki2_w "Istwert Exzenterwinkel VVT Bank 2" UWORD wink_uw_q0p1 1 100 0 230 FORMAT "%8.4" ECU_ADDRESS 0x5B979A /end MEASUREMENT
/begin MEASUREMENT exwnki_w "Istwert Exzenterwinkel VVT" UWORD wink_uw_q0p1 1 100 0 230 FORMAT "%8.4" ECU_ADDRESS 0x5B979C /end MEASUREMENT
/begin MEASUREMENT E_vvt_vsa "" UBYTE B_TRUE 1 100 0 1 FORMAT "%13.11" ECU_ADDRESS 0x5B89FD /end MEASUREMENT
/begin MEASUREMENT E_vvt_vse "" UBYTE B_TRUE 1 100 0 1 FORMAT "%13.11" ECU_ADDRESS 0x5B89FE /end MEASUREMENT
/begin MEASUREMENT Fastw_aus "Faktor Auslass teilgedrosselt" UBYTE fakspr_q0p0039 1 100 0 0.996094 ECU_ADDRESS 0x5B8CF8 /end MEASUREMENT
/begin MEASUREMENT Faswll_aus "" UBYTE fakspr_q0p0039 1 100 0 0.996094 ECU_ADDRESS 0x5B8CF9 /end MEASUREMENT
/begin MEASUREMENT Fasw_aus "Faktor Auslass ungedrosselt" UBYTE fakspr_q0p0039 1 100 0 0.996094 ECU_ADDRESS 0x5B8CFA /end MEASUREMENT
/begin MEASUREMENT Festw_aus "Faktor Einlass teilgedrosselt" UBYTE fakspr_q0p0039 1 100 0 0.996094 ECU_ADDRESS 0x5B8CFB /end MEASUREMENT
/begin MEASUREMENT Feswll_aus "" UBYTE fakspr_q0p0039 1 100 0 0.996094 ECU_ADDRESS 0x5B8CFC /end MEASUREMENT
/begin MEASUREMENT Fesw_aus "Faktor Einlass ungedrosselt" UBYTE fakspr_q0p0039 1 100 0 0.996094 ECU_ADDRESS 0x5B8CFD /end MEASUREMENT
/begin MEASUREMENT fhkrst_w "Einspritzkorrektur bei hoher Kraftstofftemperatur" SWORD fak_sw_b2x 1 100 0 1.99997 FORMAT "%8.6" ECU_ADDRESS 0x5B876A /end MEASUREMENT
/begin MEASUREMENT fhubvnsi_w "fhubvnss_w oder ¸ber NOHUBMO auf 1 geklemmt" UWORD dez 1 100 0 65535 FORMAT "%8.2" ECU_ADDRESS 0x5B979E /end MEASUREMENT
/begin MEASUREMENT fhubwll_au "" UBYTE dez 1 100 0 255 FORMAT "%5.1" ECU_ADDRESS 0x5B8CC4 /end MEASUREMENT
/begin MEASUREMENT flamsl_w "Faktor Lambda‰nderung durch Sekund‰rluft" UWORD fak_uw_b16 1 100 0 15.9998 FORMAT "%8.5" ECU_ADDRESS 0x5B8ACA /end MEASUREMENT
/begin MEASUREMENT flmssl "Faktor Lambda-Motor-Soll-Sekund‰rluftanteil" UBYTE fak_ub_b1 1 100 0 0.996094 ECU_ADDRESS 0x5B8AC1 /end MEASUREMENT
/begin MEASUREMENT fmsagd "Korrekturfaktor Abgasgegendruck der Sekund‰rluftmasse" UBYTE fak_ub_b2 1 100 0 1.99219 FORMAT "%5.3" ECU_ADDRESS 0x5B8AC2 /end MEASUREMENT
/begin MEASUREMENT fmsldyn "Faktor Dynamikbeschreibung Sekund‰rluft" UBYTE fak_ub_b1 1 100 0 0.996094 ECU_ADDRESS 0x5B8AC3 /end MEASUREMENT
/begin MEASUREMENT fmslrho "Dichtekorrektur der Sekund‰rluftmasse" UBYTE fak_ub_b2 1 100 0 1.99219 FORMAT "%5.3" ECU_ADDRESS 0x5B8AC4 /end MEASUREMENT
/begin MEASUREMENT fmsltm "tmot- Korrektur der Sekund‰rluftmasse" UBYTE fak_ub_b2 1 100 0 1.99219 FORMAT "%5.3" ECU_ADDRESS 0x5B8AC5 /end MEASUREMENT
/begin MEASUREMENT frdter_w "Faktor Regelung Referenz f¸r TE-Diagnose" UWORD dez 1 100 0 65535 FORMAT "%8.2" ECU_ADDRESS 0x5B8A00 /end MEASUREMENT
/begin MEASUREMENT frkte_w "Faktor Umrechnung rel. Kraftstoffmasse rk in effekt. Einspritzzeit te" UWORD fak_uw_b16 1 100 0 1 FORMAT "%8.6" ECU_ADDRESS 0x5B966C /end MEASUREMENT
/begin MEASUREMENT frlfsdp_w "Einspritzzeitkorrektur bei returnless Systemen" SWORD fak_sw_b2x 1 100 0 1.99997 FORMAT "%8.6" ECU_ADDRESS 0x5B876C /end MEASUREMENT
/begin MEASUREMENT fslpdyn "Faktor Dynamikbeschreibung Sekund‰rluftpumpe" UBYTE fak_ub_b1 1 100 0 0.996094 ECU_ADDRESS 0x5B8AC6 /end MEASUREMENT
/begin MEASUREMENT ftek2_w "Korrekturfaktor f¸r effektive Einspritzzeit, Bank 2" UWORD fak_uw_b16 1 100 0 1.99976 FORMAT "%8.6" ECU_ADDRESS 0x5B876E /end MEASUREMENT
/begin MEASUREMENT ftek_w "Korrekturfaktor f¸r effektive Einspritzzeit" UWORD fak_uw_b16 1 100 0 1.99976 FORMAT "%8.6" ECU_ADDRESS 0x5B8770 /end MEASUREMENT
/begin MEASUREMENT gen_htar "" UBYTE B_TRUE 1 100 0 1 BIT_MASK 0x1 FORMAT "%13.11" ECU_ADDRESS 0x3FBFB4 /end MEASUREMENT
/begin MEASUREMENT gen_last "" UBYTE B_TRUE 1 100 0 1 BIT_MASK 0x1 FORMAT "%13.11" ECU_ADDRESS 0x3FBFB5 /end MEASUREMENT
/begin MEASUREMENT gvist "Istwert Laufunruhe" SWORD fak_sw_b64 1 100 -64 63.998 FORMAT "%8.5" ECU_ADDRESS 0x5B97A0 /end MEASUREMENT
/begin MEASUREMENT hshtim "" UBYTE dez 1 100 0 255 FORMAT "%5.1" ECU_ADDRESS 0x5B8F57 /end MEASUREMENT
/begin MEASUREMENT hsvtim "" UBYTE dez 1 100 0 255 FORMAT "%5.1" ECU_ADDRESS 0x5B8F58 /end MEASUREMENT
/begin MEASUREMENT igenmess "gemessener Generatorstrom" UWORD dez 1 100 0 65535 FORMAT "%8.2" ECU_ADDRESS 0x5B942A /end MEASUREMENT
/begin MEASUREMENT imlsla_w "Luftmassenintegral f¸r Einbringen der Sekund‰rluft" UWORD m_uw_b4660 1 100 0 4660.27 FORMAT "%8.3" ECU_ADDRESS 0x5B8ACC /end MEASUREMENT
/begin MEASUREMENT imlsle_w "Luftmassenintegral f¸r Ende der Sekund‰rluft im Abgas" UWORD m_uw_b4660 1 100 0 4660.27 FORMAT "%8.3" ECU_ADDRESS 0x5B8ACE /end MEASUREMENT
/begin MEASUREMENT i_dmesys "" UBYTE strom_q3 1 100 0 765 FORMAT "%5.1" ECU_ADDRESS 0x5B8FC0 /end MEASUREMENT
/begin MEASUREMENT i_zyl "Zylinderzuordnung bei Stereo Regelung" UBYTE dez 1 100 0 8 FORMAT "%5.3" ECU_ADDRESS 0x5B8C4C /end MEASUREMENT
/begin MEASUREMENT kopwm "Klimakompressor-Signal als PWM-Signal" UBYTE rel_ub_b99p6 1 100 0 99.6094 FORMAT "%5.2" ECU_ADDRESS 0x5B8A02 /end MEASUREMENT
/begin MEASUREMENT krkte_w "Umrechnung relative Kraftstoffmasse rk in effektive Einspritzzeit te" UWORD rkt_uw_b0p5 1 100 0 0.5 FORMAT "%9.7" ECU_ADDRESS 0x5B966E /end MEASUREMENT
/begin MEASUREMENT kstaa "Aktueller Startmengenadaptionsfaktor" UBYTE fak_ub_b2 1 100 0 1.99219 FORMAT "%5.3" ECU_ADDRESS 0x5B8A03 /end MEASUREMENT
/begin MEASUREMENT kvb_w "verbrauchter Kraftstoff" UWORD vol_q3p90625Em3_l 1 100 0 255.996 FORMAT "%8.4" ECU_ADDRESS 0x5B8A10 /end MEASUREMENT
/begin MEASUREMENT lalsuvj_w "Lambda-Istwert" UWORD fak_uw_b2 1 100 0 1.99997 FORMAT "%8.6" ECU_ADDRESS 0x5B8A12 /end MEASUREMENT
/begin MEASUREMENT lamdkt_w "Lambdasoll f¸r Katdiagnose" UWORD fak_uw_b16 1 100 0 15.9998 FORMAT "%8.5" ECU_ADDRESS 0x5B8A14 /end MEASUREMENT
/begin MEASUREMENT lamsoni_w "Lambda-Istwert" UWORD fak_uw_b16 1 100 0 15.9998 FORMAT "%8.5" ECU_ADDRESS 0x5B942C /end MEASUREMENT
/begin MEASUREMENT lurminstat "Lurmin Anforderung DMD - externer Funktionen" UBYTE dez 1 100 0 255 FORMAT "%5.1" ECU_ADDRESS 0x5B8CC5 /end MEASUREMENT
/begin MEASUREMENT L_p_oil "" UBYTE B_TRUE 1 100 0 1 BIT_MASK 0x1 FORMAT "%13.11" ECU_ADDRESS 0x3FBFB6 /end MEASUREMENT
/begin MEASUREMENT L_tp_sw "" UBYTE B_TRUE 1 100 0 1 BIT_MASK 0x1 FORMAT "%13.11" ECU_ADDRESS 0x3FBFB7 /end MEASUREMENT
/begin MEASUREMENT mdarsp_w "Pr‰diziertes Moment aus ARS-Eingriff" UWORD rel_uw_b100 1 100 0 99.9985 FORMAT "%8.5" ECU_ADDRESS 0x5B942E /end MEASUREMENT
/begin MEASUREMENT mims_w "indiziertes Motormoment zum Motorschutz" UWORD rel_uw_b100 1 100 0 99.9985 FORMAT "%8.5" ECU_ADDRESS 0x5B9430 /end MEASUREMENT
/begin MEASUREMENT minhub_w "Minimal-Hub bei Teildrosselung" UWORD hub_uw_q0p001 1 100 0 65.535 FORMAT "%8.5" ECU_ADDRESS 0x5B97A2 /end MEASUREMENT
/begin MEASUREMENT misgsl_w "Inneres Soll-Motormoment luftseitig f¸r Drehzahlsynchr. bei Getriebeschaltung" UWORD rel_uw_b100 1 100 0 99.9985 FORMAT "%8.5" ECU_ADDRESS 0x5B9432 /end MEASUREMENT
/begin MEASUREMENT mistt "Startmoment" UBYTE rel_ub_b99p6 1 100 0 99.6094 FORMAT "%5.2" ECU_ADDRESS 0x5B8F93 /end MEASUREMENT
/begin MEASUREMENT mizsolv_u "Indiziertes resultierendes Sollmoment f¸r ZW-Eingriff vor Momentenbegrenzung" UBYTE rel_ub_b100 1 100 0 100 FORMAT "%5.1" ECU_ADDRESS 0x5B8CC6 /end MEASUREMENT
/begin MEASUREMENT mldpsad "Luftmassenstrom aus WDKADP" SWORD m_uw_b6553p5 1 100 -3276.8 3276.7 FORMAT "%8.3" ECU_ADDRESS 0x5B97A4 /end MEASUREMENT
/begin MEASUREMENT mracc_w "Relativer Momentenwunsch von ACC" UWORD rel_uw_b200 1 100 0 199.997 FORMAT "%8.4" ECU_ADDRESS 0x5B9434 /end MEASUREMENT
/begin MEASUREMENT mrstt_w "relatives Startmoment" UWORD rel_uw_b200 1 100 0 199.997 FORMAT "%8.4" ECU_ADDRESS 0x5B9348 /end MEASUREMENT
/begin MEASUREMENT msl "Sekund‰rluftmassenstrom" UBYTE m_ub_q0p4 1 100 0 102 FORMAT "%5.1" ECU_ADDRESS 0x5B8AC7 /end MEASUREMENT
/begin MEASUREMENT mslpub "Sekund‰rluftmassenstrom, batteriespannungsabh‰ngig" UBYTE m_ub_q0p4 1 100 0 102 FORMAT "%5.1" ECU_ADDRESS 0x5B8AC8 /end MEASUREMENT
/begin MEASUREMENT mslstat "statischer Sekund‰rluftmassenstrom" UBYTE m_ub_q0p4 1 100 0 102 FORMAT "%5.1" ECU_ADDRESS 0x5B8AC9 /end MEASUREMENT
/begin MEASUREMENT msnvvtdnn "" SWORD m_uw_b6553p5 1 100 -3276.8 3276.7 FORMAT "%8.3" ECU_ADDRESS 0x5B97A6 /end MEASUREMENT
/begin MEASUREMENT msnvvtonn "Temperaturabh‰ngiger Offset Massenstrombagleich" SWORD m_uw_b6553p5 1 100 -3276.8 3276.7 FORMAT "%8.3" ECU_ADDRESS 0x5B97A8 /end MEASUREMENT
/begin MEASUREMENT nsolfa "Leerlaufsolldrehzahl, Funktionsanforderung Tester" UBYTE nmot_ub_q10 1 100 0 2550 FORMAT "%5.0" ECU_ADDRESS 0x5B8F59 /end MEASUREMENT
/begin MEASUREMENT nturbc_w "Wandler-Turbinendrehzahl ¸ber CAN" UWORD dez 1 100 0 65535 FORMAT "%8.2" ECU_ADDRESS 0x5B97AA /end MEASUREMENT
/begin MEASUREMENT ofwnktest "" SWORD wink_uw_q0p1 1 100 -3276.8 3276.7 FORMAT "%8.3" ECU_ADDRESS 0x5B8886 /end MEASUREMENT
/begin MEASUREMENT ofwtstber "DUMMY - noch nicht benutzt" UBYTE dez 1 100 0 255 FORMAT "%5.1" ECU_ADDRESS 0x5B8F5A /end MEASUREMENT
/begin MEASUREMENT oscdktf_w "Gefiltertes Sauerstoffspeichervermˆgen des Katalysators, Katdiagnose" UWORD fak_uw_b16 1 100 0 15.9998 FORMAT "%8.5" ECU_ADDRESS 0x3FDCB2 /end MEASUREMENT
/begin MEASUREMENT performance "" UBYTE rel_ub_b100 1 100 0 100 FORMAT "%5.1" ECU_ADDRESS 0x5B8CBF /end MEASUREMENT
/begin MEASUREMENT psagr_w "Partialdruck durch externes Restgas (Restluft+Inertgas)" UWORD p_uw_q0p039 1 100 0 2559.96 FORMAT "%8.3" ECU_ADDRESS 0x5B8A04 /end MEASUREMENT
/begin MEASUREMENT pses_w "Saugrohrdruck ¸ber Verstellsystem korrigiert" UWORD p_q0p039 1 100 0 2559.96 FORMAT "%8.3" ECU_ADDRESS 0x5B8772 /end MEASUREMENT
/begin MEASUREMENT psl "÷ldruck von der Servo-Lenkung" UBYTE dez 1 100 0 255 FORMAT "%5.1" ECU_ADDRESS 0x5B8A06 /end MEASUREMENT
/begin MEASUREMENT pte "Tankdifferenzdruck, Eingangssignal, (nach AD-Wandler)" UBYTE p_sb_q32 1 100 0 63.75 FORMAT "%5.2" ECU_ADDRESS 0x5B8A07 /end MEASUREMENT
/begin MEASUREMENT qnst_w "Drehzahlquotient im Start" UWORD fak_uw_b2 1 100 0 1.99997 FORMAT "%8.6" ECU_ADDRESS 0x5B934A /end MEASUREMENT
/begin MEASUREMENT rkwez_w "Vektor additive Kraftstoffmenge bei Wiedereinsetzen" UWORD t1p0usxms 1 100 0 65.535 FORMAT "%8.5" ARRAY_SIZE 4 ECU_ADDRESS 0x3FB504 /end MEASUREMENT
/begin MEASUREMENT rlmax_w "maximal erreichbare F¸llung bei Turbo" UWORD rel_uw_q0p0234 1 100 0 1535.98 FORMAT "%8.3" ECU_ADDRESS 0x5B8A08 /end MEASUREMENT
/begin MEASUREMENT rlvwrstg_w "" UWORD rel_uw_q0p0234 1 100 0 1535.98 FORMAT "%8.3" ECU_ADDRESS 0x5B97CA /end MEASUREMENT
/begin MEASUREMENT rl_f "relative Luftf¸llung (Float)" FLOAT32_IEEE fak_r32_1 1 100 -1e+037 1e+037 FORMAT "%43.4" ECU_ADDRESS 0x3FB50C /end MEASUREMENT
/begin MEASUREMENT RSThyst1 "Hysterese Einlaﬂseite" UBYTE B_TRUE 1 100 0 1 FORMAT "%13.11" ECU_ADDRESS 0x5B8A7A /end MEASUREMENT
/begin MEASUREMENT RSThyst2 "Hysterese Auslaﬂseite" UBYTE B_TRUE 1 100 0 1 FORMAT "%13.11" ECU_ADDRESS 0x5B8A7B /end MEASUREMENT
/begin MEASUREMENT rt_1000ms "" UWORD txms_uw_q0p0004 1 100 0 26.214 FORMAT "%8.5" ECU_ADDRESS 0x5B9754 /end MEASUREMENT
/begin MEASUREMENT rt_100ms "" UWORD txms_uw_q0p0004 1 100 0 26.214 FORMAT "%8.5" ECU_ADDRESS 0x5B9756 /end MEASUREMENT
/begin MEASUREMENT rt_10ms "" UWORD txms_uw_q0p0004 1 100 0 26.214 FORMAT "%8.5" ECU_ADDRESS 0x5B9758 /end MEASUREMENT
/begin MEASUREMENT rt_10mss "" ULONG rel_ul_q0p0004 1 100 0 1.71799e+006 FORMAT "%13.5" ECU_ADDRESS 0x5B9B28 /end MEASUREMENT
/begin MEASUREMENT rt_1ms "" UWORD txms_uw_q0p0004 1 100 0 26.214 FORMAT "%8.5" ECU_ADDRESS 0x5B975A /end MEASUREMENT
/begin MEASUREMENT rt_1mss "" ULONG rel_ul_q0p0004 1 100 0 1.71799e+006 FORMAT "%13.5" ECU_ADDRESS 0x5B9B2C /end MEASUREMENT
/begin MEASUREMENT rt_200ms "" UWORD txms_uw_q0p0004 1 100 0 26.214 FORMAT "%8.5" ECU_ADDRESS 0x5B975C /end MEASUREMENT
/begin MEASUREMENT rt_20ms "" UWORD txms_uw_q0p0004 1 100 0 26.214 FORMAT "%8.5" ECU_ADDRESS 0x5B975E /end MEASUREMENT
/begin MEASUREMENT rt_20mss "" ULONG rel_ul_q0p0004 1 100 0 1.71799e+006 FORMAT "%13.5" ECU_ADDRESS 0x5B9B30 /end MEASUREMENT
/begin MEASUREMENT rt_2ms "" UWORD txms_uw_q0p0004 1 100 0 26.214 FORMAT "%8.5" ECU_ADDRESS 0x5B9760 /end MEASUREMENT
/begin MEASUREMENT rt_2mss "" ULONG rel_ul_q0p0004 1 100 0 1.71799e+006 FORMAT "%13.5" ECU_ADDRESS 0x5B9B34 /end MEASUREMENT
/begin MEASUREMENT rt_50ms "" UWORD txms_uw_q0p0004 1 100 0 26.214 FORMAT "%8.5" ECU_ADDRESS 0x5B9762 /end MEASUREMENT
/begin MEASUREMENT rt_50mss "" ULONG rel_ul_q0p0004 1 100 0 1.71799e+006 FORMAT "%13.5" ECU_ADDRESS 0x5B9B38 /end MEASUREMENT
/begin MEASUREMENT rt_bg "" UWORD txms_uw_q0p0004 1 100 0 26.214 FORMAT "%8.5" ECU_ADDRESS 0x5B9764 /end MEASUREMENT
/begin MEASUREMENT rt_bg_brutto "" UWORD txms_uw_q0p0032 1 100 0 209.712 FORMAT "%8.4" ECU_ADDRESS 0x5B9766 /end MEASUREMENT
/begin MEASUREMENT rt_bg_brutto_max "" UWORD txms_uw_q0p0032 1 100 0 209.712 FORMAT "%8.4" ECU_ADDRESS 0x5B9768 /end MEASUREMENT
/begin MEASUREMENT rt_hw1 "" UWORD txms_uw_q0p0004 1 100 0 26.214 FORMAT "%8.5" ECU_ADDRESS 0x5B976A /end MEASUREMENT
/begin MEASUREMENT rt_hw1s "" ULONG rel_ul_q0p0004 1 100 0 1.71799e+006 FORMAT "%13.5" ECU_ADDRESS 0x5B9B3C /end MEASUREMENT
/begin MEASUREMENT rt_hw2 "" UWORD txms_uw_q0p0004 1 100 0 26.214 FORMAT "%8.5" ECU_ADDRESS 0x5B976C /end MEASUREMENT
/begin MEASUREMENT rt_hw2s "" ULONG rel_ul_q0p0004 1 100 0 1.71799e+006 FORMAT "%13.5" ECU_ADDRESS 0x5B9B40 /end MEASUREMENT
/begin MEASUREMENT rt_hw3 "" UWORD txms_uw_q0p0004 1 100 0 26.214 FORMAT "%8.5" ECU_ADDRESS 0x5B976E /end MEASUREMENT
/begin MEASUREMENT rt_hw3s "" ULONG rel_ul_q0p0004 1 100 0 1.71799e+006 FORMAT "%13.5" ECU_ADDRESS 0x5B9B44 /end MEASUREMENT
/begin MEASUREMENT rt_hw4 "" UWORD txms_uw_q0p0004 1 100 0 26.214 FORMAT "%8.5" ECU_ADDRESS 0x5B9770 /end MEASUREMENT
/begin MEASUREMENT rt_hw4s "" ULONG rel_ul_q0p0004 1 100 0 1.71799e+006 FORMAT "%13.5" ECU_ADDRESS 0x5B9B48 /end MEASUREMENT
/begin MEASUREMENT rt_res5v "" UWORD txms_uw_q0p0004 1 100 0 26.214 FORMAT "%8.5" ECU_ADDRESS 0x5B9772 /end MEASUREMENT
/begin MEASUREMENT rt_syn "" UWORD txms_uw_q0p0004 1 100 0 26.214 FORMAT "%8.5" ECU_ADDRESS 0x5B9774 /end MEASUREMENT
/begin MEASUREMENT rt_syns "" ULONG rel_ul_q0p0004 1 100 0 1.71799e+006 FORMAT "%13.5" ECU_ADDRESS 0x5B9B4C /end MEASUREMENT
/begin MEASUREMENT rt_taskCamshaft1 "" UWORD txms_uw_q0p0004 1 100 0 26.214 FORMAT "%8.5" ECU_ADDRESS 0x5B9776 /end MEASUREMENT
/begin MEASUREMENT rt_taskCamshaft2 "" UWORD txms_uw_q0p0004 1 100 0 26.214 FORMAT "%8.5" ECU_ADDRESS 0x5B9778 /end MEASUREMENT
/begin MEASUREMENT rt_taskCamshaft3 "" UWORD txms_uw_q0p0004 1 100 0 26.214 FORMAT "%8.5" ECU_ADDRESS 0x5B977A /end MEASUREMENT
/begin MEASUREMENT rt_taskCamshaft4 "" UWORD txms_uw_q0p0004 1 100 0 26.214 FORMAT "%8.5" ECU_ADDRESS 0x5B977C /end MEASUREMENT
/begin MEASUREMENT rt_taskEveryToothIntISR "" UWORD txms_uw_q0p0004 1 100 0 26.214 FORMAT "%8.5" ECU_ADDRESS 0x5B977E /end MEASUREMENT
/begin MEASUREMENT rt_umtask "" UWORD txms_uw_q0p0004 1 100 0 26.214 FORMAT "%8.5" ECU_ADDRESS 0x5B9780 /end MEASUREMENT
/begin MEASUREMENT SLSlokBits "" UWORD dez 1 100 0 65535 FORMAT "%8.2" ECU_ADDRESS 0x5B8AD0 /end MEASUREMENT
/begin MEASUREMENT stssgerr "" UBYTE dez 1 100 0 255 FORMAT "%5.1" ECU_ADDRESS 0x5B8CC7 /end MEASUREMENT
/begin MEASUREMENT stvfzg "" UBYTE dez 1 100 0 255 FORMAT "%5.1" ECU_ADDRESS 0x5B8CC8 /end MEASUREMENT
/begin MEASUREMENT sumode "Zustand der Saugrohrumschaltung" UBYTE dez 1 100 0 255 FORMAT "%5.1" ECU_ADDRESS 0x5B8A0A /end MEASUREMENT
/begin MEASUREMENT S_eza "" UBYTE B_TRUE 1 100 0 1 BIT_MASK 0x1 FORMAT "%13.11" ECU_ADDRESS 0x3FBFB8 /end MEASUREMENT
/begin MEASUREMENT S_kl30h "" UBYTE B_TRUE 1 100 0 1 BIT_MASK 0x1 FORMAT "%13.11" ECU_ADDRESS 0x3FBFB9 /end MEASUREMENT
/begin MEASUREMENT S_shl "" UBYTE B_TRUE 1 100 0 1 BIT_MASK 0x1 FORMAT "%13.11" ECU_ADDRESS 0x3FBFBA /end MEASUREMENT
/begin MEASUREMENT S_wl "" UBYTE B_TRUE 1 100 0 1 BIT_MASK 0x1 FORMAT "%13.11" ECU_ADDRESS 0x3FBFBB /end MEASUREMENT
/begin MEASUREMENT taagr "ausgegebenes Tastverh‰ltnis an AGR-Ventil" UBYTE rel_ub_b99p6 1 100 0 99.6094 FORMAT "%5.2" ECU_ADDRESS 0x5B8CC9 /end MEASUREMENT
/begin MEASUREMENT tahsom_w "Abgastemperatur an Sonde hinter Kat aus Modell" UWORD temp_q0p0234_o273 1 100 -273.15 1262.83 FORMAT "%8.3" ECU_ADDRESS 0x5B8A16 /end MEASUREMENT
/begin MEASUREMENT tamldia "Tastverh‰ltnis E-L¸fter Diagnoseeingriff" UBYTE rel_ub_b100 1 100 0 100 FORMAT "%5.1" ECU_ADDRESS 0x5B8882 /end MEASUREMENT
/begin MEASUREMENT tateist_w "aktuelles Ist-Tastverh‰ltnis Tankentl¸ftungsventil (16 Bit)" UWORD rel_uw_b100 1 100 0 99.9985 FORMAT "%8.5" ECU_ADDRESS 0x5B9436 /end MEASUREMENT
/begin MEASUREMENT te2_l "effektive Einspritzzeit (long), Bank 2" ULONG t1p0usxms 1 100 0 450 FORMAT "%13.9" ECU_ADDRESS 0x5B9A08 /end MEASUREMENT
/begin MEASUREMENT te2_w "effektive Einspritzzeit Bank2 (word)" UWORD t8p0usxms 1 100 0 524.28 FORMAT "%8.4" ECU_ADDRESS 0x5B9670 /end MEASUREMENT
/begin MEASUREMENT tedub "korrigierte Einschaltdauer der LSU-Heizung" UBYTE t10msxs_ub_b2p55 1 100 0 2.55 FORMAT "%5.3" ECU_ADDRESS 0x5B8FC1 /end MEASUREMENT
/begin MEASUREMENT tevfa2_l "effektive Einspritzzeit vor Feinabgleich (longword) Bank 2" ULONG t1p0usxms 1 100 0 450 FORMAT "%13.9" ECU_ADDRESS 0x5B9A0C /end MEASUREMENT
/begin MEASUREMENT tevfa2_w "effektive Einspritzzeit vor Feinabgleich (word)" UWORD t16p0usxms 1 100 0 524.288 FORMAT "%8.4" ECU_ADDRESS 0x5B8774 /end MEASUREMENT
/begin MEASUREMENT tevfa_l "effektive Einspritzzeit vor Feinabgleich (longword)" ULONG t1p0usxms 1 100 0 450 FORMAT "%13.9" ECU_ADDRESS 0x5B9A10 /end MEASUREMENT
/begin MEASUREMENT tevfa_w "effektive Einspritzzeit vor Feinabgleich (word)" UWORD t16p0usxms 1 100 0 524.288 FORMAT "%8.4" ECU_ADDRESS 0x5B8776 /end MEASUREMENT
/begin MEASUREMENT tevtim "" UBYTE dez 1 100 0 255 FORMAT "%5.1" ECU_ADDRESS 0x5B8F5B /end MEASUREMENT
/begin MEASUREMENT tez_l "effektive Einspritzzeit (long) zylinderindividuell" ULONG t1p0usxms 1 100 0 450 FORMAT "%13.9" ARRAY_SIZE 4 ECU_ADDRESS 0x5B9A14 /end MEASUREMENT
/begin MEASUREMENT te_l "effektive Einspritzzeit (long)" ULONG t1p0usxms 1 100 0 450 FORMAT "%13.9" ECU_ADDRESS 0x5B9A24 /end MEASUREMENT
/begin MEASUREMENT te_w "effektive Einspritzzeit (word)" UWORD t8p0usxms 1 100 0 524.28 FORMAT "%8.4" ECU_ADDRESS 0x5B9672 /end MEASUREMENT
/begin MEASUREMENT tfst2 "Tankfuellstand Tank 2" UBYTE fuel_ub_q1 1 100 0 255 FORMAT "%5.1" ECU_ADDRESS 0x5B8CCA /end MEASUREMENT
/begin MEASUREMENT timmot_w "Z‰hler Zeit nach Motorlauf n>NINI (word)" UWORD t10msxs_uw_b655p35 1 100 0 655.35 FORMAT "%8.4" ECU_ADDRESS 0x5B9068 /end MEASUREMENT
/begin MEASUREMENT tistzyl "Zylindernummer der ersten Einspritzung und Z¸ndung" UBYTE dez 1 100 0 255 FORMAT "%5.1" ECU_ADDRESS 0x5B8FC2 /end MEASUREMENT
/begin MEASUREMENT tmot_kalt "" UBYTE dez 1 100 0 255 FORMAT "%5.1" ECU_ADDRESS 0x5B8FC3 /end MEASUREMENT
/begin MEASUREMENT tp_sw "" UBYTE B_TRUE 1 100 0 1 BIT_MASK 0x1 FORMAT "%13.11" ECU_ADDRESS 0x3FBFBC /end MEASUREMENT
/begin MEASUREMENT tsolletr "Solltemperatur Kennfeldk¸hlung" UBYTE temp_ub_q0p75_o48 1 100 -48 143.25 FORMAT "%5.1" ECU_ADDRESS 0x5B8A0B /end MEASUREMENT
/begin MEASUREMENT tvu_w "Batteriespannungskorrektur" UWORD t1p0usxms 1 100 0 65.535 FORMAT "%8.5" ECU_ADDRESS 0x5B9674 /end MEASUREMENT
/begin MEASUREMENT t_bthsh "" UBYTE dez 1 100 0 255 FORMAT "%5.1" ECU_ADDRESS 0x5B8F5C /end MEASUREMENT
/begin MEASUREMENT t_bthsv "" UBYTE dez 1 100 0 255 FORMAT "%5.1" ECU_ADDRESS 0x5B8F5D /end MEASUREMENT
/begin MEASUREMENT t_bttev "" UBYTE dez 1 100 0 255 FORMAT "%5.1" ECU_ADDRESS 0x5B8F5E /end MEASUREMENT
/begin MEASUREMENT t_bttim "" UBYTE dez 1 100 0 255 FORMAT "%5.1" ECU_ADDRESS 0x5B8F5F /end MEASUREMENT
/begin MEASUREMENT udsl_w "Spannung Drucksensor Ladedruck (word)" UWORD spg_uw_q0p00488 1 100 0 319.995 FORMAT "%8.4" ECU_ADDRESS 0x5B9438 /end MEASUREMENT
/begin MEASUREMENT ugen "phys. Wert Generatorsollspannung (Volt) f¸r Komponententreiber Generator" UBYTE spg_ugen 1 100 10.6 36.1 FORMAT "%5.2" ECU_ADDRESS 0x5B8CCB /end MEASUREMENT
/begin MEASUREMENT vfzg2 "" UBYTE vfzg_ub_q1p25 1 100 0 318.75 FORMAT "%5.1" ECU_ADDRESS 0x5B8CCC /end MEASUREMENT
/begin MEASUREMENT vrlsol "Verhaeltnis relative Soll-F¸llung zu Maximalfuellung" UBYTE rel_ub_b99p6 1 100 0 99.6094 FORMAT "%5.2" ECU_ADDRESS 0x5B8A0C /end MEASUREMENT
/begin MEASUREMENT Vsa_btsoll "" UWORD sprzi_q0p8s102 1 100 -102.4 52325.6 FORMAT "%8.2" ECU_ADDRESS 0x5B943A /end MEASUREMENT
/begin MEASUREMENT Vsa_vzt "" UBYTE dez 1 100 0 255 FORMAT "%5.1" ECU_ADDRESS 0x5B8A80 /end MEASUREMENT
/begin MEASUREMENT Vsa_vzz "Erfolgte Anzahl an Nachtriggerungen (Einlaﬂseite)" UBYTE dez 1 100 0 255 FORMAT "%5.1" ECU_ADDRESS 0x5B8A81 /end MEASUREMENT
/begin MEASUREMENT vsdmr "Vorgabe Drehmomentreserve ¸ber Verstellsystem VSxy" UBYTE rel_ub_q0p3906 1 100 0 99.6094 FORMAT "%5.2" ECU_ADDRESS 0x5B8FC4 /end MEASUREMENT
/begin MEASUREMENT Vse_admn "" UWORD sprzi_q0p1 1 100 0 180 FORMAT "%4.0" ECU_ADDRESS 0x5B97CC /end MEASUREMENT
/begin MEASUREMENT Vse_btsoll "" UWORD sprzi_q0p8s102 1 100 -102.4 52325.6 FORMAT "%8.2" ECU_ADDRESS 0x5B943C /end MEASUREMENT
/begin MEASUREMENT Vse_sprn "" UWORD sprzi_q0p1 1 100 0 6553.5 FORMAT "%4.0" ECU_ADDRESS 0x5B97CE /end MEASUREMENT
/begin MEASUREMENT Vse_vzt "" UBYTE DEZ 1 100 0 255 FORMAT "%5.1" ECU_ADDRESS 0x5B8A82 /end MEASUREMENT
/begin MEASUREMENT Vse_vzz "Erfolgte Anzahl an Nachtriggerungen (Auslaﬂseite)" UBYTE DEZ 1 100 0 255 FORMAT "%5.1" ECU_ADDRESS 0x5B8A83 /end MEASUREMENT
/begin MEASUREMENT vsfpses "Faktor zur Verstellung Saugrohrdruck zur Applikation Einspritzung" UBYTE fak_ub_b2 1 100 0 1.99219 FORMAT "%5.3" ECU_ADDRESS 0x5B8FC5 /end MEASUREMENT
/begin MEASUREMENT vsfrk "Korrektur der relativen Kraftstoffmasse ¸ber Verstellsysteme" UBYTE fak_ub_b1p25_o0p75 1 100 0.75 1.24805 FORMAT "%5.3" ECU_ADDRESS 0x5B8FC6 /end MEASUREMENT
/begin MEASUREMENT vske "verstellbarer Offset f¸r Klopferkennungsschwelle ¸ber VS20" SBYTE fak_ub_b4 1 100 -2 1.98438 FORMAT "%5.3" ECU_ADDRESS 0x5B8FC7 /end MEASUREMENT
/begin MEASUREMENT vsns "ƒnderung der Solldrehzahl ¸ber Verstellsystem VSxy" SBYTE nmot_sb_q10 1 100 -1280 1270 FORMAT "%5.0" ECU_ADDRESS 0x5B8FC8 /end MEASUREMENT
/begin MEASUREMENT vsvw "ƒnderung Einspritzvorlagerungswinkel ¸ber Verstellsystem" SBYTE zw_sb_q6 1 100 -768 762 FORMAT "%5.1" ECU_ADDRESS 0x5B8FC9 /end MEASUREMENT
/begin MEASUREMENT vszw "Z¸ndwinkelkorrektur durch Verstellsystem" SBYTE zw_sb_q0p75 1 100 -96 95.25 FORMAT "%5.2" ECU_ADDRESS 0x5B8FCA /end MEASUREMENT
/begin MEASUREMENT vszwkr "Zylinderindividuelle ZW-Verstellung durch Verstellsystem" SBYTE zw_sb_qn0p75 1 100 -95.25 96 FORMAT "%5.2" ARRAY_SIZE 8 ECU_ADDRESS 0x5B8FCC /end MEASUREMENT
/begin MEASUREMENT vvtstatus "Status VVT-System Bank 1" UWORD DEZ 1 100 0 65535 FORMAT "%8.2" ECU_ADDRESS 0x5B8A18 /end MEASUREMENT
/begin MEASUREMENT vvt_es "Strombedarf des VVT-System Bank1" UBYTE i_vvt_ub_q0p50_om63p50 1 100 -63.5 64 FORMAT "%5.2" ECU_ADDRESS 0x5B8CCD /end MEASUREMENT
/begin MEASUREMENT vvt_es2 "Strombedarf des VVT-System Bank2" UBYTE i_vvt_ub_q0p50_om63p50 1 100 -63.5 64 FORMAT "%5.2" ECU_ADDRESS 0x5B8CCE /end MEASUREMENT
/begin MEASUREMENT wdkdpsad "Winkel Drosselklappe aus WDKADP" SWORD rel_uw_b100 1 100 -50 49.9985 FORMAT "%8.5" ECU_ADDRESS 0x5B97AC /end MEASUREMENT
/begin MEASUREMENT wnwatst "Vorsteuerwert f¸r Auslass-Nockenwellenwinkel; Vorgabe Diagnosetester" UBYTE wkw_q0p8_o128 1 100 -102.4 101.6 FORMAT "%7.3" ECU_ADDRESS 0x5B8883 /end MEASUREMENT
/begin MEASUREMENT wnwetst "Vorsteuerwert f¸r Einlass-Nockenwellenwinkel; Vorgabe Diagnosetester" UBYTE wkw_q0p8_o128 1 100 -102.4 101.6 FORMAT "%7.3" ECU_ADDRESS 0x5B8884 /end MEASUREMENT
/begin MEASUREMENT Wnwllkh_aus "" UBYTE fakspr_q0p0039 1 100 0 0.996094 ECU_ADDRESS 0x5B8CFE /end MEASUREMENT
/begin MEASUREMENT Wnwll_aus "Wichtungsfaktor zur Auswahl der LL KF im Normalbetr. oder zum Katheizen" UBYTE fakspr_q0p0039 1 100 0 0.996094 ECU_ADDRESS 0x5B8CFF /end MEASUREMENT
/begin MEASUREMENT wnwsmn "minimaler Einlassollspreizung mit Adaptionsgrenze" UWORD sprzi_q0p1 1 100 0 180 FORMAT "%4.0" ECU_ADDRESS 0x5B97D0 /end MEASUREMENT
/begin MEASUREMENT wnwstst "Sollwinkel f¸r Nockenwelle bei Testeranforderung Systemtest" UBYTE wkw_ub_q0p25 1 100 0 63.75 FORMAT "%7.4" ECU_ADDRESS 0x5B8F60 /end MEASUREMENT
/begin MEASUREMENT w_fpdk_mod "" UBYTE relPED_ub_b100 1 100 0 100 FORMAT "%5.1" ECU_ADDRESS 0x5B8FD4 /end MEASUREMENT
/begin MEASUREMENT zwnll_aus "Zeitkonst. f¸r TP Sollwertbed‰mpfung (Ein- und Auslass) nach Motorstart" UBYTE fak_ub_b1 1 100 0 0.996094 ECU_ADDRESS 0x5B8D00 /end MEASUREMENT
/begin MEASUREMENT zyleausb "auszublendender Zylinder; bin‰re Darstellung" UBYTE dez 1 100 0 255 FORMAT "%5.1" ECU_ADDRESS 0x5B8CCF /end MEASUREMENT
/begin MEASUREMENT zzbank "Zylinderzuordnung zu Einspritzb‰nken" UBYTE dez 1 100 0 255 FORMAT "%5.1" ECU_ADDRESS 0x5B89B4 /end MEASUREMENT
/begin FUNCTION PROKON "Projektkonfiguration"
 /begin DEF_CHARACTERISTIC CDAGR CDBKVP CDDMTL CDDSBKV CDEFST CDHSH CDHSV CDHSVSA CDKAT CDKATSP CDKVS CDLASH CDLATP CDLATV CDLDP CDLLR CDLSH CDLSV CDLSVV CDMD CDNWS CDSLS CDSWE CDTANKL CDTES CWALE CWDDISA CWERFIL CWGEN1 CWGEN2 CWKMMILSCT CWKONABG CWKONFLS CWKONLS CWLSHA CWMDAPP CWNSABG CWOBD CWPSGER CWPWF CWSCTMDE CWSLS CWSLS2 CWTF CWUHR CWVL FZG_ON NSWO NSWO1 /end DEF_CHARACTERISTIC
 /begin IN_MEASUREMENT nmot /end IN_MEASUREMENT
 /begin OUT_MEASUREMENT B_abstnl B_auakt B_cdagr B_cdanws B_cdbkvp B_cddmtl B_cddsbkv B_cdenws B_cdfst B_cdhsh B_cdhsv B_cdhsvsa B_cdkat B_cdkatsp B_cdkvs B_cdlash B_cdlatp B_cdlatv B_cdldp B_cdllr B_cdlsh B_cdlsv B_cdlsvv B_cdmd B_cdsls B_cdswe B_cdtankl B_cdtes B_cwlshdyn B_cwlshsch B_cwlshvl B_etol B_fphubap B_fpwdkap B_fzg_on B_gen1 B_gen2 B_hubap B_katfz B_kmmilsct B_lsh B_lsh2 B_lsv B_lsv2 B_mde8e B_mde9e B_mrfavl B_ndsav B_nswo1 B_nswo2 B_psapp B_psger B_tfu B_uhrrmin B_uhrrsec B_wdksapcw B_zwappl cd_bits1_w cd_bits2_w cw_erfil zzbank /end OUT_MEASUREMENT
/end FUNCTION
/begin FUNCTION RESET_MON ""
 /begin OUT_MEASUREMENT dr_reg_resetBuffer dr_reg_resetBuffer_cnt dr_reg_resetBuffer_idx dr_reg_resetTimestampBuffer dr_reg_resetTimestampBuffer_idx /end OUT_MEASUREMENT
/end FUNCTION
/begin FUNCTION restgas "restgas.exported"
 /begin DEF_CHARACTERISTIC ASPRNOTL ASPSAN CWRESTKH DNMOTGLUE DTMSPR DWKRMGLUE ESPRNOTL ESPSAN FASTW FASW FASWLL FESTW FESW FESWLL KFALLW KFASPGLUE KFDASTD KFDASTDLL KFDESTD KFDESTDLL KFELLW KFESPGLUE KFKALLW KFKASLL KFKASOPT KFKASOPU KFKASVL KFKASVLT KFKELLW KFKESLL KFKESOPT KFKESOPU KFKESVL KFKESVLT KFWALLW KFWASLL KFWASOPT KFWASOPU KFWASVL KFWASVLT KFWELLW KFWESLL KFWESOPT KFWESOPU KFWESVL KFWESVLT KFWNWLL KFWNWLLKH KLASPVZ KLESPVZ MDAPPAS MDAPPES NMOTGLUE OFASPRAP OFESPRAP PT1SPR RESTNMOT16 RESTNMOT16T RESTNMOT_W RESTRLVW16 RESTRLVW_W S_ASPSATRU S_ESPSATRU TMASPR TMESPR TSPSAON TVASPSA TVESPSA VNS_VZD VNS_VZZMX VNS_WTZ WKRMGLUE WNWAIMN WNWMN ZWNLL /end DEF_CHARACTERISTIC
 /begin REF_CHARACTERISTIC SPRZG_AN /end REF_CHARACTERISTIC
 /begin IN_MEASUREMENT B_btvsa B_btvse B_gd B_kl15 B_ll B_nvnsad B_sa B_stend B_vl B_vsaadok B_vseadok B_vvtnotl dpsfak dpssol_uw E_vvt_vsa E_vvt_vse minhub_w nmot nmot_w rlvwvns_w rlvw_w rl_w tmot tnst_w Vsa_btsoll Vsa_spri Vsa_sprs Vse_adp Vse_btsoll Vse_spri Vse_sprs wkrm /end IN_MEASUREMENT
 /begin OUT_MEASUREMENT Aspr Asprl Asprlu B_glue B_wnwmnbe Espr Esprl Esprlu esst_sst_restgas12_nmot_w esst_sst_restgas12_rlvw_w esst_sst_restgas16t_nmot_w esst_sst_restgas16_nmot_w esst_sst_restgas16_rlvw_w Fastw_aus Festw_aus Vse_sprn /end OUT_MEASUREMENT
 /begin LOC_MEASUREMENT Allk Allw Ask Asprimx Asprt Aspru Astk Astw Asw Aswll B_aspan B_espan B_vsast B_vsest B_vzare B_vzere dastd dastdll destd destdll Ellk Ellw Esk Esprimx Esprt Espru Estk Estw Esw Eswll Faswll_aus Fasw_aus Feswll_aus Fesw_aus rlvwrstg_w RSThyst1 RSThyst2 Vsa_vzt Vsa_vzz Vse_admn Vse_vzt Vse_vzz Wnwllkh_aus Wnwll_aus wnwsmn zwnll_aus /end LOC_MEASUREMENT
/end FUNCTION
/begin FUNCTION RKTE "Berechnung effektive Einspritzdauer aus relativer Kraftstoffmasse rk"
 /begin DEF_CHARACTERISTIC CWPKAPP DTEMN FKKVS FRHOKRSTTE FRLFSDP KLKRKTE PSAPES TEMIN TVUB /end DEF_CHARACTERISTIC
 /begin IN_MEASUREMENT B_stend dpsddss_w evz_austot fkez nmot ps_w pu_w rk2_w rkwez_w rk_w tkrst ub vsfpses /end IN_MEASUREMENT
 /begin OUT_MEASUREMENT B_temin B_temin2 frkte_w krkte_w te2_l te2_w tez_l te_l te_w tvu_w /end OUT_MEASUREMENT
 /begin LOC_MEASUREMENT dpus_w fhkrst_w frlfsdp_w ftek2_w ftek_w i_zyl pses_w tevfa2_l tevfa2_w tevfa_l tevfa_w /end LOC_MEASUREMENT
/end FUNCTION
/begin FUNCTION RUNTIME "" /begin DEF_CHARACTERISTIC CW_RUNTIME /end DEF_CHARACTERISTIC
 /begin OUT_MEASUREMENT common_rt performance rt_1000ms rt_100ms rt_10ms rt_10mss rt_1ms rt_1mss rt_200ms rt_20ms rt_20mss rt_2ms rt_2mss rt_50ms rt_50mss rt_bg rt_bg_brutto rt_bg_brutto_max rt_hw1 rt_hw1s rt_hw2 rt_hw2s rt_hw3 rt_hw3s rt_hw4 rt_hw4s rt_res5v rt_syn rt_syns rt_taskCamshaft1 rt_taskCamshaft2 rt_taskCamshaft3 rt_taskCamshaft4 rt_taskEveryToothIntISR rt_umtask /end OUT_MEASUREMENT
/end FUNCTION
/begin FUNCTION SG_IDENT "" /begin DEF_CHARACTERISTIC CODINDEX dataID /end DEF_CHARACTERISTIC /end FUNCTION
/begin FUNCTION SLS "Sekund‰rluftsteuerung"
 /begin DEF_CHARACTERISTIC ANZSLPMX CWFASL DPSLV FMSL FMSLOFF FMSRHOL FMSTMOT IMLSLMN IMLSLMX IMLSLSA IMLSLSE KFFMSML KLRLSLSMX KLTSLMX MLSLMX MSLUB TASLSO TASLSU TDDSLA TDSLKT TDWHSLPKH TFASLAMN TLMSSLAB TLMSSLMX TMFASLMN TMSSLO TMSSLSTO TMSSLSTU TMSSLU TSLABB TSLPMN TSLUBST TVDSLOFF TVSLVOFF TVSLVON TWSLPENA TWSLPFA TWSLPOFF UBSLMN UBSLMX UBSLSTMN VSLS ZFLMSSL ZKSLPOFF ZKSLPON ZKSLSOFML ZKSLSONML /end DEF_CHARACTERISTIC
 /begin REF_CHARACTERISTIC CWDSLSAD CWSLS CWSLS2 /end REF_CHARACTERISTIC
 /begin IN_MEASUREMENT B_atmtpl B_brems B_dslfa B_dslsp4 B_dspe B_dwg B_fa B_fasls B_fs B_kh B_kha B_khab B_kuppl B_ll B_mslmn B_nmot B_sla B_slsfz B_st B_stend fmsla frhol_w imlpr mlbb_w ml_w nmot ps_w pu rl rlsol_w tans tmot tmst tnst_w twslp_w ubsqf_w vfzg /end IN_MEASUREMENT
 /begin OUT_MEASUREMENT anzslp B_anzslpmx B_fasla B_lmsslof B_msloff B_mslon B_slkhof B_slp B_slpmn B_slpoff B_sls B_slsadap B_slsoab B_slsoff B_slv flamsl_w flmssl fmsldyn fmslrho fslpdyn msl mslstat /end OUT_MEASUREMENT
 /begin LOC_MEASUREMENT B_dslreset B_dslset B_sldsl4 B_slkt B_slpena B_slpofst B_slsdis B_slserr B_whslpkh fmsagd fmsltm imlsla_w imlsle_w mslpub SLSlokBits /end LOC_MEASUREMENT
/end FUNCTION
/begin FUNCTION SREAKT "EGAS: Sicherheitskonzept, Fehlerreaktionen"
 /begin IN_MEASUREMENT B_appnolu B_dkp1e B_dkp2e B_dkpaw B_dlrbe B_dlrpide B_fproab B_fprzab B_i_ska_um B_nlpne B_ubdve B_ub_ok B_umauab B_wdksive /end IN_MEASUREMENT
 /begin OUT_MEASUREMENT B_dknolu B_dknot B_dkpiu B_dkpru B_dkpu B_dkunb B_i_ska_fr B_notlu_fr /end OUT_MEASUREMENT
/end FUNCTION
/begin FUNCTION SSTBER ""
 /begin DEF_CHARACTERISTIC SAN12ESUW SEH06KRUW SEZ06TMUB SFR04BBUW SFR08TEUB SGA07MDUB SGA08MDUB SKS06ESUB SLX06TMUW SML05DKUB SML05LKUB SML06TMUW SML07TMUW SML08LHUB SML08TEUB SN16KR1UB SN16KR2UB SNG06LLSB SNG06LLTSB SNM04DMUW1 SNM04DMUW2 SNM05DKUB SNM06LHUB SNM06LLUB SNM06MDUW SNM07ESUB SNM07LRUB SNM08DMUB SNM08DMUW1 SNM08DMUW2 SNM08FEUB SNM08GKUB SNM08LHUB SNM08OPUB SNM08ZUUB SNM08__UB SNM12ESUB SNM12FEUB SNM12KRUW SNM16GKUB SNM16KRUB SNM16OPUW SNM16ZUUB SNM24ZUUB SNM24ZUUB1 SNM24ZUUB2 SQM05TEUB SRL03ZUUB SRL04KRUB SRL06LHUB SRL06LRUB SRL08DMUB SRL08DYUB SRL08GKUB SRL08ZUUB SRL12ESUB SRL12GKUB SRL12ZUUB SRL16ZUUB ST107TMUB ST307TMUB STA04SAUB STA06ESUB STM04FEUB STM04SAUB STM05SAUB STM05TMUB STM06LLTUB STM06LLUB STM06__UB STM08BBUB STM08DMUB STM08LEUB STM08MDUB STM09ESUB STM12ESUB STS12ESUB SVA07FEUW SVE07FEUW SWP08OPUB /end DEF_CHARACTERISTIC
 /begin IN_MEASUREMENT anztib_w etazwimt etazwist evhubi_w frhol_w frmit gangi kstaa lamsons_w ml ml_w ngfil nmot nmot_w qmsdyn rl rl_w tabgmst tabst_w tans tkatmst tmot tmst ub vrlsol Vsa_spri Vse_spri wdkba wdkba_w wped /end IN_MEASUREMENT
 /begin OUT_MEASUREMENT esst_san12esuw esst_seh06kruw esst_sez06tmub esst_sfr04bbuw esst_sfr08teub esst_sga07mdub esst_sga08mdub esst_sks06esub esst_slx06tmuw esst_smi08khub esst_sml05dkub esst_sml05lkub esst_sml06tmuw esst_sml07tmuw esst_sml08lhub esst_sml08teub esst_sn16kr1ub esst_sn16kr2ub esst_sng04sasb esst_sng06llsb esst_sng06lltsb esst_snm04dmuw1 esst_snm04dmuw2 esst_snm05dkub esst_snm06lhub esst_snm06llub esst_snm06mduw esst_snm07esub esst_snm07lrub esst_snm08dmub esst_snm08dmuw1 esst_snm08dmuw2 esst_snm08feub esst_snm08gkub esst_snm08khub esst_snm08lhub esst_snm08opub esst_snm08stub esst_snm08zuub esst_snm08__ub esst_snm12esub esst_snm12feub esst_snm12kruw esst_snm16gkub esst_snm16krub esst_snm16opuw esst_snm16zuub esst_snm24zuub esst_snm24zuub1 esst_snm24zuub2 esst_sqm05teub esst_srl03zuub esst_srl04krub esst_srl06lhub esst_srl06lrub esst_srl08dmub esst_srl08dyub esst_srl08gkub esst_srl08zuub esst_srl12esub esst_srl12gkub esst_srl12zuub esst_srl16zuub esst_st107tmub esst_st307tmub esst_sta04saub esst_sta06esub esst_stm04feub esst_stm04saub esst_stm05saub esst_stm05tmub esst_stm06lltub esst_stm06llub esst_stm06__ub esst_stm08bbub esst_stm08dmub esst_stm08leub esst_stm08mdub esst_stm09esub esst_stm12esub esst_stm16wlub esst_sts12esub esst_sva07feuw esst_sve07feuw esst_swp08opub /end OUT_MEASUREMENT
/end FUNCTION
/begin FUNCTION STMD "Startmoment" /begin DEF_CHARACTERISTIC KFMDST /end DEF_CHARACTERISTIC /begin IN_MEASUREMENT B_llrein mimin_w mimxl1_w nmotll nsst tmot /end IN_MEASUREMENT /begin OUT_MEASUREMENT mistt mrstt_w /end OUT_MEASUREMENT /begin LOC_MEASUREMENT qnst_w /end LOC_MEASUREMENT /end FUNCTION
/begin FUNCTION SWADP "Software-Adapter"
 /begin DEF_CHARACTERISTIC APPTSOLETR CDSLSFZ CWDSLSAD CWLROFF DHUBMX S_TDKF S_WDKADOF S_ZNDRLP TADHMNH TADHMXH /end DEF_CHARACTERISTIC
 /begin IN_MEASUREMENT tateist tkatm wnwatst wnwetst /end IN_MEASUREMENT
 /begin OUT_MEASUREMENT address agrs anzeausb AS_elue3 AS_epee AS_mar AS_spv batt_anz B_acc B_accdme B_agr B_akr B_akrfz B_bkva B_bkvv B_clradbbo B_clradkr B_clradkrd B_clradlr B_clradlra B_clradlrh B_clradmhb B_clradmsz B_clradvvt B_craus B_cvt B_dktb B_dktsbs B_dldpte B_dmmtev B_dmtltz B_druck B_dslsk B_dtefrr B_dwg B_dylsu B_dylsuav B_edkvs2 B_elsu B_elsuv B_esnws B_estart B_etr B_ez B_faatm B_fabr B_fakvs B_falsh2 B_fanwsaa B_fanwsea B_fash B_fatp B_fatp2 B_fatv B_fatv2 B_fedkb B_fhz B_fonresv B_ftedab B_gsaf B_hdc B_HLSKW B_kftkr B_kftvar B_koger B_kse B_kvta B_lamdkt B_llk B_lowra B_lrat B_lrndia B_lroff B_lrs B_lrssa B_lsvvsp B_m8te B_masterhw B_mdwaner B_nnot B_nstabk B_nws B_phsnl B_phsnlinv B_rlh B_sacvt B_savacc B_sch B_sgs B_sl B_slsfz B_sta B_staa B_tankd B_temxon B_tevcheck B_teza B_tfst2ok B_tfstok B_vlsumrb B_vvtnotl devhubi_w dhubra_w disa_sta dkatstat dlahi_w dmrlsv_w dpsad_w dpsddss_w dpsdpsad_w dpsraus_i dps_w dynlsu_w evhubi2_w evhubi_w evhubs_kf evhubs_w exwinks_w exwnki2_w exwnki_w E_vvt_vsa E_vvt_vse fhubvnsi_w fhubwll_au frdter_w gen_htar gen_last gvist igenmess i_dmesys kopwm kstaa kvb_w lalsuvj_w lamdkt_w lamsoni_w lurminstat L_p_oil L_tp_sw mdarsp_w mims_w minhub_w misgsl_w mizsolv_u mldpsad mracc_w msnvvtdnn msnvvtonn nturbc_w oscdktf_w psagr_w psl pte rkwez_w rlmax_w rl_f stssgerr stvfzg sumode S_eza S_kl30h S_shl S_wl taagr tahsom_w tateist_w tedub tfst2 tistzyl tmot_kalt tp_sw tsolletr udsl_w ugen vfzg2 vrlsol Vsa_btsoll vsdmr Vse_btsoll vsfpses vsfrk vske vsns vsvw vszw vszwkr vvtstatus vvt_es vvt_es2 wdkdpsad w_fpdk_mod zyleausb /end OUT_MEASUREMENT
/end FUNCTION
/begin FUNCTION SYSKN "" /begin IN_MEASUREMENT B_nmot /end IN_MEASUREMENT /begin OUT_MEASUREMENT timmot_w /end OUT_MEASUREMENT /end FUNCTION
/begin FUNCTION SYSKON "Systemkonstanten" /end FUNCTION
/begin FUNCTION SY_DFPM3 "" /end FUNCTION
/begin FUNCTION T2CNV "KWP2000: Umrechnungsmodul f¸r Testerausgabe" /end FUNCTION
/begin FUNCTION T2DFA "KWP2000; Diagnosefunktion aktivieren" /begin IN_MEASUREMENT B_kl15 B_ll B_nmot B_st devoff nmot_w /end IN_MEASUREMENT
 /begin OUT_MEASUREMENT atveekpt B_avset B_bt B_btavs B_btdisa B_btebl B_bteekp B_bteepcl B_btefgr B_btekp B_btemil B_btepcl B_btev1 B_btev2 B_btev3 B_btev4 B_btfgr B_bthsh B_bthsv B_btkos B_btmil B_btmls3 B_btslp B_btslv B_btsslv B_btsta B_bttev B_btvsa B_btvsa2 B_btvse B_btvse2 B_eblet B_ekpet B_etret B_fa B_faavr B_fadisa B_fadk B_fadka B_faetr B_faevz B_faglf B_fakat B_fallas B_falls B_falr B_falra B_falsh B_falsv B_falsv2 B_famls B_fanws B_fanwsd B_fasls B_fates B_glfet B_grdst B_hshet B_hsvet B_koset B_mls3et B_slpet B_slvet B_sslvet B_staet B_tevet B_wdksap disatst hshtim hsvtim nsolfa ofwnktest ofwtstber tamldia tevtim t_bthsh t_bthsv t_bttev t_bttim wnwatst wnwetst wnwstst /end OUT_MEASUREMENT
/end FUNCTION
/begin FUNCTION TC9MOD "Testerkommunikation CARB; Mode 9, Request Vehicle Information"
 /begin IN_MEASUREMENT B_cksbrdy B_cksbrdy2 B_mde9e CALIBID1 CALIBID2 cvn cvn2 nmot_w /end IN_MEASUREMENT
 /begin OUT_MEASUREMENT B_m9cvn /end OUT_MEASUREMENT
 /begin LOC_MEASUREMENT B_m9cvnTmp /end LOC_MEASUREMENT
/end FUNCTION
/begin FUNCTION TCSORT "Testerkommunikation CARB; Sortierfunktion" /begin IN_MEASUREMENT cw_erfil fcmEnd FCMTab ffzdfp /end IN_MEASUREMENT /begin OUT_MEASUREMENT errorCntTcsort /end OUT_MEASUREMENT /end FUNCTION
/begin COMPU_METHOD B_TRUE "boolsche Zust‰nde, positive Logik" TAB_VERB "%6.3" "" COMPU_TAB_REF B_TRUE /end COMPU_METHOD
/begin COMPU_VTAB B_TRUE "boolsche Zust‰nde, positive Logik" TAB_VERB 2 0 "----" 1 "TRUE" /end COMPU_VTAB
/begin COMPU_METHOD DEZ "1 : 1 Umrechnug (dez/hex)" RAT_FUNC "%6.2" "" COEFFS 0 1 0 0 0 1 /end COMPU_METHOD
/begin COMPU_METHOD dez "1 : 1 Umrechnug (dez/hex)" RAT_FUNC "%6.2" "" COEFFS 0 1 0 0 0 1 /end COMPU_METHOD
/begin COMPU_METHOD fakspr_q0p0039 "" RAT_FUNC "%6.4" "" COEFFS 0 256 0 0 0 1 /end COMPU_METHOD
/begin COMPU_METHOD fak_r32_1 "" RAT_FUNC "%43.21" "-" COEFFS 0 1 0 0 0 1 /end COMPU_METHOD
/begin COMPU_METHOD fak_sw_b1 "" RAT_FUNC "%7.6" "-" COEFFS 0 65536 0 0 0 2 /end COMPU_METHOD
/begin COMPU_METHOD fak_sw_b2x "" RAT_FUNC "%6.3" "-" COEFFS 0 32768 -32768 0 0 1 /end COMPU_METHOD
/begin COMPU_METHOD fak_sw_b64 "" RAT_FUNC "%6.4" "-" COEFFS 0 65536 0 0 0 128 /end COMPU_METHOD
/begin COMPU_METHOD fak_ub_b1 "" RAT_FUNC "%6.4" "-" COEFFS 0 256 0 0 0 1 /end COMPU_METHOD
/begin COMPU_METHOD fak_ub_b16 "" RAT_FUNC "%6.4" "-" COEFFS 0 256 0 0 0 16 /end COMPU_METHOD
/begin COMPU_METHOD fak_ub_b1p25_o0p75 "" RAT_FUNC "%6.3" "-" COEFFS 0 1 -0.75 0 0 0.00195313 /end COMPU_METHOD
/begin COMPU_METHOD fak_ub_b2 "" RAT_FUNC "%6.4" "-" COEFFS 0 256 0 0 0 2 /end COMPU_METHOD
/begin COMPU_METHOD fak_ub_b4 "" RAT_FUNC "%6.4" "-" COEFFS 0 256 0 0 0 4 /end COMPU_METHOD
/begin COMPU_METHOD fak_uw_b16 "" RAT_FUNC "%6.5" "-" COEFFS 0 65536 0 0 0 16 /end COMPU_METHOD
/begin COMPU_METHOD fak_uw_b2 "" RAT_FUNC "%7.6" "-" COEFFS 0 65536 0 0 0 2 /end COMPU_METHOD
/begin COMPU_METHOD fuel_ub_q1 "" RAT_FUNC "%6.2" "l" COEFFS 0 1 0 0 0 1 /end COMPU_METHOD
/begin COMPU_METHOD hub_uw_q0p001 "" RAT_FUNC "%6.5" "mm" COEFFS 0 1000 0 0 0 1 /end COMPU_METHOD
/begin COMPU_METHOD i_vvt_ub_q0p50_om63p50 "" RAT_FUNC "%6.4" "" COEFFS 0 1 63.5 0 0 0.5 /end COMPU_METHOD
/begin COMPU_METHOD KennText "" RAT_FUNC "%6.2" "" COEFFS 0 1 0 0 0 1 /end COMPU_METHOD
/begin COMPU_METHOD m_q0p1 "" RAT_FUNC "%6.3" "kg/h" COEFFS 0 10 0 0 0 1 /end COMPU_METHOD
/begin COMPU_METHOD m_ub_b1020 "" RAT_FUNC "%6.2" "kg/h" COEFFS 0 1 0 0 0 4 /end COMPU_METHOD
/begin COMPU_METHOD m_ub_q0p4 "" RAT_FUNC "%6.3" "kg/h" COEFFS 0 1 0 0 0 0.4 /end COMPU_METHOD
/begin COMPU_METHOD m_uw_b102p4 "" RAT_FUNC "%6.4" "kg/h" COEFFS 0 65536 0 0 0 102.4 /end COMPU_METHOD
/begin COMPU_METHOD m_uw_b4660 "" RAT_FUNC "%6.4" "g" COEFFS 0 3600 0 0 0 256 /end COMPU_METHOD
/begin COMPU_METHOD m_uw_b6553p5 "" RAT_FUNC "%6.3" "kg/h" COEFFS 0 1 0 0 0 0.1 /end COMPU_METHOD
/begin COMPU_METHOD nmotg_sb_q100 "" RAT_FUNC "%6.0" "1/min/s" COEFFS 0 1 0 0 0 100 /end COMPU_METHOD
/begin COMPU_METHOD nmot_sb_q10 "" RAT_FUNC "%6.1" "1/min" COEFFS 0 1 0 0 0 10 /end COMPU_METHOD
/begin COMPU_METHOD nmot_ub_q10 "" RAT_FUNC "%6.1" "1/min" COEFFS 0 1 0 0 0 10 /end COMPU_METHOD
/begin COMPU_METHOD nmot_ub_q40 "" RAT_FUNC "%6.1" "1/min" COEFFS 0 1 0 0 0 40 /end COMPU_METHOD
/begin COMPU_METHOD nmot_uw_q0p25 "" RAT_FUNC "%6.3" "1/min" COEFFS 0 1 0 0 0 0.25 /end COMPU_METHOD
/begin COMPU_METHOD p_q0p039 "" RAT_FUNC "%6.4" "hPa" COEFFS 0 256 0 0 0 10 /end COMPU_METHOD
/begin COMPU_METHOD p_q0p039s32768 "" RAT_FUNC "%7.1" "hPa" COEFFS 0 256 327680 0 0 10 /end COMPU_METHOD
/begin COMPU_METHOD p_sb_q32 "" RAT_FUNC "%6.3" "hPa" COEFFS 0 256 0 0 0 64 /end COMPU_METHOD
/begin COMPU_METHOD p_sw_q0p039 "" RAT_FUNC "%6.4" "hPa" COEFFS 0 256 0 0 0 10 /end COMPU_METHOD
/begin COMPU_METHOD p_ub_q5 "" RAT_FUNC "%6.2" "hPa" COEFFS 0 1 0 0 0 5 /end COMPU_METHOD
/begin COMPU_METHOD p_uw_q0p039 "" RAT_FUNC "%6.4" "hPa" COEFFS 0 256 0 0 0 10 /end COMPU_METHOD
/begin COMPU_METHOD relPED_ub_b100 "" RAT_FUNC "%6.3" "%PED" COEFFS 0 255 0 0 0 100 /end COMPU_METHOD
/begin COMPU_METHOD rel_ub_b100 "" RAT_FUNC "%6.3" "%" COEFFS 0 255 0 0 0 100 /end COMPU_METHOD
/begin COMPU_METHOD rel_ub_b127p5 "" RAT_FUNC "%6.3" "%" COEFFS 0 2 0 0 0 1 /end COMPU_METHOD
/begin COMPU_METHOD rel_ub_b99p6 "" RAT_FUNC "%6.3" "%" COEFFS 0 256 0 0 0 100 /end COMPU_METHOD
/begin COMPU_METHOD rel_ub_q0p3906 "" RAT_FUNC "%6.3" "%" COEFFS 0 256 0 0 0 100 /end COMPU_METHOD
/begin COMPU_METHOD rel_ub_q0p75 "" RAT_FUNC "%6.3" "%" COEFFS 0 1 0 0 0 0.75 /end COMPU_METHOD
/begin COMPU_METHOD rel_ul_q0p0004 "" RAT_FUNC "%6.5" "%" COEFFS 0 2500 0 0 0 1 /end COMPU_METHOD
/begin COMPU_METHOD rel_uw_b100 "" RAT_FUNC "%6.4" "%" COEFFS 0 65536 0 0 0 100 /end COMPU_METHOD
/begin COMPU_METHOD rel_uw_b200 "" RAT_FUNC "%6.4" "%" COEFFS 0 65536 0 0 0 200 /end COMPU_METHOD
/begin COMPU_METHOD rel_uw_b3072 "" RAT_FUNC "%6.4" "%" COEFFS 0 65536 0 0 0 3072 /end COMPU_METHOD
/begin COMPU_METHOD rel_uw_q0p0234 "" RAT_FUNC "%6.4" "%" COEFFS 0 32 0 0 0 0.75 /end COMPU_METHOD
/begin COMPU_METHOD rkt_uw_b0p5 "" RAT_FUNC "%6.5" "" COEFFS 0 65536 0 0 0 32 /end COMPU_METHOD
/begin COMPU_METHOD spg_q0p00039 "" RAT_FUNC "%6.5" "V" COEFFS 0 1 0 0 0 0.000390625 /end COMPU_METHOD
/begin COMPU_METHOD spg_ubatt "" RAT_FUNC "%6.3" "V" COEFFS 0 1 0 0 0 0.0942 /end COMPU_METHOD
/begin COMPU_METHOD spg_ugen "" RAT_FUNC "%6.2" "V" COEFFS 0 10 -106 0 0 1 /end COMPU_METHOD
/begin COMPU_METHOD spg_uw_q0p00488 "" RAT_FUNC "%6.4" "V" COEFFS 0 1024 0 0 0 5 /end COMPU_METHOD
/begin COMPU_METHOD sprzi_q0p1 "" RAT_FUNC "%4.2" "Grad KW" COEFFS 0 10 0 0 0 1 /end COMPU_METHOD
/begin COMPU_METHOD sprzi_q0p8 "" RAT_FUNC "%6.2" "Grad KW" COEFFS 0 1 0 0 0 0.8 /end COMPU_METHOD
/begin COMPU_METHOD sprzi_q0p8s102 "" RAT_FUNC "%6.4" "" COEFFS 0 1 102.4 0 0 0.8 /end COMPU_METHOD
/begin COMPU_METHOD strom_q3 "" RAT_FUNC "%6.2" "A" COEFFS 0 1 0 0 0 3 /end COMPU_METHOD
/begin COMPU_METHOD t100msxs_ub_b255 "" RAT_FUNC "%6.2" "s" COEFFS 0 1 0 0 0 1 /end COMPU_METHOD
/begin COMPU_METHOD t100msxs_ub_b25p5 "" RAT_FUNC "%6.3" "s" COEFFS 0 1 0 0 0 0.1 /end COMPU_METHOD
/begin COMPU_METHOD t100msxs_uw_b6553p6 "" RAT_FUNC "%6.3" "s" COEFFS 0 10 0 0 0 1 /end COMPU_METHOD
/begin COMPU_METHOD t10msxs_ub_b2p55 "" RAT_FUNC "%6.4" "s" COEFFS 0 1 0 0 0 0.01 /end COMPU_METHOD
/begin COMPU_METHOD t10msxs_uw_b655p35 "" RAT_FUNC "%6.4" "s" COEFFS 0 1 0 0 0 0.01 /end COMPU_METHOD
/begin COMPU_METHOD t16p0usxms "" RAT_FUNC "%6.4" "ms" COEFFS 0 1000 0 0 0 16 /end COMPU_METHOD
/begin COMPU_METHOD t1p0usxms "" RAT_FUNC "%6.5" "ms" COEFFS 0 1000 0 0 0 1 /end COMPU_METHOD
/begin COMPU_METHOD t8p0usxms "" RAT_FUNC "%6.4" "ms" COEFFS 0 1000 0 0 0 8 /end COMPU_METHOD
/begin COMPU_METHOD temp_q0p0234_o273 "" RAT_FUNC "%6.1" "Grad C" COEFFS 0 1 273.15 0 0 0.0234375 /end COMPU_METHOD
/begin COMPU_METHOD temp_ub_q0p75_o48 "" RAT_FUNC "%6.2" "Grad C" COEFFS 0 1 48 0 0 0.75 /end COMPU_METHOD
/begin COMPU_METHOD temp_ub_q5_o50 "" RAT_FUNC "%6.2" "Grad C" COEFFS 0 1 50 0 0 5 /end COMPU_METHOD
/begin COMPU_METHOD txms_uw_q0p0004 "" RAT_FUNC "%6.5" "ms" COEFFS 0 2500 0 0 0 1 /end COMPU_METHOD
/begin COMPU_METHOD txms_uw_q0p0032 "" RAT_FUNC "%6.4" "ms" COEFFS 0 625 0 0 0 2 /end COMPU_METHOD
/begin COMPU_METHOD vfzg_ub_q1p25 "" RAT_FUNC "%6.2" "km/h" COEFFS 0 1 0 0 0 1.25 /end COMPU_METHOD
/begin COMPU_METHOD vol_q3p90625Em3_l "" RAT_FUNC "%6.4" "l" COEFFS 0 65536 0 0 0 256 /end COMPU_METHOD
/begin COMPU_METHOD wink_uw_q0p1 "" RAT_FUNC "%6.3" "Grad" COEFFS 0 10 0 0 0 1 /end COMPU_METHOD
/begin COMPU_METHOD wkw_q0p8_o128 "" RAT_FUNC "%7.5" "Grad KW" COEFFS 0 10 1024 0 0 8 /end COMPU_METHOD
/begin COMPU_METHOD wkw_ub_q0p25 "" RAT_FUNC "%7.3" "Grad KW" COEFFS 0 4 0 0 0 1 /end COMPU_METHOD
/begin COMPU_METHOD zk100msxs_ub_b25p5 "" RAT_FUNC "%6.3" "s" COEFFS 0 0 256 0 10 0 /end COMPU_METHOD
/begin COMPU_METHOD zk100msxs_uw_b6553 "" RAT_FUNC "%10.3" "s" COEFFS 0 0 65536 0 10 0 /end COMPU_METHOD
/begin COMPU_METHOD zw_sb_q0p75 "" RAT_FUNC "%6.3" "Grad KW" COEFFS 0 255 0 0 0 191.25 /end COMPU_METHOD
/begin COMPU_METHOD zw_sb_q6 "" RAT_FUNC "%6.2" "Grad KW" COEFFS 0 1 0 0 0 6 /end COMPU_METHOD
/begin COMPU_METHOD zw_sb_qn0p75 "" RAT_FUNC "%6.4" "Grad KW" COEFFS 0 1 0 0 0 -0.75 /end COMPU_METHOD
/begin COMPU_METHOD zw_ub_q0p75 "" RAT_FUNC "%6.3" "Grad KW" COEFFS 0 255 0 0 0 191.25 /end COMPU_METHOD
/begin COMPU_METHOD zw_ub_qn0p75 "" RAT_FUNC "%6.4" "Grad KW" COEFFS 0 1 0 0 0 -0.75 /end COMPU_METHOD
/begin COMPU_METHOD default "" RAT_FUNC "%6.2" "" COEFFS 0 1 0 0 0 1 /end COMPU_METHOD
/begin RECORD_LAYOUT GkfWU8 FNC_VALUES 1 UBYTE COLUMN_DIR DIRECT /end RECORD_LAYOUT
/begin RECORD_LAYOUT KfAxU8AyU8SstxU16SstyU16WU16 NO_AXIS_PTS_X 1 UWORD NO_AXIS_PTS_Y 2 UWORD AXIS_PTS_X 3 UWORD INDEX_INCR DIRECT AXIS_PTS_Y 4 UWORD INDEX_INCR DIRECT FNC_VALUES 5 UWORD COLUMN_DIR DIRECT /end RECORD_LAYOUT
/begin RECORD_LAYOUT KfAxUbAyUbSstxUbSstyUbWUb NO_AXIS_PTS_X 1 UBYTE NO_AXIS_PTS_Y 2 UBYTE AXIS_PTS_X 3 UBYTE INDEX_INCR DIRECT AXIS_PTS_Y 4 UBYTE INDEX_INCR DIRECT FNC_VALUES 5 UBYTE COLUMN_DIR DIRECT /end RECORD_LAYOUT
/begin RECORD_LAYOUT KfAxUbAyUbSstxUbSstyUwWUw NO_AXIS_PTS_X 1 UBYTE NO_AXIS_PTS_Y 2 UBYTE AXIS_PTS_X 3 UBYTE INDEX_INCR DIRECT AXIS_PTS_Y 4 UWORD INDEX_INCR DIRECT FNC_VALUES 5 UWORD COLUMN_DIR DIRECT /end RECORD_LAYOUT
/begin RECORD_LAYOUT KfAxUbAyUbSstxUwSstyUwWUw NO_AXIS_PTS_X 1 UWORD NO_AXIS_PTS_Y 2 UWORD AXIS_PTS_X 3 UWORD INDEX_INCR DIRECT AXIS_PTS_Y 4 UWORD INDEX_INCR DIRECT FNC_VALUES 5 UWORD COLUMN_DIR DIRECT /end RECORD_LAYOUT
/begin RECORD_LAYOUT KfAxUwAyUwSstxUwSstyUwWSw NO_AXIS_PTS_X 1 UWORD NO_AXIS_PTS_Y 2 UWORD AXIS_PTS_X 3 UWORD INDEX_INCR DIRECT AXIS_PTS_Y 4 UWORD INDEX_INCR DIRECT FNC_VALUES 5 SWORD COLUMN_DIR DIRECT /end RECORD_LAYOUT
/begin RECORD_LAYOUT KlAUbSstUbWUb NO_AXIS_PTS_X 1 UBYTE AXIS_PTS_X 2 UBYTE INDEX_INCR DIRECT FNC_VALUES 3 UBYTE COLUMN_DIR DIRECT /end RECORD_LAYOUT
/begin RECORD_LAYOUT KlAUbSstUbWUw NO_AXIS_PTS_X 1 UBYTE AXIS_PTS_X 2 UBYTE INDEX_INCR DIRECT FNC_VALUES 3 UWORD COLUMN_DIR DIRECT /end RECORD_LAYOUT
/begin RECORD_LAYOUT KlAUwSstUwWUw NO_AXIS_PTS_X 1 UWORD AXIS_PTS_X 2 UWORD INDEX_INCR DIRECT FNC_VALUES 3 UWORD COLUMN_DIR DIRECT /end RECORD_LAYOUT
/begin RECORD_LAYOUT KlAxU8SstxS16WS16 NO_AXIS_PTS_X 1 SWORD AXIS_PTS_X 2 SWORD INDEX_INCR DIRECT FNC_VALUES 3 SWORD COLUMN_DIR DIRECT /end RECORD_LAYOUT
/begin RECORD_LAYOUT KlAxU8SstxU16WS16 NO_AXIS_PTS_X 1 UWORD AXIS_PTS_X 2 UWORD INDEX_INCR DIRECT FNC_VALUES 3 SWORD COLUMN_DIR DIRECT /end RECORD_LAYOUT
/begin RECORD_LAYOUT KlAxU8SstxU16WU16 NO_AXIS_PTS_X 1 UWORD AXIS_PTS_X 2 UWORD INDEX_INCR DIRECT FNC_VALUES 3 UWORD COLUMN_DIR DIRECT /end RECORD_LAYOUT
/begin RECORD_LAYOUT KlAxU8SstxU8WU8 NO_AXIS_PTS_X 1 UBYTE AXIS_PTS_X 2 UBYTE INDEX_INCR DIRECT FNC_VALUES 3 UBYTE COLUMN_DIR DIRECT /end RECORD_LAYOUT
/begin RECORD_LAYOUT KwbWU8 FNC_VALUES 1 UBYTE COLUMN_DIR DIRECT /end RECORD_LAYOUT
/begin RECORD_LAYOUT KwUb FNC_VALUES 1 UBYTE COLUMN_DIR DIRECT /end RECORD_LAYOUT
/begin RECORD_LAYOUT KwUw FNC_VALUES 1 UWORD COLUMN_DIR DIRECT /end RECORD_LAYOUT
/begin RECORD_LAYOUT KwWS16 FNC_VALUES 1 SWORD COLUMN_DIR DIRECT /end RECORD_LAYOUT
/begin RECORD_LAYOUT KwWU16 FNC_VALUES 1 UWORD COLUMN_DIR DIRECT /end RECORD_LAYOUT
/begin RECORD_LAYOUT KwWU32 FNC_VALUES 1 ULONG COLUMN_DIR DIRECT /end RECORD_LAYOUT
/begin RECORD_LAYOUT KwWU8 FNC_VALUES 1 UBYTE COLUMN_DIR DIRECT /end RECORD_LAYOUT
/begin RECORD_LAYOUT SstASwSstSw NO_AXIS_PTS_X 1 SWORD AXIS_PTS_X 2 SWORD INDEX_INCR DIRECT /end RECORD_LAYOUT
/begin RECORD_LAYOUT SstAU8SstU16 NO_AXIS_PTS_X 1 UWORD AXIS_PTS_X 2 UWORD INDEX_INCR DIRECT /end RECORD_LAYOUT
/begin RECORD_LAYOUT SstAU8SstU8 NO_AXIS_PTS_X 1 UBYTE AXIS_PTS_X 2 UBYTE INDEX_INCR DIRECT /end RECORD_LAYOUT
/begin RECORD_LAYOUT SstAUbSstSb NO_AXIS_PTS_X 1 UBYTE AXIS_PTS_X 2 SBYTE INDEX_INCR DIRECT /end RECORD_LAYOUT
/begin RECORD_LAYOUT SstAUbSstUb NO_AXIS_PTS_X 1 UBYTE AXIS_PTS_X 2 UBYTE INDEX_INCR DIRECT /end RECORD_LAYOUT
/begin RECORD_LAYOUT SstAUwSstUw NO_AXIS_PTS_X 1 UWORD AXIS_PTS_X 2 UWORD INDEX_INCR DIRECT /end RECORD_LAYOUT
/end MODULE
/end PROJECT
