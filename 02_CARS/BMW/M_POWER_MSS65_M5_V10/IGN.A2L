/begin PROJECT MSS65-ign "Generiert am 05.06.02 um 07:49:27"
/begin HEADER "" VERSION "R341" /end HEADER
/begin MODULE _MSS65-ign "Generiert am 05.06.02 um 07:49:27"
/begin MOD_COMMON "" BYTE_ORDER MSB_FIRST /* Default byteorder (Motorola) */ /end MOD_COMMON
/* ------------------ Abschnitt erzeugt aus debug.dat ------------------ */
/begin COMPU_METHOD FORMULA_0000 "FORMULA_0000" RAT_FUNC "%5.0" "-" COEFFS 0 1 0 0 0 1 /end COMPU_METHOD
/begin COMPU_METHOD FORMULA_0001 "FORMULA_0001" RAT_FUNC "%7.0" "-" COEFFS 0 1 0 0 0 1 /end COMPU_METHOD
/* ------------------ Abschnitt erzeugt aus eeprom.dat ------------------ */
/begin COMPU_METHOD FORMULA_0002 "FORMULA_0002" TAB_VERB "%3.0" "Seite" COMPU_TAB_REF FORMULA_0002_VTAB /end COMPU_METHOD
/begin COMPU_VTAB FORMULA_0002_VTAB "FORMULA_0002_VTAB" TAB_VERB 1 128 "Keine Daten)" /end COMPU_VTAB
/begin COMPU_METHOD FORMULA_0003 "FORMULA_0003" TAB_VERB "%3.0" "Seite" COMPU_TAB_REF FORMULA_0003_VTAB /end COMPU_METHOD
/begin COMPU_VTAB FORMULA_0003_VTAB "FORMULA_0003_VTAB" TAB_VERB 2 64 "Sektoren voll->A" 96 "Sektoren voll->B" /end COMPU_VTAB
/* ------------------ Abschnitt erzeugt aus glob.dat ------------------ */
/begin COMPU_METHOD FORMULA_0004 "FORMULA_0004" RAT_FUNC "%8.3" "-" COEFFS 0 16384 0 0 0 1 /end COMPU_METHOD
/begin COMPU_METHOD FORMULA_0005 "FORMULA_0005" RAT_FUNC "%5.0" "mg" COEFFS 0 1 0 0 0 1 /end COMPU_METHOD
/begin COMPU_METHOD FORMULA_0006 "FORMULA_0006" RAT_FUNC "%8.3" "-" COEFFS 0 10000 0 0 0 1 /end COMPU_METHOD
/begin COMPU_METHOD FORMULA_0007 "FORMULA_0007" RAT_FUNC "%7.2" "-" COEFFS 0 10000 0 0 0 1 /end COMPU_METHOD
/begin COMPU_METHOD FORMULA_0008 "FORMULA_0008" RAT_FUNC "%3.0" "-" COEFFS 0 1 0 0 0 1 /end COMPU_METHOD
/begin COMPU_METHOD FORMULA_0009 "FORMULA_0009" RAT_FUNC "%6.1" "mg/asp" COEFFS 0 10 0 0 0 1 /end COMPU_METHOD
/begin COMPU_METHOD FORMULA_0010 "FORMULA_0010" RAT_FUNC "%6.1" "kg/h" COEFFS 0 10 0 0 0 1 /end COMPU_METHOD
/begin COMPU_METHOD FORMULA_0011 "FORMULA_0011" RAT_FUNC "%5.0" "Upm" COEFFS 0 1 0 0 0 1 /end COMPU_METHOD
/begin COMPU_METHOD FORMULA_0012 "FORMULA_0012" RAT_FUNC "%5.0" "Upm/s" COEFFS 0 1 0 0 0 1 /end COMPU_METHOD
/begin COMPU_METHOD FORMULA_0013 "FORMULA_0013" RAT_FUNC "%6.1" "km/h" COEFFS 0 16 0 0 0 1 /end COMPU_METHOD
/begin COMPU_METHOD FORMULA_0014 "FORMULA_0014" TAB_VERB "%7.2" "-" COMPU_TAB_REF FORMULA_0014_VTAB /end COMPU_METHOD
/begin COMPU_VTAB FORMULA_0014_VTAB "FORMULA_0014_VTAB" TAB_VERB 5 1 "VL defekt" 2 "VR defekt" 4 "HL defekt" 8 "HR defekt" 15 "alle defekt" /end COMPU_VTAB
/begin COMPU_METHOD FORMULA_0015 "FORMULA_0015" TAB_VERB "%5.2" "-" COMPU_TAB_REF FORMULA_0015_VTAB /end COMPU_METHOD
/begin COMPU_VTAB FORMULA_0015_VTAB "FORMULA_0015_VTAB" TAB_VERB 7 0 "Inaktiv" 1 "Trigger" 2 "Bereit" 3 "Tr+Be" 4 "Aktiv" 7 "Tr+Be+Aktiv" 8 "WE" /end COMPU_VTAB
/begin COMPU_METHOD FORMULA_0016 "FORMULA_0016" RAT_FUNC "%8.3" "bar" COEFFS 0 1000 0 0 0 1 /end COMPU_METHOD
/begin COMPU_METHOD FORMULA_0017 "FORMULA_0017" TAB_VERB "%7.2" "-" COMPU_TAB_REF FORMULA_0017_VTAB /end COMPU_METHOD
/begin COMPU_VTAB FORMULA_0017_VTAB "FORMULA_0017_VTAB" TAB_VERB 15 0 "O.K." 1 "SH_TO_UB" 2 "SH_TO_GND" 4 "OPENLOAD" 8 "UNPLAUSIBEL" 32 "FILTER" 33 "FILTER/SH_TO_UB" 34 "FILTER/SH_TO_GND" 36 "FILTER/OPENLOAD" 40 "FILTER/UNPLAUSIBEL" 96 "FEHLER" 97 "FEHLER/SH_TO_UB" 98 "FEHLER/SH_TO_GND" 100 "FEHLER/OPENLOAD" 104 "FEHLER/UNPLAUSIBEL" /end COMPU_VTAB
/begin COMPU_METHOD FORMULA_0018 "FORMULA_0018" RAT_FUNC "%6.1" "Nm" COEFFS 0 10 0 0 0 1 /end COMPU_METHOD
/begin COMPU_METHOD FORMULA_0019 "FORMULA_0019" RAT_FUNC "%6.1" "øC" COEFFS 0 10 2732 0 0 1 /end COMPU_METHOD
/begin COMPU_METHOD FORMULA_0020 "FORMULA_0020" RAT_FUNC "%7.2" "%" COEFFS 0 16384 0 0 0 100 /end COMPU_METHOD
/begin COMPU_METHOD FORMULA_0021 "FORMULA_0021" TAB_VERB "%7.2" "-" COMPU_TAB_REF FORMULA_0021_VTAB /end COMPU_METHOD
/begin COMPU_VTAB FORMULA_0021_VTAB "FORMULA_0021_VTAB" TAB_VERB 11 1 "Motor steht" 2 "Motor presync" 4 "Start" 8 "LLOKS" 16 "LLMKS" 32 "TL" 64 "VL" 128 "SA" 256 "NL" 512 "Abgew." 1024 "Kl15 aus" DEFAULT_VALUE "undefiniert" /end COMPU_VTAB
/begin COMPU_METHOD FORMULA_0022 "FORMULA_0022" RAT_FUNC "%6.1" "%" COEFFS 0 10 0 0 0 1 /end COMPU_METHOD
/begin COMPU_METHOD FORMULA_0023 "FORMULA_0023" TAB_VERB "%5.2" "-" COMPU_TAB_REF FORMULA_0023_VTAB /end COMPU_METHOD
/begin COMPU_VTAB FORMULA_0023_VTAB "FORMULA_0023_VTAB" TAB_VERB 4 0 "inaktiv" 1 "Momenteneingriff" 2 "Einspritzausblendung" 3 "Md + TT-Eingriff" /end COMPU_VTAB
/begin COMPU_METHOD FORMULA_0024 "FORMULA_0024" RAT_FUNC "%7.2" "-" COEFFS 0 1 0 0 0 1 /end COMPU_METHOD
/begin COMPU_METHOD FORMULA_0025 "FORMULA_0025" TAB_VERB "%7.2" "-" COMPU_TAB_REF FORMULA_0025_VTAB /end COMPU_METHOD
/begin COMPU_VTAB FORMULA_0025_VTAB "FORMULA_0025_VTAB" TAB_VERB 2 0 "BLS aus" 1 "BLS ein" /end COMPU_VTAB
/begin COMPU_METHOD FORMULA_0026 "FORMULA_0026" TAB_VERB "%7.2" "-" COMPU_TAB_REF FORMULA_0026_VTAB /end COMPU_METHOD
/begin COMPU_VTAB FORMULA_0026_VTAB "FORMULA_0026_VTAB" TAB_VERB 2 0 "offen" 2 "Kraftschluss" /end COMPU_VTAB
/begin COMPU_METHOD FORMULA_0027 "FORMULA_0027" TAB_VERB "%7.2" "-" COMPU_TAB_REF FORMULA_0027_VTAB /end COMPU_METHOD
/begin COMPU_VTAB FORMULA_0027_VTAB "FORMULA_0027_VTAB" TAB_VERB 2 0 "offen" 4 "Kraftschluss" /end COMPU_VTAB
/begin COMPU_METHOD FORMULA_0028 "FORMULA_0028" TAB_VERB "%7.2" "-" COMPU_TAB_REF FORMULA_0028_VTAB /end COMPU_METHOD
/begin COMPU_VTAB FORMULA_0028_VTAB "FORMULA_0028_VTAB" TAB_VERB 2 0 "Kl15 aus" 8 "Kl15 ein" /end COMPU_VTAB
/begin COMPU_METHOD FORMULA_0029 "FORMULA_0029" TAB_VERB "%7.2" "-" COMPU_TAB_REF FORMULA_0029_VTAB /end COMPU_METHOD
/begin COMPU_VTAB FORMULA_0029_VTAB "FORMULA_0029_VTAB" TAB_VERB 2 0 "Sport aus" 16 "Sport ein" /end COMPU_VTAB
/begin COMPU_METHOD FORMULA_0030 "FORMULA_0030" TAB_VERB "%7.2" "-" COMPU_TAB_REF FORMULA_0030_VTAB /end COMPU_METHOD
/begin COMPU_VTAB FORMULA_0030_VTAB "FORMULA_0030_VTAB" TAB_VERB 2 0 "Komfort" 64 "Sport" /end COMPU_VTAB
/begin COMPU_METHOD FORMULA_0031 "FORMULA_0031" RAT_FUNC "%6.1" "mbar" COEFFS 0 16 0 0 0 1 /end COMPU_METHOD
/begin COMPU_METHOD FORMULA_0032 "FORMULA_0032" TAB_VERB "%5.2" "-" COMPU_TAB_REF FORMULA_0032_VTAB /end COMPU_METHOD
/begin COMPU_VTAB FORMULA_0032_VTAB "FORMULA_0032_VTAB" TAB_VERB 4 0 "in Ordnung" 1 "kein Wert empf." 128 "Err/TUMG" 129 "Fehler/TAN" /end COMPU_VTAB
/begin COMPU_METHOD FORMULA_0033 "FORMULA_0033" RAT_FUNC "%9.2" "min" COEFFS 0 60 0 0 0 1 /end COMPU_METHOD
/begin COMPU_METHOD FORMULA_0034 "FORMULA_0034" RAT_FUNC "%5.0" "Tage" COEFFS 0 1 0 0 0 1 /end COMPU_METHOD
/begin COMPU_METHOD FORMULA_0035 "FORMULA_0035" RAT_FUNC "%8.3" "-" COEFFS 0 1024 0 0 0 1 /end COMPU_METHOD
/begin COMPU_METHOD FORMULA_0036 "FORMULA_0036" RAT_FUNC "%3.0" ".Gang" COEFFS 0 1 0 0 0 1 /end COMPU_METHOD
/begin COMPU_METHOD FORMULA_0037 "FORMULA_0037" RAT_FUNC "%6.1" "ø" COEFFS 0 10 0 0 0 1 /end COMPU_METHOD
/begin COMPU_METHOD FORMULA_0038 "FORMULA_0038" TAB_VERB "%7.2" "-" COMPU_TAB_REF FORMULA_0038_VTAB /end COMPU_METHOD
/begin COMPU_VTAB FORMULA_0038_VTAB "FORMULA_0038_VTAB" TAB_VERB 4 0 "O.K." 1 "LLS-Fehler" 2 "DK-Fehler" 4 "WDK-Fehler" DEFAULT_VALUE "Mehrfachfehler" /end COMPU_VTAB
/begin COMPU_METHOD FORMULA_0039 "FORMULA_0039" TAB_VERB "%5.2" "-" COMPU_TAB_REF FORMULA_0039_VTAB /end COMPU_METHOD
/begin COMPU_VTAB FORMULA_0039_VTAB "FORMULA_0039_VTAB" TAB_VERB 2 0 "kein Kickdown" 1 "Kickdown" /end COMPU_VTAB
/begin COMPU_METHOD FORMULA_0040 "FORMULA_0040" TAB_VERB "%3.0" "-" COMPU_TAB_REF FORMULA_0040_VTAB /end COMPU_METHOD
/begin COMPU_VTAB FORMULA_0040_VTAB "FORMULA_0040_VTAB" TAB_VERB 6 0 "O.K." 1 "Kanalfilter" 2 "Kanalfehler" 3 "PWG2_Fehler" 4 "PWG1_Fehler" 5 "Totalausfall" DEFAULT_VALUE "undefiniert" /end COMPU_VTAB
/begin COMPU_METHOD FORMULA_0041 "FORMULA_0041" TAB_VERB "%7.2" "-" COMPU_TAB_REF FORMULA_0041_VTAB /end COMPU_METHOD
/begin COMPU_VTAB FORMULA_0041_VTAB "FORMULA_0041_VTAB" TAB_VERB 2 0 "BLTS aus" 2 "BLTS ein" /end COMPU_VTAB
/begin COMPU_METHOD FORMULA_0042 "FORMULA_0042" TAB_VERB "%7.2" "-" COMPU_TAB_REF FORMULA_0042_VTAB /end COMPU_METHOD
/begin COMPU_VTAB FORMULA_0042_VTAB "FORMULA_0042_VTAB" TAB_VERB 2 0 "Kl15 aus" 4 "Kl15 ein" /end COMPU_VTAB
/begin COMPU_METHOD FORMULA_0043 "FORMULA_0043" TAB_VERB "%7.2" "-" COMPU_TAB_REF FORMULA_0043_VTAB /end COMPU_METHOD
/begin COMPU_VTAB FORMULA_0043_VTAB "FORMULA_0043_VTAB" TAB_VERB 2 0 "Kl87 aus" 8 "Kl87 ein" /end COMPU_VTAB
/begin COMPU_METHOD FORMULA_0044 "FORMULA_0044" TAB_VERB "%7.2" "-" COMPU_TAB_REF FORMULA_0044_VTAB /end COMPU_METHOD
/begin COMPU_VTAB FORMULA_0044_VTAB "FORMULA_0044_VTAB" TAB_VERB 2 0 "Kl50 aus" 16 "Kl50 ein" /end COMPU_VTAB
/begin COMPU_METHOD FORMULA_0045 "FORMULA_0045" RAT_FUNC "%6.1" "V" COEFFS 0 10 0 0 0 1 /end COMPU_METHOD
/begin COMPU_METHOD FORMULA_0046 "FORMULA_0046" RAT_FUNC "%7.2" "V" COEFFS 0 1966080 0 0 0 200 /end COMPU_METHOD
/begin COMPU_METHOD FORMULA_0047 "FORMULA_0047" RAT_FUNC "%5.2" "-" COEFFS 0 1 0 0 0 1 /end COMPU_METHOD
/begin COMPU_METHOD FORMULA_0048 "FORMULA_0048" TAB_VERB "%5.2" "-" COMPU_TAB_REF FORMULA_0048_VTAB /end COMPU_METHOD
/begin COMPU_VTAB FORMULA_0048_VTAB "FORMULA_0048_VTAB" TAB_VERB 2 0 "Kein KATS_B1" 1 "KATS_B1" /end COMPU_VTAB
/begin COMPU_METHOD FORMULA_0049 "FORMULA_0049" TAB_VERB "%5.2" "-" COMPU_TAB_REF FORMULA_0049_VTAB /end COMPU_METHOD
/begin COMPU_VTAB FORMULA_0049_VTAB "FORMULA_0049_VTAB" TAB_VERB 2 0 "Kein KATS_B2" 2 "KATS_B2" /end COMPU_VTAB
/begin COMPU_METHOD FORMULA_0050 "FORMULA_0050" TAB_VERB "%5.2" "-" COMPU_TAB_REF FORMULA_0050_VTAB /end COMPU_METHOD
/begin COMPU_VTAB FORMULA_0050_VTAB "FORMULA_0050_VTAB" TAB_VERB 2 0 "Abregeln_B1" 4 "Aufregeln_B1" /end COMPU_VTAB
/begin COMPU_METHOD FORMULA_0051 "FORMULA_0051" TAB_VERB "%5.2" "-" COMPU_TAB_REF FORMULA_0051_VTAB /end COMPU_METHOD
/begin COMPU_VTAB FORMULA_0051_VTAB "FORMULA_0051_VTAB" TAB_VERB 2 0 "Abregeln_B2" 8 "Aufregeln_B2" /end COMPU_VTAB
/begin COMPU_METHOD FORMULA_0052 "FORMULA_0052" TAB_VERB "%5.2" "-" COMPU_TAB_REF FORMULA_0052_VTAB /end COMPU_METHOD
/begin COMPU_VTAB FORMULA_0052_VTAB "FORMULA_0052_VTAB" TAB_VERB 2 0 "kein INIT" 128 "INIT" /end COMPU_VTAB
/begin COMPU_METHOD FORMULA_0053 "FORMULA_0053" TAB_VERB "%7.2" "-" COMPU_TAB_REF FORMULA_0053_VTAB /end COMPU_METHOD
/begin COMPU_VTAB FORMULA_0053_VTAB "FORMULA_0053_VTAB" TAB_VERB 2 0 "kein Abbruch" 1 "Abbruch" /end COMPU_VTAB
/begin COMPU_METHOD FORMULA_0054 "FORMULA_0054" TAB_VERB "%7.2" "-" COMPU_TAB_REF FORMULA_0054_VTAB /end COMPU_METHOD
/begin COMPU_VTAB FORMULA_0054_VTAB "FORMULA_0054_VTAB" TAB_VERB 2 0 "in Ordnung" 2 "Fehler" /end COMPU_VTAB
/begin COMPU_METHOD FORMULA_0055 "FORMULA_0055" TAB_VERB "%7.2" "-" COMPU_TAB_REF FORMULA_0055_VTAB /end COMPU_METHOD
/begin COMPU_VTAB FORMULA_0055_VTAB "FORMULA_0055_VTAB" TAB_VERB 2 0 "nicht geprueft" 4 "Sensor OK" /end COMPU_VTAB
/begin COMPU_METHOD FORMULA_0056 "FORMULA_0056" TAB_VERB "%7.2" "-" COMPU_TAB_REF FORMULA_0056_VTAB /end COMPU_METHOD
/begin COMPU_VTAB FORMULA_0056_VTAB "FORMULA_0056_VTAB" TAB_VERB 2 0 "nicht geprueft" 8 "offen" /end COMPU_VTAB
/begin COMPU_METHOD FORMULA_0057 "FORMULA_0057" TAB_VERB "%7.2" "-" COMPU_TAB_REF FORMULA_0057_VTAB /end COMPU_METHOD
/begin COMPU_VTAB FORMULA_0057_VTAB "FORMULA_0057_VTAB" TAB_VERB 2 0 "nicht geprueft" 16 "unlpausibel" /end COMPU_VTAB
/begin COMPU_METHOD FORMULA_0058 "FORMULA_0058" TAB_VERB "%7.2" "-" COMPU_TAB_REF FORMULA_0058_VTAB /end COMPU_METHOD
/begin COMPU_VTAB FORMULA_0058_VTAB "FORMULA_0058_VTAB" TAB_VERB 2 0 "kein Blockheater" 32 "Blockheater" /end COMPU_VTAB
/begin COMPU_METHOD FORMULA_0059 "FORMULA_0059" TAB_VERB "%7.2" "-" COMPU_TAB_REF FORMULA_0059_VTAB /end COMPU_METHOD
/begin COMPU_VTAB FORMULA_0059_VTAB "FORMULA_0059_VTAB" TAB_VERB 2 0 "normale Fkt." 64 "Zwangseinschalten" /end COMPU_VTAB
/begin COMPU_METHOD FORMULA_0060 "FORMULA_0060" TAB_VERB "%7.2" "-" COMPU_TAB_REF FORMULA_0060_VTAB /end COMPU_METHOD
/begin COMPU_VTAB FORMULA_0060_VTAB "FORMULA_0060_VTAB" TAB_VERB 2 0 "nicht geprueft" 128 "Thermo OK" /end COMPU_VTAB
/begin COMPU_METHOD FORMULA_0061 "FORMULA_0061" TAB_VERB "%7.2" "-" COMPU_TAB_REF FORMULA_0061_VTAB /end COMPU_METHOD
/begin COMPU_VTAB FORMULA_0061_VTAB "FORMULA_0061_VTAB" TAB_VERB 2 0 "keine INIT" 256 "initialisiert" /end COMPU_VTAB
/begin COMPU_METHOD FORMULA_0062 "FORMULA_0062" TAB_VERB "%7.2" "-" COMPU_TAB_REF FORMULA_0062_VTAB /end COMPU_METHOD
/begin COMPU_VTAB FORMULA_0062_VTAB "FORMULA_0062_VTAB" TAB_VERB 2 0 "kein Stop" 512 "Stop" /end COMPU_VTAB
/begin COMPU_METHOD FORMULA_0063 "FORMULA_0063" TAB_VERB "%7.2" "-" COMPU_TAB_REF FORMULA_0063_VTAB /end COMPU_METHOD
/begin COMPU_VTAB FORMULA_0063_VTAB "FORMULA_0063_VTAB" TAB_VERB 2 0 "Rampe startet" 32768 "Rampe laeuft" /end COMPU_VTAB
/begin COMPU_METHOD FORMULA_0064 "FORMULA_0064" TAB_VERB "%3.0" "-" COMPU_TAB_REF FORMULA_0064_VTAB /end COMPU_METHOD
/begin COMPU_VTAB FORMULA_0064_VTAB "FORMULA_0064_VTAB" TAB_VERB 3 0 "in Ordnung" 1 "Uebertemperatur" 2 "Wartezeit" /end COMPU_VTAB
/begin COMPU_METHOD FORMULA_0065 "FORMULA_0065" TAB_VERB "%5.2" "-" COMPU_TAB_REF FORMULA_0065_VTAB /end COMPU_METHOD
/begin COMPU_VTAB FORMULA_0065_VTAB "FORMULA_0065_VTAB" TAB_VERB 2 0 "nicht abgeschl." 1 "abgeschl." /end COMPU_VTAB
/begin COMPU_METHOD FORMULA_0066 "FORMULA_0066" TAB_VERB "%5.2" "-" COMPU_TAB_REF FORMULA_0066_VTAB /end COMPU_METHOD
/begin COMPU_VTAB FORMULA_0066_VTAB "FORMULA_0066_VTAB" TAB_VERB 2 0 "KL15 aus" 2 "KL15 an" /end COMPU_VTAB
/begin COMPU_METHOD FORMULA_0067 "FORMULA_0067" TAB_VERB "%3.0" "-" COMPU_TAB_REF FORMULA_0067_VTAB /end COMPU_METHOD
/begin COMPU_VTAB FORMULA_0067_VTAB "FORMULA_0067_VTAB" TAB_VERB 6 17 "FP im RAM" 51 "FP warten" 119 "FP fertig" 136 "Rueckflashen" 170 "RF warten" 238 "RF fertig" /end COMPU_VTAB
/begin COMPU_METHOD FORMULA_0088 "FORMULA_0088" RAT_FUNC "%8.3" "V" COEFFS 0 1024 0 0 0 5 /end COMPU_METHOD
/* ------------------ Abschnitt erzeugt aus egas.dat ------------------ */
/begin COMPU_METHOD FORMULA_0106 "FORMULA_0106" RAT_FUNC "%8.3" "%/V" COEFFS 0 102400 0 0 0 1023 /end COMPU_METHOD
/begin COMPU_METHOD FORMULA_0107 "FORMULA_0107" RAT_FUNC "%10.3" "V" COEFFS 0 1024 0 0 0 5 /end COMPU_METHOD
/begin COMPU_METHOD FORMULA_0108 "FORMULA_0108" TAB_VERB "%3.0" "-" COMPU_TAB_REF FORMULA_0108_VTAB /end COMPU_METHOD
/begin COMPU_VTAB FORMULA_0108_VTAB "FORMULA_0108_VTAB" TAB_VERB 4 0 "kein Fehler" 1 "SAT-Err" 2 "Differenz" 4 "Bereich" DEFAULT_VALUE "Mehrfach" /end COMPU_VTAB
/begin COMPU_METHOD FORMULA_0109 "FORMULA_0109" TAB_VERB "%5.0" "-" COMPU_TAB_REF FORMULA_0109_VTAB /end COMPU_METHOD
/begin COMPU_VTAB FORMULA_0109_VTAB "FORMULA_0109_VTAB" TAB_VERB 17 0 "kein Fehler" 1 "RAM-Fehler" 2 "ROM-Fehler" 4 "A/D Wandler-Fehler" 8 "Software Reset" 16 "CAN-Bus Fehler" 32 "CAN-Timeout" 64 "CAN-Fehler Chksum" 128 "CAN-Fehler Alive" 256 "Zylinderbankzuordnung" 512 "Bereichsüberwachung" 1024 "Gradientenüberwachung" 2048 "Lagereglerüberwachung" 4096 "therm. Überlast" 8192 "Motorschutz" 16384 "NP-Fehler" 32768 "NP-Abbruch" DEFAULT_VALUE "Mehrfachfehler" /end COMPU_VTAB
/begin COMPU_METHOD FORMULA_0110 "FORMULA_0110" RAT_FUNC "%4.1" "%" COEFFS 0 1.28 128 0 0 1 /end COMPU_METHOD
/begin COMPU_METHOD FORMULA_0111 "FORMULA_0111" TAB_VERB "%5.2" "-" COMPU_TAB_REF FORMULA_0111_VTAB /end COMPU_METHOD
/begin COMPU_VTAB FORMULA_0111_VTAB "FORMULA_0111_VTAB" TAB_VERB 2 0 "disable" 1 "enable" /end COMPU_VTAB
/begin COMPU_METHOD FORMULA_0112 "FORMULA_0112" TAB_VERB "%5.2" "-" COMPU_TAB_REF FORMULA_0112_VTAB /end COMPU_METHOD
/begin COMPU_VTAB FORMULA_0112_VTAB "FORMULA_0112_VTAB" TAB_VERB 7 0 "Init" 1 "Inaktiv" 2 "NP-Adapt" 4 "Aktiv" 8 "Zust bb" 10 "Federtest" 15 "Failsafe" /end COMPU_VTAB
/begin COMPU_METHOD FORMULA_0113 "FORMULA_0113" TAB_VERB "%3.0" "-" COMPU_TAB_REF FORMULA_0113_VTAB /end COMPU_METHOD
/begin COMPU_VTAB FORMULA_0113_VTAB "FORMULA_0113_VTAB" TAB_VERB 13 0 "NP aus" 1 "NP default" 2 "NP aktiv" 3 "NP erfolgreich" 4 "NP abgelehnt" 5 "NP abgebrochen" 6 "NP fehlerhaft" 8 "FT aus" 10 "FT aktiv" 11 "FT erfolgreich" 12 "FT abgelehnt" 13 "FT abgebrochen" 14 "FT fehlerhaft" DEFAULT_VALUE "undef" /end COMPU_VTAB
/begin COMPU_METHOD FORMULA_0114 "FORMULA_0114" TAB_VERB "%3.0" "-" COMPU_TAB_REF FORMULA_0114_VTAB /end COMPU_METHOD
/begin COMPU_VTAB FORMULA_0114_VTAB "FORMULA_0114_VTAB" TAB_VERB 5 0 "i.O." 1 "Bus-Off" 2 "DPR-Err" 4 "Timeout" 8 "Overflow" DEFAULT_VALUE "Mehrfach" /end COMPU_VTAB
/begin COMPU_METHOD FORMULA_0115 "FORMULA_0115" TAB_VERB "%3.0" "-" COMPU_TAB_REF FORMULA_0115_VTAB /end COMPU_METHOD
/begin COMPU_VTAB FORMULA_0115_VTAB "FORMULA_0115_VTAB" TAB_VERB 7 0 "Init" 1 "Inaktiv" 2 "NP-Adapt" 4 "Aktiv" 8 "Zust bb" 10 "Federtest" 15 "Failsafe" /end COMPU_VTAB
/begin COMPU_METHOD FORMULA_0116 "FORMULA_0116" TAB_VERB "%5.2" "-" COMPU_TAB_REF FORMULA_0116_VTAB /end COMPU_METHOD
/begin COMPU_VTAB FORMULA_0116_VTAB "FORMULA_0116_VTAB" TAB_VERB 9 0 "Wait" 1 "Inaktiv" 2 "Aktiv" 3 "Adaption" 4 "SK-Start" 5 "SK-Test" 6 "SK-Ende" 7 "Federtest" 255 "Failsafe" /end COMPU_VTAB
/begin COMPU_METHOD FORMULA_0117 "FORMULA_0117" RAT_FUNC "%7.2" "sec" COEFFS 0 200 0 0 0 1 /end COMPU_METHOD
/begin COMPU_METHOD FORMULA_0118 "FORMULA_0118" TAB_VERB "%3.0" "-" COMPU_TAB_REF FORMULA_0118_VTAB /end COMPU_METHOD
/begin COMPU_VTAB FORMULA_0118_VTAB "FORMULA_0118_VTAB" TAB_VERB 8 0 "kein Fehler" 1 "R-Mode" 2 "Diagnose" 8 "CAN-Fehler" 16 "NP-Err" 12 "Alive" 32 "SK-Fehler" 64 "Startup" DEFAULT_VALUE "Mehrfachfehler" /end COMPU_VTAB
/begin COMPU_METHOD FORMULA_0119 "FORMULA_0119" TAB_VERB "%5.2" "-" COMPU_TAB_REF FORMULA_0119_VTAB /end COMPU_METHOD
/begin COMPU_VTAB FORMULA_0119_VTAB "FORMULA_0119_VTAB" TAB_VERB 6 0 "Init" 1 "Inaktiv" 4 "Aktiv" 6 "Aktiv/Adapt" 8 "Zust bb" 15 "Failsafe" /end COMPU_VTAB
/begin COMPU_METHOD FORMULA_0120 "FORMULA_0120" TAB_VERB "%3.0" "-" COMPU_TAB_REF FORMULA_0120_VTAB /end COMPU_METHOD
/begin COMPU_VTAB FORMULA_0120_VTAB "FORMULA_0120_VTAB" TAB_VERB 6 1 "oA aus" 2 "oA aktiv" 4 "oA erfolgreich" 9 "oA abgelehnt" 10 "oA abgebrochen" 12 "oA fehlerhaft" DEFAULT_VALUE "undef" /end COMPU_VTAB
/begin COMPU_METHOD FORMULA_0121 "FORMULA_0121" TAB_VERB "%5.2" "-" COMPU_TAB_REF FORMULA_0121_VTAB /end COMPU_METHOD
/begin COMPU_VTAB FORMULA_0121_VTAB "FORMULA_0121_VTAB" TAB_VERB 5 0 "Wait" 1 "Inaktiv" 2 "Aktiv" 3 "Aktiv/Adapt" 255 "Failsafe" /end COMPU_VTAB
/begin COMPU_METHOD FORMULA_0122 "FORMULA_0122" TAB_VERB "%3.0" "-" COMPU_TAB_REF FORMULA_0122_VTAB /end COMPU_METHOD
/begin COMPU_VTAB FORMULA_0122_VTAB "FORMULA_0122_VTAB" TAB_VERB 5 0 "i.O." 1 "Bus-Off" 2 "DPR" 4 "Timeout" 8 "Overflow" DEFAULT_VALUE "Mehrfach" /end COMPU_VTAB
/begin COMPU_METHOD FORMULA_0123 "FORMULA_0123" TAB_VERB "%5.2" "-" COMPU_TAB_REF FORMULA_0123_VTAB /end COMPU_METHOD
/begin COMPU_VTAB FORMULA_0123_VTAB "FORMULA_0123_VTAB" TAB_VERB 2 0 "aus" 1 "Adaption" /end COMPU_VTAB
/begin COMPU_METHOD FORMULA_0124 "FORMULA_0124" TAB_VERB "%3.0" "-" COMPU_TAB_REF FORMULA_0124_VTAB /end COMPU_METHOD
/begin COMPU_VTAB FORMULA_0124_VTAB "FORMULA_0124_VTAB" TAB_VERB 7 0 "kein Fehler" 1 "R-Mode" 2 "Diagnose" 8 "CAN-Fehler" 16 "NP-Err" 12 "Alive" 64 "Startup" DEFAULT_VALUE "Mehrfachfehler" /end COMPU_VTAB
/begin COMPU_METHOD FORMULA_0125 "FORMULA_0125" TAB_VERB "%7.2" "-" COMPU_TAB_REF FORMULA_0125_VTAB /end COMPU_METHOD
/begin COMPU_VTAB FORMULA_0125_VTAB "FORMULA_0125_VTAB" TAB_VERB 4 0 "alles iO" 1 "Soll-Vgl" 2 "WDK-CAN-Vgl" 4 "Soll-Ist-Vgl" DEFAULT_VALUE "Mehrfachfehler" /end COMPU_VTAB
/begin COMPU_METHOD FORMULA_0126 "FORMULA_0126" RAT_FUNC "%7.2" "s" COEFFS 0 100 0 0 0 1 /end COMPU_METHOD
/begin COMPU_METHOD FORMULA_0127 "FORMULA_0127" TAB_VERB "%5.2" "-" COMPU_TAB_REF FORMULA_0127_VTAB /end COMPU_METHOD
/begin COMPU_VTAB FORMULA_0127_VTAB "FORMULA_0127_VTAB" TAB_VERB 7 0 "Normal" 1 "LLS-Test" 2 "DK-Test" 3 "LLS-/DK-Test" 4 "Walzenbetrieb" 8 "ohne NP" 12 "Walzen o. NP" /end COMPU_VTAB
/begin COMPU_METHOD FORMULA_0128 "FORMULA_0128" RAT_FUNC "%5.0" "mal" COEFFS 0 1 0 0 0 1 /end COMPU_METHOD
/begin COMPU_METHOD FORMULA_0129 "FORMULA_0129" TAB_VERB "%5.2" "-" COMPU_TAB_REF FORMULA_0129_VTAB /end COMPU_METHOD
/begin COMPU_VTAB FORMULA_0129_VTAB "FORMULA_0129_VTAB" TAB_VERB 2 0 "SK aus" 1 "SK aktiv" /end COMPU_VTAB
/begin COMPU_METHOD FORMULA_0130 "FORMULA_0130" RAT_FUNC "%5.2" "sec" COEFFS 0 200 0 0 0 1 /end COMPU_METHOD
/begin COMPU_METHOD FORMULA_0131 "FORMULA_0131" TAB_VERB "%5.2" "-" COMPU_TAB_REF FORMULA_0131_VTAB /end COMPU_METHOD
/begin COMPU_VTAB FORMULA_0131_VTAB "FORMULA_0131_VTAB" TAB_VERB 3 0 "keine" 1 "Vanos-SG" 2 "MS S65" /end COMPU_VTAB
/begin COMPU_METHOD FORMULA_0132 "FORMULA_0132" RAT_FUNC "%3.0" "bar" COEFFS 0 1 0 0 0 1 /end COMPU_METHOD
/* ------------------ Abschnitt erzeugt aus egas_cmd.dat ------------------ */
/begin COMPU_METHOD FORMULA_0133 "FORMULA_0133" TAB_VERB "%5.2" "-" COMPU_TAB_REF FORMULA_0133_VTAB /end COMPU_METHOD
/begin COMPU_VTAB FORMULA_0133_VTAB "FORMULA_0133_VTAB" TAB_VERB 8 0 "INAKTIV" 3 "NEUINIT" 5 "GET_VERS" 6 "SET_VERS" 9 "CLR_DIAGST" 10 "SET_ZYLBANK" 14 "CS_ERROR" 15 "UNKNOWN" DEFAULT_VALUE "undefiniert" /end COMPU_VTAB
/begin COMPU_METHOD FORMULA_0134 "FORMULA_0134" TAB_VERB "%3.0" "-" COMPU_TAB_REF FORMULA_0134_VTAB /end COMPU_METHOD
/begin COMPU_VTAB FORMULA_0134_VTAB "FORMULA_0134_VTAB" TAB_VERB 8 0 "INAKTIV" 3 "NEUINIT" 5 "GET_VERS" 6 "SET_VERS" 9 "CLR_DIAGST" 10 "SET_ZYLBANK" 14 "CS_ERROR" 15 "UNKNOWN" DEFAULT_VALUE "undefiniert" /end COMPU_VTAB
/begin COMPU_METHOD FORMULA_0135 "FORMULA_0135" RAT_FUNC "%6.1" "s" COEFFS 0 10 0 0 0 1 /end COMPU_METHOD
/begin COMPU_METHOD FORMULA_0136 "FORMULA_0136" TAB_VERB "%5.2" "-" COMPU_TAB_REF FORMULA_0136_VTAB /end COMPU_METHOD
/begin COMPU_VTAB FORMULA_0136_VTAB "FORMULA_0136_VTAB" TAB_VERB 3 0 "nothing" 1 "ackn" 15 "timeout" /end COMPU_VTAB
/begin COMPU_METHOD FORMULA_0137 "FORMULA_0137" TAB_VERB "%7.2" "-" COMPU_TAB_REF FORMULA_0137_VTAB /end COMPU_METHOD
/begin COMPU_VTAB FORMULA_0137_VTAB "FORMULA_0137_VTAB" TAB_VERB 15 0 "O.K." 1 "SH_TO_UB" 2 "SH_TO_GND" 4 "OPENLOAD" 8 "UNPLAUSIBEL" 32 "FILTER" 33 "FILTER/SH_TO_UB" 34 "FILTER/SH_TO_GND" 36 "FILTER/OPENLOAD" 40 "FILTER/UNPLAUSIBEL" 96 "FEHLER" 97 "FEHLER/SH_TO_UB" 98 "FEHLER/SH_TO_GND" 100 "FEHLER/OPENLOAD" 104 "FEHLER/UNPLAUSIBEL" /end COMPU_VTAB
/begin COMPU_METHOD FORMULA_0138 "FORMULA_0138" TAB_VERB "%5.0" "-" COMPU_TAB_REF FORMULA_0138_VTAB /end COMPU_METHOD
/begin COMPU_VTAB FORMULA_0138_VTAB "FORMULA_0138_VTAB" TAB_VERB 3 0 "nothing" 1 "ackn" 15 "timeout" /end COMPU_VTAB
/* ------------------ Abschnitt erzeugt aus egas_stm.dat ------------------ */
/begin COMPU_METHOD FORMULA_0139 "FORMULA_0139" TAB_VERB "%5.2" "-" COMPU_TAB_REF FORMULA_0139_VTAB /end COMPU_METHOD
/begin COMPU_VTAB FORMULA_0139_VTAB "FORMULA_0139_VTAB" TAB_VERB 7 0 "Init" 1 "Versionsabfrage" 2 "Versionsvorgabe" 3 "Bankzuordnung" 4 "Statusabfrage" 5 "Kl15 aus" 255 "Neuinit" /end COMPU_VTAB
/begin COMPU_METHOD FORMULA_0140 "FORMULA_0140" RAT_FUNC "%7.2" "sec" COEFFS 0 1000 0 0 0 5 /end COMPU_METHOD
/* ------------------ Abschnitt erzeugt aus fr.dat ------------------ */
/begin COMPU_METHOD FORMULA_0141 "FORMULA_0141" RAT_FUNC "%9.4" "-" COEFFS 0 10000 0 0 0 1 /end COMPU_METHOD
/begin COMPU_METHOD FORMULA_0142 "FORMULA_0142" RAT_FUNC "%9.4" "-" COEFFS 0 32768 0 0 0 1 /end COMPU_METHOD
/begin COMPU_METHOD FORMULA_0143 "FORMULA_0143" RAT_FUNC "%9.4" "%/10ms" COEFFS 0 524288 0 0 0 100 /end COMPU_METHOD
/begin COMPU_METHOD FORMULA_0144 "FORMULA_0144" RAT_FUNC "%5.2" "%/10ms" COEFFS 0 32768 0 0 0 100 /end COMPU_METHOD
/begin COMPU_METHOD FORMULA_0145 "FORMULA_0145" RAT_FUNC "%9.4" "-" COEFFS 0 -32768 32768 0 0 -1 /end COMPU_METHOD
/* ------------------ Abschnitt erzeugt aus heimatlos_ign.dat ------------------ */
/begin COMPU_METHOD FORMULA_0146 "FORMULA_0146" RAT_FUNC "%4.1" "-" COEFFS 0 1 0 0 0 1 /end COMPU_METHOD
/begin COMPU_METHOD FORMULA_0148 "FORMULA_0148" RAT_FUNC "%8.3" "V" COEFFS 0 1802.1445 0 0 0 1 /end COMPU_METHOD
/* ------------------ Abschnitt erzeugt aus ipkdata.dat ------------------ */
/begin COMPU_METHOD FORMULA_0151 "FORMULA_0151" RAT_FUNC "%5.0" " +24hex" COEFFS 0 1 0 0 0 2 /end COMPU_METHOD
/begin COMPU_METHOD FORMULA_0152 "FORMULA_0152" RAT_FUNC "%8.1" "ms" COEFFS 0 1000 0 0 0 1 /end COMPU_METHOD
/* ------------------ Abschnitt erzeugt aus km.dat ------------------ */
/begin COMPU_METHOD FORMULA_0153 "FORMULA_0153" RAT_FUNC "%6.1" "°KW" COEFFS 0 65536 0 0 0 720 /end COMPU_METHOD
/begin COMPU_METHOD FORMULA_0154 "FORMULA_0154" RAT_FUNC "%11.4" "-" COEFFS 0 268435456 0 0 0 1 /end COMPU_METHOD
/begin COMPU_METHOD FORMULA_0155 "FORMULA_0155" TAB_VERB "%5.2" "-" COMPU_TAB_REF FORMULA_0155_VTAB /end COMPU_METHOD
/begin COMPU_VTAB FORMULA_0155_VTAB "FORMULA_0155_VTAB" TAB_VERB 3 0 "Aus" 1 "Single" 2 "immer" DEFAULT_VALUE "undef." /end COMPU_VTAB
/begin COMPU_METHOD FORMULA_0156 "FORMULA_0156" TAB_VERB "%5.2" "-" COMPU_TAB_REF FORMULA_0156_VTAB /end COMPU_METHOD
/begin COMPU_VTAB FORMULA_0156_VTAB "FORMULA_0156_VTAB" TAB_VERB 2 0 "30V" 1 "60V" DEFAULT_VALUE "undef." /end COMPU_VTAB
/begin COMPU_METHOD FORMULA_0157 "FORMULA_0157" TAB_VERB "%5.2" "-" COMPU_TAB_REF FORMULA_0157_VTAB /end COMPU_METHOD
/begin COMPU_VTAB FORMULA_0157_VTAB "FORMULA_0157_VTAB" TAB_VERB 2 0 "aktiv" 1 "ohne" DEFAULT_VALUE "undef." /end COMPU_VTAB
/begin COMPU_METHOD FORMULA_0158 "FORMULA_0158" TAB_VERB "%5.0" "-" COMPU_TAB_REF FORMULA_0158_VTAB /end COMPU_METHOD
/begin COMPU_VTAB FORMULA_0158_VTAB "FORMULA_0158_VTAB" TAB_VERB 2 0 "VReg aus" 4095 "VReg aktiv" DEFAULT_VALUE "undefiniert" /end COMPU_VTAB
/begin COMPU_METHOD FORMULA_0159 "FORMULA_0159" TAB_VERB "%5.0" "-" COMPU_TAB_REF FORMULA_0159_VTAB /end COMPU_METHOD
/begin COMPU_VTAB FORMULA_0159_VTAB "FORMULA_0159_VTAB" TAB_VERB 2 0 "Aus" 4095 "VReg im Klopfbereich" DEFAULT_VALUE "undefiniert" /end COMPU_VTAB
/begin COMPU_METHOD FORMULA_0160 "FORMULA_0160" TAB_VERB "%5.0" "-" COMPU_TAB_REF FORMULA_0160_VTAB /end COMPU_METHOD
/begin COMPU_VTAB FORMULA_0160_VTAB "FORMULA_0160_VTAB" TAB_VERB 2 0 "Aus" 4095 "VReg im Aussetzerbereich" DEFAULT_VALUE "undefiniert" /end COMPU_VTAB
/begin COMPU_METHOD FORMULA_0161 "FORMULA_0161" RAT_FUNC "%7.0" "ms" COEFFS 0 10000 0 0 0 1 /end COMPU_METHOD
/begin COMPU_METHOD FORMULA_0162 "FORMULA_0162" RAT_FUNC "%9.4" "-" COEFFS 0 16384 0 0 0 1 /end COMPU_METHOD
/* ------------------ Abschnitt erzeugt aus kr.dat ------------------ */
/begin COMPU_METHOD FORMULA_0163 "FORMULA_0163" TAB_VERB "%5.0" "-" COMPU_TAB_REF FORMULA_0163_VTAB /end COMPU_METHOD
/begin COMPU_VTAB FORMULA_0163_VTAB "FORMULA_0163_VTAB" TAB_VERB 3 0 "Klopferkennung Aus" 8191 "Klopfen erkannt" 4096 "Klopferkennung Activ" /end COMPU_VTAB
/begin COMPU_METHOD FORMULA_0164 "FORMULA_0164" RAT_FUNC "%7.0" "Q" COEFFS 0 1 0 0 0 1 /end COMPU_METHOD
/begin COMPU_METHOD FORMULA_0165 "FORMULA_0165" RAT_FUNC "%5.0" "Q" COEFFS 0 1 0 0 0 1 /end COMPU_METHOD
/begin COMPU_METHOD FORMULA_0166 "FORMULA_0166" RAT_FUNC "%8.3" "Q" COEFFS 0 1 0 0 0 1 /end COMPU_METHOD
/* ------------------ Abschnitt erzeugt aus n_ign.dat ------------------ */
/begin COMPU_METHOD FORMULA_0195 "FORMULA_0195" TAB_VERB "%5.2" "-" COMPU_TAB_REF FORMULA_0195_VTAB /end COMPU_METHOD
/begin COMPU_VTAB FORMULA_0195_VTAB "FORMULA_0195_VTAB" TAB_VERB 4 0 "in Ordnung" 30 "Segment gesperrt" 31 "inaktiv" 95 "eingefroren" DEFAULT_VALUE "Stoerung" /end COMPU_VTAB
/begin COMPU_METHOD FORMULA_0196 "FORMULA_0196" RAT_FUNC "%5.2" "s" COEFFS 0 100 0 0 0 1 /end COMPU_METHOD
/* ------------------ Abschnitt erzeugt aus td.dat ------------------ */
/begin COMPU_METHOD FORMULA_0224 "FORMULA_0224" RAT_FUNC "%6.1" "°" COEFFS 0 256 0 0 0 6 /end COMPU_METHOD
/* ------------------ Abschnitt erzeugt aus eeprom.dat ------------------ */
/begin MEASUREMENT eeprom_seite_lesen "Wo wurde der letzte Datensatz gefunden" UBYTE FORMULA_0002 0 0 0.0 255.0 ECU_ADDRESS 0x3FB8D4 /begin FUNCTION_LIST EEPROM /end FUNCTION_LIST /end MEASUREMENT
/begin MEASUREMENT eeprom_seite_lesen_hdw "Wo wurde der letzte HDW-Datensatz gefunden" UBYTE FORMULA_0002 0 0 0.0 255.0 ECU_ADDRESS 0x3FB8D5 /begin FUNCTION_LIST EEPROM /end FUNCTION_LIST /end MEASUREMENT
/begin MEASUREMENT eeprom_seite_schreiben "Wo hin soll der naechste Datensatz geschrieben werden" UBYTE FORMULA_0003 0 0 0.0 255.0 ECU_ADDRESS 0x3FB8D6 /begin FUNCTION_LIST EEPROM /end FUNCTION_LIST /end MEASUREMENT
/* ------------------ Abschnitt erzeugt aus glob.dat ------------------ */
/begin MEASUREMENT lam_ist_mw_b1 "Mittelwert IST-Lambda" UWORD FORMULA_0004 0 0 0.0 3.9990 ECU_ADDRESS 0x3F9A20 /begin FUNCTION_LIST Global /end FUNCTION_LIST /end MEASUREMENT
/begin MEASUREMENT lam_ist_mw_b2 "Mittelwert IST-Lambda" UWORD FORMULA_0004 0 0 0.0 3.9990 ECU_ADDRESS 0x3F9A22 /begin FUNCTION_LIST Global /end FUNCTION_LIST /end MEASUREMENT
/begin MEASUREMENT lam_soll_ms_kat_b1 "gespeicherte Sauerstoffmasse im KAT" SWORD FORMULA_0005 0 0 -32768.0000 32767.0000 ECU_ADDRESS 0x3F9A24 /begin FUNCTION_LIST Global /end FUNCTION_LIST /end MEASUREMENT
/begin MEASUREMENT lam_soll_ms_kat_b2 "gespeicherte Sauerstoffmasse im KAT" SWORD FORMULA_0005 0 0 -32768.0000 32767.0000 ECU_ADDRESS 0x3F9A26 /begin FUNCTION_LIST Global /end FUNCTION_LIST /end MEASUREMENT
/begin MEASUREMENT lam_delta_lim_1of2_ "begrenzte Regelabweichung" SWORD FORMULA_0004 0 0 -2.0000 1.9999 ECU_ADDRESS 0x3F9A28 /begin FUNCTION_LIST Global /end FUNCTION_LIST /end MEASUREMENT
/begin MEASUREMENT lam_delta_lim_2of2_ "begrenzte Regelabweichung" SWORD FORMULA_0004 0 0 -2.0000 1.9999 ECU_ADDRESS 0x3F9A2A /begin FUNCTION_LIST Global /end FUNCTION_LIST /end MEASUREMENT
/begin MEASUREMENT rf_b1 "relative Fuellung" SWORD FORMULA_0006 0 0 0.0 2.0000 ECU_ADDRESS 0x3F9A2C /begin FUNCTION_LIST Global /end FUNCTION_LIST /end MEASUREMENT
/begin MEASUREMENT rf_b2 "relative Fuellung" SWORD FORMULA_0006 0 0 0.0 2.0000 ECU_ADDRESS 0x3F9A2E /begin FUNCTION_LIST Global /end FUNCTION_LIST /end MEASUREMENT
/begin MEASUREMENT rg_x_b1 "Restgasgehalt" SWORD FORMULA_0007 0 0 -0.1000 0.5000 ECU_ADDRESS 0x3F9A30 /begin FUNCTION_LIST Global /end FUNCTION_LIST /end MEASUREMENT
/begin MEASUREMENT rg_x_b2 "Restgasgehalt" SWORD FORMULA_0007 0 0 -0.1000 0.5000 ECU_ADDRESS 0x3F9A32 /begin FUNCTION_LIST Global /end FUNCTION_LIST /end MEASUREMENT
/begin MEASUREMENT rg_x_m "gem. Restgasgehalt" SWORD FORMULA_0007 0 0 -0.1000 0.5000 ECU_ADDRESS 0x3F9A34 /begin FUNCTION_LIST Global /end FUNCTION_LIST /end MEASUREMENT
/begin MEASUREMENT rg_x_m_stat "gem. Restgasgehalt" SWORD FORMULA_0007 0 0 -0.1000 0.5000 ECU_ADDRESS 0x3F9A36 /begin FUNCTION_LIST Global /end FUNCTION_LIST /end MEASUREMENT
/begin MEASUREMENT ti_ausblend_ist_b1 "Zyl-Ausblendung pro Bank" UBYTE FORMULA_0008 0 0 0.0 255.0000 ECU_ADDRESS 0x3F9A3C /begin FUNCTION_LIST Global /end FUNCTION_LIST /end MEASUREMENT
/begin MEASUREMENT ti_ausblend_ist_b2 "Zyl-Ausblendung pro Bank" UBYTE FORMULA_0008 0 0 0.0 255.0000 ECU_ADDRESS 0x3F9A3D /begin FUNCTION_LIST Global /end FUNCTION_LIST /end MEASUREMENT
/begin MEASUREMENT rg_m_av_max "Restgasmasse ueber Auslaß nach Einlaß oeffnen" SWORD FORMULA_0009 0 0 -500.0000 1500.0000 ECU_ADDRESS 0x3F9A3E /begin FUNCTION_LIST Global /end FUNCTION_LIST /end MEASUREMENT
/begin MEASUREMENT ml_b1 "Luftmassenstrom" SWORD FORMULA_0010 0 0 -100.0000 1400.0000 ECU_ADDRESS 0x3F9A40 /begin FUNCTION_LIST Global /end FUNCTION_LIST /end MEASUREMENT
/begin MEASUREMENT ml_b2 "Luftmassenstrom" SWORD FORMULA_0010 0 0 -100.0000 1400.0000 ECU_ADDRESS 0x3F9A42 /begin FUNCTION_LIST Global /end FUNCTION_LIST /end MEASUREMENT
/begin MEASUREMENT rf_m "relative Fuellung Mittel zwischen Bank 1 und 2" SWORD FORMULA_0006 0 0 0.0 2.0000 ECU_ADDRESS 0x3F9A44 /begin FUNCTION_LIST Global /end FUNCTION_LIST /end MEASUREMENT
/begin MEASUREMENT ml_ges "Luftmassenstrom Bank 1 und 2" SWORD FORMULA_0010 0 0 -100.0000 1400.0000 ECU_ADDRESS 0x3F9A46 /begin FUNCTION_LIST Global /end FUNCTION_LIST /end MEASUREMENT
/begin MEASUREMENT rps_zyl_nr "Zylinder-RPS" UBYTE FORMULA_0008 0 0 0.0 255.0000 ECU_ADDRESS 0x3F9A48 /begin FUNCTION_LIST Global /end FUNCTION_LIST /end MEASUREMENT
/begin MEASUREMENT rps_ionen_st "Status Ionen-RPS" UWORD FORMULA_0000 0 0 0.0 65535.0000 ECU_ADDRESS 0x3F9A4A /begin FUNCTION_LIST Global /end FUNCTION_LIST /end MEASUREMENT
/begin MEASUREMENT rps_ionen_stufe "Stufe Ionen-RPS" UWORD FORMULA_0000 0 0 0.0 65535.0000 ECU_ADDRESS 0x3F9A4C /begin FUNCTION_LIST Global /end FUNCTION_LIST /end MEASUREMENT
/begin MEASUREMENT rps_auss_st "Status Aussetzer-RPS" UWORD FORMULA_0000 0 0 0.0 65535.0000 ECU_ADDRESS 0x3F9A4E /begin FUNCTION_LIST Global /end FUNCTION_LIST /end MEASUREMENT
/begin MEASUREMENT n "Motordrehzahl" SWORD FORMULA_0011 0 0 0.0 10000.0000 ECU_ADDRESS 0x3F9A50 /begin FUNCTION_LIST Global /end FUNCTION_LIST /end MEASUREMENT
/begin MEASUREMENT dn_segment "Drehzahlgradient" SWORD FORMULA_0012 0 0 -10000.0000 10000.0000 ECU_ADDRESS 0x3F9A52 /begin FUNCTION_LIST Global /end FUNCTION_LIST /end MEASUREMENT
/begin MEASUREMENT dn_asp "Drehzahlgradient (Arbeitsspiel)" SWORD FORMULA_0012 0 0 -10000.0000 10000.0000 ECU_ADDRESS 0x3F9A54 /begin FUNCTION_LIST Global /end FUNCTION_LIST /end MEASUREMENT
/begin MEASUREMENT lam_soll_vl_max "Soll-Lambda bei max VL" UWORD FORMULA_0004 0 0 0.0 3.9990 ECU_ADDRESS 0x3F9A56 /begin FUNCTION_LIST Global /end FUNCTION_LIST /end MEASUREMENT
/begin MEASUREMENT v_rad_vl "v-Rad vorne-links" SWORD FORMULA_0013 0 0 -360.0000 360.0000 ECU_ADDRESS 0x3F9A58 /begin FUNCTION_LIST Global /end FUNCTION_LIST /end MEASUREMENT
/begin MEASUREMENT v_rad_vr "v-Rad vorne-rechts" SWORD FORMULA_0013 0 0 -360.0000 360.0000 ECU_ADDRESS 0x3F9A5A /begin FUNCTION_LIST Global /end FUNCTION_LIST /end MEASUREMENT
/begin MEASUREMENT v_rad_hl "v-Rad hinten-links" SWORD FORMULA_0013 0 0 -360.0000 360.0000 ECU_ADDRESS 0x3F9A5C /begin FUNCTION_LIST Global /end FUNCTION_LIST /end MEASUREMENT
/begin MEASUREMENT v_rad_hr "v-Rad hinten-rechts" SWORD FORMULA_0013 0 0 -360.0000 360.0000 ECU_ADDRESS 0x3F9A5E /begin FUNCTION_LIST Global /end FUNCTION_LIST /end MEASUREMENT
/begin MEASUREMENT v_rad_st "v-Rad-Status" UWORD FORMULA_0014 0 0 0.0 65535.0 ECU_ADDRESS 0x3F9A60 /begin FUNCTION_LIST Global /end FUNCTION_LIST /end MEASUREMENT
/begin MEASUREMENT v_vorne "v-Vorderachse" SWORD FORMULA_0013 0 0 -360.0000 360.0000 ECU_ADDRESS 0x3F9A62 /begin FUNCTION_LIST Global /end FUNCTION_LIST /end MEASUREMENT
/begin MEASUREMENT v_hinten "v-Hinterachse" SWORD FORMULA_0013 0 0 -360.0000 360.0000 ECU_ADDRESS 0x3F9A64 /begin FUNCTION_LIST Global /end FUNCTION_LIST /end MEASUREMENT
/begin MEASUREMENT sa_we_st "SAWE-Status" UBYTE FORMULA_0015 0 0 0.0 255.0 ECU_ADDRESS 0x3F9A66 /begin FUNCTION_LIST Global /end FUNCTION_LIST /end MEASUREMENT
/begin MEASUREMENT pks_ist "Kraftstoffdruck, absolut, gefiltert" SWORD FORMULA_0016 0 0 0.0 10.0000 ECU_ADDRESS 0x3F9A68 /begin FUNCTION_LIST Global /end FUNCTION_LIST /end MEASUREMENT
/begin MEASUREMENT pks_ed "Eigendiagnose Kraftstoffdruck" UWORD FORMULA_0017 0 0 0.0 111.0 ECU_ADDRESS 0x3F9A6A /begin FUNCTION_LIST Global /end FUNCTION_LIST BIT_MASK 0x6F /end MEASUREMENT
/begin MEASUREMENT rps_cfg "Auswahl RPS-Modell" UBYTE FORMULA_0008 0 0 0.0 255.0000 ECU_ADDRESS 0x3F9A6C /begin FUNCTION_LIST Global /end FUNCTION_LIST /end MEASUREMENT
/begin MEASUREMENT rps_rec1_cnt "Rec1-Fehlerzaehler" UBYTE FORMULA_0008 0 0 0.0 255.0000 ECU_ADDRESS 0x3F9A6D /begin FUNCTION_LIST Global /end FUNCTION_LIST /end MEASUREMENT
/begin MEASUREMENT rps_rec2_cnt "Rec2-Fehlerzaehler" UBYTE FORMULA_0008 0 0 0.0 255.0000 ECU_ADDRESS 0x3F9A6E /begin FUNCTION_LIST Global /end FUNCTION_LIST /end MEASUREMENT
/begin MEASUREMENT rps_llr_st "Status LLR-RPS" UBYTE FORMULA_0008 0 0 0.0 255.0000 ECU_ADDRESS 0x3F9A6F /begin FUNCTION_LIST Global /end FUNCTION_LIST /end MEASUREMENT
/begin MEASUREMENT rps_llr_md_p "P-Anteil LLR-RPS" SWORD FORMULA_0018 0 0 -100.0000 1000.0000 ECU_ADDRESS 0x3F9A70 /begin FUNCTION_LIST Global /end FUNCTION_LIST /end MEASUREMENT
/begin MEASUREMENT rps_llr_md_i "I-Anteil LLR-RPS" SWORD FORMULA_0018 0 0 -100.0000 1000.0000 ECU_ADDRESS 0x3F9A72 /begin FUNCTION_LIST Global /end FUNCTION_LIST /end MEASUREMENT
/begin MEASUREMENT rps_llr_md_tz "TZ-Anteil LLR-RPS" SWORD FORMULA_0018 0 0 -100.0000 1000.0000 ECU_ADDRESS 0x3F9A74 /begin FUNCTION_LIST Global /end FUNCTION_LIST /end MEASUREMENT
/begin MEASUREMENT rps_llr_md_ad "Adaptionswert LLR-RPS" SWORD FORMULA_0018 0 0 -100.0000 1000.0000 ECU_ADDRESS 0x3F9A76 /begin FUNCTION_LIST Global /end FUNCTION_LIST /end MEASUREMENT
/begin MEASUREMENT rps_llr_n_soll "Sollwert LLR-RPS" SWORD FORMULA_0011 0 0 0.0 10000.0000 ECU_ADDRESS 0x3F9A78 /begin FUNCTION_LIST Global /end FUNCTION_LIST /end MEASUREMENT
/begin MEASUREMENT tks "Kraftstofftemperatur" SWORD FORMULA_0019 0 0 -50.0000 150.0000 ECU_ADDRESS 0x3F9A7A /begin FUNCTION_LIST Global /end FUNCTION_LIST /end MEASUREMENT
/begin MEASUREMENT tks_ed "Eigendiagnose Kraftstofftemperatur" UWORD FORMULA_0017 0 0 0.0 111.0 ECU_ADDRESS 0x3F9A7C /begin FUNCTION_LIST Global /end FUNCTION_LIST BIT_MASK 0x6F /end MEASUREMENT
/begin MEASUREMENT can_kkos_md "Md-Aufnahme KKOS" SWORD FORMULA_0018 0 0 -100.0000 1000.0000 ECU_ADDRESS 0x3F9A7E /begin FUNCTION_LIST Global /end FUNCTION_LIST /end MEASUREMENT
/begin MEASUREMENT dr_rel_1of2_ "relative Drosselung" SWORD FORMULA_0020 0 0 0.0 199.9938 ECU_ADDRESS 0x3F9A80 /begin FUNCTION_LIST Global /end FUNCTION_LIST /end MEASUREMENT
/begin MEASUREMENT dr_rel_2of2_ "relative Drosselung" SWORD FORMULA_0020 0 0 0.0 199.9938 ECU_ADDRESS 0x3F9A82 /begin FUNCTION_LIST Global /end FUNCTION_LIST /end MEASUREMENT
/begin MEASUREMENT zustand_motor "Betriebszustand der Motorsteuerung" UWORD FORMULA_0021 0 0 0.0 65535.0 ECU_ADDRESS 0x3F9A84 /begin FUNCTION_LIST Global /end FUNCTION_LIST /end MEASUREMENT
/begin MEASUREMENT zust_md_rel_tl_vl "rel. Übergangsmoment TL-VL" SWORD FORMULA_0022 0 0 0.0 100.0000 ECU_ADDRESS 0x3F9A86 /begin FUNCTION_LIST Global /end FUNCTION_LIST /end MEASUREMENT
/begin MEASUREMENT n_begr_st "Statusvariable Drehzahlbegrenzung" UBYTE FORMULA_0023 0 0 0.0 8.0 ECU_ADDRESS 0x3F9A88 /begin FUNCTION_LIST Global /end FUNCTION_LIST /end MEASUREMENT
/begin MEASUREMENT schalter_st_inj "Schalterstatus" UWORD FORMULA_0024 0 0 0.0 65535.0000 ECU_ADDRESS 0x3F9A8A /begin FUNCTION_LIST Global /end FUNCTION_LIST /end MEASUREMENT
/begin MEASUREMENT schalter_bls_inj "Schalterstatus" UWORD FORMULA_0025 0 0 0.0 65535.0 ECU_ADDRESS 0x3F9A8A /begin FUNCTION_LIST Global /end FUNCTION_LIST BIT_MASK 0x1 /end MEASUREMENT
/begin MEASUREMENT schalter_kupplung "Schalterstatus" UWORD FORMULA_0026 0 0 0.0 65535.0 ECU_ADDRESS 0x3F9A8A /begin FUNCTION_LIST Global /end FUNCTION_LIST BIT_MASK 0x2 /end MEASUREMENT
/begin MEASUREMENT schalter_getriebe "Schalterstatus" UWORD FORMULA_0027 0 0 0.0 65535.0 ECU_ADDRESS 0x3F9A8A /begin FUNCTION_LIST Global /end FUNCTION_LIST BIT_MASK 0x4 /end MEASUREMENT
/begin MEASUREMENT schalter_kl15_inj "Schalterstatus" UWORD FORMULA_0028 0 0 0.0 65535.0 ECU_ADDRESS 0x3F9A8A /begin FUNCTION_LIST Global /end FUNCTION_LIST BIT_MASK 0x8 /end MEASUREMENT
/begin MEASUREMENT schalter_sport "Schalterstatus" UWORD FORMULA_0029 0 0 0.0 65535.0 ECU_ADDRESS 0x3F9A8A /begin FUNCTION_LIST Global /end FUNCTION_LIST BIT_MASK 0x10 /end MEASUREMENT
/begin MEASUREMENT schalter_zustand_sport "Schalterstatus" UWORD FORMULA_0030 0 0 0.0 65535.0 ECU_ADDRESS 0x3F9A8A /begin FUNCTION_LIST Global /end FUNCTION_LIST BIT_MASK 0x40 /end MEASUREMENT
/begin MEASUREMENT pumg "Gefilterter Messwert" SWORD FORMULA_0031 0 0 400.0000 1200.0000 ECU_ADDRESS 0x3F9A90 /begin FUNCTION_LIST Global /end FUNCTION_LIST /end MEASUREMENT
/begin MEASUREMENT pumg_ed "Eigendiagnose Umgebungsdruck" UWORD FORMULA_0017 0 0 0.0 111.0 ECU_ADDRESS 0x3F9A92 /begin FUNCTION_LIST Global /end FUNCTION_LIST BIT_MASK 0x6F /end MEASUREMENT
/begin MEASUREMENT tumg "Umgebungstemperatur" SWORD FORMULA_0019 0 0 -50.0000 150.0000 ECU_ADDRESS 0x3F9A9C /begin FUNCTION_LIST Global /end FUNCTION_LIST /end MEASUREMENT
/begin MEASUREMENT tumg_st "Status Umgebungstemperatur" UBYTE FORMULA_0032 0 0 0.0 255.0 ECU_ADDRESS 0x3F9A9E /begin FUNCTION_LIST Global /end FUNCTION_LIST /end MEASUREMENT
/begin MEASUREMENT time_rel "Relativzeit" ULONG FORMULA_0033 0 0 0.0 35791394.1166 ECU_ADDRESS 0x3F9AA0 /begin FUNCTION_LIST Global /end FUNCTION_LIST /end MEASUREMENT
/begin MEASUREMENT time_abs "Absolutzeit seit 1.1.2000" UWORD FORMULA_0034 0 0 0.0 65535.0000 ECU_ADDRESS 0x3F9AA4 /begin FUNCTION_LIST Global /end FUNCTION_LIST /end MEASUREMENT
/begin MEASUREMENT time_ms "Zeit seit Motor steht" ULONG FORMULA_0033 0 0 0.0 35791394.1166 ECU_ADDRESS 0x3F9AA8 /begin FUNCTION_LIST Global /end FUNCTION_LIST /end MEASUREMENT
/begin MEASUREMENT time_ml "3HaxenSchnurrZeit" ULONG FORMULA_0033 0 0 0.0 35791394.1166 ECU_ADDRESS 0x3F9AAC /begin FUNCTION_LIST Global /end FUNCTION_LIST /end MEASUREMENT
/begin MEASUREMENT rf_pt_korr "Korrektur der relativen Fuellung" UWORD FORMULA_0035 0 0 0.0 4.0000 ECU_ADDRESS 0x3F9AB0 /begin FUNCTION_LIST Global /end FUNCTION_LIST /end MEASUREMENT
/begin MEASUREMENT gang "Gang" SBYTE FORMULA_0036 0 0 -1.0000 10.0000 ECU_ADDRESS 0x3F9AB2 /begin FUNCTION_LIST Global /end FUNCTION_LIST /end MEASUREMENT
/begin MEASUREMENT tz_zyl_ti "Zylinder selektive Abschaltung der Einspritzung" UWORD FORMULA_0024 0 0 0.0 65535.0000 ECU_ADDRESS 0x3F9AB4 /begin FUNCTION_LIST Global /end FUNCTION_LIST /end MEASUREMENT
/begin MEASUREMENT egas_ist_wdk_b1 "Istwert (analog)" SWORD FORMULA_0022 0 0 -10.0000 120.0000 ECU_ADDRESS 0x3F9AB6 /begin FUNCTION_LIST Global /end FUNCTION_LIST /end MEASUREMENT
/begin MEASUREMENT egas_ist_wdk_b2 "Istwert (analog)" SWORD FORMULA_0022 0 0 -10.0000 120.0000 ECU_ADDRESS 0x3F9AB8 /begin FUNCTION_LIST Global /end FUNCTION_LIST /end MEASUREMENT
/begin MEASUREMENT md_kupp_ist_ve "Moment an der Kupplung vor Eingriff" SWORD FORMULA_0018 0 0 -100.0000 1000.0000 ECU_ADDRESS 0x3F9ABA /begin FUNCTION_LIST Global /end FUNCTION_LIST /end MEASUREMENT
/begin MEASUREMENT md_kupp_ist "Moment an der Kupplung" SWORD FORMULA_0018 0 0 -100.0000 1000.0000 ECU_ADDRESS 0x3F9ABC /begin FUNCTION_LIST Global /end FUNCTION_LIST /end MEASUREMENT
/begin MEASUREMENT md_ind_ne "ind. Moment nach Eingriff" SWORD FORMULA_0018 0 0 -100.0000 1000.0000 ECU_ADDRESS 0x3F9ABE /begin FUNCTION_LIST Global /end FUNCTION_LIST /end MEASUREMENT
/begin MEASUREMENT md_tz_soll_mittel "mittlerer Soll-TZ" SWORD FORMULA_0037 0 0 -50.0000 60.0000 ECU_ADDRESS 0x3F9AC0 /begin FUNCTION_LIST Global /end FUNCTION_LIST /end MEASUREMENT
/begin MEASUREMENT md_fw_rel "rel. Wunschmoment" SWORD FORMULA_0022 0 0 0.0 100.0000 ECU_ADDRESS 0x3F9AC4 /begin FUNCTION_LIST Global /end FUNCTION_LIST /end MEASUREMENT
/begin MEASUREMENT md_wunsch_rel "Ergebnis der Max-Auswahl" SWORD FORMULA_0022 0 0 0.0 100.0000 ECU_ADDRESS 0x3F9AC6 /begin FUNCTION_LIST Global /end FUNCTION_LIST /end MEASUREMENT
/begin MEASUREMENT md_kupp_wunsch_begr "begrenztes Wunschmoment" SWORD FORMULA_0018 0 0 -100.0000 1000.0000 ECU_ADDRESS 0x3F9AC8 /begin FUNCTION_LIST Global /end FUNCTION_LIST /end MEASUREMENT
/begin MEASUREMENT md_st "MD-Stati" UWORD FORMULA_0000 0 0 0.0 65535.0000 ECU_ADDRESS 0x3F9ACA /begin FUNCTION_LIST Global /end FUNCTION_LIST /end MEASUREMENT
/begin MEASUREMENT egas_soll_dk_b1 "DK-Sollwert" SWORD FORMULA_0022 0 0 -10.0000 120.0000 ECU_ADDRESS 0x3F9ACC /begin FUNCTION_LIST Global /end FUNCTION_LIST /end MEASUREMENT
/begin MEASUREMENT egas_soll_dk_b2 "DK-Sollwert" SWORD FORMULA_0022 0 0 -10.0000 120.0000 ECU_ADDRESS 0x3F9ACE /begin FUNCTION_LIST Global /end FUNCTION_LIST /end MEASUREMENT
/begin MEASUREMENT egas_soll_lls_b1 "LLS-Sollwert" SWORD FORMULA_0022 0 0 -10.0000 120.0000 ECU_ADDRESS 0x3F9AD0 /begin FUNCTION_LIST Global /end FUNCTION_LIST /end MEASUREMENT
/begin MEASUREMENT egas_soll_lls_b2 "LLS-Sollwert" SWORD FORMULA_0022 0 0 -10.0000 120.0000 ECU_ADDRESS 0x3F9AD2 /begin FUNCTION_LIST Global /end FUNCTION_LIST /end MEASUREMENT
/begin MEASUREMENT egas_ist_dk_b1 "Istwert (CAN)" SWORD FORMULA_0022 0 0 -10.0000 120.0000 ECU_ADDRESS 0x3F9AD4 /begin FUNCTION_LIST Global /end FUNCTION_LIST /end MEASUREMENT
/begin MEASUREMENT egas_ist_dk_b2 "Istwert (CAN)" SWORD FORMULA_0022 0 0 -10.0000 120.0000 ECU_ADDRESS 0x3F9AD6 /begin FUNCTION_LIST Global /end FUNCTION_LIST /end MEASUREMENT
/begin MEASUREMENT egas_ist_lls_b1 "Istwert (CAN)" SWORD FORMULA_0022 0 0 -10.0000 120.0000 ECU_ADDRESS 0x3F9AD8 /begin FUNCTION_LIST Global /end FUNCTION_LIST /end MEASUREMENT
/begin MEASUREMENT egas_ist_lls_b2 "Istwert (CAN)" SWORD FORMULA_0022 0 0 -10.0000 120.0000 ECU_ADDRESS 0x3F9ADA /begin FUNCTION_LIST Global /end FUNCTION_LIST /end MEASUREMENT
/begin MEASUREMENT egas_ist_st_b1 "Status Istwerte" UWORD FORMULA_0038 0 0 0.0 65535.0 ECU_ADDRESS 0x3F9ADC /begin FUNCTION_LIST Global /end FUNCTION_LIST /end MEASUREMENT
/begin MEASUREMENT egas_ist_st_b2 "Status Istwerte" UWORD FORMULA_0038 0 0 0.0 65535.0 ECU_ADDRESS 0x3F9ADE /begin FUNCTION_LIST Global /end FUNCTION_LIST /end MEASUREMENT
/begin MEASUREMENT egas_ist_wdk_rf_b1 "Fuellung aus WDK" SWORD FORMULA_0006 0 0 0.0 2.0000 ECU_ADDRESS 0x3F9AE0 /begin FUNCTION_LIST Global /end FUNCTION_LIST /end MEASUREMENT
/begin MEASUREMENT egas_ist_wdk_rf_b2 "Fuellung aus WDK" SWORD FORMULA_0006 0 0 0.0 2.0000 ECU_ADDRESS 0x3F9AE2 /begin FUNCTION_LIST Global /end FUNCTION_LIST /end MEASUREMENT
/begin MEASUREMENT egas_ist_lls_rf_b1 "Fuellung aus LLS" SWORD FORMULA_0006 0 0 0.0 2.0000 ECU_ADDRESS 0x3F9AE4 /begin FUNCTION_LIST Global /end FUNCTION_LIST /end MEASUREMENT
/begin MEASUREMENT egas_ist_lls_rf_b2 "Fuellung aus LLS" SWORD FORMULA_0006 0 0 0.0 2.0000 ECU_ADDRESS 0x3F9AE6 /begin FUNCTION_LIST Global /end FUNCTION_LIST /end MEASUREMENT
/begin MEASUREMENT pwg_kd_st "Kickdown-Status" UBYTE FORMULA_0008 0 0 0.0 255.0000 ECU_ADDRESS 0x3F9AE8 /begin FUNCTION_LIST Global /end FUNCTION_LIST BIT_MASK 0x1 /end MEASUREMENT
/begin MEASUREMENT pwg_kd_st_kickdown "Kickdown-Status" UBYTE FORMULA_0039 0 0 0.0 255.0 ECU_ADDRESS 0x3F9AE8 /begin FUNCTION_LIST Global /end FUNCTION_LIST BIT_MASK 0x1 /end MEASUREMENT
/begin MEASUREMENT pwg_mode "Ausgabezustand der Pedalwertgebererfassung" UBYTE FORMULA_0040 0 0 0.0 255.0 ECU_ADDRESS 0x3F9AE9 /begin FUNCTION_LIST Global /end FUNCTION_LIST /end MEASUREMENT
/begin MEASUREMENT schalter_st_ign "Schalterstatus" UWORD FORMULA_0024 0 0 0.0 65535.0000 ECU_ADDRESS 0x3F9AEC /begin FUNCTION_LIST Global /end FUNCTION_LIST /end MEASUREMENT
/begin MEASUREMENT schalter_bls_ign "Schalterstatus" UWORD FORMULA_0025 0 0 0.0 65535.0 ECU_ADDRESS 0x3F9AEC /begin FUNCTION_LIST Global /end FUNCTION_LIST BIT_MASK 0x1 /end MEASUREMENT
/begin MEASUREMENT schalter_blts "Schalterstatus" UWORD FORMULA_0041 0 0 0.0 65535.0 ECU_ADDRESS 0x3F9AEC /begin FUNCTION_LIST Global /end FUNCTION_LIST BIT_MASK 0x2 /end MEASUREMENT
/begin MEASUREMENT schalter_kl15 "Schalterstatus" UWORD FORMULA_0042 0 0 0.0 65535.0 ECU_ADDRESS 0x3F9AEC /begin FUNCTION_LIST Global /end FUNCTION_LIST BIT_MASK 0x4 /end MEASUREMENT
/begin MEASUREMENT schalter_kl87 "Schalterstatus" UWORD FORMULA_0043 0 0 0.0 65535.0 ECU_ADDRESS 0x3F9AEC /begin FUNCTION_LIST Global /end FUNCTION_LIST BIT_MASK 0x8 /end MEASUREMENT
/begin MEASUREMENT schalter_kl50 "Schalterstatus" UWORD FORMULA_0044 0 0 0.0 65535.0 ECU_ADDRESS 0x3F9AEC /begin FUNCTION_LIST Global /end FUNCTION_LIST BIT_MASK 0x10 /end MEASUREMENT
/begin MEASUREMENT ub_15 "Spannungswert U_KL15" SWORD FORMULA_0045 0 0 0.0 28.0000 ECU_ADDRESS 0x3F9AEE /begin FUNCTION_LIST Global /end FUNCTION_LIST /end MEASUREMENT
/begin MEASUREMENT ub "Spannungswert U_KL87" SWORD FORMULA_0045 0 0 0.0 28.0000 ECU_ADDRESS 0x3F9AF0 /begin FUNCTION_LIST Global /end FUNCTION_LIST /end MEASUREMENT
/begin MEASUREMENT ub_15_ed "Eigendiagnose U_KL15" UWORD FORMULA_0017 0 0 0.0 111.0 ECU_ADDRESS 0x3F9AF2 /begin FUNCTION_LIST Global /end FUNCTION_LIST BIT_MASK 0x6F /end MEASUREMENT
/begin MEASUREMENT ub_ed "Eigendiagnose U_KL87" UWORD FORMULA_0017 0 0 0.0 111.0 ECU_ADDRESS 0x3F9AF4 /begin FUNCTION_LIST Global /end FUNCTION_LIST BIT_MASK 0x6F /end MEASUREMENT
/begin MEASUREMENT uext_pin_m18 "Versorgungsspannung" UWORD FORMULA_0046 0 0 0.0 6.6665 ECU_ADDRESS 0x3F9AF6 /begin FUNCTION_LIST Global /end FUNCTION_LIST /end MEASUREMENT
/begin MEASUREMENT uext_pin_m66 "Versorgungsspannung" UWORD FORMULA_0046 0 0 0.0 6.6665 ECU_ADDRESS 0x3F9AF8 /begin FUNCTION_LIST Global /end FUNCTION_LIST /end MEASUREMENT
/begin MEASUREMENT uext_pin_f43 "Versorgungsspannung" UWORD FORMULA_0046 0 0 0.0 6.6665 ECU_ADDRESS 0x3F9AFA /begin FUNCTION_LIST Global /end FUNCTION_LIST /end MEASUREMENT
/begin MEASUREMENT uext_pin_f56 "Versorgungsspannung" UWORD FORMULA_0046 0 0 0.0 6.6665 ECU_ADDRESS 0x3F9AFC /begin FUNCTION_LIST Global /end FUNCTION_LIST /end MEASUREMENT
/begin MEASUREMENT uext_korr_pin_m18 "Korrekturfaktor fuer UEXT" UWORD FORMULA_0035 0 0 0.0 4.0000 ECU_ADDRESS 0x3F9AFE /begin FUNCTION_LIST Global /end FUNCTION_LIST /end MEASUREMENT
/begin MEASUREMENT uext_korr_pin_m66 "Korrekturfaktor fuer UEXT" UWORD FORMULA_0035 0 0 0.0 4.0000 ECU_ADDRESS 0x3F9B00 /begin FUNCTION_LIST Global /end FUNCTION_LIST /end MEASUREMENT
/begin MEASUREMENT uext_korr_pin_f43 "Korrekturfaktor fuer UEXT" UWORD FORMULA_0035 0 0 0.0 4.0000 ECU_ADDRESS 0x3F9B02 /begin FUNCTION_LIST Global /end FUNCTION_LIST /end MEASUREMENT
/begin MEASUREMENT uext_korr_pin_f56 "Korrekturfaktor fuer UEXT" UWORD FORMULA_0035 0 0 0.0 4.0000 ECU_ADDRESS 0x3F9B04 /begin FUNCTION_LIST Global /end FUNCTION_LIST /end MEASUREMENT
/begin MEASUREMENT uext_ed_pin_m18 "Eigendiagnose UEXT" UWORD FORMULA_0017 0 0 0.0 111.0 ECU_ADDRESS 0x3F9B06 /begin FUNCTION_LIST Global /end FUNCTION_LIST BIT_MASK 0x6F /end MEASUREMENT
/begin MEASUREMENT uext_ed_pin_m66 "Eigendiagnose UEXT" UWORD FORMULA_0017 0 0 0.0 111.0 ECU_ADDRESS 0x3F9B08 /begin FUNCTION_LIST Global /end FUNCTION_LIST BIT_MASK 0x6F /end MEASUREMENT
/begin MEASUREMENT uext_ed_pin_f43 "Eigendiagnose UEXT" UWORD FORMULA_0017 0 0 0.0 111.0 ECU_ADDRESS 0x3F9B0A /begin FUNCTION_LIST Global /end FUNCTION_LIST BIT_MASK 0x6F /end MEASUREMENT
/begin MEASUREMENT uext_ed_pin_f56 "Eigendiagnose UEXT" UWORD FORMULA_0017 0 0 0.0 111.0 ECU_ADDRESS 0x3F9B0C /begin FUNCTION_LIST Global /end FUNCTION_LIST BIT_MASK 0x6F /end MEASUREMENT
/begin MEASUREMENT md_kupp_min "Minimalmoment an der Kupplung" SWORD FORMULA_0018 0 0 -100.0000 1000.0000 ECU_ADDRESS 0x3F9B0E /begin FUNCTION_LIST Global /end FUNCTION_LIST /end MEASUREMENT
/begin MEASUREMENT llr_n_soll "Leerlaufdrehzahl" SWORD FORMULA_0011 0 0 0.0 10000.0000 ECU_ADDRESS 0x3F9B14 /begin FUNCTION_LIST Global /end FUNCTION_LIST /end MEASUREMENT
/begin MEASUREMENT md_sk_ti_st "SK-Ausblendmaske" UWORD FORMULA_0000 0 0 0.0 65535.0000 ECU_ADDRESS 0x3F9B16 /begin FUNCTION_LIST Global /end FUNCTION_LIST /end MEASUREMENT
/begin MEASUREMENT tz_min "minimal zulaessiger Zuendwinkel" SWORD FORMULA_0037 0 0 -50.0000 60.0000 ECU_ADDRESS 0x3F9B18 /begin FUNCTION_LIST Global /end FUNCTION_LIST /end MEASUREMENT
/begin MEASUREMENT tabg_b1 "Abgastemperatur" SWORD FORMULA_0019 0 0 -50.0000 1250.0000 ECU_ADDRESS 0x3F9B1A /begin FUNCTION_LIST Global /end FUNCTION_LIST /end MEASUREMENT
/begin MEASUREMENT tabg_b2 "Abgastemperatur" SWORD FORMULA_0019 0 0 -50.0000 1250.0000 ECU_ADDRESS 0x3F9B1C /begin FUNCTION_LIST Global /end FUNCTION_LIST /end MEASUREMENT
/begin MEASUREMENT tabg_lw_b1 "Abgastemperatur Ladungswechsel" SWORD FORMULA_0019 0 0 -50.0000 1250.0000 ECU_ADDRESS 0x3F9B1E /begin FUNCTION_LIST Global /end FUNCTION_LIST /end MEASUREMENT
/begin MEASUREMENT tabg_lw_b2 "Abgastemperatur Ladungswechsel" SWORD FORMULA_0019 0 0 -50.0000 1250.0000 ECU_ADDRESS 0x3F9B20 /begin FUNCTION_LIST Global /end FUNCTION_LIST /end MEASUREMENT
/begin MEASUREMENT tabg_vkat_b1 "Abgastemperatur vorm Kat" SWORD FORMULA_0019 0 0 -50.0000 1250.0000 ECU_ADDRESS 0x3F9B22 /begin FUNCTION_LIST Global /end FUNCTION_LIST /end MEASUREMENT
/begin MEASUREMENT tabg_vkat_b2 "Abgastemperatur vorm Kat" SWORD FORMULA_0019 0 0 -50.0000 1250.0000 ECU_ADDRESS 0x3F9B24 /begin FUNCTION_LIST Global /end FUNCTION_LIST /end MEASUREMENT
/begin MEASUREMENT tabg_mkat_b1 "Abgastemperatur in der Katmitte" SWORD FORMULA_0019 0 0 -50.0000 1250.0000 ECU_ADDRESS 0x3F9B26 /begin FUNCTION_LIST Global /end FUNCTION_LIST /end MEASUREMENT
/begin MEASUREMENT tabg_mkat_b2 "Abgastemperatur in der Katmitte" SWORD FORMULA_0019 0 0 -50.0000 1250.0000 ECU_ADDRESS 0x3F9B28 /begin FUNCTION_LIST Global /end FUNCTION_LIST /end MEASUREMENT
/begin MEASUREMENT tabg_mkat_mw "Abgastemperaturmittelwert in der Katmitte" SWORD FORMULA_0019 0 0 -50.0000 1250.0000 ECU_ADDRESS 0x3F9B2A /begin FUNCTION_LIST Global /end FUNCTION_LIST /end MEASUREMENT
/begin MEASUREMENT tabg_nkat_b1 "Abgastemperatur nach dem Kat" SWORD FORMULA_0019 0 0 -50.0000 1250.0000 ECU_ADDRESS 0x3F9B2C /begin FUNCTION_LIST Global /end FUNCTION_LIST /end MEASUREMENT
/begin MEASUREMENT tabg_nkat_b2 "Abgastemperatur nach dem Kat" SWORD FORMULA_0019 0 0 -50.0000 1250.0000 ECU_ADDRESS 0x3F9B2E /begin FUNCTION_LIST Global /end FUNCTION_LIST /end MEASUREMENT
/begin MEASUREMENT tabg_lw_verh_b1 "Verhaeltnis der Ladungswechseltemperaturen" UWORD FORMULA_0035 0 0 0.0 4.0000 ECU_ADDRESS 0x3F9B30 /begin FUNCTION_LIST Global /end FUNCTION_LIST /end MEASUREMENT
/begin MEASUREMENT tabg_lw_verh_b2 "Verhaeltnis der Ladungswechseltemperaturen" UWORD FORMULA_0035 0 0 0.0 4.0000 ECU_ADDRESS 0x3F9B32 /begin FUNCTION_LIST Global /end FUNCTION_LIST /end MEASUREMENT
/begin MEASUREMENT tabg_lw_verh_wurzel_b1 "Wurzel-Verhaeltnis der Ladungswechseltemperaturen" UWORD FORMULA_0035 0 0 0.0 4.0000 ECU_ADDRESS 0x3F9B34 /begin FUNCTION_LIST Global /end FUNCTION_LIST /end MEASUREMENT
/begin MEASUREMENT tabg_lw_verh_wurzel_b2 "Wurzel-Verhaeltnis der Ladungswechseltemperaturen" UWORD FORMULA_0035 0 0 0.0 4.0000 ECU_ADDRESS 0x3F9B36 /begin FUNCTION_LIST Global /end FUNCTION_LIST /end MEASUREMENT
/begin MEASUREMENT tabg_ed_b1 "Eigendiagnose Abgastemperatur" UWORD FORMULA_0017 0 0 0.0 111.0 ECU_ADDRESS 0x3F9B38 /begin FUNCTION_LIST Global /end FUNCTION_LIST BIT_MASK 0x6F /end MEASUREMENT
/begin MEASUREMENT tabg_ed_b2 "Eigendiagnose Abgastemperatur" UWORD FORMULA_0017 0 0 0.0 111.0 ECU_ADDRESS 0x3F9B3A /begin FUNCTION_LIST Global /end FUNCTION_LIST BIT_MASK 0x6F /end MEASUREMENT
/begin MEASUREMENT tabg_st "TABG-Status" UBYTE FORMULA_0047 0 0 0.0 255.0000 ECU_ADDRESS 0x3F9B3C /begin FUNCTION_LIST Global /end FUNCTION_LIST /end MEASUREMENT
/begin MEASUREMENT tabg_st_kats_b1 "Katschutz Bank 1" UBYTE FORMULA_0048 0 0 0.0 255.0 ECU_ADDRESS 0x3F9B3C /begin FUNCTION_LIST Global /end FUNCTION_LIST BIT_MASK 0x1 /end MEASUREMENT
/begin MEASUREMENT tabg_st_kats_b2 "Katschutz Bank 2" UBYTE FORMULA_0049 0 0 0.0 255.0 ECU_ADDRESS 0x3F9B3C /begin FUNCTION_LIST Global /end FUNCTION_LIST BIT_MASK 0x2 /end MEASUREMENT
/begin MEASUREMENT tabg_st_aufregeln_b1 "Kat-Enthalpie Bank 1" UBYTE FORMULA_0050 0 0 0.0 255.0 ECU_ADDRESS 0x3F9B3C /begin FUNCTION_LIST Global /end FUNCTION_LIST BIT_MASK 0x4 /end MEASUREMENT
/begin MEASUREMENT tabg_st_aufregeln_b2 "Kat-Enthalpie Bank 2" UBYTE FORMULA_0051 0 0 0.0 255.0 ECU_ADDRESS 0x3F9B3C /begin FUNCTION_LIST Global /end FUNCTION_LIST BIT_MASK 0x8 /end MEASUREMENT
/begin MEASUREMENT tabg_st_init "TABG-Init-Status" UBYTE FORMULA_0052 0 0 0.0 255.0 ECU_ADDRESS 0x3F9B3C /begin FUNCTION_LIST Global /end FUNCTION_LIST BIT_MASK 0x80 /end MEASUREMENT
/begin MEASUREMENT tan_b1 "Ansauglufttemperatur" SWORD FORMULA_0019 0 0 -50.0000 150.0000 ECU_ADDRESS 0x3F9B3E /begin FUNCTION_LIST Global /end FUNCTION_LIST /end MEASUREMENT
/begin MEASUREMENT tan_b2 "Ansauglufttemperatur" SWORD FORMULA_0019 0 0 -50.0000 150.0000 ECU_ADDRESS 0x3F9B40 /begin FUNCTION_LIST Global /end FUNCTION_LIST /end MEASUREMENT
/begin MEASUREMENT tan_ed_b1 "Eigendiagnose Ansauglufttemperatur" UWORD FORMULA_0017 0 0 0.0 111.0 ECU_ADDRESS 0x3F9B42 /begin FUNCTION_LIST Global /end FUNCTION_LIST BIT_MASK 0x6F /end MEASUREMENT
/begin MEASUREMENT tan_ed_b2 "Eigendiagnose Ansauglufttemperatur" UWORD FORMULA_0017 0 0 0.0 111.0 ECU_ADDRESS 0x3F9B44 /begin FUNCTION_LIST Global /end FUNCTION_LIST BIT_MASK 0x6F /end MEASUREMENT
/begin MEASUREMENT tdme "Steuergeraetetemperatur" SWORD FORMULA_0019 0 0 -50.0000 150.0000 ECU_ADDRESS 0x3F9B46 /begin FUNCTION_LIST Global /end FUNCTION_LIST /end MEASUREMENT
/begin MEASUREMENT tdme_ed "Eigendiagnose Steuergeraetetemperatur" UWORD FORMULA_0017 0 0 0.0 111.0 ECU_ADDRESS 0x3F9B48 /begin FUNCTION_LIST Global /end FUNCTION_LIST BIT_MASK 0x6F /end MEASUREMENT
/begin MEASUREMENT tka "Kuehlwasseraustrittstemperatur" SWORD FORMULA_0019 0 0 -50.0000 150.0000 ECU_ADDRESS 0x3F9B4A /begin FUNCTION_LIST Global /end FUNCTION_LIST /end MEASUREMENT
/begin MEASUREMENT tka_ed "Eigendiagnose Kuehlwasseraustrittstemperatur" UWORD FORMULA_0017 0 0 0.0 111.0 ECU_ADDRESS 0x3F9B4C /begin FUNCTION_LIST Global /end FUNCTION_LIST BIT_MASK 0x6F /end MEASUREMENT
/begin MEASUREMENT tmot "Motortemperatur-Kuehlwasser" SWORD FORMULA_0019 0 0 -50.0000 150.0000 ECU_ADDRESS 0x3F9B4E /begin FUNCTION_LIST Global /end FUNCTION_LIST /end MEASUREMENT
/begin MEASUREMENT tmot_ed "Eigendiagnose Kuehlwassertemperatur" UWORD FORMULA_0017 0 0 0.0 111.0 ECU_ADDRESS 0x3F9B50 /begin FUNCTION_LIST Global /end FUNCTION_LIST BIT_MASK 0x6F /end MEASUREMENT
/begin MEASUREMENT tmot_st "TMOT-Status" UWORD FORMULA_0024 0 0 0.0 65535.0000 ECU_ADDRESS 0x3F9B52 /begin FUNCTION_LIST Global /end FUNCTION_LIST /end MEASUREMENT
/begin MEASUREMENT tmot_st_sa_abbruch "TMOT-Status" UWORD FORMULA_0053 0 0 0.0 65535.0 ECU_ADDRESS 0x3F9B52 /begin FUNCTION_LIST Global /end FUNCTION_LIST BIT_MASK 0x1 /end MEASUREMENT
/begin MEASUREMENT tmot_st_min_max_fehler "TMOT-Status" UWORD FORMULA_0054 0 0 0.0 65535.0 ECU_ADDRESS 0x3F9B52 /begin FUNCTION_LIST Global /end FUNCTION_LIST BIT_MASK 0x2 /end MEASUREMENT
/begin MEASUREMENT tmot_st_sensor_ok "TMOT-Status" UWORD FORMULA_0055 0 0 0.0 65535.0 ECU_ADDRESS 0x3F9B52 /begin FUNCTION_LIST Global /end FUNCTION_LIST BIT_MASK 0x4 /end MEASUREMENT
/begin MEASUREMENT tmot_st_thermo_offen "TMOT-Status" UWORD FORMULA_0056 0 0 0.0 65535.0 ECU_ADDRESS 0x3F9B52 /begin FUNCTION_LIST Global /end FUNCTION_LIST BIT_MASK 0x8 /end MEASUREMENT
/begin MEASUREMENT tmot_st_sensor_unplaus "TMOT-Status" UWORD FORMULA_0057 0 0 0.0 65535.0 ECU_ADDRESS 0x3F9B52 /begin FUNCTION_LIST Global /end FUNCTION_LIST BIT_MASK 0x10 /end MEASUREMENT
/begin MEASUREMENT tmot_st_blockheater "TMOT-Status" UWORD FORMULA_0058 0 0 0.0 65535.0 ECU_ADDRESS 0x3F9B52 /begin FUNCTION_LIST Global /end FUNCTION_LIST BIT_MASK 0x20 /end MEASUREMENT
/begin MEASUREMENT tmot_st_la_einschalten "TMOT-Status" UWORD FORMULA_0059 0 0 0.0 65535.0 ECU_ADDRESS 0x3F9B52 /begin FUNCTION_LIST Global /end FUNCTION_LIST BIT_MASK 0x40 /end MEASUREMENT
/begin MEASUREMENT tmot_st_thermo_ok "TMOT-Status" UWORD FORMULA_0060 0 0 0.0 65535.0 ECU_ADDRESS 0x3F9B52 /begin FUNCTION_LIST Global /end FUNCTION_LIST BIT_MASK 0x80 /end MEASUREMENT
/begin MEASUREMENT tmot_st_modell_init "TMOT-Status" UWORD FORMULA_0061 0 0 0.0 65535.0 ECU_ADDRESS 0x3F9B52 /begin FUNCTION_LIST Global /end FUNCTION_LIST BIT_MASK 0x100 /end MEASUREMENT
/begin MEASUREMENT tmot_st_diagnose_stop "TMOT-Status" UWORD FORMULA_0062 0 0 0.0 65535.0 ECU_ADDRESS 0x3F9B52 /begin FUNCTION_LIST Global /end FUNCTION_LIST BIT_MASK 0x200 /end MEASUREMENT
/begin MEASUREMENT tmot_st_ersatz_init "TMOT-Status" UWORD FORMULA_0063 0 0 0.0 65535.0 ECU_ADDRESS 0x3F9B52 /begin FUNCTION_LIST Global /end FUNCTION_LIST BIT_MASK 0x8000 /end MEASUREMENT
/begin MEASUREMENT tmot_sta "Status Uebertemperaturanzeige" UBYTE FORMULA_0064 0 0 0.0 2.0 ECU_ADDRESS 0x3F9B54 /begin FUNCTION_LIST Global /end FUNCTION_LIST /end MEASUREMENT
/begin MEASUREMENT toel "Temperatur in Celsius" SWORD FORMULA_0019 0 0 -50.0000 150.0000 ECU_ADDRESS 0x3F9B56 /begin FUNCTION_LIST Global /end FUNCTION_LIST /end MEASUREMENT
/begin MEASUREMENT tsgrw_m "Mittelwert Saugrohrwandtemperatur" SWORD FORMULA_0019 0 0 -50.0000 150.0000 ECU_ADDRESS 0x3F9B5A /begin FUNCTION_LIST Global /end FUNCTION_LIST /end MEASUREMENT
/begin MEASUREMENT tsgrw_b1 "Saugrohrwandtemperatur" SWORD FORMULA_0019 0 0 -50.0000 150.0000 ECU_ADDRESS 0x3F9B5C /begin FUNCTION_LIST Global /end FUNCTION_LIST /end MEASUREMENT
/begin MEASUREMENT tsgrw_b2 "Saugrohrwandtemperatur" SWORD FORMULA_0019 0 0 -50.0000 150.0000 ECU_ADDRESS 0x3F9B5E /begin FUNCTION_LIST Global /end FUNCTION_LIST /end MEASUREMENT
/begin MEASUREMENT tumg_ersatz "Ersatzwert der Umgebungstemperatur" SWORD FORMULA_0019 0 0 -50.0000 150.0000 ECU_ADDRESS 0x3F9B60 /begin FUNCTION_LIST Global /end FUNCTION_LIST /end MEASUREMENT
/begin MEASUREMENT md_kupp_max "Maximalmoment an der Kupplung" SWORD FORMULA_0018 0 0 -100.0000 1000.0000 ECU_ADDRESS 0x3F9B62 /begin FUNCTION_LIST Global /end FUNCTION_LIST /end MEASUREMENT
/begin MEASUREMENT md_ind_schlepp_ist "Schleppmoment (aktuell)" SWORD FORMULA_0018 0 0 -100.0000 1000.0000 ECU_ADDRESS 0x3F9B64 /begin FUNCTION_LIST Global /end FUNCTION_LIST /end MEASUREMENT
/begin MEASUREMENT md_ind_opt_la_rg_zw_min "Moment mit LA/RG bei min. ZW" SWORD FORMULA_0018 0 0 -100.0000 1000.0000 ECU_ADDRESS 0x3F9B66 /begin FUNCTION_LIST Global /end FUNCTION_LIST /end MEASUREMENT
/begin MEASUREMENT md_rf_max "rf_max mit pt-Korr" SWORD FORMULA_0006 0 0 0.0 2.0000 ECU_ADDRESS 0x3F9B68 /begin FUNCTION_LIST Global /end FUNCTION_LIST /end MEASUREMENT
/begin MEASUREMENT nachl_st_ign "Nachlaufstatus fuer den IGN Proz" UBYTE FORMULA_0047 0 0 0.0 255.0000 ECU_ADDRESS 0x600DD6 /begin FUNCTION_LIST Global /end FUNCTION_LIST /end MEASUREMENT
/begin MEASUREMENT nachl_ign "" UBYTE FORMULA_0065 0 0 0.0 255.0 ECU_ADDRESS 0x600DD6 /begin FUNCTION_LIST Global /end FUNCTION_LIST BIT_MASK 0x1 /end MEASUREMENT
/begin MEASUREMENT nachl_ign_KL15 "" UBYTE FORMULA_0066 0 0 0.0 255.0 ECU_ADDRESS 0x600DD6 /begin FUNCTION_LIST Global /end FUNCTION_LIST BIT_MASK 0x2 /end MEASUREMENT
/begin MEASUREMENT ccp_fp_st_inj "Status CCP-FP" UBYTE FORMULA_0067 0 0 0.0 255.0 ECU_ADDRESS 0x600DD7 /begin FUNCTION_LIST Global /end FUNCTION_LIST /end MEASUREMENT
/begin MEASUREMENT ccp_fp_vers_inj "neue Version bei CCP-FP" UWORD FORMULA_0000 0 0 0.0 65535.0000 ECU_ADDRESS 0x600DD8 /begin FUNCTION_LIST Global /end FUNCTION_LIST /end MEASUREMENT
/begin MEASUREMENT ccp_fp_st_ign "Status CCP-FP" UBYTE FORMULA_0067 0 0 0.0 255.0 ECU_ADDRESS 0x600DDA /begin FUNCTION_LIST Global /end FUNCTION_LIST /end MEASUREMENT
/begin MEASUREMENT ccp_fp_vers_ign "neue Version bei CCP-FP" UWORD FORMULA_0000 0 0 0.0 65535.0000 ECU_ADDRESS 0x600DDC /begin FUNCTION_LIST Global /end FUNCTION_LIST /end MEASUREMENT
/* ------------------ Abschnitt erzeugt aus ipk_dpr.dat ------------------ */
/begin MEASUREMENT ipk_error "Fehlerzaehler der IPK" UBYTE FORMULA_0008 0 0 0.0 255.0000 ECU_ADDRESS 0x3FBB00 /begin FUNCTION_LIST Inter_Prozessor_Kommunikation /end FUNCTION_LIST /end MEASUREMENT
/* ------------------ Abschnitt erzeugt aus egas.dat ------------------ */
/begin CHARACTERISTIC K_EGAS_CFG "Testmodus" VALUE 0x602BC TKW_VV_VV_UB 100.0 FORMULA_0127 0.0 255.0 /begin FUNCTION_LIST Egas /end FUNCTION_LIST /end CHARACTERISTIC
/begin CHARACTERISTIC K_EGAS_WDK_MIN "min. WDK" VALUE 0x602BE TKW_VV_VV_SW 100.0 FORMULA_0088 0.0 5.0000 /begin FUNCTION_LIST Egas /end FUNCTION_LIST FORMAT "%6.3" /end CHARACTERISTIC
/begin CHARACTERISTIC K_EGAS_WDK_MAX "max. WDK" VALUE 0x602C0 TKW_VV_VV_SW 100.0 FORMULA_0088 0.0 5.0000 /begin FUNCTION_LIST Egas /end FUNCTION_LIST FORMAT "%6.3" /end CHARACTERISTIC
/begin CHARACTERISTIC K_EGAS_WDK_A0_OFF_1 "min. A0-Wert" VALUE 0x602C2 TKW_VV_VV_SW 100.0 FORMULA_0088 -2.0000 2.0000 /begin FUNCTION_LIST Egas /end FUNCTION_LIST FORMAT "%6.3" /end CHARACTERISTIC
/begin CHARACTERISTIC K_EGAS_WDK_A0_OFF_2 "min. A0-Wert" VALUE 0x602C4 TKW_VV_VV_SW 100.0 FORMULA_0088 -2.0000 2.0000 /begin FUNCTION_LIST Egas /end FUNCTION_LIST FORMAT "%6.3" /end CHARACTERISTIC
/begin CHARACTERISTIC K_EGAS_WDK_A0_MIN "min. A0-Wert" VALUE 0x602C6 TKW_VV_VV_SW 100.0 FORMULA_0088 0.0 5.0000 /begin FUNCTION_LIST Egas /end FUNCTION_LIST FORMAT "%6.3" /end CHARACTERISTIC
/begin CHARACTERISTIC K_EGAS_WDK_A0_MAX "max. A0-Wert" VALUE 0x602C8 TKW_VV_VV_SW 100.0 FORMULA_0088 0.0 5.0000 /begin FUNCTION_LIST Egas /end FUNCTION_LIST FORMAT "%6.3" /end CHARACTERISTIC
/begin CHARACTERISTIC K_EGAS_WDK_A0_DELTA_MAX "max. A0-Delta" VALUE 0x602CA TKW_VV_VV_SW 100.0 FORMULA_0088 0.0 5.0000 /begin FUNCTION_LIST Egas /end FUNCTION_LIST FORMAT "%6.3" /end CHARACTERISTIC
/begin CHARACTERISTIC K_EGAS_WDK_A0_ANZAHL "Anzahl der Durchlaeufe" VALUE 0x602CC TKW_VV_VV_SW 100.0 FORMULA_0128 0.0 1000.0000 /begin FUNCTION_LIST Egas /end FUNCTION_LIST /end CHARACTERISTIC
/begin CHARACTERISTIC K_EGAS_WDK_NORM "Umrechnung V in %" VALUE 0x602CE TKW_VV_VV_SW 100.0 FORMULA_0106 0.0 100.0000 /begin FUNCTION_LIST Egas /end FUNCTION_LIST FORMAT "%6.3" /end CHARACTERISTIC
/begin CHARACTERISTIC K_EGAS_SK_CONTROL "SK-Schalter" VALUE 0x602D0 TKW_VV_VV_UB 100.0 FORMULA_0129 0.0 255.0 /begin FUNCTION_LIST Egas /end FUNCTION_LIST /end CHARACTERISTIC
/begin CHARACTERISTIC K_EGAS_SK_SOLL_DIFF "max. Differenz Sollwertabweichung" VALUE 0x602D2 TKW_VV_VV_SW 100.0 FORMULA_0022 -10.0000 120.0000 /begin FUNCTION_LIST Egas /end FUNCTION_LIST FORMAT "%4.1" /end CHARACTERISTIC
/begin CHARACTERISTIC K_EGAS_SK_WDK_DIFF "max. Differenz Analog-/CAN-Abweichung" VALUE 0x602D4 TKW_VV_VV_SW 100.0 FORMULA_0022 -10.0000 120.0000 /begin FUNCTION_LIST Egas /end FUNCTION_LIST FORMAT "%4.1" /end CHARACTERISTIC
/begin CHARACTERISTIC K_EGAS_SK_T_SOLL "max. Zeit Sollwertabweichung" VALUE 0x602D6 TKW_VV_VV_UW 100.0 FORMULA_0126 0.0 10.0000 /begin FUNCTION_LIST Egas /end FUNCTION_LIST FORMAT "%5.2" /end CHARACTERISTIC
/begin CHARACTERISTIC K_EGAS_SK_T_WDK "max. Zeit Analog-/CAN-Abweichung" VALUE 0x602D8 TKW_VV_VV_UW 100.0 FORMULA_0126 0.0 10.0000 /begin FUNCTION_LIST Egas /end FUNCTION_LIST FORMAT "%5.2" /end CHARACTERISTIC
/begin CHARACTERISTIC K_EGAS_SK_T_WDK_MS "max. Zeit Analog-/CAN-Abweichung bei MS" VALUE 0x602DA TKW_VV_VV_UW 100.0 FORMULA_0126 0.0 10.0000 /begin FUNCTION_LIST Egas /end FUNCTION_LIST FORMAT "%5.2" /end CHARACTERISTIC
/begin CHARACTERISTIC K_EGAS_SK_T_IST "max. Zeit Soll-/Istabweichung" VALUE 0x602DC TKW_VV_VV_UW 100.0 FORMULA_0126 0.0 10.0000 /begin FUNCTION_LIST Egas /end FUNCTION_LIST FORMAT "%5.2" /end CHARACTERISTIC
/begin CHARACTERISTIC K_EGAS_SK_ALIVE_ERR_MAX "max. Zeit für CAN-Alive" VALUE 0x602DE TKW_VV_VV_UB 100.0 FORMULA_0008 0.0 255.0000 /begin FUNCTION_LIST Egas /end FUNCTION_LIST /end CHARACTERISTIC
/begin CHARACTERISTIC K_EGAS_SK_T_WAIT_CAN "Wartezeit fuer CAN-Diagnose" VALUE 0x602DF TKW_VV_VV_UB 100.0 FORMULA_0130 0.0 1.2750 /begin FUNCTION_LIST Egas /end FUNCTION_LIST /end CHARACTERISTIC
/begin CHARACTERISTIC K_EGAS_SK_T_NP_MAX "max. Dauer fuer NP-Adaption" VALUE 0x602E0 TKW_VV_VV_UW 100.0 FORMULA_0117 0.0 327.6750 /begin FUNCTION_LIST Egas /end FUNCTION_LIST FORMAT "%5.2" /end CHARACTERISTIC
/begin CHARACTERISTIC K_EGAS_SK_NEUINIT_MAX "max. Anzahl fuer Neuinits" VALUE 0x602E2 TKW_VV_VV_UB 100.0 FORMULA_0008 0.0 255.0000 /begin FUNCTION_LIST Egas /end FUNCTION_LIST /end CHARACTERISTIC
/begin CHARACTERISTIC K_VAN_PSOLL_CFG "Sollwertvorgabe" VALUE 0x602E3 TKW_VV_VV_UB 100.0 FORMULA_0131 0.0 255.0 /begin FUNCTION_LIST Egas /end FUNCTION_LIST /end CHARACTERISTIC
/begin CHARACTERISTIC K_VAN_PSOLL_MIN "min. Solldruck fuer Vanospumpe" VALUE 0x602E4 TKW_VV_VV_UB 100.0 FORMULA_0132 30.0000 110.0000 /begin FUNCTION_LIST Egas /end FUNCTION_LIST /end CHARACTERISTIC
/begin CHARACTERISTIC K_VAN_PSOLL_MAX "max. Solldruck fuer Vanospumpe" VALUE 0x602E5 TKW_VV_VV_UB 100.0 FORMULA_0132 30.0000 110.0000 /begin FUNCTION_LIST Egas /end FUNCTION_LIST /end CHARACTERISTIC
/begin CHARACTERISTIC KL_EGAS_SK_DK_DIFF_MAX "max. Differenz Soll/Ist" CURVE 0x602E6 TKL_SW_VV_SW 100.0 FORMULA_0022 -10.0000 120.0000 /begin FUNCTION_LIST Egas /end FUNCTION_LIST
 /begin AXIS_DESCR STD_AXIS dk_soll FORMULA_0022 4 -10.0000 120.0000 FORMAT "%4.1" /end AXIS_DESCR
 FORMAT "%4.1" /end CHARACTERISTIC
/begin CHARACTERISTIC KF_EGAS_SOLL_DK "Umsetzungskennfeld rf_soll auf wdk" MAP 0x602F8 TKF_SW_SW_SW 100.0 FORMULA_0022 -10.0000 120.0000 /begin FUNCTION_LIST Egas /end FUNCTION_LIST /begin AXIS_DESCR STD_AXIS n FORMULA_0011 14 0.0 10000.0000 /end AXIS_DESCR /begin AXIS_DESCR STD_AXIS rf FORMULA_0006 20 0.0 2.0000 FORMAT "%6.3" /end AXIS_DESCR FORMAT "%4.1" /end CHARACTERISTIC
/begin CHARACTERISTIC KF_EGAS_SOLL_LLS "Kennfeld" MAP 0x6056E TKF_SW_SW_SW 100.0 FORMULA_0022 -10.0000 120.0000 /begin FUNCTION_LIST Egas /end FUNCTION_LIST /begin AXIS_DESCR STD_AXIS n FORMULA_0011 10 0.0 10000.0000 /end AXIS_DESCR /begin AXIS_DESCR STD_AXIS rf_lls FORMULA_0006 12 0.0 2.0000 FORMAT "%6.3" /end AXIS_DESCR FORMAT "%4.1" /end CHARACTERISTIC
/begin MEASUREMENT egas_wdk_b1.abs "korr. U_WDK1" SWORD FORMULA_0088 0 0 0.0 5.0000 ECU_ADDRESS 0x3FB8E0 /begin FUNCTION_LIST Egas /end FUNCTION_LIST /end MEASUREMENT
/begin MEASUREMENT egas_wdk_b2.abs "korr. U_WDK1" SWORD FORMULA_0088 0 0 0.0 5.0000 ECU_ADDRESS 0x3FB8F4 /begin FUNCTION_LIST Egas /end FUNCTION_LIST /end MEASUREMENT
/begin MEASUREMENT egas_wdk_b1.norm "Normwert WDK1" SWORD FORMULA_0106 0 0 0.0 100.0000 ECU_ADDRESS 0x3FB8E2 /begin FUNCTION_LIST Egas /end FUNCTION_LIST /end MEASUREMENT
/begin MEASUREMENT egas_wdk_b2.norm "Normwert WDK1" SWORD FORMULA_0106 0 0 0.0 100.0000 ECU_ADDRESS 0x3FB8F6 /begin FUNCTION_LIST Egas /end FUNCTION_LIST /end MEASUREMENT
/begin MEASUREMENT egas_wdk_b1.a0_min "min. Wert der Adaption" SWORD FORMULA_0088 0 0 0.0 5.0000 ECU_ADDRESS 0x3FB8E6 /begin FUNCTION_LIST Egas /end FUNCTION_LIST /end MEASUREMENT
/begin MEASUREMENT egas_wdk_b2.a0_min "min. Wert der Adaption" SWORD FORMULA_0088 0 0 0.0 5.0000 ECU_ADDRESS 0x3FB8FA /begin FUNCTION_LIST Egas /end FUNCTION_LIST /end MEASUREMENT
/begin MEASUREMENT egas_wdk_b1.a0_max "max. Wert der Adaption" SWORD FORMULA_0088 0 0 0.0 5.0000 ECU_ADDRESS 0x3FB8E8 /begin FUNCTION_LIST Egas /end FUNCTION_LIST /end MEASUREMENT
/begin MEASUREMENT egas_wdk_b2.a0_max "max. Wert der Adaption" SWORD FORMULA_0088 0 0 0.0 5.0000 ECU_ADDRESS 0x3FB8FC /begin FUNCTION_LIST Egas /end FUNCTION_LIST /end MEASUREMENT
/begin MEASUREMENT egas_wdk_b1.a0_sum "Adaptionssumme" SLONG FORMULA_0107 0 0 0.0 5.0000 ECU_ADDRESS 0x3FB8EC /begin FUNCTION_LIST Egas /end FUNCTION_LIST /end MEASUREMENT
/begin MEASUREMENT egas_wdk_b2.a0_sum "Adaptionssumme" SLONG FORMULA_0107 0 0 0.0 5.0000 ECU_ADDRESS 0x3FB900 /begin FUNCTION_LIST Egas /end FUNCTION_LIST /end MEASUREMENT
/begin MEASUREMENT egas_wdk_b1.a0_cnt "Adaptionszaehler" UBYTE FORMULA_0008 0 0 0.0 255.0000 ECU_ADDRESS 0x3FB8F0 /begin FUNCTION_LIST Egas /end FUNCTION_LIST /end MEASUREMENT
/begin MEASUREMENT egas_wdk_b2.a0_cnt "Adaptionszaehler" UBYTE FORMULA_0008 0 0 0.0 255.0000 ECU_ADDRESS 0x3FB904 /begin FUNCTION_LIST Egas /end FUNCTION_LIST /end MEASUREMENT
/begin MEASUREMENT egas_wdk_b1.adapt "Adaptionsstatus" UBYTE FORMULA_0108 0 0 0.0 255.0 ECU_ADDRESS 0x3FB8F1 /begin FUNCTION_LIST Egas /end FUNCTION_LIST /end MEASUREMENT
/begin MEASUREMENT egas_wdk_b2.adapt "Adaptionsstatus" UBYTE FORMULA_0108 0 0 0.0 255.0 ECU_ADDRESS 0x3FB905 /begin FUNCTION_LIST Egas /end FUNCTION_LIST /end MEASUREMENT
/begin MEASUREMENT egas_dk_b1.r_sollw "R-Sollwert" SWORD FORMULA_0022 0 0 -10.0000 120.0000 ECU_ADDRESS 0x3FB90C /begin FUNCTION_LIST Egas /end FUNCTION_LIST /end MEASUREMENT
/begin MEASUREMENT egas_dk_b2.r_sollw "R-Sollwert" SWORD FORMULA_0022 0 0 -10.0000 120.0000 ECU_ADDRESS 0x3FB924 /begin FUNCTION_LIST Egas /end FUNCTION_LIST /end MEASUREMENT
/begin MEASUREMENT egas_dk_b1.r_diag_st "Diagnosestatus" UWORD FORMULA_0109 0 0 0.0 65535.0 ECU_ADDRESS 0x3FB90A /begin FUNCTION_LIST Egas /end FUNCTION_LIST /end MEASUREMENT
/begin MEASUREMENT egas_dk_b2.r_diag_st "Diagnosestatus" UWORD FORMULA_0109 0 0 0.0 65535.0 ECU_ADDRESS 0x3FB922 /begin FUNCTION_LIST Egas /end FUNCTION_LIST /end MEASUREMENT
/begin MEASUREMENT egas_dk_b1.r_gpos "Istwert (roh)" SWORD FORMULA_0022 0 0 -10.0000 120.0000 ECU_ADDRESS 0x3FB90E /begin FUNCTION_LIST Egas /end FUNCTION_LIST /end MEASUREMENT
/begin MEASUREMENT egas_dk_b2.r_gpos "Istwert (roh)" SWORD FORMULA_0022 0 0 -10.0000 120.0000 ECU_ADDRESS 0x3FB926 /begin FUNCTION_LIST Egas /end FUNCTION_LIST /end MEASUREMENT
/begin MEASUREMENT egas_dk_b1.r_tv "Tastverhaeltnis" UBYTE FORMULA_0110 0 0 -100.0000 99.2187 ECU_ADDRESS 0x3FB912 /begin FUNCTION_LIST Egas /end FUNCTION_LIST /end MEASUREMENT
/begin MEASUREMENT egas_dk_b2.r_tv "Tastverhaeltnis" UBYTE FORMULA_0110 0 0 -100.0000 99.2187 ECU_ADDRESS 0x3FB92A /begin FUNCTION_LIST Egas /end FUNCTION_LIST /end MEASUREMENT
/begin MEASUREMENT egas_dk_b1.r_alive "R-Alive" UBYTE FORMULA_0008 0 0 0.0 255.0000 ECU_ADDRESS 0x3FB911 /begin FUNCTION_LIST Egas /end FUNCTION_LIST /end MEASUREMENT
/begin MEASUREMENT egas_dk_b2.r_alive "R-Alive" UBYTE FORMULA_0008 0 0 0.0 255.0000 ECU_ADDRESS 0x3FB929 /begin FUNCTION_LIST Egas /end FUNCTION_LIST /end MEASUREMENT
/begin MEASUREMENT egas_dk_b1.r_enable "R-Enable" UBYTE FORMULA_0111 0 0 0.0 255.0 ECU_ADDRESS 0x3FB910 /begin FUNCTION_LIST Egas /end FUNCTION_LIST /end MEASUREMENT
/begin MEASUREMENT egas_dk_b2.r_enable "R-Enable" UBYTE FORMULA_0111 0 0 0.0 255.0 ECU_ADDRESS 0x3FB928 /begin FUNCTION_LIST Egas /end FUNCTION_LIST /end MEASUREMENT
/begin MEASUREMENT egas_dk_b1.r_mode "R-Mode" UBYTE FORMULA_0112 0 0 0.0 255.0 ECU_ADDRESS 0x3FB908 /begin FUNCTION_LIST Egas /end FUNCTION_LIST /end MEASUREMENT
/begin MEASUREMENT egas_dk_b2.r_mode "R-Mode" UBYTE FORMULA_0112 0 0 0.0 255.0 ECU_ADDRESS 0x3FB920 /begin FUNCTION_LIST Egas /end FUNCTION_LIST /end MEASUREMENT
/begin MEASUREMENT egas_dk_b1.r_adapt_st "R-Adaption" UBYTE FORMULA_0113 0 0 0.0 255.0 ECU_ADDRESS 0x3FB909 /begin FUNCTION_LIST Egas /end FUNCTION_LIST /end MEASUREMENT
/begin MEASUREMENT egas_dk_b2.r_adapt_st "R-Adaption" UBYTE FORMULA_0113 0 0 0.0 255.0 ECU_ADDRESS 0x3FB921 /begin FUNCTION_LIST Egas /end FUNCTION_LIST /end MEASUREMENT
/begin MEASUREMENT egas_dk_b1.can_st "CAN-Status" UBYTE FORMULA_0114 0 0 0.0 255.0 ECU_ADDRESS 0x3FB913 /begin FUNCTION_LIST Egas /end FUNCTION_LIST BIT_MASK 0xF /end MEASUREMENT
/begin MEASUREMENT egas_dk_b2.can_st "CAN-Status" UBYTE FORMULA_0114 0 0 0.0 255.0 ECU_ADDRESS 0x3FB92B /begin FUNCTION_LIST Egas /end FUNCTION_LIST BIT_MASK 0xF /end MEASUREMENT
/begin MEASUREMENT egas_dk_b1.mode "Mode" UBYTE FORMULA_0115 0 0 0.0 255.0 ECU_ADDRESS 0x3FB914 /begin FUNCTION_LIST Egas /end FUNCTION_LIST /end MEASUREMENT
/begin MEASUREMENT egas_dk_b2.mode "Mode" UBYTE FORMULA_0115 0 0 0.0 255.0 ECU_ADDRESS 0x3FB92C /begin FUNCTION_LIST Egas /end FUNCTION_LIST /end MEASUREMENT
/begin MEASUREMENT egas_dk_b1.state "State" UBYTE FORMULA_0116 0 0 0.0 255.0 ECU_ADDRESS 0x3FB916 /begin FUNCTION_LIST Egas /end FUNCTION_LIST /end MEASUREMENT
/begin MEASUREMENT egas_dk_b2.state "State" UBYTE FORMULA_0116 0 0 0.0 255.0 ECU_ADDRESS 0x3FB92E /begin FUNCTION_LIST Egas /end FUNCTION_LIST /end MEASUREMENT
/begin MEASUREMENT egas_dk_b1.state_time "Zeit im akt. State" UWORD FORMULA_0117 0 0 0.0 327.6750 ECU_ADDRESS 0x3FB918 /begin FUNCTION_LIST Egas /end FUNCTION_LIST /end MEASUREMENT
/begin MEASUREMENT egas_dk_b2.state_time "Zeit im akt. State" UWORD FORMULA_0117 0 0 0.0 327.6750 ECU_ADDRESS 0x3FB930 /begin FUNCTION_LIST Egas /end FUNCTION_LIST /end MEASUREMENT
/begin MEASUREMENT egas_dk_b1.flags "Flags" UBYTE FORMULA_0047 0 0 0.0 255.0000 ECU_ADDRESS 0x3FB91A /begin FUNCTION_LIST Egas /end FUNCTION_LIST /end MEASUREMENT
/begin MEASUREMENT egas_dk_b2.flags "Flags" UBYTE FORMULA_0047 0 0 0.0 255.0000 ECU_ADDRESS 0x3FB932 /begin FUNCTION_LIST Egas /end FUNCTION_LIST /end MEASUREMENT
/begin MEASUREMENT egas_dk_b1.fail_st "Failsafe-Status" UBYTE FORMULA_0118 0 0 0.0 255.0 ECU_ADDRESS 0x3FB91B /begin FUNCTION_LIST Egas /end FUNCTION_LIST /end MEASUREMENT
/begin MEASUREMENT egas_dk_b2.fail_st "Failsafe-Status" UBYTE FORMULA_0118 0 0 0.0 255.0 ECU_ADDRESS 0x3FB933 /begin FUNCTION_LIST Egas /end FUNCTION_LIST /end MEASUREMENT
/begin MEASUREMENT egas_dk_b1.alive_err "Zähler Aliveerror" UBYTE FORMULA_0008 0 0 0.0 255.0000 ECU_ADDRESS 0x3FB91C /begin FUNCTION_LIST Egas /end FUNCTION_LIST /end MEASUREMENT
/begin MEASUREMENT egas_dk_b2.alive_err "Zähler Aliveerror" UBYTE FORMULA_0008 0 0 0.0 255.0000 ECU_ADDRESS 0x3FB934 /begin FUNCTION_LIST Egas /end FUNCTION_LIST /end MEASUREMENT
/begin MEASUREMENT egas_lls_b1.r_sollw "R-Sollwert" SWORD FORMULA_0022 0 0 -10.0000 120.0000 ECU_ADDRESS 0x3FB93C /begin FUNCTION_LIST Egas /end FUNCTION_LIST /end MEASUREMENT
/begin MEASUREMENT egas_lls_b2.r_sollw "R-Sollwert" SWORD FORMULA_0022 0 0 -10.0000 120.0000 ECU_ADDRESS 0x3FB954 /begin FUNCTION_LIST Egas /end FUNCTION_LIST /end MEASUREMENT
/begin MEASUREMENT egas_lls_b1.r_diag_st "Diagnosestatus" UWORD FORMULA_0109 0 0 0.0 65535.0 ECU_ADDRESS 0x3FB93A /begin FUNCTION_LIST Egas /end FUNCTION_LIST /end MEASUREMENT
/begin MEASUREMENT egas_lls_b2.r_diag_st "Diagnosestatus" UWORD FORMULA_0109 0 0 0.0 65535.0 ECU_ADDRESS 0x3FB952 /begin FUNCTION_LIST Egas /end FUNCTION_LIST /end MEASUREMENT
/begin MEASUREMENT egas_lls_b1.r_gpos "Istwert (roh)" SWORD FORMULA_0022 0 0 -10.0000 120.0000 ECU_ADDRESS 0x3FB93E /begin FUNCTION_LIST Egas /end FUNCTION_LIST /end MEASUREMENT
/begin MEASUREMENT egas_lls_b2.r_gpos "Istwert (roh)" SWORD FORMULA_0022 0 0 -10.0000 120.0000 ECU_ADDRESS 0x3FB956 /begin FUNCTION_LIST Egas /end FUNCTION_LIST /end MEASUREMENT
/begin MEASUREMENT egas_lls_b1.r_tv "Tastverhaeltnis" UBYTE FORMULA_0110 0 0 -100.0000 99.2187 ECU_ADDRESS 0x3FB942 /begin FUNCTION_LIST Egas /end FUNCTION_LIST /end MEASUREMENT
/begin MEASUREMENT egas_lls_b2.r_tv "Tastverhaeltnis" UBYTE FORMULA_0110 0 0 -100.0000 99.2187 ECU_ADDRESS 0x3FB95A /begin FUNCTION_LIST Egas /end FUNCTION_LIST /end MEASUREMENT
/begin MEASUREMENT egas_lls_b1.r_alive "R-Alive" UBYTE FORMULA_0008 0 0 0.0 255.0000 ECU_ADDRESS 0x3FB941 /begin FUNCTION_LIST Egas /end FUNCTION_LIST /end MEASUREMENT
/begin MEASUREMENT egas_lls_b2.r_alive "R-Alive" UBYTE FORMULA_0008 0 0 0.0 255.0000 ECU_ADDRESS 0x3FB959 /begin FUNCTION_LIST Egas /end FUNCTION_LIST /end MEASUREMENT
/begin MEASUREMENT egas_lls_b1.r_mode "R-Mode" UBYTE FORMULA_0119 0 0 0.0 255.0 ECU_ADDRESS 0x3FB938 /begin FUNCTION_LIST Egas /end FUNCTION_LIST /end MEASUREMENT
/begin MEASUREMENT egas_lls_b2.r_mode "R-Mode" UBYTE FORMULA_0119 0 0 0.0 255.0 ECU_ADDRESS 0x3FB950 /begin FUNCTION_LIST Egas /end FUNCTION_LIST /end MEASUREMENT
/begin MEASUREMENT egas_lls_b1.r_adapt_st "Adaptionsstatus" UBYTE FORMULA_0120 0 0 0.0 255.0 ECU_ADDRESS 0x3FB939 /begin FUNCTION_LIST Egas /end FUNCTION_LIST /end MEASUREMENT
/begin MEASUREMENT egas_lls_b2.r_adapt_st "Adaptionsstatus" UBYTE FORMULA_0120 0 0 0.0 255.0 ECU_ADDRESS 0x3FB951 /begin FUNCTION_LIST Egas /end FUNCTION_LIST /end MEASUREMENT
/begin MEASUREMENT egas_lls_b1.state "State" UBYTE FORMULA_0121 0 0 0.0 255.0 ECU_ADDRESS 0x3FB946 /begin FUNCTION_LIST Egas /end FUNCTION_LIST /end MEASUREMENT
/begin MEASUREMENT egas_lls_b2.state "State" UBYTE FORMULA_0121 0 0 0.0 255.0 ECU_ADDRESS 0x3FB95E /begin FUNCTION_LIST Egas /end FUNCTION_LIST /end MEASUREMENT
/begin MEASUREMENT egas_lls_b1.state_time "Zeit im akt. State" UWORD FORMULA_0117 0 0 0.0 327.6750 ECU_ADDRESS 0x3FB948 /begin FUNCTION_LIST Egas /end FUNCTION_LIST /end MEASUREMENT
/begin MEASUREMENT egas_lls_b2.state_time "Zeit im akt. State" UWORD FORMULA_0117 0 0 0.0 327.6750 ECU_ADDRESS 0x3FB960 /begin FUNCTION_LIST Egas /end FUNCTION_LIST /end MEASUREMENT
/begin MEASUREMENT egas_lls_b1.mode "Mode" UBYTE FORMULA_0119 0 0 0.0 255.0 ECU_ADDRESS 0x3FB944 /begin FUNCTION_LIST Egas /end FUNCTION_LIST /end MEASUREMENT
/begin MEASUREMENT egas_lls_b2.mode "Mode" UBYTE FORMULA_0119 0 0 0.0 255.0 ECU_ADDRESS 0x3FB95C /begin FUNCTION_LIST Egas /end FUNCTION_LIST /end MEASUREMENT
/begin MEASUREMENT egas_lls_b1.can_st "CAN-Status" UBYTE FORMULA_0122 0 0 0.0 255.0 ECU_ADDRESS 0x3FB943 /begin FUNCTION_LIST Egas /end FUNCTION_LIST BIT_MASK 0xF /end MEASUREMENT
/begin MEASUREMENT egas_lls_b2.can_st "CAN-Status" UBYTE FORMULA_0122 0 0 0.0 255.0 ECU_ADDRESS 0x3FB95B /begin FUNCTION_LIST Egas /end FUNCTION_LIST BIT_MASK 0xF /end MEASUREMENT
/begin MEASUREMENT egas_lls_b1.flags "Flags" UBYTE FORMULA_0123 0 0 0.0 255.0 ECU_ADDRESS 0x3FB94A /begin FUNCTION_LIST Egas /end FUNCTION_LIST /end MEASUREMENT
/begin MEASUREMENT egas_lls_b2.flags "Flags" UBYTE FORMULA_0123 0 0 0.0 255.0 ECU_ADDRESS 0x3FB962 /begin FUNCTION_LIST Egas /end FUNCTION_LIST /end MEASUREMENT
/begin MEASUREMENT egas_lls_b1.alive_err "Zähler Aliveerror" UBYTE FORMULA_0008 0 0 0.0 255.0000 ECU_ADDRESS 0x3FB94C /begin FUNCTION_LIST Egas /end FUNCTION_LIST /end MEASUREMENT
/begin MEASUREMENT egas_lls_b2.alive_err "Zähler Aliveerror" UBYTE FORMULA_0008 0 0 0.0 255.0000 ECU_ADDRESS 0x3FB964 /begin FUNCTION_LIST Egas /end FUNCTION_LIST /end MEASUREMENT
/begin MEASUREMENT egas_lls_b1.fail_st "Failsafe-Status" UBYTE FORMULA_0124 0 0 0.0 255.0 ECU_ADDRESS 0x3FB94B /begin FUNCTION_LIST Egas /end FUNCTION_LIST /end MEASUREMENT
/begin MEASUREMENT egas_lls_b2.fail_st "Failsafe-Status" UBYTE FORMULA_0124 0 0 0.0 255.0 ECU_ADDRESS 0x3FB963 /begin FUNCTION_LIST Egas /end FUNCTION_LIST /end MEASUREMENT
/begin MEASUREMENT egas_sk_b1.zustand "SK-Zustand" UWORD FORMULA_0125 0 0 0.0 65535.0 ECU_ADDRESS 0x3FB968 /begin FUNCTION_LIST Egas /end FUNCTION_LIST /end MEASUREMENT
/begin MEASUREMENT egas_sk_b2.zustand "SK-Zustand" UWORD FORMULA_0125 0 0 0.0 65535.0 ECU_ADDRESS 0x3FB972 /begin FUNCTION_LIST Egas /end FUNCTION_LIST /end MEASUREMENT
/begin MEASUREMENT egas_sk_b1.dk_diff_max "max. Differenz Soll/Ist" SWORD FORMULA_0022 0 0 -10.0000 120.0000 ECU_ADDRESS 0x3FB96A /begin FUNCTION_LIST Egas /end FUNCTION_LIST /end MEASUREMENT
/begin MEASUREMENT egas_sk_b2.dk_diff_max "max. Differenz Soll/Ist" SWORD FORMULA_0022 0 0 -10.0000 120.0000 ECU_ADDRESS 0x3FB974 /begin FUNCTION_LIST Egas /end FUNCTION_LIST /end MEASUREMENT
/begin MEASUREMENT egas_sk_b1.t_soll "Zeit Sollwertabweichung" UWORD FORMULA_0126 0 0 0.0 10.0000 ECU_ADDRESS 0x3FB96C /begin FUNCTION_LIST Egas /end FUNCTION_LIST /end MEASUREMENT
/begin MEASUREMENT egas_sk_b2.t_soll "Zeit Sollwertabweichung" UWORD FORMULA_0126 0 0 0.0 10.0000 ECU_ADDRESS 0x3FB976 /begin FUNCTION_LIST Egas /end FUNCTION_LIST /end MEASUREMENT
/begin MEASUREMENT egas_sk_b1.t_wdk "Zeit Analog-/CAN-Abweichung" UWORD FORMULA_0126 0 0 0.0 10.0000 ECU_ADDRESS 0x3FB96E /begin FUNCTION_LIST Egas /end FUNCTION_LIST /end MEASUREMENT
/begin MEASUREMENT egas_sk_b2.t_wdk "Zeit Analog-/CAN-Abweichung" UWORD FORMULA_0126 0 0 0.0 10.0000 ECU_ADDRESS 0x3FB978 /begin FUNCTION_LIST Egas /end FUNCTION_LIST /end MEASUREMENT
/begin MEASUREMENT egas_sk_b1.t_ist "Zeit Soll-/Istabweichung" UWORD FORMULA_0126 0 0 0.0 10.0000 ECU_ADDRESS 0x3FB970 /begin FUNCTION_LIST Egas /end FUNCTION_LIST /end MEASUREMENT
/begin MEASUREMENT egas_sk_b2.t_ist "Zeit Soll-/Istabweichung" UWORD FORMULA_0126 0 0 0.0 10.0000 ECU_ADDRESS 0x3FB97A /begin FUNCTION_LIST Egas /end FUNCTION_LIST /end MEASUREMENT
/* ------------------ Abschnitt erzeugt aus egas_cmd.dat ------------------ */
/begin MEASUREMENT egas_snd_lls.cmd_b1 "CMD-B1" UBYTE FORMULA_0133 0 0 0.0 255.0 ECU_ADDRESS 0x3FB97C /begin FUNCTION_LIST Egas /end FUNCTION_LIST /end MEASUREMENT
/begin MEASUREMENT egas_snd_lls.cmd_b2 "CMD-B2" UBYTE FORMULA_0134 0 0 0.0 255.0 ECU_ADDRESS 0x3FB97D /begin FUNCTION_LIST Egas /end FUNCTION_LIST /end MEASUREMENT
/begin MEASUREMENT egas_snd_lls.cmd_b1_fifo_1of5_ "CMD-B2" UBYTE FORMULA_0134 0 0 0.0 255.0 ECU_ADDRESS 0x3FB97E /begin FUNCTION_LIST Egas /end FUNCTION_LIST /end MEASUREMENT
/begin MEASUREMENT egas_snd_lls.cmd_b1_fifo_2of5_ "CMD-B2" UBYTE FORMULA_0134 0 0 0.0 255.0 ECU_ADDRESS 0x3FB97F /begin FUNCTION_LIST Egas /end FUNCTION_LIST /end MEASUREMENT
/begin MEASUREMENT egas_snd_lls.cmd_b1_fifo_3of5_ "CMD-B2" UBYTE FORMULA_0134 0 0 0.0 255.0 ECU_ADDRESS 0x3FB980 /begin FUNCTION_LIST Egas /end FUNCTION_LIST /end MEASUREMENT
/begin MEASUREMENT egas_snd_lls.cmd_b1_fifo_4of5_ "CMD-B2" UBYTE FORMULA_0134 0 0 0.0 255.0 ECU_ADDRESS 0x3FB981 /begin FUNCTION_LIST Egas /end FUNCTION_LIST /end MEASUREMENT
/begin MEASUREMENT egas_snd_lls.cmd_b1_fifo_5of5_ "CMD-B2" UBYTE FORMULA_0134 0 0 0.0 255.0 ECU_ADDRESS 0x3FB982 /begin FUNCTION_LIST Egas /end FUNCTION_LIST /end MEASUREMENT
/begin MEASUREMENT egas_snd_lls.cmd_b2_fifo_1of5_ "CMD-B2" UBYTE FORMULA_0134 0 0 0.0 255.0 ECU_ADDRESS 0x3FB983 /begin FUNCTION_LIST Egas /end FUNCTION_LIST /end MEASUREMENT
/begin MEASUREMENT egas_snd_lls.cmd_b2_fifo_2of5_ "CMD-B2" UBYTE FORMULA_0134 0 0 0.0 255.0 ECU_ADDRESS 0x3FB984 /begin FUNCTION_LIST Egas /end FUNCTION_LIST /end MEASUREMENT
/begin MEASUREMENT egas_snd_lls.cmd_b2_fifo_3of5_ "CMD-B2" UBYTE FORMULA_0134 0 0 0.0 255.0 ECU_ADDRESS 0x3FB985 /begin FUNCTION_LIST Egas /end FUNCTION_LIST /end MEASUREMENT
/begin MEASUREMENT egas_snd_lls.cmd_b2_fifo_4of5_ "CMD-B2" UBYTE FORMULA_0134 0 0 0.0 255.0 ECU_ADDRESS 0x3FB986 /begin FUNCTION_LIST Egas /end FUNCTION_LIST /end MEASUREMENT
/begin MEASUREMENT egas_snd_lls.cmd_b2_fifo_5of5_ "CMD-B2" UBYTE FORMULA_0134 0 0 0.0 255.0 ECU_ADDRESS 0x3FB987 /begin FUNCTION_LIST Egas /end FUNCTION_LIST /end MEASUREMENT
/begin MEASUREMENT egas_snd_lls.v_ko_vers "Vorgabe KOMM" UBYTE FORMULA_0008 0 0 0.0 255.0000 ECU_ADDRESS 0x3FB98A /begin FUNCTION_LIST Egas /end FUNCTION_LIST /end MEASUREMENT
/begin MEASUREMENT egas_snd_lls.v_bank "Vorgabe BANK" UBYTE FORMULA_0008 0 0 0.0 255.0000 ECU_ADDRESS 0x3FB98B /begin FUNCTION_LIST Egas /end FUNCTION_LIST /end MEASUREMENT
/begin MEASUREMENT egas_snd_lls.v_clr_diag_b1 "Diag Bank1" UWORD FORMULA_0000 0 0 0.0 65535.0000 ECU_ADDRESS 0x3FB98C /begin FUNCTION_LIST Egas /end FUNCTION_LIST /end MEASUREMENT
/begin MEASUREMENT egas_snd_lls.v_clr_diag_b2 "Diag Bank1" UWORD FORMULA_0000 0 0 0.0 65535.0000 ECU_ADDRESS 0x3FB98E /begin FUNCTION_LIST Egas /end FUNCTION_LIST /end MEASUREMENT
/begin MEASUREMENT egas_snd_lls.time "Timeout" UWORD FORMULA_0135 0 0 0.0 6553.5000 ECU_ADDRESS 0x3FB988 /begin FUNCTION_LIST Egas /end FUNCTION_LIST /end MEASUREMENT
/begin MEASUREMENT egas_rec_lls_b1.r_cmd "R-CMD-B1" UBYTE FORMULA_0134 0 0 0.0 255.0 ECU_ADDRESS 0x3FB993 /begin FUNCTION_LIST Egas /end FUNCTION_LIST /end MEASUREMENT
/begin MEASUREMENT egas_rec_lls_b2.r_cmd "R-CMD-B1" UBYTE FORMULA_0134 0 0 0.0 255.0 ECU_ADDRESS 0x3FB9A7 /begin FUNCTION_LIST Egas /end FUNCTION_LIST /end MEASUREMENT
/begin MEASUREMENT egas_rec_lls_bX.r_cmd "R-CMD-B1" UBYTE FORMULA_0134 0 0 0.0 255.0 ECU_ADDRESS 0x3FB9BB /begin FUNCTION_LIST Egas /end FUNCTION_LIST /end MEASUREMENT
/begin MEASUREMENT egas_rec_lls_b1.r_bank "Zylinder" UBYTE FORMULA_0008 0 0 0.0 255.0000 ECU_ADDRESS 0x3FB994 /begin FUNCTION_LIST Egas /end FUNCTION_LIST /end MEASUREMENT
/begin MEASUREMENT egas_rec_lls_b2.r_bank "Zylinder" UBYTE FORMULA_0008 0 0 0.0 255.0000 ECU_ADDRESS 0x3FB9A8 /begin FUNCTION_LIST Egas /end FUNCTION_LIST /end MEASUREMENT
/begin MEASUREMENT egas_rec_lls_bX.r_bank "Zylinder" UBYTE FORMULA_0008 0 0 0.0 255.0000 ECU_ADDRESS 0x3FB9BC /begin FUNCTION_LIST Egas /end FUNCTION_LIST /end MEASUREMENT
/begin MEASUREMENT egas_rec_lls_b1.r_ko_vers "Kommunikationsversion" UBYTE FORMULA_0008 0 0 0.0 255.0000 ECU_ADDRESS 0x3FB995 /begin FUNCTION_LIST Egas /end FUNCTION_LIST /end MEASUREMENT
/begin MEASUREMENT egas_rec_lls_b2.r_ko_vers "Kommunikationsversion" UBYTE FORMULA_0008 0 0 0.0 255.0000 ECU_ADDRESS 0x3FB9A9 /begin FUNCTION_LIST Egas /end FUNCTION_LIST /end MEASUREMENT
/begin MEASUREMENT egas_rec_lls_bX.r_ko_vers "Kommunikationsversion" UBYTE FORMULA_0008 0 0 0.0 255.0000 ECU_ADDRESS 0x3FB9BD /begin FUNCTION_LIST Egas /end FUNCTION_LIST /end MEASUREMENT
/begin MEASUREMENT egas_rec_lls_b1.r_hw_vers "HW-Version" UWORD FORMULA_0000 0 0 0.0 65535.0000 ECU_ADDRESS 0x3FB996 /begin FUNCTION_LIST Egas /end FUNCTION_LIST /end MEASUREMENT
/begin MEASUREMENT egas_rec_lls_b2.r_hw_vers "HW-Version" UWORD FORMULA_0000 0 0 0.0 65535.0000 ECU_ADDRESS 0x3FB9AA /begin FUNCTION_LIST Egas /end FUNCTION_LIST /end MEASUREMENT
/begin MEASUREMENT egas_rec_lls_bX.r_hw_vers "HW-Version" UWORD FORMULA_0000 0 0 0.0 65535.0000 ECU_ADDRESS 0x3FB9BE /begin FUNCTION_LIST Egas /end FUNCTION_LIST /end MEASUREMENT
/begin MEASUREMENT egas_rec_lls_b1.r_sw_vers "SW-Version" UWORD FORMULA_0000 0 0 0.0 65535.0000 ECU_ADDRESS 0x3FB998 /begin FUNCTION_LIST Egas /end FUNCTION_LIST /end MEASUREMENT
/begin MEASUREMENT egas_rec_lls_b2.r_sw_vers "SW-Version" UWORD FORMULA_0000 0 0 0.0 65535.0000 ECU_ADDRESS 0x3FB9AC /begin FUNCTION_LIST Egas /end FUNCTION_LIST /end MEASUREMENT
/begin MEASUREMENT egas_rec_lls_bX.r_sw_vers "SW-Version" UWORD FORMULA_0000 0 0 0.0 65535.0000 ECU_ADDRESS 0x3FB9C0 /begin FUNCTION_LIST Egas /end FUNCTION_LIST /end MEASUREMENT
/begin MEASUREMENT egas_rec_lls_b1.r_diag_st "Diagnosestatus" UWORD FORMULA_0000 0 0 0.0 65535.0000 ECU_ADDRESS 0x3FB99A /begin FUNCTION_LIST Egas /end FUNCTION_LIST /end MEASUREMENT
/begin MEASUREMENT egas_rec_lls_b2.r_diag_st "Diagnosestatus" UWORD FORMULA_0000 0 0 0.0 65535.0000 ECU_ADDRESS 0x3FB9AE /begin FUNCTION_LIST Egas /end FUNCTION_LIST /end MEASUREMENT
/begin MEASUREMENT egas_rec_lls_bX.r_diag_st "Diagnosestatus" UWORD FORMULA_0000 0 0 0.0 65535.0000 ECU_ADDRESS 0x3FB9C2 /begin FUNCTION_LIST Egas /end FUNCTION_LIST /end MEASUREMENT
/begin MEASUREMENT egas_rec_lls_b1.r_set_vers "Kommunikationsversion" UBYTE FORMULA_0008 0 0 0.0 255.0000 ECU_ADDRESS 0x3FB99C /begin FUNCTION_LIST Egas /end FUNCTION_LIST /end MEASUREMENT
/begin MEASUREMENT egas_rec_lls_b2.r_set_vers "Kommunikationsversion" UBYTE FORMULA_0008 0 0 0.0 255.0000 ECU_ADDRESS 0x3FB9B0 /begin FUNCTION_LIST Egas /end FUNCTION_LIST /end MEASUREMENT
/begin MEASUREMENT egas_rec_lls_bX.r_set_vers "Kommunikationsversion" UBYTE FORMULA_0008 0 0 0.0 255.0000 ECU_ADDRESS 0x3FB9C4 /begin FUNCTION_LIST Egas /end FUNCTION_LIST /end MEASUREMENT
/begin MEASUREMENT egas_rec_lls_b1.status "Empfangsstatus" UBYTE FORMULA_0136 0 0 0.0 255.0 ECU_ADDRESS 0x3FB99E /begin FUNCTION_LIST Egas /end FUNCTION_LIST /end MEASUREMENT
/begin MEASUREMENT egas_rec_lls_b2.status "Empfangsstatus" UBYTE FORMULA_0136 0 0 0.0 255.0 ECU_ADDRESS 0x3FB9B2 /begin FUNCTION_LIST Egas /end FUNCTION_LIST /end MEASUREMENT
/begin MEASUREMENT egas_rec_lls_bX.status "Empfangsstatus" UBYTE FORMULA_0136 0 0 0.0 255.0 ECU_ADDRESS 0x3FB9C6 /begin FUNCTION_LIST Egas /end FUNCTION_LIST /end MEASUREMENT
/begin MEASUREMENT egas_rec_lls_b1.cs_err "CS-Error" UBYTE FORMULA_0008 0 0 0.0 255.0000 ECU_ADDRESS 0x3FB99D /begin FUNCTION_LIST Egas /end FUNCTION_LIST /end MEASUREMENT
/begin MEASUREMENT egas_rec_lls_b2.cs_err "CS-Error" UBYTE FORMULA_0008 0 0 0.0 255.0000 ECU_ADDRESS 0x3FB9B1 /begin FUNCTION_LIST Egas /end FUNCTION_LIST /end MEASUREMENT
/begin MEASUREMENT egas_rec_lls_bX.cs_err "CS-Error" UBYTE FORMULA_0008 0 0 0.0 255.0000 ECU_ADDRESS 0x3FB9C5 /begin FUNCTION_LIST Egas /end FUNCTION_LIST /end MEASUREMENT
/begin MEASUREMENT egas_rec_lls_b1.rec_ack "Receive-Ack" UWORD FORMULA_0024 0 0 0.0 65535.0000 ECU_ADDRESS 0x3FB9A0 /begin FUNCTION_LIST Egas /end FUNCTION_LIST /end MEASUREMENT
/begin MEASUREMENT egas_rec_lls_b2.rec_ack "Receive-Ack" UWORD FORMULA_0024 0 0 0.0 65535.0000 ECU_ADDRESS 0x3FB9B4 /begin FUNCTION_LIST Egas /end FUNCTION_LIST /end MEASUREMENT
/begin MEASUREMENT egas_rec_lls_bX.rec_ack "Receive-Ack" UWORD FORMULA_0024 0 0 0.0 65535.0000 ECU_ADDRESS 0x3FB9C8 /begin FUNCTION_LIST Egas /end FUNCTION_LIST /end MEASUREMENT
/begin MEASUREMENT egas_rec_lls_b1.rec_err "Receive-Error" UWORD FORMULA_0024 0 0 0.0 65535.0000 ECU_ADDRESS 0x3FB9A2 /begin FUNCTION_LIST Egas /end FUNCTION_LIST /end MEASUREMENT
/begin MEASUREMENT egas_rec_lls_b2.rec_err "Receive-Error" UWORD FORMULA_0024 0 0 0.0 65535.0000 ECU_ADDRESS 0x3FB9B6 /begin FUNCTION_LIST Egas /end FUNCTION_LIST /end MEASUREMENT
/begin MEASUREMENT egas_rec_lls_bX.rec_err "Receive-Error" UWORD FORMULA_0024 0 0 0.0 65535.0000 ECU_ADDRESS 0x3FB9CA /begin FUNCTION_LIST Egas /end FUNCTION_LIST /end MEASUREMENT
/begin MEASUREMENT egas_rec_lls_b1.ed "ED-Status" UWORD FORMULA_0137 0 0 0.0 65535.0 ECU_ADDRESS 0x3FB9A4 /begin FUNCTION_LIST Egas /end FUNCTION_LIST /end MEASUREMENT
/begin MEASUREMENT egas_rec_lls_b2.ed "ED-Status" UWORD FORMULA_0137 0 0 0.0 65535.0 ECU_ADDRESS 0x3FB9B8 /begin FUNCTION_LIST Egas /end FUNCTION_LIST /end MEASUREMENT
/begin MEASUREMENT egas_rec_lls_bX.ed "ED-Status" UWORD FORMULA_0137 0 0 0.0 65535.0 ECU_ADDRESS 0x3FB9CC /begin FUNCTION_LIST Egas /end FUNCTION_LIST /end MEASUREMENT
/begin MEASUREMENT egas_snd_dk.cmd_b1 "CMD-B1" UBYTE FORMULA_0133 0 0 0.0 255.0 ECU_ADDRESS 0x3FB9CE /begin FUNCTION_LIST Egas /end FUNCTION_LIST /end MEASUREMENT
/begin MEASUREMENT egas_snd_dk.cmd_b2 "CMD-B2" UBYTE FORMULA_0134 0 0 0.0 255.0 ECU_ADDRESS 0x3FB9CF /begin FUNCTION_LIST Egas /end FUNCTION_LIST /end MEASUREMENT
/begin MEASUREMENT egas_snd_dk.cmd_b1_fifo_1of5_ "CMD-B2" UBYTE FORMULA_0134 0 0 0.0 255.0 ECU_ADDRESS 0x3FB9D0 /begin FUNCTION_LIST Egas /end FUNCTION_LIST /end MEASUREMENT
/begin MEASUREMENT egas_snd_dk.cmd_b1_fifo_2of5_ "CMD-B2" UBYTE FORMULA_0134 0 0 0.0 255.0 ECU_ADDRESS 0x3FB9D1 /begin FUNCTION_LIST Egas /end FUNCTION_LIST /end MEASUREMENT
/begin MEASUREMENT egas_snd_dk.cmd_b1_fifo_3of5_ "CMD-B2" UBYTE FORMULA_0134 0 0 0.0 255.0 ECU_ADDRESS 0x3FB9D2 /begin FUNCTION_LIST Egas /end FUNCTION_LIST /end MEASUREMENT
/begin MEASUREMENT egas_snd_dk.cmd_b1_fifo_4of5_ "CMD-B2" UBYTE FORMULA_0134 0 0 0.0 255.0 ECU_ADDRESS 0x3FB9D3 /begin FUNCTION_LIST Egas /end FUNCTION_LIST /end MEASUREMENT
/begin MEASUREMENT egas_snd_dk.cmd_b1_fifo_5of5_ "CMD-B2" UBYTE FORMULA_0134 0 0 0.0 255.0 ECU_ADDRESS 0x3FB9D4 /begin FUNCTION_LIST Egas /end FUNCTION_LIST /end MEASUREMENT
/begin MEASUREMENT egas_snd_dk.cmd_b2_fifo_1of5_ "CMD-B2" UBYTE FORMULA_0134 0 0 0.0 255.0 ECU_ADDRESS 0x3FB9D5 /begin FUNCTION_LIST Egas /end FUNCTION_LIST /end MEASUREMENT
/begin MEASUREMENT egas_snd_dk.cmd_b2_fifo_2of5_ "CMD-B2" UBYTE FORMULA_0134 0 0 0.0 255.0 ECU_ADDRESS 0x3FB9D6 /begin FUNCTION_LIST Egas /end FUNCTION_LIST /end MEASUREMENT
/begin MEASUREMENT egas_snd_dk.cmd_b2_fifo_3of5_ "CMD-B2" UBYTE FORMULA_0134 0 0 0.0 255.0 ECU_ADDRESS 0x3FB9D7 /begin FUNCTION_LIST Egas /end FUNCTION_LIST /end MEASUREMENT
/begin MEASUREMENT egas_snd_dk.cmd_b2_fifo_4of5_ "CMD-B2" UBYTE FORMULA_0134 0 0 0.0 255.0 ECU_ADDRESS 0x3FB9D8 /begin FUNCTION_LIST Egas /end FUNCTION_LIST /end MEASUREMENT
/begin MEASUREMENT egas_snd_dk.cmd_b2_fifo_5of5_ "CMD-B2" UBYTE FORMULA_0134 0 0 0.0 255.0 ECU_ADDRESS 0x3FB9D9 /begin FUNCTION_LIST Egas /end FUNCTION_LIST /end MEASUREMENT
/begin MEASUREMENT egas_snd_dk.v_ko_vers "Vorgabe KOMM" UBYTE FORMULA_0008 0 0 0.0 255.0000 ECU_ADDRESS 0x3FB9DC /begin FUNCTION_LIST Egas /end FUNCTION_LIST /end MEASUREMENT
/begin MEASUREMENT egas_snd_dk.v_bank "Vorgabe BANK" UBYTE FORMULA_0008 0 0 0.0 255.0000 ECU_ADDRESS 0x3FB9DD /begin FUNCTION_LIST Egas /end FUNCTION_LIST /end MEASUREMENT
/begin MEASUREMENT egas_snd_dk.v_clr_diag_b1 "Diag Bank1" UWORD FORMULA_0000 0 0 0.0 65535.0000 ECU_ADDRESS 0x3FB9DE /begin FUNCTION_LIST Egas /end FUNCTION_LIST /end MEASUREMENT
/begin MEASUREMENT egas_snd_dk.v_clr_diag_b2 "Diag Bank1" UWORD FORMULA_0000 0 0 0.0 65535.0000 ECU_ADDRESS 0x3FB9E0 /begin FUNCTION_LIST Egas /end FUNCTION_LIST /end MEASUREMENT
/begin MEASUREMENT egas_snd_dk.time "Timeout" UWORD FORMULA_0135 0 0 0.0 6553.5000 ECU_ADDRESS 0x3FB9DA /begin FUNCTION_LIST Egas /end FUNCTION_LIST /end MEASUREMENT
/begin MEASUREMENT egas_rec_dk_b1.r_cmd "R-CMD-B1" UBYTE FORMULA_0134 0 0 0.0 255.0 ECU_ADDRESS 0x3FB9E5 /begin FUNCTION_LIST Egas /end FUNCTION_LIST /end MEASUREMENT
/begin MEASUREMENT egas_rec_dk_b2.r_cmd "R-CMD-B1" UBYTE FORMULA_0134 0 0 0.0 255.0 ECU_ADDRESS 0x3FB9F9 /begin FUNCTION_LIST Egas /end FUNCTION_LIST /end MEASUREMENT
/begin MEASUREMENT egas_rec_dk_bX.r_cmd "R-CMD-B1" UBYTE FORMULA_0134 0 0 0.0 255.0 ECU_ADDRESS 0x3FBA0D /begin FUNCTION_LIST Egas /end FUNCTION_LIST /end MEASUREMENT
/begin MEASUREMENT egas_rec_dk_b1.r_bank "Zylinder" UBYTE FORMULA_0008 0 0 0.0 255.0000 ECU_ADDRESS 0x3FB9E6 /begin FUNCTION_LIST Egas /end FUNCTION_LIST /end MEASUREMENT
/begin MEASUREMENT egas_rec_dk_b2.r_bank "Zylinder" UBYTE FORMULA_0008 0 0 0.0 255.0000 ECU_ADDRESS 0x3FB9FA /begin FUNCTION_LIST Egas /end FUNCTION_LIST /end MEASUREMENT
/begin MEASUREMENT egas_rec_dk_bX.r_bank "Zylinder" UBYTE FORMULA_0008 0 0 0.0 255.0000 ECU_ADDRESS 0x3FBA0E /begin FUNCTION_LIST Egas /end FUNCTION_LIST /end MEASUREMENT
/begin MEASUREMENT egas_rec_dk_b1.r_ko_vers "Kommunikationsversion" UBYTE FORMULA_0008 0 0 0.0 255.0000 ECU_ADDRESS 0x3FB9E7 /begin FUNCTION_LIST Egas /end FUNCTION_LIST /end MEASUREMENT
/begin MEASUREMENT egas_rec_dk_b2.r_ko_vers "Kommunikationsversion" UBYTE FORMULA_0008 0 0 0.0 255.0000 ECU_ADDRESS 0x3FB9FB /begin FUNCTION_LIST Egas /end FUNCTION_LIST /end MEASUREMENT
/begin MEASUREMENT egas_rec_dk_bX.r_ko_vers "Kommunikationsversion" UBYTE FORMULA_0008 0 0 0.0 255.0000 ECU_ADDRESS 0x3FBA0F /begin FUNCTION_LIST Egas /end FUNCTION_LIST /end MEASUREMENT
/begin MEASUREMENT egas_rec_dk_b1.r_hw_vers "HW-Version" UWORD FORMULA_0000 0 0 0.0 65535.0000 ECU_ADDRESS 0x3FB9E8 /begin FUNCTION_LIST Egas /end FUNCTION_LIST /end MEASUREMENT
/begin MEASUREMENT egas_rec_dk_b2.r_hw_vers "HW-Version" UWORD FORMULA_0000 0 0 0.0 65535.0000 ECU_ADDRESS 0x3FB9FC /begin FUNCTION_LIST Egas /end FUNCTION_LIST /end MEASUREMENT
/begin MEASUREMENT egas_rec_dk_bX.r_hw_vers "HW-Version" UWORD FORMULA_0000 0 0 0.0 65535.0000 ECU_ADDRESS 0x3FBA10 /begin FUNCTION_LIST Egas /end FUNCTION_LIST /end MEASUREMENT
/begin MEASUREMENT egas_rec_dk_b1.r_sw_vers "SW-Version" UWORD FORMULA_0000 0 0 0.0 65535.0000 ECU_ADDRESS 0x3FB9EA /begin FUNCTION_LIST Egas /end FUNCTION_LIST /end MEASUREMENT
/begin MEASUREMENT egas_rec_dk_b2.r_sw_vers "SW-Version" UWORD FORMULA_0000 0 0 0.0 65535.0000 ECU_ADDRESS 0x3FB9FE /begin FUNCTION_LIST Egas /end FUNCTION_LIST /end MEASUREMENT
/begin MEASUREMENT egas_rec_dk_bX.r_sw_vers "SW-Version" UWORD FORMULA_0000 0 0 0.0 65535.0000 ECU_ADDRESS 0x3FBA12 /begin FUNCTION_LIST Egas /end FUNCTION_LIST /end MEASUREMENT
/begin MEASUREMENT egas_rec_dk_b1.r_diag_st "Diagnosestatus" UWORD FORMULA_0138 0 0 0.0 65535.0 ECU_ADDRESS 0x3FB9EC /begin FUNCTION_LIST Egas /end FUNCTION_LIST /end MEASUREMENT
/begin MEASUREMENT egas_rec_dk_b2.r_diag_st "Diagnosestatus" UWORD FORMULA_0138 0 0 0.0 65535.0 ECU_ADDRESS 0x3FBA00 /begin FUNCTION_LIST Egas /end FUNCTION_LIST /end MEASUREMENT
/begin MEASUREMENT egas_rec_dk_bX.r_diag_st "Diagnosestatus" UWORD FORMULA_0138 0 0 0.0 65535.0 ECU_ADDRESS 0x3FBA14 /begin FUNCTION_LIST Egas /end FUNCTION_LIST /end MEASUREMENT
/begin MEASUREMENT egas_rec_dk_b1.r_set_vers "Kommunikationsversion" UBYTE FORMULA_0008 0 0 0.0 255.0000 ECU_ADDRESS 0x3FB9EE /begin FUNCTION_LIST Egas /end FUNCTION_LIST /end MEASUREMENT
/begin MEASUREMENT egas_rec_dk_b2.r_set_vers "Kommunikationsversion" UBYTE FORMULA_0008 0 0 0.0 255.0000 ECU_ADDRESS 0x3FBA02 /begin FUNCTION_LIST Egas /end FUNCTION_LIST /end MEASUREMENT
/begin MEASUREMENT egas_rec_dk_bX.r_set_vers "Kommunikationsversion" UBYTE FORMULA_0008 0 0 0.0 255.0000 ECU_ADDRESS 0x3FBA16 /begin FUNCTION_LIST Egas /end FUNCTION_LIST /end MEASUREMENT
/begin MEASUREMENT egas_rec_dk_b1.status "Empfangsstatus" UBYTE FORMULA_0136 0 0 0.0 255.0 ECU_ADDRESS 0x3FB9F0 /begin FUNCTION_LIST Egas /end FUNCTION_LIST /end MEASUREMENT
/begin MEASUREMENT egas_rec_dk_b2.status "Empfangsstatus" UBYTE FORMULA_0136 0 0 0.0 255.0 ECU_ADDRESS 0x3FBA04 /begin FUNCTION_LIST Egas /end FUNCTION_LIST /end MEASUREMENT
/begin MEASUREMENT egas_rec_dk_bX.status "Empfangsstatus" UBYTE FORMULA_0136 0 0 0.0 255.0 ECU_ADDRESS 0x3FBA18 /begin FUNCTION_LIST Egas /end FUNCTION_LIST /end MEASUREMENT
/begin MEASUREMENT egas_rec_dk_b1.cs_err "CS-Error" UBYTE FORMULA_0008 0 0 0.0 255.0000 ECU_ADDRESS 0x3FB9EF /begin FUNCTION_LIST Egas /end FUNCTION_LIST /end MEASUREMENT
/begin MEASUREMENT egas_rec_dk_b2.cs_err "CS-Error" UBYTE FORMULA_0008 0 0 0.0 255.0000 ECU_ADDRESS 0x3FBA03 /begin FUNCTION_LIST Egas /end FUNCTION_LIST /end MEASUREMENT
/begin MEASUREMENT egas_rec_dk_bX.cs_err "CS-Error" UBYTE FORMULA_0008 0 0 0.0 255.0000 ECU_ADDRESS 0x3FBA17 /begin FUNCTION_LIST Egas /end FUNCTION_LIST /end MEASUREMENT
/begin MEASUREMENT egas_rec_dk_b1.rec_ack "Receive-Ack" UWORD FORMULA_0024 0 0 0.0 65535.0000 ECU_ADDRESS 0x3FB9F2 /begin FUNCTION_LIST Egas /end FUNCTION_LIST /end MEASUREMENT
/begin MEASUREMENT egas_rec_dk_b2.rec_ack "Receive-Ack" UWORD FORMULA_0024 0 0 0.0 65535.0000 ECU_ADDRESS 0x3FBA06 /begin FUNCTION_LIST Egas /end FUNCTION_LIST /end MEASUREMENT
/begin MEASUREMENT egas_rec_dk_bX.rec_ack "Receive-Ack" UWORD FORMULA_0024 0 0 0.0 65535.0000 ECU_ADDRESS 0x3FBA1A /begin FUNCTION_LIST Egas /end FUNCTION_LIST /end MEASUREMENT
/begin MEASUREMENT egas_rec_dk_b1.rec_err "Receive-Error" UWORD FORMULA_0024 0 0 0.0 65535.0000 ECU_ADDRESS 0x3FB9F4 /begin FUNCTION_LIST Egas /end FUNCTION_LIST /end MEASUREMENT
/begin MEASUREMENT egas_rec_dk_b2.rec_err "Receive-Error" UWORD FORMULA_0024 0 0 0.0 65535.0000 ECU_ADDRESS 0x3FBA08 /begin FUNCTION_LIST Egas /end FUNCTION_LIST /end MEASUREMENT
/begin MEASUREMENT egas_rec_dk_bX.rec_err "Receive-Error" UWORD FORMULA_0024 0 0 0.0 65535.0000 ECU_ADDRESS 0x3FBA1C /begin FUNCTION_LIST Egas /end FUNCTION_LIST /end MEASUREMENT
/begin MEASUREMENT egas_rec_dk_b1.ed "ED-Status" UWORD FORMULA_0137 0 0 0.0 65535.0 ECU_ADDRESS 0x3FB9F6 /begin FUNCTION_LIST Egas /end FUNCTION_LIST /end MEASUREMENT
/begin MEASUREMENT egas_rec_dk_b2.ed "ED-Status" UWORD FORMULA_0137 0 0 0.0 65535.0 ECU_ADDRESS 0x3FBA0A /begin FUNCTION_LIST Egas /end FUNCTION_LIST /end MEASUREMENT
/begin MEASUREMENT egas_rec_dk_bX.ed "ED-Status" UWORD FORMULA_0137 0 0 0.0 65535.0 ECU_ADDRESS 0x3FBA1E /begin FUNCTION_LIST Egas /end FUNCTION_LIST /end MEASUREMENT
/* ------------------ Abschnitt erzeugt aus egas_stm.dat ------------------ */
/begin CHARACTERISTIC K_EGAS_STM_DK_WAIT_DIS "Warten auf Disable" VALUE 0x6068C TKW_VV_VV_UW 100.0 FORMULA_0140 0.0 327.6750 /begin FUNCTION_LIST Egas /end FUNCTION_LIST FORMAT "%5.2" /end CHARACTERISTIC
/begin CHARACTERISTIC K_EGAS_STM_DK_SK_TST "SK-Testzeit" VALUE 0x6068E TKW_VV_VV_UW 100.0 FORMULA_0140 0.0 327.6750 /begin FUNCTION_LIST Egas /end FUNCTION_LIST FORMAT "%5.2" /end CHARACTERISTIC
/begin MEASUREMENT egas_lls_startup "LLS-Startstate" UBYTE FORMULA_0139 0 0 0.0 255.0 ECU_ADDRESS 0x3FBA20 /begin FUNCTION_LIST Egas /end FUNCTION_LIST /end MEASUREMENT
/begin MEASUREMENT egas_dk_startup "DK-Startstate" UBYTE FORMULA_0139 0 0 0.0 255.0 ECU_ADDRESS 0x3FBA22 /begin FUNCTION_LIST Egas /end FUNCTION_LIST /end MEASUREMENT
/begin MEASUREMENT egas_lls_version "LLS-Version" UBYTE FORMULA_0047 0 0 0.0 255.0000 ECU_ADDRESS 0x3FBA24 /begin FUNCTION_LIST Egas /end FUNCTION_LIST /end MEASUREMENT
/begin MEASUREMENT egas_dk_version "DK-Version" UBYTE FORMULA_0047 0 0 0.0 255.0000 ECU_ADDRESS 0x3FBA25 /begin FUNCTION_LIST Egas /end FUNCTION_LIST /end MEASUREMENT
/begin MEASUREMENT egas_lls_neuinit_cnt "Anzahl LLS-Neuinits" UBYTE FORMULA_0008 0 0 0.0 255.0000 ECU_ADDRESS 0x3FBA26 /begin FUNCTION_LIST Egas /end FUNCTION_LIST /end MEASUREMENT
/begin MEASUREMENT egas_dk_neuinit_cnt "Anzahl DK-Neuinits" UBYTE FORMULA_0008 0 0 0.0 255.0000 ECU_ADDRESS 0x3FBA27 /begin FUNCTION_LIST Egas /end FUNCTION_LIST /end MEASUREMENT
/* ------------------ Abschnitt erzeugt aus fr.dat ------------------ */
/begin CHARACTERISTIC K_FR_DI_ENTDR "Schrittweite fr-Aufregelung bei DK entdrosselt" VALUE 0x60690 TKW_VV_VV_UB 100.0 FORMULA_0144 0.0 0.7781 /begin FUNCTION_LIST Fuellungsregler /end FUNCTION_LIST /end CHARACTERISTIC
/begin CHARACTERISTIC K_FR_EDK_DIFF "max. Abweichung WDK Soll/Ist fuer FR-Freigabe" VALUE 0x60692 TKW_VV_VV_SW 100.0 FORMULA_0022 0.0 10.0000 /begin FUNCTION_LIST Fuellungsregler /end FUNCTION_LIST FORMAT "%4.1" /end CHARACTERISTIC
/begin CHARACTERISTIC K_FR_DRREL_MAX "drrel-Schwelle zum Einfrieren fr-Regler" VALUE 0x60694 TKW_VV_VV_SW 100.0 FORMULA_0020 0.0 10.0000 /begin FUNCTION_LIST Fuellungsregler /end FUNCTION_LIST FORMAT "%5.2" /end CHARACTERISTIC
/begin CHARACTERISTIC K_FR_IMIN "Begrenzung des I-Anteils" VALUE 0x60696 TKW_VV_VV_SW 100.0 FORMULA_0145 0.5000 1.5000 /begin FUNCTION_LIST Fuellungsregler /end FUNCTION_LIST FORMAT "%7.4" /end CHARACTERISTIC
/begin CHARACTERISTIC K_FR_IMAX "Begrenzung des I-Anteils" VALUE 0x60698 TKW_VV_VV_SW 100.0 FORMULA_0145 0.5000 1.5000 /begin FUNCTION_LIST Fuellungsregler /end FUNCTION_LIST FORMAT "%7.4" /end CHARACTERISTIC
/begin CHARACTERISTIC KL_FR_IANT "-" CURVE 0x6069A TKL_SW_VV_SW 100.0 FORMULA_0143 -1.0000 1.0000 /begin FUNCTION_LIST Fuellungsregler /end FUNCTION_LIST
 /begin AXIS_DESCR STD_AXIS delta_rf FORMULA_0141 8 -1.0000 1.0000 FORMAT "%7.4" /end AXIS_DESCR
 FORMAT "%7.4" /end CHARACTERISTIC
/begin MEASUREMENT fr_rf_delta_1of2_ "rf_ist - rf_soll" SWORD FORMULA_0141 0 0 -1.0000 1.0000 ECU_ADDRESS 0x3FBA2E /begin FUNCTION_LIST Fuellungsregler /end FUNCTION_LIST /end MEASUREMENT
/begin MEASUREMENT fr_rf_delta_2of2_ "rf_ist - rf_soll" SWORD FORMULA_0141 0 0 -1.0000 1.0000 ECU_ADDRESS 0x3FBA30 /begin FUNCTION_LIST Fuellungsregler /end FUNCTION_LIST /end MEASUREMENT
/begin MEASUREMENT fr_reg_i_1of2_ "I-Anteil Fuellungsregler" SWORD FORMULA_0142 0 0 -0.5000 0.5000 ECU_ADDRESS 0x3FBA32 /begin FUNCTION_LIST Fuellungsregler /end FUNCTION_LIST /end MEASUREMENT
/begin MEASUREMENT fr_reg_i_2of2_ "I-Anteil Fuellungsregler" SWORD FORMULA_0142 0 0 -0.5000 0.5000 ECU_ADDRESS 0x3FBA34 /begin FUNCTION_LIST Fuellungsregler /end FUNCTION_LIST /end MEASUREMENT
/begin MEASUREMENT fr_ant_i_1of2_ "Schrittweite des I-Reglers" SWORD FORMULA_0143 0 0 -1.0000 1.0000 ECU_ADDRESS 0x3FBA36 /begin FUNCTION_LIST Fuellungsregler /end FUNCTION_LIST /end MEASUREMENT
/begin MEASUREMENT fr_ant_i_2of2_ "Schrittweite des I-Reglers" SWORD FORMULA_0143 0 0 -1.0000 1.0000 ECU_ADDRESS 0x3FBA38 /begin FUNCTION_LIST Fuellungsregler /end FUNCTION_LIST /end MEASUREMENT
/begin MEASUREMENT fr_reg_out_1of2_ "Korrekturfaktor FR-Regler" UWORD FORMULA_0142 0 0 0.5000 1.5000 ECU_ADDRESS 0x3FBA3A /begin FUNCTION_LIST Fuellungsregler /end FUNCTION_LIST /end MEASUREMENT
/begin MEASUREMENT fr_reg_out_2of2_ "Korrekturfaktor FR-Regler" UWORD FORMULA_0142 0 0 0.5000 1.5000 ECU_ADDRESS 0x3FBA3C /begin FUNCTION_LIST Fuellungsregler /end FUNCTION_LIST /end MEASUREMENT
/begin MEASUREMENT fr_ml_adaption_1of2_ "Adaption" SWORD FORMULA_0010 0 0 -100.0000 1400.0000 ECU_ADDRESS 0x3FBA3E /begin FUNCTION_LIST Fuellungsregler /end FUNCTION_LIST /end MEASUREMENT
/begin MEASUREMENT fr_ml_adaption_2of2_ "Adaption" SWORD FORMULA_0010 0 0 -100.0000 1400.0000 ECU_ADDRESS 0x3FBA40 /begin FUNCTION_LIST Fuellungsregler /end FUNCTION_LIST /end MEASUREMENT
/* ------------------ Abschnitt erzeugt aus heimatlos_ign.dat ------------------ */
/begin MEASUREMENT ed_fsp "-" ULONG FORMULA_0001 0 0 0.0 2147483647.0000 ECU_ADDRESS 0x3FBA44 /begin FUNCTION_LIST Heimatlos /end FUNCTION_LIST /end MEASUREMENT
/begin MEASUREMENT slp_ml_1of2_ "Sekundaerluftmasse" SWORD FORMULA_0010 0 0 -100.0000 1400.0000 ECU_ADDRESS 0x3FBA4E /begin FUNCTION_LIST Heimatlos /end FUNCTION_LIST /end MEASUREMENT
/begin MEASUREMENT slp_ml_2of2_ "Sekundaerluftmasse" SWORD FORMULA_0010 0 0 -100.0000 1400.0000 ECU_ADDRESS 0x3FBA50 /begin FUNCTION_LIST Heimatlos /end FUNCTION_LIST /end MEASUREMENT
/begin MEASUREMENT B_TPU_MOTOR_DREHT "Debug B_TPU_MOTOR_DREHT" UBYTE FORMULA_0146 0 0 0.0 1.0000 ECU_ADDRESS 0x3FBA52 /begin FUNCTION_LIST Heimatlos /end FUNCTION_LIST /end MEASUREMENT
/* ------------------ Abschnitt erzeugt aus ipkdata.dat ------------------ */
/begin CHARACTERISTIC K_IPK_IGN_T_SYNC_MAX "Wartezeit IGN auf INJ" VALUE 0x60804 TKW_VV_VV_UL 100.0 FORMULA_0152 0.0 500.0000 /begin FUNCTION_LIST Inter_Prozessor_Kommunikation /end FUNCTION_LIST FORMAT "%4.1" /end CHARACTERISTIC
/begin MEASUREMENT ipk_rec_errorcount "Fehlerzaehler fuer Empfangstelegramme" UBYTE FORMULA_0008 0 0 0.0 255.0000 ECU_ADDRESS 0x3FBB5C /begin FUNCTION_LIST Inter_Prozessor_Kommunikation /end FUNCTION_LIST /end MEASUREMENT
/begin MEASUREMENT ipk_rec_errorcode "Fehlerart fuer Empfangstelegramme" UBYTE FORMULA_0008 0 0 0.0 255.0000 ECU_ADDRESS 0x3FBB5D /begin FUNCTION_LIST Inter_Prozessor_Kommunikation /end FUNCTION_LIST /end MEASUREMENT
/begin MEASUREMENT ipk_send_errorcount "Fehlerzaehler fuer Sendetelegramme" UBYTE FORMULA_0008 0 0 0.0 255.0000 ECU_ADDRESS 0x3FBB5E /begin FUNCTION_LIST Inter_Prozessor_Kommunikation /end FUNCTION_LIST /end MEASUREMENT
/begin MEASUREMENT ipk_send_errorcode "Fehlerart fuer Sendetelegramme" UBYTE FORMULA_0008 0 0 0.0 255.0000 ECU_ADDRESS 0x3FBB5F /begin FUNCTION_LIST Inter_Prozessor_Kommunikation /end FUNCTION_LIST /end MEASUREMENT
/begin MEASUREMENT dpr_test_count "" ULONG FORMULA_0001 0 0 0.0 2147483647.0000 ECU_ADDRESS 0x3FBB68 /begin FUNCTION_LIST Inter_Prozessor_Kommunikation /end FUNCTION_LIST /end MEASUREMENT
/begin MEASUREMENT dpr_wert "" UBYTE FORMULA_0008 0 0 0.0 255.0000 ECU_ADDRESS 0x3FBB6C /begin FUNCTION_LIST Inter_Prozessor_Kommunikation /end FUNCTION_LIST /end MEASUREMENT
/begin MEASUREMENT dpr_test_wrt_cnt "" UBYTE FORMULA_0008 0 0 0.0 255.0000 ECU_ADDRESS 0x3FBB6D /begin FUNCTION_LIST Inter_Prozessor_Kommunikation /end FUNCTION_LIST /end MEASUREMENT
/begin MEASUREMENT dpr_test_richtung "" UBYTE FORMULA_0008 0 0 0.0 255.0000 ECU_ADDRESS 0x600DD4 /begin FUNCTION_LIST Inter_Prozessor_Kommunikation /end FUNCTION_LIST /end MEASUREMENT
/begin MEASUREMENT dpr_fehler_cnt_wr "" UWORD FORMULA_0000 0 0 0.0 65535.0000 ECU_ADDRESS 0x3FBB6E /begin FUNCTION_LIST Inter_Prozessor_Kommunikation /end FUNCTION_LIST /end MEASUREMENT
/begin MEASUREMENT dpr_fehler_cnt_rd "" UWORD FORMULA_0000 0 0 0.0 65535.0000 ECU_ADDRESS 0x3FBB70 /begin FUNCTION_LIST Inter_Prozessor_Kommunikation /end FUNCTION_LIST /end MEASUREMENT
/begin MEASUREMENT dpr_fehler_ptr_1of20_ "" UWORD FORMULA_0151 0 0 0.0 131070.0000 ECU_ADDRESS 0x3FBB72 /begin FUNCTION_LIST Inter_Prozessor_Kommunikation /end FUNCTION_LIST /end MEASUREMENT
/begin MEASUREMENT dpr_fehler_ptr_2of20_ "" UWORD FORMULA_0151 0 0 0.0 131070.0000 ECU_ADDRESS 0x3FBB74 /begin FUNCTION_LIST Inter_Prozessor_Kommunikation /end FUNCTION_LIST /end MEASUREMENT
/begin MEASUREMENT dpr_fehler_ptr_3of20_ "" UWORD FORMULA_0151 0 0 0.0 131070.0000 ECU_ADDRESS 0x3FBB76 /begin FUNCTION_LIST Inter_Prozessor_Kommunikation /end FUNCTION_LIST /end MEASUREMENT
/begin MEASUREMENT dpr_fehler_ptr_4of20_ "" UWORD FORMULA_0151 0 0 0.0 131070.0000 ECU_ADDRESS 0x3FBB78 /begin FUNCTION_LIST Inter_Prozessor_Kommunikation /end FUNCTION_LIST /end MEASUREMENT
/begin MEASUREMENT dpr_fehler_ptr_5of20_ "" UWORD FORMULA_0151 0 0 0.0 131070.0000 ECU_ADDRESS 0x3FBB7A /begin FUNCTION_LIST Inter_Prozessor_Kommunikation /end FUNCTION_LIST /end MEASUREMENT
/begin MEASUREMENT dpr_fehler_ptr_6of20_ "" UWORD FORMULA_0151 0 0 0.0 131070.0000 ECU_ADDRESS 0x3FBB7C /begin FUNCTION_LIST Inter_Prozessor_Kommunikation /end FUNCTION_LIST /end MEASUREMENT
/begin MEASUREMENT dpr_fehler_ptr_7of20_ "" UWORD FORMULA_0151 0 0 0.0 131070.0000 ECU_ADDRESS 0x3FBB7E /begin FUNCTION_LIST Inter_Prozessor_Kommunikation /end FUNCTION_LIST /end MEASUREMENT
/begin MEASUREMENT dpr_fehler_ptr_8of20_ "" UWORD FORMULA_0151 0 0 0.0 131070.0000 ECU_ADDRESS 0x3FBB80 /begin FUNCTION_LIST Inter_Prozessor_Kommunikation /end FUNCTION_LIST /end MEASUREMENT
/begin MEASUREMENT dpr_fehler_ptr_9of20_ "" UWORD FORMULA_0151 0 0 0.0 131070.0000 ECU_ADDRESS 0x3FBB82 /begin FUNCTION_LIST Inter_Prozessor_Kommunikation /end FUNCTION_LIST /end MEASUREMENT
/begin MEASUREMENT dpr_fehler_ptr_10of20_ "" UWORD FORMULA_0151 0 0 0.0 131070.0000 ECU_ADDRESS 0x3FBB84 /begin FUNCTION_LIST Inter_Prozessor_Kommunikation /end FUNCTION_LIST /end MEASUREMENT
/begin MEASUREMENT dpr_fehler_ptr_11of20_ "" UWORD FORMULA_0151 0 0 0.0 131070.0000 ECU_ADDRESS 0x3FBB86 /begin FUNCTION_LIST Inter_Prozessor_Kommunikation /end FUNCTION_LIST /end MEASUREMENT
/begin MEASUREMENT dpr_fehler_ptr_12of20_ "" UWORD FORMULA_0151 0 0 0.0 131070.0000 ECU_ADDRESS 0x3FBB88 /begin FUNCTION_LIST Inter_Prozessor_Kommunikation /end FUNCTION_LIST /end MEASUREMENT
/begin MEASUREMENT dpr_fehler_ptr_13of20_ "" UWORD FORMULA_0151 0 0 0.0 131070.0000 ECU_ADDRESS 0x3FBB8A /begin FUNCTION_LIST Inter_Prozessor_Kommunikation /end FUNCTION_LIST /end MEASUREMENT
/begin MEASUREMENT dpr_fehler_ptr_14of20_ "" UWORD FORMULA_0151 0 0 0.0 131070.0000 ECU_ADDRESS 0x3FBB8C /begin FUNCTION_LIST Inter_Prozessor_Kommunikation /end FUNCTION_LIST /end MEASUREMENT
/begin MEASUREMENT dpr_fehler_ptr_15of20_ "" UWORD FORMULA_0151 0 0 0.0 131070.0000 ECU_ADDRESS 0x3FBB8E /begin FUNCTION_LIST Inter_Prozessor_Kommunikation /end FUNCTION_LIST /end MEASUREMENT
/begin MEASUREMENT dpr_fehler_ptr_16of20_ "" UWORD FORMULA_0151 0 0 0.0 131070.0000 ECU_ADDRESS 0x3FBB90 /begin FUNCTION_LIST Inter_Prozessor_Kommunikation /end FUNCTION_LIST /end MEASUREMENT
/begin MEASUREMENT dpr_fehler_ptr_17of20_ "" UWORD FORMULA_0151 0 0 0.0 131070.0000 ECU_ADDRESS 0x3FBB92 /begin FUNCTION_LIST Inter_Prozessor_Kommunikation /end FUNCTION_LIST /end MEASUREMENT
/begin MEASUREMENT dpr_fehler_ptr_18of20_ "" UWORD FORMULA_0151 0 0 0.0 131070.0000 ECU_ADDRESS 0x3FBB94 /begin FUNCTION_LIST Inter_Prozessor_Kommunikation /end FUNCTION_LIST /end MEASUREMENT
/begin MEASUREMENT dpr_fehler_ptr_19of20_ "" UWORD FORMULA_0151 0 0 0.0 131070.0000 ECU_ADDRESS 0x3FBB96 /begin FUNCTION_LIST Inter_Prozessor_Kommunikation /end FUNCTION_LIST /end MEASUREMENT
/begin MEASUREMENT dpr_fehler_ptr_20of20_ "" UWORD FORMULA_0151 0 0 0.0 131070.0000 ECU_ADDRESS 0x3FBB98 /begin FUNCTION_LIST Inter_Prozessor_Kommunikation /end FUNCTION_LIST /end MEASUREMENT
/begin MEASUREMENT dpr_wert_soll "" ULONG FORMULA_0001 0 0 0.0 2147483647.0000 ECU_ADDRESS 0x3FBB9C /begin FUNCTION_LIST Inter_Prozessor_Kommunikation /end FUNCTION_LIST /end MEASUREMENT
/begin MEASUREMENT dpr_wert_ist "" ULONG FORMULA_0001 0 0 0.0 2147483647.0000 ECU_ADDRESS 0x3FBBA0 /begin FUNCTION_LIST Inter_Prozessor_Kommunikation /end FUNCTION_LIST /end MEASUREMENT
/* ------------------ Abschnitt erzeugt aus ka.dat ------------------ */
/begin CHARACTERISTIC K_KA_TZ_KLOPFSCHUTZ "Nicht gewichteter Rueckziehwinkel bei Klopfschutz" VALUE 0x60808 TKW_VV_VV_SW 100.0 FORMULA_0037 -50.0000 60.0000 /begin FUNCTION_LIST Klopfadaption /end FUNCTION_LIST FORMAT "%4.1" /end CHARACTERISTIC
/begin CHARACTERISTIC KL_KA_FAKT_VL "Gewichtungsfaktor" CURVE 0x6080A TKL_SW_VV_UW 100.0 FORMULA_0035 0.0 4.0000 /begin FUNCTION_LIST Klopfadaption /end FUNCTION_LIST /begin AXIS_DESCR STD_AXIS n FORMULA_0011 18 0.0 10000.0000 /end AXIS_DESCR FORMAT "%6.3" /end CHARACTERISTIC
/begin CHARACTERISTIC KL_KA_OFFS_VL "Abstand Klopfgrenze" CURVE 0x60854 TKL_SW_VV_SW 100.0 FORMULA_0037 -50.0000 60.0000 /begin FUNCTION_LIST Klopfadaption /end FUNCTION_LIST /begin AXIS_DESCR STD_AXIS n FORMULA_0011 18 0.0 10000.0000 /end AXIS_DESCR FORMAT "%4.1" /end CHARACTERISTIC
/begin CHARACTERISTIC KL_KA_PUMG_VL "Zuendwinkeloffset" CURVE 0x6089E TKL_SW_VV_SW 100.0 FORMULA_0037 -50.0000 60.0000 /begin FUNCTION_LIST Klopfadaption /end FUNCTION_LIST
 /begin AXIS_DESCR STD_AXIS pumg FORMULA_0031 6 400.0000 1200.0000 FORMAT "%4.1" /end AXIS_DESCR
 FORMAT "%4.1" /end CHARACTERISTIC
/begin CHARACTERISTIC KF_KA_FAKT "Gewichtungsfaktor" MAP 0x608B8 TKF_SW_SW_UW 100.0 FORMULA_0035 0.0 4.0000 /begin FUNCTION_LIST Klopfadaption /end FUNCTION_LIST /begin AXIS_DESCR STD_AXIS n FORMULA_0011 18 0.0 10000.0000 /end AXIS_DESCR /begin AXIS_DESCR STD_AXIS rf_m FORMULA_0006 12 0.0 2.0000 FORMAT "%6.3" /end AXIS_DESCR FORMAT "%6.3" /end CHARACTERISTIC
/begin CHARACTERISTIC KF_KA_OFFS "Abstand Klopfgrenze" MAP 0x60AA6 TKF_SW_SW_SW 100.0 FORMULA_0037 -50.0000 60.0000 /begin FUNCTION_LIST Klopfadaption /end FUNCTION_LIST /begin AXIS_DESCR STD_AXIS n FORMULA_0011 18 0.0 10000.0000 /end AXIS_DESCR /begin AXIS_DESCR STD_AXIS rf_m FORMULA_0006 12 0.0 2.0000 FORMAT "%6.3" /end AXIS_DESCR FORMAT "%4.1" /end CHARACTERISTIC
/begin CHARACTERISTIC KF_KA_T_KOMP "Temperaturkompensation Klopfadaption" MAP 0x60C94 TKF_SW_SW_SW 100.0 FORMULA_0037 -50.0000 60.0000 /begin FUNCTION_LIST Klopfadaption /end FUNCTION_LIST
 /begin AXIS_DESCR STD_AXIS tmot FORMULA_0019 6 -50.0000 150.0000 FORMAT "%4.1" /end AXIS_DESCR
 /begin AXIS_DESCR STD_AXIS tan FORMULA_0019 6 -50.0000 150.0000 FORMAT "%4.1" /end AXIS_DESCR
 FORMAT "%4.1" /end CHARACTERISTIC
/begin MEASUREMENT ka_dtz_zyl1 "Zuendwinkeloffset aus der Klopfadaption" SWORD FORMULA_0037 0 0 -50.0000 60.0000 ECU_ADDRESS 0x3FBBA4 /begin FUNCTION_LIST Klopfadaption /end FUNCTION_LIST /end MEASUREMENT
/begin MEASUREMENT ka_dtz_zyl2 "Zuendwinkeloffset aus der Klopfadaption" SWORD FORMULA_0037 0 0 -50.0000 60.0000 ECU_ADDRESS 0x3FBBA6 /begin FUNCTION_LIST Klopfadaption /end FUNCTION_LIST /end MEASUREMENT
/begin MEASUREMENT ka_dtz_zyl3 "Zuendwinkeloffset aus der Klopfadaption" SWORD FORMULA_0037 0 0 -50.0000 60.0000 ECU_ADDRESS 0x3FBBA8 /begin FUNCTION_LIST Klopfadaption /end FUNCTION_LIST /end MEASUREMENT
/begin MEASUREMENT ka_dtz_zyl4 "Zuendwinkeloffset aus der Klopfadaption" SWORD FORMULA_0037 0 0 -50.0000 60.0000 ECU_ADDRESS 0x3FBBAA /begin FUNCTION_LIST Klopfadaption /end FUNCTION_LIST /end MEASUREMENT
/begin MEASUREMENT ka_dtz_zyl5 "Zuendwinkeloffset aus der Klopfadaption" SWORD FORMULA_0037 0 0 -50.0000 60.0000 ECU_ADDRESS 0x3FBBAC /begin FUNCTION_LIST Klopfadaption /end FUNCTION_LIST /end MEASUREMENT
/begin MEASUREMENT ka_dtz_zyl6 "Zuendwinkeloffset aus der Klopfadaption" SWORD FORMULA_0037 0 0 -50.0000 60.0000 ECU_ADDRESS 0x3FBBAE /begin FUNCTION_LIST Klopfadaption /end FUNCTION_LIST /end MEASUREMENT
/begin MEASUREMENT ka_dtz_zyl7 "Zuendwinkeloffset aus der Klopfadaption" SWORD FORMULA_0037 0 0 -50.0000 60.0000 ECU_ADDRESS 0x3FBBB0 /begin FUNCTION_LIST Klopfadaption /end FUNCTION_LIST /end MEASUREMENT
/begin MEASUREMENT ka_dtz_zyl8 "Zuendwinkeloffset aus der Klopfadaption" SWORD FORMULA_0037 0 0 -50.0000 60.0000 ECU_ADDRESS 0x3FBBB2 /begin FUNCTION_LIST Klopfadaption /end FUNCTION_LIST /end MEASUREMENT
/begin MEASUREMENT ka_dtz_zyl9 "Zuendwinkeloffset aus der Klopfadaption" SWORD FORMULA_0037 0 0 -50.0000 60.0000 ECU_ADDRESS 0x3FBBB4 /begin FUNCTION_LIST Klopfadaption /end FUNCTION_LIST /end MEASUREMENT
/begin MEASUREMENT ka_dtz_zyl10 "Zuendwinkeloffset aus der Klopfadaption" SWORD FORMULA_0037 0 0 -50.0000 60.0000 ECU_ADDRESS 0x3FBBB6 /begin FUNCTION_LIST Klopfadaption /end FUNCTION_LIST /end MEASUREMENT
/begin MEASUREMENT ka_dtz_zyl11 "Zuendwinkeloffset aus der Klopfadaption" SWORD FORMULA_0037 0 0 -50.0000 60.0000 ECU_ADDRESS 0x3FBBB8 /begin FUNCTION_LIST Klopfadaption /end FUNCTION_LIST /end MEASUREMENT
/begin MEASUREMENT ka_dtz_zyl12 "Zuendwinkeloffset aus der Klopfadaption" SWORD FORMULA_0037 0 0 -50.0000 60.0000 ECU_ADDRESS 0x3FBBBA /begin FUNCTION_LIST Klopfadaption /end FUNCTION_LIST /end MEASUREMENT
/begin MEASUREMENT ka_offs "Offset zur Klopfgrenze" SWORD FORMULA_0037 0 0 -50.0000 60.0000 ECU_ADDRESS 0x3FBBBC /begin FUNCTION_LIST Klopfadaption /end FUNCTION_LIST /end MEASUREMENT
/begin MEASUREMENT ka_pumg "Zuendwinkeloffset durch Umgebungsdruck" SWORD FORMULA_0037 0 0 -50.0000 60.0000 ECU_ADDRESS 0x3FBBBE /begin FUNCTION_LIST Klopfadaption /end FUNCTION_LIST /end MEASUREMENT
/begin MEASUREMENT ka_t_komp_b1 "Zuendwinkeloffset durch Temperatur" SWORD FORMULA_0037 0 0 -50.0000 60.0000 ECU_ADDRESS 0x3FBBC0 /begin FUNCTION_LIST Klopfadaption /end FUNCTION_LIST /end MEASUREMENT
/begin MEASUREMENT ka_t_komp_b2 "Zuendwinkeloffset durch Temperatur" SWORD FORMULA_0037 0 0 -50.0000 60.0000 ECU_ADDRESS 0x3FBBC2 /begin FUNCTION_LIST Klopfadaption /end FUNCTION_LIST /end MEASUREMENT
/begin MEASUREMENT ka_fakt "Gewichtungsfaktor der Klopfadaption" UWORD FORMULA_0035 0 0 0.0 4.0000 ECU_ADDRESS 0x3FBBC4 /begin FUNCTION_LIST Klopfadaption /end FUNCTION_LIST /end MEASUREMENT
/* ------------------ Abschnitt erzeugt aus km.dat ------------------ */
/begin CHARACTERISTIC K_KM_TEST_SEGM "Anzahl Segm. Senden nach ZOT" VALUE 0x60CF8 TKW_VV_VV_UB 100.0 FORMULA_0008 0.0 12.0000 /begin FUNCTION_LIST Klopfmessung /end FUNCTION_LIST /end CHARACTERISTIC
/begin CHARACTERISTIC K_KM_TEST_V_MESS "Verstaerkungsstufe Test" VALUE 0x60CF9 TKW_VV_VV_UB 100.0 FORMULA_0008 0.0 7.0000 /begin FUNCTION_LIST Klopfmessung /end FUNCTION_LIST /end CHARACTERISTIC
/begin CHARACTERISTIC K_KM_TEST_U_MESS "Spannungs-Umschaltung Test" VALUE 0x60CFA TKW_VV_VV_UB 100.0 FORMULA_0156 0.0 255.0 /begin FUNCTION_LIST Klopfmessung /end FUNCTION_LIST /end CHARACTERISTIC
/begin CHARACTERISTIC K_KM_TEST_I_SOFT_OFF "Stromschwelle SoftOff Test" VALUE 0x60CFB TKW_VV_VV_UB 100.0 FORMULA_0157 0.0 255.0 /begin FUNCTION_LIST Klopfmessung /end FUNCTION_LIST /end CHARACTERISTIC
/begin CHARACTERISTIC K_KM_V_MESS_REG_SCHLT "Schalter Freigabe Verstaerkungsregelung: 0 = Aus; 1 = Aktiv" VALUE 0x60CFC TKW_VV_VV_UB 100.0 FORMULA_0008 0.0 1.0000 /begin FUNCTION_LIST Klopfmessung /end FUNCTION_LIST /end CHARACTERISTIC
/begin CHARACTERISTIC K_KM_TIME_OUT "Timeout fuer Winkelfenster." VALUE 0x60D00 TKW_VV_VV_UL 100.0 FORMULA_0161 0.0 838.8607 /begin FUNCTION_LIST Klopfmessung /end FUNCTION_LIST /end CHARACTERISTIC
/begin CHARACTERISTIC K_KM_U_ION_MAX "Maximal zul. Tiefpassgefilterter Ionenspanung." VALUE 0x60D04 TKW_VV_VV_SW 100.0 FORMULA_0148 0.0 3.4436 /begin FUNCTION_LIST Klopfmessung /end FUNCTION_LIST FORMAT "%6.3" /end CHARACTERISTIC
/begin CHARACTERISTIC K_KM_U_ION_MAX_HYS "Hysterese des maximal zul. Tiefpassgefilterter Ionenspanung." VALUE 0x60D06 TKW_VV_VV_SW 100.0 FORMULA_0148 0.0 3.4436 /begin FUNCTION_LIST Klopfmessung /end FUNCTION_LIST FORMAT "%6.3" /end CHARACTERISTIC
/begin CHARACTERISTIC K_KM_U_ION_REG_HYS "Hysterese Sollspanung." VALUE 0x60D08 TKW_VV_VV_SW 100.0 FORMULA_0148 0.0 3.4436 /begin FUNCTION_LIST Klopfmessung /end FUNCTION_LIST FORMAT "%6.3" /end CHARACTERISTIC
/begin CHARACTERISTIC K_KM_U_ION_SOLL "Sollspanung." VALUE 0x60D0A TKW_VV_VV_SW 100.0 FORMULA_0148 0.0 3.4436 /begin FUNCTION_LIST Klopfmessung /end FUNCTION_LIST FORMAT "%6.3" /end CHARACTERISTIC
/begin CHARACTERISTIC K_KM_V_MESS_REG "Initialwert vom allen Verstaerkungsregelungen." VALUE 0x60D0C TKW_VV_VV_SW 100.0 FORMULA_0000 0.0 1024.0000 /begin FUNCTION_LIST Klopfmessung /end FUNCTION_LIST /end CHARACTERISTIC
/begin CHARACTERISTIC K_KM_V_MESS_MIN "Minimalbegrenzung vom Ausgang der Verstaerkungsregelung." VALUE 0x60D0E TKW_VV_VV_SW 100.0 FORMULA_0000 0.0 1024.0000 /begin FUNCTION_LIST Klopfmessung /end FUNCTION_LIST /end CHARACTERISTIC
/begin CHARACTERISTIC K_KM_V_MESS_MAX "Maximalbegrenzung vom Ausgang der Verstaerkungsregelung." VALUE 0x60D10 TKW_VV_VV_SW 100.0 FORMULA_0000 0.0 1024.0000 /begin FUNCTION_LIST Klopfmessung /end FUNCTION_LIST /end CHARACTERISTIC
/begin CHARACTERISTIC K_KM_U_SOLL_REG_KR "Verstaerkung Sollspannungsregelung." VALUE 0x60D12 TKW_VV_VV_SW 100.0 FORMULA_0162 0.0 2.0000 /begin FUNCTION_LIST Klopfmessung /end FUNCTION_LIST FORMAT "%7.4" /end CHARACTERISTIC
/begin CHARACTERISTIC K_KM_U_MESS_REG_KR "Verstaerkung Erfassungsstufenregelung." VALUE 0x60D14 TKW_VV_VV_SW 100.0 FORMULA_0162 0.0 2.0000 /begin FUNCTION_LIST Klopfmessung /end FUNCTION_LIST FORMAT "%7.4" /end CHARACTERISTIC
/begin CHARACTERISTIC KL_KM_V_MESS_VORST_OFFS "Offsetvorsteuerung der Erfassungstufe." CURVE 0x60D16 TKL_SW_VV_SW 100.0 FORMULA_0000 0.0 1024.0000 /begin FUNCTION_LIST Klopfmessung /end FUNCTION_LIST
 /begin AXIS_DESCR STD_AXIS lam_delta_lim FORMULA_0004 8 -2.0000 1.9999 FORMAT "%6.3" /end AXIS_DESCR
/end CHARACTERISTIC
/begin CHARACTERISTIC KF_KM_ION_TZ_OFFS "Offset des Aussetzerfensters gegenueber dem Zuendwinkel." MAP 0x60D38 TKF_SW_SW_SW 100.0 FORMULA_0153 -360.0000 180.0000 /begin FUNCTION_LIST Klopfmessung /end FUNCTION_LIST /begin AXIS_DESCR STD_AXIS n FORMULA_0011 8 0.0 10000.0000 /end AXIS_DESCR /begin AXIS_DESCR STD_AXIS rf FORMULA_0006 8 0.0 2.0000 FORMAT "%6.3" /end AXIS_DESCR FORMAT "%4.1" /end CHARACTERISTIC
/begin CHARACTERISTIC KF_KM_KNOCK_TZ_OFFS "Offset des Klopffensters gegenueber dem Zuendwinkel." MAP 0x60DDA TKF_SW_SW_SW 100.0 FORMULA_0153 -360.0000 180.0000 /begin FUNCTION_LIST Klopfmessung /end FUNCTION_LIST /begin AXIS_DESCR STD_AXIS n FORMULA_0011 8 0.0 10000.0000 /end AXIS_DESCR /begin AXIS_DESCR STD_AXIS rf FORMULA_0006 8 0.0 2.0000 FORMAT "%6.3" /end AXIS_DESCR FORMAT "%4.1" /end CHARACTERISTIC
/begin CHARACTERISTIC KF_KM_ION_LAENGE "Laenge des Messfenster." MAP 0x60E7C TKF_SW_SW_SW 100.0 FORMULA_0153 -360.0000 180.0000 /begin FUNCTION_LIST Klopfmessung /end FUNCTION_LIST /begin AXIS_DESCR STD_AXIS n FORMULA_0011 8 0.0 10000.0000 /end AXIS_DESCR /begin AXIS_DESCR STD_AXIS rf FORMULA_0006 8 0.0 2.0000 FORMAT "%6.3" /end AXIS_DESCR FORMAT "%4.1" /end CHARACTERISTIC
/begin CHARACTERISTIC KF_KM_KNOCK_LAENGE "Laenge des Klopffenster." MAP 0x60F1E TKF_SW_SW_SW 100.0 FORMULA_0153 -360.0000 180.0000 /begin FUNCTION_LIST Klopfmessung /end FUNCTION_LIST /begin AXIS_DESCR STD_AXIS n FORMULA_0011 8 0.0 10000.0000 /end AXIS_DESCR /begin AXIS_DESCR STD_AXIS rf FORMULA_0006 8 0.0 2.0000 FORMAT "%6.3" /end AXIS_DESCR FORMAT "%4.1" /end CHARACTERISTIC
/begin CHARACTERISTIC TAB2D_ION_BP_A "Filterkoeffizienten A der Klopferkennung." MAP 0x60FC0 TKF_SW_SW_SL 100.0 FORMULA_0154 8.0000 7.9999 /begin FUNCTION_LIST Klopfmessung /end FUNCTION_LIST /begin AXIS_DESCR STD_AXIS n FORMULA_0011 10 0.0 10000.0000 /end AXIS_DESCR /begin AXIS_DESCR STD_AXIS x FORMULA_0000 4 1.0000 4.0000 /end AXIS_DESCR FORMAT "%7.4" /end CHARACTERISTIC
/begin CHARACTERISTIC TAB2D_ION_BP_B "Filterkoeffizienten B der Klopferkennung." MAP 0x61080 TKF_SW_SW_SL 100.0 FORMULA_0154 8.0000 7.9999 /begin FUNCTION_LIST Klopfmessung /end FUNCTION_LIST /begin AXIS_DESCR STD_AXIS n FORMULA_0011 10 0.0 10000.0000 /end AXIS_DESCR /begin AXIS_DESCR STD_AXIS x FORMULA_0000 4 1.0000 4.0000 /end AXIS_DESCR FORMAT "%7.4" /end CHARACTERISTIC
/begin CHARACTERISTIC TAB2D_ION_TP_A "Filterkoeffizienten A der Aussetzererkennung." MAP 0x61140 TKF_SW_SW_SL 100.0 FORMULA_0154 8.0000 7.9999 /begin FUNCTION_LIST Klopfmessung /end FUNCTION_LIST /begin AXIS_DESCR STD_AXIS n FORMULA_0011 10 0.0 10000.0000 /end AXIS_DESCR /begin AXIS_DESCR STD_AXIS x FORMULA_0000 4 1.0000 4.0000 /end AXIS_DESCR FORMAT "%7.4" /end CHARACTERISTIC
/begin CHARACTERISTIC TAB2D_ION_TP_B "Filterkoeffizienten B der Aussetzererkennung." MAP 0x61200 TKF_SW_SW_SL 100.0 FORMULA_0154 8.0000 7.9999 /begin FUNCTION_LIST Klopfmessung /end FUNCTION_LIST /begin AXIS_DESCR STD_AXIS n FORMULA_0011 10 0.0 10000.0000 /end AXIS_DESCR /begin AXIS_DESCR STD_AXIS x FORMULA_0000 4 1.0000 4.0000 /end AXIS_DESCR FORMAT "%7.4" /end CHARACTERISTIC
/begin CHARACTERISTIC KF_KM_V_MESS_VORST_BAS "Basisvorsteuereung der Erfassungstufe." MAP 0x612C0 TKF_SW_SW_SW 100.0 FORMULA_0000 0.0 1024.0000 /begin FUNCTION_LIST Klopfmessung /end FUNCTION_LIST /begin AXIS_DESCR STD_AXIS n FORMULA_0011 8 0.0 10000.0000 /end AXIS_DESCR /begin AXIS_DESCR STD_AXIS rf FORMULA_0006 8 0.0 2.0000 FORMAT "%6.3" /end AXIS_DESCR /end CHARACTERISTIC
/begin MEASUREMENT km_ion_tz_offs_1of2_ "Offsets vom Aussetzerfenster." SWORD FORMULA_0153 0 0 -360.0000 359.9000 ECU_ADDRESS 0x3FBBC8 /begin FUNCTION_LIST Klopfmessung /end FUNCTION_LIST /end MEASUREMENT
/begin MEASUREMENT km_ion_tz_offs_2of2_ "Offsets vom Aussetzerfenster." SWORD FORMULA_0153 0 0 -360.0000 359.9000 ECU_ADDRESS 0x3FBBCA /begin FUNCTION_LIST Klopfmessung /end FUNCTION_LIST /end MEASUREMENT
/begin MEASUREMENT km_knock_tz_offs_1of2_ "Offsets vom Klopffensters gegenueber dem Zuendwinkel." SWORD FORMULA_0153 0 0 -360.0000 359.9000 ECU_ADDRESS 0x3FBBCC /begin FUNCTION_LIST Klopfmessung /end FUNCTION_LIST /end MEASUREMENT
/begin MEASUREMENT km_knock_tz_offs_2of2_ "Offsets vom Klopffensters gegenueber dem Zuendwinkel." SWORD FORMULA_0153 0 0 -360.0000 359.9000 ECU_ADDRESS 0x3FBBCE /begin FUNCTION_LIST Klopfmessung /end FUNCTION_LIST /end MEASUREMENT
/begin MEASUREMENT km_ion_laenge_1of2_ "Laenge des Messfenster." SWORD FORMULA_0153 0 0 -360.0000 359.9000 ECU_ADDRESS 0x3FBBD0 /begin FUNCTION_LIST Klopfmessung /end FUNCTION_LIST /end MEASUREMENT
/begin MEASUREMENT km_ion_laenge_2of2_ "Laenge des Messfenster." SWORD FORMULA_0153 0 0 -360.0000 359.9000 ECU_ADDRESS 0x3FBBD2 /begin FUNCTION_LIST Klopfmessung /end FUNCTION_LIST /end MEASUREMENT
/begin MEASUREMENT km_knock_laenge_1of2_ "Laenge des Klopffenster." SWORD FORMULA_0153 0 0 -360.0000 359.9000 ECU_ADDRESS 0x3FBBD4 /begin FUNCTION_LIST Klopfmessung /end FUNCTION_LIST /end MEASUREMENT
/begin MEASUREMENT km_knock_laenge_2of2_ "Laenge des Klopffenster." SWORD FORMULA_0153 0 0 -360.0000 359.9000 ECU_ADDRESS 0x3FBBD6 /begin FUNCTION_LIST Klopfmessung /end FUNCTION_LIST /end MEASUREMENT
/begin MEASUREMENT km_ion_bp_a_1of4_ "BP-Filterkoeffizienten A." SLONG FORMULA_0154 0 0 8.0000 7.9999 ECU_ADDRESS 0x3FBBD8 /begin FUNCTION_LIST Klopfmessung /end FUNCTION_LIST /end MEASUREMENT
/begin MEASUREMENT km_ion_bp_a_2of4_ "BP-Filterkoeffizienten A." SLONG FORMULA_0154 0 0 8.0000 7.9999 ECU_ADDRESS 0x3FBBDC /begin FUNCTION_LIST Klopfmessung /end FUNCTION_LIST /end MEASUREMENT
/begin MEASUREMENT km_ion_bp_a_3of4_ "BP-Filterkoeffizienten A." SLONG FORMULA_0154 0 0 8.0000 7.9999 ECU_ADDRESS 0x3FBBE0 /begin FUNCTION_LIST Klopfmessung /end FUNCTION_LIST /end MEASUREMENT
/begin MEASUREMENT km_ion_bp_a_4of4_ "BP-Filterkoeffizienten A." SLONG FORMULA_0154 0 0 8.0000 7.9999 ECU_ADDRESS 0x3FBBE4 /begin FUNCTION_LIST Klopfmessung /end FUNCTION_LIST /end MEASUREMENT
/begin MEASUREMENT km_ion_bp_b_1of4_ "BP-Filterkoeffizienten B." SLONG FORMULA_0154 0 0 8.0000 7.9999 ECU_ADDRESS 0x3FBBE8 /begin FUNCTION_LIST Klopfmessung /end FUNCTION_LIST /end MEASUREMENT
/begin MEASUREMENT km_ion_bp_b_2of4_ "BP-Filterkoeffizienten B." SLONG FORMULA_0154 0 0 8.0000 7.9999 ECU_ADDRESS 0x3FBBEC /begin FUNCTION_LIST Klopfmessung /end FUNCTION_LIST /end MEASUREMENT
/begin MEASUREMENT km_ion_bp_b_3of4_ "BP-Filterkoeffizienten B." SLONG FORMULA_0154 0 0 8.0000 7.9999 ECU_ADDRESS 0x3FBBF0 /begin FUNCTION_LIST Klopfmessung /end FUNCTION_LIST /end MEASUREMENT
/begin MEASUREMENT km_ion_bp_b_4of4_ "BP-Filterkoeffizienten B." SLONG FORMULA_0154 0 0 8.0000 7.9999 ECU_ADDRESS 0x3FBBF4 /begin FUNCTION_LIST Klopfmessung /end FUNCTION_LIST /end MEASUREMENT
/begin MEASUREMENT km_ion_tp_a_1of4_ "TP-Filterkoeffizienten A." SLONG FORMULA_0154 0 0 8.0000 7.9999 ECU_ADDRESS 0x3FBBF8 /begin FUNCTION_LIST Klopfmessung /end FUNCTION_LIST /end MEASUREMENT
/begin MEASUREMENT km_ion_tp_a_2of4_ "TP-Filterkoeffizienten A." SLONG FORMULA_0154 0 0 8.0000 7.9999 ECU_ADDRESS 0x3FBBFC /begin FUNCTION_LIST Klopfmessung /end FUNCTION_LIST /end MEASUREMENT
/begin MEASUREMENT km_ion_tp_a_3of4_ "TP-Filterkoeffizienten A." SLONG FORMULA_0154 0 0 8.0000 7.9999 ECU_ADDRESS 0x3FBC00 /begin FUNCTION_LIST Klopfmessung /end FUNCTION_LIST /end MEASUREMENT
/begin MEASUREMENT km_ion_tp_a_4of4_ "TP-Filterkoeffizienten A." SLONG FORMULA_0154 0 0 8.0000 7.9999 ECU_ADDRESS 0x3FBC04 /begin FUNCTION_LIST Klopfmessung /end FUNCTION_LIST /end MEASUREMENT
/begin MEASUREMENT km_ion_tp_b_1of4_ "TP-Filterkoeffizienten B." SLONG FORMULA_0154 0 0 8.0000 7.9999 ECU_ADDRESS 0x3FBC08 /begin FUNCTION_LIST Klopfmessung /end FUNCTION_LIST /end MEASUREMENT
/begin MEASUREMENT km_ion_tp_b_2of4_ "TP-Filterkoeffizienten B." SLONG FORMULA_0154 0 0 8.0000 7.9999 ECU_ADDRESS 0x3FBC0C /begin FUNCTION_LIST Klopfmessung /end FUNCTION_LIST /end MEASUREMENT
/begin MEASUREMENT km_ion_tp_b_3of4_ "TP-Filterkoeffizienten B." SLONG FORMULA_0154 0 0 8.0000 7.9999 ECU_ADDRESS 0x3FBC10 /begin FUNCTION_LIST Klopfmessung /end FUNCTION_LIST /end MEASUREMENT
/begin MEASUREMENT km_ion_tp_b_4of4_ "TP-Filterkoeffizienten B." SLONG FORMULA_0154 0 0 8.0000 7.9999 ECU_ADDRESS 0x3FBC14 /begin FUNCTION_LIST Klopfmessung /end FUNCTION_LIST /end MEASUREMENT
/begin MEASUREMENT km_v_mess_vorst_bas_1of2_ "Basisvorsteuereung der Erfassungstufe." SWORD FORMULA_0000 0 0 0.0 1024.0000 ECU_ADDRESS 0x3FBC18 /begin FUNCTION_LIST Klopfmessung /end FUNCTION_LIST /end MEASUREMENT
/begin MEASUREMENT km_v_mess_vorst_bas_2of2_ "Basisvorsteuereung der Erfassungstufe." SWORD FORMULA_0000 0 0 0.0 1024.0000 ECU_ADDRESS 0x3FBC1A /begin FUNCTION_LIST Klopfmessung /end FUNCTION_LIST /end MEASUREMENT
/begin MEASUREMENT km_v_mess_vorst_offs_1of2_ "Offsetvorsteuerung der Erfassungstufe." SWORD FORMULA_0000 0 0 0.0 1024.0000 ECU_ADDRESS 0x3FBC1C /begin FUNCTION_LIST Klopfmessung /end FUNCTION_LIST /end MEASUREMENT
/begin MEASUREMENT km_v_mess_vorst_offs_2of2_ "Offsetvorsteuerung der Erfassungstufe." SWORD FORMULA_0000 0 0 0.0 1024.0000 ECU_ADDRESS 0x3FBC1E /begin FUNCTION_LIST Klopfmessung /end FUNCTION_LIST /end MEASUREMENT
/begin MEASUREMENT km_v_mess_vorst_1of2_ "Vorsteuerung der Erfassungstufe." SWORD FORMULA_0000 0 0 0.0 1024.0000 ECU_ADDRESS 0x3FBC20 /begin FUNCTION_LIST Klopfmessung /end FUNCTION_LIST /end MEASUREMENT
/begin MEASUREMENT km_v_mess_vorst_2of2_ "Vorsteuerung der Erfassungstufe." SWORD FORMULA_0000 0 0 0.0 1024.0000 ECU_ADDRESS 0x3FBC22 /begin FUNCTION_LIST Klopfmessung /end FUNCTION_LIST /end MEASUREMENT
/begin MEASUREMENT km_v_mess_st_1of12_ "Verstaerkungsstufe." SWORD FORMULA_0000 0 0 0.0 3.0000 ECU_ADDRESS 0x3FBC24 /begin FUNCTION_LIST Klopfmessung /end FUNCTION_LIST /end MEASUREMENT
/begin MEASUREMENT km_v_mess_st_2of12_ "Verstaerkungsstufe." SWORD FORMULA_0000 0 0 0.0 3.0000 ECU_ADDRESS 0x3FBC26 /begin FUNCTION_LIST Klopfmessung /end FUNCTION_LIST /end MEASUREMENT
/begin MEASUREMENT km_v_mess_st_3of12_ "Verstaerkungsstufe." SWORD FORMULA_0000 0 0 0.0 3.0000 ECU_ADDRESS 0x3FBC28 /begin FUNCTION_LIST Klopfmessung /end FUNCTION_LIST /end MEASUREMENT
/begin MEASUREMENT km_v_mess_st_4of12_ "Verstaerkungsstufe." SWORD FORMULA_0000 0 0 0.0 3.0000 ECU_ADDRESS 0x3FBC2A /begin FUNCTION_LIST Klopfmessung /end FUNCTION_LIST /end MEASUREMENT
/begin MEASUREMENT km_v_mess_st_5of12_ "Verstaerkungsstufe." SWORD FORMULA_0000 0 0 0.0 3.0000 ECU_ADDRESS 0x3FBC2C /begin FUNCTION_LIST Klopfmessung /end FUNCTION_LIST /end MEASUREMENT
/begin MEASUREMENT km_v_mess_st_6of12_ "Verstaerkungsstufe." SWORD FORMULA_0000 0 0 0.0 3.0000 ECU_ADDRESS 0x3FBC2E /begin FUNCTION_LIST Klopfmessung /end FUNCTION_LIST /end MEASUREMENT
/begin MEASUREMENT km_v_mess_st_7of12_ "Verstaerkungsstufe." SWORD FORMULA_0000 0 0 0.0 3.0000 ECU_ADDRESS 0x3FBC30 /begin FUNCTION_LIST Klopfmessung /end FUNCTION_LIST /end MEASUREMENT
/begin MEASUREMENT km_v_mess_st_8of12_ "Verstaerkungsstufe." SWORD FORMULA_0000 0 0 0.0 3.0000 ECU_ADDRESS 0x3FBC32 /begin FUNCTION_LIST Klopfmessung /end FUNCTION_LIST /end MEASUREMENT
/begin MEASUREMENT km_v_mess_st_9of12_ "Verstaerkungsstufe." SWORD FORMULA_0000 0 0 0.0 3.0000 ECU_ADDRESS 0x3FBC34 /begin FUNCTION_LIST Klopfmessung /end FUNCTION_LIST /end MEASUREMENT
/begin MEASUREMENT km_v_mess_st_10of12_ "Verstaerkungsstufe." SWORD FORMULA_0000 0 0 0.0 3.0000 ECU_ADDRESS 0x3FBC36 /begin FUNCTION_LIST Klopfmessung /end FUNCTION_LIST /end MEASUREMENT
/begin MEASUREMENT km_v_mess_st_11of12_ "Verstaerkungsstufe." SWORD FORMULA_0000 0 0 0.0 3.0000 ECU_ADDRESS 0x3FBC38 /begin FUNCTION_LIST Klopfmessung /end FUNCTION_LIST /end MEASUREMENT
/begin MEASUREMENT km_v_mess_st_12of12_ "Verstaerkungsstufe." SWORD FORMULA_0000 0 0 0.0 3.0000 ECU_ADDRESS 0x3FBC3A /begin FUNCTION_LIST Klopfmessung /end FUNCTION_LIST /end MEASUREMENT
/begin MEASUREMENT km_test_msg "Zusammengebauter SCI Wert" UBYTE FORMULA_0008 0 0 0.0 255.0000 ECU_ADDRESS 0x3FBC3C /begin FUNCTION_LIST Klopfmessung /end FUNCTION_LIST /end MEASUREMENT
/begin MEASUREMENT km_test_zyl "gerade gesendeter Zylinder" UBYTE FORMULA_0008 0 0 0.0 255.0000 ECU_ADDRESS 0x3FBC3D /begin FUNCTION_LIST Klopfmessung /end FUNCTION_LIST /end MEASUREMENT
/begin MEASUREMENT km_test_send_enable "Sender-Freigabe" UBYTE FORMULA_0155 0 0 0.0 255.0 ECU_ADDRESS 0x3FBC3E /begin FUNCTION_LIST Klopfmessung /end FUNCTION_LIST /end MEASUREMENT
/begin MEASUREMENT km_test_err_cnt "Fehlerzaehler SCI nicht mehr gestartet" UBYTE FORMULA_0008 0 0 0.0 255.0000 ECU_ADDRESS 0x3FBC3F /begin FUNCTION_LIST Klopfmessung /end FUNCTION_LIST /end MEASUREMENT
/begin MEASUREMENT km_test_msg_err "Fehlerzaehler Zuendpuls verkuerzt" UBYTE FORMULA_0008 0 0 0.0 255.0000 ECU_ADDRESS 0x3FBC40 /begin FUNCTION_LIST Klopfmessung /end FUNCTION_LIST /end MEASUREMENT
/begin MEASUREMENT km_b_v_mess_reg "Verstaerkungsregeler Aktivierung." UWORD FORMULA_0158 0 0 0.0 65535.0 ECU_ADDRESS 0x3FBC42 /begin FUNCTION_LIST Klopfmessung /end FUNCTION_LIST BIT_MASK 0xFFFF /end MEASUREMENT
/begin MEASUREMENT km_b_v_mess_reg_klopf "Verstaerkungsregelung im Klopfbereich." UWORD FORMULA_0159 0 0 0.0 65535.0 ECU_ADDRESS 0x3FBC44 /begin FUNCTION_LIST Klopfmessung /end FUNCTION_LIST BIT_MASK 0xFFFF /end MEASUREMENT
/begin MEASUREMENT km_b_v_mess_reg_auss "Verstaerkungsregelung im Aussetzerbereich." UWORD FORMULA_0160 0 0 0.0 65535.0 ECU_ADDRESS 0x3FBC46 /begin FUNCTION_LIST Klopfmessung /end FUNCTION_LIST BIT_MASK 0xFFFF /end MEASUREMENT
/begin MEASUREMENT km_u_ion_tp_max_1of12_ "Maximalwert des Tiefpassgefilterten Ionenspannung." SWORD FORMULA_0148 0 0 0.0 3.4436 ECU_ADDRESS 0x3FBC48 /begin FUNCTION_LIST Klopfmessung /end FUNCTION_LIST /end MEASUREMENT
/begin MEASUREMENT km_u_ion_tp_max_2of12_ "Maximalwert des Tiefpassgefilterten Ionenspannung." SWORD FORMULA_0148 0 0 0.0 3.4436 ECU_ADDRESS 0x3FBC4A /begin FUNCTION_LIST Klopfmessung /end FUNCTION_LIST /end MEASUREMENT
/begin MEASUREMENT km_u_ion_tp_max_3of12_ "Maximalwert des Tiefpassgefilterten Ionenspannung." SWORD FORMULA_0148 0 0 0.0 3.4436 ECU_ADDRESS 0x3FBC4C /begin FUNCTION_LIST Klopfmessung /end FUNCTION_LIST /end MEASUREMENT
/begin MEASUREMENT km_u_ion_tp_max_4of12_ "Maximalwert des Tiefpassgefilterten Ionenspannung." SWORD FORMULA_0148 0 0 0.0 3.4436 ECU_ADDRESS 0x3FBC4E /begin FUNCTION_LIST Klopfmessung /end FUNCTION_LIST /end MEASUREMENT
/begin MEASUREMENT km_u_ion_tp_max_5of12_ "Maximalwert des Tiefpassgefilterten Ionenspannung." SWORD FORMULA_0148 0 0 0.0 3.4436 ECU_ADDRESS 0x3FBC50 /begin FUNCTION_LIST Klopfmessung /end FUNCTION_LIST /end MEASUREMENT
/begin MEASUREMENT km_u_ion_tp_max_6of12_ "Maximalwert des Tiefpassgefilterten Ionenspannung." SWORD FORMULA_0148 0 0 0.0 3.4436 ECU_ADDRESS 0x3FBC52 /begin FUNCTION_LIST Klopfmessung /end FUNCTION_LIST /end MEASUREMENT
/begin MEASUREMENT km_u_ion_tp_max_7of12_ "Maximalwert des Tiefpassgefilterten Ionenspannung." SWORD FORMULA_0148 0 0 0.0 3.4436 ECU_ADDRESS 0x3FBC54 /begin FUNCTION_LIST Klopfmessung /end FUNCTION_LIST /end MEASUREMENT
/begin MEASUREMENT km_u_ion_tp_max_8of12_ "Maximalwert des Tiefpassgefilterten Ionenspannung." SWORD FORMULA_0148 0 0 0.0 3.4436 ECU_ADDRESS 0x3FBC56 /begin FUNCTION_LIST Klopfmessung /end FUNCTION_LIST /end MEASUREMENT
/begin MEASUREMENT km_u_ion_tp_max_9of12_ "Maximalwert des Tiefpassgefilterten Ionenspannung." SWORD FORMULA_0148 0 0 0.0 3.4436 ECU_ADDRESS 0x3FBC58 /begin FUNCTION_LIST Klopfmessung /end FUNCTION_LIST /end MEASUREMENT
/begin MEASUREMENT km_u_ion_tp_max_10of12_ "Maximalwert des Tiefpassgefilterten Ionenspannung." SWORD FORMULA_0148 0 0 0.0 3.4436 ECU_ADDRESS 0x3FBC5A /begin FUNCTION_LIST Klopfmessung /end FUNCTION_LIST /end MEASUREMENT
/begin MEASUREMENT km_u_ion_tp_max_11of12_ "Maximalwert des Tiefpassgefilterten Ionenspannung." SWORD FORMULA_0148 0 0 0.0 3.4436 ECU_ADDRESS 0x3FBC5C /begin FUNCTION_LIST Klopfmessung /end FUNCTION_LIST /end MEASUREMENT
/begin MEASUREMENT km_u_ion_tp_max_12of12_ "Maximalwert des Tiefpassgefilterten Ionenspannung." SWORD FORMULA_0148 0 0 0.0 3.4436 ECU_ADDRESS 0x3FBC5E /begin FUNCTION_LIST Klopfmessung /end FUNCTION_LIST /end MEASUREMENT
/begin MEASUREMENT km_u_ion_soll_reg_1of12_ "Regeleingriff Sollspannungsregelung." SWORD FORMULA_0148 0 0 0.0 3.4436 ECU_ADDRESS 0x3FBC60 /begin FUNCTION_LIST Klopfmessung /end FUNCTION_LIST /end MEASUREMENT
/begin MEASUREMENT km_u_ion_soll_reg_2of12_ "Regeleingriff Sollspannungsregelung." SWORD FORMULA_0148 0 0 0.0 3.4436 ECU_ADDRESS 0x3FBC62 /begin FUNCTION_LIST Klopfmessung /end FUNCTION_LIST /end MEASUREMENT
/begin MEASUREMENT km_u_ion_soll_reg_3of12_ "Regeleingriff Sollspannungsregelung." SWORD FORMULA_0148 0 0 0.0 3.4436 ECU_ADDRESS 0x3FBC64 /begin FUNCTION_LIST Klopfmessung /end FUNCTION_LIST /end MEASUREMENT
/begin MEASUREMENT km_u_ion_soll_reg_4of12_ "Regeleingriff Sollspannungsregelung." SWORD FORMULA_0148 0 0 0.0 3.4436 ECU_ADDRESS 0x3FBC66 /begin FUNCTION_LIST Klopfmessung /end FUNCTION_LIST /end MEASUREMENT
/begin MEASUREMENT km_u_ion_soll_reg_5of12_ "Regeleingriff Sollspannungsregelung." SWORD FORMULA_0148 0 0 0.0 3.4436 ECU_ADDRESS 0x3FBC68 /begin FUNCTION_LIST Klopfmessung /end FUNCTION_LIST /end MEASUREMENT
/begin MEASUREMENT km_u_ion_soll_reg_6of12_ "Regeleingriff Sollspannungsregelung." SWORD FORMULA_0148 0 0 0.0 3.4436 ECU_ADDRESS 0x3FBC6A /begin FUNCTION_LIST Klopfmessung /end FUNCTION_LIST /end MEASUREMENT
/begin MEASUREMENT km_u_ion_soll_reg_7of12_ "Regeleingriff Sollspannungsregelung." SWORD FORMULA_0148 0 0 0.0 3.4436 ECU_ADDRESS 0x3FBC6C /begin FUNCTION_LIST Klopfmessung /end FUNCTION_LIST /end MEASUREMENT
/begin MEASUREMENT km_u_ion_soll_reg_8of12_ "Regeleingriff Sollspannungsregelung." SWORD FORMULA_0148 0 0 0.0 3.4436 ECU_ADDRESS 0x3FBC6E /begin FUNCTION_LIST Klopfmessung /end FUNCTION_LIST /end MEASUREMENT
/begin MEASUREMENT km_u_ion_soll_reg_9of12_ "Regeleingriff Sollspannungsregelung." SWORD FORMULA_0148 0 0 0.0 3.4436 ECU_ADDRESS 0x3FBC70 /begin FUNCTION_LIST Klopfmessung /end FUNCTION_LIST /end MEASUREMENT
/begin MEASUREMENT km_u_ion_soll_reg_10of12_ "Regeleingriff Sollspannungsregelung." SWORD FORMULA_0148 0 0 0.0 3.4436 ECU_ADDRESS 0x3FBC72 /begin FUNCTION_LIST Klopfmessung /end FUNCTION_LIST /end MEASUREMENT
/begin MEASUREMENT km_u_ion_soll_reg_11of12_ "Regeleingriff Sollspannungsregelung." SWORD FORMULA_0148 0 0 0.0 3.4436 ECU_ADDRESS 0x3FBC74 /begin FUNCTION_LIST Klopfmessung /end FUNCTION_LIST /end MEASUREMENT
/begin MEASUREMENT km_u_ion_soll_reg_12of12_ "Regeleingriff Sollspannungsregelung." SWORD FORMULA_0148 0 0 0.0 3.4436 ECU_ADDRESS 0x3FBC76 /begin FUNCTION_LIST Klopfmessung /end FUNCTION_LIST /end MEASUREMENT
/begin MEASUREMENT km_u_soll_diff_1of12_ "Regeldifferenz Sollspannungsregelung." SWORD FORMULA_0148 0 0 0.0 3.4436 ECU_ADDRESS 0x3FBC90 /begin FUNCTION_LIST Klopfmessung /end FUNCTION_LIST /end MEASUREMENT
/begin MEASUREMENT km_u_soll_diff_2of12_ "Regeldifferenz Sollspannungsregelung." SWORD FORMULA_0148 0 0 0.0 3.4436 ECU_ADDRESS 0x3FBC92 /begin FUNCTION_LIST Klopfmessung /end FUNCTION_LIST /end MEASUREMENT
/begin MEASUREMENT km_u_soll_diff_3of12_ "Regeldifferenz Sollspannungsregelung." SWORD FORMULA_0148 0 0 0.0 3.4436 ECU_ADDRESS 0x3FBC94 /begin FUNCTION_LIST Klopfmessung /end FUNCTION_LIST /end MEASUREMENT
/begin MEASUREMENT km_u_soll_diff_4of12_ "Regeldifferenz Sollspannungsregelung." SWORD FORMULA_0148 0 0 0.0 3.4436 ECU_ADDRESS 0x3FBC96 /begin FUNCTION_LIST Klopfmessung /end FUNCTION_LIST /end MEASUREMENT
/begin MEASUREMENT km_u_soll_diff_5of12_ "Regeldifferenz Sollspannungsregelung." SWORD FORMULA_0148 0 0 0.0 3.4436 ECU_ADDRESS 0x3FBC98 /begin FUNCTION_LIST Klopfmessung /end FUNCTION_LIST /end MEASUREMENT
/begin MEASUREMENT km_u_soll_diff_6of12_ "Regeldifferenz Sollspannungsregelung." SWORD FORMULA_0148 0 0 0.0 3.4436 ECU_ADDRESS 0x3FBC9A /begin FUNCTION_LIST Klopfmessung /end FUNCTION_LIST /end MEASUREMENT
/begin MEASUREMENT km_u_soll_diff_7of12_ "Regeldifferenz Sollspannungsregelung." SWORD FORMULA_0148 0 0 0.0 3.4436 ECU_ADDRESS 0x3FBC9C /begin FUNCTION_LIST Klopfmessung /end FUNCTION_LIST /end MEASUREMENT
/begin MEASUREMENT km_u_soll_diff_8of12_ "Regeldifferenz Sollspannungsregelung." SWORD FORMULA_0148 0 0 0.0 3.4436 ECU_ADDRESS 0x3FBC9E /begin FUNCTION_LIST Klopfmessung /end FUNCTION_LIST /end MEASUREMENT
/begin MEASUREMENT km_u_soll_diff_9of12_ "Regeldifferenz Sollspannungsregelung." SWORD FORMULA_0148 0 0 0.0 3.4436 ECU_ADDRESS 0x3FBCA0 /begin FUNCTION_LIST Klopfmessung /end FUNCTION_LIST /end MEASUREMENT
/begin MEASUREMENT km_u_soll_diff_10of12_ "Regeldifferenz Sollspannungsregelung." SWORD FORMULA_0148 0 0 0.0 3.4436 ECU_ADDRESS 0x3FBCA2 /begin FUNCTION_LIST Klopfmessung /end FUNCTION_LIST /end MEASUREMENT
/begin MEASUREMENT km_u_soll_diff_11of12_ "Regeldifferenz Sollspannungsregelung." SWORD FORMULA_0148 0 0 0.0 3.4436 ECU_ADDRESS 0x3FBCA4 /begin FUNCTION_LIST Klopfmessung /end FUNCTION_LIST /end MEASUREMENT
/begin MEASUREMENT km_u_soll_diff_12of12_ "Regeldifferenz Sollspannungsregelung." SWORD FORMULA_0148 0 0 0.0 3.4436 ECU_ADDRESS 0x3FBCA6 /begin FUNCTION_LIST Klopfmessung /end FUNCTION_LIST /end MEASUREMENT
/begin MEASUREMENT km_u_ion_soll_1of12_ "Berechneter Sollspanung." SWORD FORMULA_0148 0 0 0.0 3.4436 ECU_ADDRESS 0x3FBCC0 /begin FUNCTION_LIST Klopfmessung /end FUNCTION_LIST /end MEASUREMENT
/begin MEASUREMENT km_u_ion_soll_2of12_ "Berechneter Sollspanung." SWORD FORMULA_0148 0 0 0.0 3.4436 ECU_ADDRESS 0x3FBCC2 /begin FUNCTION_LIST Klopfmessung /end FUNCTION_LIST /end MEASUREMENT
/begin MEASUREMENT km_u_ion_soll_3of12_ "Berechneter Sollspanung." SWORD FORMULA_0148 0 0 0.0 3.4436 ECU_ADDRESS 0x3FBCC4 /begin FUNCTION_LIST Klopfmessung /end FUNCTION_LIST /end MEASUREMENT
/begin MEASUREMENT km_u_ion_soll_4of12_ "Berechneter Sollspanung." SWORD FORMULA_0148 0 0 0.0 3.4436 ECU_ADDRESS 0x3FBCC6 /begin FUNCTION_LIST Klopfmessung /end FUNCTION_LIST /end MEASUREMENT
/begin MEASUREMENT km_u_ion_soll_5of12_ "Berechneter Sollspanung." SWORD FORMULA_0148 0 0 0.0 3.4436 ECU_ADDRESS 0x3FBCC8 /begin FUNCTION_LIST Klopfmessung /end FUNCTION_LIST /end MEASUREMENT
/begin MEASUREMENT km_u_ion_soll_6of12_ "Berechneter Sollspanung." SWORD FORMULA_0148 0 0 0.0 3.4436 ECU_ADDRESS 0x3FBCCA /begin FUNCTION_LIST Klopfmessung /end FUNCTION_LIST /end MEASUREMENT
/begin MEASUREMENT km_u_ion_soll_7of12_ "Berechneter Sollspanung." SWORD FORMULA_0148 0 0 0.0 3.4436 ECU_ADDRESS 0x3FBCCC /begin FUNCTION_LIST Klopfmessung /end FUNCTION_LIST /end MEASUREMENT
/begin MEASUREMENT km_u_ion_soll_8of12_ "Berechneter Sollspanung." SWORD FORMULA_0148 0 0 0.0 3.4436 ECU_ADDRESS 0x3FBCCE /begin FUNCTION_LIST Klopfmessung /end FUNCTION_LIST /end MEASUREMENT
/begin MEASUREMENT km_u_ion_soll_9of12_ "Berechneter Sollspanung." SWORD FORMULA_0148 0 0 0.0 3.4436 ECU_ADDRESS 0x3FBCD0 /begin FUNCTION_LIST Klopfmessung /end FUNCTION_LIST /end MEASUREMENT
/begin MEASUREMENT km_u_ion_soll_10of12_ "Berechneter Sollspanung." SWORD FORMULA_0148 0 0 0.0 3.4436 ECU_ADDRESS 0x3FBCD2 /begin FUNCTION_LIST Klopfmessung /end FUNCTION_LIST /end MEASUREMENT
/begin MEASUREMENT km_u_ion_soll_11of12_ "Berechneter Sollspanung." SWORD FORMULA_0148 0 0 0.0 3.4436 ECU_ADDRESS 0x3FBCD4 /begin FUNCTION_LIST Klopfmessung /end FUNCTION_LIST /end MEASUREMENT
/begin MEASUREMENT km_u_ion_soll_12of12_ "Berechneter Sollspanung." SWORD FORMULA_0148 0 0 0.0 3.4436 ECU_ADDRESS 0x3FBCD6 /begin FUNCTION_LIST Klopfmessung /end FUNCTION_LIST /end MEASUREMENT
/begin MEASUREMENT km_v_mess_reg_1of12_ "Regeleingriff Erfassungstufenregler." SWORD FORMULA_0000 0 0 -1024.0000 1024.0000 ECU_ADDRESS 0x3FBCD8 /begin FUNCTION_LIST Klopfmessung /end FUNCTION_LIST /end MEASUREMENT
/begin MEASUREMENT km_v_mess_reg_2of12_ "Regeleingriff Erfassungstufenregler." SWORD FORMULA_0000 0 0 -1024.0000 1024.0000 ECU_ADDRESS 0x3FBCDA /begin FUNCTION_LIST Klopfmessung /end FUNCTION_LIST /end MEASUREMENT
/begin MEASUREMENT km_v_mess_reg_3of12_ "Regeleingriff Erfassungstufenregler." SWORD FORMULA_0000 0 0 -1024.0000 1024.0000 ECU_ADDRESS 0x3FBCDC /begin FUNCTION_LIST Klopfmessung /end FUNCTION_LIST /end MEASUREMENT
/begin MEASUREMENT km_v_mess_reg_4of12_ "Regeleingriff Erfassungstufenregler." SWORD FORMULA_0000 0 0 -1024.0000 1024.0000 ECU_ADDRESS 0x3FBCDE /begin FUNCTION_LIST Klopfmessung /end FUNCTION_LIST /end MEASUREMENT
/begin MEASUREMENT km_v_mess_reg_5of12_ "Regeleingriff Erfassungstufenregler." SWORD FORMULA_0000 0 0 -1024.0000 1024.0000 ECU_ADDRESS 0x3FBCE0 /begin FUNCTION_LIST Klopfmessung /end FUNCTION_LIST /end MEASUREMENT
/begin MEASUREMENT km_v_mess_reg_6of12_ "Regeleingriff Erfassungstufenregler." SWORD FORMULA_0000 0 0 -1024.0000 1024.0000 ECU_ADDRESS 0x3FBCE2 /begin FUNCTION_LIST Klopfmessung /end FUNCTION_LIST /end MEASUREMENT
/begin MEASUREMENT km_v_mess_reg_7of12_ "Regeleingriff Erfassungstufenregler." SWORD FORMULA_0000 0 0 -1024.0000 1024.0000 ECU_ADDRESS 0x3FBCE4 /begin FUNCTION_LIST Klopfmessung /end FUNCTION_LIST /end MEASUREMENT
/begin MEASUREMENT km_v_mess_reg_8of12_ "Regeleingriff Erfassungstufenregler." SWORD FORMULA_0000 0 0 -1024.0000 1024.0000 ECU_ADDRESS 0x3FBCE6 /begin FUNCTION_LIST Klopfmessung /end FUNCTION_LIST /end MEASUREMENT
/begin MEASUREMENT km_v_mess_reg_9of12_ "Regeleingriff Erfassungstufenregler." SWORD FORMULA_0000 0 0 -1024.0000 1024.0000 ECU_ADDRESS 0x3FBCE8 /begin FUNCTION_LIST Klopfmessung /end FUNCTION_LIST /end MEASUREMENT
/begin MEASUREMENT km_v_mess_reg_10of12_ "Regeleingriff Erfassungstufenregler." SWORD FORMULA_0000 0 0 -1024.0000 1024.0000 ECU_ADDRESS 0x3FBCEA /begin FUNCTION_LIST Klopfmessung /end FUNCTION_LIST /end MEASUREMENT
/begin MEASUREMENT km_v_mess_reg_11of12_ "Regeleingriff Erfassungstufenregler." SWORD FORMULA_0000 0 0 -1024.0000 1024.0000 ECU_ADDRESS 0x3FBCEC /begin FUNCTION_LIST Klopfmessung /end FUNCTION_LIST /end MEASUREMENT
/begin MEASUREMENT km_v_mess_reg_12of12_ "Regeleingriff Erfassungstufenregler." SWORD FORMULA_0000 0 0 -1024.0000 1024.0000 ECU_ADDRESS 0x3FBCEE /begin FUNCTION_LIST Klopfmessung /end FUNCTION_LIST /end MEASUREMENT
/begin MEASUREMENT km_v_mess_1of12_ "Erfassungstufe." SWORD FORMULA_0000 0 0 0.0 1024.0000 ECU_ADDRESS 0x3FBD38 /begin FUNCTION_LIST Klopfmessung /end FUNCTION_LIST /end MEASUREMENT
/begin MEASUREMENT km_v_mess_2of12_ "Erfassungstufe." SWORD FORMULA_0000 0 0 0.0 1024.0000 ECU_ADDRESS 0x3FBD3A /begin FUNCTION_LIST Klopfmessung /end FUNCTION_LIST /end MEASUREMENT
/begin MEASUREMENT km_v_mess_3of12_ "Erfassungstufe." SWORD FORMULA_0000 0 0 0.0 1024.0000 ECU_ADDRESS 0x3FBD3C /begin FUNCTION_LIST Klopfmessung /end FUNCTION_LIST /end MEASUREMENT
/begin MEASUREMENT km_v_mess_4of12_ "Erfassungstufe." SWORD FORMULA_0000 0 0 0.0 1024.0000 ECU_ADDRESS 0x3FBD3E /begin FUNCTION_LIST Klopfmessung /end FUNCTION_LIST /end MEASUREMENT
/begin MEASUREMENT km_v_mess_5of12_ "Erfassungstufe." SWORD FORMULA_0000 0 0 0.0 1024.0000 ECU_ADDRESS 0x3FBD40 /begin FUNCTION_LIST Klopfmessung /end FUNCTION_LIST /end MEASUREMENT
/begin MEASUREMENT km_v_mess_6of12_ "Erfassungstufe." SWORD FORMULA_0000 0 0 0.0 1024.0000 ECU_ADDRESS 0x3FBD42 /begin FUNCTION_LIST Klopfmessung /end FUNCTION_LIST /end MEASUREMENT
/begin MEASUREMENT km_v_mess_7of12_ "Erfassungstufe." SWORD FORMULA_0000 0 0 0.0 1024.0000 ECU_ADDRESS 0x3FBD44 /begin FUNCTION_LIST Klopfmessung /end FUNCTION_LIST /end MEASUREMENT
/begin MEASUREMENT km_v_mess_8of12_ "Erfassungstufe." SWORD FORMULA_0000 0 0 0.0 1024.0000 ECU_ADDRESS 0x3FBD46 /begin FUNCTION_LIST Klopfmessung /end FUNCTION_LIST /end MEASUREMENT
/begin MEASUREMENT km_v_mess_9of12_ "Erfassungstufe." SWORD FORMULA_0000 0 0 0.0 1024.0000 ECU_ADDRESS 0x3FBD48 /begin FUNCTION_LIST Klopfmessung /end FUNCTION_LIST /end MEASUREMENT
/begin MEASUREMENT km_v_mess_10of12_ "Erfassungstufe." SWORD FORMULA_0000 0 0 0.0 1024.0000 ECU_ADDRESS 0x3FBD4A /begin FUNCTION_LIST Klopfmessung /end FUNCTION_LIST /end MEASUREMENT
/begin MEASUREMENT km_v_mess_11of12_ "Erfassungstufe." SWORD FORMULA_0000 0 0 0.0 1024.0000 ECU_ADDRESS 0x3FBD4C /begin FUNCTION_LIST Klopfmessung /end FUNCTION_LIST /end MEASUREMENT
/begin MEASUREMENT km_v_mess_12of12_ "Erfassungstufe." SWORD FORMULA_0000 0 0 0.0 1024.0000 ECU_ADDRESS 0x3FBD4E /begin FUNCTION_LIST Klopfmessung /end FUNCTION_LIST /end MEASUREMENT
/* ------------------ Abschnitt erzeugt aus kr.dat ------------------ */
/begin CHARACTERISTIC K_KR_SCHLT "Schalter Freigabe Klopferkennung: 0 = Aus; 1 = Aktiv" VALUE 0x61362 TKW_VV_VV_UB 100.0 FORMULA_0008 0.0 1.0000 /begin FUNCTION_LIST Klopfregelung /end FUNCTION_LIST /end CHARACTERISTIC
/begin CHARACTERISTIC KL_KR_INT_MAX_FAKT "Kennlinie Korrekturfaktor Klopfschwelle." CURVE 0x61364 TKL_SW_VV_SW 100.0 FORMULA_0035 -32.0000 31.9990 /begin FUNCTION_LIST Klopfregelung /end FUNCTION_LIST
 /begin AXIS_DESCR STD_AXIS km_u_soll_diff FORMULA_0148 6 0.0 3.4436 FORMAT "%6.3" /end AXIS_DESCR
 FORMAT "%6.3" /end CHARACTERISTIC
/begin CHARACTERISTIC KF_KR_INT_MAX "Klopfschwelle." MAP 0x6137E TKF_SW_SW_SW 100.0 FORMULA_0166 -32768.0000 32767.0000 /begin FUNCTION_LIST Klopfregelung /end FUNCTION_LIST /begin AXIS_DESCR STD_AXIS n FORMULA_0011 8 0.0 10000.0000 /end AXIS_DESCR /begin AXIS_DESCR STD_AXIS rf FORMULA_0006 8 0.0 2.0000 FORMAT "%6.3" /end AXIS_DESCR FORMAT "%6.3" /end CHARACTERISTIC
/begin MEASUREMENT kr_zustand "Zustandsvariable Klopferkennung." UWORD FORMULA_0163 0 0 0.0 65535.0 ECU_ADDRESS 0x3FBD50 /begin FUNCTION_LIST Klopfregelung /end FUNCTION_LIST BIT_MASK 0xFFFF /end MEASUREMENT
/begin MEASUREMENT kr_i_ion_pb_int_1of12_ "Klopfintegral." SLONG FORMULA_0164 0 0 -2147483648.0000 2147483647.0000 ECU_ADDRESS 0x3FBD54 /begin FUNCTION_LIST Klopfregelung /end FUNCTION_LIST /end MEASUREMENT
/begin MEASUREMENT kr_i_ion_pb_int_2of12_ "Klopfintegral." SLONG FORMULA_0164 0 0 -2147483648.0000 2147483647.0000 ECU_ADDRESS 0x3FBD58 /begin FUNCTION_LIST Klopfregelung /end FUNCTION_LIST /end MEASUREMENT
/begin MEASUREMENT kr_i_ion_pb_int_3of12_ "Klopfintegral." SLONG FORMULA_0164 0 0 -2147483648.0000 2147483647.0000 ECU_ADDRESS 0x3FBD5C /begin FUNCTION_LIST Klopfregelung /end FUNCTION_LIST /end MEASUREMENT
/begin MEASUREMENT kr_i_ion_pb_int_4of12_ "Klopfintegral." SLONG FORMULA_0164 0 0 -2147483648.0000 2147483647.0000 ECU_ADDRESS 0x3FBD60 /begin FUNCTION_LIST Klopfregelung /end FUNCTION_LIST /end MEASUREMENT
/begin MEASUREMENT kr_i_ion_pb_int_5of12_ "Klopfintegral." SLONG FORMULA_0164 0 0 -2147483648.0000 2147483647.0000 ECU_ADDRESS 0x3FBD64 /begin FUNCTION_LIST Klopfregelung /end FUNCTION_LIST /end MEASUREMENT
/begin MEASUREMENT kr_i_ion_pb_int_6of12_ "Klopfintegral." SLONG FORMULA_0164 0 0 -2147483648.0000 2147483647.0000 ECU_ADDRESS 0x3FBD68 /begin FUNCTION_LIST Klopfregelung /end FUNCTION_LIST /end MEASUREMENT
/begin MEASUREMENT kr_i_ion_pb_int_7of12_ "Klopfintegral." SLONG FORMULA_0164 0 0 -2147483648.0000 2147483647.0000 ECU_ADDRESS 0x3FBD6C /begin FUNCTION_LIST Klopfregelung /end FUNCTION_LIST /end MEASUREMENT
/begin MEASUREMENT kr_i_ion_pb_int_8of12_ "Klopfintegral." SLONG FORMULA_0164 0 0 -2147483648.0000 2147483647.0000 ECU_ADDRESS 0x3FBD70 /begin FUNCTION_LIST Klopfregelung /end FUNCTION_LIST /end MEASUREMENT
/begin MEASUREMENT kr_i_ion_pb_int_9of12_ "Klopfintegral." SLONG FORMULA_0164 0 0 -2147483648.0000 2147483647.0000 ECU_ADDRESS 0x3FBD74 /begin FUNCTION_LIST Klopfregelung /end FUNCTION_LIST /end MEASUREMENT
/begin MEASUREMENT kr_i_ion_pb_int_10of12_ "Klopfintegral." SLONG FORMULA_0164 0 0 -2147483648.0000 2147483647.0000 ECU_ADDRESS 0x3FBD78 /begin FUNCTION_LIST Klopfregelung /end FUNCTION_LIST /end MEASUREMENT
/begin MEASUREMENT kr_i_ion_pb_int_11of12_ "Klopfintegral." SLONG FORMULA_0164 0 0 -2147483648.0000 2147483647.0000 ECU_ADDRESS 0x3FBD7C /begin FUNCTION_LIST Klopfregelung /end FUNCTION_LIST /end MEASUREMENT
/begin MEASUREMENT kr_i_ion_pb_int_12of12_ "Klopfintegral." SLONG FORMULA_0164 0 0 -2147483648.0000 2147483647.0000 ECU_ADDRESS 0x3FBD80 /begin FUNCTION_LIST Klopfregelung /end FUNCTION_LIST /end MEASUREMENT
/begin MEASUREMENT kr_int_max_korr "Korrigiert Klopfschwelle." SWORD FORMULA_0165 0 0 -32768.0000 32767.0000 ECU_ADDRESS 0x3FBD84 /begin FUNCTION_LIST Klopfregelung /end FUNCTION_LIST /end MEASUREMENT
/begin MEASUREMENT kr_int_rel_1of12_ "Normierte Klopfintensitaet." SWORD FORMULA_0035 0 0 0.0 5.0000 ECU_ADDRESS 0x3FBD86 /begin FUNCTION_LIST Klopfregelung /end FUNCTION_LIST /end MEASUREMENT
/begin MEASUREMENT kr_int_rel_2of12_ "Normierte Klopfintensitaet." SWORD FORMULA_0035 0 0 0.0 5.0000 ECU_ADDRESS 0x3FBD88 /begin FUNCTION_LIST Klopfregelung /end FUNCTION_LIST /end MEASUREMENT
/begin MEASUREMENT kr_int_rel_3of12_ "Normierte Klopfintensitaet." SWORD FORMULA_0035 0 0 0.0 5.0000 ECU_ADDRESS 0x3FBD8A /begin FUNCTION_LIST Klopfregelung /end FUNCTION_LIST /end MEASUREMENT
/begin MEASUREMENT kr_int_rel_4of12_ "Normierte Klopfintensitaet." SWORD FORMULA_0035 0 0 0.0 5.0000 ECU_ADDRESS 0x3FBD8C /begin FUNCTION_LIST Klopfregelung /end FUNCTION_LIST /end MEASUREMENT
/begin MEASUREMENT kr_int_rel_5of12_ "Normierte Klopfintensitaet." SWORD FORMULA_0035 0 0 0.0 5.0000 ECU_ADDRESS 0x3FBD8E /begin FUNCTION_LIST Klopfregelung /end FUNCTION_LIST /end MEASUREMENT
/begin MEASUREMENT kr_int_rel_6of12_ "Normierte Klopfintensitaet." SWORD FORMULA_0035 0 0 0.0 5.0000 ECU_ADDRESS 0x3FBD90 /begin FUNCTION_LIST Klopfregelung /end FUNCTION_LIST /end MEASUREMENT
/begin MEASUREMENT kr_int_rel_7of12_ "Normierte Klopfintensitaet." SWORD FORMULA_0035 0 0 0.0 5.0000 ECU_ADDRESS 0x3FBD92 /begin FUNCTION_LIST Klopfregelung /end FUNCTION_LIST /end MEASUREMENT
/begin MEASUREMENT kr_int_rel_8of12_ "Normierte Klopfintensitaet." SWORD FORMULA_0035 0 0 0.0 5.0000 ECU_ADDRESS 0x3FBD94 /begin FUNCTION_LIST Klopfregelung /end FUNCTION_LIST /end MEASUREMENT
/begin MEASUREMENT kr_int_rel_9of12_ "Normierte Klopfintensitaet." SWORD FORMULA_0035 0 0 0.0 5.0000 ECU_ADDRESS 0x3FBD96 /begin FUNCTION_LIST Klopfregelung /end FUNCTION_LIST /end MEASUREMENT
/begin MEASUREMENT kr_int_rel_10of12_ "Normierte Klopfintensitaet." SWORD FORMULA_0035 0 0 0.0 5.0000 ECU_ADDRESS 0x3FBD98 /begin FUNCTION_LIST Klopfregelung /end FUNCTION_LIST /end MEASUREMENT
/begin MEASUREMENT kr_int_rel_11of12_ "Normierte Klopfintensitaet." SWORD FORMULA_0035 0 0 0.0 5.0000 ECU_ADDRESS 0x3FBD9A /begin FUNCTION_LIST Klopfregelung /end FUNCTION_LIST /end MEASUREMENT
/begin MEASUREMENT kr_int_rel_12of12_ "Normierte Klopfintensitaet." SWORD FORMULA_0035 0 0 0.0 5.0000 ECU_ADDRESS 0x3FBD9C /begin FUNCTION_LIST Klopfregelung /end FUNCTION_LIST /end MEASUREMENT
/* ------------------ Abschnitt erzeugt aus n_ign.dat ------------------ */
/begin CHARACTERISTIC K_N_OBERGRENZE "Plausibilitätsgrenze fuer die n-Erfassung" VALUE 0x62244 TKW_VV_VV_SW 100.0 FORMULA_0011 0.0 20000.0000 /begin FUNCTION_LIST Drehzahlerfassung /end FUNCTION_LIST /end CHARACTERISTIC
/begin CHARACTERISTIC K_N_ZEIT_STOERUNG "Einfrierzeit Drehzahlerfassung nach TPU Stoerung" VALUE 0x62246 TKW_VV_VV_SB 100.0 FORMULA_0196 0.0 1.2700 /begin FUNCTION_LIST Drehzahlerfassung /end FUNCTION_LIST /end CHARACTERISTIC
/begin MEASUREMENT n_ign "Ersatzdrehzahl des Zuendprozessors" SWORD FORMULA_0011 0 0 0.0 10000.0000 ECU_ADDRESS 0x3FBEDA /begin FUNCTION_LIST Drehzahlerfassung /end FUNCTION_LIST /end MEASUREMENT
/begin MEASUREMENT n_zahn "Drehzahl aus Zahnabstand" SWORD FORMULA_0011 0 0 0.0 10000.0000 ECU_ADDRESS 0x3FBEDC /begin FUNCTION_LIST Drehzahlerfassung /end FUNCTION_LIST /end MEASUREMENT
/begin MEASUREMENT n_segm1 "Drehzahl aus Segmentabstand Bank1" SWORD FORMULA_0011 0 0 0.0 10000.0000 ECU_ADDRESS 0x3FBEDE /begin FUNCTION_LIST Drehzahlerfassung /end FUNCTION_LIST /end MEASUREMENT
/begin MEASUREMENT n_segm2 "Drehzahl aus Segmentabstand Bank2" SWORD FORMULA_0011 0 0 0.0 10000.0000 ECU_ADDRESS 0x3FBEE0 /begin FUNCTION_LIST Drehzahlerfassung /end FUNCTION_LIST /end MEASUREMENT
/begin MEASUREMENT n_st "Status Drehzahlerfassung" UBYTE FORMULA_0195 0 0 0.0 255.0 ECU_ADDRESS 0x3FBEE2 /begin FUNCTION_LIST Drehzahlerfassung /end FUNCTION_LIST /end MEASUREMENT
/begin MEASUREMENT n_timer_stoerung "Zeitzaehler fuer Freeze Drehzahlerfassung" SBYTE FORMULA_0196 0 0 -1.2800 1.2700 ECU_ADDRESS 0x3FBEE3 /begin FUNCTION_LIST Drehzahlerfassung /end FUNCTION_LIST /end MEASUREMENT
/* ------------------ Abschnitt erzeugt aus td.dat ------------------ */
/begin CHARACTERISTIC K_TD_USE "Enable KIS: 0 = TD; 1 = KIS" VALUE 0x624DA TKW_VV_VV_UB 100.0 FORMULA_0008 0.0 1.0000 /begin FUNCTION_LIST KIS /end FUNCTION_LIST /end CHARACTERISTIC
/begin CHARACTERISTIC K_TD_START "Pulsstart." VALUE 0x624DC TKW_VV_VV_UW 100.0 FORMULA_0224 0.0 720.0000 /begin FUNCTION_LIST KIS /end FUNCTION_LIST FORMAT "%4.1" /end CHARACTERISTIC
/begin CHARACTERISTIC K_TD_LEN "Pulslaenge." VALUE 0x624DE TKW_VV_VV_UW 100.0 FORMULA_0224 0.0 720.0000 /begin FUNCTION_LIST KIS /end FUNCTION_LIST FORMAT "%4.1" /end CHARACTERISTIC
/begin CHARACTERISTIC K_TD_PERIOD "Pulsperiode." VALUE 0x624E0 TKW_VV_VV_UW 100.0 FORMULA_0224 0.0 720.0000 /begin FUNCTION_LIST KIS /end FUNCTION_LIST FORMAT "%4.1" /end CHARACTERISTIC
/begin FUNCTION Drehzahlerfassung "Drehzahlerfassung" /end FUNCTION
/begin FUNCTION EEPROM "EEPROM" /end FUNCTION
/begin FUNCTION Egas "Egas" /end FUNCTION
/begin FUNCTION Fuellungsregler "Fuellungsregler" /end FUNCTION
/begin FUNCTION Global "Global" /end FUNCTION
/begin FUNCTION Heimatlos "Heimatlos" /end FUNCTION
/begin FUNCTION Inter_Prozessor_Kommunikation "Inter_Prozessor_Kommunikation" /end FUNCTION
/begin FUNCTION KIS "KIS" /end FUNCTION
/begin FUNCTION Klopfadaption "Klopfadaption" /end FUNCTION
/begin FUNCTION Klopfmessung "Klopfmessung" /end FUNCTION
/begin FUNCTION Klopfregelung "Klopfregelung" /end FUNCTION
/begin RECORD_LAYOUT TKW_VV_VV_UB FNC_VALUES 1 UBYTE COLUMN_DIR DIRECT /end RECORD_LAYOUT
/begin RECORD_LAYOUT TKW_VV_VV_SB FNC_VALUES 1 SBYTE COLUMN_DIR DIRECT /end RECORD_LAYOUT
/begin RECORD_LAYOUT TKW_VV_VV_UW FNC_VALUES 1 UWORD COLUMN_DIR DIRECT /end RECORD_LAYOUT
/begin RECORD_LAYOUT TKW_VV_VV_SW FNC_VALUES 1 SWORD COLUMN_DIR DIRECT /end RECORD_LAYOUT
/begin RECORD_LAYOUT TKW_VV_VV_UL FNC_VALUES 1 ULONG COLUMN_DIR DIRECT /end RECORD_LAYOUT
/begin RECORD_LAYOUT TKL_SW_VV_UW NO_AXIS_PTS_X 1 UBYTE RESERVED 2 BYTE AXIS_PTS_X 3 SWORD INDEX_INCR DIRECT FNC_VALUES 4 UWORD COLUMN_DIR DIRECT /end RECORD_LAYOUT
/begin RECORD_LAYOUT TKL_SW_VV_SW NO_AXIS_PTS_X 1 UBYTE RESERVED 2 BYTE AXIS_PTS_X 3 SWORD INDEX_INCR DIRECT FNC_VALUES 4 SWORD COLUMN_DIR DIRECT /end RECORD_LAYOUT
/begin RECORD_LAYOUT TKF_SW_SW_UW NO_AXIS_PTS_X 1 UBYTE NO_AXIS_PTS_Y 2 UBYTE AXIS_PTS_X 3 SWORD INDEX_INCR DIRECT AXIS_PTS_Y 4 SWORD INDEX_INCR DIRECT FNC_VALUES 5 UWORD COLUMN_DIR DIRECT /end RECORD_LAYOUT
/begin RECORD_LAYOUT TKF_SW_SW_SW NO_AXIS_PTS_X 1 UBYTE NO_AXIS_PTS_Y 2 UBYTE AXIS_PTS_X 3 SWORD INDEX_INCR DIRECT AXIS_PTS_Y 4 SWORD INDEX_INCR DIRECT FNC_VALUES 5 SWORD COLUMN_DIR DIRECT /end RECORD_LAYOUT
/begin RECORD_LAYOUT TKF_SW_SW_SL NO_AXIS_PTS_X 1 UBYTE NO_AXIS_PTS_Y 2 UBYTE AXIS_PTS_X 3 SWORD INDEX_INCR DIRECT AXIS_PTS_Y 4 SWORD INDEX_INCR DIRECT FNC_VALUES 5 SLONG COLUMN_DIR DIRECT /end RECORD_LAYOUT
/end MODULE
/end PROJECT
