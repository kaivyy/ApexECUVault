ASAP2_VERSION 1 3
/begin PROJECT _725D601B "725D601B"
/begin HEADER "" VERSION "_725D601B" PROJECT_NO _725D601B /end HEADER
/begin MODULE DIM ""
/begin MOD_COMMON "" BYTE_ORDER MSB_FIRST ALIGNMENT_BYTE 1 ALIGNMENT_WORD 2 ALIGNMENT_LONG 2 ALIGNMENT_FLOAT32_IEEE 4 /end MOD_COMMON
/begin CHARACTERISTIC CDCANWSE "Codewort CARB: Auslaﬂnockenwelle- Endstufe" VAL_BLK 0xFD5D28 KwbWU16 65535.00 dez 0.00 65535.00 FORMAT "%8.2" NUMBER 4 /end CHARACTERISTIC
/begin CHARACTERISTIC CDCANWSE2 "Codewort CARB: Auslaﬂnockenwelle- Endstufe Bank2" VAL_BLK 0xFD5D30 KwbWU16 65535.00 dez 0.00 65535.00 FORMAT "%8.2" NUMBER 4 /end CHARACTERISTIC
/begin CHARACTERISTIC CDCDVAN "Codewort CARB: Fehler VVT-Anschlaglernen" VAL_BLK 0xFD5E78 KwbWU16 65535.00 DEZ 0.00 65535.00 FORMAT "%8.2" NUMBER 4 /end CHARACTERISTIC
/begin CHARACTERISTIC CDCDVCAN "Codewort CARB: Fehler CAN-Kommunikation" VAL_BLK 0xFD5E80 KwbWU16 65535.00 DEZ 0.00 65535.00 FORMAT "%8.2" NUMBER 4 /end CHARACTERISTIC
/begin CHARACTERISTIC CDCDVCAN2 "Codewort CARB: Fehler CAN-Kommunikation Bank 2" VAL_BLK 0xFD5E88 KwbWU16 65535.00 DEZ 0.00 65535.00 FORMAT "%8.2" NUMBER 4 /end CHARACTERISTIC
/begin CHARACTERISTIC CDCDVEST "Codewort CARB: Fehler Endstufe" VAL_BLK 0xFD5EC0 KwbWU16 65535.00 DEZ 0.00 65535.00 FORMAT "%8.2" NUMBER 4 /end CHARACTERISTIC
/begin CHARACTERISTIC CDCDVEST2 "Codewort CARB: Fehler Endstufe Bank 2" VAL_BLK 0xFD5EC8 KwbWU16 65535.00 DEZ 0.00 65535.00 FORMAT "%8.2" NUMBER 4 /end CHARACTERISTIC
/begin CHARACTERISTIC CDCDVFFS "Codewort CARB: Fehler Fuehrungssensor" VAL_BLK 0xFD5EF8 KwbWU16 65535.00 DEZ 0.00 65535.00 FORMAT "%8.2" NUMBER 4 /end CHARACTERISTIC
/begin CHARACTERISTIC CDCDVFFS2 "Codewort CARB: Fehler Fuehrungssensor Bank 2" VAL_BLK 0xFD5F00 KwbWU16 65535.00 DEZ 0.00 65535.00 FORMAT "%8.2" NUMBER 4 /end CHARACTERISTIC
/begin CHARACTERISTIC CDCDVFRS "Codewort CARB: Fehler Referenzsensor" VAL_BLK 0xFD5F08 KwbWU16 65535.00 DEZ 0.00 65535.00 FORMAT "%8.2" NUMBER 4 /end CHARACTERISTIC
/begin CHARACTERISTIC CDCDVFRS2 "Codewort CARB: Fehler Referenzsensor Bank 2" VAL_BLK 0xFD5F10 KwbWU16 65535.00 DEZ 0.00 65535.00 FORMAT "%8.2" NUMBER 4 /end CHARACTERISTIC
/begin CHARACTERISTIC CDCDVFSG "Codewort CARB: Fehler Steuergeraet intern" VAL_BLK 0xFD5F18 KwbWU16 65535.00 DEZ 0.00 65535.00 FORMAT "%8.2" NUMBER 4 /end CHARACTERISTIC
/begin CHARACTERISTIC CDCDVFSG2 "Codewort CARB: Fehler Steuergeraet intern Bank 2" VAL_BLK 0xFD5F20 KwbWU16 65535.00 DEZ 0.00 65535.00 FORMAT "%8.2" NUMBER 4 /end CHARACTERISTIC
/begin CHARACTERISTIC CDCDVLRN "Codewort CARB: Fehler Anschlaglernen" VAL_BLK 0xFD5F28 KwbWU16 65535.00 DEZ 0.00 65535.00 FORMAT "%8.2" NUMBER 4 /end CHARACTERISTIC
/begin CHARACTERISTIC CDCDVLRN2 "Codewort CARB: Fehler Anschlaglernen Bank 2" VAL_BLK 0xFD5F30 KwbWU16 65535.00 DEZ 0.00 65535.00 FORMAT "%8.2" NUMBER 4 /end CHARACTERISTIC
/begin CHARACTERISTIC CDCDVOVL "" VAL_BLK 0xFD5F38 KwbWU16 65535.00 DEZ 0.00 65535.00 FORMAT "%8.2" NUMBER 4 /end CHARACTERISTIC
/begin CHARACTERISTIC CDCDVOVL2 "" VAL_BLK 0xFD5F40 KwbWU16 65535.00 DEZ 0.00 65535.00 FORMAT "%8.2" NUMBER 4 /end CHARACTERISTIC
/begin CHARACTERISTIC CDCDVPLA "Codewort CARB: Fehler Sensorplausibilisierung" VAL_BLK 0xFD5F48 KwbWU16 65535.00 DEZ 0.00 65535.00 FORMAT "%8.2" NUMBER 4 /end CHARACTERISTIC
/begin CHARACTERISTIC CDCDVPLA2 "Codewort CARB: Fehler Sensorplausibilisierung Bank 2" VAL_BLK 0xFD5F50 KwbWU16 65535.00 DEZ 0.00 65535.00 FORMAT "%8.2" NUMBER 4 /end CHARACTERISTIC
/begin CHARACTERISTIC CDCDVPMN "Codewort CARB: Leistungsbegrenzung" VAL_BLK 0xFD5F58 KwbWU16 65535.00 DEZ 0.00 65535.00 FORMAT "%8.2" NUMBER 4 /end CHARACTERISTIC
/begin CHARACTERISTIC CDCDVSTE "Codewort CARB: Fehler Stellgliedueberwachung" VAL_BLK 0xFD5F60 KwbWU16 65535.00 DEZ 0.00 65535.00 FORMAT "%8.2" NUMBER 4 /end CHARACTERISTIC
/begin CHARACTERISTIC CDCDVSTE2 "Codewort CARB: Fehler Stellgliedueberwachung Bank 2" VAL_BLK 0xFD5F68 KwbWU16 65535.00 DEZ 0.00 65535.00 FORMAT "%8.2" NUMBER 4 /end CHARACTERISTIC
/begin CHARACTERISTIC CDCDVULV "Codewort CARB: Fehler Leistungsversorgung VVT" VAL_BLK 0xFD5F70 KwbWU16 65535.00 DEZ 0.00 65535.00 FORMAT "%8.2" NUMBER 4 /end CHARACTERISTIC
/begin CHARACTERISTIC CDCDVULV2 "Codewort CARB: Fehler Leistungsversorgung VVT Bank 2" VAL_BLK 0xFD5F78 KwbWU16 65535.00 DEZ 0.00 65535.00 FORMAT "%8.2" NUMBER 4 /end CHARACTERISTIC
/begin CHARACTERISTIC CDCDVUSE "Codewort CARB: Fehler Sensor-Versorgungsspannung" VAL_BLK 0xFD5F80 KwbWU16 65535.00 DEZ 0.00 65535.00 FORMAT "%8.2" NUMBER 4 /end CHARACTERISTIC
/begin CHARACTERISTIC CDCDVUSE2 "Codewort CARB: Fehler Sensor-Versorgungsspannung Bank 2" VAL_BLK 0xFD5F88 KwbWU16 65535.00 DEZ 0.00 65535.00 FORMAT "%8.2" NUMBER 4 /end CHARACTERISTIC
/begin CHARACTERISTIC CDCENWS "Codewort Carb: Nockenwellensteuerung Einlass Nockenwelle" VAL_BLK 0xFD5FF8 KwbWU16 65535.00 DEZ 0.00 65535.00 FORMAT "%8.2" NUMBER 4 /end CHARACTERISTIC
/begin CHARACTERISTIC CDCENWS2 "Codewort Carb: Nockenwellensteuerung Einlass Nockenwelle 2" VAL_BLK 0xFD6000 KwbWU16 65535.00 DEZ 0.00 65535.00 FORMAT "%8.2" NUMBER 4 /end CHARACTERISTIC
/begin CHARACTERISTIC CDCENWSE "Codewort CARB: Einlaﬂnockenwelle- Endstufe" VAL_BLK 0xFD6008 KwbWU16 65535.00 dez 0.00 65535.00 FORMAT "%8.2" NUMBER 4 /end CHARACTERISTIC
/begin CHARACTERISTIC CDCENWSE2 "Codewort CARB: Einlaﬂnockenwelle- Endstufe" VAL_BLK 0xFD6010 KwbWU16 65535.00 dez 0.00 65535.00 FORMAT "%8.2" NUMBER 4 /end CHARACTERISTIC
/begin CHARACTERISTIC CDCPH "Codewort CARB: Phasensensor" VAL_BLK 0xFD6308 KwbWU16 65535.00 dez 0.00 65535.00 FORMAT "%8.2" NUMBER 4 /end CHARACTERISTIC
/begin CHARACTERISTIC CDCPH2 "Codewort CARB: Phasensensor Bank 2" VAL_BLK 0xFD6310 KwbWU16 65535.00 dez 0.00 65535.00 FORMAT "%8.2" NUMBER 4 /end CHARACTERISTIC
/begin CHARACTERISTIC CDCPH3 "Codewort CARB: Phasensensor 3" VAL_BLK 0xFD6318 KwbWU16 65535.00 dez 0.00 65535.00 FORMAT "%8.2" NUMBER 4 /end CHARACTERISTIC
/begin CHARACTERISTIC CDCPH4 "Codewort CARB: Phasensensor 4" VAL_BLK 0xFD6320 KwbWU16 65535.00 dez 0.00 65535.00 FORMAT "%8.2" NUMBER 4 /end CHARACTERISTIC
/begin CHARACTERISTIC CDCPHM "Codewort CARB: Phasensensor MIL" VAL_BLK 0xFD6328 KwbWU16 65535.00 dez 0.00 65535.00 FORMAT "%8.2" NUMBER 4 /end CHARACTERISTIC
/begin CHARACTERISTIC CDCPLLSU "" VAL_BLK 0xFD6330 KwbUw 65535.00 dez 0.00 65535.00 FORMAT "%8.2" NUMBER 4 /end CHARACTERISTIC
/begin CHARACTERISTIC CDCPLLSU2 "" VAL_BLK 0xFD6338 KwbUw 65535.00 dez 0.00 65535.00 FORMAT "%8.2" NUMBER 4 /end CHARACTERISTIC
/begin CHARACTERISTIC CDCPOELS "Codewort CARB: Plausibilit‰t ÷ldruckschalter" VAL_BLK 0xFD6350 KwbUw 65535.00 dez 0.00 65535.00 FORMAT "%8.2" NUMBER 4 /end CHARACTERISTIC
/begin CHARACTERISTIC CDCSLPE "Codewort CARB: Sekund‰rluftpumpe (Endstufe)" VAL_BLK 0xFD6378 KwbWU16 65535.00 dez 0.00 65535.00 FORMAT "%8.2" NUMBER 4 /end CHARACTERISTIC
/begin CHARACTERISTIC CDCSLS "Codewort CARB: Sekund‰rluft-System" VAL_BLK 0xFD6380 KwbUw 65535.00 dez 0.00 65535.00 FORMAT "%8.2" NUMBER 4 /end CHARACTERISTIC
/begin CHARACTERISTIC CDCSLS2 "Codewort CARB: Sekund‰rluft-System Bank 2" VAL_BLK 0xFD6388 KwbUw 65535.00 dez 0.00 65535.00 FORMAT "%8.2" NUMBER 4 /end CHARACTERISTIC
/begin CHARACTERISTIC CDCSLV "Codewort CARB: Sekund‰rluftventil" VAL_BLK 0xFD6390 KwbUw 65535.00 dez 0.00 65535.00 FORMAT "%8.2" NUMBER 4 /end CHARACTERISTIC
/begin CHARACTERISTIC CDCSLV2 "Codewort CARB: Sekund‰rluftventil, Bank 2" VAL_BLK 0xFD6398 KwbUw 65535.00 dez 0.00 65535.00 FORMAT "%8.2" NUMBER 4 /end CHARACTERISTIC
/begin CHARACTERISTIC CDCSTA "Codewort CARB: Startautomatik" VAL_BLK 0xFD63A8 KwbUw 65535.00 dez 0.00 65535.00 FORMAT "%8.2" NUMBER 4 /end CHARACTERISTIC
/begin CHARACTERISTIC CDCSTS "Codewort CARB: Startsignal" VAL_BLK 0xFD63B0 KwbWU16 65535.00 dez 0.00 65535.00 FORMAT "%8.2" NUMBER 4 /end CHARACTERISTIC
/begin CHARACTERISTIC CDCSUE "Codewort Carb: Endstufe Saugrohrumschaltung" VAL_BLK 0xFD63B8 KwbUw 65535.00 dez 0.00 65535.00 FORMAT "%8.2" NUMBER 4 /end CHARACTERISTIC
/begin CHARACTERISTIC CDCTES "Codewort CARB: Tankentl¸ftungssystem" VAL_BLK 0xFD63D0 KwbWU16 65535.00 dez 0.00 65535.00 FORMAT "%8.2" NUMBER 4 /end CHARACTERISTIC
/begin CHARACTERISTIC CDCTEVE "Codewort CARB:	Tankentl¸ftungsventil Endstufe" VAL_BLK 0xFD63E0 KwbWU16 65535.00 dez 0.00 65535.00 FORMAT "%8.2" NUMBER 4 /end CHARACTERISTIC
/begin CHARACTERISTIC CDCTHS "Codewort CARB DTHS" VAL_BLK 0xFD63E8 KwbWU16 65535.00 DEZ 0.00 65535.00 FORMAT "%8.2" NUMBER 4 /end CHARACTERISTIC
/begin CHARACTERISTIC CDCUFMV "Codewort CARB: Funktions¸berwachung: Momentenvergleich" VAL_BLK 0xFD6410 KwbUw 65535.00 dez 0.00 65535.00 FORMAT "%8.2" NUMBER 4 /end CHARACTERISTIC
/begin CHARACTERISTIC CDCUFNC "Codewort CARB: Funktions¸berwachung: Drehzahlgeber-, Zuleitung- oder SG-Fehler" VAL_BLK 0xFD6418 KwbUw 65535.00 dez 0.00 65535.00 FORMAT "%8.2" NUMBER 4 /end CHARACTERISTIC
/begin CHARACTERISTIC CDCUFRLIP "Codewort CARB: Funktions¸berwachung: Lastsensor-, Zuleitung- oder SG-Fehler" VAL_BLK 0xFD6420 KwbUw 65535.00 dez 0.00 65535.00 FORMAT "%8.2" NUMBER 4 /end CHARACTERISTIC
/begin CHARACTERISTIC CDCUFSGA "Codewort CARB: Funktions¸berwachung: Steuerger‰te-Fehler Gruppe a" VAL_BLK 0xFD6428 KwbUw 65535.00 dez 0.00 65535.00 FORMAT "%8.2" NUMBER 4 /end CHARACTERISTIC
/begin CHARACTERISTIC CDCUFSGB "Codewort CARB: Funktions¸berwachung: Steuerger‰te-Fehler Gruppe b" VAL_BLK 0xFD6430 KwbUw 65535.00 dez 0.00 65535.00 FORMAT "%8.2" NUMBER 4 /end CHARACTERISTIC
/begin CHARACTERISTIC CDCUFSGC "Codewort CARB: Funktions¸berwachung: Steuerger‰te-Fehler Gruppe c" VAL_BLK 0xFD6438 KwbUw 65535.00 dez 0.00 65535.00 FORMAT "%8.2" NUMBER 4 /end CHARACTERISTIC
/begin CHARACTERISTIC CDCUFSPSC "Codewort CARB: Funktions¸berwachung: Pedalwertgeber-, Zuleitung- oder SG-Fehler" VAL_BLK 0xFD6440 KwbUw 65535.00 dez 0.00 65535.00 FORMAT "%8.2" NUMBER 4 /end CHARACTERISTIC
/begin CHARACTERISTIC CDCULSU "" VAL_BLK 0xFD6448 KwbUw 65535.00 dez 0.00 65535.00 FORMAT "%8.2" NUMBER 4 /end CHARACTERISTIC
/begin CHARACTERISTIC CDCULSU2 "" VAL_BLK 0xFD6450 KwbUw 65535.00 dez 0.00 65535.00 FORMAT "%8.2" NUMBER 4 /end CHARACTERISTIC
/begin CHARACTERISTIC CDCURRAM "Codewort CARB: Rechner¸berwachung: RAM" VAL_BLK 0xFD6458 KwbUw 65535.00 dez 0.00 65535.00 FORMAT "%8.2" NUMBER 4 /end CHARACTERISTIC
/begin CHARACTERISTIC CDCURROM "Codewort CARB: Rechner¸berwachung: ROM" VAL_BLK 0xFD6460 KwbUw 65535.00 dez 0.00 65535.00 FORMAT "%8.2" NUMBER 4 /end CHARACTERISTIC
/begin CHARACTERISTIC CDCURRST "Codewort CARB: Rechner¸berwachung: Reset" VAL_BLK 0xFD6468 KwbUw 65535.00 dez 0.00 65535.00 FORMAT "%8.2" NUMBER 4 /end CHARACTERISTIC
/begin CHARACTERISTIC CDCVAT "Codewort CARB: angezeigte Fahrzeuggeschwindigkeit im Tacho" VAL_BLK 0xFD6470 KwbUw 65535.00 dez 0.00 65535.00 FORMAT "%8.2" NUMBER 4 /end CHARACTERISTIC
/begin CHARACTERISTIC CDCVFZ "Codewort CARB: Fahrzeug-Geschwindigkeit" VAL_BLK 0xFD6478 KwbUw 65535.00 dez 0.00 65535.00 FORMAT "%8.2" NUMBER 4 /end CHARACTERISTIC
/begin CHARACTERISTIC CDKANWSE "Codewort Kunde:Auslaﬂnockenwelle- Endstufe" VALUE 0xFD64DA KwWU16 65535.00 dez 0.00 65535.00 FORMAT "%8.2" /end CHARACTERISTIC
/begin CHARACTERISTIC CDKANWSE2 "Codewort Kunde:Auslaﬂnockenwelle- Endstufe Bank2" VALUE 0xFD64DC KwWU16 65535.00 dez 0.00 65535.00 FORMAT "%8.2" /end CHARACTERISTIC
/begin CHARACTERISTIC CDKDVAN "Codewort Kunde: Fehler VVT-Anschlaglernen" VALUE 0xFD652E KwWU16 65535.00 DEZ 0.00 65535.00 FORMAT "%8.2" /end CHARACTERISTIC
/begin CHARACTERISTIC CDKDVCAN "Codewort Kunde: Fehler CAN-Kommunikation" VALUE 0xFD6530 KwWU16 65535.00 DEZ 0.00 65535.00 FORMAT "%8.2" /end CHARACTERISTIC
/begin CHARACTERISTIC CDKDVCAN2 "Codewort Kunde: Fehler CAN-Kommunikation Bank 2" VALUE 0xFD6532 KwWU16 65535.00 DEZ 0.00 65535.00 FORMAT "%8.2" /end CHARACTERISTIC
/begin CHARACTERISTIC CDKDVEST "Codewort Kunde: Fehler Endstufe" VALUE 0xFD6540 KwWU16 65535.00 DEZ 0.00 65535.00 FORMAT "%8.2" /end CHARACTERISTIC
/begin CHARACTERISTIC CDKDVEST2 "Codewort Kunde: Fehler Endstufe Bank 2" VALUE 0xFD6542 KwWU16 65535.00 DEZ 0.00 65535.00 FORMAT "%8.2" /end CHARACTERISTIC
/begin CHARACTERISTIC CDKDVFFS "Codewort Kunde: Fehler Fuehrungssensor" VALUE 0xFD654E KwWU16 65535.00 DEZ 0.00 65535.00 FORMAT "%8.2" /end CHARACTERISTIC
/begin CHARACTERISTIC CDKDVFFS2 "Codewort Kunde: Fehler Fuehrungssensor Bank 2" VALUE 0xFD6550 KwWU16 65535.00 DEZ 0.00 65535.00 FORMAT "%8.2" /end CHARACTERISTIC
/begin CHARACTERISTIC CDKDVFRS "Codewort Kunde: Fehler Referenzsensor" VALUE 0xFD6552 KwWU16 65535.00 DEZ 0.00 65535.00 FORMAT "%8.2" /end CHARACTERISTIC
/begin CHARACTERISTIC CDKDVFRS2 "Codewort Kunde: Fehler Referenzsensor Bank 2" VALUE 0xFD6554 KwWU16 65535.00 DEZ 0.00 65535.00 FORMAT "%8.2" /end CHARACTERISTIC
/begin CHARACTERISTIC CDKDVFSG "Codewort Kunde: Fehler Steuergeraet intern" VALUE 0xFD6556 KwWU16 65535.00 DEZ 0.00 65535.00 FORMAT "%8.2" /end CHARACTERISTIC
/begin CHARACTERISTIC CDKDVFSG2 "Codewort Kunde: Fehler Steuergeraet intern Bank 2" VALUE 0xFD6558 KwWU16 65535.00 DEZ 0.00 65535.00 FORMAT "%8.2" /end CHARACTERISTIC
/begin CHARACTERISTIC CDKDVLRN "Codewort Kunde: Fehler Anschlaglernen" VALUE 0xFD655A KwWU16 65535.00 DEZ 0.00 65535.00 FORMAT "%8.2" /end CHARACTERISTIC
/begin CHARACTERISTIC CDKDVLRN2 "Codewort Kunde: Fehler Anschlaglernen Bank 2" VALUE 0xFD655C KwWU16 65535.00 DEZ 0.00 65535.00 FORMAT "%8.2" /end CHARACTERISTIC
/begin CHARACTERISTIC CDKDVOVL "" VALUE 0xFD655E KwWU16 65535.00 DEZ 0.00 65535.00 FORMAT "%8.2" /end CHARACTERISTIC
/begin CHARACTERISTIC CDKDVOVL2 "" VALUE 0xFD6560 KwWU16 65535.00 DEZ 0.00 65535.00 FORMAT "%8.2" /end CHARACTERISTIC
/begin CHARACTERISTIC CDKDVPLA "Codewort Kunde: Fehler Sensorplausibilisierung" VALUE 0xFD6562 KwWU16 65535.00 DEZ 0.00 65535.00 FORMAT "%8.2" /end CHARACTERISTIC
/begin CHARACTERISTIC CDKDVPLA2 "Codewort Kunde: Fehler Sensorplausibilisierung Bank 2" VALUE 0xFD6564 KwWU16 65535.00 DEZ 0.00 65535.00 FORMAT "%8.2" /end CHARACTERISTIC
/begin CHARACTERISTIC CDKDVPMN "Codewort Kunde: Leistungsbegrenzung" VALUE 0xFD6566 KwWU16 65535.00 DEZ 0.00 65535.00 FORMAT "%8.2" /end CHARACTERISTIC
/begin CHARACTERISTIC CDKDVSTE "Codewort Kunde: Fehler Stellgliedueberwachung" VALUE 0xFD6568 KwWU16 65535.00 DEZ 0.00 65535.00 FORMAT "%8.2" /end CHARACTERISTIC
/begin CHARACTERISTIC CDKDVSTE2 "Codewort Kunde: Fehler Stellgliedueberwachung Bank 2" VALUE 0xFD656A KwWU16 65535.00 DEZ 0.00 65535.00 FORMAT "%8.2" /end CHARACTERISTIC
/begin CHARACTERISTIC CDKDVULV "Codewort Kunde: Fehler Leistungsversorgung VVT" VALUE 0xFD656C KwWU16 65535.00 DEZ 0.00 65535.00 FORMAT "%8.2" /end CHARACTERISTIC
/begin CHARACTERISTIC CDKDVULV2 "Codewort Kunde: Fehler Leistungsversorgung VVT Bank 2" VALUE 0xFD656E KwWU16 65535.00 DEZ 0.00 65535.00 FORMAT "%8.2" /end CHARACTERISTIC
/begin CHARACTERISTIC CDKDVUSE "Codewort Kunde: Fehler Sensor-Versorgungsspannung" VALUE 0xFD6570 KwWU16 65535.00 DEZ 0.00 65535.00 FORMAT "%8.2" /end CHARACTERISTIC
/begin CHARACTERISTIC CDKDVUSE2 "Codewort Kunde: Fehler Sensor-Versorgungsspannung Bank 2" VALUE 0xFD6572 KwWU16 65535.00 DEZ 0.00 65535.00 FORMAT "%8.2" /end CHARACTERISTIC
/begin CHARACTERISTIC CDKENWS "Codewort Kunde: Nockenwellensteuerung Einlass Nockenwelle" VALUE 0xFD658E KwWU16 65535.00 DEZ 0.00 65535.00 FORMAT "%8.2" /end CHARACTERISTIC
/begin CHARACTERISTIC CDKENWS2 "Codewort Kunde: Nockenwellensteuerung Einlass Nockenwelle 2" VALUE 0xFD6590 KwWU16 65535.00 DEZ 0.00 65535.00 FORMAT "%8.2" /end CHARACTERISTIC
/begin CHARACTERISTIC CDKENWSE "Codewort Kunde: Einlaﬂnockenwelle- Endstufe" VALUE 0xFD6592 KwWU16 65535.00 dez 0.00 65535.00 FORMAT "%8.2" /end CHARACTERISTIC
/begin CHARACTERISTIC CDKENWSE2 "Codewort Kunde: Einlaﬂnockenwelle- Endstufe Bank2" VALUE 0xFD6594 KwWU16 65535.00 dez 0.00 65535.00 FORMAT "%8.2" /end CHARACTERISTIC
/begin CHARACTERISTIC CDKPH "Codewort Kunde: Phasensensor" VALUE 0xFD6652 KwWU16 65535.00 dez 0.00 65535.00 FORMAT "%8.2" /end CHARACTERISTIC
/begin CHARACTERISTIC CDKPH2 "Codewort Kunde: Phasensensor 2" VALUE 0xFD6654 KwWU16 65535.00 dez 0.00 65535.00 FORMAT "%8.2" /end CHARACTERISTIC
/begin CHARACTERISTIC CDKPH3 "Codewort Kunde: Phasensensor 3" VALUE 0xFD6656 KwWU16 65535.00 dez 0.00 65535.00 FORMAT "%8.2" /end CHARACTERISTIC
/begin CHARACTERISTIC CDKPH4 "Codewort Kunde: Phasensensor 4" VALUE 0xFD6658 KwWU16 65535.00 dez 0.00 65535.00 FORMAT "%8.2" /end CHARACTERISTIC
/begin CHARACTERISTIC CDKPHM "Codewort Kunde: Phasensensor MIL" VALUE 0xFD665A KwWU16 65535.00 dez 0.00 65535.00 FORMAT "%8.2" /end CHARACTERISTIC
/begin CHARACTERISTIC CDKPLLSU "" VALUE 0xFD665C KwUw 65535.00 dez 0.00 65535.00 FORMAT "%8.2" /end CHARACTERISTIC
/begin CHARACTERISTIC CDKPLLSU2 "" VALUE 0xFD665E KwUw 65535.00 dez 0.00 65535.00 FORMAT "%8.2" /end CHARACTERISTIC
/begin CHARACTERISTIC CDKPOELS "Codewort Kunde: Plausibilit‰t ÷ldruckschalter" VALUE 0xFD6664 KwUw 65535.00 dez 0.00 65535.00 FORMAT "%8.2" /end CHARACTERISTIC
/begin CHARACTERISTIC CDKSLPE "Codewort Kunde: Sekund‰rluftpumpe  (Endstufe)" VALUE 0xFD666E KwWU16 65535.00 dez 0.00 65535.00 FORMAT "%8.2" /end CHARACTERISTIC
/begin CHARACTERISTIC CDKSLS "Codewort Kunde: Sekund‰rluft-System" VALUE 0xFD6670 KwUw 65535.00 dez 0.00 65535.00 FORMAT "%8.2" /end CHARACTERISTIC
/begin CHARACTERISTIC CDKSLS2 "Codewort Kunde: Sekund‰rluft-System Bank 2" VALUE 0xFD6672 KwUw 65535.00 dez 0.00 65535.00 FORMAT "%8.2" /end CHARACTERISTIC
/begin CHARACTERISTIC CDKSLV "Codewort Kunde:	Sekund‰rluftventil" VALUE 0xFD6674 KwUw 65535.00 dez 0.00 65535.00 FORMAT "%8.2" /end CHARACTERISTIC
/begin CHARACTERISTIC CDKSLV2 "Codewort Kunde: Sekund‰rluftventil Bank 2" VALUE 0xFD6676 KwUw 65535.00 dez 0.00 65535.00 FORMAT "%8.2" /end CHARACTERISTIC
/begin CHARACTERISTIC CDKSTA "Codewort Kunde: Startautomatik" VALUE 0xFD667A KwUw 65535.00 dez 0.00 65535.00 FORMAT "%8.2" /end CHARACTERISTIC
/begin CHARACTERISTIC CDKSTS "Codewort Kunde: Startsignal" VALUE 0xFD667C KwWU16 65535.00 dez 0.00 65535.00 FORMAT "%8.2" /end CHARACTERISTIC
/begin CHARACTERISTIC CDKSUE "Codewort Kunde: Endstufe Saugrohrumschaltung" VALUE 0xFD667E KwUw 65535.00 dez 0.00 65535.00 FORMAT "%8.2" /end CHARACTERISTIC
/begin CHARACTERISTIC CDKTES "Codewort Kunde: Tankentl¸ftungssystem" VALUE 0xFD6684 KwWU16 65535.00 dez 0.00 65535.00 FORMAT "%8.2" /end CHARACTERISTIC
/begin CHARACTERISTIC CDKTEVE "Codewort Kunde:	Tankentl¸ftungsventil Endstufe" VALUE 0xFD6688 KwWU16 65535.00 dez 0.00 65535.00 FORMAT "%8.2" /end CHARACTERISTIC
/begin CHARACTERISTIC CDKTHS "Codewort Fehlerpfad DTHS" VALUE 0xFD668A KwWU16 65535.00 DEZ 0.00 65535.00 FORMAT "%8.2" /end CHARACTERISTIC
/begin CHARACTERISTIC CDKUFMV "Codewort Kunde: Funktions¸berwachung: Momentenvergleich" VALUE 0xFD6694 KwUw 65535.00 dez 0.00 65535.00 FORMAT "%8.2" /end CHARACTERISTIC
/begin CHARACTERISTIC CDKUFNC "Codewort Kunde: Funktions¸berwachung: Drehzahlgeber-, Zuleitung- oder SG-Fehler" VALUE 0xFD6696 KwUw 65535.00 dez 0.00 65535.00 FORMAT "%8.2" /end CHARACTERISTIC
/begin CHARACTERISTIC CDKUFRLIP "Codewort Kunde: Funktions¸berwachung: Lastsensor-, Zuleitung- oder SG-Fehler" VALUE 0xFD6698 KwUw 65535.00 dez 0.00 65535.00 FORMAT "%8.2" /end CHARACTERISTIC
/begin CHARACTERISTIC CDKUFSGA "Codewort Kunde: Funktions¸berwachung: Steuerger‰te-Fehler Gruppe a" VALUE 0xFD669A KwUw 65535.00 dez 0.00 65535.00 FORMAT "%8.2" /end CHARACTERISTIC
/begin CHARACTERISTIC CDKUFSGB "Codewort Kunde: Funktions¸berwachung: Steuerger‰te-Fehler Gruppe b" VALUE 0xFD669C KwUw 65535.00 dez 0.00 65535.00 FORMAT "%8.2" /end CHARACTERISTIC
/begin CHARACTERISTIC CDKUFSGC "Codewort Kunde: Funktions¸berwachung: Steuerger‰te-Fehler Gruppe c" VALUE 0xFD669E KwUw 65535.00 dez 0.00 65535.00 FORMAT "%8.2" /end CHARACTERISTIC
/begin CHARACTERISTIC CDKUFSPSC "Codewort Kunde: Funktions¸berwachung: Pedalwertgeber-, Zuleitung- oder SG-Fehler" VALUE 0xFD66A0 KwUw 65535.00 dez 0.00 65535.00 FORMAT "%8.2" /end CHARACTERISTIC
/begin CHARACTERISTIC CDKULSU "" VALUE 0xFD66A2 KwUw 65535.00 dez 0.00 65535.00 FORMAT "%8.2" /end CHARACTERISTIC
/begin CHARACTERISTIC CDKULSU2 "" VALUE 0xFD66A4 KwUw 65535.00 dez 0.00 65535.00 FORMAT "%8.2" /end CHARACTERISTIC
/begin CHARACTERISTIC CDKURRAM "Codewort Kunde: Rechner¸berwachung: RAM" VALUE 0xFD66A6 KwUw 65535.00 dez 0.00 65535.00 FORMAT "%8.2" /end CHARACTERISTIC
/begin CHARACTERISTIC CDKURROM "Codewort Kunde: Rechner¸berwachung: ROM" VALUE 0xFD66A8 KwUw 65535.00 dez 0.00 65535.00 FORMAT "%8.2" /end CHARACTERISTIC
/begin CHARACTERISTIC CDKURRST "Codewort Kunde: Rechner¸berwachung: Reset" VALUE 0xFD66AA KwUw 65535.00 dez 0.00 65535.00 FORMAT "%8.2" /end CHARACTERISTIC
/begin CHARACTERISTIC CDKVAT "Codewort Kunde: angezeigte Fahrzeuggeschwindigkeit im Tacho" VALUE 0xFD66AC KwUw 65535.00 dez 0.00 65535.00 FORMAT "%8.2" /end CHARACTERISTIC
/begin CHARACTERISTIC CDKVFZ "Codewort Kunde:	Fahrzeug-Geschwindigkeit" VALUE 0xFD66AE KwUw 65535.00 dez 0.00 65535.00 FORMAT "%8.2" /end CHARACTERISTIC
/begin CHARACTERISTIC CDTANWSE "Codewort Tester: Auslaﬂnockenwelle- Endstufe" VALUE 0xFD66CE KwWU16 65535.00 dez 0.00 65535.00 FORMAT "%8.2" /end CHARACTERISTIC
/begin CHARACTERISTIC CDTANWSE2 "Codewort Tester: Auslaﬂnockenwelle- Endstufe Bank2" VALUE 0xFD66D0 KwWU16 65535.00 dez 0.00 65535.00 FORMAT "%8.2" /end CHARACTERISTIC
/begin CHARACTERISTIC CDTDVAN "Codewort Tester: Fehler VVT-Anschlaglernen" VALUE 0xFD6722 KwWU16 65535.00 DEZ 0.00 65535.00 FORMAT "%8.2" /end CHARACTERISTIC
/begin CHARACTERISTIC CDTDVCAN "Codewort Tester: Fehler CAN-Kommunikation" VALUE 0xFD6724 KwWU16 65535.00 DEZ 0.00 65535.00 FORMAT "%8.2" /end CHARACTERISTIC
/begin CHARACTERISTIC CDTDVCAN2 "Codewort Tester: Fehler CAN-Kommunikation Bank 2" VALUE 0xFD6726 KwWU16 65535.00 DEZ 0.00 65535.00 FORMAT "%8.2" /end CHARACTERISTIC
/begin CHARACTERISTIC CDTDVEST "Codewort Tester: Fehler Endstufe" VALUE 0xFD6734 KwWU16 65535.00 DEZ 0.00 65535.00 FORMAT "%8.2" /end CHARACTERISTIC
/begin CHARACTERISTIC CDTDVEST2 "Codewort Tester: Fehler Endstufe Bank 2" VALUE 0xFD6736 KwWU16 65535.00 DEZ 0.00 65535.00 FORMAT "%8.2" /end CHARACTERISTIC
/begin CHARACTERISTIC CDTDVFFS "Codewort Tester: Fehler Fuehrungssensor" VALUE 0xFD6742 KwWU16 65535.00 DEZ 0.00 65535.00 FORMAT "%8.2" /end CHARACTERISTIC
/begin CHARACTERISTIC CDTDVFFS2 "Codewort Tester: Fehler Fuehrungssensor Bank 2" VALUE 0xFD6744 KwWU16 65535.00 DEZ 0.00 65535.00 FORMAT "%8.2" /end CHARACTERISTIC
/begin CHARACTERISTIC CDTDVFRS "Codewort Tester: Fehler Referenzsensor" VALUE 0xFD6746 KwWU16 65535.00 DEZ 0.00 65535.00 FORMAT "%8.2" /end CHARACTERISTIC
/begin CHARACTERISTIC CDTDVFRS2 "Codewort Tester: Fehler Referenzsensor Bank 2" VALUE 0xFD6748 KwWU16 65535.00 DEZ 0.00 65535.00 FORMAT "%8.2" /end CHARACTERISTIC
/begin CHARACTERISTIC CDTDVFSG "Codewort Tester: Fehler Steuergeraet intern" VALUE 0xFD674A KwWU16 65535.00 DEZ 0.00 65535.00 FORMAT "%8.2" /end CHARACTERISTIC
/begin CHARACTERISTIC CDTDVFSG2 "Codewort Tester: Fehler Steuergeraet intern Bank 2" VALUE 0xFD674C KwWU16 65535.00 DEZ 0.00 65535.00 FORMAT "%8.2" /end CHARACTERISTIC
/begin CHARACTERISTIC CDTDVLRN "Codewort Tester: Fehler Anschlaglernen" VALUE 0xFD674E KwWU16 65535.00 DEZ 0.00 65535.00 FORMAT "%8.2" /end CHARACTERISTIC
/begin CHARACTERISTIC CDTDVLRN2 "Codewort Tester: Fehler Anschlaglernen Bank 2" VALUE 0xFD6750 KwWU16 65535.00 DEZ 0.00 65535.00 FORMAT "%8.2" /end CHARACTERISTIC
/begin CHARACTERISTIC CDTDVOVL "" VALUE 0xFD6752 KwWU16 65535.00 DEZ 0.00 65535.00 FORMAT "%8.2" /end CHARACTERISTIC
/begin CHARACTERISTIC CDTDVOVL2 "" VALUE 0xFD6754 KwWU16 65535.00 DEZ 0.00 65535.00 FORMAT "%8.2" /end CHARACTERISTIC
/begin CHARACTERISTIC CDTDVPLA "Fehler Sensorplausibilisierung" VALUE 0xFD6756 KwWU16 65535.00 DEZ 0.00 65535.00 FORMAT "%8.2" /end CHARACTERISTIC
/begin CHARACTERISTIC CDTDVPLA2 "Fehler Sensorplausibilisierung Bank 2" VALUE 0xFD6758 KwWU16 65535.00 DEZ 0.00 65535.00 FORMAT "%8.2" /end CHARACTERISTIC
/begin CHARACTERISTIC CDTDVPMN "Codewort Tester: Leistungsbegrenzung" VALUE 0xFD675A KwWU16 65535.00 DEZ 0.00 65535.00 FORMAT "%8.2" /end CHARACTERISTIC
/begin CHARACTERISTIC CDTDVSTE "Codewort Tester: Fehler Stellgliedueberwachung" VALUE 0xFD675C KwWU16 65535.00 DEZ 0.00 65535.00 FORMAT "%8.2" /end CHARACTERISTIC
/begin CHARACTERISTIC CDTDVSTE2 "Codewort Tester: Fehler Stellgliedueberwachung Bank 2" VALUE 0xFD675E KwWU16 65535.00 DEZ 0.00 65535.00 FORMAT "%8.2" /end CHARACTERISTIC
/begin CHARACTERISTIC CDTDVULV "Codewort Tester: Fehler Leistungsversorgung VVT" VALUE 0xFD6760 KwWU16 65535.00 DEZ 0.00 65535.00 FORMAT "%8.2" /end CHARACTERISTIC
/begin CHARACTERISTIC CDTDVULV2 "Codewort Tester: Fehler Leistungsversorgung VVT Bank 2" VALUE 0xFD6762 KwWU16 65535.00 DEZ 0.00 65535.00 FORMAT "%8.2" /end CHARACTERISTIC
/begin CHARACTERISTIC CDTDVUSE "Codewort Tester: Fehler Sensor-Versorgungsspannung" VALUE 0xFD6764 KwWU16 65535.00 DEZ 0.00 65535.00 FORMAT "%8.2" /end CHARACTERISTIC
/begin CHARACTERISTIC CDTDVUSE2 "Codewort Tester: Fehler Sensor-Versorgungsspannung Bank 2" VALUE 0xFD6766 KwWU16 65535.00 DEZ 0.00 65535.00 FORMAT "%8.2" /end CHARACTERISTIC
/begin CHARACTERISTIC CDTENWS "Codewort Tester: Nockenwellensteuerung Einlass Nockenwelle" VALUE 0xFD6782 KwWU16 65535.00 DEZ 0.00 65535.00 FORMAT "%8.2" /end CHARACTERISTIC
/begin CHARACTERISTIC CDTENWS2 "Codewort Tester: Nockenwellensteuerung Einlass Nockenwelle 2" VALUE 0xFD6784 KwWU16 65535.00 DEZ 0.00 65535.00 FORMAT "%8.2" /end CHARACTERISTIC
/begin CHARACTERISTIC CDTENWSE "Codewort Tester: Einlaﬂnockenwelle- Endstufe" VALUE 0xFD6786 KwWU16 65535.00 dez 0.00 65535.00 FORMAT "%8.2" /end CHARACTERISTIC
/begin CHARACTERISTIC CDTENWSE2 "Codewort Tester: Einlaﬂnockenwelle- EndstufeBank2" VALUE 0xFD6788 KwWU16 65535.00 dez 0.00 65535.00 FORMAT "%8.2" /end CHARACTERISTIC
/begin CHARACTERISTIC CDTPH "Codewort Tester: Phasensensor" VALUE 0xFD6846 KwWU16 65535.00 dez 0.00 65535.00 FORMAT "%8.2" /end CHARACTERISTIC
/begin CHARACTERISTIC CDTPH2 "Codewort Tester: Phasensensor Bank 2" VALUE 0xFD6848 KwWU16 65535.00 dez 0.00 65535.00 FORMAT "%8.2" /end CHARACTERISTIC
/begin CHARACTERISTIC CDTPH3 "Codewort Tester: Phasensensor 3" VALUE 0xFD684A KwWU16 65535.00 dez 0.00 65535.00 FORMAT "%8.2" /end CHARACTERISTIC
/begin CHARACTERISTIC CDTPH4 "Codewort Tester: Phasensensor 4" VALUE 0xFD684C KwWU16 65535.00 dez 0.00 65535.00 FORMAT "%8.2" /end CHARACTERISTIC
/begin CHARACTERISTIC CDTPHM "Codewort Tester: Phasensensor MIL" VALUE 0xFD684E KwWU16 65535.00 dez 0.00 65535.00 FORMAT "%8.2" /end CHARACTERISTIC
/begin CHARACTERISTIC CDTPLLSU "" VALUE 0xFD6850 KwUw 65535.00 dez 0.00 65535.00 FORMAT "%8.2" /end CHARACTERISTIC
/begin CHARACTERISTIC CDTPLLSU2 "" VALUE 0xFD6852 KwUw 65535.00 dez 0.00 65535.00 FORMAT "%8.2" /end CHARACTERISTIC
/begin CHARACTERISTIC CDTPOELS "Codewort Tester: Plausibilit‰t ÷ldruckschalter" VALUE 0xFD6858 KwUw 65535.00 dez 0.00 65535.00 FORMAT "%8.2" /end CHARACTERISTIC
/begin CHARACTERISTIC CDTSLPE "Codewort Tester: Sekund‰rluftpumpe (Endstufe)" VALUE 0xFD6862 KwWU16 65535.00 dez 0.00 65535.00 FORMAT "%8.2" /end CHARACTERISTIC
/begin CHARACTERISTIC CDTSLS "Codewort Tester: Sekund‰rluft-System" VALUE 0xFD6864 KwUw 65535.00 dez 0.00 65535.00 FORMAT "%8.2" /end CHARACTERISTIC
/begin CHARACTERISTIC CDTSLS2 "Codewort Tester: Sekund‰rluft-System, Bank 2" VALUE 0xFD6866 KwUw 65535.00 dez 0.00 65535.00 FORMAT "%8.2" /end CHARACTERISTIC
/begin CHARACTERISTIC CDTSLV "Codewort Tester: Sekund‰rluftventil" VALUE 0xFD6868 KwUw 65535.00 dez 0.00 65535.00 FORMAT "%8.2" /end CHARACTERISTIC
/begin CHARACTERISTIC CDTSLV2 "Codewort Tester: Sekund‰rluftventil, Bank 2" VALUE 0xFD686A KwUw 65535.00 dez 0.00 65535.00 FORMAT "%8.2" /end CHARACTERISTIC
/begin CHARACTERISTIC CDTSTA "Codewort Tester: Startautomatik" VALUE 0xFD686E KwUw 65535.00 dez 0.00 65535.00 FORMAT "%8.2" /end CHARACTERISTIC
/begin CHARACTERISTIC CDTSTS "Codewort Tester: Startsignal" VALUE 0xFD6870 KwWU16 65535.00 dez 0.00 65535.00 FORMAT "%8.2" /end CHARACTERISTIC
/begin CHARACTERISTIC CDTSUE "Codewort Tester: Endstufe Saugrohrumschaltung" VALUE 0xFD6872 KwUw 65535.00 dez 0.00 65535.00 FORMAT "%8.2" /end CHARACTERISTIC
/begin CHARACTERISTIC CDTTES "Codewort Tester: Tankentl¸ftungssystem" VALUE 0xFD6878 KwWU16 65535.00 dez 0.00 65535.00 FORMAT "%8.2" /end CHARACTERISTIC
/begin CHARACTERISTIC CDTTEVE "Codewort Tester: Tankentl¸ftungsventil Endstufe" VALUE 0xFD687C KwWU16 65535.00 dez 0.00 65535.00 FORMAT "%8.2" /end CHARACTERISTIC
/begin CHARACTERISTIC CDTTHS "Codewort Standard-Fehlerpfad DTHS" VALUE 0xFD687E KwWU16 65535.00 DEZ 0.00 65535.00 FORMAT "%8.2" /end CHARACTERISTIC
/begin CHARACTERISTIC CDTUFMV "Codewort Tester: Funktions¸berwachung: Momentenvergleich" VALUE 0xFD6888 KwUw 65535.00 dez 0.00 65535.00 FORMAT "%8.2" /end CHARACTERISTIC
/begin CHARACTERISTIC CDTUFNC "Codewort Tester: Fkt¸berwachung: Drehzahlgeber-, Zuleitung- oder SG-Fehler" VALUE 0xFD688A KwUw 65535.00 dez 0.00 65535.00 FORMAT "%8.2" /end CHARACTERISTIC
/begin CHARACTERISTIC CDTUFRLIP "Codewort Tester: Fkt¸berwachung: Lastsensor-, Zuleitung- oder SG-Fehler" VALUE 0xFD688C KwUw 65535.00 dez 0.00 65535.00 FORMAT "%8.2" /end CHARACTERISTIC
/begin CHARACTERISTIC CDTUFSGA "Codewort Tester: Funktions¸berwachung: Steuerger‰te-Fehler Gruppe a" VALUE 0xFD688E KwUw 65535.00 dez 0.00 65535.00 FORMAT "%8.2" /end CHARACTERISTIC
/begin CHARACTERISTIC CDTUFSGB "Codewort Tester: Funktions¸berwachung: Steuerger‰te-Fehler Gruppe b" VALUE 0xFD6890 KwUw 65535.00 dez 0.00 65535.00 FORMAT "%8.2" /end CHARACTERISTIC
/begin CHARACTERISTIC CDTUFSGC "Codewort Tester: Funktions¸berwachung: Steuerger‰te-Fehler Gruppe c" VALUE 0xFD6892 KwUw 65535.00 dez 0.00 65535.00 FORMAT "%8.2" /end CHARACTERISTIC
/begin CHARACTERISTIC CDTUFSPSC "Codewort Tester: Fkt¸berwachung: Pedalwertgeber-, Zuleitung- oder SG-Fehler" VALUE 0xFD6894 KwUw 65535.00 dez 0.00 65535.00 FORMAT "%8.2" /end CHARACTERISTIC
/begin CHARACTERISTIC CDTULSU "" VALUE 0xFD6896 KwUw 65535.00 dez 0.00 65535.00 FORMAT "%8.2" /end CHARACTERISTIC
/begin CHARACTERISTIC CDTULSU2 "" VALUE 0xFD6898 KwUw 65535.00 dez 0.00 65535.00 FORMAT "%8.2" /end CHARACTERISTIC
/begin CHARACTERISTIC CDTURRAM "Codewort Tester: Rechner¸berwachung: RAM" VALUE 0xFD689A KwUw 65535.00 dez 0.00 65535.00 FORMAT "%8.2" /end CHARACTERISTIC
/begin CHARACTERISTIC CDTURROM "Codewort Tester: Rechner¸berwachung: ROM" VALUE 0xFD689C KwUw 65535.00 dez 0.00 65535.00 FORMAT "%8.2" /end CHARACTERISTIC
/begin CHARACTERISTIC CDTURRST "Codewort Tester: Rechner¸berwachung: Reset" VALUE 0xFD689E KwUw 65535.00 dez 0.00 65535.00 FORMAT "%8.2" /end CHARACTERISTIC
/begin CHARACTERISTIC CDTVAT "Codewort Tester: angezeigte Fahrzeuggeschwindigkeit im Tacho" VALUE 0xFD68A0 KwUw 65535.00 dez 0.00 65535.00 FORMAT "%8.2" /end CHARACTERISTIC
/begin CHARACTERISTIC CDTVFZ "Codewort Tester: Fahrzeug-Geschwindigkeit" VALUE 0xFD68A2 KwUw 65535.00 dez 0.00 65535.00 FORMAT "%8.2" /end CHARACTERISTIC
/begin CHARACTERISTIC CLAANWSE "Fehlerklasse: Auslaﬂnockenwelle- Endstufe" VALUE 0xFD5728 KwWU8 255.0 dez 0.00 255.0 FORMAT "%5.1" /end CHARACTERISTIC
/begin CHARACTERISTIC CLAANWSE2 "Fehlerklasse: Auslaﬂnockenwelle- Endstufe Bank2" VALUE 0xFD5729 KwWU8 255.0 dez 0.00 255.0 FORMAT "%5.1" /end CHARACTERISTIC
/begin CHARACTERISTIC CLADVAN "Fehlerklasse: Fehler VVT-Anschlaglernen" VALUE 0xFD5752 KwWU8 255.0 DEZ 0.00 255.0 FORMAT "%5.1" /end CHARACTERISTIC
/begin CHARACTERISTIC CLADVCAN "Fehlerklasse: Fehler CAN-Kommunikation" VALUE 0xFD5753 KwWU8 255.0 DEZ 0.00 255.0 FORMAT "%5.1" /end CHARACTERISTIC
/begin CHARACTERISTIC CLADVCAN2 "Fehlerklasse: Fehler CAN-Kommunikation Bank 2" VALUE 0xFD5754 KwWU8 255.0 DEZ 0.00 255.0 FORMAT "%5.1" /end CHARACTERISTIC
/begin CHARACTERISTIC CLADVEST "Fehlerklasse: Fehler Endstufe" VALUE 0xFD575B KwWU8 255.0 DEZ 0.00 255.0 FORMAT "%5.1" /end CHARACTERISTIC
/begin CHARACTERISTIC CLADVEST2 "Fehlerklasse: Fehler Endstufe Bank 2" VALUE 0xFD575C KwWU8 255.0 DEZ 0.00 255.0 FORMAT "%5.1" /end CHARACTERISTIC
/begin CHARACTERISTIC CLADVFFS "Fehlerklasse: Fehler Fuehrungssensor" VALUE 0xFD5762 KwWU8 255.0 DEZ 0.00 255.0 FORMAT "%5.1" /end CHARACTERISTIC
/begin CHARACTERISTIC CLADVFFS2 "Fehlerklasse: Fehler Fuehrungssensor Bank 2" VALUE 0xFD5763 KwWU8 255.0 DEZ 0.00 255.0 FORMAT "%5.1" /end CHARACTERISTIC
/begin CHARACTERISTIC CLADVFRS "Fehlerklasse: Fehler Referenzsensor" VALUE 0xFD5764 KwWU8 255.0 DEZ 0.00 255.0 FORMAT "%5.1" /end CHARACTERISTIC
/begin CHARACTERISTIC CLADVFRS2 "Fehlerklasse: Fehler Referenzsensor Bank 2" VALUE 0xFD5765 KwWU8 255.0 DEZ 0.00 255.0 FORMAT "%5.1" /end CHARACTERISTIC
/begin CHARACTERISTIC CLADVFSG "Fehlerklasse: Fehler Steuergeraet intern" VALUE 0xFD5766 KwWU8 255.0 DEZ 0.00 255.0 FORMAT "%5.1" /end CHARACTERISTIC
/begin CHARACTERISTIC CLADVFSG2 "Fehlerklasse: Fehler Steuergeraet intern Bank 2" VALUE 0xFD5767 KwWU8 255.0 DEZ 0.00 255.0 FORMAT "%5.1" /end CHARACTERISTIC
/begin CHARACTERISTIC CLADVLRN "Fehlerklasse: Fehler Anschlaglernen" VALUE 0xFD5768 KwWU8 255.0 DEZ 0.00 255.0 FORMAT "%5.1" /end CHARACTERISTIC
/begin CHARACTERISTIC CLADVLRN2 "Fehlerklasse: Fehler Anschlaglernen Bank 2" VALUE 0xFD5769 KwWU8 255.0 DEZ 0.00 255.0 FORMAT "%5.1" /end CHARACTERISTIC
/begin CHARACTERISTIC CLADVOVL "" VALUE 0xFD576A KwWU8 255.0 DEZ 0.00 255.0 FORMAT "%5.1" /end CHARACTERISTIC
/begin CHARACTERISTIC CLADVOVL2 "" VALUE 0xFD576B KwWU8 255.0 DEZ 0.00 255.0 FORMAT "%5.1" /end CHARACTERISTIC
/begin CHARACTERISTIC CLADVPLA "Fehlerklasse: Fehler Sensorplausibilisierung" VALUE 0xFD576C KwWU8 255.0 DEZ 0.00 255.0 FORMAT "%5.1" /end CHARACTERISTIC
/begin CHARACTERISTIC CLADVPLA2 "Fehlerklasse: Fehler Sensorplausibilisierung Bank 2" VALUE 0xFD576D KwWU8 255.0 DEZ 0.00 255.0 FORMAT "%5.1" /end CHARACTERISTIC
/begin CHARACTERISTIC CLADVPMN "Fehlerklasse: Leistungsbegrenzung" VALUE 0xFD576E KwWU8 255.0 DEZ 0.00 255.0 FORMAT "%5.1" /end CHARACTERISTIC
/begin CHARACTERISTIC CLADVSTE "Fehlerklasse: Fehler Stellgliedueberwachung" VALUE 0xFD576F KwWU8 255.0 DEZ 0.00 255.0 FORMAT "%5.1" /end CHARACTERISTIC
/begin CHARACTERISTIC CLADVSTE2 "Fehlerklasse: Fehler Stellgliedueberwachung Bank 2" VALUE 0xFD5770 KwWU8 255.0 DEZ 0.00 255.0 FORMAT "%5.1" /end CHARACTERISTIC
/begin CHARACTERISTIC CLADVULV "Fehlerklasse: Fehler Leistungsversorgung VVT" VALUE 0xFD5771 KwWU8 255.0 DEZ 0.00 255.0 FORMAT "%5.1" /end CHARACTERISTIC
/begin CHARACTERISTIC CLADVULV2 "Fehlerklasse: Fehler Leistungsversorgung VVT Bank 2" VALUE 0xFD5772 KwWU8 255.0 DEZ 0.00 255.0 FORMAT "%5.1" /end CHARACTERISTIC
/begin CHARACTERISTIC CLADVUSE "Fehlerklasse: Fehler Sensor-Versorgungsspannung" VALUE 0xFD5773 KwWU8 255.0 DEZ 0.00 255.0 FORMAT "%5.1" /end CHARACTERISTIC
/begin CHARACTERISTIC CLADVUSE2 "Fehlerklasse: Fehler Sensor-Versorgungsspannung Bank 2" VALUE 0xFD5774 KwWU8 255.0 DEZ 0.00 255.0 FORMAT "%5.1" /end CHARACTERISTIC
/begin CHARACTERISTIC CLAENWS "Fehlerklasse: Nockenwellensteuerung Einlass Nockenwelle" VALUE 0xFD5782 KwWU8 255.0 DEZ 0.00 255.0 FORMAT "%5.1" /end CHARACTERISTIC
/begin CHARACTERISTIC CLAENWS2 "Fehlerklasse: Nockenwellensteuerung Einlass Nockenwelle 2" VALUE 0xFD5783 KwWU8 255.0 DEZ 0.00 255.0 FORMAT "%5.1" /end CHARACTERISTIC
/begin CHARACTERISTIC CLAENWSE "Fehlerklasse: Einlaﬂnockenwelle- Endstufe" VALUE 0xFD5784 KwWU8 255.0 dez 0.00 255.0 FORMAT "%5.1" /end CHARACTERISTIC
/begin CHARACTERISTIC CLAENWSE2 "Fehlerklasse: Einlaﬂnockenwelle- Endstufe Bank2" VALUE 0xFD5785 KwWU8 255.0 dez 0.00 255.0 FORMAT "%5.1" /end CHARACTERISTIC
/begin CHARACTERISTIC CLAPH "Fehlerklasse: Phasengeber" VALUE 0xFD57E4 KwWU8 255.0 dez 0.00 255.0 FORMAT "%5.1" /end CHARACTERISTIC
/begin CHARACTERISTIC CLAPH2 "Fehlerklasse: Phasengeber Bank 2" VALUE 0xFD57E5 KwWU8 255.0 dez 0.00 255.0 FORMAT "%5.1" /end CHARACTERISTIC
/begin CHARACTERISTIC CLAPH3 "Fehlerklasse: Phasengeber 3" VALUE 0xFD57E6 KwWU8 255.0 dez 0.00 255.0 FORMAT "%5.1" /end CHARACTERISTIC
/begin CHARACTERISTIC CLAPH4 "Fehlerklasse: Phasengeber 4" VALUE 0xFD57E7 KwWU8 255.0 dez 0.00 255.0 FORMAT "%5.1" /end CHARACTERISTIC
/begin CHARACTERISTIC CLAPHM "Fehlerklasse: Phasengeber MIL" VALUE 0xFD57E8 KwWU8 255.0 dez 0.00 255.0 FORMAT "%5.1" /end CHARACTERISTIC
/begin CHARACTERISTIC CLAPLLSU "" VALUE 0xFD57E9 KwUb 255.0 dez 0.00 255.0 FORMAT "%5.1" /end CHARACTERISTIC
/begin CHARACTERISTIC CLAPLLSU2 "" VALUE 0xFD57EA KwUb 255.0 dez 0.00 255.0 FORMAT "%5.1" /end CHARACTERISTIC
/begin CHARACTERISTIC CLAPOELS "" VALUE 0xFD57ED KwUb 255.0 dez 0.00 255.0 FORMAT "%5.1" /end CHARACTERISTIC
/begin CHARACTERISTIC CLASLPE "Fehlerklasse: Sekund‰rluftpumpe Endstufe" VALUE 0xFD57F2 KwWU8 255.0 dez 0.00 255.0 FORMAT "%5.1" /end CHARACTERISTIC
/begin CHARACTERISTIC CLASLS "Fehlerklasse: Sekund‰rluftsystem" VALUE 0xFD57F3 KwUb 255.0 dez 0.00 255.0 FORMAT "%5.1" /end CHARACTERISTIC
/begin CHARACTERISTIC CLASLS2 "Fehlerklasse: Sekund‰rluftsystem, Bank 2" VALUE 0xFD57F4 KwUb 255.0 dez 0.00 255.0 FORMAT "%5.1" /end CHARACTERISTIC
/begin CHARACTERISTIC CLASLV "Fehlerklasse: Dichtheit Sekund‰rluftventil" VALUE 0xFD57F5 KwUb 255.0 dez 0.00 255.0 FORMAT "%5.1" /end CHARACTERISTIC
/begin CHARACTERISTIC CLASLV2 "Fehlerklasse: Dichtheit Sekund‰rluftventil, Bank 2" VALUE 0xFD57F6 KwUb 255.0 dez 0.00 255.0 FORMAT "%5.1" /end CHARACTERISTIC
/begin CHARACTERISTIC CLASTA "Fehlerklasse : Startautomatik-Ansteuerung" VALUE 0xFD57F8 KwUb 255.0 dez 0.00 255.0 FORMAT "%5.1" /end CHARACTERISTIC
/begin CHARACTERISTIC CLASTS "Fehlerklasse: Startautomatik Ansteuerung" VALUE 0xFD57F9 KwWU8 255.0 dez 0.00 255.0 FORMAT "%5.1" /end CHARACTERISTIC
/begin CHARACTERISTIC CLASUE "Fehlerklasse: Saugrohrumschaltung Endstufe" VALUE 0xFD57FA KwUb 255.0 dez 0.00 255.0 FORMAT "%5.1" /end CHARACTERISTIC
/begin CHARACTERISTIC CLATES "Fehlerklasse: Tankdiagnose, TEV offen" VALUE 0xFD57FD KwWU8 255.0 dez 0.00 255.0 FORMAT "%5.1" /end CHARACTERISTIC
/begin CHARACTERISTIC CLATEVE "Fehlerklasse: Tankentl¸ftungsventil Endstufe" VALUE 0xFD57FF KwWU8 255.0 dez 0.00 255.0 FORMAT "%5.1" /end CHARACTERISTIC
/begin CHARACTERISTIC CLATHS "Codewort Fehlerklasse DTHS" VALUE 0xFD5800 KwWU8 255.0 DEZ 0.00 255.0 FORMAT "%5.1" /end CHARACTERISTIC
/begin CHARACTERISTIC CLAUFMV "Fehlerklasse: Funktions¸berwachung: Momentenvergleich" VALUE 0xFD5805 KwUb 255.0 dez 0.00 255.0 FORMAT "%5.1" /end CHARACTERISTIC
/begin CHARACTERISTIC CLAUFNC "Fehlerklasse: Funktions¸berwachung: Drehzahlgeber-, Zuleitung- oder SG-Fehler" VALUE 0xFD5806 KwUb 255.0 dez 0.00 255.0 FORMAT "%5.1" /end CHARACTERISTIC
/begin CHARACTERISTIC CLAUFRLIP "Fehlerklasse: Funktions¸berwachung: Lastsensor-, Zuleitung- oder SG-Fehler" VALUE 0xFD5807 KwUb 255.0 dez 0.00 255.0 FORMAT "%5.1" /end CHARACTERISTIC
/begin CHARACTERISTIC CLAUFSGA "Fehlerklasse: Funktions¸berwachung: Steuerger‰te-Fehler Gruppe a" VALUE 0xFD5808 KwUb 255.0 dez 0.00 255.0 FORMAT "%5.1" /end CHARACTERISTIC
/begin CHARACTERISTIC CLAUFSGB "Fehlerklasse: Funktions¸berwachung: Steuerger‰te-Fehler Gruppe b" VALUE 0xFD5809 KwUb 255.0 dez 0.00 255.0 FORMAT "%5.1" /end CHARACTERISTIC
/begin CHARACTERISTIC CLAUFSGC "Fehlerklasse: Funktions¸berwachung: Steuerger‰te-Fehler Gruppe c" VALUE 0xFD580A KwUb 255.0 dez 0.00 255.0 FORMAT "%5.1" /end CHARACTERISTIC
/begin CHARACTERISTIC CLAUFSPSC "Fehlerklasse: Funktions¸berwachung: Pedalwertgeber-, Zuleitung- oder SG-Fehler" VALUE 0xFD580B KwUb 255.0 dez 0.00 255.0 FORMAT "%5.1" /end CHARACTERISTIC
/begin CHARACTERISTIC CLAULSU "" VALUE 0xFD580C KwUb 255.0 dez 0.00 255.0 FORMAT "%5.1" /end CHARACTERISTIC
/begin CHARACTERISTIC CLAULSU2 "" VALUE 0xFD580D KwUb 255.0 dez 0.00 255.0 FORMAT "%5.1" /end CHARACTERISTIC
/begin CHARACTERISTIC CLAURRAM "Fehlerklasse: Rechner¸berwachung: RAM" VALUE 0xFD580E KwUb 255.0 dez 0.00 255.0 FORMAT "%5.1" /end CHARACTERISTIC
/begin CHARACTERISTIC CLAURROM "Fehlerklasse: Rechner¸berwachung: ROM" VALUE 0xFD580F KwUb 255.0 dez 0.00 255.0 FORMAT "%5.1" /end CHARACTERISTIC
/begin CHARACTERISTIC CLAURRST "Fehlerklasse: Rechner¸berwachung: Reset" VALUE 0xFD5810 KwUb 255.0 dez 0.00 255.0 FORMAT "%5.1" /end CHARACTERISTIC
/begin CHARACTERISTIC CLAVAT "Fehlerklasse: angezeigte Fahrzeuggeschwindigkeit im Tacho" VALUE 0xFD5811 KwUb 255.0 dez 0.00 255.0 FORMAT "%5.1" /end CHARACTERISTIC
/begin CHARACTERISTIC CLAVFZ "Fehlerklasse: Geschwindigkeitssignal" VALUE 0xFD5812 KwUb 255.0 dez 0.00 255.0 FORMAT "%5.1" /end CHARACTERISTIC
/begin CHARACTERISTIC FFTANWSE "Freeze Frame Tabelle: Auslaﬂnockenwelle- Endstufe" VAL_BLK 0xFD5831 KwbWU8 255.0 dez 0.00 255.0 FORMAT "%5.1" NUMBER 4 /end CHARACTERISTIC
/begin CHARACTERISTIC FFTANWSE2 "Freeze Frame Tabelle: Auslaﬂnockenwelle- Endstufe Bank2" VAL_BLK 0xFD5835 KwbWU8 255.0 dez 0.00 255.0 FORMAT "%5.1" NUMBER 4 /end CHARACTERISTIC
/begin CHARACTERISTIC FFTDVAN "Freeze Frame Tabelle: Fehler VVT-Anschlaglernen" VAL_BLK 0xFD58D9 KwbWU8 255.0 DEZ 0.00 255.0 FORMAT "%5.1" NUMBER 4 /end CHARACTERISTIC
/begin CHARACTERISTIC FFTDVCAN "Freeze Frame Tabelle: Fehler CAN-Kommunikation" VAL_BLK 0xFD58DD KwbWU8 255.0 DEZ 0.00 255.0 FORMAT "%5.1" NUMBER 4 /end CHARACTERISTIC
/begin CHARACTERISTIC FFTDVCAN2 "Freeze Frame Tabelle: Fehler CAN-Kommunikation Bank 2" VAL_BLK 0xFD58E1 KwbWU8 255.0 DEZ 0.00 255.0 FORMAT "%5.1" NUMBER 4 /end CHARACTERISTIC
/begin CHARACTERISTIC FFTDVEST "Freeze Frame Tabelle: Fehler Endstufe" VAL_BLK 0xFD58FD KwbWU8 255.0 DEZ 0.00 255.0 FORMAT "%5.1" NUMBER 4 /end CHARACTERISTIC
/begin CHARACTERISTIC FFTDVEST2 "Freeze Frame Tabelle: Fehler Endstufe Bank 2" VAL_BLK 0xFD5901 KwbWU8 255.0 DEZ 0.00 255.0 FORMAT "%5.1" NUMBER 4 /end CHARACTERISTIC
/begin CHARACTERISTIC FFTDVFFS "Freeze Frame Tabelle: Fehler Fuehrungssensor" VAL_BLK 0xFD5919 KwbWU8 255.0 DEZ 0.00 255.0 FORMAT "%5.1" NUMBER 4 /end CHARACTERISTIC
/begin CHARACTERISTIC FFTDVFFS2 "Freeze Frame Tabelle: Fehler Fuehrungssensor Bank 2" VAL_BLK 0xFD591D KwbWU8 255.0 DEZ 0.00 255.0 FORMAT "%5.1" NUMBER 4 /end CHARACTERISTIC
/begin CHARACTERISTIC FFTDVFRS "Freeze Frame Tabelle: Fehler Referenzsensor" VAL_BLK 0xFD5921 KwbWU8 255.0 DEZ 0.00 255.0 FORMAT "%5.1" NUMBER 4 /end CHARACTERISTIC
/begin CHARACTERISTIC FFTDVFRS2 "Freeze Frame Tabelle: Fehler Referenzsensor Bank 2" VAL_BLK 0xFD5925 KwbWU8 255.0 DEZ 0.00 255.0 FORMAT "%5.1" NUMBER 4 /end CHARACTERISTIC
/begin CHARACTERISTIC FFTDVFSG "Freeze Frame Tabelle: Fehler Steuergeraet intern" VAL_BLK 0xFD5929 KwbWU8 255.0 DEZ 0.00 255.0 FORMAT "%5.1" NUMBER 4 /end CHARACTERISTIC
/begin CHARACTERISTIC FFTDVFSG2 "Freeze Frame Tabelle: Fehler Steuergeraet intern Bank 2" VAL_BLK 0xFD592D KwbWU8 255.0 DEZ 0.00 255.0 FORMAT "%5.1" NUMBER 4 /end CHARACTERISTIC
/begin CHARACTERISTIC FFTDVLRN "Freeze Frame Tabelle: Fehler Anschlaglernen" VAL_BLK 0xFD5931 KwbWU8 255.0 DEZ 0.00 255.0 FORMAT "%5.1" NUMBER 4 /end CHARACTERISTIC
/begin CHARACTERISTIC FFTDVLRN2 "Freeze Frame Tabelle: Fehler Anschlaglernen Bank 2" VAL_BLK 0xFD5935 KwbWU8 255.0 DEZ 0.00 255.0 FORMAT "%5.1" NUMBER 4 /end CHARACTERISTIC
/begin CHARACTERISTIC FFTDVOVL "" VAL_BLK 0xFD5939 KwbWU8 255.0 DEZ 0.00 255.0 FORMAT "%5.1" NUMBER 4 /end CHARACTERISTIC
/begin CHARACTERISTIC FFTDVOVL2 "" VAL_BLK 0xFD593D KwbWU8 255.0 DEZ 0.00 255.0 FORMAT "%5.1" NUMBER 4 /end CHARACTERISTIC
/begin CHARACTERISTIC FFTDVPLA "Freeze Frame Tabelle: Fehler Sensorplausibilisierung" VAL_BLK 0xFD5941 KwbWU8 255.0 DEZ 0.00 255.0 FORMAT "%5.1" NUMBER 4 /end CHARACTERISTIC
/begin CHARACTERISTIC FFTDVPLA2 "Freeze Frame Tabelle: Fehler Sensorplausibilisierung Bank 2" VAL_BLK 0xFD5945 KwbWU8 255.0 DEZ 0.00 255.0 FORMAT "%5.1" NUMBER 4 /end CHARACTERISTIC
/begin CHARACTERISTIC FFTDVPMN "Freeze Frame Tabelle: Leistungsbegrenzung" VAL_BLK 0xFD5949 KwbWU8 255.0 DEZ 0.00 255.0 FORMAT "%5.1" NUMBER 4 /end CHARACTERISTIC
/begin CHARACTERISTIC FFTDVSTE "Freeze Frame Tabelle: Fehler Stellgliedueberwachung" VAL_BLK 0xFD594D KwbWU8 255.0 DEZ 0.00 255.0 FORMAT "%5.1" NUMBER 4 /end CHARACTERISTIC
/begin CHARACTERISTIC FFTDVSTE2 "Freeze Frame Tabelle: Fehler Stellgliedueberwachung Bank 2" VAL_BLK 0xFD5951 KwbWU8 255.0 DEZ 0.00 255.0 FORMAT "%5.1" NUMBER 4 /end CHARACTERISTIC
/begin CHARACTERISTIC FFTDVULV "Freeze Frame Tabelle: Fehler Leistungsversorgung VVT" VAL_BLK 0xFD5955 KwbWU8 255.0 DEZ 0.00 255.0 FORMAT "%5.1" NUMBER 4 /end CHARACTERISTIC
/begin CHARACTERISTIC FFTDVULV2 "Freeze Frame Tabelle: Fehler Leistungsversorgung VVT Bank 2" VAL_BLK 0xFD5959 KwbWU8 255.0 DEZ 0.00 255.0 FORMAT "%5.1" NUMBER 4 /end CHARACTERISTIC
/begin CHARACTERISTIC FFTDVUSE "Freeze Frame Tabelle: Fehler Sensor-Versorgungsspannung" VAL_BLK 0xFD595D KwbWU8 255.0 DEZ 0.00 255.0 FORMAT "%5.1" NUMBER 4 /end CHARACTERISTIC
/begin CHARACTERISTIC FFTDVUSE2 "Freeze Frame Tabelle: Fehler Sensor-Versorgungsspannung Bank 2" VAL_BLK 0xFD5961 KwbWU8 255.0 DEZ 0.00 255.0 FORMAT "%5.1" NUMBER 4 /end CHARACTERISTIC
/begin CHARACTERISTIC FFTENWS "Freeze Frame Tabelle: Nockenwellensteuerung Einlass Nockenwelle" VAL_BLK 0xFD5999 KwbWU8 255.0 DEZ 0.00 255.0 FORMAT "%5.1" NUMBER 4 /end CHARACTERISTIC
/begin CHARACTERISTIC FFTENWS2 "Freeze Frame Tabelle: Nockenwellensteuerung Einlass Nockenwelle 2" VAL_BLK 0xFD599D KwbWU8 255.0 DEZ 0.00 255.0 FORMAT "%5.1" NUMBER 4 /end CHARACTERISTIC
/begin CHARACTERISTIC FFTENWSE "Freeze Frame Tabelle: Einlaﬂnockenwelle- Endstufe" VAL_BLK 0xFD59A1 KwbWU8 255.0 dez 0.00 255.0 FORMAT "%5.1" NUMBER 4 /end CHARACTERISTIC
/begin CHARACTERISTIC FFTENWSE2 "Freeze Frame Tabelle: Einlaﬂnockenwelle- Endstufe Bank2" VAL_BLK 0xFD59A5 KwbWU8 255.0 dez 0.00 255.0 FORMAT "%5.1" NUMBER 4 /end CHARACTERISTIC
/begin CHARACTERISTIC FFTPH "Freeze Frame Tabelle: Phasensensor" VAL_BLK 0xFD5B21 KwbWU8 255.0 dez 0.00 255.0 FORMAT "%5.1" NUMBER 4 /end CHARACTERISTIC
/begin CHARACTERISTIC FFTPH2 "Freeze Frame Tabelle: Phasensensor Bank 2" VAL_BLK 0xFD5B25 KwbWU8 255.0 dez 0.00 255.0 FORMAT "%5.1" NUMBER 4 /end CHARACTERISTIC
/begin CHARACTERISTIC FFTPH3 "Freeze Frame Tabelle: Phasensensor 3" VAL_BLK 0xFD5B29 KwbWU8 255.0 dez 0.00 255.0 FORMAT "%5.1" NUMBER 4 /end CHARACTERISTIC
/begin CHARACTERISTIC FFTPH4 "Freeze Frame Tabelle: Phasensensor 4" VAL_BLK 0xFD5B2D KwbWU8 255.0 dez 0.00 255.0 FORMAT "%5.1" NUMBER 4 /end CHARACTERISTIC
/begin CHARACTERISTIC FFTPHM "Freeze Frame Tabelle: Phasensensor MIL" VAL_BLK 0xFD5B31 KwbWU8 255.0 dez 0.00 255.0 FORMAT "%5.1" NUMBER 4 /end CHARACTERISTIC
/begin CHARACTERISTIC FFTPLLSU "" VAL_BLK 0xFD5B35 KwbUb 255.0 dez 0.00 255.0 FORMAT "%5.1" NUMBER 4 /end CHARACTERISTIC
/begin CHARACTERISTIC FFTPLLSU2 "" VAL_BLK 0xFD5B39 KwbUb 255.0 dez 0.00 255.0 FORMAT "%5.1" NUMBER 4 /end CHARACTERISTIC
/begin CHARACTERISTIC FFTPOELS "" VAL_BLK 0xFD5B45 KwbUb 255.0 dez 0.00 255.0 FORMAT "%5.1" NUMBER 4 /end CHARACTERISTIC
/begin CHARACTERISTIC FFTSLPE "Freeze Frame Tabelle: Sekund‰rluftpumpe Endstufe" VAL_BLK 0xFD5B59 KwbWU8 255.0 dez 0.00 255.0 FORMAT "%5.1" NUMBER 4 /end CHARACTERISTIC
/begin CHARACTERISTIC FFTSLS "Freeze Frame Tabelle: Sekund‰rluftsystem" VAL_BLK 0xFD5B5D KwbUb 255.0 dez 0.00 255.0 FORMAT "%5.1" NUMBER 4 /end CHARACTERISTIC
/begin CHARACTERISTIC FFTSLS2 "Freeze Frame Tabelle: Sekund‰rluftsystem, Bank 2" VAL_BLK 0xFD5B61 KwbUb 255.0 dez 0.00 255.0 FORMAT "%5.1" NUMBER 4 /end CHARACTERISTIC
/begin CHARACTERISTIC FFTSLV "Freeze Frame Tabelle: Dichtheit Sekund‰rluftventil" VAL_BLK 0xFD5B65 KwbUb 255.0 dez 0.00 255.0 FORMAT "%5.1" NUMBER 4 /end CHARACTERISTIC
/begin CHARACTERISTIC FFTSLV2 "Freeze Frame Tabelle: Dichtheit Sekund‰rluftventil, Bank 2" VAL_BLK 0xFD5B69 KwbUb 255.0 dez 0.00 255.0 FORMAT "%5.1" NUMBER 4 /end CHARACTERISTIC
/begin CHARACTERISTIC FFTSTA "Freeze Frame Tabelle : Startautomatik-Ansteuerung" VAL_BLK 0xFD5B71 KwbUb 255.0 dez 0.00 255.0 FORMAT "%5.1" NUMBER 4 /end CHARACTERISTIC
/begin CHARACTERISTIC FFTSTS "Freeze Frame Tabelle: Startsignal" VAL_BLK 0xFD5B75 KwbWU8 255.0 dez 0.00 255.0 FORMAT "%5.1" NUMBER 4 /end CHARACTERISTIC
/begin CHARACTERISTIC FFTSUE "Freeze Frame Tabelle: Saugrohrumschaltung Endstufe" VAL_BLK 0xFD5B79 KwbUb 255.0 dez 0.00 255.0 FORMAT "%5.1" NUMBER 4 /end CHARACTERISTIC
/begin CHARACTERISTIC FFTTES "Freeze Frame Tabelle: Tankentl¸ftungsventil" VAL_BLK 0xFD5B85 KwbWU8 255.0 dez 0.00 255.0 FORMAT "%5.1" NUMBER 4 /end CHARACTERISTIC
/begin CHARACTERISTIC FFTTEVE "Freeze Frame Tabelle: Tankentl¸ftungsventil Endstufe" VAL_BLK 0xFD5B8D KwbWU8 255.0 dez 0.00 255.0 FORMAT "%5.1" NUMBER 4 /end CHARACTERISTIC
/begin CHARACTERISTIC FFTTHS "Umweltbedingungen DTHS" VAL_BLK 0xFD5B91 KwbWU8 255.0 DEZ 0.00 255.0 FORMAT "%5.1" NUMBER 4 /end CHARACTERISTIC
/begin CHARACTERISTIC FFTUFMV "Freeze Frame Tabelle: Funktions¸berwachung: Momentenvergleich" VAL_BLK 0xFD5BA5 KwbUb 255.0 dez 0.00 255.0 FORMAT "%5.1" NUMBER 4 /end CHARACTERISTIC
/begin CHARACTERISTIC FFTUFNC "Freeze Frame Tabelle: Fkt¸berwachung: Drehzahlgeber-, Zuleitung- oder SG-Fehler" VAL_BLK 0xFD5BA9 KwbUb 255.0 dez 0.00 255.0 FORMAT "%5.1" NUMBER 4 /end CHARACTERISTIC
/begin CHARACTERISTIC FFTUFRLIP "Freeze Frame Tabelle: Fkt¸berwachung: Lastsensor-, Zuleitung- oder SG-Fehler" VAL_BLK 0xFD5BAD KwbUb 255.0 dez 0.00 255.0 FORMAT "%5.1" NUMBER 4 /end CHARACTERISTIC
/begin CHARACTERISTIC FFTUFSGA "Freeze Frame Tabelle: Funktions¸berwachung: Steuerger‰te-Fehler Gruppe a" VAL_BLK 0xFD5BB1 KwbUb 255.0 dez 0.00 255.0 FORMAT "%5.1" NUMBER 4 /end CHARACTERISTIC
/begin CHARACTERISTIC FFTUFSGB "Freeze Frame Tabelle: Funktions¸berwachung: Steuerger‰te-Fehler Gruppe b" VAL_BLK 0xFD5BB5 KwbUb 255.0 dez 0.00 255.0 FORMAT "%5.1" NUMBER 4 /end CHARACTERISTIC
/begin CHARACTERISTIC FFTUFSGC "Freeze Frame Tabelle: Funktions¸berwachung: Steuerger‰te-Fehler Gruppe c" VAL_BLK 0xFD5BB9 KwbUb 255.0 dez 0.00 255.0 FORMAT "%5.1" NUMBER 4 /end CHARACTERISTIC
/begin CHARACTERISTIC FFTUFSPSC "Freeze Frame Tabelle: Fkt¸berwachung: Pedalwertgeber-, Zuleitung- oder SG-Fehler" VAL_BLK 0xFD5BBD KwbUb 255.0 dez 0.00 255.0 FORMAT "%5.1" NUMBER 4 /end CHARACTERISTIC
/begin CHARACTERISTIC FFTULSU "" VAL_BLK 0xFD5BC1 KwbUb 255.0 dez 0.00 255.0 FORMAT "%5.1" NUMBER 4 /end CHARACTERISTIC
/begin CHARACTERISTIC FFTULSU2 "" VAL_BLK 0xFD5BC5 KwbUb 255.0 dez 0.00 255.0 FORMAT "%5.1" NUMBER 4 /end CHARACTERISTIC
/begin CHARACTERISTIC FFTURRAM "Freeze Frame Tabelle: Rechner¸berwachung: RAM" VAL_BLK 0xFD5BC9 KwbUb 255.0 dez 0.00 255.0 FORMAT "%5.1" NUMBER 4 /end CHARACTERISTIC
/begin CHARACTERISTIC FFTURROM "Freeze Frame Tabelle: Rechner¸berwachung: ROM" VAL_BLK 0xFD5BCD KwbUb 255.0 dez 0.00 255.0 FORMAT "%5.1" NUMBER 4 /end CHARACTERISTIC
/begin CHARACTERISTIC FFTURRST "Freeze Frame Tabelle: Rechner¸berwachung: Reset" VAL_BLK 0xFD5BD1 KwbUb 255.0 dez 0.00 255.0 FORMAT "%5.1" NUMBER 4 /end CHARACTERISTIC
/begin CHARACTERISTIC FFTVAT "Freeze Frame Tabelle: angezeigte Fahrzeuggeschwindigkeit im Tacho" VAL_BLK 0xFD5BD5 KwbUb 255.0 dez 0.00 255.0 FORMAT "%5.1" NUMBER 4 /end CHARACTERISTIC
/begin CHARACTERISTIC FFTVFZ "Freeze Frame Tabelle: Geschwindigkeitssignal" VAL_BLK 0xFD5BD9 KwbUb 255.0 dez 0.00 255.0 FORMAT "%5.1" NUMBER 4 /end CHARACTERISTIC
/begin CHARACTERISTIC TSFANWSE "Fehlersummenzeit: Auslaﬂnockenwelle- Endstufe" VALUE 0xFD5C0A KwWU8 255.0 dez 0.00 255.0 FORMAT "%5.1" /end CHARACTERISTIC
/begin CHARACTERISTIC TSFANWSE2 "Fehlersummenzeit: Auslaﬂnockenwelle- Endstufe Bank2" VALUE 0xFD5C0B KwWU8 255.0 dez 0.00 255.0 FORMAT "%5.1" /end CHARACTERISTIC
/begin CHARACTERISTIC TSFDVAN "Fehlersummenzeit: Fehler VVT-Anschlaglernen" VALUE 0xFD5C34 KwWU8 255.0 DEZ 0.00 255.0 FORMAT "%5.1" /end CHARACTERISTIC
/begin CHARACTERISTIC TSFDVCAN "Fehlersummenzeit: Fehler CAN-Kommunikation" VALUE 0xFD5C35 KwWU8 255.0 DEZ 0.00 255.0 FORMAT "%5.1" /end CHARACTERISTIC
/begin CHARACTERISTIC TSFDVCAN2 "Fehlersummenzeit: Fehler CAN-Kommunikation Bank 2" VALUE 0xFD5C36 KwWU8 255.0 DEZ 0.00 255.0 FORMAT "%5.1" /end CHARACTERISTIC
/begin CHARACTERISTIC TSFDVEST "Fehlersummenzeit: Fehler Endstufe" VALUE 0xFD5C3D KwWU8 255.0 DEZ 0.00 255.0 FORMAT "%5.1" /end CHARACTERISTIC
/begin CHARACTERISTIC TSFDVEST2 "Fehlersummenzeit: Fehler Endstufe Bank 2" VALUE 0xFD5C3E KwWU8 255.0 DEZ 0.00 255.0 FORMAT "%5.1" /end CHARACTERISTIC
/begin CHARACTERISTIC TSFDVFFS "Fehlersummenzeit: Fehler Fuehrungssensor" VALUE 0xFD5C44 KwWU8 255.0 DEZ 0.00 255.0 FORMAT "%5.1" /end CHARACTERISTIC
/begin CHARACTERISTIC TSFDVFFS2 "Fehlersummenzeit: Fehler Fuehrungssensor Bank 2" VALUE 0xFD5C45 KwWU8 255.0 DEZ 0.00 255.0 FORMAT "%5.1" /end CHARACTERISTIC
/begin CHARACTERISTIC TSFDVFRS "Fehlersummenzeit: Fehler Referenzsensor" VALUE 0xFD5C46 KwWU8 255.0 DEZ 0.00 255.0 FORMAT "%5.1" /end CHARACTERISTIC
/begin CHARACTERISTIC TSFDVFRS2 "Fehlersummenzeit: Fehler Referenzsensor Bank 2" VALUE 0xFD5C47 KwWU8 255.0 DEZ 0.00 255.0 FORMAT "%5.1" /end CHARACTERISTIC
/begin CHARACTERISTIC TSFDVFSG "Fehlersummenzeit: Fehler Steuergeraet intern" VALUE 0xFD5C48 KwWU8 255.0 DEZ 0.00 255.0 FORMAT "%5.1" /end CHARACTERISTIC
/begin CHARACTERISTIC TSFDVFSG2 "Fehlersummenzeit: Fehler Steuergeraet intern Bank 2" VALUE 0xFD5C49 KwWU8 255.0 DEZ 0.00 255.0 FORMAT "%5.1" /end CHARACTERISTIC
/begin CHARACTERISTIC TSFDVLRN "Fehlersummenzeit: Fehler Anschlaglernen" VALUE 0xFD5C4A KwWU8 255.0 DEZ 0.00 255.0 FORMAT "%5.1" /end CHARACTERISTIC
/begin CHARACTERISTIC TSFDVLRN2 "Fehlersummenzeit: Fehler Anschlaglernen Bank 2" VALUE 0xFD5C4B KwWU8 255.0 DEZ 0.00 255.0 FORMAT "%5.1" /end CHARACTERISTIC
/begin CHARACTERISTIC TSFDVOVL "" VALUE 0xFD5C4C KwWU8 255.0 DEZ 0.00 255.0 FORMAT "%5.1" /end CHARACTERISTIC
/begin CHARACTERISTIC TSFDVOVL2 "" VALUE 0xFD5C4D KwWU8 255.0 DEZ 0.00 255.0 FORMAT "%5.1" /end CHARACTERISTIC
/begin CHARACTERISTIC TSFDVPLA "Fehlersummenzeit: Fehler Sensorplausibilisierung" VALUE 0xFD5C4E KwWU8 255.0 DEZ 0.00 255.0 FORMAT "%5.1" /end CHARACTERISTIC
/begin CHARACTERISTIC TSFDVPLA2 "Fehlersummenzeit: Fehler Sensorplausibilisierung Bank 2" VALUE 0xFD5C4F KwWU8 255.0 DEZ 0.00 255.0 FORMAT "%5.1" /end CHARACTERISTIC
/begin CHARACTERISTIC TSFDVPMN "Fehlersummenzeit: Leistungsbegrenzung" VALUE 0xFD5C50 KwWU8 255.0 DEZ 0.00 255.0 FORMAT "%5.1" /end CHARACTERISTIC
/begin CHARACTERISTIC TSFDVSTE "Fehlersummenzeit: Fehler Stellgliedueberwachung" VALUE 0xFD5C51 KwWU8 255.0 DEZ 0.00 255.0 FORMAT "%5.1" /end CHARACTERISTIC
/begin CHARACTERISTIC TSFDVSTE2 "Fehlersummenzeit: Fehler Stellgliedueberwachung Bank 2" VALUE 0xFD5C52 KwWU8 255.0 DEZ 0.00 255.0 FORMAT "%5.1" /end CHARACTERISTIC
/begin CHARACTERISTIC TSFDVULV "Fehlersummenzeit: Fehler Leistungsversorgung VVT" VALUE 0xFD5C53 KwWU8 255.0 DEZ 0.00 255.0 FORMAT "%5.1" /end CHARACTERISTIC
/begin CHARACTERISTIC TSFDVULV2 "Fehlersummenzeit: Fehler Leistungsversorgung VVT Bank 2" VALUE 0xFD5C54 KwWU8 255.0 DEZ 0.00 255.0 FORMAT "%5.1" /end CHARACTERISTIC
/begin CHARACTERISTIC TSFDVUSE "Fehlersummenzeit: Fehler Sensor-Versorgungsspannung" VALUE 0xFD5C55 KwWU8 255.0 DEZ 0.00 255.0 FORMAT "%5.1" /end CHARACTERISTIC
/begin CHARACTERISTIC TSFDVUSE2 "Fehlersummenzeit: Fehler Sensor-Versorgungsspannung Bank 2" VALUE 0xFD5C56 KwWU8 255.0 DEZ 0.00 255.0 FORMAT "%5.1" /end CHARACTERISTIC
/begin CHARACTERISTIC TSFENWS "Fehlersummenzeit: Nockenwellensteuerung Einlass Nockenwelle" VALUE 0xFD5C64 KwWU8 255.0 DEZ 0.00 255.0 FORMAT "%5.1" /end CHARACTERISTIC
/begin CHARACTERISTIC TSFENWS2 "Fehlersummenzeit: Nockenwellensteuerung Einlass Nockenwelle 2" VALUE 0xFD5C65 KwWU8 255.0 DEZ 0.00 255.0 FORMAT "%5.1" /end CHARACTERISTIC
/begin CHARACTERISTIC TSFENWSE "Fehlersummenzeit: Einlaﬂnockenwelle- Endstufe" VALUE 0xFD5C66 KwWU8 255.0 dez 0.00 255.0 FORMAT "%5.1" /end CHARACTERISTIC
/begin CHARACTERISTIC TSFENWSE2 "Fehlersummenzeit: Einlaﬂnockenwelle- Endstufe Bank2" VALUE 0xFD5C67 KwWU8 255.0 dez 0.00 255.0 FORMAT "%5.1" /end CHARACTERISTIC
/begin CHARACTERISTIC TSFPH "Fehlersummenzeit: Phasensensor" VALUE 0xFD5CC6 KwWU8 255.0 dez 0.00 255.0 FORMAT "%5.1" /end CHARACTERISTIC
/begin CHARACTERISTIC TSFPH2 "Fehlersummenzeit: Phasensensor 2" VALUE 0xFD5CC7 KwWU8 255.0 dez 0.00 255.0 FORMAT "%5.1" /end CHARACTERISTIC
/begin CHARACTERISTIC TSFPH3 "Fehlersummenzeit: Phasensensor 3" VALUE 0xFD5CC8 KwWU8 255.0 dez 0.00 255.0 FORMAT "%5.1" /end CHARACTERISTIC
/begin CHARACTERISTIC TSFPH4 "Fehlersummenzeit: Phasensensor 4" VALUE 0xFD5CC9 KwWU8 255.0 dez 0.00 255.0 FORMAT "%5.1" /end CHARACTERISTIC
/begin CHARACTERISTIC TSFPHM "Fehlersummenzeit: Phasensensor MIL" VALUE 0xFD5CCA KwWU8 255.0 dez 0.00 255.0 FORMAT "%5.1" /end CHARACTERISTIC
/begin CHARACTERISTIC TSFPLLSU "" VALUE 0xFD5CCB KwUb 255.0 dez 0.00 255.0 FORMAT "%5.1" /end CHARACTERISTIC
/begin CHARACTERISTIC TSFPLLSU2 "" VALUE 0xFD5CCC KwUb 255.0 dez 0.00 255.0 FORMAT "%5.1" /end CHARACTERISTIC
/begin CHARACTERISTIC TSFPOELS "Fehlersummenzeit: Plausibilit‰t ÷ldruckschalter" VALUE 0xFD5CCF KwUb 255.0 dez 0.00 255.0 FORMAT "%5.1" /end CHARACTERISTIC
/begin CHARACTERISTIC TSFSLPE "Fehlersummenzeit: Sekund‰rluftpumpe (Endstufe)" VALUE 0xFD5CD4 KwWU8 255.0 dez 0.00 255.0 FORMAT "%5.1" /end CHARACTERISTIC
/begin CHARACTERISTIC TSFSLS "Fehlersummenzeit: Sekund‰rluft-System" VALUE 0xFD5CD5 KwUb 255.0 dez 0.00 255.0 FORMAT "%5.1" /end CHARACTERISTIC
/begin CHARACTERISTIC TSFSLS2 "Fehlersummenzeit: Sekund‰rluft-System Bank 2" VALUE 0xFD5CD6 KwUb 255.0 dez 0.00 255.0 FORMAT "%5.1" /end CHARACTERISTIC
/begin CHARACTERISTIC TSFSLV "Fehlersummenzeit: Sekund‰rluftventil" VALUE 0xFD5CD7 KwUb 255.0 dez 0.00 255.0 FORMAT "%5.1" /end CHARACTERISTIC
/begin CHARACTERISTIC TSFSLV2 "Fehlersummenzeit: Sekund‰rluftventil, Bank 2" VALUE 0xFD5CD8 KwUb 255.0 dez 0.00 255.0 FORMAT "%5.1" /end CHARACTERISTIC
/begin CHARACTERISTIC TSFSTA "Fehlersummenzeit: Startautomatik" VALUE 0xFD5CDA KwUb 255.0 dez 0.00 255.0 FORMAT "%5.1" /end CHARACTERISTIC
/begin CHARACTERISTIC TSFSTS "Fehlersummenzeit: Startsignal" VALUE 0xFD5CDB KwWU8 255.0 dez 0.00 255.0 FORMAT "%5.1" /end CHARACTERISTIC
/begin CHARACTERISTIC TSFSUE "Fehlersummenzeit: Endstufe Saugrohrumschaltung" VALUE 0xFD5CDC KwUb 255.0 dez 0.00 255.0 FORMAT "%5.1" /end CHARACTERISTIC
/begin CHARACTERISTIC TSFTES "Fehlersummenzeit: Tankentl¸ftungssystem" VALUE 0xFD5CDF KwWU8 255.0 dez 0.00 255.0 FORMAT "%5.1" /end CHARACTERISTIC
/begin CHARACTERISTIC TSFTEVE "Fehlersummenzeit: Tankentl¸ftungsventil Endstufe" VALUE 0xFD5CE1 KwWU8 255.0 dez 0.00 255.0 FORMAT "%5.1" /end CHARACTERISTIC
/begin CHARACTERISTIC TSFTHS "Schwelle f¸r Fehlerschwere DTHS" VALUE 0xFD5CE2 KwWU8 255.0 DEZ 0.00 255.0 FORMAT "%5.1" /end CHARACTERISTIC
/begin CHARACTERISTIC TSFUFMV "Fehlersummenzeit: Funktions¸berwachung: Momentenvergleich" VALUE 0xFD5CE7 KwUb 255.0 dez 0.00 255.0 FORMAT "%5.1" /end CHARACTERISTIC
/begin CHARACTERISTIC TSFUFNC "Fehlersummenzeit: Fkt¸berwachung: Drehzahlgeber-, Zuleitung- oder SG-Fehler" VALUE 0xFD5CE8 KwUb 255.0 dez 0.00 255.0 FORMAT "%5.1" /end CHARACTERISTIC
/begin CHARACTERISTIC TSFUFRLIP "Fehlersummenzeit: Fkt¸berwachung: Lastsensor-, Zuleitung- oder SG-Fehler" VALUE 0xFD5CE9 KwUb 255.0 dez 0.00 255.0 FORMAT "%5.1" /end CHARACTERISTIC
/begin CHARACTERISTIC TSFUFSGA "Fehlersummenzeit: Funktions¸berwachung: Steuerger‰te-Fehler Gruppe a" VALUE 0xFD5CEA KwUb 255.0 dez 0.00 255.0 FORMAT "%5.1" /end CHARACTERISTIC
/begin CHARACTERISTIC TSFUFSGB "Fehlersummenzeit: Funktions¸berwachung: Steuerger‰te-Fehler Gruppe b" VALUE 0xFD5CEB KwUb 255.0 dez 0.00 255.0 FORMAT "%5.1" /end CHARACTERISTIC
/begin CHARACTERISTIC TSFUFSGC "Fehlersummenzeit: Funktions¸berwachung: Steuerger‰te-Fehler Gruppe c" VALUE 0xFD5CEC KwUb 255.0 dez 0.00 255.0 FORMAT "%5.1" /end CHARACTERISTIC
/begin CHARACTERISTIC TSFUFSPSC "Fehlersummenzeit: Fkt¸berwachung: Pedalwertgeber-, Zuleitung- oder SG-Fehler" VALUE 0xFD5CED KwUb 255.0 dez 0.00 255.0 FORMAT "%5.1" /end CHARACTERISTIC
/begin CHARACTERISTIC TSFULSU "" VALUE 0xFD5CEE KwUb 255.0 dez 0.00 255.0 FORMAT "%5.1" /end CHARACTERISTIC
/begin CHARACTERISTIC TSFULSU2 "" VALUE 0xFD5CEF KwUb 255.0 dez 0.00 255.0 FORMAT "%5.1" /end CHARACTERISTIC
/begin CHARACTERISTIC TSFURRAM "Fehlersummenzeit: Rechner¸berwachung: RAM" VALUE 0xFD5CF0 KwUb 255.0 dez 0.00 255.0 FORMAT "%5.1" /end CHARACTERISTIC
/begin CHARACTERISTIC TSFURROM "Fehlersummenzeit: Rechner¸berwachung: ROM" VALUE 0xFD5CF1 KwUb 255.0 dez 0.00 255.0 FORMAT "%5.1" /end CHARACTERISTIC
/begin CHARACTERISTIC TSFURRST "Fehlersummenzeit: Rechner¸berwachung: Reset" VALUE 0xFD5CF2 KwUb 255.0 dez 0.00 255.0 FORMAT "%5.1" /end CHARACTERISTIC
/begin CHARACTERISTIC TSFVAT "Fehlersummenzeit: angezeigte Fahrzeuggeschwindigkeit im Tacho" VALUE 0xFD5CF3 KwUb 255.0 dez 0.00 255.0 FORMAT "%5.1" /end CHARACTERISTIC
/begin CHARACTERISTIC TSFVFZ "Fehlersummenzeit: Fahrzeug-Geschwindigkeit" VALUE 0xFD5CF4 KwUb 255.0 dez 0.00 255.0 FORMAT "%5.1" /end CHARACTERISTIC
/begin MEASUREMENT B_beanwse "Bedingung Bandende-Funktionsanforderung NWS Endstufe (Bank1, Auslaﬂ)" UWORD B_TRUE 1 100 0 1 BIT_MASK 0x20 FORMAT "%13.11" ECU_ADDRESS 0x3FE3B8 /end MEASUREMENT
/begin MEASUREMENT B_beanwse2 "Bedingung Bandende-Funktionsanforderung NWS Endstufe (Bank2, Auslaﬂ)" UWORD B_TRUE 1 100 0 1 BIT_MASK 0x20 FORMAT "%13.11" ECU_ADDRESS 0x3FE3BA /end MEASUREMENT
/begin MEASUREMENT B_bedvan "" UWORD B_TRUE 1 100 0 1 BIT_MASK 0x20 FORMAT "%13.11" ECU_ADDRESS 0x3FE40C /end MEASUREMENT
/begin MEASUREMENT B_bedvcan "" UWORD B_TRUE 1 100 0 1 BIT_MASK 0x20 FORMAT "%13.11" ECU_ADDRESS 0x3FE40E /end MEASUREMENT
/begin MEASUREMENT B_bedvcan2 "" UWORD B_TRUE 1 100 0 1 BIT_MASK 0x20 FORMAT "%13.11" ECU_ADDRESS 0x3FE410 /end MEASUREMENT
/begin MEASUREMENT B_bedvest "Bedingung Bandendetest VVT-Endstufe" UWORD B_TRUE 1 100 0 1 BIT_MASK 0x20 FORMAT "%13.11" ECU_ADDRESS 0x3FE41E /end MEASUREMENT
/begin MEASUREMENT B_bedvest2 "" UWORD B_TRUE 1 100 0 1 BIT_MASK 0x20 FORMAT "%13.11" ECU_ADDRESS 0x3FE420 /end MEASUREMENT
/begin MEASUREMENT B_bedvffs "Bedingung Bandendetest VVT-F¸hrungssensor" UWORD B_TRUE 1 100 0 1 BIT_MASK 0x20 FORMAT "%13.11" ECU_ADDRESS 0x3FE42C /end MEASUREMENT
/begin MEASUREMENT B_bedvffs2 "" UWORD B_TRUE 1 100 0 1 BIT_MASK 0x20 FORMAT "%13.11" ECU_ADDRESS 0x3FE42E /end MEASUREMENT
/begin MEASUREMENT B_bedvfrs "Bedingung Bandendetest VVT-Referenzsensor" UWORD B_TRUE 1 100 0 1 BIT_MASK 0x20 FORMAT "%13.11" ECU_ADDRESS 0x3FE430 /end MEASUREMENT
/begin MEASUREMENT B_bedvfrs2 "" UWORD B_TRUE 1 100 0 1 BIT_MASK 0x20 FORMAT "%13.11" ECU_ADDRESS 0x3FE432 /end MEASUREMENT
/begin MEASUREMENT B_bedvfsg "" UWORD B_TRUE 1 100 0 1 BIT_MASK 0x20 FORMAT "%13.11" ECU_ADDRESS 0x3FE434 /end MEASUREMENT
/begin MEASUREMENT B_bedvfsg2 "" UWORD B_TRUE 1 100 0 1 BIT_MASK 0x20 FORMAT "%13.11" ECU_ADDRESS 0x3FE436 /end MEASUREMENT
/begin MEASUREMENT B_bedvlrn "Bedingung Bandendetest VVT-Anschlaglernen" UWORD B_TRUE 1 100 0 1 BIT_MASK 0x20 FORMAT "%13.11" ECU_ADDRESS 0x3FE438 /end MEASUREMENT
/begin MEASUREMENT B_bedvlrn2 "" UWORD B_TRUE 1 100 0 1 BIT_MASK 0x20 FORMAT "%13.11" ECU_ADDRESS 0x3FE43A /end MEASUREMENT
/begin MEASUREMENT B_bedvovl "Bedingung Bandendetest VVT-‹berlastschutz" UWORD B_TRUE 1 100 0 1 BIT_MASK 0x20 FORMAT "%13.11" ECU_ADDRESS 0x3FE43C /end MEASUREMENT
/begin MEASUREMENT B_bedvovl2 "" UWORD B_TRUE 1 100 0 1 BIT_MASK 0x20 FORMAT "%13.11" ECU_ADDRESS 0x3FE43E /end MEASUREMENT
/begin MEASUREMENT B_bedvpla "Bedingung Bandendetest VVT-Sensorplausibilisierung" UWORD B_TRUE 1 100 0 1 BIT_MASK 0x20 FORMAT "%13.11" ECU_ADDRESS 0x3FE440 /end MEASUREMENT
/begin MEASUREMENT B_bedvpla2 "" UWORD B_TRUE 1 100 0 1 BIT_MASK 0x20 FORMAT "%13.11" ECU_ADDRESS 0x3FE442 /end MEASUREMENT
/begin MEASUREMENT B_bedvpmn "Bedingung, Bandende Funktionsanforderung Leistungsbegrenzung VVT dignose" UWORD B_TRUE 1 100 0 1 BIT_MASK 0x20 FORMAT "%13.11" ECU_ADDRESS 0x3FE444 /end MEASUREMENT
/begin MEASUREMENT B_bedvste "Bedingung: Bandendetest DVSTE" UWORD B_TRUE 1 100 0 1 BIT_MASK 0x20 FORMAT "%13.11" ECU_ADDRESS 0x3FE446 /end MEASUREMENT
/begin MEASUREMENT B_bedvste2 "" UWORD B_TRUE 1 100 0 1 BIT_MASK 0x20 FORMAT "%13.11" ECU_ADDRESS 0x3FE448 /end MEASUREMENT
/begin MEASUREMENT B_bedvulv "" UWORD B_TRUE 1 100 0 1 BIT_MASK 0x20 FORMAT "%13.11" ECU_ADDRESS 0x3FE44A /end MEASUREMENT
/begin MEASUREMENT B_bedvulv2 "" UWORD B_TRUE 1 100 0 1 BIT_MASK 0x20 FORMAT "%13.11" ECU_ADDRESS 0x3FE44C /end MEASUREMENT
/begin MEASUREMENT B_bedvuse "Bedingung Bandendetest VVT-Sensorversorgungspannung" UWORD B_TRUE 1 100 0 1 BIT_MASK 0x20 FORMAT "%13.11" ECU_ADDRESS 0x3FE44E /end MEASUREMENT
/begin MEASUREMENT B_bedvuse2 "" UWORD B_TRUE 1 100 0 1 BIT_MASK 0x20 FORMAT "%13.11" ECU_ADDRESS 0x3FE450 /end MEASUREMENT
/begin MEASUREMENT B_beenws "Bedingung Bandende-Funktionsanforderung NWS (Einlass,Bank1)" UWORD B_TRUE 1 100 0 1 BIT_MASK 0x20 FORMAT "%13.11" ECU_ADDRESS 0x3FE46C /end MEASUREMENT
/begin MEASUREMENT B_beenws2 "Bedingung Bandende-Funktionsanforderung NWS2 (Einlass,Bank2)" UWORD B_TRUE 1 100 0 1 BIT_MASK 0x20 FORMAT "%13.11" ECU_ADDRESS 0x3FE46E /end MEASUREMENT
/begin MEASUREMENT B_beenwse "Bedingung Bandende-Funktionsanforderung NWS Endstufe (Bank1, Einlaﬂ)" UWORD B_TRUE 1 100 0 1 BIT_MASK 0x20 FORMAT "%13.11" ECU_ADDRESS 0x3FE470 /end MEASUREMENT
/begin MEASUREMENT B_beenwse2 "Bedingung Bandende-Funktionsanforderung NWS Endstufe (Bank2, Einlaﬂ)" UWORD B_TRUE 1 100 0 1 BIT_MASK 0x20 FORMAT "%13.11" ECU_ADDRESS 0x3FE472 /end MEASUREMENT
/begin MEASUREMENT B_beph "Bedingung: Bandendefunktionanford. f¸r Phasengeber" UWORD B_TRUE 1 100 0 1 BIT_MASK 0x20 FORMAT "%13.11" ECU_ADDRESS 0x3FE530 /end MEASUREMENT
/begin MEASUREMENT B_beph2 "Bedingung: Bandendefunktionanford. f¸r Phasengeber 2" UWORD B_TRUE 1 100 0 1 BIT_MASK 0x20 FORMAT "%13.11" ECU_ADDRESS 0x3FE532 /end MEASUREMENT
/begin MEASUREMENT B_beph3 "Bedingung: Bandendefunktionanford. f¸r Phasengeber 3" UWORD B_TRUE 1 100 0 1 BIT_MASK 0x20 FORMAT "%13.11" ECU_ADDRESS 0x3FE534 /end MEASUREMENT
/begin MEASUREMENT B_beph4 "Bedingung: Bandendefunktionanford. f¸r Phasengeber 4" UWORD B_TRUE 1 100 0 1 BIT_MASK 0x20 FORMAT "%13.11" ECU_ADDRESS 0x3FE536 /end MEASUREMENT
/begin MEASUREMENT B_bephm "Bedingung: Bandendefunktionanford. f¸r Phasengeber MIL" UWORD B_TRUE 1 100 0 1 BIT_MASK 0x20 FORMAT "%13.11" ECU_ADDRESS 0x3FE538 /end MEASUREMENT
/begin MEASUREMENT B_bepllsu "Bedingung: Bandendefunktionanford. f¸r DPLLSU" UWORD B_TRUE 1 100 0 1 BIT_MASK 0x20 FORMAT "%13.11" ECU_ADDRESS 0x3FE53A /end MEASUREMENT
/begin MEASUREMENT B_bepllsu2 "Bedingung: Bandendefunktionanford. f¸r DPLLSU, Bank 2" UWORD B_TRUE 1 100 0 1 BIT_MASK 0x20 FORMAT "%13.11" ECU_ADDRESS 0x3FE53C /end MEASUREMENT
/begin MEASUREMENT B_bepoels "Bandendebit f¸r die Plausibilisierung des ÷ldruckschalters" UWORD B_TRUE 1 100 0 1 BIT_MASK 0x20 FORMAT "%13.11" ECU_ADDRESS 0x3FE542 /end MEASUREMENT
/begin MEASUREMENT B_beslpe "Bedingung Bandendeanforderung setzt Fehler Sekund‰rluftpumpe Endstufe" UWORD B_TRUE 1 100 0 1 BIT_MASK 0x20 FORMAT "%13.11" ECU_ADDRESS 0x3FE54C /end MEASUREMENT
/begin MEASUREMENT B_besls "Bedingung Bandende-Funktionsanforderung Sekund‰rluftsystem" UWORD B_TRUE 1 100 0 1 BIT_MASK 0x20 FORMAT "%13.11" ECU_ADDRESS 0x3FE54E /end MEASUREMENT
/begin MEASUREMENT B_besls2 "Bedingung Bandende-Funktionsanforderung Sekund‰rluftsystem, Bank2" UWORD B_TRUE 1 100 0 1 BIT_MASK 0x20 FORMAT "%13.11" ECU_ADDRESS 0x3FE550 /end MEASUREMENT
/begin MEASUREMENT B_beslv "Bedingung Bandende-Funktionsanforderung SLS" UWORD B_TRUE 1 100 0 1 BIT_MASK 0x20 FORMAT "%13.11" ECU_ADDRESS 0x3FE552 /end MEASUREMENT
/begin MEASUREMENT B_beslv2 "Bedingung Bandende-Funktionsanforderung SLS, Bank2" UWORD B_TRUE 1 100 0 1 BIT_MASK 0x20 FORMAT "%13.11" ECU_ADDRESS 0x3FE554 /end MEASUREMENT
/begin MEASUREMENT B_besta "Bedingung Bandendeanforderung f¸r Automatikstart" UWORD B_TRUE 1 100 0 1 BIT_MASK 0x20 FORMAT "%13.11" ECU_ADDRESS 0x3FE558 /end MEASUREMENT
/begin MEASUREMENT B_bests "" UWORD B_TRUE 1 100 0 1 BIT_MASK 0x20 FORMAT "%13.11" ECU_ADDRESS 0x3FE55A /end MEASUREMENT
/begin MEASUREMENT B_besue "Bedingung Bandendeanforderung f¸r Endstufe Saugrohrumschaltung" UWORD B_TRUE 1 100 0 1 BIT_MASK 0x20 FORMAT "%13.11" ECU_ADDRESS 0x3FE55C /end MEASUREMENT
/begin MEASUREMENT B_beteve "Bedingung Bandendeanford. f¸r Fehler Tanentl¸ftungsventil Endstufe" UWORD B_TRUE 1 100 0 1 BIT_MASK 0x20 FORMAT "%13.11" ECU_ADDRESS 0x3FE566 /end MEASUREMENT
/begin MEASUREMENT B_beths "Bandendepr¸fung" UWORD B_TRUE 1 100 0 1 BIT_MASK 0x20 FORMAT "%13.11" ECU_ADDRESS 0x3FE568 /end MEASUREMENT
/begin MEASUREMENT B_beufmv "Bedingung Bandende:Fkt¸berwachung-Anforderung" UWORD B_TRUE 1 100 0 1 BIT_MASK 0x20 FORMAT "%13.11" ECU_ADDRESS 0x3FE572 /end MEASUREMENT
/begin MEASUREMENT B_beufnc "Bedingung Bandende:Fkt¸berwachung-Anforderung" UWORD B_TRUE 1 100 0 1 BIT_MASK 0x20 FORMAT "%13.11" ECU_ADDRESS 0x3FE574 /end MEASUREMENT
/begin MEASUREMENT B_beufrlip "Bedingung Bandende:Fkt¸berwachung-Anforderung" UWORD B_TRUE 1 100 0 1 BIT_MASK 0x20 FORMAT "%13.11" ECU_ADDRESS 0x3FE576 /end MEASUREMENT
/begin MEASUREMENT B_beufsga "Bedingung Bandende:Fkt¸berwachung-Anforderung" UWORD B_TRUE 1 100 0 1 BIT_MASK 0x20 FORMAT "%13.11" ECU_ADDRESS 0x3FE578 /end MEASUREMENT
/begin MEASUREMENT B_beufsgb "Bedingung Bandende:Fkt¸berwachung-Anforderung" UWORD B_TRUE 1 100 0 1 BIT_MASK 0x20 FORMAT "%13.11" ECU_ADDRESS 0x3FE57A /end MEASUREMENT
/begin MEASUREMENT B_beufsgc "Bedingung Bandende:Fkt¸berwachung-Anforderung" UWORD B_TRUE 1 100 0 1 BIT_MASK 0x20 FORMAT "%13.11" ECU_ADDRESS 0x3FE57C /end MEASUREMENT
/begin MEASUREMENT B_beufspsc "Bedingung Bandende:Fkt¸berwachung-Anforderung" UWORD B_TRUE 1 100 0 1 BIT_MASK 0x20 FORMAT "%13.11" ECU_ADDRESS 0x3FE57E /end MEASUREMENT
/begin MEASUREMENT B_beulsu "Bedingung: Bandendefunktionanford. f¸r DULSU" UWORD B_TRUE 1 100 0 1 BIT_MASK 0x20 FORMAT "%13.11" ECU_ADDRESS 0x3FE580 /end MEASUREMENT
/begin MEASUREMENT B_beulsu2 "Bedingung: Bandendefunktionanford. f¸r DULSU, Bank 2" UWORD B_TRUE 1 100 0 1 BIT_MASK 0x20 FORMAT "%13.11" ECU_ADDRESS 0x3FE582 /end MEASUREMENT
/begin MEASUREMENT B_beurram "" UWORD B_TRUE 1 100 0 1 BIT_MASK 0x20 FORMAT "%13.11" ECU_ADDRESS 0x3FE584 /end MEASUREMENT
/begin MEASUREMENT B_beurrom "" UWORD B_TRUE 1 100 0 1 BIT_MASK 0x20 FORMAT "%13.11" ECU_ADDRESS 0x3FE586 /end MEASUREMENT
/begin MEASUREMENT B_beurrst "" UWORD B_TRUE 1 100 0 1 BIT_MASK 0x20 FORMAT "%13.11" ECU_ADDRESS 0x3FE588 /end MEASUREMENT
/begin MEASUREMENT B_bevat "" UWORD B_TRUE 1 100 0 1 BIT_MASK 0x20 FORMAT "%13.11" ECU_ADDRESS 0x3FE58A /end MEASUREMENT
/begin MEASUREMENT B_bevfz "Bedingung Bandende-Funktionsanforderung f¸r Fehlerpfad Fahrzeuggeschwindigkeit" UWORD B_TRUE 1 100 0 1 BIT_MASK 0x20 FORMAT "%13.11" ECU_ADDRESS 0x3FE58C /end MEASUREMENT
/begin MEASUREMENT B_bkanwse "Bedingung Ersatzwert aktiv: NWS Endstufe (Bank1, Auslaﬂ)" UWORD B_TRUE 1 100 0 1 BIT_MASK 0x40 FORMAT "%13.11" ECU_ADDRESS 0x3FE3B8 /end MEASUREMENT
/begin MEASUREMENT B_bkanwse2 "Bedingung Ersatzwert aktiv: NWS Endstufe (Bank2, Auslaﬂ)" UWORD B_TRUE 1 100 0 1 BIT_MASK 0x40 FORMAT "%13.11" ECU_ADDRESS 0x3FE3BA /end MEASUREMENT
/begin MEASUREMENT B_bkdvan "" UWORD B_TRUE 1 100 0 1 BIT_MASK 0x40 FORMAT "%13.11" ECU_ADDRESS 0x3FE40C /end MEASUREMENT
/begin MEASUREMENT B_bkdvcan "" UWORD B_TRUE 1 100 0 1 BIT_MASK 0x40 FORMAT "%13.11" ECU_ADDRESS 0x3FE40E /end MEASUREMENT
/begin MEASUREMENT B_bkdvcan2 "" UWORD B_TRUE 1 100 0 1 BIT_MASK 0x40 FORMAT "%13.11" ECU_ADDRESS 0x3FE410 /end MEASUREMENT
/begin MEASUREMENT B_bkdvest "Erstazwert aktiv: VVT-Endstufe" UWORD B_TRUE 1 100 0 1 BIT_MASK 0x40 FORMAT "%13.11" ECU_ADDRESS 0x3FE41E /end MEASUREMENT
/begin MEASUREMENT B_bkdvest2 "" UWORD B_TRUE 1 100 0 1 BIT_MASK 0x40 FORMAT "%13.11" ECU_ADDRESS 0x3FE420 /end MEASUREMENT
/begin MEASUREMENT B_bkdvffs "Bedingung Ersatzwert aktiv: VVT-F¸hrungssensor" UWORD B_TRUE 1 100 0 1 BIT_MASK 0x40 FORMAT "%13.11" ECU_ADDRESS 0x3FE42C /end MEASUREMENT
/begin MEASUREMENT B_bkdvffs2 "" UWORD B_TRUE 1 100 0 1 BIT_MASK 0x40 FORMAT "%13.11" ECU_ADDRESS 0x3FE42E /end MEASUREMENT
/begin MEASUREMENT B_bkdvfrs "Bedingung Ersatzwert aktiv: VVT-Referenzsensor" UWORD B_TRUE 1 100 0 1 BIT_MASK 0x40 FORMAT "%13.11" ECU_ADDRESS 0x3FE430 /end MEASUREMENT
/begin MEASUREMENT B_bkdvfrs2 "" UWORD B_TRUE 1 100 0 1 BIT_MASK 0x40 FORMAT "%13.11" ECU_ADDRESS 0x3FE432 /end MEASUREMENT
/begin MEASUREMENT B_bkdvfsg "" UWORD B_TRUE 1 100 0 1 BIT_MASK 0x40 FORMAT "%13.11" ECU_ADDRESS 0x3FE434 /end MEASUREMENT
/begin MEASUREMENT B_bkdvfsg2 "" UWORD B_TRUE 1 100 0 1 BIT_MASK 0x40 FORMAT "%13.11" ECU_ADDRESS 0x3FE436 /end MEASUREMENT
/begin MEASUREMENT B_bkdvlrn "Bedingung Ersatzwert aktiv: VVT-Anschlaglernen" UWORD B_TRUE 1 100 0 1 BIT_MASK 0x40 FORMAT "%13.11" ECU_ADDRESS 0x3FE438 /end MEASUREMENT
/begin MEASUREMENT B_bkdvlrn2 "" UWORD B_TRUE 1 100 0 1 BIT_MASK 0x40 FORMAT "%13.11" ECU_ADDRESS 0x3FE43A /end MEASUREMENT
/begin MEASUREMENT B_bkdvovl "Bedingung Ersatzwert aktiv: VVT-‹berlastschutz" UWORD B_TRUE 1 100 0 1 BIT_MASK 0x40 FORMAT "%13.11" ECU_ADDRESS 0x3FE43C /end MEASUREMENT
/begin MEASUREMENT B_bkdvovl2 "" UWORD B_TRUE 1 100 0 1 BIT_MASK 0x40 FORMAT "%13.11" ECU_ADDRESS 0x3FE43E /end MEASUREMENT
/begin MEASUREMENT B_bkdvpla "Bedingung Ersatzwert aktiv: VVT-Sensorplusibilisierung" UWORD B_TRUE 1 100 0 1 BIT_MASK 0x40 FORMAT "%13.11" ECU_ADDRESS 0x3FE440 /end MEASUREMENT
/begin MEASUREMENT B_bkdvpla2 "" UWORD B_TRUE 1 100 0 1 BIT_MASK 0x40 FORMAT "%13.11" ECU_ADDRESS 0x3FE442 /end MEASUREMENT
/begin MEASUREMENT B_bkdvpmn "Bedingung, Ersatzwert aktiv Leistungsbegrenzungs VVT" UWORD B_TRUE 1 100 0 1 BIT_MASK 0x40 FORMAT "%13.11" ECU_ADDRESS 0x3FE444 /end MEASUREMENT
/begin MEASUREMENT B_bkdvste "Bedingung: Ersatzwert DVSTE" UWORD B_TRUE 1 100 0 1 BIT_MASK 0x40 FORMAT "%13.11" ECU_ADDRESS 0x3FE446 /end MEASUREMENT
/begin MEASUREMENT B_bkdvste2 "" UWORD B_TRUE 1 100 0 1 BIT_MASK 0x40 FORMAT "%13.11" ECU_ADDRESS 0x3FE448 /end MEASUREMENT
/begin MEASUREMENT B_bkdvulv "" UWORD B_TRUE 1 100 0 1 BIT_MASK 0x40 FORMAT "%13.11" ECU_ADDRESS 0x3FE44A /end MEASUREMENT
/begin MEASUREMENT B_bkdvulv2 "" UWORD B_TRUE 1 100 0 1 BIT_MASK 0x40 FORMAT "%13.11" ECU_ADDRESS 0x3FE44C /end MEASUREMENT
/begin MEASUREMENT B_bkdvuse "Bedingung Ersatzwert aktiv:  VVT-Sensorversorgungspannung" UWORD B_TRUE 1 100 0 1 BIT_MASK 0x40 FORMAT "%13.11" ECU_ADDRESS 0x3FE44E /end MEASUREMENT
/begin MEASUREMENT B_bkdvuse2 "" UWORD B_TRUE 1 100 0 1 BIT_MASK 0x40 FORMAT "%13.11" ECU_ADDRESS 0x3FE450 /end MEASUREMENT
/begin MEASUREMENT B_bkenws "Bedingung Ersatzwert aktiv: NWS (Einlass,Bank1)" UWORD B_TRUE 1 100 0 1 BIT_MASK 0x40 FORMAT "%13.11" ECU_ADDRESS 0x3FE46C /end MEASUREMENT
/begin MEASUREMENT B_bkenws2 "Bedingung Ersatzwert aktiv: NWS2 (Einlass,Bank2)" UWORD B_TRUE 1 100 0 1 BIT_MASK 0x40 FORMAT "%13.11" ECU_ADDRESS 0x3FE46E /end MEASUREMENT
/begin MEASUREMENT B_bkenwse "Bedingung Ersatzwert aktiv: NWS Endstufe (Bank1, Einlaﬂ)" UWORD B_TRUE 1 100 0 1 BIT_MASK 0x40 FORMAT "%13.11" ECU_ADDRESS 0x3FE470 /end MEASUREMENT
/begin MEASUREMENT B_bkenwse2 "Bedingung Ersatzwert aktiv: NWS Endstufe (Bank2, Einlaﬂ)" UWORD B_TRUE 1 100 0 1 BIT_MASK 0x40 FORMAT "%13.11" ECU_ADDRESS 0x3FE472 /end MEASUREMENT
/begin MEASUREMENT B_bkph "Bedingung: Phasengeber aktiv" UWORD B_TRUE 1 100 0 1 BIT_MASK 0x40 FORMAT "%13.11" ECU_ADDRESS 0x3FE530 /end MEASUREMENT
/begin MEASUREMENT B_bkph2 "Bedingung: Phasengeber Bank 2 aktiv" UWORD B_TRUE 1 100 0 1 BIT_MASK 0x40 FORMAT "%13.11" ECU_ADDRESS 0x3FE532 /end MEASUREMENT
/begin MEASUREMENT B_bkph3 "Bedingung: Phasengeber 3 aktiv" UWORD B_TRUE 1 100 0 1 BIT_MASK 0x40 FORMAT "%13.11" ECU_ADDRESS 0x3FE534 /end MEASUREMENT
/begin MEASUREMENT B_bkph4 "Bedingung: Phasengeber 4 aktiv" UWORD B_TRUE 1 100 0 1 BIT_MASK 0x40 FORMAT "%13.11" ECU_ADDRESS 0x3FE536 /end MEASUREMENT
/begin MEASUREMENT B_bkphm "Bedingung: Phasengeber MIL aktiv" UWORD B_TRUE 1 100 0 1 BIT_MASK 0x40 FORMAT "%13.11" ECU_ADDRESS 0x3FE538 /end MEASUREMENT
/begin MEASUREMENT B_bkpllsu "Bedingung Ersatzwert aktiv: Plausibilit‰t der LSU" UWORD B_TRUE 1 100 0 1 BIT_MASK 0x40 FORMAT "%13.11" ECU_ADDRESS 0x3FE53A /end MEASUREMENT
/begin MEASUREMENT B_bkpllsu2 "Bedingung Ersatzwert aktiv: Plausibilit‰t der LSU, Bank 2" UWORD B_TRUE 1 100 0 1 BIT_MASK 0x40 FORMAT "%13.11" ECU_ADDRESS 0x3FE53C /end MEASUREMENT
/begin MEASUREMENT B_bkpoels "Backupbit f¸r die Plausibilisierung des ÷ldruckschalters" UWORD B_TRUE 1 100 0 1 BIT_MASK 0x40 FORMAT "%13.11" ECU_ADDRESS 0x3FE542 /end MEASUREMENT
/begin MEASUREMENT B_bkslpe "Bedingung: Sekund‰rluftpumpe ( Endstufe) aktiv" UWORD B_TRUE 1 100 0 1 BIT_MASK 0x40 FORMAT "%13.11" ECU_ADDRESS 0x3FE54C /end MEASUREMENT
/begin MEASUREMENT B_bksls "Bedingung: Sekund‰rluftsystem aktiv" UWORD B_TRUE 1 100 0 1 BIT_MASK 0x40 FORMAT "%13.11" ECU_ADDRESS 0x3FE54E /end MEASUREMENT
/begin MEASUREMENT B_bksls2 "Bedingung: Sekund‰rluftsystem Bank 2 aktiv" UWORD B_TRUE 1 100 0 1 BIT_MASK 0x40 FORMAT "%13.11" ECU_ADDRESS 0x3FE550 /end MEASUREMENT
/begin MEASUREMENT B_bkslv "Bedingung: Sekund‰rluftventil aktiv" UWORD B_TRUE 1 100 0 1 BIT_MASK 0x40 FORMAT "%13.11" ECU_ADDRESS 0x3FE552 /end MEASUREMENT
/begin MEASUREMENT B_bkslv2 "Bedingung: Sekund‰rluftventil Bank 2 aktiv" UWORD B_TRUE 1 100 0 1 BIT_MASK 0x40 FORMAT "%13.11" ECU_ADDRESS 0x3FE554 /end MEASUREMENT
/begin MEASUREMENT B_bksta "Bedingung Ersatzwert f¸r Automatikstart" UWORD B_TRUE 1 100 0 1 BIT_MASK 0x40 FORMAT "%13.11" ECU_ADDRESS 0x3FE558 /end MEASUREMENT
/begin MEASUREMENT B_bksts "Bedingung Startsignal aktiv" UWORD B_TRUE 1 100 0 1 BIT_MASK 0x40 FORMAT "%13.11" ECU_ADDRESS 0x3FE55A /end MEASUREMENT
/begin MEASUREMENT B_bksue "Bedingung: Ersatzwert Saugrohrumschaltung Endstufe aktiv" UWORD B_TRUE 1 100 0 1 BIT_MASK 0x40 FORMAT "%13.11" ECU_ADDRESS 0x3FE55C /end MEASUREMENT
/begin MEASUREMENT B_bkteve "Bedingung: Tankentl¸ftungsventil Endstufe aktiv" UWORD B_TRUE 1 100 0 1 BIT_MASK 0x40 FORMAT "%13.11" ECU_ADDRESS 0x3FE566 /end MEASUREMENT
/begin MEASUREMENT B_bkths "Diagnose verwendet Ersatzwert" UWORD B_TRUE 1 100 0 1 BIT_MASK 0x40 FORMAT "%13.11" ECU_ADDRESS 0x3FE568 /end MEASUREMENT
/begin MEASUREMENT B_bkufmv "Bedingung: Funktios¸berwachung Momentanvergleich aktiv" UWORD B_TRUE 1 100 0 1 BIT_MASK 0x40 FORMAT "%13.11" ECU_ADDRESS 0x3FE572 /end MEASUREMENT
/begin MEASUREMENT B_bkufnc "Bedingung Ersatzwert aktiv:Funktions¸berwachung" UWORD B_TRUE 1 100 0 1 BIT_MASK 0x40 FORMAT "%13.11" ECU_ADDRESS 0x3FE574 /end MEASUREMENT
/begin MEASUREMENT B_bkufrlip "Bedingung Ersatzwert aktiv:Funktions¸berwachung" UWORD B_TRUE 1 100 0 1 BIT_MASK 0x40 FORMAT "%13.11" ECU_ADDRESS 0x3FE576 /end MEASUREMENT
/begin MEASUREMENT B_bkufsga "Bedingung Ersatzwert aktiv:Funktions¸berwachung" UWORD B_TRUE 1 100 0 1 BIT_MASK 0x40 FORMAT "%13.11" ECU_ADDRESS 0x3FE578 /end MEASUREMENT
/begin MEASUREMENT B_bkufsgb "Bedingung Ersatzwert aktiv:Funktions¸berwachung" UWORD B_TRUE 1 100 0 1 BIT_MASK 0x40 FORMAT "%13.11" ECU_ADDRESS 0x3FE57A /end MEASUREMENT
/begin MEASUREMENT B_bkufsgc "Bedingung Ersatzwert aktiv:Funktions¸berwachung" UWORD B_TRUE 1 100 0 1 BIT_MASK 0x40 FORMAT "%13.11" ECU_ADDRESS 0x3FE57C /end MEASUREMENT
/begin MEASUREMENT B_bkufspsc "Bedingung Ersatzwert aktiv:Funktions¸berwachung" UWORD B_TRUE 1 100 0 1 BIT_MASK 0x40 FORMAT "%13.11" ECU_ADDRESS 0x3FE57E /end MEASUREMENT
/begin MEASUREMENT B_bkulsu "Bedingung Ersatzwert aktiv: Spannungssignal LSU" UWORD B_TRUE 1 100 0 1 BIT_MASK 0x40 FORMAT "%13.11" ECU_ADDRESS 0x3FE580 /end MEASUREMENT
/begin MEASUREMENT B_bkulsu2 "Bedingung Ersatzwert aktiv: Spannungssignal LSU, Bank 2" UWORD B_TRUE 1 100 0 1 BIT_MASK 0x40 FORMAT "%13.11" ECU_ADDRESS 0x3FE582 /end MEASUREMENT
/begin MEASUREMENT B_bkurram "Bedingung: Rechner¸berwachung: RAM" UWORD B_TRUE 1 100 0 1 BIT_MASK 0x40 FORMAT "%13.11" ECU_ADDRESS 0x3FE584 /end MEASUREMENT
/begin MEASUREMENT B_bkurrom "Bedingung: Rechner¸berwachung: ROM" UWORD B_TRUE 1 100 0 1 BIT_MASK 0x40 FORMAT "%13.11" ECU_ADDRESS 0x3FE586 /end MEASUREMENT
/begin MEASUREMENT B_bkurrst "Bedingung: Rechner¸berwachung: RESET" UWORD B_TRUE 1 100 0 1 BIT_MASK 0x40 FORMAT "%13.11" ECU_ADDRESS 0x3FE588 /end MEASUREMENT
/begin MEASUREMENT B_bkvat "" UWORD B_TRUE 1 100 0 1 BIT_MASK 0x40 FORMAT "%13.11" ECU_ADDRESS 0x3FE58A /end MEASUREMENT
/begin MEASUREMENT B_bkvfz "Bedingung Ersatzwert aktiv: Fahrzeuggeschwindigkeitssignal" UWORD B_TRUE 1 100 0 1 BIT_MASK 0x40 FORMAT "%13.11" ECU_ADDRESS 0x3FE58C /end MEASUREMENT
/begin MEASUREMENT B_clanwse "Bedingung Fehlerpfad Nockenwellensteuerung Endstufe lˆschen (Bank1,Auslaﬂ)" UWORD B_TRUE 1 100 0 1 BIT_MASK 0x80 FORMAT "%13.11" ECU_ADDRESS 0x3FE3B8 /end MEASUREMENT
/begin MEASUREMENT B_clanwse2 "Bedingung Fehlerpfad Nockenwellensteuerung Endstufe lˆschen (Bank2,Auslaﬂ)" UWORD B_TRUE 1 100 0 1 BIT_MASK 0x80 FORMAT "%13.11" ECU_ADDRESS 0x3FE3BA /end MEASUREMENT
/begin MEASUREMENT B_cldvan "" UWORD B_TRUE 1 100 0 1 BIT_MASK 0x80 FORMAT "%13.11" ECU_ADDRESS 0x3FE40C /end MEASUREMENT
/begin MEASUREMENT B_cldvcan "" UWORD B_TRUE 1 100 0 1 BIT_MASK 0x80 FORMAT "%13.11" ECU_ADDRESS 0x3FE40E /end MEASUREMENT
/begin MEASUREMENT B_cldvcan2 "" UWORD B_TRUE 1 100 0 1 BIT_MASK 0x80 FORMAT "%13.11" ECU_ADDRESS 0x3FE410 /end MEASUREMENT
/begin MEASUREMENT B_cldvest "Flag f¸r Lˆschung:VVT- Endstufen" UWORD B_TRUE 1 100 0 1 BIT_MASK 0x80 FORMAT "%13.11" ECU_ADDRESS 0x3FE41E /end MEASUREMENT
/begin MEASUREMENT B_cldvest2 "" UWORD B_TRUE 1 100 0 1 BIT_MASK 0x80 FORMAT "%13.11" ECU_ADDRESS 0x3FE420 /end MEASUREMENT
/begin MEASUREMENT B_cldvffs "Bedingung Fehlerpfad VVT-F¸hrungssensor lˆschen" UWORD B_TRUE 1 100 0 1 BIT_MASK 0x80 FORMAT "%13.11" ECU_ADDRESS 0x3FE42C /end MEASUREMENT
/begin MEASUREMENT B_cldvffs2 "" UWORD B_TRUE 1 100 0 1 BIT_MASK 0x80 FORMAT "%13.11" ECU_ADDRESS 0x3FE42E /end MEASUREMENT
/begin MEASUREMENT B_cldvfrs "Bedingung Fehlerpfad VVT-Referenzsensor lˆschen" UWORD B_TRUE 1 100 0 1 BIT_MASK 0x80 FORMAT "%13.11" ECU_ADDRESS 0x3FE430 /end MEASUREMENT
/begin MEASUREMENT B_cldvfrs2 "" UWORD B_TRUE 1 100 0 1 BIT_MASK 0x80 FORMAT "%13.11" ECU_ADDRESS 0x3FE432 /end MEASUREMENT
/begin MEASUREMENT B_cldvfsg "" UWORD B_TRUE 1 100 0 1 BIT_MASK 0x80 FORMAT "%13.11" ECU_ADDRESS 0x3FE434 /end MEASUREMENT
/begin MEASUREMENT B_cldvfsg2 "" UWORD B_TRUE 1 100 0 1 BIT_MASK 0x80 FORMAT "%13.11" ECU_ADDRESS 0x3FE436 /end MEASUREMENT
/begin MEASUREMENT B_cldvlrn "Bedingung Fehlerpfad VVT-Anschlaglernen lˆschen" UWORD B_TRUE 1 100 0 1 BIT_MASK 0x80 FORMAT "%13.11" ECU_ADDRESS 0x3FE438 /end MEASUREMENT
/begin MEASUREMENT B_cldvlrn2 "" UWORD B_TRUE 1 100 0 1 BIT_MASK 0x80 FORMAT "%13.11" ECU_ADDRESS 0x3FE43A /end MEASUREMENT
/begin MEASUREMENT B_cldvovl "" UWORD B_TRUE 1 100 0 1 BIT_MASK 0x80 FORMAT "%13.11" ECU_ADDRESS 0x3FE43C /end MEASUREMENT
/begin MEASUREMENT B_cldvovl2 "" UWORD B_TRUE 1 100 0 1 BIT_MASK 0x80 FORMAT "%13.11" ECU_ADDRESS 0x3FE43E /end MEASUREMENT
/begin MEASUREMENT B_cldvpla "Bedingung Fehlerpfad VVT-Sensor Plausibilisierung lˆschen" UWORD B_TRUE 1 100 0 1 BIT_MASK 0x80 FORMAT "%13.11" ECU_ADDRESS 0x3FE440 /end MEASUREMENT
/begin MEASUREMENT B_cldvpla2 "" UWORD B_TRUE 1 100 0 1 BIT_MASK 0x80 FORMAT "%13.11" ECU_ADDRESS 0x3FE442 /end MEASUREMENT
/begin MEASUREMENT B_cldvpmn "Fehlerpfad in DVPMN lˆschen" UWORD B_TRUE 1 100 0 1 BIT_MASK 0x80 FORMAT "%13.11" ECU_ADDRESS 0x3FE444 /end MEASUREMENT
/begin MEASUREMENT B_cldvste "" UWORD B_TRUE 1 100 0 1 BIT_MASK 0x80 FORMAT "%13.11" ECU_ADDRESS 0x3FE446 /end MEASUREMENT
/begin MEASUREMENT B_cldvste2 "" UWORD B_TRUE 1 100 0 1 BIT_MASK 0x80 FORMAT "%13.11" ECU_ADDRESS 0x3FE448 /end MEASUREMENT
/begin MEASUREMENT B_cldvulv "Bedingung: Fehler Entlastungsrelais Diagnose  lˆschen" UWORD B_TRUE 1 100 0 1 BIT_MASK 0x80 FORMAT "%13.11" ECU_ADDRESS 0x3FE44A /end MEASUREMENT
/begin MEASUREMENT B_cldvulv2 "" UWORD B_TRUE 1 100 0 1 BIT_MASK 0x80 FORMAT "%13.11" ECU_ADDRESS 0x3FE44C /end MEASUREMENT
/begin MEASUREMENT B_cldvuse "Bedingung Fehlerpfad  VVT-Sensorversorgungspannung lˆschen" UWORD B_TRUE 1 100 0 1 BIT_MASK 0x80 FORMAT "%13.11" ECU_ADDRESS 0x3FE44E /end MEASUREMENT
/begin MEASUREMENT B_cldvuse2 "" UWORD B_TRUE 1 100 0 1 BIT_MASK 0x80 FORMAT "%13.11" ECU_ADDRESS 0x3FE450 /end MEASUREMENT
/begin MEASUREMENT B_clenws "Bedingung Fehlerpfad Nockenwellensteuerung (Einlaﬂ,Bank1) lˆschen" UWORD B_TRUE 1 100 0 1 BIT_MASK 0x80 FORMAT "%13.11" ECU_ADDRESS 0x3FE46C /end MEASUREMENT
/begin MEASUREMENT B_clenws2 "Bedingung Fehlerpfad Nockenwellensteuerung (Einlaﬂ,Bank2) lˆschen" UWORD B_TRUE 1 100 0 1 BIT_MASK 0x80 FORMAT "%13.11" ECU_ADDRESS 0x3FE46E /end MEASUREMENT
/begin MEASUREMENT B_clenwse "Bedingung Fehlerpfad Nockenwellensteuerung Endstufe lˆschen (Bank1,Einlaﬂ)" UWORD B_TRUE 1 100 0 1 BIT_MASK 0x80 FORMAT "%13.11" ECU_ADDRESS 0x3FE470 /end MEASUREMENT
/begin MEASUREMENT B_clenwse2 "Bedingung Fehlerpfad Nockenwellensteuerung Endstufe lˆschen (Bank2,Einlaﬂ)" UWORD B_TRUE 1 100 0 1 BIT_MASK 0x80 FORMAT "%13.11" ECU_ADDRESS 0x3FE472 /end MEASUREMENT
/begin MEASUREMENT B_clph "Bedingung Fehlerpfad PH lˆschen" UWORD B_TRUE 1 100 0 1 BIT_MASK 0x80 FORMAT "%13.11" ECU_ADDRESS 0x3FE530 /end MEASUREMENT
/begin MEASUREMENT B_clph2 "Bedingung Fehlerpfad Phasengeber 2 lˆschen" UWORD B_TRUE 1 100 0 1 BIT_MASK 0x80 FORMAT "%13.11" ECU_ADDRESS 0x3FE532 /end MEASUREMENT
/begin MEASUREMENT B_clph3 "Bedingung Fehlerpfad Phasengeber 3 lˆschen" UWORD B_TRUE 1 100 0 1 BIT_MASK 0x80 FORMAT "%13.11" ECU_ADDRESS 0x3FE534 /end MEASUREMENT
/begin MEASUREMENT B_clph4 "Bedingung Fehlerpfad Phasengeber 4 lˆschen" UWORD B_TRUE 1 100 0 1 BIT_MASK 0x80 FORMAT "%13.11" ECU_ADDRESS 0x3FE536 /end MEASUREMENT
/begin MEASUREMENT B_clphm "Bedingung Fehlerpfad Phasengeber MIL lˆschen" UWORD B_TRUE 1 100 0 1 BIT_MASK 0x80 FORMAT "%13.11" ECU_ADDRESS 0x3FE538 /end MEASUREMENT
/begin MEASUREMENT B_clpllsu "Bedingung Fehlerflag ""Plausibilit‰tsdiagnose LSU"" lˆschen" UWORD B_TRUE 1 100 0 1 BIT_MASK 0x80 FORMAT "%13.11" ECU_ADDRESS 0x3FE53A /end MEASUREMENT
/begin MEASUREMENT B_clpllsu2 "Bedingung Fehlerflag ""Plausibilit‰tsdiagnose LSU"" lˆschen (Bank2)" UWORD B_TRUE 1 100 0 1 BIT_MASK 0x80 FORMAT "%13.11" ECU_ADDRESS 0x3FE53C /end MEASUREMENT
/begin MEASUREMENT B_clpoels "Bedingung Fehlerflag f¸r die Plausibilisierung des ÷ldruckschalters lˆschenb" UWORD B_TRUE 1 100 0 1 BIT_MASK 0x80 FORMAT "%13.11" ECU_ADDRESS 0x3FE542 /end MEASUREMENT
/begin MEASUREMENT B_clslpe "Bedingung: Fehlerpfad Endstufe Sekund‰rluftpumpe lˆschen" UWORD B_TRUE 1 100 0 1 BIT_MASK 0x80 FORMAT "%13.11" ECU_ADDRESS 0x3FE54C /end MEASUREMENT
/begin MEASUREMENT B_clsls "Bedingung: Fehler Sekund‰rluftsystem lˆschen" UWORD B_TRUE 1 100 0 1 BIT_MASK 0x80 FORMAT "%13.11" ECU_ADDRESS 0x3FE54E /end MEASUREMENT
/begin MEASUREMENT B_clsls2 "Bedingung: Fehler Sekund‰rluftsystem lˆschen (Bank 2)" UWORD B_TRUE 1 100 0 1 BIT_MASK 0x80 FORMAT "%13.11" ECU_ADDRESS 0x3FE550 /end MEASUREMENT
/begin MEASUREMENT B_clslv "Bedingung: Fehler Sekund‰rluftventil lˆschen" UWORD B_TRUE 1 100 0 1 BIT_MASK 0x80 FORMAT "%13.11" ECU_ADDRESS 0x3FE552 /end MEASUREMENT
/begin MEASUREMENT B_clslv2 "Bedingung: Fehler Sekund‰rluftventil lˆschen (Bank 2)" UWORD B_TRUE 1 100 0 1 BIT_MASK 0x80 FORMAT "%13.11" ECU_ADDRESS 0x3FE554 /end MEASUREMENT
/begin MEASUREMENT B_clsta "Bedingung Fehlerpfad STA  lˆschen" UWORD B_TRUE 1 100 0 1 BIT_MASK 0x80 FORMAT "%13.11" ECU_ADDRESS 0x3FE558 /end MEASUREMENT
/begin MEASUREMENT B_clsts "Bedingung Fehlerpfad Startsignal lˆschen" UWORD B_TRUE 1 100 0 1 BIT_MASK 0x80 FORMAT "%13.11" ECU_ADDRESS 0x3FE55A /end MEASUREMENT
/begin MEASUREMENT B_clsue "Bedingung Fehlerpfad Saugrohrumschaltung-Endstufe lˆschen" UWORD B_TRUE 1 100 0 1 BIT_MASK 0x80 FORMAT "%13.11" ECU_ADDRESS 0x3FE55C /end MEASUREMENT
/begin MEASUREMENT B_cltes "Bedingung Fehlerflag ""Tankentl¸ftungssystem offen"" lˆschen" UWORD B_TRUE 1 100 0 1 BIT_MASK 0x80 FORMAT "%13.11" ECU_ADDRESS 0x3FE562 /end MEASUREMENT
/begin MEASUREMENT B_clteve "Bedingung Fehlerphad TEVE lˆschen" UWORD B_TRUE 1 100 0 1 BIT_MASK 0x80 FORMAT "%13.11" ECU_ADDRESS 0x3FE566 /end MEASUREMENT
/begin MEASUREMENT B_clths "Flag f¸r Lˆschen der Diagnosedaten" UWORD B_TRUE 1 100 0 1 BIT_MASK 0x80 FORMAT "%13.11" ECU_ADDRESS 0x3FE568 /end MEASUREMENT
/begin MEASUREMENT B_clufmv "Flag f¸r Lˆschung: Funktions¸berwachung: Momentenvergleich" UWORD B_TRUE 1 100 0 1 BIT_MASK 0x80 FORMAT "%13.11" ECU_ADDRESS 0x3FE572 /end MEASUREMENT
/begin MEASUREMENT B_clufnc "Flag f¸r Lˆschung: Fkt¸berwachung: Drehzahlgeber-, Zuleitung- oder SG-Fehler" UWORD B_TRUE 1 100 0 1 BIT_MASK 0x80 FORMAT "%13.11" ECU_ADDRESS 0x3FE574 /end MEASUREMENT
/begin MEASUREMENT B_clufrlip "Flag f¸r Lˆschung: Fkt¸berwachung: Lastsensor-, Zuleitung- oder SG-Fehler" UWORD B_TRUE 1 100 0 1 BIT_MASK 0x80 FORMAT "%13.11" ECU_ADDRESS 0x3FE576 /end MEASUREMENT
/begin MEASUREMENT B_clufsga "Flag f¸r Lˆschung: Funktions¸berwachung: Steuerger‰te-Fehler Gruppe a" UWORD B_TRUE 1 100 0 1 BIT_MASK 0x80 FORMAT "%13.11" ECU_ADDRESS 0x3FE578 /end MEASUREMENT
/begin MEASUREMENT B_clufsgb "Flag f¸r Lˆschung: Funktions¸berwachung: Steuerger‰te-Fehler Gruppe b" UWORD B_TRUE 1 100 0 1 BIT_MASK 0x80 FORMAT "%13.11" ECU_ADDRESS 0x3FE57A /end MEASUREMENT
/begin MEASUREMENT B_clufsgc "Flag f¸r Lˆschung: Funktions¸berwachung: Steuerger‰te-Fehler Gruppe c" UWORD B_TRUE 1 100 0 1 BIT_MASK 0x80 FORMAT "%13.11" ECU_ADDRESS 0x3FE57C /end MEASUREMENT
/begin MEASUREMENT B_clufspsc "Flag f¸r Lˆschung: Fkt¸berwachung: Pedalwertgeber-, Zuleitung- oder SG-Fehler" UWORD B_TRUE 1 100 0 1 BIT_MASK 0x80 FORMAT "%13.11" ECU_ADDRESS 0x3FE57E /end MEASUREMENT
/begin MEASUREMENT B_clulsu "Bedingung Fehlerflag ""Spannungs¸berwachung LSU"" lˆschen" UWORD B_TRUE 1 100 0 1 BIT_MASK 0x80 FORMAT "%13.11" ECU_ADDRESS 0x3FE580 /end MEASUREMENT
/begin MEASUREMENT B_clulsu2 "Bedingung Fehlerflag ""Spannungs¸berwachung LSU"" lˆschen, Bank 2" UWORD B_TRUE 1 100 0 1 BIT_MASK 0x80 FORMAT "%13.11" ECU_ADDRESS 0x3FE582 /end MEASUREMENT
/begin MEASUREMENT B_clurram "Flag f¸r Lˆschung: Rechner¸berwachung: RAM" UWORD B_TRUE 1 100 0 1 BIT_MASK 0x80 FORMAT "%13.11" ECU_ADDRESS 0x3FE584 /end MEASUREMENT
/begin MEASUREMENT B_clurrom "Flag f¸r Lˆschung: Rechner¸berwachung: ROM" UWORD B_TRUE 1 100 0 1 BIT_MASK 0x80 FORMAT "%13.11" ECU_ADDRESS 0x3FE586 /end MEASUREMENT
/begin MEASUREMENT B_clurrst "Flag f¸r Lˆschung: Rechner¸berwachung: Reset" UWORD B_TRUE 1 100 0 1 BIT_MASK 0x80 FORMAT "%13.11" ECU_ADDRESS 0x3FE588 /end MEASUREMENT
/begin MEASUREMENT B_clvat "" UWORD B_TRUE 1 100 0 1 BIT_MASK 0x80 FORMAT "%13.11" ECU_ADDRESS 0x3FE58A /end MEASUREMENT
/begin MEASUREMENT B_clvfz "Bedingung Fehlerpfad VFZ (Fahrzeuggeschwindigkeit) lˆschen" UWORD B_TRUE 1 100 0 1 BIT_MASK 0x80 FORMAT "%13.11" ECU_ADDRESS 0x3FE58C /end MEASUREMENT
/begin MEASUREMENT B_ftanwse "Bedingung: Fehlereintrag durch Tester f¸r NWS Endstufe (Auslaﬂ, Bank1)" UWORD B_TRUE 1 100 0 1 BIT_MASK 0x10 FORMAT "%13.11" ECU_ADDRESS 0x3FE3B8 /end MEASUREMENT
/begin MEASUREMENT B_ftanwse2 "Bedingung: Fehlereintrag durch Tester f¸r NWS Endstufe (Auslaﬂ, Bank2)" UWORD B_TRUE 1 100 0 1 BIT_MASK 0x10 FORMAT "%13.11" ECU_ADDRESS 0x3FE3BA /end MEASUREMENT
/begin MEASUREMENT B_ftdvan "" UWORD B_TRUE 1 100 0 1 BIT_MASK 0x10 FORMAT "%13.11" ECU_ADDRESS 0x3FE40C /end MEASUREMENT
/begin MEASUREMENT B_ftdvcan "" UWORD B_TRUE 1 100 0 1 BIT_MASK 0x10 FORMAT "%13.11" ECU_ADDRESS 0x3FE40E /end MEASUREMENT
/begin MEASUREMENT B_ftdvcan2 "" UWORD B_TRUE 1 100 0 1 BIT_MASK 0x10 FORMAT "%13.11" ECU_ADDRESS 0x3FE410 /end MEASUREMENT
/begin MEASUREMENT B_ftdvest "Bedingung Fehlereintrag durch Tester: VVT-Endstufe" UWORD B_TRUE 1 100 0 1 BIT_MASK 0x10 FORMAT "%13.11" ECU_ADDRESS 0x3FE41E /end MEASUREMENT
/begin MEASUREMENT B_ftdvest2 "" UWORD B_TRUE 1 100 0 1 BIT_MASK 0x10 FORMAT "%13.11" ECU_ADDRESS 0x3FE420 /end MEASUREMENT
/begin MEASUREMENT B_ftdvffs "Bedingung Fehlereintrag durch Tester: VVT-F¸hrungssensor" UWORD B_TRUE 1 100 0 1 BIT_MASK 0x10 FORMAT "%13.11" ECU_ADDRESS 0x3FE42C /end MEASUREMENT
/begin MEASUREMENT B_ftdvffs2 "" UWORD B_TRUE 1 100 0 1 BIT_MASK 0x10 FORMAT "%13.11" ECU_ADDRESS 0x3FE42E /end MEASUREMENT
/begin MEASUREMENT B_ftdvfrs "Bedingung Fehlereintrag durch Tester: VVT-Referenzsensor" UWORD B_TRUE 1 100 0 1 BIT_MASK 0x10 FORMAT "%13.11" ECU_ADDRESS 0x3FE430 /end MEASUREMENT
/begin MEASUREMENT B_ftdvfrs2 "" UWORD B_TRUE 1 100 0 1 BIT_MASK 0x10 FORMAT "%13.11" ECU_ADDRESS 0x3FE432 /end MEASUREMENT
/begin MEASUREMENT B_ftdvfsg "" UWORD B_TRUE 1 100 0 1 BIT_MASK 0x10 FORMAT "%13.11" ECU_ADDRESS 0x3FE434 /end MEASUREMENT
/begin MEASUREMENT B_ftdvfsg2 "" UWORD B_TRUE 1 100 0 1 BIT_MASK 0x10 FORMAT "%13.11" ECU_ADDRESS 0x3FE436 /end MEASUREMENT
/begin MEASUREMENT B_ftdvlrn "Bedingung Fehlereintrag durch Tester: VVT-Anschlaglernen" UWORD B_TRUE 1 100 0 1 BIT_MASK 0x10 FORMAT "%13.11" ECU_ADDRESS 0x3FE438 /end MEASUREMENT
/begin MEASUREMENT B_ftdvlrn2 "" UWORD B_TRUE 1 100 0 1 BIT_MASK 0x10 FORMAT "%13.11" ECU_ADDRESS 0x3FE43A /end MEASUREMENT
/begin MEASUREMENT B_ftdvovl "Bedingung Fehlereintrag durch Tester: VVT-‹berlastschutz" UWORD B_TRUE 1 100 0 1 BIT_MASK 0x10 FORMAT "%13.11" ECU_ADDRESS 0x3FE43C /end MEASUREMENT
/begin MEASUREMENT B_ftdvovl2 "" UWORD B_TRUE 1 100 0 1 BIT_MASK 0x10 FORMAT "%13.11" ECU_ADDRESS 0x3FE43E /end MEASUREMENT
/begin MEASUREMENT B_ftdvpla "Bedingung Fehlereintrag durch Tester: VVT-Sensorplausibilisierung" UWORD B_TRUE 1 100 0 1 BIT_MASK 0x10 FORMAT "%13.11" ECU_ADDRESS 0x3FE440 /end MEASUREMENT
/begin MEASUREMENT B_ftdvpla2 "" UWORD B_TRUE 1 100 0 1 BIT_MASK 0x10 FORMAT "%13.11" ECU_ADDRESS 0x3FE442 /end MEASUREMENT
/begin MEASUREMENT B_ftdvpmn "Bedingung, Fehlereintrag durch Tester, Leistungsbegrenzung VVT" UWORD B_TRUE 1 100 0 1 BIT_MASK 0x10 FORMAT "%13.11" ECU_ADDRESS 0x3FE444 /end MEASUREMENT
/begin MEASUREMENT B_ftdvste "Bedingung: Fehlereintrag durch Tester DVSTE" UWORD B_TRUE 1 100 0 1 BIT_MASK 0x10 FORMAT "%13.11" ECU_ADDRESS 0x3FE446 /end MEASUREMENT
/begin MEASUREMENT B_ftdvste2 "" UWORD B_TRUE 1 100 0 1 BIT_MASK 0x10 FORMAT "%13.11" ECU_ADDRESS 0x3FE448 /end MEASUREMENT
/begin MEASUREMENT B_ftdvulv "" UWORD B_TRUE 1 100 0 1 BIT_MASK 0x10 FORMAT "%13.11" ECU_ADDRESS 0x3FE44A /end MEASUREMENT
/begin MEASUREMENT B_ftdvulv2 "" UWORD B_TRUE 1 100 0 1 BIT_MASK 0x10 FORMAT "%13.11" ECU_ADDRESS 0x3FE44C /end MEASUREMENT
/begin MEASUREMENT B_ftdvuse "Bedingung Fehlereintrag durch Tester:  VVT-Sensorversorgungspannung" UWORD B_TRUE 1 100 0 1 BIT_MASK 0x10 FORMAT "%13.11" ECU_ADDRESS 0x3FE44E /end MEASUREMENT
/begin MEASUREMENT B_ftdvuse2 "" UWORD B_TRUE 1 100 0 1 BIT_MASK 0x10 FORMAT "%13.11" ECU_ADDRESS 0x3FE450 /end MEASUREMENT
/begin MEASUREMENT B_ftenws "Bedingung: Fehlereintrag durch Tester f¸r NWS (Einlaﬂ, Bank1)" UWORD B_TRUE 1 100 0 1 BIT_MASK 0x10 FORMAT "%13.11" ECU_ADDRESS 0x3FE46C /end MEASUREMENT
/begin MEASUREMENT B_ftenws2 "Bedingung: Fehlereintrag durch Tester f¸r NWS2 (Einlass, Bank2)" UWORD B_TRUE 1 100 0 1 BIT_MASK 0x10 FORMAT "%13.11" ECU_ADDRESS 0x3FE46E /end MEASUREMENT
/begin MEASUREMENT B_ftenwse "Bedingung: Fehlereintrag durch Tester f¸r NWS Endstufe (Einlaﬂ, Bank1)" UWORD B_TRUE 1 100 0 1 BIT_MASK 0x10 FORMAT "%13.11" ECU_ADDRESS 0x3FE470 /end MEASUREMENT
/begin MEASUREMENT B_ftenwse2 "Bedingung: Fehlereintrag durch Tester f¸r NWS Endstufe (Einlaﬂ, Bank2)" UWORD B_TRUE 1 100 0 1 BIT_MASK 0x10 FORMAT "%13.11" ECU_ADDRESS 0x3FE472 /end MEASUREMENT
/begin MEASUREMENT B_ftph "Bedingung Fehlereintrag durch Tester f¸r Phasensensor" UWORD B_TRUE 1 100 0 1 BIT_MASK 0x10 FORMAT "%13.11" ECU_ADDRESS 0x3FE530 /end MEASUREMENT
/begin MEASUREMENT B_ftph2 "Bedingung: Fehlereintrag durch Tester f¸r Phasengeber 2" UWORD B_TRUE 1 100 0 1 BIT_MASK 0x10 FORMAT "%13.11" ECU_ADDRESS 0x3FE532 /end MEASUREMENT
/begin MEASUREMENT B_ftph3 "Bedingung: Fehlereintrag durch Tester f¸r Phasengeber 3" UWORD B_TRUE 1 100 0 1 BIT_MASK 0x10 FORMAT "%13.11" ECU_ADDRESS 0x3FE534 /end MEASUREMENT
/begin MEASUREMENT B_ftph4 "Bedingung: Fehlereintrag durch Tester f¸r Phasengeber 4" UWORD B_TRUE 1 100 0 1 BIT_MASK 0x10 FORMAT "%13.11" ECU_ADDRESS 0x3FE536 /end MEASUREMENT
/begin MEASUREMENT B_ftphm "Bedingung: Fehlereintrag durch Tester f¸r Phasengeber MIL" UWORD B_TRUE 1 100 0 1 BIT_MASK 0x10 FORMAT "%13.11" ECU_ADDRESS 0x3FE538 /end MEASUREMENT
/begin MEASUREMENT B_ftpllsu "Bedingung Fehlereintrag durch Tester f¸r die Plausibilit‰t der LSU" UWORD B_TRUE 1 100 0 1 BIT_MASK 0x10 FORMAT "%13.11" ECU_ADDRESS 0x3FE53A /end MEASUREMENT
/begin MEASUREMENT B_ftpllsu2 "Bedingung Fehlereintrag durch Tester f¸r die Plausibilit‰t der LSU, Bank 2" UWORD B_TRUE 1 100 0 1 BIT_MASK 0x10 FORMAT "%13.11" ECU_ADDRESS 0x3FE53C /end MEASUREMENT
/begin MEASUREMENT B_ftpoels "Bedingung Fehlereintrag durch Tester f¸r Plausibilisierung des ÷ldruckschalters" UWORD B_TRUE 1 100 0 1 BIT_MASK 0x10 FORMAT "%13.11" ECU_ADDRESS 0x3FE542 /end MEASUREMENT
/begin MEASUREMENT B_ftslpe "Bedingung Fehlereintrag durch Tester Sekund‰rluftpumpe Endstufe" UWORD B_TRUE 1 100 0 1 BIT_MASK 0x10 FORMAT "%13.11" ECU_ADDRESS 0x3FE54C /end MEASUREMENT
/begin MEASUREMENT B_ftsls "Bedingung: Fehlereintrag durch Tester f¸r Katheizen" UWORD B_TRUE 1 100 0 1 BIT_MASK 0x10 FORMAT "%13.11" ECU_ADDRESS 0x3FE54E /end MEASUREMENT
/begin MEASUREMENT B_ftsls2 "Bedingung: Fehlereintrag durch Tester f¸r SLS, Bank2" UWORD B_TRUE 1 100 0 1 BIT_MASK 0x10 FORMAT "%13.11" ECU_ADDRESS 0x3FE550 /end MEASUREMENT
/begin MEASUREMENT B_ftslv "Bedingung: Fehlereintrag durch Tester f¸r SLV" UWORD B_TRUE 1 100 0 1 BIT_MASK 0x10 FORMAT "%13.11" ECU_ADDRESS 0x3FE552 /end MEASUREMENT
/begin MEASUREMENT B_ftslv2 "Bedingung: Fehlereintrag durch Tester f¸r SLV, Bank2" UWORD B_TRUE 1 100 0 1 BIT_MASK 0x10 FORMAT "%13.11" ECU_ADDRESS 0x3FE554 /end MEASUREMENT
/begin MEASUREMENT B_ftsta "Bedingung: Fehlereintrag durch Tester f¸r Automatikstart" UWORD B_TRUE 1 100 0 1 BIT_MASK 0x10 FORMAT "%13.11" ECU_ADDRESS 0x3FE558 /end MEASUREMENT
/begin MEASUREMENT B_ftsts "" UWORD B_TRUE 1 100 0 1 BIT_MASK 0x10 FORMAT "%13.11" ECU_ADDRESS 0x3FE55A /end MEASUREMENT
/begin MEASUREMENT B_ftsue "Bedingung: Fehlereintrag durch Tester f¸r Endstufe Saugrohrumschaltung" UWORD B_TRUE 1 100 0 1 BIT_MASK 0x10 FORMAT "%13.11" ECU_ADDRESS 0x3FE55C /end MEASUREMENT
/begin MEASUREMENT B_ftteve "Bedingung Fehlereintrag durch Tester Tankentl¸ftungsventil Endstufe" UWORD B_TRUE 1 100 0 1 BIT_MASK 0x10 FORMAT "%13.11" ECU_ADDRESS 0x3FE566 /end MEASUREMENT
/begin MEASUREMENT B_ftths "Pr¸fung durch Kundendiensttester" UWORD B_TRUE 1 100 0 1 BIT_MASK 0x10 FORMAT "%13.11" ECU_ADDRESS 0x3FE568 /end MEASUREMENT
/begin MEASUREMENT B_ftufmv "Bedingung: Fehlereintrag durch Tester: Momentvergleich" UWORD B_TRUE 1 100 0 1 BIT_MASK 0x10 FORMAT "%13.11" ECU_ADDRESS 0x3FE572 /end MEASUREMENT
/begin MEASUREMENT B_ftufnc "Bedingung: Fehlereintrag durch Tester:Drehzahlgeber-,Zuleitung oder SG-Fehler" UWORD B_TRUE 1 100 0 1 BIT_MASK 0x10 FORMAT "%13.11" ECU_ADDRESS 0x3FE574 /end MEASUREMENT
/begin MEASUREMENT B_ftufrlip "Bedingung: Fehlereintrag durch Tester: Lastsensor-,Zuleitung- oder SG-Fehler" UWORD B_TRUE 1 100 0 1 BIT_MASK 0x10 FORMAT "%13.11" ECU_ADDRESS 0x3FE576 /end MEASUREMENT
/begin MEASUREMENT B_ftufsga "Bedingung: Fehlereintrag durch Tester: SG-Fehler Gruppe a" UWORD B_TRUE 1 100 0 1 BIT_MASK 0x10 FORMAT "%13.11" ECU_ADDRESS 0x3FE578 /end MEASUREMENT
/begin MEASUREMENT B_ftufsgb "Bedingung: Fehlereintrag durch Tester: SG-Fehler Gruppe b" UWORD B_TRUE 1 100 0 1 BIT_MASK 0x10 FORMAT "%13.11" ECU_ADDRESS 0x3FE57A /end MEASUREMENT
/begin MEASUREMENT B_ftufsgc "Bedingung: Fehlereintrag durch Tester: SG-Fehler Gruppe c" UWORD B_TRUE 1 100 0 1 BIT_MASK 0x10 FORMAT "%13.11" ECU_ADDRESS 0x3FE57C /end MEASUREMENT
/begin MEASUREMENT B_ftufspsc "Bedingung: Fehlereintrag durch Tester:Pedalwertgeber-,Zuleitung oder SG-Fehler" UWORD B_TRUE 1 100 0 1 BIT_MASK 0x10 FORMAT "%13.11" ECU_ADDRESS 0x3FE57E /end MEASUREMENT
/begin MEASUREMENT B_ftulsu "Bedingung Fehlereintrag durch Tester f¸r Spannungssignal LSU" UWORD B_TRUE 1 100 0 1 BIT_MASK 0x10 FORMAT "%13.11" ECU_ADDRESS 0x3FE580 /end MEASUREMENT
/begin MEASUREMENT B_ftulsu2 "Bedingung Fehlereintrag durch Tester f¸r Spannungssignal LSU, Bank 2" UWORD B_TRUE 1 100 0 1 BIT_MASK 0x10 FORMAT "%13.11" ECU_ADDRESS 0x3FE582 /end MEASUREMENT
/begin MEASUREMENT B_fturram "" UWORD B_TRUE 1 100 0 1 BIT_MASK 0x10 FORMAT "%13.11" ECU_ADDRESS 0x3FE584 /end MEASUREMENT
/begin MEASUREMENT B_fturrom "" UWORD B_TRUE 1 100 0 1 BIT_MASK 0x10 FORMAT "%13.11" ECU_ADDRESS 0x3FE586 /end MEASUREMENT
/begin MEASUREMENT B_fturrst "" UWORD B_TRUE 1 100 0 1 BIT_MASK 0x10 FORMAT "%13.11" ECU_ADDRESS 0x3FE588 /end MEASUREMENT
/begin MEASUREMENT B_ftvat "" UWORD B_TRUE 1 100 0 1 BIT_MASK 0x10 FORMAT "%13.11" ECU_ADDRESS 0x3FE58A /end MEASUREMENT
/begin MEASUREMENT B_ftvfz "Bedingung Fehlereintrag durch Tester f¸r Fehlerpfad VFZ" UWORD B_TRUE 1 100 0 1 BIT_MASK 0x10 FORMAT "%13.11" ECU_ADDRESS 0x3FE58C /end MEASUREMENT
/begin MEASUREMENT B_mnanwse "Fehlerart: Kurzschluﬂ Masse Nockenwellensteuerungsventil Endstufe (Bank1,Auslaﬂ)" UWORD B_TRUE 1 100 0 1 BIT_MASK 0x200 FORMAT "%13.11" ECU_ADDRESS 0x3FE3B8 /end MEASUREMENT
/begin MEASUREMENT B_mnanwse2 "Fehlerart: Kurzschluﬂ Masse Nockenwellensteuerungsventil Endstufe (Bank2,Auslaﬂ)" UWORD B_TRUE 1 100 0 1 BIT_MASK 0x200 FORMAT "%13.11" ECU_ADDRESS 0x3FE3BA /end MEASUREMENT
/begin MEASUREMENT B_mndvan "" UWORD B_TRUE 1 100 0 1 BIT_MASK 0x200 FORMAT "%13.11" ECU_ADDRESS 0x3FE40C /end MEASUREMENT
/begin MEASUREMENT B_mndvcan "" UWORD B_TRUE 1 100 0 1 BIT_MASK 0x200 FORMAT "%13.11" ECU_ADDRESS 0x3FE40E /end MEASUREMENT
/begin MEASUREMENT B_mndvcan2 "" UWORD B_TRUE 1 100 0 1 BIT_MASK 0x200 FORMAT "%13.11" ECU_ADDRESS 0x3FE410 /end MEASUREMENT
/begin MEASUREMENT B_mndvest "Endstufe Kurzschluss Masse" UWORD B_TRUE 1 100 0 1 BIT_MASK 0x200 FORMAT "%13.11" ECU_ADDRESS 0x3FE41E /end MEASUREMENT
/begin MEASUREMENT B_mndvest2 "Endstufe Kurzschluss Masse Bank 2" UWORD B_TRUE 1 100 0 1 BIT_MASK 0x200 FORMAT "%13.11" ECU_ADDRESS 0x3FE420 /end MEASUREMENT
/begin MEASUREMENT B_mndvffs "Fuehrungssensor Resetfehler" UWORD B_TRUE 1 100 0 1 BIT_MASK 0x200 FORMAT "%13.11" ECU_ADDRESS 0x3FE42C /end MEASUREMENT
/begin MEASUREMENT B_mndvffs2 "Fuehrungssensor Resetfehler Bank 2" UWORD B_TRUE 1 100 0 1 BIT_MASK 0x200 FORMAT "%13.11" ECU_ADDRESS 0x3FE42E /end MEASUREMENT
/begin MEASUREMENT B_mndvfrs "Referenzsensor Resetfehler" UWORD B_TRUE 1 100 0 1 BIT_MASK 0x200 FORMAT "%13.11" ECU_ADDRESS 0x3FE430 /end MEASUREMENT
/begin MEASUREMENT B_mndvfrs2 "Referenzsensor Resetfehler Bank 2" UWORD B_TRUE 1 100 0 1 BIT_MASK 0x200 FORMAT "%13.11" ECU_ADDRESS 0x3FE432 /end MEASUREMENT
/begin MEASUREMENT B_mndvfsg "Steuergeraet intern RAM-Test" UWORD B_TRUE 1 100 0 1 BIT_MASK 0x200 FORMAT "%13.11" ECU_ADDRESS 0x3FE434 /end MEASUREMENT
/begin MEASUREMENT B_mndvfsg2 "Steuergeraet intern RAM-Test Bank 2" UWORD B_TRUE 1 100 0 1 BIT_MASK 0x200 FORMAT "%13.11" ECU_ADDRESS 0x3FE436 /end MEASUREMENT
/begin MEASUREMENT B_mndvlrn "Anschlaglernen Fehler unteres Lernfenster" UWORD B_TRUE 1 100 0 1 BIT_MASK 0x200 FORMAT "%13.11" ECU_ADDRESS 0x3FE438 /end MEASUREMENT
/begin MEASUREMENT B_mndvlrn2 "Anschlaglernen Fehler unteres Lernfenster Bank 2" UWORD B_TRUE 1 100 0 1 BIT_MASK 0x200 FORMAT "%13.11" ECU_ADDRESS 0x3FE43A /end MEASUREMENT
/begin MEASUREMENT B_mndvovl "Fehlerart: Temperatur VVT-Motor zu hoch" UWORD B_TRUE 1 100 0 1 BIT_MASK 0x200 FORMAT "%13.11" ECU_ADDRESS 0x3FE43C /end MEASUREMENT
/begin MEASUREMENT B_mndvovl2 "" UWORD B_TRUE 1 100 0 1 BIT_MASK 0x200 FORMAT "%13.11" ECU_ADDRESS 0x3FE43E /end MEASUREMENT
/begin MEASUREMENT B_mndvpla "" UWORD B_TRUE 1 100 0 1 BIT_MASK 0x200 FORMAT "%13.11" ECU_ADDRESS 0x3FE440 /end MEASUREMENT
/begin MEASUREMENT B_mndvpla2 "" UWORD B_TRUE 1 100 0 1 BIT_MASK 0x200 FORMAT "%13.11" ECU_ADDRESS 0x3FE442 /end MEASUREMENT
/begin MEASUREMENT B_mndvpmn "Plausibilisierung Laufunruhe" UWORD B_TRUE 1 100 0 1 BIT_MASK 0x200 FORMAT "%13.11" ECU_ADDRESS 0x3FE444 /end MEASUREMENT
/begin MEASUREMENT B_mndvste "Fehlerart: MIN-Fehler Stellglied¸berwachung" UWORD B_TRUE 1 100 0 1 BIT_MASK 0x200 FORMAT "%13.11" ECU_ADDRESS 0x3FE446 /end MEASUREMENT
/begin MEASUREMENT B_mndvste2 "" UWORD B_TRUE 1 100 0 1 BIT_MASK 0x200 FORMAT "%13.11" ECU_ADDRESS 0x3FE448 /end MEASUREMENT
/begin MEASUREMENT B_mndvulv "Leistungsversorgung VVT Spannung zu gering" UWORD B_TRUE 1 100 0 1 BIT_MASK 0x200 FORMAT "%13.11" ECU_ADDRESS 0x3FE44A /end MEASUREMENT
/begin MEASUREMENT B_mndvulv2 "Leistungsversorgung VVT Spannung zu gering Bank 2" UWORD B_TRUE 1 100 0 1 BIT_MASK 0x200 FORMAT "%13.11" ECU_ADDRESS 0x3FE44C /end MEASUREMENT
/begin MEASUREMENT B_mndvuse "Sensor-Versorgungsspannung zu gering" UWORD B_TRUE 1 100 0 1 BIT_MASK 0x200 FORMAT "%13.11" ECU_ADDRESS 0x3FE44E /end MEASUREMENT
/begin MEASUREMENT B_mndvuse2 "Sensor-Versorgungsspannung zu gering Bank 2" UWORD B_TRUE 1 100 0 1 BIT_MASK 0x200 FORMAT "%13.11" ECU_ADDRESS 0x3FE450 /end MEASUREMENT
/begin MEASUREMENT B_mnenws "Bed. Nockenwellenverstellung hat Fr¸hposition nicht erreicht (Einlaﬂ,Bank1)" UWORD B_TRUE 1 100 0 1 BIT_MASK 0x200 FORMAT "%13.11" ECU_ADDRESS 0x3FE46C /end MEASUREMENT
/begin MEASUREMENT B_mnenws2 "Bed. Nockenwellenverstellung hat Fr¸hposition nicht erreicht (Einlaﬂ,Bank2)" UWORD B_TRUE 1 100 0 1 BIT_MASK 0x200 FORMAT "%13.11" ECU_ADDRESS 0x3FE46E /end MEASUREMENT
/begin MEASUREMENT B_mnenwse "Fehlerart: Kurzschluﬂ Masse Nockenwellensteuerungsventil Endstufe" UWORD B_TRUE 1 100 0 1 BIT_MASK 0x200 FORMAT "%13.11" ECU_ADDRESS 0x3FE470 /end MEASUREMENT
/begin MEASUREMENT B_mnenwse2 "Bedingung: min. Fehler Nockenwellensteuerung Endstufe (Bank2, Einlaﬂ)" UWORD B_TRUE 1 100 0 1 BIT_MASK 0x200 FORMAT "%13.11" ECU_ADDRESS 0x3FE472 /end MEASUREMENT
/begin MEASUREMENT B_mnph "Fehlerart: Kurzschluﬂ Masse Phasengeber" UWORD B_TRUE 1 100 0 1 BIT_MASK 0x200 FORMAT "%13.11" ECU_ADDRESS 0x3FE530 /end MEASUREMENT
/begin MEASUREMENT B_mnph2 "Fehlerart: Kurzschluﬂ Masse Phasengeber 2" UWORD B_TRUE 1 100 0 1 BIT_MASK 0x200 FORMAT "%13.11" ECU_ADDRESS 0x3FE532 /end MEASUREMENT
/begin MEASUREMENT B_mnph3 "Fehlerart: Kurzschluﬂ Masse Phasengeber 3" UWORD B_TRUE 1 100 0 1 BIT_MASK 0x200 FORMAT "%13.11" ECU_ADDRESS 0x3FE534 /end MEASUREMENT
/begin MEASUREMENT B_mnph4 "Fehlerart: Kurzschluﬂ Masse Phasengeber 4" UWORD B_TRUE 1 100 0 1 BIT_MASK 0x200 FORMAT "%13.11" ECU_ADDRESS 0x3FE536 /end MEASUREMENT
/begin MEASUREMENT B_mnphm "Fehlerart: Minfehler Phasengeber MIL" UWORD B_TRUE 1 100 0 1 BIT_MASK 0x200 FORMAT "%13.11" ECU_ADDRESS 0x3FE538 /end MEASUREMENT
/begin MEASUREMENT B_mnpllsu "Bedingung: Min-Fehler Plausibilit‰t LSU: Sonde zeigt keine Aktivit‰t" UWORD B_TRUE 1 100 0 1 BIT_MASK 0x200 FORMAT "%13.11" ECU_ADDRESS 0x3FE53A /end MEASUREMENT
/begin MEASUREMENT B_mnpllsu2 "Bedingung: Min-Fehler Plausibilit‰t LSU: Sonde zeigt keine Aktivit‰t, Bank 2" UWORD B_TRUE 1 100 0 1 BIT_MASK 0x200 FORMAT "%13.11" ECU_ADDRESS 0x3FE53C /end MEASUREMENT
/begin MEASUREMENT B_mnpoels "MinError f¸r die Plausibilisierung des ÷ldruckschalters" UWORD B_TRUE 1 100 0 1 BIT_MASK 0x200 FORMAT "%13.11" ECU_ADDRESS 0x3FE542 /end MEASUREMENT
/begin MEASUREMENT B_mnslpe "Fehlertype: Kurzschluﬂ nach Masse Endstufe Sekund‰rluftpumpe" UWORD B_TRUE 1 100 0 1 BIT_MASK 0x200 FORMAT "%13.11" ECU_ADDRESS 0x3FE54C /end MEASUREMENT
/begin MEASUREMENT B_mnsls "Fehlerart: Sekund‰rluftmasse zu gering" UWORD B_TRUE 1 100 0 1 BIT_MASK 0x200 FORMAT "%13.11" ECU_ADDRESS 0x3FE54E /end MEASUREMENT
/begin MEASUREMENT B_mnsls2 "Fehlerart: Sekund‰rluftmasse zu gering, Bank 2" UWORD B_TRUE 1 100 0 1 BIT_MASK 0x200 FORMAT "%13.11" ECU_ADDRESS 0x3FE550 /end MEASUREMENT
/begin MEASUREMENT B_mnslv "Fehlerart:" UWORD B_TRUE 1 100 0 1 BIT_MASK 0x200 FORMAT "%13.11" ECU_ADDRESS 0x3FE552 /end MEASUREMENT
/begin MEASUREMENT B_mnslv2 "Fehlerart:" UWORD B_TRUE 1 100 0 1 BIT_MASK 0x200 FORMAT "%13.11" ECU_ADDRESS 0x3FE554 /end MEASUREMENT
/begin MEASUREMENT B_mnsta "Fehlerart: mechanisch blockierter Motor" UWORD B_TRUE 1 100 0 1 BIT_MASK 0x200 FORMAT "%13.11" ECU_ADDRESS 0x3FE558 /end MEASUREMENT
/begin MEASUREMENT B_mnsts "Fehlerart:" UWORD B_TRUE 1 100 0 1 BIT_MASK 0x200 FORMAT "%13.11" ECU_ADDRESS 0x3FE55A /end MEASUREMENT
/begin MEASUREMENT B_mnsue "Fehlerart: Kurzschluﬂ Masse an Endstufe f¸r Saugrohrumschaltung" UWORD B_TRUE 1 100 0 1 BIT_MASK 0x200 FORMAT "%13.11" ECU_ADDRESS 0x3FE55C /end MEASUREMENT
/begin MEASUREMENT B_mntes "Fehlertyp 'Minimalwert' erkannt" UWORD B_TRUE 1 100 0 1 BIT_MASK 0x200 FORMAT "%13.11" ECU_ADDRESS 0x3FE562 /end MEASUREMENT
/begin MEASUREMENT B_mnteve "Fehlertyp: Kurzschluﬂ Masse Tankentl¸ftungsventil Endstufe" UWORD B_TRUE 1 100 0 1 BIT_MASK 0x200 FORMAT "%13.11" ECU_ADDRESS 0x3FE566 /end MEASUREMENT
/begin MEASUREMENT B_mnths "Minimaler Wert unterschritten" UWORD B_TRUE 1 100 0 1 BIT_MASK 0x200 FORMAT "%13.11" ECU_ADDRESS 0x3FE568 /end MEASUREMENT
/begin MEASUREMENT B_mnufmv "Fehlertyp min.: Funktions¸berwachung: Momentenvergleich" UWORD B_TRUE 1 100 0 1 BIT_MASK 0x200 FORMAT "%13.11" ECU_ADDRESS 0x3FE572 /end MEASUREMENT
/begin MEASUREMENT B_mnufnc "Fehlertyp min.:Fkt¸berwachung:Drehzahlgeber-,Zuleitung- oder SG-Fehler" UWORD B_TRUE 1 100 0 1 BIT_MASK 0x200 FORMAT "%13.11" ECU_ADDRESS 0x3FE574 /end MEASUREMENT
/begin MEASUREMENT B_mnufrlip "Fehlertyp min.: Fkt¸berw: Lastsensor-, Zuleitung- oder SG-Fehler (ei_dps_um)" UWORD B_TRUE 1 100 0 1 BIT_MASK 0x200 FORMAT "%13.11" ECU_ADDRESS 0x3FE576 /end MEASUREMENT
/begin MEASUREMENT B_mnufsga "Fehlertyp min.: Funktions¸berwachung: Steuerger‰te-Fehler Gruppe a (ei_zwc_um)" UWORD B_TRUE 1 100 0 1 BIT_MASK 0x200 FORMAT "%13.11" ECU_ADDRESS 0x3FE578 /end MEASUREMENT
/begin MEASUREMENT B_mnufsgb "Fehlertyp min.: Funktions¸berwachung: Steuerger‰te-Fehler Gruppe b (ei_rkti_um)" UWORD B_TRUE 1 100 0 1 BIT_MASK 0x200 FORMAT "%13.11" ECU_ADDRESS 0x3FE57A /end MEASUREMENT
/begin MEASUREMENT B_mnufsgc "Fehlertyp min.:Fkt¸berwachung:SG-Fehler Gruppe c" UWORD B_TRUE 1 100 0 1 BIT_MASK 0x200 FORMAT "%13.11" ECU_ADDRESS 0x3FE57C /end MEASUREMENT
/begin MEASUREMENT B_mnufspsc "Fehlertyp min.:Fkt¸berwachung:Pedalwertgeber-,Zuleitung- oder SG-Fehler" UWORD B_TRUE 1 100 0 1 BIT_MASK 0x200 FORMAT "%13.11" ECU_ADDRESS 0x3FE57E /end MEASUREMENT
/begin MEASUREMENT B_mnulsu "Fehlerart: Min-Fehler, Spannungsdiagnose LSU" UWORD B_TRUE 1 100 0 1 BIT_MASK 0x200 FORMAT "%13.11" ECU_ADDRESS 0x3FE580 /end MEASUREMENT
/begin MEASUREMENT B_mnulsu2 "Fehlerart: Min-Fehler, Spannungsdiagnose LSU, Bank 2" UWORD B_TRUE 1 100 0 1 BIT_MASK 0x200 FORMAT "%13.11" ECU_ADDRESS 0x3FE582 /end MEASUREMENT
/begin MEASUREMENT B_mnurram "Fehlertyp min.: Rechner¸berwachung: RAM" UWORD B_TRUE 1 100 0 1 BIT_MASK 0x200 FORMAT "%13.11" ECU_ADDRESS 0x3FE584 /end MEASUREMENT
/begin MEASUREMENT B_mnurrom "Fehlertyp min.: Rechner¸berwachung: ROM" UWORD B_TRUE 1 100 0 1 BIT_MASK 0x200 FORMAT "%13.11" ECU_ADDRESS 0x3FE586 /end MEASUREMENT
/begin MEASUREMENT B_mnurrst "Fehlertyp min.: Rechner¸berwachung: Reset" UWORD B_TRUE 1 100 0 1 BIT_MASK 0x200 FORMAT "%13.11" ECU_ADDRESS 0x3FE588 /end MEASUREMENT
/begin MEASUREMENT B_mnvat "Fehlertyp VAT:  Minimalwert unterschritten" UWORD B_TRUE 1 100 0 1 BIT_MASK 0x200 FORMAT "%13.11" ECU_ADDRESS 0x3FE58A /end MEASUREMENT
/begin MEASUREMENT B_mnvfz "Fehlertyp min,: Fahrzeuggeschwindigkeit" UWORD B_TRUE 1 100 0 1 BIT_MASK 0x200 FORMAT "%13.11" ECU_ADDRESS 0x3FE58C /end MEASUREMENT
/begin MEASUREMENT B_mxanwse "Fehlerart: Kurzschluﬂ Ubat Nockenwellensteuerungsventil Endstufe (Bank1, Auslaﬂ)" UWORD B_TRUE 1 100 0 1 BIT_MASK 0x100 FORMAT "%13.11" ECU_ADDRESS 0x3FE3B8 /end MEASUREMENT
/begin MEASUREMENT B_mxanwse2 "Fehlerart: Kurzschluﬂ Ubat Nockenwellensteuerungsventil Endstufe (Bank2, Auslaﬂ)" UWORD B_TRUE 1 100 0 1 BIT_MASK 0x100 FORMAT "%13.11" ECU_ADDRESS 0x3FE3BA /end MEASUREMENT
/begin MEASUREMENT B_mxdvan "VVt Anschl‰ge nicht gelernt" UWORD B_TRUE 1 100 0 1 BIT_MASK 0x100 FORMAT "%13.11" ECU_ADDRESS 0x3FE40C /end MEASUREMENT
/begin MEASUREMENT B_mxdvcan "" UWORD B_TRUE 1 100 0 1 BIT_MASK 0x100 FORMAT "%13.11" ECU_ADDRESS 0x3FE40E /end MEASUREMENT
/begin MEASUREMENT B_mxdvcan2 "" UWORD B_TRUE 1 100 0 1 BIT_MASK 0x100 FORMAT "%13.11" ECU_ADDRESS 0x3FE410 /end MEASUREMENT
/begin MEASUREMENT B_mxdvest "Endstufe Kurzschluss UBatt" UWORD B_TRUE 1 100 0 1 BIT_MASK 0x100 FORMAT "%13.11" ECU_ADDRESS 0x3FE41E /end MEASUREMENT
/begin MEASUREMENT B_mxdvest2 "Endstufe Kurzschluss UBatt Bank 2" UWORD B_TRUE 1 100 0 1 BIT_MASK 0x100 FORMAT "%13.11" ECU_ADDRESS 0x3FE420 /end MEASUREMENT
/begin MEASUREMENT B_mxdvffs "Fuehrungssensor Magnet Loss" UWORD B_TRUE 1 100 0 1 BIT_MASK 0x100 FORMAT "%13.11" ECU_ADDRESS 0x3FE42C /end MEASUREMENT
/begin MEASUREMENT B_mxdvffs2 "Fuehrungssensor Magnet Loss Bank 2" UWORD B_TRUE 1 100 0 1 BIT_MASK 0x100 FORMAT "%13.11" ECU_ADDRESS 0x3FE42E /end MEASUREMENT
/begin MEASUREMENT B_mxdvfrs "Referenzsensor Magnet Loss" UWORD B_TRUE 1 100 0 1 BIT_MASK 0x100 FORMAT "%13.11" ECU_ADDRESS 0x3FE430 /end MEASUREMENT
/begin MEASUREMENT B_mxdvfrs2 "Referenzsensor Magnet Loss Bank 2" UWORD B_TRUE 1 100 0 1 BIT_MASK 0x100 FORMAT "%13.11" ECU_ADDRESS 0x3FE432 /end MEASUREMENT
/begin MEASUREMENT B_mxdvfsg "Steuergeraet intern EEPROM-Test" UWORD B_TRUE 1 100 0 1 BIT_MASK 0x100 FORMAT "%13.11" ECU_ADDRESS 0x3FE434 /end MEASUREMENT
/begin MEASUREMENT B_mxdvfsg2 "Fehlertyp unplaus.: Steuergeraet intern ROM-Test Bank 2" UWORD B_TRUE 1 100 0 1 BIT_MASK 0x100 FORMAT "%13.11" ECU_ADDRESS 0x3FE436 /end MEASUREMENT
/begin MEASUREMENT B_mxdvlrn "Anschlaglernen Verstellbereich fehlerhaft" UWORD B_TRUE 1 100 0 1 BIT_MASK 0x100 FORMAT "%13.11" ECU_ADDRESS 0x3FE438 /end MEASUREMENT
/begin MEASUREMENT B_mxdvlrn2 "Anschlaglernen Verstellbereich fehlerhaft Bank 2" UWORD B_TRUE 1 100 0 1 BIT_MASK 0x100 FORMAT "%13.11" ECU_ADDRESS 0x3FE43A /end MEASUREMENT
/begin MEASUREMENT B_mxdvovl "Fehlerart: Temperatur VVT-Endstufe zu hoch" UWORD B_TRUE 1 100 0 1 BIT_MASK 0x100 FORMAT "%13.11" ECU_ADDRESS 0x3FE43C /end MEASUREMENT
/begin MEASUREMENT B_mxdvovl2 "" UWORD B_TRUE 1 100 0 1 BIT_MASK 0x100 FORMAT "%13.11" ECU_ADDRESS 0x3FE43E /end MEASUREMENT
/begin MEASUREMENT B_mxdvpla "" UWORD B_TRUE 1 100 0 1 BIT_MASK 0x100 FORMAT "%13.11" ECU_ADDRESS 0x3FE440 /end MEASUREMENT
/begin MEASUREMENT B_mxdvpla2 "" UWORD B_TRUE 1 100 0 1 BIT_MASK 0x100 FORMAT "%13.11" ECU_ADDRESS 0x3FE442 /end MEASUREMENT
/begin MEASUREMENT B_mxdvpmn "Ventil nicht zu ˆffnen" UWORD B_TRUE 1 100 0 1 BIT_MASK 0x100 FORMAT "%13.11" ECU_ADDRESS 0x3FE444 /end MEASUREMENT
/begin MEASUREMENT B_mxdvste "Bedingung: MAX-Fehler VVT-Stellglied¸berwachung" UWORD B_TRUE 1 100 0 1 BIT_MASK 0x100 FORMAT "%13.11" ECU_ADDRESS 0x3FE446 /end MEASUREMENT
/begin MEASUREMENT B_mxdvste2 "" UWORD B_TRUE 1 100 0 1 BIT_MASK 0x100 FORMAT "%13.11" ECU_ADDRESS 0x3FE448 /end MEASUREMENT
/begin MEASUREMENT B_mxdvulv "Leistungsversorgung VVT Spannung zu hoch" UWORD B_TRUE 1 100 0 1 BIT_MASK 0x100 FORMAT "%13.11" ECU_ADDRESS 0x3FE44A /end MEASUREMENT
/begin MEASUREMENT B_mxdvulv2 "Leistungsversorgung VVT Spannung zu hoch Bank 2" UWORD B_TRUE 1 100 0 1 BIT_MASK 0x100 FORMAT "%13.11" ECU_ADDRESS 0x3FE44C /end MEASUREMENT
/begin MEASUREMENT B_mxdvuse "Sensor-Versorgungsspannung zu hoch" UWORD B_TRUE 1 100 0 1 BIT_MASK 0x100 FORMAT "%13.11" ECU_ADDRESS 0x3FE44E /end MEASUREMENT
/begin MEASUREMENT B_mxdvuse2 "Sensor-Versorgungsspannung zu hoch Bank 2" UWORD B_TRUE 1 100 0 1 BIT_MASK 0x100 FORMAT "%13.11" ECU_ADDRESS 0x3FE450 /end MEASUREMENT
/begin MEASUREMENT B_mxenws "Bed. Nockenwellenverstellung hat Sp‰tposition nicht erreicht (Einlaﬂ,Bank1)" UWORD B_TRUE 1 100 0 1 BIT_MASK 0x100 FORMAT "%13.11" ECU_ADDRESS 0x3FE46C /end MEASUREMENT
/begin MEASUREMENT B_mxenws2 "Bed. Nockenwellenverstellung hat Sp‰tposition nicht erreicht (Einlaﬂ,Bank2)" UWORD B_TRUE 1 100 0 1 BIT_MASK 0x100 FORMAT "%13.11" ECU_ADDRESS 0x3FE46E /end MEASUREMENT
/begin MEASUREMENT B_mxenwse "Fehlerart: Kurzschluﬂ Ubat Nockenwellensteuerungsventil Endstufe" UWORD B_TRUE 1 100 0 1 BIT_MASK 0x100 FORMAT "%13.11" ECU_ADDRESS 0x3FE470 /end MEASUREMENT
/begin MEASUREMENT B_mxenwse2 "Bedingung: max. Fehler Nockenwellensteuerung Endstufe (Bank2, Einlaﬂ)" UWORD B_TRUE 1 100 0 1 BIT_MASK 0x100 FORMAT "%13.11" ECU_ADDRESS 0x3FE472 /end MEASUREMENT
/begin MEASUREMENT B_mxph "Fehlerart: Kurzschluﬂ Ubat Phasengeber" UWORD B_TRUE 1 100 0 1 BIT_MASK 0x100 FORMAT "%13.11" ECU_ADDRESS 0x3FE530 /end MEASUREMENT
/begin MEASUREMENT B_mxph2 "Fehlerart: Kurzschluﬂ  Ubat Phasengeber 2" UWORD B_TRUE 1 100 0 1 BIT_MASK 0x100 FORMAT "%13.11" ECU_ADDRESS 0x3FE532 /end MEASUREMENT
/begin MEASUREMENT B_mxph3 "Fehlerart: Kurzschluﬂ  Ubat Phasengeber 3" UWORD B_TRUE 1 100 0 1 BIT_MASK 0x100 FORMAT "%13.11" ECU_ADDRESS 0x3FE534 /end MEASUREMENT
/begin MEASUREMENT B_mxph4 "Fehlerart: Kurzschluﬂ  Ubat Phasengeber 4" UWORD B_TRUE 1 100 0 1 BIT_MASK 0x100 FORMAT "%13.11" ECU_ADDRESS 0x3FE536 /end MEASUREMENT
/begin MEASUREMENT B_mxphm "Fehlerart: Maxfehler Phasengeber MIL" UWORD B_TRUE 1 100 0 1 BIT_MASK 0x100 FORMAT "%13.11" ECU_ADDRESS 0x3FE538 /end MEASUREMENT
/begin MEASUREMENT B_mxpllsu "Fehlerart:  Max-Fehler Plausibilit‰t LSU: Offsetfehler" UWORD B_TRUE 1 100 0 1 BIT_MASK 0x100 FORMAT "%13.11" ECU_ADDRESS 0x3FE53A /end MEASUREMENT
/begin MEASUREMENT B_mxpllsu2 "Fehlerart:  Max-Fehler Plausibilit‰t LSU: Offsetfehler, Bank 2" UWORD B_TRUE 1 100 0 1 BIT_MASK 0x100 FORMAT "%13.11" ECU_ADDRESS 0x3FE53C /end MEASUREMENT
/begin MEASUREMENT B_mxpoels "MaxError f¸r die Plausibilisierung des ÷ldruckschalters" UWORD B_TRUE 1 100 0 1 BIT_MASK 0x100 FORMAT "%13.11" ECU_ADDRESS 0x3FE542 /end MEASUREMENT
/begin MEASUREMENT B_mxslpe "Fehlertype: Kurzschluﬂ nach Ubatt Endstufe Sekund‰rluftpumpe" UWORD B_TRUE 1 100 0 1 BIT_MASK 0x100 FORMAT "%13.11" ECU_ADDRESS 0x3FE54C /end MEASUREMENT
/begin MEASUREMENT B_mxsls "Fehlerart:Sekund‰rluftsystem" UWORD B_TRUE 1 100 0 1 BIT_MASK 0x100 FORMAT "%13.11" ECU_ADDRESS 0x3FE54E /end MEASUREMENT
/begin MEASUREMENT B_mxsls2 "Fehlerart:Sekund‰rluftsystem Bank 2" UWORD B_TRUE 1 100 0 1 BIT_MASK 0x100 FORMAT "%13.11" ECU_ADDRESS 0x3FE550 /end MEASUREMENT
/begin MEASUREMENT B_mxslv "Fehlerart: Sekund‰rluftmasse bei Ventildichtheitspr¸fung zu groﬂ" UWORD B_TRUE 1 100 0 1 BIT_MASK 0x100 FORMAT "%13.11" ECU_ADDRESS 0x3FE552 /end MEASUREMENT
/begin MEASUREMENT B_mxslv2 "Fehlerart: Sekund‰rluftmasse bei Ventildichtheitspr¸fung zu groﬂ, Bank 2" UWORD B_TRUE 1 100 0 1 BIT_MASK 0x100 FORMAT "%13.11" ECU_ADDRESS 0x3FE554 /end MEASUREMENT
/begin MEASUREMENT B_mxsta "Fehlerart: Kurzschluﬂ an Endstufe des Anlasser" UWORD B_TRUE 1 100 0 1 BIT_MASK 0x100 FORMAT "%13.11" ECU_ADDRESS 0x3FE558 /end MEASUREMENT
/begin MEASUREMENT B_mxsts "Fehlerart: Dauersignal von KL 50" UWORD B_TRUE 1 100 0 1 BIT_MASK 0x100 FORMAT "%13.11" ECU_ADDRESS 0x3FE55A /end MEASUREMENT
/begin MEASUREMENT B_mxsue "Fehlerart: Kurzschluﬂ Ubat an Endstufe f¸r Saugrohrumschaltung" UWORD B_TRUE 1 100 0 1 BIT_MASK 0x100 FORMAT "%13.11" ECU_ADDRESS 0x3FE55C /end MEASUREMENT
/begin MEASUREMENT B_mxteve "Fehlertyp: Kurzschluﬂ Ubat Tankentl¸ftungsventil Endstufe" UWORD B_TRUE 1 100 0 1 BIT_MASK 0x100 FORMAT "%13.11" ECU_ADDRESS 0x3FE566 /end MEASUREMENT
/begin MEASUREMENT B_mxths "Maximaler Wert ‹berschritten" UWORD B_TRUE 1 100 0 1 BIT_MASK 0x100 FORMAT "%13.11" ECU_ADDRESS 0x3FE568 /end MEASUREMENT
/begin MEASUREMENT B_mxufmv "Fehlertyp max.: Funktions¸berwachung: Momentenvergleich" UWORD B_TRUE 1 100 0 1 BIT_MASK 0x100 FORMAT "%13.11" ECU_ADDRESS 0x3FE572 /end MEASUREMENT
/begin MEASUREMENT B_mxufnc "Fehlertyp max.:Fkt¸berwachung:Drehzahlgeber-,Zuleitung- oder SG-Fehler" UWORD B_TRUE 1 100 0 1 BIT_MASK 0x100 FORMAT "%13.11" ECU_ADDRESS 0x3FE574 /end MEASUREMENT
/begin MEASUREMENT B_mxufrlip "Fehlertyp max.:Fkt¸berwachung:Lastsensor-,Zuleitung oder SG-Fehler" UWORD B_TRUE 1 100 0 1 BIT_MASK 0x100 FORMAT "%13.11" ECU_ADDRESS 0x3FE576 /end MEASUREMENT
/begin MEASUREMENT B_mxufsga "Fehlertyp max.: Funktions¸berwachung: Steuerger‰te-Fehler Gruppe a (ei_rlc_um)" UWORD B_TRUE 1 100 0 1 BIT_MASK 0x100 FORMAT "%13.11" ECU_ADDRESS 0x3FE578 /end MEASUREMENT
/begin MEASUREMENT B_mxufsgb "Fehlertyp max.: Funktions¸berwachung: Steuerger‰te-Fehler Gruppe b (ei_gkc_um)" UWORD B_TRUE 1 100 0 1 BIT_MASK 0x100 FORMAT "%13.11" ECU_ADDRESS 0x3FE57A /end MEASUREMENT
/begin MEASUREMENT B_mxufsgc "Fehlertyp max.: Funktions¸berwachung: Steuerger‰te-Fehler Gruppe c (ei_tpu_um)" UWORD B_TRUE 1 100 0 1 BIT_MASK 0x100 FORMAT "%13.11" ECU_ADDRESS 0x3FE57C /end MEASUREMENT
/begin MEASUREMENT B_mxufspsc "Fehlertyp max.:Fkt¸berwachung:Pedalwergeber-,Zuleitung-oder SG-Fehler" UWORD B_TRUE 1 100 0 1 BIT_MASK 0x100 FORMAT "%13.11" ECU_ADDRESS 0x3FE57E /end MEASUREMENT
/begin MEASUREMENT B_mxulsu "Fehlerart: Max-Fehler, Spannungsdiagnose LSU," UWORD B_TRUE 1 100 0 1 BIT_MASK 0x100 FORMAT "%13.11" ECU_ADDRESS 0x3FE580 /end MEASUREMENT
/begin MEASUREMENT B_mxulsu2 "Fehlerart: Max-Fehler, Spannungsdiagnose LSU, Bank 2" UWORD B_TRUE 1 100 0 1 BIT_MASK 0x100 FORMAT "%13.11" ECU_ADDRESS 0x3FE582 /end MEASUREMENT
/begin MEASUREMENT B_mxurram "Fehlertyp max.: Rechner¸berwachung: RAM" UWORD B_TRUE 1 100 0 1 BIT_MASK 0x100 FORMAT "%13.11" ECU_ADDRESS 0x3FE584 /end MEASUREMENT
/begin MEASUREMENT B_mxurrom "Fehlertyp max.: Rechner¸berwachung: ROM" UWORD B_TRUE 1 100 0 1 BIT_MASK 0x100 FORMAT "%13.11" ECU_ADDRESS 0x3FE586 /end MEASUREMENT
/begin MEASUREMENT B_mxurrst "Fehlertyp max.: Rechner¸berwachung: Reset" UWORD B_TRUE 1 100 0 1 BIT_MASK 0x100 FORMAT "%13.11" ECU_ADDRESS 0x3FE588 /end MEASUREMENT
/begin MEASUREMENT B_mxvat "Fehlertyp VAT:  Maximalwert ¸berschritten" UWORD B_TRUE 1 100 0 1 BIT_MASK 0x100 FORMAT "%13.11" ECU_ADDRESS 0x3FE58A /end MEASUREMENT
/begin MEASUREMENT B_mxvfz "Fehlertyp max.: Fahrzeuggeschwindigkeit" UWORD B_TRUE 1 100 0 1 BIT_MASK 0x100 FORMAT "%13.11" ECU_ADDRESS 0x3FE58C /end MEASUREMENT
/begin MEASUREMENT B_npanwse "Fehlertyp unplaus.: Nockenwellensteuerung Endstufe (Auslaﬂ, Bank1)" UWORD B_TRUE 1 100 0 1 BIT_MASK 0x800 FORMAT "%13.11" ECU_ADDRESS 0x3FE3B8 /end MEASUREMENT
/begin MEASUREMENT B_npanwse2 "Fehlertyp unplaus.: Nockenwellensteuerung Endstufe (Auslaﬂ, Bank2)" UWORD B_TRUE 1 100 0 1 BIT_MASK 0x800 FORMAT "%13.11" ECU_ADDRESS 0x3FE3BA /end MEASUREMENT
/begin MEASUREMENT B_npdvan "" UWORD B_TRUE 1 100 0 1 BIT_MASK 0x800 FORMAT "%13.11" ECU_ADDRESS 0x3FE40C /end MEASUREMENT
/begin MEASUREMENT B_npdvcan "CAN Kommunikation unplaus. Werte" UWORD B_TRUE 1 100 0 1 BIT_MASK 0x800 FORMAT "%13.11" ECU_ADDRESS 0x3FE40E /end MEASUREMENT
/begin MEASUREMENT B_npdvcan2 "CAN Kommunikation unplaus. Werte Bank 2" UWORD B_TRUE 1 100 0 1 BIT_MASK 0x800 FORMAT "%13.11" ECU_ADDRESS 0x3FE410 /end MEASUREMENT
/begin MEASUREMENT B_npdvest "" UWORD B_TRUE 1 100 0 1 BIT_MASK 0x800 FORMAT "%13.11" ECU_ADDRESS 0x3FE41E /end MEASUREMENT
/begin MEASUREMENT B_npdvest2 "" UWORD B_TRUE 1 100 0 1 BIT_MASK 0x800 FORMAT "%13.11" ECU_ADDRESS 0x3FE420 /end MEASUREMENT
/begin MEASUREMENT B_npdvffs "Fuehrungssensor Gradientenueberschreitung" UWORD B_TRUE 1 100 0 1 BIT_MASK 0x800 FORMAT "%13.11" ECU_ADDRESS 0x3FE42C /end MEASUREMENT
/begin MEASUREMENT B_npdvffs2 "Fuehrungssensor Gradientenueberschreitung Bank 2" UWORD B_TRUE 1 100 0 1 BIT_MASK 0x800 FORMAT "%13.11" ECU_ADDRESS 0x3FE42E /end MEASUREMENT
/begin MEASUREMENT B_npdvfrs "Referenzsensor Gradientenueberschreitung" UWORD B_TRUE 1 100 0 1 BIT_MASK 0x800 FORMAT "%13.11" ECU_ADDRESS 0x3FE430 /end MEASUREMENT
/begin MEASUREMENT B_npdvfrs2 "Referenzsensor Gradientenueberschreitung Bank 2" UWORD B_TRUE 1 100 0 1 BIT_MASK 0x800 FORMAT "%13.11" ECU_ADDRESS 0x3FE432 /end MEASUREMENT
/begin MEASUREMENT B_npdvfsg "Steuergeraet intern ROM-Test" UWORD B_TRUE 1 100 0 1 BIT_MASK 0x800 FORMAT "%13.11" ECU_ADDRESS 0x3FE434 /end MEASUREMENT
/begin MEASUREMENT B_npdvfsg2 "Steuergeraet intern ROM-Test Bank 2" UWORD B_TRUE 1 100 0 1 BIT_MASK 0x800 FORMAT "%13.11" ECU_ADDRESS 0x3FE436 /end MEASUREMENT
/begin MEASUREMENT B_npdvlrn "" UWORD B_TRUE 1 100 0 1 BIT_MASK 0x800 FORMAT "%13.11" ECU_ADDRESS 0x3FE438 /end MEASUREMENT
/begin MEASUREMENT B_npdvlrn2 "" UWORD B_TRUE 1 100 0 1 BIT_MASK 0x800 FORMAT "%13.11" ECU_ADDRESS 0x3FE43A /end MEASUREMENT
/begin MEASUREMENT B_npdvovl "" UWORD B_TRUE 1 100 0 1 BIT_MASK 0x800 FORMAT "%13.11" ECU_ADDRESS 0x3FE43C /end MEASUREMENT
/begin MEASUREMENT B_npdvovl2 "" UWORD B_TRUE 1 100 0 1 BIT_MASK 0x800 FORMAT "%13.11" ECU_ADDRESS 0x3FE43E /end MEASUREMENT
/begin MEASUREMENT B_npdvpla "Sensorsignale zueinander unplausibel" UWORD B_TRUE 1 100 0 1 BIT_MASK 0x800 FORMAT "%13.11" ECU_ADDRESS 0x3FE440 /end MEASUREMENT
/begin MEASUREMENT B_npdvpla2 "Sensorsignale zueinander unplausibel Bank 2" UWORD B_TRUE 1 100 0 1 BIT_MASK 0x800 FORMAT "%13.11" ECU_ADDRESS 0x3FE442 /end MEASUREMENT
/begin MEASUREMENT B_npdvpmn "" UWORD B_TRUE 1 100 0 1 BIT_MASK 0x800 FORMAT "%13.11" ECU_ADDRESS 0x3FE444 /end MEASUREMENT
/begin MEASUREMENT B_npdvste "Stellgliedueberwachung Drehrichtung" UWORD B_TRUE 1 100 0 1 BIT_MASK 0x800 FORMAT "%13.11" ECU_ADDRESS 0x3FE446 /end MEASUREMENT
/begin MEASUREMENT B_npdvste2 "Stellgliedueberwachung Drehrichtung Bank 2" UWORD B_TRUE 1 100 0 1 BIT_MASK 0x800 FORMAT "%13.11" ECU_ADDRESS 0x3FE448 /end MEASUREMENT
/begin MEASUREMENT B_npdvulv "Leistungsvers. VVT Abschaltung fehlerhaft" UWORD B_TRUE 1 100 0 1 BIT_MASK 0x800 FORMAT "%13.11" ECU_ADDRESS 0x3FE44A /end MEASUREMENT
/begin MEASUREMENT B_npdvulv2 "Leistungsvers. VVT Abschaltung fehlerhaft Bank 2" UWORD B_TRUE 1 100 0 1 BIT_MASK 0x800 FORMAT "%13.11" ECU_ADDRESS 0x3FE44C /end MEASUREMENT
/begin MEASUREMENT B_npdvuse "" UWORD B_TRUE 1 100 0 1 BIT_MASK 0x800 FORMAT "%13.11" ECU_ADDRESS 0x3FE44E /end MEASUREMENT
/begin MEASUREMENT B_npdvuse2 "" UWORD B_TRUE 1 100 0 1 BIT_MASK 0x800 FORMAT "%13.11" ECU_ADDRESS 0x3FE450 /end MEASUREMENT
/begin MEASUREMENT B_npenws "Bed. Nockenwellenverstellung hat unplausible Position (Einlaﬂ,Bank1)" UWORD B_TRUE 1 100 0 1 BIT_MASK 0x800 FORMAT "%13.11" ECU_ADDRESS 0x3FE46C /end MEASUREMENT
/begin MEASUREMENT B_npenws2 "Bed. Nockenwellenverstellung hat unplausible Position (Einlaﬂ,Bank2)" UWORD B_TRUE 1 100 0 1 BIT_MASK 0x800 FORMAT "%13.11" ECU_ADDRESS 0x3FE46E /end MEASUREMENT
/begin MEASUREMENT B_npenwse "Fehlertyp unplaus.: Nockenwellensteuerung Endstufe (Einlaﬂ, Bank1)" UWORD B_TRUE 1 100 0 1 BIT_MASK 0x800 FORMAT "%13.11" ECU_ADDRESS 0x3FE470 /end MEASUREMENT
/begin MEASUREMENT B_npenwse2 "Fehlertyp unplaus.: Nockenwellensteuerung Endstufe (Einlaﬂ, Bank2)" UWORD B_TRUE 1 100 0 1 BIT_MASK 0x800 FORMAT "%13.11" ECU_ADDRESS 0x3FE472 /end MEASUREMENT
/begin MEASUREMENT B_npph "Bedingung Phasengebersignal ist unplausibel (ph)" UWORD B_TRUE 1 100 0 1 BIT_MASK 0x800 FORMAT "%13.11" ECU_ADDRESS 0x3FE530 /end MEASUREMENT
/begin MEASUREMENT B_npph2 "Bedingung Phasengebersignal ist unplausibel (ph2)" UWORD B_TRUE 1 100 0 1 BIT_MASK 0x800 FORMAT "%13.11" ECU_ADDRESS 0x3FE532 /end MEASUREMENT
/begin MEASUREMENT B_npph3 "Bedingung Phasengebersignal ist unplausibel (ph3)" UWORD B_TRUE 1 100 0 1 BIT_MASK 0x800 FORMAT "%13.11" ECU_ADDRESS 0x3FE534 /end MEASUREMENT
/begin MEASUREMENT B_npph4 "Bedingung Phasengebersignal ist unplausibel (ph4)" UWORD B_TRUE 1 100 0 1 BIT_MASK 0x800 FORMAT "%13.11" ECU_ADDRESS 0x3FE536 /end MEASUREMENT
/begin MEASUREMENT B_npphm "Fehlerart: nicht plausibel Phasengeber MIL" UWORD B_TRUE 1 100 0 1 BIT_MASK 0x800 FORMAT "%13.11" ECU_ADDRESS 0x3FE538 /end MEASUREMENT
/begin MEASUREMENT B_nppllsu "Bedingung Signalfehler LSU: LSU zeigt zu mager" UWORD B_TRUE 1 100 0 1 BIT_MASK 0x800 FORMAT "%13.11" ECU_ADDRESS 0x3FE53A /end MEASUREMENT
/begin MEASUREMENT B_nppllsu2 "Bedingung Signalfehler LSU: LSU zeigt zu mager, Bank 2" UWORD B_TRUE 1 100 0 1 BIT_MASK 0x800 FORMAT "%13.11" ECU_ADDRESS 0x3FE53C /end MEASUREMENT
/begin MEASUREMENT B_nppoels "NplError f¸r die Plausibilisierung des ÷ldruckschalters" UWORD B_TRUE 1 100 0 1 BIT_MASK 0x800 FORMAT "%13.11" ECU_ADDRESS 0x3FE542 /end MEASUREMENT
/begin MEASUREMENT B_npslpe "Nicht plausibler Fehler: Sekund‰rluftpumpe Endstufe" UWORD B_TRUE 1 100 0 1 BIT_MASK 0x800 FORMAT "%13.11" ECU_ADDRESS 0x3FE54C /end MEASUREMENT
/begin MEASUREMENT B_npsls "Fehlerart: Offsetwert Sekund‰rluftmasse zu groﬂ" UWORD B_TRUE 1 100 0 1 BIT_MASK 0x800 FORMAT "%13.11" ECU_ADDRESS 0x3FE54E /end MEASUREMENT
/begin MEASUREMENT B_npsls2 "Fehlerart: Offsetwert Sekund‰rluftmasse zu groﬂ, Bank 2" UWORD B_TRUE 1 100 0 1 BIT_MASK 0x800 FORMAT "%13.11" ECU_ADDRESS 0x3FE550 /end MEASUREMENT
/begin MEASUREMENT B_npslv "Fehlerart: Offsetwert Sekund‰rluftmasse zu groﬂ" UWORD B_TRUE 1 100 0 1 BIT_MASK 0x800 FORMAT "%13.11" ECU_ADDRESS 0x3FE552 /end MEASUREMENT
/begin MEASUREMENT B_npslv2 "Fehlerart: Offsetwert Sekund‰rluftmasse zu groﬂ, Bank 2" UWORD B_TRUE 1 100 0 1 BIT_MASK 0x800 FORMAT "%13.11" ECU_ADDRESS 0x3FE554 /end MEASUREMENT
/begin MEASUREMENT B_npsta "Fehlerart: noch nicht belegt" UWORD B_TRUE 1 100 0 1 BIT_MASK 0x800 FORMAT "%13.11" ECU_ADDRESS 0x3FE558 /end MEASUREMENT
/begin MEASUREMENT B_npsts "Fehlerart:" UWORD B_TRUE 1 100 0 1 BIT_MASK 0x800 FORMAT "%13.11" ECU_ADDRESS 0x3FE55A /end MEASUREMENT
/begin MEASUREMENT B_npsue "Nicht plausibler Fehler: Saugrohrumschaltung Endstufe" UWORD B_TRUE 1 100 0 1 BIT_MASK 0x800 FORMAT "%13.11" ECU_ADDRESS 0x3FE55C /end MEASUREMENT
/begin MEASUREMENT B_npteve "Nicht plausibler Fehler: Tankentl¸ftungsventil Endstufe" UWORD B_TRUE 1 100 0 1 BIT_MASK 0x800 FORMAT "%13.11" ECU_ADDRESS 0x3FE566 /end MEASUREMENT
/begin MEASUREMENT B_npths "Signal unplausibel" UWORD B_TRUE 1 100 0 1 BIT_MASK 0x800 FORMAT "%13.11" ECU_ADDRESS 0x3FE568 /end MEASUREMENT
/begin MEASUREMENT B_npufmv "Fehlertyp unplaus.: Funktions¸berwachung: Momentenvergleich" UWORD B_TRUE 1 100 0 1 BIT_MASK 0x800 FORMAT "%13.11" ECU_ADDRESS 0x3FE572 /end MEASUREMENT
/begin MEASUREMENT B_npufnc "Fehlertyp unplaus.: Fkt¸berwachung: Drehzahlgeber-, Zuleitung- oder SG-Fehler" UWORD B_TRUE 1 100 0 1 BIT_MASK 0x800 FORMAT "%13.11" ECU_ADDRESS 0x3FE574 /end MEASUREMENT
/begin MEASUREMENT B_npufrlip "Fehlertyp unplaus.: Fkt¸berw: Lastsensor-, Zuleitung-oder SG-Fehler (ei_rlip_um)" UWORD B_TRUE 1 100 0 1 BIT_MASK 0x800 FORMAT "%13.11" ECU_ADDRESS 0x3FE576 /end MEASUREMENT
/begin MEASUREMENT B_npufsga "Fehlertyp unplaus.: Funktions¸berwach: Steuerger‰te-Fehler Gruppe a (ei_reac_um)" UWORD B_TRUE 1 100 0 1 BIT_MASK 0x800 FORMAT "%13.11" ECU_ADDRESS 0x3FE578 /end MEASUREMENT
/begin MEASUREMENT B_npufsgb "Fehlertyp unplaus.: Funktions¸berwach: Steuerger‰te-Fehler Gruppe b (ei_ipa_um)" UWORD B_TRUE 1 100 0 1 BIT_MASK 0x800 FORMAT "%13.11" ECU_ADDRESS 0x3FE57A /end MEASUREMENT
/begin MEASUREMENT B_npufsgc "Fehlertyp unplaus.:Funktions¸berwachung:SG-Fehler Gruppe c" UWORD B_TRUE 1 100 0 1 BIT_MASK 0x800 FORMAT "%13.11" ECU_ADDRESS 0x3FE57C /end MEASUREMENT
/begin MEASUREMENT B_npufspsc "Fehlertyp unplaus.: Fkt¸berwachung: Pedalwertgeber-, Zuleitung- oder SG-Fehler" UWORD B_TRUE 1 100 0 1 BIT_MASK 0x800 FORMAT "%13.11" ECU_ADDRESS 0x3FE57E /end MEASUREMENT
/begin MEASUREMENT B_npulsu "Fehlerart: Plaus-Fehler, Spannungsdiagnose LSU" UWORD B_TRUE 1 100 0 1 BIT_MASK 0x800 FORMAT "%13.11" ECU_ADDRESS 0x3FE580 /end MEASUREMENT
/begin MEASUREMENT B_npulsu2 "Fehlerart: Plaus-Fehler, Spannungsdiagnose LSU, Bank 2" UWORD B_TRUE 1 100 0 1 BIT_MASK 0x800 FORMAT "%13.11" ECU_ADDRESS 0x3FE582 /end MEASUREMENT
/begin MEASUREMENT B_npurram "Fehlertyp unplaus: Rechner¸berwachung: RAM" UWORD B_TRUE 1 100 0 1 BIT_MASK 0x800 FORMAT "%13.11" ECU_ADDRESS 0x3FE584 /end MEASUREMENT
/begin MEASUREMENT B_npurrom "Fehlertyp unplaus.: Rechner¸berwachung: ROM" UWORD B_TRUE 1 100 0 1 BIT_MASK 0x800 FORMAT "%13.11" ECU_ADDRESS 0x3FE586 /end MEASUREMENT
/begin MEASUREMENT B_npurrst "Fehlertyp unplaus: Rechner¸berwachung: Reset" UWORD B_TRUE 1 100 0 1 BIT_MASK 0x800 FORMAT "%13.11" ECU_ADDRESS 0x3FE588 /end MEASUREMENT
/begin MEASUREMENT B_npvat "Fehlertyp VAT: Pr¸fresultat nicht plausibel" UWORD B_TRUE 1 100 0 1 BIT_MASK 0x800 FORMAT "%13.11" ECU_ADDRESS 0x3FE58A /end MEASUREMENT
/begin MEASUREMENT B_npvfz "Fehlerart: Fahrzeuggeschwindigkeit nicht plausibel" UWORD B_TRUE 1 100 0 1 BIT_MASK 0x800 FORMAT "%13.11" ECU_ADDRESS 0x3FE58C /end MEASUREMENT
/begin MEASUREMENT B_sianwse "Fehlerart: Leitungsabfall Nockenwellensteuerungsventil Endstufe (Bank1, Auslaﬂ)" UWORD B_TRUE 1 100 0 1 BIT_MASK 0x400 FORMAT "%13.11" ECU_ADDRESS 0x3FE3B8 /end MEASUREMENT
/begin MEASUREMENT B_sianwse2 "Fehlerart: Leitungsabfall Nockenwellensteuerungsventil Endstufe (Bank2, Auslaﬂ)" UWORD B_TRUE 1 100 0 1 BIT_MASK 0x400 FORMAT "%13.11" ECU_ADDRESS 0x3FE3BA /end MEASUREMENT
/begin MEASUREMENT B_sidvan "" UWORD B_TRUE 1 100 0 1 BIT_MASK 0x400 FORMAT "%13.11" ECU_ADDRESS 0x3FE40C /end MEASUREMENT
/begin MEASUREMENT B_sidvcan "CAN Kommunikation Timeout" UWORD B_TRUE 1 100 0 1 BIT_MASK 0x400 FORMAT "%13.11" ECU_ADDRESS 0x3FE40E /end MEASUREMENT
/begin MEASUREMENT B_sidvcan2 "CAN Kommunikation Timeout Bank 2" UWORD B_TRUE 1 100 0 1 BIT_MASK 0x400 FORMAT "%13.11" ECU_ADDRESS 0x3FE410 /end MEASUREMENT
/begin MEASUREMENT B_sidvest "Endstufe Kurzschluss Motorwicklung" UWORD B_TRUE 1 100 0 1 BIT_MASK 0x400 FORMAT "%13.11" ECU_ADDRESS 0x3FE41E /end MEASUREMENT
/begin MEASUREMENT B_sidvest2 "Endstufe Kurzschluss Motorwicklung Bank 2" UWORD B_TRUE 1 100 0 1 BIT_MASK 0x400 FORMAT "%13.11" ECU_ADDRESS 0x3FE420 /end MEASUREMENT
/begin MEASUREMENT B_sidvffs "Fuehrungssensor Parityfehler/kein Signal" UWORD B_TRUE 1 100 0 1 BIT_MASK 0x400 FORMAT "%13.11" ECU_ADDRESS 0x3FE42C /end MEASUREMENT
/begin MEASUREMENT B_sidvffs2 "Fuehrungssensor Parityfehler/kein Signal Bank 2" UWORD B_TRUE 1 100 0 1 BIT_MASK 0x400 FORMAT "%13.11" ECU_ADDRESS 0x3FE42E /end MEASUREMENT
/begin MEASUREMENT B_sidvfrs "Referenzsensor Parityfehler/kein Signal" UWORD B_TRUE 1 100 0 1 BIT_MASK 0x400 FORMAT "%13.11" ECU_ADDRESS 0x3FE430 /end MEASUREMENT
/begin MEASUREMENT B_sidvfrs2 "Referenzsensor Parityfehler/kein Signal Bank 2" UWORD B_TRUE 1 100 0 1 BIT_MASK 0x400 FORMAT "%13.11" ECU_ADDRESS 0x3FE432 /end MEASUREMENT
/begin MEASUREMENT B_sidvfsg "Steuergeraet intern Stackueberwachung" UWORD B_TRUE 1 100 0 1 BIT_MASK 0x400 FORMAT "%13.11" ECU_ADDRESS 0x3FE434 /end MEASUREMENT
/begin MEASUREMENT B_sidvfsg2 "Steuergeraet intern Stackueberwachung Bank 2" UWORD B_TRUE 1 100 0 1 BIT_MASK 0x400 FORMAT "%13.11" ECU_ADDRESS 0x3FE436 /end MEASUREMENT
/begin MEASUREMENT B_sidvlrn "Anschlaglernen Abbruch wegen Timeout" UWORD B_TRUE 1 100 0 1 BIT_MASK 0x400 FORMAT "%13.11" ECU_ADDRESS 0x3FE438 /end MEASUREMENT
/begin MEASUREMENT B_sidvlrn2 "Anschlaglernen Abbruch wegen Timeout Bank 2" UWORD B_TRUE 1 100 0 1 BIT_MASK 0x400 FORMAT "%13.11" ECU_ADDRESS 0x3FE43A /end MEASUREMENT
/begin MEASUREMENT B_sidvovl "" UWORD B_TRUE 1 100 0 1 BIT_MASK 0x400 FORMAT "%13.11" ECU_ADDRESS 0x3FE43C /end MEASUREMENT
/begin MEASUREMENT B_sidvovl2 "" UWORD B_TRUE 1 100 0 1 BIT_MASK 0x400 FORMAT "%13.11" ECU_ADDRESS 0x3FE43E /end MEASUREMENT
/begin MEASUREMENT B_sidvpla "Sensorplausibilisierung Datenkonformitaet" UWORD B_TRUE 1 100 0 1 BIT_MASK 0x400 FORMAT "%13.11" ECU_ADDRESS 0x3FE440 /end MEASUREMENT
/begin MEASUREMENT B_sidvpla2 "Sensorplausibilisierung Datenkonformitaet Bank 2" UWORD B_TRUE 1 100 0 1 BIT_MASK 0x400 FORMAT "%13.11" ECU_ADDRESS 0x3FE442 /end MEASUREMENT
/begin MEASUREMENT B_sidvpmn "Plausibilisierung ml zu gering" UWORD B_TRUE 1 100 0 1 BIT_MASK 0x400 FORMAT "%13.11" ECU_ADDRESS 0x3FE444 /end MEASUREMENT
/begin MEASUREMENT B_sidvste "Stellgliedueberwachung Lageregler" UWORD B_TRUE 1 100 0 1 BIT_MASK 0x400 FORMAT "%13.11" ECU_ADDRESS 0x3FE446 /end MEASUREMENT
/begin MEASUREMENT B_sidvste2 "Stellgliedueberwachung Lageregler Bank 2" UWORD B_TRUE 1 100 0 1 BIT_MASK 0x400 FORMAT "%13.11" ECU_ADDRESS 0x3FE448 /end MEASUREMENT
/begin MEASUREMENT B_sidvulv "" UWORD B_TRUE 1 100 0 1 BIT_MASK 0x400 FORMAT "%13.11" ECU_ADDRESS 0x3FE44A /end MEASUREMENT
/begin MEASUREMENT B_sidvulv2 "" UWORD B_TRUE 1 100 0 1 BIT_MASK 0x400 FORMAT "%13.11" ECU_ADDRESS 0x3FE44C /end MEASUREMENT
/begin MEASUREMENT B_sidvuse "" UWORD B_TRUE 1 100 0 1 BIT_MASK 0x400 FORMAT "%13.11" ECU_ADDRESS 0x3FE44E /end MEASUREMENT
/begin MEASUREMENT B_sidvuse2 "" UWORD B_TRUE 1 100 0 1 BIT_MASK 0x400 FORMAT "%13.11" ECU_ADDRESS 0x3FE450 /end MEASUREMENT
/begin MEASUREMENT B_sienws "Fehlerart: Leitungsabfall Nockenwellensteuerungsventil (Bank1, Einlaﬂ)" UWORD B_TRUE 1 100 0 1 BIT_MASK 0x400 FORMAT "%13.11" ECU_ADDRESS 0x3FE46C /end MEASUREMENT
/begin MEASUREMENT B_sienws2 "Fehlerart: Leitungsabfall Nockenwellensteuerungsventil (Bank2, Einlaﬂ)" UWORD B_TRUE 1 100 0 1 BIT_MASK 0x400 FORMAT "%13.11" ECU_ADDRESS 0x3FE46E /end MEASUREMENT
/begin MEASUREMENT B_sienwse "Fehlerart: Leitungsabfall Nockenwellensteuerungsventil Endstufe (Bank1, Einlaﬂ)" UWORD B_TRUE 1 100 0 1 BIT_MASK 0x400 FORMAT "%13.11" ECU_ADDRESS 0x3FE470 /end MEASUREMENT
/begin MEASUREMENT B_sienwse2 "Fehlerart: Nockenwellensteuerung Endstufe (Einlaﬂ, Bank2)" UWORD B_TRUE 1 100 0 1 BIT_MASK 0x400 FORMAT "%13.11" ECU_ADDRESS 0x3FE472 /end MEASUREMENT
/begin MEASUREMENT B_siph "Bedingung keine alternierende Phasenpegel PG in den Bezugsmarken" UWORD B_TRUE 1 100 0 1 BIT_MASK 0x400 FORMAT "%13.11" ECU_ADDRESS 0x3FE530 /end MEASUREMENT
/begin MEASUREMENT B_siph2 "Bedingung keine alternierende Phasenpegel PG2 in den Bezugsmarken" UWORD B_TRUE 1 100 0 1 BIT_MASK 0x400 FORMAT "%13.11" ECU_ADDRESS 0x3FE532 /end MEASUREMENT
/begin MEASUREMENT B_siph3 "Fehlerart: Phasenflanke von PG3 auﬂerhalb Toleranz" UWORD B_TRUE 1 100 0 1 BIT_MASK 0x400 FORMAT "%13.11" ECU_ADDRESS 0x3FE534 /end MEASUREMENT
/begin MEASUREMENT B_siph4 "Fehlerart: Phasenflanke von PG4 auﬂerhalb Toleranz" UWORD B_TRUE 1 100 0 1 BIT_MASK 0x400 FORMAT "%13.11" ECU_ADDRESS 0x3FE536 /end MEASUREMENT
/begin MEASUREMENT B_siphm "Fehlerart: Kein Phasengeber im System verf¸gbar" UWORD B_TRUE 1 100 0 1 BIT_MASK 0x400 FORMAT "%13.11" ECU_ADDRESS 0x3FE538 /end MEASUREMENT
/begin MEASUREMENT B_sipllsu "Bedingung Signalfehler LSU: LSU zeigt zu fett" UWORD B_TRUE 1 100 0 1 BIT_MASK 0x400 FORMAT "%13.11" ECU_ADDRESS 0x3FE53A /end MEASUREMENT
/begin MEASUREMENT B_sipllsu2 "Bedingung Signalfehler LSU: LSU zeigt zu fett, Bank 2" UWORD B_TRUE 1 100 0 1 BIT_MASK 0x400 FORMAT "%13.11" ECU_ADDRESS 0x3FE53C /end MEASUREMENT
/begin MEASUREMENT B_sipoels "SigError f¸r die Plausibilisierung des ÷ldruckschalters" UWORD B_TRUE 1 100 0 1 BIT_MASK 0x400 FORMAT "%13.11" ECU_ADDRESS 0x3FE542 /end MEASUREMENT
/begin MEASUREMENT B_sislpe "Fehlertype: Leitungsabfall Endstufe Sekund‰rluftpumpe" UWORD B_TRUE 1 100 0 1 BIT_MASK 0x400 FORMAT "%13.11" ECU_ADDRESS 0x3FE54C /end MEASUREMENT
/begin MEASUREMENT B_sisls "Fehlertype: Sekund‰rluftsystem" UWORD B_TRUE 1 100 0 1 BIT_MASK 0x400 FORMAT "%13.11" ECU_ADDRESS 0x3FE54E /end MEASUREMENT
/begin MEASUREMENT B_sisls2 "Fehlertyp:Sekund‰rluftsystem Bank 2" UWORD B_TRUE 1 100 0 1 BIT_MASK 0x400 FORMAT "%13.11" ECU_ADDRESS 0x3FE550 /end MEASUREMENT
/begin MEASUREMENT B_sislv "Fehlertyp: Sekund‰rluftventil" UWORD B_TRUE 1 100 0 1 BIT_MASK 0x400 FORMAT "%13.11" ECU_ADDRESS 0x3FE552 /end MEASUREMENT
/begin MEASUREMENT B_sislv2 "Fehlertyp: Sekund‰rluftventil Bank 2" UWORD B_TRUE 1 100 0 1 BIT_MASK 0x400 FORMAT "%13.11" ECU_ADDRESS 0x3FE554 /end MEASUREMENT
/begin MEASUREMENT B_sista "Bedingung Signalfehler Startautomatik" UWORD B_TRUE 1 100 0 1 BIT_MASK 0x400 FORMAT "%13.11" ECU_ADDRESS 0x3FE558 /end MEASUREMENT
/begin MEASUREMENT B_sists "Fehlerart: Signalfehler Startautomatik Signaleingang" UWORD B_TRUE 1 100 0 1 BIT_MASK 0x400 FORMAT "%13.11" ECU_ADDRESS 0x3FE55A /end MEASUREMENT
/begin MEASUREMENT B_sisue "Fehlerart: Leitungsabfall  an Endstufe f¸r Saugrohrumschaltung" UWORD B_TRUE 1 100 0 1 BIT_MASK 0x400 FORMAT "%13.11" ECU_ADDRESS 0x3FE55C /end MEASUREMENT
/begin MEASUREMENT B_siteve "Fehlertyp: Leitungsabfall Tankentl¸ftungsventil Endstufe" UWORD B_TRUE 1 100 0 1 BIT_MASK 0x400 FORMAT "%13.11" ECU_ADDRESS 0x3FE566 /end MEASUREMENT
/begin MEASUREMENT B_siths "Signal inaktiv" UWORD B_TRUE 1 100 0 1 BIT_MASK 0x400 FORMAT "%13.11" ECU_ADDRESS 0x3FE568 /end MEASUREMENT
/begin MEASUREMENT B_siufmv "Fehlertyp sig.: Funktions¸berwachung: Momentenvergleich" UWORD B_TRUE 1 100 0 1 BIT_MASK 0x400 FORMAT "%13.11" ECU_ADDRESS 0x3FE572 /end MEASUREMENT
/begin MEASUREMENT B_siufnc "Fehlertyp signal:Fkt¸berwachung:Drehzahlgeber-,Zuleitung oder SG-Fehler" UWORD B_TRUE 1 100 0 1 BIT_MASK 0x400 FORMAT "%13.11" ECU_ADDRESS 0x3FE574 /end MEASUREMENT
/begin MEASUREMENT B_siufrlip "Fehlertyp sig.: Fkt¸berw: Lastsensor-, Zuleitung- oder SG-Fehler (ei_vvt_um)" UWORD B_TRUE 1 100 0 1 BIT_MASK 0x400 FORMAT "%13.11" ECU_ADDRESS 0x3FE576 /end MEASUREMENT
/begin MEASUREMENT B_siufsga "Fehlertyp sig.: Funktions¸berwachung: Steuerger‰te-Fehler Gruppe a (ei_adcc_um)" UWORD B_TRUE 1 100 0 1 BIT_MASK 0x400 FORMAT "%13.11" ECU_ADDRESS 0x3FE578 /end MEASUREMENT
/begin MEASUREMENT B_siufsgb "Fehlertyp sig.: Funktions¸berwachung: Steuerger‰te-Fehler Gruppe b (ei_varc_um)" UWORD B_TRUE 1 100 0 1 BIT_MASK 0x400 FORMAT "%13.11" ECU_ADDRESS 0x3FE57A /end MEASUREMENT
/begin MEASUREMENT B_siufsgc "Fehlertyp signal:Fkt¸berwachung:SG-Fehler Gruppe c" UWORD B_TRUE 1 100 0 1 BIT_MASK 0x400 FORMAT "%13.11" ECU_ADDRESS 0x3FE57C /end MEASUREMENT
/begin MEASUREMENT B_siufspsc "Fehlertyp signal:Fkt¸berwachung:Pedalwertgeber-,Zuleitung oder SG-Fehler" UWORD B_TRUE 1 100 0 1 BIT_MASK 0x400 FORMAT "%13.11" ECU_ADDRESS 0x3FE57E /end MEASUREMENT
/begin MEASUREMENT B_siulsu "Fehlerart: Sig-Fehler, Spannungsdiagnose LSU" UWORD B_TRUE 1 100 0 1 BIT_MASK 0x400 FORMAT "%13.11" ECU_ADDRESS 0x3FE580 /end MEASUREMENT
/begin MEASUREMENT B_siulsu2 "Fehlerart: Sig-Fehler, Spannungsdiagnose LSU, Bank 2" UWORD B_TRUE 1 100 0 1 BIT_MASK 0x400 FORMAT "%13.11" ECU_ADDRESS 0x3FE582 /end MEASUREMENT
/begin MEASUREMENT B_siurram "Fehlertyp sig.: Rechner¸berwachung: RAM" UWORD B_TRUE 1 100 0 1 BIT_MASK 0x400 FORMAT "%13.11" ECU_ADDRESS 0x3FE584 /end MEASUREMENT
/begin MEASUREMENT B_siurrom "Fehlertyp sig.: Rechner¸berwachung: ROM" UWORD B_TRUE 1 100 0 1 BIT_MASK 0x400 FORMAT "%13.11" ECU_ADDRESS 0x3FE586 /end MEASUREMENT
/begin MEASUREMENT B_siurrst "Fehlertyp sig.: Rechner¸berwachung: Reset" UWORD B_TRUE 1 100 0 1 BIT_MASK 0x400 FORMAT "%13.11" ECU_ADDRESS 0x3FE588 /end MEASUREMENT
/begin MEASUREMENT B_sivat "Fehlertyp VAT: Signal inaktiv" UWORD B_TRUE 1 100 0 1 BIT_MASK 0x400 FORMAT "%13.11" ECU_ADDRESS 0x3FE58A /end MEASUREMENT
/begin MEASUREMENT B_sivfz "Bedingung fehlendes Signal Fahrzeuggeschwindigkeit" UWORD B_TRUE 1 100 0 1 BIT_MASK 0x400 FORMAT "%13.11" ECU_ADDRESS 0x3FE58C /end MEASUREMENT
/begin MEASUREMENT E_anwse "Errorflag: Nockenwellensteuerungsventil Endstufe (Bank1,Auslaﬂ)" UWORD B_TRUE 1 100 0 1 BIT_MASK 0x1 FORMAT "%13.11" ECU_ADDRESS 0x3FE3B8 /end MEASUREMENT
/begin MEASUREMENT E_anwse2 "Errorflag: Nockenwellensteuerungsventil Endstufe (Bank2,Auslaﬂ)" UWORD B_TRUE 1 100 0 1 BIT_MASK 0x1 FORMAT "%13.11" ECU_ADDRESS 0x3FE3BA /end MEASUREMENT
/begin MEASUREMENT E_dvan "Errorflag: Fehler VVT-Anschlaglernen" UWORD B_TRUE 1 100 0 1 BIT_MASK 0x1 FORMAT "%13.11" ECU_ADDRESS 0x3FE40C /end MEASUREMENT
/begin MEASUREMENT E_dvcan "Errorflag: Fehler CAN-Kommunikation" UWORD B_TRUE 1 100 0 1 BIT_MASK 0x1 FORMAT "%13.11" ECU_ADDRESS 0x3FE40E /end MEASUREMENT
/begin MEASUREMENT E_dvcan2 "Errorflag: Fehler CAN-Kommunikation Bank 2" UWORD B_TRUE 1 100 0 1 BIT_MASK 0x1 FORMAT "%13.11" ECU_ADDRESS 0x3FE410 /end MEASUREMENT
/begin MEASUREMENT E_dvest "Errorflag: Fehler Endstufe" UWORD B_TRUE 1 100 0 1 BIT_MASK 0x1 FORMAT "%13.11" ECU_ADDRESS 0x3FE41E /end MEASUREMENT
/begin MEASUREMENT E_dvest2 "Errorflag: Fehler Endstufe Bank 2" UWORD B_TRUE 1 100 0 1 BIT_MASK 0x1 FORMAT "%13.11" ECU_ADDRESS 0x3FE420 /end MEASUREMENT
/begin MEASUREMENT E_dvffs "Errorflag: Fehler Fuehrungssensor" UWORD B_TRUE 1 100 0 1 BIT_MASK 0x1 FORMAT "%13.11" ECU_ADDRESS 0x3FE42C /end MEASUREMENT
/begin MEASUREMENT E_dvffs2 "Errorflag: Fehler Fuehrungssensor Bank 2" UWORD B_TRUE 1 100 0 1 BIT_MASK 0x1 FORMAT "%13.11" ECU_ADDRESS 0x3FE42E /end MEASUREMENT
/begin MEASUREMENT E_dvfrs "Errorflag: Fehler Referenzsensor" UWORD B_TRUE 1 100 0 1 BIT_MASK 0x1 FORMAT "%13.11" ECU_ADDRESS 0x3FE430 /end MEASUREMENT
/begin MEASUREMENT E_dvfrs2 "Errorflag: Fehler Referenzsensor Bank 2" UWORD B_TRUE 1 100 0 1 BIT_MASK 0x1 FORMAT "%13.11" ECU_ADDRESS 0x3FE432 /end MEASUREMENT
/begin MEASUREMENT E_dvfsg "Errorflag: Fehler Steuergeraet intern" UWORD B_TRUE 1 100 0 1 BIT_MASK 0x1 FORMAT "%13.11" ECU_ADDRESS 0x3FE434 /end MEASUREMENT
/begin MEASUREMENT E_dvfsg2 "Errorflag: Fehler Steuergeraet intern Bank 2" UWORD B_TRUE 1 100 0 1 BIT_MASK 0x1 FORMAT "%13.11" ECU_ADDRESS 0x3FE436 /end MEASUREMENT
/begin MEASUREMENT E_dvlrn "Errorflag: Fehler Anschlaglernen" UWORD B_TRUE 1 100 0 1 BIT_MASK 0x1 FORMAT "%13.11" ECU_ADDRESS 0x3FE438 /end MEASUREMENT
/begin MEASUREMENT E_dvlrn2 "Errorflag: Fehler Anschlaglernen Bank 2" UWORD B_TRUE 1 100 0 1 BIT_MASK 0x1 FORMAT "%13.11" ECU_ADDRESS 0x3FE43A /end MEASUREMENT
/begin MEASUREMENT E_dvovl "Errorflag: VVT-‹berlastschutz" UWORD B_TRUE 1 100 0 1 BIT_MASK 0x1 FORMAT "%13.11" ECU_ADDRESS 0x3FE43C /end MEASUREMENT
/begin MEASUREMENT E_dvovl2 "" UWORD B_TRUE 1 100 0 1 BIT_MASK 0x1 FORMAT "%13.11" ECU_ADDRESS 0x3FE43E /end MEASUREMENT
/begin MEASUREMENT E_dvpla "Errorflag: Fehler Sensorplausibilisierung" UWORD B_TRUE 1 100 0 1 BIT_MASK 0x1 FORMAT "%13.11" ECU_ADDRESS 0x3FE440 /end MEASUREMENT
/begin MEASUREMENT E_dvpla2 "Errorflag: Fehler Sensorplausibilisierung Bank 2" UWORD B_TRUE 1 100 0 1 BIT_MASK 0x1 FORMAT "%13.11" ECU_ADDRESS 0x3FE442 /end MEASUREMENT
/begin MEASUREMENT E_dvpmn "Errorflag: Leistungsbegrenzung VVT" UWORD B_TRUE 1 100 0 1 BIT_MASK 0x1 FORMAT "%13.11" ECU_ADDRESS 0x3FE444 /end MEASUREMENT
/begin MEASUREMENT E_dvste "Errorflag: Fehler Stellgliedueberwachung" UWORD B_TRUE 1 100 0 1 BIT_MASK 0x1 FORMAT "%13.11" ECU_ADDRESS 0x3FE446 /end MEASUREMENT
/begin MEASUREMENT E_dvste2 "Errorflag: Fehler Stellgliedueberwachung Bank 2" UWORD B_TRUE 1 100 0 1 BIT_MASK 0x1 FORMAT "%13.11" ECU_ADDRESS 0x3FE448 /end MEASUREMENT
/begin MEASUREMENT E_dvulv "Errorflag: Fehler Leistungsversorgung VVT" UWORD B_TRUE 1 100 0 1 BIT_MASK 0x1 FORMAT "%13.11" ECU_ADDRESS 0x3FE44A /end MEASUREMENT
/begin MEASUREMENT E_dvulv2 "Errorflag: Fehler Leistungsversorgung VVT Bank 2" UWORD B_TRUE 1 100 0 1 BIT_MASK 0x1 FORMAT "%13.11" ECU_ADDRESS 0x3FE44C /end MEASUREMENT
/begin MEASUREMENT E_dvuse "Errorflag: Fehler Sensor-Versorgungsspannung" UWORD B_TRUE 1 100 0 1 BIT_MASK 0x1 FORMAT "%13.11" ECU_ADDRESS 0x3FE44E /end MEASUREMENT
/begin MEASUREMENT E_dvuse2 "Errorflag: Fehler Sensor-Versorgungsspannung Bank 2" UWORD B_TRUE 1 100 0 1 BIT_MASK 0x1 FORMAT "%13.11" ECU_ADDRESS 0x3FE450 /end MEASUREMENT
/begin MEASUREMENT E_enws "Errorflag: Nockenwellensteuerung (Einlaﬂ,Bank1)" UWORD B_TRUE 1 100 0 1 BIT_MASK 0x1 FORMAT "%13.11" ECU_ADDRESS 0x3FE46C /end MEASUREMENT
/begin MEASUREMENT E_enws2 "Errorflag: Nockenwellensteuerung (Einlaﬂ,Bank2)" UWORD B_TRUE 1 100 0 1 BIT_MASK 0x1 FORMAT "%13.11" ECU_ADDRESS 0x3FE46E /end MEASUREMENT
/begin MEASUREMENT E_enwse "Errorflag: Endstufe Nockenwellensteuerung (Einlaﬂ, Bank1)" UWORD B_TRUE 1 100 0 1 BIT_MASK 0x1 FORMAT "%13.11" ECU_ADDRESS 0x3FE470 /end MEASUREMENT
/begin MEASUREMENT E_enwse2 "Errorflag: Nockenwellensteuerungsventil Endstufe (Bank2,Einlaﬂ)" UWORD B_TRUE 1 100 0 1 BIT_MASK 0x1 FORMAT "%13.11" ECU_ADDRESS 0x3FE472 /end MEASUREMENT
/begin MEASUREMENT E_ph "Errorflag: Phasensensor" UWORD B_TRUE 1 100 0 1 BIT_MASK 0x1 FORMAT "%13.11" ECU_ADDRESS 0x3FE530 /end MEASUREMENT
/begin MEASUREMENT E_ph2 "Errorflag: Phasensensor 2" UWORD B_TRUE 1 100 0 1 BIT_MASK 0x1 FORMAT "%13.11" ECU_ADDRESS 0x3FE532 /end MEASUREMENT
/begin MEASUREMENT E_ph3 "Errorflag: Phasensensor 3" UWORD B_TRUE 1 100 0 1 BIT_MASK 0x1 FORMAT "%13.11" ECU_ADDRESS 0x3FE534 /end MEASUREMENT
/begin MEASUREMENT E_ph4 "Errorflag: Phasensensor 4" UWORD B_TRUE 1 100 0 1 BIT_MASK 0x1 FORMAT "%13.11" ECU_ADDRESS 0x3FE536 /end MEASUREMENT
/begin MEASUREMENT E_phm "Master-Errorflag f¸r Phasensensoren" UWORD B_TRUE 1 100 0 1 BIT_MASK 0x1 FORMAT "%13.11" ECU_ADDRESS 0x3FE538 /end MEASUREMENT
/begin MEASUREMENT E_pllsu "Errorflag: Plausibilit‰t der LSU" UWORD B_TRUE 1 100 0 1 BIT_MASK 0x1 FORMAT "%13.11" ECU_ADDRESS 0x3FE53A /end MEASUREMENT
/begin MEASUREMENT E_pllsu2 "Errorflag: Plausibilit‰t der LSU, Bank 2" UWORD B_TRUE 1 100 0 1 BIT_MASK 0x1 FORMAT "%13.11" ECU_ADDRESS 0x3FE53C /end MEASUREMENT
/begin MEASUREMENT E_poels "Errorflag: Plausibilit‰t ÷ldruckschalter" UWORD B_TRUE 1 100 0 1 BIT_MASK 0x1 FORMAT "%13.11" ECU_ADDRESS 0x3FE542 /end MEASUREMENT
/begin MEASUREMENT E_slpe "Errorflag: Sekund‰rluftpumpe (Endstufe)" UWORD B_TRUE 1 100 0 1 BIT_MASK 0x1 FORMAT "%13.11" ECU_ADDRESS 0x3FE54C /end MEASUREMENT
/begin MEASUREMENT E_sls "Errorflag: Sekund‰rluft-System" UWORD B_TRUE 1 100 0 1 BIT_MASK 0x1 FORMAT "%13.11" ECU_ADDRESS 0x3FE54E /end MEASUREMENT
/begin MEASUREMENT E_sls2 "Errorflag: Sekund‰rluft-System Bank 2" UWORD B_TRUE 1 100 0 1 BIT_MASK 0x1 FORMAT "%13.11" ECU_ADDRESS 0x3FE550 /end MEASUREMENT
/begin MEASUREMENT E_slv "Errorflag: Sekund‰rluftventil" UWORD B_TRUE 1 100 0 1 BIT_MASK 0x1 FORMAT "%13.11" ECU_ADDRESS 0x3FE552 /end MEASUREMENT
/begin MEASUREMENT E_slv2 "Errorflag: Sekund‰rluftventil Bank 2" UWORD B_TRUE 1 100 0 1 BIT_MASK 0x1 FORMAT "%13.11" ECU_ADDRESS 0x3FE554 /end MEASUREMENT
/begin MEASUREMENT E_sta "Errorflag: Automatischer Start" UWORD B_TRUE 1 100 0 1 BIT_MASK 0x1 FORMAT "%13.11" ECU_ADDRESS 0x3FE558 /end MEASUREMENT
/begin MEASUREMENT E_sts "Errorflag: Startsignal" UWORD B_TRUE 1 100 0 1 BIT_MASK 0x1 FORMAT "%13.11" ECU_ADDRESS 0x3FE55A /end MEASUREMENT
/begin MEASUREMENT E_sue "Errorflag: Endstufe Saugrohrumschaltung" UWORD B_TRUE 1 100 0 1 BIT_MASK 0x1 FORMAT "%13.11" ECU_ADDRESS 0x3FE55C /end MEASUREMENT
/begin MEASUREMENT E_tes "Errorflag: Tankentl¸ftungssystem" UWORD B_TRUE 1 100 0 1 BIT_MASK 0x1 FORMAT "%13.11" ECU_ADDRESS 0x3FE562 /end MEASUREMENT
/begin MEASUREMENT E_teve "Errorflag: Tankentl¸ftungsventil Endstufe" UWORD B_TRUE 1 100 0 1 BIT_MASK 0x1 FORMAT "%13.11" ECU_ADDRESS 0x3FE566 /end MEASUREMENT
/begin MEASUREMENT E_ths "Fehlerflag DTHS" UWORD B_TRUE 1 100 0 1 BIT_MASK 0x1 FORMAT "%13.11" ECU_ADDRESS 0x3FE568 /end MEASUREMENT
/begin MEASUREMENT E_ufmv "Errorflag: Funktions¸berwachung: Momentenvergleich" UWORD B_TRUE 1 100 0 1 BIT_MASK 0x1 FORMAT "%13.11" ECU_ADDRESS 0x3FE572 /end MEASUREMENT
/begin MEASUREMENT E_ufnc "Errorflag: Fkt¸berwachung: Drehzahlgeber-, Zuleitung- oder Steuerger‰te-Fehler" UWORD B_TRUE 1 100 0 1 BIT_MASK 0x1 FORMAT "%13.11" ECU_ADDRESS 0x3FE574 /end MEASUREMENT
/begin MEASUREMENT E_ufrlip "Errorflag: Fkt¸berwachung: Lastsensor-, Zuleitung- oder Steuerger‰te-Fehler" UWORD B_TRUE 1 100 0 1 BIT_MASK 0x1 FORMAT "%13.11" ECU_ADDRESS 0x3FE576 /end MEASUREMENT
/begin MEASUREMENT E_ufsga "Errorflag: Funktions¸berwachung: Steuerger‰te-Fehler Gruppe a" UWORD B_TRUE 1 100 0 1 BIT_MASK 0x1 FORMAT "%13.11" ECU_ADDRESS 0x3FE578 /end MEASUREMENT
/begin MEASUREMENT E_ufsgb "Errorflag: Funktions¸berwachung: Steuerger‰te-Fehler Gruppe b" UWORD B_TRUE 1 100 0 1 BIT_MASK 0x1 FORMAT "%13.11" ECU_ADDRESS 0x3FE57A /end MEASUREMENT
/begin MEASUREMENT E_ufsgc "Errorflag: Funktions¸berwachung: Steuerger‰te-Fehler Gruppe c" UWORD B_TRUE 1 100 0 1 BIT_MASK 0x1 FORMAT "%13.11" ECU_ADDRESS 0x3FE57C /end MEASUREMENT
/begin MEASUREMENT E_ufspsc "Errorflag: Fkt¸berwachung: Pedalwertgeber-, Zuleitung- oder Steuerger‰te-Fehler" UWORD B_TRUE 1 100 0 1 BIT_MASK 0x1 FORMAT "%13.11" ECU_ADDRESS 0x3FE57E /end MEASUREMENT
/begin MEASUREMENT E_ulsu "Errorflag: Spannungs¸berwachung LSU" UWORD B_TRUE 1 100 0 1 BIT_MASK 0x1 FORMAT "%13.11" ECU_ADDRESS 0x3FE580 /end MEASUREMENT
/begin MEASUREMENT E_ulsu2 "Errorflag: Spannungsdiagnose LSU, Bank 2" UWORD B_TRUE 1 100 0 1 BIT_MASK 0x1 FORMAT "%13.11" ECU_ADDRESS 0x3FE582 /end MEASUREMENT
/begin MEASUREMENT E_urram "Errorflag: Rechner¸berwachung: RAM" UWORD B_TRUE 1 100 0 1 BIT_MASK 0x1 FORMAT "%13.11" ECU_ADDRESS 0x3FE584 /end MEASUREMENT
/begin MEASUREMENT E_urrom "Errorflag: Rechner¸berwachung: ROM" UWORD B_TRUE 1 100 0 1 BIT_MASK 0x1 FORMAT "%13.11" ECU_ADDRESS 0x3FE586 /end MEASUREMENT
/begin MEASUREMENT E_urrst "Errorflag: Rechner¸berwachung: Reset" UWORD B_TRUE 1 100 0 1 BIT_MASK 0x1 FORMAT "%13.11" ECU_ADDRESS 0x3FE588 /end MEASUREMENT
/begin MEASUREMENT E_vat "Fehlerflag: angezeigte Fahrzeuggeschwindigkeit im Tacho" UWORD B_TRUE 1 100 0 1 BIT_MASK 0x1 FORMAT "%13.11" ECU_ADDRESS 0x3FE58A /end MEASUREMENT
/begin MEASUREMENT E_vfz "Errorflag: Fahrzeug-Geschwindigkeit" UWORD B_TRUE 1 100 0 1 BIT_MASK 0x1 FORMAT "%13.11" ECU_ADDRESS 0x3FE58C /end MEASUREMENT
/begin MEASUREMENT sfpanwse "Status Fehlerpfad: Nockenwellensteuerung Endstufe (Auslaﬂ, Bank1)" UWORD dez 1 100 0 65535 FORMAT "%8.2" ECU_ADDRESS 0x3FE3B8 /end MEASUREMENT
/begin MEASUREMENT sfpanwse2 "Status Fehlerpfad: Nockenwellensteuerung Endstufe (Auslaﬂ, Bank2)" UWORD dez 1 100 0 65535 FORMAT "%8.2" ECU_ADDRESS 0x3FE3BA /end MEASUREMENT
/begin MEASUREMENT sfpdvan "" UWORD dez 1 100 0 65535 FORMAT "%8.2" ECU_ADDRESS 0x3FE40C /end MEASUREMENT
/begin MEASUREMENT sfpdvcan "" UWORD dez 1 100 0 65535 FORMAT "%8.2" ECU_ADDRESS 0x3FE40E /end MEASUREMENT
/begin MEASUREMENT sfpdvcan2 "" UWORD dez 1 100 0 65535 FORMAT "%8.2" ECU_ADDRESS 0x3FE410 /end MEASUREMENT
/begin MEASUREMENT sfpdvest "Status Fehlerpfad: VVT-Endstufe" UWORD dez 1 100 0 65535 FORMAT "%8.2" ECU_ADDRESS 0x3FE41E /end MEASUREMENT
/begin MEASUREMENT sfpdvest2 "" UWORD dez 1 100 0 65535 FORMAT "%8.2" ECU_ADDRESS 0x3FE420 /end MEASUREMENT
/begin MEASUREMENT sfpdvffs "Status Fehlerpfad: VVT-F¸hrungssensor" UWORD dez 1 100 0 65535 FORMAT "%8.2" ECU_ADDRESS 0x3FE42C /end MEASUREMENT
/begin MEASUREMENT sfpdvffs2 "" UWORD dez 1 100 0 65535 FORMAT "%8.2" ECU_ADDRESS 0x3FE42E /end MEASUREMENT
/begin MEASUREMENT sfpdvfrs "Status Fehlerpfad: VVT-Referenzsensor" UWORD dez 1 100 0 65535 FORMAT "%8.2" ECU_ADDRESS 0x3FE430 /end MEASUREMENT
/begin MEASUREMENT sfpdvfrs2 "" UWORD dez 1 100 0 65535 FORMAT "%8.2" ECU_ADDRESS 0x3FE432 /end MEASUREMENT
/begin MEASUREMENT sfpdvfsg "" UWORD dez 1 100 0 65535 FORMAT "%8.2" ECU_ADDRESS 0x3FE434 /end MEASUREMENT
/begin MEASUREMENT sfpdvfsg2 "" UWORD dez 1 100 0 65535 FORMAT "%8.2" ECU_ADDRESS 0x3FE436 /end MEASUREMENT
/begin MEASUREMENT sfpdvlrn "Status Fehlerpfad: VVT-Anschlaglernen" UWORD dez 1 100 0 65535 FORMAT "%8.2" ECU_ADDRESS 0x3FE438 /end MEASUREMENT
/begin MEASUREMENT sfpdvlrn2 "" UWORD dez 1 100 0 65535 FORMAT "%8.2" ECU_ADDRESS 0x3FE43A /end MEASUREMENT
/begin MEASUREMENT sfpdvovl "Status Fehlerpfad: VVT-‹berlastschutz" UWORD dez 1 100 0 65535 FORMAT "%8.2" ECU_ADDRESS 0x3FE43C /end MEASUREMENT
/begin MEASUREMENT sfpdvovl2 "" UWORD dez 1 100 0 65535 FORMAT "%8.2" ECU_ADDRESS 0x3FE43E /end MEASUREMENT
/begin MEASUREMENT sfpdvpla "Status Fehlerpfad: VVT-Sensorplausibilisierung" UWORD dez 1 100 0 65535 FORMAT "%8.2" ECU_ADDRESS 0x3FE440 /end MEASUREMENT
/begin MEASUREMENT sfpdvpla2 "" UWORD dez 1 100 0 65535 FORMAT "%8.2" ECU_ADDRESS 0x3FE442 /end MEASUREMENT
/begin MEASUREMENT sfpdvpmn "Status Fehlerpfad, Leistungsbegrenzung VVT" UWORD dez 1 100 0 65535 FORMAT "%8.2" ECU_ADDRESS 0x3FE444 /end MEASUREMENT
/begin MEASUREMENT sfpdvste "Status Fehlerpfad: VVT-Stellglied¸berwachung" UWORD dez 1 100 0 65535 FORMAT "%8.2" ECU_ADDRESS 0x3FE446 /end MEASUREMENT
/begin MEASUREMENT sfpdvste2 "" UWORD dez 1 100 0 65535 FORMAT "%8.2" ECU_ADDRESS 0x3FE448 /end MEASUREMENT
/begin MEASUREMENT sfpdvulv "Status Fehlerpfad: VVT-Entlastungsrelais" UWORD dez 1 100 0 65535 FORMAT "%8.2" ECU_ADDRESS 0x3FE44A /end MEASUREMENT
/begin MEASUREMENT sfpdvulv2 "" UWORD dez 1 100 0 65535 FORMAT "%8.2" ECU_ADDRESS 0x3FE44C /end MEASUREMENT
/begin MEASUREMENT sfpdvuse "Status Fehlerpfad: VVT-Sensorversorgungspannung" UWORD dez 1 100 0 65535 FORMAT "%8.2" ECU_ADDRESS 0x3FE44E /end MEASUREMENT
/begin MEASUREMENT sfpdvuse2 "" UWORD dez 1 100 0 65535 FORMAT "%8.2" ECU_ADDRESS 0x3FE450 /end MEASUREMENT
/begin MEASUREMENT sfpenws "Status Fehlerpfad: Nockenwellensteuerung (Einlaﬂ, Bank1)" UWORD dez 1 100 0 65535 FORMAT "%8.2" ECU_ADDRESS 0x3FE46C /end MEASUREMENT
/begin MEASUREMENT sfpenws2 "Status Fehlerpfad: Nockenwellensteuerung (Einlaﬂ, Bank2)" UWORD dez 1 100 0 65535 FORMAT "%8.2" ECU_ADDRESS 0x3FE46E /end MEASUREMENT
/begin MEASUREMENT sfpenwse "Status Fehlerpfad: Nockenwellensteuerung Endstufe (Einlaﬂ, Bank1)" UWORD dez 1 100 0 65535 FORMAT "%8.2" ECU_ADDRESS 0x3FE470 /end MEASUREMENT
/begin MEASUREMENT sfpenwse2 "Status Fehlerpfad: Nockenwellensteuerung Endstufe (Einlaﬂ, Bank2)" UWORD dez 1 100 0 65535 FORMAT "%8.2" ECU_ADDRESS 0x3FE472 /end MEASUREMENT
/begin MEASUREMENT sfpph "Status Fehlerpfad: Phasengeber" UWORD dez 1 100 0 65535 FORMAT "%8.2" ECU_ADDRESS 0x3FE530 /end MEASUREMENT
/begin MEASUREMENT sfpph2 "Status Fehlerpfad: Phasengeber Bank 2" UWORD dez 1 100 0 65535 FORMAT "%8.2" ECU_ADDRESS 0x3FE532 /end MEASUREMENT
/begin MEASUREMENT sfpph3 "Status Fehlerpfad: Phasengeber 3" UWORD dez 1 100 0 65535 FORMAT "%8.2" ECU_ADDRESS 0x3FE534 /end MEASUREMENT
/begin MEASUREMENT sfpph4 "Status Fehlerpfad: Phasengeber 4" UWORD dez 1 100 0 65535 FORMAT "%8.2" ECU_ADDRESS 0x3FE536 /end MEASUREMENT
/begin MEASUREMENT sfpphm "Status Fehlerpfad: Phasengeber MIL" UWORD dez 1 100 0 65535 FORMAT "%8.2" ECU_ADDRESS 0x3FE538 /end MEASUREMENT
/begin MEASUREMENT sfppllsu "Status Fehlerpfad E_pllsu" UWORD default 1 100 0 65535 FORMAT "%8.2" ECU_ADDRESS 0x3FE53A /end MEASUREMENT
/begin MEASUREMENT sfppllsu2 "Status Fehlerpfad E_pllsu2" UWORD default 1 100 0 65535 FORMAT "%8.2" ECU_ADDRESS 0x3FE53C /end MEASUREMENT
/begin MEASUREMENT sfppoels "lokale Kopie des Fehlerpfadstatus" UWORD default 1 100 0 65535 FORMAT "%8.2" ECU_ADDRESS 0x3FE542 /end MEASUREMENT
/begin MEASUREMENT sfpslpe "Status Fehlerpfad: Sekund‰rluftpumpe Endstufe" UWORD dez 1 100 0 65535 FORMAT "%8.2" ECU_ADDRESS 0x3FE54C /end MEASUREMENT
/begin MEASUREMENT sfpsls "Status Fehlerpfad: Diagnose Sekund‰rluftsystem" UWORD dez 1 100 0 65535 FORMAT "%8.2" ECU_ADDRESS 0x3FE54E /end MEASUREMENT
/begin MEASUREMENT sfpsls2 "Status Fehlerpfad: Diagnose Sekund‰rluftsystem, Bank 2" UWORD dez 1 100 0 65535 FORMAT "%8.2" ECU_ADDRESS 0x3FE550 /end MEASUREMENT
/begin MEASUREMENT sfpslv "Status Fehlerpfad: Diagnose Sekund‰rluftventil" UWORD dez 1 100 0 65535 FORMAT "%8.2" ECU_ADDRESS 0x3FE552 /end MEASUREMENT
/begin MEASUREMENT sfpslv2 "Status Fehlerpfad: Diagnose Sekund‰rluftventil, Bank 2" UWORD dez 1 100 0 65535 FORMAT "%8.2" ECU_ADDRESS 0x3FE554 /end MEASUREMENT
/begin MEASUREMENT sfpsta "Status Fehlerpfad :  Startautomatik-Ansteuerung" UWORD dez 1 100 0 65535 FORMAT "%8.2" ECU_ADDRESS 0x3FE558 /end MEASUREMENT
/begin MEASUREMENT sfpsts "Status Fehlerpfad: Startsignal" UWORD dez 1 100 0 65535 FORMAT "%8.2" ECU_ADDRESS 0x3FE55A /end MEASUREMENT
/begin MEASUREMENT sfpsue "Status Fehlerpfad: Endstufe Saugrohrumschaltung" UWORD dez 1 100 0 65535 FORMAT "%8.2" ECU_ADDRESS 0x3FE55C /end MEASUREMENT
/begin MEASUREMENT sfptes "Status Fehlerpfad: Tankdiagnose, TEV defekt offen" UWORD dez 1 100 0 65535 FORMAT "%8.2" ECU_ADDRESS 0x3FE562 /end MEASUREMENT
/begin MEASUREMENT sfpteve "Status Fehlerpfad: Tankl¸ftungsventil Endstufe" UWORD dez 1 100 0 65535 FORMAT "%8.2" ECU_ADDRESS 0x3FE566 /end MEASUREMENT
/begin MEASUREMENT sfpths "Status Fehlerpfad DTHS" UWORD dez 1 100 0 65535 FORMAT "%8.2" ECU_ADDRESS 0x3FE568 /end MEASUREMENT
/begin MEASUREMENT sfpufmv "Statuswort: Funktions¸berwachung: Momentenvergleich" UWORD dez 1 100 0 65535 FORMAT "%8.2" ECU_ADDRESS 0x3FE572 /end MEASUREMENT
/begin MEASUREMENT sfpufnc "Statuswort: Funktions¸berwachung:Drehzahlgeber-,Zuleitung- oder SG-Fehler" UWORD dez 1 100 0 65535 FORMAT "%8.2" ECU_ADDRESS 0x3FE574 /end MEASUREMENT
/begin MEASUREMENT sfpufrlip "Statuswort: Funktions¸berwachung:Lastsensor-,Zuleitung oder SG-Fehler" UWORD dez 1 100 0 65535 FORMAT "%8.2" ECU_ADDRESS 0x3FE576 /end MEASUREMENT
/begin MEASUREMENT sfpufsga "Statuswort: Funktions¸berwachung:SG-Fehler Gruppe a" UWORD dez 1 100 0 65535 FORMAT "%8.2" ECU_ADDRESS 0x3FE578 /end MEASUREMENT
/begin MEASUREMENT sfpufsgb "Statuswort: Funktions¸berwachung:SG-Fehler Gruppe b" UWORD dez 1 100 0 65535 FORMAT "%8.2" ECU_ADDRESS 0x3FE57A /end MEASUREMENT
/begin MEASUREMENT sfpufsgc "Statuswort: Funktions¸berwachung:SG-Fehler Gruppe c" UWORD dez 1 100 0 65535 FORMAT "%8.2" ECU_ADDRESS 0x3FE57C /end MEASUREMENT
/begin MEASUREMENT sfpufspsc "Statuswort: Funktions¸berwachung:Pedalwergeber-,Zuleitung-oder SG-Fehler" UWORD dez 1 100 0 65535 FORMAT "%8.2" ECU_ADDRESS 0x3FE57E /end MEASUREMENT
/begin MEASUREMENT sfpulsu "Status Fehlerpfad E_ulsu" UWORD default 1 100 0 65535 FORMAT "%8.2" ECU_ADDRESS 0x3FE580 /end MEASUREMENT
/begin MEASUREMENT sfpulsu2 "Status Fehlerpfad E_ulsu, Bank 2" UWORD default 1 100 0 65535 FORMAT "%8.2" ECU_ADDRESS 0x3FE582 /end MEASUREMENT
/begin MEASUREMENT sfpurram "Statuswort: Rechner¸berwachung: RAM" UWORD dez 1 100 0 65535 FORMAT "%8.2" ECU_ADDRESS 0x3FE584 /end MEASUREMENT
/begin MEASUREMENT sfpurrom "Statuswort: Rechner¸berwachung: ROM" UWORD dez 1 100 0 65535 FORMAT "%8.2" ECU_ADDRESS 0x3FE586 /end MEASUREMENT
/begin MEASUREMENT sfpurrst "Statuswort: Rechner¸berwachung: Reset" UWORD dez 1 100 0 65535 FORMAT "%8.2" ECU_ADDRESS 0x3FE588 /end MEASUREMENT
/begin MEASUREMENT sfpvat "Status Fehlerpfad VAT:  angezeigte Fahrzeuggeschwindigkeit im Tacho" UWORD dez 1 100 0 65535 FORMAT "%8.2" ECU_ADDRESS 0x3FE58A /end MEASUREMENT
/begin MEASUREMENT sfpvfz "Status Fehlerpfad: Fahrzeuggeschwindigkeit" UWORD dez 1 100 0 65535 FORMAT "%8.2" ECU_ADDRESS 0x3FE58C /end MEASUREMENT
/begin MEASUREMENT TYP_anwse "" UWORD B_TRUE 1 100 0 1 BIT_MASK 0xf00 FORMAT "%13.11" ECU_ADDRESS 0x3FE3B8 /end MEASUREMENT
/begin MEASUREMENT TYP_anwse2 "" UWORD B_TRUE 1 100 0 1 BIT_MASK 0xf00 FORMAT "%13.11" ECU_ADDRESS 0x3FE3BA /end MEASUREMENT
/begin MEASUREMENT TYP_dvan "" UWORD B_TRUE 1 100 0 1 BIT_MASK 0xf00 FORMAT "%13.11" ECU_ADDRESS 0x3FE40C /end MEASUREMENT
/begin MEASUREMENT TYP_dvcan "" UWORD B_TRUE 1 100 0 1 BIT_MASK 0xf00 FORMAT "%13.11" ECU_ADDRESS 0x3FE40E /end MEASUREMENT
/begin MEASUREMENT TYP_dvcan2 "" UWORD B_TRUE 1 100 0 1 BIT_MASK 0xf00 FORMAT "%13.11" ECU_ADDRESS 0x3FE410 /end MEASUREMENT
/begin MEASUREMENT TYP_dvest "" UWORD B_TRUE 1 100 0 1 BIT_MASK 0xf00 FORMAT "%13.11" ECU_ADDRESS 0x3FE41E /end MEASUREMENT
/begin MEASUREMENT TYP_dvest2 "" UWORD B_TRUE 1 100 0 1 BIT_MASK 0xf00 FORMAT "%13.11" ECU_ADDRESS 0x3FE420 /end MEASUREMENT
/begin MEASUREMENT TYP_dvffs "" UWORD B_TRUE 1 100 0 1 BIT_MASK 0xf00 FORMAT "%13.11" ECU_ADDRESS 0x3FE42C /end MEASUREMENT
/begin MEASUREMENT TYP_dvffs2 "" UWORD B_TRUE 1 100 0 1 BIT_MASK 0xf00 FORMAT "%13.11" ECU_ADDRESS 0x3FE42E /end MEASUREMENT
/begin MEASUREMENT TYP_dvfrs "" UWORD B_TRUE 1 100 0 1 BIT_MASK 0xf00 FORMAT "%13.11" ECU_ADDRESS 0x3FE430 /end MEASUREMENT
/begin MEASUREMENT TYP_dvfrs2 "" UWORD B_TRUE 1 100 0 1 BIT_MASK 0xf00 FORMAT "%13.11" ECU_ADDRESS 0x3FE432 /end MEASUREMENT
/begin MEASUREMENT TYP_dvfsg "" UWORD B_TRUE 1 100 0 1 BIT_MASK 0xf00 FORMAT "%13.11" ECU_ADDRESS 0x3FE434 /end MEASUREMENT
/begin MEASUREMENT TYP_dvfsg2 "" UWORD B_TRUE 1 100 0 1 BIT_MASK 0xf00 FORMAT "%13.11" ECU_ADDRESS 0x3FE436 /end MEASUREMENT
/begin MEASUREMENT TYP_dvlrn "" UWORD B_TRUE 1 100 0 1 BIT_MASK 0xf00 FORMAT "%13.11" ECU_ADDRESS 0x3FE438 /end MEASUREMENT
/begin MEASUREMENT TYP_dvlrn2 "" UWORD B_TRUE 1 100 0 1 BIT_MASK 0xf00 FORMAT "%13.11" ECU_ADDRESS 0x3FE43A /end MEASUREMENT
/begin MEASUREMENT TYP_dvovl "" UWORD B_TRUE 1 100 0 1 BIT_MASK 0xf00 FORMAT "%13.11" ECU_ADDRESS 0x3FE43C /end MEASUREMENT
/begin MEASUREMENT TYP_dvovl2 "" UWORD B_TRUE 1 100 0 1 BIT_MASK 0xf00 FORMAT "%13.11" ECU_ADDRESS 0x3FE43E /end MEASUREMENT
/begin MEASUREMENT TYP_dvpla "" UWORD B_TRUE 1 100 0 1 BIT_MASK 0xf00 FORMAT "%13.11" ECU_ADDRESS 0x3FE440 /end MEASUREMENT
/begin MEASUREMENT TYP_dvpla2 "" UWORD B_TRUE 1 100 0 1 BIT_MASK 0xf00 FORMAT "%13.11" ECU_ADDRESS 0x3FE442 /end MEASUREMENT
/begin MEASUREMENT TYP_dvpmn "" UWORD B_TRUE 1 100 0 1 BIT_MASK 0xf00 FORMAT "%13.11" ECU_ADDRESS 0x3FE444 /end MEASUREMENT
/begin MEASUREMENT TYP_dvste "" UWORD B_TRUE 1 100 0 1 BIT_MASK 0xf00 FORMAT "%13.11" ECU_ADDRESS 0x3FE446 /end MEASUREMENT
/begin MEASUREMENT TYP_dvste2 "" UWORD B_TRUE 1 100 0 1 BIT_MASK 0xf00 FORMAT "%13.11" ECU_ADDRESS 0x3FE448 /end MEASUREMENT
/begin MEASUREMENT TYP_dvulv "" UWORD B_TRUE 1 100 0 1 BIT_MASK 0xf00 FORMAT "%13.11" ECU_ADDRESS 0x3FE44A /end MEASUREMENT
/begin MEASUREMENT TYP_dvulv2 "" UWORD B_TRUE 1 100 0 1 BIT_MASK 0xf00 FORMAT "%13.11" ECU_ADDRESS 0x3FE44C /end MEASUREMENT
/begin MEASUREMENT TYP_dvuse "" UWORD B_TRUE 1 100 0 1 BIT_MASK 0xf00 FORMAT "%13.11" ECU_ADDRESS 0x3FE44E /end MEASUREMENT
/begin MEASUREMENT TYP_dvuse2 "" UWORD B_TRUE 1 100 0 1 BIT_MASK 0xf00 FORMAT "%13.11" ECU_ADDRESS 0x3FE450 /end MEASUREMENT
/begin MEASUREMENT TYP_enws "" UWORD B_TRUE 1 100 0 1 BIT_MASK 0xf00 FORMAT "%13.11" ECU_ADDRESS 0x3FE46C /end MEASUREMENT
/begin MEASUREMENT TYP_enws2 "" UWORD B_TRUE 1 100 0 1 BIT_MASK 0xf00 FORMAT "%13.11" ECU_ADDRESS 0x3FE46E /end MEASUREMENT
/begin MEASUREMENT TYP_enwse "" UWORD B_TRUE 1 100 0 1 BIT_MASK 0xf00 FORMAT "%13.11" ECU_ADDRESS 0x3FE470 /end MEASUREMENT
/begin MEASUREMENT TYP_enwse2 "" UWORD B_TRUE 1 100 0 1 BIT_MASK 0xf00 FORMAT "%13.11" ECU_ADDRESS 0x3FE472 /end MEASUREMENT
/begin MEASUREMENT TYP_ph "" UWORD B_TRUE 1 100 0 1 BIT_MASK 0xf00 FORMAT "%13.11" ECU_ADDRESS 0x3FE530 /end MEASUREMENT
/begin MEASUREMENT TYP_ph2 "" UWORD B_TRUE 1 100 0 1 BIT_MASK 0xf00 FORMAT "%13.11" ECU_ADDRESS 0x3FE532 /end MEASUREMENT
/begin MEASUREMENT TYP_ph3 "" UWORD B_TRUE 1 100 0 1 BIT_MASK 0xf00 FORMAT "%13.11" ECU_ADDRESS 0x3FE534 /end MEASUREMENT
/begin MEASUREMENT TYP_ph4 "" UWORD B_TRUE 1 100 0 1 BIT_MASK 0xf00 FORMAT "%13.11" ECU_ADDRESS 0x3FE536 /end MEASUREMENT
/begin MEASUREMENT TYP_phm "" UWORD B_TRUE 1 100 0 1 BIT_MASK 0xf00 FORMAT "%13.11" ECU_ADDRESS 0x3FE538 /end MEASUREMENT
/begin MEASUREMENT TYP_pllsu "" UWORD B_TRUE 1 100 0 1 BIT_MASK 0xf00 FORMAT "%13.11" ECU_ADDRESS 0x3FE53A /end MEASUREMENT
/begin MEASUREMENT TYP_pllsu2 "" UWORD B_TRUE 1 100 0 1 BIT_MASK 0xf00 FORMAT "%13.11" ECU_ADDRESS 0x3FE53C /end MEASUREMENT
/begin MEASUREMENT TYP_poels "" UWORD B_TRUE 1 100 0 1 BIT_MASK 0xf00 FORMAT "%13.11" ECU_ADDRESS 0x3FE542 /end MEASUREMENT
/begin MEASUREMENT TYP_slpe "" UWORD B_TRUE 1 100 0 1 BIT_MASK 0xf00 FORMAT "%13.11" ECU_ADDRESS 0x3FE54C /end MEASUREMENT
/begin MEASUREMENT TYP_sls "Fehlertyp: Sekund‰rluftsystem" UWORD B_TRUE 1 100 0 1 BIT_MASK 0xf00 FORMAT "%13.11" ECU_ADDRESS 0x3FE54E /end MEASUREMENT
/begin MEASUREMENT TYP_sls2 "Fehlertyp: Sekund‰rluftsystem, Bank 2" UWORD B_TRUE 1 100 0 1 BIT_MASK 0xf00 FORMAT "%13.11" ECU_ADDRESS 0x3FE550 /end MEASUREMENT
/begin MEASUREMENT TYP_slv "Fehlertyp: Dichtheit Sekund‰rluftventil" UWORD B_TRUE 1 100 0 1 BIT_MASK 0xf00 FORMAT "%13.11" ECU_ADDRESS 0x3FE552 /end MEASUREMENT
/begin MEASUREMENT TYP_slv2 "Fehlertyp: Dichtheit Sekund‰rluftventil, Bank 2" UWORD B_TRUE 1 100 0 1 BIT_MASK 0xf00 FORMAT "%13.11" ECU_ADDRESS 0x3FE554 /end MEASUREMENT
/begin MEASUREMENT TYP_sta "" UWORD B_TRUE 1 100 0 1 BIT_MASK 0xf00 FORMAT "%13.11" ECU_ADDRESS 0x3FE558 /end MEASUREMENT
/begin MEASUREMENT TYP_sts "" UWORD B_TRUE 1 100 0 1 BIT_MASK 0xf00 FORMAT "%13.11" ECU_ADDRESS 0x3FE55A /end MEASUREMENT
/begin MEASUREMENT TYP_sue "" UWORD B_TRUE 1 100 0 1 BIT_MASK 0xf00 FORMAT "%13.11" ECU_ADDRESS 0x3FE55C /end MEASUREMENT
/begin MEASUREMENT TYP_teve "" UWORD B_TRUE 1 100 0 1 BIT_MASK 0xf00 FORMAT "%13.11" ECU_ADDRESS 0x3FE566 /end MEASUREMENT
/begin MEASUREMENT TYP_ths "" UWORD B_TRUE 1 100 0 1 BIT_MASK 0xf00 FORMAT "%13.11" ECU_ADDRESS 0x3FE568 /end MEASUREMENT
/begin MEASUREMENT TYP_ufmv "Fehlertyp: Funktions¸berwachung: Momentenvergleich" UWORD B_TRUE 1 100 0 1 BIT_MASK 0xf00 FORMAT "%13.11" ECU_ADDRESS 0x3FE572 /end MEASUREMENT
/begin MEASUREMENT TYP_ufnc "" UWORD B_TRUE 1 100 0 1 BIT_MASK 0xf00 FORMAT "%13.11" ECU_ADDRESS 0x3FE574 /end MEASUREMENT
/begin MEASUREMENT TYP_ufrlip "" UWORD B_TRUE 1 100 0 1 BIT_MASK 0xf00 FORMAT "%13.11" ECU_ADDRESS 0x3FE576 /end MEASUREMENT
/begin MEASUREMENT TYP_ufsga "" UWORD B_TRUE 1 100 0 1 BIT_MASK 0xf00 FORMAT "%13.11" ECU_ADDRESS 0x3FE578 /end MEASUREMENT
/begin MEASUREMENT TYP_ufsgb "" UWORD B_TRUE 1 100 0 1 BIT_MASK 0xf00 FORMAT "%13.11" ECU_ADDRESS 0x3FE57A /end MEASUREMENT
/begin MEASUREMENT TYP_ufsgc "" UWORD B_TRUE 1 100 0 1 BIT_MASK 0xf00 FORMAT "%13.11" ECU_ADDRESS 0x3FE57C /end MEASUREMENT
/begin MEASUREMENT TYP_ufspsc "" UWORD B_TRUE 1 100 0 1 BIT_MASK 0xf00 FORMAT "%13.11" ECU_ADDRESS 0x3FE57E /end MEASUREMENT
/begin MEASUREMENT TYP_ulsu "" UWORD B_TRUE 1 100 0 1 BIT_MASK 0xf00 FORMAT "%13.11" ECU_ADDRESS 0x3FE580 /end MEASUREMENT
/begin MEASUREMENT TYP_ulsu2 "" UWORD B_TRUE 1 100 0 1 BIT_MASK 0xf00 FORMAT "%13.11" ECU_ADDRESS 0x3FE582 /end MEASUREMENT
/begin MEASUREMENT TYP_urram "Fehlertyp: Rechner¸berwachung: RAM" UWORD B_TRUE 1 100 0 1 BIT_MASK 0xf00 FORMAT "%13.11" ECU_ADDRESS 0x3FE584 /end MEASUREMENT
/begin MEASUREMENT TYP_urrom "Fehlertyp: Rechner¸berwachung: ROM" UWORD B_TRUE 1 100 0 1 BIT_MASK 0xf00 FORMAT "%13.11" ECU_ADDRESS 0x3FE586 /end MEASUREMENT
/begin MEASUREMENT TYP_urrst "Fehlertyp: Rechner¸berwachung: Reset" UWORD B_TRUE 1 100 0 1 BIT_MASK 0xf00 FORMAT "%13.11" ECU_ADDRESS 0x3FE588 /end MEASUREMENT
/begin MEASUREMENT TYP_vat "" UWORD B_TRUE 1 100 0 1 BIT_MASK 0xf00 FORMAT "%13.11" ECU_ADDRESS 0x3FE58A /end MEASUREMENT
/begin MEASUREMENT TYP_vfz "" UWORD B_TRUE 1 100 0 1 BIT_MASK 0xf00 FORMAT "%13.11" ECU_ADDRESS 0x3FE58C /end MEASUREMENT
/begin MEASUREMENT Z_anwse "Zyklusflag: Nockenwellensteuerungsventil Endstufe (Bank1,Auslaﬂ)" UWORD B_TRUE 1 100 0 1 BIT_MASK 0x2 FORMAT "%13.11" ECU_ADDRESS 0x3FE3B8 /end MEASUREMENT
/begin MEASUREMENT Z_anwse2 "Zyklusflag: Nockenwellensteuerungsventil Endstufe (Bank2,Auslaﬂ)" UWORD B_TRUE 1 100 0 1 BIT_MASK 0x2 FORMAT "%13.11" ECU_ADDRESS 0x3FE3BA /end MEASUREMENT
/begin MEASUREMENT Z_dvan "Zyklusflag: Fehler VVT-Anschlaglernen" UWORD B_TRUE 1 100 0 1 BIT_MASK 0x2 FORMAT "%13.11" ECU_ADDRESS 0x3FE40C /end MEASUREMENT
/begin MEASUREMENT Z_dvcan "Zyklusflag: Fehler CAN-Kommunikation" UWORD B_TRUE 1 100 0 1 BIT_MASK 0x2 FORMAT "%13.11" ECU_ADDRESS 0x3FE40E /end MEASUREMENT
/begin MEASUREMENT Z_dvcan2 "Zyklusflag: Fehler CAN-Kommunikation Bank 2" UWORD B_TRUE 1 100 0 1 BIT_MASK 0x2 FORMAT "%13.11" ECU_ADDRESS 0x3FE410 /end MEASUREMENT
/begin MEASUREMENT Z_dvest "Zyklusflag: Fehler Endstufe" UWORD B_TRUE 1 100 0 1 BIT_MASK 0x2 FORMAT "%13.11" ECU_ADDRESS 0x3FE41E /end MEASUREMENT
/begin MEASUREMENT Z_dvest2 "Zyklusflag: Fehler Endstufe Bank 2" UWORD B_TRUE 1 100 0 1 BIT_MASK 0x2 FORMAT "%13.11" ECU_ADDRESS 0x3FE420 /end MEASUREMENT
/begin MEASUREMENT Z_dvffs "Zyklusflag: Fehler Fuehrungssensor" UWORD B_TRUE 1 100 0 1 BIT_MASK 0x2 FORMAT "%13.11" ECU_ADDRESS 0x3FE42C /end MEASUREMENT
/begin MEASUREMENT Z_dvffs2 "Zyklusflag: Fehler Fuehrungssensor Bank 2" UWORD B_TRUE 1 100 0 1 BIT_MASK 0x2 FORMAT "%13.11" ECU_ADDRESS 0x3FE42E /end MEASUREMENT
/begin MEASUREMENT Z_dvfrs "Zyklusflag: Fehler Referenzsensor" UWORD B_TRUE 1 100 0 1 BIT_MASK 0x2 FORMAT "%13.11" ECU_ADDRESS 0x3FE430 /end MEASUREMENT
/begin MEASUREMENT Z_dvfrs2 "Zyklusflag: Fehler Referenzsensor Bank 2" UWORD B_TRUE 1 100 0 1 BIT_MASK 0x2 FORMAT "%13.11" ECU_ADDRESS 0x3FE432 /end MEASUREMENT
/begin MEASUREMENT Z_dvfsg "Zyklusflag: Fehler Steuergeraet intern" UWORD B_TRUE 1 100 0 1 BIT_MASK 0x2 FORMAT "%13.11" ECU_ADDRESS 0x3FE434 /end MEASUREMENT
/begin MEASUREMENT Z_dvfsg2 "Zyklusflag: Fehler Steuergeraet intern Bank 2" UWORD B_TRUE 1 100 0 1 BIT_MASK 0x2 FORMAT "%13.11" ECU_ADDRESS 0x3FE436 /end MEASUREMENT
/begin MEASUREMENT Z_dvlrn "Zyklusflag: Fehler Anschlaglernen" UWORD B_TRUE 1 100 0 1 BIT_MASK 0x2 FORMAT "%13.11" ECU_ADDRESS 0x3FE438 /end MEASUREMENT
/begin MEASUREMENT Z_dvlrn2 "Zyklusflag: Fehler Anschlaglernen Bank 2" UWORD B_TRUE 1 100 0 1 BIT_MASK 0x2 FORMAT "%13.11" ECU_ADDRESS 0x3FE43A /end MEASUREMENT
/begin MEASUREMENT Z_dvovl "Zyklusflag: VVT-‹berlastschutz" UWORD B_TRUE 1 100 0 1 BIT_MASK 0x2 FORMAT "%13.11" ECU_ADDRESS 0x3FE43C /end MEASUREMENT
/begin MEASUREMENT Z_dvovl2 "" UWORD B_TRUE 1 100 0 1 BIT_MASK 0x2 FORMAT "%13.11" ECU_ADDRESS 0x3FE43E /end MEASUREMENT
/begin MEASUREMENT Z_dvpla "Zyklusflag: Fehler Sensorplausibilisierung" UWORD B_TRUE 1 100 0 1 BIT_MASK 0x2 FORMAT "%13.11" ECU_ADDRESS 0x3FE440 /end MEASUREMENT
/begin MEASUREMENT Z_dvpla2 "Zyklusflag: Fehler Sensorplausibilisierung Bank 2" UWORD B_TRUE 1 100 0 1 BIT_MASK 0x2 FORMAT "%13.11" ECU_ADDRESS 0x3FE442 /end MEASUREMENT
/begin MEASUREMENT Z_dvpmn "Zyklusflag: Leistungsbegrenzung VVT" UWORD B_TRUE 1 100 0 1 BIT_MASK 0x2 FORMAT "%13.11" ECU_ADDRESS 0x3FE444 /end MEASUREMENT
/begin MEASUREMENT Z_dvste "Zyklusflag: Fehler Stellgliedueberwachung" UWORD B_TRUE 1 100 0 1 BIT_MASK 0x2 FORMAT "%13.11" ECU_ADDRESS 0x3FE446 /end MEASUREMENT
/begin MEASUREMENT Z_dvste2 "Zyklusflag: Fehler Stellgliedueberwachung Bank 2" UWORD B_TRUE 1 100 0 1 BIT_MASK 0x2 FORMAT "%13.11" ECU_ADDRESS 0x3FE448 /end MEASUREMENT
/begin MEASUREMENT Z_dvulv "Zyklusflag: Fehler Leistungsversorgung VVT" UWORD B_TRUE 1 100 0 1 BIT_MASK 0x2 FORMAT "%13.11" ECU_ADDRESS 0x3FE44A /end MEASUREMENT
/begin MEASUREMENT Z_dvulv2 "Zyklusflag: Fehler Leistungsversorgung VVT Bank 2" UWORD B_TRUE 1 100 0 1 BIT_MASK 0x2 FORMAT "%13.11" ECU_ADDRESS 0x3FE44C /end MEASUREMENT
/begin MEASUREMENT Z_dvuse "Zyklusflag: Fehler Sensor-Versorgungsspannung" UWORD B_TRUE 1 100 0 1 BIT_MASK 0x2 FORMAT "%13.11" ECU_ADDRESS 0x3FE44E /end MEASUREMENT
/begin MEASUREMENT Z_dvuse2 "Zyklusflag: Fehler Sensor-Versorgungsspannung Bank 2" UWORD B_TRUE 1 100 0 1 BIT_MASK 0x2 FORMAT "%13.11" ECU_ADDRESS 0x3FE450 /end MEASUREMENT
/begin MEASUREMENT Z_enws "Zyklusflag: Nockenwellensteuerung (Einlaﬂ,Bank1)" UWORD B_TRUE 1 100 0 1 BIT_MASK 0x2 FORMAT "%13.11" ECU_ADDRESS 0x3FE46C /end MEASUREMENT
/begin MEASUREMENT Z_enws2 "Zyklusflag: Nockenwellensteuerung (Einlaﬂ,Bank2)" UWORD B_TRUE 1 100 0 1 BIT_MASK 0x2 FORMAT "%13.11" ECU_ADDRESS 0x3FE46E /end MEASUREMENT
/begin MEASUREMENT Z_enwse "Zyklusflag: Nockenwellensteuerungsventil Endstufe (Bank1,Einlaﬂ)" UWORD B_TRUE 1 100 0 1 BIT_MASK 0x2 FORMAT "%13.11" ECU_ADDRESS 0x3FE470 /end MEASUREMENT
/begin MEASUREMENT Z_enwse2 "Zyklusflag: Nockenwellensteuerungsventil Endstufe (Bank2,Einlaﬂ)" UWORD B_TRUE 1 100 0 1 BIT_MASK 0x2 FORMAT "%13.11" ECU_ADDRESS 0x3FE472 /end MEASUREMENT
/begin MEASUREMENT Z_ph "Zyklusflag: Phasensensor" UWORD B_TRUE 1 100 0 1 BIT_MASK 0x2 FORMAT "%13.11" ECU_ADDRESS 0x3FE530 /end MEASUREMENT
/begin MEASUREMENT Z_ph2 "Zyklusflag: Phasensensor 2" UWORD B_TRUE 1 100 0 1 BIT_MASK 0x2 FORMAT "%13.11" ECU_ADDRESS 0x3FE532 /end MEASUREMENT
/begin MEASUREMENT Z_ph3 "Zyklusflag: Phasensensor 3" UWORD B_TRUE 1 100 0 1 BIT_MASK 0x2 FORMAT "%13.11" ECU_ADDRESS 0x3FE534 /end MEASUREMENT
/begin MEASUREMENT Z_ph4 "Zyklusflag: Phasensensor 4" UWORD B_TRUE 1 100 0 1 BIT_MASK 0x2 FORMAT "%13.11" ECU_ADDRESS 0x3FE536 /end MEASUREMENT
/begin MEASUREMENT Z_phm "Master-Zyklusflag f¸r Phasensensoren" UWORD B_TRUE 1 100 0 1 BIT_MASK 0x2 FORMAT "%13.11" ECU_ADDRESS 0x3FE538 /end MEASUREMENT
/begin MEASUREMENT Z_pllsu "Zyklusflag: Plausibilit‰t der LSU" UWORD B_TRUE 1 100 0 1 BIT_MASK 0x2 FORMAT "%13.11" ECU_ADDRESS 0x3FE53A /end MEASUREMENT
/begin MEASUREMENT Z_pllsu2 "Zyklusflag: Plausibilit‰t der LSU, Bank 2" UWORD B_TRUE 1 100 0 1 BIT_MASK 0x2 FORMAT "%13.11" ECU_ADDRESS 0x3FE53C /end MEASUREMENT
/begin MEASUREMENT Z_poels "Zyklusflag: Plausibilit‰t ÷ldruckschalter" UWORD B_TRUE 1 100 0 1 BIT_MASK 0x2 FORMAT "%13.11" ECU_ADDRESS 0x3FE542 /end MEASUREMENT
/begin MEASUREMENT Z_slpe "Zyklusflag: Sekund‰rluftpumpe (Endstufe)" UWORD B_TRUE 1 100 0 1 BIT_MASK 0x2 FORMAT "%13.11" ECU_ADDRESS 0x3FE54C /end MEASUREMENT
/begin MEASUREMENT Z_sls "Zyklusflag: Sekund‰rluft-System" UWORD B_TRUE 1 100 0 1 BIT_MASK 0x2 FORMAT "%13.11" ECU_ADDRESS 0x3FE54E /end MEASUREMENT
/begin MEASUREMENT Z_sls2 "Zyklusflag: Sekund‰rluft-System Bank 2" UWORD B_TRUE 1 100 0 1 BIT_MASK 0x2 FORMAT "%13.11" ECU_ADDRESS 0x3FE550 /end MEASUREMENT
/begin MEASUREMENT Z_slv "Zyklusflag: Sekund‰rluftventil" UWORD B_TRUE 1 100 0 1 BIT_MASK 0x2 FORMAT "%13.11" ECU_ADDRESS 0x3FE552 /end MEASUREMENT
/begin MEASUREMENT Z_slv2 "Zyklusflag: Sekund‰rluftventil, Bank 2" UWORD B_TRUE 1 100 0 1 BIT_MASK 0x2 FORMAT "%13.11" ECU_ADDRESS 0x3FE554 /end MEASUREMENT
/begin MEASUREMENT Z_sta "Zyklusflag: Startautomatik" UWORD B_TRUE 1 100 0 1 BIT_MASK 0x2 FORMAT "%13.11" ECU_ADDRESS 0x3FE558 /end MEASUREMENT
/begin MEASUREMENT Z_sts "Zyklusflag: Startsignal" UWORD B_TRUE 1 100 0 1 BIT_MASK 0x2 FORMAT "%13.11" ECU_ADDRESS 0x3FE55A /end MEASUREMENT
/begin MEASUREMENT Z_sue "Zyklusflag: Endstufe Saugrohrumschaltung" UWORD B_TRUE 1 100 0 1 BIT_MASK 0x2 FORMAT "%13.11" ECU_ADDRESS 0x3FE55C /end MEASUREMENT
/begin MEASUREMENT Z_tes "Zyklusflag: Tankentl¸ftungssystem" UWORD B_TRUE 1 100 0 1 BIT_MASK 0x2 FORMAT "%13.11" ECU_ADDRESS 0x3FE562 /end MEASUREMENT
/begin MEASUREMENT Z_teve "Zyklusflag:	Tankentl¸ftungsventil Endstufe" UWORD B_TRUE 1 100 0 1 BIT_MASK 0x2 FORMAT "%13.11" ECU_ADDRESS 0x3FE566 /end MEASUREMENT
/begin MEASUREMENT Z_ths "Zyklusflag DTHS" UWORD B_TRUE 1 100 0 1 BIT_MASK 0x2 FORMAT "%13.11" ECU_ADDRESS 0x3FE568 /end MEASUREMENT
/begin MEASUREMENT Z_ufmv "Zyklusflag: Funktions¸berwachung: Momentenvergleich" UWORD B_TRUE 1 100 0 1 BIT_MASK 0x2 FORMAT "%13.11" ECU_ADDRESS 0x3FE572 /end MEASUREMENT
/begin MEASUREMENT Z_ufnc "Zyklusflag: Funktions¸berwachung: Drehzahlgeber-, Zuleitung- oder SG-Fehler" UWORD B_TRUE 1 100 0 1 BIT_MASK 0x2 FORMAT "%13.11" ECU_ADDRESS 0x3FE574 /end MEASUREMENT
/begin MEASUREMENT Z_ufrlip "Zyklusflag: Funktions¸berwachung: Lastsensor-, Zuleitung- oder SG-Fehler" UWORD B_TRUE 1 100 0 1 BIT_MASK 0x2 FORMAT "%13.11" ECU_ADDRESS 0x3FE576 /end MEASUREMENT
/begin MEASUREMENT Z_ufsga "Zyklusflag: Funktions¸berwachung: Steuerger‰te-Fehler Gruppe a" UWORD B_TRUE 1 100 0 1 BIT_MASK 0x2 FORMAT "%13.11" ECU_ADDRESS 0x3FE578 /end MEASUREMENT
/begin MEASUREMENT Z_ufsgb "Zyklusflag: Funktions¸berwachung: Steuerger‰te-Fehler Gruppe b" UWORD B_TRUE 1 100 0 1 BIT_MASK 0x2 FORMAT "%13.11" ECU_ADDRESS 0x3FE57A /end MEASUREMENT
/begin MEASUREMENT Z_ufsgc "Zyklusflag: Funktions¸berwachung: Steuerger‰te-Fehler Gruppe c" UWORD B_TRUE 1 100 0 1 BIT_MASK 0x2 FORMAT "%13.11" ECU_ADDRESS 0x3FE57C /end MEASUREMENT
/begin MEASUREMENT Z_ufspsc "Zyklusflag: Funktions¸berwachung: Pedalwertgeber-, Zuleitung- oder SG-Fehler" UWORD B_TRUE 1 100 0 1 BIT_MASK 0x2 FORMAT "%13.11" ECU_ADDRESS 0x3FE57E /end MEASUREMENT
/begin MEASUREMENT Z_ulsu "Zyklusflag: Spannungsdiagnose der LSU" UWORD B_TRUE 1 100 0 1 BIT_MASK 0x2 FORMAT "%13.11" ECU_ADDRESS 0x3FE580 /end MEASUREMENT
/begin MEASUREMENT Z_ulsu2 "Zyklusflag: Spannungsdiagnose der LSU, Bank 2" UWORD B_TRUE 1 100 0 1 BIT_MASK 0x2 FORMAT "%13.11" ECU_ADDRESS 0x3FE582 /end MEASUREMENT
/begin MEASUREMENT Z_urram "Zyklusflag: Rechner¸berwachung: RAM" UWORD B_TRUE 1 100 0 1 BIT_MASK 0x2 FORMAT "%13.11" ECU_ADDRESS 0x3FE584 /end MEASUREMENT
/begin MEASUREMENT Z_urrom "Zyklusflag: Rechner¸berwachung: ROM" UWORD B_TRUE 1 100 0 1 BIT_MASK 0x2 FORMAT "%13.11" ECU_ADDRESS 0x3FE586 /end MEASUREMENT
/begin MEASUREMENT Z_urrst "Zyklusflag: Rechner¸berwachung: Reset" UWORD B_TRUE 1 100 0 1 BIT_MASK 0x2 FORMAT "%13.11" ECU_ADDRESS 0x3FE588 /end MEASUREMENT
/begin MEASUREMENT Z_vat "Zyklusflag: angezeigte Fahrzeuggeschwindigkeit im Tacho" UWORD B_TRUE 1 100 0 1 BIT_MASK 0x2 FORMAT "%13.11" ECU_ADDRESS 0x3FE58A /end MEASUREMENT
/begin MEASUREMENT Z_vfz "Zyklusflag: Fahrzeug-Geschwindigkeit" UWORD B_TRUE 1 100 0 1 BIT_MASK 0x2 FORMAT "%13.11" ECU_ADDRESS 0x3FE58C /end MEASUREMENT
/begin FUNCTION DFPM_DNWSEAUS ""
 /begin DEF_CHARACTERISTIC CDCANWSE CDCANWSE2 CDKANWSE CDKANWSE2 CDTANWSE CDTANWSE2 CLAANWSE CLAANWSE2 FFTANWSE FFTANWSE2 TSFANWSE TSFANWSE2 /end DEF_CHARACTERISTIC
 /begin OUT_MEASUREMENT B_beanwse B_beanwse2 B_bkanwse B_bkanwse2 B_clanwse B_clanwse2 B_ftanwse B_ftanwse2 B_mnanwse B_mnanwse2 B_mxanwse B_mxanwse2 B_npanwse B_npanwse2 B_sianwse B_sianwse2 E_anwse E_anwse2 sfpanwse sfpanwse2 TYP_anwse TYP_anwse2 Z_anwse Z_anwse2 /end OUT_MEASUREMENT
/end FUNCTION
/begin FUNCTION DFPM_DNWSEEIN ""
 /begin DEF_CHARACTERISTIC CDCENWSE CDCENWSE2 CDKENWSE CDKENWSE2 CDTENWSE CDTENWSE2 CLAENWSE CLAENWSE2 FFTENWSE FFTENWSE2 TSFENWSE TSFENWSE2 /end DEF_CHARACTERISTIC
 /begin OUT_MEASUREMENT B_beenwse B_beenwse2 B_bkenwse B_bkenwse2 B_clenwse B_clenwse2 B_ftenwse B_ftenwse2 B_mnenwse B_mnenwse2 B_mxenwse B_mxenwse2 B_npenwse B_npenwse2 B_sienwse B_sienwse2 E_enwse E_enwse2 sfpenwse sfpenwse2 TYP_enwse TYP_enwse2 Z_enwse Z_enwse2 /end OUT_MEASUREMENT
/end FUNCTION
/begin FUNCTION DFPM_DNWSEIN "DNWSEIN.exported"
 /begin DEF_CHARACTERISTIC CDCENWS CDCENWS2 CDKENWS CDKENWS2 CDTENWS CDTENWS2 CLAENWS CLAENWS2 FFTENWS FFTENWS2 TSFENWS TSFENWS2 /end DEF_CHARACTERISTIC
 /begin OUT_MEASUREMENT B_beenws B_beenws2 B_bkenws B_bkenws2 B_clenws B_clenws2 B_ftenws B_ftenws2 B_mnenws B_mnenws2 B_mxenws B_mxenws2 B_npenws B_npenws2 B_sienws B_sienws2 E_enws E_enws2 sfpenws sfpenws2 TYP_enws TYP_enws2 Z_enws Z_enws2 /end OUT_MEASUREMENT
/end FUNCTION
/begin FUNCTION DFPM_DODSNL "" /begin DEF_CHARACTERISTIC CDCPOELS CDKPOELS CDTPOELS CLAPOELS FFTPOELS TSFPOELS /end DEF_CHARACTERISTIC
 /begin OUT_MEASUREMENT B_bepoels B_bkpoels B_clpoels B_ftpoels B_mnpoels B_mxpoels B_nppoels B_sipoels E_poels sfppoels TYP_poels Z_poels /end OUT_MEASUREMENT
/end FUNCTION
/begin FUNCTION DFPM_DPH ""
 /begin DEF_CHARACTERISTIC CDCPH CDCPH2 CDCPH3 CDCPH4 CDCPHM CDKPH CDKPH2 CDKPH3 CDKPH4 CDKPHM CDTPH CDTPH2 CDTPH3 CDTPH4 CDTPHM CLAPH CLAPH2 CLAPH3 CLAPH4 CLAPHM FFTPH FFTPH2 FFTPH3 FFTPH4 FFTPHM TSFPH TSFPH2 TSFPH3 TSFPH4 TSFPHM /end DEF_CHARACTERISTIC
 /begin OUT_MEASUREMENT B_beph B_beph2 B_beph3 B_beph4 B_bephm B_bkph B_bkph2 B_bkph3 B_bkph4 B_bkphm B_clph B_clph2 B_clph3 B_clph4 B_clphm B_ftph B_ftph2 B_ftph3 B_ftph4 B_ftphm B_mnph B_mnph2 B_mnph3 B_mnph4 B_mnphm B_mxph B_mxph2 B_mxph3 B_mxph4 B_mxphm B_npph B_npph2 B_npph3 B_npph4 B_npphm B_siph B_siph2 B_siph3 B_siph4 B_siphm E_ph E_ph2 E_ph3 E_ph4 E_phm sfpph sfpph2 sfpph3 sfpph4 sfpphm TYP_ph TYP_ph2 TYP_ph3 TYP_ph4 TYP_phm Z_ph Z_ph2 Z_ph3 Z_ph4 Z_phm /end OUT_MEASUREMENT
/end FUNCTION
/begin FUNCTION DFPM_DPLLSU ""
 /begin DEF_CHARACTERISTIC CDCPLLSU CDCPLLSU2 CDKPLLSU CDKPLLSU2 CDTPLLSU CDTPLLSU2 CLAPLLSU CLAPLLSU2 FFTPLLSU FFTPLLSU2 TSFPLLSU TSFPLLSU2 /end DEF_CHARACTERISTIC
 /begin OUT_MEASUREMENT B_bepllsu B_bepllsu2 B_bkpllsu B_bkpllsu2 B_clpllsu B_clpllsu2 B_ftpllsu B_ftpllsu2 B_mnpllsu B_mnpllsu2 B_mxpllsu B_mxpllsu2 B_nppllsu B_nppllsu2 B_sipllsu B_sipllsu2 E_pllsu E_pllsu2 sfppllsu sfppllsu2 TYP_pllsu TYP_pllsu2 Z_pllsu Z_pllsu2 /end OUT_MEASUREMENT
/end FUNCTION
/begin FUNCTION DFPM_DSLPE "" /begin DEF_CHARACTERISTIC CDCSLPE CDKSLPE CDTSLPE CLASLPE FFTSLPE TSFSLPE /end DEF_CHARACTERISTIC
 /begin OUT_MEASUREMENT B_beslpe B_bkslpe B_clslpe B_ftslpe B_mnslpe B_mxslpe B_npslpe B_sislpe E_slpe sfpslpe TYP_slpe Z_slpe /end OUT_MEASUREMENT
/end FUNCTION
/begin FUNCTION DFPM_DSLSLRS ""
 /begin DEF_CHARACTERISTIC CDCSLS CDCSLS2 CDCSLV CDCSLV2 CDKSLS CDKSLS2 CDKSLV CDKSLV2 CDTSLS CDTSLS2 CDTSLV CDTSLV2 CLASLS CLASLS2 CLASLV CLASLV2 FFTSLS FFTSLS2 FFTSLV FFTSLV2 TSFSLS TSFSLS2 TSFSLV TSFSLV2 /end DEF_CHARACTERISTIC
 /begin OUT_MEASUREMENT B_besls B_besls2 B_beslv B_beslv2 B_bksls B_bksls2 B_bkslv B_bkslv2 B_clsls B_clsls2 B_clslv B_clslv2 B_ftsls B_ftsls2 B_ftslv B_ftslv2 B_mnsls B_mnsls2 B_mnslv B_mnslv2 B_mxsls B_mxsls2 B_mxslv B_mxslv2 B_npsls B_npsls2 B_npslv B_npslv2 B_sisls B_sisls2 B_sislv B_sislv2 E_sls E_sls2 E_slv E_slv2 sfpsls sfpsls2 sfpslv sfpslv2 TYP_sls TYP_sls2 TYP_slv TYP_slv2 Z_sls Z_sls2 Z_slv Z_slv2 /end OUT_MEASUREMENT
/end FUNCTION
/begin FUNCTION DFPM_DSTA "" /begin DEF_CHARACTERISTIC CDCSTA CDKSTA CDTSTA CLASTA FFTSTA TSFSTA /end DEF_CHARACTERISTIC
 /begin OUT_MEASUREMENT B_besta B_bksta B_clsta B_ftsta B_mnsta B_mxsta B_npsta B_sista E_sta sfpsta TYP_sta Z_sta /end OUT_MEASUREMENT
/end FUNCTION
/begin FUNCTION DFPM_DSTS "" /begin DEF_CHARACTERISTIC CDCSTS CDKSTS CDTSTS CLASTS FFTSTS TSFSTS /end DEF_CHARACTERISTIC
 /begin OUT_MEASUREMENT B_bests B_bksts B_clsts B_ftsts B_mnsts B_mxsts B_npsts B_sists E_sts sfpsts TYP_sts Z_sts /end OUT_MEASUREMENT
/end FUNCTION
/begin FUNCTION DFPM_DSUE "" /begin DEF_CHARACTERISTIC CDCSUE CDKSUE CDTSUE CLASUE FFTSUE TSFSUE /end DEF_CHARACTERISTIC
 /begin OUT_MEASUREMENT B_besue B_bksue B_clsue B_ftsue B_mnsue B_mxsue B_npsue B_sisue E_sue sfpsue TYP_sue Z_sue /end OUT_MEASUREMENT
/end FUNCTION
/begin FUNCTION DFPM_DTEVE "" /begin DEF_CHARACTERISTIC CDCTEVE CDKTEVE CDTTEVE CLATEVE FFTTEVE TSFTEVE /end DEF_CHARACTERISTIC
 /begin OUT_MEASUREMENT B_beteve B_bkteve B_clteve B_ftteve B_mnteve B_mxteve B_npteve B_siteve E_teve sfpteve TYP_teve Z_teve /end OUT_MEASUREMENT
/end FUNCTION
/begin FUNCTION DFPM_DTEVN "" /begin DEF_CHARACTERISTIC CDCTES CDKTES CDTTES CLATES FFTTES TSFTES /end DEF_CHARACTERISTIC /begin OUT_MEASUREMENT B_cltes B_mntes E_tes sfptes Z_tes /end OUT_MEASUREMENT /end FUNCTION
/begin FUNCTION DFPM_DTHS "DTHS." /begin DEF_CHARACTERISTIC CDCTHS CDKTHS CDTTHS CLATHS FFTTHS TSFTHS /end DEF_CHARACTERISTIC
 /begin OUT_MEASUREMENT B_beths B_bkths B_clths B_ftths B_mnths B_mxths B_npths B_siths E_ths sfpths TYP_ths Z_ths /end OUT_MEASUREMENT
/end FUNCTION
/begin FUNCTION DFPM_DUF ""
 /begin DEF_CHARACTERISTIC CDCUFMV CDCUFNC CDCUFRLIP CDCUFSGA CDCUFSGB CDCUFSGC CDCUFSPSC CDKUFMV CDKUFNC CDKUFRLIP CDKUFSGA CDKUFSGB CDKUFSGC CDKUFSPSC CDTUFMV CDTUFNC CDTUFRLIP CDTUFSGA CDTUFSGB CDTUFSGC CDTUFSPSC CLAUFMV CLAUFNC CLAUFRLIP CLAUFSGA CLAUFSGB CLAUFSGC CLAUFSPSC FFTUFMV FFTUFNC FFTUFRLIP FFTUFSGA FFTUFSGB FFTUFSGC FFTUFSPSC TSFUFMV TSFUFNC TSFUFRLIP TSFUFSGA TSFUFSGB TSFUFSGC TSFUFSPSC /end DEF_CHARACTERISTIC
 /begin OUT_MEASUREMENT B_beufmv B_beufnc B_beufrlip B_beufsga B_beufsgb B_beufsgc B_beufspsc B_bkufmv B_bkufnc B_bkufrlip B_bkufsga B_bkufsgb B_bkufsgc B_bkufspsc B_clufmv B_clufnc B_clufrlip B_clufsga B_clufsgb B_clufsgc B_clufspsc B_ftufmv B_ftufnc B_ftufrlip B_ftufsga B_ftufsgb B_ftufsgc B_ftufspsc B_mnufmv B_mnufnc B_mnufrlip B_mnufsga B_mnufsgb B_mnufsgc B_mnufspsc B_mxufmv B_mxufnc B_mxufrlip B_mxufsga B_mxufsgb B_mxufsgc B_mxufspsc B_npufmv B_npufnc B_npufrlip B_npufsga B_npufsgb B_npufsgc B_npufspsc B_siufmv B_siufnc B_siufrlip B_siufsga B_siufsgb B_siufsgc B_siufspsc E_ufmv E_ufnc E_ufrlip E_ufsga E_ufsgb E_ufsgc E_ufspsc sfpufmv sfpufnc sfpufrlip sfpufsga sfpufsgb sfpufsgc sfpufspsc TYP_ufmv TYP_ufnc TYP_ufrlip TYP_ufsga TYP_ufsgb TYP_ufsgc TYP_ufspsc Z_ufmv Z_ufnc Z_ufrlip Z_ufsga Z_ufsgb Z_ufsgc Z_ufspsc /end OUT_MEASUREMENT
/end FUNCTION
/begin FUNCTION DFPM_DULSU ""
 /begin DEF_CHARACTERISTIC CDCULSU CDCULSU2 CDKULSU CDKULSU2 CDTULSU CDTULSU2 CLAULSU CLAULSU2 FFTULSU FFTULSU2 TSFULSU TSFULSU2 /end DEF_CHARACTERISTIC
 /begin OUT_MEASUREMENT B_beulsu B_beulsu2 B_bkulsu B_bkulsu2 B_clulsu B_clulsu2 B_ftulsu B_ftulsu2 B_mnulsu B_mnulsu2 B_mxulsu B_mxulsu2 B_npulsu B_npulsu2 B_siulsu B_siulsu2 E_ulsu E_ulsu2 sfpulsu sfpulsu2 TYP_ulsu TYP_ulsu2 Z_ulsu Z_ulsu2 /end OUT_MEASUREMENT
/end FUNCTION
/begin FUNCTION DFPM_DUR ""
 /begin DEF_CHARACTERISTIC CDCURRAM CDCURROM CDCURRST CDKURRAM CDKURROM CDKURRST CDTURRAM CDTURROM CDTURRST CLAURRAM CLAURROM CLAURRST FFTURRAM FFTURROM FFTURRST TSFURRAM TSFURROM TSFURRST /end DEF_CHARACTERISTIC
 /begin OUT_MEASUREMENT B_beurram B_beurrom B_beurrst B_bkurram B_bkurrom B_bkurrst B_clurram B_clurrom B_clurrst B_fturram B_fturrom B_fturrst B_mnurram B_mnurrom B_mnurrst B_mxurram B_mxurrom B_mxurrst B_npurram B_npurrom B_npurrst B_siurram B_siurrom B_siurrst E_urram E_urrom E_urrst sfpurram sfpurrom sfpurrst TYP_urram TYP_urrom TYP_urrst Z_urram Z_urrom Z_urrst /end OUT_MEASUREMENT
/end FUNCTION
/begin FUNCTION DFPM_DVAT "" /begin DEF_CHARACTERISTIC CDCVAT CDKVAT CDTVAT CLAVAT FFTVAT TSFVAT /end DEF_CHARACTERISTIC
 /begin OUT_MEASUREMENT B_bevat B_bkvat B_clvat B_ftvat B_mnvat B_mxvat B_npvat B_sivat E_vat sfpvat TYP_vat Z_vat /end OUT_MEASUREMENT
/end FUNCTION
/begin FUNCTION DFPM_DVFZ "" /begin DEF_CHARACTERISTIC CDCVFZ CDKVFZ CDTVFZ CLAVFZ FFTVFZ TSFVFZ /end DEF_CHARACTERISTIC
 /begin OUT_MEASUREMENT B_bevfz B_bkvfz B_clvfz B_ftvfz B_mnvfz B_mxvfz B_npvfz B_sivfz E_vfz sfpvfz TYP_vfz Z_vfz /end OUT_MEASUREMENT
/end FUNCTION
/begin FUNCTION DFPM_DVVT "DVVT."
 /begin DEF_CHARACTERISTIC CDCDVAN CDCDVCAN CDCDVCAN2 CDCDVEST CDCDVEST2 CDCDVFFS CDCDVFFS2 CDCDVFRS CDCDVFRS2 CDCDVFSG CDCDVFSG2 CDCDVLRN CDCDVLRN2 CDCDVOVL CDCDVOVL2 CDCDVPLA CDCDVPLA2 CDCDVPMN CDCDVSTE CDCDVSTE2 CDCDVULV CDCDVULV2 CDCDVUSE CDCDVUSE2 CDKDVAN CDKDVCAN CDKDVCAN2 CDKDVEST CDKDVEST2 CDKDVFFS CDKDVFFS2 CDKDVFRS CDKDVFRS2 CDKDVFSG CDKDVFSG2 CDKDVLRN CDKDVLRN2 CDKDVOVL CDKDVOVL2 CDKDVPLA CDKDVPLA2 CDKDVPMN CDKDVSTE CDKDVSTE2 CDKDVULV CDKDVULV2 CDKDVUSE CDKDVUSE2 CDTDVAN CDTDVCAN CDTDVCAN2 CDTDVEST CDTDVEST2 CDTDVFFS CDTDVFFS2 CDTDVFRS CDTDVFRS2 CDTDVFSG CDTDVFSG2 CDTDVLRN CDTDVLRN2 CDTDVOVL CDTDVOVL2 CDTDVPLA CDTDVPLA2 CDTDVPMN CDTDVSTE CDTDVSTE2 CDTDVULV CDTDVULV2 CDTDVUSE CDTDVUSE2 CLADVAN CLADVCAN CLADVCAN2 CLADVEST CLADVEST2 CLADVFFS CLADVFFS2 CLADVFRS CLADVFRS2 CLADVFSG CLADVFSG2 CLADVLRN CLADVLRN2 CLADVOVL CLADVOVL2 CLADVPLA CLADVPLA2 CLADVPMN CLADVSTE CLADVSTE2 CLADVULV CLADVULV2 CLADVUSE CLADVUSE2 FFTDVAN FFTDVCAN FFTDVCAN2 FFTDVEST FFTDVEST2 FFTDVFFS FFTDVFFS2 FFTDVFRS FFTDVFRS2 FFTDVFSG FFTDVFSG2 FFTDVLRN FFTDVLRN2 FFTDVOVL FFTDVOVL2 FFTDVPLA FFTDVPLA2 FFTDVPMN FFTDVSTE FFTDVSTE2 FFTDVULV FFTDVULV2 FFTDVUSE FFTDVUSE2 TSFDVAN TSFDVCAN TSFDVCAN2 TSFDVEST TSFDVEST2 TSFDVFFS TSFDVFFS2 TSFDVFRS TSFDVFRS2 TSFDVFSG TSFDVFSG2 TSFDVLRN TSFDVLRN2 TSFDVOVL TSFDVOVL2 TSFDVPLA TSFDVPLA2 TSFDVPMN TSFDVSTE TSFDVSTE2 TSFDVULV TSFDVULV2 TSFDVUSE TSFDVUSE2 /end DEF_CHARACTERISTIC
 /begin OUT_MEASUREMENT B_bedvan B_bedvcan B_bedvcan2 B_bedvest B_bedvest2 B_bedvffs B_bedvffs2 B_bedvfrs B_bedvfrs2 B_bedvfsg B_bedvfsg2 B_bedvlrn B_bedvlrn2 B_bedvovl B_bedvovl2 B_bedvpla B_bedvpla2 B_bedvpmn B_bedvste B_bedvste2 B_bedvulv B_bedvulv2 B_bedvuse B_bedvuse2 B_bkdvan B_bkdvcan B_bkdvcan2 B_bkdvest B_bkdvest2 B_bkdvffs B_bkdvffs2 B_bkdvfrs B_bkdvfrs2 B_bkdvfsg B_bkdvfsg2 B_bkdvlrn B_bkdvlrn2 B_bkdvovl B_bkdvovl2 B_bkdvpla B_bkdvpla2 B_bkdvpmn B_bkdvste B_bkdvste2 B_bkdvulv B_bkdvulv2 B_bkdvuse B_bkdvuse2 B_cldvan B_cldvcan B_cldvcan2 B_cldvest B_cldvest2 B_cldvffs B_cldvffs2 B_cldvfrs B_cldvfrs2 B_cldvfsg B_cldvfsg2 B_cldvlrn B_cldvlrn2 B_cldvovl B_cldvovl2 B_cldvpla B_cldvpla2 B_cldvpmn B_cldvste B_cldvste2 B_cldvulv B_cldvulv2 B_cldvuse B_cldvuse2 B_ftdvan B_ftdvcan B_ftdvcan2 B_ftdvest B_ftdvest2 B_ftdvffs B_ftdvffs2 B_ftdvfrs B_ftdvfrs2 B_ftdvfsg B_ftdvfsg2 B_ftdvlrn B_ftdvlrn2 B_ftdvovl B_ftdvovl2 B_ftdvpla B_ftdvpla2 B_ftdvpmn B_ftdvste B_ftdvste2 B_ftdvulv B_ftdvulv2 B_ftdvuse B_ftdvuse2 B_mndvan B_mndvcan B_mndvcan2 B_mndvest B_mndvest2 B_mndvffs B_mndvffs2 B_mndvfrs B_mndvfrs2 B_mndvfsg B_mndvfsg2 B_mndvlrn B_mndvlrn2 B_mndvovl B_mndvovl2 B_mndvpla B_mndvpla2 B_mndvpmn B_mndvste B_mndvste2 B_mndvulv B_mndvulv2 B_mndvuse B_mndvuse2 B_mxdvan B_mxdvcan B_mxdvcan2 B_mxdvest B_mxdvest2 B_mxdvffs B_mxdvffs2 B_mxdvfrs B_mxdvfrs2 B_mxdvfsg B_mxdvfsg2 B_mxdvlrn B_mxdvlrn2 B_mxdvovl B_mxdvovl2 B_mxdvpla B_mxdvpla2 B_mxdvpmn B_mxdvste B_mxdvste2 B_mxdvulv B_mxdvulv2 B_mxdvuse B_mxdvuse2 B_npdvan B_npdvcan B_npdvcan2 B_npdvest B_npdvest2 B_npdvffs B_npdvffs2 B_npdvfrs B_npdvfrs2 B_npdvfsg B_npdvfsg2 B_npdvlrn B_npdvlrn2 B_npdvovl B_npdvovl2 B_npdvpla B_npdvpla2 B_npdvpmn B_npdvste B_npdvste2 B_npdvulv B_npdvulv2 B_npdvuse B_npdvuse2 B_sidvan B_sidvcan B_sidvcan2 B_sidvest B_sidvest2 B_sidvffs B_sidvffs2 B_sidvfrs B_sidvfrs2 B_sidvfsg B_sidvfsg2 B_sidvlrn B_sidvlrn2 B_sidvovl B_sidvovl2 B_sidvpla B_sidvpla2 B_sidvpmn B_sidvste B_sidvste2 B_sidvulv B_sidvulv2 B_sidvuse B_sidvuse2 E_dvan E_dvcan E_dvcan2 E_dvest E_dvest2 E_dvffs E_dvffs2 E_dvfrs E_dvfrs2 E_dvfsg E_dvfsg2 E_dvlrn E_dvlrn2 E_dvovl E_dvovl2 E_dvpla E_dvpla2 E_dvpmn E_dvste E_dvste2 E_dvulv E_dvulv2 E_dvuse E_dvuse2 sfpdvan sfpdvcan sfpdvcan2 sfpdvest sfpdvest2 sfpdvffs sfpdvffs2 sfpdvfrs sfpdvfrs2 sfpdvfsg sfpdvfsg2 sfpdvlrn sfpdvlrn2 sfpdvovl sfpdvovl2 sfpdvpla sfpdvpla2 sfpdvpmn sfpdvste sfpdvste2 sfpdvulv sfpdvulv2 sfpdvuse sfpdvuse2 TYP_dvan TYP_dvcan TYP_dvcan2 TYP_dvest TYP_dvest2 TYP_dvffs TYP_dvffs2 TYP_dvfrs TYP_dvfrs2 TYP_dvfsg TYP_dvfsg2 TYP_dvlrn TYP_dvlrn2 TYP_dvovl TYP_dvovl2 TYP_dvpla TYP_dvpla2 TYP_dvpmn TYP_dvste TYP_dvste2 TYP_dvulv TYP_dvulv2 TYP_dvuse TYP_dvuse2 Z_dvan Z_dvcan Z_dvcan2 Z_dvest Z_dvest2 Z_dvffs Z_dvffs2 Z_dvfrs Z_dvfrs2 Z_dvfsg Z_dvfsg2 Z_dvlrn Z_dvlrn2 Z_dvovl Z_dvovl2 Z_dvpla Z_dvpla2 Z_dvpmn Z_dvste Z_dvste2 Z_dvulv Z_dvulv2 Z_dvuse Z_dvuse2 /end OUT_MEASUREMENT
/end FUNCTION
/begin COMPU_METHOD B_TRUE "boolsche Zust‰nde, positive Logik" TAB_VERB "%6.3" "" COMPU_TAB_REF B_TRUE /end COMPU_METHOD
/begin COMPU_VTAB B_TRUE "boolsche Zust‰nde, positive Logik" TAB_VERB 2 0 "----" 1 "TRUE" /end COMPU_VTAB
/begin COMPU_METHOD DEZ "1 : 1 Umrechnug (dez/hex)" RAT_FUNC "%6.2" "" COEFFS 0 1 0 0 0 1 /end COMPU_METHOD
/begin COMPU_METHOD dez "1 : 1 Umrechnug (dez/hex)" RAT_FUNC "%6.2" "" COEFFS 0 1 0 0 0 1 /end COMPU_METHOD
/begin COMPU_METHOD default "" RAT_FUNC "%6.2" "" COEFFS 0 1 0 0 0 1 /end COMPU_METHOD
/begin RECORD_LAYOUT KwbUb FNC_VALUES 1 UBYTE COLUMN_DIR DIRECT /end RECORD_LAYOUT
/begin RECORD_LAYOUT KwbUw FNC_VALUES 1 UWORD COLUMN_DIR DIRECT /end RECORD_LAYOUT
/begin RECORD_LAYOUT KwbWU16 FNC_VALUES 1 UWORD COLUMN_DIR DIRECT /end RECORD_LAYOUT
/begin RECORD_LAYOUT KwbWU8 FNC_VALUES 1 UBYTE COLUMN_DIR DIRECT /end RECORD_LAYOUT
/begin RECORD_LAYOUT KwUb FNC_VALUES 1 UBYTE COLUMN_DIR DIRECT /end RECORD_LAYOUT
/begin RECORD_LAYOUT KwUw FNC_VALUES 1 UWORD COLUMN_DIR DIRECT /end RECORD_LAYOUT
/begin RECORD_LAYOUT KwWU16 FNC_VALUES 1 UWORD COLUMN_DIR DIRECT /end RECORD_LAYOUT
/begin RECORD_LAYOUT KwWU8 FNC_VALUES 1 UBYTE COLUMN_DIR DIRECT /end RECORD_LAYOUT
/end MODULE
/end PROJECT
