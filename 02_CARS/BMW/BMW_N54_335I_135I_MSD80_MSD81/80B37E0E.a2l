ASAP2_VERSION 1 41
/begin PROJECT MSD70 "Spray Guided DI-System with Piezo Injectors for 6-Cylinder"
/begin HEADER "_default_HeaderComment" PROJECT_NO _0B /end HEADER
/begin MODULE _default_ModuleName "_default_ModuleLongIdentifier"
/begin MOD_COMMON "_default_ModCommonComment" DEPOSIT ABSOLUTE BYTE_ORDER MSB_LAST ALIGNMENT_BYTE 1 ALIGNMENT_WORD 2 ALIGNMENT_LONG 2 ALIGNMENT_FLOAT32_IEEE 2 ALIGNMENT_FLOAT64_IEEE 4 /end MOD_COMMON
/begin CHARACTERISTIC c_lamb_delta_p_lam_adj_max "" VALUE 0xa1002bb0 _REC_VAL_20_s2 0.25 _CNV_A_R_LINEAR_____23_CM -0.125 0.125 DISPLAY_IDENTIFIER C_LAMB_DELTA_P_LAM_ADJ_MAX FORMAT "%8.5" /end CHARACTERISTIC
/begin MEASUREMENT lv_err_acr_dr "Present failure for power stage diagnosis after error debounce " UBYTE _CNV_S_2_RANGE__0___1_CM 1 100. 0. 1. DISPLAY_IDENTIFIER LV_ERR_ACR_DR ECU_ADDRESS 0xd00034ce BIT_MASK 0x1 /end MEASUREMENT
/begin CHARACTERISTIC c_abc_inc_acr_dr "Anti bounce counter increment for the power stage diagnosis" VALUE 0xa10010e2 _REC_VAL_20_u1 255. _CNV_A_R_LINEAR_____0_CM 0. 255. DISPLAY_IDENTIFIER C_ABC_INC_ACR_DR FORMAT "%3.0" /end CHARACTERISTIC
/begin CHARACTERISTIC c_abc_max_acr_dr "Maximum value for anti bounce counter for the power stage diagnosis" VALUE 0xa10010e5 _REC_VAL_20_u1 254. _CNV_A_R_LINEAR_____0_CM 1. 255. DISPLAY_IDENTIFIER C_ABC_MAX_ACR_DR FORMAT "%3.0" /end CHARACTERISTIC
/begin MEASUREMENT lv_inh_diag_acr_dr "Inhibition condition for the power stage diagnosis" UBYTE _CNV_S_2_RANGE__0___1_CM 1 100. 0. 1. DISPLAY_IDENTIFIER LV_INH_DIAG_ACR_DR ECU_ADDRESS 0xd0002cf1 BIT_MASK 0x1 /end MEASUREMENT
/begin CHARACTERISTIC c_vb_min_acr_dr_diag "Minimum threshold for the activation/deactivation of the power stage diagnosis" VALUE 0xa1001134 _REC_VAL_20_u1 25.8984375 _CNV_A_R_LINEAR_____289_CM 0. 25.8984375 DISPLAY_IDENTIFIER C_VB_MIN_ACR_DR_DIAG FORMAT "%9.6" /end CHARACTERISTIC
/begin MEASUREMENT av_open_egr "actual opening value of the EGR valve after adaptation" UBYTE _CNV_A_R_LINEAR_____5_CM 1 100. 0. 99.609375 DISPLAY_IDENTIFIER AV_OPEN_EGR ECU_ADDRESS 0xd0002cd8 FORMAT "%4.1" /end MEASUREMENT
/begin MEASUREMENT lv_err_egr_2 "stucked valve or potentiometer failed" UBYTE _CNV_S_2_RANGE__0___1_CM 1 100. 0. 1. DISPLAY_IDENTIFIER LV_ERR_EGR_2 ECU_ADDRESS 0xd0002cde BIT_MASK 0x1 /end MEASUREMENT
/begin MEASUREMENT stk_av_egr "actual value of the stroke of EGR value" UBYTE _CNV_A_R_LINEAR_____5_CM 1 100. 0. 99.609375 DISPLAY_IDENTIFIER STK_AV_EGR ECU_ADDRESS 0xd0002ce9 /end MEASUREMENT
/begin MEASUREMENT lv_er_fdout "" UBYTE _CNV_S_2_RANGE__0___1_CM 1 100. 0. 1. DISPLAY_IDENTIFIER LV_ER_FDOUT ECU_ADDRESS 0xd0002cdd /end MEASUREMENT
/begin MEASUREMENT lv_egr_act "Logical value for EGR-control active" UBYTE _CNV_S_2_RANGE__0___1_CM 1 100. 0. 1. DISPLAY_IDENTIFIER LV_EGR_ACT ECU_ADDRESS 0xd0002cdc /end MEASUREMENT
/begin MEASUREMENT opg_sp_req_acr "Actuator valve position setpoint request in normal operation" UWORD _CNV_A_R_ACRC_LINEA_813_CM 1 100. 0. 99.9755859375 DISPLAY_IDENTIFIER OPG_SP_REQ_ACR ECU_ADDRESS 0xd0002ce4 FORMAT "%5.2" /end MEASUREMENT
/begin MEASUREMENT egr_ratio_sp "EGR-Ratio Setpoint" UWORD _CNV_A_R_LINEAR_____7_CM 1 100. 0. 99.99847412109381 DISPLAY_IDENTIFIER EGR_RATIO_SP ECU_ADDRESS 0xd0002498 /end MEASUREMENT
/begin MEASUREMENT service_1_pid_1_diag "" UBYTE _CNV_A_R_LINEAR_____50_CM 1 100. 0. 255. DISPLAY_IDENTIFIER SERVICE_1_PID_1_DIAG ECU_ADDRESS 0xd000394c FORMAT "%3.0" /end MEASUREMENT
/begin CHARACTERISTIC c_service_1_pid_1_diag "Calibration byte which defines the PIDs supported by mode 01 (01h -08h)" VALUE 0xa102081b _REC_VAL_20_u1 255. _CNV_A_R_LINEAR_____0_CM 0. 255. DISPLAY_IDENTIFIER C_SERVICE_1_PID_1_DIAG FORMAT "%3.0" /end CHARACTERISTIC
/begin CHARACTERISTIC c_service_1_pid_2_diag "Calibration byte which defines the PIDs supported by mode 01 (09h -10h)" VALUE 0xa102081c _REC_VAL_20_u1 255. _CNV_A_R_LINEAR_____0_CM 0. 255. DISPLAY_IDENTIFIER C_SERVICE_1_PID_2_DIAG FORMAT "%3.0" /end CHARACTERISTIC
/begin CHARACTERISTIC c_service_1_pid_3_diag "Calibration byte which defines the PIDs supported by mode 01 (11h -18h)" VALUE 0xa102081d _REC_VAL_20_u1 255. _CNV_A_R_LINEAR_____0_CM 0. 255. DISPLAY_IDENTIFIER C_SERVICE_1_PID_3_DIAG FORMAT "%3.0" /end CHARACTERISTIC
/begin CHARACTERISTIC c_service_1_pid_4_diag "Calibration byte which defines the PIDs supported by mode 01 (19h -20h)" VALUE 0xa102081e _REC_VAL_20_u1 255. _CNV_A_R_LINEAR_____0_CM 0. 255. DISPLAY_IDENTIFIER C_SERVICE_1_PID_4_DIAG FORMAT "%3.0" /end CHARACTERISTIC
/begin CHARACTERISTIC c_service_1_pid_5_diag "Calibration byte which defines the PIDs supported by mode 01 (21h -28h)" VALUE 0xa102081f _REC_VAL_20_u1 255. _CNV_A_R_LINEAR_____0_CM 0. 255. DISPLAY_IDENTIFIER C_SERVICE_1_PID_5_DIAG FORMAT "%3.0" /end CHARACTERISTIC
/begin CHARACTERISTIC c_service_1_pid_6_diag "Calibration byte which defines the PIDs supported by mode 01 (29h -30h)" VALUE 0xa1020820 _REC_VAL_20_u1 255. _CNV_A_R_LINEAR_____0_CM 0. 255. DISPLAY_IDENTIFIER C_SERVICE_1_PID_6_DIAG FORMAT "%3.0" /end CHARACTERISTIC
/begin CHARACTERISTIC c_service_1_pid_7_diag "Calibration byte which defines the PIDs supported by mode 01 (31h -38h)" VALUE 0xa1020821 _REC_VAL_20_u1 255. _CNV_A_R_LINEAR_____0_CM 0. 255. DISPLAY_IDENTIFIER C_SERVICE_1_PID_7_DIAG FORMAT "%3.0" /end CHARACTERISTIC
/begin CHARACTERISTIC c_service_1_pid_8_diag "Calibration byte which defines the PIDs supported by mode 01 (39h -40h)" VALUE 0xa1020822 _REC_VAL_20_u1 255. _CNV_A_R_LINEAR_____0_CM 0. 255. DISPLAY_IDENTIFIER C_SERVICE_1_PID_8_DIAG FORMAT "%3.0" /end CHARACTERISTIC
/begin CHARACTERISTIC c_service_1_pid_9_diag "Calibration byte which defines the PIDs supported by mode 01 (39h -40h)" VALUE 0xa1020823 _REC_VAL_20_u1 255. _CNV_A_R_LINEAR_____0_CM 0. 255. DISPLAY_IDENTIFIER C_SERVICE_1_PID_9_DIAG FORMAT "%3.0" /end CHARACTERISTIC
/begin CHARACTERISTIC c_service_1_pid_A_diag "Calibration byte which defines the PIDs supported by mode 01 (39h -40h)" VALUE 0xa1020824 _REC_VAL_20_u1 255. _CNV_A_R_LINEAR_____0_CM 0. 255. DISPLAY_IDENTIFIER C_SERVICE_1_PID_A_DIAG FORMAT "%3.0" /end CHARACTERISTIC
/begin CHARACTERISTIC c_service_1_pid_B_diag "Calibration byte which defines the PIDs supported by mode 01 (39h -40h)" VALUE 0xa1020825 _REC_VAL_20_u1 255. _CNV_A_R_LINEAR_____0_CM 0. 255. DISPLAY_IDENTIFIER C_SERVICE_1_PID_B_DIAG FORMAT "%3.0" /end CHARACTERISTIC
/begin CHARACTERISTIC c_service_1_pid_C_diag "Calibration byte which defines the PIDs supported by mode 01 (39h -40h)" VALUE 0xa1020826 _REC_VAL_20_u1 255. _CNV_A_R_LINEAR_____0_CM 0. 255. DISPLAY_IDENTIFIER C_SERVICE_1_PID_C_DIAG FORMAT "%3.0" /end CHARACTERISTIC
/begin CHARACTERISTIC c_obd_req "byte wich indicates the OBD requirements" VALUE 0xa1020818 _REC_VAL_20_u1 255. _CNV_A_R_LINEAR_____0_CM 0. 255. DISPLAY_IDENTIFIER C_OBD_REQ FORMAT "%3.0" /end CHARACTERISTIC
/begin CHARACTERISTIC c_psn_ls "byte wich indicates the location of oxygen sensors" VALUE 0xa1020819 _REC_VAL_20_u1 255. _CNV_A_R_LINEAR_____0_CM 0. 255. DISPLAY_IDENTIFIER C_PSN_LS FORMAT "%3.0" /end CHARACTERISTIC
/begin CHARACTERISTIC c_psn_ls_1 "byte wich indicates the location of oxygen sensors" VALUE 0xa102081a _REC_VAL_20_u1 255. _CNV_A_R_LINEAR_____0_CM 0. 255. DISPLAY_IDENTIFIER C_PSN_LS_1 FORMAT "%3.0" /end CHARACTERISTIC
/begin CHARACTERISTIC lc_var_sap "byte wich indicates the location of oxygen sensors" VALUE 0xa1020857 _REC_VAL_20_u1 1. _CNV_A_R_LINEAR_____0_CM 0. 1. DISPLAY_IDENTIFIER LC_VAR_SAP FORMAT "%1.0" /end CHARACTERISTIC
/begin MEASUREMENT service_1_pid_2_diag "" UBYTE _CNV_A_R_LINEAR_____50_CM 1 100. 0. 255. DISPLAY_IDENTIFIER SERVICE_1_PID_2_DIAG ECU_ADDRESS 0xd000394d FORMAT "%3.0" /end MEASUREMENT
/begin MEASUREMENT service_1_pid_3_diag "" UBYTE _CNV_A_R_LINEAR_____50_CM 1 100. 0. 255. DISPLAY_IDENTIFIER SERVICE_1_PID_3_DIAG ECU_ADDRESS 0xd000394e FORMAT "%3.0" /end MEASUREMENT
/begin MEASUREMENT service_1_pid_4_diag "" UBYTE _CNV_A_R_LINEAR_____50_CM 1 100. 0. 255. DISPLAY_IDENTIFIER SERVICE_1_PID_4_DIAG ECU_ADDRESS 0xd000394f FORMAT "%3.0" /end MEASUREMENT
/begin CHARACTERISTIC c_service_2_pid_1_diag "Calibration byte which defines the PIDs supported by mode 02 (01h -08h)" VALUE 0xa1020827 _REC_VAL_20_u1 255. _CNV_A_R_LINEAR_____0_CM 0. 255. DISPLAY_IDENTIFIER C_SERVICE_2_PID_1_DIAG FORMAT "%3.0" /end CHARACTERISTIC
/begin CHARACTERISTIC c_service_2_pid_2_diag "Calibration byte which defines the PIDs supported by mode 02 (09h -10h)" VALUE 0xa1020828 _REC_VAL_20_u1 255. _CNV_A_R_LINEAR_____0_CM 0. 255. DISPLAY_IDENTIFIER C_SERVICE_2_PID_2_DIAG FORMAT "%3.0" /end CHARACTERISTIC
/begin CHARACTERISTIC c_service_2_pid_3_diag "Calibration byte which defines the PIDs supported by mode 02 (11h -18h)" VALUE 0xa1020829 _REC_VAL_20_u1 255. _CNV_A_R_LINEAR_____0_CM 0. 255. DISPLAY_IDENTIFIER C_SERVICE_2_PID_3_DIAG FORMAT "%3.0" /end CHARACTERISTIC
/begin CHARACTERISTIC c_service_2_pid_4_diag "Calibration byte which defines the PIDs supported by mode 02 (19h -20h)" VALUE 0xa102082a _REC_VAL_20_u1 255. _CNV_A_R_LINEAR_____0_CM 0. 255. DISPLAY_IDENTIFIER C_SERVICE_2_PID_4_DIAG FORMAT "%3.0" /end CHARACTERISTIC
/begin CHARACTERISTIC c_service_2_pid_5_diag "Calibration byte which defines the PIDs supported by mode 02 (19h -20h)" VALUE 0xa102082b _REC_VAL_20_u1 255. _CNV_A_R_LINEAR_____0_CM 0. 255. DISPLAY_IDENTIFIER C_SERVICE_2_PID_5_DIAG FORMAT "%3.0" /end CHARACTERISTIC
/begin CHARACTERISTIC c_service_2_pid_6_diag "Calibration byte which defines the PIDs supported by mode 02 (19h -20h)" VALUE 0xa102082c _REC_VAL_20_u1 255. _CNV_A_R_LINEAR_____0_CM 0. 255. DISPLAY_IDENTIFIER C_SERVICE_2_PID_6_DIAG FORMAT "%3.0" /end CHARACTERISTIC
/begin CHARACTERISTIC c_service_2_pid_7_diag "Calibration byte which defines the PIDs supported by mode 02 (19h -20h)" VALUE 0xa102082d _REC_VAL_20_u1 255. _CNV_A_R_LINEAR_____0_CM 0. 255. DISPLAY_IDENTIFIER C_SERVICE_2_PID_7_DIAG FORMAT "%3.0" /end CHARACTERISTIC
/begin CHARACTERISTIC c_service_2_pid_8_diag "Calibration byte which defines the PIDs supported by mode 02 (19h -20h)" VALUE 0xa102082e _REC_VAL_20_u1 255. _CNV_A_R_LINEAR_____0_CM 0. 255. DISPLAY_IDENTIFIER C_SERVICE_2_PID_8_DIAG FORMAT "%3.0" /end CHARACTERISTIC
/begin CHARACTERISTIC c_service_2_pid_9_diag "Calibration byte which defines the PIDs supported by mode 02 (19h -20h)" VALUE 0xa102082f _REC_VAL_20_u1 255. _CNV_A_R_LINEAR_____0_CM 0. 255. DISPLAY_IDENTIFIER C_SERVICE_2_PID_9_DIAG FORMAT "%3.0" /end CHARACTERISTIC
/begin CHARACTERISTIC c_service_2_pid_A_diag "Calibration byte which defines the PIDs supported by mode 02 (19h -20h)" VALUE 0xa1020830 _REC_VAL_20_u1 255. _CNV_A_R_LINEAR_____0_CM 0. 255. DISPLAY_IDENTIFIER C_SERVICE_2_PID_A_DIAG FORMAT "%3.0" /end CHARACTERISTIC
/begin CHARACTERISTIC c_service_2_pid_B_diag "Calibration byte which defines the PIDs supported by mode 02 (19h -20h)" VALUE 0xa1020831 _REC_VAL_20_u1 255. _CNV_A_R_LINEAR_____0_CM 0. 255. DISPLAY_IDENTIFIER C_SERVICE_2_PID_B_DIAG FORMAT "%3.0" /end CHARACTERISTIC
/begin CHARACTERISTIC c_service_2_pid_C_diag "Calibration byte which defines the PIDs supported by mode 02 (19h -20h)" VALUE 0xa1020832 _REC_VAL_20_u1 255. _CNV_A_R_LINEAR_____0_CM 0. 255. DISPLAY_IDENTIFIER C_SERVICE_2_PID_C_DIAG FORMAT "%3.0" /end CHARACTERISTIC
/begin MEASUREMENT service_2_pid_1_diag "" UBYTE _CNV_A_R_LINEAR_____50_CM 1 100. 0. 255. DISPLAY_IDENTIFIER SERVICE_2_PID_1_DIAG ECU_ADDRESS 0xd0003950 FORMAT "%3.0" /end MEASUREMENT
/begin MEASUREMENT service_2_pid_2_diag "" UBYTE _CNV_A_R_LINEAR_____50_CM 1 100. 0. 255. DISPLAY_IDENTIFIER SERVICE_2_PID_2_DIAG ECU_ADDRESS 0xd0003951 FORMAT "%3.0" /end MEASUREMENT
/begin MEASUREMENT service_2_pid_3_diag "" UBYTE _CNV_A_R_LINEAR_____50_CM 1 100. 0. 255. DISPLAY_IDENTIFIER SERVICE_2_PID_3_DIAG ECU_ADDRESS 0xd0003952 FORMAT "%3.0" /end MEASUREMENT
/begin MEASUREMENT service_2_pid_4_diag "" UBYTE _CNV_A_R_LINEAR_____50_CM 1 100. 0. 255. DISPLAY_IDENTIFIER SERVICE_2_PID_4_DIAG ECU_ADDRESS 0xd0003953 FORMAT "%3.0" /end MEASUREMENT
/begin CHARACTERISTIC c_service_6_obdmid_10_diag "Calibration byte which defines the PIDs supported by mode 02 (19h -20h)" VALUE 0xa1020833 _REC_VAL_20_u1 255. _CNV_A_R_LINEAR_____0_CM 0. 255. DISPLAY_IDENTIFIER C_SERVICE_6_OBDMID_10_DIAG FORMAT "%3.0" /end CHARACTERISTIC
/begin CHARACTERISTIC c_service_6_obdmid_11_diag "Calibration byte which defines the PIDs supported by mode 02 (19h -20h)" VALUE 0xa1020834 _REC_VAL_20_u1 255. _CNV_A_R_LINEAR_____0_CM 0. 255. DISPLAY_IDENTIFIER C_SERVICE_6_OBDMID_11_DIAG FORMAT "%3.0" /end CHARACTERISTIC
/begin CHARACTERISTIC c_service_6_obdmid_12_diag "Calibration byte which defines the PIDs supported by mode 02 (19h -20h)" VALUE 0xa1020835 _REC_VAL_20_u1 255. _CNV_A_R_LINEAR_____0_CM 0. 255. DISPLAY_IDENTIFIER C_SERVICE_6_OBDMID_12_DIAG FORMAT "%3.0" /end CHARACTERISTIC
/begin CHARACTERISTIC c_service_6_obdmid_13_diag "Calibration byte which defines the PIDs supported by mode 02 (19h -20h)" VALUE 0xa1020836 _REC_VAL_20_u1 255. _CNV_A_R_LINEAR_____0_CM 0. 255. DISPLAY_IDENTIFIER C_SERVICE_6_OBDMID_13_DIAG FORMAT "%3.0" /end CHARACTERISTIC
/begin CHARACTERISTIC c_service_6_obdmid_14_diag "Calibration byte which defines the PIDs supported by mode 02 (19h -20h)" VALUE 0xa1020837 _REC_VAL_20_u1 255. _CNV_A_R_LINEAR_____0_CM 0. 255. DISPLAY_IDENTIFIER C_SERVICE_6_OBDMID_14_DIAG FORMAT "%3.0" /end CHARACTERISTIC
/begin CHARACTERISTIC c_service_6_obdmid_15_diag "Calibration byte which defines the PIDs supported by mode 02 (19h -20h)" VALUE 0xa1020838 _REC_VAL_20_u1 255. _CNV_A_R_LINEAR_____0_CM 0. 255. DISPLAY_IDENTIFIER C_SERVICE_6_OBDMID_15_DIAG FORMAT "%3.0" /end CHARACTERISTIC
/begin CHARACTERISTIC c_service_6_obdmid_16_diag "Calibration byte which defines the PIDs supported by mode 02 (19h -20h)" VALUE 0xa1020839 _REC_VAL_20_u1 255. _CNV_A_R_LINEAR_____0_CM 0. 255. DISPLAY_IDENTIFIER C_SERVICE_6_OBDMID_16_DIAG FORMAT "%3.0" /end CHARACTERISTIC
/begin CHARACTERISTIC c_service_6_obdmid_17_diag "Calibration byte which defines the PIDs supported by mode 02 (19h -20h)" VALUE 0xa102083a _REC_VAL_20_u1 255. _CNV_A_R_LINEAR_____0_CM 0. 255. DISPLAY_IDENTIFIER C_SERVICE_6_OBDMID_17_DIAG FORMAT "%3.0" /end CHARACTERISTIC
/begin CHARACTERISTIC c_service_6_obdmid_18_diag "Calibration byte which defines the PIDs supported by mode 02 (19h -20h)" VALUE 0xa102083b _REC_VAL_20_u1 255. _CNV_A_R_LINEAR_____0_CM 0. 255. DISPLAY_IDENTIFIER C_SERVICE_6_OBDMID_18_DIAG FORMAT "%3.0" /end CHARACTERISTIC
/begin CHARACTERISTIC c_service_6_obdmid_19_diag "Calibration byte which defines the PIDs supported by mode 02 (19h -20h)" VALUE 0xa102083c _REC_VAL_20_u1 255. _CNV_A_R_LINEAR_____0_CM 0. 255. DISPLAY_IDENTIFIER C_SERVICE_6_OBDMID_19_DIAG FORMAT "%3.0" /end CHARACTERISTIC
/begin CHARACTERISTIC c_service_6_obdmid_1_diag "Calibration byte which defines the PIDs supported by mode 02 (19h -20h)" VALUE 0xa102083d _REC_VAL_20_u1 255. _CNV_A_R_LINEAR_____0_CM 0. 255. DISPLAY_IDENTIFIER C_SERVICE_6_OBDMID_1_DIAG FORMAT "%3.0" /end CHARACTERISTIC
/begin CHARACTERISTIC c_service_6_obdmid_20_diag "Calibration byte which defines the PIDs supported by mode 02 (19h -20h)" VALUE 0xa102083e _REC_VAL_20_u1 255. _CNV_A_R_LINEAR_____0_CM 0. 255. DISPLAY_IDENTIFIER C_SERVICE_6_OBDMID_20_DIAG FORMAT "%3.0" /end CHARACTERISTIC
/begin CHARACTERISTIC c_service_6_obdmid_21_diag "Calibration byte which defines the PIDs supported by mode 02 (19h -20h)" VALUE 0xa102083f _REC_VAL_20_u1 255. _CNV_A_R_LINEAR_____0_CM 0. 255. DISPLAY_IDENTIFIER C_SERVICE_6_OBDMID_21_DIAG FORMAT "%3.0" /end CHARACTERISTIC
/begin CHARACTERISTIC c_service_6_obdmid_22_diag "Calibration byte which defines the PIDs supported by mode 02 (19h -20h)" VALUE 0xa1020840 _REC_VAL_20_u1 255. _CNV_A_R_LINEAR_____0_CM 0. 255. DISPLAY_IDENTIFIER C_SERVICE_6_OBDMID_22_DIAG FORMAT "%3.0" /end CHARACTERISTIC
/begin CHARACTERISTIC c_service_6_obdmid_23_diag "Calibration byte which defines the PIDs supported by mode 02 (19h -20h)" VALUE 0xa1020841 _REC_VAL_20_u1 255. _CNV_A_R_LINEAR_____0_CM 0. 255. DISPLAY_IDENTIFIER C_SERVICE_6_OBDMID_23_DIAG FORMAT "%3.0" /end CHARACTERISTIC
/begin CHARACTERISTIC c_service_6_obdmid_24_diag "Calibration byte which defines the PIDs supported by mode 02 (19h -20h)" VALUE 0xa1020842 _REC_VAL_20_u1 255. _CNV_A_R_LINEAR_____0_CM 0. 255. DISPLAY_IDENTIFIER C_SERVICE_6_OBDMID_24_DIAG FORMAT "%3.0" /end CHARACTERISTIC
/begin CHARACTERISTIC c_service_6_obdmid_25_diag "Calibration byte which defines the PIDs supported by mode 02 (19h -20h)" VALUE 0xa1020843 _REC_VAL_20_u1 255. _CNV_A_R_LINEAR_____0_CM 0. 255. DISPLAY_IDENTIFIER C_SERVICE_6_OBDMID_25_DIAG FORMAT "%3.0" /end CHARACTERISTIC
/begin CHARACTERISTIC c_service_6_obdmid_26_diag "Calibration byte which defines the PIDs supported by mode 02 (19h -20h)" VALUE 0xa1020844 _REC_VAL_20_u1 255. _CNV_A_R_LINEAR_____0_CM 0. 255. DISPLAY_IDENTIFIER C_SERVICE_6_OBDMID_26_DIAG FORMAT "%3.0" /end CHARACTERISTIC
/begin CHARACTERISTIC c_service_6_obdmid_27_diag "Calibration byte which defines the PIDs supported by mode 02 (19h -20h)" VALUE 0xa1020845 _REC_VAL_20_u1 255. _CNV_A_R_LINEAR_____0_CM 0. 255. DISPLAY_IDENTIFIER C_SERVICE_6_OBDMID_27_DIAG FORMAT "%3.0" /end CHARACTERISTIC
/begin CHARACTERISTIC c_service_6_obdmid_28_diag "Calibration byte which defines the PIDs supported by mode 02 (19h -20h)" VALUE 0xa1020846 _REC_VAL_20_u1 255. _CNV_A_R_LINEAR_____0_CM 0. 255. DISPLAY_IDENTIFIER C_SERVICE_6_OBDMID_28_DIAG FORMAT "%3.0" /end CHARACTERISTIC
/begin CHARACTERISTIC c_service_6_obdmid_2_diag "Calibration byte which defines the PIDs supported by mode 02 (19h -20h)" VALUE 0xa1020847 _REC_VAL_20_u1 255. _CNV_A_R_LINEAR_____0_CM 0. 255. DISPLAY_IDENTIFIER C_SERVICE_6_OBDMID_2_DIAG FORMAT "%3.0" /end CHARACTERISTIC
/begin CHARACTERISTIC c_service_6_obdmid_3_diag "Calibration byte which defines the PIDs supported by mode 02 (19h -20h)" VALUE 0xa1020848 _REC_VAL_20_u1 255. _CNV_A_R_LINEAR_____0_CM 0. 255. DISPLAY_IDENTIFIER C_SERVICE_6_OBDMID_3_DIAG FORMAT "%3.0" /end CHARACTERISTIC
/begin CHARACTERISTIC c_service_6_obdmid_4_diag "Calibration byte which defines the PIDs supported by mode 02 (19h -20h)" VALUE 0xa1020849 _REC_VAL_20_u1 255. _CNV_A_R_LINEAR_____0_CM 0. 255. DISPLAY_IDENTIFIER C_SERVICE_6_OBDMID_4_DIAG FORMAT "%3.0" /end CHARACTERISTIC
/begin CHARACTERISTIC c_service_6_obdmid_5_diag "Calibration byte which defines the PIDs supported by mode 02 (19h -20h)" VALUE 0xa102084a _REC_VAL_20_u1 255. _CNV_A_R_LINEAR_____0_CM 0. 255. DISPLAY_IDENTIFIER C_SERVICE_6_OBDMID_5_DIAG FORMAT "%3.0" /end CHARACTERISTIC
/begin CHARACTERISTIC c_service_6_obdmid_6_diag "Calibration byte which defines the PIDs supported by mode 02 (19h -20h)" VALUE 0xa102084b _REC_VAL_20_u1 255. _CNV_A_R_LINEAR_____0_CM 0. 255. DISPLAY_IDENTIFIER C_SERVICE_6_OBDMID_6_DIAG FORMAT "%3.0" /end CHARACTERISTIC
/begin CHARACTERISTIC c_service_6_obdmid_7_diag "Calibration byte which defines the PIDs supported by mode 02 (19h -20h)" VALUE 0xa102084c _REC_VAL_20_u1 255. _CNV_A_R_LINEAR_____0_CM 0. 255. DISPLAY_IDENTIFIER C_SERVICE_6_OBDMID_7_DIAG FORMAT "%3.0" /end CHARACTERISTIC
/begin CHARACTERISTIC c_service_6_obdmid_8_diag "Calibration byte which defines the PIDs supported by mode 02 (19h -20h)" VALUE 0xa102084d _REC_VAL_20_u1 255. _CNV_A_R_LINEAR_____0_CM 0. 255. DISPLAY_IDENTIFIER C_SERVICE_6_OBDMID_8_DIAG FORMAT "%3.0" /end CHARACTERISTIC
/begin CHARACTERISTIC c_service_6_obdmid_9_diag "Calibration byte which defines the PIDs supported by mode 02 (19h -20h)" VALUE 0xa102084e _REC_VAL_20_u1 255. _CNV_A_R_LINEAR_____0_CM 0. 255. DISPLAY_IDENTIFIER C_SERVICE_6_OBDMID_9_DIAG FORMAT "%3.0" /end CHARACTERISTIC
/begin MEASUREMENT service_6_obdmid_1_diag "" UBYTE _CNV_A_R_LINEAR_____50_CM 1 100. 0. 255. DISPLAY_IDENTIFIER SERVICE_6_OBDMID_1_DIAG ECU_ADDRESS 0xd0003954 FORMAT "%3.0" /end MEASUREMENT
/begin MEASUREMENT service_6_obdmid_2_diag "" UBYTE _CNV_A_R_LINEAR_____50_CM 1 100. 0. 255. DISPLAY_IDENTIFIER SERVICE_6_OBDMID_2_DIAG ECU_ADDRESS 0xd0003955 FORMAT "%3.0" /end MEASUREMENT
/begin MEASUREMENT service_6_obdmid_3_diag "" UBYTE _CNV_A_R_LINEAR_____50_CM 1 100. 0. 255. DISPLAY_IDENTIFIER SERVICE_6_OBDMID_3_DIAG ECU_ADDRESS 0xd0003956 FORMAT "%3.0" /end MEASUREMENT
/begin MEASUREMENT service_6_obdmid_4_diag "" UBYTE _CNV_A_R_LINEAR_____50_CM 1 100. 0. 255. DISPLAY_IDENTIFIER SERVICE_6_OBDMID_4_DIAG ECU_ADDRESS 0xd0003957 FORMAT "%3.0" /end MEASUREMENT
/begin MEASUREMENT service_6_obdmid_5_diag "" UBYTE _CNV_A_R_LINEAR_____50_CM 1 100. 0. 255. DISPLAY_IDENTIFIER SERVICE_6_OBDMID_5_DIAG ECU_ADDRESS 0xd0003958 FORMAT "%3.0" /end MEASUREMENT
/begin MEASUREMENT service_6_obdmid_6_diag "" UBYTE _CNV_A_R_LINEAR_____50_CM 1 100. 0. 255. DISPLAY_IDENTIFIER SERVICE_6_OBDMID_6_DIAG ECU_ADDRESS 0xd0003959 FORMAT "%3.0" /end MEASUREMENT
/begin MEASUREMENT service_6_obdmid_7_diag "" UBYTE _CNV_A_R_LINEAR_____50_CM 1 100. 0. 255. DISPLAY_IDENTIFIER SERVICE_6_OBDMID_7_DIAG ECU_ADDRESS 0xd000395a FORMAT "%3.0" /end MEASUREMENT
/begin MEASUREMENT service_6_obdmid_8_diag "" UBYTE _CNV_A_R_LINEAR_____50_CM 1 100. 0. 255. DISPLAY_IDENTIFIER SERVICE_6_OBDMID_8_DIAG ECU_ADDRESS 0xd000395b FORMAT "%3.0" /end MEASUREMENT
/begin MEASUREMENT service_6_obdmid_9_diag "" UBYTE _CNV_A_R_LINEAR_____50_CM 1 100. 0. 255. DISPLAY_IDENTIFIER SERVICE_6_OBDMID_9_DIAG ECU_ADDRESS 0xd000395c FORMAT "%3.0" /end MEASUREMENT
/begin MEASUREMENT service_6_obdmid_10_diag "" UBYTE _CNV_A_R_LINEAR_____50_CM 1 100. 0. 255. DISPLAY_IDENTIFIER SERVICE_6_OBDMID_10_DIAG ECU_ADDRESS 0xd000395d FORMAT "%3.0" /end MEASUREMENT
/begin MEASUREMENT service_6_obdmid_11_diag "" UBYTE _CNV_A_R_LINEAR_____50_CM 1 100. 0. 255. DISPLAY_IDENTIFIER SERVICE_6_OBDMID_11_DIAG ECU_ADDRESS 0xd000395e FORMAT "%3.0" /end MEASUREMENT
/begin MEASUREMENT service_6_obdmid_12_diag "" UBYTE _CNV_A_R_LINEAR_____50_CM 1 100. 0. 255. DISPLAY_IDENTIFIER SERVICE_6_OBDMID_12_DIAG ECU_ADDRESS 0xd000395f FORMAT "%3.0" /end MEASUREMENT
/begin MEASUREMENT service_6_obdmid_13_diag "" UBYTE _CNV_A_R_LINEAR_____50_CM 1 100. 0. 255. DISPLAY_IDENTIFIER SERVICE_6_OBDMID_13_DIAG ECU_ADDRESS 0xd0003960 FORMAT "%3.0" /end MEASUREMENT
/begin MEASUREMENT service_6_obdmid_14_diag "" UBYTE _CNV_A_R_LINEAR_____50_CM 1 100. 0. 255. DISPLAY_IDENTIFIER SERVICE_6_OBDMID_14_DIAG ECU_ADDRESS 0xd0003961 FORMAT "%3.0" /end MEASUREMENT
/begin MEASUREMENT service_6_obdmid_15_diag "" UBYTE _CNV_A_R_LINEAR_____50_CM 1 100. 0. 255. DISPLAY_IDENTIFIER SERVICE_6_OBDMID_15_DIAG ECU_ADDRESS 0xd0003962 FORMAT "%3.0" /end MEASUREMENT
/begin MEASUREMENT service_6_obdmid_16_diag "" UBYTE _CNV_A_R_LINEAR_____50_CM 1 100. 0. 255. DISPLAY_IDENTIFIER SERVICE_6_OBDMID_16_DIAG ECU_ADDRESS 0xd0003963 FORMAT "%3.0" /end MEASUREMENT
/begin MEASUREMENT service_6_obdmid_17_diag "" UBYTE _CNV_A_R_LINEAR_____50_CM 1 100. 0. 255. DISPLAY_IDENTIFIER SERVICE_6_OBDMID_17_DIAG ECU_ADDRESS 0xd0003964 FORMAT "%3.0" /end MEASUREMENT
/begin MEASUREMENT service_6_obdmid_18_diag "" UBYTE _CNV_A_R_LINEAR_____50_CM 1 100. 0. 255. DISPLAY_IDENTIFIER SERVICE_6_OBDMID_18_DIAG ECU_ADDRESS 0xd0003965 FORMAT "%3.0" /end MEASUREMENT
/begin MEASUREMENT service_6_obdmid_19_diag "" UBYTE _CNV_A_R_LINEAR_____50_CM 1 100. 0. 255. DISPLAY_IDENTIFIER SERVICE_6_OBDMID_19_DIAG ECU_ADDRESS 0xd0003966 FORMAT "%3.0" /end MEASUREMENT
/begin MEASUREMENT service_6_obdmid_20_diag "" UBYTE _CNV_A_R_LINEAR_____50_CM 1 100. 0. 255. DISPLAY_IDENTIFIER SERVICE_6_OBDMID_20_DIAG ECU_ADDRESS 0xd0003967 FORMAT "%3.0" /end MEASUREMENT
/begin MEASUREMENT service_6_obdmid_21_diag "" UBYTE _CNV_A_R_LINEAR_____50_CM 1 100. 0. 255. DISPLAY_IDENTIFIER SERVICE_6_OBDMID_21_DIAG ECU_ADDRESS 0xd0003968 FORMAT "%3.0" /end MEASUREMENT
/begin MEASUREMENT service_6_obdmid_22_diag "" UBYTE _CNV_A_R_LINEAR_____50_CM 1 100. 0. 255. DISPLAY_IDENTIFIER SERVICE_6_OBDMID_22_DIAG ECU_ADDRESS 0xd0003969 FORMAT "%3.0" /end MEASUREMENT
/begin MEASUREMENT service_6_obdmid_23_diag "" UBYTE _CNV_A_R_LINEAR_____50_CM 1 100. 0. 255. DISPLAY_IDENTIFIER SERVICE_6_OBDMID_23_DIAG ECU_ADDRESS 0xd000396a FORMAT "%3.0" /end MEASUREMENT
/begin MEASUREMENT service_6_obdmid_24_diag "" UBYTE _CNV_A_R_LINEAR_____50_CM 1 100. 0. 255. DISPLAY_IDENTIFIER SERVICE_6_OBDMID_24_DIAG ECU_ADDRESS 0xd000396b FORMAT "%3.0" /end MEASUREMENT
/begin MEASUREMENT service_6_obdmid_25_diag "" UBYTE _CNV_A_R_LINEAR_____50_CM 1 100. 0. 255. DISPLAY_IDENTIFIER SERVICE_6_OBDMID_25_DIAG ECU_ADDRESS 0xd000396c FORMAT "%3.0" /end MEASUREMENT
/begin MEASUREMENT service_6_obdmid_26_diag "" UBYTE _CNV_A_R_LINEAR_____50_CM 1 100. 0. 255. DISPLAY_IDENTIFIER SERVICE_6_OBDMID_26_DIAG ECU_ADDRESS 0xd000396d FORMAT "%3.0" /end MEASUREMENT
/begin MEASUREMENT service_6_obdmid_27_diag "" UBYTE _CNV_A_R_LINEAR_____50_CM 1 100. 0. 255. DISPLAY_IDENTIFIER SERVICE_6_OBDMID_27_DIAG ECU_ADDRESS 0xd000396e FORMAT "%3.0" /end MEASUREMENT
/begin MEASUREMENT service_6_obdmid_28_diag "" UBYTE _CNV_A_R_LINEAR_____50_CM 1 100. 0. 255. DISPLAY_IDENTIFIER SERVICE_6_OBDMID_28_DIAG ECU_ADDRESS 0xd000396f FORMAT "%3.0" /end MEASUREMENT
/begin CHARACTERISTIC c_service_8_tid_1_diag_c "Calibration byte which defines the PIDs supported by mode 02 (19h -20h)" VALUE 0xa102084f _REC_VAL_20_u1 255. _CNV_A_R_LINEAR_____0_CM 0. 255. DISPLAY_IDENTIFIER C_SERVICE_8_TID_1_DIAG_C FORMAT "%3.0" /end CHARACTERISTIC
/begin CHARACTERISTIC c_service_8_tid_2_diag_c "Calibration byte which defines the PIDs supported by mode 02 (19h -20h)" VALUE 0xa1020850 _REC_VAL_20_u1 255. _CNV_A_R_LINEAR_____0_CM 0. 255. DISPLAY_IDENTIFIER C_SERVICE_8_TID_2_DIAG_C FORMAT "%3.0" /end CHARACTERISTIC
/begin CHARACTERISTIC c_service_8_tid_3_diag_c "Calibration byte which defines the PIDs supported by mode 02 (19h -20h)" VALUE 0xa1020851 _REC_VAL_20_u1 255. _CNV_A_R_LINEAR_____0_CM 0. 255. DISPLAY_IDENTIFIER C_SERVICE_8_TID_3_DIAG_C FORMAT "%3.0" /end CHARACTERISTIC
/begin CHARACTERISTIC c_service_8_tid_4_diag_c "Calibration byte which defines the PIDs supported by mode 02 (19h -20h)" VALUE 0xa1020852 _REC_VAL_20_u1 255. _CNV_A_R_LINEAR_____0_CM 0. 255. DISPLAY_IDENTIFIER C_SERVICE_8_TID_4_DIAG_C FORMAT "%3.0" /end CHARACTERISTIC
/begin MEASUREMENT service_8_tid_1_diag_c "" UBYTE _CNV_A_R_LINEAR_____50_CM 1 100. 0. 255. DISPLAY_IDENTIFIER SERVICE_8_TID_1_DIAG_C ECU_ADDRESS 0xd0003970 FORMAT "%3.0" /end MEASUREMENT
/begin MEASUREMENT service_8_tid_2_diag_c "" UBYTE _CNV_A_R_LINEAR_____50_CM 1 100. 0. 255. DISPLAY_IDENTIFIER SERVICE_8_TID_2_DIAG_C ECU_ADDRESS 0xd0003971 FORMAT "%3.0" /end MEASUREMENT
/begin MEASUREMENT service_8_tid_3_diag_c "" UBYTE _CNV_A_R_LINEAR_____50_CM 1 100. 0. 255. DISPLAY_IDENTIFIER SERVICE_8_TID_3_DIAG_C ECU_ADDRESS 0xd0003972 FORMAT "%3.0" /end MEASUREMENT
/begin MEASUREMENT service_8_tid_4_diag_c "" UBYTE _CNV_A_R_LINEAR_____50_CM 1 100. 0. 255. DISPLAY_IDENTIFIER SERVICE_8_TID_4_DIAG_C ECU_ADDRESS 0xd0003973 FORMAT "%3.0" /end MEASUREMENT
/begin CHARACTERISTIC c_service_9_infotype_1_diag_c "Calibration byte which defines the PIDs supported by mode 02 (19h -20h)" VALUE 0xa1020853 _REC_VAL_20_u1 255. _CNV_A_R_LINEAR_____0_CM 0. 255. DISPLAY_IDENTIFIER C_SERVICE_9_INFOTYPE_1_DIAG_C FORMAT "%3.0" /end CHARACTERISTIC
/begin CHARACTERISTIC c_service_9_infotype_2_diag_c "Calibration byte which defines the PIDs supported by mode 02 (19h -20h)" VALUE 0xa1020854 _REC_VAL_20_u1 255. _CNV_A_R_LINEAR_____0_CM 0. 255. DISPLAY_IDENTIFIER C_SERVICE_9_INFOTYPE_2_DIAG_C FORMAT "%3.0" /end CHARACTERISTIC
/begin CHARACTERISTIC c_service_9_infotype_3_diag_c "Calibration byte which defines the PIDs supported by mode 02 (19h -20h)" VALUE 0xa1020855 _REC_VAL_20_u1 255. _CNV_A_R_LINEAR_____0_CM 0. 255. DISPLAY_IDENTIFIER C_SERVICE_9_INFOTYPE_3_DIAG_C FORMAT "%3.0" /end CHARACTERISTIC
/begin CHARACTERISTIC c_service_9_infotype_4_diag_c "Calibration byte which defines the PIDs supported by mode 02 (19h -20h)" VALUE 0xa1020856 _REC_VAL_20_u1 255. _CNV_A_R_LINEAR_____0_CM 0. 255. DISPLAY_IDENTIFIER C_SERVICE_9_INFOTYPE_4_DIAG_C FORMAT "%3.0" /end CHARACTERISTIC
/begin MEASUREMENT service_9_infotype_1_diag_c "" UBYTE _CNV_A_R_LINEAR_____50_CM 1 100. 0. 255. DISPLAY_IDENTIFIER SERVICE_9_INFOTYPE_1_DIAG_C ECU_ADDRESS 0xd0003974 FORMAT "%3.0" /end MEASUREMENT
/begin MEASUREMENT service_9_infotype_2_diag_c "" UBYTE _CNV_A_R_LINEAR_____50_CM 1 100. 0. 255. DISPLAY_IDENTIFIER SERVICE_9_INFOTYPE_2_DIAG_C ECU_ADDRESS 0xd0003975 FORMAT "%3.0" /end MEASUREMENT
/begin MEASUREMENT service_9_infotype_3_diag_c "" UBYTE _CNV_A_R_LINEAR_____50_CM 1 100. 0. 255. DISPLAY_IDENTIFIER SERVICE_9_INFOTYPE_3_DIAG_C ECU_ADDRESS 0xd0003976 FORMAT "%3.0" /end MEASUREMENT
/begin MEASUREMENT service_9_infotype_4_diag_c "" UBYTE _CNV_A_R_LINEAR_____50_CM 1 100. 0. 255. DISPLAY_IDENTIFIER SERVICE_9_INFOTYPE_4_DIAG_C ECU_ADDRESS 0xd0003977 FORMAT "%3.0" /end MEASUREMENT
/begin MEASUREMENT td_igc[0] "dwell time duration" UWORD _CNV_A_R_LINEAR_____111_CM 1 100. 0. 262.14 DISPLAY_IDENTIFIER TD_IGC[0] ECU_ADDRESS 0xd00024cc FORMAT "%7.3" /end MEASUREMENT
/begin MEASUREMENT td_igc[1] "dwell time duration" UWORD _CNV_A_R_LINEAR_____111_CM 1 100. 0. 262.14 DISPLAY_IDENTIFIER TD_IGC[1] ECU_ADDRESS 0xd00024ce FORMAT "%7.3" /end MEASUREMENT
/begin MEASUREMENT td_igc[2] "dwell time duration" UWORD _CNV_A_R_LINEAR_____111_CM 1 100. 0. 262.14 DISPLAY_IDENTIFIER TD_IGC[2] ECU_ADDRESS 0xd00024d0 FORMAT "%7.3" /end MEASUREMENT
/begin MEASUREMENT td_igc[3] "dwell time duration" UWORD _CNV_A_R_LINEAR_____111_CM 1 100. 0. 262.14 DISPLAY_IDENTIFIER TD_IGC[3] ECU_ADDRESS 0xd00024d2 FORMAT "%7.3" /end MEASUREMENT
/begin MEASUREMENT td_igc[4] "dwell time duration" UWORD _CNV_A_R_LINEAR_____111_CM 1 100. 0. 262.14 DISPLAY_IDENTIFIER TD_IGC[4] ECU_ADDRESS 0xd00024d4 FORMAT "%7.3" /end MEASUREMENT
/begin MEASUREMENT td_igc[5] "dwell time duration" UWORD _CNV_A_R_LINEAR_____111_CM 1 100. 0. 262.14 DISPLAY_IDENTIFIER TD_IGC[5] ECU_ADDRESS 0xd00024d6 FORMAT "%7.3" /end MEASUREMENT
/begin MEASUREMENT iga_igc_h_rng[0] "Ignition angle (high range) of cylinder x" SWORD _CNV_A_R_LINEAR_____166_CM 1 100. -90. 90. DISPLAY_IDENTIFIER IGA_IGC_H_RNG[0] ECU_ADDRESS 0xd00024bc FORMAT "%8.4" /end MEASUREMENT
/begin MEASUREMENT iga_igc_h_rng[1] "Ignition angle (high range) of cylinder x" SWORD _CNV_A_R_LINEAR_____166_CM 1 100. -90. 90. DISPLAY_IDENTIFIER IGA_IGC_H_RNG[1] ECU_ADDRESS 0xd00024be FORMAT "%8.4" /end MEASUREMENT
/begin MEASUREMENT iga_igc_h_rng[2] "Ignition angle (high range) of cylinder x" SWORD _CNV_A_R_LINEAR_____166_CM 1 100. -90. 90. DISPLAY_IDENTIFIER IGA_IGC_H_RNG[2] ECU_ADDRESS 0xd00024c0 FORMAT "%8.4" /end MEASUREMENT
/begin MEASUREMENT iga_igc_h_rng[3] "Ignition angle (high range) of cylinder x" SWORD _CNV_A_R_LINEAR_____166_CM 1 100. -90. 90. DISPLAY_IDENTIFIER IGA_IGC_H_RNG[3] ECU_ADDRESS 0xd00024c2 FORMAT "%8.4" /end MEASUREMENT
/begin MEASUREMENT iga_igc_h_rng[4] "Ignition angle (high range) of cylinder x" SWORD _CNV_A_R_LINEAR_____166_CM 1 100. -90. 90. DISPLAY_IDENTIFIER IGA_IGC_H_RNG[4] ECU_ADDRESS 0xd00024c4 FORMAT "%8.4" /end MEASUREMENT
/begin MEASUREMENT iga_igc_h_rng[5] "Ignition angle (high range) of cylinder x" SWORD _CNV_A_R_LINEAR_____166_CM 1 100. -90. 90. DISPLAY_IDENTIFIER IGA_IGC_H_RNG[5] ECU_ADDRESS 0xd00024c6 FORMAT "%8.4" /end MEASUREMENT
/begin MEASUREMENT inh_igc "Inhibition of selected cylinder" UBYTE _CNV_A_R_LINEAR_____0_CM 1 100. 0. 255. DISPLAY_IDENTIFIER INH_IGC ECU_ADDRESS 0xd0002cfa FORMAT "%3.0" /end MEASUREMENT
/begin MEASUREMENT lv_td_mpl_spc_ign_act "Activation of the 2° ignition event using modified extended MPL" UBYTE _CNV_S_2_RANGE__0___1_CM 1 100. 0. 1. DISPLAY_IDENTIFIER LV_TD_MPL_SPC_IGN_ACT ECU_ADDRESS 0xd0002d1a BIT_MASK 0x1 /end MEASUREMENT
/begin CHARACTERISTIC lc_td_mpl_spc_ign_act "Calibration for activation control of 2° ignition event using modified extended MPL to switch off" VALUE 0xa10015d4 _REC_VAL_20_u1 1. _CNV_S_2_RANGE__0___1_CM 0. 1. DISPLAY_IDENTIFIER LC_TD_MPL_SPC_IGN_ACT /end CHARACTERISTIC
/begin CHARACTERISTIC c_n_max_mpl_spc_ign_act "Maximum engine speed for 2° ignition event activation" VALUE 0xa10015b2 _REC_VAL_20_u1 8160. _CNV_A_R_LINEAR_____9_CM 0. 8160. DISPLAY_IDENTIFIER C_N_MAX_MPL_SPC_IGN_ACT FORMAT "%4.0" /end CHARACTERISTIC
/begin MEASUREMENT igc_diag_mis "Non filtered error information for misfire detection" UBYTE _CNV_A_R_LINEAR_____0_CM 1 100. 0. 255. DISPLAY_IDENTIFIER IGC_DIAG_MIS ECU_ADDRESS 0xd0002cf8 FORMAT "%3.0" /end MEASUREMENT
/begin CHARACTERISTIC c_abc_igc_scp "Value of anti-bounce counter after regeneration cycle Typical value for debug = 128" VALUE 0xa10015a4 _REC_VAL_20_u1 255. _CNV_A_R_LINEAR_____0_CM 0. 255. DISPLAY_IDENTIFIER C_ABC_IGC_SCP FORMAT "%3.0" /end CHARACTERISTIC
/begin CHARACTERISTIC c_iga_off_cycnr_hld "Duration for regeneration cycle recurrence number ; coil has been switched off - - typical value for debug = 16" VALUE 0xa10015ac _REC_VAL_20_u1 255. _CNV_A_R_LINEAR_____0_CM 0. 255. DISPLAY_IDENTIFIER C_IGA_OFF_CYCNR_HLD FORMAT "%3.0" /end CHARACTERISTIC
/begin CHARACTERISTIC c_sum_igc_scp "Number of cycles before switching off the coil until reset - - typical value for debug = 255" VALUE 0xa10015b8 _REC_VAL_20_u1 255. _CNV_A_R_LINEAR_____0_CM 0. 255. DISPLAY_IDENTIFIER C_SUM_IGC_SCP FORMAT "%3.0" /end CHARACTERISTIC
/begin CHARACTERISTIC c_esb_ign_cut_diag "C_ESB_IGN_CUT_DIAG = 0 will inhibit the function - - typical value for debug = 0" VALUE 0xa10015ab _REC_VAL_20_u1 1. _CNV_S_2_RANGE__0___1_CM 0. 1. DISPLAY_IDENTIFIER C_ESB_IGN_CUT_DIAG /end CHARACTERISTIC
/begin CHARACTERISTIC c_abc_inc_igc_ol "Anti - bounce counter increment for ignition system diagnosis OL  - typical value for debug = 5" VALUE 0xa10015a5 _REC_VAL_20_u1 255. _CNV_A_R_LINEAR_____0_CM 0. 255. DISPLAY_IDENTIFIER C_ABC_INC_IGC_OL FORMAT "%3.0" /end CHARACTERISTIC
/begin CHARACTERISTIC c_abc_max_igc_scp "Maximum value of the anti-bounce counter for the ignition system diagnosis to switch off the coil  - typical value for debug = 255" VALUE 0xa10015aa _REC_VAL_20_u1 254. _CNV_A_R_LINEAR_____0_CM 1. 255. DISPLAY_IDENTIFIER C_ABC_MAX_IGC_SCP FORMAT "%3.0" /end CHARACTERISTIC
/begin CHARACTERISTIC c_abc_max_igc_scg "Maximum value of the anti-bounce counter for the ignition diagnosis SCG - typical value for debug = 255" VALUE 0xa10015a9 _REC_VAL_20_u1 254. _CNV_A_R_LINEAR_____0_CM 1. 255. DISPLAY_IDENTIFIER C_ABC_MAX_IGC_SCG FORMAT "%3.0" /end CHARACTERISTIC
/begin CHARACTERISTIC c_abc_max_igc_ol "Maximum value of the anti-bounce counter for the ignition diagnosis OL - - typical value for debug = 255" VALUE 0xa10015a8 _REC_VAL_20_u1 254. _CNV_A_R_LINEAR_____0_CM 1. 255. DISPLAY_IDENTIFIER C_ABC_MAX_IGC_OL FORMAT "%3.0" /end CHARACTERISTIC
/begin CHARACTERISTIC c_n_32_min_scp_igc_diag "Minimum engine speed for condition diagnosis SCP - Typical value for debug = 500 rpm" VALUE 0xa10015ae _REC_VAL_20_u1 8160. _CNV_A_R_LINEAR_____9_CM 0. 8160. DISPLAY_IDENTIFIER C_N_32_MIN_SCP_IGC_DIAG FORMAT "%4.0" /end CHARACTERISTIC
/begin CHARACTERISTIC c_n_32_min_ol_scg_igc_diag "Min engine speed for condition diagnosis OL/SCG  - Typical value for debug value = 500 rpm" VALUE 0xa10015ad _REC_VAL_20_u1 8160. _CNV_A_R_LINEAR_____9_CM 0. 8160. DISPLAY_IDENTIFIER C_N_32_MIN_OL_SCG_IGC_DIAG FORMAT "%4.0" /end CHARACTERISTIC
/begin CHARACTERISTIC c_tco_min_igc_diag "min temperature for condition diagnosis OL & SCG - - typical value for debug = 20°C  ( emission cycle starting )" VALUE 0xa10015c2 _REC_VAL_20_u1 190.5 _CNV_A_R_LINEAR_____16_CM -48. 142.5 DISPLAY_IDENTIFIER C_TCO_MIN_IGC_DIAG FORMAT "%6.2" /end CHARACTERISTIC
/begin CHARACTERISTIC c_abc_inc_igc_scp "Anti - bounce counter increment for ignition system diagnosis SCP -  typical value for debug = 5" VALUE 0xa10015a7 _REC_VAL_20_u1 255. _CNV_A_R_LINEAR_____0_CM 0. 255. DISPLAY_IDENTIFIER C_ABC_INC_IGC_SCP FORMAT "%3.0" /end CHARACTERISTIC
/begin CHARACTERISTIC c_abc_inc_igc_scg "Anti - bounce counter increment for ignition system diagnosis SCG -  typical value for debug = 5" VALUE 0xa10015a6 _REC_VAL_20_u1 255. _CNV_A_R_LINEAR_____0_CM 0. 255. DISPLAY_IDENTIFIER C_ABC_INC_IGC_SCG FORMAT "%3.0" /end CHARACTERISTIC
/begin MEASUREMENT lv_err_igc_scp_0 "ignition coil failure short circuit plus of cylinder 0" UBYTE _CNV_S_2_RANGE__0___1_CM 1 100. 0. 1. DISPLAY_IDENTIFIER LV_ERR_IGC_SCP_0 ECU_ADDRESS 0xd00033d7 BIT_MASK 0x1 /end MEASUREMENT
/begin MEASUREMENT lv_err_igc_scp_1 "ignition coil failure short circuit plus of cylinder 1" UBYTE _CNV_S_2_RANGE__0___1_CM 1 100. 0. 1. DISPLAY_IDENTIFIER LV_ERR_IGC_SCP_1 ECU_ADDRESS 0xd00033d8 BIT_MASK 0x1 /end MEASUREMENT
/begin MEASUREMENT lv_err_igc_scp_2 "ignition coil failure short circuit plus of cylinder 2" UBYTE _CNV_S_2_RANGE__0___1_CM 1 100. 0. 1. DISPLAY_IDENTIFIER LV_ERR_IGC_SCP_2 ECU_ADDRESS 0xd00033d9 BIT_MASK 0x1 /end MEASUREMENT
/begin MEASUREMENT lv_err_igc_scp_3 "ignition coil failure short circuit plus of cylinder 3" UBYTE _CNV_S_2_RANGE__0___1_CM 1 100. 0. 1. DISPLAY_IDENTIFIER LV_ERR_IGC_SCP_3 ECU_ADDRESS 0xd00033da BIT_MASK 0x1 /end MEASUREMENT
/begin MEASUREMENT lv_err_igc_scp_4 "ignition coil failure short circuit plus of cylinder 4" UBYTE _CNV_S_2_RANGE__0___1_CM 1 100. 0. 1. DISPLAY_IDENTIFIER LV_ERR_IGC_SCP_4 ECU_ADDRESS 0xd00033db BIT_MASK 0x1 /end MEASUREMENT
/begin MEASUREMENT lv_err_igc_scp_5 "ignition coil failure short circuit plus of cylinder 5" UBYTE _CNV_S_2_RANGE__0___1_CM 1 100. 0. 1. DISPLAY_IDENTIFIER LV_ERR_IGC_SCP_5 ECU_ADDRESS 0xd00033dc BIT_MASK 0x1 /end MEASUREMENT
/begin MEASUREMENT lv_err_igc_scg_0 "ignition coil failure primary short circuit ground of cylinder 0" UBYTE _CNV_S_2_RANGE__0___1_CM 1 100. 0. 1. DISPLAY_IDENTIFIER LV_ERR_IGC_SCG_0 ECU_ADDRESS 0xd00033dd BIT_MASK 0x1 /end MEASUREMENT
/begin MEASUREMENT lv_err_igc_scg_1 "ignition coil failure primary short circuit ground of cylinder 1" UBYTE _CNV_S_2_RANGE__0___1_CM 1 100. 0. 1. DISPLAY_IDENTIFIER LV_ERR_IGC_SCG_1 ECU_ADDRESS 0xd00033de BIT_MASK 0x1 /end MEASUREMENT
/begin MEASUREMENT lv_err_igc_scg_2 "ignition coil failure primary short circuit ground of cylinder 2" UBYTE _CNV_S_2_RANGE__0___1_CM 1 100. 0. 1. DISPLAY_IDENTIFIER LV_ERR_IGC_SCG_2 ECU_ADDRESS 0xd00033df BIT_MASK 0x1 /end MEASUREMENT
/begin MEASUREMENT lv_err_igc_scg_3 "ignition coil failure primary short circuit ground of cylinder 3" UBYTE _CNV_S_2_RANGE__0___1_CM 1 100. 0. 1. DISPLAY_IDENTIFIER LV_ERR_IGC_SCG_3 ECU_ADDRESS 0xd00033e0 BIT_MASK 0x1 /end MEASUREMENT
/begin MEASUREMENT lv_err_igc_scg_4 "ignition coil failure primary short circuit ground of cylinder 4" UBYTE _CNV_S_2_RANGE__0___1_CM 1 100. 0. 1. DISPLAY_IDENTIFIER LV_ERR_IGC_SCG_4 ECU_ADDRESS 0xd00033e1 BIT_MASK 0x1 /end MEASUREMENT
/begin MEASUREMENT lv_err_igc_scg_5 "ignition coil failure primary short circuit ground of cylinder 5" UBYTE _CNV_S_2_RANGE__0___1_CM 1 100. 0. 1. DISPLAY_IDENTIFIER LV_ERR_IGC_SCG_5 ECU_ADDRESS 0xd00033e2 BIT_MASK 0x1 /end MEASUREMENT
/begin MEASUREMENT lv_err_igc_ol_0 "ignition coil failure primary open load of cylinder 0" UBYTE _CNV_S_2_RANGE__0___1_CM 1 100. 0. 1. DISPLAY_IDENTIFIER LV_ERR_IGC_OL_0 ECU_ADDRESS 0xd00033e3 BIT_MASK 0x1 /end MEASUREMENT
/begin MEASUREMENT lv_err_igc_ol_1 "ignition coil failure primary open load of cylinder 1" UBYTE _CNV_S_2_RANGE__0___1_CM 1 100. 0. 1. DISPLAY_IDENTIFIER LV_ERR_IGC_OL_1 ECU_ADDRESS 0xd00033e4 BIT_MASK 0x1 /end MEASUREMENT
/begin MEASUREMENT lv_err_igc_ol_2 "ignition coil failure primary open load of cylinder 2" UBYTE _CNV_S_2_RANGE__0___1_CM 1 100. 0. 1. DISPLAY_IDENTIFIER LV_ERR_IGC_OL_2 ECU_ADDRESS 0xd00033e5 BIT_MASK 0x1 /end MEASUREMENT
/begin MEASUREMENT lv_err_igc_ol_3 "ignition coil failure primary open load of cylinder 3" UBYTE _CNV_S_2_RANGE__0___1_CM 1 100. 0. 1. DISPLAY_IDENTIFIER LV_ERR_IGC_OL_3 ECU_ADDRESS 0xd00033e6 BIT_MASK 0x1 /end MEASUREMENT
/begin MEASUREMENT lv_err_igc_ol_4 "ignition coil failure primary open load of cylinder 4" UBYTE _CNV_S_2_RANGE__0___1_CM 1 100. 0. 1. DISPLAY_IDENTIFIER LV_ERR_IGC_OL_4 ECU_ADDRESS 0xd00033e7 BIT_MASK 0x1 /end MEASUREMENT
/begin MEASUREMENT lv_err_igc_ol_5 "ignition coil failure primary open load of cylinder 5" UBYTE _CNV_S_2_RANGE__0___1_CM 1 100. 0. 1. DISPLAY_IDENTIFIER LV_ERR_IGC_OL_5 ECU_ADDRESS 0xd00033e8 BIT_MASK 0x1 /end MEASUREMENT
/begin MEASUREMENT lv_err_igc "OR of every failure" UBYTE _CNV_S_2_RANGE__0___1_CM 1 100. 0. 1. DISPLAY_IDENTIFIER LV_ERR_IGC ECU_ADDRESS 0xd0002d00 BIT_MASK 0x1 /end MEASUREMENT
/begin MEASUREMENT lv_inh_igc[0] "Inhibition for ignition system of cylinder x" UBYTE _CNV_S_2_RANGE__0___1_CM 1 100. 0. 1. DISPLAY_IDENTIFIER LV_INH_IGC_0 ECU_ADDRESS 0xd0002d02 BIT_MASK 0x1 /end MEASUREMENT
/begin MEASUREMENT lv_inh_igc[1] "Inhibition for ignition system of cylinder x" UBYTE _CNV_S_2_RANGE__0___1_CM 1 100. 0. 1. DISPLAY_IDENTIFIER LV_INH_IGC_1 ECU_ADDRESS 0xd0002d03 BIT_MASK 0x1 /end MEASUREMENT
/begin MEASUREMENT lv_inh_igc[2] "Inhibition for ignition system of cylinder x" UBYTE _CNV_S_2_RANGE__0___1_CM 1 100. 0. 1. DISPLAY_IDENTIFIER LV_INH_IGC_2 ECU_ADDRESS 0xd0002d04 BIT_MASK 0x1 /end MEASUREMENT
/begin MEASUREMENT lv_inh_igc[3] "Inhibition for ignition system of cylinder x" UBYTE _CNV_S_2_RANGE__0___1_CM 1 100. 0. 1. DISPLAY_IDENTIFIER LV_INH_IGC_3 ECU_ADDRESS 0xd0002d05 BIT_MASK 0x1 /end MEASUREMENT
/begin MEASUREMENT lv_inh_igc[4] "Inhibition for ignition system of cylinder x" UBYTE _CNV_S_2_RANGE__0___1_CM 1 100. 0. 1. DISPLAY_IDENTIFIER LV_INH_IGC_4 ECU_ADDRESS 0xd0002d06 BIT_MASK 0x1 /end MEASUREMENT
/begin MEASUREMENT lv_inh_igc[5] "Inhibition for ignition system of cylinder x" UBYTE _CNV_S_2_RANGE__0___1_CM 1 100. 0. 1. DISPLAY_IDENTIFIER LV_INH_IGC_5 ECU_ADDRESS 0xd0002d07 BIT_MASK 0x1 /end MEASUREMENT
/begin MEASUREMENT lv_scp_igc[0] "Diagnostic of primary short circuit to battery ( cylinder selected )" UBYTE _CNV_S_2_RANGE__0___1_CM 1 100. 0. 1. DISPLAY_IDENTIFIER LV_SCP_IGC_0 ECU_ADDRESS 0xd0002d14 BIT_MASK 0x1 /end MEASUREMENT
/begin MEASUREMENT lv_scp_igc[1] "Diagnostic of primary short circuit to battery ( cylinder selected )" UBYTE _CNV_S_2_RANGE__0___1_CM 1 100. 0. 1. DISPLAY_IDENTIFIER LV_SCP_IGC_1 ECU_ADDRESS 0xd0002d15 BIT_MASK 0x1 /end MEASUREMENT
/begin MEASUREMENT lv_scp_igc[2] "Diagnostic of primary short circuit to battery ( cylinder selected )" UBYTE _CNV_S_2_RANGE__0___1_CM 1 100. 0. 1. DISPLAY_IDENTIFIER LV_SCP_IGC_2 ECU_ADDRESS 0xd0002d16 BIT_MASK 0x1 /end MEASUREMENT
/begin MEASUREMENT lv_scp_igc[3] "Diagnostic of primary short circuit to battery ( cylinder selected )" UBYTE _CNV_S_2_RANGE__0___1_CM 1 100. 0. 1. DISPLAY_IDENTIFIER LV_SCP_IGC_3 ECU_ADDRESS 0xd0002d17 BIT_MASK 0x1 /end MEASUREMENT
/begin MEASUREMENT lv_scp_igc[4] "Diagnostic of primary short circuit to battery ( cylinder selected )" UBYTE _CNV_S_2_RANGE__0___1_CM 1 100. 0. 1. DISPLAY_IDENTIFIER LV_SCP_IGC_4 ECU_ADDRESS 0xd0002d18 BIT_MASK 0x1 /end MEASUREMENT
/begin MEASUREMENT lv_scp_igc[5] "Diagnostic of primary short circuit to battery ( cylinder selected )" UBYTE _CNV_S_2_RANGE__0___1_CM 1 100. 0. 1. DISPLAY_IDENTIFIER LV_SCP_IGC_5 ECU_ADDRESS 0xd0002d19 BIT_MASK 0x1 /end MEASUREMENT
/begin MEASUREMENT lv_ol_igc[0] "Diagnostic of primary open load ( cylinder selected )" UBYTE _CNV_S_2_RANGE__0___1_CM 1 100. 0. 1. DISPLAY_IDENTIFIER LV_OL_IGC_0 ECU_ADDRESS 0xd0002d08 BIT_MASK 0x1 /end MEASUREMENT
/begin MEASUREMENT lv_ol_igc[1] "Diagnostic of primary open load ( cylinder selected )" UBYTE _CNV_S_2_RANGE__0___1_CM 1 100. 0. 1. DISPLAY_IDENTIFIER LV_OL_IGC_1 ECU_ADDRESS 0xd0002d09 BIT_MASK 0x1 /end MEASUREMENT
/begin MEASUREMENT lv_ol_igc[2] "Diagnostic of primary open load ( cylinder selected )" UBYTE _CNV_S_2_RANGE__0___1_CM 1 100. 0. 1. DISPLAY_IDENTIFIER LV_OL_IGC_2 ECU_ADDRESS 0xd0002d0a BIT_MASK 0x1 /end MEASUREMENT
/begin MEASUREMENT lv_ol_igc[3] "Diagnostic of primary open load ( cylinder selected )" UBYTE _CNV_S_2_RANGE__0___1_CM 1 100. 0. 1. DISPLAY_IDENTIFIER LV_OL_IGC_3 ECU_ADDRESS 0xd0002d0b BIT_MASK 0x1 /end MEASUREMENT
/begin MEASUREMENT lv_ol_igc[4] "Diagnostic of primary open load ( cylinder selected )" UBYTE _CNV_S_2_RANGE__0___1_CM 1 100. 0. 1. DISPLAY_IDENTIFIER LV_OL_IGC_4 ECU_ADDRESS 0xd0002d0c BIT_MASK 0x1 /end MEASUREMENT
/begin MEASUREMENT lv_ol_igc[5] "Diagnostic of primary open load ( cylinder selected )" UBYTE _CNV_S_2_RANGE__0___1_CM 1 100. 0. 1. DISPLAY_IDENTIFIER LV_OL_IGC_5 ECU_ADDRESS 0xd0002d0d BIT_MASK 0x1 /end MEASUREMENT
/begin MEASUREMENT lv_scg_igc[0] "Diagnostic of primary short circuit to ground ( cylinder selected )" UBYTE _CNV_S_2_RANGE__0___1_CM 1 100. 0. 1. DISPLAY_IDENTIFIER LV_SCG_IGC_0 ECU_ADDRESS 0xd0002d0e BIT_MASK 0x1 /end MEASUREMENT
/begin MEASUREMENT lv_scg_igc[1] "Diagnostic of primary short circuit to ground ( cylinder selected )" UBYTE _CNV_S_2_RANGE__0___1_CM 1 100. 0. 1. DISPLAY_IDENTIFIER LV_SCG_IGC_1 ECU_ADDRESS 0xd0002d0f BIT_MASK 0x1 /end MEASUREMENT
/begin MEASUREMENT lv_scg_igc[2] "Diagnostic of primary short circuit to ground ( cylinder selected )" UBYTE _CNV_S_2_RANGE__0___1_CM 1 100. 0. 1. DISPLAY_IDENTIFIER LV_SCG_IGC_2 ECU_ADDRESS 0xd0002d10 BIT_MASK 0x1 /end MEASUREMENT
/begin MEASUREMENT lv_scg_igc[3] "Diagnostic of primary short circuit to ground ( cylinder selected )" UBYTE _CNV_S_2_RANGE__0___1_CM 1 100. 0. 1. DISPLAY_IDENTIFIER LV_SCG_IGC_3 ECU_ADDRESS 0xd0002d11 BIT_MASK 0x1 /end MEASUREMENT
/begin MEASUREMENT lv_scg_igc[4] "Diagnostic of primary short circuit to ground ( cylinder selected )" UBYTE _CNV_S_2_RANGE__0___1_CM 1 100. 0. 1. DISPLAY_IDENTIFIER LV_SCG_IGC_4 ECU_ADDRESS 0xd0002d12 BIT_MASK 0x1 /end MEASUREMENT
/begin MEASUREMENT lv_scg_igc[5] "Diagnostic of primary short circuit to ground ( cylinder selected )" UBYTE _CNV_S_2_RANGE__0___1_CM 1 100. 0. 1. DISPLAY_IDENTIFIER LV_SCG_IGC_5 ECU_ADDRESS 0xd0002d13 BIT_MASK 0x1 /end MEASUREMENT
/begin CHARACTERISTIC id_v_dur_igc_min "Minimum duration of the burntime to detect ignition errors" MAP 0xa1001354 _REC_MAP_20_u2_u1_u1 262.14 _CNV_A_R_LINEAR_____111_CM 0. 262.14 DISPLAY_IDENTIFIER ID_V_DUR_IGC_MIN FORMAT "%7.3"
 /begin AXIS_DESCR COM_AXIS n_32 _CNV_A_R_LINEAR_____9_CM 8 0. 8160. FORMAT "%4.0" AXIS_PTS_REF ldp_n_32_id_v_dur_igc_min /end AXIS_DESCR
 /begin AXIS_DESCR COM_AXIS NO_INPUT_QUANTITY _CNV_A_R_LINEAR_____14_CM 6 0. 1389. FORMAT "%4.0" AXIS_PTS_REF ldp_maf_id_v_dur_igc_min /end AXIS_DESCR
/end CHARACTERISTIC
/begin AXIS_PTS ldp_n_32_id_v_dur_igc_min "" 0xa1001318 n_32 _REC_AXS_20_u1 8160. _CNV_A_R_LINEAR_____9_CM 8 0. 8160. FORMAT "%4.0" /end AXIS_PTS
/begin AXIS_PTS ldp_maf_id_v_dur_igc_min "" 0xa1001310 NO_INPUT_QUANTITY _REC_AXS_20_u1 1389. _CNV_A_R_LINEAR_____14_CM 6 0. 1389. FORMAT "%4.0" /end AXIS_PTS
/begin MEASUREMENT v_dur_igc[0] "burn time duration for diag validation" UWORD _CNV_A_R_LINEAR_____111_CM 1 100. 0. 262.14 DISPLAY_IDENTIFIER V_DUR_IGC_0 ECU_ADDRESS 0xd00024e4 FORMAT "%7.3" /end MEASUREMENT
/begin MEASUREMENT v_dur_igc[1] "burn time duration for diag validation" UWORD _CNV_A_R_LINEAR_____111_CM 1 100. 0. 262.14 DISPLAY_IDENTIFIER V_DUR_IGC_1 ECU_ADDRESS 0xd00024e6 FORMAT "%7.3" /end MEASUREMENT
/begin MEASUREMENT v_dur_igc[2] "burn time duration for diag validation" UWORD _CNV_A_R_LINEAR_____111_CM 1 100. 0. 262.14 DISPLAY_IDENTIFIER V_DUR_IGC_2 ECU_ADDRESS 0xd00024e8 FORMAT "%7.3" /end MEASUREMENT
/begin MEASUREMENT v_dur_igc[3] "burn time duration for diag validation" UWORD _CNV_A_R_LINEAR_____111_CM 1 100. 0. 262.14 DISPLAY_IDENTIFIER V_DUR_IGC_3 ECU_ADDRESS 0xd00024ea FORMAT "%7.3" /end MEASUREMENT
/begin MEASUREMENT v_dur_igc[4] "burn time duration for diag validation" UWORD _CNV_A_R_LINEAR_____111_CM 1 100. 0. 262.14 DISPLAY_IDENTIFIER V_DUR_IGC_4 ECU_ADDRESS 0xd00024ec FORMAT "%7.3" /end MEASUREMENT
/begin MEASUREMENT v_dur_igc[5] "burn time duration for diag validation" UWORD _CNV_A_R_LINEAR_____111_CM 1 100. 0. 262.14 DISPLAY_IDENTIFIER V_DUR_IGC_5 ECU_ADDRESS 0xd00024ee FORMAT "%7.3" /end MEASUREMENT
/begin CHARACTERISTIC c_td_fac_st_min "Factor for minimum dwell time" VALUE 0xa10015c7 _REC_VAL_20_u1 1.984375 _CNV_A_R_LINEAR_____100_CM 7.8125e-003 1.9921875 DISPLAY_IDENTIFIER C_TD_FAC_ST_MIN FORMAT "%8.6" /end CHARACTERISTIC
/begin CHARACTERISTIC c_td_fac_st_max "Factor for maximum dwell time" VALUE 0xa10015c6 _REC_VAL_20_u1 1.984375 _CNV_A_R_LINEAR_____100_CM 7.8125e-003 1.9921875 DISPLAY_IDENTIFIER C_TD_FAC_ST_MAX FORMAT "%8.6" /end CHARACTERISTIC
/begin CHARACTERISTIC c_td_vb_max "Maximum battery voltage to activate MPL ( typ value : 16V )" VALUE 0xa10015ce _REC_VAL_20_u1 25.8984375 _CNV_A_R_LINEAR_____289_CM 0. 25.8984375 DISPLAY_IDENTIFIER C_TD_VB_MAX FORMAT "%9.6" /end CHARACTERISTIC
/begin CHARACTERISTIC ip_td_fac_max "Max Dwell time factor" CURVE 0xa1001474 _REC_CUR_20_u1_u1 1.984375 _CNV_A_R_LINEAR_____100_CM 7.8125e-003 1.9921875 DISPLAY_IDENTIFIER IP_TD_FAC_MAX FORMAT "%8.6"
 /begin AXIS_DESCR COM_AXIS n_32 _CNV_A_R_LINEAR_____9_CM 8 0. 8160. FORMAT "%4.0" AXIS_PTS_REF ldpm_n_32_1_igre /end AXIS_DESCR
/end CHARACTERISTIC
/begin CHARACTERISTIC ip_td_fac_min "Min Dwell time factor" CURVE 0xa100147c _REC_CUR_20_u1_u1 1.984375 _CNV_A_R_LINEAR_____100_CM 7.8125e-003 1.9921875 DISPLAY_IDENTIFIER IP_TD_FAC_MIN FORMAT "%8.6"
 /begin AXIS_DESCR COM_AXIS n_32 _CNV_A_R_LINEAR_____9_CM 8 0. 8160. FORMAT "%4.0" AXIS_PTS_REF ldpm_n_32_1_igre /end AXIS_DESCR
/end CHARACTERISTIC
/begin MEASUREMENT td_fac_max "Maximum dwell time control" UBYTE _CNV_A_R_LINEAR_____100_CM 1 100. 7.8125e-003 1.9921875 DISPLAY_IDENTIFIER TD_FAC_MAX ECU_ADDRESS 0xd0002cfd FORMAT "%8.6" /end MEASUREMENT
/begin MEASUREMENT td_fac_min "Minimum dwell time control" UBYTE _CNV_A_R_LINEAR_____100_CM 1 100. 7.8125e-003 1.9921875 DISPLAY_IDENTIFIER TD_FAC_MIN ECU_ADDRESS 0xd0002cfe FORMAT "%8.6" /end MEASUREMENT
/begin CHARACTERISTIC lc_igc_lih_conf "Configuration Choice for Half static Mode in case of CAM limp home: 0 = no Limp Home - 1 = Half Static" VALUE 0xa10015d3 _REC_VAL_20_u1 1. _CNV_A_R_LINEAR_____0_CM 0. 1. DISPLAY_IDENTIFIER LC_IGC_LIH_CONF FORMAT "%1.0" /end CHARACTERISTIC
/begin AXIS_PTS ldpm_n_32_1_igre "" 0xa1001330 n_32 _REC_AXS_20_u1 8160. _CNV_A_R_LINEAR_____9_CM 8 0. 8160. FORMAT "%4.0" /end AXIS_PTS
/begin AXIS_PTS ldpm_vb_1_igre "Battery Voltage" 0xa1001348 vb _REC_AXS_20_u1 25.8984375 _CNV_A_R_LINEAR_____289_CM 8 0. 25.8984375 FORMAT "%9.6" /end AXIS_PTS
/begin MEASUREMENT td_fac "General dwell time control factor" UBYTE _CNV_A_R_LINEAR_____100_CM 1 100. 7.8125e-003 1.9921875 DISPLAY_IDENTIFIER TD_FAC ECU_ADDRESS 0xd0002cfc FORMAT "%8.6" /end MEASUREMENT
/begin CHARACTERISTIC ip_td_st_fac "Factor for dwell time boost at start" CURVE 0xa100151c _REC_CUR_20_u1_u1 1.984375 _CNV_A_R_LINEAR_____100_CM 7.8125e-003 1.9921875 DISPLAY_IDENTIFIER IP_TD_ST_FAC FORMAT "%8.6"
 /begin AXIS_DESCR COM_AXIS vb _CNV_A_R_LINEAR_____289_CM 8 0. 25.8984375 FORMAT "%9.6" AXIS_PTS_REF ldpm_vb_1_igre /end AXIS_DESCR
/end CHARACTERISTIC
/begin CHARACTERISTIC ip_td_fac_tco "Adjustement factor for dwell time" CURVE 0xa1001484 _REC_CUR_20_u1_u1 1.984375 _CNV_A_R_LINEAR_____100_CM 7.8125e-003 1.9921875 DISPLAY_IDENTIFIER IP_TD_FAC_TCO FORMAT "%8.6"
 /begin AXIS_DESCR COM_AXIS tco _CNV_A_R_LINEAR_____16_CM 8 -48. 142.5 FORMAT "%6.2" AXIS_PTS_REF ldpm_tco_td_fac /end AXIS_DESCR
/end CHARACTERISTIC
/begin AXIS_PTS ldpm_tco_td_fac "" 0xa100133c tco _REC_AXS_20_u1 190.5 _CNV_A_R_LINEAR_____16_CM 8 -48. 142.5 FORMAT "%6.2" /end AXIS_PTS
/begin MEASUREMENT td_st_fac "Boost factor for start face" UBYTE _CNV_A_R_LINEAR_____100_CM 1 100. 7.8125e-003 1.9921875 DISPLAY_IDENTIFIER TD_ST_FAC ECU_ADDRESS 0xc000232d FORMAT "%8.6" /end MEASUREMENT
/begin MEASUREMENT td_fac_tco "Adjustment factor with TCO dependence" UBYTE _CNV_A_R_LINEAR_____100_CM 1 100. 7.8125e-003 1.9921875 DISPLAY_IDENTIFIER TD_FAC_TCO ECU_ADDRESS 0xc000232c FORMAT "%8.6" /end MEASUREMENT
/begin MEASUREMENT td_mpl_dly "Dwell time interruption between MPL sparks (except between main and 1st MPL spark)" UWORD _CNV_A_R_LINEAR_____111_CM 1 100. 0. 262.14 DISPLAY_IDENTIFIER TD_MPL_DLY ECU_ADDRESS 0xd00024de FORMAT "%7.3" /end MEASUREMENT
/begin MEASUREMENT ign_mpl_nr "Number of ignition sparks" UBYTE _CNV_A_R_LINEAR_____0_CM 1 100. 0. 255. DISPLAY_IDENTIFIER IGN_MPL_NR ECU_ADDRESS 0xd0002cf9 FORMAT "%3.0" /end MEASUREMENT
/begin CHARACTERISTIC c_tco_max_mpl_st "Max. Coolant Temp. to have multiple spark at start" VALUE 0xa10015c1 _REC_VAL_20_u1 190.5 _CNV_A_R_LINEAR_____16_CM -48. 142.5 DISPLAY_IDENTIFIER C_TCO_MAX_MPL_ST FORMAT "%6.2" /end CHARACTERISTIC
/begin CHARACTERISTIC c_tco_max_mpl_is "Max. Coolant Temp. to have multiple spark at idle speed" VALUE 0xa10015be _REC_VAL_20_u1 190.5 _CNV_A_R_LINEAR_____16_CM -48. 142.5 DISPLAY_IDENTIFIER C_TCO_MAX_MPL_IS FORMAT "%6.2" /end CHARACTERISTIC
/begin CHARACTERISTIC c_tco_max_mpl_pl_pu_fl "Max. Coolant Temp. to have multiple spark at Run" VALUE 0xa10015bf _REC_VAL_20_u1 190.5 _CNV_A_R_LINEAR_____16_CM -48. 142.5 DISPLAY_IDENTIFIER C_TCO_MAX_MPL_PL_PU_FL FORMAT "%6.2" /end CHARACTERISTIC
/begin CHARACTERISTIC c_tco_max_mpl_puc "Max. Coolant Temp. to have multiple spark at fuel cut off" VALUE 0xa10015c0 _REC_VAL_20_u1 190.5 _CNV_A_R_LINEAR_____16_CM -48. 142.5 DISPLAY_IDENTIFIER C_TCO_MAX_MPL_PUC FORMAT "%6.2" /end CHARACTERISTIC
/begin CHARACTERISTIC c_vb_max_mpl_is "Max. Battery Voltage  to have multiple spark ( requested value 16 ) at idle speed" VALUE 0xa10015cf _REC_VAL_20_u1 25.8984375 _CNV_A_R_LINEAR_____289_CM 0. 25.8984375 DISPLAY_IDENTIFIER C_VB_MAX_MPL_IS FORMAT "%9.6" /end CHARACTERISTIC
/begin CHARACTERISTIC c_vb_max_mpl_pl_pu_fl "Max. Battery Voltage  to have multiple spark ( requested value 16 ) at Run" VALUE 0xa10015d0 _REC_VAL_20_u1 25.8984375 _CNV_A_R_LINEAR_____289_CM 0. 25.8984375 DISPLAY_IDENTIFIER C_VB_MAX_MPL_PL_PU_FL FORMAT "%9.6" /end CHARACTERISTIC
/begin CHARACTERISTIC c_vb_max_mpl_st "Max. Battery Voltage  to have multiple spark ( requested value 16 ) at start" VALUE 0xa10015d2 _REC_VAL_20_u1 25.8984375 _CNV_A_R_LINEAR_____289_CM 0. 25.8984375 DISPLAY_IDENTIFIER C_VB_MAX_MPL_ST FORMAT "%9.6" /end CHARACTERISTIC
/begin CHARACTERISTIC c_n_min_mpl_st "Engine speed min for ignition with multiple spark at start" VALUE 0xa10015b7 _REC_VAL_20_u1 8160. _CNV_A_R_LINEAR_____9_CM 0. 8160. DISPLAY_IDENTIFIER C_N_MIN_MPL_ST FORMAT "%4.0" /end CHARACTERISTIC
/begin CHARACTERISTIC c_n_max_mpl_st "Engine speed max for ignition with multiple spark at start" VALUE 0xa10015b3 _REC_VAL_20_u1 8160. _CNV_A_R_LINEAR_____9_CM 0. 8160. DISPLAY_IDENTIFIER C_N_MAX_MPL_ST FORMAT "%4.0" /end CHARACTERISTIC
/begin CHARACTERISTIC c_n_max_mpl_is "Engine speed max for ignition with multiple spark at idle speed" VALUE 0xa10015af _REC_VAL_20_u1 8160. _CNV_A_R_LINEAR_____9_CM 0. 8160. DISPLAY_IDENTIFIER C_N_MAX_MPL_IS FORMAT "%4.0" /end CHARACTERISTIC
/begin CHARACTERISTIC c_n_min_mpl_is "Engine speed min for ignition with multiple spark at idle speed" VALUE 0xa10015b4 _REC_VAL_20_u1 8160. _CNV_A_R_LINEAR_____9_CM 0. 8160. DISPLAY_IDENTIFIER C_N_MIN_MPL_IS FORMAT "%4.0" /end CHARACTERISTIC
/begin CHARACTERISTIC c_n_min_mpl_pl_pu_fl "Engine speed min for ignition with multiple spark at Run" VALUE 0xa10015b5 _REC_VAL_20_u1 8160. _CNV_A_R_LINEAR_____9_CM 0. 8160. DISPLAY_IDENTIFIER C_N_MIN_MPL_PL_PU_FL FORMAT "%4.0" /end CHARACTERISTIC
/begin CHARACTERISTIC c_n_max_mpl_pl_pu_fl "Engine speed max for ignition with multiple spark at Run" VALUE 0xa10015b0 _REC_VAL_20_u1 8160. _CNV_A_R_LINEAR_____9_CM 0. 8160. DISPLAY_IDENTIFIER C_N_MAX_MPL_PL_PU_FL FORMAT "%4.0" /end CHARACTERISTIC
/begin CHARACTERISTIC c_n_max_mpl_puc "Engine speed max for ignition with multiple spark at Fuel cut off" VALUE 0xa10015b1 _REC_VAL_20_u1 8160. _CNV_A_R_LINEAR_____9_CM 0. 8160. DISPLAY_IDENTIFIER C_N_MAX_MPL_PUC FORMAT "%4.0" /end CHARACTERISTIC
/begin CHARACTERISTIC c_n_min_mpl_puc "Engine speed min for ignition with multiple spark at Fuel cut off" VALUE 0xa10015b6 _REC_VAL_20_u1 8160. _CNV_A_R_LINEAR_____9_CM 0. 8160. DISPLAY_IDENTIFIER C_N_MIN_MPL_PUC FORMAT "%4.0" /end CHARACTERISTIC
/begin CHARACTERISTIC c_td_mpl_man "Manual activation of the MPL" VALUE 0xa10015ca _REC_VAL_20_u1 1. _CNV_S_2_RANGE__0___1_CM 0. 1. DISPLAY_IDENTIFIER C_TD_MPL_MAN /end CHARACTERISTIC
/begin CHARACTERISTIC c_vb_max_mpl_puc "Max. Battery Voltage  to have multiple spark ( requested value 16 ) at fuel cut off" VALUE 0xa10015d1 _REC_VAL_20_u1 25.8984375 _CNV_A_R_LINEAR_____289_CM 0. 25.8984375 DISPLAY_IDENTIFIER C_VB_MAX_MPL_PUC FORMAT "%9.6" /end CHARACTERISTIC
/begin AXIS_PTS ldp_tco_ip_nr_mpl "" 0xa1001324 tco _REC_AXS_20_u1 190.5 _CNV_A_R_LINEAR_____16_CM 8 -48. 142.5 FORMAT "%6.2" /end AXIS_PTS
/begin CHARACTERISTIC ip_td_mpl_s "dwell time for multiple spark in stratified mode confirmed" CURVE 0xa10011fc _REC_CUR_20_u2_u1 262.14 _CNV_A_R_LINEAR_____111_CM 0. 262.14 DISPLAY_IDENTIFIER IP_TD_MPL_S FORMAT "%7.3"
 /begin AXIS_DESCR COM_AXIS vb _CNV_A_R_LINEAR_____289_CM 8 0. 25.8984375 FORMAT "%9.6" AXIS_PTS_REF ldpm_vb_1_igre /end AXIS_DESCR
/end CHARACTERISTIC
/begin CHARACTERISTIC ip_nr_mpl "Number of successives ignition sparks depending on engine speed and TCO" MAP 0xa10013b4 _REC_MAP_20_u1_u1_u1 255. _CNV_A_R_LINEAR_____0_CM 0. 255. DISPLAY_IDENTIFIER IP_NR_MPL FORMAT "%3.0"
 /begin AXIS_DESCR COM_AXIS n_32 _CNV_A_R_LINEAR_____9_CM 8 0. 8160. FORMAT "%4.0" AXIS_PTS_REF ldpm_n_32_1_igre /end AXIS_DESCR
 /begin AXIS_DESCR COM_AXIS tco _CNV_A_R_LINEAR_____16_CM 8 -48. 142.5 FORMAT "%6.2" AXIS_PTS_REF ldp_tco_ip_nr_mpl /end AXIS_DESCR
/end CHARACTERISTIC
/begin CHARACTERISTIC ip_nr_mpl_s "Number of successives ignition sparks depending on engine speed and TCO in stratified mode" MAP 0xa100113c _REC_MAP_20_u1_u1_u1 255. _CNV_A_R_LINEAR_____0_CM 0. 255. DISPLAY_IDENTIFIER IP_NR_MPL_S FORMAT "%3.0"
 /begin AXIS_DESCR COM_AXIS n_32 _CNV_A_R_LINEAR_____9_CM 8 0. 8160. FORMAT "%4.0" AXIS_PTS_REF ldpm_n_32_1_igre /end AXIS_DESCR
 /begin AXIS_DESCR COM_AXIS tco _CNV_A_R_LINEAR_____16_CM 8 -48. 142.5 FORMAT "%6.2" AXIS_PTS_REF ldp_tco_ip_nr_mpl /end AXIS_DESCR
/end CHARACTERISTIC
/begin CHARACTERISTIC c_td_t_mpl "Minimum time between two ignition ( normal value 150 us )" VALUE 0xa10015cc _REC_VAL_20_u2 262.14 _CNV_A_R_LINEAR_____111_CM 0. 262.14 DISPLAY_IDENTIFIER C_TD_T_MPL FORMAT "%7.3" /end CHARACTERISTIC
/begin CHARACTERISTIC c_t_ctr_td_mpl_ast "maintenance time of Multiple spark activation before out case and for the after start phase" VALUE 0xa10015bc _REC_VAL_20_u2 655.34 _CNV_A_R_LINEAR_____3_CM 0. 655.34 DISPLAY_IDENTIFIER C_T_CTR_TD_MPL_AST FORMAT "%6.2" /end CHARACTERISTIC
/begin CHARACTERISTIC c_t_ctr_td_mpl "maintenance time of Multiple spark activation before out case" VALUE 0xa10015ba _REC_VAL_20_u2 655.34 _CNV_A_R_LINEAR_____3_CM 0. 655.34 DISPLAY_IDENTIFIER C_T_CTR_TD_MPL FORMAT "%6.2" /end CHARACTERISTIC
/begin MEASUREMENT t_ctr_td_mpl "Maintenance time of multiple spark activation before out case" UWORD _CNV_A_R_LINEAR_____3_CM 1 100. 0. 655.35 DISPLAY_IDENTIFIER T_CTR_TD_MPL ECU_ADDRESS 0xd00024c8 FORMAT "%6.2" /end MEASUREMENT
/begin CHARACTERISTIC ip_td_mpl "dwell time for multiple spark" CURVE 0xa100148c _REC_CUR_20_u2_u1 262.14 _CNV_A_R_LINEAR_____111_CM 0. 262.14 DISPLAY_IDENTIFIER IP_TD_MPL FORMAT "%7.3"
 /begin AXIS_DESCR COM_AXIS vb _CNV_A_R_LINEAR_____289_CM 8 0. 25.8984375 FORMAT "%9.6" AXIS_PTS_REF ldpm_vb_1_igre /end AXIS_DESCR
/end CHARACTERISTIC
/begin CHARACTERISTIC ip_td_t_mpl_1 "Time delay between mains spark and start of ign coil drive for 1st MPL spark (homogeneous mode confirmed)" MAP 0xa1001524 _REC_MAP_20_u2_u1_u1 262.14 _CNV_A_R_LINEAR_____111_CM 0. 262.14 DISPLAY_IDENTIFIER IP_TD_T_MPL_1 FORMAT "%7.3"
 /begin AXIS_DESCR COM_AXIS vb _CNV_A_R_LINEAR_____289_CM 8 0. 25.8984375 FORMAT "%9.6" AXIS_PTS_REF ldpm_vb_1_igre /end AXIS_DESCR
 /begin AXIS_DESCR COM_AXIS n_32 _CNV_A_R_LINEAR_____9_CM 8 0. 8160. FORMAT "%4.0" AXIS_PTS_REF ldpm_n_32_1_igre /end AXIS_DESCR
/end CHARACTERISTIC
/begin CHARACTERISTIC ip_td_mpl_1 "Dwell time for 1st multiple spark in homogeneous mode confirmed" MAP 0xa100149c _REC_MAP_20_u2_u1_u1 262.14 _CNV_A_R_LINEAR_____111_CM 0. 262.14 DISPLAY_IDENTIFIER IP_TD_MPL_1 FORMAT "%7.3"
 /begin AXIS_DESCR COM_AXIS vb _CNV_A_R_LINEAR_____289_CM 8 0. 25.8984375 FORMAT "%9.6" AXIS_PTS_REF ldpm_vb_1_igre /end AXIS_DESCR
 /begin AXIS_DESCR COM_AXIS n_32 _CNV_A_R_LINEAR_____9_CM 8 0. 8160. FORMAT "%4.0" AXIS_PTS_REF ldpm_n_32_1_igre /end AXIS_DESCR
/end CHARACTERISTIC
/begin CHARACTERISTIC ip_td_mpl_1_s "Dwell time for 1st multiple spark in stratified  mode confirmed" MAP 0xa100117c _REC_MAP_20_u2_u1_u1 262.14 _CNV_A_R_LINEAR_____111_CM 0. 262.14 DISPLAY_IDENTIFIER IP_TD_MPL_1_S FORMAT "%7.3"
 /begin AXIS_DESCR COM_AXIS vb _CNV_A_R_LINEAR_____289_CM 8 0. 25.8984375 FORMAT "%9.6" AXIS_PTS_REF ldpm_vb_1_igre /end AXIS_DESCR
 /begin AXIS_DESCR COM_AXIS n_32 _CNV_A_R_LINEAR_____9_CM 8 0. 8160. FORMAT "%4.0" AXIS_PTS_REF ldpm_n_32_1_igre /end AXIS_DESCR
/end CHARACTERISTIC
/begin CHARACTERISTIC ip_td_t_mpl_1_s "Time delay between main spark and start of ign coil drive for 1st MPL spark (stratified  mode confirmed)" MAP 0xa100128c _REC_MAP_20_u2_u1_u1 262.14 _CNV_A_R_LINEAR_____111_CM 0. 262.14 DISPLAY_IDENTIFIER IP_TD_T_MPL_1_S FORMAT "%7.3"
 /begin AXIS_DESCR COM_AXIS vb _CNV_A_R_LINEAR_____289_CM 8 0. 25.8984375 FORMAT "%9.6" AXIS_PTS_REF ldpm_vb_1_igre /end AXIS_DESCR
 /begin AXIS_DESCR COM_AXIS n_32 _CNV_A_R_LINEAR_____9_CM 8 0. 8160. FORMAT "%4.0" AXIS_PTS_REF ldpm_n_32_1_igre /end AXIS_DESCR
/end CHARACTERISTIC
/begin MEASUREMENT td_mpl "Dwell time for multiple spark (for 2nd and others MPL sparks)" UWORD _CNV_A_R_LINEAR_____111_CM 1 100. 0. 262.14 DISPLAY_IDENTIFIER TD_MPL ECU_ADDRESS 0xd00024d8 FORMAT "%7.3" /end MEASUREMENT
/begin MEASUREMENT td_mpl_1 "Dwell time for 1st  multiple spark (e.g. 1st spark after main spark)" UWORD _CNV_A_R_LINEAR_____111_CM 1 100. 0. 262.14 DISPLAY_IDENTIFIER TD_MPL_1 ECU_ADDRESS 0xd00024da FORMAT "%7.3" /end MEASUREMENT
/begin MEASUREMENT td_mpl_1_dly "Dwell time interruption between main spark and 1st MPL spark" UWORD _CNV_A_R_LINEAR_____111_CM 1 100. 0. 262.14 DISPLAY_IDENTIFIER TD_MPL_1_DLY ECU_ADDRESS 0xd00024dc FORMAT "%7.3" /end MEASUREMENT
/begin CHARACTERISTIC c_td_as "Dwell time offset usual value : 0 ms" VALUE 0xa10015c4 _REC_VAL_20_s2 16.32 _CNV_A_R_LINEAR_____111_CM -8.192 8.128 DISPLAY_IDENTIFIER C_TD_AS /end CHARACTERISTIC
/begin CHARACTERISTIC ip_td "Dwell time correction versus battery voltage and engine speed" MAP 0xa10013f4 _REC_MAP_20_u2_u1_u1 262.14 _CNV_A_R_LINEAR_____111_CM 0. 262.14 DISPLAY_IDENTIFIER IP_TD FORMAT "%7.3"
 /begin AXIS_DESCR COM_AXIS vb _CNV_A_R_LINEAR_____289_CM 8 0. 25.8984375 FORMAT "%9.6" AXIS_PTS_REF ldpm_vb_1_igre /end AXIS_DESCR
 /begin AXIS_DESCR COM_AXIS n_32 _CNV_A_R_LINEAR_____9_CM 8 0. 8160. FORMAT "%4.0" AXIS_PTS_REF ldpm_n_32_1_igre /end AXIS_DESCR
/end CHARACTERISTIC
/begin MEASUREMENT td "Dwell time" UWORD _CNV_A_R_LINEAR_____111_CM 1 100. 0. 262.14 DISPLAY_IDENTIFIER TD ECU_ADDRESS 0xd00024ca FORMAT "%7.3" /end MEASUREMENT
/begin CHARACTERISTIC c_td_ini "Initial value for dwell time control ( typ. Value 3ms for standart coils and <2ms for pencils coils) " VALUE 0xa10015c8 _REC_VAL_20_u2 262.14 _CNV_A_R_LINEAR_____111_CM 0. 262.14 DISPLAY_IDENTIFIER C_TD_INI FORMAT "%7.3" /end CHARACTERISTIC
/begin CHARACTERISTIC c_td_s_as "Application intervention for stratified mode (typ. value : 0 ms)" VALUE 0xa100130c _REC_VAL_20_s2 16.32 _CNV_A_R_LINEAR_____111_CM -8.192 8.128 DISPLAY_IDENTIFIER C_TD_S_AS /end CHARACTERISTIC
/begin CHARACTERISTIC ip_td_s "Dwell time correction versus battery voltage and engine speed for stratified mode" MAP 0xa100120c _REC_MAP_20_u2_u1_u1 262.14 _CNV_A_R_LINEAR_____111_CM 0. 262.14 DISPLAY_IDENTIFIER IP_TD_S FORMAT "%7.3"
 /begin AXIS_DESCR COM_AXIS vb _CNV_A_R_LINEAR_____289_CM 8 0. 25.8984375 FORMAT "%9.6" AXIS_PTS_REF ldpm_vb_1_igre /end AXIS_DESCR
 /begin AXIS_DESCR COM_AXIS n_32 _CNV_A_R_LINEAR_____9_CM 8 0. 8160. FORMAT "%4.0" AXIS_PTS_REF ldpm_n_32_1_igre /end AXIS_DESCR
/end CHARACTERISTIC
/begin MEASUREMENT td_s "Dwell time for stratified mode" UWORD _CNV_A_R_LINEAR_____111_CM 1 100. 0. 262.14 DISPLAY_IDENTIFIER TD_S ECU_ADDRESS 0xd00024e0 FORMAT "%7.3" /end MEASUREMENT
/begin CHARACTERISTIC c_td_s_ini "Initial value for dwell time control ( same for homogeneous and stratified mode ))" VALUE 0xa100130e _REC_VAL_20_u2 262.14 _CNV_A_R_LINEAR_____111_CM 0. 262.14 DISPLAY_IDENTIFIER C_TD_S_INI FORMAT "%7.3" /end CHARACTERISTIC
/begin AXIS_PTS ldpm_maf_hb_1_egtr "" 0xa1002454 NO_INPUT_QUANTITY _REC_AXS_20_u1 1389. _CNV_A_R_LINEAR_____14_CM 8 0. 1389. FORMAT "%4.0" /end AXIS_PTS
/begin AXIS_PTS ldpm_eff_cat_diag_1_egtr "" 0xa100244a online_dummy _REC_AXS_20_u1 1.9921875 _CNV_A_R_LINEAR_____100_CM 6 0. 1.9921875 FORMAT "%8.6" /end AXIS_PTS
/begin AXIS_PTS ldpm_n_32_1_egtr "" 0xa1002460 n_32 _REC_AXS_20_u1 8160. _CNV_A_R_LINEAR_____9_CM 8 0. 8160. FORMAT "%4.0" /end AXIS_PTS
/begin AXIS_PTS ldpm_n_32_3_egtr "" 0xa100246a n_32 _REC_AXS_20_u1 8160. _CNV_A_R_LINEAR_____9_CM 6 0. 8160. FORMAT "%4.0" /end AXIS_PTS
/begin CHARACTERISTIC c_vls_down_thd_cat_purge "Downstream voltage signal threshold for end of pre cat purge detection" VALUE 0xa1002c26 _REC_VAL_20_u2 4.9951171875 _CNV_A_R_LINEAR_____2_CM 0. 4.9951171875 DISPLAY_IDENTIFIER C_VLS_DOWN_THD_CAT_PURGE FORMAT "%5.3" /end CHARACTERISTIC
/begin AXIS_PTS ldp_temp_main_cat_purge_ip_fac "" 0xa10023f8 egtr[0].egtr_struct_defspcenri0.temp_main_cat_purge _REC_AXS_20_u2 2047.94 _CNV_A_R_EGTR_LINEA_821_CM 6 -273.15 1774.79 FORMAT "%9.4" /end AXIS_PTS
/begin AXIS_PTS ldp_maf_cyl_ip_lamb_sp "" 0xa100236c maf_cyl _REC_AXS_20_u2 2047.96875 _CNV_A_R_LINEAR_____207_CM 6 0. 2047.96875 FORMAT "%10.5" /end AXIS_PTS
/begin AXIS_PTS ldp_ratio_o2l_rls_ip_lamb_sp "" 0xa1002398 egtr[0].egtr_struct_defspcenr0.ratio_o2l_rls_cat_purge _REC_AXS_20_u1 0.99609375 _CNV_A_R_LINEAR_____27_CM 8 0. 0.99609375 FORMAT "%5.3" /end AXIS_PTS
/begin CHARACTERISTIC ip_fac_main_cat_purge "Weighting factor considering volume ratio (pre / main cat) and cat temperature (for main cat purge)" MAP 0xa10024b4 _REC_MAP_20_u1_u2_u1 1.9921875 _CNV_A_R_LINEAR_____100_CM 0. 1.9921875 DISPLAY_IDENTIFIER IP_FAC_MAIN_CAT_PURGE FORMAT "%8.6"
 /begin AXIS_DESCR COM_AXIS egtr[0].egtr_struct_defspcenri0.temp_main_cat_purge _CNV_A_R_EGTR_LINEA_821_CM 6 -273.15 1774.79 FORMAT "%9.4" AXIS_PTS_REF ldp_temp_main_cat_purge_ip_fac /end AXIS_DESCR
 /begin AXIS_DESCR COM_AXIS online_dummy _CNV_A_R_LINEAR_____100_CM 6 0. 1.9921875 FORMAT "%8.6" AXIS_PTS_REF ldpm_eff_cat_diag_1_egtr /end AXIS_DESCR
/end CHARACTERISTIC
/begin CHARACTERISTIC ip_lamb_sp_delta_cat_purge "Lambda set point shift of catalyst purge function" MAP 0xa1002974 _REC_MAP_20_u2_u2_u1 0.24992 _CNV_A_R_LINEAR_____23_CM 0. 0.24992 DISPLAY_IDENTIFIER IP_LAMB_SP_DELTA_CAT_PURGE FORMAT "%7.5"
 /begin AXIS_DESCR COM_AXIS maf_cyl _CNV_A_R_LINEAR_____207_CM 6 0. 2047.96875 FORMAT "%10.5" AXIS_PTS_REF ldp_maf_cyl_ip_lamb_sp /end AXIS_DESCR
 /begin AXIS_DESCR COM_AXIS egtr[0].egtr_struct_defspcenr0.ratio_o2l_rls_cat_purge _CNV_A_R_LINEAR_____27_CM 8 0. 0.99609375 FORMAT "%5.3" AXIS_PTS_REF ldp_ratio_o2l_rls_ip_lamb_sp /end AXIS_DESCR
/end CHARACTERISTIC
/begin CHARACTERISTIC c_fac_add_main_cat_purge_ch "Additional weighting factor to define oxygen loading for main cat purge after catalyst heating phase" VALUE 0xa1002b91 _REC_VAL_20_u1 1.9921875 _CNV_A_R_LINEAR_____100_CM 0. 1.9921875 DISPLAY_IDENTIFIER C_FAC_ADD_MAIN_CAT_PURGE_CH FORMAT "%8.6" /end CHARACTERISTIC
/begin CHARACTERISTIC c_fac_add_main_cat_purge_hst "Additional weighting factor to define oxygen loading for main cat purge after hot start" VALUE 0xa1002b93 _REC_VAL_20_u1 1.9921875 _CNV_A_R_LINEAR_____100_CM 0. 1.9921875 DISPLAY_IDENTIFIER C_FAC_ADD_MAIN_CAT_PURGE_HST FORMAT "%8.6" /end CHARACTERISTIC
/begin CHARACTERISTIC c_fac_add_main_cat_purge_sa "Additional weighting factor to define oxygen loading for main cat purge after secondary air injection" VALUE 0xa1002b94 _REC_VAL_20_u1 1.9921875 _CNV_A_R_LINEAR_____100_CM 0. 1.9921875 DISPLAY_IDENTIFIER C_FAC_ADD_MAIN_CAT_PURGE_SA FORMAT "%8.6" /end CHARACTERISTIC
/begin CHARACTERISTIC c_maf_int_puc_act_min_cat_purge "Minimum air mass flow integral during PUC to activate cat purge function" VALUE 0xa1002bda _REC_VAL_20_u2 2912.666666666671 _CNV_A_R_LINEAR_____329_CM 0. 2912.66666666667 DISPLAY_IDENTIFIER C_MAF_INT_PUC_ACT_MIN_CAT_PURGE FORMAT "%7.2" /end CHARACTERISTIC
/begin CHARACTERISTIC c_o2l_rls_max_pcat_purge "Upper limit of oxygen loading set point for pre cat purge" VALUE 0xa1002bea _REC_VAL_20_u2 2.616848958333331 _CNV_A_R_LINEAR_____822_CM 0. 2.61684895833333 DISPLAY_IDENTIFIER C_O2L_RLS_MAX_PCAT_PURGE FORMAT "%7.5" /end CHARACTERISTIC
/begin CHARACTERISTIC c_o2l_rls_sp_pcat_purge_ch "Oxygen loading to be purged after catalyst heating lean phase" VALUE 0xa1002bec _REC_VAL_20_u2 2.616848958333331 _CNV_A_R_LINEAR_____822_CM 0. 2.61684895833333 DISPLAY_IDENTIFIER C_O2L_RLS_SP_PCAT_PURGE_CH FORMAT "%7.5" /end CHARACTERISTIC
/begin CHARACTERISTIC c_o2l_rls_sp_pcat_purge_hst "Oxygen loading to be purged after hot start" VALUE 0xa1002bee _REC_VAL_20_u2 2.616848958333331 _CNV_A_R_LINEAR_____822_CM 0. 2.61684895833333 DISPLAY_IDENTIFIER C_O2L_RLS_SP_PCAT_PURGE_HST FORMAT "%7.5" /end CHARACTERISTIC
/begin CHARACTERISTIC c_o2l_rls_sp_pcat_purge_sa "Oxygen loading to be purged after secondary air injection" VALUE 0xa1002bf0 _REC_VAL_20_u2 2.616848958333331 _CNV_A_R_LINEAR_____822_CM 0. 2.61684895833333 DISPLAY_IDENTIFIER C_O2L_RLS_SP_PCAT_PURGE_SA FORMAT "%7.5" /end CHARACTERISTIC
/begin CHARACTERISTIC c_tco_thd_cat_purge_hst "Temperature threshold for hot start detection of cat purge function" VALUE 0xa1002c12 _REC_VAL_20_u1 190.5 _CNV_A_R_LINEAR_____16_CM -48. 142.5 DISPLAY_IDENTIFIER C_TCO_THD_CAT_PURGE_HST FORMAT "%6.2" /end CHARACTERISTIC
/begin AXIS_PTS ldp_maf_int_puc_act_ip_o2l_rls "" 0xa100237c online_dummy _REC_AXS_20_u2 2912.666666666671 _CNV_A_R_LINEAR_____329_CM 6 0. 2912.66666666667 FORMAT "%7.2" /end AXIS_PTS
/begin AXIS_PTS ldp_temp_cat_ip_fac_pcat_purge "" 0xa10023d4 online_dummy _REC_AXS_20_u2 2047.9375 _CNV_A_R_LINEAR_____204_CM 6 -273.15 1774.7875 FORMAT "%9.4" /end AXIS_PTS
/begin CHARACTERISTIC ip_o2l_rls_sp_pcat_purge_puc "Oxygen loading to be purged after pull cut off phase" CURVE 0xa10029ec _REC_CUR_20_u2_u2 2.616848958333331 _CNV_A_R_LINEAR_____822_CM 0. 2.61684895833333 DISPLAY_IDENTIFIER IP_O2L_RLS_SP_PCAT_PURGE_PUC FORMAT "%7.5"
 /begin AXIS_DESCR COM_AXIS online_dummy _CNV_A_R_LINEAR_____329_CM 6 0. 2912.66666666667 FORMAT "%7.2" AXIS_PTS_REF ldp_maf_int_puc_act_ip_o2l_rls /end AXIS_DESCR
/end CHARACTERISTIC
/begin CHARACTERISTIC ip_fac_o2l_rls_sp_pcat_purge "Weighting factor for oxygen loading to be released during pre cat purge" MAP 0xa10025d8 _REC_MAP_20_u1_u2_u1 0.99609375 _CNV_A_R_LINEAR_____27_CM 0. 0.99609375 DISPLAY_IDENTIFIER IP_FAC_O2L_RLS_SP_PCAT_PURGE FORMAT "%5.3"
 /begin AXIS_DESCR COM_AXIS online_dummy _CNV_A_R_LINEAR_____204_CM 6 -273.15 1774.7875 FORMAT "%9.4" AXIS_PTS_REF ldp_temp_cat_ip_fac_pcat_purge /end AXIS_DESCR
 /begin AXIS_DESCR COM_AXIS online_dummy _CNV_A_R_LINEAR_____100_CM 6 0. 1.9921875 FORMAT "%8.6" AXIS_PTS_REF ldpm_eff_cat_diag_1_egtr /end AXIS_DESCR
/end CHARACTERISTIC
/begin CHARACTERISTIC c_fac_add_main_cat_purge_gs_scc "Additional weighting factor for pre and main cat differences in case of gear shift with cylinder cut off" VALUE 0xa1002b92 _REC_VAL_20_u1 1.9921875 _CNV_A_R_LINEAR_____100_CM 0. 1.9921875 DISPLAY_IDENTIFIER C_FAC_ADD_MAIN_CAT_PURGE_GS_SCC FORMAT "%8.6" /end CHARACTERISTIC
/begin CHARACTERISTIC c_maf_int_gs_scc_min_cat_purge "Minimum air mass flow integral during cylinder cut-off at gear-shift to activate cat purge function" VALUE 0xa1002bd4 _REC_VAL_20_u2 2912.666666666671 _CNV_A_R_LINEAR_____329_CM 0. 2912.66666666667 DISPLAY_IDENTIFIER C_MAF_INT_GS_SCC_MIN_CAT_PURGE FORMAT "%7.2" /end CHARACTERISTIC
/begin CHARACTERISTIC c_maf_cyl_max_cat_purge "Maximum air mass flow threshold for cat purge activation" VALUE 0xa1002bca _REC_VAL_20_u2 2047.96875 _CNV_A_R_LINEAR_____207_CM 0. 2047.96875 DISPLAY_IDENTIFIER C_MAF_CYL_MAX_CAT_PURGE FORMAT "%10.5" /end CHARACTERISTIC
/begin CHARACTERISTIC c_n_max_cat_purge "Maximum engine speed for cat purge activation" VALUE 0xa1002be6 _REC_VAL_20_u1 8160. _CNV_A_R_LINEAR_____9_CM 0. 8160. DISPLAY_IDENTIFIER C_N_MAX_CAT_PURGE FORMAT "%4.0" /end CHARACTERISTIC
/begin CHARACTERISTIC c_tco_min_cat_purge "Minimum TCO threshold for cat purge activation" VALUE 0xa1002c11 _REC_VAL_20_u1 190.5 _CNV_A_R_LINEAR_____16_CM -48. 142.5 DISPLAY_IDENTIFIER C_TCO_MIN_CAT_PURGE FORMAT "%6.2" /end CHARACTERISTIC
/begin CHARACTERISTIC c_temp_dif_pcat_main_cat_purge[0] "Temperature difference between pre and main cat" VALUE 0xa1002c16 _REC_VAL_20_u2 2047.9375 _CNV_A_R_LINEAR_____204_CM -273.15 1774.7875 DISPLAY_IDENTIFIER C_TEMP_DIF_PCAT_MAIN_CAT_PURGE[1] FORMAT "%9.4" /end CHARACTERISTIC
/begin CHARACTERISTIC c_temp_dif_pcat_main_cat_purge[1] "Temperature difference between pre and main cat" VALUE 0xa1002c18 _REC_VAL_20_u2 2047.9375 _CNV_A_R_LINEAR_____204_CM -273.15 1774.7875 DISPLAY_IDENTIFIER C_TEMP_DIF_PCAT_MAIN_CAT_PURGE[2] FORMAT "%9.4" /end CHARACTERISTIC
/begin CHARACTERISTIC lc_cat_purge_inh[0] "Calibration flag to force cat purge function to be inhibited" VALUE 0xa1002c30 _REC_VAL_20_u1 1. _CNV_A_R_LINEAR_____0_CM 0. 1. DISPLAY_IDENTIFIER LC_CAT_PURGE_INH[1] FORMAT "%1.0" /end CHARACTERISTIC
/begin CHARACTERISTIC lc_cat_purge_inh[1] "Calibration flag to force cat purge function to be inhibited" VALUE 0xa1002c31 _REC_VAL_20_u1 1. _CNV_A_R_LINEAR_____0_CM 0. 1. DISPLAY_IDENTIFIER LC_CAT_PURGE_INH[2] FORMAT "%1.0" /end CHARACTERISTIC
/begin MEASUREMENT lv_gs_scc "Cylinder cut of during gear shift" UBYTE _CNV_S_2_RANGE__0___1_CM 1 100. 0. 1. DISPLAY_IDENTIFIER LV_GS_SCC ECU_ADDRESS 0xd0002dc0 BIT_MASK 0x1 /end MEASUREMENT
/begin MEASUREMENT maf_int_puc_act "Air mass flow integral during pull cut off phase" UWORD _CNV_A_R_LINEAR_____329_CM 1 100. 0. 2912.66666666667 DISPLAY_IDENTIFIER MAF_INT_PUC_ACT ECU_ADDRESS 0xd000254c FORMAT "%7.2" /end MEASUREMENT
/begin MEASUREMENT maf_int_puc_not_act "Air mass flow integral during not pull cut off phase" UWORD _CNV_A_R_LINEAR_____329_CM 1 100. 0. 2912.66666666667 DISPLAY_IDENTIFIER MAF_INT_PUC_NOT_ACT ECU_ADDRESS 0xd000254e FORMAT "%7.2" /end MEASUREMENT
/begin MEASUREMENT maf_int_gs_scc "Air mass flow integral at cylinder cut of during gear shift phase" UWORD _CNV_A_R_LINEAR_____329_CM 1 100. 0. 2912.66666666667 DISPLAY_IDENTIFIER MAF_INT_GS_SCC ECU_ADDRESS 0xd000254a FORMAT "%7.2" /end MEASUREMENT
/begin CHARACTERISTIC lc_ns_2_deac "Force usage of first NOx sensor for cat purge of both banks" VALUE 0xa1002c3f _REC_VAL_20_u1 1. _CNV_A_R_LINEAR_____0_CM 0. 1. DISPLAY_IDENTIFIER LC_NS_2_DEAC FORMAT "%1.0" /end CHARACTERISTIC
/begin AXIS_PTS ldp_maf_cyl_ip_lamb_add_purge "" 0xa100235c maf_cyl _REC_AXS_20_u2 2047.96875 _CNV_A_R_LINEAR_____207_CM 6 0. 2047.96875 FORMAT "%10.5" /end AXIS_PTS
/begin AXIS_PTS ldp_vls_nox_sens_ip_lamb_add "" 0xa1002438 online_dummy _REC_AXS_20_u2 1400. _CNV_A_R_LINEAR_____211_CM 8 -200. 1200. FORMAT "%4.0" /end AXIS_PTS
/begin CHARACTERISTIC ip_lamb_add_purge "Delta lambda map for cat purge after lean mode" MAP 0xa10026fc _REC_MAP_20_u2_u2_u2 0.24993896484375 _CNV_A_R_LINEAR_____23_CM 0. 0.24993896484375 DISPLAY_IDENTIFIER IP_LAMB_ADD_PURGE FORMAT "%7.5"
 /begin AXIS_DESCR COM_AXIS maf_cyl _CNV_A_R_LINEAR_____207_CM 6 0. 2047.96875 FORMAT "%10.5" AXIS_PTS_REF ldp_maf_cyl_ip_lamb_add_purge /end AXIS_DESCR
 /begin AXIS_DESCR COM_AXIS online_dummy _CNV_A_R_LINEAR_____211_CM 8 -200. 1200. FORMAT "%4.0" AXIS_PTS_REF ldp_vls_nox_sens_ip_lamb_add /end AXIS_DESCR
/end CHARACTERISTIC
/begin MEASUREMENT lv_lamb_pls_syn_cbk "Flag used for exhaust gas bank synchonization" UBYTE _CNV_S_2_RANGE__0___1_CM 1 100. 0. 1. DISPLAY_IDENTIFIER LV_LAMB_PLS_SYN_CBK ECU_ADDRESS 0xd0002dc1 BIT_MASK 0x1 /end MEASUREMENT
/begin CHARACTERISTIC c_lamb_sp_de_thd_lamb_pls_off "Upper threshold of cat purge deviation for de-activating the forced stimulation" VALUE 0xa1002bba _REC_VAL_20_u2 0.24992 _CNV_A_R_LINEAR_____23_CM 0. 0.24992 DISPLAY_IDENTIFIER C_LAMB_SP_DE_THD_LAMB_PLS_OFF FORMAT "%7.5" /end CHARACTERISTIC
/begin CHARACTERISTIC c_lamb_sp_de_thd_lamb_pls_on "Lower threshold of cat purge deviation for activating the forced stimulation" VALUE 0xa1002bbc _REC_VAL_20_u2 0.24992 _CNV_A_R_LINEAR_____23_CM 0. 0.24992 DISPLAY_IDENTIFIER C_LAMB_SP_DE_THD_LAMB_PLS_ON FORMAT "%7.5" /end CHARACTERISTIC
/begin CHARACTERISTIC c_lamb_sp_max_lamb_pls_act "Maximum lambda set point for forced lambda stimulation activation" VALUE 0xa1002bbe _REC_VAL_20_u2 1.99993896484375 _CNV_A_R_LINEAR_____23_CM 0. 1.99993896484375 DISPLAY_IDENTIFIER C_LAMB_SP_MAX_LAMB_PLS_ACT FORMAT "%7.5" /end CHARACTERISTIC
/begin CHARACTERISTIC c_lamb_sp_min_lamb_pls_act "Minimum lambda set point for forced lambda stimulation activation" VALUE 0xa1002bc0 _REC_VAL_20_u2 1.99993896484375 _CNV_A_R_LINEAR_____23_CM 0. 1.99993896484375 DISPLAY_IDENTIFIER C_LAMB_SP_MIN_LAMB_PLS_ACT FORMAT "%7.5" /end CHARACTERISTIC
/begin CHARACTERISTIC c_maf_int_min_lamb_pls_act "Threshold for the air mass flow integral for the activation of the forced stimulation" VALUE 0xa1002bd8 _REC_VAL_20_u2 1456.33 _CNV_A_R_LACO_LINEA_390_CM 0. 1456.33 DISPLAY_IDENTIFIER C_MAF_INT_MIN_LAMB_PLS_ACT FORMAT "%11.6" /end CHARACTERISTIC
/begin CHARACTERISTIC c_temp_cat_min_lamb_pls_act "Minimum value of the catalyst temperature for the activation of the forced stimulation" VALUE 0xa1002c14 _REC_VAL_20_u2 2047.94 _CNV_A_R_EGTR_LINEA_821_CM -273.15 1774.79 DISPLAY_IDENTIFIER C_TEMP_CAT_MIN_LAMB_PLS_ACT FORMAT "%9.4" /end CHARACTERISTIC
/begin CHARACTERISTIC c_fac_dif_thd_afl_pls_on "Lambda control difference threshold for re-activating lean stimulation half wave" VALUE 0xa1002b98 _REC_VAL_20_s2 1.999969482421875 _CNV_A_R_LINEAR_____275_CM -1. 0.999969482421875 DISPLAY_IDENTIFIER C_FAC_DIF_THD_AFL_PLS_ON FORMAT "%8.5" /end CHARACTERISTIC
/begin CHARACTERISTIC c_fac_dif_thd_afl_pls_off "Lambda control difference threshold for deactivating lean stimulation half wave" VALUE 0xa1002b96 _REC_VAL_20_s2 0.999969482421875 _CNV_A_R_LINEAR_____275_CM 0. 0.999969482421875 DISPLAY_IDENTIFIER C_FAC_DIF_THD_AFL_PLS_OFF FORMAT "%8.5" /end CHARACTERISTIC
/begin CHARACTERISTIC c_fac_dif_thd_afr_pls_off "Lambda control difference threshold for deactivating rich stimulation half wave" VALUE 0xa1002b9a _REC_VAL_20_s2 0.9999900000000002 _CNV_A_R_LINEAR_____275_CM -1. -1.e-005 DISPLAY_IDENTIFIER C_FAC_DIF_THD_AFR_PLS_OFF FORMAT "%8.5" /end CHARACTERISTIC
/begin CHARACTERISTIC c_fac_dif_thd_afr_pls_on "Lambda control difference threshold for re-activating rich stimulation half wave" VALUE 0xa1002b9c _REC_VAL_20_s2 1.999969482421875 _CNV_A_R_LINEAR_____275_CM -1. 0.999969482421875 DISPLAY_IDENTIFIER C_FAC_DIF_THD_AFR_PLS_ON FORMAT "%8.5" /end CHARACTERISTIC
/begin CHARACTERISTIC lc_lamb_pls_cor_act_is "Calibration flag indicating that corrective action for lambda stimulation is allowed in idle speed" VALUE 0xa1002c38 _REC_VAL_20_u1 1. _CNV_A_R_LINEAR_____0_CM 0. 1. DISPLAY_IDENTIFIER LC_LAMB_PLS_COR_ACT_IS FORMAT "%1.0" /end CHARACTERISTIC
/begin MEASUREMENT state_lamb_pls_det_value "State variable of forced lambda stimulation parameter determination" UBYTE _CNV_S_7_EGTR_RANGE_823_CM 1 100. 0. 6. DISPLAY_IDENTIFIER STATE_LAMB_PLS_DET_VALUE ECU_ADDRESS 0xd0002dc4 /end MEASUREMENT
/begin MEASUREMENT lamb_sp_de_pls "Amplitude of the forced lambda stimulation" UWORD _CNV_A_R_LINEAR_____23_CM 1 100. 0. 0.1249389 DISPLAY_IDENTIFIER LAMB_SP_DE_PLS ECU_ADDRESS 0xd0002546 FORMAT "%7.5" /end MEASUREMENT
/begin MEASUREMENT lamb_delta_max_pls "Lambda set point deviation step height per sample step" UWORD _CNV_A_R_LINEAR_____23_CM 1 100. 0. 0.24992 DISPLAY_IDENTIFIER LAMB_DELTA_MAX_PLS ECU_ADDRESS 0xd0002544 FORMAT "%7.5" /end MEASUREMENT
/begin MEASUREMENT ctr_step_pls_nom_cat_diag "Step counter to switch between nominal and cat diagnosis forced stimulation" UBYTE _CNV_A_R_LINEAR_____0_CM 1 100. 0. 7. DISPLAY_IDENTIFIER CTR_STEP_PLS_NOM_CAT_DIAG ECU_ADDRESS 0xc0001a38 FORMAT "%3.0" /end MEASUREMENT
/begin CHARACTERISTIC c_lamb_delta_max_is_pls "Lambda set point deviation step height per sample step for forced stimulation in case of idle speed" VALUE 0xa1002bac _REC_VAL_20_u2 0.24992 _CNV_A_R_LINEAR_____23_CM 0. 0.24992 DISPLAY_IDENTIFIER C_LAMB_DELTA_MAX_IS_PLS FORMAT "%7.5" /end CHARACTERISTIC
/begin CHARACTERISTIC c_lamb_delta_max_lsh_diag_pls "Lambda set point deviation step height per sample step for forced stimulation requested by sensor heater " VALUE 0xa1002bae _REC_VAL_20_u2 0.24992 _CNV_A_R_LINEAR_____23_CM 0. 0.24992 DISPLAY_IDENTIFIER C_LAMB_DELTA_MAX_LSH_DIAG_PLS FORMAT "%7.5" /end CHARACTERISTIC
/begin CHARACTERISTIC c_lamb_sp_de_dyn_diag_pls "Amplitude of the forced lambda stimulation in case of active WRAF sensor dynamic diagnosis" VALUE 0xa1002bb4 _REC_VAL_20_u2 0.1249389 _CNV_A_R_LINEAR_____23_CM 0. 0.1249389 DISPLAY_IDENTIFIER C_LAMB_SP_DE_DYN_DIAG_PLS FORMAT "%7.5" /end CHARACTERISTIC
/begin CHARACTERISTIC c_lamb_sp_de_is_pls "Amplitude of forced stimulation in case of idle speed" VALUE 0xa1002bb6 _REC_VAL_20_u2 0.1249389 _CNV_A_R_LINEAR_____23_CM 0. 0.1249389 DISPLAY_IDENTIFIER C_LAMB_SP_DE_IS_PLS FORMAT "%7.5" /end CHARACTERISTIC
/begin CHARACTERISTIC c_lamb_sp_de_lsh_diag_pls "Amplitude of forced stimulation requested by sensor heater diagnosis" VALUE 0xa1002bb8 _REC_VAL_20_u2 0.1249389 _CNV_A_R_LINEAR_____23_CM 0. 0.1249389 DISPLAY_IDENTIFIER C_LAMB_SP_DE_LSH_DIAG_PLS FORMAT "%7.5" /end CHARACTERISTIC
/begin CHARACTERISTIC c_nr_step_pls_nom_cat_diag "Number of lean - rich steps to switch between nominal and cat diagnosis forced stimulation" VALUE 0xa1002be7 _REC_VAL_20_u1 7. _CNV_A_R_LINEAR_____0_CM 0. 7. DISPLAY_IDENTIFIER C_NR_STEP_PLS_NOM_CAT_DIAG FORMAT "%3.0" /end CHARACTERISTIC
/begin MEASUREMENT o2l_sp_pls "Oxygen loading set point for forced lambda stimulation" UWORD _CNV_A_R_LINEAR_____822_CM 1 100. 0. 2.61684895833333 DISPLAY_IDENTIFIER O2L_SP_PLS ECU_ADDRESS 0xd0002550 FORMAT "%7.5" /end MEASUREMENT
/begin CHARACTERISTIC c_o2l_sp_is_pls "Oxygen loading set point for forced lambda stimulation in case of idle speed" VALUE 0xa1002bf2 _REC_VAL_20_u2 2.616848958333331 _CNV_A_R_LINEAR_____822_CM 0. 2.61684895833333 DISPLAY_IDENTIFIER C_O2L_SP_IS_PLS FORMAT "%7.5" /end CHARACTERISTIC
/begin CHARACTERISTIC c_o2l_sp_lsh_diag_pls "Oxygen loading set point for forced lambda stimulation requested by sensor heater diagnosis" VALUE 0xa1002bf4 _REC_VAL_20_u2 2.616848958333331 _CNV_A_R_LINEAR_____822_CM 0. 2.61684895833333 DISPLAY_IDENTIFIER C_O2L_SP_LSH_DIAG_PLS FORMAT "%7.5" /end CHARACTERISTIC
/begin AXIS_PTS ldp_eff_cat_diag_ip_fac_1_pls "" 0xa100232c online_dummy _REC_AXS_20_u1 1.9921875 _CNV_A_R_LINEAR_____100_CM 4 0. 1.9921875 FORMAT "%8.6" /end AXIS_PTS
/begin AXIS_PTS ldp_t_ast_ip_fac_2_pls "" 0xa10023a4 t_ast _REC_AXS_20_u2 6553.5 _CNV_A_R_LINEAR_____4_CM 4 0. 6553.5 FORMAT "%6.1" /end AXIS_PTS
/begin CHARACTERISTIC ip_fac_2_lamb_sp_de_pls "Second factor for forced stimulation amplitude(depending on time after start and cat temperature)" MAP 0xa100249c _REC_MAP_20_u1_u2_u2 1.9921875 _CNV_A_R_LINEAR_____100_CM 0. 1.9921875 DISPLAY_IDENTIFIER IP_FAC_2_LAMB_SP_DE_PLS FORMAT "%8.6"
 /begin AXIS_DESCR COM_AXIS t_ast _CNV_A_R_LINEAR_____4_CM 4 0. 6553.5 FORMAT "%6.1" AXIS_PTS_REF ldp_t_ast_ip_fac_2_pls /end AXIS_DESCR
 /begin AXIS_DESCR COM_AXIS online_dummy _CNV_A_R_EGTR_LINEA_821_CM 4 -273.15 1774.79 FORMAT "%9.4" AXIS_PTS_REF ldp_temp_cat_ip_fac_2_pls /end AXIS_DESCR
/end CHARACTERISTIC
/begin AXIS_PTS ldp_temp_cat_ip_fac_2_pls "" 0xa10023c8 online_dummy _REC_AXS_20_u2 2047.94 _CNV_A_R_EGTR_LINEA_821_CM 4 -273.15 1774.79 FORMAT "%9.4" /end AXIS_PTS
/begin CHARACTERISTIC ip_fac_1_lamb_sp_de_pls "First factor for forced stimulation amplitude (depending on maximal value of EFF_CAT_DIAG[i])" CURVE 0xa1002498 _REC_CUR_20_u1_u1 1.9921875 _CNV_A_R_LINEAR_____100_CM 0. 1.9921875 DISPLAY_IDENTIFIER IP_FAC_1_LAMB_SP_DE_PLS FORMAT "%8.6"
 /begin AXIS_DESCR COM_AXIS online_dummy _CNV_A_R_LINEAR_____100_CM 4 0. 1.9921875 FORMAT "%8.6" AXIS_PTS_REF ldp_eff_cat_diag_ip_fac_1_pls /end AXIS_DESCR
/end CHARACTERISTIC
/begin CHARACTERISTIC ip_lamb_delta_max_cat_diag_pls "Lambda set point deviation step height per sample step for forced stimulation in case of active catalyst diagnosis" MAP 0xa1002774 _REC_MAP_20_u2_u1_u1 0.24992 _CNV_A_R_LINEAR_____23_CM 0. 0.24992 DISPLAY_IDENTIFIER IP_LAMB_DELTA_MAX_CAT_DIAG_PLS FORMAT "%7.5"
 /begin AXIS_DESCR COM_AXIS n_32 _CNV_A_R_LINEAR_____9_CM 8 0. 8160. FORMAT "%4.0" AXIS_PTS_REF ldpm_n_32_1_egtr /end AXIS_DESCR
 /begin AXIS_DESCR COM_AXIS NO_INPUT_QUANTITY _CNV_A_R_LINEAR_____14_CM 8 0. 1389. FORMAT "%4.0" AXIS_PTS_REF ldpm_maf_hb_1_egtr /end AXIS_DESCR
/end CHARACTERISTIC
/begin CHARACTERISTIC ip_lamb_delta_max_nom_pls "Lambda set point deviation step height per sample step for nominal forced stimulation" MAP 0xa10027f4 _REC_MAP_20_u2_u1_u1 0.24992 _CNV_A_R_LINEAR_____23_CM 0. 0.24992 DISPLAY_IDENTIFIER IP_LAMB_DELTA_MAX_NOM_PLS FORMAT "%7.5"
 /begin AXIS_DESCR COM_AXIS n_32 _CNV_A_R_LINEAR_____9_CM 8 0. 8160. FORMAT "%4.0" AXIS_PTS_REF ldpm_n_32_1_egtr /end AXIS_DESCR
 /begin AXIS_DESCR COM_AXIS NO_INPUT_QUANTITY _CNV_A_R_LINEAR_____14_CM 8 0. 1389. FORMAT "%4.0" AXIS_PTS_REF ldpm_maf_hb_1_egtr /end AXIS_DESCR
/end CHARACTERISTIC
/begin CHARACTERISTIC ip_lamb_sp_de_cat_diag_pls "Amplitude of forced stimulation in case of active catalyst diagnosis" MAP 0xa1002874 _REC_MAP_20_u2_u1_u1 0.1249389 _CNV_A_R_LINEAR_____23_CM 0. 0.1249389 DISPLAY_IDENTIFIER IP_LAMB_SP_DE_CAT_DIAG_PLS FORMAT "%7.5"
 /begin AXIS_DESCR COM_AXIS n_32 _CNV_A_R_LINEAR_____9_CM 8 0. 8160. FORMAT "%4.0" AXIS_PTS_REF ldpm_n_32_1_egtr /end AXIS_DESCR
 /begin AXIS_DESCR COM_AXIS NO_INPUT_QUANTITY _CNV_A_R_LINEAR_____14_CM 8 0. 1389. FORMAT "%4.0" AXIS_PTS_REF ldpm_maf_hb_1_egtr /end AXIS_DESCR
/end CHARACTERISTIC
/begin CHARACTERISTIC ip_lamb_sp_de_nom_pls "Amplitude of nominal forced stimulation" MAP 0xa10028f4 _REC_MAP_20_u2_u1_u1 0.1249389 _CNV_A_R_LINEAR_____23_CM 0. 0.1249389 DISPLAY_IDENTIFIER IP_LAMB_SP_DE_NOM_PLS FORMAT "%7.5"
 /begin AXIS_DESCR COM_AXIS n_32 _CNV_A_R_LINEAR_____9_CM 8 0. 8160. FORMAT "%4.0" AXIS_PTS_REF ldpm_n_32_1_egtr /end AXIS_DESCR
 /begin AXIS_DESCR COM_AXIS NO_INPUT_QUANTITY _CNV_A_R_LINEAR_____14_CM 8 0. 1389. FORMAT "%4.0" AXIS_PTS_REF ldpm_maf_hb_1_egtr /end AXIS_DESCR
/end CHARACTERISTIC
/begin CHARACTERISTIC ip_o2l_sp_cat_diag_pls "Oxygen loading set point for forced lambda stimulation in case of active catalyst diagnosis" MAP 0xa10029f8 _REC_MAP_20_u2_u1_u1 2.616848958333331 _CNV_A_R_LINEAR_____822_CM 0. 2.61684895833333 DISPLAY_IDENTIFIER IP_O2L_SP_CAT_DIAG_PLS FORMAT "%7.5"
 /begin AXIS_DESCR COM_AXIS n_32 _CNV_A_R_LINEAR_____9_CM 8 0. 8160. FORMAT "%4.0" AXIS_PTS_REF ldpm_n_32_1_egtr /end AXIS_DESCR
 /begin AXIS_DESCR COM_AXIS NO_INPUT_QUANTITY _CNV_A_R_LINEAR_____14_CM 8 0. 1389. FORMAT "%4.0" AXIS_PTS_REF ldpm_maf_hb_1_egtr /end AXIS_DESCR
/end CHARACTERISTIC
/begin CHARACTERISTIC ip_o2l_sp_dyn_diag_pls "Oxygen loading set point for forced lambda stimulation in case of active dynamic WRAF sensor diagnosis" MAP 0xa1002a78 _REC_MAP_20_u2_u1_u1 2.616848958333331 _CNV_A_R_LINEAR_____822_CM 0. 2.61684895833333 DISPLAY_IDENTIFIER IP_O2L_SP_DYN_DIAG_PLS FORMAT "%7.5"
 /begin AXIS_DESCR COM_AXIS n_32 _CNV_A_R_LINEAR_____9_CM 8 0. 8160. FORMAT "%4.0" AXIS_PTS_REF ldpm_n_32_1_egtr /end AXIS_DESCR
 /begin AXIS_DESCR COM_AXIS NO_INPUT_QUANTITY _CNV_A_R_LINEAR_____14_CM 8 0. 1389. FORMAT "%4.0" AXIS_PTS_REF ldpm_maf_hb_1_egtr /end AXIS_DESCR
/end CHARACTERISTIC
/begin CHARACTERISTIC ip_o2l_sp_nom_pls "Oxygen loading set point for nominal forced lambda stimulation" MAP 0xa1002af8 _REC_MAP_20_u2_u1_u1 2.616848958333331 _CNV_A_R_LINEAR_____822_CM 0. 2.61684895833333 DISPLAY_IDENTIFIER IP_O2L_SP_NOM_PLS FORMAT "%7.5"
 /begin AXIS_DESCR COM_AXIS n_32 _CNV_A_R_LINEAR_____9_CM 8 0. 8160. FORMAT "%4.0" AXIS_PTS_REF ldpm_n_32_1_egtr /end AXIS_DESCR
 /begin AXIS_DESCR COM_AXIS NO_INPUT_QUANTITY _CNV_A_R_LINEAR_____14_CM 8 0. 1389. FORMAT "%4.0" AXIS_PTS_REF ldpm_maf_hb_1_egtr /end AXIS_DESCR
/end CHARACTERISTIC
/begin CHARACTERISTIC lc_lamb_sti_off_lsl_ofs_adj "Calibration flag to allow inhibition of lambda stimulation during offset adjustment" VALUE 0xa1002c3c _REC_VAL_20_u1 1. _CNV_A_R_LINEAR_____0_CM 0. 1. DISPLAY_IDENTIFIER LC_LAMB_STI_OFF_LSL_OFS_ADJ FORMAT "%1.0" /end CHARACTERISTIC
/begin CHARACTERISTIC lc_lamb_pls_inh[0] "Calibration flag to force lambda stimulation to be inhibited" VALUE 0xa1002c3a _REC_VAL_20_u1 1. _CNV_A_R_LINEAR_____0_CM 0. 1. DISPLAY_IDENTIFIER LC_LAMB_PLS_INH[1] FORMAT "%1.0" /end CHARACTERISTIC
/begin CHARACTERISTIC lc_lamb_pls_inh[1] "Calibration flag to force lambda stimulation to be inhibited" VALUE 0xa1002c3b _REC_VAL_20_u1 1. _CNV_A_R_LINEAR_____0_CM 0. 1. DISPLAY_IDENTIFIER LC_LAMB_PLS_INH[2] FORMAT "%1.0" /end CHARACTERISTIC
/begin CHARACTERISTIC c_ctr_min_cat_diag "min. number of required monitoring cycles for catalyst diagnosis" VALUE 0xa1002b88 _REC_VAL_20_u2 511. _CNV_A_R_LINEAR_____0_CM 0. 511. DISPLAY_IDENTIFIER C_CTR_MIN_CAT_DIAG FORMAT "%5.0" /end CHARACTERISTIC
/begin CHARACTERISTIC c_ctr_min_cat_diag_eol "min. threshold of required monitoring cycles for catalyst diagnosis at eol test" VALUE 0xa1002b8a _REC_VAL_20_u2 511. _CNV_A_R_LINEAR_____0_CM 0. 511. DISPLAY_IDENTIFIER C_CTR_MIN_CAT_DIAG_EOL FORMAT "%5.0" /end CHARACTERISTIC
/begin CHARACTERISTIC c_ctr_lamb_out_cat_diag "threshold to switch off cat diag due to to lamb_cat_down_mv is not in the right range" VALUE 0xa1002b86 _REC_VAL_20_u1 255. _CNV_A_R_LINEAR_____0_CM 0. 255. DISPLAY_IDENTIFIER C_CTR_LAMB_OUT_CAT_DIAG FORMAT "%3.0" /end CHARACTERISTIC
/begin CHARACTERISTIC c_lamb_cat_mv_dif_max "max. allowed lamb_cat_down_mv[i] fluctuation between 2 subsequent monitoring cycles" VALUE 0xa1002ba2 _REC_VAL_20_u2 1.99996948242188 _CNV_A_R_LINEAR_____8_CM 0. 1.99996948242188 DISPLAY_IDENTIFIER C_LAMB_CAT_MV_DIF_MAX FORMAT "%7.5" /end CHARACTERISTIC
/begin CHARACTERISTIC c_lamb_cat_mv_max "max. lamb_cat_down_mv[i] threshold for a valid monitoring cycle" VALUE 0xa1002ba4 _REC_VAL_20_u2 1.99996948242188 _CNV_A_R_LINEAR_____8_CM 0. 1.99996948242188 DISPLAY_IDENTIFIER C_LAMB_CAT_MV_MAX FORMAT "%7.5" /end CHARACTERISTIC
/begin CHARACTERISTIC c_lamb_cat_mv_max_eol "max. lamb_cat_mv threshold for a valid monitoring cycle" VALUE 0xa1002ba6 _REC_VAL_20_u2 1.99996948242188 _CNV_A_R_LINEAR_____8_CM 0. 1.99996948242188 DISPLAY_IDENTIFIER C_LAMB_CAT_MV_MAX_EOL FORMAT "%7.5" /end CHARACTERISTIC
/begin CHARACTERISTIC c_lamb_cat_mv_min "min. lamb_cat_down_mv[i] threshold for a valid monitoring cycle" VALUE 0xa1002ba8 _REC_VAL_20_u2 1.99996948242188 _CNV_A_R_LINEAR_____8_CM 0. 1.99996948242188 DISPLAY_IDENTIFIER C_LAMB_CAT_MV_MIN FORMAT "%7.5" /end CHARACTERISTIC
/begin CHARACTERISTIC c_lamb_cat_mv_delta_max "max. allowed fluctuation between lamb_cat_down[i] and lamb_cat_down_mv[i] fin the same monitoring cycle" VALUE 0xa1002ba0 _REC_VAL_20_u2 1.99996948242188 _CNV_A_R_LINEAR_____8_CM 0. 1.99996948242188 DISPLAY_IDENTIFIER C_LAMB_CAT_MV_DELTA_MAX FORMAT "%7.5" /end CHARACTERISTIC
/begin CHARACTERISTIC c_n_32_cat_diag_deac "engine speed threshold to deactivate catalyst diagnosis to save ecu performance" VALUE 0xa1002be0 _REC_VAL_20_u1 8160. _CNV_A_R_LINEAR_____9_CM 0. 8160. DISPLAY_IDENTIFIER C_N_32_CAT_DIAG_DEAC FORMAT "%4.0" /end CHARACTERISTIC
/begin AXIS_PTS ldp_vls_down_ip_lamb_cat "" 0xa100241c NO_INPUT_QUANTITY _REC_AXS_20_u2 4.9951171875 _CNV_A_R_LINEAR_____2_CM 12 0. 4.9951171875 FORMAT "%5.3" /end AXIS_PTS
/begin CHARACTERISTIC ip_fac_mass_o2_cat_diag_at "weight factor of downstream sensor signal integral for automatic transmission" MAP 0xa10024d8 _REC_MAP_20_u2_u1_u1 1.99996948242188 _CNV_A_R_LINEAR_____8_CM 0. 1.99996948242188 DISPLAY_IDENTIFIER IP_FAC_MASS_O2_CAT_DIAG_AT FORMAT "%7.5"
 /begin AXIS_DESCR COM_AXIS n_32 _CNV_A_R_LINEAR_____9_CM 8 0. 8160. FORMAT "%4.0" AXIS_PTS_REF ldpm_n_32_1_egtr /end AXIS_DESCR
 /begin AXIS_DESCR COM_AXIS NO_INPUT_QUANTITY _CNV_A_R_LINEAR_____14_CM 8 0. 1389. FORMAT "%4.0" AXIS_PTS_REF ldpm_maf_hb_1_egtr /end AXIS_DESCR
/end CHARACTERISTIC
/begin CHARACTERISTIC ip_fac_mass_o2_cat_diag_mt "weight factor of downstream sensor signal integral for manual transmission" MAP 0xa1002558 _REC_MAP_20_u2_u1_u1 1.99996948242188 _CNV_A_R_LINEAR_____8_CM 0. 1.99996948242188 DISPLAY_IDENTIFIER IP_FAC_MASS_O2_CAT_DIAG_MT FORMAT "%7.5"
 /begin AXIS_DESCR COM_AXIS n_32 _CNV_A_R_LINEAR_____9_CM 8 0. 8160. FORMAT "%4.0" AXIS_PTS_REF ldpm_n_32_1_egtr /end AXIS_DESCR
 /begin AXIS_DESCR COM_AXIS NO_INPUT_QUANTITY _CNV_A_R_LINEAR_____14_CM 8 0. 1389. FORMAT "%4.0" AXIS_PTS_REF ldpm_maf_hb_1_egtr /end AXIS_DESCR
/end CHARACTERISTIC
/begin AXIS_PTS ldp_temp_cat_dyn_mdl_ip_fac_cat "" 0xa10023bc online_dummy _REC_AXS_20_u1 2040. _CNV_A_R_EGTR_LINEA_824_CM 8 -273.15 1766.85 FORMAT "%9.4" /end AXIS_PTS
/begin AXIS_PTS ldp_temp_cat_dif_ip_fac_cat "" 0xa10023b0 egtr[0].egtr_struct_fctdgcef0.temp_cat_dif_dyn_stat _REC_AXS_20_u1 255. _CNV_A_R_EGTR_LINEA_825_CM 8 -127. 128. FORMAT "%4.0" /end AXIS_PTS
/begin CHARACTERISTIC ip_lamb_cat "lambda linearization from downstream ls signal" CURVE 0xa100275c _REC_CUR_20_u2_u2 1.99996948242188 _CNV_A_R_LINEAR_____8_CM 0. 1.99996948242188 DISPLAY_IDENTIFIER IP_LAMB_CAT FORMAT "%7.5"
 /begin AXIS_DESCR COM_AXIS NO_INPUT_QUANTITY _CNV_A_R_LINEAR_____2_CM 12 0. 4.9951171875 FORMAT "%5.3" AXIS_PTS_REF ldp_vls_down_ip_lamb_cat /end AXIS_DESCR
/end CHARACTERISTIC
/begin CHARACTERISTIC c_lamb_cat_mv_min_eol "min. lamb_cat_mv threshold for a valid monitoring cycle" VALUE 0xa1002baa _REC_VAL_20_u2 1.99996948242188 _CNV_A_R_LINEAR_____8_CM 0. 1.99996948242188 DISPLAY_IDENTIFIER C_LAMB_CAT_MV_MIN_EOL FORMAT "%7.5" /end CHARACTERISTIC
/begin CHARACTERISTIC ip_fac_temp_cat_dif_stat "Factor to correct cat. diag value at catalyst temperature different to stationary temperature in this working point" MAP 0xa100263c _REC_MAP_20_u2_u1_u1 4.9951171875 _CNV_A_R_LINEAR_____826_CM 0. 4.9951171875 DISPLAY_IDENTIFIER IP_FAC_TEMP_CAT_DIF_STAT FORMAT "%8.6"
 /begin AXIS_DESCR COM_AXIS online_dummy _CNV_A_R_EGTR_LINEA_824_CM 8 -273.15 1766.85 FORMAT "%9.4" AXIS_PTS_REF ldp_temp_cat_dyn_mdl_ip_fac_cat /end AXIS_DESCR
 /begin AXIS_DESCR COM_AXIS egtr[0].egtr_struct_fctdgcef0.temp_cat_dif_dyn_stat _CNV_A_R_EGTR_LINEA_825_CM 8 -127. 128. FORMAT "%4.0" AXIS_PTS_REF ldp_temp_cat_dif_ip_fac_cat /end AXIS_DESCR
/end CHARACTERISTIC
/begin CHARACTERISTIC c_o2l_cat_afl "Adjust parameter for ratio_mas_o2l_cat_dif calculation" VALUE 0xa1002be8 _REC_VAL_20_u2 1.308404 _CNV_A_R_LINEAR_____822_CM 0. 1.308404 DISPLAY_IDENTIFIER C_O2L_CAT_AFL FORMAT "%7.5" /end CHARACTERISTIC
/begin CHARACTERISTIC c_amp_min_cat "min. ambient pressure threshold" VALUE 0xa1002b7c _REC_VAL_20_u2 5434. _CNV_A_R_LINEAR_____26_CM 0. 5434. DISPLAY_IDENTIFIER C_AMP_MIN_CAT FORMAT "%7.2" /end CHARACTERISTIC
/begin CHARACTERISTIC c_cl_max_cat "maximum canister load to allow catalyst and o2 sensor diagnosis" VALUE 0xa1002b7e _REC_VAL_20_u2 1.99996948242188 _CNV_A_R_LINEAR_____8_CM 0. 1.99996948242188 DISPLAY_IDENTIFIER C_CL_MAX_CAT FORMAT "%7.5" /end CHARACTERISTIC
/begin CHARACTERISTIC c_maf_hys_cat "hysterese after exceeding maf_lam_cat threshold" VALUE 0xa1002bd0 _REC_VAL_20_u2 1389. _CNV_A_R_LINEAR_____108_CM 0. 1389. DISPLAY_IDENTIFIER C_MAF_HYS_CAT FORMAT "%7.2" /end CHARACTERISTIC
/begin CHARACTERISTIC c_maf_int_dly_cat_diag "air mass flow threshold for cat diag activation after puc, cl max purge, forced stimulation on, downstream sensor ready" VALUE 0xa1002bd2 _REC_VAL_20_u2 1456.33 _CNV_A_R_LACO_LINEA_390_CM 0. 1456.33 DISPLAY_IDENTIFIER C_MAF_INT_DLY_CAT_DIAG FORMAT "%11.6" /end CHARACTERISTIC
/begin CHARACTERISTIC c_maf_int_sw_cat_diag "air mass flow initial for cat diag activation after MAX to NO_PURGE and back" VALUE 0xa1002bdc _REC_VAL_20_u2 1456.33 _CNV_A_R_LACO_LINEA_390_CM 0. 1456.33 DISPLAY_IDENTIFIER C_MAF_INT_SW_CAT_DIAG FORMAT "%11.6" /end CHARACTERISTIC
/begin CHARACTERISTIC c_tco_min_cat "min. tco threshold for catalyst diagnosis activation" VALUE 0xa1002c10 _REC_VAL_20_u1 190.5 _CNV_A_R_LINEAR_____16_CM -48. 142.5 DISPLAY_IDENTIFIER C_TCO_MIN_CAT FORMAT "%6.2" /end CHARACTERISTIC
/begin CHARACTERISTIC c_temp_hys_cat "hysteresis after exeeding catayst temperature threshold for catalyst diagnosis activation" VALUE 0xa1002c1c _REC_VAL_20_u1 2040. _CNV_A_R_EGTR_LINEA_824_CM -273.15 1766.85 DISPLAY_IDENTIFIER C_TEMP_HYS_CAT FORMAT "%9.4" /end CHARACTERISTIC
/begin CHARACTERISTIC c_temp_max_cat "max. catalyst temperature threshold for catalyst diagnosis activation" VALUE 0xa1002c20 _REC_VAL_20_u1 2040. _CNV_A_R_EGTR_LINEA_824_CM -273.15 1766.85 DISPLAY_IDENTIFIER C_TEMP_MAX_CAT FORMAT "%9.4" /end CHARACTERISTIC
/begin CHARACTERISTIC c_temp_min_cat "min. catalyst temperature threshold for catalyst diagnosis activation" VALUE 0xa1002c21 _REC_VAL_20_u1 2040. _CNV_A_R_EGTR_LINEA_824_CM -273.15 1766.85 DISPLAY_IDENTIFIER C_TEMP_MIN_CAT FORMAT "%9.4" /end CHARACTERISTIC
/begin CHARACTERISTIC c_temp_min_cat_eol "min. catalyst temperature threshold for catalyst diagnosis activation in case of EOL test" VALUE 0xa1002c22 _REC_VAL_20_u1 2040. _CNV_A_R_EGTR_LINEA_824_CM -273.15 1766.85 DISPLAY_IDENTIFIER C_TEMP_MIN_CAT_EOL FORMAT "%9.4" /end CHARACTERISTIC
/begin CHARACTERISTIC c_vs_max_cat "max. vs threshold for catalyst diagnosis activation" VALUE 0xa1002c2a _REC_VAL_20_u1 255. _CNV_A_R_LINEAR_____6_CM 0. 255. DISPLAY_IDENTIFIER C_VS_MAX_CAT FORMAT "%3.0" /end CHARACTERISTIC
/begin CHARACTERISTIC c_vs_min_cat "min. vs threshold for catalyst diagnosis activation" VALUE 0xa1002c2b _REC_VAL_20_u1 255. _CNV_A_R_LINEAR_____6_CM 0. 255. DISPLAY_IDENTIFIER C_VS_MIN_CAT FORMAT "%3.0" /end CHARACTERISTIC
/begin CHARACTERISTIC lc_cat_diag_cdn_act_man "flag to set catalyst diagnosis condition manually" VALUE 0xa1002c2c _REC_VAL_20_u1 1. _CNV_A_R_LINEAR_____0_CM 0. 1. DISPLAY_IDENTIFIER LC_CAT_DIAG_CDN_ACT_MAN FORMAT "%1.0" /end CHARACTERISTIC
/begin CHARACTERISTIC ip_maf_max_cat "max. MAF threshold for catalyst diagnosis activation" CURVE 0xa10029d4 _REC_CUR_20_u2_u1 1389. _CNV_A_R_LINEAR_____108_CM 0. 1389. DISPLAY_IDENTIFIER IP_MAF_MAX_CAT FORMAT "%7.2"
 /begin AXIS_DESCR COM_AXIS n_32 _CNV_A_R_LINEAR_____9_CM 6 0. 8160. FORMAT "%4.0" AXIS_PTS_REF ldpm_n_32_3_egtr /end AXIS_DESCR
/end CHARACTERISTIC
/begin CHARACTERISTIC ip_maf_min_cat "min. MAF threshold for catalyst diagnosis activation" CURVE 0xa10029e0 _REC_CUR_20_u2_u1 1389. _CNV_A_R_LINEAR_____108_CM 0. 1389. DISPLAY_IDENTIFIER IP_MAF_MIN_CAT FORMAT "%7.2"
 /begin AXIS_DESCR COM_AXIS n_32 _CNV_A_R_LINEAR_____9_CM 6 0. 8160. FORMAT "%4.0" AXIS_PTS_REF ldpm_n_32_3_egtr /end AXIS_DESCR
/end CHARACTERISTIC
/begin MEASUREMENT load_cat_ldc "catalyst diagnosis specific load for limited dynamics calculation" UWORD _CNV_A_R_CPULOAD__0_461_CM 1 100. 0. 99.90234375 DISPLAY_IDENTIFIER LOAD_CAT_LDC ECU_ADDRESS 0xd0002548 FORMAT "%5.2" /end MEASUREMENT
/begin CHARACTERISTIC lc_inh_cat_diag_man_deac[0] "Manual deactivation of CAT diagnosis inhibition conditions" VALUE 0xa1002c36 _REC_VAL_20_u1 1. _CNV_A_R_LINEAR_____0_CM 0. 1. DISPLAY_IDENTIFIER LC_INH_CAT_DIAG_MAN_DEAC[0] FORMAT "%1.0" /end CHARACTERISTIC
/begin CHARACTERISTIC lc_inh_cat_diag_man_deac[1] "Manual deactivation of CAT diagnosis inhibition conditions" VALUE 0xa1002c37 _REC_VAL_20_u1 1. _CNV_A_R_LINEAR_____0_CM 0. 1. DISPLAY_IDENTIFIER LC_INH_CAT_DIAG_MAN_DEAC[1] FORMAT "%1.0" /end CHARACTERISTIC
/begin CHARACTERISTIC c_eff_cat_max_50_diag "max. threshold for eff_cat_diag to detect a separate catalyst with efficiency lower then 50%" VALUE 0xa1002b8d _REC_VAL_20_u1 1.9921875 _CNV_A_R_LINEAR_____100_CM 0. 1.9921875 DISPLAY_IDENTIFIER C_EFF_CAT_MAX_50_DIAG FORMAT "%8.6" /end CHARACTERISTIC
/begin CHARACTERISTIC c_eff_cat_max_diag "max. threshold for eff_cat_diag to detect a separate catalyst with obd limit emissions" VALUE 0xa1002b8e _REC_VAL_20_u1 1.9921875 _CNV_A_R_LINEAR_____100_CM 0. 1.9921875 DISPLAY_IDENTIFIER C_EFF_CAT_MAX_DIAG FORMAT "%8.6" /end CHARACTERISTIC
/begin CHARACTERISTIC c_eff_cat_max_diag_eol "max. threshold for eff_cat_diag[i] to detect a separate catalyst with obd limit emissions at eol test" VALUE 0xa1002b8f _REC_VAL_20_u1 1.9921875 _CNV_A_R_LINEAR_____100_CM 0. 1.9921875 DISPLAY_IDENTIFIER C_EFF_CAT_MAX_DIAG_EOL FORMAT "%8.6" /end CHARACTERISTIC
/begin CHARACTERISTIC c_eff_cat_max_sum_diag "max. threshold for eff_cat_diag to common detect of catalysts with vehicle obd limit emissions" VALUE 0xa1002b90 _REC_VAL_20_u1 1.9921875 _CNV_A_R_LINEAR_____100_CM 0. 1.9921875 DISPLAY_IDENTIFIER C_EFF_CAT_MAX_SUM_DIAG FORMAT "%8.6" /end CHARACTERISTIC
/begin CHARACTERISTIC lc_cat_diag_dis "for report value to scan tool: separate eff_cat_diag for each catalyst or common, if over obd emiss. limit" VALUE 0xa1002c2d _REC_VAL_20_u1 1. _CNV_A_R_LINEAR_____0_CM 0. 1. DISPLAY_IDENTIFIER LC_CAT_DIAG_DIS FORMAT "%1.0" /end CHARACTERISTIC
/begin CHARACTERISTIC lc_cat_diag_resu "switch over the failure memory setting: separate for each catalyst or common for obd emiss. limit" VALUE 0xa1002c2e _REC_VAL_20_u1 1. _CNV_A_R_LINEAR_____0_CM 0. 1. DISPLAY_IDENTIFIER LC_CAT_DIAG_RESU FORMAT "%1.0" /end CHARACTERISTIC
/begin AXIS_PTS ldp_eff_cat_diag_1_ip_eff_cat "" 0xa100231c egtr[0].egtr_struct_fctdgcef0.eff_cat_diag _REC_AXS_20_u1 1.9921875 _CNV_A_R_LINEAR_____100_CM 6 0. 1.9921875 FORMAT "%8.6" /end AXIS_PTS
/begin AXIS_PTS ldp_eff_cat_diag_2_ip_eff_cat "" 0xa1002324 egtr[1].egtr_struct_fctdgcef0.eff_cat_diag _REC_AXS_20_u1 1.9921875 _CNV_A_R_LINEAR_____100_CM 6 0. 1.9921875 FORMAT "%8.6" /end AXIS_PTS
/begin CHARACTERISTIC ip_eff_cat_diag_sum "map of common eff_cat_diag_sum value depending from separate bank values for common obd emiss. limit" MAP 0xa1002474 _REC_MAP_20_u1_u1_u1 1.9921875 _CNV_A_R_LINEAR_____100_CM 0. 1.9921875 DISPLAY_IDENTIFIER IP_EFF_CAT_DIAG_SUM FORMAT "%8.6"
 /begin AXIS_DESCR COM_AXIS egtr[0].egtr_struct_fctdgcef0.eff_cat_diag _CNV_A_R_LINEAR_____100_CM 6 0. 1.9921875 FORMAT "%8.6" AXIS_PTS_REF ldp_eff_cat_diag_1_ip_eff_cat /end AXIS_DESCR
 /begin AXIS_DESCR COM_AXIS egtr[1].egtr_struct_fctdgcef0.eff_cat_diag _CNV_A_R_LINEAR_____100_CM 6 0. 1.9921875 FORMAT "%8.6" AXIS_PTS_REF ldp_eff_cat_diag_2_ip_eff_cat /end AXIS_DESCR
/end CHARACTERISTIC
/begin MEASUREMENT eff_cat_diag_sum "common value for catalyst conversion capability of both cylinder banks (obd emission limit)" UBYTE _CNV_A_R_LINEAR_____100_CM 1 100. 0. 1.9921875 DISPLAY_IDENTIFIER EFF_CAT_DIAG_SUM ECU_ADDRESS 0xc0001a2c FORMAT "%8.6" /end MEASUREMENT
/begin MEASUREMENT lv_diag_end_cbk_cat_diag "logical DIAG_END_CBK_CAT_DIAG" UBYTE _CNV_S_2_RANGE__0___1_CM 1 100. 0. 1. DISPLAY_IDENTIFIER LV_DIAG_END_CBK_CAT_DIAG ECU_ADDRESS 0xc0001a3c BIT_MASK 0x0 /end MEASUREMENT
/begin MEASUREMENT maf_mmv_cat_ldc "floating mean value for limited maf" UWORD _CNV_A_R_LINEAR_____108_CM 1 100. 0. 1389. DISPLAY_IDENTIFIER MAF_MMV_CAT_LDC ECU_ADDRESS 0xc0001a32 FORMAT "%7.2" /end MEASUREMENT
/begin MEASUREMENT n_mmv_cat_ldc "floating mean value for limited engine speed" UWORD _CNV_A_R_LINEAR_____13_CM 1 100. 0. 8160. DISPLAY_IDENTIFIER N_MMV_CAT_LDC ECU_ADDRESS 0xc0001a34 FORMAT "%4.0" /end MEASUREMENT
/begin MEASUREMENT load_grd_sum_cat_ldc "sum value of load gradient fro limited dynamics for catalyst diagnosis" UWORD _CNV_A_R_EGTR_LINEA_827_CM 1 100. 0. 159998. DISPLAY_IDENTIFIER LOAD_GRD_SUM_CAT_LDC ECU_ADDRESS 0xc0001a30 FORMAT "%12.5" /end MEASUREMENT
/begin MEASUREMENT load_grd_cat_ldc "load gradient for limted dynamics of catalyst diagnosis" SWORD _CNV_A_R_EGTR_LINEA_828_CM 1 100. -1250. 1247.56 DISPLAY_IDENTIFIER LOAD_GRD_CAT_LDC ECU_ADDRESS 0xc0001a2e FORMAT "%10.5" /end MEASUREMENT
/begin MEASUREMENT lv_load_grd_cat_ldc "status limited dynamic load_grd_cat_ldc" UBYTE _CNV_S_2_RANGE__0___1_CM 1 100. 0. 1. DISPLAY_IDENTIFIER LV_LOAD_GRD_CAT_LDC ECU_ADDRESS 0xc0001a3d BIT_MASK 0x1 /end MEASUREMENT
/begin MEASUREMENT lv_maf_cat_ldc "status limited dynamic maf" UBYTE _CNV_S_2_RANGE__0___1_CM 1 100. 0. 1. DISPLAY_IDENTIFIER LV_MAF_CAT_LDC ECU_ADDRESS 0xc0001a3e BIT_MASK 0x1 /end MEASUREMENT
/begin MEASUREMENT lv_n_cat_ldc "status limited dynamic n" UBYTE _CNV_S_2_RANGE__0___1_CM 1 100. 0. 1. DISPLAY_IDENTIFIER LV_N_CAT_LDC ECU_ADDRESS 0xc0001a3f BIT_MASK 0x1 /end MEASUREMENT
/begin CHARACTERISTIC c_crlc_maf_cat_ldc "correlation constant for floating mean value calculation of air mass flow" VALUE 0xa1002b80 _REC_VAL_20_u2 0.9999847412109381 _CNV_A_R_LINEAR_____68_CM 0. 0.9999847412109381 DISPLAY_IDENTIFIER C_CRLC_MAF_CAT_LDC FORMAT "%7.5" /end CHARACTERISTIC
/begin CHARACTERISTIC c_crlc_n_cat_ldc "correlation constant for floating mean value calculation of engine speed" VALUE 0xa1002b82 _REC_VAL_20_u2 0.9999847412109381 _CNV_A_R_LINEAR_____68_CM 0. 0.9999847412109381 DISPLAY_IDENTIFIER C_CRLC_N_CAT_LDC FORMAT "%7.5" /end CHARACTERISTIC
/begin CHARACTERISTIC c_fac_lam_mv_dyw_cat "threshold limited dynamic lambda" VALUE 0xa1002b9e _REC_VAL_20_u2 99.99847412109381 _CNV_A_R_LINEAR_____7_CM 0. 99.99847412109381 DISPLAY_IDENTIFIER C_FAC_LAM_MV_DYW_CAT /end CHARACTERISTIC
/begin CHARACTERISTIC c_load_grd_dec "decrement for calculation load_cat_ldc gradient" VALUE 0xa1002bc2 _REC_VAL_20_u2 2497.5653 _CNV_A_R_EGTR_LINEA_827_CM 0. 2497.5653 DISPLAY_IDENTIFIER C_LOAD_GRD_DEC FORMAT "%12.5" /end CHARACTERISTIC
/begin CHARACTERISTIC c_load_grd_min_sum_cat "min. threshold for load_grd cat_ldc summation" VALUE 0xa1002bc4 _REC_VAL_20_u2 1247.56 _CNV_A_R_EGTR_LINEA_827_CM 0. 1247.56 DISPLAY_IDENTIFIER C_LOAD_GRD_MIN_SUM_CAT FORMAT "%12.5" /end CHARACTERISTIC
/begin CHARACTERISTIC c_load_grd_sum_max "max threshold limited dynamic load_cat_ldc gradient" VALUE 0xa1002bc6 _REC_VAL_20_u2 159998. _CNV_A_R_EGTR_LINEA_827_CM 0. 159998. DISPLAY_IDENTIFIER C_LOAD_GRD_SUM_MAX FORMAT "%12.5" /end CHARACTERISTIC
/begin CHARACTERISTIC c_load_grd_sum_min "min threshold limited dynamic load_cat_ldc gradient" VALUE 0xa1002bc8 _REC_VAL_20_u2 159998. _CNV_A_R_EGTR_LINEA_827_CM 0. 159998. DISPLAY_IDENTIFIER C_LOAD_GRD_SUM_MIN FORMAT "%12.5" /end CHARACTERISTIC
/begin CHARACTERISTIC c_maf_dyw_cat_ldc "threshold limited dynamic engine maf" VALUE 0xa1002bce _REC_VAL_20_u2 1389. _CNV_A_R_LINEAR_____108_CM 0. 1389. DISPLAY_IDENTIFIER C_MAF_DYW_CAT_LDC FORMAT "%7.2" /end CHARACTERISTIC
/begin CHARACTERISTIC c_maf_int_min_cat_ldc "maf integral after setting limited dynamic conditions lv_cat_ldc[i] i before starting the monitoring cycle" VALUE 0xa1002bd6 _REC_VAL_20_u2 1456.33 _CNV_A_R_LACO_LINEA_390_CM 0. 1456.33 DISPLAY_IDENTIFIER C_MAF_INT_MIN_CAT_LDC FORMAT "%11.6" /end CHARACTERISTIC
/begin CHARACTERISTIC c_n_dyw_cat_ldc "threshold limited dynamic engine speed" VALUE 0xa1002be4 _REC_VAL_20_u2 8160. _CNV_A_R_LINEAR_____13_CM 0. 8160. DISPLAY_IDENTIFIER C_N_DYW_CAT_LDC FORMAT "%4.0" /end CHARACTERISTIC
/begin CHARACTERISTIC c_t_load_grd_dec_sum "time periods for calculation limited dynamic load_cat_ldc gradient" VALUE 0xa1002c0e _REC_VAL_20_u1 5.1 _CNV_A_R_LINEAR_____107_CM 0. 5.1 DISPLAY_IDENTIFIER C_T_LOAD_GRD_DEC_SUM FORMAT "%4.2" /end CHARACTERISTIC
/begin CHARACTERISTIC lc_fac_lam_rst_cat_ldc "switch for active reset of filtered fac_lam to not filtered after lim. dyn. over threshold" VALUE 0xa1002c34 _REC_VAL_20_u1 1. _CNV_A_R_LINEAR_____0_CM 0. 1. DISPLAY_IDENTIFIER LC_FAC_LAM_RST_CAT_LDC FORMAT "%1.0" /end CHARACTERISTIC
/begin CHARACTERISTIC lc_maf_rst_cat_ldc "switch for active reset of filtered maf to not filtered after lim. dyn. over threshold" VALUE 0xa1002c3d _REC_VAL_20_u1 1. _CNV_A_R_LINEAR_____0_CM 0. 1. DISPLAY_IDENTIFIER LC_MAF_RST_CAT_LDC FORMAT "%1.0" /end CHARACTERISTIC
/begin CHARACTERISTIC lc_n_rst_cat_ldc "switch for active reset of filtered n to not filtered after lim. dyn. over threshold" VALUE 0xa1002c3e _REC_VAL_20_u1 1. _CNV_A_R_LINEAR_____0_CM 0. 1. DISPLAY_IDENTIFIER LC_N_RST_CAT_LDC FORMAT "%1.0" /end CHARACTERISTIC
/begin MEASUREMENT egtr[0].egtr_struct_defspfstic0.lamb_pls "Lambda deviation for the lambda controller" SWORD _CNV_A_R_LINEAR_____23_CM 1 100. -0.125 0.1249389 DISPLAY_IDENTIFIER LAMB_PLS[1] ECU_ADDRESS 0xd0001ee0 FORMAT "%8.5" /end MEASUREMENT
/begin MEASUREMENT egtr[0].egtr_struct_defspfstic0.lv_lamb_pls_afl_cor_act "Flag indicating that corrective action for lean half wave of lambda stimulation is active" UBYTE _CNV_S_2_RANGE__0___1_CM 1 100. 0. 1. DISPLAY_IDENTIFIER LV_LAMB_PLS_AFL_COR_ACT[1] ECU_ADDRESS 0xd0001ee2 BIT_MASK 0x1 /end MEASUREMENT
/begin MEASUREMENT egtr[0].egtr_struct_defspfstic0.lv_lamb_pls_afr_cor_act "Flag indicating that corrective action for rich half wave of lambda stimulation is active" UBYTE _CNV_S_2_RANGE__0___1_CM 1 100. 0. 1. DISPLAY_IDENTIFIER LV_LAMB_PLS_AFR_COR_ACT[1] ECU_ADDRESS 0xd0001ee3 BIT_MASK 0x1 /end MEASUREMENT
/begin MEASUREMENT egtr[0].egtr_struct_defspfstia0.maf_int_lamb_pls_act "Air mass flow integral for forced lambda stimulation activation" UWORD _CNV_A_R_LACO_LINEA_390_CM 1 100. 0. 1456.33 DISPLAY_IDENTIFIER MAF_INT_LAMB_PLS_ACT[1] ECU_ADDRESS 0xd0001ee4 FORMAT "%11.6" /end MEASUREMENT
/begin MEASUREMENT egtr[0].egtr_struct_defspfstia0.lv_lamb_pls_act "Flag indicating that forced lambda stimulation is active" UBYTE _CNV_S_2_RANGE__0___1_CM 1 100. 0. 1. DISPLAY_IDENTIFIER LV_LAMB_PLS_ACT[1] ECU_ADDRESS 0xd0001ee6 BIT_MASK 0x1 /end MEASUREMENT
/begin MEASUREMENT egtr[0].egtr_struct_defspfstia0.lv_lamb_pls_diag_lsh_up "Flag indicating that requested exaggerated forced lambda stimulation is active" UBYTE _CNV_S_2_RANGE__0___1_CM 1 100. 0. 1. DISPLAY_IDENTIFIER LV_LAMB_PLS_DIAG_LSH_UP[1] ECU_ADDRESS 0xd0001ee7 BIT_MASK 0x1 /end MEASUREMENT
/begin MEASUREMENT egtr[0].egtr_struct_defspfstia0.lv_lamb_pls_act_cat_purge "Flag that indicates that the forced stimulation can be activated due to cat purge" UBYTE _CNV_S_2_RANGE__0___1_CM 1 100. 0. 1. DISPLAY_IDENTIFIER LV_LAMB_PLS_ACT_CAT_PURGE[1] ECU_ADDRESS 0xd0001ee8 BIT_MASK 0x1 /end MEASUREMENT
/begin MEASUREMENT egtr[0].egtr_struct_defspfsti0.o2l_add_lamb_pls "O2 load to be added to the O2 load integral each sample step" SLONG _CNV_A_R_EGTR_LINEA_829_CM 1 100. -669.923556 669.923555 DISPLAY_IDENTIFIER O2L_ADD_LAMB_PLS[1] ECU_ADDRESS 0xd0001eec FORMAT "%11.6" /end MEASUREMENT
/begin MEASUREMENT egtr[0].egtr_struct_defspfsti0.o2l_lamb_pls "Current O2 loading or release for forced lambda stimulation" SLONG _CNV_A_R_EGTR_LINEA_829_CM 1 100. -669.923556 669.923555 DISPLAY_IDENTIFIER O2L_LAMB_PLS[1] ECU_ADDRESS 0xd0001ef0 FORMAT "%11.6" /end MEASUREMENT
/begin MEASUREMENT egtr[0].egtr_struct_defspfsti0.o2l_sp_new_lamb_pls "O2 loading set point that is realized by forced lambda stimulation" UWORD _CNV_A_R_LINEAR_____822_CM 1 100. 0. 2.61684895833333 DISPLAY_IDENTIFIER O2L_SP_NEW_LAMB_PLS[1] ECU_ADDRESS 0xd0001ef4 FORMAT "%7.5" /end MEASUREMENT
/begin MEASUREMENT egtr[0].egtr_struct_defspfsti0.lamb_pls_o2l_osc "Lambda set point deviation based on forced stimulation O2 balancing" SWORD _CNV_A_R_LINEAR_____23_CM 1 100. -0.125 0.12493 DISPLAY_IDENTIFIER LAMB_PLS_O2L_OSC[1] ECU_ADDRESS 0xd0001ef6 FORMAT "%8.5" /end MEASUREMENT
/begin MEASUREMENT egtr[0].egtr_struct_defspfsti0.fac_o2l_lamb_pls "Temporary factor for O2 loading calculation considering the lambda set point deviation" SWORD _CNV_A_R_EGTR_LINEA_830_CM 1 100. -0.25 0.249992 DISPLAY_IDENTIFIER FAC_O2L_LAMB_PLS[1] ECU_ADDRESS 0xd0001ef8 FORMAT "%9.6" /end MEASUREMENT
/begin MEASUREMENT egtr[0].egtr_struct_defspfsti0.o2l_sp_half_lamb_pls "Auxiliary value; half O2 loading set point of forced lambda stimulation" UWORD _CNV_A_R_LINEAR_____822_CM 1 100. 0. 2.61684895833333 DISPLAY_IDENTIFIER O2L_SP_HALF_LAMB_PLS[1] ECU_ADDRESS 0xd0001efa FORMAT "%7.5" /end MEASUREMENT
/begin MEASUREMENT egtr[0].egtr_struct_defspfsti0.state_lamb_pls "State of forced lambda stimulation" UBYTE _CNV_S_3_EGTR_RANGE_831_CM 1 100. 0. 2. DISPLAY_IDENTIFIER STATE_LAMB_PLS[1] ECU_ADDRESS 0xd0001efc /end MEASUREMENT
/begin MEASUREMENT egtr[0].egtr_struct_defspfsti0.lv_lamb_pls_o2l_osc_pos "Auxiliary flag indicating positive lambda stimulation half wave" UBYTE _CNV_S_2_RANGE__0___1_CM 1 100. 0. 1. DISPLAY_IDENTIFIER LV_LAMB_PLS_O2L_OSC_POS[1] ECU_ADDRESS 0xd0001efd BIT_MASK 0x1 /end MEASUREMENT
/begin MEASUREMENT egtr[0].egtr_struct_defspfsti0.lv_lamb_pls_mst_cbk "Auxiliary flag indicating that this bank is master bank for forced stimulation" UBYTE _CNV_S_2_RANGE__0___1_CM 1 100. 0. 1. DISPLAY_IDENTIFIER LV_LAMB_PLS_MST_CBK[1] ECU_ADDRESS 0xd0001efe BIT_MASK 0x1 /end MEASUREMENT
/begin MEASUREMENT egtr[0].egtr_struct_defspcenrc0.lamb_sp_delta_cat_purge "Lambda set point shift of cat purge function" UWORD _CNV_A_R_LINEAR_____23_CM 1 100. 0. 0.24992 DISPLAY_IDENTIFIER LAMB_SP_DELTA_CAT_PURGE[1] ECU_ADDRESS 0xd0001f00 FORMAT "%7.5" /end MEASUREMENT
/begin MEASUREMENT egtr[0].egtr_struct_defspfstii0.lv_inh_lamb_pls "Inhibition flag for forced lambda stimulation" UBYTE _CNV_S_2_RANGE__0___1_CM 1 100. 0. 1. DISPLAY_IDENTIFIER LV_INH_LAMB_PLS[1] ECU_ADDRESS 0xd0001f02 BIT_MASK 0x1 /end MEASUREMENT
/begin MEASUREMENT egtr[0].egtr_struct_defspcenr0.o2l_rls_pcat_purge "Oxygen loading to be released for pre cat purge" SLONG _CNV_A_R_EGTR_LINEA_829_CM 1 100. -669.923556 669.923555 DISPLAY_IDENTIFIER O2L_RLS_PCAT_PURGE[1] ECU_ADDRESS 0xd0001f04 FORMAT "%11.6" /end MEASUREMENT
/begin MEASUREMENT egtr[0].egtr_struct_defspcenr0.o2l_rls_tot_cat_purge "Total oxygen loading to be released for pre and main cat purge" SLONG _CNV_A_R_EGTR_LINEA_829_CM 1 100. -669.923556 669.923555 DISPLAY_IDENTIFIER O2L_RLS_TOT_CAT_PURGE[1] ECU_ADDRESS 0xd0001f08 FORMAT "%11.6" /end MEASUREMENT
/begin MEASUREMENT egtr[0].egtr_struct_defspcenr0.o2l_rls_rest_cat_purge "Estimated rest oxygen loading to be released for pre and main cat purge" SLONG _CNV_A_R_EGTR_LINEA_829_CM 1 100. -669.923556 669.923555 DISPLAY_IDENTIFIER O2L_RLS_REST_CAT_PURGE[1] ECU_ADDRESS 0xd0001f0c FORMAT "%11.6" /end MEASUREMENT
/begin MEASUREMENT egtr[0].egtr_struct_defspcenr0.o2l_rls_add_cat_purge "Oxygen loading to be added each sample step for cat purge air mass flow integral" SLONG _CNV_A_R_EGTR_LINEA_829_CM 1 100. -669.923556 669.923555 DISPLAY_IDENTIFIER O2L_RLS_ADD_CAT_PURGE[1] ECU_ADDRESS 0xd0001f10 FORMAT "%11.6" /end MEASUREMENT
/begin MEASUREMENT egtr[0].egtr_struct_defspcenr0.o2l_rls_main_cat_purge "Oxygen loading to be released for main cat purge" SLONG _CNV_A_R_EGTR_LINEA_829_CM 1 100. -669.923556 669.923555 DISPLAY_IDENTIFIER O2L_RLS_MAIN_CAT_PURGE[1] ECU_ADDRESS 0xd0001f14 FORMAT "%11.6" /end MEASUREMENT
/begin MEASUREMENT egtr[0].egtr_struct_defspcenr0.lamb_sp_delta_it_cat_purge "Lambda set point shift of cat purge function (internal value)" UWORD _CNV_A_R_LINEAR_____23_CM 1 100. 0. 0.24992 DISPLAY_IDENTIFIER LAMB_SP_DELTA_IT_CAT_PURGE[1] ECU_ADDRESS 0xd0001f18 FORMAT "%7.5" /end MEASUREMENT
/begin MEASUREMENT egtr[0].egtr_struct_defspcenr0.fac_o2l_rls_cat_purge "Temporary factor for O2 loading release calculation considering the lambda set point deviation" SWORD _CNV_A_R_EGTR_LINEA_830_CM 1 100. -0.25 0.249992 DISPLAY_IDENTIFIER FAC_O2L_RLS_CAT_PURGE[1] ECU_ADDRESS 0xd0001f1a FORMAT "%9.6" /end MEASUREMENT
/begin MEASUREMENT egtr[0].egtr_struct_defspcenr0.ratio_o2l_rls_cat_purge "Quotient used by cat purge: current rest oxygen loading / total oxygen loading" UBYTE _CNV_A_R_LINEAR_____27_CM 1 100. 0. 0.99609375 DISPLAY_IDENTIFIER RATIO_O2L_RLS_CAT_PURGE[1] ECU_ADDRESS 0xd0001f1c FORMAT "%5.3" /end MEASUREMENT
/begin MEASUREMENT egtr[0].egtr_struct_defspcenr0.lv_cat_purge_act "Flag indicating that cat purge function is active" UBYTE _CNV_S_2_RANGE__0___1_CM 1 100. 0. 1. DISPLAY_IDENTIFIER LV_CAT_PURGE_ACT[1] ECU_ADDRESS 0xd0001f1d BIT_MASK 0x1 /end MEASUREMENT
/begin MEASUREMENT egtr[0].egtr_struct_defspcenr0.lv_vls_down_act_cat_purge "Flag indicating that downstream signal is/was below calibration threshold" UBYTE _CNV_S_2_RANGE__0___1_CM 1 100. 0. 1. DISPLAY_IDENTIFIER LV_VLS_DOWN_ACT_CAT_PURGE[1] ECU_ADDRESS 0xd0001f1e BIT_MASK 0x1 /end MEASUREMENT
/begin MEASUREMENT egtr[0].egtr_struct_defspcenr0.lv_cat_purge_main_cat "Flag indicating that cat purge for main cat is active" UBYTE _CNV_S_2_RANGE__0___1_CM 1 100. 0. 1. DISPLAY_IDENTIFIER LV_CAT_PURGE_MAIN_CAT[1] ECU_ADDRESS 0xd0001f1f BIT_MASK 0x1 /end MEASUREMENT
/begin MEASUREMENT egtr[0].egtr_struct_defspcenr0.lv_cat_purge_pcat "Flag indicating that cat purge for pre cat is active" UBYTE _CNV_S_2_RANGE__0___1_CM 1 100. 0. 1. DISPLAY_IDENTIFIER LV_CAT_PURGE_PCAT[1] ECU_ADDRESS 0xd0001f20 BIT_MASK 0x1 /end MEASUREMENT
/begin MEASUREMENT egtr[0].egtr_struct_defspcenrd0.o2l_rls_sp_pcat_purge "Oxygen loading to be purged (released) during pre cat purge" UWORD _CNV_A_R_LINEAR_____822_CM 1 100. 0. 2.61684895833333 DISPLAY_IDENTIFIER O2L_RLS_SP_PCAT_PURGE[1] ECU_ADDRESS 0xd0001f22 FORMAT "%7.5" /end MEASUREMENT
/begin MEASUREMENT egtr[0].egtr_struct_defspcenrd0.fac_add_main_cat_purge "Additional weighting factor for pre and main cat differences" UBYTE _CNV_A_R_LINEAR_____100_CM 1 100. 0. 1.9921875 DISPLAY_IDENTIFIER FAC_ADD_MAIN_CAT_PURGE[1] ECU_ADDRESS 0xd0001f24 FORMAT "%8.6" /end MEASUREMENT
/begin MEASUREMENT egtr[0].egtr_struct_defspcenrd0.state_cat_purge "State indicating the activation reason of cat purge" UBYTE _CNV_S_6_EGTR_RANGE_832_CM 1 100. 0. 5. DISPLAY_IDENTIFIER STATE_CAT_PURGE[1] ECU_ADDRESS 0xd0001f25 /end MEASUREMENT
/begin MEASUREMENT egtr[0].egtr_struct_defspcenrd0.lv_cat_purge_post_puc_trig "Auxiliary flag indicating that cat purge after PUC was triggered" UBYTE _CNV_S_2_RANGE__0___1_CM 1 100. 0. 1. DISPLAY_IDENTIFIER LV_CAT_PURGE_POST_PUC_TRIG[1] ECU_ADDRESS 0xd0001f26 BIT_MASK 0x1 /end MEASUREMENT
/begin MEASUREMENT egtr[0].egtr_struct_defspcenrd0.lv_cat_purge_st "Flag indicating that cat purge can be started (set for one sample step)" UBYTE _CNV_S_2_RANGE__0___1_CM 1 100. 0. 1. DISPLAY_IDENTIFIER LV_CAT_PURGE_ST[1] ECU_ADDRESS 0xd0001f27 BIT_MASK 0x1 /end MEASUREMENT
/begin MEASUREMENT egtr[0].egtr_struct_defspcenri0.temp_main_cat_purge "Catalyst temperature of main cat for cat purge function" UWORD _CNV_A_R_LINEAR_____204_CM 1 100. -273.15 1774.7875 DISPLAY_IDENTIFIER TEMP_MAIN_CAT_PURGE[1] ECU_ADDRESS 0xd0001f28 FORMAT "%9.4" /end MEASUREMENT
/begin MEASUREMENT egtr[0].egtr_struct_defspcenri0.lamb_sp_delta_add_cat_purge "Additional lambda set point shift for cat purge output" UWORD _CNV_A_R_LINEAR_____23_CM 1 100. 0. 0.24993896484375 DISPLAY_IDENTIFIER LAMB_SP_DELTA_ADD_CAT_PURGE[1] ECU_ADDRESS 0xd0001f2a FORMAT "%7.5" /end MEASUREMENT
/begin MEASUREMENT egtr[0].egtr_struct_defspcenri0.lv_inh_cat_purge "Inhibition flag for cat purge function" UBYTE _CNV_S_2_RANGE__0___1_CM 1 100. 0. 1. DISPLAY_IDENTIFIER LV_INH_CAT_PURGE[1] ECU_ADDRESS 0xd0001f2c BIT_MASK 0x1 /end MEASUREMENT
/begin MEASUREMENT egtr[0].egtr_struct_fctdgcefld0.fac_lam_mv_delta_cat_ldc "difference between filtered and not filtered fac_lam_mv[i] for lambda limited dynamic" SWORD _CNV_A_R_LINEAR_____110_CM 1 100. -50. 49.9984741210938 DISPLAY_IDENTIFIER FAC_LAM_MV_DELTA_CAT_LDC[1] ECU_ADDRESS 0xd0001f2e FORMAT "%7.3" /end MEASUREMENT
/begin MEASUREMENT egtr[0].egtr_struct_fctdgcefld0.maf_int_cat_ldc "integral of mass air flow since limited dynamic conditions fulfilled" UWORD _CNV_A_R_LACO_LINEA_390_CM 1 100. 0. 1456.33 DISPLAY_IDENTIFIER MAF_INT_CAT_LDC[1] ECU_ADDRESS 0xd0001f30 FORMAT "%11.6" /end MEASUREMENT
/begin MEASUREMENT egtr[0].egtr_struct_fctdgcefld0.lv_cat_ldc "status of limited dynamics for catalyst efficiency diagnosis" UBYTE _CNV_S_2_RANGE__0___1_CM 1 100. 0. 1. DISPLAY_IDENTIFIER LV_CAT_LDC[1] ECU_ADDRESS 0xd0001f32 BIT_MASK 0x1 /end MEASUREMENT
/begin MEASUREMENT egtr[0].egtr_struct_fctdgcefld0.lv_fac_lam_cat_ldc "status limited dynamic fac_lam_mv[nc_cbk_ex_nr]" UBYTE _CNV_S_2_RANGE__0___1_CM 1 100. 0. 1. DISPLAY_IDENTIFIER LV_FAC_LAM_CAT_LDC[1] ECU_ADDRESS 0xd0001f33 BIT_MASK 0x1 /end MEASUREMENT
/begin MEASUREMENT egtr[0].egtr_struct_fctdgcefif0.eff_cat_diag_obd "cat. diag. value for obd scantool mod 6 output" UBYTE _CNV_A_R_LINEAR_____100_CM 1 100. 0. 1.9921875 DISPLAY_IDENTIFIER EFF_CAT_DIAG_OBD[1] ECU_ADDRESS 0xd0001f34 FORMAT "%8.6" /end MEASUREMENT
/begin MEASUREMENT egtr[0].egtr_struct_fctdgcefif0.eff_cat_max_diag_obd "actually threshold for scantool mod 6 output" UBYTE _CNV_A_R_LINEAR_____100_CM 1 100. 0. 1.9921875 DISPLAY_IDENTIFIER EFF_CAT_MAX_DIAG_OBD[1] ECU_ADDRESS 0xd0001f35 FORMAT "%8.6" /end MEASUREMENT
/begin MEASUREMENT egtr[0].egtr_struct_fctdgcefif0.lv_cdn_diag_cat_diag "Flag condition for catalyst diagnosis active" UBYTE _CNV_S_2_RANGE__0___1_CM 1 100. 0. 1. DISPLAY_IDENTIFIER LV_CDN_DIAG_CAT_DIAG[1] ECU_ADDRESS 0xd0001f36 BIT_MASK 0x1 /end MEASUREMENT
/begin MEASUREMENT egtr[0].egtr_struct_fctdgcefif0.lv_end_diag_cat_diag "flag catalyst diagnosis finished for that driving cycle" UBYTE _CNV_S_2_RANGE__0___1_CM 1 100. 0. 1. DISPLAY_IDENTIFIER LV_END_DIAG_CAT_DIAG[1] ECU_ADDRESS 0xd0001f37 BIT_MASK 0x1 /end MEASUREMENT
/begin MEASUREMENT egtr[0].egtr_struct_fctdgcefif0.lv_err_cat_diag "Present_failure: failure after filtering diagnosis value catalyst diagnose" UBYTE _CNV_S_2_RANGE__0___1_CM 1 100. 0. 1. DISPLAY_IDENTIFIER LV_ERR_CAT_DIAG[1] ECU_ADDRESS 0xd0001f38 BIT_MASK 0x1 /end MEASUREMENT
/begin MEASUREMENT egtr[0].egtr_struct_fctdgcefac0.maf_int_dly_cat_diag "Air mass flow integral after conditions are fulfilled for catalyst diagnosis activation" UWORD _CNV_A_R_LACO_LINEA_390_CM 1 100. 0. 1456.33 DISPLAY_IDENTIFIER MAF_INT_DLY_CAT_DIAG[1] ECU_ADDRESS 0xd0001f3a FORMAT "%11.6" /end MEASUREMENT
/begin MEASUREMENT egtr[0].egtr_struct_fctdgcefac0.lv_cat_diag_cdn_act "Activation condition for O2 sensor and catalyst efficiency diagnosis (OSC-method)" UBYTE _CNV_S_2_RANGE__0___1_CM 1 100. 0. 1. DISPLAY_IDENTIFIER LV_CAT_DIAG_CDN_ACT[1] ECU_ADDRESS 0xd0001f3c BIT_MASK 0x1 /end MEASUREMENT
/begin MEASUREMENT egtr[0].egtr_struct_fctdgcef0.ratio_mass_o2_cat_dif_sum "summation of mass_o2_cat_dif_ratio[i] over all valid monitoring cycles" ULONG _CNV_A_R_EGTR_LINEA_833_CM 1 100. 0. 131072. DISPLAY_IDENTIFIER RATIO_MASS_O2_CAT_DIF_SUM[1] ECU_ADDRESS 0xd0001f40 FORMAT "%13.5" /end MEASUREMENT
/begin MEASUREMENT egtr[0].egtr_struct_fctdgcef0.lamb_cat_down_sum "integral of downstream lambda through 1 diagnosis period for calculation of mean value" ULONG _CNV_A_R_EGTR_LINEA_833_CM 1 100. 0. 131072. DISPLAY_IDENTIFIER LAMB_CAT_DOWN_SUM[1] ECU_ADDRESS 0xd0001f44 FORMAT "%13.5" /end MEASUREMENT
/begin MEASUREMENT egtr[0].egtr_struct_fctdgcef0.ratio_mass_o2_cat_dif "weighted mass_o2_cat_dif_cyc[i] value related to o2-load upstream catalyst from lambda controller" UWORD _CNV_A_R_LINEAR_____8_CM 1 100. 0. 1.99996948242188 DISPLAY_IDENTIFIER RATIO_MASS_O2_CAT_DIF[1] ECU_ADDRESS 0xd0001f48 FORMAT "%7.5" /end MEASUREMENT
/begin MEASUREMENT egtr[0].egtr_struct_fctdgcef0.mass_o2_cat_dif_cyc "mass o2 downsteam catalyst to mean value through 1 diagnosis period" UWORD _CNV_A_R_EGTR_LINEA_834_CM 1 100. 0. 8.17765e-002 DISPLAY_IDENTIFIER MASS_O2_CAT_DIF_CYC[1] ECU_ADDRESS 0xd0001f4a FORMAT "%8.6" /end MEASUREMENT
/begin MEASUREMENT egtr[0].egtr_struct_fctdgcef0.lamb_cat_down_mv "downstream lambda mean value for complete diagnosis period" UWORD _CNV_A_R_LINEAR_____8_CM 1 100. 0. 1.99996948242188 DISPLAY_IDENTIFIER LAMB_CAT_DOWN_MV[1] ECU_ADDRESS 0xd0001f4c FORMAT "%7.5" /end MEASUREMENT
/begin MEASUREMENT egtr[0].egtr_struct_fctdgcef0.lamb_cat_down_st_cyc "lamb_cat_down[i] value at start of monitoring cycle" UWORD _CNV_A_R_LINEAR_____8_CM 1 100. 0. 1.99996948242188 DISPLAY_IDENTIFIER LAMB_CAT_DOWN_ST_CYC[1] ECU_ADDRESS 0xd0001f4e FORMAT "%7.5" /end MEASUREMENT
/begin MEASUREMENT egtr[0].egtr_struct_fctdgcef0.lamb_cat_down "lambda downstream of catalyst; linearization of downstream ls signal" UWORD _CNV_A_R_LINEAR_____8_CM 1 100. 0. 1.99996948242188 DISPLAY_IDENTIFIER LAMB_CAT_DOWN[1] ECU_ADDRESS 0xd0001f50 FORMAT "%7.5" /end MEASUREMENT
/begin MEASUREMENT egtr[0].egtr_struct_fctdgcef0.flow_o2_cat_dif "downstream O2 flow difference to mean value" UWORD _CNV_A_R_EGTR_LINEA_835_CM 1 100. 0. 2.04441325e-003 DISPLAY_IDENTIFIER FLOW_O2_CAT_DIF[1] ECU_ADDRESS 0xd0001f52 FORMAT "%8.6" /end MEASUREMENT
/begin MEASUREMENT egtr[0].egtr_struct_fctdgcef0.ctr_cat_diag "monitoring cycle counter" UWORD _CNV_A_R_LINEAR_____0_CM 1 100. 0. 511. DISPLAY_IDENTIFIER CTR_CAT_DIAG[1] ECU_ADDRESS 0xd0001f54 FORMAT "%5.0" /end MEASUREMENT
/begin MEASUREMENT egtr[0].egtr_struct_fctdgcef0.ctr_lamb_out_cat_diag "counter of non valid cycle due to lamb_cat_down_mv[i] is not in right range, for switch off cat diag" UBYTE _CNV_A_R_LINEAR_____0_CM 1 100. 0. 255. DISPLAY_IDENTIFIER CTR_LAMB_OUT_CAT_DIAG[1] ECU_ADDRESS 0xd0001f56 FORMAT "%3.0" /end MEASUREMENT
/begin MEASUREMENT egtr[0].egtr_struct_fctdgcef0.ctr_tot_cat_diag "total sum of all completed diagnosis cycles since ecu programming" UBYTE _CNV_A_R_LINEAR_____0_CM 1 100. 0. 255. DISPLAY_IDENTIFIER CTR_TOT_CAT_DIAG[1] ECU_ADDRESS 0xd0001f57 FORMAT "%3.0" /end MEASUREMENT
/begin MEASUREMENT egtr[0].egtr_struct_fctdgcef0.eff_cat_diag "at ended diagnosis final value for catalyst conversion capability" UBYTE _CNV_A_R_LINEAR_____100_CM 1 100. 0. 1.9921875 DISPLAY_IDENTIFIER EFF_CAT_DIAG[1] ECU_ADDRESS 0xd0001f58 FORMAT "%8.6" /end MEASUREMENT
/begin MEASUREMENT egtr[0].egtr_struct_fctdgcef0.temp_cat_dif_dyn_stat "temperature difference between dynamic and stationary catalyst temperature (from cat. temperature model)" UBYTE _CNV_A_R_EGTR_LINEA_825_CM 1 100. -127. 128. DISPLAY_IDENTIFIER TEMP_CAT_DIF_DYN_STAT[1] ECU_ADDRESS 0xd0001f59 FORMAT "%4.0" /end MEASUREMENT
/begin MEASUREMENT egtr[0].egtr_struct_fctdgcef0.state_cat_diag "state of diagnosis" UBYTE _CNV_S_5_EGTR_RANGE_836_CM 1 100. 0. 4. DISPLAY_IDENTIFIER STATE_CAT_DIAG[1] ECU_ADDRESS 0xd0001f5a /end MEASUREMENT
/begin MEASUREMENT egtr[0].egtr_struct_fctdgcef0.state_cat_diag_cyc_vld "summary validity bits, current monitoring cycle valid and involved in calculation of diagnosis value" UBYTE _CNV_A_R_LINEAR_____0_CM 1 100. 0. 15. DISPLAY_IDENTIFIER STATE_CAT_DIAG_CYC_VLD[1] ECU_ADDRESS 0xd0001f5b FORMAT "%3.0" /end MEASUREMENT
/begin MEASUREMENT egtr[0].egtr_struct_fctdgcef0.lv_lamb_pls_req_cat_diag "flag to switch forced stimulation parameters for osc/nox cat. diagnosis" UBYTE _CNV_S_2_RANGE__0___1_CM 1 100. 0. 1. DISPLAY_IDENTIFIER LV_LAMB_PLS_REQ_CAT_DIAG[1] ECU_ADDRESS 0xd0001f5c BIT_MASK 0x1 /end MEASUREMENT
/begin MEASUREMENT egtr[0].egtr_struct_fctdgcef0.lv_lam_adj_cat_diag "flag to switch trim control parameters for osc/nox cat. diagnosis" UBYTE _CNV_S_2_RANGE__0___1_CM 1 100. 0. 1. DISPLAY_IDENTIFIER LV_LAM_ADJ_CAT_DIAG[1] ECU_ADDRESS 0xd0001f5d BIT_MASK 0x1 /end MEASUREMENT
/begin MEASUREMENT egtr[0].egtr_struct_fctdgcefi0.state_rbm_cat "interface of monitor cat_diag for the rate based monitoring statistics" UBYTE _CNV_A_R_LINEAR_____0_CM 1 100. 0. 15. DISPLAY_IDENTIFIER STATE_RBM_CAT[1] ECU_ADDRESS 0xd0001f5e FORMAT "%3.0" /end MEASUREMENT
/begin MEASUREMENT egtr[0].egtr_struct_fctdgcefi0.lv_inh_diag_cat_diag "flag to inhibit catalyst diagnosis function if there is a component failure" UBYTE _CNV_A_R_LINEAR_____0_CM 1 100. 0. 1. DISPLAY_IDENTIFIER LV_INH_DIAG_CAT_DIAG[1] ECU_ADDRESS 0xd0001f5f FORMAT "%1.0" BIT_MASK 0x1 /end MEASUREMENT
/begin MEASUREMENT egtr[0].egtr_struct_fctdgcefi0.lv_inh_diag_rbm_cat_diag "flag to inhibit rbm catalyst diagnosis dc incrementation if there is a component failure" UBYTE _CNV_A_R_LINEAR_____0_CM 1 100. 0. 1. DISPLAY_IDENTIFIER LV_INH_DIAG_RBM_CAT_DIAG[1] ECU_ADDRESS 0xd0001f60 FORMAT "%1.0" BIT_MASK 0x1 /end MEASUREMENT
/begin MEASUREMENT egtr[0].egtr_struct_fctdgtdloc0.action_O2L_data_h_ampl.o2l_pha "Calculated O2L" UWORD _CNV_A_R_LINEAR_____822_CM 1 100. 0. 2.61684895833333 DISPLAY_IDENTIFIER O2L_RGN_H_AMPL_PHA[1] ECU_ADDRESS 0xd0001f90 FORMAT "%7.5" /end MEASUREMENT
/begin MEASUREMENT egtr[0].egtr_struct_fctdgtdloc0.action_O2L_data_h_ampl.o2l_int_pha "Calculated O2L Integral" UWORD _CNV_A_R_LINEAR_____822_CM 1 100. 0. 2.61684895833333 DISPLAY_IDENTIFIER O2L_INT_RGN_H_AMPL_PHA[1] ECU_ADDRESS 0xd0001f92 FORMAT "%7.5" /end MEASUREMENT
/begin MEASUREMENT egtr[0].egtr_struct_fctdgtdloc0.action_O2L_data_h_ampl.lv_o2l_clc "Flag for calculation of O2L" UBYTE _CNV_A_R_LINEAR_____0_CM 1 100. 0. 1. DISPLAY_IDENTIFIER LV_O2L_CLC_RGN_H_AMPL[1] ECU_ADDRESS 0xd0001f95 FORMAT "%1.0" BIT_MASK 0x1 /end MEASUREMENT
/begin MEASUREMENT egtr[0].egtr_struct_fctdgtdloc0.action_O2L_data_l_ampl.o2l_pha "Calculated O2L" UWORD _CNV_A_R_LINEAR_____822_CM 1 100. 0. 2.61684895833333 DISPLAY_IDENTIFIER O2L_RGN_L_AMPL_PHA[1] ECU_ADDRESS 0xd0001f98 FORMAT "%7.5" /end MEASUREMENT
/begin MEASUREMENT egtr[0].egtr_struct_fctdgtdloc0.action_O2L_data_l_ampl.o2l_int_pha "Calculated O2L Integral" UWORD _CNV_A_R_LINEAR_____822_CM 1 100. 0. 2.61684895833333 DISPLAY_IDENTIFIER O2L_INT_RGN_L_AMPL_PHA[1] ECU_ADDRESS 0xd0001f9a FORMAT "%7.5" /end MEASUREMENT
/begin MEASUREMENT egtr[0].egtr_struct_fctdgtdloc0.action_O2L_data_l_ampl.lv_o2l_clc "Flag for calculation of O2L" UBYTE _CNV_A_R_LINEAR_____0_CM 1 100. 0. 1. DISPLAY_IDENTIFIER LV_O2L_CLC_RGN_L_AMPL[1] ECU_ADDRESS 0xd0001f9d FORMAT "%1.0" BIT_MASK 0x1 /end MEASUREMENT
/begin MEASUREMENT egtr[0].egtr_struct_fctdgtdloc0.action_O2L_data_park.o2l_pha "Calculated O2L" UWORD _CNV_A_R_LINEAR_____822_CM 1 100. 0. 2.61684895833333 DISPLAY_IDENTIFIER O2L_PARK_PHA[1] ECU_ADDRESS 0xd0001fa0 FORMAT "%7.5" /end MEASUREMENT
/begin MEASUREMENT egtr[0].egtr_struct_fctdgtdloc0.action_O2L_data_park.o2l_int_pha "Calculated O2L Integral" UWORD _CNV_A_R_LINEAR_____822_CM 1 100. 0. 2.61684895833333 DISPLAY_IDENTIFIER O2L_INT_PARK_PHA[1] ECU_ADDRESS 0xd0001fa2 FORMAT "%7.5" /end MEASUREMENT
/begin MEASUREMENT egtr[0].egtr_struct_fctdgtdloc0.action_O2L_data_park.lv_o2l_clc "Flag for calculation of O2L" UBYTE _CNV_A_R_LINEAR_____0_CM 1 100. 0. 1. DISPLAY_IDENTIFIER LV_O2L_CLC_PARK[1] ECU_ADDRESS 0xd0001fa5 FORMAT "%1.0" BIT_MASK 0x1 /end MEASUREMENT
/begin MEASUREMENT egtr[0].egtr_struct_fctdgtdloc0.action_O2L_data_load.o2l_pha "Calculated O2L" UWORD _CNV_A_R_LINEAR_____822_CM 1 100. 0. 2.61684895833333 DISPLAY_IDENTIFIER O2L_LOAD_PHA[1] ECU_ADDRESS 0xd0001fa8 FORMAT "%7.5" /end MEASUREMENT
/begin MEASUREMENT egtr[0].egtr_struct_fctdgtdloc0.action_O2L_data_load.o2l_int_pha "Calculated O2L Integral" UWORD _CNV_A_R_LINEAR_____822_CM 1 100. 0. 2.61684895833333 DISPLAY_IDENTIFIER O2L_INT_LOAD_PHA[1] ECU_ADDRESS 0xd0001faa FORMAT "%7.5" /end MEASUREMENT
/begin MEASUREMENT egtr[0].egtr_struct_fctdgtdloc0.action_O2L_data_load.lv_o2l_clc "Flag for calculation of O2L" UBYTE _CNV_A_R_LINEAR_____0_CM 1 100. 0. 1. DISPLAY_IDENTIFIER LV_O2L_CLC_LOAD[1] ECU_ADDRESS 0xd0001fad FORMAT "%1.0" BIT_MASK 0x1 /end MEASUREMENT
/begin MEASUREMENT egtr[0].egtr_struct_fctdgtdloc0.state_o2l_clc_vld "Validation state for O2L integral calculation" UBYTE _CNV_A_R_LINEAR_____0_CM 1 100. 0. 255. DISPLAY_IDENTIFIER STATE_O2L_CLC_VLD[1] ECU_ADDRESS 0xd0001fb0 FORMAT "%3.0" /end MEASUREMENT
/begin MEASUREMENT egtr[0].egtr_struct_fctdgtdloc0.t_afl_cdn_out "Timer for exit from state LEAN_CDN" UWORD _CNV_A_R_LINEAR_____3_CM 1 100. 0. 655.35 DISPLAY_IDENTIFIER T_AFL_CDN_OUT[1] ECU_ADDRESS 0xd0001fb2 FORMAT "%6.2" /end MEASUREMENT
/begin MEASUREMENT egtr[0].egtr_struct_fctdgtdloc0.state_cat_diag_afl "OSC calculation state for TWC diagnosis at lean operation" UBYTE _CNV_S_4_RANGE_STAT_838_CM 1 100. 0. 3. DISPLAY_IDENTIFIER STATE_CAT_DIAG_AFL[1] ECU_ADDRESS 0xd0001fb4 /end MEASUREMENT
/begin MEASUREMENT egtr[1].egtr_struct_defspfstic0.lamb_pls "Lambda deviation for the lambda controller" SWORD _CNV_A_R_LINEAR_____23_CM 1 100. -0.125 0.1249389 DISPLAY_IDENTIFIER LAMB_PLS[2] ECU_ADDRESS 0xd0001fb8 FORMAT "%8.5" /end MEASUREMENT
/begin MEASUREMENT egtr[1].egtr_struct_defspfstic0.lv_lamb_pls_afl_cor_act "Flag indicating that corrective action for lean half wave of lambda stimulation is active" UBYTE _CNV_S_2_RANGE__0___1_CM 1 100. 0. 1. DISPLAY_IDENTIFIER LV_LAMB_PLS_AFL_COR_ACT[2] ECU_ADDRESS 0xd0001fba BIT_MASK 0x1 /end MEASUREMENT
/begin MEASUREMENT egtr[1].egtr_struct_defspfstic0.lv_lamb_pls_afr_cor_act "Flag indicating that corrective action for rich half wave of lambda stimulation is active" UBYTE _CNV_S_2_RANGE__0___1_CM 1 100. 0. 1. DISPLAY_IDENTIFIER LV_LAMB_PLS_AFR_COR_ACT[2] ECU_ADDRESS 0xd0001fbb BIT_MASK 0x1 /end MEASUREMENT
/begin MEASUREMENT egtr[1].egtr_struct_defspfstia0.maf_int_lamb_pls_act "Air mass flow integral for forced lambda stimulation activation" UWORD _CNV_A_R_LACO_LINEA_390_CM 1 100. 0. 1456.33 DISPLAY_IDENTIFIER MAF_INT_LAMB_PLS_ACT[2] ECU_ADDRESS 0xd0001fbc FORMAT "%11.6" /end MEASUREMENT
/begin MEASUREMENT egtr[1].egtr_struct_defspfstia0.lv_lamb_pls_act "Flag indicating that forced lambda stimulation is active" UBYTE _CNV_S_2_RANGE__0___1_CM 1 100. 0. 1. DISPLAY_IDENTIFIER LV_LAMB_PLS_ACT[2] ECU_ADDRESS 0xd0001fbe BIT_MASK 0x1 /end MEASUREMENT
/begin MEASUREMENT egtr[1].egtr_struct_defspfstia0.lv_lamb_pls_diag_lsh_up "Flag indicating that requested exaggerated forced lambda stimulation is active" UBYTE _CNV_S_2_RANGE__0___1_CM 1 100. 0. 1. DISPLAY_IDENTIFIER LV_LAMB_PLS_DIAG_LSH_UP[2] ECU_ADDRESS 0xd0001fbf BIT_MASK 0x1 /end MEASUREMENT
/begin MEASUREMENT egtr[1].egtr_struct_defspfstia0.lv_lamb_pls_act_cat_purge "Flag that indicates that the forced stimulation can be activated due to cat purge" UBYTE _CNV_S_2_RANGE__0___1_CM 1 100. 0. 1. DISPLAY_IDENTIFIER LV_LAMB_PLS_ACT_CAT_PURGE[2] ECU_ADDRESS 0xd0001fc0 BIT_MASK 0x1 /end MEASUREMENT
/begin MEASUREMENT egtr[1].egtr_struct_defspfsti0.o2l_add_lamb_pls "O2 load to be added to the O2 load integral each sample step" SLONG _CNV_A_R_EGTR_LINEA_829_CM 1 100. -669.923556 669.923555 DISPLAY_IDENTIFIER O2L_ADD_LAMB_PLS[2] ECU_ADDRESS 0xd0001fc4 FORMAT "%11.6" /end MEASUREMENT
/begin MEASUREMENT egtr[1].egtr_struct_defspfsti0.o2l_lamb_pls "Current O2 loading or release for forced lambda stimulation" SLONG _CNV_A_R_EGTR_LINEA_829_CM 1 100. -669.923556 669.923555 DISPLAY_IDENTIFIER O2L_LAMB_PLS[2] ECU_ADDRESS 0xd0001fc8 FORMAT "%11.6" /end MEASUREMENT
/begin MEASUREMENT egtr[1].egtr_struct_defspfsti0.o2l_sp_new_lamb_pls "O2 loading set point that is realized by forced lambda stimulation" UWORD _CNV_A_R_LINEAR_____822_CM 1 100. 0. 2.61684895833333 DISPLAY_IDENTIFIER O2L_SP_NEW_LAMB_PLS[2] ECU_ADDRESS 0xd0001fcc FORMAT "%7.5" /end MEASUREMENT
/begin MEASUREMENT egtr[1].egtr_struct_defspfsti0.lamb_pls_o2l_osc "Lambda set point deviation based on forced stimulation O2 balancing" SWORD _CNV_A_R_LINEAR_____23_CM 1 100. -0.125 0.12493 DISPLAY_IDENTIFIER LAMB_PLS_O2L_OSC[2] ECU_ADDRESS 0xd0001fce FORMAT "%8.5" /end MEASUREMENT
/begin MEASUREMENT egtr[1].egtr_struct_defspfsti0.fac_o2l_lamb_pls "Temporary factor for O2 loading calculation considering the lambda set point deviation" SWORD _CNV_A_R_EGTR_LINEA_830_CM 1 100. -0.25 0.249992 DISPLAY_IDENTIFIER FAC_O2L_LAMB_PLS[2] ECU_ADDRESS 0xd0001fd0 FORMAT "%9.6" /end MEASUREMENT
/begin MEASUREMENT egtr[1].egtr_struct_defspfsti0.o2l_sp_half_lamb_pls "Auxiliary value; half O2 loading set point of forced lambda stimulation" UWORD _CNV_A_R_LINEAR_____822_CM 1 100. 0. 2.61684895833333 DISPLAY_IDENTIFIER O2L_SP_HALF_LAMB_PLS[2] ECU_ADDRESS 0xd0001fd2 FORMAT "%7.5" /end MEASUREMENT
/begin MEASUREMENT egtr[1].egtr_struct_defspfsti0.state_lamb_pls "State of forced lambda stimulation" UBYTE _CNV_S_3_EGTR_RANGE_831_CM 1 100. 0. 2. DISPLAY_IDENTIFIER STATE_LAMB_PLS[2] ECU_ADDRESS 0xd0001fd4 /end MEASUREMENT
/begin MEASUREMENT egtr[1].egtr_struct_defspfsti0.lv_lamb_pls_o2l_osc_pos "Auxiliary flag indicating positive lambda stimulation half wave" UBYTE _CNV_S_2_RANGE__0___1_CM 1 100. 0. 1. DISPLAY_IDENTIFIER LV_LAMB_PLS_O2L_OSC_POS[2] ECU_ADDRESS 0xd0001fd5 BIT_MASK 0x1 /end MEASUREMENT
/begin MEASUREMENT egtr[1].egtr_struct_defspfsti0.lv_lamb_pls_mst_cbk "Auxiliary flag indicating that this bank is master bank for forced stimulation" UBYTE _CNV_S_2_RANGE__0___1_CM 1 100. 0. 1. DISPLAY_IDENTIFIER LV_LAMB_PLS_MST_CBK[2] ECU_ADDRESS 0xd0001fd6 BIT_MASK 0x1 /end MEASUREMENT
/begin MEASUREMENT egtr[1].egtr_struct_defspcenrc0.lamb_sp_delta_cat_purge "Lambda set point shift of cat purge function" UWORD _CNV_A_R_LINEAR_____23_CM 1 100. 0. 0.24992 DISPLAY_IDENTIFIER LAMB_SP_DELTA_CAT_PURGE[2] ECU_ADDRESS 0xd0001fd8 FORMAT "%7.5" /end MEASUREMENT
/begin MEASUREMENT egtr[1].egtr_struct_defspfstii0.lv_inh_lamb_pls "Inhibition flag for forced lambda stimulation" UBYTE _CNV_S_2_RANGE__0___1_CM 1 100. 0. 1. DISPLAY_IDENTIFIER LV_INH_LAMB_PLS[2] ECU_ADDRESS 0xd0001fda BIT_MASK 0x1 /end MEASUREMENT
/begin MEASUREMENT egtr[1].egtr_struct_defspcenr0.o2l_rls_pcat_purge "Oxygen loading to be released for pre cat purge" SLONG _CNV_A_R_EGTR_LINEA_829_CM 1 100. -669.923556 669.923555 DISPLAY_IDENTIFIER O2L_RLS_PCAT_PURGE[2] ECU_ADDRESS 0xd0001fdc FORMAT "%11.6" /end MEASUREMENT
/begin MEASUREMENT egtr[1].egtr_struct_defspcenr0.o2l_rls_tot_cat_purge "Total oxygen loading to be released for pre and main cat purge" SLONG _CNV_A_R_EGTR_LINEA_829_CM 1 100. -669.923556 669.923555 DISPLAY_IDENTIFIER O2L_RLS_TOT_CAT_PURGE[2] ECU_ADDRESS 0xd0001fe0 FORMAT "%11.6" /end MEASUREMENT
/begin MEASUREMENT egtr[1].egtr_struct_defspcenr0.o2l_rls_rest_cat_purge "Estimated rest oxygen loading to be released for pre and main cat purge" SLONG _CNV_A_R_EGTR_LINEA_829_CM 1 100. -669.923556 669.923555 DISPLAY_IDENTIFIER O2L_RLS_REST_CAT_PURGE[2] ECU_ADDRESS 0xd0001fe4 FORMAT "%11.6" /end MEASUREMENT
/begin MEASUREMENT egtr[1].egtr_struct_defspcenr0.o2l_rls_add_cat_purge "Oxygen loading to be added each sample step for cat purge air mass flow integral" SLONG _CNV_A_R_EGTR_LINEA_829_CM 1 100. -669.923556 669.923555 DISPLAY_IDENTIFIER O2L_RLS_ADD_CAT_PURGE[2] ECU_ADDRESS 0xd0001fe8 FORMAT "%11.6" /end MEASUREMENT
/begin MEASUREMENT egtr[1].egtr_struct_defspcenr0.o2l_rls_main_cat_purge "Oxygen loading to be released for main cat purge" SLONG _CNV_A_R_EGTR_LINEA_829_CM 1 100. -669.923556 669.923555 DISPLAY_IDENTIFIER O2L_RLS_MAIN_CAT_PURGE[2] ECU_ADDRESS 0xd0001fec FORMAT "%11.6" /end MEASUREMENT
/begin MEASUREMENT egtr[1].egtr_struct_defspcenr0.lamb_sp_delta_it_cat_purge "Lambda set point shift of cat purge function (internal value)" UWORD _CNV_A_R_LINEAR_____23_CM 1 100. 0. 0.24992 DISPLAY_IDENTIFIER LAMB_SP_DELTA_IT_CAT_PURGE[2] ECU_ADDRESS 0xd0001ff0 FORMAT "%7.5" /end MEASUREMENT
/begin MEASUREMENT egtr[1].egtr_struct_defspcenr0.fac_o2l_rls_cat_purge "Temporary factor for O2 loading release calculation considering the lambda set point deviation" SWORD _CNV_A_R_EGTR_LINEA_830_CM 1 100. -0.25 0.249992 DISPLAY_IDENTIFIER FAC_O2L_RLS_CAT_PURGE[2] ECU_ADDRESS 0xd0001ff2 FORMAT "%9.6" /end MEASUREMENT
/begin MEASUREMENT egtr[1].egtr_struct_defspcenr0.ratio_o2l_rls_cat_purge "Quotient used by cat purge: current rest oxygen loading / total oxygen loading" UBYTE _CNV_A_R_LINEAR_____27_CM 1 100. 0. 0.99609375 DISPLAY_IDENTIFIER RATIO_O2L_RLS_CAT_PURGE[2] ECU_ADDRESS 0xd0001ff4 FORMAT "%5.3" /end MEASUREMENT
/begin MEASUREMENT egtr[1].egtr_struct_defspcenr0.lv_cat_purge_act "Flag indicating that cat purge function is active" UBYTE _CNV_S_2_RANGE__0___1_CM 1 100. 0. 1. DISPLAY_IDENTIFIER LV_CAT_PURGE_ACT[2] ECU_ADDRESS 0xd0001ff5 BIT_MASK 0x1 /end MEASUREMENT
/begin MEASUREMENT egtr[1].egtr_struct_defspcenr0.lv_vls_down_act_cat_purge "Flag indicating that downstream signal is/was below calibration threshold" UBYTE _CNV_S_2_RANGE__0___1_CM 1 100. 0. 1. DISPLAY_IDENTIFIER LV_VLS_DOWN_ACT_CAT_PURGE[2] ECU_ADDRESS 0xd0001ff6 BIT_MASK 0x1 /end MEASUREMENT
/begin MEASUREMENT egtr[1].egtr_struct_defspcenr0.lv_cat_purge_main_cat "Flag indicating that cat purge for main cat is active" UBYTE _CNV_S_2_RANGE__0___1_CM 1 100. 0. 1. DISPLAY_IDENTIFIER LV_CAT_PURGE_MAIN_CAT[2] ECU_ADDRESS 0xd0001ff7 BIT_MASK 0x1 /end MEASUREMENT
/begin MEASUREMENT egtr[1].egtr_struct_defspcenr0.lv_cat_purge_pcat "Flag indicating that cat purge for pre cat is active" UBYTE _CNV_S_2_RANGE__0___1_CM 1 100. 0. 1. DISPLAY_IDENTIFIER LV_CAT_PURGE_PCAT[2] ECU_ADDRESS 0xd0001ff8 BIT_MASK 0x1 /end MEASUREMENT
/begin MEASUREMENT egtr[1].egtr_struct_defspcenrd0.o2l_rls_sp_pcat_purge "Oxygen loading to be purged (released) during pre cat purge" UWORD _CNV_A_R_LINEAR_____822_CM 1 100. 0. 2.61684895833333 DISPLAY_IDENTIFIER O2L_RLS_SP_PCAT_PURGE[2] ECU_ADDRESS 0xd0001ffa FORMAT "%7.5" /end MEASUREMENT
/begin MEASUREMENT egtr[1].egtr_struct_defspcenrd0.fac_add_main_cat_purge "Additional weighting factor for pre and main cat differences" UBYTE _CNV_A_R_LINEAR_____100_CM 1 100. 0. 1.9921875 DISPLAY_IDENTIFIER FAC_ADD_MAIN_CAT_PURGE[2] ECU_ADDRESS 0xd0001ffc FORMAT "%8.6" /end MEASUREMENT
/begin MEASUREMENT egtr[1].egtr_struct_defspcenrd0.state_cat_purge "State indicating the activation reason of cat purge" UBYTE _CNV_S_6_EGTR_RANGE_832_CM 1 100. 0. 5. DISPLAY_IDENTIFIER STATE_CAT_PURGE[2] ECU_ADDRESS 0xd0001ffd /end MEASUREMENT
/begin MEASUREMENT egtr[1].egtr_struct_defspcenrd0.lv_cat_purge_post_puc_trig "Auxiliary flag indicating that cat purge after PUC was triggered" UBYTE _CNV_S_2_RANGE__0___1_CM 1 100. 0. 1. DISPLAY_IDENTIFIER LV_CAT_PURGE_POST_PUC_TRIG[2] ECU_ADDRESS 0xd0001ffe BIT_MASK 0x1 /end MEASUREMENT
/begin MEASUREMENT egtr[1].egtr_struct_defspcenrd0.lv_cat_purge_st "Flag indicating that cat purge can be started (set for one sample step)" UBYTE _CNV_S_2_RANGE__0___1_CM 1 100. 0. 1. DISPLAY_IDENTIFIER LV_CAT_PURGE_ST[2] ECU_ADDRESS 0xd0001fff BIT_MASK 0x1 /end MEASUREMENT
/begin MEASUREMENT egtr[1].egtr_struct_defspcenri0.temp_main_cat_purge "Catalyst temperature of main cat for cat purge function" UWORD _CNV_A_R_LINEAR_____204_CM 1 100. -273.15 1774.7875 DISPLAY_IDENTIFIER TEMP_MAIN_CAT_PURGE[2] ECU_ADDRESS 0xd0002000 FORMAT "%9.4" /end MEASUREMENT
/begin MEASUREMENT egtr[1].egtr_struct_defspcenri0.lamb_sp_delta_add_cat_purge "Additional lambda set point shift for cat purge output" UWORD _CNV_A_R_LINEAR_____23_CM 1 100. 0. 0.24993896484375 DISPLAY_IDENTIFIER LAMB_SP_DELTA_ADD_CAT_PURGE[2] ECU_ADDRESS 0xd0002002 FORMAT "%7.5" /end MEASUREMENT
/begin MEASUREMENT egtr[1].egtr_struct_defspcenri0.lv_inh_cat_purge "Inhibition flag for cat purge function" UBYTE _CNV_S_2_RANGE__0___1_CM 1 100. 0. 1. DISPLAY_IDENTIFIER LV_INH_CAT_PURGE[2] ECU_ADDRESS 0xd0002004 BIT_MASK 0x1 /end MEASUREMENT
/begin MEASUREMENT egtr[1].egtr_struct_fctdgcefld0.fac_lam_mv_delta_cat_ldc "difference between filtered and not filtered fac_lam_mv[i] for lambda limited dynamic" SWORD _CNV_A_R_LINEAR_____110_CM 1 100. -50. 49.9984741210938 DISPLAY_IDENTIFIER FAC_LAM_MV_DELTA_CAT_LDC[2] ECU_ADDRESS 0xd0002006 FORMAT "%7.3" /end MEASUREMENT
/begin MEASUREMENT egtr[1].egtr_struct_fctdgcefld0.maf_int_cat_ldc "integral of mass air flow since limited dynamic conditions fulfilled" UWORD _CNV_A_R_LACO_LINEA_390_CM 1 100. 0. 1456.33 DISPLAY_IDENTIFIER MAF_INT_CAT_LDC[2] ECU_ADDRESS 0xd0002008 FORMAT "%11.6" /end MEASUREMENT
/begin MEASUREMENT egtr[1].egtr_struct_fctdgcefld0.lv_cat_ldc "status of limited dynamics for catalyst efficiency diagnosis" UBYTE _CNV_S_2_RANGE__0___1_CM 1 100. 0. 1. DISPLAY_IDENTIFIER LV_CAT_LDC[2] ECU_ADDRESS 0xd000200a BIT_MASK 0x1 /end MEASUREMENT
/begin MEASUREMENT egtr[1].egtr_struct_fctdgcefld0.lv_fac_lam_cat_ldc "status limited dynamic fac_lam_mv[nc_cbk_ex_nr]" UBYTE _CNV_S_2_RANGE__0___1_CM 1 100. 0. 1. DISPLAY_IDENTIFIER LV_FAC_LAM_CAT_LDC[2] ECU_ADDRESS 0xd000200b BIT_MASK 0x1 /end MEASUREMENT
/begin MEASUREMENT egtr[1].egtr_struct_fctdgcefif0.eff_cat_diag_obd "cat. diag. value for obd scantool mod 6 output" UBYTE _CNV_A_R_LINEAR_____100_CM 1 100. 0. 1.9921875 DISPLAY_IDENTIFIER EFF_CAT_DIAG_OBD[2] ECU_ADDRESS 0xd000200c FORMAT "%8.6" /end MEASUREMENT
/begin MEASUREMENT egtr[1].egtr_struct_fctdgcefif0.eff_cat_max_diag_obd "actually threshold for scantool mod 6 output" UBYTE _CNV_A_R_LINEAR_____100_CM 1 100. 0. 1.9921875 DISPLAY_IDENTIFIER EFF_CAT_MAX_DIAG_OBD[2] ECU_ADDRESS 0xd000200d FORMAT "%8.6" /end MEASUREMENT
/begin MEASUREMENT egtr[1].egtr_struct_fctdgcefif0.lv_cdn_diag_cat_diag "Flag condition for catalyst diagnosis active" UBYTE _CNV_S_2_RANGE__0___1_CM 1 100. 0. 1. DISPLAY_IDENTIFIER LV_CDN_DIAG_CAT_DIAG[2] ECU_ADDRESS 0xd000200e BIT_MASK 0x1 /end MEASUREMENT
/begin MEASUREMENT egtr[1].egtr_struct_fctdgcefif0.lv_end_diag_cat_diag "flag catalyst diagnosis finished for that driving cycle" UBYTE _CNV_S_2_RANGE__0___1_CM 1 100. 0. 1. DISPLAY_IDENTIFIER LV_END_DIAG_CAT_DIAG[2] ECU_ADDRESS 0xd000200f BIT_MASK 0x1 /end MEASUREMENT
/begin MEASUREMENT egtr[1].egtr_struct_fctdgcefif0.lv_err_cat_diag "Present_failure: failure after filtering diagnosis value catalyst diagnose" UBYTE _CNV_S_2_RANGE__0___1_CM 1 100. 0. 1. DISPLAY_IDENTIFIER LV_ERR_CAT_DIAG[2] ECU_ADDRESS 0xd0002010 BIT_MASK 0x1 /end MEASUREMENT
/begin MEASUREMENT egtr[1].egtr_struct_fctdgcefac0.maf_int_dly_cat_diag "Air mass flow integral after conditions are fulfilled for catalyst diagnosis activation" UWORD _CNV_A_R_LACO_LINEA_390_CM 1 100. 0. 1456.33 DISPLAY_IDENTIFIER MAF_INT_DLY_CAT_DIAG[2] ECU_ADDRESS 0xd0002012 FORMAT "%11.6" /end MEASUREMENT
/begin MEASUREMENT egtr[1].egtr_struct_fctdgcefac0.lv_cat_diag_cdn_act "Activation condition for O2 sensor and catalyst efficiency diagnosis (OSC-method)" UBYTE _CNV_S_2_RANGE__0___1_CM 1 100. 0. 1. DISPLAY_IDENTIFIER LV_CAT_DIAG_CDN_ACT[2] ECU_ADDRESS 0xd0002014 BIT_MASK 0x1 /end MEASUREMENT
/begin MEASUREMENT egtr[1].egtr_struct_fctdgcef0.ratio_mass_o2_cat_dif_sum "summation of mass_o2_cat_dif_ratio[i] over all valid monitoring cycles" ULONG _CNV_A_R_EGTR_LINEA_833_CM 1 100. 0. 131072. DISPLAY_IDENTIFIER RATIO_MASS_O2_CAT_DIF_SUM[2] ECU_ADDRESS 0xd0002018 FORMAT "%13.5" /end MEASUREMENT
/begin MEASUREMENT egtr[1].egtr_struct_fctdgcef0.lamb_cat_down_sum "integral of downstream lambda through 1 diagnosis period for calculation of mean value" ULONG _CNV_A_R_EGTR_LINEA_833_CM 1 100. 0. 131072. DISPLAY_IDENTIFIER LAMB_CAT_DOWN_SUM[2] ECU_ADDRESS 0xd000201c FORMAT "%13.5" /end MEASUREMENT
/begin MEASUREMENT egtr[1].egtr_struct_fctdgcef0.ratio_mass_o2_cat_dif "weighted mass_o2_cat_dif_cyc[i] value related to o2-load upstream catalyst from lambda controller" UWORD _CNV_A_R_LINEAR_____8_CM 1 100. 0. 1.99996948242188 DISPLAY_IDENTIFIER RATIO_MASS_O2_CAT_DIF[2] ECU_ADDRESS 0xd0002020 FORMAT "%7.5" /end MEASUREMENT
/begin MEASUREMENT egtr[1].egtr_struct_fctdgcef0.mass_o2_cat_dif_cyc "mass o2 downsteam catalyst to mean value through 1 diagnosis period" UWORD _CNV_A_R_EGTR_LINEA_834_CM 1 100. 0. 8.17765e-002 DISPLAY_IDENTIFIER MASS_O2_CAT_DIF_CYC[2] ECU_ADDRESS 0xd0002022 FORMAT "%8.6" /end MEASUREMENT
/begin MEASUREMENT egtr[1].egtr_struct_fctdgcef0.lamb_cat_down_mv "downstream lambda mean value for complete diagnosis period" UWORD _CNV_A_R_LINEAR_____8_CM 1 100. 0. 1.99996948242188 DISPLAY_IDENTIFIER LAMB_CAT_DOWN_MV[2] ECU_ADDRESS 0xd0002024 FORMAT "%7.5" /end MEASUREMENT
/begin MEASUREMENT egtr[1].egtr_struct_fctdgcef0.lamb_cat_down_st_cyc "lamb_cat_down[i] value at start of monitoring cycle" UWORD _CNV_A_R_LINEAR_____8_CM 1 100. 0. 1.99996948242188 DISPLAY_IDENTIFIER LAMB_CAT_DOWN_ST_CYC[2] ECU_ADDRESS 0xd0002026 FORMAT "%7.5" /end MEASUREMENT
/begin MEASUREMENT egtr[1].egtr_struct_fctdgcef0.lamb_cat_down "lambda downstream of catalyst; linearization of downstream ls signal" UWORD _CNV_A_R_LINEAR_____8_CM 1 100. 0. 1.99996948242188 DISPLAY_IDENTIFIER LAMB_CAT_DOWN[2] ECU_ADDRESS 0xd0002028 FORMAT "%7.5" /end MEASUREMENT
/begin MEASUREMENT egtr[1].egtr_struct_fctdgcef0.flow_o2_cat_dif "downstream O2 flow difference to mean value" UWORD _CNV_A_R_EGTR_LINEA_835_CM 1 100. 0. 2.04441325e-003 DISPLAY_IDENTIFIER FLOW_O2_CAT_DIF[2] ECU_ADDRESS 0xd000202a FORMAT "%8.6" /end MEASUREMENT
/begin MEASUREMENT egtr[1].egtr_struct_fctdgcef0.ctr_cat_diag "monitoring cycle counter" UWORD _CNV_A_R_LINEAR_____0_CM 1 100. 0. 511. DISPLAY_IDENTIFIER CTR_CAT_DIAG[2] ECU_ADDRESS 0xd000202c FORMAT "%5.0" /end MEASUREMENT
/begin MEASUREMENT egtr[1].egtr_struct_fctdgcef0.ctr_lamb_out_cat_diag "counter of non valid cycle due to lamb_cat_down_mv[i] is not in right range, for switch off cat diag" UBYTE _CNV_A_R_LINEAR_____0_CM 1 100. 0. 255. DISPLAY_IDENTIFIER CTR_LAMB_OUT_CAT_DIAG[2] ECU_ADDRESS 0xd000202e FORMAT "%3.0" /end MEASUREMENT
/begin MEASUREMENT egtr[1].egtr_struct_fctdgcef0.ctr_tot_cat_diag "total sum of all completed diagnosis cycles since ecu programming" UBYTE _CNV_A_R_LINEAR_____0_CM 1 100. 0. 255. DISPLAY_IDENTIFIER CTR_TOT_CAT_DIAG[2] ECU_ADDRESS 0xd000202f FORMAT "%3.0" /end MEASUREMENT
/begin MEASUREMENT egtr[1].egtr_struct_fctdgcef0.eff_cat_diag "at ended diagnosis final value for catalyst conversion capability" UBYTE _CNV_A_R_LINEAR_____100_CM 1 100. 0. 1.9921875 DISPLAY_IDENTIFIER EFF_CAT_DIAG[2] ECU_ADDRESS 0xd0002030 FORMAT "%8.6" /end MEASUREMENT
/begin MEASUREMENT egtr[1].egtr_struct_fctdgcef0.temp_cat_dif_dyn_stat "temperature difference between dynamic and stationary catalyst temperature (from cat. temperature model)" UBYTE _CNV_A_R_EGTR_LINEA_825_CM 1 100. -127. 128. DISPLAY_IDENTIFIER TEMP_CAT_DIF_DYN_STAT[2] ECU_ADDRESS 0xd0002031 FORMAT "%4.0" /end MEASUREMENT
/begin MEASUREMENT egtr[1].egtr_struct_fctdgcef0.state_cat_diag "state of diagnosis" UBYTE _CNV_S_5_EGTR_RANGE_836_CM 1 100. 0. 4. DISPLAY_IDENTIFIER STATE_CAT_DIAG[2] ECU_ADDRESS 0xd0002032 /end MEASUREMENT
/begin MEASUREMENT egtr[1].egtr_struct_fctdgcef0.state_cat_diag_cyc_vld "summary validity bits, current monitoring cycle valid and involved in calculation of diagnosis value" UBYTE _CNV_A_R_LINEAR_____0_CM 1 100. 0. 15. DISPLAY_IDENTIFIER STATE_CAT_DIAG_CYC_VLD[2] ECU_ADDRESS 0xd0002033 FORMAT "%3.0" /end MEASUREMENT
/begin MEASUREMENT egtr[1].egtr_struct_fctdgcef0.lv_lamb_pls_req_cat_diag "flag to switch forced stimulation parameters for osc/nox cat. diagnosis" UBYTE _CNV_S_2_RANGE__0___1_CM 1 100. 0. 1. DISPLAY_IDENTIFIER LV_LAMB_PLS_REQ_CAT_DIAG[2] ECU_ADDRESS 0xd0002034 BIT_MASK 0x1 /end MEASUREMENT
/begin MEASUREMENT egtr[1].egtr_struct_fctdgcef0.lv_lam_adj_cat_diag "flag to switch trim control parameters for osc/nox cat. diagnosis" UBYTE _CNV_S_2_RANGE__0___1_CM 1 100. 0. 1. DISPLAY_IDENTIFIER LV_LAM_ADJ_CAT_DIAG[2] ECU_ADDRESS 0xd0002035 BIT_MASK 0x1 /end MEASUREMENT
/begin MEASUREMENT egtr[1].egtr_struct_fctdgcefi0.state_rbm_cat "interface of monitor cat_diag for the rate based monitoring statistics" UBYTE _CNV_A_R_LINEAR_____0_CM 1 100. 0. 15. DISPLAY_IDENTIFIER STATE_RBM_CAT[2] ECU_ADDRESS 0xd0002036 FORMAT "%3.0" /end MEASUREMENT
/begin MEASUREMENT egtr[1].egtr_struct_fctdgcefi0.lv_inh_diag_cat_diag "flag to inhibit catalyst diagnosis function if there is a component failure" UBYTE _CNV_A_R_LINEAR_____0_CM 1 100. 0. 1. DISPLAY_IDENTIFIER LV_INH_DIAG_CAT_DIAG[2] ECU_ADDRESS 0xd0002037 FORMAT "%1.0" BIT_MASK 0x1 /end MEASUREMENT
/begin MEASUREMENT egtr[1].egtr_struct_fctdgcefi0.lv_inh_diag_rbm_cat_diag "flag to inhibit rbm catalyst diagnosis dc incrementation if there is a component failure" UBYTE _CNV_A_R_LINEAR_____0_CM 1 100. 0. 1. DISPLAY_IDENTIFIER LV_INH_DIAG_RBM_CAT_DIAG[2] ECU_ADDRESS 0xd0002038 FORMAT "%1.0" BIT_MASK 0x1 /end MEASUREMENT
/begin MEASUREMENT egtr[1].egtr_struct_fctdgtdloc0.action_O2L_data_h_ampl.o2l_pha "Calculated O2L" UWORD _CNV_A_R_LINEAR_____822_CM 1 100. 0. 2.61684895833333 DISPLAY_IDENTIFIER O2L_RGN_H_AMPL_PHA[2] ECU_ADDRESS 0xd0002068 FORMAT "%7.5" /end MEASUREMENT
/begin MEASUREMENT egtr[1].egtr_struct_fctdgtdloc0.action_O2L_data_h_ampl.o2l_int_pha "Calculated O2L Integral" UWORD _CNV_A_R_LINEAR_____822_CM 1 100. 0. 2.61684895833333 DISPLAY_IDENTIFIER O2L_INT_RGN_H_AMPL_PHA[2] ECU_ADDRESS 0xd000206a FORMAT "%7.5" /end MEASUREMENT
/begin MEASUREMENT egtr[1].egtr_struct_fctdgtdloc0.action_O2L_data_h_ampl.lv_o2l_clc "Flag for calculation of O2L" UBYTE _CNV_A_R_LINEAR_____0_CM 1 100. 0. 1. DISPLAY_IDENTIFIER LV_O2L_CLC_RGN_H_AMPL[2] ECU_ADDRESS 0xd000206d FORMAT "%1.0" BIT_MASK 0x1 /end MEASUREMENT
/begin MEASUREMENT egtr[1].egtr_struct_fctdgtdloc0.action_O2L_data_l_ampl.o2l_pha "Calculated O2L" UWORD _CNV_A_R_LINEAR_____822_CM 1 100. 0. 2.61684895833333 DISPLAY_IDENTIFIER O2L_RGN_L_AMPL_PHA[2] ECU_ADDRESS 0xd0002070 FORMAT "%7.5" /end MEASUREMENT
/begin MEASUREMENT egtr[1].egtr_struct_fctdgtdloc0.action_O2L_data_l_ampl.o2l_int_pha "Calculated O2L Integral" UWORD _CNV_A_R_LINEAR_____822_CM 1 100. 0. 2.61684895833333 DISPLAY_IDENTIFIER O2L_INT_RGN_L_AMPL_PHA[2] ECU_ADDRESS 0xd0002072 FORMAT "%7.5" /end MEASUREMENT
/begin MEASUREMENT egtr[1].egtr_struct_fctdgtdloc0.action_O2L_data_l_ampl.lv_o2l_clc "Flag for calculation of O2L" UBYTE _CNV_A_R_LINEAR_____0_CM 1 100. 0. 1. DISPLAY_IDENTIFIER LV_O2L_CLC_RGN_L_AMPL[2] ECU_ADDRESS 0xd0002075 FORMAT "%1.0" BIT_MASK 0x1 /end MEASUREMENT
/begin MEASUREMENT egtr[1].egtr_struct_fctdgtdloc0.action_O2L_data_park.o2l_pha "Calculated O2L" UWORD _CNV_A_R_LINEAR_____822_CM 1 100. 0. 2.61684895833333 DISPLAY_IDENTIFIER O2L_PARK_PHA[2] ECU_ADDRESS 0xd0002078 FORMAT "%7.5" /end MEASUREMENT
/begin MEASUREMENT egtr[1].egtr_struct_fctdgtdloc0.action_O2L_data_park.o2l_int_pha "Calculated O2L Integral" UWORD _CNV_A_R_LINEAR_____822_CM 1 100. 0. 2.61684895833333 DISPLAY_IDENTIFIER O2L_INT_PARK_PHA[2] ECU_ADDRESS 0xd000207a FORMAT "%7.5" /end MEASUREMENT
/begin MEASUREMENT egtr[1].egtr_struct_fctdgtdloc0.action_O2L_data_park.lv_o2l_clc "Flag for calculation of O2L" UBYTE _CNV_A_R_LINEAR_____0_CM 1 100. 0. 1. DISPLAY_IDENTIFIER LV_O2L_CLC_PARK[2] ECU_ADDRESS 0xd000207d FORMAT "%1.0" BIT_MASK 0x1 /end MEASUREMENT
/begin MEASUREMENT egtr[1].egtr_struct_fctdgtdloc0.action_O2L_data_load.o2l_pha "Calculated O2L" UWORD _CNV_A_R_LINEAR_____822_CM 1 100. 0. 2.61684895833333 DISPLAY_IDENTIFIER O2L_LOAD_PHA[2] ECU_ADDRESS 0xd0002080 FORMAT "%7.5" /end MEASUREMENT
/begin MEASUREMENT egtr[1].egtr_struct_fctdgtdloc0.action_O2L_data_load.o2l_int_pha "Calculated O2L Integral" UWORD _CNV_A_R_LINEAR_____822_CM 1 100. 0. 2.61684895833333 DISPLAY_IDENTIFIER O2L_INT_LOAD_PHA[2] ECU_ADDRESS 0xd0002082 FORMAT "%7.5" /end MEASUREMENT
/begin MEASUREMENT egtr[1].egtr_struct_fctdgtdloc0.action_O2L_data_load.lv_o2l_clc "Flag for calculation of O2L" UBYTE _CNV_A_R_LINEAR_____0_CM 1 100. 0. 1. DISPLAY_IDENTIFIER LV_O2L_CLC_LOAD[2] ECU_ADDRESS 0xd0002085 FORMAT "%1.0" BIT_MASK 0x1 /end MEASUREMENT
/begin MEASUREMENT egtr[1].egtr_struct_fctdgtdloc0.state_o2l_clc_vld "Validation state for O2L integral calculation" UBYTE _CNV_A_R_LINEAR_____0_CM 1 100. 0. 255. DISPLAY_IDENTIFIER STATE_O2L_CLC_VLD[2] ECU_ADDRESS 0xd0002088 FORMAT "%3.0" /end MEASUREMENT
/begin MEASUREMENT egtr[1].egtr_struct_fctdgtdloc0.t_afl_cdn_out "Timer for exit from state LEAN_CDN" UWORD _CNV_A_R_LINEAR_____3_CM 1 100. 0. 655.35 DISPLAY_IDENTIFIER T_AFL_CDN_OUT[2] ECU_ADDRESS 0xd000208a FORMAT "%6.2" /end MEASUREMENT
/begin MEASUREMENT egtr[1].egtr_struct_fctdgtdloc0.state_cat_diag_afl "OSC calculation state for TWC diagnosis at lean operation" UBYTE _CNV_S_4_RANGE_STAT_838_CM 1 100. 0. 3. DISPLAY_IDENTIFIER STATE_CAT_DIAG_AFL[2] ECU_ADDRESS 0xd000208c /end MEASUREMENT
/begin CHARACTERISTIC c_state_o2l_clc_ena "State to allow of calculation of O2L integrals" VALUE 0xa1002c0a _REC_VAL_20_u1 255. _CNV_A_R_LINEAR_____0_CM 0. 255. DISPLAY_IDENTIFIER C_STATE_O2L_CLC_ENA FORMAT "%3.0" /end CHARACTERISTIC
/begin CHARACTERISTIC c_t_afl_cdn_out "Maximal time to exit from LEAN_CDN state" VALUE 0xa1002c0c _REC_VAL_20_u2 655.35 _CNV_A_R_LINEAR_____3_CM 0. 655.35 DISPLAY_IDENTIFIER C_T_AFL_CDN_OUT FORMAT "%6.2" /end CHARACTERISTIC
/begin AXIS_PTS ldp_lamb_ls_up_ip_fac_diag_afl "" 0xa1002334 online_dummy _REC_AXS_20_u2 31.9990234375 _CNV_A_R_LINEAR_____122_CM 8 0. 31.9990234375 FORMAT "%7.4" /end AXIS_PTS
/begin CHARACTERISTIC ip_fac_lamb_diag_afl "O2L correction factor depending on lambda" CURVE 0xa10024ac _REC_CUR_20_u1_u2 3.984375 _CNV_A_R_LINEAR_____283_CM 0. 3.984375 DISPLAY_IDENTIFIER IP_FAC_LAMB_DIAG_AFL FORMAT "%8.6"
 /begin AXIS_DESCR COM_AXIS online_dummy _CNV_A_R_LINEAR_____122_CM 8 0. 31.9990234375 FORMAT "%7.4" AXIS_PTS_REF ldp_lamb_ls_up_ip_fac_diag_afl /end AXIS_DESCR
/end CHARACTERISTIC
/begin AXIS_PTS ldp_n_32_ip_fac_diag_afl "" 0xa100238c n_32 _REC_AXS_20_u1 8160. _CNV_A_R_LINEAR_____9_CM 8 0. 8160. FORMAT "%4.0" /end AXIS_PTS
/begin AXIS_PTS ldp_maf_cyl_ip_fac_diag_afl "" 0xa1002348 maf_cyl _REC_AXS_20_u2 2047.96875 _CNV_A_R_LINEAR_____207_CM 8 0. 2047.96875 FORMAT "%10.5" /end AXIS_PTS
/begin CHARACTERISTIC ip_fac_opp_diag_afl "O2L correction factor depending on operating point" MAP 0xa10025fc _REC_MAP_20_u1_u1_u2 3.984375 _CNV_A_R_LINEAR_____283_CM 0. 3.984375 DISPLAY_IDENTIFIER IP_FAC_OPP_DIAG_AFL FORMAT "%8.6"
 /begin AXIS_DESCR COM_AXIS n_32 _CNV_A_R_LINEAR_____9_CM 8 0. 8160. FORMAT "%4.0" AXIS_PTS_REF ldp_n_32_ip_fac_diag_afl /end AXIS_DESCR
 /begin AXIS_DESCR COM_AXIS maf_cyl _CNV_A_R_LINEAR_____207_CM 8 0. 2047.96875 FORMAT "%10.5" AXIS_PTS_REF ldp_maf_cyl_ip_fac_diag_afl /end AXIS_DESCR
/end CHARACTERISTIC
/begin AXIS_PTS ldp_temp_stat_ip_fac_diag_afl "" 0xa1002408 online_dummy _REC_AXS_20_u2 2047.9375 _CNV_A_R_LINEAR_____204_CM 8 -273.15 1774.7875 FORMAT "%9.4" /end AXIS_PTS
/begin AXIS_PTS ldp_temp_dif_ip_fac_diag_afl "" 0xa10023e4 online_dummy _REC_AXS_20_u2 4095.9375 _CNV_A_R_EGCP_LINEA_315_CM 8 -2048. 2047.9375 FORMAT "%10.4" /end AXIS_PTS
/begin CHARACTERISTIC ip_fac_temp_diag_afl "O2L correction factor depending on TWC temperature" MAP 0xa10026bc _REC_MAP_20_u1_u2_u2 3.984375 _CNV_A_R_LINEAR_____283_CM 0. 3.984375 DISPLAY_IDENTIFIER IP_FAC_TEMP_DIAG_AFL FORMAT "%8.6"
 /begin AXIS_DESCR COM_AXIS online_dummy _CNV_A_R_LINEAR_____204_CM 8 -273.15 1774.7875 FORMAT "%9.4" AXIS_PTS_REF ldp_temp_stat_ip_fac_diag_afl /end AXIS_DESCR
 /begin AXIS_DESCR COM_AXIS online_dummy _CNV_A_R_EGCP_LINEA_315_CM 8 -2048. 2047.9375 FORMAT "%10.4" AXIS_PTS_REF ldp_temp_dif_ip_fac_diag_afl /end AXIS_DESCR
/end CHARACTERISTIC
/begin COMPU_METHOD _CNV_A_R_LINEAR_____0_CM "" RAT_FUNC "%6.3" "-" COEFFS 0 1. 0. 0 0 1 /end COMPU_METHOD
/begin COMPU_METHOD _CNV_S_2_RANGE__0___1_CM "" TAB_VERB "%6.3" "-" COMPU_TAB_REF _CNV_S_2_RANGE__0___1 /end COMPU_METHOD
/begin COMPU_VTAB _CNV_S_2_RANGE__0___1 "" TAB_VERB 2 0 "0" 1 "1" /end COMPU_VTAB
/begin COMPU_METHOD _CNV_A_R_LINEAR_____2_CM "" RAT_FUNC "%6.3" "V" COEFFS 0 204.8 0. 0 0 1 /end COMPU_METHOD
/begin COMPU_METHOD _CNV_A_R_LINEAR_____3_CM "" RAT_FUNC "%6.3" "s" COEFFS 0 100. 0. 0 0 1 /end COMPU_METHOD
/begin COMPU_METHOD _CNV_A_R_LINEAR_____4_CM "" RAT_FUNC "%6.3" "s" COEFFS 0 10. 0. 0 0 1 /end COMPU_METHOD
/begin COMPU_METHOD _CNV_A_R_LINEAR_____5_CM "" RAT_FUNC "%6.3" "%" COEFFS 0 2.56 0. 0 0 1 /end COMPU_METHOD
/begin COMPU_METHOD _CNV_A_R_LINEAR_____6_CM "" RAT_FUNC "%6.3" "km/h" COEFFS 0 1. 0. 0 0 1 /end COMPU_METHOD
/begin COMPU_METHOD _CNV_A_R_LINEAR_____7_CM "" RAT_FUNC "%6.3" "%" COEFFS 0 655.3599999999997 0. 0 0 1 /end COMPU_METHOD
/begin COMPU_METHOD _CNV_A_R_LINEAR_____8_CM "" RAT_FUNC "%6.3" "-" COEFFS 0 32767.99999999992 0. 0 0 1 /end COMPU_METHOD
/begin COMPU_METHOD _CNV_A_R_LINEAR_____9_CM "" RAT_FUNC "%6.3" "rpm" COEFFS 0 3.125e-002 0. 0 0 1 /end COMPU_METHOD
/begin COMPU_METHOD _CNV_A_R_LINEAR_____13_CM "" RAT_FUNC "%6.3" "rpm" COEFFS 0 1. 0. 0 0 1 /end COMPU_METHOD
/begin COMPU_METHOD _CNV_A_R_LINEAR_____14_CM "" RAT_FUNC "%6.3" "mg/stk" COEFFS 0 0.183585313174946 0. 0 0 1 /end COMPU_METHOD
/begin COMPU_METHOD _CNV_A_R_LINEAR_____16_CM "" RAT_FUNC "%6.3" "°C" COEFFS 0 1.333333333333333 64. 0 0 1 /end COMPU_METHOD
/begin COMPU_METHOD _CNV_A_R_LINEAR_____23_CM "" RAT_FUNC "%6.3" "-" COEFFS 0 16384. 0. 0 0 1 /end COMPU_METHOD
/begin COMPU_METHOD _CNV_A_R_LINEAR_____26_CM "" RAT_FUNC "%6.3" "hPa" COEFFS 0 12.06017666543982 0. 0 0 1 /end COMPU_METHOD
/begin COMPU_METHOD _CNV_A_R_LINEAR_____27_CM "" RAT_FUNC "%6.3" "-" COEFFS 0 256. 0. 0 0 1 /end COMPU_METHOD
/begin COMPU_METHOD _CNV_A_R_LINEAR_____50_CM "" RAT_FUNC "%6.3" "" COEFFS 0 1. 0. 0 0 1 /end COMPU_METHOD
/begin COMPU_METHOD _CNV_A_R_LINEAR_____68_CM "" RAT_FUNC "%6.3" "-" COEFFS 0 65535.99999999996 0. 0 0 1 /end COMPU_METHOD
/begin COMPU_METHOD _CNV_A_R_LINEAR_____100_CM "" RAT_FUNC "%6.3" "-" COEFFS 0 128. 0. 0 0 1 /end COMPU_METHOD
/begin COMPU_METHOD _CNV_A_R_LINEAR_____107_CM "" RAT_FUNC "%6.3" "s" COEFFS 0 50. 0. 0 0 1 /end COMPU_METHOD
/begin COMPU_METHOD _CNV_A_R_LINEAR_____108_CM "" RAT_FUNC "%6.3" "mg/stk" COEFFS 0 47.18142548596112 0. 0 0 1 /end COMPU_METHOD
/begin COMPU_METHOD _CNV_A_R_LINEAR_____110_CM "" RAT_FUNC "%6.3" "%" COEFFS 0 655.3599999999997 -1.455191522836685e-011 0 0 1 /end COMPU_METHOD
/begin COMPU_METHOD _CNV_A_R_LINEAR_____111_CM "" RAT_FUNC "%6.3" "ms" COEFFS 0 250. 0. 0 0 1 /end COMPU_METHOD
/begin COMPU_METHOD _CNV_A_R_LINEAR_____122_CM "" RAT_FUNC "%6.3" "-" COEFFS 0 1024. 0. 0 0 1 /end COMPU_METHOD
/begin COMPU_METHOD _CNV_A_R_LINEAR_____166_CM "" RAT_FUNC "%6.3" "°CRK" COEFFS 0 16. 0. 0 0 1 /end COMPU_METHOD
/begin COMPU_METHOD _CNV_A_R_LINEAR_____204_CM "" RAT_FUNC "%6.3" "°C" COEFFS 0 16. 4370.4 0 0 1 /end COMPU_METHOD
/begin COMPU_METHOD _CNV_A_R_LINEAR_____207_CM "" RAT_FUNC "%6.3" "kg/h" COEFFS 0 32. 0. 0 0 1 /end COMPU_METHOD
/begin COMPU_METHOD _CNV_A_R_LINEAR_____211_CM "" RAT_FUNC "%6.3" "mV" COEFFS 0 1. 200. 0 0 1 /end COMPU_METHOD
/begin COMPU_METHOD _CNV_A_R_LINEAR_____275_CM "" RAT_FUNC "%6.3" "-" COEFFS 0 32768. 0. 0 0 1 /end COMPU_METHOD
/begin COMPU_METHOD _CNV_A_R_LINEAR_____283_CM "" RAT_FUNC "%6.3" "-" COEFFS 0 64. 0. 0 0 1 /end COMPU_METHOD
/begin COMPU_METHOD _CNV_A_R_LINEAR_____289_CM "Battery voltage" RAT_FUNC "%6.3" "V" COEFFS 0 9.846153846153847 0. 0 0 1 /end COMPU_METHOD
/begin COMPU_METHOD _CNV_A_R_EGCP_LINEA_315_CM "Battery voltage" RAT_FUNC "%6.3" "°C" COEFFS 0 16. 32768. 0 0 1 /end COMPU_METHOD
/begin COMPU_METHOD _CNV_A_R_LINEAR_____329_CM "" RAT_FUNC "%6.3" "g" COEFFS 0 22.49999999999997 0. 0 0 1 /end COMPU_METHOD
/begin COMPU_METHOD _CNV_A_R_LACO_LINEA_390_CM "" RAT_FUNC "%6.3" "g" COEFFS 0 45.00010299863355 0. 0 0 1 /end COMPU_METHOD
/begin COMPU_METHOD _CNV_A_R_CPULOAD__0_461_CM "" RAT_FUNC "%6.3" "%" COEFFS 0 10.24 0. 0 0 1 /end COMPU_METHOD
/begin COMPU_METHOD _CNV_A_R_ACRC_LINEA_813_CM "" RAT_FUNC "%6.3" "%" COEFFS 0 40.96 0. 0 0 1 /end COMPU_METHOD
/begin COMPU_METHOD _CNV_A_R_EGTR_LINEA_821_CM "" RAT_FUNC "%6.3" "°C" COEFFS 0 15.99998046817778 4370.39466488276 0 0 1 /end COMPU_METHOD
/begin COMPU_METHOD _CNV_A_R_LINEAR_____822_CM "" RAT_FUNC "%6.3" "g" COEFFS 0 25043.4782608696 0. 0 0 1 /end COMPU_METHOD
/begin COMPU_METHOD _CNV_S_7_EGTR_RANGE_823_CM "" TAB_VERB "%6.3" "-" COMPU_TAB_REF _CNV_S_7_EGTR_RANGE_823 /end COMPU_METHOD
/begin COMPU_VTAB _CNV_S_7_EGTR_RANGE_823 "" TAB_VERB 7 0 "PLS_OFF" 1 "PLS_LSH_DIAG" 2 "PLS_CAT_DIAG" 3 "PLS_CAT_DIAG_TRAN" 4 "PLS_DYN_DIAG" 5 "PLS_IS" 6 "PLS_NOM" /end COMPU_VTAB
/begin COMPU_METHOD _CNV_A_R_EGTR_LINEA_824_CM "" RAT_FUNC "%6.3" "°C" COEFFS 0 0.125 34.14375 0 0 1 /end COMPU_METHOD
/begin COMPU_METHOD _CNV_A_R_EGTR_LINEA_825_CM "" RAT_FUNC "%6.3" "°C" COEFFS 0 1. 127. 0 0 1 /end COMPU_METHOD
/begin COMPU_METHOD _CNV_A_R_LINEAR_____826_CM "" RAT_FUNC "%6.3" "-" COEFFS 0 204.8 0. 0 0 1 /end COMPU_METHOD
/begin COMPU_METHOD _CNV_A_R_EGTR_LINEA_827_CM "" RAT_FUNC "%6.3" "%/s" COEFFS 0 0.4095988699858748 0. 0 0 1 /end COMPU_METHOD
/begin COMPU_METHOD _CNV_A_R_EGTR_LINEA_828_CM "" RAT_FUNC "%6.3" "%/s" COEFFS 0 0.4095997693749099 -2.882813626001735e-004 0 0 1 /end COMPU_METHOD
/begin COMPU_METHOD _CNV_A_R_EGTR_LINEA_829_CM "" RAT_FUNC "%6.3" "g" COEFFS 0 3205565.216910782 1.102782249450684 0 0 1 /end COMPU_METHOD
/begin COMPU_METHOD _CNV_A_R_EGTR_LINEA_830_CM "" RAT_FUNC "%6.3" "-" COEFFS 0 131072.0971535545 2.428838861669647e-002 0 0 1 /end COMPU_METHOD
/begin COMPU_METHOD _CNV_S_3_EGTR_RANGE_831_CM "" TAB_VERB "%6.3" "-" COMPU_TAB_REF _CNV_S_3_EGTR_RANGE_831 /end COMPU_METHOD
/begin COMPU_VTAB _CNV_S_3_EGTR_RANGE_831 "" TAB_VERB 3 0 "OFF" 1 "AFL" 2 "AFR" /end COMPU_VTAB
/begin COMPU_METHOD _CNV_S_6_EGTR_RANGE_832_CM "" TAB_VERB "%6.3" "-" COMPU_TAB_REF _CNV_S_6_EGTR_RANGE_832 /end COMPU_METHOD
/begin COMPU_VTAB _CNV_S_6_EGTR_RANGE_832 "" TAB_VERB 6 0 "CAT_PURGE_OFF" 1 "CAT_PURGE_PUC" 2 "CAT_PURGE_SA" 3 "CAT_PURGE_HST" 4 "CAT_PURGE_CH" 5 "CAT_PURGE_GS_SCC" /end COMPU_VTAB
/begin COMPU_METHOD _CNV_A_R_EGTR_LINEA_833_CM "" RAT_FUNC "%6.3" "-" COEFFS 0 32767.99999237061 0. 0 0 1 /end COMPU_METHOD
/begin COMPU_METHOD _CNV_A_R_EGTR_LINEA_834_CM "" RAT_FUNC "%6.3" "g" COEFFS 0 801391.5978306726 0. 0 0 1 /end COMPU_METHOD
/begin COMPU_METHOD _CNV_A_R_EGTR_LINEA_835_CM "" RAT_FUNC "%6.3" "g/ms" COEFFS 0 32055652.15349685 0. 0 0 1 /end COMPU_METHOD
/begin COMPU_METHOD _CNV_S_5_EGTR_RANGE_836_CM "" TAB_VERB "%6.3" "-" COMPU_TAB_REF _CNV_S_5_EGTR_RANGE_836 /end COMPU_METHOD
/begin COMPU_VTAB _CNV_S_5_EGTR_RANGE_836 "" TAB_VERB 5 0 "PASSIVE" 1 "WAIT" 2 "CYC_LEAN" 3 "CYC_RICH" 4 "END" /end COMPU_VTAB
/begin COMPU_METHOD _CNV_S_4_RANGE_STAT_838_CM "" TAB_VERB "%6.3" "-" COMPU_TAB_REF _CNV_S_4_RANGE_STAT_838 /end COMPU_METHOD
/begin COMPU_VTAB _CNV_S_4_RANGE_STAT_838 "" TAB_VERB 4 0 "PASSIVE" 1 "RICH_CDN" 2 "LEAN_CDN" 3 "WAIT" /end COMPU_VTAB
/begin RECORD_LAYOUT _REC_VAL_20_u1 FNC_VALUES 1 UBYTE COLUMN_DIR DIRECT /end RECORD_LAYOUT
/begin RECORD_LAYOUT _REC_VAL_20_u2 FNC_VALUES 1 UWORD COLUMN_DIR DIRECT /end RECORD_LAYOUT
/begin RECORD_LAYOUT _REC_AXS_20_u1 NO_AXIS_PTS_X 1 UBYTE AXIS_PTS_X 2 UBYTE INDEX_INCR DIRECT /end RECORD_LAYOUT
/begin RECORD_LAYOUT _REC_MAP_20_u2_u1_u1 FNC_VALUES 1 UWORD COLUMN_DIR DIRECT /end RECORD_LAYOUT
/begin RECORD_LAYOUT _REC_CUR_20_u1_u1 FNC_VALUES 1 UBYTE COLUMN_DIR DIRECT /end RECORD_LAYOUT
/begin RECORD_LAYOUT _REC_VAL_20_s2 FNC_VALUES 1 SWORD COLUMN_DIR DIRECT /end RECORD_LAYOUT
/begin RECORD_LAYOUT _REC_MAP_20_u2_u2_u1 FNC_VALUES 1 UWORD COLUMN_DIR DIRECT /end RECORD_LAYOUT
/begin RECORD_LAYOUT _REC_AXS_20_u2 NO_AXIS_PTS_X 1 UWORD AXIS_PTS_X 2 UWORD INDEX_INCR DIRECT /end RECORD_LAYOUT
/begin RECORD_LAYOUT _REC_CUR_20_u2_u1 FNC_VALUES 1 UWORD COLUMN_DIR DIRECT /end RECORD_LAYOUT
/begin RECORD_LAYOUT _REC_CUR_20_u2_u2 FNC_VALUES 1 UWORD COLUMN_DIR DIRECT /end RECORD_LAYOUT
/begin RECORD_LAYOUT _REC_CUR_20_u1_u2 FNC_VALUES 1 UBYTE COLUMN_DIR DIRECT /end RECORD_LAYOUT
/begin RECORD_LAYOUT _REC_MAP_20_u2_u2_u2 FNC_VALUES 1 UWORD COLUMN_DIR DIRECT /end RECORD_LAYOUT
/begin RECORD_LAYOUT _REC_MAP_20_u1_u2_u2 FNC_VALUES 1 UBYTE COLUMN_DIR DIRECT /end RECORD_LAYOUT
/begin RECORD_LAYOUT _REC_MAP_20_u1_u1_u1 FNC_VALUES 1 UBYTE COLUMN_DIR DIRECT /end RECORD_LAYOUT
/begin RECORD_LAYOUT _REC_MAP_20_u1_u2_u1 FNC_VALUES 1 UBYTE COLUMN_DIR DIRECT /end RECORD_LAYOUT
/begin RECORD_LAYOUT _REC_MAP_20_u1_u1_u2 FNC_VALUES 1 UBYTE COLUMN_DIR DIRECT /end RECORD_LAYOUT
/begin FUNCTION ACRC_power_stage_diagnosis "" /begin DEF_CHARACTERISTIC c_abc_inc_acr_dr c_abc_max_acr_dr /end DEF_CHARACTERISTIC /begin OUT_MEASUREMENT lv_err_acr_dr /end OUT_MEASUREMENT /end FUNCTION
/begin FUNCTION ACRC_power_stage_diagnosis_AI "" /begin DEF_CHARACTERISTIC c_vb_min_acr_dr_diag /end DEF_CHARACTERISTIC /begin OUT_MEASUREMENT lv_inh_diag_acr_dr /end OUT_MEASUREMENT /end FUNCTION
/begin FUNCTION C_3_ACRC "" /begin SUB_FUNCTION ACRC_AGGR_adaptation_EGRC /end SUB_FUNCTION /end FUNCTION
/begin FUNCTION ACRC_AGGR_adaptation_EGRC "" /begin OUT_MEASUREMENT av_open_egr lv_err_egr_2 stk_av_egr lv_er_fdout lv_egr_act /end OUT_MEASUREMENT /end FUNCTION
/begin FUNCTION C_R_ACRC "" /begin SUB_FUNCTION ACRC_customer_adap_module_EGRC /end SUB_FUNCTION /end FUNCTION
/begin FUNCTION ACRC_customer_adap_module_EGRC "" /begin OUT_MEASUREMENT opg_sp_req_acr egr_ratio_sp /end OUT_MEASUREMENT /end FUNCTION
/begin FUNCTION SEC_Constants_for_EOBD_Service_1 ""
 /begin DEF_CHARACTERISTIC c_service_1_pid_1_diag c_service_1_pid_2_diag c_service_1_pid_3_diag c_service_1_pid_4_diag c_service_1_pid_5_diag c_service_1_pid_6_diag c_service_1_pid_7_diag c_service_1_pid_8_diag c_service_1_pid_9_diag c_service_1_pid_A_diag c_service_1_pid_B_diag c_service_1_pid_C_diag c_obd_req c_psn_ls c_psn_ls_1 lc_var_sap /end DEF_CHARACTERISTIC
 /begin OUT_MEASUREMENT service_1_pid_1_diag service_1_pid_2_diag service_1_pid_3_diag service_1_pid_4_diag /end OUT_MEASUREMENT
/end FUNCTION
/begin FUNCTION SEC_Constants_for_EOBD_Service_2 ""
 /begin DEF_CHARACTERISTIC c_service_2_pid_1_diag c_service_2_pid_2_diag c_service_2_pid_3_diag c_service_2_pid_4_diag c_service_2_pid_5_diag c_service_2_pid_6_diag c_service_2_pid_7_diag c_service_2_pid_8_diag c_service_2_pid_9_diag c_service_2_pid_A_diag c_service_2_pid_B_diag c_service_2_pid_C_diag /end DEF_CHARACTERISTIC
 /begin OUT_MEASUREMENT service_2_pid_1_diag service_2_pid_2_diag service_2_pid_3_diag service_2_pid_4_diag /end OUT_MEASUREMENT
/end FUNCTION
/begin FUNCTION SEC_Constants_for_EOBD_Service_6_CAN ""
 /begin DEF_CHARACTERISTIC c_service_6_obdmid_10_diag c_service_6_obdmid_11_diag c_service_6_obdmid_12_diag c_service_6_obdmid_13_diag c_service_6_obdmid_14_diag c_service_6_obdmid_15_diag c_service_6_obdmid_16_diag c_service_6_obdmid_17_diag c_service_6_obdmid_18_diag c_service_6_obdmid_19_diag c_service_6_obdmid_1_diag c_service_6_obdmid_20_diag c_service_6_obdmid_21_diag c_service_6_obdmid_22_diag c_service_6_obdmid_23_diag c_service_6_obdmid_24_diag c_service_6_obdmid_25_diag c_service_6_obdmid_26_diag c_service_6_obdmid_27_diag c_service_6_obdmid_28_diag c_service_6_obdmid_2_diag c_service_6_obdmid_3_diag c_service_6_obdmid_4_diag c_service_6_obdmid_5_diag c_service_6_obdmid_6_diag c_service_6_obdmid_7_diag c_service_6_obdmid_8_diag c_service_6_obdmid_9_diag /end DEF_CHARACTERISTIC
 /begin OUT_MEASUREMENT service_6_obdmid_1_diag service_6_obdmid_2_diag service_6_obdmid_3_diag service_6_obdmid_4_diag service_6_obdmid_5_diag service_6_obdmid_6_diag service_6_obdmid_7_diag service_6_obdmid_8_diag service_6_obdmid_9_diag service_6_obdmid_10_diag service_6_obdmid_11_diag service_6_obdmid_12_diag service_6_obdmid_13_diag service_6_obdmid_14_diag service_6_obdmid_15_diag service_6_obdmid_16_diag service_6_obdmid_17_diag service_6_obdmid_18_diag service_6_obdmid_19_diag service_6_obdmid_20_diag service_6_obdmid_21_diag service_6_obdmid_22_diag service_6_obdmid_23_diag service_6_obdmid_24_diag service_6_obdmid_25_diag service_6_obdmid_26_diag service_6_obdmid_27_diag service_6_obdmid_28_diag /end OUT_MEASUREMENT
/end FUNCTION
/begin FUNCTION SEC_Constants_for_EOBD_Service_8_CAN ""
 /begin DEF_CHARACTERISTIC c_service_8_tid_1_diag_c c_service_8_tid_2_diag_c c_service_8_tid_3_diag_c c_service_8_tid_4_diag_c /end DEF_CHARACTERISTIC
 /begin OUT_MEASUREMENT service_8_tid_1_diag_c service_8_tid_2_diag_c service_8_tid_3_diag_c service_8_tid_4_diag_c /end OUT_MEASUREMENT
/end FUNCTION
/begin FUNCTION SEC_Constants_for_EOBD_Service_9_CAN ""
 /begin DEF_CHARACTERISTIC c_service_9_infotype_1_diag_c c_service_9_infotype_2_diag_c c_service_9_infotype_3_diag_c c_service_9_infotype_4_diag_c /end DEF_CHARACTERISTIC
 /begin OUT_MEASUREMENT service_9_infotype_1_diag_c service_9_infotype_2_diag_c service_9_infotype_3_diag_c service_9_infotype_4_diag_c /end OUT_MEASUREMENT
/end FUNCTION
/begin FUNCTION C_6_IGRE "C_6_IGRE" /begin DEF_CHARACTERISTIC ldpm_n_32_1_igre ldpm_vb_1_igre ldpm_tco_td_fac /end DEF_CHARACTERISTIC
 /begin SUB_FUNCTION IGRE_Dwell_time_control IGRE_Ignition_activation_control IGRE_Ignition_multiple_spark IGRE_Dwell_time_period_strat_mod IGRE_TD_and_IGA_switches IGRE_Dwell_time_factor_calc /end SUB_FUNCTION
/end FUNCTION
/begin FUNCTION IGRE_Dwell_time_control "Dwell_time_control" /begin DEF_CHARACTERISTIC c_td_as ip_td c_td_ini /end DEF_CHARACTERISTIC /begin OUT_MEASUREMENT td /end OUT_MEASUREMENT /end FUNCTION
/begin FUNCTION IGRE_Ignition_activation_control "Ignition_activation_control" /begin DEF_CHARACTERISTIC lc_td_mpl_spc_ign_act c_n_max_mpl_spc_ign_act /end DEF_CHARACTERISTIC /begin OUT_MEASUREMENT inh_igc lv_td_mpl_spc_ign_act /end OUT_MEASUREMENT /end FUNCTION
/begin FUNCTION IGRE_Ignition_multiple_spark "Ignition_multiple_spark"
 /begin DEF_CHARACTERISTIC c_tco_max_mpl_st c_tco_max_mpl_is c_tco_max_mpl_pl_pu_fl c_tco_max_mpl_puc c_vb_max_mpl_is c_vb_max_mpl_pl_pu_fl c_vb_max_mpl_st c_n_min_mpl_st c_n_max_mpl_st c_n_max_mpl_is c_n_min_mpl_is c_n_min_mpl_pl_pu_fl c_n_max_mpl_pl_pu_fl c_n_max_mpl_puc c_n_min_mpl_puc c_td_mpl_man c_vb_max_mpl_puc ldp_tco_ip_nr_mpl ip_td_mpl_s ip_nr_mpl ip_nr_mpl_s c_td_t_mpl c_t_ctr_td_mpl_ast c_t_ctr_td_mpl ip_td_mpl ip_td_t_mpl_1 ip_td_mpl_1 ip_td_mpl_1_s ip_td_t_mpl_1_s /end DEF_CHARACTERISTIC
 /begin OUT_MEASUREMENT td_mpl_dly ign_mpl_nr t_ctr_td_mpl td_mpl td_mpl_1 td_mpl_1_dly /end OUT_MEASUREMENT
/end FUNCTION
/begin FUNCTION IGRE_Dwell_time_period_strat_mod "Dwell_time_period_strat_mod" /begin DEF_CHARACTERISTIC c_td_s_as ip_td_s c_td_s_ini /end DEF_CHARACTERISTIC /begin OUT_MEASUREMENT td_s /end OUT_MEASUREMENT /end FUNCTION
/begin FUNCTION IGRE_TD_and_IGA_switches "TD_and_IGA_switches"
 /begin OUT_MEASUREMENT td_igc[0] td_igc[1] td_igc[2] td_igc[3] td_igc[4] td_igc[5] iga_igc_h_rng[0] iga_igc_h_rng[1] iga_igc_h_rng[2] iga_igc_h_rng[3] iga_igc_h_rng[4] iga_igc_h_rng[5] /end OUT_MEASUREMENT
/end FUNCTION
/begin FUNCTION IGRE_Dwell_time_factor_calc "Dwell_time_factor_calc" /begin DEF_CHARACTERISTIC ip_td_st_fac ip_td_fac_tco /end DEF_CHARACTERISTIC /begin OUT_MEASUREMENT td_fac td_st_fac td_fac_tco /end OUT_MEASUREMENT /end FUNCTION
/begin FUNCTION C_2_IGRE "C_2_IGRE"
 /begin SUB_FUNCTION IGRE_Ignition_output_diagnosis IGRE_Spark_Adv_and_Dwell_Output IGRE_Dwell_time_ad_appl_inci IGRE_Dwell_time_adaptation /end SUB_FUNCTION
/end FUNCTION
/begin FUNCTION IGRE_Ignition_output_diagnosis "Ignition_output_diagnosis"
 /begin DEF_CHARACTERISTIC id_v_dur_igc_min ldp_n_32_id_v_dur_igc_min ldp_maf_id_v_dur_igc_min /end DEF_CHARACTERISTIC
 /begin OUT_MEASUREMENT lv_scp_igc[0] lv_scp_igc[1] lv_scp_igc[2] lv_scp_igc[3] lv_scp_igc[4] lv_scp_igc[5] lv_ol_igc[0] lv_ol_igc[1] lv_ol_igc[2] lv_ol_igc[3] lv_ol_igc[4] lv_ol_igc[5] lv_scg_igc[0] lv_scg_igc[1] lv_scg_igc[2] lv_scg_igc[3] lv_scg_igc[4] lv_scg_igc[5] v_dur_igc[0] v_dur_igc[1] v_dur_igc[2] v_dur_igc[3] v_dur_igc[4] v_dur_igc[5] /end OUT_MEASUREMENT
/end FUNCTION
/begin FUNCTION IGRE_Spark_Adv_and_Dwell_Output "Spark_Advance_and_Dwell_Output"
 /begin DEF_CHARACTERISTIC c_td_fac_st_min c_td_fac_st_max c_td_vb_max ip_td_fac_max ip_td_fac_min lc_igc_lih_conf /end DEF_CHARACTERISTIC
 /begin OUT_MEASUREMENT td_fac_max td_fac_min /end OUT_MEASUREMENT
/end FUNCTION
/begin FUNCTION IGRE_Dwell_time_ad_appl_inci "" /end FUNCTION
/begin FUNCTION IGRE_Dwell_time_adaptation "" /end FUNCTION
/begin FUNCTION C_A_IGRE "C_A_IGRE" /begin SUB_FUNCTION IGRE_Ignition_diagnosis IGRE_Appli_inci_ignition_diag /end SUB_FUNCTION /end FUNCTION
/begin FUNCTION IGRE_Ignition_diagnosis "Ignition_diagnosis"
 /begin DEF_CHARACTERISTIC c_abc_igc_scp c_iga_off_cycnr_hld c_sum_igc_scp c_esb_ign_cut_diag c_abc_inc_igc_ol c_abc_max_igc_scp c_abc_max_igc_scg c_abc_max_igc_ol c_n_32_min_scp_igc_diag c_n_32_min_ol_scg_igc_diag c_tco_min_igc_diag c_abc_inc_igc_scp c_abc_inc_igc_scg /end DEF_CHARACTERISTIC
 /begin OUT_MEASUREMENT igc_diag_mis lv_err_igc_scp_0 lv_err_igc_scp_1 lv_err_igc_scp_2 lv_err_igc_scp_3 lv_err_igc_scp_4 lv_err_igc_scp_5 lv_err_igc_scg_0 lv_err_igc_scg_1 lv_err_igc_scg_2 lv_err_igc_scg_3 lv_err_igc_scg_4 lv_err_igc_scg_5 lv_err_igc_ol_0 lv_err_igc_ol_1 lv_err_igc_ol_2 lv_err_igc_ol_3 lv_err_igc_ol_4 lv_err_igc_ol_5 lv_err_igc lv_inh_igc[0] lv_inh_igc[1] lv_inh_igc[2] lv_inh_igc[3] lv_inh_igc[4] lv_inh_igc[5] /end OUT_MEASUREMENT
/end FUNCTION
/begin FUNCTION IGRE_Appli_inci_ignition_diag "Appli_inci_ignition_diag" /end FUNCTION
/begin FUNCTION C_7_EGTR "C_7_EGTR"
 /begin DEF_CHARACTERISTIC ldpm_maf_hb_1_egtr ldpm_eff_cat_diag_1_egtr ldpm_n_32_1_egtr /end DEF_CHARACTERISTIC
 /begin SUB_FUNCTION EGTR_Activ_forced_lambda_stim EGTR_Coord_forced_lambda_stim EGTR_Forced_lambda_stim_linear EGTR_Det_forced_lambda_stim EGTR_Coord_catalyst_enrichment EGTR_Appl_inci_forced_lambda EGTR_Catalyst_enrichment EGTR_O2L_det_cat_enrichment EGTR_Appl_inci_cat_enrichment /end SUB_FUNCTION
/end FUNCTION
/begin FUNCTION EGTR_Activ_forced_lambda_stim "_Activ_forced_lambda_stim"
 /begin DEF_CHARACTERISTIC c_lamb_sp_de_thd_lamb_pls_off c_lamb_sp_de_thd_lamb_pls_on c_lamb_sp_max_lamb_pls_act c_lamb_sp_min_lamb_pls_act c_maf_int_min_lamb_pls_act c_temp_cat_min_lamb_pls_act /end DEF_CHARACTERISTIC
 /begin OUT_MEASUREMENT egtr[0].egtr_struct_defspfstia0.maf_int_lamb_pls_act egtr[0].egtr_struct_defspfstia0.lv_lamb_pls_act egtr[0].egtr_struct_defspfstia0.lv_lamb_pls_diag_lsh_up egtr[0].egtr_struct_defspfstia0.lv_lamb_pls_act_cat_purge egtr[1].egtr_struct_defspfstia0.maf_int_lamb_pls_act egtr[1].egtr_struct_defspfstia0.lv_lamb_pls_act egtr[1].egtr_struct_defspfstia0.lv_lamb_pls_diag_lsh_up egtr[1].egtr_struct_defspfstia0.lv_lamb_pls_act_cat_purge /end OUT_MEASUREMENT
/end FUNCTION
/begin FUNCTION EGTR_Coord_forced_lambda_stim "_Coord_forced_lambda_stim"
 /begin DEF_CHARACTERISTIC c_fac_dif_thd_afl_pls_on c_fac_dif_thd_afl_pls_off c_fac_dif_thd_afr_pls_off c_fac_dif_thd_afr_pls_on lc_lamb_pls_cor_act_is /end DEF_CHARACTERISTIC
 /begin OUT_MEASUREMENT egtr[0].egtr_struct_defspfstic0.lamb_pls egtr[0].egtr_struct_defspfstic0.lv_lamb_pls_afl_cor_act egtr[0].egtr_struct_defspfstic0.lv_lamb_pls_afr_cor_act egtr[1].egtr_struct_defspfstic0.lamb_pls egtr[1].egtr_struct_defspfstic0.lv_lamb_pls_afl_cor_act egtr[1].egtr_struct_defspfstic0.lv_lamb_pls_afr_cor_act /end OUT_MEASUREMENT
/end FUNCTION
/begin FUNCTION EGTR_Forced_lambda_stim_linear "_Forced_lambda_stim_linear"
 /begin OUT_MEASUREMENT lv_lamb_pls_syn_cbk egtr[0].egtr_struct_defspfsti0.o2l_add_lamb_pls egtr[0].egtr_struct_defspfsti0.o2l_lamb_pls egtr[0].egtr_struct_defspfsti0.o2l_sp_new_lamb_pls egtr[0].egtr_struct_defspfsti0.lamb_pls_o2l_osc egtr[0].egtr_struct_defspfsti0.fac_o2l_lamb_pls egtr[0].egtr_struct_defspfsti0.o2l_sp_half_lamb_pls egtr[0].egtr_struct_defspfsti0.state_lamb_pls egtr[0].egtr_struct_defspfsti0.lv_lamb_pls_o2l_osc_pos egtr[0].egtr_struct_defspfsti0.lv_lamb_pls_mst_cbk egtr[1].egtr_struct_defspfsti0.o2l_add_lamb_pls egtr[1].egtr_struct_defspfsti0.o2l_lamb_pls egtr[1].egtr_struct_defspfsti0.o2l_sp_new_lamb_pls egtr[1].egtr_struct_defspfsti0.lamb_pls_o2l_osc egtr[1].egtr_struct_defspfsti0.fac_o2l_lamb_pls egtr[1].egtr_struct_defspfsti0.o2l_sp_half_lamb_pls egtr[1].egtr_struct_defspfsti0.state_lamb_pls egtr[1].egtr_struct_defspfsti0.lv_lamb_pls_o2l_osc_pos egtr[1].egtr_struct_defspfsti0.lv_lamb_pls_mst_cbk /end OUT_MEASUREMENT
/end FUNCTION
/begin FUNCTION EGTR_Det_forced_lambda_stim "_Det_forced_lambda_stim"
 /begin DEF_CHARACTERISTIC c_lamb_delta_max_is_pls c_lamb_delta_max_lsh_diag_pls c_lamb_sp_de_dyn_diag_pls c_lamb_sp_de_is_pls c_lamb_sp_de_lsh_diag_pls c_nr_step_pls_nom_cat_diag c_o2l_sp_is_pls c_o2l_sp_lsh_diag_pls ldp_eff_cat_diag_ip_fac_1_pls ldp_t_ast_ip_fac_2_pls ip_fac_2_lamb_sp_de_pls ldp_temp_cat_ip_fac_2_pls ip_fac_1_lamb_sp_de_pls ip_lamb_delta_max_cat_diag_pls ip_lamb_delta_max_nom_pls ip_lamb_sp_de_cat_diag_pls ip_lamb_sp_de_nom_pls ip_o2l_sp_cat_diag_pls ip_o2l_sp_dyn_diag_pls ip_o2l_sp_nom_pls /end DEF_CHARACTERISTIC
 /begin OUT_MEASUREMENT state_lamb_pls_det_value lamb_sp_de_pls lamb_delta_max_pls ctr_step_pls_nom_cat_diag o2l_sp_pls /end OUT_MEASUREMENT
/end FUNCTION
/begin FUNCTION EGTR_Coord_catalyst_enrichment "_Coord_catalyst_enrichment"
 /begin OUT_MEASUREMENT egtr[0].egtr_struct_defspcenrc0.lamb_sp_delta_cat_purge egtr[1].egtr_struct_defspcenrc0.lamb_sp_delta_cat_purge /end OUT_MEASUREMENT
/end FUNCTION
/begin FUNCTION EGTR_Appl_inci_forced_lambda "_Appl_inci_forced_lambda"
 /begin DEF_CHARACTERISTIC lc_lamb_sti_off_lsl_ofs_adj lc_lamb_pls_inh[0] lc_lamb_pls_inh[1] /end DEF_CHARACTERISTIC
 /begin OUT_MEASUREMENT egtr[0].egtr_struct_defspfstii0.lv_inh_lamb_pls egtr[1].egtr_struct_defspfstii0.lv_inh_lamb_pls /end OUT_MEASUREMENT
/end FUNCTION
/begin FUNCTION EGTR_Catalyst_enrichment "_Catalyst_enrichment"
 /begin DEF_CHARACTERISTIC c_vls_down_thd_cat_purge ldp_temp_main_cat_purge_ip_fac ldp_maf_cyl_ip_lamb_sp ldp_ratio_o2l_rls_ip_lamb_sp ip_fac_main_cat_purge ip_lamb_sp_delta_cat_purge /end DEF_CHARACTERISTIC
 /begin OUT_MEASUREMENT egtr[0].egtr_struct_defspcenr0.o2l_rls_pcat_purge egtr[0].egtr_struct_defspcenr0.o2l_rls_tot_cat_purge egtr[0].egtr_struct_defspcenr0.o2l_rls_rest_cat_purge egtr[0].egtr_struct_defspcenr0.o2l_rls_add_cat_purge egtr[0].egtr_struct_defspcenr0.o2l_rls_main_cat_purge egtr[0].egtr_struct_defspcenr0.lamb_sp_delta_it_cat_purge egtr[0].egtr_struct_defspcenr0.fac_o2l_rls_cat_purge egtr[0].egtr_struct_defspcenr0.ratio_o2l_rls_cat_purge egtr[0].egtr_struct_defspcenr0.lv_cat_purge_act egtr[0].egtr_struct_defspcenr0.lv_vls_down_act_cat_purge egtr[0].egtr_struct_defspcenr0.lv_cat_purge_main_cat egtr[0].egtr_struct_defspcenr0.lv_cat_purge_pcat egtr[1].egtr_struct_defspcenr0.o2l_rls_pcat_purge egtr[1].egtr_struct_defspcenr0.o2l_rls_tot_cat_purge egtr[1].egtr_struct_defspcenr0.o2l_rls_rest_cat_purge egtr[1].egtr_struct_defspcenr0.o2l_rls_add_cat_purge egtr[1].egtr_struct_defspcenr0.o2l_rls_main_cat_purge egtr[1].egtr_struct_defspcenr0.lamb_sp_delta_it_cat_purge egtr[1].egtr_struct_defspcenr0.fac_o2l_rls_cat_purge egtr[1].egtr_struct_defspcenr0.ratio_o2l_rls_cat_purge egtr[1].egtr_struct_defspcenr0.lv_cat_purge_act egtr[1].egtr_struct_defspcenr0.lv_vls_down_act_cat_purge egtr[1].egtr_struct_defspcenr0.lv_cat_purge_main_cat egtr[1].egtr_struct_defspcenr0.lv_cat_purge_pcat /end OUT_MEASUREMENT
/end FUNCTION
/begin FUNCTION EGTR_O2L_det_cat_enrichment "_O2L_det_cat_enrichment"
 /begin DEF_CHARACTERISTIC c_fac_add_main_cat_purge_ch c_fac_add_main_cat_purge_hst c_fac_add_main_cat_purge_sa c_maf_int_puc_act_min_cat_purge c_o2l_rls_max_pcat_purge c_o2l_rls_sp_pcat_purge_ch c_o2l_rls_sp_pcat_purge_hst c_o2l_rls_sp_pcat_purge_sa c_tco_thd_cat_purge_hst ldp_maf_int_puc_act_ip_o2l_rls ldp_temp_cat_ip_fac_pcat_purge ip_o2l_rls_sp_pcat_purge_puc ip_fac_o2l_rls_sp_pcat_purge c_fac_add_main_cat_purge_gs_scc c_maf_int_gs_scc_min_cat_purge /end DEF_CHARACTERISTIC
 /begin OUT_MEASUREMENT egtr[0].egtr_struct_defspcenrd0.o2l_rls_sp_pcat_purge egtr[0].egtr_struct_defspcenrd0.fac_add_main_cat_purge egtr[0].egtr_struct_defspcenrd0.state_cat_purge egtr[0].egtr_struct_defspcenrd0.lv_cat_purge_post_puc_trig egtr[0].egtr_struct_defspcenrd0.lv_cat_purge_st egtr[1].egtr_struct_defspcenrd0.o2l_rls_sp_pcat_purge egtr[1].egtr_struct_defspcenrd0.fac_add_main_cat_purge egtr[1].egtr_struct_defspcenrd0.state_cat_purge egtr[1].egtr_struct_defspcenrd0.lv_cat_purge_post_puc_trig egtr[1].egtr_struct_defspcenrd0.lv_cat_purge_st /end OUT_MEASUREMENT
/end FUNCTION
/begin FUNCTION EGTR_Appl_inci_cat_enrichment "_Appl_inci_cat_enrichment"
 /begin DEF_CHARACTERISTIC c_maf_cyl_max_cat_purge c_n_max_cat_purge c_tco_min_cat_purge c_temp_dif_pcat_main_cat_purge[0] c_temp_dif_pcat_main_cat_purge[1] lc_cat_purge_inh[0] lc_cat_purge_inh[1] lc_ns_2_deac ldp_maf_cyl_ip_lamb_add_purge ldp_vls_nox_sens_ip_lamb_add ip_lamb_add_purge /end DEF_CHARACTERISTIC
 /begin OUT_MEASUREMENT lv_gs_scc maf_int_puc_act maf_int_puc_not_act maf_int_gs_scc egtr[0].egtr_struct_defspcenri0.temp_main_cat_purge egtr[0].egtr_struct_defspcenri0.lamb_sp_delta_add_cat_purge egtr[0].egtr_struct_defspcenri0.lv_inh_cat_purge egtr[1].egtr_struct_defspcenri0.temp_main_cat_purge egtr[1].egtr_struct_defspcenri0.lamb_sp_delta_add_cat_purge egtr[1].egtr_struct_defspcenri0.lv_inh_cat_purge /end OUT_MEASUREMENT
/end FUNCTION
/begin FUNCTION C_B_EGTR "C_B_EGTR : Diagnosis part for EGTR aggregate" /begin DEF_CHARACTERISTIC ldpm_n_32_3_egtr /end DEF_CHARACTERISTIC
 /begin SUB_FUNCTION EGTR_Lim_dyn_for_cat_eff_diag EGTR_Cat_eff_diag_err_intf_2bank EGTR_Act_cond_cat_eff_diag_bin EGTR_Cat_eff_diag_bin_lamb_ctl EGTR_App_inc_cat_eff_diag EGTR_OSC_Calculation EGTR_Diag_value_determination EGTR_Diag_value_determination_AI EGTR_Activation_conditions /end SUB_FUNCTION
/end FUNCTION
/begin FUNCTION EGTR_Lim_dyn_for_cat_eff_diag "_Limited_dynamics_for_catalyst_efficiency_diagnosis"
 /begin DEF_CHARACTERISTIC c_crlc_maf_cat_ldc c_crlc_n_cat_ldc c_fac_lam_mv_dyw_cat c_load_grd_dec c_load_grd_min_sum_cat c_load_grd_sum_max c_load_grd_sum_min c_maf_dyw_cat_ldc c_maf_int_min_cat_ldc c_n_dyw_cat_ldc c_t_load_grd_dec_sum lc_fac_lam_rst_cat_ldc lc_maf_rst_cat_ldc lc_n_rst_cat_ldc /end DEF_CHARACTERISTIC
 /begin OUT_MEASUREMENT maf_mmv_cat_ldc n_mmv_cat_ldc load_grd_sum_cat_ldc load_grd_cat_ldc lv_load_grd_cat_ldc lv_maf_cat_ldc lv_n_cat_ldc egtr[0].egtr_struct_fctdgcefld0.fac_lam_mv_delta_cat_ldc egtr[0].egtr_struct_fctdgcefld0.maf_int_cat_ldc egtr[0].egtr_struct_fctdgcefld0.lv_cat_ldc egtr[0].egtr_struct_fctdgcefld0.lv_fac_lam_cat_ldc egtr[1].egtr_struct_fctdgcefld0.fac_lam_mv_delta_cat_ldc egtr[1].egtr_struct_fctdgcefld0.maf_int_cat_ldc egtr[1].egtr_struct_fctdgcefld0.lv_cat_ldc egtr[1].egtr_struct_fctdgcefld0.lv_fac_lam_cat_ldc /end OUT_MEASUREMENT
/end FUNCTION
/begin FUNCTION EGTR_Cat_eff_diag_err_intf_2bank "_Cat_eff_diag_err_interface_for_2_bank_system"
 /begin DEF_CHARACTERISTIC c_eff_cat_max_50_diag c_eff_cat_max_diag c_eff_cat_max_diag_eol c_eff_cat_max_sum_diag lc_cat_diag_dis lc_cat_diag_resu ldp_eff_cat_diag_1_ip_eff_cat ldp_eff_cat_diag_2_ip_eff_cat ip_eff_cat_diag_sum /end DEF_CHARACTERISTIC
 /begin OUT_MEASUREMENT eff_cat_diag_sum lv_diag_end_cbk_cat_diag egtr[0].egtr_struct_fctdgcefif0.eff_cat_diag_obd egtr[0].egtr_struct_fctdgcefif0.eff_cat_max_diag_obd egtr[0].egtr_struct_fctdgcefif0.lv_cdn_diag_cat_diag egtr[0].egtr_struct_fctdgcefif0.lv_end_diag_cat_diag egtr[0].egtr_struct_fctdgcefif0.lv_err_cat_diag egtr[1].egtr_struct_fctdgcefif0.eff_cat_diag_obd egtr[1].egtr_struct_fctdgcefif0.eff_cat_max_diag_obd egtr[1].egtr_struct_fctdgcefif0.lv_cdn_diag_cat_diag egtr[1].egtr_struct_fctdgcefif0.lv_end_diag_cat_diag egtr[1].egtr_struct_fctdgcefif0.lv_err_cat_diag /end OUT_MEASUREMENT
/end FUNCTION
/begin FUNCTION EGTR_Act_cond_cat_eff_diag_bin "_Act_cond_for_cat_eff_diag_binary_lambda_ctl"
 /begin DEF_CHARACTERISTIC c_amp_min_cat c_cl_max_cat c_maf_hys_cat c_maf_int_dly_cat_diag c_maf_int_sw_cat_diag c_tco_min_cat c_temp_hys_cat c_temp_max_cat c_temp_min_cat c_temp_min_cat_eol c_vs_max_cat c_vs_min_cat lc_cat_diag_cdn_act_man ip_maf_max_cat ip_maf_min_cat /end DEF_CHARACTERISTIC
 /begin OUT_MEASUREMENT egtr[0].egtr_struct_fctdgcefac0.maf_int_dly_cat_diag egtr[0].egtr_struct_fctdgcefac0.lv_cat_diag_cdn_act egtr[1].egtr_struct_fctdgcefac0.maf_int_dly_cat_diag egtr[1].egtr_struct_fctdgcefac0.lv_cat_diag_cdn_act /end OUT_MEASUREMENT
/end FUNCTION
/begin FUNCTION EGTR_Cat_eff_diag_bin_lamb_ctl ""
 /begin DEF_CHARACTERISTIC c_ctr_min_cat_diag c_ctr_min_cat_diag_eol c_ctr_lamb_out_cat_diag c_lamb_cat_mv_dif_max c_lamb_cat_mv_max c_lamb_cat_mv_max_eol c_lamb_cat_mv_min c_lamb_cat_mv_delta_max c_n_32_cat_diag_deac ldp_vls_down_ip_lamb_cat ip_fac_mass_o2_cat_diag_at ip_fac_mass_o2_cat_diag_mt ldp_temp_cat_dyn_mdl_ip_fac_cat ldp_temp_cat_dif_ip_fac_cat ip_lamb_cat c_lamb_cat_mv_min_eol ip_fac_temp_cat_dif_stat c_o2l_cat_afl /end DEF_CHARACTERISTIC
 /begin OUT_MEASUREMENT egtr[0].egtr_struct_fctdgcef0.ratio_mass_o2_cat_dif_sum egtr[0].egtr_struct_fctdgcef0.lamb_cat_down_sum egtr[0].egtr_struct_fctdgcef0.ratio_mass_o2_cat_dif egtr[0].egtr_struct_fctdgcef0.mass_o2_cat_dif_cyc egtr[0].egtr_struct_fctdgcef0.lamb_cat_down_mv egtr[0].egtr_struct_fctdgcef0.lamb_cat_down_st_cyc egtr[0].egtr_struct_fctdgcef0.lamb_cat_down egtr[0].egtr_struct_fctdgcef0.flow_o2_cat_dif egtr[0].egtr_struct_fctdgcef0.ctr_cat_diag egtr[0].egtr_struct_fctdgcef0.ctr_lamb_out_cat_diag egtr[0].egtr_struct_fctdgcef0.ctr_tot_cat_diag egtr[0].egtr_struct_fctdgcef0.eff_cat_diag egtr[0].egtr_struct_fctdgcef0.temp_cat_dif_dyn_stat egtr[0].egtr_struct_fctdgcef0.state_cat_diag egtr[0].egtr_struct_fctdgcef0.state_cat_diag_cyc_vld egtr[0].egtr_struct_fctdgcef0.lv_lamb_pls_req_cat_diag egtr[0].egtr_struct_fctdgcef0.lv_lam_adj_cat_diag egtr[1].egtr_struct_fctdgcef0.ratio_mass_o2_cat_dif_sum egtr[1].egtr_struct_fctdgcef0.lamb_cat_down_sum egtr[1].egtr_struct_fctdgcef0.ratio_mass_o2_cat_dif egtr[1].egtr_struct_fctdgcef0.mass_o2_cat_dif_cyc egtr[1].egtr_struct_fctdgcef0.lamb_cat_down_mv egtr[1].egtr_struct_fctdgcef0.lamb_cat_down_st_cyc egtr[1].egtr_struct_fctdgcef0.lamb_cat_down egtr[1].egtr_struct_fctdgcef0.flow_o2_cat_dif egtr[1].egtr_struct_fctdgcef0.ctr_cat_diag egtr[1].egtr_struct_fctdgcef0.ctr_lamb_out_cat_diag egtr[1].egtr_struct_fctdgcef0.ctr_tot_cat_diag egtr[1].egtr_struct_fctdgcef0.eff_cat_diag egtr[1].egtr_struct_fctdgcef0.temp_cat_dif_dyn_stat egtr[1].egtr_struct_fctdgcef0.state_cat_diag egtr[1].egtr_struct_fctdgcef0.state_cat_diag_cyc_vld egtr[1].egtr_struct_fctdgcef0.lv_lamb_pls_req_cat_diag egtr[1].egtr_struct_fctdgcef0.lv_lam_adj_cat_diag /end OUT_MEASUREMENT
/end FUNCTION
/begin FUNCTION EGTR_App_inc_cat_eff_diag "_App_inc_cat_eff_diag"
 /begin DEF_CHARACTERISTIC c_lamb_delta_p_lam_adj_max lc_inh_cat_diag_man_deac[0] lc_inh_cat_diag_man_deac[1] /end DEF_CHARACTERISTIC
 /begin OUT_MEASUREMENT load_cat_ldc egtr[0].egtr_struct_fctdgcefi0.state_rbm_cat egtr[0].egtr_struct_fctdgcefi0.lv_inh_diag_cat_diag egtr[0].egtr_struct_fctdgcefi0.lv_inh_diag_rbm_cat_diag egtr[1].egtr_struct_fctdgcefi0.state_rbm_cat egtr[1].egtr_struct_fctdgcefi0.lv_inh_diag_cat_diag egtr[1].egtr_struct_fctdgcefi0.lv_inh_diag_rbm_cat_diag /end OUT_MEASUREMENT
/end FUNCTION
/begin FUNCTION EGTR_OSC_Calculation ""
 /begin DEF_CHARACTERISTIC c_state_o2l_clc_ena c_t_afl_cdn_out ldp_lamb_ls_up_ip_fac_diag_afl ip_fac_lamb_diag_afl ldp_n_32_ip_fac_diag_afl ldp_maf_cyl_ip_fac_diag_afl ip_fac_opp_diag_afl ldp_temp_stat_ip_fac_diag_afl ldp_temp_dif_ip_fac_diag_afl ip_fac_temp_diag_afl /end DEF_CHARACTERISTIC
 /begin OUT_MEASUREMENT egtr[0].egtr_struct_fctdgtdloc0.action_O2L_data_h_ampl.o2l_pha egtr[0].egtr_struct_fctdgtdloc0.action_O2L_data_h_ampl.o2l_int_pha egtr[0].egtr_struct_fctdgtdloc0.action_O2L_data_h_ampl.lv_o2l_clc egtr[0].egtr_struct_fctdgtdloc0.action_O2L_data_l_ampl.o2l_pha egtr[0].egtr_struct_fctdgtdloc0.action_O2L_data_l_ampl.o2l_int_pha egtr[0].egtr_struct_fctdgtdloc0.action_O2L_data_l_ampl.lv_o2l_clc egtr[0].egtr_struct_fctdgtdloc0.action_O2L_data_park.o2l_pha egtr[0].egtr_struct_fctdgtdloc0.action_O2L_data_park.o2l_int_pha egtr[0].egtr_struct_fctdgtdloc0.action_O2L_data_park.lv_o2l_clc egtr[0].egtr_struct_fctdgtdloc0.action_O2L_data_load.o2l_pha egtr[0].egtr_struct_fctdgtdloc0.action_O2L_data_load.o2l_int_pha egtr[0].egtr_struct_fctdgtdloc0.action_O2L_data_load.lv_o2l_clc egtr[0].egtr_struct_fctdgtdloc0.state_o2l_clc_vld egtr[0].egtr_struct_fctdgtdloc0.t_afl_cdn_out egtr[0].egtr_struct_fctdgtdloc0.state_cat_diag_afl egtr[1].egtr_struct_fctdgtdloc0.action_O2L_data_h_ampl.o2l_pha egtr[1].egtr_struct_fctdgtdloc0.action_O2L_data_h_ampl.o2l_int_pha egtr[1].egtr_struct_fctdgtdloc0.action_O2L_data_h_ampl.lv_o2l_clc egtr[1].egtr_struct_fctdgtdloc0.action_O2L_data_l_ampl.o2l_pha egtr[1].egtr_struct_fctdgtdloc0.action_O2L_data_l_ampl.o2l_int_pha egtr[1].egtr_struct_fctdgtdloc0.action_O2L_data_l_ampl.lv_o2l_clc egtr[1].egtr_struct_fctdgtdloc0.action_O2L_data_park.o2l_pha egtr[1].egtr_struct_fctdgtdloc0.action_O2L_data_park.o2l_int_pha egtr[1].egtr_struct_fctdgtdloc0.action_O2L_data_park.lv_o2l_clc egtr[1].egtr_struct_fctdgtdloc0.action_O2L_data_load.o2l_pha egtr[1].egtr_struct_fctdgtdloc0.action_O2L_data_load.o2l_int_pha egtr[1].egtr_struct_fctdgtdloc0.action_O2L_data_load.lv_o2l_clc egtr[1].egtr_struct_fctdgtdloc0.state_o2l_clc_vld egtr[1].egtr_struct_fctdgtdloc0.t_afl_cdn_out egtr[1].egtr_struct_fctdgtdloc0.state_cat_diag_afl /end OUT_MEASUREMENT
/end FUNCTION
/end MODULE
/end PROJECT
