ASAP2_VERSION 1 41
/begin PROJECT MSD85 "Spray Guided DI-System with Piezo Injectors for 8-Cylinder"
/begin HEADER "_default_HeaderComment" PROJECT_NO _91 /end HEADER
/begin MODULE _default_ModuleName "_default_ModuleLongIdentifier"
/begin MOD_COMMON "_default_ModCommonComment" DEPOSIT ABSOLUTE BYTE_ORDER MSB_LAST ALIGNMENT_BYTE 1 ALIGNMENT_WORD 2 ALIGNMENT_LONG 2 ALIGNMENT_FLOAT32_IEEE 2 ALIGNMENT_FLOAT64_IEEE 4 /end MOD_COMMON
/begin MEASUREMENT iga_min_teg_h_rng "minimum ignition angle" SWORD _CNV_A_R_LINEAR_____188_CM 1 100. -90. 90. DISPLAY_IDENTIFIER IGA_MIN_TEG_H_RNG ECU_ADDRESS 0xd000a7d6 FORMAT "%8.4" /end MEASUREMENT
/begin MEASUREMENT iga_dif_min_teg_h_rng "Difference of minimum ignition angle with reference one - TEG correction included" UWORD _CNV_A_R_LINEAR_____189_CM 1 100. 0. -180. DISPLAY_IDENTIFIER IGA_DIF_MIN_TEG_H_RNG ECU_ADDRESS 0xd000a7d8 FORMAT "%8.4" /end MEASUREMENT
/begin CHARACTERISTIC c_teg_max_iga_hys "Hysterisis on exhaust gas temperature for spark retard control" VALUE 0xa080c30a _REC_VAL_20_u2 2047. _CNV_A_R_LINEAR_____130_CM 0. 2047. DISPLAY_IDENTIFIER C_TEG_MAX_IGA_HYS FORMAT "%7.2" /end CHARACTERISTIC
/begin CHARACTERISTIC c_teg_max_iga "Maximum allowable exhaust gas temperature for spark retard control" VALUE 0xa080c308 _REC_VAL_20_u2 2047. _CNV_A_R_LINEAR_____130_CM 0. 2047. DISPLAY_IDENTIFIER C_TEG_MAX_IGA FORMAT "%7.2" /end CHARACTERISTIC
/begin CHARACTERISTIC ip_iga_dif_min_teg_h_rng__teg "Minimum ignition angle versus exhaust gas temperature" CURVE 0xa080ad14 _REC_CUR_20_u2_u2 -180. _CNV_A_R_LINEAR_____189_CM 0. -180. DISPLAY_IDENTIFIER IP_IGA_DIF_MIN_TEG_H_RNG__TEG FORMAT "%8.4"
 /begin AXIS_DESCR COM_AXIS teg_dyn_hys _CNV_A_R_LINEAR_____130_CM 16 0. 2047. FORMAT "%7.2" AXIS_PTS_REF ldp_teg_dyn_hys /end AXIS_DESCR
/end CHARACTERISTIC
/begin MEASUREMENT teg_dyn_hys "Temperature of exhaust gas with hysterisis for IGA_MIN limitation" UWORD _CNV_A_R_LINEAR_____130_CM 1 100. 0. 2047. DISPLAY_IDENTIFIER TEG_DYN_HYS ECU_ADDRESS 0xd0000dc4 FORMAT "%7.2" /end MEASUREMENT
/begin MEASUREMENT teg_cat_up_mdl_max "Maximal temperature of exhaust gas between all cylinder bank" UWORD _CNV_A_R_LINEAR_____130_CM 1 100. 0. 2047. DISPLAY_IDENTIFIER TEG_CAT_UP_MDL_MAX ECU_ADDRESS 0xd000a7d4 FORMAT "%7.2" /end MEASUREMENT
/begin AXIS_PTS ldp_teg_dyn_hys "" 0xa0808e28 teg_dyn_hys _REC_AXS_20_u2 2047. _CNV_A_R_LINEAR_____130_CM 16 0. 2047. FORMAT "%7.2" /end AXIS_PTS
/begin CHARACTERISTIC ip_maf_min_knk__n__tco "Air-mass Threshold Release KNK" MAP 0xa080aea8 _REC_MAP_20_u1_u1_u1 1389. _CNV_A_R_LINEAR_____15_CM 0. 1389. DISPLAY_IDENTIFIER IP_MAF_MIN_KNK__N__TCO FORMAT "%4.0"
 /begin AXIS_DESCR COM_AXIS n_32 _CNV_A_R_LINEAR_____10_CM 8 0. 8160. FORMAT "%4.0" AXIS_PTS_REF ldpm_n_3_9 /end AXIS_DESCR
 /begin AXIS_DESCR COM_AXIS tco _CNV_A_R_LINEAR_____17_CM 4 -48. 142.5 FORMAT "%3.0" AXIS_PTS_REF ldp_tco__maf_min_knk /end AXIS_DESCR
/end CHARACTERISTIC
/begin CHARACTERISTIC id_iga_dec_knk_1__n "Spark retard at recognised knocking, Intensity 1" CURVE 0xa08099dc _REC_CUR_20_u1_u1 47.25 _CNV_A_R_LINEAR_____196_CM 0.375 47.625 DISPLAY_IDENTIFIER ID_IGA_DEC_KNK_1__N FORMAT "%4.1"
 /begin AXIS_DESCR COM_AXIS n_knk _CNV_A_R_LINEAR_____10_CM 3 0. 8160. FORMAT "%4.0" AXIS_PTS_REF ldpm_n_4_9 /end AXIS_DESCR
/end CHARACTERISTIC
/begin CHARACTERISTIC id_iga_dec_knk_2__n "Spark retard at recognised knocking, Intensity 2" CURVE 0xa08099e0 _REC_CUR_20_u1_u1 47.25 _CNV_A_R_LINEAR_____196_CM 0.375 47.625 DISPLAY_IDENTIFIER ID_IGA_DEC_KNK_2__N FORMAT "%4.1"
 /begin AXIS_DESCR COM_AXIS n_knk _CNV_A_R_LINEAR_____10_CM 3 0. 8160. FORMAT "%4.0" AXIS_PTS_REF ldpm_n_4_9 /end AXIS_DESCR
/end CHARACTERISTIC
/begin CHARACTERISTIC id_n_grd_max_knk__n "Speed Gradient for dynamic identification" CURVE 0xa0809c4c _REC_CUR_20_u1_u1 4064. _CNV_A_R_LINEAR_____30_CM 0. 4064. DISPLAY_IDENTIFIER ID_N_GRD_MAX_KNK__N FORMAT "%4.0"
 /begin AXIS_DESCR COM_AXIS n_knk _CNV_A_R_LINEAR_____10_CM 8 0. 8160. FORMAT "%4.0" AXIS_PTS_REF ldpm_n_iga_ad /end AXIS_DESCR
/end CHARACTERISTIC
/begin CHARACTERISTIC ip_iga_inc_knk__n "Re-set Increment KNK" CURVE 0xa080ad50 _REC_CUR_20_u2_u1 47.99707032000001 _CNV_A_R_LINEAR_____197_CM 1.46484e-003 47.99853516 DISPLAY_IDENTIFIER IP_IGA_INC_KNK__N FORMAT "%8.5"
 /begin AXIS_DESCR COM_AXIS n_knk _CNV_A_R_LINEAR_____10_CM 4 0. 8160. FORMAT "%4.0" AXIS_PTS_REF ldpm_n_fil_frq_knk /end AXIS_DESCR
/end CHARACTERISTIC
/begin MEASUREMENT knks_cyl_conf_act "Actual configuration value of analog channel of knock sensor for all cylinders dependant on the configuration" UWORD _CNV_A_R_LINEAR_____0_CM 1 100. 0. 65535. DISPLAY_IDENTIFIER KNKS_CYL_CONF_ACT ECU_ADDRESS 0xd000a80c FORMAT "%5.0" /end MEASUREMENT
/begin MEASUREMENT iga_knk[0] "Spark retard through knock control without Adaptation(cylinder individual)" UBYTE _CNV_A_R_LINEAR_____198_CM 1 100. -48. 0. DISPLAY_IDENTIFIER IGA_KNK[0] ECU_ADDRESS 0xd0008c5c FORMAT "%7.3" /end MEASUREMENT
/begin MEASUREMENT iga_knk[1] "Spark retard through knock control without Adaptation(cylinder individual)" UBYTE _CNV_A_R_LINEAR_____198_CM 1 100. -48. 0. DISPLAY_IDENTIFIER IGA_KNK[1] ECU_ADDRESS 0xd0008c5d FORMAT "%7.3" /end MEASUREMENT
/begin MEASUREMENT iga_knk[2] "Spark retard through knock control without Adaptation(cylinder individual)" UBYTE _CNV_A_R_LINEAR_____198_CM 1 100. -48. 0. DISPLAY_IDENTIFIER IGA_KNK[2] ECU_ADDRESS 0xd0008c5e FORMAT "%7.3" /end MEASUREMENT
/begin MEASUREMENT iga_knk[3] "Spark retard through knock control without Adaptation(cylinder individual)" UBYTE _CNV_A_R_LINEAR_____198_CM 1 100. -48. 0. DISPLAY_IDENTIFIER IGA_KNK[3] ECU_ADDRESS 0xd0008c5f FORMAT "%7.3" /end MEASUREMENT
/begin MEASUREMENT iga_knk[4] "Spark retard through knock control without Adaptation(cylinder individual)" UBYTE _CNV_A_R_LINEAR_____198_CM 1 100. -48. 0. DISPLAY_IDENTIFIER IGA_KNK[4] ECU_ADDRESS 0xd0008c60 FORMAT "%7.3" /end MEASUREMENT
/begin MEASUREMENT iga_knk[5] "Spark retard through knock control without Adaptation(cylinder individual)" UBYTE _CNV_A_R_LINEAR_____198_CM 1 100. -48. 0. DISPLAY_IDENTIFIER IGA_KNK[5] ECU_ADDRESS 0xd0008c61 FORMAT "%7.3" /end MEASUREMENT
/begin MEASUREMENT iga_knk[6] "Spark retard through knock control without Adaptation(cylinder individual)" UBYTE _CNV_A_R_LINEAR_____198_CM 1 100. -48. 0. DISPLAY_IDENTIFIER IGA_KNK[6] ECU_ADDRESS 0xd0008c62 FORMAT "%7.3" /end MEASUREMENT
/begin MEASUREMENT iga_knk[7] "Spark retard through knock control without Adaptation(cylinder individual)" UBYTE _CNV_A_R_LINEAR_____198_CM 1 100. -48. 0. DISPLAY_IDENTIFIER IGA_KNK[7] ECU_ADDRESS 0xd0008c63 FORMAT "%7.3" /end MEASUREMENT
/begin MEASUREMENT knk_thd[0] "Knock Threshold cylinder x" UBYTE _CNV_A_R_LINEAR_____199_CM 1 100. 0. 4.998 DISPLAY_IDENTIFIER KNK_THD[0] ECU_ADDRESS 0xd0008c68 FORMAT "%6.4" /end MEASUREMENT
/begin MEASUREMENT knk_thd[1] "Knock Threshold cylinder x" UBYTE _CNV_A_R_LINEAR_____199_CM 1 100. 0. 4.998 DISPLAY_IDENTIFIER KNK_THD[1] ECU_ADDRESS 0xd0008c69 FORMAT "%6.4" /end MEASUREMENT
/begin MEASUREMENT knk_thd[2] "Knock Threshold cylinder x" UBYTE _CNV_A_R_LINEAR_____199_CM 1 100. 0. 4.998 DISPLAY_IDENTIFIER KNK_THD[2] ECU_ADDRESS 0xd0008c6a FORMAT "%6.4" /end MEASUREMENT
/begin MEASUREMENT knk_thd[3] "Knock Threshold cylinder x" UBYTE _CNV_A_R_LINEAR_____199_CM 1 100. 0. 4.998 DISPLAY_IDENTIFIER KNK_THD[3] ECU_ADDRESS 0xd0008c6b FORMAT "%6.4" /end MEASUREMENT
/begin MEASUREMENT knk_thd[4] "Knock Threshold cylinder x" UBYTE _CNV_A_R_LINEAR_____199_CM 1 100. 0. 4.998 DISPLAY_IDENTIFIER KNK_THD[4] ECU_ADDRESS 0xd0008c6c FORMAT "%6.4" /end MEASUREMENT
/begin MEASUREMENT knk_thd[5] "Knock Threshold cylinder x" UBYTE _CNV_A_R_LINEAR_____199_CM 1 100. 0. 4.998 DISPLAY_IDENTIFIER KNK_THD[5] ECU_ADDRESS 0xd0008c6d FORMAT "%6.4" /end MEASUREMENT
/begin MEASUREMENT knk_thd[6] "Knock Threshold cylinder x" UBYTE _CNV_A_R_LINEAR_____199_CM 1 100. 0. 4.998 DISPLAY_IDENTIFIER KNK_THD[6] ECU_ADDRESS 0xd0008c6e FORMAT "%6.4" /end MEASUREMENT
/begin MEASUREMENT knk_thd[7] "Knock Threshold cylinder x" UBYTE _CNV_A_R_LINEAR_____199_CM 1 100. 0. 4.998 DISPLAY_IDENTIFIER KNK_THD[7] ECU_ADDRESS 0xd0008c6f FORMAT "%6.4" /end MEASUREMENT
/begin MEASUREMENT knks_cmd_fil[0] "Knock Filter Frequency and Reference Filter Frequency Cyl.x" UBYTE _CNV_A_R_LINEAR_____0_CM 1 100. 0. 63. DISPLAY_IDENTIFIER KNKS_CMD_FIL[0] ECU_ADDRESS 0xd0008c3c FORMAT "%2.0" /end MEASUREMENT
/begin MEASUREMENT knks_cmd_fil[1] "Knock Filter Frequency and Reference Filter Frequency Cyl.x" UBYTE _CNV_A_R_LINEAR_____0_CM 1 100. 0. 63. DISPLAY_IDENTIFIER KNKS_CMD_FIL[1] ECU_ADDRESS 0xd0008c3d FORMAT "%2.0" /end MEASUREMENT
/begin MEASUREMENT knks_cmd_fil[2] "Knock Filter Frequency and Reference Filter Frequency Cyl.x" UBYTE _CNV_A_R_LINEAR_____0_CM 1 100. 0. 63. DISPLAY_IDENTIFIER KNKS_CMD_FIL[2] ECU_ADDRESS 0xd0008c3e FORMAT "%2.0" /end MEASUREMENT
/begin MEASUREMENT knks_cmd_fil[3] "Knock Filter Frequency and Reference Filter Frequency Cyl.x" UBYTE _CNV_A_R_LINEAR_____0_CM 1 100. 0. 63. DISPLAY_IDENTIFIER KNKS_CMD_FIL[3] ECU_ADDRESS 0xd0008c3f FORMAT "%2.0" /end MEASUREMENT
/begin MEASUREMENT knks_cmd_fil[4] "Knock Filter Frequency and Reference Filter Frequency Cyl.x" UBYTE _CNV_A_R_LINEAR_____0_CM 1 100. 0. 63. DISPLAY_IDENTIFIER KNKS_CMD_FIL[4] ECU_ADDRESS 0xd0008c40 FORMAT "%2.0" /end MEASUREMENT
/begin MEASUREMENT knks_cmd_fil[5] "Knock Filter Frequency and Reference Filter Frequency Cyl.x" UBYTE _CNV_A_R_LINEAR_____0_CM 1 100. 0. 63. DISPLAY_IDENTIFIER KNKS_CMD_FIL[5] ECU_ADDRESS 0xd0008c41 FORMAT "%2.0" /end MEASUREMENT
/begin MEASUREMENT knks_cmd_fil[6] "Knock Filter Frequency and Reference Filter Frequency Cyl.x" UBYTE _CNV_A_R_LINEAR_____0_CM 1 100. 0. 63. DISPLAY_IDENTIFIER KNKS_CMD_FIL[6] ECU_ADDRESS 0xd0008c42 FORMAT "%2.0" /end MEASUREMENT
/begin MEASUREMENT knks_cmd_fil[7] "Knock Filter Frequency and Reference Filter Frequency Cyl.x" UBYTE _CNV_A_R_LINEAR_____0_CM 1 100. 0. 63. DISPLAY_IDENTIFIER KNKS_CMD_FIL[7] ECU_ADDRESS 0xd0008c43 FORMAT "%2.0" /end MEASUREMENT
/begin MEASUREMENT knkwb[0] "Beginning of Measurement Window Cyl.x" UWORD _CNV_A_R_LINEAR_____200_CM 1 100. 0. 108. DISPLAY_IDENTIFIER KNKWB[0] ECU_ADDRESS 0xd000a7ec FORMAT "%5.1" /end MEASUREMENT
/begin MEASUREMENT knkwb[1] "Beginning of Measurement Window Cyl.x" UWORD _CNV_A_R_LINEAR_____200_CM 1 100. 0. 108. DISPLAY_IDENTIFIER KNKWB[1] ECU_ADDRESS 0xd000a7ee FORMAT "%5.1" /end MEASUREMENT
/begin MEASUREMENT knkwb[2] "Beginning of Measurement Window Cyl.x" UWORD _CNV_A_R_LINEAR_____200_CM 1 100. 0. 108. DISPLAY_IDENTIFIER KNKWB[2] ECU_ADDRESS 0xd000a7f0 FORMAT "%5.1" /end MEASUREMENT
/begin MEASUREMENT knkwb[3] "Beginning of Measurement Window Cyl.x" UWORD _CNV_A_R_LINEAR_____200_CM 1 100. 0. 108. DISPLAY_IDENTIFIER KNKWB[3] ECU_ADDRESS 0xd000a7f2 FORMAT "%5.1" /end MEASUREMENT
/begin MEASUREMENT knkwb[4] "Beginning of Measurement Window Cyl.x" UWORD _CNV_A_R_LINEAR_____200_CM 1 100. 0. 108. DISPLAY_IDENTIFIER KNKWB[4] ECU_ADDRESS 0xd000a7f4 FORMAT "%5.1" /end MEASUREMENT
/begin MEASUREMENT knkwb[5] "Beginning of Measurement Window Cyl.x" UWORD _CNV_A_R_LINEAR_____200_CM 1 100. 0. 108. DISPLAY_IDENTIFIER KNKWB[5] ECU_ADDRESS 0xd000a7f6 FORMAT "%5.1" /end MEASUREMENT
/begin MEASUREMENT knkwb[6] "Beginning of Measurement Window Cyl.x" UWORD _CNV_A_R_LINEAR_____200_CM 1 100. 0. 108. DISPLAY_IDENTIFIER KNKWB[6] ECU_ADDRESS 0xd000a7f8 FORMAT "%5.1" /end MEASUREMENT
/begin MEASUREMENT knkwb[7] "Beginning of Measurement Window Cyl.x" UWORD _CNV_A_R_LINEAR_____200_CM 1 100. 0. 108. DISPLAY_IDENTIFIER KNKWB[7] ECU_ADDRESS 0xd000a7fa FORMAT "%5.1" /end MEASUREMENT
/begin MEASUREMENT knkwe[0] "End of Measurement Window Cyl.x" UWORD _CNV_A_R_LINEAR_____200_CM 1 100. 0.375 114. DISPLAY_IDENTIFIER KNKWE[0] ECU_ADDRESS 0xd000a7fc FORMAT "%5.1" /end MEASUREMENT
/begin MEASUREMENT knkwe[1] "End of Measurement Window Cyl.x" UWORD _CNV_A_R_LINEAR_____200_CM 1 100. 0.375 114. DISPLAY_IDENTIFIER KNKWE[1] ECU_ADDRESS 0xd000a7fe FORMAT "%5.1" /end MEASUREMENT
/begin MEASUREMENT knkwe[2] "End of Measurement Window Cyl.x" UWORD _CNV_A_R_LINEAR_____200_CM 1 100. 0.375 114. DISPLAY_IDENTIFIER KNKWE[2] ECU_ADDRESS 0xd000a800 FORMAT "%5.1" /end MEASUREMENT
/begin MEASUREMENT knkwe[3] "End of Measurement Window Cyl.x" UWORD _CNV_A_R_LINEAR_____200_CM 1 100. 0.375 114. DISPLAY_IDENTIFIER KNKWE[3] ECU_ADDRESS 0xd000a802 FORMAT "%5.1" /end MEASUREMENT
/begin MEASUREMENT knkwe[4] "End of Measurement Window Cyl.x" UWORD _CNV_A_R_LINEAR_____200_CM 1 100. 0.375 114. DISPLAY_IDENTIFIER KNKWE[4] ECU_ADDRESS 0xd000a804 FORMAT "%5.1" /end MEASUREMENT
/begin MEASUREMENT knkwe[5] "End of Measurement Window Cyl.x" UWORD _CNV_A_R_LINEAR_____200_CM 1 100. 0.375 114. DISPLAY_IDENTIFIER KNKWE[5] ECU_ADDRESS 0xd000a806 FORMAT "%5.1" /end MEASUREMENT
/begin MEASUREMENT knkwe[6] "End of Measurement Window Cyl.x" UWORD _CNV_A_R_LINEAR_____200_CM 1 100. 0.375 114. DISPLAY_IDENTIFIER KNKWE[6] ECU_ADDRESS 0xd000a808 FORMAT "%5.1" /end MEASUREMENT
/begin MEASUREMENT knkwe[7] "End of Measurement Window Cyl.x" UWORD _CNV_A_R_LINEAR_____200_CM 1 100. 0.375 114. DISPLAY_IDENTIFIER KNKWE[7] ECU_ADDRESS 0xd000a80a FORMAT "%5.1" /end MEASUREMENT
/begin MEASUREMENT lv_knk_ctl_ena "Boolean for knock control enabled" UBYTE _CNV_S_2_RANGE__0___1_CM 1 100. 0. 1. DISPLAY_IDENTIFIER LV_KNK_CTL_ENA ECU_ADDRESS 0xd0008c78 BIT_MASK 0x1 /end MEASUREMENT
/begin MEASUREMENT lv_knk_tra_maf "Logical variable for Load Dynamic Function active or passive" UBYTE _CNV_S_2_RANGE__0___1_CM 1 100. 0. 1. DISPLAY_IDENTIFIER LV_KNK_TRA_MAF ECU_ADDRESS 0xd00010c9 BIT_MASK 0x1 /end MEASUREMENT
/begin MEASUREMENT n_knk "Engine speed with hysteresis" UBYTE _CNV_A_R_LINEAR_____10_CM 1 100. 0. 8160. DISPLAY_IDENTIFIER N_KNK ECU_ADDRESS 0xd00010c0 FORMAT "%4.0" /end MEASUREMENT
/begin MEASUREMENT nl[0] "Floating mean value of the noise signal" UWORD _CNV_A_R_LINEAR_____201_CM 1 100. 0. 4.99992371 DISPLAY_IDENTIFIER NL[0] ECU_ADDRESS 0xd000a7dc FORMAT "%7.5" /end MEASUREMENT
/begin MEASUREMENT nl[1] "Floating mean value of the noise signal" UWORD _CNV_A_R_LINEAR_____201_CM 1 100. 0. 4.99992371 DISPLAY_IDENTIFIER NL[1] ECU_ADDRESS 0xd000a7de FORMAT "%7.5" /end MEASUREMENT
/begin MEASUREMENT nl[2] "Floating mean value of the noise signal" UWORD _CNV_A_R_LINEAR_____201_CM 1 100. 0. 4.99992371 DISPLAY_IDENTIFIER NL[2] ECU_ADDRESS 0xd000a7e0 FORMAT "%7.5" /end MEASUREMENT
/begin MEASUREMENT nl[3] "Floating mean value of the noise signal" UWORD _CNV_A_R_LINEAR_____201_CM 1 100. 0. 4.99992371 DISPLAY_IDENTIFIER NL[3] ECU_ADDRESS 0xd000a7e2 FORMAT "%7.5" /end MEASUREMENT
/begin MEASUREMENT nl[4] "Floating mean value of the noise signal" UWORD _CNV_A_R_LINEAR_____201_CM 1 100. 0. 4.99992371 DISPLAY_IDENTIFIER NL[4] ECU_ADDRESS 0xd000a7e4 FORMAT "%7.5" /end MEASUREMENT
/begin MEASUREMENT nl[5] "Floating mean value of the noise signal" UWORD _CNV_A_R_LINEAR_____201_CM 1 100. 0. 4.99992371 DISPLAY_IDENTIFIER NL[5] ECU_ADDRESS 0xd000a7e6 FORMAT "%7.5" /end MEASUREMENT
/begin MEASUREMENT nl[6] "Floating mean value of the noise signal" UWORD _CNV_A_R_LINEAR_____201_CM 1 100. 0. 4.99992371 DISPLAY_IDENTIFIER NL[6] ECU_ADDRESS 0xd000a7e8 FORMAT "%7.5" /end MEASUREMENT
/begin MEASUREMENT nl[7] "Floating mean value of the noise signal" UWORD _CNV_A_R_LINEAR_____201_CM 1 100. 0. 4.99992371 DISPLAY_IDENTIFIER NL[7] ECU_ADDRESS 0xd000a7ea FORMAT "%7.5" /end MEASUREMENT
/begin CHARACTERISTIC c_fac_tra_knk "correction factor for load dynamic active" VALUE 0xa080bd26 _REC_VAL_20_u1 6.96875 _CNV_A_R_LINEAR_____192_CM 1. 7.96875 DISPLAY_IDENTIFIER C_FAC_TRA_KNK FORMAT "%5.3" /end CHARACTERISTIC
/begin CHARACTERISTIC c_iga_dif_min_max_knk "Control excursion limit valid for spark advance and spark retard " VALUE 0xa080bdb0 _REC_VAL_20_u1 48. _CNV_A_R_LINEAR_____200_CM 0. 48. DISPLAY_IDENTIFIER C_IGA_DIF_MIN_MAX_KNK FORMAT "%4.1" /end CHARACTERISTIC
/begin CHARACTERISTIC c_maf_iga_hys_knk "Air-Mass Hysteresis for Knock Control" VALUE 0xa080be2a _REC_VAL_20_u1 1389. _CNV_A_R_LINEAR_____15_CM 0. 1389. DISPLAY_IDENTIFIER C_MAF_IGA_HYS_KNK FORMAT "%4.0" /end CHARACTERISTIC
/begin CHARACTERISTIC c_n_iga_hys_knk "Speed Hysteresis for Knock Control" VALUE 0xa080bf4e _REC_VAL_20_u1 8160. _CNV_A_R_LINEAR_____10_CM 0. 8160. DISPLAY_IDENTIFIER C_N_IGA_HYS_KNK FORMAT "%4.0" /end CHARACTERISTIC
/begin CHARACTERISTIC c_nl_crlc "Averaging Constant for Noise Value Calculation" VALUE 0xa080bfe4 _REC_VAL_20_u1 0.99609375 _CNV_A_R_LINEAR_____28_CM 0. 0.99609375 DISPLAY_IDENTIFIER C_NL_CRLC FORMAT "%5.3" /end CHARACTERISTIC
/begin CHARACTERISTIC c_nl_crlc_tra "Averaging Constant for Noise Value Calculation for Transient Case" VALUE 0xa080bfe6 _REC_VAL_20_u1 0.99609375 _CNV_A_R_LINEAR_____28_CM 0. 0.99609375 DISPLAY_IDENTIFIER C_NL_CRLC_TRA FORMAT "%5.3" /end CHARACTERISTIC
/begin MEASUREMENT iga_adj_knk[0] "Total spark retard through knock control with Adaptation (cylinder individual)" UBYTE _CNV_A_R_LINEAR_____198_CM 1 100. -48. 0. DISPLAY_IDENTIFIER IGA_ADJ_KNK[0] ECU_ADDRESS 0xd0008c54 FORMAT "%5.1" /end MEASUREMENT
/begin MEASUREMENT iga_adj_knk[1] "Total spark retard through knock control with Adaptation (cylinder individual)" UBYTE _CNV_A_R_LINEAR_____198_CM 1 100. -48. 0. DISPLAY_IDENTIFIER IGA_ADJ_KNK[1] ECU_ADDRESS 0xd0008c55 FORMAT "%5.1" /end MEASUREMENT
/begin MEASUREMENT iga_adj_knk[2] "Total spark retard through knock control with Adaptation (cylinder individual)" UBYTE _CNV_A_R_LINEAR_____198_CM 1 100. -48. 0. DISPLAY_IDENTIFIER IGA_ADJ_KNK[2] ECU_ADDRESS 0xd0008c56 FORMAT "%5.1" /end MEASUREMENT
/begin MEASUREMENT iga_adj_knk[3] "Total spark retard through knock control with Adaptation (cylinder individual)" UBYTE _CNV_A_R_LINEAR_____198_CM 1 100. -48. 0. DISPLAY_IDENTIFIER IGA_ADJ_KNK[3] ECU_ADDRESS 0xd0008c57 FORMAT "%5.1" /end MEASUREMENT
/begin MEASUREMENT iga_adj_knk[4] "Total spark retard through knock control with Adaptation (cylinder individual)" UBYTE _CNV_A_R_LINEAR_____198_CM 1 100. -48. 0. DISPLAY_IDENTIFIER IGA_ADJ_KNK[4] ECU_ADDRESS 0xd0008c58 FORMAT "%5.1" /end MEASUREMENT
/begin MEASUREMENT iga_adj_knk[5] "Total spark retard through knock control with Adaptation (cylinder individual)" UBYTE _CNV_A_R_LINEAR_____198_CM 1 100. -48. 0. DISPLAY_IDENTIFIER IGA_ADJ_KNK[5] ECU_ADDRESS 0xd0008c59 FORMAT "%5.1" /end MEASUREMENT
/begin MEASUREMENT iga_adj_knk[6] "Total spark retard through knock control with Adaptation (cylinder individual)" UBYTE _CNV_A_R_LINEAR_____198_CM 1 100. -48. 0. DISPLAY_IDENTIFIER IGA_ADJ_KNK[6] ECU_ADDRESS 0xd0008c5a FORMAT "%5.1" /end MEASUREMENT
/begin MEASUREMENT iga_adj_knk[7] "Total spark retard through knock control with Adaptation (cylinder individual)" UBYTE _CNV_A_R_LINEAR_____198_CM 1 100. -48. 0. DISPLAY_IDENTIFIER IGA_ADJ_KNK[7] ECU_ADDRESS 0xd0008c5b FORMAT "%5.1" /end MEASUREMENT
/begin MEASUREMENT iga_mv_adj_knk "meanvalue of actual retard adjustment with Adaptation values" UBYTE _CNV_A_R_LINEAR_____198_CM 1 100. -48. 0. DISPLAY_IDENTIFIER IGA_MV_ADJ_KNK ECU_ADDRESS 0xd0008c64 FORMAT "%4.1" /end MEASUREMENT
/begin MEASUREMENT iga_mv_cbk_adj_knk[0] "meanvalue of actual retard adjustment with Adaptation values bank selective" UBYTE _CNV_A_R_LINEAR_____198_CM 1 100. -48. 0. DISPLAY_IDENTIFIER IGA_MV_CBK_ADJ_KNK[0] ECU_ADDRESS 0xd0008c76 FORMAT "%5.1" /end MEASUREMENT
/begin MEASUREMENT iga_mv_cbk_adj_knk[1] "meanvalue of actual retard adjustment with Adaptation values bank selective" UBYTE _CNV_A_R_LINEAR_____198_CM 1 100. -48. 0. DISPLAY_IDENTIFIER IGA_MV_CBK_ADJ_KNK[1] ECU_ADDRESS 0xd0008c77 FORMAT "%5.1" /end MEASUREMENT
/begin MEASUREMENT cyl_id_knk "cylinder number for knock control" UBYTE _CNV_A_R_LINEAR_____0_CM 1 100. 0. 255. DISPLAY_IDENTIFIER CYL_ID_KNK ECU_ADDRESS 0xd0008c39 FORMAT "%3.0" /end MEASUREMENT
/begin MEASUREMENT lv_knk "Logical variable for recognition of knock" UBYTE _CNV_S_2_RANGE__0___1_CM 1 100. 0. 1. DISPLAY_IDENTIFIER LV_KNK ECU_ADDRESS 0xd0008c7b BIT_MASK 0x1 /end MEASUREMENT
/begin MEASUREMENT iga_mv_knk "meanvalue of actual retard adjustment without Adaptation values" UBYTE _CNV_A_R_LINEAR_____198_CM 1 100. -48. 0. DISPLAY_IDENTIFIER IGA_MV_KNK ECU_ADDRESS 0xd0008c74 FORMAT "%4.1" /end MEASUREMENT
/begin MEASUREMENT knks_cmd_gain[0] "Amplification precontrol Cyl.x" UBYTE _CNV_A_R_LINEAR_____0_CM 1 100. 0. 63. DISPLAY_IDENTIFIER KNKS_CMD_GAIN[0] ECU_ADDRESS 0xd0008c4c FORMAT "%2.0" /end MEASUREMENT
/begin MEASUREMENT knks_cmd_gain[1] "Amplification precontrol Cyl.x" UBYTE _CNV_A_R_LINEAR_____0_CM 1 100. 0. 63. DISPLAY_IDENTIFIER KNKS_CMD_GAIN[1] ECU_ADDRESS 0xd0008c4d FORMAT "%2.0" /end MEASUREMENT
/begin MEASUREMENT knks_cmd_gain[2] "Amplification precontrol Cyl.x" UBYTE _CNV_A_R_LINEAR_____0_CM 1 100. 0. 63. DISPLAY_IDENTIFIER KNKS_CMD_GAIN[2] ECU_ADDRESS 0xd0008c4e FORMAT "%2.0" /end MEASUREMENT
/begin MEASUREMENT knks_cmd_gain[3] "Amplification precontrol Cyl.x" UBYTE _CNV_A_R_LINEAR_____0_CM 1 100. 0. 63. DISPLAY_IDENTIFIER KNKS_CMD_GAIN[3] ECU_ADDRESS 0xd0008c4f FORMAT "%2.0" /end MEASUREMENT
/begin MEASUREMENT knks_cmd_gain[4] "Amplification precontrol Cyl.x" UBYTE _CNV_A_R_LINEAR_____0_CM 1 100. 0. 63. DISPLAY_IDENTIFIER KNKS_CMD_GAIN[4] ECU_ADDRESS 0xd0008c50 FORMAT "%2.0" /end MEASUREMENT
/begin MEASUREMENT knks_cmd_gain[5] "Amplification precontrol Cyl.x" UBYTE _CNV_A_R_LINEAR_____0_CM 1 100. 0. 63. DISPLAY_IDENTIFIER KNKS_CMD_GAIN[5] ECU_ADDRESS 0xd0008c51 FORMAT "%2.0" /end MEASUREMENT
/begin MEASUREMENT knks_cmd_gain[6] "Amplification precontrol Cyl.x" UBYTE _CNV_A_R_LINEAR_____0_CM 1 100. 0. 63. DISPLAY_IDENTIFIER KNKS_CMD_GAIN[6] ECU_ADDRESS 0xd0008c52 FORMAT "%2.0" /end MEASUREMENT
/begin MEASUREMENT knks_cmd_gain[7] "Amplification precontrol Cyl.x" UBYTE _CNV_A_R_LINEAR_____0_CM 1 100. 0. 63. DISPLAY_IDENTIFIER KNKS_CMD_GAIN[7] ECU_ADDRESS 0xd0008c53 FORMAT "%2.0" /end MEASUREMENT
/begin MEASUREMENT knks_cmd_int[0] "Integration time constant Cyl.x" UBYTE _CNV_A_R_LINEAR_____0_CM 1 100. 0. 31. DISPLAY_IDENTIFIER KNKS_CMD_INT[0] ECU_ADDRESS 0xd0008c44 FORMAT "%2.0" /end MEASUREMENT
/begin MEASUREMENT knks_cmd_int[1] "Integration time constant Cyl.x" UBYTE _CNV_A_R_LINEAR_____0_CM 1 100. 0. 31. DISPLAY_IDENTIFIER KNKS_CMD_INT[1] ECU_ADDRESS 0xd0008c45 FORMAT "%2.0" /end MEASUREMENT
/begin MEASUREMENT knks_cmd_int[2] "Integration time constant Cyl.x" UBYTE _CNV_A_R_LINEAR_____0_CM 1 100. 0. 31. DISPLAY_IDENTIFIER KNKS_CMD_INT[2] ECU_ADDRESS 0xd0008c46 FORMAT "%2.0" /end MEASUREMENT
/begin MEASUREMENT knks_cmd_int[3] "Integration time constant Cyl.x" UBYTE _CNV_A_R_LINEAR_____0_CM 1 100. 0. 31. DISPLAY_IDENTIFIER KNKS_CMD_INT[3] ECU_ADDRESS 0xd0008c47 FORMAT "%2.0" /end MEASUREMENT
/begin MEASUREMENT knks_cmd_int[4] "Integration time constant Cyl.x" UBYTE _CNV_A_R_LINEAR_____0_CM 1 100. 0. 31. DISPLAY_IDENTIFIER KNKS_CMD_INT[4] ECU_ADDRESS 0xd0008c48 FORMAT "%2.0" /end MEASUREMENT
/begin MEASUREMENT knks_cmd_int[5] "Integration time constant Cyl.x" UBYTE _CNV_A_R_LINEAR_____0_CM 1 100. 0. 31. DISPLAY_IDENTIFIER KNKS_CMD_INT[5] ECU_ADDRESS 0xd0008c49 FORMAT "%2.0" /end MEASUREMENT
/begin MEASUREMENT knks_cmd_int[6] "Integration time constant Cyl.x" UBYTE _CNV_A_R_LINEAR_____0_CM 1 100. 0. 31. DISPLAY_IDENTIFIER KNKS_CMD_INT[6] ECU_ADDRESS 0xd0008c4a FORMAT "%2.0" /end MEASUREMENT
/begin MEASUREMENT knks_cmd_int[7] "Integration time constant Cyl.x" UBYTE _CNV_A_R_LINEAR_____0_CM 1 100. 0. 31. DISPLAY_IDENTIFIER KNKS_CMD_INT[7] ECU_ADDRESS 0xd0008c4b FORMAT "%2.0" /end MEASUREMENT
/begin CHARACTERISTIC id_cycnr_fac_tra_knk__n "Cycle counter during which the Load Dynamic Function stays active after triggering" CURVE 0xa080994e _REC_CUR_20_u1_u1 255. _CNV_A_R_LINEAR_____0_CM 0. 255. DISPLAY_IDENTIFIER ID_CYCNR_FAC_TRA_KNK__N FORMAT "%3.0"
 /begin AXIS_DESCR COM_AXIS n_knk _CNV_A_R_LINEAR_____10_CM 4 0. 8160. FORMAT "%4.0" AXIS_PTS_REF ldpm_n_6_4 /end AXIS_DESCR
/end CHARACTERISTIC
/begin CHARACTERISTIC ip_knkwb_1__n__maf "Beginning of Measurement Window Cyl.2" MAP 0xa08151ec _REC_MAP_20_u2_u1_u1 108. _CNV_A_R_LINEAR_____200_CM 0. 108. DISPLAY_IDENTIFIER IP_KNKWB[1] FORMAT "%5.1"
 /begin AXIS_DESCR COM_AXIS n_knk _CNV_A_R_LINEAR_____10_CM 10 0. 8160. FORMAT "%4.0" AXIS_PTS_REF ldpm_n_knkwb /end AXIS_DESCR
 /begin AXIS_DESCR COM_AXIS maf_knk _CNV_A_R_LINEAR_____15_CM 4 0. 1389. FORMAT "%4.0" AXIS_PTS_REF ldpm_maf_knkwb /end AXIS_DESCR
/end CHARACTERISTIC
/begin CHARACTERISTIC ip_gain_knk_1__n__maf "Amplification precontrol Cyl.2" MAP 0xa0814bbc _REC_MAP_20_u1_u1_u1 63. _CNV_A_R_LINEAR_____0_CM 0. 63. DISPLAY_IDENTIFIER IP_GAIN_KNK[1] FORMAT "%2.0"
 /begin AXIS_DESCR COM_AXIS n_knk _CNV_A_R_LINEAR_____10_CM 16 0. 8160. FORMAT "%4.0" AXIS_PTS_REF ldpm_n_2_9 /end AXIS_DESCR
 /begin AXIS_DESCR COM_AXIS maf_knk _CNV_A_R_LINEAR_____15_CM 8 0. 1389. FORMAT "%4.0" AXIS_PTS_REF ldpm_maf_gain_knk /end AXIS_DESCR
/end CHARACTERISTIC
/begin CHARACTERISTIC ip_fac_thd_knk_0__n__maf "Knock Factor Table Cyl. 1" MAP 0xa080a590 _REC_MAP_20_u1_u1_u1 7.96875 _CNV_A_R_LINEAR_____192_CM 0. 7.96875 DISPLAY_IDENTIFIER IP_FAC_THD_KNK[0] FORMAT "%4.2"
 /begin AXIS_DESCR COM_AXIS n_knk _CNV_A_R_LINEAR_____10_CM 16 0. 8160. FORMAT "%4.0" AXIS_PTS_REF ldpm_n_2_9 /end AXIS_DESCR
 /begin AXIS_DESCR COM_AXIS maf_knk _CNV_A_R_LINEAR_____15_CM 4 0. 1389. FORMAT "%4.0" AXIS_PTS_REF ldpm_maf_1_9 /end AXIS_DESCR
/end CHARACTERISTIC
/begin CHARACTERISTIC ip_fac_thd_knk_1__n__maf "Knock Factor Table Cyl. 2" MAP 0xa080a5d0 _REC_MAP_20_u1_u1_u1 7.96875 _CNV_A_R_LINEAR_____192_CM 0. 7.96875 DISPLAY_IDENTIFIER IP_FAC_THD_KNK[1] FORMAT "%4.2"
 /begin AXIS_DESCR COM_AXIS n_knk _CNV_A_R_LINEAR_____10_CM 16 0. 8160. FORMAT "%4.0" AXIS_PTS_REF ldpm_n_2_9 /end AXIS_DESCR
 /begin AXIS_DESCR COM_AXIS maf_knk _CNV_A_R_LINEAR_____15_CM 4 0. 1389. FORMAT "%4.0" AXIS_PTS_REF ldpm_maf_1_9 /end AXIS_DESCR
/end CHARACTERISTIC
/begin CHARACTERISTIC ip_fac_thd_knk_2__n__maf "Knock Factor Table Cyl. 3" MAP 0xa080a610 _REC_MAP_20_u1_u1_u1 7.96875 _CNV_A_R_LINEAR_____192_CM 0. 7.96875 DISPLAY_IDENTIFIER IP_FAC_THD_KNK[2] FORMAT "%4.2"
 /begin AXIS_DESCR COM_AXIS n_knk _CNV_A_R_LINEAR_____10_CM 16 0. 8160. FORMAT "%4.0" AXIS_PTS_REF ldpm_n_2_9 /end AXIS_DESCR
 /begin AXIS_DESCR COM_AXIS maf_knk _CNV_A_R_LINEAR_____15_CM 4 0. 1389. FORMAT "%4.0" AXIS_PTS_REF ldpm_maf_1_9 /end AXIS_DESCR
/end CHARACTERISTIC
/begin CHARACTERISTIC ip_fac_thd_knk_3__n__maf "Knock Factor Table Cyl. 4" MAP 0xa080a650 _REC_MAP_20_u1_u1_u1 7.96875 _CNV_A_R_LINEAR_____192_CM 0. 7.96875 DISPLAY_IDENTIFIER IP_FAC_THD_KNK[3] FORMAT "%4.2"
 /begin AXIS_DESCR COM_AXIS n_knk _CNV_A_R_LINEAR_____10_CM 16 0. 8160. FORMAT "%4.0" AXIS_PTS_REF ldpm_n_2_9 /end AXIS_DESCR
 /begin AXIS_DESCR COM_AXIS maf_knk _CNV_A_R_LINEAR_____15_CM 4 0. 1389. FORMAT "%4.0" AXIS_PTS_REF ldpm_maf_1_9 /end AXIS_DESCR
/end CHARACTERISTIC
/begin CHARACTERISTIC ip_fac_thd_knk_4__n__maf "Knock Factor Table Cyl. 5" MAP 0xa080a690 _REC_MAP_20_u1_u1_u1 7.96875 _CNV_A_R_LINEAR_____192_CM 0. 7.96875 DISPLAY_IDENTIFIER IP_FAC_THD_KNK[4] FORMAT "%4.2"
 /begin AXIS_DESCR COM_AXIS n_knk _CNV_A_R_LINEAR_____10_CM 16 0. 8160. FORMAT "%4.0" AXIS_PTS_REF ldpm_n_2_9 /end AXIS_DESCR
 /begin AXIS_DESCR COM_AXIS maf_knk _CNV_A_R_LINEAR_____15_CM 4 0. 1389. FORMAT "%4.0" AXIS_PTS_REF ldpm_maf_1_9 /end AXIS_DESCR
/end CHARACTERISTIC
/begin CHARACTERISTIC ip_fac_thd_knk_5__n__maf "Knock Factor Table Cyl. 6" MAP 0xa080a6d0 _REC_MAP_20_u1_u1_u1 7.96875 _CNV_A_R_LINEAR_____192_CM 0. 7.96875 DISPLAY_IDENTIFIER IP_FAC_THD_KNK[5] FORMAT "%4.2"
 /begin AXIS_DESCR COM_AXIS n_knk _CNV_A_R_LINEAR_____10_CM 16 0. 8160. FORMAT "%4.0" AXIS_PTS_REF ldpm_n_2_9 /end AXIS_DESCR
 /begin AXIS_DESCR COM_AXIS maf_knk _CNV_A_R_LINEAR_____15_CM 4 0. 1389. FORMAT "%4.0" AXIS_PTS_REF ldpm_maf_1_9 /end AXIS_DESCR
/end CHARACTERISTIC
/begin CHARACTERISTIC ip_fac_thd_knk_6__n__maf "Knock Factor Table Cyl. 7" MAP 0xa080a710 _REC_MAP_20_u1_u1_u1 7.96875 _CNV_A_R_LINEAR_____192_CM 0. 7.96875 DISPLAY_IDENTIFIER IP_FAC_THD_KNK[6] FORMAT "%4.2"
 /begin AXIS_DESCR COM_AXIS n_knk _CNV_A_R_LINEAR_____10_CM 16 0. 8160. FORMAT "%4.0" AXIS_PTS_REF ldpm_n_2_9 /end AXIS_DESCR
 /begin AXIS_DESCR COM_AXIS maf_knk _CNV_A_R_LINEAR_____15_CM 4 0. 1389. FORMAT "%4.0" AXIS_PTS_REF ldpm_maf_1_9 /end AXIS_DESCR
/end CHARACTERISTIC
/begin CHARACTERISTIC ip_fac_thd_knk_7__n__maf "Knock Factor Table Cyl. 8" MAP 0xa080a750 _REC_MAP_20_u1_u1_u1 7.96875 _CNV_A_R_LINEAR_____192_CM 0. 7.96875 DISPLAY_IDENTIFIER IP_FAC_THD_KNK[7] FORMAT "%4.2"
 /begin AXIS_DESCR COM_AXIS n_knk _CNV_A_R_LINEAR_____10_CM 16 0. 8160. FORMAT "%4.0" AXIS_PTS_REF ldpm_n_2_9 /end AXIS_DESCR
 /begin AXIS_DESCR COM_AXIS maf_knk _CNV_A_R_LINEAR_____15_CM 4 0. 1389. FORMAT "%4.0" AXIS_PTS_REF ldpm_maf_1_9 /end AXIS_DESCR
/end CHARACTERISTIC
/begin CHARACTERISTIC c_nl_min "Minimum noise value" VALUE 0xa080bfe8 _REC_VAL_20_u1 4.998 _CNV_A_R_LINEAR_____199_CM 0. 4.998 DISPLAY_IDENTIFIER C_NL_MIN FORMAT "%5.3" /end CHARACTERISTIC
/begin CHARACTERISTIC id_maf_dif_tra_knk__n "Throttle Position Gradient for Load Dynamik Recognition" CURVE 0xa0809be4 _REC_CUR_20_s2_u1 1388.978806 _CNV_A_R_LINEAR_____202_CM -694.5 694.478806 DISPLAY_IDENTIFIER ID_MAF_DIF_TRA_KNK__N FORMAT "%7.2"
 /begin AXIS_DESCR COM_AXIS n_knk _CNV_A_R_LINEAR_____10_CM 4 0. 8160. FORMAT "%4.0" AXIS_PTS_REF ldpm_n_6_4 /end AXIS_DESCR
/end CHARACTERISTIC
/begin AXIS_PTS ldp_tco__maf_min_knk "" 0xa0808dda tco _REC_AXS_20_u1 190.5 _CNV_A_R_LINEAR_____17_CM 4 -48. 142.5 FORMAT "%3.0" /end AXIS_PTS
/begin AXIS_PTS ldpm_n_3_9 "" 0xa0809638 n_32 _REC_AXS_20_u1 8160. _CNV_A_R_LINEAR_____10_CM 8 0. 8160. FORMAT "%4.0" /end AXIS_PTS
/begin AXIS_PTS ldpm_n_4_9 "" 0xa0809652 n_knk _REC_AXS_20_u1 8160. _CNV_A_R_LINEAR_____10_CM 3 0. 8160. FORMAT "%4.0" /end AXIS_PTS
/begin AXIS_PTS ldpm_n_6_4 "" 0xa0809666 n_knk _REC_AXS_20_u1 8160. _CNV_A_R_LINEAR_____10_CM 4 0. 8160. FORMAT "%4.0" /end AXIS_PTS
/begin CHARACTERISTIC c_knk_thd_max "Maximum knock threshold" VALUE 0xa080bdb7 _REC_VAL_20_u1 4.998 _CNV_A_R_LINEAR_____199_CM 0. 4.998 DISPLAY_IDENTIFIER C_KNK_THD_MAX FORMAT "%4.2" /end CHARACTERISTIC
/begin AXIS_PTS ldpm_n_iga_ad "" 0xa08096c4 n_knk _REC_AXS_20_u1 8160. _CNV_A_R_LINEAR_____10_CM 8 0. 8160. FORMAT "%4.0" /end AXIS_PTS
/begin AXIS_PTS ldpm_maf_iga_ad "" 0xa08094ee maf_knk _REC_AXS_20_u1 1389. _CNV_A_R_LINEAR_____15_CM 6 0. 1389. FORMAT "%7.2" /end AXIS_PTS
/begin AXIS_PTS ldpm_n_knkwb "" 0xa08096d0 n_knk _REC_AXS_20_u1 8160. _CNV_A_R_LINEAR_____10_CM 10 0. 8160. FORMAT "%4.0" /end AXIS_PTS
/begin AXIS_PTS ldpm_maf_knkwb "" 0xa0809518 maf_knk _REC_AXS_20_u1 1389. _CNV_A_R_LINEAR_____15_CM 4 0. 1389. FORMAT "%4.0" /end AXIS_PTS
/begin AXIS_PTS ldpm_n_fil_frq_knk "" 0xa08096b2 n_knk _REC_AXS_20_u1 8160. _CNV_A_R_LINEAR_____10_CM 4 0. 8160. FORMAT "%4.0" /end AXIS_PTS
/begin AXIS_PTS ldpm_n_2_9 "" 0xa08095b0 n_knk _REC_AXS_20_u1 8160. _CNV_A_R_LINEAR_____10_CM 16 0. 8160. FORMAT "%4.0" /end AXIS_PTS
/begin CHARACTERISTIC id_fil_frq_knk_0__n "Knock Filter Frequency and Reference Filter Frequency Cyl.1" CURVE 0xa08099a2 _REC_CUR_20_u1_u1 63. _CNV_A_R_LINEAR_____0_CM 0. 63. DISPLAY_IDENTIFIER ID_FIL_FRQ_KNK[0] FORMAT "%2.0"
 /begin AXIS_DESCR COM_AXIS n_knk _CNV_A_R_LINEAR_____10_CM 4 0. 8160. FORMAT "%4.0" AXIS_PTS_REF ldpm_n_fil_frq_knk /end AXIS_DESCR
/end CHARACTERISTIC
/begin CHARACTERISTIC id_fil_frq_knk_1__n "Knock Filter Frequency and Reference Filter Frequency Cyl.2" CURVE 0xa08099a6 _REC_CUR_20_u1_u1 63. _CNV_A_R_LINEAR_____0_CM 0. 63. DISPLAY_IDENTIFIER ID_FIL_FRQ_KNK[1] FORMAT "%2.0"
 /begin AXIS_DESCR COM_AXIS n_knk _CNV_A_R_LINEAR_____10_CM 4 0. 8160. FORMAT "%4.0" AXIS_PTS_REF ldpm_n_fil_frq_knk /end AXIS_DESCR
/end CHARACTERISTIC
/begin CHARACTERISTIC id_fil_frq_knk_2__n "Knock Filter Frequency and Reference Filter Frequency Cyl.3" CURVE 0xa08099aa _REC_CUR_20_u1_u1 63. _CNV_A_R_LINEAR_____0_CM 0. 63. DISPLAY_IDENTIFIER ID_FIL_FRQ_KNK[2] FORMAT "%2.0"
 /begin AXIS_DESCR COM_AXIS n_knk _CNV_A_R_LINEAR_____10_CM 4 0. 8160. FORMAT "%4.0" AXIS_PTS_REF ldpm_n_fil_frq_knk /end AXIS_DESCR
/end CHARACTERISTIC
/begin CHARACTERISTIC id_fil_frq_knk_3__n "Knock Filter Frequency and Reference Filter Frequency Cyl.4" CURVE 0xa08099ae _REC_CUR_20_u1_u1 63. _CNV_A_R_LINEAR_____0_CM 0. 63. DISPLAY_IDENTIFIER ID_FIL_FRQ_KNK[3] FORMAT "%2.0"
 /begin AXIS_DESCR COM_AXIS n_knk _CNV_A_R_LINEAR_____10_CM 4 0. 8160. FORMAT "%4.0" AXIS_PTS_REF ldpm_n_fil_frq_knk /end AXIS_DESCR
/end CHARACTERISTIC
/begin CHARACTERISTIC id_fil_frq_knk_4__n "Knock Filter Frequency and Reference Filter Frequency Cyl.5" CURVE 0xa08099b2 _REC_CUR_20_u1_u1 63. _CNV_A_R_LINEAR_____0_CM 0. 63. DISPLAY_IDENTIFIER ID_FIL_FRQ_KNK[4] FORMAT "%2.0"
 /begin AXIS_DESCR COM_AXIS n_knk _CNV_A_R_LINEAR_____10_CM 4 0. 8160. FORMAT "%4.0" AXIS_PTS_REF ldpm_n_fil_frq_knk /end AXIS_DESCR
/end CHARACTERISTIC
/begin CHARACTERISTIC id_fil_frq_knk_5__n "Knock Filter Frequency and Reference Filter Frequency Cyl.6" CURVE 0xa08099b6 _REC_CUR_20_u1_u1 63. _CNV_A_R_LINEAR_____0_CM 0. 63. DISPLAY_IDENTIFIER ID_FIL_FRQ_KNK[5] FORMAT "%2.0"
 /begin AXIS_DESCR COM_AXIS n_knk _CNV_A_R_LINEAR_____10_CM 4 0. 8160. FORMAT "%4.0" AXIS_PTS_REF ldpm_n_fil_frq_knk /end AXIS_DESCR
/end CHARACTERISTIC
/begin CHARACTERISTIC id_fil_frq_knk_6__n "Knock Filter Frequency and Reference Filter Frequency Cyl.7" CURVE 0xa08099ba _REC_CUR_20_u1_u1 63. _CNV_A_R_LINEAR_____0_CM 0. 63. DISPLAY_IDENTIFIER ID_FIL_FRQ_KNK[6] FORMAT "%2.0"
 /begin AXIS_DESCR COM_AXIS n_knk _CNV_A_R_LINEAR_____10_CM 4 0. 8160. FORMAT "%4.0" AXIS_PTS_REF ldpm_n_fil_frq_knk /end AXIS_DESCR
/end CHARACTERISTIC
/begin CHARACTERISTIC id_fil_frq_knk_7__n "Knock Filter Frequency and Reference Filter Frequency Cyl.8" CURVE 0xa08099be _REC_CUR_20_u1_u1 63. _CNV_A_R_LINEAR_____0_CM 0. 63. DISPLAY_IDENTIFIER ID_FIL_FRQ_KNK[7] FORMAT "%2.0"
 /begin AXIS_DESCR COM_AXIS n_knk _CNV_A_R_LINEAR_____10_CM 4 0. 8160. FORMAT "%4.0" AXIS_PTS_REF ldpm_n_fil_frq_knk /end AXIS_DESCR
/end CHARACTERISTIC
/begin MEASUREMENT knks[0] "" UWORD _CNV_A_R_LINEAR_____201_CM 1 100. 0. 4.99992371 DISPLAY_IDENTIFIER KNKS[0] ECU_ADDRESS 0xd000acac FORMAT "%7.5" /end MEASUREMENT
/begin MEASUREMENT knks[1] "" UWORD _CNV_A_R_LINEAR_____201_CM 1 100. 0. 4.99992371 DISPLAY_IDENTIFIER KNKS[1] ECU_ADDRESS 0xd000acae FORMAT "%7.5" /end MEASUREMENT
/begin MEASUREMENT knks[2] "" UWORD _CNV_A_R_LINEAR_____201_CM 1 100. 0. 4.99992371 DISPLAY_IDENTIFIER KNKS[2] ECU_ADDRESS 0xd000acb0 FORMAT "%7.5" /end MEASUREMENT
/begin MEASUREMENT knks[3] "" UWORD _CNV_A_R_LINEAR_____201_CM 1 100. 0. 4.99992371 DISPLAY_IDENTIFIER KNKS[3] ECU_ADDRESS 0xd000acb2 FORMAT "%7.5" /end MEASUREMENT
/begin MEASUREMENT knks[4] "" UWORD _CNV_A_R_LINEAR_____201_CM 1 100. 0. 4.99992371 DISPLAY_IDENTIFIER KNKS[4] ECU_ADDRESS 0xd000acb4 FORMAT "%7.5" /end MEASUREMENT
/begin MEASUREMENT knks[5] "" UWORD _CNV_A_R_LINEAR_____201_CM 1 100. 0. 4.99992371 DISPLAY_IDENTIFIER KNKS[5] ECU_ADDRESS 0xd000acb6 FORMAT "%7.5" /end MEASUREMENT
/begin MEASUREMENT knks[6] "" UWORD _CNV_A_R_LINEAR_____201_CM 1 100. 0. 4.99992371 DISPLAY_IDENTIFIER KNKS[6] ECU_ADDRESS 0xd000acb8 FORMAT "%7.5" /end MEASUREMENT
/begin MEASUREMENT knks[7] "" UWORD _CNV_A_R_LINEAR_____201_CM 1 100. 0. 4.99992371 DISPLAY_IDENTIFIER KNKS[7] ECU_ADDRESS 0xd000acba FORMAT "%7.5" /end MEASUREMENT
/begin CHARACTERISTIC ip_knkwb_2__n__maf "Beginning of Measurement Window Cyl.3" MAP 0xa081523c _REC_MAP_20_u2_u1_u1 108. _CNV_A_R_LINEAR_____200_CM 0. 108. DISPLAY_IDENTIFIER IP_KNKWB[2] FORMAT "%5.1"
 /begin AXIS_DESCR COM_AXIS n_knk _CNV_A_R_LINEAR_____10_CM 10 0. 8160. FORMAT "%4.0" AXIS_PTS_REF ldpm_n_knkwb /end AXIS_DESCR
 /begin AXIS_DESCR COM_AXIS maf_knk _CNV_A_R_LINEAR_____15_CM 4 0. 1389. FORMAT "%4.0" AXIS_PTS_REF ldpm_maf_knkwb /end AXIS_DESCR
/end CHARACTERISTIC
/begin CHARACTERISTIC ip_knkwb_3__n__maf "Beginning of Measurement Window Cyl.4" MAP 0xa081528c _REC_MAP_20_u2_u1_u1 108. _CNV_A_R_LINEAR_____200_CM 0. 108. DISPLAY_IDENTIFIER IP_KNKWB[3] FORMAT "%5.1"
 /begin AXIS_DESCR COM_AXIS n_knk _CNV_A_R_LINEAR_____10_CM 10 0. 8160. FORMAT "%4.0" AXIS_PTS_REF ldpm_n_knkwb /end AXIS_DESCR
 /begin AXIS_DESCR COM_AXIS maf_knk _CNV_A_R_LINEAR_____15_CM 4 0. 1389. FORMAT "%4.0" AXIS_PTS_REF ldpm_maf_knkwb /end AXIS_DESCR
/end CHARACTERISTIC
/begin CHARACTERISTIC ip_knkwb_4__n__maf "Beginning of Measurement Window Cyl.5" MAP 0xa08152dc _REC_MAP_20_u2_u1_u1 108. _CNV_A_R_LINEAR_____200_CM 0. 108. DISPLAY_IDENTIFIER IP_KNKWB[4] FORMAT "%5.1"
 /begin AXIS_DESCR COM_AXIS n_knk _CNV_A_R_LINEAR_____10_CM 10 0. 8160. FORMAT "%4.0" AXIS_PTS_REF ldpm_n_knkwb /end AXIS_DESCR
 /begin AXIS_DESCR COM_AXIS maf_knk _CNV_A_R_LINEAR_____15_CM 4 0. 1389. FORMAT "%4.0" AXIS_PTS_REF ldpm_maf_knkwb /end AXIS_DESCR
/end CHARACTERISTIC
/begin CHARACTERISTIC ip_knkwb_5__n__maf "Beginning of Measurement Window Cyl.6" MAP 0xa081532c _REC_MAP_20_u2_u1_u1 108. _CNV_A_R_LINEAR_____200_CM 0. 108. DISPLAY_IDENTIFIER IP_KNKWB[5] FORMAT "%5.1"
 /begin AXIS_DESCR COM_AXIS n_knk _CNV_A_R_LINEAR_____10_CM 10 0. 8160. FORMAT "%4.0" AXIS_PTS_REF ldpm_n_knkwb /end AXIS_DESCR
 /begin AXIS_DESCR COM_AXIS maf_knk _CNV_A_R_LINEAR_____15_CM 4 0. 1389. FORMAT "%4.0" AXIS_PTS_REF ldpm_maf_knkwb /end AXIS_DESCR
/end CHARACTERISTIC
/begin CHARACTERISTIC ip_knkwb_6__n__maf "Beginning of Measurement Window Cyl.7" MAP 0xa081537c _REC_MAP_20_u2_u1_u1 108. _CNV_A_R_LINEAR_____200_CM 0. 108. DISPLAY_IDENTIFIER IP_KNKWB[6] FORMAT "%5.1"
 /begin AXIS_DESCR COM_AXIS n_knk _CNV_A_R_LINEAR_____10_CM 10 0. 8160. FORMAT "%4.0" AXIS_PTS_REF ldpm_n_knkwb /end AXIS_DESCR
 /begin AXIS_DESCR COM_AXIS maf_knk _CNV_A_R_LINEAR_____15_CM 4 0. 1389. FORMAT "%4.0" AXIS_PTS_REF ldpm_maf_knkwb /end AXIS_DESCR
/end CHARACTERISTIC
/begin CHARACTERISTIC ip_knkwb_7__n__maf "Beginning of Measurement Window Cyl.8" MAP 0xa08153cc _REC_MAP_20_u2_u1_u1 108. _CNV_A_R_LINEAR_____200_CM 0. 108. DISPLAY_IDENTIFIER IP_KNKWB[7] FORMAT "%5.1"
 /begin AXIS_DESCR COM_AXIS n_knk _CNV_A_R_LINEAR_____10_CM 10 0. 8160. FORMAT "%4.0" AXIS_PTS_REF ldpm_n_knkwb /end AXIS_DESCR
 /begin AXIS_DESCR COM_AXIS maf_knk _CNV_A_R_LINEAR_____15_CM 4 0. 1389. FORMAT "%4.0" AXIS_PTS_REF ldpm_maf_knkwb /end AXIS_DESCR
/end CHARACTERISTIC
/begin CHARACTERISTIC ip_knkwe_0__n__maf "End of Measurement Window Cyl.1" MAP 0xa081541c _REC_MAP_20_u2_u1_u1 113.625 _CNV_A_R_LINEAR_____200_CM 0.375 114. DISPLAY_IDENTIFIER IP_KNKWE[0] FORMAT "%5.1"
 /begin AXIS_DESCR COM_AXIS n_knk _CNV_A_R_LINEAR_____10_CM 10 0. 8160. FORMAT "%4.0" AXIS_PTS_REF ldpm_n_knkwb /end AXIS_DESCR
 /begin AXIS_DESCR COM_AXIS maf_knk _CNV_A_R_LINEAR_____15_CM 4 0. 1389. FORMAT "%4.0" AXIS_PTS_REF ldpm_maf_knkwb /end AXIS_DESCR
/end CHARACTERISTIC
/begin CHARACTERISTIC ip_knkwe_1__n__maf "End of Measurement Window Cyl.2" MAP 0xa081546c _REC_MAP_20_u2_u1_u1 113.625 _CNV_A_R_LINEAR_____200_CM 0.375 114. DISPLAY_IDENTIFIER IP_KNKWE[1] FORMAT "%5.1"
 /begin AXIS_DESCR COM_AXIS n_knk _CNV_A_R_LINEAR_____10_CM 10 0. 8160. FORMAT "%4.0" AXIS_PTS_REF ldpm_n_knkwb /end AXIS_DESCR
 /begin AXIS_DESCR COM_AXIS maf_knk _CNV_A_R_LINEAR_____15_CM 4 0. 1389. FORMAT "%4.0" AXIS_PTS_REF ldpm_maf_knkwb /end AXIS_DESCR
/end CHARACTERISTIC
/begin CHARACTERISTIC ip_knkwe_2__n__maf "End of Measurement Window Cyl.3" MAP 0xa08154bc _REC_MAP_20_u2_u1_u1 113.625 _CNV_A_R_LINEAR_____200_CM 0.375 114. DISPLAY_IDENTIFIER IP_KNKWE[2] FORMAT "%5.1"
 /begin AXIS_DESCR COM_AXIS n_knk _CNV_A_R_LINEAR_____10_CM 10 0. 8160. FORMAT "%4.0" AXIS_PTS_REF ldpm_n_knkwb /end AXIS_DESCR
 /begin AXIS_DESCR COM_AXIS maf_knk _CNV_A_R_LINEAR_____15_CM 4 0. 1389. FORMAT "%4.0" AXIS_PTS_REF ldpm_maf_knkwb /end AXIS_DESCR
/end CHARACTERISTIC
/begin CHARACTERISTIC ip_knkwe_3__n__maf "End of Measurement Window Cyl.4" MAP 0xa081550c _REC_MAP_20_u2_u1_u1 113.625 _CNV_A_R_LINEAR_____200_CM 0.375 114. DISPLAY_IDENTIFIER IP_KNKWE[3] FORMAT "%5.1"
 /begin AXIS_DESCR COM_AXIS n_knk _CNV_A_R_LINEAR_____10_CM 10 0. 8160. FORMAT "%4.0" AXIS_PTS_REF ldpm_n_knkwb /end AXIS_DESCR
 /begin AXIS_DESCR COM_AXIS maf_knk _CNV_A_R_LINEAR_____15_CM 4 0. 1389. FORMAT "%4.0" AXIS_PTS_REF ldpm_maf_knkwb /end AXIS_DESCR
/end CHARACTERISTIC
/begin CHARACTERISTIC ip_knkwe_4__n__maf "End of Measurement Window Cyl.5" MAP 0xa081555c _REC_MAP_20_u2_u1_u1 113.625 _CNV_A_R_LINEAR_____200_CM 0.375 114. DISPLAY_IDENTIFIER IP_KNKWE[4] FORMAT "%5.1"
 /begin AXIS_DESCR COM_AXIS n_knk _CNV_A_R_LINEAR_____10_CM 10 0. 8160. FORMAT "%4.0" AXIS_PTS_REF ldpm_n_knkwb /end AXIS_DESCR
 /begin AXIS_DESCR COM_AXIS maf_knk _CNV_A_R_LINEAR_____15_CM 4 0. 1389. FORMAT "%4.0" AXIS_PTS_REF ldpm_maf_knkwb /end AXIS_DESCR
/end CHARACTERISTIC
/begin CHARACTERISTIC ip_knkwe_5__n__maf "End of Measurement Window Cyl.6" MAP 0xa08155ac _REC_MAP_20_u2_u1_u1 113.625 _CNV_A_R_LINEAR_____200_CM 0.375 114. DISPLAY_IDENTIFIER IP_KNKWE[5] FORMAT "%5.1"
 /begin AXIS_DESCR COM_AXIS n_knk _CNV_A_R_LINEAR_____10_CM 10 0. 8160. FORMAT "%4.0" AXIS_PTS_REF ldpm_n_knkwb /end AXIS_DESCR
 /begin AXIS_DESCR COM_AXIS maf_knk _CNV_A_R_LINEAR_____15_CM 4 0. 1389. FORMAT "%4.0" AXIS_PTS_REF ldpm_maf_knkwb /end AXIS_DESCR
/end CHARACTERISTIC
/begin CHARACTERISTIC ip_knkwe_6__n__maf "End of Measurement Window Cyl.7" MAP 0xa08155fc _REC_MAP_20_u2_u1_u1 113.625 _CNV_A_R_LINEAR_____200_CM 0.375 114. DISPLAY_IDENTIFIER IP_KNKWE[6] FORMAT "%5.1"
 /begin AXIS_DESCR COM_AXIS n_knk _CNV_A_R_LINEAR_____10_CM 10 0. 8160. FORMAT "%4.0" AXIS_PTS_REF ldpm_n_knkwb /end AXIS_DESCR
 /begin AXIS_DESCR COM_AXIS maf_knk _CNV_A_R_LINEAR_____15_CM 4 0. 1389. FORMAT "%4.0" AXIS_PTS_REF ldpm_maf_knkwb /end AXIS_DESCR
/end CHARACTERISTIC
/begin CHARACTERISTIC ip_knkwe_7__n__maf "End of Measurement Window Cyl.8" MAP 0xa081564c _REC_MAP_20_u2_u1_u1 113.625 _CNV_A_R_LINEAR_____200_CM 0.375 114. DISPLAY_IDENTIFIER IP_KNKWE[7] FORMAT "%5.1"
 /begin AXIS_DESCR COM_AXIS n_knk _CNV_A_R_LINEAR_____10_CM 10 0. 8160. FORMAT "%4.0" AXIS_PTS_REF ldpm_n_knkwb /end AXIS_DESCR
 /begin AXIS_DESCR COM_AXIS maf_knk _CNV_A_R_LINEAR_____15_CM 4 0. 1389. FORMAT "%4.0" AXIS_PTS_REF ldpm_maf_knkwb /end AXIS_DESCR
/end CHARACTERISTIC
/begin CHARACTERISTIC ip_gain_knk_0__n__maf "Amplification precontrol Cyl.1" MAP 0xa0814b3c _REC_MAP_20_u1_u1_u1 63. _CNV_A_R_LINEAR_____0_CM 0. 63. DISPLAY_IDENTIFIER IP_GAIN_KNK[0] FORMAT "%2.0"
 /begin AXIS_DESCR COM_AXIS n_knk _CNV_A_R_LINEAR_____10_CM 16 0. 8160. FORMAT "%4.0" AXIS_PTS_REF ldpm_n_2_9 /end AXIS_DESCR
 /begin AXIS_DESCR COM_AXIS maf_knk _CNV_A_R_LINEAR_____15_CM 8 0. 1389. FORMAT "%4.0" AXIS_PTS_REF ldpm_maf_gain_knk /end AXIS_DESCR
/end CHARACTERISTIC
/begin CHARACTERISTIC ip_gain_knk_2__n__maf "Amplification precontrol Cyl.3" MAP 0xa0814c3c _REC_MAP_20_u1_u1_u1 63. _CNV_A_R_LINEAR_____0_CM 0. 63. DISPLAY_IDENTIFIER IP_GAIN_KNK[2] FORMAT "%2.0"
 /begin AXIS_DESCR COM_AXIS n_knk _CNV_A_R_LINEAR_____10_CM 16 0. 8160. FORMAT "%4.0" AXIS_PTS_REF ldpm_n_2_9 /end AXIS_DESCR
 /begin AXIS_DESCR COM_AXIS maf_knk _CNV_A_R_LINEAR_____15_CM 8 0. 1389. FORMAT "%4.0" AXIS_PTS_REF ldpm_maf_gain_knk /end AXIS_DESCR
/end CHARACTERISTIC
/begin CHARACTERISTIC ip_gain_knk_3__n__maf "Amplification precontrol Cyl.4" MAP 0xa0814cbc _REC_MAP_20_u1_u1_u1 63. _CNV_A_R_LINEAR_____0_CM 0. 63. DISPLAY_IDENTIFIER IP_GAIN_KNK[3] FORMAT "%2.0"
 /begin AXIS_DESCR COM_AXIS n_knk _CNV_A_R_LINEAR_____10_CM 16 0. 8160. FORMAT "%4.0" AXIS_PTS_REF ldpm_n_2_9 /end AXIS_DESCR
 /begin AXIS_DESCR COM_AXIS maf_knk _CNV_A_R_LINEAR_____15_CM 8 0. 1389. FORMAT "%4.0" AXIS_PTS_REF ldpm_maf_gain_knk /end AXIS_DESCR
/end CHARACTERISTIC
/begin CHARACTERISTIC ip_gain_knk_4__n__maf "Amplification precontrol Cyl.5" MAP 0xa0814d3c _REC_MAP_20_u1_u1_u1 63. _CNV_A_R_LINEAR_____0_CM 0. 63. DISPLAY_IDENTIFIER IP_GAIN_KNK[4] FORMAT "%2.0"
 /begin AXIS_DESCR COM_AXIS n_knk _CNV_A_R_LINEAR_____10_CM 16 0. 8160. FORMAT "%4.0" AXIS_PTS_REF ldpm_n_2_9 /end AXIS_DESCR
 /begin AXIS_DESCR COM_AXIS maf_knk _CNV_A_R_LINEAR_____15_CM 8 0. 1389. FORMAT "%4.0" AXIS_PTS_REF ldpm_maf_gain_knk /end AXIS_DESCR
/end CHARACTERISTIC
/begin CHARACTERISTIC ip_gain_knk_5__n__maf "Amplification precontrol Cyl.6" MAP 0xa0814dbc _REC_MAP_20_u1_u1_u1 63. _CNV_A_R_LINEAR_____0_CM 0. 63. DISPLAY_IDENTIFIER IP_GAIN_KNK[5] FORMAT "%2.0"
 /begin AXIS_DESCR COM_AXIS n_knk _CNV_A_R_LINEAR_____10_CM 16 0. 8160. FORMAT "%4.0" AXIS_PTS_REF ldpm_n_2_9 /end AXIS_DESCR
 /begin AXIS_DESCR COM_AXIS maf_knk _CNV_A_R_LINEAR_____15_CM 8 0. 1389. FORMAT "%4.0" AXIS_PTS_REF ldpm_maf_gain_knk /end AXIS_DESCR
/end CHARACTERISTIC
/begin CHARACTERISTIC ip_gain_knk_6__n__maf "Amplification precontrol Cyl.7" MAP 0xa0814e3c _REC_MAP_20_u1_u1_u1 63. _CNV_A_R_LINEAR_____0_CM 0. 63. DISPLAY_IDENTIFIER IP_GAIN_KNK[6] FORMAT "%2.0"
 /begin AXIS_DESCR COM_AXIS n_knk _CNV_A_R_LINEAR_____10_CM 16 0. 8160. FORMAT "%4.0" AXIS_PTS_REF ldpm_n_2_9 /end AXIS_DESCR
 /begin AXIS_DESCR COM_AXIS maf_knk _CNV_A_R_LINEAR_____15_CM 8 0. 1389. FORMAT "%4.0" AXIS_PTS_REF ldpm_maf_gain_knk /end AXIS_DESCR
/end CHARACTERISTIC
/begin CHARACTERISTIC ip_gain_knk_7__n__maf "Amplification precontrol Cyl.8" MAP 0xa0814ebc _REC_MAP_20_u1_u1_u1 63. _CNV_A_R_LINEAR_____0_CM 0. 63. DISPLAY_IDENTIFIER IP_GAIN_KNK[7] FORMAT "%2.0"
 /begin AXIS_DESCR COM_AXIS n_knk _CNV_A_R_LINEAR_____10_CM 16 0. 8160. FORMAT "%4.0" AXIS_PTS_REF ldpm_n_2_9 /end AXIS_DESCR
 /begin AXIS_DESCR COM_AXIS maf_knk _CNV_A_R_LINEAR_____15_CM 8 0. 1389. FORMAT "%4.0" AXIS_PTS_REF ldpm_maf_gain_knk /end AXIS_DESCR
/end CHARACTERISTIC
/begin CHARACTERISTIC ip_knkwb_0__n__maf "Beginning of Measurement Window Cyl.1" MAP 0xa081519c _REC_MAP_20_u2_u1_u1 108. _CNV_A_R_LINEAR_____200_CM 0. 108. DISPLAY_IDENTIFIER IP_KNKWB[0] FORMAT "%5.1"
 /begin AXIS_DESCR COM_AXIS n_knk _CNV_A_R_LINEAR_____10_CM 10 0. 8160. FORMAT "%4.0" AXIS_PTS_REF ldpm_n_knkwb /end AXIS_DESCR
 /begin AXIS_DESCR COM_AXIS maf_knk _CNV_A_R_LINEAR_____15_CM 4 0. 1389. FORMAT "%4.0" AXIS_PTS_REF ldpm_maf_knkwb /end AXIS_DESCR
/end CHARACTERISTIC
/begin CHARACTERISTIC id_itc_knk_0__n__maf "Integration time constant Cyl.1" MAP 0xa08099e4 _REC_MAP_20_u1_u1_u1 31. _CNV_A_R_LINEAR_____0_CM 0. 31. DISPLAY_IDENTIFIER ID_ITC_KNK[0] FORMAT "%2.0"
 /begin AXIS_DESCR COM_AXIS n_knk _CNV_A_R_LINEAR_____10_CM 16 0. 8160. FORMAT "%4.0" AXIS_PTS_REF ldpm_n_2_9 /end AXIS_DESCR
 /begin AXIS_DESCR COM_AXIS maf_knk _CNV_A_R_LINEAR_____15_CM 4 0. 1389. FORMAT "%4.0" AXIS_PTS_REF ldpm_maf_1_9 /end AXIS_DESCR
/end CHARACTERISTIC
/begin CHARACTERISTIC id_itc_knk_1__n__maf "Integration time constant Cyl.2" MAP 0xa0809a24 _REC_MAP_20_u1_u1_u1 31. _CNV_A_R_LINEAR_____0_CM 0. 31. DISPLAY_IDENTIFIER ID_ITC_KNK[1] FORMAT "%2.0"
 /begin AXIS_DESCR COM_AXIS n_knk _CNV_A_R_LINEAR_____10_CM 16 0. 8160. FORMAT "%4.0" AXIS_PTS_REF ldpm_n_2_9 /end AXIS_DESCR
 /begin AXIS_DESCR COM_AXIS maf_knk _CNV_A_R_LINEAR_____15_CM 4 0. 1389. FORMAT "%4.0" AXIS_PTS_REF ldpm_maf_1_9 /end AXIS_DESCR
/end CHARACTERISTIC
/begin CHARACTERISTIC id_itc_knk_2__n__maf "Integration time constant Cyl.3" MAP 0xa0809a64 _REC_MAP_20_u1_u1_u1 31. _CNV_A_R_LINEAR_____0_CM 0. 31. DISPLAY_IDENTIFIER ID_ITC_KNK[2] FORMAT "%2.0"
 /begin AXIS_DESCR COM_AXIS n_knk _CNV_A_R_LINEAR_____10_CM 16 0. 8160. FORMAT "%4.0" AXIS_PTS_REF ldpm_n_2_9 /end AXIS_DESCR
 /begin AXIS_DESCR COM_AXIS maf_knk _CNV_A_R_LINEAR_____15_CM 4 0. 1389. FORMAT "%4.0" AXIS_PTS_REF ldpm_maf_1_9 /end AXIS_DESCR
/end CHARACTERISTIC
/begin CHARACTERISTIC id_itc_knk_3__n__maf "Integration time constant Cyl.4" MAP 0xa0809aa4 _REC_MAP_20_u1_u1_u1 31. _CNV_A_R_LINEAR_____0_CM 0. 31. DISPLAY_IDENTIFIER ID_ITC_KNK[3] FORMAT "%2.0"
 /begin AXIS_DESCR COM_AXIS n_knk _CNV_A_R_LINEAR_____10_CM 16 0. 8160. FORMAT "%4.0" AXIS_PTS_REF ldpm_n_2_9 /end AXIS_DESCR
 /begin AXIS_DESCR COM_AXIS maf_knk _CNV_A_R_LINEAR_____15_CM 4 0. 1389. FORMAT "%4.0" AXIS_PTS_REF ldpm_maf_1_9 /end AXIS_DESCR
/end CHARACTERISTIC
/begin CHARACTERISTIC id_itc_knk_4__n__maf "Integration time constant Cyl.5" MAP 0xa0809ae4 _REC_MAP_20_u1_u1_u1 31. _CNV_A_R_LINEAR_____0_CM 0. 31. DISPLAY_IDENTIFIER ID_ITC_KNK[4] FORMAT "%2.0"
 /begin AXIS_DESCR COM_AXIS n_knk _CNV_A_R_LINEAR_____10_CM 16 0. 8160. FORMAT "%4.0" AXIS_PTS_REF ldpm_n_2_9 /end AXIS_DESCR
 /begin AXIS_DESCR COM_AXIS maf_knk _CNV_A_R_LINEAR_____15_CM 4 0. 1389. FORMAT "%4.0" AXIS_PTS_REF ldpm_maf_1_9 /end AXIS_DESCR
/end CHARACTERISTIC
/begin CHARACTERISTIC id_itc_knk_5__n__maf "Integration time constant Cyl.6" MAP 0xa0809b24 _REC_MAP_20_u1_u1_u1 31. _CNV_A_R_LINEAR_____0_CM 0. 31. DISPLAY_IDENTIFIER ID_ITC_KNK[5] FORMAT "%2.0"
 /begin AXIS_DESCR COM_AXIS n_knk _CNV_A_R_LINEAR_____10_CM 16 0. 8160. FORMAT "%4.0" AXIS_PTS_REF ldpm_n_2_9 /end AXIS_DESCR
 /begin AXIS_DESCR COM_AXIS maf_knk _CNV_A_R_LINEAR_____15_CM 4 0. 1389. FORMAT "%4.0" AXIS_PTS_REF ldpm_maf_1_9 /end AXIS_DESCR
/end CHARACTERISTIC
/begin CHARACTERISTIC id_itc_knk_6__n__maf "Integration time constant Cyl.7" MAP 0xa0809b64 _REC_MAP_20_u1_u1_u1 31. _CNV_A_R_LINEAR_____0_CM 0. 31. DISPLAY_IDENTIFIER ID_ITC_KNK[6] FORMAT "%2.0"
 /begin AXIS_DESCR COM_AXIS n_knk _CNV_A_R_LINEAR_____10_CM 16 0. 8160. FORMAT "%4.0" AXIS_PTS_REF ldpm_n_2_9 /end AXIS_DESCR
 /begin AXIS_DESCR COM_AXIS maf_knk _CNV_A_R_LINEAR_____15_CM 4 0. 1389. FORMAT "%4.0" AXIS_PTS_REF ldpm_maf_1_9 /end AXIS_DESCR
/end CHARACTERISTIC
/begin CHARACTERISTIC id_itc_knk_7__n__maf "Integration time constant Cyl.8" MAP 0xa0809ba4 _REC_MAP_20_u1_u1_u1 31. _CNV_A_R_LINEAR_____0_CM 0. 31. DISPLAY_IDENTIFIER ID_ITC_KNK[7] FORMAT "%2.0"
 /begin AXIS_DESCR COM_AXIS n_knk _CNV_A_R_LINEAR_____10_CM 16 0. 8160. FORMAT "%4.0" AXIS_PTS_REF ldpm_n_2_9 /end AXIS_DESCR
 /begin AXIS_DESCR COM_AXIS maf_knk _CNV_A_R_LINEAR_____15_CM 4 0. 1389. FORMAT "%4.0" AXIS_PTS_REF ldpm_maf_1_9 /end AXIS_DESCR
/end CHARACTERISTIC
/begin CHARACTERISTIC c_knks_1_diag "Assignment of cylinder number to knock sensor 1 (diagnosis only)" VALUE 0xa080bdb8 _REC_VAL_20_u1 255. _CNV_A_R_LINEAR_____0_CM 0. 255. DISPLAY_IDENTIFIER C_KNKS_1_DIAG FORMAT "%3.0" /end CHARACTERISTIC
/begin CHARACTERISTIC c_knks_2_diag "Assignment of cylinder number to knock sensor 2 (diagnosis only)" VALUE 0xa080bdb9 _REC_VAL_20_u1 255. _CNV_A_R_LINEAR_____0_CM 0. 255. DISPLAY_IDENTIFIER C_KNKS_2_DIAG FORMAT "%3.0" /end CHARACTERISTIC
/begin CHARACTERISTIC c_knks_3_diag "Assignment of cylinder number to knock sensor 1 (diagnosis only)" VALUE 0xa080bdba _REC_VAL_20_u1 255. _CNV_A_R_LINEAR_____0_CM 0. 255. DISPLAY_IDENTIFIER C_KNKS_3_DIAG FORMAT "%3.0" /end CHARACTERISTIC
/begin CHARACTERISTIC c_knks_4_diag "Assignment of cylinder number to knock sensor 2 (diagnosis only)" VALUE 0xa080bdbb _REC_VAL_20_u1 255. _CNV_A_R_LINEAR_____0_CM 0. 255. DISPLAY_IDENTIFIER C_KNKS_4_DIAG FORMAT "%3.0" /end CHARACTERISTIC
/begin CHARACTERISTIC c_knks_cyl_conf "Configuration of the knock sensors and the cylinders" VALUE 0xa080bdbc _REC_VAL_20_u1 1. _CNV_A_R_LINEAR_____0_CM 0. 1. DISPLAY_IDENTIFIER C_KNKS_CYL_CONF FORMAT "%1.0" /end CHARACTERISTIC
/begin MEASUREMENT maf_knk "Mass air flow with hysteresis" UBYTE _CNV_A_R_LINEAR_____15_CM 1 100. 0. 1389. DISPLAY_IDENTIFIER MAF_KNK ECU_ADDRESS 0xd0008c38 FORMAT "%7.2" /end MEASUREMENT
/begin CHARACTERISTIC ip_knk_thd_add_n "Knock summand" CURVE 0xa080ada0 _REC_CUR_20_u1_u1 5.1 _CNV_A_R_LINEAR_____203_CM -2.56 2.54 DISPLAY_IDENTIFIER IP_KNK_THD_ADD_N FORMAT "%4.2"
 /begin AXIS_DESCR COM_AXIS n_knk _CNV_A_R_LINEAR_____10_CM 16 0. 8160. FORMAT "%4.0" AXIS_PTS_REF ldpm_n_2_9 /end AXIS_DESCR
/end CHARACTERISTIC
/begin AXIS_PTS ldpm_maf_1_9 "" 0xa0809472 maf_knk _REC_AXS_20_u1 69.45 _CNV_A_R_LINEAR_____15_CM 4 0. 1389. FORMAT "%4.0" /end AXIS_PTS
/begin AXIS_PTS ldpm_maf_gain_knk "" 0xa08094d8 maf_knk _REC_AXS_20_u1 69.45 _CNV_A_R_LINEAR_____15_CM 8 0. 1389. FORMAT "%4.0" /end AXIS_PTS
/begin MEASUREMENT state_cmb_ctl_tmp "States of the combustion management" UBYTE _CNV_S_9_RANGE_STAT_204_CM 1 100. 0. 8. DISPLAY_IDENTIFIER STATE_CMB_CTL_TMP ECU_ADDRESS 0xd00010c7 /end MEASUREMENT
/begin MEASUREMENT state_cmb_ctl_knk "States of the combustion management to be saved for further use" UBYTE _CNV_S_9_RANGE_STAT_204_CM 1 100. 0. 8. DISPLAY_IDENTIFIER STATE_CMB_CTL_KNK ECU_ADDRESS 0xd00010c8 /end MEASUREMENT
/begin MEASUREMENT lv_ctr_knk_cmb "Logical variable to enable counter after combustion mode change" UBYTE _CNV_S_2_RANGE__0___1_CM 1 100. 0. 1. DISPLAY_IDENTIFIER LV_CTR_KNK_CMB ECU_ADDRESS 0xd00010ca BIT_MASK 0x1 /end MEASUREMENT
/begin MEASUREMENT ctr_knk_cmb "Counter to disable KNK control after combustion mode switch" UBYTE _CNV_A_R_LINEAR_____0_CM 1 100. 0. 255. DISPLAY_IDENTIFIER CTR_KNK_CMB ECU_ADDRESS 0xd00010c6 FORMAT "%3.0" /end MEASUREMENT
/begin CHARACTERISTIC id_ctr_knk_cmb "Counter to disable KNK control after combustion mode switch" CURVE 0xa0809944 _REC_CUR_20_u1_u1 255. _CNV_A_R_LINEAR_____0_CM 0. 255. DISPLAY_IDENTIFIER ID_CTR_KNK_CMB FORMAT "%4.1"
 /begin AXIS_DESCR COM_AXIS state_cmb_ctl_knk _CNV_A_R_LINEAR_____0_CM 9 0. 255. FORMAT "%3.0" AXIS_PTS_REF ldp_state_cmb_ctl_knk /end AXIS_DESCR
/end CHARACTERISTIC
/begin AXIS_PTS ldp_state_cmb_ctl_knk "" 0xa0808c8c state_cmb_ctl_knk _REC_AXS_20_u1 255. _CNV_A_R_LINEAR_____0_CM 9 0. 255. FORMAT "%3.0" /end AXIS_PTS
/begin CHARACTERISTIC c_nl_crlc_cmb "Averaging Constant for Noise Value Calculation at HOM_AFS combustion" VALUE 0xa080bfe5 _REC_VAL_20_u1 0.99609375 _CNV_A_R_LINEAR_____28_CM 0. 0.99609375 DISPLAY_IDENTIFIER C_NL_CRLC_CMB FORMAT "%5.3" /end CHARACTERISTIC
/begin MEASUREMENT lv_knk_tra_n "Logical variable for Engine Speed Dynamic Function active or passive" UBYTE _CNV_S_2_RANGE__0___1_CM 1 100. 0. 1. DISPLAY_IDENTIFIER LV_KNK_TRA_N ECU_ADDRESS 0xd0008c79 BIT_MASK 0x1 /end MEASUREMENT
/begin MEASUREMENT lv_iga_dif_max_knk "Indicator for excursion limit analysis (knock ignition angle of one cylinder is at maximum deviation limit from mean value)" UBYTE _CNV_S_2_RANGE__0___1_CM 1 100. 0. 1. DISPLAY_IDENTIFIER LV_IGA_DIF_MAX_KNK ECU_ADDRESS 0xd0008c7a BIT_MASK 0x1 /end MEASUREMENT
/begin MEASUREMENT knk_ctl_dis "knock control disabled due to malfunctions" UBYTE _CNV_S_2_RANGE__0___1_CM 1 100. 0. 1. DISPLAY_IDENTIFIER KNK_CTL_DIS ECU_ADDRESS 0xd0008c7c /end MEASUREMENT
/begin CHARACTERISTIC c_iga_lgrd_3 "gradient limitation when  underspending knock load threshold" VALUE 0xa080bdb4 _REC_VAL_20_u2 47.99853 _CNV_A_R_LINEAR_____205_CM 0. 47.99853 DISPLAY_IDENTIFIER C_IGA_LGRD_3 /end CHARACTERISTIC
/begin MEASUREMENT ctr_iga_dif_max_knk[0] "Counter for number of occured excursion limit events (cylinder individual)" UBYTE _CNV_A_R_LINEAR_____0_CM 1 100. 0. 255. DISPLAY_IDENTIFIER CTR_IGA_DIF_MAX_KNK[0] ECU_ADDRESS 0xd00010cc FORMAT "%3.0" /end MEASUREMENT
/begin MEASUREMENT ctr_iga_dif_max_knk[1] "Counter for number of occured excursion limit events (cylinder individual)" UBYTE _CNV_A_R_LINEAR_____0_CM 1 100. 0. 255. DISPLAY_IDENTIFIER CTR_IGA_DIF_MAX_KNK[1] ECU_ADDRESS 0xd00010cd FORMAT "%3.0" /end MEASUREMENT
/begin MEASUREMENT ctr_iga_dif_max_knk[2] "Counter for number of occured excursion limit events (cylinder individual)" UBYTE _CNV_A_R_LINEAR_____0_CM 1 100. 0. 255. DISPLAY_IDENTIFIER CTR_IGA_DIF_MAX_KNK[2] ECU_ADDRESS 0xd00010ce FORMAT "%3.0" /end MEASUREMENT
/begin MEASUREMENT ctr_iga_dif_max_knk[3] "Counter for number of occured excursion limit events (cylinder individual)" UBYTE _CNV_A_R_LINEAR_____0_CM 1 100. 0. 255. DISPLAY_IDENTIFIER CTR_IGA_DIF_MAX_KNK[3] ECU_ADDRESS 0xd00010cf FORMAT "%3.0" /end MEASUREMENT
/begin MEASUREMENT ctr_iga_dif_max_knk[4] "Counter for number of occured excursion limit events (cylinder individual)" UBYTE _CNV_A_R_LINEAR_____0_CM 1 100. 0. 255. DISPLAY_IDENTIFIER CTR_IGA_DIF_MAX_KNK[4] ECU_ADDRESS 0xd00010d0 FORMAT "%3.0" /end MEASUREMENT
/begin MEASUREMENT ctr_iga_dif_max_knk[5] "Counter for number of occured excursion limit events (cylinder individual)" UBYTE _CNV_A_R_LINEAR_____0_CM 1 100. 0. 255. DISPLAY_IDENTIFIER CTR_IGA_DIF_MAX_KNK[5] ECU_ADDRESS 0xd00010d1 FORMAT "%3.0" /end MEASUREMENT
/begin MEASUREMENT ctr_iga_dif_max_knk[6] "Counter for number of occured excursion limit events (cylinder individual)" UBYTE _CNV_A_R_LINEAR_____0_CM 1 100. 0. 255. DISPLAY_IDENTIFIER CTR_IGA_DIF_MAX_KNK[6] ECU_ADDRESS 0xd00010d2 FORMAT "%3.0" /end MEASUREMENT
/begin MEASUREMENT ctr_iga_dif_max_knk[7] "Counter for number of occured excursion limit events (cylinder individual)" UBYTE _CNV_A_R_LINEAR_____0_CM 1 100. 0. 255. DISPLAY_IDENTIFIER CTR_IGA_DIF_MAX_KNK[7] ECU_ADDRESS 0xd00010d3 FORMAT "%3.0" /end MEASUREMENT
/begin MEASUREMENT n_iga_dif_max_knk[0] "Freeze frame for engine speed when excursion limit event occurs" UBYTE _CNV_A_R_LINEAR_____10_CM 1 100. 0. 8160. DISPLAY_IDENTIFIER N_IGA_DIF_MAX_KNK[0] ECU_ADDRESS 0xd00010d4 FORMAT "%4.0" /end MEASUREMENT
/begin MEASUREMENT n_iga_dif_max_knk[1] "Freeze frame for engine speed when excursion limit event occurs" UBYTE _CNV_A_R_LINEAR_____10_CM 1 100. 0. 8160. DISPLAY_IDENTIFIER N_IGA_DIF_MAX_KNK[1] ECU_ADDRESS 0xd00010d5 FORMAT "%4.0" /end MEASUREMENT
/begin MEASUREMENT n_iga_dif_max_knk[2] "Freeze frame for engine speed when excursion limit event occurs" UBYTE _CNV_A_R_LINEAR_____10_CM 1 100. 0. 8160. DISPLAY_IDENTIFIER N_IGA_DIF_MAX_KNK[2] ECU_ADDRESS 0xd00010d6 FORMAT "%4.0" /end MEASUREMENT
/begin MEASUREMENT n_iga_dif_max_knk[3] "Freeze frame for engine speed when excursion limit event occurs" UBYTE _CNV_A_R_LINEAR_____10_CM 1 100. 0. 8160. DISPLAY_IDENTIFIER N_IGA_DIF_MAX_KNK[3] ECU_ADDRESS 0xd00010d7 FORMAT "%4.0" /end MEASUREMENT
/begin MEASUREMENT n_iga_dif_max_knk[4] "Freeze frame for engine speed when excursion limit event occurs" UBYTE _CNV_A_R_LINEAR_____10_CM 1 100. 0. 8160. DISPLAY_IDENTIFIER N_IGA_DIF_MAX_KNK[4] ECU_ADDRESS 0xd00010d8 FORMAT "%4.0" /end MEASUREMENT
/begin MEASUREMENT n_iga_dif_max_knk[5] "Freeze frame for engine speed when excursion limit event occurs" UBYTE _CNV_A_R_LINEAR_____10_CM 1 100. 0. 8160. DISPLAY_IDENTIFIER N_IGA_DIF_MAX_KNK[5] ECU_ADDRESS 0xd00010d9 FORMAT "%4.0" /end MEASUREMENT
/begin MEASUREMENT n_iga_dif_max_knk[6] "Freeze frame for engine speed when excursion limit event occurs" UBYTE _CNV_A_R_LINEAR_____10_CM 1 100. 0. 8160. DISPLAY_IDENTIFIER N_IGA_DIF_MAX_KNK[6] ECU_ADDRESS 0xd00010da FORMAT "%4.0" /end MEASUREMENT
/begin MEASUREMENT n_iga_dif_max_knk[7] "Freeze frame for engine speed when excursion limit event occurs" UBYTE _CNV_A_R_LINEAR_____10_CM 1 100. 0. 8160. DISPLAY_IDENTIFIER N_IGA_DIF_MAX_KNK[7] ECU_ADDRESS 0xd00010db FORMAT "%4.0" /end MEASUREMENT
/begin MEASUREMENT n_iga_dif_max_knk[8] "Freeze frame for engine speed when excursion limit event occurs" UBYTE _CNV_A_R_LINEAR_____10_CM 1 100. 0. 8160. DISPLAY_IDENTIFIER N_IGA_DIF_MAX_KNK[8] ECU_ADDRESS 0xd00010dc FORMAT "%4.0" /end MEASUREMENT
/begin MEASUREMENT n_iga_dif_max_knk[9] "Freeze frame for engine speed when excursion limit event occurs" UBYTE _CNV_A_R_LINEAR_____10_CM 1 100. 0. 8160. DISPLAY_IDENTIFIER N_IGA_DIF_MAX_KNK[9] ECU_ADDRESS 0xd00010dd FORMAT "%4.0" /end MEASUREMENT
/begin MEASUREMENT n_iga_dif_max_knk[10] "Freeze frame for engine speed when excursion limit event occurs" UBYTE _CNV_A_R_LINEAR_____10_CM 1 100. 0. 8160. DISPLAY_IDENTIFIER N_IGA_DIF_MAX_KNK[10] ECU_ADDRESS 0xd00010de FORMAT "%4.0" /end MEASUREMENT
/begin MEASUREMENT n_iga_dif_max_knk[11] "Freeze frame for engine speed when excursion limit event occurs" UBYTE _CNV_A_R_LINEAR_____10_CM 1 100. 0. 8160. DISPLAY_IDENTIFIER N_IGA_DIF_MAX_KNK[11] ECU_ADDRESS 0xd00010df FORMAT "%4.0" /end MEASUREMENT
/begin MEASUREMENT n_iga_dif_max_knk[12] "Freeze frame for engine speed when excursion limit event occurs" UBYTE _CNV_A_R_LINEAR_____10_CM 1 100. 0. 8160. DISPLAY_IDENTIFIER N_IGA_DIF_MAX_KNK[12] ECU_ADDRESS 0xd00010e0 FORMAT "%4.0" /end MEASUREMENT
/begin MEASUREMENT n_iga_dif_max_knk[13] "Freeze frame for engine speed when excursion limit event occurs" UBYTE _CNV_A_R_LINEAR_____10_CM 1 100. 0. 8160. DISPLAY_IDENTIFIER N_IGA_DIF_MAX_KNK[13] ECU_ADDRESS 0xd00010e1 FORMAT "%4.0" /end MEASUREMENT
/begin MEASUREMENT n_iga_dif_max_knk[14] "Freeze frame for engine speed when excursion limit event occurs" UBYTE _CNV_A_R_LINEAR_____10_CM 1 100. 0. 8160. DISPLAY_IDENTIFIER N_IGA_DIF_MAX_KNK[14] ECU_ADDRESS 0xd00010e2 FORMAT "%4.0" /end MEASUREMENT
/begin MEASUREMENT n_iga_dif_max_knk[15] "Freeze frame for engine speed when excursion limit event occurs" UBYTE _CNV_A_R_LINEAR_____10_CM 1 100. 0. 8160. DISPLAY_IDENTIFIER N_IGA_DIF_MAX_KNK[15] ECU_ADDRESS 0xd00010e3 FORMAT "%4.0" /end MEASUREMENT
/begin MEASUREMENT n_iga_dif_max_knk[16] "Freeze frame for engine speed when excursion limit event occurs" UBYTE _CNV_A_R_LINEAR_____10_CM 1 100. 0. 8160. DISPLAY_IDENTIFIER N_IGA_DIF_MAX_KNK[16] ECU_ADDRESS 0xd00010e4 FORMAT "%4.0" /end MEASUREMENT
/begin MEASUREMENT n_iga_dif_max_knk[17] "Freeze frame for engine speed when excursion limit event occurs" UBYTE _CNV_A_R_LINEAR_____10_CM 1 100. 0. 8160. DISPLAY_IDENTIFIER N_IGA_DIF_MAX_KNK[17] ECU_ADDRESS 0xd00010e5 FORMAT "%4.0" /end MEASUREMENT
/begin MEASUREMENT n_iga_dif_max_knk[18] "Freeze frame for engine speed when excursion limit event occurs" UBYTE _CNV_A_R_LINEAR_____10_CM 1 100. 0. 8160. DISPLAY_IDENTIFIER N_IGA_DIF_MAX_KNK[18] ECU_ADDRESS 0xd00010e6 FORMAT "%4.0" /end MEASUREMENT
/begin MEASUREMENT n_iga_dif_max_knk[19] "Freeze frame for engine speed when excursion limit event occurs" UBYTE _CNV_A_R_LINEAR_____10_CM 1 100. 0. 8160. DISPLAY_IDENTIFIER N_IGA_DIF_MAX_KNK[19] ECU_ADDRESS 0xd00010e7 FORMAT "%4.0" /end MEASUREMENT
/begin MEASUREMENT n_iga_dif_max_knk[20] "Freeze frame for engine speed when excursion limit event occurs" UBYTE _CNV_A_R_LINEAR_____10_CM 1 100. 0. 8160. DISPLAY_IDENTIFIER N_IGA_DIF_MAX_KNK[20] ECU_ADDRESS 0xd00010e8 FORMAT "%4.0" /end MEASUREMENT
/begin MEASUREMENT n_iga_dif_max_knk[21] "Freeze frame for engine speed when excursion limit event occurs" UBYTE _CNV_A_R_LINEAR_____10_CM 1 100. 0. 8160. DISPLAY_IDENTIFIER N_IGA_DIF_MAX_KNK[21] ECU_ADDRESS 0xd00010e9 FORMAT "%4.0" /end MEASUREMENT
/begin MEASUREMENT n_iga_dif_max_knk[22] "Freeze frame for engine speed when excursion limit event occurs" UBYTE _CNV_A_R_LINEAR_____10_CM 1 100. 0. 8160. DISPLAY_IDENTIFIER N_IGA_DIF_MAX_KNK[22] ECU_ADDRESS 0xd00010ea FORMAT "%4.0" /end MEASUREMENT
/begin MEASUREMENT n_iga_dif_max_knk[23] "Freeze frame for engine speed when excursion limit event occurs" UBYTE _CNV_A_R_LINEAR_____10_CM 1 100. 0. 8160. DISPLAY_IDENTIFIER N_IGA_DIF_MAX_KNK[23] ECU_ADDRESS 0xd00010eb FORMAT "%4.0" /end MEASUREMENT
/begin MEASUREMENT n_iga_dif_max_knk[24] "Freeze frame for engine speed when excursion limit event occurs" UBYTE _CNV_A_R_LINEAR_____10_CM 1 100. 0. 8160. DISPLAY_IDENTIFIER N_IGA_DIF_MAX_KNK[24] ECU_ADDRESS 0xd00010ec FORMAT "%4.0" /end MEASUREMENT
/begin MEASUREMENT n_iga_dif_max_knk[25] "Freeze frame for engine speed when excursion limit event occurs" UBYTE _CNV_A_R_LINEAR_____10_CM 1 100. 0. 8160. DISPLAY_IDENTIFIER N_IGA_DIF_MAX_KNK[25] ECU_ADDRESS 0xd00010ed FORMAT "%4.0" /end MEASUREMENT
/begin MEASUREMENT n_iga_dif_max_knk[26] "Freeze frame for engine speed when excursion limit event occurs" UBYTE _CNV_A_R_LINEAR_____10_CM 1 100. 0. 8160. DISPLAY_IDENTIFIER N_IGA_DIF_MAX_KNK[26] ECU_ADDRESS 0xd00010ee FORMAT "%4.0" /end MEASUREMENT
/begin MEASUREMENT n_iga_dif_max_knk[27] "Freeze frame for engine speed when excursion limit event occurs" UBYTE _CNV_A_R_LINEAR_____10_CM 1 100. 0. 8160. DISPLAY_IDENTIFIER N_IGA_DIF_MAX_KNK[27] ECU_ADDRESS 0xd00010ef FORMAT "%4.0" /end MEASUREMENT
/begin MEASUREMENT n_iga_dif_max_knk[28] "Freeze frame for engine speed when excursion limit event occurs" UBYTE _CNV_A_R_LINEAR_____10_CM 1 100. 0. 8160. DISPLAY_IDENTIFIER N_IGA_DIF_MAX_KNK[28] ECU_ADDRESS 0xd00010f0 FORMAT "%4.0" /end MEASUREMENT
/begin MEASUREMENT n_iga_dif_max_knk[29] "Freeze frame for engine speed when excursion limit event occurs" UBYTE _CNV_A_R_LINEAR_____10_CM 1 100. 0. 8160. DISPLAY_IDENTIFIER N_IGA_DIF_MAX_KNK[29] ECU_ADDRESS 0xd00010f1 FORMAT "%4.0" /end MEASUREMENT
/begin MEASUREMENT n_iga_dif_max_knk[30] "Freeze frame for engine speed when excursion limit event occurs" UBYTE _CNV_A_R_LINEAR_____10_CM 1 100. 0. 8160. DISPLAY_IDENTIFIER N_IGA_DIF_MAX_KNK[30] ECU_ADDRESS 0xd00010f2 FORMAT "%4.0" /end MEASUREMENT
/begin MEASUREMENT n_iga_dif_max_knk[31] "Freeze frame for engine speed when excursion limit event occurs" UBYTE _CNV_A_R_LINEAR_____10_CM 1 100. 0. 8160. DISPLAY_IDENTIFIER N_IGA_DIF_MAX_KNK[31] ECU_ADDRESS 0xd00010f3 FORMAT "%4.0" /end MEASUREMENT
/begin MEASUREMENT n_iga_dif_max_knk[32] "Freeze frame for engine speed when excursion limit event occurs" UBYTE _CNV_A_R_LINEAR_____10_CM 1 100. 0. 8160. DISPLAY_IDENTIFIER N_IGA_DIF_MAX_KNK[32] ECU_ADDRESS 0xd00010f4 FORMAT "%4.0" /end MEASUREMENT
/begin MEASUREMENT n_iga_dif_max_knk[33] "Freeze frame for engine speed when excursion limit event occurs" UBYTE _CNV_A_R_LINEAR_____10_CM 1 100. 0. 8160. DISPLAY_IDENTIFIER N_IGA_DIF_MAX_KNK[33] ECU_ADDRESS 0xd00010f5 FORMAT "%4.0" /end MEASUREMENT
/begin MEASUREMENT n_iga_dif_max_knk[34] "Freeze frame for engine speed when excursion limit event occurs" UBYTE _CNV_A_R_LINEAR_____10_CM 1 100. 0. 8160. DISPLAY_IDENTIFIER N_IGA_DIF_MAX_KNK[34] ECU_ADDRESS 0xd00010f6 FORMAT "%4.0" /end MEASUREMENT
/begin MEASUREMENT n_iga_dif_max_knk[35] "Freeze frame for engine speed when excursion limit event occurs" UBYTE _CNV_A_R_LINEAR_____10_CM 1 100. 0. 8160. DISPLAY_IDENTIFIER N_IGA_DIF_MAX_KNK[35] ECU_ADDRESS 0xd00010f7 FORMAT "%4.0" /end MEASUREMENT
/begin MEASUREMENT n_iga_dif_max_knk[36] "Freeze frame for engine speed when excursion limit event occurs" UBYTE _CNV_A_R_LINEAR_____10_CM 1 100. 0. 8160. DISPLAY_IDENTIFIER N_IGA_DIF_MAX_KNK[36] ECU_ADDRESS 0xd00010f8 FORMAT "%4.0" /end MEASUREMENT
/begin MEASUREMENT n_iga_dif_max_knk[37] "Freeze frame for engine speed when excursion limit event occurs" UBYTE _CNV_A_R_LINEAR_____10_CM 1 100. 0. 8160. DISPLAY_IDENTIFIER N_IGA_DIF_MAX_KNK[37] ECU_ADDRESS 0xd00010f9 FORMAT "%4.0" /end MEASUREMENT
/begin MEASUREMENT n_iga_dif_max_knk[38] "Freeze frame for engine speed when excursion limit event occurs" UBYTE _CNV_A_R_LINEAR_____10_CM 1 100. 0. 8160. DISPLAY_IDENTIFIER N_IGA_DIF_MAX_KNK[38] ECU_ADDRESS 0xd00010fa FORMAT "%4.0" /end MEASUREMENT
/begin MEASUREMENT n_iga_dif_max_knk[39] "Freeze frame for engine speed when excursion limit event occurs" UBYTE _CNV_A_R_LINEAR_____10_CM 1 100. 0. 8160. DISPLAY_IDENTIFIER N_IGA_DIF_MAX_KNK[39] ECU_ADDRESS 0xd00010fb FORMAT "%4.0" /end MEASUREMENT
/begin MEASUREMENT n_iga_dif_max_knk[40] "Freeze frame for engine speed when excursion limit event occurs" UBYTE _CNV_A_R_LINEAR_____10_CM 1 100. 0. 8160. DISPLAY_IDENTIFIER N_IGA_DIF_MAX_KNK[40] ECU_ADDRESS 0xd00010fc FORMAT "%4.0" /end MEASUREMENT
/begin MEASUREMENT n_iga_dif_max_knk[41] "Freeze frame for engine speed when excursion limit event occurs" UBYTE _CNV_A_R_LINEAR_____10_CM 1 100. 0. 8160. DISPLAY_IDENTIFIER N_IGA_DIF_MAX_KNK[41] ECU_ADDRESS 0xd00010fd FORMAT "%4.0" /end MEASUREMENT
/begin MEASUREMENT n_iga_dif_max_knk[42] "Freeze frame for engine speed when excursion limit event occurs" UBYTE _CNV_A_R_LINEAR_____10_CM 1 100. 0. 8160. DISPLAY_IDENTIFIER N_IGA_DIF_MAX_KNK[42] ECU_ADDRESS 0xd00010fe FORMAT "%4.0" /end MEASUREMENT
/begin MEASUREMENT n_iga_dif_max_knk[43] "Freeze frame for engine speed when excursion limit event occurs" UBYTE _CNV_A_R_LINEAR_____10_CM 1 100. 0. 8160. DISPLAY_IDENTIFIER N_IGA_DIF_MAX_KNK[43] ECU_ADDRESS 0xd00010ff FORMAT "%4.0" /end MEASUREMENT
/begin MEASUREMENT n_iga_dif_max_knk[44] "Freeze frame for engine speed when excursion limit event occurs" UBYTE _CNV_A_R_LINEAR_____10_CM 1 100. 0. 8160. DISPLAY_IDENTIFIER N_IGA_DIF_MAX_KNK[44] ECU_ADDRESS 0xd0001100 FORMAT "%4.0" /end MEASUREMENT
/begin MEASUREMENT n_iga_dif_max_knk[45] "Freeze frame for engine speed when excursion limit event occurs" UBYTE _CNV_A_R_LINEAR_____10_CM 1 100. 0. 8160. DISPLAY_IDENTIFIER N_IGA_DIF_MAX_KNK[45] ECU_ADDRESS 0xd0001101 FORMAT "%4.0" /end MEASUREMENT
/begin MEASUREMENT n_iga_dif_max_knk[46] "Freeze frame for engine speed when excursion limit event occurs" UBYTE _CNV_A_R_LINEAR_____10_CM 1 100. 0. 8160. DISPLAY_IDENTIFIER N_IGA_DIF_MAX_KNK[46] ECU_ADDRESS 0xd0001102 FORMAT "%4.0" /end MEASUREMENT
/begin MEASUREMENT n_iga_dif_max_knk[47] "Freeze frame for engine speed when excursion limit event occurs" UBYTE _CNV_A_R_LINEAR_____10_CM 1 100. 0. 8160. DISPLAY_IDENTIFIER N_IGA_DIF_MAX_KNK[47] ECU_ADDRESS 0xd0001103 FORMAT "%4.0" /end MEASUREMENT
/begin MEASUREMENT n_iga_dif_max_knk[48] "Freeze frame for engine speed when excursion limit event occurs" UBYTE _CNV_A_R_LINEAR_____10_CM 1 100. 0. 8160. DISPLAY_IDENTIFIER N_IGA_DIF_MAX_KNK[48] ECU_ADDRESS 0xd0001104 FORMAT "%4.0" /end MEASUREMENT
/begin MEASUREMENT n_iga_dif_max_knk[49] "Freeze frame for engine speed when excursion limit event occurs" UBYTE _CNV_A_R_LINEAR_____10_CM 1 100. 0. 8160. DISPLAY_IDENTIFIER N_IGA_DIF_MAX_KNK[49] ECU_ADDRESS 0xd0001105 FORMAT "%4.0" /end MEASUREMENT
/begin MEASUREMENT n_iga_dif_max_knk[50] "Freeze frame for engine speed when excursion limit event occurs" UBYTE _CNV_A_R_LINEAR_____10_CM 1 100. 0. 8160. DISPLAY_IDENTIFIER N_IGA_DIF_MAX_KNK[50] ECU_ADDRESS 0xd0001106 FORMAT "%4.0" /end MEASUREMENT
/begin MEASUREMENT n_iga_dif_max_knk[51] "Freeze frame for engine speed when excursion limit event occurs" UBYTE _CNV_A_R_LINEAR_____10_CM 1 100. 0. 8160. DISPLAY_IDENTIFIER N_IGA_DIF_MAX_KNK[51] ECU_ADDRESS 0xd0001107 FORMAT "%4.0" /end MEASUREMENT
/begin MEASUREMENT n_iga_dif_max_knk[52] "Freeze frame for engine speed when excursion limit event occurs" UBYTE _CNV_A_R_LINEAR_____10_CM 1 100. 0. 8160. DISPLAY_IDENTIFIER N_IGA_DIF_MAX_KNK[52] ECU_ADDRESS 0xd0001108 FORMAT "%4.0" /end MEASUREMENT
/begin MEASUREMENT n_iga_dif_max_knk[53] "Freeze frame for engine speed when excursion limit event occurs" UBYTE _CNV_A_R_LINEAR_____10_CM 1 100. 0. 8160. DISPLAY_IDENTIFIER N_IGA_DIF_MAX_KNK[53] ECU_ADDRESS 0xd0001109 FORMAT "%4.0" /end MEASUREMENT
/begin MEASUREMENT n_iga_dif_max_knk[54] "Freeze frame for engine speed when excursion limit event occurs" UBYTE _CNV_A_R_LINEAR_____10_CM 1 100. 0. 8160. DISPLAY_IDENTIFIER N_IGA_DIF_MAX_KNK[54] ECU_ADDRESS 0xd000110a FORMAT "%4.0" /end MEASUREMENT
/begin MEASUREMENT n_iga_dif_max_knk[55] "Freeze frame for engine speed when excursion limit event occurs" UBYTE _CNV_A_R_LINEAR_____10_CM 1 100. 0. 8160. DISPLAY_IDENTIFIER N_IGA_DIF_MAX_KNK[55] ECU_ADDRESS 0xd000110b FORMAT "%4.0" /end MEASUREMENT
/begin MEASUREMENT n_iga_dif_max_knk[56] "Freeze frame for engine speed when excursion limit event occurs" UBYTE _CNV_A_R_LINEAR_____10_CM 1 100. 0. 8160. DISPLAY_IDENTIFIER N_IGA_DIF_MAX_KNK[56] ECU_ADDRESS 0xd000110c FORMAT "%4.0" /end MEASUREMENT
/begin MEASUREMENT n_iga_dif_max_knk[57] "Freeze frame for engine speed when excursion limit event occurs" UBYTE _CNV_A_R_LINEAR_____10_CM 1 100. 0. 8160. DISPLAY_IDENTIFIER N_IGA_DIF_MAX_KNK[57] ECU_ADDRESS 0xd000110d FORMAT "%4.0" /end MEASUREMENT
/begin MEASUREMENT n_iga_dif_max_knk[58] "Freeze frame for engine speed when excursion limit event occurs" UBYTE _CNV_A_R_LINEAR_____10_CM 1 100. 0. 8160. DISPLAY_IDENTIFIER N_IGA_DIF_MAX_KNK[58] ECU_ADDRESS 0xd000110e FORMAT "%4.0" /end MEASUREMENT
/begin MEASUREMENT n_iga_dif_max_knk[59] "Freeze frame for engine speed when excursion limit event occurs" UBYTE _CNV_A_R_LINEAR_____10_CM 1 100. 0. 8160. DISPLAY_IDENTIFIER N_IGA_DIF_MAX_KNK[59] ECU_ADDRESS 0xd000110f FORMAT "%4.0" /end MEASUREMENT
/begin MEASUREMENT maf_iga_dif_max_knk[0] "Freeze frame for mass air flow when excursion limit event occurs" UBYTE _CNV_A_R_LINEAR_____15_CM 1 100. 0. 1389. DISPLAY_IDENTIFIER MAF_IGA_DIF_MAX_KNK[0] ECU_ADDRESS 0xd0001110 FORMAT "%4.0" /end MEASUREMENT
/begin MEASUREMENT maf_iga_dif_max_knk[1] "Freeze frame for mass air flow when excursion limit event occurs" UBYTE _CNV_A_R_LINEAR_____15_CM 1 100. 0. 1389. DISPLAY_IDENTIFIER MAF_IGA_DIF_MAX_KNK[1] ECU_ADDRESS 0xd0001111 FORMAT "%4.0" /end MEASUREMENT
/begin MEASUREMENT maf_iga_dif_max_knk[2] "Freeze frame for mass air flow when excursion limit event occurs" UBYTE _CNV_A_R_LINEAR_____15_CM 1 100. 0. 1389. DISPLAY_IDENTIFIER MAF_IGA_DIF_MAX_KNK[2] ECU_ADDRESS 0xd0001112 FORMAT "%4.0" /end MEASUREMENT
/begin MEASUREMENT maf_iga_dif_max_knk[3] "Freeze frame for mass air flow when excursion limit event occurs" UBYTE _CNV_A_R_LINEAR_____15_CM 1 100. 0. 1389. DISPLAY_IDENTIFIER MAF_IGA_DIF_MAX_KNK[3] ECU_ADDRESS 0xd0001113 FORMAT "%4.0" /end MEASUREMENT
/begin MEASUREMENT maf_iga_dif_max_knk[4] "Freeze frame for mass air flow when excursion limit event occurs" UBYTE _CNV_A_R_LINEAR_____15_CM 1 100. 0. 1389. DISPLAY_IDENTIFIER MAF_IGA_DIF_MAX_KNK[4] ECU_ADDRESS 0xd0001114 FORMAT "%4.0" /end MEASUREMENT
/begin MEASUREMENT maf_iga_dif_max_knk[5] "Freeze frame for mass air flow when excursion limit event occurs" UBYTE _CNV_A_R_LINEAR_____15_CM 1 100. 0. 1389. DISPLAY_IDENTIFIER MAF_IGA_DIF_MAX_KNK[5] ECU_ADDRESS 0xd0001115 FORMAT "%4.0" /end MEASUREMENT
/begin MEASUREMENT maf_iga_dif_max_knk[6] "Freeze frame for mass air flow when excursion limit event occurs" UBYTE _CNV_A_R_LINEAR_____15_CM 1 100. 0. 1389. DISPLAY_IDENTIFIER MAF_IGA_DIF_MAX_KNK[6] ECU_ADDRESS 0xd0001116 FORMAT "%4.0" /end MEASUREMENT
/begin MEASUREMENT maf_iga_dif_max_knk[7] "Freeze frame for mass air flow when excursion limit event occurs" UBYTE _CNV_A_R_LINEAR_____15_CM 1 100. 0. 1389. DISPLAY_IDENTIFIER MAF_IGA_DIF_MAX_KNK[7] ECU_ADDRESS 0xd0001117 FORMAT "%4.0" /end MEASUREMENT
/begin MEASUREMENT maf_iga_dif_max_knk[8] "Freeze frame for mass air flow when excursion limit event occurs" UBYTE _CNV_A_R_LINEAR_____15_CM 1 100. 0. 1389. DISPLAY_IDENTIFIER MAF_IGA_DIF_MAX_KNK[8] ECU_ADDRESS 0xd0001118 FORMAT "%4.0" /end MEASUREMENT
/begin MEASUREMENT maf_iga_dif_max_knk[9] "Freeze frame for mass air flow when excursion limit event occurs" UBYTE _CNV_A_R_LINEAR_____15_CM 1 100. 0. 1389. DISPLAY_IDENTIFIER MAF_IGA_DIF_MAX_KNK[9] ECU_ADDRESS 0xd0001119 FORMAT "%4.0" /end MEASUREMENT
/begin MEASUREMENT maf_iga_dif_max_knk[10] "Freeze frame for mass air flow when excursion limit event occurs" UBYTE _CNV_A_R_LINEAR_____15_CM 1 100. 0. 1389. DISPLAY_IDENTIFIER MAF_IGA_DIF_MAX_KNK[10] ECU_ADDRESS 0xd000111a FORMAT "%4.0" /end MEASUREMENT
/begin MEASUREMENT maf_iga_dif_max_knk[11] "Freeze frame for mass air flow when excursion limit event occurs" UBYTE _CNV_A_R_LINEAR_____15_CM 1 100. 0. 1389. DISPLAY_IDENTIFIER MAF_IGA_DIF_MAX_KNK[11] ECU_ADDRESS 0xd000111b FORMAT "%4.0" /end MEASUREMENT
/begin MEASUREMENT maf_iga_dif_max_knk[12] "Freeze frame for mass air flow when excursion limit event occurs" UBYTE _CNV_A_R_LINEAR_____15_CM 1 100. 0. 1389. DISPLAY_IDENTIFIER MAF_IGA_DIF_MAX_KNK[12] ECU_ADDRESS 0xd000111c FORMAT "%4.0" /end MEASUREMENT
/begin MEASUREMENT maf_iga_dif_max_knk[13] "Freeze frame for mass air flow when excursion limit event occurs" UBYTE _CNV_A_R_LINEAR_____15_CM 1 100. 0. 1389. DISPLAY_IDENTIFIER MAF_IGA_DIF_MAX_KNK[13] ECU_ADDRESS 0xd000111d FORMAT "%4.0" /end MEASUREMENT
/begin MEASUREMENT maf_iga_dif_max_knk[14] "Freeze frame for mass air flow when excursion limit event occurs" UBYTE _CNV_A_R_LINEAR_____15_CM 1 100. 0. 1389. DISPLAY_IDENTIFIER MAF_IGA_DIF_MAX_KNK[14] ECU_ADDRESS 0xd000111e FORMAT "%4.0" /end MEASUREMENT
/begin MEASUREMENT maf_iga_dif_max_knk[15] "Freeze frame for mass air flow when excursion limit event occurs" UBYTE _CNV_A_R_LINEAR_____15_CM 1 100. 0. 1389. DISPLAY_IDENTIFIER MAF_IGA_DIF_MAX_KNK[15] ECU_ADDRESS 0xd000111f FORMAT "%4.0" /end MEASUREMENT
/begin MEASUREMENT maf_iga_dif_max_knk[16] "Freeze frame for mass air flow when excursion limit event occurs" UBYTE _CNV_A_R_LINEAR_____15_CM 1 100. 0. 1389. DISPLAY_IDENTIFIER MAF_IGA_DIF_MAX_KNK[16] ECU_ADDRESS 0xd0001120 FORMAT "%4.0" /end MEASUREMENT
/begin MEASUREMENT maf_iga_dif_max_knk[17] "Freeze frame for mass air flow when excursion limit event occurs" UBYTE _CNV_A_R_LINEAR_____15_CM 1 100. 0. 1389. DISPLAY_IDENTIFIER MAF_IGA_DIF_MAX_KNK[17] ECU_ADDRESS 0xd0001121 FORMAT "%4.0" /end MEASUREMENT
/begin MEASUREMENT maf_iga_dif_max_knk[18] "Freeze frame for mass air flow when excursion limit event occurs" UBYTE _CNV_A_R_LINEAR_____15_CM 1 100. 0. 1389. DISPLAY_IDENTIFIER MAF_IGA_DIF_MAX_KNK[18] ECU_ADDRESS 0xd0001122 FORMAT "%4.0" /end MEASUREMENT
/begin MEASUREMENT maf_iga_dif_max_knk[19] "Freeze frame for mass air flow when excursion limit event occurs" UBYTE _CNV_A_R_LINEAR_____15_CM 1 100. 0. 1389. DISPLAY_IDENTIFIER MAF_IGA_DIF_MAX_KNK[19] ECU_ADDRESS 0xd0001123 FORMAT "%4.0" /end MEASUREMENT
/begin MEASUREMENT maf_iga_dif_max_knk[20] "Freeze frame for mass air flow when excursion limit event occurs" UBYTE _CNV_A_R_LINEAR_____15_CM 1 100. 0. 1389. DISPLAY_IDENTIFIER MAF_IGA_DIF_MAX_KNK[20] ECU_ADDRESS 0xd0001124 FORMAT "%4.0" /end MEASUREMENT
/begin MEASUREMENT maf_iga_dif_max_knk[21] "Freeze frame for mass air flow when excursion limit event occurs" UBYTE _CNV_A_R_LINEAR_____15_CM 1 100. 0. 1389. DISPLAY_IDENTIFIER MAF_IGA_DIF_MAX_KNK[21] ECU_ADDRESS 0xd0001125 FORMAT "%4.0" /end MEASUREMENT
/begin MEASUREMENT maf_iga_dif_max_knk[22] "Freeze frame for mass air flow when excursion limit event occurs" UBYTE _CNV_A_R_LINEAR_____15_CM 1 100. 0. 1389. DISPLAY_IDENTIFIER MAF_IGA_DIF_MAX_KNK[22] ECU_ADDRESS 0xd0001126 FORMAT "%4.0" /end MEASUREMENT
/begin MEASUREMENT maf_iga_dif_max_knk[23] "Freeze frame for mass air flow when excursion limit event occurs" UBYTE _CNV_A_R_LINEAR_____15_CM 1 100. 0. 1389. DISPLAY_IDENTIFIER MAF_IGA_DIF_MAX_KNK[23] ECU_ADDRESS 0xd0001127 FORMAT "%4.0" /end MEASUREMENT
/begin MEASUREMENT maf_iga_dif_max_knk[24] "Freeze frame for mass air flow when excursion limit event occurs" UBYTE _CNV_A_R_LINEAR_____15_CM 1 100. 0. 1389. DISPLAY_IDENTIFIER MAF_IGA_DIF_MAX_KNK[24] ECU_ADDRESS 0xd0001128 FORMAT "%4.0" /end MEASUREMENT
/begin MEASUREMENT maf_iga_dif_max_knk[25] "Freeze frame for mass air flow when excursion limit event occurs" UBYTE _CNV_A_R_LINEAR_____15_CM 1 100. 0. 1389. DISPLAY_IDENTIFIER MAF_IGA_DIF_MAX_KNK[25] ECU_ADDRESS 0xd0001129 FORMAT "%4.0" /end MEASUREMENT
/begin MEASUREMENT maf_iga_dif_max_knk[26] "Freeze frame for mass air flow when excursion limit event occurs" UBYTE _CNV_A_R_LINEAR_____15_CM 1 100. 0. 1389. DISPLAY_IDENTIFIER MAF_IGA_DIF_MAX_KNK[26] ECU_ADDRESS 0xd000112a FORMAT "%4.0" /end MEASUREMENT
/begin MEASUREMENT maf_iga_dif_max_knk[27] "Freeze frame for mass air flow when excursion limit event occurs" UBYTE _CNV_A_R_LINEAR_____15_CM 1 100. 0. 1389. DISPLAY_IDENTIFIER MAF_IGA_DIF_MAX_KNK[27] ECU_ADDRESS 0xd000112b FORMAT "%4.0" /end MEASUREMENT
/begin MEASUREMENT maf_iga_dif_max_knk[28] "Freeze frame for mass air flow when excursion limit event occurs" UBYTE _CNV_A_R_LINEAR_____15_CM 1 100. 0. 1389. DISPLAY_IDENTIFIER MAF_IGA_DIF_MAX_KNK[28] ECU_ADDRESS 0xd000112c FORMAT "%4.0" /end MEASUREMENT
/begin MEASUREMENT maf_iga_dif_max_knk[29] "Freeze frame for mass air flow when excursion limit event occurs" UBYTE _CNV_A_R_LINEAR_____15_CM 1 100. 0. 1389. DISPLAY_IDENTIFIER MAF_IGA_DIF_MAX_KNK[29] ECU_ADDRESS 0xd000112d FORMAT "%4.0" /end MEASUREMENT
/begin MEASUREMENT maf_iga_dif_max_knk[30] "Freeze frame for mass air flow when excursion limit event occurs" UBYTE _CNV_A_R_LINEAR_____15_CM 1 100. 0. 1389. DISPLAY_IDENTIFIER MAF_IGA_DIF_MAX_KNK[30] ECU_ADDRESS 0xd000112e FORMAT "%4.0" /end MEASUREMENT
/begin MEASUREMENT maf_iga_dif_max_knk[31] "Freeze frame for mass air flow when excursion limit event occurs" UBYTE _CNV_A_R_LINEAR_____15_CM 1 100. 0. 1389. DISPLAY_IDENTIFIER MAF_IGA_DIF_MAX_KNK[31] ECU_ADDRESS 0xd000112f FORMAT "%4.0" /end MEASUREMENT
/begin MEASUREMENT maf_iga_dif_max_knk[32] "Freeze frame for mass air flow when excursion limit event occurs" UBYTE _CNV_A_R_LINEAR_____15_CM 1 100. 0. 1389. DISPLAY_IDENTIFIER MAF_IGA_DIF_MAX_KNK[32] ECU_ADDRESS 0xd0001130 FORMAT "%4.0" /end MEASUREMENT
/begin MEASUREMENT maf_iga_dif_max_knk[33] "Freeze frame for mass air flow when excursion limit event occurs" UBYTE _CNV_A_R_LINEAR_____15_CM 1 100. 0. 1389. DISPLAY_IDENTIFIER MAF_IGA_DIF_MAX_KNK[33] ECU_ADDRESS 0xd0001131 FORMAT "%4.0" /end MEASUREMENT
/begin MEASUREMENT maf_iga_dif_max_knk[34] "Freeze frame for mass air flow when excursion limit event occurs" UBYTE _CNV_A_R_LINEAR_____15_CM 1 100. 0. 1389. DISPLAY_IDENTIFIER MAF_IGA_DIF_MAX_KNK[34] ECU_ADDRESS 0xd0001132 FORMAT "%4.0" /end MEASUREMENT
/begin MEASUREMENT maf_iga_dif_max_knk[35] "Freeze frame for mass air flow when excursion limit event occurs" UBYTE _CNV_A_R_LINEAR_____15_CM 1 100. 0. 1389. DISPLAY_IDENTIFIER MAF_IGA_DIF_MAX_KNK[35] ECU_ADDRESS 0xd0001133 FORMAT "%4.0" /end MEASUREMENT
/begin MEASUREMENT maf_iga_dif_max_knk[36] "Freeze frame for mass air flow when excursion limit event occurs" UBYTE _CNV_A_R_LINEAR_____15_CM 1 100. 0. 1389. DISPLAY_IDENTIFIER MAF_IGA_DIF_MAX_KNK[36] ECU_ADDRESS 0xd0001134 FORMAT "%4.0" /end MEASUREMENT
/begin MEASUREMENT maf_iga_dif_max_knk[37] "Freeze frame for mass air flow when excursion limit event occurs" UBYTE _CNV_A_R_LINEAR_____15_CM 1 100. 0. 1389. DISPLAY_IDENTIFIER MAF_IGA_DIF_MAX_KNK[37] ECU_ADDRESS 0xd0001135 FORMAT "%4.0" /end MEASUREMENT
/begin MEASUREMENT maf_iga_dif_max_knk[38] "Freeze frame for mass air flow when excursion limit event occurs" UBYTE _CNV_A_R_LINEAR_____15_CM 1 100. 0. 1389. DISPLAY_IDENTIFIER MAF_IGA_DIF_MAX_KNK[38] ECU_ADDRESS 0xd0001136 FORMAT "%4.0" /end MEASUREMENT
/begin MEASUREMENT maf_iga_dif_max_knk[39] "Freeze frame for mass air flow when excursion limit event occurs" UBYTE _CNV_A_R_LINEAR_____15_CM 1 100. 0. 1389. DISPLAY_IDENTIFIER MAF_IGA_DIF_MAX_KNK[39] ECU_ADDRESS 0xd0001137 FORMAT "%4.0" /end MEASUREMENT
/begin MEASUREMENT maf_iga_dif_max_knk[40] "Freeze frame for mass air flow when excursion limit event occurs" UBYTE _CNV_A_R_LINEAR_____15_CM 1 100. 0. 1389. DISPLAY_IDENTIFIER MAF_IGA_DIF_MAX_KNK[40] ECU_ADDRESS 0xd0001138 FORMAT "%4.0" /end MEASUREMENT
/begin MEASUREMENT maf_iga_dif_max_knk[41] "Freeze frame for mass air flow when excursion limit event occurs" UBYTE _CNV_A_R_LINEAR_____15_CM 1 100. 0. 1389. DISPLAY_IDENTIFIER MAF_IGA_DIF_MAX_KNK[41] ECU_ADDRESS 0xd0001139 FORMAT "%4.0" /end MEASUREMENT
/begin MEASUREMENT maf_iga_dif_max_knk[42] "Freeze frame for mass air flow when excursion limit event occurs" UBYTE _CNV_A_R_LINEAR_____15_CM 1 100. 0. 1389. DISPLAY_IDENTIFIER MAF_IGA_DIF_MAX_KNK[42] ECU_ADDRESS 0xd000113a FORMAT "%4.0" /end MEASUREMENT
/begin MEASUREMENT maf_iga_dif_max_knk[43] "Freeze frame for mass air flow when excursion limit event occurs" UBYTE _CNV_A_R_LINEAR_____15_CM 1 100. 0. 1389. DISPLAY_IDENTIFIER MAF_IGA_DIF_MAX_KNK[43] ECU_ADDRESS 0xd000113b FORMAT "%4.0" /end MEASUREMENT
/begin MEASUREMENT maf_iga_dif_max_knk[44] "Freeze frame for mass air flow when excursion limit event occurs" UBYTE _CNV_A_R_LINEAR_____15_CM 1 100. 0. 1389. DISPLAY_IDENTIFIER MAF_IGA_DIF_MAX_KNK[44] ECU_ADDRESS 0xd000113c FORMAT "%4.0" /end MEASUREMENT
/begin MEASUREMENT maf_iga_dif_max_knk[45] "Freeze frame for mass air flow when excursion limit event occurs" UBYTE _CNV_A_R_LINEAR_____15_CM 1 100. 0. 1389. DISPLAY_IDENTIFIER MAF_IGA_DIF_MAX_KNK[45] ECU_ADDRESS 0xd000113d FORMAT "%4.0" /end MEASUREMENT
/begin MEASUREMENT maf_iga_dif_max_knk[46] "Freeze frame for mass air flow when excursion limit event occurs" UBYTE _CNV_A_R_LINEAR_____15_CM 1 100. 0. 1389. DISPLAY_IDENTIFIER MAF_IGA_DIF_MAX_KNK[46] ECU_ADDRESS 0xd000113e FORMAT "%4.0" /end MEASUREMENT
/begin MEASUREMENT maf_iga_dif_max_knk[47] "Freeze frame for mass air flow when excursion limit event occurs" UBYTE _CNV_A_R_LINEAR_____15_CM 1 100. 0. 1389. DISPLAY_IDENTIFIER MAF_IGA_DIF_MAX_KNK[47] ECU_ADDRESS 0xd000113f FORMAT "%4.0" /end MEASUREMENT
/begin MEASUREMENT maf_iga_dif_max_knk[48] "Freeze frame for mass air flow when excursion limit event occurs" UBYTE _CNV_A_R_LINEAR_____15_CM 1 100. 0. 1389. DISPLAY_IDENTIFIER MAF_IGA_DIF_MAX_KNK[48] ECU_ADDRESS 0xd0001140 FORMAT "%4.0" /end MEASUREMENT
/begin MEASUREMENT maf_iga_dif_max_knk[49] "Freeze frame for mass air flow when excursion limit event occurs" UBYTE _CNV_A_R_LINEAR_____15_CM 1 100. 0. 1389. DISPLAY_IDENTIFIER MAF_IGA_DIF_MAX_KNK[49] ECU_ADDRESS 0xd0001141 FORMAT "%4.0" /end MEASUREMENT
/begin MEASUREMENT maf_iga_dif_max_knk[50] "Freeze frame for mass air flow when excursion limit event occurs" UBYTE _CNV_A_R_LINEAR_____15_CM 1 100. 0. 1389. DISPLAY_IDENTIFIER MAF_IGA_DIF_MAX_KNK[50] ECU_ADDRESS 0xd0001142 FORMAT "%4.0" /end MEASUREMENT
/begin MEASUREMENT maf_iga_dif_max_knk[51] "Freeze frame for mass air flow when excursion limit event occurs" UBYTE _CNV_A_R_LINEAR_____15_CM 1 100. 0. 1389. DISPLAY_IDENTIFIER MAF_IGA_DIF_MAX_KNK[51] ECU_ADDRESS 0xd0001143 FORMAT "%4.0" /end MEASUREMENT
/begin MEASUREMENT maf_iga_dif_max_knk[52] "Freeze frame for mass air flow when excursion limit event occurs" UBYTE _CNV_A_R_LINEAR_____15_CM 1 100. 0. 1389. DISPLAY_IDENTIFIER MAF_IGA_DIF_MAX_KNK[52] ECU_ADDRESS 0xd0001144 FORMAT "%4.0" /end MEASUREMENT
/begin MEASUREMENT maf_iga_dif_max_knk[53] "Freeze frame for mass air flow when excursion limit event occurs" UBYTE _CNV_A_R_LINEAR_____15_CM 1 100. 0. 1389. DISPLAY_IDENTIFIER MAF_IGA_DIF_MAX_KNK[53] ECU_ADDRESS 0xd0001145 FORMAT "%4.0" /end MEASUREMENT
/begin MEASUREMENT maf_iga_dif_max_knk[54] "Freeze frame for mass air flow when excursion limit event occurs" UBYTE _CNV_A_R_LINEAR_____15_CM 1 100. 0. 1389. DISPLAY_IDENTIFIER MAF_IGA_DIF_MAX_KNK[54] ECU_ADDRESS 0xd0001146 FORMAT "%4.0" /end MEASUREMENT
/begin MEASUREMENT maf_iga_dif_max_knk[55] "Freeze frame for mass air flow when excursion limit event occurs" UBYTE _CNV_A_R_LINEAR_____15_CM 1 100. 0. 1389. DISPLAY_IDENTIFIER MAF_IGA_DIF_MAX_KNK[55] ECU_ADDRESS 0xd0001147 FORMAT "%4.0" /end MEASUREMENT
/begin MEASUREMENT maf_iga_dif_max_knk[56] "Freeze frame for mass air flow when excursion limit event occurs" UBYTE _CNV_A_R_LINEAR_____15_CM 1 100. 0. 1389. DISPLAY_IDENTIFIER MAF_IGA_DIF_MAX_KNK[56] ECU_ADDRESS 0xd0001148 FORMAT "%4.0" /end MEASUREMENT
/begin MEASUREMENT maf_iga_dif_max_knk[57] "Freeze frame for mass air flow when excursion limit event occurs" UBYTE _CNV_A_R_LINEAR_____15_CM 1 100. 0. 1389. DISPLAY_IDENTIFIER MAF_IGA_DIF_MAX_KNK[57] ECU_ADDRESS 0xd0001149 FORMAT "%4.0" /end MEASUREMENT
/begin MEASUREMENT maf_iga_dif_max_knk[58] "Freeze frame for mass air flow when excursion limit event occurs" UBYTE _CNV_A_R_LINEAR_____15_CM 1 100. 0. 1389. DISPLAY_IDENTIFIER MAF_IGA_DIF_MAX_KNK[58] ECU_ADDRESS 0xd000114a FORMAT "%4.0" /end MEASUREMENT
/begin MEASUREMENT maf_iga_dif_max_knk[59] "Freeze frame for mass air flow when excursion limit event occurs" UBYTE _CNV_A_R_LINEAR_____15_CM 1 100. 0. 1389. DISPLAY_IDENTIFIER MAF_IGA_DIF_MAX_KNK[59] ECU_ADDRESS 0xd000114b FORMAT "%4.0" /end MEASUREMENT
/begin MEASUREMENT tco_iga_dif_max_knk[0] "Freeze frame for coolant temperature when excursion limit event occurs" UBYTE _CNV_A_R_LINEAR_____17_CM 1 100. -48. 142.5 DISPLAY_IDENTIFIER TCO_IGA_DIF_MAX_KNK[0] ECU_ADDRESS 0xd000114c FORMAT "%5.1" /end MEASUREMENT
/begin MEASUREMENT tco_iga_dif_max_knk[1] "Freeze frame for coolant temperature when excursion limit event occurs" UBYTE _CNV_A_R_LINEAR_____17_CM 1 100. -48. 142.5 DISPLAY_IDENTIFIER TCO_IGA_DIF_MAX_KNK[1] ECU_ADDRESS 0xd000114d FORMAT "%5.1" /end MEASUREMENT
/begin MEASUREMENT tco_iga_dif_max_knk[2] "Freeze frame for coolant temperature when excursion limit event occurs" UBYTE _CNV_A_R_LINEAR_____17_CM 1 100. -48. 142.5 DISPLAY_IDENTIFIER TCO_IGA_DIF_MAX_KNK[2] ECU_ADDRESS 0xd000114e FORMAT "%5.1" /end MEASUREMENT
/begin MEASUREMENT tco_iga_dif_max_knk[3] "Freeze frame for coolant temperature when excursion limit event occurs" UBYTE _CNV_A_R_LINEAR_____17_CM 1 100. -48. 142.5 DISPLAY_IDENTIFIER TCO_IGA_DIF_MAX_KNK[3] ECU_ADDRESS 0xd000114f FORMAT "%5.1" /end MEASUREMENT
/begin MEASUREMENT tco_iga_dif_max_knk[4] "Freeze frame for coolant temperature when excursion limit event occurs" UBYTE _CNV_A_R_LINEAR_____17_CM 1 100. -48. 142.5 DISPLAY_IDENTIFIER TCO_IGA_DIF_MAX_KNK[4] ECU_ADDRESS 0xd0001150 FORMAT "%5.1" /end MEASUREMENT
/begin MEASUREMENT tco_iga_dif_max_knk[5] "Freeze frame for coolant temperature when excursion limit event occurs" UBYTE _CNV_A_R_LINEAR_____17_CM 1 100. -48. 142.5 DISPLAY_IDENTIFIER TCO_IGA_DIF_MAX_KNK[5] ECU_ADDRESS 0xd0001151 FORMAT "%5.1" /end MEASUREMENT
/begin MEASUREMENT tco_iga_dif_max_knk[6] "Freeze frame for coolant temperature when excursion limit event occurs" UBYTE _CNV_A_R_LINEAR_____17_CM 1 100. -48. 142.5 DISPLAY_IDENTIFIER TCO_IGA_DIF_MAX_KNK[6] ECU_ADDRESS 0xd0001152 FORMAT "%5.1" /end MEASUREMENT
/begin MEASUREMENT tco_iga_dif_max_knk[7] "Freeze frame for coolant temperature when excursion limit event occurs" UBYTE _CNV_A_R_LINEAR_____17_CM 1 100. -48. 142.5 DISPLAY_IDENTIFIER TCO_IGA_DIF_MAX_KNK[7] ECU_ADDRESS 0xd0001153 FORMAT "%5.1" /end MEASUREMENT
/begin MEASUREMENT tco_iga_dif_max_knk[8] "Freeze frame for coolant temperature when excursion limit event occurs" UBYTE _CNV_A_R_LINEAR_____17_CM 1 100. -48. 142.5 DISPLAY_IDENTIFIER TCO_IGA_DIF_MAX_KNK[8] ECU_ADDRESS 0xd0001154 FORMAT "%5.1" /end MEASUREMENT
/begin MEASUREMENT tco_iga_dif_max_knk[9] "Freeze frame for coolant temperature when excursion limit event occurs" UBYTE _CNV_A_R_LINEAR_____17_CM 1 100. -48. 142.5 DISPLAY_IDENTIFIER TCO_IGA_DIF_MAX_KNK[9] ECU_ADDRESS 0xd0001155 FORMAT "%5.1" /end MEASUREMENT
/begin MEASUREMENT tco_iga_dif_max_knk[10] "Freeze frame for coolant temperature when excursion limit event occurs" UBYTE _CNV_A_R_LINEAR_____17_CM 1 100. -48. 142.5 DISPLAY_IDENTIFIER TCO_IGA_DIF_MAX_KNK[10] ECU_ADDRESS 0xd0001156 FORMAT "%5.1" /end MEASUREMENT
/begin MEASUREMENT tco_iga_dif_max_knk[11] "Freeze frame for coolant temperature when excursion limit event occurs" UBYTE _CNV_A_R_LINEAR_____17_CM 1 100. -48. 142.5 DISPLAY_IDENTIFIER TCO_IGA_DIF_MAX_KNK[11] ECU_ADDRESS 0xd0001157 FORMAT "%5.1" /end MEASUREMENT
/begin MEASUREMENT tco_iga_dif_max_knk[12] "Freeze frame for coolant temperature when excursion limit event occurs" UBYTE _CNV_A_R_LINEAR_____17_CM 1 100. -48. 142.5 DISPLAY_IDENTIFIER TCO_IGA_DIF_MAX_KNK[12] ECU_ADDRESS 0xd0001158 FORMAT "%5.1" /end MEASUREMENT
/begin MEASUREMENT tco_iga_dif_max_knk[13] "Freeze frame for coolant temperature when excursion limit event occurs" UBYTE _CNV_A_R_LINEAR_____17_CM 1 100. -48. 142.5 DISPLAY_IDENTIFIER TCO_IGA_DIF_MAX_KNK[13] ECU_ADDRESS 0xd0001159 FORMAT "%5.1" /end MEASUREMENT
/begin MEASUREMENT tco_iga_dif_max_knk[14] "Freeze frame for coolant temperature when excursion limit event occurs" UBYTE _CNV_A_R_LINEAR_____17_CM 1 100. -48. 142.5 DISPLAY_IDENTIFIER TCO_IGA_DIF_MAX_KNK[14] ECU_ADDRESS 0xd000115a FORMAT "%5.1" /end MEASUREMENT
/begin MEASUREMENT tco_iga_dif_max_knk[15] "Freeze frame for coolant temperature when excursion limit event occurs" UBYTE _CNV_A_R_LINEAR_____17_CM 1 100. -48. 142.5 DISPLAY_IDENTIFIER TCO_IGA_DIF_MAX_KNK[15] ECU_ADDRESS 0xd000115b FORMAT "%5.1" /end MEASUREMENT
/begin MEASUREMENT tco_iga_dif_max_knk[16] "Freeze frame for coolant temperature when excursion limit event occurs" UBYTE _CNV_A_R_LINEAR_____17_CM 1 100. -48. 142.5 DISPLAY_IDENTIFIER TCO_IGA_DIF_MAX_KNK[16] ECU_ADDRESS 0xd000115c FORMAT "%5.1" /end MEASUREMENT
/begin MEASUREMENT tco_iga_dif_max_knk[17] "Freeze frame for coolant temperature when excursion limit event occurs" UBYTE _CNV_A_R_LINEAR_____17_CM 1 100. -48. 142.5 DISPLAY_IDENTIFIER TCO_IGA_DIF_MAX_KNK[17] ECU_ADDRESS 0xd000115d FORMAT "%5.1" /end MEASUREMENT
/begin MEASUREMENT tco_iga_dif_max_knk[18] "Freeze frame for coolant temperature when excursion limit event occurs" UBYTE _CNV_A_R_LINEAR_____17_CM 1 100. -48. 142.5 DISPLAY_IDENTIFIER TCO_IGA_DIF_MAX_KNK[18] ECU_ADDRESS 0xd000115e FORMAT "%5.1" /end MEASUREMENT
/begin MEASUREMENT tco_iga_dif_max_knk[19] "Freeze frame for coolant temperature when excursion limit event occurs" UBYTE _CNV_A_R_LINEAR_____17_CM 1 100. -48. 142.5 DISPLAY_IDENTIFIER TCO_IGA_DIF_MAX_KNK[19] ECU_ADDRESS 0xd000115f FORMAT "%5.1" /end MEASUREMENT
/begin MEASUREMENT tco_iga_dif_max_knk[20] "Freeze frame for coolant temperature when excursion limit event occurs" UBYTE _CNV_A_R_LINEAR_____17_CM 1 100. -48. 142.5 DISPLAY_IDENTIFIER TCO_IGA_DIF_MAX_KNK[20] ECU_ADDRESS 0xd0001160 FORMAT "%5.1" /end MEASUREMENT
/begin MEASUREMENT tco_iga_dif_max_knk[21] "Freeze frame for coolant temperature when excursion limit event occurs" UBYTE _CNV_A_R_LINEAR_____17_CM 1 100. -48. 142.5 DISPLAY_IDENTIFIER TCO_IGA_DIF_MAX_KNK[21] ECU_ADDRESS 0xd0001161 FORMAT "%5.1" /end MEASUREMENT
/begin MEASUREMENT tco_iga_dif_max_knk[22] "Freeze frame for coolant temperature when excursion limit event occurs" UBYTE _CNV_A_R_LINEAR_____17_CM 1 100. -48. 142.5 DISPLAY_IDENTIFIER TCO_IGA_DIF_MAX_KNK[22] ECU_ADDRESS 0xd0001162 FORMAT "%5.1" /end MEASUREMENT
/begin MEASUREMENT tco_iga_dif_max_knk[23] "Freeze frame for coolant temperature when excursion limit event occurs" UBYTE _CNV_A_R_LINEAR_____17_CM 1 100. -48. 142.5 DISPLAY_IDENTIFIER TCO_IGA_DIF_MAX_KNK[23] ECU_ADDRESS 0xd0001163 FORMAT "%5.1" /end MEASUREMENT
/begin MEASUREMENT tco_iga_dif_max_knk[24] "Freeze frame for coolant temperature when excursion limit event occurs" UBYTE _CNV_A_R_LINEAR_____17_CM 1 100. -48. 142.5 DISPLAY_IDENTIFIER TCO_IGA_DIF_MAX_KNK[24] ECU_ADDRESS 0xd0001164 FORMAT "%5.1" /end MEASUREMENT
/begin MEASUREMENT tco_iga_dif_max_knk[25] "Freeze frame for coolant temperature when excursion limit event occurs" UBYTE _CNV_A_R_LINEAR_____17_CM 1 100. -48. 142.5 DISPLAY_IDENTIFIER TCO_IGA_DIF_MAX_KNK[25] ECU_ADDRESS 0xd0001165 FORMAT "%5.1" /end MEASUREMENT
/begin MEASUREMENT tco_iga_dif_max_knk[26] "Freeze frame for coolant temperature when excursion limit event occurs" UBYTE _CNV_A_R_LINEAR_____17_CM 1 100. -48. 142.5 DISPLAY_IDENTIFIER TCO_IGA_DIF_MAX_KNK[26] ECU_ADDRESS 0xd0001166 FORMAT "%5.1" /end MEASUREMENT
/begin MEASUREMENT tco_iga_dif_max_knk[27] "Freeze frame for coolant temperature when excursion limit event occurs" UBYTE _CNV_A_R_LINEAR_____17_CM 1 100. -48. 142.5 DISPLAY_IDENTIFIER TCO_IGA_DIF_MAX_KNK[27] ECU_ADDRESS 0xd0001167 FORMAT "%5.1" /end MEASUREMENT
/begin MEASUREMENT tco_iga_dif_max_knk[28] "Freeze frame for coolant temperature when excursion limit event occurs" UBYTE _CNV_A_R_LINEAR_____17_CM 1 100. -48. 142.5 DISPLAY_IDENTIFIER TCO_IGA_DIF_MAX_KNK[28] ECU_ADDRESS 0xd0001168 FORMAT "%5.1" /end MEASUREMENT
/begin MEASUREMENT tco_iga_dif_max_knk[29] "Freeze frame for coolant temperature when excursion limit event occurs" UBYTE _CNV_A_R_LINEAR_____17_CM 1 100. -48. 142.5 DISPLAY_IDENTIFIER TCO_IGA_DIF_MAX_KNK[29] ECU_ADDRESS 0xd0001169 FORMAT "%5.1" /end MEASUREMENT
/begin MEASUREMENT tco_iga_dif_max_knk[30] "Freeze frame for coolant temperature when excursion limit event occurs" UBYTE _CNV_A_R_LINEAR_____17_CM 1 100. -48. 142.5 DISPLAY_IDENTIFIER TCO_IGA_DIF_MAX_KNK[30] ECU_ADDRESS 0xd000116a FORMAT "%5.1" /end MEASUREMENT
/begin MEASUREMENT tco_iga_dif_max_knk[31] "Freeze frame for coolant temperature when excursion limit event occurs" UBYTE _CNV_A_R_LINEAR_____17_CM 1 100. -48. 142.5 DISPLAY_IDENTIFIER TCO_IGA_DIF_MAX_KNK[31] ECU_ADDRESS 0xd000116b FORMAT "%5.1" /end MEASUREMENT
/begin MEASUREMENT tco_iga_dif_max_knk[32] "Freeze frame for coolant temperature when excursion limit event occurs" UBYTE _CNV_A_R_LINEAR_____17_CM 1 100. -48. 142.5 DISPLAY_IDENTIFIER TCO_IGA_DIF_MAX_KNK[32] ECU_ADDRESS 0xd000116c FORMAT "%5.1" /end MEASUREMENT
/begin MEASUREMENT tco_iga_dif_max_knk[33] "Freeze frame for coolant temperature when excursion limit event occurs" UBYTE _CNV_A_R_LINEAR_____17_CM 1 100. -48. 142.5 DISPLAY_IDENTIFIER TCO_IGA_DIF_MAX_KNK[33] ECU_ADDRESS 0xd000116d FORMAT "%5.1" /end MEASUREMENT
/begin MEASUREMENT tco_iga_dif_max_knk[34] "Freeze frame for coolant temperature when excursion limit event occurs" UBYTE _CNV_A_R_LINEAR_____17_CM 1 100. -48. 142.5 DISPLAY_IDENTIFIER TCO_IGA_DIF_MAX_KNK[34] ECU_ADDRESS 0xd000116e FORMAT "%5.1" /end MEASUREMENT
/begin MEASUREMENT tco_iga_dif_max_knk[35] "Freeze frame for coolant temperature when excursion limit event occurs" UBYTE _CNV_A_R_LINEAR_____17_CM 1 100. -48. 142.5 DISPLAY_IDENTIFIER TCO_IGA_DIF_MAX_KNK[35] ECU_ADDRESS 0xd000116f FORMAT "%5.1" /end MEASUREMENT
/begin MEASUREMENT tco_iga_dif_max_knk[36] "Freeze frame for coolant temperature when excursion limit event occurs" UBYTE _CNV_A_R_LINEAR_____17_CM 1 100. -48. 142.5 DISPLAY_IDENTIFIER TCO_IGA_DIF_MAX_KNK[36] ECU_ADDRESS 0xd0001170 FORMAT "%5.1" /end MEASUREMENT
/begin MEASUREMENT tco_iga_dif_max_knk[37] "Freeze frame for coolant temperature when excursion limit event occurs" UBYTE _CNV_A_R_LINEAR_____17_CM 1 100. -48. 142.5 DISPLAY_IDENTIFIER TCO_IGA_DIF_MAX_KNK[37] ECU_ADDRESS 0xd0001171 FORMAT "%5.1" /end MEASUREMENT
/begin MEASUREMENT tco_iga_dif_max_knk[38] "Freeze frame for coolant temperature when excursion limit event occurs" UBYTE _CNV_A_R_LINEAR_____17_CM 1 100. -48. 142.5 DISPLAY_IDENTIFIER TCO_IGA_DIF_MAX_KNK[38] ECU_ADDRESS 0xd0001172 FORMAT "%5.1" /end MEASUREMENT
/begin MEASUREMENT tco_iga_dif_max_knk[39] "Freeze frame for coolant temperature when excursion limit event occurs" UBYTE _CNV_A_R_LINEAR_____17_CM 1 100. -48. 142.5 DISPLAY_IDENTIFIER TCO_IGA_DIF_MAX_KNK[39] ECU_ADDRESS 0xd0001173 FORMAT "%5.1" /end MEASUREMENT
/begin MEASUREMENT tco_iga_dif_max_knk[40] "Freeze frame for coolant temperature when excursion limit event occurs" UBYTE _CNV_A_R_LINEAR_____17_CM 1 100. -48. 142.5 DISPLAY_IDENTIFIER TCO_IGA_DIF_MAX_KNK[40] ECU_ADDRESS 0xd0001174 FORMAT "%5.1" /end MEASUREMENT
/begin MEASUREMENT tco_iga_dif_max_knk[41] "Freeze frame for coolant temperature when excursion limit event occurs" UBYTE _CNV_A_R_LINEAR_____17_CM 1 100. -48. 142.5 DISPLAY_IDENTIFIER TCO_IGA_DIF_MAX_KNK[41] ECU_ADDRESS 0xd0001175 FORMAT "%5.1" /end MEASUREMENT
/begin MEASUREMENT tco_iga_dif_max_knk[42] "Freeze frame for coolant temperature when excursion limit event occurs" UBYTE _CNV_A_R_LINEAR_____17_CM 1 100. -48. 142.5 DISPLAY_IDENTIFIER TCO_IGA_DIF_MAX_KNK[42] ECU_ADDRESS 0xd0001176 FORMAT "%5.1" /end MEASUREMENT
/begin MEASUREMENT tco_iga_dif_max_knk[43] "Freeze frame for coolant temperature when excursion limit event occurs" UBYTE _CNV_A_R_LINEAR_____17_CM 1 100. -48. 142.5 DISPLAY_IDENTIFIER TCO_IGA_DIF_MAX_KNK[43] ECU_ADDRESS 0xd0001177 FORMAT "%5.1" /end MEASUREMENT
/begin MEASUREMENT tco_iga_dif_max_knk[44] "Freeze frame for coolant temperature when excursion limit event occurs" UBYTE _CNV_A_R_LINEAR_____17_CM 1 100. -48. 142.5 DISPLAY_IDENTIFIER TCO_IGA_DIF_MAX_KNK[44] ECU_ADDRESS 0xd0001178 FORMAT "%5.1" /end MEASUREMENT
/begin MEASUREMENT tco_iga_dif_max_knk[45] "Freeze frame for coolant temperature when excursion limit event occurs" UBYTE _CNV_A_R_LINEAR_____17_CM 1 100. -48. 142.5 DISPLAY_IDENTIFIER TCO_IGA_DIF_MAX_KNK[45] ECU_ADDRESS 0xd0001179 FORMAT "%5.1" /end MEASUREMENT
/begin MEASUREMENT tco_iga_dif_max_knk[46] "Freeze frame for coolant temperature when excursion limit event occurs" UBYTE _CNV_A_R_LINEAR_____17_CM 1 100. -48. 142.5 DISPLAY_IDENTIFIER TCO_IGA_DIF_MAX_KNK[46] ECU_ADDRESS 0xd000117a FORMAT "%5.1" /end MEASUREMENT
/begin MEASUREMENT tco_iga_dif_max_knk[47] "Freeze frame for coolant temperature when excursion limit event occurs" UBYTE _CNV_A_R_LINEAR_____17_CM 1 100. -48. 142.5 DISPLAY_IDENTIFIER TCO_IGA_DIF_MAX_KNK[47] ECU_ADDRESS 0xd000117b FORMAT "%5.1" /end MEASUREMENT
/begin MEASUREMENT tco_iga_dif_max_knk[48] "Freeze frame for coolant temperature when excursion limit event occurs" UBYTE _CNV_A_R_LINEAR_____17_CM 1 100. -48. 142.5 DISPLAY_IDENTIFIER TCO_IGA_DIF_MAX_KNK[48] ECU_ADDRESS 0xd000117c FORMAT "%5.1" /end MEASUREMENT
/begin MEASUREMENT tco_iga_dif_max_knk[49] "Freeze frame for coolant temperature when excursion limit event occurs" UBYTE _CNV_A_R_LINEAR_____17_CM 1 100. -48. 142.5 DISPLAY_IDENTIFIER TCO_IGA_DIF_MAX_KNK[49] ECU_ADDRESS 0xd000117d FORMAT "%5.1" /end MEASUREMENT
/begin MEASUREMENT tco_iga_dif_max_knk[50] "Freeze frame for coolant temperature when excursion limit event occurs" UBYTE _CNV_A_R_LINEAR_____17_CM 1 100. -48. 142.5 DISPLAY_IDENTIFIER TCO_IGA_DIF_MAX_KNK[50] ECU_ADDRESS 0xd000117e FORMAT "%5.1" /end MEASUREMENT
/begin MEASUREMENT tco_iga_dif_max_knk[51] "Freeze frame for coolant temperature when excursion limit event occurs" UBYTE _CNV_A_R_LINEAR_____17_CM 1 100. -48. 142.5 DISPLAY_IDENTIFIER TCO_IGA_DIF_MAX_KNK[51] ECU_ADDRESS 0xd000117f FORMAT "%5.1" /end MEASUREMENT
/begin MEASUREMENT tco_iga_dif_max_knk[52] "Freeze frame for coolant temperature when excursion limit event occurs" UBYTE _CNV_A_R_LINEAR_____17_CM 1 100. -48. 142.5 DISPLAY_IDENTIFIER TCO_IGA_DIF_MAX_KNK[52] ECU_ADDRESS 0xd0001180 FORMAT "%5.1" /end MEASUREMENT
/begin MEASUREMENT tco_iga_dif_max_knk[53] "Freeze frame for coolant temperature when excursion limit event occurs" UBYTE _CNV_A_R_LINEAR_____17_CM 1 100. -48. 142.5 DISPLAY_IDENTIFIER TCO_IGA_DIF_MAX_KNK[53] ECU_ADDRESS 0xd0001181 FORMAT "%5.1" /end MEASUREMENT
/begin MEASUREMENT tco_iga_dif_max_knk[54] "Freeze frame for coolant temperature when excursion limit event occurs" UBYTE _CNV_A_R_LINEAR_____17_CM 1 100. -48. 142.5 DISPLAY_IDENTIFIER TCO_IGA_DIF_MAX_KNK[54] ECU_ADDRESS 0xd0001182 FORMAT "%5.1" /end MEASUREMENT
/begin MEASUREMENT tco_iga_dif_max_knk[55] "Freeze frame for coolant temperature when excursion limit event occurs" UBYTE _CNV_A_R_LINEAR_____17_CM 1 100. -48. 142.5 DISPLAY_IDENTIFIER TCO_IGA_DIF_MAX_KNK[55] ECU_ADDRESS 0xd0001183 FORMAT "%5.1" /end MEASUREMENT
/begin MEASUREMENT tco_iga_dif_max_knk[56] "Freeze frame for coolant temperature when excursion limit event occurs" UBYTE _CNV_A_R_LINEAR_____17_CM 1 100. -48. 142.5 DISPLAY_IDENTIFIER TCO_IGA_DIF_MAX_KNK[56] ECU_ADDRESS 0xd0001184 FORMAT "%5.1" /end MEASUREMENT
/begin MEASUREMENT tco_iga_dif_max_knk[57] "Freeze frame for coolant temperature when excursion limit event occurs" UBYTE _CNV_A_R_LINEAR_____17_CM 1 100. -48. 142.5 DISPLAY_IDENTIFIER TCO_IGA_DIF_MAX_KNK[57] ECU_ADDRESS 0xd0001185 FORMAT "%5.1" /end MEASUREMENT
/begin MEASUREMENT tco_iga_dif_max_knk[58] "Freeze frame for coolant temperature when excursion limit event occurs" UBYTE _CNV_A_R_LINEAR_____17_CM 1 100. -48. 142.5 DISPLAY_IDENTIFIER TCO_IGA_DIF_MAX_KNK[58] ECU_ADDRESS 0xd0001186 FORMAT "%5.1" /end MEASUREMENT
/begin MEASUREMENT tco_iga_dif_max_knk[59] "Freeze frame for coolant temperature when excursion limit event occurs" UBYTE _CNV_A_R_LINEAR_____17_CM 1 100. -48. 142.5 DISPLAY_IDENTIFIER TCO_IGA_DIF_MAX_KNK[59] ECU_ADDRESS 0xd0001187 FORMAT "%5.1" /end MEASUREMENT
/begin MEASUREMENT tia_iga_dif_max_knk[0] "Freeze frame for temperature of injected when excursion limit event occurs" UBYTE _CNV_A_R_LINEAR_____17_CM 1 100. -48. 142.5 DISPLAY_IDENTIFIER TIA_IGA_DIF_MAX_KNK[0] ECU_ADDRESS 0xd0001188 FORMAT "%5.1" /end MEASUREMENT
/begin MEASUREMENT tia_iga_dif_max_knk[1] "Freeze frame for temperature of injected when excursion limit event occurs" UBYTE _CNV_A_R_LINEAR_____17_CM 1 100. -48. 142.5 DISPLAY_IDENTIFIER TIA_IGA_DIF_MAX_KNK[1] ECU_ADDRESS 0xd0001189 FORMAT "%5.1" /end MEASUREMENT
/begin MEASUREMENT tia_iga_dif_max_knk[2] "Freeze frame for temperature of injected when excursion limit event occurs" UBYTE _CNV_A_R_LINEAR_____17_CM 1 100. -48. 142.5 DISPLAY_IDENTIFIER TIA_IGA_DIF_MAX_KNK[2] ECU_ADDRESS 0xd000118a FORMAT "%5.1" /end MEASUREMENT
/begin MEASUREMENT tia_iga_dif_max_knk[3] "Freeze frame for temperature of injected when excursion limit event occurs" UBYTE _CNV_A_R_LINEAR_____17_CM 1 100. -48. 142.5 DISPLAY_IDENTIFIER TIA_IGA_DIF_MAX_KNK[3] ECU_ADDRESS 0xd000118b FORMAT "%5.1" /end MEASUREMENT
/begin MEASUREMENT tia_iga_dif_max_knk[4] "Freeze frame for temperature of injected when excursion limit event occurs" UBYTE _CNV_A_R_LINEAR_____17_CM 1 100. -48. 142.5 DISPLAY_IDENTIFIER TIA_IGA_DIF_MAX_KNK[4] ECU_ADDRESS 0xd000118c FORMAT "%5.1" /end MEASUREMENT
/begin MEASUREMENT tia_iga_dif_max_knk[5] "Freeze frame for temperature of injected when excursion limit event occurs" UBYTE _CNV_A_R_LINEAR_____17_CM 1 100. -48. 142.5 DISPLAY_IDENTIFIER TIA_IGA_DIF_MAX_KNK[5] ECU_ADDRESS 0xd000118d FORMAT "%5.1" /end MEASUREMENT
/begin MEASUREMENT tia_iga_dif_max_knk[6] "Freeze frame for temperature of injected when excursion limit event occurs" UBYTE _CNV_A_R_LINEAR_____17_CM 1 100. -48. 142.5 DISPLAY_IDENTIFIER TIA_IGA_DIF_MAX_KNK[6] ECU_ADDRESS 0xd000118e FORMAT "%5.1" /end MEASUREMENT
/begin MEASUREMENT tia_iga_dif_max_knk[7] "Freeze frame for temperature of injected when excursion limit event occurs" UBYTE _CNV_A_R_LINEAR_____17_CM 1 100. -48. 142.5 DISPLAY_IDENTIFIER TIA_IGA_DIF_MAX_KNK[7] ECU_ADDRESS 0xd000118f FORMAT "%5.1" /end MEASUREMENT
/begin MEASUREMENT tia_iga_dif_max_knk[8] "Freeze frame for temperature of injected when excursion limit event occurs" UBYTE _CNV_A_R_LINEAR_____17_CM 1 100. -48. 142.5 DISPLAY_IDENTIFIER TIA_IGA_DIF_MAX_KNK[8] ECU_ADDRESS 0xd0001190 FORMAT "%5.1" /end MEASUREMENT
/begin MEASUREMENT tia_iga_dif_max_knk[9] "Freeze frame for temperature of injected when excursion limit event occurs" UBYTE _CNV_A_R_LINEAR_____17_CM 1 100. -48. 142.5 DISPLAY_IDENTIFIER TIA_IGA_DIF_MAX_KNK[9] ECU_ADDRESS 0xd0001191 FORMAT "%5.1" /end MEASUREMENT
/begin MEASUREMENT tia_iga_dif_max_knk[10] "Freeze frame for temperature of injected when excursion limit event occurs" UBYTE _CNV_A_R_LINEAR_____17_CM 1 100. -48. 142.5 DISPLAY_IDENTIFIER TIA_IGA_DIF_MAX_KNK[10] ECU_ADDRESS 0xd0001192 FORMAT "%5.1" /end MEASUREMENT
/begin MEASUREMENT tia_iga_dif_max_knk[11] "Freeze frame for temperature of injected when excursion limit event occurs" UBYTE _CNV_A_R_LINEAR_____17_CM 1 100. -48. 142.5 DISPLAY_IDENTIFIER TIA_IGA_DIF_MAX_KNK[11] ECU_ADDRESS 0xd0001193 FORMAT "%5.1" /end MEASUREMENT
/begin MEASUREMENT tia_iga_dif_max_knk[12] "Freeze frame for temperature of injected when excursion limit event occurs" UBYTE _CNV_A_R_LINEAR_____17_CM 1 100. -48. 142.5 DISPLAY_IDENTIFIER TIA_IGA_DIF_MAX_KNK[12] ECU_ADDRESS 0xd0001194 FORMAT "%5.1" /end MEASUREMENT
/begin MEASUREMENT tia_iga_dif_max_knk[13] "Freeze frame for temperature of injected when excursion limit event occurs" UBYTE _CNV_A_R_LINEAR_____17_CM 1 100. -48. 142.5 DISPLAY_IDENTIFIER TIA_IGA_DIF_MAX_KNK[13] ECU_ADDRESS 0xd0001195 FORMAT "%5.1" /end MEASUREMENT
/begin MEASUREMENT tia_iga_dif_max_knk[14] "Freeze frame for temperature of injected when excursion limit event occurs" UBYTE _CNV_A_R_LINEAR_____17_CM 1 100. -48. 142.5 DISPLAY_IDENTIFIER TIA_IGA_DIF_MAX_KNK[14] ECU_ADDRESS 0xd0001196 FORMAT "%5.1" /end MEASUREMENT
/begin MEASUREMENT tia_iga_dif_max_knk[15] "Freeze frame for temperature of injected when excursion limit event occurs" UBYTE _CNV_A_R_LINEAR_____17_CM 1 100. -48. 142.5 DISPLAY_IDENTIFIER TIA_IGA_DIF_MAX_KNK[15] ECU_ADDRESS 0xd0001197 FORMAT "%5.1" /end MEASUREMENT
/begin MEASUREMENT tia_iga_dif_max_knk[16] "Freeze frame for temperature of injected when excursion limit event occurs" UBYTE _CNV_A_R_LINEAR_____17_CM 1 100. -48. 142.5 DISPLAY_IDENTIFIER TIA_IGA_DIF_MAX_KNK[16] ECU_ADDRESS 0xd0001198 FORMAT "%5.1" /end MEASUREMENT
/begin MEASUREMENT tia_iga_dif_max_knk[17] "Freeze frame for temperature of injected when excursion limit event occurs" UBYTE _CNV_A_R_LINEAR_____17_CM 1 100. -48. 142.5 DISPLAY_IDENTIFIER TIA_IGA_DIF_MAX_KNK[17] ECU_ADDRESS 0xd0001199 FORMAT "%5.1" /end MEASUREMENT
/begin MEASUREMENT tia_iga_dif_max_knk[18] "Freeze frame for temperature of injected when excursion limit event occurs" UBYTE _CNV_A_R_LINEAR_____17_CM 1 100. -48. 142.5 DISPLAY_IDENTIFIER TIA_IGA_DIF_MAX_KNK[18] ECU_ADDRESS 0xd000119a FORMAT "%5.1" /end MEASUREMENT
/begin MEASUREMENT tia_iga_dif_max_knk[19] "Freeze frame for temperature of injected when excursion limit event occurs" UBYTE _CNV_A_R_LINEAR_____17_CM 1 100. -48. 142.5 DISPLAY_IDENTIFIER TIA_IGA_DIF_MAX_KNK[19] ECU_ADDRESS 0xd000119b FORMAT "%5.1" /end MEASUREMENT
/begin MEASUREMENT tia_iga_dif_max_knk[20] "Freeze frame for temperature of injected when excursion limit event occurs" UBYTE _CNV_A_R_LINEAR_____17_CM 1 100. -48. 142.5 DISPLAY_IDENTIFIER TIA_IGA_DIF_MAX_KNK[20] ECU_ADDRESS 0xd000119c FORMAT "%5.1" /end MEASUREMENT
/begin MEASUREMENT tia_iga_dif_max_knk[21] "Freeze frame for temperature of injected when excursion limit event occurs" UBYTE _CNV_A_R_LINEAR_____17_CM 1 100. -48. 142.5 DISPLAY_IDENTIFIER TIA_IGA_DIF_MAX_KNK[21] ECU_ADDRESS 0xd000119d FORMAT "%5.1" /end MEASUREMENT
/begin MEASUREMENT tia_iga_dif_max_knk[22] "Freeze frame for temperature of injected when excursion limit event occurs" UBYTE _CNV_A_R_LINEAR_____17_CM 1 100. -48. 142.5 DISPLAY_IDENTIFIER TIA_IGA_DIF_MAX_KNK[22] ECU_ADDRESS 0xd000119e FORMAT "%5.1" /end MEASUREMENT
/begin MEASUREMENT tia_iga_dif_max_knk[23] "Freeze frame for temperature of injected when excursion limit event occurs" UBYTE _CNV_A_R_LINEAR_____17_CM 1 100. -48. 142.5 DISPLAY_IDENTIFIER TIA_IGA_DIF_MAX_KNK[23] ECU_ADDRESS 0xd000119f FORMAT "%5.1" /end MEASUREMENT
/begin MEASUREMENT tia_iga_dif_max_knk[24] "Freeze frame for temperature of injected when excursion limit event occurs" UBYTE _CNV_A_R_LINEAR_____17_CM 1 100. -48. 142.5 DISPLAY_IDENTIFIER TIA_IGA_DIF_MAX_KNK[24] ECU_ADDRESS 0xd00011a0 FORMAT "%5.1" /end MEASUREMENT
/begin MEASUREMENT tia_iga_dif_max_knk[25] "Freeze frame for temperature of injected when excursion limit event occurs" UBYTE _CNV_A_R_LINEAR_____17_CM 1 100. -48. 142.5 DISPLAY_IDENTIFIER TIA_IGA_DIF_MAX_KNK[25] ECU_ADDRESS 0xd00011a1 FORMAT "%5.1" /end MEASUREMENT
/begin MEASUREMENT tia_iga_dif_max_knk[26] "Freeze frame for temperature of injected when excursion limit event occurs" UBYTE _CNV_A_R_LINEAR_____17_CM 1 100. -48. 142.5 DISPLAY_IDENTIFIER TIA_IGA_DIF_MAX_KNK[26] ECU_ADDRESS 0xd00011a2 FORMAT "%5.1" /end MEASUREMENT
/begin MEASUREMENT tia_iga_dif_max_knk[27] "Freeze frame for temperature of injected when excursion limit event occurs" UBYTE _CNV_A_R_LINEAR_____17_CM 1 100. -48. 142.5 DISPLAY_IDENTIFIER TIA_IGA_DIF_MAX_KNK[27] ECU_ADDRESS 0xd00011a3 FORMAT "%5.1" /end MEASUREMENT
/begin MEASUREMENT tia_iga_dif_max_knk[28] "Freeze frame for temperature of injected when excursion limit event occurs" UBYTE _CNV_A_R_LINEAR_____17_CM 1 100. -48. 142.5 DISPLAY_IDENTIFIER TIA_IGA_DIF_MAX_KNK[28] ECU_ADDRESS 0xd00011a4 FORMAT "%5.1" /end MEASUREMENT
/begin MEASUREMENT tia_iga_dif_max_knk[29] "Freeze frame for temperature of injected when excursion limit event occurs" UBYTE _CNV_A_R_LINEAR_____17_CM 1 100. -48. 142.5 DISPLAY_IDENTIFIER TIA_IGA_DIF_MAX_KNK[29] ECU_ADDRESS 0xd00011a5 FORMAT "%5.1" /end MEASUREMENT
/begin MEASUREMENT tia_iga_dif_max_knk[30] "Freeze frame for temperature of injected when excursion limit event occurs" UBYTE _CNV_A_R_LINEAR_____17_CM 1 100. -48. 142.5 DISPLAY_IDENTIFIER TIA_IGA_DIF_MAX_KNK[30] ECU_ADDRESS 0xd00011a6 FORMAT "%5.1" /end MEASUREMENT
/begin MEASUREMENT tia_iga_dif_max_knk[31] "Freeze frame for temperature of injected when excursion limit event occurs" UBYTE _CNV_A_R_LINEAR_____17_CM 1 100. -48. 142.5 DISPLAY_IDENTIFIER TIA_IGA_DIF_MAX_KNK[31] ECU_ADDRESS 0xd00011a7 FORMAT "%5.1" /end MEASUREMENT
/begin MEASUREMENT tia_iga_dif_max_knk[32] "Freeze frame for temperature of injected when excursion limit event occurs" UBYTE _CNV_A_R_LINEAR_____17_CM 1 100. -48. 142.5 DISPLAY_IDENTIFIER TIA_IGA_DIF_MAX_KNK[32] ECU_ADDRESS 0xd00011a8 FORMAT "%5.1" /end MEASUREMENT
/begin MEASUREMENT tia_iga_dif_max_knk[33] "Freeze frame for temperature of injected when excursion limit event occurs" UBYTE _CNV_A_R_LINEAR_____17_CM 1 100. -48. 142.5 DISPLAY_IDENTIFIER TIA_IGA_DIF_MAX_KNK[33] ECU_ADDRESS 0xd00011a9 FORMAT "%5.1" /end MEASUREMENT
/begin MEASUREMENT tia_iga_dif_max_knk[34] "Freeze frame for temperature of injected when excursion limit event occurs" UBYTE _CNV_A_R_LINEAR_____17_CM 1 100. -48. 142.5 DISPLAY_IDENTIFIER TIA_IGA_DIF_MAX_KNK[34] ECU_ADDRESS 0xd00011aa FORMAT "%5.1" /end MEASUREMENT
/begin MEASUREMENT tia_iga_dif_max_knk[35] "Freeze frame for temperature of injected when excursion limit event occurs" UBYTE _CNV_A_R_LINEAR_____17_CM 1 100. -48. 142.5 DISPLAY_IDENTIFIER TIA_IGA_DIF_MAX_KNK[35] ECU_ADDRESS 0xd00011ab FORMAT "%5.1" /end MEASUREMENT
/begin MEASUREMENT tia_iga_dif_max_knk[36] "Freeze frame for temperature of injected when excursion limit event occurs" UBYTE _CNV_A_R_LINEAR_____17_CM 1 100. -48. 142.5 DISPLAY_IDENTIFIER TIA_IGA_DIF_MAX_KNK[36] ECU_ADDRESS 0xd00011ac FORMAT "%5.1" /end MEASUREMENT
/begin MEASUREMENT tia_iga_dif_max_knk[37] "Freeze frame for temperature of injected when excursion limit event occurs" UBYTE _CNV_A_R_LINEAR_____17_CM 1 100. -48. 142.5 DISPLAY_IDENTIFIER TIA_IGA_DIF_MAX_KNK[37] ECU_ADDRESS 0xd00011ad FORMAT "%5.1" /end MEASUREMENT
/begin MEASUREMENT tia_iga_dif_max_knk[38] "Freeze frame for temperature of injected when excursion limit event occurs" UBYTE _CNV_A_R_LINEAR_____17_CM 1 100. -48. 142.5 DISPLAY_IDENTIFIER TIA_IGA_DIF_MAX_KNK[38] ECU_ADDRESS 0xd00011ae FORMAT "%5.1" /end MEASUREMENT
/begin MEASUREMENT tia_iga_dif_max_knk[39] "Freeze frame for temperature of injected when excursion limit event occurs" UBYTE _CNV_A_R_LINEAR_____17_CM 1 100. -48. 142.5 DISPLAY_IDENTIFIER TIA_IGA_DIF_MAX_KNK[39] ECU_ADDRESS 0xd00011af FORMAT "%5.1" /end MEASUREMENT
/begin MEASUREMENT tia_iga_dif_max_knk[40] "Freeze frame for temperature of injected when excursion limit event occurs" UBYTE _CNV_A_R_LINEAR_____17_CM 1 100. -48. 142.5 DISPLAY_IDENTIFIER TIA_IGA_DIF_MAX_KNK[40] ECU_ADDRESS 0xd00011b0 FORMAT "%5.1" /end MEASUREMENT
/begin MEASUREMENT tia_iga_dif_max_knk[41] "Freeze frame for temperature of injected when excursion limit event occurs" UBYTE _CNV_A_R_LINEAR_____17_CM 1 100. -48. 142.5 DISPLAY_IDENTIFIER TIA_IGA_DIF_MAX_KNK[41] ECU_ADDRESS 0xd00011b1 FORMAT "%5.1" /end MEASUREMENT
/begin MEASUREMENT tia_iga_dif_max_knk[42] "Freeze frame for temperature of injected when excursion limit event occurs" UBYTE _CNV_A_R_LINEAR_____17_CM 1 100. -48. 142.5 DISPLAY_IDENTIFIER TIA_IGA_DIF_MAX_KNK[42] ECU_ADDRESS 0xd00011b2 FORMAT "%5.1" /end MEASUREMENT
/begin MEASUREMENT tia_iga_dif_max_knk[43] "Freeze frame for temperature of injected when excursion limit event occurs" UBYTE _CNV_A_R_LINEAR_____17_CM 1 100. -48. 142.5 DISPLAY_IDENTIFIER TIA_IGA_DIF_MAX_KNK[43] ECU_ADDRESS 0xd00011b3 FORMAT "%5.1" /end MEASUREMENT
/begin MEASUREMENT tia_iga_dif_max_knk[44] "Freeze frame for temperature of injected when excursion limit event occurs" UBYTE _CNV_A_R_LINEAR_____17_CM 1 100. -48. 142.5 DISPLAY_IDENTIFIER TIA_IGA_DIF_MAX_KNK[44] ECU_ADDRESS 0xd00011b4 FORMAT "%5.1" /end MEASUREMENT
/begin MEASUREMENT tia_iga_dif_max_knk[45] "Freeze frame for temperature of injected when excursion limit event occurs" UBYTE _CNV_A_R_LINEAR_____17_CM 1 100. -48. 142.5 DISPLAY_IDENTIFIER TIA_IGA_DIF_MAX_KNK[45] ECU_ADDRESS 0xd00011b5 FORMAT "%5.1" /end MEASUREMENT
/begin MEASUREMENT tia_iga_dif_max_knk[46] "Freeze frame for temperature of injected when excursion limit event occurs" UBYTE _CNV_A_R_LINEAR_____17_CM 1 100. -48. 142.5 DISPLAY_IDENTIFIER TIA_IGA_DIF_MAX_KNK[46] ECU_ADDRESS 0xd00011b6 FORMAT "%5.1" /end MEASUREMENT
/begin MEASUREMENT tia_iga_dif_max_knk[47] "Freeze frame for temperature of injected when excursion limit event occurs" UBYTE _CNV_A_R_LINEAR_____17_CM 1 100. -48. 142.5 DISPLAY_IDENTIFIER TIA_IGA_DIF_MAX_KNK[47] ECU_ADDRESS 0xd00011b7 FORMAT "%5.1" /end MEASUREMENT
/begin MEASUREMENT tia_iga_dif_max_knk[48] "Freeze frame for temperature of injected when excursion limit event occurs" UBYTE _CNV_A_R_LINEAR_____17_CM 1 100. -48. 142.5 DISPLAY_IDENTIFIER TIA_IGA_DIF_MAX_KNK[48] ECU_ADDRESS 0xd00011b8 FORMAT "%5.1" /end MEASUREMENT
/begin MEASUREMENT tia_iga_dif_max_knk[49] "Freeze frame for temperature of injected when excursion limit event occurs" UBYTE _CNV_A_R_LINEAR_____17_CM 1 100. -48. 142.5 DISPLAY_IDENTIFIER TIA_IGA_DIF_MAX_KNK[49] ECU_ADDRESS 0xd00011b9 FORMAT "%5.1" /end MEASUREMENT
/begin MEASUREMENT tia_iga_dif_max_knk[50] "Freeze frame for temperature of injected when excursion limit event occurs" UBYTE _CNV_A_R_LINEAR_____17_CM 1 100. -48. 142.5 DISPLAY_IDENTIFIER TIA_IGA_DIF_MAX_KNK[50] ECU_ADDRESS 0xd00011ba FORMAT "%5.1" /end MEASUREMENT
/begin MEASUREMENT tia_iga_dif_max_knk[51] "Freeze frame for temperature of injected when excursion limit event occurs" UBYTE _CNV_A_R_LINEAR_____17_CM 1 100. -48. 142.5 DISPLAY_IDENTIFIER TIA_IGA_DIF_MAX_KNK[51] ECU_ADDRESS 0xd00011bb FORMAT "%5.1" /end MEASUREMENT
/begin MEASUREMENT tia_iga_dif_max_knk[52] "Freeze frame for temperature of injected when excursion limit event occurs" UBYTE _CNV_A_R_LINEAR_____17_CM 1 100. -48. 142.5 DISPLAY_IDENTIFIER TIA_IGA_DIF_MAX_KNK[52] ECU_ADDRESS 0xd00011bc FORMAT "%5.1" /end MEASUREMENT
/begin MEASUREMENT tia_iga_dif_max_knk[53] "Freeze frame for temperature of injected when excursion limit event occurs" UBYTE _CNV_A_R_LINEAR_____17_CM 1 100. -48. 142.5 DISPLAY_IDENTIFIER TIA_IGA_DIF_MAX_KNK[53] ECU_ADDRESS 0xd00011bd FORMAT "%5.1" /end MEASUREMENT
/begin MEASUREMENT tia_iga_dif_max_knk[54] "Freeze frame for temperature of injected when excursion limit event occurs" UBYTE _CNV_A_R_LINEAR_____17_CM 1 100. -48. 142.5 DISPLAY_IDENTIFIER TIA_IGA_DIF_MAX_KNK[54] ECU_ADDRESS 0xd00011be FORMAT "%5.1" /end MEASUREMENT
/begin MEASUREMENT tia_iga_dif_max_knk[55] "Freeze frame for temperature of injected when excursion limit event occurs" UBYTE _CNV_A_R_LINEAR_____17_CM 1 100. -48. 142.5 DISPLAY_IDENTIFIER TIA_IGA_DIF_MAX_KNK[55] ECU_ADDRESS 0xd00011bf FORMAT "%5.1" /end MEASUREMENT
/begin MEASUREMENT tia_iga_dif_max_knk[56] "Freeze frame for temperature of injected when excursion limit event occurs" UBYTE _CNV_A_R_LINEAR_____17_CM 1 100. -48. 142.5 DISPLAY_IDENTIFIER TIA_IGA_DIF_MAX_KNK[56] ECU_ADDRESS 0xd00011c0 FORMAT "%5.1" /end MEASUREMENT
/begin MEASUREMENT tia_iga_dif_max_knk[57] "Freeze frame for temperature of injected when excursion limit event occurs" UBYTE _CNV_A_R_LINEAR_____17_CM 1 100. -48. 142.5 DISPLAY_IDENTIFIER TIA_IGA_DIF_MAX_KNK[57] ECU_ADDRESS 0xd00011c1 FORMAT "%5.1" /end MEASUREMENT
/begin MEASUREMENT tia_iga_dif_max_knk[58] "Freeze frame for temperature of injected when excursion limit event occurs" UBYTE _CNV_A_R_LINEAR_____17_CM 1 100. -48. 142.5 DISPLAY_IDENTIFIER TIA_IGA_DIF_MAX_KNK[58] ECU_ADDRESS 0xd00011c2 FORMAT "%5.1" /end MEASUREMENT
/begin MEASUREMENT tia_iga_dif_max_knk[59] "Freeze frame for temperature of injected when excursion limit event occurs" UBYTE _CNV_A_R_LINEAR_____17_CM 1 100. -48. 142.5 DISPLAY_IDENTIFIER TIA_IGA_DIF_MAX_KNK[59] ECU_ADDRESS 0xd00011c3 FORMAT "%5.1" /end MEASUREMENT
/begin MEASUREMENT cyl_id_iga_dif_max_knk[0] "Freeze frame for knocking cylinder identification when excursion limit event occurs" UBYTE _CNV_A_R_LINEAR_____0_CM 1 100. 0. 255. DISPLAY_IDENTIFIER CYL_ID_IGA_DIF_MAX_KNK[0] ECU_ADDRESS 0xd00011c4 FORMAT "%3.0" /end MEASUREMENT
/begin MEASUREMENT cyl_id_iga_dif_max_knk[1] "Freeze frame for knocking cylinder identification when excursion limit event occurs" UBYTE _CNV_A_R_LINEAR_____0_CM 1 100. 0. 255. DISPLAY_IDENTIFIER CYL_ID_IGA_DIF_MAX_KNK[1] ECU_ADDRESS 0xd00011c5 FORMAT "%3.0" /end MEASUREMENT
/begin MEASUREMENT cyl_id_iga_dif_max_knk[2] "Freeze frame for knocking cylinder identification when excursion limit event occurs" UBYTE _CNV_A_R_LINEAR_____0_CM 1 100. 0. 255. DISPLAY_IDENTIFIER CYL_ID_IGA_DIF_MAX_KNK[2] ECU_ADDRESS 0xd00011c6 FORMAT "%3.0" /end MEASUREMENT
/begin MEASUREMENT cyl_id_iga_dif_max_knk[3] "Freeze frame for knocking cylinder identification when excursion limit event occurs" UBYTE _CNV_A_R_LINEAR_____0_CM 1 100. 0. 255. DISPLAY_IDENTIFIER CYL_ID_IGA_DIF_MAX_KNK[3] ECU_ADDRESS 0xd00011c7 FORMAT "%3.0" /end MEASUREMENT
/begin MEASUREMENT cyl_id_iga_dif_max_knk[4] "Freeze frame for knocking cylinder identification when excursion limit event occurs" UBYTE _CNV_A_R_LINEAR_____0_CM 1 100. 0. 255. DISPLAY_IDENTIFIER CYL_ID_IGA_DIF_MAX_KNK[4] ECU_ADDRESS 0xd00011c8 FORMAT "%3.0" /end MEASUREMENT
/begin MEASUREMENT cyl_id_iga_dif_max_knk[5] "Freeze frame for knocking cylinder identification when excursion limit event occurs" UBYTE _CNV_A_R_LINEAR_____0_CM 1 100. 0. 255. DISPLAY_IDENTIFIER CYL_ID_IGA_DIF_MAX_KNK[5] ECU_ADDRESS 0xd00011c9 FORMAT "%3.0" /end MEASUREMENT
/begin MEASUREMENT cyl_id_iga_dif_max_knk[6] "Freeze frame for knocking cylinder identification when excursion limit event occurs" UBYTE _CNV_A_R_LINEAR_____0_CM 1 100. 0. 255. DISPLAY_IDENTIFIER CYL_ID_IGA_DIF_MAX_KNK[6] ECU_ADDRESS 0xd00011ca FORMAT "%3.0" /end MEASUREMENT
/begin MEASUREMENT cyl_id_iga_dif_max_knk[7] "Freeze frame for knocking cylinder identification when excursion limit event occurs" UBYTE _CNV_A_R_LINEAR_____0_CM 1 100. 0. 255. DISPLAY_IDENTIFIER CYL_ID_IGA_DIF_MAX_KNK[7] ECU_ADDRESS 0xd00011cb FORMAT "%3.0" /end MEASUREMENT
/begin MEASUREMENT cyl_id_iga_dif_max_knk[8] "Freeze frame for knocking cylinder identification when excursion limit event occurs" UBYTE _CNV_A_R_LINEAR_____0_CM 1 100. 0. 255. DISPLAY_IDENTIFIER CYL_ID_IGA_DIF_MAX_KNK[8] ECU_ADDRESS 0xd00011cc FORMAT "%3.0" /end MEASUREMENT
/begin MEASUREMENT cyl_id_iga_dif_max_knk[9] "Freeze frame for knocking cylinder identification when excursion limit event occurs" UBYTE _CNV_A_R_LINEAR_____0_CM 1 100. 0. 255. DISPLAY_IDENTIFIER CYL_ID_IGA_DIF_MAX_KNK[9] ECU_ADDRESS 0xd00011cd FORMAT "%3.0" /end MEASUREMENT
/begin MEASUREMENT cyl_id_iga_dif_max_knk[10] "Freeze frame for knocking cylinder identification when excursion limit event occurs" UBYTE _CNV_A_R_LINEAR_____0_CM 1 100. 0. 255. DISPLAY_IDENTIFIER CYL_ID_IGA_DIF_MAX_KNK[10] ECU_ADDRESS 0xd00011ce FORMAT "%3.0" /end MEASUREMENT
/begin MEASUREMENT cyl_id_iga_dif_max_knk[11] "Freeze frame for knocking cylinder identification when excursion limit event occurs" UBYTE _CNV_A_R_LINEAR_____0_CM 1 100. 0. 255. DISPLAY_IDENTIFIER CYL_ID_IGA_DIF_MAX_KNK[11] ECU_ADDRESS 0xd00011cf FORMAT "%3.0" /end MEASUREMENT
/begin MEASUREMENT cyl_id_iga_dif_max_knk[12] "Freeze frame for knocking cylinder identification when excursion limit event occurs" UBYTE _CNV_A_R_LINEAR_____0_CM 1 100. 0. 255. DISPLAY_IDENTIFIER CYL_ID_IGA_DIF_MAX_KNK[12] ECU_ADDRESS 0xd00011d0 FORMAT "%3.0" /end MEASUREMENT
/begin MEASUREMENT cyl_id_iga_dif_max_knk[13] "Freeze frame for knocking cylinder identification when excursion limit event occurs" UBYTE _CNV_A_R_LINEAR_____0_CM 1 100. 0. 255. DISPLAY_IDENTIFIER CYL_ID_IGA_DIF_MAX_KNK[13] ECU_ADDRESS 0xd00011d1 FORMAT "%3.0" /end MEASUREMENT
/begin MEASUREMENT cyl_id_iga_dif_max_knk[14] "Freeze frame for knocking cylinder identification when excursion limit event occurs" UBYTE _CNV_A_R_LINEAR_____0_CM 1 100. 0. 255. DISPLAY_IDENTIFIER CYL_ID_IGA_DIF_MAX_KNK[14] ECU_ADDRESS 0xd00011d2 FORMAT "%3.0" /end MEASUREMENT
/begin MEASUREMENT cyl_id_iga_dif_max_knk[15] "Freeze frame for knocking cylinder identification when excursion limit event occurs" UBYTE _CNV_A_R_LINEAR_____0_CM 1 100. 0. 255. DISPLAY_IDENTIFIER CYL_ID_IGA_DIF_MAX_KNK[15] ECU_ADDRESS 0xd00011d3 FORMAT "%3.0" /end MEASUREMENT
/begin MEASUREMENT cyl_id_iga_dif_max_knk[16] "Freeze frame for knocking cylinder identification when excursion limit event occurs" UBYTE _CNV_A_R_LINEAR_____0_CM 1 100. 0. 255. DISPLAY_IDENTIFIER CYL_ID_IGA_DIF_MAX_KNK[16] ECU_ADDRESS 0xd00011d4 FORMAT "%3.0" /end MEASUREMENT
/begin MEASUREMENT cyl_id_iga_dif_max_knk[17] "Freeze frame for knocking cylinder identification when excursion limit event occurs" UBYTE _CNV_A_R_LINEAR_____0_CM 1 100. 0. 255. DISPLAY_IDENTIFIER CYL_ID_IGA_DIF_MAX_KNK[17] ECU_ADDRESS 0xd00011d5 FORMAT "%3.0" /end MEASUREMENT
/begin MEASUREMENT cyl_id_iga_dif_max_knk[18] "Freeze frame for knocking cylinder identification when excursion limit event occurs" UBYTE _CNV_A_R_LINEAR_____0_CM 1 100. 0. 255. DISPLAY_IDENTIFIER CYL_ID_IGA_DIF_MAX_KNK[18] ECU_ADDRESS 0xd00011d6 FORMAT "%3.0" /end MEASUREMENT
/begin MEASUREMENT cyl_id_iga_dif_max_knk[19] "Freeze frame for knocking cylinder identification when excursion limit event occurs" UBYTE _CNV_A_R_LINEAR_____0_CM 1 100. 0. 255. DISPLAY_IDENTIFIER CYL_ID_IGA_DIF_MAX_KNK[19] ECU_ADDRESS 0xd00011d7 FORMAT "%3.0" /end MEASUREMENT
/begin MEASUREMENT cyl_id_iga_dif_max_knk[20] "Freeze frame for knocking cylinder identification when excursion limit event occurs" UBYTE _CNV_A_R_LINEAR_____0_CM 1 100. 0. 255. DISPLAY_IDENTIFIER CYL_ID_IGA_DIF_MAX_KNK[20] ECU_ADDRESS 0xd00011d8 FORMAT "%3.0" /end MEASUREMENT
/begin MEASUREMENT cyl_id_iga_dif_max_knk[21] "Freeze frame for knocking cylinder identification when excursion limit event occurs" UBYTE _CNV_A_R_LINEAR_____0_CM 1 100. 0. 255. DISPLAY_IDENTIFIER CYL_ID_IGA_DIF_MAX_KNK[21] ECU_ADDRESS 0xd00011d9 FORMAT "%3.0" /end MEASUREMENT
/begin MEASUREMENT cyl_id_iga_dif_max_knk[22] "Freeze frame for knocking cylinder identification when excursion limit event occurs" UBYTE _CNV_A_R_LINEAR_____0_CM 1 100. 0. 255. DISPLAY_IDENTIFIER CYL_ID_IGA_DIF_MAX_KNK[22] ECU_ADDRESS 0xd00011da FORMAT "%3.0" /end MEASUREMENT
/begin MEASUREMENT cyl_id_iga_dif_max_knk[23] "Freeze frame for knocking cylinder identification when excursion limit event occurs" UBYTE _CNV_A_R_LINEAR_____0_CM 1 100. 0. 255. DISPLAY_IDENTIFIER CYL_ID_IGA_DIF_MAX_KNK[23] ECU_ADDRESS 0xd00011db FORMAT "%3.0" /end MEASUREMENT
/begin MEASUREMENT cyl_id_iga_dif_max_knk[24] "Freeze frame for knocking cylinder identification when excursion limit event occurs" UBYTE _CNV_A_R_LINEAR_____0_CM 1 100. 0. 255. DISPLAY_IDENTIFIER CYL_ID_IGA_DIF_MAX_KNK[24] ECU_ADDRESS 0xd00011dc FORMAT "%3.0" /end MEASUREMENT
/begin MEASUREMENT cyl_id_iga_dif_max_knk[25] "Freeze frame for knocking cylinder identification when excursion limit event occurs" UBYTE _CNV_A_R_LINEAR_____0_CM 1 100. 0. 255. DISPLAY_IDENTIFIER CYL_ID_IGA_DIF_MAX_KNK[25] ECU_ADDRESS 0xd00011dd FORMAT "%3.0" /end MEASUREMENT
/begin MEASUREMENT cyl_id_iga_dif_max_knk[26] "Freeze frame for knocking cylinder identification when excursion limit event occurs" UBYTE _CNV_A_R_LINEAR_____0_CM 1 100. 0. 255. DISPLAY_IDENTIFIER CYL_ID_IGA_DIF_MAX_KNK[26] ECU_ADDRESS 0xd00011de FORMAT "%3.0" /end MEASUREMENT
/begin MEASUREMENT cyl_id_iga_dif_max_knk[27] "Freeze frame for knocking cylinder identification when excursion limit event occurs" UBYTE _CNV_A_R_LINEAR_____0_CM 1 100. 0. 255. DISPLAY_IDENTIFIER CYL_ID_IGA_DIF_MAX_KNK[27] ECU_ADDRESS 0xd00011df FORMAT "%3.0" /end MEASUREMENT
/begin MEASUREMENT cyl_id_iga_dif_max_knk[28] "Freeze frame for knocking cylinder identification when excursion limit event occurs" UBYTE _CNV_A_R_LINEAR_____0_CM 1 100. 0. 255. DISPLAY_IDENTIFIER CYL_ID_IGA_DIF_MAX_KNK[28] ECU_ADDRESS 0xd00011e0 FORMAT "%3.0" /end MEASUREMENT
/begin MEASUREMENT cyl_id_iga_dif_max_knk[29] "Freeze frame for knocking cylinder identification when excursion limit event occurs" UBYTE _CNV_A_R_LINEAR_____0_CM 1 100. 0. 255. DISPLAY_IDENTIFIER CYL_ID_IGA_DIF_MAX_KNK[29] ECU_ADDRESS 0xd00011e1 FORMAT "%3.0" /end MEASUREMENT
/begin MEASUREMENT cyl_id_iga_dif_max_knk[30] "Freeze frame for knocking cylinder identification when excursion limit event occurs" UBYTE _CNV_A_R_LINEAR_____0_CM 1 100. 0. 255. DISPLAY_IDENTIFIER CYL_ID_IGA_DIF_MAX_KNK[30] ECU_ADDRESS 0xd00011e2 FORMAT "%3.0" /end MEASUREMENT
/begin MEASUREMENT cyl_id_iga_dif_max_knk[31] "Freeze frame for knocking cylinder identification when excursion limit event occurs" UBYTE _CNV_A_R_LINEAR_____0_CM 1 100. 0. 255. DISPLAY_IDENTIFIER CYL_ID_IGA_DIF_MAX_KNK[31] ECU_ADDRESS 0xd00011e3 FORMAT "%3.0" /end MEASUREMENT
/begin MEASUREMENT cyl_id_iga_dif_max_knk[32] "Freeze frame for knocking cylinder identification when excursion limit event occurs" UBYTE _CNV_A_R_LINEAR_____0_CM 1 100. 0. 255. DISPLAY_IDENTIFIER CYL_ID_IGA_DIF_MAX_KNK[32] ECU_ADDRESS 0xd00011e4 FORMAT "%3.0" /end MEASUREMENT
/begin MEASUREMENT cyl_id_iga_dif_max_knk[33] "Freeze frame for knocking cylinder identification when excursion limit event occurs" UBYTE _CNV_A_R_LINEAR_____0_CM 1 100. 0. 255. DISPLAY_IDENTIFIER CYL_ID_IGA_DIF_MAX_KNK[33] ECU_ADDRESS 0xd00011e5 FORMAT "%3.0" /end MEASUREMENT
/begin MEASUREMENT cyl_id_iga_dif_max_knk[34] "Freeze frame for knocking cylinder identification when excursion limit event occurs" UBYTE _CNV_A_R_LINEAR_____0_CM 1 100. 0. 255. DISPLAY_IDENTIFIER CYL_ID_IGA_DIF_MAX_KNK[34] ECU_ADDRESS 0xd00011e6 FORMAT "%3.0" /end MEASUREMENT
/begin MEASUREMENT cyl_id_iga_dif_max_knk[35] "Freeze frame for knocking cylinder identification when excursion limit event occurs" UBYTE _CNV_A_R_LINEAR_____0_CM 1 100. 0. 255. DISPLAY_IDENTIFIER CYL_ID_IGA_DIF_MAX_KNK[35] ECU_ADDRESS 0xd00011e7 FORMAT "%3.0" /end MEASUREMENT
/begin MEASUREMENT cyl_id_iga_dif_max_knk[36] "Freeze frame for knocking cylinder identification when excursion limit event occurs" UBYTE _CNV_A_R_LINEAR_____0_CM 1 100. 0. 255. DISPLAY_IDENTIFIER CYL_ID_IGA_DIF_MAX_KNK[36] ECU_ADDRESS 0xd00011e8 FORMAT "%3.0" /end MEASUREMENT
/begin MEASUREMENT cyl_id_iga_dif_max_knk[37] "Freeze frame for knocking cylinder identification when excursion limit event occurs" UBYTE _CNV_A_R_LINEAR_____0_CM 1 100. 0. 255. DISPLAY_IDENTIFIER CYL_ID_IGA_DIF_MAX_KNK[37] ECU_ADDRESS 0xd00011e9 FORMAT "%3.0" /end MEASUREMENT
/begin MEASUREMENT cyl_id_iga_dif_max_knk[38] "Freeze frame for knocking cylinder identification when excursion limit event occurs" UBYTE _CNV_A_R_LINEAR_____0_CM 1 100. 0. 255. DISPLAY_IDENTIFIER CYL_ID_IGA_DIF_MAX_KNK[38] ECU_ADDRESS 0xd00011ea FORMAT "%3.0" /end MEASUREMENT
/begin MEASUREMENT cyl_id_iga_dif_max_knk[39] "Freeze frame for knocking cylinder identification when excursion limit event occurs" UBYTE _CNV_A_R_LINEAR_____0_CM 1 100. 0. 255. DISPLAY_IDENTIFIER CYL_ID_IGA_DIF_MAX_KNK[39] ECU_ADDRESS 0xd00011eb FORMAT "%3.0" /end MEASUREMENT
/begin MEASUREMENT cyl_id_iga_dif_max_knk[40] "Freeze frame for knocking cylinder identification when excursion limit event occurs" UBYTE _CNV_A_R_LINEAR_____0_CM 1 100. 0. 255. DISPLAY_IDENTIFIER CYL_ID_IGA_DIF_MAX_KNK[40] ECU_ADDRESS 0xd00011ec FORMAT "%3.0" /end MEASUREMENT
/begin MEASUREMENT cyl_id_iga_dif_max_knk[41] "Freeze frame for knocking cylinder identification when excursion limit event occurs" UBYTE _CNV_A_R_LINEAR_____0_CM 1 100. 0. 255. DISPLAY_IDENTIFIER CYL_ID_IGA_DIF_MAX_KNK[41] ECU_ADDRESS 0xd00011ed FORMAT "%3.0" /end MEASUREMENT
/begin MEASUREMENT cyl_id_iga_dif_max_knk[42] "Freeze frame for knocking cylinder identification when excursion limit event occurs" UBYTE _CNV_A_R_LINEAR_____0_CM 1 100. 0. 255. DISPLAY_IDENTIFIER CYL_ID_IGA_DIF_MAX_KNK[42] ECU_ADDRESS 0xd00011ee FORMAT "%3.0" /end MEASUREMENT
/begin MEASUREMENT cyl_id_iga_dif_max_knk[43] "Freeze frame for knocking cylinder identification when excursion limit event occurs" UBYTE _CNV_A_R_LINEAR_____0_CM 1 100. 0. 255. DISPLAY_IDENTIFIER CYL_ID_IGA_DIF_MAX_KNK[43] ECU_ADDRESS 0xd00011ef FORMAT "%3.0" /end MEASUREMENT
/begin MEASUREMENT cyl_id_iga_dif_max_knk[44] "Freeze frame for knocking cylinder identification when excursion limit event occurs" UBYTE _CNV_A_R_LINEAR_____0_CM 1 100. 0. 255. DISPLAY_IDENTIFIER CYL_ID_IGA_DIF_MAX_KNK[44] ECU_ADDRESS 0xd00011f0 FORMAT "%3.0" /end MEASUREMENT
/begin MEASUREMENT cyl_id_iga_dif_max_knk[45] "Freeze frame for knocking cylinder identification when excursion limit event occurs" UBYTE _CNV_A_R_LINEAR_____0_CM 1 100. 0. 255. DISPLAY_IDENTIFIER CYL_ID_IGA_DIF_MAX_KNK[45] ECU_ADDRESS 0xd00011f1 FORMAT "%3.0" /end MEASUREMENT
/begin MEASUREMENT cyl_id_iga_dif_max_knk[46] "Freeze frame for knocking cylinder identification when excursion limit event occurs" UBYTE _CNV_A_R_LINEAR_____0_CM 1 100. 0. 255. DISPLAY_IDENTIFIER CYL_ID_IGA_DIF_MAX_KNK[46] ECU_ADDRESS 0xd00011f2 FORMAT "%3.0" /end MEASUREMENT
/begin MEASUREMENT cyl_id_iga_dif_max_knk[47] "Freeze frame for knocking cylinder identification when excursion limit event occurs" UBYTE _CNV_A_R_LINEAR_____0_CM 1 100. 0. 255. DISPLAY_IDENTIFIER CYL_ID_IGA_DIF_MAX_KNK[47] ECU_ADDRESS 0xd00011f3 FORMAT "%3.0" /end MEASUREMENT
/begin MEASUREMENT cyl_id_iga_dif_max_knk[48] "Freeze frame for knocking cylinder identification when excursion limit event occurs" UBYTE _CNV_A_R_LINEAR_____0_CM 1 100. 0. 255. DISPLAY_IDENTIFIER CYL_ID_IGA_DIF_MAX_KNK[48] ECU_ADDRESS 0xd00011f4 FORMAT "%3.0" /end MEASUREMENT
/begin MEASUREMENT cyl_id_iga_dif_max_knk[49] "Freeze frame for knocking cylinder identification when excursion limit event occurs" UBYTE _CNV_A_R_LINEAR_____0_CM 1 100. 0. 255. DISPLAY_IDENTIFIER CYL_ID_IGA_DIF_MAX_KNK[49] ECU_ADDRESS 0xd00011f5 FORMAT "%3.0" /end MEASUREMENT
/begin MEASUREMENT cyl_id_iga_dif_max_knk[50] "Freeze frame for knocking cylinder identification when excursion limit event occurs" UBYTE _CNV_A_R_LINEAR_____0_CM 1 100. 0. 255. DISPLAY_IDENTIFIER CYL_ID_IGA_DIF_MAX_KNK[50] ECU_ADDRESS 0xd00011f6 FORMAT "%3.0" /end MEASUREMENT
/begin MEASUREMENT cyl_id_iga_dif_max_knk[51] "Freeze frame for knocking cylinder identification when excursion limit event occurs" UBYTE _CNV_A_R_LINEAR_____0_CM 1 100. 0. 255. DISPLAY_IDENTIFIER CYL_ID_IGA_DIF_MAX_KNK[51] ECU_ADDRESS 0xd00011f7 FORMAT "%3.0" /end MEASUREMENT
/begin MEASUREMENT cyl_id_iga_dif_max_knk[52] "Freeze frame for knocking cylinder identification when excursion limit event occurs" UBYTE _CNV_A_R_LINEAR_____0_CM 1 100. 0. 255. DISPLAY_IDENTIFIER CYL_ID_IGA_DIF_MAX_KNK[52] ECU_ADDRESS 0xd00011f8 FORMAT "%3.0" /end MEASUREMENT
/begin MEASUREMENT cyl_id_iga_dif_max_knk[53] "Freeze frame for knocking cylinder identification when excursion limit event occurs" UBYTE _CNV_A_R_LINEAR_____0_CM 1 100. 0. 255. DISPLAY_IDENTIFIER CYL_ID_IGA_DIF_MAX_KNK[53] ECU_ADDRESS 0xd00011f9 FORMAT "%3.0" /end MEASUREMENT
/begin MEASUREMENT cyl_id_iga_dif_max_knk[54] "Freeze frame for knocking cylinder identification when excursion limit event occurs" UBYTE _CNV_A_R_LINEAR_____0_CM 1 100. 0. 255. DISPLAY_IDENTIFIER CYL_ID_IGA_DIF_MAX_KNK[54] ECU_ADDRESS 0xd00011fa FORMAT "%3.0" /end MEASUREMENT
/begin MEASUREMENT cyl_id_iga_dif_max_knk[55] "Freeze frame for knocking cylinder identification when excursion limit event occurs" UBYTE _CNV_A_R_LINEAR_____0_CM 1 100. 0. 255. DISPLAY_IDENTIFIER CYL_ID_IGA_DIF_MAX_KNK[55] ECU_ADDRESS 0xd00011fb FORMAT "%3.0" /end MEASUREMENT
/begin MEASUREMENT cyl_id_iga_dif_max_knk[56] "Freeze frame for knocking cylinder identification when excursion limit event occurs" UBYTE _CNV_A_R_LINEAR_____0_CM 1 100. 0. 255. DISPLAY_IDENTIFIER CYL_ID_IGA_DIF_MAX_KNK[56] ECU_ADDRESS 0xd00011fc FORMAT "%3.0" /end MEASUREMENT
/begin MEASUREMENT cyl_id_iga_dif_max_knk[57] "Freeze frame for knocking cylinder identification when excursion limit event occurs" UBYTE _CNV_A_R_LINEAR_____0_CM 1 100. 0. 255. DISPLAY_IDENTIFIER CYL_ID_IGA_DIF_MAX_KNK[57] ECU_ADDRESS 0xd00011fd FORMAT "%3.0" /end MEASUREMENT
/begin MEASUREMENT cyl_id_iga_dif_max_knk[58] "Freeze frame for knocking cylinder identification when excursion limit event occurs" UBYTE _CNV_A_R_LINEAR_____0_CM 1 100. 0. 255. DISPLAY_IDENTIFIER CYL_ID_IGA_DIF_MAX_KNK[58] ECU_ADDRESS 0xd00011fe FORMAT "%3.0" /end MEASUREMENT
/begin MEASUREMENT cyl_id_iga_dif_max_knk[59] "Freeze frame for knocking cylinder identification when excursion limit event occurs" UBYTE _CNV_A_R_LINEAR_____0_CM 1 100. 0. 255. DISPLAY_IDENTIFIER CYL_ID_IGA_DIF_MAX_KNK[59] ECU_ADDRESS 0xd00011ff FORMAT "%3.0" /end MEASUREMENT
/begin CHARACTERISTIC c_lamb_cop_min "minimum value for catalyst overheating protection" VALUE 0xa080bdc6 _REC_VAL_20_u2 31.9990234375 _CNV_A_R_LINEAR_____129_CM 0. 31.9990234375 DISPLAY_IDENTIFIER C_LAMB_COP_MIN FORMAT "%7.4" /end CHARACTERISTIC
/begin CHARACTERISTIC c_lamb_cop_pas "passive value for the lambda catalyst overheating prevention" VALUE 0xa080bdc8 _REC_VAL_20_u2 31.9990234375 _CNV_A_R_LINEAR_____129_CM 0. 31.9990234375 DISPLAY_IDENTIFIER C_LAMB_COP_PAS FORMAT "%7.4" /end CHARACTERISTIC
/begin CHARACTERISTIC c_lamb_teg_cat_up_mdl_cop_i "I-part of controler" VALUE 0xa080bdfe _REC_VAL_20_u2 3.9219e-003 _CNV_A_R_LINEAR_____208_CM 0. 3.9219e-003 DISPLAY_IDENTIFIER C_LAMB_TEG_CAT_UP_MDL_COP_I FORMAT "%9.8" /end CHARACTERISTIC
/begin CHARACTERISTIC c_lamb_teg_cat_down_cop_i "I-part of controler" VALUE 0xa080bdfc _REC_VAL_20_u2 3.9219e-003 _CNV_A_R_LINEAR_____208_CM 0. 3.9219e-003 DISPLAY_IDENTIFIER C_LAMB_TEG_CAT_DOWN_COP_I FORMAT "%9.8" /end CHARACTERISTIC
/begin CHARACTERISTIC c_lamb_tnt_mdl_h_cop_i "I-part of controler" VALUE 0xa080be00 _REC_VAL_20_u2 3.9219e-003 _CNV_A_R_LINEAR_____208_CM 0. 3.9219e-003 DISPLAY_IDENTIFIER C_LAMB_TNT_MDL_H_COP_I FORMAT "%9.8" /end CHARACTERISTIC
/begin CHARACTERISTIC c_teg_cat_up_mdl_thd_min_cop "bottom threshold for exhaust gas temperature upstream of the precatalyst" VALUE 0xa080c306 _REC_VAL_20_u2 2047. _CNV_A_R_LINEAR_____130_CM 0. 2047. DISPLAY_IDENTIFIER C_TEG_CAT_UP_MDL_THD_MIN_COP FORMAT "%7.2" /end CHARACTERISTIC
/begin CHARACTERISTIC c_tnt_mdl_h_thd_min_cop "bottom threshold for temperature in the NOx Trap catalyst" VALUE 0xa080c338 _REC_VAL_20_u2 1023.984375 _CNV_A_R_LINEAR_____209_CM 0. 1023.984375 DISPLAY_IDENTIFIER C_TNT_MDL_H_THD_MIN_COP FORMAT "%6.1" /end CHARACTERISTIC
/begin CHARACTERISTIC c_tnt_mdl_h_thd_cop "threshold for temperature in the NOx Trap catalyst - I-controller activation" VALUE 0xa080c334 _REC_VAL_20_u2 1023.984375 _CNV_A_R_LINEAR_____209_CM 0. 1023.984375 DISPLAY_IDENTIFIER C_TNT_MDL_H_THD_COP FORMAT "%6.1" /end CHARACTERISTIC
/begin CHARACTERISTIC c_tnt_mdl_h_thd_max_cop "maximum threshold for temperature in the NOx Trap catalyst" VALUE 0xa080c336 _REC_VAL_20_u2 1023.984375 _CNV_A_R_LINEAR_____209_CM 0. 1023.984375 DISPLAY_IDENTIFIER C_TNT_MDL_H_THD_MAX_COP FORMAT "%6.1" /end CHARACTERISTIC
/begin CHARACTERISTIC c_teg_cat_down_thd_min_cop "bottom threshold for exhaust gas temperature downstream of the precatalyst" VALUE 0xa080c2fe _REC_VAL_20_u2 2047. _CNV_A_R_LINEAR_____130_CM 0. 2047. DISPLAY_IDENTIFIER C_TEG_CAT_DOWN_THD_MIN_COP FORMAT "%7.2" /end CHARACTERISTIC
/begin CHARACTERISTIC c_teg_cat_up_mdl_thd_cop "threshold for exhaust gas temperature upstream of the precatalyst - I-controller activation" VALUE 0xa080c302 _REC_VAL_20_u2 2047. _CNV_A_R_LINEAR_____130_CM 0. 2047. DISPLAY_IDENTIFIER C_TEG_CAT_UP_MDL_THD_COP FORMAT "%7.2" /end CHARACTERISTIC
/begin CHARACTERISTIC c_teg_cat_down_thd_cop "threshold for exhaust gas temperature downstream of the precatalyst  - I-controller activation" VALUE 0xa080c2fa _REC_VAL_20_u2 2047. _CNV_A_R_LINEAR_____130_CM 0. 2047. DISPLAY_IDENTIFIER C_TEG_CAT_DOWN_THD_COP FORMAT "%7.2" /end CHARACTERISTIC
/begin CHARACTERISTIC c_teg_cat_up_mdl_thd_max_cop "Maximum threshold for exhaust gas temperature upstream of the precatalyst" VALUE 0xa080c304 _REC_VAL_20_u2 2047. _CNV_A_R_LINEAR_____130_CM 0. 2047. DISPLAY_IDENTIFIER C_TEG_CAT_UP_MDL_THD_MAX_COP FORMAT "%7.2" /end CHARACTERISTIC
/begin CHARACTERISTIC c_teg_cat_down_thd_max_cop "Maximum threshold for exhaust gas temperature downstream of the precatalyst" VALUE 0xa080c2fc _REC_VAL_20_u2 2047. _CNV_A_R_LINEAR_____130_CM 0. 2047. DISPLAY_IDENTIFIER C_TEG_CAT_DOWN_THD_MAX_COP FORMAT "%7.2" /end CHARACTERISTIC
/begin MEASUREMENT lam_bank_1.cat_prev.lamb_cop_cus "lambda for catalyst overheating prevention" UWORD _CNV_A_R_LINEAR_____129_CM 1 100. 0. 31.9990234375 DISPLAY_IDENTIFIER LAMB_COP_CUS_1 ECU_ADDRESS 0xd000b838 FORMAT "%7.4" /end MEASUREMENT
/begin MEASUREMENT lam_bank_1.cat_prev.lv_lamb_cop_cus "general flag for catalyst overheating prevention active and output" UBYTE _CNV_S_2_RANGE__0___1_CM 1 100. 0. 1. DISPLAY_IDENTIFIER LV_LAMB_COP_CUS_1 ECU_ADDRESS 0xd000b842 BIT_MASK 0x1 /end MEASUREMENT
/begin MEASUREMENT lam_bank_1.cat_prev.lamb_teg_cat_up_mdl_cop "calculation value for catalyst overheating prevention upstream of the precatalyst" UWORD _CNV_A_R_LINEAR_____129_CM 1 100. 0. 31.9990234375 DISPLAY_IDENTIFIER LAMB_TEG_CAT_UP_MDL_COP_1 ECU_ADDRESS 0xd000b83a FORMAT "%7.4" /end MEASUREMENT
/begin MEASUREMENT lam_bank_1.cat_prev.lamb_teg_cat_down_cop "calculation value for catalyst overheating prevention downstream the precatalyst" UWORD _CNV_A_R_LINEAR_____129_CM 1 100. 0. 31.9990234375 DISPLAY_IDENTIFIER LAMB_TEG_CAT_DOWN_COP_1 ECU_ADDRESS 0xd000b83c FORMAT "%7.4" /end MEASUREMENT
/begin MEASUREMENT lam_bank_1.cat_prev.lamb_tnt_mdl_h_cop "calculation value for catalyst overheating prevention in the NOx-trap catalyst" UWORD _CNV_A_R_LINEAR_____129_CM 1 100. 0. 31.9990234375 DISPLAY_IDENTIFIER LAMB_TNT_MDL_H_COP_1 ECU_ADDRESS 0xd000b83e FORMAT "%7.4" /end MEASUREMENT
/begin MEASUREMENT lam_bank_1.cat_prev.lv_teg_cat_up_mdl_cop "flag for catalyst overheating prevention active" UBYTE _CNV_S_2_RANGE__0___1_CM 1 100. 0. 1. DISPLAY_IDENTIFIER LV_TEG_CAT_UP_MDL_COP_1 ECU_ADDRESS 0xd000b843 BIT_MASK 0x1 /end MEASUREMENT
/begin MEASUREMENT lam_bank_1.cat_prev.lv_teg_cat_down_cop "flag for catalyst overheating prevention active" UBYTE _CNV_S_2_RANGE__0___1_CM 1 100. 0. 1. DISPLAY_IDENTIFIER LV_TEG_CAT_DOWN_COP_1 ECU_ADDRESS 0xd000b844 BIT_MASK 0x1 /end MEASUREMENT
/begin MEASUREMENT lam_bank_1.cat_prev.lv_tnt_mdl_h_cop "flag for catalyst overheating prevention active" UBYTE _CNV_S_2_RANGE__0___1_CM 1 100. 0. 1. DISPLAY_IDENTIFIER LV_TNT_MDL_H_COP_1 ECU_ADDRESS 0xd000b845 BIT_MASK 0x1 /end MEASUREMENT
/begin MEASUREMENT lam_bank_1.cat_prev.teg_cat_down "Exhaust gas temperature downstream the catalyst" UWORD _CNV_A_R_LINEAR_____130_CM 1 100. 0. 2047. DISPLAY_IDENTIFIER TEG_CAT_DOWN_1 ECU_ADDRESS 0xd000b840 FORMAT "%7.2" /end MEASUREMENT
/begin MEASUREMENT lam_bank_2.cat_prev.lamb_cop_cus "lambda for catalyst overheating prevention" UWORD _CNV_A_R_LINEAR_____129_CM 1 100. 0. 31.9990234375 DISPLAY_IDENTIFIER LAMB_COP_CUS_2 ECU_ADDRESS 0xd000b8b4 FORMAT "%7.4" /end MEASUREMENT
/begin MEASUREMENT lam_bank_2.cat_prev.lv_lamb_cop_cus "general flag for catalyst overheating prevention active and output" UBYTE _CNV_S_2_RANGE__0___1_CM 1 100. 0. 1. DISPLAY_IDENTIFIER LV_LAMB_COP_CUS_2 ECU_ADDRESS 0xd000b8be BIT_MASK 0x1 /end MEASUREMENT
/begin MEASUREMENT lam_bank_2.cat_prev.lamb_teg_cat_up_mdl_cop "calculation value for catalyst overheating prevention upstream of the precatalyst" UWORD _CNV_A_R_LINEAR_____129_CM 1 100. 0. 31.9990234375 DISPLAY_IDENTIFIER LAMB_TEG_CAT_UP_MDL_COP_2 ECU_ADDRESS 0xd000b8b6 FORMAT "%7.4" /end MEASUREMENT
/begin MEASUREMENT lam_bank_2.cat_prev.lamb_teg_cat_down_cop "calculation value for catalyst overheating prevention downstream the precatalyst" UWORD _CNV_A_R_LINEAR_____129_CM 1 100. 0. 31.9990234375 DISPLAY_IDENTIFIER LAMB_TEG_CAT_DOWN_COP_2 ECU_ADDRESS 0xd000b8b8 FORMAT "%7.4" /end MEASUREMENT
/begin MEASUREMENT lam_bank_2.cat_prev.lamb_tnt_mdl_h_cop "calculation value for catalyst overheating prevention in the NOx-trap catalyst" UWORD _CNV_A_R_LINEAR_____129_CM 1 100. 0. 31.9990234375 DISPLAY_IDENTIFIER LAMB_TNT_MDL_H_COP_2 ECU_ADDRESS 0xd000b8ba FORMAT "%7.4" /end MEASUREMENT
/begin MEASUREMENT lam_bank_2.cat_prev.lv_teg_cat_up_mdl_cop "flag for catalyst overheating prevention active" UBYTE _CNV_S_2_RANGE__0___1_CM 1 100. 0. 1. DISPLAY_IDENTIFIER LV_TEG_CAT_UP_MDL_COP_2 ECU_ADDRESS 0xd000b8bf BIT_MASK 0x1 /end MEASUREMENT
/begin MEASUREMENT lam_bank_2.cat_prev.lv_teg_cat_down_cop "flag for catalyst overheating prevention active" UBYTE _CNV_S_2_RANGE__0___1_CM 1 100. 0. 1. DISPLAY_IDENTIFIER LV_TEG_CAT_DOWN_COP_2 ECU_ADDRESS 0xd000b8c0 BIT_MASK 0x1 /end MEASUREMENT
/begin MEASUREMENT lam_bank_2.cat_prev.lv_tnt_mdl_h_cop "flag for catalyst overheating prevention active" UBYTE _CNV_S_2_RANGE__0___1_CM 1 100. 0. 1. DISPLAY_IDENTIFIER LV_TNT_MDL_H_COP_2 ECU_ADDRESS 0xd000b8c1 BIT_MASK 0x1 /end MEASUREMENT
/begin MEASUREMENT lam_bank_2.cat_prev.teg_cat_down "Exhaust gas temperature downstream the catalyst" UWORD _CNV_A_R_LINEAR_____130_CM 1 100. 0. 2047. DISPLAY_IDENTIFIER TEG_CAT_DOWN_2 ECU_ADDRESS 0xd000b8bc FORMAT "%7.2" /end MEASUREMENT
/begin MEASUREMENT mff_sp_hom[0] "Mass fuel flow setpoint for homogeneous charge (output)" UWORD _CNV_A_R_LINEAR_____111_CM 1 100. 0. 1389. DISPLAY_IDENTIFIER MFF_SP_HOM[1] ECU_ADDRESS 0xd000a810 FORMAT "%7.2" /end MEASUREMENT
/begin MEASUREMENT mff_sp_hom[1] "Mass fuel flow setpoint for homogeneous charge (output)" UWORD _CNV_A_R_LINEAR_____111_CM 1 100. 0. 1389. DISPLAY_IDENTIFIER MFF_SP_HOM[2] ECU_ADDRESS 0xd000a812 FORMAT "%7.2" /end MEASUREMENT
/begin MEASUREMENT mff_sp_fup_ctl "Mass fuel flow setpoint for fuel pressure control" UWORD _CNV_A_R_LINEAR_____111_CM 1 100. 0. 1389. DISPLAY_IDENTIFIER MFF_SP_FUP_CTL ECU_ADDRESS 0xd000a81e FORMAT "%7.2" /end MEASUREMENT
/begin MEASUREMENT mff_sp_hom_eng[0] "Mass fuel flow setpoint after combustion seletion" UWORD _CNV_A_R_LINEAR_____111_CM 1 100. 0. 1389. DISPLAY_IDENTIFIER MFF_SP_HOM_ENG[1] ECU_ADDRESS 0xd000a814 FORMAT "%7.2" /end MEASUREMENT
/begin MEASUREMENT mff_sp_hom_eng[1] "Mass fuel flow setpoint after combustion seletion" UWORD _CNV_A_R_LINEAR_____111_CM 1 100. 0. 1389. DISPLAY_IDENTIFIER MFF_SP_HOM_ENG[2] ECU_ADDRESS 0xd000a816 FORMAT "%7.2" /end MEASUREMENT
/begin MEASUREMENT mff_sp_mv "Mass fuel flow setpoint after combustion selection - mean value" UWORD _CNV_A_R_LINEAR_____111_CM 1 100. 0. 1389. DISPLAY_IDENTIFIER MFF_SP_MV ECU_ADDRESS 0xd000a81c FORMAT "%7.2" /end MEASUREMENT
/begin MEASUREMENT mff_sp[0] "Mass fuel flow setpoint after combustion selection - bank selective" UWORD _CNV_A_R_LINEAR_____111_CM 1 100. 0. 1389. DISPLAY_IDENTIFIER MFF_SP[1] ECU_ADDRESS 0xd000a818 FORMAT "%7.2" /end MEASUREMENT
/begin MEASUREMENT mff_sp[1] "Mass fuel flow setpoint after combustion selection - bank selective" UWORD _CNV_A_R_LINEAR_____111_CM 1 100. 0. 1389. DISPLAY_IDENTIFIER MFF_SP[2] ECU_ADDRESS 0xd000a81a FORMAT "%7.2" /end MEASUREMENT
/begin CHARACTERISTIC c_lamb_bas_cor_min "Minimum value for lambda setpoint" VALUE 0xa080bdc4 _REC_VAL_20_u2 31.9990234375 _CNV_A_R_LINEAR_____129_CM 0. 31.9990234375 DISPLAY_IDENTIFIER C_LAMB_BAS_COR_MIN FORMAT "%7.4" /end CHARACTERISTIC
/begin MEASUREMENT inh_iv_amt "Shut off sequence of AMT transmission" UBYTE _CNV_A_R_LINEAR_____0_CM 1 100. 0. 255. DISPLAY_IDENTIFIER INH_IV_AMT ECU_ADDRESS 0xd0008e3a FORMAT "%3.0" /end MEASUREMENT
/begin MEASUREMENT lv_ast_end "logical bit for \"After-start end\"" UBYTE _CNV_S_2_RANGE__0___1_CM 1 100. 0. 1. DISPLAY_IDENTIFIER LV_AST_END ECU_ADDRESS 0xd0008c89 BIT_MASK 0x1 /end MEASUREMENT
/begin AXIS_PTS ldpm_tia_ip_ti_cast "" 0xa0809852 tia _REC_AXS_20_u1 28.575 _CNV_A_R_LINEAR_____17_CM 2 -48. 142.5 FORMAT "%5.1" /end AXIS_PTS
/begin AXIS_PTS ldpm_tco__mff_deac_cst "" 0xa08097ac tco _REC_AXS_20_u1 19.05 _CNV_A_R_LINEAR_____17_CM 10 -48. 142.5 FORMAT "%5.1" /end AXIS_PTS
/begin MEASUREMENT ti_cast "Cold post start injection time correction" UWORD _CNV_A_R_LINEAR_____24_CM 1 100. 0. 3.99993896484375 DISPLAY_IDENTIFIER TI_CAST ECU_ADDRESS 0xd000a824 FORMAT "%7.5" /end MEASUREMENT
/begin AXIS_PTS ldpm_fac_st_rest "" 0xa08093aa fac_st_rest _REC_AXS_20_u1 1.99220002 _CNV_A_R_LINEAR_____100_CM 6 0. 1.99220002 FORMAT "%5.3" /end AXIS_PTS
/begin AXIS_PTS ldpm_cyc_cast_1 "" 0xa0809374 cyc_cast _REC_AXS_20_u2 65535. _CNV_A_R_LINEAR_____0_CM 8 0. 65535. FORMAT "%5.0" /end AXIS_PTS
/begin AXIS_PTS ldpm_cyc_cast_2 "" 0xa0809388 cyc_cast _REC_AXS_20_u2 65535. _CNV_A_R_LINEAR_____0_CM 16 0. 65535. FORMAT "%5.0" /end AXIS_PTS
/begin MEASUREMENT ti_cast_h_prs "cold start fuel mass flow at high fuel pressure" UWORD _CNV_A_R_LINEAR_____24_CM 1 100. 0. 3.99993896484375 DISPLAY_IDENTIFIER TI_CAST_H_PRS ECU_ADDRESS 0xd00016a4 FORMAT "%7.5" /end MEASUREMENT
/begin MEASUREMENT ti_cast_lih_l_prs "cold start fuel mass flow at limb home low fuel pressure" UWORD _CNV_A_R_LINEAR_____24_CM 1 100. 0. 3.99993896484375 DISPLAY_IDENTIFIER TI_CAST_LIH_L_PRS ECU_ADDRESS 0xd00016a6 FORMAT "%7.5" /end MEASUREMENT
/begin CHARACTERISTIC ip_fac_rest_ti_cast_h_prs "Correction of TI_CAST at restart high fuel pressure" MAP 0xa080a494 _REC_MAP_20_u1_u2_u1 9.9609375e-002 _CNV_A_R_LINEAR_____185_CM 0. 0.99609375 DISPLAY_IDENTIFIER IP_FAC_REST_TI_CAST_H_PRS FORMAT "%5.3"
 /begin AXIS_DESCR COM_AXIS cyc_cast _CNV_A_R_LINEAR_____0_CM 8 0. 65535. FORMAT "%5.0" AXIS_PTS_REF ldpm_cyc_cast_1 /end AXIS_DESCR
 /begin AXIS_DESCR COM_AXIS fac_st_rest _CNV_A_R_LINEAR_____100_CM 6 0. 1.99220002 FORMAT "%5.3" AXIS_PTS_REF ldpm_fac_st_rest /end AXIS_DESCR
/end CHARACTERISTIC
/begin CHARACTERISTIC ip_fac_rest_ti_cast_lih_l_prs "Correction of TI_CAST at restart low fuel pressure" MAP 0xa080a4c4 _REC_MAP_20_u1_u2_u1 9.9609375e-002 _CNV_A_R_LINEAR_____185_CM 0. 0.99609375 DISPLAY_IDENTIFIER IP_FAC_REST_TI_CAST_LIH_L_PRS FORMAT "%5.3"
 /begin AXIS_DESCR COM_AXIS cyc_cast _CNV_A_R_LINEAR_____0_CM 8 0. 65535. FORMAT "%5.0" AXIS_PTS_REF ldpm_cyc_cast_1 /end AXIS_DESCR
 /begin AXIS_DESCR COM_AXIS fac_st_rest _CNV_A_R_LINEAR_____100_CM 6 0. 1.99220002 FORMAT "%5.3" AXIS_PTS_REF ldpm_fac_st_rest /end AXIS_DESCR
/end CHARACTERISTIC
/begin CHARACTERISTIC ip_ti_cast_h_prs "Initialization value of post start enrichment factor at high fuel pressure" MAP 0xa080b584 _REC_MAP_20_u1_u1_u1 0.3984375 _CNV_A_R_LINEAR_____243_CM 0. 3.984375 DISPLAY_IDENTIFIER IP_TI_CAST_H_PRS FORMAT "%4.2"
 /begin AXIS_DESCR COM_AXIS tia _CNV_A_R_LINEAR_____17_CM 2 -48. 142.5 FORMAT "%5.1" AXIS_PTS_REF ldpm_tia_ip_ti_cast /end AXIS_DESCR
 /begin AXIS_DESCR COM_AXIS tco _CNV_A_R_LINEAR_____17_CM 10 -48. 142.5 FORMAT "%5.1" AXIS_PTS_REF ldpm_tco__mff_deac_cst /end AXIS_DESCR
/end CHARACTERISTIC
/begin CHARACTERISTIC ip_ti_cast_lih_l_prs "Initialization value of post start enrichment factor at low fuel pressure" MAP 0xa080b598 _REC_MAP_20_u1_u1_u1 0.3984375 _CNV_A_R_LINEAR_____243_CM 0. 3.984375 DISPLAY_IDENTIFIER IP_TI_CAST_LIH_L_PRS FORMAT "%4.2"
 /begin AXIS_DESCR COM_AXIS tia _CNV_A_R_LINEAR_____17_CM 2 -48. 142.5 FORMAT "%5.1" AXIS_PTS_REF ldpm_tia_ip_ti_cast /end AXIS_DESCR
 /begin AXIS_DESCR COM_AXIS tco _CNV_A_R_LINEAR_____17_CM 10 -48. 142.5 FORMAT "%5.1" AXIS_PTS_REF ldpm_tco__mff_deac_cst /end AXIS_DESCR
/end CHARACTERISTIC
/begin CHARACTERISTIC ip_ti_deac_cast_h_prs "Deactivation factor of post start enrichment at high fuel pressure" MAP 0xa0815f44 _REC_MAP_20_u1_u2_u1 9.9609375e-002 _CNV_A_R_LINEAR_____185_CM 0. 0.99609375 DISPLAY_IDENTIFIER IP_TI_DEAC_CAST_H_PRS FORMAT "%5.3"
 /begin AXIS_DESCR COM_AXIS cyc_cast _CNV_A_R_LINEAR_____0_CM 16 0. 65535. FORMAT "%5.0" AXIS_PTS_REF ldpm_cyc_cast_2 /end AXIS_DESCR
 /begin AXIS_DESCR COM_AXIS tco _CNV_A_R_LINEAR_____17_CM 10 -48. 142.5 FORMAT "%5.1" AXIS_PTS_REF ldpm_tco__mff_deac_cst /end AXIS_DESCR
/end CHARACTERISTIC
/begin CHARACTERISTIC ip_ti_deac_cast_lih_l_prs "Deactivation factor of post start enrichment at low fuel pressure" MAP 0xa0815fe4 _REC_MAP_20_u1_u2_u1 9.9609375e-002 _CNV_A_R_LINEAR_____185_CM 0. 0.99609375 DISPLAY_IDENTIFIER IP_TI_DEAC_CAST_LIH_L_PRS FORMAT "%5.3"
 /begin AXIS_DESCR COM_AXIS cyc_cast _CNV_A_R_LINEAR_____0_CM 16 0. 65535. FORMAT "%5.0" AXIS_PTS_REF ldpm_cyc_cast_2 /end AXIS_DESCR
 /begin AXIS_DESCR COM_AXIS tco _CNV_A_R_LINEAR_____17_CM 10 -48. 142.5 FORMAT "%5.1" AXIS_PTS_REF ldpm_tco__mff_deac_cst /end AXIS_DESCR
/end CHARACTERISTIC
/begin AXIS_PTS ldp_fup_fac_ti_cast "" 0xa0808728 fup[0] _REC_AXS_20_u2 347776. _CNV_A_R_LINEAR_____171_CM 6 0. 347776. FORMAT "%6.0" /end AXIS_PTS
/begin CHARACTERISTIC ip_fac_ti_cast_fup "Factor for weighting the influence of fuel pressure on cold post start injection" CURVE 0xa080a790 _REC_CUR_20_u1_u2 1.9921875 _CNV_A_R_LINEAR_____103_CM 0. 1.9921875 DISPLAY_IDENTIFIER IP_FAC_TI_CAST_FUP FORMAT "%5.3"
 /begin AXIS_DESCR COM_AXIS fup[0] _CNV_A_R_LINEAR_____171_CM 6 0. 347776. FORMAT "%6.0" AXIS_PTS_REF ldp_fup_fac_ti_cast /end AXIS_DESCR
/end CHARACTERISTIC
/begin MEASUREMENT ti_wup_1 "Warm-up enrichment part after operation mode manager, intermediate value" UWORD _CNV_A_R_LINEAR_____24_CM 1 100. 0. 3.99993896484375 DISPLAY_IDENTIFIER TI_WUP_1 ECU_ADDRESS 0xd0001726 FORMAT "%7.5" /end MEASUREMENT
/begin MEASUREMENT ti_wup "Warm-up injection time correction" UWORD _CNV_A_R_LINEAR_____24_CM 1 100. 0. 3.99993896484375 DISPLAY_IDENTIFIER TI_WUP ECU_ADDRESS 0xd000a828 FORMAT "%7.5" /end MEASUREMENT
/begin MEASUREMENT ti_temp "Warm-up enrichment part, intermediate, permanent part" UWORD _CNV_A_R_LINEAR_____24_CM 1 100. 0. 3.99993896484375 DISPLAY_IDENTIFIER TI_TEMP ECU_ADDRESS 0xd000171c FORMAT "%7.5" /end MEASUREMENT
/begin CHARACTERISTIC ip_ti_fac_n_map "Injection time weighting for temperature influence f(operating point)" MAP 0xa080b5ac _REC_MAP_20_u1_u2_u1 9.9609375e-002 _CNV_A_R_LINEAR_____28_CM 0. 0.99609375 DISPLAY_IDENTIFIER IP_TI_FAC_N_MAP FORMAT "%5.3"
 /begin AXIS_DESCR COM_AXIS map _CNV_A_R_LINEAR_____27_CM 8 0. 5434. FORMAT "%7.2" AXIS_PTS_REF ldp_map__ti_fac_n_map /end AXIS_DESCR
 /begin AXIS_DESCR COM_AXIS n_32 _CNV_A_R_LINEAR_____10_CM 8 0. 8160. FORMAT "%4.0" AXIS_PTS_REF ldp_n_32__ti_fac_n_map /end AXIS_DESCR
/end CHARACTERISTIC
/begin CHARACTERISTIC ip_ti_fac_tia_toil "Injection time weighting for temperature influence f(TIA, TOIL)" MAP 0xa080b5f0 _REC_MAP_20_u1_u1_u1 0.19921875 _CNV_A_R_LINEAR_____103_CM 0. 1.9921875 DISPLAY_IDENTIFIER IP_TI_FAC_TIA_TOIL FORMAT "%8.6"
 /begin AXIS_DESCR COM_AXIS tia _CNV_A_R_LINEAR_____17_CM 6 -48. 142.5 FORMAT "%6.2" AXIS_PTS_REF ldp_tia_ti_fac_tia_toil /end AXIS_DESCR
 /begin AXIS_DESCR COM_AXIS toil _CNV_A_R_LINEAR_____26_CM 6 -40. 160. FORMAT "%3.0" AXIS_PTS_REF ldp_toil_ti_fac_tia_toil /end AXIS_DESCR
/end CHARACTERISTIC
/begin CHARACTERISTIC ip_ti_fac_tco "Injection time weighting for temperature influence f(coolant temperature)" CURVE 0xa080b5ec _REC_CUR_20_u1_u1 9.9609375e-002 _CNV_A_R_LINEAR_____28_CM 0. 0.99609375 DISPLAY_IDENTIFIER IP_TI_FAC_TCO FORMAT "%5.3"
 /begin AXIS_DESCR COM_AXIS tco _CNV_A_R_LINEAR_____17_CM 3 -48. 142.5 FORMAT "%6.2" AXIS_PTS_REF ldp_tco__ti_fac_tco /end AXIS_DESCR
/end CHARACTERISTIC
/begin AXIS_PTS ldpm_maf_hb__ti_wup "" 0xa08094e4 maf_hb _REC_AXS_20_u1 1389. _CNV_A_R_LINEAR_____15_CM 8 0. 1389. FORMAT "%4.0" /end AXIS_PTS
/begin AXIS_PTS ldpm_n_32__ti_wup "" 0xa0809604 n_32 _REC_AXS_20_u1 8160. _CNV_A_R_LINEAR_____10_CM 8 0. 8160. FORMAT "%4.0" /end AXIS_PTS
/begin AXIS_PTS ldp_map_dif__fac_ti_vo_wup "" 0xa0808914 online_dummy _REC_AXS_20_u2 5434. _CNV_A_R_LINEAR_____27_CM 8 0. 5434. FORMAT "%7.2" /end AXIS_PTS
/begin AXIS_PTS ldp_map__ti_fac_n_map "" 0xa0808900 map _REC_AXS_20_u2 5434. _CNV_A_R_LINEAR_____27_CM 8 0. 5434. FORMAT "%7.2" /end AXIS_PTS
/begin AXIS_PTS ldp_n_32__ti_fac_n_map "" 0xa08089a4 n_32 _REC_AXS_20_u1 8160. _CNV_A_R_LINEAR_____10_CM 8 0. 8160. FORMAT "%4.0" /end AXIS_PTS
/begin AXIS_PTS ldp_toil_ti_fac_tia_toil "" 0xa0808f46 toil _REC_AXS_20_u1 200. _CNV_A_R_LINEAR_____26_CM 6 -40. 160. FORMAT "%3.0" /end AXIS_PTS
/begin AXIS_PTS ldp_tia_ti_fac_tia_toil "" 0xa0808e9e tia _REC_AXS_20_u1 190.5 _CNV_A_R_LINEAR_____17_CM 6 -48. 142.5 FORMAT "%6.2" /end AXIS_PTS
/begin AXIS_PTS ldp_tco__ti_fac_tco "" 0xa0808df4 tco _REC_AXS_20_u1 190.5 _CNV_A_R_LINEAR_____17_CM 3 -48. 142.5 FORMAT "%6.2" /end AXIS_PTS
/begin CHARACTERISTIC ip_fac_ti_vo_wup "Factor map for TCO/VO dependent warm up correction" MAP 0xa080a7c8 _REC_MAP_20_u1_u2_u1 0.19921875 _CNV_A_R_LINEAR_____103_CM 0. 1.9921875 DISPLAY_IDENTIFIER IP_FAC_TI_VO_WUP FORMAT "%8.6"
 /begin AXIS_DESCR COM_AXIS online_dummy _CNV_A_R_LINEAR_____27_CM 8 0. 5434. FORMAT "%7.2" AXIS_PTS_REF ldp_map_dif__fac_ti_vo_wup /end AXIS_DESCR
 /begin AXIS_DESCR COM_AXIS n_32 _CNV_A_R_LINEAR_____10_CM 8 0. 8160. FORMAT "%4.0" AXIS_PTS_REF ldpm_n_32__ti_wup /end AXIS_DESCR
/end CHARACTERISTIC
/begin MEASUREMENT ti_wup_1_add "Warm-up enrichment, additive part of intermediate value" UWORD _CNV_A_R_LINEAR_____24_CM 1 100. 0. 3.99993896484375 DISPLAY_IDENTIFIER TI_WUP_1_ADD ECU_ADDRESS 0xd000a82a FORMAT "%7.5" /end MEASUREMENT
/begin MEASUREMENT ti_wup_1_h_prs "Warm up enrichment part at high fuel pressure" UWORD _CNV_A_R_LINEAR_____24_CM 1 100. 0. 3.99993896484375 DISPLAY_IDENTIFIER TI_WUP_1_H_PRS ECU_ADDRESS 0xd000171e FORMAT "%7.5" /end MEASUREMENT
/begin MEASUREMENT ti_wup_1_add_h_prs "Warm up enrichment, additive part of intermediate value at high fuel pressure" UWORD _CNV_A_R_LINEAR_____24_CM 1 100. 0. 3.99993896484375 DISPLAY_IDENTIFIER TI_WUP_1_ADD_H_PRS ECU_ADDRESS 0xd0001722 FORMAT "%7.5" /end MEASUREMENT
/begin MEASUREMENT ti_wup_1_lih_l_prs "Warm up enrichment part at low fuel pressure" UWORD _CNV_A_R_LINEAR_____24_CM 1 100. 0. 3.99993896484375 DISPLAY_IDENTIFIER TI_WUP_1_LIH_L_PRS ECU_ADDRESS 0xd0001720 FORMAT "%7.5" /end MEASUREMENT
/begin MEASUREMENT ti_wup_1_add_lih_l_prs "Warm up enrichment, additive part of intermediate value at low fuel pressure" UWORD _CNV_A_R_LINEAR_____24_CM 1 100. 0. 3.99993896484375 DISPLAY_IDENTIFIER TI_WUP_1_ADD_LIH_L_PRS ECU_ADDRESS 0xd0001724 FORMAT "%7.5" /end MEASUREMENT
/begin CHARACTERISTIC ip_fac_ti_tco_wup_h_prs "warm up basic factor at high fuel pressure" CURVE 0xa080a7b8 _REC_CUR_20_u1_u1 0.19921875 _CNV_A_R_LINEAR_____103_CM 0. 1.9921875 DISPLAY_IDENTIFIER IP_FAC_TI_TCO_WUP_H_PRS FORMAT "%8.6"
 /begin AXIS_DESCR COM_AXIS tco _CNV_A_R_LINEAR_____17_CM 8 -48. 142.5 FORMAT "%6.2" AXIS_PTS_REF ldpm_tco__ti_wup_h_prs /end AXIS_DESCR
/end CHARACTERISTIC
/begin AXIS_PTS ldpm_tco__ti_wup_h_prs "" 0xa08097d0 tco _REC_AXS_20_u1 190.5 _CNV_A_R_LINEAR_____17_CM 8 -48. 142.5 FORMAT "%6.2" /end AXIS_PTS
/begin CHARACTERISTIC ip_fac_ti_tco_wup_lih_l_prs "warm up basic factor at low fuel pressure" CURVE 0xa080a7c0 _REC_CUR_20_u1_u1 0.19921875 _CNV_A_R_LINEAR_____103_CM 0. 1.9921875 DISPLAY_IDENTIFIER IP_FAC_TI_TCO_WUP_LIH_L_PRS FORMAT "%8.6"
 /begin AXIS_DESCR COM_AXIS tco _CNV_A_R_LINEAR_____17_CM 8 -48. 142.5 FORMAT "%6.2" AXIS_PTS_REF ldpm_tco__ti_wup_lih_l_prs /end AXIS_DESCR
/end CHARACTERISTIC
/begin AXIS_PTS ldpm_tco__ti_wup_lih_l_prs "" 0xa08097dc tco _REC_AXS_20_u1 190.5 _CNV_A_R_LINEAR_____17_CM 8 -48. 142.5 FORMAT "%6.2" /end AXIS_PTS
/begin CHARACTERISTIC ip_ti_tco_wup_h_prs "TCO/TCO_ST dependent warm up correction at high fuel pressure" MAP 0xa080b614 _REC_MAP_20_u1_u1_u1 0.19921875 _CNV_A_R_LINEAR_____103_CM 0. 1.9921875 DISPLAY_IDENTIFIER IP_TI_TCO_WUP_H_PRS FORMAT "%8.6"
 /begin AXIS_DESCR COM_AXIS tco_st _CNV_A_R_LINEAR_____17_CM 3 -48. 142.5 FORMAT "%6.2" AXIS_PTS_REF ldp_tco_st_ti_tco_wup_h_prs /end AXIS_DESCR
 /begin AXIS_DESCR COM_AXIS tco _CNV_A_R_LINEAR_____17_CM 8 -48. 142.5 FORMAT "%6.2" AXIS_PTS_REF ldpm_tco__ti_wup_h_prs /end AXIS_DESCR
/end CHARACTERISTIC
/begin AXIS_PTS ldp_tco_st_ti_tco_wup_h_prs "" 0xa0808e12 tco_st _REC_AXS_20_u1 190.5 _CNV_A_R_LINEAR_____17_CM 3 -48. 142.5 FORMAT "%6.2" /end AXIS_PTS
/begin AXIS_PTS ldp_tco_st_ti_tco_wup_lih_l_prs "" 0xa0808e16 tco_st _REC_AXS_20_u1 190.5 _CNV_A_R_LINEAR_____17_CM 3 -48. 142.5 FORMAT "%6.2" /end AXIS_PTS
/begin CHARACTERISTIC ip_ti_tco_wup_lih_l_prs "TCO/TCO_ST dependent warm up correction at low fuel pressure" MAP 0xa080b62c _REC_MAP_20_u1_u1_u1 0.19921875 _CNV_A_R_LINEAR_____103_CM 0. 1.9921875 DISPLAY_IDENTIFIER IP_TI_TCO_WUP_LIH_L_PRS FORMAT "%8.6"
 /begin AXIS_DESCR COM_AXIS tco_st _CNV_A_R_LINEAR_____17_CM 3 -48. 142.5 FORMAT "%6.2" AXIS_PTS_REF ldp_tco_st_ti_tco_wup_lih_l_prs /end AXIS_DESCR
 /begin AXIS_DESCR COM_AXIS tco _CNV_A_R_LINEAR_____17_CM 8 -48. 142.5 FORMAT "%6.2" AXIS_PTS_REF ldpm_tco__ti_wup_lih_l_prs /end AXIS_DESCR
/end CHARACTERISTIC
/begin CHARACTERISTIC ip_ti_wup_h_prs "TI warm up correction at high fuel pressure" MAP 0xa080b644 _REC_MAP_20_u1_u1_u1 0.1494140625 _CNV_A_R_LINEAR_____185_CM 0. 0.99609375 DISPLAY_IDENTIFIER IP_TI_WUP_H_PRS FORMAT "%5.3"
 /begin AXIS_DESCR COM_AXIS maf_hb _CNV_A_R_LINEAR_____15_CM 8 0. 1389. FORMAT "%4.0" AXIS_PTS_REF ldpm_maf_hb__ti_wup /end AXIS_DESCR
 /begin AXIS_DESCR COM_AXIS n_32 _CNV_A_R_LINEAR_____10_CM 8 0. 8160. FORMAT "%4.0" AXIS_PTS_REF ldpm_n_32__ti_wup /end AXIS_DESCR
/end CHARACTERISTIC
/begin CHARACTERISTIC ip_ti_wup_lih_l_prs "TI warm up correction at low fuel pressure" MAP 0xa080b684 _REC_MAP_20_u1_u1_u1 0.1494140625 _CNV_A_R_LINEAR_____185_CM 0. 0.99609375 DISPLAY_IDENTIFIER IP_TI_WUP_LIH_L_PRS FORMAT "%5.3"
 /begin AXIS_DESCR COM_AXIS maf_hb _CNV_A_R_LINEAR_____15_CM 8 0. 1389. FORMAT "%4.0" AXIS_PTS_REF ldpm_maf_hb__ti_wup /end AXIS_DESCR
 /begin AXIS_DESCR COM_AXIS n_32 _CNV_A_R_LINEAR_____10_CM 8 0. 8160. FORMAT "%4.0" AXIS_PTS_REF ldpm_n_32__ti_wup /end AXIS_DESCR
/end CHARACTERISTIC
/begin MEASUREMENT fac_ti_wup_fup "Factor for weighting the influence of fuel pressure on warm up injection" UBYTE _CNV_A_R_LINEAR_____103_CM 1 100. 0. 1.9921875 DISPLAY_IDENTIFIER FAC_TI_WUP_FUP ECU_ADDRESS 0xd0001728 FORMAT "%5.3" /end MEASUREMENT
/begin CHARACTERISTIC c_crlc_fac_ti_wup_fup "Low pass filter correlation constant for the weighting factor of fuel pressure" VALUE 0xa080bae6 _REC_VAL_20_u1 0.99609375 _CNV_A_R_LINEAR_____185_CM 0. 0.99609375 DISPLAY_IDENTIFIER C_CRLC_FAC_TI_WUP_FUP FORMAT "%5.3" /end CHARACTERISTIC
/begin AXIS_PTS ldp_fup_fac_ti_wup "" 0xa0808738 fup[0] _REC_AXS_20_u2 347776. _CNV_A_R_LINEAR_____171_CM 6 0. 347776. FORMAT "%6.0" /end AXIS_PTS
/begin CHARACTERISTIC ip_fac_ti_wup_fup "Factor for weighting the influence of fuel pressure on warm up injection" CURVE 0xa080a808 _REC_CUR_20_u1_u2 0.298828125 _CNV_A_R_LINEAR_____103_CM 0. 1.9921875 DISPLAY_IDENTIFIER IP_FAC_TI_WUP_FUP FORMAT "%5.3"
 /begin AXIS_DESCR COM_AXIS fup[0] _CNV_A_R_LINEAR_____171_CM 6 0. 347776. FORMAT "%6.0" AXIS_PTS_REF ldp_fup_fac_ti_wup /end AXIS_DESCR
/end CHARACTERISTIC
/begin MEASUREMENT lv_ad_clr_ron "toggle bit for reseting of RON adaption value" UBYTE _CNV_S_2_RANGE__0___1_CM 1 100. 0. 1. DISPLAY_IDENTIFIER LV_AD_CLR_RON ECU_ADDRESS 0xd0003498 BIT_MASK 0x1 /end MEASUREMENT
/begin CHARACTERISTIC c_knks_rel_ini "ini value of relative knock signal" VALUE 0xa080bdbe _REC_VAL_20_u2 0.999755 _CNV_A_R_LINEAR_____433_CM 0. 0.999755 DISPLAY_IDENTIFIER C_KNKS_REL_INI FORMAT "%7.5" /end CHARACTERISTIC
/begin MEASUREMENT knks_rel_nl[0] "Relative knock value" UWORD _CNV_A_R_LINEAR_____126_CM 1 100. 0. 0.9999847 DISPLAY_IDENTIFIER KNKS_REL_NL[0] ECU_ADDRESS 0xd000ac9c FORMAT "%7.5" /end MEASUREMENT
/begin MEASUREMENT knks_rel_nl[1] "Relative knock value" UWORD _CNV_A_R_LINEAR_____126_CM 1 100. 0. 0.9999847 DISPLAY_IDENTIFIER KNKS_REL_NL[1] ECU_ADDRESS 0xd000ac9e FORMAT "%7.5" /end MEASUREMENT
/begin MEASUREMENT knks_rel_nl[2] "Relative knock value" UWORD _CNV_A_R_LINEAR_____126_CM 1 100. 0. 0.9999847 DISPLAY_IDENTIFIER KNKS_REL_NL[2] ECU_ADDRESS 0xd000aca0 FORMAT "%7.5" /end MEASUREMENT
/begin MEASUREMENT knks_rel_nl[3] "Relative knock value" UWORD _CNV_A_R_LINEAR_____126_CM 1 100. 0. 0.9999847 DISPLAY_IDENTIFIER KNKS_REL_NL[3] ECU_ADDRESS 0xd000aca2 FORMAT "%7.5" /end MEASUREMENT
/begin MEASUREMENT knks_rel_nl[4] "Relative knock value" UWORD _CNV_A_R_LINEAR_____126_CM 1 100. 0. 0.9999847 DISPLAY_IDENTIFIER KNKS_REL_NL[4] ECU_ADDRESS 0xd000aca4 FORMAT "%7.5" /end MEASUREMENT
/begin MEASUREMENT knks_rel_nl[5] "Relative knock value" UWORD _CNV_A_R_LINEAR_____126_CM 1 100. 0. 0.9999847 DISPLAY_IDENTIFIER KNKS_REL_NL[5] ECU_ADDRESS 0xd000aca6 FORMAT "%7.5" /end MEASUREMENT
/begin MEASUREMENT knks_rel_nl[6] "Relative knock value" UWORD _CNV_A_R_LINEAR_____126_CM 1 100. 0. 0.9999847 DISPLAY_IDENTIFIER KNKS_REL_NL[6] ECU_ADDRESS 0xd000aca8 FORMAT "%7.5" /end MEASUREMENT
/begin MEASUREMENT knks_rel_nl[7] "Relative knock value" UWORD _CNV_A_R_LINEAR_____126_CM 1 100. 0. 0.9999847 DISPLAY_IDENTIFIER KNKS_REL_NL[7] ECU_ADDRESS 0xd000acaa FORMAT "%7.5" /end MEASUREMENT
/begin MEASUREMENT lamb_sp "lambda setpoint" UWORD _CNV_A_R_LINEAR_____129_CM 1 100. 0. 31.9990234375 DISPLAY_IDENTIFIER LAMB_SP ECU_ADDRESS 0xd000a228 FORMAT "%7.4" /end MEASUREMENT
/begin MEASUREMENT lamb_hom_afl "lambda setpoint for homogeneous lean combustion" UWORD _CNV_A_R_LINEAR_____129_CM 1 100. 0. 31.9990234375 DISPLAY_IDENTIFIER LAMB_HOM_AFL ECU_ADDRESS 0xd000a22e FORMAT "%7.4" /end MEASUREMENT
/begin MEASUREMENT lamb_bas_h_res[0] "bank selective basic lambda setpoint with high resolution" ULONG _CNV_A_R_LINEAR_____453_CM 1 100. 0. 32. DISPLAY_IDENTIFIER LAMB_BAS_H_RES[1] ECU_ADDRESS 0xd000ad98 FORMAT "%8.5" /end MEASUREMENT
/begin MEASUREMENT lamb_bas_h_res[1] "bank selective basic lambda setpoint with high resolution" ULONG _CNV_A_R_LINEAR_____453_CM 1 100. 0. 32. DISPLAY_IDENTIFIER LAMB_BAS_H_RES[2] ECU_ADDRESS 0xd000ad9c FORMAT "%8.5" /end MEASUREMENT
/begin MEASUREMENT lamb_bas[0] "basic lambda setpoint" UWORD _CNV_A_R_LINEAR_____129_CM 1 100. 0. 31.9990234375 DISPLAY_IDENTIFIER LAMB_BAS[1] ECU_ADDRESS 0xd000a22a FORMAT "%7.4" /end MEASUREMENT
/begin MEASUREMENT lamb_bas[1] "basic lambda setpoint" UWORD _CNV_A_R_LINEAR_____129_CM 1 100. 0. 31.9990234375 DISPLAY_IDENTIFIER LAMB_BAS[2] ECU_ADDRESS 0xd000a22c FORMAT "%7.4" /end MEASUREMENT
/begin CHARACTERISTIC c_mff_fac "Constannt for stoichiometric air/fuel ratio (=1/14.7)" VALUE 0xa080be7a _REC_VAL_20_u2 0.125 _CNV_A_R_LINEAR_____454_CM 0. 0.125 DISPLAY_IDENTIFIER C_MFF_FAC FORMAT "%7.5" /end CHARACTERISTIC
/begin MEASUREMENT iga_bas_egr_cor_hom "Additive basic ignition angle correction due to EGR influence to homogenous mode" SBYTE _CNV_A_R_LINEAR_____200_CM 1 100. -48. 47.625 DISPLAY_IDENTIFIER IGA_BAS_EGR_COR_HOM ECU_ADDRESS 0xd0000dc2 FORMAT "%5.1" /end MEASUREMENT
/begin MEASUREMENT iga_bas_egr_cor_s "Additive basic ignition angle correction due to EGR influence to stratified mode" SBYTE _CNV_A_R_LINEAR_____200_CM 1 100. -48. 47.625 DISPLAY_IDENTIFIER IGA_BAS_EGR_COR_S ECU_ADDRESS 0xd0000dc3 FORMAT "%5.1" /end MEASUREMENT
/begin CHARACTERISTIC ip_fac_rate_egr_afl "Temperature corrective factor (air/fuel lean)" CURVE 0xa080a444 _REC_CUR_20_u1_u1 1.99220002 _CNV_A_R_LINEAR_____100_CM 0. 1.99220002 DISPLAY_IDENTIFIER IP_FAC_RATE_EGR_AFL FORMAT "%5.3"
 /begin AXIS_DESCR COM_AXIS tco _CNV_A_R_LINEAR_____17_CM 8 -48. 142.5 FORMAT "%5.1" AXIS_PTS_REF ldpm_tco__iga_egr /end AXIS_DESCR
/end CHARACTERISTIC
/begin CHARACTERISTIC ip_fac_rate_egr_s "temperature corrective factor (stratified mode)" CURVE 0xa080a44c _REC_CUR_20_u1_u1 1.99220002 _CNV_A_R_LINEAR_____100_CM 0. 1.99220002 DISPLAY_IDENTIFIER IP_FAC_RATE_EGR_S FORMAT "%5.3"
 /begin AXIS_DESCR COM_AXIS tco _CNV_A_R_LINEAR_____17_CM 8 -48. 142.5 FORMAT "%5.1" AXIS_PTS_REF ldpm_tco__iga_egr /end AXIS_DESCR
/end CHARACTERISTIC
/begin CHARACTERISTIC ip_iga_egr_s "Spark advance added to basic value with EGR function (stratified mode)" MAP 0xa080ad34 _REC_MAP_20_u1_u1_u2 95.625 _CNV_A_R_LINEAR_____198_CM -48. 47.625 DISPLAY_IDENTIFIER IP_IGA_EGR_S FORMAT "%5.1"
 /begin AXIS_DESCR COM_AXIS n_32 _CNV_A_R_LINEAR_____10_CM 5 0. 8160. FORMAT "%4.0" AXIS_PTS_REF ldp_n_32__iga_egr_s /end AXIS_DESCR
 /begin AXIS_DESCR COM_AXIS mff_sp_s _CNV_A_R_LINEAR_____111_CM 5 0. 1389. FORMAT "%7.2" AXIS_PTS_REF ldp_mff_sp_s__egr_iga /end AXIS_DESCR
/end CHARACTERISTIC
/begin MEASUREMENT iga_bas_egr_cor "Additive basic ignition angle correction due to EGR influence" SBYTE _CNV_A_R_LINEAR_____200_CM 1 100. -48. 47.625 DISPLAY_IDENTIFIER IGA_BAS_EGR_COR ECU_ADDRESS 0xd0008c20 FORMAT "%5.1" /end MEASUREMENT
/begin MEASUREMENT egr_ratio_cor_2 "Corrected EGR_RATIO for LDP of LPD_IGA_BAS_EGR" UWORD _CNV_A_R_LINEAR_____8_CM 1 100. 0. 99.99847412109381 DISPLAY_IDENTIFIER EGR_RATIO_COR_2 ECU_ADDRESS 0xd0000dbc /end MEASUREMENT
/begin CHARACTERISTIC ip_fac_iga_bas_egr_lamb "Factor for EGR_RATIO list of datapoints" MAP 0xa08144c4 _REC_MAP_20_u1_u1_u2 0.99609375 _CNV_A_R_LINEAR_____28_CM 0. 0.99609375 DISPLAY_IDENTIFIER IP_FAC_IGA_BAS_EGR_LAMB FORMAT "%5.3"
 /begin AXIS_DESCR COM_AXIS n_32 _CNV_A_R_LINEAR_____10_CM 12 0. 8160. FORMAT "%4.0" AXIS_PTS_REF ldpm_n_32_ip_egr_ratio /end AXIS_DESCR
 /begin AXIS_DESCR COM_AXIS maf _CNV_A_R_LINEAR_____111_CM 12 0. 1389. FORMAT "%7.2" AXIS_PTS_REF ldpm_maf_ip_egr_ratio /end AXIS_DESCR
/end CHARACTERISTIC
/begin CHARACTERISTIC ip_iga_bas_egr "Basis for EGR correction IGA_BAS" CURVE 0xa080ad0c _REC_CUR_20_u1_u2 95.625 _CNV_A_R_LINEAR_____198_CM -48. 47.625 DISPLAY_IDENTIFIER IP_IGA_BAS_EGR FORMAT "%5.1"
 /begin AXIS_DESCR COM_AXIS egr_ratio_cor_2 _CNV_A_R_LINEAR_____480_CM 6 0. 99.99847412109381 AXIS_PTS_REF ldp_egr_ratio_cor_2__iga_bas /end AXIS_DESCR
/end CHARACTERISTIC
/begin CHARACTERISTIC ip_iga_bas_egr_fac__n__maf "" MAP 0xa0814fbc _REC_MAP_20_u1_u1_u2 1.99220002 _CNV_A_R_LINEAR_____100_CM 0. 1.99220002 DISPLAY_IDENTIFIER IP_IGA_BAS_EGR_FAC__N__MAF FORMAT "%5.3"
 /begin AXIS_DESCR COM_AXIS n_32 _CNV_A_R_LINEAR_____10_CM 12 0. 8160. FORMAT "%4.0" AXIS_PTS_REF ldpm_n_32_ip_egr_ratio /end AXIS_DESCR
 /begin AXIS_DESCR COM_AXIS maf _CNV_A_R_LINEAR_____111_CM 12 0. 1389. FORMAT "%7.2" AXIS_PTS_REF ldpm_maf_ip_egr_ratio /end AXIS_DESCR
/end CHARACTERISTIC
/begin AXIS_PTS ldp_n_32__iga_egr_s "" 0xa0808996 n_32 _REC_AXS_20_u1 8160. _CNV_A_R_LINEAR_____10_CM 5 0. 8160. FORMAT "%4.0" /end AXIS_PTS
/begin AXIS_PTS ldp_mff_sp_s__egr_iga "" 0xa0808980 mff_sp_s _REC_AXS_20_u2 1389. _CNV_A_R_LINEAR_____111_CM 5 0. 1389. FORMAT "%7.2" /end AXIS_PTS
/begin AXIS_PTS ldp_egr_ratio_cor_2__iga_bas "" 0xa08085c8 egr_ratio_cor_2 _REC_AXS_20_u2 99.99847412109381 _CNV_A_R_LINEAR_____480_CM 6 0. 99.99847412109381 /end AXIS_PTS
/begin AXIS_PTS ldpm_tco__iga_egr "" 0xa08097a0 tco _REC_AXS_20_u1 190.5 _CNV_A_R_LINEAR_____17_CM 8 -48. 142.5 FORMAT "%5.1" /end AXIS_PTS
/begin AXIS_PTS ldpm_n_32_ip_egr_ratio "" 0xa0809628 n_32 _REC_AXS_20_u1 8160. _CNV_A_R_LINEAR_____10_CM 12 0. 8160. FORMAT "%4.0" /end AXIS_PTS
/begin AXIS_PTS ldpm_maf_ip_egr_ratio "" 0xa08094f8 maf _REC_AXS_20_u2 1389. _CNV_A_R_LINEAR_____111_CM 12 0. 1389. FORMAT "%7.2" /end AXIS_PTS
/begin MEASUREMENT lv_iga_tra_knk "Load dynamic correction active" UBYTE _CNV_S_2_RANGE__0___1_CM 1 100. 0. 1. DISPLAY_IDENTIFIER LV_IGA_TRA_KNK ECU_ADDRESS 0xd000877a BIT_MASK 0x1 /end MEASUREMENT
/begin MEASUREMENT iga_mv_adj_knk_cus "Mean spark retard of knock control incl. knock - and fuel quality adaptation by customer" UBYTE _CNV_A_R_LINEAR_____198_CM 1 100. -48. 0. DISPLAY_IDENTIFIER IGA_MV_ADJ_KNK_CUS ECU_ADDRESS 0xd0008778 FORMAT "%7.3" /end MEASUREMENT
/begin MEASUREMENT iga_adj_max_knk "Total spark retard through knock control including adaptation (cylinder individual)" UBYTE _CNV_A_R_LINEAR_____190_CM 1 100. -35.625 60. DISPLAY_IDENTIFIER IGA_ADJ_MAX_KNK ECU_ADDRESS 0xd0008779 FORMAT "%5.1" /end MEASUREMENT
/begin COMPU_METHOD _CNV_A_R_LINEAR_____0_CM "" RAT_FUNC "%6.3" "-" COEFFS 0 1. 0. 0 0 1 /end COMPU_METHOD
/begin COMPU_METHOD _CNV_S_2_RANGE__0___1_CM "" TAB_VERB "%6.3" "-" COMPU_TAB_REF _CNV_S_2_RANGE__0___1 /end COMPU_METHOD
/begin COMPU_VTAB _CNV_S_2_RANGE__0___1 "" TAB_VERB 2 0 "0" 1 "1" /end COMPU_VTAB
/begin COMPU_METHOD _CNV_A_R_LINEAR_____8_CM "" RAT_FUNC "%6.3" "%" COEFFS 0 655.3599999999997 0. 0 0 1 /end COMPU_METHOD
/begin COMPU_METHOD _CNV_A_R_LINEAR_____10_CM "" RAT_FUNC "%6.3" "rpm" COEFFS 0 3.125e-002 0. 0 0 1 /end COMPU_METHOD
/begin COMPU_METHOD _CNV_A_R_LINEAR_____15_CM "" RAT_FUNC "%6.3" "mg/stk" COEFFS 0 0.183585313174946 0. 0 0 1 /end COMPU_METHOD
/begin COMPU_METHOD _CNV_A_R_LINEAR_____17_CM "" RAT_FUNC "%6.3" "°C" COEFFS 0 1.333333333333333 64. 0 0 1 /end COMPU_METHOD
/begin COMPU_METHOD _CNV_A_R_LINEAR_____24_CM "" RAT_FUNC "%6.3" "-" COEFFS 0 16384. 0. 0 0 1 /end COMPU_METHOD
/begin COMPU_METHOD _CNV_A_R_LINEAR_____26_CM "" RAT_FUNC "%6.3" "°C" COEFFS 0 1. 40. 0 0 1 /end COMPU_METHOD
/begin COMPU_METHOD _CNV_A_R_LINEAR_____27_CM "" RAT_FUNC "%6.3" "hPa" COEFFS 0 12.06017666543982 0. 0 0 1 /end COMPU_METHOD
/begin COMPU_METHOD _CNV_A_R_LINEAR_____28_CM "" RAT_FUNC "%6.3" "-" COEFFS 0 256. 0. 0 0 1 /end COMPU_METHOD
/begin COMPU_METHOD _CNV_A_R_LINEAR_____30_CM "" RAT_FUNC "%6.3" "rpm/s" COEFFS 0 3.125e-002 0. 0 0 1 /end COMPU_METHOD
/begin COMPU_METHOD _CNV_A_R_LINEAR_____100_CM "" RAT_FUNC "%6.3" "-" COEFFS 0 127.9991955827809 0. 0 0 1 /end COMPU_METHOD
/begin COMPU_METHOD _CNV_A_R_LINEAR_____103_CM "" RAT_FUNC "%6.3" "-" COEFFS 0 128. 0. 0 0 1 /end COMPU_METHOD
/begin COMPU_METHOD _CNV_A_R_LINEAR_____111_CM "" RAT_FUNC "%6.3" "mg/stk" COEFFS 0 47.18142548596112 0. 0 0 1 /end COMPU_METHOD
/begin COMPU_METHOD _CNV_A_R_LINEAR_____126_CM "" RAT_FUNC "%6.3" "-" COEFFS 0 65536.00270084133 0. 0 0 1 /end COMPU_METHOD
/begin COMPU_METHOD _CNV_A_R_LINEAR_____129_CM "" RAT_FUNC "%6.3" "-" COEFFS 0 1024. 0. 0 0 1 /end COMPU_METHOD
/begin COMPU_METHOD _CNV_A_R_LINEAR_____130_CM "" RAT_FUNC "%6.3" "°C" COEFFS 0 16. 0. 0 0 1 /end COMPU_METHOD
/begin COMPU_METHOD _CNV_A_R_LINEAR_____171_CM "" RAT_FUNC "%6.3" "hPa" COEFFS 0 0.1884402603974972 0. 0 0 1 /end COMPU_METHOD
/begin COMPU_METHOD _CNV_A_R_LINEAR_____185_CM "" RAT_FUNC "%6.3" "" COEFFS 0 256. 0. 0 0 1 /end COMPU_METHOD
/begin COMPU_METHOD _CNV_A_R_LINEAR_____188_CM "" RAT_FUNC "%6.3" "°CRK" COEFFS 0 16. 0. 0 0 1 /end COMPU_METHOD
/begin COMPU_METHOD _CNV_A_R_LINEAR_____189_CM "" RAT_FUNC "%6.3" "°CRK" COEFFS 0 -16. 0. 0 0 1 /end COMPU_METHOD
/begin COMPU_METHOD _CNV_A_R_LINEAR_____190_CM "" RAT_FUNC "%6.3" "°CRK" COEFFS 0 2.666666666666667 95. 0 0 1 /end COMPU_METHOD
/begin COMPU_METHOD _CNV_A_R_LINEAR_____192_CM "" RAT_FUNC "%6.3" "-" COEFFS 0 32. 0. 0 0 1 /end COMPU_METHOD
/begin COMPU_METHOD _CNV_A_R_LINEAR_____196_CM "" RAT_FUNC "%6.3" "-" COEFFS 0 2.666666666666667 0. 0 0 1 /end COMPU_METHOD
/begin COMPU_METHOD _CNV_A_R_LINEAR_____197_CM "" RAT_FUNC "%6.3" "-" COEFFS 0 682.6666665599934 2.560156259323598e-006 0 0 1 /end COMPU_METHOD
/begin COMPU_METHOD _CNV_A_R_LINEAR_____198_CM "" RAT_FUNC "%6.3" "°CRK" COEFFS 0 2.666666666666667 128. 0 0 1 /end COMPU_METHOD
/begin COMPU_METHOD _CNV_A_R_LINEAR_____199_CM "" RAT_FUNC "%6.3" "V" COEFFS 0 51.0204081632653 0. 0 0 1 /end COMPU_METHOD
/begin COMPU_METHOD _CNV_A_R_LINEAR_____200_CM "" RAT_FUNC "%6.3" "°CRK" COEFFS 0 2.666666666666667 0. 0 0 1 /end COMPU_METHOD
/begin COMPU_METHOD _CNV_A_R_LINEAR_____201_CM "" RAT_FUNC "%6.3" "V" COEFFS 0 13107.19998965744 0. 0 0 1 /end COMPU_METHOD
/begin COMPU_METHOD _CNV_A_R_LINEAR_____202_CM "" RAT_FUNC "%6.3" "mg/stk" COEFFS 0 47.18214541280769 -1.080506262951531e-005 0 0 1 /end COMPU_METHOD
/begin COMPU_METHOD _CNV_A_R_LINEAR_____203_CM "" RAT_FUNC "%6.3" "V" COEFFS 0 50. 128. 0 0 1 /end COMPU_METHOD
/begin COMPU_METHOD _CNV_S_9_RANGE_STAT_204_CM "" TAB_VERB "%6.3" "" COMPU_TAB_REF _CNV_S_9_RANGE_STAT_204 /end COMPU_METHOD
/begin COMPU_VTAB _CNV_S_9_RANGE_STAT_204 "" TAB_VERB 9 0 "HOM_AFS" 1 "AFS_TO_AFL" 2 "HOM_AFL" 3 "AFL_TO_AFS" 4 "HOM_TO_S" 5 "BACKS" 6 "S" 7 "S_TO_HOM" 8 "BACKHOM" /end COMPU_VTAB
/begin COMPU_METHOD _CNV_A_R_LINEAR_____205_CM "" RAT_FUNC "%6.3" "°CRK" COEFFS 0 682.6667400022459 0. 0 0 1 /end COMPU_METHOD
/begin COMPU_METHOD _CNV_A_R_LINEAR_____208_CM "" RAT_FUNC "%6.3" "1/°C" COEFFS 0 16710013.00390117 0. 0 0 1 /end COMPU_METHOD
/begin COMPU_METHOD _CNV_A_R_LINEAR_____209_CM "" RAT_FUNC "%6.3" "°C" COEFFS 0 64. 0. 0 0 1 /end COMPU_METHOD
/begin COMPU_METHOD _CNV_A_R_LINEAR_____243_CM "" RAT_FUNC "%6.3" "" COEFFS 0 64. 0. 0 0 1 /end COMPU_METHOD
/begin COMPU_METHOD _CNV_A_R_LINEAR_____433_CM "" RAT_FUNC "%6.3" "-" COEFFS 0 65551.06000970239 0. 0 0 1 /end COMPU_METHOD
/begin COMPU_METHOD _CNV_A_R_LINEAR_____453_CM "" RAT_FUNC "%6.3" "-" COEFFS 0 16383.96875 0. 0 0 1 /end COMPU_METHOD
/begin COMPU_METHOD _CNV_A_R_LINEAR_____454_CM "" RAT_FUNC "%6.3" "-" COEFFS 0 524280. 0. 0 0 1 /end COMPU_METHOD
/begin COMPU_METHOD _CNV_A_R_LINEAR_____480_CM "" RAT_FUNC "%6.3" "-" COEFFS 0 655.3599999999997 0. 0 0 1 /end COMPU_METHOD
/begin RECORD_LAYOUT _REC_VAL_20_u1 FNC_VALUES 1 UBYTE COLUMN_DIR DIRECT /end RECORD_LAYOUT
/begin RECORD_LAYOUT _REC_VAL_20_u2 FNC_VALUES 1 UWORD COLUMN_DIR DIRECT /end RECORD_LAYOUT
/begin RECORD_LAYOUT _REC_AXS_20_u1 NO_AXIS_PTS_X 1 UBYTE AXIS_PTS_X 2 UBYTE INDEX_INCR DIRECT /end RECORD_LAYOUT
/begin RECORD_LAYOUT _REC_MAP_20_u2_u1_u1 FNC_VALUES 1 UWORD COLUMN_DIR DIRECT /end RECORD_LAYOUT
/begin RECORD_LAYOUT _REC_CUR_20_u1_u1 FNC_VALUES 1 UBYTE COLUMN_DIR DIRECT /end RECORD_LAYOUT
/begin RECORD_LAYOUT _REC_AXS_20_u2 NO_AXIS_PTS_X 1 UWORD AXIS_PTS_X 2 UWORD INDEX_INCR DIRECT /end RECORD_LAYOUT
/begin RECORD_LAYOUT _REC_CUR_20_u2_u1 FNC_VALUES 1 UWORD COLUMN_DIR DIRECT /end RECORD_LAYOUT
/begin RECORD_LAYOUT _REC_CUR_20_u2_u2 FNC_VALUES 1 UWORD COLUMN_DIR DIRECT /end RECORD_LAYOUT
/begin RECORD_LAYOUT _REC_CUR_20_u1_u2 FNC_VALUES 1 UBYTE COLUMN_DIR DIRECT /end RECORD_LAYOUT
/begin RECORD_LAYOUT _REC_MAP_20_u1_u1_u1 FNC_VALUES 1 UBYTE COLUMN_DIR DIRECT /end RECORD_LAYOUT
/begin RECORD_LAYOUT _REC_CUR_20_s2_u1 FNC_VALUES 1 SWORD COLUMN_DIR DIRECT /end RECORD_LAYOUT
/begin RECORD_LAYOUT _REC_MAP_20_u1_u2_u1 FNC_VALUES 1 UBYTE COLUMN_DIR DIRECT /end RECORD_LAYOUT
/begin RECORD_LAYOUT _REC_MAP_20_u1_u1_u2 FNC_VALUES 1 UBYTE COLUMN_DIR DIRECT /end RECORD_LAYOUT
/begin FUNCTION IGA_KnockControl "_KnockControl"
 /begin DEF_CHARACTERISTIC ip_maf_min_knk__n__tco id_iga_dec_knk_1__n id_iga_dec_knk_2__n id_n_grd_max_knk__n ip_iga_inc_knk__n c_fac_tra_knk c_iga_dif_min_max_knk c_maf_iga_hys_knk c_n_iga_hys_knk c_nl_crlc c_nl_crlc_tra id_cycnr_fac_tra_knk__n ip_knkwb_1__n__maf ip_gain_knk_1__n__maf ip_fac_thd_knk_0__n__maf ip_fac_thd_knk_1__n__maf ip_fac_thd_knk_2__n__maf ip_fac_thd_knk_3__n__maf ip_fac_thd_knk_4__n__maf ip_fac_thd_knk_5__n__maf ip_fac_thd_knk_6__n__maf ip_fac_thd_knk_7__n__maf c_nl_min id_maf_dif_tra_knk__n ldp_tco__maf_min_knk ldpm_n_3_9 c_knk_thd_max ldpm_n_iga_ad ldpm_maf_iga_ad ldpm_n_knkwb ldpm_maf_knkwb ldpm_n_fil_frq_knk id_fil_frq_knk_0__n id_fil_frq_knk_1__n id_fil_frq_knk_2__n id_fil_frq_knk_3__n id_fil_frq_knk_4__n id_fil_frq_knk_5__n id_fil_frq_knk_6__n id_fil_frq_knk_7__n ip_knkwb_2__n__maf ip_knkwb_3__n__maf ip_knkwb_4__n__maf ip_knkwb_5__n__maf ip_knkwb_6__n__maf ip_knkwb_7__n__maf ip_knkwe_0__n__maf ip_knkwe_1__n__maf ip_knkwe_2__n__maf ip_knkwe_3__n__maf ip_knkwe_4__n__maf ip_knkwe_5__n__maf ip_knkwe_6__n__maf ip_knkwe_7__n__maf ip_gain_knk_0__n__maf ip_gain_knk_2__n__maf ip_gain_knk_3__n__maf ip_gain_knk_4__n__maf ip_gain_knk_5__n__maf ip_gain_knk_6__n__maf ip_gain_knk_7__n__maf ip_knkwb_0__n__maf id_itc_knk_0__n__maf id_itc_knk_1__n__maf id_itc_knk_2__n__maf id_itc_knk_3__n__maf id_itc_knk_4__n__maf id_itc_knk_5__n__maf id_itc_knk_6__n__maf id_itc_knk_7__n__maf c_knks_1_diag c_knks_2_diag c_knks_3_diag c_knks_4_diag c_knks_cyl_conf ip_knk_thd_add_n id_ctr_knk_cmb ldp_state_cmb_ctl_knk c_nl_crlc_cmb c_iga_lgrd_3 c_knks_rel_ini /end DEF_CHARACTERISTIC
 /begin OUT_MEASUREMENT knks_cyl_conf_act iga_knk[0] iga_knk[1] iga_knk[2] iga_knk[3] iga_knk[4] iga_knk[5] iga_knk[6] iga_knk[7] knk_thd[0] knk_thd[1] knk_thd[2] knk_thd[3] knk_thd[4] knk_thd[5] knk_thd[6] knk_thd[7] knks_cmd_fil[0] knks_cmd_fil[1] knks_cmd_fil[2] knks_cmd_fil[3] knks_cmd_fil[4] knks_cmd_fil[5] knks_cmd_fil[6] knks_cmd_fil[7] knkwb[0] knkwb[1] knkwb[2] knkwb[3] knkwb[4] knkwb[5] knkwb[6] knkwb[7] knkwe[0] knkwe[1] knkwe[2] knkwe[3] knkwe[4] knkwe[5] knkwe[6] knkwe[7] lv_knk_ctl_ena lv_knk_tra_maf n_knk nl[0] nl[1] nl[2] nl[3] nl[4] nl[5] nl[6] nl[7] iga_adj_knk[0] iga_adj_knk[1] iga_adj_knk[2] iga_adj_knk[3] iga_adj_knk[4] iga_adj_knk[5] iga_adj_knk[6] iga_adj_knk[7] iga_mv_adj_knk iga_mv_cbk_adj_knk[0] iga_mv_cbk_adj_knk[1] cyl_id_knk lv_knk iga_mv_knk knks_cmd_gain[0] knks_cmd_gain[1] knks_cmd_gain[2] knks_cmd_gain[3] knks_cmd_gain[4] knks_cmd_gain[5] knks_cmd_gain[6] knks_cmd_gain[7] knks_cmd_int[0] knks_cmd_int[1] knks_cmd_int[2] knks_cmd_int[3] knks_cmd_int[4] knks_cmd_int[5] knks_cmd_int[6] knks_cmd_int[7] knks[0] knks[1] knks[2] knks[3] knks[4] knks[5] knks[6] knks[7] maf_knk state_cmb_ctl_tmp state_cmb_ctl_knk lv_ctr_knk_cmb ctr_knk_cmb lv_knk_tra_n lv_iga_dif_max_knk knk_ctl_dis ctr_iga_dif_max_knk[0] ctr_iga_dif_max_knk[1] ctr_iga_dif_max_knk[2] ctr_iga_dif_max_knk[3] ctr_iga_dif_max_knk[4] ctr_iga_dif_max_knk[5] ctr_iga_dif_max_knk[6] ctr_iga_dif_max_knk[7] n_iga_dif_max_knk[0] n_iga_dif_max_knk[1] n_iga_dif_max_knk[2] n_iga_dif_max_knk[3] n_iga_dif_max_knk[4] n_iga_dif_max_knk[5] n_iga_dif_max_knk[6] n_iga_dif_max_knk[7] n_iga_dif_max_knk[8] n_iga_dif_max_knk[9] n_iga_dif_max_knk[10] n_iga_dif_max_knk[11] n_iga_dif_max_knk[12] n_iga_dif_max_knk[13] n_iga_dif_max_knk[14] n_iga_dif_max_knk[15] n_iga_dif_max_knk[16] n_iga_dif_max_knk[17] n_iga_dif_max_knk[18] n_iga_dif_max_knk[19] n_iga_dif_max_knk[20] n_iga_dif_max_knk[21] n_iga_dif_max_knk[22] n_iga_dif_max_knk[23] n_iga_dif_max_knk[24] n_iga_dif_max_knk[25] n_iga_dif_max_knk[26] n_iga_dif_max_knk[27] n_iga_dif_max_knk[28] n_iga_dif_max_knk[29] n_iga_dif_max_knk[30] n_iga_dif_max_knk[31] n_iga_dif_max_knk[32] n_iga_dif_max_knk[33] n_iga_dif_max_knk[34] n_iga_dif_max_knk[35] n_iga_dif_max_knk[36] n_iga_dif_max_knk[37] n_iga_dif_max_knk[38] n_iga_dif_max_knk[39] n_iga_dif_max_knk[40] n_iga_dif_max_knk[41] n_iga_dif_max_knk[42] n_iga_dif_max_knk[43] n_iga_dif_max_knk[44] n_iga_dif_max_knk[45] n_iga_dif_max_knk[46] n_iga_dif_max_knk[47] n_iga_dif_max_knk[48] n_iga_dif_max_knk[49] n_iga_dif_max_knk[50] n_iga_dif_max_knk[51] n_iga_dif_max_knk[52] n_iga_dif_max_knk[53] n_iga_dif_max_knk[54] n_iga_dif_max_knk[55] n_iga_dif_max_knk[56] n_iga_dif_max_knk[57] n_iga_dif_max_knk[58] n_iga_dif_max_knk[59] maf_iga_dif_max_knk[0] maf_iga_dif_max_knk[1] maf_iga_dif_max_knk[2] maf_iga_dif_max_knk[3] maf_iga_dif_max_knk[4] maf_iga_dif_max_knk[5] maf_iga_dif_max_knk[6] maf_iga_dif_max_knk[7] maf_iga_dif_max_knk[8] maf_iga_dif_max_knk[9] maf_iga_dif_max_knk[10] maf_iga_dif_max_knk[11] maf_iga_dif_max_knk[12] maf_iga_dif_max_knk[13] maf_iga_dif_max_knk[14] maf_iga_dif_max_knk[15] maf_iga_dif_max_knk[16] maf_iga_dif_max_knk[17] maf_iga_dif_max_knk[18] maf_iga_dif_max_knk[19] maf_iga_dif_max_knk[20] maf_iga_dif_max_knk[21] maf_iga_dif_max_knk[22] maf_iga_dif_max_knk[23] maf_iga_dif_max_knk[24] maf_iga_dif_max_knk[25] maf_iga_dif_max_knk[26] maf_iga_dif_max_knk[27] maf_iga_dif_max_knk[28] maf_iga_dif_max_knk[29] maf_iga_dif_max_knk[30] maf_iga_dif_max_knk[31] maf_iga_dif_max_knk[32] maf_iga_dif_max_knk[33] maf_iga_dif_max_knk[34] maf_iga_dif_max_knk[35] maf_iga_dif_max_knk[36] maf_iga_dif_max_knk[37] maf_iga_dif_max_knk[38] maf_iga_dif_max_knk[39] maf_iga_dif_max_knk[40] maf_iga_dif_max_knk[41] maf_iga_dif_max_knk[42] maf_iga_dif_max_knk[43] maf_iga_dif_max_knk[44] maf_iga_dif_max_knk[45] maf_iga_dif_max_knk[46] maf_iga_dif_max_knk[47] maf_iga_dif_max_knk[48] maf_iga_dif_max_knk[49] maf_iga_dif_max_knk[50] maf_iga_dif_max_knk[51] maf_iga_dif_max_knk[52] maf_iga_dif_max_knk[53] maf_iga_dif_max_knk[54] maf_iga_dif_max_knk[55] maf_iga_dif_max_knk[56] maf_iga_dif_max_knk[57] maf_iga_dif_max_knk[58] maf_iga_dif_max_knk[59] tco_iga_dif_max_knk[0] tco_iga_dif_max_knk[1] tco_iga_dif_max_knk[2] tco_iga_dif_max_knk[3] tco_iga_dif_max_knk[4] tco_iga_dif_max_knk[5] tco_iga_dif_max_knk[6] tco_iga_dif_max_knk[7] tco_iga_dif_max_knk[8] tco_iga_dif_max_knk[9] tco_iga_dif_max_knk[10] tco_iga_dif_max_knk[11] tco_iga_dif_max_knk[12] tco_iga_dif_max_knk[13] tco_iga_dif_max_knk[14] tco_iga_dif_max_knk[15] tco_iga_dif_max_knk[16] tco_iga_dif_max_knk[17] tco_iga_dif_max_knk[18] tco_iga_dif_max_knk[19] tco_iga_dif_max_knk[20] tco_iga_dif_max_knk[21] tco_iga_dif_max_knk[22] tco_iga_dif_max_knk[23] tco_iga_dif_max_knk[24] tco_iga_dif_max_knk[25] tco_iga_dif_max_knk[26] tco_iga_dif_max_knk[27] tco_iga_dif_max_knk[28] tco_iga_dif_max_knk[29] tco_iga_dif_max_knk[30] tco_iga_dif_max_knk[31] tco_iga_dif_max_knk[32] tco_iga_dif_max_knk[33] tco_iga_dif_max_knk[34] tco_iga_dif_max_knk[35] tco_iga_dif_max_knk[36] tco_iga_dif_max_knk[37] tco_iga_dif_max_knk[38] tco_iga_dif_max_knk[39] tco_iga_dif_max_knk[40] tco_iga_dif_max_knk[41] tco_iga_dif_max_knk[42] tco_iga_dif_max_knk[43] tco_iga_dif_max_knk[44] tco_iga_dif_max_knk[45] tco_iga_dif_max_knk[46] tco_iga_dif_max_knk[47] tco_iga_dif_max_knk[48] tco_iga_dif_max_knk[49] tco_iga_dif_max_knk[50] tco_iga_dif_max_knk[51] tco_iga_dif_max_knk[52] tco_iga_dif_max_knk[53] tco_iga_dif_max_knk[54] tco_iga_dif_max_knk[55] tco_iga_dif_max_knk[56] tco_iga_dif_max_knk[57] tco_iga_dif_max_knk[58] tco_iga_dif_max_knk[59] tia_iga_dif_max_knk[0] tia_iga_dif_max_knk[1] tia_iga_dif_max_knk[2] tia_iga_dif_max_knk[3] tia_iga_dif_max_knk[4] tia_iga_dif_max_knk[5] tia_iga_dif_max_knk[6] tia_iga_dif_max_knk[7] tia_iga_dif_max_knk[8] tia_iga_dif_max_knk[9] tia_iga_dif_max_knk[10] tia_iga_dif_max_knk[11] tia_iga_dif_max_knk[12] tia_iga_dif_max_knk[13] tia_iga_dif_max_knk[14] tia_iga_dif_max_knk[15] tia_iga_dif_max_knk[16] tia_iga_dif_max_knk[17] tia_iga_dif_max_knk[18] tia_iga_dif_max_knk[19] tia_iga_dif_max_knk[20] tia_iga_dif_max_knk[21] tia_iga_dif_max_knk[22] tia_iga_dif_max_knk[23] tia_iga_dif_max_knk[24] tia_iga_dif_max_knk[25] tia_iga_dif_max_knk[26] tia_iga_dif_max_knk[27] tia_iga_dif_max_knk[28] tia_iga_dif_max_knk[29] tia_iga_dif_max_knk[30] tia_iga_dif_max_knk[31] tia_iga_dif_max_knk[32] tia_iga_dif_max_knk[33] tia_iga_dif_max_knk[34] tia_iga_dif_max_knk[35] tia_iga_dif_max_knk[36] tia_iga_dif_max_knk[37] tia_iga_dif_max_knk[38] tia_iga_dif_max_knk[39] tia_iga_dif_max_knk[40] tia_iga_dif_max_knk[41] tia_iga_dif_max_knk[42] tia_iga_dif_max_knk[43] tia_iga_dif_max_knk[44] tia_iga_dif_max_knk[45] tia_iga_dif_max_knk[46] tia_iga_dif_max_knk[47] tia_iga_dif_max_knk[48] tia_iga_dif_max_knk[49] tia_iga_dif_max_knk[50] tia_iga_dif_max_knk[51] tia_iga_dif_max_knk[52] tia_iga_dif_max_knk[53] tia_iga_dif_max_knk[54] tia_iga_dif_max_knk[55] tia_iga_dif_max_knk[56] tia_iga_dif_max_knk[57] tia_iga_dif_max_knk[58] tia_iga_dif_max_knk[59] cyl_id_iga_dif_max_knk[0] cyl_id_iga_dif_max_knk[1] cyl_id_iga_dif_max_knk[2] cyl_id_iga_dif_max_knk[3] cyl_id_iga_dif_max_knk[4] cyl_id_iga_dif_max_knk[5] cyl_id_iga_dif_max_knk[6] cyl_id_iga_dif_max_knk[7] cyl_id_iga_dif_max_knk[8] cyl_id_iga_dif_max_knk[9] cyl_id_iga_dif_max_knk[10] cyl_id_iga_dif_max_knk[11] cyl_id_iga_dif_max_knk[12] cyl_id_iga_dif_max_knk[13] cyl_id_iga_dif_max_knk[14] cyl_id_iga_dif_max_knk[15] cyl_id_iga_dif_max_knk[16] cyl_id_iga_dif_max_knk[17] cyl_id_iga_dif_max_knk[18] cyl_id_iga_dif_max_knk[19] cyl_id_iga_dif_max_knk[20] cyl_id_iga_dif_max_knk[21] cyl_id_iga_dif_max_knk[22] cyl_id_iga_dif_max_knk[23] cyl_id_iga_dif_max_knk[24] cyl_id_iga_dif_max_knk[25] cyl_id_iga_dif_max_knk[26] cyl_id_iga_dif_max_knk[27] cyl_id_iga_dif_max_knk[28] cyl_id_iga_dif_max_knk[29] cyl_id_iga_dif_max_knk[30] cyl_id_iga_dif_max_knk[31] cyl_id_iga_dif_max_knk[32] cyl_id_iga_dif_max_knk[33] cyl_id_iga_dif_max_knk[34] cyl_id_iga_dif_max_knk[35] cyl_id_iga_dif_max_knk[36] cyl_id_iga_dif_max_knk[37] cyl_id_iga_dif_max_knk[38] cyl_id_iga_dif_max_knk[39] cyl_id_iga_dif_max_knk[40] cyl_id_iga_dif_max_knk[41] cyl_id_iga_dif_max_knk[42] cyl_id_iga_dif_max_knk[43] cyl_id_iga_dif_max_knk[44] cyl_id_iga_dif_max_knk[45] cyl_id_iga_dif_max_knk[46] cyl_id_iga_dif_max_knk[47] cyl_id_iga_dif_max_knk[48] cyl_id_iga_dif_max_knk[49] cyl_id_iga_dif_max_knk[50] cyl_id_iga_dif_max_knk[51] cyl_id_iga_dif_max_knk[52] cyl_id_iga_dif_max_knk[53] cyl_id_iga_dif_max_knk[54] cyl_id_iga_dif_max_knk[55] cyl_id_iga_dif_max_knk[56] cyl_id_iga_dif_max_knk[57] cyl_id_iga_dif_max_knk[58] cyl_id_iga_dif_max_knk[59] knks_rel_nl[0] knks_rel_nl[1] knks_rel_nl[2] knks_rel_nl[3] knks_rel_nl[4] knks_rel_nl[5] knks_rel_nl[6] knks_rel_nl[7] /end OUT_MEASUREMENT
/end FUNCTION
/begin FUNCTION IGA_Ignition_angle_correction_due_to_EGR "_Ignition angle correction due to EGR"
 /begin DEF_CHARACTERISTIC ip_fac_rate_egr_afl ip_fac_rate_egr_s ip_iga_egr_s ip_fac_iga_bas_egr_lamb ip_iga_bas_egr ip_iga_bas_egr_fac__n__maf /end DEF_CHARACTERISTIC
 /begin OUT_MEASUREMENT iga_bas_egr_cor_hom iga_bas_egr_cor_s iga_bas_egr_cor egr_ratio_cor_2 /end OUT_MEASUREMENT
/end FUNCTION
/begin FUNCTION IGA_Minimum_IGA_limitation_for_exhaust_gas_temperature_protection "_Minimum IGA limitation for exhaust gas temperature protection"
 /begin DEF_CHARACTERISTIC c_teg_max_iga_hys c_teg_max_iga ip_iga_dif_min_teg_h_rng__teg /end DEF_CHARACTERISTIC
 /begin OUT_MEASUREMENT iga_min_teg_h_rng iga_dif_min_teg_h_rng teg_dyn_hys teg_cat_up_mdl_max /end OUT_MEASUREMENT
/end FUNCTION
/begin FUNCTION IGA_Load_dynamics_correction "_Load dynamics correction"
 /begin OUT_MEASUREMENT lv_ad_clr_ron lv_iga_tra_knk iga_mv_adj_knk_cus iga_adj_max_knk /end OUT_MEASUREMENT
/end FUNCTION
/begin FUNCTION C_7_INJ "C_7_INJ"
 /begin SUB_FUNCTION INJ_General_Calculation_of_Fuel_Inj_Time INJ_Warm_up_correction INJ_Cylinder_shut_off INJ_Injection_fuel_setpoint_for_homogeneous_mode INJ_Lambda_coordination INJ_Lambda_Catalyst_overheating_prevention INJ_Basic_lambda_setpoint INJ_Lambda_setpoint_for_catalyst_regeneration INJ_Injection_Time_Correction_by_the_Application_System INJ_Exhaust_Gas_temperature_model INJ_Catalyst_enrichment_function INJ_Application_incidences_for_catalyst_enrichment_function INJ_Lambda_stimulation_for_a_lambda_controller_with_an_UEGO_sensor INJ_Forced_stimulation_for_a_lambda_controller_with_an_UEGO_sensor INJ_Restart_function INJ_Detection_of_limited_dynamic_condition_for_dynamic_fuel_trim INJ_Application_incidence_exhaust_gas_temperature_model INJ_Conditioning_of_catalyst_O2_loading INJ_Application_Incidences_for_conditioning_of_catalyst_O2_loading INJ_Downstream_oxygen_sensor_internal_resistance_determination INJ_Inhibition_Conditions_for_OBDII_oxygen_downstream_heater_diagnosis INJ_Seq_FCUT_And_Restart_Fuel_Feed INJ_Application_incidence_NOx_catalyst_management INJ_NOx_catalyst_management___auxiliary_functionalities INJ_NOx_Catalyst_Monolith_Temperature_Model INJ_NOx_Cat_Monolith_Temp_Model__AI INJ_NOx_tailpipe_emission INJ_NOx_Cat_Sulphur_Model INJ_NOx_Cat_Model_Control INJ_NOx_Cat_Desulfation_Lambda_Stimulation INJ_NOx_Engine_out_Emission_Adaptation INJ_NOx_catalyst_management_catalyst_states INJ_NOx_catalyst_desulfation INJ_NOx_engine_out_emission_stratified_mode INJ_NOx___Sensor_function INJ_NOx_catalyst_Oxygen_storage_capacity_adaptation INJ_Application_Incidence_for_NOx_Cat_Desulfation_Lambda_Stimulation INJ_NOx_engine_out_emission_homogeneous_mode INJ_NOx_catalyst_desulfation___heating_activation INJ_Application_incidence_for_NOx_cat_aging INJ_NOx_Catalyst_aging /end SUB_FUNCTION
/end FUNCTION
/begin FUNCTION INJ_General_Calculation_of_Fuel_Inj_Time "_General Calculation of Fuel Inj Time"
 /begin DEF_CHARACTERISTIC ip_fac_rest_ti_cast_h_prs ip_fac_rest_ti_cast_lih_l_prs ip_ti_cast_h_prs ip_ti_cast_lih_l_prs ip_ti_deac_cast_h_prs ip_ti_deac_cast_lih_l_prs ip_fac_ti_cast_fup c_mff_fac /end DEF_CHARACTERISTIC
 /begin OUT_MEASUREMENT lv_ast_end ti_cast ti_cast_h_prs ti_cast_lih_l_prs /end OUT_MEASUREMENT
/end FUNCTION
/begin FUNCTION INJ_Warm_up_correction "_Warm up correction"
 /begin DEF_CHARACTERISTIC ip_ti_fac_n_map ip_ti_fac_tia_toil ip_ti_fac_tco ip_fac_ti_vo_wup ip_fac_ti_tco_wup_h_prs ip_fac_ti_tco_wup_lih_l_prs ip_ti_tco_wup_h_prs ip_ti_tco_wup_lih_l_prs ip_ti_wup_h_prs ip_ti_wup_lih_l_prs c_crlc_fac_ti_wup_fup ip_fac_ti_wup_fup /end DEF_CHARACTERISTIC
 /begin OUT_MEASUREMENT ti_wup_1 ti_wup ti_temp ti_wup_1_add ti_wup_1_h_prs ti_wup_1_add_h_prs ti_wup_1_lih_l_prs ti_wup_1_add_lih_l_prs fac_ti_wup_fup /end OUT_MEASUREMENT
/end FUNCTION
/begin FUNCTION INJ_Cylinder_shut_off "_Cylinder shut off" /begin OUT_MEASUREMENT inh_iv_amt /end OUT_MEASUREMENT /end FUNCTION
/begin FUNCTION INJ_Injection_fuel_setpoint_for_homogeneous_mode "_Injection fuel setpoint for homogeneous mode"
 /begin OUT_MEASUREMENT mff_sp_hom[0] mff_sp_hom[1] mff_sp_fup_ctl mff_sp_hom_eng[0] mff_sp_hom_eng[1] mff_sp_mv mff_sp[0] mff_sp[1] /end OUT_MEASUREMENT
/end FUNCTION
/begin FUNCTION INJ_Lambda_coordination "_Lambda coordination" /begin DEF_CHARACTERISTIC c_lamb_bas_cor_min /end DEF_CHARACTERISTIC
 /begin OUT_MEASUREMENT lamb_sp lamb_bas_h_res[0] lamb_bas_h_res[1] lamb_bas[0] lamb_bas[1] /end OUT_MEASUREMENT
/end FUNCTION
/begin FUNCTION INJ_Lambda_Catalyst_overheating_prevention "_Lambda Catalyst overheating prevention"
 /begin DEF_CHARACTERISTIC c_lamb_cop_min c_lamb_cop_pas c_lamb_teg_cat_up_mdl_cop_i c_lamb_teg_cat_down_cop_i c_lamb_tnt_mdl_h_cop_i c_teg_cat_up_mdl_thd_min_cop c_tnt_mdl_h_thd_min_cop c_tnt_mdl_h_thd_cop c_tnt_mdl_h_thd_max_cop c_teg_cat_down_thd_min_cop c_teg_cat_up_mdl_thd_cop c_teg_cat_down_thd_cop c_teg_cat_up_mdl_thd_max_cop c_teg_cat_down_thd_max_cop /end DEF_CHARACTERISTIC
 /begin OUT_MEASUREMENT lam_bank_1.cat_prev.lamb_cop_cus lam_bank_1.cat_prev.lv_lamb_cop_cus lam_bank_1.cat_prev.lamb_teg_cat_up_mdl_cop lam_bank_1.cat_prev.lamb_teg_cat_down_cop lam_bank_1.cat_prev.lamb_tnt_mdl_h_cop lam_bank_1.cat_prev.lv_teg_cat_up_mdl_cop lam_bank_1.cat_prev.lv_teg_cat_down_cop lam_bank_1.cat_prev.lv_tnt_mdl_h_cop lam_bank_1.cat_prev.teg_cat_down lam_bank_2.cat_prev.lamb_cop_cus lam_bank_2.cat_prev.lv_lamb_cop_cus lam_bank_2.cat_prev.lamb_teg_cat_up_mdl_cop lam_bank_2.cat_prev.lamb_teg_cat_down_cop lam_bank_2.cat_prev.lamb_tnt_mdl_h_cop lam_bank_2.cat_prev.lv_teg_cat_up_mdl_cop lam_bank_2.cat_prev.lv_teg_cat_down_cop lam_bank_2.cat_prev.lv_tnt_mdl_h_cop lam_bank_2.cat_prev.teg_cat_down /end OUT_MEASUREMENT
/end FUNCTION
/begin FUNCTION INJ_Basic_lambda_setpoint "_Basic lambda setpoint" /begin OUT_MEASUREMENT lamb_hom_afl /end OUT_MEASUREMENT /end FUNCTION
/end MODULE
/end PROJECT
