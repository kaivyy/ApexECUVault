ASAP2_VERSION 1 3
/begin PROJECT _715C4500 "basisme9"
/begin HEADER "" VERSION "_715C4500" PROJECT_NO _715C4500 /end HEADER
/begin MODULE DIM ""
/begin MOD_COMMON "" BYTE_ORDER MSB_FIRST ALIGNMENT_BYTE 1 ALIGNMENT_WORD 2 ALIGNMENT_LONG 2 ALIGNMENT_FLOAT32_IEEE 4 /end MOD_COMMON
/begin CHARACTERISTIC ATVINI "Initialisierungswert f¸r Stellgrˆﬂe atv, Aktivieren ¸ber Codewort NOATV" VALUE 0xFC6B08 KwSb 2.550 t100msxs_sb_q0p01 -1.280 1.270 FORMAT "%5.3" /end CHARACTERISTIC
/begin CHARACTERISTIC ATVINI2 "Initialisierungswert f¸r Stellgrˆﬂe atv, Bank 2, Aktivieren ¸ber Codewort NOATV" VALUE 0xFC6B09 KwSb 2.550 t100msxs_sb_q0p01 -1.280 1.270 FORMAT "%5.3" /end CHARACTERISTIC
/begin CHARACTERISTIC ATVMN "untere Regelbereichsgrenze f¸r Stellgrˆﬂe atv" VALUE 0xFC6B0A KwSb 2.550 t100msxs_sb_q0p01 -1.280 1.270 FORMAT "%5.3" /end CHARACTERISTIC
/begin CHARACTERISTIC ATVMX "obere Regelbereichsgrenze f¸r Stellgrˆﬂe atv" VALUE 0xFC6B0B KwSb 2.550 t100msxs_sb_q0p01 -1.280 1.270 FORMAT "%5.3" /end CHARACTERISTIC
/begin CHARACTERISTIC CFRA "Codewort Adaption Regelhub in LR" VALUE 0xFC6A88 KwUb 255.0 dez 0.00 255.0 FORMAT "%5.1" /end CHARACTERISTIC
/begin CHARACTERISTIC CLRHK "Codewort f¸r Lambda - Regelung hinter Kat ein/aus" VALUE 0xFC6B0C KwUb 255.0 dez 0.00 255.0 FORMAT "%5.1" /end CHARACTERISTIC
/begin CHARACTERISTIC CLRKA "Codewort f¸r Funktion O2-Kat-Ausr‰umen" VALUE 0xFC6B98 KwUb 255.0 dez 0.00 255.0 FORMAT "%5.1" /end CHARACTERISTIC
/begin CHARACTERISTIC CLRZWTMS "Codewort Zwangseinschaltung LR gem‰ﬂ CARB-Forderung" VALUE 0xFCF07C KwUb 255.0 dez 0.00 255.0 FORMAT "%5.1" /end CHARACTERISTIC
/begin CHARACTERISTIC CNFMDVER "Codewort zur Konfiguration von MDVER" VALUE 0xFCF2E0 KwUb 255.0 dez 0.00 255.0 FORMAT "%5.1" /end CHARACTERISTIC
/begin CHARACTERISTIC CNFMDWAN "Codewort f¸r die Einberechnung von MDWAN in der LLR" VALUE 0xFC7084 KwUb 255.0 dez 0.00 255.0 FORMAT "%5.1" /end CHARACTERISTIC
/begin CHARACTERISTIC CREDSTU "Codewort f¸r Reduzierstufe ein/aus" VALUE 0xFC81A0 KwUb 255.0 dez 0.00 255.0 FORMAT "%5.1" /end CHARACTERISTIC
/begin CHARACTERISTIC CWDMFAB "Codewort Sw-Schalter f¸r ƒnderungsbegrenzung" VALUE 0xFC7CBA KwUb 255.0 DEZ 0.00 255.0 FORMAT "%5.1" /end CHARACTERISTIC
/begin CHARACTERISTIC CWDMFAB2 "Codewort2 Sw-Schalter f¸r ƒnderungsbegrenzung" VALUE 0xFC7CBB KwUb 255.0 DEZ 0.00 255.0 FORMAT "%5.1" /end CHARACTERISTIC
/begin CHARACTERISTIC CWMBAS "Codewort f¸r MDBAS" VALUE 0xFC754B KwUb 255.0 dez 0.00 255.0 FORMAT "%5.1" /end CHARACTERISTIC
/begin CHARACTERISTIC CWMDKOG "Codewort MDKOG: Z¸ndwinkelsp‰tverstellung bei Unterdruckbegrenzung" VALUE 0xFC80EA KwUb 255.0 dez 0.00 255.0 FORMAT "%5.1" /end CHARACTERISTIC
/begin CHARACTERISTIC CWMDSL "" VALUE 0xFCF35C KwUb 255.0 dez 0.00 255.0 FORMAT "%5.1" /end CHARACTERISTIC
/begin CHARACTERISTIC CWTEZW "Codewort Z¸ndwinkeleingriff bei TEV-Pr¸fung" VALUE 0xFC80EB KwUb 255.0 dez 0.00 255.0 FORMAT "%5.1" /end CHARACTERISTIC
/begin CHARACTERISTIC CWZWE "Codewort ZW-Eingriffe f¸r MD-Struktur aktiv" VALUE 0xFC80EC KwUb 255.0 dez 0.00 255.0 FORMAT "%5.1" /end CHARACTERISTIC
/begin CHARACTERISTIC CWZWVMX "Codewort Z¸ndwinkeleingriff bei VMAX-Begrenzung" VALUE 0xFC80ED KwUb 255.0 dez 0.00 255.0 FORMAT "%5.1" /end CHARACTERISTIC
/begin CHARACTERISTIC CW_FMKNUL "Codewort f¸r Berechnungsart fmknul" VALUE 0xFC7CBC KwUb 255.0 dez 0.00 255.0 FORMAT "%5.1" /end CHARACTERISTIC
/begin CHARACTERISTIC DFRMN "Min. Lambda-Abweichung f¸r Bestimmung Station‰rbedingung und ‹K-Adaption" VALUE 0xFC6ABC KwSw 1.999969 fak_sw_b1 -1.000000 0.9999695 FORMAT "%8.6" /end CHARACTERISTIC
/begin CHARACTERISTIC DFRSPS "Hub des Lambda-Regelfaktors (Sollwert)" VALUE 0xFC6ABE KwSw 1.999969 fak_sw_b1 -1.000000 0.9999695 FORMAT "%8.6" /end CHARACTERISTIC
/begin CHARACTERISTIC DLSDWE "D‰mpfung PT2-Filter Lastschlagd‰mpfung bei hohem Kupplungsmoment" VALUE 0xFC7CC0 KwUw 1.999969 fak_uw_b2 0.00 1.999969 FORMAT "%8.6" /end CHARACTERISTIC
/begin CHARACTERISTIC DMADFK "Maximal adaptierbares Delta-Verlustmoment pro Adaptionsphase Fahrst.+Kompr." VALUE 0xFCF33E KwUb 24.90 rel_ub_b24p9 0.00 24.90 FORMAT "%5.2" /end CHARACTERISTIC
/begin CHARACTERISTIC DMADFS "Maximal adaptierbares Delta-Verlustmoment pro Adaptionsphase mit Fahrstufe ein" VALUE 0xFCF33F KwUb 24.90 rel_ub_b24p9 0.00 24.90 FORMAT "%5.2" /end CHARACTERISTIC
/begin CHARACTERISTIC DMADKO "Maximal adaptierbares Delta-Verlustmoment pro Adaptionsphase Kompr.ein" VALUE 0xFCF340 KwUb 24.90 rel_ub_b24p9 0.00 24.90 FORMAT "%5.2" /end CHARACTERISTIC
/begin CHARACTERISTIC DMADLL "Maximal adaptierbares Delta-Verlustmoment pro Adaptionsphase ohne Last" VALUE 0xFCF341 KwUb 24.90 rel_ub_b24p9 0.00 24.90 FORMAT "%5.2" /end CHARACTERISTIC
/begin CHARACTERISTIC DMADMNFK "Minimal adaptierbares Delta-Verlustmoment Fahrstufe eingelegt + Kompressor ein" VALUE 0xFCF342 KwUb 24.90 rel_ub_bn24p9 -24.90 0.00 FORMAT "%5.2" /end CHARACTERISTIC
/begin CHARACTERISTIC DMADMNFS "Minimal adaptierbares Delta-Verlustmoment Fahrstufe eingelegt" VALUE 0xFCF343 KwUb 24.90 rel_ub_bn24p9 -24.90 0.00 FORMAT "%5.2" /end CHARACTERISTIC
/begin CHARACTERISTIC DMADMNKO "Minimal adaptierbares Delta-Verlustmoment Klimakompressor ein" VALUE 0xFCF344 KwUb 24.90 rel_ub_bn24p9 -24.90 0.00 FORMAT "%5.2" /end CHARACTERISTIC
/begin CHARACTERISTIC DMADMNLL "Minimal adaptierbares Delta-Verlustmoment ohne Last" VALUE 0xFCF345 KwUb 24.90 rel_ub_bn24p9 -24.90 0.00 FORMAT "%5.2" /end CHARACTERISTIC
/begin CHARACTERISTIC DMADMXFK "Maximal adaptierbares Delta-Verlustmoment Farstufe + Klimakompressor ein" VALUE 0xFCF346 KwUb 24.90 rel_ub_b24p9 0.00 24.90 FORMAT "%5.2" /end CHARACTERISTIC
/begin CHARACTERISTIC DMADMXFS "Maximal adaptierbares Delta-Verlustmoment Farstufe ein" VALUE 0xFCF347 KwUb 24.90 rel_ub_b24p9 0.00 24.90 FORMAT "%5.2" /end CHARACTERISTIC
/begin CHARACTERISTIC DMADMXKO "Maximal adaptierbares Delta-Verlustmoment Klimakompressor ein" VALUE 0xFCF348 KwUb 24.90 rel_ub_b24p9 0.00 24.90 FORMAT "%5.2" /end CHARACTERISTIC
/begin CHARACTERISTIC DMADMXLL "Maximal adaptierbares Delta-Verlustmoment ohne Last" VALUE 0xFCF349 KwUb 24.90 rel_ub_b24p9 0.00 24.90 FORMAT "%5.2" /end CHARACTERISTIC
/begin CHARACTERISTIC DMAUFN "Delta-Moment Aufregelung nach Drehmomenteingriff" CURVE 0xFD0250 KlAUwSstUwWUw 99.99847 rel_uw_b100 0.00 99.99847 FORMAT "%8.5"
 /begin AXIS_DESCR STD_AXIS nmot_w nmot_uw_q0p25 8 0.00 16383.75 FORMAT "%8.2" DEPOSIT ABSOLUTE /end AXIS_DESCR
/end CHARACTERISTIC
/begin CHARACTERISTIC DMDKOE "Anfangswert Momentenfilter bei Klimakompressor Einschalten" CURVE 0xFCF360 KlAUbSstUbWUb 49.73 rel_ub_b49p725 0.00 49.73 FORMAT "%5.2"
 /begin AXIS_DESCR STD_AXIS nmot nmot_ub_q40 6 0.00 10200. FORMAT "%5.0" DEPOSIT ABSOLUTE /end AXIS_DESCR
/end CHARACTERISTIC
/begin CHARACTERISTIC DMDNSM "Delta Moment zur Nachstartkompensation" CURVE 0xFCF2E4 KlAUbSstUbWUb 99.61 rel_ub_b99p6 0.00 99.61 FORMAT "%5.2"
 /begin AXIS_DESCR STD_AXIS tmot temp_ub_q0p75_o48 8 -48.00 143.3 FORMAT "%5.1" DEPOSIT ABSOLUTE /end AXIS_DESCR
/end CHARACTERISTIC
/begin CHARACTERISTIC DMDNSMVT "Delta Moment zur Nachstartkompensation (VVT)" CURVE 0xFCF2F8 KlAUbSstUbWUb 99.61 rel_ub_b99p6 0.00 99.61 FORMAT "%5.2"
 /begin AXIS_DESCR STD_AXIS tmot temp_ub_q0p75_o48 8 -48.00 143.3 FORMAT "%5.1" DEPOSIT ABSOLUTE /end AXIS_DESCR
/end CHARACTERISTIC
/begin CHARACTERISTIC DMDPUG "delta Moment Dashpotende" CURVE 0xFCF676 GklWSw 199.9969 rel_sw_b100 -100.0000 99.99695 FORMAT "%8.4"
 /begin AXIS_DESCR COM_AXIS gangi dez 8 0.00 255.0 FORMAT "%5.1" AXIS_PTS_REF SGA08MDUB /end AXIS_DESCR
/end CHARACTERISTIC
/begin CHARACTERISTIC DMDWHYS "Hysterese f¸r Bildung D-Anteil-Wandlermoment" VALUE 0xFC7085 KwUb 99.61 rel_ub_b99p6 0.00 99.61 FORMAT "%5.2" /end CHARACTERISTIC
/begin CHARACTERISTIC DMDWM "D-Anteil Wandlermoment bei Einlegen der Fahrstufe" CURVE 0xFCF3FC GklWUb 99.61 rel_ub_b99p6 0.00 99.61 FORMAT "%5.2"
 /begin AXIS_DESCR COM_AXIS tmot temp_ub_q0p75_o48 8 -48.00 143.3 FORMAT "%5.1" AXIS_PTS_REF STM08MDUB /end AXIS_DESCR
/end CHARACTERISTIC
/begin CHARACTERISTIC DMIFSAWE "Schwelle bei mimin-Sprung f¸r R¸cksetzen von B_fil" VALUE 0xFC7CC2 KwUw 99.99695 rel_uw_b100 0.001525879 99.99847 FORMAT "%8.5" /end CHARACTERISTIC
/begin CHARACTERISTIC DMIZWMN "Offset auf indiziertes Motormoment bei sp‰testem Z¸ndwinkel und ASR-Eingriff" VALUE 0xFC81A1 KwUb 99.61 rel_ub_b99p6 0.00 99.61 FORMAT "%5.2" /end CHARACTERISTIC
/begin CHARACTERISTIC DMLSDUG "Delta Moment Ende Lastschlagd‰mpfung" CURVE 0xFCF686 GklWSw 199.9969 rel_sw_b100 -100.0000 99.99695 FORMAT "%8.4"
 /begin AXIS_DESCR COM_AXIS gangi dez 8 0.00 255.0 FORMAT "%5.1" AXIS_PTS_REF SGA08MDUB /end AXIS_DESCR
/end CHARACTERISTIC
/begin CHARACTERISTIC DMOFK "LLR Adaptionsoffset bei FK" VALUE 0xFCF34C KwSw 199.9969 rel_sw_b100 -100.0000 99.99695 FORMAT "%8.4" /end CHARACTERISTIC
/begin CHARACTERISTIC DMOFS "LLR Adaptionsoffset bei FS" VALUE 0xFCF34E KwSw 199.9969 rel_sw_b100 -100.0000 99.99695 FORMAT "%8.4" /end CHARACTERISTIC
/begin CHARACTERISTIC DMOKO "LLR Adaptionsoffset bei KO" VALUE 0xFCF350 KwSw 199.9969 rel_sw_b100 -100.0000 99.99695 FORMAT "%8.4" /end CHARACTERISTIC
/begin CHARACTERISTIC DMOLL "LLR Adaptionsoffset bei LL" VALUE 0xFCF352 KwSw 199.9969 rel_sw_b100 -100.0000 99.99695 FORMAT "%8.4" /end CHARACTERISTIC
/begin CHARACTERISTIC DMRFAV "ƒnderungsbegrenzung von mr bei EGS-Notlauf" CURVE 0xFCF696 KlAUwSstUwWUw 199.9969 rel_uw_b200 0.00 199.9969 FORMAT "%8.4"
 /begin AXIS_DESCR STD_AXIS vfzg_w vfzg_uw_b512 2 0.00 511.9922 FORMAT "%8.4" DEPOSIT ABSOLUTE /end AXIS_DESCR
/end CHARACTERISTIC
/begin CHARACTERISTIC DMRKHO "obere Hytereseschwelle Katheiz-Momentenreserve mit ZW-Eingriff" VALUE 0xFC80EE KwUb 99.61 rel_ub_b99p6 0.00 99.61 FORMAT "%5.2" /end CHARACTERISTIC
/begin CHARACTERISTIC DMRKHU "Untere Hytereseschwelle Katheiz-Momentenreserve mit ZW-Eingriff" VALUE 0xFC80EF KwUb 99.61 rel_ub_b99p6 0.00 99.61 FORMAT "%5.2" /end CHARACTERISTIC
/begin CHARACTERISTIC DTMR "Hysterese f¸r Einschaltschwelle" VALUE 0xFCF07D KwUb 191.3 temp_ub_b191p25 0.00 191.3 FORMAT "%5.1" /end CHARACTERISTIC
/begin CHARACTERISTIC DTMTMRW "Temperaturdiff.-Schwelle f¸r die Pr¸fung, ob Zwangseinschaltung LR nˆtig (CARB)" VALUE 0xFCF07E KwUb 191.3 temp_sb_q0p75 0.00 191.3 FORMAT "%5.1" /end CHARACTERISTIC
/begin CHARACTERISTIC DTVKAML "Delta-tv f¸r Katalysator-Ausr‰umen (luftmassenabh‰ngig)" CURVE 0xFCF180 GklWSb 2.550 t100msxs_sb_q0p01 -1.280 1.270 FORMAT "%5.3"
 /begin AXIS_DESCR COM_AXIS ml m_ub_b1020 5 0.00 1020. FORMAT "%5.0" AXIS_PTS_REF SML05LKUB /end AXIS_DESCR
/end CHARACTERISTIC
/begin CHARACTERISTIC DTVKAML2 "Delta-tv f¸r Katalysator-Ausr‰umen (luftmassenabh‰ngig) Bank2" CURVE 0xFCF188 GklWSb 2.550 t100msxs_sb_q0p01 -1.280 1.270 FORMAT "%5.3"
 /begin AXIS_DESCR COM_AXIS ml m_ub_b1020 5 0.00 1020. FORMAT "%5.0" AXIS_PTS_REF SML05LKUB /end AXIS_DESCR
/end CHARACTERISTIC
/begin CHARACTERISTIC DZW2DZWQ "Deltaz¸ndwinkel (quadratisch)" CURVE 0xFC754C FklWUb 90.72 kwq_ub_q0p35576 0.00 90.72 FORMAT "%5.2"
 /begin AXIS_DESCR FIX_AXIS dzwb zw_sb_q0p75 128 0.00 95.25 FORMAT "%5.2" FIX_AXIS_PAR 0 0 128 /end AXIS_DESCR
/end CHARACTERISTIC
/begin CHARACTERISTIC DZWKOEFKT "" VALUE 0xFC75CC KwUb 11.20 fak_q0p0439 0.00 11.20 FORMAT "%5.2" /end CHARACTERISTIC
/begin CHARACTERISTIC DZWOLA "Lambda-Abh‰ngigkeit des optimalen Z¸ndwinkels bezogen auf Lambda 1" CURVE 0xFC77F6 KlAUbSstUbWSb 191.3 zw_sb_q0p75 -96.00 95.25 FORMAT "%5.2"
 /begin AXIS_DESCR STD_AXIS lambas fak_ub_b2 10 0.00 1.992 FORMAT "%5.3" DEPOSIT ABSOLUTE /end AXIS_DESCR
/end CHARACTERISTIC
/begin CHARACTERISTIC DZWOM "temperaturabh‰ngiger Offset des optimalen ZW" CURVE 0xFC780B KlAUbSstUbWSb 191.3 zw_sb_q0p75 -96.00 95.25 FORMAT "%5.2"
 /begin AXIS_DESCR STD_AXIS tmot temp_ub_q0p75_o48 5 -48.00 143.3 FORMAT "%5.1" DEPOSIT ABSOLUTE /end AXIS_DESCR
/end CHARACTERISTIC
/begin CHARACTERISTIC DZWQ2DZW "Deltaz¸ndwinkel" CURVE 0xFCB1C8 FklWSb 191.3 zw_sb_q0p75 -96.00 95.25 FORMAT "%5.2"
 /begin AXIS_DESCR FIX_AXIS dzwssq kwq_ub_q0p35576 201 0.00 71.15 FORMAT "%5.2" FIX_AXIS_PAR 0 0 201 /end AXIS_DESCR
/end CHARACTERISTIC
/begin CHARACTERISTIC DZWQ2DZWL "Deltaz¸ndwinkel unterer Bereich" CURVE 0xFCB294 FklWSb 191.3 zw_sb_q0p75 -96.00 95.25 FORMAT "%5.2"
 /begin AXIS_DESCR FIX_AXIS dzwssql kwq_ub_q0p04447 64 0.00 2.802 FORMAT "%5.3" FIX_AXIS_PAR 0 0 64 /end AXIS_DESCR
/end CHARACTERISTIC
/begin CHARACTERISTIC ETALAM "Lambda-Wirkungsgrad" CURVE 0xFC75D0 KlAUbSstUbWUb 127.5 rel_ub_b127p5 0.00 127.5 FORMAT "%5.1"
 /begin AXIS_DESCR STD_AXIS lambas fak_ub_b2 10 0.00 1.992 FORMAT "%5.3" DEPOSIT ABSOLUTE /end AXIS_DESCR
/end CHARACTERISTIC
/begin CHARACTERISTIC ETAZWMNL "minimaler Z¸ndwinkel-Wirkungsgrad f¸r Lastwechselschlagd‰mpfung" VALUE 0xFCFABA KwUb 127.5 rel_ub_b127p5 0.00 127.5 FORMAT "%5.1" /end CHARACTERISTIC
/begin CHARACTERISTIC FABMDKO "Anfangsfaktor Klimakompressor-Lastabregelung" VALUE 0xFCF36D KwUb 7.969 fak_ub_b8 0.00 7.969 FORMAT "%5.3" /end CHARACTERISTIC
/begin CHARACTERISTIC FABMDWA "Faktor zur Absteuerung des Wandlermoments abh‰ngig von nturb/nsol" CURVE 0xFC7088 KlAUbSstUbWUb 0.9961 fak_ub_b1 0.00 0.9961
 /begin AXIS_DESCR STD_AXIS qntns fak_ub_b8 6 0.00 7.969 FORMAT "%5.3" DEPOSIT ABSOLUTE /end AXIS_DESCR
/end CHARACTERISTIC
/begin CHARACTERISTIC FDMDWAN "Wichtungsfaktor f¸r Einrechnung D-Anteil in Wandlermoment" VALUE 0xFC7095 KwUb 0.9961 fak_ub_b1 0.00 0.9961 /end CHARACTERISTIC
/begin CHARACTERISTIC FDZWKOFTMT "" CURVE 0xFCF5E0 KlAUbSstUbWUb 0.9961 fak_ub_b1 0.00 0.9961
 /begin AXIS_DESCR STD_AXIS tmot temp_ub_q0p75_o48 6 -48.00 143.3 FORMAT "%5.1" DEPOSIT ABSOLUTE /end AXIS_DESCR
/end CHARACTERISTIC
/begin CHARACTERISTIC FFRITMS "Faktor f¸r I-Dynamik des Lambdareglers in Abh‰ngigkeit von tmst" CURVE 0xFCEF20 KlAUbSstUbWUb 0.9961 fak_ub_b1 0.00 0.9961
 /begin AXIS_DESCR STD_AXIS tmst temp_ub_q0p75_o48 4 -48.00 143.3 FORMAT "%5.1" DEPOSIT ABSOLUTE /end AXIS_DESCR
/end CHARACTERISTIC
/begin CHARACTERISTIC FFWEKA "Gewichtungsfaktor zur Einrechnung Wiedereinsetzfaktor fwe in Fettfl‰che" VALUE 0xFC6B99 KwUb 0.9961 fak_ub_b1 0.00 0.9961 /end CHARACTERISTIC
/begin CHARACTERISTIC FKAXAVKAT "Gewichtungsfaktor Sauerstoffspeicher in Abh‰ngigkeit von avkatf" CURVE 0xFCF190 KlAUbSstUbWUb 0.9961 fak_ub_b1 0.00 0.9961 /begin AXIS_DESCR STD_AXIS avkatf fak_ub_b1 5 0.00 0.9961 DEPOSIT ABSOLUTE /end AXIS_DESCR /end CHARACTERISTIC
/begin CHARACTERISTIC FLMLKAMA "Faktor zur Bewertung Schwellwert integr. Fettfl. f. Abbruch Kat-Ausr. Pre/Main" VALUE 0xFC6B9A KwUb 7.969 fak_ub_b8 0.00 7.969 FORMAT "%5.3" /end CHARACTERISTIC
/begin CHARACTERISTIC FLMLKAPR "Faktor zur Bewertung des gemessenen gespeicherten Sauerstoffs" VALUE 0xFC6B9B KwUb 7.969 fak_ub_b8 0.00 7.969 FORMAT "%5.3" /end CHARACTERISTIC
/begin CHARACTERISTIC FLRFKATE "Gewichtung des Adaptionswertes fkatei aus %TEB zur Anpassung der Reglerparameter" CURVE 0xFC6AC0 KlAUbSstSbWUb 1.992 fak_ub_b2 0.00 1.992 FORMAT "%5.3"
 /begin AXIS_DESCR STD_AXIS fkatei fak_sb_b1 5 -1.000 0.9922 FORMAT "%5.3" DEPOSIT ABSOLUTE /end AXIS_DESCR
/end CHARACTERISTIC
/begin CHARACTERISTIC FLRM "Faktor f¸r I-Dynamik des Lambdareglers in Abh‰ngigkeit von tmot" CURVE 0xFC6A8C KlAUbSstUbWUb 3.984 fak_ub_b4 0.00 3.984 FORMAT "%5.3"
 /begin AXIS_DESCR STD_AXIS tmot temp_ub_q0p75_o48 5 -48.00 143.3 FORMAT "%5.1" DEPOSIT ABSOLUTE /end AXIS_DESCR
/end CHARACTERISTIC
/begin CHARACTERISTIC FMDWAT "Faktor zur Berechnung des Wandlermoments abh. von der ÷ltemperatur des Wandlers" CURVE 0xFCF404 GklWUb 0.0001199 fak_ub_q4p7Em7 0.00 0.0001199 FORMAT "%9.7"
 /begin AXIS_DESCR COM_AXIS tmot temp_ub_q0p75_o48 8 -48.00 143.3 FORMAT "%5.1" AXIS_PTS_REF STM08MDUB /end AXIS_DESCR
/end CHARACTERISTIC
/begin CHARACTERISTIC FMIHGN "Wichtungsfaktor Momentenbegrenzung bei Schaltgetriebeschutz" CURVE 0xFCFAA4 KlAUbSstUbWUb 1.992 rel_ub_b2p0 0.00 1.992 FORMAT "%5.3"
 /begin AXIS_DESCR STD_AXIS nmot nmot_ub_q40 8 0.00 10200. FORMAT "%5.0" DEPOSIT ABSOLUTE /end AXIS_DESCR
/end CHARACTERISTIC
/begin CHARACTERISTIC FMIVL "Faktor Korrektur maximales Moment bei VL" VALUE 0xFC8154 KwUb 1.992 fak_ub_b2 0.00 1.992 FORMAT "%5.3" /end CHARACTERISTIC
/begin CHARACTERISTIC FMLKAMA "Faktor zur Bewertung Schwellwert integr. Luftm. f. Abbruch Kat-Ausr. Pre/Main" VALUE 0xFC6B9C KwUb 7.969 fak_ub_b8 0.00 7.969 FORMAT "%5.3" /end CHARACTERISTIC
/begin CHARACTERISTIC FMLVFZG "Korrekturfaktor E-L¸fter-Tastverh‰ltnis aus vfzg" CURVE 0xFD054C KlAUbSstUbWUb 0.9961 fak_ub_b1 0.00 0.9961
 /begin AXIS_DESCR STD_AXIS vfzg vfzg_ub_q1p25 10 0.00 318.8 FORMAT "%5.1" DEPOSIT ABSOLUTE /end AXIS_DESCR
/end CHARACTERISTIC
/begin CHARACTERISTIC FNRAD "Faktor zwischen Raddrehzahl und Geschwindigkeit f(Radumfang)" VALUE 0xFC7096 KwUb 15.94 fak_ub_b16 0.00 15.94 FORMAT "%5.2" /end CHARACTERISTIC
/begin CHARACTERISTIC FNSTABNV "Faktor zur Drehzahlstabilisierung durch Drehmoment" CURVE 0xFC6E2C KlAxU8SstxU16WU16 7.999878 fak_uw_b8 0.00 7.999878 FORMAT "%8.6"
 /begin AXIS_DESCR STD_AXIS fnsta_in fak_uw_b8 6 0.00 7.999878 FORMAT "%8.6" DEPOSIT ABSOLUTE /end AXIS_DESCR
/end CHARACTERISTIC
/begin CHARACTERISTIC FRAOMN "untere Begrenzung des Korrekturfaktors frao" VALUE 0xFCDF18 KwUb 1.992 fak_ub_b2 0.00 1.992 FORMAT "%5.3" /end CHARACTERISTIC
/begin CHARACTERISTIC FRAOMX "obere Begrenzung des Korrekturfaktors frao" VALUE 0xFCDF19 KwUb 1.992 fak_ub_b2 0.00 1.992 FORMAT "%5.3" /end CHARACTERISTIC
/begin CHARACTERISTIC FRAORN "untere reduzierte Schwelle des Korrekturfaktors frao" VALUE 0xFCDF1A KwUb 1.992 fak_ub_b2 0.00 1.992 FORMAT "%5.3" /end CHARACTERISTIC
/begin CHARACTERISTIC FRAORX "obere reduzierte Schwelle des Korrekturfaktors frao" VALUE 0xFCDF1B KwUb 1.992 fak_ub_b2 0.00 1.992 FORMAT "%5.3" /end CHARACTERISTIC
/begin CHARACTERISTIC FRAUMN "untere Begrenzung des Korrekturfaktors frau" VALUE 0xFCDF1C KwUb 1.992 fak_ub_b2 0.00 1.992 FORMAT "%5.3" /end CHARACTERISTIC
/begin CHARACTERISTIC FRAUMX "obere Begrenzung des Korrekturfaktors frau" VALUE 0xFCDF1D KwUb 1.992 fak_ub_b2 0.00 1.992 FORMAT "%5.3" /end CHARACTERISTIC
/begin CHARACTERISTIC FRAURN "untere reduzierte Schwelle des Korrekturfaktors frau" VALUE 0xFCDF1E KwUb 1.992 fak_ub_b2 0.00 1.992 FORMAT "%5.3" /end CHARACTERISTIC
/begin CHARACTERISTIC FRAURX "obere reduzierte Schwelle des Korrekturfaktors frau" VALUE 0xFCDF1F KwUb 1.992 fak_ub_b2 0.00 1.992 FORMAT "%5.3" /end CHARACTERISTIC
/begin CHARACTERISTIC FRIPDSL1 "Faktor zur Verstellung von fri und frp w‰hrend Phase1 in DSLSLR aktiv" VALUE 0xFC6A97 KwUb 3.984 fak_ub_b4 0.00 3.984 FORMAT "%5.3" /end CHARACTERISTIC
/begin CHARACTERISTIC FRIPDSL4 "Faktor zur Verstellung von fri und frp w‰hrend Phase 4 in DSLSLR aktiv" VALUE 0xFC6A98 KwUb 3.984 fak_ub_b4 0.00 3.984 FORMAT "%5.3" /end CHARACTERISTIC
/begin CHARACTERISTIC FRIPDTES "Faktor zur Verstellung von fri und frp w‰hrend DTEV aktiv" VALUE 0xFC6A99 KwUb 3.984 fak_ub_b4 0.00 3.984 FORMAT "%5.3" /end CHARACTERISTIC
/begin CHARACTERISTIC FRIPTES "Faktor zur Verstellung von fri und frp bei Fehler ""offenes TEV klemmt""" VALUE 0xFC6A9A KwUb 3.984 fak_ub_b4 0.00 3.984 FORMAT "%5.3" /end CHARACTERISTIC
/begin CHARACTERISTIC FRLVTM "Korrekturfaktor max. Volumenstrom bei offener Drosselklappe" CURVE 0xFC8158 KlAUbSstUbWUb 1.992 fak_ub_b2 0.00 1.992 FORMAT "%5.3"
 /begin AXIS_DESCR STD_AXIS tmot temp_ub_q0p75_o48 5 -48.00 143.3 FORMAT "%5.1" DEPOSIT ABSOLUTE /end AXIS_DESCR
/end CHARACTERISTIC
/begin CHARACTERISTIC FRMAX "obere Regelbereichsgrenze" VALUE 0xFC6ACC KwUw 1.999969 fak_uw_b2 0.00 1.999969 FORMAT "%8.6" /end CHARACTERISTIC
/begin CHARACTERISTIC FRMINSLS "Minimaler Lambdaregelfaktor w‰hrend Phase 1 der Sekund‰rluftdiagnose" VALUE 0xFCF032 KwUw 1.999969 fak_uw_b2 0.00 1.999969 FORMAT "%8.6" /end CHARACTERISTIC
/begin CHARACTERISTIC FRMINSLSK "Minimaler Lambdaregelfaktor w‰hrend Phase 1 Kurtztest  Sekund‰rluftdiagnose" VALUE 0xFCF034 KwUw 1.999969 fak_uw_b2 0.00 1.999969 FORMAT "%8.6" /end CHARACTERISTIC
/begin CHARACTERISTIC FRTEMX "obere Regelbereichsgrenze bei Fehler ""offen klemmendes TEV""" VALUE 0xFC6ACE KwUw 1.999969 fak_uw_b2 0.00 1.999969 FORMAT "%8.6" /end CHARACTERISTIC
/begin CHARACTERISTIC FVDMDWAN "Verst‰rkungsfaktor zur Bildung D-Ateil-Wandlermomnet" VALUE 0xFC7097 KwUb 7.969 fak_ub_b8 0.00 7.969 FORMAT "%5.3" /end CHARACTERISTIC
/begin CHARACTERISTIC ILMLKAXTK "Schwelle Fettfl‰che Kat-Ausr‰umen nach SA, Funktion der Kat-Temperatur" CURVE 0xFCF19C KlAUwSstUwWUw 4660.267 m_uw_b4660 0.00 4660.267 FORMAT "%8.3"
 /begin AXIS_DESCR STD_AXIS tkatms_w temp_uw_q0p0195_o50 5 -50.00000 1229.980 FORMAT "%8.3" DEPOSIT ABSOLUTE /end AXIS_DESCR
/end CHARACTERISTIC
/begin CHARACTERISTIC IMLAKMN "Schwellwert integr. Luftmasse f. Mindestdauer Katalysator-Ausr‰umen" VALUE 0xFC6BA2 KwUw 4660.267 m_uw_b4660 0.00 4660.267 FORMAT "%8.3" /end CHARACTERISTIC
/begin CHARACTERISTIC IMLKAXTK "Schwellwert f(tkatm_w) integr. Luftmasse f. Abbruch Katalysator-Ausr‰umen" CURVE 0xFCF1B2 KlAUwSstUwWUw 4660.267 m_uw_b4660 0.00 4660.267 FORMAT "%8.3"
 /begin AXIS_DESCR STD_AXIS tkatms_w temp_uw_q0p0195_o50 5 -50.00000 1229.980 FORMAT "%8.3" DEPOSIT ABSOLUTE /end AXIS_DESCR
/end CHARACTERISTIC
/begin CHARACTERISTIC IMLSALR "Schwellwert integr. Luftmasse f. Einschaltverzˆgerung LR nach SA" VALUE 0xFC6ADA KwUw 4660.267 m_uw_b4660 0.00 4660.267 FORMAT "%8.3" /end CHARACTERISTIC
/begin CHARACTERISTIC KDLASHKI "Kennlinie ¸ber dlashkm, Bewertungsfaktor f¸r I-Anteil in der LRHK" CURVE 0xFCF12C KlASwSstSwWSw 1.999969 fak_sw_b1 -1.000000 0.9999695 FORMAT "%8.6"
 /begin AXIS_DESCR STD_AXIS idlashkm_w fak_sw_b1 10 -1.000000 0.9999695 FORMAT "%8.6" DEPOSIT ABSOLUTE /end AXIS_DESCR
/end CHARACTERISTIC
/begin CHARACTERISTIC KDLASHKP "Kennlinie ¸ber dlashkm_w, Bewertungsfaktor f¸r P-Anteil in der LRHK" CURVE 0xFCF156 KlASwSstSwWSw 1.999969 fak_sw_b1 -1.000000 0.9999695 FORMAT "%8.6"
 /begin AXIS_DESCR STD_AXIS idlashkm_w fak_sw_b1 10 -1.000000 0.9999695 FORMAT "%8.6" DEPOSIT ABSOLUTE /end AXIS_DESCR
/end CHARACTERISTIC
/begin CHARACTERISTIC KFDLSD "D‰mpfung PT2-Filter Lastschlagd‰mpfung" MAP 0xFCF6A0 GkfWUw 1.999969 fak_uw_b2 0.00 1.999969 FORMAT "%8.6"
 /begin AXIS_DESCR COM_AXIS gangi dez 8 0.00 255.0 FORMAT "%5.1" AXIS_PTS_REF SGA08MDUB /end AXIS_DESCR
 /begin AXIS_DESCR COM_AXIS nmot_w nmot_uw_q0p25 6 0.00 16383.75 FORMAT "%8.2" AXIS_PTS_REF SNM06MDUW /end AXIS_DESCR
/end CHARACTERISTIC
/begin CHARACTERISTIC KFDMDPO "Delta Moment Dashpotauslˆsung" MAP 0xFC7CC4 GkfWSw 199.9969 rel_sw_b100 -100.0000 99.99695 FORMAT "%8.4"
 /begin AXIS_DESCR COM_AXIS gangi dez 8 0.00 255.0 FORMAT "%5.1" AXIS_PTS_REF SGA08MDUB /end AXIS_DESCR
 /begin AXIS_DESCR COM_AXIS mkfanb_w rel_sw_b100 6 -100.0000 99.99695 FORMAT "%8.4" AXIS_PTS_REF SMK06MDUW /end AXIS_DESCR
/end CHARACTERISTIC
/begin CHARACTERISTIC KFDMLSDO "Delta Moment Auslˆsung Lastschlagd‰mpfung" MAP 0xFC7D24 GkfWSw 199.9969 rel_sw_b100 -100.0000 99.99695 FORMAT "%8.4"
 /begin AXIS_DESCR COM_AXIS gangi dez 8 0.00 255.0 FORMAT "%5.1" AXIS_PTS_REF SGA08MDUB /end AXIS_DESCR
 /begin AXIS_DESCR COM_AXIS mkfanb_w rel_sw_b100 6 -100.0000 99.99695 FORMAT "%8.4" AXIS_PTS_REF SMK06MDUW /end AXIS_DESCR
/end CHARACTERISTIC
/begin CHARACTERISTIC KFDZWAGR "Z¸ndwinkeloffset bei AGR" MAP 0xFCF5ED KfAxUbAyUbSstxUbSstyUbWSb 191.3 zw_sb_q0p75 -96.00 95.25 FORMAT "%5.2"
 /begin AXIS_DESCR STD_AXIS rl rel_ub_q0p75 8 0.00 191.3 FORMAT "%5.1" DEPOSIT ABSOLUTE /end AXIS_DESCR
 /begin AXIS_DESCR STD_AXIS agrr rel_ub_b99p6 6 0.00 99.61 FORMAT "%5.2" DEPOSIT ABSOLUTE /end AXIS_DESCR
/end CHARACTERISTIC
/begin CHARACTERISTIC KFDZWKOEF "Kennfeld Koeffizient f¸r ZW-Wirkungsgrad" MAP 0xFC71DC GkfWU8 11.20 fak_q0p0439 0.00 11.20 FORMAT "%5.2"
 /begin AXIS_DESCR COM_AXIS nmot_w nmot_uw_q0p25 16 0.00 16383.75 FORMAT "%8.2" AXIS_PTS_REF SNM16OPUW /end AXIS_DESCR
 /begin AXIS_DESCR COM_AXIS rl_w_kge rel_uw_q0p0234 16 0.00 1535.977 FORMAT "%8.3" AXIS_PTS_REF SRL16OPUW /end AXIS_DESCR
/end CHARACTERISTIC
/begin CHARACTERISTIC KFDZWKOEFT "Kennfeld Koeffizient f¸r ZW-Wirkungsgrad Teil-Dross" MAP 0xFC72DC GkfWU8 11.20 fak_q0p0439 0.00 11.20 FORMAT "%5.2"
 /begin AXIS_DESCR COM_AXIS nmot_w nmot_uw_q0p25 16 0.00 16383.75 FORMAT "%8.2" AXIS_PTS_REF SNM16OPUW /end AXIS_DESCR
 /begin AXIS_DESCR COM_AXIS rl_w_kge rel_uw_q0p0234 16 0.00 1535.977 FORMAT "%8.3" AXIS_PTS_REF SRL16OPUW /end AXIS_DESCR
/end CHARACTERISTIC
/begin CHARACTERISTIC KFETAGD "KF Wirkungsgrad gedrosselt in Bezug auf 100% bei ungedrosseltem Betrieb" MAP 0xFC7816 GkfWUw 99.99847 rel_uw_b100 0.00 99.99847 FORMAT "%8.5"
 /begin AXIS_DESCR COM_AXIS nmot_w nmot_uw_q0p25 16 0.00 16383.75 FORMAT "%8.2" AXIS_PTS_REF SNM16OPUW /end AXIS_DESCR
 /begin AXIS_DESCR COM_AXIS rl_w_kge rel_uw_q0p0234 16 0.00 1535.977 FORMAT "%8.3" AXIS_PTS_REF SRL16OPUW /end AXIS_DESCR
/end CHARACTERISTIC
/begin CHARACTERISTIC KFETAMN "Minimaler ZW-Wirkungsgrad bei LSD" MAP 0xFC8100 KfAxUbAyUbSstxUbSstyUbWUb 127.5 rel_ub_b127p5 0.00 127.5 FORMAT "%5.1"
 /begin AXIS_DESCR STD_AXIS mifa rel_ub_b99p6 8 0.00 99.61 FORMAT "%5.2" DEPOSIT ABSOLUTE /end AXIS_DESCR
 /begin AXIS_DESCR STD_AXIS gangi dez 8 0.00 255.0 FORMAT "%5.1" DEPOSIT ABSOLUTE /end AXIS_DESCR
/end CHARACTERISTIC
/begin CHARACTERISTIC KFFDMFBT "Faktor zur ‹berblendung ungedrosselt - teilgedrosselt - gedrosselt" MAP 0xFCF650 KfAxUbAyUbSstxUbSstyUbWUb 0.9961 fak_ub_b1 0.00 0.9961
 /begin AXIS_DESCR STD_AXIS dpsfaktd fak_ub_q0p00392 6 0.00 1.000 FORMAT "%5.3" DEPOSIT ABSOLUTE /end AXIS_DESCR
 /begin AXIS_DESCR STD_AXIS dpsfak fak_ub_q0p00392 2 0.00 1.000 FORMAT "%5.3" DEPOSIT ABSOLUTE /end AXIS_DESCR
/end CHARACTERISTIC
/begin CHARACTERISTIC KFFMKNULFS "Kennfeld Faktor f¸r momentenneutraler Nulldurchgang f¸r DASH/LSD" MAP 0xFC7C3A KfAxUbAyUbSstxUwSstyUwWUw 1.999969 fak_uw_b2 0.00 1.999969 FORMAT "%8.6"
 /begin AXIS_DESCR STD_AXIS ntnmot_w fak_uw_b4 6 0.00 3.999939 FORMAT "%8.6" DEPOSIT ABSOLUTE /end AXIS_DESCR
 /begin AXIS_DESCR STD_AXIS gangi dez 8 0.00 7.000 FORMAT "%5.3" DEPOSIT ABSOLUTE /end AXIS_DESCR
/end CHARACTERISTIC
/begin CHARACTERISTIC KFFRMIN "untere Regelbereichsgrenze" MAP 0xFCF036 KfAxUbAyUbSstxUbSstyUwWUw 1.999969 fak_uw_b2 0.00 1.999969 FORMAT "%8.6"
 /begin AXIS_DESCR STD_AXIS tmot temp_ub_q0p75_o48 5 -48.00 143.3 FORMAT "%5.1" DEPOSIT ABSOLUTE /end AXIS_DESCR
 /begin AXIS_DESCR STD_AXIS tnst_w t10msxs_uw_b655p35 5 0.00 655.3500 FORMAT "%8.4" DEPOSIT ABSOLUTE /end AXIS_DESCR
/end CHARACTERISTIC
/begin CHARACTERISTIC KFFTV "Gewichtungskennfeld f¸r TVLRH" MAP 0xFCF0C4 GkfWUb 1.992 fak_ub_b2 0.00 1.992 FORMAT "%5.3"
 /begin AXIS_DESCR COM_AXIS nmot nmot_ub_q40 6 0.00 10200. FORMAT "%5.0" AXIS_PTS_REF SNM06LHUB /end AXIS_DESCR
 /begin AXIS_DESCR COM_AXIS rl rel_ub_q0p75 6 0.00 191.3 FORMAT "%5.1" AXIS_PTS_REF SRL06LHUB /end AXIS_DESCR
/end CHARACTERISTIC
/begin CHARACTERISTIC KFKDZWKOFT "" MAP 0xFC73DC GkfWU8 11.20 fak_q0p0439 0.00 11.20 FORMAT "%5.2"
 /begin AXIS_DESCR COM_AXIS nmot_w nmot_uw_q0p25 16 0.00 16383.75 FORMAT "%8.2" AXIS_PTS_REF SNM16OPUW /end AXIS_DESCR
 /begin AXIS_DESCR COM_AXIS rl_w_kge rel_uw_q0p0234 16 0.00 1535.977 FORMAT "%8.3" AXIS_PTS_REF SRL16OPUW /end AXIS_DESCR
/end CHARACTERISTIC
/begin CHARACTERISTIC KFMDGEN "Drehmomentenaufnahme Generator" MAP 0xFC701C KfAxU8AyU8SstxU16SstyU16WU16 1.999969 fak_uw_b2 0.00 1.999969 FORMAT "%8.6"
 /begin AXIS_DESCR STD_AXIS nmot_w nmot_uw_q0p25 6 0.00 16383.75 FORMAT "%8.2" DEPOSIT ABSOLUTE /end AXIS_DESCR
 /begin AXIS_DESCR STD_AXIS mdgenvf_w rel_uw_b100 6 0.00 99.99847 FORMAT "%8.5" DEPOSIT ABSOLUTE /end AXIS_DESCR
/end CHARACTERISTIC
/begin CHARACTERISTIC KFMDKO "Drehmomentaufnahme Klimakompressor" MAP 0xFCF370 KfAxUbAyUbSstxUbSstyUbWUb 49.73 rel_ub_b49p725 0.00 49.73 FORMAT "%5.2"
 /begin AXIS_DESCR STD_AXIS nmot nmot_ub_q40 6 0.00 10200. FORMAT "%5.0" DEPOSIT ABSOLUTE /end AXIS_DESCR
 /begin AXIS_DESCR STD_AXIS kopwm rel_ub_b99p6 6 0.00 99.61 FORMAT "%5.2" DEPOSIT ABSOLUTE /end AXIS_DESCR
/end CHARACTERISTIC
/begin CHARACTERISTIC KFMDKOG "Drehmomentaufnahme geregelter Klimakompressor" MAP 0xFCF3A4 KfAxUbAyUbSstxUbSstyUbWUb 49.73 rel_ub_b49p725 0.00 49.73 FORMAT "%5.2"
 /begin AXIS_DESCR STD_AXIS nmot nmot_ub_q40 6 0.00 10200. FORMAT "%5.0" DEPOSIT ABSOLUTE /end AXIS_DESCR
 /begin AXIS_DESCR STD_AXIS mdkog md_ub_q1 6 0.00 255.0 FORMAT "%5.1" DEPOSIT ABSOLUTE /end AXIS_DESCR
/end CHARACTERISTIC
/begin CHARACTERISTIC KFMDS "Schleppmoment Drehzahl- und Lastabh‰ngigkeit" MAP 0xFC6E6C KfAxUwAyUwSstxUwSstyUwWUw 99.99847 rel_uw_b100 0.00 99.99847 FORMAT "%8.5"
 /begin AXIS_DESCR STD_AXIS nmot_w nmot_uw_q0p25 10 0.00 16383.75 FORMAT "%8.2" DEPOSIT ABSOLUTE /end AXIS_DESCR
 /begin AXIS_DESCR STD_AXIS rl_w rel_uw_q0p0234 12 0.00 1535.977 FORMAT "%8.3" DEPOSIT ABSOLUTE /end AXIS_DESCR
/end CHARACTERISTIC
/begin CHARACTERISTIC KFMDSM "Schleppmoment Temperaturanteil" MAP 0xFC6F8C KfAxUbAyUbSstxUbSstyUwWUw 99.99847 rel_uw_b100 0.00 99.99847 FORMAT "%8.5"
 /begin AXIS_DESCR STD_AXIS tmot temp_ub_q0p75_o48 6 -48.00 143.3 FORMAT "%5.1" DEPOSIT ABSOLUTE /end AXIS_DESCR
 /begin AXIS_DESCR STD_AXIS tol temp_ub_q0p75_o48 6 -48.00 143.3 FORMAT "%5.1" DEPOSIT ABSOLUTE /end AXIS_DESCR
/end CHARACTERISTIC
/begin CHARACTERISTIC KFMDWMX "Max. Begrenzung f¸r Drehmomentaufnahme des Wandlers" MAP 0xFC7098 KfAxUbAyUbSstxUbSstyUbWUb 99.61 rel_ub_b99p6 0.00 99.61 FORMAT "%5.2"
 /begin AXIS_DESCR STD_AXIS vfzg vfzg_ub_q1p25 6 0.00 318.8 FORMAT "%5.1" DEPOSIT ABSOLUTE /end AXIS_DESCR
 /begin AXIS_DESCR STD_AXIS tmot temp_ub_q0p75_o48 8 -48.00 143.3 FORMAT "%5.1" DEPOSIT ABSOLUTE /end AXIS_DESCR
/end CHARACTERISTIC
/begin CHARACTERISTIC KFMIFALGD "Indiziertes Fahrerwunschmoment f¸r F¸llungspfad gedrosselt bei Lastschlagd." MAP 0xFCF700 KfAxUbAyUbSstxUbSstyUwWUw 99.99847 rel_uw_b100 0.00 99.99847 FORMAT "%8.5"
 /begin AXIS_DESCR STD_AXIS gangi dez 8 0.00 255.0 FORMAT "%5.1" DEPOSIT ABSOLUTE /end AXIS_DESCR
 /begin AXIS_DESCR STD_AXIS minbeg_w rel_uw_b100 8 0.00 99.99847 FORMAT "%8.5" DEPOSIT ABSOLUTE /end AXIS_DESCR
/end CHARACTERISTIC
/begin CHARACTERISTIC KFMIFALS "Indiziertes Fahrerwunschmoment f¸r F¸llungspfad bei Lastschlagd‰mpfung" MAP 0xFCF79A KfAxUbAyUbSstxUbSstyUwWUw 99.99847 rel_uw_b100 0.00 99.99847 FORMAT "%8.5"
 /begin AXIS_DESCR STD_AXIS gangi dez 8 0.00 255.0 FORMAT "%5.1" DEPOSIT ABSOLUTE /end AXIS_DESCR
 /begin AXIS_DESCR STD_AXIS minbeg_w rel_uw_b100 8 0.00 99.99847 FORMAT "%8.5" DEPOSIT ABSOLUTE /end AXIS_DESCR
/end CHARACTERISTIC
/begin CHARACTERISTIC KFMILSD "Startwert indiziertes Moment f¸r Lastschlagd‰mpfung" MAP 0xFCF834 GkfWUw 98.99902 rel_uw_b100 0.9994507 99.99847 FORMAT "%8.5"
 /begin AXIS_DESCR COM_AXIS gangi dez 8 0.00 255.0 FORMAT "%5.1" AXIS_PTS_REF SGA08MDUB /end AXIS_DESCR
 /begin AXIS_DESCR COM_AXIS nmot_w nmot_uw_q0p25 6 0.00 16383.75 FORMAT "%8.2" AXIS_PTS_REF SNM06MDUW /end AXIS_DESCR
/end CHARACTERISTIC
/begin CHARACTERISTIC KFMIMR "Kennfeld fuer Momenten¸berhˆhung im Pedal¸berweg" MAP 0xFC7D84 KfAxUwAyUwSstxUwSstyUwWUw 199.9969 rel_uw_b200 0.00 199.9969 FORMAT "%8.4"
 /begin AXIS_DESCR STD_AXIS nmot_w nmot_uw_q0p25 16 0.00 16383.75 FORMAT "%8.2" DEPOSIT ABSOLUTE /end AXIS_DESCR
 /begin AXIS_DESCR STD_AXIS mrfa_w rel_uw_b200 6 0.00 199.9969 FORMAT "%8.4" DEPOSIT ABSOLUTE /end AXIS_DESCR
/end CHARACTERISTIC
/begin CHARACTERISTIC KFMIOP "Kennfeld optimales Motormoment" MAP 0xFC7A16 GkfWUw 99.99847 rel_uw_b100 0.00 99.99847 FORMAT "%8.5"
 /begin AXIS_DESCR COM_AXIS nmot_w nmot_uw_q0p25 16 0.00 16383.75 FORMAT "%8.2" AXIS_PTS_REF SNM16OPUW /end AXIS_DESCR
 /begin AXIS_DESCR COM_AXIS rl_w_kge rel_uw_q0p0234 16 0.00 1535.977 FORMAT "%8.3" AXIS_PTS_REF SRL16OPUW /end AXIS_DESCR
/end CHARACTERISTIC
/begin CHARACTERISTIC KFMIRL "Kennfeld f¸r Berechnung Sollf¸llung" MAP 0xFC47C4 KfAxUwAyUwSstxUwSstyUwWUw 1535.977 rel_uw_q0p0234 0.00 1535.977 FORMAT "%8.3"
 /begin AXIS_DESCR STD_AXIS nmot_w nmot_uw_q0p25 16 0.00 16383.75 FORMAT "%8.2" DEPOSIT ABSOLUTE /end AXIS_DESCR
 /begin AXIS_DESCR STD_AXIS misopl1_w rel_uw_b100 16 0.00 99.99847 FORMAT "%8.5" DEPOSIT ABSOLUTE /end AXIS_DESCR
/end CHARACTERISTIC
/begin CHARACTERISTIC KFMIZUFIL "Zul‰ssiges indiziertes Moment zur Momentenbegrenzung vor Filter" MAP 0xFC81A8 GkfWUb 99.61 rel_ub_b99p6 0.00 99.61 FORMAT "%5.2"
 /begin AXIS_DESCR COM_AXIS wped relPED_ub_b100 8 0.00 100.0 FORMAT "%5.1" AXIS_PTS_REF SWP08OPUB /end AXIS_DESCR
 /begin AXIS_DESCR COM_AXIS nmot nmot_ub_q40 8 0.00 10200. FORMAT "%5.0" AXIS_PTS_REF SNM08OPUB /end AXIS_DESCR
/end CHARACTERISTIC
/begin CHARACTERISTIC KFMIZUNS "Zul‰ssiges Moment bei Nachstartaufweitung" MAP 0xFC81E8 GkfWUb 99.61 rel_ub_b99p6 0.00 99.61 FORMAT "%5.2"
 /begin AXIS_DESCR COM_AXIS wped relPED_ub_b100 8 0.00 100.0 FORMAT "%5.1" AXIS_PTS_REF SWP08OPUB /end AXIS_DESCR
 /begin AXIS_DESCR COM_AXIS nmot nmot_ub_q40 8 0.00 10200. FORMAT "%5.0" AXIS_PTS_REF SNM08OPUB /end AXIS_DESCR
/end CHARACTERISTIC
/begin CHARACTERISTIC KFMIZUOF "Zul‰ssiges indiziertes Moment zur Momentenbegrenzung" MAP 0xFC8228 GkfWUb 99.61 rel_ub_b99p6 0.00 99.61 FORMAT "%5.2"
 /begin AXIS_DESCR COM_AXIS mizuvfil rel_ub_b99p6 8 0.00 99.61 FORMAT "%5.2" AXIS_PTS_REF SMO08OPUB /end AXIS_DESCR
 /begin AXIS_DESCR COM_AXIS nmot nmot_ub_q40 8 0.00 10200. FORMAT "%5.0" AXIS_PTS_REF SNM08OPUB /end AXIS_DESCR
/end CHARACTERISTIC
/begin CHARACTERISTIC KFMRMI "Kennfeld f¸r Momenten¸berhˆhung im Pedal¸berweg rel. in ind. Moment" MAP 0xFC7E74 KfAxUwAyUwSstxUwSstyUwWUw 175.5829 rel_uw_b200 24.41406 199.9969 FORMAT "%8.4"
 /begin AXIS_DESCR STD_AXIS nmot_w nmot_uw_q0p25 16 0.00 16383.75 FORMAT "%8.2" DEPOSIT ABSOLUTE /end AXIS_DESCR
 /begin AXIS_DESCR STD_AXIS fmil_w rel_uw_b200 6 0.00 199.9969 FORMAT "%8.4" DEPOSIT ABSOLUTE /end AXIS_DESCR
/end CHARACTERISTIC
/begin CHARACTERISTIC KFPED "Relatives Fahrerwunschmoment aus Fahrpedal" MAP 0xFC7F64 KfAxUwAyUwSstxUwSstyUwWUw 199.9969 rel_uw_b200 0.00 199.9969 FORMAT "%8.4"
 /begin AXIS_DESCR STD_AXIS wped_w relPED_uw_b100 16 0.00 100.0000 FORMAT "%8.4" DEPOSIT ABSOLUTE /end AXIS_DESCR
 /begin AXIS_DESCR STD_AXIS nmot_w nmot_uw_q0p25 8 0.00 16383.75 FORMAT "%8.2" DEPOSIT ABSOLUTE /end AXIS_DESCR
/end CHARACTERISTIC
/begin CHARACTERISTIC KFRI "I - Kennfeld" MAP 0xFCEF2C GkfWUb 77.82 fak_ub_b77p81 0.00 77.82 FORMAT "%5.2"
 /begin AXIS_DESCR COM_AXIS nmot nmot_ub_q40 7 0.00 10200. FORMAT "%5.0" AXIS_PTS_REF SNM07LRUB /end AXIS_DESCR
 /begin AXIS_DESCR COM_AXIS rl rel_ub_q0p75 6 0.00 191.3 FORMAT "%5.1" AXIS_PTS_REF SRL06LRUB /end AXIS_DESCR
/end CHARACTERISTIC
/begin CHARACTERISTIC KFRI2 "LR-I-Kennfeld f¸r Bank 2" MAP 0xFCEF58 GkfWUb 77.82 fak_ub_b77p81 0.00 77.82 FORMAT "%5.2"
 /begin AXIS_DESCR COM_AXIS nmot nmot_ub_q40 7 0.00 10200. FORMAT "%5.0" AXIS_PTS_REF SNM07LRUB /end AXIS_DESCR
 /begin AXIS_DESCR COM_AXIS rl rel_ub_q0p75 6 0.00 191.3 FORMAT "%5.1" AXIS_PTS_REF SRL06LRUB /end AXIS_DESCR
/end CHARACTERISTIC
/begin CHARACTERISTIC KFRLMNN "Kennfeld minimale F¸llung" MAP 0xFCD644 GkfWUb 191.3 rel_ub_q0p75 0.00 191.3 FORMAT "%5.1"
 /begin AXIS_DESCR COM_AXIS nmot nmot_ub_q40 12 0.00 10200. FORMAT "%5.0" AXIS_PTS_REF SNM12FEUB /end AXIS_DESCR
 /begin AXIS_DESCR COM_AXIS tmot temp_ub_q0p75_o48 4 -48.00 143.3 FORMAT "%5.1" AXIS_PTS_REF STM04FEUB /end AXIS_DESCR
/end CHARACTERISTIC
/begin CHARACTERISTIC KFRLMNNT "" MAP 0xFCD674 GkfWUb 191.3 rel_ub_q0p75 0.00 191.3 FORMAT "%5.1"
 /begin AXIS_DESCR COM_AXIS nmot nmot_ub_q40 12 0.00 10200. FORMAT "%5.0" AXIS_PTS_REF SNM12FEUB /end AXIS_DESCR
 /begin AXIS_DESCR COM_AXIS tmot temp_ub_q0p75_o48 4 -48.00 143.3 FORMAT "%5.1" AXIS_PTS_REF STM04FEUB /end AXIS_DESCR
/end CHARACTERISTIC
/begin CHARACTERISTIC KFRLMNSAN "Kennfeld minimale F¸llung im Schub" MAP 0xFCD6A4 GkfWUb 191.3 rel_ub_q0p75 0.00 191.3 FORMAT "%5.1"
 /begin AXIS_DESCR COM_AXIS nmot nmot_ub_q40 12 0.00 10200. FORMAT "%5.0" AXIS_PTS_REF SNM12FEUB /end AXIS_DESCR
 /begin AXIS_DESCR COM_AXIS tmot temp_ub_q0p75_o48 4 -48.00 143.3 FORMAT "%5.1" AXIS_PTS_REF STM04FEUB /end AXIS_DESCR
/end CHARACTERISTIC
/begin CHARACTERISTIC KFRLMNSANT "" MAP 0xFCD6D4 GkfWUb 191.3 rel_ub_q0p75 0.00 191.3 FORMAT "%5.1"
 /begin AXIS_DESCR COM_AXIS nmot nmot_ub_q40 12 0.00 10200. FORMAT "%5.0" AXIS_PTS_REF SNM12FEUB /end AXIS_DESCR
 /begin AXIS_DESCR COM_AXIS tmot temp_ub_q0p75_o48 4 -48.00 143.3 FORMAT "%5.1" AXIS_PTS_REF STM04FEUB /end AXIS_DESCR
/end CHARACTERISTIC
/begin CHARACTERISTIC KFRP "P - Kennfeld" MAP 0xFCEF84 GkfWUb 9.766 fak_ub_b12p45 0.00 9.766 FORMAT "%5.3"
 /begin AXIS_DESCR COM_AXIS nmot nmot_ub_q40 7 0.00 10200. FORMAT "%5.0" AXIS_PTS_REF SNM07LRUB /end AXIS_DESCR
 /begin AXIS_DESCR COM_AXIS rl rel_ub_q0p75 6 0.00 191.3 FORMAT "%5.1" AXIS_PTS_REF SRL06LRUB /end AXIS_DESCR
/end CHARACTERISTIC
/begin CHARACTERISTIC KFRP2 "LR-P-Kennfeld f¸r rechten Abgasstrang" MAP 0xFCEFB0 GkfWUb 9.766 fak_ub_b12p45 0.00 9.766 FORMAT "%5.3"
 /begin AXIS_DESCR COM_AXIS nmot nmot_ub_q40 7 0.00 10200. FORMAT "%5.0" AXIS_PTS_REF SNM07LRUB /end AXIS_DESCR
 /begin AXIS_DESCR COM_AXIS rl rel_ub_q0p75 6 0.00 191.3 FORMAT "%5.1" AXIS_PTS_REF SRL06LRUB /end AXIS_DESCR
/end CHARACTERISTIC
/begin CHARACTERISTIC KFRTV "TV - Kennfeld (Lambdaregelung Reglerumschaltverzˆgerung)" MAP 0xFCEFDC GkfWSb 2.550 t10msxs_sb_q0p01 -1.280 1.270 FORMAT "%5.3"
 /begin AXIS_DESCR COM_AXIS nmot nmot_ub_q40 7 0.00 10200. FORMAT "%5.0" AXIS_PTS_REF SNM07LRUB /end AXIS_DESCR
 /begin AXIS_DESCR COM_AXIS rl rel_ub_q0p75 6 0.00 191.3 FORMAT "%5.1" AXIS_PTS_REF SRL06LRUB /end AXIS_DESCR
/end CHARACTERISTIC
/begin CHARACTERISTIC KFRTV2 "TV - Kennfeld (Lambdaregelung Reglerumschaltverzˆgerung) Bank2" MAP 0xFCF008 GkfWSb 2.550 t10msxs_sb_q0p01 -1.280 1.270 FORMAT "%5.3"
 /begin AXIS_DESCR COM_AXIS nmot nmot_ub_q40 7 0.00 10200. FORMAT "%5.0" AXIS_PTS_REF SNM07LRUB /end AXIS_DESCR
 /begin AXIS_DESCR COM_AXIS rl rel_ub_q0p75 6 0.00 191.3 FORMAT "%5.1" AXIS_PTS_REF SRL06LRUB /end AXIS_DESCR
/end CHARACTERISTIC
/begin CHARACTERISTIC KFUSHK "Sondenspannungssollwert f¸r Regelung hinter Kat. (statt KFUSRHK f¸r Variantenk.)" MAP 0xFCF0E8 GkfWUb 1.330 spg_ub_q0p0052_o0p2 -0.2000 1.130 FORMAT "%5.3"
 /begin AXIS_DESCR COM_AXIS nmot nmot_ub_q40 6 0.00 10200. FORMAT "%5.0" AXIS_PTS_REF SNM06LHUB /end AXIS_DESCR
 /begin AXIS_DESCR COM_AXIS rl rel_ub_q0p75 6 0.00 191.3 FORMAT "%5.1" AXIS_PTS_REF SRL06LHUB /end AXIS_DESCR
/end CHARACTERISTIC
/begin CHARACTERISTIC KFWDMVAD "Wichtung der Leerlaufadaption dmvad_w" MAP 0xFC6FE8 KfAxU8AyU8SstxU16SstyU16WU16 0.9999847 fak_uw_b1 0.00 0.9999847 FORMAT "%9.7"
 /begin AXIS_DESCR STD_AXIS rl_w rel_uw_q0p0234 4 0.00 1535.977 FORMAT "%8.3" DEPOSIT ABSOLUTE /end AXIS_DESCR
 /begin AXIS_DESCR STD_AXIS nmot_w nmot_uw_q0p25 4 0.00 16383.75 FORMAT "%8.2" DEPOSIT ABSOLUTE /end AXIS_DESCR
/end CHARACTERISTIC
/begin CHARACTERISTIC KFWPFGR "Inverses Pedalkennfeld f¸r FGR-Betrieb" MAP 0xFCF894 KfAxUwAyUwSstxUwSstyUwWUw 99.99847 rel_uw_b100 0.00 99.99847 FORMAT "%8.5"
 /begin AXIS_DESCR STD_AXIS mrfgr_w rel_uw_b200 16 0.00 199.9969 FORMAT "%8.4" DEPOSIT ABSOLUTE /end AXIS_DESCR
 /begin AXIS_DESCR STD_AXIS nmot_w nmot_uw_q0p25 8 0.00 16383.75 FORMAT "%8.2" DEPOSIT ABSOLUTE /end AXIS_DESCR
/end CHARACTERISTIC
/begin CHARACTERISTIC KFZDASH "Zeitkonstante PT1-Filter Dashpot" MAP 0xFCF9C8 GkfWUw 655.34999985 zk10msxs_uw_b655 0.010000152590 655.36000000 FORMAT "%12.8"
 /begin AXIS_DESCR COM_AXIS gangi dez 8 0.00 255.0 FORMAT "%5.1" AXIS_PTS_REF SGA08MDUB /end AXIS_DESCR
 /begin AXIS_DESCR COM_AXIS nmot_w nmot_uw_q0p25 6 0.00 16383.75 FORMAT "%8.2" AXIS_PTS_REF SNM06MDUW /end AXIS_DESCR
/end CHARACTERISTIC
/begin CHARACTERISTIC KFZLSD "Zeitkonstante PT2-Filter Lastschlagd‰mpfung" MAP 0xFCFA28 GkfWUw 655.34999985 zk10msxs_uw_b655 0.010000152590 655.36000000 FORMAT "%12.8"
 /begin AXIS_DESCR COM_AXIS gangi dez 8 0.00 255.0 FORMAT "%5.1" AXIS_PTS_REF SGA08MDUB /end AXIS_DESCR
 /begin AXIS_DESCR COM_AXIS nmot_w nmot_uw_q0p25 6 0.00 16383.75 FORMAT "%8.2" AXIS_PTS_REF SNM06MDUW /end AXIS_DESCR
/end CHARACTERISTIC
/begin CHARACTERISTIC KFZWOP "optimaler Z¸ndwinkel" MAP 0xFC75E8 GkfWSb 191.3 zw_sb_q0p75 -96.00 95.25 FORMAT "%5.2"
 /begin AXIS_DESCR COM_AXIS nmot_w nmot_uw_q0p25 16 0.00 16383.75 FORMAT "%8.2" AXIS_PTS_REF SNM16OPUW /end AXIS_DESCR
 /begin AXIS_DESCR COM_AXIS rl_w_kge rel_uw_q0p0234 16 0.00 1535.977 FORMAT "%8.3" AXIS_PTS_REF SRL16OPUW /end AXIS_DESCR
/end CHARACTERISTIC
/begin CHARACTERISTIC KFZWOP2 "optimaler Z¸ndwinkel Variante 2" MAP 0xFC76E8 GkfWSb 191.3 zw_sb_q0p75 -96.00 95.25 FORMAT "%5.2"
 /begin AXIS_DESCR COM_AXIS nmot_w nmot_uw_q0p25 16 0.00 16383.75 FORMAT "%8.2" AXIS_PTS_REF SNM16OPUW /end AXIS_DESCR
 /begin AXIS_DESCR COM_AXIS rl_w_kge rel_uw_q0p0234 16 0.00 1535.977 FORMAT "%8.3" AXIS_PTS_REF SRL16OPUW /end AXIS_DESCR
/end CHARACTERISTIC
/begin CHARACTERISTIC KFZWOPLL "optimaler Z¸ndwinkel im Leerlauf" MAP 0xFC74DC KfAxU8AyU8SstxU8SstyU8WS8 191.3 zw_sb_q0p75 -96.00 95.25 FORMAT "%5.2"
 /begin AXIS_DESCR STD_AXIS nmot nmot_ub_q40 8 0.00 10200. FORMAT "%5.0" DEPOSIT ABSOLUTE /end AXIS_DESCR
 /begin AXIS_DESCR STD_AXIS rl_kge rel_ub_q0p75 5 0.00 191.3 FORMAT "%5.1" DEPOSIT ABSOLUTE /end AXIS_DESCR
/end CHARACTERISTIC
/begin CHARACTERISTIC KFZWOPLLT "optimaler Z¸ndwinkel im Leerlauf (VVT)" MAP 0xFC7513 KfAxU8AyU8SstxU8SstyU8WS8 191.3 zw_sb_q0p75 -96.00 95.25 FORMAT "%5.2"
 /begin AXIS_DESCR STD_AXIS nmot nmot_ub_q40 8 0.00 10200. FORMAT "%5.0" DEPOSIT ABSOLUTE /end AXIS_DESCR
 /begin AXIS_DESCR STD_AXIS rl_kge rel_ub_q0p75 5 0.00 191.3 FORMAT "%5.1" DEPOSIT ABSOLUTE /end AXIS_DESCR
/end CHARACTERISTIC
/begin CHARACTERISTIC KLFMKNUL "Kennlinie Faktor Kupplungsmoment 0" CURVE 0xFCFA88 GklWUw 1.999939 fak_uw_b2 0.00003051758 1.999969 FORMAT "%8.6"
 /begin AXIS_DESCR COM_AXIS mkfanb_w rel_sw_b100 6 -100.0000 99.99695 FORMAT "%8.4" AXIS_PTS_REF SMK06MDUW /end AXIS_DESCR
/end CHARACTERISTIC
/begin CHARACTERISTIC KLFWUELL "Umrechnung von Summenverh‰ltnis der Spreizungen in zwopt LL-Gewichtung" CURVE 0xFC77E8 KlAUbSstUbWUb 0.9961 fak_ub_b1 0.00 0.9961
 /begin AXIS_DESCR STD_AXIS fwuell fak_ub_b2 6 0.00 1.992 FORMAT "%5.3" DEPOSIT ABSOLUTE /end AXIS_DESCR
/end CHARACTERISTIC
/begin CHARACTERISTIC KLMDHUB "Hubabhaengiger Anteil des Schleppmoments" CURVE 0xFC6E48 KlAxU8SstxU16WU16 99.99847 rel_uw_b100 0.00 99.99847 FORMAT "%8.5"
 /begin AXIS_DESCR STD_AXIS evhubi_w hub_uw_q0p001 8 0.00 65.53500 FORMAT "%8.5" DEPOSIT ABSOLUTE /end AXIS_DESCR
/end CHARACTERISTIC
/begin CHARACTERISTIC KLMDSL "Kennlinie Reservermoment Sekund‰rluftgebl‰se" CURVE 0xFCF3D6 KlAUwSstSwWUw 99.99847 rel_uw_b100 0.00 99.99847 FORMAT "%8.5"
 /begin AXIS_DESCR STD_AXIS lws_w lws_q0p04375 9 -1433.600 1433.556 FORMAT "%8.3" DEPOSIT ABSOLUTE /end AXIS_DESCR
/end CHARACTERISTIC
/begin CHARACTERISTIC KLTAMLKFT "Kennlinie Tastverh‰ltnis L¸fter aus Anforderung Kennfeldthermostat" CURVE 0xFD0564 KlAUbSstUbWUb 100.0 rel_ub_b100 0.00 100.0 FORMAT "%5.1"
 /begin AXIS_DESCR STD_AXIS tkadif temp_ub_q0p75 10 0.00 191.3 FORMAT "%5.1" DEPOSIT ABSOLUTE /end AXIS_DESCR
/end CHARACTERISTIC
/begin CHARACTERISTIC KLTWEMEMO "Zeitbegr. Umschaltung LSD bei Wiedereinsetzen" CURVE 0xFCF668 GklWUb 2.550 t10msxs_ub_b2p55 0.00 2.550 FORMAT "%5.3"
 /begin AXIS_DESCR COM_AXIS nmot_w nmot_uw_q0p25 6 0.00 16383.75 FORMAT "%8.2" AXIS_PTS_REF SNM06MDUW /end AXIS_DESCR
/end CHARACTERISTIC
/begin CHARACTERISTIC KLTWEMEMO2 "Zeitbegr. Umschaltung LSD bei Wiedereinsetzen f¸r Leerlauf" CURVE 0xFCF670 GklWUb 2.550 t10msxs_ub_b2p55 0.00 2.550 FORMAT "%5.3"
 /begin AXIS_DESCR COM_AXIS nmot_w nmot_uw_q0p25 6 0.00 16383.75 FORMAT "%8.2" AXIS_PTS_REF SNM06MDUW /end AXIS_DESCR
/end CHARACTERISTIC
/begin CHARACTERISTIC LALIUSH "Lambdalinearisierung, Sonde hinter Katalysator" CURVE 0xFC6B26 KlAUwSstUwWUw 15.99976 fak_uw_b16 0.00 15.99976 FORMAT "%8.5"
 /begin AXIS_DESCR STD_AXIS ushk_w spg_uw_q0p00488_o1 10 -1.000000 318.9951 FORMAT "%8.4" DEPOSIT ABSOLUTE /end AXIS_DESCR
/end CHARACTERISTIC
/begin CHARACTERISTIC LALIUSRH "Lambdalinearisierung, Sonde hinter Katalysator, Sollwert" CURVE 0xFC6B50 KlAUbSstUbWUw 15.99976 fak_uw_b16 0.00 15.99976 FORMAT "%8.5"
 /begin AXIS_DESCR STD_AXIS usrhk spg_ub_q0p0052_o0p2 10 -0.2000 1.130 FORMAT "%5.3" DEPOSIT ABSOLUTE /end AXIS_DESCR
/end CHARACTERISTIC
/begin CHARACTERISTIC LAMKAML "Lambdasollwert f¸r Katalysator-Ausr‰umen (luftmassenabh‰ngig)" CURVE 0xFCF1C8 GklWUw 15.99976 fak_uw_b16 0.00 15.99976 FORMAT "%8.5"
 /begin AXIS_DESCR COM_AXIS ml m_ub_b1020 5 0.00 1020. FORMAT "%5.0" AXIS_PTS_REF SML05LKUB /end AXIS_DESCR
/end CHARACTERISTIC
/begin CHARACTERISTIC LAMKAML2 "Lambdasollwert f¸r Katalysator-Ausr‰umen (luftmassenabh‰ngig), Bank 2" CURVE 0xFCF1D2 GklWUw 15.99976 fak_uw_b16 0.00 15.99976 FORMAT "%8.5"
 /begin AXIS_DESCR COM_AXIS ml m_ub_b1020 5 0.00 1020. FORMAT "%5.0" AXIS_PTS_REF SML05LKUB /end AXIS_DESCR
/end CHARACTERISTIC
/begin CHARACTERISTIC LASHKAB "Startwert f¸r dynamische Sollwertanhebung (lamsolh) in der LRHK" VALUE 0xFC6B70 KwSw 0.9999695 fak_sw_b1 0.00 0.9999695 FORMAT "%9.7" /end CHARACTERISTIC
/begin CHARACTERISTIC MDATNM "Drehmomentaufnahme AT-Getriebe in Fahrstufe N/P" CURVE 0xFCF42C GklWSw 99.99695 rel_sw_b100 0.00 99.99695 FORMAT "%8.5"
 /begin AXIS_DESCR COM_AXIS tmot temp_ub_q0p75_o48 8 -48.00 143.3 FORMAT "%5.1" AXIS_PTS_REF STM08MDUB /end AXIS_DESCR
/end CHARACTERISTIC
/begin CHARACTERISTIC MDATRM "Drehmomentanteil (Pumpenanteil) AT-Getriebe in Fahrstufe R" CURVE 0xFCF43C GklWSw 99.99695 rel_sw_b100 0.00 99.99695 FORMAT "%8.5"
 /begin AXIS_DESCR COM_AXIS tmot temp_ub_q0p75_o48 8 -48.00 143.3 FORMAT "%5.1" AXIS_PTS_REF STM08MDUB /end AXIS_DESCR
/end CHARACTERISTIC
/begin CHARACTERISTIC MDHYEZ "Momenten-Hysterese bei Entscheidung der Zylinderausblendung" VALUE 0xFC81A2 KwUb 99.61 rel_ub_b99p6 0.00 99.61 FORMAT "%5.2" /end CHARACTERISTIC
/begin CHARACTERISTIC MDHYST "Hysterese bei der Begrenzung des Sollmoments (Ebene 1 ‹berwachungskonzept)" VALUE 0xFC80FE KwUw 99.99847 rel_uw_b100 0.00 99.99847 FORMAT "%8.5" /end CHARACTERISTIC
/begin CHARACTERISTIC MDIAGMX "Festwert max. erlaubtes ind. Motormoment (bei AG) bei CAN-Timeout" VALUE 0xFC80D0 KwUb 99.61 rel_ub_b99p6 0.00 99.61 FORMAT "%5.2" /end CHARACTERISTIC
/begin CHARACTERISTIC MDSH "Hˆhenabh‰ngiger Anteil des Schleppmomentes" CURVE 0xFCF331 KlAUbSstUbWSb 49.90 rel_q0p1957 -25.05 24.85 FORMAT "%5.2"
 /begin AXIS_DESCR STD_AXIS fho fak_ub_b4 6 0.00 3.984 FORMAT "%5.3" DEPOSIT ABSOLUTE /end AXIS_DESCR
/end CHARACTERISTIC
/begin CHARACTERISTIC MDSL "Momentenanforderung der Servolenkung" VALUE 0xFC7080 KwUb 49.73 rel_ub_b49p725 0.00 49.73 FORMAT "%5.2" /end CHARACTERISTIC
/begin CHARACTERISTIC MDWANER "Ersatzwert fur mdwan_w bei Fehler" VALUE 0xFC70D8 KwUb 99.61 rel_ub_b99p6 0.00 99.61 FORMAT "%5.2" /end CHARACTERISTIC
/begin CHARACTERISTIC MIHGSLG "Drehmomentbegrenzung f¸r Schaltgetriebeschutz" CURVE 0xFC80D4 KlAUbSstUbWUb 99.61 rel_ub_b99p6 0.00 99.61 FORMAT "%5.2"
 /begin AXIS_DESCR STD_AXIS gangi dez 7 0.00 255.0 FORMAT "%5.1" DEPOSIT ABSOLUTE /end AXIS_DESCR
/end CHARACTERISTIC
/begin CHARACTERISTIC MKLSDUGA "Kupplungsmoment-Schwelle f¸r Parameterumschaltung LSD gangabh‰ngig" CURVE 0xFCFA94 GklWSw 199.9969 rel_sw_b100 -100.0000 99.99695 FORMAT "%8.4"
 /begin AXIS_DESCR COM_AXIS gangi dez 8 0.00 255.0 FORMAT "%5.1" AXIS_PTS_REF SGA08MDUB /end AXIS_DESCR
/end CHARACTERISTIC
/begin CHARACTERISTIC MLNKAX "Luftmassenschwelle f¸r Einschaltbereitschaft LRSHK I-Anteil" VALUE 0xFC6B72 KwUw 7281.667 m_uw_b7281 0.00 7281.667 FORMAT "%8.3" /end CHARACTERISTIC
/begin CHARACTERISTIC MLO1 "obere Luftmengenschwelle Bereich 1" VALUE 0xFCDF28 KwUw 6553.500 m_uw_b6553p5 0.00 6553.500 FORMAT "%8.3" /end CHARACTERISTIC
/begin CHARACTERISTIC MLO2 "obere Luftmengenschwelle Bereich 2" VALUE 0xFC545E KwUw 6553.500 m_uw_b6553p5 0.00 6553.500 FORMAT "%8.3" /end CHARACTERISTIC
/begin CHARACTERISTIC MLO3 "obere Luftmengenschwelle Bereich 3" VALUE 0xFCDF2A KwUw 6553.500 m_uw_b6553p5 0.00 6553.500 FORMAT "%8.3" /end CHARACTERISTIC
/begin CHARACTERISTIC MLU2 "untere Luftmengenschwelle Bereich 2" VALUE 0xFCDF2C KwUw 6553.500 m_uw_b6553p5 0.00 6553.500 FORMAT "%8.3" /end CHARACTERISTIC
/begin CHARACTERISTIC MLU4 "untere Luftmengenschwelle Bereich 4" VALUE 0xFC5460 KwUw 6553.500 m_uw_b6553p5 0.00 6553.500 FORMAT "%8.3" /end CHARACTERISTIC
/begin CHARACTERISTIC MRFALLO "Obere Leerlaufschwelle des relativen Fahrerwunschmoments" VALUE 0xFC8098 KwUw 199.9969 rel_uw_b200 0.00 199.9969 FORMAT "%8.4" /end CHARACTERISTIC
/begin CHARACTERISTIC MRFALLU "Untere Leerlaufschwelle des relativen Fahrerwunschmoments" VALUE 0xFC809A KwUw 199.9969 rel_uw_b200 0.00 199.9969 FORMAT "%8.4" /end CHARACTERISTIC
/begin CHARACTERISTIC MRFUEMXN "Kennlinie max. ereichbares Fahrerwunschmoment f¸r Pedal¸berweg" CURVE 0xFC809C KlAUwSstUwWUw 199.9969 rel_uw_b200 0.00 199.9969 FORMAT "%8.4"
 /begin AXIS_DESCR STD_AXIS nmot_w nmot_uw_q0p25 6 0.00 16383.75 FORMAT "%8.2" DEPOSIT ABSOLUTE /end AXIS_DESCR
/end CHARACTERISTIC
/begin CHARACTERISTIC N0 "Umrechnungskonstante f¸r Einrechnung Gemischkorrektur rkat" VALUE 0xFC545C KwUb 10200. nmot_ub_q40 0.00 10200. FORMAT "%5.0" /end CHARACTERISTIC
/begin CHARACTERISTIC NASNOT "Drehzahlschwelle f¸r ASR-Verbot wegen Abw¸rgeschutz" VALUE 0xFC80F0 KwUb 2560. nmot_ub_q40 0.00 2560. FORMAT "%5.0" /end CHARACTERISTIC
/begin CHARACTERISTIC NGFSAWE "Schwelle Drehzahlgradient f¸r Sperrung Filter SA/WE" VALUE 0xFC80B6 KwSw 25599.94 nmotg_sw_q0p39 -12800.16 12799.77 FORMAT "%8.2" /end CHARACTERISTIC
/begin CHARACTERISTIC NGHGS "Drehzahlgradient f¸r gangabh‰ngige Momentenbegrenzung" VALUE 0xFC80E4 KwSw 25599.94 nmotg_sw_q0p39 -12800.16 12799.77 FORMAT "%8.2" /end CHARACTERISTIC
/begin CHARACTERISTIC NKUPZWEO "Obere Drehzahl-Hytereseschwelle f¸r KUP-ZW-Eingriffe" VALUE 0xFC80F1 KwUb 10200. nmot_ub_q40 0.00 10200. FORMAT "%5.0" /end CHARACTERISTIC
/begin CHARACTERISTIC NKUPZWEU "Untere Drehzahl-Hytereseschwelle f¸r KUP-ZW-Eingriffe" VALUE 0xFC80F2 KwUb 10200. nmot_ub_q40 0.00 10200. FORMAT "%5.0" /end CHARACTERISTIC
/begin CHARACTERISTIC NLLZWEO "Obere  Drehzahl-Hytereseschwelle f¸r LL-ZW-Eingriffe" VALUE 0xFC80F3 KwUb 10200. nmot_ub_q40 0.00 10200. FORMAT "%5.0" /end CHARACTERISTIC
/begin CHARACTERISTIC NLLZWEU "Untere Drehzahl-Hytereseschwelle f¸r LL-ZW-Eingriffe" VALUE 0xFC80F4 KwUb 10200. nmot_ub_q40 0.00 10200. FORMAT "%5.0" /end CHARACTERISTIC
/begin CHARACTERISTIC NLRHO "obere Drehzahlgrenze f¸r Regelung hinter Kat" VALUE 0xFC6B0D KwUb 10200. nmot_ub_q40 0.00 10200. FORMAT "%5.0" /end CHARACTERISTIC
/begin CHARACTERISTIC NLRHU "untere Drehzahlgrenze f¸r Regelung hinter Kat" VALUE 0xFC6B0E KwUb 10200. nmot_ub_q40 0.00 10200. FORMAT "%5.0" /end CHARACTERISTIC
/begin CHARACTERISTIC NLRKA "Drehzahlschwelle f¸r Unterdr¸cken gesteuertes Kat-Ausr‰umen" VALUE 0xFC6B9D KwUb 10200. nmot_ub_q40 0.00 10200. FORMAT "%5.0" /end CHARACTERISTIC
/begin CHARACTERISTIC NLRSHB "Drehzahlschwelle, Abschalten LR bei Schub, in Verbindung mit LL und TLLRSHB" VALUE 0xFC6AD6 KwUb 10200. nmot_ub_q40 0.00 10200. FORMAT "%5.0" /end CHARACTERISTIC
/begin CHARACTERISTIC NLSDZWEO "Obere Drehzahl-Hytereseschwelle f¸r LSD-ZW-Eingriffe" VALUE 0xFC80F5 KwUb 10200. nmot_ub_q40 0.00 10200. FORMAT "%5.0" /end CHARACTERISTIC
/begin CHARACTERISTIC NLSDZWEU "Untere Drehzahl-Hytereseschwelle f¸r LSD-ZW-Eingriffe" VALUE 0xFC80F6 KwUb 10200. nmot_ub_q40 0.00 10200. FORMAT "%5.0" /end CHARACTERISTIC
/begin CHARACTERISTIC NMDSTAOF "Drehzahloffset auf Wiedereinsetzdrehzahl f¸r Momentenberechnung" VALUE 0xFC6E46 KwUb 10200. nmot_ub_q40 0.00 10200. FORMAT "%5.0" /end CHARACTERISTIC
/begin CHARACTERISTIC NO1 "obere Drehzahlschwelle Bereich 1" VALUE 0xFCDF20 KwUb 10200. nmot_ub_q40 0.00 10200. FORMAT "%5.0" /end CHARACTERISTIC
/begin CHARACTERISTIC NOLRA "Codewort f¸r Adaptionsfreigabe" VALUE 0xFCDF21 KwUb 255.0 dez 0.00 255.0 FORMAT "%5.1" /end CHARACTERISTIC
/begin CHARACTERISTIC NRKAB "Mindestdrehzahl f¸r Begrenzung Stelleingriff rkat bei niedrigen Drehzahlen" VALUE 0xFC545D KwUb 10200. nmot_ub_q40 0.00 10200. FORMAT "%5.0" /end CHARACTERISTIC
/begin CHARACTERISTIC NSTART "Motordrehzahlschwelle f¸r Unterdrehzahl-Ausstieg bei Nachstartaufweitung" VALUE 0xFC8268 KwUb 10200. nmot_ub_q40 0.00 10200. FORMAT "%5.0" /end CHARACTERISTIC
/begin CHARACTERISTIC NSTEND "Motordrehzahlschwelle f¸r Start Ende bei Nachstartaufweitung" VALUE 0xFC8269 KwUb 10200. nmot_ub_q40 0.00 10200. FORMAT "%5.0" /end CHARACTERISTIC
/begin CHARACTERISTIC NU3 "untere Drehzahlschwelle Bereich 3" VALUE 0xFCDF22 KwUb 10200. nmot_ub_q40 0.00 10200. FORMAT "%5.0" /end CHARACTERISTIC
/begin CHARACTERISTIC PLRHAV "Wichtungsfaktor des P-Anteils in der LRHK ¸ber KAT-Alterung" CURVE 0xFC6B10 KlAUbSstUbWUb 0.9961 fak_ub_b1 0.00 0.9961 /begin AXIS_DESCR STD_AXIS iavkatf fak_ub_b1 8 0.00 0.9961 DEPOSIT ABSOLUTE /end AXIS_DESCR /end CHARACTERISTIC
/begin CHARACTERISTIC PLRHML "P-Anteil LRHK, wirkt zusammen mit gewichteter Sondenspannungsdiff. hinter KAT" CURVE 0xFCF10C GklWSb 2.550 t100msxs_sb_q0p01 -1.280 1.270 FORMAT "%5.3"
 /begin AXIS_DESCR COM_AXIS ml m_ub_b1020 8 0.00 1020. FORMAT "%5.0" AXIS_PTS_REF SML08LHUB /end AXIS_DESCR
/end CHARACTERISTIC
/begin CHARACTERISTIC QUFRMN "minimaler fri-Quotient f¸r Station‰rbedingung Lambdaregler" VALUE 0xFC6AD0 KwUw 1.999969 fak_uw_b2 0.00 1.999969 FORMAT "%8.6" /end CHARACTERISTIC
/begin CHARACTERISTIC QUFRMX "maximaler fri-Quotient f¸r Station‰rbedingung Lambdaregler" VALUE 0xFC6AD2 KwUw 1.999969 fak_uw_b2 0.00 1.999969 FORMAT "%8.6" /end CHARACTERISTIC
/begin CHARACTERISTIC REDHYOC "Hysterese der Reduzierstufe bei grˆﬂerer Soll-Reduzierstufe als Ist-Wert" VALUE 0xFC81A3 KwSb 3.984 rel_sb_q0p02 -2.000 1.984 FORMAT "%5.3" /end CHARACTERISTIC
/begin CHARACTERISTIC REDHYUC "Hysterese der Reduzierstufe bei kleinerer Soll-Reduzierstufe als Ist-Wert" VALUE 0xFC81A4 KwSb 3.984 rel_sb_q0p02 -2.000 1.984 FORMAT "%5.3" /end CHARACTERISTIC
/begin CHARACTERISTIC REDMXSA "maximale Reduzierstufe bei sequentieller Schubabschaltung" VALUE 0xFC81A5 KwUb 255.0 dez 0.00 255.0 FORMAT "%5.1" /end CHARACTERISTIC
/begin CHARACTERISTIC REDZEM "Schwelle zwischen Z¸ndeingriff und Einspritzausblendung" CURVE 0xFCFABC KlAUbSstUbWUb 255.0 dez 0.00 255.0 FORMAT "%5.1"
 /begin AXIS_DESCR STD_AXIS tmot temp_ub_q0p75_o48 5 -48.00 143.3 FORMAT "%5.1" DEPOSIT ABSOLUTE /end AXIS_DESCR
/end CHARACTERISTIC
/begin CHARACTERISTIC RKATMN "untere Schwelle additive Korrektur pro Zeit" VALUE 0xFCDF2E KwSw 3071.953 rel_sw_b1536 -1536.000 1535.953 FORMAT "%8.3" /end CHARACTERISTIC
/begin CHARACTERISTIC RKATMX "obere Schwelle additive Korrektur pro Zeit" VALUE 0xFCDF30 KwSw 3071.953 rel_sw_b1536 -1536.000 1535.953 FORMAT "%8.3" /end CHARACTERISTIC
/begin CHARACTERISTIC RKATRN "reduzierte untere Schwelle additive Korrektur pro Zeit" VALUE 0xFCDF32 KwSw 3071.953 rel_sw_b1536 -1536.000 1535.953 FORMAT "%8.3" /end CHARACTERISTIC
/begin CHARACTERISTIC RKATRX "reduzierte obere Schwelle additive Korrektur pro Zeit" VALUE 0xFCDF34 KwSw 3071.953 rel_sw_b1536 -1536.000 1535.953 FORMAT "%8.3" /end CHARACTERISTIC
/begin CHARACTERISTIC RKAZMN "untere Schwelle additive Korrektur pro Z¸ndung" VALUE 0xFCDF36 KwSw 3071.953 rel_sw_b1536 -1536.000 1535.953 FORMAT "%8.3" /end CHARACTERISTIC
/begin CHARACTERISTIC RKAZMX "obere Schwelle additive Korrektur pro Z¸ndung" VALUE 0xFCDF38 KwSw 3071.953 rel_sw_b1536 -1536.000 1535.953 FORMAT "%8.3" /end CHARACTERISTIC
/begin CHARACTERISTIC RKAZRN "reduzierte untere Schwelle additive Korrektur pro Z¸ndung" VALUE 0xFCDF3A KwSw 3071.953 rel_sw_b1536 -1536.000 1535.953 FORMAT "%8.3" /end CHARACTERISTIC
/begin CHARACTERISTIC RKAZRX "reduzierte obere Schwelle additive Korrektur pro Z¸ndung" VALUE 0xFCDF3C KwSw 3071.953 rel_sw_b1536 -1536.000 1535.953 FORMAT "%8.3" /end CHARACTERISTIC
/begin CHARACTERISTIC RLLRHON "Kennlinie ¸ber nmot, obere rL Regelgrenze f¸r Regler hinter KAT" CURVE 0xFCF114 GklWUb 191.3 rel_ub_q0p75 0.00 191.3 FORMAT "%5.1"
 /begin AXIS_DESCR COM_AXIS nmot nmot_ub_q40 8 0.00 10200. FORMAT "%5.0" AXIS_PTS_REF SNM08LHUB /end AXIS_DESCR
/end CHARACTERISTIC
/begin CHARACTERISTIC RLLRHUN "Kennlinie ¸ber nmot, untere rL Regelgrenze f¸r Regler hinter KAT" CURVE 0xFCF11C GklWUb 191.3 rel_ub_q0p75 0.00 191.3 FORMAT "%5.1"
 /begin AXIS_DESCR COM_AXIS nmot nmot_ub_q40 8 0.00 10200. FORMAT "%5.0" AXIS_PTS_REF SNM08LHUB /end AXIS_DESCR
/end CHARACTERISTIC
/begin CHARACTERISTIC RLLRSHB "relative Lastschwelle, Abschalten LR bei SLS, in Verbindung mit LL und NLRSHB" VALUE 0xFC6AD7 KwUb 191.3 rel_ub_q0p75 0.00 191.3 FORMAT "%5.1" /end CHARACTERISTIC
/begin CHARACTERISTIC RLLRUN "Kennlinie ¸ber nmot, untere rL Regelgrenze f¸r Regler vor KAT" CURVE 0xFCF080 KlAUbSstUbWUb 191.3 rel_ub_q0p75 0.00 191.3 FORMAT "%5.1"
 /begin AXIS_DESCR STD_AXIS nmot nmot_ub_q40 8 0.00 10200. FORMAT "%5.0" DEPOSIT ABSOLUTE /end AXIS_DESCR
/end CHARACTERISTIC
/begin CHARACTERISTIC RLO2 "obere Lastschwelle Bereich 2" VALUE 0xFCDF23 KwUb 191.3 rel_ub_q0p75 0.00 191.3 FORMAT "%5.1" /end CHARACTERISTIC
/begin CHARACTERISTIC RLO3 "obere rl - Schwelle Bereich 3" VALUE 0xFCDF24 KwUb 191.3 rel_ub_q0p75 0.00 191.3 FORMAT "%5.1" /end CHARACTERISTIC
/begin CHARACTERISTIC RLRAN "Lastschwelle Lambdaregelung" CURVE 0xFCF094 KlAUbSstUbWUb 191.3 rel_ub_q0p75 0.00 191.3 FORMAT "%5.1"
 /begin AXIS_DESCR STD_AXIS nmot nmot_ub_q40 8 0.00 10200. FORMAT "%5.0" DEPOSIT ABSOLUTE /end AXIS_DESCR
/end CHARACTERISTIC
/begin CHARACTERISTIC RLRVAO "obere rL - Schwelle f¸r Auslˆsen Sperre LR bei VA" VALUE 0xFCF0A5 KwUb 191.3 rel_ub_q0p75 0.00 191.3 FORMAT "%5.1" /end CHARACTERISTIC
/begin CHARACTERISTIC RLU2 "untere rl - Schwelle Bereich 2" VALUE 0xFCDF25 KwUb 191.3 rel_ub_q0p75 0.00 191.3 FORMAT "%5.1" /end CHARACTERISTIC
/begin CHARACTERISTIC RLU3 "untere rl - Schwelle Bereich 3" VALUE 0xFCDF26 KwUb 191.3 rel_ub_q0p75 0.00 191.3 FORMAT "%5.1" /end CHARACTERISTIC
/begin CHARACTERISTIC RLU4 "untere rl -Schwelle oberer multiplikativer Bereich" VALUE 0xFCDF27 KwUb 191.3 rel_ub_q0p75 0.00 191.3 FORMAT "%5.1" /end CHARACTERISTIC
/begin CHARACTERISTIC RLVMXN "Maximaler Volumenstrom bei offener Drosselklappe" CURVE 0xFC8164 KlAUbSstUbWUb 191.3 rel_ub_q0p75 0.00 191.3 FORMAT "%5.1"
 /begin AXIS_DESCR STD_AXIS snmta nmot_ub_q40 11 0.00 10200. FORMAT "%5.0" DEPOSIT ABSOLUTE /end AXIS_DESCR
/end CHARACTERISTIC
/begin CHARACTERISTIC RLVSMXN "Maximaler Volumenstrom bei offener Drosselklappe und SU" CURVE 0xFC817C KlAUbSstUbWUb 191.3 rel_ub_q0p75 0.00 191.3 FORMAT "%5.1"
 /begin AXIS_DESCR STD_AXIS snmta nmot_ub_q40 11 0.00 10200. FORMAT "%5.0" DEPOSIT ABSOLUTE /end AXIS_DESCR
/end CHARACTERISTIC
/begin AXIS_PTS SGA08MDUB "St¸tzstellenverteilung Ist Gang 8 Sst." 0xFC0F6C gangi SstAUbSstUb 255.0 dez 8 0.00 255.0 FORMAT "%5.1" DEPOSIT ABSOLUTE /end AXIS_PTS
/begin AXIS_PTS SMK06MDUW "" 0xFC80B8 mkfanb_w SstASwSstSw 199.9969 rel_sw_b100 6 -100.0000 99.99695 FORMAT "%8.4" DEPOSIT ABSOLUTE /end AXIS_PTS
/begin AXIS_PTS SML05LKUB "5 St¸tzstellen f¸r ?" 0xFC0F88 ml SstAUbSstUb 1020. m_ub_b1020 5 0.00 1020. FORMAT "%5.0" DEPOSIT ABSOLUTE /end AXIS_PTS
/begin AXIS_PTS SML08LHUB "ml abh‰ngige St¸tzstellen (Anzahl 8)" 0xFCC830 ml SstAUbSstUb 1020. m_ub_b1020 8 0.00 1020. FORMAT "%5.0" DEPOSIT ABSOLUTE /end AXIS_PTS
/begin AXIS_PTS SMO08OPUB "St¸tzstellenverteilung f¸r zul‰ssiges Moment mizuvfil" 0xFC826C mizuvfil SstAUbSstUb 99.61 rel_ub_b99p6 8 0.00 99.61 FORMAT "%5.2" DEPOSIT ABSOLUTE /end AXIS_PTS
/begin AXIS_PTS SNM06LHUB "6 St¸tzstellen Drehzahl f¸r ?" 0xFCC848 nmot SstAUbSstUb 10200. nmot_ub_q40 6 0.00 10200. FORMAT "%5.0" DEPOSIT ABSOLUTE /end AXIS_PTS
/begin AXIS_PTS SNM06MDUW "Rover" 0xFCC954 nmot_w SstAUwSstUw 16383.75 nmot_uw_q0p25 6 0.00 16383.75 FORMAT "%8.2" DEPOSIT ABSOLUTE /end AXIS_PTS
/begin AXIS_PTS SNM07LRUB "7 Drehzahlst¸tzstellen f¸r ?" 0xFC0FB0 nmot SstAUbSstUb 10200. nmot_ub_q40 7 0.00 10200. FORMAT "%5.0" DEPOSIT ABSOLUTE /end AXIS_PTS
/begin AXIS_PTS SNM08LHUB "nmot abh‰ngige St¸tzstellen (Anzahl 8)" 0xFCC858 nmot SstAUbSstUb 10200. nmot_ub_q40 8 0.00 10200. FORMAT "%5.0" DEPOSIT ABSOLUTE /end AXIS_PTS
/begin AXIS_PTS SNM08OPUB "St¸tzstellenverteilung f¸r Motordrehzahl nmot" 0xFC0FD0 nmot SstAUbSstUb 10200. nmot_ub_q40 8 0.00 10200. FORMAT "%5.0" DEPOSIT ABSOLUTE /end AXIS_PTS
/begin AXIS_PTS SNM12FEUB "St¸tzstellen f¸r WDKSMX, WDKUGDN" 0xFC1004 nmot SstAUbSstUb 10200. nmot_ub_q40 12 0.00 10200. FORMAT "%5.0" DEPOSIT ABSOLUTE /end AXIS_PTS
/begin AXIS_PTS SNM16OPUW "St¸tzstellenverteilung Drehzahl" 0xFC113C nmot_w SstAUwSstUw 16383.75 nmot_uw_q0p25 16 0.00 16383.75 FORMAT "%8.2" DEPOSIT ABSOLUTE /end AXIS_PTS
/begin AXIS_PTS SRL06LHUB "6 F¸llungsst¸tzstellen f¸r ?" 0xFC1088 rl SstAUbSstUb 191.3 rel_ub_q0p75 6 0.00 191.3 FORMAT "%5.1" DEPOSIT ABSOLUTE /end AXIS_PTS
/begin AXIS_PTS SRL06LRUB "6 F¸llungsst¸tzstellen f¸r ?" 0xFC1090 rl SstAUbSstUb 191.3 rel_ub_q0p75 6 0.00 191.3 FORMAT "%5.1" DEPOSIT ABSOLUTE /end AXIS_PTS
/begin AXIS_PTS SRL16OPUW "St¸tzstellenverteilung relative Luftf¸llung" 0xFC7C16 rl_w_kge SstAUwSstUw 1535.977 rel_uw_q0p0234 16 0.00 1535.977 FORMAT "%8.3" DEPOSIT ABSOLUTE /end AXIS_PTS
/begin AXIS_PTS STM04FEUB "St¸tzstellenverteilung Motortemperatur" 0xFC10F8 tmot SstAUbSstUb 191.3 temp_ub_q0p75_o48 4 -48.00 143.3 FORMAT "%5.1" DEPOSIT ABSOLUTE /end AXIS_PTS
/begin AXIS_PTS STM08LEUB "8 Motortemperaturst¸tzstellen f¸r ?" 0xFCC8E8 tmot SstAUbSstUb 191.3 temp_ub_q0p75_o48 8 -48.00 143.3 FORMAT "%5.1" DEPOSIT ABSOLUTE /end AXIS_PTS
/begin AXIS_PTS STM08MDUB "St¸tzstellenverteilung: tmot f¸r Drehmomentwandler" 0xFCC8F4 tmot SstAUbSstUb 191.3 temp_ub_q0p75_o48 8 -48.00 143.3 FORMAT "%5.1" DEPOSIT ABSOLUTE /end AXIS_PTS
/begin CHARACTERISTIC STNMTA "St¸tzstellen-Korrektur von nmot" CURVE 0xFC8193 KlAUbSstUbWSb 10200. nmot_sb_q40 -5120. 5080. FORMAT "%5.0"
 /begin AXIS_DESCR STD_AXIS tans temp_ub_q0p75_o48 6 -48.00 143.3 FORMAT "%5.1" DEPOSIT ABSOLUTE /end AXIS_DESCR
/end CHARACTERISTIC
/begin AXIS_PTS SWP08OPUB "St¸tzstellenverteilung f¸r Pedalstellung wped" 0xFC1118 wped SstAUbSstUb 100.0 relPED_ub_b100 8 0.00 100.0 FORMAT "%5.1" DEPOSIT ABSOLUTE /end AXIS_PTS
/begin CHARACTERISTIC S_dmfbdpf "Umschaltung Solldifferenzdruck Saugrohr gefiltert/ungefiltert f¸r Berechnung Fak" VALUE 0xFC7CBD KwUb 255.0 dez 0.00 255.0 FORMAT "%5.1" /end CHARACTERISTIC
/begin CHARACTERISTIC S_mdversta "Umschalter f¸r Einrechnung Verbrauchermomente in mimin_w" VALUE 0xFC6E6A KwUb 255.0 dez 0.00 255.0 FORMAT "%5.1" /end CHARACTERISTIC
/begin CHARACTERISTIC TALUNL "Tastverh‰ltnis f¸r EC-L¸fternachlaufsteuerung bei 10 Hz" VALUE 0xFD0579 KwUb 100.0 rel_ub_b100 0.00 100.0 FORMAT "%5.1" /end CHARACTERISTIC
/begin CHARACTERISTIC TAMHYS "Tastverh‰ltnis E-L¸fter Hysterese" VALUE 0xFD057A KwUb 100.0 rel_ub_b100 0.00 100.0 FORMAT "%5.1" /end CHARACTERISTIC
/begin CHARACTERISTIC TAMLAC "Anforderung E-L¸fter-Tastverh‰ltnis von Klimaanlage" CURVE 0xFD057C KlAUbSstUbWUb 100.0 rel_ub_b100 0.00 100.0 FORMAT "%5.1"
 /begin AXIS_DESCR STD_AXIS stmlac dez 10 0.00 255.0 FORMAT "%5.1" DEPOSIT ABSOLUTE /end AXIS_DESCR
/end CHARACTERISTIC
/begin CHARACTERISTIC TAMLSMN "Minimales Tastverh‰ltnis Ansteuerung Motorl¸fter" VALUE 0xFD0591 KwUb 100.0 rel_ub_b100 0.00 100.0 FORMAT "%5.1" /end CHARACTERISTIC
/begin CHARACTERISTIC TAMLSMX "Maximales Tastverh‰ltnis Ansteuerung Motorl¸fter" VALUE 0xFD0592 KwUb 100.0 rel_ub_b100 0.00 100.0 FORMAT "%5.1" /end CHARACTERISTIC
/begin CHARACTERISTIC TAMLSNH "Anforderung E-L¸fter-Tastverh‰ltnis nach Hysterese" CURVE 0xFD0594 KlAUbSstUbWUb 100.0 rel_ub_b100 0.00 100.0 FORMAT "%5.1"
 /begin AXIS_DESCR STD_AXIS tamlausab rel_ub_b100 8 0.00 100.0 FORMAT "%5.1" DEPOSIT ABSOLUTE /end AXIS_DESCR
/end CHARACTERISTIC
/begin CHARACTERISTIC TAMLTKA "Anforderung E-L¸fter-Tastverh‰ltnis aus K¸hlerausgangstemperatur" CURVE 0xFD05A8 KlAUbSstUbWUb 100.0 rel_ub_b100 0.00 100.0 FORMAT "%5.1"
 /begin AXIS_DESCR STD_AXIS tka temp_ub_q0p75_o48 10 -48.00 143.3 FORMAT "%5.1" DEPOSIT ABSOLUTE /end AXIS_DESCR
/end CHARACTERISTIC
/begin CHARACTERISTIC TAMLU "Unempfindlichkeitsschwelle E-L¸fter-Tastverh‰ltnis" VALUE 0xFD05BD KwUb 100.0 rel_ub_b100 0.00 100.0 FORMAT "%5.1" /end CHARACTERISTIC
/begin CHARACTERISTIC TANSMN "Ansauglufttemperaturschwelle zur Nachstartaufweitung" VALUE 0xFC8275 KwUb 191.3 temp_ub_q0p75_o48 -48.00 143.3 FORMAT "%5.1" /end CHARACTERISTIC
/begin CHARACTERISTIC TARA "Temperaturschwelle Ansaugluft" VALUE 0xFC548C KwUb 191.3 temp_ub_q0p75_o48 -48.00 143.3 FORMAT "%5.1" /end CHARACTERISTIC
/begin CHARACTERISTIC TARAU "Ansauglufttemperaturschwelle f¸r Einschalten der Lambda - Regelung" VALUE 0xFCF0A6 KwUb 191.3 temp_ub_q0p75_o48 -48.00 143.3 FORMAT "%5.1" /end CHARACTERISTIC
/begin CHARACTERISTIC TASHS "Schwelle Ansauglufttemp. f¸r Auslˆsung TLRHS - Sperrzeit LR bei Heiﬂstart" VALUE 0xFCF0A7 KwUb 191.3 temp_ub_q0p75_o48 -48.00 143.3 FORMAT "%5.1" /end CHARACTERISTIC
/begin CHARACTERISTIC TBLRH "Sperrzeit f¸r Regelung hinter Kat nach Freigabe durch Regelung vor Kat" VALUE 0xFC6B21 KwUb 25.40 t100msxs_ub_b25p5 0.1000 25.50 FORMAT "%5.2" /end CHARACTERISTIC
/begin CHARACTERISTIC TBLRH2 "Sperrzeit f¸r Regelung hinter Kat nach Freigabe durch Regelung vor Kat Bank 2" VALUE 0xFC6B22 KwUb 25.40 t100msxs_ub_b25p5 0.1000 25.50 FORMAT "%5.2" /end CHARACTERISTIC
/begin CHARACTERISTIC TDFRKAD "Absteuerzeit f¸r gesteuertes Katalysator-Ausr‰umen" VALUE 0xFC6BA4 KwUw 1309.9800107 zk20msxs_uw_b1310 0.019989318685 1310.0000000 FORMAT "%12.7" /end CHARACTERISTIC
/begin CHARACTERISTIC TDFRKAU "Aufsteuerzeit f¸r gesteuertes Katalysator-Ausr‰umen" VALUE 0xFC6BA6 KwUw 1309.9800107 zk20msxs_uw_b1310 0.019989318685 1310.0000000 FORMAT "%12.7" /end CHARACTERISTIC
/begin CHARACTERISTIC TDMFBSA "Zeitkonstante PT1-Filter beim Schubabschalten" VALUE 0xFC80C6 KwUw 655.34999985 zk10msxs_uw_b655 0.010000152590 655.36000000 FORMAT "%12.8" /end CHARACTERISTIC
/begin CHARACTERISTIC TDMFBWE "Zeitkonstante PT1-Filter beim weichen Wiedereinsetzen" VALUE 0xFC80C8 KwUw 655.34999985 zk10msxs_uw_b655 0.010000152590 655.36000000 FORMAT "%12.8" /end CHARACTERISTIC
/begin CHARACTERISTIC TFMIZU "Filterzeitkonstante zur Filterung des zul‰ssigen Moments" VALUE 0xFC8278 KwUw 655.34999985 zk10msxs_uw_b655 0.010000152590 655.36000000 FORMAT "%12.8" /end CHARACTERISTIC
/begin CHARACTERISTIC TKATMLRH "Einschaltschwelle Kat-Modelltemperatur  f¸r Lambdaregelung hinter Kat" VALUE 0xFC6B23 KwUb 1275. temp_ub_q5_o50 -50.00 1225. FORMAT "%5.0" /end CHARACTERISTIC
/begin CHARACTERISTIC TKATMLRH2 "Einschaltschwelle Kat-Modelltemperatur  f¸r Lambdaregelung hinter Kat, Bank 2" VALUE 0xFC6B24 KwUb 1275. temp_ub_q5_o50 -50.00 1225. FORMAT "%5.0" /end CHARACTERISTIC
/begin CHARACTERISTIC TLRBAM "Sperrzeit f¸r Einschalten LR nach BA" CURVE 0xFCF0A8 GklWUb 25.50 t100msxs_ub_b25p5 0.00 25.50 FORMAT "%5.2"
 /begin AXIS_DESCR COM_AXIS tmot temp_ub_q0p75_o48 8 -48.00 143.3 FORMAT "%5.1" AXIS_PTS_REF STM08LEUB /end AXIS_DESCR
/end CHARACTERISTIC
/begin CHARACTERISTIC TLRHS "Sperrzeit LR bei Heiﬂstart, ausgelˆst ¸ber Schwellen TASHS und TMSHS" VALUE 0xFCF0B0 KwUb 25.50 t100msxs_ub_b25p5 0.00 25.50 FORMAT "%5.2" /end CHARACTERISTIC
/begin CHARACTERISTIC TLRTMS "Sperrzeit LR nach Start, abh‰ngig von der Motortemperatur bei Start" CURVE 0xFC6ADC KlAUbSstUbWUw 6553.500 t100msxs_uw_b6553p5 0.00 6553.500 FORMAT "%8.3"
 /begin AXIS_DESCR STD_AXIS tmst temp_ub_q0p75_o48 5 -48.00 143.3 FORMAT "%5.1" DEPOSIT ABSOLUTE /end AXIS_DESCR
/end CHARACTERISTIC
/begin CHARACTERISTIC TLRVAM "Sperrzeit f¸r Einschalten LR nach VA" CURVE 0xFCF0B4 GklWUb 25.50 t100msxs_ub_b25p5 0.00 25.50 FORMAT "%5.2"
 /begin AXIS_DESCR COM_AXIS tmot temp_ub_q0p75_o48 8 -48.00 143.3 FORMAT "%5.1" AXIS_PTS_REF STM08LEUB /end AXIS_DESCR
/end CHARACTERISTIC
/begin CHARACTERISTIC TLRZWTMS "Zeit f¸r Zwangseinschaltung LR (CARB-Forderung) nach Start" CURVE 0xFC6AEC KlAUbSstUbWUw 6553.500 t100msxs_uw_b6553p5 0.00 6553.500 FORMAT "%8.3"
 /begin AXIS_DESCR STD_AXIS tmst temp_ub_q0p75_o48 4 -48.00 143.3 FORMAT "%5.1" DEPOSIT ABSOLUTE /end AXIS_DESCR
/end CHARACTERISTIC
/begin CHARACTERISTIC TMDMAD "Motortemperaturschwelle f¸r Freigabe der Adaption des Verlustmoments" VALUE 0xFCF34A KwUb 191.3 temp_ub_q0p75_o48 -48.00 143.3 FORMAT "%5.1" /end CHARACTERISTIC
/begin CHARACTERISTIC TMMLN "Temperaturschwelle f¸r Motorl¸fter im Nachlauf" VALUE 0xFD05BE KwUb 255.0 temp_ub_q0p75_o48 0.00 255.0 FORMAT "%5.1" /end CHARACTERISTIC
/begin CHARACTERISTIC TMNSMN "Motortemperaturschwelle f¸r die Nachstartaufweitung" VALUE 0xFC8276 KwUb 191.3 temp_ub_q0p75_o48 -48.00 143.3 FORMAT "%5.1" /end CHARACTERISTIC
/begin CHARACTERISTIC TMRA1 "Ausschaltbedingung (S_LL = 0)" VALUE 0xFCF0BC KwUb 191.3 temp_ub_q0p75_o48 -48.00 143.3 FORMAT "%5.1" /end CHARACTERISTIC
/begin CHARACTERISTIC TMRA2 "Ausschaltbedingung (S_LL = 1)" VALUE 0xFCF0BD KwUb 191.3 temp_ub_q0p75_o48 -48.00 143.3 FORMAT "%5.1" /end CHARACTERISTIC
/begin CHARACTERISTIC TMRAA "Einschalttemperatur LRA" VALUE 0xFC548D KwUb 191.3 temp_ub_q0p75_o48 -48.00 143.3 FORMAT "%5.1" /end CHARACTERISTIC
/begin CHARACTERISTIC TMRAK "Ausschaltschwelle der Lambda - Regelung bei niedriger Starttemperatur" VALUE 0xFCF0BE KwUb 191.3 temp_ub_q0p75_o48 -48.00 143.3 FORMAT "%5.1" /end CHARACTERISTIC
/begin CHARACTERISTIC TMSHS "Schwelle Motortemp. f¸r Auslˆsung TLRHS - Sperrzeit LR bei Heiﬂstart" VALUE 0xFCF0BF KwUb 191.3 temp_ub_q0p75_o48 -48.00 143.3 FORMAT "%5.1" /end CHARACTERISTIC
/begin CHARACTERISTIC TMSPR "" VALUE 0xFC754A KwWU8 191.3 temp_ub_q0p75_o48 -48.00 143.3 FORMAT "%5.1" /end CHARACTERISTIC
/begin CHARACTERISTIC TMVER "Entprellzeit zur Erkennung einer dauerhaften Momentenbegrenzung" VALUE 0xFCFAB6 KwUw 65535.00 t1sxs_uw_b65535 0.00 65535.00 FORMAT "%8.2" /end CHARACTERISTIC
/begin CHARACTERISTIC TNLSGMN "Minimale Zeit f¸r SG-Nachlauf" VALUE 0xFCFAF8 KwUw 6553.300 t100msxs_uw_b6553p6 0.2000000 6553.500 FORMAT "%8.3" /end CHARACTERISTIC
/begin CHARACTERISTIC TNLSGMX "Maximale Zeit f¸r SG-Nachlauf" VALUE 0xFCFAFA KwUw 6553.500 t100msxs_uw_b6553p6 0.00 6553.500 FORMAT "%8.3" /end CHARACTERISTIC
/begin CHARACTERISTIC TNSC "Nachstart¸berwachungszeit" VALUE 0xFC827A KwUw 1310.700 t20msxs_uw_q0p02 0.00 1310.700 FORMAT "%8.3" /end CHARACTERISTIC
/begin CHARACTERISTIC TNSOF "Entprellzeit zur Abschaltung der Nachstartaufweitung" VALUE 0xFC8277 KwUb 5.100 t20msxs_ub_b5p1 0.00 5.100 FORMAT "%5.3" /end CHARACTERISTIC
/begin CHARACTERISTIC TPNSMD "Pr¸fzeit nach Startende f¸r Diagnose Momentenbegrenzung" VALUE 0xFCFAB8 KwUw 65535.00 t1sxs_uw_b65535 0.00 65535.00 FORMAT "%8.2" /end CHARACTERISTIC
/begin CHARACTERISTIC TRAB "‹berwachungszeit f¸r Lastschwelle Lambdaregelung" VALUE 0xFC6AD8 KwUb 25.50 t100msxs_ub_b25p5 0.00 25.50 FORMAT "%5.2" /end CHARACTERISTIC
/begin CHARACTERISTIC TRAU "‹berwachungszeit f¸r untere Lastschwelle der Lambdaregelung" VALUE 0xFCF0C0 KwUb 25.50 t100msxs_ub_b25p5 0.00 25.50 FORMAT "%5.2" /end CHARACTERISTIC
/begin CHARACTERISTIC TSAKAMN "Mindestdauer SA f¸r Funktion Katalysator-Ausr‰umen" VALUE 0xFC6B9E KwUb 5.100 t20msxs_ub_b5p1 0.00 5.100 FORMAT "%5.3" /end CHARACTERISTIC
/begin CHARACTERISTIC TSBBVTMS "Verzˆgerung Einschalten LR nach Sondenbetriebsbereitschaft" CURVE 0xFC6AFA KlAUbSstUbWUw 6553.500 t100msxs_uw_b6553p5 0.00 6553.500 FORMAT "%8.3"
 /begin AXIS_DESCR STD_AXIS tmst temp_ub_q0p75_o48 4 -48.00 143.3 FORMAT "%5.1" DEPOSIT ABSOLUTE /end AXIS_DESCR
/end CHARACTERISTIC
/begin CHARACTERISTIC TSPERN "Sperrzeit P-Sprung nach Sondensprung" CURVE 0xFC6A9C KlAUbSstUbWUb 2.550 t10msxs_ub_b2p55 0.00 2.550 FORMAT "%5.3"
 /begin AXIS_DESCR STD_AXIS nmot nmot_ub_q40 7 0.00 10200. FORMAT "%5.0" DEPOSIT ABSOLUTE /end AXIS_DESCR
/end CHARACTERISTIC
/begin CHARACTERISTIC TSPERN2 "Sperrzeit P-Sprung nach Sondensprung, Bank 2" CURVE 0xFC6AAC KlAUbSstUbWUb 2.550 t10msxs_ub_b2p55 0.00 2.550 FORMAT "%5.3"
 /begin AXIS_DESCR STD_AXIS nmot nmot_ub_q40 7 0.00 10200. FORMAT "%5.0" DEPOSIT ABSOLUTE /end AXIS_DESCR
/end CHARACTERISTIC
/begin CHARACTERISTIC TVDPSTEND "Verzˆgerungszeit B_stend f¸r Berechnung Erlaubnis Dashpot" VALUE 0xFC80CA KwUw 655.3500 t10msxs_uw_b655p35 0.00 655.3500 FORMAT "%8.4" /end CHARACTERISTIC
/begin CHARACTERISTIC TVFSAM "Temperaturabh‰ngige Verzˆgerungszeit f¸r Fahrstufe AUS" CURVE 0xFCF40C GklWUb 5.100 t20msxs_ub_b5p1 0.00 5.100 FORMAT "%5.3"
 /begin AXIS_DESCR COM_AXIS tmot temp_ub_q0p75_o48 8 -48.00 143.3 FORMAT "%5.1" AXIS_PTS_REF STM08MDUB /end AXIS_DESCR
/end CHARACTERISTIC
/begin CHARACTERISTIC TVFSAWE "Verzˆgerungszeit f¸r R¸cksetzen von B_fil" VALUE 0xFC7CBE KwUb 2.540 t10msxs_ub_b2p55 0.01000 2.550 FORMAT "%5.3" /end CHARACTERISTIC
/begin CHARACTERISTIC TVFSEM "Temperaturabh‰ngige Verzˆgerungszeit f¸r Fahrstufe EIN" CURVE 0xFCF414 GklWUb 5.100 t20msxs_ub_b5p1 0.00 5.100 FORMAT "%5.3"
 /begin AXIS_DESCR COM_AXIS tmot temp_ub_q0p75_o48 8 -48.00 143.3 FORMAT "%5.1" AXIS_PTS_REF STM08MDUB /end AXIS_DESCR
/end CHARACTERISTIC
/begin CHARACTERISTIC TVFSRAM "motortemperaturabh‰ngige Verzˆgerungszeit f¸r Fahrstufe aus (R)" CURVE 0xFCF41C GklWUb 5.100 t20msxs_ub_b5p1 0.00 5.100 FORMAT "%5.3"
 /begin AXIS_DESCR COM_AXIS tmot temp_ub_q0p75_o48 8 -48.00 143.3 FORMAT "%5.1" AXIS_PTS_REF STM08MDUB /end AXIS_DESCR
/end CHARACTERISTIC
/begin CHARACTERISTIC TVFSREM "motortemperaturabh‰ngige Verzˆgerungszeit f¸r Fahrstufe ein (R)" CURVE 0xFCF424 GklWUb 5.100 t20msxs_ub_b5p1 0.00 5.100 FORMAT "%5.3"
 /begin AXIS_DESCR COM_AXIS tmot temp_ub_q0p75_o48 8 -48.00 143.3 FORMAT "%5.1" AXIS_PTS_REF STM08MDUB /end AXIS_DESCR
/end CHARACTERISTIC
/begin CHARACTERISTIC TVFUE "Verzˆgerungszeit f¸r den Aufbau der F¸llung" VALUE 0xFC70D9 KwUb 5.100 t20msxs_ub_b5p1 0.00 5.100 FORMAT "%5.3" /end CHARACTERISTIC
/begin CHARACTERISTIC TVLRA "Verzˆgerungszeit f¸r Aktivierung Gemischadaption nach Lambdaregelung aktiv" VALUE 0xFC548E KwUb 25.40 t100msxs_ub_b25p5 0.1000 25.50 FORMAT "%5.2" /end CHARACTERISTIC
/begin CHARACTERISTIC TWDMAD "Wartezeit bis Freigabe der Adaption des Verlustmoments" VALUE 0xFCF34B KwUb 51.00 t200msxs_ub_b51 0.00 51.00 FORMAT "%5.2" /end CHARACTERISTIC
/begin CHARACTERISTIC TWPFGR "Zeitkonstante PT1-Filter f¸r R¸ckgerechneter Pedalwert bei FGR-Betrieb" VALUE 0xFC80CC KwUw 3276.7499992 zk50msxs_uw_b3276p8 0.050000762951 3276.8000000 FORMAT "%12.7" /end CHARACTERISTIC
/begin CHARACTERISTIC UEVERG "‹bersetzungsverh‰ltnis abh. vom eingelegten Gang" CURVE 0xFC70DC FklWUb 15.94 fak_ub_b16 0.00 15.94 FORMAT "%5.2"
 /begin AXIS_DESCR FIX_AXIS gangi dez 8 0.00 7.000 FORMAT "%5.3" FIX_AXIS_PAR 0 0 8 /end AXIS_DESCR
/end CHARACTERISTIC
/begin CHARACTERISTIC USHKAMN "Sondenspannung hinter Kat f¸r Erkennung Kat ist mit O2 gef¸llt" VALUE 0xFC6B9F KwUb 1.330 spg_ub_q0p0052_o0p2 -0.2000 1.130 FORMAT "%5.3" /end CHARACTERISTIC
/begin CHARACTERISTIC USHKAMX "Sondenspannung hinter Kat f¸r Abbruch Kat-Ausr‰umen" VALUE 0xFC6BA0 KwUb 1.330 spg_ub_q0p0052_o0p2 -0.2000 1.130 FORMAT "%5.3" /end CHARACTERISTIC
/begin CHARACTERISTIC USR "Regelschwelle f¸r Regelung vor Kat" VALUE 0xFC6ABB KwUb 1.330 spg_ub_q0p0052_o0p2 -0.2000 1.130 FORMAT "%5.3" /end CHARACTERISTIC
/begin CHARACTERISTIC USVKAMX "Sondenspannung vor Kat f¸r Erkennung Magerbedingung Kat-Ausr‰umen" VALUE 0xFC6BA1 KwUb 1.330 spg_ub_q0p0052_o0p2 -0.2000 1.130 FORMAT "%5.3" /end CHARACTERISTIC
/begin CHARACTERISTIC VKUPZWEO "Obere vfzg-Hytereseschwelle f¸r KUP-ZW-Eingriffe" VALUE 0xFC80F7 KwUb 318.8 vfzg_ub_q1p25 0.00 318.8 FORMAT "%5.1" /end CHARACTERISTIC
/begin CHARACTERISTIC VKUPZWEU "Untere vfzg-Hytereseschwelle f¸r KUP-ZW-Eingriffe" VALUE 0xFC80F8 KwUb 318.8 vfzg_ub_q1p25 0.00 318.8 FORMAT "%5.1" /end CHARACTERISTIC
/begin CHARACTERISTIC VLLZWEO "Obere vfzg-Hytereseschwelle f¸r LL-ZW-Eingriffe" VALUE 0xFC80F9 KwUb 318.8 vfzg_ub_q1p25 0.00 318.8 FORMAT "%5.1" /end CHARACTERISTIC
/begin CHARACTERISTIC VLLZWEU "Untere vfzg-Hytereseschwelle f¸r LL-ZW-Eingriffe" VALUE 0xFC80FA KwUb 318.8 vfzg_ub_q1p25 0.00 318.8 FORMAT "%5.1" /end CHARACTERISTIC
/begin CHARACTERISTIC VLSDZWEO "Obere vfzg-Hytereseschwelle f¸r LSD-ZW-Eingriffe" VALUE 0xFC80FB KwUb 318.8 vfzg_ub_q1p25 0.00 318.8 FORMAT "%5.1" /end CHARACTERISTIC
/begin CHARACTERISTIC VLSDZWEU "Untere vfzg-Hytereseschwelle f¸r LSD-ZW-Eingriffe" VALUE 0xFC80FC KwUb 318.8 vfzg_ub_q1p25 0.00 318.8 FORMAT "%5.1" /end CHARACTERISTIC
/begin CHARACTERISTIC WDKARN "DK-Winkel-Schwelle f¸r Gemischadaption aktiv" CURVE 0xFCDF40 KlAUbSstUbWUb 99.61 rel_ub_b99p6 0.00 99.61 FORMAT "%5.2"
 /begin AXIS_DESCR STD_AXIS nmot nmot_ub_q40 10 0.00 10200. FORMAT "%5.0" DEPOSIT ABSOLUTE /end AXIS_DESCR
/end CHARACTERISTIC
/begin CHARACTERISTIC ZDFR "Abregelfaktor Tiefpaﬂ f¸r Adaption Regelhub von fr" VALUE 0xFC6AD4 KwUw 0.9999847 fak_uw_b1 0.00 0.9999847 FORMAT "%9.7" /end CHARACTERISTIC
/begin CHARACTERISTIC ZDZWKOEFT "" VALUE 0xFC7C38 KwUw 2047.938 zk10msxs_ub_b8 0.03125000 2047.969 FORMAT "%8.3" /end CHARACTERISTIC
/begin CHARACTERISTIC ZETABASN "Tiefpaﬂfilterzeitkonstante f¸r etabas_w" CURVE 0xFC47B8 GklWUb 2.54000 zk10msxs_ub_b2p55 0.0100000 2.55000 FORMAT "%7.5"
 /begin AXIS_DESCR COM_AXIS nmot nmot_ub_q40 12 0.00 10200. FORMAT "%5.0" AXIS_PTS_REF SNM12FEUB /end AXIS_DESCR
/end CHARACTERISTIC
/begin CHARACTERISTIC ZFMDVERL "Zeitkonstante f¸r Filterung Verlustmoment" VALUE 0xFC6E6B KwUb 2.53000 zk20msxs_ub_b5p1 0.0200000 2.55000 FORMAT "%7.5" /end CHARACTERISTIC
/begin CHARACTERISTIC ZKDMADFK "Zeitkonstante f¸r Adaption des Verlustmoments Fahrstufe und Kompressor ein" VALUE 0xFCF354 KwUw 815.98754883 zk200msxs_uw_b13107 3.1999511719 819.18750000 FORMAT "%12.8" /end CHARACTERISTIC
/begin CHARACTERISTIC ZKDMADFS "Zeitkonstante f¸r Adaption des Verlustmoments Fahrstufe ein" VALUE 0xFCF356 KwUw 815.98754883 zk200msxs_uw_b13107 3.1999511719 819.18750000 FORMAT "%12.8" /end CHARACTERISTIC
/begin CHARACTERISTIC ZKDMADKO "Zeitkonstante f¸r Adaption des Verlustmoments Klimakompressor ein" VALUE 0xFCF358 KwUw 815.98754883 zk200msxs_uw_b13107 3.1999511719 819.18750000 FORMAT "%12.8" /end CHARACTERISTIC
/begin CHARACTERISTIC ZKDMADLL "Zeitkonstante f¸r Adaption des Verlustmoments ohne Last" VALUE 0xFCF35A KwUw 815.98754883 zk200msxs_uw_b13107 3.1999511719 819.18750000 FORMAT "%12.8" /end CHARACTERISTIC
/begin CHARACTERISTIC ZKDMDW "Zeitkonstante f¸r Abregelung D-Anteil Wandlermoment" VALUE 0xFC70E4 KwUb 5.08000 zk20msxs_ub_b5p1 0.0200000 5.10000 FORMAT "%7.5" /end CHARACTERISTIC
/begin CHARACTERISTIC ZKFRAOA "Zeitkonstante f¸r frao-Integrator, f(Anzahl Starts mit ÷lverd¸nnung)" CURVE 0xFC5462 KlAUwSstUwWUw 4.999924 zk200msxs_uw_b5 0.00 4.999924 FORMAT "%8.6"
 /begin AXIS_DESCR STD_AXIS abo dez 3 0.00 255.0 FORMAT "%5.1" DEPOSIT ABSOLUTE /end AXIS_DESCR
/end CHARACTERISTIC
/begin CHARACTERISTIC ZKFRAUA "Zeitkonstante f¸r frau-Integrator, f(Anzahl Stats mit ÷lverd¸nnung)" CURVE 0xFC5470 KlAUwSstUwWUw 4.999924 zk200msxs_uw_b5 0.00 4.999924 FORMAT "%8.6"
 /begin AXIS_DESCR STD_AXIS abo dez 3 0.00 255.0 FORMAT "%5.1" DEPOSIT ABSOLUTE /end AXIS_DESCR
/end CHARACTERISTIC
/begin CHARACTERISTIC ZKFZNWLL "Zeitkonstante Ausblendung der zwopt LL-Umschaltung" VALUE 0xFC77F5 KwUb 7.969 zk10msxs_ub_b8 0.00 7.969 FORMAT "%5.3" /end CHARACTERISTIC
/begin CHARACTERISTIC ZKMDGEN "Zeitkonstante Generator-Lastabregelung" VALUE 0xFC7081 KwUb 5.08000 zk20msxs_ub_b5p1 0.0200000 5.10000 FORMAT "%7.5" /end CHARACTERISTIC
/begin CHARACTERISTIC ZKMDKO "Zeitkonstante Klimakompressor-Lastabregelung" VALUE 0xFC7082 KwUb 5.08000 zk20msxs_ub_b5p1 0.0200000 5.10000 FORMAT "%7.5" /end CHARACTERISTIC
/begin CHARACTERISTIC ZKMDWAB "Zeitkonstante f¸r Abregelung der  Drehmomentaufnahme des Wandlers" VALUE 0xFC70E5 KwUb 5.08000 zk20msxs_ub_b5p1 0.0200000 5.10000 FORMAT "%7.5" /end CHARACTERISTIC
/begin CHARACTERISTIC ZKMDWAUF "Zeitkonstante f¸r Aufregelung der  Drehmomentaufnahme des Wandlers" VALUE 0xFC70E6 KwUb 5.08000 zk20msxs_ub_b5p1 0.0200000 5.10000 FORMAT "%7.5" /end CHARACTERISTIC
/begin CHARACTERISTIC ZKMDWF "Zeitkonstante f¸r Filterung Wandlermoment zur Bildung D-Anteil" VALUE 0xFC70E7 KwUb 5.08000 zk20msxs_ub_b5p1 0.0200000 5.10000 FORMAT "%7.5" /end CHARACTERISTIC
/begin CHARACTERISTIC ZKRKATA "Integrationsgeschwindigkeit Integrator rkat, f(abo)" CURVE 0xFC547E KlAUwSstUwWUw 959.9854 zk200msxs_uw_b960 0.00 959.9854 FORMAT "%8.4"
 /begin AXIS_DESCR STD_AXIS abo dez 3 0.00 255.0 FORMAT "%5.1" DEPOSIT ABSOLUTE /end AXIS_DESCR
/end CHARACTERISTIC
/begin CHARACTERISTIC ZKRKAZ "Integrationsgeschwindigkeit Integrator rkaz" VALUE 0xFCDF3E KwUw 959.9854 zk200msxs_uw_b960 0.00 959.9854 FORMAT "%8.4" /end CHARACTERISTIC
/begin CHARACTERISTIC ZKUEVERG "Filterzeitkonstante: Turbinendrehzahl bei Gangwechsel" VALUE 0xFC70E8 KwUb 5.08000 zk20msxs_ub_b5p1 0.0200000 5.10000 FORMAT "%7.5" /end CHARACTERISTIC
/begin CHARACTERISTIC ZLASHKAB "Zeitkonstante f¸r Abregelung der dyn. Sollwertanhebung (dlasohkab) rin der LRHK" VALUE 0xFC6B74 KwUw 655.34999985 zk10msxs_uw_b655 0.010000152590 655.36000000 FORMAT "%12.8" /end CHARACTERISTIC
/begin CHARACTERISTIC ZLASOHML "Zeitkonstante f¸r PT1-Filter des Pseudo-Lambda hinter Kat" CURVE 0xFC6B76 KlAUwSstUwWUw 655.34999985 zk10msxs_uw_b655 0.010000152590 655.36000000 FORMAT "%12.8"
 /begin AXIS_DESCR STD_AXIS ml_w m_uw_b6553p5 8 0.00 6553.500 FORMAT "%8.3" DEPOSIT ABSOLUTE /end AXIS_DESCR
/end CHARACTERISTIC
/begin CHARACTERISTIC ZLRFRI "Zeitkonstante zum Aufregeln des tmst abh‰ngigen Gewichtungsfaktor FFRITMS" VALUE 0xFCF07A KwUw 6553.4999985 zk100msxs_uw_b655 0.10000152590 6553.6000000 FORMAT "%12.7" /end CHARACTERISTIC
/begin CHARACTERISTIC ZLRHML "Luftmassendurchsatz abh‰ngige Zeitkonstante f¸r Lambdaregler hinter Katalysator" CURVE 0xFCF124 GklWUb 9.961 tgrad_ub_q0p039 0.00 9.961 FORMAT "%5.3"
 /begin AXIS_DESCR COM_AXIS ml m_ub_b1020 8 0.00 1020. FORMAT "%5.0" AXIS_PTS_REF SML08LHUB /end AXIS_DESCR
/end CHARACTERISTIC
/begin CHARACTERISTIC ZLSDWE "Zeitkonstante PT2-Filter Lastschlagd‰mpfung bei hohem Kupplungsmoment" VALUE 0xFC80CE KwUw 655.34999985 zk10msxs_uw_b655 0.010000152590 655.36000000 FORMAT "%12.8" /end CHARACTERISTIC
/begin CHARACTERISTIC ZMDNSM "Zeitkonstante zur Abrgelung des Nachstart-Momentenoffset" CURVE 0xFCF30C KlAUbSstUbWUb 50.9992 zk200msxs_ub_b51p2 0.200784 51.2000 FORMAT "%7.4"
 /begin AXIS_DESCR STD_AXIS tmot temp_ub_q0p75_o48 8 -48.00 143.3 FORMAT "%5.1" DEPOSIT ABSOLUTE /end AXIS_DESCR
/end CHARACTERISTIC
/begin CHARACTERISTIC ZMDNSMVT "Zeitkonstante zur Abrgelung des Nachstart-Momentenoffset (VVT)" CURVE 0xFCF320 KlAUbSstUbWUb 50.9992 zk200msxs_ub_b51p2 0.200784 51.2000 FORMAT "%7.4"
 /begin AXIS_DESCR STD_AXIS tmot temp_ub_q0p75_o48 8 -48.00 143.3 FORMAT "%5.1" DEPOSIT ABSOLUTE /end AXIS_DESCR
/end CHARACTERISTIC
/begin CHARACTERISTIC ZMIBGR "Zeitkonstante f¸r Faktor gangabh. Momentenbegrenzung" VALUE 0xFC80E6 KwUw 3276.7499992 zk50msxs_uw_b3276p8 0.050000762951 3276.8000000 FORMAT "%12.7" /end CHARACTERISTIC
/begin CHARACTERISTIC ZNGHGS "Zeitkonstante Tiefpaﬂ f¸r Drehzahlgradient" VALUE 0xFC80E8 KwUw 3276.7499992 zk50msxs_uw_b3276p8 0.050000762951 3276.8000000 FORMAT "%12.7" /end CHARACTERISTIC
/begin CHARACTERISTIC ZRL_W_KGE "" CURVE 0xFCF62E GklWUw 655.34999985 zk10msxs_uw_b655 0.010000152590 655.36000000 FORMAT "%12.8"
 /begin AXIS_DESCR COM_AXIS nmot_w nmot_uw_q0p25 16 0.00 16383.75 FORMAT "%8.2" AXIS_PTS_REF SNM16OPUW /end AXIS_DESCR
/end CHARACTERISTIC
/begin MEASUREMENT Asprll "Soll-Auslassspreizung im Leerlauf" UBYTE sprzi_q0p8 1 100 0 204 FORMAT "%5.1" ECU_ADDRESS 0x5B8CAD /end MEASUREMENT
/begin MEASUREMENT atv "aktueller Lernkennfeld-Integratorwert der Regelung hinter Kat" SBYTE t100msxs_sb_q0p01 1 100 -1.28 1.27 FORMAT "%5.3" ECU_ADDRESS 0x3FDC74 /end MEASUREMENT
/begin MEASUREMENT atvinii "Initialisierungswert f¸r Integrator atv" SBYTE t100msxs_sb_q0p01 1 100 -1.28 1.27 FORMAT "%5.3" ECU_ADDRESS 0x5B8F71 /end MEASUREMENT
/begin MEASUREMENT B_adwfk "Bedingung Adaptionswert Fahrstufe und Kompressor ein verwenden" UBYTE B_TRUE 1 100 0 1 BIT_MASK 0x1 FORMAT "%13.11" ECU_ADDRESS 0x3FBEFF /end MEASUREMENT
/begin MEASUREMENT B_adwfs "Bedingung Adaptionswert Fahrstufe ein verwenden" UBYTE B_TRUE 1 100 0 1 BIT_MASK 0x1 FORMAT "%13.11" ECU_ADDRESS 0x3FBF00 /end MEASUREMENT
/begin MEASUREMENT B_adwko "Bedingung Adaptionswert Klimakompressor ein verwenden" UBYTE B_TRUE 1 100 0 1 BIT_MASK 0x1 FORMAT "%13.11" ECU_ADDRESS 0x3FBF01 /end MEASUREMENT
/begin MEASUREMENT B_allzw "Bedingung zw-Verstellung durch MD-Struktur aktiv (LL,DASH,LSD,KUP)" UBYTE B_TRUE 1 100 0 1 BIT_MASK 0x1 FORMAT "%13.11" ECU_ADDRESS 0x3FBF25 /end MEASUREMENT
/begin MEASUREMENT B_allzwe "Bedingung zw-Verstellung durch MD-Struktur aktiv (LL,DASH,LSD,KUP)" UBYTE B_TRUE 1 100 0 1 BIT_MASK 0x1 FORMAT "%13.11" ECU_ADDRESS 0x3FBF26 /end MEASUREMENT
/begin MEASUREMENT B_asr "Bedingung f¸r ASR aktiv" UBYTE B_TRUE 1 100 0 1 BIT_MASK 0x1 FORMAT "%13.11" ECU_ADDRESS 0x3FBF27 /end MEASUREMENT
/begin MEASUREMENT B_atvini "Bedingung Integrator atv initialisieren" UBYTE B_TRUE 1 100 0 1 BIT_MASK 0x1 FORMAT "%13.11" ECU_ADDRESS 0x5B8F75 /end MEASUREMENT
/begin MEASUREMENT B_blrka "Bedingung gesteuertes Katalysator-Ausr‰umen angefordert" UBYTE B_TRUE 1 100 0 1 BIT_MASK 0x1 FORMAT "%13.11" ECU_ADDRESS 0x3FBEE5 /end MEASUREMENT
/begin MEASUREMENT B_bvdel "ODER-Verkn¸pfung der verzˆgerten Sperrbedingungen B_bag / B_vag" UBYTE B_TRUE 1 100 0 1 BIT_MASK 0x1 FORMAT "%13.11" ECU_ADDRESS 0x3FBEC4 /end MEASUREMENT
/begin MEASUREMENT B_clradllr "Bedingung:  Adaptionswerte LL-Regelung selektiv loeschen" UBYTE B_TRUE 1 100 0 1 BIT_MASK 0x1 FORMAT "%13.11" ECU_ADDRESS 0x3FBF02 /end MEASUREMENT
/begin MEASUREMENT B_dash "Bedingung: Dashpot-ƒnderungsbegrenzung aktiv" UBYTE B_TRUE 1 100 0 1 BIT_MASK 0x1 FORMAT "%13.11" ECU_ADDRESS 0x3FBF16 /end MEASUREMENT
/begin MEASUREMENT B_dfrf "Bedingung Anfettung in LR erkannt" UBYTE B_TRUE 1 100 0 1 BIT_MASK 0x1 FORMAT "%13.11" ECU_ADDRESS 0x3FBEA8 /end MEASUREMENT
/begin MEASUREMENT B_dfrf2 "Bedingung Anfettung in LR erkannt, Bank2" UBYTE B_TRUE 1 100 0 1 BIT_MASK 0x1 FORMAT "%13.11" ECU_ADDRESS 0x3FBEA9 /end MEASUREMENT
/begin MEASUREMENT B_dfrm "Bedingung Ausmagerung in LR erkannt" UBYTE B_TRUE 1 100 0 1 BIT_MASK 0x1 FORMAT "%13.11" ECU_ADDRESS 0x3FBEAA /end MEASUREMENT
/begin MEASUREMENT B_dfrm2 "Bedingung Ausmagerung in LR erkannt, Bank2" UBYTE B_TRUE 1 100 0 1 BIT_MASK 0x1 FORMAT "%13.11" ECU_ADDRESS 0x3FBEAB /end MEASUREMENT
/begin MEASUREMENT B_dmrwan "Bedingung Aufbau Momentenreserve f¸r Wandlermoment" UBYTE B_TRUE 1 100 0 1 BIT_MASK 0x1 FORMAT "%13.11" ECU_ADDRESS 0x3FBF08 /end MEASUREMENT
/begin MEASUREMENT B_dp "Bedingung: Dashpotwert grˆﬂer Fahrerwunsch (=1)" UBYTE B_TRUE 1 100 0 1 BIT_MASK 0x1 FORMAT "%13.11" ECU_ADDRESS 0x3FBF17 /end MEASUREMENT
/begin MEASUREMENT B_edp "Bedingung Erlaubnis Dashpot" UBYTE B_TRUE 1 100 0 1 BIT_MASK 0x1 FORMAT "%13.11" ECU_ADDRESS 0x3FBF18 /end MEASUREMENT
/begin MEASUREMENT B_elsd "Bedingung Erlaubnis Lastschlagd‰mpfung" UBYTE B_TRUE 1 100 0 1 BIT_MASK 0x1 FORMAT "%13.11" ECU_ADDRESS 0x3FBF19 /end MEASUREMENT
/begin MEASUREMENT B_eobdlr "OBDII-Summenfehler. sperrt die LR" UBYTE B_TRUE 1 100 0 1 BIT_MASK 0x1 FORMAT "%13.11" ECU_ADDRESS 0x3FBEC5 /end MEASUREMENT
/begin MEASUREMENT B_eobdlr2 "OBDII-Summenfehler. sperrt die LR, Bank 2" UBYTE B_TRUE 1 100 0 1 BIT_MASK 0x1 FORMAT "%13.11" ECU_ADDRESS 0x3FBEC6 /end MEASUREMENT
/begin MEASUREMENT B_fgr "Bedingung FGR (Tempomat) aktiv" UBYTE B_TRUE 1 100 0 1 BIT_MASK 0x1 FORMAT "%13.11" ECU_ADDRESS 0x3FBF1A /end MEASUREMENT
/begin MEASUREMENT B_fil "Bedingung PT1-Filter f¸r SAWE aktiv" UBYTE B_TRUE 1 100 0 1 BIT_MASK 0x1 FORMAT "%13.11" ECU_ADDRESS 0x3FBF1B /end MEASUREMENT
/begin MEASUREMENT B_fnstab "Bedingung Drehzahlstabilisierung aktiv" UBYTE B_TRUE 1 100 0 1 BIT_MASK 0x1 FORMAT "%13.11" ECU_ADDRESS 0x3FBEFE /end MEASUREMENT
/begin MEASUREMENT B_frab "Bedingung Regelfaktor fr auﬂerhalb adaptierten Band" UBYTE B_TRUE 1 100 0 1 BIT_MASK 0x1 FORMAT "%13.11" ECU_ADDRESS 0x3FBEAC /end MEASUREMENT
/begin MEASUREMENT B_frab2 "Bedingung Regelfaktor fr auﬂerhalb adaptierten Band, Bank 2" UBYTE B_TRUE 1 100 0 1 BIT_MASK 0x1 FORMAT "%13.11" ECU_ADDRESS 0x3FBEAD /end MEASUREMENT
/begin MEASUREMENT B_frao "Einschaltbedingung f¸r Adaption von frao" UBYTE B_TRUE 1 100 0 1 BIT_MASK 0x1 FORMAT "%13.11" ECU_ADDRESS 0x3FBD9A /end MEASUREMENT
/begin MEASUREMENT B_fraor "Bedingung frao-Integrator auﬂerhalb reduzierter Bereich" UBYTE B_TRUE 1 100 0 1 BIT_MASK 0x1 FORMAT "%13.11" ECU_ADDRESS 0x3FBD9B /end MEASUREMENT
/begin MEASUREMENT B_fraor2 "Bedingung frao2-Integrator auﬂerhalb reduzierter Bereich" UBYTE B_TRUE 1 100 0 1 BIT_MASK 0x1 FORMAT "%13.11" ECU_ADDRESS 0x3FBD9C /end MEASUREMENT
/begin MEASUREMENT B_frau "Einschaltbedingung f¸r Adaption von frau" UBYTE B_TRUE 1 100 0 1 BIT_MASK 0x1 FORMAT "%13.11" ECU_ADDRESS 0x3FBD9D /end MEASUREMENT
/begin MEASUREMENT B_fraur "Bedingung frau-Integrator auﬂerhalb reduzierter Bereich" UBYTE B_TRUE 1 100 0 1 BIT_MASK 0x1 FORMAT "%13.11" ECU_ADDRESS 0x3FBD9E /end MEASUREMENT
/begin MEASUREMENT B_fraur2 "Bedingung frau2-Integrator auﬂerhalb reduzierter Bereich" UBYTE B_TRUE 1 100 0 1 BIT_MASK 0x1 FORMAT "%13.11" ECU_ADDRESS 0x3FBD9F /end MEASUREMENT
/begin MEASUREMENT B_frini "Bedingung Regelfaktor fr initialisieren" UBYTE B_TRUE 1 100 0 1 BIT_MASK 0x1 FORMAT "%13.11" ECU_ADDRESS 0x3FBEE3 /end MEASUREMENT
/begin MEASUREMENT B_frini2 "Bedingung Regelfaktor fr initialisieren, Bank 2" UBYTE B_TRUE 1 100 0 1 BIT_MASK 0x1 FORMAT "%13.11" ECU_ADDRESS 0x3FBEE4 /end MEASUREMENT
/begin MEASUREMENT B_frmax "Lambda-Regelung setzt Bit sobald FR am Anschlag FRMAX" UBYTE B_TRUE 1 100 0 1 BIT_MASK 0x1 FORMAT "%13.11" ECU_ADDRESS 0x3FBEAE /end MEASUREMENT
/begin MEASUREMENT B_frmax2 "Lambda-Regelung setzt Bit sobald FR am Anschlag FRMAX, Bank 2" UBYTE B_TRUE 1 100 0 1 BIT_MASK 0x1 FORMAT "%13.11" ECU_ADDRESS 0x3FBEAF /end MEASUREMENT
/begin MEASUREMENT B_frmin "Lambda-Regelung setzt Bit sobald FR am Anschlag FRMIN" UBYTE B_TRUE 1 100 0 1 BIT_MASK 0x1 FORMAT "%13.11" ECU_ADDRESS 0x3FBEB0 /end MEASUREMENT
/begin MEASUREMENT B_frmin2 "Lambda-Regelung setzt Bit sobald FR am Anschlag FRMIN, Bank 2" UBYTE B_TRUE 1 100 0 1 BIT_MASK 0x1 FORMAT "%13.11" ECU_ADDRESS 0x3FBEB1 /end MEASUREMENT
/begin MEASUREMENT B_frmini "Bildung fr-Mittelwert: Bed. Initialisieren von frm_w" UBYTE B_TRUE 1 100 0 1 BIT_MASK 0x1 FORMAT "%13.11" ECU_ADDRESS 0x3FBEB2 /end MEASUREMENT
/begin MEASUREMENT B_frsp "Bedingung Reglersprung" UBYTE B_TRUE 1 100 0 1 BIT_MASK 0x1 FORMAT "%13.11" ECU_ADDRESS 0x3FBEB3 /end MEASUREMENT
/begin MEASUREMENT B_fslr "Bed. LR aktiv/inaktiv bei Fettschutz (lamsons_w < 1.0)" UBYTE B_TRUE 1 100 0 1 BIT_MASK 0x1 FORMAT "%13.11" ECU_ADDRESS 0x3FBEC7 /end MEASUREMENT
/begin MEASUREMENT B_fslr2 "Bed. LR aktiv/inaktiv w‰hrend Fettschutz (lamsons_w < 1.0), Bank 2" UBYTE B_TRUE 1 100 0 1 BIT_MASK 0x1 FORMAT "%13.11" ECU_ADDRESS 0x3FBEC8 /end MEASUREMENT
/begin MEASUREMENT B_fsu "Bedingung Fahrstufe, Umschaltung" UBYTE B_TRUE 1 100 0 1 BIT_MASK 0x1 FORMAT "%13.11" ECU_ADDRESS 0x3FBF09 /end MEASUREMENT
/begin MEASUREMENT B_gasp "Bedingung Grundadaption gesperrt" UBYTE B_TRUE 1 100 0 1 BIT_MASK 0x1 FORMAT "%13.11" ECU_ADDRESS 0x3FBDAC /end MEASUREMENT
/begin MEASUREMENT B_hgsndy "Bedingung Drehzahldynamik in gangabh‰ngiger Momentenbegrenzung" UBYTE B_TRUE 1 100 0 1 BIT_MASK 0x1 FORMAT "%13.11" ECU_ADDRESS 0x3FBF23 /end MEASUREMENT
/begin MEASUREMENT B_iflsd "Bedingung Initialisierung Filter Lastschlagd‰mpfung" UBYTE B_TRUE 1 100 0 1 BIT_MASK 0x1 FORMAT "%13.11" ECU_ADDRESS 0x3FBF1C /end MEASUREMENT
/begin MEASUREMENT B_ilmlkat "Bedingung g¸ltige Messung des Sauerstoffspeichers" UBYTE B_TRUE 1 100 0 1 BIT_MASK 0x1 FORMAT "%13.11" ECU_ADDRESS 0x3FBEE6 /end MEASUREMENT
/begin MEASUREMENT B_inifrm "Bildung fr-Mittelwert: Bed. Auswahl Initialisierungswert von frm_w" UBYTE B_TRUE 1 100 0 1 BIT_MASK 0x1 FORMAT "%13.11" ECU_ADDRESS 0x3FBEB4 /end MEASUREMENT
/begin MEASUREMENT B_int "LR: Bedingung Integration erlaubt" UBYTE B_TRUE 1 100 0 1 BIT_MASK 0x1 FORMAT "%13.11" ECU_ADDRESS 0x3FBEB5 /end MEASUREMENT
/begin MEASUREMENT B_kawe "Faktor fwe aktiv w‰hrend Kat-Ausr‰umen, Bank 1" UBYTE B_TRUE 1 100 0 1 BIT_MASK 0x1 FORMAT "%13.11" ECU_ADDRESS 0x3FBEE7 /end MEASUREMENT
/begin MEASUREMENT B_koefini "" UBYTE B_TRUE 1 100 0 1 FORMAT "%13.11" ECU_ADDRESS 0x5B8B65 /end MEASUREMENT
/begin MEASUREMENT B_koefkf "" UBYTE B_TRUE 1 100 0 1 FORMAT "%13.11" ECU_ADDRESS 0x5B8B66 /end MEASUREMENT
/begin MEASUREMENT B_ll "Bedingung Leerlauf" UBYTE B_TRUE 1 100 0 1 BIT_MASK 0x1 FORMAT "%13.11" ECU_ADDRESS 0x3FBF1D /end MEASUREMENT
/begin MEASUREMENT B_lr "LREB: Bedingung Lambdaregelung (vor Kat); (Bank 1)" UBYTE B_TRUE 1 100 0 1 BIT_MASK 0x1 FORMAT "%13.11" ECU_ADDRESS 0x3FBEC9 /end MEASUREMENT
/begin MEASUREMENT B_lr2 "Bedingung Lambdaregelung (vor Kat); Bank 2" UBYTE B_TRUE 1 100 0 1 BIT_MASK 0x1 FORMAT "%13.11" ECU_ADDRESS 0x3FBECA /end MEASUREMENT
/begin MEASUREMENT B_lr2s "CARB FREEZE FRAME, Bank1 bit 1, LR: Regelbetrieb mit zwei Sonden" UBYTE B_TRUE 1 100 0 1 BIT_MASK 0x2 FORMAT "%13.11" ECU_ADDRESS 0x5B8F6F /end MEASUREMENT
/begin MEASUREMENT B_lr2s2 "CARB FREEZE FRAME, Bank2 Bit 1, LR: Regelbetrieb mit zwei Sonden" UBYTE B_TRUE 1 100 0 1 BIT_MASK 0x2 FORMAT "%13.11" ECU_ADDRESS 0x5B8F70 /end MEASUREMENT
/begin MEASUREMENT B_lra "Bedingung Gemischadaption freigegeben" UBYTE B_TRUE 1 100 0 1 BIT_MASK 0x1 FORMAT "%13.11" ECU_ADDRESS 0x3FBDAD /end MEASUREMENT
/begin MEASUREMENT B_lra2 "Bedingung Gemischadaption 2 freigegeben" UBYTE B_TRUE 1 100 0 1 BIT_MASK 0x1 FORMAT "%13.11" ECU_ADDRESS 0x3FBDAE /end MEASUREMENT
/begin MEASUREMENT B_lrare "Bedingung Reset LRA" UBYTE B_TRUE 1 100 0 1 BIT_MASK 0x1 FORMAT "%13.11" ECU_ADDRESS 0x3FBDA0 /end MEASUREMENT
/begin MEASUREMENT B_lrare2 "Bedingung Reset LRA Bank 2" UBYTE B_TRUE 1 100 0 1 BIT_MASK 0x1 FORMAT "%13.11" ECU_ADDRESS 0x3FBDA1 /end MEASUREMENT
/begin MEASUREMENT B_lrareb "Bedingung Resetbereitschaft LRA" UBYTE B_TRUE 1 100 0 1 BIT_MASK 0x1 FORMAT "%13.11" ECU_ADDRESS 0x3FBDA2 /end MEASUREMENT
/begin MEASUREMENT B_lreb100 "Sammelbit der im 100 ms-Raster gebildeten Sperrbedingungen" UBYTE B_TRUE 1 100 0 1 BIT_MASK 0x1 FORMAT "%13.11" ECU_ADDRESS 0x3FBECB /end MEASUREMENT
/begin MEASUREMENT B_lreble "Bedingung LR inaktiv bei Abmagerung und Sonde zeigt""fett""" UBYTE B_TRUE 1 100 0 1 BIT_MASK 0x1 FORMAT "%13.11" ECU_ADDRESS 0x3FBECC /end MEASUREMENT
/begin MEASUREMENT B_lreble2 "Bedingung LR inaktiv bei Abmagerung und Sonde zeigt""fett"", Bank 2" UBYTE B_TRUE 1 100 0 1 BIT_MASK 0x1 FORMAT "%13.11" ECU_ADDRESS 0x3FBECD /end MEASUREMENT
/begin MEASUREMENT B_lrebpr "Bedingung LR inaktiv bei Anfettung, Sonde ""mager"" oder Abmagerung, Sonde ""fett""" UBYTE B_TRUE 1 100 0 1 BIT_MASK 0x1 FORMAT "%13.11" ECU_ADDRESS 0x3FBECE /end MEASUREMENT
/begin MEASUREMENT B_lrebpr2 "Bedingung LR inaktiv bei Anfett. Sonde ""mager"" oder Abmager. Sonde ""fett"", Bank2" UBYTE B_TRUE 1 100 0 1 BIT_MASK 0x1 FORMAT "%13.11" ECU_ADDRESS 0x3FBECF /end MEASUREMENT
/begin MEASUREMENT B_lrebri "Bedingung LR inaktiv bei Anfettung: lamsons_w < 1, B_vl, B_vag oder B_bag" UBYTE B_TRUE 1 100 0 1 BIT_MASK 0x1 FORMAT "%13.11" ECU_ADDRESS 0x3FBED0 /end MEASUREMENT
/begin MEASUREMENT B_lrebri2 "Bedingung LR inaktiv bei Anfettung: lamsons_w < 1, B_vl, B_vag oder B_bag, Bank2" UBYTE B_TRUE 1 100 0 1 BIT_MASK 0x1 FORMAT "%13.11" ECU_ADDRESS 0x3FBED1 /end MEASUREMENT
/begin MEASUREMENT B_lrhk "Bedingung Lambdaregelung hinter Kat" UBYTE B_TRUE 1 100 0 1 BIT_MASK 0x1 FORMAT "%13.11" ECU_ADDRESS 0x3FBEE2 /end MEASUREMENT
/begin MEASUREMENT B_lrhkb "Bedingung Lambdaregelung h. Kat, bankspez. Parameter Bank 1" UBYTE B_TRUE 1 100 0 1 BIT_MASK 0x4 FORMAT "%13.11" ECU_ADDRESS 0x5B8F75 /end MEASUREMENT
/begin MEASUREMENT B_lrhkg "bankunabh‰ngige Bedingung Lambdaregelung hinter Kat" UBYTE B_TRUE 1 100 0 1 BIT_MASK 0x10 FORMAT "%13.11" ECU_ADDRESS 0x5B8F75 /end MEASUREMENT
/begin MEASUREMENT B_lrhkgi "bankunabh‰ngige Bedingung I-Anteil Lambdaregelung hinter Kat" UBYTE B_TRUE 1 100 0 1 BIT_MASK 0x20 FORMAT "%13.11" ECU_ADDRESS 0x5B8F75 /end MEASUREMENT
/begin MEASUREMENT B_lrhkp "LRHK: Freigabebedingung P-Anteil Lambdaregelung hinter Kat" UBYTE B_TRUE 1 100 0 1 BIT_MASK 0x40 FORMAT "%13.11" ECU_ADDRESS 0x5B8F75 /end MEASUREMENT
/begin MEASUREMENT B_lrka "Bedingung Katalysator-Ausr‰umen" UBYTE B_TRUE 1 100 0 1 BIT_MASK 0x1 FORMAT "%13.11" ECU_ADDRESS 0x3FBEE8 /end MEASUREMENT
/begin MEASUREMENT B_lrkaa "Bedingung Katalysator-Ausr‰umen auf-/abregeln" UBYTE B_TRUE 1 100 0 1 BIT_MASK 0x1 FORMAT "%13.11" ECU_ADDRESS 0x3FBEE9 /end MEASUREMENT
/begin MEASUREMENT B_lrkae "Bedingung gesteuertes Katalysator-Ausr‰umen mˆglich" UBYTE B_TRUE 1 100 0 1 BIT_MASK 0x1 FORMAT "%13.11" ECU_ADDRESS 0x3FBEEA /end MEASUREMENT
/begin MEASUREMENT B_lrkaei "Bedingung gesteuertes Katalysator-Ausr‰umen mˆglich (ALRKAGST)" UBYTE B_TRUE 1 100 0 1 BIT_MASK 0x1 FORMAT "%13.11" ECU_ADDRESS 0x3FBEEB /end MEASUREMENT
/begin MEASUREMENT B_lrkaon "Status aktives Ausr‰umen wird durch erneute Ausr‰umbedingung unterbrochen" UBYTE B_TRUE 1 100 0 1 BIT_MASK 0x1 FORMAT "%13.11" ECU_ADDRESS 0x3FBEEC /end MEASUREMENT
/begin MEASUREMENT B_lrkarg "Bedingung Katalysator-Ausr‰umen, geregelt" UBYTE B_TRUE 1 100 0 1 BIT_MASK 0x1 FORMAT "%13.11" ECU_ADDRESS 0x3FBEED /end MEASUREMENT
/begin MEASUREMENT B_lrkast "Bedingung Katalysator-Ausr‰umen, gesteuert" UBYTE B_TRUE 1 100 0 1 BIT_MASK 0x1 FORMAT "%13.11" ECU_ADDRESS 0x3FBEEE /end MEASUREMENT
/begin MEASUREMENT B_lrnd "Steuerbit LR aktiv setzen; Anforderung ""NORMAL-"" oder ""DIAGNOSE-Betrieb""" UBYTE B_TRUE 1 100 0 1 BIT_MASK 0x1 FORMAT "%13.11" ECU_ADDRESS 0x3FBED2 /end MEASUREMENT
/begin MEASUREMENT B_lrnd2 "Steuerbit LR aktiv setzen; Anforderung ""NORMAL-"" oder ""DIAGNOSE"" z.B. bei SLS" UBYTE B_TRUE 1 100 0 1 BIT_MASK 0x1 FORMAT "%13.11" ECU_ADDRESS 0x3FBED3 /end MEASUREMENT
/begin MEASUREMENT B_lrnda "LR Bank1 aktiv bei Bedingungen : B_lrpspa & B_lrkasn & !E_obdlr" UBYTE B_TRUE 1 100 0 1 BIT_MASK 0x1 FORMAT "%13.11" ECU_ADDRESS 0x3FBED4 /end MEASUREMENT
/begin MEASUREMENT B_lrnda2 "LR Bank2 aktiv bei Bedingungen : B_lrpspa & B_lrkasn & !E_obdlr" UBYTE B_TRUE 1 100 0 1 BIT_MASK 0x1 FORMAT "%13.11" ECU_ADDRESS 0x3FBED5 /end MEASUREMENT
/begin MEASUREMENT B_lrpspa "LREB: Projektspezifische Ausschaltbedingung Lambdaregelung (vor Kat)" UBYTE B_TRUE 1 100 0 1 BIT_MASK 0x1 FORMAT "%13.11" ECU_ADDRESS 0x3FBED6 /end MEASUREMENT
/begin MEASUREMENT B_lrrl "LREB: Von Last abh‰ngige Bedingung Lambdaregelung (vor Kat)" UBYTE B_TRUE 1 100 0 1 BIT_MASK 0x1 FORMAT "%13.11" ECU_ADDRESS 0x3FBED7 /end MEASUREMENT
/begin MEASUREMENT B_lrsp "Bedingung Sondensprung" UBYTE B_TRUE 1 100 0 1 BIT_MASK 0x1 FORMAT "%13.11" ECU_ADDRESS 0x3FBEB6 /end MEASUREMENT
/begin MEASUREMENT B_lrsp2 "Bedingung Sondensprung Zylinderbank 2" UBYTE B_TRUE 1 100 0 1 BIT_MASK 0x1 FORMAT "%13.11" ECU_ADDRESS 0x3FBEB7 /end MEASUREMENT
/begin MEASUREMENT B_lrstat "Bedingung Lambdaregler arbeitet station‰r" UBYTE B_TRUE 1 100 0 1 BIT_MASK 0x1 FORMAT "%13.11" ECU_ADDRESS 0x3FBEB8 /end MEASUREMENT
/begin MEASUREMENT B_lrstat2 "Bedingung Lambdaregler arbeitet station‰r, Bank2" UBYTE B_TRUE 1 100 0 1 BIT_MASK 0x1 FORMAT "%13.11" ECU_ADDRESS 0x3FBEB9 /end MEASUREMENT
/begin MEASUREMENT B_lrstta "Bedingung Lambdaregler arbeitet station‰r, Zeit und Amplitudenbedingung" UBYTE B_TRUE 1 100 0 1 BIT_MASK 0x1 FORMAT "%13.11" ECU_ADDRESS 0x3FBEBA /end MEASUREMENT
/begin MEASUREMENT B_lrstta2 "Bedingung Lambdaregler arbeitet station‰r, Zeit und Amplitudenbedingung Bank 2" UBYTE B_TRUE 1 100 0 1 BIT_MASK 0x1 FORMAT "%13.11" ECU_ADDRESS 0x3FBEBB /end MEASUREMENT
/begin MEASUREMENT B_lrtpp "Periodendauer g¸ltig, Bed. LR arbeitet station‰r (Amplitude/Periode) erf¸llt" UBYTE B_TRUE 1 100 0 1 BIT_MASK 0x1 FORMAT "%13.11" ECU_ADDRESS 0x3FBEBC /end MEASUREMENT
/begin MEASUREMENT B_lrtpp2 "Bedingung Lambdaregler arbeitet station‰r (Amplitude/Periode) Bank2" UBYTE B_TRUE 1 100 0 1 BIT_MASK 0x1 FORMAT "%13.11" ECU_ADDRESS 0x3FBEBD /end MEASUREMENT
/begin MEASUREMENT B_lrvk "CARB FREEZE FRAME, Bank1 Bit 4, LR: Regelung nur mit einer Sonde (vor KAT)" UBYTE B_TRUE 1 100 0 1 BIT_MASK 0x10 FORMAT "%13.11" ECU_ADDRESS 0x5B8F6F /end MEASUREMENT
/begin MEASUREMENT B_lrvk2 "CARB FREEZE FRAME, Bank2 Bit 4, LR: Regelung nur mit einer Sonde (vor KAT)" UBYTE B_TRUE 1 100 0 1 BIT_MASK 0x10 FORMAT "%13.11" ECU_ADDRESS 0x5B8F70 /end MEASUREMENT
/begin MEASUREMENT B_lrwla "LR aktiv bei Bedingungen : B_lrrl & B_tmlr & B_pspwl & Bstend" UBYTE B_TRUE 1 100 0 1 BIT_MASK 0x1 FORMAT "%13.11" ECU_ADDRESS 0x3FBED8 /end MEASUREMENT
/begin MEASUREMENT B_ls "Bedingung: Lastschlagbegrenzung kleiner Fahrerwunsch (=1)" UBYTE B_TRUE 1 100 0 1 BIT_MASK 0x1 FORMAT "%13.11" ECU_ADDRESS 0x3FBF1E /end MEASUREMENT
/begin MEASUREMENT B_lsd "Bedingung: Pos. Lastschlagd‰mpfung aktiv" UBYTE B_TRUE 1 100 0 1 BIT_MASK 0x1 FORMAT "%13.11" ECU_ADDRESS 0x3FBF1F /end MEASUREMENT
/begin MEASUREMENT B_madfk "Bedingung Momentenadaption Fahrstufe und Klimakompressor ein" UBYTE B_TRUE 1 100 0 1 BIT_MASK 0x1 FORMAT "%13.11" ECU_ADDRESS 0x3FBF03 /end MEASUREMENT
/begin MEASUREMENT B_madfs "Bedingung Momentenadaption Fahrstufe ein" UBYTE B_TRUE 1 100 0 1 BIT_MASK 0x1 FORMAT "%13.11" ECU_ADDRESS 0x3FBF04 /end MEASUREMENT
/begin MEASUREMENT B_madko "Bedingung Momentenadaption Klimakompressor ein" UBYTE B_TRUE 1 100 0 1 BIT_MASK 0x1 FORMAT "%13.11" ECU_ADDRESS 0x3FBF05 /end MEASUREMENT
/begin MEASUREMENT B_madll "Bedingung Momentenadaption ohne Last" UBYTE B_TRUE 1 100 0 1 BIT_MASK 0x1 FORMAT "%13.11" ECU_ADDRESS 0x3FBF06 /end MEASUREMENT
/begin MEASUREMENT B_madstp "Bedingung Momentenadaption durch Fehler im System gestoppt" UBYTE B_TRUE 1 100 0 1 BIT_MASK 0x1 FORMAT "%13.11" ECU_ADDRESS 0x3FBF07 /end MEASUREMENT
/begin MEASUREMENT B_mdee "Bedingung Momentenreduzierung ¸ber Einspritzausblendung erlaubt" UBYTE B_TRUE 1 100 0 1 BIT_MASK 0x1 FORMAT "%13.11" ECU_ADDRESS 0x3FBF2E /end MEASUREMENT
/begin MEASUREMENT B_mdein "Bedingung Momenteneingriff aktiv" UBYTE B_TRUE 1 100 0 1 BIT_MASK 0x1 FORMAT "%13.11" ECU_ADDRESS 0x3FBF28 /end MEASUREMENT
/begin MEASUREMENT B_mdmin "Bedingung minimal erreichbares indiziertes Moment erreicht" UBYTE B_TRUE 1 100 0 1 BIT_MASK 0x1 FORMAT "%13.11" ECU_ADDRESS 0x3FBD2B /end MEASUREMENT
/begin MEASUREMENT B_mdredhyein "" UBYTE B_TRUE 1 100 0 1 BIT_MASK 0x1 FORMAT "%13.11" ECU_ADDRESS 0x3FBF2F /end MEASUREMENT
/begin MEASUREMENT B_mibeg "Bedingung Momentenbegrenzung ist aktiv" UBYTE B_TRUE 1 100 0 1 BIT_MASK 0x1 FORMAT "%13.11" ECU_ADDRESS 0x3FBF29 /end MEASUREMENT
/begin MEASUREMENT B_mibegdau "Bedingung: Momenten¸berwachung begrenzt dauerhaft" UBYTE B_TRUE 1 100 0 1 BIT_MASK 0x1 FORMAT "%13.11" ECU_ADDRESS 0x3FBF2A /end MEASUREMENT
/begin MEASUREMENT B_mibgr "Bedingung Regelung der gangabh. Momentenbegrenzung aktiv" UBYTE B_TRUE 1 100 0 1 BIT_MASK 0x1 FORMAT "%13.11" ECU_ADDRESS 0x3FBF24 /end MEASUREMENT
/begin MEASUREMENT B_mlrsa "LRSEB: Ausschaltbed. f¸r Lambdareg. auf bei und nach Schub ¸ber Luftmassenschw." UBYTE B_TRUE 1 100 0 1 BIT_MASK 0x1 FORMAT "%13.11" ECU_ADDRESS 0x3FBED9 /end MEASUREMENT
/begin MEASUREMENT B_msfslr "Bed. LR aktiv/inaktiv bei Fett/Magerschutz" UBYTE B_TRUE 1 100 0 1 BIT_MASK 0x1 FORMAT "%13.11" ECU_ADDRESS 0x3FBEDA /end MEASUREMENT
/begin MEASUREMENT B_msfslr2 "Bed. LR aktiv/inaktiv w‰hrend Fett-/Magerschutz, Bank 2" UBYTE B_TRUE 1 100 0 1 BIT_MASK 0x1 FORMAT "%13.11" ECU_ADDRESS 0x3FBEDB /end MEASUREMENT
/begin MEASUREMENT B_mslr "Bed. LR aktiv/inaktiv bei Fett/Magerschutz" UBYTE B_TRUE 1 100 0 1 BIT_MASK 0x1 FORMAT "%13.11" ECU_ADDRESS 0x3FBEDC /end MEASUREMENT
/begin MEASUREMENT B_mslr2 "Bed. LR aktiv/inaktiv w‰hrend Fett-/Magerschutz" UBYTE B_TRUE 1 100 0 1 BIT_MASK 0x1 FORMAT "%13.11" ECU_ADDRESS 0x3FBEDD /end MEASUREMENT
/begin MEASUREMENT B_msr "Bedingung f¸r Momentenschlupfregelung" UBYTE B_TRUE 1 100 0 1 BIT_MASK 0x1 FORMAT "%13.11" ECU_ADDRESS 0x3FBF2B /end MEASUREMENT
/begin MEASUREMENT B_mzns "Nachstartaufweitung des zul. Moments aktiv" UBYTE B_TRUE 1 100 0 1 BIT_MASK 0x1 FORMAT "%13.11" ECU_ADDRESS 0x3FBF31 /end MEASUREMENT
/begin MEASUREMENT B_nachl "Steuerung SG-Nachlauf" UWORD B_TRUE 1 100 0 1 BIT_MASK 0x8000 FORMAT "%13.11" ECU_ADDRESS 0x3FDC90 /end MEASUREMENT
/begin MEASUREMENT B_nachlend "Bedingung SG-Nachlauf regul‰r beendet" UWORD B_TRUE 1 100 0 1 BIT_MASK 0x4000 FORMAT "%13.11" ECU_ADDRESS 0x3FDC90 /end MEASUREMENT
/begin MEASUREMENT B_nachln "Steuerung SG-Nachlauf nach n > NMIN" UBYTE B_TRUE 1 100 0 1 BIT_MASK 0x1 FORMAT "%13.11" ECU_ADDRESS 0x3FC018 /end MEASUREMENT
/begin MEASUREMENT B_nachlram "Steuerung SG-Nachlauf mit Systemcheck" UBYTE B_TRUE 1 100 0 1 BIT_MASK 0x1 FORMAT "%13.11" ECU_ADDRESS 0x3FBF39 /end MEASUREMENT
/begin MEASUREMENT B_nl10 "Bedingung EC-L¸fternachlaufsteuerung mit 10 Hz" UBYTE B_TRUE 1 100 0 1 BIT_MASK 0x1 FORMAT "%13.11" ECU_ADDRESS 0x3FC019 /end MEASUREMENT
/begin MEASUREMENT B_nlacls "Anforderung Steuerger‰tenachlauf von AC-L¸ftersteuerung" UWORD B_TRUE 1 100 0 1 BIT_MASK 0x2 FORMAT "%13.11" ECU_ADDRESS 0x3FDC90 /end MEASUREMENT
/begin MEASUREMENT B_nlale "Anforderung Steuerger‰tenachlauf von Funktion ALE" UWORD B_TRUE 1 100 0 1 BIT_MASK 0x1 FORMAT "%13.11" ECU_ADDRESS 0x3FDC90 /end MEASUREMENT
/begin MEASUREMENT B_nlatm "Anforderung Steuerger‰tenachlauf f¸r Abgastemp.Modell Sondenschutz" UWORD B_TRUE 1 100 0 1 BIT_MASK 0x400 FORMAT "%13.11" ECU_ADDRESS 0x3FDC90 /end MEASUREMENT
/begin MEASUREMENT B_nlcan "Bedingung f¸r SG-Nachlauf von CAN" UWORD B_TRUE 1 100 0 1 BIT_MASK 0x200 FORMAT "%13.11" ECU_ADDRESS 0x3FDC90 /end MEASUREMENT
/begin MEASUREMENT B_nldte "Anforderung Steuerger‰tenachlauf Diagnose Tankentl¸ftung" UWORD B_TRUE 1 100 0 1 BIT_MASK 0x100 FORMAT "%13.11" ECU_ADDRESS 0x3FDC90 /end MEASUREMENT
/begin MEASUREMENT B_nlEEPR "Bedingung Nachlauf EEPROM schreiben" UWORD B_TRUE 1 100 0 1 BIT_MASK 0x20 FORMAT "%13.11" ECU_ADDRESS 0x3FDC90 /end MEASUREMENT
/begin MEASUREMENT B_nlmls "Anforderung Steuerger‰tenachlauf von Motor-L¸ftersteuerung" UWORD B_TRUE 1 100 0 1 BIT_MASK 0x8 FORMAT "%13.11" ECU_ADDRESS 0x3FDC90 /end MEASUREMENT
/begin MEASUREMENT B_nlobd "Anforderung Steuerger‰tenachlauf von OBD" UWORD B_TRUE 1 100 0 1 BIT_MASK 0x10 FORMAT "%13.11" ECU_ADDRESS 0x3FDC90 /end MEASUREMENT
/begin MEASUREMENT B_nlsgls "Anforderung Steuerger‰tenachlauf von Steuerger‰te-L¸ftersteuerung" UWORD B_TRUE 1 100 0 1 BIT_MASK 0x40 FORMAT "%13.11" ECU_ADDRESS 0x3FDC90 /end MEASUREMENT
/begin MEASUREMENT B_nlsiko "Bedingung Nachlauf EGAS-‹berwachung" UWORD B_TRUE 1 100 0 1 BIT_MASK 0x80 FORMAT "%13.11" ECU_ADDRESS 0x3FDC90 /end MEASUREMENT
/begin MEASUREMENT B_nlvvtchk "Bedingung Anforderung Steuerger‰tenachlauf f¸r Anschlagadaption VVT" UWORD B_TRUE 1 100 0 1 BIT_MASK 0x800 FORMAT "%13.11" ECU_ADDRESS 0x3FDC90 /end MEASUREMENT
/begin MEASUREMENT B_nlwst "Anforderung Steuerger‰tenachlauf f¸r Wiederholstarterkennung" UWORD B_TRUE 1 100 0 1 BIT_MASK 0x4 FORMAT "%13.11" ECU_ADDRESS 0x3FDC90 /end MEASUREMENT
/begin MEASUREMENT B_nofra "Bedingung Sperren der multiplikativen Gemischkorrektur" UBYTE B_TRUE 1 100 0 1 BIT_MASK 0x1 FORMAT "%13.11" ECU_ADDRESS 0x3FBDA3 /end MEASUREMENT
/begin MEASUREMENT B_nolrb "CARB FREEZE FRAME, Bank1 Bit 2, LR: Steuerbetrieb durch Betriebsbedingungen" UBYTE B_TRUE 1 100 0 1 BIT_MASK 0x4 FORMAT "%13.11" ECU_ADDRESS 0x5B8F6F /end MEASUREMENT
/begin MEASUREMENT B_nolrb2 "CARB FREEZE FRAME, Bank2 Bit 2, LR: Steuerung durch Betriebsbedingung" UBYTE B_TRUE 1 100 0 1 BIT_MASK 0x4 FORMAT "%13.11" ECU_ADDRESS 0x5B8F70 /end MEASUREMENT
/begin MEASUREMENT B_nolre "CARB FREEZE FRAME, Bank1 Bit 3, LR: Steuerung nach Systemfehler" UBYTE B_TRUE 1 100 0 1 BIT_MASK 0x8 FORMAT "%13.11" ECU_ADDRESS 0x5B8F6F /end MEASUREMENT
/begin MEASUREMENT B_nolre2 "CARB FREEZE FRAME, Bank2 Bit 3, LR: Steuerung nach Systemfehler" UBYTE B_TRUE 1 100 0 1 BIT_MASK 0x8 FORMAT "%13.11" ECU_ADDRESS 0x5B8F70 /end MEASUREMENT
/begin MEASUREMENT B_nolrw "CARB FREEZE FRAME, Bank1 Bit 0, LR: Steuerbetrieb, Startbed. noch nicht erf¸llt" UBYTE B_TRUE 1 100 0 1 BIT_MASK 0x1 FORMAT "%13.11" ECU_ADDRESS 0x5B8F6F /end MEASUREMENT
/begin MEASUREMENT B_nolrw2 "CARB FREEZE FRAME, Bank2 Bit 0, LR: Steuerbetrieb, Startbed. noch nicht erf¸llt" UBYTE B_TRUE 1 100 0 1 BIT_MASK 0x1 FORMAT "%13.11" ECU_ADDRESS 0x5B8F70 /end MEASUREMENT
/begin MEASUREMENT B_norkat "Bedingung additive Korrektur der Gemischadaption pro Zeit abgeschaltet" UBYTE B_TRUE 1 100 0 1 BIT_MASK 0x1 FORMAT "%13.11" ECU_ADDRESS 0x3FBDA4 /end MEASUREMENT
/begin MEASUREMENT B_norkaz "Bedingung additive Korrektur der Gemischadaption pro Z¸ndung abgeschaltet" UBYTE B_TRUE 1 100 0 1 BIT_MASK 0x1 FORMAT "%13.11" ECU_ADDRESS 0x3FBDA5 /end MEASUREMENT
/begin MEASUREMENT B_nozwe "Bedingung kein Z¸ndwinkeleingriff der Drehmomentstruktur" UBYTE B_TRUE 1 100 0 1 BIT_MASK 0x1 FORMAT "%13.11" ECU_ADDRESS 0x3FBFE7 /end MEASUREMENT
/begin MEASUREMENT B_nsakt "Nachstart aktiv f¸r Nachstartaufweitung" UBYTE B_TRUE 1 100 0 1 BIT_MASK 0x1 FORMAT "%13.11" ECU_ADDRESS 0x3FBF32 /end MEASUREMENT
/begin MEASUREMENT B_nsend "Nachstart¸berwachungszeit abgelaufen" UBYTE B_TRUE 1 100 0 1 BIT_MASK 0x1 FORMAT "%13.11" ECU_ADDRESS 0x3FBF33 /end MEASUREMENT
/begin MEASUREMENT B_pspaus "Bedingung LR inaktiv bei projektspez. AUS-Bedingungen" UBYTE B_TRUE 1 100 0 1 BIT_MASK 0x1 FORMAT "%13.11" ECU_ADDRESS 0x3FBEDE /end MEASUREMENT
/begin MEASUREMENT B_pspwl "Bedingung LR inaktiv bei projektspez. Warmlauf-Bedingungen" UBYTE B_TRUE 1 100 0 1 BIT_MASK 0x1 FORMAT "%13.11" ECU_ADDRESS 0x3FBEDF /end MEASUREMENT
/begin MEASUREMENT B_rgang "Bedingung R¸ckw‰rtsgang eingelegt" UBYTE B_TRUE 1 100 0 1 BIT_MASK 0x1 FORMAT "%13.11" ECU_ADDRESS 0x3FBF0A /end MEASUREMENT
/begin MEASUREMENT B_rkat "Bedingung Lernbereich additive Korrektur pro Zeit aktiv" UBYTE B_TRUE 1 100 0 1 BIT_MASK 0x1 FORMAT "%13.11" ECU_ADDRESS 0x3FBDA6 /end MEASUREMENT
/begin MEASUREMENT B_rkatr "Bedingung rkat-Integrator auﬂerhalb reduzierten Bereich" UBYTE B_TRUE 1 100 0 1 BIT_MASK 0x1 FORMAT "%13.11" ECU_ADDRESS 0x3FBDA7 /end MEASUREMENT
/begin MEASUREMENT B_rkatr2 "Bedingung rkat2-Integrator auﬂerhalb reduzierten Bereich" UBYTE B_TRUE 1 100 0 1 BIT_MASK 0x1 FORMAT "%13.11" ECU_ADDRESS 0x3FBDA8 /end MEASUREMENT
/begin MEASUREMENT B_rkaz "Bedingung Lernbereich additive Korrektur pro Z¸ndung aktiv" UBYTE B_TRUE 1 100 0 1 BIT_MASK 0x1 FORMAT "%13.11" ECU_ADDRESS 0x3FBDA9 /end MEASUREMENT
/begin MEASUREMENT B_rkazr "Bedingung rkaz-Integrator auﬂerhalb reduzierten Bereich" UBYTE B_TRUE 1 100 0 1 BIT_MASK 0x1 FORMAT "%13.11" ECU_ADDRESS 0x3FBDAA /end MEASUREMENT
/begin MEASUREMENT B_rkazr2 "Bedingung rkaz2-Integrator auﬂerhalb reduzierten Bereich" UBYTE B_TRUE 1 100 0 1 BIT_MASK 0x1 FORMAT "%13.11" ECU_ADDRESS 0x3FBDAB /end MEASUREMENT
/begin MEASUREMENT B_sa "Bedingung Schubabschalten" UBYTE B_TRUE 1 100 0 1 BIT_MASK 0x1 FORMAT "%13.11" ECU_ADDRESS 0x3FBF30 /end MEASUREMENT
/begin MEASUREMENT B_sgnalt "Vorzeichen f¸r Gemisch vor Kat (Bool), 1 Rechenraster verzˆgert" UBYTE B_TRUE 1 100 0 1 BIT_MASK 0x1 FORMAT "%13.11" ECU_ADDRESS 0x3FBEBE /end MEASUREMENT
/begin MEASUREMENT B_sgnlr "Vorzeichen f¸r Gemisch vor Kat (Bool)" UBYTE B_TRUE 1 100 0 1 BIT_MASK 0x1 FORMAT "%13.11" ECU_ADDRESS 0x3FBEBF /end MEASUREMENT
/begin MEASUREMENT B_sgnlr2 "Vorzeichen f¸r Gemisch vor Kat (Bool), Bank 2" UBYTE B_TRUE 1 100 0 1 BIT_MASK 0x1 FORMAT "%13.11" ECU_ADDRESS 0x3FBEC0 /end MEASUREMENT
/begin MEASUREMENT B_sgnra "Vorzeichen f¸r Gemisch vor Kat gem. Sperrzeitsteuerung (Bool)" UBYTE B_TRUE 1 100 0 1 BIT_MASK 0x1 FORMAT "%13.11" ECU_ADDRESS 0x3FBEC1 /end MEASUREMENT
/begin MEASUREMENT B_tarau "LREB: Bedingung Start bei niedrigen Ansauglufttemperaturen" UBYTE B_TRUE 1 100 0 1 BIT_MASK 0x1 FORMAT "%13.11" ECU_ADDRESS 0x3FBEE0 /end MEASUREMENT
/begin MEASUREMENT B_tmlr "LREB: Von Motortemp. abh‰ngige Bedingungen Lambdaregelung (vor Kat)" UBYTE B_TRUE 1 100 0 1 BIT_MASK 0x1 FORMAT "%13.11" ECU_ADDRESS 0x3FBEE1 /end MEASUREMENT
/begin MEASUREMENT B_tsper "LR: Bedingung Starten der Sperrzeit" UBYTE B_TRUE 1 100 0 1 BIT_MASK 0x1 FORMAT "%13.11" ECU_ADDRESS 0x3FBEC2 /end MEASUREMENT
/begin MEASUREMENT B_tspon "Bedingung Entstˆrsperrzeit in der Lambdaregelung starten" UBYTE B_TRUE 1 100 0 1 BIT_MASK 0x1 FORMAT "%13.11" ECU_ADDRESS 0x3FBEC3 /end MEASUREMENT
/begin MEASUREMENT B_wememo "" UBYTE B_TRUE 1 100 0 1 BIT_MASK 0x1 FORMAT "%13.11" ECU_ADDRESS 0x3FBF20 /end MEASUREMENT
/begin MEASUREMENT B_zwvs "Bedingung f¸r schnellen ‰uﬂeren ZW-Eingriff der Momentenschnittstelle" UBYTE B_TRUE 1 100 0 1 BIT_MASK 0x1 FORMAT "%13.11" ECU_ADDRESS 0x3FBF2C /end MEASUREMENT
/begin MEASUREMENT B_zwvz "Bedingung f¸r Z¸ndwinkeleingriff der Momentenschnittstelle" UBYTE B_TRUE 1 100 0 1 BIT_MASK 0x1 FORMAT "%13.11" ECU_ADDRESS 0x3FBF2D /end MEASUREMENT
/begin MEASUREMENT B_zwvzm "" UBYTE B_TRUE 1 100 0 1 BIT_MASK 0x1 FORMAT "%13.11" ECU_ADDRESS 0x3FBFE8 /end MEASUREMENT
/begin MEASUREMENT dfrm2_w "Abweichung schneller Mittelwert des Lambdareglers von 1.0 (Word)" SWORD fak_sw_b1 1 100 -1 0.999969 FORMAT "%8.6" ECU_ADDRESS 0x5B8766 /end MEASUREMENT
/begin MEASUREMENT dfrm_w "Abweichung schneller Mittelwert des Lambdareglers von 1.0 (Word)" SWORD fak_sw_b1 1 100 -1 0.999969 FORMAT "%8.6" ECU_ADDRESS 0x5B8768 /end MEASUREMENT
/begin MEASUREMENT dfrsp2_w "delta Spitzenwert Lambdaregelfaktor frsp Bank 2" SWORD fak_sw_b1 1 100 -1 0.999969 FORMAT "%8.6" ECU_ADDRESS 0x5B92AE /end MEASUREMENT
/begin MEASUREMENT dfrsp_w "delta Spitzenwert Lambdaregelfaktor frsp" SWORD fak_sw_b1 1 100 -1 0.999969 FORMAT "%8.6" ECU_ADDRESS 0x5B92B0 /end MEASUREMENT
/begin MEASUREMENT dfrst2_w "fr-Regelhub im Station‰rzustand (Zylinderbank 2)" SWORD fak_sw_b1 1 100 -1 0.999969 FORMAT "%8.6" ECU_ADDRESS 0x5B92B2 /end MEASUREMENT
/begin MEASUREMENT dfrstga_w "Regelhub im Station‰rbetrieb (Grundadaptions-Phase)" SWORD fak_sw_b1 1 100 -1 0.999969 FORMAT "%8.6" ECU_ADDRESS 0x3FDC6E /end MEASUREMENT
/begin MEASUREMENT dfrstte_w "Regelhub im Station‰rbetrieb (Tankentl¸ftung-Sp¸lphase)" SWORD fak_sw_b1 1 100 -1 0.999969 FORMAT "%8.6" ECU_ADDRESS 0x3FDC70 /end MEASUREMENT
/begin MEASUREMENT dfrst_w "fr-Regelhub im Station‰rzustand" SWORD fak_sw_b1 1 100 -1 0.999969 FORMAT "%8.6" ECU_ADDRESS 0x5B92B4 /end MEASUREMENT
/begin MEASUREMENT dlahkab_w "Dynamische ‹berhˆhung des Pseudo Lambda-Sollwertes hinter Kat" SWORD fak_sw_b1 1 100 -1 0.999969 FORMAT "%8.6" ECU_ADDRESS 0x5B92DC /end MEASUREMENT
/begin MEASUREMENT dlashki_w "Delta-Lambda gewichtet f¸r I-Anteil LRSHK" SWORD fak_sw_b1 1 100 -1 0.999969 FORMAT "%8.6" ECU_ADDRESS 0x5B92DE /end MEASUREMENT
/begin MEASUREMENT dlashkm_w "Delta-Lambda aus Lambdaregelung hinter Kat (Ist-Wert fr-synchron gemittelt)" SWORD fak_sw_b1 1 100 -1 0.999969 FORMAT "%8.6" ECU_ADDRESS 0x5B92E0 /end MEASUREMENT
/begin MEASUREMENT dlashkp_w "Delta-Lambda gewichtet f¸r P-Anteil LRSHK5.30" SWORD fak_sw_b1 1 100 -1 0.999969 FORMAT "%8.6" ECU_ADDRESS 0x5B92E2 /end MEASUREMENT
/begin MEASUREMENT dlsd_w "D‰mpfung PT2-Filter in Lastschlagd‰mpfung" UWORD fak_uw_b2 1 100 0 1.99997 FORMAT "%8.6" ECU_ADDRESS 0x5B9378 /end MEASUREMENT
/begin MEASUREMENT dmaufr_w "Delta Aufregelmoment" UWORD rel_uw_b100 1 100 0 99.9985 FORMAT "%8.5" ECU_ADDRESS 0x5B9498 /end MEASUREMENT
/begin MEASUREMENT dmdpo_w "delta Moment Dashpot-Ausloesung" SWORD rel_sw_b100 1 100 -100 99.9969 FORMAT "%8.4" ECU_ADDRESS 0x5B937A /end MEASUREMENT
/begin MEASUREMENT dmdpu_w "delta Moment Dashpot-Ende" SWORD rel_sw_b100 1 100 -100 99.9969 FORMAT "%8.4" ECU_ADDRESS 0x5B937C /end MEASUREMENT
/begin MEASUREMENT dmdwan_w "" UWORD rel_uw_b200 1 100 0 199.997 FORMAT "%8.4" ECU_ADDRESS 0x5B9340 /end MEASUREMENT
/begin MEASUREMENT dmlsdo_w "Delta Moment Auslˆsung Lastschlagd‰mpfung" SWORD rel_sw_b100 1 100 -100 99.9969 FORMAT "%8.4" ECU_ADDRESS 0x5B937E /end MEASUREMENT
/begin MEASUREMENT dmlsdu_w "Delta Moment Ende Lastschlagd‰mpfung" SWORD rel_sw_b100 1 100 -100 99.9969 FORMAT "%8.4" ECU_ADDRESS 0x5B9380 /end MEASUREMENT
/begin MEASUREMENT dmrac "Reservemoment f¸r AC-Kompressor" UBYTE rel_ub_b99p6 1 100 0 99.6094 FORMAT "%5.2" ECU_ADDRESS 0x5B8F91 /end MEASUREMENT
/begin MEASUREMENT dmrkt_w "Momentenreserve im Kurztrip" UWORD rel_uw_b100 1 100 0 99.9985 FORMAT "%8.5" ECU_ADDRESS 0x5B88FC /end MEASUREMENT
/begin MEASUREMENT dmrmx_w "Delta-Moment F¸llung durch Momentenreserve" UWORD rel_uw_b100 1 100 0 99.9985 FORMAT "%8.5" ECU_ADDRESS 0x5B93E4 /end MEASUREMENT
/begin MEASUREMENT dmrwan "Momentreserve f¸r Drehmomentaufnahme des Wandlers" UBYTE rel_ub_b99p6 1 100 0 99.6094 FORMAT "%5.2" ECU_ADDRESS 0x5B8F95 /end MEASUREMENT
/begin MEASUREMENT dmvadfk_w "Delta-Motordrehmoment aus Verlustmoment-Adaption (B_fs=1 & B_ko=1)" SWORD rel_sw_b100 1 100 -100 99.9969 FORMAT "%8.4" ECU_ADDRESS 0x3FE948 /end MEASUREMENT
/begin MEASUREMENT dmvadfs_w "Delta-Motordrehmoment aus Verlustmoment-Adaption (B_fs=1)" SWORD rel_sw_b100 1 100 -100 99.9969 FORMAT "%8.4" ECU_ADDRESS 0x3FE94A /end MEASUREMENT
/begin MEASUREMENT dmvadko_w "Delta-Motordrehmoment aus Verlustmoment-Adaption (B_ko=1)" SWORD rel_sw_b100 1 100 -100 99.9969 FORMAT "%8.4" ECU_ADDRESS 0x3FE94C /end MEASUREMENT
/begin MEASUREMENT dmvadll_w "Delta-Motordrehmoment aus Verlustmoment-Adaption (B_ll=1)" SWORD rel_sw_b100 1 100 -100 99.9969 FORMAT "%8.4" ECU_ADDRESS 0x3FE94E /end MEASUREMENT
/begin MEASUREMENT dmvad_w "Delta-Motordrehmoment aus Verlustmoment-Adaption" SWORD rel_sw_b100 1 100 -100 99.9969 FORMAT "%8.4" ECU_ADDRESS 0x5B88DA /end MEASUREMENT
/begin MEASUREMENT dmvamnfk_w "Minimalbegrenzung der Verlustmomentadaption (B_fs=1 & B_ko=1)" SWORD rel_sw_b100 1 100 -100 99.9969 FORMAT "%8.4" ECU_ADDRESS 0x5B88DC /end MEASUREMENT
/begin MEASUREMENT dmvamnfs_w "Minimalbegrenzung der Verlustmomentadaption (B_fs=1)" SWORD rel_sw_b100 1 100 -100 99.9969 FORMAT "%8.4" ECU_ADDRESS 0x5B88DE /end MEASUREMENT
/begin MEASUREMENT dmvamnko_w "Minimalbegrenzung der Verlustmomentadaption (B_ko=1)" SWORD rel_sw_b100 1 100 -100 99.9969 FORMAT "%8.4" ECU_ADDRESS 0x5B88E0 /end MEASUREMENT
/begin MEASUREMENT dmvamnll_w "Minimalbegrenzung der Verlustmomentadaption (B_ll=1)" SWORD rel_sw_b100 1 100 -100 99.9969 FORMAT "%8.4" ECU_ADDRESS 0x5B88E2 /end MEASUREMENT
/begin MEASUREMENT dmvamxfk_w "0aximalbegrenzung der Verlustmomentadaption (B_fs=1 & B_ko=1)" SWORD rel_sw_b100 1 100 -100 99.9969 FORMAT "%8.4" ECU_ADDRESS 0x5B88E4 /end MEASUREMENT
/begin MEASUREMENT dmvamxfs_w "Maximalbegrenzung der Verlustmomentadaption (B_fs=1)" SWORD rel_sw_b100 1 100 -100 99.9969 FORMAT "%8.4" ECU_ADDRESS 0x5B88E6 /end MEASUREMENT
/begin MEASUREMENT dmvamxko_w "Maximalbegrenzung der Verlustmomentadaption (B_ko=1)" SWORD rel_sw_b100 1 100 -100 99.9969 FORMAT "%8.4" ECU_ADDRESS 0x5B88E8 /end MEASUREMENT
/begin MEASUREMENT dmvamxll_w "Maximalbegrenzung der Verlustmomentadaption (B_ll=1)" SWORD rel_sw_b100 1 100 -100 99.9969 FORMAT "%8.4" ECU_ADDRESS 0x5B88EA /end MEASUREMENT
/begin MEASUREMENT dmverl_w "Verlustmoment nach DT1-Filter" SWORD rel_sw_b100 1 100 -100 99.9969 FORMAT "%8.4" ECU_ADDRESS 0x5B932E /end MEASUREMENT
/begin MEASUREMENT dmzms_w "Abstand des indizierten Sollmoments vom zul‰ssigen Sollmoment" SWORD rel_sw_b100 1 100 -100 99.9969 FORMAT "%8.4" ECU_ADDRESS 0x5B93D4 /end MEASUREMENT
/begin MEASUREMENT dnturb_w "Turbinendrehzahldifferenz des Wandlers" SWORD nmot_q0p125 1 100 -4096 4095.88 FORMAT "%8.3" ECU_ADDRESS 0x5B9342 /end MEASUREMENT
/begin MEASUREMENT dpsfaktd "Faktor Saugrohrdruck f¸r gedrosselt, teilgedrosselt, ungedrosselt" UBYTE fak_ub_q0p00392 1 100 0 1 FORMAT "%5.3" ECU_ADDRESS 0x5B8CB3 /end MEASUREMENT
/begin MEASUREMENT drlsol_w "ƒnderung Sollf¸llung" SWORD rel_sw_q0p0234 1 100 -768 767.977 FORMAT "%8.4" ECU_ADDRESS 0x5B916E /end MEASUREMENT
/begin MEASUREMENT dtvka "Delta-tv f¸r Katalysator-Ausr‰umen" SBYTE t100msxs_sb_q0p01 1 100 -1.28 1.27 FORMAT "%5.3" ECU_ADDRESS 0x5B8F7C /end MEASUREMENT
/begin MEASUREMENT dtvkai "Delta-tv f¸r Katalysator-Ausr‰umen, lokale Verwendung" SBYTE t100msxs_sb_q0p01 1 100 -1.28 1.27 FORMAT "%5.3" ECU_ADDRESS 0x5B8F7D /end MEASUREMENT
/begin MEASUREMENT dzwagr "delta Z¸ndwinkel bei B_AGR=1 (AGR aktiv)" SBYTE zw_sb_q0p75 1 100 -96 95.25 FORMAT "%5.2" ECU_ADDRESS 0x5B8F9E /end MEASUREMENT
/begin MEASUREMENT dzwb "Differenz BasisZW optimaler Z¸ndwinkel" SBYTE zw_sb_q0p75 1 100 -96 95.25 FORMAT "%5.2" ECU_ADDRESS 0x5B8F9F /end MEASUREMENT
/begin MEASUREMENT dzwi "Delta Z¸ndwinkel zwischen zwopt und zwout" SBYTE zw_sb_q0p75 1 100 -96 95.25 FORMAT "%5.2" ECU_ADDRESS 0x5B8FAC /end MEASUREMENT
/begin MEASUREMENT dzwkoef "Koeffizient auf delta Z¸ndwinkel" UBYTE fak_q0p0439 1 100 0 11.1961 FORMAT "%5.2" ECU_ADDRESS 0x5B88F0 /end MEASUREMENT
/begin MEASUREMENT dzwkoefkt "" UBYTE fak_q0p0439 1 100 0 11.1961 FORMAT "%5.2" ECU_ADDRESS 0x5B88F1 /end MEASUREMENT
/begin MEASUREMENT dzwkoeft "" UBYTE fak_q0p0439 1 100 0 11.1961 FORMAT "%5.2" ECU_ADDRESS 0x5B88F2 /end MEASUREMENT
/begin MEASUREMENT dzwkoeftnf "" UBYTE fak_q0p0439 1 100 0 11.1961 FORMAT "%5.2" ECU_ADDRESS 0x5B88F3 /end MEASUREMENT
/begin MEASUREMENT dzwkoefwt "" UBYTE fak_q0p0439 1 100 0 11.1961 FORMAT "%5.2" ECU_ADDRESS 0x5B88F4 /end MEASUREMENT
/begin MEASUREMENT dzwoag "abgasr¸ckf¸hrratenabh. Z¸ndwinkelkorrektur des optimalen ZW" SBYTE zw_sb_q0p75 1 100 -96 95.25 FORMAT "%5.2" ECU_ADDRESS 0x5B8FA0 /end MEASUREMENT
/begin MEASUREMENT dzwol "lambdaabh. Z¸ndwinkelkorrektur des optimalen ZW" SBYTE zw_sb_q0p75 1 100 -96 95.25 FORMAT "%5.2" ECU_ADDRESS 0x5B8FA1 /end MEASUREMENT
/begin MEASUREMENT dzwotm "temperaturabh‰ngige Z¸ndwinkelkorrektur des optimalen ZW" SBYTE zw_sb_q0p75 1 100 -96 95.25 FORMAT "%5.2" ECU_ADDRESS 0x5B8FA2 /end MEASUREMENT
/begin MEASUREMENT dzws "Delta Z¸ndwinekl zwischen zwopt und zwsol" SBYTE zw_sb_q0p75 1 100 -96 95.25 FORMAT "%5.2" ECU_ADDRESS 0x5B8FF5 /end MEASUREMENT
/begin MEASUREMENT dzwssq "Delta Z¸ndwinkel (quadratisch) zwischen zwopt und zwsol" UBYTE kwq_ub_q0p35576 1 100 0 90.72 FORMAT "%5.2" ECU_ADDRESS 0x5B8A8C /end MEASUREMENT
/begin MEASUREMENT dzwssql "Delta Z¸ndwinkel (quadratisch) zwischen zwopt und zwsol unterer Bereich" UBYTE kwq_ub_q0p04447 1 100 0 11.34 FORMAT "%5.2" ECU_ADDRESS 0x5B8A8D /end MEASUREMENT
/begin MEASUREMENT Esprll "Soll-Einlassspreizung im Leerlauf" UBYTE sprzi_q0p8 1 100 0 204 FORMAT "%5.1" ECU_ADDRESS 0x5B8CAE /end MEASUREMENT
/begin MEASUREMENT esst_smk06mduw "" ULONG dez 1 100 0 4.29497e+009 FORMAT "%13.2" ECU_ADDRESS 0x5B9A84 /end MEASUREMENT
/begin MEASUREMENT esst_smo08opub "" ULONG dez 1 100 0 4.29497e+009 FORMAT "%13.2" ECU_ADDRESS 0x5B9A88 /end MEASUREMENT
/begin MEASUREMENT esst_srl16opuw "" ULONG dez 1 100 0 4.29497e+009 FORMAT "%13.2" ECU_ADDRESS 0x5B9A80 /end MEASUREMENT
/begin MEASUREMENT etabasf_w "Gefiltertes etabas_w" UWORD rel_uw_b100 1 100 0 99.9985 FORMAT "%8.5" ECU_ADDRESS 0x5B9170 /end MEASUREMENT
/begin MEASUREMENT etabas_w "multiplizierter zw und lambda-Wirkungsgrad" UWORD rel_uw_b100 1 100 0 99.9985 FORMAT "%8.5" ECU_ADDRESS 0x5B9172 /end MEASUREMENT
/begin MEASUREMENT etagd "Wirkungsgrad gedrosselt in Bezug auf 100% bei ungedrosseltem Betrieb" UBYTE rel_ub_b127p5 1 100 0 127.5 FORMAT "%5.1" ECU_ADDRESS 0x5B8FA3 /end MEASUREMENT
/begin MEASUREMENT etalab "Lambda-Wirkungsgrad ohne Eingriff bezogen auf optimales Moment bei Lambda=1" UBYTE rel_ub_b127p5 1 100 0 127.5 FORMAT "%5.1" ECU_ADDRESS 0x5B8FA4 /end MEASUREMENT
/begin MEASUREMENT etatrmn "minimaler Wert in der Wirkungsgradtrommel" UBYTE rel_ub_b127p5 1 100 0 127.5 FORMAT "%5.1" ECU_ADDRESS 0x5B8FA5 /end MEASUREMENT
/begin MEASUREMENT etazaist "Ist-Zylinderausblendungswirkungsgrad" UBYTE rel_ub_b127p5 1 100 0 127.5 FORMAT "%5.1" ECU_ADDRESS 0x5B8FAD /end MEASUREMENT
/begin MEASUREMENT etazwb "Z¸ndwinkelwirkungsgrad des Basisz¸ndwinkels" UBYTE rel_ub_b127p5 1 100 0 127.5 FORMAT "%5.1" ECU_ADDRESS 0x5B8FA6 /end MEASUREMENT
/begin MEASUREMENT etazwbm "gemittelter Z¸ndwinkelwirkungsgrad des Basisz¸ndwinkels" UBYTE rel_ub_b127p5 1 100 0 127.5 FORMAT "%5.1" ECU_ADDRESS 0x5B8FA7 /end MEASUREMENT
/begin MEASUREMENT etazwist "Ist-Z¸ndwinkelwirkungsgrad" UBYTE rel_ub_b127p5 1 100 0 127.5 FORMAT "%5.1" ECU_ADDRESS 0x5B8FAE /end MEASUREMENT
/begin MEASUREMENT etazws "Sollz¸ndwinkelwirkungsgrad" UBYTE rel_ub_b127p5 1 100 0 127.5 FORMAT "%5.1" ECU_ADDRESS 0x5B8FF6 /end MEASUREMENT
/begin MEASUREMENT favkatmx "Gewichtungsfaktor Sauerstoffspeicher ¸ber avkatf" UBYTE fak_ub_b1 1 100 0 0.996094 ECU_ADDRESS 0x5B88B0 /end MEASUREMENT
/begin MEASUREMENT fdmfbt "Faktor zur ‹berblendung ungedrosselt - teilgedrosselt - gedrosselt" UBYTE fak_ub_b1 1 100 0 0.996094 ECU_ADDRESS 0x5B8FAA /end MEASUREMENT
/begin MEASUREMENT ffri "LR mit Integratorstop : Gewichtungsfaktor I-Steigung bei langsamer Sonde" UBYTE fak_ub_b4 1 100 0 3.98438 FORMAT "%5.3" ECU_ADDRESS 0x5B88AA /end MEASUREMENT
/begin MEASUREMENT ffrip_w "Gewichtungsfaktor I-Steigung und P-Sprung zur Ver‰nderung der Reglerdynamik" UWORD fak_uw_b8 1 100 0 7.99988 FORMAT "%8.6" ECU_ADDRESS 0x5B88AC /end MEASUREMENT
/begin MEASUREMENT flglrs "CARB FREEZE FRAME Byte, Bank 1, f¸r LR" UBYTE dez 1 100 0 255 FORMAT "%5.1" ECU_ADDRESS 0x5B8F6F /end MEASUREMENT
/begin MEASUREMENT flglrs2 "CARB FREEZE FRAME Byte, Bank 2, f¸r LR" UBYTE dez 1 100 0 255 FORMAT "%5.1" ECU_ADDRESS 0x5B8F70 /end MEASUREMENT
/begin MEASUREMENT fmibgrv_w "Regelfaktor f¸r Korrektur gangabh‰ngige Momentenbegrenzung vor Filterung" UWORD fak_uw_b2 1 100 0 1.99997 FORMAT "%8.6" ECU_ADDRESS 0x5B93C0 /end MEASUREMENT
/begin MEASUREMENT fmibgr_w "Regelfaktor f¸r Korrektur gangabh‰ngige Momentenbegrenzung" UWORD fak_uw_b2 1 100 0 1.99997 FORMAT "%8.6" ECU_ADDRESS 0x5B93C2 /end MEASUREMENT
/begin MEASUREMENT fmil_w "Faktor rel/ind Moment" UWORD rel_uw_b200 1 100 0 199.997 FORMAT "%8.4" ECU_ADDRESS 0x5B9382 /end MEASUREMENT
/begin MEASUREMENT fmknul "" UWORD fak_uw_b2 1 100 3.05176e-005 1.99997 FORMAT "%8.6" ECU_ADDRESS 0x5B9384 /end MEASUREMENT
/begin MEASUREMENT fnstab_w "Faktor zur Stabilisierung mittels Drehzahlquotient" UWORD fak_uw_b8 1 100 0 7.99988 FORMAT "%8.6" ECU_ADDRESS 0x5B974A /end MEASUREMENT
/begin MEASUREMENT fnsta_in "Source f¸r FNSTABNV" UWORD fak_uw_b8 1 100 0 7.99988 FORMAT "%8.6" ECU_ADDRESS 0x5B974C /end MEASUREMENT
/begin MEASUREMENT fnwll "Gewichtungsfaktor fuer zwoptLL" UBYTE fak_ub_b1 1 100 0 0.996094 ECU_ADDRESS 0x5B8CAF /end MEASUREMENT
/begin MEASUREMENT fnwlleff "Gewichtungsfaktor fuer zwoptLL" UBYTE fak_ub_b1 1 100 0 0.996094 ECU_ADDRESS 0x5B8CB0 /end MEASUREMENT
/begin MEASUREMENT fqml "TA-Frequenz E-L¸fter" UBYTE freq_q1 1 100 0 255 FORMAT "%5.1" ECU_ADDRESS 0x5B8AB8 /end MEASUREMENT
/begin MEASUREMENT fr2_w "Lambda-Regler-Ausgang; Bank2 (Word)" UWORD fak_uw_b2 1 100 0 1.99997 FORMAT "%8.6" ECU_ADDRESS 0x5B92B6 /end MEASUREMENT
/begin MEASUREMENT fra2_w "multiplikative Gemischkorrektur der Gemischadaption (Word)" UWORD fak_uw_b2 1 100 0 1.99997 FORMAT "%8.6" ECU_ADDRESS 0x5B91E8 /end MEASUREMENT
/begin MEASUREMENT frao2_w "multipl. Gemischadaptionsfaktor oberer Lastbereich Bank 2 (Word)" UWORD fak_uw_b2 1 100 0 1.99997 FORMAT "%8.6" ECU_ADDRESS 0x3FDC30 /end MEASUREMENT
/begin MEASUREMENT frao_w "multiplikativer Gemischadaptionsfaktor oberer Lastbereich (Word)" UWORD fak_uw_b2 1 100 0 1.99997 FORMAT "%8.6" ECU_ADDRESS 0x3FDC32 /end MEASUREMENT
/begin MEASUREMENT frau2_w "multipl. Gemischadaptionsfaktor unterer mult. Bereich der Bank 2 (Word)" UWORD fak_uw_b2 1 100 0 1.99997 FORMAT "%8.6" ECU_ADDRESS 0x3FDC34 /end MEASUREMENT
/begin MEASUREMENT frau_w "multiplikativer Gemischadaptionsfaktor unterer mult. Bereich (Word)" UWORD fak_uw_b2 1 100 0 1.99997 FORMAT "%8.6" ECU_ADDRESS 0x3FDC36 /end MEASUREMENT
/begin MEASUREMENT fra_w "multiplikative Gemischkorrektur der Gemischadaption (Word)" UWORD fak_uw_b2 1 100 0 1.99997 FORMAT "%8.6" ECU_ADDRESS 0x5B91EA /end MEASUREMENT
/begin MEASUREMENT frband_w "Lambdaregelung (Zwei-Punkt) frm-Bildung,  lokale Variable im Zustandsautomat" SWORD fak_sw_b1 1 100 -1 0.999969 FORMAT "%8.6" ECU_ADDRESS 0x5B92B8 /end MEASUREMENT
/begin MEASUREMENT fri "LR mit Integratorstop : I-Steigung aus KFRI(n,tL) oder gem‰ﬂ DSLS" UBYTE fak_ub_b77p81 1 100 0 77.8198 FORMAT "%5.2" ECU_ADDRESS 0x5B8F65 /end MEASUREMENT
/begin MEASUREMENT friband_w "Lambdaregelung (Zwei-Punkt) frm-Bildung,  lokale Variable im Zustandsautomat" SWORD fak_sw_b1 1 100 -1 0.999969 FORMAT "%8.6" ECU_ADDRESS 0x5B92BA /end MEASUREMENT
/begin MEASUREMENT friint "I-Steigung aus KFRI(nmot,rL) oder gem‰ﬂ DSLS, lokale Hilfsgrˆﬂe" UBYTE fak_ub_b77p81 1 100 0 77.8198 FORMAT "%5.2" ECU_ADDRESS 0x5B8F66 /end MEASUREMENT
/begin MEASUREMENT frini2_w "Initialisierungswert f¸r Regelfaktor Lambdaregelung, Bank 2" UWORD fak_uw_b2 1 100 0 1.99997 FORMAT "%8.6" ECU_ADDRESS 0x5B92F2 /end MEASUREMENT
/begin MEASUREMENT frini_w "Initialisierungswert f¸r Regelfaktor Lambdaregelung" UWORD fak_uw_b2 1 100 0 1.99997 FORMAT "%8.6" ECU_ADDRESS 0x5B92F4 /end MEASUREMENT
/begin MEASUREMENT frint_w "Regelfaktor Lambdaregelung, Integratorausgang" UWORD fak_uw_b2 1 100 0 1.99997 FORMAT "%8.6" ECU_ADDRESS 0x5B92BC /end MEASUREMENT
/begin MEASUREMENT frm2_w "schneller Mittelwert des Lambdaregelfaktors Bank 2(Word)" UWORD fak_uw_b2 1 100 0 1.99997 FORMAT "%8.6" ECU_ADDRESS 0x5B92BE /end MEASUREMENT
/begin MEASUREMENT frmn2_w "Lambda-Regler-Ausgang Minimalwert, Bank 2" UWORD fak_uw_b2 1 100 0 1.99997 FORMAT "%8.6" ECU_ADDRESS 0x5B92C0 /end MEASUREMENT
/begin MEASUREMENT frmn_w "Lambda-Regler-Ausgang Minimalwert" UWORD fak_uw_b2 1 100 0 1.99997 FORMAT "%8.6" ECU_ADDRESS 0x5B92C2 /end MEASUREMENT
/begin MEASUREMENT frmx2_w "LR Bank 2: Max. Begrenzung Integrator fr,; FRMAX / angehoben d.DSLS" UWORD fak_uw_b2 1 100 0 1.99997 FORMAT "%8.6" ECU_ADDRESS 0x5B92C4 /end MEASUREMENT
/begin MEASUREMENT frmx_w "LR mit Integratorstop : Max. Begrenzung Integrator fr,; FRMAX / angehoben d.DSLS" UWORD fak_uw_b2 1 100 0 1.99997 FORMAT "%8.6" ECU_ADDRESS 0x5B92C6 /end MEASUREMENT
/begin MEASUREMENT frm_w "schneller Mittelwert des Lambdaregelfaktors (Word)" UWORD fak_uw_b2 1 100 0 1.99997 FORMAT "%8.6" ECU_ADDRESS 0x5B92C8 /end MEASUREMENT
/begin MEASUREMENT frp "LR mit Integratorstop : P-Sprung aus KFRP(n,tL) oder 0 bei DSLS aktiv" UBYTE fak_ub_b12p45 1 100 0 12.4512 FORMAT "%5.2" ECU_ADDRESS 0x5B8F67 /end MEASUREMENT
/begin MEASUREMENT frpint "P-Sprung aus KFRP(nmot,rL) oder gem‰ﬂ DSLS, lokale Hilfsgrˆﬂe" UBYTE fak_ub_b12p45 1 100 0 12.4512 FORMAT "%5.2" ECU_ADDRESS 0x5B8F68 /end MEASUREMENT
/begin MEASUREMENT frsp_w "Zweipunktregelung: Regelfaktor fr vor Sprung (Max-/Min-Wert)" UWORD fak_uw_b2 1 100 0 1.99997 FORMAT "%8.6" ECU_ADDRESS 0x5B92CA /end MEASUREMENT
/begin MEASUREMENT frtv "tv-Zeit aus KFRTV(nmot,rL) oder gem‰ﬂ DSLS" SBYTE t10msxs_sb_q0p01 1 100 -1.28 1.27 FORMAT "%5.3" ECU_ADDRESS 0x5B8F69 /end MEASUREMENT
/begin MEASUREMENT fr_w "Lambda-Regler-Ausgang (Word)" UWORD fak_uw_b2 1 100 0 1.99997 FORMAT "%8.6" ECU_ADDRESS 0x5B92CC /end MEASUREMENT
/begin MEASUREMENT ftv "Faktor Bewertung tv-Korrektur Regelung hinter Kat" UBYTE fak_ub_b2 1 100 0 1.99219 FORMAT "%5.3" ECU_ADDRESS 0x5B8F72 /end MEASUREMENT
/begin MEASUREMENT fwuell "Summenverh‰ltnis LL-Sollspreizungen zu aktuellen Ist-Spreizungen" UBYTE fak_ub_b2 1 100 0 1.99219 FORMAT "%5.3" ECU_ADDRESS 0x5B8CB1 /end MEASUREMENT
/begin MEASUREMENT fznwll "Faktor Ausblendung der zwopt LL-Umschaltung" UBYTE fak_ub_b1 1 100 0 0.996094 ECU_ADDRESS 0x5B8CB2 /end MEASUREMENT
/begin MEASUREMENT iavkatf "Kl-Source: gef. Amplitudenverh‰ltnis hinter/vor Katalysator" UBYTE fak_ub_b1 1 100 0 0.996094 ECU_ADDRESS 0x5B8F73 /end MEASUREMENT
/begin MEASUREMENT idlashkm_w "KL-Source: Delta-Lambda aus Lambdareg. h. Kat (Ist-Wert fr-synchron gemittelt)" SWORD fak_sw_b1 1 100 -1 0.999969 FORMAT "%8.6" ECU_ADDRESS 0x5B92E4 /end MEASUREMENT
/begin MEASUREMENT ilmlkah_w "Gewichteter Integrator Fettfl‰che f¸r Ausr‰umen Haupt-kat" UWORD m_uw_b4660 1 100 0 4660.27 FORMAT "%8.3" ECU_ADDRESS 0x5B92F6 /end MEASUREMENT
/begin MEASUREMENT ilmlkam_w "Gewichteter Integrator Sauerstoffeintrag in den Hauptkat" UWORD m_uw_b4660 1 100 0 4660.27 FORMAT "%8.3" ECU_ADDRESS 0x5B92F8 /end MEASUREMENT
/begin MEASUREMENT ilmlkat_w "G¸ltig gemessener Wert des Sauerstoffspeichers" UWORD m_uw_b4660 1 100 0 4660.27 FORMAT "%8.3" ECU_ADDRESS 0x5B92FA /end MEASUREMENT
/begin MEASUREMENT ilmlkav_w "Gewichteter Integrator Fettfl‰che nach Ende Ausr‰umen Vorkat" UWORD m_uw_b4660 1 100 0 4660.27 FORMAT "%8.3" ECU_ADDRESS 0x5B92FC /end MEASUREMENT
/begin MEASUREMENT ilmlkax_w "Fettfl‰chenschwelle gesteuertes Kat-Ausr‰umen f(tkatm), Bank 1" UWORD m_uw_b4660 1 100 0 4660.27 FORMAT "%8.3" ECU_ADDRESS 0x5B92FE /end MEASUREMENT
/begin MEASUREMENT ilmlka_w "Integrator Fettfl‰che f¸r Katalysator-Ausr‰umen" UWORD m_uw_b4660 1 100 0 4660.27 FORMAT "%8.3" ECU_ADDRESS 0x5B9300 /end MEASUREMENT
/begin MEASUREMENT imlkav_w "Gewichteter Integrator Luftmasse bei Ende Ausr‰umen Vorkat" UWORD m_uw_b4660 1 100 0 4660.27 FORMAT "%8.3" ECU_ADDRESS 0x5B9302 /end MEASUREMENT
/begin MEASUREMENT imlkax_w "Luftmassenschwelle geregeltes Kat-Ausr‰umen f(tkatm), Bank 1" UWORD m_uw_b4660 1 100 0 4660.27 FORMAT "%8.3" ECU_ADDRESS 0x5B9304 /end MEASUREMENT
/begin MEASUREMENT imlka_w "Integrator Luftmasse f¸r Katalysator-Ausr‰umen" UWORD m_uw_b4660 1 100 0 4660.27 FORMAT "%8.3" ECU_ADDRESS 0x5B9306 /end MEASUREMENT
/begin MEASUREMENT imlrsa_w "Luftmasse nach SA f¸r stetige Lambdaregelung" UWORD m_uw_b4660 1 100 0 4660.27 FORMAT "%8.3" ECU_ADDRESS 0x5B92DA /end MEASUREMENT
/begin MEASUREMENT iwflsd_w "Initialisierungswert Filter Lastschlagd‰mpfung" UWORD rel_uw_b100 1 100 0 99.9985 FORMAT "%8.5" ECU_ADDRESS 0x5B9386 /end MEASUREMENT
/begin MEASUREMENT lahkmz "Zustandsbyte des Automaten: fr-synchrone Mittelung Pseodo-Lambda hinter Kat" UBYTE dez 1 100 0 255 FORMAT "%5.1" ECU_ADDRESS 0x5B8F74 /end MEASUREMENT
/begin MEASUREMENT lamhf_w "Pseudolinearisietes Lambda hinter Kat, PT1-gefiltert, Word" UWORD fak_uw_b16 1 100 0 15.9998 FORMAT "%8.5" ECU_ADDRESS 0x5B92E6 /end MEASUREMENT
/begin MEASUREMENT lamhm_w "fr-synchron gemittelter Pseudo Lambda-Istwert gem. mit Nernst-Sonde h.Kat, Word" UWORD fak_uw_b16 1 100 0 15.9998 FORMAT "%8.5" ECU_ADDRESS 0x5B92E8 /end MEASUREMENT
/begin MEASUREMENT lamkaii_w "Lambdasollwert Katausr‰umen, lokaler Zwischenwert" UWORD fak_uw_b16 1 100 0 15.9998 FORMAT "%8.5" ECU_ADDRESS 0x5B9308 /end MEASUREMENT
/begin MEASUREMENT lamkai_w "Lambdasollwert Katausr‰umen, Kennfeldwert" UWORD fak_uw_b16 1 100 0 15.9998 FORMAT "%8.5" ECU_ADDRESS 0x5B930A /end MEASUREMENT
/begin MEASUREMENT lamka_w "Lambdasollwert Katausr‰umen" UWORD fak_uw_b16 1 100 0 15.9998 FORMAT "%8.5" ECU_ADDRESS 0x5B930C /end MEASUREMENT
/begin MEASUREMENT lamsnka_w "Lambda-Sollwert interne Auswertung in LRKA" UWORD fak_uw_b16 1 100 0 15.9998 FORMAT "%8.5" ECU_ADDRESS 0x5B930E /end MEASUREMENT
/begin MEASUREMENT lamsolh_w "Pseudo Lambda-Sollwert hinter Kat" UWORD fak_uw_b16 1 100 0 15.9998 FORMAT "%8.5" ECU_ADDRESS 0x5B92EA /end MEASUREMENT
/begin MEASUREMENT lamsonh_w "Pseudo Lambda-Istwert gemessen mit Nernst-Sonde hinter Kat (word)" UWORD fak_uw_b16 1 100 0 15.9998 FORMAT "%8.5" ECU_ADDRESS 0x5B92EC /end MEASUREMENT
/begin MEASUREMENT lrfrmz "Zustandsbyte des Automaten Bildung des fr-Mittelwert frm_w" UBYTE dez 1 100 0 255 FORMAT "%5.1" ECU_ADDRESS 0x5B8F6A /end MEASUREMENT
/begin MEASUREMENT lrfrz "Zustandsbyte des LR-Automaten" UBYTE dez 1 100 0 255 FORMAT "%5.1" ECU_ADDRESS 0x5B8F6B /end MEASUREMENT
/begin MEASUREMENT LRHKlokbits "" UBYTE dez 1 100 0 255 FORMAT "%5.1" ECU_ADDRESS 0x5B8F75 /end MEASUREMENT
/begin MEASUREMENT lrkaz "Zustandsbyte des Automaten Kat-Ausr‰umen" UBYTE dez 1 100 0 255 FORMAT "%5.1" ECU_ADDRESS 0x5B8F7E /end MEASUREMENT
/begin MEASUREMENT mdatxm_w "Drehmomentaufnahme des Wandlers bei B_fs = false" UWORD rel_uw_b200 1 100 0 199.997 FORMAT "%8.4" ECU_ADDRESS 0x5B9344 /end MEASUREMENT
/begin MEASUREMENT mdgen "Momentenaufnahme Generator" UBYTE rel_ub_b99p6 1 100 0 99.6094 FORMAT "%5.2" ECU_ADDRESS 0x5B8F92 /end MEASUREMENT
/begin MEASUREMENT mdgen_w "Generatormoment" UWORD rel_uw_b100 1 100 0 99.9985 FORMAT "%8.5" ECU_ADDRESS 0x5B933C /end MEASUREMENT
/begin MEASUREMENT mdindg_w "indiziertes Motormoment Hochdruckphase wenn alle Zylinder befeuert" UWORD rel_uw_b100 1 100 0 99.9985 FORMAT "%8.5" ECU_ADDRESS 0x5B93CC /end MEASUREMENT
/begin MEASUREMENT mdko "Momentenaufnahme Klimakompressor" UBYTE rel_ub_b99p6 1 100 0 99.6094 FORMAT "%5.2" ECU_ADDRESS 0x5B8F93 /end MEASUREMENT
/begin MEASUREMENT mdsh_aus "" SBYTE rel_q0p1957 1 100 -25.0489 24.8532 FORMAT "%5.2" ECU_ADDRESS 0x5B8F90 /end MEASUREMENT
/begin MEASUREMENT mdsm_w "Schleppmoment Temperatur-Anteil" UWORD rel_uw_b100 1 100 0 99.9985 FORMAT "%8.5" ECU_ADDRESS 0x5B9330 /end MEASUREMENT
/begin MEASUREMENT mdsvad_w "" UWORD rel_uw_b100 1 100 0 99.9985 FORMAT "%8.5" ECU_ADDRESS 0x5B9332 /end MEASUREMENT
/begin MEASUREMENT mdsw_w "Motorschleppmoment" UWORD rel_uw_b100 1 100 0 99.9985 FORMAT "%8.5" ECU_ADDRESS 0x5B9334 /end MEASUREMENT
/begin MEASUREMENT mds_w "Motorschleppmoment" UWORD rel_uw_b100 1 100 0 99.9985 FORMAT "%8.5" ECU_ADDRESS 0x5B9336 /end MEASUREMENT
/begin MEASUREMENT mdverb "Momentenbedarf der Nebenaggregate" UBYTE rel_ub_b99p6 1 100 0 99.6094 FORMAT "%5.2" ECU_ADDRESS 0x5B8F94 /end MEASUREMENT
/begin MEASUREMENT mdverbfa_w "" SWORD rel_sw_b100 1 100 -100 99.9969 FORMAT "%8.4" ECU_ADDRESS 0x5B9388 /end MEASUREMENT
/begin MEASUREMENT mdverb_w "Momentenbedarf der Nebenaggregate" UWORD rel_uw_b100 1 100 0 99.9985 FORMAT "%8.5" ECU_ADDRESS 0x5B933E /end MEASUREMENT
/begin MEASUREMENT mdverf_w "Gefiltertes Verlustmoment" UWORD rel_uw_b100 1 100 0 99.9985 FORMAT "%8.5" ECU_ADDRESS 0x5B9338 /end MEASUREMENT
/begin MEASUREMENT mdverl_w "Motor-Verlustmoment" UWORD rel_uw_b100 1 100 0 99.9985 FORMAT "%8.5" ECU_ADDRESS 0x5B933A /end MEASUREMENT
/begin MEASUREMENT mdwanvf_w "Drehmomentaufnahme des Wandlers vor Filterung" UWORD rel_uw_b200 1 100 0 199.997 FORMAT "%8.4" ECU_ADDRESS 0x5B9346 /end MEASUREMENT
/begin MEASUREMENT mdwan_w "Drehmomentaufnahme des Wandlers" UWORD rel_uw_b200 1 100 0 199.997 FORMAT "%8.4" ECU_ADDRESS 0x5B9348 /end MEASUREMENT
/begin MEASUREMENT meist_w "" UWORD md_q0p5 1 100 0 32767.5 FORMAT "%8.2" ECU_ADDRESS 0x5B93CE /end MEASUREMENT
/begin MEASUREMENT menist_w "" UWORD rel_uw_b100 1 100 0 99.9985 FORMAT "%8.5" ECU_ADDRESS 0x5B93D0 /end MEASUREMENT
/begin MEASUREMENT mibas_w "indiziertes Basis-Moment" UWORD rel_uw_b100 1 100 0 99.9985 FORMAT "%8.5" ECU_ADDRESS 0x5B936E /end MEASUREMENT
/begin MEASUREMENT mibdp_w "indiziertes Soll-Motormoment Dashpot" UWORD rel_uw_b100 1 100 0 99.9985 FORMAT "%8.5" ECU_ADDRESS 0x5B938A /end MEASUREMENT
/begin MEASUREMENT mibeg_w "Begrenzungsmoment" UWORD rel_uw_b100 1 100 0 99.9985 FORMAT "%8.5" ECU_ADDRESS 0x5B93D6 /end MEASUREMENT
/begin MEASUREMENT mibgrv_w "indiziertes soll-Moment f¸r gangabh‰ngige Momentenbegrenzung vor Regelung" UWORD rel_uw_b100 1 100 0 99.9985 FORMAT "%8.5" ECU_ADDRESS 0x5B93C4 /end MEASUREMENT
/begin MEASUREMENT mibgr_w "indiziertes soll-Moment f¸r gangabh‰ngige Kupplungsmomentbegrenzung" UWORD rel_uw_b100 1 100 0 99.9985 FORMAT "%8.5" ECU_ADDRESS 0x5B93C6 /end MEASUREMENT
/begin MEASUREMENT miblsd_w "Begrenztes indiziertes Moment aus Lastschlagd‰mpfung" UWORD rel_uw_b100 1 100 0 99.9985 FORMAT "%8.5" ECU_ADDRESS 0x5B938C /end MEASUREMENT
/begin MEASUREMENT miextv_w "von extern gefordertes Moment vor Abw¸rgeschutz" UWORD rel_uw_b100 1 100 0 99.9985 FORMAT "%8.5" ECU_ADDRESS 0x5B93D8 /end MEASUREMENT
/begin MEASUREMENT miext_w "von auﬂen (ASR, GS, usw.) angefordertes indiziertes Motormoment" UWORD rel_uw_b100 1 100 0 99.9985 FORMAT "%8.5" ECU_ADDRESS 0x5B93DA /end MEASUREMENT
/begin MEASUREMENT mifa "indiziertes Motormoment Fahrerwunsch" UBYTE rel_ub_b99p6 1 100 0 99.6094 FORMAT "%5.2" ECU_ADDRESS 0x5B8FAB /end MEASUREMENT
/begin MEASUREMENT mifab_w "Begrenztes indiziertes Fahrerwunschmoment" UWORD rel_uw_b100 1 100 0 99.9985 FORMAT "%8.5" ECU_ADDRESS 0x5B93DC /end MEASUREMENT
/begin MEASUREMENT mifafu_w "Fahrermomentenwunsch f¸r F¸llung" UWORD rel_uw_b100 1 100 0 99.9985 FORMAT "%8.5" ECU_ADDRESS 0x5B93E6 /end MEASUREMENT
/begin MEASUREMENT mifal_w "Indiziertes Fahrerwunschmoment f¸r Momentenkoordination F¸llung" UWORD rel_uw_b100 1 100 0 99.9985 FORMAT "%8.5" ECU_ADDRESS 0x5B938E /end MEASUREMENT
/begin MEASUREMENT mifa_w "indiziertes Motormoment Fahrerwunsch" UWORD rel_uw_b100 1 100 0 99.9985 FORMAT "%8.5" ECU_ADDRESS 0x5B9390 /end MEASUREMENT
/begin MEASUREMENT migef_w "Gefiltertes indiziertes Fahrerwunschmoment" UWORD rel_uw_b100 1 100 0 99.9985 FORMAT "%8.5" ECU_ADDRESS 0x5B9392 /end MEASUREMENT
/begin MEASUREMENT miges_w "Indiziertes Soll-Motormoment f¸r Getriebeschutz" UWORD rel_uw_b100 1 100 0 99.9985 FORMAT "%8.5" ECU_ADDRESS 0x5B93C8 /end MEASUREMENT
/begin MEASUREMENT miist_w "indiziertes Motormoment Hochdruckphase Istwert" UWORD rel_uw_b100 1 100 0 99.9985 FORMAT "%8.5" ECU_ADDRESS 0x5B93D2 /end MEASUREMENT
/begin MEASUREMENT mil1_w "ind. Moment aus MINMAX-Auswahl" UWORD rel_uw_b100 1 100 0 99.9985 FORMAT "%8.5" ECU_ADDRESS 0x5B9394 /end MEASUREMENT
/begin MEASUREMENT mil2_w "ind. Moment aus MINMAX-Auswahl" UWORD rel_uw_b100 1 100 0 99.9985 FORMAT "%8.5" ECU_ADDRESS 0x5B9396 /end MEASUREMENT
/begin MEASUREMENT mil3_w "ind. Moment aus MINMAX-Auswahl" UWORD rel_uw_b100 1 100 0 99.9985 FORMAT "%8.5" ECU_ADDRESS 0x5B9398 /end MEASUREMENT
/begin MEASUREMENT mill_w "Indiziertes Motormoment im Leerlauf" UWORD rel_uw_b100 1 100 0 99.9985 FORMAT "%8.5" ECU_ADDRESS 0x5B932A /end MEASUREMENT
/begin MEASUREMENT milres_w "Momentenanforderung f¸r Luftpfad mit allen Reserven" UWORD rel_uw_b100 1 100 0 99.9985 FORMAT "%8.5" ECU_ADDRESS 0x5B93E8 /end MEASUREMENT
/begin MEASUREMENT milsol_w "Fahrermomentenwunsch f¸r F¸llung" UWORD rel_uw_b100 1 100 0 99.9985 FORMAT "%8.5" ECU_ADDRESS 0x5B93EA /end MEASUREMENT
/begin MEASUREMENT mimax_w "maximal erreichbares indiziertes Moment" UWORD rel_uw_b100 1 100 0 99.9985 FORMAT "%8.5" ECU_ADDRESS 0x5B93EC /end MEASUREMENT
/begin MEASUREMENT mimin_w "Minimales Motor-Moment" UWORD rel_uw_b100 1 100 0 99.9985 FORMAT "%8.5" ECU_ADDRESS 0x5B932C /end MEASUREMENT
/begin MEASUREMENT mimxl1_w "Maximales optimales Moment bei Lambda = 1" UWORD rel_uw_b100 1 100 0 99.9985 FORMAT "%8.5" ECU_ADDRESS 0x5B93EE /end MEASUREMENT
/begin MEASUREMENT minbeg_w "Indiziertes Fahrerwunschmoment nach ƒnderungsbegrenzung" UWORD rel_uw_b100 1 100 0 99.9985 FORMAT "%8.5" ECU_ADDRESS 0x5B939A /end MEASUREMENT
/begin MEASUREMENT mioptl1_w "optimales indiziertes Motormoment bei Lambda = 1" UWORD rel_uw_b100 1 100 0 99.9985 FORMAT "%8.5" ECU_ADDRESS 0x5B9370 /end MEASUREMENT
/begin MEASUREMENT mioptugd_w "optimales indiziertes Moment ungedrosselt" UWORD rel_uw_b100 1 100 0 99.9985 FORMAT "%8.5" ECU_ADDRESS 0x5B9372 /end MEASUREMENT
/begin MEASUREMENT miopt_w "optimales indiziertes Moment" UWORD rel_uw_b100 1 100 0 99.9985 FORMAT "%8.5" ECU_ADDRESS 0x5B9374 /end MEASUREMENT
/begin MEASUREMENT misolv_w "Indiziertes resultierendes Sollmoment vor Momentenbegrenzung" UWORD rel_uw_b100 1 100 0 99.9985 FORMAT "%8.5" ECU_ADDRESS 0x5B93DE /end MEASUREMENT
/begin MEASUREMENT misol_w "Indiziertes resultierendes Sollmoment" UWORD rel_uw_b100 1 100 0 99.9985 FORMAT "%8.5" ECU_ADDRESS 0x3FC08C /end MEASUREMENT
/begin MEASUREMENT misopl1_w "Solluftmoment, r¸ckgerechnet auf Lambda=1 und zwopt" UWORD rel_uw_b100 1 100 0 99.9985 FORMAT "%8.5" ECU_ADDRESS 0x5B9174 /end MEASUREMENT
/begin MEASUREMENT miszul_w "Maximal zul‰ssiges indiziertes Moment" UWORD rel_uw_b100 1 100 0 99.9985 FORMAT "%8.5" ECU_ADDRESS 0x5B93F6 /end MEASUREMENT
/begin MEASUREMENT mivbeb_w "Indiziertes Moment vor ƒnderungsbegrenzung, nach oben auf mimax_w begrenzt" UWORD rel_uw_b100 1 100 0 99.9985 FORMAT "%8.5" ECU_ADDRESS 0x5B939C /end MEASUREMENT
/begin MEASUREMENT mivbeg_w "inidziertes Fahrerwunschmoment vor ƒnderungsbegrenzung" UWORD rel_uw_b100 1 100 0 99.9985 FORMAT "%8.5" ECU_ADDRESS 0x5B939E /end MEASUREMENT
/begin MEASUREMENT mizsolv_w "Indiziertes resultierendes Sollmoment f¸r ZW-Eingriff vor Momentenbegrenzung" UWORD rel_uw_b100 1 100 0 99.9985 FORMAT "%8.5" ECU_ADDRESS 0x5B93E0 /end MEASUREMENT
/begin MEASUREMENT mizsol_w "Indiziertes resultierendes Sollmoment f¸r ZW-Eingriff" UWORD rel_uw_b100 1 100 0 99.9985 FORMAT "%8.5" ECU_ADDRESS 0x5B93E2 /end MEASUREMENT
/begin MEASUREMENT mizufil_w "Zul‰ssiges indiziertes Moment nach Filter" UWORD rel_uw_b100 1 100 0 99.9985 FORMAT "%8.5" ECU_ADDRESS 0x5B93F8 /end MEASUREMENT
/begin MEASUREMENT mizuofil "Zul‰ssiges indiziertes Moment ohne Filter" UBYTE rel_ub_b99p6 1 100 0 99.6094 FORMAT "%5.2" ECU_ADDRESS 0x5B8FB5 /end MEASUREMENT
/begin MEASUREMENT mizuvfil "Zul‰ssiges indiziertes Moment vor Filter" UBYTE rel_ub_b99p6 1 100 0 99.6094 FORMAT "%5.2" ECU_ADDRESS 0x5B8FB6 /end MEASUREMENT
/begin MEASUREMENT mizwmn_w "indiziertes Motormoment beim sp‰testen Z¸ndwinkel" UWORD rel_uw_b100 1 100 0 99.9985 FORMAT "%8.5" ECU_ADDRESS 0x5B93F2 /end MEASUREMENT
/begin MEASUREMENT mi_mr_w "ind. Moment in rel. Moment" UWORD rel_uw_b200 1 100 0 199.997 FORMAT "%8.4" ECU_ADDRESS 0x5B93A0 /end MEASUREMENT
/begin MEASUREMENT mkfanb_w "Kupplungsmoment aus begrenztem Fahrerwunsch" SWORD rel_sw_b100 1 100 -100 99.9969 FORMAT "%8.4" ECU_ADDRESS 0x5B93A2 /end MEASUREMENT
/begin MEASUREMENT mlnka_w "Luftmasse nach Kat-Ausr‰umen" UWORD m_uw_b7281 1 100 0 7281.67 FORMAT "%8.3" ECU_ADDRESS 0x5B92EE /end MEASUREMENT
/begin MEASUREMENT mrfamx_w "Relatives Fahrerwunschmoment Maximalwert" UWORD rel_uw_b200 1 100 0 199.997 FORMAT "%8.4" ECU_ADDRESS 0x5B93A4 /end MEASUREMENT
/begin MEASUREMENT mrfav_w "Relatives Fahrerwunschmoment vor Ber¸cksichtigung Notfahren" UWORD rel_uw_b200 1 100 0 199.997 FORMAT "%8.4" ECU_ADDRESS 0x5B93A6 /end MEASUREMENT
/begin MEASUREMENT mrfa_w "Relatives Fahrerwunschmoment aus FGR und Pedal" UWORD rel_uw_b200 1 100 0 199.997 FORMAT "%8.4" ECU_ADDRESS 0x5B93A8 /end MEASUREMENT
/begin MEASUREMENT mrfuemx_w "max. erreichbares rel. Fahrerwunschmoment f¸r Pedal¸berweg" UWORD rel_uw_b200 1 100 0 199.997 FORMAT "%8.4" ECU_ADDRESS 0x5B93AA /end MEASUREMENT
/begin MEASUREMENT mrfue_w "Relatives Fahrerwunschmoment im Pedal¸berweg" UWORD rel_uw_b200 1 100 0 199.997 FORMAT "%8.4" ECU_ADDRESS 0x5B93AC /end MEASUREMENT
/begin MEASUREMENT mrpedv_w "relatives Fahrerwunschmoment aus Fahrpedalkennfeld" UWORD rel_uw_b200 1 100 0 199.997 FORMAT "%8.4" ECU_ADDRESS 0x5B93AE /end MEASUREMENT
/begin MEASUREMENT mrped_w "relatives Fahrerwunschmoment aus Fahrpedal" UWORD rel_uw_b200 1 100 0 199.997 FORMAT "%8.4" ECU_ADDRESS 0x5B93B0 /end MEASUREMENT
/begin MEASUREMENT nghgs_w "gefilterter Drehzahlgradient" SWORD nmotg_sw_q0p39 1 100 -12800.2 12799.8 FORMAT "%8.2" ECU_ADDRESS 0x5B93CA /end MEASUREMENT
/begin MEASUREMENT nstatfak "" UWORD fak_uw_b8 1 100 0 7.99988 FORMAT "%8.6" ECU_ADDRESS 0x5B974E /end MEASUREMENT
/begin MEASUREMENT ntnmot_w "Quotient Wandler-Turbinendr. / Motordrehzahl" UWORD fak_uw_b4 1 100 0 3.99994 FORMAT "%8.6" ECU_ADDRESS 0x5B93B2 /end MEASUREMENT
/begin MEASUREMENT nturbv_w "Vorraussichtliche Turbinendrehzahl des Wandlers" UWORD nmot_q0p125 1 100 0 8191.88 FORMAT "%8.3" ECU_ADDRESS 0x5B934A /end MEASUREMENT
/begin MEASUREMENT nturb_w "Turbinendrehzahl des Wandlers" UWORD nmot_q0p125 1 100 0 8191.88 FORMAT "%8.3" ECU_ADDRESS 0x5B934C /end MEASUREMENT
/begin MEASUREMENT nwem_fak "" UWORD fak_uw_b8 1 100 0 7.99988 FORMAT "%8.6" ECU_ADDRESS 0x5B9750 /end MEASUREMENT
/begin MEASUREMENT percnt_w "Z‰hler 10-ms-Schritte f¸r fr-synchrone lamsolh-Mittelung" UWORD dez 1 100 0 65535 FORMAT "%8.2" ECU_ADDRESS 0x5B92F0 /end MEASUREMENT
/begin MEASUREMENT ptv "LRHK: P-Anteil f¸r verzˆgerte Reglerumschaltung tv, ungewichtet" SBYTE t100msxs_sb_q0p01 1 100 -1.28 1.27 FORMAT "%5.3" ECU_ADDRESS 0x5B8F76 /end MEASUREMENT
/begin MEASUREMENT qntns "Quotient aus Turbinendrehzahl des Wandlers und Solldrehzahl der LLR" UBYTE fak_ub_b8 1 100 0 7.96875 FORMAT "%5.3" ECU_ADDRESS 0x5B8F96 /end MEASUREMENT
/begin MEASUREMENT redhyst "Reduzierstufenhysterese" SBYTE rel_sb_q0p02 1 100 -2 1.98438 FORMAT "%5.3" ECU_ADDRESS 0x5B8FB1 /end MEASUREMENT
/begin MEASUREMENT redneu "neu berechnete Reduzierstufe" UBYTE dez 1 100 0 255 FORMAT "%5.1" ECU_ADDRESS 0x5B8FB2 /end MEASUREMENT
/begin MEASUREMENT redsol "Berechnete Soll-Reduzierstufe" UBYTE dez 1 100 0 255 FORMAT "%5.1" ECU_ADDRESS 0x5B8FB3 /end MEASUREMENT
/begin MEASUREMENT redze "Schwelle in Reduzierstufe zwischen Z¸nd- und Einspritzeingriff" UBYTE dez 1 100 0 255 FORMAT "%5.1" ECU_ADDRESS 0x5B8FB4 /end MEASUREMENT
/begin MEASUREMENT redzst_w "Reduzierstufe ohne Hysterese und Rundung" UWORD rel_uw_q0p001 1 100 0 65.535 FORMAT "%8.5" ECU_ADDRESS 0x5B93F4 /end MEASUREMENT
/begin MEASUREMENT rka2_w "Additive adaptive Korrektur der relativen Kraftstoffmasse" SWORD rel_sw_b1536 1 100 -1536 1535.95 FORMAT "%8.3" ECU_ADDRESS 0x5B91EC /end MEASUREMENT
/begin MEASUREMENT rkat2_w "additive Gemischkorrektur (pro Zeit) der Gemischadaption Bank 2 (Word)" SWORD rel_sw_b1536 1 100 -1536 1535.95 FORMAT "%8.3" ECU_ADDRESS 0x3FDC38 /end MEASUREMENT
/begin MEASUREMENT rkat_w "additive Gemischkorrektur (pro Zeit) der Gemischdaption (Word)" SWORD rel_sw_b1536 1 100 -1536 1535.95 FORMAT "%8.3" ECU_ADDRESS 0x3FDC3A /end MEASUREMENT
/begin MEASUREMENT rkaz2_w "additive Gemischkorrektur (pro Z¸ndung) der Gemischadaption Bank2 (Word)" SWORD rel_sw_b1536 1 100 -1536 1535.95 FORMAT "%8.3" ECU_ADDRESS 0x3FDC3C /end MEASUREMENT
/begin MEASUREMENT rkaz_w "additive Gemischkorrektur (pro Z¸ndung) der Gemischadaption" SWORD rel_sw_b1536 1 100 -1536 1535.95 FORMAT "%8.3" ECU_ADDRESS 0x3FDC3E /end MEASUREMENT
/begin MEASUREMENT rka_w "Additive adaptive Korrektur der relativen Kraftstoffmasse" SWORD rel_sw_b1536 1 100 -1536 1535.95 FORMAT "%8.3" ECU_ADDRESS 0x5B91EE /end MEASUREMENT
/begin MEASUREMENT rlmin_w "minimal zul‰ssiges rl" UWORD rel_uw_q0p0234 1 100 0 1535.98 FORMAT "%8.3" ECU_ADDRESS 0x5B9176 /end MEASUREMENT
/begin MEASUREMENT rlsolold_w "" UWORD rel_uw_q0p0234 1 100 0 1535.98 FORMAT "%8.3" ECU_ADDRESS 0x5B9178 /end MEASUREMENT
/begin MEASUREMENT rlsol_w "Soll-F¸llung" UWORD rel_uw_q0p0234 1 100 0 1535.98 FORMAT "%8.3" ECU_ADDRESS 0x5B917A /end MEASUREMENT
/begin MEASUREMENT rlugd_w "F¸llung im ungedrosselten Zustand" UWORD rel_uw_q0p0234 1 100 0 1535.98 FORMAT "%8.3" ECU_ADDRESS 0x5B93F0 /end MEASUREMENT
/begin MEASUREMENT rlvugd "unkorrigierte F¸llung im ungedrosselten Zustand" UBYTE rel_ub_q0p75 1 100 0 191.25 FORMAT "%5.1" ECU_ADDRESS 0x5B8FAF /end MEASUREMENT
/begin MEASUREMENT rl_kge "Eingang relative F¸llung f¸r mehrfach verwendete Kenngrˆﬂen" UBYTE rel_ub_q0p75 1 100 0 191.25 FORMAT "%5.1" ECU_ADDRESS 0x3FC057 /end MEASUREMENT
/begin MEASUREMENT rl_w_kge "Eingang relative F¸llung (Word) f¸r mehrfach verwendete Kenngr." UWORD rel_uw_q0p0234 1 100 0 1535.98 FORMAT "%8.3" ECU_ADDRESS 0x5B9376 /end MEASUREMENT
/begin MEASUREMENT snmta "St¸tzstellenkorrektur von nmot" UBYTE nmot_ub_q40 1 100 0 10200 FORMAT "%5.0" ECU_ADDRESS 0x5B8FB0 /end MEASUREMENT
/begin MEASUREMENT swOffDlBits "" UWORD dez 1 100 0 65535 FORMAT "%8.2" ECU_ADDRESS 0x3FDC90 /end MEASUREMENT
/begin MEASUREMENT S_dp "Schalter Dashpot (1=ein)" UBYTE B_TRUE 1 100 0 1 BIT_MASK 0x1 FORMAT "%13.11" ECU_ADDRESS 0x3FBF21 /end MEASUREMENT
/begin MEASUREMENT S_ls "Schalter Lastschlagd‰mpfung (1=ein)" UBYTE B_TRUE 1 100 0 1 BIT_MASK 0x1 FORMAT "%13.11" ECU_ADDRESS 0x3FBF22 /end MEASUREMENT
/begin MEASUREMENT taml "Tastverh‰ltnis E-L¸fter" UBYTE rel_ub_b100 1 100 0 100 FORMAT "%5.1" ECU_ADDRESS 0x5B8AB9 /end MEASUREMENT
/begin MEASUREMENT tamlaus "Tastverh‰ltnis Motorl¸fter nach Normierung" UBYTE rel_ub_b100 1 100 0 100 FORMAT "%5.1" ECU_ADDRESS 0x5B8ABA /end MEASUREMENT
/begin MEASUREMENT tamlausab "Tastverh‰ltnis Motorl¸fter nach Normierung und Abschaltbedingung" UBYTE rel_ub_b100 1 100 0 100 FORMAT "%5.1" ECU_ADDRESS 0x5B8ABB /end MEASUREMENT
/begin MEASUREMENT tamlkft "Ansteuerung L¸fter bei Anforderung von geregeltem Kennfeldthermostat" UBYTE rel_ub_b100 1 100 0 100 FORMAT "%5.1" ECU_ADDRESS 0x5B8ABC /end MEASUREMENT
/begin MEASUREMENT tamlnh "Tastverh‰ltnis E-L¸fter nach Hysterese (prozentuale L¸fterleistung)" UBYTE rel_ub_b100 1 100 0 100 FORMAT "%5.1" ECU_ADDRESS 0x5B8ABD /end MEASUREMENT
/begin MEASUREMENT tamlnl "Tastverh‰ltnis E-L¸fter im L¸fternachlauf" UBYTE rel_ub_b100 1 100 0 100 FORMAT "%5.1" ECU_ADDRESS 0x5B8ABE /end MEASUREMENT
/begin MEASUREMENT tamls "Tastverh‰ltnis (prozentuale L¸fterleistung)" UBYTE rel_ub_b100 1 100 0 100 FORMAT "%5.1" ECU_ADDRESS 0x5B8ABF /end MEASUREMENT
/begin MEASUREMENT tansst "Ansaugluft-Temperatur bei Start" UBYTE temp_ub_q0p75_o48 1 100 -48 143.25 FORMAT "%5.1" ECU_ADDRESS 0x5B88AE /end MEASUREMENT
/begin MEASUREMENT tfrnint_w "Z‰hler zum Ausmessen Zeitdauer Lambdaregler I-Anteil negative Steigung" UWORD t10msxs_uw_b655p35 1 100 0 655.35 FORMAT "%8.4" ECU_ADDRESS 0x5B92CE /end MEASUREMENT
/begin MEASUREMENT tfrn_w "Zeitdauer Lambdaregler I-Anteil negative Steigung" UWORD t10msxs_uw_b655p35 1 100 0 655.35 FORMAT "%8.4" ECU_ADDRESS 0x5B92D0 /end MEASUREMENT
/begin MEASUREMENT tfrpint_w "Z‰hler zur Messung der Zeitdauer Lambdaregler I-Anteil positive Steigung" UWORD t10msxs_uw_b655p35 1 100 0 655.35 FORMAT "%8.4" ECU_ADDRESS 0x5B92D2 /end MEASUREMENT
/begin MEASUREMENT tfrp_w "Zeitdauer Lambdaregler I-Anteil positive Steigung" UWORD t10msxs_uw_b655p35 1 100 0 655.35 FORMAT "%8.4" ECU_ADDRESS 0x5B92D4 /end MEASUREMENT
/begin MEASUREMENT tkadif "Differenz zwischen K¸hlwassertemperatur Soll und Ist" UBYTE temp_ub_q0p75 1 100 0 191.25 FORMAT "%5.1" ECU_ADDRESS 0x5B8AC0 /end MEASUREMENT
/begin MEASUREMENT tkatms_w "Source f¸r Kennlinie ILMLKAXTK" UWORD temp_uw_q0p0195_o50 1 100 -50 1229.98 FORMAT "%8.3" ECU_ADDRESS 0x5B88B2 /end MEASUREMENT
/begin MEASUREMENT tnachl_w "SG-Nachlaufzeit" UWORD t100msxs_uw_b6553p6 1 100 0 6553.5 FORMAT "%8.3" ECU_ADDRESS 0x3FDC92 /end MEASUREMENT
/begin MEASUREMENT tnscCtr_w "" UWORD t20msxs_uw_q0p02 1 100 0 1310.7 FORMAT "%8.3" ECU_ADDRESS 0x5B93FA /end MEASUREMENT
/begin MEASUREMENT tnsofCtr "" UBYTE t20msxs_ub_b5p1 1 100 0 5.1 FORMAT "%5.3" ECU_ADDRESS 0x5B8FB7 /end MEASUREMENT
/begin MEASUREMENT tplrvk2_w "Periodendauerwert Rohwert der Sonde vor Kat, ermittelt in %LR, Bank 2" UWORD t10msxs_uw_b655p35 1 100 0 655.35 FORMAT "%8.4" ECU_ADDRESS 0x5B92D6 /end MEASUREMENT
/begin MEASUREMENT tplrvk_w "Periodendauerwert Rohwert der Sonde vor Kat, ermittelt in %LR" UWORD t10msxs_uw_b655p35 1 100 0 655.35 FORMAT "%8.4" ECU_ADDRESS 0x5B92D8 /end MEASUREMENT
/begin MEASUREMENT tsaka "Timer Schubdauer f¸r Katalysator-Ausr‰umen" UBYTE t20msxs_ub_b5p1 1 100 0 5.1 FORMAT "%5.3" ECU_ADDRESS 0x5B8F7F /end MEASUREMENT
/begin MEASUREMENT tsperr "Sperrzeit f¸r Lambdaregelung" UBYTE t10msxs_ub_b2p55 1 100 0 2.55 FORMAT "%5.3" ECU_ADDRESS 0x5B8F6C /end MEASUREMENT
/begin MEASUREMENT tv "LR: Integratorstopzeit-Z‰hler / ES: Bereitstellung Spannungskorrektur" SBYTE t10msxs_sb_q0p01 1 100 -1.28 1.27 FORMAT "%5.3" ECU_ADDRESS 0x5B8F6D /end MEASUREMENT
/begin MEASUREMENT tvlr "LR: Summenwert f¸r verzˆgerte Reglerumschaltung tv" SBYTE t10msxs_sb_q0p01 1 100 -1.28 1.27 FORMAT "%5.3" ECU_ADDRESS 0x5B8F6E /end MEASUREMENT
/begin MEASUREMENT tvlrh "LRHK: Korrekturwert f¸r verzˆgerte Reglerumschaltung tv" SBYTE t100msxs_sb_q0p01 1 100 -1.28 1.27 FORMAT "%5.3" ECU_ADDRESS 0x5B8F77 /end MEASUREMENT
/begin MEASUREMENT tvlrhi "I-Anteil f¸r verzˆgerte Reglerumschaltung tv, gewichtet" SBYTE t100msxs_sb_q0p01 1 100 -1.28 1.27 FORMAT "%5.3" ECU_ADDRESS 0x5B8F78 /end MEASUREMENT
/begin MEASUREMENT tvlrhp "P-Anteil f¸r verzˆgerte Reglerumschaltung tv, gewichtet" SBYTE t100msxs_sb_q0p01 1 100 -1.28 1.27 FORMAT "%5.3" ECU_ADDRESS 0x5B8F79 /end MEASUREMENT
/begin MEASUREMENT usrhk "aktuelle Regelschwelle Lambdasignal h.K." UBYTE spg_ub_q0p0052_o0p2 1 100 -0.2 1.13 FORMAT "%5.3" ECU_ADDRESS 0x5B8F7A /end MEASUREMENT
/begin MEASUREMENT wpfgruf_w "R¸ckgerechneter Pedalwert bei FGR-Betrieb ungefiltert" UWORD rel_uw_b100 1 100 0 99.9985 FORMAT "%8.5" ECU_ADDRESS 0x5B93B4 /end MEASUREMENT
/begin MEASUREMENT wpfgr_w "R¸ckgerechneter Pedalwert bei FGR-Betrieb" UWORD rel_uw_b100 1 100 0 99.9985 FORMAT "%8.5" ECU_ADDRESS 0x5B93B6 /end MEASUREMENT
/begin MEASUREMENT zatv "Integrationsgeschindigkeit I-Anteil  Regelung hinter Kat" UBYTE tgrad_ub_q0p039 1 100 0 9.96094 FORMAT "%5.3" ECU_ADDRESS 0x5B8F7B /end MEASUREMENT
/begin MEASUREMENT zdashvfmk "" UWORD zk10msxs_uw_b655 1 100 0.0100002 655.36 FORMAT "%12.8" ECU_ADDRESS 0x5B93B8 /end MEASUREMENT
/begin MEASUREMENT zdash_w "Zeitkonstante Dashpot" UWORD zk10msxs_uw_b655 1 100 0.0100002 655.36 FORMAT "%12.8" ECU_ADDRESS 0x5B93BA /end MEASUREMENT
/begin MEASUREMENT zlsdvfmk "" UWORD zk10msxs_uw_b655 1 100 0.0100002 655.36 FORMAT "%12.8" ECU_ADDRESS 0x5B93BC /end MEASUREMENT
/begin MEASUREMENT zlsd_w "Zeitkonstante PT2-Filter Lastschlagd‰mpfung" UWORD zk10msxs_uw_b655 1 100 0.0100002 655.36 FORMAT "%12.8" ECU_ADDRESS 0x5B93BE /end MEASUREMENT
/begin MEASUREMENT zwopt "optimaler Z¸ndwinkel" SBYTE zw_sb_q0p75 1 100 -96 95.25 FORMAT "%5.2" ECU_ADDRESS 0x5B8FA8 /end MEASUREMENT
/begin MEASUREMENT zwoptl1 "optimaler Z¸ndwinkel bei Lambda=1" SBYTE zw_sb_q0p75 1 100 -96 95.25 FORMAT "%5.2" ECU_ADDRESS 0x5B8FA9 /end MEASUREMENT
/begin MEASUREMENT zwsol "Soll-Z¸ndwinkel aus Momenteneingriff" SBYTE zw_sb_q0p75 1 100 -96 95.25 FORMAT "%5.2" ECU_ADDRESS 0x5B8FF8 /end MEASUREMENT
/begin FUNCTION LR "Lambdaregelung"
 /begin DEF_CHARACTERISTIC CFRA DFRMN DFRSPS FFRITMS FLRFKATE FLRM FRIPDSL1 FRIPDSL4 FRIPDTES FRIPTES FRMAX FRMINSLS FRMINSLSK FRTEMX KFFRMIN KFRI KFRI2 KFRP KFRP2 KFRTV KFRTV2 QUFRMN QUFRMX TSPERN TSPERN2 USR ZDFR ZLRFRI /end DEF_CHARACTERISTIC
 /begin REF_CHARACTERISTIC SNM07LRUB SRL06LRUB /end REF_CHARACTERISTIC
 /begin IN_MEASUREMENT B_atmtpa B_dktlp B_dsl1 B_dsl4 B_dslme B_dtefrr B_dtes B_dtest B_fasls B_frini B_ll B_lrnd B_pwf B_te B_tehbx dtvka esst_snm07lrub esst_srl06lrub falrdkt fkatei frini_w nmot rl tmot tmst tnst_w tvlrh tvlrhi usvk /end IN_MEASUREMENT
 /begin OUT_MEASUREMENT B_dfrf B_dfrf2 B_dfrm B_dfrm2 B_frab B_frab2 B_frmax B_frmax2 B_frmin B_frmin2 B_lrsp B_lrsp2 B_lrstat B_lrstat2 B_lrstta B_lrstta2 B_lrtpp B_lrtpp2 B_sgnlr B_sgnlr2 dfrsp2_w dfrsp_w dfrst2_w dfrst_w fr2_w frm2_w frmn2_w frmn_w frmx2_w frmx_w frm_w fr_w tfrn_w tplrvk2_w tplrvk_w /end OUT_MEASUREMENT
 /begin LOC_MEASUREMENT B_frmini B_frsp B_inifrm B_int B_sgnalt B_sgnra B_tsper B_tspon dfrstga_w dfrstte_w ffri ffrip_w frband_w fri friband_w friint frint_w frp frpint frsp_w frtv lrfrmz lrfrz tfrnint_w tfrpint_w tfrp_w tsperr tv tvlr /end LOC_MEASUREMENT
/end FUNCTION
/begin FUNCTION LRA "Adaptive Vorsteuerung f¸r Lambdaregelung"
 /begin DEF_CHARACTERISTIC FRAOMN FRAOMX FRAORN FRAORX FRAUMN FRAUMX FRAURN FRAURX MLO1 MLO2 MLO3 MLU2 MLU4 N0 NO1 NOLRA NRKAB NU3 RKATMN RKATMX RKATRN RKATRX RKAZMN RKAZMX RKAZRN RKAZRX RLO2 RLO3 RLU2 RLU3 RLU4 ZKFRAOA ZKFRAUA ZKRKATA ZKRKAZ /end DEF_CHARACTERISTIC
 /begin IN_MEASUREMENT abo B_abor B_edkvs B_edkvs2 B_fa B_fakvs B_lra B_lra2 B_lrar B_lsvvsp B_pwf frm_w ml_w nmot rl /end IN_MEASUREMENT
 /begin OUT_MEASUREMENT B_frao B_fraor B_fraor2 B_frau B_fraur B_fraur2 B_lrare B_lrare2 B_nofra B_norkat B_norkaz B_rkat B_rkatr B_rkatr2 B_rkaz B_rkazr B_rkazr2 fra2_w frao2_w frao_w frau2_w frau_w fra_w rka2_w rkat2_w rkat_w rkaz2_w rkaz_w rka_w /end OUT_MEASUREMENT
 /begin LOC_MEASUREMENT B_lrareb dfrm2_w dfrm_w /end LOC_MEASUREMENT
/end FUNCTION
/begin FUNCTION LRAEB "Einschaltbedingungen Gemischadaption" /begin DEF_CHARACTERISTIC TARA TMRAA TVLRA WDKARN /end DEF_CHARACTERISTIC
 /begin IN_MEASUREMENT B_auakt B_dsls B_dtest B_esnws B_fa B_fakvs B_falra B_gap B_lr B_mdarv B_sls B_te B_ukg B_vl nmot tans tmot wdkba /end IN_MEASUREMENT
 /begin OUT_MEASUREMENT B_gasp B_lra B_lra2 /end OUT_MEASUREMENT
/end FUNCTION
/begin FUNCTION LREB "Lambdaregelung Einschaltbedingungen"
 /begin DEF_CHARACTERISTIC CLRZWTMS DTMR DTMTMRW IMLSALR NLRSHB RLLRSHB RLLRUN RLRAN RLRVAO TARAU TASHS TLRBAM TLRHS TLRTMS TLRVAM TLRZWTMS TMRA1 TMRA2 TMRAK TMSHS TRAB TRAU TSBBVTMS /end DEF_CHARACTERISTIC
 /begin REF_CHARACTERISTIC CLRKA STM08LEUB USR /end REF_CHARACTERISTIC
 /begin IN_MEASUREMENT B_bag B_blkmd B_craus B_dsl B_dsls B_dslsk B_eev B_esls B_evloc B_falr B_kse B_ll B_lrka B_lrkast B_lsvvsp B_sa B_sbbvk B_sbbvk2 B_sls B_slsfz B_slsoff B_st B_stend B_temin B_temin2 B_vag esst_stm08leub fr2_w fr_w lamsons_w ml_w nmot rl tans tmot tmotlin tmrw tmst usvk usvk2 /end IN_MEASUREMENT
 /begin OUT_MEASUREMENT B_eobdlr B_lr B_lr2 B_lr2s B_lr2s2 B_lrnd B_lrnd2 B_lrnda B_lrnda2 B_lrvk B_lrvk2 B_mlrsa B_nolrb B_nolrb2 B_nolre B_nolre2 B_nolrw B_nolrw2 B_tmlr flglrs flglrs2 /end OUT_MEASUREMENT
 /begin LOC_MEASUREMENT B_bvdel B_eobdlr2 B_fslr B_fslr2 B_lreb100 B_lreble B_lreble2 B_lrebpr B_lrebpr2 B_lrebri B_lrebri2 B_lrpspa B_lrrl B_lrwla B_msfslr B_msfslr2 B_mslr B_mslr2 B_pspaus B_pspwl B_tarau imlrsa_w tansst /end LOC_MEASUREMENT
/end FUNCTION
/begin FUNCTION LRHK "F¸hrungsregelung mit Sonde hinter KAT (OBDII)"
 /begin DEF_CHARACTERISTIC ATVINI ATVINI2 ATVMN ATVMX CLRHK KDLASHKI KDLASHKP KFFTV KFUSHK LALIUSH LALIUSRH LASHKAB MLNKAX NLRHO NLRHU PLRHAV PLRHML RLLRHON RLLRHUN TBLRH TBLRH2 TKATMLRH TKATMLRH2 ZLASHKAB ZLASOHML ZLRHML /end DEF_CHARACTERISTIC
 /begin REF_CHARACTERISTIC SML08LHUB SNM06LHUB SNM08LHUB SRL06LHUB /end REF_CHARACTERISTIC
 /begin IN_MEASUREMENT avkatf avkatf2 B_dsls B_edkvs B_edkvs2 B_falsh B_falsh2 B_lr B_lr2 B_lrka B_lrsp B_lrsp2 B_mdarv B_pwf B_sbbhk B_st B_tehb esst_sml08lhub esst_snm06lhub esst_snm08lhub esst_srl06lhub E_hsh E_hsh2 E_hsv E_hsv2 E_kat E_lash E_lm E_sls E_tes E_teve E_teve2 ml ml_w nmot rl tkatm ushk_w /end IN_MEASUREMENT
 /begin OUT_MEASUREMENT atv B_lrhk lamsolh_w lamsonh_w tvlrh tvlrhi usrhk /end OUT_MEASUREMENT
 /begin LOC_MEASUREMENT atvinii B_atvini B_lrhkb B_lrhkg B_lrhkgi B_lrhkp dlahkab_w dlashki_w dlashkm_w dlashkp_w ftv iavkatf idlashkm_w lahkmz lamhf_w lamhm_w LRHKlokbits mlnka_w percnt_w ptv tvlrhp zatv /end LOC_MEASUREMENT
/end FUNCTION
/begin FUNCTION LRINI "Lambdaregelung, Koordination der Initialisierung" /begin IN_MEASUREMENT B_dtefrr B_lrnd B_lrnd2 frdter_w /end IN_MEASUREMENT /begin OUT_MEASUREMENT B_frini B_frini2 frini2_w frini_w /end OUT_MEASUREMENT /end FUNCTION
/begin FUNCTION LRKA "Zweipunkt-Lambdaregelung mit tv : Funkt. KAT-Ausr‰umen von Sauerstoff"
 /begin DEF_CHARACTERISTIC CLRKA DTVKAML DTVKAML2 FFWEKA FKAXAVKAT FLMLKAMA FLMLKAPR FMLKAMA ILMLKAXTK IMLAKMN IMLKAXTK LAMKAML LAMKAML2 NLRKA TDFRKAD TDFRKAU TSAKAMN USHKAMN USHKAMX USVKAMX /end DEF_CHARACTERISTIC
 /begin REF_CHARACTERISTIC SML05LKUB /end REF_CHARACTERISTIC
 /begin IN_MEASUREMENT avkatf B_bevab B_sa B_sbbhk B_sls esst_sml05lkub fwe lamsons_w ml ml_w nmot tikatm_w tkatm_w ushk usvk /end IN_MEASUREMENT
 /begin OUT_MEASUREMENT B_ilmlkat B_lrka dtvka ilmlkat_w lamka_w /end OUT_MEASUREMENT
 /begin LOC_MEASUREMENT B_blrka B_kawe B_lrkaa B_lrkae B_lrkaei B_lrkaon B_lrkarg B_lrkast dtvkai favkatmx ilmlkah_w ilmlkam_w ilmlkav_w ilmlkax_w ilmlka_w imlkav_w imlkax_w imlka_w lamkaii_w lamkai_w lamsnka_w lrkaz tkatms_w tsaka /end LOC_MEASUREMENT
/end FUNCTION
/begin FUNCTION MCY310_CONF "" /end FUNCTION
/begin FUNCTION MDBAS "Berechnung der Basisgrˆﬂen f¸r Momentenschnittstelle"
 /begin DEF_CHARACTERISTIC CWMBAS DZW2DZWQ DZWKOEFKT DZWOLA DZWOM ETALAM FDZWKOFTMT KFDZWAGR KFDZWKOEF KFDZWKOEFT KFETAGD KFKDZWKOFT KFMIOP KFZWOP KFZWOP2 KFZWOPLL KFZWOPLLT KLFWUELL SRL16OPUW TMSPR ZDZWKOEFT ZKFZNWLL ZRL_W_KGE /end DEF_CHARACTERISTIC
 /begin REF_CHARACTERISTIC DTMSPR SNM16OPUW /end REF_CHARACTERISTIC
 /begin IN_MEASUREMENT agrr Asprl Asprlu B_agr B_ll B_st dpsfak dzwwl Esprl Esprlu esst_snm16opuw lambas nmot nmot_w rl rl_w tmot Vsa_spri Vse_spri zwbas /end IN_MEASUREMENT
 /begin OUT_MEASUREMENT dzwkoef dzwkoefkt dzwkoeft dzwkoeftnf dzwkoefwt dzwoag dzwol esst_srl16opuw etagd etalab etatrmn etazwb etazwbm mibas_w miopt_w rl_kge rl_w_kge zwopt zwoptl1 /end OUT_MEASUREMENT
 /begin LOC_MEASUREMENT Asprll B_koefini B_koefkf dzwagr dzwb dzwotm Esprll fnwll fnwlleff fwuell fznwll mioptl1_w mioptugd_w /end LOC_MEASUREMENT
/end FUNCTION
/begin FUNCTION MDFAW "Fahrerwunschmoment"
 /begin DEF_CHARACTERISTIC CWDMFAB CWDMFAB2 CW_FMKNUL DLSDWE DMDPUG DMIFSAWE DMLSDUG DMRFAV KFDLSD KFDMDPO KFDMLSDO KFFDMFBT KFFMKNULFS KFMIFALGD KFMIFALS KFMILSD KFMIMR KFMRMI KFPED KFWPFGR KFZDASH KFZLSD KLFMKNUL KLTWEMEMO KLTWEMEMO2 MKLSDUGA MRFALLO MRFALLU MRFUEMXN NGFSAWE SMK06MDUW S_dmfbdpf TDMFBSA TDMFBWE TVDPSTEND TVFSAWE TWPFGR ZLSDWE /end DEF_CHARACTERISTIC
 /begin REF_CHARACTERISTIC MDIMX SGA08MDUB SNM06MDUW S_mdversta /end REF_CHARACTERISTIC
 /begin IN_MEASUREMENT B_kuppl B_nmot B_sa B_sab B_savfgr B_stend B_vnull dmllri_w dmverl_w dpsfak dpssolgd_w dpssol_uw dpssol_w esst_sga08mdub esst_snm06mduw gangi kfdps_aus mdverb_w mdverl_w miasrl_w mibgr_w miges_w miist_w milsol_w mimax_w mimin_w mimxl1_w minmx_w mivmx_w mrfgr_w mrstt_w ngfil_w nmot_w nturbc_w nturbv_w vfzg_w wped_w /end IN_MEASUREMENT
 /begin OUT_MEASUREMENT B_dash B_fgr B_fil B_ll B_lsd esst_smk06mduw fdmfbt fmil_w mifa mifal_w mifa_w mivbeg_w mrfamx_w mrfav_w mrfa_w mrfuemx_w mrfue_w mrped_w ntnmot_w wpfgruf_w wpfgr_w /end OUT_MEASUREMENT
 /begin LOC_MEASUREMENT B_dp B_edp B_elsd B_iflsd B_ls B_wememo dlsd_w dmdpo_w dmdpu_w dmlsdo_w dmlsdu_w dpsfaktd fmknul iwflsd_w mdverbfa_w mibdp_w miblsd_w migef_w mil1_w mil2_w mil3_w minbeg_w mivbeb_w mi_mr_w mkfanb_w mrpedv_w S_dp S_ls zdashvfmk zdash_w zlsdvfmk zlsd_w /end LOC_MEASUREMENT
/end FUNCTION
/begin FUNCTION MDFUE "Sollwertvorgabe f¸r Luftmasse aus Sollmoment" /begin DEF_CHARACTERISTIC KFMIRL KFRLMNN KFRLMNNT KFRLMNSAN KFRLMNSANT ZETABASN /end DEF_CHARACTERISTIC /begin REF_CHARACTERISTIC SNM12FEUB STM04FEUB /end REF_CHARACTERISTIC
 /begin IN_MEASUREMENT B_sa dpsfak esst_snm12feub esst_stm04feub etalab etazwbm milsol_w nmot nmot_w rlmax_w tmot /end IN_MEASUREMENT
 /begin OUT_MEASUREMENT B_mdmin drlsol_w rlmin_w rlsol_w /end OUT_MEASUREMENT
 /begin LOC_MEASUREMENT etabasf_w etabas_w misopl1_w rlsolold_w /end LOC_MEASUREMENT
/end FUNCTION
/begin FUNCTION MDIHGS "Momentenbegrenzung Gangabh‰ngig" /begin DEF_CHARACTERISTIC FMIHGN MDIAGMX MIHGSLG NGHGS ZMIBGR ZNGHGS /end DEF_CHARACTERISTIC /begin REF_CHARACTERISTIC MDIMX /end REF_CHARACTERISTIC
 /begin IN_MEASUREMENT B_autget B_gts gangi mifafu_w migs_w miint_w milsol_w ngas_w nmot /end IN_MEASUREMENT
 /begin OUT_MEASUREMENT B_hgsndy B_mibgr fmibgrv_w fmibgr_w mibgrv_w mibgr_w miges_w nghgs_w /end OUT_MEASUREMENT
/end FUNCTION
/begin FUNCTION MDIST "Motormomentenberechnung" /begin REF_CHARACTERISTIC DZW2DZWQ MDNORM /end REF_CHARACTERISTIC /begin IN_MEASUREMENT dzwkoef mdverl_w miopt_w redist zwist zwopt /end IN_MEASUREMENT /begin OUT_MEASUREMENT etazaist etazwist meist_w menist_w miist_w /end OUT_MEASUREMENT /begin LOC_MEASUREMENT dzwi mdindg_w /end LOC_MEASUREMENT /end FUNCTION
/begin FUNCTION MDKOG "9.40      Drehmomentenkoordination f¸r Gesamteingriffe"
 /begin DEF_CHARACTERISTIC CWMDKOG CWTEZW CWZWE CWZWVMX DMRKHO DMRKHU MDHYST NASNOT NKUPZWEO NKUPZWEU NLLZWEO NLLZWEU NLSDZWEO NLSDZWEU TMVER TPNSMD VKUPZWEO VKUPZWEU VLLZWEO VLLZWEU VLSDZWEO VLSDZWEU /end DEF_CHARACTERISTIC
 /begin REF_CHARACTERISTIC MDIMX /end REF_CHARACTERISTIC
 /begin IN_MEASUREMENT B_dash B_fil B_kh B_kuppl B_kw B_ll B_llrein B_lsd B_stend dmar_w dmllrz_w dmrkh dmrkt_w miasrl_w miasrs_w mibas_w mibgr_w mifa_w migs_w milres_w mimax_w mimsr_w minmx_w miszul_w mitebg_w mivmx_w nmot rlmin_w rlsol_w vfzg /end IN_MEASUREMENT
 /begin OUT_MEASUREMENT B_allzw B_allzwe B_asr B_mdein B_mibeg B_msr B_zwvs B_zwvz dmzms_w miext_w mifab_w misolv_w misol_w mizsol_w /end OUT_MEASUREMENT
 /begin LOC_MEASUREMENT B_mibegdau mibeg_w miextv_w mizsolv_w /end LOC_MEASUREMENT
/end FUNCTION
/begin FUNCTION MDKOL "Momentenkoordination auf F¸llungsebene" /begin DEF_CHARACTERISTIC ETAZWMNL KFETAMN /end DEF_CHARACTERISTIC /begin REF_CHARACTERISTIC MDIMX NASNOT /end REF_CHARACTERISTIC
 /begin IN_MEASUREMENT B_dash B_fil B_llrein B_lsd B_mibeg B_zwms dmllr_w dmrkh dmrkt_w dmrllr_w etazwbm etazwmn gangi miasrl_w mibgr_w mifa mifal_w mifa_w miges_w mimsr_w minmx_w misgsl_w miszul_w mitebg_w mivmx_w nmot vsdmr /end IN_MEASUREMENT
 /begin OUT_MEASUREMENT dmrmx_w mifafu_w milres_w milsol_w /end OUT_MEASUREMENT
/end FUNCTION
/begin FUNCTION MDMAX "Berechnung maximales indiziertes Motormoment" /begin DEF_CHARACTERISTIC FMIVL FRLVTM RLVMXN RLVSMXN STNMTA /end DEF_CHARACTERISTIC /begin REF_CHARACTERISTIC KFMIOP SNM16OPUW SRL16OPUW /end REF_CHARACTERISTIC
 /begin IN_MEASUREMENT B_su esst_snm16opuw esst_srl16opuw fho_w ftvdk mrfamx_w nmot nmot_w rl_w_kge tans tmot /end IN_MEASUREMENT
 /begin OUT_MEASUREMENT mimax_w mimxl1_w rlugd_w rlvugd /end OUT_MEASUREMENT
 /begin LOC_MEASUREMENT snmta /end LOC_MEASUREMENT
/end FUNCTION
/begin FUNCTION MDMIN "Minimales Motormoment Koordination" /begin IN_MEASUREMENT B_sab fnstab_w mdverf_w mistt nmot_w /end IN_MEASUREMENT /begin OUT_MEASUREMENT mill_w mimin_w /end OUT_MEASUREMENT /end FUNCTION
/begin FUNCTION MDNSTAB "Drehmoment: Drehzahlstabilisierung" /begin DEF_CHARACTERISTIC FNSTABNV NMDSTAOF /end DEF_CHARACTERISTIC /begin IN_MEASUREMENT B_stend nmot_w nstat nwem_out /end IN_MEASUREMENT /begin OUT_MEASUREMENT B_fnstab fnstab_w fnsta_in /end OUT_MEASUREMENT /begin LOC_MEASUREMENT nstatfak nwem_fak /end LOC_MEASUREMENT /end FUNCTION
/begin FUNCTION MDRED "Berechnung Reduzierstufe aus Momentenanforderung" /begin DEF_CHARACTERISTIC CREDSTU DMIZWMN MDHYEZ REDHYOC REDHYUC REDMXSA REDZEM /end DEF_CHARACTERISTIC
 /begin IN_MEASUREMENT B_asr B_dknolu B_dkpu B_msr B_nmax B_sab B_zmsoff etazwmn mibas_w miopt_w misol_w redist tmot /end IN_MEASUREMENT
 /begin OUT_MEASUREMENT B_sa mizwmn_w redsol /end OUT_MEASUREMENT
 /begin LOC_MEASUREMENT B_mdee B_mdredhyein redhyst redneu redze redzst_w /end LOC_MEASUREMENT
/end FUNCTION
/begin FUNCTION MDTRIP "Berechnung der Momentenreserve im Kurztrip" /begin IN_MEASUREMENT dmrdkt_w dmrdsls_w dmrlash_w dmrlsh_w dmrlsv_w /end IN_MEASUREMENT /begin OUT_MEASUREMENT dmrkt_w /end OUT_MEASUREMENT /end FUNCTION
/begin FUNCTION MDVER "Motor-Verlustmoment"
 /begin DEF_CHARACTERISTIC CNFMDVER DMDNSM DMDNSMVT KFMDS KFMDSM KFWDMVAD KLMDHUB MDSH S_mdversta ZFMDVERL ZMDNSM ZMDNSMVT /end DEF_CHARACTERISTIC
 /begin IN_MEASUREMENT B_gdst B_gen2 B_llrein B_sa dmvad_w esst_stm06__ub evhubi_w fho mdgen mdko mdverb_w mdwan_w nmot_w rl_w tmot tol /end IN_MEASUREMENT
 /begin OUT_MEASUREMENT dmverl_w mdsh_aus mdsm_w mdsvad_w mdsw_w mdverf_w mdverl_w /end OUT_MEASUREMENT
 /begin LOC_MEASUREMENT mds_w /end LOC_MEASUREMENT
/end FUNCTION
/begin FUNCTION MDVERAD "Adaption Verlustmoment"
 /begin DEF_CHARACTERISTIC DMADFK DMADFS DMADKO DMADLL DMADMNFK DMADMNFS DMADMNKO DMADMNLL DMADMXFK DMADMXFS DMADMXKO DMADMXLL DMOFK DMOFS DMOKO DMOLL TMDMAD TWDMAD ZKDMADFK ZKDMADFS ZKDMADKO ZKDMADLL /end DEF_CHARACTERISTIC
 /begin IN_MEASUREMENT B_dknolu B_dkpu B_dtes B_edkvs B_eemrdy B_eepdif B_eepwf B_eev B_evloc B_fs B_koe B_llr B_llrein B_mdarv B_nswo1 B_vllr dmllri_w tmot /end IN_MEASUREMENT
 /begin OUT_MEASUREMENT B_clradllr dmvadfk_w dmvadfs_w dmvadko_w dmvadll_w dmvad_w /end OUT_MEASUREMENT
 /begin LOC_MEASUREMENT B_adwfk B_adwfs B_adwko B_madfk B_madfs B_madko B_madll B_madstp dmvamnfk_w dmvamnfs_w dmvamnko_w dmvamnll_w dmvamxfk_w dmvamxfs_w dmvamxko_w dmvamxll_w /end LOC_MEASUREMENT
/end FUNCTION
/begin FUNCTION MDVERB "Momentenbedarf der Nebenaggregate (z.B. Klimaanlage, sonst. Verbraucher)"
 /begin DEF_CHARACTERISTIC CWMDSL DMDKOE FABMDKO KFMDGEN KFMDKO KFMDKOG KLMDSL MDSL ZKMDGEN ZKMDKO /end DEF_CHARACTERISTIC
 /begin IN_MEASUREMENT B_acres B_gen1 B_gene B_koe B_koger B_sl kopwm lws_w mdarsp_w mdgenvf_w mdkog nmot nmot_w tans /end IN_MEASUREMENT
 /begin OUT_MEASUREMENT dmrac mdgen mdgen_w mdko mdverb mdverb_w /end OUT_MEASUREMENT
/end FUNCTION
/begin FUNCTION MDWAN "Drehmomentaufnahme des Wandlers"
 /begin DEF_CHARACTERISTIC CNFMDWAN DMDWHYS DMDWM FABMDWA FDMDWAN FMDWAT FNRAD FVDMDWAN KFMDWMX MDATNM MDATRM MDWANER TVFSAM TVFSEM TVFSRAM TVFSREM TVFUE UEVERG ZKDMDW ZKMDWAB ZKMDWAUF ZKMDWF ZKUEVERG /end DEF_CHARACTERISTIC
 /begin REF_CHARACTERISTIC STM08MDUB /end REF_CHARACTERISTIC
 /begin IN_MEASUREMENT B_autget B_fs B_mdwaner esst_stm08mdub gangi mdwancan nstat nturbc_w tmot vfzg vfzg_w /end IN_MEASUREMENT
 /begin OUT_MEASUREMENT B_dmrwan dmdwan_w dmrwan mdwanvf_w mdwan_w /end OUT_MEASUREMENT
 /begin LOC_MEASUREMENT B_fsu B_rgang dnturb_w mdatxm_w nturbv_w nturb_w qntns /end LOC_MEASUREMENT
/end FUNCTION
/begin FUNCTION MDZUL "Maximal zul‰ssiges Moment"
 /begin DEF_CHARACTERISTIC KFMIZUFIL KFMIZUNS KFMIZUOF NSTART NSTEND SMO08OPUB TANSMN TFMIZU TMNSMN TNSC TNSOF /end DEF_CHARACTERISTIC
 /begin REF_CHARACTERISTIC MDIMX SNM08OPUB SWP08OPUB /end REF_CHARACTERISTIC
 /begin IN_MEASUREMENT B_fgr B_msr B_mzns_um esst_snm08opub esst_swp08opub nmot tans tmot wped /end IN_MEASUREMENT
 /begin OUT_MEASUREMENT miszul_w mizuvfil /end OUT_MEASUREMENT
 /begin LOC_MEASUREMENT B_mzns B_nsakt B_nsend esst_smo08opub mizufil_w mizuofil tnscCtr_w tnsofCtr /end LOC_MEASUREMENT
/end FUNCTION
/begin FUNCTION MDZW "Berechnung Moment in Sollz¸ndwinkel" /begin DEF_CHARACTERISTIC DMAUFN DZWQ2DZW DZWQ2DZWL /end DEF_CHARACTERISTIC
 /begin IN_MEASUREMENT B_zwvs B_zwvz dzwkoef etazaist mibas_w miopt_w misol_w mizsol_w mizwmn_w nmot_w redist zwopt /end IN_MEASUREMENT
 /begin OUT_MEASUREMENT B_nozwe dmaufr_w etazws zwsol /end OUT_MEASUREMENT
 /begin LOC_MEASUREMENT B_zwvzm dzws dzwssq dzwssql /end LOC_MEASUREMENT
/end FUNCTION
/begin FUNCTION MLS "Motorl¸fter-Steuerung"
 /begin DEF_CHARACTERISTIC FMLVFZG KLTAMLKFT TALUNL TAMHYS TAMLAC TAMLSMN TAMLSMX TAMLSNH TAMLTKA TAMLU TMMLN /end DEF_CHARACTERISTIC
 /begin REF_CHARACTERISTIC TNLSGMN /end REF_CHARACTERISTIC
 /begin IN_MEASUREMENT B_famls B_kalt B_kftvar B_nachl B_nmin B_stend stmlac tamldia tka tkws tmot tnachl_w ub vfzg /end IN_MEASUREMENT
 /begin OUT_MEASUREMENT B_nachln B_nl10 fqml taml tamlaus tamlnl tamls /end OUT_MEASUREMENT
 /begin LOC_MEASUREMENT tamlausab tamlkft tamlnh tkadif /end LOC_MEASUREMENT
/end FUNCTION
/begin FUNCTION MOTAUS "Motor-Abstellen" /begin DEF_CHARACTERISTIC TNLSGMN TNLSGMX /end DEF_CHARACTERISTIC /begin IN_MEASUREMENT B_kl15 B_nmin B_pwf /end IN_MEASUREMENT
 /begin OUT_MEASUREMENT B_nachl B_nachlend B_nachlram B_nlacls B_nlale B_nlatm B_nlcan B_nldte B_nlEEPR B_nlmls B_nlobd B_nlsgls B_nlsiko B_nlvvtchk B_nlwst swOffDlBits tnachl_w /end OUT_MEASUREMENT
/end FUNCTION
/begin COMPU_METHOD B_TRUE "boolsche Zust‰nde, positive Logik" TAB_VERB "%6.3" "" COMPU_TAB_REF B_TRUE /end COMPU_METHOD
/begin COMPU_VTAB B_TRUE "boolsche Zust‰nde, positive Logik" TAB_VERB 2 0 "----" 1 "TRUE" /end COMPU_VTAB
/begin COMPU_METHOD DEZ "1 : 1 Umrechnug (dez/hex)" RAT_FUNC "%6.2" "" COEFFS 0 1 0 0 0 1 /end COMPU_METHOD
/begin COMPU_METHOD dez "1 : 1 Umrechnug (dez/hex)" RAT_FUNC "%6.2" "" COEFFS 0 1 0 0 0 1 /end COMPU_METHOD
/begin COMPU_METHOD fak_q0p0439 "" RAT_FUNC "%6.4" "%/(Grad KWQ)" COEFFS 0 32 0 0 0 1.405 /end COMPU_METHOD
/begin COMPU_METHOD fak_sb_b1 "" RAT_FUNC "%6.4" "-" COEFFS 0 256 0 0 0 2 /end COMPU_METHOD
/begin COMPU_METHOD fak_sw_b1 "" RAT_FUNC "%7.6" "-" COEFFS 0 65536 0 0 0 2 /end COMPU_METHOD
/begin COMPU_METHOD fak_ub_b1 "" RAT_FUNC "%6.4" "-" COEFFS 0 256 0 0 0 1 /end COMPU_METHOD
/begin COMPU_METHOD fak_ub_b12p45 "" RAT_FUNC "%6.4" "%" COEFFS 0 2048 0 0 0 100 /end COMPU_METHOD
/begin COMPU_METHOD fak_ub_b16 "" RAT_FUNC "%6.4" "-" COEFFS 0 256 0 0 0 16 /end COMPU_METHOD
/begin COMPU_METHOD fak_ub_b2 "" RAT_FUNC "%6.4" "-" COEFFS 0 256 0 0 0 2 /end COMPU_METHOD
/begin COMPU_METHOD fak_ub_b4 "" RAT_FUNC "%6.4" "-" COEFFS 0 256 0 0 0 4 /end COMPU_METHOD
/begin COMPU_METHOD fak_ub_b77p81 "" RAT_FUNC "%6.3" "%/s" COEFFS 0 327.68 0 0 0 100 /end COMPU_METHOD
/begin COMPU_METHOD fak_ub_b8 "" RAT_FUNC "%6.4" "-" COEFFS 0 256 0 0 0 8 /end COMPU_METHOD
/begin COMPU_METHOD fak_ub_q0p00392 "" RAT_FUNC "%6.4" "-" COEFFS 0 255 0 0 0 1 /end COMPU_METHOD
/begin COMPU_METHOD fak_ub_q4p7Em7 "" RAT_FUNC "%9.8" "-" COEFFS 0 1 0 0 0 4.7e-007 /end COMPU_METHOD
/begin COMPU_METHOD fak_uw_b1 "" RAT_FUNC "%7.6" "-" COEFFS 0 65536 0 0 0 1 /end COMPU_METHOD
/begin COMPU_METHOD fak_uw_b16 "" RAT_FUNC "%6.5" "-" COEFFS 0 65536 0 0 0 16 /end COMPU_METHOD
/begin COMPU_METHOD fak_uw_b2 "" RAT_FUNC "%7.6" "-" COEFFS 0 65536 0 0 0 2 /end COMPU_METHOD
/begin COMPU_METHOD fak_uw_b4 "" RAT_FUNC "%7.6" "-" COEFFS 0 65536 0 0 0 4 /end COMPU_METHOD
/begin COMPU_METHOD fak_uw_b8 "" RAT_FUNC "%6.5" "-" COEFFS 0 65536 0 0 0 8 /end COMPU_METHOD
/begin COMPU_METHOD freq_q1 "" RAT_FUNC "%6.2" "1/s" COEFFS 0 1 0 0 0 1 /end COMPU_METHOD
/begin COMPU_METHOD hub_uw_q0p001 "" RAT_FUNC "%6.5" "mm" COEFFS 0 1000 0 0 0 1 /end COMPU_METHOD
/begin COMPU_METHOD kwq_ub_q0p04447 "" RAT_FUNC "%6.4" "Grad KWQ" COEFFS 0 25500 0 0 0 1134 /end COMPU_METHOD
/begin COMPU_METHOD kwq_ub_q0p35576 "" RAT_FUNC "%6.3" "Grad KWQ" COEFFS 0 25500 0 0 0 9072 /end COMPU_METHOD
/begin COMPU_METHOD lws_q0p04375 "" RAT_FUNC "%6.4" "Grad" COEFFS 0 1 0 0 0 0.04375 /end COMPU_METHOD
/begin COMPU_METHOD md_q0p5 "" RAT_FUNC "%6.3" "Nm" COEFFS 0 1 0 0 0 0.5 /end COMPU_METHOD
/begin COMPU_METHOD md_ub_q1 "" RAT_FUNC "%6.2" "Nm" COEFFS 0 1 0 0 0 1 /end COMPU_METHOD
/begin COMPU_METHOD m_ub_b1020 "" RAT_FUNC "%6.2" "kg/h" COEFFS 0 1 0 0 0 4 /end COMPU_METHOD
/begin COMPU_METHOD m_uw_b4660 "" RAT_FUNC "%6.4" "g" COEFFS 0 3600 0 0 0 256 /end COMPU_METHOD
/begin COMPU_METHOD m_uw_b6553p5 "" RAT_FUNC "%6.3" "kg/h" COEFFS 0 1 0 0 0 0.1 /end COMPU_METHOD
/begin COMPU_METHOD m_uw_b7281 "" RAT_FUNC "%6.3" "g" COEFFS 0 9 0 0 0 1 /end COMPU_METHOD
/begin COMPU_METHOD nmotg_sw_q0p39 "" RAT_FUNC "%6.3" "1/min/s" COEFFS 0 1 0 0 0 0.39063 /end COMPU_METHOD
/begin COMPU_METHOD nmot_q0p125 "" RAT_FUNC "%6.3" "1/min" COEFFS 0 8 0 0 0 1 /end COMPU_METHOD
/begin COMPU_METHOD nmot_sb_q40 "" RAT_FUNC "%6.1" "1/min" COEFFS 0 1 0 0 0 40 /end COMPU_METHOD
/begin COMPU_METHOD nmot_ub_q40 "" RAT_FUNC "%6.1" "1/min" COEFFS 0 1 0 0 0 40 /end COMPU_METHOD
/begin COMPU_METHOD nmot_uw_q0p25 "" RAT_FUNC "%6.3" "1/min" COEFFS 0 1 0 0 0 0.25 /end COMPU_METHOD
/begin COMPU_METHOD relPED_ub_b100 "" RAT_FUNC "%6.3" "%PED" COEFFS 0 255 0 0 0 100 /end COMPU_METHOD
/begin COMPU_METHOD relPED_uw_b100 "" RAT_FUNC "%6.4" "%PED" COEFFS 0 65535 0 0 0 100 /end COMPU_METHOD
/begin COMPU_METHOD rel_q0p1957 "" RAT_FUNC "%6.3" "%" COEFFS 0 511 0 0 0 100 /end COMPU_METHOD
/begin COMPU_METHOD rel_sb_q0p02 "" RAT_FUNC "%6.4" "%" COEFFS 0 64 0 0 0 1 /end COMPU_METHOD
/begin COMPU_METHOD rel_sw_b100 "" RAT_FUNC "%6.4" "%" COEFFS 0 32768 0 0 0 100 /end COMPU_METHOD
/begin COMPU_METHOD rel_sw_b1536 "" RAT_FUNC "%6.4" "%" COEFFS 0 65536 0 0 0 3072 /end COMPU_METHOD
/begin COMPU_METHOD rel_sw_q0p0234 "" RAT_FUNC "%6.4" "%/seg" COEFFS 0 32 0 0 0 0.75 /end COMPU_METHOD
/begin COMPU_METHOD rel_ub_b100 "" RAT_FUNC "%6.3" "%" COEFFS 0 255 0 0 0 100 /end COMPU_METHOD
/begin COMPU_METHOD rel_ub_b127p5 "" RAT_FUNC "%6.3" "%" COEFFS 0 2 0 0 0 1 /end COMPU_METHOD
/begin COMPU_METHOD rel_ub_b24p9 "" RAT_FUNC "%6.3" "%" COEFFS 0 255 0 0 0 24.9 /end COMPU_METHOD
/begin COMPU_METHOD rel_ub_b2p0 "" RAT_FUNC "%6.4" "%" COEFFS 0 256 0 0 0 2 /end COMPU_METHOD
/begin COMPU_METHOD rel_ub_b49p725 "" RAT_FUNC "%6.3" "%" COEFFS 0 255 0 0 0 49.725 /end COMPU_METHOD
/begin COMPU_METHOD rel_ub_b99p6 "" RAT_FUNC "%6.3" "%" COEFFS 0 256 0 0 0 100 /end COMPU_METHOD
/begin COMPU_METHOD rel_ub_bn24p9 "" RAT_FUNC "%6.5" "%" COEFFS 0 -255 0 0 0 24.9 /end COMPU_METHOD
/begin COMPU_METHOD rel_ub_q0p75 "" RAT_FUNC "%6.3" "%" COEFFS 0 1 0 0 0 0.75 /end COMPU_METHOD
/begin COMPU_METHOD rel_uw_b100 "" RAT_FUNC "%6.4" "%" COEFFS 0 65536 0 0 0 100 /end COMPU_METHOD
/begin COMPU_METHOD rel_uw_b200 "" RAT_FUNC "%6.4" "%" COEFFS 0 65536 0 0 0 200 /end COMPU_METHOD
/begin COMPU_METHOD rel_uw_q0p001 "" RAT_FUNC "%6.5" "%" COEFFS 0 1000 0 0 0 1 /end COMPU_METHOD
/begin COMPU_METHOD rel_uw_q0p0234 "" RAT_FUNC "%6.4" "%" COEFFS 0 32 0 0 0 0.75 /end COMPU_METHOD
/begin COMPU_METHOD spg_ub_q0p0052_o0p2 "" RAT_FUNC "%6.3" "V" COEFFS 0 255 51 0 0 1.33 /end COMPU_METHOD
/begin COMPU_METHOD spg_uw_q0p00488_o1 "" RAT_FUNC "%6.3" "V" COEFFS 0 1024 1024 0 0 5 /end COMPU_METHOD
/begin COMPU_METHOD sprzi_q0p8 "" RAT_FUNC "%6.2" "Grad KW" COEFFS 0 1 0 0 0 0.8 /end COMPU_METHOD
/begin COMPU_METHOD t100msxs_sb_q0p01 "" RAT_FUNC "%6.4" "s" COEFFS 0 1 0 0 0 0.01 /end COMPU_METHOD
/begin COMPU_METHOD t100msxs_ub_b25p5 "" RAT_FUNC "%6.3" "s" COEFFS 0 1 0 0 0 0.1 /end COMPU_METHOD
/begin COMPU_METHOD t100msxs_uw_b6553p5 "" RAT_FUNC "%6.3" "s" COEFFS 0 1 0 0 0 0.1 /end COMPU_METHOD
/begin COMPU_METHOD t100msxs_uw_b6553p6 "" RAT_FUNC "%6.3" "s" COEFFS 0 10 0 0 0 1 /end COMPU_METHOD
/begin COMPU_METHOD t10msxs_sb_q0p01 "" RAT_FUNC "%6.4" "s" COEFFS 0 1 0 0 0 0.01 /end COMPU_METHOD
/begin COMPU_METHOD t10msxs_ub_b2p55 "" RAT_FUNC "%6.4" "s" COEFFS 0 1 0 0 0 0.01 /end COMPU_METHOD
/begin COMPU_METHOD t10msxs_uw_b655p35 "" RAT_FUNC "%6.4" "s" COEFFS 0 1 0 0 0 0.01 /end COMPU_METHOD
/begin COMPU_METHOD t1sxs_uw_b65535 "" RAT_FUNC "%6.2" "s" COEFFS 0 1 0 0 0 1 /end COMPU_METHOD
/begin COMPU_METHOD t200msxs_ub_b51 "" RAT_FUNC "%6.3" "s" COEFFS 0 1 0 0 0 0.2 /end COMPU_METHOD
/begin COMPU_METHOD t20msxs_ub_b5p1 "" RAT_FUNC "%6.4" "s" COEFFS 0 1 0 0 0 0.02 /end COMPU_METHOD
/begin COMPU_METHOD t20msxs_uw_q0p02 "" RAT_FUNC "%6.4" "s" COEFFS 0 1 0 0 0 0.02 /end COMPU_METHOD
/begin COMPU_METHOD temp_sb_q0p75 "" RAT_FUNC "%6.3" "Grad C" COEFFS 0 1 0 0 0 0.75 /end COMPU_METHOD
/begin COMPU_METHOD temp_ub_b191p25 "" RAT_FUNC "%6.3" "Grad C" COEFFS 0 1 0 0 0 0.75 /end COMPU_METHOD
/begin COMPU_METHOD temp_ub_q0p75 "" RAT_FUNC "%6.3" "Grad C" COEFFS 0 1 0 0 0 0.75 /end COMPU_METHOD
/begin COMPU_METHOD temp_ub_q0p75_o48 "" RAT_FUNC "%6.2" "Grad C" COEFFS 0 1 48 0 0 0.75 /end COMPU_METHOD
/begin COMPU_METHOD temp_ub_q5_o50 "" RAT_FUNC "%6.2" "Grad C" COEFFS 0 1 50 0 0 5 /end COMPU_METHOD
/begin COMPU_METHOD temp_uw_q0p0195_o50 "" RAT_FUNC "%6.2" "Grad C" COEFFS 0 256 12800 0 0 5 /end COMPU_METHOD
/begin COMPU_METHOD tgrad_ub_q0p039 "" RAT_FUNC "%6.4" "ms/s" COEFFS 0 256 0 0 0 10 /end COMPU_METHOD
/begin COMPU_METHOD vfzg_ub_q1p25 "" RAT_FUNC "%6.2" "km/h" COEFFS 0 1 0 0 0 1.25 /end COMPU_METHOD
/begin COMPU_METHOD vfzg_uw_b512 "" RAT_FUNC "%6.4" "km/h" COEFFS 0 65536 0 0 0 512 /end COMPU_METHOD
/begin COMPU_METHOD zk100msxs_uw_b655 "" RAT_FUNC "%6.1" "s" COEFFS 0 0 65536 0 10 0 /end COMPU_METHOD
/begin COMPU_METHOD zk10msxs_ub_b2p55 "" RAT_FUNC "%6.4" "s" COEFFS 0 0 255 0 100 0 /end COMPU_METHOD
/begin COMPU_METHOD zk10msxs_ub_b8 "" RAT_FUNC "%6.4" "1/s" COEFFS 0 256 0 0 0 8 /end COMPU_METHOD
/begin COMPU_METHOD zk10msxs_uw_b655 "" RAT_FUNC "%6.2" "s" COEFFS 0 0 65536 0 100 0 /end COMPU_METHOD
/begin COMPU_METHOD zk200msxs_ub_b51p2 "" RAT_FUNC "%6.3" "s" COEFFS 0 0 51.2 0 1 0 /end COMPU_METHOD
/begin COMPU_METHOD zk200msxs_uw_b13107 "" RAT_FUNC "%6.0" "s" COEFFS 0 0 13107 0 1 0 /end COMPU_METHOD
/begin COMPU_METHOD zk200msxs_uw_b5 "" RAT_FUNC "%7.6" "1/s" COEFFS 0 65536 0 0 0 5 /end COMPU_METHOD
/begin COMPU_METHOD zk200msxs_uw_b960 "" RAT_FUNC "%6.4" "%/s" COEFFS 0 65536 0 0 0 960 /end COMPU_METHOD
/begin COMPU_METHOD zk20msxs_ub_b5p1 "" RAT_FUNC "%6.4" "s" COEFFS 0 0 5.1 0 1 0 /end COMPU_METHOD
/begin COMPU_METHOD zk20msxs_uw_b1310 "" RAT_FUNC "%6.1" "s" COEFFS 0 0 1310 0 1 0 /end COMPU_METHOD
/begin COMPU_METHOD zk50msxs_uw_b3276p8 "" RAT_FUNC "%6.1" "s" COEFFS 0 0 65536 0 20 0 /end COMPU_METHOD
/begin COMPU_METHOD zw_sb_q0p75 "" RAT_FUNC "%6.3" "Grad KW" COEFFS 0 255 0 0 0 191.25 /end COMPU_METHOD
/begin RECORD_LAYOUT FklWSb FNC_VALUES 1 SBYTE COLUMN_DIR DIRECT /end RECORD_LAYOUT
/begin RECORD_LAYOUT FklWUb FNC_VALUES 1 UBYTE COLUMN_DIR DIRECT /end RECORD_LAYOUT
/begin RECORD_LAYOUT GkfWSb FNC_VALUES 1 SBYTE COLUMN_DIR DIRECT /end RECORD_LAYOUT
/begin RECORD_LAYOUT GkfWSw FNC_VALUES 1 SWORD COLUMN_DIR DIRECT /end RECORD_LAYOUT
/begin RECORD_LAYOUT GkfWU8 FNC_VALUES 1 UBYTE COLUMN_DIR DIRECT /end RECORD_LAYOUT
/begin RECORD_LAYOUT GkfWUb FNC_VALUES 1 UBYTE COLUMN_DIR DIRECT /end RECORD_LAYOUT
/begin RECORD_LAYOUT GkfWUw FNC_VALUES 1 UWORD COLUMN_DIR DIRECT /end RECORD_LAYOUT
/begin RECORD_LAYOUT GklWSb FNC_VALUES 1 SBYTE COLUMN_DIR DIRECT /end RECORD_LAYOUT
/begin RECORD_LAYOUT GklWSw FNC_VALUES 1 SWORD COLUMN_DIR DIRECT /end RECORD_LAYOUT
/begin RECORD_LAYOUT GklWUb FNC_VALUES 1 UBYTE COLUMN_DIR DIRECT /end RECORD_LAYOUT
/begin RECORD_LAYOUT GklWUw FNC_VALUES 1 UWORD COLUMN_DIR DIRECT /end RECORD_LAYOUT
/begin RECORD_LAYOUT KfAxU8AyU8SstxU16SstyU16WU16 NO_AXIS_PTS_X 1 UWORD NO_AXIS_PTS_Y 2 UWORD AXIS_PTS_X 3 UWORD INDEX_INCR DIRECT AXIS_PTS_Y 4 UWORD INDEX_INCR DIRECT FNC_VALUES 5 UWORD COLUMN_DIR DIRECT /end RECORD_LAYOUT
/begin RECORD_LAYOUT KfAxU8AyU8SstxU8SstyU8WS8 NO_AXIS_PTS_X 1 UBYTE NO_AXIS_PTS_Y 2 UBYTE AXIS_PTS_X 3 UBYTE INDEX_INCR DIRECT AXIS_PTS_Y 4 UBYTE INDEX_INCR DIRECT FNC_VALUES 5 SBYTE COLUMN_DIR DIRECT /end RECORD_LAYOUT
/begin RECORD_LAYOUT KfAxUbAyUbSstxUbSstyUbWSb NO_AXIS_PTS_X 1 UBYTE NO_AXIS_PTS_Y 2 UBYTE AXIS_PTS_X 3 UBYTE INDEX_INCR DIRECT AXIS_PTS_Y 4 UBYTE INDEX_INCR DIRECT FNC_VALUES 5 SBYTE COLUMN_DIR DIRECT /end RECORD_LAYOUT
/begin RECORD_LAYOUT KfAxUbAyUbSstxUbSstyUbWUb NO_AXIS_PTS_X 1 UBYTE NO_AXIS_PTS_Y 2 UBYTE AXIS_PTS_X 3 UBYTE INDEX_INCR DIRECT AXIS_PTS_Y 4 UBYTE INDEX_INCR DIRECT FNC_VALUES 5 UBYTE COLUMN_DIR DIRECT /end RECORD_LAYOUT
/begin RECORD_LAYOUT KfAxUbAyUbSstxUbSstyUwWUw NO_AXIS_PTS_X 1 UBYTE NO_AXIS_PTS_Y 2 UBYTE AXIS_PTS_X 3 UBYTE INDEX_INCR DIRECT AXIS_PTS_Y 4 UWORD INDEX_INCR DIRECT FNC_VALUES 5 UWORD COLUMN_DIR DIRECT /end RECORD_LAYOUT
/begin RECORD_LAYOUT KfAxUbAyUbSstxUwSstyUwWUw NO_AXIS_PTS_X 1 UWORD NO_AXIS_PTS_Y 2 UWORD AXIS_PTS_X 3 UWORD INDEX_INCR DIRECT AXIS_PTS_Y 4 UWORD INDEX_INCR DIRECT FNC_VALUES 5 UWORD COLUMN_DIR DIRECT /end RECORD_LAYOUT
/begin RECORD_LAYOUT KfAxUwAyUwSstxUwSstyUwWUw NO_AXIS_PTS_X 1 UWORD NO_AXIS_PTS_Y 2 UWORD AXIS_PTS_X 3 UWORD INDEX_INCR DIRECT AXIS_PTS_Y 4 UWORD INDEX_INCR DIRECT FNC_VALUES 5 UWORD COLUMN_DIR DIRECT /end RECORD_LAYOUT
/begin RECORD_LAYOUT KlASwSstSwWSw NO_AXIS_PTS_X 1 SWORD AXIS_PTS_X 2 SWORD INDEX_INCR DIRECT FNC_VALUES 3 SWORD COLUMN_DIR DIRECT /end RECORD_LAYOUT
/begin RECORD_LAYOUT KlAUbSstSbWUb NO_AXIS_PTS_X 1 UBYTE AXIS_PTS_X 2 SBYTE INDEX_INCR DIRECT FNC_VALUES 3 UBYTE COLUMN_DIR DIRECT /end RECORD_LAYOUT
/begin RECORD_LAYOUT KlAUbSstUbWSb NO_AXIS_PTS_X 1 UBYTE AXIS_PTS_X 2 UBYTE INDEX_INCR DIRECT FNC_VALUES 3 SBYTE COLUMN_DIR DIRECT /end RECORD_LAYOUT
/begin RECORD_LAYOUT KlAUbSstUbWUb NO_AXIS_PTS_X 1 UBYTE AXIS_PTS_X 2 UBYTE INDEX_INCR DIRECT FNC_VALUES 3 UBYTE COLUMN_DIR DIRECT /end RECORD_LAYOUT
/begin RECORD_LAYOUT KlAUbSstUbWUw NO_AXIS_PTS_X 1 UBYTE AXIS_PTS_X 2 UBYTE INDEX_INCR DIRECT FNC_VALUES 3 UWORD COLUMN_DIR DIRECT /end RECORD_LAYOUT
/begin RECORD_LAYOUT KlAUwSstSwWUw NO_AXIS_PTS_X 1 UWORD AXIS_PTS_X 2 SWORD INDEX_INCR DIRECT FNC_VALUES 3 UWORD COLUMN_DIR DIRECT /end RECORD_LAYOUT
/begin RECORD_LAYOUT KlAUwSstUwWUw NO_AXIS_PTS_X 1 UWORD AXIS_PTS_X 2 UWORD INDEX_INCR DIRECT FNC_VALUES 3 UWORD COLUMN_DIR DIRECT /end RECORD_LAYOUT
/begin RECORD_LAYOUT KlAxU8SstxU16WU16 NO_AXIS_PTS_X 1 UWORD AXIS_PTS_X 2 UWORD INDEX_INCR DIRECT FNC_VALUES 3 UWORD COLUMN_DIR DIRECT /end RECORD_LAYOUT
/begin RECORD_LAYOUT KwSb FNC_VALUES 1 SBYTE COLUMN_DIR DIRECT /end RECORD_LAYOUT
/begin RECORD_LAYOUT KwSw FNC_VALUES 1 SWORD COLUMN_DIR DIRECT /end RECORD_LAYOUT
/begin RECORD_LAYOUT KwUb FNC_VALUES 1 UBYTE COLUMN_DIR DIRECT /end RECORD_LAYOUT
/begin RECORD_LAYOUT KwUw FNC_VALUES 1 UWORD COLUMN_DIR DIRECT /end RECORD_LAYOUT
/begin RECORD_LAYOUT KwWU8 FNC_VALUES 1 UBYTE COLUMN_DIR DIRECT /end RECORD_LAYOUT
/begin RECORD_LAYOUT SstASwSstSw NO_AXIS_PTS_X 1 SWORD AXIS_PTS_X 2 SWORD INDEX_INCR DIRECT /end RECORD_LAYOUT
/begin RECORD_LAYOUT SstAUbSstUb NO_AXIS_PTS_X 1 UBYTE AXIS_PTS_X 2 UBYTE INDEX_INCR DIRECT /end RECORD_LAYOUT
/begin RECORD_LAYOUT SstAUwSstUw NO_AXIS_PTS_X 1 UWORD AXIS_PTS_X 2 UWORD INDEX_INCR DIRECT /end RECORD_LAYOUT
/end MODULE
/end PROJECT
