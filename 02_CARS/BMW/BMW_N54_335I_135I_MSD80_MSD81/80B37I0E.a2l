ASAP2_VERSION 1 41
/begin PROJECT MSD70 "Spray Guided DI-System with Piezo Injectors for 6-Cylinder"
/begin HEADER "_default_HeaderComment" PROJECT_NO _0B /end HEADER
/begin MODULE _default_ModuleName "_default_ModuleLongIdentifier"
/begin MOD_COMMON "_default_ModCommonComment" DEPOSIT ABSOLUTE BYTE_ORDER MSB_LAST ALIGNMENT_BYTE 1 ALIGNMENT_WORD 2 ALIGNMENT_LONG 2 ALIGNMENT_FLOAT32_IEEE 2 ALIGNMENT_FLOAT64_IEEE 4 /end MOD_COMMON
/begin MEASUREMENT fup_mes_mmv "Measured mean value fuel pressure" UWORD _CNV_A_R_LINEAR_____152_CM 1 100. 0. 347776. DISPLAY_IDENTIFIER FUP_MES_MMV ECU_ADDRESS 0xd0004d10 FORMAT "%6.0" /end MEASUREMENT
/begin MEASUREMENT fup_mes "Measured fuel pressure" UWORD _CNV_A_R_LINEAR_____152_CM 1 100. 0. 347776. DISPLAY_IDENTIFIER FUP_MES ECU_ADDRESS 0xc000067c FORMAT "%6.0" /end MEASUREMENT
/begin CHARACTERISTIC ip_fup_mes "Fuel pressure sensor linearisation table" CURVE 0xa1024ae4 _REC_CUR_20_u2_u2 347776. _CNV_A_R_LINEAR_____152_CM 0. 347776. DISPLAY_IDENTIFIER IP_FUP_MES FORMAT "%6.0"
 /begin AXIS_DESCR COM_AXIS v_fup_mv _CNV_A_R_LINEAR_____2_CM 8 0. 4.9951171875 FORMAT "%5.3" AXIS_PTS_REF ldp_v_fup_mv_ip_fup_mes /end AXIS_DESCR
/end CHARACTERISTIC
/begin AXIS_PTS ldp_v_fup_mv_ip_fup_mes "" 0xa102164c v_fup_mv _REC_AXS_20_u2 4.9951171875 _CNV_A_R_LINEAR_____2_CM 8 0. 4.9951171875 FORMAT "%5.3" /end AXIS_PTS
/begin MEASUREMENT v_fup_mv "Mean value of the acquired sensor voltage" UWORD _CNV_A_R_LINEAR_____2_CM 1 100. 0. 4.9951171875 DISPLAY_IDENTIFIER V_FUP_MV ECU_ADDRESS 0xd0004d12 FORMAT "%5.3" /end MEASUREMENT
/begin MEASUREMENT lv_fup_seg "Logical variable indicating the buffer to read the sensor voltage in BSW" UBYTE _CNV_S_2_RANGE__0___1_CM 1 100. 0. 1. DISPLAY_IDENTIFIER LV_FUP_SEG ECU_ADDRESS 0xd00039b8 BIT_MASK 0x1 /end MEASUREMENT
/begin MEASUREMENT fup "Fuel pressure" UWORD _CNV_A_R_LINEAR_____152_CM 1 100. 0. 347776. DISPLAY_IDENTIFIER FUP ECU_ADDRESS 0xd0004d0c FORMAT "%6.0" /end MEASUREMENT
/begin MEASUREMENT fup_h "Fuel pressure, high range" UWORD _CNV_A_R_LINEAR_____152_CM 1 100. 0. 347776. DISPLAY_IDENTIFIER FUP_H ECU_ADDRESS 0xd0004d0e FORMAT "%6.0" /end MEASUREMENT
/begin CHARACTERISTIC c_fup_mes_crlc "Filter constatnt for the measured fuel pressure value" VALUE 0xa1029440 _REC_VAL_20_u1 0.99609375 _CNV_A_R_LINEAR_____27_CM 0. 0.99609375 DISPLAY_IDENTIFIER C_FUP_MES_CRLC FORMAT "%5.3" /end CHARACTERISTIC
/begin CHARACTERISTIC c_fup_ofs_lih_l_prs_ctl_req "Offset for FUP at low pressure control limphome" VALUE 0xa1029446 _REC_VAL_20_u2 173888. _CNV_A_R_LINEAR_____153_CM 0. 173888. DISPLAY_IDENTIFIER C_FUP_OFS_LIH_L_PRS_CTL_REQ FORMAT "%8.1" /end CHARACTERISTIC
/begin MEASUREMENT fup_efp "Fuel pressure efp" UWORD _CNV_A_R_LINEAR_____153_CM 1 100. 0. 173888. DISPLAY_IDENTIFIER FUP_EFP ECU_ADDRESS 0xd0004d54 FORMAT "%8.1" /end MEASUREMENT
/begin MEASUREMENT fup_efp_mes "Measured fuel pressure value in the feedline" UWORD _CNV_A_R_LINEAR_____153_CM 1 100. 0. 173888. DISPLAY_IDENTIFIER FUP_EFP_MES ECU_ADDRESS 0xd0004d56 FORMAT "%8.1" /end MEASUREMENT
/begin CHARACTERISTIC c_fup_efp_mes_crlc "Correlation constant for fuel pressure filter for the low pressure pump" VALUE 0xa1029426 _REC_VAL_20_u1 0.99609375 _CNV_A_R_LINEAR_____27_CM 0. 0.99609375 DISPLAY_IDENTIFIER C_FUP_EFP_MES_CRLC FORMAT "%5.3" /end CHARACTERISTIC
/begin AXIS_PTS ldp_v_fup_efp_ip_fup_efp "" 0xa1021644 v_fup_efp_mv _REC_AXS_20_u2 4.9951171875 _CNV_A_R_LINEAR_____2_CM 3 0. 4.9951171875 FORMAT "%5.3" /end AXIS_PTS
/begin CHARACTERISTIC ip_fup_efp "Fuel pressure sensor linearisation table" CURVE 0xa1024a2c _REC_CUR_20_u2_u2 173888. _CNV_A_R_LINEAR_____153_CM 0. 173888. DISPLAY_IDENTIFIER IP_FUP_EFP FORMAT "%8.1"
 /begin AXIS_DESCR COM_AXIS v_fup_efp_mv _CNV_A_R_LINEAR_____2_CM 3 0. 4.9951171875 FORMAT "%5.3" AXIS_PTS_REF ldp_v_fup_efp_ip_fup_efp /end AXIS_DESCR
/end CHARACTERISTIC
/begin MEASUREMENT fup_efp_mmv "Mean fuel pressure value in the feedline" UWORD _CNV_A_R_LINEAR_____153_CM 1 100. 0. 173888. DISPLAY_IDENTIFIER FUP_EFP_MMV ECU_ADDRESS 0xc00006a8 FORMAT "%8.1" /end MEASUREMENT
/begin CHARACTERISTIC c_fup_efp_lih "Limp home value for fuel pressure of low pressure circuit (opening pressure of safety valve)" VALUE 0xa1029422 _REC_VAL_20_u2 173888. _CNV_A_R_LINEAR_____153_CM 0. 173888. DISPLAY_IDENTIFIER C_FUP_EFP_LIH FORMAT "%8.1" /end CHARACTERISTIC
/begin MEASUREMENT v_fup_efp_mv "Voltage of the low fuel pressure sensor ( for diagnosis)" UWORD _CNV_A_R_LINEAR_____2_CM 1 100. 0. 4.9951171875 DISPLAY_IDENTIFIER V_FUP_EFP_MV ECU_ADDRESS 0xd0004d58 FORMAT "%5.3" /end MEASUREMENT
/begin MEASUREMENT lv_etcu_disable "Logical variable for disabling GS intervention due to EMS error" UBYTE _CNV_S_2_RANGE__0___1_CM 1 100. 0. 1. DISPLAY_IDENTIFIER LV_ETCU_DISABLE ECU_ADDRESS 0xd0003eb1 BIT_MASK 0x1 /end MEASUREMENT
/begin MEASUREMENT lv_etcu_disable_can "logical variable for disabling GS intervention due to CAN error" UBYTE _CNV_S_2_RANGE__0___1_CM 1 100. 0. 1. DISPLAY_IDENTIFIER LV_ETCU_DISABLE_CAN ECU_ADDRESS 0xd0003eb2 BIT_MASK 0x1 /end MEASUREMENT
/begin MEASUREMENT lv_gs_ena_dec "logical variable for decreased torque intervention due to gear shift" UBYTE _CNV_S_2_RANGE__0___1_CM 1 100. 0. 1. DISPLAY_IDENTIFIER LV_GS_ENA_DEC ECU_ADDRESS 0xd0003eb3 BIT_MASK 0x1 /end MEASUREMENT
/begin MEASUREMENT lv_gs_ena "Logical variable for GS intervention enabling" UBYTE _CNV_S_2_RANGE__0___1_CM 1 100. 0. 1. DISPLAY_IDENTIFIER LV_GS_ENA ECU_ADDRESS 0xc00006ee BIT_MASK 0x1 /end MEASUREMENT
/begin CHARACTERISTIC c_t_max_tqr_gs_intv "Maximum duration of torque reduction due gear shift intervention" VALUE 0xa10298e0 _REC_VAL_20_u2 655.35 _CNV_A_R_LINEAR_____3_CM 0. 655.35 DISPLAY_IDENTIFIER C_T_MAX_TQR_GS_INTV FORMAT "%6.2" /end CHARACTERISTIC
/begin MEASUREMENT tqi_gs_fast_dec_req_1 "Torque decrement for fast torque intervention during gear shift" SWORD _CNV_A_R_LINEAR_____30_CM 1 100. -1024. 1023.96875 DISPLAY_IDENTIFIER TQI_GS_FAST_DEC_REQ_1 ECU_ADDRESS 0xd00052c6 FORMAT "%8.2" /end MEASUREMENT
/begin MEASUREMENT tqi_gs_slow_dec_req "Torque decrement for slow torque intervention during gear shift" SWORD _CNV_A_R_LINEAR_____30_CM 1 100. -1024. 1023.96875 DISPLAY_IDENTIFIER TQI_GS_SLOW_DEC_REQ ECU_ADDRESS 0xd00052c0 FORMAT "%8.2" /end MEASUREMENT
/begin MEASUREMENT tqi_gs_fast_inc_req_1 "torque increase for fast torque intervention during gear shift" SWORD _CNV_A_R_LINEAR_____30_CM 1 100. -1024. 1023.96875 DISPLAY_IDENTIFIER TQI_GS_FAST_INC_REQ_1 ECU_ADDRESS 0xd00052ca FORMAT "%8.2" /end MEASUREMENT
/begin MEASUREMENT tqi_gs_slow_inc_req "torque increase for slow torque intervention during gear shift" SWORD _CNV_A_R_LINEAR_____30_CM 1 100. -1024. 1023.96875 DISPLAY_IDENTIFIER TQI_GS_SLOW_INC_REQ ECU_ADDRESS 0xd00052c4 FORMAT "%8.2" /end MEASUREMENT
/begin MEASUREMENT t_tqr_gs_intv "duration of gear shift torque intervention" UWORD _CNV_A_R_LINEAR_____3_CM 1 100. 0. 655.35 DISPLAY_IDENTIFIER T_TQR_GS_INTV ECU_ADDRESS 0xd00052bc FORMAT "%6.2" /end MEASUREMENT
/begin MEASUREMENT tqi_gs_fast_dec_req "Torque decrement for fast torque intervention during gear shift" SWORD _CNV_A_R_LINEAR_____30_CM 1 100. -1024. 1023.96875 DISPLAY_IDENTIFIER TQI_GS_FAST_DEC_REQ ECU_ADDRESS 0xd00052be FORMAT "%8.2" /end MEASUREMENT
/begin MEASUREMENT tqi_gs_fast_dec "torque decrement for fast torque intervention during gear shift" SWORD _CNV_A_R_LINEAR_____30_CM 1 100. -1024. 1023.96875 DISPLAY_IDENTIFIER TQI_GS_FAST_DEC ECU_ADDRESS 0xd00052ce FORMAT "%8.2" /end MEASUREMENT
/begin MEASUREMENT tqi_gs_slow_dec_req_1 "Torque decrement for slow torque intervention during gear shift" SWORD _CNV_A_R_LINEAR_____30_CM 1 100. -1024. 1023.96875 DISPLAY_IDENTIFIER TQI_GS_SLOW_DEC_REQ_1 ECU_ADDRESS 0xd00052c8 FORMAT "%8.2" /end MEASUREMENT
/begin MEASUREMENT tqi_gs_slow_dec "Torque decrement for slow torque intervention during gear shift" SWORD _CNV_A_R_LINEAR_____30_CM 1 100. -1024. 1023.96875 DISPLAY_IDENTIFIER TQI_GS_SLOW_DEC ECU_ADDRESS 0xd00052d0 FORMAT "%8.2" /end MEASUREMENT
/begin MEASUREMENT lv_gs_ena_inc "logical variable for increased torque intervention due to gear shift" UBYTE _CNV_S_2_RANGE__0___1_CM 1 100. 0. 1. DISPLAY_IDENTIFIER LV_GS_ENA_INC ECU_ADDRESS 0xd0003eb4 BIT_MASK 0x1 /end MEASUREMENT
/begin MEASUREMENT lv_gs_dec_lih "logical variable for torque intervention LIH due to gear shift" UBYTE _CNV_S_2_RANGE__0___1_CM 1 100. 0. 1. DISPLAY_IDENTIFIER LV_GS_DEC_LIH ECU_ADDRESS 0xc00006ef BIT_MASK 0x1 /end MEASUREMENT
/begin CHARACTERISTIC c_gs_ena_inc_dec "Enable switch GS intervention" VALUE 0xa1029494 _REC_VAL_20_u1 3. _CNV_S_4_STATE_AMT__164_CM 0. 3. DISPLAY_IDENTIFIER C_GS_ENA_INC_DEC /end CHARACTERISTIC
/begin MEASUREMENT tqi_gs_fast_inc_req "torque increase for fast torque intervention during gear shift" SWORD _CNV_A_R_LINEAR_____30_CM 1 100. -1024. 1023.96875 DISPLAY_IDENTIFIER TQI_GS_FAST_INC_REQ ECU_ADDRESS 0xd00052c2 FORMAT "%8.2" /end MEASUREMENT
/begin MEASUREMENT tqi_gs_fast_inc "torque increase for fast torque intervention during gear shift" SWORD _CNV_A_R_LINEAR_____30_CM 1 100. -1024. 1023.96875 DISPLAY_IDENTIFIER TQI_GS_FAST_INC ECU_ADDRESS 0xd00052d2 FORMAT "%8.2" /end MEASUREMENT
/begin MEASUREMENT tqi_gs_slow_inc_req_1 "torque increase for slow torque intervention during gear shift" SWORD _CNV_A_R_LINEAR_____30_CM 1 100. -1024. 1023.96875 DISPLAY_IDENTIFIER TQI_GS_SLOW_INC_REQ_1 ECU_ADDRESS 0xd00052cc FORMAT "%8.2" /end MEASUREMENT
/begin MEASUREMENT tqi_gs_slow_inc "torque increase for slow torque intervention during gear shift" SWORD _CNV_A_R_LINEAR_____30_CM 1 100. -1024. 1023.96875 DISPLAY_IDENTIFIER TQI_GS_SLOW_INC ECU_ADDRESS 0xd00052d4 FORMAT "%8.2" /end MEASUREMENT
/begin MEASUREMENT lv_gs_dec_act "logical variable for torque intervention due to gear shift" UBYTE _CNV_S_2_RANGE__0___1_CM 1 100. 0. 1. DISPLAY_IDENTIFIER LV_GS_DEC_ACT ECU_ADDRESS 0xd0003eb5 BIT_MASK 0x1 /end MEASUREMENT
/begin MEASUREMENT lv_gs_inc_lih "logical variable for torque intervention LIH due to gear shift" UBYTE _CNV_S_2_RANGE__0___1_CM 1 100. 0. 1. DISPLAY_IDENTIFIER LV_GS_INC_LIH ECU_ADDRESS 0xd0003eb7 BIT_MASK 0x1 /end MEASUREMENT
/begin CHARACTERISTIC c_lgrd_lih_gs_dec "limiting gradient for GS emergency ramp function (default  0.6 Nm/10ms)" VALUE 0xa1029522 _REC_VAL_20_u2 1023.96875 _CNV_A_R_LINEAR_____165_CM 0. 1023.96875 DISPLAY_IDENTIFIER C_LGRD_LIH_GS_DEC FORMAT "%7.2" /end CHARACTERISTIC
/begin CHARACTERISTIC c_lgrd_lih_gs_inc "limiting gradient for GS emergency ramp function (default  0.6 Nm/10ms)" VALUE 0xa1029524 _REC_VAL_20_u2 1023.96875 _CNV_A_R_LINEAR_____165_CM 0. 1023.96875 DISPLAY_IDENTIFIER C_LGRD_LIH_GS_INC FORMAT "%7.2" /end CHARACTERISTIC
/begin CHARACTERISTIC c_t_dly_lih_gs_dec "delay time for activation of GS emergency ramp function (default 0s)" VALUE 0xa102986a _REC_VAL_20_u1 2.55 _CNV_A_R_LINEAR_____3_CM 0. 2.55 DISPLAY_IDENTIFIER C_T_DLY_LIH_GS_DEC FORMAT "%4.2" /end CHARACTERISTIC
/begin CHARACTERISTIC c_t_dly_lih_gs_inc "delay time for activation of GS emergency ramp function (default 0s)" VALUE 0xa102986b _REC_VAL_20_u1 2.55 _CNV_A_R_LINEAR_____3_CM 0. 2.55 DISPLAY_IDENTIFIER C_T_DLY_LIH_GS_INC FORMAT "%4.2" /end CHARACTERISTIC
/begin MEASUREMENT lv_gs_inc_act "logical variable for torque intervention due to gear shift" UBYTE _CNV_S_2_RANGE__0___1_CM 1 100. 0. 1. DISPLAY_IDENTIFIER LV_GS_INC_ACT ECU_ADDRESS 0xd0003eb6 BIT_MASK 0x1 /end MEASUREMENT
/begin MEASUREMENT t_gs_inc_lih_ctr "delay time for activation of GS emergency ramp function " UBYTE _CNV_A_R_LINEAR_____3_CM 1 100. 0. 2.55 DISPLAY_IDENTIFIER T_GS_INC_LIH_CTR ECU_ADDRESS 0xc00006ed FORMAT "%4.2" /end MEASUREMENT
/begin MEASUREMENT t_gs_dec_lih_ctr "delay time for activation of GS emergency ramp function" UBYTE _CNV_A_R_LINEAR_____3_CM 1 100. 0. 2.55 DISPLAY_IDENTIFIER T_GS_DEC_LIH_CTR ECU_ADDRESS 0xc00006ec FORMAT "%4.2" /end MEASUREMENT
/begin MEASUREMENT state_tq_etcu_plaus "Bitwise coded State for ETCU intervention state" UBYTE _CNV_A_R_LINEAR_____0_CM 1 100. 0. 255. DISPLAY_IDENTIFIER STATE_TQ_ETCU_PLAUS ECU_ADDRESS 0xd0003eb0 FORMAT "%3.0" /end MEASUREMENT
/begin CHARACTERISTIC ip_fac_tq_loss_acc_on "TQ_LOSS_ACC weighting factor at ACC activation" MAP 0xa10245a8 _REC_MAP_20_u1_u1_u1 1.99220002 _CNV_A_R_LINEAR_____97_CM 0. 1.99220002 DISPLAY_IDENTIFIER IP_FAC_TQ_LOSS_ACC_ON FORMAT "%5.3"
 /begin AXIS_DESCR COM_AXIS t_acc _CNV_A_R_LINEAR_____3_CM 8 0. 2.55 FORMAT "%4.2" AXIS_PTS_REF ldp_t_acc_ip_fac_tq_loss_acc_on /end AXIS_DESCR
 /begin AXIS_DESCR COM_AXIS n_32 _CNV_A_R_LINEAR_____9_CM 8 0. 8160. FORMAT "%4.0" AXIS_PTS_REF ldp_n_32_ip_fac_tq_loss_acc_on /end AXIS_DESCR
/end CHARACTERISTIC
/begin CHARACTERISTIC ip_fac_tq_loss_acc_off "TQ_LOSS_ACC weighting factor at ACC deactivation" CURVE 0xa10245a0 _REC_CUR_20_u1_u1 1.99220002 _CNV_A_R_LINEAR_____97_CM 0. 1.99220002 DISPLAY_IDENTIFIER IP_FAC_TQ_LOSS_ACC_OFF FORMAT "%5.3"
 /begin AXIS_DESCR COM_AXIS t_acc _CNV_A_R_LINEAR_____3_CM 8 0. 2.55 FORMAT "%4.2" AXIS_PTS_REF ldp_t_acc_fac_tq_loss_acc /end AXIS_DESCR
/end CHARACTERISTIC
/begin MEASUREMENT tq_add_acc "Torque reserve for switching on air conditioning compressor" SWORD _CNV_A_R_LINEAR_____30_CM 1 100. -1024. 1023.96875 DISPLAY_IDENTIFIER TQ_ADD_ACC ECU_ADDRESS 0xd0005302 FORMAT "%7.1" /end MEASUREMENT
/begin MEASUREMENT tq_loss_acc "Engine torque losses air conditioning compressor" SWORD _CNV_A_R_LINEAR_____30_CM 1 100. -1024. 1023.96875 DISPLAY_IDENTIFIER TQ_LOSS_ACC ECU_ADDRESS 0xd0005300 FORMAT "%8.2" /end MEASUREMENT
/begin MEASUREMENT tq_add_heat_acc "Torque reserve for switching on additional heating by ACC" SWORD _CNV_A_R_LINEAR_____30_CM 1 100. -1024. 1023.96875 DISPLAY_IDENTIFIER TQ_ADD_HEAT_ACC ECU_ADDRESS 0xd0005304 FORMAT "%8.2" /end MEASUREMENT
/begin MEASUREMENT lv_tout_acc "logical variable to start deactivation of torque reserve and condition for switch off TQ_LOSS_ACC calculation" UBYTE _CNV_S_2_RANGE__0___1_CM 1 100. 0. 1. DISPLAY_IDENTIFIER LV_TOUT_ACC ECU_ADDRESS 0xd0003dbc BIT_MASK 0x1 /end MEASUREMENT
/begin MEASUREMENT lv_req_heat_acc_ena "LV indicating that the conditions for additional heating are fulfilled" UBYTE _CNV_S_2_RANGE__0___1_CM 1 100. 0. 1. DISPLAY_IDENTIFIER LV_REQ_HEAT_ACC_ENA ECU_ADDRESS 0xd0003ecc BIT_MASK 0x1 /end MEASUREMENT
/begin MEASUREMENT lv_tout_req_heat_acc "logical variable to start deactivation of torque reserve TQ_ADD_HEAT_ACC" UBYTE _CNV_S_2_RANGE__0___1_CM 1 100. 0. 1. DISPLAY_IDENTIFIER LV_TOUT_REQ_HEAT_ACC ECU_ADDRESS 0xd0003ecd BIT_MASK 0x1 /end MEASUREMENT
/begin MEASUREMENT t_req_heat_acc "timer for duration of torque reserve TQ_ADD_HEAT_ACC calculation" ULONG _CNV_A_R_LINEAR_____3_CM 1 100. 0. 42949672.95 DISPLAY_IDENTIFIER T_REQ_HEAT_ACC ECU_ADDRESS 0xd0005804 FORMAT "%11.2" /end MEASUREMENT
/begin CHARACTERISTIC ip_tq_add_acc "Torque reserve for switching on air conditioning compressor" MAP 0xa1028188 _REC_MAP_20_u2_u1_u2 2047.96875 _CNV_A_R_LINEAR_____65_CM -1024. 1023.96875 DISPLAY_IDENTIFIER IP_TQ_ADD_ACC FORMAT "%6.2"
 /begin AXIS_DESCR COM_AXIS n_32 _CNV_A_R_LINEAR_____9_CM 6 0. 8160. FORMAT "%4.0" AXIS_PTS_REF ldp_n_32__tq_add_acc /end AXIS_DESCR
 /begin AXIS_DESCR COM_AXIS tq_loss_acc_inp _CNV_A_R_LINEAR_____65_CM 6 -1024. 1023.96875 FORMAT "%6.2" AXIS_PTS_REF ldp_tq_loss_acc_inp__tq_add_acc /end AXIS_DESCR
/end CHARACTERISTIC
/begin CHARACTERISTIC ip_tq_add_heat_acc "Torque reserve for switching on additional heating" CURVE 0xa10282b4 _REC_CUR_20_u2_u1 2047.96875 _CNV_A_R_LINEAR_____65_CM -1024. 1023.96875 DISPLAY_IDENTIFIER IP_TQ_ADD_HEAT_ACC FORMAT "%6.2"
 /begin AXIS_DESCR COM_AXIS n_32 _CNV_A_R_LINEAR_____9_CM 6 0. 8160. FORMAT "%4.0" AXIS_PTS_REF ldp_n_32__tq_add_heat_acc /end AXIS_DESCR
/end CHARACTERISTIC
/begin CHARACTERISTIC c_tq_add_acc_lgrd "Limitation gradiant for TQ_ADD_ACC decrease after deactivation" VALUE 0xa1029ada _REC_VAL_20_u2 1023.96875 _CNV_A_R_LINEAR_____30_CM 0. 1023.96875 DISPLAY_IDENTIFIER C_TQ_ADD_ACC_LGRD FORMAT "%7.2" /end CHARACTERISTIC
/begin CHARACTERISTIC c_tq_add_heat_acc_lgrd "Limitation gradient for TQ_ADD_HEAT_ACC decrease after deactivation" VALUE 0xa1029ae2 _REC_VAL_20_u2 1023.96875 _CNV_A_R_LINEAR_____30_CM 0. 1023.96875 DISPLAY_IDENTIFIER C_TQ_ADD_HEAT_ACC_LGRD FORMAT "%7.2" /end CHARACTERISTIC
/begin CHARACTERISTIC c_tco_min_req_heat_acc "TCO threshold for enabling additional heat request" VALUE 0xa10299e7 _REC_VAL_20_u1 190.5 _CNV_A_R_LINEAR_____16_CM -48. 142.5 DISPLAY_IDENTIFIER C_TCO_MIN_REQ_HEAT_ACC FORMAT "%5.1" /end CHARACTERISTIC
/begin CHARACTERISTIC c_tam_min_req_heat_acc "TAM threshold for enabling additional heat request" VALUE 0xa10299c2 _REC_VAL_20_u1 190.5 _CNV_A_R_LINEAR_____16_CM -48. 142.5 DISPLAY_IDENTIFIER C_TAM_MIN_REQ_HEAT_ACC FORMAT "%5.1" /end CHARACTERISTIC
/begin CHARACTERISTIC c_tq_loss_max_acc "Maximum TQ_LOSS_ACC" VALUE 0xa1029b16 _REC_VAL_20_s2 2047.96875 _CNV_A_R_LINEAR_____30_CM -1024. 1023.96875 DISPLAY_IDENTIFIER C_TQ_LOSS_MAX_ACC FORMAT "%8.2" /end CHARACTERISTIC
/begin AXIS_PTS ldp_t_acc_ip_fac_tq_loss_acc_on "" 0xa1021184 t_acc _REC_AXS_20_u1 2.55 _CNV_A_R_LINEAR_____3_CM 8 0. 2.55 FORMAT "%4.2" /end AXIS_PTS
/begin AXIS_PTS ldp_n_32_ip_fac_tq_loss_acc_on "" 0xa1020e0c n_32 _REC_AXS_20_u1 8160. _CNV_A_R_LINEAR_____9_CM 8 0. 8160. FORMAT "%4.0" /end AXIS_PTS
/begin AXIS_PTS ldp_n_32__tq_add_acc "" 0xa1020db8 n_32 _REC_AXS_20_u1 8160. _CNV_A_R_LINEAR_____9_CM 6 0. 8160. FORMAT "%4.0" /end AXIS_PTS
/begin AXIS_PTS ldp_t_acc_fac_tq_loss_acc "" 0xa1021178 t_acc _REC_AXS_20_u1 2.55 _CNV_A_R_LINEAR_____3_CM 8 0. 2.55 FORMAT "%4.2" /end AXIS_PTS
/begin AXIS_PTS ldp_n_32__tq_add_heat_acc "" 0xa1020dc0 n_32 _REC_AXS_20_u1 8160. _CNV_A_R_LINEAR_____9_CM 6 0. 8160. FORMAT "%4.0" /end AXIS_PTS
/begin MEASUREMENT tq_loss_acc_inp "ACC-torque for torque function" SWORD _CNV_A_R_LINEAR_____30_CM 1 100. -1024. 1023.96875 DISPLAY_IDENTIFIER TQ_LOSS_ACC_INP ECU_ADDRESS 0xc0000d0c FORMAT "%8.2" /end MEASUREMENT
/begin CHARACTERISTIC c_crlc_tq_loss_acc_inp "Correlation factor for TQ_ACCIN_CAN calculation" VALUE 0xa102923a _REC_VAL_20_u1 0.99609375 _CNV_A_R_LINEAR_____27_CM 0. 0.99609375 DISPLAY_IDENTIFIER C_CRLC_TQ_LOSS_ACC_INP FORMAT "%5.3" /end CHARACTERISTIC
/begin AXIS_PTS ldp_tq_loss_acc_inp__tq_add_acc "" 0xa1021530 tq_loss_acc_inp _REC_AXS_20_u2 2047.96875 _CNV_A_R_LINEAR_____65_CM 6 -1024. 1023.96875 FORMAT "%6.2" /end AXIS_PTS
/begin CHARACTERISTIC c_tq_add_acc_lgrd_on "Limitation gradiant for TQ_ADD_ACC increase at activation" VALUE 0xa1029adc _REC_VAL_20_u2 1023.96875 _CNV_A_R_LINEAR_____30_CM 0. 1023.96875 DISPLAY_IDENTIFIER C_TQ_ADD_ACC_LGRD_ON FORMAT "%7.2" /end CHARACTERISTIC
/begin CHARACTERISTIC c_t_req_heat_acc "time for duration of torque reserve TQ_ADD_HEAT_ACC calculation" VALUE 0xa1029958 _REC_VAL_20_u4 42949672.95 _CNV_A_R_LINEAR_____3_CM 0. 42949672.95 DISPLAY_IDENTIFIER C_T_REQ_HEAT_ACC FORMAT "%11.2" /end CHARACTERISTIC
/begin MEASUREMENT tq_conv_can_1 "converter torque of CAN" SWORD _CNV_A_R_LINEAR_____30_CM 1 100. -1024. 1023.96875 DISPLAY_IDENTIFIER TQ_CONV_CAN_1 ECU_ADDRESS 0xd000530a FORMAT "%6.2" /end MEASUREMENT
/begin MEASUREMENT tq_add_conv "Torque reserve for switching converter Torque" SWORD _CNV_A_R_LINEAR_____30_CM 1 100. -1024. 1023.96875 DISPLAY_IDENTIFIER TQ_ADD_CONV ECU_ADDRESS 0xd000530c FORMAT "%6.2" /end MEASUREMENT
/begin MEASUREMENT lv_tout_conv "logical variable to start deactivation of torque reserve and condition for switch off TQ_CONV calculation" UBYTE _CNV_S_2_RANGE__0___1_CM 1 100. 0. 1. DISPLAY_IDENTIFIER LV_TOUT_CONV ECU_ADDRESS 0xc0000d2d BIT_MASK 0x1 /end MEASUREMENT
/begin MEASUREMENT t_conv "timer for duration of transient TQ_LOSS_CONV correction" UWORD _CNV_A_R_LINEAR_____3_CM 1 100. 0. 5.1 DISPLAY_IDENTIFIER T_CONV ECU_ADDRESS 0xc0000d1c FORMAT "%4.2" /end MEASUREMENT
/begin MEASUREMENT tq_clu_amt "converter torque" SWORD _CNV_A_R_LINEAR_____30_CM 1 100. -1024. 1023.96875 DISPLAY_IDENTIFIER TQ_CLU_AMT ECU_ADDRESS 0xd0005312 FORMAT "%8.2" /end MEASUREMENT
/begin MEASUREMENT lv_amt_crawl_on "Active AMT clutch torque" UBYTE _CNV_S_2_RANGE__0___1_CM 1 100. 0. 1. DISPLAY_IDENTIFIER LV_AMT_CRAWL_ON ECU_ADDRESS 0xd0003ed1 BIT_MASK 0x1 /end MEASUREMENT
/begin CHARACTERISTIC ip_tq_amt "AMT torque offset" CURVE 0xa10284c8 _REC_CUR_20_u2_u1 2047.96875 _CNV_A_R_LINEAR_____65_CM -1024. 1023.96875 DISPLAY_IDENTIFIER IP_TQ_AMT FORMAT "%6.2"
 /begin AXIS_DESCR COM_AXIS tco _CNV_A_R_LINEAR_____16_CM 6 -48. 142.5 FORMAT "%5.1" AXIS_PTS_REF ldp_tco__tq_clu_amt /end AXIS_DESCR
/end CHARACTERISTIC
/begin CHARACTERISTIC ip_tq_vs_fil_amt "AMT torque offset by VS and N_DIF" MAP 0xa1028f50 _REC_MAP_20_u2_u2_u2 2047.96875 _CNV_A_R_LINEAR_____65_CM -1024. 1023.96875 DISPLAY_IDENTIFIER IP_TQ_VS_FIL_AMT FORMAT "%6.2"
 /begin AXIS_DESCR COM_AXIS vs_fil _CNV_A_R_LINEAR_____66_CM 6 0. 511.99218 FORMAT "%7.3" AXIS_PTS_REF ldp_vs_fil__tq_clu_amt /end AXIS_DESCR
 /begin AXIS_DESCR COM_AXIS n_dif _CNV_A_R_LINEAR_____172_CM 6 -32768. 32767. FORMAT "%6.0" AXIS_PTS_REF ldp_n_dif__tq_clu_amt /end AXIS_DESCR
/end CHARACTERISTIC
/begin CHARACTERISTIC c_tq_add_conv_lgrd "Limitation gradient for TQ_ADD_CONV decrease after deactivation" VALUE 0xa1029ae0 _REC_VAL_20_u2 1023.96875 _CNV_A_R_LINEAR_____30_CM 0. 1023.96875 DISPLAY_IDENTIFIER C_TQ_ADD_CONV_LGRD FORMAT "%7.2" /end CHARACTERISTIC
/begin MEASUREMENT tq_add_trans "Torque reserve for Transmission" SWORD _CNV_A_R_LINEAR_____30_CM 1 100. -1024. 1023.96875 DISPLAY_IDENTIFIER TQ_ADD_TRANS ECU_ADDRESS 0xd000530e FORMAT "%8.2" /end MEASUREMENT
/begin MEASUREMENT tq_add_amt "Torque reserve for switching AMT Torque" SWORD _CNV_A_R_LINEAR_____30_CM 1 100. -1024. 1023.96875 DISPLAY_IDENTIFIER TQ_ADD_AMT ECU_ADDRESS 0xd0005314 FORMAT "%8.2" /end MEASUREMENT
/begin MEASUREMENT lv_tout_amt "logical variable to start deactivation of torque reserve and condition for switch off AMT calculation" UBYTE _CNV_S_2_RANGE__0___1_CM 1 100. 0. 1. DISPLAY_IDENTIFIER LV_TOUT_AMT ECU_ADDRESS 0xd0003ed2 BIT_MASK 0x1 /end MEASUREMENT
/begin MEASUREMENT t_amt "timer for duration of transient TQ_LOSS_AMT correction" UWORD _CNV_A_R_LINEAR_____3_CM 1 100. 0. 5.1 DISPLAY_IDENTIFIER T_AMT ECU_ADDRESS 0xc0000d1e FORMAT "%4.2" /end MEASUREMENT
/begin CHARACTERISTIC ip_tq_add_conv "Torque reserve for switch GS" MAP 0xa10281dc _REC_MAP_20_u2_u1_u1 2047.96875 _CNV_A_R_LINEAR_____65_CM -1024. 1023.96875 DISPLAY_IDENTIFIER IP_TQ_ADD_CONV FORMAT "%6.2"
 /begin AXIS_DESCR COM_AXIS n_32 _CNV_A_R_LINEAR_____9_CM 6 0. 8160. FORMAT "%4.0" AXIS_PTS_REF ldp_n_32_ip_tq_add_conv /end AXIS_DESCR
 /begin AXIS_DESCR COM_AXIS toil _CNV_A_R_LINEAR_____25_CM 6 -40. 160. FORMAT "%3.0" AXIS_PTS_REF ldpm_toil_tq_add_conv /end AXIS_DESCR
/end CHARACTERISTIC
/begin CHARACTERISTIC ip_tq_add_amt "Torque reserve for switching on AMT" CURVE 0xa10281d0 _REC_CUR_20_u2_u1 2047.96875 _CNV_A_R_LINEAR_____65_CM -1024. 1023.96875 DISPLAY_IDENTIFIER IP_TQ_ADD_AMT FORMAT "%6.2"
 /begin AXIS_DESCR COM_AXIS n_32 _CNV_A_R_LINEAR_____9_CM 6 0. 8160. FORMAT "%4.0" AXIS_PTS_REF ldp_n_32_ip_tq_add_amt /end AXIS_DESCR
/end CHARACTERISTIC
/begin MEASUREMENT lv_dly_n_sp_is "Flag for idle speed setpoint change" UBYTE _CNV_S_2_RANGE__0___1_CM 1 100. 0. 1. DISPLAY_IDENTIFIER LV_DLY_N_SP_IS ECU_ADDRESS 0xd0003ed0 BIT_MASK 0x1 /end MEASUREMENT
/begin MEASUREMENT tq_conv_stn "Stationary Converter Torque" SWORD _CNV_A_R_LINEAR_____30_CM 1 100. -1024. 1023.96875 DISPLAY_IDENTIFIER TQ_CONV_STN ECU_ADDRESS 0xc0000d24 FORMAT "%6.2" /end MEASUREMENT
/begin CHARACTERISTIC lc_tq_conv_dri_inh "logical constant converter torque calculation at LV_DRI = 0 inhibit" VALUE 0xa1029df7 _REC_VAL_20_u1 1. _CNV_A_R_LINEAR_____0_CM 0. 1. DISPLAY_IDENTIFIER LC_TQ_CONV_DRI_INH FORMAT "%2.0" /end CHARACTERISTIC
/begin CHARACTERISTIC lc_tq_conv_can_inh "logical constant converter torque by CAN-interface inhibit" VALUE 0xa1029df6 _REC_VAL_20_u1 1. _CNV_A_R_LINEAR_____0_CM 0. 1. DISPLAY_IDENTIFIER LC_TQ_CONV_CAN_INH FORMAT "%2.0" /end CHARACTERISTIC
/begin CHARACTERISTIC ip_fac_conv__toil "Converter characteristic" CURVE 0xa102345c _REC_CUR_20_u2_u1 4.88e-004 _CNV_A_R_LINEAR_____273_CM 0. 4.88e-004 DISPLAY_IDENTIFIER IP_FAC_CONV__TOIL FORMAT "%8.7"
 /begin AXIS_DESCR COM_AXIS toil _CNV_A_R_LINEAR_____25_CM 8 -40. 160. FORMAT "%3.0" AXIS_PTS_REF ldp_toil_fac_conv /end AXIS_DESCR
/end CHARACTERISTIC
/begin CHARACTERISTIC ip_fac_conv_dri__toil "Converter characteristic" CURVE 0xa102346c _REC_CUR_20_u2_u1 4.88e-004 _CNV_A_R_LINEAR_____273_CM 0. 4.88e-004 DISPLAY_IDENTIFIER IP_FAC_CONV_DRI__TOIL FORMAT "%8.7"
 /begin AXIS_DESCR COM_AXIS toil _CNV_A_R_LINEAR_____25_CM 8 -40. 160. FORMAT "%3.0" AXIS_PTS_REF ldp_toil_fac_conv /end AXIS_DESCR
/end CHARACTERISTIC
/begin CHARACTERISTIC ip_t_dly_conv__toil "Time delay for TQ_CONV activation" CURVE 0xa1027c24 _REC_CUR_20_u1_u1 2550. _CNV_A_R_LINEAR_____18_CM 0. 2550. DISPLAY_IDENTIFIER IP_T_DLY_CONV__TOIL FORMAT "%4.0"
 /begin AXIS_DESCR COM_AXIS toil _CNV_A_R_LINEAR_____25_CM 8 -40. 160. FORMAT "%3.0" AXIS_PTS_REF ldp_toil_t_dly_conv /end AXIS_DESCR
/end CHARACTERISTIC
/begin CHARACTERISTIC ip_t_dly_n_sp_is__toil "Time delay for change of idle speed setpoint " CURVE 0xa1027c34 _REC_CUR_20_u1_u1 2550. _CNV_A_R_LINEAR_____18_CM 0. 2550. DISPLAY_IDENTIFIER IP_T_DLY_N_SP_IS__TOIL FORMAT "%4.0"
 /begin AXIS_DESCR COM_AXIS toil _CNV_A_R_LINEAR_____25_CM 8 -40. 160. FORMAT "%3.0" AXIS_PTS_REF ldp_toil_t_dly_n_sp_is /end AXIS_DESCR
/end CHARACTERISTIC
/begin CHARACTERISTIC ip_fac_tq_conv__n_ratio_conv "Torque request factor" CURVE 0xa1024404 _REC_CUR_20_u2_u1 1.99996948242188 _CNV_A_R_LINEAR_____8_CM 0. 1.99996948242188 DISPLAY_IDENTIFIER IP_FAC_TQ_CONV__N_RATIO_CONV FORMAT "%7.5"
 /begin AXIS_DESCR COM_AXIS n_ratio_conv _CNV_A_R_LINEAR_____27_CM 8 0. 0.99609375 FORMAT "%5.3" AXIS_PTS_REF ldp_n_ratio_conv_fac_tq_conv /end AXIS_DESCR
/end CHARACTERISTIC
/begin CHARACTERISTIC c_tq_thd_amt_isc "Threshold look  ISC" VALUE 0xa1029b2c _REC_VAL_20_u2 1023.96875 _CNV_A_R_LINEAR_____30_CM 0. 1023.96875 DISPLAY_IDENTIFIER C_TQ_THD_AMT_ISC FORMAT "%7.2" /end CHARACTERISTIC
/begin CHARACTERISTIC c_tq_add_amt_lgrd "Limitation gradient for TQ_ADD_AMT decrease after deactivation" VALUE 0xa1029ade _REC_VAL_20_u2 1023.96875 _CNV_A_R_LINEAR_____30_CM 0. 1023.96875 DISPLAY_IDENTIFIER C_TQ_ADD_AMT_LGRD FORMAT "%7.2" /end CHARACTERISTIC
/begin CHARACTERISTIC c_tq_lgrd_crawl_inc "????" VALUE 0xa1029b08 _REC_VAL_20_u2 1023.96875 _CNV_A_R_LINEAR_____30_CM 0. 1023.96875 DISPLAY_IDENTIFIER C_TQ_LGRD_CRAWL_INC FORMAT "%7.2" /end CHARACTERISTIC
/begin CHARACTERISTIC c_tq_lgrd_crawl_dec "????" VALUE 0xa1029b06 _REC_VAL_20_u2 1023.96875 _CNV_A_R_LINEAR_____30_CM 0. 1023.96875 DISPLAY_IDENTIFIER C_TQ_LGRD_CRAWL_DEC FORMAT "%7.2" /end CHARACTERISTIC
/begin MEASUREMENT tq_conv "Converter Torque" SWORD _CNV_A_R_LINEAR_____30_CM 1 100. -1024. 1023.96875 DISPLAY_IDENTIFIER TQ_CONV ECU_ADDRESS 0xd0005308 FORMAT "%6.2" /end MEASUREMENT
/begin CHARACTERISTIC ip_n_tur__gr_at__vs "Turbine speed" MAP 0xa102656c _REC_MAP_20_u2_u1_u1 65535. _CNV_A_R_LINEAR_____13_CM 0. 65535. DISPLAY_IDENTIFIER IP_N_TUR__GR_AT__VS FORMAT "%5.0"
 /begin AXIS_DESCR COM_AXIS gr_at _CNV_A_R_LINEAR_____0_CM 13 0. 8. FORMAT "%1.0" AXIS_PTS_REF ldp_gr_at_n_tur /end AXIS_DESCR
 /begin AXIS_DESCR COM_AXIS vs _CNV_A_R_LINEAR_____6_CM 2 0. 255. FORMAT "%3.0" AXIS_PTS_REF ldp_vs_n_tur /end AXIS_DESCR
/end CHARACTERISTIC
/begin CHARACTERISTIC ip_tq_conv_can "Corrected Converter tourque via N_32" MAP 0xa10284d4 _REC_MAP_20_u2_u1_u2 2047.96875 _CNV_A_R_LINEAR_____65_CM -1024. 1023.96875 DISPLAY_IDENTIFIER IP_TQ_CONV_CAN FORMAT "%6.2"
 /begin AXIS_DESCR COM_AXIS n_32 _CNV_A_R_LINEAR_____9_CM 8 0. 8160. FORMAT "%4.0" AXIS_PTS_REF ldp_n_32__tq_conv /end AXIS_DESCR
 /begin AXIS_DESCR COM_AXIS tq_conv_can _CNV_A_R_LINEAR_____65_CM 8 -1024. 1023.96875 FORMAT "%6.2" AXIS_PTS_REF ldp_tq_conv_can__tq_conv /end AXIS_DESCR
/end CHARACTERISTIC
/begin AXIS_PTS ldp_tco__tq_clu_amt "" 0xa10212a0 tco _REC_AXS_20_u1 190.5 _CNV_A_R_LINEAR_____16_CM 6 -48. 142.5 FORMAT "%5.1" /end AXIS_PTS
/begin AXIS_PTS ldp_n_dif__tq_clu_amt "" 0xa1020ed4 n_dif _REC_AXS_20_u2 65535. _CNV_A_R_LINEAR_____172_CM 6 -32768. 32767. FORMAT "%6.0" /end AXIS_PTS
/begin AXIS_PTS ldp_n_32_ip_tq_add_conv "" 0xa1020e5e n_32 _REC_AXS_20_u1 8160. _CNV_A_R_LINEAR_____9_CM 6 0. 8160. FORMAT "%4.0" /end AXIS_PTS
/begin AXIS_PTS ldp_n_32_ip_tq_add_amt "" 0xa1020e56 n_32 _REC_AXS_20_u1 8160. _CNV_A_R_LINEAR_____9_CM 6 0. 8160. FORMAT "%4.0" /end AXIS_PTS
/begin AXIS_PTS ldp_vs_fil__tq_clu_amt "" 0xa1021874 vs_fil _REC_AXS_20_u2 511.99218 _CNV_A_R_LINEAR_____66_CM 6 0. 511.99218 FORMAT "%7.3" /end AXIS_PTS
/begin AXIS_PTS ldp_n_ratio_conv_fac_tq_conv "" 0xa1020fe8 n_ratio_conv _REC_AXS_20_u1 0.99609375 _CNV_A_R_LINEAR_____27_CM 8 0. 0.99609375 FORMAT "%5.3" /end AXIS_PTS
/begin AXIS_PTS ldp_toil_t_dly_n_sp_is "" 0xa1021434 toil _REC_AXS_20_u1 200. _CNV_A_R_LINEAR_____25_CM 8 -40. 160. FORMAT "%3.0" /end AXIS_PTS
/begin AXIS_PTS ldp_toil_t_dly_conv "" 0xa1021428 toil _REC_AXS_20_u1 200. _CNV_A_R_LINEAR_____25_CM 8 -40. 160. FORMAT "%3.0" /end AXIS_PTS
/begin AXIS_PTS ldp_toil_fac_conv "" 0xa10213f8 toil _REC_AXS_20_u1 200. _CNV_A_R_LINEAR_____25_CM 8 -40. 160. FORMAT "%3.0" /end AXIS_PTS
/begin AXIS_PTS ldp_gr_at_n_tur "" 0xa1020afc gr_at _REC_AXS_20_u1 8. _CNV_A_R_LINEAR_____0_CM 13 0. 8. FORMAT "%1.0" /end AXIS_PTS
/begin AXIS_PTS ldp_n_32__tq_conv "" 0xa1020dc8 n_32 _REC_AXS_20_u1 8160. _CNV_A_R_LINEAR_____9_CM 8 0. 8160. FORMAT "%4.0" /end AXIS_PTS
/begin AXIS_PTS ldp_vs_n_tur "" 0xa10218c2 vs _REC_AXS_20_u1 255. _CNV_A_R_LINEAR_____6_CM 2 0. 255. FORMAT "%3.0" /end AXIS_PTS
/begin AXIS_PTS ldp_tq_conv_can__tq_conv "" 0xa10214fc tq_conv_can _REC_AXS_20_u2 2047.96875 _CNV_A_R_LINEAR_____65_CM 8 -1024. 1023.96875 FORMAT "%6.2" /end AXIS_PTS
/begin CHARACTERISTIC ip_t_ramp_conv_neg__toil "Ramp after shift disengaging" CURVE 0xa1027db8 _REC_CUR_20_u1_u1 2550. _CNV_A_R_LINEAR_____18_CM 0. 2550. DISPLAY_IDENTIFIER IP_T_RAMP_CONV_NEG__TOIL FORMAT "%4.0"
 /begin AXIS_DESCR COM_AXIS toil _CNV_A_R_LINEAR_____25_CM 8 -40. 160. FORMAT "%3.0" AXIS_PTS_REF ldp_toil_t_ramp_conv_neg /end AXIS_DESCR
/end CHARACTERISTIC
/begin CHARACTERISTIC ip_t_ramp_conv_pos__toil "Ramp after shift engaging" CURVE 0xa1027dc0 _REC_CUR_20_u1_u1 2550. _CNV_A_R_LINEAR_____18_CM 0. 2550. DISPLAY_IDENTIFIER IP_T_RAMP_CONV_POS__TOIL FORMAT "%4.0"
 /begin AXIS_DESCR COM_AXIS toil _CNV_A_R_LINEAR_____25_CM 8 -40. 160. FORMAT "%3.0" AXIS_PTS_REF ldp_toil_t_ramp_conv_pos /end AXIS_DESCR
/end CHARACTERISTIC
/begin AXIS_PTS ldp_toil_t_ramp_conv_pos "" 0xa102144c toil _REC_AXS_20_u1 200. _CNV_A_R_LINEAR_____25_CM 8 -40. 160. FORMAT "%3.0" /end AXIS_PTS
/begin AXIS_PTS ldp_toil_t_ramp_conv_neg "" 0xa1021440 toil _REC_AXS_20_u1 200. _CNV_A_R_LINEAR_____25_CM 8 -40. 160. FORMAT "%3.0" /end AXIS_PTS
/begin AXIS_PTS ldpm_toil_tq_add_conv "" 0xa1022364 toil _REC_AXS_20_u1 200. _CNV_A_R_LINEAR_____25_CM 6 -40. 160. FORMAT "%3.0" /end AXIS_PTS
/begin AXIS_PTS ldpm_vs_tq_add_conv "" 0xa102241c vs _REC_AXS_20_u1 255. _CNV_A_R_LINEAR_____6_CM 6 0. 255. FORMAT "%3.0" /end AXIS_PTS
/begin AXIS_PTS ldp_n_grd_tq_add_conv "" 0xa1020f26 n_grd _REC_AXS_20_u1 8160. _CNV_A_R_LINEAR_____28_CM 6 -4096. 4064. FORMAT "%5.0" /end AXIS_PTS
/begin AXIS_PTS ldp_ac_cru_tq_add_conv "" 0xa102085c ac_cru _REC_AXS_20_u2 31.43952 _CNV_A_R_LINEAR_____274_CM 6 -15.72 15.71952 FORMAT "%8.4" /end AXIS_PTS
/begin CHARACTERISTIC ip_tq_add_conv_ac "Torque reserve for switch GS by AC_CRU" MAP 0xa1028224 _REC_MAP_20_u2_u2_u1 2047.96875 _CNV_A_R_LINEAR_____65_CM -1024. 1023.96875 DISPLAY_IDENTIFIER IP_TQ_ADD_CONV_AC FORMAT "%6.2"
 /begin AXIS_DESCR COM_AXIS ac_cru _CNV_A_R_LINEAR_____274_CM 6 -15.72 15.71952 FORMAT "%8.4" AXIS_PTS_REF ldp_ac_cru_tq_add_conv /end AXIS_DESCR
 /begin AXIS_DESCR COM_AXIS vs _CNV_A_R_LINEAR_____6_CM 6 0. 255. FORMAT "%3.0" AXIS_PTS_REF ldpm_vs_tq_add_conv /end AXIS_DESCR
/end CHARACTERISTIC
/begin CHARACTERISTIC ip_tq_add_conv_n_grd "Torque reserve for switch GS by N_GRD" MAP 0xa102826c _REC_MAP_20_u2_u1_u1 2047.96875 _CNV_A_R_LINEAR_____65_CM -1024. 1023.96875 DISPLAY_IDENTIFIER IP_TQ_ADD_CONV_N_GRD FORMAT "%6.2"
 /begin AXIS_DESCR COM_AXIS n_grd _CNV_A_R_LINEAR_____28_CM 6 -4096. 4064. FORMAT "%5.0" AXIS_PTS_REF ldp_n_grd_tq_add_conv /end AXIS_DESCR
 /begin AXIS_DESCR COM_AXIS vs _CNV_A_R_LINEAR_____6_CM 6 0. 255. FORMAT "%3.0" AXIS_PTS_REF ldpm_vs_tq_add_conv /end AXIS_DESCR
/end CHARACTERISTIC
/begin CHARACTERISTIC ip_fac_tq_add_conv_toil "Torque reserve for switch GS" CURVE 0xa1024348 _REC_CUR_20_u2_u1 1. _CNV_A_R_LINEAR_____232_CM 0. 1. DISPLAY_IDENTIFIER IP_FAC_TQ_ADD_CONV_TOIL FORMAT "%6.4"
 /begin AXIS_DESCR COM_AXIS toil _CNV_A_R_LINEAR_____25_CM 6 -40. 160. FORMAT "%3.0" AXIS_PTS_REF ldpm_toil_tq_add_conv /end AXIS_DESCR
/end CHARACTERISTIC
/begin MEASUREMENT tq_add_conv_2 "Torque reserve for switching converter Torque" SWORD _CNV_A_R_LINEAR_____30_CM 1 100. -1024. 1023.96875 DISPLAY_IDENTIFIER TQ_ADD_CONV_2 ECU_ADDRESS 0xd0005310 FORMAT "%6.2" /end MEASUREMENT
/begin MEASUREMENT lv_dcc_disable_can "logical variable for disabling DCC intervention due to CAN error" UBYTE _CNV_S_2_RANGE__0___1_CM 1 100. 0. 1. DISPLAY_IDENTIFIER LV_DCC_DISABLE_CAN ECU_ADDRESS 0xd0003ee5 BIT_MASK 0x1 /end MEASUREMENT
/begin MEASUREMENT tqi_dcc_fast_inc_req "torque increase for fast torque intervention during DCC" SWORD _CNV_A_R_LINEAR_____30_CM 1 100. -1024. 1023.96875 DISPLAY_IDENTIFIER TQI_DCC_FAST_INC_REQ ECU_ADDRESS 0xc0000d30 FORMAT "%8.2" /end MEASUREMENT
/begin MEASUREMENT tqi_dcc_slow_inc_req "torque increase for slow torque intervention during DCC" SWORD _CNV_A_R_LINEAR_____30_CM 1 100. -1024. 1023.96875 DISPLAY_IDENTIFIER TQI_DCC_SLOW_INC_REQ ECU_ADDRESS 0xc0000d32 FORMAT "%8.2" /end MEASUREMENT
/begin MEASUREMENT tqi_dcc_fast_inc "torque increase for fast torque intervention during DCC" SWORD _CNV_A_R_LINEAR_____30_CM 1 100. -1024. 1023.96875 DISPLAY_IDENTIFIER TQI_DCC_FAST_INC ECU_ADDRESS 0xd0005338 FORMAT "%8.2" /end MEASUREMENT
/begin MEASUREMENT lv_dcc_ena_inc "logical variable for increased torque intervention due to DCC" UBYTE _CNV_S_2_RANGE__0___1_CM 1 100. 0. 1. DISPLAY_IDENTIFIER LV_DCC_ENA_INC ECU_ADDRESS 0xd0003ee6 BIT_MASK 0x1 /end MEASUREMENT
/begin MEASUREMENT lv_dcc_inc_act "logical variable for torque intervention due to DCC or LDM" UBYTE _CNV_S_2_RANGE__0___1_CM 1 100. 0. 1. DISPLAY_IDENTIFIER LV_DCC_INC_ACT ECU_ADDRESS 0xd0003ee7 BIT_MASK 0x1 /end MEASUREMENT
/begin CHARACTERISTIC c_lgrd_lih_dcc_inc "limiting gradient for DCC emergency ramp function (default  0.6 Nm/10ms)" VALUE 0xa1029520 _REC_VAL_20_u2 1023.96875 _CNV_A_R_LINEAR_____165_CM 0. 1023.96875 DISPLAY_IDENTIFIER C_LGRD_LIH_DCC_INC FORMAT "%7.2" /end CHARACTERISTIC
/begin MEASUREMENT tqi_dcc_slow_inc "torque increase for slow torque intervention during DCC" SWORD _CNV_A_R_LINEAR_____30_CM 1 100. -1024. 1023.96875 DISPLAY_IDENTIFIER TQI_DCC_SLOW_INC ECU_ADDRESS 0xd000533a FORMAT "%8.2" /end MEASUREMENT
/begin MEASUREMENT lv_dcc_inc_lih "logical variable for torque intervention LIH due to DCC" UBYTE _CNV_S_2_RANGE__0___1_CM 1 100. 0. 1. DISPLAY_IDENTIFIER LV_DCC_INC_LIH ECU_ADDRESS 0xd0003ee8 BIT_MASK 0x1 /end MEASUREMENT
/begin MEASUREMENT t_dcc_lih_ctr "time counter delay time" UBYTE _CNV_A_R_LINEAR_____3_CM 1 100. 0. 2.55 DISPLAY_IDENTIFIER T_DCC_LIH_CTR ECU_ADDRESS 0xc0000d38 FORMAT "%4.2" /end MEASUREMENT
/begin MEASUREMENT lv_err_bn_tq_dcc "Present error BN2000" UBYTE _CNV_S_2_RANGE__0___1_CM 1 100. 0. 1. DISPLAY_IDENTIFIER LV_ERR_BN_TQ_DCC ECU_ADDRESS 0xd0003448 BIT_MASK 0x1 /end MEASUREMENT
/begin MEASUREMENT state_tq_dcc_plaus "Bitwise coded State for DCC intervention state" UBYTE _CNV_A_R_LINEAR_____0_CM 1 100. 0. 255. DISPLAY_IDENTIFIER STATE_TQ_DCC_PLAUS ECU_ADDRESS 0xd0003ee4 FORMAT "%3.0" /end MEASUREMENT
/begin CHARACTERISTIC c_t_dly_lih_dcc_inc "delay time for activation of DCC emergency ramp function (default 0s)" VALUE 0xa1029869 _REC_VAL_20_u1 2.55 _CNV_A_R_LINEAR_____3_CM 0. 2.55 DISPLAY_IDENTIFIER C_T_DLY_LIH_DCC_INC FORMAT "%4.2" /end CHARACTERISTIC
/begin MEASUREMENT eff_scc_av "Actual efficiency fuel cut-off" UWORD _CNV_A_R_LINEAR_____8_CM 1 100. 0. 1.99996948242188 DISPLAY_IDENTIFIER EFF_SCC_AV ECU_ADDRESS 0xd000531a FORMAT "%7.5" /end MEASUREMENT
/begin MEASUREMENT eff_scc_av_can "Actual efficiency fuel cut-off for CAN" UWORD _CNV_A_R_LINEAR_____8_CM 1 100. 0. 1.99996948242188 DISPLAY_IDENTIFIER EFF_SCC_AV_CAN ECU_ADDRESS 0xd000531c FORMAT "%7.5" /end MEASUREMENT
/begin MEASUREMENT eff_scc_sp_hys "Setpoint efficiency fuel cut-off pattern with hysteresis" UWORD _CNV_A_R_LINEAR_____8_CM 1 100. 0. 1.99996948242188 DISPLAY_IDENTIFIER EFF_SCC_SP_HYS ECU_ADDRESS 0xc0000d50 FORMAT "%7.5" /end MEASUREMENT
/begin MEASUREMENT eff_scc_bas "Basic efficiency fuel  cut-off" UWORD _CNV_A_R_LINEAR_____8_CM 1 100. 0. 1.99996948242188 DISPLAY_IDENTIFIER EFF_SCC_BAS ECU_ADDRESS 0xd0005318 FORMAT "%7.5" /end MEASUREMENT
/begin MEASUREMENT fac_iga_min_teg_iga_bas "scaling factor for efficiency calculation with EFF_IGA_MIN_TEG and EFF_IGA_BAS_COR" UWORD _CNV_A_R_LINEAR_____8_CM 1 100. 0. 1.99996948242188 DISPLAY_IDENTIFIER FAC_IGA_MIN_TEG_IGA_BAS ECU_ADDRESS 0xc0000d52 FORMAT "%7.5" /end MEASUREMENT
/begin MEASUREMENT lv_auth_tq_pat "Logical variable for authorizing fuel cut-off pattern" UBYTE _CNV_S_2_RANGE__0___1_CM 1 100. 0. 1. DISPLAY_IDENTIFIER LV_AUTH_TQ_PAT ECU_ADDRESS 0xc0000d59 BIT_MASK 0x1 /end MEASUREMENT
/begin MEASUREMENT nr_pat_scc "Selected index of fuel cut-off pattern" UBYTE _CNV_A_R_LINEAR_____0_CM 1 100. 0. 255. DISPLAY_IDENTIFIER NR_PAT_SCC ECU_ADDRESS 0xd0003ed4 FORMAT "%3.0" /end MEASUREMENT
/begin CHARACTERISTIC lc_eff_scc_sp_man "flag for setting EFF_SCC_SP by application system" VALUE 0xa1029d1d _REC_VAL_20_u1 1. _CNV_A_R_LINEAR_____0_CM 0. 1. DISPLAY_IDENTIFIER LC_EFF_SCC_SP_MAN FORMAT "%2.0" /end CHARACTERISTIC
/begin CHARACTERISTIC lc_eff_scc_bas_swi_clc "logical variable for deactivation of basic efficiency fuel cut_off calculation through missfire pattern" VALUE 0xa1029d1c _REC_VAL_20_u1 1. _CNV_A_R_LINEAR_____0_CM 0. 1. DISPLAY_IDENTIFIER LC_EFF_SCC_BAS_SWI_CLC FORMAT "%2.0" /end CHARACTERISTIC
/begin CHARACTERISTIC lc_inh_fcut_fast "inhibition flag for fuel cut-off due fast fuel cut-off" VALUE 0xa1029d4f _REC_VAL_20_u1 1. _CNV_A_R_LINEAR_____0_CM 0. 1. DISPLAY_IDENTIFIER LC_INH_FCUT_FAST FORMAT "%2.0" /end CHARACTERISTIC
/begin CHARACTERISTIC lc_ena_eff_scc_bas_man "logical variable for manually adjusting basic efficiency fuel cut-off" VALUE 0xa1029d27 _REC_VAL_20_u1 1. _CNV_A_R_LINEAR_____0_CM 0. 1. DISPLAY_IDENTIFIER LC_ENA_EFF_SCC_BAS_MAN FORMAT "%2.0" /end CHARACTERISTIC
/begin CHARACTERISTIC c_eff_scc_sp_hys "Hysteresis applied on EFF_SCC_SP for NR_PAT_SCC calculation" VALUE 0xa1029320 _REC_VAL_20_u2 1.99996948242188 _CNV_A_R_LINEAR_____8_CM 0. 1.99996948242188 DISPLAY_IDENTIFIER C_EFF_SCC_SP_HYS FORMAT "%7.5" /end CHARACTERISTIC
/begin CHARACTERISTIC c_eff_scc_bas_man "manually adjusted basic efficiency fuel cut-off" VALUE 0xa102931e _REC_VAL_20_u2 1.99996948242188 _CNV_A_R_LINEAR_____8_CM 0. 1.99996948242188 DISPLAY_IDENTIFIER C_EFF_SCC_BAS_MAN FORMAT "%7.5" /end CHARACTERISTIC
/begin CHARACTERISTIC lc_ena_fcut_tot_gs "logical variable for setting scaling factor due to gear shift intervention" VALUE 0xa1029d2e _REC_VAL_20_u1 1. _CNV_A_R_LINEAR_____0_CM 0. 1. DISPLAY_IDENTIFIER LC_ENA_FCUT_TOT_GS FORMAT "%2.0" /end CHARACTERISTIC
/begin CHARACTERISTIC lc_inh_fcut_gs_iga "inhibition flag for fuel cut-off due to gear shift intervention with spark retarding" VALUE 0xa1029d51 _REC_VAL_20_u1 1. _CNV_A_R_LINEAR_____0_CM 0. 1. DISPLAY_IDENTIFIER LC_INH_FCUT_GS_IGA FORMAT "%2.0" /end CHARACTERISTIC
/begin CHARACTERISTIC lc_inh_fcut_asr "inhibition flag for fuel cut-off due to ASR" VALUE 0xa1029d4d _REC_VAL_20_u1 1. _CNV_A_R_LINEAR_____0_CM 0. 1. DISPLAY_IDENTIFIER LC_INH_FCUT_ASR FORMAT "%2.0" /end CHARACTERISTIC
/begin CHARACTERISTIC lc_ena_fcut_tot_asr "logical variable for setting scaling factor due to ASR" VALUE 0xa1029d2b _REC_VAL_20_u1 1. _CNV_A_R_LINEAR_____0_CM 0. 1. DISPLAY_IDENTIFIER LC_ENA_FCUT_TOT_ASR FORMAT "%2.0" /end CHARACTERISTIC
/begin CHARACTERISTIC lc_inh_fcut_n_max "inhibition flag for fuel cut-off due to speed limitation" VALUE 0xa1029d53 _REC_VAL_20_u1 1. _CNV_A_R_LINEAR_____0_CM 0. 1. DISPLAY_IDENTIFIER LC_INH_FCUT_N_MAX FORMAT "%2.0" /end CHARACTERISTIC
/begin CHARACTERISTIC lc_tq_scc_inh_man "inhibition flag for fuel cut-off due to torque management" VALUE 0xa1029e06 _REC_VAL_20_u1 1. _CNV_A_R_LINEAR_____0_CM 0. 1. DISPLAY_IDENTIFIER LC_TQ_SCC_INH_MAN FORMAT "%2.0" /end CHARACTERISTIC
/begin CHARACTERISTIC lc_ena_fcut_tot_fast "logical variable for setting scaling factor due to fast fuel cut-off" VALUE 0xa1029d2d _REC_VAL_20_u1 1. _CNV_A_R_LINEAR_____0_CM 0. 1. DISPLAY_IDENTIFIER LC_ENA_FCUT_TOT_FAST FORMAT "%2.0" /end CHARACTERISTIC
/begin CHARACTERISTIC lc_tq_scc_ena_man "flag for enabling SCC by application system" VALUE 0xa1029e05 _REC_VAL_20_u1 1. _CNV_A_R_LINEAR_____0_CM 0. 1. DISPLAY_IDENTIFIER LC_TQ_SCC_ENA_MAN FORMAT "%2.0" /end CHARACTERISTIC
/begin CHARACTERISTIC c_eff_scc_sp_man "setpoint for efficiency of fuel cut-off set by application intervention" VALUE 0xa1029322 _REC_VAL_20_u2 1.99996948242188 _CNV_A_R_LINEAR_____8_CM 0. 1.99996948242188 DISPLAY_IDENTIFIER C_EFF_SCC_SP_MAN FORMAT "%7.5" /end CHARACTERISTIC
/begin CHARACTERISTIC c_fac_iga_min_teg_iga_bas "manually adjusted scaling factor for efficiency calculation with EFF_IGA_MIN_TEG and EFF_IGA_BAS_COR" VALUE 0xa1029380 _REC_VAL_20_u2 1. _CNV_A_R_LINEAR_____275_CM 0. 1. DISPLAY_IDENTIFIER C_FAC_IGA_MIN_TEG_IGA_BAS FORMAT "%6.4" /end CHARACTERISTIC
/begin CHARACTERISTIC c_hys_eff_iga_min_teg "hysteresis in falling direction for IGA_MIN_TEG correction" VALUE 0xa1029496 _REC_VAL_20_u2 1.99996948242188 _CNV_A_R_LINEAR_____8_CM 0. 1.99996948242188 DISPLAY_IDENTIFIER C_HYS_EFF_IGA_MIN_TEG FORMAT "%7.5" /end CHARACTERISTIC
/begin CHARACTERISTIC c_min_dec_eff_iga_min_teg_1 "minimum decrement for first decrease phase " VALUE 0xa10295a4 _REC_VAL_20_u2 1.99996948242188 _CNV_A_R_LINEAR_____8_CM 0. 1.99996948242188 DISPLAY_IDENTIFIER C_MIN_DEC_EFF_IGA_MIN_TEG_1 FORMAT "%7.5" /end CHARACTERISTIC
/begin CHARACTERISTIC c_min_dec_eff_iga_min_teg_2 "minimum decrement for second decrease phase " VALUE 0xa10295a6 _REC_VAL_20_u2 1.99996948242188 _CNV_A_R_LINEAR_____8_CM 0. 1.99996948242188 DISPLAY_IDENTIFIER C_MIN_DEC_EFF_IGA_MIN_TEG_2 FORMAT "%7.5" /end CHARACTERISTIC
/begin CHARACTERISTIC id_nr_pat_scc "SCC pattern depending on SCC efficiency" CURVE 0xa1022e88 _REC_CUR_20_u1_u2 255. _CNV_A_R_LINEAR_____0_CM 0. 255. DISPLAY_IDENTIFIER ID_NR_PAT_SCC FORMAT "%3.0"
 /begin AXIS_DESCR COM_AXIS eff_scc_sp _CNV_A_R_LINEAR_____8_CM 13 0. 1.99996948242188 FORMAT "%7.5" AXIS_PTS_REF ldp_eff_scc_sp__nr_pat_scc /end AXIS_DESCR
/end CHARACTERISTIC
/begin CHARACTERISTIC lc_inh_fcut_gs "inhibition flag for fuel cut-off due to gear shift intervention" VALUE 0xa1029d50 _REC_VAL_20_u1 1. _CNV_A_R_LINEAR_____0_CM 0. 1. DISPLAY_IDENTIFIER LC_INH_FCUT_GS FORMAT "%2.0" /end CHARACTERISTIC
/begin CHARACTERISTIC lc_inh_fcut_amt "inhibition flag for fuel cut-off due to AMT intervention" VALUE 0xa1029d4c _REC_VAL_20_u1 1. _CNV_A_R_LINEAR_____0_CM 0. 1. DISPLAY_IDENTIFIER LC_INH_FCUT_AMT FORMAT "%2.0" /end CHARACTERISTIC
/begin CHARACTERISTIC lc_inh_fcut_dcc "inhibition flag for fuel cut-off due to DCC intervention" VALUE 0xa1029d4e _REC_VAL_20_u1 1. _CNV_A_R_LINEAR_____0_CM 0. 1. DISPLAY_IDENTIFIER LC_INH_FCUT_DCC FORMAT "%2.0" /end CHARACTERISTIC
/begin CHARACTERISTIC lc_ena_fcut_tot_n_max "logical variable for setting scaling factor due to engine speed limitation" VALUE 0xa1029d30 _REC_VAL_20_u1 1. _CNV_A_R_LINEAR_____0_CM 0. 1. DISPLAY_IDENTIFIER LC_ENA_FCUT_TOT_N_MAX FORMAT "%2.0" /end CHARACTERISTIC
/begin CHARACTERISTIC lc_ena_fcut_tot_amt "logical variable for setting scaling factor due AMT" VALUE 0xa1029d2a _REC_VAL_20_u1 1. _CNV_A_R_LINEAR_____0_CM 0. 1. DISPLAY_IDENTIFIER LC_ENA_FCUT_TOT_AMT FORMAT "%2.0" /end CHARACTERISTIC
/begin CHARACTERISTIC lc_ena_fcut_tot_dcc "logical variable for setting scaling factor due to DCC" VALUE 0xa1029d2c _REC_VAL_20_u1 1. _CNV_A_R_LINEAR_____0_CM 0. 1. DISPLAY_IDENTIFIER LC_ENA_FCUT_TOT_DCC FORMAT "%2.0" /end CHARACTERISTIC
/begin AXIS_PTS ldp_eff_scc_sp__nr_pat_scc "" 0xa10208f4 eff_scc_sp _REC_AXS_20_u2 1.99996948242188 _CNV_A_R_LINEAR_____8_CM 13 0. 1.99996948242188 FORMAT "%7.5" /end AXIS_PTS
/begin CHARACTERISTIC lc_inh_fcut_ldm "inhibition flag for fuel cut-off due to LDM intervention" VALUE 0xa1029d52 _REC_VAL_20_u1 1. _CNV_A_R_LINEAR_____0_CM 0. 1. DISPLAY_IDENTIFIER LC_INH_FCUT_LDM FORMAT "%2.0" /end CHARACTERISTIC
/begin CHARACTERISTIC lc_ena_fcut_tot_ldm "logical variable for setting scaling factor due to LDM" VALUE 0xa1029d2f _REC_VAL_20_u1 1. _CNV_A_R_LINEAR_____0_CM 0. 1. DISPLAY_IDENTIFIER LC_ENA_FCUT_TOT_LDM FORMAT "%2.0" /end CHARACTERISTIC
/begin MEASUREMENT eff_scc_sp "Setpoint efficiency fuel cut-off pattern" UWORD _CNV_A_R_LINEAR_____8_CM 1 100. 0. 1.99996948242188 DISPLAY_IDENTIFIER EFF_SCC_SP ECU_ADDRESS 0xd0005320 FORMAT "%7.5" /end MEASUREMENT
/begin MEASUREMENT sum_inh_iv_tot "Sum of cylinders which are shut off either by means of static or dynamic fuel cut-off pattern" UBYTE _CNV_A_R_LINEAR_____0_CM 1 100. 0. 8. DISPLAY_IDENTIFIER SUM_INH_IV_TOT ECU_ADDRESS 0xc0000d58 FORMAT "%1.0" /end MEASUREMENT
/begin MEASUREMENT sum_inh_iv_bas "Sum of cylinders which are shut off due to malfunctions" UBYTE _CNV_A_R_LINEAR_____0_CM 1 100. 0. 8. DISPLAY_IDENTIFIER SUM_INH_IV_BAS ECU_ADDRESS 0xd0003ed5 FORMAT "%1.0" /end MEASUREMENT
/begin MEASUREMENT inh_iv_tot "Overall shut off pattern (static and dynamic)" UWORD _CNV_A_R_LINEAR_____0_CM 1 100. 0. 65535. DISPLAY_IDENTIFIER INH_IV_TOT ECU_ADDRESS 0xc0000d56 FORMAT "%5.0" /end MEASUREMENT
/begin MEASUREMENT t_max_fcut_fast "time counter for clutch switch observation fast fuel cut off" UBYTE _CNV_A_R_LINEAR_____3_CM 1 100. 0. 2.55 DISPLAY_IDENTIFIER T_MAX_FCUT_FAST ECU_ADDRESS 0xc0000d5c FORMAT "%4.2" /end MEASUREMENT
/begin CHARACTERISTIC c_maf_dif_min_fcut_fast "min. load decrease fast fuel cut-off" VALUE 0xa1029536 _REC_VAL_20_u2 1389. _CNV_A_R_LINEAR_____108_CM 0. 1389. DISPLAY_IDENTIFIER C_MAF_DIF_MIN_FCUT_FAST FORMAT "%7.2" /end CHARACTERISTIC
/begin CHARACTERISTIC c_tco_min_fcut_fast "min. coolant temperature fast fuel cut-off" VALUE 0xa10299df _REC_VAL_20_u1 190.5 _CNV_A_R_LINEAR_____16_CM -48. 142.5 DISPLAY_IDENTIFIER C_TCO_MIN_FCUT_FAST FORMAT "%5.1" /end CHARACTERISTIC
/begin MEASUREMENT lv_cs_chg "Logical variable" UBYTE _CNV_S_2_RANGE__0___1_CM 1 100. 0. 1. DISPLAY_IDENTIFIER LV_CS_CHG ECU_ADDRESS 0xc0000d60 BIT_MASK 0x1 /end MEASUREMENT
/begin MEASUREMENT lv_fcut_fast "Logical variable for authorizing fuel cut off pattern" UBYTE _CNV_S_2_RANGE__0___1_CM 1 100. 0. 1. DISPLAY_IDENTIFIER LV_FCUT_FAST ECU_ADDRESS 0xd0003ed8 BIT_MASK 0x1 /end MEASUREMENT
/begin MEASUREMENT lv_ct_chg "Logical variable" UBYTE _CNV_S_2_RANGE__0___1_CM 1 100. 0. 1. DISPLAY_IDENTIFIER LV_CT_CHG ECU_ADDRESS 0xc0000d5f BIT_MASK 0x1 /end MEASUREMENT
/begin CHARACTERISTIC c_t_max_fcut_fast "max. time cllutch switch observation fast fuel cut-off" VALUE 0xa10298c1 _REC_VAL_20_u1 2.55 _CNV_A_R_LINEAR_____3_CM 0. 2.55 DISPLAY_IDENTIFIER C_T_MAX_FCUT_FAST FORMAT "%4.2" /end CHARACTERISTIC
/begin CHARACTERISTIC c_vs_min_fcut_fast "min veh. speed  fuel cut-off" VALUE 0xa1029cb9 _REC_VAL_20_u1 255. _CNV_A_R_LINEAR_____6_CM 0. 255. DISPLAY_IDENTIFIER C_VS_MIN_FCUT_FAST FORMAT "%3.0" /end CHARACTERISTIC
/begin CHARACTERISTIC id_maf_n_min_fcut_fast "engine speed -load threshold for  fast fuel cut-off" MAP 0xa1022b5c _REC_MAP_20_u1_u2_u2 1. _CNV_S_2_RANGE______75_CM 0. 1. DISPLAY_IDENTIFIER ID_MAF_N_MIN_FCUT_FAST
 /begin AXIS_DESCR COM_AXIS maf _CNV_A_R_LINEAR_____108_CM 4 0. 1389. FORMAT "%7.2" AXIS_PTS_REF ldp_maf__min_fcut_fast /end AXIS_DESCR
 /begin AXIS_DESCR COM_AXIS n _CNV_A_R_LINEAR_____13_CM 4 0. 8160. FORMAT "%4.0" AXIS_PTS_REF ldp_n__min_fcut_fast /end AXIS_DESCR
/end CHARACTERISTIC
/begin AXIS_PTS ldp_maf__min_fcut_fast "" 0xa1020c50 maf _REC_AXS_20_u2 1389. _CNV_A_R_LINEAR_____108_CM 4 0. 1389. FORMAT "%7.2" /end AXIS_PTS
/begin AXIS_PTS ldp_n__min_fcut_fast "" 0xa1020e98 n _REC_AXS_20_u2 8160. _CNV_A_R_LINEAR_____13_CM 4 0. 8160. FORMAT "%4.0" /end AXIS_PTS
/begin MEASUREMENT tq_st_1 "Engine Start Torque raw value" SWORD _CNV_A_R_LINEAR_____30_CM 1 100. -1024. 1023.96875 DISPLAY_IDENTIFIER TQ_ST_1 ECU_ADDRESS 0xc0000d64 FORMAT "%6.2" /end MEASUREMENT
/begin CHARACTERISTIC c_crlc_tq_st "" VALUE 0xa102923b _REC_VAL_20_u1 0.99609375 _CNV_A_R_LINEAR_____71_CM 0. 0.99609375 DISPLAY_IDENTIFIER C_CRLC_TQ_ST FORMAT "%5.3" /end CHARACTERISTIC
/begin AXIS_PTS ldpm_tco_ip_tq_st "" 0xa1022288 tco _REC_AXS_20_u1 190.5 _CNV_A_R_LINEAR_____16_CM 8 -48. 142.5 FORMAT "%5.1" /end AXIS_PTS
/begin AXIS_PTS ldpm_n_dif_ip_tq_st "" 0xa1021fd4 n_dif _REC_AXS_20_u2 65535. _CNV_A_R_LINEAR_____172_CM 8 -32768. 32767. FORMAT "%6.0" /end AXIS_PTS
/begin CHARACTERISTIC ip_tq_st_mt_opm_2 "Engine torque at start for manual transmission in engine operation mode 2" MAP 0xa1028ed0 _REC_MAP_20_u2_u2_u1 2047.96875 _CNV_A_R_LINEAR_____65_CM -1024. 1023.96875 DISPLAY_IDENTIFIER IP_TQ_ST_MT_OPM_2 FORMAT "%6.2"
 /begin AXIS_DESCR COM_AXIS n_dif _CNV_A_R_LINEAR_____172_CM 8 -32768. 32767. FORMAT "%6.0" AXIS_PTS_REF ldpm_n_dif_ip_tq_st /end AXIS_DESCR
 /begin AXIS_DESCR COM_AXIS tco _CNV_A_R_LINEAR_____16_CM 8 -48. 142.5 FORMAT "%5.1" AXIS_PTS_REF ldpm_tco_ip_tq_st /end AXIS_DESCR
/end CHARACTERISTIC
/begin CHARACTERISTIC ip_tq_st_mt_opm_1 "Engine torque at start for manual transmission in engine operation mode 1" MAP 0xa1028e50 _REC_MAP_20_u2_u2_u1 2047.96875 _CNV_A_R_LINEAR_____65_CM -1024. 1023.96875 DISPLAY_IDENTIFIER IP_TQ_ST_MT_OPM_1 FORMAT "%6.2"
 /begin AXIS_DESCR COM_AXIS n_dif _CNV_A_R_LINEAR_____172_CM 8 -32768. 32767. FORMAT "%6.0" AXIS_PTS_REF ldpm_n_dif_ip_tq_st /end AXIS_DESCR
 /begin AXIS_DESCR COM_AXIS tco _CNV_A_R_LINEAR_____16_CM 8 -48. 142.5 FORMAT "%5.1" AXIS_PTS_REF ldpm_tco_ip_tq_st /end AXIS_DESCR
/end CHARACTERISTIC
/begin CHARACTERISTIC ip_tq_st_at_opm_1 "Engine torque at start for automatic transmission in engine operation mode 1" MAP 0xa1028d50 _REC_MAP_20_u2_u2_u1 2047.96875 _CNV_A_R_LINEAR_____65_CM -1024. 1023.96875 DISPLAY_IDENTIFIER IP_TQ_ST_AT_OPM_1 FORMAT "%6.2"
 /begin AXIS_DESCR COM_AXIS n_dif _CNV_A_R_LINEAR_____172_CM 8 -32768. 32767. FORMAT "%6.0" AXIS_PTS_REF ldpm_n_dif_ip_tq_st /end AXIS_DESCR
 /begin AXIS_DESCR COM_AXIS tco _CNV_A_R_LINEAR_____16_CM 8 -48. 142.5 FORMAT "%5.1" AXIS_PTS_REF ldpm_tco_ip_tq_st /end AXIS_DESCR
/end CHARACTERISTIC
/begin CHARACTERISTIC ip_tq_st_at_opm_2 "Engine torque at start for automatic transmission in engine operation mode 2" MAP 0xa1028dd0 _REC_MAP_20_u2_u2_u1 2047.96875 _CNV_A_R_LINEAR_____65_CM -1024. 1023.96875 DISPLAY_IDENTIFIER IP_TQ_ST_AT_OPM_2 FORMAT "%6.2"
 /begin AXIS_DESCR COM_AXIS n_dif _CNV_A_R_LINEAR_____172_CM 8 -32768. 32767. FORMAT "%6.0" AXIS_PTS_REF ldpm_n_dif_ip_tq_st /end AXIS_DESCR
 /begin AXIS_DESCR COM_AXIS tco _CNV_A_R_LINEAR_____16_CM 8 -48. 142.5 FORMAT "%5.1" AXIS_PTS_REF ldpm_tco_ip_tq_st /end AXIS_DESCR
/end CHARACTERISTIC
/begin CHARACTERISTIC id_opm_av_tq_st "Operation mode matrix (actual)" CURVE 0xa1022e98 _REC_CUR_20_u1_u1 7. _CNV_A_R_LINEAR_____0_CM 1. 8. DISPLAY_IDENTIFIER ID_OPM_AV_TQ_ST FORMAT "%1.0"
 /begin AXIS_DESCR COM_AXIS opm_av _CNV_A_R_LINEAR_____0_CM 8 0. 8. FORMAT "%1.0" AXIS_PTS_REF ldpm_opm_av /end AXIS_DESCR
/end CHARACTERISTIC
/begin MEASUREMENT tq_st "Engine Start Torque" SWORD _CNV_A_R_LINEAR_____30_CM 1 100. -1024. 1023.96875 DISPLAY_IDENTIFIER TQ_ST ECU_ADDRESS 0xd0005324 FORMAT "%6.2" /end MEASUREMENT
/begin MEASUREMENT opm_av_sel_tq_st "Operation mode ( after selection )" UBYTE _CNV_A_R_LINEAR_____0_CM 1 100. 1. 8. DISPLAY_IDENTIFIER OPM_AV_SEL_TQ_ST ECU_ADDRESS 0xc0000d68 FORMAT "%1.0" /end MEASUREMENT
/begin MEASUREMENT fac_tq_req_cru "Torque factor request for cruise control" UWORD _CNV_A_R_LINEAR_____8_CM 1 100. 0. 1.99996948242188 DISPLAY_IDENTIFIER FAC_TQ_REQ_CRU ECU_ADDRESS 0xd000536c FORMAT "%7.5" /end MEASUREMENT
/begin MEASUREMENT fac_tq_req_dcc "Scaling factor of inverse  DCC model" UWORD _CNV_A_R_LINEAR_____8_CM 1 100. 0. 1.99996948242188 DISPLAY_IDENTIFIER FAC_TQ_REQ_DCC ECU_ADDRESS 0xd000536e FORMAT "%7.5" /end MEASUREMENT
/begin MEASUREMENT state_tq_dcc "State of DCC torque intervention" UBYTE _CNV_S_6_STATE_TQ_D_276_CM 1 100. 0. 11. DISPLAY_IDENTIFIER STATE_TQ_DCC ECU_ADDRESS 0xd0003f08 /end MEASUREMENT
/begin MEASUREMENT lv_tq_dcc_act "Torque structure leaded by DCC intervention" UBYTE _CNV_S_2_RANGE__0___1_CM 1 100. 0. 1. DISPLAY_IDENTIFIER LV_TQ_DCC_ACT ECU_ADDRESS 0xc0000d80 BIT_MASK 0x1 /end MEASUREMENT
/begin MEASUREMENT tq_delta_max_clu "Difference between TQ_MAX_CLU and TQ_MIN_CLU" SWORD _CNV_A_R_LINEAR_____30_CM 1 100. -1024. 1023.96875 DISPLAY_IDENTIFIER TQ_DELTA_MAX_CLU ECU_ADDRESS 0xc0000d7c FORMAT "%8.2" /end MEASUREMENT
/begin CHARACTERISTIC c_lgrd_tq_cru_inc_1 "Change limitation for cruise control request out of lower vehicle speed" VALUE 0xa102952a _REC_VAL_20_u2 1.99996948242188 _CNV_A_R_LINEAR_____8_CM 0. 1.99996948242188 DISPLAY_IDENTIFIER C_LGRD_TQ_CRU_INC_1 FORMAT "%7.5" /end CHARACTERISTIC
/begin CHARACTERISTIC c_lgrd_tq_cru_inc_2 "Change limitation for cruise control request out of higher vehicle speed" VALUE 0xa102952c _REC_VAL_20_u2 1.99996948242188 _CNV_A_R_LINEAR_____8_CM 0. 1.99996948242188 DISPLAY_IDENTIFIER C_LGRD_TQ_CRU_INC_2 FORMAT "%7.5" /end CHARACTERISTIC
/begin CHARACTERISTIC c_fac_dcc_fl "Full load detection of DCC" VALUE 0xa102937c _REC_VAL_20_u2 1. _CNV_A_R_LINEAR_____275_CM 0. 1. DISPLAY_IDENTIFIER C_FAC_DCC_FL FORMAT "%6.4" /end CHARACTERISTIC
/begin MEASUREMENT state_tq_ldm "State of DCC torque intervention" UBYTE _CNV_S_6_STATE_TQ_D_276_CM 1 100. 0. 11. DISPLAY_IDENTIFIER STATE_TQ_LDM ECU_ADDRESS 0xd0003f09 /end MEASUREMENT
/begin CHARACTERISTIC ip_fac_tq_req_driv_rng_l "Scaling factor for requested torque at clutch from driver in low range mode" MAP 0xa10247f8 _REC_MAP_20_u2_u2_u2 1.99996948242188 _CNV_A_R_LINEAR_____8_CM 0. 1.99996948242188 DISPLAY_IDENTIFIER IP_FAC_TQ_REQ_DRIV_RNG_L FORMAT "%7.5"
 /begin AXIS_DESCR COM_AXIS n _CNV_A_R_LINEAR_____13_CM 12 0. 8160. FORMAT "%4.0" AXIS_PTS_REF ldpm_n_fac_tq_req_driv /end AXIS_DESCR
 /begin AXIS_DESCR COM_AXIS pv_cus _CNV_A_R_LINEAR_____7_CM 12 0. 99.99847412109381 AXIS_PTS_REF ldpm_pv_cus_fac_tq_req_driv /end AXIS_DESCR
/end CHARACTERISTIC
/begin CHARACTERISTIC ip_fac_tq_req_driv "Scaling factor for requested torque at clutch from driver" MAP 0xa10246b8 _REC_MAP_20_u2_u2_u2 1.99996948242188 _CNV_A_R_LINEAR_____8_CM 0. 1.99996948242188 DISPLAY_IDENTIFIER IP_FAC_TQ_REQ_DRIV FORMAT "%7.5"
 /begin AXIS_DESCR COM_AXIS n _CNV_A_R_LINEAR_____13_CM 12 0. 8160. FORMAT "%4.0" AXIS_PTS_REF ldpm_n_fac_tq_req_driv /end AXIS_DESCR
 /begin AXIS_DESCR COM_AXIS pv_cus _CNV_A_R_LINEAR_____7_CM 12 0. 99.99847412109381 AXIS_PTS_REF ldpm_pv_cus_fac_tq_req_driv /end AXIS_DESCR
/end CHARACTERISTIC
/begin CHARACTERISTIC c_fac_tq_req_driv_sof_max "Scaling factor threshold for activation IP_FAC_TQ_REQ_DRIV_RNG_L" VALUE 0xa10293c0 _REC_VAL_20_u2 1.99996948242188 _CNV_A_R_LINEAR_____8_CM 0. 1.99996948242188 DISPLAY_IDENTIFIER C_FAC_TQ_REQ_DRIV_SOF_MAX FORMAT "%7.5" /end CHARACTERISTIC
/begin CHARACTERISTIC c_pv_av_grd_sof_max "Pedal value gradient rheshold for recognition of LV_RNG_L" VALUE 0xa1029729 _REC_VAL_20_u1 2490.234 _CNV_A_R_LINEAR_____247_CM -1250. 1240.234 DISPLAY_IDENTIFIER C_PV_AV_GRD_SOF_MAX FORMAT "%6.1" /end CHARACTERISTIC
/begin CHARACTERISTIC c_t_pv_av_grd_sof_max "Minimum time for pedal value gradient for recognition of LV_RNG_L" VALUE 0xa1029942 _REC_VAL_20_u2 655.35 _CNV_A_R_LINEAR_____3_CM 0. 655.35 DISPLAY_IDENTIFIER C_T_PV_AV_GRD_SOF_MAX FORMAT "%6.2" /end CHARACTERISTIC
/begin MEASUREMENT fac_tq_req_driv "Scaling factor for requested torque at clutch from driver" UWORD _CNV_A_R_LINEAR_____8_CM 1 100. 0. 1.99996948242188 DISPLAY_IDENTIFIER FAC_TQ_REQ_DRIV ECU_ADDRESS 0xd0005370 FORMAT "%7.5" /end MEASUREMENT
/begin MEASUREMENT lv_rng_l_req "Activation condition for low-range-mode" UBYTE _CNV_S_2_RANGE__0___1_CM 1 100. 0. 1. DISPLAY_IDENTIFIER LV_RNG_L_REQ ECU_ADDRESS 0xd0003f0c BIT_MASK 0x1 /end MEASUREMENT
/begin AXIS_PTS ldpm_n_fac_tq_req_driv "" 0xa1022004 n _REC_AXS_20_u2 8160. _CNV_A_R_LINEAR_____13_CM 12 0. 8160. FORMAT "%4.0" /end AXIS_PTS
/begin AXIS_PTS ldpm_pv_cus_fac_tq_req_driv "" 0xa10221c0 pv_cus _REC_AXS_20_u2 99.99847412109381 _CNV_A_R_LINEAR_____7_CM 12 0. 99.99847412109381 /end AXIS_PTS
/begin CHARACTERISTIC lc_rng_l_man_as "logical constant for to activate IP_FAC_TQ_REQ_DRIV_RNG_L (low range mode) in case if LV_RNG_L = 0 (default value = 0)" VALUE 0xa1029dc6 _REC_VAL_20_u1 1. _CNV_A_R_LINEAR_____0_CM 0. 1. DISPLAY_IDENTIFIER LC_RNG_L_MAN_AS FORMAT "%2.0" /end CHARACTERISTIC
/begin CHARACTERISTIC c_pv_cus_sof_min "PV_AV threshold for activation IP_FAC_TQ_REQ_DRIV_RNG_L" VALUE 0xa1029730 _REC_VAL_20_u2 99.99847412109381 _CNV_A_R_LINEAR_____7_CM 0. 99.99847412109381 DISPLAY_IDENTIFIER C_PV_CUS_SOF_MIN /end CHARACTERISTIC
/begin MEASUREMENT tq_min_clu "Minimum  torque at clutch " SWORD _CNV_A_R_LINEAR_____30_CM 1 100. -1024. 1023.96875 DISPLAY_IDENTIFIER TQ_MIN_CLU ECU_ADDRESS 0xd00052d8 FORMAT "%6.2" /end MEASUREMENT
/begin MEASUREMENT tq_min_clu_1 "Minimum  torque at clutch intermitted value 1" SWORD _CNV_A_R_LINEAR_____30_CM 1 100. -1024. 1023.96875 DISPLAY_IDENTIFIER TQ_MIN_CLU_1 ECU_ADDRESS 0xc0000d8c FORMAT "%6.2" /end MEASUREMENT
/begin MEASUREMENT tq_min_clu_2 "Minimum  torque at clutch intermitted value 2" SWORD _CNV_A_R_LINEAR_____30_CM 1 100. -1024. 1023.96875 DISPLAY_IDENTIFIER TQ_MIN_CLU_2 ECU_ADDRESS 0xc0000d8e FORMAT "%6.2" /end MEASUREMENT
/begin MEASUREMENT fac_n_dif_is "Control factor for the engine self stabilizing" SWORD _CNV_A_R_LINEAR_____11_CM 1 100. -8. 7.99975586 DISPLAY_IDENTIFIER FAC_N_DIF_IS ECU_ADDRESS 0xc0000d90 FORMAT "%7.4" /end MEASUREMENT
/begin MEASUREMENT lv_tq_min_clu "Logical variable for coordination engine start torque and minimum torque and clutch" UBYTE _CNV_S_2_RANGE__0___1_CM 1 100. 0. 1. DISPLAY_IDENTIFIER LV_TQ_MIN_CLU ECU_ADDRESS 0xd0003eb8 BIT_MASK 0x1 /end MEASUREMENT
/begin MEASUREMENT tqi_min_req_pu "Minimum requested indicated torque in PU phase" SWORD _CNV_A_R_LINEAR_____30_CM 1 100. -1024. 1023.96875 DISPLAY_IDENTIFIER TQI_MIN_REQ_PU ECU_ADDRESS 0xd00052da FORMAT "%6.2" /end MEASUREMENT
/begin MEASUREMENT tq_min_req_pu "Minimum requested torque at clutch in PU phase" SWORD _CNV_A_R_LINEAR_____30_CM 1 100. -1024. 1023.96875 DISPLAY_IDENTIFIER TQ_MIN_REQ_PU ECU_ADDRESS 0xc0000d92 FORMAT "%6.2" /end MEASUREMENT
/begin CHARACTERISTIC c_n_dif_tq_st_1 "N_DIF threshold 1 for deactivating TQ_ST" VALUE 0xa10295f0 _REC_VAL_20_s2 65535. _CNV_A_R_LINEAR_____13_CM -32768. 32767. DISPLAY_IDENTIFIER C_N_DIF_TQ_ST_1 FORMAT "%5.0" /end CHARACTERISTIC
/begin CHARACTERISTIC c_n_dif_tq_st_2 "N_DIF threshold 2 for deactivating TQ_ST" VALUE 0xa10295f2 _REC_VAL_20_s2 65535. _CNV_A_R_LINEAR_____13_CM -32768. 32767. DISPLAY_IDENTIFIER C_N_DIF_TQ_ST_2 FORMAT "%5.0" /end CHARACTERISTIC
/begin CHARACTERISTIC ip_fac_n_dif_is "Idle self stabilizing factor" CURVE 0xa1023b20 _REC_CUR_20_u2_u2 15.999756 _CNV_A_R_LINEAR_____277_CM -8. 7.999756 DISPLAY_IDENTIFIER IP_FAC_N_DIF_IS FORMAT "%7.5"
 /begin AXIS_DESCR COM_AXIS n_sp_is_ratio _CNV_A_R_LINEAR_____113_CM 8 0. 7.9998779296875 FORMAT "%6.4" AXIS_PTS_REF ldp_n_sp_is_ratio /end AXIS_DESCR
/end CHARACTERISTIC
/begin CHARACTERISTIC ip_tqi_min_req_pu "Minimum requested indicated torque in PU phase" MAP 0xa1028fb8 _REC_MAP_20_u2_u1_u1 1023.96875 _CNV_A_R_LINEAR_____30_CM 0. 1023.96875 DISPLAY_IDENTIFIER IP_TQI_MIN_REQ_PU FORMAT "%7.2"
 /begin AXIS_DESCR COM_AXIS n_32 _CNV_A_R_LINEAR_____9_CM 12 0. 8160. FORMAT "%4.0" AXIS_PTS_REF ldpm_n_32__tqi_min_pu /end AXIS_DESCR
 /begin AXIS_DESCR COM_AXIS tco _CNV_A_R_LINEAR_____16_CM 4 -48. 142.5 FORMAT "%5.1" AXIS_PTS_REF ldpm_tco__tqi_min_pu /end AXIS_DESCR
/end CHARACTERISTIC
/begin AXIS_PTS ldp_n_sp_is_ratio "" 0xa1021008 n_sp_is_ratio _REC_AXS_20_u2 7.9998779296875 _CNV_A_R_LINEAR_____113_CM 8 0. 7.9998779296875 FORMAT "%6.4" /end AXIS_PTS
/begin CHARACTERISTIC lc_tq_loss_min_clu "Change of  TQ_MIN_CLU_1 calculation" VALUE 0xa1029dff _REC_VAL_20_u1 1. _CNV_A_R_LINEAR_____0_CM 0. 1. DISPLAY_IDENTIFIER LC_TQ_LOSS_MIN_CLU FORMAT "%1.0" /end CHARACTERISTIC
/begin CHARACTERISTIC lc_tq_loss_min_clu_1 "Change of  TQ_MIN_CLU_1 calculation addional TQ lossses" VALUE 0xa1029e00 _REC_VAL_20_u1 1. _CNV_A_R_LINEAR_____0_CM 0. 1. DISPLAY_IDENTIFIER LC_TQ_LOSS_MIN_CLU_1 FORMAT "%1.0" /end CHARACTERISTIC
/begin CHARACTERISTIC lc_tq_loss_min_clu_is "Change of  TQ_MIN_CLU_1 calculation addional switch at LV_IS " VALUE 0xa1029e01 _REC_VAL_20_u1 1. _CNV_A_R_LINEAR_____0_CM 0. 1. DISPLAY_IDENTIFIER LC_TQ_LOSS_MIN_CLU_IS FORMAT "%1.0" /end CHARACTERISTIC
/begin CHARACTERISTIC lc_inh_pu_req "Manual inhibition to consider LV_PU for TQ_MIN_CLU calculation" VALUE 0xa1029d64 _REC_VAL_20_u1 1. _CNV_A_R_LINEAR_____0_CM 0. 1. DISPLAY_IDENTIFIER LC_INH_PU_REQ FORMAT "%2.0" /end CHARACTERISTIC
/begin CHARACTERISTIC lc_inh_puc_req "Manual inhibition to consider LV_PUC for TQ_MIN_CLU calculation" VALUE 0xa1029d65 _REC_VAL_20_u1 1. _CNV_A_R_LINEAR_____0_CM 0. 1. DISPLAY_IDENTIFIER LC_INH_PUC_REQ FORMAT "%2.0" /end CHARACTERISTIC
/begin AXIS_PTS ldpm_n_32__tqi_min_pu "" 0xa1021e48 n_32 _REC_AXS_20_u1 8160. _CNV_A_R_LINEAR_____9_CM 12 0. 8160. FORMAT "%4.0" /end AXIS_PTS
/begin AXIS_PTS ldpm_tco__tqi_min_pu "" 0xa102227a tco _REC_AXS_20_u1 190.5 _CNV_A_R_LINEAR_____16_CM 4 -48. 142.5 FORMAT "%5.1" /end AXIS_PTS
/begin MEASUREMENT fac_tq_req_clu "Torque scaling factor for calculation requested torque at clutch" UWORD _CNV_A_R_LINEAR_____8_CM 1 100. 0. 1.99996948242188 DISPLAY_IDENTIFIER FAC_TQ_REQ_CLU ECU_ADDRESS 0xd0005376 FORMAT "%7.5" /end MEASUREMENT
/begin MEASUREMENT lv_tq_cru_act "Logical variable cruise control active" UBYTE _CNV_S_2_RANGE__0___1_CM 1 100. 0. 1. DISPLAY_IDENTIFIER LV_TQ_CRU_ACT ECU_ADDRESS 0xd0003f10 BIT_MASK 0x1 /end MEASUREMENT
/begin MEASUREMENT fac_tq_req "Torque factor from pedal value interpretation and cruise control" UWORD _CNV_A_R_LINEAR_____8_CM 1 100. 0. 1.99996948242188 DISPLAY_IDENTIFIER FAC_TQ_REQ ECU_ADDRESS 0xd0005374 FORMAT "%7.5" /end MEASUREMENT
/begin MEASUREMENT tqi_vs_max "???" SWORD _CNV_A_R_LINEAR_____30_CM 1 100. -1024. 1023.96875 DISPLAY_IDENTIFIER TQI_VS_MAX ECU_ADDRESS 0xd000538c FORMAT "%6.2" /end MEASUREMENT
/begin MEASUREMENT tq_loss_scha "Torque losses super-charger" SWORD _CNV_A_R_LINEAR_____30_CM 1 100. -1024. 1023.96875 DISPLAY_IDENTIFIER TQ_LOSS_SCHA ECU_ADDRESS 0xd0005384 FORMAT "%8.2" /end MEASUREMENT
/begin MEASUREMENT lv_tq_loss_acc_inp_orng "???" UBYTE _CNV_S_2_RANGE__0___1_CM 1 100. 0. 1. DISPLAY_IDENTIFIER LV_TQ_LOSS_ACC_INP_ORNG ECU_ADDRESS 0xd0003f18 BIT_MASK 0x1 /end MEASUREMENT
/begin MEASUREMENT lv_iga_ch_so2p_stb "???" UBYTE _CNV_S_2_RANGE__0___1_CM 1 100. 0. 1. DISPLAY_IDENTIFIER LV_IGA_CH_SO2P_STB ECU_ADDRESS 0xd0003f1f BIT_MASK 0x1 /end MEASUREMENT
/begin MEASUREMENT lamb_bas_cor_max "Maximum value basic lambda value" UWORD _CNV_A_R_LINEAR_____122_CM 1 100. 0. 31.9990234375 DISPLAY_IDENTIFIER LAMB_BAS_COR_MAX ECU_ADDRESS 0xd0005378 FORMAT "%7.4" /end MEASUREMENT
/begin MEASUREMENT lv_can_gs_ack "???" UBYTE _CNV_S_2_RANGE__0___1_CM 1 100. 0. 1. DISPLAY_IDENTIFIER LV_CAN_GS_ACK ECU_ADDRESS 0xd0003f17 BIT_MASK 0x1 /end MEASUREMENT
/begin MEASUREMENT lv_acp_orng "???" UBYTE _CNV_S_2_RANGE__0___1_CM 1 100. 0. 1. DISPLAY_IDENTIFIER LV_ACP_ORNG ECU_ADDRESS 0xd0003f19 BIT_MASK 0x1 /end MEASUREMENT
/begin MEASUREMENT eff_egr_s "???" UWORD _CNV_A_R_LINEAR_____8_CM 1 100. 0. 1.99996948242188 DISPLAY_IDENTIFIER EFF_EGR_S ECU_ADDRESS 0xd000537a FORMAT "%7.5" /end MEASUREMENT
/begin MEASUREMENT eff_pha_s "???" UWORD _CNV_A_R_LINEAR_____8_CM 1 100. 0. 1.99996948242188 DISPLAY_IDENTIFIER EFF_PHA_S ECU_ADDRESS 0xd000537c FORMAT "%7.5" /end MEASUREMENT
/begin MEASUREMENT tq_ad_add_s_swi "Adaptive engine torque value for switch between hom. and strat." SWORD _CNV_A_R_LINEAR_____30_CM 1 100. -1024. 1023.96875 DISPLAY_IDENTIFIER TQ_AD_ADD_S_SWI ECU_ADDRESS 0xd0005390 FORMAT "%7.1" /end MEASUREMENT
/begin MEASUREMENT tqi_cat_prot "???" SWORD _CNV_A_R_LINEAR_____30_CM 1 100. -1024. 1023.96875 DISPLAY_IDENTIFIER TQI_CAT_PROT ECU_ADDRESS 0xd000538e FORMAT "%6.2" /end MEASUREMENT
/begin MEASUREMENT tq_loss_thermo "Engine torque losses thermostat" SWORD _CNV_A_R_LINEAR_____30_CM 1 100. -1024. 1023.96875 DISPLAY_IDENTIFIER TQ_LOSS_THERMO ECU_ADDRESS 0xd0005386 FORMAT "%8.2" /end MEASUREMENT
/begin MEASUREMENT tq_loss_win_heat "Engine torque losses rar window heater" SWORD _CNV_A_R_LINEAR_____30_CM 1 100. -1024. 1023.96875 DISPLAY_IDENTIFIER TQ_LOSS_WIN_HEAT ECU_ADDRESS 0xd0005388 FORMAT "%8.2" /end MEASUREMENT
/begin CHARACTERISTIC c_tq_ad_add_s_swi "Adaptive engine torque Adaptation value for switch between hom and strat" VALUE 0xa1029ad8 _REC_VAL_20_s2 2047.96875 _CNV_A_R_LINEAR_____30_CM -1024. 1023.96875 DISPLAY_IDENTIFIER C_TQ_AD_ADD_S_SWI FORMAT "%7.1" /end CHARACTERISTIC
/begin CHARACTERISTIC c_fac_tqe "Effective engine torque at clutch" VALUE 0xa10293c8 _REC_VAL_20_u1 0.24902344 _CNV_A_R_LINEAR_____278_CM 0. 0.24902344 DISPLAY_IDENTIFIER C_FAC_TQE FORMAT "%6.4" /end CHARACTERISTIC
/begin MEASUREMENT tq_av "Actual engine torque static at clutch" SWORD _CNV_A_R_LINEAR_____30_CM 1 100. -1024. 1023.96875 DISPLAY_IDENTIFIER TQ_AV ECU_ADDRESS 0xd00052dc FORMAT "%6.2" /end MEASUREMENT
/begin MEASUREMENT tqe "Effective engine torque at clutch" SWORD _CNV_A_R_LINEAR_____30_CM 1 100. -1024. 1023.96875 DISPLAY_IDENTIFIER TQE ECU_ADDRESS 0xd00052de FORMAT "%6.2" /end MEASUREMENT
/begin MEASUREMENT tqe_dif "Difference effective engine torque at clutch" SWORD _CNV_A_R_LINEAR_____30_CM 1 100. -1024. 1023.96875 DISPLAY_IDENTIFIER TQE_DIF ECU_ADDRESS 0xc0000d9a FORMAT "%6.2" /end MEASUREMENT
/begin MEASUREMENT eff_tot_av "Total actual efficiency (in homogeneous mode)" UWORD _CNV_A_R_LINEAR_____8_CM 1 100. 0. 1.99996948242188 DISPLAY_IDENTIFIER EFF_TOT_AV ECU_ADDRESS 0xc0000d98 FORMAT "%7.5" /end MEASUREMENT
/begin MEASUREMENT tqi_bas "Basic indicated engine torque" SWORD _CNV_A_R_LINEAR_____30_CM 1 100. -1024. 1023.96875 DISPLAY_IDENTIFIER TQI_BAS ECU_ADDRESS 0xd00052e0 FORMAT "%6.2" /end MEASUREMENT
/begin MEASUREMENT tqi_ref_iga "Indicated engine torque corrected by EFF_IGA_BAS_COR" SWORD _CNV_A_R_LINEAR_____30_CM 1 100. -1024. 1023.96875 DISPLAY_IDENTIFIER TQI_REF_IGA ECU_ADDRESS 0xd00052e8 FORMAT "%6.2" /end MEASUREMENT
/begin MEASUREMENT tqi_ref_iga_lamb "Indicated engine torque corrected by EFF_IGA_BAS_COR and EFF_LAMB_BAS" SWORD _CNV_A_R_LINEAR_____30_CM 1 100. -1024. 1023.96875 DISPLAY_IDENTIFIER TQI_REF_IGA_LAMB ECU_ADDRESS 0xd00052e6 FORMAT "%6.2" /end MEASUREMENT
/begin MEASUREMENT tqi_ref_iga_min_lamb "Indicated engine torque corrected by EFF_IGA_MIN and EFF_LAMB_BAS" SWORD _CNV_A_R_LINEAR_____30_CM 1 100. -1024. 1023.96875 DISPLAY_IDENTIFIER TQI_REF_IGA_MIN_LAMB ECU_ADDRESS 0xd00052ee FORMAT "%6.2" /end MEASUREMENT
/begin MEASUREMENT tqi_ref_iga_scc "Indicated engine torque corrected by EFF_IGA_BAS_COR and EFF_SCC_BAS" SWORD _CNV_A_R_LINEAR_____30_CM 1 100. -1024. 1023.96875 DISPLAY_IDENTIFIER TQI_REF_IGA_SCC ECU_ADDRESS 0xd00052ec FORMAT "%6.2" /end MEASUREMENT
/begin MEASUREMENT tqi_ref_lamb "Indicated engine torque corrected by EFF_LAMB_BAS" SWORD _CNV_A_R_LINEAR_____30_CM 1 100. -1024. 1023.96875 DISPLAY_IDENTIFIER TQI_REF_LAMB ECU_ADDRESS 0xd00052e4 FORMAT "%6.2" /end MEASUREMENT
/begin MEASUREMENT tqi_ref_lamb_scc "Indicated engine torque corrected by EFF_LAMB_BAS and EFF_SCC_BAS" SWORD _CNV_A_R_LINEAR_____30_CM 1 100. -1024. 1023.96875 DISPLAY_IDENTIFIER TQI_REF_LAMB_SCC ECU_ADDRESS 0xd00052e2 FORMAT "%6.2" /end MEASUREMENT
/begin MEASUREMENT tqi_ref_scc "Indicated engine torque corrected by EFF_SCC_BAS" SWORD _CNV_A_R_LINEAR_____30_CM 1 100. -1024. 1023.96875 DISPLAY_IDENTIFIER TQI_REF_SCC ECU_ADDRESS 0xd00052ea FORMAT "%6.2" /end MEASUREMENT
/begin MEASUREMENT eff_tot_bas "Total basic efficiency" UWORD _CNV_A_R_LINEAR_____8_CM 1 100. 0. 1.99996948242188 DISPLAY_IDENTIFIER EFF_TOT_BAS ECU_ADDRESS 0xd00052f0 FORMAT "%7.5" /end MEASUREMENT
/begin MEASUREMENT eff_tot_bas_slow "Total basic efficiency for feedback to slow torque path" UWORD _CNV_A_R_LINEAR_____8_CM 1 100. 0. 1.99996948242188 DISPLAY_IDENTIFIER EFF_TOT_BAS_SLOW ECU_ADDRESS 0xd00052f2 FORMAT "%7.5" /end MEASUREMENT
/begin CHARACTERISTIC lc_mod_eff_av "Logical variable switch to EFF_LAMB_AV and EFF_SCC_AV calculation mode for TQI_BAS" VALUE 0xa1029d7c _REC_VAL_20_u1 1. _CNV_A_R_LINEAR_____0_CM 0. 1. DISPLAY_IDENTIFIER LC_MOD_EFF_AV FORMAT "%1.0" /end CHARACTERISTIC
/begin CHARACTERISTIC lc_tq_lim_inh "logical constant inhibition torque intervetion for safety in general" VALUE 0xa1029dfc _REC_VAL_20_u1 1. _CNV_A_R_LINEAR_____0_CM 0. 1. DISPLAY_IDENTIFIER LC_TQ_LIM_INH FORMAT "%2.0" /end CHARACTERISTIC
/begin CHARACTERISTIC lc_tq_lim_inh_fast "logical constant inhibition torque intervetion for safety for fast path" VALUE 0xa1029dfd _REC_VAL_20_u1 1. _CNV_A_R_LINEAR_____0_CM 0. 1. DISPLAY_IDENTIFIER LC_TQ_LIM_INH_FAST FORMAT "%2.0" /end CHARACTERISTIC
/begin CHARACTERISTIC lc_tq_lim_inh_slow "logical constant inhibition torque intervetion for safety for slow path" VALUE 0xa1029dfe _REC_VAL_20_u1 1. _CNV_A_R_LINEAR_____0_CM 0. 1. DISPLAY_IDENTIFIER LC_TQ_LIM_INH_SLOW FORMAT "%2.0" /end CHARACTERISTIC
/begin CHARACTERISTIC c_tqi_req_lim_pas "Maximum positive gradient of the requested torque TQI_REQ_LIM" VALUE 0xa1029b46 _REC_VAL_20_u2 1023.96875 _CNV_A_R_LINEAR_____30_CM 0. 1023.96875 DISPLAY_IDENTIFIER C_TQI_REQ_LIM_PAS FORMAT "%7.2" /end CHARACTERISTIC
/begin CHARACTERISTIC c_tq_lim_inc "Maximum positive gradient of the requested torque TQI_REQ_LIM" VALUE 0xa1029b0e _REC_VAL_20_u2 1023.96875 _CNV_A_R_LINEAR_____30_CM 0. 1023.96875 DISPLAY_IDENTIFIER C_TQ_LIM_INC FORMAT "%7.2" /end CHARACTERISTIC
/begin CHARACTERISTIC c_tq_lim_dec "Maximum negative gradient of the requested torque TQI_REQ_LIM" VALUE 0xa1029b0c _REC_VAL_20_u2 1023.96875 _CNV_A_R_LINEAR_____30_CM 0. 1023.96875 DISPLAY_IDENTIFIER C_TQ_LIM_DEC FORMAT "%7.2" /end CHARACTERISTIC
/begin CHARACTERISTIC c_t_tq_lim_intv "Time after active torque intervention to reset LV_TQ_LIM_INTV" VALUE 0xa102998c _REC_VAL_20_u2 2621.4 _CNV_A_R_LINEAR_____279_CM 0. 2621.4 DISPLAY_IDENTIFIER C_T_TQ_LIM_INTV FORMAT "%7.2" /end CHARACTERISTIC
/begin CHARACTERISTIC ip_tqi_dif_lim "Torque after torque interventionj to reset LV_TQ_LIM_INTV" MAP 0xa1028f98 _REC_MAP_20_u2_u1_u1 2047.96875 _CNV_A_R_LINEAR_____65_CM -1024. 1023.96875 DISPLAY_IDENTIFIER IP_TQI_DIF_LIM FORMAT "%6.2"
 /begin AXIS_DESCR COM_AXIS n_32 _CNV_A_R_LINEAR_____9_CM 4 0. 8160. FORMAT "%4.0" AXIS_PTS_REF ldp_n_32__tqi_dif_lim /end AXIS_DESCR
 /begin AXIS_DESCR COM_AXIS tqi_sp_mon _CNV_A_R_LINEAR_____280_CM 4 0. 510. FORMAT "%3.0" AXIS_PTS_REF ldp_tqi_sp_mon__tqi_dif_lim /end AXIS_DESCR
/end CHARACTERISTIC
/begin AXIS_PTS ldp_n_32__tqi_dif_lim "" 0xa1020dda n_32 _REC_AXS_20_u1 8160. _CNV_A_R_LINEAR_____9_CM 4 0. 8160. FORMAT "%4.0" /end AXIS_PTS
/begin AXIS_PTS ldp_tqi_sp_mon__tqi_dif_lim "" 0xa102162a tqi_sp_mon _REC_AXS_20_u1 510. _CNV_A_R_LINEAR_____280_CM 4 0. 510. FORMAT "%3.0" /end AXIS_PTS
/begin MEASUREMENT t_tq_lim_intv "Time counter after transition LV_TQ_INTV_ACT 1-->0 to set LV_TQ_LIM_INTV = 0" UWORD _CNV_A_R_LINEAR_____279_CM 1 100. 0. 2621.4 DISPLAY_IDENTIFIER T_TQ_LIM_INTV ECU_ADDRESS 0xc0000da0 FORMAT "%7.2" /end MEASUREMENT
/begin MEASUREMENT sum_tqi_req_lim "Event counter of active torque limitations" UWORD _CNV_A_R_LINEAR_____0_CM 1 100. 0. 65535. DISPLAY_IDENTIFIER SUM_TQI_REQ_LIM ECU_ADDRESS 0xd0005394 FORMAT "%5.0" /end MEASUREMENT
/begin MEASUREMENT tqi_req_lim_4 "Intermediate value 4 for requested torque for safety" SWORD _CNV_A_R_LINEAR_____30_CM 1 100. -1024. 1023.96875 DISPLAY_IDENTIFIER TQI_REQ_LIM_4 ECU_ADDRESS 0xc0000daa FORMAT "%6.2" /end MEASUREMENT
/begin MEASUREMENT tqi_req_lim_slow "???" SWORD _CNV_A_R_LINEAR_____30_CM 1 100. -1024. 1023.96875 DISPLAY_IDENTIFIER TQI_REQ_LIM_SLOW ECU_ADDRESS 0xd000539e FORMAT "%8.2" /end MEASUREMENT
/begin MEASUREMENT tqi_req_lim_3 "Intermediate value 3 for requested torque for safety" SWORD _CNV_A_R_LINEAR_____30_CM 1 100. -1024. 1023.96875 DISPLAY_IDENTIFIER TQI_REQ_LIM_3 ECU_ADDRESS 0xc0000da8 FORMAT "%6.2" /end MEASUREMENT
/begin MEASUREMENT lv_tq_lim_intv "Bit for torque intervention for safety active" UBYTE _CNV_S_2_RANGE__0___1_CM 1 100. 0. 1. DISPLAY_IDENTIFIER LV_TQ_LIM_INTV ECU_ADDRESS 0xd0003f20 BIT_MASK 0x1 /end MEASUREMENT
/begin MEASUREMENT tqi_req_lim_1 "Intermediate value 1 for requested torque for safety" SWORD _CNV_A_R_LINEAR_____30_CM 1 100. -1024. 1023.96875 DISPLAY_IDENTIFIER TQI_REQ_LIM_1 ECU_ADDRESS 0xc0000da4 FORMAT "%6.2" /end MEASUREMENT
/begin MEASUREMENT tqi_req_lim_2 "Intermediate value 2 for requested torque for safety" SWORD _CNV_A_R_LINEAR_____30_CM 1 100. -1024. 1023.96875 DISPLAY_IDENTIFIER TQI_REQ_LIM_2 ECU_ADDRESS 0xc0000da6 FORMAT "%6.2" /end MEASUREMENT
/begin MEASUREMENT tqi_dif_lim "Torque offset for regnition torque intervention active" SWORD _CNV_A_R_LINEAR_____30_CM 1 100. -1024. 1023.96875 DISPLAY_IDENTIFIER TQI_DIF_LIM ECU_ADDRESS 0xd000539a FORMAT "%6.2" /end MEASUREMENT
/begin MEASUREMENT t_tqi_req_lim "incremented time counter after transition LV_TQ_LIM_INTV_\" 0 -> 1 to set LV_TQ_LIM_INTV = 0" UWORD _CNV_A_R_LINEAR_____279_CM 1 100. 0. 2621.4 DISPLAY_IDENTIFIER T_TQI_REQ_LIM ECU_ADDRESS 0xc0000da2 FORMAT "%7.2" /end MEASUREMENT
/begin MEASUREMENT t_tqi_req_lim_max "max time counter after transition LV_TQ_LIM_INTV_\" 0 -> 1 to set LV_TQ_LIM_INTV = 0" UWORD _CNV_A_R_LINEAR_____279_CM 1 100. 0. 2621.4 DISPLAY_IDENTIFIER T_TQI_REQ_LIM_MAX ECU_ADDRESS 0xd0005396 FORMAT "%7.2" /end MEASUREMENT
/begin MEASUREMENT tqi_req_lim_fast "???" SWORD _CNV_A_R_LINEAR_____30_CM 1 100. -1024. 1023.96875 DISPLAY_IDENTIFIER TQI_REQ_LIM_FAST ECU_ADDRESS 0xd000539c FORMAT "%8.2" /end MEASUREMENT
/begin MEASUREMENT tqi_req_lim_dif "difference of torque request for safety" SWORD _CNV_A_R_LINEAR_____30_CM 1 100. -1024. 1023.96875 DISPLAY_IDENTIFIER TQI_REQ_LIM_DIF ECU_ADDRESS 0xc0000dac FORMAT "%8.2" /end MEASUREMENT
/begin MEASUREMENT tqi_req_lim_dif_max "max. difference of torque request for safety" SWORD _CNV_A_R_LINEAR_____30_CM 1 100. -1024. 1023.96875 DISPLAY_IDENTIFIER TQI_REQ_LIM_DIF_MAX ECU_ADDRESS 0xd0005398 FORMAT "%8.2" /end MEASUREMENT
/begin MEASUREMENT lv_tq_lim_intv_1 "Result for TQI_AV > TQI_SP_MON" UBYTE _CNV_S_2_RANGE__0___1_CM 1 100. 0. 1. DISPLAY_IDENTIFIER LV_TQ_LIM_INTV_1 ECU_ADDRESS 0xc0000db2 BIT_MASK 0x1 /end MEASUREMENT
/begin MEASUREMENT lv_tq_lim_intv_2 "ON-Delayed (40 ms) result for TQI_AV > TQI_SP_MON" UBYTE _CNV_S_2_RANGE__0___1_CM 1 100. 0. 1. DISPLAY_IDENTIFIER LV_TQ_LIM_INTV_2 ECU_ADDRESS 0xc0000db3 BIT_MASK 0x1 /end MEASUREMENT
/begin MEASUREMENT tqi_req_lim_dif_ofs "Permitted deviation offset" UWORD _CNV_A_R_LINEAR_____30_CM 1 100. 0. 255. DISPLAY_IDENTIFIER TQI_REQ_LIM_DIF_OFS ECU_ADDRESS 0xc0000dae FORMAT "%7.3" /end MEASUREMENT
/begin CHARACTERISTIC c_tqi_dif_lim_max_ofs "Offset after start condition" VALUE 0xa1029b3c _REC_VAL_20_u2 255. _CNV_A_R_LINEAR_____30_CM 0. 255. DISPLAY_IDENTIFIER C_TQI_DIF_LIM_MAX_OFS FORMAT "%7.3" /end CHARACTERISTIC
/begin CHARACTERISTIC c_dec_tqi_lim_dif_max "Decrement after start condition" VALUE 0xa10292f4 _REC_VAL_20_u2 254. _CNV_A_R_LINEAR_____30_CM 1. 255. DISPLAY_IDENTIFIER C_DEC_TQI_LIM_DIF_MAX FORMAT "%7.3" /end CHARACTERISTIC
/begin MEASUREMENT tqi_p_max "???" SWORD _CNV_A_R_LINEAR_____30_CM 1 100. -1024. 1023.96875 DISPLAY_IDENTIFIER TQI_P_MAX ECU_ADDRESS 0xd00053a0 FORMAT "%6.2" /end MEASUREMENT
/begin CHARACTERISTIC ip_tq_lim_amt "Maximum allowed torque at clutch due to torque limitation depending on gear ratio by AMT" CURVE 0xa1028970 _REC_CUR_20_u2_u2 1023.96875 _CNV_A_R_LINEAR_____30_CM 0. 1023.96875 DISPLAY_IDENTIFIER IP_TQ_LIM_AMT FORMAT "%7.2"
 /begin AXIS_DESCR COM_AXIS vs_fil _CNV_A_R_LINEAR_____66_CM 6 0. 511.99218 FORMAT "%7.3" AXIS_PTS_REF ldpm_vs_fil__tq_p_max /end AXIS_DESCR
/end CHARACTERISTIC
/begin CHARACTERISTIC ip_tq_lim_at "Maximum allowed torque at clutch due to torque limitation depending on gear ratio by AT" CURVE 0xa102897c _REC_CUR_20_u2_u2 1023.96875 _CNV_A_R_LINEAR_____30_CM 0. 1023.96875 DISPLAY_IDENTIFIER IP_TQ_LIM_AT FORMAT "%7.2"
 /begin AXIS_DESCR COM_AXIS vs_fil _CNV_A_R_LINEAR_____66_CM 6 0. 511.99218 FORMAT "%7.3" AXIS_PTS_REF ldpm_vs_fil__tq_p_max /end AXIS_DESCR
/end CHARACTERISTIC
/begin CHARACTERISTIC c_t_tq_lim "Time delay vehicle speed activation" VALUE 0xa102998a _REC_VAL_20_u2 20.47 _CNV_A_R_LINEAR_____3_CM 0. 20.47 DISPLAY_IDENTIFIER C_T_TQ_LIM FORMAT "%5.3" /end CHARACTERISTIC
/begin CHARACTERISTIC lc_tqi_p_max_inh_as "Logical constant for torque limitation ON/OFF (0=ON)" VALUE 0xa1029e08 _REC_VAL_20_u1 1. _CNV_A_R_LINEAR_____0_CM 0. 1. DISPLAY_IDENTIFIER LC_TQI_P_MAX_INH_AS FORMAT "%1.0" /end CHARACTERISTIC
/begin CHARACTERISTIC id_tq_p_max_mt "Maximum allowed torque at clutch due to torque limitation depending on gear ratio" CURVE 0xa1022ffc _REC_CUR_20_u2_u1 1023.96875 _CNV_A_R_LINEAR_____30_CM 0. 1023.96875 DISPLAY_IDENTIFIER ID_TQ_P_MAX_MT FORMAT "%7.2"
 /begin AXIS_DESCR COM_AXIS gear _CNV_A_R_LINEAR_____50_CM 13 0. 12. FORMAT "%3.0" AXIS_PTS_REF ldpm_gear__tq_p_max /end AXIS_DESCR
/end CHARACTERISTIC
/begin CHARACTERISTIC id_tq_p_max_at "Minimum allowed torque at clutch due to torque limitation depending on gear ratio" CURVE 0xa1022fe0 _REC_CUR_20_u2_u1 1023.96875 _CNV_A_R_LINEAR_____30_CM 0. 1023.96875 DISPLAY_IDENTIFIER ID_TQ_P_MAX_AT FORMAT "%7.2"
 /begin AXIS_DESCR COM_AXIS gear _CNV_A_R_LINEAR_____50_CM 13 0. 12. FORMAT "%3.0" AXIS_PTS_REF ldpm_gear__tq_p_max /end AXIS_DESCR
/end CHARACTERISTIC
/begin AXIS_PTS ldpm_gear__tq_p_max "" 0xa1021ae8 gear _REC_AXS_20_u1 12. _CNV_A_R_LINEAR_____50_CM 13 0. 12. FORMAT "%3.0" /end AXIS_PTS
/begin AXIS_PTS ldpm_vs_fil__tq_p_max "" 0xa10223e8 vs_fil _REC_AXS_20_u2 511.99218 _CNV_A_R_LINEAR_____66_CM 6 0. 511.99218 FORMAT "%7.3" /end AXIS_PTS
/begin CHARACTERISTIC c_tq_lim_at_lgrd "Limitating gradient at end of AT torque limitation" VALUE 0xa1029b0a _REC_VAL_20_u2 1023.96875 _CNV_A_R_LINEAR_____30_CM 0. 1023.96875 DISPLAY_IDENTIFIER C_TQ_LIM_AT_LGRD FORMAT "%7.2" /end CHARACTERISTIC
/begin MEASUREMENT tq_loss_pste "Summary Engine Torque losses power steering" SWORD _CNV_A_R_LINEAR_____30_CM 1 100. -1024. 1023.96875 DISPLAY_IDENTIFIER TQ_LOSS_PSTE ECU_ADDRESS 0xd00052f4 FORMAT "%8.2" /end MEASUREMENT
/begin MEASUREMENT lv_pste_disable "LV for disabling PSTE intervention due to EMS error" UBYTE _CNV_S_2_RANGE__0___1_CM 1 100. 0. 1. DISPLAY_IDENTIFIER LV_PSTE_DISABLE ECU_ADDRESS 0xd0003ec3 BIT_MASK 0x1 /end MEASUREMENT
/begin MEASUREMENT lv_pste_disable_can "LV for disabling PSTE intervention due to CAN error" UBYTE _CNV_S_2_RANGE__0___1_CM 1 100. 0. 1. DISPLAY_IDENTIFIER LV_PSTE_DISABLE_CAN ECU_ADDRESS 0xd0003ec2 BIT_MASK 0x1 /end MEASUREMENT
/begin MEASUREMENT lv_pste_ena "LV for enabling PSTE intervention" UBYTE _CNV_S_2_RANGE__0___1_CM 1 100. 0. 1. DISPLAY_IDENTIFIER LV_PSTE_ENA ECU_ADDRESS 0xd0003ec4 BIT_MASK 0x1 /end MEASUREMENT
/begin CHARACTERISTIC lc_pste_ena "Logical constant for enabling of power steering" VALUE 0xa1029db8 _REC_VAL_20_u1 1. _CNV_A_R_LINEAR_____0_CM 0. 1. DISPLAY_IDENTIFIER LC_PSTE_ENA FORMAT "%1.0" /end CHARACTERISTIC
/begin CHARACTERISTIC ip_tq_add_pste "Power steering torque reserve depending on engine-speed" CURVE 0xa10283d8 _REC_CUR_20_u2_u2 1023.96875 _CNV_A_R_LINEAR_____30_CM 0. 1023.96875 DISPLAY_IDENTIFIER IP_TQ_ADD_PSTE FORMAT "%7.2"
 /begin AXIS_DESCR COM_AXIS ang_pste_stnd _CNV_A_R_LINEAR_____225_CM 8 -100. 99.99694824 FORMAT "%8.3" AXIS_PTS_REF ldpm_ang_pste_stnd_tqlo_1 /end AXIS_DESCR
/end CHARACTERISTIC
/begin MEASUREMENT tq_loss_pste_1 "Engine Torque losses power steering" SWORD _CNV_A_R_LINEAR_____30_CM 1 100. -1024. 1023.96875 DISPLAY_IDENTIFIER TQ_LOSS_PSTE_1 ECU_ADDRESS 0xd00052f8 FORMAT "%8.2" /end MEASUREMENT
/begin MEASUREMENT lv_pste_2_disable "LV for disabling PSTE_2 intervention due to EMS error" UBYTE _CNV_S_2_RANGE__0___1_CM 1 100. 0. 1. DISPLAY_IDENTIFIER LV_PSTE_2_DISABLE ECU_ADDRESS 0xd0003ec6 BIT_MASK 0x1 /end MEASUREMENT
/begin MEASUREMENT lv_pste_2_disable_can "LV for disabling PSTE_2 intervention due to CAN error" UBYTE _CNV_S_2_RANGE__0___1_CM 1 100. 0. 1. DISPLAY_IDENTIFIER LV_PSTE_2_DISABLE_CAN ECU_ADDRESS 0xd0003ec5 BIT_MASK 0x1 /end MEASUREMENT
/begin MEASUREMENT lv_pste_2_ena "LV for enabling PSTE_2 intervention" UBYTE _CNV_S_2_RANGE__0___1_CM 1 100. 0. 1. DISPLAY_IDENTIFIER LV_PSTE_2_ENA ECU_ADDRESS 0xd0003ec7 BIT_MASK 0x1 /end MEASUREMENT
/begin MEASUREMENT tq_loss_pste_2_av "Engine Torque losses active front steering active value" SWORD _CNV_A_R_LINEAR_____30_CM 1 100. -1024. 1023.96875 DISPLAY_IDENTIFIER TQ_LOSS_PSTE_2_AV ECU_ADDRESS 0xc0000dc4 FORMAT "%8.2" /end MEASUREMENT
/begin MEASUREMENT tq_loss_pste_2_sp "Engine Torque losses active front steering set point" SWORD _CNV_A_R_LINEAR_____30_CM 1 100. -1024. 1023.96875 DISPLAY_IDENTIFIER TQ_LOSS_PSTE_2_SP ECU_ADDRESS 0xc0000dc2 FORMAT "%8.2" /end MEASUREMENT
/begin MEASUREMENT tq_loss_pste_2_dif "Engine Torque losses active front steering difference" SWORD _CNV_A_R_LINEAR_____30_CM 1 100. -1024. 1023.96875 DISPLAY_IDENTIFIER TQ_LOSS_PSTE_2_DIF ECU_ADDRESS 0xc0000dc6 FORMAT "%8.2" /end MEASUREMENT
/begin MEASUREMENT tq_loss_pste_2_grd "Engine Torque losses active front steering gradient" SWORD _CNV_A_R_LINEAR_____165_CM 1 100. -1024. 1023.96875 DISPLAY_IDENTIFIER TQ_LOSS_PSTE_2_GRD ECU_ADDRESS 0xc0000dc8 FORMAT "%8.2" /end MEASUREMENT
/begin MEASUREMENT t_pste_2 "SP AV Timer PSTE_2" UBYTE _CNV_A_R_LINEAR_____3_CM 1 100. 0. 2.55 DISPLAY_IDENTIFIER T_PSTE_2 ECU_ADDRESS 0xd0003ec0 FORMAT "%4.2" /end MEASUREMENT
/begin CHARACTERISTIC lc_pste_2_ena "Logical constant for inhibitation of active power steering" VALUE 0xa1029db6 _REC_VAL_20_u1 1. _CNV_A_R_LINEAR_____0_CM 0. 1. DISPLAY_IDENTIFIER LC_PSTE_2_ENA FORMAT "%1.0" /end CHARACTERISTIC
/begin AXIS_PTS ldpm_n_32__pste_2 "" 0xa1021e1c n_32 _REC_AXS_20_u1 8160. _CNV_A_R_LINEAR_____9_CM 8 0. 8160. FORMAT "%4.0" /end AXIS_PTS
/begin AXIS_PTS ldpm_t_pste_2__pste_2 "" 0xa10221f4 t_pste_2 _REC_AXS_20_u1 2.55 _CNV_A_R_LINEAR_____3_CM 4 0. 2.55 FORMAT "%4.2" /end AXIS_PTS
/begin CHARACTERISTIC ip_fac_tq_loss_pste_2_sp "Active power steering torque loss correction SP" MAP 0xa1024670 _REC_MAP_20_u1_u1_u1 3.984375 _CNV_A_R_LINEAR_____281_CM -2. 1.984375 DISPLAY_IDENTIFIER IP_FAC_TQ_LOSS_PSTE_2_SP FORMAT "%5.2"
 /begin AXIS_DESCR COM_AXIS n_32 _CNV_A_R_LINEAR_____9_CM 4 0. 8160. FORMAT "%4.0" AXIS_PTS_REF ldpm_n_32__pste_2_1 /end AXIS_DESCR
 /begin AXIS_DESCR COM_AXIS t_pste_2 _CNV_A_R_LINEAR_____3_CM 4 0. 2.55 FORMAT "%4.2" AXIS_PTS_REF ldpm_t_pste_2__pste_2 /end AXIS_DESCR
/end CHARACTERISTIC
/begin CHARACTERISTIC ip_fac_tq_loss_pste_2_av "Active power steering torque loss correction AV" MAP 0xa1024660 _REC_MAP_20_u1_u1_u1 3.984375 _CNV_A_R_LINEAR_____281_CM -2. 1.984375 DISPLAY_IDENTIFIER IP_FAC_TQ_LOSS_PSTE_2_AV FORMAT "%5.2"
 /begin AXIS_DESCR COM_AXIS n_32 _CNV_A_R_LINEAR_____9_CM 4 0. 8160. FORMAT "%4.0" AXIS_PTS_REF ldpm_n_32__pste_2_1 /end AXIS_DESCR
 /begin AXIS_DESCR COM_AXIS t_pste_2 _CNV_A_R_LINEAR_____3_CM 4 0. 2.55 FORMAT "%4.2" AXIS_PTS_REF ldpm_t_pste_2__pste_2 /end AXIS_DESCR
/end CHARACTERISTIC
/begin CHARACTERISTIC c_fac_tq_loss_pste_2_grd "Correction value gradient" VALUE 0xa10293bb _REC_VAL_20_u1 0.159375 _CNV_A_R_LINEAR_____281_CM -2. 1.984375 DISPLAY_IDENTIFIER C_FAC_TQ_LOSS_PSTE_2_GRD FORMAT "%5.2" /end CHARACTERISTIC
/begin CHARACTERISTIC c_fac_tq_loss_pste_2_dif "Correction value differences" VALUE 0xa10293ba _REC_VAL_20_u1 0.159375 _CNV_A_R_LINEAR_____281_CM -2. 1.984375 DISPLAY_IDENTIFIER C_FAC_TQ_LOSS_PSTE_2_DIF FORMAT "%5.2" /end CHARACTERISTIC
/begin MEASUREMENT tq_add_pste "Engine torque reserve for power steering" SWORD _CNV_A_R_LINEAR_____30_CM 1 100. -1024. 1023.96875 DISPLAY_IDENTIFIER TQ_ADD_PSTE ECU_ADDRESS 0xd00052f6 FORMAT "%8.2" /end MEASUREMENT
/begin MEASUREMENT tq_add_pste_1 "Engine torque reserve for power steering" SWORD _CNV_A_R_LINEAR_____30_CM 1 100. -1024. 1023.96875 DISPLAY_IDENTIFIER TQ_ADD_PSTE_1 ECU_ADDRESS 0xc0000dc0 FORMAT "%8.2" /end MEASUREMENT
/begin MEASUREMENT tq_add_pste_2 "Engine torque reserve active front  steering" SWORD _CNV_A_R_LINEAR_____30_CM 1 100. -1024. 1023.96875 DISPLAY_IDENTIFIER TQ_ADD_PSTE_2 ECU_ADDRESS 0xd00052fc FORMAT "%8.2" /end MEASUREMENT
/begin MEASUREMENT tq_loss_pste_2 "Engine Torque losses active front steering" SWORD _CNV_A_R_LINEAR_____30_CM 1 100. -1024. 1023.96875 DISPLAY_IDENTIFIER TQ_LOSS_PSTE_2 ECU_ADDRESS 0xd00052fa FORMAT "%8.2" /end MEASUREMENT
/begin MEASUREMENT tq_loss_pste_2_raw "Engine Torque losses active front steering" SWORD _CNV_A_R_LINEAR_____30_CM 1 100. -1024. 1023.96875 DISPLAY_IDENTIFIER TQ_LOSS_PSTE_2_RAW ECU_ADDRESS 0xc0000dca FORMAT "%8.2" /end MEASUREMENT
/begin CHARACTERISTIC c_tq_add_pste_1_lih "limp home value torque reserve" VALUE 0xa1029ae6 _REC_VAL_20_u2 40.95875 _CNV_A_R_LINEAR_____30_CM 0. 1023.96875 DISPLAY_IDENTIFIER C_TQ_ADD_PSTE_1_LIH FORMAT "%7.2" /end CHARACTERISTIC
/begin AXIS_PTS ldpm_ang_pste_stnd_tqlo_1 "" 0xa1021910 ang_pste_stnd _REC_AXS_20_u2 199.99694824 _CNV_A_R_LINEAR_____225_CM 8 -100. 99.99694824 FORMAT "%8.3" /end AXIS_PTS
/begin AXIS_PTS ldpm_ang_pste_stnd_tqlo "" 0xa10218fc ang_pste_stnd _REC_AXS_20_u2 199.99694824 _CNV_A_R_LINEAR_____225_CM 8 -100. 99.99694824 FORMAT "%8.3" /end AXIS_PTS
/begin AXIS_PTS ldp_tq_loss_pste_2_sp_can "" 0xa10215b0 tq_loss_pste_2_sp_can _REC_AXS_20_u2 2047.96875 _CNV_A_R_LINEAR_____65_CM 8 -1024. 1023.96875 FORMAT "%6.2" /end AXIS_PTS
/begin CHARACTERISTIC ip_fac_tq_loss_pste "Factor weighting the torque request" CURVE 0xa10245e8 _REC_CUR_20_u1_u2 3.984375 _CNV_A_R_LINEAR_____255_CM 0. 3.984375 DISPLAY_IDENTIFIER IP_FAC_TQ_LOSS_PSTE FORMAT "%4.2"
 /begin AXIS_DESCR COM_AXIS n _CNV_A_R_LINEAR_____13_CM 8 0. 8160. FORMAT "%4.0" AXIS_PTS_REF ldp_n__fac_tq_add_pste /end AXIS_DESCR
/end CHARACTERISTIC
/begin AXIS_PTS ldp_n__fac_tq_add_pste "" 0xa1020e84 n _REC_AXS_20_u2 8160. _CNV_A_R_LINEAR_____13_CM 8 0. 8160. FORMAT "%4.0" /end AXIS_PTS
/begin AXIS_PTS ldpm_vs_tq_loss_pste_2 "" 0xa1022424 vs _REC_AXS_20_u1 255. _CNV_A_R_LINEAR_____6_CM 6 0. 255. FORMAT "%3.0" /end AXIS_PTS
/begin CHARACTERISTIC ip_tq_add_pste_2 "Active power steering torque reserve" MAP 0xa10283e8 _REC_MAP_20_u2_u2_u2 2047.96875 _CNV_A_R_LINEAR_____65_CM -1024. 1023.96875 DISPLAY_IDENTIFIER IP_TQ_ADD_PSTE_2 FORMAT "%6.2"
 /begin AXIS_DESCR COM_AXIS ang_pste_stnd _CNV_A_R_LINEAR_____225_CM 8 -100. 99.99694824 FORMAT "%8.3" AXIS_PTS_REF ldpm_ang_pste_stnd_tqlo /end AXIS_DESCR
 /begin AXIS_DESCR COM_AXIS tq_loss_pste_2_sp_can _CNV_A_R_LINEAR_____65_CM 8 -1024. 1023.96875 FORMAT "%6.2" AXIS_PTS_REF ldp_tq_loss_pste_2_sp_can /end AXIS_DESCR
/end CHARACTERISTIC
/begin CHARACTERISTIC ip_tq_add_pste_2_lih "factor active power steering torque loss correction vs" MAP 0xa1028468 _REC_MAP_20_u2_u1_u2 2047.96875 _CNV_A_R_LINEAR_____65_CM -1024. 1023.96875 DISPLAY_IDENTIFIER IP_TQ_ADD_PSTE_2_LIH FORMAT "%6.2"
 /begin AXIS_DESCR COM_AXIS vs _CNV_A_R_LINEAR_____6_CM 6 0. 255. FORMAT "%3.0" AXIS_PTS_REF ldpm_vs_tq_loss_pste_2 /end AXIS_DESCR
 /begin AXIS_DESCR COM_AXIS ang_pste_stnd _CNV_A_R_LINEAR_____225_CM 8 -100. 99.99694824 FORMAT "%8.3" AXIS_PTS_REF ldpm_ang_pste_stnd_tqlo /end AXIS_DESCR
/end CHARACTERISTIC
/begin CHARACTERISTIC ip_tq_loss_pste "Power steering torque loss versus engine-speed" MAP 0xa1028bd0 _REC_MAP_20_u2_u2_u2 2047.96875 _CNV_A_R_LINEAR_____65_CM -1024. 1023.96875 DISPLAY_IDENTIFIER IP_TQ_LOSS_PSTE FORMAT "%6.2"
 /begin AXIS_DESCR COM_AXIS ang_pste_stnd _CNV_A_R_LINEAR_____225_CM 8 -100. 99.99694824 FORMAT "%8.3" AXIS_PTS_REF ldpm_ang_pste_stnd_tqlo_1 /end AXIS_DESCR
 /begin AXIS_DESCR COM_AXIS vel_ang_pste_cor _CNV_A_R_LINEAR_____282_CM 8 -1439.98976 1439.945815 FORMAT "%8.2" AXIS_PTS_REF ldp_vel_ang_pste_tqlo_1 /end AXIS_DESCR
/end CHARACTERISTIC
/begin AXIS_PTS ldp_vel_ang_pste_tqlo_1 "" 0xa102171c vel_ang_pste_cor _REC_AXS_20_u2 2879.935575 _CNV_A_R_LINEAR_____282_CM 8 -1439.98976 1439.945815 FORMAT "%8.2" /end AXIS_PTS
/begin AXIS_PTS ldpm_vel_ang_pste_tqlo "" 0xa10223ac vel_ang_pste_cor _REC_AXS_20_u2 2879.935575 _CNV_A_R_LINEAR_____282_CM 8 -1439.98976 1439.945815 FORMAT "%8.2" /end AXIS_PTS
/begin CHARACTERISTIC ip_fac_tq_add_pste_2_vs "Active power steering torque loss correction" CURVE 0xa10243fc _REC_CUR_20_u1_u1 3.984375 _CNV_A_R_LINEAR_____283_CM 0. 3.984375 DISPLAY_IDENTIFIER IP_FAC_TQ_ADD_PSTE_2_VS FORMAT "%4.2"
 /begin AXIS_DESCR COM_AXIS vs _CNV_A_R_LINEAR_____6_CM 6 0. 255. FORMAT "%3.0" AXIS_PTS_REF ldpm_vs_tq_loss_pste_2 /end AXIS_DESCR
/end CHARACTERISTIC
/begin CHARACTERISTIC ip_fac_tq_loss_pste_2 "factor active power steering torque loss correction vs" MAP 0xa10245f0 _REC_MAP_20_u1_u1_u1 3.984375 _CNV_A_R_LINEAR_____283_CM 0. 3.984375 DISPLAY_IDENTIFIER IP_FAC_TQ_LOSS_PSTE_2 FORMAT "%4.2"
 /begin AXIS_DESCR COM_AXIS vs _CNV_A_R_LINEAR_____6_CM 6 0. 255. FORMAT "%3.0" AXIS_PTS_REF ldpm_vs_tq_loss_pste_2 /end AXIS_DESCR
 /begin AXIS_DESCR COM_AXIS n_32 _CNV_A_R_LINEAR_____9_CM 8 0. 8160. FORMAT "%4.0" AXIS_PTS_REF ldpm_n_32__pste_2 /end AXIS_DESCR
/end CHARACTERISTIC
/begin CHARACTERISTIC ip_fac_tq_loss_pste_2_vs "factor active power steering torque loss correction vs" MAP 0xa1024680 _REC_MAP_20_u1_u1_u1 3.984375 _CNV_A_R_LINEAR_____283_CM 0. 3.984375 DISPLAY_IDENTIFIER IP_FAC_TQ_LOSS_PSTE_2_VS FORMAT "%4.2"
 /begin AXIS_DESCR COM_AXIS vs _CNV_A_R_LINEAR_____6_CM 6 0. 255. FORMAT "%3.0" AXIS_PTS_REF ldpm_vs_tq_loss_pste_2 /end AXIS_DESCR
 /begin AXIS_DESCR COM_AXIS n_32 _CNV_A_R_LINEAR_____9_CM 8 0. 8160. FORMAT "%4.0" AXIS_PTS_REF ldpm_n_32__pste_2 /end AXIS_DESCR
/end CHARACTERISTIC
/begin CHARACTERISTIC ip_tq_loss_pste_2 "Active power steering torque loss correction" MAP 0xa1028c50 _REC_MAP_20_u2_u2_u2 2047.96875 _CNV_A_R_LINEAR_____65_CM -1024. 1023.96875 DISPLAY_IDENTIFIER IP_TQ_LOSS_PSTE_2 FORMAT "%6.2"
 /begin AXIS_DESCR COM_AXIS ang_pste_stnd _CNV_A_R_LINEAR_____225_CM 8 -100. 99.99694824 FORMAT "%8.3" AXIS_PTS_REF ldpm_ang_pste_stnd_tqlo /end AXIS_DESCR
 /begin AXIS_DESCR COM_AXIS vel_ang_pste_cor _CNV_A_R_LINEAR_____282_CM 8 -1439.98976 1439.945815 FORMAT "%8.2" AXIS_PTS_REF ldpm_vel_ang_pste_tqlo /end AXIS_DESCR
/end CHARACTERISTIC
/begin CHARACTERISTIC ip_fac_tq_loss_pste_2_ang "factor active power steering torque loss correction °STW" MAP 0xa1024620 _REC_MAP_20_u1_u2_u2 3.984375 _CNV_A_R_LINEAR_____283_CM 0. 3.984375 DISPLAY_IDENTIFIER IP_FAC_TQ_LOSS_PSTE_2_ANG FORMAT "%4.2"
 /begin AXIS_DESCR COM_AXIS ang_pste_stnd _CNV_A_R_LINEAR_____225_CM 8 -100. 99.99694824 FORMAT "%8.3" AXIS_PTS_REF ldpm_ang_pste_stnd_tqlo /end AXIS_DESCR
 /begin AXIS_DESCR COM_AXIS vel_ang_pste_cor _CNV_A_R_LINEAR_____282_CM 8 -1439.98976 1439.945815 FORMAT "%8.2" AXIS_PTS_REF ldpm_vel_ang_pste_tqlo /end AXIS_DESCR
/end CHARACTERISTIC
/begin CHARACTERISTIC c_tq_loss_pste_2_sp_min "Min torque threshold for timer reset" VALUE 0xa1029b1c _REC_VAL_20_s2 81.91875 _CNV_A_R_LINEAR_____30_CM -1024. 1023.96875 DISPLAY_IDENTIFIER C_TQ_LOSS_PSTE_2_SP_MIN FORMAT "%8.2" /end CHARACTERISTIC
/begin CHARACTERISTIC lc_tq_loss_pste_2_swi "configuration AFS switch" VALUE 0xa1029e02 _REC_VAL_20_u1 4.e-002 _CNV_A_R_LINEAR_____0_CM 0. 1. DISPLAY_IDENTIFIER LC_TQ_LOSS_PSTE_2_SWI FORMAT "%2.0" /end CHARACTERISTIC
/begin CHARACTERISTIC c_tq_loss_pste_1_lih "limp home value torque losses" VALUE 0xa1029b18 _REC_VAL_20_s2 81.91875 _CNV_A_R_LINEAR_____30_CM -1024. 1023.96875 DISPLAY_IDENTIFIER C_TQ_LOSS_PSTE_1_LIH FORMAT "%8.2" /end CHARACTERISTIC
/begin CHARACTERISTIC c_tq_loss_pste_2_lih "limp home value torque losses" VALUE 0xa1029b1a _REC_VAL_20_s2 81.91875 _CNV_A_R_LINEAR_____30_CM -1024. 1023.96875 DISPLAY_IDENTIFIER C_TQ_LOSS_PSTE_2_LIH FORMAT "%8.2" /end CHARACTERISTIC
/begin MEASUREMENT state_tq_pste_2_plaus "Bitwise coded State for PSTE_2 intervention state" UBYTE _CNV_A_R_LINEAR_____0_CM 1 100. 0. 255. DISPLAY_IDENTIFIER STATE_TQ_PSTE_2_PLAUS ECU_ADDRESS 0xd0003ec1 FORMAT "%3.0" /end MEASUREMENT
/begin CHARACTERISTIC c_tq_add_pste_ad "threshold torque reserve PSTE for inhibition of IS-control adaptations" VALUE 0xa1029ae8 _REC_VAL_20_u2 40.95875 _CNV_A_R_LINEAR_____30_CM 0. 1023.96875 DISPLAY_IDENTIFIER C_TQ_ADD_PSTE_AD FORMAT "%7.2" /end CHARACTERISTIC
/begin CHARACTERISTIC c_tq_loss_pste_ad "threshold torque reserve PSTE for inhibition of IS-control adaptations" VALUE 0xa1029b1e _REC_VAL_20_s2 81.91875 _CNV_A_R_LINEAR_____30_CM -1024. 1023.96875 DISPLAY_IDENTIFIER C_TQ_LOSS_PSTE_AD FORMAT "%8.2" /end CHARACTERISTIC
/begin CHARACTERISTIC c_t_pste_dly_ad "threshold torque reserve PSTE for inhibition of IS-control adaptations" VALUE 0xa102993a _REC_VAL_20_u1 0.102 _CNV_A_R_LINEAR_____3_CM 0. 2.55 DISPLAY_IDENTIFIER C_T_PSTE_DLY_AD FORMAT "%4.2" /end CHARACTERISTIC
/begin MEASUREMENT lv_tq_loss_pste_is_ad_inh "flag for inhibition of IS-control adaptations due to torque losses PSTE" UBYTE _CNV_S_2_RANGE__0___1_CM 1 100. 0. 1. DISPLAY_IDENTIFIER LV_TQ_LOSS_PSTE_IS_AD_INH ECU_ADDRESS 0xd0003ec8 BIT_MASK 0x1 /end MEASUREMENT
/begin MEASUREMENT lv_tq_add_pste_is_ad_inh "flag for inhibition of IS-control adaptations due to torque reserve PSTE" UBYTE _CNV_S_2_RANGE__0___1_CM 1 100. 0. 1. DISPLAY_IDENTIFIER LV_TQ_ADD_PSTE_IS_AD_INH ECU_ADDRESS 0xd0003ec9 BIT_MASK 0x1 /end MEASUREMENT
/begin CHARACTERISTIC lc_pste_2_man_act "logical variable for manual activation of PSTE_2 conditions independent of PSTE_2 messages" VALUE 0xa1029db7 _REC_VAL_20_u1 1. _CNV_A_R_LINEAR_____0_CM 0. 1. DISPLAY_IDENTIFIER LC_PSTE_2_MAN_ACT FORMAT "%1.0" /end CHARACTERISTIC
/begin AXIS_PTS ldpm_n_32__pste_2_1 "" 0xa1021e26 n_32 _REC_AXS_20_u1 8160. _CNV_A_R_LINEAR_____9_CM 4 0. 8160. FORMAT "%4.0" /end AXIS_PTS
/begin MEASUREMENT ang_pste_stnd "relative steering wheel sensor angle" SWORD _CNV_A_R_LINEAR_____201_CM 1 100. -100. 99.9969482421875 DISPLAY_IDENTIFIER ANG_PSTE_STND ECU_ADDRESS 0xd00050c0 FORMAT "%8.3" /end MEASUREMENT
/begin MEASUREMENT ang_pste_end_ri_ad "relative steering wheel sensor angle right" SWORD _CNV_A_R_LINEAR_____80_CM 1 100. -1439.98976 1439.945815 DISPLAY_IDENTIFIER ANG_PSTE_END_RI_AD ECU_ADDRESS 0xd00050c2 FORMAT "%8.3" /end MEASUREMENT
/begin MEASUREMENT ang_pste_end_le_ad "relative steering wheel sensor left side adaptation" SWORD _CNV_A_R_LINEAR_____80_CM 1 100. -1439.98976 1439.945815 DISPLAY_IDENTIFIER ANG_PSTE_END_LE_AD ECU_ADDRESS 0xd00050c4 FORMAT "%8.3" /end MEASUREMENT
/begin CHARACTERISTIC c_ang_pste_end_le_ini "initialisation value  left  ANG_PSTE_STND" VALUE 0xa10291a4 _REC_VAL_20_s2 2879.935575 _CNV_A_R_LINEAR_____80_CM -1439.98976 1439.945815 DISPLAY_IDENTIFIER C_ANG_PSTE_END_LE_INI FORMAT "%8.3" /end CHARACTERISTIC
/begin CHARACTERISTIC c_ang_pste_end_ri_ini "initialisation value  right  ANG_PSTE_STND" VALUE 0xa10291a6 _REC_VAL_20_s2 2879.935575 _CNV_A_R_LINEAR_____80_CM -1439.98976 1439.945815 DISPLAY_IDENTIFIER C_ANG_PSTE_END_RI_INI FORMAT "%8.3" /end CHARACTERISTIC
/begin CHARACTERISTIC c_ang_pste_end_dif "cal. difference between  ANG_PSTE_END_LE/RI_AD out of NVMY and init-value (at reset)" VALUE 0xa10291a2 _REC_VAL_20_s2 2879.935575 _CNV_A_R_LINEAR_____80_CM -1439.98976 1439.945815 DISPLAY_IDENTIFIER C_ANG_PSTE_END_DIF FORMAT "%8.3" /end CHARACTERISTIC
/begin MEASUREMENT vel_ang_pste_cor "Filtered steering-wheel-angle velocity" SWORD _CNV_A_R_LINEAR_____79_CM 1 100. -1439.98976 1439.945815 DISPLAY_IDENTIFIER VEL_ANG_PSTE_COR ECU_ADDRESS 0xd00050c6 FORMAT "%8.3" /end MEASUREMENT
/begin MEASUREMENT vel_ang_pste_mmv "moving mean value of steering-wheel-angle velocity" SWORD _CNV_A_R_LINEAR_____79_CM 1 100. -1439.98976 1439.945815 DISPLAY_IDENTIFIER VEL_ANG_PSTE_MMV ECU_ADDRESS 0xc0000b54 FORMAT "%8.3" /end MEASUREMENT
/begin MEASUREMENT t_vel_ang_pste "Time for detecting \"released\" steering wheel" UBYTE _CNV_A_R_LINEAR_____3_CM 1 100. 0. 2.55 DISPLAY_IDENTIFIER T_VEL_ANG_PSTE ECU_ADDRESS 0xc0000b5c FORMAT "%4.2" /end MEASUREMENT
/begin MEASUREMENT lv_vel_ang_pste_min_det "LV indicating \"released\" steering wheel" UBYTE _CNV_S_2_RANGE__0___1_CM 1 100. 0. 1. DISPLAY_IDENTIFIER LV_VEL_ANG_PSTE_MIN_DET ECU_ADDRESS 0xc0000b5d BIT_MASK 0x1 /end MEASUREMENT
/begin MEASUREMENT lv_stg_ri_act "LV indicating steering active(direction:1  = right , 0 = left)" UBYTE _CNV_S_2_RANGE__0___1_CM 1 100. 0. 1. DISPLAY_IDENTIFIER LV_STG_RI_ACT ECU_ADDRESS 0xc0000b5e BIT_MASK 0x1 /end MEASUREMENT
/begin CHARACTERISTIC c_crlc_vel_ang_pste "Correlation constant for steering wheel angle velocity" VALUE 0xa1029244 _REC_VAL_20_u1 0.99609375 _CNV_A_R_LINEAR_____71_CM 0. 0.99609375 DISPLAY_IDENTIFIER C_CRLC_VEL_ANG_PSTE FORMAT "%5.3" /end CHARACTERISTIC
/begin CHARACTERISTIC c_vel_ang_pste_min_1 "minimum threshold VEL_ANG_PSTE_MMV for detection of steering active" VALUE 0xa1029bec _REC_VAL_20_s2 2879.935575 _CNV_A_R_LINEAR_____79_CM -1439.98976 1439.945815 DISPLAY_IDENTIFIER C_VEL_ANG_PSTE_MIN_1 FORMAT "%8.3" /end CHARACTERISTIC
/begin CHARACTERISTIC c_vel_ang_pste_min_2 "minimum threshold VEL_ANG_PSTE_MMV for detection of \"released\" steering wheel" VALUE 0xa1029bee _REC_VAL_20_s2 2879.935575 _CNV_A_R_LINEAR_____79_CM -1439.98976 1439.945815 DISPLAY_IDENTIFIER C_VEL_ANG_PSTE_MIN_2 FORMAT "%8.3" /end CHARACTERISTIC
/begin CHARACTERISTIC c_t_vel_ang_pste "Time for detecting \"released steering wheel" VALUE 0xa1029992 _REC_VAL_20_u1 2.55 _CNV_A_R_LINEAR_____3_CM 0. 2.55 DISPLAY_IDENTIFIER C_T_VEL_ANG_PSTE FORMAT "%4.2" /end CHARACTERISTIC
/begin CHARACTERISTIC lc_vel_ang_pste_cor "calculation of VEL_ANG_PSTE_COR depending on steering wheel state" VALUE 0xa1029e16 _REC_VAL_20_u1 1. _CNV_A_R_LINEAR_____0_CM 0. 1. DISPLAY_IDENTIFIER LC_VEL_ANG_PSTE_COR FORMAT "%1.0" /end CHARACTERISTIC
/begin CHARACTERISTIC c_vs_pste "vehicle speed threshold for power steering" VALUE 0xa1029ccd _REC_VAL_20_u1 255. _CNV_A_R_LINEAR_____6_CM 0. 255. DISPLAY_IDENTIFIER C_VS_PSTE FORMAT "%3.0" /end CHARACTERISTIC
/begin CHARACTERISTIC c_vel_ang_pste_max_ad "VEL_ANG_PSTE-threshold for adaptation of steering wheel angle" VALUE 0xa1029bea _REC_VAL_20_s2 2879.935575 _CNV_A_R_LINEAR_____79_CM -1439.98976 1439.945815 DISPLAY_IDENTIFIER C_VEL_ANG_PSTE_MAX_AD FORMAT "%8.3" /end CHARACTERISTIC
/begin CHARACTERISTIC c_ang_pste_ad_lgrd "" VALUE 0xa10291a0 _REC_VAL_20_u2 1439.945815 _CNV_A_R_LINEAR_____80_CM 0. 1439.945815 DISPLAY_IDENTIFIER C_ANG_PSTE_AD_LGRD FORMAT "%8.2" /end CHARACTERISTIC
/begin CHARACTERISTIC c_t_ang_pste_ad "Time during which adaptation of steering wheel angle is inhibited" VALUE 0xa10297f6 _REC_VAL_20_u2 655.35 _CNV_A_R_LINEAR_____3_CM 0. 655.35 DISPLAY_IDENTIFIER C_T_ANG_PSTE_AD FORMAT "%6.2" /end CHARACTERISTIC
/begin MEASUREMENT tq_add_pl_drof "TQ reserve for drive off support" UWORD _CNV_A_R_LINEAR_____30_CM 1 100. 0. 1023.96875 DISPLAY_IDENTIFIER TQ_ADD_PL_DROF ECU_ADDRESS 0xd00050b8 FORMAT "%7.2" /end MEASUREMENT
/begin MEASUREMENT n_dif_pred_pl_drof "Predicted idle speed control variable at drive-off-support" SWORD _CNV_A_R_LINEAR_____13_CM 1 100. -32768. 32767. DISPLAY_IDENTIFIER N_DIF_PRED_PL_DROF ECU_ADDRESS 0xc000058c FORMAT "%6.0" /end MEASUREMENT
/begin MEASUREMENT lv_fast_load_im "Fast Manifold Filling enabled" UBYTE _CNV_S_2_RANGE__0___1_CM 1 100. 0. 1. DISPLAY_IDENTIFIER LV_FAST_LOAD_IM ECU_ADDRESS 0xd0003cad BIT_MASK 0x1 /end MEASUREMENT
/begin CHARACTERISTIC ip_t_n_dif_ofs_pred_drof "Time constant for calculation of predicted engine speed deviation at drive-off-support (PL)" CURVE 0xa1027d80 _REC_CUR_20_u1_u2 7.96875 _CNV_A_R_LINEAR_____183_CM 0. 7.96875 DISPLAY_IDENTIFIER IP_T_N_DIF_OFS_PRED_DROF FORMAT "%4.2"
 /begin AXIS_DESCR COM_AXIS n _CNV_A_R_LINEAR_____13_CM 8 0. 8160. FORMAT "%4.0" AXIS_PTS_REF ldpm_n_t_n_dif_ofs_pred /end AXIS_DESCR
/end CHARACTERISTIC
/begin AXIS_PTS ldpm_n_t_n_dif_ofs_pred "" 0xa10220f4 n _REC_AXS_20_u2 8160. _CNV_A_R_LINEAR_____13_CM 8 0. 8160. FORMAT "%4.0" /end AXIS_PTS
/begin CHARACTERISTIC c_gear_max_fast_load_im "Highest gear for Fast Manifold Filling" VALUE 0xa1029490 _REC_VAL_20_u1 255. _CNV_A_R_LINEAR_____0_CM 0. 255. DISPLAY_IDENTIFIER C_GEAR_MAX_FAST_LOAD_IM FORMAT "%3.0" /end CHARACTERISTIC
/begin CHARACTERISTIC c_vs_max_fast_load_im "Highest vehicle speed  for Fast Manifold Filling" VALUE 0xa1029cac _REC_VAL_20_u1 255. _CNV_A_R_LINEAR_____6_CM 0. 255. DISPLAY_IDENTIFIER C_VS_MAX_FAST_LOAD_IM FORMAT "%3.0" /end CHARACTERISTIC
/begin CHARACTERISTIC c_n_max_fast_load_im "Highest engine speed  for Fast Manifold Filling" VALUE 0xa1029622 _REC_VAL_20_u2 8160. _CNV_A_R_LINEAR_____13_CM 0. 8160. DISPLAY_IDENTIFIER C_N_MAX_FAST_LOAD_IM FORMAT "%4.0" /end CHARACTERISTIC
/begin CHARACTERISTIC c_t_ast_min_fast_load_im "Minimum time after start before enabling Fast Manifold Filling" VALUE 0xa1029812 _REC_VAL_20_u2 6553.5 _CNV_A_R_LINEAR_____4_CM 0. 6553.5 DISPLAY_IDENTIFIER C_T_AST_MIN_FAST_LOAD_IM FORMAT "%6.1" /end CHARACTERISTIC
/begin CHARACTERISTIC lc_fast_load_im_is "0: Fast Manifold Filling possible only during 'idle'" VALUE 0xa1029d3a _REC_VAL_20_u1 1. _CNV_A_R_LINEAR_____0_CM 0. 1. DISPLAY_IDENTIFIER LC_FAST_LOAD_IM_IS FORMAT "%2.0" /end CHARACTERISTIC
/begin CHARACTERISTIC lc_ena_fast_load_im_n_sp "1: Fast Manifold Filling can be requested by LV_N_SP_IS_CS = 1" VALUE 0xa1029d28 _REC_VAL_20_u1 1. _CNV_A_R_LINEAR_____0_CM 0. 1. DISPLAY_IDENTIFIER LC_ENA_FAST_LOAD_IM_N_SP FORMAT "%2.0" /end CHARACTERISTIC
/begin AXIS_PTS ldp_vs_fil_ip_fac_vs_tq_add_pl "" 0xa10218a4 vs_fil _REC_AXS_20_u2 511.99218 _CNV_A_R_LINEAR_____66_CM 4 0. 511.99218 FORMAT "%7.3" /end AXIS_PTS
/begin CHARACTERISTIC ip_fac_vs_tq_add_pl_drof "Vehicle speed correction for IP_TQ_ADD_PL_DROF" CURVE 0xa10249d4 _REC_CUR_20_u2_u2 1.99996948242188 _CNV_A_R_LINEAR_____8_CM 0. 1.99996948242188 DISPLAY_IDENTIFIER IP_FAC_VS_TQ_ADD_PL_DROF FORMAT "%9.8"
 /begin AXIS_DESCR COM_AXIS vs_fil _CNV_A_R_LINEAR_____66_CM 4 0. 511.99218 FORMAT "%7.3" AXIS_PTS_REF ldp_vs_fil_ip_fac_vs_tq_add_pl /end AXIS_DESCR
/end CHARACTERISTIC
/begin AXIS_PTS ldp_tq_av_ip_fac_n_grd "" 0xa10214f0 tq_av _REC_AXS_20_u2 2047.96875 _CNV_A_R_LINEAR_____65_CM 4 -1024. 1023.96875 FORMAT "%6.2" /end AXIS_PTS
/begin CHARACTERISTIC ip_fac_n_grd_tq_av "Weighing of additive part of N_DIF_DROF dependent from actual torque" CURVE 0xa1023b60 _REC_CUR_20_u2_u2 1.99996948242188 _CNV_A_R_LINEAR_____8_CM 0. 1.99996948242188 DISPLAY_IDENTIFIER IP_FAC_N_GRD_TQ_AV FORMAT "%9.8"
 /begin AXIS_DESCR COM_AXIS tq_av _CNV_A_R_LINEAR_____65_CM 4 -1024. 1023.96875 FORMAT "%6.2" AXIS_PTS_REF ldp_tq_av_ip_fac_n_grd /end AXIS_DESCR
/end CHARACTERISTIC
/begin AXIS_PTS ldp_fac_tq_req_ip_fac_tq_drof "" 0xa10209dc fac_tq_req _REC_AXS_20_u2 1.99996948242188 _CNV_A_R_LINEAR_____8_CM 6 0. 1.99996948242188 FORMAT "%9.8" /end AXIS_PTS
/begin CHARACTERISTIC ip_fac_tq_drof_fac_tq_req "Weighing of IP_TQ_DROF dependent from FAC_TQ_REQ" CURVE 0xa1024540 _REC_CUR_20_u2_u2 1.99996948242188 _CNV_A_R_LINEAR_____8_CM 0. 1.99996948242188 DISPLAY_IDENTIFIER IP_FAC_TQ_DROF_FAC_TQ_REQ FORMAT "%9.8"
 /begin AXIS_DESCR COM_AXIS fac_tq_req _CNV_A_R_LINEAR_____8_CM 6 0. 1.99996948242188 FORMAT "%9.8" AXIS_PTS_REF ldp_fac_tq_req_ip_fac_tq_drof /end AXIS_DESCR
/end CHARACTERISTIC
/begin CHARACTERISTIC c_n_dif_drof_min "Minimum N_DIF_DROF for functionTQ_DROF" VALUE 0xa10295e2 _REC_VAL_20_s2 65535. _CNV_A_R_LINEAR_____13_CM -32768. 32767. DISPLAY_IDENTIFIER C_N_DIF_DROF_MIN FORMAT "%6.0" /end CHARACTERISTIC
/begin CHARACTERISTIC c_n_dif_drof_max "Maximum N_DIF_DROF for functionTQ_DROF" VALUE 0xa10295e0 _REC_VAL_20_s2 65535. _CNV_A_R_LINEAR_____13_CM -32768. 32767. DISPLAY_IDENTIFIER C_N_DIF_DROF_MAX FORMAT "%6.0" /end CHARACTERISTIC
/begin CHARACTERISTIC lc_tq_drof_isc_off "Boolean to enable/disable idle speed controller during drive-off; 1 = disabled" VALUE 0xa1029dfa _REC_VAL_20_u1 1. _CNV_A_R_LINEAR_____0_CM 0. 1. DISPLAY_IDENTIFIER LC_TQ_DROF_ISC_OFF FORMAT "%2.0" /end CHARACTERISTIC
/begin MEASUREMENT tq_drof_slow "TQ request for drive-off assistance" SWORD _CNV_A_R_LINEAR_____30_CM 1 100. -1024. 1023.96875 DISPLAY_IDENTIFIER TQ_DROF_SLOW ECU_ADDRESS 0xd00050bc FORMAT "%8.2" /end MEASUREMENT
/begin MEASUREMENT n_dif_drof "Engine speed difference effective for TQ_DROF" SWORD _CNV_A_R_LINEAR_____13_CM 1 100. -32768. 32767. DISPLAY_IDENTIFIER N_DIF_DROF ECU_ADDRESS 0xc000058e FORMAT "%6.0" /end MEASUREMENT
/begin MEASUREMENT lv_isc_off_drof "Boolean to enable/disable idle speed controller during drive-off; 1=disabled" UBYTE _CNV_S_2_RANGE__0___1_CM 1 100. 0. 1. DISPLAY_IDENTIFIER LV_ISC_OFF_DROF ECU_ADDRESS 0xd0003cac BIT_MASK 0x1 /end MEASUREMENT
/begin MEASUREMENT tq_drof_fast "TQ request for drive-off assistance" SWORD _CNV_A_R_LINEAR_____30_CM 1 100. -1024. 1023.96875 DISPLAY_IDENTIFIER TQ_DROF_FAST ECU_ADDRESS 0xd00050ba FORMAT "%8.2" /end MEASUREMENT
/begin AXIS_PTS ldp_n_dif_drof__id_tq_drof "" 0xa1020ee4 n_dif_drof _REC_AXS_20_u2 65535. _CNV_A_R_LINEAR_____172_CM 3 -32768. 32767. FORMAT "%6.0" /end AXIS_PTS
/begin AXIS_PTS ldp_n_grd__id_tq_drof "" 0xa1020f06 n_grd _REC_AXS_20_u1 8160. _CNV_A_R_LINEAR_____28_CM 3 -4096. 4064. FORMAT "%5.0" /end AXIS_PTS
/begin CHARACTERISTIC id_tq_drof_ena "Enable conditions" MAP 0xa1022fd4 _REC_MAP_20_u1_u2_u1 1. _CNV_A_R_LINEAR_____0_CM 0. 1. DISPLAY_IDENTIFIER ID_TQ_DROF_ENA FORMAT "%1.0"
 /begin AXIS_DESCR COM_AXIS n_dif_drof _CNV_A_R_LINEAR_____172_CM 3 -32768. 32767. FORMAT "%6.0" AXIS_PTS_REF ldp_n_dif_drof__id_tq_drof /end AXIS_DESCR
 /begin AXIS_DESCR COM_AXIS n_grd _CNV_A_R_LINEAR_____28_CM 3 -4096. 4064. FORMAT "%5.0" AXIS_PTS_REF ldp_n_grd__id_tq_drof /end AXIS_DESCR
/end CHARACTERISTIC
/begin CHARACTERISTIC c_tq_drof_min "threshold TQ_DRF fast load" VALUE 0xa1029af8 _REC_VAL_20_s2 2047.96875 _CNV_A_R_LINEAR_____30_CM -1024. 1023.96875 DISPLAY_IDENTIFIER C_TQ_DROF_MIN FORMAT "%8.2" /end CHARACTERISTIC
/begin AXIS_PTS ldp_gear__var_amt_load_im "" 0xa1020af0 gear _REC_AXS_20_u1 255. _CNV_A_R_LINEAR_____0_CM 8 0. 255. FORMAT "%3.0" /end AXIS_PTS
/begin CHARACTERISTIC id_var_amt_load_im "enabled gears at LV_VAR_AMT" CURVE 0xa1023018 _REC_CUR_20_u1_u1 1. _CNV_S_2_RANGE______75_CM 0. 1. DISPLAY_IDENTIFIER ID_VAR_AMT_LOAD_IM
 /begin AXIS_DESCR COM_AXIS gear _CNV_A_R_LINEAR_____0_CM 8 0. 255. FORMAT "%3.0" AXIS_PTS_REF ldp_gear__var_amt_load_im /end AXIS_DESCR
/end CHARACTERISTIC
/begin MEASUREMENT lv_tq_drof_is_ad_inh "Flag for inhibition of IS-control adaptations" UBYTE _CNV_S_2_RANGE__0___1_CM 1 100. 0. 1. DISPLAY_IDENTIFIER LV_TQ_DROF_IS_AD_INH ECU_ADDRESS 0xd0003cae BIT_MASK 0x1 /end MEASUREMENT
/begin CHARACTERISTIC c_tq_drof_ad "threshold TQ_DROF for inhibition of IS-control adaptations" VALUE 0xa1029af6 _REC_VAL_20_s2 2047.96875 _CNV_A_R_LINEAR_____30_CM -1024. 1023.96875 DISPLAY_IDENTIFIER C_TQ_DROF_AD FORMAT "%8.2" /end CHARACTERISTIC
/begin CHARACTERISTIC c_t_tq_drof_dly_ad "timer TQ_DROF for inhibition of IS-control adaptations" VALUE 0xa1029987 _REC_VAL_20_u1 2.55 _CNV_A_R_LINEAR_____3_CM 0. 2.55 DISPLAY_IDENTIFIER C_T_TQ_DROF_DLY_AD FORMAT "%4.2" /end CHARACTERISTIC
/begin AXIS_PTS ldp_n_dif_pred_fac_tq_add_is_1 "" 0xa1020eec n_dif_pred_pl_drof _REC_AXS_20_u2 65535. _CNV_A_R_LINEAR_____172_CM 6 -32768. 32767. FORMAT "%6.0" /end AXIS_PTS
/begin AXIS_PTS ldp_n_dif_pred_fac_tq_add_is_2 "" 0xa1020efc n_dif_pred_pl_drof _REC_AXS_20_u2 65535. _CNV_A_R_LINEAR_____172_CM 4 -32768. 32767. FORMAT "%6.0" /end AXIS_PTS
/begin AXIS_PTS ldp_fac_tq_req_drof_1 "" 0xa10209c0 fac_tq_req _REC_AXS_20_u2 1.99996948242188 _CNV_A_R_LINEAR_____8_CM 6 0. 1.99996948242188 FORMAT "%7.5" /end AXIS_PTS
/begin AXIS_PTS ldp_fac_tq_req_drof_2 "" 0xa10209d0 fac_tq_req _REC_AXS_20_u2 1.99996948242188 _CNV_A_R_LINEAR_____8_CM 4 0. 1.99996948242188 FORMAT "%7.5" /end AXIS_PTS
/begin CHARACTERISTIC ip_tq_add_pl_drof_opm_1 "Torque reserve at part load for drive off support in operation mode 1" MAP 0xa1028370 _REC_MAP_20_u2_u2_u2 1023.96875 _CNV_A_R_LINEAR_____30_CM 0. 1023.96875 DISPLAY_IDENTIFIER IP_TQ_ADD_PL_DROF_OPM_1 FORMAT "%7.2"
 /begin AXIS_DESCR COM_AXIS n_dif_pred_pl_drof _CNV_A_R_LINEAR_____172_CM 6 -32768. 32767. FORMAT "%6.0" AXIS_PTS_REF ldp_n_dif_pred_fac_tq_add_is_1 /end AXIS_DESCR
 /begin AXIS_DESCR COM_AXIS fac_tq_req _CNV_A_R_LINEAR_____8_CM 6 0. 1.99996948242188 FORMAT "%7.5" AXIS_PTS_REF ldp_fac_tq_req_drof_1 /end AXIS_DESCR
/end CHARACTERISTIC
/begin CHARACTERISTIC ip_tq_add_pl_drof_opm_2 "Torque reserve at part load for drive off support in operation mode 2" MAP 0xa10283b8 _REC_MAP_20_u2_u2_u2 1023.96875 _CNV_A_R_LINEAR_____30_CM 0. 1023.96875 DISPLAY_IDENTIFIER IP_TQ_ADD_PL_DROF_OPM_2 FORMAT "%7.2"
 /begin AXIS_DESCR COM_AXIS n_dif_pred_pl_drof _CNV_A_R_LINEAR_____172_CM 4 -32768. 32767. FORMAT "%6.0" AXIS_PTS_REF ldp_n_dif_pred_fac_tq_add_is_2 /end AXIS_DESCR
 /begin AXIS_DESCR COM_AXIS fac_tq_req _CNV_A_R_LINEAR_____8_CM 4 0. 1.99996948242188 FORMAT "%7.5" AXIS_PTS_REF ldp_fac_tq_req_drof_2 /end AXIS_DESCR
/end CHARACTERISTIC
/begin AXIS_PTS ldp_tia_ip_fac_temp_tq_add_1 "" 0xa102137e tia _REC_AXS_20_u1 190.5 _CNV_A_R_LINEAR_____16_CM 6 -48. 142.5 FORMAT "%5.1" /end AXIS_PTS
/begin AXIS_PTS ldp_toil_ip_fac_temp_tq_add_1 "" 0xa1021402 toil _REC_AXS_20_u1 200. _CNV_A_R_LINEAR_____25_CM 6 -40. 160. FORMAT "%3.0" /end AXIS_PTS
/begin AXIS_PTS ldp_toil_ip_fac_temp_tq_add_2 "" 0xa102140a toil _REC_AXS_20_u1 200. _CNV_A_R_LINEAR_____25_CM 4 -40. 160. FORMAT "%3.0" /end AXIS_PTS
/begin CHARACTERISTIC ip_fac_temp_tq_add_drof_opm_1 "Temperature correction  for IP_TQ_ADD_PL_DROF in operation mode 1" MAP 0xa102405c _REC_MAP_20_u2_u1_u1 1.99996948242188 _CNV_A_R_LINEAR_____8_CM 0. 1.99996948242188 DISPLAY_IDENTIFIER IP_FAC_TEMP_TQ_ADD_DROF_OPM_1 FORMAT "%9.8"
 /begin AXIS_DESCR COM_AXIS tia _CNV_A_R_LINEAR_____16_CM 6 -48. 142.5 FORMAT "%5.1" AXIS_PTS_REF ldp_tia_ip_fac_temp_tq_add_1 /end AXIS_DESCR
 /begin AXIS_DESCR COM_AXIS toil _CNV_A_R_LINEAR_____25_CM 6 -40. 160. FORMAT "%3.0" AXIS_PTS_REF ldp_toil_ip_fac_temp_tq_add_1 /end AXIS_DESCR
/end CHARACTERISTIC
/begin CHARACTERISTIC ip_fac_temp_tq_add_drof_opm_2 "Temperature correction  for IP_TQ_ADD_PL_DROF in operation mode 2" CURVE 0xa10240a4 _REC_CUR_20_u2_u1 1.99996948242188 _CNV_A_R_LINEAR_____8_CM 0. 1.99996948242188 DISPLAY_IDENTIFIER IP_FAC_TEMP_TQ_ADD_DROF_OPM_2 FORMAT "%9.8"
 /begin AXIS_DESCR COM_AXIS toil _CNV_A_R_LINEAR_____25_CM 4 -40. 160. FORMAT "%3.0" AXIS_PTS_REF ldp_toil_ip_fac_temp_tq_add_2 /end AXIS_DESCR
/end CHARACTERISTIC
/begin AXIS_PTS ldp_n_grd_ip_n_dif_add_drof_1 "" 0xa1020f0a n_grd _REC_AXS_20_u1 8160. _CNV_A_R_LINEAR_____28_CM 4 -4096. 4064. FORMAT "%5.0" /end AXIS_PTS
/begin AXIS_PTS ldp_n_grd_ip_n_dif_add_drof_2 "" 0xa1020f10 n_grd _REC_AXS_20_u1 8160. _CNV_A_R_LINEAR_____28_CM 4 -4096. 4064. FORMAT "%5.0" /end AXIS_PTS
/begin AXIS_PTS ldp_n_sp_is_ip_n_dif_add_drof_1 "" 0xa1020ff4 n_sp_is _REC_AXS_20_u2 8160. _CNV_A_R_LINEAR_____13_CM 4 0. 8160. FORMAT "%4.0" /end AXIS_PTS
/begin AXIS_PTS ldp_n_sp_is_ip_n_dif_add_drof_2 "" 0xa1021000 n_sp_is _REC_AXS_20_u2 8160. _CNV_A_R_LINEAR_____13_CM 3 0. 8160. FORMAT "%4.0" /end AXIS_PTS
/begin CHARACTERISTIC ip_n_dif_add_drof_opm_1 "Additive part of N_DIF_DROF dependant from engine speed gradient in operation mode 1" MAP 0xa10262f4 _REC_MAP_20_u2_u1_u2 65535. _CNV_A_R_LINEAR_____172_CM -32768. 32767. DISPLAY_IDENTIFIER IP_N_DIF_ADD_DROF_OPM_1 FORMAT "%6.0"
 /begin AXIS_DESCR COM_AXIS n_grd _CNV_A_R_LINEAR_____28_CM 4 -4096. 4064. FORMAT "%5.0" AXIS_PTS_REF ldp_n_grd_ip_n_dif_add_drof_1 /end AXIS_DESCR
 /begin AXIS_DESCR COM_AXIS n_sp_is _CNV_A_R_LINEAR_____13_CM 4 0. 8160. FORMAT "%4.0" AXIS_PTS_REF ldp_n_sp_is_ip_n_dif_add_drof_1 /end AXIS_DESCR
/end CHARACTERISTIC
/begin CHARACTERISTIC ip_n_dif_add_drof_opm_2 "Additive part of N_DIF_DROF dependant from engine speed gradient in operation mode 2" MAP 0xa1026314 _REC_MAP_20_u2_u1_u2 65535. _CNV_A_R_LINEAR_____172_CM -32768. 32767. DISPLAY_IDENTIFIER IP_N_DIF_ADD_DROF_OPM_2 FORMAT "%6.0"
 /begin AXIS_DESCR COM_AXIS n_grd _CNV_A_R_LINEAR_____28_CM 4 -4096. 4064. FORMAT "%5.0" AXIS_PTS_REF ldp_n_grd_ip_n_dif_add_drof_2 /end AXIS_DESCR
 /begin AXIS_DESCR COM_AXIS n_sp_is _CNV_A_R_LINEAR_____13_CM 3 0. 8160. FORMAT "%4.0" AXIS_PTS_REF ldp_n_sp_is_ip_n_dif_add_drof_2 /end AXIS_DESCR
/end CHARACTERISTIC
/begin CHARACTERISTIC id_idx_opm_drof "Switch map to choose DROF calculation path (OPM_1 or OPM_2) depending on OPM_AV" CURVE 0xa10229b4 _REC_CUR_20_u1_u1 1. _CNV_A_R_LINEAR_____0_CM 0. 1. DISPLAY_IDENTIFIER ID_IDX_OPM_DROF FORMAT "%1.0"
 /begin AXIS_DESCR COM_AXIS opm_av _CNV_A_R_LINEAR_____0_CM 8 0. 8. FORMAT "%1.0" AXIS_PTS_REF ldpm_opm_av /end AXIS_DESCR
/end CHARACTERISTIC
/begin AXIS_PTS ldpm_n_dif_drof_ip_tq_drof_1 "" 0xa1021f98 n_dif_drof _REC_AXS_20_u2 65535. _CNV_A_R_LINEAR_____172_CM 11 -32768. 32767. FORMAT "%6.0" /end AXIS_PTS
/begin AXIS_PTS ldpm_n_dif_drof_ip_tq_drof_2 "" 0xa1021fb0 n_dif_drof _REC_AXS_20_u2 65535. _CNV_A_R_LINEAR_____172_CM 6 -32768. 32767. FORMAT "%6.0" /end AXIS_PTS
/begin AXIS_PTS ldpm_n_grd_ip_tq_drof_1 "" 0xa1022024 n_grd _REC_AXS_20_u1 8160. _CNV_A_R_LINEAR_____28_CM 10 -4096. 4064. FORMAT "%5.0" /end AXIS_PTS
/begin AXIS_PTS ldpm_n_grd_ip_tq_drof_2 "" 0xa1022030 n_grd _REC_AXS_20_u1 8160. _CNV_A_R_LINEAR_____28_CM 6 -4096. 4064. FORMAT "%5.0" /end AXIS_PTS
/begin CHARACTERISTIC ip_tq_drof_slow_opm_1 "Torque for driving off assistance, basic value in operation mode 1" MAP 0xa102869c _REC_MAP_20_u2_u2_u1 2047.96875 _CNV_A_R_LINEAR_____65_CM -1024. 1023.96875 DISPLAY_IDENTIFIER IP_TQ_DROF_SLOW_OPM_1 FORMAT "%6.2"
 /begin AXIS_DESCR COM_AXIS n_dif_drof _CNV_A_R_LINEAR_____172_CM 11 -32768. 32767. FORMAT "%6.0" AXIS_PTS_REF ldpm_n_dif_drof_ip_tq_drof_1 /end AXIS_DESCR
 /begin AXIS_DESCR COM_AXIS n_grd _CNV_A_R_LINEAR_____28_CM 10 -4096. 4064. FORMAT "%5.0" AXIS_PTS_REF ldpm_n_grd_ip_tq_drof_1 /end AXIS_DESCR
/end CHARACTERISTIC
/begin CHARACTERISTIC ip_tq_drof_slow_opm_2 "Torque for driving off assistance, basic value in operation mode 2" MAP 0xa1028778 _REC_MAP_20_u2_u2_u1 2047.96875 _CNV_A_R_LINEAR_____65_CM -1024. 1023.96875 DISPLAY_IDENTIFIER IP_TQ_DROF_SLOW_OPM_2 FORMAT "%6.2"
 /begin AXIS_DESCR COM_AXIS n_dif_drof _CNV_A_R_LINEAR_____172_CM 6 -32768. 32767. FORMAT "%6.0" AXIS_PTS_REF ldpm_n_dif_drof_ip_tq_drof_2 /end AXIS_DESCR
 /begin AXIS_DESCR COM_AXIS n_grd _CNV_A_R_LINEAR_____28_CM 6 -4096. 4064. FORMAT "%5.0" AXIS_PTS_REF ldpm_n_grd_ip_tq_drof_2 /end AXIS_DESCR
/end CHARACTERISTIC
/begin CHARACTERISTIC ip_tq_drof_fast_opm_1 "Torque for driving off assistance, basic value in operation mode 1" MAP 0xa1028560 _REC_MAP_20_u2_u2_u1 2047.96875 _CNV_A_R_LINEAR_____65_CM -1024. 1023.96875 DISPLAY_IDENTIFIER IP_TQ_DROF_FAST_OPM_1 FORMAT "%6.2"
 /begin AXIS_DESCR COM_AXIS n_dif_drof _CNV_A_R_LINEAR_____172_CM 11 -32768. 32767. FORMAT "%6.0" AXIS_PTS_REF ldpm_n_dif_drof_ip_tq_drof_1 /end AXIS_DESCR
 /begin AXIS_DESCR COM_AXIS n_grd _CNV_A_R_LINEAR_____28_CM 10 -4096. 4064. FORMAT "%5.0" AXIS_PTS_REF ldpm_n_grd_ip_tq_drof_1 /end AXIS_DESCR
/end CHARACTERISTIC
/begin CHARACTERISTIC ip_tq_drof_fast_opm_2 "Torque for driving off assistance, basic value in operation mode 2" MAP 0xa102863c _REC_MAP_20_u2_u2_u1 2047.96875 _CNV_A_R_LINEAR_____65_CM -1024. 1023.96875 DISPLAY_IDENTIFIER IP_TQ_DROF_FAST_OPM_2 FORMAT "%6.2"
 /begin AXIS_DESCR COM_AXIS n_dif_drof _CNV_A_R_LINEAR_____172_CM 6 -32768. 32767. FORMAT "%6.0" AXIS_PTS_REF ldpm_n_dif_drof_ip_tq_drof_2 /end AXIS_DESCR
 /begin AXIS_DESCR COM_AXIS n_grd _CNV_A_R_LINEAR_____28_CM 6 -4096. 4064. FORMAT "%5.0" AXIS_PTS_REF ldpm_n_grd_ip_tq_drof_2 /end AXIS_DESCR
/end CHARACTERISTIC
/begin AXIS_PTS ldp_vs_fil_ip_fac_tq_drof_vs_1 "" 0xa1021884 vs_fil _REC_AXS_20_u2 511.99218 _CNV_A_R_LINEAR_____66_CM 6 0. 511.99218 FORMAT "%7.3" /end AXIS_PTS
/begin AXIS_PTS ldp_vs_fil_ip_fac_tq_drof_vs_2 "" 0xa1021894 vs_fil _REC_AXS_20_u2 511.99218 _CNV_A_R_LINEAR_____66_CM 6 0. 511.99218 FORMAT "%7.3" /end AXIS_PTS
/begin AXIS_PTS ldp_n_ip_fac_tq_drof_vs_1 "" 0xa1020f70 n _REC_AXS_20_u2 8160. _CNV_A_R_LINEAR_____13_CM 6 0. 8160. FORMAT "%4.0" /end AXIS_PTS
/begin CHARACTERISTIC ip_fac_tq_drof_vs_opm_1 "Weighing of IP_TQ_DROF dependant from engine and vehicle speed in operation mode 1" MAP 0xa102454c _REC_MAP_20_u2_u2_u2 1.99996948242188 _CNV_A_R_LINEAR_____8_CM 0. 1.99996948242188 DISPLAY_IDENTIFIER IP_FAC_TQ_DROF_VS_OPM_1 FORMAT "%9.8"
 /begin AXIS_DESCR COM_AXIS vs_fil _CNV_A_R_LINEAR_____66_CM 6 0. 511.99218 FORMAT "%7.3" AXIS_PTS_REF ldp_vs_fil_ip_fac_tq_drof_vs_1 /end AXIS_DESCR
 /begin AXIS_DESCR COM_AXIS n _CNV_A_R_LINEAR_____13_CM 6 0. 8160. FORMAT "%4.0" AXIS_PTS_REF ldp_n_ip_fac_tq_drof_vs_1 /end AXIS_DESCR
/end CHARACTERISTIC
/begin CHARACTERISTIC ip_fac_tq_drof_vs_opm_2 "Weighing of IP_TQ_DROF dependant from engine and vehicle speed in operation mode 2" CURVE 0xa1024594 _REC_CUR_20_u2_u2 1.99996948242188 _CNV_A_R_LINEAR_____8_CM 0. 1.99996948242188 DISPLAY_IDENTIFIER IP_FAC_TQ_DROF_VS_OPM_2 FORMAT "%9.8"
 /begin AXIS_DESCR COM_AXIS vs_fil _CNV_A_R_LINEAR_____66_CM 6 0. 511.99218 FORMAT "%7.3" AXIS_PTS_REF ldp_vs_fil_ip_fac_tq_drof_vs_2 /end AXIS_DESCR
/end CHARACTERISTIC
/begin AXIS_PTS ldp_tq_drof_grd_deac_1 "" 0xa1021510 tq_drof_fast _REC_AXS_20_u2 1023.96875 _CNV_A_R_LINEAR_____30_CM 6 0. 1023.96875 FORMAT "%7.2" /end AXIS_PTS
/begin AXIS_PTS ldp_tq_drof_grd_deac_2 "" 0xa1021520 tq_drof_fast _REC_AXS_20_u2 1023.96875 _CNV_A_R_LINEAR_____30_CM 6 0. 1023.96875 FORMAT "%7.2" /end AXIS_PTS
/begin CHARACTERISTIC ip_tq_drof_grd_deac_opm_1 "Decrement for the termination ramp of TQ_DROF_SLOW/_FAST in operation mode 1" CURVE 0xa1028684 _REC_CUR_20_u2_u2 1023.96875 _CNV_A_R_LINEAR_____30_CM 0. 1023.96875 DISPLAY_IDENTIFIER IP_TQ_DROF_GRD_DEAC_OPM_1 FORMAT "%7.2"
 /begin AXIS_DESCR COM_AXIS tq_drof_fast _CNV_A_R_LINEAR_____30_CM 6 0. 1023.96875 FORMAT "%7.2" AXIS_PTS_REF ldp_tq_drof_grd_deac_1 /end AXIS_DESCR
/end CHARACTERISTIC
/begin CHARACTERISTIC ip_tq_drof_grd_deac_opm_2 "Decrement for the termination ramp of TQ_DROF_SLOW/_FAST in operation mode 2" CURVE 0xa1028690 _REC_CUR_20_u2_u2 1023.96875 _CNV_A_R_LINEAR_____30_CM 0. 1023.96875 DISPLAY_IDENTIFIER IP_TQ_DROF_GRD_DEAC_OPM_2 FORMAT "%7.2"
 /begin AXIS_DESCR COM_AXIS tq_drof_fast _CNV_A_R_LINEAR_____30_CM 6 0. 1023.96875 FORMAT "%7.2" AXIS_PTS_REF ldp_tq_drof_grd_deac_2 /end AXIS_DESCR
/end CHARACTERISTIC
/begin MEASUREMENT tqi_ref "Reference indicated engine torque" SWORD _CNV_A_R_LINEAR_____30_CM 1 100. -1024. 1023.96875 DISPLAY_IDENTIFIER TQI_REF ECU_ADDRESS 0xd0004cd0 FORMAT "%8.2" /end MEASUREMENT
/begin MEASUREMENT tqi_ref_max "Maximum indicated torque from IP_TQI_REF" SWORD _CNV_A_R_LINEAR_____30_CM 1 100. -1024. 1023.96875 DISPLAY_IDENTIFIER TQI_REF_MAX ECU_ADDRESS 0xd0004cde FORMAT "%6.2" /end MEASUREMENT
/begin MEASUREMENT lv_tq_iga_ena "torque intervention for ignition released" UBYTE _CNV_S_2_RANGE__0___1_CM 1 100. 0. 1. DISPLAY_IDENTIFIER LV_TQ_IGA_ENA ECU_ADDRESS 0xd00038d6 BIT_MASK 0x1 /end MEASUREMENT
/begin MEASUREMENT tqi_av_hom "Actual indicated engine torque for homogeneous mode" SWORD _CNV_A_R_LINEAR_____30_CM 1 100. -1024. 1023.96875 DISPLAY_IDENTIFIER TQI_AV_HOM ECU_ADDRESS 0xd0004cdc FORMAT "%6.2" /end MEASUREMENT
/begin MEASUREMENT eff_lamb_av "Actual lambda efficiency" UWORD _CNV_A_R_LINEAR_____8_CM 1 100. 0. 1.99996948242188 DISPLAY_IDENTIFIER EFF_LAMB_AV ECU_ADDRESS 0xd0004cd2 FORMAT "%7.5" /end MEASUREMENT
/begin MEASUREMENT eff_lamb_bas_cor "Basic lambda efficiency" UWORD _CNV_A_R_LINEAR_____8_CM 1 100. 0. 1.99996948242188 DISPLAY_IDENTIFIER EFF_LAMB_BAS_COR ECU_ADDRESS 0xd0004cd4 FORMAT "%7.5" /end MEASUREMENT
/begin MEASUREMENT tqi_av_s "Actual indicated engine torque for stratified mode" SWORD _CNV_A_R_LINEAR_____30_CM 1 100. -1024. 1023.96875 DISPLAY_IDENTIFIER TQI_AV_S ECU_ADDRESS 0xd0004cd6 FORMAT "%6.2" /end MEASUREMENT
/begin MEASUREMENT tqi_ref_s "Indicated  reference engine torque for stratified mode" SWORD _CNV_A_R_LINEAR_____30_CM 1 100. -1024. 1023.96875 DISPLAY_IDENTIFIER TQI_REF_S ECU_ADDRESS 0xd0004cd8 FORMAT "%8.2" /end MEASUREMENT
/begin MEASUREMENT eff_lamb_sp_bas "Basic lambda setpoint efficiency" UWORD _CNV_A_R_LINEAR_____8_CM 1 100. 0. 1.99996948242188 DISPLAY_IDENTIFIER EFF_LAMB_SP_BAS ECU_ADDRESS 0xd0004cda FORMAT "%7.5" /end MEASUREMENT
/begin MEASUREMENT tq_max_clu "Max. torque at clutch" SWORD _CNV_A_R_LINEAR_____30_CM 1 100. -1024. 1023.96875 DISPLAY_IDENTIFIER TQ_MAX_CLU ECU_ADDRESS 0xd0004ce0 FORMAT "%8.2" /end MEASUREMENT
/begin MEASUREMENT fac_cam_ch "Factor for weighting FAC_EFF_IGA at Catalyst heating" UBYTE _CNV_A_R_LINEAR_____71_CM 1 100. 0. 0.99609375 DISPLAY_IDENTIFIER FAC_CAM_CH ECU_ADDRESS 0xd00038d4 FORMAT "%5.3" /end MEASUREMENT
/begin MEASUREMENT fac_eff_iga_ch "Überblendfaktor  (warm/kalt) für Spreizung und Zündhaken während Katheizen" UBYTE _CNV_A_R_LINEAR_____71_CM 1 100. 0. 0.99609375 DISPLAY_IDENTIFIER FAC_EFF_IGA_CH ECU_ADDRESS 0xd00038d5 FORMAT "%5.3" /end MEASUREMENT
/begin MEASUREMENT tqi_sp_maf "Torque setpoint at air path" SWORD _CNV_A_R_LINEAR_____30_CM 1 100. -1024. 1023.96875 DISPLAY_IDENTIFIER TQI_SP_MAF ECU_ADDRESS 0xd0004ce2 FORMAT "%8.2" /end MEASUREMENT
/begin MEASUREMENT tqi_min_s "Min Reference indicated engine torque for stratified mode" SWORD _CNV_A_R_LINEAR_____30_CM 1 100. -1024. 1023.96875 DISPLAY_IDENTIFIER TQI_MIN_S ECU_ADDRESS 0xd0004ce4 FORMAT "%8.2" /end MEASUREMENT
/begin AXIS_PTS ldpm_opm_av "" 0xa102218c opm_av _REC_AXS_20_u1 8. _CNV_A_R_LINEAR_____0_CM 8 0. 8. FORMAT "%1.0" /end AXIS_PTS
/begin MEASUREMENT teg_pcat_down_st "Exhaust gas temperature downstream of pre-catalyst at engine start " UWORD _CNV_A_R_LINEAR_____197_CM 1 100. 0. 1023.984375 DISPLAY_IDENTIFIER TEG_PCAT_DOWN_ST ECU_ADDRESS 0xd0004f84 FORMAT "%7.2" /end MEASUREMENT
/begin CHARACTERISTIC c_teg_pcat_down_st_ini "Initialisation value of TEG_PCAT_DOWN_ST_i used in case of sensor error" VALUE 0xa1029a1a _REC_VAL_20_u2 1023.984375 _CNV_A_R_LINEAR_____197_CM 0. 1023.984375 DISPLAY_IDENTIFIER C_TEG_PCAT_DOWN_ST_INI FORMAT "%7.2" /end CHARACTERISTIC
/begin AXIS_PTS ldp_maf_kgh_ip_teg_pcat_err "" 0xa1020caa maf_kgh _REC_AXS_20_u1 2040. _CNV_A_R_LINEAR_____508_CM 4 0. 2040. FORMAT "%4.0" /end AXIS_PTS
/begin CHARACTERISTIC ip_teg_pcat_down_add_err "Additional offset on the temperature model in case of sensor error" CURVE 0xa1027e38 _REC_CUR_20_u1_u1 510. _CNV_A_R_LINEAR_____537_CM 0. 510. DISPLAY_IDENTIFIER IP_TEG_PCAT_DOWN_ADD_ERR FORMAT "%5.1"
 /begin AXIS_DESCR COM_AXIS maf_kgh _CNV_A_R_LINEAR_____508_CM 4 0. 2040. FORMAT "%4.0" AXIS_PTS_REF ldp_maf_kgh_ip_teg_pcat_err /end AXIS_DESCR
/end CHARACTERISTIC
/begin MEASUREMENT teg_pcat_down_wide_rng_st "Exhaust gas temperature downstream of pre-catalyst at engine start with wide range, unit: Kelvin" UWORD _CNV_A_R_LINEAR_____538_CM 1 100. 0. 2047.96875 DISPLAY_IDENTIFIER TEG_PCAT_DOWN_WIDE_RNG_ST ECU_ADDRESS 0xd0004f86 FORMAT "%8.5" /end MEASUREMENT
/begin AXIS_PTS ldp_v_teg__teg "" 0xa10216a0 NO_INPUT_QUANTITY _REC_AXS_20_u2 4.9951171875 _CNV_A_R_LINEAR_____2_CM 16 0. 4.9951171875 FORMAT "%5.3" /end AXIS_PTS
/begin AXIS_PTS ldp_v_teg__teg_wide_rng "" 0xa10216c4 NO_INPUT_QUANTITY _REC_AXS_20_u2 4.9951171875 _CNV_A_R_LINEAR_____2_CM 8 0. 4.9951171875 FORMAT "%5.3" /end AXIS_PTS
/begin CHARACTERISTIC ip_teg__v_teg "conversion table of exhaust gas temp." CURVE 0xa1027e08 _REC_CUR_20_u2_u2 1023.984375 _CNV_A_R_LINEAR_____197_CM 0. 1023.984375 DISPLAY_IDENTIFIER IP_TEG__V_TEG FORMAT "%7.2"
 /begin AXIS_DESCR COM_AXIS NO_INPUT_QUANTITY _CNV_A_R_LINEAR_____2_CM 16 0. 4.9951171875 FORMAT "%5.3" AXIS_PTS_REF ldp_v_teg__teg /end AXIS_DESCR
/end CHARACTERISTIC
/begin CHARACTERISTIC ip_teg_wide_rng__v_teg "conversion table of exhaust gas temp. with extended range " CURVE 0xa1027e3c _REC_CUR_20_u2_u2 2047.96875 _CNV_A_R_LINEAR_____538_CM 0. 2047.96875 DISPLAY_IDENTIFIER IP_TEG_WIDE_RNG__V_TEG FORMAT "%8.5"
 /begin AXIS_DESCR COM_AXIS NO_INPUT_QUANTITY _CNV_A_R_LINEAR_____2_CM 8 0. 4.9951171875 FORMAT "%5.3" AXIS_PTS_REF ldp_v_teg__teg_wide_rng /end AXIS_DESCR
/end CHARACTERISTIC
/begin MEASUREMENT teg_pcat_down_1 "Exhaust gas temperature downstream of pre-catalyst" UWORD _CNV_A_R_LINEAR_____197_CM 1 100. 0. 1023.984375 DISPLAY_IDENTIFIER TEG_PCAT_DOWN_1 ECU_ADDRESS 0xd0004f8a FORMAT "%7.2" /end MEASUREMENT
/begin MEASUREMENT teg_pcat_down_2 "Exhaust gas temperature downstream of pre-catalyst" UWORD _CNV_A_R_LINEAR_____197_CM 1 100. 0. 1023.984375 DISPLAY_IDENTIFIER TEG_PCAT_DOWN_2 ECU_ADDRESS 0xd0004f8e FORMAT "%7.2" /end MEASUREMENT
/begin MEASUREMENT teg_pcat_down_raw_1 "Exhaust gas temp downstream of pre-catalyst, raw value i.e. not replaced by substitute value, wide range " UWORD _CNV_A_R_LINEAR_____538_CM 1 100. 0. 2047.96875 DISPLAY_IDENTIFIER TEG_PCAT_DOWN_RAW_1 ECU_ADDRESS 0xd0004f8c FORMAT "%8.5" /end MEASUREMENT
/begin MEASUREMENT teg_pcat_down_raw_2 "Exhaust gas temp downstream of pre-catalyst, raw value i.e. not replaced by substitute value, wide range " UWORD _CNV_A_R_LINEAR_____538_CM 1 100. 0. 2047.96875 DISPLAY_IDENTIFIER TEG_PCAT_DOWN_RAW_2 ECU_ADDRESS 0xd0004f90 FORMAT "%8.5" /end MEASUREMENT
/begin MEASUREMENT teg_pcat_down_wide_rng_1 "Exhaust gas temperature downstream of pre-catalyst with wide range, unit: Kelvin" UWORD _CNV_A_R_LINEAR_____538_CM 1 100. 0. 2047.96875 DISPLAY_IDENTIFIER TEG_PCAT_DOWN_WIDE_RNG_1 ECU_ADDRESS 0xd0004f88 FORMAT "%8.5" /end MEASUREMENT
/begin MEASUREMENT teg_pcat_down_wide_rng_2 "Exhaust gas temperature downstream of pre-catalyst with wide range, unit: Kelvin" UWORD _CNV_A_R_LINEAR_____538_CM 1 100. 0. 2047.96875 DISPLAY_IDENTIFIER TEG_PCAT_DOWN_WIDE_RNG_2 ECU_ADDRESS 0xd0004f92 FORMAT "%8.5" /end MEASUREMENT
/begin MEASUREMENT tfu "fuel temperature" UBYTE _CNV_A_R_LINEAR_____16_CM 1 100. -48. 142.5 DISPLAY_IDENTIFIER TFU ECU_ADDRESS 0xd00039e0 FORMAT "%6.2" /end MEASUREMENT
/begin MEASUREMENT tfu_sub_stop "Modeled fuel temperature at last engine stop" UBYTE _CNV_A_R_LINEAR_____16_CM 1 100. -48. 142.5 DISPLAY_IDENTIFIER TFU_SUB_STOP ECU_ADDRESS 0xd00039e1 FORMAT "%6.2" /end MEASUREMENT
/begin CHARACTERISTIC c_tfu_sub_stop_ini "TFU_SUB_STOP initialization value" VALUE 0xa1029a27 _REC_VAL_20_u1 190.5 _CNV_A_R_LINEAR_____16_CM -48. 142.5 DISPLAY_IDENTIFIER C_TFU_SUB_STOP_INI FORMAT "%6.2" /end CHARACTERISTIC
/begin CHARACTERISTIC ip_fac_vs_ecfpwm_ecf "Weighting factor for air speed" MAP 0xa102494c _REC_MAP_20_u1_u1_u1 1.9921875 _CNV_A_R_LINEAR_____100_CM 0. 1.9921875 DISPLAY_IDENTIFIER IP_FAC_VS_ECFPWM_ECF FORMAT "%8.6"
 /begin AXIS_DESCR COM_AXIS vs _CNV_A_R_LINEAR_____6_CM 6 0. 255. FORMAT "%3.0" AXIS_PTS_REF ldp_vs_ip_fac_vs_ecfpwm_ecf /end AXIS_DESCR
 /begin AXIS_DESCR COM_AXIS ecfpwm_ecf _CNV_A_R_LINEAR_____5_CM 6 0. 99.609375 FORMAT "%4.1" AXIS_PTS_REF ldp_ecfpwm_ecf_ip_fac /end AXIS_DESCR
/end CHARACTERISTIC
/begin AXIS_PTS ldp_vs_ip_fac_vs_ecfpwm_ecf "" 0xa10218b4 vs _REC_AXS_20_u1 255. _CNV_A_R_LINEAR_____6_CM 6 0. 255. FORMAT "%3.0" /end AXIS_PTS
/begin AXIS_PTS ldp_ecfpwm_ecf_ip_fac "" 0xa10208a6 ecfpwm_ecf _REC_AXS_20_u1 99.609375 _CNV_A_R_LINEAR_____5_CM 6 0. 99.609375 FORMAT "%4.1" /end AXIS_PTS
/begin CHARACTERISTIC ip_fac_teg_t_es_teg_dyn_stop "Weighting factor for exhaust temperature" MAP 0xa1024030 _REC_MAP_20_u1_u2_u2 1.9921875 _CNV_A_R_LINEAR_____100_CM 0. 1.9921875 DISPLAY_IDENTIFIER IP_FAC_TEG_T_ES_TEG_DYN_STOP FORMAT "%8.6"
 /begin AXIS_DESCR COM_AXIS teg_dyn_stop _CNV_A_R_LINEAR_____123_CM 6 0. 2047. FORMAT "%7.2" AXIS_PTS_REF ldp_teg_dyn_stop_ip_fac_teg /end AXIS_DESCR
 /begin AXIS_DESCR COM_AXIS t_es _CNV_A_R_LINEAR_____77_CM 6 0. 65535. FORMAT "%5.0" AXIS_PTS_REF ldp_t_es_ip_fac_teg_t_es /end AXIS_DESCR
/end CHARACTERISTIC
/begin AXIS_PTS ldp_teg_dyn_stop_ip_fac_teg "" 0xa102130c teg_dyn_stop _REC_AXS_20_u2 2047. _CNV_A_R_LINEAR_____123_CM 6 0. 2047. FORMAT "%7.2" /end AXIS_PTS
/begin AXIS_PTS ldp_t_es_ip_fac_teg_t_es "" 0xa1021200 t_es _REC_AXS_20_u2 65535. _CNV_A_R_LINEAR_____77_CM 6 0. 65535. FORMAT "%5.0" /end AXIS_PTS
/begin AXIS_PTS ldp_t_es_ip_fac_t_es "" 0xa10211ec t_es _REC_AXS_20_u2 65535. _CNV_A_R_LINEAR_____77_CM 9 0. 65535. FORMAT "%5.0" /end AXIS_PTS
/begin MEASUREMENT temp_dif_tco_tia "Temperature difference between TCO_EX and TCO or TIA and TCO" UBYTE _CNV_A_R_LINEAR_____16_CM 1 100. -48. 142.5 DISPLAY_IDENTIFIER TEMP_DIF_TCO_TIA ECU_ADDRESS 0xd00039e2 FORMAT "%6.2" /end MEASUREMENT
/begin MEASUREMENT tfu_lpf_tco "Modeled fuel temperature with low pass filter" UBYTE _CNV_A_R_LINEAR_____16_CM 1 100. -48. 142.5 DISPLAY_IDENTIFIER TFU_LPF_TCO ECU_ADDRESS 0xc0000bfd FORMAT "%6.2" /end MEASUREMENT
/begin MEASUREMENT tfu_raw "Modeled fuel temperature raw value" UBYTE _CNV_A_R_LINEAR_____16_CM 1 100. -48. 142.5 DISPLAY_IDENTIFIER TFU_RAW ECU_ADDRESS 0xc0000bfc FORMAT "%6.2" /end MEASUREMENT
/begin MEASUREMENT tfu_add_fuel_flow "Fuel temperature increase / decrease due to fuel flow" UBYTE _CNV_A_R_LINEAR_____16_CM 1 100. -48. 142.5 DISPLAY_IDENTIFIER TFU_ADD_FUEL_FLOW ECU_ADDRESS 0xc0000bfb FORMAT "%6.2" /end MEASUREMENT
/begin MEASUREMENT temp_fuel_rail_wall "Modeled rail wall temperature" UBYTE _CNV_A_R_LINEAR_____16_CM 1 100. -48. 142.5 DISPLAY_IDENTIFIER TEMP_FUEL_RAIL_WALL ECU_ADDRESS 0xc0000bfa FORMAT "%6.2" /end MEASUREMENT
/begin MEASUREMENT tfu_ofs_air "Fuel temperature offset depending on ambient conditions" UBYTE _CNV_A_R_LINEAR_____16_CM 1 100. -48. 142.5 DISPLAY_IDENTIFIER TFU_OFS_AIR ECU_ADDRESS 0xc0000bf9 FORMAT "%6.2" /end MEASUREMENT
/begin CHARACTERISTIC c_crlc_fac_temp_dif_tco_tia "Low pass filter correlation constant for difference of coolant temperature" VALUE 0xa10291f5 _REC_VAL_20_u1 0.99609375 _CNV_A_R_LINEAR_____71_CM 0. 0.99609375 DISPLAY_IDENTIFIER C_CRLC_FAC_TEMP_DIF_TCO_TIA FORMAT "%5.3" /end CHARACTERISTIC
/begin CHARACTERISTIC c_crlc_fac_vff_mff_sp_fup_ctl "Low pass filter correlation constant for the weighting factor of volume fuel flow through the injectors" VALUE 0xa10291f8 _REC_VAL_20_u1 0.99609375 _CNV_A_R_LINEAR_____71_CM 0. 0.99609375 DISPLAY_IDENTIFIER C_CRLC_FAC_VFF_MFF_SP_FUP_CTL FORMAT "%5.3" /end CHARACTERISTIC
/begin CHARACTERISTIC ip_fac_t_es "Factor for correction of  Engine off duration time" CURVE 0xa102401c _REC_CUR_20_u1_u2 1.9921875 _CNV_A_R_LINEAR_____100_CM 0. 1.9921875 DISPLAY_IDENTIFIER IP_FAC_T_ES FORMAT "%8.6"
 /begin AXIS_DESCR COM_AXIS t_es _CNV_A_R_LINEAR_____77_CM 9 0. 65535. FORMAT "%5.0" AXIS_PTS_REF ldp_t_es_ip_fac_t_es /end AXIS_DESCR
/end CHARACTERISTIC
/begin CHARACTERISTIC ip_fac_vff_mff_sp_fup_ctl "Factor for conversion of required fuel volume to cooling" CURVE 0xa1024918 _REC_CUR_20_u1_u2 1.9921875 _CNV_A_R_LINEAR_____100_CM 0. 1.9921875 DISPLAY_IDENTIFIER IP_FAC_VFF_MFF_SP_FUP_CTL FORMAT "%8.6"
 /begin AXIS_DESCR COM_AXIS vff_mff_sp_fup_ctl _CNV_A_R_LINEAR_____156_CM 9 0. 255. FORMAT "%7.3" AXIS_PTS_REF ldp_vff_mff_sp_fup_ctl /end AXIS_DESCR
/end CHARACTERISTIC
/begin AXIS_PTS ldp_vff_mff_sp_fup_ctl "" 0xa1021744 vff_mff_sp_fup_ctl _REC_AXS_20_u2 25.5 _CNV_A_R_LINEAR_____156_CM 9 0. 255. FORMAT "%7.3" /end AXIS_PTS
/begin CHARACTERISTIC ip_crlc_tfu_t_ast_vff_mff_sp "Weighting factor for correction of the fuel temperature" MAP 0xa10231c8 _REC_MAP_20_u1_u2_u2 0.99609375 _CNV_A_R_LINEAR_____71_CM 0. 0.99609375 DISPLAY_IDENTIFIER IP_CRLC_TFU_T_AST_VFF_MFF_SP FORMAT "%5.3"
 /begin AXIS_DESCR COM_AXIS t_ast _CNV_A_R_LINEAR_____4_CM 6 0. 6553.5 FORMAT "%6.1" AXIS_PTS_REF ldp_t_ast_ip_crlc_tfu_vff_mff /end AXIS_DESCR
 /begin AXIS_DESCR COM_AXIS vff_mff_sp_fup_ctl _CNV_A_R_LINEAR_____156_CM 6 0. 255. FORMAT "%7.3" AXIS_PTS_REF ldp_vff_mff_sp_fup_ctl_ip_crlc /end AXIS_DESCR
/end CHARACTERISTIC
/begin AXIS_PTS ldp_t_ast_ip_crlc_tfu_vff_mff "" 0xa10211b4 t_ast _REC_AXS_20_u2 6553.5 _CNV_A_R_LINEAR_____4_CM 6 0. 6553.5 FORMAT "%6.1" /end AXIS_PTS
/begin AXIS_PTS ldp_vff_mff_sp_fup_ctl_ip_crlc "" 0xa1021758 vff_mff_sp_fup_ctl _REC_AXS_20_u2 255. _CNV_A_R_LINEAR_____156_CM 6 0. 255. FORMAT "%7.3" /end AXIS_PTS
/begin CHARACTERISTIC ip_tco_temp_dif_tco_tia "Factor for correction of the coolant temperature" CURVE 0xa1027df0 _REC_CUR_20_u1_u1 190.5 _CNV_A_R_LINEAR_____16_CM -48. 142.5 DISPLAY_IDENTIFIER IP_TCO_TEMP_DIF_TCO_TIA FORMAT "%5.1"
 /begin AXIS_DESCR COM_AXIS temp_dif_tco_tia _CNV_A_R_LINEAR_____16_CM 6 -48. 142.5 FORMAT "%5.1" AXIS_PTS_REF ldp_temp_dif_tco_tia_ip_tco /end AXIS_DESCR
/end CHARACTERISTIC
/begin AXIS_PTS ldp_temp_dif_tco_tia_ip_tco "" 0xa102131a temp_dif_tco_tia _REC_AXS_20_u1 190.5 _CNV_A_R_LINEAR_____16_CM 6 -48. 142.5 FORMAT "%5.1" /end AXIS_PTS
/begin CHARACTERISTIC c_crlc_fac_vs_ecfpwm_ecf "Low pass filter correlation constant for the weighting factor for air speed" VALUE 0xa10291f9 _REC_VAL_20_u1 0.99609375 _CNV_A_R_LINEAR_____71_CM 0. 0.99609375 DISPLAY_IDENTIFIER C_CRLC_FAC_VS_ECFPWM_ECF FORMAT "%5.3" /end CHARACTERISTIC
/begin CHARACTERISTIC c_t_tfu_clc "Time recurrence for TFU calculation" VALUE 0xa1029978 _REC_VAL_20_u1 254. _CNV_A_R_LINEAR_____35_CM 1. 255. DISPLAY_IDENTIFIER C_T_TFU_CLC FORMAT "%3.0" /end CHARACTERISTIC
/begin CHARACTERISTIC ip_d_tiv_norm_n_mff_sp "Load-dependent temperature differential to coolant temperature" MAP 0xa1023208 _REC_MAP_20_u1_u2_u2 190.5 _CNV_A_R_LINEAR_____16_CM -48. 142.5 DISPLAY_IDENTIFIER IP_D_TIV_NORM_N_MFF_SP FORMAT "%5.1"
 /begin AXIS_DESCR COM_AXIS n _CNV_A_R_LINEAR_____13_CM 6 0. 8160. FORMAT "%4.0" AXIS_PTS_REF ldp_n_ip_d_tiv_norm_n_mff_sp /end AXIS_DESCR
 /begin AXIS_DESCR COM_AXIS mff_sp_mv _CNV_A_R_LINEAR_____108_CM 4 0. 1389. FORMAT "%7.2" AXIS_PTS_REF ldp_mff_sp_ip_d_tiv_norm_n_mff /end AXIS_DESCR
/end CHARACTERISTIC
/begin CHARACTERISTIC ip_temp_dif_n_mff_sp_iv "N and MFF_SP dependent injektor temperatur differential to coolant temperature" MAP 0xa1027e4c _REC_MAP_20_u1_u2_u2 190.5 _CNV_A_R_LINEAR_____16_CM -48. 142.5 DISPLAY_IDENTIFIER IP_TEMP_DIF_N_MFF_SP_IV FORMAT "%5.1"
 /begin AXIS_DESCR COM_AXIS n _CNV_A_R_LINEAR_____13_CM 6 0. 8160. FORMAT "%4.0" AXIS_PTS_REF ldp_n_ip_temp_dif_iv /end AXIS_DESCR
 /begin AXIS_DESCR COM_AXIS mff_sp_mv _CNV_A_R_LINEAR_____108_CM 4 0. 1389. FORMAT "%7.2" AXIS_PTS_REF ldp_mff_sp_ip_temp_dif_iv /end AXIS_DESCR
/end CHARACTERISTIC
/begin CHARACTERISTIC ip_fac_tiv_ewp_cor "Factor for correction between RPM of electrical water pump and injector temperature" CURVE 0xa10242f4 _REC_CUR_20_u1_u1 1.9921875 _CNV_A_R_LINEAR_____100_CM 0. 1.9921875 DISPLAY_IDENTIFIER IP_FAC_TIV_EWP_COR FORMAT "%8.6"
 /begin AXIS_DESCR COM_AXIS n_rel_cwp _CNV_A_R_LINEAR_____0_CM 6 0. 255. FORMAT "%3.0" AXIS_PTS_REF ldp_tiv_ewp_cor_ip_fac_tiv_ewp /end AXIS_DESCR
/end CHARACTERISTIC
/begin CHARACTERISTIC ip_fac_temp_iv_cwp_cor "Factor for correlation between RPM of cooling water pump and injector temperature" CURVE 0xa1024054 _REC_CUR_20_u1_u1 1.9921875 _CNV_A_R_LINEAR_____100_CM 0. 1.9921875 DISPLAY_IDENTIFIER IP_FAC_TEMP_IV_CWP_COR FORMAT "%8.6"
 /begin AXIS_DESCR COM_AXIS n_rel_cwp _CNV_A_R_LINEAR_____0_CM 6 0. 255. FORMAT "%3.0" AXIS_PTS_REF ldp_n_ip_fac_temp_iv_cwp_cor /end AXIS_DESCR
/end CHARACTERISTIC
/begin CHARACTERISTIC ip_fac_tiv_tco_cor "Factor for correction between TCO and injector temperature" CURVE 0xa10242fa _REC_CUR_20_u1_u1 1.9921875 _CNV_A_R_LINEAR_____100_CM 0. 1.9921875 DISPLAY_IDENTIFIER IP_FAC_TIV_TCO_COR FORMAT "%8.6"
 /begin AXIS_DESCR COM_AXIS tco _CNV_A_R_LINEAR_____16_CM 6 -48. 142.5 FORMAT "%6.2" AXIS_PTS_REF ldp_tiv_tco_cor_ip_fac_tiv_tco /end AXIS_DESCR
/end CHARACTERISTIC
/begin CHARACTERISTIC ip_fac_tco_temp_iv_cor "Correction factor for correlation between TCO and injector temperature" CURVE 0xa102402a _REC_CUR_20_u1_u1 1.9921875 _CNV_A_R_LINEAR_____100_CM 0. 1.9921875 DISPLAY_IDENTIFIER IP_FAC_TCO_TEMP_IV_COR FORMAT "%8.6"
 /begin AXIS_DESCR COM_AXIS tco _CNV_A_R_LINEAR_____16_CM 6 -48. 142.5 FORMAT "%6.2" AXIS_PTS_REF ldp_tco_ip_fac_tco_temp_iv_cor /end AXIS_DESCR
/end CHARACTERISTIC
/begin CHARACTERISTIC c_crlc_fac_temp_iv "Low pass filter correlation constant for the injection valve temperature out of coolant temperature" VALUE 0xa10291f6 _REC_VAL_20_u1 0.99609375 _CNV_A_R_LINEAR_____71_CM 0. 0.99609375 DISPLAY_IDENTIFIER C_CRLC_FAC_TEMP_IV FORMAT "%5.3" /end CHARACTERISTIC
/begin CHARACTERISTIC c_crlc_fac_tfu_iv_sub "Low pass filter correlation constant for the fuel temperature of the injektor out of coolant temperature" VALUE 0xa10291f7 _REC_VAL_20_u1 0.99609375 _CNV_A_R_LINEAR_____71_CM 0. 0.99609375 DISPLAY_IDENTIFIER C_CRLC_FAC_TFU_IV_SUB FORMAT "%5.3" /end CHARACTERISTIC
/begin MEASUREMENT temp_fuel_rail_sub "Modeled fuel rail temperature depending from tco and N" UBYTE _CNV_A_R_LINEAR_____16_CM 1 100. -48. 142.5 DISPLAY_IDENTIFIER TEMP_FUEL_RAIL_SUB ECU_ADDRESS 0xc0000bf8 FORMAT "%6.2" /end MEASUREMENT
/begin MEASUREMENT tfu_iv_sub "Modeled injektor fuel temperature depending from TCO, N, MFF_SP, and EWP" UBYTE _CNV_A_R_LINEAR_____16_CM 1 100. -48. 142.5 DISPLAY_IDENTIFIER TFU_IV_SUB ECU_ADDRESS 0xd00039e3 FORMAT "%6.2" /end MEASUREMENT
/begin MEASUREMENT tfu_iv "Injektor fuel temperature depending from TCO, N, MFF_SP, and EWP" UBYTE _CNV_A_R_LINEAR_____16_CM 1 100. -48. 142.5 DISPLAY_IDENTIFIER TFU_IV ECU_ADDRESS 0xd00039e4 FORMAT "%6.2" /end MEASUREMENT
/begin CHARACTERISTIC lc_tfu_tia_tco_ex "Logical switch TIA and TCO_EX for TFU_OFS_AIR calculation" VALUE 0xa1029ded _REC_VAL_20_u1 1. _CNV_S_2_RANGE__0___1_CM 0. 1. DISPLAY_IDENTIFIER LC_TFU_TIA_TCO_EX /end CHARACTERISTIC
/begin CHARACTERISTIC lc_tco_tfu_iv_sub "Logical switch TIA and TCO_EX for TFU_OFS_AIR calculation" VALUE 0xa1029dea _REC_VAL_20_u1 1. _CNV_S_2_RANGE__0___1_CM 0. 1. DISPLAY_IDENTIFIER LC_TCO_TFU_IV_SUB /end CHARACTERISTIC
/begin AXIS_PTS ldp_n_ip_d_tiv_norm_n_mff_sp "" 0xa1020f30 n _REC_AXS_20_u2 8160. _CNV_A_R_LINEAR_____13_CM 6 0. 8160. FORMAT "%4.0" /end AXIS_PTS
/begin AXIS_PTS ldp_n_ip_temp_dif_iv "" 0xa1020f80 n _REC_AXS_20_u2 8160. _CNV_A_R_LINEAR_____13_CM 6 0. 8160. FORMAT "%4.0" /end AXIS_PTS
/begin AXIS_PTS ldp_mff_sp_ip_d_tiv_norm_n_mff "" 0xa1020d34 mff_sp_mv _REC_AXS_20_u2 1389. _CNV_A_R_LINEAR_____108_CM 4 0. 1389. FORMAT "%7.2" /end AXIS_PTS
/begin AXIS_PTS ldp_mff_sp_ip_temp_dif_iv "" 0xa1020d40 mff_sp_mv _REC_AXS_20_u2 1389. _CNV_A_R_LINEAR_____108_CM 4 0. 1389. FORMAT "%7.2" /end AXIS_PTS
/begin AXIS_PTS ldp_tiv_tco_cor_ip_fac_tiv_tco "" 0xa1021396 tco _REC_AXS_20_u1 19.05 _CNV_A_R_LINEAR_____16_CM 6 -48. 142.5 FORMAT "%6.2" /end AXIS_PTS
/begin AXIS_PTS ldp_tco_ip_fac_tco_temp_iv_cor "" 0xa10212b0 tco _REC_AXS_20_u1 19.05 _CNV_A_R_LINEAR_____16_CM 6 -48. 142.5 FORMAT "%6.2" /end AXIS_PTS
/begin AXIS_PTS ldp_tiv_ewp_cor_ip_fac_tiv_ewp "" 0xa102138e n_rel_cwp _REC_AXS_20_u1 25.5 _CNV_A_R_LINEAR_____0_CM 6 0. 255. FORMAT "%3.0" /end AXIS_PTS
/begin AXIS_PTS ldp_n_ip_fac_temp_iv_cwp_cor "" 0xa1020f52 n_rel_cwp _REC_AXS_20_u1 25.5 _CNV_A_R_LINEAR_____0_CM 6 0. 255. FORMAT "%3.0" /end AXIS_PTS
/begin MEASUREMENT tfu_efp "Fuel temperature for the low pressure pump" UBYTE _CNV_A_R_LINEAR_____16_CM 1 100. -48. 142.5 DISPLAY_IDENTIFIER TFU_EFP ECU_ADDRESS 0xd00039e5 FORMAT "%6.2" /end MEASUREMENT
/begin CHARACTERISTIC c_tfu_efp_ofs "Offset for the modelling of the fuel temperature of the low pressure pump" VALUE 0xa1029a24 _REC_VAL_20_u1 190.5 _CNV_A_R_LINEAR_____16_CM -48. 142.5 DISPLAY_IDENTIFIER C_TFU_EFP_OFS FORMAT "%6.2" /end CHARACTERISTIC
/begin MEASUREMENT lv_map_puc_lim_act_lsl_gain_ad "Logical variable is set if MAP limitation is activated" UBYTE _CNV_S_2_RANGE__0___1_CM 1 100. 0. 1. DISPLAY_IDENTIFIER LV_MAP_PUC_LIM_ACT_LSL_GAIN_AD ECU_ADDRESS 0xd00038d8 BIT_MASK 0x1 /end MEASUREMENT
/begin MEASUREMENT tqi_av "Actual indicated engine torque" SWORD _CNV_A_R_LINEAR_____30_CM 1 100. -1024. 1023.96875 DISPLAY_IDENTIFIER TQI_AV ECU_ADDRESS 0xd0004ce8 FORMAT "%6.2" /end MEASUREMENT
/begin MEASUREMENT er_stnd_bal "Normalized cylinder selective engine roughness values" SWORD _CNV_A_R_LINEAR_____130_CM 1 100. -325.78 325.770057983398 DISPLAY_IDENTIFIER ER_STND_BAL ECU_ADDRESS 0xc00004bc FORMAT "%8.3" /end MEASUREMENT
/begin MEASUREMENT er_stnd_fil_bal "Normalized cylinder selective engine roughness values after median filter" SWORD _CNV_A_R_LINEAR_____130_CM 1 100. -325.78 325.770057983398 DISPLAY_IDENTIFIER ER_STND_FIL_BAL ECU_ADDRESS 0xc00004be FORMAT "%8.3" /end MEASUREMENT
/begin MEASUREMENT er_stnd_mmv_bal[0] "Filtered normalized cylinder selective engine roughness values" SWORD _CNV_A_R_LINEAR_____130_CM 1 100. -325.78 325.770057983398 DISPLAY_IDENTIFIER ER_STND_MMV_BAL[0] ECU_ADDRESS 0xd00051a0 FORMAT "%8.3" /end MEASUREMENT
/begin MEASUREMENT er_stnd_mmv_bal[1] "Filtered normalized cylinder selective engine roughness values" SWORD _CNV_A_R_LINEAR_____130_CM 1 100. -325.78 325.770057983398 DISPLAY_IDENTIFIER ER_STND_MMV_BAL[1] ECU_ADDRESS 0xd00051a2 FORMAT "%8.3" /end MEASUREMENT
/begin MEASUREMENT er_stnd_mmv_bal[2] "Filtered normalized cylinder selective engine roughness values" SWORD _CNV_A_R_LINEAR_____130_CM 1 100. -325.78 325.770057983398 DISPLAY_IDENTIFIER ER_STND_MMV_BAL[2] ECU_ADDRESS 0xd00051a4 FORMAT "%8.3" /end MEASUREMENT
/begin MEASUREMENT er_stnd_mmv_bal[3] "Filtered normalized cylinder selective engine roughness values" SWORD _CNV_A_R_LINEAR_____130_CM 1 100. -325.78 325.770057983398 DISPLAY_IDENTIFIER ER_STND_MMV_BAL[3] ECU_ADDRESS 0xd00051a6 FORMAT "%8.3" /end MEASUREMENT
/begin MEASUREMENT er_stnd_mmv_bal[4] "Filtered normalized cylinder selective engine roughness values" SWORD _CNV_A_R_LINEAR_____130_CM 1 100. -325.78 325.770057983398 DISPLAY_IDENTIFIER ER_STND_MMV_BAL[4] ECU_ADDRESS 0xd00051a8 FORMAT "%8.3" /end MEASUREMENT
/begin MEASUREMENT er_stnd_mmv_bal[5] "Filtered normalized cylinder selective engine roughness values" SWORD _CNV_A_R_LINEAR_____130_CM 1 100. -325.78 325.770057983398 DISPLAY_IDENTIFIER ER_STND_MMV_BAL[5] ECU_ADDRESS 0xd00051aa FORMAT "%8.3" /end MEASUREMENT
/begin MEASUREMENT er_stnd_mmv_mv_bal "Mean value of all engine roughness values of the last [NC_CYL_NR] segments" SWORD _CNV_A_R_LINEAR_____130_CM 1 100. -325.78 325.770057983398 DISPLAY_IDENTIFIER ER_STND_MMV_MV_BAL ECU_ADDRESS 0xc00004c0 FORMAT "%8.3" /end MEASUREMENT
/begin MEASUREMENT er_stnd_mmv_dif_bal[0] "Difference of filtered normalized and average engine roughness value" SWORD _CNV_A_R_LINEAR_____130_CM 1 100. -325.78 325.770057983398 DISPLAY_IDENTIFIER ER_STND_MMV_DIF_BAL[0] ECU_ADDRESS 0xd00051ac FORMAT "%8.3" /end MEASUREMENT
/begin MEASUREMENT er_stnd_mmv_dif_bal[1] "Difference of filtered normalized and average engine roughness value" SWORD _CNV_A_R_LINEAR_____130_CM 1 100. -325.78 325.770057983398 DISPLAY_IDENTIFIER ER_STND_MMV_DIF_BAL[1] ECU_ADDRESS 0xd00051ae FORMAT "%8.3" /end MEASUREMENT
/begin MEASUREMENT er_stnd_mmv_dif_bal[2] "Difference of filtered normalized and average engine roughness value" SWORD _CNV_A_R_LINEAR_____130_CM 1 100. -325.78 325.770057983398 DISPLAY_IDENTIFIER ER_STND_MMV_DIF_BAL[2] ECU_ADDRESS 0xd00051b0 FORMAT "%8.3" /end MEASUREMENT
/begin MEASUREMENT er_stnd_mmv_dif_bal[3] "Difference of filtered normalized and average engine roughness value" SWORD _CNV_A_R_LINEAR_____130_CM 1 100. -325.78 325.770057983398 DISPLAY_IDENTIFIER ER_STND_MMV_DIF_BAL[3] ECU_ADDRESS 0xd00051b2 FORMAT "%8.3" /end MEASUREMENT
/begin MEASUREMENT er_stnd_mmv_dif_bal[4] "Difference of filtered normalized and average engine roughness value" SWORD _CNV_A_R_LINEAR_____130_CM 1 100. -325.78 325.770057983398 DISPLAY_IDENTIFIER ER_STND_MMV_DIF_BAL[4] ECU_ADDRESS 0xd00051b4 FORMAT "%8.3" /end MEASUREMENT
/begin MEASUREMENT er_stnd_mmv_dif_bal[5] "Difference of filtered normalized and average engine roughness value" SWORD _CNV_A_R_LINEAR_____130_CM 1 100. -325.78 325.770057983398 DISPLAY_IDENTIFIER ER_STND_MMV_DIF_BAL[5] ECU_ADDRESS 0xd00051b6 FORMAT "%8.3" /end MEASUREMENT
/begin MEASUREMENT er_stnd_mmv_std_bal[0] "Filtered normalized engine roughness values for calculation of the standard deviation" SWORD _CNV_A_R_LINEAR_____130_CM 1 100. -325.78 325.770057983398 DISPLAY_IDENTIFIER ER_STND_MMV_STD_BAL[0] ECU_ADDRESS 0xd00051c4 FORMAT "%8.3" /end MEASUREMENT
/begin MEASUREMENT er_stnd_mmv_std_bal[1] "Filtered normalized engine roughness values for calculation of the standard deviation" SWORD _CNV_A_R_LINEAR_____130_CM 1 100. -325.78 325.770057983398 DISPLAY_IDENTIFIER ER_STND_MMV_STD_BAL[1] ECU_ADDRESS 0xd00051c6 FORMAT "%8.3" /end MEASUREMENT
/begin MEASUREMENT er_stnd_mmv_std_bal[2] "Filtered normalized engine roughness values for calculation of the standard deviation" SWORD _CNV_A_R_LINEAR_____130_CM 1 100. -325.78 325.770057983398 DISPLAY_IDENTIFIER ER_STND_MMV_STD_BAL[2] ECU_ADDRESS 0xd00051c8 FORMAT "%8.3" /end MEASUREMENT
/begin MEASUREMENT er_stnd_mmv_std_bal[3] "Filtered normalized engine roughness values for calculation of the standard deviation" SWORD _CNV_A_R_LINEAR_____130_CM 1 100. -325.78 325.770057983398 DISPLAY_IDENTIFIER ER_STND_MMV_STD_BAL[3] ECU_ADDRESS 0xd00051ca FORMAT "%8.3" /end MEASUREMENT
/begin MEASUREMENT er_stnd_mmv_std_bal[4] "Filtered normalized engine roughness values for calculation of the standard deviation" SWORD _CNV_A_R_LINEAR_____130_CM 1 100. -325.78 325.770057983398 DISPLAY_IDENTIFIER ER_STND_MMV_STD_BAL[4] ECU_ADDRESS 0xd00051cc FORMAT "%8.3" /end MEASUREMENT
/begin MEASUREMENT er_stnd_mmv_std_bal[5] "Filtered normalized engine roughness values for calculation of the standard deviation" SWORD _CNV_A_R_LINEAR_____130_CM 1 100. -325.78 325.770057983398 DISPLAY_IDENTIFIER ER_STND_MMV_STD_BAL[5] ECU_ADDRESS 0xd00051ce FORMAT "%8.3" /end MEASUREMENT
/begin MEASUREMENT er_std_dif_bal "Difference of the filtered normalized and normalized engine roughness values for calc. of the standard deviation" SWORD _CNV_A_R_LINEAR_____130_CM 1 100. -325.78 325.770057983398 DISPLAY_IDENTIFIER ER_STD_DIF_BAL ECU_ADDRESS 0xc00004c2 FORMAT "%8.3" /end MEASUREMENT
/begin MEASUREMENT er_std_bal[0] "Standard deviation of the engine roughness" SWORD _CNV_A_R_LINEAR_____130_CM 1 100. -325.78 325.770057983398 DISPLAY_IDENTIFIER ER_STD_BAL[0] ECU_ADDRESS 0xc00004c4 FORMAT "%8.3" /end MEASUREMENT
/begin MEASUREMENT er_std_bal[1] "Standard deviation of the engine roughness" SWORD _CNV_A_R_LINEAR_____130_CM 1 100. -325.78 325.770057983398 DISPLAY_IDENTIFIER ER_STD_BAL[1] ECU_ADDRESS 0xc00004c6 FORMAT "%8.3" /end MEASUREMENT
/begin MEASUREMENT er_std_bal[2] "Standard deviation of the engine roughness" SWORD _CNV_A_R_LINEAR_____130_CM 1 100. -325.78 325.770057983398 DISPLAY_IDENTIFIER ER_STD_BAL[2] ECU_ADDRESS 0xc00004c8 FORMAT "%8.3" /end MEASUREMENT
/begin MEASUREMENT er_std_bal[3] "Standard deviation of the engine roughness" SWORD _CNV_A_R_LINEAR_____130_CM 1 100. -325.78 325.770057983398 DISPLAY_IDENTIFIER ER_STD_BAL[3] ECU_ADDRESS 0xc00004ca FORMAT "%8.3" /end MEASUREMENT
/begin MEASUREMENT er_std_bal[4] "Standard deviation of the engine roughness" SWORD _CNV_A_R_LINEAR_____130_CM 1 100. -325.78 325.770057983398 DISPLAY_IDENTIFIER ER_STD_BAL[4] ECU_ADDRESS 0xc00004cc FORMAT "%8.3" /end MEASUREMENT
/begin MEASUREMENT er_std_bal[5] "Standard deviation of the engine roughness" SWORD _CNV_A_R_LINEAR_____130_CM 1 100. -325.78 325.770057983398 DISPLAY_IDENTIFIER ER_STD_BAL[5] ECU_ADDRESS 0xc00004ce FORMAT "%8.3" /end MEASUREMENT
/begin MEASUREMENT er_std_mmv_bal[0] "Filtered standard deviation of the engine roughness" SWORD _CNV_A_R_LINEAR_____130_CM 1 100. -325.78 325.770057983398 DISPLAY_IDENTIFIER ER_STD_MMV_BAL[0] ECU_ADDRESS 0xd00051b8 FORMAT "%8.3" /end MEASUREMENT
/begin MEASUREMENT er_std_mmv_bal[1] "Filtered standard deviation of the engine roughness" SWORD _CNV_A_R_LINEAR_____130_CM 1 100. -325.78 325.770057983398 DISPLAY_IDENTIFIER ER_STD_MMV_BAL[1] ECU_ADDRESS 0xd00051ba FORMAT "%8.3" /end MEASUREMENT
/begin MEASUREMENT er_std_mmv_bal[2] "Filtered standard deviation of the engine roughness" SWORD _CNV_A_R_LINEAR_____130_CM 1 100. -325.78 325.770057983398 DISPLAY_IDENTIFIER ER_STD_MMV_BAL[2] ECU_ADDRESS 0xd00051bc FORMAT "%8.3" /end MEASUREMENT
/begin MEASUREMENT er_std_mmv_bal[3] "Filtered standard deviation of the engine roughness" SWORD _CNV_A_R_LINEAR_____130_CM 1 100. -325.78 325.770057983398 DISPLAY_IDENTIFIER ER_STD_MMV_BAL[3] ECU_ADDRESS 0xd00051be FORMAT "%8.3" /end MEASUREMENT
/begin MEASUREMENT er_std_mmv_bal[4] "Filtered standard deviation of the engine roughness" SWORD _CNV_A_R_LINEAR_____130_CM 1 100. -325.78 325.770057983398 DISPLAY_IDENTIFIER ER_STD_MMV_BAL[4] ECU_ADDRESS 0xd00051c0 FORMAT "%8.3" /end MEASUREMENT
/begin MEASUREMENT er_std_mmv_bal[5] "Filtered standard deviation of the engine roughness" SWORD _CNV_A_R_LINEAR_____130_CM 1 100. -325.78 325.770057983398 DISPLAY_IDENTIFIER ER_STD_MMV_BAL[5] ECU_ADDRESS 0xd00051c2 FORMAT "%8.3" /end MEASUREMENT
/begin MEASUREMENT drv1_stnd_bal "Standardized acceleration component of the ER value" SWORD _CNV_A_R_LINEAR_____130_CM 1 100. -325.78 325.770057983398 DISPLAY_IDENTIFIER DRV1_STND_BAL ECU_ADDRESS 0xc00004d0 FORMAT "%8.3" /end MEASUREMENT
/begin MEASUREMENT dly_drv1_stnd_bal "Segment delay for acceleration fade out of cylinder balancing" UWORD _CNV_A_R_LINEAR_____0_CM 1 100. 0. 65535. DISPLAY_IDENTIFIER DLY_DRV1_STND_BAL ECU_ADDRESS 0xc00004b8 FORMAT "%5.0" /end MEASUREMENT
/begin MEASUREMENT ctr_dly_drv1_stnd_bal "Segment delay counter for acceleration fade out of cylinder balancing" UWORD _CNV_A_R_LINEAR_____0_CM 1 100. 0. 65535. DISPLAY_IDENTIFIER CTR_DLY_DRV1_STND_BAL ECU_ADDRESS 0xc00004ba FORMAT "%5.0" /end MEASUREMENT
/begin MEASUREMENT lv_drv1_stnd_bal_fdout "Flag for acceleration fade out of cylinder balancing" UBYTE _CNV_S_2_RANGE__0___1_CM 1 100. 0. 1. DISPLAY_IDENTIFIER LV_DRV1_STND_BAL_FDOUT ECU_ADDRESS 0xd0003d88 BIT_MASK 0x1 /end MEASUREMENT
/begin CHARACTERISTIC c_crlc_er_stnd_bal "Correlation constant for ER_STND_FIL_BAL value filter" VALUE 0xa10291e3 _REC_VAL_20_u1 0.99609375 _CNV_A_R_LINEAR_____27_CM 0. 0.99609375 DISPLAY_IDENTIFIER C_CRLC_ER_STND_BAL FORMAT "%5.3" /end CHARACTERISTIC
/begin CHARACTERISTIC c_crlc_er_std_bal "Correlation constant for ER_STND_FIL_BAL value filter for standard deviation" VALUE 0xa10291e1 _REC_VAL_20_u1 0.99609375 _CNV_A_R_LINEAR_____27_CM 0. 0.99609375 DISPLAY_IDENTIFIER C_CRLC_ER_STD_BAL FORMAT "%5.3" /end CHARACTERISTIC
/begin CHARACTERISTIC c_crlc_er_std_mmv_bal "Correlation constant for ER_STD_BAL value filter" VALUE 0xa10291e2 _REC_VAL_20_u1 0.99609375 _CNV_A_R_LINEAR_____27_CM 0. 0.99609375 DISPLAY_IDENTIFIER C_CRLC_ER_STD_MMV_BAL FORMAT "%5.3" /end CHARACTERISTIC
/begin CHARACTERISTIC c_fac_er_std_neg_bal "Weighing factor for negative ER_STD_DIF_BAL values" VALUE 0xa102937e _REC_VAL_20_u1 0.99609375 _CNV_A_R_LINEAR_____27_CM 0. 0.99609375 DISPLAY_IDENTIFIER C_FAC_ER_STD_NEG_BAL FORMAT "%5.3" /end CHARACTERISTIC
/begin CHARACTERISTIC c_fac_er_std_pos_bal "Weighing factor for positive ER_STD_DIF_BAL values" VALUE 0xa102937f _REC_VAL_20_u1 0.99609375 _CNV_A_R_LINEAR_____27_CM 0. 0.99609375 DISPLAY_IDENTIFIER C_FAC_ER_STD_POS_BAL FORMAT "%5.3" /end CHARACTERISTIC
/begin CHARACTERISTIC c_ctr_dly_drv1_stnd_bal_dec "Segment delay counter decrement value" VALUE 0xa1029291 _REC_VAL_20_u1 255. _CNV_A_R_LINEAR_____0_CM 0. 255. DISPLAY_IDENTIFIER C_CTR_DLY_DRV1_STND_BAL_DEC FORMAT "%3.0" /end CHARACTERISTIC
/begin AXIS_PTS ldp_drv1_stnd_bal_ip_dly_bal "" 0xa1020894 drv1_stnd_bal _REC_AXS_20_u2 651.5500579833979 _CNV_A_R_LINEAR_____128_CM 8 -325.78 325.770057983398 FORMAT "%8.3" /end AXIS_PTS
/begin CHARACTERISTIC ip_dly_drv1_stnd_bal "Segment delay counter start value" CURVE 0xa1023260 _REC_CUR_20_u2_u2 65535. _CNV_A_R_LINEAR_____0_CM 0. 65535. DISPLAY_IDENTIFIER IP_DLY_DRV1_STND_BAL FORMAT "%5.0"
 /begin AXIS_DESCR COM_AXIS drv1_stnd_bal _CNV_A_R_LINEAR_____128_CM 8 -325.78 325.770057983398 FORMAT "%8.3" AXIS_PTS_REF ldp_drv1_stnd_bal_ip_dly_bal /end AXIS_DESCR
/end CHARACTERISTIC
/begin MEASUREMENT lv_er_stnd_er_bal_act "Activation condition to enable cylinder balancing signal preparation calculation" UBYTE _CNV_S_2_RANGE__0___1_CM 1 100. 0. 1. DISPLAY_IDENTIFIER LV_ER_STND_ER_BAL_ACT ECU_ADDRESS 0xd0003d78 BIT_MASK 0x1 /end MEASUREMENT
/begin MEASUREMENT lv_drv1_er_bal_act "Activation condition to enable cylinder balancing fade out calculation" UBYTE _CNV_S_2_RANGE__0___1_CM 1 100. 0. 1. DISPLAY_IDENTIFIER LV_DRV1_ER_BAL_ACT ECU_ADDRESS 0xd0003d79 BIT_MASK 0x1 /end MEASUREMENT
/begin MEASUREMENT lv_ti_er_bal_act "Activation condition to enable cylinder balancing TI intervention calculation" UBYTE _CNV_S_2_RANGE__0___1_CM 1 100. 0. 1. DISPLAY_IDENTIFIER LV_TI_ER_BAL_ACT ECU_ADDRESS 0xd0003d7a BIT_MASK 0x1 /end MEASUREMENT
/begin MEASUREMENT lv_ti_er_bal_ena_ext "External condition to enable cylinder balancing manager calculations" UBYTE _CNV_S_2_RANGE__0___1_CM 1 100. 0. 1. DISPLAY_IDENTIFIER LV_TI_ER_BAL_ENA_EXT ECU_ADDRESS 0xd0003d7b BIT_MASK 0x1 /end MEASUREMENT
/begin MEASUREMENT lv_ti_add_ad_er_bal_ena_ext "External condition to enable cylinder balancing additive adaptation manager calculations" UBYTE _CNV_S_2_RANGE__0___1_CM 1 100. 0. 1. DISPLAY_IDENTIFIER LV_TI_ADD_AD_ER_BAL_ENA_EXT ECU_ADDRESS 0xd0003d7c BIT_MASK 0x1 /end MEASUREMENT
/begin MEASUREMENT lv_fac_ti_ad_er_bal_ena_ext "External condition to enable cylinder balancing multiple adaptation manager calculations" UBYTE _CNV_S_2_RANGE__0___1_CM 1 100. 0. 1. DISPLAY_IDENTIFIER LV_FAC_TI_AD_ER_BAL_ENA_EXT ECU_ADDRESS 0xd0003d7d BIT_MASK 0x1 /end MEASUREMENT
/begin MEASUREMENT lv_ti_cyl_bal_er_act "Flag for cylinder balancing (TI intervention) via engine roughness activated" UBYTE _CNV_S_2_RANGE__0___1_CM 1 100. 0. 1. DISPLAY_IDENTIFIER LV_TI_CYL_BAL_ER_ACT ECU_ADDRESS 0xd0003d7e BIT_MASK 0x1 /end MEASUREMENT
/begin MEASUREMENT lv_ti_cyl_bal_lam_act "Flag for cylinder balancing (TI intervention) via lambda sensor activated" UBYTE _CNV_S_2_RANGE__0___1_CM 1 100. 0. 1. DISPLAY_IDENTIFIER LV_TI_CYL_BAL_LAM_ACT ECU_ADDRESS 0xd0003d7f BIT_MASK 0x1 /end MEASUREMENT
/begin CHARACTERISTIC c_er_stnd_er_bal_act_man "Manual adjustment of activation conditions for cylinder balancing signal preparation" VALUE 0xa102935e _REC_VAL_20_u1 2. _CNV_S_3_CYBL_RANGE_793_CM 0. 2. DISPLAY_IDENTIFIER C_ER_STND_ER_BAL_ACT_MAN /end CHARACTERISTIC
/begin CHARACTERISTIC c_drv1_er_bal_act_man "Manual adjustment of activation conditions for cylinder balancing fade out" VALUE 0xa1029311 _REC_VAL_20_u1 2. _CNV_S_3_CYBL_RANGE_793_CM 0. 2. DISPLAY_IDENTIFIER C_DRV1_ER_BAL_ACT_MAN /end CHARACTERISTIC
/begin CHARACTERISTIC c_ti_er_bal_act_man "Manual adjustment of activation conditions for cylinder balancing via TI intervention" VALUE 0xa1029a44 _REC_VAL_20_u1 2. _CNV_S_3_CYBL_RANGE_793_CM 0. 2. DISPLAY_IDENTIFIER C_TI_ER_BAL_ACT_MAN /end CHARACTERISTIC
/begin CHARACTERISTIC c_tqi_min_ti_er_bal "Minimum engine torque for cylinder balancing via TI intervention" VALUE 0xa1029b42 _REC_VAL_20_s2 2047.96875 _CNV_A_R_LINEAR_____30_CM -1024. 1023.96875 DISPLAY_IDENTIFIER C_TQI_MIN_TI_ER_BAL FORMAT "%11.5" /end CHARACTERISTIC
/begin CHARACTERISTIC c_tqi_max_ti_er_bal "Maximum engine torque for cylinder balancing via TI intervention" VALUE 0xa1029b40 _REC_VAL_20_s2 2047.96875 _CNV_A_R_LINEAR_____30_CM -1024. 1023.96875 DISPLAY_IDENTIFIER C_TQI_MAX_TI_ER_BAL FORMAT "%11.5" /end CHARACTERISTIC
/begin CHARACTERISTIC c_t_ast_min_ti_er_bal "Minimum time after engine start for cylinder balancing via TI intervention" VALUE 0xa1029816 _REC_VAL_20_u2 6553.5 _CNV_A_R_LINEAR_____4_CM 0. 6553.5 DISPLAY_IDENTIFIER C_T_AST_MIN_TI_ER_BAL FORMAT "%6.1" /end CHARACTERISTIC
/begin CHARACTERISTIC lc_ti_er_bal_stop_man "Logical constant for manual stop (=1) of all cylinder balancing functions (TI intervention)" VALUE 0xa1029df2 _REC_VAL_20_u1 1. _CNV_A_R_LINEAR_____0_CM 0. 1. DISPLAY_IDENTIFIER LC_TI_ER_BAL_STOP_MAN FORMAT "%1.0" /end CHARACTERISTIC
/begin MEASUREMENT lv_ti_er_bal_ena "Flag for cylinder balancing via TI intervention enabled" UBYTE _CNV_S_2_RANGE__0___1_CM 1 100. 0. 1. DISPLAY_IDENTIFIER LV_TI_ER_BAL_ENA ECU_ADDRESS 0xc00004a9 BIT_MASK 0x1 /end MEASUREMENT
/begin MEASUREMENT lv_ti_add_er_bal_ena "Flag for additive cylinder balancing TI correction active" UBYTE _CNV_S_2_RANGE__0___1_CM 1 100. 0. 1. DISPLAY_IDENTIFIER LV_TI_ADD_ER_BAL_ENA ECU_ADDRESS 0xd0003d81 BIT_MASK 0x1 /end MEASUREMENT
/begin MEASUREMENT lv_ti_add_ad_er_bal_ena "Flag for additive cylinder balancing TI adaptation active" UBYTE _CNV_S_2_RANGE__0___1_CM 1 100. 0. 1. DISPLAY_IDENTIFIER LV_TI_ADD_AD_ER_BAL_ENA ECU_ADDRESS 0xd0003d82 BIT_MASK 0x1 /end MEASUREMENT
/begin MEASUREMENT lv_fac_ti_er_bal_ena "Flag for multiple cylinder balancing TI correction active" UBYTE _CNV_S_2_RANGE__0___1_CM 1 100. 0. 1. DISPLAY_IDENTIFIER LV_FAC_TI_ER_BAL_ENA ECU_ADDRESS 0xd0003d83 BIT_MASK 0x1 /end MEASUREMENT
/begin MEASUREMENT lv_fac_ti_ad_er_bal_ena "Flag for multiple cylinder balancing TI adaptation active" UBYTE _CNV_S_2_RANGE__0___1_CM 1 100. 0. 1. DISPLAY_IDENTIFIER LV_FAC_TI_AD_ER_BAL_ENA ECU_ADDRESS 0xd0003d84 BIT_MASK 0x1 /end MEASUREMENT
/begin MEASUREMENT ctr_ti_er_bal_ena "Engine cycle counter to delay TI intervention at entry to state cylinder balancing" UWORD _CNV_A_R_LINEAR_____0_CM 1 100. 0. 65535. DISPLAY_IDENTIFIER CTR_TI_ER_BAL_ENA ECU_ADDRESS 0xc00004a4 FORMAT "%5.0" /end MEASUREMENT
/begin MEASUREMENT lv_er_stnd_mmv_max_ti_er_bal "Flag for maximum ER_STND_MMV_BAL value for cylinder balancing via TI intervention" UBYTE _CNV_S_2_RANGE__0___1_CM 1 100. 0. 1. DISPLAY_IDENTIFIER LV_ER_STND_MMV_MAX_TI_ER_BAL ECU_ADDRESS 0xc00004aa BIT_MASK 0x1 /end MEASUREMENT
/begin MEASUREMENT lv_er_std_mmv_max_ti_er_bal "Flag for maximum ER_STD_MMV_BAL value for cylinder balancing via TI intervention" UBYTE _CNV_S_2_RANGE__0___1_CM 1 100. 0. 1. DISPLAY_IDENTIFIER LV_ER_STD_MMV_MAX_TI_ER_BAL ECU_ADDRESS 0xc00004ab BIT_MASK 0x1 /end MEASUREMENT
/begin CHARACTERISTIC c_tco_max_ti_er_bal "Maximum coolant temperature value for cylinder balancing via TI intervention" VALUE 0xa10299d6 _REC_VAL_20_u1 190.5 _CNV_A_R_LINEAR_____16_CM -48. 142.5 DISPLAY_IDENTIFIER C_TCO_MAX_TI_ER_BAL FORMAT "%6.2" /end CHARACTERISTIC
/begin CHARACTERISTIC c_tco_min_fac_ti_ad_er_bal "Minimum coolant temperature value for cylinder balancing multiple TI adaptation" VALUE 0xa10299de _REC_VAL_20_u1 190.5 _CNV_A_R_LINEAR_____16_CM -48. 142.5 DISPLAY_IDENTIFIER C_TCO_MIN_FAC_TI_AD_ER_BAL FORMAT "%6.2" /end CHARACTERISTIC
/begin CHARACTERISTIC c_tco_min_ti_add_ad_er_bal "Minimum coolant temperature value for cylinder balancing additive TI adaptation" VALUE 0xa10299e8 _REC_VAL_20_u1 190.5 _CNV_A_R_LINEAR_____16_CM -48. 142.5 DISPLAY_IDENTIFIER C_TCO_MIN_TI_ADD_AD_ER_BAL FORMAT "%6.2" /end CHARACTERISTIC
/begin CHARACTERISTIC c_er_stnd_mmv_max_ti_er_bal "Maximum ER_STND_MMV_BAL value for cylinder balancing via TI intervention" VALUE 0xa1029360 _REC_VAL_20_s2 651.5500579833979 _CNV_A_R_LINEAR_____130_CM -325.78 325.770057983398 DISPLAY_IDENTIFIER C_ER_STND_MMV_MAX_TI_ER_BAL FORMAT "%8.3" /end CHARACTERISTIC
/begin CHARACTERISTIC c_er_std_mmv_max_ti_er_bal "Maximum ER_STD_MMV_BAL value for cylinder balancing via TI intervention" VALUE 0xa102935c _REC_VAL_20_s2 651.5500579833979 _CNV_A_R_LINEAR_____130_CM -325.78 325.770057983398 DISPLAY_IDENTIFIER C_ER_STD_MMV_MAX_TI_ER_BAL FORMAT "%8.3" /end CHARACTERISTIC
/begin CHARACTERISTIC lc_ti_add_er_bal_ena "Logical constant to enable additive TI intervention out of idle" VALUE 0xa1029def _REC_VAL_20_u1 1. _CNV_A_R_LINEAR_____0_CM 0. 1. DISPLAY_IDENTIFIER LC_TI_ADD_ER_BAL_ENA FORMAT "%1.0" /end CHARACTERISTIC
/begin MEASUREMENT state_ti_er_bal "State of cylinder balancing via TI intervention" UBYTE _CNV_S_4_CYBL_RANGE_794_CM 1 100. 0. 3. DISPLAY_IDENTIFIER STATE_TI_ER_BAL ECU_ADDRESS 0xd0003d80 /end MEASUREMENT
/begin MEASUREMENT state_ctl_ti_er_bal "State of cylinder balancing control via TI intervention" UBYTE _CNV_S_5_CYBL_RANGE_795_CM 1 100. 0. 4. DISPLAY_IDENTIFIER STATE_CTL_TI_ER_BAL ECU_ADDRESS 0xc00004a8 /end MEASUREMENT
/begin CHARACTERISTIC c_tco_min_ti_er_bal "Minimum coolant temperature value for cylinder balancing via TI intervention" VALUE 0xa10299e9 _REC_VAL_20_u1 190.5 _CNV_A_R_LINEAR_____16_CM -48. 142.5 DISPLAY_IDENTIFIER C_TCO_MIN_TI_ER_BAL FORMAT "%6.2" /end CHARACTERISTIC
/begin CHARACTERISTIC c_mff_sp_max_fac_ti_er_bal "Maximum mass fuel flow setpoint for cylinder balancing multiple TI correction" VALUE 0xa102958e _REC_VAL_20_u2 1389. _CNV_A_R_LINEAR_____108_CM 0. 1389. DISPLAY_IDENTIFIER C_MFF_SP_MAX_FAC_TI_ER_BAL FORMAT "%7.2" /end CHARACTERISTIC
/begin CHARACTERISTIC c_mff_sp_min_fac_ti_ad_er_bal "Minimum mass fuel flow setpoint for cylinder balancing multiple TI adaptation" VALUE 0xa1029598 _REC_VAL_20_u2 1389. _CNV_A_R_LINEAR_____108_CM 0. 1389. DISPLAY_IDENTIFIER C_MFF_SP_MIN_FAC_TI_AD_ER_BAL FORMAT "%7.2" /end CHARACTERISTIC
/begin CHARACTERISTIC c_mff_sp_max_fac_ti_ad_er_bal "Maximum mass fuel flow setpoint for cylinder balancing multiple TI adaptation" VALUE 0xa102958c _REC_VAL_20_u2 1389. _CNV_A_R_LINEAR_____108_CM 0. 1389. DISPLAY_IDENTIFIER C_MFF_SP_MAX_FAC_TI_AD_ER_BAL FORMAT "%7.2" /end CHARACTERISTIC
/begin CHARACTERISTIC c_mff_sp_min_fac_ti_er_bal "Minimum mass fuel flow setpoint for cylinder balancing multiple TI correction" VALUE 0xa102959a _REC_VAL_20_u2 1389. _CNV_A_R_LINEAR_____108_CM 0. 1389. DISPLAY_IDENTIFIER C_MFF_SP_MIN_FAC_TI_ER_BAL FORMAT "%7.2" /end CHARACTERISTIC
/begin CHARACTERISTIC c_mff_sp_max_ti_add_er_bal "Maximum mass fuel flow setpoint for cylinder balancing additive TI correction" VALUE 0xa1029592 _REC_VAL_20_u2 1389. _CNV_A_R_LINEAR_____108_CM 0. 1389. DISPLAY_IDENTIFIER C_MFF_SP_MAX_TI_ADD_ER_BAL FORMAT "%7.2" /end CHARACTERISTIC
/begin CHARACTERISTIC c_mff_sp_min_ti_add_ad_er_bal "Minimum mass fuel flow setpoint for cylinder balancing additive TI adaptation" VALUE 0xa102959c _REC_VAL_20_u2 1389. _CNV_A_R_LINEAR_____108_CM 0. 1389. DISPLAY_IDENTIFIER C_MFF_SP_MIN_TI_ADD_AD_ER_BAL FORMAT "%7.2" /end CHARACTERISTIC
/begin CHARACTERISTIC c_mff_sp_max_ti_add_ad_er_bal "Maximum mass fuel flow setpoint for cylinder balancing additive TI adaptation" VALUE 0xa1029590 _REC_VAL_20_u2 1389. _CNV_A_R_LINEAR_____108_CM 0. 1389. DISPLAY_IDENTIFIER C_MFF_SP_MAX_TI_ADD_AD_ER_BAL FORMAT "%7.2" /end CHARACTERISTIC
/begin CHARACTERISTIC c_mff_sp_min_ti_add_er_bal "Minimum mass fuel flow setpoint for cylinder balancing additive TI correction" VALUE 0xa102959e _REC_VAL_20_u2 1389. _CNV_A_R_LINEAR_____108_CM 0. 1389. DISPLAY_IDENTIFIER C_MFF_SP_MIN_TI_ADD_ER_BAL FORMAT "%7.2" /end CHARACTERISTIC
/begin CHARACTERISTIC c_n_32_min_ti_add_er_bal "Minimum engine speed for cylinder balancing additive TI correction" VALUE 0xa10295ce _REC_VAL_20_u1 8160. _CNV_A_R_LINEAR_____9_CM 0. 8160. DISPLAY_IDENTIFIER C_N_32_MIN_TI_ADD_ER_BAL FORMAT "%4.0" /end CHARACTERISTIC
/begin CHARACTERISTIC c_n_32_max_ti_add_er_bal "Maximum engine speed for cylinder balancing additive TI correction" VALUE 0xa10295c6 _REC_VAL_20_u1 8160. _CNV_A_R_LINEAR_____9_CM 0. 8160. DISPLAY_IDENTIFIER C_N_32_MAX_TI_ADD_ER_BAL FORMAT "%4.0" /end CHARACTERISTIC
/begin CHARACTERISTIC c_n_32_max_ti_add_ad_er_bal "Maximum engine speed for cylinder balancing additive TI adaptation" VALUE 0xa10295c5 _REC_VAL_20_u1 8160. _CNV_A_R_LINEAR_____9_CM 0. 8160. DISPLAY_IDENTIFIER C_N_32_MAX_TI_ADD_AD_ER_BAL FORMAT "%4.0" /end CHARACTERISTIC
/begin CHARACTERISTIC c_n_32_min_ti_add_ad_er_bal "Minimum engine speed for cylinder balancing additive TI adaptation" VALUE 0xa10295cd _REC_VAL_20_u1 8160. _CNV_A_R_LINEAR_____9_CM 0. 8160. DISPLAY_IDENTIFIER C_N_32_MIN_TI_ADD_AD_ER_BAL FORMAT "%4.0" /end CHARACTERISTIC
/begin CHARACTERISTIC c_n_32_min_fac_ti_er_bal "Minimum engine speed for cylinder balancing multiple TI correction" VALUE 0xa10295c9 _REC_VAL_20_u1 8160. _CNV_A_R_LINEAR_____9_CM 0. 8160. DISPLAY_IDENTIFIER C_N_32_MIN_FAC_TI_ER_BAL FORMAT "%4.0" /end CHARACTERISTIC
/begin CHARACTERISTIC c_n_32_max_fac_ti_er_bal "Maximum engine speed for cylinder balancing multiple TI correction" VALUE 0xa10295c3 _REC_VAL_20_u1 8160. _CNV_A_R_LINEAR_____9_CM 0. 8160. DISPLAY_IDENTIFIER C_N_32_MAX_FAC_TI_ER_BAL FORMAT "%4.0" /end CHARACTERISTIC
/begin CHARACTERISTIC c_n_32_max_fac_ti_ad_er_bal "Maximum engine speed for cylinder balancing multiple TI adaptation" VALUE 0xa10295c2 _REC_VAL_20_u1 8160. _CNV_A_R_LINEAR_____9_CM 0. 8160. DISPLAY_IDENTIFIER C_N_32_MAX_FAC_TI_AD_ER_BAL FORMAT "%4.0" /end CHARACTERISTIC
/begin CHARACTERISTIC c_n_32_min_fac_ti_ad_er_bal "Minimum engine speed for cylinder balancing multiple TI adaptation" VALUE 0xa10295c8 _REC_VAL_20_u1 8160. _CNV_A_R_LINEAR_____9_CM 0. 8160. DISPLAY_IDENTIFIER C_N_32_MIN_FAC_TI_AD_ER_BAL FORMAT "%4.0" /end CHARACTERISTIC
/begin AXIS_PTS ldp_n_32_ip_ctr_ti_er_bal_ini "" 0xa1020df2 n_32 _REC_AXS_20_u1 8160. _CNV_A_R_LINEAR_____9_CM 4 0. 8160. FORMAT "%4.0" /end AXIS_PTS
/begin CHARACTERISTIC ip_ctr_ti_er_bal_ena_ini "Engine cycle counter start value to delay TI intervention at entry to state cylinder balancing" CURVE 0xa10231ec _REC_CUR_20_u2_u1 65535. _CNV_A_R_LINEAR_____0_CM 0. 65535. DISPLAY_IDENTIFIER IP_CTR_TI_ER_BAL_ENA_INI FORMAT "%5.0"
 /begin AXIS_DESCR COM_AXIS n_32 _CNV_A_R_LINEAR_____9_CM 4 0. 8160. FORMAT "%4.0" AXIS_PTS_REF ldp_n_32_ip_ctr_ti_er_bal_ini /end AXIS_DESCR
/end CHARACTERISTIC
/begin COMPU_METHOD _CNV_A_R_LINEAR_____0_CM "" RAT_FUNC "%6.3" "-" COEFFS 0 1. 0. 0 0 1 /end COMPU_METHOD
/begin COMPU_METHOD _CNV_S_2_RANGE__0___1_CM "" TAB_VERB "%6.3" "-" COMPU_TAB_REF _CNV_S_2_RANGE__0___1 /end COMPU_METHOD
/begin COMPU_VTAB _CNV_S_2_RANGE__0___1 "" TAB_VERB 2 0 "0" 1 "1" /end COMPU_VTAB
/begin COMPU_METHOD _CNV_A_R_LINEAR_____2_CM "" RAT_FUNC "%6.3" "V" COEFFS 0 204.8 0. 0 0 1 /end COMPU_METHOD
/begin COMPU_METHOD _CNV_A_R_LINEAR_____3_CM "" RAT_FUNC "%6.3" "s" COEFFS 0 100. 0. 0 0 1 /end COMPU_METHOD
/begin COMPU_METHOD _CNV_A_R_LINEAR_____4_CM "" RAT_FUNC "%6.3" "s" COEFFS 0 10. 0. 0 0 1 /end COMPU_METHOD
/begin COMPU_METHOD _CNV_A_R_LINEAR_____5_CM "" RAT_FUNC "%6.3" "%" COEFFS 0 2.56 0. 0 0 1 /end COMPU_METHOD
/begin COMPU_METHOD _CNV_A_R_LINEAR_____6_CM "" RAT_FUNC "%6.3" "km/h" COEFFS 0 1. 0. 0 0 1 /end COMPU_METHOD
/begin COMPU_METHOD _CNV_A_R_LINEAR_____7_CM "" RAT_FUNC "%6.3" "%" COEFFS 0 655.3599999999997 0. 0 0 1 /end COMPU_METHOD
/begin COMPU_METHOD _CNV_A_R_LINEAR_____8_CM "" RAT_FUNC "%6.3" "-" COEFFS 0 32767.99999999992 0. 0 0 1 /end COMPU_METHOD
/begin COMPU_METHOD _CNV_A_R_LINEAR_____9_CM "" RAT_FUNC "%6.3" "rpm" COEFFS 0 3.125e-002 0. 0 0 1 /end COMPU_METHOD
/begin COMPU_METHOD _CNV_A_R_LINEAR_____11_CM "" RAT_FUNC "%6.3" "-" COEFFS 0 4095.999999839998 -1.280019205296412e-006 0 0 1 /end COMPU_METHOD
/begin COMPU_METHOD _CNV_A_R_LINEAR_____13_CM "" RAT_FUNC "%6.3" "rpm" COEFFS 0 1. 0. 0 0 1 /end COMPU_METHOD
/begin COMPU_METHOD _CNV_A_R_LINEAR_____16_CM "" RAT_FUNC "%6.3" "°C" COEFFS 0 1.333333333333333 64. 0 0 1 /end COMPU_METHOD
/begin COMPU_METHOD _CNV_A_R_LINEAR_____18_CM "" RAT_FUNC "%6.3" "ms" COEFFS 0 0.1 0. 0 0 1 /end COMPU_METHOD
/begin COMPU_METHOD _CNV_A_R_LINEAR_____25_CM "" RAT_FUNC "%6.3" "°C" COEFFS 0 1. 40. 0 0 1 /end COMPU_METHOD
/begin COMPU_METHOD _CNV_A_R_LINEAR_____27_CM "" RAT_FUNC "%6.3" "-" COEFFS 0 256. 0. 0 0 1 /end COMPU_METHOD
/begin COMPU_METHOD _CNV_A_R_LINEAR_____28_CM "" RAT_FUNC "%6.3" "rpm/s" COEFFS 0 3.125e-002 128. 0 0 1 /end COMPU_METHOD
/begin COMPU_METHOD _CNV_A_R_LINEAR_____30_CM "" RAT_FUNC "%6.3" "Nm" COEFFS 0 32. 0. 0 0 1 /end COMPU_METHOD
/begin COMPU_METHOD _CNV_A_R_LINEAR_____35_CM "" RAT_FUNC "%6.3" "s" COEFFS 0 1. 0. 0 0 1 /end COMPU_METHOD
/begin COMPU_METHOD _CNV_A_R_LINEAR_____50_CM "" RAT_FUNC "%6.3" "" COEFFS 0 1. 0. 0 0 1 /end COMPU_METHOD
/begin COMPU_METHOD _CNV_A_R_LINEAR_____65_CM "" RAT_FUNC "%6.3" "Nm" COEFFS 0 32. 32768. 0 0 1 /end COMPU_METHOD
/begin COMPU_METHOD _CNV_A_R_LINEAR_____66_CM "" RAT_FUNC "%6.3" "km/h" COEFFS 0 128.0000018750286 0. 0 0 1 /end COMPU_METHOD
/begin COMPU_METHOD _CNV_A_R_LINEAR_____71_CM "" RAT_FUNC "%6.3" "" COEFFS 0 256. 0. 0 0 1 /end COMPU_METHOD
/begin COMPU_METHOD _CNV_S_2_RANGE______75_CM "" TAB_VERB "%6.3" "" COMPU_TAB_REF _CNV_S_2_RANGE______75 /end COMPU_METHOD
/begin COMPU_VTAB _CNV_S_2_RANGE______75 "" TAB_VERB 2 0 "0" 1 "1" /end COMPU_VTAB
/begin COMPU_METHOD _CNV_A_R_LINEAR_____77_CM "" RAT_FUNC "%6.3" "min" COEFFS 0 1. 0. 0 0 1 /end COMPU_METHOD
/begin COMPU_METHOD _CNV_A_R_LINEAR_____79_CM "" RAT_FUNC "%6.3" "°STW/s" COEFFS 0 22.75571737399022 0. 0 0 1 /end COMPU_METHOD
/begin COMPU_METHOD _CNV_A_R_LINEAR_____80_CM "" RAT_FUNC "%6.3" "°STW" COEFFS 0 22.75571737399022 0. 0 0 1 /end COMPU_METHOD
/begin COMPU_METHOD _CNV_A_R_LINEAR_____97_CM "" RAT_FUNC "%6.3" "-" COEFFS 0 127.9991955827809 0. 0 0 1 /end COMPU_METHOD
/begin COMPU_METHOD _CNV_A_R_LINEAR_____100_CM "" RAT_FUNC "%6.3" "-" COEFFS 0 128. 0. 0 0 1 /end COMPU_METHOD
/begin COMPU_METHOD _CNV_A_R_LINEAR_____108_CM "" RAT_FUNC "%6.3" "mg/stk" COEFFS 0 47.18142548596112 0. 0 0 1 /end COMPU_METHOD
/begin COMPU_METHOD _CNV_A_R_LINEAR_____113_CM "" RAT_FUNC "%6.3" "-" COEFFS 0 8192. 0. 0 0 1 /end COMPU_METHOD
/begin COMPU_METHOD _CNV_A_R_LINEAR_____122_CM "" RAT_FUNC "%6.3" "-" COEFFS 0 1024. 0. 0 0 1 /end COMPU_METHOD
/begin COMPU_METHOD _CNV_A_R_LINEAR_____123_CM "" RAT_FUNC "%6.3" "°C" COEFFS 0 16. 0. 0 0 1 /end COMPU_METHOD
/begin COMPU_METHOD _CNV_A_R_LINEAR_____128_CM "" RAT_FUNC "%6.3" "1/s²" COEFFS 0 100.5832156670146 32768.00000000002 0 0 1 /end COMPU_METHOD
/begin COMPU_METHOD _CNV_A_R_LINEAR_____130_CM "" RAT_FUNC "%6.3" "1/s²" COEFFS 0 100.5832156670146 2.182787284255028e-011 0 0 1 /end COMPU_METHOD
/begin COMPU_METHOD _CNV_A_R_LINEAR_____152_CM "" RAT_FUNC "%6.3" "hPa" COEFFS 0 0.1884402603974972 0. 0 0 1 /end COMPU_METHOD
/begin COMPU_METHOD _CNV_A_R_LINEAR_____153_CM "" RAT_FUNC "%6.3" "hPa" COEFFS 0 0.3768805207949945 0. 0 0 1 /end COMPU_METHOD
/begin COMPU_METHOD _CNV_A_R_LINEAR_____156_CM "" RAT_FUNC "%6.3" "l/h" COEFFS 0 257. 0. 0 0 1 /end COMPU_METHOD
/begin COMPU_METHOD _CNV_S_4_STATE_AMT__164_CM "" TAB_VERB "%6.3" "" COMPU_TAB_REF _CNV_S_4_STATE_AMT__164 /end COMPU_METHOD
/begin COMPU_VTAB _CNV_S_4_STATE_AMT__164 "" TAB_VERB 4 0 "NO" 1 "DEC" 2 "INC" 3 "DEC_INC" /end COMPU_VTAB
/begin COMPU_METHOD _CNV_A_R_LINEAR_____165_CM "" RAT_FUNC "%6.3" "Nm/10ms" COEFFS 0 32. 0. 0 0 1 /end COMPU_METHOD
/begin COMPU_METHOD _CNV_A_R_LINEAR_____172_CM "" RAT_FUNC "%6.3" "rpm" COEFFS 0 1. 32768. 0 0 1 /end COMPU_METHOD
/begin COMPU_METHOD _CNV_A_R_LINEAR_____183_CM "" RAT_FUNC "%6.3" "s" COEFFS 0 32. 0. 0 0 1 /end COMPU_METHOD
/begin COMPU_METHOD _CNV_A_R_LINEAR_____197_CM "" RAT_FUNC "%6.3" "°C" COEFFS 0 64. 0. 0 0 1 /end COMPU_METHOD
/begin COMPU_METHOD _CNV_A_R_LINEAR_____201_CM "" RAT_FUNC "%6.3" "%" COEFFS 0 327.68 0. 0 0 1 /end COMPU_METHOD
/begin COMPU_METHOD _CNV_A_R_LINEAR_____225_CM "" RAT_FUNC "%6.3" "%" COEFFS 0 327.680000003584 32768.00000035841 0 0 1 /end COMPU_METHOD
/begin COMPU_METHOD _CNV_A_R_LINEAR_____232_CM "" RAT_FUNC "%6.3" "" COEFFS 0 65535. 0. 0 0 1 /end COMPU_METHOD
/begin COMPU_METHOD _CNV_A_R_LINEAR_____247_CM "" RAT_FUNC "%6.3" "%/s" COEFFS 0 0.1024000154202376 128.000019275297 0 0 1 /end COMPU_METHOD
/begin COMPU_METHOD _CNV_A_R_LINEAR_____255_CM "" RAT_FUNC "%6.3" "" COEFFS 0 64. 0. 0 0 1 /end COMPU_METHOD
/begin COMPU_METHOD _CNV_A_R_LINEAR_____273_CM "" RAT_FUNC "%6.3" "Nm/rpm*rpm" COEFFS 0 134293032.7868853 0. 0 0 1 /end COMPU_METHOD
/begin COMPU_METHOD _CNV_A_R_LINEAR_____274_CM "" RAT_FUNC "%6.3" "m/s²" COEFFS 0 2084.478388983038 32768.00027481336 0 0 1 /end COMPU_METHOD
/begin COMPU_METHOD _CNV_A_R_LINEAR_____275_CM "" RAT_FUNC "%6.3" "-" COEFFS 0 32768. 0. 0 0 1 /end COMPU_METHOD
/begin COMPU_METHOD _CNV_S_6_STATE_TQ_D_276_CM "" TAB_VERB "%6.3" "" COMPU_TAB_REF _CNV_S_6_STATE_TQ_D_276 /end COMPU_METHOD
/begin COMPU_VTAB _CNV_S_6_STATE_TQ_D_276 "" TAB_VERB 6 0 "0" 1 "1" 8 "2" 9 "3" 10 "4" 11 "5" /end COMPU_VTAB
/begin COMPU_METHOD _CNV_A_R_LINEAR_____277_CM "" RAT_FUNC "%6.3" "-" COEFFS 0 4095.999963999451 32767.99971199561 0 0 1 /end COMPU_METHOD
/begin COMPU_METHOD _CNV_A_R_LINEAR_____278_CM "" RAT_FUNC "%6.3" "" COEFFS 0 1023.999989719843 0. 0 0 1 /end COMPU_METHOD
/begin COMPU_METHOD _CNV_A_R_LINEAR_____279_CM "" RAT_FUNC "%6.3" "s" COEFFS 0 25. 0. 0 0 1 /end COMPU_METHOD
/begin COMPU_METHOD _CNV_A_R_LINEAR_____280_CM "" RAT_FUNC "%6.3" "Nm" COEFFS 0 0.5 0. 0 0 1 /end COMPU_METHOD
/begin COMPU_METHOD _CNV_A_R_LINEAR_____281_CM "" RAT_FUNC "%6.3" "-" COEFFS 0 64. 128. 0 0 1 /end COMPU_METHOD
/begin COMPU_METHOD _CNV_A_R_LINEAR_____282_CM "" RAT_FUNC "%6.3" "°STW/s" COEFFS 0 22.75571737399022 32768. 0 0 1 /end COMPU_METHOD
/begin COMPU_METHOD _CNV_A_R_LINEAR_____283_CM "" RAT_FUNC "%6.3" "-" COEFFS 0 64. 0. 0 0 1 /end COMPU_METHOD
/begin COMPU_METHOD _CNV_A_R_LINEAR_____508_CM "" RAT_FUNC "%6.3" "kg/h" COEFFS 0 0.125 0. 0 0 1 /end COMPU_METHOD
/begin COMPU_METHOD _CNV_A_R_LINEAR_____537_CM "" RAT_FUNC "%6.3" "°C" COEFFS 0 0.5 0. 0 0 1 /end COMPU_METHOD
/begin COMPU_METHOD _CNV_A_R_LINEAR_____538_CM "" RAT_FUNC "%6.3" "K" COEFFS 0 32. 0. 0 0 1 /end COMPU_METHOD
/begin COMPU_METHOD _CNV_S_3_CYBL_RANGE_793_CM "" TAB_VERB "%6.3" "-" COMPU_TAB_REF _CNV_S_3_CYBL_RANGE_793 /end COMPU_METHOD
/begin COMPU_VTAB _CNV_S_3_CYBL_RANGE_793 "" TAB_VERB 3 0 "NEUTRAL" 1 "ENABLE" 2 "DISABLE" /end COMPU_VTAB
/begin COMPU_METHOD _CNV_S_4_CYBL_RANGE_794_CM "" TAB_VERB "%6.3" "-" COMPU_TAB_REF _CNV_S_4_CYBL_RANGE_794 /end COMPU_METHOD
/begin COMPU_VTAB _CNV_S_4_CYBL_RANGE_794 "" TAB_VERB 4 0 "Initialization" 1 "Lock" 2 "Wait" 3 "Cylinder Balancing" /end COMPU_VTAB
/begin COMPU_METHOD _CNV_S_5_CYBL_RANGE_795_CM "" TAB_VERB "%6.3" "-" COMPU_TAB_REF _CNV_S_5_CYBL_RANGE_795 /end COMPU_METHOD
/begin COMPU_VTAB _CNV_S_5_CYBL_RANGE_795 "" TAB_VERB 5 0 "Non" 1 "Additive" 2 "Additive AD" 3 "Multiple" 4 "Multiple AD" /end COMPU_VTAB
/begin RECORD_LAYOUT _REC_VAL_20_u1 FNC_VALUES 1 UBYTE COLUMN_DIR DIRECT /end RECORD_LAYOUT
/begin RECORD_LAYOUT _REC_VAL_20_u2 FNC_VALUES 1 UWORD COLUMN_DIR DIRECT /end RECORD_LAYOUT
/begin RECORD_LAYOUT _REC_AXS_20_u1 NO_AXIS_PTS_X 1 UBYTE AXIS_PTS_X 2 UBYTE INDEX_INCR DIRECT /end RECORD_LAYOUT
/begin RECORD_LAYOUT _REC_MAP_20_u2_u1_u1 FNC_VALUES 1 UWORD COLUMN_DIR DIRECT /end RECORD_LAYOUT
/begin RECORD_LAYOUT _REC_CUR_20_u1_u1 FNC_VALUES 1 UBYTE COLUMN_DIR DIRECT /end RECORD_LAYOUT
/begin RECORD_LAYOUT _REC_VAL_20_s2 FNC_VALUES 1 SWORD COLUMN_DIR DIRECT /end RECORD_LAYOUT
/begin RECORD_LAYOUT _REC_MAP_20_u2_u2_u1 FNC_VALUES 1 UWORD COLUMN_DIR DIRECT /end RECORD_LAYOUT
/begin RECORD_LAYOUT _REC_AXS_20_u2 NO_AXIS_PTS_X 1 UWORD AXIS_PTS_X 2 UWORD INDEX_INCR DIRECT /end RECORD_LAYOUT
/begin RECORD_LAYOUT _REC_CUR_20_u2_u1 FNC_VALUES 1 UWORD COLUMN_DIR DIRECT /end RECORD_LAYOUT
/begin RECORD_LAYOUT _REC_CUR_20_u2_u2 FNC_VALUES 1 UWORD COLUMN_DIR DIRECT /end RECORD_LAYOUT
/begin RECORD_LAYOUT _REC_MAP_20_u2_u1_u2 FNC_VALUES 1 UWORD COLUMN_DIR DIRECT /end RECORD_LAYOUT
/begin RECORD_LAYOUT _REC_CUR_20_u1_u2 FNC_VALUES 1 UBYTE COLUMN_DIR DIRECT /end RECORD_LAYOUT
/begin RECORD_LAYOUT _REC_MAP_20_u2_u2_u2 FNC_VALUES 1 UWORD COLUMN_DIR DIRECT /end RECORD_LAYOUT
/begin RECORD_LAYOUT _REC_MAP_20_u1_u2_u2 FNC_VALUES 1 UBYTE COLUMN_DIR DIRECT /end RECORD_LAYOUT
/begin RECORD_LAYOUT _REC_VAL_20_u4 FNC_VALUES 1 ULONG COLUMN_DIR DIRECT /end RECORD_LAYOUT
/begin RECORD_LAYOUT _REC_MAP_20_u1_u1_u1 FNC_VALUES 1 UBYTE COLUMN_DIR DIRECT /end RECORD_LAYOUT
/begin RECORD_LAYOUT _REC_MAP_20_u1_u2_u1 FNC_VALUES 1 UBYTE COLUMN_DIR DIRECT /end RECORD_LAYOUT
/begin FUNCTION SYS_Driving_off_assistance "_Driving off assistance"
 /begin DEF_CHARACTERISTIC ip_t_n_dif_ofs_pred_drof c_gear_max_fast_load_im c_vs_max_fast_load_im c_n_max_fast_load_im c_t_ast_min_fast_load_im lc_fast_load_im_is lc_ena_fast_load_im_n_sp ip_fac_vs_tq_add_pl_drof ip_fac_n_grd_tq_av ip_fac_tq_drof_fac_tq_req c_n_dif_drof_min c_n_dif_drof_max lc_tq_drof_isc_off id_tq_drof_ena c_tq_drof_min id_var_amt_load_im c_tq_drof_ad c_t_tq_drof_dly_ad ip_tq_add_pl_drof_opm_1 ip_tq_add_pl_drof_opm_2 ip_fac_temp_tq_add_drof_opm_1 ip_fac_temp_tq_add_drof_opm_2 ip_n_dif_add_drof_opm_1 ip_n_dif_add_drof_opm_2 id_idx_opm_drof ip_tq_drof_slow_opm_1 ip_tq_drof_slow_opm_2 ip_tq_drof_fast_opm_1 ip_tq_drof_fast_opm_2 ip_fac_tq_drof_vs_opm_1 ip_fac_tq_drof_vs_opm_2 ip_tq_drof_grd_deac_opm_1 ip_tq_drof_grd_deac_opm_2 /end DEF_CHARACTERISTIC
 /begin OUT_MEASUREMENT tq_add_pl_drof n_dif_pred_pl_drof lv_fast_load_im tq_drof_slow n_dif_drof lv_isc_off_drof tq_drof_fast lv_tq_drof_is_ad_inh /end OUT_MEASUREMENT
/end FUNCTION
/begin FUNCTION SYS_Power_Steering_acquisition_variable "_Power Steering acquisition variable"
 /begin DEF_CHARACTERISTIC c_ang_pste_end_le_ini c_ang_pste_end_ri_ini c_ang_pste_end_dif c_crlc_vel_ang_pste c_vel_ang_pste_min_1 c_vel_ang_pste_min_2 c_t_vel_ang_pste lc_vel_ang_pste_cor c_vs_pste c_vel_ang_pste_max_ad c_ang_pste_ad_lgrd c_t_ang_pste_ad /end DEF_CHARACTERISTIC
 /begin OUT_MEASUREMENT ang_pste_stnd ang_pste_end_ri_ad ang_pste_end_le_ad vel_ang_pste_cor vel_ang_pste_mmv t_vel_ang_pste lv_vel_ang_pste_min_det lv_stg_ri_act /end OUT_MEASUREMENT
/end FUNCTION
/begin FUNCTION SYS_Acquisition_of_exhaust_gas_temperature_downstream_of_pre_catalyst "_Acquisition of exhaust gas temperature downstream of pre-catalyst"
 /begin DEF_CHARACTERISTIC c_teg_pcat_down_st_ini ldp_maf_kgh_ip_teg_pcat_err ip_teg_pcat_down_add_err ldp_v_teg__teg ldp_v_teg__teg_wide_rng ip_teg__v_teg ip_teg_wide_rng__v_teg /end DEF_CHARACTERISTIC
 /begin OUT_MEASUREMENT teg_pcat_down_st teg_pcat_down_wide_rng_st teg_pcat_down_1 teg_pcat_down_2 teg_pcat_down_raw_1 teg_pcat_down_raw_2 teg_pcat_down_wide_rng_1 teg_pcat_down_wide_rng_2 /end OUT_MEASUREMENT
/end FUNCTION
/begin FUNCTION SYS_Fuel_pressure "_Fuel pressure"
 /begin DEF_CHARACTERISTIC ip_fup_mes ldp_v_fup_mv_ip_fup_mes c_fup_mes_crlc c_fup_ofs_lih_l_prs_ctl_req /end DEF_CHARACTERISTIC
 /begin OUT_MEASUREMENT fup_mes_mmv fup_mes v_fup_mv lv_fup_seg fup fup_h /end OUT_MEASUREMENT
/end FUNCTION
/begin FUNCTION SYS_Modeled_Fuel_Temperature "_Modeled Fuel Temperature"
 /begin DEF_CHARACTERISTIC c_tfu_sub_stop_ini ip_fac_vs_ecfpwm_ecf ldp_vs_ip_fac_vs_ecfpwm_ecf ldp_ecfpwm_ecf_ip_fac ip_fac_teg_t_es_teg_dyn_stop ldp_teg_dyn_stop_ip_fac_teg ldp_t_es_ip_fac_teg_t_es ldp_t_es_ip_fac_t_es c_crlc_fac_temp_dif_tco_tia c_crlc_fac_vff_mff_sp_fup_ctl ip_fac_t_es ip_fac_vff_mff_sp_fup_ctl ldp_vff_mff_sp_fup_ctl ip_crlc_tfu_t_ast_vff_mff_sp ldp_t_ast_ip_crlc_tfu_vff_mff ldp_vff_mff_sp_fup_ctl_ip_crlc ip_tco_temp_dif_tco_tia ldp_temp_dif_tco_tia_ip_tco c_crlc_fac_vs_ecfpwm_ecf c_t_tfu_clc ip_d_tiv_norm_n_mff_sp ip_temp_dif_n_mff_sp_iv ip_fac_tiv_ewp_cor ip_fac_temp_iv_cwp_cor ip_fac_tiv_tco_cor ip_fac_tco_temp_iv_cor c_crlc_fac_temp_iv c_crlc_fac_tfu_iv_sub lc_tfu_tia_tco_ex lc_tco_tfu_iv_sub ldp_n_ip_d_tiv_norm_n_mff_sp ldp_n_ip_temp_dif_iv ldp_mff_sp_ip_d_tiv_norm_n_mff ldp_mff_sp_ip_temp_dif_iv ldp_tiv_tco_cor_ip_fac_tiv_tco ldp_tco_ip_fac_tco_temp_iv_cor ldp_tiv_ewp_cor_ip_fac_tiv_ewp ldp_n_ip_fac_temp_iv_cwp_cor c_tfu_efp_ofs /end DEF_CHARACTERISTIC
 /begin OUT_MEASUREMENT tfu tfu_sub_stop temp_dif_tco_tia tfu_lpf_tco tfu_raw tfu_add_fuel_flow temp_fuel_rail_wall tfu_ofs_air temp_fuel_rail_sub tfu_iv_sub tfu_iv tfu_efp /end OUT_MEASUREMENT
/end FUNCTION
/begin FUNCTION SYS_Fuel_pres_acq_ele_fuel_pump "Fuel_pres_acq_ele_fuel_pump"
 /begin DEF_CHARACTERISTIC c_fup_efp_mes_crlc ldp_v_fup_efp_ip_fup_efp ip_fup_efp c_fup_efp_lih /end DEF_CHARACTERISTIC
 /begin OUT_MEASUREMENT fup_efp fup_efp_mes fup_efp_mmv v_fup_efp_mv /end OUT_MEASUREMENT
/end FUNCTION
/begin FUNCTION C_9_INJ "" /begin SUB_FUNCTION INJ_Cyl_Bal_Mng INJ_Cyl_Bal_Mng_AI /end SUB_FUNCTION /end FUNCTION
/begin FUNCTION INJ_Cyl_Bal_Mng "_Cyl_Bal_Mng"
 /begin DEF_CHARACTERISTIC c_tco_max_ti_er_bal c_tco_min_fac_ti_ad_er_bal c_tco_min_ti_add_ad_er_bal c_er_stnd_mmv_max_ti_er_bal c_er_std_mmv_max_ti_er_bal lc_ti_add_er_bal_ena c_tco_min_ti_er_bal c_mff_sp_max_fac_ti_er_bal c_mff_sp_min_fac_ti_ad_er_bal c_mff_sp_max_fac_ti_ad_er_bal c_mff_sp_min_fac_ti_er_bal c_mff_sp_max_ti_add_er_bal c_mff_sp_min_ti_add_ad_er_bal c_mff_sp_max_ti_add_ad_er_bal c_mff_sp_min_ti_add_er_bal c_n_32_min_ti_add_er_bal c_n_32_max_ti_add_er_bal c_n_32_max_ti_add_ad_er_bal c_n_32_min_ti_add_ad_er_bal c_n_32_min_fac_ti_er_bal c_n_32_max_fac_ti_er_bal c_n_32_max_fac_ti_ad_er_bal c_n_32_min_fac_ti_ad_er_bal ldp_n_32_ip_ctr_ti_er_bal_ini ip_ctr_ti_er_bal_ena_ini /end DEF_CHARACTERISTIC
 /begin OUT_MEASUREMENT lv_ti_er_bal_ena lv_ti_add_er_bal_ena lv_ti_add_ad_er_bal_ena lv_fac_ti_er_bal_ena lv_fac_ti_ad_er_bal_ena ctr_ti_er_bal_ena lv_er_stnd_mmv_max_ti_er_bal lv_er_std_mmv_max_ti_er_bal state_ti_er_bal state_ctl_ti_er_bal /end OUT_MEASUREMENT
/end FUNCTION
/begin FUNCTION INJ_Cyl_Bal_Mng_AI "_Cyl_Bal_Mng_AI"
 /begin DEF_CHARACTERISTIC c_er_stnd_er_bal_act_man c_drv1_er_bal_act_man c_ti_er_bal_act_man c_tqi_min_ti_er_bal c_tqi_max_ti_er_bal c_t_ast_min_ti_er_bal lc_ti_er_bal_stop_man /end DEF_CHARACTERISTIC
 /begin OUT_MEASUREMENT lv_er_stnd_er_bal_act lv_drv1_er_bal_act lv_ti_er_bal_act lv_ti_er_bal_ena_ext lv_ti_add_ad_er_bal_ena_ext lv_fac_ti_ad_er_bal_ena_ext lv_ti_cyl_bal_er_act lv_ti_cyl_bal_lam_act /end OUT_MEASUREMENT
/end FUNCTION
/begin FUNCTION C_6_CYBL "" /begin SUB_FUNCTION CYBL_Eng_Rough_for_Cyl_Bal /end SUB_FUNCTION /end FUNCTION
/begin FUNCTION CYBL_Eng_Rough_for_Cyl_Bal "_CYBL_Eng_Rough_for_Cyl_Bal"
 /begin DEF_CHARACTERISTIC c_crlc_er_stnd_bal c_crlc_er_std_bal c_crlc_er_std_mmv_bal c_fac_er_std_neg_bal c_fac_er_std_pos_bal c_ctr_dly_drv1_stnd_bal_dec ldp_drv1_stnd_bal_ip_dly_bal ip_dly_drv1_stnd_bal /end DEF_CHARACTERISTIC
 /begin OUT_MEASUREMENT er_stnd_bal er_stnd_fil_bal er_stnd_mmv_bal[0] er_stnd_mmv_bal[1] er_stnd_mmv_bal[2] er_stnd_mmv_bal[3] er_stnd_mmv_bal[4] er_stnd_mmv_bal[5] er_stnd_mmv_mv_bal er_stnd_mmv_dif_bal[0] er_stnd_mmv_dif_bal[1] er_stnd_mmv_dif_bal[2] er_stnd_mmv_dif_bal[3] er_stnd_mmv_dif_bal[4] er_stnd_mmv_dif_bal[5] er_stnd_mmv_std_bal[0] er_stnd_mmv_std_bal[1] er_stnd_mmv_std_bal[2] er_stnd_mmv_std_bal[3] er_stnd_mmv_std_bal[4] er_stnd_mmv_std_bal[5] er_std_dif_bal er_std_bal[0] er_std_bal[1] er_std_bal[2] er_std_bal[3] er_std_bal[4] er_std_bal[5] er_std_mmv_bal[0] er_std_mmv_bal[1] er_std_mmv_bal[2] er_std_mmv_bal[3] er_std_mmv_bal[4] er_std_mmv_bal[5] drv1_stnd_bal dly_drv1_stnd_bal ctr_dly_drv1_stnd_bal lv_drv1_stnd_bal_fdout /end OUT_MEASUREMENT
/end FUNCTION
/begin FUNCTION C_D_TQM "C_D_TQM"
 /begin SUB_FUNCTION TQM_Torque_request_for_gear_shift_intervention TQM_Initialization_module TQM_Torque_control_at_engine_start TQM_Reference_and_basic_torque TQM_Torque_loss_and_reserve_for_ACC TQM_Torque_based_pattern_calculation TQM_Minimum_torque_at_clutch TQM_Converter_torque TQM_Pedal_value_interpretation TQM_Maximum_torque_at_clutch TQM_Torque_Request_at_Clutch_General TQM_Actual_Engine_Torque TQM_Engine_torque_limitation TQM_Torque_Request_for_Cruise_Control TQM_Torque_Request_for_safety TQM_Torque_loss_for_power_steering TQM_Torque_Monitoring_Limitation_and_Coordination TQM_Application_incidences_for_torque_based_pattern_calculation TQM_Torque_Transient TQM_Torque_request_for_distance_cruise_control TQM_AMT_Clutch_torque TQM_Torque_request_for_AMT_intervention TQM_Minimum_indicated_engine_torque_at_trailing_throttle TQM_Torque_Request_for_Traction_Control_TCS TQM_Torque_Loss___Anti_Roll_Stabilisation TQM_TQ_Based_CH_For_Desulf TQM_Torque_Request_for_LDM TQM_General_Flag_for_inhibition_of_external_torque_request /end SUB_FUNCTION
/end FUNCTION
/begin FUNCTION TQM_Torque_request_for_gear_shift_intervention "_Torque request for gear shift intervention"
 /begin DEF_CHARACTERISTIC c_t_max_tqr_gs_intv c_gs_ena_inc_dec c_lgrd_lih_gs_dec c_lgrd_lih_gs_inc c_t_dly_lih_gs_dec c_t_dly_lih_gs_inc /end DEF_CHARACTERISTIC
 /begin OUT_MEASUREMENT lv_etcu_disable lv_etcu_disable_can lv_gs_ena_dec lv_gs_ena tqi_gs_fast_dec_req_1 tqi_gs_slow_dec_req tqi_gs_fast_inc_req_1 tqi_gs_slow_inc_req t_tqr_gs_intv tqi_gs_fast_dec_req tqi_gs_fast_dec tqi_gs_slow_dec_req_1 tqi_gs_slow_dec lv_gs_ena_inc lv_gs_dec_lih tqi_gs_fast_inc_req tqi_gs_fast_inc tqi_gs_slow_inc_req_1 tqi_gs_slow_inc lv_gs_dec_act lv_gs_inc_lih lv_gs_inc_act t_gs_inc_lih_ctr t_gs_dec_lih_ctr state_tq_etcu_plaus /end OUT_MEASUREMENT
/end FUNCTION
/begin FUNCTION TQM_Initialization_module "_Initialization module"
 /begin OUT_MEASUREMENT tqi_vs_max tq_loss_scha lv_tq_loss_acc_inp_orng lv_iga_ch_so2p_stb lamb_bas_cor_max lv_can_gs_ack lv_acp_orng eff_egr_s eff_pha_s tq_ad_add_s_swi tqi_cat_prot tq_loss_thermo tq_loss_win_heat tqi_p_max /end OUT_MEASUREMENT
/end FUNCTION
/begin FUNCTION TQM_Torque_control_at_engine_start "_Torque control at engine start"
 /begin DEF_CHARACTERISTIC c_crlc_tq_st ip_tq_st_mt_opm_2 ip_tq_st_mt_opm_1 ip_tq_st_at_opm_1 ip_tq_st_at_opm_2 id_opm_av_tq_st /end DEF_CHARACTERISTIC
 /begin OUT_MEASUREMENT tq_st_1 tq_st opm_av_sel_tq_st /end OUT_MEASUREMENT
/end FUNCTION
/begin FUNCTION TQM_Reference_and_basic_torque "_Reference and basic torque" /begin DEF_CHARACTERISTIC lc_mod_eff_av /end DEF_CHARACTERISTIC
 /begin OUT_MEASUREMENT tqi_bas tqi_ref_iga tqi_ref_iga_lamb tqi_ref_iga_min_lamb tqi_ref_iga_scc tqi_ref_lamb tqi_ref_lamb_scc tqi_ref_scc eff_tot_bas eff_tot_bas_slow tqi_ref lv_tq_iga_ena fac_cam_ch fac_eff_iga_ch lv_map_puc_lim_act_lsl_gain_ad /end OUT_MEASUREMENT
/end FUNCTION
/begin FUNCTION TQM_Torque_loss_and_reserve_for_ACC "_Torque loss and reserve for ACC"
 /begin DEF_CHARACTERISTIC ip_fac_tq_loss_acc_on ip_fac_tq_loss_acc_off ip_tq_add_acc ip_tq_add_heat_acc c_tq_add_acc_lgrd c_tq_add_heat_acc_lgrd c_tco_min_req_heat_acc c_tam_min_req_heat_acc c_tq_loss_max_acc c_crlc_tq_loss_acc_inp c_tq_add_acc_lgrd_on c_t_req_heat_acc /end DEF_CHARACTERISTIC
 /begin OUT_MEASUREMENT tq_add_acc tq_loss_acc tq_add_heat_acc lv_tout_acc lv_req_heat_acc_ena lv_tout_req_heat_acc t_req_heat_acc tq_loss_acc_inp /end OUT_MEASUREMENT
/end FUNCTION
/begin FUNCTION TQM_Torque_based_pattern_calculation "_Torque based pattern calculation"
 /begin DEF_CHARACTERISTIC lc_eff_scc_sp_man lc_eff_scc_bas_swi_clc lc_inh_fcut_fast lc_ena_eff_scc_bas_man c_eff_scc_sp_hys c_eff_scc_bas_man lc_ena_fcut_tot_gs lc_inh_fcut_gs_iga lc_inh_fcut_asr lc_ena_fcut_tot_asr lc_inh_fcut_n_max lc_tq_scc_inh_man lc_ena_fcut_tot_fast lc_tq_scc_ena_man c_eff_scc_sp_man c_fac_iga_min_teg_iga_bas c_hys_eff_iga_min_teg c_min_dec_eff_iga_min_teg_1 c_min_dec_eff_iga_min_teg_2 id_nr_pat_scc lc_inh_fcut_gs lc_inh_fcut_amt lc_inh_fcut_dcc lc_ena_fcut_tot_n_max lc_ena_fcut_tot_amt lc_ena_fcut_tot_dcc lc_inh_fcut_ldm lc_ena_fcut_tot_ldm /end DEF_CHARACTERISTIC
 /begin OUT_MEASUREMENT eff_scc_av eff_scc_av_can eff_scc_sp_hys eff_scc_bas fac_iga_min_teg_iga_bas lv_auth_tq_pat nr_pat_scc eff_scc_sp sum_inh_iv_tot sum_inh_iv_bas inh_iv_tot t_max_fcut_fast /end OUT_MEASUREMENT
/end FUNCTION
/begin FUNCTION TQM_Minimum_torque_at_clutch "_Minimum torque at clutch"
 /begin DEF_CHARACTERISTIC c_n_dif_tq_st_1 c_n_dif_tq_st_2 ip_fac_n_dif_is ip_tqi_min_req_pu lc_tq_loss_min_clu lc_tq_loss_min_clu_1 lc_tq_loss_min_clu_is lc_inh_pu_req lc_inh_puc_req /end DEF_CHARACTERISTIC
 /begin OUT_MEASUREMENT tq_min_clu tq_min_clu_1 tq_min_clu_2 fac_n_dif_is lv_tq_min_clu tqi_min_req_pu tq_min_req_pu /end OUT_MEASUREMENT
/end FUNCTION
/begin FUNCTION TQM_Converter_torque "_Converter torque"
 /begin DEF_CHARACTERISTIC c_tq_add_conv_lgrd ip_tq_add_conv lc_tq_conv_dri_inh lc_tq_conv_can_inh ip_fac_conv__toil ip_fac_conv_dri__toil ip_t_dly_conv__toil ip_t_dly_n_sp_is__toil ip_fac_tq_conv__n_ratio_conv ip_n_tur__gr_at__vs ip_tq_conv_can ip_t_ramp_conv_neg__toil ip_t_ramp_conv_pos__toil ip_tq_add_conv_ac ip_tq_add_conv_n_grd ip_fac_tq_add_conv_toil /end DEF_CHARACTERISTIC
 /begin OUT_MEASUREMENT tq_conv_can_1 tq_add_conv lv_tout_conv t_conv tq_add_trans lv_dly_n_sp_is tq_conv_stn tq_conv tq_add_conv_2 /end OUT_MEASUREMENT
/end FUNCTION
/begin FUNCTION TQM_Pedal_value_interpretation "_Pedal value interpretation"
 /begin DEF_CHARACTERISTIC ip_fac_tq_req_driv_rng_l ip_fac_tq_req_driv c_fac_tq_req_driv_sof_max c_pv_av_grd_sof_max c_t_pv_av_grd_sof_max lc_rng_l_man_as c_pv_cus_sof_min /end DEF_CHARACTERISTIC
 /begin OUT_MEASUREMENT fac_tq_req_driv lv_rng_l_req /end OUT_MEASUREMENT
/end FUNCTION
/begin FUNCTION TQM_Maximum_torque_at_clutch "_Maximum torque at clutch" /begin OUT_MEASUREMENT tqi_ref_max tq_max_clu /end OUT_MEASUREMENT /end FUNCTION
/begin FUNCTION TQM_Torque_Request_at_Clutch_General "_Torque Request at Clutch General" /begin OUT_MEASUREMENT fac_tq_req_clu lv_tq_cru_act fac_tq_req /end OUT_MEASUREMENT /end FUNCTION
/begin FUNCTION TQM_Actual_Engine_Torque "_Actual Engine Torque" /begin DEF_CHARACTERISTIC c_fac_tqe /end DEF_CHARACTERISTIC
 /begin OUT_MEASUREMENT tq_av tqe tqe_dif eff_tot_av tqi_av_hom eff_lamb_av eff_lamb_bas_cor tqi_av_s tqi_ref_s eff_lamb_sp_bas tqi_sp_maf tqi_min_s tqi_av /end OUT_MEASUREMENT
/end FUNCTION
/begin FUNCTION TQM_Engine_torque_limitation "_Engine torque limitation"
 /begin DEF_CHARACTERISTIC ip_tq_lim_amt ip_tq_lim_at c_t_tq_lim lc_tqi_p_max_inh_as id_tq_p_max_mt id_tq_p_max_at c_tq_lim_at_lgrd /end DEF_CHARACTERISTIC
/end FUNCTION
/begin FUNCTION TQM_Torque_Request_for_Cruise_Control "_Torque Request for Cruise Control" /begin DEF_CHARACTERISTIC c_lgrd_tq_cru_inc_1 c_lgrd_tq_cru_inc_2 c_fac_dcc_fl /end DEF_CHARACTERISTIC
 /begin OUT_MEASUREMENT fac_tq_req_cru fac_tq_req_dcc state_tq_dcc lv_tq_dcc_act tq_delta_max_clu state_tq_ldm /end OUT_MEASUREMENT
/end FUNCTION
/begin FUNCTION TQM_Torque_Request_for_safety "_Torque Request for safety"
 /begin DEF_CHARACTERISTIC lc_tq_lim_inh lc_tq_lim_inh_fast lc_tq_lim_inh_slow c_tqi_req_lim_pas c_tq_lim_inc c_tq_lim_dec c_t_tq_lim_intv ip_tqi_dif_lim c_tqi_dif_lim_max_ofs c_dec_tqi_lim_dif_max /end DEF_CHARACTERISTIC
 /begin OUT_MEASUREMENT t_tq_lim_intv sum_tqi_req_lim tqi_req_lim_4 tqi_req_lim_slow tqi_req_lim_3 lv_tq_lim_intv tqi_req_lim_1 tqi_req_lim_2 tqi_dif_lim t_tqi_req_lim t_tqi_req_lim_max tqi_req_lim_fast tqi_req_lim_dif tqi_req_lim_dif_max lv_tq_lim_intv_1 lv_tq_lim_intv_2 tqi_req_lim_dif_ofs /end OUT_MEASUREMENT
/end FUNCTION
/begin FUNCTION TQM_Torque_loss_for_power_steering "_Torque loss for power steering"
 /begin DEF_CHARACTERISTIC lc_pste_ena ip_tq_add_pste lc_pste_2_ena ldpm_n_32__pste_2 ldpm_t_pste_2__pste_2 ip_fac_tq_loss_pste_2_sp ip_fac_tq_loss_pste_2_av c_fac_tq_loss_pste_2_grd c_fac_tq_loss_pste_2_dif c_tq_add_pste_1_lih ip_fac_tq_loss_pste ip_tq_add_pste_2 ip_tq_add_pste_2_lih ip_tq_loss_pste ip_fac_tq_add_pste_2_vs ip_fac_tq_loss_pste_2 ip_fac_tq_loss_pste_2_vs ip_tq_loss_pste_2 ip_fac_tq_loss_pste_2_ang c_tq_loss_pste_2_sp_min lc_tq_loss_pste_2_swi c_tq_loss_pste_1_lih c_tq_loss_pste_2_lih c_tq_add_pste_ad c_tq_loss_pste_ad c_t_pste_dly_ad lc_pste_2_man_act ldpm_n_32__pste_2_1 /end DEF_CHARACTERISTIC
 /begin OUT_MEASUREMENT tq_loss_pste lv_pste_disable lv_pste_disable_can lv_pste_ena tq_loss_pste_1 lv_pste_2_disable lv_pste_2_disable_can lv_pste_2_ena tq_loss_pste_2_av tq_loss_pste_2_sp tq_loss_pste_2_dif tq_loss_pste_2_grd t_pste_2 tq_add_pste tq_add_pste_1 tq_add_pste_2 tq_loss_pste_2 tq_loss_pste_2_raw state_tq_pste_2_plaus lv_tq_loss_pste_is_ad_inh lv_tq_add_pste_is_ad_inh /end OUT_MEASUREMENT
/end FUNCTION
/begin FUNCTION TQM_Torque_Monitoring_Limitation_and_Coordination "_Torque Monitoring Limitation and Coordination" /begin DEF_CHARACTERISTIC c_tq_ad_add_s_swi /end DEF_CHARACTERISTIC /end FUNCTION
/begin FUNCTION TQM_Application_incidences_for_torque_based_pattern_calculation "_Application incidences for torque based pattern calculation"
 /begin DEF_CHARACTERISTIC c_maf_dif_min_fcut_fast c_tco_min_fcut_fast c_t_max_fcut_fast c_vs_min_fcut_fast id_maf_n_min_fcut_fast /end DEF_CHARACTERISTIC
 /begin OUT_MEASUREMENT lv_cs_chg lv_fcut_fast lv_ct_chg /end OUT_MEASUREMENT
/end FUNCTION
/begin FUNCTION TQM_Torque_Transient "_Torque Transient" /end FUNCTION
/begin FUNCTION TQM_Torque_request_for_distance_cruise_control "_Torque request for distance cruise control" /begin DEF_CHARACTERISTIC c_lgrd_lih_dcc_inc c_t_dly_lih_dcc_inc /end DEF_CHARACTERISTIC
 /begin OUT_MEASUREMENT lv_dcc_disable_can tqi_dcc_fast_inc_req tqi_dcc_slow_inc_req tqi_dcc_fast_inc lv_dcc_ena_inc lv_dcc_inc_act tqi_dcc_slow_inc lv_dcc_inc_lih t_dcc_lih_ctr lv_err_bn_tq_dcc state_tq_dcc_plaus /end OUT_MEASUREMENT
/end FUNCTION
/begin FUNCTION TQM_AMT_Clutch_torque "_AMT Clutch torque"
 /begin DEF_CHARACTERISTIC ip_tq_amt ip_tq_vs_fil_amt ip_tq_add_amt c_tq_thd_amt_isc c_tq_add_amt_lgrd c_tq_lgrd_crawl_inc c_tq_lgrd_crawl_dec /end DEF_CHARACTERISTIC
 /begin OUT_MEASUREMENT tq_clu_amt lv_amt_crawl_on tq_add_amt lv_tout_amt t_amt /end OUT_MEASUREMENT
/end FUNCTION
/end MODULE
/end PROJECT
