ASAP2_VERSION 1 3
/begin PROJECT P411 "BMW DDE6.0 6-Zylinder V66.1 07.01.2004 CAN12H"
/begin HEADER "" VERSION "V571_6Z_CAN12H" PROJECT_NO P411 /end HEADER
/begin MODULE DIM ""
/begin MOD_COMMON "" BYTE_ORDER MSB_FIRST ALIGNMENT_BYTE 1 ALIGNMENT_WORD 2 ALIGNMENT_LONG 4 ALIGNMENT_FLOAT32_IEEE 4 /end MOD_COMMON
/begin CHARACTERISTIC EngPrt_dTrqLimUp_C "ramp slope up" VALUE 0xD01AC Kw_Wu32 6553594.99817 RmpTrq 5.00030517578 6553599.99847 FORMAT "%13.5" EXTENDED_LIMITS 0.00 6553599.99847 /end CHARACTERISTIC
/begin CHARACTERISTIC EngPrt_dTrqLimDown_C "ramp slope down" VALUE 0xD01B0 Kw_Wu32 6553594.99817 RmpTrq 5.00030517578 6553599.99847 FORMAT "%13.5" EXTENDED_LIMITS 0.00 6553599.99847 /end CHARACTERISTIC
/begin CHARACTERISTIC EngPrt_facAPSPrv_MAP "Kennfeld für Überhitzungsschutz in Abhängigkeit des Atmosphärendrucks" MAP 0xD01B4 Kf_Xs16_Ys16_Ws16 3.999878 Fact 0.00 3.999878 FORMAT "%8.6" EXTENDED_LIMITS -4.000000 3.999878
 /begin AXIS_DESCR STD_AXIS APSCD_pVal Pres_hPa 9 -32768.00 32767.00 FORMAT "%8.2" DEPOSIT ABSOLUTE /end AXIS_DESCR
 /begin AXIS_DESCR STD_AXIS Eng_nAvrg EngN 9 0.00 32767.00 FORMAT "%8.2" EXTENDED_LIMITS -32768.00 32767.00 DEPOSIT ABSOLUTE /end AXIS_DESCR
/end CHARACTERISTIC
/begin CHARACTERISTIC EngPrt_facOvhtPrvCT_CUR "Überhitzungsschutz-Kennlinie Kühlwassertemperatur in Faktor" CURVE 0xD056A Kl_Xs16_Ws16 1.000000 Fact 0.00 1.000000 FORMAT "%8.6" EXTENDED_LIMITS -4.000000 3.999878
 /begin AXIS_DESCR STD_AXIS CTSCD_tClnt Temp_Cels 25 -50.14000 199.8600 FORMAT "%8.4" EXTENDED_LIMITS -3549.940 3003.560 DEPOSIT ABSOLUTE /end AXIS_DESCR
/end CHARACTERISTIC
/begin CHARACTERISTIC EngPrt_facOvhtPrvFT_CUR "Überhitzungsschutz-Kennlinie Kraftstofftemperatur in Faktor" CURVE 0xD05D0 Kl_Xs16_Ws16 1.000000 Fact 0.00 1.000000 FORMAT "%8.6" EXTENDED_LIMITS -4.000000 3.999878
 /begin AXIS_DESCR STD_AXIS FTSCD_tFuel Temp_Cels 25 -50.14000 199.8600 FORMAT "%8.4" EXTENDED_LIMITS -3549.940 3003.560 DEPOSIT ABSOLUTE /end AXIS_DESCR
/end CHARACTERISTIC
/begin CHARACTERISTIC EngPrt_facOvhtPrvOT_CUR "Überhitzungsschutz-Kennlinie Motoröltemperatur in Faktor" CURVE 0xD0636 Kl_Xs16_Ws16 1.000000 Fact 0.00 1.000000 FORMAT "%8.6" EXTENDED_LIMITS -4.000000 3.999878
 /begin AXIS_DESCR STD_AXIS OTSCD_tEngOil Temp_Cels 25 -50.14000 199.8600 FORMAT "%8.4" EXTENDED_LIMITS -3549.940 3003.560 DEPOSIT ABSOLUTE /end AXIS_DESCR
/end CHARACTERISTIC
/begin CHARACTERISTIC EngPrt_facOvhtPrv_MAP "Map for overheating prevention factor of engine" MAP 0xD027E Kf_Xs16_Ys16_Ws16 3.999878 Fact 0.00 3.999878 FORMAT "%8.6" EXTENDED_LIMITS -4.000000 3.999878
 /begin AXIS_DESCR STD_AXIS Eng_tEng Temp_Cels 7 -50.140 899.860 FORMAT "%8.3" EXTENDED_LIMITS -3549.940 3003.560 DEPOSIT ABSOLUTE /end AXIS_DESCR
 /begin AXIS_DESCR STD_AXIS VSSCD_v Vel 7 0.00 327.6700 FORMAT "%8.4" EXTENDED_LIMITS -327.6800 327.6700 DEPOSIT ABSOLUTE /end AXIS_DESCR
/end CHARACTERISTIC
/begin CHARACTERISTIC EngPrt_nOvrSpd_C "#SSD Schwelle für Überdrehzahlerkennung" VALUE 0xD0300 Kw_Ws16 6000.000 EngN 0.00 6000.000 FORMAT "%8.3" EXTENDED_LIMITS -32768.00 32767.00 /end CHARACTERISTIC
/begin CHARACTERISTIC EngPrt_nTrqShutOff_C "threshold value of engine speed for fly wheel oscillation detection" VALUE 0xD0564 Kw_Ws16 6000.000 EngN 0.00 6000.000 FORMAT "%8.3" EXTENDED_LIMITS -32768.00 32767.00 /end CHARACTERISTIC
/begin CHARACTERISTIC EngPrt_pAPSPrvDfl_C "Default-Wert bei Ausfall des Atmosphärendrucksensors" VALUE 0xD0302 Kw_Ws16 3500.000 Pres_hPa 0.00 3500.000 FORMAT "%8.3" EXTENDED_LIMITS -32768.00 32767.00 /end CHARACTERISTIC
/begin CHARACTERISTIC EngPrt_qOvhtPrvNRng_MAP "Überhitzungsschutz-Kennfeld für Drehzahl" MAP 0xD069C Kf_Xs16_Ys16_Ws16 327.6700 InjMass 0.00 327.6700 FORMAT "%8.4" EXTENDED_LIMITS -327.6800 327.6700
 /begin AXIS_DESCR STD_AXIS Eng_nAvrg EngN 16 40.00000 6000.000 FORMAT "%8.3" EXTENDED_LIMITS -32768.00 32767.00 DEPOSIT ABSOLUTE /end AXIS_DESCR
 /begin AXIS_DESCR STD_AXIS EngPrt_facOvhtPrv_mp Fact 16 0.00 1.000000 FORMAT "%8.6" EXTENDED_LIMITS -4.000000 3.999878 DEPOSIT ABSOLUTE /end AXIS_DESCR
/end CHARACTERISTIC
/begin CHARACTERISTIC EngPrt_qOvhtPrvVRng_MAP "Überhitzungsschutz-Kennfeld für Fahrzeuggeschwindigkeit" MAP 0xD08E0 Kf_Xs16_Ys16_Ws16 327.6700 InjMass 0.00 327.6700 FORMAT "%8.4" EXTENDED_LIMITS -327.6800 327.6700
 /begin AXIS_DESCR STD_AXIS EngPrt_facOvhtPrv_mp Fact 16 0.00 1.000000 FORMAT "%8.6" EXTENDED_LIMITS -4.000000 3.999878 DEPOSIT ABSOLUTE /end AXIS_DESCR
 /begin AXIS_DESCR STD_AXIS VSSCD_v Vel 16 0.00 300.0000 FORMAT "%8.4" EXTENDED_LIMITS -327.6800 327.6700 DEPOSIT ABSOLUTE /end AXIS_DESCR
/end CHARACTERISTIC
/begin CHARACTERISTIC EngPrt_qPrtLim_Vector "#SSD Bypass Label, nicht ändern!" VALUE 0xC2EBA Kw_Wu8 255.0 OneToOne 0.00 255.0 FORMAT "%5.1" /end CHARACTERISTIC
/begin CHARACTERISTIC EngPrt_qPrtLim_Channel "#SSD Bypass Label, nicht ändern!" VALUE 0xC2EBB Kw_Wu8 255.0 OneToOne 0.00 255.0 FORMAT "%5.1" /end CHARACTERISTIC
/begin CHARACTERISTIC EngPrt_dtrqUpCBLim_C "Positiv rampensteigung fuer Drehmomentbegrenzung bei Verdichterbypass oeffnen" VALUE 0xD0304 Kw_Wu32 6553594.99817 RmpTrq 5.00030517578 6553599.99847 FORMAT "%13.5" EXTENDED_LIMITS 0.00 6553599.99847 /end CHARACTERISTIC
/begin CHARACTERISTIC EngPrt_dtrqDwnCBLim_C "Negativ rampensteigung fuer Drehmomentbegrenzung bei Verdichterbypass oeffnen" VALUE 0xD0308 Kw_Wu32 6553594.99817 RmpTrq 5.00030517578 6553599.99847 FORMAT "%13.5" EXTENDED_LIMITS 0.00 6553599.99847 /end CHARACTERISTIC
/begin CHARACTERISTIC EngPrt_dtrqUpNLim_C "Rampenanstieg von Ersatzkennlinie auf Normalkennlinie der Motordrehzahlbegrenzung" VALUE 0xD030C Kw_Wu32 6553594.99817 RmpTrq 5.00030517578 6553599.99847 FORMAT "%13.5" EXTENDED_LIMITS 0.00 6553599.99847 /end CHARACTERISTIC
/begin CHARACTERISTIC EngPrt_dtrqDwnNLim_C "Rampenanstieg von Normalkennlinie zur Ersatzkennlinie der Motordrehzahlbegrenzung" VALUE 0xD0310 Kw_Wu32 6553594.99817 RmpTrq 5.00030517578 6553599.99847 FORMAT "%13.5" EXTENDED_LIMITS 0.00 6553599.99847 /end CHARACTERISTIC
/begin CHARACTERISTIC EngPrt_rVnDAMax_C "Maximum v/n Verhältnis" VALUE 0xD0314 Kw_Ws16 0.3276700 VelToN 0.00 0.3276700 FORMAT "%9.7" EXTENDED_LIMITS -0.3276800 0.3276700 /end CHARACTERISTIC
/begin CHARACTERISTIC EngPrt_rVnDAMin_C "Minimum v/n Verhältnis" VALUE 0xD0316 Kw_Ws16 0.3276700 VelToN 0.00 0.3276700 FORMAT "%9.7" EXTENDED_LIMITS -0.3276800 0.3276700 /end CHARACTERISTIC
/begin CHARACTERISTIC EngPrt_rVnTrqMax_C "Maximum v/n Verhältnis" VALUE 0xD0318 Kw_Ws16 0.3276700 VelToN 0.00 0.3276700 FORMAT "%9.7" EXTENDED_LIMITS -0.3276800 0.3276700 /end CHARACTERISTIC
/begin CHARACTERISTIC EngPrt_rVnTrqMin_C "Minimum v/n Verhältnis" VALUE 0xD031A Kw_Ws16 0.3276700 VelToN 0.00 0.3276700 FORMAT "%9.7" EXTENDED_LIMITS -0.3276800 0.3276700 /end CHARACTERISTIC
/begin CHARACTERISTIC EngPrt_swtTrqGear_CUR "applizierbare Gänge: Wert = 0 nicht aktiv; Wert = 1 aktiv" CURVE 0xD031C Kl_Xs16_Ws16 32767.00 OneToOne 0.00 32767.00 FORMAT "%8.2" EXTENDED_LIMITS -32768.00 32767.00
 /begin AXIS_DESCR STD_AXIS Gearbx_stGear OneToOne 8 -1.000 127.0 FORMAT "%5.1" EXTENDED_LIMITS -128.0 127.0 DEPOSIT ABSOLUTE /end AXIS_DESCR
/end CHARACTERISTIC
/begin CHARACTERISTIC EngPrt_trqCBLim1_CUR "Drehmomentbegrenzung bei geoeffnetem Verdichterbypass" CURVE 0xD033E Kl_Xs16_Ws16 3276.700 Trq 0.00 3276.700 FORMAT "%8.3" EXTENDED_LIMITS -3276.800 3276.700
 /begin AXIS_DESCR STD_AXIS Eng_nAvrg EngN 20 0.00 32767.00 FORMAT "%8.2" EXTENDED_LIMITS -32768.00 32767.00 DEPOSIT ABSOLUTE /end AXIS_DESCR
/end CHARACTERISTIC
/begin CHARACTERISTIC EngPrt_trqCBLim_CUR "Drehmomentbegrenzung bei geoeffnetem Verdichterbypass" CURVE 0xD0390 Kl_Xs16_Ws16 3276.700 Trq 0.00 3276.700 FORMAT "%8.3" EXTENDED_LIMITS -3276.800 3276.700
 /begin AXIS_DESCR STD_AXIS Eng_nAvrg EngN 20 0.00 32767.00 FORMAT "%8.2" EXTENDED_LIMITS -32768.00 32767.00 DEPOSIT ABSOLUTE /end AXIS_DESCR
/end CHARACTERISTIC
/begin CHARACTERISTIC EngPrt_trqLim1_CUR "Momentenbegrenzungskurve für AT mit geschlossener Wandlerkupplung und aktueller Gang muß in EngPrt_swtTrqGear_CUR 1 sein." CURVE 0xD03E2 Kl_Xs16_Ws16 3276.700 Trq 0.00 3276.700 FORMAT "%8.3" EXTENDED_LIMITS -3276.800 3276.700
 /begin AXIS_DESCR STD_AXIS Eng_nAvrg EngN 21 0.00 32767.00 FORMAT "%8.2" EXTENDED_LIMITS -32768.00 32767.00 DEPOSIT ABSOLUTE /end AXIS_DESCR
/end CHARACTERISTIC
/begin CHARACTERISTIC EngPrt_trqLimDA_CUR "Anfahrdrehmomentenbegrenzungskennlinie" CURVE 0xD0438 Kl_Xs16_Ws16 3276.700 Trq 0.00 3276.700 FORMAT "%8.3" EXTENDED_LIMITS -3276.800 3276.700
 /begin AXIS_DESCR STD_AXIS Eng_nAvrg EngN 21 0.00 32767.00 FORMAT "%8.2" EXTENDED_LIMITS -32768.00 32767.00 DEPOSIT ABSOLUTE /end AXIS_DESCR
/end CHARACTERISTIC
/begin CHARACTERISTIC EngPrt_trqLim_CUR "Kennlinie die Drehmomentbegrenzung (je nach Application inneres oder äußeres Motormoment)" CURVE 0xD048E Kl_Xs16_Ws16 3276.700 Trq 0.00 3276.700 FORMAT "%8.3" EXTENDED_LIMITS -3276.800 3276.700
 /begin AXIS_DESCR STD_AXIS Eng_nAvrg EngN 21 0.00 32767.00 FORMAT "%8.2" EXTENDED_LIMITS -32768.00 32767.00 DEPOSIT ABSOLUTE /end AXIS_DESCR
/end CHARACTERISTIC
/begin CHARACTERISTIC EngPrt_trqNLimSpr_CUR "Kennlinie für Motordrehzahlbegrenzung bei Systemfehler (als Begrenzungsmoment)" CURVE 0xD04E4 Kl_Xs16_Ws16 3276.700 Trq 0.00 3276.700 FORMAT "%8.3" EXTENDED_LIMITS -3276.800 3276.700
 /begin AXIS_DESCR STD_AXIS Eng_nAvrg EngN 10 0.00 32767.00 FORMAT "%8.2" EXTENDED_LIMITS -32768.00 32767.00 DEPOSIT ABSOLUTE /end AXIS_DESCR
/end CHARACTERISTIC
/begin CHARACTERISTIC EngPrt_trqNLim_CUR "Kennlinie für Drehzahlbegrenzung im Normalbetrieb (inneres Motormoment)" CURVE 0xD050E Kl_Xs16_Ws16 3276.700 Trq 0.00 3276.700 FORMAT "%8.3" EXTENDED_LIMITS -3276.800 3276.700
 /begin AXIS_DESCR STD_AXIS Eng_nAvrg EngN 21 0.00 32767.00 FORMAT "%8.2" EXTENDED_LIMITS -32768.00 32767.00 DEPOSIT ABSOLUTE /end AXIS_DESCR
/end CHARACTERISTIC
/begin CHARACTERISTIC EngPrt_trqNLim_Vector "#SSD Bypass Label, nicht ändern!" VALUE 0xC2EBC Kw_Wu8 255.0 OneToOne 0.00 255.0 FORMAT "%5.1" /end CHARACTERISTIC
/begin CHARACTERISTIC EngPrt_trqNLim_Channel "#SSD Bypass Label, nicht ändern!" VALUE 0xC2EBD Kw_Wu8 255.0 OneToOne 0.00 255.0 FORMAT "%5.1" /end CHARACTERISTIC
/begin CHARACTERISTIC EngPrt_trqPrtLim_Vector "#SSD Bypass Label, nicht ändern!" VALUE 0xC2EBE Kw_Wu8 255.0 OneToOne 0.00 255.0 FORMAT "%5.1" /end CHARACTERISTIC
/begin CHARACTERISTIC EngPrt_trqPrtLim_Channel "#SSD Bypass Label, nicht ändern!" VALUE 0xC2EBF Kw_Wu8 255.0 OneToOne 0.00 255.0 FORMAT "%5.1" /end CHARACTERISTIC
/begin CHARACTERISTIC Eng_tiOvrTemp2_C "Zeitverzögerung Übertemperatur 2" VALUE 0xCFE44 Kw_Ws16 655.3500 Time_s -327.6800 327.6700 FORMAT "%8.4" /end CHARACTERISTIC
/begin CHARACTERISTIC Eng_tiOvrTemp_C "Zeitverzögerung Übertemperatur 1" VALUE 0xCFE46 Kw_Ws16 655.3500 Time_s -327.6800 327.6700 FORMAT "%8.4" /end CHARACTERISTIC
/begin CHARACTERISTIC ErLpCD_ctMilPwrStgOnMax_C "Maximum number of powerstage switch on per driving cycle in case of SCB or excess temperature" VALUE 0xD0B24 Kw_Wu16 65535.00 OneToOne 0.00 65535.00 FORMAT "%8.2" /end CHARACTERISTIC
/begin CHARACTERISTIC ErLpCD_ctSysLmpPwrStgOnMax_C "Maximum number of powerstage switch on per driving cycle in case of SCB or excess temperature" VALUE 0xD0B26 Kw_Wu16 65535.00 OneToOne 0.00 65535.00 FORMAT "%8.2" /end CHARACTERISTIC
/begin CHARACTERISTIC ErLpCD_tiDefMil_C "Zeit für MIL Defekterkennung (Endstufenüberwachung)" VALUE 0xD0B28 Kw_Wu16 655350.0 Time_ms 0.00 655350.0 FORMAT "%8.1" /end CHARACTERISTIC
/begin CHARACTERISTIC ErLpCD_tiOkMil_C "Zeit für MIL in Ordnung Erkennung (Endstufenüberwachung)" VALUE 0xD0B2A Kw_Wu16 655350.0 Time_ms 0.00 655350.0 FORMAT "%8.1" /end CHARACTERISTIC
/begin CHARACTERISTIC ErLpCD_nThresMil_C "Drehzahlgrenze für MIL-Test" VALUE 0xD0B2C Kw_Ws16 65535.00 EngN -32768.00 32767.00 FORMAT "%8.2" /end CHARACTERISTIC
/begin CHARACTERISTIC ErLpCD_tiMaxMil_C "Zeitgrenze für MIL-Test" VALUE 0xD0B2E Kw_Wu16 655350.0 Time_ms 0.00 655350.0 FORMAT "%8.1" /end CHARACTERISTIC
/begin CHARACTERISTIC ErLpCD_tiMilTst_C "zusätzliche MIL Test Zeit nach Überschreiten Drehzahlschwelle" VALUE 0xD0B30 Kw_Wu16 655350.0 Time_ms 0.00 655350.0 FORMAT "%8.1" /end CHARACTERISTIC
/begin CHARACTERISTIC ErLpCD_tiDelMil_C "Verzögerung der MIL Anzeige nach Lampentest" VALUE 0xD0B32 Kw_Wu16 655350.0 Time_ms 0.00 655350.0 FORMAT "%8.1" /end CHARACTERISTIC
/begin CHARACTERISTIC ErLpCD_tiBlkMil_C "halbe Zeit der MIL Blink Periodedauer" VALUE 0xD0B34 Kw_Wu16 655350.0 Time_ms 0.00 655350.0 FORMAT "%8.1" /end CHARACTERISTIC
/begin CHARACTERISTIC ErLpCD_swtMilEna_C "MIL Freigabe Schalter (0 = abgeschaltet; 1 = eingeschaltet)" VALUE 0xD0B36 Kw_Wu8 1.000 OneToOne 0.00 1.000 FORMAT "%5.3" EXTENDED_LIMITS 0.00 255.0 /end CHARACTERISTIC
/begin CHARACTERISTIC ErLpCD_numDiaErrLmp_C "#SSD application parameter for error lamp diagnostic signal" VALUE 0xD0B38 Kw_Wu8 27.0000000000 NumPinDia 0.00 27.0000000000 FORMAT "%13.10" /end CHARACTERISTIC
/begin CHARACTERISTIC ErLpCD_numDiaSysLmp_C "#SSD application parameter for system lamp diagnostic signal" VALUE 0xD0B39 Kw_Wu8 27.0000000000 NumPinDia 0.00 27.0000000000 FORMAT "%13.10" /end CHARACTERISTIC
/begin CHARACTERISTIC ErLpCD_numDioOutErrLmp_C "#SSD application parameter for error lamp" VALUE 0xD0B3A Kw_Wu8 10.0000000000 NumPinDioOut 0.00 10.0000000000 FORMAT "%13.10" /end CHARACTERISTIC
/begin CHARACTERISTIC ErLpCD_numDioOutSysLmp_C "#SSD application parameter for system lamp" VALUE 0xD0B3B Kw_Wu8 10.0000000000 NumPinDioOut 0.00 10.0000000000 FORMAT "%13.10" /end CHARACTERISTIC
/begin CHARACTERISTIC ErLpCD_stRdy_C "Status of the readiness functionality" VALUE 0xD0B3C Kw_Wu8 1.000 OneToOne 0.00 1.000 FORMAT "%5.3" EXTENDED_LIMITS 0.00 255.0 /end CHARACTERISTIC
/begin CHARACTERISTIC ErLpCD_tiRdy_C "Maximum time given for the checking of readiness status via MIL" VALUE 0xD0B3E Kw_Wu16 655350.0 Time_ms 0.00 655350.0 FORMAT "%8.1" /end CHARACTERISTIC
/begin CHARACTERISTIC ErLpCD_tiBlkOn_C "Blink on period during the blinking phase" VALUE 0xD0B40 Kw_Wu16 655350.0 Time_ms 0.00 655350.0 FORMAT "%8.1" /end CHARACTERISTIC
/begin CHARACTERISTIC ErLpCD_tiBlkOff_C "Blink off period during the blinking phase" VALUE 0xD0B42 Kw_Wu16 655350.0 Time_ms 0.00 655350.0 FORMAT "%8.1" /end CHARACTERISTIC
/begin CHARACTERISTIC ErLpCD_stMilSPICtl_C "0 = Non SPI powerstage )" VALUE 0xD0B44 Kw_Wu8 1.000 OneToOne 0.00 1.000 FORMAT "%5.3" EXTENDED_LIMITS 0.00 255.0 /end CHARACTERISTIC
/begin CHARACTERISTIC ErLpCD_stPwrStgActvLmp_C "Spezifikation des Abschaltverhaltens der Lamp-Endstufe" VALUE 0xD0B45 Kw_Wu8 255.0 OneToOne 0.00 255.0 FORMAT "%5.1" /end CHARACTERISTIC
/begin CHARACTERISTIC ErLpCD_stPwrStgActvMil_C "Spezifikation des Abschaltverhaltens der MIL-Endstufe" VALUE 0xD0B46 Kw_Wu8 255.0 OneToOne 0.00 255.0 FORMAT "%5.1" /end CHARACTERISTIC
/begin CHARACTERISTIC ErLpCD_stPwrStgDiaLmp_C "Spezifikation des Diagnoseabschaltverhaltens der Lamp-Endstufe" VALUE 0xD0B47 Kw_Wu8 255.0 OneToOne 0.00 255.0 FORMAT "%5.1" /end CHARACTERISTIC
/begin CHARACTERISTIC ErLpCD_stPwrStgDiaMil_C "Spezifikation des Diagnoseabschaltverhaltens der MIL-Endstufe" VALUE 0xD0B48 Kw_Wu8 255.0 OneToOne 0.00 255.0 FORMAT "%5.1" /end CHARACTERISTIC
/begin CHARACTERISTIC ErLpCD_stSysLmpSPICtl_C "0 = Non SPI powerstage )" VALUE 0xD0B49 Kw_Wu8 1.000 OneToOne 0.00 1.000 FORMAT "%5.3" EXTENDED_LIMITS 0.00 255.0 /end CHARACTERISTIC
/begin CHARACTERISTIC ErLpCD_swtSysEqGlwLmp_C "SysLamp entspricht Glühlampe (Signalumleitung) (0 = abgeschaltet; 1 = eingeschaltet)" VALUE 0xD0B4A Kw_Wu8 1.000 OneToOne 0.00 1.000 FORMAT "%5.3" EXTENDED_LIMITS 0.00 255.0 /end CHARACTERISTIC
/begin CHARACTERISTIC ErLpCD_tiDefSysLmp_C "Zeit für SysLamp Defekterkennung (Endstufenüberwachung)" VALUE 0xD0B4C Kw_Wu16 655350.0 Time_ms 0.00 655350.0 FORMAT "%8.1" /end CHARACTERISTIC
/begin CHARACTERISTIC ErLpCD_tiOkSysLmp_C "Zeit für SysLamp in Ordnung Erkennung (Endstufenüberwachung)" VALUE 0xD0B4E Kw_Wu16 655350.0 Time_ms 0.00 655350.0 FORMAT "%8.1" /end CHARACTERISTIC
/begin CHARACTERISTIC ErLpCD_nThresSysLmp_C "Drehzahlgrenze für SysLamp-Test" VALUE 0xD0B50 Kw_Ws16 65535.00 EngN -32768.00 32767.00 FORMAT "%8.2" /end CHARACTERISTIC
/begin CHARACTERISTIC ErLpCD_tiMaxSysLmp_C "Zeitgrenze für SysLamp-Test" VALUE 0xD0B52 Kw_Wu16 655350.0 Time_ms 0.00 655350.0 FORMAT "%8.1" /end CHARACTERISTIC
/begin CHARACTERISTIC ErLpCD_tiTstSysLmp_C "zusätzliche SysLamp Test Zeit nach Überschreiten Drehzahlschwelle" VALUE 0xD0B54 Kw_Wu16 655350.0 Time_ms 0.00 655350.0 FORMAT "%8.1" /end CHARACTERISTIC
/begin CHARACTERISTIC ErLpCD_tiDelSysLmp_C "Verzögerung der SysLamp Anzeige nach Lampentest" VALUE 0xD0B56 Kw_Wu16 655350.0 Time_ms 0.00 655350.0 FORMAT "%8.1" /end CHARACTERISTIC
/begin CHARACTERISTIC ErLpCD_tiBlkSysLmp_C "halbe Zeit der SysLamp Blink Periodedauer" VALUE 0xD0B58 Kw_Wu16 655350.0 Time_ms 0.00 655350.0 FORMAT "%8.1" /end CHARACTERISTIC
/begin CHARACTERISTIC ErLpCD_swtSysLmpEna_C "SysLamp Freigabe Schalter (0 = abgeschaltet; 1 = eingeschaltet)" VALUE 0xD0B5A Kw_Wu8 1.000 OneToOne 0.00 1.000 FORMAT "%5.3" EXTENDED_LIMITS 0.00 255.0 /end CHARACTERISTIC
/begin CHARACTERISTIC ErLpCD_tiBtwTstMil_C "Time interval between powerstage switch on to test the error condition" VALUE 0xD0B5C Kw_Wu16 655140.0 Time_ms 0.00 655140.0 FORMAT "%8.1" EXTENDED_LIMITS 0.00 655350.0 /end CHARACTERISTIC
/begin CHARACTERISTIC ErLpCD_tiBtwTstSysLmp_C "Time interval between powerstage switch on to test the error condition" VALUE 0xD0B5E Kw_Wu16 655140.0 Time_ms 0.00 655140.0 FORMAT "%8.1" EXTENDED_LIMITS 0.00 655350.0 /end CHARACTERISTIC
/begin CHARACTERISTIC ErLpCD_tiMilPwrStgOn_C "Time for which the powerstage is switched on in case of non SPI powerstage" VALUE 0xD0B60 Kw_Wu16 655140.0 Time_ms 0.00 655140.0 FORMAT "%8.1" EXTENDED_LIMITS 0.00 655350.0 /end CHARACTERISTIC
/begin CHARACTERISTIC ErLpCD_tiSysLmpPwrStgOn_C "Time for which the powerstage is switched on in case of non SPI powerstage" VALUE 0xD0B62 Kw_Wu16 655140.0 Time_ms 0.00 655140.0 FORMAT "%8.1" EXTENDED_LIMITS 0.00 655350.0 /end CHARACTERISTIC
/begin CHARACTERISTIC ESS_nBattMin_C "#SSD Wert der geforderten Drehzahl nach Freigabe" VALUE 0xD0B6C Kw_Ws16 38768.00 EngN -32768.00 6000.000 FORMAT "%8.2" EXTENDED_LIMITS -32768.00 32767.00 /end CHARACTERISTIC
/begin CHARACTERISTIC ESS_nLIBattThres_C "Schwelle Drehzahl zur Aktivierung der Drehzahlforderung" VALUE 0xD0B64 Kw_Ws16 38768.00 EngN -32768.00 6000.000 FORMAT "%8.2" EXTENDED_LIMITS -32768.00 32767.00 /end CHARACTERISTIC
/begin CHARACTERISTIC ESS_nMinThres_C "Drehzahlschwelle zur Verhinderung eines Momentensprungs" VALUE 0xD0B66 Kw_Ws16 38768.00 EngN -32768.00 6000.000 FORMAT "%8.2" EXTENDED_LIMITS -32768.00 32767.00 /end CHARACTERISTIC
/begin CHARACTERISTIC ESS_tiDelayUBattFFRes_C "Zeit bis Rücknahme der Drehzahlforderung nach Deaktivierung" VALUE 0xD0B6E Kw_Ws16 655.3500 Time_s -327.6800 327.6700 FORMAT "%8.4" /end CHARACTERISTIC
/begin CHARACTERISTIC ESS_tiDelayUBattFFSet_C "Zeit bis Freigabe der Drehzahlforderung nach Aktivierung" VALUE 0xD0B68 Kw_Ws16 655.3500 Time_s -327.6800 327.6700 FORMAT "%8.4" /end CHARACTERISTIC
/begin CHARACTERISTIC ESS_uLIBattThresFFRes_C "Schwelle Batteriespannung zur Deaktivierung der Drehzahlforderung" VALUE 0xD0B70 Kw_Ws16 1281232. Volt_Batt -640625.6 640606.1 FORMAT "%8.1" /end CHARACTERISTIC
/begin CHARACTERISTIC ESS_uLIBattThresFFSet_C "Schwelle Batteriespannung zur Aktivierung der Drehzahlforderung" VALUE 0xD0B6A Kw_Ws16 1281232. Volt_Batt -640625.6 640606.1 FORMAT "%8.1" /end CHARACTERISTIC
/begin CHARACTERISTIC ETClb_ctDflLrn_CA "Defaultwerte für die applikative Änderung der Lernzykluszähler der Ansteuerdauerkalibrierung für die ZFC" VAL_BLK 0xD0BC8 Kwb_Wu16 65535.00 OneToOne 0.00 65535.00 FORMAT "%8.2" NUMBER 3 /end CHARACTERISTIC
/begin CHARACTERISTIC ETClb_ctLrnThres2_C "" VALUE 0xD0B72 Kw_Wu16 65535.00 OneToOne 0.00 65535.00 FORMAT "%8.2" /end CHARACTERISTIC
/begin CHARACTERISTIC ETClb_ctLrnThresQck_C "Anzahl der Lernzyklen für die Freigabe der Ansteuerdauerkorrektur durch die Ansteurdauerkalibrierung bei Schnellkalibrierung" VALUE 0xD0B74 Kw_Wu16 65535.00 OneToOne 0.00 65535.00 FORMAT "%8.2" /end CHARACTERISTIC
/begin CHARACTERISTIC ETClb_ctLrnThres_C "Anzahl der Lernzyklen für die Freigabe der Ansteuerdauerkorrektur durch die Ansteurdauerkalibrierung" VALUE 0xD0B76 Kw_Wu16 65535.00 OneToOne 0.00 65535.00 FORMAT "%8.2" /end CHARACTERISTIC
/begin CHARACTERISTIC ETClb_DebETFltMaxDefect_C "Entprellzeit der Defekterkennung der Überschreitung der maximalen gefilterten Ansteuerdauer von der Ansteuerdauerkalibrierung" VALUE 0xD0BCE Kw_Wu16 0.00 OneToOne 1.000000 1.000000 FORMAT "%8.6" EXTENDED_LIMITS 0.00 65535.00 /end CHARACTERISTIC
/begin CHARACTERISTIC ETClb_DebETFltMaxOk_C "Entprellzeit der Intakterkennung der Überschreitung der maximalen gefilterten Ansteuerdauer von der Ansteuerdauerkalibrierung" VALUE 0xD0BD0 Kw_Wu16 0.00 OneToOne 0.00 0.00 FORMAT "%8.2" EXTENDED_LIMITS 0.00 65535.00 /end CHARACTERISTIC
/begin CHARACTERISTIC ETClb_DebETFltMinDefect_C "Entprellzeit der Defekterkennung der Unterschreitung der minimalen gefilterten Ansteuerdauer von der Ansteuerdauerkalibrierung" VALUE 0xD0BD2 Kw_Wu16 0.00 OneToOne 1.000000 1.000000 FORMAT "%8.6" EXTENDED_LIMITS 0.00 65535.00 /end CHARACTERISTIC
/begin CHARACTERISTIC ETClb_DebETFltMinOk_C "Entprellzeit der Intakterkennung der Unterschreitung der minimalen gefilterten Ansteuerdauer von der Ansteuerdauerkalibrierung" VALUE 0xD0BD4 Kw_Wu16 0.00 OneToOne 0.00 0.00 FORMAT "%8.2" EXTENDED_LIMITS 0.00 65535.00 /end CHARACTERISTIC
/begin CHARACTERISTIC ETClb_DebETMaxDefect_C "#SSD Entprellzeit der Defekterkennung der Überschreitung der maximalen Ansteuerdauer von der Ansteuerdauerkalibrierung" VALUE 0xD0BAC Kw_Wu16 65535.00 OneToOne 0.00 65535.00 FORMAT "%8.2" /end CHARACTERISTIC
/begin CHARACTERISTIC ETClb_DebETMaxOk_C "#SSD Entprellzeit der Intakterkennung der Überschreitung der maximalen Ansteuerdauer von der Ansteuerdauerkalibrierung" VALUE 0xD0BAE Kw_Wu16 65535.00 OneToOne 0.00 65535.00 FORMAT "%8.2" /end CHARACTERISTIC
/begin CHARACTERISTIC ETClb_DebETMinDefect_C "#SSD Entprellzeit der Defekterkennung der Unterschreitung der minimalen Ansteuerdauer von der Ansteuerdauerkalibrierung" VALUE 0xD0BB0 Kw_Wu16 65535.00 OneToOne 0.00 65535.00 FORMAT "%8.2" /end CHARACTERISTIC
/begin CHARACTERISTIC ETClb_DebETMinOk_C "#SSD Entprellzeit der Intakterkennung der Unterschreitung der minimalen Ansteuerdauer von der Ansteuerdauerkalibrierung" VALUE 0xD0BB2 Kw_Wu16 65535.00 OneToOne 0.00 65535.00 FORMAT "%8.2" /end CHARACTERISTIC
/begin CHARACTERISTIC ETClb_dpRailLim_CA "Raildruck-Kalibrierpunkt abhängige max. Abweichung des Raildrucks für die Nullmengenkalibrierung" VAL_BLK 0xD0B78 Kwb_Ws16 2000.000 Pres_Rail 0.00 2000.000 FORMAT "%5.3" EXTENDED_LIMITS -3276.800 3276.700 NUMBER 3 /end CHARACTERISTIC
/begin CHARACTERISTIC ETClb_dtiDflETFlt0_CA "Defaultwerte für die gefilterte Ansteuerdauerdifferenz der Ansteuerdauerkalibrierung für den Raildruck-Kalibrierpunkt 0" VAL_BLK 0xD0BD6 Kwb_Ws16 5200.000 InjTime_us -200.0000 5000.000 FORMAT "%8.3" EXTENDED_LIMITS -32768.00 32767.00 NUMBER 6 /end CHARACTERISTIC
/begin CHARACTERISTIC ETClb_dtiDflETFlt1_CA "Defaultwerte für die gefilterte Ansteuerdauerdifferenz der Ansteuerdauerkalibrierung für den Raildruck-Kalibrierpunkt 1" VAL_BLK 0xD0BE2 Kwb_Ws16 5200.000 InjTime_us -200.0000 5000.000 FORMAT "%8.3" EXTENDED_LIMITS -32768.00 32767.00 NUMBER 6 /end CHARACTERISTIC
/begin CHARACTERISTIC ETClb_dtiDflETFlt2_CA "Defaultwerte für die gefilterte Ansteuerdauerdifferenz der Ansteuerdauerkalibrierung für den Raildruck-Kalibrierpunkt 2" VAL_BLK 0xD0BEE Kwb_Ws16 5200.000 InjTime_us -200.0000 5000.000 FORMAT "%8.3" EXTENDED_LIMITS -32768.00 32767.00 NUMBER 6 /end CHARACTERISTIC
/begin CHARACTERISTIC ETClb_facFlt2_C "" VALUE 0xD0B7E Kw_Wu16 1.000000 Fact 0.00 1.000000 FORMAT "%8.6" EXTENDED_LIMITS 0.00 7.999878 /end CHARACTERISTIC
/begin CHARACTERISTIC ETClb_facFltQck_C "Filterkonstante für die Ansteuerdauerdifferenz der Ansteuerdauerkalibrierung bei Schnellkalibrierung" VALUE 0xD0B80 Kw_Wu16 1.000000 Fact 0.00 1.000000 FORMAT "%8.6" EXTENDED_LIMITS 0.00 7.999878 /end CHARACTERISTIC
/begin CHARACTERISTIC ETClb_facFlt_C "Filterkonstante für die Ansteuerdauerdifferenz der Ansteuerdauerkalibrierung" VALUE 0xD0B82 Kw_Wu16 1.000000 Fact 0.00 1.000000 FORMAT "%8.6" EXTENDED_LIMITS 0.00 7.999878 /end CHARACTERISTIC
/begin CHARACTERISTIC ETClb_numCyclMeas_C "#SSD Anzahl der Einspritzzyklen für die Messung der Ansteuerdauerkalibrierung" VALUE 0xD0B84 Kw_Wu16 65535.00 OneToOne 0.00 65535.00 FORMAT "%8.2" /end CHARACTERISTIC
/begin CHARACTERISTIC ETClb_numCyclNoDyn_C "Anzahl der Einspritzzyklen bis die Ansteuerdauekalibrierung den maximalen Drehzahlanstieg prüft" VALUE 0xD0B86 Kw_Wu16 65535.00 OneToOne 0.00 65535.00 FORMAT "%8.2" /end CHARACTERISTIC
/begin CHARACTERISTIC ETClb_numCyclStartEnergize_C "#SSD Anzahl der Einspritzzyklen bis die Ansteuerdauerkalibrierung für die Messung eingeschwungen ist" VALUE 0xD0B88 Kw_Wu16 65535.00 OneToOne 0.00 65535.00 FORMAT "%8.2" /end CHARACTERISTIC
/begin CHARACTERISTIC ETClb_numDflCylCur_CA "Testwerte für die aktuellen Zylinder der Ansteuerdauerkalibrierung für jeden Raildruck-Kalibrierpunkt" VAL_BLK 0xD0BFA Kwb_Wu8 5.000 OneToOne 1.000 6.000 FORMAT "%5.3" EXTENDED_LIMITS 0.00 255.0 NUMBER 3 /end CHARACTERISTIC
/begin CHARACTERISTIC ETClb_pRailSet_CA "#SSD Raildruck-Kalibrierpunkte für die Ansteuerdauerkalibrierung" VAL_BLK 0xD0B8A Kwb_Ws16 2000.000 Pres_Rail 0.00 2000.000 FORMAT "%5.3" EXTENDED_LIMITS -3276.800 3276.700 NUMBER 3 /end CHARACTERISTIC
/begin CHARACTERISTIC ETClb_SigThres_CA "#SSD Raildurck-Kalibrierpunkt abhänge Signalschwelle der Nullmengenkalibrierung" VAL_BLK 0xD0B90 Kwb_Ws16 200.0000 OneToOne 0.00 200.0000 FORMAT "%8.4" EXTENDED_LIMITS -32768.00 32767.00 NUMBER 3 /end CHARACTERISTIC
/begin CHARACTERISTIC ETClb_swtCorActvVal_C "Applikativer Wert des SW-Schalters für die Ansteuerdauerkorrektur" VALUE 0xD0B96 Kw_Wu8 1.000 OneToOne 0.00 1.000 FORMAT "%5.3" EXTENDED_LIMITS 0.00 255.0 /end CHARACTERISTIC
/begin CHARACTERISTIC ETClb_swtCorActvType_C "Typ des SW-Schalters für die Ansteuerdauerkorrektur der Nullmengenkalibrierung" VALUE 0xD0B97 Kw_Wu8 2.000 OneToOne 0.00 2.000 FORMAT "%5.3" EXTENDED_LIMITS 0.00 255.0 /end CHARACTERISTIC
/begin CHARACTERISTIC ETClb_swtDflQckClb_C "Testwert zum Umschalten auf Schnellkalibrierung der Ansteuerdauerkalibrierung" VALUE 0xD0BFD Kw_Wu8 1.000 OneToOne 0.00 1.000 FORMAT "%5.3" EXTENDED_LIMITS 0.00 255.0 /end CHARACTERISTIC
/begin CHARACTERISTIC ETClb_swtWrDflVal_C "Aktivierung zum schreiben der Testwerte für die Ansteuerdauerkalibrierung bei Wechsel von 0 nach 1" VALUE 0xD0B98 Kw_Wu8 1.000 OneToOne 0.00 1.000 FORMAT "%5.3" EXTENDED_LIMITS 0.00 255.0 /end CHARACTERISTIC
/begin CHARACTERISTIC ETClb_tiDflETCur_CA "Testwert der aktuellen Ansteuerdauer für die Ansteuerdauerkalibrierung bei jedem Raildruck-Kalibrierpunkt" VAL_BLK 0xD0BFE Kwb_Ws16 4850.000 InjTime_us 150.0000 5000.000 FORMAT "%8.3" EXTENDED_LIMITS -32768.00 32767.00 NUMBER 3 /end CHARACTERISTIC
/begin CHARACTERISTIC ETClb_tiDflInjInit_C "Defaultwert für die applikative Änderung des Ininitialisierungswerts des Injektor-Betriebsstundenzählers" VALUE 0xD0C04 Kw_Wu32 4294967295.00 OneToOne 0.00 4294967295.00 FORMAT "%13.2" /end CHARACTERISTIC
/begin CHARACTERISTIC ETClb_tiETOfs_CA "Offset der max. gefilterten Ansteuerdauer zur max. Ansteuerdauer für jeden Raildruck-Kalibrierpunkt" VAL_BLK 0xD0C08 Kwb_Ws16 5000.0000 InjTime_us 0.00 5000.0000 FORMAT "%8.4" EXTENDED_LIMITS -32768.00 32767.00 NUMBER 3 /end CHARACTERISTIC
/begin CHARACTERISTIC ETClb_tiETStep_CA "Schrittweite der Ansteuerdauer für die Anhebung oder Senkung der Ansteuerdauer von der Ansteuerdauer-Kalibrierung" VAL_BLK 0xD0BB4 Kwb_Ws16 5000.000 InjTime_us 0.00 5000.000 FORMAT "%8.3" EXTENDED_LIMITS -32768.00 32767.00 NUMBER 3 /end CHARACTERISTIC
/begin CHARACTERISTIC ETClb_tiET_MAX_CA "#SSD Maximale Ansteuerdauer der Einspritzungen für die Ansteuerdauerkalibrierung für jeden Raildruck-Kalibirierpunkt" VAL_BLK 0xD0BBA Kwb_Ws16 32767.00 InjTime_us 0.00 32767.00 FORMAT "%8.2" EXTENDED_LIMITS -32768.00 32767.00 NUMBER 3 /end CHARACTERISTIC
/begin CHARACTERISTIC ETClb_tiET_MIN_CA "#SSD Minimale Ansteuerdauer der Einspritzungen für die Ansteuerdauerkalibrierung für jeden Raildruck-Kalibirierpunkt" VAL_BLK 0xD0BC0 Kwb_Ws16 32767.00 InjTime_us 0.00 32767.00 FORMAT "%8.2" EXTENDED_LIMITS -32768.00 32767.00 NUMBER 3 /end CHARACTERISTIC
/begin CHARACTERISTIC ETClb_volEffectiveMin_CA "#SSD Menge der Wirkgrenze für die Ansteuerdauerkalibrierung" VAL_BLK 0xD0B9A Kwb_Ws16 100.0000 InjQntInj 0.00 100.0000 FORMAT "%8.4" EXTENDED_LIMITS -327.6800 327.6700 NUMBER 3 /end CHARACTERISTIC
/begin CHARACTERISTIC ETClb_vStartClb_CA "Minimale Fahrzeuggeschwindigkeit zum Starten der Ansteuerdauerkalibrierung bei jedem Raildruck-Kalibrierpunkt" VAL_BLK 0xD0BA0 Kwb_Ws16 200.0000 Vel 0.00 200.0000 FORMAT "%8.4" EXTENDED_LIMITS -327.6800 327.6700 NUMBER 3 /end CHARACTERISTIC
/begin CHARACTERISTIC ETClb_vStopClb_CA "Minimale Fahrzeuggeschwindigkeit der Ansteuerdauerkalibrierung bei jedem Raildruck-Kalibrierpunkt" VAL_BLK 0xD0BA6 Kwb_Ws16 200.0000 Vel 0.00 200.0000 FORMAT "%8.4" EXTENDED_LIMITS -327.6800 327.6700 NUMBER 3 /end CHARACTERISTIC
/begin CHARACTERISTIC FanCD_ctPwrStgOnMax_C "Maximum number of powerstage switch on per driving cycle in case of SCB or excess temperature" VALUE 0xD0C10 Kw_Wu16 65535.00 OneToOne 0.00 65535.00 FORMAT "%8.2" /end CHARACTERISTIC
/begin CHARACTERISTIC FanCD_DebExcTempDef_C "Fehlerentprellzeit für Fehler Übertemperatur" VALUE 0xD0C12 Kw_Wu16 655350.0 Time_ms 0.00 655350.0 FORMAT "%8.1" /end CHARACTERISTIC
/begin CHARACTERISTIC FanCD_DebExcTempOk_C "Heilungsentprellzeit für Fehler Übertemperatur" VALUE 0xD0C14 Kw_Wu16 655350.0 Time_ms 0.00 655350.0 FORMAT "%8.1" /end CHARACTERISTIC
/begin CHARACTERISTIC FanCD_tiDebDia1Def_C "Fehlerentprellzeit für Lüfter Diagnose erstes Zeitfenster" VALUE 0xD0C16 Kw_Wu16 655350.0 Time_ms 0.00 655350.0 FORMAT "%8.1" /end CHARACTERISTIC
/begin CHARACTERISTIC FanCD_tiDebDia1Ok_C "Fehlerheilzeit für Lüfter Diagnose erstes Zeitfenster" VALUE 0xD0C18 Kw_Wu16 655350.0 Time_ms 0.00 655350.0 FORMAT "%8.1" /end CHARACTERISTIC
/begin CHARACTERISTIC FanCD_tiDebDia2Def_C "Fehlerentprellzeit für Lüfter Diagnose zweites Zeitfenster" VALUE 0xD0C1A Kw_Wu16 655350.0 Time_ms 0.00 655350.0 FORMAT "%8.1" /end CHARACTERISTIC
/begin CHARACTERISTIC FanCD_tiDebDia2Ok_C "Fehlerheilzeit für Lüfter Diagnose zweites Zeitfenster" VALUE 0xD0C1C Kw_Wu16 655350.0 Time_ms 0.00 655350.0 FORMAT "%8.1" /end CHARACTERISTIC
/begin CHARACTERISTIC FanCD_tiDebDia3Def_C "Fehlerentprellzeit für Lüfter Diagnose drittes Zeitfenster" VALUE 0xD0C1E Kw_Wu16 655350.0 Time_ms 0.00 655350.0 FORMAT "%8.1" /end CHARACTERISTIC
/begin CHARACTERISTIC FanCD_tiDebDia3Ok_C "Fehlerheilzeit für Lüfter Diagnose drittes Zeitfenster" VALUE 0xD0C20 Kw_Wu16 655350.0 Time_ms 0.00 655350.0 FORMAT "%8.1" /end CHARACTERISTIC
/begin CHARACTERISTIC FanCD_DebNoLoadDef_C "Defektentprellung für den Lastabfall des Lüfters" VALUE 0xD0C22 Kw_Wu16 655350.0 Time_ms 0.00 655350.0 FORMAT "%8.1" /end CHARACTERISTIC
/begin CHARACTERISTIC FanCD_DebNoLoadOk_C "Heilungsentprellung für den Lastabfall des Lüfters" VALUE 0xD0C24 Kw_Wu16 655350.0 Time_ms 0.00 655350.0 FORMAT "%8.1" /end CHARACTERISTIC
/begin CHARACTERISTIC FanCD_DebShortCircBatDef_C "Entprelldauer für Fehler Kurzschluss zur Batterie" VALUE 0xD0C26 Kw_Wu16 655350.0 Time_ms 0.00 655350.0 FORMAT "%8.1" /end CHARACTERISTIC
/begin CHARACTERISTIC FanCD_DebShortCircBatOk_C "Heilungsdauer für Fehler Kurzschluss zur Batterie" VALUE 0xD0C28 Kw_Wu16 655350.0 Time_ms 0.00 655350.0 FORMAT "%8.1" /end CHARACTERISTIC
/begin CHARACTERISTIC FanCD_DebShortCircGndDef_C "#SSD Entprelldauer für Fehler Kurzschluss zur Masse" VALUE 0xD0C2A Kw_Wu16 655350.0 Time_ms 0.00 655350.0 FORMAT "%8.1" /end CHARACTERISTIC
/begin CHARACTERISTIC FanCD_DebShortCircGndOk_C "Heilungsdauer für Fehler Kurzschluss zur Masse" VALUE 0xD0C2C Kw_Wu16 655350.0 Time_ms 0.00 655350.0 FORMAT "%8.1" /end CHARACTERISTIC
/begin CHARACTERISTIC FanCD_numDia_C "#SSD Applikationsparameter fuer Luefter Komponententreiber" VALUE 0xD0C2E Kw_Wu8 27.0000000000 NumPinDia 0.00 27.0000000000 FORMAT "%13.10" /end CHARACTERISTIC
/begin CHARACTERISTIC FanCD_numPwmOut_C "#SSD Applikationsparameter fuer Luefter" VALUE 0xD0C2F Kw_Wu8 12.0000000000 NumPinPwmOut 0.00 12.0000000000 FORMAT "%13.10" /end CHARACTERISTIC
/begin CHARACTERISTIC FanCD_stInvOut_C "Invertierungsparameter der PWM-Endstufe" VALUE 0xD0C30 Kw_Wu8 1.000 OneToOne 0.00 1.000 FORMAT "%5.3" EXTENDED_LIMITS 0.00 255.0 /end CHARACTERISTIC
/begin CHARACTERISTIC FanCD_stSPICtl_C "Parameter to indicate the type of powerstage used ( 1 = SPI controllable powerstage, 0 = Non SPI powerstage)" VALUE 0xD0C31 Kw_Wu8 1.000 OneToOne 0.00 1.000 FORMAT "%5.3" EXTENDED_LIMITS 0.00 255.0 /end CHARACTERISTIC
/begin CHARACTERISTIC FanCD_tiBtwTst_C "#SSD Zeitabstand, in dem im Fehlerfall die Endstufe getestet wird" VALUE 0xD0C32 Kw_Wu16 29980.00 Time_ms 20.00000 30000.00 FORMAT "%8.2" EXTENDED_LIMITS 0.00 655350.0 /end CHARACTERISTIC
/begin CHARACTERISTIC FanCD_tiFanCtlr1Max_C "Maximum des ersten Signalfensters für Fehlersignale des Lüfter-SG" VALUE 0xD0C34 Kw_Wu16 655350.0 Time_ms 0.00 655350.0 FORMAT "%8.1" /end CHARACTERISTIC
/begin CHARACTERISTIC FanCD_tiFanCtlr1Min_C "Minimum des ersten Signalfensters für Fehlersignale des Lüfter-SG" VALUE 0xD0C36 Kw_Wu16 655350.0 Time_ms 0.00 655350.0 FORMAT "%8.1" /end CHARACTERISTIC
/begin CHARACTERISTIC FanCD_tiFanCtlr2Max_C "#SSD Maximum des zweiten Signalfensters für Fehlersignale des Lüfter-SG" VALUE 0xD0C38 Kw_Wu16 655350.0 Time_ms 0.00 655350.0 FORMAT "%8.1" /end CHARACTERISTIC
/begin CHARACTERISTIC FanCD_tiFanCtlr2Min_C "#SSD Minimum des zweiten Signalfensters für Fehlersignale des Lüfter-SG" VALUE 0xD0C3A Kw_Wu16 655350.0 Time_ms 0.00 655350.0 FORMAT "%8.1" /end CHARACTERISTIC
/begin CHARACTERISTIC FanCD_tiFanCtlr3Max_C "#SSD Maximum des dritten Signalfensters für Fehlersignale des Lüfter-SG" VALUE 0xD0C3C Kw_Wu16 655350.0 Time_ms 0.00 655350.0 FORMAT "%8.1" /end CHARACTERISTIC
/begin CHARACTERISTIC FanCD_tiFanCtlr3Min_C "#SSD Minimum des dritten Signalfensters für Fehlersignale des Lüfter-SG" VALUE 0xD0C3E Kw_Wu16 655350.0 Time_ms 0.00 655350.0 FORMAT "%8.1" /end CHARACTERISTIC
/begin CHARACTERISTIC FanCD_tiPwrStgOn_C "Time for which the powerstage is switched on in case of non SPI powerstage" VALUE 0xD0C40 Kw_Wu16 655140.0 Time_ms 0.00 655140.0 FORMAT "%8.1" EXTENDED_LIMITS 0.00 655350.0 /end CHARACTERISTIC
/begin CHARACTERISTIC FanCtl_dcycAftRun_C "TV für 10Hz Nachlauf" VALUE 0xD0C44 Kw_Ws16 100.0000 DtyCyc 0.00 100.0000 FORMAT "%8.4" EXTENDED_LIMITS -327.6800 327.6700 /end CHARACTERISTIC
/begin CHARACTERISTIC FanCtl_dcycHysDelta_C "Hystereseschwelle" VALUE 0xD0C46 Kw_Ws16 100.0000 DtyCyc 0.00 100.0000 FORMAT "%8.4" EXTENDED_LIMITS -327.6800 327.6700 /end CHARACTERISTIC
/begin CHARACTERISTIC FanCtl_dcycMax_C "High-PWM-Signal der Hysterese" VALUE 0xD0C48 Kw_Ws16 100.0000 DtyCyc 0.00 100.0000 FORMAT "%8.4" EXTENDED_LIMITS -327.6800 327.6700 /end CHARACTERISTIC
/begin CHARACTERISTIC FanCtl_dcycMinOff_C "Minimumwert, ""Lüfter aus""" VALUE 0xD0C4A Kw_Ws16 100.0000 DtyCyc 0.00 100.0000 FORMAT "%8.4" EXTENDED_LIMITS -327.6800 327.6700 /end CHARACTERISTIC
/begin CHARACTERISTIC FanCtl_dcycSwtLimOff_C "Schwelle für Erkennung ""Lüfter aus""" VALUE 0xD0C4C Kw_Ws16 100.0000 DtyCyc 0.00 100.0000 FORMAT "%8.4" EXTENDED_LIMITS -327.6800 327.6700 /end CHARACTERISTIC
/begin CHARACTERISTIC FanCtl_dcycSwtLimOn_C "Schwelle für Erkennung ""Lüfter ein""" VALUE 0xD0C4E Kw_Ws16 100.0000 DtyCyc 0.00 100.0000 FORMAT "%8.4" EXTENDED_LIMITS -327.6800 327.6700 /end CHARACTERISTIC
/begin CHARACTERISTIC FanCtl_dcyc_CUR "Umrechnungs-KL, Drehzahl / Tastverhältnis" CURVE 0xD0C50 Kl_Xs16_Ws16 100.0000 DtyCyc 0.00 100.0000 FORMAT "%8.4" EXTENDED_LIMITS -327.6800 327.6700
 /begin AXIS_DESCR STD_AXIS FanCtl_nSetPoint FanSpd 4 0.00 3000.000 FORMAT "%8.3" EXTENDED_LIMITS -3000.092 3000.000 DEPOSIT ABSOLUTE /end AXIS_DESCR
/end CHARACTERISTIC
/begin CHARACTERISTIC FanCtl_facWghFctr_CUR "wighting factor for fanspeed = f(veh. speed)" CURVE 0xD0C62 Kl_Xs16_Ws16 10.00000 Fact 0.00 10.00000 FORMAT "%8.5" EXTENDED_LIMITS -4.000000 3.999878
 /begin AXIS_DESCR STD_AXIS VSSCD_v Vel 4 0.00 300.0000 FORMAT "%8.4" EXTENDED_LIMITS -327.6800 327.6700 DEPOSIT ABSOLUTE /end AXIS_DESCR
/end CHARACTERISTIC
/begin CHARACTERISTIC FanCtl_nDemFanOffLim_C "Drehzahlausschaltschwelle für hohe Lenköltemperaturen" VALUE 0xD0C74 Kw_Ws16 5960.000 EngN 40.00000 6000.000 FORMAT "%8.3" EXTENDED_LIMITS -32768.00 32767.00 /end CHARACTERISTIC
/begin CHARACTERISTIC FanCtl_nDemFanOn_C "Drehzahl Vorgabewert des Lüfters für hohe Lenköltemperaturen" VALUE 0xD0C76 Kw_Ws16 5960.000 EngN 40.00000 6000.000 FORMAT "%8.3" EXTENDED_LIMITS -32768.00 32767.00 /end CHARACTERISTIC
/begin CHARACTERISTIC FanCtl_nMin_C "Drehzahlschwelle für ""Lüfter ein""" VALUE 0xD0C78 Kw_Ws16 5960.000 EngN 40.00000 6000.000 FORMAT "%8.3" EXTENDED_LIMITS -32768.00 32767.00 /end CHARACTERISTIC
/begin CHARACTERISTIC FanCtl_nSetGbxOil_MAP "fan speed derived from vehicle speed and  gearbox temperature" MAP 0xD0C7A Kf_Xs16_Ys16_Ws16 3000.000 FanSpd 0.00 3000.000 FORMAT "%8.3" EXTENDED_LIMITS -3000.092 3000.000
 /begin AXIS_DESCR STD_AXIS VSSCD_v Vel 8 0.00 300.0000 FORMAT "%8.4" EXTENDED_LIMITS -327.6800 327.6700 DEPOSIT ABSOLUTE /end AXIS_DESCR
 /begin AXIS_DESCR STD_AXIS FanCtl_tGbxOil_mp Temp_Cels 10 -50.14000 199.8600 FORMAT "%8.4" EXTENDED_LIMITS -3549.940 3003.560 DEPOSIT ABSOLUTE /end AXIS_DESCR
/end CHARACTERISTIC
/begin CHARACTERISTIC FanCtl_nSetPnt_MAP "fanspeed = f(veh. speed, coolant temp.)" MAP 0xD0D42 Kf_Xs16_Ys16_Ws16 3000.000 FanSpd 0.00 3000.000 FORMAT "%8.3" EXTENDED_LIMITS -3000.092 3000.000
 /begin AXIS_DESCR STD_AXIS VSSCD_v Vel 8 0.00 300.0000 FORMAT "%8.4" EXTENDED_LIMITS -327.6800 327.6700 DEPOSIT ABSOLUTE /end AXIS_DESCR
 /begin AXIS_DESCR STD_AXIS FanCtl_tClnt_mp Temp_Cels 10 -50.14000 199.8600 FORMAT "%8.4" EXTENDED_LIMITS -3549.940 3003.560 DEPOSIT ABSOLUTE /end AXIS_DESCR
/end CHARACTERISTIC
/begin CHARACTERISTIC FanCtl_nSetPointFanOn_C "Drehzahl Vorgabewert des Lüfters für hohe Lenköltemperaturen" VALUE 0xD0E0A Kw_Ws16 3000.000 FanSpd 0.00 3000.000 FORMAT "%8.3" EXTENDED_LIMITS -3000.092 3000.000 /end CHARACTERISTIC
/begin CHARACTERISTIC FanCtl_stDemFanOffGear_C "Gang bei dem der Lüfter ausgeschaltet wird um die Lenköltemperatur zu veringern" VALUE 0xD0E0C Kw_Ws8 7.000 OneToOne -1.000 6.000 FORMAT "%5.3" EXTENDED_LIMITS -128.0 127.0 /end CHARACTERISTIC
/begin CHARACTERISTIC FanCtl_stDemFanOnGear_C "Gang bei dem der Lüfter eingeschaltet wird um die Lenköltemperatur zu veringern" VALUE 0xD0E0D Kw_Ws8 7.000 OneToOne -1.000 6.000 FORMAT "%5.3" EXTENDED_LIMITS -128.0 127.0 /end CHARACTERISTIC
/begin CHARACTERISTIC FanCtl_swtBattCor_C "Schalter zur Aktivierung Ubatt Korrektur (0...aus / 1...ein)" VALUE 0xD0E0E Kw_Ws16 1.000000 OneToOne 0.00 1.000000 FORMAT "%8.6" EXTENDED_LIMITS -32768.00 32767.00 /end CHARACTERISTIC
/begin CHARACTERISTIC FanCtl_tClntDfl_C "Wassertemperaturersatzwert bei defektem Wassertemperatursensor" VALUE 0xD0E10 Kw_Ws16 250.0000 Temp_Cels -50.14000 199.8600 FORMAT "%8.4" EXTENDED_LIMITS -3549.940 3003.560 /end CHARACTERISTIC
/begin CHARACTERISTIC FanCtl_tDemFanOffLim_C "Drehzahlausschaltschwelle für hohe Lenköltemperaturen" VALUE 0xD0E12 Kw_Ws16 250.0000 Temp_Cels -50.14000 199.8600 FORMAT "%8.4" EXTENDED_LIMITS -3549.940 3003.560 /end CHARACTERISTIC
/begin CHARACTERISTIC FanCtl_tDemFanOnLim_C "Einschalttemperaturschwelle für hohe Lenköltemperaturen" VALUE 0xD0E14 Kw_Ws16 250.0000 Temp_Cels -50.14000 199.8600 FORMAT "%8.4" EXTENDED_LIMITS -3549.940 3003.560 /end CHARACTERISTIC
/begin CHARACTERISTIC FanCtl_tEngAftRunThres_C "Motortemp. Schwelle für 10Hz Nachlauf" VALUE 0xD0E16 Kw_Ws16 250.0000 Temp_Cels -50.14000 199.8600 FORMAT "%8.4" EXTENDED_LIMITS -3549.940 3003.560 /end CHARACTERISTIC
/begin CHARACTERISTIC FanCtl_tGbxOilDfl_C "Default Gear box oil temperature" VALUE 0xD0E18 Kw_Ws16 950.0000 Temp_Cels -50.1400 899.8600 FORMAT "%8.4" EXTENDED_LIMITS -3549.940 3003.560 /end CHARACTERISTIC
/begin CHARACTERISTIC FanCtl_tiDemFanOn_C "Zeit bis die Lüfterdrehzahl auf den Vorgabewert für hohe Lenköltemperaturen umgeschaltet wird" VALUE 0xD0E1C Kw_Wu32 42949672.9500 Time_s 0.00 42949672.9500 FORMAT "%13.4" /end CHARACTERISTIC
/begin CHARACTERISTIC FanCtl_tiMinAftRunOfs_C "neg. Offset zur min. SG-Nachlaufzeit" VALUE 0xD0E20 Kw_Wu32 42949672950.0 Time_ms 0.00 42949672950.0 FORMAT "%13.1" /end CHARACTERISTIC
/begin CHARACTERISTIC FanCtl_uBattRef_C "Batteriespannungs, Referenzwert" VALUE 0xD0E24 Kw_Ws16 28602.15 Volt_Batt 0.00 28602.15 FORMAT "%8.2" EXTENDED_LIMITS -640625.6 640606.1 /end CHARACTERISTIC
/begin CHARACTERISTIC FanCtl_vDemFanOffMax_C "Obere Ausschaltgeschwindigkeitsschwelle für hohe Lenköltemperaturen" VALUE 0xD0E26 Kw_Ws16 327.6700 Vel 0.00 327.6700 FORMAT "%8.4" EXTENDED_LIMITS -327.6800 327.6700 /end CHARACTERISTIC
/begin CHARACTERISTIC FanCtl_vDemFanOffMin_C "Untere Ausschaltgeschwindigkeitsschwelle für hohe Lenköltemperaturen" VALUE 0xD0E28 Kw_Ws16 327.6700 Vel 0.00 327.6700 FORMAT "%8.4" EXTENDED_LIMITS -327.6800 327.6700 /end CHARACTERISTIC
/begin CHARACTERISTIC FanCtl_vDemFanOnMax_C "Obere Einschaltgeschwindigkeitsschwelle für hohe Lenköltemperaturen" VALUE 0xD0E2A Kw_Ws16 327.6700 Vel 0.00 327.6700 FORMAT "%8.4" EXTENDED_LIMITS -327.6800 327.6700 /end CHARACTERISTIC
/begin CHARACTERISTIC FanCtl_vDemFanOnMin_C "Untere Einschaltgeschwindigkeitsschwelle für hohe Lenköltemperaturen" VALUE 0xD0E2C Kw_Ws16 327.6700 Vel 0.00 327.6700 FORMAT "%8.4" EXTENDED_LIMITS -327.6800 327.6700 /end CHARACTERISTIC
/begin CHARACTERISTIC FBC_AACoeff_C "Antialiasingfilterkoeffizienten" VAL_BLK 0xD0F28 Kwb_Wr32 2.00000000 OneToOne -1.00000000 1.00000000 FORMAT "%10.8" EXTENDED_LIMITS -1.00000000E+37 1.00000000E+37 NUMBER 9 /end CHARACTERISTIC
/begin CHARACTERISTIC FBC_AAOrd_C "Filterordnung des Antialiasingfilter" VALUE 0xD0F4C Kw_Wu8 8.000 OneToOne 0.00 8.000 FORMAT "%5.3" EXTENDED_LIMITS 0.00 255.0 /end CHARACTERISTIC
/begin CHARACTERISTIC FBC_Act_C "=0: Geberradadaption inaktiv; =1 aktiv; =2 lösche Adaptionsergebnisspeicher (EEPROM)" VALUE 0xD0F4D Kw_Wu8 2.000 OneToOne 0.00 2.000 FORMAT "%5.3" EXTENDED_LIMITS 0.00 255.0 /end CHARACTERISTIC
/begin CHARACTERISTIC FBC_BPFac1NumG_CUR "drehmomentübersetzungsabhänige Nockenwellenbandpassverstärkung" CURVE 0xD0E30 Kl_Xs16_Ws16 60.00183 FBC_BPfac -30.00092 30.00092 FORMAT "%8.5" EXTENDED_LIMITS -60.00183 60.00000
 /begin AXIS_DESCR STD_AXIS DrvTrn_rTransDT TransR 6 0.00 100.0000 FORMAT "%8.4" EXTENDED_LIMITS -327.6800 327.6700 DEPOSIT ABSOLUTE /end AXIS_DESCR
/end CHARACTERISTIC
/begin CHARACTERISTIC FBC_dBPFacNumLo_CA "Bandpass array: Zählerkoeffizienten für unteren Drehzahlbereich" VAL_BLK 0xD0E4C Kwb_Wr32 30.0000000 OneToOne -15.0000000 15.0000000 FORMAT "%10.7" EXTENDED_LIMITS -1.00000000E+37 1.00000000E+37 NUMBER 3 /end CHARACTERISTIC
/begin CHARACTERISTIC FBC_dBPFacNumHi_CA "Bandpass array: Zählerkoeffizienten für den oberen Drehzahlbereich" VAL_BLK 0xD0E58 Kwb_Wr32 30.0000000 OneToOne -15.0000000 15.0000000 FORMAT "%10.7" EXTENDED_LIMITS -1.00000000E+37 1.00000000E+37 NUMBER 3 /end CHARACTERISTIC
/begin CHARACTERISTIC FBC_dBPFacDen1_CA "Bandpass Array: Nenner 1" VAL_BLK 0xD0E64 Kwb_Wr32 20.0000000 OneToOne -10.0000000 10.0000000 FORMAT "%10.7" EXTENDED_LIMITS -1.00000000E+37 1.00000000E+37 NUMBER 3 /end CHARACTERISTIC
/begin CHARACTERISTIC FBC_dBPFacDen2_CA "Bandpass Array: Nenner 2" VAL_BLK 0xD0E70 Kwb_Wr32 20.0000000 OneToOne -10.0000000 10.0000000 FORMAT "%10.7" EXTENDED_LIMITS -1.00000000E+37 1.00000000E+37 NUMBER 3 /end CHARACTERISTIC
/begin CHARACTERISTIC FBC_ctSegOffset_C "Abstand zwischen FBC-Berechnung und entsprechendem OT" VALUE 0xD0E7C Kw_Ws8 0.00 OneToOne 3.000 3.000 FORMAT "%5.3" EXTENDED_LIMITS -128.0 127.0 /end CHARACTERISTIC
/begin CHARACTERISTIC FBC_dSegNhiCaS_C "Segmentwert für Eng_nAvrg > FBC_nThresFbc_C" VAL_BLK 0xD0E7E Kwb_Wu16 255.9961 Per_Ratio 0.00 255.9961 FORMAT "%8.4" NUMBER 3 /end CHARACTERISTIC
/begin CHARACTERISTIC FBC_dSegNloCaS_C "Segmentwert für Eng_nAvrg < FBC_nThresFbc_C" VAL_BLK 0xD0E84 Kwb_Wu16 255.9961 Per_Ratio 0.00 255.9961 FORMAT "%8.4" NUMBER 3 /end CHARACTERISTIC
/begin CHARACTERISTIC FBC_dSyn_C "Abstand OT Zyl.1 zu Segmentzählerstand 0 (bezogen auf CrSCD_numSeg)" VALUE 0xD0E8A Kw_Ws8 24.00 OneToOne -12.00 12.00 FORMAT "%5.2" EXTENDED_LIMITS -128.0 127.0 /end CHARACTERISTIC
/begin CHARACTERISTIC FBC_DXadptl_C "Untere Schwelle der Adaptionsgüte" VALUE 0xD0F50 Kw_Wr32 1.00000000 Prc_float 0.00 1.00000000 FORMAT "%10.8" EXTENDED_LIMITS -1.00000000E+39 1.00000000E+39 /end CHARACTERISTIC
/begin CHARACTERISTIC FBC_DXadptu_C "Obere Schwelle der Adaptionsgüte" VALUE 0xD0F54 Kw_Wr32 1.00000000 Prc_float 0.00 1.00000000 FORMAT "%10.8" EXTENDED_LIMITS -1.00000000E+39 1.00000000E+39 /end CHARACTERISTIC
/begin CHARACTERISTIC FBC_DXalf0_C "Startwerte für FBC_DXSfn, FBC_DXSfp" VALUE 0xD0F58 Kw_Wr32 3.00000000 Prc_float 0.00 3.00000000 FORMAT "%10.8" EXTENDED_LIMITS -1.00000000E+39 1.00000000E+39 READ_ONLY /end CHARACTERISTIC
/begin CHARACTERISTIC FBC_fSurge_CUR "drehmomentübersetzungsabhängige Ruckelfrequenzen" CURVE 0xD0E8C Kl_Xs16_Ws16 20.00000 Surge_Frq 0.00 20.00000 FORMAT "%8.5" EXTENDED_LIMITS -273.0667 273.0583
 /begin AXIS_DESCR STD_AXIS DrvTrn_rTransDT TransR 6 0.00 100.0000 FORMAT "%8.4" EXTENDED_LIMITS -327.6800 327.6700 DEPOSIT ABSOLUTE /end AXIS_DESCR
/end CHARACTERISTIC
/begin CHARACTERISTIC FBC_GvrnIKi_C "Regler: Integrationskonstante" VALUE 0xD0EA8 Kw_Wr32 1.00000000 FBC_GvrnIKi_float 0.00 1.00000000 FORMAT "%10.8" EXTENDED_LIMITS -1.00000000E+37 1.00000000E+37 /end CHARACTERISTIC
/begin CHARACTERISTIC FBC_GvrnIKiPos_C "Regler: Integrationskonstante" VALUE 0xD0EAC Kw_Wr32 1.00000000 FBC_GvrnIKi_float 0.00 1.00000000 FORMAT "%10.8" EXTENDED_LIMITS -1.00000000E+37 1.00000000E+37 READ_ONLY /end CHARACTERISTIC
/begin CHARACTERISTIC FBC_GvrnIKiNeg_C "Regler: Integrationskonstante" VALUE 0xD0EB0 Kw_Wr32 1.00000000 FBC_GvrnIKi_float 0.00 1.00000000 FORMAT "%10.8" EXTENDED_LIMITS -1.00000000E+37 1.00000000E+37 READ_ONLY /end CHARACTERISTIC
/begin CHARACTERISTIC FBC_GvrnIWinPos_C "Regler: I-Parameter" VALUE 0xD0EB4 Kw_Wr32 12200.0000 EngN_float -6100.00000 6100.00000 FORMAT "%10.5" EXTENDED_LIMITS -1.00000000E+37 1.00000000E+37 READ_ONLY /end CHARACTERISTIC
/begin CHARACTERISTIC FBC_GvrnIWinNeg_C "Regler: I-Parameter" VALUE 0xD0EB8 Kw_Wr32 12200.0000 EngN_float -6100.00000 6100.00000 FORMAT "%10.5" EXTENDED_LIMITS -1.00000000E+37 1.00000000E+37 READ_ONLY /end CHARACTERISTIC
/begin CHARACTERISTIC FBC_GvrnPKp_C "Regler: Proportionaltitätskonstante" VALUE 0xD0EBC Kw_Wr32 1.00000000 FBC_GvrnPKp_float 0.00 1.00000000 FORMAT "%10.8" EXTENDED_LIMITS -1.00000000E+37 1.00000000E+37 /end CHARACTERISTIC
/begin CHARACTERISTIC FBC_GvrnPKpPos_C "Regler: Proportionaltitätskonstante" VALUE 0xD0EC0 Kw_Wr32 1.00000000 FBC_GvrnPKp_float 0.00 1.00000000 FORMAT "%10.8" EXTENDED_LIMITS -1.00000000E+37 1.00000000E+37 READ_ONLY /end CHARACTERISTIC
/begin CHARACTERISTIC FBC_GvrnPKpNeg_C "Regler: Proportionaltitätskonstante" VALUE 0xD0EC4 Kw_Wr32 1.00000000 FBC_GvrnPKp_float 0.00 1.00000000 FORMAT "%10.8" EXTENDED_LIMITS -1.00000000E+37 1.00000000E+37 READ_ONLY /end CHARACTERISTIC
/begin CHARACTERISTIC FBC_GvrnPWinPos_C "Regler: P-Parameter" VALUE 0xD0EC8 Kw_Wr32 12200.0000 EngN_float -6100.00000 6100.00000 FORMAT "%10.5" EXTENDED_LIMITS -1.00000000E+37 1.00000000E+37 READ_ONLY /end CHARACTERISTIC
/begin CHARACTERISTIC FBC_GvrnPWinNeg_C "Regler: P-Parameter" VALUE 0xD0ECC Kw_Wr32 12200.0000 EngN_float -6100.00000 6100.00000 FORMAT "%10.5" EXTENDED_LIMITS -1.00000000E+37 1.00000000E+37 READ_ONLY /end CHARACTERISTIC
/begin CHARACTERISTIC FBC_lrn_Vector "#SSD Bypass Label, nicht ändern!" VALUE 0xC2EC2 Kw_Wu8 255.0 OneToOne 0.00 255.0 FORMAT "%5.1" /end CHARACTERISTIC
/begin CHARACTERISTIC FBC_lrn_Channel "#SSD Bypass Label, nicht ändern!" VALUE 0xC2EC3 Kw_Wu8 255.0 OneToOne 0.00 255.0 FORMAT "%5.1" /end CHARACTERISTIC
/begin CHARACTERISTIC FBC_nCtlOfsMin_C "Offset der unteren drehzahlabhängigen Steuerschwelle zur aktuellen Leerlaufdrehzahl" VALUE 0xD0ED0 Kw_Ws16 65535.00 EngN -32768.00 32767.00 FORMAT "%8.2" /end CHARACTERISTIC
/begin CHARACTERISTIC FBC_nCtlThresMax_C "obere Drehzahlsteuerschwelle" VALUE 0xD0ED2 Kw_Ws16 65535.00 EngN -32768.00 32767.00 FORMAT "%8.2" /end CHARACTERISTIC
/begin CHARACTERISTIC FBC_nGvrnOfsMin_C "Offset der unteren drehzahlabhängigen Regelschwelle zur aktuellen Leerlaufdrehzahl" VALUE 0xD0ED4 Kw_Ws16 65535.00 EngN -32768.00 32767.00 FORMAT "%8.2" /end CHARACTERISTIC
/begin CHARACTERISTIC FBC_nGvrnThresMax_C "obere Drehzahlregelschwelle" VALUE 0xD0ED6 Kw_Ws16 6000.000 EngN 0.00 6000.000 FORMAT "%8.3" EXTENDED_LIMITS -32768.00 32767.00 /end CHARACTERISTIC
/begin CHARACTERISTIC FBC_nHyst_C "Drehzahlhysterese" VALUE 0xD0ED8 Kw_Ws16 100.0000 EngN 0.00 100.0000 FORMAT "%8.4" EXTENDED_LIMITS -32768.00 32767.00 /end CHARACTERISTIC
/begin CHARACTERISTIC FBC_nLrnThres_C "Drehzahlschwellen der Lernbereiche der Geberradadaption" VAL_BLK 0xD0F5C Kwb_Ws16 6000.000 EngN 0.00 6000.000 FORMAT "%8.3" EXTENDED_LIMITS -32768.00 32767.00 NUMBER 3 /end CHARACTERISTIC
/begin CHARACTERISTIC FBC_nSurgeOffset_C "pos. Offset zur kritischen Drehzahl, bei der fNW=fRuck gilt." VALUE 0xD0EDA Kw_Ws16 1000.000 EngN 0.00 1000.000 FORMAT "%8.3" EXTENDED_LIMITS -32768.00 32767.00 /end CHARACTERISTIC
/begin CHARACTERISTIC FBC_nThresFbc_C "Komfortdrehzahlbereich für Segmentwerte" VALUE 0xD0F62 Kw_Ws16 65535.00 EngN -32768.00 32767.00 FORMAT "%8.2" /end CHARACTERISTIC
/begin CHARACTERISTIC FBC_qCtlOfsMax_C "Offset für obere mengenabhängige Steuerschwelle" VALUE 0xD0EDC Kw_Ws16 655.3500 InjMass -327.6800 327.6700 FORMAT "%8.4" /end CHARACTERISTIC
/begin CHARACTERISTIC FBC_qCtlThresMin_C "untere Mengensteuerschwelle" VALUE 0xD0EDE Kw_Ws16 655.3500 InjMass -327.6800 327.6700 FORMAT "%8.4" /end CHARACTERISTIC
/begin CHARACTERISTIC FBC_qDvtMax_CUR "Kennlinie zur Berechnung der max. Integratorwertschwelle" CURVE 0xD0EE0 Kl_Xs16_Ws16 655.3400 InjMass -327.6700 327.6700 FORMAT "%8.4" EXTENDED_LIMITS -327.6800 327.6700
 /begin AXIS_DESCR STD_AXIS InjCtl_qSetUnBal InjMassCyc 2 0.00 327.6700 FORMAT "%8.4" EXTENDED_LIMITS -327.6800 327.6700 DEPOSIT ABSOLUTE /end AXIS_DESCR
/end CHARACTERISTIC
/begin CHARACTERISTIC FBC_qDvtMin_CUR "Kennlinie zur Berechnung der min. Integratorwertschwelle" CURVE 0xD0EEA Kl_Xs16_Ws16 655.3400 InjMass -327.6700 327.6700 FORMAT "%8.4" EXTENDED_LIMITS -327.6800 327.6700
 /begin AXIS_DESCR STD_AXIS InjCtl_qSetUnBal InjMassCyc 2 0.00 327.6700 FORMAT "%8.4" EXTENDED_LIMITS -327.6800 327.6700 DEPOSIT ABSOLUTE /end AXIS_DESCR
/end CHARACTERISTIC
/begin CHARACTERISTIC FBC_qGvrnThresMax_CUR "obere mengenabhängige Regelschwelle" CURVE 0xD0EF4 Kl_Xs16_Ws16 327.6700 InjMass 0.00 327.6700 FORMAT "%8.4" EXTENDED_LIMITS -327.6800 327.6700
 /begin AXIS_DESCR STD_AXIS Eng_nAvrg EngN 4 0.00 6000.000 FORMAT "%8.3" EXTENDED_LIMITS -32768.00 32767.00 DEPOSIT ABSOLUTE /end AXIS_DESCR
/end CHARACTERISTIC
/begin CHARACTERISTIC FBC_qGvrnThresMin_C "untere Mengenregelschwelle" VALUE 0xD0F06 Kw_Ws16 655.3500 InjMass -327.6800 327.6700 FORMAT "%8.4" /end CHARACTERISTIC
/begin CHARACTERISTIC FBC_qLim_CUR "mengenabhängige Korrekturmengenbegrenzung" CURVE 0xD0F08 Kl_Xs16_Ws16 327.6700 InjMass 0.00 327.6700 FORMAT "%8.4" EXTENDED_LIMITS -327.6800 327.6700
 /begin AXIS_DESCR STD_AXIS InjCtl_qSetUnBal InjMassCyc 4 0.00 327.6700 FORMAT "%8.4" EXTENDED_LIMITS -327.6800 327.6700 DEPOSIT ABSOLUTE /end AXIS_DESCR
/end CHARACTERISTIC
/begin CHARACTERISTIC FBC_q_Vector "#SSD Bypass Label, nicht ändern!" VALUE 0xC2EC0 Kw_Wu8 255.0 OneToOne 0.00 255.0 FORMAT "%5.1" /end CHARACTERISTIC
/begin CHARACTERISTIC FBC_q_Channel "#SSD Bypass Label, nicht ändern!" VALUE 0xC2EC1 Kw_Wu8 255.0 OneToOne 0.00 255.0 FORMAT "%5.1" /end CHARACTERISTIC
/begin CHARACTERISTIC FBC_stInitI_C "Initialisierung des I-Anteils im Zustand ""inaktiv"": '0' einfrieren, '1' mit 0 initialisieren." VALUE 0xD0F1A Kw_Ws8 1.000 OneToOne 0.00 1.000 FORMAT "%5.3" EXTENDED_LIMITS -128.0 127.0 /end CHARACTERISTIC
/begin CHARACTERISTIC FBC_stMskRgn_C "Maske für Regenerationsstatus (NOx-Kat)" VALUE 0xD0F1C Kw_Ws32 4294967295.00 OneToOne -2147483648.00 2147483647.00 FORMAT "%13.2" /end CHARACTERISTIC
/begin CHARACTERISTIC FBC_TFlrn_C "Filterkoeffizient des Bewertungsfilters" VALUE 0xD0F64 Kw_Wr32 1.00000000 OneToOne 0.00 1.00000000 FORMAT "%10.8" EXTENDED_LIMITS -1.00000000E+37 1.00000000E+37 /end CHARACTERISTIC
/begin CHARACTERISTIC FBC_TF_C "Filterkoeffizient des Adaptionsfilters" VALUE 0xD0F68 Kw_Wr32 1.00000000 OneToOne 0.00 1.00000000 FORMAT "%10.8" EXTENDED_LIMITS -1.00000000E+37 1.00000000E+37 /end CHARACTERISTIC
/begin CHARACTERISTIC FBC_ThresDyn_C "Drehzahldynamikgrenzwert um die Adaption zu deaktivieren" VALUE 0xD0F6C Kw_Wr32 1.00000000 OneToOne 0.00 1.00000000 FORMAT "%10.8" EXTENDED_LIMITS -1.00000000E+37 1.00000000E+37 /end CHARACTERISTIC
/begin CHARACTERISTIC FBC_tiDvtMaxDefect_C "Fehler-Entprellzeit Überwachung Integratorwert (Max)" VALUE 0xD0F20 Kw_Wu16 655350.0 Time_ms 0.00 655350.0 FORMAT "%8.1" /end CHARACTERISTIC
/begin CHARACTERISTIC FBC_tiDvtMaxOk_C "Heilung-Entprellzeit Überwachung Integratorwert (Max)" VALUE 0xD0F22 Kw_Wu16 655350.0 Time_ms 0.00 655350.0 FORMAT "%8.1" /end CHARACTERISTIC
/begin CHARACTERISTIC FBC_tiDvtMinDefect_C "Fehler-Entprellzeit Überwachung Integratorwert (Min)" VALUE 0xD0F24 Kw_Wu16 655350.0 Time_ms 0.00 655350.0 FORMAT "%8.1" /end CHARACTERISTIC
/begin CHARACTERISTIC FBC_tiDvtMinOk_C "Heilung-Entprellzeit Überwachung Integratorwert (Min)" VALUE 0xD0F26 Kw_Wu16 655350.0 Time_ms 0.00 655350.0 FORMAT "%8.1" /end CHARACTERISTIC
/begin CHARACTERISTIC FBC_TSm_C "Koeffizienten für Mittelwertfilter" VAL_BLK 0xD0F70 Kwb_Wr32 13.0000000 OneToOne -6.00000000 7.00000000 FORMAT "%10.8" EXTENDED_LIMITS -1.00000000E+37 1.00000000E+37 NUMBER 2 /end CHARACTERISTIC
/begin CHARACTERISTIC FlFCD_numDioIn_C "#SSD Auswahl des digitalen Eingangspins des Sensors der Wasserstandserkennung im Kraftstofffilter" VALUE 0xD0F78 Kw_Wu8 14.0000000000 NumPinDioIn 0.00 14.0000000000 FORMAT "%13.10" /end CHARACTERISTIC
/begin CHARACTERISTIC FlFCD_swtFlFltInv_C "Schalter zum Invertieren des Eingangssignals" VALUE 0xD0F79 Kw_Wu8 1.000 OneToOne 0.00 1.000 FORMAT "%5.3" EXTENDED_LIMITS 0.00 255.0 /end CHARACTERISTIC
/begin CHARACTERISTIC FlFCD_swtFlFltSens_C "Kraftstofffilter-Sensor vorhanden" VALUE 0xD0F7A Kw_Wu8 1.000 OneToOne 0.00 1.000 FORMAT "%5.3" EXTENDED_LIMITS 0.00 255.0 /end CHARACTERISTIC
/begin CHARACTERISTIC FlFCD_tiDebFlFltDef_C "Fehlerentprellzeit für Kraftstofffilter-Sensor" VALUE 0xD0F7C Kw_Wu16 655350.0 Time_ms 0.00 655350.0 FORMAT "%8.1" /end CHARACTERISTIC
/begin CHARACTERISTIC FlFCD_tiDebFlFltOk_C "Heilungsentprellzeit für Kraftstofffilter-Sensor" VALUE 0xD0F7E Kw_Wu16 655350.0 Time_ms 0.00 655350.0 FORMAT "%8.1" /end CHARACTERISTIC
/begin CHARACTERISTIC FlFCD_tiFlFltDebNeg_C "Entprellzeit für negative Flanken" VALUE 0xD0F80 Kw_Wu16 2000.000 TimeDeb 0.00 2000.000 FORMAT "%8.3" EXTENDED_LIMITS 0.00 655350.0 /end CHARACTERISTIC
/begin CHARACTERISTIC FlFCD_tiFlFltDebPos_C "Entprellzeit für positive Flanken" VALUE 0xD0F82 Kw_Wu16 2000.000 TimeDeb 0.00 2000.000 FORMAT "%8.3" EXTENDED_LIMITS 0.00 655350.0 /end CHARACTERISTIC
/begin CHARACTERISTIC FlMng_tiDebSmkDefectDef_C "debounce duration for detached charge air tube error detection" VALUE 0xD0F84 Kw_Wu16 655350.0 Time_ms 0.00 655350.0 FORMAT "%8.1" /end CHARACTERISTIC
/begin CHARACTERISTIC FlMng_tiDebSmkDefectOk_C "debounce duration for detached charge air tube error healing" VALUE 0xD0F86 Kw_Wu16 655350.0 Time_ms 0.00 655350.0 FORMAT "%8.1" /end CHARACTERISTIC
/begin CHARACTERISTIC FlMng_dqLimUp_C "step per time interval for ramping up" VALUE 0xD0F88 Kw_Wu32 655359.999847 RmpInjMass 0.00 655359.999847 FORMAT "%13.6" /end CHARACTERISTIC
/begin CHARACTERISTIC FlMng_dqLimDwn_C "step per time interval for ramping down" VALUE 0xD0F8C Kw_Wu32 655359.999847 RmpInjMass 0.00 655359.999847 FORMAT "%13.6" /end CHARACTERISTIC
/begin CHARACTERISTIC FlMng_dSmkLimUp_C "ramp gradient for ramping up" VALUE 0xD0F90 Kw_Wu32 2621439999.39 PrcPerSec 0.00 2621439999.39 FORMAT "%13.2" /end CHARACTERISTIC
/begin CHARACTERISTIC FlMng_dSmkLimDwn_C "ramp gradient for ramping down" VALUE 0xD0F94 Kw_Wu32 2621439999.39 PrcPerSec 0.00 2621439999.39 FORMAT "%13.2" /end CHARACTERISTIC
/begin CHARACTERISTIC FlMng_facAPSCorNeg_CUR "Kennlinie zur multiplikativen Korrektur der Filterzeitkonstante bei negativer Änderung der Luftmasse" CURVE 0xD0F98 Kl_Xs16_Ws16 5.000000 Fact 0.00 5.000000 FORMAT "%8.6" EXTENDED_LIMITS -4.000000 3.999878
 /begin AXIS_DESCR STD_AXIS APSCD_pVal Pres_hPa 8 0.00 3500.0000 FORMAT "%8.4" EXTENDED_LIMITS -32768.00 32767.00 DEPOSIT ABSOLUTE /end AXIS_DESCR
/end CHARACTERISTIC
/begin CHARACTERISTIC FlMng_facAPSCorPos_CUR "Kennlinie zur multiplikativen Korrektur der Filterzeitkonstante bei positiver Änderung der Luftmasse" CURVE 0xD0FBA Kl_Xs16_Ws16 5.000000 Fact 0.00 5.000000 FORMAT "%8.6" EXTENDED_LIMITS -4.000000 3.999878
 /begin AXIS_DESCR STD_AXIS APSCD_pVal Pres_hPa 8 0.00 3500.0000 FORMAT "%8.4" EXTENDED_LIMITS -32768.00 32767.00 DEPOSIT ABSOLUTE /end AXIS_DESCR
/end CHARACTERISTIC
/begin CHARACTERISTIC FlMng_facLmbdAPSCor_CUR "Multiplicative air pressure correction" CURVE 0xD0FDC Kl_Xs16_Ws16 5.000000 Fact 0.00 5.000000 FORMAT "%8.6" EXTENDED_LIMITS -4.000000 3.999878
 /begin AXIS_DESCR STD_AXIS APSCD_pVal Pres_hPa 8 0.00 3500.0000 FORMAT "%8.4" EXTENDED_LIMITS -32768.00 32767.00 DEPOSIT ABSOLUTE /end AXIS_DESCR
/end CHARACTERISTIC
/begin CHARACTERISTIC FlMng_facLmbdATSCor_CUR "Multiplicative ATS correction" CURVE 0xD0FFE Kl_Xs16_Ws16 5.000000 Fact 0.00 5.000000 FORMAT "%8.6" EXTENDED_LIMITS -4.000000 3.999878
 /begin AXIS_DESCR STD_AXIS IATSCD_tAir Temp_Cels 8 -50.1400 899.8600 FORMAT "%8.4" EXTENDED_LIMITS -3549.940 3003.560 DEPOSIT ABSOLUTE /end AXIS_DESCR
/end CHARACTERISTIC
/begin CHARACTERISTIC FlMng_facLmbdETSCor_CUR "Multiplicative ETS correction" CURVE 0xD1020 Kl_Xs16_Ws16 5.000000 Fact 0.00 5.000000 FORMAT "%8.6" EXTENDED_LIMITS -4.000000 3.999878
 /begin AXIS_DESCR STD_AXIS Eng_tEng Temp_Cels 8 -50.1400 899.8600 FORMAT "%8.4" EXTENDED_LIMITS -3549.940 3003.560 DEPOSIT ABSOLUTE /end AXIS_DESCR
/end CHARACTERISTIC
/begin CHARACTERISTIC FlMng_FullLdRglIKi_CUR "Drehzahlabhängige Ki-Parameter der Vollastregelung" CURVE 0xD3228 Kl_Xs16_Ws16 762.9162 Ki_LmbdRec2InjMass 0.00 762.9162 FORMAT "%8.4" EXTENDED_LIMITS -762.9395 762.9162
 /begin AXIS_DESCR STD_AXIS Eng_nAvrg EngN 7 0.00 6000.000 FORMAT "%8.3" EXTENDED_LIMITS -32768.00 32767.00 DEPOSIT ABSOLUTE /end AXIS_DESCR
/end CHARACTERISTIC
/begin CHARACTERISTIC FlMng_qFullLdRglMax_C "Maximale Stellgröße für Vollastregler" VALUE 0xD3246 Kw_Ws16 327.6700 InjMass 0.00 327.6700 FORMAT "%8.4" EXTENDED_LIMITS -327.6800 327.6700 /end CHARACTERISTIC
/begin CHARACTERISTIC FlMng_qFullLdRglMin_C "Minimale Stellgröße für Volllastregler" VALUE 0xD3248 Kw_Ws16 327.6800 InjMass -327.6800 0.00 FORMAT "%8.4" EXTENDED_LIMITS -327.6800 327.6700 /end CHARACTERISTIC
/begin CHARACTERISTIC FlMng_FullLdRglPKp_CUR "Drehzahlabhängige P-Parameter der Vollastregelung" CURVE 0xD324A Kl_Xs16_Ws16 399.9878 Kp_LmbdRec2InjMass_1 0.00 399.9878 FORMAT "%8.4" EXTENDED_LIMITS -400.0000 399.9878
 /begin AXIS_DESCR STD_AXIS Eng_nAvrg EngN 7 0.00 6000.000 FORMAT "%8.3" EXTENDED_LIMITS -32768.00 32767.00 DEPOSIT ABSOLUTE /end AXIS_DESCR
/end CHARACTERISTIC
/begin CHARACTERISTIC FlMng_mAirPerCylMin_C "untere Begrenzung der Luftmasse" VALUE 0xD1042 Kw_Ws16 6553.500 AirMassPerCyl -3276.800 3276.700 FORMAT "%8.3" /end CHARACTERISTIC
/begin CHARACTERISTIC FlMng_numRevEng_C "Threshold for revolution counter" VALUE 0xD1044 Kw_Wu16 65535.00 OneToOne 0.00 65535.00 FORMAT "%8.2" /end CHARACTERISTIC
/begin CHARACTERISTIC FlMng_pThresLmbd0_C "environment pressure threshold for dynamic smoke limitation" VALUE 0xD1046 Kw_Ws16 3500.000 Pres_hPa 0.00 3500.000 FORMAT "%8.3" EXTENDED_LIMITS -32768.00 32767.00 /end CHARACTERISTIC
/begin CHARACTERISTIC FlMng_pThresLmbd1_C "environment pressure threshold  for static smoke limitation" VALUE 0xD1048 Kw_Ws16 3500.000 Pres_hPa 0.00 3500.000 FORMAT "%8.3" EXTENDED_LIMITS -32768.00 32767.00 /end CHARACTERISTIC
/begin CHARACTERISTIC FlMng_pThresLmbd2_C "environment pressure threshold for static smoke limitation" VALUE 0xD104A Kw_Ws16 3500.000 Pres_hPa 0.00 3500.000 FORMAT "%8.3" EXTENDED_LIMITS -32768.00 32767.00 /end CHARACTERISTIC
/begin CHARACTERISTIC FlMng_qDefectMin_MAP "Rauchbegrenzungsmenge bei abgefallenen Ladeluftschlauch" MAP 0xD104C Kf_Xs16_Ys16_Ws16 327.6700 InjMass 0.00 327.6700 FORMAT "%8.4" EXTENDED_LIMITS -327.6800 327.6700
 /begin AXIS_DESCR STD_AXIS Eng_nAvrg EngN 16 0.00 6000.000 FORMAT "%8.3" EXTENDED_LIMITS -32768.00 32767.00 DEPOSIT ABSOLUTE /end AXIS_DESCR
 /begin AXIS_DESCR STD_AXIS APSCD_pVal Pres_hPa 16 0.00 3500.000 FORMAT "%8.3" EXTENDED_LIMITS -32768.00 32767.00 DEPOSIT ABSOLUTE /end AXIS_DESCR
/end CHARACTERISTIC
/begin CHARACTERISTIC FlMng_qDefectOfs_C "Offset Wert für Erkennung eines abgefallenen Ladeluftschlauch" VALUE 0xD1290 Kw_Ws16 327.6700 InjMass 0.00 327.6700 FORMAT "%8.4" EXTENDED_LIMITS -327.6800 327.6700 /end CHARACTERISTIC
/begin CHARACTERISTIC FlMng_qEngTemp_CUR "fuel mass = f(engine temperature)" CURVE 0xD1292 Kl_Xs16_Ws16 327.6700 InjMassInj 0.00 327.6700 FORMAT "%8.4" EXTENDED_LIMITS -327.6800 327.6700
 /begin AXIS_DESCR STD_AXIS Eng_tEng Temp_Cels 5 -50.14000 199.8600 FORMAT "%8.4" EXTENDED_LIMITS -3549.940 3003.560 DEPOSIT ABSOLUTE /end AXIS_DESCR
/end CHARACTERISTIC
/begin CHARACTERISTIC FlMng_rLmbdAPSCor_MAP "Kennfeld zur Ermittlung des Lambda-Korrekturwertes in Abhängigkeit des Umgebungsdrucks" MAP 0xD12A8 Kf_Xs16_Ys16_Ws16 32.00000 lambda 0.00 32.00000 FORMAT "%8.5" EXTENDED_LIMITS -32.76800 32.76700
 /begin AXIS_DESCR STD_AXIS Eng_nAvrg EngN 16 0.00 6000.000 FORMAT "%8.3" EXTENDED_LIMITS -32768.00 32767.00 DEPOSIT ABSOLUTE /end AXIS_DESCR
 /begin AXIS_DESCR STD_AXIS ASMod_mAirPerCylCorr AirMassPerCyl 16 0.00 2500.000 FORMAT "%8.3" EXTENDED_LIMITS -3276.800 3276.700 DEPOSIT ABSOLUTE /end AXIS_DESCR
/end CHARACTERISTIC
/begin CHARACTERISTIC FlMng_rLmbdATSCor_MAP "map to determine the lambda value of smoke limitation for Intake air temperature correction" MAP 0xD14EC Kf_Xs16_Ys16_Ws16 32.00000 lambda 0.00 32.00000 FORMAT "%8.5" EXTENDED_LIMITS -32.76800 32.76700
 /begin AXIS_DESCR STD_AXIS Eng_nAvrg EngN 16 0.00 6000.000 FORMAT "%8.3" EXTENDED_LIMITS -32768.00 32767.00 DEPOSIT ABSOLUTE /end AXIS_DESCR
 /begin AXIS_DESCR STD_AXIS ASMod_mAirPerCylCorr AirMassPerCyl 16 0.00 2500.000 FORMAT "%8.3" EXTENDED_LIMITS -3276.800 3276.700 DEPOSIT ABSOLUTE /end AXIS_DESCR
/end CHARACTERISTIC
/begin CHARACTERISTIC FlMng_rLmbdETSCor_MAP "map to determine the lambda value of smoke limitation for Engine temperature correction" MAP 0xD1730 Kf_Xs16_Ys16_Ws16 32.00000 lambda 0.00 32.00000 FORMAT "%8.5" EXTENDED_LIMITS -32.76800 32.76700
 /begin AXIS_DESCR STD_AXIS Eng_nAvrg EngN 16 0.00 6000.000 FORMAT "%8.3" EXTENDED_LIMITS -32768.00 32767.00 DEPOSIT ABSOLUTE /end AXIS_DESCR
 /begin AXIS_DESCR STD_AXIS ASMod_mAirPerCylCorr AirMassPerCyl 16 0.00 2500.000 FORMAT "%8.3" EXTENDED_LIMITS -3276.800 3276.700 DEPOSIT ABSOLUTE /end AXIS_DESCR
/end CHARACTERISTIC
/begin CHARACTERISTIC FlMng_rLmbdRecDvtMax_C "Maximale reziproke Lamda-Regelabweichung der Volllastregelung" VALUE 0xD3268 Kw_Ws16 1.330000 lambdaRec 0.00 1.330000 FORMAT "%8.6" EXTENDED_LIMITS -3.276800 3.276700 /end CHARACTERISTIC
/begin CHARACTERISTIC FlMng_rLmbdRecDvtMin_C "Minimale reziproke Lambda-Regelabweichung der Vollastregelung" VALUE 0xD326A Kw_Ws16 1.330000 lambdaRec -1.330000 0.00 FORMAT "%8.6" EXTENDED_LIMITS -3.276800 3.276700 /end CHARACTERISTIC
/begin CHARACTERISTIC FlMng_rLmbdSmk2FDC_MAP " 2nd map to determine the lambda value of smoke limitation" MAP 0xD1974 Kf_Xs16_Ys16_Ws16 32.00000 lambda 0.00 32.00000 FORMAT "%8.5" EXTENDED_LIMITS -32.76800 32.76700
 /begin AXIS_DESCR STD_AXIS Eng_nAvrg EngN 16 0.00 6000.000 FORMAT "%8.3" EXTENDED_LIMITS -32768.00 32767.00 DEPOSIT ABSOLUTE /end AXIS_DESCR
 /begin AXIS_DESCR STD_AXIS FlMng_mAirPerCylFltSmk_mp AirMassPerCyl 16 0.00 2500.000 FORMAT "%8.3" EXTENDED_LIMITS -3276.800 3276.700 DEPOSIT ABSOLUTE /end AXIS_DESCR
/end CHARACTERISTIC
/begin CHARACTERISTIC FlMng_rLmbdSmk2UpperGbxFDC_MAP "2nd map to determine the lambda value of smoke limitation in case the gear belongs to upper gear box" MAP 0xD1BB8 Kf_Xs16_Ys16_Ws16 32.00000 lambda 0.00 32.00000 FORMAT "%8.5" EXTENDED_LIMITS -32.76800 32.76700
 /begin AXIS_DESCR STD_AXIS Eng_nAvrg EngN 16 0.00 6000.000 FORMAT "%8.3" EXTENDED_LIMITS -32768.00 32767.00 DEPOSIT ABSOLUTE /end AXIS_DESCR
 /begin AXIS_DESCR STD_AXIS FlMng_mAirPerCylFltSmk_mp AirMassPerCyl 16 0.00 2500.000 FORMAT "%8.3" EXTENDED_LIMITS -3276.800 3276.700 DEPOSIT ABSOLUTE /end AXIS_DESCR
/end CHARACTERISTIC
/begin CHARACTERISTIC FlMng_rLmbdSmk2UpperGbx_MAP "2nd map to determine the lambda value of smoke limitation in case the gear belongs to upper gear box" MAP 0xD1DFC Kf_Xs16_Ys16_Ws16 32.00000 lambda 0.00 32.00000 FORMAT "%8.5" EXTENDED_LIMITS -32.76800 32.76700
 /begin AXIS_DESCR STD_AXIS Eng_nAvrg EngN 16 0.00 6000.000 FORMAT "%8.3" EXTENDED_LIMITS -32768.00 32767.00 DEPOSIT ABSOLUTE /end AXIS_DESCR
 /begin AXIS_DESCR STD_AXIS ASMod_mAirPerCylCorr AirMassPerCyl 16 0.00 2500.000 FORMAT "%8.3" EXTENDED_LIMITS -3276.800 3276.700 DEPOSIT ABSOLUTE /end AXIS_DESCR
/end CHARACTERISTIC
/begin CHARACTERISTIC FlMng_rLmbdSmk2_MAP "Map number 2 for determining the lambda value for smoke limitation" MAP 0xD2040 Kf_Xs16_Ys16_Ws16 32.00000 lambda 0.00 32.00000 FORMAT "%8.5" EXTENDED_LIMITS -32.76800 32.76700
 /begin AXIS_DESCR STD_AXIS Eng_nAvrg EngN 16 0.00 6000.000 FORMAT "%8.3" EXTENDED_LIMITS -32768.00 32767.00 DEPOSIT ABSOLUTE /end AXIS_DESCR
 /begin AXIS_DESCR STD_AXIS ASMod_mAirPerCylCorr AirMassPerCyl 16 0.00 2500.000 FORMAT "%8.3" EXTENDED_LIMITS -3276.800 3276.700 DEPOSIT ABSOLUTE /end AXIS_DESCR
/end CHARACTERISTIC
/begin CHARACTERISTIC FlMng_rLmbdSmkFDC_MAP "map to determine the lambda value of smoke limitation" MAP 0xD2284 Kf_Xs16_Ys16_Ws16 32.00000 lambda 0.00 32.00000 FORMAT "%8.5" EXTENDED_LIMITS -32.76800 32.76700
 /begin AXIS_DESCR STD_AXIS Eng_nAvrg EngN 16 0.00 6000.000 FORMAT "%8.3" EXTENDED_LIMITS -32768.00 32767.00 DEPOSIT ABSOLUTE /end AXIS_DESCR
 /begin AXIS_DESCR STD_AXIS FlMng_mAirPerCylFltSmk_mp AirMassPerCyl 16 0.00 2500.000 FORMAT "%8.3" EXTENDED_LIMITS -3276.800 3276.700 DEPOSIT ABSOLUTE /end AXIS_DESCR
/end CHARACTERISTIC
/begin CHARACTERISTIC FlMng_rLmbdSmkRgn1_MAP "Kennfeld zur Ermittlung des Lambda-Wertes der Rauchbegrenzung im Regenerationszustand 1" MAP 0xD24C8 Kf_Xs16_Ys16_Ws16 32.00000 lambda 0.00 32.00000 FORMAT "%8.5" EXTENDED_LIMITS -32.76800 32.76700
 /begin AXIS_DESCR STD_AXIS Eng_nAvrg EngN 16 0.00 6000.000 FORMAT "%8.3" EXTENDED_LIMITS -32768.00 32767.00 DEPOSIT ABSOLUTE /end AXIS_DESCR
 /begin AXIS_DESCR STD_AXIS ASMod_mAirPerCylCorr AirMassPerCyl 16 0.00 2500.000 FORMAT "%8.3" EXTENDED_LIMITS -3276.800 3276.700 DEPOSIT ABSOLUTE /end AXIS_DESCR
/end CHARACTERISTIC
/begin CHARACTERISTIC FlMng_rLmbdSmkRgn2_MAP "Kennfeld zur Ermittlung des Lambda-Wertes der Rauchbegrenzung im Regenerationszustand 2" MAP 0xD270C Kf_Xs16_Ys16_Ws16 32.00000 lambda 0.00 32.00000 FORMAT "%8.5" EXTENDED_LIMITS -32.76800 32.76700
 /begin AXIS_DESCR STD_AXIS Eng_nAvrg EngN 16 0.00 6000.000 FORMAT "%8.3" EXTENDED_LIMITS -32768.00 32767.00 DEPOSIT ABSOLUTE /end AXIS_DESCR
 /begin AXIS_DESCR STD_AXIS ASMod_mAirPerCylCorr AirMassPerCyl 16 0.00 2500.000 FORMAT "%8.3" EXTENDED_LIMITS -3276.800 3276.700 DEPOSIT ABSOLUTE /end AXIS_DESCR
/end CHARACTERISTIC
/begin CHARACTERISTIC FlMng_rLmbdSmkUpperGbxFDC_MAP "map to determine the lambda value of smoke limitation in case the gear belongs to upper gear box" MAP 0xD2950 Kf_Xs16_Ys16_Ws16 32.00000 lambda 0.00 32.00000 FORMAT "%8.5" EXTENDED_LIMITS -32.76800 32.76700
 /begin AXIS_DESCR STD_AXIS Eng_nAvrg EngN 16 0.00 6000.000 FORMAT "%8.3" EXTENDED_LIMITS -32768.00 32767.00 DEPOSIT ABSOLUTE /end AXIS_DESCR
 /begin AXIS_DESCR STD_AXIS FlMng_mAirPerCylFltSmk_mp AirMassPerCyl 16 0.00 2500.000 FORMAT "%8.3" EXTENDED_LIMITS -3276.800 3276.700 DEPOSIT ABSOLUTE /end AXIS_DESCR
/end CHARACTERISTIC
/begin CHARACTERISTIC FlMng_rLmbdSmkUpperGbx_MAP "map to determine the lambda value of smoke limitation in case the gear belongs to upper gear box" MAP 0xD2B94 Kf_Xs16_Ys16_Ws16 32.00000 lambda 0.00 32.00000 FORMAT "%8.5" EXTENDED_LIMITS -32.76800 32.76700
 /begin AXIS_DESCR STD_AXIS Eng_nAvrg EngN 16 0.00 6000.000 FORMAT "%8.3" EXTENDED_LIMITS -32768.00 32767.00 DEPOSIT ABSOLUTE /end AXIS_DESCR
 /begin AXIS_DESCR STD_AXIS ASMod_mAirPerCylCorr AirMassPerCyl 16 0.00 2500.000 FORMAT "%8.3" EXTENDED_LIMITS -3276.800 3276.700 DEPOSIT ABSOLUTE /end AXIS_DESCR
/end CHARACTERISTIC
/begin CHARACTERISTIC FlMng_rLmbdSmk_MAP "Kennfeld zur Ermittlung des Lambda-Werts der Rauchbegrenzung" MAP 0xD2DD8 Kf_Xs16_Ys16_Ws16 32.00000 lambda 0.00 32.00000 FORMAT "%8.5" EXTENDED_LIMITS -32.76800 32.76700
 /begin AXIS_DESCR STD_AXIS Eng_nAvrg EngN 16 0.00 6000.000 FORMAT "%8.3" EXTENDED_LIMITS -32768.00 32767.00 DEPOSIT ABSOLUTE /end AXIS_DESCR
 /begin AXIS_DESCR STD_AXIS ASMod_mAirPerCylCorr AirMassPerCyl 16 0.00 2500.000 FORMAT "%8.3" EXTENDED_LIMITS -3276.800 3276.700 DEPOSIT ABSOLUTE /end AXIS_DESCR
/end CHARACTERISTIC
/begin CHARACTERISTIC FlMng_dqSlpPos_C "Positive Steigung der Abklingrampe der Vollastregelung" VALUE 0xD326C Kw_Wu32 655359.999847 RmpInjMass 0.00 655359.999847 FORMAT "%13.6" /end CHARACTERISTIC
/begin CHARACTERISTIC FlMng_dqSlpNeg_C "Negative Steigung der Abklingrampe der Vollastregelung" VALUE 0xD3270 Kw_Wu32 655359.999847 RmpInjMass 0.00 655359.999847 FORMAT "%13.6" /end CHARACTERISTIC
/begin CHARACTERISTIC FlMng_stEGTRglOff_C "Maske zur Abschaltung des Reglers bei Regenerationsbetrieb bei Abgasnachbehandlung" VALUE 0xD3274 Kw_Ws32 4294967295.00 OneToOne -2147483648.00 2147483647.00 FORMAT "%13.2" /end CHARACTERISTIC
/begin CHARACTERISTIC FlMng_stGearGroupSwitch_C "Switch to determine the upper gear group and the lower gear group" VALUE 0xD301C Kw_Wu8 9.000 OneToOne 1.000 10.00 FORMAT "%5.2" EXTENDED_LIMITS 0.00 255.0 /end CHARACTERISTIC
/begin CHARACTERISTIC FlMng_stRgnMsk1_C "applizierbare Bitmaske für Regenerationsanforderung 1 der Abgasnachbehandlung" VALUE 0xD3020 Kw_Wu32 2147483647.00 OneToOne 0.00 2147483647.00 FORMAT "%13.2" EXTENDED_LIMITS 0.00 4294967295.00 /end CHARACTERISTIC
/begin CHARACTERISTIC FlMng_stRgnMsk2_C "applizierbare Bitmaske für Regenerationsanforderung 2 der Abgasnachbehandlung" VALUE 0xD3024 Kw_Wu32 2147483647.00 OneToOne 0.00 2147483647.00 FORMAT "%13.2" EXTENDED_LIMITS 0.00 4294967295.00 /end CHARACTERISTIC
/begin CHARACTERISTIC FlMng_swtFullLdRglVal_C "#SSD Schalter um Volllastregelung zu (de)aktivieren" VALUE 0xD3278 Kw_Wu8 1.000 OneToOne 0.00 1.000 FORMAT "%5.3" EXTENDED_LIMITS 0.00 255.0 /end CHARACTERISTIC
/begin CHARACTERISTIC FlMng_swtFullLdRglType_C "#SSD Typ des Schalters um Volllastregelung zu (de)aktivieren" VALUE 0xD3279 Kw_Wu8 1.000 OneToOne 1.000 2.000 FORMAT "%5.3" EXTENDED_LIMITS 0.00 255.0 /end CHARACTERISTIC
/begin CHARACTERISTIC FlMng_tiAirPerCylPT1_MAP "map to get filter time constant for AFSCD_mAirPerCyl PT1 filtering" MAP 0xD3028 Kf_Xs16_Ys16_Ws16 16.776216 TimeDelay_s_2 0.0010000129 16.777216 FORMAT "%9.6" EXTENDED_LIMITS 0.00051201563 16.777216
 /begin AXIS_DESCR STD_AXIS Eng_nAvrg EngN 8 0.00 6000.000 FORMAT "%8.3" EXTENDED_LIMITS -32768.00 32767.00 DEPOSIT ABSOLUTE /end AXIS_DESCR
 /begin AXIS_DESCR STD_AXIS PCR_pBGDev Pres_hPa 8 -5000.000 5000.000 FORMAT "%8.3" EXTENDED_LIMITS -32768.00 32767.00 DEPOSIT ABSOLUTE /end AXIS_DESCR
/end CHARACTERISTIC
/begin CHARACTERISTIC FlMng_tiDefectDead_C "Zeitverzögerung zur Erkennung eines abgefallenen Ladeluftschlauchs" VALUE 0xD30CC Kw_Wu16 655.1400 Time_s 0.00 655.1400 FORMAT "%8.4" EXTENDED_LIMITS 0.00 655.3500 /end CHARACTERISTIC
/begin CHARACTERISTIC FlMng_tiFullLdRglDel_CUR "Drehzahlabhängige Einschaltverzögerung der Vollastregelung" CURVE 0xD327A Kl_Xs16_Ws16 327670.0 Time_ms 0.00 327670.0 FORMAT "%8.1" EXTENDED_LIMITS -327680.0 327670.0
 /begin AXIS_DESCR STD_AXIS Eng_nAvrg EngN 10 0.00 6000.000 FORMAT "%8.3" EXTENDED_LIMITS -32768.00 32767.00 DEPOSIT ABSOLUTE /end AXIS_DESCR
/end CHARACTERISTIC
/begin CHARACTERISTIC FlMng_tiPT1Neg_MAP "Kennfeld zur Ermittlung der Basisfilterzeitkonstante zur Filterung der Luftmasse bei negativer Änderung" MAP 0xD30CE Kf_Xs16_Ys16_Ws16 16.776216 TimeDelay_s_2 0.0010000129 16.777216 FORMAT "%9.6" EXTENDED_LIMITS 0.00051201563 16.777216
 /begin AXIS_DESCR STD_AXIS Eng_nAvrg EngN 8 0.00 6000.000 FORMAT "%8.3" EXTENDED_LIMITS -32768.00 32767.00 DEPOSIT ABSOLUTE /end AXIS_DESCR
 /begin AXIS_DESCR STD_AXIS PCR_pBGDev Pres_hPa 8 -5000.000 5000.000 FORMAT "%8.3" EXTENDED_LIMITS -32768.00 32767.00 DEPOSIT ABSOLUTE /end AXIS_DESCR
/end CHARACTERISTIC
/begin CHARACTERISTIC FlMng_tiPT1Pos_MAP "Kennfeld zur Ermittlung der Basisfilterzeitkonstante zur Filterung der Luftmasse bei positiver Änderung" MAP 0xD3172 Kf_Xs16_Ys16_Ws16 16.776216 TimeDelay_s_2 0.0010000129 16.777216 FORMAT "%9.6" EXTENDED_LIMITS 0.00051201563 16.777216
 /begin AXIS_DESCR STD_AXIS Eng_nAvrg EngN 8 0.00 6000.000 FORMAT "%8.3" EXTENDED_LIMITS -32768.00 32767.00 DEPOSIT ABSOLUTE /end AXIS_DESCR
 /begin AXIS_DESCR STD_AXIS PCR_pBGDev Pres_hPa 8 -5000.000 5000.000 FORMAT "%8.3" EXTENDED_LIMITS -32768.00 32767.00 DEPOSIT ABSOLUTE /end AXIS_DESCR
/end CHARACTERISTIC
/begin CHARACTERISTIC FlMng_tiRmpSlp_C "Rampenlaufzeit für Mehrfachschalter EGT_RgnSwtE" VALUE 0xD3218 Kw_Wu32 31.775030303030302 TimeEGTRmp 0.99296969696969695 32.768000000000001 FORMAT "%19.16" EXTENDED_LIMITS 0.000000015258789066052715 65.536000000000001 /end CHARACTERISTIC
/begin CHARACTERISTIC FlMng_trqEpsLim_C "halbe Intervallbreite für Abfrage der Abschaltbedingung" VALUE 0xD32A4 Kw_Ws16 3276.700 Trq 0.00 3276.700 FORMAT "%8.3" EXTENDED_LIMITS -3276.800 3276.700 /end CHARACTERISTIC
/begin CHARACTERISTIC FlMng_trqEps_C "Hysterese für Momentenschwellwert der Vollastregelung" VALUE 0xD32A6 Kw_Ws16 3276.700 Trq 0.00 3276.700 FORMAT "%8.3" EXTENDED_LIMITS -3276.800 3276.700 /end CHARACTERISTIC
/begin CHARACTERISTIC FlMng_trqThresInrDes0_C "torque threshold for dynamic smoke limitation" VALUE 0xD321C Kw_Ws16 1500.000 Trq -500.0000 1000.000 FORMAT "%8.3" EXTENDED_LIMITS -3276.800 3276.700 /end CHARACTERISTIC
/begin CHARACTERISTIC FlMng_trqThresInrDes1_C "torque threshold for static smoke limitation" VALUE 0xD321E Kw_Ws16 1500.000 Trq -500.0000 1000.000 FORMAT "%8.3" EXTENDED_LIMITS -3276.800 3276.700 /end CHARACTERISTIC
/begin CHARACTERISTIC FlMng_trqThresInrDes2_C "torque threshold for static smoke limitation" VALUE 0xD3220 Kw_Ws16 1500.000 Trq -500.0000 1000.000 FORMAT "%8.3" EXTENDED_LIMITS -3276.800 3276.700 /end CHARACTERISTIC
/begin CHARACTERISTIC FlMng_trqThresInr_C "torque threshold for smoke limitation" VALUE 0xD3222 Kw_Ws16 1500.000 Trq -500.0000 1000.000 FORMAT "%8.3" EXTENDED_LIMITS -3276.800 3276.700 /end CHARACTERISTIC
/begin CHARACTERISTIC FlMng_tThresLmbdHigh_C "temperature threshold high for smoke limitation" VALUE 0xD3224 Kw_Ws16 250.0000 Temp_Cels -50.14000 199.8600 FORMAT "%8.4" EXTENDED_LIMITS -3549.940 3003.560 /end CHARACTERISTIC
/begin CHARACTERISTIC FlMng_tThresLmbdLow_C "temperature threshold low for smoke limitation" VALUE 0xD3226 Kw_Ws16 250.0000 Temp_Cels -50.14000 199.8600 FORMAT "%8.4" EXTENDED_LIMITS -3549.940 3003.560 /end CHARACTERISTIC
/begin CHARACTERISTIC FlSys_nDeflateMax_C "#SSD obere Drehzahlschwelle für die Entlueftung Niederdruckkreis" VALUE 0xD32B4 Kw_Ws16 32767.00 EngN 0.00 32767.00 FORMAT "%8.2" EXTENDED_LIMITS -32768.00 32767.00 /end CHARACTERISTIC
/begin CHARACTERISTIC FlSys_nDeflateMin_C "#SSD untere Drehzahlschwelle für die Entlueftung Niederdruckkreis" VALUE 0xD32B6 Kw_Ws16 32767.00 EngN 0.00 32767.00 FORMAT "%8.2" EXTENDED_LIMITS -32768.00 32767.00 /end CHARACTERISTIC
/begin CHARACTERISTIC FlSys_pDeflate_C "#SSD Raildruckschwelle für die Entlueftung Niederdruckkreis" VALUE 0xD32B8 Kw_Ws16 2000.000 Pres_Rail 0.00 2000.000 FORMAT "%5.3" EXTENDED_LIMITS -3276.800 3276.700 /end CHARACTERISTIC
/begin CHARACTERISTIC FlSys_rhoFl_C "#SSD Kraftstoffdichte bei Normtemperatur" VALUE 0xD32A8 Kw_Ws16 999.9000 RhoFuel 0.1000000 1000.000 FORMAT "%8.3" EXTENDED_LIMITS -3276.800 3276.700 /end CHARACTERISTIC
/begin CHARACTERISTIC FlSys_rhoFl_CUR "#SSD temperaturabhängige Kraftstoffdichte" CURVE 0xD32AA Kl_Xs16_Ws16 999.9000 RhoFuel 0.1000000 1000.000 FORMAT "%8.3" EXTENDED_LIMITS -3276.800 3276.700
 /begin AXIS_DESCR STD_AXIS FTSCD_tFuel Temp_Cels 2 -50.14000 199.8600 FORMAT "%8.4" EXTENDED_LIMITS -3549.940 3003.560 DEPOSIT ABSOLUTE /end AXIS_DESCR
/end CHARACTERISTIC
/begin CHARACTERISTIC FlSys_swtTempSel_C "Auswahl der Kraftstoffsystemtemperatur" VALUE 0xD32BC Kw_Wu8 2.000 OneToOne 0.00 2.000 FORMAT "%5.3" EXTENDED_LIMITS 0.00 255.0 /end CHARACTERISTIC
/begin CHARACTERISTIC FlSys_swtTempSensCfgVal_C "Schalterwert, ob Kraftstofftemperaturfühler vorhanden" VALUE 0xD32BD Kw_Wu8 1.000 OneToOne 0.00 1.000 FORMAT "%5.3" EXTENDED_LIMITS 0.00 255.0 /end CHARACTERISTIC
/begin CHARACTERISTIC FlSys_swtTempSensCfgType_C "#SSD Auswahl der Quelle des Softwareschalters ob Kraftstofftemperaturfühler vorhanden. (Datensatz oder EEPROM)" VALUE 0xD32BE Kw_Wu8 0.00 OneToOne 2.000 2.000 FORMAT "%5.3" EXTENDED_LIMITS 0.00 255.0 /end CHARACTERISTIC
/begin CHARACTERISTIC FlSys_tDfl_C "Ersatzwert für Kraftstoffsystemtemperatur" VALUE 0xD32C0 Kw_Ws16 250.0000 Temp_Cels -50.14000 199.8600 FORMAT "%8.4" EXTENDED_LIMITS -3549.940 3003.560 /end CHARACTERISTIC
/begin CHARACTERISTIC FlSys_tiDeflateDel_C "#SSD Verzoegerungszeit für die Entlueftung Niederdruckkreis" VALUE 0xD32BA Kw_Wu16 655350.0 Time_ms 0.00 655350.0 FORMAT "%8.1" /end CHARACTERISTIC
/begin CHARACTERISTIC FMA_dfacSwtOffMax_C "Maximal zulässige Änderungsgeschwindigkeit der temperaturabhängigen Abschaltfaktoren" VALUE 0xD33C8 Kw_Wu32 50.0000007451 Rmp_Fact 0.00 50.0000007451 FORMAT "%13.10" EXTENDED_LIMITS 0.00 7999.99999814 /end CHARACTERISTIC
/begin CHARACTERISTIC FMA_dqThrs_C "Schwelle für Erkennung starker Einspritzmengenänderungen der FMA" VALUE 0xD33CC Kw_Ws16 200.0000 InjMassSec 0.00 200.0000 FORMAT "%8.4" EXTENDED_LIMITS -327.6800 327.6700 /end CHARACTERISTIC
/begin CHARACTERISTIC FMA_drLmbdThrs_C "Schwelle für Erkennung starker Lambdaänderung der FMA" VALUE 0xD33CE Kw_Ws16 10.20000 lambdaSec -0.2000000 10.00000 FORMAT "%8.5" EXTENDED_LIMITS -32.76800 32.76700 /end CHARACTERISTIC
/begin CHARACTERISTIC FMA_facAirSwtOff_CUR "Kennlinie des ansauglufttemperaturabhängigen Abschaltfaktors der FMA" CURVE 0xD33D0 Kl_Xs16_Ws16 1.000000 Fact 0.00 1.000000 FORMAT "%8.6" EXTENDED_LIMITS -4.000000 3.999878
 /begin AXIS_DESCR STD_AXIS IATSCD_tAir Temp_Cels 8 -50.14000 199.8600 FORMAT "%8.4" EXTENDED_LIMITS -3549.940 3003.560 DEPOSIT ABSOLUTE /end AXIS_DESCR
/end CHARACTERISTIC
/begin CHARACTERISTIC FMA_facAPSwtOff_CUR "Kennlinie des atmosphärendruckabhängigen Abschaltfaktors der FMA" CURVE 0xD33F2 Kl_Xs16_Ws16 1.000000 Fact 0.00 1.000000 FORMAT "%8.6" EXTENDED_LIMITS -4.000000 3.999878
 /begin AXIS_DESCR STD_AXIS APSCD_pVal Pres_hPa 8 0.00 3500.000 FORMAT "%8.3" EXTENDED_LIMITS -32768.00 32767.00 DEPOSIT ABSOLUTE /end AXIS_DESCR
/end CHARACTERISTIC
/begin CHARACTERISTIC FMA_facDensCor_C "Faktor für Dichtekorrektur bei Angabe der Kraftstoffmenge in" VALUE 0xD32C2 Kw_Ws16 0.1999512 Fact 0.8000488 1.000000 FORMAT "%8.6" EXTENDED_LIMITS -4.000000 3.999878 /end CHARACTERISTIC
/begin CHARACTERISTIC FMA_facEngSwtOff_CUR "Kennlinie des motortemperaturabhängigen Abschaltfaktors der FMA" CURVE 0xD3414 Kl_Xs16_Ws16 1.000000 Fact 0.00 1.000000 FORMAT "%8.6" EXTENDED_LIMITS -4.000000 3.999878
 /begin AXIS_DESCR STD_AXIS Eng_tEng Temp_Cels 8 -50.14000 199.8600 FORMAT "%8.4" EXTENDED_LIMITS -3549.940 3003.560 DEPOSIT ABSOLUTE /end AXIS_DESCR
/end CHARACTERISTIC
/begin CHARACTERISTIC FMA_facFlSwtOff_CUR "Kennlinie des kraftstofftemperaturabhängigen Abschaltfaktors der FMA" CURVE 0xD3436 Kl_Xs16_Ws16 1.000000 Fact 0.00 1.000000 FORMAT "%8.6" EXTENDED_LIMITS -4.000000 3.999878
 /begin AXIS_DESCR STD_AXIS FTSCD_tFuel Temp_Cels 8 -50.14000 199.8600 FORMAT "%8.4" EXTENDED_LIMITS -3549.940 3003.560 DEPOSIT ABSOLUTE /end AXIS_DESCR
/end CHARACTERISTIC
/begin CHARACTERISTIC FMA_facNQSwtOff_MAP "Kennfeld des motodrehzahl-/einspritzmengenabhängigen Abschaltfaktors der FMA für betriebsbereichsabhängige Abschaltung" MAP 0xD32C8 Kf_Xs16_Ys16_Ws16 1.000000 Fact 0.00 1.000000 FORMAT "%8.6" EXTENDED_LIMITS -4.000000 3.999878
 /begin AXIS_DESCR STD_AXIS Eng_nAvrg EngN 8 0.00 8000.000 FORMAT "%8.3" EXTENDED_LIMITS -32768.00 32767.00 DEPOSIT ABSOLUTE /end AXIS_DESCR
 /begin AXIS_DESCR STD_AXIS FMA_qCtl_mp InjMass 8 0.00 200.0000 FORMAT "%8.4" EXTENDED_LIMITS -327.6800 327.6700 DEPOSIT ABSOLUTE /end AXIS_DESCR
/end CHARACTERISTIC
/begin CHARACTERISTIC FMA_IKiFst_C "Integriererverstärkung der FMA bei Kleinsignalen (schnelles Einlernen des Kennfelds)" VALUE 0xD336C Kw_Wu32 4.00003045797 Ki 0.00 4.00003045797 FORMAT "%13.11" EXTENDED_LIMITS 0.00 999999.999767 /end CHARACTERISTIC
/begin CHARACTERISTIC FMA_IKiPosFst_C "Integriererverstärkung der FMA bei positiven Großsignalen (schnelles Einlernen des Kennfelds)" VALUE 0xD3370 Kw_Wu32 4.00003045797 Ki 0.00 4.00003045797 FORMAT "%13.11" EXTENDED_LIMITS 0.00 999999.999767 /end CHARACTERISTIC
/begin CHARACTERISTIC FMA_IKiNegFst_C "Integriererverstärkung der FMA bei negativen Großsignalen (schnelles Einlernen des Kennfelds)" VALUE 0xD3374 Kw_Wu32 4.00003045797 Ki 0.00 4.00003045797 FORMAT "%13.11" EXTENDED_LIMITS 0.00 999999.999767 /end CHARACTERISTIC
/begin CHARACTERISTIC FMA_qIWinPosFst_C "Obere Kleinsignalgrenze für Integratoren der FMA (schnelles Einlernen des Kennfelds)" VALUE 0xD3378 Kw_Ws16 20.00000 InjMass 0.00 20.00000 FORMAT "%8.5" EXTENDED_LIMITS -327.6800 327.6700 /end CHARACTERISTIC
/begin CHARACTERISTIC FMA_qIWinNegFst_C "Untere Kleinsignalgrenze für Integratoren der FMA (schnelles Einlernen des Kennfelds)" VALUE 0xD337A Kw_Ws16 20.00000 InjMass -20.00000 0.00 FORMAT "%8.5" EXTENDED_LIMITS -327.6800 327.6700 /end CHARACTERISTIC
/begin CHARACTERISTIC FMA_IKiSlw_C "Integriererverstärkung der FMA bei Kleinsignalen (langsames Einlernen des Kennfelds)" VALUE 0xD337C Kw_Wu32 4.00003045797 Ki 0.00 4.00003045797 FORMAT "%13.11" EXTENDED_LIMITS 0.00 999999.999767 /end CHARACTERISTIC
/begin CHARACTERISTIC FMA_IKiPosSlw_C "Integriererverstärkung der FMA bei positiven Großsignalen (langsames Einlernen des Kennfelds)" VALUE 0xD3380 Kw_Wu32 4.00003045797 Ki 0.00 4.00003045797 FORMAT "%13.11" EXTENDED_LIMITS 0.00 999999.999767 /end CHARACTERISTIC
/begin CHARACTERISTIC FMA_IKiNegSlw_C "Integriererverstärkung der FMA bei negativen Großsignalen (langsames Einlernen des Kennfelds)" VALUE 0xD3384 Kw_Wu32 4.00003045797 Ki 0.00 4.00003045797 FORMAT "%13.11" EXTENDED_LIMITS 0.00 999999.999767 /end CHARACTERISTIC
/begin CHARACTERISTIC FMA_qIWinPosSlw_C "Obere Kleinsignalgrenze für Integratoren der FMA (langsames Einlernen des Kennfelds)" VALUE 0xD3388 Kw_Ws16 20.00000 InjMass 0.00 20.00000 FORMAT "%8.5" EXTENDED_LIMITS -327.6800 327.6700 /end CHARACTERISTIC
/begin CHARACTERISTIC FMA_qIWinNegSlw_C "Untere Kleinsignalgrenze für Integratoren der FMA (langsames Einlernen des Kennfelds)" VALUE 0xD338A Kw_Ws16 20.00000 InjMass -20.00000 0.00 FORMAT "%8.5" EXTENDED_LIMITS -327.6800 327.6700 /end CHARACTERISTIC
/begin CHARACTERISTIC FMA_nGrid_C "Vektor der Drehzahlwerte der Kennfeldstützstellen" VAL_BLK 0xD338C Kwb_Ws16 4000.000 EngN 0.00 4000.000 FORMAT "%8.3" EXTENDED_LIMITS -32768.00 32767.00 NUMBER 8 /end CHARACTERISTIC
/begin CHARACTERISTIC FMA_nThrs_C "Drehzahlschwelle für Schuberkennung der FMA" VALUE 0xD3458 Kw_Ws16 5960.000 EngN 40.00000 6000.000 FORMAT "%8.3" EXTENDED_LIMITS -32768.00 32767.00 /end CHARACTERISTIC
/begin CHARACTERISTIC FMA_numNGrid_C "Anzahl der Drehzahlstützstellen des adaptiven Kenfelds" VALUE 0xD339C Kw_Wu8 6.000 OneToOne 2.000 8.000 FORMAT "%5.3" EXTENDED_LIMITS 0.00 255.0 /end CHARACTERISTIC
/begin CHARACTERISTIC FMA_numQGrid_C "Anzahl der Mengenstützstellen des adaptiven Kenfelds" VALUE 0xD339D Kw_Wu8 6.000 OneToOne 2.000 8.000 FORMAT "%5.3" EXTENDED_LIMITS 0.00 255.0 /end CHARACTERISTIC
/begin CHARACTERISTIC FMA_tiPT1Fst_C "Zeitkonstante der PT1-Filter zur Filterung des aktuellen Mengenfehlers (schnelles Einlernen des Kennfelds)" VALUE 0xD33A0 Kw_Wu32 4294.9663 TimeDelay_s 0.0010000001 4294.9673 FORMAT "%9.4" EXTENDED_LIMITS 0.0000010000000 4294.9673 /end CHARACTERISTIC
/begin CHARACTERISTIC FMA_tiPT1Slw_C "Zeitkonstante der PT1-Filter zur Filterung des aktuellen Mengenfehlers (langsames Einlernen des Kennfelds)" VALUE 0xD33A4 Kw_Wu32 4294.9663 TimeDelay_s 0.0010000001 4294.9673 FORMAT "%9.4" EXTENDED_LIMITS 0.0000010000000 4294.9673 /end CHARACTERISTIC
/begin CHARACTERISTIC FMA_qGrid_C "Vektor der Mengenwerte der Kennfeldstützstellen" VAL_BLK 0xD33A8 Kwb_Ws16 80.00000 InjMass -40.00000 40.00000 FORMAT "%8.5" EXTENDED_LIMITS -327.6800 327.6700 NUMBER 8 /end CHARACTERISTIC
/begin CHARACTERISTIC FMA_qIntMax_C "Maximal zulässiger Wert für adaptierte Mengenfehler in den Lernpunkten , d.h. für Zustände der Integratoren und PT1-Glieder" VALUE 0xD33B8 Kw_Ws16 80.00000 InjMass -40.00000 40.00000 FORMAT "%8.5" EXTENDED_LIMITS -327.6800 327.6700 /end CHARACTERISTIC
/begin CHARACTERISTIC FMA_qIntMin_C "Minimal zulässiger Wert für adaptierte Mengenfehler in den Lernpunkten , d.h. für Zustände der Integratoren und PT1-Glieder" VALUE 0xD33BA Kw_Ws16 80.00000 InjMass -40.00000 40.00000 FORMAT "%8.5" EXTENDED_LIMITS -327.6800 327.6700 /end CHARACTERISTIC
/begin CHARACTERISTIC FMA_qMax_C "Oberer Grenzwert für Einspritzmengenkorrektur der FMA" VALUE 0xD33BC Kw_Ws16 80.00000 InjMass -40.00000 40.00000 FORMAT "%8.5" EXTENDED_LIMITS -327.6800 327.6700 /end CHARACTERISTIC
/begin CHARACTERISTIC FMA_qMin_C "Unterer Grenzwert für Einspritzmengenkorrektur der FMA" VALUE 0xD33BE Kw_Ws16 80.00000 InjMass -40.00000 40.00000 FORMAT "%8.5" EXTENDED_LIMITS -327.6800 327.6700 /end CHARACTERISTIC
/begin CHARACTERISTIC FMA_qThrs_C "Einspritzmengenschwelle für Schuberkennung der FMA" VALUE 0xD345A Kw_Ws16 40.00000 InjMass 0.00 40.00000 FORMAT "%8.5" EXTENDED_LIMITS -327.6800 327.6700 /end CHARACTERISTIC
/begin CHARACTERISTIC FMA_rLmbdThrsMax_C "Obere Grenze des für FMA zulässigen Lambdabereichs" VALUE 0xD345C Kw_Ws16 10.20000 lambda -0.2000000 10.00000 FORMAT "%8.5" EXTENDED_LIMITS -32.76800 32.76700 /end CHARACTERISTIC
/begin CHARACTERISTIC FMA_rLmbdThrsMin_C "Untere Grenze des für FMA zulässigen Lambdabereichs" VALUE 0xD345E Kw_Ws16 10.20000 lambda -0.2000000 10.00000 FORMAT "%8.5" EXTENDED_LIMITS -32.76800 32.76700 /end CHARACTERISTIC
/begin CHARACTERISTIC FMA_stRgnMsk_C "Bitmaske zur Abschaltung der FMA bei bestimmten Regenerationszuständen EGT_st" VALUE 0xD3460 Kw_Wu32 4294967295.00 OneToOne 0.00 4294967295.00 FORMAT "%13.2" /end CHARACTERISTIC
/begin CHARACTERISTIC FMA_swtIC_C "Schalter für Betriebsartauswahl der FMA (Indirect Control - Direct Control)" VALUE 0xD32C4 Kw_Wu8 1.000 OneToOne 0.00 1.000 FORMAT "%5.3" EXTENDED_LIMITS 0.00 255.0 READ_ONLY /end CHARACTERISTIC
/begin CHARACTERISTIC FMA_swtOnFMA_C "Schalter zum Ein-/Ausschalten der gesamten FMA" VALUE 0xD3464 Kw_Wu8 1.000 OneToOne 0.00 1.000 FORMAT "%5.3" EXTENDED_LIMITS 0.00 255.0 /end CHARACTERISTIC
/begin CHARACTERISTIC FMA_swtRst_C "Schalter zur Reinitialisierung des Fehlermodells" VALUE 0xD33C0 Kw_Wu8 1.000 OneToOne 0.00 1.000 FORMAT "%5.3" EXTENDED_LIMITS 0.00 255.0 /end CHARACTERISTIC
/begin CHARACTERISTIC FMA_tiDLmbdThrs_C "Wartezeit bis der FMA- Lambdaänderungsstatus nach Ende der Lambdaänderung zurückgesetzt wird" VALUE 0xD3466 Kw_Wu16 20.00000 Time_s 0.00 20.00000 FORMAT "%8.5" EXTENDED_LIMITS 0.00 655.3500 /end CHARACTERISTIC
/begin CHARACTERISTIC FMA_tiDynThrs_C "Wartezeit bis der FMA-Einspritzmengendynamikstatus nach Ende der Einspritzmengenänderung zurückgesetzt wird" VALUE 0xD3468 Kw_Wu16 20.00000 Time_s 0.00 20.00000 FORMAT "%8.5" EXTENDED_LIMITS 0.00 655.3500 /end CHARACTERISTIC
/begin CHARACTERISTIC FMA_tiFaultRmp_C "Dauer des rampenförmigen Abschaltens der FMA bei schweren Systemfehlern" VALUE 0xD346C Kw_Wu32 40.0000000000 Time_s 0.00 40.0000000000 FORMAT "%13.10" EXTENDED_LIMITS 0.00 42949672.9500 /end CHARACTERISTIC
/begin CHARACTERISTIC FMA_tiLmbdDT1_C "Verzögerungszeitkonstante der Differentiation von Lambda in der FMA" VALUE 0xD3470 Kw_Wu32 3.9980385 TimeDelay_s 0.0010000001 3.9990385 FORMAT "%9.7" EXTENDED_LIMITS 0.0000010000000 4294.9673 /end CHARACTERISTIC
/begin CHARACTERISTIC FMA_tiLmbdThrs_C "Wartezeit bis der FMA- Lambdabereichstatus nach Bereichs-verletzung zurückgesetzt wird" VALUE 0xD3474 Kw_Wu16 20.00000 Time_s 0.00 20.00000 FORMAT "%8.5" EXTENDED_LIMITS 0.00 655.3500 /end CHARACTERISTIC
/begin CHARACTERISTIC FMA_tiOvrRun_C "Wartezeit bis der FMA-Schbstatus nach Schubende zurückgesetzt wird" VALUE 0xD3476 Kw_Wu16 20.00000 Time_s 0.00 20.00000 FORMAT "%8.5" EXTENDED_LIMITS 0.00 655.3500 /end CHARACTERISTIC
/begin CHARACTERISTIC FMA_tiQDT1_C "Vezögerungszeitkonstante der Differentiation der Einspritzmenge für Erkennung starker Mengenänderungen der FMA" VALUE 0xD3478 Kw_Wu32 3.9980385 TimeDelay_s 0.0010000001 3.9990385 FORMAT "%9.7" EXTENDED_LIMITS 0.0000010000000 4294.9673 /end CHARACTERISTIC
/begin CHARACTERISTIC FMA_tiQLmbd_C "Verzögerungszeit nach einer Resetierung um die Adaption zuzulassen" VALUE 0xD347C Kw_Wu16 20.00000 Time_s 0.00 20.00000 FORMAT "%8.5" EXTENDED_LIMITS 0.00 655.3500 /end CHARACTERISTIC
/begin CHARACTERISTIC FMA_tiSwtPar_C "Betriebszeit der FMA, nach der von schnellem auf langsames Lernen umgeschaltet wird" VALUE 0xD33C4 Kw_Ws32 1000000.00000 Time_s 0.00 1000000.00000 FORMAT "%13.5" EXTENDED_LIMITS -21474836.4800 21474836.4700 /end CHARACTERISTIC
/begin CHARACTERISTIC FMTC_dqtrq2qBasRmpUp_C "Positiver Rampengradient" VALUE 0xD3480 Kw_Wu32 655359.999847 RmpInjMass 0.00 655359.999847 FORMAT "%13.6" /end CHARACTERISTIC
/begin CHARACTERISTIC FMTC_dqtrq2qBasRmpDwn_C "Negativer Rampengradient" VALUE 0xD3484 Kw_Wu32 655359.999847 RmpInjMass 0.00 655359.999847 FORMAT "%13.6" /end CHARACTERISTIC
/begin CHARACTERISTIC FMTC_eta0_C "fester Wirkungsgradfaktor zur Umrechnung Startmoment in Startmenge" VALUE 0xD3488 Kw_Ws16 100.0000 Eta 0.00 100.0000 FORMAT "%8.4" EXTENDED_LIMITS -256.0000 255.9922 /end CHARACTERISTIC
/begin CHARACTERISTIC FMTC_facAirCorr_CUR "Gewichtungsfaktor der Eta-Korrektur für die Abweichug der Luft pro Zylinder vom Referenzwert" CURVE 0xD4048 Kl_Xs16_Ws16 503.9999 Fact -500.0000 3.999878 FORMAT "%8.4" EXTENDED_LIMITS -4.000000 3.999878
 /begin AXIS_DESCR STD_AXIS CoEng_trqInrSet Trq 8 -3276.800 3276.700 FORMAT "%8.3" DEPOSIT ABSOLUTE /end AXIS_DESCR
/end CHARACTERISTIC
/begin CHARACTERISTIC FMTC_facAirCorr_MAP "eta correction for start of injection, base value" MAP 0xD406A Kf_Xs16_Ys16_Ws16 10.00000 Fact 0.00 10.00000 FORMAT "%8.5" EXTENDED_LIMITS -4.000000 3.999878
 /begin AXIS_DESCR STD_AXIS Eng_nAvrg EngN 8 0.00 6000.000 FORMAT "%8.3" EXTENDED_LIMITS -32768.00 32767.00 DEPOSIT ABSOLUTE /end AXIS_DESCR
 /begin AXIS_DESCR STD_AXIS FMTC_mAirDiff_mp AirMassPerCyl 8 -30.00000 30.00000 FORMAT "%8.5" EXTENDED_LIMITS -3276.800 3276.700 DEPOSIT ABSOLUTE /end AXIS_DESCR
/end CHARACTERISTIC
/begin CHARACTERISTIC FMTC_facStrtInjCorr_CUR "Eta-Korrektur für die Abweichug des Spritzbeginns vom Referenzwert, Gewichtungsfaktor" CURVE 0xD410E Kl_Xs16_Ws16 3.999878 Fact 0.00 3.999878 FORMAT "%8.6" EXTENDED_LIMITS -4.000000 3.999878
 /begin AXIS_DESCR STD_AXIS CoEng_trqInrSet Trq 8 -500.0000 1000.000 FORMAT "%8.3" EXTENDED_LIMITS -3276.800 3276.700 DEPOSIT ABSOLUTE /end AXIS_DESCR
/end CHARACTERISTIC
/begin CHARACTERISTIC FMTC_facStrtInjCorr_MAP "eta correction for start of injection, base value" MAP 0xD4130 Kf_Xs16_Ys16_Ws16 10.00000 Fact 0.00 10.00000 FORMAT "%8.5" EXTENDED_LIMITS -4.000000 3.999878
 /begin AXIS_DESCR STD_AXIS Eng_nAvrg EngN 8 0.00 6000.000 FORMAT "%8.3" EXTENDED_LIMITS -32768.00 32767.00 DEPOSIT ABSOLUTE /end AXIS_DESCR
 /begin AXIS_DESCR STD_AXIS FMTC_phiStrtInjDiff_mp AngleCrS 8 -30.00000 30.00000 FORMAT "%8.5" EXTENDED_LIMITS -768.0000 767.9766 DEPOSIT ABSOLUTE /end AXIS_DESCR
/end CHARACTERISTIC
/begin CHARACTERISTIC FMTC_mAirOpt_MAP "optimale Frischluftmasse  (bzgl. Wirkungsgrad)" MAP 0xD41D4 Kf_Xs16_Ys16_Ws16 3276.700 AirMassPerCyl 0.00 3276.700 FORMAT "%8.3" EXTENDED_LIMITS -3276.800 3276.700
 /begin AXIS_DESCR STD_AXIS Eng_nAvrg EngN 16 0.00 6000.000 FORMAT "%8.3" EXTENDED_LIMITS -32768.00 32767.00 DEPOSIT ABSOLUTE /end AXIS_DESCR
 /begin AXIS_DESCR STD_AXIS CoEng_trqInrSet Trq 16 -500.0000 1000.000 FORMAT "%8.3" EXTENDED_LIMITS -3276.800 3276.700 DEPOSIT ABSOLUTE /end AXIS_DESCR
/end CHARACTERISTIC
/begin CHARACTERISTIC FMTC_phiStrtInjOpt_MAP "Eta-Korrektur, Referenzwert für den Spritzbeginn" MAP 0xD4418 Kf_Xs16_Ys16_Ws16 60.00000 AngleCrS -30.00000 30.00000 FORMAT "%8.5" EXTENDED_LIMITS -768.0000 767.9766
 /begin AXIS_DESCR STD_AXIS Eng_nAvrg EngN 16 0.00 6000.000 FORMAT "%8.3" EXTENDED_LIMITS -32768.00 32767.00 DEPOSIT ABSOLUTE /end AXIS_DESCR
 /begin AXIS_DESCR STD_AXIS CoEng_trqInrSet Trq 16 -500.0000 1000.000 FORMAT "%8.3" EXTENDED_LIMITS -3276.800 3276.700 DEPOSIT ABSOLUTE /end AXIS_DESCR
/end CHARACTERISTIC
/begin CHARACTERISTIC FMTC_stRgnMsk1_C "applizierbare Bitmaske für Regenerationsstatus 1" VALUE 0xD348C Kw_Wu32 4294967295.00 OneToOne 0.00 4294967295.00 FORMAT "%13.2" /end CHARACTERISTIC
/begin CHARACTERISTIC FMTC_stRgnMsk2_C "applizierbare Bitmaske für Regenerationsstatus 2" VALUE 0xD3490 Kw_Wu32 4294967295.00 OneToOne 0.00 4294967295.00 FORMAT "%13.2" /end CHARACTERISTIC
/begin CHARACTERISTIC FMTC_swtCorr_C "Softwareschalter Aktivieren/Deaktivieren der Wirkungsgradkorrektur" VALUE 0xD465C Kw_Wu8 3.000 OneToOne 0.00 3.000 FORMAT "%5.3" EXTENDED_LIMITS 0.00 255.0 /end CHARACTERISTIC
/begin CHARACTERISTIC FMTC_tiRmpSlp_C "Rampenlaufzeit für Mehrfachschalter" VALUE 0xD3494 Kw_Wu16 65.435945038 TimeEGTRmp 0.10005496183 65.536000000 FORMAT "%12.9" EXTENDED_LIMITS 0.0010000152590 65.536000000 /end CHARACTERISTIC
/begin CHARACTERISTIC FMTC_trq2qBasCBOpn_MAP "Basis-Grundkennfeld fuer Drehmoment zu q Umwandlung bei geoeffnetem Verdichterbypass" MAP 0xD3496 Kf_Xs16_Ys16_Ws16 327.6700 InjMassCyc 0.00 327.6700 FORMAT "%8.4" EXTENDED_LIMITS -327.6800 327.6700
 /begin AXIS_DESCR STD_AXIS Eng_nAvrg EngN 16 0.00 6000.000 FORMAT "%8.3" EXTENDED_LIMITS -32768.00 32767.00 DEPOSIT ABSOLUTE /end AXIS_DESCR
 /begin AXIS_DESCR STD_AXIS CoEng_trqInrSet Trq 16 -500.0000 1000.000 FORMAT "%8.3" EXTENDED_LIMITS -3276.800 3276.700 DEPOSIT ABSOLUTE /end AXIS_DESCR
/end CHARACTERISTIC
/begin CHARACTERISTIC FMTC_trq2qBas_MAP "#SSD Grundkennfeld für Moment/Menge Umrechnung als Funktion des Arbeitspunktes" MAP 0xD36DA Kf_Xs16_Ys16_Ws16 327.6700 InjMassCyc 0.00 327.6700 FORMAT "%8.4" EXTENDED_LIMITS -327.6800 327.6700
 /begin AXIS_DESCR STD_AXIS Eng_nAvrg EngN 24 0.00 6000.000 FORMAT "%8.3" EXTENDED_LIMITS -32768.00 32767.00 DEPOSIT ABSOLUTE /end AXIS_DESCR
 /begin AXIS_DESCR STD_AXIS CoEng_trqInrSet Trq 24 -500.0000 1000.000 FORMAT "%8.3" EXTENDED_LIMITS -3276.800 3276.700 DEPOSIT ABSOLUTE /end AXIS_DESCR
/end CHARACTERISTIC
/begin CHARACTERISTIC FMTC_trq2qRgn1_MAP "#SSD Grundkennfeld für Moment-/Mengenumrechnung unter Regenerationsanforderung 1 der Abgasnachbehandlung" MAP 0xD3BBE Kf_Xs16_Ys16_Ws16 327.6700 InjMassCyc 0.00 327.6700 FORMAT "%8.4" EXTENDED_LIMITS -327.6800 327.6700
 /begin AXIS_DESCR STD_AXIS Eng_nAvrg EngN 16 0.00 6000.000 FORMAT "%8.3" EXTENDED_LIMITS -32768.00 32767.00 DEPOSIT ABSOLUTE /end AXIS_DESCR
 /begin AXIS_DESCR STD_AXIS CoEng_trqInrSet Trq 16 -500.0000 1000.000 FORMAT "%8.3" EXTENDED_LIMITS -3276.800 3276.700 DEPOSIT ABSOLUTE /end AXIS_DESCR
/end CHARACTERISTIC
/begin CHARACTERISTIC FMTC_trq2qRgn2_MAP "#SSD Grundkennfeld für Moment-/Mengenumrechnung unter Regenerationsanforderung 2 der Abgasnachbehandlung" MAP 0xD3E02 Kf_Xs16_Ys16_Ws16 327.6700 InjMassCyc 0.00 327.6700 FORMAT "%8.4" EXTENDED_LIMITS -327.6800 327.6700
 /begin AXIS_DESCR STD_AXIS Eng_nAvrg EngN 16 0.00 6000.000 FORMAT "%8.3" EXTENDED_LIMITS -32768.00 32767.00 DEPOSIT ABSOLUTE /end AXIS_DESCR
 /begin AXIS_DESCR STD_AXIS CoEng_trqInrSet Trq 16 -500.0000 1000.000 FORMAT "%8.3" EXTENDED_LIMITS -3276.800 3276.700 DEPOSIT ABSOLUTE /end AXIS_DESCR
/end CHARACTERISTIC
/begin CHARACTERISTIC EngPrt_tiFWOscDetDebDef_C "Debounce time for fly wheel oscillation defect detection" VALUE 0xD0566 Kw_Wu16 2000.000 TimeDeb 0.00 2000.000 FORMAT "%8.3" EXTENDED_LIMITS 0.00 655350.0 /end CHARACTERISTIC
/begin CHARACTERISTIC EngPrt_tiFWOscDetDebOk_C "Debounce time for fly wheel oscillation defect healing" VALUE 0xD0568 Kw_Wu16 2000.000 TimeDeb 0.00 2000.000 FORMAT "%8.3" EXTENDED_LIMITS 0.00 655350.0 /end CHARACTERISTIC
/begin MEASUREMENT EngPrt_facOvhtPrvCT_mp "Faktor aus Kühlmitteltemperatur" SWORD Fact 1 100 -4.000000 3.999878 FORMAT "%8.6" ECU_ADDRESS 0x8FEE12 /end MEASUREMENT
/begin MEASUREMENT EngPrt_facOvhtPrvFT_mp "Faktor aus Kraftstofftemperatur" SWORD Fact 1 100 -4.000000 3.999878 FORMAT "%8.6" ECU_ADDRESS 0x8FEE14 /end MEASUREMENT
/begin MEASUREMENT EngPrt_facOvhtPrvOT_mp "Faktor aus Motoröltemperatur" SWORD Fact 1 100 -4.000000 3.999878 FORMAT "%8.6" ECU_ADDRESS 0x8FEE16 /end MEASUREMENT
/begin MEASUREMENT EngPrt_facOvhtPrv_mp "Minimum der Temperaturfaktoren" SWORD Fact 1 100 -4.000000 3.999878 FORMAT "%8.6" ECU_ADDRESS 0x8FEE18 /end MEASUREMENT
/begin MEASUREMENT EngPrt_facPrtLim "Motorschutzbegrenzungsfaktor" SWORD Fact 1 100 -4.000000 3.999878 FORMAT "%8.6" ECU_ADDRESS 0x7F8C30 /end MEASUREMENT
/begin MEASUREMENT EngPrt_qOvhtPrvNRng_mp "Begrenzungsmenge auf Grund der mittleren Drehzahl" SWORD InjMass 1 100 -327.6800 327.6700 FORMAT "%8.4" ECU_ADDRESS 0x8FEE1A /end MEASUREMENT
/begin MEASUREMENT EngPrt_qOvhtPrvVRng_mp "Begrenzungsmenge auf Grund der Fahrzeuggeschwindigkeit" SWORD InjMass 1 100 -327.6800 327.6700 FORMAT "%8.4" ECU_ADDRESS 0x8FEE1C /end MEASUREMENT
/begin MEASUREMENT EngPrt_qPrtLim "Begrenzungmenge zum thermischen Motorschutz" SWORD InjMass 1 100 -327.6800 327.6700 FORMAT "%8.4" ECU_ADDRESS 0x7F8C32 /end MEASUREMENT
/begin MEASUREMENT EngPrt_stFWOscDet "Status of fly wheel oscillation detection" UBYTE OneToOne 1 100 0.00 255.0 FORMAT "%5.1" ECU_ADDRESS 0x7F8846 /end MEASUREMENT
/begin MEASUREMENT EngPrt_stOvrSpd "Überdrehzahl-Status" UBYTE OneToOne 1 100 0.00 255.0 FORMAT "%5.1" ECU_ADDRESS 0x7F8847 /end MEASUREMENT
/begin MEASUREMENT EngPrt_stTrqRampSwitch_mp "status of rampswitch" UWORD OneToOne 1 100 0.00 65535.00 FORMAT "%8.2" ECU_ADDRESS 0x8FEE1E /end MEASUREMENT
/begin MEASUREMENT EngPrt_trqLim "Begrenzungsmoment zum Schutz vor zu hohem Drehmoment (als inneres Motormoment)" SWORD Trq 1 100 -3276.800 3276.700 FORMAT "%8.3" ECU_ADDRESS 0x7F8C34 /end MEASUREMENT
/begin MEASUREMENT EngPrt_trqLimPrvLim_mp "" SWORD Trq 1 100 -3276.800 3276.700 FORMAT "%8.3" ECU_ADDRESS 0x8FEE20 /end MEASUREMENT
/begin MEASUREMENT EngPrt_trqNLim "Begrenzungsmoment zum Schutz vor zu hoher Drehzahl (als inneres Motormoment)" SWORD Trq 1 100 -3276.800 3276.700 FORMAT "%8.3" ECU_ADDRESS 0x7F8C36 /end MEASUREMENT
/begin MEASUREMENT EngPrt_trqOvhtPrv "Begrenzungsmoment für Überhitzungsschutz" SWORD Trq 1 100 -3276.800 3276.700 FORMAT "%8.3" ECU_ADDRESS 0x7F8C38 /end MEASUREMENT
/begin MEASUREMENT EngPrt_trqPrtLim "resultierendes Begrenzungsmoment für Motormechanikschutz (inneres Motormoment)" SWORD Trq 1 100 -3276.800 3276.700 FORMAT "%8.3" ECU_ADDRESS 0x7F8C3A /end MEASUREMENT
/begin MEASUREMENT EngPrt_trqRamLim1_mp "Ausgang der Sekunde rampswitch" SWORD Trq 1 100 -3276.800 3276.700 FORMAT "%8.3" ECU_ADDRESS 0x8FEE22 /end MEASUREMENT
/begin MEASUREMENT EngPrt_trqRamLim_mp "Ausgang von erstem rampswitch" SWORD Trq 1 100 -3276.800 3276.700 FORMAT "%8.3" ECU_ADDRESS 0x8FEE24 /end MEASUREMENT
/begin MEASUREMENT Eng_dnAvrg "gemittelte Drehzahländerung pro Sekunde" SWORD dn_dZ20 1 100 -327680.0 327670.0 FORMAT "%8.1" ECU_ADDRESS 0x7F8C3C /end MEASUREMENT
/begin MEASUREMENT Eng_nAvrg "mittlere Motordrehzahl" SWORD EngN 1 100 -32768.00 32767.00 FORMAT "%8.2" ECU_ADDRESS 0x7F8C3E /end MEASUREMENT
/begin MEASUREMENT Eng_nCurr "aktuelle Motordrehzahl" SWORD EngN 1 100 -32768.00 32767.00 FORMAT "%8.2" ECU_ADDRESS 0x7F8C40 /end MEASUREMENT
/begin MEASUREMENT Eng_stOvrTemp "Status Übertemperatur" UBYTE OneToOne 1 100 0.00 255.0 FORMAT "%5.1" ECU_ADDRESS 0x7F8848 /end MEASUREMENT
/begin MEASUREMENT Eng_stOvrTemp2 "Status Übertemperatur 2" UBYTE OneToOne 1 100 0.00 255.0 FORMAT "%5.1" ECU_ADDRESS 0x7F8849 /end MEASUREMENT
/begin MEASUREMENT Eng_stOvrTemp_mp "Status Übertemperatur" UBYTE OneToOne 1 100 0.00 255.0 FORMAT "%5.1" ECU_ADDRESS 0x8FEDBE /end MEASUREMENT
/begin MEASUREMENT Eng_tEng "Motortemperatur" SWORD Temp_Cels 1 100 -50.140 899.860 FORMAT "%8.3" ECU_ADDRESS 0x7F8C42 /end MEASUREMENT
/begin MEASUREMENT Eng_tFld "Motortemperatur-Feld" SWORD Temp_Cels 1 100 -50.140 899.860 FORMAT "%8.3" ARRAY_SIZE 3 ECU_ADDRESS 0x7F91E4 /end MEASUREMENT
/begin MEASUREMENT Eng_trqCrvMax "maximales Moment des Momentenintervalls (über Drehzahl)" SWORD Trq 1 100 -3276.800 3276.700 FORMAT "%8.3" ECU_ADDRESS 0x7F8C48 /end MEASUREMENT
/begin MEASUREMENT Eng_tStrt "Motortemperatur beim Start" SWORD Temp_Cels 1 100 -50.140 899.860 FORMAT "%8.3" ECU_ADDRESS 0x7F8C44 /end MEASUREMENT
/begin MEASUREMENT ErLpCD_OrdGlwLmp "Message vom Fehlerlampen Handler and Glühzeitsteuerung, steuert die Glühlampe bei Systemlampenfehlern an." UBYTE OneToOne 1 100 0.00 255.0 FORMAT "%5.1" ECU_ADDRESS 0x7F884A /end MEASUREMENT
/begin MEASUREMENT ErLpCD_stMil "Gesamtatus der MIL und Status der Aktivierungsquellen" UBYTE OneToOne 1 100 0.00 255.0 FORMAT "%5.1" ECU_ADDRESS 0x7F884B /end MEASUREMENT
/begin MEASUREMENT ErLpCD_stMilLmpTst "status of the MIL due the lamp test" UBYTE OneToOne 1 100 0.00 255.0 FORMAT "%5.1" ECU_ADDRESS 0x7F884C /end MEASUREMENT
/begin MEASUREMENT ErLpCD_stMilReq "Status der externen MIL Ansteuerungs Anforderung (Achtung: wechselt während der Ansteuerung dauernd den Zustand)" UBYTE OneToOne 1 100 0.00 255.0 FORMAT "%5.1" ECU_ADDRESS 0x7F884D /end MEASUREMENT
/begin MEASUREMENT ErLpCD_stSysLmp "Gesamtatus der System Lampe und Status der Aktivierungsquellen" UBYTE OneToOne 1 100 0.00 255.0 FORMAT "%5.1" ECU_ADDRESS 0x7F884E /end MEASUREMENT
/begin MEASUREMENT ErLpCD_stSysLmpReq "Status der externen Systemlampen  Ansteuerungs Anforderung (Achtung: wechselt während der Ansteuerung dauernd den Zustand)" UBYTE OneToOne 1 100 0.00 255.0 FORMAT "%5.1" ECU_ADDRESS 0x7F884F /end MEASUREMENT
/begin MEASUREMENT ErLpCD_stTstMIL_mp "Testzustand und Fehlerspeicheranforderung der MIL" UBYTE OneToOne 1 100 0.00 255.0 FORMAT "%5.1" ECU_ADDRESS 0x8FEE26 /end MEASUREMENT
/begin MEASUREMENT ErLpCD_stTstSysLmp_mp "Testzustand und Anforderung durch Fehlerspeicher für Systemlampe" UBYTE OneToOne 1 100 0.00 255.0 FORMAT "%5.1" ECU_ADDRESS 0x8FEE27 /end MEASUREMENT
/begin MEASUREMENT ESS_nBattMin "Leerlaufdrehzahl wegen schwacher Batterie" SWORD EngN 1 100 -32768.00 32767.00 FORMAT "%8.2" ECU_ADDRESS 0x7F8C08 /end MEASUREMENT
/begin MEASUREMENT ESS_nMax "Hoechstdrehzahl für ESS" SWORD EngN 1 100 -32768.00 32767.00 FORMAT "%8.2" ECU_ADDRESS 0x7F8C0A /end MEASUREMENT
/begin MEASUREMENT ESS_nMin "Leerlaufdrehzahl aus ESS" SWORD EngN 1 100 -32768.00 32767.00 FORMAT "%8.2" ECU_ADDRESS 0x7F8C0C /end MEASUREMENT
/begin MEASUREMENT ESS_pwrDes "Leistungsbedarf aller Aggregate des Bordnetzes" SWORD Pwr 1 100 -308831.1 308821.7 FORMAT "%8.1" ECU_ADDRESS 0x7F8C0E /end MEASUREMENT
/begin MEASUREMENT ESS_pwrLead "Vorhaltleistung des el. Bordnetzes" SWORD Pwr 1 100 -308831.1 308821.7 FORMAT "%8.1" ECU_ADDRESS 0x7F8C10 /end MEASUREMENT
/begin MEASUREMENT ETClb_ctInjCycl_mp "Aktuelle Anzahl der Einspritzzyklen für die Ansteuerdauerkalibrierung" UWORD OneToOne 1 100 0.00 65535.00 FORMAT "%8.2" ECU_ADDRESS 0x8FEE56 /end MEASUREMENT
/begin MEASUREMENT ETClb_ctLrn_mp "Lernzykluszähler für jeden Raildruck-Kalibrierpunkt der Ansteuerdauerkalibrierung" UWORD OneToOne 1 100 0.00 65535.00 FORMAT "%8.2" ARRAY_SIZE 3 ECU_ADDRESS 0x6F8086 /end MEASUREMENT
/begin MEASUREMENT ETClb_dtiETFlt0_mp "Gefilterte Ansteuerdauerdifferenz der Ansteuerdauerkalibrierung für jeden Zylinder beim Raildruck-Kalibrierpunkt 0" SWORD InjTime_us 1 100 -32768.00 32767.00 FORMAT "%8.2" ARRAY_SIZE 6 ECU_ADDRESS 0x6F808C /end MEASUREMENT
/begin MEASUREMENT ETClb_dtiETFlt1_mp "Gefilterte Ansteuerdauerdifferenz der Ansteuerdauerkalibrierung für jeden Zylinder beim Raildruck-Kalibrierpunkt 1" SWORD InjTime_us 1 100 -32768.00 32767.00 FORMAT "%8.2" ARRAY_SIZE 6 ECU_ADDRESS 0x6F8098 /end MEASUREMENT
/begin MEASUREMENT ETClb_dtiETFlt2_mp "Gefilterte Ansteuerdauerdifferenz der Ansteuerdauerkalibrierung für jeden Zylinder beim Raildruck-Kalibrierpunkt 2" SWORD InjTime_us 1 100 -32768.00 32767.00 FORMAT "%8.2" ARRAY_SIZE 6 ECU_ADDRESS 0x6F80A4 /end MEASUREMENT
/begin MEASUREMENT ETClb_numCylCur_mp "Aktueller Zylinder für die Ansteuerdauerkalibrierung bei jedem Raildruck-Kalibrierpunkt" UBYTE OneToOne 1 100 0.00 255.0 FORMAT "%5.1" ARRAY_SIZE 3 ECU_ADDRESS 0x8FEE28 /end MEASUREMENT
/begin MEASUREMENT ETClb_numPres_mp "Aktueller Raildruck-Kalibrierpunkt der Ansteuerdauerkalibrierung" UBYTE OneToOne 1 100 0.00 255.0 FORMAT "%5.1" ECU_ADDRESS 0x8FEE58 /end MEASUREMENT
/begin MEASUREMENT ETClb_numRailPresClbPnt_mp "Anzahl der Raildruck-Kalibrierpunkte für die Ansteuerdauerkalibrierung" UBYTE OneToOne 1 100 0.00 255.0 FORMAT "%5.1" ECU_ADDRESS 0x8FEE59 /end MEASUREMENT
/begin MEASUREMENT ETClb_stCor "Statusanzeige der Freigaben für die Ansteuerdauerkorrektur der Nullmengenkalibrierung" UBYTE OneToOne 1 100 0.00 255.0 FORMAT "%5.1" ECU_ADDRESS 0x7F8832 /end MEASUREMENT
/begin MEASUREMENT ETClb_stDemCor_mp "Anforderung der Ansteuerdauerkorrektur der Ansteuerdauerkalibrierung" UBYTE OneToOne 1 100 0.00 255.0 FORMAT "%5.1" ECU_ADDRESS 0x8FEE5A /end MEASUREMENT
/begin MEASUREMENT ETClb_stEvalResult_mp "Ergebnis der Ansteuerdauerkalibrierungs-Einspritzungen" UBYTE ETClb_Eval_Rslt 1 100 0.00 2.00000000000 FORMAT "%13.11" ECU_ADDRESS 0x8FEE5E /end MEASUREMENT
/begin MEASUREMENT ETClb_stEval_mp "Zustand des Zustandsautomaten zur Auswertung der Ansteuerdauerkalibrierung" UBYTE ETClb_Eval_State 1 100 0.00 2.00000000000 FORMAT "%13.11" ARRAY_SIZE 3 ECU_ADDRESS 0x8FEE5B /end MEASUREMENT
/begin MEASUREMENT ETClb_stRailpClbPntErr_mp "Status der Begrenzung der Ansteuerdauer der ZFC Kalibrierung für jeden Raildruck-Kalibrierpunkt" UBYTE OneToOne 1 100 0.00 255.0 FORMAT "%5.1" ARRAY_SIZE 6 ECU_ADDRESS 0x6F80BA /end MEASUREMENT
/begin MEASUREMENT ETClb_stRlsCylCor_mp "Zylinderspezifische Freigabe der Ansteuerdauerkorrektur der Ansteuerdauerkalibrierung" UBYTE OneToOne 1 100 0.00 255.0 FORMAT "%5.1" ECU_ADDRESS 0x6F80B8 /end MEASUREMENT
/begin MEASUREMENT ETClb_st_mp "Zustand der Ansteuerdauerkalibrierung" UBYTE ETClb_State 1 100 0.00 4.00000000000 FORMAT "%13.11" ECU_ADDRESS 0x6F80B9 /end MEASUREMENT
/begin MEASUREMENT ETClb_swtCorActv "SW-Schalter zur Aktivierung der Ansteuerdauerkorrektur der Nullmengenkalibrierung" UBYTE OneToOne 1 100 0.00 255.0 FORMAT "%5.1" ECU_ADDRESS 0x7F8833 /end MEASUREMENT
/begin MEASUREMENT ETClb_swtQckClb_mp "Anzeiger der Umschaltung auf schnelle Ansteuerdauerkalibrierung" UBYTE OneToOne 1 100 0.00 255.0 FORMAT "%5.1" ECU_ADDRESS 0x6F80B0 /end MEASUREMENT
/begin MEASUREMENT ETClb_tiETChkCor0_mp "Ansteuerdauer der Nullmenge der ZFC nach Korrektur durch die IMA für Raildruck-Kalibrierpunkt 0" SWORD InjTime_us 1 100 -32768.00 32767.00 FORMAT "%8.2" ARRAY_SIZE 6 ECU_ADDRESS 0x8FEE60 /end MEASUREMENT
/begin MEASUREMENT ETClb_tiETChkCor1_mp "Ansteuerdauer der Nullmenge der ZFC nach Korrektur durch die IMA für Raildruck-Kalibrierpunkt 1" SWORD InjTime_us 1 100 -32768.00 32767.00 FORMAT "%8.2" ARRAY_SIZE 6 ECU_ADDRESS 0x8FEE6C /end MEASUREMENT
/begin MEASUREMENT ETClb_tiETChkCor2_mp "Ansteuerdauer der Nullmenge der ZFC nach Korrektur durch die IMA für Raildruck-Kalibrierpunkt 2" SWORD InjTime_us 1 100 -32768.00 32767.00 FORMAT "%8.2" ARRAY_SIZE 6 ECU_ADDRESS 0x8FEE78 /end MEASUREMENT
/begin MEASUREMENT ETClb_tiETCor0_mp "Ansteuerdauerkorrekturwert der Ansteuerdauer-Kalibrierung für den Raildruck-Kalibrierpunkt 0" SWORD InjTime_us 1 100 -32768.00 32767.00 FORMAT "%8.2" ARRAY_SIZE 6 ECU_ADDRESS 0x8FEE2C /end MEASUREMENT
/begin MEASUREMENT ETClb_tiETCor1_mp "Ansteuerdauerkorrekturwert der Ansteuerdauer-Kalibrierung für den Raildruck-Kalibrierpunkt 1" SWORD InjTime_us 1 100 -32768.00 32767.00 FORMAT "%8.2" ARRAY_SIZE 6 ECU_ADDRESS 0x8FEE38 /end MEASUREMENT
/begin MEASUREMENT ETClb_tiETCor2_mp "Ansteuerdauerkorrekturwert der Ansteuerdauer-Kalibrierung für den Raildruck-Kalibrierpunkt 2" SWORD InjTime_us 1 100 -32768.00 32767.00 FORMAT "%8.2" ARRAY_SIZE 6 ECU_ADDRESS 0x8FEE44 /end MEASUREMENT
/begin MEASUREMENT ETClb_tiETCur_mp "Aktuelle Ansteuerdauer der Ansteuerdauer-Kalibrierung für jeden Raildruck-Kalibrierpunkt" SWORD InjTime_us 1 100 -32768.00 32767.00 FORMAT "%8.2" ARRAY_SIZE 3 ECU_ADDRESS 0x8FEE50 /end MEASUREMENT
/begin MEASUREMENT ETClb_tiETMinEff_mp "Ansteuerdauer der Nullmenge des aktuellen Zylinder fuer jeden Raildruck-Kalibrierpunkt" SWORD InjTime_us 1 100 -32768.00 32767.00 FORMAT "%8.2" ARRAY_SIZE 3 ECU_ADDRESS 0x6F80B2 /end MEASUREMENT
/begin MEASUREMENT FanCD_dcycRaw_mp "fanspeed transfered to dutycycle" SWORD DtyCyc 1 100 -327.6800 327.6700 FORMAT "%8.4" ECU_ADDRESS 0x6F80C0 /end MEASUREMENT
/begin MEASUREMENT FanCtl_dcycAftRun_mp "Tastverhältnis im Nachlauf" SWORD DtyCyc 1 100 -327.6800 327.6700 FORMAT "%8.4" ECU_ADDRESS 0x8FEE84 /end MEASUREMENT
/begin MEASUREMENT FanCtl_dcycBattCor_mp "TV nach Batt-Korr. und Hysteresefunktion" SWORD DtyCyc 1 100 -327.6800 327.6700 FORMAT "%8.4" ECU_ADDRESS 0x8FEE86 /end MEASUREMENT
/begin MEASUREMENT FanCtl_dcycHysStart_mp "Startwert der Hysterese" SWORD DtyCyc 1 100 -327.6800 327.6700 FORMAT "%8.4" ECU_ADDRESS 0x8FEE88 /end MEASUREMENT
/begin MEASUREMENT FanCtl_dcycHys_mp "TV am Ausgang der Hysteresefunktion" SWORD DtyCyc 1 100 -327.6800 327.6700 FORMAT "%8.4" ECU_ADDRESS 0x8FEE8A /end MEASUREMENT
/begin MEASUREMENT FanCtl_dcycOut "Tastverhältnis, Lüfter" SWORD DtyCyc 1 100 -327.6800 327.6700 FORMAT "%8.4" ECU_ADDRESS 0x7F8C74 /end MEASUREMENT
/begin MEASUREMENT FanCtl_dcycRaw_mp "Tastverhältnis Rohwert" SWORD DtyCyc 1 100 -327.6800 327.6700 FORMAT "%8.4" ECU_ADDRESS 0x8FEE8C /end MEASUREMENT
/begin MEASUREMENT FanCtl_facWghFctr_mp "weighting factor for fanspeed from CAN" SWORD Fact 1 100 -4.000000 3.999878 FORMAT "%8.6" ECU_ADDRESS 0x8FEE8E /end MEASUREMENT
/begin MEASUREMENT FanCtl_nSetGbxOilMap_mp "fanspeed dependend on vehicle speed and Oil temp" SWORD FanSpd 1 100 -3000.092 3000.000 FORMAT "%8.3" ECU_ADDRESS 0x8FEE90 /end MEASUREMENT
/begin MEASUREMENT FanCtl_nSetPntCAN_mp "fanspeed derived from CAN" SWORD FanSpd 1 100 -3000.092 3000.000 FORMAT "%8.3" ECU_ADDRESS 0x8FEE92 /end MEASUREMENT
/begin MEASUREMENT FanCtl_nSetPntMap_mp "fanspeed dependend on veh.speed and coolant temp." SWORD FanSpd 1 100 -3000.092 3000.000 FORMAT "%8.3" ECU_ADDRESS 0x8FEE94 /end MEASUREMENT
/begin MEASUREMENT FanCtl_nSetPoint "Endgültige Soll- Lüfterdrehzahl" SWORD FanSpd 1 100 -3000.092 3000.000 FORMAT "%8.3" ECU_ADDRESS 0x7F8C76 /end MEASUREMENT
/begin MEASUREMENT FanCtl_nSetPoint_mp "Lüfter-Drehzahlsollwert" SWORD FanSpd 1 100 -3000.092 3000.000 FORMAT "%8.3" ECU_ADDRESS 0x8FEE96 /end MEASUREMENT
/begin MEASUREMENT FanCtl_stAftRun "Statuswort, Lüftersteuerung" UBYTE OneToOne 1 100 0.00 255.0 FORMAT "%5.1" ECU_ADDRESS 0x7F8855 /end MEASUREMENT
/begin MEASUREMENT FanCtl_stDemFanShOff_mp "Ausschaltbitleiste für hohe Lenköltemperaturen" UBYTE OneToOne 1 100 0.00 255.0 FORMAT "%5.1" ECU_ADDRESS 0x8FEE98 /end MEASUREMENT
/begin MEASUREMENT FanCtl_stDemFan_mp "Einschaltbitleiste für hohe Lenköltemperaturen" UBYTE OneToOne 1 100 0.00 255.0 FORMAT "%5.1" ECU_ADDRESS 0x8FEE99 /end MEASUREMENT
/begin MEASUREMENT FanCtl_stHys_mp "Statuswort der Hysteresefunktion" UBYTE OneToOne 1 100 0.00 255.0 FORMAT "%5.1" ECU_ADDRESS 0x8FEE9A /end MEASUREMENT
/begin MEASUREMENT FanCtl_stLogic_mp "Statuswort der Ansteuerlogik" UBYTE OneToOne 1 100 0.00 255.0 FORMAT "%5.1" ECU_ADDRESS 0x8FEE9B /end MEASUREMENT
/begin MEASUREMENT FanCtl_stOut "Zustand Lüfternachlauf" UBYTE OneToOne 1 100 0.00 255.0 FORMAT "%5.1" ECU_ADDRESS 0x7F8C78 /end MEASUREMENT
/begin MEASUREMENT FanCtl_tClnt_mp "intern verwendete Kühlwassertemperatur" SWORD Temp_Cels 1 100 -50.140 899.860 FORMAT "%8.3" ECU_ADDRESS 0x8FEE9C /end MEASUREMENT
/begin MEASUREMENT FanCtl_tGbxOil_mp "Oil temp or Default Temp  for MAP i/p" SWORD Temp_Cels 1 100 -50.140 899.860 FORMAT "%8.3" ECU_ADDRESS 0x8FEE9E /end MEASUREMENT
/begin MEASUREMENT FBC_AALOut_mp "Ausgang des Antialiasingfiler" FLOAT32_IEEE OneToOne 1 100 -150000000. 150000000. FORMAT "%10.0" ECU_ADDRESS 0x8FEEBC /end MEASUREMENT
/begin MEASUREMENT FBC_Badpt "Adaptionsstatus" UBYTE OneToOne 1 100 0.00 255.0 FORMAT "%5.1" ECU_ADDRESS 0x7F8850 /end MEASUREMENT
/begin MEASUREMENT FBC_ctSegInt "interner Segmentzähler von FBC" UBYTE OneToOne 1 100 0.00 255.0 FORMAT "%5.1" ECU_ADDRESS 0x7F8852 /end MEASUREMENT
/begin MEASUREMENT FBC_dBPCaS_mp "Array der Bandpassausgänge" SWORD EngN 1 100 -32768.00 32767.00 FORMAT "%8.2" ARRAY_SIZE 3 ECU_ADDRESS 0x8FEEA0 /end MEASUREMENT
/begin MEASUREMENT FBC_dBPSum "FBC Mengenersatzsignal, Eingang PI-Regler" SWORD OneToOne 1 100 -32768.00 32767.00 FORMAT "%8.2" ECU_ADDRESS 0x7F8C4A /end MEASUREMENT
/begin MEASUREMENT FBC_DXadpt_mp "aktuelle Adaptionsgüte" SWORD Dxs 1 100 -0.8192000 0.8191750 FORMAT "%9.7" ECU_ADDRESS 0x8FEEC0 /end MEASUREMENT
/begin MEASUREMENT FBC_DXSfn_mp "Ausgang des negativen Bewertungsfilter" SWORD Dxs 1 100 -0.8192000 0.8191750 FORMAT "%9.7" ARRAY_SIZE 12 ECU_ADDRESS 0x8FEEC2 /end MEASUREMENT
/begin MEASUREMENT FBC_DXSfp_mp "Ausgang des positiven Bewertungsfilter" SWORD Dxs 1 100 -0.8192000 0.8191750 FORMAT "%9.7" ARRAY_SIZE 12 ECU_ADDRESS 0x8FEEDA /end MEASUREMENT
/begin MEASUREMENT FBC_DXSf_mp "relative,aktuelle und gefilterte Zahnteilungsfehler (Adaptionsfilter)" SWORD Dxs 1 100 -0.8192000 0.8191750 FORMAT "%9.7" ARRAY_SIZE 12 ECU_ADDRESS 0x8FEEF2 /end MEASUREMENT
/begin MEASUREMENT FBC_DXSl_mp "relative, gefilterte Zahnteilungsfehler (Adaptionsfilter, eingelernte Werte)" SWORD Dxs 1 100 -0.8192000 0.8191750 FORMAT "%9.7" ARRAY_SIZE 12 ECU_ADDRESS 0x8FEF0A /end MEASUREMENT
/begin MEASUREMENT FBC_DXS_mp "relative Zahnteilungsfehler (ungefiltert)" SWORD Dxs 1 100 -0.8192000 0.8191750 FORMAT "%9.7" ARRAY_SIZE 12 ECU_ADDRESS 0x8FEF22 /end MEASUREMENT
/begin MEASUREMENT FBC_facBPNum_mp "aktuell verwendete Bandpasszählerkoeffizienten" SWORD FBC_BPfac 1 100 -60.00183 60.00000 FORMAT "%8.5" ARRAY_SIZE 3 ECU_ADDRESS 0x8FEEA6 /end MEASUREMENT
/begin MEASUREMENT FBC_facSegVal_mp "aktuelle verwendete Segmentwahl" UWORD Per_Ratio 1 100 0.00 255.9961 FORMAT "%8.4" ARRAY_SIZE 3 ECU_ADDRESS 0x8FEEAC /end MEASUREMENT
/begin MEASUREMENT FBC_nMaxOvrRun_mp "maximale Drehzahl, bis zu der die Bandpässe berechnet werden" SWORD EngN 1 100 -32768.00 32767.00 FORMAT "%8.2" ECU_ADDRESS 0x8FEEB2 /end MEASUREMENT
/begin MEASUREMENT FBC_q "Ausgangsmenge der Mengenausgleichsregelung" SWORD InjMass 1 100 -327.6800 327.6700 FORMAT "%8.4" ECU_ADDRESS 0x7F8C4C /end MEASUREMENT
/begin MEASUREMENT FBC_qDvtCyl "aktuelle zylinderindividuelle Korrekturmenge: I-Anteil" SWORD InjMass 1 100 -327.6800 327.6700 FORMAT "%8.4" ARRAY_SIZE 7 ECU_ADDRESS 0x7F92B6 /end MEASUREMENT
/begin MEASUREMENT FBC_qDvtMax_mp "obere Integratorwertschwelle" SWORD InjMass 1 100 -327.6800 327.6700 FORMAT "%8.4" ECU_ADDRESS 0x8FEEB4 /end MEASUREMENT
/begin MEASUREMENT FBC_qDvtMin_mp "untere Integratorwertschwelle" SWORD InjMass 1 100 -327.6800 327.6700 FORMAT "%8.4" ECU_ADDRESS 0x8FEEB6 /end MEASUREMENT
/begin MEASUREMENT FBC_qLimAct "Aktuelle Begrenzungsmenge für FBC_q" SWORD InjMass 1 100 -327.6800 327.6700 FORMAT "%8.4" ECU_ADDRESS 0x7F8C4E /end MEASUREMENT
/begin MEASUREMENT FBC_RegionChng "signalisiert einen Wechsel der Lernregion in der FBC" UBYTE OneToOne 1 100 0.00 255.0 FORMAT "%5.1" ECU_ADDRESS 0x7F8851 /end MEASUREMENT
/begin MEASUREMENT FBC_Region_mp "Drehzahl-/Mengenbereich für ""regeln - steuern - inaktiv""" UBYTE OneToOne 1 100 0.00 255.0 FORMAT "%5.1" ECU_ADDRESS 0x8FEF3A /end MEASUREMENT
/begin MEASUREMENT FBC_stActive "Status FBC-Regler -> '1': Regeln; '0': Steuern" UBYTE OneToOne 1 100 0.00 255.0 FORMAT "%5.1" ECU_ADDRESS 0x7F8853 /end MEASUREMENT
/begin MEASUREMENT FBC_stDvt_mp "Status der Überwachung Integratorwerte" UBYTE OneToOne 1 100 0.00 255.0 FORMAT "%5.1" ECU_ADDRESS 0x8FEEB8 /end MEASUREMENT
/begin MEASUREMENT FBC_stEqualInit "Initialisierungsstatus für FBC-Regler" UBYTE OneToOne 1 100 0.00 255.0 FORMAT "%5.1" ECU_ADDRESS 0x7F8854 /end MEASUREMENT
/begin MEASUREMENT FBC_stLearn "Bitfeld für Übergänge des Zustandsautomaten" UWORD OneToOne 1 100 0.00 65535.00 FORMAT "%8.2" ECU_ADDRESS 0x7F8C50 /end MEASUREMENT
/begin MEASUREMENT FBC_stRegion_mp "Status  Regler in Abhängigkeit von Menge/Drehzahl ('regeln','steuern','inaktiv')" UBYTE OneToOne 1 100 0.00 255.0 FORMAT "%5.1" ECU_ADDRESS 0x8FEEB9 /end MEASUREMENT
/begin MEASUREMENT FBC_stState_mp "Status des Zustandsautomates der Adaption" UBYTE FBC_LrnState 1 100 1.00000000000 5.00000000000 FORMAT "%13.11" ECU_ADDRESS 0x8FEF3B /end MEASUREMENT
/begin MEASUREMENT FBC_WheelLrnOut "Eingangsignal für FBC Bandpässe" FLOAT32_IEEE OneToOne 1 100 -1.00000000E+35 1.00000000E+35 FORMAT "%10.0" ECU_ADDRESS 0x7F912C /end MEASUREMENT
/begin MEASUREMENT FlFCD_stFlFltDebVal "Entprellter Zustand des Kraftstofffilters" UBYTE OneToOne 1 100 0.00 255.0 FORMAT "%5.1" ECU_ADDRESS 0x7F8856 /end MEASUREMENT
/begin MEASUREMENT FlFCD_stFlFltRawVal "Unentprellter Zustand des Kraftstofffilters" UBYTE OneToOne 1 100 0.00 255.0 FORMAT "%5.1" ECU_ADDRESS 0x7F8857 /end MEASUREMENT
/begin MEASUREMENT FlMng_mAirPerCylFltSmk_mp "PT1 filtered air mass per cylinder" SWORD AirMassPerCyl 1 100 -3276.800 3276.700 FORMAT "%8.3" ECU_ADDRESS 0x8FEF48 /end MEASUREMENT
/begin MEASUREMENT FlMng_mAirPerCylLim_mp "begrenzte Luftmasse" SWORD AirMassPerCyl 1 100 -3276.800 3276.700 FORMAT "%8.3" ECU_ADDRESS 0x8FEF4A /end MEASUREMENT
/begin MEASUREMENT FlMng_qFullLdRgl "Korrekturmenge der Volllastregelung" SWORD InjMass 1 100 -327.6800 327.6700 FORMAT "%8.4" ECU_ADDRESS 0x7F8C7A /end MEASUREMENT
/begin MEASUREMENT FlMng_qFullLdRglI_mp "I-Anteil der Vollastregelung" SLONG InjMass 1 100 -21474836.4800 21474836.4700 FORMAT "%13.4" ECU_ADDRESS 0x8FEF3C /end MEASUREMENT
/begin MEASUREMENT FlMng_qFullLdRglP_mp "P-Anteil der Vollastregelung" SWORD InjMass 1 100 -327.6800 327.6700 FORMAT "%8.4" ECU_ADDRESS 0x8FEF40 /end MEASUREMENT
/begin MEASUREMENT FlMng_qLimSmk "Begrenzungsmenge zur Rauchbegrenzung" SWORD InjMass 1 100 -327.6800 327.6700 FORMAT "%8.4" ECU_ADDRESS 0x7F8C7C /end MEASUREMENT
/begin MEASUREMENT FlMng_qLimSmkDefect_mp "Quantity to detect and in the case of an detached charge air tube" SWORD InjMass 1 100 -327.6800 327.6700 FORMAT "%8.4" ECU_ADDRESS 0x8FEF4C /end MEASUREMENT
/begin MEASUREMENT FlMng_qLimSmk_mp "rauchabhängige Mengenbegrenzung" SWORD InjMass 1 100 -327.6800 327.6700 FORMAT "%8.4" ECU_ADDRESS 0x8FEF4E /end MEASUREMENT
/begin MEASUREMENT FlMng_rLmbdAPSCor_mp "Lambda-Korrekturwertes in Abhängigkeit des Umgebungsdrucks für die Rauchbegrenzung" SWORD lambda 1 100 -32.76800 32.76700 FORMAT "%8.5" ECU_ADDRESS 0x8FEF50 /end MEASUREMENT
/begin MEASUREMENT FlMng_rLmbdRecDvt_mp "Kehrwert der Lambdaabweichung bei Volllastregelung" SWORD lambdaRec 1 100 -3.276800 3.276700 FORMAT "%8.6" ECU_ADDRESS 0x8FEF42 /end MEASUREMENT
/begin MEASUREMENT FlMng_rLmbdSet "Stellgröße für Lambda-Regler" SWORD lambda 1 100 -32.76800 32.76700 FORMAT "%8.5" ECU_ADDRESS 0x7F8C7E /end MEASUREMENT
/begin MEASUREMENT FlMng_rLmbdSmk_mp "Lambda-Wert der Rauchbegrenzung" SWORD lambda 1 100 -32.76800 32.76700 FORMAT "%8.5" ECU_ADDRESS 0x8FEF52 /end MEASUREMENT
/begin MEASUREMENT FlMng_stCurrInp_mp "Status, welcher Eingang von EGT_RgnSwtE3 momentan berechnet werden muss" UBYTE OneToOne 1 100 0.00 255.0 FORMAT "%5.1" ECU_ADDRESS 0x8FEF54 /end MEASUREMENT
/begin MEASUREMENT FlMng_stDefect_mp "Current defect stat" UBYTE OneToOne 1 100 0.00 255.0 FORMAT "%5.1" ECU_ADDRESS 0x8FEF55 /end MEASUREMENT
/begin MEASUREMENT FlMng_stGearGroup_mp "Gear group status" SWORD OneToOne 1 100 -32768.00 32767.00 FORMAT "%8.2" ECU_ADDRESS 0x8FEF56 /end MEASUREMENT
/begin MEASUREMENT FlMng_stMon_mp "Status der Einschaltlogik und Überwachung der VOllastregellung" UBYTE OneToOne 1 100 0.00 255.0 FORMAT "%5.1" ECU_ADDRESS 0x8FEF44 /end MEASUREMENT
/begin MEASUREMENT FlMng_stSmkLim_mp "status of smoke limitation map switching" UBYTE OneToOne 1 100 0.00 255.0 FORMAT "%5.1" ECU_ADDRESS 0x8FEF58 /end MEASUREMENT
/begin MEASUREMENT FlMng_swtFullLdRgl "Schalter zur (de)aktivierung der Vollastregelung" UBYTE OneToOne 1 100 0.00 255.0 FORMAT "%5.1" ECU_ADDRESS 0x7F8858 /end MEASUREMENT
/begin MEASUREMENT FlMng_tiAirPerCylPT1_mp "Time constant for PT1 filtering of air mass per cylinder" ULONG TimeDelay_s 1 100 0.0000010000000 4294.9673 FORMAT "%9.4" ECU_ADDRESS 0x8FEF5C /end MEASUREMENT
/begin MEASUREMENT FlSys_rhoFl "Koeffizient Kraftstoffdichte" SWORD RhoFuel 1 100 -3276.800 3276.700 FORMAT "%8.3" ECU_ADDRESS 0x7F8C82 /end MEASUREMENT
/begin MEASUREMENT FlSys_stDeflate_mp "Aktivierung der Niederdruckentlueftung" UBYTE OneToOne 1 100 0.00 255.0 FORMAT "%5.1" ECU_ADDRESS 0x8FEF60 /end MEASUREMENT
/begin MEASUREMENT FlSys_stTemp_mp "Statusbits zur Erfassung der Kraftstoffsystemtemperatur" UBYTE OneToOne 1 100 0.00 255.0 FORMAT "%5.1" ECU_ADDRESS 0x8FEF61 /end MEASUREMENT
/begin MEASUREMENT FlSys_swtTempSensCfg "Schalter, ob Kraftstofftemperaturfühler vorhanden" UBYTE OneToOne 1 100 0.00 255.0 FORMAT "%5.1" ECU_ADDRESS 0x7F8859 /end MEASUREMENT
/begin MEASUREMENT FlSys_t "aktuelle Systemtemperatur" SWORD Temp_Cels 1 100 -50.140 899.860 FORMAT "%8.3" ECU_ADDRESS 0x7F8C84 /end MEASUREMENT
/begin MEASUREMENT FMA_dqAbs_mp "Absolutwert der Einspritzmengenänderung für FMA" SWORD InjMassSec 1 100 -327.6800 327.6700 FORMAT "%8.4" ECU_ADDRESS 0x8FEF74 /end MEASUREMENT
/begin MEASUREMENT FMA_drLmbdAbs_mp "Absolutwert der Lambdaänderung für FMA" SWORD lambdaSec 1 100 -32.76800 32.76700 FORMAT "%8.5" ECU_ADDRESS 0x8FEF76 /end MEASUREMENT
/begin MEASUREMENT FMA_facAirSwtOff_mp "Ansauglufttemperaturabhängiger Abschaltfaktor der FMA" SWORD Fact 1 100 -4.000000 3.999878 FORMAT "%8.6" ECU_ADDRESS 0x8FEF78 /end MEASUREMENT
/begin MEASUREMENT FMA_facAPSwtOff_mp "Atmosphärendruckabhängiger Abschaltfaktor der FMA" SWORD Fact 1 100 -4.000000 3.999878 FORMAT "%8.6" ECU_ADDRESS 0x8FEF7A /end MEASUREMENT
/begin MEASUREMENT FMA_facEngSwtOff_mp "Motortemperaturabhängiger Abschaltfaktor der FMA" SWORD Fact 1 100 -4.000000 3.999878 FORMAT "%8.6" ECU_ADDRESS 0x8FEF7C /end MEASUREMENT
/begin MEASUREMENT FMA_facFaultSwtOff_mp "Faktor für langsame FMA-Abschaltung bei schweren Systemfehlern" SWORD Fact 1 100 -4.000000 3.999878 FORMAT "%8.6" ECU_ADDRESS 0x8FEF7E /end MEASUREMENT
/begin MEASUREMENT FMA_facFlSwtOff_mp "Kraftstofftemperaturabhängiger Abschaltfaktor der FMA" SWORD Fact 1 100 -4.000000 3.999878 FORMAT "%8.6" ECU_ADDRESS 0x8FEF80 /end MEASUREMENT
/begin MEASUREMENT FMA_facNQSwtOff_mp "Drehzahl-/einspritzmengenabhängiger Abschaltfaktor der FMA für betriebsbereichsabhängige Abschaltung" SWORD Fact 1 100 -4.000000 3.999878 FORMAT "%8.6" ECU_ADDRESS 0x8FEF68 /end MEASUREMENT
/begin MEASUREMENT FMA_facRgnSwtOff_mp "Regenerations-/ Applikationsabhängiger Abschaltfaktor der FMA" SWORD Fact 1 100 -4.000000 3.999878 FORMAT "%8.6" ECU_ADDRESS 0x8FEF82 /end MEASUREMENT
/begin MEASUREMENT FMA_facSlpSwtOff_mp "Abschaltfaktor der FMA, gebildet aus den 4 oberen Abschaltfaktoren" SWORD Fact 1 100 -4.000000 3.999878 FORMAT "%8.6" ECU_ADDRESS 0x8FEF84 /end MEASUREMENT
/begin MEASUREMENT FMA_facSwtOff "Abschaltfaktor zum langsamen Aus- und Einschalten der FMA" SWORD Fact 1 100 -4.000000 3.999878 FORMAT "%8.6" ECU_ADDRESS 0x7F8C52 /end MEASUREMENT
/begin MEASUREMENT FMA_facSwtOffTot_mp "Gesamtabschaltfaktor zum langsamen Aus- und Einschalten der FMA" SWORD Fact 1 100 -4.000000 3.999878 FORMAT "%8.6" ECU_ADDRESS 0x8FEF6A /end MEASUREMENT
/begin MEASUREMENT FMA_qAct_mp "Aus Lambda- und Luftmassenmessung ermittelte Einspritzmenge. ""Wirkliche"" Einspritzmenge der FMA" SWORD InjMass 1 100 -327.6800 327.6700 FORMAT "%8.4" ECU_ADDRESS 0x8FEF62 /end MEASUREMENT
/begin MEASUREMENT FMA_qCtl_mp "Für Bestimmung des Mengenfehlers verwendetes Mengensignal" SWORD InjMass 1 100 -327.6800 327.6700 FORMAT "%8.4" ECU_ADDRESS 0x8FEF66 /end MEASUREMENT
/begin MEASUREMENT FMA_qDC "Von FMA ermittelter Einspritzmengenfehler bzw. -korrekturwert für Betriebsart Direct Control (Modellfehler)" SWORD InjMass 1 100 -327.6800 327.6700 FORMAT "%8.4" ECU_ADDRESS 0x7F8C54 /end MEASUREMENT
/begin MEASUREMENT FMA_qDev_mp "Abweichung der ""wirklichen"" Einspritzmenge von der gewünschten Einspritzmenge in der FMA" SWORD InjMass 1 100 -327.6800 327.6700 FORMAT "%8.4" ECU_ADDRESS 0x8FEF64 /end MEASUREMENT
/begin MEASUREMENT FMA_qDiff_mp "Differenz aus Einspritzmengenfehler und aktuellem Kennfeldwert" SWORD InjMass 1 100 -327.6800 327.6700 FORMAT "%8.4" ECU_ADDRESS 0x8FEF6C /end MEASUREMENT
/begin MEASUREMENT FMA_qErrMod_mp "Aus Fehlermodell ermittelter Rohwert des Einspritzmengenfehlers" SWORD InjMass 1 100 -327.6800 327.6700 FORMAT "%8.4" ECU_ADDRESS 0x8FEF6E /end MEASUREMENT
/begin MEASUREMENT FMA_qIC "Von FMA ermittelter Einspritzmengenfehler bzw. -korrekturwert für Betriebsart Indirect Control (Modellfehler)" SWORD InjMass 1 100 -327.6800 327.6700 FORMAT "%8.4" ECU_ADDRESS 0x7F8C56 /end MEASUREMENT
/begin MEASUREMENT FMA_qMapRow0_mp "Kennfeldwerte für erste Mengenstützstelle (erste zeile von adaptive Kennfeld)" SWORD InjMass 1 100 -327.6800 327.6700 FORMAT "%8.4" ARRAY_SIZE 8 ECU_ADDRESS 0x6F80C4 /end MEASUREMENT
/begin MEASUREMENT FMA_qMapRow1_mp "Kennfeldwerte für zweite Mengenstützstelle (zweite zeile von adaptive Kennfeld)" SWORD InjMass 1 100 -327.6800 327.6700 FORMAT "%8.4" ARRAY_SIZE 8 ECU_ADDRESS 0x6F80D4 /end MEASUREMENT
/begin MEASUREMENT FMA_qMapRow2_mp "Kennfeldwerte für dritte Mengenstützstelle (dritte zeile von adaptive Kennfeld)" SWORD InjMass 1 100 -327.6800 327.6700 FORMAT "%8.4" ARRAY_SIZE 8 ECU_ADDRESS 0x6F80E4 /end MEASUREMENT
/begin MEASUREMENT FMA_qMapRow3_mp "Kennfeldwerte für vierte Mengenstützstelle (vierte zeile von adaptive Kennfeld)" SWORD InjMass 1 100 -327.6800 327.6700 FORMAT "%8.4" ARRAY_SIZE 8 ECU_ADDRESS 0x6F80F4 /end MEASUREMENT
/begin MEASUREMENT FMA_qMapRow4_mp "Kennfeldwerte für fünfte Mengenstützstelle (fünfte zeile von adaptive Kennfeld)" SWORD InjMass 1 100 -327.6800 327.6700 FORMAT "%8.4" ARRAY_SIZE 8 ECU_ADDRESS 0x6F8104 /end MEASUREMENT
/begin MEASUREMENT FMA_qMapRow5_mp "Kennfeldwerte für sechste Mengenstützstelle (sechste zeile von adaptive Kennfeld)" SWORD InjMass 1 100 -327.6800 327.6700 FORMAT "%8.4" ARRAY_SIZE 8 ECU_ADDRESS 0x6F8114 /end MEASUREMENT
/begin MEASUREMENT FMA_qMapRow6_mp "Kennfeldwerte für siebte Mengenstützstelle (siebte zeile von adaptive Kennfeld)" SWORD InjMass 1 100 -327.6800 327.6700 FORMAT "%8.4" ARRAY_SIZE 8 ECU_ADDRESS 0x6F8124 /end MEASUREMENT
/begin MEASUREMENT FMA_qMapRow7_mp "Kennfeldwerte für achte Mengenstützstelle (achte zeile von adaptive Kennfeld)" SWORD InjMass 1 100 -327.6800 327.6700 FORMAT "%8.4" ARRAY_SIZE 8 ECU_ADDRESS 0x6F8134 /end MEASUREMENT
/begin MEASUREMENT FMA_qReg_mp "Einspritzmengenfehler im aktuellen Lernbereich" SWORD InjMass 1 100 -327.6800 327.6700 FORMAT "%8.4" ECU_ADDRESS 0x8FEF70 /end MEASUREMENT
/begin MEASUREMENT FMA_qSetFil_mp "Initialisierungswert für Integrierer bzw. PT1-Filter" SWORD InjMass 1 100 -327.6800 327.6700 FORMAT "%8.4" ECU_ADDRESS 0x8FEF72 /end MEASUREMENT
/begin MEASUREMENT FMA_q_mp "Mit abshaltfactor multiplizierter Mengenfehler des Fehlermodells" SWORD InjMass 1 100 -327.6800 327.6700 FORMAT "%8.4" ECU_ADDRESS 0x6F80C2 /end MEASUREMENT
/begin MEASUREMENT FMA_stDynDlyd_mp "FMA-Status: Aktuell oder vor kurzem starke Änderung der Einspritzmenge (verzögerte Einspritzmengendynamik)" UBYTE OneToOne 1 100 0.00 255.0 FORMAT "%5.1" ECU_ADDRESS 0x8FEF86 /end MEASUREMENT
/begin MEASUREMENT FMA_stDynLmbd_mp "FMA- Status: Aktuell oder bis vor kurzem starke Lambdaänderung" UBYTE OneToOne 1 100 0.00 255.0 FORMAT "%5.1" ECU_ADDRESS 0x8FEF87 /end MEASUREMENT
/begin MEASUREMENT FMA_stNoAdapt_mp "Status: Adaption des FMA-Fehlermodells angehalten" UWORD OneToOne 1 100 0.00 65535.00 FORMAT "%8.2" ECU_ADDRESS 0x8FEF88 /end MEASUREMENT
/begin MEASUREMENT FMA_stOvrRunDlyd_mp "FMA-Status: Aktuell oder bis vor kurzem Schubbetrieb (verzögerter Schubbetrieb)" UBYTE OneToOne 1 100 0.00 255.0 FORMAT "%5.1" ECU_ADDRESS 0x8FEF8A /end MEASUREMENT
/begin MEASUREMENT FMA_stReset_mp "Status: FMA-Fehlermodell wird zurückgesetzt" UBYTE OneToOne 1 100 0.00 255.0 FORMAT "%5.1" ECU_ADDRESS 0x8FEF8B /end MEASUREMENT
/begin MEASUREMENT FMA_stRngLmbd_mp "FMA_ Status: Lambda aktuell oder bis vor kurzem außerhalb" UBYTE OneToOne 1 100 0.00 255.0 FORMAT "%5.1" ECU_ADDRESS 0x8FEF8C /end MEASUREMENT
/begin MEASUREMENT FMA_stSwtOff "Abschaltzustand der FMA" UWORD OneToOne 1 100 0.00 65535.00 FORMAT "%8.2" ECU_ADDRESS 0x7F8C58 /end MEASUREMENT
/begin MEASUREMENT FMA_tiFuncOp_mp "Betriebszeit des Fehlermodells seit der letzten Initialisierung der Lernwerte" SLONG Time_s 1 100 -21474836.4800 21474836.4700 FORMAT "%13.4" ECU_ADDRESS 0x6F8144 /end MEASUREMENT
/begin MEASUREMENT FMTC_etaCurr "aktueller Wirkunggsgrad (korrigiert)" SWORD Eta 1 100 -256.0000 255.9922 FORMAT "%8.4" ECU_ADDRESS 0x7F8C5A /end MEASUREMENT
/begin MEASUREMENT FMTC_etaCurrStd "aktueller Standard-Wirkungsgradfaktor (ohne Regenerationsmaßnahmen)" SWORD Eta 1 100 -256.0000 255.9922 FORMAT "%8.4" ECU_ADDRESS 0x7F8C5C /end MEASUREMENT
/begin MEASUREMENT FMTC_facAirCor_mp "Eta-Korrekturfaktor für die Frischluft pro Zylinder" SWORD Fact 1 100 -4.000000 3.999878 FORMAT "%8.6" ECU_ADDRESS 0x8FEF8E /end MEASUREMENT
/begin MEASUREMENT FMTC_facEtaCor "aktueller Wirkungsgradkorrekturwert" SWORD Fact 1 100 -4.000000 3.999878 FORMAT "%8.6" ECU_ADDRESS 0x7F8C5E /end MEASUREMENT
/begin MEASUREMENT FMTC_facStrtInjCor_mp "Eta-Korrekturfaktor für den Spritzbeginn" SWORD Fact 1 100 -4.000000 3.999878 FORMAT "%8.6" ECU_ADDRESS 0x8FEF90 /end MEASUREMENT
/begin MEASUREMENT FMTC_mAirDiff_mp "Differenz Luftmasse optimal-aktueller Wert" SWORD AirMassPerCyl 1 100 -3276.800 3276.700 FORMAT "%8.3" ECU_ADDRESS 0x8FEF92 /end MEASUREMENT
/begin MEASUREMENT FMTC_mAirOpt_mp "Eta-Korrektur, Referenzwert für die Luft pro Zylinder" SWORD AirMassPerCyl 1 100 -3276.800 3276.700 FORMAT "%8.3" ECU_ADDRESS 0x8FEF94 /end MEASUREMENT
/begin MEASUREMENT FMTC_phiStrtInjDiff_mp "Differenz Spritzbeginn optimal-aktueller Wert" SWORD AngleCrS 1 100 -768.0000 767.9766 FORMAT "%8.4" ECU_ADDRESS 0x8FEF96 /end MEASUREMENT
/begin MEASUREMENT FMTC_phiStrtInjOpt_mp "aktueller Seferenzwert für Spritzbeginnkorrektur" SWORD AngleCrS 1 100 -768.0000 767.9766 FORMAT "%8.4" ECU_ADDRESS 0x8FEF98 /end MEASUREMENT
/begin MEASUREMENT FMTC_qCurr "Einspritzmenge aktueller Wert" SWORD InjMass 1 100 -327.6800 327.6700 FORMAT "%8.4" ECU_ADDRESS 0x7F8C60 /end MEASUREMENT
/begin MEASUREMENT FMTC_qDes "Einspritzmenge Wunschwert" SWORD InjMass 1 100 -327.6800 327.6700 FORMAT "%8.4" ECU_ADDRESS 0x7F8C62 /end MEASUREMENT
/begin MEASUREMENT FMTC_qRaw "Einspritzmenge Rohwert (>Luftsystem)" SWORD InjMass 1 100 -327.6800 327.6700 FORMAT "%8.4" ECU_ADDRESS 0x7F8C64 /end MEASUREMENT
/begin MEASUREMENT FMTC_qSet "Einspritzmenge Sollwert (>Einspritzung)" SWORD InjMass 1 100 -327.6800 327.6700 FORMAT "%8.4" ECU_ADDRESS 0x7F8C66 /end MEASUREMENT
/begin MEASUREMENT FMTC_qSetOptStd_mp "optimale Standardsollmenge ohne Korrekturen" SWORD InjMass 1 100 -327.6800 327.6700 FORMAT "%8.4" ECU_ADDRESS 0x8FEF9A /end MEASUREMENT
/begin MEASUREMENT FMTC_qSetRgn1_mp "Regenerationseinspritzmenge Sollwert mit Berücksichtigung einer Regenerationsanforderung 1 der Abgasnachbehandlung" SWORD InjMass 1 100 -327.6800 327.6700 FORMAT "%8.4" ECU_ADDRESS 0x8FEF9C /end MEASUREMENT
/begin MEASUREMENT FMTC_qSetRgn2_mp "Regenerationseinspritzmenge Sollwert mit Berücksichtigung einer Regenerationsanforderung 2 der Abgasnachbehandlung" SWORD InjMass 1 100 -327.6800 327.6700 FORMAT "%8.4" ECU_ADDRESS 0x8FEF9E /end MEASUREMENT
/begin MEASUREMENT FMTC_qSetStd_mp "Standardeinspritzmenge Sollwert ohne Berücksichtigung der Regenerationsanforderung der Abgasnachbehandlung" SWORD InjMass 1 100 -327.6800 327.6700 FORMAT "%8.4" ECU_ADDRESS 0x8FEFA0 /end MEASUREMENT
/begin MEASUREMENT FMTC_qStrt "Einspritzmenge Startwert" SWORD InjMass 1 100 -327.6800 327.6700 FORMAT "%8.4" ECU_ADDRESS 0x7F8C68 /end MEASUREMENT
/begin MEASUREMENT FMTC_trqInr "aktuelles rückgerechnetes inneres Motormoment" SWORD Trq 1 100 -3276.800 3276.700 FORMAT "%8.3" ECU_ADDRESS 0x7F8C6A /end MEASUREMENT
/begin MEASUREMENT FMTC_trqInrLimSmk "Begrenzungsmoment Rauchgrenze" SWORD Trq 1 100 -3276.800 3276.700 FORMAT "%8.3" ECU_ADDRESS 0x7F8C6C /end MEASUREMENT
/begin FUNCTION engprt "Motormechanikschutz"
 /begin DEF_CHARACTERISTIC EngPrt_dTrqLimUp_C EngPrt_dTrqLimDown_C EngPrt_facAPSPrv_MAP EngPrt_facOvhtPrv_MAP EngPrt_nOvrSpd_C EngPrt_pAPSPrvDfl_C EngPrt_dtrqUpCBLim_C EngPrt_dtrqDwnCBLim_C EngPrt_dtrqUpNLim_C EngPrt_dtrqDwnNLim_C EngPrt_rVnDAMax_C EngPrt_rVnDAMin_C EngPrt_rVnTrqMax_C EngPrt_rVnTrqMin_C EngPrt_swtTrqGear_CUR EngPrt_trqCBLim1_CUR EngPrt_trqCBLim_CUR EngPrt_trqLim1_CUR EngPrt_trqLimDA_CUR EngPrt_trqLim_CUR EngPrt_trqNLimSpr_CUR EngPrt_trqNLim_CUR /end DEF_CHARACTERISTIC
 /begin IN_MEASUREMENT APSCD_pVal Eng_nAvrg Eng_tEng Gearbx_stGear VSSCD_v /end IN_MEASUREMENT
/end FUNCTION
/begin FUNCTION engprt_fwoscdet ""
 /begin DEF_CHARACTERISTIC EngPrt_nTrqShutOff_C EngPrt_tiFWOscDetDebDef_C EngPrt_tiFWOscDetDebOk_C /end DEF_CHARACTERISTIC
/end FUNCTION
/begin FUNCTION engprt_fwoscdet_msg "" /begin OUT_MEASUREMENT EngPrt_stFWOscDet /end OUT_MEASUREMENT /end FUNCTION
/begin FUNCTION engprt_fwoscdet_uic "" /end FUNCTION
/begin FUNCTION engprt_msg ""
 /begin OUT_MEASUREMENT EngPrt_facPrtLim EngPrt_stOvrSpd EngPrt_trqLim EngPrt_trqNLim EngPrt_trqOvhtPrv EngPrt_trqPrtLim /end OUT_MEASUREMENT
/end FUNCTION
/begin FUNCTION engprt_prtlim_var_uic "" /end FUNCTION
/begin FUNCTION engprt_qprtlim "Begrenzungmenge zum thermischen Motorschutz"
 /begin DEF_CHARACTERISTIC EngPrt_facOvhtPrvCT_CUR EngPrt_facOvhtPrvFT_CUR EngPrt_facOvhtPrvOT_CUR EngPrt_qOvhtPrvNRng_MAP EngPrt_qOvhtPrvVRng_MAP /end DEF_CHARACTERISTIC
 /begin IN_MEASUREMENT CTSCD_tClnt EngPrt_facOvhtPrv_mp Eng_nAvrg FTSCD_tFuel OTSCD_tEngOil VSSCD_v /end IN_MEASUREMENT
/end FUNCTION
/begin FUNCTION engprt_qprtlim_msg "" /begin OUT_MEASUREMENT EngPrt_qPrtLim /end OUT_MEASUREMENT /end FUNCTION
/begin FUNCTION engprt_qprtlim_uic "" /begin DEF_CHARACTERISTIC EngPrt_qPrtLim_Vector EngPrt_qPrtLim_Channel /end DEF_CHARACTERISTIC
 /begin OUT_MEASUREMENT EngPrt_facOvhtPrvCT_mp EngPrt_facOvhtPrvFT_mp EngPrt_facOvhtPrvOT_mp EngPrt_facOvhtPrv_mp EngPrt_qOvhtPrvNRng_mp EngPrt_qOvhtPrvVRng_mp /end OUT_MEASUREMENT
/end FUNCTION
/begin FUNCTION engprt_uic ""
 /begin DEF_CHARACTERISTIC EngPrt_trqNLim_Vector EngPrt_trqNLim_Channel EngPrt_trqPrtLim_Vector EngPrt_trqPrtLim_Channel /end DEF_CHARACTERISTIC
 /begin OUT_MEASUREMENT EngPrt_stTrqRampSwitch_mp EngPrt_trqLimPrvLim_mp EngPrt_trqRamLim1_mp EngPrt_trqRamLim_mp /end OUT_MEASUREMENT
/end FUNCTION
/begin FUNCTION engprt_var_msg "" /end FUNCTION
/begin FUNCTION eng_msg ""
 /begin OUT_MEASUREMENT Eng_dnAvrg Eng_nAvrg Eng_nCurr Eng_stOvrTemp Eng_stOvrTemp2 Eng_trqCrvMax /end OUT_MEASUREMENT
/end FUNCTION
/begin FUNCTION eng_teng "Motortemperatur" /begin DEF_CHARACTERISTIC Eng_tiOvrTemp2_C Eng_tiOvrTemp_C /end DEF_CHARACTERISTIC /end FUNCTION
/begin FUNCTION eng_teng_msg "" /begin OUT_MEASUREMENT Eng_tEng Eng_tFld Eng_tStrt /end OUT_MEASUREMENT /end FUNCTION
/begin FUNCTION eng_teng_uic "" /begin OUT_MEASUREMENT Eng_stOvrTemp_mp /end OUT_MEASUREMENT /end FUNCTION
/begin FUNCTION erlpcd "Fehlerlampe Komponententreiber"
 /begin DEF_CHARACTERISTIC ErLpCD_ctMilPwrStgOnMax_C ErLpCD_ctSysLmpPwrStgOnMax_C ErLpCD_tiDefMil_C ErLpCD_tiOkMil_C ErLpCD_nThresMil_C ErLpCD_tiMaxMil_C ErLpCD_tiMilTst_C ErLpCD_tiDelMil_C ErLpCD_tiBlkMil_C ErLpCD_swtMilEna_C ErLpCD_numDiaErrLmp_C ErLpCD_numDiaSysLmp_C ErLpCD_numDioOutErrLmp_C ErLpCD_numDioOutSysLmp_C ErLpCD_stRdy_C ErLpCD_tiRdy_C ErLpCD_tiBlkOn_C ErLpCD_tiBlkOff_C ErLpCD_stMilSPICtl_C ErLpCD_stPwrStgActvLmp_C ErLpCD_stPwrStgActvMil_C ErLpCD_stPwrStgDiaLmp_C ErLpCD_stPwrStgDiaMil_C ErLpCD_stSysLmpSPICtl_C ErLpCD_swtSysEqGlwLmp_C ErLpCD_tiDefSysLmp_C ErLpCD_tiOkSysLmp_C ErLpCD_nThresSysLmp_C ErLpCD_tiMaxSysLmp_C ErLpCD_tiTstSysLmp_C ErLpCD_tiDelSysLmp_C ErLpCD_tiBlkSysLmp_C ErLpCD_swtSysLmpEna_C ErLpCD_tiBtwTstMil_C ErLpCD_tiBtwTstSysLmp_C ErLpCD_tiMilPwrStgOn_C ErLpCD_tiSysLmpPwrStgOn_C /end DEF_CHARACTERISTIC
/end FUNCTION
/begin FUNCTION erlpcd_msg ""
 /begin OUT_MEASUREMENT ErLpCD_OrdGlwLmp ErLpCD_stMil ErLpCD_stMilLmpTst ErLpCD_stMilReq ErLpCD_stSysLmp ErLpCD_stSysLmpReq /end OUT_MEASUREMENT
/end FUNCTION
/begin FUNCTION erlpcd_uic "" /begin OUT_MEASUREMENT ErLpCD_stTstMIL_mp ErLpCD_stTstSysLmp_mp /end OUT_MEASUREMENT /end FUNCTION
/begin FUNCTION ess_getnmin "Leerlaufanhebung bei schwacher Batterie"
 /begin DEF_CHARACTERISTIC ESS_nLIBattThres_C ESS_nMinThres_C ESS_tiDelayUBattFFSet_C ESS_uLIBattThresFFSet_C /end DEF_CHARACTERISTIC
/end FUNCTION
/begin FUNCTION ess_getnmin_uic "" /end FUNCTION
/begin FUNCTION ess_getnmin_var ""
 /begin DEF_CHARACTERISTIC ESS_nBattMin_C ESS_tiDelayUBattFFRes_C ESS_uLIBattThresFFRes_C /end DEF_CHARACTERISTIC
/end FUNCTION
/begin FUNCTION ess_getnmin_var_uic "" /end FUNCTION
/begin FUNCTION ess_msg "" /begin OUT_MEASUREMENT ESS_nBattMin ESS_nMax ESS_nMin ESS_pwrDes ESS_pwrLead /end OUT_MEASUREMENT /end FUNCTION
/begin FUNCTION ess_updatedem "" /end FUNCTION
/begin FUNCTION ess_updatedem_uic "" /end FUNCTION
/begin FUNCTION etclb_calibration "Ansteuerdauer Kalibrierung"
 /begin DEF_CHARACTERISTIC ETClb_ctLrnThres2_C ETClb_ctLrnThresQck_C ETClb_ctLrnThres_C ETClb_dpRailLim_CA ETClb_facFlt2_C ETClb_facFltQck_C ETClb_facFlt_C ETClb_numCyclMeas_C ETClb_numCyclNoDyn_C ETClb_numCyclStartEnergize_C ETClb_pRailSet_CA ETClb_SigThres_CA ETClb_swtCorActvVal_C ETClb_swtCorActvType_C ETClb_swtWrDflVal_C ETClb_volEffectiveMin_CA ETClb_vStartClb_CA ETClb_vStopClb_CA /end DEF_CHARACTERISTIC
 /begin OUT_MEASUREMENT ETClb_ctLrn_mp ETClb_dtiETFlt0_mp ETClb_dtiETFlt1_mp ETClb_dtiETFlt2_mp ETClb_numCylCur_mp ETClb_swtQckClb_mp ETClb_tiETCor0_mp ETClb_tiETCor1_mp ETClb_tiETCor2_mp ETClb_tiETCur_mp ETClb_tiETMinEff_mp /end OUT_MEASUREMENT
/end FUNCTION
/begin FUNCTION etclb_calibration_msg "" /begin OUT_MEASUREMENT ETClb_stCor ETClb_swtCorActv /end OUT_MEASUREMENT /end FUNCTION
/begin FUNCTION etclb_calibration_uic ""
 /begin OUT_MEASUREMENT ETClb_ctInjCycl_mp ETClb_numPres_mp ETClb_numRailPresClbPnt_mp ETClb_stDemCor_mp ETClb_stRlsCylCor_mp ETClb_st_mp /end OUT_MEASUREMENT
/end FUNCTION
/begin FUNCTION etclb_eval "Auswertung von Einspritzungen fuer die Ansteuerdauer Kalibrierung"
 /begin DEF_CHARACTERISTIC ETClb_DebETMaxDefect_C ETClb_DebETMaxOk_C ETClb_DebETMinDefect_C ETClb_DebETMinOk_C ETClb_tiETStep_CA ETClb_tiET_MAX_CA ETClb_tiET_MIN_CA /end DEF_CHARACTERISTIC
 /begin OUT_MEASUREMENT ETClb_stEval_mp ETClb_stRailpClbPntErr_mp /end OUT_MEASUREMENT
/end FUNCTION
/begin FUNCTION etclb_eval_uic "" /begin OUT_MEASUREMENT ETClb_stEvalResult_mp /end OUT_MEASUREMENT /end FUNCTION
/begin FUNCTION etclb_lib ""
 /begin DEF_CHARACTERISTIC ETClb_ctDflLrn_CA ETClb_DebETFltMaxDefect_C ETClb_DebETFltMaxOk_C ETClb_DebETFltMinDefect_C ETClb_DebETFltMinOk_C ETClb_dtiDflETFlt0_CA ETClb_dtiDflETFlt1_CA ETClb_dtiDflETFlt2_CA ETClb_numDflCylCur_CA ETClb_swtDflQckClb_C ETClb_tiDflETCur_CA ETClb_tiDflInjInit_C ETClb_tiETOfs_CA /end DEF_CHARACTERISTIC
 /begin OUT_MEASUREMENT ETClb_tiETChkCor0_mp ETClb_tiETChkCor1_mp ETClb_tiETChkCor2_mp /end OUT_MEASUREMENT
/end FUNCTION
/begin FUNCTION etclb_lib_uic "" /end FUNCTION
/begin FUNCTION fancd_co "Komponententreiber Lüfter Koordination"
 /begin DEF_CHARACTERISTIC FanCD_ctPwrStgOnMax_C FanCD_DebExcTempDef_C FanCD_DebExcTempOk_C FanCD_tiDebDia1Def_C FanCD_tiDebDia1Ok_C FanCD_tiDebDia2Def_C FanCD_tiDebDia2Ok_C FanCD_tiDebDia3Def_C FanCD_tiDebDia3Ok_C FanCD_DebNoLoadDef_C FanCD_DebNoLoadOk_C FanCD_DebShortCircBatDef_C FanCD_DebShortCircBatOk_C FanCD_DebShortCircGndDef_C FanCD_DebShortCircGndOk_C FanCD_numDia_C FanCD_numPwmOut_C FanCD_stInvOut_C FanCD_stSPICtl_C FanCD_tiBtwTst_C FanCD_tiFanCtlr1Max_C FanCD_tiFanCtlr1Min_C FanCD_tiFanCtlr2Max_C FanCD_tiFanCtlr2Min_C FanCD_tiFanCtlr3Max_C FanCD_tiFanCtlr3Min_C FanCD_tiPwrStgOn_C /end DEF_CHARACTERISTIC
/end FUNCTION
/begin FUNCTION fancd_co_uic "" /begin OUT_MEASUREMENT FanCD_dcycRaw_mp /end OUT_MEASUREMENT /end FUNCTION
/begin FUNCTION fancd_msg "" /end FUNCTION
/begin FUNCTION fanctl "Lüftersteuerung"
 /begin DEF_CHARACTERISTIC FanCtl_dcycAftRun_C FanCtl_dcycHysDelta_C FanCtl_dcycMax_C FanCtl_dcycMinOff_C FanCtl_dcycSwtLimOff_C FanCtl_dcycSwtLimOn_C FanCtl_dcyc_CUR FanCtl_facWghFctr_CUR FanCtl_nDemFanOffLim_C FanCtl_nDemFanOn_C FanCtl_nMin_C FanCtl_nSetGbxOil_MAP FanCtl_nSetPnt_MAP FanCtl_nSetPointFanOn_C FanCtl_stDemFanOffGear_C FanCtl_stDemFanOnGear_C FanCtl_swtBattCor_C FanCtl_tClntDfl_C FanCtl_tDemFanOffLim_C FanCtl_tDemFanOnLim_C FanCtl_tEngAftRunThres_C FanCtl_tGbxOilDfl_C FanCtl_tiDemFanOn_C FanCtl_tiMinAftRunOfs_C FanCtl_uBattRef_C FanCtl_vDemFanOffMax_C FanCtl_vDemFanOffMin_C FanCtl_vDemFanOnMax_C FanCtl_vDemFanOnMin_C /end DEF_CHARACTERISTIC
 /begin IN_MEASUREMENT FanCtl_nSetPoint FanCtl_tClnt_mp FanCtl_tGbxOil_mp VSSCD_v /end IN_MEASUREMENT
/end FUNCTION
/begin FUNCTION fanctl_msg ""
 /begin OUT_MEASUREMENT FanCtl_dcycOut FanCtl_nSetPoint FanCtl_stAftRun FanCtl_stOut /end OUT_MEASUREMENT
/end FUNCTION
/begin FUNCTION fanctl_uic ""
 /begin OUT_MEASUREMENT FanCtl_dcycAftRun_mp FanCtl_dcycBattCor_mp FanCtl_dcycHysStart_mp FanCtl_dcycHys_mp FanCtl_dcycRaw_mp FanCtl_facWghFctr_mp FanCtl_nSetGbxOilMap_mp FanCtl_nSetPntCAN_mp FanCtl_nSetPntMap_mp FanCtl_nSetPoint_mp FanCtl_stDemFanShOff_mp FanCtl_stDemFan_mp FanCtl_stHys_mp FanCtl_stLogic_mp FanCtl_tClnt_mp FanCtl_tGbxOil_mp /end OUT_MEASUREMENT
/end FUNCTION
/begin FUNCTION fbc_equal "Laufruheregler"
 /begin DEF_CHARACTERISTIC FBC_BPFac1NumG_CUR FBC_dBPFacNumLo_CA FBC_dBPFacNumHi_CA FBC_dBPFacDen1_CA FBC_dBPFacDen2_CA FBC_ctSegOffset_C FBC_dSegNhiCaS_C FBC_dSegNloCaS_C FBC_dSyn_C FBC_fSurge_CUR FBC_GvrnIKi_C FBC_GvrnIKiPos_C FBC_GvrnIKiNeg_C FBC_GvrnIWinPos_C FBC_GvrnIWinNeg_C FBC_GvrnPKp_C FBC_GvrnPKpPos_C FBC_GvrnPKpNeg_C FBC_GvrnPWinPos_C FBC_GvrnPWinNeg_C FBC_nCtlOfsMin_C FBC_nCtlThresMax_C FBC_nGvrnOfsMin_C FBC_nGvrnThresMax_C FBC_nHyst_C FBC_nSurgeOffset_C FBC_qCtlOfsMax_C FBC_qCtlThresMin_C FBC_qDvtMax_CUR FBC_qDvtMin_CUR FBC_qGvrnThresMax_CUR FBC_qGvrnThresMin_C FBC_qLim_CUR FBC_stInitI_C FBC_stMskRgn_C FBC_tiDvtMaxDefect_C FBC_tiDvtMaxOk_C FBC_tiDvtMinDefect_C FBC_tiDvtMinOk_C /end DEF_CHARACTERISTIC
 /begin IN_MEASUREMENT DrvTrn_rTransDT Eng_nAvrg InjCtl_qSetUnBal /end IN_MEASUREMENT
 /begin OUT_MEASUREMENT FBC_dBPCaS_mp FBC_facBPNum_mp FBC_facSegVal_mp FBC_nMaxOvrRun_mp /end OUT_MEASUREMENT
/end FUNCTION
/begin FUNCTION fbc_equal_uic "" /begin DEF_CHARACTERISTIC FBC_q_Vector FBC_q_Channel /end DEF_CHARACTERISTIC /begin OUT_MEASUREMENT FBC_qDvtMax_mp FBC_qDvtMin_mp FBC_stDvt_mp FBC_stRegion_mp /end OUT_MEASUREMENT /end FUNCTION
/begin FUNCTION fbc_msg ""
 /begin OUT_MEASUREMENT FBC_Badpt FBC_ctSegInt FBC_dBPSum FBC_q FBC_qDvtCyl FBC_qLimAct FBC_RegionChng FBC_stActive FBC_stEqualInit FBC_stLearn FBC_WheelLrnOut /end OUT_MEASUREMENT
/end FUNCTION
/begin FUNCTION fbc_wheellrn "Antialiasingfilter und Geberradadaption"
 /begin DEF_CHARACTERISTIC FBC_AACoeff_C FBC_AAOrd_C FBC_Act_C FBC_DXadptl_C FBC_DXadptu_C FBC_DXalf0_C FBC_nLrnThres_C FBC_nThresFbc_C FBC_TFlrn_C FBC_TF_C FBC_ThresDyn_C FBC_TSm_C /end DEF_CHARACTERISTIC
 /begin OUT_MEASUREMENT FBC_AALOut_mp FBC_DXadpt_mp FBC_DXSfn_mp FBC_DXSfp_mp FBC_DXSf_mp FBC_DXSl_mp FBC_DXS_mp FBC_Region_mp FBC_stState_mp /end OUT_MEASUREMENT
/end FUNCTION
/begin FUNCTION fbc_wheellrn_uic "" /begin DEF_CHARACTERISTIC FBC_lrn_Vector FBC_lrn_Channel /end DEF_CHARACTERISTIC /end FUNCTION
/begin FUNCTION flfcd "Kraftstoffilter Komponententreiber"
 /begin DEF_CHARACTERISTIC FlFCD_numDioIn_C FlFCD_swtFlFltInv_C FlFCD_swtFlFltSens_C FlFCD_tiDebFlFltDef_C FlFCD_tiDebFlFltOk_C FlFCD_tiFlFltDebNeg_C FlFCD_tiFlFltDebPos_C /end DEF_CHARACTERISTIC
/end FUNCTION
/begin FUNCTION flfcd_msg "" /begin OUT_MEASUREMENT FlFCD_stFlFltDebVal FlFCD_stFlFltRawVal /end OUT_MEASUREMENT /end FUNCTION
/begin FUNCTION flfcd_uic "" /end FUNCTION
/begin FUNCTION flmng "Gemischbildung"
 /begin DEF_CHARACTERISTIC FlMng_tiDebSmkDefectDef_C FlMng_tiDebSmkDefectOk_C FlMng_dqLimUp_C FlMng_dqLimDwn_C FlMng_dSmkLimUp_C FlMng_dSmkLimDwn_C FlMng_facAPSCorNeg_CUR FlMng_facAPSCorPos_CUR FlMng_facLmbdAPSCor_CUR FlMng_facLmbdATSCor_CUR FlMng_facLmbdETSCor_CUR FlMng_mAirPerCylMin_C FlMng_numRevEng_C FlMng_pThresLmbd0_C FlMng_pThresLmbd1_C FlMng_pThresLmbd2_C FlMng_qDefectMin_MAP FlMng_qDefectOfs_C FlMng_qEngTemp_CUR FlMng_rLmbdAPSCor_MAP FlMng_rLmbdATSCor_MAP FlMng_rLmbdETSCor_MAP FlMng_rLmbdSmk2FDC_MAP FlMng_rLmbdSmk2UpperGbxFDC_MAP FlMng_rLmbdSmk2UpperGbx_MAP FlMng_rLmbdSmk2_MAP FlMng_rLmbdSmkFDC_MAP FlMng_rLmbdSmkRgn1_MAP FlMng_rLmbdSmkRgn2_MAP FlMng_rLmbdSmkUpperGbxFDC_MAP FlMng_rLmbdSmkUpperGbx_MAP FlMng_rLmbdSmk_MAP FlMng_stGearGroupSwitch_C FlMng_stRgnMsk1_C FlMng_stRgnMsk2_C FlMng_tiAirPerCylPT1_MAP FlMng_tiDefectDead_C FlMng_tiPT1Neg_MAP FlMng_tiPT1Pos_MAP FlMng_tiRmpSlp_C FlMng_trqThresInrDes0_C FlMng_trqThresInrDes1_C FlMng_trqThresInrDes2_C FlMng_trqThresInr_C FlMng_tThresLmbdHigh_C FlMng_tThresLmbdLow_C /end DEF_CHARACTERISTIC
 /begin IN_MEASUREMENT APSCD_pVal ASMod_mAirPerCylCorr Eng_nAvrg Eng_tEng FlMng_mAirPerCylFltSmk_mp IATSCD_tAir PCR_pBGDev /end IN_MEASUREMENT
/end FUNCTION
/begin FUNCTION flmng_fullldrgl "Volllastreglung"
 /begin DEF_CHARACTERISTIC FlMng_FullLdRglIKi_CUR FlMng_qFullLdRglMax_C FlMng_qFullLdRglMin_C FlMng_FullLdRglPKp_CUR FlMng_rLmbdRecDvtMax_C FlMng_rLmbdRecDvtMin_C FlMng_dqSlpPos_C FlMng_dqSlpNeg_C FlMng_stEGTRglOff_C FlMng_swtFullLdRglVal_C FlMng_swtFullLdRglType_C FlMng_tiFullLdRglDel_CUR FlMng_trqEpsLim_C FlMng_trqEps_C /end DEF_CHARACTERISTIC
 /begin IN_MEASUREMENT Eng_nAvrg /end IN_MEASUREMENT
/end FUNCTION
/begin FUNCTION flmng_fullldrgl_msg "" /begin OUT_MEASUREMENT FlMng_qFullLdRgl FlMng_swtFullLdRgl /end OUT_MEASUREMENT /end FUNCTION
/begin FUNCTION flmng_fullldrgl_uic ""
 /begin OUT_MEASUREMENT FlMng_qFullLdRglI_mp FlMng_qFullLdRglP_mp FlMng_rLmbdRecDvt_mp FlMng_stMon_mp /end OUT_MEASUREMENT
/end FUNCTION
/begin FUNCTION flmng_fullldrgl_var "" /end FUNCTION
/begin FUNCTION flmng_fullldrgl_var_uic "" /end FUNCTION
/begin FUNCTION flmng_msg "" /begin OUT_MEASUREMENT FlMng_qLimSmk FlMng_rLmbdSet /end OUT_MEASUREMENT /end FUNCTION
/begin FUNCTION flmng_uic ""
 /begin OUT_MEASUREMENT FlMng_mAirPerCylFltSmk_mp FlMng_mAirPerCylLim_mp FlMng_qLimSmkDefect_mp FlMng_qLimSmk_mp FlMng_rLmbdAPSCor_mp FlMng_rLmbdSmk_mp FlMng_stCurrInp_mp FlMng_stDefect_mp FlMng_stGearGroup_mp FlMng_stSmkLim_mp FlMng_tiAirPerCylPT1_mp /end OUT_MEASUREMENT
/end FUNCTION
/begin FUNCTION flmng_var "" /end FUNCTION
/begin FUNCTION flmng_var_uic "" /end FUNCTION
/begin FUNCTION flsys_calccnvfac "Berechnung Umwandlungsfaktor von Einspritzmenge nach Einspritzvolumen" /begin DEF_CHARACTERISTIC FlSys_rhoFl_C FlSys_rhoFl_CUR /end DEF_CHARACTERISTIC /begin IN_MEASUREMENT FTSCD_tFuel /end IN_MEASUREMENT /end FUNCTION
/begin FUNCTION flsys_calccnvfac_msg "" /begin OUT_MEASUREMENT FlSys_rhoFl /end OUT_MEASUREMENT /end FUNCTION
/begin FUNCTION flsys_calccnvfac_uic "" /end FUNCTION
/begin FUNCTION flsys_deflate "Entlueftung des Niederdruckkreislaufs"
 /begin DEF_CHARACTERISTIC FlSys_nDeflateMax_C FlSys_nDeflateMin_C FlSys_pDeflate_C FlSys_tiDeflateDel_C /end DEF_CHARACTERISTIC
/end FUNCTION
/begin FUNCTION flsys_deflate_uic "" /begin OUT_MEASUREMENT FlSys_stDeflate_mp /end OUT_MEASUREMENT /end FUNCTION
/begin FUNCTION flsys_shofftst "Test des niederdruckseitigen Abstellpfades" /end FUNCTION
/begin FUNCTION flsys_shofftst_uic "" /end FUNCTION
/begin FUNCTION flsys_temp "Kraftstoffsystem-Temperatur"
 /begin DEF_CHARACTERISTIC FlSys_swtTempSel_C FlSys_swtTempSensCfgVal_C FlSys_swtTempSensCfgType_C FlSys_tDfl_C /end DEF_CHARACTERISTIC
/end FUNCTION
/begin FUNCTION flsys_temp_msg "" /begin OUT_MEASUREMENT FlSys_swtTempSensCfg FlSys_t /end OUT_MEASUREMENT /end FUNCTION
/begin FUNCTION flsys_temp_uic "" /begin OUT_MEASUREMENT FlSys_stTemp_mp /end OUT_MEASUREMENT /end FUNCTION
/begin FUNCTION fma_adapt "Mengenmittelwertadaption - Adaption des Einspritzmengen-Fehlermodells" /begin DEF_CHARACTERISTIC FMA_facDensCor_C /end DEF_CHARACTERISTIC /end FUNCTION
/begin FUNCTION fma_adapt_uic "" /begin OUT_MEASUREMENT FMA_qAct_mp FMA_qDev_mp /end OUT_MEASUREMENT /end FUNCTION
/begin FUNCTION fma_ctlcalc "Mengenmittelwertadaption - Berechnung des Einspritzmengenfehlers mittels adaptiver Steuerung" /begin DEF_CHARACTERISTIC FMA_swtIC_C /end DEF_CHARACTERISTIC /end FUNCTION
/begin FUNCTION fma_ctlcalc_msg "" /begin OUT_MEASUREMENT FMA_qDC FMA_qIC /end OUT_MEASUREMENT /end FUNCTION
/begin FUNCTION fma_ctlcalc_uic "" /begin OUT_MEASUREMENT FMA_qCtl_mp FMA_q_mp /end OUT_MEASUREMENT /end FUNCTION
/begin FUNCTION fma_errmod "Mengenmittelwertadaption - Algoithmen für Adaption und Auswertung des Fehlermodells für FMA_Adapt und FMA_CtlCalc"
 /begin DEF_CHARACTERISTIC FMA_facNQSwtOff_MAP FMA_IKiFst_C FMA_IKiPosFst_C FMA_IKiNegFst_C FMA_qIWinPosFst_C FMA_qIWinNegFst_C FMA_IKiSlw_C FMA_IKiPosSlw_C FMA_IKiNegSlw_C FMA_qIWinPosSlw_C FMA_qIWinNegSlw_C FMA_nGrid_C FMA_numNGrid_C FMA_numQGrid_C FMA_tiPT1Fst_C FMA_tiPT1Slw_C FMA_qGrid_C FMA_qIntMax_C FMA_qIntMin_C FMA_qMax_C FMA_qMin_C FMA_swtRst_C FMA_tiSwtPar_C /end DEF_CHARACTERISTIC
 /begin IN_MEASUREMENT Eng_nAvrg FMA_qCtl_mp /end IN_MEASUREMENT
 /begin OUT_MEASUREMENT FMA_qMapRow0_mp FMA_qMapRow1_mp FMA_qMapRow2_mp FMA_qMapRow3_mp FMA_qMapRow4_mp FMA_qMapRow5_mp FMA_qMapRow6_mp FMA_qMapRow7_mp /end OUT_MEASUREMENT
/end FUNCTION
/begin FUNCTION fma_errmod_uic ""
 /begin OUT_MEASUREMENT FMA_facNQSwtOff_mp FMA_facSwtOffTot_mp FMA_qDiff_mp FMA_qErrMod_mp FMA_qReg_mp FMA_qSetFil_mp FMA_tiFuncOp_mp /end OUT_MEASUREMENT
/end FUNCTION
/begin FUNCTION fma_monitor "Mengenmittelwertadaption - Überwachung und Abschaltung"
 /begin DEF_CHARACTERISTIC FMA_dfacSwtOffMax_C FMA_dqThrs_C FMA_drLmbdThrs_C FMA_facAirSwtOff_CUR FMA_facAPSwtOff_CUR FMA_facEngSwtOff_CUR FMA_facFlSwtOff_CUR FMA_nThrs_C FMA_qThrs_C FMA_rLmbdThrsMax_C FMA_rLmbdThrsMin_C FMA_stRgnMsk_C FMA_swtOnFMA_C FMA_tiDLmbdThrs_C FMA_tiDynThrs_C FMA_tiFaultRmp_C FMA_tiLmbdDT1_C FMA_tiLmbdThrs_C FMA_tiOvrRun_C FMA_tiQDT1_C FMA_tiQLmbd_C /end DEF_CHARACTERISTIC
 /begin IN_MEASUREMENT APSCD_pVal Eng_tEng FTSCD_tFuel IATSCD_tAir /end IN_MEASUREMENT
/end FUNCTION
/begin FUNCTION fma_monitor_msg "" /begin OUT_MEASUREMENT FMA_facSwtOff FMA_stSwtOff /end OUT_MEASUREMENT /end FUNCTION
/begin FUNCTION fma_monitor_uic ""
 /begin OUT_MEASUREMENT FMA_dqAbs_mp FMA_drLmbdAbs_mp FMA_facAirSwtOff_mp FMA_facAPSwtOff_mp FMA_facEngSwtOff_mp FMA_facFaultSwtOff_mp FMA_facFlSwtOff_mp FMA_facRgnSwtOff_mp FMA_facSlpSwtOff_mp FMA_stDynDlyd_mp FMA_stDynLmbd_mp FMA_stNoAdapt_mp FMA_stOvrRunDlyd_mp FMA_stReset_mp FMA_stRngLmbd_mp /end OUT_MEASUREMENT
/end FUNCTION
/begin FUNCTION fmtc "Masse/Momenten-Wandler"
 /begin DEF_CHARACTERISTIC FMTC_dqtrq2qBasRmpUp_C FMTC_dqtrq2qBasRmpDwn_C FMTC_eta0_C FMTC_stRgnMsk1_C FMTC_stRgnMsk2_C FMTC_tiRmpSlp_C FMTC_trq2qBasCBOpn_MAP FMTC_trq2qBas_MAP FMTC_trq2qRgn1_MAP FMTC_trq2qRgn2_MAP /end DEF_CHARACTERISTIC
 /begin IN_MEASUREMENT CoEng_trqInrSet Eng_nAvrg /end IN_MEASUREMENT
/end FUNCTION
/begin FUNCTION fmtc_calccorr "Berchnung des Wirkungsgrad Korrekturfaktors"
 /begin DEF_CHARACTERISTIC FMTC_facAirCorr_CUR FMTC_facAirCorr_MAP FMTC_facStrtInjCorr_CUR FMTC_facStrtInjCorr_MAP FMTC_mAirOpt_MAP FMTC_phiStrtInjOpt_MAP FMTC_swtCorr_C /end DEF_CHARACTERISTIC
 /begin IN_MEASUREMENT CoEng_trqInrSet Eng_nAvrg FMTC_mAirDiff_mp FMTC_phiStrtInjDiff_mp /end IN_MEASUREMENT
/end FUNCTION
/begin FUNCTION fmtc_calccorr_msg "" /begin OUT_MEASUREMENT FMTC_facEtaCor /end OUT_MEASUREMENT /end FUNCTION
/begin FUNCTION fmtc_calccorr_uic ""
 /begin OUT_MEASUREMENT FMTC_facAirCor_mp FMTC_facStrtInjCor_mp FMTC_mAirDiff_mp FMTC_mAirOpt_mp FMTC_phiStrtInjDiff_mp FMTC_phiStrtInjOpt_mp /end OUT_MEASUREMENT
/end FUNCTION
/begin FUNCTION fmtc_msg ""
 /begin OUT_MEASUREMENT FMTC_etaCurr FMTC_etaCurrStd FMTC_qCurr FMTC_qDes FMTC_qRaw FMTC_qSet FMTC_qStrt FMTC_trqInr FMTC_trqInrLimSmk /end OUT_MEASUREMENT
/end FUNCTION
/begin FUNCTION fmtc_uic ""
 /begin OUT_MEASUREMENT FMTC_qSetOptStd_mp FMTC_qSetRgn1_mp FMTC_qSetRgn2_mp FMTC_qSetStd_mp /end OUT_MEASUREMENT
/end FUNCTION
/begin COMPU_METHOD AirMassPerCyl "Luftmasse pro Zylinder" RAT_FUNC "%6.3" "mg/Hub" COEFFS 0 10 0 0 0 1 /end COMPU_METHOD
/begin COMPU_METHOD AngleCrS "Winkel Kurbelwelle" RAT_FUNC "%6.4" "deg CrS" COEFFS 0 42.6666666666667 0 0 0 1 /end COMPU_METHOD
/begin COMPU_METHOD dn_dZ20 "Motorbeschleunigung pro Zeit (dn/dt) (im 20 ms Raster)" RAT_FUNC "%6.1" "rmp/s" COEFFS 0 0.1 0 0 0 1 /end COMPU_METHOD
/begin COMPU_METHOD DtyCyc "Tastverhaeltnis" RAT_FUNC "%6.4" "%" COEFFS 0 100 0 0 0 1 /end COMPU_METHOD
/begin COMPU_METHOD Dxs "Prozentsatz fuer DXs (-100% ... 100%)" RAT_FUNC "%7.6" "%" COEFFS 0 40000 0 0 0 1 /end COMPU_METHOD
/begin COMPU_METHOD EngN "Motordrehzahl" RAT_FUNC "%6.2" "rpm" COEFFS 0 1 0 0 0 1 /end COMPU_METHOD
/begin COMPU_METHOD EngN_float "Formel fuer die Drehzahl (Fließkomma)" RAT_FUNC "%6.2" "rpm" COEFFS 0 1 0 0 0 1 /end COMPU_METHOD
/begin COMPU_METHOD Eta "Umrechnugsformel für Wirkungsgradfaktor eta" RAT_FUNC "%6.4" "Nm/(mg/cyc)" COEFFS 0 128 0 0 0 1 /end COMPU_METHOD
/begin COMPU_METHOD ETClb_Eval_Rslt "Umrechnung der Zustände der  Ansteuerdauerkalibrierungsauswertung" TAB_VERB "%6.3" "-" COMPU_TAB_REF ETClb_Eval_Rslt /end COMPU_METHOD
/begin COMPU_VTAB ETClb_Eval_Rslt "Umrechnung der Zustände der  Ansteuerdauerkalibrierungsauswertung" TAB_VERB 3 0 "ZFC_ST_CLB_CONT" 1 "ZFC_ST_CLB_END" 2 "ZFC_ST_CLB_ERR" /end COMPU_VTAB
/begin COMPU_METHOD ETClb_Eval_State "Umrechnung der Zustände der Ausgabe des Zustandsautomaten der Evaluierung der Nullmengenkalibrierung" TAB_VERB "%6.3" "-" COMPU_TAB_REF ETClb_Eval_State /end COMPU_METHOD
/begin COMPU_VTAB ETClb_Eval_State "Umrechnung der Zustände der Ausgabe des Zustandsautomaten der Evaluierung der Nullmengenkalibrierung" TAB_VERB 3 0 "ETCLB_ST_EVAL_INIT" 1 "ETCLB_ST_EVAL_ADD" 2 "ETCLB_ST_EVAL_SUB" /end COMPU_VTAB
/begin COMPU_METHOD ETClb_State "Zustand des Zusandsautmaten der Ansteuerdauerkalibrierung" TAB_VERB "%6.3" "-" COMPU_TAB_REF ETClb_State /end COMPU_METHOD
/begin COMPU_VTAB ETClb_State "Zustand des Zusandsautmaten der Ansteuerdauerkalibrierung" TAB_VERB 5 0 "ETCLB_ST_NOT_ACTV" 1 "ETCLB_ST_START_ENERGIZE" 2 "ETCLB_ST_MEASURE" 3 "ETCLB_ST_EVALUATE" 4 "ETCLB_ST_DELAY" /end COMPU_VTAB
/begin COMPU_METHOD Fact "Faktor mit Auflösung 1 / 8192, hauptsächlich für einen Faktorenbereich 0...1 verwendet" RAT_FUNC "%6.5" "-" COEFFS 0 8192 0 0 0 1 /end COMPU_METHOD
/begin COMPU_METHOD FanSpd "(MAXSINT16 / FANSPD_MAX) * phys" RAT_FUNC "%6.3" "1/min" COEFFS 0 10.9223333333333 0 0 0 1 /end COMPU_METHOD
/begin COMPU_METHOD FBC_BPfac "Umrechnungsformel für drehmomentübersetzungsabhängige Bandpassverstärkung" RAT_FUNC "%6.4" "-" COEFFS 0 546.116666666667 0 0 0 1 /end COMPU_METHOD
/begin COMPU_METHOD FBC_GvrnIKi_float "Integrationskonstante für FBC" RAT_FUNC "%6.2" "mg/((1/min^2)*s)" COEFFS 0 1 0 0 0 1 /end COMPU_METHOD
/begin COMPU_METHOD FBC_GvrnPKp_float "Proportinalitäts-Faktor für FBC" RAT_FUNC "%6.2" "mg/(1/min^2)" COEFFS 0 1 0 0 0 1 /end COMPU_METHOD
/begin COMPU_METHOD FBC_LrnState "Zustände des FBC Zustandsautomaten" TAB_VERB "%6.3" "-" COMPU_TAB_REF FBC_LrnState /end COMPU_METHOD
/begin COMPU_VTAB FBC_LrnState "Zustände des FBC Zustandsautomaten" TAB_VERB 5 1 "INIT   " 2 "DX_WAIT" 3 "LEARN  " 4 "APPLY  " 5 "DELAY  " /end COMPU_VTAB
/begin COMPU_METHOD InjMass "Einspritzmenge" RAT_FUNC "%6.4" "mg/hub" COEFFS 0 100 0 0 0 1 /end COMPU_METHOD
/begin COMPU_METHOD InjMassCyc "Einspritzmenge pro Zyklus (mg/Zyklus)" RAT_FUNC "%6.4" "mg/cyc" COEFFS 0 100 0 0 0 1 /end COMPU_METHOD
/begin COMPU_METHOD InjMassInj "Einspritzmenge pro Einspritzung (mg/Einspritzung)" RAT_FUNC "%6.4" "mg/inj" COEFFS 0 100 0 0 0 1 /end COMPU_METHOD
/begin COMPU_METHOD InjMassNSlp "Steigung der Korrektureinspritzmenge aufgrund der Drehzahlrichtung" RAT_FUNC "%7.6" "(mg/hub)/rpm" COEFFS 0 10000 0 0 0 1 /end COMPU_METHOD
/begin COMPU_METHOD InjMassQSlp "Steigung der Korrektureinspritzmenge aufgrund der Mengenrichtung" RAT_FUNC "%6.4" "-" COEFFS 0 100 0 0 0 1 /end COMPU_METHOD
/begin COMPU_METHOD InjMassSec "Einspritzmenge pro Sekunde" RAT_FUNC "%6.4" "mg/hub/s" COEFFS 0 100 0 0 0 1 /end COMPU_METHOD
/begin COMPU_METHOD InjQntInj "Einspritzmenge der einzelnen Einspritzung" RAT_FUNC "%6.4" "mm^3/inj" COEFFS 0 100 0 0 0 1 /end COMPU_METHOD
/begin COMPU_METHOD InjTime_us "Zeit in Microsekunden für das Einspritztiming" RAT_FUNC "%6.2" "us" COEFFS 0 1 0 0 0 1 /end COMPU_METHOD
/begin COMPU_METHOD Ki "Integrale Verstärkung Ki (gleiche Einheit/Umrechnungsregel an Ein- und Ausgang)" RAT_FUNC "%6.5" "1/s" COEFFS 0 4294.967296 0 0 0 1 /end COMPU_METHOD
/begin COMPU_METHOD Ki_LmbdRec2InjMass "Integrationsverstärkung (reziprokes Lambda zu Einspritzmenge)" RAT_FUNC "%6.4" "mg/stroke/s" COEFFS 0 42.94967296 0 0 0 1 /end COMPU_METHOD
/begin COMPU_METHOD Kp_LmbdRec2InjMass_1 "Proportionale Verstärkung Kp (reziprokes Lambda zu Einspritzmenge)" RAT_FUNC "%6.4" "mg/stroke" COEFFS 0 81.92 0 0 0 1 /end COMPU_METHOD
/begin COMPU_METHOD lambda "Lambda" RAT_FUNC "%6.5" "-" COEFFS 0 1000 0 0 0 1 /end COMPU_METHOD
/begin COMPU_METHOD lambdaRec "Kehrwert von Lambda" RAT_FUNC "%7.6" "-" COEFFS 0 10000 0 0 0 1 /end COMPU_METHOD
/begin COMPU_METHOD lambdaSec "Lambda Aenderungsrate" RAT_FUNC "%6.5" "-/s" COEFFS 0 1000 0 0 0 1 /end COMPU_METHOD
/begin COMPU_METHOD NumPinDia "Verbale Umrechnung für Diagnose Signale" TAB_VERB "%6.3" "-" COMPU_TAB_REF NumPinDia /end COMPU_METHOD
/begin COMPU_VTAB NumPinDia "Verbale Umrechnung für Diagnose Signale" TAB_VERB 28 0 "CJ945_Diagnostic_Signal" 1 "AC_Compressor_DiaSig" 2 "Fuel_Pump_Diagnostic_Signal_232" 3 "Starter_234" 4 "Oil_Pressure_Lamp_Switch_245" 5 "Engine_Bay_Air_Flaps_123" 6 "Ebox_Fan_Actuator_Diagnostic_Signal_219" 7 "Shuttr_Actuator_Diagnostic_Signal_231" 8 "Twostage_TurboLoading_SW_DiaSig" 9 "DIO_OUT_DIAGNOSTIC_DUMMY_NOT_USED" 10 "Alternator" 11 "Boost_Pressure_Actuator_Diagnostic_Signal_193" 12 "EGR_Actuator_Diagnostic_Signal_194" 13 "1st_Pressure_Control_Valve_Diagnostic_Signal_172" 14 "2nd_Pressure_Control_Valve_Diagnostic_Signal_172" 15 "1st_Metering_Unit_Diagnostic_Signal_171" 16 "2nd_Metering_Unit_Diagnostic_Signal_171" 17 "Variable_Swirl_Actuator_Diagnostic_Signal_195" 18 "FAN_240" 19 "Add_On_Heater_244" 20 "EngM_Bearing_Actuator_Diagnostic_Signal_124" 21 "EngM_Bearing_Actuator_Diagnostic_Signal_121" 22 "Throttle_Valve_Diagnostic_Signal_196" 23 "Low pressure stage BPA_Diagnostic_Signal_117" 24 "PWM_DIAGNOSTIC_DUMMY_NOT_USED" 25 "1st_Sensor_Supply_Voltage_DiaSig" 26 "2nd_Sensor_Supply_Voltage_DiaSig" 27 "3rd_Sensor_Supply_Voltage_DiaSig" /end COMPU_VTAB
/begin COMPU_METHOD NumPinDioIn "Verbale Umrechnung für Digitaleingang Signale" TAB_VERB "%6.3" "-" COMPU_TAB_REF NumPinDioIn /end COMPU_METHOD
/begin COMPU_VTAB NumPinDioIn "Verbale Umrechnung für Digitaleingang Signale" TAB_VERB 15 0 "Terminal_15_207" 1 "Main_Brake_Switch_236" 2 "Redundant_Brake_Switch_223" 3 "Clutch_Switch" 4 "Terminal_50_224" 5 "ECU_selection_Switch_251" 6 "FlFlt_Switch_211" 7 "Coolant-heater_212" 8 "Redundant_Terminal_15_209(118)" 9 "AC-compressor_overboost_213" 10 "Additive_tank_level_switch_235" 11 "Terminal_61_113" 12 "Lambda_Regeneration" 13 "Oil_Level_sensor_138" 14 "DIO_IN_DUMMY_NOT_USED" /end COMPU_VTAB
/begin COMPU_METHOD NumPinDioOut "Verbale Umrechnung für Digitalausgang Signale" TAB_VERB "%6.3" "-" COMPU_TAB_REF NumPinDioOut /end COMPU_METHOD
/begin COMPU_VTAB NumPinDioOut "Verbale Umrechnung für Digitalausgang Signale" TAB_VERB 11 0 "Main_Relay_220(144)" 1 "AC_Compressor" 2 "Fuel_Pump_232" 3 "Starter_234" 4 "OPS_Lamp_245" 5 "EBAF_123" 6 "Ebox_Fan_Actuator_219" 7 "Shuttr_Actuator_231" 8 "STATREG_PSOFF_Bit" 9 "Twostage_TurboLoading_120" 10 "DIO_OUT_DUMMY_NOT_USED" /end COMPU_VTAB
/begin COMPU_METHOD NumPinPwmOut "Verbale Umrechnung für PWM-Ausgang Signale" TAB_VERB "%6.3" "-" COMPU_TAB_REF NumPinPwmOut /end COMPU_METHOD
/begin COMPU_VTAB NumPinPwmOut "Verbale Umrechnung für PWM-Ausgang Signale" TAB_VERB 13 0 "Boost_Pressure_Actuator_193" 1 "EGR_Actuator_194" 2 "PCV_Actuator_172" 3 "MeUn_Actuator_171" 4 "Variable_Swirl_Actuator_195" 5 "Fan_Actuator_240" 6 "Add_On_Heater_244" 7 "EngM_Bearing_Actuator_124" 8 "EngM_Bearing_Actuator_121" 9 "Throttle_Valve_196" 10 "LSU_Heater_PWMOutput" 11 "Low pressure stage BPA_117" 12 "PWM_DUMMY_NOT_USED" /end COMPU_VTAB
/begin COMPU_METHOD OneToOne "eins zu eins (physikalischer Wert ist gleich dem internen Wert)" RAT_FUNC "%6.2" "-" COEFFS 0 1 0 0 0 1 /end COMPU_METHOD
/begin COMPU_METHOD Per_Ratio "Umwandlung fuer Bereichsgewichtung" RAT_FUNC "%6.4" "-" COEFFS 0 256 0 0 0 1 /end COMPU_METHOD
/begin COMPU_METHOD PrcPerSec "Prozentänderung pro Sekunde für 20ms-Tasks" RAT_FUNC "%6.3" "%/s" COEFFS 0 1.6384 0 0 0 1 /end COMPU_METHOD
/begin COMPU_METHOD Prc_float "Prozent Umrechnung für float" RAT_FUNC "%6.0" "%" COEFFS 0 0.01 0 0 0 1 /end COMPU_METHOD
/begin COMPU_METHOD Pres_hPa "Druck (angezeigt in [hPa])" RAT_FUNC "%6.2" "hPa" COEFFS 0 1 0 0 0 1 /end COMPU_METHOD
/begin COMPU_METHOD Pres_Rail "Raildruck in hPa" RAT_FUNC "%4.3" "bar" COEFFS 0 10.000000 0 0 0 1 /end COMPU_METHOD
/begin COMPU_METHOD Pwr "Leistung" RAT_FUNC "%6.2" "W" COEFFS 0 0.10610329539459 0 0 0 1 /end COMPU_METHOD
/begin COMPU_METHOD RhoFuel "Kraftstoffdichte" RAT_FUNC "%6.3" "kg/m^3" COEFFS 0 10 0 0 0 1 /end COMPU_METHOD
/begin COMPU_METHOD RmpInjMass "Rampengradient für Einspritzmenge" RAT_FUNC "%6.5" "(mg/stroke)/s" COEFFS 0 6553.6 0 0 0 1 /end COMPU_METHOD
/begin COMPU_METHOD RmpTrq "Rampengradient für Motormoment" RAT_FUNC "%6.4" "Nm/s" COEFFS 0 655.36 0 0 0 1 /end COMPU_METHOD
/begin COMPU_METHOD Rmp_Fact "Rampenfaktorgradient" RAT_FUNC "%8.7" "1/s" COEFFS 0 536870.912 0 0 0 1 /end COMPU_METHOD
/begin COMPU_METHOD Surge_Frq "Umrechung der Ruckelfrequenz in kritische Drehzahl für fNW=fRuck" RAT_FUNC "%6.4" "Hz" COEFFS 0 120 0 0 0 1 /end COMPU_METHOD
/begin COMPU_METHOD Temp_Cels "Temperatur dargestellt in °C (gleiche interne Darstellung wie Temp_Kelv)" RAT_FUNC "%6.1" "deg C" COEFFS 0 10 2731.4 0 0 1 /end COMPU_METHOD
/begin COMPU_METHOD TimeDeb "Entprellzeit in Millisekunden für Libraryfunktion Debounce" RAT_FUNC "%6.1" "ms" COEFFS 0 0.1 0 0 0 1 /end COMPU_METHOD
/begin COMPU_METHOD TimeDelay_s "Zeitkonstante T1 (in s) für PT1, DT1, etc." RAT_FUNC "%9.3" "s" COEFFS 0 0 1 0 0.00023283064365387 0 /end COMPU_METHOD
/begin COMPU_METHOD TimeDelay_s_2 "Zeitkonstante T1 (in s) für PT1, DT1, etc. normiert auf 16 bit" RAT_FUNC "%9.4" "s" COEFFS 0 0 1 0 0.0596046447753906 0 /end COMPU_METHOD
/begin COMPU_METHOD TimeEGTRmp "Umrechnung  Zeit in Rampensteigung,  Verwendet in EGT-Bibliothek" RAT_FUNC "%6.3" "s" COEFFS 0 0 1 0 0.0152587890625 0 /end COMPU_METHOD
/begin COMPU_METHOD Time_ms "Zeit in ms für Fehlerentprellung (DSM) und SW-Timer" RAT_FUNC "%6.1" "ms" COEFFS 0 0.1 0 0 0 1 /end COMPU_METHOD
/begin COMPU_METHOD Time_s "Zeit in s für Fehlerentprellung (DSM) und SW-Timer" RAT_FUNC "%6.4" "s" COEFFS 0 100 0 0 0 1 /end COMPU_METHOD
/begin COMPU_METHOD TransR "Übersetzungsverhältnis (Getriebe etc.)" RAT_FUNC "%6.4" "-" COEFFS 0 100 0 0 0 1 /end COMPU_METHOD
/begin COMPU_METHOD Trq "Motormoment" RAT_FUNC "%6.3" "Nm" COEFFS 0 10 0 0 0 1 /end COMPU_METHOD
/begin COMPU_METHOD Vel "Fahrzeuggeschwindigkeit, gleiche interne Auflösung wie Vel_SI" RAT_FUNC "%6.4" "km/h" COEFFS 0 100 0 0 0 1 /end COMPU_METHOD
/begin COMPU_METHOD VelToN "Verhältnis Fahrzeuggeschwindigkeit zu Motordrehzahl v/n" RAT_FUNC "%8.7" "(km/h)/rpm" COEFFS 0 100000 0 0 0 1 /end COMPU_METHOD
/begin COMPU_METHOD Volt_Batt "Batteriespannung" RAT_FUNC "%6.1" "mV" COEFFS 0 0.05115 0 0 0 1 /end COMPU_METHOD
/begin RECORD_LAYOUT Kf_Xs16_Ys16_Ws16 NO_AXIS_PTS_X 1 SWORD NO_AXIS_PTS_Y 2 SWORD AXIS_PTS_X 3 SWORD INDEX_INCR DIRECT AXIS_PTS_Y 4 SWORD INDEX_INCR DIRECT FNC_VALUES 5 SWORD COLUMN_DIR DIRECT /end RECORD_LAYOUT
/begin RECORD_LAYOUT Kl_Xs16_Ws16 NO_AXIS_PTS_X 1 SWORD AXIS_PTS_X 2 SWORD INDEX_INCR DIRECT FNC_VALUES 3 SWORD COLUMN_DIR DIRECT /end RECORD_LAYOUT
/begin RECORD_LAYOUT Kwb_Wr32 FNC_VALUES 1 FLOAT32_IEEE COLUMN_DIR DIRECT /end RECORD_LAYOUT
/begin RECORD_LAYOUT Kwb_Ws16 FNC_VALUES 1 SWORD COLUMN_DIR DIRECT /end RECORD_LAYOUT
/begin RECORD_LAYOUT Kwb_Wu16 FNC_VALUES 1 UWORD COLUMN_DIR DIRECT /end RECORD_LAYOUT
/begin RECORD_LAYOUT Kwb_Wu8 FNC_VALUES 1 UBYTE COLUMN_DIR DIRECT /end RECORD_LAYOUT
/begin RECORD_LAYOUT Kw_Wr32 FNC_VALUES 1 FLOAT32_IEEE COLUMN_DIR DIRECT /end RECORD_LAYOUT
/begin RECORD_LAYOUT Kw_Ws16 FNC_VALUES 1 SWORD COLUMN_DIR DIRECT /end RECORD_LAYOUT
/begin RECORD_LAYOUT Kw_Ws32 FNC_VALUES 1 SLONG COLUMN_DIR DIRECT /end RECORD_LAYOUT
/begin RECORD_LAYOUT Kw_Ws8 FNC_VALUES 1 SBYTE COLUMN_DIR DIRECT /end RECORD_LAYOUT
/begin RECORD_LAYOUT Kw_Wu16 FNC_VALUES 1 UWORD COLUMN_DIR DIRECT /end RECORD_LAYOUT
/begin RECORD_LAYOUT Kw_Wu32 FNC_VALUES 1 ULONG COLUMN_DIR DIRECT /end RECORD_LAYOUT
/begin RECORD_LAYOUT Kw_Wu8 FNC_VALUES 1 UBYTE COLUMN_DIR DIRECT /end RECORD_LAYOUT
/end MODULE
/end PROJECT
