ASAP2_VERSION 1 3
/begin PROJECT P411 "BMW DDE6.0 6-Zylinder V66.1 07.01.2004 CAN12H"
/begin HEADER "" VERSION "V571_6Z_CAN12H" PROJECT_NO P411 /end HEADER
/begin MODULE DIM ""
/begin MOD_COMMON "" BYTE_ORDER MSB_FIRST ALIGNMENT_BYTE 1 ALIGNMENT_WORD 2 ALIGNMENT_LONG 4 ALIGNMENT_FLOAT32_IEEE 4 /end MOD_COMMON
/begin CHARACTERISTIC DSM_RdyABForceMsk_C "Maske zur Erzwingung von Readiness durch bitweises AND mit Message DSM_stRdyAB" VALUE 0xCCB76 Kw_Wu16 65535.00 OneToOne 0.00 65535.00 FORMAT "%8.2" /end CHARACTERISTIC
/begin CHARACTERISTIC DSM_RdyCDForceMsk_C "Maske zur Erzwingung von Readiness durch bitweises AND mit Message DSM_stRdyCD" VALUE 0xCCB78 Kw_Wu16 65535.00 OneToOne 0.00 65535.00 FORMAT "%8.2" /end CHARACTERISTIC
/begin CHARACTERISTIC DSM_RdyOnMilEnable_C "Verhalten Readiness bei angesteuerter MIL" VALUE 0xCCB7A Kw_Wu8 1.00000000000 RdyOnMilEnable 0.00 1.00000000000 FORMAT "%13.11" /end CHARACTERISTIC
/begin CHARACTERISTIC DSM_TypDfp_Layer_TANS_C "Konvertierung der Fehlertypen auf der Diagnoseschnittstelle fuer Fehlerpfad Dfp_Layer_TANS" VAL_BLK 0xCC522 Kwb_Wu8 255.0 OneToOne 0.00 255.0 FORMAT "%5.1" NUMBER 4 /end CHARACTERISTIC
/begin CHARACTERISTIC DSM_TypDfp_ACCDCmpr_C "Konvertierung der Fehlertypen auf der Diagnoseschnittstelle fuer Fehlerpfad Dfp_ACCDCmpr" VAL_BLK 0xCC526 Kwb_Wu8 255.0 OneToOne 0.00 255.0 FORMAT "%5.1" NUMBER 4 /end CHARACTERISTIC
/begin CHARACTERISTIC DSM_TypDfp_ACCDPres_C "Konvertierung der Fehlertypen auf der Diagnoseschnittstelle fuer Fehlerpfad Dfp_ACCDPres" VAL_BLK 0xCC52A Kwb_Wu8 255.0 OneToOne 0.00 255.0 FORMAT "%5.1" NUMBER 4 /end CHARACTERISTIC
/begin CHARACTERISTIC DSM_TypDfp_ACCDPres1_C "Konvertierung der Fehlertypen auf der Diagnoseschnittstelle fuer Fehlerpfad Dfp_ACCDPres1" VAL_BLK 0xCC52E Kwb_Wu8 255.0 OneToOne 0.00 255.0 FORMAT "%5.1" NUMBER 4 /end CHARACTERISTIC
/begin CHARACTERISTIC DSM_TypDfp_ACCDPresAna_C "Konvertierung der Fehlertypen auf der Diagnoseschnittstelle fuer Fehlerpfad Dfp_ACCDPresAna" VAL_BLK 0xCC532 Kwb_Wu8 255.0 OneToOne 0.00 255.0 FORMAT "%5.1" NUMBER 4 /end CHARACTERISTIC
/begin CHARACTERISTIC DSM_TypDfp_ACCDSwtin_C "Konvertierung der Fehlertypen auf der Diagnoseschnittstelle fuer Fehlerpfad Dfp_ACCDSwtin" VAL_BLK 0xCC536 Kwb_Wu8 255.0 OneToOne 0.00 255.0 FORMAT "%5.1" NUMBER 4 /end CHARACTERISTIC
/begin CHARACTERISTIC DSM_TypDfp_ACC_PlausTrqDes_C "Konvertierung der Fehlertypen auf der Diagnoseschnittstelle fuer Fehlerpfad Dfp_ACC_PlausTrqDes" VAL_BLK 0xCC53A Kwb_Wu8 255.0 OneToOne 0.00 255.0 FORMAT "%5.1" NUMBER 4 /end CHARACTERISTIC
/begin CHARACTERISTIC DSM_TypDfp_ACC_trqInr_C "Konvertierung der Fehlertypen auf der Diagnoseschnittstelle fuer Fehlerpfad Dfp_ACC_trqInr" VAL_BLK 0xCC53E Kwb_Wu8 255.0 OneToOne 0.00 255.0 FORMAT "%5.1" NUMBER 4 /end CHARACTERISTIC
/begin CHARACTERISTIC DSM_TypDfp_ACTrq_C "Konvertierung der Fehlertypen auf der Diagnoseschnittstelle fuer Fehlerpfad Dfp_ACTrq" VAL_BLK 0xCC542 Kwb_Wu8 255.0 OneToOne 0.00 255.0 FORMAT "%5.1" NUMBER 4 /end CHARACTERISTIC
/begin CHARACTERISTIC DSM_TypDfp_ADCMon_C "Konvertierung der Fehlertypen auf der Diagnoseschnittstelle fuer Fehlerpfad Dfp_ADCMon" VAL_BLK 0xCC546 Kwb_Wu8 255.0 OneToOne 0.00 255.0 FORMAT "%5.1" NUMBER 4 /end CHARACTERISTIC
/begin CHARACTERISTIC DSM_TypDfp_AFSCDIdlAdjVal_C "Konvertierung der Fehlertypen auf der Diagnoseschnittstelle fuer Fehlerpfad Dfp_AFSCDIdlAdjVal" VAL_BLK 0xCC54A Kwb_Wu8 255.0 OneToOne 0.00 255.0 FORMAT "%5.1" NUMBER 4 /end CHARACTERISTIC
/begin CHARACTERISTIC DSM_TypDfp_AFSCDLdAdjVal_C "Konvertierung der Fehlertypen auf der Diagnoseschnittstelle fuer Fehlerpfad Dfp_AFSCDLdAdjVal" VAL_BLK 0xCC54E Kwb_Wu8 255.0 OneToOne 0.00 255.0 FORMAT "%5.1" NUMBER 4 /end CHARACTERISTIC
/begin CHARACTERISTIC DSM_TypDfp_AFSCD_AirTempDcyc_C "Konvertierung der Fehlertypen auf der Diagnoseschnittstelle fuer Fehlerpfad Dfp_AFSCD_AirTempDcyc" VAL_BLK 0xCC552 Kwb_Wu8 255.0 OneToOne 0.00 255.0 FORMAT "%5.1" NUMBER 4 /end CHARACTERISTIC
/begin CHARACTERISTIC DSM_TypDfp_AFSCD_PlOffsDrft_C "Konvertierung der Fehlertypen auf der Diagnoseschnittstelle fuer Fehlerpfad Dfp_AFSCD_PlOffsDrft" VAL_BLK 0xCC556 Kwb_Wu8 255.0 OneToOne 0.00 255.0 FORMAT "%5.1" NUMBER 4 /end CHARACTERISTIC
/begin CHARACTERISTIC DSM_TypDfp_AFSCD_PlSetyDrft_C "Konvertierung der Fehlertypen auf der Diagnoseschnittstelle fuer Fehlerpfad Dfp_AFSCD_PlSetyDrft" VAL_BLK 0xCC55A Kwb_Wu8 255.0 OneToOne 0.00 255.0 FORMAT "%5.1" NUMBER 4 /end CHARACTERISTIC
/begin CHARACTERISTIC DSM_TypDfp_AFSCD_SRCAirTemp_C "Konvertierung der Fehlertypen auf der Diagnoseschnittstelle fuer Fehlerpfad Dfp_AFSCD_SRCAirTemp" VAL_BLK 0xCC55E Kwb_Wu8 255.0 OneToOne 0.00 255.0 FORMAT "%5.1" NUMBER 4 /end CHARACTERISTIC
/begin CHARACTERISTIC DSM_TypDfp_AFSCD_SRCBatt_C "Konvertierung der Fehlertypen auf der Diagnoseschnittstelle fuer Fehlerpfad Dfp_AFSCD_SRCBatt" VAL_BLK 0xCC562 Kwb_Wu8 255.0 OneToOne 0.00 255.0 FORMAT "%5.1" NUMBER 4 /end CHARACTERISTIC
/begin CHARACTERISTIC DSM_TypDfp_AFSCD_SRCCorrAirm_C "Konvertierung der Fehlertypen auf der Diagnoseschnittstelle fuer Fehlerpfad Dfp_AFSCD_SRCCorrAirm" VAL_BLK 0xCC566 Kwb_Wu8 255.0 OneToOne 0.00 255.0 FORMAT "%5.1" NUMBER 4 /end CHARACTERISTIC
/begin CHARACTERISTIC DSM_TypDfp_AFSCD_SRCRawAirm_C "Konvertierung der Fehlertypen auf der Diagnoseschnittstelle fuer Fehlerpfad Dfp_AFSCD_SRCRawAirm" VAL_BLK 0xCC56A Kwb_Wu8 255.0 OneToOne 0.00 255.0 FORMAT "%5.1" NUMBER 4 /end CHARACTERISTIC
/begin CHARACTERISTIC DSM_TypDfp_Layer_TUMG_C "Konvertierung der Fehlertypen auf der Diagnoseschnittstelle fuer Fehlerpfad Dfp_Layer_TUMG" VAL_BLK 0xCC56E Kwb_Wu8 255.0 OneToOne 0.00 255.0 FORMAT "%5.1" NUMBER 4 /end CHARACTERISTIC
/begin CHARACTERISTIC DSM_TypDfp_AFSCD_SRCRefSigPer_C "Konvertierung der Fehlertypen auf der Diagnoseschnittstelle fuer Fehlerpfad Dfp_AFSCD_SRCRefSigPer" VAL_BLK 0xCC572 Kwb_Wu8 255.0 OneToOne 0.00 255.0 FORMAT "%5.1" NUMBER 4 /end CHARACTERISTIC
/begin CHARACTERISTIC DSM_TypDfp_AOHtCD_C "Konvertierung der Fehlertypen auf der Diagnoseschnittstelle fuer Fehlerpfad Dfp_AOHtCD" VAL_BLK 0xCC576 Kwb_Wu8 255.0 OneToOne 0.00 255.0 FORMAT "%5.1" NUMBER 4 /end CHARACTERISTIC
/begin CHARACTERISTIC DSM_TypDfp_Layer_GEN_C "Konvertierung der Fehlertypen auf der Diagnoseschnittstelle fuer Fehlerpfad Dfp_Layer_GEN" VAL_BLK 0xCC57A Kwb_Wu8 255.0 OneToOne 0.00 255.0 FORMAT "%5.1" NUMBER 4 /end CHARACTERISTIC
/begin CHARACTERISTIC DSM_TypDfp_Layer_BSD_C "Konvertierung der Fehlertypen auf der Diagnoseschnittstelle fuer Fehlerpfad Dfp_Layer_BSD" VAL_BLK 0xCC57E Kwb_Wu8 255.0 OneToOne 0.00 255.0 FORMAT "%5.1" NUMBER 4 /end CHARACTERISTIC
/begin CHARACTERISTIC DSM_TypDfp_AOHtCD_AOHtDia1_C "Konvertierung der Fehlertypen auf der Diagnoseschnittstelle fuer Fehlerpfad Dfp_AOHtCD_AOHtDia1" VAL_BLK 0xCC582 Kwb_Wu8 255.0 OneToOne 0.00 255.0 FORMAT "%5.1" NUMBER 4 /end CHARACTERISTIC
/begin CHARACTERISTIC DSM_TypDfp_AOHtCD_AOHtDia2_C "Konvertierung der Fehlertypen auf der Diagnoseschnittstelle fuer Fehlerpfad Dfp_AOHtCD_AOHtDia2" VAL_BLK 0xCC586 Kwb_Wu8 255.0 OneToOne 0.00 255.0 FORMAT "%5.1" NUMBER 4 /end CHARACTERISTIC
/begin CHARACTERISTIC DSM_TypDfp_AOHtCD_AOHtDia3_C "Konvertierung der Fehlertypen auf der Diagnoseschnittstelle fuer Fehlerpfad Dfp_AOHtCD_AOHtDia3" VAL_BLK 0xCC58A Kwb_Wu8 255.0 OneToOne 0.00 255.0 FORMAT "%5.1" NUMBER 4 /end CHARACTERISTIC
/begin CHARACTERISTIC DSM_TypDfp_APP1_C "Konvertierung der Fehlertypen auf der Diagnoseschnittstelle fuer Fehlerpfad Dfp_APP1" VAL_BLK 0xCC58E Kwb_Wu8 255.0 OneToOne 0.00 255.0 FORMAT "%5.1" NUMBER 4 /end CHARACTERISTIC
/begin CHARACTERISTIC DSM_TypDfp_APP2_C "Konvertierung der Fehlertypen auf der Diagnoseschnittstelle fuer Fehlerpfad Dfp_APP2" VAL_BLK 0xCC592 Kwb_Wu8 255.0 OneToOne 0.00 255.0 FORMAT "%5.1" NUMBER 4 /end CHARACTERISTIC
/begin CHARACTERISTIC DSM_TypDfp_APPSync_C "Konvertierung der Fehlertypen auf der Diagnoseschnittstelle fuer Fehlerpfad Dfp_APPSync" VAL_BLK 0xCC596 Kwb_Wu8 255.0 OneToOne 0.00 255.0 FORMAT "%5.1" NUMBER 4 /end CHARACTERISTIC
/begin CHARACTERISTIC DSM_TypDfp_APSCD_C "Konvertierung der Fehlertypen auf der Diagnoseschnittstelle fuer Fehlerpfad Dfp_APSCD" VAL_BLK 0xCC59A Kwb_Wu8 255.0 OneToOne 0.00 255.0 FORMAT "%5.1" NUMBER 4 /end CHARACTERISTIC
/begin CHARACTERISTIC DSM_TypDfp_ARS_C "Konvertierung der Fehlertypen auf der Diagnoseschnittstelle fuer Fehlerpfad Dfp_ARS" VAL_BLK 0xCC59E Kwb_Wu8 255.0 OneToOne 0.00 255.0 FORMAT "%5.1" NUMBER 4 /end CHARACTERISTIC
/begin CHARACTERISTIC DSM_TypDfp_AccPedPlausBrk_C "Konvertierung der Fehlertypen auf der Diagnoseschnittstelle fuer Fehlerpfad Dfp_AccPedPlausBrk" VAL_BLK 0xCC5A2 Kwb_Wu8 255.0 OneToOne 0.00 255.0 FORMAT "%5.1" NUMBER 4 /end CHARACTERISTIC
/begin CHARACTERISTIC DSM_TypDfp_AirCtlPlateBreak_C "DSM variable for Dfp_AirCtlPlateBreak_mp" VAL_BLK 0xCC5A6 Kwb_Wu8 255.0 OneToOne 0.00 255.0 FORMAT "%5.1" NUMBER 4 /end CHARACTERISTIC
/begin CHARACTERISTIC DSM_TypDfp_Layer_QLT_C "Konvertierung der Fehlertypen auf der Diagnoseschnittstelle fuer Fehlerpfad Dfp_Layer_QLT" VAL_BLK 0xCC5AA Kwb_Wu8 255.0 OneToOne 0.00 255.0 FORMAT "%5.1" NUMBER 4 /end CHARACTERISTIC
/begin CHARACTERISTIC DSM_TypDfp_AirCtl_GovNegDev_C "Konvertierung der Fehlertypen auf der Diagnoseschnittstelle fuer Fehlerpfad Dfp_AirCtl_GovNegDev" VAL_BLK 0xCC5AE Kwb_Wu8 255.0 OneToOne 0.00 255.0 FORMAT "%5.1" NUMBER 4 /end CHARACTERISTIC
/begin CHARACTERISTIC DSM_TypDfp_Layer_IBS1_C "Konvertierung der Fehlertypen auf der Diagnoseschnittstelle fuer Fehlerpfad Dfp_Layer_IBS1" VAL_BLK 0xCC5B2 Kwb_Wu8 255.0 OneToOne 0.00 255.0 FORMAT "%5.1" NUMBER 4 /end CHARACTERISTIC
/begin CHARACTERISTIC DSM_TypDfp_Layer_IBS2_C "Konvertierung der Fehlertypen auf der Diagnoseschnittstelle fuer Fehlerpfad Dfp_Layer_IBS2" VAL_BLK 0xCC5B6 Kwb_Wu8 255.0 OneToOne 0.00 255.0 FORMAT "%5.1" NUMBER 4 /end CHARACTERISTIC
/begin CHARACTERISTIC DSM_TypDfp_Layer_IBS3_C "Konvertierung der Fehlertypen auf der Diagnoseschnittstelle fuer Fehlerpfad Dfp_Layer_IBS3" VAL_BLK 0xCC5BA Kwb_Wu8 255.0 OneToOne 0.00 255.0 FORMAT "%5.1" NUMBER 4 /end CHARACTERISTIC
/begin CHARACTERISTIC DSM_TypDfp_Layer_PMBN_C "Konvertierung der Fehlertypen auf der Diagnoseschnittstelle fuer Fehlerpfad Dfp_Layer_PMBN" VAL_BLK 0xCC5BE Kwb_Wu8 255.0 OneToOne 0.00 255.0 FORMAT "%5.1" NUMBER 4 /end CHARACTERISTIC
/begin CHARACTERISTIC DSM_TypDfp_Layer_PMBATT_C "Konvertierung der Fehlertypen auf der Diagnoseschnittstelle fuer Fehlerpfad Dfp_Layer_PMBATT" VAL_BLK 0xCC5C2 Kwb_Wu8 255.0 OneToOne 0.00 255.0 FORMAT "%5.1" NUMBER 4 /end CHARACTERISTIC
/begin CHARACTERISTIC DSM_TypDfp_AirCtl_GovNegDev2_C "Konvertierung der Fehlertypen auf der Diagnoseschnittstelle fuer Fehlerpfad Dfp_AirCtl_GovNegDev2" VAL_BLK 0xCC5C6 Kwb_Wu8 255.0 OneToOne 0.00 255.0 FORMAT "%5.1" NUMBER 4 /end CHARACTERISTIC
/begin CHARACTERISTIC DSM_TypDfp_AirCtl_GovPosDev_C "Konvertierung der Fehlertypen auf der Diagnoseschnittstelle fuer Fehlerpfad Dfp_AirCtl_GovPosDev" VAL_BLK 0xCC5CA Kwb_Wu8 255.0 OneToOne 0.00 255.0 FORMAT "%5.1" NUMBER 4 /end CHARACTERISTIC
/begin CHARACTERISTIC DSM_TypDfp_AirCtl_GovPosDev2_C "Konvertierung der Fehlertypen auf der Diagnoseschnittstelle fuer Fehlerpfad Dfp_AirCtl_GovPosDev2" VAL_BLK 0xCC5CE Kwb_Wu8 255.0 OneToOne 0.00 255.0 FORMAT "%5.1" NUMBER 4 /end CHARACTERISTIC
/begin CHARACTERISTIC DSM_TypDfp_AltCD_C "Konvertierung der Fehlertypen auf der Diagnoseschnittstelle fuer Fehlerpfad Dfp_AltCD" VAL_BLK 0xCC5D2 Kwb_Wu8 255.0 OneToOne 0.00 255.0 FORMAT "%5.1" NUMBER 4 /end CHARACTERISTIC
/begin CHARACTERISTIC DSM_TypDfp_AltCD_Load_C "Konvertierung der Fehlertypen auf der Diagnoseschnittstelle fuer Fehlerpfad Dfp_AltCD_Load" VAL_BLK 0xCC5D6 Kwb_Wu8 255.0 OneToOne 0.00 255.0 FORMAT "%5.1" NUMBER 4 /end CHARACTERISTIC
/begin CHARACTERISTIC DSM_TypDfp_BPACD_BPADia1_C "Konvertierung der Fehlertypen auf der Diagnoseschnittstelle fuer Fehlerpfad Dfp_BPACD_BPADia1" VAL_BLK 0xCC5DA Kwb_Wu8 255.0 OneToOne 0.00 255.0 FORMAT "%5.1" NUMBER 4 /end CHARACTERISTIC
/begin CHARACTERISTIC DSM_TypDfp_BPACD_BPADia2_C "Konvertierung der Fehlertypen auf der Diagnoseschnittstelle fuer Fehlerpfad Dfp_BPACD_BPADia2" VAL_BLK 0xCC5DE Kwb_Wu8 255.0 OneToOne 0.00 255.0 FORMAT "%5.1" NUMBER 4 /end CHARACTERISTIC
/begin CHARACTERISTIC DSM_TypDfp_BPACD_BPADia3_C "Konvertierung der Fehlertypen auf der Diagnoseschnittstelle fuer Fehlerpfad Dfp_BPACD_BPADia3" VAL_BLK 0xCC5E2 Kwb_Wu8 255.0 OneToOne 0.00 255.0 FORMAT "%5.1" NUMBER 4 /end CHARACTERISTIC
/begin CHARACTERISTIC DSM_TypDfp_BPACD_Max_C "Konvertierung der Fehlertypen auf der Diagnoseschnittstelle fuer Fehlerpfad Dfp_BPACD_Max" VAL_BLK 0xCC5E6 Kwb_Wu8 255.0 OneToOne 0.00 255.0 FORMAT "%5.1" NUMBER 4 /end CHARACTERISTIC
/begin CHARACTERISTIC DSM_TypDfp_BPACD_Min_C "Konvertierung der Fehlertypen auf der Diagnoseschnittstelle fuer Fehlerpfad Dfp_BPACD_Min" VAL_BLK 0xCC5EA Kwb_Wu8 255.0 OneToOne 0.00 255.0 FORMAT "%5.1" NUMBER 4 /end CHARACTERISTIC
/begin CHARACTERISTIC DSM_TypDfp_BPACD_SigNpl_C "Konvertierung der Fehlertypen auf der Diagnoseschnittstelle fuer Fehlerpfad Dfp_BPACD_SigNpl" VAL_BLK 0xCC5EE Kwb_Wu8 255.0 OneToOne 0.00 255.0 FORMAT "%5.1" NUMBER 4 /end CHARACTERISTIC
/begin CHARACTERISTIC DSM_TypDfp_BPSCD_C "Konvertierung der Fehlertypen auf der Diagnoseschnittstelle fuer Fehlerpfad Dfp_BPSCD" VAL_BLK 0xCC5F2 Kwb_Wu8 255.0 OneToOne 0.00 255.0 FORMAT "%5.1" NUMBER 4 /end CHARACTERISTIC
/begin CHARACTERISTIC DSM_TypDfp_BattCD_C "Konvertierung der Fehlertypen auf der Diagnoseschnittstelle fuer Fehlerpfad Dfp_BattCD" VAL_BLK 0xCC5F6 Kwb_Wu8 255.0 OneToOne 0.00 255.0 FORMAT "%5.1" NUMBER 4 /end CHARACTERISTIC
/begin CHARACTERISTIC DSM_TypDfp_BrkCD_C "Konvertierung der Fehlertypen auf der Diagnoseschnittstelle fuer Fehlerpfad Dfp_BrkCD" VAL_BLK 0xCC5FA Kwb_Wu8 255.0 OneToOne 0.00 255.0 FORMAT "%5.1" NUMBER 4 /end CHARACTERISTIC
/begin CHARACTERISTIC DSM_TypDfp_Bss_C "Konvertierung der Fehlertypen auf der Diagnoseschnittstelle fuer Fehlerpfad Dfp_Bss" VAL_BLK 0xCC5FE Kwb_Wu8 255.0 OneToOne 0.00 255.0 FORMAT "%5.1" NUMBER 4 /end CHARACTERISTIC
/begin CHARACTERISTIC DSM_TypDfp_CBACD_C "Konvertierung der Fehlertypen auf der Diagnoseschnittstelle fuer Fehlerpfad Dfp_CBACD" VAL_BLK 0xCC602 Kwb_Wu8 255.0 OneToOne 0.00 255.0 FORMAT "%5.1" NUMBER 4 /end CHARACTERISTIC
/begin CHARACTERISTIC DSM_TypDfp_CTSCD_C "Konvertierung der Fehlertypen auf der Diagnoseschnittstelle fuer Fehlerpfad Dfp_CTSCD" VAL_BLK 0xCC606 Kwb_Wu8 255.0 OneToOne 0.00 255.0 FORMAT "%5.1" NUMBER 4 /end CHARACTERISTIC
/begin CHARACTERISTIC DSM_TypDfp_Clg_DynTst_C "Konvertierung der Fehlertypen auf der Diagnoseschnittstelle fuer Fehlerpfad Dfp_Clg_DynTst" VAL_BLK 0xCC60A Kwb_Wu8 255.0 OneToOne 0.00 255.0 FORMAT "%5.1" NUMBER 4 /end CHARACTERISTIC
/begin CHARACTERISTIC DSM_TypDfp_CmbChbMisfire1_C "Konvertierung der Fehlertypen auf der Diagnoseschnittstelle fuer Fehlerpfad Dfp_CmbChbMisfire1" VAL_BLK 0xCC60E Kwb_Wu8 255.0 OneToOne 0.00 255.0 FORMAT "%5.1" NUMBER 4 /end CHARACTERISTIC
/begin CHARACTERISTIC DSM_TypDfp_CmbChbMisfire2_C "Konvertierung der Fehlertypen auf der Diagnoseschnittstelle fuer Fehlerpfad Dfp_CmbChbMisfire2" VAL_BLK 0xCC612 Kwb_Wu8 255.0 OneToOne 0.00 255.0 FORMAT "%5.1" NUMBER 4 /end CHARACTERISTIC
/begin CHARACTERISTIC DSM_TypDfp_CmbChbMisfire3_C "Konvertierung der Fehlertypen auf der Diagnoseschnittstelle fuer Fehlerpfad Dfp_CmbChbMisfire3" VAL_BLK 0xCC616 Kwb_Wu8 255.0 OneToOne 0.00 255.0 FORMAT "%5.1" NUMBER 4 /end CHARACTERISTIC
/begin CHARACTERISTIC DSM_TypDfp_CmbChbMisfire4_C "Konvertierung der Fehlertypen auf der Diagnoseschnittstelle fuer Fehlerpfad Dfp_CmbChbMisfire4" VAL_BLK 0xCC61A Kwb_Wu8 255.0 OneToOne 0.00 255.0 FORMAT "%5.1" NUMBER 4 /end CHARACTERISTIC
/begin CHARACTERISTIC DSM_TypDfp_CmbChbMisfire5_C "Konvertierung der Fehlertypen auf der Diagnoseschnittstelle fuer Fehlerpfad Dfp_CmbChbMisfire5" VAL_BLK 0xCC61E Kwb_Wu8 255.0 OneToOne 0.00 255.0 FORMAT "%5.1" NUMBER 4 /end CHARACTERISTIC
/begin CHARACTERISTIC DSM_TypDfp_CmbChbMisfire6_C "Konvertierung der Fehlertypen auf der Diagnoseschnittstelle fuer Fehlerpfad Dfp_CmbChbMisfire6" VAL_BLK 0xCC622 Kwb_Wu8 255.0 OneToOne 0.00 255.0 FORMAT "%5.1" NUMBER 4 /end CHARACTERISTIC
/begin CHARACTERISTIC DSM_TypDfp_CmbChbMisfireMul_C "Konvertierung der Fehlertypen auf der Diagnoseschnittstelle fuer Fehlerpfad Dfp_CmbChbMisfireMul" VAL_BLK 0xCC626 Kwb_Wu8 255.0 OneToOne 0.00 255.0 FORMAT "%5.1" NUMBER 4 /end CHARACTERISTIC
/begin CHARACTERISTIC DSM_TypDfp_CoVMDCSh_C "Konvertierung der Fehlertypen auf der Diagnoseschnittstelle fuer Fehlerpfad Dfp_CoVMDCSh" VAL_BLK 0xCC62A Kwb_Wu8 255.0 OneToOne 0.00 255.0 FORMAT "%5.1" NUMBER 4 /end CHARACTERISTIC
/begin CHARACTERISTIC DSM_TypDfp_ConvCD_C "Konvertierung der Fehlertypen auf der Diagnoseschnittstelle fuer Fehlerpfad Dfp_ConvCD" VAL_BLK 0xCC62E Kwb_Wu8 255.0 OneToOne 0.00 255.0 FORMAT "%5.1" NUMBER 4 /end CHARACTERISTIC
/begin CHARACTERISTIC DSM_TypDfp_CrCCDMFL_C "Konvertierung der Fehlertypen auf der Diagnoseschnittstelle fuer Fehlerpfad Dfp_CrCCDMFL" VAL_BLK 0xCC632 Kwb_Wu8 255.0 OneToOne 0.00 255.0 FORMAT "%5.1" NUMBER 4 /end CHARACTERISTIC
/begin CHARACTERISTIC DSM_TypDfp_CrCtl_vCrCtl_C "Konvertierung der Fehlertypen auf der Diagnoseschnittstelle fuer Fehlerpfad Dfp_CrCtl_vCrCtl" VAL_BLK 0xCC636 Kwb_Wu8 255.0 OneToOne 0.00 255.0 FORMAT "%5.1" NUMBER 4 /end CHARACTERISTIC
/begin CHARACTERISTIC DSM_TypDfp_Dummy1_C "Konvertierung der Fehlertypen auf der Diagnoseschnittstelle fuer Fehlerpfad Dfp_Dummy1" VAL_BLK 0xCC63A Kwb_Wu8 255.0 OneToOne 0.00 255.0 FORMAT "%5.1" NUMBER 4 /end CHARACTERISTIC
/begin CHARACTERISTIC DSM_TypDfp_EATSCD_C "Konvertierung der Fehlertypen auf der Diagnoseschnittstelle fuer Fehlerpfad Dfp_EATSCD" VAL_BLK 0xCC63E Kwb_Wu8 255.0 OneToOne 0.00 255.0 FORMAT "%5.1" NUMBER 4 /end CHARACTERISTIC
/begin CHARACTERISTIC DSM_TypDfp_EBAFCD_C "Konvertierung der Fehlertypen auf der Diagnoseschnittstelle fuer Fehlerpfad Dfp_EBAFCD" VAL_BLK 0xCC642 Kwb_Wu8 255.0 OneToOne 0.00 255.0 FORMAT "%5.1" NUMBER 4 /end CHARACTERISTIC
/begin CHARACTERISTIC DSM_TypDfp_Layer_PMRUHVERL_C "Konvertierung der Fehlertypen auf der Diagnoseschnittstelle fuer Fehlerpfad Dfp_Layer_PMRUHVERL" VAL_BLK 0xCC646 Kwb_Wu8 255.0 OneToOne 0.00 255.0 FORMAT "%5.1" NUMBER 4 /end CHARACTERISTIC
/begin CHARACTERISTIC DSM_TypDfp_EBFCD_C "Konvertierung der Fehlertypen auf der Diagnoseschnittstelle fuer Fehlerpfad Dfp_EBFCD" VAL_BLK 0xCC64A Kwb_Wu8 255.0 OneToOne 0.00 255.0 FORMAT "%5.1" NUMBER 4 /end CHARACTERISTIC
/begin CHARACTERISTIC DSM_TypDfp_EBTSCD_C "Konvertierung der Fehlertypen auf der Diagnoseschnittstelle fuer Fehlerpfad Dfp_EBTSCD" VAL_BLK 0xCC64E Kwb_Wu8 255.0 OneToOne 0.00 255.0 FORMAT "%5.1" NUMBER 4 /end CHARACTERISTIC
/begin CHARACTERISTIC DSM_TypDfp_EBTSCD_OvrTemp_C "Konvertierung der Fehlertypen auf der Diagnoseschnittstelle fuer Fehlerpfad Dfp_EBTSCD_OvrTemp" VAL_BLK 0xCC652 Kwb_Wu8 255.0 OneToOne 0.00 255.0 FORMAT "%5.1" NUMBER 4 /end CHARACTERISTIC
/begin CHARACTERISTIC DSM_TypDfp_EEPCDVarMng_C "Konvertierung der Fehlertypen auf der Diagnoseschnittstelle fuer Fehlerpfad Dfp_EEPCDVarMng" VAL_BLK 0xCC656 Kwb_Wu8 255.0 OneToOne 0.00 255.0 FORMAT "%5.1" NUMBER 4 /end CHARACTERISTIC
/begin CHARACTERISTIC DSM_TypDfp_Layer_TOENS_C "Konvertierung der Fehlertypen auf der Diagnoseschnittstelle fuer Fehlerpfad Dfp_Layer_TOENS" VAL_BLK 0xCC65A Kwb_Wu8 255.0 OneToOne 0.00 255.0 FORMAT "%5.1" NUMBER 4 /end CHARACTERISTIC
/begin CHARACTERISTIC DSM_TypDfp_Layer_MANHYDR_C "Konvertierung der Fehlertypen auf der Diagnoseschnittstelle fuer Fehlerpfad Dfp_Layer_MANHYDR" VAL_BLK 0xCC65E Kwb_Wu8 255.0 OneToOne 0.00 255.0 FORMAT "%5.1" NUMBER 4 /end CHARACTERISTIC
/begin CHARACTERISTIC DSM_TypDfp_Layer_MANLUFT_C "Konvertierung der Fehlertypen auf der Diagnoseschnittstelle fuer Fehlerpfad Dfp_Layer_MANLUFT" VAL_BLK 0xCC662 Kwb_Wu8 255.0 OneToOne 0.00 255.0 FORMAT "%5.1" NUMBER 4 /end CHARACTERISTIC
/begin CHARACTERISTIC DSM_TypDfp_EGPpCD_C "Konvertierung der Fehlertypen auf der Diagnoseschnittstelle fuer Fehlerpfad Dfp_EGPpCD" VAL_BLK 0xCC666 Kwb_Wu8 255.0 OneToOne 0.00 255.0 FORMAT "%5.1" NUMBER 4 /end CHARACTERISTIC
/begin CHARACTERISTIC DSM_TypDfp_EGPpCDTPreTrbn_C "Konvertierung der Fehlertypen auf der Diagnoseschnittstelle fuer Fehlerpfad Dfp_EgPpCDTPreTrbn" VAL_BLK 0xCC66A Kwb_Wu8 255.0 OneToOne 0.00 255.0 FORMAT "%5.1" NUMBER 4 /end CHARACTERISTIC
/begin CHARACTERISTIC DSM_TypDfp_EGRCD_Max_C "Konvertierung der Fehlertypen auf der Diagnoseschnittstelle fuer Fehlerpfad Dfp_EGRCD_Max" VAL_BLK 0xCC66E Kwb_Wu8 255.0 OneToOne 0.00 255.0 FORMAT "%5.1" NUMBER 4 /end CHARACTERISTIC
/begin CHARACTERISTIC DSM_TypDfp_EGRCD_Min_C "Konvertierung der Fehlertypen auf der Diagnoseschnittstelle fuer Fehlerpfad Dfp_EGRCD_Min" VAL_BLK 0xCC672 Kwb_Wu8 255.0 OneToOne 0.00 255.0 FORMAT "%5.1" NUMBER 4 /end CHARACTERISTIC
/begin CHARACTERISTIC DSM_TypDfp_EGRCD_SigNpl_C "Konvertierung der Fehlertypen auf der Diagnoseschnittstelle fuer Fehlerpfad Dfp_EGRCD_SigNpl" VAL_BLK 0xCC676 Kwb_Wu8 255.0 OneToOne 0.00 255.0 FORMAT "%5.1" NUMBER 4 /end CHARACTERISTIC
/begin CHARACTERISTIC DSM_TypDfp_EGTRgnOilDil_C "Konvertierung der Fehlertypen auf der Diagnoseschnittstelle fuer Fehlerpfad Dfp_EGTRgnOilDil" VAL_BLK 0xCC67A Kwb_Wu8 255.0 OneToOne 0.00 255.0 FORMAT "%5.1" NUMBER 4 /end CHARACTERISTIC
/begin CHARACTERISTIC DSM_TypDfp_EMCCDNoLoad1_C "" VAL_BLK 0xCC67E Kwb_Wu8 255.0 OneToOne 0.00 255.0 FORMAT "%5.1" NUMBER 4 /end CHARACTERISTIC
/begin CHARACTERISTIC DSM_TypDfp_EMCCDNoLoad2_C "" VAL_BLK 0xCC682 Kwb_Wu8 255.0 OneToOne 0.00 255.0 FORMAT "%5.1" NUMBER 4 /end CHARACTERISTIC
/begin CHARACTERISTIC DSM_TypDfp_EMCCDSCBat1_C "" VAL_BLK 0xCC686 Kwb_Wu8 255.0 OneToOne 0.00 255.0 FORMAT "%5.1" NUMBER 4 /end CHARACTERISTIC
/begin CHARACTERISTIC DSM_TypDfp_EMCCDSCBat2_C "" VAL_BLK 0xCC68A Kwb_Wu8 255.0 OneToOne 0.00 255.0 FORMAT "%5.1" NUMBER 4 /end CHARACTERISTIC
/begin CHARACTERISTIC DSM_TypDfp_EMCCDSCGnd1_C "" VAL_BLK 0xCC68E Kwb_Wu8 255.0 OneToOne 0.00 255.0 FORMAT "%5.1" NUMBER 4 /end CHARACTERISTIC
/begin CHARACTERISTIC DSM_TypDfp_EMCCDSCGnd2_C "" VAL_BLK 0xCC692 Kwb_Wu8 255.0 OneToOne 0.00 255.0 FORMAT "%5.1" NUMBER 4 /end CHARACTERISTIC
/begin CHARACTERISTIC DSM_TypDfp_EMCCD_ADC1_C "" VAL_BLK 0xCC696 Kwb_Wu8 255.0 OneToOne 0.00 255.0 FORMAT "%5.1" NUMBER 4 /end CHARACTERISTIC
/begin CHARACTERISTIC DSM_TypDfp_EMCCD_ADC2_C "" VAL_BLK 0xCC69A Kwb_Wu8 255.0 OneToOne 0.00 255.0 FORMAT "%5.1" NUMBER 4 /end CHARACTERISTIC
/begin CHARACTERISTIC DSM_TypDfp_ETClbETFltInj1_C "Konvertierung der Fehlertypen auf der Diagnoseschnittstelle fuer Fehlerpfad Dfp_ETClbETFltInj1" VAL_BLK 0xCC69E Kwb_Wu8 255.0 OneToOne 0.00 255.0 FORMAT "%5.1" NUMBER 4 /end CHARACTERISTIC
/begin CHARACTERISTIC DSM_TypDfp_ETClbETFltInj2_C "Konvertierung der Fehlertypen auf der Diagnoseschnittstelle fuer Fehlerpfad Dfp_ETClbETFltInj2" VAL_BLK 0xCC6A2 Kwb_Wu8 255.0 OneToOne 0.00 255.0 FORMAT "%5.1" NUMBER 4 /end CHARACTERISTIC
/begin CHARACTERISTIC DSM_TypDfp_ETClbETFltInj3_C "Konvertierung der Fehlertypen auf der Diagnoseschnittstelle fuer Fehlerpfad Dfp_ETClbETFltInj3" VAL_BLK 0xCC6A6 Kwb_Wu8 255.0 OneToOne 0.00 255.0 FORMAT "%5.1" NUMBER 4 /end CHARACTERISTIC
/begin CHARACTERISTIC DSM_TypDfp_ETClbETFltInj4_C "Konvertierung der Fehlertypen auf der Diagnoseschnittstelle fuer Fehlerpfad Dfp_ETClbETFltInj4" VAL_BLK 0xCC6AA Kwb_Wu8 255.0 OneToOne 0.00 255.0 FORMAT "%5.1" NUMBER 4 /end CHARACTERISTIC
/begin CHARACTERISTIC DSM_TypDfp_ETClbETFltInj5_C "Konvertierung der Fehlertypen auf der Diagnoseschnittstelle fuer Fehlerpfad Dfp_ETClbETFltInj5" VAL_BLK 0xCC6AE Kwb_Wu8 255.0 OneToOne 0.00 255.0 FORMAT "%5.1" NUMBER 4 /end CHARACTERISTIC
/begin CHARACTERISTIC DSM_TypDfp_ETClbETFltInj6_C "Konvertierung der Fehlertypen auf der Diagnoseschnittstelle fuer Fehlerpfad Dfp_ETClbETFltInj6" VAL_BLK 0xCC6B2 Kwb_Wu8 255.0 OneToOne 0.00 255.0 FORMAT "%5.1" NUMBER 4 /end CHARACTERISTIC
/begin CHARACTERISTIC DSM_TypDfp_ETClbInj1_C "Konvertierung der Fehlertypen auf der Diagnoseschnittstelle fuer Fehlerpfad Dfp_ETClbInj1" VAL_BLK 0xCC6B6 Kwb_Wu8 255.0 OneToOne 0.00 255.0 FORMAT "%5.1" NUMBER 4 /end CHARACTERISTIC
/begin CHARACTERISTIC DSM_TypDfp_ETClbInj2_C "Konvertierung der Fehlertypen auf der Diagnoseschnittstelle fuer Fehlerpfad Dfp_ETClbInj2" VAL_BLK 0xCC6BA Kwb_Wu8 255.0 OneToOne 0.00 255.0 FORMAT "%5.1" NUMBER 4 /end CHARACTERISTIC
/begin CHARACTERISTIC DSM_TypDfp_ETClbInj3_C "Konvertierung der Fehlertypen auf der Diagnoseschnittstelle fuer Fehlerpfad Dfp_ETClbInj3" VAL_BLK 0xCC6BE Kwb_Wu8 255.0 OneToOne 0.00 255.0 FORMAT "%5.1" NUMBER 4 /end CHARACTERISTIC
/begin CHARACTERISTIC DSM_TypDfp_ETClbInj4_C "Konvertierung der Fehlertypen auf der Diagnoseschnittstelle fuer Fehlerpfad Dfp_ETClbInj4" VAL_BLK 0xCC6C2 Kwb_Wu8 255.0 OneToOne 0.00 255.0 FORMAT "%5.1" NUMBER 4 /end CHARACTERISTIC
/begin CHARACTERISTIC DSM_TypDfp_ETClbInj5_C "Konvertierung der Fehlertypen auf der Diagnoseschnittstelle fuer Fehlerpfad Dfp_ETClbInj5" VAL_BLK 0xCC6C6 Kwb_Wu8 255.0 OneToOne 0.00 255.0 FORMAT "%5.1" NUMBER 4 /end CHARACTERISTIC
/begin CHARACTERISTIC DSM_TypDfp_ETClbInj6_C "Konvertierung der Fehlertypen auf der Diagnoseschnittstelle fuer Fehlerpfad Dfp_ETClbInj6" VAL_BLK 0xCC6CA Kwb_Wu8 255.0 OneToOne 0.00 255.0 FORMAT "%5.1" NUMBER 4 /end CHARACTERISTIC
/begin CHARACTERISTIC DSM_TypDfp_EngMCaS1_C "Konvertierung der Fehlertypen auf der Diagnoseschnittstelle fuer Fehlerpfad Dfp_EngMCaS1" VAL_BLK 0xCC6CE Kwb_Wu8 255.0 OneToOne 0.00 255.0 FORMAT "%5.1" NUMBER 4 /end CHARACTERISTIC
/begin CHARACTERISTIC DSM_TypDfp_EngMCrS1_C "Konvertierung der Fehlertypen auf der Diagnoseschnittstelle fuer Fehlerpfad Dfp_EngMCrS1" VAL_BLK 0xCC6D2 Kwb_Wu8 255.0 OneToOne 0.00 255.0 FORMAT "%5.1" NUMBER 4 /end CHARACTERISTIC
/begin CHARACTERISTIC DSM_TypDfp_EngMOfsCaSCrS_C "Konvertierung der Fehlertypen auf der Diagnoseschnittstelle fuer Fehlerpfad Dfp_EngMOfsCaSCrS" VAL_BLK 0xCC6D6 Kwb_Wu8 255.0 OneToOne 0.00 255.0 FORMAT "%5.1" NUMBER 4 /end CHARACTERISTIC
/begin CHARACTERISTIC DSM_TypDfp_EngPrtFWODet_C "Konvertierung der Fehlertypen auf der Diagnoseschnittstelle fuer Fehlerpfad Dfp_EngPrtFWODet" VAL_BLK 0xCC6DA Kwb_Wu8 255.0 OneToOne 0.00 255.0 FORMAT "%5.1" NUMBER 4 /end CHARACTERISTIC
/begin CHARACTERISTIC DSM_TypDfp_FBCqDvt_C "Konvertierung der Fehlertypen auf der Diagnoseschnittstelle fuer Fehlerpfad Dfp_FBCqDvt" VAL_BLK 0xCC6DE Kwb_Wu8 255.0 OneToOne 0.00 255.0 FORMAT "%5.1" NUMBER 4 /end CHARACTERISTIC
/begin CHARACTERISTIC DSM_TypDfp_FMTC_NonMonotonMap_C "Konvertierung der Fehlertypen auf der Diagnoseschnittstelle fuer Fehlerpfad Dfp_FMTC_NonMonotonMap" VAL_BLK 0xCC6E2 Kwb_Wu8 255.0 OneToOne 0.00 255.0 FORMAT "%5.1" NUMBER 4 /end CHARACTERISTIC
/begin CHARACTERISTIC DSM_TypDfp_FTSCD_C "Konvertierung der Fehlertypen auf der Diagnoseschnittstelle fuer Fehlerpfad Dfp_FTSCD" VAL_BLK 0xCC6E6 Kwb_Wu8 255.0 OneToOne 0.00 255.0 FORMAT "%5.1" NUMBER 4 /end CHARACTERISTIC
/begin CHARACTERISTIC DSM_TypDfp_FanCD_C "Konvertierung der Fehlertypen auf der Diagnoseschnittstelle fuer Fehlerpfad Dfp_FanCD" VAL_BLK 0xCC6EA Kwb_Wu8 255.0 OneToOne 0.00 255.0 FORMAT "%5.1" NUMBER 4 /end CHARACTERISTIC
/begin CHARACTERISTIC DSM_TypDfp_FanCD_FanCtlr1_C "Konvertierung der Fehlertypen auf der Diagnoseschnittstelle fuer Fehlerpfad Dfp_FanCD_FanCtlr1" VAL_BLK 0xCC6EE Kwb_Wu8 255.0 OneToOne 0.00 255.0 FORMAT "%5.1" NUMBER 4 /end CHARACTERISTIC
/begin CHARACTERISTIC DSM_TypDfp_FanCD_FanCtlr2_C "Konvertierung der Fehlertypen auf der Diagnoseschnittstelle fuer Fehlerpfad Dfp_FanCD_FanCtlr2" VAL_BLK 0xCC6F2 Kwb_Wu8 255.0 OneToOne 0.00 255.0 FORMAT "%5.1" NUMBER 4 /end CHARACTERISTIC
/begin CHARACTERISTIC DSM_TypDfp_FanCD_FanCtlr3_C "Konvertierung der Fehlertypen auf der Diagnoseschnittstelle fuer Fehlerpfad Dfp_FanCD_FanCtlr3" VAL_BLK 0xCC6F6 Kwb_Wu8 255.0 OneToOne 0.00 255.0 FORMAT "%5.1" NUMBER 4 /end CHARACTERISTIC
/begin CHARACTERISTIC DSM_TypDfp_FlFCD_C "Konvertierung der Fehlertypen auf der Diagnoseschnittstelle fuer Fehlerpfad Dfp_FlFCD" VAL_BLK 0xCC6FA Kwb_Wu8 255.0 OneToOne 0.00 255.0 FORMAT "%5.1" NUMBER 4 /end CHARACTERISTIC
/begin CHARACTERISTIC DSM_TypDfp_FlMngSmkDefect_C "Konvertierung der Fehlertypen auf der Diagnoseschnittstelle fuer Fehlerpfad Dfp_FlMngSmkDefect" VAL_BLK 0xCC6FE Kwb_Wu8 255.0 OneToOne 0.00 255.0 FORMAT "%5.1" NUMBER 4 /end CHARACTERISTIC
/begin CHARACTERISTIC DSM_TypDfp_FrmMngASC1_C "Konvertierung der Fehlertypen auf der Diagnoseschnittstelle fuer Fehlerpfad Dfp_FrmMngASC1" VAL_BLK 0xCC702 Kwb_Wu8 255.0 OneToOne 0.00 255.0 FORMAT "%5.1" NUMBER 4 /end CHARACTERISTIC
/begin CHARACTERISTIC DSM_TypDfp_FrmMngASC2_C "Konvertierung der Fehlertypen auf der Diagnoseschnittstelle fuer Fehlerpfad Dfp_FrmMngASC2" VAL_BLK 0xCC706 Kwb_Wu8 255.0 OneToOne 0.00 255.0 FORMAT "%5.1" NUMBER 4 /end CHARACTERISTIC
/begin CHARACTERISTIC DSM_TypDfp_FrmMngASC3_C "Konvertierung der Fehlertypen auf der Diagnoseschnittstelle fuer Fehlerpfad Dfp_FrmMngASC3" VAL_BLK 0xCC70A Kwb_Wu8 255.0 OneToOne 0.00 255.0 FORMAT "%5.1" NUMBER 4 /end CHARACTERISTIC
/begin CHARACTERISTIC DSM_TypDfp_FrmMngASC4_C "Konvertierung der Fehlertypen auf der Diagnoseschnittstelle fuer Fehlerpfad Dfp_FrmMngASC4" VAL_BLK 0xCC70E Kwb_Wu8 255.0 OneToOne 0.00 255.0 FORMAT "%5.1" NUMBER 4 /end CHARACTERISTIC
/begin CHARACTERISTIC DSM_TypDfp_FrmMngBOS_RESET_C "Konvertierung der Fehlertypen auf der Diagnoseschnittstelle fuer Fehlerpfad Dfp_FrmMngBOS_RESET" VAL_BLK 0xCC712 Kwb_Wu8 255.0 OneToOne 0.00 255.0 FORMAT "%5.1" NUMBER 4 /end CHARACTERISTIC
/begin CHARACTERISTIC DSM_TypDfp_FrmMngBOS_RESET_2_C "" VAL_BLK 0xCC716 Kwb_Wu8 255.0 OneToOne 0.00 255.0 FORMAT "%5.1" NUMBER 4 /end CHARACTERISTIC
/begin CHARACTERISTIC DSM_TypDfp_FrmMngDMANFAFS_C "Konvertierung der Fehlertypen auf der Diagnoseschnittstelle fuer Fehlerpfad Dfp_FrmMngDMANFAFS" VAL_BLK 0xCC71A Kwb_Wu8 255.0 OneToOne 0.00 255.0 FORMAT "%5.1" NUMBER 4 /end CHARACTERISTIC
/begin CHARACTERISTIC DSM_TypDfp_FrmMngDRMANFSSG_C "Konvertierung der Fehlertypen auf der Diagnoseschnittstelle fuer Fehlerpfad Dfp_FrmMngDRMANFSSG" VAL_BLK 0xCC71E Kwb_Wu8 255.0 OneToOne 0.00 255.0 FORMAT "%5.1" NUMBER 4 /end CHARACTERISTIC
/begin CHARACTERISTIC DSM_TypDfp_FrmMngEGS1_C "Konvertierung der Fehlertypen auf der Diagnoseschnittstelle fuer Fehlerpfad Dfp_FrmMngEGS1" VAL_BLK 0xCC722 Kwb_Wu8 255.0 OneToOne 0.00 255.0 FORMAT "%5.1" NUMBER 4 /end CHARACTERISTIC
/begin CHARACTERISTIC DSM_TypDfp_FrmMngEGS2_C "Konvertierung der Fehlertypen auf der Diagnoseschnittstelle fuer Fehlerpfad Dfp_FrmMngEGS2" VAL_BLK 0xCC726 Kwb_Wu8 255.0 OneToOne 0.00 255.0 FORMAT "%5.1" NUMBER 4 /end CHARACTERISTIC
/begin CHARACTERISTIC DSM_TypDfp_FrmMngGEARBX_DATA_C "type for faults in path" VAL_BLK 0xCC72A Kwb_Wu8 255.0 OneToOne 0.00 255.0 FORMAT "%5.1" NUMBER 4 /end CHARACTERISTIC
/begin CHARACTERISTIC DSM_TypDfp_FrmMngGEARBX_DATA2_C "Konvertierung der Fehlertypen auf der Diagnoseschnittstelle fuer Fehlerpfad Dfp_FrmMngGEARBX_DATA2" VAL_BLK 0xCC72E Kwb_Wu8 255.0 OneToOne 0.00 255.0 FORMAT "%5.1" NUMBER 4 /end CHARACTERISTIC
/begin CHARACTERISTIC DSM_TypDfp_FrmMngHEAT_AC_C "type for faults in path" VAL_BLK 0xCC732 Kwb_Wu8 255.0 OneToOne 0.00 255.0 FORMAT "%5.1" NUMBER 4 /end CHARACTERISTIC
/begin CHARACTERISTIC DSM_TypDfp_FrmMngINSTR2_C "Konvertierung der Fehlertypen auf der Diagnoseschnittstelle fuer Fehlerpfad Dfp_FrmMngINSTR2" VAL_BLK 0xCC736 Kwb_Wu8 255.0 OneToOne 0.00 255.0 FORMAT "%5.1" NUMBER 4 /end CHARACTERISTIC
/begin CHARACTERISTIC DSM_TypDfp_FrmMngINSTR3_C "Konvertierung der Fehlertypen auf der Diagnoseschnittstelle fuer Fehlerpfad Dfp_FrmMngINSTR3" VAL_BLK 0xCC73A Kwb_Wu8 255.0 OneToOne 0.00 255.0 FORMAT "%5.1" NUMBER 4 /end CHARACTERISTIC
/begin CHARACTERISTIC DSM_TypDfp_FrmMngLENKRADWINKEL_C "Konvertierung der Fehlertypen auf der Diagnoseschnittstelle fuer Fehlerpfad Dfp_FrmMngLENKRADWINKEL" VAL_BLK 0xCC73E Kwb_Wu8 255.0 OneToOne 0.00 255.0 FORMAT "%5.1" NUMBER 4 /end CHARACTERISTIC
/begin CHARACTERISTIC DSM_TypDfp_FrmMngMILEAGE_RANGE_C "Konvertierung der Fehlertypen auf der Diagnoseschnittstelle fuer Fehlerpfad Dfp_FrmMngMILEAGE_RANGE" VAL_BLK 0xCC742 Kwb_Wu8 255.0 OneToOne 0.00 255.0 FORMAT "%5.1" NUMBER 4 /end CHARACTERISTIC
/begin CHARACTERISTIC DSM_TypDfp_FrmMngOPCRCTLACC_C "Konvertierung der Fehlertypen auf der Diagnoseschnittstelle fuer Fehlerpfad Dfp_FrmMngOPCRCTLACC" VAL_BLK 0xCC746 Kwb_Wu8 255.0 OneToOne 0.00 255.0 FORMAT "%5.1" NUMBER 4 /end CHARACTERISTIC
/begin CHARACTERISTIC DSM_TypDfp_FrmMngPRGG_CCTR_C "Konvertierung der Fehlertypen auf der Diagnoseschnittstelle fuer Fehlerpfad Dfp_FrmMngPRGG_CCTR" VAL_BLK 0xCC74A Kwb_Wu8 255.0 OneToOne 0.00 255.0 FORMAT "%5.1" NUMBER 4 /end CHARACTERISTIC
/begin CHARACTERISTIC DSM_TypDfp_FrmMngPWRMNG_LOADV_C "Konvertierung der Fehlertypen auf der Diagnoseschnittstelle fuer Fehlerpfad Dfp_FrmMngPWRMNG_LOADV" VAL_BLK 0xCC74E Kwb_Wu8 255.0 OneToOne 0.00 255.0 FORMAT "%5.1" NUMBER 4 /end CHARACTERISTIC
/begin CHARACTERISTIC DSM_TypDfp_FrmMngParkConsumer_C "Konvertierung der Fehlertypen auf der Diagnoseschnittstelle fuer Fehlerpfad Dfp_FrmMngParkConsumer" VAL_BLK 0xCC752 Kwb_Wu8 255.0 OneToOne 0.00 255.0 FORMAT "%5.1" NUMBER 4 /end CHARACTERISTIC
/begin CHARACTERISTIC DSM_TypDfp_FrmMngRQSTGEFAN_C "RQ_STG_EFAN - CAN-message related errors" VAL_BLK 0xCC756 Kwb_Wu8 255.0 OneToOne 0.00 255.0 FORMAT "%5.1" NUMBER 4 /end CHARACTERISTIC
/begin CHARACTERISTIC DSM_TypDfp_FrmMngSSGErr_C "Konvertierung der Fehlertypen auf der Diagnoseschnittstelle fuer Fehlerpfad Dfp_FrmMngSSGErr" VAL_BLK 0xCC75A Kwb_Wu8 255.0 OneToOne 0.00 255.0 FORMAT "%5.1" NUMBER 4 /end CHARACTERISTIC
/begin CHARACTERISTIC DSM_TypDfp_FrmMngSSGShOff_C "Konvertierung der Fehlertypen auf der Diagnoseschnittstelle fuer Fehlerpfad Dfp_FrmMngSSGShOff" VAL_BLK 0xCC75E Kwb_Wu8 255.0 OneToOne 0.00 255.0 FORMAT "%5.1" NUMBER 4 /end CHARACTERISTIC
/begin CHARACTERISTIC DSM_TypDfp_FrmMngSTAT_ANH_C "Konvertierung der Fehlertypen auf der Diagnoseschnittstelle fuer Fehlerpfad Dfp_FrmMngSTAT_ANH" VAL_BLK 0xCC762 Kwb_Wu8 255.0 OneToOne 0.00 255.0 FORMAT "%5.1" NUMBER 4 /end CHARACTERISTIC
/begin CHARACTERISTIC DSM_TypDfp_FrmMngSTAT_ARS_C "type for faults in path" VAL_BLK 0xCC766 Kwb_Wu8 255.0 OneToOne 0.00 255.0 FORMAT "%5.1" NUMBER 4 /end CHARACTERISTIC
/begin CHARACTERISTIC DSM_TypDfp_FrmMngSTAT_DSC_C "type for faults in path" VAL_BLK 0xCC76A Kwb_Wu8 255.0 OneToOne 0.00 255.0 FORMAT "%5.1" NUMBER 4 /end CHARACTERISTIC
/begin CHARACTERISTIC DSM_TypDfp_FrmMngSTAT_EKP_C "Konvertierung der Fehlertypen auf der Diagnoseschnittstelle fuer Fehlerpfad Dfp_FrmMngSTAT_EKP" VAL_BLK 0xCC76E Kwb_Wu8 255.0 OneToOne 0.00 255.0 FORMAT "%5.1" NUMBER 4 /end CHARACTERISTIC
/begin CHARACTERISTIC DSM_TypDfp_FrmMngSTAT_KOMBI_C "Konvertierung der Fehlertypen auf der Diagnoseschnittstelle fuer Fehlerpfad Dfp_FrmMngSTAT_KOMBI" VAL_BLK 0xCC772 Kwb_Wu8 255.0 OneToOne 0.00 255.0 FORMAT "%5.1" NUMBER 4 /end CHARACTERISTIC
/begin CHARACTERISTIC DSM_TypDfp_FrmMngSTAT_SITZ_C "Konvertierung der Fehlertypen auf der Diagnoseschnittstelle fuer Fehlerpfad Dfp_FrmMngSTAT_SITZ" VAL_BLK 0xCC776 Kwb_Wu8 255.0 OneToOne 0.00 255.0 FORMAT "%5.1" NUMBER 4 /end CHARACTERISTIC
/begin CHARACTERISTIC DSM_TypDfp_FrmMngStOBDGbxMilOf_C "Konvertierung der Fehlertypen auf der Diagnoseschnittstelle fuer Fehlerpfad Dfp_FrmMngStOBDGbxMilOf" VAL_BLK 0xCC77A Kwb_Wu8 255.0 OneToOne 0.00 255.0 FORMAT "%5.1" NUMBER 4 /end CHARACTERISTIC
/begin CHARACTERISTIC DSM_TypDfp_FrmMngStOBDGbxMilOn_C "Konvertierung der Fehlertypen auf der Diagnoseschnittstelle fuer Fehlerpfad Dfp_FrmMngStOBDGbxMilOn" VAL_BLK 0xCC77E Kwb_Wu8 255.0 OneToOne 0.00 255.0 FORMAT "%5.1" NUMBER 4 /end CHARACTERISTIC
/begin CHARACTERISTIC DSM_TypDfp_FrmMngTEMPRELTIME_C "Konvertierung der Fehlertypen auf der Diagnoseschnittstelle fuer Fehlerpfad Dfp_FrmMngTEMPRELTIME" VAL_BLK 0xCC782 Kwb_Wu8 255.0 OneToOne 0.00 255.0 FORMAT "%5.1" NUMBER 4 /end CHARACTERISTIC
/begin CHARACTERISTIC DSM_TypDfp_FrmMngTERMINAL_C "type for faults in path" VAL_BLK 0xCC786 Kwb_Wu8 255.0 OneToOne 0.00 255.0 FORMAT "%5.1" NUMBER 4 /end CHARACTERISTIC
/begin CHARACTERISTIC DSM_TypDfp_FrmMngTIME_DATE_C "Konvertierung der Fehlertypen auf der Diagnoseschnittstelle fuer Fehlerpfad Dfp_FrmMngTIME_DATE" VAL_BLK 0xCC78A Kwb_Wu8 255.0 OneToOne 0.00 255.0 FORMAT "%5.1" NUMBER 4 /end CHARACTERISTIC
/begin CHARACTERISTIC DSM_TypDfp_FrmMngTORQUE_DSC_C "type for faults in path" VAL_BLK 0xCC78E Kwb_Wu8 255.0 OneToOne 0.00 255.0 FORMAT "%5.1" NUMBER 4 /end CHARACTERISTIC
/begin CHARACTERISTIC DSM_TypDfp_FrmMngTORQUE_GEARBX_C "type for faults in path" VAL_BLK 0xCC792 Kwb_Wu8 255.0 OneToOne 0.00 255.0 FORMAT "%5.1" NUMBER 4 /end CHARACTERISTIC
/begin CHARACTERISTIC DSM_TypDfp_FrmMngTrq_ReqACC_C "Konvertierung der Fehlertypen auf der Diagnoseschnittstelle fuer Fehlerpfad Dfp_FrmMngTrq_ReqACC" VAL_BLK 0xCC796 Kwb_Wu8 255.0 OneToOne 0.00 255.0 FORMAT "%5.1" NUMBER 4 /end CHARACTERISTIC
/begin CHARACTERISTIC DSM_TypDfp_FrmMngVEH_MOD_C "VEH_MOD - CAN-message related errors" VAL_BLK 0xCC79A Kwb_Wu8 255.0 OneToOne 0.00 255.0 FORMAT "%5.1" NUMBER 4 /end CHARACTERISTIC
/begin CHARACTERISTIC DSM_TypDfp_FrmMngVELOCITY_C "type for faults in path" VAL_BLK 0xCC79E Kwb_Wu8 255.0 OneToOne 0.00 255.0 FORMAT "%5.1" NUMBER 4 /end CHARACTERISTIC
/begin CHARACTERISTIC DSM_TypDfp_FrmMngWHEEL_SPEED_C "Konvertierung der Fehlertypen auf der Diagnoseschnittstelle fuer Fehlerpfad Dfp_FrmMngWHEEL_SPEED" VAL_BLK 0xCC7A2 Kwb_Wu8 255.0 OneToOne 0.00 255.0 FORMAT "%5.1" NUMBER 4 /end CHARACTERISTIC
/begin CHARACTERISTIC DSM_TypDfp_FrmMngstCurr_C "Fehlertyp Feld für Dfp_FrmMngstCurr" VAL_BLK 0xCC7A6 Kwb_Wu8 255.0 OneToOne 0.00 255.0 FORMAT "%5.1" NUMBER 4 /end CHARACTERISTIC
/begin CHARACTERISTIC DSM_TypDfp_FrmMngswtPSPOff_C "Fehlertyp Feld für Dfp_FrmMngswtPSPOff" VAL_BLK 0xCC7AA Kwb_Wu8 255.0 OneToOne 0.00 255.0 FORMAT "%5.1" NUMBER 4 /end CHARACTERISTIC
/begin CHARACTERISTIC DSM_TypDfp_GearbxIncMax_C "Konvertierung der Fehlertypen auf der Diagnoseschnittstelle fuer Fehlerpfad Dfp_GearbxIncMax" VAL_BLK 0xCC7AE Kwb_Wu8 255.0 OneToOne 0.00 255.0 FORMAT "%5.1" NUMBER 4 /end CHARACTERISTIC
/begin CHARACTERISTIC DSM_TypDfp_GlwCD_C "Konvertierung der Fehlertypen auf der Diagnoseschnittstelle fuer Fehlerpfad Dfp_GlwCD" VAL_BLK 0xCC7B2 Kwb_Wu8 255.0 OneToOne 0.00 255.0 FORMAT "%5.1" NUMBER 4 /end CHARACTERISTIC
/begin CHARACTERISTIC DSM_TypDfp_GlwCDGlwCirc1_C "Konvertierung der Fehlertypen auf der Diagnoseschnittstelle fuer Fehlerpfad Dfp_GlwCDGlwCirc1" VAL_BLK 0xCC7B6 Kwb_Wu8 255.0 OneToOne 0.00 255.0 FORMAT "%5.1" NUMBER 4 /end CHARACTERISTIC
/begin CHARACTERISTIC DSM_TypDfp_GlwCDGlwCirc2_C "Konvertierung der Fehlertypen auf der Diagnoseschnittstelle fuer Fehlerpfad Dfp_GlwCDGlwCirc2" VAL_BLK 0xCC7BA Kwb_Wu8 255.0 OneToOne 0.00 255.0 FORMAT "%5.1" NUMBER 4 /end CHARACTERISTIC
/begin CHARACTERISTIC DSM_TypDfp_GlwCDGlwCirc3_C "Konvertierung der Fehlertypen auf der Diagnoseschnittstelle fuer Fehlerpfad Dfp_GlwCDGlwCirc3" VAL_BLK 0xCC7BE Kwb_Wu8 255.0 OneToOne 0.00 255.0 FORMAT "%5.1" NUMBER 4 /end CHARACTERISTIC
/begin CHARACTERISTIC DSM_TypDfp_GlwCDGlwCirc4_C "Konvertierung der Fehlertypen auf der Diagnoseschnittstelle fuer Fehlerpfad Dfp_GlwCDGlwCirc4" VAL_BLK 0xCC7C2 Kwb_Wu8 255.0 OneToOne 0.00 255.0 FORMAT "%5.1" NUMBER 4 /end CHARACTERISTIC
/begin CHARACTERISTIC DSM_TypDfp_GlwCDGlwCirc5_C "Konvertierung der Fehlertypen auf der Diagnoseschnittstelle fuer Fehlerpfad Dfp_GlwCDGlwCirc5" VAL_BLK 0xCC7C6 Kwb_Wu8 255.0 OneToOne 0.00 255.0 FORMAT "%5.1" NUMBER 4 /end CHARACTERISTIC
/begin CHARACTERISTIC DSM_TypDfp_GlwCDGlwCirc6_C "Konvertierung der Fehlertypen auf der Diagnoseschnittstelle fuer Fehlerpfad Dfp_GlwCDGlwCirc6" VAL_BLK 0xCC7CA Kwb_Wu8 255.0 OneToOne 0.00 255.0 FORMAT "%5.1" NUMBER 4 /end CHARACTERISTIC
/begin CHARACTERISTIC DSM_TypDfp_GlwCDGlwCirc7_C "Konvertierung der Fehlertypen auf der Diagnoseschnittstelle fuer Fehlerpfad Dfp_GlwCDGlwCirc7" VAL_BLK 0xCC7CE Kwb_Wu8 255.0 OneToOne 0.00 255.0 FORMAT "%5.1" NUMBER 4 /end CHARACTERISTIC
/begin CHARACTERISTIC DSM_TypDfp_GlwCDGlwCirc8_C "Konvertierung der Fehlertypen auf der Diagnoseschnittstelle fuer Fehlerpfad Dfp_GlwCDGlwCirc8" VAL_BLK 0xCC7D2 Kwb_Wu8 255.0 OneToOne 0.00 255.0 FORMAT "%5.1" NUMBER 4 /end CHARACTERISTIC
/begin CHARACTERISTIC DSM_TypDfp_GlwCtl_C "Konvertierung der Fehlertypen auf der Diagnoseschnittstelle fuer Fehlerpfad Dfp_GlwCtl" VAL_BLK 0xCC7D6 Kwb_Wu8 255.0 OneToOne 0.00 255.0 FORMAT "%5.1" NUMBER 4 /end CHARACTERISTIC
/begin CHARACTERISTIC DSM_TypDfp_HWEMonCom_C "Konvertierung der Fehlertypen auf der Diagnoseschnittstelle fuer Fehlerpfad Dfp_HWEMonCom" VAL_BLK 0xCC7DA Kwb_Wu8 255.0 OneToOne 0.00 255.0 FORMAT "%5.1" NUMBER 4 /end CHARACTERISTIC
/begin CHARACTERISTIC DSM_TypDfp_HWEMonEEPROM_C "Konvertierung der Fehlertypen auf der Diagnoseschnittstelle fuer Fehlerpfad Dfp_HWEMonEEPROM" VAL_BLK 0xCC7DE Kwb_Wu8 255.0 OneToOne 0.00 255.0 FORMAT "%5.1" NUMBER 4 /end CHARACTERISTIC
/begin CHARACTERISTIC DSM_TypDfp_HWEMonRcyLocked_C "Konvertierung der Fehlertypen auf der Diagnoseschnittstelle fuer Fehlerpfad Dfp_HWEMonRcyLocked" VAL_BLK 0xCC7E2 Kwb_Wu8 255.0 OneToOne 0.00 255.0 FORMAT "%5.1" NUMBER 4 /end CHARACTERISTIC
/begin CHARACTERISTIC DSM_TypDfp_HWEMonRcySuppressed_C "Konvertierung der Fehlertypen auf der Diagnoseschnittstelle fuer Fehlerpfad Dfp_HWEMonRcySuppressed" VAL_BLK 0xCC7E6 Kwb_Wu8 255.0 OneToOne 0.00 255.0 FORMAT "%5.1" NUMBER 4 /end CHARACTERISTIC
/begin CHARACTERISTIC DSM_TypDfp_HWEMonRcyVisible_C "Konvertierung der Fehlertypen auf der Diagnoseschnittstelle fuer Fehlerpfad Dfp_HWEMonRcyVisible" VAL_BLK 0xCC7EA Kwb_Wu8 255.0 OneToOne 0.00 255.0 FORMAT "%5.1" NUMBER 4 /end CHARACTERISTIC
/begin CHARACTERISTIC DSM_TypDfp_HWEMonUMaxSupply_C "Konvertierung der Fehlertypen auf der Diagnoseschnittstelle fuer Fehlerpfad Dfp_HWEMonUMaxSupply" VAL_BLK 0xCC7EE Kwb_Wu8 255.0 OneToOne 0.00 255.0 FORMAT "%5.1" NUMBER 4 /end CHARACTERISTIC
/begin CHARACTERISTIC DSM_TypDfp_HWEMonUMinSupply_C "Konvertierung der Fehlertypen auf der Diagnoseschnittstelle fuer Fehlerpfad Dfp_HWEMonUMinSupply" VAL_BLK 0xCC7F2 Kwb_Wu8 255.0 OneToOne 0.00 255.0 FORMAT "%5.1" NUMBER 4 /end CHARACTERISTIC
/begin CHARACTERISTIC DSM_TypDfp_IATSCD_C "Konvertierung der Fehlertypen auf der Diagnoseschnittstelle fuer Fehlerpfad Dfp_IATSCD" VAL_BLK 0xCC7F6 Kwb_Wu8 255.0 OneToOne 0.00 255.0 FORMAT "%5.1" NUMBER 4 /end CHARACTERISTIC
/begin CHARACTERISTIC DSM_TypDfp_IATSCD_CATS_C "Konvertierung der Fehlertypen auf der Diagnoseschnittstelle fuer Fehlerpfad Dfp_IATSCD_CATS" VAL_BLK 0xCC7FA Kwb_Wu8 255.0 OneToOne 0.00 255.0 FORMAT "%5.1" NUMBER 4 /end CHARACTERISTIC
/begin CHARACTERISTIC DSM_TypDfp_ImmCtlImmCD_C "Konvertierung der Fehlertypen auf der Diagnoseschnittstelle fuer Fehlerpfad Dfp_ImmCtlImmCD" VAL_BLK 0xCC7FE Kwb_Wu8 255.0 OneToOne 0.00 255.0 FORMAT "%5.1" NUMBER 4 /end CHARACTERISTIC
/begin CHARACTERISTIC DSM_TypDfp_ImmCtlImmEep_C "Konvertierung der Fehlertypen auf der Diagnoseschnittstelle fuer Fehlerpfad Dfp_ImmCtlImmEep" VAL_BLK 0xCC802 Kwb_Wu8 255.0 OneToOne 0.00 255.0 FORMAT "%5.1" NUMBER 4 /end CHARACTERISTIC
/begin CHARACTERISTIC DSM_TypDfp_ImmCtlMpl_C "Konvertierung der Fehlertypen auf der Diagnoseschnittstelle fuer Fehlerpfad Dfp_ImmCtlMpl" VAL_BLK 0xCC806 Kwb_Wu8 255.0 OneToOne 0.00 255.0 FORMAT "%5.1" NUMBER 4 /end CHARACTERISTIC
/begin CHARACTERISTIC DSM_TypDfp_IndSys1_C "Konvertierung der Fehlertypen auf der Diagnoseschnittstelle fuer Fehlerpfad Dfp_IndSys1" VAL_BLK 0xCC80A Kwb_Wu8 255.0 OneToOne 0.00 255.0 FORMAT "%5.1" NUMBER 4 /end CHARACTERISTIC
/begin CHARACTERISTIC DSM_TypDfp_IndSys2_C "Konvertierung der Fehlertypen auf der Diagnoseschnittstelle fuer Fehlerpfad Dfp_IndSys2" VAL_BLK 0xCC80E Kwb_Wu8 255.0 OneToOne 0.00 255.0 FORMAT "%5.1" NUMBER 4 /end CHARACTERISTIC
/begin CHARACTERISTIC DSM_TypDfp_InjCrv_InjLim_C "Konvertierung der Fehlertypen auf der Diagnoseschnittstelle fuer Fehlerpfad Dfp_InjCrv_InjLim" VAL_BLK 0xCC812 Kwb_Wu8 255.0 OneToOne 0.00 255.0 FORMAT "%5.1" NUMBER 4 /end CHARACTERISTIC
/begin CHARACTERISTIC DSM_TypDfp_InjCtlAdjQnt_C "Konvertierung der Fehlertypen auf der Diagnoseschnittstelle fuer Fehlerpfad Dfp_InjCtlAdjQnt" VAL_BLK 0xCC816 Kwb_Wu8 255.0 OneToOne 0.00 255.0 FORMAT "%5.1" NUMBER 4 /end CHARACTERISTIC
/begin CHARACTERISTIC DSM_TypDfp_InjCtlDrift_C "Konvertierung der Fehlertypen auf der Diagnoseschnittstelle fuer Fehlerpfad Dfp_InjCtlDrift" VAL_BLK 0xCC81A Kwb_Wu8 255.0 OneToOne 0.00 255.0 FORMAT "%5.1" NUMBER 4 /end CHARACTERISTIC
/begin CHARACTERISTIC DSM_TypDfp_InjVlvBnk1A_C "Konvertierung der Fehlertypen auf der Diagnoseschnittstelle fuer Fehlerpfad Dfp_InjVlvBnk1A" VAL_BLK 0xCC81E Kwb_Wu8 255.0 OneToOne 0.00 255.0 FORMAT "%5.1" NUMBER 4 /end CHARACTERISTIC
/begin CHARACTERISTIC DSM_TypDfp_InjVlvBnk1B_C "Konvertierung der Fehlertypen auf der Diagnoseschnittstelle fuer Fehlerpfad Dfp_InjVlvBnk1B" VAL_BLK 0xCC822 Kwb_Wu8 255.0 OneToOne 0.00 255.0 FORMAT "%5.1" NUMBER 4 /end CHARACTERISTIC
/begin CHARACTERISTIC DSM_TypDfp_InjVlvBnk2A_C "Konvertierung der Fehlertypen auf der Diagnoseschnittstelle fuer Fehlerpfad Dfp_InjVlvBnk2A" VAL_BLK 0xCC826 Kwb_Wu8 255.0 OneToOne 0.00 255.0 FORMAT "%5.1" NUMBER 4 /end CHARACTERISTIC
/begin CHARACTERISTIC DSM_TypDfp_InjVlvBnk2B_C "Konvertierung der Fehlertypen auf der Diagnoseschnittstelle fuer Fehlerpfad Dfp_InjVlvBnk2B" VAL_BLK 0xCC82A Kwb_Wu8 255.0 OneToOne 0.00 255.0 FORMAT "%5.1" NUMBER 4 /end CHARACTERISTIC
/begin CHARACTERISTIC DSM_TypDfp_InjVlvChipA_C "Konvertierung der Fehlertypen auf der Diagnoseschnittstelle fuer Fehlerpfad Dfp_InjVlvChipA" VAL_BLK 0xCC82E Kwb_Wu8 255.0 OneToOne 0.00 255.0 FORMAT "%5.1" NUMBER 4 /end CHARACTERISTIC
/begin CHARACTERISTIC DSM_TypDfp_InjVlvChipB_C "Konvertierung der Fehlertypen auf der Diagnoseschnittstelle fuer Fehlerpfad Dfp_InjVlvChipB" VAL_BLK 0xCC832 Kwb_Wu8 255.0 OneToOne 0.00 255.0 FORMAT "%5.1" NUMBER 4 /end CHARACTERISTIC
/begin CHARACTERISTIC DSM_TypDfp_InjVlvCyl1A_C "Konvertierung der Fehlertypen auf der Diagnoseschnittstelle fuer Fehlerpfad Dfp_InjVlvCyl1A" VAL_BLK 0xCC836 Kwb_Wu8 255.0 OneToOne 0.00 255.0 FORMAT "%5.1" NUMBER 4 /end CHARACTERISTIC
/begin CHARACTERISTIC DSM_TypDfp_InjVlvCyl1B_C "Konvertierung der Fehlertypen auf der Diagnoseschnittstelle fuer Fehlerpfad Dfp_InjVlvCyl1B" VAL_BLK 0xCC83A Kwb_Wu8 255.0 OneToOne 0.00 255.0 FORMAT "%5.1" NUMBER 4 /end CHARACTERISTIC
/begin CHARACTERISTIC DSM_TypDfp_InjVlvCyl2A_C "Konvertierung der Fehlertypen auf der Diagnoseschnittstelle fuer Fehlerpfad Dfp_InjVlvCyl2A" VAL_BLK 0xCC83E Kwb_Wu8 255.0 OneToOne 0.00 255.0 FORMAT "%5.1" NUMBER 4 /end CHARACTERISTIC
/begin CHARACTERISTIC DSM_TypDfp_InjVlvCyl2B_C "Konvertierung der Fehlertypen auf der Diagnoseschnittstelle fuer Fehlerpfad Dfp_InjVlvCyl2B" VAL_BLK 0xCC842 Kwb_Wu8 255.0 OneToOne 0.00 255.0 FORMAT "%5.1" NUMBER 4 /end CHARACTERISTIC
/begin CHARACTERISTIC DSM_TypDfp_InjVlvCyl3A_C "Konvertierung der Fehlertypen auf der Diagnoseschnittstelle fuer Fehlerpfad Dfp_InjVlvCyl3A" VAL_BLK 0xCC846 Kwb_Wu8 255.0 OneToOne 0.00 255.0 FORMAT "%5.1" NUMBER 4 /end CHARACTERISTIC
/begin CHARACTERISTIC DSM_TypDfp_InjVlvCyl3B_C "Konvertierung der Fehlertypen auf der Diagnoseschnittstelle fuer Fehlerpfad Dfp_InjVlvCyl3B" VAL_BLK 0xCC84A Kwb_Wu8 255.0 OneToOne 0.00 255.0 FORMAT "%5.1" NUMBER 4 /end CHARACTERISTIC
/begin CHARACTERISTIC DSM_TypDfp_InjVlvCyl4A_C "Konvertierung der Fehlertypen auf der Diagnoseschnittstelle fuer Fehlerpfad Dfp_InjVlvCyl4A" VAL_BLK 0xCC84E Kwb_Wu8 255.0 OneToOne 0.00 255.0 FORMAT "%5.1" NUMBER 4 /end CHARACTERISTIC
/begin CHARACTERISTIC DSM_TypDfp_InjVlvCyl4B_C "Konvertierung der Fehlertypen auf der Diagnoseschnittstelle fuer Fehlerpfad Dfp_InjVlvCyl4B" VAL_BLK 0xCC852 Kwb_Wu8 255.0 OneToOne 0.00 255.0 FORMAT "%5.1" NUMBER 4 /end CHARACTERISTIC
/begin CHARACTERISTIC DSM_TypDfp_InjVlvCyl5A_C "Konvertierung der Fehlertypen auf der Diagnoseschnittstelle fuer Fehlerpfad Dfp_InjVlvCyl5A" VAL_BLK 0xCC856 Kwb_Wu8 255.0 OneToOne 0.00 255.0 FORMAT "%5.1" NUMBER 4 /end CHARACTERISTIC
/begin CHARACTERISTIC DSM_TypDfp_InjVlvCyl5B_C "Konvertierung der Fehlertypen auf der Diagnoseschnittstelle fuer Fehlerpfad Dfp_InjVlvCyl5B" VAL_BLK 0xCC85A Kwb_Wu8 255.0 OneToOne 0.00 255.0 FORMAT "%5.1" NUMBER 4 /end CHARACTERISTIC
/begin CHARACTERISTIC DSM_TypDfp_InjVlvCyl6A_C "Konvertierung der Fehlertypen auf der Diagnoseschnittstelle fuer Fehlerpfad Dfp_InjVlvCyl6A" VAL_BLK 0xCC85E Kwb_Wu8 255.0 OneToOne 0.00 255.0 FORMAT "%5.1" NUMBER 4 /end CHARACTERISTIC
/begin CHARACTERISTIC DSM_TypDfp_InjVlvCyl6B_C "Konvertierung der Fehlertypen auf der Diagnoseschnittstelle fuer Fehlerpfad Dfp_InjVlvCyl6B" VAL_BLK 0xCC862 Kwb_Wu8 255.0 OneToOne 0.00 255.0 FORMAT "%5.1" NUMBER 4 /end CHARACTERISTIC
/begin CHARACTERISTIC DSM_TypDfp_LPACD_Max_C "Konvertierung der Fehlertypen auf der Diagnoseschnittstelle fuer Fehlerpfad Dfp_LPACD_Max" VAL_BLK 0xCC866 Kwb_Wu8 255.0 OneToOne 0.00 255.0 FORMAT "%5.1" NUMBER 4 /end CHARACTERISTIC
/begin CHARACTERISTIC DSM_TypDfp_LPACD_Min_C "Konvertierung der Fehlertypen auf der Diagnoseschnittstelle fuer Fehlerpfad Dfp_LPACD_Min" VAL_BLK 0xCC86A Kwb_Wu8 255.0 OneToOne 0.00 255.0 FORMAT "%5.1" NUMBER 4 /end CHARACTERISTIC
/begin CHARACTERISTIC DSM_TypDfp_LPACD_SigNpl_C "Konvertierung der Fehlertypen auf der Diagnoseschnittstelle fuer Fehlerpfad Dfp_LPACD_SigNpl" VAL_BLK 0xCC86E Kwb_Wu8 255.0 OneToOne 0.00 255.0 FORMAT "%5.1" NUMBER 4 /end CHARACTERISTIC
/begin CHARACTERISTIC DSM_TypDfp_LSUCDCircNernst0_C "Konvertierung der Fehlertypen auf der Diagnoseschnittstelle fuer Fehlerpfad Dfp_LSUCDCircNernst0" VAL_BLK 0xCC872 Kwb_Wu8 255.0 OneToOne 0.00 255.0 FORMAT "%5.1" NUMBER 4 /end CHARACTERISTIC
/begin CHARACTERISTIC DSM_TypDfp_LSUCDCircPumpCur0_C "Konvertierung der Fehlertypen auf der Diagnoseschnittstelle fuer Fehlerpfad Dfp_LSUCDCircPumpCur0" VAL_BLK 0xCC876 Kwb_Wu8 255.0 OneToOne 0.00 255.0 FORMAT "%5.1" NUMBER 4 /end CHARACTERISTIC
/begin CHARACTERISTIC DSM_TypDfp_LSUCDCircVirtGnd0_C "Konvertierung der Fehlertypen auf der Diagnoseschnittstelle fuer Fehlerpfad Dfp_LSUCDCircVirtGnd0" VAL_BLK 0xCC87A Kwb_Wu8 255.0 OneToOne 0.00 255.0 FORMAT "%5.1" NUMBER 4 /end CHARACTERISTIC
/begin CHARACTERISTIC DSM_TypDfp_LSUCDHeater0_C "Konvertierung der Fehlertypen auf der Diagnoseschnittstelle fuer Fehlerpfad Dfp_LSUCDHeater0" VAL_BLK 0xCC87E Kwb_Wu8 255.0 OneToOne 0.00 255.0 FORMAT "%5.1" NUMBER 4 /end CHARACTERISTIC
/begin CHARACTERISTIC DSM_TypDfp_LSUCDHtCoup0_C "Konvertierung der Fehlertypen auf der Diagnoseschnittstelle fuer Fehlerpfad Dfp_LSUCDHtCoup0" VAL_BLK 0xCC882 Kwb_Wu8 255.0 OneToOne 0.00 255.0 FORMAT "%5.1" NUMBER 4 /end CHARACTERISTIC
/begin CHARACTERISTIC DSM_TypDfp_LSUCDO20_C "Konvertierung der Fehlertypen auf der Diagnoseschnittstelle fuer Fehlerpfad Dfp_LSUCDO20" VAL_BLK 0xCC886 Kwb_Wu8 255.0 OneToOne 0.00 255.0 FORMAT "%5.1" NUMBER 4 /end CHARACTERISTIC
/begin CHARACTERISTIC DSM_TypDfp_LSUCDO2Clb0_C "Konvertierung der Fehlertypen auf der Diagnoseschnittstelle fuer Fehlerpfad Dfp_LSUCDO2Clb0" VAL_BLK 0xCC88A Kwb_Wu8 255.0 OneToOne 0.00 255.0 FORMAT "%5.1" NUMBER 4 /end CHARACTERISTIC
/begin CHARACTERISTIC DSM_TypDfp_LSUCDRiClb0_C "Konvertierung der Fehlertypen auf der Diagnoseschnittstelle fuer Fehlerpfad Dfp_LSUCDRiClb0" VAL_BLK 0xCC88E Kwb_Wu8 255.0 OneToOne 0.00 255.0 FORMAT "%5.1" NUMBER 4 /end CHARACTERISTIC
/begin CHARACTERISTIC DSM_TypDfp_LSUCDSPI0_C "Konvertierung der Fehlertypen auf der Diagnoseschnittstelle fuer Fehlerpfad Dfp_LSUCDSPI0" VAL_BLK 0xCC892 Kwb_Wu8 255.0 OneToOne 0.00 255.0 FORMAT "%5.1" NUMBER 4 /end CHARACTERISTIC
/begin CHARACTERISTIC DSM_TypDfp_LSUCDSPIBattLow0_C "Konvertierung der Fehlertypen auf der Diagnoseschnittstelle fuer Fehlerpfad Dfp_LSUCDSPIBattLow0" VAL_BLK 0xCC896 Kwb_Wu8 255.0 OneToOne 0.00 255.0 FORMAT "%5.1" NUMBER 4 /end CHARACTERISTIC
/begin CHARACTERISTIC DSM_TypDfp_LSUCDWireIP0_C "Konvertierung der Fehlertypen auf der Diagnoseschnittstelle fuer Fehlerpfad Dfp_LSUCDWireIP0" VAL_BLK 0xCC89A Kwb_Wu8 255.0 OneToOne 0.00 255.0 FORMAT "%5.1" NUMBER 4 /end CHARACTERISTIC
/begin CHARACTERISTIC DSM_TypDfp_LSUCtlRiExc0_C "Konvertierung der Fehlertypen auf der Diagnoseschnittstelle fuer Fehlerpfad Dfp_LSUCtlRiExc0" VAL_BLK 0xCC89E Kwb_Wu8 255.0 OneToOne 0.00 255.0 FORMAT "%5.1" NUMBER 4 /end CHARACTERISTIC
/begin CHARACTERISTIC DSM_TypDfp_LSUMon1Sens_C "Konvertierung der Fehlertypen auf der Diagnoseschnittstelle fuer Fehlerpfad Dfp_LSUMon1Sens" VAL_BLK 0xCC8A2 Kwb_Wu8 255.0 OneToOne 0.00 255.0 FORMAT "%5.1" NUMBER 4 /end CHARACTERISTIC
/begin CHARACTERISTIC DSM_TypDfp_LSUMon2Sens_C "Konvertierung der Fehlertypen auf der Diagnoseschnittstelle fuer Fehlerpfad Dfp_LSUMon2Sens" VAL_BLK 0xCC8A6 Kwb_Wu8 255.0 OneToOne 0.00 255.0 FORMAT "%5.1" NUMBER 4 /end CHARACTERISTIC
/begin CHARACTERISTIC DSM_TypDfp_LubCD_C "Konvertierung der Fehlertypen auf der Diagnoseschnittstelle fuer Fehlerpfad Dfp_LubCD" VAL_BLK 0xCC8AA Kwb_Wu8 255.0 OneToOne 0.00 255.0 FORMAT "%5.1" NUMBER 4 /end CHARACTERISTIC
/begin CHARACTERISTIC DSM_TypDfp_MIL_C "Konvertierung der Fehlertypen auf der Diagnoseschnittstelle fuer Fehlerpfad Dfp_MIL" VAL_BLK 0xCC8AE Kwb_Wu8 255.0 OneToOne 0.00 255.0 FORMAT "%5.1" NUMBER 4 /end CHARACTERISTIC
/begin CHARACTERISTIC DSM_TypDfp_MRlyCD_C "Konvertierung der Fehlertypen auf der Diagnoseschnittstelle fuer Fehlerpfad Dfp_MRlyCD" VAL_BLK 0xCC8B2 Kwb_Wu8 255.0 OneToOne 0.00 255.0 FORMAT "%5.1" NUMBER 4 /end CHARACTERISTIC
/begin CHARACTERISTIC DSM_TypDfp_MSidCD_Comm_C "Konvertierung der Fehlertypen auf der Diagnoseschnittstelle fuer Fehlerpfad Dfp_MSidCD_Comm" VAL_BLK 0xCC8B6 Kwb_Wu8 255.0 OneToOne 0.00 255.0 FORMAT "%5.1" NUMBER 4 /end CHARACTERISTIC
/begin CHARACTERISTIC DSM_TypDfp_MSidCD_Pin_C "Konvertierung der Fehlertypen auf der Diagnoseschnittstelle fuer Fehlerpfad Dfp_MSidCD_Pin" VAL_BLK 0xCC8BA Kwb_Wu8 255.0 OneToOne 0.00 255.0 FORMAT "%5.1" NUMBER 4 /end CHARACTERISTIC
/begin CHARACTERISTIC DSM_TypDfp_MSidCD_Sel_INI_C "Konvertierung der Fehlertypen auf der Diagnoseschnittstelle fuer Fehlerpfad Dfp_MSidCD_Sel_INI" VAL_BLK 0xCC8BE Kwb_Wu8 255.0 OneToOne 0.00 255.0 FORMAT "%5.1" NUMBER 4 /end CHARACTERISTIC
/begin CHARACTERISTIC DSM_TypDfp_MSidCD_Select_C "Konvertierung der Fehlertypen auf der Diagnoseschnittstelle fuer Fehlerpfad Dfp_MSidCD_Select" VAL_BLK 0xCC8C2 Kwb_Wu8 255.0 OneToOne 0.00 255.0 FORMAT "%5.1" NUMBER 4 /end CHARACTERISTIC
/begin CHARACTERISTIC DSM_TypDfp_MeUnCDNoLoad_C "Konvertierung der Fehlertypen auf der Diagnoseschnittstelle fuer Fehlerpfad Dfp_MeUnCDNoLoad" VAL_BLK 0xCC8C6 Kwb_Wu8 255.0 OneToOne 0.00 255.0 FORMAT "%5.1" NUMBER 4 /end CHARACTERISTIC
/begin CHARACTERISTIC DSM_TypDfp_MeUnCDSCBat_C "Konvertierung der Fehlertypen auf der Diagnoseschnittstelle fuer Fehlerpfad Dfp_MeUnCDSCBat" VAL_BLK 0xCC8CA Kwb_Wu8 255.0 OneToOne 0.00 255.0 FORMAT "%5.1" NUMBER 4 /end CHARACTERISTIC
/begin CHARACTERISTIC DSM_TypDfp_MeUnCDSCGnd_C "Konvertierung der Fehlertypen auf der Diagnoseschnittstelle fuer Fehlerpfad Dfp_MeUnCDSCGnd" VAL_BLK 0xCC8CE Kwb_Wu8 255.0 OneToOne 0.00 255.0 FORMAT "%5.1" NUMBER 4 /end CHARACTERISTIC
/begin CHARACTERISTIC DSM_TypDfp_MeUnCD_ADC_C "Konvertierung der Fehlertypen auf der Diagnoseschnittstelle fuer Fehlerpfad Dfp_MeUnCD_ADC" VAL_BLK 0xCC8D2 Kwb_Wu8 255.0 OneToOne 0.00 255.0 FORMAT "%5.1" NUMBER 4 /end CHARACTERISTIC
/begin CHARACTERISTIC DSM_TypDfp_MeUnCD_SigTst_C "Konvertierung der Fehlertypen auf der Diagnoseschnittstelle fuer Fehlerpfad Dfp_MeUnCD_SigTst" VAL_BLK 0xCC8D6 Kwb_Wu8 255.0 OneToOne 0.00 255.0 FORMAT "%5.1" NUMBER 4 /end CHARACTERISTIC
/begin CHARACTERISTIC DSM_TypDfp_Montr_C "Konvertierung der Fehlertypen auf der Diagnoseschnittstelle fuer Fehlerpfad Dfp_Montr" VAL_BLK 0xCC8DA Kwb_Wu8 255.0 OneToOne 0.00 255.0 FORMAT "%5.1" NUMBER 4 /end CHARACTERISTIC
/begin CHARACTERISTIC DSM_TypDfp_NetMngDeviceA_C "Konvertierung der Fehlertypen auf der Diagnoseschnittstelle fuer Fehlerpfad Dfp_NetMngDeviceA" VAL_BLK 0xCC8DE Kwb_Wu8 255.0 OneToOne 0.00 255.0 FORMAT "%5.1" NUMBER 4 /end CHARACTERISTIC
/begin CHARACTERISTIC DSM_TypDfp_NetMngDeviceB_C "Konvertierung der Fehlertypen auf der Diagnoseschnittstelle fuer Fehlerpfad Dfp_NetMngDeviceB" VAL_BLK 0xCC8E2 Kwb_Wu8 255.0 OneToOne 0.00 255.0 FORMAT "%5.1" NUMBER 4 /end CHARACTERISTIC
/begin CHARACTERISTIC DSM_TypDfp_NetMngDeviceC_C "Konvertierung der Fehlertypen auf der Diagnoseschnittstelle fuer Fehlerpfad Dfp_NetMngDeviceC" VAL_BLK 0xCC8E6 Kwb_Wu8 255.0 OneToOne 0.00 255.0 FORMAT "%5.1" NUMBER 4 /end CHARACTERISTIC
/begin CHARACTERISTIC DSM_TypDfp_OPSCD_Lamp_C "Konvertierung der Fehlertypen auf der Diagnoseschnittstelle fuer Fehlerpfad Dfp_OPSCD_Lamp" VAL_BLK 0xCC8EA Kwb_Wu8 255.0 OneToOne 0.00 255.0 FORMAT "%5.1" NUMBER 4 /end CHARACTERISTIC
/begin CHARACTERISTIC DSM_TypDfp_OPSCD_anain_C "Konvertierung der Fehlertypen auf der Diagnoseschnittstelle fuer Fehlerpfad Dfp_OPSCD_anain" VAL_BLK 0xCC8EE Kwb_Wu8 255.0 OneToOne 0.00 255.0 FORMAT "%5.1" NUMBER 4 /end CHARACTERISTIC
/begin CHARACTERISTIC DSM_TypDfp_OTSCD_C "Konvertierung der Fehlertypen auf der Diagnoseschnittstelle fuer Fehlerpfad Dfp_OTSCD" VAL_BLK 0xCC8F2 Kwb_Wu8 255.0 OneToOne 0.00 255.0 FORMAT "%5.1" NUMBER 4 /end CHARACTERISTIC
/begin CHARACTERISTIC DSM_TypDfp_OvRMon_C "Konvertierung der Fehlertypen auf der Diagnoseschnittstelle fuer Fehlerpfad Dfp_OvRMon" VAL_BLK 0xCC8F6 Kwb_Wu8 255.0 OneToOne 0.00 255.0 FORMAT "%5.1" NUMBER 4 /end CHARACTERISTIC
/begin CHARACTERISTIC DSM_TypDfp_OvRMonBrk_C "conversion of fault types for diagnostic interface for fault path Dfp_OvRMonBrk" VAL_BLK 0xCC8FA Kwb_Wu8 255.0 OneToOne 0.00 255.0 FORMAT "%5.1" NUMBER 4 /end CHARACTERISTIC
/begin CHARACTERISTIC DSM_TypDfp_OvRMonSigA_C "Konvertierung der Fehlertypen auf der Diagnoseschnittstelle fuer Fehlerpfad Dfp_OvRMonSigA" VAL_BLK 0xCC8FE Kwb_Wu8 255.0 OneToOne 0.00 255.0 FORMAT "%5.1" NUMBER 4 /end CHARACTERISTIC
/begin CHARACTERISTIC DSM_TypDfp_OxiCCDTPre_C "Konvertierung der Fehlertypen auf der Diagnoseschnittstelle fuer Fehlerpfad Dfp_OxiCCDTPre" VAL_BLK 0xCC902 Kwb_Wu8 255.0 OneToOne 0.00 255.0 FORMAT "%5.1" NUMBER 4 /end CHARACTERISTIC
/begin CHARACTERISTIC DSM_TypDfp_PCR_GovDevNeg_C "Konvertierung der Fehlertypen auf der Diagnoseschnittstelle fuer Fehlerpfad Dfp_PCR_GovDevNeg" VAL_BLK 0xCC906 Kwb_Wu8 255.0 OneToOne 0.00 255.0 FORMAT "%5.1" NUMBER 4 /end CHARACTERISTIC
/begin CHARACTERISTIC DSM_TypDfp_PCR_GovDevPos_C "Konvertierung der Fehlertypen auf der Diagnoseschnittstelle fuer Fehlerpfad Dfp_PCR_GovDevPos" VAL_BLK 0xCC90A Kwb_Wu8 255.0 OneToOne 0.00 255.0 FORMAT "%5.1" NUMBER 4 /end CHARACTERISTIC
/begin CHARACTERISTIC DSM_TypDfp_PCVCDNoLoad_C "Konvertierung der Fehlertypen auf der Diagnoseschnittstelle fuer Fehlerpfad Dfp_PCVCDNoLoad" VAL_BLK 0xCC90E Kwb_Wu8 255.0 OneToOne 0.00 255.0 FORMAT "%5.1" NUMBER 4 /end CHARACTERISTIC
/begin CHARACTERISTIC DSM_TypDfp_PCVCDSCBat_C "Konvertierung der Fehlertypen auf der Diagnoseschnittstelle fuer Fehlerpfad Dfp_PCVCDSCBat" VAL_BLK 0xCC912 Kwb_Wu8 255.0 OneToOne 0.00 255.0 FORMAT "%5.1" NUMBER 4 /end CHARACTERISTIC
/begin CHARACTERISTIC DSM_TypDfp_PCVCDSCGnd_C "Konvertierung der Fehlertypen auf der Diagnoseschnittstelle fuer Fehlerpfad Dfp_PCVCDSCGnd" VAL_BLK 0xCC916 Kwb_Wu8 255.0 OneToOne 0.00 255.0 FORMAT "%5.1" NUMBER 4 /end CHARACTERISTIC
/begin CHARACTERISTIC DSM_TypDfp_PCVCD_ADC_C "Konvertierung der Fehlertypen auf der Diagnoseschnittstelle fuer Fehlerpfad Dfp_PCVCD_ADC" VAL_BLK 0xCC91A Kwb_Wu8 255.0 OneToOne 0.00 255.0 FORMAT "%5.1" NUMBER 4 /end CHARACTERISTIC
/begin CHARACTERISTIC DSM_TypDfp_PCVCD_SigTst_C "Konvertierung der Fehlertypen auf der Diagnoseschnittstelle fuer Fehlerpfad Dfp_PCVCD_SigTst" VAL_BLK 0xCC91E Kwb_Wu8 255.0 OneToOne 0.00 255.0 FORMAT "%5.1" NUMBER 4 /end CHARACTERISTIC
/begin CHARACTERISTIC DSM_TypDfp_PFltAPSens_C "Konvertierung der Fehlertypen auf der Diagnoseschnittstelle fuer Fehlerpfad Dfp_PFltAPSens" VAL_BLK 0xCC922 Kwb_Wu8 255.0 OneToOne 0.00 255.0 FORMAT "%5.1" NUMBER 4 /end CHARACTERISTIC
/begin CHARACTERISTIC DSM_TypDfp_PFltCDPPre_C "Konvertierung der Fehlertypen auf der Diagnoseschnittstelle fuer Fehlerpfad Dfp_PFltCDPPre" VAL_BLK 0xCC926 Kwb_Wu8 255.0 OneToOne 0.00 255.0 FORMAT "%5.1" NUMBER 4 /end CHARACTERISTIC
/begin CHARACTERISTIC DSM_TypDfp_PFltCDTempPre_C "Konvertierung der Fehlertypen auf der Diagnoseschnittstelle fuer Fehlerpfad Dfp_PFltCDTempPre" VAL_BLK 0xCC92A Kwb_Wu8 255.0 OneToOne 0.00 255.0 FORMAT "%5.1" NUMBER 4 /end CHARACTERISTIC
/begin CHARACTERISTIC DSM_TypDfp_PFltChar_C "Konvertierung der Fehlertypen auf der Diagnoseschnittstelle fuer Fehlerpfad Dfp_PFltChar" VAL_BLK 0xCC92E Kwb_Wu8 255.0 OneToOne 0.00 255.0 FORMAT "%5.1" NUMBER 4 /end CHARACTERISTIC
/begin CHARACTERISTIC DSM_TypDfp_PFltEngPrt_C "Konvertierung der Fehlertypen auf der Diagnoseschnittstelle fuer Fehlerpfad Dfp_PFltEngPrt" VAL_BLK 0xCC932 Kwb_Wu8 255.0 OneToOne 0.00 255.0 FORMAT "%5.1" NUMBER 4 /end CHARACTERISTIC
/begin CHARACTERISTIC DSM_TypDfp_PFltPresDynPlaus_C "Konvertierung der Fehlertypen auf der Diagnoseschnittstelle fuer Fehlerpfad Dfp_PFltPresDynPlaus" VAL_BLK 0xCC936 Kwb_Wu8 255.0 OneToOne 0.00 255.0 FORMAT "%5.1" NUMBER 4 /end CHARACTERISTIC
/begin CHARACTERISTIC DSM_TypDfp_PFltPresSens_C "Konvertierung der Fehlertypen auf der Diagnoseschnittstelle fuer Fehlerpfad Dfp_PFltPresSens" VAL_BLK 0xCC93A Kwb_Wu8 255.0 OneToOne 0.00 255.0 FORMAT "%5.1" NUMBER 4 /end CHARACTERISTIC
/begin CHARACTERISTIC DSM_TypDfp_PFltPresSensFrz_C "Konvertierung der Fehlertypen auf der Diagnoseschnittstelle fuer Fehlerpfad Dfp_PFltPresSensFrz" VAL_BLK 0xCC93E Kwb_Wu8 255.0 OneToOne 0.00 255.0 FORMAT "%5.1" NUMBER 4 /end CHARACTERISTIC
/begin CHARACTERISTIC DSM_TypDfp_PFltPresSensHsLn_C "Konvertierung der Fehlertypen auf der Diagnoseschnittstelle fuer Fehlerpfad Dfp_PFltPresSensHsLn" VAL_BLK 0xCC942 Kwb_Wu8 255.0 OneToOne 0.00 255.0 FORMAT "%5.1" NUMBER 4 /end CHARACTERISTIC
/begin CHARACTERISTIC DSM_TypDfp_PFltPresSensSot_C "Konvertierung der Fehlertypen auf der Diagnoseschnittstelle fuer Fehlerpfad Dfp_PFltPresSensSot" VAL_BLK 0xCC946 Kwb_Wu8 255.0 OneToOne 0.00 255.0 FORMAT "%5.1" NUMBER 4 /end CHARACTERISTIC
/begin CHARACTERISTIC DSM_TypDfp_PFltRgnPerm_C "Konvertierung der Fehlertypen auf der Diagnoseschnittstelle fuer Fehlerpfad Dfp_PFltRgnPerm" VAL_BLK 0xCC94A Kwb_Wu8 255.0 OneToOne 0.00 255.0 FORMAT "%5.1" NUMBER 4 /end CHARACTERISTIC
/begin CHARACTERISTIC DSM_TypDfp_PFltTempDwnStrm_C "Konvertierung der Fehlertypen auf der Diagnoseschnittstelle fuer Fehlerpfad Dfp_PFltTempDwnStrm" VAL_BLK 0xCC94E Kwb_Wu8 255.0 OneToOne 0.00 255.0 FORMAT "%5.1" NUMBER 4 /end CHARACTERISTIC
/begin CHARACTERISTIC DSM_TypDfp_PFltTempSens_C "Konvertierung der Fehlertypen auf der Diagnoseschnittstelle fuer Fehlerpfad Dfp_PFltTempSens" VAL_BLK 0xCC952 Kwb_Wu8 255.0 OneToOne 0.00 255.0 FORMAT "%5.1" NUMBER 4 /end CHARACTERISTIC
/begin CHARACTERISTIC DSM_TypDfp_PFltTempUpStrm_C "Konvertierung der Fehlertypen auf der Diagnoseschnittstelle fuer Fehlerpfad Dfp_PFltTempUpStrm" VAL_BLK 0xCC956 Kwb_Wu8 255.0 OneToOne 0.00 255.0 FORMAT "%5.1" NUMBER 4 /end CHARACTERISTIC
/begin CHARACTERISTIC DSM_TypDfp_PFltmSotDiffMax_C "Konvertierung der Fehlertypen auf der Diagnoseschnittstelle fuer Fehlerpfad Dfp_PFltmSotDiffMax" VAL_BLK 0xCC95A Kwb_Wu8 255.0 OneToOne 0.00 255.0 FORMAT "%5.1" NUMBER 4 /end CHARACTERISTIC
/begin CHARACTERISTIC DSM_TypDfp_PSPCD_Actr_C "Konvertierung der Fehlertypen auf der Diagnoseschnittstelle fuer Fehlerpfad Dfp_PSPCD_Actr" VAL_BLK 0xCC95E Kwb_Wu8 255.0 OneToOne 0.00 255.0 FORMAT "%5.1" NUMBER 4 /end CHARACTERISTIC
/begin CHARACTERISTIC DSM_TypDfp_QLTCD_C "Konvertierung der Fehlertypen auf der Diagnoseschnittstelle fuer Fehlerpfad Dfp_QLTCD" VAL_BLK 0xCC962 Kwb_Wu8 255.0 OneToOne 0.00 255.0 FORMAT "%5.1" NUMBER 4 /end CHARACTERISTIC
/begin CHARACTERISTIC DSM_TypDfp_RailCD_C "Konvertierung der Fehlertypen auf der Diagnoseschnittstelle fuer Fehlerpfad Dfp_RailCD" VAL_BLK 0xCC966 Kwb_Wu8 255.0 OneToOne 0.00 255.0 FORMAT "%5.1" NUMBER 4 /end CHARACTERISTIC
/begin CHARACTERISTIC DSM_TypDfp_RailCDOfsTst_C "Konvertierung der Fehlertypen auf der Diagnoseschnittstelle fuer Fehlerpfad Dfp_RailCDOfsTst" VAL_BLK 0xCC96A Kwb_Wu8 255.0 OneToOne 0.00 255.0 FORMAT "%5.1" NUMBER 4 /end CHARACTERISTIC
/begin CHARACTERISTIC DSM_TypDfp_RailCD_PMonStrt_C "Konvertierung der Fehlertypen auf der Diagnoseschnittstelle fuer Fehlerpfad Dfp_RailCD_PMonStrt" VAL_BLK 0xCC96E Kwb_Wu8 255.0 OneToOne 0.00 255.0 FORMAT "%5.1" NUMBER 4 /end CHARACTERISTIC
/begin CHARACTERISTIC DSM_TypDfp_RailCtlModeMeUnDiag_C "Konvertierung der Fehlertypen auf der Diagnoseschnittstelle fuer Fehlerpfad Dfp_RailCtlModeMeUnDiag" VAL_BLK 0xCC972 Kwb_Wu8 255.0 OneToOne 0.00 255.0 FORMAT "%5.1" NUMBER 4 /end CHARACTERISTIC
/begin CHARACTERISTIC DSM_TypDfp_RailCtlModePCVDiag_C "Konvertierung der Fehlertypen auf der Diagnoseschnittstelle fuer Fehlerpfad Dfp_RailCtlModePCVDiag" VAL_BLK 0xCC976 Kwb_Wu8 255.0 OneToOne 0.00 255.0 FORMAT "%5.1" NUMBER 4 /end CHARACTERISTIC
/begin CHARACTERISTIC DSM_TypDfp_RailMeUn0_C "Konvertierung der Fehlertypen auf der Diagnoseschnittstelle fuer Fehlerpfad Dfp_RailMeUn0" VAL_BLK 0xCC97A Kwb_Wu8 255.0 OneToOne 0.00 255.0 FORMAT "%5.1" NUMBER 4 /end CHARACTERISTIC
/begin CHARACTERISTIC DSM_TypDfp_RailMeUn1_C "Konvertierung der Fehlertypen auf der Diagnoseschnittstelle fuer Fehlerpfad Dfp_RailMeUn1" VAL_BLK 0xCC97E Kwb_Wu8 255.0 OneToOne 0.00 255.0 FORMAT "%5.1" NUMBER 4 /end CHARACTERISTIC
/begin CHARACTERISTIC DSM_TypDfp_RailMeUn2_C "Konvertierung der Fehlertypen auf der Diagnoseschnittstelle fuer Fehlerpfad Dfp_RailMeUn2" VAL_BLK 0xCC982 Kwb_Wu8 255.0 OneToOne 0.00 255.0 FORMAT "%5.1" NUMBER 4 /end CHARACTERISTIC
/begin CHARACTERISTIC DSM_TypDfp_RailMeUn3_C "Konvertierung der Fehlertypen auf der Diagnoseschnittstelle fuer Fehlerpfad Dfp_RailMeUn3" VAL_BLK 0xCC986 Kwb_Wu8 255.0 OneToOne 0.00 255.0 FORMAT "%5.1" NUMBER 4 /end CHARACTERISTIC
/begin CHARACTERISTIC DSM_TypDfp_RailMeUn4_C "Konvertierung der Fehlertypen auf der Diagnoseschnittstelle fuer Fehlerpfad Dfp_RailMeUn4" VAL_BLK 0xCC98A Kwb_Wu8 255.0 OneToOne 0.00 255.0 FORMAT "%5.1" NUMBER 4 /end CHARACTERISTIC
/begin CHARACTERISTIC DSM_TypDfp_RailPCV0_C "Konvertierung der Fehlertypen auf der Diagnoseschnittstelle fuer Fehlerpfad Dfp_RailPCV0" VAL_BLK 0xCC98E Kwb_Wu8 255.0 OneToOne 0.00 255.0 FORMAT "%5.1" NUMBER 4 /end CHARACTERISTIC
/begin CHARACTERISTIC DSM_TypDfp_RailPCV1_C "Konvertierung der Fehlertypen auf der Diagnoseschnittstelle fuer Fehlerpfad Dfp_RailPCV1" VAL_BLK 0xCC992 Kwb_Wu8 255.0 OneToOne 0.00 255.0 FORMAT "%5.1" NUMBER 4 /end CHARACTERISTIC
/begin CHARACTERISTIC DSM_TypDfp_RailPCV2_C "Konvertierung der Fehlertypen auf der Diagnoseschnittstelle fuer Fehlerpfad Dfp_RailPCV2" VAL_BLK 0xCC996 Kwb_Wu8 255.0 OneToOne 0.00 255.0 FORMAT "%5.1" NUMBER 4 /end CHARACTERISTIC
/begin CHARACTERISTIC DSM_TypDfp_RailPCV3_C "Konvertierung der Fehlertypen auf der Diagnoseschnittstelle fuer Fehlerpfad Dfp_RailPCV3" VAL_BLK 0xCC99A Kwb_Wu8 255.0 OneToOne 0.00 255.0 FORMAT "%5.1" NUMBER 4 /end CHARACTERISTIC
/begin CHARACTERISTIC DSM_TypDfp_RailPCV4_C "Konvertierung der Fehlertypen auf der Diagnoseschnittstelle fuer Fehlerpfad Dfp_RailPCV4" VAL_BLK 0xCC99E Kwb_Wu8 255.0 OneToOne 0.00 255.0 FORMAT "%5.1" NUMBER 4 /end CHARACTERISTIC
/begin CHARACTERISTIC DSM_TypDfp_RailPCV5_C "Konvertierung der Fehlertypen auf der Diagnoseschnittstelle fuer Fehlerpfad Dfp_RailPCV5" VAL_BLK 0xCC9A2 Kwb_Wu8 255.0 OneToOne 0.00 255.0 FORMAT "%5.1" NUMBER 4 /end CHARACTERISTIC
/begin CHARACTERISTIC DSM_TypDfp_SOPTst_C "Konvertierung der Fehlertypen auf der Diagnoseschnittstelle fuer Fehlerpfad Dfp_SOPTst" VAL_BLK 0xCC9A6 Kwb_Wu8 255.0 OneToOne 0.00 255.0 FORMAT "%5.1" NUMBER 4 /end CHARACTERISTIC
/begin CHARACTERISTIC DSM_TypDfp_SSpMon1_C "Konvertierung der Fehlertypen auf der Diagnoseschnittstelle fuer Fehlerpfad Dfp_SSpMon1" VAL_BLK 0xCC9AA Kwb_Wu8 255.0 OneToOne 0.00 255.0 FORMAT "%5.1" NUMBER 4 /end CHARACTERISTIC
/begin CHARACTERISTIC DSM_TypDfp_SSpMon2_C "Konvertierung der Fehlertypen auf der Diagnoseschnittstelle fuer Fehlerpfad Dfp_SSpMon2" VAL_BLK 0xCC9AE Kwb_Wu8 255.0 OneToOne 0.00 255.0 FORMAT "%5.1" NUMBER 4 /end CHARACTERISTIC
/begin CHARACTERISTIC DSM_TypDfp_SSpMon3_C "Konvertierung der Fehlertypen auf der Diagnoseschnittstelle fuer Fehlerpfad Dfp_SSpMon3" VAL_BLK 0xCC9B2 Kwb_Wu8 255.0 OneToOne 0.00 255.0 FORMAT "%5.1" NUMBER 4 /end CHARACTERISTIC
/begin CHARACTERISTIC DSM_TypDfp_SWChk_CycSigChkDat_C "Konvertierung der Fehlertypen auf der Diagnoseschnittstelle fuer Fehlerpfad Dfp_SWChk_CycSigChkDat" VAL_BLK 0xCC9B6 Kwb_Wu8 255.0 OneToOne 0.00 255.0 FORMAT "%5.1" NUMBER 4 /end CHARACTERISTIC
/begin CHARACTERISTIC DSM_TypDfp_SWChk_CycSigChkPrg_C "Konvertierung der Fehlertypen auf der Diagnoseschnittstelle fuer Fehlerpfad Dfp_SWChk_CycSigChkPrg" VAL_BLK 0xCC9BA Kwb_Wu8 255.0 OneToOne 0.00 255.0 FORMAT "%5.1" NUMBER 4 /end CHARACTERISTIC
/begin CHARACTERISTIC DSM_TypDfp_ShutCD_C "Konvertierung der Fehlertypen auf der Diagnoseschnittstelle fuer Fehlerpfad Dfp_ShutCD" VAL_BLK 0xCC9BE Kwb_Wu8 255.0 OneToOne 0.00 255.0 FORMAT "%5.1" NUMBER 4 /end CHARACTERISTIC
/begin CHARACTERISTIC DSM_TypDfp_StSysTrqShutOff_C "Konvertierung der Fehlertypen auf der Diagnoseschnittstelle fuer Fehlerpfad Dfp_StSysTrqShutOff" VAL_BLK 0xCC9C2 Kwb_Wu8 255.0 OneToOne 0.00 255.0 FORMAT "%5.1" NUMBER 4 /end CHARACTERISTIC
/begin CHARACTERISTIC DSM_TypDfp_StrtCD_Actr_C "Konvertierung der Fehlertypen auf der Diagnoseschnittstelle fuer Fehlerpfad Dfp_StrtCD_Actr" VAL_BLK 0xCC9C6 Kwb_Wu8 255.0 OneToOne 0.00 255.0 FORMAT "%5.1" NUMBER 4 /end CHARACTERISTIC
/begin CHARACTERISTIC DSM_TypDfp_SysLamp_C "Konvertierung der Fehlertypen auf der Diagnoseschnittstelle fuer Fehlerpfad Dfp_SysLamp" VAL_BLK 0xCC9CA Kwb_Wu8 255.0 OneToOne 0.00 255.0 FORMAT "%5.1" NUMBER 4 /end CHARACTERISTIC
/begin CHARACTERISTIC DSM_TypDfp_T15CD_C "Konvertierung der Fehlertypen auf der Diagnoseschnittstelle fuer Fehlerpfad Dfp_T15CD" VAL_BLK 0xCC9CE Kwb_Wu8 255.0 OneToOne 0.00 255.0 FORMAT "%5.1" NUMBER 4 /end CHARACTERISTIC
/begin CHARACTERISTIC DSM_TypDfp_TGearbx_C "Konvertierung der Fehlertypen auf der Diagnoseschnittstelle fuer Fehlerpfad Dfp_TGearbx" VAL_BLK 0xCC9D2 Kwb_Wu8 255.0 OneToOne 0.00 255.0 FORMAT "%5.1" NUMBER 4 /end CHARACTERISTIC
/begin CHARACTERISTIC DSM_TypDfp_TPUMon_C "Konvertierung der Fehlertypen auf der Diagnoseschnittstelle fuer Fehlerpfad Dfp_TPUMon" VAL_BLK 0xCC9D6 Kwb_Wu8 255.0 OneToOne 0.00 255.0 FORMAT "%5.1" NUMBER 4 /end CHARACTERISTIC
/begin CHARACTERISTIC DSM_TypDfp_TVACD_Max_C "Konvertierung der Fehlertypen auf der Diagnoseschnittstelle fuer Fehlerpfad Dfp_TVACD_Max" VAL_BLK 0xCC9DA Kwb_Wu8 255.0 OneToOne 0.00 255.0 FORMAT "%5.1" NUMBER 4 /end CHARACTERISTIC
/begin CHARACTERISTIC DSM_TypDfp_TVACD_Min_C "Konvertierung der Fehlertypen auf der Diagnoseschnittstelle fuer Fehlerpfad Dfp_TVACD_Min" VAL_BLK 0xCC9DE Kwb_Wu8 255.0 OneToOne 0.00 255.0 FORMAT "%5.1" NUMBER 4 /end CHARACTERISTIC
/begin CHARACTERISTIC DSM_TypDfp_TVACD_SigNpl_C "Konvertierung der Fehlertypen auf der Diagnoseschnittstelle fuer Fehlerpfad Dfp_TVACD_SigNpl" VAL_BLK 0xCC9E2 Kwb_Wu8 255.0 OneToOne 0.00 255.0 FORMAT "%5.1" NUMBER 4 /end CHARACTERISTIC
/begin CHARACTERISTIC DSM_TypDfp_TVACD_TVADia1_C "Konvertierung der Fehlertypen auf der Diagnoseschnittstelle fuer Fehlerpfad Dfp_TVACD_TVADia1" VAL_BLK 0xCC9E6 Kwb_Wu8 255.0 OneToOne 0.00 255.0 FORMAT "%5.1" NUMBER 4 /end CHARACTERISTIC
/begin CHARACTERISTIC DSM_TypDfp_TVACD_TVADia2_C "Konvertierung der Fehlertypen auf der Diagnoseschnittstelle fuer Fehlerpfad Dfp_TVACD_TVADia2" VAL_BLK 0xCC9EA Kwb_Wu8 255.0 OneToOne 0.00 255.0 FORMAT "%5.1" NUMBER 4 /end CHARACTERISTIC
/begin CHARACTERISTIC DSM_TypDfp_TVACD_TVADia3_C "Konvertierung der Fehlertypen auf der Diagnoseschnittstelle fuer Fehlerpfad Dfp_TVACD_TVADia3" VAL_BLK 0xCC9EE Kwb_Wu8 255.0 OneToOne 0.00 255.0 FORMAT "%5.1" NUMBER 4 /end CHARACTERISTIC
/begin CHARACTERISTIC DSM_TypDfp_TVACD_TVADia4_C "Konvertierung der Fehlertypen auf der Diagnoseschnittstelle fuer Fehlerpfad Dfp_TVACD_TVADia4" VAL_BLK 0xCC9F2 Kwb_Wu8 255.0 OneToOne 0.00 255.0 FORMAT "%5.1" NUMBER 4 /end CHARACTERISTIC
/begin CHARACTERISTIC DSM_TypDfp_VSACD_DioInDia1_C "Konvertierung der Fehlertypen auf der Diagnoseschnittstelle fuer Fehlerpfad Dfp_VSACD_DioInDia1" VAL_BLK 0xCC9F6 Kwb_Wu8 255.0 OneToOne 0.00 255.0 FORMAT "%5.1" NUMBER 4 /end CHARACTERISTIC
/begin CHARACTERISTIC DSM_TypDfp_VSACD_DioInDia2_C "Konvertierung der Fehlertypen auf der Diagnoseschnittstelle fuer Fehlerpfad Dfp_VSACD_DioInDia2" VAL_BLK 0xCC9FA Kwb_Wu8 255.0 OneToOne 0.00 255.0 FORMAT "%5.1" NUMBER 4 /end CHARACTERISTIC
/begin CHARACTERISTIC DSM_TypDfp_VSACD_DioInDia3_C "Konvertierung der Fehlertypen auf der Diagnoseschnittstelle fuer Fehlerpfad Dfp_VSACD_DioInDia3" VAL_BLK 0xCC9FE Kwb_Wu8 255.0 OneToOne 0.00 255.0 FORMAT "%5.1" NUMBER 4 /end CHARACTERISTIC
/begin CHARACTERISTIC DSM_TypDfp_VSACD_DioInDia4_C "Konvertierung der Fehlertypen auf der Diagnoseschnittstelle fuer Fehlerpfad Dfp_VSACD_DioInDia4" VAL_BLK 0xCCA02 Kwb_Wu8 255.0 OneToOne 0.00 255.0 FORMAT "%5.1" NUMBER 4 /end CHARACTERISTIC
/begin CHARACTERISTIC DSM_TypDfp_VSACD_DioInMin_C "Konvertierung der Fehlertypen auf der Diagnoseschnittstelle fuer Fehlerpfad Dfp_VSACD_DioInMin" VAL_BLK 0xCCA06 Kwb_Wu8 255.0 OneToOne 0.00 255.0 FORMAT "%5.1" NUMBER 4 /end CHARACTERISTIC
/begin CHARACTERISTIC DSM_TypDfp_VSACD_Max_C "Konvertierung der Fehlertypen auf der Diagnoseschnittstelle fuer Fehlerpfad Dfp_VSACD_Max" VAL_BLK 0xCCA0A Kwb_Wu8 255.0 OneToOne 0.00 255.0 FORMAT "%5.1" NUMBER 4 /end CHARACTERISTIC
/begin CHARACTERISTIC DSM_TypDfp_VSACD_Min_C "Konvertierung der Fehlertypen auf der Diagnoseschnittstelle fuer Fehlerpfad Dfp_VSACD_Min" VAL_BLK 0xCCA0E Kwb_Wu8 255.0 OneToOne 0.00 255.0 FORMAT "%5.1" NUMBER 4 /end CHARACTERISTIC
/begin CHARACTERISTIC DSM_TypDfp_VSACD_SigNpl_C "Konvertierung der Fehlertypen auf der Diagnoseschnittstelle fuer Fehlerpfad Dfp_VSACD_SigNpl" VAL_BLK 0xCCA12 Kwb_Wu8 255.0 OneToOne 0.00 255.0 FORMAT "%5.1" NUMBER 4 /end CHARACTERISTIC
/begin CHARACTERISTIC DSM_TypDfp_VSACD_VSADia1_C "Konvertierung der Fehlertypen auf der Diagnoseschnittstelle fuer Fehlerpfad Dfp_VSACD_VSADia1" VAL_BLK 0xCCA16 Kwb_Wu8 255.0 OneToOne 0.00 255.0 FORMAT "%5.1" NUMBER 4 /end CHARACTERISTIC
/begin CHARACTERISTIC DSM_TypDfp_VSACD_VSADia2_C "Konvertierung der Fehlertypen auf der Diagnoseschnittstelle fuer Fehlerpfad Dfp_VSACD_VSADia2" VAL_BLK 0xCCA1A Kwb_Wu8 255.0 OneToOne 0.00 255.0 FORMAT "%5.1" NUMBER 4 /end CHARACTERISTIC
/begin CHARACTERISTIC DSM_TypDfp_VSACD_VSADia3_C "Konvertierung der Fehlertypen auf der Diagnoseschnittstelle fuer Fehlerpfad Dfp_VSACD_VSADia3" VAL_BLK 0xCCA1E Kwb_Wu8 255.0 OneToOne 0.00 255.0 FORMAT "%5.1" NUMBER 4 /end CHARACTERISTIC
/begin CHARACTERISTIC DSM_TypDfp_VSACD_VSADia4_C "Konvertierung der Fehlertypen auf der Diagnoseschnittstelle fuer Fehlerpfad Dfp_VSACD_VSADia4" VAL_BLK 0xCCA22 Kwb_Wu8 255.0 OneToOne 0.00 255.0 FORMAT "%5.1" NUMBER 4 /end CHARACTERISTIC
/begin CHARACTERISTIC DSM_TypDfp_VSSCD1_C "Konvertierung der Fehlertypen auf der Diagnoseschnittstelle fuer Fehlerpfad Dfp_VSSCD1" VAL_BLK 0xCCA26 Kwb_Wu8 255.0 OneToOne 0.00 255.0 FORMAT "%5.1" NUMBER 4 /end CHARACTERISTIC
/begin CHARACTERISTIC DSM_TypDfp_VSSCD2_C "Konvertierung der Fehlertypen auf der Diagnoseschnittstelle fuer Fehlerpfad Dfp_VSSCD2" VAL_BLK 0xCCA2A Kwb_Wu8 255.0 OneToOne 0.00 255.0 FORMAT "%5.1" NUMBER 4 /end CHARACTERISTIC
/begin CHARACTERISTIC DSM_TypDfp_WdCom_C "Konvertierung der Fehlertypen auf der Diagnoseschnittstelle fuer Fehlerpfad Dfp_WdCom" VAL_BLK 0xCCA2E Kwb_Wu8 255.0 OneToOne 0.00 255.0 FORMAT "%5.1" NUMBER 4 /end CHARACTERISTIC
/begin CHARACTERISTIC DSM_TsfDfp_Layer_TANS_C "Schwerezaehlergrenze fuer Fehlerpfad Dfp_Layer_TANS" VALUE 0xCCA32 Kw_Wu8 51000. TimeDsmTsf 0.00 51000. FORMAT "%5.0" /end CHARACTERISTIC
/begin CHARACTERISTIC DSM_TsfDfp_ACCDCmpr_C "Schwerezaehlergrenze fuer Fehlerpfad Dfp_ACCDCmpr" VALUE 0xCCA33 Kw_Wu8 51000. TimeDsmTsf 0.00 51000. FORMAT "%5.0" /end CHARACTERISTIC
/begin CHARACTERISTIC DSM_TsfDfp_ACCDPres_C "Schwerezaehlergrenze fuer Fehlerpfad Dfp_ACCDPres" VALUE 0xCCA34 Kw_Wu8 51000. TimeDsmTsf 0.00 51000. FORMAT "%5.0" /end CHARACTERISTIC
/begin CHARACTERISTIC DSM_TsfDfp_ACCDPres1_C "Schwerezaehlergrenze fuer Fehlerpfad Dfp_ACCDPres1" VALUE 0xCCA35 Kw_Wu8 51000. TimeDsmTsf 0.00 51000. FORMAT "%5.0" /end CHARACTERISTIC
/begin CHARACTERISTIC DSM_TsfDfp_ACCDPresAna_C "Schwerezaehlergrenze fuer Fehlerpfad Dfp_ACCDPresAna" VALUE 0xCCA36 Kw_Wu8 51000. TimeDsmTsf 0.00 51000. FORMAT "%5.0" /end CHARACTERISTIC
/begin CHARACTERISTIC DSM_TsfDfp_ACCDSwtin_C "Schwerezaehlergrenze fuer Fehlerpfad Dfp_ACCDSwtin" VALUE 0xCCA37 Kw_Wu8 51000. TimeDsmTsf 0.00 51000. FORMAT "%5.0" /end CHARACTERISTIC
/begin CHARACTERISTIC DSM_TsfDfp_ACC_PlausTrqDes_C "Schwerezaehlergrenze fuer Fehlerpfad Dfp_ACC_PlausTrqDes" VALUE 0xCCA38 Kw_Wu8 51000. TimeDsmTsf 0.00 51000. FORMAT "%5.0" /end CHARACTERISTIC
/begin CHARACTERISTIC DSM_TsfDfp_ACC_trqInr_C "Schwerezaehlergrenze fuer Fehlerpfad Dfp_ACC_trqInr" VALUE 0xCCA39 Kw_Wu8 51000. TimeDsmTsf 0.00 51000. FORMAT "%5.0" /end CHARACTERISTIC
/begin CHARACTERISTIC DSM_TsfDfp_ACTrq_C "Schwerezaehlergrenze fuer Fehlerpfad Dfp_ACTrq" VALUE 0xCCA3A Kw_Wu8 51000. TimeDsmTsf 0.00 51000. FORMAT "%5.0" /end CHARACTERISTIC
/begin CHARACTERISTIC DSM_TsfDfp_ADCMon_C "Schwerezaehlergrenze fuer Fehlerpfad Dfp_ADCMon" VALUE 0xCCA3B Kw_Wu8 51000. TimeDsmTsf 0.00 51000. FORMAT "%5.0" /end CHARACTERISTIC
/begin CHARACTERISTIC DSM_TsfDfp_AFSCDIdlAdjVal_C "Schwerezaehlergrenze fuer Fehlerpfad Dfp_AFSCDIdlAdjVal" VALUE 0xCCA3C Kw_Wu8 51000. TimeDsmTsf 0.00 51000. FORMAT "%5.0" /end CHARACTERISTIC
/begin CHARACTERISTIC DSM_TsfDfp_AFSCDLdAdjVal_C "Schwerezaehlergrenze fuer Fehlerpfad Dfp_AFSCDLdAdjVal" VALUE 0xCCA3D Kw_Wu8 51000. TimeDsmTsf 0.00 51000. FORMAT "%5.0" /end CHARACTERISTIC
/begin CHARACTERISTIC DSM_TsfDfp_AFSCD_AirTempDcyc_C "Schwerezaehlergrenze fuer Fehlerpfad Dfp_AFSCD_AirTempDcyc" VALUE 0xCCA3E Kw_Wu8 51000. TimeDsmTsf 0.00 51000. FORMAT "%5.0" /end CHARACTERISTIC
/begin CHARACTERISTIC DSM_TsfDfp_AFSCD_PlOffsDrft_C "Schwerezaehlergrenze fuer Fehlerpfad Dfp_AFSCD_PlOffsDrft" VALUE 0xCCA3F Kw_Wu8 51000. TimeDsmTsf 0.00 51000. FORMAT "%5.0" /end CHARACTERISTIC
/begin CHARACTERISTIC DSM_TsfDfp_AFSCD_PlSetyDrft_C "Schwerezaehlergrenze fuer Fehlerpfad Dfp_AFSCD_PlSetyDrft" VALUE 0xCCA40 Kw_Wu8 51000. TimeDsmTsf 0.00 51000. FORMAT "%5.0" /end CHARACTERISTIC
/begin CHARACTERISTIC DSM_TsfDfp_AFSCD_SRCAirTemp_C "Schwerezaehlergrenze fuer Fehlerpfad Dfp_AFSCD_SRCAirTemp" VALUE 0xCCA41 Kw_Wu8 51000. TimeDsmTsf 0.00 51000. FORMAT "%5.0" /end CHARACTERISTIC
/begin CHARACTERISTIC DSM_TsfDfp_AFSCD_SRCBatt_C "Schwerezaehlergrenze fuer Fehlerpfad Dfp_AFSCD_SRCBatt" VALUE 0xCCA42 Kw_Wu8 51000. TimeDsmTsf 0.00 51000. FORMAT "%5.0" /end CHARACTERISTIC
/begin CHARACTERISTIC DSM_TsfDfp_AFSCD_SRCCorrAirm_C "Schwerezaehlergrenze fuer Fehlerpfad Dfp_AFSCD_SRCCorrAirm" VALUE 0xCCA43 Kw_Wu8 51000. TimeDsmTsf 0.00 51000. FORMAT "%5.0" /end CHARACTERISTIC
/begin CHARACTERISTIC DSM_TsfDfp_AFSCD_SRCRawAirm_C "Schwerezaehlergrenze fuer Fehlerpfad Dfp_AFSCD_SRCRawAirm" VALUE 0xCCA44 Kw_Wu8 51000. TimeDsmTsf 0.00 51000. FORMAT "%5.0" /end CHARACTERISTIC
/begin CHARACTERISTIC DSM_TsfDfp_Layer_TUMG_C "Schwerezaehlergrenze fuer Fehlerpfad Dfp_Layer_TUMG" VALUE 0xCCA45 Kw_Wu8 51000. TimeDsmTsf 0.00 51000. FORMAT "%5.0" /end CHARACTERISTIC
/begin CHARACTERISTIC DSM_TsfDfp_AFSCD_SRCRefSigPer_C "Schwerezaehlergrenze fuer Fehlerpfad Dfp_AFSCD_SRCRefSigPer" VALUE 0xCCA46 Kw_Wu8 51000. TimeDsmTsf 0.00 51000. FORMAT "%5.0" /end CHARACTERISTIC
/begin CHARACTERISTIC DSM_TsfDfp_AOHtCD_C "Schwerezaehlergrenze fuer Fehlerpfad Dfp_AOHtCD" VALUE 0xCCA47 Kw_Wu8 51000. TimeDsmTsf 0.00 51000. FORMAT "%5.0" /end CHARACTERISTIC
/begin CHARACTERISTIC DSM_TsfDfp_Layer_GEN_C "Schwerezaehlergrenze fuer Fehlerpfad Dfp_Layer_GEN" VALUE 0xCCA48 Kw_Wu8 51000. TimeDsmTsf 0.00 51000. FORMAT "%5.0" /end CHARACTERISTIC
/begin CHARACTERISTIC DSM_TsfDfp_Layer_BSD_C "Schwerezaehlergrenze fuer Fehlerpfad Dfp_Layer_BSD" VALUE 0xCCA49 Kw_Wu8 51000. TimeDsmTsf 0.00 51000. FORMAT "%5.0" /end CHARACTERISTIC
/begin CHARACTERISTIC DSM_TsfDfp_AOHtCD_AOHtDia1_C "Schwerezaehlergrenze fuer Fehlerpfad Dfp_AOHtCD_AOHtDia1" VALUE 0xCCA4A Kw_Wu8 51000. TimeDsmTsf 0.00 51000. FORMAT "%5.0" /end CHARACTERISTIC
/begin CHARACTERISTIC DSM_TsfDfp_AOHtCD_AOHtDia2_C "Schwerezaehlergrenze fuer Fehlerpfad Dfp_AOHtCD_AOHtDia2" VALUE 0xCCA4B Kw_Wu8 51000. TimeDsmTsf 0.00 51000. FORMAT "%5.0" /end CHARACTERISTIC
/begin CHARACTERISTIC DSM_TsfDfp_AOHtCD_AOHtDia3_C "Schwerezaehlergrenze fuer Fehlerpfad Dfp_AOHtCD_AOHtDia3" VALUE 0xCCA4C Kw_Wu8 51000. TimeDsmTsf 0.00 51000. FORMAT "%5.0" /end CHARACTERISTIC
/begin CHARACTERISTIC DSM_TsfDfp_APP1_C "Schwerezaehlergrenze fuer Fehlerpfad Dfp_APP1" VALUE 0xCCA4D Kw_Wu8 51000. TimeDsmTsf 0.00 51000. FORMAT "%5.0" /end CHARACTERISTIC
/begin CHARACTERISTIC DSM_TsfDfp_APP2_C "Schwerezaehlergrenze fuer Fehlerpfad Dfp_APP2" VALUE 0xCCA4E Kw_Wu8 51000. TimeDsmTsf 0.00 51000. FORMAT "%5.0" /end CHARACTERISTIC
/begin CHARACTERISTIC DSM_TsfDfp_APPSync_C "Schwerezaehlergrenze fuer Fehlerpfad Dfp_APPSync" VALUE 0xCCA4F Kw_Wu8 51000. TimeDsmTsf 0.00 51000. FORMAT "%5.0" /end CHARACTERISTIC
/begin CHARACTERISTIC DSM_TsfDfp_APSCD_C "Schwerezaehlergrenze fuer Fehlerpfad Dfp_APSCD" VALUE 0xCCA50 Kw_Wu8 51000. TimeDsmTsf 0.00 51000. FORMAT "%5.0" /end CHARACTERISTIC
/begin CHARACTERISTIC DSM_TsfDfp_ARS_C "Schwerezaehlergrenze fuer Fehlerpfad Dfp_ARS" VALUE 0xCCA51 Kw_Wu8 51000. TimeDsmTsf 0.00 51000. FORMAT "%5.0" /end CHARACTERISTIC
/begin CHARACTERISTIC DSM_TsfDfp_AccPedPlausBrk_C "Schwerezaehlergrenze fuer Fehlerpfad Dfp_AccPedPlausBrk" VALUE 0xCCA52 Kw_Wu8 51000. TimeDsmTsf 0.00 51000. FORMAT "%5.0" /end CHARACTERISTIC
/begin CHARACTERISTIC DSM_TsfDfp_AirCtlPlateBreak_C "DSM variable for Dfp_AirCtlPlateBreak_mp" VALUE 0xCCA53 Kw_Wu8 51000. TimeDsmTsf 0.00 51000. FORMAT "%5.0" /end CHARACTERISTIC
/begin CHARACTERISTIC DSM_TsfDfp_Layer_QLT_C "Schwerezaehlergrenze fuer Fehlerpfad Dfp_Layer_QLT" VALUE 0xCCA54 Kw_Wu8 51000. TimeDsmTsf 0.00 51000. FORMAT "%5.0" /end CHARACTERISTIC
/begin CHARACTERISTIC DSM_TsfDfp_AirCtl_GovNegDev_C "Schwerezaehlergrenze fuer Fehlerpfad Dfp_AirCtl_GovNegDev" VALUE 0xCCA55 Kw_Wu8 51000. TimeDsmTsf 0.00 51000. FORMAT "%5.0" /end CHARACTERISTIC
/begin CHARACTERISTIC DSM_TsfDfp_Layer_IBS1_C "Schwerezaehlergrenze fuer Fehlerpfad Dfp_Layer_IBS1" VALUE 0xCCA56 Kw_Wu8 51000. TimeDsmTsf 0.00 51000. FORMAT "%5.0" /end CHARACTERISTIC
/begin CHARACTERISTIC DSM_TsfDfp_Layer_IBS2_C "Schwerezaehlergrenze fuer Fehlerpfad Dfp_Layer_IBS2" VALUE 0xCCA57 Kw_Wu8 51000. TimeDsmTsf 0.00 51000. FORMAT "%5.0" /end CHARACTERISTIC
/begin CHARACTERISTIC DSM_TsfDfp_Layer_IBS3_C "Schwerezaehlergrenze fuer Fehlerpfad Dfp_Layer_IBS3" VALUE 0xCCA58 Kw_Wu8 51000. TimeDsmTsf 0.00 51000. FORMAT "%5.0" /end CHARACTERISTIC
/begin CHARACTERISTIC DSM_TsfDfp_Layer_PMBN_C "Schwerezaehlergrenze fuer Fehlerpfad Dfp_Layer_PMBN" VALUE 0xCCA59 Kw_Wu8 51000. TimeDsmTsf 0.00 51000. FORMAT "%5.0" /end CHARACTERISTIC
/begin CHARACTERISTIC DSM_TsfDfp_Layer_PMBATT_C "Schwerezaehlergrenze fuer Fehlerpfad Dfp_Layer_PMBATT" VALUE 0xCCA5A Kw_Wu8 51000. TimeDsmTsf 0.00 51000. FORMAT "%5.0" /end CHARACTERISTIC
/begin CHARACTERISTIC DSM_TsfDfp_AirCtl_GovNegDev2_C "Schwerezaehlergrenze fuer Fehlerpfad Dfp_AirCtl_GovNegDev2" VALUE 0xCCA5B Kw_Wu8 51000. TimeDsmTsf 0.00 51000. FORMAT "%5.0" /end CHARACTERISTIC
/begin CHARACTERISTIC DSM_TsfDfp_AirCtl_GovPosDev_C "Schwerezaehlergrenze fuer Fehlerpfad Dfp_AirCtl_GovPosDev" VALUE 0xCCA5C Kw_Wu8 51000. TimeDsmTsf 0.00 51000. FORMAT "%5.0" /end CHARACTERISTIC
/begin CHARACTERISTIC DSM_TsfDfp_AirCtl_GovPosDev2_C "Schwerezaehlergrenze fuer Fehlerpfad Dfp_AirCtl_GovPosDev2" VALUE 0xCCA5D Kw_Wu8 51000. TimeDsmTsf 0.00 51000. FORMAT "%5.0" /end CHARACTERISTIC
/begin CHARACTERISTIC DSM_TsfDfp_AltCD_C "Schwerezaehlergrenze fuer Fehlerpfad Dfp_AltCD" VALUE 0xCCA5E Kw_Wu8 51000. TimeDsmTsf 0.00 51000. FORMAT "%5.0" /end CHARACTERISTIC
/begin CHARACTERISTIC DSM_TsfDfp_AltCD_Load_C "Schwerezaehlergrenze fuer Fehlerpfad Dfp_AltCD_Load" VALUE 0xCCA5F Kw_Wu8 51000. TimeDsmTsf 0.00 51000. FORMAT "%5.0" /end CHARACTERISTIC
/begin CHARACTERISTIC DSM_TsfDfp_BPACD_BPADia1_C "Schwerezaehlergrenze fuer Fehlerpfad Dfp_BPACD_BPADia1" VALUE 0xCCA60 Kw_Wu8 51000. TimeDsmTsf 0.00 51000. FORMAT "%5.0" /end CHARACTERISTIC
/begin CHARACTERISTIC DSM_TsfDfp_BPACD_BPADia2_C "Schwerezaehlergrenze fuer Fehlerpfad Dfp_BPACD_BPADia2" VALUE 0xCCA61 Kw_Wu8 51000. TimeDsmTsf 0.00 51000. FORMAT "%5.0" /end CHARACTERISTIC
/begin CHARACTERISTIC DSM_TsfDfp_BPACD_BPADia3_C "Schwerezaehlergrenze fuer Fehlerpfad Dfp_BPACD_BPADia3" VALUE 0xCCA62 Kw_Wu8 51000. TimeDsmTsf 0.00 51000. FORMAT "%5.0" /end CHARACTERISTIC
/begin CHARACTERISTIC DSM_TsfDfp_BPACD_Max_C "Schwerezaehlergrenze fuer Fehlerpfad Dfp_BPACD_Max" VALUE 0xCCA63 Kw_Wu8 51000. TimeDsmTsf 0.00 51000. FORMAT "%5.0" /end CHARACTERISTIC
/begin CHARACTERISTIC DSM_TsfDfp_BPACD_Min_C "Schwerezaehlergrenze fuer Fehlerpfad Dfp_BPACD_Min" VALUE 0xCCA64 Kw_Wu8 51000. TimeDsmTsf 0.00 51000. FORMAT "%5.0" /end CHARACTERISTIC
/begin CHARACTERISTIC DSM_TsfDfp_BPACD_SigNpl_C "Schwerezaehlergrenze fuer Fehlerpfad Dfp_BPACD_SigNpl" VALUE 0xCCA65 Kw_Wu8 51000. TimeDsmTsf 0.00 51000. FORMAT "%5.0" /end CHARACTERISTIC
/begin CHARACTERISTIC DSM_TsfDfp_BPSCD_C "Schwerezaehlergrenze fuer Fehlerpfad Dfp_BPSCD" VALUE 0xCCA66 Kw_Wu8 51000. TimeDsmTsf 0.00 51000. FORMAT "%5.0" /end CHARACTERISTIC
/begin CHARACTERISTIC DSM_TsfDfp_BattCD_C "Schwerezaehlergrenze fuer Fehlerpfad Dfp_BattCD" VALUE 0xCCA67 Kw_Wu8 51000. TimeDsmTsf 0.00 51000. FORMAT "%5.0" /end CHARACTERISTIC
/begin CHARACTERISTIC DSM_TsfDfp_BrkCD_C "Schwerezaehlergrenze fuer Fehlerpfad Dfp_BrkCD" VALUE 0xCCA68 Kw_Wu8 51000. TimeDsmTsf 0.00 51000. FORMAT "%5.0" /end CHARACTERISTIC
/begin CHARACTERISTIC DSM_TsfDfp_Bss_C "Schwerezaehlergrenze fuer Fehlerpfad Dfp_Bss" VALUE 0xCCA69 Kw_Wu8 51000. TimeDsmTsf 0.00 51000. FORMAT "%5.0" /end CHARACTERISTIC
/begin CHARACTERISTIC DSM_TsfDfp_CBACD_C "Schwerezaehlergrenze fuer Fehlerpfad Dfp_CBACD" VALUE 0xCCA6A Kw_Wu8 51000. TimeDsmTsf 0.00 51000. FORMAT "%5.0" /end CHARACTERISTIC
/begin CHARACTERISTIC DSM_TsfDfp_CTSCD_C "Schwerezaehlergrenze fuer Fehlerpfad Dfp_CTSCD" VALUE 0xCCA6B Kw_Wu8 51000. TimeDsmTsf 0.00 51000. FORMAT "%5.0" /end CHARACTERISTIC
/begin CHARACTERISTIC DSM_TsfDfp_Clg_DynTst_C "Schwerezaehlergrenze fuer Fehlerpfad Dfp_Clg_DynTst" VALUE 0xCCA6C Kw_Wu8 51000. TimeDsmTsf 0.00 51000. FORMAT "%5.0" /end CHARACTERISTIC
/begin CHARACTERISTIC DSM_TsfDfp_CmbChbMisfire1_C "Schwerezaehlergrenze fuer Fehlerpfad Dfp_CmbChbMisfire1" VALUE 0xCCA6D Kw_Wu8 51000. TimeDsmTsf 0.00 51000. FORMAT "%5.0" /end CHARACTERISTIC
/begin CHARACTERISTIC DSM_TsfDfp_CmbChbMisfire2_C "Schwerezaehlergrenze fuer Fehlerpfad Dfp_CmbChbMisfire2" VALUE 0xCCA6E Kw_Wu8 51000. TimeDsmTsf 0.00 51000. FORMAT "%5.0" /end CHARACTERISTIC
/begin CHARACTERISTIC DSM_TsfDfp_CmbChbMisfire3_C "Schwerezaehlergrenze fuer Fehlerpfad Dfp_CmbChbMisfire3" VALUE 0xCCA6F Kw_Wu8 51000. TimeDsmTsf 0.00 51000. FORMAT "%5.0" /end CHARACTERISTIC
/begin CHARACTERISTIC DSM_TsfDfp_CmbChbMisfire4_C "Schwerezaehlergrenze fuer Fehlerpfad Dfp_CmbChbMisfire4" VALUE 0xCCA70 Kw_Wu8 51000. TimeDsmTsf 0.00 51000. FORMAT "%5.0" /end CHARACTERISTIC
/begin CHARACTERISTIC DSM_TsfDfp_CmbChbMisfire5_C "Schwerezaehlergrenze fuer Fehlerpfad Dfp_CmbChbMisfire5" VALUE 0xCCA71 Kw_Wu8 51000. TimeDsmTsf 0.00 51000. FORMAT "%5.0" /end CHARACTERISTIC
/begin CHARACTERISTIC DSM_TsfDfp_CmbChbMisfire6_C "Schwerezaehlergrenze fuer Fehlerpfad Dfp_CmbChbMisfire6" VALUE 0xCCA72 Kw_Wu8 51000. TimeDsmTsf 0.00 51000. FORMAT "%5.0" /end CHARACTERISTIC
/begin CHARACTERISTIC DSM_TsfDfp_CmbChbMisfireMul_C "Schwerezaehlergrenze fuer Fehlerpfad Dfp_CmbChbMisfireMul" VALUE 0xCCA73 Kw_Wu8 51000. TimeDsmTsf 0.00 51000. FORMAT "%5.0" /end CHARACTERISTIC
/begin CHARACTERISTIC DSM_TsfDfp_CoVMDCSh_C "Schwerezaehlergrenze fuer Fehlerpfad Dfp_CoVMDCSh" VALUE 0xCCA74 Kw_Wu8 51000. TimeDsmTsf 0.00 51000. FORMAT "%5.0" /end CHARACTERISTIC
/begin CHARACTERISTIC DSM_TsfDfp_ConvCD_C "Schwerezaehlergrenze fuer Fehlerpfad Dfp_ConvCD" VALUE 0xCCA75 Kw_Wu8 51000. TimeDsmTsf 0.00 51000. FORMAT "%5.0" /end CHARACTERISTIC
/begin CHARACTERISTIC DSM_TsfDfp_CrCCDMFL_C "Schwerezaehlergrenze fuer Fehlerpfad Dfp_CrCCDMFL" VALUE 0xCCA76 Kw_Wu8 51000. TimeDsmTsf 0.00 51000. FORMAT "%5.0" /end CHARACTERISTIC
/begin CHARACTERISTIC DSM_TsfDfp_CrCtl_vCrCtl_C "Schwerezaehlergrenze fuer Fehlerpfad Dfp_CrCtl_vCrCtl" VALUE 0xCCA77 Kw_Wu8 51000. TimeDsmTsf 0.00 51000. FORMAT "%5.0" /end CHARACTERISTIC
/begin CHARACTERISTIC DSM_TsfDfp_Dummy1_C "Schwerezaehlergrenze fuer Fehlerpfad Dfp_Dummy1" VALUE 0xCCA78 Kw_Wu8 51000. TimeDsmTsf 0.00 51000. FORMAT "%5.0" /end CHARACTERISTIC
/begin CHARACTERISTIC DSM_TsfDfp_EATSCD_C "Schwerezaehlergrenze fuer Fehlerpfad Dfp_EATSCD" VALUE 0xCCA79 Kw_Wu8 51000. TimeDsmTsf 0.00 51000. FORMAT "%5.0" /end CHARACTERISTIC
/begin CHARACTERISTIC DSM_TsfDfp_EBAFCD_C "Schwerezaehlergrenze fuer Fehlerpfad Dfp_EBAFCD" VALUE 0xCCA7A Kw_Wu8 51000. TimeDsmTsf 0.00 51000. FORMAT "%5.0" /end CHARACTERISTIC
/begin CHARACTERISTIC DSM_TsfDfp_Layer_PMRUHVERL_C "Schwerezaehlergrenze fuer Fehlerpfad Dfp_Layer_PMRUHVERL" VALUE 0xCCA7B Kw_Wu8 51000. TimeDsmTsf 0.00 51000. FORMAT "%5.0" /end CHARACTERISTIC
/begin CHARACTERISTIC DSM_TsfDfp_EBFCD_C "Schwerezaehlergrenze fuer Fehlerpfad Dfp_EBFCD" VALUE 0xCCA7C Kw_Wu8 51000. TimeDsmTsf 0.00 51000. FORMAT "%5.0" /end CHARACTERISTIC
/begin CHARACTERISTIC DSM_TsfDfp_EBTSCD_C "Schwerezaehlergrenze fuer Fehlerpfad Dfp_EBTSCD" VALUE 0xCCA7D Kw_Wu8 51000. TimeDsmTsf 0.00 51000. FORMAT "%5.0" /end CHARACTERISTIC
/begin CHARACTERISTIC DSM_TsfDfp_EBTSCD_OvrTemp_C "Schwerezaehlergrenze fuer Fehlerpfad Dfp_EBTSCD_OvrTemp" VALUE 0xCCA7E Kw_Wu8 51000. TimeDsmTsf 0.00 51000. FORMAT "%5.0" /end CHARACTERISTIC
/begin CHARACTERISTIC DSM_TsfDfp_EEPCDVarMng_C "Schwerezaehlergrenze fuer Fehlerpfad Dfp_EEPCDVarMng" VALUE 0xCCA7F Kw_Wu8 51000. TimeDsmTsf 0.00 51000. FORMAT "%5.0" /end CHARACTERISTIC
/begin CHARACTERISTIC DSM_TsfDfp_Layer_TOENS_C "Schwerezaehlergrenze fuer Fehlerpfad Dfp_Layer_TOENS" VALUE 0xCCA80 Kw_Wu8 51000. TimeDsmTsf 0.00 51000. FORMAT "%5.0" /end CHARACTERISTIC
/begin CHARACTERISTIC DSM_TsfDfp_Layer_MANHYDR_C "Schwerezaehlergrenze fuer Fehlerpfad Dfp_Layer_MANHYDR" VALUE 0xCCA81 Kw_Wu8 51000. TimeDsmTsf 0.00 51000. FORMAT "%5.0" /end CHARACTERISTIC
/begin CHARACTERISTIC DSM_TsfDfp_Layer_MANLUFT_C "Schwerezaehlergrenze fuer Fehlerpfad Dfp_Layer_MANLUFT" VALUE 0xCCA82 Kw_Wu8 51000. TimeDsmTsf 0.00 51000. FORMAT "%5.0" /end CHARACTERISTIC
/begin CHARACTERISTIC DSM_TsfDfp_EGPpCD_C "Schwerezaehlergrenze fuer Fehlerpfad Dfp_EGPpCD" VALUE 0xCCA83 Kw_Wu8 51000. TimeDsmTsf 0.00 51000. FORMAT "%5.0" /end CHARACTERISTIC
/begin CHARACTERISTIC DSM_TsfDfp_EGPpCDTPreTrbn_C "Schwerezaehlergrenze fuer Fehlerpfad Dfp_EgPpCDTPreTrbn" VALUE 0xCCA84 Kw_Wu8 51000. TimeDsmTsf 0.00 51000. FORMAT "%5.0" /end CHARACTERISTIC
/begin CHARACTERISTIC DSM_TsfDfp_EGRCD_Max_C "Schwerezaehlergrenze fuer Fehlerpfad Dfp_EGRCD_Max" VALUE 0xCCA85 Kw_Wu8 51000. TimeDsmTsf 0.00 51000. FORMAT "%5.0" /end CHARACTERISTIC
/begin CHARACTERISTIC DSM_TsfDfp_EGRCD_Min_C "Schwerezaehlergrenze fuer Fehlerpfad Dfp_EGRCD_Min" VALUE 0xCCA86 Kw_Wu8 51000. TimeDsmTsf 0.00 51000. FORMAT "%5.0" /end CHARACTERISTIC
/begin CHARACTERISTIC DSM_TsfDfp_EGRCD_SigNpl_C "Schwerezaehlergrenze fuer Fehlerpfad Dfp_EGRCD_SigNpl" VALUE 0xCCA87 Kw_Wu8 51000. TimeDsmTsf 0.00 51000. FORMAT "%5.0" /end CHARACTERISTIC
/begin CHARACTERISTIC DSM_TsfDfp_EGTRgnOilDil_C "Schwerezaehlergrenze fuer Fehlerpfad Dfp_EGTRgnOilDil" VALUE 0xCCA88 Kw_Wu8 51000. TimeDsmTsf 0.00 51000. FORMAT "%5.0" /end CHARACTERISTIC
/begin CHARACTERISTIC DSM_TsfDfp_EMCCDNoLoad1_C "" VALUE 0xCCA89 Kw_Wu8 51000. TimeDsmTsf 0.00 51000. FORMAT "%5.0" /end CHARACTERISTIC
/begin CHARACTERISTIC DSM_TsfDfp_EMCCDNoLoad2_C "" VALUE 0xCCA8A Kw_Wu8 51000. TimeDsmTsf 0.00 51000. FORMAT "%5.0" /end CHARACTERISTIC
/begin CHARACTERISTIC DSM_TsfDfp_EMCCDSCBat1_C "" VALUE 0xCCA8B Kw_Wu8 51000. TimeDsmTsf 0.00 51000. FORMAT "%5.0" /end CHARACTERISTIC
/begin CHARACTERISTIC DSM_TsfDfp_EMCCDSCBat2_C "" VALUE 0xCCA8C Kw_Wu8 51000. TimeDsmTsf 0.00 51000. FORMAT "%5.0" /end CHARACTERISTIC
/begin CHARACTERISTIC DSM_TsfDfp_EMCCDSCGnd1_C "" VALUE 0xCCA8D Kw_Wu8 51000. TimeDsmTsf 0.00 51000. FORMAT "%5.0" /end CHARACTERISTIC
/begin CHARACTERISTIC DSM_TsfDfp_EMCCDSCGnd2_C "" VALUE 0xCCA8E Kw_Wu8 51000. TimeDsmTsf 0.00 51000. FORMAT "%5.0" /end CHARACTERISTIC
/begin CHARACTERISTIC DSM_TsfDfp_EMCCD_ADC1_C "" VALUE 0xCCA8F Kw_Wu8 51000. TimeDsmTsf 0.00 51000. FORMAT "%5.0" /end CHARACTERISTIC
/begin CHARACTERISTIC DSM_TsfDfp_EMCCD_ADC2_C "" VALUE 0xCCA90 Kw_Wu8 51000. TimeDsmTsf 0.00 51000. FORMAT "%5.0" /end CHARACTERISTIC
/begin CHARACTERISTIC DSM_TsfDfp_ETClbETFltInj1_C "Schwerezaehlergrenze fuer Fehlerpfad Dfp_ETClbETFltInj1" VALUE 0xCCA91 Kw_Wu8 51000. TimeDsmTsf 0.00 51000. FORMAT "%5.0" /end CHARACTERISTIC
/begin CHARACTERISTIC DSM_TsfDfp_ETClbETFltInj2_C "Schwerezaehlergrenze fuer Fehlerpfad Dfp_ETClbETFltInj2" VALUE 0xCCA92 Kw_Wu8 51000. TimeDsmTsf 0.00 51000. FORMAT "%5.0" /end CHARACTERISTIC
/begin CHARACTERISTIC DSM_TsfDfp_ETClbETFltInj3_C "Schwerezaehlergrenze fuer Fehlerpfad Dfp_ETClbETFltInj3" VALUE 0xCCA93 Kw_Wu8 51000. TimeDsmTsf 0.00 51000. FORMAT "%5.0" /end CHARACTERISTIC
/begin CHARACTERISTIC DSM_TsfDfp_ETClbETFltInj4_C "Schwerezaehlergrenze fuer Fehlerpfad Dfp_ETClbETFltInj4" VALUE 0xCCA94 Kw_Wu8 51000. TimeDsmTsf 0.00 51000. FORMAT "%5.0" /end CHARACTERISTIC
/begin CHARACTERISTIC DSM_TsfDfp_ETClbETFltInj5_C "Schwerezaehlergrenze fuer Fehlerpfad Dfp_ETClbETFltInj5" VALUE 0xCCA95 Kw_Wu8 51000. TimeDsmTsf 0.00 51000. FORMAT "%5.0" /end CHARACTERISTIC
/begin CHARACTERISTIC DSM_TsfDfp_ETClbETFltInj6_C "Schwerezaehlergrenze fuer Fehlerpfad Dfp_ETClbETFltInj6" VALUE 0xCCA96 Kw_Wu8 51000. TimeDsmTsf 0.00 51000. FORMAT "%5.0" /end CHARACTERISTIC
/begin CHARACTERISTIC DSM_TsfDfp_ETClbInj1_C "Schwerezaehlergrenze fuer Fehlerpfad Dfp_ETClbInj1" VALUE 0xCCA97 Kw_Wu8 51000. TimeDsmTsf 0.00 51000. FORMAT "%5.0" /end CHARACTERISTIC
/begin CHARACTERISTIC DSM_TsfDfp_ETClbInj2_C "Schwerezaehlergrenze fuer Fehlerpfad Dfp_ETClbInj2" VALUE 0xCCA98 Kw_Wu8 51000. TimeDsmTsf 0.00 51000. FORMAT "%5.0" /end CHARACTERISTIC
/begin CHARACTERISTIC DSM_TsfDfp_ETClbInj3_C "Schwerezaehlergrenze fuer Fehlerpfad Dfp_ETClbInj3" VALUE 0xCCA99 Kw_Wu8 51000. TimeDsmTsf 0.00 51000. FORMAT "%5.0" /end CHARACTERISTIC
/begin CHARACTERISTIC DSM_TsfDfp_ETClbInj4_C "Schwerezaehlergrenze fuer Fehlerpfad Dfp_ETClbInj4" VALUE 0xCCA9A Kw_Wu8 51000. TimeDsmTsf 0.00 51000. FORMAT "%5.0" /end CHARACTERISTIC
/begin CHARACTERISTIC DSM_TsfDfp_ETClbInj5_C "Schwerezaehlergrenze fuer Fehlerpfad Dfp_ETClbInj5" VALUE 0xCCA9B Kw_Wu8 51000. TimeDsmTsf 0.00 51000. FORMAT "%5.0" /end CHARACTERISTIC
/begin CHARACTERISTIC DSM_TsfDfp_ETClbInj6_C "Schwerezaehlergrenze fuer Fehlerpfad Dfp_ETClbInj6" VALUE 0xCCA9C Kw_Wu8 51000. TimeDsmTsf 0.00 51000. FORMAT "%5.0" /end CHARACTERISTIC
/begin CHARACTERISTIC DSM_TsfDfp_EngMCaS1_C "Schwerezaehlergrenze fuer Fehlerpfad Dfp_EngMCaS1" VALUE 0xCCA9D Kw_Wu8 51000. TimeDsmTsf 0.00 51000. FORMAT "%5.0" /end CHARACTERISTIC
/begin CHARACTERISTIC DSM_TsfDfp_EngMCrS1_C "Schwerezaehlergrenze fuer Fehlerpfad Dfp_EngMCrS1" VALUE 0xCCA9E Kw_Wu8 51000. TimeDsmTsf 0.00 51000. FORMAT "%5.0" /end CHARACTERISTIC
/begin CHARACTERISTIC DSM_TsfDfp_EngMOfsCaSCrS_C "Schwerezaehlergrenze fuer Fehlerpfad Dfp_EngMOfsCaSCrS" VALUE 0xCCA9F Kw_Wu8 51000. TimeDsmTsf 0.00 51000. FORMAT "%5.0" /end CHARACTERISTIC
/begin CHARACTERISTIC DSM_TsfDfp_EngPrtFWODet_C "Schwerezaehlergrenze fuer Fehlerpfad Dfp_EngPrtFWODet" VALUE 0xCCAA0 Kw_Wu8 51000. TimeDsmTsf 0.00 51000. FORMAT "%5.0" /end CHARACTERISTIC
/begin CHARACTERISTIC DSM_TsfDfp_FBCqDvt_C "Schwerezaehlergrenze fuer Fehlerpfad Dfp_FBCqDvt" VALUE 0xCCAA1 Kw_Wu8 51000. TimeDsmTsf 0.00 51000. FORMAT "%5.0" /end CHARACTERISTIC
/begin CHARACTERISTIC DSM_TsfDfp_FMTC_NonMonotonMap_C "Schwerezaehlergrenze fuer Fehlerpfad Dfp_FMTC_NonMonotonMap" VALUE 0xCCAA2 Kw_Wu8 51000. TimeDsmTsf 0.00 51000. FORMAT "%5.0" /end CHARACTERISTIC
/begin CHARACTERISTIC DSM_TsfDfp_FTSCD_C "Schwerezaehlergrenze fuer Fehlerpfad Dfp_FTSCD" VALUE 0xCCAA3 Kw_Wu8 51000. TimeDsmTsf 0.00 51000. FORMAT "%5.0" /end CHARACTERISTIC
/begin CHARACTERISTIC DSM_TsfDfp_FanCD_C "Schwerezaehlergrenze fuer Fehlerpfad Dfp_FanCD" VALUE 0xCCAA4 Kw_Wu8 51000. TimeDsmTsf 0.00 51000. FORMAT "%5.0" /end CHARACTERISTIC
/begin CHARACTERISTIC DSM_TsfDfp_FanCD_FanCtlr1_C "Schwerezaehlergrenze fuer Fehlerpfad Dfp_FanCD_FanCtlr1" VALUE 0xCCAA5 Kw_Wu8 51000. TimeDsmTsf 0.00 51000. FORMAT "%5.0" /end CHARACTERISTIC
/begin CHARACTERISTIC DSM_TsfDfp_FanCD_FanCtlr2_C "Schwerezaehlergrenze fuer Fehlerpfad Dfp_FanCD_FanCtlr2" VALUE 0xCCAA6 Kw_Wu8 51000. TimeDsmTsf 0.00 51000. FORMAT "%5.0" /end CHARACTERISTIC
/begin CHARACTERISTIC DSM_TsfDfp_FanCD_FanCtlr3_C "Schwerezaehlergrenze fuer Fehlerpfad Dfp_FanCD_FanCtlr3" VALUE 0xCCAA7 Kw_Wu8 51000. TimeDsmTsf 0.00 51000. FORMAT "%5.0" /end CHARACTERISTIC
/begin CHARACTERISTIC DSM_TsfDfp_FlFCD_C "Schwerezaehlergrenze fuer Fehlerpfad Dfp_FlFCD" VALUE 0xCCAA8 Kw_Wu8 51000. TimeDsmTsf 0.00 51000. FORMAT "%5.0" /end CHARACTERISTIC
/begin CHARACTERISTIC DSM_TsfDfp_FlMngSmkDefect_C "Schwerezaehlergrenze fuer Fehlerpfad Dfp_FlMngSmkDefect" VALUE 0xCCAA9 Kw_Wu8 51000. TimeDsmTsf 0.00 51000. FORMAT "%5.0" /end CHARACTERISTIC
/begin CHARACTERISTIC DSM_TsfDfp_FrmMngASC1_C "Schwerezaehlergrenze fuer Fehlerpfad Dfp_FrmMngASC1" VALUE 0xCCAAA Kw_Wu8 51000. TimeDsmTsf 0.00 51000. FORMAT "%5.0" /end CHARACTERISTIC
/begin CHARACTERISTIC DSM_TsfDfp_FrmMngASC2_C "Schwerezaehlergrenze fuer Fehlerpfad Dfp_FrmMngASC2" VALUE 0xCCAAB Kw_Wu8 51000. TimeDsmTsf 0.00 51000. FORMAT "%5.0" /end CHARACTERISTIC
/begin CHARACTERISTIC DSM_TsfDfp_FrmMngASC3_C "Schwerezaehlergrenze fuer Fehlerpfad Dfp_FrmMngASC3" VALUE 0xCCAAC Kw_Wu8 51000. TimeDsmTsf 0.00 51000. FORMAT "%5.0" /end CHARACTERISTIC
/begin CHARACTERISTIC DSM_TsfDfp_FrmMngASC4_C "Schwerezaehlergrenze fuer Fehlerpfad Dfp_FrmMngASC4" VALUE 0xCCAAD Kw_Wu8 51000. TimeDsmTsf 0.00 51000. FORMAT "%5.0" /end CHARACTERISTIC
/begin CHARACTERISTIC DSM_TsfDfp_FrmMngBOS_RESET_C "Schwerezaehlergrenze fuer Fehlerpfad Dfp_FrmMngBOS_RESET" VALUE 0xCCAAE Kw_Wu8 51000. TimeDsmTsf 0.00 51000. FORMAT "%5.0" /end CHARACTERISTIC
/begin CHARACTERISTIC DSM_TsfDfp_FrmMngBOS_RESET_2_C "" VALUE 0xCCAAF Kw_Wu8 51000. TimeDsmTsf 0.00 51000. FORMAT "%5.0" /end CHARACTERISTIC
/begin CHARACTERISTIC DSM_TsfDfp_FrmMngDMANFAFS_C "Schwerezaehlergrenze fuer Fehlerpfad Dfp_FrmMngDMANFAFS" VALUE 0xCCAB0 Kw_Wu8 51000. TimeDsmTsf 0.00 51000. FORMAT "%5.0" /end CHARACTERISTIC
/begin CHARACTERISTIC DSM_TsfDfp_FrmMngDRMANFSSG_C "Schwerezaehlergrenze fuer Fehlerpfad Dfp_FrmMngDRMANFSSG" VALUE 0xCCAB1 Kw_Wu8 51000. TimeDsmTsf 0.00 51000. FORMAT "%5.0" /end CHARACTERISTIC
/begin CHARACTERISTIC DSM_TsfDfp_FrmMngEGS1_C "Schwerezaehlergrenze fuer Fehlerpfad Dfp_FrmMngEGS1" VALUE 0xCCAB2 Kw_Wu8 51000. TimeDsmTsf 0.00 51000. FORMAT "%5.0" /end CHARACTERISTIC
/begin CHARACTERISTIC DSM_TsfDfp_FrmMngEGS2_C "Schwerezaehlergrenze fuer Fehlerpfad Dfp_FrmMngEGS2" VALUE 0xCCAB3 Kw_Wu8 51000. TimeDsmTsf 0.00 51000. FORMAT "%5.0" /end CHARACTERISTIC
/begin CHARACTERISTIC DSM_TsfDfp_FrmMngGEARBX_DATA_C "severity-counter for path" VALUE 0xCCAB4 Kw_Wu8 51000. TimeDsmTsf 0.00 51000. FORMAT "%5.0" /end CHARACTERISTIC
/begin CHARACTERISTIC DSM_TsfDfp_FrmMngGEARBX_DATA2_C "Schwerezaehlergrenze fuer Fehlerpfad Dfp_FrmMngGEARBX_DATA2" VALUE 0xCCAB5 Kw_Wu8 51000. TimeDsmTsf 0.00 51000. FORMAT "%5.0" /end CHARACTERISTIC
/begin CHARACTERISTIC DSM_TsfDfp_FrmMngHEAT_AC_C "severity-counter for path" VALUE 0xCCAB6 Kw_Wu8 51000. TimeDsmTsf 0.00 51000. FORMAT "%5.0" /end CHARACTERISTIC
/begin CHARACTERISTIC DSM_TsfDfp_FrmMngINSTR2_C "Schwerezaehlergrenze fuer Fehlerpfad Dfp_FrmMngINSTR2" VALUE 0xCCAB7 Kw_Wu8 51000. TimeDsmTsf 0.00 51000. FORMAT "%5.0" /end CHARACTERISTIC
/begin CHARACTERISTIC DSM_TsfDfp_FrmMngINSTR3_C "Schwerezaehlergrenze fuer Fehlerpfad Dfp_FrmMngINSTR3" VALUE 0xCCAB8 Kw_Wu8 51000. TimeDsmTsf 0.00 51000. FORMAT "%5.0" /end CHARACTERISTIC
/begin CHARACTERISTIC DSM_TsfDfp_FrmMngLENKRADWINKEL_C "Schwerezaehlergrenze fuer Fehlerpfad Dfp_FrmMngLENKRADWINKEL" VALUE 0xCCAB9 Kw_Wu8 51000. TimeDsmTsf 0.00 51000. FORMAT "%5.0" /end CHARACTERISTIC
/begin CHARACTERISTIC DSM_TsfDfp_FrmMngMILEAGE_RANGE_C "Schwerezaehlergrenze fuer Fehlerpfad Dfp_FrmMngMILEAGE_RANGE" VALUE 0xCCABA Kw_Wu8 51000. TimeDsmTsf 0.00 51000. FORMAT "%5.0" /end CHARACTERISTIC
/begin CHARACTERISTIC DSM_TsfDfp_FrmMngOPCRCTLACC_C "Schwerezaehlergrenze fuer Fehlerpfad Dfp_FrmMngOPCRCTLACC" VALUE 0xCCABB Kw_Wu8 51000. TimeDsmTsf 0.00 51000. FORMAT "%5.0" /end CHARACTERISTIC
/begin CHARACTERISTIC DSM_TsfDfp_FrmMngPRGG_CCTR_C "Schwerezaehlergrenze fuer Fehlerpfad Dfp_FrmMngPRGG_CCTR" VALUE 0xCCABC Kw_Wu8 51000. TimeDsmTsf 0.00 51000. FORMAT "%5.0" /end CHARACTERISTIC
/begin CHARACTERISTIC DSM_TsfDfp_FrmMngPWRMNG_LOADV_C "Schwerezaehlergrenze fuer Fehlerpfad Dfp_FrmMngPWRMNG_LOADV" VALUE 0xCCABD Kw_Wu8 51000. TimeDsmTsf 0.00 51000. FORMAT "%5.0" /end CHARACTERISTIC
/begin CHARACTERISTIC DSM_TsfDfp_FrmMngParkConsumer_C "Schwerezaehlgrenze fuer Fehlerpfad Dfp_FrmMngParkConsumer" VALUE 0xCCABE Kw_Wu8 51000. TimeDsmTsf 0.00 51000. FORMAT "%5.0" /end CHARACTERISTIC
/begin CHARACTERISTIC DSM_TsfDfp_FrmMngRQSTGEFAN_C "RQ_STG_EFAN - CAN-message related errors" VALUE 0xCCABF Kw_Wu8 51000. TimeDsmTsf 0.00 51000. FORMAT "%5.0" /end CHARACTERISTIC
/begin CHARACTERISTIC DSM_TsfDfp_FrmMngSSGErr_C "Schwerezaehlergrenze fuer Fehlerpfad Dfp_FrmMngSSGErr" VALUE 0xCCAC0 Kw_Wu8 51000. TimeDsmTsf 0.00 51000. FORMAT "%5.0" /end CHARACTERISTIC
/begin CHARACTERISTIC DSM_TsfDfp_FrmMngSSGShOff_C "Schwerezaehlergrenze fuer Fehlerpfad Dfp_FrmMngSSGShOff" VALUE 0xCCAC1 Kw_Wu8 51000. TimeDsmTsf 0.00 51000. FORMAT "%5.0" /end CHARACTERISTIC
/begin CHARACTERISTIC DSM_TsfDfp_FrmMngSTAT_ANH_C "Schwerezaehlergrenze fuer Fehlerpfad Dfp_FrmMngSTAT_ANH" VALUE 0xCCAC2 Kw_Wu8 51000. TimeDsmTsf 0.00 51000. FORMAT "%5.0" /end CHARACTERISTIC
/begin CHARACTERISTIC DSM_TsfDfp_FrmMngSTAT_ARS_C "severity-counter for path" VALUE 0xCCAC3 Kw_Wu8 51000. TimeDsmTsf 0.00 51000. FORMAT "%5.0" /end CHARACTERISTIC
/begin CHARACTERISTIC DSM_TsfDfp_FrmMngSTAT_DSC_C "severity-counter for path" VALUE 0xCCAC4 Kw_Wu8 51000. TimeDsmTsf 0.00 51000. FORMAT "%5.0" /end CHARACTERISTIC
/begin CHARACTERISTIC DSM_TsfDfp_FrmMngSTAT_EKP_C "Schwerezaehlergrenze fuer Fehlerpfad Dfp_FrmMngSTAT_EKP" VALUE 0xCCAC5 Kw_Wu8 51000. TimeDsmTsf 0.00 51000. FORMAT "%5.0" /end CHARACTERISTIC
/begin CHARACTERISTIC DSM_TsfDfp_FrmMngSTAT_KOMBI_C "Schwerezaehlergrenze fuer Fehlerpfad Dfp_FrmMngSTAT_KOMBI" VALUE 0xCCAC6 Kw_Wu8 51000. TimeDsmTsf 0.00 51000. FORMAT "%5.0" /end CHARACTERISTIC
/begin CHARACTERISTIC DSM_TsfDfp_FrmMngSTAT_SITZ_C "Schwerezaehlergrenze fuer Fehlerpfad Dfp_FrmMngSTAT_SITZ" VALUE 0xCCAC7 Kw_Wu8 51000. TimeDsmTsf 0.00 51000. FORMAT "%5.0" /end CHARACTERISTIC
/begin CHARACTERISTIC DSM_TsfDfp_FrmMngStOBDGbxMilOf_C "Schwerezaehlergrenze fuer Fehlerpfad Dfp_FrmMngStOBDGbxMilOf" VALUE 0xCCAC8 Kw_Wu8 51000. TimeDsmTsf 0.00 51000. FORMAT "%5.0" /end CHARACTERISTIC
/begin CHARACTERISTIC DSM_TsfDfp_FrmMngStOBDGbxMilOn_C "Schwerezaehlergrenze fuer Fehlerpfad Dfp_FrmMngStOBDGbxMilOn" VALUE 0xCCAC9 Kw_Wu8 51000. TimeDsmTsf 0.00 51000. FORMAT "%5.0" /end CHARACTERISTIC
/begin CHARACTERISTIC DSM_TsfDfp_FrmMngTEMPRELTIME_C "Schwerezaehlergrenze fuer Fehlerpfad Dfp_FrmMngTEMPRELTIME" VALUE 0xCCACA Kw_Wu8 51000. TimeDsmTsf 0.00 51000. FORMAT "%5.0" /end CHARACTERISTIC
/begin CHARACTERISTIC DSM_TsfDfp_FrmMngTERMINAL_C "severity-counter for path" VALUE 0xCCACB Kw_Wu8 51000. TimeDsmTsf 0.00 51000. FORMAT "%5.0" /end CHARACTERISTIC
/begin CHARACTERISTIC DSM_TsfDfp_FrmMngTIME_DATE_C "Schwerezaehlergrenze fuer Fehlerpfad Dfp_FrmMngTIME_DATE" VALUE 0xCCACC Kw_Wu8 51000. TimeDsmTsf 0.00 51000. FORMAT "%5.0" /end CHARACTERISTIC
/begin CHARACTERISTIC DSM_TsfDfp_FrmMngTORQUE_DSC_C "severity-counter for path" VALUE 0xCCACD Kw_Wu8 51000. TimeDsmTsf 0.00 51000. FORMAT "%5.0" /end CHARACTERISTIC
/begin CHARACTERISTIC DSM_TsfDfp_FrmMngTORQUE_GEARBX_C "severity-counter for path" VALUE 0xCCACE Kw_Wu8 51000. TimeDsmTsf 0.00 51000. FORMAT "%5.0" /end CHARACTERISTIC
/begin CHARACTERISTIC DSM_TsfDfp_FrmMngTrq_ReqACC_C "Schwerezaehlergrenze fuer Fehlerpfad Dfp_FrmMngTrq_ReqACC" VALUE 0xCCACF Kw_Wu8 51000. TimeDsmTsf 0.00 51000. FORMAT "%5.0" /end CHARACTERISTIC
/begin CHARACTERISTIC DSM_TsfDfp_FrmMngVEH_MOD_C "VEH_MOD - CAN-message related errors" VALUE 0xCCAD0 Kw_Wu8 51000. TimeDsmTsf 0.00 51000. FORMAT "%5.0" /end CHARACTERISTIC
/begin CHARACTERISTIC DSM_TsfDfp_FrmMngVELOCITY_C "severity-counter for path" VALUE 0xCCAD1 Kw_Wu8 51000. TimeDsmTsf 0.00 51000. FORMAT "%5.0" /end CHARACTERISTIC
/begin CHARACTERISTIC DSM_TsfDfp_FrmMngWHEEL_SPEED_C "Schwerezaehlergrenze fuer Fehlerpfad Dfp_FrmMngWHEEL_SPEED" VALUE 0xCCAD2 Kw_Wu8 51000. TimeDsmTsf 0.00 51000. FORMAT "%5.0" /end CHARACTERISTIC
/begin CHARACTERISTIC DSM_TsfDfp_FrmMngstCurr_C "Schwerezählergrenze für Dfp_FrmMngstCurr" VALUE 0xCCAD3 Kw_Wu8 51000. TimeDsmTsf 0.00 51000. FORMAT "%5.0" /end CHARACTERISTIC
/begin CHARACTERISTIC DSM_TsfDfp_FrmMngswtPSPOff_C "Schwerezählergrenze für Dfp_FrmMngswtPSPOff" VALUE 0xCCAD4 Kw_Wu8 51000. TimeDsmTsf 0.00 51000. FORMAT "%5.0" /end CHARACTERISTIC
/begin CHARACTERISTIC DSM_TsfDfp_GearbxIncMax_C "Schwerezaehlergrenze fuer Fehlerpfad Dfp_GearbxIncMax" VALUE 0xCCAD5 Kw_Wu8 51000. TimeDsmTsf 0.00 51000. FORMAT "%5.0" /end CHARACTERISTIC
/begin CHARACTERISTIC DSM_TsfDfp_GlwCD_C "Schwerezaehlergrenze fuer Fehlerpfad Dfp_GlwCD" VALUE 0xCCAD6 Kw_Wu8 51000. TimeDsmTsf 0.00 51000. FORMAT "%5.0" /end CHARACTERISTIC
/begin CHARACTERISTIC DSM_TsfDfp_GlwCDGlwCirc1_C "Schwerezaehlergrenze fuer Fehlerpfad Dfp_GlwCDGlwCirc1" VALUE 0xCCAD7 Kw_Wu8 51000. TimeDsmTsf 0.00 51000. FORMAT "%5.0" /end CHARACTERISTIC
/begin CHARACTERISTIC DSM_TsfDfp_GlwCDGlwCirc2_C "Schwerezaehlergrenze fuer Fehlerpfad Dfp_GlwCDGlwCirc2" VALUE 0xCCAD8 Kw_Wu8 51000. TimeDsmTsf 0.00 51000. FORMAT "%5.0" /end CHARACTERISTIC
/begin CHARACTERISTIC DSM_TsfDfp_GlwCDGlwCirc3_C "Schwerezaehlergrenze fuer Fehlerpfad Dfp_GlwCDGlwCirc3" VALUE 0xCCAD9 Kw_Wu8 51000. TimeDsmTsf 0.00 51000. FORMAT "%5.0" /end CHARACTERISTIC
/begin CHARACTERISTIC DSM_TsfDfp_GlwCDGlwCirc4_C "Schwerezaehlergrenze fuer Fehlerpfad Dfp_GlwCDGlwCirc4" VALUE 0xCCADA Kw_Wu8 51000. TimeDsmTsf 0.00 51000. FORMAT "%5.0" /end CHARACTERISTIC
/begin CHARACTERISTIC DSM_TsfDfp_GlwCDGlwCirc5_C "Schwerezaehlergrenze fuer Fehlerpfad Dfp_GlwCDGlwCirc5" VALUE 0xCCADB Kw_Wu8 51000. TimeDsmTsf 0.00 51000. FORMAT "%5.0" /end CHARACTERISTIC
/begin CHARACTERISTIC DSM_TsfDfp_GlwCDGlwCirc6_C "Schwerezaehlergrenze fuer Fehlerpfad Dfp_GlwCDGlwCirc6" VALUE 0xCCADC Kw_Wu8 51000. TimeDsmTsf 0.00 51000. FORMAT "%5.0" /end CHARACTERISTIC
/begin CHARACTERISTIC DSM_TsfDfp_GlwCDGlwCirc7_C "Schwerezaehlergrenze fuer Fehlerpfad Dfp_GlwCDGlwCirc7" VALUE 0xCCADD Kw_Wu8 51000. TimeDsmTsf 0.00 51000. FORMAT "%5.0" /end CHARACTERISTIC
/begin CHARACTERISTIC DSM_TsfDfp_GlwCDGlwCirc8_C "Schwerezaehlergrenze fuer Fehlerpfad Dfp_GlwCDGlwCirc8" VALUE 0xCCADE Kw_Wu8 51000. TimeDsmTsf 0.00 51000. FORMAT "%5.0" /end CHARACTERISTIC
/begin CHARACTERISTIC DSM_TsfDfp_GlwCtl_C "Schwerezaehlergrenze fuer Fehlerpfad Dfp_GlwCtl" VALUE 0xCCADF Kw_Wu8 51000. TimeDsmTsf 0.00 51000. FORMAT "%5.0" /end CHARACTERISTIC
/begin CHARACTERISTIC DSM_TsfDfp_HWEMonCom_C "Schwerezaehlergrenze fuer Fehlerpfad Dfp_HWEMonCom" VALUE 0xCCAE0 Kw_Wu8 51000. TimeDsmTsf 0.00 51000. FORMAT "%5.0" /end CHARACTERISTIC
/begin CHARACTERISTIC DSM_TsfDfp_HWEMonEEPROM_C "Schwerezaehlergrenze fuer Fehlerpfad Dfp_HWEMonEEPROM" VALUE 0xCCAE1 Kw_Wu8 51000. TimeDsmTsf 0.00 51000. FORMAT "%5.0" /end CHARACTERISTIC
/begin CHARACTERISTIC DSM_TsfDfp_HWEMonRcyLocked_C "Schwerezaehlergrenze fuer Fehlerpfad Dfp_HWEMonRcyLocked" VALUE 0xCCAE2 Kw_Wu8 51000. TimeDsmTsf 0.00 51000. FORMAT "%5.0" /end CHARACTERISTIC
/begin CHARACTERISTIC DSM_TsfDfp_HWEMonRcySuppressed_C "Schwerezaehlergrenze fuer Fehlerpfad Dfp_HWEMonRcySuppressed" VALUE 0xCCAE3 Kw_Wu8 51000. TimeDsmTsf 0.00 51000. FORMAT "%5.0" /end CHARACTERISTIC
/begin CHARACTERISTIC DSM_TsfDfp_HWEMonRcyVisible_C "Schwerezaehlergrenze fuer Fehlerpfad Dfp_HWEMonRcyVisible" VALUE 0xCCAE4 Kw_Wu8 51000. TimeDsmTsf 0.00 51000. FORMAT "%5.0" /end CHARACTERISTIC
/begin CHARACTERISTIC DSM_TsfDfp_HWEMonUMaxSupply_C "Schwerezaehlergrenze fuer Fehlerpfad Dfp_HWEMonUMaxSupply" VALUE 0xCCAE5 Kw_Wu8 51000. TimeDsmTsf 0.00 51000. FORMAT "%5.0" /end CHARACTERISTIC
/begin CHARACTERISTIC DSM_TsfDfp_HWEMonUMinSupply_C "Schwerezaehlergrenze fuer Fehlerpfad Dfp_HWEMonUMinSupply" VALUE 0xCCAE6 Kw_Wu8 51000. TimeDsmTsf 0.00 51000. FORMAT "%5.0" /end CHARACTERISTIC
/begin CHARACTERISTIC DSM_TsfDfp_IATSCD_C "Schwerezaehlergrenze fuer Fehlerpfad Dfp_IATSCD" VALUE 0xCCAE7 Kw_Wu8 51000. TimeDsmTsf 0.00 51000. FORMAT "%5.0" /end CHARACTERISTIC
/begin CHARACTERISTIC DSM_TsfDfp_IATSCD_CATS_C "Schwerezaehlergrenze fuer Fehlerpfad Dfp_IATSCD_CATS" VALUE 0xCCAE8 Kw_Wu8 51000. TimeDsmTsf 0.00 51000. FORMAT "%5.0" /end CHARACTERISTIC
/begin CHARACTERISTIC DSM_TsfDfp_ImmCtlImmCD_C "Schwerezaehlergrenze fuer Fehlerpfad Dfp_ImmCtlImmCD" VALUE 0xCCAE9 Kw_Wu8 51000. TimeDsmTsf 0.00 51000. FORMAT "%5.0" /end CHARACTERISTIC
/begin CHARACTERISTIC DSM_TsfDfp_ImmCtlImmEep_C "Schwerezaehlergrenze fuer Fehlerpfad Dfp_ImmCtlImmEep" VALUE 0xCCAEA Kw_Wu8 51000. TimeDsmTsf 0.00 51000. FORMAT "%5.0" /end CHARACTERISTIC
/begin CHARACTERISTIC DSM_TsfDfp_ImmCtlMpl_C "Schwerezaehlergrenze fuer Fehlerpfad Dfp_ImmCtlMpl" VALUE 0xCCAEB Kw_Wu8 51000. TimeDsmTsf 0.00 51000. FORMAT "%5.0" /end CHARACTERISTIC
/begin CHARACTERISTIC DSM_TsfDfp_IndSys1_C "Schwerezaehlergrenze fuer Fehlerpfad Dfp_IndSys1" VALUE 0xCCAEC Kw_Wu8 51000. TimeDsmTsf 0.00 51000. FORMAT "%5.0" /end CHARACTERISTIC
/begin CHARACTERISTIC DSM_TsfDfp_IndSys2_C "Schwerezaehlergrenze fuer Fehlerpfad Dfp_IndSys2" VALUE 0xCCAED Kw_Wu8 51000. TimeDsmTsf 0.00 51000. FORMAT "%5.0" /end CHARACTERISTIC
/begin CHARACTERISTIC DSM_TsfDfp_InjCrv_InjLim_C "Schwerezaehlergrenze fuer Fehlerpfad Dfp_InjCrv_InjLim" VALUE 0xCCAEE Kw_Wu8 51000. TimeDsmTsf 0.00 51000. FORMAT "%5.0" /end CHARACTERISTIC
/begin CHARACTERISTIC DSM_TsfDfp_InjCtlAdjQnt_C "Schwerezaehlergrenze fuer Fehlerpfad Dfp_InjCtlAdjQnt" VALUE 0xCCAEF Kw_Wu8 51000. TimeDsmTsf 0.00 51000. FORMAT "%5.0" /end CHARACTERISTIC
/begin CHARACTERISTIC DSM_TsfDfp_InjCtlDrift_C "Schwerezaehlergrenze fuer Fehlerpfad Dfp_InjCtlDrift" VALUE 0xCCAF0 Kw_Wu8 51000. TimeDsmTsf 0.00 51000. FORMAT "%5.0" /end CHARACTERISTIC
/begin CHARACTERISTIC DSM_TsfDfp_InjVlvBnk1A_C "Schwerezaehlergrenze fuer Fehlerpfad Dfp_InjVlvBnk1A" VALUE 0xCCAF1 Kw_Wu8 51000. TimeDsmTsf 0.00 51000. FORMAT "%5.0" /end CHARACTERISTIC
/begin CHARACTERISTIC DSM_TsfDfp_InjVlvBnk1B_C "Schwerezaehlergrenze fuer Fehlerpfad Dfp_InjVlvBnk1B" VALUE 0xCCAF2 Kw_Wu8 51000. TimeDsmTsf 0.00 51000. FORMAT "%5.0" /end CHARACTERISTIC
/begin CHARACTERISTIC DSM_TsfDfp_InjVlvBnk2A_C "Schwerezaehlergrenze fuer Fehlerpfad Dfp_InjVlvBnk2A" VALUE 0xCCAF3 Kw_Wu8 51000. TimeDsmTsf 0.00 51000. FORMAT "%5.0" /end CHARACTERISTIC
/begin CHARACTERISTIC DSM_TsfDfp_InjVlvBnk2B_C "Schwerezaehlergrenze fuer Fehlerpfad Dfp_InjVlvBnk2B" VALUE 0xCCAF4 Kw_Wu8 51000. TimeDsmTsf 0.00 51000. FORMAT "%5.0" /end CHARACTERISTIC
/begin CHARACTERISTIC DSM_TsfDfp_InjVlvChipA_C "Schwerezaehlergrenze fuer Fehlerpfad Dfp_InjVlvChipA" VALUE 0xCCAF5 Kw_Wu8 51000. TimeDsmTsf 0.00 51000. FORMAT "%5.0" /end CHARACTERISTIC
/begin CHARACTERISTIC DSM_TsfDfp_InjVlvChipB_C "Schwerezaehlergrenze fuer Fehlerpfad Dfp_InjVlvChipB" VALUE 0xCCAF6 Kw_Wu8 51000. TimeDsmTsf 0.00 51000. FORMAT "%5.0" /end CHARACTERISTIC
/begin CHARACTERISTIC DSM_TsfDfp_InjVlvCyl1A_C "Schwerezaehlergrenze fuer Fehlerpfad Dfp_InjVlvCyl1A" VALUE 0xCCAF7 Kw_Wu8 51000. TimeDsmTsf 0.00 51000. FORMAT "%5.0" /end CHARACTERISTIC
/begin CHARACTERISTIC DSM_TsfDfp_InjVlvCyl1B_C "Schwerezaehlergrenze fuer Fehlerpfad Dfp_InjVlvCyl1B" VALUE 0xCCAF8 Kw_Wu8 51000. TimeDsmTsf 0.00 51000. FORMAT "%5.0" /end CHARACTERISTIC
/begin CHARACTERISTIC DSM_TsfDfp_InjVlvCyl2A_C "Schwerezaehlergrenze fuer Fehlerpfad Dfp_InjVlvCyl2A" VALUE 0xCCAF9 Kw_Wu8 51000. TimeDsmTsf 0.00 51000. FORMAT "%5.0" /end CHARACTERISTIC
/begin CHARACTERISTIC DSM_TsfDfp_InjVlvCyl2B_C "Schwerezaehlergrenze fuer Fehlerpfad Dfp_InjVlvCyl2B" VALUE 0xCCAFA Kw_Wu8 51000. TimeDsmTsf 0.00 51000. FORMAT "%5.0" /end CHARACTERISTIC
/begin CHARACTERISTIC DSM_TsfDfp_InjVlvCyl3A_C "Schwerezaehlergrenze fuer Fehlerpfad Dfp_InjVlvCyl3A" VALUE 0xCCAFB Kw_Wu8 51000. TimeDsmTsf 0.00 51000. FORMAT "%5.0" /end CHARACTERISTIC
/begin CHARACTERISTIC DSM_TsfDfp_InjVlvCyl3B_C "Schwerezaehlergrenze fuer Fehlerpfad Dfp_InjVlvCyl3B" VALUE 0xCCAFC Kw_Wu8 51000. TimeDsmTsf 0.00 51000. FORMAT "%5.0" /end CHARACTERISTIC
/begin CHARACTERISTIC DSM_TsfDfp_InjVlvCyl4A_C "Schwerezaehlergrenze fuer Fehlerpfad Dfp_InjVlvCyl4A" VALUE 0xCCAFD Kw_Wu8 51000. TimeDsmTsf 0.00 51000. FORMAT "%5.0" /end CHARACTERISTIC
/begin CHARACTERISTIC DSM_TsfDfp_InjVlvCyl4B_C "Schwerezaehlergrenze fuer Fehlerpfad Dfp_InjVlvCyl4B" VALUE 0xCCAFE Kw_Wu8 51000. TimeDsmTsf 0.00 51000. FORMAT "%5.0" /end CHARACTERISTIC
/begin CHARACTERISTIC DSM_TsfDfp_InjVlvCyl5A_C "Schwerezaehlergrenze fuer Fehlerpfad Dfp_InjVlvCyl5A" VALUE 0xCCAFF Kw_Wu8 51000. TimeDsmTsf 0.00 51000. FORMAT "%5.0" /end CHARACTERISTIC
/begin CHARACTERISTIC DSM_TsfDfp_InjVlvCyl5B_C "Schwerezaehlergrenze fuer Fehlerpfad Dfp_InjVlvCyl5B" VALUE 0xCCB00 Kw_Wu8 51000. TimeDsmTsf 0.00 51000. FORMAT "%5.0" /end CHARACTERISTIC
/begin CHARACTERISTIC DSM_TsfDfp_InjVlvCyl6A_C "Schwerezaehlergrenze fuer Fehlerpfad Dfp_InjVlvCyl6A" VALUE 0xCCB01 Kw_Wu8 51000. TimeDsmTsf 0.00 51000. FORMAT "%5.0" /end CHARACTERISTIC
/begin CHARACTERISTIC DSM_TsfDfp_InjVlvCyl6B_C "Schwerezaehlergrenze fuer Fehlerpfad Dfp_InjVlvCyl6B" VALUE 0xCCB02 Kw_Wu8 51000. TimeDsmTsf 0.00 51000. FORMAT "%5.0" /end CHARACTERISTIC
/begin CHARACTERISTIC DSM_TsfDfp_LPACD_Max_C "Schwerezaehlergrenze fuer Fehlerpfad Dfp_LPACD_Max" VALUE 0xCCB03 Kw_Wu8 51000. TimeDsmTsf 0.00 51000. FORMAT "%5.0" /end CHARACTERISTIC
/begin CHARACTERISTIC DSM_TsfDfp_LPACD_Min_C "Schwerezaehlergrenze fuer Fehlerpfad Dfp_LPACD_Min" VALUE 0xCCB04 Kw_Wu8 51000. TimeDsmTsf 0.00 51000. FORMAT "%5.0" /end CHARACTERISTIC
/begin CHARACTERISTIC DSM_TsfDfp_LPACD_SigNpl_C "Schwerezaehlergrenze fuer Fehlerpfad Dfp_LPACD_SigNpl" VALUE 0xCCB05 Kw_Wu8 51000. TimeDsmTsf 0.00 51000. FORMAT "%5.0" /end CHARACTERISTIC
/begin CHARACTERISTIC DSM_TsfDfp_LSUCDCircNernst0_C "Schwerezaehlergrenze fuer Fehlerpfad Dfp_LSUCDCircNernst0" VALUE 0xCCB06 Kw_Wu8 51000. TimeDsmTsf 0.00 51000. FORMAT "%5.0" /end CHARACTERISTIC
/begin CHARACTERISTIC DSM_TsfDfp_LSUCDCircPumpCur0_C "Schwerezaehlergrenze fuer Fehlerpfad Dfp_LSUCDCircPumpCur0" VALUE 0xCCB07 Kw_Wu8 51000. TimeDsmTsf 0.00 51000. FORMAT "%5.0" /end CHARACTERISTIC
/begin CHARACTERISTIC DSM_TsfDfp_LSUCDCircVirtGnd0_C "Schwerezaehlergrenze fuer Fehlerpfad Dfp_LSUCDCircVirtGnd0" VALUE 0xCCB08 Kw_Wu8 51000. TimeDsmTsf 0.00 51000. FORMAT "%5.0" /end CHARACTERISTIC
/begin CHARACTERISTIC DSM_TsfDfp_LSUCDHeater0_C "Schwerezaehlergrenze fuer Fehlerpfad Dfp_LSUCDHeater0" VALUE 0xCCB09 Kw_Wu8 51000. TimeDsmTsf 0.00 51000. FORMAT "%5.0" /end CHARACTERISTIC
/begin CHARACTERISTIC DSM_TsfDfp_LSUCDHtCoup0_C "Schwerezaehlergrenze fuer Fehlerpfad Dfp_LSUCDHtCoup0" VALUE 0xCCB0A Kw_Wu8 51000. TimeDsmTsf 0.00 51000. FORMAT "%5.0" /end CHARACTERISTIC
/begin CHARACTERISTIC DSM_TsfDfp_LSUCDO20_C "Schwerezaehlergrenze fuer Fehlerpfad Dfp_LSUCDO20" VALUE 0xCCB0B Kw_Wu8 51000. TimeDsmTsf 0.00 51000. FORMAT "%5.0" /end CHARACTERISTIC
/begin CHARACTERISTIC DSM_TsfDfp_LSUCDO2Clb0_C "Schwerezaehlergrenze fuer Fehlerpfad Dfp_LSUCDO2Clb0" VALUE 0xCCB0C Kw_Wu8 51000. TimeDsmTsf 0.00 51000. FORMAT "%5.0" /end CHARACTERISTIC
/begin CHARACTERISTIC DSM_TsfDfp_LSUCDRiClb0_C "Schwerezaehlergrenze fuer Fehlerpfad Dfp_LSUCDRiClb0" VALUE 0xCCB0D Kw_Wu8 51000. TimeDsmTsf 0.00 51000. FORMAT "%5.0" /end CHARACTERISTIC
/begin CHARACTERISTIC DSM_TsfDfp_LSUCDSPI0_C "Schwerezaehlergrenze fuer Fehlerpfad Dfp_LSUCDSPI0" VALUE 0xCCB0E Kw_Wu8 51000. TimeDsmTsf 0.00 51000. FORMAT "%5.0" /end CHARACTERISTIC
/begin CHARACTERISTIC DSM_TsfDfp_LSUCDSPIBattLow0_C "Schwerezaehlergrenze fuer Fehlerpfad Dfp_LSUCDSPIBattLow0" VALUE 0xCCB0F Kw_Wu8 51000. TimeDsmTsf 0.00 51000. FORMAT "%5.0" /end CHARACTERISTIC
/begin CHARACTERISTIC DSM_TsfDfp_LSUCDWireIP0_C "Schwerezaehlergrenze fuer Fehlerpfad Dfp_LSUCDWireIP0" VALUE 0xCCB10 Kw_Wu8 51000. TimeDsmTsf 0.00 51000. FORMAT "%5.0" /end CHARACTERISTIC
/begin CHARACTERISTIC DSM_TsfDfp_LSUCtlRiExc0_C "Schwerezaehlergrenze fuer Fehlerpfad Dfp_LSUCtlRiExc0" VALUE 0xCCB11 Kw_Wu8 51000. TimeDsmTsf 0.00 51000. FORMAT "%5.0" /end CHARACTERISTIC
/begin CHARACTERISTIC DSM_TsfDfp_LSUMon1Sens_C "Schwerezaehlergrenze fuer Fehlerpfad Dfp_LSUMon1Sens" VALUE 0xCCB12 Kw_Wu8 51000. TimeDsmTsf 0.00 51000. FORMAT "%5.0" /end CHARACTERISTIC
/begin CHARACTERISTIC DSM_TsfDfp_LSUMon2Sens_C "Schwerezaehlergrenze fuer Fehlerpfad Dfp_LSUMon2Sens" VALUE 0xCCB13 Kw_Wu8 51000. TimeDsmTsf 0.00 51000. FORMAT "%5.0" /end CHARACTERISTIC
/begin CHARACTERISTIC DSM_TsfDfp_LubCD_C "Schwerezaehlergrenze fuer Fehlerpfad Dfp_LubCD" VALUE 0xCCB14 Kw_Wu8 51000. TimeDsmTsf 0.00 51000. FORMAT "%5.0" /end CHARACTERISTIC
/begin CHARACTERISTIC DSM_TsfDfp_MIL_C "Schwerezaehlergrenze fuer Fehlerpfad Dfp_MIL" VALUE 0xCCB15 Kw_Wu8 51000. TimeDsmTsf 0.00 51000. FORMAT "%5.0" /end CHARACTERISTIC
/begin CHARACTERISTIC DSM_TsfDfp_MRlyCD_C "Schwerezaehlergrenze fuer Fehlerpfad Dfp_MRlyCD" VALUE 0xCCB16 Kw_Wu8 51000. TimeDsmTsf 0.00 51000. FORMAT "%5.0" /end CHARACTERISTIC
/begin CHARACTERISTIC DSM_TsfDfp_MSidCD_Comm_C "Schwerezaehlergrenze fuer Fehlerpfad Dfp_MSidCD_Comm" VALUE 0xCCB17 Kw_Wu8 51000. TimeDsmTsf 0.00 51000. FORMAT "%5.0" /end CHARACTERISTIC
/begin CHARACTERISTIC DSM_TsfDfp_MSidCD_Pin_C "Schwerezaehlergrenze fuer Fehlerpfad Dfp_MSidCD_Pin" VALUE 0xCCB18 Kw_Wu8 51000. TimeDsmTsf 0.00 51000. FORMAT "%5.0" /end CHARACTERISTIC
/begin CHARACTERISTIC DSM_TsfDfp_MSidCD_Sel_INI_C "Schwerezaehlergrenze fuer Fehlerpfad Dfp_MSidCD_Sel_INI" VALUE 0xCCB19 Kw_Wu8 51000. TimeDsmTsf 0.00 51000. FORMAT "%5.0" /end CHARACTERISTIC
/begin CHARACTERISTIC DSM_TsfDfp_MSidCD_Select_C "Schwerezaehlergrenze fuer Fehlerpfad Dfp_MSidCD_Select" VALUE 0xCCB1A Kw_Wu8 51000. TimeDsmTsf 0.00 51000. FORMAT "%5.0" /end CHARACTERISTIC
/begin CHARACTERISTIC DSM_TsfDfp_MeUnCDNoLoad_C "Schwerezaehlergrenze fuer Fehlerpfad Dfp_MeUnCDNoLoad" VALUE 0xCCB1B Kw_Wu8 51000. TimeDsmTsf 0.00 51000. FORMAT "%5.0" /end CHARACTERISTIC
/begin CHARACTERISTIC DSM_TsfDfp_MeUnCDSCBat_C "Schwerezaehlergrenze fuer Fehlerpfad Dfp_MeUnCDSCBat" VALUE 0xCCB1C Kw_Wu8 51000. TimeDsmTsf 0.00 51000. FORMAT "%5.0" /end CHARACTERISTIC
/begin CHARACTERISTIC DSM_TsfDfp_MeUnCDSCGnd_C "Schwerezaehlergrenze fuer Fehlerpfad Dfp_MeUnCDSCGnd" VALUE 0xCCB1D Kw_Wu8 51000. TimeDsmTsf 0.00 51000. FORMAT "%5.0" /end CHARACTERISTIC
/begin CHARACTERISTIC DSM_TsfDfp_MeUnCD_ADC_C "Schwerezaehlergrenze fuer Fehlerpfad Dfp_MeUnCD_ADC" VALUE 0xCCB1E Kw_Wu8 51000. TimeDsmTsf 0.00 51000. FORMAT "%5.0" /end CHARACTERISTIC
/begin CHARACTERISTIC DSM_TsfDfp_MeUnCD_SigTst_C "Schwerezaehlergrenze fuer Fehlerpfad Dfp_MeUnCD_SigTst" VALUE 0xCCB1F Kw_Wu8 51000. TimeDsmTsf 0.00 51000. FORMAT "%5.0" /end CHARACTERISTIC
/begin CHARACTERISTIC DSM_TsfDfp_Montr_C "Schwerezaehlergrenze fuer Fehlerpfad Dfp_Montr" VALUE 0xCCB20 Kw_Wu8 51000. TimeDsmTsf 0.00 51000. FORMAT "%5.0" /end CHARACTERISTIC
/begin CHARACTERISTIC DSM_TsfDfp_NetMngDeviceA_C "Schwerezaehlergrenze fuer Fehlerpfad Dfp_NetMngDeviceA" VALUE 0xCCB21 Kw_Wu8 51000. TimeDsmTsf 0.00 51000. FORMAT "%5.0" /end CHARACTERISTIC
/begin CHARACTERISTIC DSM_TsfDfp_NetMngDeviceB_C "Schwerezaehlergrenze fuer Fehlerpfad Dfp_NetMngDeviceB" VALUE 0xCCB22 Kw_Wu8 51000. TimeDsmTsf 0.00 51000. FORMAT "%5.0" /end CHARACTERISTIC
/begin CHARACTERISTIC DSM_TsfDfp_NetMngDeviceC_C "Schwerezaehlergrenze fuer Fehlerpfad Dfp_NetMngDeviceC" VALUE 0xCCB23 Kw_Wu8 51000. TimeDsmTsf 0.00 51000. FORMAT "%5.0" /end CHARACTERISTIC
/begin CHARACTERISTIC DSM_TsfDfp_OPSCD_Lamp_C "Schwerezaehlergrenze fuer Fehlerpfad Dfp_OPSCD_Lamp" VALUE 0xCCB24 Kw_Wu8 51000. TimeDsmTsf 0.00 51000. FORMAT "%5.0" /end CHARACTERISTIC
/begin CHARACTERISTIC DSM_TsfDfp_OPSCD_anain_C "Schwerezaehlergrenze fuer Fehlerpfad Dfp_OPSCD_anain" VALUE 0xCCB25 Kw_Wu8 51000. TimeDsmTsf 0.00 51000. FORMAT "%5.0" /end CHARACTERISTIC
/begin CHARACTERISTIC DSM_TsfDfp_OTSCD_C "Schwerezaehlergrenze fuer Fehlerpfad Dfp_OTSCD" VALUE 0xCCB26 Kw_Wu8 51000. TimeDsmTsf 0.00 51000. FORMAT "%5.0" /end CHARACTERISTIC
/begin CHARACTERISTIC DSM_TsfDfp_OvRMon_C "Schwerezaehlergrenze fuer Fehlerpfad Dfp_OvRMon" VALUE 0xCCB27 Kw_Wu8 51000. TimeDsmTsf 0.00 51000. FORMAT "%5.0" /end CHARACTERISTIC
/begin CHARACTERISTIC DSM_TsfDfp_OvRMonBrk_C "Schwerezaehlergrenze fuer Fehlerpfad Dfp_OvRMonBrk" VALUE 0xCCB28 Kw_Wu8 51000. TimeDsmTsf 0.00 51000. FORMAT "%5.0" /end CHARACTERISTIC
/begin CHARACTERISTIC DSM_TsfDfp_OvRMonSigA_C "Schwerezaehlergrenze fuer Fehlerpfad Dfp_OvRMonSigA" VALUE 0xCCB29 Kw_Wu8 51000. TimeDsmTsf 0.00 51000. FORMAT "%5.0" /end CHARACTERISTIC
/begin CHARACTERISTIC DSM_TsfDfp_OxiCCDTPre_C "Schwerezaehlergrenze fuer Fehlerpfad Dfp_OxiCCDTPre" VALUE 0xCCB2A Kw_Wu8 51000. TimeDsmTsf 0.00 51000. FORMAT "%5.0" /end CHARACTERISTIC
/begin CHARACTERISTIC DSM_TsfDfp_PCR_GovDevNeg_C "Schwerezaehlergrenze fuer Fehlerpfad Dfp_PCR_GovDevNeg" VALUE 0xCCB2B Kw_Wu8 51000. TimeDsmTsf 0.00 51000. FORMAT "%5.0" /end CHARACTERISTIC
/begin CHARACTERISTIC DSM_TsfDfp_PCR_GovDevPos_C "Schwerezaehlergrenze fuer Fehlerpfad Dfp_PCR_GovDevPos" VALUE 0xCCB2C Kw_Wu8 51000. TimeDsmTsf 0.00 51000. FORMAT "%5.0" /end CHARACTERISTIC
/begin CHARACTERISTIC DSM_TsfDfp_PCVCDNoLoad_C "Schwerezaehlergrenze fuer Fehlerpfad Dfp_PCVCDNoLoad" VALUE 0xCCB2D Kw_Wu8 51000. TimeDsmTsf 0.00 51000. FORMAT "%5.0" /end CHARACTERISTIC
/begin CHARACTERISTIC DSM_TsfDfp_PCVCDSCBat_C "Schwerezaehlergrenze fuer Fehlerpfad Dfp_PCVCDSCBat" VALUE 0xCCB2E Kw_Wu8 51000. TimeDsmTsf 0.00 51000. FORMAT "%5.0" /end CHARACTERISTIC
/begin CHARACTERISTIC DSM_TsfDfp_PCVCDSCGnd_C "Schwerezaehlergrenze fuer Fehlerpfad Dfp_PCVCDSCGnd" VALUE 0xCCB2F Kw_Wu8 51000. TimeDsmTsf 0.00 51000. FORMAT "%5.0" /end CHARACTERISTIC
/begin CHARACTERISTIC DSM_TsfDfp_PCVCD_ADC_C "Schwerezaehlergrenze fuer Fehlerpfad Dfp_PCVCD_ADC" VALUE 0xCCB30 Kw_Wu8 51000. TimeDsmTsf 0.00 51000. FORMAT "%5.0" /end CHARACTERISTIC
/begin CHARACTERISTIC DSM_TsfDfp_PCVCD_SigTst_C "Schwerezaehlergrenze fuer Fehlerpfad Dfp_PCVCD_SigTst" VALUE 0xCCB31 Kw_Wu8 51000. TimeDsmTsf 0.00 51000. FORMAT "%5.0" /end CHARACTERISTIC
/begin CHARACTERISTIC DSM_TsfDfp_PFltAPSens_C "Schwerezaehlergrenze fuer Fehlerpfad Dfp_PFltAPSens" VALUE 0xCCB32 Kw_Wu8 51000. TimeDsmTsf 0.00 51000. FORMAT "%5.0" /end CHARACTERISTIC
/begin CHARACTERISTIC DSM_TsfDfp_PFltCDPPre_C "Schwerezaehlergrenze fuer Fehlerpfad Dfp_PFltCDPPre" VALUE 0xCCB33 Kw_Wu8 51000. TimeDsmTsf 0.00 51000. FORMAT "%5.0" /end CHARACTERISTIC
/begin CHARACTERISTIC DSM_TsfDfp_PFltCDTempPre_C "Schwerezaehlergrenze fuer Fehlerpfad Dfp_PFltCDTempPre" VALUE 0xCCB34 Kw_Wu8 51000. TimeDsmTsf 0.00 51000. FORMAT "%5.0" /end CHARACTERISTIC
/begin CHARACTERISTIC DSM_TsfDfp_PFltChar_C "Schwerezaehlergrenze fuer Fehlerpfad Dfp_PFltChar" VALUE 0xCCB35 Kw_Wu8 51000. TimeDsmTsf 0.00 51000. FORMAT "%5.0" /end CHARACTERISTIC
/begin CHARACTERISTIC DSM_TsfDfp_PFltEngPrt_C "Schwerezaehlergrenze fuer Fehlerpfad Dfp_PFltEngPrt" VALUE 0xCCB36 Kw_Wu8 51000. TimeDsmTsf 0.00 51000. FORMAT "%5.0" /end CHARACTERISTIC
/begin CHARACTERISTIC DSM_TsfDfp_PFltPresDynPlaus_C "Schwerezaehlergrenze fuer Fehlerpfad Dfp_PFltPresDynPlaus" VALUE 0xCCB37 Kw_Wu8 51000. TimeDsmTsf 0.00 51000. FORMAT "%5.0" /end CHARACTERISTIC
/begin CHARACTERISTIC DSM_TsfDfp_PFltPresSens_C "Schwerezaehlergrenze fuer Fehlerpfad Dfp_PFltPresSens" VALUE 0xCCB38 Kw_Wu8 51000. TimeDsmTsf 0.00 51000. FORMAT "%5.0" /end CHARACTERISTIC
/begin CHARACTERISTIC DSM_TsfDfp_PFltPresSensFrz_C "Schwerezaehlergrenze fuer Fehlerpfad Dfp_PFltPresSensFrz" VALUE 0xCCB39 Kw_Wu8 51000. TimeDsmTsf 0.00 51000. FORMAT "%5.0" /end CHARACTERISTIC
/begin CHARACTERISTIC DSM_TsfDfp_PFltPresSensHsLn_C "Schwerezaehlergrenze fuer Fehlerpfad Dfp_PFltPresSensHsLn" VALUE 0xCCB3A Kw_Wu8 51000. TimeDsmTsf 0.00 51000. FORMAT "%5.0" /end CHARACTERISTIC
/begin CHARACTERISTIC DSM_TsfDfp_PFltPresSensSot_C "Schwerezaehlergrenze fuer Fehlerpfad Dfp_PFltPresSensSot" VALUE 0xCCB3B Kw_Wu8 51000. TimeDsmTsf 0.00 51000. FORMAT "%5.0" /end CHARACTERISTIC
/begin CHARACTERISTIC DSM_TsfDfp_PFltRgnPerm_C "Schwerezaehlergrenze fuer Fehlerpfad Dfp_PFltRgnPerm" VALUE 0xCCB3C Kw_Wu8 51000. TimeDsmTsf 0.00 51000. FORMAT "%5.0" /end CHARACTERISTIC
/begin CHARACTERISTIC DSM_TsfDfp_PFltTempDwnStrm_C "Schwerezaehlergrenze fuer Fehlerpfad Dfp_PFltTempDwnStrm" VALUE 0xCCB3D Kw_Wu8 51000. TimeDsmTsf 0.00 51000. FORMAT "%5.0" /end CHARACTERISTIC
/begin CHARACTERISTIC DSM_TsfDfp_PFltTempSens_C "Schwerezaehlergrenze fuer Fehlerpfad Dfp_PFltTempSens" VALUE 0xCCB3E Kw_Wu8 51000. TimeDsmTsf 0.00 51000. FORMAT "%5.0" /end CHARACTERISTIC
/begin CHARACTERISTIC DSM_TsfDfp_PFltTempUpStrm_C "Schwerezaehlergrenze fuer Fehlerpfad Dfp_PFltTempUpStrm" VALUE 0xCCB3F Kw_Wu8 51000. TimeDsmTsf 0.00 51000. FORMAT "%5.0" /end CHARACTERISTIC
/begin CHARACTERISTIC DSM_TsfDfp_PFltmSotDiffMax_C "Schwerezaehlergrenze fuer Fehlerpfad Dfp_PFltmSotDiffMax" VALUE 0xCCB40 Kw_Wu8 51000. TimeDsmTsf 0.00 51000. FORMAT "%5.0" /end CHARACTERISTIC
/begin CHARACTERISTIC DSM_TsfDfp_PSPCD_Actr_C "Schwerezaehlergrenze fuer Fehlerpfad Dfp_PSPCD_Actr" VALUE 0xCCB41 Kw_Wu8 51000. TimeDsmTsf 0.00 51000. FORMAT "%5.0" /end CHARACTERISTIC
/begin CHARACTERISTIC DSM_TsfDfp_QLTCD_C "Schwerezaehlergrenze fuer Fehlerpfad Dfp_QLTCD" VALUE 0xCCB42 Kw_Wu8 51000. TimeDsmTsf 0.00 51000. FORMAT "%5.0" /end CHARACTERISTIC
/begin CHARACTERISTIC DSM_TsfDfp_RailCD_C "Schwerezaehlergrenze fuer Fehlerpfad Dfp_RailCD" VALUE 0xCCB43 Kw_Wu8 51000. TimeDsmTsf 0.00 51000. FORMAT "%5.0" /end CHARACTERISTIC
/begin CHARACTERISTIC DSM_TsfDfp_RailCDOfsTst_C "Schwerezaehlergrenze fuer Fehlerpfad Dfp_RailCDOfsTst" VALUE 0xCCB44 Kw_Wu8 51000. TimeDsmTsf 0.00 51000. FORMAT "%5.0" /end CHARACTERISTIC
/begin CHARACTERISTIC DSM_TsfDfp_RailCD_PMonStrt_C "Schwerezaehlergrenze fuer Fehlerpfad Dfp_RailCD_PMonStrt" VALUE 0xCCB45 Kw_Wu8 51000. TimeDsmTsf 0.00 51000. FORMAT "%5.0" /end CHARACTERISTIC
/begin CHARACTERISTIC DSM_TsfDfp_RailCtlModeMeUnDiag_C "Schwerezaehlergrenze fuer Fehlerpfad Dfp_RailCtlModeMeUnDiag" VALUE 0xCCB46 Kw_Wu8 51000. TimeDsmTsf 0.00 51000. FORMAT "%5.0" /end CHARACTERISTIC
/begin CHARACTERISTIC DSM_TsfDfp_RailCtlModePCVDiag_C "Schwerezaehlergrenze fuer Fehlerpfad Dfp_RailCtlModePCVDiag" VALUE 0xCCB47 Kw_Wu8 51000. TimeDsmTsf 0.00 51000. FORMAT "%5.0" /end CHARACTERISTIC
/begin CHARACTERISTIC DSM_TsfDfp_RailMeUn0_C "Schwerezaehlergrenze fuer Fehlerpfad Dfp_RailMeUn0" VALUE 0xCCB48 Kw_Wu8 51000. TimeDsmTsf 0.00 51000. FORMAT "%5.0" /end CHARACTERISTIC
/begin CHARACTERISTIC DSM_TsfDfp_RailMeUn1_C "Schwerezaehlergrenze fuer Fehlerpfad Dfp_RailMeUn1" VALUE 0xCCB49 Kw_Wu8 51000. TimeDsmTsf 0.00 51000. FORMAT "%5.0" /end CHARACTERISTIC
/begin CHARACTERISTIC DSM_TsfDfp_RailMeUn2_C "Schwerezaehlergrenze fuer Fehlerpfad Dfp_RailMeUn2" VALUE 0xCCB4A Kw_Wu8 51000. TimeDsmTsf 0.00 51000. FORMAT "%5.0" /end CHARACTERISTIC
/begin CHARACTERISTIC DSM_TsfDfp_RailMeUn3_C "Schwerezaehlergrenze fuer Fehlerpfad Dfp_RailMeUn3" VALUE 0xCCB4B Kw_Wu8 51000. TimeDsmTsf 0.00 51000. FORMAT "%5.0" /end CHARACTERISTIC
/begin CHARACTERISTIC DSM_TsfDfp_RailMeUn4_C "Schwerezaehlergrenze fuer Fehlerpfad Dfp_RailMeUn4" VALUE 0xCCB4C Kw_Wu8 51000. TimeDsmTsf 0.00 51000. FORMAT "%5.0" /end CHARACTERISTIC
/begin CHARACTERISTIC DSM_TsfDfp_RailPCV0_C "Schwerezaehlergrenze fuer Fehlerpfad Dfp_RailPCV0" VALUE 0xCCB4D Kw_Wu8 51000. TimeDsmTsf 0.00 51000. FORMAT "%5.0" /end CHARACTERISTIC
/begin CHARACTERISTIC DSM_TsfDfp_RailPCV1_C "Schwerezaehlergrenze fuer Fehlerpfad Dfp_RailPCV1" VALUE 0xCCB4E Kw_Wu8 51000. TimeDsmTsf 0.00 51000. FORMAT "%5.0" /end CHARACTERISTIC
/begin CHARACTERISTIC DSM_TsfDfp_RailPCV2_C "Schwerezaehlergrenze fuer Fehlerpfad Dfp_RailPCV2" VALUE 0xCCB4F Kw_Wu8 51000. TimeDsmTsf 0.00 51000. FORMAT "%5.0" /end CHARACTERISTIC
/begin CHARACTERISTIC DSM_TsfDfp_RailPCV3_C "Schwerezaehlergrenze fuer Fehlerpfad Dfp_RailPCV3" VALUE 0xCCB50 Kw_Wu8 51000. TimeDsmTsf 0.00 51000. FORMAT "%5.0" /end CHARACTERISTIC
/begin CHARACTERISTIC DSM_TsfDfp_RailPCV4_C "Schwerezaehlergrenze fuer Fehlerpfad Dfp_RailPCV4" VALUE 0xCCB51 Kw_Wu8 51000. TimeDsmTsf 0.00 51000. FORMAT "%5.0" /end CHARACTERISTIC
/begin CHARACTERISTIC DSM_TsfDfp_RailPCV5_C "Schwerezaehlergrenze fuer Fehlerpfad Dfp_RailPCV5" VALUE 0xCCB52 Kw_Wu8 51000. TimeDsmTsf 0.00 51000. FORMAT "%5.0" /end CHARACTERISTIC
/begin CHARACTERISTIC DSM_TsfDfp_SOPTst_C "Schwerezaehlergrenze fuer Fehlerpfad Dfp_SOPTst" VALUE 0xCCB53 Kw_Wu8 51000. TimeDsmTsf 0.00 51000. FORMAT "%5.0" /end CHARACTERISTIC
/begin CHARACTERISTIC DSM_TsfDfp_SSpMon1_C "Schwerezaehlergrenze fuer Fehlerpfad Dfp_SSpMon1" VALUE 0xCCB54 Kw_Wu8 51000. TimeDsmTsf 0.00 51000. FORMAT "%5.0" /end CHARACTERISTIC
/begin CHARACTERISTIC DSM_TsfDfp_SSpMon2_C "Schwerezaehlergrenze fuer Fehlerpfad Dfp_SSpMon2" VALUE 0xCCB55 Kw_Wu8 51000. TimeDsmTsf 0.00 51000. FORMAT "%5.0" /end CHARACTERISTIC
/begin CHARACTERISTIC DSM_TsfDfp_SSpMon3_C "Schwerezaehlergrenze fuer Fehlerpfad Dfp_SSpMon3" VALUE 0xCCB56 Kw_Wu8 51000. TimeDsmTsf 0.00 51000. FORMAT "%5.0" /end CHARACTERISTIC
/begin CHARACTERISTIC DSM_TsfDfp_SWChk_CycSigChkDat_C "Schwerezaehlergrenze fuer Fehlerpfad Dfp_SWChk_CycSigChkDat" VALUE 0xCCB57 Kw_Wu8 51000. TimeDsmTsf 0.00 51000. FORMAT "%5.0" /end CHARACTERISTIC
/begin CHARACTERISTIC DSM_TsfDfp_SWChk_CycSigChkPrg_C "Schwerezaehlergrenze fuer Fehlerpfad Dfp_SWChk_CycSigChkPrg" VALUE 0xCCB58 Kw_Wu8 51000. TimeDsmTsf 0.00 51000. FORMAT "%5.0" /end CHARACTERISTIC
/begin CHARACTERISTIC DSM_TsfDfp_ShutCD_C "Schwerezaehlergrenze fuer Fehlerpfad Dfp_ShutCD" VALUE 0xCCB59 Kw_Wu8 51000. TimeDsmTsf 0.00 51000. FORMAT "%5.0" /end CHARACTERISTIC
/begin CHARACTERISTIC DSM_TsfDfp_StSysTrqShutOff_C "Schwerezaehlergrenze fuer Fehlerpfad Dfp_StSysTrqShutOff" VALUE 0xCCB5A Kw_Wu8 51000. TimeDsmTsf 0.00 51000. FORMAT "%5.0" /end CHARACTERISTIC
/begin CHARACTERISTIC DSM_TsfDfp_StrtCD_Actr_C "Schwerezaehlergrenze fuer Fehlerpfad Dfp_StrtCD_Actr" VALUE 0xCCB5B Kw_Wu8 51000. TimeDsmTsf 0.00 51000. FORMAT "%5.0" /end CHARACTERISTIC
/begin CHARACTERISTIC DSM_TsfDfp_SysLamp_C "Schwerezaehlergrenze fuer Fehlerpfad Dfp_SysLamp" VALUE 0xCCB5C Kw_Wu8 51000. TimeDsmTsf 0.00 51000. FORMAT "%5.0" /end CHARACTERISTIC
/begin CHARACTERISTIC DSM_TsfDfp_T15CD_C "Schwerezaehlergrenze fuer Fehlerpfad Dfp_T15CD" VALUE 0xCCB5D Kw_Wu8 51000. TimeDsmTsf 0.00 51000. FORMAT "%5.0" /end CHARACTERISTIC
/begin CHARACTERISTIC DSM_TsfDfp_TGearbx_C "Schwerezaehlergrenze fuer Fehlerpfad Dfp_TGearbx" VALUE 0xCCB5E Kw_Wu8 51000. TimeDsmTsf 0.00 51000. FORMAT "%5.0" /end CHARACTERISTIC
/begin CHARACTERISTIC DSM_TsfDfp_TPUMon_C "Schwerezaehlergrenze fuer Fehlerpfad Dfp_TPUMon" VALUE 0xCCB5F Kw_Wu8 51000. TimeDsmTsf 0.00 51000. FORMAT "%5.0" /end CHARACTERISTIC
/begin CHARACTERISTIC DSM_TsfDfp_TVACD_Max_C "Schwerezaehlergrenze fuer Fehlerpfad Dfp_TVACD_Max" VALUE 0xCCB60 Kw_Wu8 51000. TimeDsmTsf 0.00 51000. FORMAT "%5.0" /end CHARACTERISTIC
/begin CHARACTERISTIC DSM_TsfDfp_TVACD_Min_C "Schwerezaehlergrenze fuer Fehlerpfad Dfp_TVACD_Min" VALUE 0xCCB61 Kw_Wu8 51000. TimeDsmTsf 0.00 51000. FORMAT "%5.0" /end CHARACTERISTIC
/begin CHARACTERISTIC DSM_TsfDfp_TVACD_SigNpl_C "Schwerezaehlergrenze fuer Fehlerpfad Dfp_TVACD_SigNpl" VALUE 0xCCB62 Kw_Wu8 51000. TimeDsmTsf 0.00 51000. FORMAT "%5.0" /end CHARACTERISTIC
/begin CHARACTERISTIC DSM_TsfDfp_TVACD_TVADia1_C "Schwerezaehlergrenze fuer Fehlerpfad Dfp_TVACD_TVADia1" VALUE 0xCCB63 Kw_Wu8 51000. TimeDsmTsf 0.00 51000. FORMAT "%5.0" /end CHARACTERISTIC
/begin CHARACTERISTIC DSM_TsfDfp_TVACD_TVADia2_C "Schwerezaehlergrenze fuer Fehlerpfad Dfp_TVACD_TVADia2" VALUE 0xCCB64 Kw_Wu8 51000. TimeDsmTsf 0.00 51000. FORMAT "%5.0" /end CHARACTERISTIC
/begin CHARACTERISTIC DSM_TsfDfp_TVACD_TVADia3_C "Schwerezaehlergrenze fuer Fehlerpfad Dfp_TVACD_TVADia3" VALUE 0xCCB65 Kw_Wu8 51000. TimeDsmTsf 0.00 51000. FORMAT "%5.0" /end CHARACTERISTIC
/begin CHARACTERISTIC DSM_TsfDfp_TVACD_TVADia4_C "Schwerezaehlergrenze fuer Fehlerpfad Dfp_TVACD_TVADia4" VALUE 0xCCB66 Kw_Wu8 51000. TimeDsmTsf 0.00 51000. FORMAT "%5.0" /end CHARACTERISTIC
/begin CHARACTERISTIC DSM_TsfDfp_VSACD_DioInDia1_C "Schwerezaehlergrenze fuer Fehlerpfad Dfp_VSACD_DioInDia1" VALUE 0xCCB67 Kw_Wu8 51000. TimeDsmTsf 0.00 51000. FORMAT "%5.0" /end CHARACTERISTIC
/begin CHARACTERISTIC DSM_TsfDfp_VSACD_DioInDia2_C "Schwerezaehlergrenze fuer Fehlerpfad Dfp_VSACD_DioInDia2" VALUE 0xCCB68 Kw_Wu8 51000. TimeDsmTsf 0.00 51000. FORMAT "%5.0" /end CHARACTERISTIC
/begin CHARACTERISTIC DSM_TsfDfp_VSACD_DioInDia3_C "Schwerezaehlergrenze fuer Fehlerpfad Dfp_VSACD_DioInDia3" VALUE 0xCCB69 Kw_Wu8 51000. TimeDsmTsf 0.00 51000. FORMAT "%5.0" /end CHARACTERISTIC
/begin CHARACTERISTIC DSM_TsfDfp_VSACD_DioInDia4_C "Schwerezaehlergrenze fuer Fehlerpfad Dfp_VSACD_DioInDia4" VALUE 0xCCB6A Kw_Wu8 51000. TimeDsmTsf 0.00 51000. FORMAT "%5.0" /end CHARACTERISTIC
/begin CHARACTERISTIC DSM_TsfDfp_VSACD_DioInMin_C "Schwerezaehlergrenze fuer Fehlerpfad Dfp_VSACD_DioInMin" VALUE 0xCCB6B Kw_Wu8 51000. TimeDsmTsf 0.00 51000. FORMAT "%5.0" /end CHARACTERISTIC
/begin CHARACTERISTIC DSM_TsfDfp_VSACD_Max_C "Schwerezaehlergrenze fuer Fehlerpfad Dfp_VSACD_Max" VALUE 0xCCB6C Kw_Wu8 51000. TimeDsmTsf 0.00 51000. FORMAT "%5.0" /end CHARACTERISTIC
/begin CHARACTERISTIC DSM_TsfDfp_VSACD_Min_C "Schwerezaehlergrenze fuer Fehlerpfad Dfp_VSACD_Min" VALUE 0xCCB6D Kw_Wu8 51000. TimeDsmTsf 0.00 51000. FORMAT "%5.0" /end CHARACTERISTIC
/begin CHARACTERISTIC DSM_TsfDfp_VSACD_SigNpl_C "Schwerezaehlergrenze fuer Fehlerpfad Dfp_VSACD_SigNpl" VALUE 0xCCB6E Kw_Wu8 51000. TimeDsmTsf 0.00 51000. FORMAT "%5.0" /end CHARACTERISTIC
/begin CHARACTERISTIC DSM_TsfDfp_VSACD_VSADia1_C "Schwerezaehlergrenze fuer Fehlerpfad Dfp_VSACD_VSADia1" VALUE 0xCCB6F Kw_Wu8 51000. TimeDsmTsf 0.00 51000. FORMAT "%5.0" /end CHARACTERISTIC
/begin CHARACTERISTIC DSM_TsfDfp_VSACD_VSADia2_C "Schwerezaehlergrenze fuer Fehlerpfad Dfp_VSACD_VSADia2" VALUE 0xCCB70 Kw_Wu8 51000. TimeDsmTsf 0.00 51000. FORMAT "%5.0" /end CHARACTERISTIC
/begin CHARACTERISTIC DSM_TsfDfp_VSACD_VSADia3_C "Schwerezaehlergrenze fuer Fehlerpfad Dfp_VSACD_VSADia3" VALUE 0xCCB71 Kw_Wu8 51000. TimeDsmTsf 0.00 51000. FORMAT "%5.0" /end CHARACTERISTIC
/begin CHARACTERISTIC DSM_TsfDfp_VSACD_VSADia4_C "Schwerezaehlergrenze fuer Fehlerpfad Dfp_VSACD_VSADia4" VALUE 0xCCB72 Kw_Wu8 51000. TimeDsmTsf 0.00 51000. FORMAT "%5.0" /end CHARACTERISTIC
/begin CHARACTERISTIC DSM_TsfDfp_VSSCD1_C "Schwerezaehlergrenze fuer Fehlerpfad Dfp_VSSCD1" VALUE 0xCCB73 Kw_Wu8 51000. TimeDsmTsf 0.00 51000. FORMAT "%5.0" /end CHARACTERISTIC
/begin CHARACTERISTIC DSM_TsfDfp_VSSCD2_C "Schwerezaehlergrenze fuer Fehlerpfad Dfp_VSSCD2" VALUE 0xCCB74 Kw_Wu8 51000. TimeDsmTsf 0.00 51000. FORMAT "%5.0" /end CHARACTERISTIC
/begin CHARACTERISTIC DSM_TsfDfp_WdCom_C "Schwerezaehlergrenze fuer Fehlerpfad Dfp_WdCom" VALUE 0xCCB75 Kw_Wu8 51000. TimeDsmTsf 0.00 51000. FORMAT "%5.0" /end CHARACTERISTIC
/begin CHARACTERISTIC EATSCD_uSRCMin_C "SRC Minimum Umgebungstemperatur" VALUE 0xCCB84 Kw_Ws16 5200.391 Volt 0.00 5200.391 FORMAT "%8.3" EXTENDED_LIMITS -160156.4 160151.5 /end CHARACTERISTIC
/begin CHARACTERISTIC EATSCD_uSRCMax_C "SRC Maximum Umgebungstemperatur" VALUE 0xCCB86 Kw_Ws16 5200.391 Volt 0.00 5200.391 FORMAT "%8.3" EXTENDED_LIMITS -160156.4 160151.5 /end CHARACTERISTIC
/begin CHARACTERISTIC EATSCD_tLin_CUR "Linearisierungskennlinie der Umgebungstemperatur" CURVE 0xCCB88 Kl_Xs16_Ws16 950.0000 Temp_Cels -50.1400 899.8600 FORMAT "%8.4" EXTENDED_LIMITS -3549.940 3003.560
 /begin AXIS_DESCR STD_AXIS EATSCD_uRaw Volt 25 0.00 5200.391 FORMAT "%8.3" EXTENDED_LIMITS -160156.4 160151.5 DEPOSIT ABSOLUTE /end AXIS_DESCR
/end CHARACTERISTIC
/begin CHARACTERISTIC EATSCD_DebSigDef_C "Entprellzeit defekt CAN Signal Fehler Umgebungstemperatur" VALUE 0xCCBEE Kw_Wu16 655350.0 Time_ms 0.00 655350.0 FORMAT "%8.1" /end CHARACTERISTIC
/begin CHARACTERISTIC EATSCD_DebSigOk_C "Heilungsentprellzeit CAN Signalfehler Umgebungstemperatur" VALUE 0xCCBF0 Kw_Wu16 655350.0 Time_ms 0.00 655350.0 FORMAT "%8.1" /end CHARACTERISTIC
/begin CHARACTERISTIC EATSCD_DebSRCHighDef_C "EATS Fehlerentprellungszeit fuer SRC-High" VALUE 0xCCBF2 Kw_Wu16 655350.0 Time_ms 0.00 655350.0 FORMAT "%8.1" /end CHARACTERISTIC
/begin CHARACTERISTIC EATSCD_DebSRCHighOk_C "EATS Heilungsentprellzeit fuer SRC-High" VALUE 0xCCBF4 Kw_Wu16 655350.0 Time_ms 0.00 655350.0 FORMAT "%8.1" /end CHARACTERISTIC
/begin CHARACTERISTIC EATSCD_DebSRCLowDef_C "EATS Fehlerentprellungszeit fuer SRC-Low" VALUE 0xCCBF6 Kw_Wu16 655350.0 Time_ms 0.00 655350.0 FORMAT "%8.1" /end CHARACTERISTIC
/begin CHARACTERISTIC EATSCD_DebSRCLowOk_C "EATS Heilungsentprellzeit fuer SRC-Low" VALUE 0xCCBF8 Kw_Wu16 655350.0 Time_ms 0.00 655350.0 FORMAT "%8.1" /end CHARACTERISTIC
/begin CHARACTERISTIC EATSCD_dtRmpSubs_C "Rampensteigung für Umgebungstemperatur" VALUE 0xCCBFC Kw_Wu32 6553.59899750 RmpTempCels 0.00100097656250 6553.59999847 FORMAT "%13.8" EXTENDED_LIMITS 0.00 6553.59999847 /end CHARACTERISTIC
/begin CHARACTERISTIC EATSCD_dtRmpSubsUp_C "Rampensteigung für Umschaltung der Umgebungstemperatur" VALUE 0xCCC00 Kw_Wu32 6553.59899750 RmpTempCels 0.00100097656250 6553.59999847 FORMAT "%13.8" EXTENDED_LIMITS 0.00 6553.59999847 /end CHARACTERISTIC
/begin CHARACTERISTIC EATSCD_dtRmpSubsDwn_C "Rampensteigung für Umschaltung der Umgebungstemperatur" VALUE 0xCCC04 Kw_Wu32 6553.59899750 RmpTempCels 0.00100097656250 6553.59999847 FORMAT "%13.8" EXTENDED_LIMITS 0.00 6553.59999847 /end CHARACTERISTIC
/begin CHARACTERISTIC EATSCD_numAdc_C "#SSD Applikationsparameter fuer Umgebungslufttemperatur-Fuhehler" VALUE 0xCCC08 Kw_Wu8 26.0000000000 NumPinAdc 0.00 26.0000000000 FORMAT "%13.10" /end CHARACTERISTIC
/begin CHARACTERISTIC EATSCD_dtRmpSlpUp_C "popsitive Rampensteigung" VALUE 0xCCC0C Kw_Wu32 6553598.99749 RmpTemp 1.00097656250 6553599.99847 FORMAT "%13.5" EXTENDED_LIMITS 0.00 6553599.99847 /end CHARACTERISTIC
/begin CHARACTERISTIC EATSCD_dtRmpSlpDwn_C "negative Rampensteigung" VALUE 0xCCC10 Kw_Wu32 6553598.99749 RmpTemp 1.00097656250 6553599.99847 FORMAT "%13.5" EXTENDED_LIMITS 0.00 6553599.99847 /end CHARACTERISTIC
/begin CHARACTERISTIC EATSCD_swtSensImpl_C "Schalter zur Auswahl der Umgebungstemperatur" VALUE 0xCCC14 Kw_Wu8 2.000 OneToOne 0.00 2.000 FORMAT "%5.3" EXTENDED_LIMITS 0.00 255.0 /end CHARACTERISTIC
/begin CHARACTERISTIC EATSCD_swtSigVal_C "Datensatzwert Signalquelle Umgebungsluftemperatur (ADC oder CAN)" VALUE 0xCCC15 Kw_Wu8 1.000 OneToOne 0.00 1.000 FORMAT "%5.3" EXTENDED_LIMITS 0.00 255.0 /end CHARACTERISTIC
/begin CHARACTERISTIC EATSCD_tAirSubs_C "Ersatzwert für Umgebungstemperatur" VALUE 0xCCC16 Kw_Ws16 250.0000 Temp_Cels -50.14000 199.8600 FORMAT "%8.4" EXTENDED_LIMITS -3549.940 3003.560 /end CHARACTERISTIC
/begin CHARACTERISTIC EATSCD_stSensIDWord_C "Geberkennwort Umgebungstemperatur" VALUE 0xCCC18 Kw_Wu16 65535.00 OneToOne 0.00 65535.00 FORMAT "%8.2" /end CHARACTERISTIC
/begin CHARACTERISTIC EATSCD_tDfl_C "Vorgabewert Umgebungstemperatur" VALUE 0xCCC1A Kw_Ws16 950.0000 Temp_Cels -50.1400 899.8600 FORMAT "%8.4" EXTENDED_LIMITS -3549.940 3003.560 /end CHARACTERISTIC
/begin CHARACTERISTIC EBAFCD_ctPwrStgOnMax_C "" VALUE 0xCCC1C Kw_Wu16 65535.00 OneToOne 0.00 65535.00 FORMAT "%8.2" /end CHARACTERISTIC
/begin CHARACTERISTIC EBAFCD_DebExcTempDef_C "Defect time for EXC_TEMP error" VALUE 0xCCC1E Kw_Wu16 655350.0 Time_ms 0.00 655350.0 FORMAT "%8.1" /end CHARACTERISTIC
/begin CHARACTERISTIC EBAFCD_DebExcTempOk_C "Healing time for EXC_TEMP error" VALUE 0xCCC20 Kw_Wu16 655350.0 Time_ms 0.00 655350.0 FORMAT "%8.1" /end CHARACTERISTIC
/begin CHARACTERISTIC EBAFCD_DebNoLoadDef_C "Defect time for NO_LOAD error" VALUE 0xCCC22 Kw_Wu16 655350.0 Time_ms 0.00 655350.0 FORMAT "%8.1" /end CHARACTERISTIC
/begin CHARACTERISTIC EBAFCD_DebNoLoadOk_C "Healing time for NO_LOAD error" VALUE 0xCCC24 Kw_Wu16 655350.0 Time_ms 0.00 655350.0 FORMAT "%8.1" /end CHARACTERISTIC
/begin CHARACTERISTIC EBAFCD_DebShortCircBatDef_C "Defect time for SHORT_CIRC_BAT error" VALUE 0xCCC26 Kw_Wu16 655350.0 Time_ms 0.00 655350.0 FORMAT "%8.1" /end CHARACTERISTIC
/begin CHARACTERISTIC EBAFCD_DebShortCircBatOk_C "Healing time for SHORT_CIRC_BAT error" VALUE 0xCCC28 Kw_Wu16 655350.0 Time_ms 0.00 655350.0 FORMAT "%8.1" /end CHARACTERISTIC
/begin CHARACTERISTIC EBAFCD_DebShortCircGndDef_C "Defect time for SHORT_CIRC_GND error" VALUE 0xCCC2A Kw_Wu16 655350.0 Time_ms 0.00 655350.0 FORMAT "%8.1" /end CHARACTERISTIC
/begin CHARACTERISTIC EBAFCD_DebShortCircGndOk_C "Healing time for SHORT_CIRC_GND error" VALUE 0xCCC2C Kw_Wu16 655350.0 Time_ms 0.00 655350.0 FORMAT "%8.1" /end CHARACTERISTIC
/begin CHARACTERISTIC EBAFCD_InvSigOut_C "status word for (non)/inverting output EBAFCD_stSigOut" VALUE 0xCCC2E Kw_Wu8 255.0 OneToOne 0.00 255.0 FORMAT "%5.1" /end CHARACTERISTIC
/begin CHARACTERISTIC EBAFCD_nFan_C "minimum rpm of fan to disable outout" VALUE 0xCCC30 Kw_Ws16 6000.092 FanSpd -3000.092 3000.000 FORMAT "%8.3" /end CHARACTERISTIC
/begin CHARACTERISTIC EBAFCD_numDiaOut_C "#SSD Request of test of power stage from tester" VALUE 0xCCC32 Kw_Wu8 27.0000000000 NumPinDia 0.00 27.0000000000 FORMAT "%13.10" /end CHARACTERISTIC
/begin CHARACTERISTIC EBAFCD_numDioOut_C "#SSD Selection of power stage" VALUE 0xCCC33 Kw_Wu8 10.0000000000 NumPinDioOut 0.00 10.0000000000 FORMAT "%13.10" /end CHARACTERISTIC
/begin CHARACTERISTIC EBAFCD_stSPICtl_C "" VALUE 0xCCC34 Kw_Wu8 1.000 OneToOne 0.00 1.000 FORMAT "%5.3" EXTENDED_LIMITS 0.00 255.0 /end CHARACTERISTIC
/begin CHARACTERISTIC EBAFCD_tClntTrMin_C "threshold low engine protection pressure hysteresis" VALUE 0xCCC36 Kw_Ws16 950.000 Temp_Cels -50.140 899.860 FORMAT "%8.3" EXTENDED_LIMITS -3549.940 3003.560 /end CHARACTERISTIC
/begin CHARACTERISTIC EBAFCD_tClntTrMax_C "threshold high engine protection pressure hysteresis" VALUE 0xCCC38 Kw_Ws16 950.000 Temp_Cels -50.140 899.860 FORMAT "%8.3" EXTENDED_LIMITS -3549.940 3003.560 /end CHARACTERISTIC
/begin CHARACTERISTIC EBAFCD_sttClntTrOff_C "engine protection off" VALUE 0xCCC3A Kw_Ws16 65535.00 OneToOne -32768.00 32767.00 FORMAT "%8.2" READ_ONLY /end CHARACTERISTIC
/begin CHARACTERISTIC EBAFCD_sttClntTrOn_C "engine protection on" VALUE 0xCCC3C Kw_Ws16 65535.00 OneToOne -32768.00 32767.00 FORMAT "%8.2" READ_ONLY /end CHARACTERISTIC
/begin CHARACTERISTIC EBAFCD_tClntMin_C "threshold low engine protection pressure hysteresis" VALUE 0xCCC3E Kw_Ws16 950.000 Temp_Cels -50.140 899.860 FORMAT "%8.3" EXTENDED_LIMITS -3549.940 3003.560 /end CHARACTERISTIC
/begin CHARACTERISTIC EBAFCD_tClntMax_C "threshold high engine protection pressure hysteresis" VALUE 0xCCC40 Kw_Ws16 950.000 Temp_Cels -50.140 899.860 FORMAT "%8.3" EXTENDED_LIMITS -3549.940 3003.560 /end CHARACTERISTIC
/begin CHARACTERISTIC EBAFCD_sttClntOff_C "engine protection off" VALUE 0xCCC42 Kw_Ws16 65535.00 OneToOne -32768.00 32767.00 FORMAT "%8.2" READ_ONLY /end CHARACTERISTIC
/begin CHARACTERISTIC EBAFCD_sttClntOn_C "engine protection on" VALUE 0xCCC44 Kw_Ws16 65535.00 OneToOne -32768.00 32767.00 FORMAT "%8.2" READ_ONLY /end CHARACTERISTIC
/begin CHARACTERISTIC EBAFCD_tiBtwTst_C "" VALUE 0xCCC46 Kw_Wu16 29980.00 Time_ms 20.00000 30000.00 FORMAT "%8.2" EXTENDED_LIMITS 0.00 655350.0 /end CHARACTERISTIC
/begin CHARACTERISTIC EBAFCD_tiPwrStgOn_C "" VALUE 0xCCC48 Kw_Wu16 655140.0 Time_ms 0.00 655140.0 FORMAT "%8.1" EXTENDED_LIMITS 0.00 655350.0 /end CHARACTERISTIC
/begin MEASUREMENT DfpErrCol_mp "Meßpunkt der für alle Fehlerpfade die Fehlerinformation gesammelt zur Verfügung stellt." UWORD OneToOne 1 100 0.00 65535.00 FORMAT "%8.2" ARRAY_SIZE 22 ECU_ADDRESS 0x6F8026 /end MEASUREMENT
/begin MEASUREMENT DFPM_stFCMChkCause "Message für DSM internen gebrauch (unterstützung bei DSM problemen)" UBYTE FCMChkCause 1 100 1.00000000000 15.0000000000 FORMAT "%13.10" ECU_ADDRESS 0x7F9F98 /end MEASUREMENT
/begin MEASUREMENT DfpZyfCol_mp "Meßpunkt der gesammelt für alle Fehlerpfade das Zyklus Bit (getested Info) zur Verfügung stellt." UWORD OneToOne 1 100 0.00 65535.00 FORMAT "%8.2" ARRAY_SIZE 22 ECU_ADDRESS 0x6F8052 /end MEASUREMENT
/begin MEASUREMENT DSCHED_numDefDfpArray_mp "Array von defekten DFPs welche einen ausgewählten FID verriegeln" UWORD DfpName 1 100 0.00 324.000000000 FORMAT "%13.9" ARRAY_SIZE 10 ECU_ADDRESS 0x8FEC00 /end MEASUREMENT
/begin MEASUREMENT DSCHED_numOkDfpArray_mp "Array von nicht defekten DFPs welche einen ausgewählten FID verriegeln" UWORD DfpName 1 100 0.00 324.000000000 FORMAT "%13.9" ARRAY_SIZE 20 ECU_ADDRESS 0x8FEC14 /end MEASUREMENT
/begin MEASUREMENT DSM_ctDfctPath "Anzahl der momentan defekten Fehlerpfade" UWORD OneToOne 1 100 0.00 65535.00 FORMAT "%8.2" ECU_ADDRESS 0x7F8B96 /end MEASUREMENT
/begin MEASUREMENT DSM_ctFcmEntry "Anzahl der belegten Fehlerspeichereinträge" UBYTE OneToOne 1 100 0.00 255.0 FORMAT "%5.1" ECU_ADDRESS 0x7F881D /end MEASUREMENT
/begin MEASUREMENT DSM_ctFCMEntrySize_mp "Größe eines Fehlerspeichereintrages in Bytes (Inklusive Füllbyte falls vorhanden)" UBYTE OneToOne 1 100 0.00 255.0 FORMAT "%5.1" ECU_ADDRESS 0x8FEC3C /end MEASUREMENT
/begin MEASUREMENT DSM_ctOBDPath "Anzahl der momentanen OBD-fehler im Fehlerspeicher" UBYTE OneToOne 1 100 0.00 255.0 FORMAT "%5.1" ECU_ADDRESS 0x7F881E /end MEASUREMENT
/begin MEASUREMENT DSM_ctOBDValidPath "Anzahl bestätigter OBD relevanter Fehlerspeicher Einträge." UBYTE OneToOne 1 100 0.00 255.0 FORMAT "%5.1" ECU_ADDRESS 0x7F881F /end MEASUREMENT
/begin MEASUREMENT DSM_ctPath_mp "Anzahl der existierenden Fehlerpfade" UWORD OneToOne 1 100 0.00 65535.00 FORMAT "%8.2" ECU_ADDRESS 0x8FEC3E /end MEASUREMENT
/begin MEASUREMENT DSM_ctRdyActCyc_mp "Status für jedes Readinessbit aus dem aktuellen driving cycle" UBYTE OneToOne 1 100 0.00 255.0 FORMAT "%5.1" ECU_ADDRESS 0x6F801C /end MEASUREMENT
/begin MEASUREMENT DSM_ctRdyCycCat_mp "Anzahl der für Readiness Bit Catalyst erreichten Zyklen." UBYTE OneToOne 1 100 0.00 255.0 FORMAT "%5.1" ECU_ADDRESS 0x8FEBE8 /end MEASUREMENT
/begin MEASUREMENT DSM_ctRdyCycCompr_mp "Anzahl der für Readiness Bit Comprehensive Components erreichten Zyklen." UBYTE OneToOne 1 100 0.00 255.0 FORMAT "%5.1" ECU_ADDRESS 0x8FEBE9 /end MEASUREMENT
/begin MEASUREMENT DSM_ctRdyCycEGR_mp "Anzahl der für Readiness Bit EGR erreichten Zyklen." UBYTE OneToOne 1 100 0.00 255.0 FORMAT "%5.1" ECU_ADDRESS 0x8FEBEA /end MEASUREMENT
/begin MEASUREMENT DSM_ctRdyCycFuel_mp "Anzahl der für Readiness Bit Fuel System erreichten Zyklen." UBYTE OneToOne 1 100 0.00 255.0 FORMAT "%5.1" ECU_ADDRESS 0x8FEBEB /end MEASUREMENT
/begin MEASUREMENT DSM_ctRdyCycMisf_mp "Anzahl der für Readiness Bit Misfire erreichten Zyklen." UBYTE OneToOne 1 100 0.00 255.0 FORMAT "%5.1" ECU_ADDRESS 0x8FEBEC /end MEASUREMENT
/begin MEASUREMENT DSM_ctRdyCycOxSenHt_mp "Anzahl erreichter Zyklen für Readiness Bit Oxygen Sensor Heater" UBYTE OneToOne 1 100 0.00 255.0 FORMAT "%5.1" ECU_ADDRESS 0x8FEBED /end MEASUREMENT
/begin MEASUREMENT DSM_ctRdyCycOxSen_mp "Anzahl der erreichten Zyklen für Readiness Bit Oxygen Sensor" UBYTE OneToOne 1 100 0.00 255.0 FORMAT "%5.1" ECU_ADDRESS 0x8FEBEE /end MEASUREMENT
/begin MEASUREMENT DSM_ctRdyLimCat_mp "Notwendige Anzahl Zyklen für Readiness Bit Catalyst." UBYTE OneToOne 1 100 0.00 255.0 FORMAT "%5.1" ECU_ADDRESS 0x8FEBEF /end MEASUREMENT
/begin MEASUREMENT DSM_ctRdyLimCompr_mp "Notwendige Anzahl Zyklen für Readiness Bit Comprehensive Components." UBYTE OneToOne 1 100 0.00 255.0 FORMAT "%5.1" ECU_ADDRESS 0x8FEBF0 /end MEASUREMENT
/begin MEASUREMENT DSM_ctRdyLimEGR_mp "Notwendige Anzahl Zyklen für Readiness Bit EGR." UBYTE OneToOne 1 100 0.00 255.0 FORMAT "%5.1" ECU_ADDRESS 0x8FEBF1 /end MEASUREMENT
/begin MEASUREMENT DSM_ctRdyLimFuel_mp "Notwendige Anzahl Zyklen für Readiness Bit Fuel System." UBYTE OneToOne 1 100 0.00 255.0 FORMAT "%5.1" ECU_ADDRESS 0x8FEBF2 /end MEASUREMENT
/begin MEASUREMENT DSM_ctRdyLimMisf_mp "Notwendige Anzahl Zyklen für Readiness Bit Misfire." UBYTE OneToOne 1 100 0.00 255.0 FORMAT "%5.1" ECU_ADDRESS 0x8FEBF3 /end MEASUREMENT
/begin MEASUREMENT DSM_ctRdyLimOxSenHt_mp "Notwendige Anzahl von Zyklen für Readiness Bit Oxygen Sensor Heater" UBYTE OneToOne 1 100 0.00 255.0 FORMAT "%5.1" ECU_ADDRESS 0x8FEBF4 /end MEASUREMENT
/begin MEASUREMENT DSM_ctRdyLimOxSen_mp "Notwendige Anzahl Zyklen für Readiness Bit Oxygen Sensor" UBYTE OneToOne 1 100 0.00 255.0 FORMAT "%5.1" ECU_ADDRESS 0x8FEBF5 /end MEASUREMENT
/begin MEASUREMENT DSM_ctRdyPathsCat_mp "Anzahl von Fehlerpfaden die zum Readiness Bit Catalyst gehören." UBYTE OneToOne 1 100 0.00 255.0 FORMAT "%5.1" ECU_ADDRESS 0x8FEBF6 /end MEASUREMENT
/begin MEASUREMENT DSM_ctRdyPathsCompr_mp "Anzahl von Fehlerpfaden die zum Readiness Bit Comprehensive Components gehören." UBYTE OneToOne 1 100 0.00 255.0 FORMAT "%5.1" ECU_ADDRESS 0x8FEBF7 /end MEASUREMENT
/begin MEASUREMENT DSM_ctRdyPathsEGR_mp "Anzahl von Fehlerpfaden die zum Readiness Bit EGR gehören." UBYTE OneToOne 1 100 0.00 255.0 FORMAT "%5.1" ECU_ADDRESS 0x8FEBF8 /end MEASUREMENT
/begin MEASUREMENT DSM_ctRdyPathsFuel_mp "Anzahl von Fehlerpfaden die zum Readiness Bit Fuel System gehören." UBYTE OneToOne 1 100 0.00 255.0 FORMAT "%5.1" ECU_ADDRESS 0x8FEBF9 /end MEASUREMENT
/begin MEASUREMENT DSM_ctRdyPathsMisf_mp "Anzahl von Fehlerpfaden die zum Readiness Bit Misfire gehören." UBYTE OneToOne 1 100 0.00 255.0 FORMAT "%5.1" ECU_ADDRESS 0x8FEBFA /end MEASUREMENT
/begin MEASUREMENT DSM_ctRdyPathsOxSenHt_mp "Anzahl von Fehlerpfaden, die zum Readiness Bit Oxygen Sensor Heater gehören" UBYTE OneToOne 1 100 0.00 255.0 FORMAT "%5.1" ECU_ADDRESS 0x8FEBFB /end MEASUREMENT
/begin MEASUREMENT DSM_ctRdyPathsOxSen_mp "Anzahl der Fehlerpfade die zum Readiness Bit Oxygen Sensor gehören" UBYTE OneToOne 1 100 0.00 255.0 FORMAT "%5.1" ECU_ADDRESS 0x8FEBFC /end MEASUREMENT
/begin MEASUREMENT DSM_ctRdyTstCat_mp "Anzahl von in diesem Zyklus getesteten Fehlerpfaden die zum Readiness Bit Catalyst gehören." UBYTE OneToOne 1 100 0.00 255.0 FORMAT "%5.1" ECU_ADDRESS 0x8FEBFD /end MEASUREMENT
/begin MEASUREMENT DSM_ctRdyTstCompr_mp "Anzahl von in diesem Zyklus getesteten Fehlerpfaden die zum Readiness Bit Comprehensive Components  gehören." UBYTE OneToOne 1 100 0.00 255.0 FORMAT "%5.1" ECU_ADDRESS 0x6F801E /end MEASUREMENT
/begin MEASUREMENT DSM_ctRdyTstEGR_mp "Anzahl von in diesem Zyklus getesteten Fehlerpfaden die zum Readiness Bit EGR gehören." UBYTE OneToOne 1 100 0.00 255.0 FORMAT "%5.1" ECU_ADDRESS 0x6F8020 /end MEASUREMENT
/begin MEASUREMENT DSM_ctRdyTstFuel_mp "Anzahl von in diesem Zyklus getesteten Fehlerpfaden die zum Readiness Bit Fuel System gehören." UBYTE OneToOne 1 100 0.00 255.0 FORMAT "%5.1" ECU_ADDRESS 0x6F8022 /end MEASUREMENT
/begin MEASUREMENT DSM_ctRdyTstMisf_mp "Anzahl von in diesem Zyklus getesteten Fehlerpfaden die zum Readiness Bit Misfire  gehören." UBYTE OneToOne 1 100 0.00 255.0 FORMAT "%5.1" ECU_ADDRESS 0x6F8024 /end MEASUREMENT
/begin MEASUREMENT DSM_ctRdyTstOxSenHt_mp "Anzahl von in diesem Zyklus getesteten Fehlerpfaden die zum Readiness Bit Oxygen Sensor Heater gehören." UBYTE OneToOne 1 100 0.00 255.0 FORMAT "%5.1" ECU_ADDRESS 0x8FEBFE /end MEASUREMENT
/begin MEASUREMENT DSM_ctRdyTstOxSen_mp "Anzahl von in diesem Zyklus getesteten Fehlerpfaden die zum Readiness Bit Oxygen Sensor Heater gehören." UBYTE OneToOne 1 100 0.00 255.0 FORMAT "%5.1" ECU_ADDRESS 0x8FEBFF /end MEASUREMENT
/begin MEASUREMENT DSM_ctTstPath "Anzahl der getesteten Fehlerpfade" UWORD OneToOne 1 100 0.00 65535.00 FORMAT "%8.2" ECU_ADDRESS 0x7F8B98 /end MEASUREMENT
/begin MEASUREMENT DSM_ctWUC "Anzahl der Warm Up Cycle seit dem letzten Fehlerspeicherlöschen  (PID $30)" UBYTE OneToOne 1 100 0.00 255.0 FORMAT "%5.1" ECU_ADDRESS 0x7FEF2A /end MEASUREMENT
/begin MEASUREMENT DSM_lDist "Anzahl der gefahrenen Strecke seitdem letzten Fehlerspeicherlöschen (PID $31)" UWORD OneToOne 1 100 0.00 65535.00 FORMAT "%8.2" ECU_ADDRESS 0x7FEF2C /end MEASUREMENT
/begin MEASUREMENT DSM_stCycles "Status der DSM Trigger Zyklen (WUC, DC, ...)" UBYTE OneToOne 1 100 0.00 255.0 FORMAT "%5.1" ECU_ADDRESS 0x7F8820 /end MEASUREMENT
/begin MEASUREMENT DSM_stECUMasterSlave "Statusinformation ob das Steuergerät ein Master- oder ein Slave-Steuergerät ist" UBYTE OneToOne 1 100 0.00 255.0 FORMAT "%5.1" ECU_ADDRESS 0x7F8821 /end MEASUREMENT
/begin MEASUREMENT DSM_stInhDelay "Status Fehlerverriegelungs Verzögerung (1 wenn mindestens 1 Verzögerung aktiv)" UBYTE OneToOne 1 100 0.00 255.0 FORMAT "%5.1" ECU_ADDRESS 0x7F8822 /end MEASUREMENT
/begin MEASUREMENT DSM_stMIL "DSM Mil Anforderungsstatus (1 = kontinuierlich, 2 blinkend)" UBYTE OneToOne 1 100 0.00 255.0 FORMAT "%5.1" ECU_ADDRESS 0x7F8823 /end MEASUREMENT
/begin MEASUREMENT DSM_stPID41 "Readiness Status für Diagnoseschnittstelle gemäß ISO/DIS 15031-6.5, PID41" ULONG OneToOne 1 100 0.00 4294967295.00 FORMAT "%13.2" ECU_ADDRESS 0x7F90FC /end MEASUREMENT
/begin MEASUREMENT DSM_stRdyAB "Readiness Status für Diagnoseschnittstelle gemäß SAE J1979 PID1 Byte A + B" UWORD OneToOne 1 100 0.00 65535.00 FORMAT "%8.2" ECU_ADDRESS 0x7F8B9A /end MEASUREMENT
/begin MEASUREMENT DSM_stRdyCD "Readiness Status für Diagnoseschnittstelle gemäß SAE J1979 PID1 Byte C * D" UWORD OneToOne 1 100 0.00 65535.00 FORMAT "%8.2" ECU_ADDRESS 0x7F8B9C /end MEASUREMENT
/begin MEASUREMENT DSM_stRdyCheckEnable "veroderte ready-bits der dfps, die durch die Funktion DSM_SetDfpSleep ermittelt wurden" UBYTE OneToOne 1 100 0.00 255.0 FORMAT "%5.1" ECU_ADDRESS 0x7F8824 /end MEASUREMENT
/begin MEASUREMENT DSM_stSysLamp "DSM System Lampen Anforderungsstatus (1 = kontinuierlich)" UBYTE OneToOne 1 100 0.00 255.0 FORMAT "%5.1" ECU_ADDRESS 0x7F8825 /end MEASUREMENT
/begin MEASUREMENT DSM_tiDCDelay_mp "aktuelle Zeit für Driving cycle Verzögerungszeit" UWORD OneToOne 1 100 0.00 65535.00 FORMAT "%8.2" ECU_ADDRESS 0x6F807E /end MEASUREMENT
/begin MEASUREMENT EATSCD_swtSig "Signalquelle Umgebungstemperatur (ADC oder CAN)" UBYTE OneToOne 1 100 0.00 255.0 FORMAT "%5.1" ECU_ADDRESS 0x7F8826 /end MEASUREMENT
/begin MEASUREMENT EATSCD_tAir "Umgebungstemperatur" SWORD Temp_Cels 1 100 -50.140 899.860 FORMAT "%8.3" ECU_ADDRESS 0x7F8BA2 /end MEASUREMENT
/begin MEASUREMENT EATSCD_tAirLin "linearisierter Wert der Umgebungstemperatur" SWORD Temp_Cels 1 100 -50.140 899.860 FORMAT "%8.3" ECU_ADDRESS 0x7F8BA4 /end MEASUREMENT
/begin MEASUREMENT EATSCD_uRaw "Spannungsrohwert der Umgebungstemperatur" SWORD Volt 1 100 0.00 5000.000 FORMAT "%8.3" ECU_ADDRESS 0x7F8BA6 /end MEASUREMENT
/begin MEASUREMENT EBAFCD_stSigOut "source of activation for electrical power stage of EBAFCD output" UBYTE OneToOne 1 100 0.00 255.0 FORMAT "%5.1" ECU_ADDRESS 0x7F8827 /end MEASUREMENT
/begin MEASUREMENT EBAFCD_st_mp "Status of Engine Bay Air Flap" UBYTE OneToOne 1 100 0.00 255.0 FORMAT "%5.1" ECU_ADDRESS 0x8FEC6C /end MEASUREMENT
/begin MEASUREMENT EGT_tInrBiTrb "Temperatur des inneren Reglers für Bi-Turbo Motoren." SWORD Temp_Cels 1 100 -50.140 899.860 FORMAT "%8.3" ECU_ADDRESS 0x7F8BEC /end MEASUREMENT
/begin MEASUREMENT EGT_tInrDesCorBiTrb "Vorgabe Korrekturwert des inneren Reglers für Bi_Turbo Motoren" SWORD Temp_Cels 1 100 -50.140 899.860 FORMAT "%8.3" ECU_ADDRESS 0x7F8BEE /end MEASUREMENT
/begin MEASUREMENT EGT_tInrDesInTempGvnr "Kundenspezifischer Temperaturvorgabewert des inneren Reglers." SWORD Temp_Cels 1 100 -50.140 899.860 FORMAT "%8.3" ECU_ADDRESS 0x7F8BF2 /end MEASUREMENT
/begin MEASUREMENT EGT_tOutrDesInTempGvnr "Kundenspezifischer Temperaturvorgabewert des äußeren Reglers." SWORD Temp_Cels 1 100 -50.140 899.860 FORMAT "%8.3" ECU_ADDRESS 0x7F8BF8 /end MEASUREMENT
/begin MEASUREMENT FidCol_mp "Meßpunkt der gesammelt den Zustand aller Funktionsidentifier (Fid) zur Verfügung stellt." UWORD OneToOne 1 100 0.00 65535.00 FORMAT "%8.2" ARRAY_SIZE 19 ECU_ADDRESS 0x8FEC40 /end MEASUREMENT
/begin MEASUREMENT PFlt_tOxiPst "Temperatur nach dem Oxidations Katalysator" SWORD Temp_Cels 1 100 -50.140 899.860 FORMAT "%8.3" ECU_ADDRESS 0x7F8FBC /end MEASUREMENT
/begin MEASUREMENT PFlt_tTurbPre "Temperatur vor dem Turbolader" SWORD Temp_Cels 1 100 -50.140 899.860 FORMAT "%8.3" ECU_ADDRESS 0x7F8FC6 /end MEASUREMENT
/begin MEASUREMENT Uhwe_ctAtomicLvl_mp "Interrupt Lock Level" ULONG OneToOne 1 100 0.00 4294967295.00 FORMAT "%13.2" ECU_ADDRESS 0x8FEC68 /end MEASUREMENT
/begin FUNCTION dsm_auto_trans ""
 /begin DEF_CHARACTERISTIC DSM_TypDfp_Layer_TANS_C DSM_TypDfp_ACCDCmpr_C DSM_TypDfp_ACCDPres_C DSM_TypDfp_ACCDPres1_C DSM_TypDfp_ACCDPresAna_C DSM_TypDfp_ACCDSwtin_C DSM_TypDfp_ACC_PlausTrqDes_C DSM_TypDfp_ACC_trqInr_C DSM_TypDfp_ACTrq_C DSM_TypDfp_ADCMon_C DSM_TypDfp_AFSCDIdlAdjVal_C DSM_TypDfp_AFSCDLdAdjVal_C DSM_TypDfp_AFSCD_AirTempDcyc_C DSM_TypDfp_AFSCD_PlOffsDrft_C DSM_TypDfp_AFSCD_PlSetyDrft_C DSM_TypDfp_AFSCD_SRCAirTemp_C DSM_TypDfp_AFSCD_SRCBatt_C DSM_TypDfp_AFSCD_SRCCorrAirm_C DSM_TypDfp_AFSCD_SRCRawAirm_C DSM_TypDfp_Layer_TUMG_C DSM_TypDfp_AFSCD_SRCRefSigPer_C DSM_TypDfp_AOHtCD_C DSM_TypDfp_Layer_GEN_C DSM_TypDfp_Layer_BSD_C DSM_TypDfp_AOHtCD_AOHtDia1_C DSM_TypDfp_AOHtCD_AOHtDia2_C DSM_TypDfp_AOHtCD_AOHtDia3_C DSM_TypDfp_APP1_C DSM_TypDfp_APP2_C DSM_TypDfp_APPSync_C DSM_TypDfp_APSCD_C DSM_TypDfp_ARS_C DSM_TypDfp_AccPedPlausBrk_C DSM_TypDfp_AirCtlPlateBreak_C DSM_TypDfp_Layer_QLT_C DSM_TypDfp_AirCtl_GovNegDev_C DSM_TypDfp_Layer_IBS1_C DSM_TypDfp_Layer_IBS2_C DSM_TypDfp_Layer_IBS3_C DSM_TypDfp_Layer_PMBN_C DSM_TypDfp_Layer_PMBATT_C DSM_TypDfp_AirCtl_GovNegDev2_C DSM_TypDfp_AirCtl_GovPosDev_C DSM_TypDfp_AirCtl_GovPosDev2_C DSM_TypDfp_AltCD_C DSM_TypDfp_AltCD_Load_C DSM_TypDfp_BPACD_BPADia1_C DSM_TypDfp_BPACD_BPADia2_C DSM_TypDfp_BPACD_BPADia3_C DSM_TypDfp_BPACD_Max_C DSM_TypDfp_BPACD_Min_C DSM_TypDfp_BPACD_SigNpl_C DSM_TypDfp_BPSCD_C DSM_TypDfp_BattCD_C DSM_TypDfp_BrkCD_C DSM_TypDfp_Bss_C DSM_TypDfp_CBACD_C DSM_TypDfp_CTSCD_C DSM_TypDfp_Clg_DynTst_C DSM_TypDfp_CmbChbMisfire1_C DSM_TypDfp_CmbChbMisfire2_C DSM_TypDfp_CmbChbMisfire3_C DSM_TypDfp_CmbChbMisfire4_C DSM_TypDfp_CmbChbMisfire5_C DSM_TypDfp_CmbChbMisfire6_C DSM_TypDfp_CmbChbMisfireMul_C DSM_TypDfp_CoVMDCSh_C DSM_TypDfp_ConvCD_C DSM_TypDfp_CrCCDMFL_C DSM_TypDfp_CrCtl_vCrCtl_C DSM_TypDfp_Dummy1_C DSM_TypDfp_EATSCD_C DSM_TypDfp_EBAFCD_C DSM_TypDfp_Layer_PMRUHVERL_C DSM_TypDfp_EBFCD_C DSM_TypDfp_EBTSCD_C DSM_TypDfp_EBTSCD_OvrTemp_C DSM_TypDfp_EEPCDVarMng_C DSM_TypDfp_Layer_TOENS_C DSM_TypDfp_Layer_MANHYDR_C DSM_TypDfp_Layer_MANLUFT_C DSM_TypDfp_EGPpCD_C DSM_TypDfp_EGPpCDTPreTrbn_C DSM_TypDfp_EGRCD_Max_C DSM_TypDfp_EGRCD_Min_C DSM_TypDfp_EGRCD_SigNpl_C DSM_TypDfp_EGTRgnOilDil_C DSM_TypDfp_EMCCDNoLoad1_C DSM_TypDfp_EMCCDNoLoad2_C DSM_TypDfp_EMCCDSCBat1_C DSM_TypDfp_EMCCDSCBat2_C DSM_TypDfp_EMCCDSCGnd1_C DSM_TypDfp_EMCCDSCGnd2_C DSM_TypDfp_EMCCD_ADC1_C DSM_TypDfp_EMCCD_ADC2_C DSM_TypDfp_ETClbETFltInj1_C DSM_TypDfp_ETClbETFltInj2_C DSM_TypDfp_ETClbETFltInj3_C DSM_TypDfp_ETClbETFltInj4_C DSM_TypDfp_ETClbETFltInj5_C DSM_TypDfp_ETClbETFltInj6_C DSM_TypDfp_ETClbInj1_C DSM_TypDfp_ETClbInj2_C DSM_TypDfp_ETClbInj3_C DSM_TypDfp_ETClbInj4_C DSM_TypDfp_ETClbInj5_C DSM_TypDfp_ETClbInj6_C DSM_TypDfp_EngMCaS1_C DSM_TypDfp_EngMCrS1_C DSM_TypDfp_EngMOfsCaSCrS_C DSM_TypDfp_EngPrtFWODet_C DSM_TypDfp_FBCqDvt_C DSM_TypDfp_FMTC_NonMonotonMap_C DSM_TypDfp_FTSCD_C DSM_TypDfp_FanCD_C DSM_TypDfp_FanCD_FanCtlr1_C DSM_TypDfp_FanCD_FanCtlr2_C DSM_TypDfp_FanCD_FanCtlr3_C DSM_TypDfp_FlFCD_C DSM_TypDfp_FlMngSmkDefect_C DSM_TypDfp_FrmMngASC1_C DSM_TypDfp_FrmMngASC2_C DSM_TypDfp_FrmMngASC3_C DSM_TypDfp_FrmMngASC4_C DSM_TypDfp_FrmMngBOS_RESET_C DSM_TypDfp_FrmMngBOS_RESET_2_C DSM_TypDfp_FrmMngDMANFAFS_C DSM_TypDfp_FrmMngDRMANFSSG_C DSM_TypDfp_FrmMngEGS1_C DSM_TypDfp_FrmMngEGS2_C DSM_TypDfp_FrmMngGEARBX_DATA_C DSM_TypDfp_FrmMngGEARBX_DATA2_C DSM_TypDfp_FrmMngHEAT_AC_C DSM_TypDfp_FrmMngINSTR2_C DSM_TypDfp_FrmMngINSTR3_C DSM_TypDfp_FrmMngLENKRADWINKEL_C DSM_TypDfp_FrmMngMILEAGE_RANGE_C DSM_TypDfp_FrmMngOPCRCTLACC_C DSM_TypDfp_FrmMngPRGG_CCTR_C DSM_TypDfp_FrmMngPWRMNG_LOADV_C DSM_TypDfp_FrmMngParkConsumer_C DSM_TypDfp_FrmMngRQSTGEFAN_C DSM_TypDfp_FrmMngSSGErr_C DSM_TypDfp_FrmMngSSGShOff_C DSM_TypDfp_FrmMngSTAT_ANH_C DSM_TypDfp_FrmMngSTAT_ARS_C DSM_TypDfp_FrmMngSTAT_DSC_C DSM_TypDfp_FrmMngSTAT_EKP_C DSM_TypDfp_FrmMngSTAT_KOMBI_C DSM_TypDfp_FrmMngSTAT_SITZ_C DSM_TypDfp_FrmMngStOBDGbxMilOf_C DSM_TypDfp_FrmMngStOBDGbxMilOn_C DSM_TypDfp_FrmMngTEMPRELTIME_C DSM_TypDfp_FrmMngTERMINAL_C DSM_TypDfp_FrmMngTIME_DATE_C DSM_TypDfp_FrmMngTORQUE_DSC_C DSM_TypDfp_FrmMngTORQUE_GEARBX_C DSM_TypDfp_FrmMngTrq_ReqACC_C DSM_TypDfp_FrmMngVEH_MOD_C DSM_TypDfp_FrmMngVELOCITY_C DSM_TypDfp_FrmMngWHEEL_SPEED_C DSM_TypDfp_FrmMngstCurr_C DSM_TypDfp_FrmMngswtPSPOff_C DSM_TypDfp_GearbxIncMax_C DSM_TypDfp_GlwCD_C DSM_TypDfp_GlwCDGlwCirc1_C DSM_TypDfp_GlwCDGlwCirc2_C DSM_TypDfp_GlwCDGlwCirc3_C DSM_TypDfp_GlwCDGlwCirc4_C DSM_TypDfp_GlwCDGlwCirc5_C DSM_TypDfp_GlwCDGlwCirc6_C DSM_TypDfp_GlwCDGlwCirc7_C DSM_TypDfp_GlwCDGlwCirc8_C DSM_TypDfp_GlwCtl_C DSM_TypDfp_HWEMonCom_C DSM_TypDfp_HWEMonEEPROM_C DSM_TypDfp_HWEMonRcyLocked_C DSM_TypDfp_HWEMonRcySuppressed_C DSM_TypDfp_HWEMonRcyVisible_C DSM_TypDfp_HWEMonUMaxSupply_C DSM_TypDfp_HWEMonUMinSupply_C DSM_TypDfp_IATSCD_C DSM_TypDfp_IATSCD_CATS_C DSM_TypDfp_ImmCtlImmCD_C DSM_TypDfp_ImmCtlImmEep_C DSM_TypDfp_ImmCtlMpl_C DSM_TypDfp_IndSys1_C DSM_TypDfp_IndSys2_C DSM_TypDfp_InjCrv_InjLim_C DSM_TypDfp_InjCtlAdjQnt_C DSM_TypDfp_InjCtlDrift_C DSM_TypDfp_InjVlvBnk1A_C DSM_TypDfp_InjVlvBnk1B_C DSM_TypDfp_InjVlvBnk2A_C DSM_TypDfp_InjVlvBnk2B_C DSM_TypDfp_InjVlvChipA_C DSM_TypDfp_InjVlvChipB_C DSM_TypDfp_InjVlvCyl1A_C DSM_TypDfp_InjVlvCyl1B_C DSM_TypDfp_InjVlvCyl2A_C DSM_TypDfp_InjVlvCyl2B_C DSM_TypDfp_InjVlvCyl3A_C DSM_TypDfp_InjVlvCyl3B_C DSM_TypDfp_InjVlvCyl4A_C DSM_TypDfp_InjVlvCyl4B_C DSM_TypDfp_InjVlvCyl5A_C DSM_TypDfp_InjVlvCyl5B_C DSM_TypDfp_InjVlvCyl6A_C DSM_TypDfp_InjVlvCyl6B_C DSM_TypDfp_LPACD_Max_C DSM_TypDfp_LPACD_Min_C DSM_TypDfp_LPACD_SigNpl_C DSM_TypDfp_LSUCDCircNernst0_C DSM_TypDfp_LSUCDCircPumpCur0_C DSM_TypDfp_LSUCDCircVirtGnd0_C DSM_TypDfp_LSUCDHeater0_C DSM_TypDfp_LSUCDHtCoup0_C DSM_TypDfp_LSUCDO20_C DSM_TypDfp_LSUCDO2Clb0_C DSM_TypDfp_LSUCDRiClb0_C DSM_TypDfp_LSUCDSPI0_C DSM_TypDfp_LSUCDSPIBattLow0_C DSM_TypDfp_LSUCDWireIP0_C DSM_TypDfp_LSUCtlRiExc0_C DSM_TypDfp_LSUMon1Sens_C DSM_TypDfp_LSUMon2Sens_C DSM_TypDfp_LubCD_C DSM_TypDfp_MIL_C DSM_TypDfp_MRlyCD_C DSM_TypDfp_MSidCD_Comm_C DSM_TypDfp_MSidCD_Pin_C DSM_TypDfp_MSidCD_Sel_INI_C DSM_TypDfp_MSidCD_Select_C DSM_TypDfp_MeUnCDNoLoad_C DSM_TypDfp_MeUnCDSCBat_C DSM_TypDfp_MeUnCDSCGnd_C DSM_TypDfp_MeUnCD_ADC_C DSM_TypDfp_MeUnCD_SigTst_C DSM_TypDfp_Montr_C DSM_TypDfp_NetMngDeviceA_C DSM_TypDfp_NetMngDeviceB_C DSM_TypDfp_NetMngDeviceC_C DSM_TypDfp_OPSCD_Lamp_C DSM_TypDfp_OPSCD_anain_C DSM_TypDfp_OTSCD_C DSM_TypDfp_OvRMon_C DSM_TypDfp_OvRMonBrk_C DSM_TypDfp_OvRMonSigA_C DSM_TypDfp_OxiCCDTPre_C DSM_TypDfp_PCR_GovDevNeg_C DSM_TypDfp_PCR_GovDevPos_C DSM_TypDfp_PCVCDNoLoad_C DSM_TypDfp_PCVCDSCBat_C DSM_TypDfp_PCVCDSCGnd_C DSM_TypDfp_PCVCD_ADC_C DSM_TypDfp_PCVCD_SigTst_C DSM_TypDfp_PFltAPSens_C DSM_TypDfp_PFltCDPPre_C DSM_TypDfp_PFltCDTempPre_C DSM_TypDfp_PFltChar_C DSM_TypDfp_PFltEngPrt_C DSM_TypDfp_PFltPresDynPlaus_C DSM_TypDfp_PFltPresSens_C DSM_TypDfp_PFltPresSensFrz_C DSM_TypDfp_PFltPresSensHsLn_C DSM_TypDfp_PFltPresSensSot_C DSM_TypDfp_PFltRgnPerm_C DSM_TypDfp_PFltTempDwnStrm_C DSM_TypDfp_PFltTempSens_C DSM_TypDfp_PFltTempUpStrm_C DSM_TypDfp_PFltmSotDiffMax_C DSM_TypDfp_PSPCD_Actr_C DSM_TypDfp_QLTCD_C DSM_TypDfp_RailCD_C DSM_TypDfp_RailCDOfsTst_C DSM_TypDfp_RailCD_PMonStrt_C DSM_TypDfp_RailCtlModeMeUnDiag_C DSM_TypDfp_RailCtlModePCVDiag_C DSM_TypDfp_RailMeUn0_C DSM_TypDfp_RailMeUn1_C DSM_TypDfp_RailMeUn2_C DSM_TypDfp_RailMeUn3_C DSM_TypDfp_RailMeUn4_C DSM_TypDfp_RailPCV0_C DSM_TypDfp_RailPCV1_C DSM_TypDfp_RailPCV2_C DSM_TypDfp_RailPCV3_C DSM_TypDfp_RailPCV4_C DSM_TypDfp_RailPCV5_C DSM_TypDfp_SOPTst_C DSM_TypDfp_SSpMon1_C DSM_TypDfp_SSpMon2_C DSM_TypDfp_SSpMon3_C DSM_TypDfp_SWChk_CycSigChkDat_C DSM_TypDfp_SWChk_CycSigChkPrg_C DSM_TypDfp_ShutCD_C DSM_TypDfp_StSysTrqShutOff_C DSM_TypDfp_StrtCD_Actr_C DSM_TypDfp_SysLamp_C DSM_TypDfp_T15CD_C DSM_TypDfp_TGearbx_C DSM_TypDfp_TPUMon_C DSM_TypDfp_TVACD_Max_C DSM_TypDfp_TVACD_Min_C DSM_TypDfp_TVACD_SigNpl_C DSM_TypDfp_TVACD_TVADia1_C DSM_TypDfp_TVACD_TVADia2_C DSM_TypDfp_TVACD_TVADia3_C DSM_TypDfp_TVACD_TVADia4_C DSM_TypDfp_VSACD_DioInDia1_C DSM_TypDfp_VSACD_DioInDia2_C DSM_TypDfp_VSACD_DioInDia3_C DSM_TypDfp_VSACD_DioInDia4_C DSM_TypDfp_VSACD_DioInMin_C DSM_TypDfp_VSACD_Max_C DSM_TypDfp_VSACD_Min_C DSM_TypDfp_VSACD_SigNpl_C DSM_TypDfp_VSACD_VSADia1_C DSM_TypDfp_VSACD_VSADia2_C DSM_TypDfp_VSACD_VSADia3_C DSM_TypDfp_VSACD_VSADia4_C DSM_TypDfp_VSSCD1_C DSM_TypDfp_VSSCD2_C DSM_TypDfp_WdCom_C /end DEF_CHARACTERISTIC
/end FUNCTION
/begin FUNCTION dsm_auto_tsf ""
 /begin DEF_CHARACTERISTIC DSM_TsfDfp_Layer_TANS_C DSM_TsfDfp_ACCDCmpr_C DSM_TsfDfp_ACCDPres_C DSM_TsfDfp_ACCDPres1_C DSM_TsfDfp_ACCDPresAna_C DSM_TsfDfp_ACCDSwtin_C DSM_TsfDfp_ACC_PlausTrqDes_C DSM_TsfDfp_ACC_trqInr_C DSM_TsfDfp_ACTrq_C DSM_TsfDfp_ADCMon_C DSM_TsfDfp_AFSCDIdlAdjVal_C DSM_TsfDfp_AFSCDLdAdjVal_C DSM_TsfDfp_AFSCD_AirTempDcyc_C DSM_TsfDfp_AFSCD_PlOffsDrft_C DSM_TsfDfp_AFSCD_PlSetyDrft_C DSM_TsfDfp_AFSCD_SRCAirTemp_C DSM_TsfDfp_AFSCD_SRCBatt_C DSM_TsfDfp_AFSCD_SRCCorrAirm_C DSM_TsfDfp_AFSCD_SRCRawAirm_C DSM_TsfDfp_Layer_TUMG_C DSM_TsfDfp_AFSCD_SRCRefSigPer_C DSM_TsfDfp_AOHtCD_C DSM_TsfDfp_Layer_GEN_C DSM_TsfDfp_Layer_BSD_C DSM_TsfDfp_AOHtCD_AOHtDia1_C DSM_TsfDfp_AOHtCD_AOHtDia2_C DSM_TsfDfp_AOHtCD_AOHtDia3_C DSM_TsfDfp_APP1_C DSM_TsfDfp_APP2_C DSM_TsfDfp_APPSync_C DSM_TsfDfp_APSCD_C DSM_TsfDfp_ARS_C DSM_TsfDfp_AccPedPlausBrk_C DSM_TsfDfp_AirCtlPlateBreak_C DSM_TsfDfp_Layer_QLT_C DSM_TsfDfp_AirCtl_GovNegDev_C DSM_TsfDfp_Layer_IBS1_C DSM_TsfDfp_Layer_IBS2_C DSM_TsfDfp_Layer_IBS3_C DSM_TsfDfp_Layer_PMBN_C DSM_TsfDfp_Layer_PMBATT_C DSM_TsfDfp_AirCtl_GovNegDev2_C DSM_TsfDfp_AirCtl_GovPosDev_C DSM_TsfDfp_AirCtl_GovPosDev2_C DSM_TsfDfp_AltCD_C DSM_TsfDfp_AltCD_Load_C DSM_TsfDfp_BPACD_BPADia1_C DSM_TsfDfp_BPACD_BPADia2_C DSM_TsfDfp_BPACD_BPADia3_C DSM_TsfDfp_BPACD_Max_C DSM_TsfDfp_BPACD_Min_C DSM_TsfDfp_BPACD_SigNpl_C DSM_TsfDfp_BPSCD_C DSM_TsfDfp_BattCD_C DSM_TsfDfp_BrkCD_C DSM_TsfDfp_Bss_C DSM_TsfDfp_CBACD_C DSM_TsfDfp_CTSCD_C DSM_TsfDfp_Clg_DynTst_C DSM_TsfDfp_CmbChbMisfire1_C DSM_TsfDfp_CmbChbMisfire2_C DSM_TsfDfp_CmbChbMisfire3_C DSM_TsfDfp_CmbChbMisfire4_C DSM_TsfDfp_CmbChbMisfire5_C DSM_TsfDfp_CmbChbMisfire6_C DSM_TsfDfp_CmbChbMisfireMul_C DSM_TsfDfp_CoVMDCSh_C DSM_TsfDfp_ConvCD_C DSM_TsfDfp_CrCCDMFL_C DSM_TsfDfp_CrCtl_vCrCtl_C DSM_TsfDfp_Dummy1_C DSM_TsfDfp_EATSCD_C DSM_TsfDfp_EBAFCD_C DSM_TsfDfp_Layer_PMRUHVERL_C DSM_TsfDfp_EBFCD_C DSM_TsfDfp_EBTSCD_C DSM_TsfDfp_EBTSCD_OvrTemp_C DSM_TsfDfp_EEPCDVarMng_C DSM_TsfDfp_Layer_TOENS_C DSM_TsfDfp_Layer_MANHYDR_C DSM_TsfDfp_Layer_MANLUFT_C DSM_TsfDfp_EGPpCD_C DSM_TsfDfp_EGPpCDTPreTrbn_C DSM_TsfDfp_EGRCD_Max_C DSM_TsfDfp_EGRCD_Min_C DSM_TsfDfp_EGRCD_SigNpl_C DSM_TsfDfp_EGTRgnOilDil_C DSM_TsfDfp_EMCCDNoLoad1_C DSM_TsfDfp_EMCCDNoLoad2_C DSM_TsfDfp_EMCCDSCBat1_C DSM_TsfDfp_EMCCDSCBat2_C DSM_TsfDfp_EMCCDSCGnd1_C DSM_TsfDfp_EMCCDSCGnd2_C DSM_TsfDfp_EMCCD_ADC1_C DSM_TsfDfp_EMCCD_ADC2_C DSM_TsfDfp_ETClbETFltInj1_C DSM_TsfDfp_ETClbETFltInj2_C DSM_TsfDfp_ETClbETFltInj3_C DSM_TsfDfp_ETClbETFltInj4_C DSM_TsfDfp_ETClbETFltInj5_C DSM_TsfDfp_ETClbETFltInj6_C DSM_TsfDfp_ETClbInj1_C DSM_TsfDfp_ETClbInj2_C DSM_TsfDfp_ETClbInj3_C DSM_TsfDfp_ETClbInj4_C DSM_TsfDfp_ETClbInj5_C DSM_TsfDfp_ETClbInj6_C DSM_TsfDfp_EngMCaS1_C DSM_TsfDfp_EngMCrS1_C DSM_TsfDfp_EngMOfsCaSCrS_C DSM_TsfDfp_EngPrtFWODet_C DSM_TsfDfp_FBCqDvt_C DSM_TsfDfp_FMTC_NonMonotonMap_C DSM_TsfDfp_FTSCD_C DSM_TsfDfp_FanCD_C DSM_TsfDfp_FanCD_FanCtlr1_C DSM_TsfDfp_FanCD_FanCtlr2_C DSM_TsfDfp_FanCD_FanCtlr3_C DSM_TsfDfp_FlFCD_C DSM_TsfDfp_FlMngSmkDefect_C DSM_TsfDfp_FrmMngASC1_C DSM_TsfDfp_FrmMngASC2_C DSM_TsfDfp_FrmMngASC3_C DSM_TsfDfp_FrmMngASC4_C DSM_TsfDfp_FrmMngBOS_RESET_C DSM_TsfDfp_FrmMngBOS_RESET_2_C DSM_TsfDfp_FrmMngDMANFAFS_C DSM_TsfDfp_FrmMngDRMANFSSG_C DSM_TsfDfp_FrmMngEGS1_C DSM_TsfDfp_FrmMngEGS2_C DSM_TsfDfp_FrmMngGEARBX_DATA_C DSM_TsfDfp_FrmMngGEARBX_DATA2_C DSM_TsfDfp_FrmMngHEAT_AC_C DSM_TsfDfp_FrmMngINSTR2_C DSM_TsfDfp_FrmMngINSTR3_C DSM_TsfDfp_FrmMngLENKRADWINKEL_C DSM_TsfDfp_FrmMngMILEAGE_RANGE_C DSM_TsfDfp_FrmMngOPCRCTLACC_C DSM_TsfDfp_FrmMngPRGG_CCTR_C DSM_TsfDfp_FrmMngPWRMNG_LOADV_C DSM_TsfDfp_FrmMngParkConsumer_C DSM_TsfDfp_FrmMngRQSTGEFAN_C DSM_TsfDfp_FrmMngSSGErr_C DSM_TsfDfp_FrmMngSSGShOff_C DSM_TsfDfp_FrmMngSTAT_ANH_C DSM_TsfDfp_FrmMngSTAT_ARS_C DSM_TsfDfp_FrmMngSTAT_DSC_C DSM_TsfDfp_FrmMngSTAT_EKP_C DSM_TsfDfp_FrmMngSTAT_KOMBI_C DSM_TsfDfp_FrmMngSTAT_SITZ_C DSM_TsfDfp_FrmMngStOBDGbxMilOf_C DSM_TsfDfp_FrmMngStOBDGbxMilOn_C DSM_TsfDfp_FrmMngTEMPRELTIME_C DSM_TsfDfp_FrmMngTERMINAL_C DSM_TsfDfp_FrmMngTIME_DATE_C DSM_TsfDfp_FrmMngTORQUE_DSC_C DSM_TsfDfp_FrmMngTORQUE_GEARBX_C DSM_TsfDfp_FrmMngTrq_ReqACC_C DSM_TsfDfp_FrmMngVEH_MOD_C DSM_TsfDfp_FrmMngVELOCITY_C DSM_TsfDfp_FrmMngWHEEL_SPEED_C DSM_TsfDfp_FrmMngstCurr_C DSM_TsfDfp_FrmMngswtPSPOff_C DSM_TsfDfp_GearbxIncMax_C DSM_TsfDfp_GlwCD_C DSM_TsfDfp_GlwCDGlwCirc1_C DSM_TsfDfp_GlwCDGlwCirc2_C DSM_TsfDfp_GlwCDGlwCirc3_C DSM_TsfDfp_GlwCDGlwCirc4_C DSM_TsfDfp_GlwCDGlwCirc5_C DSM_TsfDfp_GlwCDGlwCirc6_C DSM_TsfDfp_GlwCDGlwCirc7_C DSM_TsfDfp_GlwCDGlwCirc8_C DSM_TsfDfp_GlwCtl_C DSM_TsfDfp_HWEMonCom_C DSM_TsfDfp_HWEMonEEPROM_C DSM_TsfDfp_HWEMonRcyLocked_C DSM_TsfDfp_HWEMonRcySuppressed_C DSM_TsfDfp_HWEMonRcyVisible_C DSM_TsfDfp_HWEMonUMaxSupply_C DSM_TsfDfp_HWEMonUMinSupply_C DSM_TsfDfp_IATSCD_C DSM_TsfDfp_IATSCD_CATS_C DSM_TsfDfp_ImmCtlImmCD_C DSM_TsfDfp_ImmCtlImmEep_C DSM_TsfDfp_ImmCtlMpl_C DSM_TsfDfp_IndSys1_C DSM_TsfDfp_IndSys2_C DSM_TsfDfp_InjCrv_InjLim_C DSM_TsfDfp_InjCtlAdjQnt_C DSM_TsfDfp_InjCtlDrift_C DSM_TsfDfp_InjVlvBnk1A_C DSM_TsfDfp_InjVlvBnk1B_C DSM_TsfDfp_InjVlvBnk2A_C DSM_TsfDfp_InjVlvBnk2B_C DSM_TsfDfp_InjVlvChipA_C DSM_TsfDfp_InjVlvChipB_C DSM_TsfDfp_InjVlvCyl1A_C DSM_TsfDfp_InjVlvCyl1B_C DSM_TsfDfp_InjVlvCyl2A_C DSM_TsfDfp_InjVlvCyl2B_C DSM_TsfDfp_InjVlvCyl3A_C DSM_TsfDfp_InjVlvCyl3B_C DSM_TsfDfp_InjVlvCyl4A_C DSM_TsfDfp_InjVlvCyl4B_C DSM_TsfDfp_InjVlvCyl5A_C DSM_TsfDfp_InjVlvCyl5B_C DSM_TsfDfp_InjVlvCyl6A_C DSM_TsfDfp_InjVlvCyl6B_C DSM_TsfDfp_LPACD_Max_C DSM_TsfDfp_LPACD_Min_C DSM_TsfDfp_LPACD_SigNpl_C DSM_TsfDfp_LSUCDCircNernst0_C DSM_TsfDfp_LSUCDCircPumpCur0_C DSM_TsfDfp_LSUCDCircVirtGnd0_C DSM_TsfDfp_LSUCDHeater0_C DSM_TsfDfp_LSUCDHtCoup0_C DSM_TsfDfp_LSUCDO20_C DSM_TsfDfp_LSUCDO2Clb0_C DSM_TsfDfp_LSUCDRiClb0_C DSM_TsfDfp_LSUCDSPI0_C DSM_TsfDfp_LSUCDSPIBattLow0_C DSM_TsfDfp_LSUCDWireIP0_C DSM_TsfDfp_LSUCtlRiExc0_C DSM_TsfDfp_LSUMon1Sens_C DSM_TsfDfp_LSUMon2Sens_C DSM_TsfDfp_LubCD_C DSM_TsfDfp_MIL_C DSM_TsfDfp_MRlyCD_C DSM_TsfDfp_MSidCD_Comm_C DSM_TsfDfp_MSidCD_Pin_C DSM_TsfDfp_MSidCD_Sel_INI_C DSM_TsfDfp_MSidCD_Select_C DSM_TsfDfp_MeUnCDNoLoad_C DSM_TsfDfp_MeUnCDSCBat_C DSM_TsfDfp_MeUnCDSCGnd_C DSM_TsfDfp_MeUnCD_ADC_C DSM_TsfDfp_MeUnCD_SigTst_C DSM_TsfDfp_Montr_C DSM_TsfDfp_NetMngDeviceA_C DSM_TsfDfp_NetMngDeviceB_C DSM_TsfDfp_NetMngDeviceC_C DSM_TsfDfp_OPSCD_Lamp_C DSM_TsfDfp_OPSCD_anain_C DSM_TsfDfp_OTSCD_C DSM_TsfDfp_OvRMon_C DSM_TsfDfp_OvRMonBrk_C DSM_TsfDfp_OvRMonSigA_C DSM_TsfDfp_OxiCCDTPre_C DSM_TsfDfp_PCR_GovDevNeg_C DSM_TsfDfp_PCR_GovDevPos_C DSM_TsfDfp_PCVCDNoLoad_C DSM_TsfDfp_PCVCDSCBat_C DSM_TsfDfp_PCVCDSCGnd_C DSM_TsfDfp_PCVCD_ADC_C DSM_TsfDfp_PCVCD_SigTst_C DSM_TsfDfp_PFltAPSens_C DSM_TsfDfp_PFltCDPPre_C DSM_TsfDfp_PFltCDTempPre_C DSM_TsfDfp_PFltChar_C DSM_TsfDfp_PFltEngPrt_C DSM_TsfDfp_PFltPresDynPlaus_C DSM_TsfDfp_PFltPresSens_C DSM_TsfDfp_PFltPresSensFrz_C DSM_TsfDfp_PFltPresSensHsLn_C DSM_TsfDfp_PFltPresSensSot_C DSM_TsfDfp_PFltRgnPerm_C DSM_TsfDfp_PFltTempDwnStrm_C DSM_TsfDfp_PFltTempSens_C DSM_TsfDfp_PFltTempUpStrm_C DSM_TsfDfp_PFltmSotDiffMax_C DSM_TsfDfp_PSPCD_Actr_C DSM_TsfDfp_QLTCD_C DSM_TsfDfp_RailCD_C DSM_TsfDfp_RailCDOfsTst_C DSM_TsfDfp_RailCD_PMonStrt_C DSM_TsfDfp_RailCtlModeMeUnDiag_C DSM_TsfDfp_RailCtlModePCVDiag_C DSM_TsfDfp_RailMeUn0_C DSM_TsfDfp_RailMeUn1_C DSM_TsfDfp_RailMeUn2_C DSM_TsfDfp_RailMeUn3_C DSM_TsfDfp_RailMeUn4_C DSM_TsfDfp_RailPCV0_C DSM_TsfDfp_RailPCV1_C DSM_TsfDfp_RailPCV2_C DSM_TsfDfp_RailPCV3_C DSM_TsfDfp_RailPCV4_C DSM_TsfDfp_RailPCV5_C DSM_TsfDfp_SOPTst_C DSM_TsfDfp_SSpMon1_C DSM_TsfDfp_SSpMon2_C DSM_TsfDfp_SSpMon3_C DSM_TsfDfp_SWChk_CycSigChkDat_C DSM_TsfDfp_SWChk_CycSigChkPrg_C DSM_TsfDfp_ShutCD_C DSM_TsfDfp_StSysTrqShutOff_C DSM_TsfDfp_StrtCD_Actr_C DSM_TsfDfp_SysLamp_C DSM_TsfDfp_T15CD_C DSM_TsfDfp_TGearbx_C DSM_TsfDfp_TPUMon_C DSM_TsfDfp_TVACD_Max_C DSM_TsfDfp_TVACD_Min_C DSM_TsfDfp_TVACD_SigNpl_C DSM_TsfDfp_TVACD_TVADia1_C DSM_TsfDfp_TVACD_TVADia2_C DSM_TsfDfp_TVACD_TVADia3_C DSM_TsfDfp_TVACD_TVADia4_C DSM_TsfDfp_VSACD_DioInDia1_C DSM_TsfDfp_VSACD_DioInDia2_C DSM_TsfDfp_VSACD_DioInDia3_C DSM_TsfDfp_VSACD_DioInDia4_C DSM_TsfDfp_VSACD_DioInMin_C DSM_TsfDfp_VSACD_Max_C DSM_TsfDfp_VSACD_Min_C DSM_TsfDfp_VSACD_SigNpl_C DSM_TsfDfp_VSACD_VSADia1_C DSM_TsfDfp_VSACD_VSADia2_C DSM_TsfDfp_VSACD_VSADia3_C DSM_TsfDfp_VSACD_VSADia4_C DSM_TsfDfp_VSSCD1_C DSM_TsfDfp_VSSCD2_C DSM_TsfDfp_WdCom_C /end DEF_CHARACTERISTIC
/end FUNCTION
/begin FUNCTION dsm_msg ""
 /begin OUT_MEASUREMENT DFPM_stFCMChkCause DSM_ctDfctPath DSM_ctFcmEntry DSM_ctOBDPath DSM_ctOBDValidPath DSM_ctTstPath DSM_ctWUC DSM_lDist DSM_stCycles DSM_stECUMasterSlave DSM_stInhDelay DSM_stMIL DSM_stPID41 DSM_stRdyAB DSM_stRdyCD DSM_stRdyCheckEnable DSM_stSysLamp /end OUT_MEASUREMENT
/end FUNCTION
/begin FUNCTION dsm_rdy ""
 /begin DEF_CHARACTERISTIC DSM_RdyABForceMsk_C DSM_RdyCDForceMsk_C DSM_RdyOnMilEnable_C /end DEF_CHARACTERISTIC
/end FUNCTION
/begin FUNCTION dsm_rdy_msg "" /end FUNCTION
/begin FUNCTION dsm_rdy_uic ""
 /begin OUT_MEASUREMENT DSM_ctRdyActCyc_mp DSM_ctRdyCycCat_mp DSM_ctRdyCycCompr_mp DSM_ctRdyCycEGR_mp DSM_ctRdyCycFuel_mp DSM_ctRdyCycMisf_mp DSM_ctRdyCycOxSenHt_mp DSM_ctRdyCycOxSen_mp DSM_ctRdyLimCat_mp DSM_ctRdyLimCompr_mp DSM_ctRdyLimEGR_mp DSM_ctRdyLimFuel_mp DSM_ctRdyLimMisf_mp DSM_ctRdyLimOxSenHt_mp DSM_ctRdyLimOxSen_mp DSM_ctRdyPathsCat_mp DSM_ctRdyPathsCompr_mp DSM_ctRdyPathsEGR_mp DSM_ctRdyPathsFuel_mp DSM_ctRdyPathsMisf_mp DSM_ctRdyPathsOxSenHt_mp DSM_ctRdyPathsOxSen_mp DSM_ctRdyTstCat_mp DSM_ctRdyTstCompr_mp DSM_ctRdyTstEGR_mp DSM_ctRdyTstFuel_mp DSM_ctRdyTstMisf_mp DSM_ctRdyTstOxSenHt_mp DSM_ctRdyTstOxSen_mp /end OUT_MEASUREMENT
/end FUNCTION
/begin FUNCTION dsm_sy_conf "" /end FUNCTION
/begin FUNCTION dsm_uic ""
 /begin OUT_MEASUREMENT DfpErrCol_mp DfpZyfCol_mp DSCHED_numDefDfpArray_mp DSCHED_numOkDfpArray_mp DSM_ctFCMEntrySize_mp DSM_ctPath_mp DSM_tiDCDelay_mp FidCol_mp /end OUT_MEASUREMENT
/end FUNCTION
/begin FUNCTION dummy "" /end FUNCTION
/begin FUNCTION dummy_proj_msg ""
 /begin OUT_MEASUREMENT EGT_tInrBiTrb EGT_tInrDesCorBiTrb EGT_tInrDesInTempGvnr EGT_tOutrDesInTempGvnr PFlt_tOxiPst PFlt_tTurbPre /end OUT_MEASUREMENT
/end FUNCTION
/begin FUNCTION dummy_uic "" /begin OUT_MEASUREMENT Uhwe_ctAtomicLvl_mp /end OUT_MEASUREMENT /end FUNCTION
/begin FUNCTION eatscd "Umgebungslufttemperaturerfassung"
 /begin DEF_CHARACTERISTIC EATSCD_uSRCMin_C EATSCD_uSRCMax_C EATSCD_tLin_CUR EATSCD_DebSigDef_C EATSCD_DebSigOk_C EATSCD_DebSRCHighDef_C EATSCD_DebSRCHighOk_C EATSCD_DebSRCLowDef_C EATSCD_DebSRCLowOk_C EATSCD_dtRmpSubs_C EATSCD_dtRmpSubsUp_C EATSCD_dtRmpSubsDwn_C EATSCD_numAdc_C EATSCD_dtRmpSlpUp_C EATSCD_dtRmpSlpDwn_C EATSCD_swtSensImpl_C EATSCD_swtSigVal_C EATSCD_tAirSubs_C EATSCD_stSensIDWord_C EATSCD_tDfl_C /end DEF_CHARACTERISTIC
 /begin IN_MEASUREMENT EATSCD_uRaw /end IN_MEASUREMENT
/end FUNCTION
/begin FUNCTION eatscd_msg "" /begin OUT_MEASUREMENT EATSCD_swtSig EATSCD_tAir EATSCD_tAirLin EATSCD_uRaw /end OUT_MEASUREMENT /end FUNCTION
/begin FUNCTION eatscd_uic "" /end FUNCTION
/begin FUNCTION ebafcd "Abluftklappensteuerung Komponententreiber"
 /begin DEF_CHARACTERISTIC EBAFCD_ctPwrStgOnMax_C EBAFCD_DebExcTempDef_C EBAFCD_DebExcTempOk_C EBAFCD_DebNoLoadDef_C EBAFCD_DebNoLoadOk_C EBAFCD_DebShortCircBatDef_C EBAFCD_DebShortCircBatOk_C EBAFCD_DebShortCircGndDef_C EBAFCD_DebShortCircGndOk_C EBAFCD_InvSigOut_C EBAFCD_nFan_C EBAFCD_numDiaOut_C EBAFCD_numDioOut_C EBAFCD_stSPICtl_C EBAFCD_tClntTrMin_C EBAFCD_tClntTrMax_C EBAFCD_sttClntTrOff_C EBAFCD_sttClntTrOn_C EBAFCD_tClntMin_C EBAFCD_tClntMax_C EBAFCD_sttClntOff_C EBAFCD_sttClntOn_C EBAFCD_tiBtwTst_C EBAFCD_tiPwrStgOn_C /end DEF_CHARACTERISTIC
/end FUNCTION
/begin FUNCTION ebafcd_msg "" /begin OUT_MEASUREMENT EBAFCD_stSigOut /end OUT_MEASUREMENT /end FUNCTION
/begin FUNCTION ebafcd_uic "" /begin OUT_MEASUREMENT EBAFCD_st_mp /end OUT_MEASUREMENT /end FUNCTION
/begin COMPU_METHOD DfpName "Verbale Umrechnung für Fehlerpfadnamen" TAB_VERB "%6.3" "-" COMPU_TAB_REF DfpName /end COMPU_METHOD
/begin COMPU_VTAB DfpName "Verbale Umrechnung für Fehlerpfadnamen" TAB_VERB 325 0 "Dfp_unused" 1 "Dfp_Layer_TANS" 2 "Dfp_ACCDCmpr" 3 "Dfp_ACCDPres" 4 "Dfp_ACCDPres1" 5 "Dfp_ACCDPresAna" 6 "Dfp_ACCDSwtin" 7 "Dfp_ACC_PlausTrqDes" 8 "Dfp_ACC_trqInr" 9 "Dfp_ACTrq" 10 "Dfp_ADCMon" 11 "Dfp_AFSCDIdlAdjVal" 12 "Dfp_AFSCDLdAdjVal" 13 "Dfp_AFSCD_AirTempDcyc" 14 "Dfp_AFSCD_PlOffsDrft" 15 "Dfp_AFSCD_PlSetyDrft" 16 "Dfp_AFSCD_SRCAirTemp" 17 "Dfp_AFSCD_SRCBatt" 18 "Dfp_AFSCD_SRCCorrAirm" 19 "Dfp_AFSCD_SRCRawAirm" 20 "Dfp_Layer_TUMG" 21 "Dfp_AFSCD_SRCRefSigPer" 22 "Dfp_AOHtCD" 23 "Dfp_Layer_GEN" 24 "Dfp_Layer_BSD" 25 "Dfp_AOHtCD_AOHtDia1" 26 "Dfp_AOHtCD_AOHtDia2" 27 "Dfp_AOHtCD_AOHtDia3" 28 "Dfp_APP1" 29 "Dfp_APP2" 30 "Dfp_APPSync" 31 "Dfp_APSCD" 32 "Dfp_ARS" 33 "Dfp_AccPedPlausBrk" 34 "Dfp_AirCtlPlateBreak" 35 "Dfp_Layer_QLT" 36 "Dfp_AirCtl_GovNegDev" 37 "Dfp_Layer_IBS1" 38 "Dfp_Layer_IBS2" 39 "Dfp_Layer_IBS3" 40 "Dfp_Layer_PMBN" 41 "Dfp_Layer_PMBATT" 42 "Dfp_AirCtl_GovNegDev2" 43 "Dfp_AirCtl_GovPosDev" 44 "Dfp_AirCtl_GovPosDev2" 45 "Dfp_AltCD" 46 "Dfp_AltCD_Load" 47 "Dfp_BPACD_BPADia1" 48 "Dfp_BPACD_BPADia2" 49 "Dfp_BPACD_BPADia3" 50 "Dfp_BPACD_Max" 51 "Dfp_BPACD_Min" 52 "Dfp_BPACD_SigNpl" 53 "Dfp_BPSCD" 54 "Dfp_BattCD" 55 "Dfp_BrkCD" 56 "Dfp_Bss" 57 "Dfp_CBACD" 58 "Dfp_CTSCD" 59 "Dfp_Clg_DynTst" 60 "Dfp_CmbChbMisfire1" 61 "Dfp_CmbChbMisfire2" 62 "Dfp_CmbChbMisfire3" 63 "Dfp_CmbChbMisfire4" 64 "Dfp_CmbChbMisfire5" 65 "Dfp_CmbChbMisfire6" 66 "Dfp_CmbChbMisfireMul" 67 "Dfp_CoVMDCSh" 68 "Dfp_ConvCD" 69 "Dfp_CrCCDMFL" 70 "Dfp_CrCtl_vCrCtl" 71 "Dfp_Dummy1" 72 "Dfp_EATSCD" 73 "Dfp_EBAFCD" 74 "Dfp_Layer_PMRUHVERL" 75 "Dfp_EBFCD" 76 "Dfp_EBTSCD" 77 "Dfp_EBTSCD_OvrTemp" 78 "Dfp_EEPCDVarMng" 79 "Dfp_Layer_TOENS" 80 "Dfp_Layer_MANHYDR" 81 "Dfp_Layer_MANLUFT" 82 "Dfp_EGPpCD" 83 "Dfp_EGPpCDTPreTrbn" 84 "Dfp_EGRCD_Max" 85 "Dfp_EGRCD_Min" 86 "Dfp_EGRCD_SigNpl" 87 "Dfp_EGTRgnOilDil" 88 "Dfp_EMCCDNoLoad1" 89 "Dfp_EMCCDNoLoad2" 90 "Dfp_EMCCDSCBat1" 91 "Dfp_EMCCDSCBat2" 92 "Dfp_EMCCDSCGnd1" 93 "Dfp_EMCCDSCGnd2" 94 "Dfp_EMCCD_ADC1" 95 "Dfp_EMCCD_ADC2" 96 "Dfp_ETClbETFltInj1" 97 "Dfp_ETClbETFltInj2" 98 "Dfp_ETClbETFltInj3" 99 "Dfp_ETClbETFltInj4" 100 "Dfp_ETClbETFltInj5" 101 "Dfp_ETClbETFltInj6" 102 "Dfp_ETClbInj1" 103 "Dfp_ETClbInj2" 104 "Dfp_ETClbInj3" 105 "Dfp_ETClbInj4" 106 "Dfp_ETClbInj5" 107 "Dfp_ETClbInj6" 108 "Dfp_EngMCaS1" 109 "Dfp_EngMCrS1" 110 "Dfp_EngMOfsCaSCrS" 111 "Dfp_EngPrtFWODet" 112 "Dfp_FBCqDvt" 113 "Dfp_FMTC_NonMonotonMap" 114 "Dfp_FTSCD" 115 "Dfp_FanCD" 116 "Dfp_FanCD_FanCtlr1" 117 "Dfp_FanCD_FanCtlr2" 118 "Dfp_FanCD_FanCtlr3" 119 "Dfp_FlFCD" 120 "Dfp_FlMngSmkDefect" 121 "Dfp_FrmMngASC1" 122 "Dfp_FrmMngASC2" 123 "Dfp_FrmMngASC3" 124 "Dfp_FrmMngASC4" 125 "Dfp_FrmMngBOS_RESET" 126 "Dfp_FrmMngBOS_RESET_2" 127 "Dfp_FrmMngDMANFAFS" 128 "Dfp_FrmMngDRMANFSSG" 129 "Dfp_FrmMngEGS1" 130 "Dfp_FrmMngEGS2" 131 "Dfp_FrmMngGEARBX_DATA" 132 "Dfp_FrmMngGEARBX_DATA2" 133 "Dfp_FrmMngHEAT_AC" 134 "Dfp_FrmMngINSTR2" 135 "Dfp_FrmMngINSTR3" 136 "Dfp_FrmMngLENKRADWINKEL" 137 "Dfp_FrmMngMILEAGE_RANGE" 138 "Dfp_FrmMngOPCRCTLACC" 139 "Dfp_FrmMngPRGG_CCTR" 140 "Dfp_FrmMngPWRMNG_LOADV" 141 "Dfp_FrmMngParkConsumer" 142 "Dfp_FrmMngRQSTGEFAN" 143 "Dfp_FrmMngSSGErr" 144 "Dfp_FrmMngSSGShOff" 145 "Dfp_FrmMngSTAT_ANH" 146 "Dfp_FrmMngSTAT_ARS" 147 "Dfp_FrmMngSTAT_DSC" 148 "Dfp_FrmMngSTAT_EKP" 149 "Dfp_FrmMngSTAT_KOMBI" 150 "Dfp_FrmMngSTAT_SITZ" 151 "Dfp_FrmMngStOBDGbxMilOf" 152 "Dfp_FrmMngStOBDGbxMilOn" 153 "Dfp_FrmMngTEMPRELTIME" 154 "Dfp_FrmMngTERMINAL" 155 "Dfp_FrmMngTIME_DATE" 156 "Dfp_FrmMngTORQUE_DSC" 157 "Dfp_FrmMngTORQUE_GEARBX" 158 "Dfp_FrmMngTrq_ReqACC" 159 "Dfp_FrmMngVEH_MOD" 160 "Dfp_FrmMngVELOCITY" 161 "Dfp_FrmMngWHEEL_SPEED" 162 "Dfp_FrmMngstCurr" 163 "Dfp_FrmMngswtPSPOff" 164 "Dfp_GearbxIncMax" 165 "Dfp_GlwCD" 166 "Dfp_GlwCDGlwCirc1" 167 "Dfp_GlwCDGlwCirc2" 168 "Dfp_GlwCDGlwCirc3" 169 "Dfp_GlwCDGlwCirc4" 170 "Dfp_GlwCDGlwCirc5" 171 "Dfp_GlwCDGlwCirc6" 172 "Dfp_GlwCDGlwCirc7" 173 "Dfp_GlwCDGlwCirc8" 174 "Dfp_GlwCtl" 175 "Dfp_HWEMonCom" 176 "Dfp_HWEMonEEPROM" 177 "Dfp_HWEMonRcyLocked" 178 "Dfp_HWEMonRcySuppressed" 179 "Dfp_HWEMonRcyVisible" 180 "Dfp_HWEMonUMaxSupply" 181 "Dfp_HWEMonUMinSupply" 182 "Dfp_IATSCD" 183 "Dfp_IATSCD_CATS" 184 "Dfp_ImmCtlImmCD" 185 "Dfp_ImmCtlImmEep" 186 "Dfp_ImmCtlMpl" 187 "Dfp_IndSys1" 188 "Dfp_IndSys2" 189 "Dfp_InjCrv_InjLim" 190 "Dfp_InjCtlAdjQnt" 191 "Dfp_InjCtlDrift" 192 "Dfp_InjVlvBnk1A" 193 "Dfp_InjVlvBnk1B" 194 "Dfp_InjVlvBnk2A" 195 "Dfp_InjVlvBnk2B" 196 "Dfp_InjVlvChipA" 197 "Dfp_InjVlvChipB" 198 "Dfp_InjVlvCyl1A" 199 "Dfp_InjVlvCyl1B" 200 "Dfp_InjVlvCyl2A" 201 "Dfp_InjVlvCyl2B" 202 "Dfp_InjVlvCyl3A" 203 "Dfp_InjVlvCyl3B" 204 "Dfp_InjVlvCyl4A" 205 "Dfp_InjVlvCyl4B" 206 "Dfp_InjVlvCyl5A" 207 "Dfp_InjVlvCyl5B" 208 "Dfp_InjVlvCyl6A" 209 "Dfp_InjVlvCyl6B" 210 "Dfp_LPACD_Max" 211 "Dfp_LPACD_Min" 212 "Dfp_LPACD_SigNpl" 213 "Dfp_LSUCDCircNernst0" 214 "Dfp_LSUCDCircPumpCur0" 215 "Dfp_LSUCDCircVirtGnd0" 216 "Dfp_LSUCDHeater0" 217 "Dfp_LSUCDHtCoup0" 218 "Dfp_LSUCDO20" 219 "Dfp_LSUCDO2Clb0" 220 "Dfp_LSUCDRiClb0" 221 "Dfp_LSUCDSPI0" 222 "Dfp_LSUCDSPIBattLow0" 223 "Dfp_LSUCDWireIP0" 224 "Dfp_LSUCtlRiExc0" 225 "Dfp_LSUMon1Sens" 226 "Dfp_LSUMon2Sens" 227 "Dfp_LubCD" 228 "Dfp_MIL" 229 "Dfp_MRlyCD" 230 "Dfp_MSidCD_Comm" 231 "Dfp_MSidCD_Pin" 232 "Dfp_MSidCD_Sel_INI" 233 "Dfp_MSidCD_Select" 234 "Dfp_MeUnCDNoLoad" 235 "Dfp_MeUnCDSCBat" 236 "Dfp_MeUnCDSCGnd" 237 "Dfp_MeUnCD_ADC" 238 "Dfp_MeUnCD_SigTst" 239 "Dfp_Montr" 240 "Dfp_NetMngDeviceA" 241 "Dfp_NetMngDeviceB" 242 "Dfp_NetMngDeviceC" 243 "Dfp_OPSCD_Lamp" 244 "Dfp_OPSCD_anain" 245 "Dfp_OTSCD" 246 "Dfp_OvRMon" 247 "Dfp_OvRMonBrk" 248 "Dfp_OvRMonSigA" 249 "Dfp_OxiCCDTPre" 250 "Dfp_PCR_GovDevNeg" 251 "Dfp_PCR_GovDevPos" 252 "Dfp_PCVCDNoLoad" 253 "Dfp_PCVCDSCBat" 254 "Dfp_PCVCDSCGnd" 255 "Dfp_PCVCD_ADC" 256 "Dfp_PCVCD_SigTst" 257 "Dfp_PFltAPSens" 258 "Dfp_PFltCDPPre" 259 "Dfp_PFltCDTempPre" 260 "Dfp_PFltChar" 261 "Dfp_PFltEngPrt" 262 "Dfp_PFltPresDynPlaus" 263 "Dfp_PFltPresSens" 264 "Dfp_PFltPresSensFrz" 265 "Dfp_PFltPresSensHsLn" 266 "Dfp_PFltPresSensSot" 267 "Dfp_PFltRgnPerm" 268 "Dfp_PFltTempDwnStrm" 269 "Dfp_PFltTempSens" 270 "Dfp_PFltTempUpStrm" 271 "Dfp_PFltmSotDiffMax" 272 "Dfp_PSPCD_Actr" 273 "Dfp_QLTCD" 274 "Dfp_RailCD" 275 "Dfp_RailCDOfsTst" 276 "Dfp_RailCD_PMonStrt" 277 "Dfp_RailCtlModeMeUnDiag" 278 "Dfp_RailCtlModePCVDiag" 279 "Dfp_RailMeUn0" 280 "Dfp_RailMeUn1" 281 "Dfp_RailMeUn2" 282 "Dfp_RailMeUn3" 283 "Dfp_RailMeUn4" 284 "Dfp_RailPCV0" 285 "Dfp_RailPCV1" 286 "Dfp_RailPCV2" 287 "Dfp_RailPCV3" 288 "Dfp_RailPCV4" 289 "Dfp_RailPCV5" 290 "Dfp_SOPTst" 291 "Dfp_SSpMon1" 292 "Dfp_SSpMon2" 293 "Dfp_SSpMon3" 294 "Dfp_SWChk_CycSigChkDat" 295 "Dfp_SWChk_CycSigChkPrg" 296 "Dfp_ShutCD" 297 "Dfp_StSysTrqShutOff" 298 "Dfp_StrtCD_Actr" 299 "Dfp_SysLamp" 300 "Dfp_T15CD" 301 "Dfp_TGearbx" 302 "Dfp_TPUMon" 303 "Dfp_TVACD_Max" 304 "Dfp_TVACD_Min" 305 "Dfp_TVACD_SigNpl" 306 "Dfp_TVACD_TVADia1" 307 "Dfp_TVACD_TVADia2" 308 "Dfp_TVACD_TVADia3" 309 "Dfp_TVACD_TVADia4" 310 "Dfp_VSACD_DioInDia1" 311 "Dfp_VSACD_DioInDia2" 312 "Dfp_VSACD_DioInDia3" 313 "Dfp_VSACD_DioInDia4" 314 "Dfp_VSACD_DioInMin" 315 "Dfp_VSACD_Max" 316 "Dfp_VSACD_Min" 317 "Dfp_VSACD_SigNpl" 318 "Dfp_VSACD_VSADia1" 319 "Dfp_VSACD_VSADia2" 320 "Dfp_VSACD_VSADia3" 321 "Dfp_VSACD_VSADia4" 322 "Dfp_VSSCD1" 323 "Dfp_VSSCD2" 324 "Dfp_WdCom" /end COMPU_VTAB
/begin COMPU_METHOD FactHigh "Faktor mit Auflösung 1/4096, hauptsächlich für einen Faktorenbereich 0.1...10 verwendet" RAT_FUNC "%6.5" "-" COEFFS 0 8192 0 0 0 1 /end COMPU_METHOD
/begin COMPU_METHOD FanSpd "(MAXSINT16 / FANSPD_MAX) * phys" RAT_FUNC "%6.3" "1/min" COEFFS 0 10.9223333333333 0 0 0 1 /end COMPU_METHOD
/begin COMPU_METHOD FCMChkCause "Verbale Umrechnung für Message für DSM internen gebrauch (unterstützung bei DSM problemen)" TAB_VERB "%6.3" "-" COMPU_TAB_REF FCMChkCause /end COMPU_METHOD
/begin COMPU_VTAB FCMChkCause "Verbale Umrechnung für Message für DSM internen gebrauch (unterstützung bei DSM problemen)" TAB_VERB 15 1 "fcmEnd npl: fcmEnd > FCM_TAB_SIZE" 2 "Erf and Typ npl" 3 "fcmEnd npl: line == fcmEnd" 4 "Mem set but no entry" 5 "No Mem set but entry" 6 "Mem npl class blocked" 7 "class npl" 8 "Mil npl 1" 9 "Mil npl 2" 10 "Scatt npl" 11 "Flc npl" 12 "Hlc npl" 13 "Fcm blocked" 14 "complement npl" 15 "dpfToClear are blocked" /end COMPU_VTAB
/begin COMPU_METHOD NumPinAdc "verbale Umrechnung für ADC Signale" TAB_VERB "%6.3" "-" COMPU_TAB_REF NumPinAdc /end COMPU_METHOD
/begin COMPU_VTAB NumPinAdc "verbale Umrechnung für ADC Signale" TAB_VERB 27 0 "Water_Temperature_Sensor_182" 1 "Intake_Air_Temperature_Sensor_157" 2 "Charge_Air_Temperature_Sensor_183" 3 "Exhaust_Temperature_Sensor_2_134" 4 "Exhaust_Temperature_Sensor_1_158" 5 "1st_APP_Sensor_252" 6 "2nd_APP_Sensor_239" 7 "ADC_REF" 8 "Boost_Pressure_Sensor_154" 9 "Atmospheric_Pressure_Sensor" 10 "Battery_Voltage_Sensor" 11 "Rail_Pressure_Sensor_156" 12 "Rail_Pressure_Peak_Value_156" 13 "Booster_Voltage_Sensor" 14 "Current_MeUn_Sensor" 15 "Current_PCV_Sensor" 16 "Voltage_Bank_1" 17 "Voltage_Bank_2" 18 "Pressure_Upstream_Particle_Filter_159" 19 "Engine_Oil_Pressure_110" 20 "Temperature_ECU_PCB" 21 "Voltage_Lambda_Ua" 22 "Voltage_Lambda_Ri" 23 "EMCCD_Current_Governor1_124" 24 "EMCCD_Current_Governor2_121" 25 "ADC_DUMMY_NOT_USED" 26 "ADC_DUMMY_A_NOT_USED" /end COMPU_VTAB
/begin COMPU_METHOD NumPinDia "Verbale Umrechnung für Diagnose Signale" TAB_VERB "%6.3" "-" COMPU_TAB_REF NumPinDia /end COMPU_METHOD
/begin COMPU_VTAB NumPinDia "Verbale Umrechnung für Diagnose Signale" TAB_VERB 28 0 "CJ945_Diagnostic_Signal" 1 "AC_Compressor_DiaSig" 2 "Fuel_Pump_Diagnostic_Signal_232" 3 "Starter_234" 4 "Oil_Pressure_Lamp_Switch_245" 5 "Engine_Bay_Air_Flaps_123" 6 "Ebox_Fan_Actuator_Diagnostic_Signal_219" 7 "Shuttr_Actuator_Diagnostic_Signal_231" 8 "Twostage_TurboLoading_SW_DiaSig" 9 "DIO_OUT_DIAGNOSTIC_DUMMY_NOT_USED" 10 "Alternator" 11 "Boost_Pressure_Actuator_Diagnostic_Signal_193" 12 "EGR_Actuator_Diagnostic_Signal_194" 13 "1st_Pressure_Control_Valve_Diagnostic_Signal_172" 14 "2nd_Pressure_Control_Valve_Diagnostic_Signal_172" 15 "1st_Metering_Unit_Diagnostic_Signal_171" 16 "2nd_Metering_Unit_Diagnostic_Signal_171" 17 "Variable_Swirl_Actuator_Diagnostic_Signal_195" 18 "FAN_240" 19 "Add_On_Heater_244" 20 "EngM_Bearing_Actuator_Diagnostic_Signal_124" 21 "EngM_Bearing_Actuator_Diagnostic_Signal_121" 22 "Throttle_Valve_Diagnostic_Signal_196" 23 "Low pressure stage BPA_Diagnostic_Signal_117" 24 "PWM_DIAGNOSTIC_DUMMY_NOT_USED" 25 "1st_Sensor_Supply_Voltage_DiaSig" 26 "2nd_Sensor_Supply_Voltage_DiaSig" 27 "3rd_Sensor_Supply_Voltage_DiaSig" /end COMPU_VTAB
/begin COMPU_METHOD NumPinDioOut "Verbale Umrechnung für Digitalausgang Signale" TAB_VERB "%6.3" "-" COMPU_TAB_REF NumPinDioOut /end COMPU_METHOD
/begin COMPU_VTAB NumPinDioOut "Verbale Umrechnung für Digitalausgang Signale" TAB_VERB 11 0 "Main_Relay_220(144)" 1 "AC_Compressor" 2 "Fuel_Pump_232" 3 "Starter_234" 4 "OPS_Lamp_245" 5 "EBAF_123" 6 "Ebox_Fan_Actuator_219" 7 "Shuttr_Actuator_231" 8 "STATREG_PSOFF_Bit" 9 "Twostage_TurboLoading_120" 10 "DIO_OUT_DUMMY_NOT_USED" /end COMPU_VTAB
/begin COMPU_METHOD OneToOne "eins zu eins (physikalischer Wert ist gleich dem internen Wert)" RAT_FUNC "%6.2" "-" COEFFS 0 1 0 0 0 1 /end COMPU_METHOD
/begin COMPU_METHOD RdyOnMilEnable "Verbale Umrechnung für DSM_RdyOnMilEnable_C" TAB_VERB "%6.3" "-" COMPU_TAB_REF RdyOnMilEnable /end COMPU_METHOD
/begin COMPU_VTAB RdyOnMilEnable "Verbale Umrechnung für DSM_RdyOnMilEnable_C" TAB_VERB 2 0 "normal" 1 "set all Rdy bits on Mil ON" /end COMPU_VTAB
/begin COMPU_METHOD RmpTemp "Rampengradient für Temperatur" RAT_FUNC "%6.4" "deg C/s" COEFFS 0 655.36 0 0 0 1 /end COMPU_METHOD
/begin COMPU_METHOD RmpTempCels "temperature ramp gradient in Centigrade" RAT_FUNC "%8.7" "C/ms" COEFFS 0 655360 0 0 0 1 /end COMPU_METHOD
/begin COMPU_METHOD Temp_Cels "Temperatur dargestellt in °C (gleiche interne Darstellung wie Temp_Kelv)" RAT_FUNC "%6.1" "deg C" COEFFS 0 10 2731.4 0 0 1 /end COMPU_METHOD
/begin COMPU_METHOD TimeDsmTsf "Skalierung der DSM Schwerezähler Werte" RAT_FUNC "%6.0" "ms" COEFFS 0 0.005 0 0 0 1 /end COMPU_METHOD
/begin COMPU_METHOD Time_ms "Zeit in ms für Fehlerentprellung (DSM) und SW-Timer" RAT_FUNC "%6.1" "ms" COEFFS 0 0.1 0 0 0 1 /end COMPU_METHOD
/begin COMPU_METHOD Volt "Spannung in V (von ADC)" RAT_FUNC "%6.2" "mV" COEFFS 0 0.2046 0 0 0 1 /end COMPU_METHOD
/begin RECORD_LAYOUT Kl_Xs16_Ws16 NO_AXIS_PTS_X 1 SWORD AXIS_PTS_X 2 SWORD INDEX_INCR DIRECT FNC_VALUES 3 SWORD COLUMN_DIR DIRECT /end RECORD_LAYOUT
/begin RECORD_LAYOUT Kwb_Wu8 FNC_VALUES 1 UBYTE COLUMN_DIR DIRECT /end RECORD_LAYOUT
/begin RECORD_LAYOUT Kw_Ws16 FNC_VALUES 1 SWORD COLUMN_DIR DIRECT /end RECORD_LAYOUT
/begin RECORD_LAYOUT Kw_Wu16 FNC_VALUES 1 UWORD COLUMN_DIR DIRECT /end RECORD_LAYOUT
/begin RECORD_LAYOUT Kw_Wu32 FNC_VALUES 1 ULONG COLUMN_DIR DIRECT /end RECORD_LAYOUT
/begin RECORD_LAYOUT Kw_Wu8 FNC_VALUES 1 UBYTE COLUMN_DIR DIRECT /end RECORD_LAYOUT
/end MODULE
/end PROJECT
