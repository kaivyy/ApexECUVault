ASAP2_VERSION 1 41
/begin PROJECT MSD70 "Spray Guided DI-System with Piezo Injectors for 6-Cylinder"
/begin HEADER "_default_HeaderComment" PROJECT_NO _0B /end HEADER
/begin MODULE _default_ModuleName "_default_ModuleLongIdentifier"
/begin MOD_COMMON "_default_ModCommonComment" DEPOSIT ABSOLUTE BYTE_ORDER MSB_LAST ALIGNMENT_BYTE 1 ALIGNMENT_WORD 2 ALIGNMENT_LONG 2 ALIGNMENT_FLOAT32_IEEE 2 ALIGNMENT_FLOAT64_IEEE 4 /end MOD_COMMON
/begin MEASUREMENT A_quer "Querbeschleunigung" SWORD _CNV_R_R_Def_a_sw_b_570_CM 1 100. -64. 63.998 DISPLAY_IDENTIFIER A_QUER ECU_ADDRESS 0xd0006790 FORMAT "%7.2" /end MEASUREMENT
/begin MEASUREMENT Acfzgl "Fahrzeuglängsbeschleunigung" SBYTE _CNV_R_R_Def_ac_sb__572_CM 1 100. -32. 31.75 DISPLAY_IDENTIFIER ACFZGL ECU_ADDRESS 0xd0006792 FORMAT "%4.1" /end MEASUREMENT
/begin MEASUREMENT Acfzgq "Fahrzeugquerbeschleunigung" SBYTE _CNV_R_R_Def_ac_sb__572_CM 1 100. -32. 31.75 DISPLAY_IDENTIFIER ACFZGQ ECU_ADDRESS 0xc00025fc FORMAT "%4.1" /end MEASUREMENT
/begin MEASUREMENT Agrpos "AGR-Ventil Ist-Position" UWORD _CNV_R_R_Def_f_uw_b_576_CM 1 100. 0. 99.9984 DISPLAY_IDENTIFIER AGRPOS ECU_ADDRESS 0xd0006794 FORMAT "%8.3" /end MEASUREMENT
/begin MEASUREMENT Ba_ist_ewp "EWAPU Betriebsart" UBYTE _CNV_S_11_Def_ba_ewp_586_CM 1 100. 0. 10. DISPLAY_IDENTIFIER BA_IST_EWP ECU_ADDRESS 0xc00025fd BIT_MASK 0xFF /end MEASUREMENT
/begin MEASUREMENT Batt_class "Klassifizierung der in diesem Fzg. eingebauten Batterie" UBYTE _CNV_R_R_Def_dez_sl_575_CM 1 100. 0. 255. DISPLAY_IDENTIFIER BATT_CLASS ECU_ADDRESS 0xc0004000 FORMAT "%3.0" /end MEASUREMENT
/begin MEASUREMENT Batt_coort "Codierter Batterieeinbauort" UBYTE _CNV_R_R_Def_dez_sl_575_CM 1 100. 0. 255. DISPLAY_IDENTIFIER BATT_COORT ECU_ADDRESS 0xc00025fe FORMAT "%3.0" /end MEASUREMENT
/begin MEASUREMENT Batt_ort "Batterieeinbauort" UBYTE _CNV_R_R_Def_dez_sl_575_CM 1 100. 0. 255. DISPLAY_IDENTIFIER BATT_ORT ECU_ADDRESS 0xc00026b6 FORMAT "%3.0" /end MEASUREMENT
/begin MEASUREMENT Batt_tfil "Zeitkonstante Batterie" UWORD _CNV_R_R_Def_f_uw_b_591_CM 1 100. 0. 0.9999847412109381 DISPLAY_IDENTIFIER BATT_TFIL ECU_ADDRESS 0xc00026b4 FORMAT "%14.5" /end MEASUREMENT
/begin MEASUREMENT Bordnetz "Ausgewähltes Bordnetz(0x01 => CAN11H, 0x02 => CAN12H(BN2000))" UBYTE _CNV_R_R_Def_dez_sl_575_CM 1 100. 0. 255. DISPLAY_IDENTIFIER BORDNETZ ECU_ADDRESS 0xd0006796 FORMAT "%3.0" /end MEASUREMENT
/begin MEASUREMENT Bosbtvfbkt "Verfügbarkeit über Tester" UBYTE _CNV_R_R_Def_dez_sl_575_CM 1 100. 0. 255. DISPLAY_IDENTIFIER BOSBTVFBKT ECU_ADDRESS 0xc00025ff FORMAT "%3.0" /end MEASUREMENT
/begin MEASUREMENT Bosfxid2r "ID_Funktion_BOS_Rückstellung_2" UWORD _CNV_R_R_Def_dez_sl_575_CM 1 100. 0. 65535. DISPLAY_IDENTIFIER BOSFXID2R ECU_ADDRESS 0xc0002600 FORMAT "%5.0" /end MEASUREMENT
/begin MEASUREMENT Bosid2r "ID_2_BOS_Rückstellung_2" UBYTE _CNV_R_R_Def_dez_sl_575_CM 1 100. 0. 255. DISPLAY_IDENTIFIER BOSID2R ECU_ADDRESS 0xc0002602 FORMAT "%3.0" /end MEASUREMENT
/begin MEASUREMENT Bosjzielr "Zieltermin_Monat_BOS_Rückstellung_2" UBYTE _CNV_R_R_Def_dez_sl_575_CM 1 100. 0. 255. DISPLAY_IDENTIFIER BOSJZIELR ECU_ADDRESS 0xc0002603 FORMAT "%3.0" /end MEASUREMENT
/begin MEASUREMENT Bosjzielt "Zieltermin_Jahr vom Tester" UBYTE _CNV_R_R_Def_dez_sl_575_CM 1 100. 0. 255. DISPLAY_IDENTIFIER BOSJZIELT ECU_ADDRESS 0xc0002604 FORMAT "%3.0" /end MEASUREMENT
/begin MEASUREMENT Bosmzielr "Zieltermin_Jahr_BOS_Rückstellung_2" UBYTE _CNV_R_R_Def_dez_sl_575_CM 1 100. 0. 255. DISPLAY_IDENTIFIER BOSMZIELR ECU_ADDRESS 0xc0002605 FORMAT "%3.0" /end MEASUREMENT
/begin MEASUREMENT Bosmzielt "Zieltermin_Monat vom Tester" UBYTE _CNV_R_R_Def_dez_sl_575_CM 1 100. 0. 255. DISPLAY_IDENTIFIER BOSMZIELT ECU_ADDRESS 0xc0002606 FORMAT "%3.0" /end MEASUREMENT
/begin MEASUREMENT Bosprog2r "Prognose_Intervall_Zeit_BOS_Rückstellung_2" UBYTE _CNV_R_R_Def_dez_sl_575_CM 1 100. 0. 255. DISPLAY_IDENTIFIER BOSPROG2R ECU_ADDRESS 0xc0004001 FORMAT "%3.0" /end MEASUREMENT
/begin MEASUREMENT Bosprog2t "Prognose_Intervall_Zeit vom Tester" UBYTE _CNV_R_R_Def_dez_sl_575_CM 1 100. 0. 255. DISPLAY_IDENTIFIER BOSPROG2T ECU_ADDRESS 0xc0004c34 FORMAT "%3.0" /end MEASUREMENT
/begin MEASUREMENT Bosrlsmr "Restlaufstrecke Motoröl vom Kombi" SWORD _CNV_R_R_Def_km_sw__64_CM 1 100. -327680. 327670. DISPLAY_IDENTIFIER BOSRLSMR ECU_ADDRESS 0xc0002608 FORMAT "%6.1" /end MEASUREMENT
/begin MEASUREMENT Bosrlsmt "Restlaufstrecke Motoröl vom Tester" SWORD _CNV_R_R_Def_km_sw__64_CM 1 100. -327680. 327670. DISPLAY_IDENTIFIER BOSRLSMT ECU_ADDRESS 0xc0004c36 FORMAT "%6.1" /end MEASUREMENT
/begin MEASUREMENT Bosrw2r "Prognose_Intervall_Weg_BOS_Rückstellung_2" UBYTE _CNV_R_R_Def_km_ub__443_CM 1 100. 0. 255000. DISPLAY_IDENTIFIER BOSRW2R ECU_ADDRESS 0xc000260a FORMAT "%3.0" /end MEASUREMENT
/begin MEASUREMENT Bosrw2t "Prognose_Intervall_Weg vom Tester" UBYTE _CNV_R_R_Def_km_ub__443_CM 1 100. 0. 255000. DISPLAY_IDENTIFIER BOSRW2T ECU_ADDRESS 0xc000260b FORMAT "%3.0" /end MEASUREMENT
/begin MEASUREMENT Bosv "Verfügbarkeit vom Kombi" UBYTE _CNV_R_R_Def_dez_sl_575_CM 1 100. 0. 255. DISPLAY_IDENTIFIER BOSV ECU_ADDRESS 0xc000260c FORMAT "%3.0" /end MEASUREMENT
/begin MEASUREMENT Bsdcontrol "3 Byte Schnittstelle kt_ibs" UBYTE _CNV_R_R_Def_dez_sl_575_CM 1 100. 0. 255. DISPLAY_IDENTIFIER BSDCONTROL ECU_ADDRESS 0xc000260d FORMAT "%3.0" /end MEASUREMENT
/begin MEASUREMENT Bsddata "3 Byte Schnittstelle kt_ibs" UBYTE _CNV_R_R_Def_dez_sl_575_CM 1 100. 0. 255. DISPLAY_IDENTIFIER BSDDATA ECU_ADDRESS 0xc000260e FORMAT "%3.0" /end MEASUREMENT
/begin MEASUREMENT Bsdgencv "Chipversion Generator 1" UBYTE _CNV_R_R_Def_dez_sl_575_CM 1 100. 0. 255. DISPLAY_IDENTIFIER BSDGENCV ECU_ADDRESS 0xc0004c38 FORMAT "%3.0" /end MEASUREMENT
/begin MEASUREMENT Bsdgenregv "Reglerversion Generator 1" UBYTE _CNV_R_R_Def_dez_sl_575_CM 1 100. 0. 255. DISPLAY_IDENTIFIER BSDGENREGV ECU_ADDRESS 0xc0004c39 FORMAT "%3.0" /end MEASUREMENT
/begin MEASUREMENT Bsdregadr "3 Byte Schnittstelle für kt_ibs" UBYTE _CNV_R_R_Def_dez_sl_575_CM 1 100. 0. 255. DISPLAY_IDENTIFIER BSDREGADR ECU_ADDRESS 0xc000260f FORMAT "%3.0" /end MEASUREMENT
/begin MEASUREMENT Ctr_genms "Generatorsollspannung vom Powermodul" UWORD _CNV_R_R_Def_f_uw_b_594_CM 1 100. 0. 15.9997 DISPLAY_IDENTIFIER CTR_GENMS ECU_ADDRESS 0xc0002610 FORMAT "%9.4" /end MEASUREMENT
/begin MEASUREMENT D_la_sa1 "Lambdakorrektur bei Ende Schubabschaltung Bank 1" UWORD _CNV_R_R_Def_f_uw_b_594_CM 1 100. 0. 15.9997 DISPLAY_IDENTIFIER D_LA_SA1 ECU_ADDRESS 0xd0006798 FORMAT "%9.4" /end MEASUREMENT
/begin MEASUREMENT D_la_sa2 "Lambdakorrektur bei Ende der Schubabschaltung Bank 2" UWORD _CNV_R_R_Def_f_uw_b_594_CM 1 100. 0. 15.9997 DISPLAY_IDENTIFIER D_LA_SA2 ECU_ADDRESS 0xd000679a FORMAT "%9.4" /end MEASUREMENT
/begin MEASUREMENT Dffgen "ss_msv.dat" UBYTE _CNV_R_R_Def_f_ub_b_602_CM 1 100. 0. 99.60930000000001 DISPLAY_IDENTIFIER DFFGEN ECU_ADDRESS 0xd0007278 FORMAT "%5.2" /end MEASUREMENT
/begin MEASUREMENT Dfgrob "Grobwert Auslastungsgrad Generator 1" UBYTE _CNV_R_R_Def_dez_sl_575_CM 1 100. 0. 255. DISPLAY_IDENTIFIER DFGROB ECU_ADDRESS 0xc0002612 FORMAT "%3.0" /end MEASUREMENT
/begin MEASUREMENT Dfmonitor "DF-Monitor für FASTA" UBYTE _CNV_R_R_Def_f_ub_b_602_CM 1 100. 0. 99.60930000000001 DISPLAY_IDENTIFIER DFMONITOR ECU_ADDRESS 0xc0004644 FORMAT "%5.2" /end MEASUREMENT
/begin MEASUREMENT Dfpropval "" UWORD _CNV_R_R_Def_f_uw_b_604_CM 1 100. 0. 31.9995 DISPLAY_IDENTIFIER DFPROPVAL ECU_ADDRESS 0xd0007274 FORMAT "%9.4" /end MEASUREMENT
/begin MEASUREMENT Dfsiggen "Auslastungsgrad Generator 1" UBYTE _CNV_R_R_Def_f_ub_b_602_CM 1 100. 0. 99.60930000000001 DISPLAY_IDENTIFIER DFSIGGEN ECU_ADDRESS 0xc0002613 FORMAT "%5.2" /end MEASUREMENT
/begin MEASUREMENT Dfsumme "DFMonitor Summe FASTA" FLOAT32_IEEE _CNV_R_R_Def_dez_sl_575_CM 1 100. 1. 3.40282346638529e+038 DISPLAY_IDENTIFIER DFSUMME ECU_ADDRESS 0xc000463c FORMAT "%14.7" /end MEASUREMENT
/begin MEASUREMENT Dfwanzahl "DF-Wertezähler" FLOAT32_IEEE _CNV_R_R_Def_dez_sl_575_CM 1 100. 1. 3.40282346638529e+038 DISPLAY_IDENTIFIER DFWANZAHL ECU_ADDRESS 0xc0004640 FORMAT "%14.7" /end MEASUREMENT
/begin MEASUREMENT Disa_ist "Ist Position Disa" UWORD _CNV_R_R_Def_f_uw_b_576_CM 1 100. 0. 99.9984 DISPLAY_IDENTIFIER DISA_IST ECU_ADDRESS 0xd000679c FORMAT "%8.3" /end MEASUREMENT
/begin MEASUREMENT Dlahi1 "I-Anteil Lambdaregelung" SWORD _CNV_R_R_Def_f_sw_b_608_CM 1 100. -2. 1.9999 DISPLAY_IDENTIFIER DLAHI1 ECU_ADDRESS 0xc0004c3a FORMAT "%14.5" /end MEASUREMENT
/begin MEASUREMENT Dlahi2 "I_Anteil Lambdaregelung" SWORD _CNV_R_R_Def_f_sw_b_608_CM 1 100. -2. 1.9999 DISPLAY_IDENTIFIER DLAHI2 ECU_ADDRESS 0xc0004c3c FORMAT "%14.5" /end MEASUREMENT
/begin MEASUREMENT Dpsr "Differenzdruck Saugrohr" SWORD _CNV_R_R_Def_p_sw_q_578_CM 1 100. -1280. 1279.9609 DISPLAY_IDENTIFIER DPSR ECU_ADDRESS 0xd000679e FORMAT "%7.2" /end MEASUREMENT
/begin MEASUREMENT Dpsr_seg "Differenzdruck Saugrohr" SWORD _CNV_R_R_Def_p_sw_q_578_CM 1 100. -1280. 1279.9609 DISPLAY_IDENTIFIER DPSR_SEG ECU_ADDRESS 0xd00067a0 FORMAT "%7.2" /end MEASUREMENT
/begin MEASUREMENT Drfkh_s "Luftmassendifferenz für S - KH" SWORD _CNV_R_R_Def_rf_sw__616_CM 1 100. -327.68 327.67 DISPLAY_IDENTIFIER DRFKH_S ECU_ADDRESS 0xd00067a2 FORMAT "%9.4" /end MEASUREMENT
/begin MEASUREMENT Dwesb3_kh_s "Delta-Winkel Zündung <-> Einspritzbeginn 3. Einspritzung Schicht" SWORD _CNV_R_R_Def_kw_sw__622_CM 1 100. -768. 767.9765 DISPLAY_IDENTIFIER DWESB3_KH_S ECU_ADDRESS 0xd00067a4 FORMAT "%8.3" /end MEASUREMENT
/begin MEASUREMENT Dwese2_kh_h "Delta-Winkel Zündung <-> Einspritzende 2. Einspritzung homogen" SWORD _CNV_R_R_Def_kw_sw__622_CM 1 100. -768. 767.9765 DISPLAY_IDENTIFIER DWESE2_KH_H ECU_ADDRESS 0xd00067a6 FORMAT "%8.3" /end MEASUREMENT
/begin MEASUREMENT Dzw_agr_kor "Korrektur des Grundzündwinkels aus AGR" SWORD _CNV_R_R_Def_zw_sw__599_CM 1 100. -50. 60. DISPLAY_IDENTIFIER DZW_AGR_KOR ECU_ADDRESS 0xd00067a8 FORMAT "%6.1" /end MEASUREMENT
/begin MEASUREMENT Dzw_kh_s "Ignition angle difference Startified" SWORD _CNV_R_R_Def_zw_sw__599_CM 1 100. -50. 60. DISPLAY_IDENTIFIER DZW_KH_S ECU_ADDRESS 0xd00067aa FORMAT "%6.1" /end MEASUREMENT
/begin MEASUREMENT Dzw_kr "Zündwinkeleingriff durch Klopfregelung" SWORD _CNV_R_R_Def_zw_sw__599_CM 1 100. -50. 60. DISPLAY_IDENTIFIER DZW_KR ECU_ADDRESS 0xd00067ac FORMAT "%6.1" ARRAY_SIZE 6 MATRIX_DIM 6 1 1 /end MEASUREMENT
/begin MEASUREMENT Dzw_mkr "Mittlere Spätstellung Klopfregelung" SWORD _CNV_R_R_Def_zw_sw__599_CM 1 100. -50. 60. DISPLAY_IDENTIFIER DZW_MKR ECU_ADDRESS 0xd00067b8 FORMAT "%6.1" /end MEASUREMENT
/begin MEASUREMENT Dzw_mkrad "Mittlere Spätverstellung Klopfregelung inkl. mittlere zyl.ind. Adaption" SWORD _CNV_R_R_Def_zw_sw__599_CM 1 100. -50. 60. DISPLAY_IDENTIFIER DZW_MKRAD ECU_ADDRESS 0xc0004c3e FORMAT "%6.1" /end MEASUREMENT
/begin MEASUREMENT Eta_lambda_bas "" SWORD _CNV_R_R_Def_eta_sw_617_CM 1 100. -200. 199.9938 DISPLAY_IDENTIFIER ETA_LAMBDA_BAS ECU_ADDRESS 0xd00067ba FORMAT "%8.3" /end MEASUREMENT
/begin MEASUREMENT Eta_zw_ist1 "Aktueller Zündwinkelwirkungsgrad Bank 1" SWORD _CNV_R_R_Def_eta_sw_628_CM 1 100. 0. 100. DISPLAY_IDENTIFIER ETA_ZW_IST1 ECU_ADDRESS 0xd00067bc FORMAT "%8.3" /end MEASUREMENT
/begin MEASUREMENT Eta_zw_ist2 "Aktueller Zündwinkelwirkungsgrad Bank 2" SWORD _CNV_R_R_Def_eta_sw_628_CM 1 100. 0. 100. DISPLAY_IDENTIFIER ETA_ZW_IST2 ECU_ADDRESS 0xd00067be FORMAT "%8.3" /end MEASUREMENT
/begin MEASUREMENT Eta_zw_min "Wirkungsgrad bei minimalem Zündwinkel" SWORD _CNV_R_R_Def_eta_sw_628_CM 1 100. 0. 100. DISPLAY_IDENTIFIER ETA_ZW_MIN ECU_ADDRESS 0xc0004c40 FORMAT "%8.3" /end MEASUREMENT
/begin MEASUREMENT Eta_zw_mint "Wirkungsgrad bei minimalem Zündwinkel abh. vom Temperaturmodell" SWORD _CNV_R_R_Def_f_sw_b_597_CM 1 100. -100. 99.9969 DISPLAY_IDENTIFIER ETA_ZW_MINT ECU_ADDRESS 0xd00067c0 FORMAT "%8.3" /end MEASUREMENT
/begin MEASUREMENT Eta_zw_ve "Zylinderindividueller Zündwinkelwirkungsgrad vor Eingriff der Momentenstruktur" SWORD _CNV_R_R_Def_eta_sw_628_CM 1 100. 0. 100. DISPLAY_IDENTIFIER ETA_ZW_VE ECU_ADDRESS 0xd00067c4 FORMAT "%8.3" ARRAY_SIZE 6 MATRIX_DIM 6 1 1 /end MEASUREMENT
/begin MEASUREMENT Eta_zwve_m "Über alle Zylinder gemittelter Zündwinkelwirkungsgrad vor Eingriff der Momentenstruktur" SWORD _CNV_R_R_Def_eta_sw_628_CM 1 100. 0. 100. DISPLAY_IDENTIFIER ETA_ZWVE_M ECU_ADDRESS 0xd00067d0 FORMAT "%8.3" /end MEASUREMENT
/begin MEASUREMENT Eta_zyl_aus "Wirkungsgrad" SWORD _CNV_R_R_Def_eta_sw_628_CM 1 100. 0. 100. DISPLAY_IDENTIFIER ETA_ZYL_AUS ECU_ADDRESS 0xd00067d2 FORMAT "%8.3" /end MEASUREMENT
/begin MEASUREMENT Eta_zylaus_sp "Wirkungsgrad sollwert für Zylinderabschaltung" SWORD _CNV_R_R_Def_eta_sw_628_CM 1 100. 0. 100. DISPLAY_IDENTIFIER ETA_ZYLAUS_SP ECU_ADDRESS 0xc0004c42 FORMAT "%8.3" /end MEASUREMENT
/begin MEASUREMENT Eta_zylausbas "Wirkungsgrad bei defekte Zylinder" UWORD _CNV_R_R_Def_eta_uw_627_CM 1 100. 0. 199.9969 DISPLAY_IDENTIFIER ETA_ZYLAUSBAS ECU_ADDRESS 0xc0004c44 FORMAT "%8.3" /end MEASUREMENT
/begin MEASUREMENT Ewp_manufak "Herstellercode el. Wasserpumpe" UBYTE _CNV_R_R_Def_dez_sl_575_CM 1 100. 0. 255. DISPLAY_IDENTIFIER EWP_MANUFAK ECU_ADDRESS 0xc0004c46 FORMAT "%3.0" /end MEASUREMENT
/begin MEASUREMENT Ewp_typkenn "Kennung el. Wasserpumpe" UBYTE _CNV_R_R_Def_dez_sl_575_CM 1 100. 0. 255. DISPLAY_IDENTIFIER EWP_TYPKENN ECU_ADDRESS 0xc0004c47 FORMAT "%3.0" /end MEASUREMENT
/begin MEASUREMENT F_lakor1 "Faktor Lin-Lambdaregler" SWORD _CNV_R_R_Def_rel_sw_584_CM 1 100. -100. 99.9969 DISPLAY_IDENTIFIER F_LAKOR1 ECU_ADDRESS 0xd00067d4 FORMAT "%8.3" /end MEASUREMENT
/begin MEASUREMENT F_lakor2 "Faktor Lin-Lambdaregler" SWORD _CNV_R_R_Def_rel_sw_584_CM 1 100. -100. 99.9969 DISPLAY_IDENTIFIER F_LAKOR2 ECU_ADDRESS 0xd00067d6 FORMAT "%8.3" /end MEASUREMENT
/begin MEASUREMENT F_nox_alter "Alterungsfaktor Nox-KAT (H. Ramatschi)" UBYTE _CNV_R_R_Def_f_ub_b_573_CM 1 100. 0. 0.996 DISPLAY_IDENTIFIER F_NOX_ALTER ECU_ADDRESS 0xc0004c48 /end MEASUREMENT
/begin MEASUREMENT F_rk_ad1 "Lambdaadaption multiplikativ" SWORD _CNV_R_R_Def_rel_sw_584_CM 1 100. -100. 99.9969 DISPLAY_IDENTIFIER F_RK_AD1 ECU_ADDRESS 0xc0004c4a FORMAT "%8.3" /end MEASUREMENT
/begin MEASUREMENT F_rk_ad2 "Lambdaadaption multiplikativ" SWORD _CNV_R_R_Def_rel_sw_584_CM 1 100. -100. 99.9969 DISPLAY_IDENTIFIER F_RK_AD2 ECU_ADDRESS 0xc0004c4c FORMAT "%8.3" /end MEASUREMENT
/begin MEASUREMENT F_roz_ad "Faktor Überblendung Zw-Vorsteuerung in Abhängigkeit der Treibstoffqualität" UWORD _CNV_R_R_Def_f_uw_b_591_CM 1 100. 0. 0.9999 DISPLAY_IDENTIFIER F_ROZ_AD ECU_ADDRESS 0xd00067d8 FORMAT "%14.5" /end MEASUREMENT
/begin MEASUREMENT F_start "Startkorrekturen: Umgebungsdruck und Wiederholstart" SWORD _CNV_R_R_Def_rel_sw_584_CM 1 100. -100. 99.9969 DISPLAY_IDENTIFIER F_START ECU_ADDRESS 0xd00067da FORMAT "%8.3" /end MEASUREMENT
/begin MEASUREMENT F_tizyl "Faktor, mit der die Einspritzzeit von Zylinder 0 multipliziert wird (kommt aus dem zylinderindividuellem Lambda)" SWORD _CNV_R_R_Def_f_sw_q_571_CM 1 100. -50. 49.9984 DISPLAY_IDENTIFIER F_TIZYL ECU_ADDRESS 0xc0004c50 FORMAT "%8.3" ARRAY_SIZE 6 MATRIX_DIM 6 1 1 /end MEASUREMENT
/begin MEASUREMENT F_uevns_kh "Überblendfaktor für Vanos spreizung KH" UWORD _CNV_R_R_Def_f_uw_b_591_CM 1 100. 0. 0.9999 DISPLAY_IDENTIFIER F_UEVNS_KH ECU_ADDRESS 0xd00067dc FORMAT "%14.5" /end MEASUREMENT
/begin MEASUREMENT F_vst "Gemisch-anreicherungsfaktor gesamt" UWORD _CNV_R_R_Def_f_uw_b_580_CM 1 100. 0. 63.999 DISPLAY_IDENTIFIER F_VST ECU_ADDRESS 0xd00067de FORMAT "%9.4" /end MEASUREMENT
/begin MEASUREMENT Fahrzeug "Fahrzeugtypbezeichnung (E60 = 60, E65 = 65, E46 = 46)" UBYTE _CNV_R_R_Def_dez_sl_575_CM 1 100. 0. 255. DISPLAY_IDENTIFIER FAHRZEUG ECU_ADDRESS 0xc0002614 FORMAT "%3.0" /end MEASUREMENT
/begin MEASUREMENT Fho "Korrekturfaktor Höhe" UWORD _CNV_R_R_Def_f_uw_b_579_CM 1 100. 0. 1.9999 DISPLAY_IDENTIFIER FHO ECU_ADDRESS 0xc0002616 FORMAT "%14.5" /end MEASUREMENT
/begin MEASUREMENT Ftbr "Faktor Brennraumtemperatur im Brennraum" UWORD _CNV_R_R_Def_f_uw_b_579_CM 1 100. 0. 1.9999 DISPLAY_IDENTIFIER FTBR ECU_ADDRESS 0xd00067e0 FORMAT "%14.5" /end MEASUREMENT
/begin MEASUREMENT Gangi "Aktueller Gang intern" UBYTE _CNV_R_R_Def_dez_sl_575_CM 1 100. 0. 255. DISPLAY_IDENTIFIER GANGI ECU_ADDRESS 0xd00067e2 FORMAT "%3.0" /end MEASUREMENT
/begin MEASUREMENT Gangi_alt "Aktueller Gang intern" UBYTE _CNV_R_R_Def_dez_sl_575_CM 1 100. 0. 255. DISPLAY_IDENTIFIER GANGI_ALT ECU_ADDRESS 0xd000730b FORMAT "%3.0" /end MEASUREMENT
/begin MEASUREMENT Gangi_buf "" UBYTE _CNV_R_R_Def_dez_sl_575_CM 1 100. 0. 255. DISPLAY_IDENTIFIER GANGI_BUF ECU_ADDRESS 0xd000730e FORMAT "%3.0" /end MEASUREMENT
/begin MEASUREMENT Gangi_entpr "Entprellter Gang" UBYTE _CNV_R_R_Def_dez_sl_575_CM 1 100. 0. 255. DISPLAY_IDENTIFIER GANGI_ENTPR ECU_ADDRESS 0xd000730c FORMAT "%3.0" /end MEASUREMENT
/begin MEASUREMENT Gangi_entpr_alt "Aktueller Gang intern" UBYTE _CNV_R_R_Def_dez_sl_575_CM 1 100. 0. 255. DISPLAY_IDENTIFIER GANGI_ENTPR_ALT ECU_ADDRESS 0xd000730d FORMAT "%3.0" /end MEASUREMENT
/begin MEASUREMENT Gen_manufak "Herstellercode Generator 1" UBYTE _CNV_R_R_Def_dez_sl_575_CM 1 100. 0. 255. DISPLAY_IDENTIFIER GEN_MANUFAK ECU_ADDRESS 0xc0002618 FORMAT "%3.0" /end MEASUREMENT
/begin MEASUREMENT Gen_typkenn "Kennung Generatortyp Gen 1" UBYTE _CNV_R_R_Def_dez_sl_575_CM 1 100. 0. 255. DISPLAY_IDENTIFIER GEN_TYPKENN ECU_ADDRESS 0xc0002619 FORMAT "%3.0" /end MEASUREMENT
/begin MEASUREMENT I_eff "effektive Übersetzung" UWORD _CNV_R_R_Def_f_uw_b_580_CM 1 100. 0. 63.999 DISPLAY_IDENTIFIER I_EFF ECU_ADDRESS 0xd000732c FORMAT "%9.4" /end MEASUREMENT
/begin MEASUREMENT I_eff_gs "Strangverstärkung" UWORD _CNV_R_R_Def_strv_u_643_CM 1 100. 0. 511.9921 DISPLAY_IDENTIFIER I_EFF_GS ECU_ADDRESS 0xd00067e4 FORMAT "%7.2" /end MEASUREMENT
/begin MEASUREMENT I_ewp "EWAPU-Strom" UBYTE _CNV_R_R_DEZ_436_CM 1 100. 0. 255. DISPLAY_IDENTIFIER I_EWP ECU_ADDRESS 0xc0004c5c /end MEASUREMENT
/begin MEASUREMENT I_ges "Gesamtübersetzung" UWORD _CNV_R_R_Def_f_uw_b_580_CM 1 100. 0. 63.999 DISPLAY_IDENTIFIER I_GES ECU_ADDRESS 0xd00072ec FORMAT "%9.4" /end MEASUREMENT
/begin MEASUREMENT I_ges_at "Gesamtübersetzung für AT" UWORD _CNV_R_R_Def_f_uw_b_580_CM 1 100. 0. 63.999 DISPLAY_IDENTIFIER I_GES_AT ECU_ADDRESS 0xd0007314 FORMAT "%9.4" /end MEASUREMENT
/begin MEASUREMENT I_ges_hs "Gesamtübersetzung für HS" UWORD _CNV_R_R_Def_f_uw_b_580_CM 1 100. 0. 63.999 DISPLAY_IDENTIFIER I_GES_HS ECU_ADDRESS 0xd0007312 FORMAT "%9.4" /end MEASUREMENT
/begin MEASUREMENT I_opt "opt. Übersetzung" UWORD _CNV_R_R_Def_f_uw_b_580_CM 1 100. 0. 63.999 DISPLAY_IDENTIFIER I_OPT ECU_ADDRESS 0xd000732a FORMAT "%9.4" /end MEASUREMENT
/begin MEASUREMENT Id_bosrst "ID für BOS-Reset vom Kombi" UBYTE _CNV_R_R_Def_dez_sl_575_CM 1 100. 0. 255. DISPLAY_IDENTIFIER ID_BOSRST ECU_ADDRESS 0xc000261a FORMAT "%3.0" /end MEASUREMENT
/begin MEASUREMENT Id_bosrtt "ID f BOS_Reset vom Tester" UBYTE _CNV_R_R_Def_dez_sl_575_CM 1 100. 0. 255. DISPLAY_IDENTIFIER ID_BOSRTT ECU_ADDRESS 0xc000261b FORMAT "%3.0" /end MEASUREMENT
/begin MEASUREMENT Id_bosrtw "ID für Motoröl vom Kombi" UWORD _CNV_R_R_Def_dez_sl_575_CM 1 100. 0. 65535. DISPLAY_IDENTIFIER ID_BOSRTW ECU_ADDRESS 0xc000261c FORMAT "%5.0" /end MEASUREMENT
/begin MEASUREMENT Ierr "Erregerstrom Generator1" UBYTE _CNV_R_R_Def_i_ub_q_645_CM 1 100. 0. 31.875 DISPLAY_IDENTIFIER IERR ECU_ADDRESS 0xc000261e /end MEASUREMENT
/begin MEASUREMENT Ierr_fil "Gefilterter Erregerstrom" UBYTE _CNV_R_R_Def_i_ub_q_645_CM 1 100. 0. 31.875 DISPLAY_IDENTIFIER IERR_FIL ECU_ADDRESS 0xc00051fc /end MEASUREMENT
/begin MEASUREMENT Ierr_grenz_ext "Grenzerregerstrom vom Tester" UBYTE _CNV_R_R_Def_i_ub_q_645_CM 1 100. 0. 31.875 DISPLAY_IDENTIFIER IERR_GRENZ_EXT ECU_ADDRESS 0xc000261f /end MEASUREMENT
/begin MEASUREMENT Ierrfgrenz "Kopie begrenzter Erregerstrom Generator 1" UBYTE _CNV_R_R_Def_i_ub_q_645_CM 1 100. 0. 31.875 DISPLAY_IDENTIFIER IERRFGRENZ ECU_ADDRESS 0xc0004c5d /end MEASUREMENT
/begin MEASUREMENT Ikurz_ogr "Obere Grenze Kurzschlussstrom vom CAS" UBYTE _CNV_R_R_Def_i_ub_q_651_CM 1 100. 0. 2550. DISPLAY_IDENTIFIER IKURZ_OGR ECU_ADDRESS 0xc0004002 FORMAT "%5.2" /end MEASUREMENT
/begin MEASUREMENT Ikurz_ugr "Untere Grenze Kurzschlussstrom vom CAS" UBYTE _CNV_R_R_Def_i_ub_q_651_CM 1 100. 0. 2550. DISPLAY_IDENTIFIER IKURZ_UGR ECU_ADDRESS 0xc0004003 FORMAT "%5.2" /end MEASUREMENT
/begin MEASUREMENT Iwakeupgr "Fahrzeugspezifischer Ruhestrom" UBYTE _CNV_R_R_Def_i_sw_q_650_CM 1 100. 0. 0.255 DISPLAY_IDENTIFIER IWAKEUPGR ECU_ADDRESS 0xc0004004 /end MEASUREMENT
/begin MEASUREMENT Km_st "Kilometerstand" UWORD _CNV_R_R_Def_km_sw__64_CM 1 100. 0. 655350. DISPLAY_IDENTIFIER KM_ST ECU_ADDRESS 0xc0004006 FORMAT "%5.0" /end MEASUREMENT
/begin MEASUREMENT Km_st_1 "Wegstrecke_km auf 1km genau" ULONG _CNV_R_R_Def_dez_sl_575_CM 1 100. 0. 4294967295. DISPLAY_IDENTIFIER KM_ST_1 ECU_ADDRESS 0xc0004008 FORMAT "%7.0" /end MEASUREMENT
/begin MEASUREMENT Km_st_old "Kilometerstand" UWORD _CNV_R_R_Def_km_sw__64_CM 1 100. 0. 655350. DISPLAY_IDENTIFIER KM_ST_OLD ECU_ADDRESS 0xc000400c FORMAT "%5.0" /end MEASUREMENT
/begin MEASUREMENT Kvaverbr "Kraftstoffverbrauch (Einspritzmenge in Microliter)" UWORD _CNV_R_R_Def_dez_sl_575_CM 1 100. 0. 65535. DISPLAY_IDENTIFIER KVAVERBR ECU_ADDRESS 0xc0002620 FORMAT "%5.0" /end MEASUREMENT
/begin MEASUREMENT L_pwmout "Tastverhältnis E-Lüfter" UBYTE _CNV_R_R_Def_f_ub_b_602_CM 1 100. 0. 99.60930000000001 DISPLAY_IDENTIFIER L_PWMOUT ECU_ADDRESS 0xc0002622 FORMAT "%5.2" /end MEASUREMENT
/begin MEASUREMENT La_bszuli1 "Lambdasollwertvorgabe Bauteilschutzfunktion Zulieferer Bank 1" UWORD _CNV_R_R_Def_f_uw_b_594_CM 1 100. 0. 15.9997 DISPLAY_IDENTIFIER LA_BSZULI1 ECU_ADDRESS 0xd00067e6 FORMAT "%9.4" /end MEASUREMENT
/begin MEASUREMENT La_bszuli2 "Lambdasollwertvorgabe Bauteilschutzfunktion Zulieferer Bank 2" UWORD _CNV_R_R_Def_f_uw_b_594_CM 1 100. 0. 15.9997 DISPLAY_IDENTIFIER LA_BSZULI2 ECU_ADDRESS 0xd00067e8 FORMAT "%9.4" /end MEASUREMENT
/begin MEASUREMENT La_desu1 "Absolute Lambda Sollwert zur Lambda Pulsation Entschwefelung Bank1" UWORD _CNV_R_R_Def_f_uw_b_594_CM 1 100. 0. 15.9997 DISPLAY_IDENTIFIER LA_DESU1 ECU_ADDRESS 0xd00067ea FORMAT "%9.4" /end MEASUREMENT
/begin MEASUREMENT La_desu2 "Absolute Lambda Sollwert zur Lambda Pulsation Entschwefelung Bank2" UWORD _CNV_R_R_Def_f_uw_b_594_CM 1 100. 0. 15.9997 DISPLAY_IDENTIFIER LA_DESU2 ECU_ADDRESS 0xd00067ec FORMAT "%9.4" /end MEASUREMENT
/begin MEASUREMENT La_desu_kh1 "Lambda Sollwert zur Entschwefelung mit Kat Heizung Bank1 (ohne Puls Anteil)" UWORD _CNV_R_R_Def_f_uw_b_594_CM 1 100. 0. 15.9997 DISPLAY_IDENTIFIER LA_DESU_KH1 ECU_ADDRESS 0xd00067ee FORMAT "%9.4" /end MEASUREMENT
/begin MEASUREMENT La_desu_kh2 "Lambda Sollwert zur Entschwefelung mit Kat Heizung Bank2 (ohne Puls Anteil)" UWORD _CNV_R_R_Def_f_uw_b_594_CM 1 100. 0. 15.9997 DISPLAY_IDENTIFIER LA_DESU_KH2 ECU_ADDRESS 0xd00067f0 FORMAT "%9.4" /end MEASUREMENT
/begin MEASUREMENT La_es "Lambda zur fetten Entschwefelung" UWORD _CNV_R_R_Def_f_uw_b_594_CM 1 100. 0. 15.9997 DISPLAY_IDENTIFIER LA_ES ECU_ADDRESS 0xd00067f2 FORMAT "%9.4" /end MEASUREMENT
/begin MEASUREMENT La_ist_1 "Ist-Wert Lambda Bank 1" UWORD _CNV_R_R_Def_f_uw_b_594_CM 1 100. 0. 15.9997 DISPLAY_IDENTIFIER LA_IST_1 ECU_ADDRESS 0xc0004c5e FORMAT "%9.4" /end MEASUREMENT
/begin MEASUREMENT La_ist_2 "Ist-Wert Lambda Bank 2" UWORD _CNV_R_R_Def_f_uw_b_594_CM 1 100. 0. 15.9997 DISPLAY_IDENTIFIER LA_IST_2 ECU_ADDRESS 0xc0004c60 FORMAT "%9.4" /end MEASUREMENT
/begin MEASUREMENT La_kh1 "Lambda setpoint for CH" UWORD _CNV_R_R_Def_f_uw_b_594_CM 1 100. 0. 15.9997 DISPLAY_IDENTIFIER LA_KH1 ECU_ADDRESS 0xd00067f4 FORMAT "%9.4" /end MEASUREMENT
/begin MEASUREMENT La_kh2 "Lambda setpoint for CH" UWORD _CNV_R_R_Def_f_uw_b_594_CM 1 100. 0. 15.9997 DISPLAY_IDENTIFIER LA_KH2 ECU_ADDRESS 0xd00067f6 FORMAT "%9.4" /end MEASUREMENT
/begin MEASUREMENT La_pruef1 "Lambda zur Plausibilisierung Bank 1" UWORD _CNV_R_R_Def_f_uw_b_594_CM 1 100. 0. 15.9997 DISPLAY_IDENTIFIER LA_PRUEF1 ECU_ADDRESS 0xd00067f8 FORMAT "%9.4" /end MEASUREMENT
/begin MEASUREMENT La_pruef2 "Lamba für Plausibilitätsprüfung" UWORD _CNV_R_R_Def_f_uw_b_594_CM 1 100. 0. 15.9997 DISPLAY_IDENTIFIER LA_PRUEF2 ECU_ADDRESS 0xd00067fa FORMAT "%9.4" /end MEASUREMENT
/begin MEASUREMENT La_puls1 "Anregung Lin-Lambdaregler (forced la stimulation) Bank1" SBYTE _CNV_R_R_Def_f_sb_b_655_CM 1 100. -0.125 0.124 DISPLAY_IDENTIFIER LA_PULS1 ECU_ADDRESS 0xd00067fc FORMAT "%5.2" /end MEASUREMENT
/begin MEASUREMENT La_puls2 "Anregung Lin-Lambdaregler (forced la stimulation) Bank2" SBYTE _CNV_R_R_Def_f_sb_b_655_CM 1 100. -0.125 0.124 DISPLAY_IDENTIFIER LA_PULS2 ECU_ADDRESS 0xd00067fd FORMAT "%5.2" /end MEASUREMENT
/begin MEASUREMENT La_rgn1 "Lambda zur Speicherkatregenerierung" UWORD _CNV_R_R_Def_f_uw_b_594_CM 1 100. 0. 15.9997 DISPLAY_IDENTIFIER LA_RGN1 ECU_ADDRESS 0xd00067fe FORMAT "%9.4" /end MEASUREMENT
/begin MEASUREMENT La_rgn2 "Lambda zur Speicherkatregenerierung" UWORD _CNV_R_R_Def_f_uw_b_594_CM 1 100. 0. 15.9997 DISPLAY_IDENTIFIER LA_RGN2 ECU_ADDRESS 0xd0006800 FORMAT "%9.4" /end MEASUREMENT
/begin MEASUREMENT La_rgn_rpu1 "Lambda zur Regenerierung aus RP System" UWORD _CNV_R_R_Def_f_uw_b_594_CM 1 100. 0. 15.9997 DISPLAY_IDENTIFIER LA_RGN_RPU1 ECU_ADDRESS 0xd0006802 FORMAT "%9.4" /end MEASUREMENT
/begin MEASUREMENT La_rgn_rpu2 "Lambda zur Regenerierung aus RP System" UWORD _CNV_R_R_Def_f_uw_b_594_CM 1 100. 0. 15.9997 DISPLAY_IDENTIFIER LA_RGN_RPU2 ECU_ADDRESS 0xd0006804 FORMAT "%9.4" /end MEASUREMENT
/begin MEASUREMENT Lam_son1 "Ist-Lambda aus Sonde Bank 1" UWORD _CNV_R_R_Def_f_uw_b_594_CM 1 100. 0. 15.9997 DISPLAY_IDENTIFIER LAM_SON1 ECU_ADDRESS 0xd0006806 FORMAT "%9.4" /end MEASUREMENT
/begin MEASUREMENT Lam_son2 "Ist-Lambda aus Sonde Bank 2" UWORD _CNV_R_R_Def_f_uw_b_594_CM 1 100. 0. 15.9997 DISPLAY_IDENTIFIER LAM_SON2 ECU_ADDRESS 0xd0006808 FORMAT "%9.4" /end MEASUREMENT
/begin MEASUREMENT Loadresp "Loadresponse Zeit aus Kennfeldrechnung (alte Version)" UBYTE _CNV_R_R_Def_td_ub__593_CM 1 100. 0. 25.5 DISPLAY_IDENTIFIER LOADRESP ECU_ADDRESS 0xd0007286 FORMAT "%4.1" /end MEASUREMENT
/begin MEASUREMENT Lur "Laufunruhewerte zylinderselektiv" SWORD _CNV_R_R_Def_dez_sl_575_CM 1 100. -32768. 32767. DISPLAY_IDENTIFIER LUR ECU_ADDRESS 0xc0004c64 FORMAT "%5.0" ARRAY_SIZE 6 MATRIX_DIM 6 1 1 /end MEASUREMENT
/begin MEASUREMENT Md_ab_max "max Abtriebsmoment" SLONG _CNV_R_R_Def_m_sw_q_574_CM 1 100. -214748364.8 214748364.7 DISPLAY_IDENTIFIER MD_AB_MAX ECU_ADDRESS 0xd000733a FORMAT "%9.2" /end MEASUREMENT
/begin MEASUREMENT Md_ab_min "min Abtriebsmoment" SLONG _CNV_R_R_Def_m_sw_q_574_CM 1 100. -214748364.8 214748364.7 DISPLAY_IDENTIFIER MD_AB_MIN ECU_ADDRESS 0xd0007336 FORMAT "%9.2" /end MEASUREMENT
/begin MEASUREMENT Md_ab_wunsch "Abtriebswunschmoment des Fahrers" SLONG _CNV_R_R_Def_m_sw_q_574_CM 1 100. -214748364.8 214748364.7 DISPLAY_IDENTIFIER MD_AB_WUNSCH ECU_ADDRESS 0xd0007332 FORMAT "%9.2" /end MEASUREMENT
/begin MEASUREMENT Md_anfhi "Moment Anfahrhilfe" SWORD _CNV_R_R_Def_m_sw_q_574_CM 1 100. -3276.8 3276.7 DISPLAY_IDENTIFIER MD_ANFHI ECU_ADDRESS 0xd000680a FORMAT "%7.2" /end MEASUREMENT
/begin MEASUREMENT Md_getriebe "Eingangsmoment Getriebe" SWORD _CNV_R_R_Def_m_sw_q_574_CM 1 100. -3276.8 3276.7 DISPLAY_IDENTIFIER MD_GETRIEBE ECU_ADDRESS 0xd000680c FORMAT "%7.2" /end MEASUREMENT
/begin MEASUREMENT Md_grenz "Maximalmoment Generator an BSDII" SWORD _CNV_R_R_Def_m_sw_q_574_CM 1 100. -3276.8 3276.7 DISPLAY_IDENTIFIER MD_GRENZ ECU_ADDRESS 0xd0007284 FORMAT "%7.2" /end MEASUREMENT
/begin MEASUREMENT Md_na_ac "Verlustmoment Klimakompressor" SWORD _CNV_R_R_Def_m_sw_q_574_CM 1 100. -3276.8 3276.7 DISPLAY_IDENTIFIER MD_NA_AC ECU_ADDRESS 0xd000680e FORMAT "%7.2" /end MEASUREMENT
/begin MEASUREMENT Md_na_ars "Verlustmoment aktive Rollstabilisierung" SWORD _CNV_R_R_Def_m_sw_q_574_CM 1 100. -3276.8 3276.7 DISPLAY_IDENTIFIER MD_NA_ARS ECU_ADDRESS 0xd0006810 FORMAT "%7.2" /end MEASUREMENT
/begin MEASUREMENT Md_na_defrost "Verlustmoment Heckscheibenheizung" SWORD _CNV_R_R_Def_m_sw_q_574_CM 1 100. -3276.8 3276.7 DISPLAY_IDENTIFIER MD_NA_DEFROST ECU_ADDRESS 0xd0006812 FORMAT "%7.2" /end MEASUREMENT
/begin MEASUREMENT Md_na_el "Verlustmoment elektrischer Lüfter" SWORD _CNV_R_R_Def_m_sw_q_574_CM 1 100. -3276.8 3276.7 DISPLAY_IDENTIFIER MD_NA_EL ECU_ADDRESS 0xd0006814 FORMAT "%7.2" /end MEASUREMENT
/begin MEASUREMENT Md_na_ewapu "Verlustmoment elektrische Wasserpumpe" SWORD _CNV_R_R_Def_m_sw_q_574_CM 1 100. -3276.8 3276.7 DISPLAY_IDENTIFIER MD_NA_EWAPU ECU_ADDRESS 0xd0006816 FORMAT "%7.2" /end MEASUREMENT
/begin MEASUREMENT Md_na_ext "Verlustmoment Nebenaggregate" SWORD _CNV_R_R_Def_m_sw_q_574_CM 1 100. -3276.8 3276.7 DISPLAY_IDENTIFIER MD_NA_EXT ECU_ADDRESS 0xd0006818 FORMAT "%7.2" /end MEASUREMENT
/begin MEASUREMENT Md_na_mlad "Verlustmoment mechanischer Lader" SWORD _CNV_R_R_Def_m_sw_q_574_CM 1 100. -3276.8 3276.7 DISPLAY_IDENTIFIER MD_NA_MLAD ECU_ADDRESS 0xd000681a FORMAT "%7.2" /end MEASUREMENT
/begin MEASUREMENT Md_na_sl "Verlustmoment Servopumpe" SWORD _CNV_R_R_Def_m_sw_q_574_CM 1 100. -3276.8 3276.7 DISPLAY_IDENTIFIER MD_NA_SL ECU_ADDRESS 0xd000681c FORMAT "%7.2" /end MEASUREMENT
/begin MEASUREMENT Md_na_sls "Verlustmoment Sekundärluftpumpe" SWORD _CNV_R_R_Def_m_sw_q_574_CM 1 100. -3276.8 3276.7 DISPLAY_IDENTIFIER MD_NA_SLS ECU_ADDRESS 0xd000681e FORMAT "%7.2" /end MEASUREMENT
/begin MEASUREMENT Md_na_thermo "Verlustmoment Thermostat" SWORD _CNV_R_R_Def_m_sw_q_574_CM 1 100. -3276.8 3276.7 DISPLAY_IDENTIFIER MD_NA_THERMO ECU_ADDRESS 0xd0006820 FORMAT "%7.2" /end MEASUREMENT
/begin MEASUREMENT Md_rad_ist "" SLONG _CNV_R_R_Def_m_sw_q_574_CM 1 100. -214748364.8 214748364.7 DISPLAY_IDENTIFIER MD_RAD_IST ECU_ADDRESS 0xd0007300 FORMAT "%9.2" /end MEASUREMENT
/begin MEASUREMENT Md_rad_ksoll "Sollmoment am Rad koordiniert" SLONG _CNV_R_R_Def_m_sw_q_574_CM 1 100. -214748364.8 214748364.7 DISPLAY_IDENTIFIER MD_RAD_KSOLL ECU_ADDRESS 0xd0007304 FORMAT "%9.2" /end MEASUREMENT
/begin MEASUREMENT Md_rad_max "" SLONG _CNV_R_R_Def_m_sw_q_574_CM 1 100. -214748364.8 214748364.7 DISPLAY_IDENTIFIER MD_RAD_MAX ECU_ADDRESS 0xd00072fc FORMAT "%9.2" /end MEASUREMENT
/begin MEASUREMENT Md_rad_min "" SLONG _CNV_R_R_Def_m_sw_q_574_CM 1 100. -214748364.8 214748364.7 DISPLAY_IDENTIFIER MD_RAD_MIN ECU_ADDRESS 0xd00072f8 FORMAT "%9.2" /end MEASUREMENT
/begin MEASUREMENT Md_rad_minti "" SLONG _CNV_R_R_Def_m_sw_q_574_CM 1 100. -214748364.8 214748364.7 DISPLAY_IDENTIFIER MD_RAD_MINTI ECU_ADDRESS 0xd00072f4 FORMAT "%9.2" /end MEASUREMENT
/begin MEASUREMENT Md_rad_soll "Soll-Radmoment" SLONG _CNV_R_R_Def_m_sw_q_574_CM 1 100. -214748364.8 214748364.7 DISPLAY_IDENTIFIER MD_RAD_SOLL ECU_ADDRESS 0xd0006822 FORMAT "%9.2" /end MEASUREMENT
/begin MEASUREMENT Md_rad_wunsch "Fahrerwunschmoment am Rad" SLONG _CNV_R_R_Def_m_sw_q_574_CM 1 100. -214748364.8 214748364.7 DISPLAY_IDENTIFIER MD_RAD_WUNSCH ECU_ADDRESS 0xd000732e FORMAT "%9.2" /end MEASUREMENT
/begin MEASUREMENT Md_res_anfhi "Moment Anfahrhilfe" SWORD _CNV_R_R_Def_m_sw_q_574_CM 1 100. -3276.8 3276.7 DISPLAY_IDENTIFIER MD_RES_ANFHI ECU_ADDRESS 0xd0006826 FORMAT "%7.2" /end MEASUREMENT
/begin MEASUREMENT Mdi_accl_plus "Momentenanforderung ACC langsam" SWORD _CNV_R_R_Def_m_sw_q_574_CM 1 100. -3276.8 3276.7 DISPLAY_IDENTIFIER MDI_ACCL_PLUS ECU_ADDRESS 0xd0006828 FORMAT "%7.2" /end MEASUREMENT
/begin MEASUREMENT Mdi_accs_plus "Momentenanforderung ACC schnell" SWORD _CNV_R_R_Def_m_sw_q_574_CM 1 100. -3276.8 3276.7 DISPLAY_IDENTIFIER MDI_ACCS_PLUS ECU_ADDRESS 0xd000682a FORMAT "%7.2" /end MEASUREMENT
/begin MEASUREMENT Mdi_asr_l "Momentenbegrenzung ASR langsamer Pfad" SWORD _CNV_R_R_Def_m_sw_q_574_CM 1 100. -3276.8 3276.7 DISPLAY_IDENTIFIER MDI_ASR_L ECU_ADDRESS 0xd000682c FORMAT "%7.2" /end MEASUREMENT
/begin MEASUREMENT Mdi_asr_s "Momentenbegrenzung ASR schneller Pfad" SWORD _CNV_R_R_Def_m_sw_q_574_CM 1 100. -3276.8 3276.7 DISPLAY_IDENTIFIER MDI_ASR_S ECU_ADDRESS 0xd000682e FORMAT "%7.2" /end MEASUREMENT
/begin MEASUREMENT Mdi_bas "aktuelles inneres Ist-Moment mit Berücksichtigung von Zw_ve" SWORD _CNV_R_R_Def_m_sw_q_574_CM 1 100. -3276.8 3276.7 DISPLAY_IDENTIFIER MDI_BAS ECU_ADDRESS 0xd0006830 FORMAT "%7.2" /end MEASUREMENT
/begin MEASUREMENT Mdi_gsl_minus "Langsamer Momenteneingriff EGS : Momentenerniedrigung" SWORD _CNV_R_R_Def_m_sw_q_574_CM 1 100. -3276.8 3276.7 DISPLAY_IDENTIFIER MDI_GSL_MINUS ECU_ADDRESS 0xd0006832 FORMAT "%7.2" /end MEASUREMENT
/begin MEASUREMENT Mdi_gsl_plus "Langsamer Momenteneingriff EGS : Momentenerhöhung" SWORD _CNV_R_R_Def_m_sw_q_574_CM 1 100. -3276.8 3276.7 DISPLAY_IDENTIFIER MDI_GSL_PLUS ECU_ADDRESS 0xd0006834 FORMAT "%7.2" /end MEASUREMENT
/begin MEASUREMENT Mdi_gss_minus "Schneller Momenteneingriff EGS" SWORD _CNV_R_R_Def_m_sw_q_574_CM 1 100. -3276.8 3276.7 DISPLAY_IDENTIFIER MDI_GSS_MINUS ECU_ADDRESS 0xd0006836 FORMAT "%7.2" /end MEASUREMENT
/begin MEASUREMENT Mdi_gss_plus "Momenteneingriff EGS schnell" SWORD _CNV_R_R_Def_m_sw_q_574_CM 1 100. -3276.8 3276.7 DISPLAY_IDENTIFIER MDI_GSS_PLUS ECU_ADDRESS 0xd0006838 FORMAT "%7.2" /end MEASUREMENT
/begin MEASUREMENT Mdi_katschutz "Momentenbegrenzung Katschutz" SWORD _CNV_R_R_Def_m_sw_q_574_CM 1 100. -3276.8 3276.7 DISPLAY_IDENTIFIER MDI_KATSCHUTZ ECU_ADDRESS 0xd000683a FORMAT "%7.2" /end MEASUREMENT
/begin MEASUREMENT Mdi_llri "I-Anteil Llr" SWORD _CNV_R_R_Def_m_sw_q_574_CM 1 100. -3276.8 3276.7 DISPLAY_IDENTIFIER MDI_LLRI ECU_ADDRESS 0xd000683c FORMAT "%7.2" /end MEASUREMENT
/begin MEASUREMENT Mdi_llrp "P-Anteil Llr" SWORD _CNV_R_R_Def_m_sw_q_574_CM 1 100. -3276.8 3276.7 DISPLAY_IDENTIFIER MDI_LLRP ECU_ADDRESS 0xd000683e FORMAT "%7.2" /end MEASUREMENT
/begin MEASUREMENT Mdi_llrzw "PD-Anteil Llr" SWORD _CNV_R_R_Def_m_sw_q_574_CM 1 100. -3276.8 3276.7 DISPLAY_IDENTIFIER MDI_LLRZW ECU_ADDRESS 0xd0006840 FORMAT "%7.2" /end MEASUREMENT
/begin MEASUREMENT Mdi_minti "Moment bei Rf_min" SWORD _CNV_R_R_Def_m_sw_q_574_CM 1 100. -3276.8 3276.7 DISPLAY_IDENTIFIER MDI_MINTI ECU_ADDRESS 0xd0007322 FORMAT "%7.2" /end MEASUREMENT
/begin MEASUREMENT Mdi_msr_l "Begrenzungsmoment aus Motorschleppmomentenregelung langsamer Pfad" SWORD _CNV_R_R_Def_m_sw_q_574_CM 1 100. -3276.8 3276.7 DISPLAY_IDENTIFIER MDI_MSR_L ECU_ADDRESS 0xd0006842 FORMAT "%7.2" /end MEASUREMENT
/begin MEASUREMENT Mdi_msr_s "Begrenzungsmoment aus Motorschleppmomentenregelung schneller Pfad" SWORD _CNV_R_R_Def_m_sw_q_574_CM 1 100. -3276.8 3276.7 DISPLAY_IDENTIFIER MDI_MSR_S ECU_ADDRESS 0xd0006844 FORMAT "%7.2" /end MEASUREMENT
/begin MEASUREMENT Mdi_nmax "Moment der Maximaldrehzahlabregelung." SWORD _CNV_R_R_Def_m_sw_q_574_CM 1 100. -3276.8 3276.7 DISPLAY_IDENTIFIER MDI_NMAX ECU_ADDRESS 0xd0006846 FORMAT "%7.2" /end MEASUREMENT
/begin MEASUREMENT Mdi_opt_kor "Mdi_opt um Lambda- und Zw-Wirkungsgrad korrigiert" SWORD _CNV_R_R_Def_m_sw_q_574_CM 1 100. -3276.8 3276.7 DISPLAY_IDENTIFIER MDI_OPT_KOR ECU_ADDRESS 0xc0004c70 FORMAT "%7.2" /end MEASUREMENT
/begin MEASUREMENT Mdi_pmax "Leistungsbegenzung" SWORD _CNV_R_R_Def_m_sw_q_574_CM 1 100. -3276.8 3276.7 DISPLAY_IDENTIFIER MDI_PMAX ECU_ADDRESS 0xd0006848 FORMAT "%7.2" /end MEASUREMENT
/begin MEASUREMENT Mdi_reib "Motorschleppmoment im aktuellen Betriebspunkt: Summe aus Ladungswechselverlusten und Reibmoment und einem Reiboffset im Start in der aktuellen Betriebsart." SWORD _CNV_R_R_Def_m_sw_q_574_CM 1 100. -3276.8 3276.7 DISPLAY_IDENTIFIER MDI_REIB ECU_ADDRESS 0xc0002624 FORMAT "%7.2" /end MEASUREMENT
/begin MEASUREMENT Mdi_res_ac "Momentenreserve für den Klimakompressor" SWORD _CNV_R_R_Def_m_sw_q_574_CM 1 100. -3276.8 3276.7 DISPLAY_IDENTIFIER MDI_RES_AC ECU_ADDRESS 0xd000684a FORMAT "%7.2" /end MEASUREMENT
/begin MEASUREMENT Mdi_res_afs "für AFS-Lenkung" SWORD _CNV_R_R_Def_m_sw_q_574_CM 1 100. -3276.8 3276.7 DISPLAY_IDENTIFIER MDI_RES_AFS ECU_ADDRESS 0xd000684c FORMAT "%7.2" /end MEASUREMENT
/begin MEASUREMENT Mdi_res_gs "für Getriebe" SWORD _CNV_R_R_Def_m_sw_q_574_CM 1 100. -3276.8 3276.7 DISPLAY_IDENTIFIER MDI_RES_GS ECU_ADDRESS 0xd000684e FORMAT "%7.2" /end MEASUREMENT
/begin MEASUREMENT Mdi_res_heiz "für Heizung aus Klimasteuergerät" SWORD _CNV_R_R_Def_m_sw_q_574_CM 1 100. -3276.8 3276.7 DISPLAY_IDENTIFIER MDI_RES_HEIZ ECU_ADDRESS 0xd0006850 FORMAT "%7.2" /end MEASUREMENT
/begin MEASUREMENT Mdi_res_kh "Momentenreserve für Katheizen" SWORD _CNV_R_R_Def_m_sw_q_574_CM 1 100. -3276.8 3276.7 DISPLAY_IDENTIFIER MDI_RES_KH ECU_ADDRESS 0xd0006852 FORMAT "%7.2" /end MEASUREMENT
/begin MEASUREMENT Mdi_res_llmn "untere Begrenzung Momentenreserve im LL" SWORD _CNV_R_R_Def_m_sw_q_574_CM 1 100. -3276.8 3276.7 DISPLAY_IDENTIFIER MDI_RES_LLMN ECU_ADDRESS 0xd0006854 FORMAT "%7.2" /end MEASUREMENT
/begin MEASUREMENT Mdi_res_llmx "inneres Moment incl. max mögliche Momentenreserve mit Einfluss LL" SWORD _CNV_R_R_Def_m_sw_q_574_CM 1 100. -3276.8 3276.7 DISPLAY_IDENTIFIER MDI_RES_LLMX ECU_ADDRESS 0xd0006856 FORMAT "%7.2" /end MEASUREMENT
/begin MEASUREMENT Mdi_res_sl "für Servo-Lenkung" SWORD _CNV_R_R_Def_m_sw_q_574_CM 1 100. -3276.8 3276.7 DISPLAY_IDENTIFIER MDI_RES_SL ECU_ADDRESS 0xd0006858 FORMAT "%7.2" /end MEASUREMENT
/begin MEASUREMENT Mdi_res_st "Momentenvorhalt im Start" SWORD _CNV_R_R_Def_m_sw_q_574_CM 1 100. -3276.8 3276.7 DISPLAY_IDENTIFIER MDI_RES_ST ECU_ADDRESS 0xd000685a FORMAT "%7.2" /end MEASUREMENT
/begin MEASUREMENT Mdi_res_tev "Momentenreserve für die TEV" SWORD _CNV_R_R_Def_m_sw_q_574_CM 1 100. -3276.8 3276.7 DISPLAY_IDENTIFIER MDI_RES_TEV ECU_ADDRESS 0xd000685c FORMAT "%7.2" /end MEASUREMENT
/begin MEASUREMENT Mdi_siko_l "Momentenbegrenzung Sicherheitskonzept langsamer Pfad" SWORD _CNV_R_R_Def_m_sw_q_574_CM 1 100. -3276.8 3276.7 DISPLAY_IDENTIFIER MDI_SIKO_L ECU_ADDRESS 0xd000685e FORMAT "%7.2" /end MEASUREMENT
/begin MEASUREMENT Mdi_siko_s "Momentenbegrenzung Sicherheitskonzept schneller Pfad" SWORD _CNV_R_R_Def_m_sw_q_574_CM 1 100. -3276.8 3276.7 DISPLAY_IDENTIFIER MDI_SIKO_S ECU_ADDRESS 0xd0006860 FORMAT "%7.2" /end MEASUREMENT
/begin MEASUREMENT Mdi_smgl_minus "Momentenanforderung SMG Getriebe langsam negativ" SWORD _CNV_R_R_Def_m_sw_q_574_CM 1 100. -3276.8 3276.7 DISPLAY_IDENTIFIER MDI_SMGL_MINUS ECU_ADDRESS 0xd0006862 FORMAT "%7.2" /end MEASUREMENT
/begin MEASUREMENT Mdi_smgl_plus "Momentenanforderung SMG Getriebe langsam positiv" SWORD _CNV_R_R_Def_m_sw_q_574_CM 1 100. -3276.8 3276.7 DISPLAY_IDENTIFIER MDI_SMGL_PLUS ECU_ADDRESS 0xd0006864 FORMAT "%7.2" /end MEASUREMENT
/begin MEASUREMENT Mdi_smgs_minus "Momentenanforderung SMG Getriebe schnell negativ" SWORD _CNV_R_R_Def_m_sw_q_574_CM 1 100. -3276.8 3276.7 DISPLAY_IDENTIFIER MDI_SMGS_MINUS ECU_ADDRESS 0xd0006866 FORMAT "%7.2" /end MEASUREMENT
/begin MEASUREMENT Mdi_smgs_plus "Momentenanforderung SMG Getriebe schnell positiv" SWORD _CNV_R_R_Def_m_sw_q_574_CM 1 100. -3276.8 3276.7 DISPLAY_IDENTIFIER MDI_SMGS_PLUS ECU_ADDRESS 0xd0006868 FORMAT "%7.2" /end MEASUREMENT
/begin MEASUREMENT Mdi_vmax "Vmax-Begrenzung" SWORD _CNV_R_R_Def_m_sw_q_574_CM 1 100. -3276.8 3276.7 DISPLAY_IDENTIFIER MDI_VMAX ECU_ADDRESS 0xd000686a FORMAT "%7.2" /end MEASUREMENT
/begin MEASUREMENT Mdk_ist "Kupplungsistmoment" SWORD _CNV_R_R_Def_m_sw_q_574_CM 1 100. -3276.8 3276.7 DISPLAY_IDENTIFIER MDK_IST ECU_ADDRESS 0xd000686c FORMAT "%7.2" /end MEASUREMENT
/begin MEASUREMENT Mdk_min "Minimales Kupllungsmoment" SWORD _CNV_R_R_Def_m_sw_q_574_CM 1 100. -3276.8 3276.7 DISPLAY_IDENTIFIER MDK_MIN ECU_ADDRESS 0xd000686e FORMAT "%7.2" /end MEASUREMENT
/begin MEASUREMENT Mdk_wunsch_ipm "Sollmoment an der Kupplung" SWORD _CNV_R_R_Def_m_sw_q_574_CM 1 100. -3276.8 3276.7 DISPLAY_IDENTIFIER MDK_WUNSCH_IPM ECU_ADDRESS 0xd00072ee FORMAT "%7.2" /end MEASUREMENT
/begin MEASUREMENT Mdk_wunsch_rad "Sollmoment an der Kupplung" SWORD _CNV_R_R_Def_m_sw_q_574_CM 1 100. -3276.8 3276.7 DISPLAY_IDENTIFIER MDK_WUNSCH_RAD ECU_ADDRESS 0xd00072f0 FORMAT "%7.2" /end MEASUREMENT
/begin MEASUREMENT Mdr_ab_max "max aus Mdr_ab_virt und Mdr_ab_wunsch" SWORD _CNV_R_R_Def_md_rel_660_CM 1 100. 0. 100. DISPLAY_IDENTIFIER MDR_AB_MAX ECU_ADDRESS 0xd00072ea FORMAT "%6.1" /end MEASUREMENT
/begin MEASUREMENT Mdr_ab_virt "aus Md_rad_soll zurückgerechnetes relatives Fahrerwunschabtriebsmoment" SWORD _CNV_R_R_Def_md_rel_660_CM 1 100. 0. 100. DISPLAY_IDENTIFIER MDR_AB_VIRT ECU_ADDRESS 0xd0007326 FORMAT "%6.1" /end MEASUREMENT
/begin MEASUREMENT Mdr_ab_wunsch "relatives Fahrerwunschabtriebsmoment" SWORD _CNV_R_R_Def_md_rel_660_CM 1 100. 0. 100. DISPLAY_IDENTIFIER MDR_AB_WUNSCH ECU_ADDRESS 0xd0007324 FORMAT "%6.1" /end MEASUREMENT
/begin MEASUREMENT Mdr_wunsch "Rel. Wunschmoment. Fahrerwunsch und Fahrgeschwindigkeitsregler bereits koordiniert." SWORD _CNV_R_R_Def_md_rel_660_CM 1 100. 0. 100. DISPLAY_IDENTIFIER MDR_WUNSCH ECU_ADDRESS 0xd0006870 FORMAT "%6.1" /end MEASUREMENT
/begin MEASUREMENT Ms_sl "Massenstrom Sekundärluft [kg/h]" UWORD _CNV_R_R_Def_ms_uw__611_CM 1 100. 0. 2047.9687 DISPLAY_IDENTIFIER MS_SL ECU_ADDRESS 0xd0006872 FORMAT "%8.3" /end MEASUREMENT
/begin MEASUREMENT Msbkvup "Massenstrom Bremmskraftverstaerker" UWORD _CNV_R_R_Def_ms_uw__611_CM 1 100. 0. 2047.9687 DISPLAY_IDENTIFIER MSBKVUP ECU_ADDRESS 0xd0006874 FORMAT "%8.3" /end MEASUREMENT
/begin MEASUREMENT Mshfm_ist "Massenstrom vom HFM" UWORD _CNV_R_R_Def_ms_uw__611_CM 1 100. 0. 2047.9687 DISPLAY_IDENTIFIER MSHFM_IST ECU_ADDRESS 0xd0006876 FORMAT "%8.3" /end MEASUREMENT
/begin MEASUREMENT Mshfm_m "HFM Luftmassenmittelwert" UWORD _CNV_R_R_Def_ms_uw__611_CM 1 100. 0. 2047.9687 DISPLAY_IDENTIFIER MSHFM_M ECU_ADDRESS 0xd0006878 FORMAT "%8.3" /end MEASUREMENT
/begin MEASUREMENT Mslui "Integr. Luftmasse" UWORD _CNV_R_R_Def_lm_uw__663_CM 1 100. 0. 29.1266 DISPLAY_IDENTIFIER MSLUI ECU_ADDRESS 0xc0004c72 FORMAT "%9.4" /end MEASUREMENT
/begin MEASUREMENT Mste "Massenstrom durch Tankentlüftungsventil" UWORD _CNV_R_R_Def_ms_uw__665_CM 1 100. 0. 25.5996 DISPLAY_IDENTIFIER MSTE ECU_ADDRESS 0xc0002626 FORMAT "%9.4" /end MEASUREMENT
/begin MEASUREMENT N_ab "Abtriebsdrehzahl" SWORD _CNV_R_R_Def_n_sw_q_612_CM 1 100. -32768. 32767. DISPLAY_IDENTIFIER N_AB ECU_ADDRESS 0xd00072f2 FORMAT "%5.0" /end MEASUREMENT
/begin MEASUREMENT N_idlibs "Leerlaufdrehzahlvorgabe von LC-Powermanagement" UBYTE _CNV_R_R_Def_dez_sl_575_CM 1 100. 0. 255. DISPLAY_IDENTIFIER N_IDLIBS ECU_ADDRESS 0xc00051f8 FORMAT "%3.0" /end MEASUREMENT
/begin MEASUREMENT N_idlms "Leerlaufdrehzahlanhebung von Powermodul" UBYTE _CNV_R_R_Def_dez_sl_575_CM 1 100. 0. 255. DISPLAY_IDENTIFIER N_IDLMS ECU_ADDRESS 0xc0002628 FORMAT "%3.0" /end MEASUREMENT
/begin MEASUREMENT N_nstart "Motordrehzahl nach Motorstart" SWORD _CNV_R_R_Def_n_sw_q_612_CM 1 100. -32768. 32767. DISPLAY_IDENTIFIER N_NSTART ECU_ADDRESS 0xd0007272 FORMAT "%5.0" /end MEASUREMENT
/begin MEASUREMENT N_pmstart "Motordrehzahl E65 Startauswertung" SWORD _CNV_R_R_Def_n_sw_q_612_CM 1 100. -32768. 32767. DISPLAY_IDENTIFIER N_PMSTART ECU_ADDRESS 0xc000262a FORMAT "%5.0" /end MEASUREMENT
/begin MEASUREMENT N_zylab1 "Durchschnittliche Anzahl der ausgeblendeten Zylinder in den letzten 200 ms für Bank 1" UBYTE _CNV_R_R_Def_dez_ub_667_CM 1 100. 0. 127.5 DISPLAY_IDENTIFIER N_ZYLAB1 ECU_ADDRESS 0xd000687a /end MEASUREMENT
/begin MEASUREMENT N_zylab2 "Durchschnittliche Anzahl der ausgeblendeten Zylinder in den letzten 200 ms für Bank 2" UBYTE _CNV_R_R_Def_dez_ub_667_CM 1 100. 0. 127.5 DISPLAY_IDENTIFIER N_ZYLAB2 ECU_ADDRESS 0xd000687b /end MEASUREMENT
/begin MEASUREMENT Nelueft_klima "Anforderung E-Lüfter Drehzahl von IHKA als PWM-Signal" UBYTE _CNV_R_R_Def_f_ub_b_602_CM 1 100. 0. 99.60930000000001 DISPLAY_IDENTIFIER NELUEFT_KLIMA ECU_ADDRESS 0xc000262c FORMAT "%5.2" /end MEASUREMENT
/begin MEASUREMENT Nelueft_lenk "E-Lüfteranforderung von derLenkhilfe" UBYTE _CNV_R_R_Def_f_ub_b_602_CM 1 100. 0. 99.60930000000001 DISPLAY_IDENTIFIER NELUEFT_LENK ECU_ADDRESS 0xc000262d FORMAT "%5.2" /end MEASUREMENT
/begin MEASUREMENT Newp_dif "Aktuelle Different Sollwert - Istwert" UBYTE _CNV_R_R_Def_dez_sl_575_CM 1 100. 0. 255. DISPLAY_IDENTIFIER NEWP_DIF ECU_ADDRESS 0xc0004c74 FORMAT "%3.0" /end MEASUREMENT
/begin MEASUREMENT Newp_ist "Istdrehzahl elektrische Wasserpumpe" UBYTE _CNV_R_R_Def_dez_sl_575_CM 1 100. 0. 255. DISPLAY_IDENTIFIER NEWP_IST ECU_ADDRESS 0xc0004c75 FORMAT "%3.0" /end MEASUREMENT
/begin MEASUREMENT Nkw "Drehzahl" SWORD _CNV_R_R_Def_n_sw_q_612_CM 1 100. -32768. 32767. DISPLAY_IDENTIFIER NKW ECU_ADDRESS 0xd000687c FORMAT "%5.0" /end MEASUREMENT
/begin MEASUREMENT Nkw_disa_1 "Disa Schalt-drehzahl 1 (akt. Wert incl. Temp.- Korr. u. Hysterese)" SWORD _CNV_R_R_Def_n_sw_q_612_CM 1 100. -32768. 32767. DISPLAY_IDENTIFIER NKW_DISA_1 ECU_ADDRESS 0xc0004c76 FORMAT "%5.0" /end MEASUREMENT
/begin MEASUREMENT Nkw_disa_2 "Disa Schalt-drehzahl 2 (akt. Wert incl. Temp.-Korr. u. Hysterese)" SWORD _CNV_R_R_Def_n_sw_q_612_CM 1 100. -32768. 32767. DISPLAY_IDENTIFIER NKW_DISA_2 ECU_ADDRESS 0xc0004c78 FORMAT "%5.0" /end MEASUREMENT
/begin MEASUREMENT Nkw_grad "Drehzahlgradient" SBYTE _CNV_R_R_Def_ngrd_s_668_CM 1 100. -4096. 4064. DISPLAY_IDENTIFIER NKW_GRAD ECU_ADDRESS 0xd000687e FORMAT "%5.2" /end MEASUREMENT
/begin MEASUREMENT Nkw_grad_fpt1 "Nkw-Gradient PT1 gefiltert" SBYTE _CNV_R_R_Def_ngrd_s_668_CM 1 100. -4096. 4064. DISPLAY_IDENTIFIER NKW_GRAD_FPT1 ECU_ADDRESS 0xd0007308 FORMAT "%5.2" /end MEASUREMENT
/begin MEASUREMENT Nkw_opt "Motordrehzahl die zu opt. Übersetzung führt" SWORD _CNV_R_R_Def_n_sw_q_612_CM 1 100. -32768. 32767. DISPLAY_IDENTIFIER NKW_OPT ECU_ADDRESS 0xd0007328 FORMAT "%5.0" /end MEASUREMENT
/begin MEASUREMENT Nkw_soll "Solldrehzahl" SWORD _CNV_R_R_Def_n_sw_q_612_CM 1 100. -32768. 32767. DISPLAY_IDENTIFIER NKW_SOLL ECU_ADDRESS 0xd0006880 FORMAT "%5.0" /end MEASUREMENT
/begin MEASUREMENT Nkw_zahn "Drehzahl aus KW-Zähnen" SWORD _CNV_R_R_Def_n_sw_q_612_CM 1 100. -32768. 32767. DISPLAY_IDENTIFIER NKW_ZAHN ECU_ADDRESS 0xd0006882 FORMAT "%5.0" /end MEASUREMENT
/begin MEASUREMENT Nmax_hschalt "Motordrehzahl die zu einem Hochschalthinweis führt" SWORD _CNV_R_R_Def_n_sw_q_612_CM 1 100. -32768. 32767. DISPLAY_IDENTIFIER NMAX_HSCHALT ECU_ADDRESS 0xd0007316 FORMAT "%5.0" /end MEASUREMENT
/begin MEASUREMENT Nmax_var "roter Drehzahlbereich" SWORD _CNV_R_R_Def_n_sw_q_612_CM 1 100. -32768. 32767. DISPLAY_IDENTIFIER NMAX_VAR ECU_ADDRESS 0xd0006884 FORMAT "%5.0" /end MEASUREMENT
/begin MEASUREMENT Nmin_hschalt "Motordrehzahl die zu einem Rückschalthinweis führt" SWORD _CNV_R_R_Def_n_sw_q_612_CM 1 100. -32768. 32767. DISPLAY_IDENTIFIER NMIN_HSCHALT ECU_ADDRESS 0xd0007318 FORMAT "%5.0" /end MEASUREMENT
/begin MEASUREMENT Nslb "N_soll Korrektur von Ladebilanz Batterie" SWORD _CNV_R_R_Def_n_sw_q_612_CM 1 100. 0. 32767. DISPLAY_IDENTIFIER NSLB ECU_ADDRESS 0xc0005200 FORMAT "%5.0" /end MEASUREMENT
/begin MEASUREMENT Nsll_kh "Idle speed setpoint during CH" SWORD _CNV_R_R_Def_n_sw_q_612_CM 1 100. -32768. 32767. DISPLAY_IDENTIFIER NSLL_KH ECU_ADDRESS 0xc0004c7a FORMAT "%5.0" /end MEASUREMENT
/begin MEASUREMENT Nsllm "Solldrehzahl im Leerlauf ohne Fahrstufe" SWORD _CNV_R_R_Def_n_sw_q_612_CM 1 100. -32768. 32767. DISPLAY_IDENTIFIER NSLLM ECU_ADDRESS 0xc000262e FORMAT "%5.0" /end MEASUREMENT
/begin MEASUREMENT Nstat "Solldrehzahl ohne Nachführung" SWORD _CNV_R_R_Def_n_sw_q_612_CM 1 100. -32768. 32767. DISPLAY_IDENTIFIER NSTAT ECU_ADDRESS 0xc0002630 FORMAT "%5.0" /end MEASUREMENT
/begin MEASUREMENT Nturb "Drehzahl Getriebeeingang" SWORD _CNV_R_R_Def_n_sw_q_612_CM 1 100. -32768. 32767. DISPLAY_IDENTIFIER NTURB ECU_ADDRESS 0xd0006886 FORMAT "%5.0" /end MEASUREMENT
/begin MEASUREMENT Nwa1_pos "Auslassnockenwellenposition (el. fallende Flanken)" UWORD _CNV_R_R_Def_spr_sw_583_CM 1 100. 0. 6553.5 DISPLAY_IDENTIFIER NWA1_POS ECU_ADDRESS 0xd0006888 FORMAT "%7.2" /end MEASUREMENT
/begin MEASUREMENT Nwa1_time "Zeitstempel bei el. fallender Auslassnockenwellenflanke (1 Inc. = 1 ms)" ULONG _CNV_R_R_Def_dez_sl_575_CM 1 100. 0. 4294967295. DISPLAY_IDENTIFIER NWA1_TIME ECU_ADDRESS 0xd000688a FORMAT "%7.0" /end MEASUREMENT
/begin MEASUREMENT Nwe "Wiedereinsetzdrehzahl + drehzahlgradientabhängiger Offset" SWORD _CNV_R_R_Def_n_sw_q_612_CM 1 100. -32768. 32767. DISPLAY_IDENTIFIER NWE ECU_ADDRESS 0xc0002632 FORMAT "%5.0" /end MEASUREMENT
/begin MEASUREMENT Nwe1_pos "Einlassnockenwellenposition (el. fallende Flanken)" UWORD _CNV_R_R_Def_spr_sw_583_CM 1 100. 0. 6553.5 DISPLAY_IDENTIFIER NWE1_POS ECU_ADDRESS 0xd000688e FORMAT "%7.2" /end MEASUREMENT
/begin MEASUREMENT Nwe1_time "Zeitstempel bei el. fallender Einlassnockenwellenflanke (1 Inc. = 1 ms)" ULONG _CNV_R_R_Def_dez_sl_575_CM 1 100. 0. 4294967295. DISPLAY_IDENTIFIER NWE1_TIME ECU_ADDRESS 0xd0006890 FORMAT "%7.0" /end MEASUREMENT
/begin MEASUREMENT Oz_datstat "Status Anzeige Uhrzeit Datum" UBYTE _CNV_R_R_Def_dez_sl_575_CM 1 100. 0. 255. DISPLAY_IDENTIFIER OZ_DATSTAT ECU_ADDRESS 0xc0002634 FORMAT "%3.0" /end MEASUREMENT
/begin MEASUREMENT Oz_lf1c "Länderfaktor 1 codiert" UBYTE _CNV_R_R_Def_lf_ub__675_CM 1 100. 0. 2.55 DISPLAY_IDENTIFIER OZ_LF1C ECU_ADDRESS 0xc0002635 FORMAT "%5.2" /end MEASUREMENT
/begin MEASUREMENT Oz_lf2c "Länderfaktor 2 codiert" UBYTE _CNV_R_R_Def_lf_ub__675_CM 1 100. 0. 2.55 DISPLAY_IDENTIFIER OZ_LF2C ECU_ADDRESS 0xc0002636 FORMAT "%5.2" /end MEASUREMENT
/begin MEASUREMENT Oz_nivr "Rohwert Ölniveau vom Sensor" UBYTE _CNV_R_R_Def_dez_sl_575_CM 1 100. 0. 255. DISPLAY_IDENTIFIER OZ_NIVR ECU_ADDRESS 0xc0002637 FORMAT "%3.0" /end MEASUREMENT
/begin MEASUREMENT Oz_permr "Rohwert Permittivität vom Sensor" UWORD _CNV_R_R_Def_dez_sl_575_CM 1 100. 0. 65535. DISPLAY_IDENTIFIER OZ_PERMR ECU_ADDRESS 0xc0002638 FORMAT "%5.0" /end MEASUREMENT
/begin MEASUREMENT Oz_resetr "Status der Resetart vom Kombi" UBYTE _CNV_R_R_Def_dez_sl_575_CM 1 100. 0. 255. DISPLAY_IDENTIFIER OZ_RESETR ECU_ADDRESS 0xc0004c7c FORMAT "%3.0" /end MEASUREMENT
/begin MEASUREMENT Oz_status "Statusinfo vom Sensor" UBYTE _CNV_R_R_Def_dez_sl_575_CM 1 100. 0. 255. DISPLAY_IDENTIFIER OZ_STATUS ECU_ADDRESS 0xc000263a FORMAT "%3.0" /end MEASUREMENT
/begin MEASUREMENT Oz_tempr "Rohwert Öltemperatur vom Sensor" UBYTE _CNV_R_R_Def_dez_sl_575_CM 1 100. 0. 255. DISPLAY_IDENTIFIER OZ_TEMPR ECU_ADDRESS 0xc000263b FORMAT "%3.0" /end MEASUREMENT
/begin MEASUREMENT P_oel_ist "Ist Öldruck." UWORD _CNV_R_R_Def_p_sw_q_683_CM 1 100. 0. 65535. DISPLAY_IDENTIFIER P_OEL_IST ECU_ADDRESS 0xd0006894 FORMAT "%6.1" /end MEASUREMENT
/begin MEASUREMENT P_oelsol_tst "Sollwert Öldruck über Tester" UBYTE _CNV_R_R_Def_p_ub_q_684_CM 1 100. 0. 8160. DISPLAY_IDENTIFIER P_OELSOL_TST ECU_ADDRESS 0xd0006896 FORMAT "%4.1" /end MEASUREMENT
/begin MEASUREMENT P_rail_kh "Raildruck vom Katheizmanager" UWORD _CNV_R_R_Def_p_uw_q_685_CM 1 100. 0. 39.9993 DISPLAY_IDENTIFIER P_RAIL_KH ECU_ADDRESS 0xd0006898 FORMAT "%9.4" /end MEASUREMENT
/begin MEASUREMENT Pbrems "Bremsdruck" UBYTE _CNV_R_R_Def_p_ub_q_686_CM 1 100. 0. 99.60930000000001 DISPLAY_IDENTIFIER PBREMS ECU_ADDRESS 0xd000689a FORMAT "%5.2" /end MEASUREMENT
/begin MEASUREMENT Pe_ist_ewp "Elektrische Leistung EWAPU" UBYTE _CNV_R_R_Def_f_ub_b_602_CM 1 100. 0. 99.60930000000001 DISPLAY_IDENTIFIER PE_IST_EWP ECU_ADDRESS 0xc0004c7d FORMAT "%5.2" /end MEASUREMENT
/begin MEASUREMENT Pmsv "Angemeldete Powermanagment Standverbraucher" UBYTE _CNV_R_R_Def_dez_sl_575_CM 1 100. 0. 255. DISPLAY_IDENTIFIER PMSV ECU_ADDRESS 0xc0004010 FORMAT "%3.0" ARRAY_SIZE 15 MATRIX_DIM 15 1 1 /end MEASUREMENT
/begin MEASUREMENT Prail_ist "Raildruck" UWORD _CNV_R_R_Def_p_uw_q_685_CM 1 100. 0. 39.9993 DISPLAY_IDENTIFIER PRAIL_IST ECU_ADDRESS 0xd000689c FORMAT "%9.4" /end MEASUREMENT
/begin MEASUREMENT Prio_katman1 "Prioritätzahl des besten Wunsches des CHM" UBYTE _CNV_R_R_Def_dez_sl_575_CM 1 100. 0. 255. DISPLAY_IDENTIFIER PRIO_KATMAN1 ECU_ADDRESS 0xc000263c FORMAT "%3.0" /end MEASUREMENT
/begin MEASUREMENT Prio_katman2 "Prioritätzahl des zweiten Wunsches des CHM" UBYTE _CNV_R_R_Def_dez_sl_575_CM 1 100. 0. 255. DISPLAY_IDENTIFIER PRIO_KATMAN2 ECU_ADDRESS 0xc000263d FORMAT "%3.0" /end MEASUREMENT
/begin MEASUREMENT Ps_abs "Absolut Sammler druck vom Sensor" UWORD _CNV_R_R_Def_p_sw_q_578_CM 1 100. 0. 2559.9609 DISPLAY_IDENTIFIER PS_ABS ECU_ADDRESS 0xd000689e FORMAT "%7.2" /end MEASUREMENT
/begin MEASUREMENT Pu "Umgebungsdruck" UWORD _CNV_R_R_Def_p_sw_q_578_CM 1 100. 0. 2559.9609 DISPLAY_IDENTIFIER PU ECU_ADDRESS 0xc000263e FORMAT "%7.2" /end MEASUREMENT
/begin MEASUREMENT Pvagr "absoluter Abgasdruck" UWORD _CNV_R_R_Def_p_sw_q_578_CM 1 100. 0. 2559.9609 DISPLAY_IDENTIFIER PVAGR ECU_ADDRESS 0xd00068a0 FORMAT "%7.2" /end MEASUREMENT
/begin MEASUREMENT Pvdkds "Druck vor Drosselklappe vom Sensor" UWORD _CNV_R_R_Def_p_sw_q_578_CM 1 100. 0. 2559.9609 DISPLAY_IDENTIFIER PVDKDS ECU_ADDRESS 0xd00068a2 FORMAT "%7.2" /end MEASUREMENT
/begin MEASUREMENT Pvld1 "Absolutdrucksensor vor Verdichter 1" UWORD _CNV_R_R_Def_p_sw_q_578_CM 1 100. 0. 2559.9609 DISPLAY_IDENTIFIER PVLD1 ECU_ADDRESS 0xc0004c7e FORMAT "%7.2" /end MEASUREMENT
/begin MEASUREMENT Pvld2 "Absolutdrucksensor vor Verdichter 2" UWORD _CNV_R_R_Def_p_sw_q_578_CM 1 100. 0. 2559.9609 DISPLAY_IDENTIFIER PVLD2 ECU_ADDRESS 0xc0004c80 FORMAT "%7.2" /end MEASUREMENT
/begin MEASUREMENT Pwg_ist "Pedalwert Fahrerwunsch in %" SWORD _CNV_R_R_Def_wdk_sw_691_CM 1 100. -800. 799.9755 DISPLAY_IDENTIFIER PWG_IST ECU_ADDRESS 0xc0002640 FORMAT "%7.2" /end MEASUREMENT
/begin MEASUREMENT Pwg_max "Maximalauswahl aus Pwg_ist und virtuellem Fahrpedal" SWORD _CNV_R_R_Def_wdk_sw_691_CM 1 100. -800. 799.9755 DISPLAY_IDENTIFIER PWG_MAX ECU_ADDRESS 0xd00068a4 FORMAT "%7.2" /end MEASUREMENT
/begin MEASUREMENT Qs_anf_klima "Wärmestromanforderung an DME zur Ansteuerung eWAPU" UBYTE _CNV_R_R_Def_f_ub_b_602_CM 1 100. 0. 99.60930000000001 DISPLAY_IDENTIFIER QS_ANF_KLIMA ECU_ADDRESS 0xc0002642 FORMAT "%5.2" /end MEASUREMENT
/begin MEASUREMENT Rk2_kh_h "Fuel mass setpoint for the second pulse at homogeneous mode during CH" SWORD _CNV_R_R_Def_rel_sw_584_CM 1 100. -100. 99.9969 DISPLAY_IDENTIFIER RK2_KH_H ECU_ADDRESS 0xd00068a6 FORMAT "%8.3" /end MEASUREMENT
/begin MEASUREMENT Rk3_kh_s "Mass fuel flow of the post injection during CH" SWORD _CNV_R_R_Def_rel_sw_584_CM 1 100. -100. 99.9969 DISPLAY_IDENTIFIER RK3_KH_S ECU_ADDRESS 0xd00068a8 FORMAT "%8.3" /end MEASUREMENT
/begin MEASUREMENT Rk_1 "Relative Kraftstoffmasse" UWORD _CNV_R_R_Def_rk_uw__696_CM 1 100. 0. 31.9995 DISPLAY_IDENTIFIER RK_1 ECU_ADDRESS 0xd00068aa FORMAT "%9.4" /end MEASUREMENT
/begin MEASUREMENT Rk_2 "Relative Kraftstoffmasse" UWORD _CNV_R_R_Def_rk_uw__696_CM 1 100. 0. 31.9995 DISPLAY_IDENTIFIER RK_2 ECU_ADDRESS 0xd00068ac FORMAT "%9.4" /end MEASUREMENT
/begin MEASUREMENT Rk_add_ad1 "Lambdaadaption additiv Bank1" SWORD _CNV_R_R_Def_rk_sw__697_CM 1 100. -1600. 1599.9511 DISPLAY_IDENTIFIER RK_ADD_AD1 ECU_ADDRESS 0xc0004c82 FORMAT "%8.3" /end MEASUREMENT
/begin MEASUREMENT Rk_add_ad2 "Lambdaadaption additiv" SWORD _CNV_R_R_Def_rk_sw__697_CM 1 100. -1600. 1599.9511 DISPLAY_IDENTIFIER RK_ADD_AD2 ECU_ADDRESS 0xc0004c84 FORMAT "%8.3" /end MEASUREMENT
/begin MEASUREMENT Rk_nz_ist "letzte eingespritzte Kraftstoffmenge nach Zündung" SWORD _CNV_R_R_Def_rk_sw__697_CM 1 100. -1600. 1599.9511 DISPLAY_IDENTIFIER RK_NZ_IST ECU_ADDRESS 0xc0004c86 FORMAT "%8.3" /end MEASUREMENT
/begin MEASUREMENT Rk_vz_ist "letzte eingespritzte Kraftstoffmenge vor Zündung" SWORD _CNV_R_R_Def_rk_sw__697_CM 1 100. -1600. 1599.9511 DISPLAY_IDENTIFIER RK_VZ_IST ECU_ADDRESS 0xc0004c88 FORMAT "%8.3" /end MEASUREMENT
/begin MEASUREMENT Rktev "Kraftstoffkorrektur durch TEV" SWORD _CNV_R_R_Def_rk_sw__698_CM 1 100. -16. 15.9995 DISPLAY_IDENTIFIER RKTEV ECU_ADDRESS 0xc0002644 FORMAT "%9.4" /end MEASUREMENT
/begin MEASUREMENT Segakt "Aktuelles Segment aus der TPU" UBYTE _CNV_R_R_Def_dez_sl_575_CM 1 100. 0. 255. DISPLAY_IDENTIFIER SEGAKT ECU_ADDRESS 0xd00068ae FORMAT "%3.0" /end MEASUREMENT
/begin MEASUREMENT St_agr "Status Abgasrückführung" UBYTE _CNV_R_R_Def_dez_sl_575_CM 1 100. 0. 255. DISPLAY_IDENTIFIER ST_AGR ECU_ADDRESS 0xd00068af FORMAT "%3.0" /end MEASUREMENT
/begin MEASUREMENT St_agr.B_agr_ktrl "AGR Kontrol aktiv" UBYTE _CNV_S_2_Def_bit_ub_700_CM 1 100. 0. 1. DISPLAY_IDENTIFIER B_AGR_KTRL ECU_ADDRESS 0xd00068af BIT_MASK 0x1 /end MEASUREMENT
/begin MEASUREMENT St_anf_prail "Statuswort Anforderung Diagnose für Raildruck" UBYTE _CNV_R_R_Def_dez_sl_575_CM 1 100. 0. 255. DISPLAY_IDENTIFIER ST_ANF_PRAIL ECU_ADDRESS 0xc0004c8a FORMAT "%3.0" /end MEASUREMENT
/begin MEASUREMENT St_anf_prail.B_aprail_hom "Anforderung Diagnose-Raildruck Homogen" UBYTE _CNV_S_2_Def_bit_ub_700_CM 1 100. 0. 1. DISPLAY_IDENTIFIER B_APRAIL_HOM ECU_ADDRESS 0xc0004c8a BIT_MASK 0x1 /end MEASUREMENT
/begin MEASUREMENT St_anf_prail.B_aprail_ndnotl "Anforderung Diagnose-Raildruck Niederdrucknotlauf" UBYTE _CNV_S_2_Def_bit_ub_701_CM 1 100. 0. 2. DISPLAY_IDENTIFIER B_APRAIL_NDNOTL ECU_ADDRESS 0xc0004c8a BIT_MASK 0x2 /end MEASUREMENT
/begin MEASUREMENT St_anf_prail.B_prail_h "Anforderung des Homogenbetriebs" UBYTE _CNV_S_2_Def_bit_ub_702_CM 1 100. 0. 4. DISPLAY_IDENTIFIER B_PRAIL_H ECU_ADDRESS 0xc0004c8a BIT_MASK 0x4 /end MEASUREMENT
/begin MEASUREMENT St_anf_prail.B_prailvcv_h "Anforderung des Homogenbetriebes bei offenstehendem VCV" UBYTE _CNV_S_2_Def_bit_ub_703_CM 1 100. 0. 8. DISPLAY_IDENTIFIER B_PRAILVCV_H ECU_ADDRESS 0xc0004c8a BIT_MASK 0x8 /end MEASUREMENT
/begin MEASUREMENT St_anf_prail.B_prailvfd_h "Anforderung des Limphomes mit Vorförderdruck." UBYTE _CNV_S_2_Def_bit_ub_704_CM 1 100. 0. 16. DISPLAY_IDENTIFIER B_PRAILVFD_H ECU_ADDRESS 0xc0004c8a BIT_MASK 0x10 /end MEASUREMENT
/begin MEASUREMENT St_anman "Status Antriebsmanagement" UBYTE _CNV_R_R_Def_dez_sl_575_CM 1 100. 0. 255. DISPLAY_IDENTIFIER ST_ANMAN ECU_ADDRESS 0xd00072e4 FORMAT "%3.0" /end MEASUREMENT
/begin MEASUREMENT St_anman.B_2fl_gangi "Status Antriebsmanagement" UBYTE _CNV_S_2_Def_bit_ub_705_CM 1 100. 0. 32. DISPLAY_IDENTIFIER B_2FL_GANGI ECU_ADDRESS 0xd00072e4 BIT_MASK 0x20 /end MEASUREMENT
/begin MEASUREMENT St_anman.B_antieb "Status Antriebsmanagement" UBYTE _CNV_S_2_Def_bit_ub_702_CM 1 100. 0. 4. DISPLAY_IDENTIFIER B_ANTIEB ECU_ADDRESS 0xd00072e4 BIT_MASK 0x4 /end MEASUREMENT
/begin MEASUREMENT St_anman.B_antieb_starr "Status Antriebsmanagement" UBYTE _CNV_S_2_Def_bit_ub_701_CM 1 100. 0. 2. DISPLAY_IDENTIFIER B_ANTIEB_STARR ECU_ADDRESS 0xd00072e4 BIT_MASK 0x2 /end MEASUREMENT
/begin MEASUREMENT St_anman.B_kein_gang "Status Antriebsmanagement" UBYTE _CNV_S_2_Def_bit_ub_703_CM 1 100. 0. 8. DISPLAY_IDENTIFIER B_KEIN_GANG ECU_ADDRESS 0xd00072e4 BIT_MASK 0x8 /end MEASUREMENT
/begin MEASUREMENT St_anman.B_kupp_int "Status Antriebsmanagement" UBYTE _CNV_S_2_Def_bit_ub_706_CM 1 100. 0. 64. DISPLAY_IDENTIFIER B_KUPP_INT ECU_ADDRESS 0xd00072e4 BIT_MASK 0x40 /end MEASUREMENT
/begin MEASUREMENT St_anman.B_ldm_bremst "Status Antriebsmanagement" UBYTE _CNV_S_2_Def_bit_ub_704_CM 1 100. 0. 16. DISPLAY_IDENTIFIER B_LDM_BREMST ECU_ADDRESS 0xd00072e4 BIT_MASK 0x10 /end MEASUREMENT
/begin MEASUREMENT St_anman.B_ldm_mdrad "Status Antriebsmanagement" UBYTE _CNV_S_2_Def_bit_ub_700_CM 1 100. 0. 1. DISPLAY_IDENTIFIER B_LDM_MDRAD ECU_ADDRESS 0xd00072e4 BIT_MASK 0x1 /end MEASUREMENT
/begin MEASUREMENT St_anman1 "Status Anman" UBYTE _CNV_R_R_Def_dez_sl_575_CM 1 100. 0. 255. DISPLAY_IDENTIFIER ST_ANMAN1 ECU_ADDRESS 0xd00068b0 FORMAT "%3.0" /end MEASUREMENT
/begin MEASUREMENT St_anman1.B_ldm_ena "Enable Momentenwunsch aus LDM" UBYTE _CNV_S_2_Def_bit_ub_702_CM 1 100. 0. 4. DISPLAY_IDENTIFIER B_LDM_ENA ECU_ADDRESS 0xd00068b0 BIT_MASK 0x4 /end MEASUREMENT
/begin MEASUREMENT St_anman1.B_ldm_nofil "Bedingung schnelle Momenteneinstellung von LDM" UBYTE _CNV_S_2_Def_bit_ub_700_CM 1 100. 0. 1. DISPLAY_IDENTIFIER B_LDM_NOFIL ECU_ADDRESS 0xd00068b0 BIT_MASK 0x1 /end MEASUREMENT
/begin MEASUREMENT St_anman1.B_nosa "Bedingung SA verboten von LDM" UBYTE _CNV_S_2_Def_bit_ub_701_CM 1 100. 0. 2. DISPLAY_IDENTIFIER B_NOSA ECU_ADDRESS 0xd00068b0 BIT_MASK 0x2 /end MEASUREMENT
/begin MEASUREMENT St_ba "Status Betriebsarten" UBYTE _CNV_R_R_Def_dez_sl_575_CM 1 100. 0. 255. DISPLAY_IDENTIFIER ST_BA ECU_ADDRESS 0xd00068b1 FORMAT "%3.0" /end MEASUREMENT
/begin MEASUREMENT St_ba.B_vb_hmm "Homogenmagerbetrieb verboten" UBYTE _CNV_S_2_Def_bit_ub_700_CM 1 100. 0. 1. DISPLAY_IDENTIFIER B_VB_HMM ECU_ADDRESS 0xd00068b1 BIT_MASK 0x1 /end MEASUREMENT
/begin MEASUREMENT St_ba.B_vb_sch "Schichtbetrieb verboten" UBYTE _CNV_S_2_Def_bit_ub_701_CM 1 100. 0. 2. DISPLAY_IDENTIFIER B_VB_SCH ECU_ADDRESS 0xd00068b1 BIT_MASK 0x2 /end MEASUREMENT
/begin MEASUREMENT St_bldstg "Statuswort" UBYTE _CNV_R_R_Def_dez_sl_575_CM 1 100. 0. 255. DISPLAY_IDENTIFIER ST_BLDSTG ECU_ADDRESS 0xd0007270 FORMAT "%3.0" /end MEASUREMENT
/begin MEASUREMENT St_bldstg.B_ubeb_start "Bed. Motorstart für Startauswertung PM durch Erkennung Spannngseinbruch" UBYTE _CNV_S_2_Def_bit_ub_700_CM 1 100. 0. 1. DISPLAY_IDENTIFIER B_UBEB_START ECU_ADDRESS 0xd0007270 BIT_MASK 0x1 /end MEASUREMENT
/begin MEASUREMENT St_bls "" UBYTE _CNV_R_R_Def_dez_sl_575_CM 1 100. 0. 255. DISPLAY_IDENTIFIER ST_BLS ECU_ADDRESS 0xd00068b2 FORMAT "%3.0" /end MEASUREMENT
/begin MEASUREMENT St_bls.B_bls "Bedingung Bremslichtschalter" UBYTE _CNV_S_2_Def_bit_ub_700_CM 1 100. 0. 1. DISPLAY_IDENTIFIER B_BLS ECU_ADDRESS 0xd00068b2 BIT_MASK 0x1 /end MEASUREMENT
/begin MEASUREMENT St_blsdisa1 "Statuswort BLSDISA Eingang" UBYTE _CNV_R_R_Def_dez_sl_575_CM 1 100. 0. 255. DISPLAY_IDENTIFIER ST_BLSDISA1 ECU_ADDRESS 0xd00068b3 FORMAT "%3.0" /end MEASUREMENT
/begin MEASUREMENT St_blsdisa1.B_disa_akt "Disa-Ansteuerung freigegeben" UBYTE _CNV_S_2_Def_bit_ub_700_CM 1 100. 0. 1. DISPLAY_IDENTIFIER B_DISA_AKT ECU_ADDRESS 0xd00068b3 BIT_MASK 0x1 /end MEASUREMENT
/begin MEASUREMENT St_bsd "Status BSD" UBYTE _CNV_R_R_Def_dez_sl_575_CM 1 100. 0. 255. DISPLAY_IDENTIFIER ST_BSD ECU_ADDRESS 0xc0004c8b FORMAT "%3.0" /end MEASUREMENT
/begin MEASUREMENT St_btvns "" UBYTE _CNV_R_R_Def_dez_sl_575_CM 1 100. 0. 255. DISPLAY_IDENTIFIER ST_BTVNS ECU_ADDRESS 0xd00068b4 FORMAT "%3.0" /end MEASUREMENT
/begin MEASUREMENT St_btvns.B_btvsa "Bedingung Testeransteuerung AVANOS" UBYTE _CNV_S_2_Def_bit_ub_700_CM 1 100. 0. 1. DISPLAY_IDENTIFIER B_BTVSA ECU_ADDRESS 0xd00068b4 BIT_MASK 0x1 /end MEASUREMENT
/begin MEASUREMENT St_btvns.B_btvse "Bedingung Testeransteuerung EVANOS" UBYTE _CNV_S_2_Def_bit_ub_701_CM 1 100. 0. 2. DISPLAY_IDENTIFIER B_BTVSE ECU_ADDRESS 0xd00068b4 BIT_MASK 0x2 /end MEASUREMENT
/begin MEASUREMENT St_ckl15 "Klemmensignale vom CAN" UBYTE _CNV_R_R_Def_dez_sl_575_CM 1 100. 0. 255. DISPLAY_IDENTIFIER ST_CKL15 ECU_ADDRESS 0xc0002646 FORMAT "%3.0" /end MEASUREMENT
/begin MEASUREMENT St_ckl15.B_ckl30 "Bedingung Klemme R (über CAN)" UBYTE _CNV_S_2_Def_bit_ub_701_CM 1 100. 0. 2. DISPLAY_IDENTIFIER B_CKL30 ECU_ADDRESS 0xc0002646 BIT_MASK 0x2 /end MEASUREMENT
/begin MEASUREMENT St_ckl15.B_ckl50 "Bedingung Klemme 50 (vom CAN)" UBYTE _CNV_S_2_Def_bit_ub_700_CM 1 100. 0. 1. DISPLAY_IDENTIFIER B_CKL50 ECU_ADDRESS 0xc0002646 BIT_MASK 0x1 /end MEASUREMENT
/begin MEASUREMENT St_ckl15.B_cklr "Bedingung Klemme R (über CAN)" UBYTE _CNV_S_2_Def_bit_ub_701_CM 1 100. 0. 2. DISPLAY_IDENTIFIER B_CKLR ECU_ADDRESS 0xc0002646 BIT_MASK 0x2 /end MEASUREMENT
/begin MEASUREMENT St_clc "Status Clc" UBYTE _CNV_R_R_Def_dez_sl_575_CM 1 100. 0. 255. DISPLAY_IDENTIFIER ST_CLC ECU_ADDRESS 0xd00068b5 FORMAT "%3.0" /end MEASUREMENT
/begin MEASUREMENT St_clc.B_hmm_clc "Berechnung für homogen mager aktiv" UBYTE _CNV_S_2_Def_bit_ub_700_CM 1 100. 0. 1. DISPLAY_IDENTIFIER B_HMM_CLC ECU_ADDRESS 0xd00068b5 BIT_MASK 0x1 /end MEASUREMENT
/begin MEASUREMENT St_clc.B_sch_clc "Berechnung für schicht aktiv" UBYTE _CNV_S_2_Def_bit_ub_701_CM 1 100. 0. 2. DISPLAY_IDENTIFIER B_SCH_CLC ECU_ADDRESS 0xd00068b5 BIT_MASK 0x2 /end MEASUREMENT
/begin MEASUREMENT St_cybl "Statuswort Gleichstellung" UWORD _CNV_R_R_Def_dez_sl_575_CM 1 100. 0. 65535. DISPLAY_IDENTIFIER ST_CYBL ECU_ADDRESS 0xd00068b6 FORMAT "%5.0" /end MEASUREMENT
/begin MEASUREMENT St_cybl.B_gl_ad "Lambdaadaption am Bandende hat fertig gelernt." UWORD _CNV_S_2_Def_bit_ub_700_CM 1 100. 0. 1. DISPLAY_IDENTIFIER B_GL_AD ECU_ADDRESS 0xd00068b6 BIT_MASK 0x1 /end MEASUREMENT
/begin MEASUREMENT St_cybl.B_gl_adder "ER_Balancing am Bandende hat additiv adaptiert" UWORD _CNV_S_2_Def_bit_ub_704_CM 1 100. 0. 16. DISPLAY_IDENTIFIER B_GL_ADDER ECU_ADDRESS 0xd00068b6 BIT_MASK 0x10 /end MEASUREMENT
/begin MEASUREMENT St_cybl.B_gl_adz "Lambdaadaption ist nötig. Zyklisch während Motorbetrieb zu 1 gesetzt" UWORD _CNV_S_2_Def_bit_ub_705_CM 1 100. 0. 32. DISPLAY_IDENTIFIER B_GL_ADZ ECU_ADDRESS 0xd00068b6 BIT_MASK 0x20 /end MEASUREMENT
/begin MEASUREMENT St_cybl.B_gl_faker "ER_Balancing am Bandende hat den Faktor adaptiert" UWORD _CNV_S_2_Def_bit_ub_703_CM 1 100. 0. 8. DISPLAY_IDENTIFIER B_GL_FAKER ECU_ADDRESS 0xd00068b6 BIT_MASK 0x8 /end MEASUREMENT
/begin MEASUREMENT St_cybl.B_gl_hz "Zylindersel. Lambdaregelung fordert homogen an. Zyklisch während dem Motorbetrieb zu 1 gesetzt." UWORD _CNV_S_2_Def_bit_ub_707_CM 1 100. 0. 128. DISPLAY_IDENTIFIER B_GL_HZ ECU_ADDRESS 0xd00068b6 BIT_MASK 0x80 /end MEASUREMENT
/begin MEASUREMENT St_cybl.B_gl_wg1 "Bedingung Gleichstellung zur Öffnung des Waste Gate 1" UWORD _CNV_S_2_Def_bit_uw_708_CM 1 100. 0. 256. DISPLAY_IDENTIFIER B_GL_WG1 ECU_ADDRESS 0xd00068b6 BIT_MASK 0x100 /end MEASUREMENT
/begin MEASUREMENT St_cybl.B_gl_wg2 "Bedingung Gleichstellung zur Öffnung des Waste Gate 2" UWORD _CNV_S_2_Def_bit_uw_709_CM 1 100. 0. 512. DISPLAY_IDENTIFIER B_GL_WG2 ECU_ADDRESS 0xd00068b6 BIT_MASK 0x200 /end MEASUREMENT
/begin MEASUREMENT St_cybl.B_gl_zsk "Zylindersel. Lambdaregelung kalt am Bandende hat fertig adaptiert" UWORD _CNV_S_2_Def_bit_ub_701_CM 1 100. 0. 2. DISPLAY_IDENTIFIER B_GL_ZSK ECU_ADDRESS 0xd00068b6 BIT_MASK 0x2 /end MEASUREMENT
/begin MEASUREMENT St_cybl.B_gl_zsw "Zylindersel. Lambdaregelung warm am Bandende hat fertig adaptiert." UWORD _CNV_S_2_Def_bit_ub_702_CM 1 100. 0. 4. DISPLAY_IDENTIFIER B_GL_ZSW ECU_ADDRESS 0xd00068b6 BIT_MASK 0x4 /end MEASUREMENT
/begin MEASUREMENT St_cybl.B_gl_zswz "Zylindersel. Lambdaregelung warm ist nötig. Zyklisch während Motorbetrieb zu 1 gesetzt" UWORD _CNV_S_2_Def_bit_ub_706_CM 1 100. 0. 64. DISPLAY_IDENTIFIER B_GL_ZSWZ ECU_ADDRESS 0xd00068b6 BIT_MASK 0x40 /end MEASUREMENT
/begin MEASUREMENT St_ddss "" UBYTE _CNV_R_R_Def_dez_sl_575_CM 1 100. 0. 255. DISPLAY_IDENTIFIER ST_DDSS ECU_ADDRESS 0xd00068b8 FORMAT "%3.0" /end MEASUREMENT
/begin MEASUREMENT St_ddss.B_bkddss "Bedingung Ersatzwert Differenzdrucksensor Saugrohr" UBYTE _CNV_S_2_Def_bit_ub_700_CM 1 100. 0. 1. DISPLAY_IDENTIFIER B_BKDDSS ECU_ADDRESS 0xd00068b8 BIT_MASK 0x1 /end MEASUREMENT
/begin MEASUREMENT St_ddss.B_bkpddss "Bedingung Ersatzwert Druck Differenzdrucksensor Saugrohr" UBYTE _CNV_S_2_Def_bit_ub_701_CM 1 100. 0. 2. DISPLAY_IDENTIFIER B_BKPDDSS ECU_ADDRESS 0xd00068b8 BIT_MASK 0x2 /end MEASUREMENT
/begin MEASUREMENT St_desul "Status Entschwefelung" UBYTE _CNV_R_R_Def_dez_sl_575_CM 1 100. 0. 255. DISPLAY_IDENTIFIER ST_DESUL ECU_ADDRESS 0xc0002647 FORMAT "%3.0" /end MEASUREMENT
/begin MEASUREMENT St_desul.B_desu_fett "eine fette Entschwefelung ist angefordert" UBYTE _CNV_S_2_Def_bit_ub_703_CM 1 100. 0. 8. DISPLAY_IDENTIFIER B_DESU_FETT ECU_ADDRESS 0xc0002647 BIT_MASK 0x8 /end MEASUREMENT
/begin MEASUREMENT St_desul.B_desu_puls "langsame Desulfatisierung (lambda pulsation) angefordert." UBYTE _CNV_S_2_Def_bit_ub_700_CM 1 100. 0. 1. DISPLAY_IDENTIFIER B_DESU_PULS ECU_ADDRESS 0xc0002647 BIT_MASK 0x1 /end MEASUREMENT
/begin MEASUREMENT St_desul.B_desul_akt "Desulfatisierung aktiv" UBYTE _CNV_S_2_Def_bit_ub_702_CM 1 100. 0. 4. DISPLAY_IDENTIFIER B_DESUL_AKT ECU_ADDRESS 0xc0002647 BIT_MASK 0x4 /end MEASUREMENT
/begin MEASUREMENT St_devxdetec "Ergebnis BSD-Lernfunktion" UBYTE _CNV_R_R_Def_dez_sl_575_CM 1 100. 0. 255. DISPLAY_IDENTIFIER ST_DEVXDETEC ECU_ADDRESS 0xc000401f FORMAT "%3.0" /end MEASUREMENT
/begin MEASUREMENT St_devxdetec.B_dev0detec "BSD Dev. 0 gelernt" UBYTE _CNV_S_2_Def_bit_ub_700_CM 1 100. 0. 1. DISPLAY_IDENTIFIER B_DEV0DETEC ECU_ADDRESS 0xc000401f BIT_MASK 0x1 /end MEASUREMENT
/begin MEASUREMENT St_devxdetec.B_dev1detec "BSD Dev. 1 gelernt" UBYTE _CNV_S_2_Def_bit_ub_701_CM 1 100. 0. 2. DISPLAY_IDENTIFIER B_DEV1DETEC ECU_ADDRESS 0xc000401f BIT_MASK 0x2 /end MEASUREMENT
/begin MEASUREMENT St_devxdetec.B_dev2detec "BSD Dev. 2 gelernt" UBYTE _CNV_S_2_Def_bit_ub_702_CM 1 100. 0. 4. DISPLAY_IDENTIFIER B_DEV2DETEC ECU_ADDRESS 0xc000401f BIT_MASK 0x4 /end MEASUREMENT
/begin MEASUREMENT St_devxdetec.B_dev3detec "BSD Dev. 3 gelernt" UBYTE _CNV_S_2_Def_bit_ub_703_CM 1 100. 0. 8. DISPLAY_IDENTIFIER B_DEV3DETEC ECU_ADDRESS 0xc000401f BIT_MASK 0x8 /end MEASUREMENT
/begin MEASUREMENT St_devxdetec.B_dev4detec "BSD Dev. 4 gelernt" UBYTE _CNV_S_2_Def_bit_ub_704_CM 1 100. 0. 16. DISPLAY_IDENTIFIER B_DEV4DETEC ECU_ADDRESS 0xc000401f BIT_MASK 0x10 /end MEASUREMENT
/begin MEASUREMENT St_devxdetec.B_dev5detec "BSD Dev. 5 gelernt" UBYTE _CNV_S_2_Def_bit_ub_705_CM 1 100. 0. 32. DISPLAY_IDENTIFIER B_DEV5DETEC ECU_ADDRESS 0xc000401f BIT_MASK 0x20 /end MEASUREMENT
/begin MEASUREMENT St_devxdetec.B_dev6detec "BSD Dev. 6 gelernt" UBYTE _CNV_S_2_Def_bit_ub_706_CM 1 100. 0. 64. DISPLAY_IDENTIFIER B_DEV6DETEC ECU_ADDRESS 0xc000401f BIT_MASK 0x40 /end MEASUREMENT
/begin MEASUREMENT St_devxdetec.B_dev7detec "BSD Dev. 7 gelernt" UBYTE _CNV_S_2_Def_bit_ub_707_CM 1 100. 0. 128. DISPLAY_IDENTIFIER B_DEV7DETEC ECU_ADDRESS 0xc000401f BIT_MASK 0x80 /end MEASUREMENT
/begin MEASUREMENT St_dk_diag "Status TPS Diagnose" UBYTE _CNV_R_R_Def_dez_sl_575_CM 1 100. 0. 255. DISPLAY_IDENTIFIER ST_DK_DIAG ECU_ADDRESS 0xd00068b9 FORMAT "%3.0" /end MEASUREMENT
/begin MEASUREMENT St_dk_diag.B_dkerr_2pot "Bedingung beide DK-Potis defekt" UBYTE _CNV_S_2_Def_bit_ub_702_CM 1 100. 0. 4. DISPLAY_IDENTIFIER B_DKERR_2POT ECU_ADDRESS 0xd00068b9 BIT_MASK 0x4 /end MEASUREMENT
/begin MEASUREMENT St_dk_diag.B_nlf "Notluftfahren aktiv" UBYTE _CNV_S_2_Def_bit_ub_703_CM 1 100. 0. 8. DISPLAY_IDENTIFIER B_NLF ECU_ADDRESS 0xd00068b9 BIT_MASK 0x8 /end MEASUREMENT
/begin MEASUREMENT St_dk_diag.B_ska "SKA aktiv, ausgelöst über Ebene 1, 2 oder 3" UBYTE _CNV_S_2_Def_bit_ub_704_CM 1 100. 0. 16. DISPLAY_IDENTIFIER B_SKA ECU_ADDRESS 0xd00068b9 BIT_MASK 0x10 /end MEASUREMENT
/begin MEASUREMENT St_dk_notl "Status Dk-Notlauf" UBYTE _CNV_R_R_Def_dez_sl_575_CM 1 100. 0. 255. DISPLAY_IDENTIFIER ST_DK_NOTL ECU_ADDRESS 0xd00068ba FORMAT "%3.0" /end MEASUREMENT
/begin MEASUREMENT St_dkratio "Status DK Ratiocheck" UBYTE _CNV_R_R_Def_dez_sl_575_CM 1 100. 0. 255. DISPLAY_IDENTIFIER ST_DKRATIO ECU_ADDRESS 0xc0002648 FORMAT "%3.0" /end MEASUREMENT
/begin MEASUREMENT St_dkratio.B_dkratio_h "Homogener Betrieb angefordert" UBYTE _CNV_S_2_Def_bit_ub_701_CM 1 100. 0. 2. DISPLAY_IDENTIFIER B_DKRATIO_H ECU_ADDRESS 0xc0002648 BIT_MASK 0x2 /end MEASUREMENT
/begin MEASUREMENT St_dmdblock "Statuswort" UBYTE _CNV_R_R_Def_dez_sl_575_CM 1 100. 0. 255. DISPLAY_IDENTIFIER ST_DMDBLOCK ECU_ADDRESS 0xd0007280 FORMAT "%3.0" /end MEASUREMENT
/begin MEASUREMENT St_dmdblock.B_dmd_frei "Statuswort" UBYTE _CNV_S_2_Def_bit_ub_702_CM 1 100. 0. 4. DISPLAY_IDENTIFIER B_DMD_FREI ECU_ADDRESS 0xd0007280 BIT_MASK 0x4 /end MEASUREMENT
/begin MEASUREMENT St_dmdblock.B_timmax "Statuswort" UBYTE _CNV_S_2_Def_bit_ub_701_CM 1 100. 0. 2. DISPLAY_IDENTIFIER B_TIMMAX ECU_ADDRESS 0xd0007280 BIT_MASK 0x2 /end MEASUREMENT
/begin MEASUREMENT St_dmdblock.B_timmin "Statuswort" UBYTE _CNV_S_2_Def_bit_ub_700_CM 1 100. 0. 1. DISPLAY_IDENTIFIER B_TIMMIN ECU_ADDRESS 0xd0007280 BIT_MASK 0x1 /end MEASUREMENT
/begin MEASUREMENT St_dtev "Status TEV-Diagnose" UBYTE _CNV_R_R_Def_dez_sl_575_CM 1 100. 0. 255. DISPLAY_IDENTIFIER ST_DTEV ECU_ADDRESS 0xc0002649 FORMAT "%3.0" /end MEASUREMENT
/begin MEASUREMENT St_dtev.B_dtev_aktiv "Bedingung sperrt DPS-Regler durch TEV-Diagnose" UBYTE _CNV_S_2_Def_bit_ub_700_CM 1 100. 0. 1. DISPLAY_IDENTIFIER B_DTEV_AKTIV ECU_ADDRESS 0xc0002649 BIT_MASK 0x1 /end MEASUREMENT
/begin MEASUREMENT St_egs "Statusbyte Automatikgetriebe" UBYTE _CNV_R_R_Def_dez_sl_575_CM 1 100. 0. 255. DISPLAY_IDENTIFIER ST_EGS ECU_ADDRESS 0xc000264a FORMAT "%3.0" /end MEASUREMENT
/begin MEASUREMENT St_egs.B_egs_khl1 "Bedingung Anforderung Kühlstufe 1 von Getriebesteuerung" UBYTE _CNV_S_2_Def_bit_ub_701_CM 1 100. 0. 2. DISPLAY_IDENTIFIER B_EGS_KHL1 ECU_ADDRESS 0xc000264a BIT_MASK 0x2 /end MEASUREMENT
/begin MEASUREMENT St_egs.B_egs_khl2 "Bedingung Anforderung Kühlstufe 2 von Getriebesteuerung" UBYTE _CNV_S_2_Def_bit_ub_702_CM 1 100. 0. 4. DISPLAY_IDENTIFIER B_EGS_KHL2 ECU_ADDRESS 0xc000264a BIT_MASK 0x4 /end MEASUREMENT
/begin MEASUREMENT St_egs.B_fs "Bedingung Fahrstufe" UBYTE _CNV_S_2_Def_bit_ub_700_CM 1 100. 0. 1. DISPLAY_IDENTIFIER B_FS ECU_ADDRESS 0xc000264a BIT_MASK 0x1 /end MEASUREMENT
/begin MEASUREMENT St_ekp "Statusbyte fuer EKP" UBYTE _CNV_R_R_Def_dez_sl_575_CM 1 100. 0. 255. DISPLAY_IDENTIFIER ST_EKP ECU_ADDRESS 0xd00068bb FORMAT "%3.0" /end MEASUREMENT
/begin MEASUREMENT St_ekp.B_dkpu "Bedingung Sicherheitskraftstoffabschaltung" UBYTE _CNV_S_2_Def_bit_ub_703_CM 1 100. 0. 8. DISPLAY_IDENTIFIER B_DKPU ECU_ADDRESS 0xd00068bb BIT_MASK 0x8 /end MEASUREMENT
/begin MEASUREMENT St_elu "Statuswort für Bits für Elüfter(True meint 600W Lüfter verbaut)" UBYTE _CNV_R_R_Def_dez_sl_575_CM 1 100. 0. 255. DISPLAY_IDENTIFIER ST_ELU ECU_ADDRESS 0xc000264b FORMAT "%3.0" /end MEASUREMENT
/begin MEASUREMENT St_elu.B_elu600 "Bedingung Elüftertyp" UBYTE _CNV_S_2_Def_bit_ub_700_CM 1 100. 0. 1. DISPLAY_IDENTIFIER B_ELU600 ECU_ADDRESS 0xc000264b BIT_MASK 0x1 /end MEASUREMENT
/begin MEASUREMENT St_ewp "Statusbyte elektrische Wasserpumpe" UWORD _CNV_R_R_Def_dez_sl_575_CM 1 100. 0. 65535. DISPLAY_IDENTIFIER ST_EWP ECU_ADDRESS 0xc000264c FORMAT "%5.0" /end MEASUREMENT
/begin MEASUREMENT St_ewp.B_ewp_dblk "Bedingung Deblockierungsfunktion aktiv" UWORD _CNV_S_2_Def_bit_ub_706_CM 1 100. 0. 64. DISPLAY_IDENTIFIER B_EWP_DBLK ECU_ADDRESS 0xc000264c BIT_MASK 0x40 /end MEASUREMENT
/begin MEASUREMENT St_ewp.B_ewp_noff "Bedingung Pumpe ist im gesteuerten Betrieb" UWORD _CNV_S_2_Def_bit_ub_707_CM 1 100. 0. 128. DISPLAY_IDENTIFIER B_EWP_NOFF ECU_ADDRESS 0xc000264c BIT_MASK 0x80 /end MEASUREMENT
/begin MEASUREMENT St_fdc "Statuswort FDC" UBYTE _CNV_R_R_Def_dez_sl_575_CM 1 100. 0. 255. DISPLAY_IDENTIFIER ST_FDC ECU_ADDRESS 0xd00068bc FORMAT "%3.0" /end MEASUREMENT
/begin MEASUREMENT St_fdc.B_sport "Bedingung Sport" UBYTE _CNV_S_2_Def_bit_ub_700_CM 1 100. 0. 1. DISPLAY_IDENTIFIER B_SPORT ECU_ADDRESS 0xd00068bc BIT_MASK 0x1 /end MEASUREMENT
/begin MEASUREMENT St_fgr "Status FGR" UBYTE _CNV_R_R_Def_dez_sl_575_CM 1 100. 0. 255. DISPLAY_IDENTIFIER ST_FGR ECU_ADDRESS 0xd00068bd FORMAT "%3.0" /end MEASUREMENT
/begin MEASUREMENT St_fgr.B_fgr_akt "Bedingung FGR aktiv" UBYTE _CNV_S_2_Def_bit_ub_700_CM 1 100. 0. 1. DISPLAY_IDENTIFIER B_FGR_AKT ECU_ADDRESS 0xd00068bd BIT_MASK 0x1 /end MEASUREMENT
/begin MEASUREMENT St_fzg_1 "Variante Fzg" ULONG _CNV_R_R_Def_dez_sl_575_CM 1 100. 0. 4294967295. DISPLAY_IDENTIFIER ST_FZG_1 ECU_ADDRESS 0xc000264e FORMAT "%7.0" /end MEASUREMENT
/begin MEASUREMENT St_fzg_2 "Variante Fzg" ULONG _CNV_R_R_Def_dez_sl_575_CM 1 100. 0. 4294967295. DISPLAY_IDENTIFIER ST_FZG_2 ECU_ADDRESS 0xc0002652 FORMAT "%7.0" /end MEASUREMENT
/begin MEASUREMENT St_fzg_ass "Status Fahrerassistenzsystem Antrieb" UBYTE _CNV_R_R_Def_dez_sl_575_CM 1 100. 0. 255. DISPLAY_IDENTIFIER ST_FZG_ASS ECU_ADDRESS 0xd00068be FORMAT "%3.0" /end MEASUREMENT
/begin MEASUREMENT St_gen_ext "Statusbyte Testerzugriff Generator" UBYTE _CNV_R_R_Def_dez_sl_575_CM 1 100. 0. 255. DISPLAY_IDENTIFIER ST_GEN_EXT ECU_ADDRESS 0xc0002656 FORMAT "%3.0" /end MEASUREMENT
/begin MEASUREMENT St_gen_ext.B_gen_ext "Bedingung Testeransteuerung Generator" UBYTE _CNV_S_2_Def_bit_ub_700_CM 1 100. 0. 1. DISPLAY_IDENTIFIER B_GEN_EXT ECU_ADDRESS 0xc0002656 BIT_MASK 0x1 /end MEASUREMENT
/begin MEASUREMENT St_gen_ext.B_ierr_ext "Anforderung Grenzerregerstrom vom Tester" UBYTE _CNV_S_2_Def_bit_ub_702_CM 1 100. 0. 4. DISPLAY_IDENTIFIER B_IERR_EXT ECU_ADDRESS 0xc0002656 BIT_MASK 0x4 /end MEASUREMENT
/begin MEASUREMENT St_gen_ext.B_loadre_ext "Anforderung Loadresponse vom Tester" UBYTE _CNV_S_2_Def_bit_ub_701_CM 1 100. 0. 2. DISPLAY_IDENTIFIER B_LOADRE_EXT ECU_ADDRESS 0xc0002656 BIT_MASK 0x2 /end MEASUREMENT
/begin MEASUREMENT St_genallg "Allgemeine Eingangsbits" UBYTE _CNV_R_R_Def_dez_sl_575_CM 1 100. 0. 255. DISPLAY_IDENTIFIER ST_GENALLG ECU_ADDRESS 0xc0002657 FORMAT "%3.0" /end MEASUREMENT
/begin MEASUREMENT St_genallg.B_abliactiv "Bedingung Abblendlicht aktiv" UBYTE _CNV_S_2_Def_bit_ub_701_CM 1 100. 0. 2. DISPLAY_IDENTIFIER B_ABLIACTIV ECU_ADDRESS 0xc0002657 BIT_MASK 0x2 /end MEASUREMENT
/begin MEASUREMENT St_genallg.B_bsdprot1 "Bedingung BSD Protokollinhalt für BSD1 Regler" UBYTE _CNV_S_2_Def_bit_ub_703_CM 1 100. 0. 8. DISPLAY_IDENTIFIER B_BSDPROT1 ECU_ADDRESS 0xc0002657 BIT_MASK 0x8 /end MEASUREMENT
/begin MEASUREMENT St_genallg.B_bsdprot2 "Bedingung BSD Protokollinhalt für BSD 2 Regler" UBYTE _CNV_S_2_Def_bit_ub_704_CM 1 100. 0. 16. DISPLAY_IDENTIFIER B_BSDPROT2 ECU_ADDRESS 0xc0002657 BIT_MASK 0x10 /end MEASUREMENT
/begin MEASUREMENT St_genallg.B_iliactiv "Bedingung Innenlicht aktiv" UBYTE _CNV_S_2_Def_bit_ub_700_CM 1 100. 0. 1. DISPLAY_IDENTIFIER B_ILIACTIV ECU_ADDRESS 0xc0002657 BIT_MASK 0x1 /end MEASUREMENT
/begin MEASUREMENT St_genallg.B_rd_gentyp "Bedingung Schalter APK zum Auslesen Hersteller und Generatortyp" UBYTE _CNV_S_2_Def_bit_ub_705_CM 1 100. 0. 32. DISPLAY_IDENTIFIER B_RD_GENTYP ECU_ADDRESS 0xc0002657 BIT_MASK 0x20 /end MEASUREMENT
/begin MEASUREMENT St_generator "Statusbyte Generator" UBYTE _CNV_R_R_Def_dez_sl_575_CM 1 100. 0. 255. DISPLAY_IDENTIFIER ST_GENERATOR ECU_ADDRESS 0xc0002658 FORMAT "%3.0" /end MEASUREMENT
/begin MEASUREMENT St_generator.B_crashgen "Bedingung Generator abschalten bei Crash" UBYTE _CNV_S_2_Def_bit_ub_706_CM 1 100. 0. 64. DISPLAY_IDENTIFIER B_CRASHGEN ECU_ADDRESS 0xc0002658 BIT_MASK 0x40 /end MEASUREMENT
/begin MEASUREMENT St_generator.B_genactiv "Bedingung Generatorinterface aktiv" UBYTE _CNV_S_2_Def_bit_ub_700_CM 1 100. 0. 1. DISPLAY_IDENTIFIER B_GENACTIV ECU_ADDRESS 0xc0002658 BIT_MASK 0x1 /end MEASUREMENT
/begin MEASUREMENT St_generator.B_genfbsd "Bedingung Kommunikationsverlust BSD Generator" UBYTE _CNV_S_2_Def_bit_ub_702_CM 1 100. 0. 4. DISPLAY_IDENTIFIER B_GENFBSD ECU_ADDRESS 0xc0002658 BIT_MASK 0x4 /end MEASUREMENT
/begin MEASUREMENT St_generator.B_genfel "Bedingung Generatorfehler elektrisch" UBYTE _CNV_S_2_Def_bit_ub_703_CM 1 100. 0. 8. DISPLAY_IDENTIFIER B_GENFEL ECU_ADDRESS 0xc0002658 BIT_MASK 0x8 /end MEASUREMENT
/begin MEASUREMENT St_generator.B_genfht "Bedingung Generatorzustand hohe Temparatur" UBYTE _CNV_S_2_Def_bit_ub_704_CM 1 100. 0. 16. DISPLAY_IDENTIFIER B_GENFHT ECU_ADDRESS 0xc0002658 BIT_MASK 0x10 /end MEASUREMENT
/begin MEASUREMENT St_generator.B_genfme "Bedingung Generatorfehler mechanisch" UBYTE _CNV_S_2_Def_bit_ub_705_CM 1 100. 0. 32. DISPLAY_IDENTIFIER B_GENFME ECU_ADDRESS 0xc0002658 BIT_MASK 0x20 /end MEASUREMENT
/begin MEASUREMENT St_genll "LR Eingänge" UBYTE _CNV_R_R_Def_dez_sl_575_CM 1 100. 0. 255. DISPLAY_IDENTIFIER ST_GENLL ECU_ADDRESS 0xc0004c8c FORMAT "%3.0" /end MEASUREMENT
/begin MEASUREMENT St_genll.B_lrfoff "Kopie Drehzahlschwelle für LR-Funktion Generator 1 aktiv" UBYTE _CNV_S_2_Def_bit_ub_700_CM 1 100. 0. 1. DISPLAY_IDENTIFIER B_LRFOFF ECU_ADDRESS 0xc0004c8c BIT_MASK 0x1 /end MEASUREMENT
/begin MEASUREMENT St_genll.B_lrreg1ak "LR-Register 1 aktiv Generator 1" UBYTE _CNV_S_2_Def_bit_ub_702_CM 1 100. 0. 4. DISPLAY_IDENTIFIER B_LRREG1AK ECU_ADDRESS 0xc0004c8c BIT_MASK 0x4 /end MEASUREMENT
/begin MEASUREMENT St_getriebe "Statuswort Getriebe" UBYTE _CNV_R_R_Def_dez_sl_575_CM 1 100. 0. 255. DISPLAY_IDENTIFIER ST_GETRIEBE ECU_ADDRESS 0xc0002659 FORMAT "%3.0" /end MEASUREMENT
/begin MEASUREMENT St_getriebe.B_autget "Bedingung Automatikgetriebe verbaut" UBYTE _CNV_S_2_Def_bit_ub_700_CM 1 100. 0. 1. DISPLAY_IDENTIFIER B_AUTGET ECU_ADDRESS 0xc0002659 BIT_MASK 0x1 /end MEASUREMENT
/begin MEASUREMENT St_gglsu2 "Bedingung LSU betriebsbereit vor Kat" UBYTE _CNV_R_R_Def_dez_sl_575_CM 1 100. 0. 255. DISPLAY_IDENTIFIER ST_GGLSU2 ECU_ADDRESS 0xd00068bf FORMAT "%3.0" /end MEASUREMENT
/begin MEASUREMENT St_gglsu2.B_sbblsu "Bedingung LSU betriebsbereit vor Kat" UBYTE _CNV_S_2_Def_bit_ub_700_CM 1 100. 0. 1. DISPLAY_IDENTIFIER B_SBBLSU ECU_ADDRESS 0xd00068bf BIT_MASK 0x1 /end MEASUREMENT
/begin MEASUREMENT St_gglsu2.B_sbblsu2 "Bedingung LSU2 betriebsbereit vor Kat" UBYTE _CNV_S_2_Def_bit_ub_701_CM 1 100. 0. 2. DISPLAY_IDENTIFIER B_SBBLSU2 ECU_ADDRESS 0xd00068bf BIT_MASK 0x2 /end MEASUREMENT
/begin MEASUREMENT St_gw "Status Gangwechsel" UBYTE _CNV_R_R_Def_dez_sl_575_CM 1 100. 0. 255. DISPLAY_IDENTIFIER ST_GW ECU_ADDRESS 0xc0004c8d FORMAT "%3.0" /end MEASUREMENT
/begin MEASUREMENT St_gw.B_gw "Gangwechsel aktiv" UBYTE _CNV_S_2_Def_bit_ub_700_CM 1 100. 0. 1. DISPLAY_IDENTIFIER B_GW ECU_ADDRESS 0xc0004c8d BIT_MASK 0x1 /end MEASUREMENT
/begin MEASUREMENT St_ibs "Statusbyte" UBYTE _CNV_R_R_Def_dez_sl_575_CM 1 100. 0. 255. DISPLAY_IDENTIFIER ST_IBS ECU_ADDRESS 0xc0004020 FORMAT "%3.0" /end MEASUREMENT
/begin MEASUREMENT St_ibs.B_ibsdetec "Bedingung IBS erkannt" UBYTE _CNV_S_2_Def_bit_ub_700_CM 1 100. 0. 1. DISPLAY_IDENTIFIER B_IBSDETEC ECU_ADDRESS 0xc0004020 BIT_MASK 0x1 /end MEASUREMENT
/begin MEASUREMENT St_inf "Status interception function" UBYTE _CNV_R_R_Def_dez_sl_575_CM 1 100. 0. 255. DISPLAY_IDENTIFIER ST_INF ECU_ADDRESS 0xc0004c8e FORMAT "%3.0" /end MEASUREMENT
/begin MEASUREMENT St_inf.B_inf "Bedingung interception Function" UBYTE _CNV_S_2_Def_bit_ub_700_CM 1 100. 0. 1. DISPLAY_IDENTIFIER B_INF ECU_ADDRESS 0xc0004c8e BIT_MASK 0x1 /end MEASUREMENT
/begin MEASUREMENT St_instr3_1 "Status Can Botschaft Instr3 (CAN11)" UBYTE _CNV_R_R_Def_dez_sl_575_CM 1 100. 0. 255. DISPLAY_IDENTIFIER ST_INSTR3_1 ECU_ADDRESS 0xc000265a FORMAT "%3.0" /end MEASUREMENT
/begin MEASUREMENT St_kath "Statuswort Katheizen" UBYTE _CNV_R_R_Def_dez_sl_575_CM 1 100. 0. 255. DISPLAY_IDENTIFIER ST_KATH ECU_ADDRESS 0xc0004c8f FORMAT "%3.0" /end MEASUREMENT
/begin MEASUREMENT St_kath.B_hsplit_kh "Katheizen durch Doppeleinspritzung Homogen" UBYTE _CNV_S_2_Def_bit_ub_703_CM 1 100. 0. 8. DISPLAY_IDENTIFIER B_HSPLIT_KH ECU_ADDRESS 0xc0004c8f BIT_MASK 0x8 /end MEASUREMENT
/begin MEASUREMENT St_kath.B_kh "catalyst heating function Lean Injection" UBYTE _CNV_S_2_Def_bit_ub_700_CM 1 100. 0. 1. DISPLAY_IDENTIFIER B_KH ECU_ADDRESS 0xc0004c8f BIT_MASK 0x1 /end MEASUREMENT
/begin MEASUREMENT St_kath.B_nesps_kh "Katheizen durch Nacheinspritzung Schicht" UBYTE _CNV_S_2_Def_bit_ub_701_CM 1 100. 0. 2. DISPLAY_IDENTIFIER B_NESPS_KH ECU_ADDRESS 0xc0004c8f BIT_MASK 0x2 /end MEASUREMENT
/begin MEASUREMENT St_kath.B_nlast_kh "Katheizen wegen Niedriglast" UBYTE _CNV_S_2_Def_bit_ub_706_CM 1 100. 0. 64. DISPLAY_IDENTIFIER B_NLAST_KH ECU_ADDRESS 0xc0004c8f BIT_MASK 0x40 /end MEASUREMENT
/begin MEASUREMENT St_kath.B_nst_kh "Katheizen wegen nach Start" UBYTE _CNV_S_2_Def_bit_ub_707_CM 1 100. 0. 128. DISPLAY_IDENTIFIER B_NST_KH ECU_ADDRESS 0xc0004c8f BIT_MASK 0x80 /end MEASUREMENT
/begin MEASUREMENT St_kath.B_so2p_kh "Katheizen wegen Desulfatisierung" UBYTE _CNV_S_2_Def_bit_ub_705_CM 1 100. 0. 32. DISPLAY_IDENTIFIER B_SO2P_KH ECU_ADDRESS 0xc0004c8f BIT_MASK 0x20 /end MEASUREMENT
/begin MEASUREMENT St_kath.B_zw_kh "Katheizen über ZW Homogen" UBYTE _CNV_S_2_Def_bit_ub_702_CM 1 100. 0. 4. DISPLAY_IDENTIFIER B_ZW_KH ECU_ADDRESS 0xc0004c8f BIT_MASK 0x4 /end MEASUREMENT
/begin MEASUREMENT St_kath_anf1 "Statuswort Katheizanforderung - Beste Wunsch" UBYTE _CNV_R_R_Def_dez_sl_575_CM 1 100. 0. 255. DISPLAY_IDENTIFIER ST_KATH_ANF1 ECU_ADDRESS 0xd00068c0 FORMAT "%3.0" /end MEASUREMENT
/begin MEASUREMENT St_kath_anf1.B_akh_h1 "Anforderung Katheizen Homogen - Wunsch1" UBYTE _CNV_S_2_Def_bit_ub_702_CM 1 100. 0. 4. DISPLAY_IDENTIFIER B_AKH_H1 ECU_ADDRESS 0xd00068c0 BIT_MASK 0x4 /end MEASUREMENT
/begin MEASUREMENT St_kath_anf1.B_akh_nesps1 "Anforderung Katheizen Schicht Nacheinspritzung -Wunsch1" UBYTE _CNV_S_2_Def_bit_ub_701_CM 1 100. 0. 2. DISPLAY_IDENTIFIER B_AKH_NESPS1 ECU_ADDRESS 0xd00068c0 BIT_MASK 0x2 /end MEASUREMENT
/begin MEASUREMENT St_kath_anf1.B_akh_splith1 "Anforderung Katheizen Homogen-Split - Wunsch1" UBYTE _CNV_S_2_Def_bit_ub_703_CM 1 100. 0. 8. DISPLAY_IDENTIFIER B_AKH_SPLITH1 ECU_ADDRESS 0xd00068c0 BIT_MASK 0x8 /end MEASUREMENT
/begin MEASUREMENT St_kath_anf2 "Statuswort Katheizanforderung - Default Wunsch" UBYTE _CNV_R_R_Def_dez_sl_575_CM 1 100. 0. 255. DISPLAY_IDENTIFIER ST_KATH_ANF2 ECU_ADDRESS 0xd00068c1 FORMAT "%3.0" /end MEASUREMENT
/begin MEASUREMENT St_kath_anf2.B_akh_h2 "Anforderung Katheizen Homogen - Wunsch2" UBYTE _CNV_S_2_Def_bit_ub_702_CM 1 100. 0. 4. DISPLAY_IDENTIFIER B_AKH_H2 ECU_ADDRESS 0xd00068c1 BIT_MASK 0x4 /end MEASUREMENT
/begin MEASUREMENT St_kath_anf2.B_akh_nesps2 "Anforderung Katheizen Schicht Nacheinspritzung - Wunsch 2" UBYTE _CNV_S_2_Def_bit_ub_701_CM 1 100. 0. 2. DISPLAY_IDENTIFIER B_AKH_NESPS2 ECU_ADDRESS 0xd00068c1 BIT_MASK 0x2 /end MEASUREMENT
/begin MEASUREMENT St_kath_anf2.B_akh_splith2 "Anforderung Katheizen Homogen-Split - Wunsch2" UBYTE _CNV_S_2_Def_bit_ub_703_CM 1 100. 0. 8. DISPLAY_IDENTIFIER B_AKH_SPLITH2 ECU_ADDRESS 0xd00068c1 BIT_MASK 0x8 /end MEASUREMENT
/begin MEASUREMENT St_katueb "Status Katüberwachung" UBYTE _CNV_R_R_Def_dez_sl_575_CM 1 100. 0. 255. DISPLAY_IDENTIFIER ST_KATUEB ECU_ADDRESS 0xd00068c2 FORMAT "%3.0" /end MEASUREMENT
/begin MEASUREMENT St_katueb.B_kathom "Homogen stöch wg. Kat-Regenerierungsbedarf angefordert" UBYTE _CNV_S_2_Def_bit_ub_705_CM 1 100. 0. 32. DISPLAY_IDENTIFIER B_KATHOM ECU_ADDRESS 0xd00068c2 BIT_MASK 0x20 /end MEASUREMENT
/begin MEASUREMENT St_katueb.B_nk_hom "Homogen stöch wg. Nox Kat-Regenerierungsbedarf angefordert" UBYTE _CNV_S_2_Def_bit_ub_704_CM 1 100. 0. 16. DISPLAY_IDENTIFIER B_NK_HOM ECU_ADDRESS 0xd00068c2 BIT_MASK 0x10 /end MEASUREMENT
/begin MEASUREMENT St_katueb.B_rgnkat "Regenerierung Kat angefordert" UBYTE _CNV_S_2_Def_bit_ub_700_CM 1 100. 0. 1. DISPLAY_IDENTIFIER B_RGNKAT ECU_ADDRESS 0xd00068c2 BIT_MASK 0x1 /end MEASUREMENT
/begin MEASUREMENT St_katueb.B_rgnkat_hla1 "Umschaltung über Homogen RGN, wegen Kat Regenerierungsbedarfs" UBYTE _CNV_S_2_Def_bit_ub_701_CM 1 100. 0. 2. DISPLAY_IDENTIFIER B_RGNKAT_HLA1 ECU_ADDRESS 0xd00068c2 BIT_MASK 0x2 /end MEASUREMENT
/begin MEASUREMENT St_kh_allg "Statuswort für Bitgrößen KHM" UBYTE _CNV_R_R_Def_dez_sl_575_CM 1 100. 0. 255. DISPLAY_IDENTIFIER ST_KH_ALLG ECU_ADDRESS 0xc0004c90 FORMAT "%3.0" /end MEASUREMENT
/begin MEASUREMENT St_kh_allg.B_ess_kh "Katheizen über Nacheinspritzung im Schichtbetrieb aktiv" UBYTE _CNV_S_2_Def_bit_ub_702_CM 1 100. 0. 4. DISPLAY_IDENTIFIER B_ESS_KH ECU_ADDRESS 0xc0004c90 BIT_MASK 0x4 /end MEASUREMENT
/begin MEASUREMENT St_kh_allg.B_la_kh "Katheizen über Lambda aktiv" UBYTE _CNV_S_2_Def_bit_ub_701_CM 1 100. 0. 2. DISPLAY_IDENTIFIER B_LA_KH ECU_ADDRESS 0xc0004c90 BIT_MASK 0x2 /end MEASUREMENT
/begin MEASUREMENT St_kh_allg.B_md_kh "Katheizen über Momentenreserve aktiv" UBYTE _CNV_S_2_Def_bit_ub_700_CM 1 100. 0. 1. DISPLAY_IDENTIFIER B_MD_KH ECU_ADDRESS 0xc0004c90 BIT_MASK 0x1 /end MEASUREMENT
/begin MEASUREMENT St_kh_vanons "Statuswort für KHM Bitgrößen" UBYTE _CNV_R_R_Def_dez_sl_575_CM 1 100. 0. 255. DISPLAY_IDENTIFIER ST_KH_VANONS ECU_ADDRESS 0xc0004c91 FORMAT "%3.0" /end MEASUREMENT
/begin MEASUREMENT St_kh_vanons.B_vanos_kh "Katheizen über Nockenwellensteuerung aktiv" UBYTE _CNV_S_2_Def_bit_ub_700_CM 1 100. 0. 1. DISPLAY_IDENTIFIER B_VANOS_KH ECU_ADDRESS 0xc0004c91 BIT_MASK 0x1 /end MEASUREMENT
/begin MEASUREMENT St_kl15 "Statusbyte Klemme 15" UBYTE _CNV_R_R_Def_dez_sl_575_CM 1 100. 0. 255. DISPLAY_IDENTIFIER ST_KL15 ECU_ADDRESS 0xc000265b FORMAT "%3.0" /end MEASUREMENT
/begin MEASUREMENT St_kl15.B_kl15_ep "Bitgröße, Bedingung KL15 gesetzt" UBYTE _CNV_S_2_Def_bit_ub_700_CM 1 100. 0. 1. DISPLAY_IDENTIFIER B_KL15_EP ECU_ADDRESS 0xc000265b BIT_MASK 0x1 /end MEASUREMENT
/begin MEASUREMENT St_kl15.B_kl15_vorab "Bedingung KL15 gedrückt" UBYTE _CNV_S_2_Def_bit_ub_707_CM 1 100. 0. 128. DISPLAY_IDENTIFIER B_KL15_VORAB ECU_ADDRESS 0xc000265b BIT_MASK 0x80 /end MEASUREMENT
/begin MEASUREMENT St_klopfen "Statuswort Klopfen" UBYTE _CNV_R_R_Def_dez_sl_575_CM 1 100. 0. 255. DISPLAY_IDENTIFIER ST_KLOPFEN ECU_ADDRESS 0xd00068c3 FORMAT "%3.0" /end MEASUREMENT
/begin MEASUREMENT St_klopfen.B_klopfen "Klopfen erkannt" UBYTE _CNV_S_2_Def_bit_ub_700_CM 1 100. 0. 1. DISPLAY_IDENTIFIER B_KLOPFEN ECU_ADDRESS 0xd00068c3 BIT_MASK 0x1 /end MEASUREMENT
/begin MEASUREMENT St_kr "Bedingung Klopfregelung" UBYTE _CNV_R_R_Def_dez_sl_575_CM 1 100. 0. 255. DISPLAY_IDENTIFIER ST_KR ECU_ADDRESS 0xd00068c4 FORMAT "%3.0" /end MEASUREMENT
/begin MEASUREMENT St_kr.B_clradkr "Bedingung Adaptionswerte Klopfregelung selektiv löschen (Testeranforderung)" UBYTE _CNV_S_2_Def_bit_ub_700_CM 1 100. 0. 1. DISPLAY_IDENTIFIER B_CLRADKR ECU_ADDRESS 0xd00068c4 BIT_MASK 0x1 /end MEASUREMENT
/begin MEASUREMENT St_kr.B_krdws "Bedingung Klopfregelung Sicherheitsspätverstellung" UBYTE _CNV_S_2_Def_bit_ub_702_CM 1 100. 0. 4. DISPLAY_IDENTIFIER B_KRDWS ECU_ADDRESS 0xd00068c4 BIT_MASK 0x4 /end MEASUREMENT
/begin MEASUREMENT St_kr.B_krndy "Bedingung Drehzahldynamik für Klopfregelung aktiv" UBYTE _CNV_S_2_Def_bit_ub_701_CM 1 100. 0. 2. DISPLAY_IDENTIFIER B_KRNDY ECU_ADDRESS 0xd00068c4 BIT_MASK 0x2 /end MEASUREMENT
/begin MEASUREMENT St_kr.B_zwkraa "Bedingung Zündwinkel der Klopfregelung wird ausgegeben" UBYTE _CNV_S_2_Def_bit_ub_704_CM 1 100. 0. 16. DISPLAY_IDENTIFIER B_ZWKRAA ECU_ADDRESS 0xd00068c4 BIT_MASK 0x10 /end MEASUREMENT
/begin MEASUREMENT St_kr1 "Statusbyte Klopfregelung" UBYTE _CNV_R_R_Def_dez_sl_575_CM 1 100. 0. 255. DISPLAY_IDENTIFIER ST_KR1 ECU_ADDRESS 0xd00068c5 FORMAT "%3.0" /end MEASUREMENT
/begin MEASUREMENT St_kr1.B_krakt "Bedingung Klopfregelung aktiv" UBYTE _CNV_S_2_Def_bit_ub_707_CM 1 100. 0. 128. DISPLAY_IDENTIFIER B_KRAKT ECU_ADDRESS 0xd00068c5 BIT_MASK 0x80 /end MEASUREMENT
/begin MEASUREMENT St_ksdiag "Status Kraftstoffsystem diagnose" UBYTE _CNV_R_R_Def_dez_sl_575_CM 1 100. 0. 255. DISPLAY_IDENTIFIER ST_KSDIAG ECU_ADDRESS 0xd00068c6 FORMAT "%3.0" /end MEASUREMENT
/begin MEASUREMENT St_ksdiag.B_tstkvs "Bedingung Funktionsanforderung Kraftstoffsystemdiagnose" UBYTE _CNV_S_2_Def_bit_ub_700_CM 1 100. 0. 1. DISPLAY_IDENTIFIER B_TSTKVS ECU_ADDRESS 0xd00068c6 BIT_MASK 0x1 /end MEASUREMENT
/begin MEASUREMENT St_kupp_smg "Status Kupplung SMG" UBYTE _CNV_R_R_Def_dez_sl_575_CM 1 100. 0. 255. DISPLAY_IDENTIFIER ST_KUPP_SMG ECU_ADDRESS 0xd00068c7 FORMAT "%3.0" /end MEASUREMENT
/begin MEASUREMENT St_la_rpu "Statuswort für Bits aus NOX RP System" UBYTE _CNV_R_R_Def_dez_sl_575_CM 1 100. 0. 255. DISPLAY_IDENTIFIER ST_LA_RPU ECU_ADDRESS 0xd00068c8 FORMAT "%3.0" /end MEASUREMENT
/begin MEASUREMENT St_la_rpu.B_largnrpu1 "Bedingung aus RP System zu Kat Regenerierung" UBYTE _CNV_S_2_Def_bit_ub_700_CM 1 100. 0. 1. DISPLAY_IDENTIFIER B_LARGNRPU1 ECU_ADDRESS 0xd00068c8 BIT_MASK 0x1 /end MEASUREMENT
/begin MEASUREMENT St_la_rpu.B_largnrpu2 "Bedingung aus RP System zu Kat Regenerierung" UBYTE _CNV_S_2_Def_bit_ub_701_CM 1 100. 0. 2. DISPLAY_IDENTIFIER B_LARGNRPU2 ECU_ADDRESS 0xd00068c8 BIT_MASK 0x2 /end MEASUREMENT
/begin MEASUREMENT St_la_rpu.B_noxrpu "Bedingung aus RP System zu Kat Regenerierung" UBYTE _CNV_S_2_Def_bit_ub_702_CM 1 100. 0. 4. DISPLAY_IDENTIFIER B_NOXRPU ECU_ADDRESS 0xd00068c8 BIT_MASK 0x4 /end MEASUREMENT
/begin MEASUREMENT St_lareg "Status Lambdaregelung" UBYTE _CNV_R_R_Def_dez_sl_575_CM 1 100. 0. 255. DISPLAY_IDENTIFIER ST_LAREG ECU_ADDRESS 0xd00068c9 FORMAT "%3.0" /end MEASUREMENT
/begin MEASUREMENT St_lareg.B_lrr "Bedingung Lambdaregelung regelt" UBYTE _CNV_S_2_Def_bit_ub_702_CM 1 100. 0. 4. DISPLAY_IDENTIFIER B_LRR ECU_ADDRESS 0xd00068c9 BIT_MASK 0x4 /end MEASUREMENT
/begin MEASUREMENT St_lareg.B_lrr2 "Bedingung Lambdaregelung regelt Bank2" UBYTE _CNV_S_2_Def_bit_ub_703_CM 1 100. 0. 8. DISPLAY_IDENTIFIER B_LRR2 ECU_ADDRESS 0xd00068c9 BIT_MASK 0x8 /end MEASUREMENT
/begin MEASUREMENT St_lbattcal0 "Statuswort" UBYTE _CNV_R_R_Def_dez_sl_575_CM 1 100. 0. 255. DISPLAY_IDENTIFIER ST_LBATTCAL0 ECU_ADDRESS 0xd000726c FORMAT "%3.0" /end MEASUREMENT
/begin MEASUREMENT St_lbattcal0.B_dly_tbi "Bedingung für Startwertberechnung" UBYTE _CNV_S_2_Def_bit_ub_705_CM 1 100. 0. 32. DISPLAY_IDENTIFIER B_DLY_TBI ECU_ADDRESS 0xd000726c BIT_MASK 0x20 /end MEASUREMENT
/begin MEASUREMENT St_lbattcal0.B_lbatteinih "Ende Initialisierungsphase Lbattcal Batterie hinten" UBYTE _CNV_S_2_Def_bit_ub_700_CM 1 100. 0. 1. DISPLAY_IDENTIFIER B_LBATTEINIH ECU_ADDRESS 0xd000726c BIT_MASK 0x1 /end MEASUREMENT
/begin MEASUREMENT St_lbattcal0.B_lbatteiniv "Ende Initialisierungsphase Lbattcal Batterie vorne" UBYTE _CNV_S_2_Def_bit_ub_701_CM 1 100. 0. 2. DISPLAY_IDENTIFIER B_LBATTEINIV ECU_ADDRESS 0xd000726c BIT_MASK 0x2 /end MEASUREMENT
/begin MEASUREMENT St_lbattcal0.B_lbattenh "Enable Batterie hinten" UBYTE _CNV_S_2_Def_bit_ub_702_CM 1 100. 0. 4. DISPLAY_IDENTIFIER B_LBATTENH ECU_ADDRESS 0xd000726c BIT_MASK 0x4 /end MEASUREMENT
/begin MEASUREMENT St_lbattcal0.B_lbattenv "Enable Batterie vorne" UBYTE _CNV_S_2_Def_bit_ub_703_CM 1 100. 0. 8. DISPLAY_IDENTIFIER B_LBATTENV ECU_ADDRESS 0xd000726c BIT_MASK 0x8 /end MEASUREMENT
/begin MEASUREMENT St_lbattcal0.B_lbattinit "Initialisierung LBATTCAL beendet" UBYTE _CNV_S_2_Def_bit_ub_704_CM 1 100. 0. 16. DISPLAY_IDENTIFIER B_LBATTINIT ECU_ADDRESS 0xd000726c BIT_MASK 0x10 /end MEASUREMENT
/begin MEASUREMENT St_ldm_kupp "Status Kraftschluss" UBYTE _CNV_R_R_Def_dez_sl_575_CM 1 100. 0. 255. DISPLAY_IDENTIFIER ST_LDM_KUPP ECU_ADDRESS 0xd00072e5 FORMAT "%3.0" /end MEASUREMENT
/begin MEASUREMENT St_ldstgen "Lastzustand Generator elektrisch/thermisch" UBYTE _CNV_R_R_Def_dez_sl_575_CM 1 100. 0. 255. DISPLAY_IDENTIFIER ST_LDSTGEN ECU_ADDRESS 0xd0007279 FORMAT "%3.0" /end MEASUREMENT
/begin MEASUREMENT St_lklps "Statusbyte Luftklappensteuerung" UBYTE _CNV_R_R_Def_dez_sl_575_CM 1 100. 0. 255. DISPLAY_IDENTIFIER ST_LKLPS ECU_ADDRESS 0xc0004c92 FORMAT "%3.0" /end MEASUREMENT
/begin MEASUREMENT St_ll "Status Leerlauf" UBYTE _CNV_R_R_Def_dez_sl_575_CM 1 100. 0. 255. DISPLAY_IDENTIFIER ST_LL ECU_ADDRESS 0xd00068ca FORMAT "%3.0" /end MEASUREMENT
/begin MEASUREMENT St_ll.B_llr_on "Llr darf aktiv werden" UBYTE _CNV_S_2_Def_bit_ub_700_CM 1 100. 0. 1. DISPLAY_IDENTIFIER B_LLR_ON ECU_ADDRESS 0xd00068ca BIT_MASK 0x1 /end MEASUREMENT
/begin MEASUREMENT St_llr "Statusword Leerlaufregler" UWORD _CNV_R_R_Def_dez_sl_575_CM 1 100. 0. 65535. DISPLAY_IDENTIFIER ST_LLR ECU_ADDRESS 0xc000265c FORMAT "%5.0" /end MEASUREMENT
/begin MEASUREMENT St_llr.B_llrein "wird beim ersten LL-Regler ein gesetzt und nicht mehr geändert" UWORD _CNV_S_2_Def_bit_ub_700_CM 1 100. 0. 1. DISPLAY_IDENTIFIER B_LLREIN ECU_ADDRESS 0xc000265c BIT_MASK 0x1 /end MEASUREMENT
/begin MEASUREMENT St_llranh0 "Statuswort" UBYTE _CNV_R_R_Def_dez_sl_575_CM 1 100. 0. 255. DISPLAY_IDENTIFIER ST_LLRANH0 ECU_ADDRESS 0xd000727c FORMAT "%3.0" /end MEASUREMENT
/begin MEASUREMENT St_llranh0.B_idl_tp "Temporäres Berechnungsbit" UBYTE _CNV_S_2_Def_bit_ub_702_CM 1 100. 0. 4. DISPLAY_IDENTIFIER B_IDL_TP ECU_ADDRESS 0xd000727c BIT_MASK 0x4 /end MEASUREMENT
/begin MEASUREMENT St_llranh0.B_idlgspec "Statuswort" UBYTE _CNV_S_2_Def_bit_ub_700_CM 1 100. 0. 1. DISPLAY_IDENTIFIER B_IDLGSPEC ECU_ADDRESS 0xd000727c BIT_MASK 0x1 /end MEASUREMENT
/begin MEASUREMENT St_llranh0.B_nsub "Bedingung für Solldrehzahlanhebung bei niedriger Batteriespannung" UBYTE _CNV_S_2_Def_bit_ub_701_CM 1 100. 0. 2. DISPLAY_IDENTIFIER B_NSUB ECU_ADDRESS 0xd000727c BIT_MASK 0x2 /end MEASUREMENT
/begin MEASUREMENT St_loadresp "Statuswort" UBYTE _CNV_R_R_Def_dez_sl_575_CM 1 100. 0. 255. DISPLAY_IDENTIFIER ST_LOADRESP ECU_ADDRESS 0xd0007281 FORMAT "%3.0" /end MEASUREMENT
/begin MEASUREMENT St_loadresp.B_lroff "Statuswort" UBYTE _CNV_S_2_Def_bit_ub_700_CM 1 100. 0. 1. DISPLAY_IDENTIFIER B_LROFF ECU_ADDRESS 0xd0007281 BIT_MASK 0x1 /end MEASUREMENT
/begin MEASUREMENT St_loadresp.B_lroff2 "Statuswort" UBYTE _CNV_S_2_Def_bit_ub_701_CM 1 100. 0. 2. DISPLAY_IDENTIFIER B_LROFF2 ECU_ADDRESS 0xd0007281 BIT_MASK 0x2 /end MEASUREMENT
/begin MEASUREMENT St_loadresp0 "Statuswort" UBYTE _CNV_R_R_Def_dez_sl_575_CM 1 100. 0. 255. DISPLAY_IDENTIFIER ST_LOADRESP0 ECU_ADDRESS 0xd0007282 FORMAT "%3.0" /end MEASUREMENT
/begin MEASUREMENT St_loadresp0.B_fub "Bedingung: Fehler Batteriespannungssensor" UBYTE _CNV_S_2_Def_bit_ub_702_CM 1 100. 0. 4. DISPLAY_IDENTIFIER B_FUB ECU_ADDRESS 0xd0007282 BIT_MASK 0x4 /end MEASUREMENT
/begin MEASUREMENT St_loadresp0.B_genoffmd "Abschaltung Generator angefordert" UBYTE _CNV_S_2_Def_bit_ub_701_CM 1 100. 0. 2. DISPLAY_IDENTIFIER B_GENOFFMD ECU_ADDRESS 0xd0007282 BIT_MASK 0x2 /end MEASUREMENT
/begin MEASUREMENT St_loadresp0.B_genoffst "Bedingung Generatorabschaltung im Start" UBYTE _CNV_S_2_Def_bit_ub_700_CM 1 100. 0. 1. DISPLAY_IDENTIFIER B_GENOFFST ECU_ADDRESS 0xd0007282 BIT_MASK 0x1 /end MEASUREMENT
/begin MEASUREMENT St_loadresp10ms "Statuswort" UBYTE _CNV_R_R_Def_dez_sl_575_CM 1 100. 0. 255. DISPLAY_IDENTIFIER ST_LOADRESP10MS ECU_ADDRESS 0xd0007283 FORMAT "%3.0" /end MEASUREMENT
/begin MEASUREMENT St_loadresp10ms.B_mdgrenz "Bedingung Generator im Modus Momentenbegrenzung" UBYTE _CNV_S_2_Def_bit_ub_700_CM 1 100. 0. 1. DISPLAY_IDENTIFIER B_MDGRENZ ECU_ADDRESS 0xd0007283 BIT_MASK 0x1 /end MEASUREMENT
/begin MEASUREMENT St_loadresp_nv0 "Statuswort" UBYTE _CNV_R_R_Def_dez_sl_575_CM 1 100. 0. 255. DISPLAY_IDENTIFIER ST_LOADRESP_NV0 ECU_ADDRESS 0xc0004648 FORMAT "%3.0" /end MEASUREMENT
/begin MEASUREMENT St_loadresp_nv0.B_genoffvl "Bedingung Generatorabschaltung bei Vollast" UBYTE _CNV_S_2_Def_bit_ub_700_CM 1 100. 0. 1. DISPLAY_IDENTIFIER B_GENOFFVL ECU_ADDRESS 0xc0004648 BIT_MASK 0x1 /end MEASUREMENT
/begin MEASUREMENT St_mdpruef "Status Momentenplausibilisierung" UBYTE _CNV_R_R_Def_dez_sl_575_CM 1 100. 0. 255. DISPLAY_IDENTIFIER ST_MDPRUEF ECU_ADDRESS 0xd00068cb FORMAT "%3.0" /end MEASUREMENT
/begin MEASUREMENT St_mdpruef.B_mdpruef "Momentenplausibilitätsprüfung forder hom" UBYTE _CNV_S_2_Def_bit_ub_700_CM 1 100. 0. 1. DISPLAY_IDENTIFIER B_MDPRUEF ECU_ADDRESS 0xd00068cb BIT_MASK 0x1 /end MEASUREMENT
/begin MEASUREMENT St_mdpruef.B_mdpruef_akt "Momentenplausibilitätsprüfung hom aktiv" UBYTE _CNV_S_2_Def_bit_ub_701_CM 1 100. 0. 2. DISPLAY_IDENTIFIER B_MDPRUEF_AKT ECU_ADDRESS 0xd00068cb BIT_MASK 0x2 /end MEASUREMENT
/begin MEASUREMENT St_mkwchn "Statuswort Masterkurbelwelle" UBYTE _CNV_R_R_Def_dez_sl_575_CM 1 100. 0. 255. DISPLAY_IDENTIFIER ST_MKWCHN ECU_ADDRESS 0xd00068cc FORMAT "%3.0" /end MEASUREMENT
/begin MEASUREMENT St_mkwchn.B_kwdreht "Bedingung drehende Kurbelwelle erkannt" UBYTE _CNV_S_2_Def_bit_ub_705_CM 1 100. 0. 32. DISPLAY_IDENTIFIER B_KWDREHT ECU_ADDRESS 0xd00068cc BIT_MASK 0x20 /end MEASUREMENT
/begin MEASUREMENT St_motzustd "Statusword fuer Motorzustand" UWORD _CNV_R_R_Def_dez_sl_575_CM 1 100. 0. 65535. DISPLAY_IDENTIFIER ST_MOTZUSTD ECU_ADDRESS 0xd00068ce FORMAT "%5.0" /end MEASUREMENT
/begin MEASUREMENT St_motzustd.B_ll_roh "Bedingung Leerlauf Rohwert" UWORD _CNV_S_2_Def_bit_uw_708_CM 1 100. 0. 256. DISPLAY_IDENTIFIER B_LL_ROH ECU_ADDRESS 0xd00068ce BIT_MASK 0x100 /end MEASUREMENT
/begin MEASUREMENT St_motzustd.B_vl "Bedingung Vollast" UWORD _CNV_S_2_Def_bit_ub_705_CM 1 100. 0. 32. DISPLAY_IDENTIFIER B_VL ECU_ADDRESS 0xd00068ce BIT_MASK 0x20 /end MEASUREMENT
/begin MEASUREMENT St_nachlauf "Statuswort Nachlauf" UBYTE _CNV_R_R_Def_dez_sl_575_CM 1 100. 0. 255. DISPLAY_IDENTIFIER ST_NACHLAUF ECU_ADDRESS 0xc0004c93 FORMAT "%3.0" /end MEASUREMENT
/begin MEASUREMENT St_nachlauf.B_nachlauf "Bedingung Nachlauf" UBYTE _CNV_S_2_Def_bit_ub_700_CM 1 100. 0. 1. DISPLAY_IDENTIFIER B_NACHLAUF ECU_ADDRESS 0xc0004c93 BIT_MASK 0x1 /end MEASUREMENT
/begin MEASUREMENT St_nst "Status Nachstart" UBYTE _CNV_R_R_Def_dez_sl_575_CM 1 100. 0. 255. DISPLAY_IDENTIFIER ST_NST ECU_ADDRESS 0xc0004c94 FORMAT "%3.0" /end MEASUREMENT
/begin MEASUREMENT St_nst.B_nst "Bedingung Nachstart" UBYTE _CNV_S_2_Def_bit_ub_700_CM 1 100. 0. 1. DISPLAY_IDENTIFIER B_NST ECU_ADDRESS 0xc0004c94 BIT_MASK 0x1 /end MEASUREMENT
/begin MEASUREMENT St_nwf "Neue Aus-/Einlassnockenwellenflanke" UBYTE _CNV_R_R_Def_dez_sl_575_CM 1 100. 0. 255. DISPLAY_IDENTIFIER ST_NWF ECU_ADDRESS 0xd00068d0 FORMAT "%3.0" /end MEASUREMENT
/begin MEASUREMENT St_nwf.B_nwa1flanke "Neue Auslassnockenwellenflanke" UBYTE _CNV_S_2_Def_bit_ub_700_CM 1 100. 0. 1. DISPLAY_IDENTIFIER B_NWA1FLANKE ECU_ADDRESS 0xd00068d0 BIT_MASK 0x1 /end MEASUREMENT
/begin MEASUREMENT St_nwf.B_nwe1flanke "Neue Einlassnockenwellenflanke" UBYTE _CNV_S_2_Def_bit_ub_701_CM 1 100. 0. 2. DISPLAY_IDENTIFIER B_NWE1FLANKE ECU_ADDRESS 0xd00068d0 BIT_MASK 0x2 /end MEASUREMENT
/begin MEASUREMENT St_oz "Statuswort Eingangsgrößen Ölzustandssensor" UBYTE _CNV_R_R_Def_dez_sl_575_CM 1 100. 0. 255. DISPLAY_IDENTIFIER ST_OZ ECU_ADDRESS 0xc000265e FORMAT "%3.0" /end MEASUREMENT
/begin MEASUREMENT St_oz.B_anhang "Bedingung Anhänger erkannt" UBYTE _CNV_S_2_Def_bit_ub_700_CM 1 100. 0. 1. DISPLAY_IDENTIFIER B_ANHANG ECU_ADDRESS 0xc000265e BIT_MASK 0x1 /end MEASUREMENT
/begin MEASUREMENT St_oz.B_ozfbsd "Bedingung Fehler BSD-Kommunikation" UBYTE _CNV_S_2_Def_bit_ub_701_CM 1 100. 0. 2. DISPLAY_IDENTIFIER B_OZFBSD ECU_ADDRESS 0xc000265e BIT_MASK 0x2 /end MEASUREMENT
/begin MEASUREMENT St_oz_i "Statusbyte für Eingang OZ" UBYTE _CNV_R_R_Def_dez_sl_575_CM 1 100. 0. 255. DISPLAY_IDENTIFIER ST_OZ_I ECU_ADDRESS 0xc000265f FORMAT "%3.0" /end MEASUREMENT
/begin MEASUREMENT St_oz_i.B_td_og "Bedingung Abkühlzeit gültig" UBYTE _CNV_S_2_Def_bit_ub_700_CM 1 100. 0. 1. DISPLAY_IDENTIFIER B_TD_OG ECU_ADDRESS 0xc000265f BIT_MASK 0x1 /end MEASUREMENT
/begin MEASUREMENT St_oz_i.B_td_ogok "Bedingung State-Machine 1x gültig gerechnet" UBYTE _CNV_S_2_Def_bit_ub_704_CM 1 100. 0. 16. DISPLAY_IDENTIFIER B_TD_OGOK ECU_ADDRESS 0xc000265f BIT_MASK 0x10 /end MEASUREMENT
/begin MEASUREMENT St_oz_i.B_toel "Bedingung tr und tv gültig" UBYTE _CNV_S_2_Def_bit_ub_701_CM 1 100. 0. 2. DISPLAY_IDENTIFIER B_TOEL ECU_ADDRESS 0xc000265f BIT_MASK 0x2 /end MEASUREMENT
/begin MEASUREMENT St_pmbnstab "Statusbyte Powermanagement Bordnetzstabilität" UBYTE _CNV_R_R_Def_dez_sl_575_CM 1 100. 0. 255. DISPLAY_IDENTIFIER ST_PMBNSTAB ECU_ADDRESS 0xc0004021 FORMAT "%3.0" /end MEASUREMENT
/begin MEASUREMENT St_pmbnstab.B_nachlend "Bedingung Nachlauf beendet" UBYTE _CNV_S_2_Def_bit_ub_700_CM 1 100. 0. 1. DISPLAY_IDENTIFIER B_NACHLEND ECU_ADDRESS 0xc0004021 BIT_MASK 0x1 /end MEASUREMENT
/begin MEASUREMENT St_pmi "Statuswort Eingänge LCP" UBYTE _CNV_R_R_Def_dez_sl_575_CM 1 100. 0. 255. DISPLAY_IDENTIFIER ST_PMI ECU_ADDRESS 0xc0004022 FORMAT "%3.0" /end MEASUREMENT
/begin MEASUREMENT St_pmi.B_fabttreg "Bedingung Batterietausch registrieren" UBYTE _CNV_S_2_Def_bit_ub_701_CM 1 100. 0. 2. DISPLAY_IDENTIFIER B_FABTTREG ECU_ADDRESS 0xc0004022 BIT_MASK 0x2 /end MEASUREMENT
/begin MEASUREMENT St_pmi.B_fahisrst "Bedingung Histogramm Reset" UBYTE _CNV_S_2_Def_bit_ub_702_CM 1 100. 0. 4. DISPLAY_IDENTIFIER B_FAHISRST ECU_ADDRESS 0xc0004022 BIT_MASK 0x4 /end MEASUREMENT
/begin MEASUREMENT St_pmi_nv "Statuswort Eingänge LCP non volatile" UBYTE _CNV_R_R_Def_dez_sl_575_CM 1 100. 0. 255. DISPLAY_IDENTIFIER ST_PMI_NV ECU_ADDRESS 0xc0004023 FORMAT "%3.0" /end MEASUREMENT
/begin MEASUREMENT St_pmi_nv.B_fapmmess "Bedingung Messmethode PM" UBYTE _CNV_S_2_Def_bit_ub_700_CM 1 100. 0. 1. DISPLAY_IDENTIFIER B_FAPMMESS ECU_ADDRESS 0xc0004023 BIT_MASK 0x1 /end MEASUREMENT
/begin MEASUREMENT St_pmi_nv.B_ulcp "ULCP Aktiv" UBYTE _CNV_S_2_Def_bit_ub_701_CM 1 100. 0. 2. DISPLAY_IDENTIFIER B_ULCP ECU_ADDRESS 0xc0004023 BIT_MASK 0x2 /end MEASUREMENT
/begin MEASUREMENT St_poelreg1 "Status Öldruckregelung 1" UBYTE _CNV_R_R_Def_dez_sl_575_CM 1 100. 0. 255. DISPLAY_IDENTIFIER ST_POELREG1 ECU_ADDRESS 0xd00068d1 FORMAT "%3.0" /end MEASUREMENT
/begin MEASUREMENT St_poelreg1.B_poelsoltst "Bedingung Sollwert Öldruck über Tester" UBYTE _CNV_S_2_Def_bit_ub_700_CM 1 100. 0. 1. DISPLAY_IDENTIFIER B_POELSOLTST ECU_ADDRESS 0xd00068d1 BIT_MASK 0x1 /end MEASUREMENT
/begin MEASUREMENT St_pruef "Status Plausibilitätsprüfung" UBYTE _CNV_R_R_Def_dez_sl_575_CM 1 100. 0. 255. DISPLAY_IDENTIFIER ST_PRUEF ECU_ADDRESS 0xd00068d2 FORMAT "%3.0" /end MEASUREMENT
/begin MEASUREMENT St_pruef.B_pruef1 "Lambdaanforderung for plausibility test bank1" UBYTE _CNV_S_2_Def_bit_ub_700_CM 1 100. 0. 1. DISPLAY_IDENTIFIER B_PRUEF1 ECU_ADDRESS 0xd00068d2 BIT_MASK 0x1 /end MEASUREMENT
/begin MEASUREMENT St_pruef.B_pruef2 "Lambdaanforderung for plausibility test bank2" UBYTE _CNV_S_2_Def_bit_ub_701_CM 1 100. 0. 2. DISPLAY_IDENTIFIER B_PRUEF2 ECU_ADDRESS 0xd00068d2 BIT_MASK 0x2 /end MEASUREMENT
/begin MEASUREMENT St_ptc_pwr "Status Rückmeldung für Individuelle Ansteuerung für einen Sonderverbraucher (PTC)." UBYTE _CNV_R_R_Def_f_ub_b_595_CM 1 100. 0. 127.5 DISPLAY_IDENTIFIER ST_PTC_PWR ECU_ADDRESS 0xc0004c95 FORMAT "%5.2" /end MEASUREMENT
/begin MEASUREMENT St_pwf "Statuswert fuer Power-fail" UBYTE _CNV_R_R_Def_dez_sl_575_CM 1 100. 0. 255. DISPLAY_IDENTIFIER ST_PWF ECU_ADDRESS 0xc0002660 FORMAT "%3.0" /end MEASUREMENT
/begin MEASUREMENT St_pwf.B_pwf "Bedingung Powerfail" UBYTE _CNV_S_2_Def_bit_ub_700_CM 1 100. 0. 1. DISPLAY_IDENTIFIER B_PWF ECU_ADDRESS 0xc0002660 BIT_MASK 0x1 /end MEASUREMENT
/begin MEASUREMENT St_sawe "Statusbyte Schubabschaltung/Wiedereinsetzen" UBYTE _CNV_R_R_Def_dez_sl_575_CM 1 100. 0. 255. DISPLAY_IDENTIFIER ST_SAWE ECU_ADDRESS 0xc0002661 FORMAT "%3.0" /end MEASUREMENT
/begin MEASUREMENT St_sawe.B_sa "Bedingung Schubabschaltung" UBYTE _CNV_S_2_Def_bit_ub_703_CM 1 100. 0. 8. DISPLAY_IDENTIFIER B_SA ECU_ADDRESS 0xc0002661 BIT_MASK 0x8 /end MEASUREMENT
/begin MEASUREMENT St_sawe.B_sae "Schubabschalten Bereitschaft" UBYTE _CNV_S_2_Def_bit_ub_700_CM 1 100. 0. 1. DISPLAY_IDENTIFIER B_SAE ECU_ADDRESS 0xc0002661 BIT_MASK 0x1 /end MEASUREMENT
/begin MEASUREMENT St_sk "Statuswort" UBYTE _CNV_R_R_Def_dez_sl_575_CM 1 100. 0. 255. DISPLAY_IDENTIFIER ST_SK ECU_ADDRESS 0xd00068d3 FORMAT "%3.0" /end MEASUREMENT
/begin MEASUREMENT St_sk.B_sk_homla1 "Anforderung nach Homogen Lambda 1 aus Sicherheitskonzept" UBYTE _CNV_S_2_Def_bit_ub_700_CM 1 100. 0. 1. DISPLAY_IDENTIFIER B_SK_HOMLA1 ECU_ADDRESS 0xd00068d3 BIT_MASK 0x1 /end MEASUREMENT
/begin MEASUREMENT St_slp "Statusbyte Sekundärluftpumpe" UBYTE _CNV_R_R_Def_dez_sl_575_CM 1 100. 0. 255. DISPLAY_IDENTIFIER ST_SLP ECU_ADDRESS 0xd00068d4 FORMAT "%3.0" /end MEASUREMENT
/begin MEASUREMENT St_slp.B_fasls "Bed. Funktionsanf Sekundärluftsystem" UBYTE _CNV_S_2_Def_bit_ub_700_CM 1 100. 0. 1. DISPLAY_IDENTIFIER B_FASLS ECU_ADDRESS 0xd00068d4 BIT_MASK 0x1 /end MEASUREMENT
/begin MEASUREMENT St_slp.B_genslp "Bedingung Spannungsanforderung Sekundärluftpumpe" UBYTE _CNV_S_2_Def_bit_ub_702_CM 1 100. 0. 4. DISPLAY_IDENTIFIER B_GENSLP ECU_ADDRESS 0xd00068d4 BIT_MASK 0x4 /end MEASUREMENT
/begin MEASUREMENT St_sls "Statuswort Sekundärluftsystem" UBYTE _CNV_R_R_Def_dez_sl_575_CM 1 100. 0. 255. DISPLAY_IDENTIFIER ST_SLS ECU_ADDRESS 0xc0002662 FORMAT "%3.0" /end MEASUREMENT
/begin MEASUREMENT St_sls.B_sls "Bedingung Sekundärluftsystem aktiv" UBYTE _CNV_S_2_Def_bit_ub_700_CM 1 100. 0. 1. DISPLAY_IDENTIFIER B_SLS ECU_ADDRESS 0xc0002662 BIT_MASK 0x1 /end MEASUREMENT
/begin MEASUREMENT St_start "Status Start" UBYTE _CNV_R_R_Def_dez_sl_575_CM 1 100. 0. 255. DISPLAY_IDENTIFIER ST_START ECU_ADDRESS 0xc0004024 FORMAT "%3.0" /end MEASUREMENT
/begin MEASUREMENT St_start.B_sta "Bedingung Automatikstart" UBYTE _CNV_S_2_Def_bit_ub_707_CM 1 100. 0. 128. DISPLAY_IDENTIFIER B_STA ECU_ADDRESS 0xc0004024 BIT_MASK 0x80 /end MEASUREMENT
/begin MEASUREMENT St_start.B_start "Bedingung Start" UBYTE _CNV_S_2_Def_bit_ub_700_CM 1 100. 0. 1. DISPLAY_IDENTIFIER B_START ECU_ADDRESS 0xc0004024 BIT_MASK 0x1 /end MEASUREMENT
/begin MEASUREMENT St_start.B_startende "Bedingung Startende" UBYTE _CNV_S_2_Def_bit_ub_703_CM 1 100. 0. 8. DISPLAY_IDENTIFIER B_STARTENDE ECU_ADDRESS 0xc0004024 BIT_MASK 0x8 /end MEASUREMENT
/begin MEASUREMENT St_start.B_wst "Bedingung Wiederholstart" UBYTE _CNV_S_2_Def_bit_ub_701_CM 1 100. 0. 2. DISPLAY_IDENTIFIER B_WST ECU_ADDRESS 0xc0004024 BIT_MASK 0x2 /end MEASUREMENT
/begin MEASUREMENT St_szboost "Eingang" UBYTE _CNV_R_R_Def_dez_sl_575_CM 1 100. 0. 255. DISPLAY_IDENTIFIER ST_SZBOOST ECU_ADDRESS 0xd00068d5 FORMAT "%3.0" /end MEASUREMENT
/begin MEASUREMENT St_szboost.B_fofu "Bedingung Folgefunken aktiv" UBYTE _CNV_S_2_Def_bit_ub_703_CM 1 100. 0. 8. DISPLAY_IDENTIFIER B_FOFU ECU_ADDRESS 0xd00068d5 BIT_MASK 0x8 /end MEASUREMENT
/begin MEASUREMENT St_szboost.B_kath "Bedingung Katheizen aktiv" UBYTE _CNV_S_2_Def_bit_ub_701_CM 1 100. 0. 2. DISPLAY_IDENTIFIER B_KATH ECU_ADDRESS 0xd00068d5 BIT_MASK 0x2 /end MEASUREMENT
/begin MEASUREMENT St_szboost.B_kath_sch "Katheizen im Schichtbetrieb erforderlich" UBYTE _CNV_S_2_Def_bit_ub_700_CM 1 100. 0. 1. DISPLAY_IDENTIFIER B_KATH_SCH ECU_ADDRESS 0xd00068d5 BIT_MASK 0x1 /end MEASUREMENT
/begin MEASUREMENT St_szboost.B_warml "Bedingung Warmlauf aktiv" UBYTE _CNV_S_2_Def_bit_ub_702_CM 1 100. 0. 4. DISPLAY_IDENTIFIER B_WARML ECU_ADDRESS 0xd00068d5 BIT_MASK 0x4 /end MEASUREMENT
/begin MEASUREMENT St_tank "Tank-Status" UBYTE _CNV_R_R_Def_dez_sl_575_CM 1 100. 0. 255. DISPLAY_IDENTIFIER ST_TANK ECU_ADDRESS 0xd00068d6 FORMAT "%3.0" /end MEASUREMENT
/begin MEASUREMENT St_tank.B_betankt "Betankung erfolgt" UBYTE _CNV_S_2_Def_bit_ub_700_CM 1 100. 0. 1. DISPLAY_IDENTIFIER B_BETANKT ECU_ADDRESS 0xd00068d6 BIT_MASK 0x1 /end MEASUREMENT
/begin MEASUREMENT St_tank.B_taleer "Bedingung Tank leer" UBYTE _CNV_S_2_Def_bit_ub_700_CM 1 100. 0. 1. DISPLAY_IDENTIFIER B_TALEER ECU_ADDRESS 0xd00068d6 BIT_MASK 0x1 /end MEASUREMENT
/begin MEASUREMENT St_tevanst "Status Tev" UBYTE _CNV_R_R_Def_dez_sl_575_CM 1 100. 0. 255. DISPLAY_IDENTIFIER ST_TEVANST ECU_ADDRESS 0xc0002663 FORMAT "%3.0" /end MEASUREMENT
/begin MEASUREMENT St_tevanst.B_tev_zu "Bedingung Tankentlüftungsventil geschlossen" UBYTE _CNV_S_2_Def_bit_ub_701_CM 1 100. 0. 2. DISPLAY_IDENTIFIER B_TEV_ZU ECU_ADDRESS 0xc0002663 BIT_MASK 0x2 /end MEASUREMENT
/begin MEASUREMENT St_tevein "Status Tev" UBYTE _CNV_R_R_Def_dez_sl_575_CM 1 100. 0. 255. DISPLAY_IDENTIFIER ST_TEVEIN ECU_ADDRESS 0xc0002664 FORMAT "%3.0" /end MEASUREMENT
/begin MEASUREMENT St_tevein.B_te "Bedingung Tankentlüftung freigegeben" UBYTE _CNV_S_2_Def_bit_ub_701_CM 1 100. 0. 2. DISPLAY_IDENTIFIER B_TE ECU_ADDRESS 0xc0002664 BIT_MASK 0x2 /end MEASUREMENT
/begin MEASUREMENT St_tevein.B_te_la1 "TEV fordert Lambda 1 an" UBYTE _CNV_S_2_Def_bit_ub_700_CM 1 100. 0. 1. DISPLAY_IDENTIFIER B_TE_LA1 ECU_ADDRESS 0xc0002664 BIT_MASK 0x1 /end MEASUREMENT
/begin MEASUREMENT St_tevein.B_teblg "Bedingung Beladungsgrad wird gelernt" UBYTE _CNV_S_2_Def_bit_ub_707_CM 1 100. 0. 128. DISPLAY_IDENTIFIER B_TEBLG ECU_ADDRESS 0xc0002664 BIT_MASK 0x80 /end MEASUREMENT
/begin MEASUREMENT St_tevein.B_tev_erf "Tankentlüftung angefordert" UBYTE _CNV_S_2_Def_bit_ub_706_CM 1 100. 0. 64. DISPLAY_IDENTIFIER B_TEV_ERF ECU_ADDRESS 0xc0002664 BIT_MASK 0x40 /end MEASUREMENT
/begin MEASUREMENT St_ti "Status Einspritzung" UBYTE _CNV_R_R_Def_dez_sl_575_CM 1 100. 0. 255. DISPLAY_IDENTIFIER ST_TI ECU_ADDRESS 0xd00068d7 FORMAT "%3.0" /end MEASUREMENT
/begin MEASUREMENT St_ti.B_dosp_akt "Bedingung Doppeleinspritzung aktiv" UBYTE _CNV_S_2_Def_bit_ub_700_CM 1 100. 0. 1. DISPLAY_IDENTIFIER B_DOSP_AKT ECU_ADDRESS 0xd00068d7 BIT_MASK 0x1 /end MEASUREMENT
/begin MEASUREMENT St_tp "Bedingung Taupunktende erreicht Lambdasonde vor Kat" UBYTE _CNV_R_R_Def_dez_sl_575_CM 1 100. 0. 255. DISPLAY_IDENTIFIER ST_TP ECU_ADDRESS 0xc0002665 FORMAT "%3.0" /end MEASUREMENT
/begin MEASUREMENT St_tp.B_atm_tpvk "Bedingung Taupunktende erreicht Lambdasonde vor Kat" UBYTE _CNV_S_2_Def_bit_ub_700_CM 1 100. 0. 1. DISPLAY_IDENTIFIER B_ATM_TPVK ECU_ADDRESS 0xc0002665 BIT_MASK 0x1 /end MEASUREMENT
/begin MEASUREMENT St_tp.B_atm_tpvk1 "Bedingung Taupunktende erreicht Lambdasonde vor Kat1" UBYTE _CNV_S_2_Def_bit_ub_701_CM 1 100. 0. 2. DISPLAY_IDENTIFIER B_ATM_TPVK1 ECU_ADDRESS 0xc0002665 BIT_MASK 0x2 /end MEASUREMENT
/begin MEASUREMENT St_tp.B_atm_tpvk2 "Bedingung Taupunktende erreicht Lambdasonde vor Kat2" UBYTE _CNV_S_2_Def_bit_ub_702_CM 1 100. 0. 4. DISPLAY_IDENTIFIER B_ATM_TPVK2 ECU_ADDRESS 0xc0002665 BIT_MASK 0x4 /end MEASUREMENT
/begin MEASUREMENT St_tum "Statusbyte tum" UBYTE _CNV_R_R_Def_dez_sl_575_CM 1 100. 0. 255. DISPLAY_IDENTIFIER ST_TUM ECU_ADDRESS 0xc0002666 FORMAT "%3.0" /end MEASUREMENT
/begin MEASUREMENT St_tum.B_tumers "Bedingung Umgebungstemperaturersatzwert" UBYTE _CNV_S_2_Def_bit_ub_700_CM 1 100. 0. 1. DISPLAY_IDENTIFIER B_TUMERS ECU_ADDRESS 0xc0002666 BIT_MASK 0x1 /end MEASUREMENT
/begin MEASUREMENT St_vsa3 "Status Anschlagadaption Auslass" UBYTE _CNV_R_R_Def_dez_sl_575_CM 1 100. 0. 255. DISPLAY_IDENTIFIER ST_VSA3 ECU_ADDRESS 0xc0004c96 FORMAT "%3.0" /end MEASUREMENT
/begin MEASUREMENT St_vsa3.B_vsaadpokext "Anschlagadaption Auslassspreizung variable NWS von extern ausgeführt" UBYTE _CNV_S_2_Def_bit_ub_700_CM 1 100. 0. 1. DISPLAY_IDENTIFIER B_VSAADPOKEXT ECU_ADDRESS 0xc0004c96 BIT_MASK 0x1 /end MEASUREMENT
/begin MEASUREMENT St_vse3 "Status Anschlagadaption Einlass" UBYTE _CNV_R_R_Def_dez_sl_575_CM 1 100. 0. 255. DISPLAY_IDENTIFIER ST_VSE3 ECU_ADDRESS 0xc0004c97 FORMAT "%3.0" /end MEASUREMENT
/begin MEASUREMENT St_vse3.B_vseadpokext "Anschlagadaption Einlassspreizung variable NWS von extern ausgeführt" UBYTE _CNV_S_2_Def_bit_ub_700_CM 1 100. 0. 1. DISPLAY_IDENTIFIER B_VSEADPOKEXT ECU_ADDRESS 0xc0004c97 BIT_MASK 0x1 /end MEASUREMENT
/begin MEASUREMENT St_wk "Status WK" UBYTE _CNV_R_R_Def_dez_sl_575_CM 1 100. 0. 255. DISPLAY_IDENTIFIER ST_WK ECU_ADDRESS 0xd00068d8 FORMAT "%3.0" /end MEASUREMENT
/begin MEASUREMENT St_wm "Statusbyte fuer Eingang WM-Koordinator" UBYTE _CNV_R_R_Def_dez_sl_575_CM 1 100. 0. 255. DISPLAY_IDENTIFIER ST_WM ECU_ADDRESS 0xc0002667 FORMAT "%3.0" /end MEASUREMENT
/begin MEASUREMENT St_wm.B_hz "Heizungsanforderung" UBYTE _CNV_S_2_Def_bit_ub_706_CM 1 100. 0. 64. DISPLAY_IDENTIFIER B_HZ ECU_ADDRESS 0xc0002667 BIT_MASK 0x40 /end MEASUREMENT
/begin MEASUREMENT St_wm.B_korel "Bedingung Klimakompressor" UBYTE _CNV_S_2_Def_bit_ub_703_CM 1 100. 0. 8. DISPLAY_IDENTIFIER B_KOREL ECU_ADDRESS 0xc0002667 BIT_MASK 0x8 /end MEASUREMENT
/begin MEASUREMENT St_wm.B_lklps_kl1 "Anforderung LKLPS auf von IHKA" UBYTE _CNV_S_2_Def_bit_ub_702_CM 1 100. 0. 4. DISPLAY_IDENTIFIER B_LKLPS_KL1 ECU_ADDRESS 0xc0002667 BIT_MASK 0x4 /end MEASUREMENT
/begin MEASUREMENT St_wm.B_lklps_kl2 "Anforderung LKLPS ganz auf von IHKA" UBYTE _CNV_S_2_Def_bit_ub_701_CM 1 100. 0. 2. DISPLAY_IDENTIFIER B_LKLPS_KL2 ECU_ADDRESS 0xc0002667 BIT_MASK 0x2 /end MEASUREMENT
/begin MEASUREMENT St_wm.B_nkmtemp "Bedingung niedrige Kühlmitteltemperatur (von IHKA)" UBYTE _CNV_S_2_Def_bit_ub_705_CM 1 100. 0. 32. DISPLAY_IDENTIFIER B_NKMTEMP ECU_ADDRESS 0xc0002667 BIT_MASK 0x20 /end MEASUREMENT
/begin MEASUREMENT St_zwbts "Statuswort" UBYTE _CNV_R_R_Def_dez_sl_575_CM 1 100. 0. 255. DISPLAY_IDENTIFIER ST_ZWBTS ECU_ADDRESS 0xc0002668 FORMAT "%3.0" /end MEASUREMENT
/begin MEASUREMENT St_zwbts.B_atm_tpnk1 "Bedingung Taupunktende erreicht Lambdasonde nach Kat1" UBYTE _CNV_S_2_Def_bit_ub_703_CM 1 100. 0. 8. DISPLAY_IDENTIFIER B_ATM_TPNK1 ECU_ADDRESS 0xc0002668 BIT_MASK 0x8 /end MEASUREMENT
/begin MEASUREMENT St_zwbts.B_atm_tpnk2 "Bedingung Taupunktende erreicht Lambdasonde nach Kat2" UBYTE _CNV_S_2_Def_bit_ub_705_CM 1 100. 0. 32. DISPLAY_IDENTIFIER B_ATM_TPNK2 ECU_ADDRESS 0xc0002668 BIT_MASK 0x20 /end MEASUREMENT
/begin MEASUREMENT St_zwbts.B_bsakt_zuli1 "Bedingung Bauteilschutz aktiv Zulieferer Bank 1" UBYTE _CNV_S_2_Def_bit_ub_700_CM 1 100. 0. 1. DISPLAY_IDENTIFIER B_BSAKT_ZULI1 ECU_ADDRESS 0xc0002668 BIT_MASK 0x1 /end MEASUREMENT
/begin MEASUREMENT St_zwbts.B_bsakt_zuli2 "Bedingung Bauteilschutz aktiv Zulieferer Bank 2" UBYTE _CNV_S_2_Def_bit_ub_701_CM 1 100. 0. 2. DISPLAY_IDENTIFIER B_BSAKT_ZULI2 ECU_ADDRESS 0xc0002668 BIT_MASK 0x2 /end MEASUREMENT
/begin MEASUREMENT St_zwktibs "Statusbyte zwktibs" UBYTE _CNV_R_R_Def_dez_sl_575_CM 1 100. 0. 255. DISPLAY_IDENTIFIER ST_ZWKTIBS ECU_ADDRESS 0xc0004c98 FORMAT "%3.0" /end MEASUREMENT
/begin MEASUREMENT St_zwktibs.B_ibsactiv "Bedingung Kommunikation IBS vorhanden" UBYTE _CNV_S_2_Def_bit_ub_700_CM 1 100. 0. 1. DISPLAY_IDENTIFIER B_IBSACTIV ECU_ADDRESS 0xc0004c98 BIT_MASK 0x1 /end MEASUREMENT
/begin MEASUREMENT St_zylab "Bedingung Einzelzylinderabschaltung Bank i" UBYTE _CNV_R_R_Def_dez_sl_575_CM 1 100. 0. 255. DISPLAY_IDENTIFIER ST_ZYLAB ECU_ADDRESS 0xd00068d9 FORMAT "%3.0" /end MEASUREMENT
/begin MEASUREMENT St_zylab.B_zylab1 "Bedingung Einzelzylinderabschaltung Bank 1" UBYTE _CNV_S_2_Def_bit_ub_700_CM 1 100. 0. 1. DISPLAY_IDENTIFIER B_ZYLAB1 ECU_ADDRESS 0xd00068d9 BIT_MASK 0x1 /end MEASUREMENT
/begin MEASUREMENT St_zylab.B_zylab2 "Bedingung Einzelzylinderabschaltung Bank 2" UBYTE _CNV_S_2_Def_bit_ub_701_CM 1 100. 0. 2. DISPLAY_IDENTIFIER B_ZYLAB2 ECU_ADDRESS 0xd00068d9 BIT_MASK 0x2 /end MEASUREMENT
/begin MEASUREMENT Status_kwnot "Status KW Notlauf" UBYTE _CNV_R_R_Def_dez_sl_575_CM 1 100. 0. 255. DISPLAY_IDENTIFIER STATUS_KWNOT ECU_ADDRESS 0xd00068da FORMAT "%3.0" /end MEASUREMENT
/begin MEASUREMENT Status_kwnot.B_kwnotl "Bedingung Drehzahlgebernotlauf" UBYTE _CNV_S_2_Def_bit_ub_707_CM 1 100. 0. 128. DISPLAY_IDENTIFIER B_KWNOTL ECU_ADDRESS 0xd00068da BIT_MASK 0x80 /end MEASUREMENT
/begin MEASUREMENT T_batstiniv "Starttemperatur Batterie vorne" SWORD _CNV_R_R_Def_t_sw_q_618_CM 1 100. -3276.8 3276.7 DISPLAY_IDENTIFIER T_BATSTINIV ECU_ADDRESS 0xc00026a6 FORMAT "%6.1" /end MEASUREMENT
/begin MEASUREMENT T_batt_ini "Startwert Batterietemperatur" SWORD _CNV_R_R_Def_t_sw_q_618_CM 1 100. -3276.8 3276.7 DISPLAY_IDENTIFIER T_BATT_INI ECU_ADDRESS 0xc00026a8 FORMAT "%6.1" /end MEASUREMENT
/begin MEASUREMENT T_batt_lb "Batterietemperatur" SWORD _CNV_R_R_Def_t_sw_q_618_CM 1 100. -3276.8 3276.7 DISPLAY_IDENTIFIER T_BATT_LB ECU_ADDRESS 0xc00026a0 FORMAT "%6.1" /end MEASUREMENT
/begin MEASUREMENT T_batt_zw "Temporäre Batterietemperatur" SWORD _CNV_R_R_Def_t_sw_q_618_CM 1 100. -3276.8 3276.7 DISPLAY_IDENTIFIER T_BATT_ZW ECU_ADDRESS 0xc00026aa FORMAT "%6.1" /end MEASUREMENT
/begin MEASUREMENT T_batt_zw2 "Temporäre Zwischengroesse" SWORD _CNV_R_R_Def_t_sw_q_618_CM 1 100. -3276.8 3276.7 DISPLAY_IDENTIFIER T_BATT_ZW2 ECU_ADDRESS 0xc00026ac FORMAT "%6.1" /end MEASUREMENT
/begin MEASUREMENT T_batt_zw3 "" SWORD _CNV_R_R_Def_t_sw_q_618_CM 1 100. -3276.8 3276.7 DISPLAY_IDENTIFIER T_BATT_ZW3 ECU_ADDRESS 0xc00026ae FORMAT "%6.1" /end MEASUREMENT
/begin MEASUREMENT T_battabst "Batterieabstelltemperatur" SWORD _CNV_R_R_Def_t_sw_q_618_CM 1 100. -3276.8 3276.7 DISPLAY_IDENTIFIER T_BATTABST ECU_ADDRESS 0xc0004634 FORMAT "%6.1" /end MEASUREMENT
/begin MEASUREMENT T_entpr_gang "Entprellzeit Gangi" UWORD _CNV_R_R_Def_td_uw__679_CM 1 100. 0. 655.35 DISPLAY_IDENTIFIER T_ENTPR_GANG ECU_ADDRESS 0xd0007310 FORMAT "%7.2" /end MEASUREMENT
/begin MEASUREMENT T_jahr "Borddatum" UWORD _CNV_R_R_Def_dez_sl_575_CM 1 100. 0. 65535. DISPLAY_IDENTIFIER T_JAHR ECU_ADDRESS 0xc000266a FORMAT "%5.0" /end MEASUREMENT
/begin MEASUREMENT T_mdpruef "Zeit für Momentenplausibilitätsprüfung mit Verbot Schichtbetrieb" UBYTE _CNV_R_R_Def_td_uw__679_CM 1 100. 0. 2.55 DISPLAY_IDENTIFIER T_MDPRUEF ECU_ADDRESS 0xc0004c99 FORMAT "%5.2" /end MEASUREMENT
/begin MEASUREMENT T_monate "Borddatum" UBYTE _CNV_R_R_Def_dez_sl_575_CM 1 100. 0. 255. DISPLAY_IDENTIFIER T_MONATE ECU_ADDRESS 0xc000266c FORMAT "%3.0" /end MEASUREMENT
/begin MEASUREMENT T_tag "Borddatum" UBYTE _CNV_R_R_Def_dez_sl_575_CM 1 100. 0. 255. DISPLAY_IDENTIFIER T_TAG ECU_ADDRESS 0xc0004c9a FORMAT "%3.0" /end MEASUREMENT
/begin MEASUREMENT Tabg_sens1 "Signal Temperatursensor" SWORD _CNV_R_R_Def_t_sw_q_618_CM 1 100. -3276.8 3276.7 DISPLAY_IDENTIFIER TABG_SENS1 ECU_ADDRESS 0xc000266e FORMAT "%6.1" /end MEASUREMENT
/begin MEASUREMENT Tabg_sens2 "Signal Temperatursensor" SWORD _CNV_R_R_Def_t_sw_q_618_CM 1 100. -3276.8 3276.7 DISPLAY_IDENTIFIER TABG_SENS2 ECU_ADDRESS 0xc0002670 FORMAT "%6.1" /end MEASUREMENT
/begin MEASUREMENT Tans "Ansauglufttemperatur" SWORD _CNV_R_R_Def_t_sw_q_618_CM 1 100. -3276.8 3276.7 DISPLAY_IDENTIFIER TANS ECU_ADDRESS 0xd00068dc FORMAT "%6.1" /end MEASUREMENT
/begin MEASUREMENT Tchip "Chiptemperatur Generator1" SWORD _CNV_R_R_Def_t_sw_q_618_CM 1 100. -3276.8 3276.7 DISPLAY_IDENTIFIER TCHIP ECU_ADDRESS 0xc0002672 FORMAT "%6.1" /end MEASUREMENT
/begin MEASUREMENT Td_f_ierr "Filterzeit Erregerstrom aus BSD-Timingkoordinator" UBYTE _CNV_R_R_Def_td_uw__679_CM 1 100. 0. 2.55 DISPLAY_IDENTIFIER TD_F_IERR ECU_ADDRESS 0xc0004c9b FORMAT "%5.2" /end MEASUREMENT
/begin MEASUREMENT Td_kein_gang "Verzögerungszeit" UBYTE _CNV_R_R_Def_td_uw__679_CM 1 100. 0. 2.55 DISPLAY_IDENTIFIER TD_KEIN_GANG ECU_ADDRESS 0xd000730a FORMAT "%5.2" /end MEASUREMENT
/begin MEASUREMENT Td_kupp_ext "Verzögerungszeit" UBYTE _CNV_R_R_Def_td_uw__679_CM 1 100. 0. 2.55 DISPLAY_IDENTIFIER TD_KUPP_EXT ECU_ADDRESS 0xd0007309 FORMAT "%5.2" /end MEASUREMENT
/begin MEASUREMENT Td_ldm_aus "Verzögerungszeit LDM aus" UWORD _CNV_R_R_Def_td_uw__679_CM 1 100. 0. 655.35 DISPLAY_IDENTIFIER TD_LDM_AUS ECU_ADDRESS 0xd000731a FORMAT "%7.2" /end MEASUREMENT
/begin MEASUREMENT Td_ldm_aus1 "Verzögerungszeit LDM aus" UWORD _CNV_R_R_Def_td_uw__679_CM 1 100. 0. 655.35 DISPLAY_IDENTIFIER TD_LDM_AUS1 ECU_ADDRESS 0xd000731c FORMAT "%7.2" /end MEASUREMENT
/begin MEASUREMENT Td_og_cnt "Zähler für fallende Flanken im Töns Signal" UBYTE _CNV_R_R_Def_dez_sl_575_CM 1 100. 0. 255. DISPLAY_IDENTIFIER TD_OG_CNT ECU_ADDRESS 0xc0002674 FORMAT "%3.0" /end MEASUREMENT
/begin MEASUREMENT Td_og_icnt "Zeit zwischen 2 fallenden Flanken" UWORD _CNV_R_R_Def_td_uw__679_CM 1 100. 0. 655.35 DISPLAY_IDENTIFIER TD_OG_ICNT ECU_ADDRESS 0xc0002676 FORMAT "%7.2" /end MEASUREMENT
/begin MEASUREMENT Td_og_tk "Abkühlzeit vom TÖNS" UWORD _CNV_R_R_Def_td_ub__593_CM 1 100. 0. 6553.5 DISPLAY_IDENTIFIER TD_OG_TK ECU_ADDRESS 0xc0002678 FORMAT "%6.1" /end MEASUREMENT
/begin MEASUREMENT Td_og_tr "Referntzeit" UWORD _CNV_R_R_Def_td_ub__593_CM 1 100. 0. 6553.5 DISPLAY_IDENTIFIER TD_OG_TR ECU_ADDRESS 0xc000267a FORMAT "%6.1" /end MEASUREMENT
/begin MEASUREMENT Td_og_tv "Abkühlzeit Vom TÖNS" UWORD _CNV_R_R_Def_td_ub__593_CM 1 100. 0. 6553.5 DISPLAY_IDENTIFIER TD_OG_TV ECU_ADDRESS 0xc000267c FORMAT "%6.1" /end MEASUREMENT
/begin MEASUREMENT Td_og_uplcnt "Zähler für unplausible Signale" UBYTE _CNV_R_R_Def_dez_sl_575_CM 1 100. 0. 255. DISPLAY_IDENTIFIER TD_OG_UPLCNT ECU_ADDRESS 0xc000267e FORMAT "%3.0" /end MEASUREMENT
/begin MEASUREMENT Td_rdgenreg2 "Auslesezeit für DF-Signal und Diagnose" UBYTE _CNV_R_R_Def_td_ub__593_CM 1 100. 0. 25.5 DISPLAY_IDENTIFIER TD_RDGENREG2 ECU_ADDRESS 0xc0004c9c FORMAT "%4.1" /end MEASUREMENT
/begin MEASUREMENT Tdhschalt "Verzögerungszeit" UWORD _CNV_R_R_Def_td_uw__679_CM 1 100. 0. 655.35 DISPLAY_IDENTIFIER TDHSCHALT ECU_ADDRESS 0xd000731e FORMAT "%7.2" /end MEASUREMENT
/begin MEASUREMENT Tdrschalt "Verzögerungszeit" UWORD _CNV_R_R_Def_td_uw__679_CM 1 100. 0. 655.35 DISPLAY_IDENTIFIER TDRSCHALT ECU_ADDRESS 0xd0007320 FORMAT "%7.2" /end MEASUREMENT
/begin MEASUREMENT Tewp_el "Elektroniktemperatur EWAPU" SWORD _CNV_R_R_Def_t_sw_q_620_CM 1 100. -327.68 327.67 DISPLAY_IDENTIFIER TEWP_EL ECU_ADDRESS 0xc0004c9e FORMAT "%7.2" /end MEASUREMENT
/begin MEASUREMENT Tget "Getriebetemperatur" SWORD _CNV_R_R_Def_t_sw_q_620_CM 1 100. -327.68 327.67 DISPLAY_IDENTIFIER TGET ECU_ADDRESS 0xc0002680 FORMAT "%7.2" /end MEASUREMENT
/begin MEASUREMENT Ti_1_homext "effektive Einspritzzeit Bank 1" UWORD _CNV_R_R_Def_ti_uw__721_CM 1 100. 0. 838.848 DISPLAY_IDENTIFIER TI_1_HOMEXT ECU_ADDRESS 0xd00068de FORMAT "%8.3" /end MEASUREMENT
/begin MEASUREMENT Ti_2_homext "effektive Einspritzzeit Bank 2" UWORD _CNV_R_R_Def_ti_uw__721_CM 1 100. 0. 838.848 DISPLAY_IDENTIFIER TI_2_HOMEXT ECU_ADDRESS 0xd00068e0 FORMAT "%8.3" /end MEASUREMENT
/begin MEASUREMENT Tka "Temperatur Kühlwasser Kühleraustritt" SWORD _CNV_R_R_Def_t_sw_q_620_CM 1 100. -327.68 327.67 DISPLAY_IDENTIFIER TKA ECU_ADDRESS 0xc0002682 FORMAT "%7.2" /end MEASUREMENT
/begin MEASUREMENT Tkat_mod "Modellierte Katalysatortemperatur" SWORD _CNV_R_R_Def_t_sw_q_618_CM 1 100. -3276.8 3276.7 DISPLAY_IDENTIFIER TKAT_MOD ECU_ADDRESS 0xc0002684 FORMAT "%6.1" /end MEASUREMENT
/begin MEASUREMENT Tlrfgen "Kopier Generator1 LR Vorgabe auf Bus gelegt" UBYTE _CNV_R_R_Def_td_ub__593_CM 1 100. 0. 25.5 DISPLAY_IDENTIFIER TLRFGEN ECU_ADDRESS 0xc0002686 FORMAT "%4.1" /end MEASUREMENT
/begin MEASUREMENT Tlrgen "Sollwert Load- Response- Zeit Generator" UBYTE _CNV_R_R_Def_td_ub__593_CM 1 100. 0. 25.5 DISPLAY_IDENTIFIER TLRGEN ECU_ADDRESS 0xc00026b8 FORMAT "%4.1" /end MEASUREMENT
/begin MEASUREMENT Tlrgen2 "Sollwert Load- Response- Zeit Generator2" UBYTE _CNV_R_R_Def_td_ub__593_CM 1 100. 0. 25.5 DISPLAY_IDENTIFIER TLRGEN2 ECU_ADDRESS 0xc00026b9 FORMAT "%4.1" /end MEASUREMENT
/begin MEASUREMENT Tlrgen_ext "Loadresponse vom Tester" UBYTE _CNV_R_R_Def_td_ub__593_CM 1 100. 0. 25.5 DISPLAY_IDENTIFIER TLRGEN_EXT ECU_ADDRESS 0xc0002687 FORMAT "%4.1" /end MEASUREMENT
/begin MEASUREMENT Tmot "Kühlwassertemperatur" SWORD _CNV_R_R_Def_t_sw_q_620_CM 1 100. -327.68 327.67 DISPLAY_IDENTIFIER TMOT ECU_ADDRESS 0xd00068e2 FORMAT "%7.2" /end MEASUREMENT
/begin MEASUREMENT Tmot_abstell "Motorabstelltemperatur" SWORD _CNV_R_R_Def_t_sw_q_620_CM 1 100. -327.68 327.67 DISPLAY_IDENTIFIER TMOT_ABSTELL ECU_ADDRESS 0xc0004026 FORMAT "%7.2" /end MEASUREMENT
/begin MEASUREMENT Tmot_start "Motorstarttemperatur" SWORD _CNV_R_R_Def_t_sw_q_620_CM 1 100. -327.68 327.67 DISPLAY_IDENTIFIER TMOT_START ECU_ADDRESS 0xd00068e4 FORMAT "%7.2" /end MEASUREMENT
/begin MEASUREMENT Tn_abstell "Abstellzeit" UWORD _CNV_R_R_Def_dez_sl_575_CM 1 100. 0. 65535. DISPLAY_IDENTIFIER TN_ABSTELL ECU_ADDRESS 0xd00068e6 FORMAT "%5.0" /end MEASUREMENT
/begin MEASUREMENT Tn_abstellm "Abstellzeit in Minuten" UWORD _CNV_R_R_Def_tn_uw__671_CM 1 100. 0. 65535. DISPLAY_IDENTIFIER TN_ABSTELLM ECU_ADDRESS 0xc0004028 FORMAT "%7.2" /end MEASUREMENT
/begin MEASUREMENT Tn_start_10 "Zeit nach Startende in 10ms aufgelöst" UWORD _CNV_R_R_Def_td_uw__679_CM 1 100. 0. 655.35 DISPLAY_IDENTIFIER TN_START_10 ECU_ADDRESS 0xd00068e8 FORMAT "%7.2" /end MEASUREMENT
/begin MEASUREMENT Toel_getr "Getriebeöltemperatur" SWORD _CNV_R_R_Def_t_sw_q_620_CM 1 100. -327.68 327.67 DISPLAY_IDENTIFIER TOEL_GETR ECU_ADDRESS 0xc0004ca0 FORMAT "%7.2" /end MEASUREMENT
/begin MEASUREMENT Toel_mdl "Modelltemperatur Motoröl" SWORD _CNV_R_R_Def_t_sw_q_618_CM 1 100. -3276.8 3276.7 DISPLAY_IDENTIFIER TOEL_MDL ECU_ADDRESS 0xc0002688 FORMAT "%6.1" /end MEASUREMENT
/begin MEASUREMENT Tsg "Temperatur Steuergerät" SWORD _CNV_R_R_Def_t_sw_q_620_CM 1 100. -327.68 327.67 DISPLAY_IDENTIFIER TSG ECU_ADDRESS 0xc0004ca2 FORMAT "%7.2" /end MEASUREMENT
/begin MEASUREMENT Tumg "Umgebungstemperatur" SWORD _CNV_R_R_Def_t_sw_q_618_CM 1 100. -3276.8 3276.7 DISPLAY_IDENTIFIER TUMG ECU_ADDRESS 0xc000268a FORMAT "%6.1" /end MEASUREMENT
/begin MEASUREMENT Tumg_abst "Abstell-Aussentemperatur" SWORD _CNV_R_R_Def_t_sw_q_618_CM 1 100. -3276.8 3276.7 DISPLAY_IDENTIFIER TUMG_ABST ECU_ADDRESS 0xc0004636 FORMAT "%6.1" /end MEASUREMENT
/begin MEASUREMENT Tumg_battab "Abstell-Umgebungstemperatur Batterie" SWORD _CNV_R_R_Def_t_sw_q_618_CM 1 100. -3276.8 3276.7 DISPLAY_IDENTIFIER TUMG_BATTAB ECU_ADDRESS 0xc0004638 FORMAT "%6.1" /end MEASUREMENT
/begin MEASUREMENT Tumg_can "Umgebungstemperatur" SWORD _CNV_R_R_Def_t_sw_q_618_CM 1 100. -3276.8 3276.7 DISPLAY_IDENTIFIER TUMG_CAN ECU_ADDRESS 0xc000268c FORMAT "%6.1" /end MEASUREMENT
/begin MEASUREMENT Tumg_dt "Temporäre zwischengroesse" SWORD _CNV_R_R_Def_t_sw_q_618_CM 1 100. -3276.8 3276.7 DISPLAY_IDENTIFIER TUMG_DT ECU_ADDRESS 0xc00026b0 FORMAT "%6.1" /end MEASUREMENT
/begin MEASUREMENT Tumg_ers "Aussentemperatur oder Ersatzwert" SWORD _CNV_R_R_Def_t_sw_q_618_CM 1 100. -3276.8 3276.7 DISPLAY_IDENTIFIER TUMG_ERS ECU_ADDRESS 0xc00026a2 FORMAT "%6.1" /end MEASUREMENT
/begin MEASUREMENT Tumg_tp "" SWORD _CNV_R_R_Def_t_sw_q_618_CM 1 100. -3276.8 3276.7 DISPLAY_IDENTIFIER TUMG_TP ECU_ADDRESS 0xc00026b2 FORMAT "%6.1" /end MEASUREMENT
/begin MEASUREMENT Tv_av_heizkrist "Istwert Absperrventil" UBYTE _CNV_R_R_Def_f_ub_b_602_CM 1 100. 0. 99.60930000000001 DISPLAY_IDENTIFIER TV_AV_HEIZKRIST ECU_ADDRESS 0xc0004ca4 FORMAT "%5.2" /end MEASUREMENT
/begin MEASUREMENT Tv_av_status "Status Absperrventil Heizkreislauf" UBYTE _CNV_R_R_Def_dez_sl_575_CM 1 100. 0. 255. DISPLAY_IDENTIFIER TV_AV_STATUS ECU_ADDRESS 0xc0004ca5 FORMAT "%3.0" /end MEASUREMENT
/begin MEASUREMENT Tv_kft_ext "Istwert Kennfeldthermostat von Extern" UWORD _CNV_R_R_Def_f_uw_b_576_CM 1 100. 0. 99.9984 DISPLAY_IDENTIFIER TV_KFT_EXT ECU_ADDRESS 0xc000268e FORMAT "%8.3" /end MEASUREMENT
/begin MEASUREMENT Tvld "Temperatur vom Diagnose HFM" SWORD _CNV_R_R_Def_t_sw_q_618_CM 1 100. -3276.8 3276.7 DISPLAY_IDENTIFIER TVLD ECU_ADDRESS 0xd00068ea FORMAT "%6.1" /end MEASUREMENT
/begin MEASUREMENT U_fgen "Kopierter Wert von zum Generator gesendete Sollspannung Generator 1" UWORD _CNV_R_R_Def_u_uw_q_731_CM 1 100. 0. 6553.5 DISPLAY_IDENTIFIER U_FGEN ECU_ADDRESS 0xc0002690 FORMAT "%8.3" /end MEASUREMENT
/begin MEASUREMENT U_gen_ext "Physikalischer Wert Generatorsollspannung für Generator vom Tester" UWORD _CNV_R_R_Def_u_uw_q_731_CM 1 100. 0. 6553.5 DISPLAY_IDENTIFIER U_GEN_EXT ECU_ADDRESS 0xc0002692 FORMAT "%8.3" /end MEASUREMENT
/begin MEASUREMENT U_gen_slp "Spannungsanforderung Sekundärluftpumpe" UWORD _CNV_R_R_Def_u_uw_q_731_CM 1 100. 0. 6553.5 DISPLAY_IDENTIFIER U_GEN_SLP ECU_ADDRESS 0xc0002694 FORMAT "%8.3" /end MEASUREMENT
/begin MEASUREMENT U_gensollm "Generatorsollspannung" SWORD _CNV_R_R_Def_u_sw_b_732_CM 1 100. -128. 127.996 DISPLAY_IDENTIFIER U_GENSOLLM ECU_ADDRESS 0xc00026a4 FORMAT "%8.3" /end MEASUREMENT
/begin MEASUREMENT U_gensollpm "Sollwert Spannung vom Powermodul" SWORD _CNV_R_R_Def_u_sw_b_732_CM 1 100. -128. 127.996 DISPLAY_IDENTIFIER U_GENSOLLPM ECU_ADDRESS 0xc0002696 FORMAT "%8.3" /end MEASUREMENT
/begin MEASUREMENT U_kompk "Zwischengröße" SWORD _CNV_R_R_Def_u_sw_b_732_CM 1 100. 0. 127.996 DISPLAY_IDENTIFIER U_KOMPK ECU_ADDRESS 0xc00051d8 FORMAT "%8.3" /end MEASUREMENT
/begin MEASUREMENT U_kompm "Zwischengröße" SWORD _CNV_R_R_Def_u_sw_b_732_CM 1 100. 0. 127.996 DISPLAY_IDENTIFIER U_KOMPM ECU_ADDRESS 0xc00051da FORMAT "%8.3" /end MEASUREMENT
/begin MEASUREMENT U_lade "Zwischengröße" SWORD _CNV_R_R_Def_u_sw_b_732_CM 1 100. 0. 127.996 DISPLAY_IDENTIFIER U_LADE ECU_ADDRESS 0xc00051dc FORMAT "%8.3" /end MEASUREMENT
/begin MEASUREMENT Ub "Bordnetzspannung" UWORD _CNV_R_R_Def_u_sb_q_598_CM 1 100. 0. 6173.397 DISPLAY_IDENTIFIER UB ECU_ADDRESS 0xd00068ec FORMAT "%6.1" /end MEASUREMENT
/begin MEASUREMENT Ub_old_st "letzter Wert Batteriespannung für Starterkennung" UWORD _CNV_R_R_Def_u_sb_q_598_CM 1 100. 0. 6173.397 DISPLAY_IDENTIFIER UB_OLD_ST ECU_ADDRESS 0xd0007276 FORMAT "%6.1" /end MEASUREMENT
/begin MEASUREMENT Ulams_1 "Lambda-Spannungsistwert mit Offsetkorrektur (kontinuierlich)" UWORD _CNV_R_R_Def_u_uw_q_734_CM 1 100. 0. 4.9951 DISPLAY_IDENTIFIER ULAMS_1 ECU_ADDRESS 0xd00068ee FORMAT "%8.3" /end MEASUREMENT
/begin MEASUREMENT Ulams_2 "Lambda-Spannungsistwert mit Offsetkorrektur (kontinuierlich)" UWORD _CNV_R_R_Def_u_uw_q_734_CM 1 100. 0. 4.9951 DISPLAY_IDENTIFIER ULAMS_2 ECU_ADDRESS 0xd00068f0 FORMAT "%8.3" /end MEASUREMENT
/begin MEASUREMENT Uregnom "Nominalspannung Regler Generator 1" UWORD _CNV_R_R_Def_u_uw_q_731_CM 1 100. 0. 6553.5 DISPLAY_IDENTIFIER UREGNOM ECU_ADDRESS 0xc0004ca6 FORMAT "%8.3" /end MEASUREMENT
/begin MEASUREMENT V "Fahrzeuggeschwindigkeit" UWORD _CNV_R_R_Def_v_uw_q_737_CM 1 100. 0. 360. ECU_ADDRESS 0xd00068f2 FORMAT "%5.0" /end MEASUREMENT
/begin MEASUREMENT V_can "Fahrzeuggeschwindigkeit vom DSC" UWORD _CNV_R_R_Def_v_uw_q_738_CM 1 100. 0. 6553.5 DISPLAY_IDENTIFIER V_CAN ECU_ADDRESS 0xd00068f4 FORMAT "%7.2" /end MEASUREMENT
/begin MEASUREMENT Var_hs "Variante Handschalter erkannt" UBYTE _CNV_R_R_Def_dez_sl_575_CM 1 100. 0. 255. DISPLAY_IDENTIFIER VAR_HS ECU_ADDRESS 0xd00072e7 FORMAT "%3.0" /end MEASUREMENT
/begin MEASUREMENT Var_ldm "Variante LDM erkannt" UBYTE _CNV_R_R_Def_dez_sl_575_CM 1 100. 0. 255. DISPLAY_IDENTIFIER VAR_LDM ECU_ADDRESS 0xd00072e6 FORMAT "%3.0" /end MEASUREMENT
/begin MEASUREMENT Var_smg "Variante SMG erkannt" UBYTE _CNV_R_R_Def_dez_sl_575_CM 1 100. 0. 255. DISPLAY_IDENTIFIER VAR_SMG ECU_ADDRESS 0xd00072e8 FORMAT "%3.0" /end MEASUREMENT
/begin MEASUREMENT Vsa_adp_ext "Adaptionswert Anschlag Auslassspreizung variable NWS von extern" UWORD _CNV_R_R_Def_spr_sw_583_CM 1 100. 0. 6553.5 DISPLAY_IDENTIFIER VSA_ADP_EXT ECU_ADDRESS 0xd00068f6 FORMAT "%7.2" /end MEASUREMENT
/begin MEASUREMENT Vsa_btsoll "Spreizungsvorgabe Tester für AVANOS" UWORD _CNV_R_R_Def_kw_uw__741_CM 1 100. -128. 52300. DISPLAY_IDENTIFIER VSA_BTSOLL ECU_ADDRESS 0xd00068f8 FORMAT "%5.0" /end MEASUREMENT
/begin MEASUREMENT Vsa_sprs_kh "Exhaust camshaft setpoint (outlet)" UWORD _CNV_R_R_Def_spr_sw_583_CM 1 100. 0. 6553.5 DISPLAY_IDENTIFIER VSA_SPRS_KH ECU_ADDRESS 0xd00068fa FORMAT "%7.2" /end MEASUREMENT
/begin MEASUREMENT Vse_adp_ext "Adaptionswert Anschlag Einlassspreizung variable NWS von extern" UWORD _CNV_R_R_Def_spr_sw_583_CM 1 100. 0. 6553.5 DISPLAY_IDENTIFIER VSE_ADP_EXT ECU_ADDRESS 0xd00068fc FORMAT "%7.2" /end MEASUREMENT
/begin MEASUREMENT Vse_btsoll "Spreizungsvorgabe Tester für EVANOS" UWORD _CNV_R_R_Def_kw_uw__741_CM 1 100. -128. 52300. DISPLAY_IDENTIFIER VSE_BTSOLL ECU_ADDRESS 0xd00068fe FORMAT "%5.0" /end MEASUREMENT
/begin MEASUREMENT Vse_sprs_kh "Intake camshaft setpoint (inlet)" UWORD _CNV_R_R_Def_spr_sw_583_CM 1 100. 0. 6553.5 DISPLAY_IDENTIFIER VSE_SPRS_KH ECU_ADDRESS 0xd0006900 FORMAT "%7.2" /end MEASUREMENT
/begin MEASUREMENT W_ub "Ungefilterte Bordnetzspannung [0 .. 24,021 V]" UBYTE _CNV_R_R_Def_u_sb_q_598_CM 1 100. 0. 24.021 DISPLAY_IDENTIFIER W_UB ECU_ADDRESS 0xc0002698 FORMAT "%7.4" /end MEASUREMENT
/begin MEASUREMENT Wdk_ist "Aktueller Drosselklappenwinkel" SWORD _CNV_R_R_Def_wdk_sw_691_CM 1 100. -800. 799.9755 DISPLAY_IDENTIFIER WDK_IST ECU_ADDRESS 0xd0006902 FORMAT "%7.2" /end MEASUREMENT
/begin MEASUREMENT Wesb1kh_h "start of injection of the first injection for homogeneous combustion mode relatet to EOI_LIM" SWORD _CNV_R_R_Def_kw_sw__622_CM 1 100. -768. 767.9765 DISPLAY_IDENTIFIER WESB1KH_H ECU_ADDRESS 0xd0006904 FORMAT "%8.3" ARRAY_SIZE 6 MATRIX_DIM 6 1 1 /end MEASUREMENT
/begin MEASUREMENT Wese "Winkel Einspritzende bezogen auf Einlaßventil schließt" UWORD _CNV_R_R_Def_kw_sw__622_CM 1 100. 0. 1535.9765 DISPLAY_IDENTIFIER WESE ECU_ADDRESS 0xd0006910 FORMAT "%8.3" /end MEASUREMENT
/begin MEASUREMENT Z_dmdblock "" UBYTE _CNV_R_R_Def_dez_sl_575_CM 1 100. 0. 255. DISPLAY_IDENTIFIER Z_DMDBLOCK ECU_ADDRESS 0xc0004649 FORMAT "%3.0" /end MEASUREMENT
/begin MEASUREMENT Zr_seg_nstart "Segmentzähler: Wird nach Startende neu gestartet" UWORD _CNV_R_R_Def_dez_sl_575_CM 1 100. 0. 65535. DISPLAY_IDENTIFIER ZR_SEG_NSTART ECU_ADDRESS 0xd0006912 FORMAT "%5.0" /end MEASUREMENT
/begin MEASUREMENT Zrbosr "Servicezähler vom Kombi" UBYTE _CNV_R_R_Def_dez_sl_575_CM 1 100. 0. 255. DISPLAY_IDENTIFIER ZRBOSR ECU_ADDRESS 0xc0002699 FORMAT "%3.0" /end MEASUREMENT
/begin MEASUREMENT Zrbosrt "Servicezählerstand vom Tester" UBYTE _CNV_R_R_Def_dez_sl_575_CM 1 100. 0. 255. DISPLAY_IDENTIFIER ZRBOSRT ECU_ADDRESS 0xc000269a FORMAT "%3.0" /end MEASUREMENT
/begin MEASUREMENT Ztageabs "Tagezähler vom Kombi" UWORD _CNV_R_R_Def_dez_sl_575_CM 1 100. 0. 65535. DISPLAY_IDENTIFIER ZTAGEABS ECU_ADDRESS 0xc000269c FORMAT "%5.0" /end MEASUREMENT
/begin MEASUREMENT Zw_kr_bas "Zündwinkelspätziehung aus Klopf Regelung" SWORD _CNV_R_R_Def_zw_sw__599_CM 1 100. -50. 60. DISPLAY_IDENTIFIER ZW_KR_BAS ECU_ADDRESS 0xc0004ca8 FORMAT "%6.1" ARRAY_SIZE 6 MATRIX_DIM 6 1 1 /end MEASUREMENT
/begin MEASUREMENT Zw_md "Zündwinkel nach Momenteneingriff" SWORD _CNV_R_R_Def_zw_sw__599_CM 1 100. -50. 60. DISPLAY_IDENTIFIER ZW_MD ECU_ADDRESS 0xd0006914 FORMAT "%6.1" ARRAY_SIZE 6 MATRIX_DIM 6 1 1 /end MEASUREMENT
/begin MEASUREMENT Zw_min "Minimaler Zündwinkel" SWORD _CNV_R_R_Def_zw_sw__599_CM 1 100. -50. 60. DISPLAY_IDENTIFIER ZW_MIN ECU_ADDRESS 0xd0006920 FORMAT "%6.1" /end MEASUREMENT
/begin MEASUREMENT Zw_out "Ausgegebener Zündwinkel" SWORD _CNV_R_R_Def_zw_sw__599_CM 1 100. -50. 60. DISPLAY_IDENTIFIER ZW_OUT ECU_ADDRESS 0xd0006924 FORMAT "%6.1" ARRAY_SIZE 6 MATRIX_DIM 6 1 1 /end MEASUREMENT
/begin MEASUREMENT Zw_out_mw "Ausgegebener Zündwinkel gemittelt" SWORD _CNV_R_R_Def_zw_sw__599_CM 1 100. -50. 60. DISPLAY_IDENTIFIER ZW_OUT_MW ECU_ADDRESS 0xd0006930 FORMAT "%6.1" /end MEASUREMENT
/begin MEASUREMENT Zw_ve "Zündwinkel vor Momenteneingriff" SWORD _CNV_R_R_Def_zw_sw__599_CM 1 100. -50. 60. DISPLAY_IDENTIFIER ZW_VE ECU_ADDRESS 0xd0006934 FORMAT "%6.1" ARRAY_SIZE 6 MATRIX_DIM 6 1 1 /end MEASUREMENT
/begin MEASUREMENT Zyl_akt "Aktueller Zylinder" UBYTE _CNV_R_R_Def_dez_sl_575_CM 1 100. 0. 255. DISPLAY_IDENTIFIER ZYL_AKT ECU_ADDRESS 0xc0004cb4 FORMAT "%3.0" /end MEASUREMENT
/begin CHARACTERISTIC CW_BATTCOD "Enable Handcodierung" VALUE 0xa10172dc _REC_VAL_20_u1 2. _CNV_R_R_Def_dez_sl_575_CM 0. 2. FORMAT "%3.0" /end CHARACTERISTIC
/begin CHARACTERISTIC CW_BNS_LR "Codewort zur Einrechnung Bordnetzstabilität in Loadresponse" VALUE 0xa1017414 _REC_VAL_20_u1 1. _CNV_R_R_Def_dez_sl_575_CM 0. 1. FORMAT "%3.0" /end CHARACTERISTIC
/begin CHARACTERISTIC KF_LORESP "Kennfeld Loadresponse ueber Motordrehzahl und rel. Luftmasse" MAP 0xa10174dc _REC_MAP_52_u1_s2_s2 25.5 _CNV_R_R_Def_td_ub__593_CM 0. 25.5 FORMAT "%4.1"
 /begin AXIS_DESCR STD_AXIS Nkw _CNV_R_R_Def_n_sw_q_612_CM 6 -32768. 32767. FORMAT "%5.0" /end AXIS_DESCR
 /begin AXIS_DESCR STD_AXIS Rf _CNV_R_R_Def_rf_sw__616_CM 6 -327.68 327.67 FORMAT "%7.4" /end AXIS_DESCR
/end CHARACTERISTIC
/begin CHARACTERISTIC KF_LRMAXG "Loadresponse bei begrenztem Generatormoment" MAP 0xa101745c _REC_MAP_52_u1_u1_s2 25.5 _CNV_R_R_Def_td_ub__593_CM 0. 25.5 FORMAT "%4.1"
 /begin AXIS_DESCR STD_AXIS Na_bnanteil _CNV_R_R_Def_f_ub_b_625_CM 8 0. 1.9921 /end AXIS_DESCR
 /begin AXIS_DESCR STD_AXIS Rf _CNV_R_R_Def_rf_sw__616_CM 8 -327.68 327.67 FORMAT "%7.4" /end AXIS_DESCR
/end CHARACTERISTIC
/begin CHARACTERISTIC KF_MDR_ABV "rel gewünschtes Moment am Hinterrad" MAP 0xa1017d70 _REC_MAP_52_UBYTE_s2_u2_s2 100. _CNV_R_R_Def_md_rel_660_CM 0. 100. FORMAT "%7.4"
 /begin AXIS_DESCR STD_AXIS V _CNV_R_R_Def_v_uw_q_737_CM 8 0. 360. FORMAT "%5.0" /end AXIS_DESCR
 /begin AXIS_DESCR STD_AXIS Pwg_ist _CNV_R_R_Def_wdk_sw_691_CM 8 -800. 799.9755 FORMAT "%5.2" /end AXIS_DESCR
/end CHARACTERISTIC
/begin CHARACTERISTIC KF_ZLRESOF "Kennfeld Generatorausschaltzeit bei Stillstand" MAP 0xa10174b8 _REC_MAP_52_u1_s2_u2 99.45 _CNV_R_R_Def_td_uw__682_CM 0. 255. FORMAT "%5.2"
 /begin AXIS_DESCR STD_AXIS Tmot_start _CNV_R_R_Def_t_sw_q_620_CM 4 -327.68 327.67 FORMAT "%5.2" /end AXIS_DESCR
 /begin AXIS_DESCR STD_AXIS Km_st _CNV_R_R_Def_km_sw__64_CM 4 0. 655350. FORMAT "%5.0" /end AXIS_DESCR
/end CHARACTERISTIC
/begin CHARACTERISTIC KF_ZLRRESOFV "Kennfeld Generatorausschaltzeit bei Fahrt" MAP 0xa1017438 _REC_MAP_52_u1_s2_u2 99.45 _CNV_R_R_Def_td_uw__682_CM 0. 255. FORMAT "%5.2"
 /begin AXIS_DESCR STD_AXIS Tmot_start _CNV_R_R_Def_t_sw_q_620_CM 4 -327.68 327.67 FORMAT "%5.2" /end AXIS_DESCR
 /begin AXIS_DESCR STD_AXIS Km_st _CNV_R_R_Def_km_sw__64_CM 4 0. 655350. FORMAT "%5.0" /end AXIS_DESCR
/end CHARACTERISTIC
/begin CHARACTERISTIC KL_BATTLSTR "Geschwindigkeitsfaktor Batterieumgebungstemperatur" CURVE 0xa1017330 _REC_CUR_TKL_UW_VV__u2_u2 99.83844000000001 _CNV_R_R_Def_f_uw_b_632_CM 0. 255.996
 /begin AXIS_DESCR STD_AXIS NO_INPUT_QUANTITY _CNV_R_R_Def_v_uw_q_737_CM 6 0. 360. FORMAT "%5.0" /end AXIS_DESCR
/end CHARACTERISTIC
/begin CHARACTERISTIC KL_EXPALH "Funktion EXP(-ALPHA*tabst_w) hinten" CURVE 0xa101737c _REC_CUR_TKL_UW_VV__u2_u2 0.9999847412109381 _CNV_R_R_Def_f_uw_b_591_CM 0. 0.9999847412109381 FORMAT "%14.5"
 /begin AXIS_DESCR STD_AXIS NO_INPUT_QUANTITY _CNV_R_R_Def_dez_sl_575_CM 11 0. 65535. FORMAT "%5.0" /end AXIS_DESCR
/end CHARACTERISTIC
/begin CHARACTERISTIC KL_EXPALV "Funktion EXP(-ALPHA*tabst_w) hinten" CURVE 0xa101734c _REC_CUR_TKL_UW_VV__u2_u2 0.9999847412109381 _CNV_R_R_Def_f_uw_b_591_CM 0. 0.9999847412109381 FORMAT "%14.5"
 /begin AXIS_DESCR STD_AXIS Tn_abstell _CNV_R_R_Def_dez_sl_575_CM 11 0. 65535. FORMAT "%5.0" /end AXIS_DESCR
/end CHARACTERISTIC
/begin CHARACTERISTIC KL_EXPBETAV "Funktion EXP (-BETA*tabst_w)" CURVE 0xa1017300 _REC_CUR_TKL_UW_VV__u2_u2 0.9999847412109381 _CNV_R_R_Def_f_uw_b_591_CM 0. 0.9999847412109381 FORMAT "%14.5"
 /begin AXIS_DESCR STD_AXIS NO_INPUT_QUANTITY _CNV_R_R_Def_dez_sl_575_CM 11 0. 65535. FORMAT "%5.0" /end AXIS_DESCR
/end CHARACTERISTIC
/begin CHARACTERISTIC KL_E_FUNKTION "Approximation der E-Funktion" CURVE 0xa100acd0 _REC_CUR_TKL_UW_VV__S4_S4 0. _CNV_R_R_Def_dez_sl_575_CM -1000000000000. 10000000000000. FORMAT "%14.7"
 /begin AXIS_DESCR STD_AXIS NO_INPUT_QUANTITY _CNV_R_R_Def_dez_sl_575_CM 13 -1000000000000. 10000000000000. FORMAT "%14.7" /end AXIS_DESCR
/end CHARACTERISTIC
/begin CHARACTERISTIC KL_GENLDST "Auslastungsgrad Generator" CURVE 0xa10173c8 _REC_CUR_TKL_UW_VV__u1_s2 99.60930000000001 _CNV_R_R_Def_f_ub_b_602_CM 0. 99.60930000000001 FORMAT "%5.2"
 /begin AXIS_DESCR STD_AXIS Tgen _CNV_R_R_Def_t_sw_q_618_CM 6 -3276.8 3276.7 FORMAT "%4.1" /end AXIS_DESCR
/end CHARACTERISTIC
/begin CHARACTERISTIC KL_LADEKENNL "Batterieladespannungskennlinie" CURVE 0xa10172e4 _REC_CUR_TKL_UW_VV__s2_s2 99.83688000000001 _CNV_R_R_Def_u_sw_b_732_CM 0. 127.996
 /begin AXIS_DESCR STD_AXIS T_battabst _CNV_R_R_Def_t_sw_q_618_CM 6 -3276.8 3276.7 FORMAT "%4.1" /end AXIS_DESCR
/end CHARACTERISTIC
/begin CHARACTERISTIC KL_LORESPM "Motorabhängiger Loadresponse-Faktor" CURVE 0xa1017424 _REC_CUR_TKL_UW_VV__u1_s2 3.9843 _CNV_R_R_Def_f_ub_b_670_CM 0. 3.9843 FORMAT "%5.2"
 /begin AXIS_DESCR STD_AXIS Tmot _CNV_R_R_Def_t_sw_q_620_CM 6 -327.68 327.67 FORMAT "%5.2" /end AXIS_DESCR
/end CHARACTERISTIC
/begin CHARACTERISTIC KL_MDMAX "-" CURVE 0xa1017d2c _REC_CUR_TKL_UW_VV__s2_s2 85.536 _CNV_R_R_Def_m_sw_q_574_CM -3276.8 1000. FORMAT "%5.2"
 /begin AXIS_DESCR STD_AXIS Nkw_opt _CNV_R_R_Def_n_sw_q_612_CM 11 -32768. 32767. FORMAT "%5.0" /end AXIS_DESCR
/end CHARACTERISTIC
/begin CHARACTERISTIC KL_NMAXGRAD_KUP "N-Gradient zur Erkennung Gang rausgeschoben" CURVE 0xa1017d5c _REC_CUR_TKL_UW_VV__s1_u1 81.60000000000001 _CNV_R_R_Def_ngrd_s_668_CM -4096. 4064. FORMAT "%5.2"
 /begin AXIS_DESCR STD_AXIS Gangi _CNV_R_R_Def_dez_sl_575_CM 8 0. 255. FORMAT "%3.0" /end AXIS_DESCR
/end CHARACTERISTIC
/begin CHARACTERISTIC K_APPLROFF "" VALUE 0xa1017415 _REC_VAL_20_u1 1. _CNV_R_R_Def_dez_sl_575_CM 0. 1. FORMAT "%4.1" /end CHARACTERISTIC
/begin CHARACTERISTIC K_APPTBATINI "Enable Applikation Initwert Batterietemperatur" VALUE 0xa10172dd _REC_VAL_20_u1 99.45 _CNV_R_R_Def_dez_sl_575_CM 0. 255. FORMAT "%3.0" /end CHARACTERISTIC
/begin CHARACTERISTIC K_APPUPLLDST "Applikationswert St_ldstgen für Nachlauf" VALUE 0xa10173be _REC_VAL_20_u1 99.45 _CNV_R_R_Def_dez_sl_575_CM 0. 255. FORMAT "%3.0" /end CHARACTERISTIC
/begin CHARACTERISTIC K_APP_LLAH "Kennwert zum Umschalten auf Applikationskonstante" VALUE 0xa10173e0 _REC_VAL_20_u1 99.45 _CNV_R_R_Def_dez_sl_575_CM 0. 255. FORMAT "%3.0" /end CHARACTERISTIC
/begin CHARACTERISTIC K_BATTHTAUVG "Zeitkonstante Batterie hinten bei VFZG>" VALUE 0xa10172c0 _REC_VAL_20_u2 0.9999847412109381 _CNV_R_R_Def_f_uw_b_591_CM 0. 0.9999847412109381 FORMAT "%14.5" /end CHARACTERISTIC
/begin CHARACTERISTIC K_BATTHTAUVK "Zeitkonstante Batterie hinten bei VFZG<" VALUE 0xa10172c2 _REC_VAL_20_u2 0.9999847412109381 _CNV_R_R_Def_f_uw_b_591_CM 0. 0.9999847412109381 FORMAT "%14.5" /end CHARACTERISTIC
/begin CHARACTERISTIC K_BATTORT0 "Batterieeinbauort No1" VALUE 0xa10172de _REC_VAL_20_u1 2. _CNV_R_R_Def_dez_sl_575_CM 0. 2. FORMAT "%3.0" /end CHARACTERISTIC
/begin CHARACTERISTIC K_BATTORT2 "Batterieeinbauort No2" VALUE 0xa10172df _REC_VAL_20_u1 2. _CNV_R_R_Def_dez_sl_575_CM 0. 2. FORMAT "%3.0" /end CHARACTERISTIC
/begin CHARACTERISTIC K_BATTVTAUVG "Zeitkonstante Batterie vorne bei VFZG>" VALUE 0xa10172c4 _REC_VAL_20_u2 0.9999847412109381 _CNV_R_R_Def_f_uw_b_591_CM 0. 0.9999847412109381 FORMAT "%14.5" /end CHARACTERISTIC
/begin CHARACTERISTIC K_BATTVTAUVK "Zeitkonstante Batterie bei VFZG<Zeitkonstante Batterie bei VFZG>" VALUE 0xa10172c6 _REC_VAL_20_u2 0.9999847412109381 _CNV_R_R_Def_f_uw_b_591_CM 0. 0.9999847412109381 FORMAT "%14.5" /end CHARACTERISTIC
/begin CHARACTERISTIC K_BATT_ALFAH "Alphatau-Wert Batterie hinten" VALUE 0xa10172c8 _REC_VAL_20_u2 0.9999694824218756 _CNV_R_R_Def_f_uw_b_591_CM 1.52587890625e-005 0.9999847412109381 FORMAT "%14.5" /end CHARACTERISTIC
/begin CHARACTERISTIC K_BATT_ALFAV "Alphatau-Wert Batterie vorne" VALUE 0xa10172ca _REC_VAL_20_u2 0.9999694824218756 _CNV_R_R_Def_f_uw_b_591_CM 1.52587890625e-005 0.9999847412109381 FORMAT "%14.5" /end CHARACTERISTIC
/begin CHARACTERISTIC K_BATT_BETAV "Beta-Wert Batterie vorne" VALUE 0xa10172cc _REC_VAL_20_u2 0.9999694824218756 _CNV_R_R_Def_f_uw_b_591_CM 1.52587890625e-005 0.9999847412109381 FORMAT "%14.5" /end CHARACTERISTIC
/begin CHARACTERISTIC K_BATVFZGTAU "VFZG-Umschaltschwelle TAU Batterie" VALUE 0xa10172ce _REC_VAL_20_u2 0. _CNV_R_R_Def_v_uw_q_737_CM 0. 65535. FORMAT "%5.0" /end CHARACTERISTIC
/begin CHARACTERISTIC K_BGAPP "Applikationswert Generatorbegrenzung über Maximalmoment" VALUE 0xa1017416 _REC_VAL_20_u1 1. _CNV_R_R_Def_dez_sl_575_CM 0. 1. FORMAT "%4.1" /end CHARACTERISTIC
/begin CHARACTERISTIC K_DFLLMIN "DF unterhalb derer die LLDZanh. zurueckgenommen wird." VALUE 0xa10173b2 _REC_VAL_20_u1 99.60930000000001 _CNV_R_R_Def_f_ub_b_602_CM 0. 99.60930000000001 FORMAT "%5.2" /end CHARACTERISTIC
/begin CHARACTERISTIC K_DFMAX "Obere Schwelle DF Signal" VALUE 0xa10173b3 _REC_VAL_20_u1 99.60930000000001 _CNV_R_R_Def_f_ub_b_602_CM 0. 99.60930000000001 FORMAT "%5.2" /end CHARACTERISTIC
/begin CHARACTERISTIC K_DFMODE "DF-Mode-Schalter themermisch/elektrisch" VALUE 0xa10173bf _REC_VAL_20_u1 99.45 _CNV_R_R_Def_dez_sl_575_CM 0. 255. FORMAT "%3.0" /end CHARACTERISTIC
/begin CHARACTERISTIC K_DFS_MAX "DF-Auslastung Maximalschwelle" VALUE 0xa10173c0 _REC_VAL_20_u1 99.60930000000001 _CNV_R_R_Def_f_ub_b_602_CM 0. 99.60930000000001 FORMAT "%5.2" /end CHARACTERISTIC
/begin CHARACTERISTIC K_DFS_MIN "DF-Auslastung Minimalschwelle" VALUE 0xa10173c1 _REC_VAL_20_u1 99.60930000000001 _CNV_R_R_Def_f_ub_b_602_CM 0. 99.60930000000001 FORMAT "%5.2" /end CHARACTERISTIC
/begin CHARACTERISTIC K_DFS_MITT "DF-Auslastung Mittelschwelle" VALUE 0xa10173c2 _REC_VAL_20_u1 99.60930000000001 _CNV_R_R_Def_f_ub_b_602_CM 0. 99.60930000000001 FORMAT "%5.2" /end CHARACTERISTIC
/begin CHARACTERISTIC K_DMDGEN_SCHMN "" VALUE 0xa10173e6 _REC_VAL_20_s2 131.07 _CNV_R_R_Def_m_sw_q_574_CM -3276.8 3276.7 FORMAT "%5.2" /end CHARACTERISTIC
/begin CHARACTERISTIC K_DMDGEN_SCHMX "" VALUE 0xa10173e8 _REC_VAL_20_s2 131.07 _CNV_R_R_Def_m_sw_q_574_CM -3276.8 3276.7 FORMAT "%5.2" /end CHARACTERISTIC
/begin CHARACTERISTIC K_DSOCHYST "Hystereschwelle SOC" VALUE 0xa10173ac _REC_VAL_20_s2 99.99844999999999 _CNV_R_R_Def_f_sw_b_597_CM -100. 99.9969 /end CHARACTERISTIC
/begin CHARACTERISTIC K_DSOCLLANH "Abstand zur Stfgrz, bei der die LLDZanh aktiviert wird." VALUE 0xa10173ae _REC_VAL_20_s2 99.99844999999999 _CNV_R_R_Def_f_sw_b_597_CM -100. 99.9969 /end CHARACTERISTIC
/begin CHARACTERISTIC K_DSOCMIN "" VALUE 0xa10173ea _REC_VAL_20_s2 99.99844999999999 _CNV_R_R_Def_f_sw_b_597_CM -100. 99.9969 /end CHARACTERISTIC
/begin CHARACTERISTIC K_DTANSKOR "Ansaugluftmodelloffset Aussentemperatur" VALUE 0xa10172b0 _REC_VAL_20_s2 131.07 _CNV_R_R_Def_t_sw_q_618_CM -3276.8 3276.7 FORMAT "%4.1" /end CHARACTERISTIC
/begin CHARACTERISTIC K_ENAPPLGOFF "Enable Generatorauschaltsteuerung" VALUE 0xa1017417 _REC_VAL_20_u1 99.45 _CNV_R_R_Def_dez_sl_575_CM 0. 255. FORMAT "%3.0" /end CHARACTERISTIC
/begin CHARACTERISTIC K_ENAPPLRESP "Enable Handsteuerung Loadresponse" VALUE 0xa1017418 _REC_VAL_20_u1 99.45 _CNV_R_R_Def_dez_sl_575_CM 0. 255. FORMAT "%3.0" /end CHARACTERISTIC
/begin CHARACTERISTIC K_ETA_GETR "Getriebewirkungsgrad" VALUE 0xa1017d14 _REC_VAL_20_s2 100. _CNV_R_R_Def_eta_sw_628_CM 0. 100. /end CHARACTERISTIC
/begin CHARACTERISTIC K_FHOGNMN "minimaler Wichtungsfaktor fuer minimale HFM-Luftmassen Schwelle in Abhaengigkeit von d.Hoehe fuer Generatorreduzierung" VALUE 0xa1017419 _REC_VAL_20_u1 3.9843 _CNV_R_R_Def_f_ub_b_670_CM 0. 3.9843 FORMAT "%5.2" /end CHARACTERISTIC
/begin CHARACTERISTIC K_GENLDDFMAX "Schwell Anzeige maximaler Auslastungsgrad Generator" VALUE 0xa10173c3 _REC_VAL_20_u1 99.60930000000001 _CNV_R_R_Def_f_ub_b_602_CM 0. 99.60930000000001 FORMAT "%5.2" /end CHARACTERISTIC
/begin CHARACTERISTIC K_GENLLAHAPP "Applikationskonstente zum Setzen B_idlespec" VALUE 0xa10173e1 _REC_VAL_20_u1 99.45 _CNV_R_R_Def_dez_sl_575_CM 0. 255. FORMAT "%3.0" /end CHARACTERISTIC
/begin CHARACTERISTIC K_IEFFGS_KFS "Schwelle Triebstrangverstärkung zur Erkennung Standabkopplung" VALUE 0xa1017d00 _REC_VAL_20_u2 102.39842 _CNV_R_R_Def_strv_u_643_CM 0. 511.9921 FORMAT "%5.2" /end CHARACTERISTIC
/begin CHARACTERISTIC K_IEFF_GSMN "min. Triebstrangverstärkung" VALUE 0xa1017d0e _REC_VAL_20_u2 102.39684 _CNV_R_R_Def_strv_u_643_CM 7.900000000000001e-003 511.9921 FORMAT "%5.2" /end CHARACTERISTIC
/begin CHARACTERISTIC K_IEFF_GSMX "max. Triebstrangverstärkung" VALUE 0xa1017d0c _REC_VAL_20_u2 102.39684 _CNV_R_R_Def_strv_u_643_CM 7.900000000000001e-003 511.9921 FORMAT "%5.2" /end CHARACTERISTIC
/begin CHARACTERISTIC K_IERRFIL "Filterkonstante für Filterung Erregerstrom" VALUE 0xa10173c4 _REC_VAL_20_u1 0.9920000000000001 _CNV_R_R_Def_f_ub_b_573_CM 4.e-003 0.996 /end CHARACTERISTIC
/begin CHARACTERISTIC K_ILMINUMG "integrierte Lufmassenschwelle Aussentemperaturmodell" VALUE 0xa10172d0 _REC_VAL_20_u2 29.1266 _CNV_R_R_Def_lm_uw__663_CM 0. 29.1266 FORMAT "%7.4" /end CHARACTERISTIC
/begin CHARACTERISTIC K_I_1GANG "Übersetzng erster Gang" VALUE 0xa1017d20 _REC_VAL_20_u2 5.999 _CNV_R_R_Def_f_uw_b_580_CM 1.e-003 6. FORMAT "%7.4" /end CHARACTERISTIC
/begin CHARACTERISTIC K_I_1GANGAT "Übersetzng erster Gang AT" VALUE 0xa1017d24 _REC_VAL_20_u2 5.999 _CNV_R_R_Def_f_uw_b_580_CM 1.e-003 6. FORMAT "%7.4" /end CHARACTERISTIC
/begin CHARACTERISTIC K_I_HA "Hinterachsenübersetzung" VALUE 0xa1017d26 _REC_VAL_20_u2 5.999 _CNV_R_R_Def_f_uw_b_580_CM 1.e-003 6. FORMAT "%7.4" /end CHARACTERISTIC
/begin CHARACTERISTIC K_I_HAAT "Hinterachsenübersetzung für AT" VALUE 0xa1017d28 _REC_VAL_20_u2 5.999 _CNV_R_R_Def_f_uw_b_580_CM 1.e-003 6. FORMAT "%7.4" /end CHARACTERISTIC
/begin CHARACTERISTIC K_I_LGANG "Übersetzng längster Gang" VALUE 0xa1017d1e _REC_VAL_20_u2 5.999 _CNV_R_R_Def_f_uw_b_580_CM 1.e-003 6. FORMAT "%7.4" /end CHARACTERISTIC
/begin CHARACTERISTIC K_I_LGANGAT "Übersetzng längster Gang AT" VALUE 0xa1017d22 _REC_VAL_20_u2 5.999 _CNV_R_R_Def_f_uw_b_580_CM 1.e-003 6. FORMAT "%7.4" /end CHARACTERISTIC
/begin CHARACTERISTIC K_LBATTMAXK "maximale Batterieladespannung Kofferraum" VALUE 0xa101729c _REC_VAL_20_s2 99.83688000000001 _CNV_R_R_Def_u_sw_b_732_CM 0. 127.996 /end CHARACTERISTIC
/begin CHARACTERISTIC K_LBATTMAXM "maximale Batterieladespannung" VALUE 0xa101729e _REC_VAL_20_s2 99.83688000000001 _CNV_R_R_Def_u_sw_b_732_CM 0. 127.996 /end CHARACTERISTIC
/begin CHARACTERISTIC K_LBATTMIN "minmale Batterieladespannung Licht an" VALUE 0xa10172a0 _REC_VAL_20_s2 99.83688000000001 _CNV_R_R_Def_u_sw_b_732_CM 0. 127.996 /end CHARACTERISTIC
/begin CHARACTERISTIC K_LBATTTUMG "" VALUE 0xa10172a2 _REC_VAL_20_s2 131.07 _CNV_R_R_Def_t_sw_q_618_CM -3276.8 3276.7 FORMAT "%4.1" /end CHARACTERISTIC
/begin CHARACTERISTIC K_LBATTTUMGBA "" VALUE 0xa10172a4 _REC_VAL_20_s2 131.07 _CNV_R_R_Def_t_sw_q_618_CM -3276.8 3276.7 FORMAT "%4.1" /end CHARACTERISTIC
/begin CHARACTERISTIC K_LDM_BREMST "Codierung LDM-Bremsung" VALUE 0xa1017cf9 _REC_VAL_20_u1 99.45 _CNV_R_R_Def_dez_sl_575_CM 0. 255. FORMAT "%3.0" /end CHARACTERISTIC
/begin CHARACTERISTIC K_LLANHAPP "LLDZanh.-level, falls Generator fehlerhaft ist." VALUE 0xa10173b4 _REC_VAL_20_u1 99.45 _CNV_R_R_Def_dez_sl_575_CM 0. 255. FORMAT "%3.0" /end CHARACTERISTIC
/begin CHARACTERISTIC K_LLPMAPP "Handapplikationswert für Leerlaufdrehzahlvorgabe" VALUE 0xa10173b5 _REC_VAL_20_u1 99.45 _CNV_R_R_Def_dez_sl_575_CM 0. 255. FORMAT "%3.0" /end CHARACTERISTIC
/begin CHARACTERISTIC K_LRBNS "Loadrespo´nse bei Warnung Bordnetzstabilität gefährdet" VALUE 0xa101741a _REC_VAL_20_u1 25.5 _CNV_R_R_Def_td_ub__593_CM 0. 25.5 FORMAT "%4.1" /end CHARACTERISTIC
/begin CHARACTERISTIC K_LRESPAPP "Load-Response Applikation" VALUE 0xa101741b _REC_VAL_20_u1 25.5 _CNV_R_R_Def_td_ub__593_CM 0. 25.5 FORMAT "%4.1" /end CHARACTERISTIC
/begin CHARACTERISTIC K_MCOBATTORT "Codierung Hand Batterieeinbauort" VALUE 0xa10172e0 _REC_VAL_20_u1 2. _CNV_R_R_Def_dez_sl_575_CM 0. 2. FORMAT "%3.0" /end CHARACTERISTIC
/begin CHARACTERISTIC K_MDGNHYS "Hysterese für Drehzahlschwelle Generator-Maximalmomentbegrenzung" VALUE 0xa10173ec _REC_VAL_20_s2 0. _CNV_R_R_Def_n_sw_q_612_CM -32768. 32767. FORMAT "%5.0" /end CHARACTERISTIC
/begin CHARACTERISTIC K_MDGNMAX "Maximaldrehzahl für Generator-Maximalmomentbegrenzung" VALUE 0xa10173ee _REC_VAL_20_s2 0. _CNV_R_R_Def_n_sw_q_612_CM -32768. 32767. FORMAT "%5.0" /end CHARACTERISTIC
/begin CHARACTERISTIC K_MGMAXAPP "Applikationswert Genratormaximalmoment" VALUE 0xa10173f0 _REC_VAL_20_s2 131.07 _CNV_R_R_Def_m_sw_q_574_CM -3276.8 3276.7 FORMAT "%5.2" /end CHARACTERISTIC
/begin CHARACTERISTIC K_NAB_MN "min mögliche Abtriebsdrehzahl" VALUE 0xa1017d18 _REC_VAL_20_s2 0. _CNV_R_R_Def_n_sw_q_612_CM 1. 32767. FORMAT "%5.0" /end CHARACTERISTIC
/begin CHARACTERISTIC K_NGENOFMN "" VALUE 0xa10173f2 _REC_VAL_20_s2 0. _CNV_R_R_Def_n_sw_q_612_CM -32768. 32767. FORMAT "%5.0" /end CHARACTERISTIC
/begin CHARACTERISTIC K_NGENOFMX "" VALUE 0xa10173f4 _REC_VAL_20_s2 0. _CNV_R_R_Def_n_sw_q_612_CM -32768. 32767. FORMAT "%5.0" /end CHARACTERISTIC
/begin CHARACTERISTIC K_NKW_PEMAX "Drehzahl bei der der Motor sein Leistungsmax hat" VALUE 0xa1017d16 _REC_VAL_20_s2 0. _CNV_R_R_Def_n_sw_q_612_CM -32768. 32767. FORMAT "%5.0" /end CHARACTERISTIC
/begin CHARACTERISTIC K_NKW_SCH "Drehzahlschwelle für Grenzmomentberechnung" VALUE 0xa10173e4 _REC_VAL_20_s2 0. _CNV_R_R_Def_n_sw_q_612_CM 0. 32767. FORMAT "%5.0" /end CHARACTERISTIC
/begin CHARACTERISTIC K_NLLMIN "Motordrehzahl unterhalb derer die LLDZanh. zurueckgenommen wird." VALUE 0xa10173b0 _REC_VAL_20_s2 0. _CNV_R_R_Def_n_sw_q_612_CM -32768. 32767. FORMAT "%5.0" /end CHARACTERISTIC
/begin CHARACTERISTIC K_NMAX_WARN "min.Drehzahl für Hochschalthinweis" VALUE 0xa1017d1a _REC_VAL_20_s2 0. _CNV_R_R_Def_n_sw_q_612_CM -32768. 32767. FORMAT "%5.0" /end CHARACTERISTIC
/begin CHARACTERISTIC K_NMINUMG "Drehzahlschwelle Aussentemperaturmodell" VALUE 0xa10172b2 _REC_VAL_20_s2 0. _CNV_R_R_Def_n_sw_q_612_CM 0. 32767. FORMAT "%5.0" /end CHARACTERISTIC
/begin CHARACTERISTIC K_NMIN_LDMAUS "Drehzahl ab der LDM wegen Unterdrehzahl abgeschaltet werden kann" VALUE 0xa1017d02 _REC_VAL_20_s2 0. _CNV_R_R_Def_n_sw_q_612_CM -32768. 32767. FORMAT "%5.0" /end CHARACTERISTIC
/begin CHARACTERISTIC K_NMIN_WARN "min.Drehzahl für Hochschalthinweis" VALUE 0xa1017d1c _REC_VAL_20_s2 0. _CNV_R_R_Def_n_sw_q_612_CM -32768. 32767. FORMAT "%5.0" /end CHARACTERISTIC
/begin CHARACTERISTIC K_NMXGENOF "Motordrehzahlschwelle für Generatorzuschaltung" VALUE 0xa10173f6 _REC_VAL_20_s2 0. _CNV_R_R_Def_n_sw_q_612_CM -32768. 32767. FORMAT "%5.0" /end CHARACTERISTIC
/begin CHARACTERISTIC K_NSUBO "N_soll bei Batterieladebilanz zu niedrig" VALUE 0xa10173de _REC_VAL_20_s2 0. _CNV_R_R_Def_n_sw_q_612_CM 0. 32767. FORMAT "%5.0" /end CHARACTERISTIC
/begin CHARACTERISTIC K_NSUBU "N_soll bei Ladebilanz iO" VALUE 0xa10173dc _REC_VAL_20_s2 0. _CNV_R_R_Def_n_sw_q_612_CM 0. 32767. FORMAT "%5.0" /end CHARACTERISTIC
/begin CHARACTERISTIC K_OFTUMGCAN "Offset Umgebungstemperatur CAN" VALUE 0xa10172b4 _REC_VAL_20_s2 131.07 _CNV_R_R_Def_t_sw_q_618_CM -3276.8 3276.7 FORMAT "%4.1" /end CHARACTERISTIC
/begin CHARACTERISTIC K_OFULADE "Offset Ladekennlinie Batthinten" VALUE 0xa10172b6 _REC_VAL_20_s2 99.83843999999999 _CNV_R_R_Def_u_sw_b_732_CM -128. 127.996 /end CHARACTERISTIC
/begin CHARACTERISTIC K_PLBATTUMG "Plausibilisierung-Schwelle Batterieumgebungstemperatur" VALUE 0xa10172b8 _REC_VAL_20_s2 98.30099999999999 _CNV_R_R_Def_t_sw_q_618_CM 0. 3276.7 FORMAT "%4.1" /end CHARACTERISTIC
/begin CHARACTERISTIC K_RLEITUNGK "Widerstand Ladeleitung Batterie Kofferraum" VALUE 0xa10172aa _REC_VAL_20_u1 31.875 _CNV_R_R_Def_f_ub_b_695_CM 0. 31.875 FORMAT "%5.2" /end CHARACTERISTIC
/begin CHARACTERISTIC K_RLEITUNGM "Widerstand Ladeleitung Batterie Motorraum" VALUE 0xa10172ab _REC_VAL_20_u1 31.875 _CNV_R_R_Def_f_ub_b_695_CM 0. 31.875 FORMAT "%5.2" /end CHARACTERISTIC
/begin CHARACTERISTIC K_RLMXGENOF "relative Luftfüllungschwelle für Generatorzuschaltung" VALUE 0xa10173f8 _REC_VAL_20_s2 98.30250000000001 _CNV_R_R_Def_rf_sw__616_CM -327.68 327.67 FORMAT "%7.4" /end CHARACTERISTIC
/begin CHARACTERISTIC K_R_DYN "" VALUE 0xa1017d10 _REC_VAL_20_u2 0.9998 _CNV_R_R_Def_f_uw_b_591_CM 1.e-004 0.9999 FORMAT "%14.5" /end CHARACTERISTIC
/begin CHARACTERISTIC K_R_DYNLDM "" VALUE 0xa1017d12 _REC_VAL_20_u2 0.9998 _CNV_R_R_Def_f_uw_b_591_CM 1.e-004 0.9999 FORMAT "%14.5" /end CHARACTERISTIC
/begin CHARACTERISTIC K_SCHALT_KOMB "Erzwingen Hoch- und Rückschalthinweis" VALUE 0xa1017cf5 _REC_VAL_20_u1 1.17 _CNV_S_4_Def_schalt_779_CM 0. 3. BIT_MASK 0xFF /end CHARACTERISTIC
/begin CHARACTERISTIC K_TABSTGNMN "minimale Abstellzeit für Generatorreduzierung" VALUE 0xa1017406 _REC_VAL_20_u2 0. _CNV_R_R_Def_dez_sl_575_CM 0. 65535. FORMAT "%5.0" /end CHARACTERISTIC
/begin CHARACTERISTIC K_TABSTGNMX "maximale Abstellzeit für Generatorreduzierung" VALUE 0xa1017408 _REC_VAL_20_u2 0. _CNV_R_R_Def_dez_sl_575_CM 0. 65535. FORMAT "%5.0" /end CHARACTERISTIC
/begin CHARACTERISTIC K_TATMGENOF "Motordrehzahlschwelle  Katalysatortemperatur" VALUE 0xa10173fa _REC_VAL_20_s2 131.07 _CNV_R_R_Def_t_sw_q_618_CM -3276.8 3276.7 FORMAT "%4.1" /end CHARACTERISTIC
/begin CHARACTERISTIC K_TBATINIMAN "Applikation INITWERT Batterietemperatur" VALUE 0xa10172ba _REC_VAL_20_s2 98.30099999999999 _CNV_R_R_Def_t_sw_q_618_CM 0. 3276.7 FORMAT "%4.1" /end CHARACTERISTIC
/begin CHARACTERISTIC K_TBATTFTAUV "Zeitkonstante 5*Tau Batterievorne" VALUE 0xa10172d2 _REC_VAL_20_u2 0. _CNV_R_R_Def_dez_sl_575_CM 0. 65535. FORMAT "%5.0" /end CHARACTERISTIC
/begin CHARACTERISTIC K_TBATTTAUFH "Zeitkonstante Batterie 5*Tau hinten" VALUE 0xa10172d4 _REC_VAL_20_u2 0. _CNV_R_R_Def_dez_sl_575_CM 0. 65535. FORMAT "%5.0" /end CHARACTERISTIC
/begin CHARACTERISTIC K_TDHSCHALT "" VALUE 0xa1017d08 _REC_VAL_20_u2 98.30250000000001 _CNV_R_R_Def_td_uw__679_CM 0. 655.35 FORMAT "%5.2" /end CHARACTERISTIC
/begin CHARACTERISTIC K_TDKEIN_GANG "Zeitverzögerung Erkennung Gang ausgelegt ohne Kupplung" VALUE 0xa1017cfa _REC_VAL_20_u1 2.55 _CNV_R_R_Def_td_uw__679_CM 0. 2.55 FORMAT "%5.2" /end CHARACTERISTIC
/begin CHARACTERISTIC K_TDMDGEN_VERZAUS "" VALUE 0xa101740a _REC_VAL_20_u2 98.30250000000001 _CNV_R_R_Def_td_uw__679_CM 0. 655.35 FORMAT "%5.2" /end CHARACTERISTIC
/begin CHARACTERISTIC K_TDMDGEN_VERZEIN "" VALUE 0xa101740c _REC_VAL_20_u2 98.30250000000001 _CNV_R_R_Def_td_uw__679_CM 0. 655.35 FORMAT "%5.2" /end CHARACTERISTIC
/begin CHARACTERISTIC K_TDRSCHALT "" VALUE 0xa1017d0a _REC_VAL_20_u2 98.30250000000001 _CNV_R_R_Def_td_uw__679_CM 0. 655.35 FORMAT "%5.2" /end CHARACTERISTIC
/begin CHARACTERISTIC K_TD_KUPPEXT "Zeitverzögerung fallende Flanke B_kupp_ext" VALUE 0xa1017cf4 _REC_VAL_20_u1 2.55 _CNV_R_R_Def_td_uw__679_CM 0. 2.55 FORMAT "%5.2" /end CHARACTERISTIC
/begin CHARACTERISTIC K_TD_LDMAUS "Zeitverzögerung Abschaltung LDM bei B_rschalt" VALUE 0xa1017d04 _REC_VAL_20_u2 98.30250000000001 _CNV_R_R_Def_td_uw__679_CM 0. 655.35 FORMAT "%5.2" /end CHARACTERISTIC
/begin CHARACTERISTIC K_TD_LDMAUS1 "Zeitverzögerung Abschaltung LDM bei B_hschalt" VALUE 0xa1017d06 _REC_VAL_20_u2 98.30250000000001 _CNV_R_R_Def_td_uw__679_CM 0. 655.35 FORMAT "%5.2" /end CHARACTERISTIC
/begin CHARACTERISTIC K_TGENOFMN "" VALUE 0xa10173fc _REC_VAL_20_s2 131.07 _CNV_R_R_Def_t_sw_q_618_CM -3276.8 3276.7 FORMAT "%4.1" /end CHARACTERISTIC
/begin CHARACTERISTIC K_TGENOFMX "" VALUE 0xa10173fe _REC_VAL_20_s2 131.07 _CNV_R_R_Def_t_sw_q_618_CM -3276.8 3276.7 FORMAT "%4.1" /end CHARACTERISTIC
/begin CHARACTERISTIC K_TGENOFVL "Generatorsabschaltzeit bei Vollastbeschleunigung" VALUE 0xa101741c _REC_VAL_20_u1 99.45 _CNV_R_R_Def_dez_sl_575_CM 0. 255. FORMAT "%3.0" /end CHARACTERISTIC
/begin CHARACTERISTIC K_TIMERDLY "Verzoegerungszeit für Startwertberechnung" VALUE 0xa10172ac _REC_VAL_20_u1 99.45 _CNV_R_R_Def_dez_sl_575_CM 0. 255. FORMAT "%3.0" /end CHARACTERISTIC
/begin CHARACTERISTIC K_TLORESPST "Startloadresponse" VALUE 0xa101741d _REC_VAL_20_u1 25.5 _CNV_R_R_Def_td_ub__593_CM 0. 25.5 FORMAT "%4.1" /end CHARACTERISTIC
/begin CHARACTERISTIC K_TMOTABGNMN "minimale Motorabstelltemperatur für Generatorreduzierung" VALUE 0xa1017400 _REC_VAL_20_s2 98.30250000000001 _CNV_R_R_Def_t_sw_q_620_CM -327.68 327.67 FORMAT "%5.2" /end CHARACTERISTIC
/begin CHARACTERISTIC K_TNNSTART "Zeittriggerschwelle nach Motorstart" VALUE 0xa10173bc _REC_VAL_20_u2 98.30250000000001 _CNV_R_R_Def_td_uw__679_CM 0. 655.35 FORMAT "%5.2" /end CHARACTERISTIC
/begin CHARACTERISTIC K_TUMGGNMN "minimale Umgebungstemperatur für Generatorreduzierung" VALUE 0xa1017402 _REC_VAL_20_s2 131.07 _CNV_R_R_Def_t_sw_q_618_CM -3276.8 3276.7 FORMAT "%4.1" /end CHARACTERISTIC
/begin CHARACTERISTIC K_TUMGGNMX "maximale Umgebungstemperatur für Generatorreduzierung" VALUE 0xa1017404 _REC_VAL_20_s2 131.07 _CNV_R_R_Def_t_sw_q_618_CM -3276.8 3276.7 FORMAT "%4.1" /end CHARACTERISTIC
/begin CHARACTERISTIC K_TUMGINI "Initialisierungswert Aussentemperaturmodell" VALUE 0xa10172bc _REC_VAL_20_s2 131.07 _CNV_R_R_Def_t_sw_q_618_CM -3276.8 3276.7 FORMAT "%4.1" /end CHARACTERISTIC
/begin CHARACTERISTIC K_TUMGTAU "Zeitkonstante 5*Tau Aussentemperatur" VALUE 0xa10172d6 _REC_VAL_20_u2 0. _CNV_R_R_Def_dez_sl_575_CM 0. 65535. FORMAT "%5.0" /end CHARACTERISTIC
/begin CHARACTERISTIC K_TVLOFHYST "Hysterese Generatorvollastabschaltung" VALUE 0xa101741e _REC_VAL_20_u1 99.45 _CNV_R_R_Def_dez_sl_575_CM 0. 255. FORMAT "%3.0" /end CHARACTERISTIC
/begin CHARACTERISTIC K_T_ENTPRGANG "Entprellzeit Gangi" VALUE 0xa1017cfe _REC_VAL_20_u2 98.30250000000001 _CNV_R_R_Def_td_uw__679_CM 0. 655.35 FORMAT "%5.2" /end CHARACTERISTIC
/begin CHARACTERISTIC K_UBATTNORM "Batterienormspannung" VALUE 0xa10172be _REC_VAL_20_s2 99.83843999999999 _CNV_R_R_Def_u_sw_b_732_CM -128. 127.996 /end CHARACTERISTIC
/begin CHARACTERISTIC K_UB_GRENZST "Grenzwert Gradient d. Bordnetzspannung im Start" VALUE 0xa10173b8 _REC_VAL_20_u2 123.46794 _CNV_R_R_Def_u_sb_q_598_CM 0. 6173.397 FORMAT "%4.1" /end CHARACTERISTIC
/begin CHARACTERISTIC K_UKOMPK "Applikationswert Kompensationsspannung Kafferraum" VALUE 0xa10172a6 _REC_VAL_20_s2 99.83688000000001 _CNV_R_R_Def_u_sw_b_732_CM 0. 127.996 /end CHARACTERISTIC
/begin CHARACTERISTIC K_UKOMPM "Applikationswert Kompensationsspannung Motorraum" VALUE 0xa10172a8 _REC_VAL_20_s2 99.83688000000001 _CNV_R_R_Def_u_sw_b_732_CM 0. 127.996 /end CHARACTERISTIC
/begin CHARACTERISTIC K_ULADE_TAU "Batterieladespannungs Zeitkonstante" VALUE 0xa10172d8 _REC_VAL_20_u2 0.9999847412109381 _CNV_R_R_Def_f_uw_b_591_CM 0. 0.9999847412109381 FORMAT "%14.5" /end CHARACTERISTIC
/begin CHARACTERISTIC K_V2NAB "Umrechnungsfaktor V in N_ab" VALUE 0xa1017d2a _REC_VAL_20_u2 63.99900000000001 _CNV_R_R_Def_f_uw_b_580_CM 0. 63.999 FORMAT "%7.4" /end CHARACTERISTIC
/begin CHARACTERISTIC K_VGENOFMN "Geschwindigkeitgeneratorabschaltschwelle bei Vollastbeschleunigung" VALUE 0xa101740e _REC_VAL_20_u2 0. _CNV_R_R_Def_v_uw_q_737_CM 0. 65535. FORMAT "%5.0" /end CHARACTERISTIC
/begin CHARACTERISTIC K_VGENOGMX "Geschwindigkeitgeneratorzuschaltschwelle bei Vollastbeschleunigung" VALUE 0xa1017410 _REC_VAL_20_u2 0. _CNV_R_R_Def_v_uw_q_737_CM 0. 65535. FORMAT "%5.0" /end CHARACTERISTIC
/begin CHARACTERISTIC K_VMINUMG "Fahrzeuggeschwindigkeitsschwelle Aussentemperaturmodell" VALUE 0xa10172da _REC_VAL_20_u2 0. _CNV_R_R_Def_v_uw_q_737_CM 0. 65535. FORMAT "%5.0" /end CHARACTERISTIC
/begin CHARACTERISTIC K_VZLORESOFV "Geschwindigkeitsschwelle für Generatorzuschaltung" VALUE 0xa1017412 _REC_VAL_20_u2 0. _CNV_R_R_Def_v_uw_q_737_CM 0. 65535. FORMAT "%5.0" /end CHARACTERISTIC
/begin CHARACTERISTIC K_ZK_NKWGRAD "Zeitkonstante PT1-Filterung Nkw_grad" VALUE 0xa1017cf3 _REC_VAL_20_u1 0.996 _CNV_R_R_Def_f_ub_b_573_CM 0. 0.996 /end CHARACTERISTIC
/begin CHARACTERISTIC S_GANGWECHSEL_AN "1: Gangwechsel wird für B_antrieb ausgewertet" VALUE 0xa1017cf2 _REC_VAL_20_u1 99.45 _CNV_R_R_Def_dez_sl_575_CM 0. 255. FORMAT "%3.0" /end CHARACTERISTIC
/begin CHARACTERISTIC S_IEFF_GS "" VALUE 0xa1017cfc _REC_VAL_20_u1 99.45 _CNV_R_R_Def_dez_sl_575_CM 0. 255. FORMAT "%3.0" /end CHARACTERISTIC
/begin CHARACTERISTIC S_IPM_06 "" VALUE 0xa1017cf1 _REC_VAL_20_u1 99.45 _CNV_R_R_Def_dez_sl_575_CM 0. 255. FORMAT "%3.0" /end CHARACTERISTIC
/begin CHARACTERISTIC S_IPM_BSPORT "Freigabe Umschaltung Pedalauswertung durch Sport-Taster" VALUE 0xa1017cf0 _REC_VAL_20_u1 99.45 _CNV_R_R_Def_dez_sl_575_CM 0. 255. FORMAT "%3.0" /end CHARACTERISTIC
/begin CHARACTERISTIC S_IPM_HS "" VALUE 0xa1017cfb _REC_VAL_20_u1 99.45 _CNV_R_R_Def_dez_sl_575_CM 0. 255. FORMAT "%3.0" /end CHARACTERISTIC
/begin CHARACTERISTIC S_LBATT1 "Applikationsschalter1 Auswahl Ersatztemperatur" VALUE 0xa10172ad _REC_VAL_20_u1 1. _CNV_R_R_Def_dez_sl_575_CM 0. 1. FORMAT "%4.1" /end CHARACTERISTIC
/begin CHARACTERISTIC S_LBATT2 "Applikationsschalter2 Auswahl Ersatztemperatur" VALUE 0xa10172ae _REC_VAL_20_u1 1. _CNV_R_R_Def_dez_sl_575_CM 0. 1. FORMAT "%4.1" /end CHARACTERISTIC
/begin CHARACTERISTIC S_LBATTAPPL "" VALUE 0xa10172e1 _REC_VAL_20_u1 1. _CNV_R_R_Def_dez_sl_575_CM 0. 1. FORMAT "%4.1" /end CHARACTERISTIC
/begin CHARACTERISTIC S_LDMAUSHS_AKT "1: Abschaltung LDM (bei B_hschalt) durch B_ldm_off aktiv" VALUE 0xa1017cf6 _REC_VAL_20_u1 99.45 _CNV_R_R_Def_dez_sl_575_CM 0. 255. FORMAT "%3.0" /end CHARACTERISTIC
/begin CHARACTERISTIC S_LDMAUSRS_AKT "1: Abschaltung LDM (bei B_rschalt) durch B_ldm_off aktiv" VALUE 0xa1017cf7 _REC_VAL_20_u1 99.45 _CNV_R_R_Def_dez_sl_575_CM 0. 255. FORMAT "%3.0" /end CHARACTERISTIC
/begin CHARACTERISTIC S_LDMBREMS_AUS "1: Systembremsung LDM wird bei B_rschalt nicht berücksichtigt" VALUE 0xa1017cf8 _REC_VAL_20_u1 99.45 _CNV_R_R_Def_dez_sl_575_CM 0. 255. FORMAT "%3.0" /end CHARACTERISTIC
/begin CHARACTERISTIC S_LORESLL "Schalter Kennlinienausschaltzeit " VALUE 0xa101741f _REC_VAL_20_u1 1. _CNV_R_R_Def_dez_sl_575_CM 0. 1. FORMAT "%4.1" /end CHARACTERISTIC
/begin CHARACTERISTIC S_MGAPP "Schalter für Applikationswert Genratormaximalmoment" VALUE 0xa1017420 _REC_VAL_20_u1 1. _CNV_R_R_Def_dez_sl_575_CM 0. 1. FORMAT "%4.1" /end CHARACTERISTIC
/begin CHARACTERISTIC S_N_IDLIBS "Schalter zum manuellen Setzen von LL aktiv" VALUE 0xa10173b6 _REC_VAL_20_u1 1. _CNV_R_R_Def_dez_sl_575_CM 0. 1. FORMAT "%4.1" /end CHARACTERISTIC
/begin CHARACTERISTIC S_PMSTRTMOD "Startnkw aufgrund B_sta || Spgseinbruch" VALUE 0xa10173ba _REC_VAL_20_u1 99.45 _CNV_R_R_Def_dez_sl_575_CM 0. 255. FORMAT "%3.0" /end CHARACTERISTIC
/begin CHARACTERISTIC S_SAPP "Schalter für Applikationswert Begrenzungsstrategie" VALUE 0xa1017421 _REC_VAL_20_u1 1. _CNV_R_R_Def_dez_sl_575_CM 0. 1. FORMAT "%4.1" /end CHARACTERISTIC
/begin CHARACTERISTIC S_STRTNKWMOD "Schalter N oder Nkw_zahn" VALUE 0xa10173bb _REC_VAL_20_u1 99.45 _CNV_R_R_Def_dez_sl_575_CM 0. 255. FORMAT "%3.0" /end CHARACTERISTIC
/begin CHARACTERISTIC S_TLACTIV "Schalter, um Grenzmoment in allen Motorzuständen freizugeben" VALUE 0xa1017422 _REC_VAL_20_u1 1. _CNV_R_R_Def_dez_sl_575_CM 0. 1. FORMAT "%4.1" /end CHARACTERISTIC
/begin COMPU_METHOD _CNV_R_R_Def_km_sw__64_CM "Def_km_sw_q10" RAT_FUNC "%6.3" "km" COEFFS 0. 1. 0. 0. 0. 10. /end COMPU_METHOD
/begin COMPU_METHOD _CNV_R_R_DEZ_436_CM "" RAT_FUNC "%6.3" "" COEFFS 0. 1. 0. 0. 0. 1. /end COMPU_METHOD
/begin COMPU_METHOD _CNV_R_R_Def_km_ub__443_CM "Def_km_ub_q1000" RAT_FUNC "%6.3" "km" COEFFS 0. 1. 0. 0. 0. 1000. /end COMPU_METHOD
/begin COMPU_METHOD _CNV_R_R_Def_a_sw_b_570_CM "Def_a_sw_b64" RAT_FUNC "%6.3" "m/s²" COEFFS 0. 32768. 0. 0. 0. 64. /end COMPU_METHOD
/begin COMPU_METHOD _CNV_R_R_Def_f_sw_q_571_CM "Def_f_sw_q0p00153" RAT_FUNC "%6.3" "-" COEFFS 0. 32768. 0. 0. 0. 50. /end COMPU_METHOD
/begin COMPU_METHOD _CNV_R_R_Def_ac_sb__572_CM "Def_ac_sb_q0p25" RAT_FUNC "%6.3" "-" COEFFS 0. 4. 0. 0. 0. 1. /end COMPU_METHOD
/begin COMPU_METHOD _CNV_R_R_Def_f_ub_b_573_CM "Def_f_ub_b1" RAT_FUNC "%6.3" "-" COEFFS 0. 256. 0. 0. 0. 1. /end COMPU_METHOD
/begin COMPU_METHOD _CNV_R_R_Def_m_sw_q_574_CM "Def_m_sw_q0p1" RAT_FUNC "%6.3" "Nm" COEFFS 0. 10. 0. 0. 0. 1. /end COMPU_METHOD
/begin COMPU_METHOD _CNV_R_R_Def_dez_sl_575_CM "Def_dez_sl_q1" RAT_FUNC "%6.3" "-" COEFFS 0. 1. 0. 0. 0. 1. /end COMPU_METHOD
/begin COMPU_METHOD _CNV_R_R_Def_f_uw_b_576_CM "Def_f_uw_b100" RAT_FUNC "%6.3" "%" COEFFS 0. 65536. 0. 0. 0. 100. /end COMPU_METHOD
/begin COMPU_METHOD _CNV_R_R_Def_p_sw_q_578_CM "Def_p_sw_q0p039" RAT_FUNC "%6.3" "hPa" COEFFS 0. 256. 0. 0. 0. 10. /end COMPU_METHOD
/begin COMPU_METHOD _CNV_R_R_Def_f_uw_b_579_CM "Def_f_uw_b2" RAT_FUNC "%6.3" "-" COEFFS 0. 65536. 0. 0. 0. 2. /end COMPU_METHOD
/begin COMPU_METHOD _CNV_R_R_Def_f_uw_b_580_CM "Def_f_uw_b64" RAT_FUNC "%6.3" "-" COEFFS 0. 65536. 0. 0. 0. 64. /end COMPU_METHOD
/begin COMPU_METHOD _CNV_R_R_Def_spr_sw_583_CM "Def_spr_sw_q0p1" RAT_FUNC "%6.3" "° KW" COEFFS 0. 10. 0. 0. 0. 1. /end COMPU_METHOD
/begin COMPU_METHOD _CNV_R_R_Def_rel_sw_584_CM "Def_rel_sw_b100" RAT_FUNC "%6.3" "%" COEFFS 0. 32768. 0. 0. 0. 100. /end COMPU_METHOD
/begin COMPU_METHOD _CNV_S_11_Def_ba_ewp_586_CM "Def_ba_ewp" TAB_VERB "%6.3" "-" COMPU_TAB_REF _CNV_S_11_Def_ba_ewp_586 /end COMPU_METHOD
/begin COMPU_VTAB _CNV_S_11_Def_ba_ewp_586 "Def_ba_ewp" TAB_VERB 11 0 "INIT" 1 "NORMAL_GESTEUERT" 2 "NORMAL_GEREGELT" 3 "REDUZIERT_USP" 4 "REDUZIERT_UEBT1" 5 "REDUZIERT_UEBT2" 6 "REDUZIERT_TROCKENLAUF" 7 "ABSCHALTUNG_TEMP" 8 "ABSCHALTUNG_DEBLOCK" 9 "ABSCHALTUNG_PERM" 10 "NPLAUS" /end COMPU_VTAB
/begin COMPU_METHOD _CNV_R_R_Def_f_uw_b_591_CM "Def_f_uw_b1" RAT_FUNC "%6.3" "-" COEFFS 0. 65536. 0. 0. 0. 1. /end COMPU_METHOD
/begin COMPU_METHOD _CNV_R_R_Def_td_ub__593_CM "Def_td_ub_q0p1" RAT_FUNC "%6.3" "s" COEFFS 0. 10. 0. 0. 0. 1. /end COMPU_METHOD
/begin COMPU_METHOD _CNV_R_R_Def_f_uw_b_594_CM "Def_f_uw_b16" RAT_FUNC "%6.3" "-" COEFFS 0. 65536. 0. 0. 0. 16. /end COMPU_METHOD
/begin COMPU_METHOD _CNV_R_R_Def_f_ub_b_595_CM "Def_f_ub_b127p5" RAT_FUNC "%6.3" "%" COEFFS 0. 2. 0. 0. 0. 1. /end COMPU_METHOD
/begin COMPU_METHOD _CNV_R_R_Def_f_sw_b_597_CM "Def_f_sw_b100" RAT_FUNC "%6.3" "-" COEFFS 0. 32768. 0. 0. 0. 100. /end COMPU_METHOD
/begin COMPU_METHOD _CNV_R_R_Def_u_sb_q_598_CM "Def_u_sb_q0p0942" RAT_FUNC "%6.3" "V" COEFFS 0. 1. 0. 0. 0. 9.420000000000001e-002 /end COMPU_METHOD
/begin COMPU_METHOD _CNV_R_R_Def_zw_sw__599_CM "Def_zw_sw_q0p1" RAT_FUNC "%6.3" "°" COEFFS 0. 10. 0. 0. 0. 1. /end COMPU_METHOD
/begin COMPU_METHOD _CNV_R_R_Def_f_ub_b_602_CM "Def_f_ub_b100" RAT_FUNC "%6.3" "%" COEFFS 0. 256. 0. 0. 0. 100. /end COMPU_METHOD
/begin COMPU_METHOD _CNV_R_R_Def_f_uw_b_604_CM "Def_f_uw_b32" RAT_FUNC "%6.3" "-" COEFFS 0. 65536. 0. 0. 0. 32. /end COMPU_METHOD
/begin COMPU_METHOD _CNV_R_R_Def_f_sw_b_608_CM "Def_f_sw_b2" RAT_FUNC "%6.3" "-" COEFFS 0. 65536. 0. 0. 0. 4. /end COMPU_METHOD
/begin COMPU_METHOD _CNV_R_R_Def_ms_uw__611_CM "Def_ms_uw_q0p03125" RAT_FUNC "%6.3" "kg/h" COEFFS 0. 32. 0. 0. 0. 1. /end COMPU_METHOD
/begin COMPU_METHOD _CNV_R_R_Def_n_sw_q_612_CM "Def_n_sw_q1p0" RAT_FUNC "%6.3" "Upm" COEFFS 0. 1. 0. 0. 0. 1. /end COMPU_METHOD
/begin COMPU_METHOD _CNV_R_R_Def_rf_sw__616_CM "Def_rf_sw_q0p01" RAT_FUNC "%6.3" "%" COEFFS 0. 100. 0. 0. 0. 1. /end COMPU_METHOD
/begin COMPU_METHOD _CNV_R_R_Def_eta_sw_617_CM "Def_eta_sw_b200" RAT_FUNC "%6.3" "%" COEFFS 0. 32768. 0. 0. 0. 200. /end COMPU_METHOD
/begin COMPU_METHOD _CNV_R_R_Def_t_sw_q_618_CM "Def_t_sw_q0p1" RAT_FUNC "%6.3" "°C" COEFFS 0. 10. 0. 0. 0. 1. /end COMPU_METHOD
/begin COMPU_METHOD _CNV_R_R_Def_t_sw_q_620_CM "Def_t_sw_q0p01" RAT_FUNC "%6.3" "°C" COEFFS 0. 100. 0. 0. 0. 1. /end COMPU_METHOD
/begin COMPU_METHOD _CNV_R_R_Def_kw_sw__622_CM "Def_kw_sw_q0p0234" RAT_FUNC "%6.3" "°KW" COEFFS 0. 256. 0. 0. 0. 6. /end COMPU_METHOD
/begin COMPU_METHOD _CNV_R_R_Def_f_ub_b_625_CM "Def_f_ub_b2" RAT_FUNC "%6.3" "-" COEFFS 0. 256. 0. 0. 0. 2. /end COMPU_METHOD
/begin COMPU_METHOD _CNV_R_R_Def_eta_uw_627_CM "Def_eta_uw_b200" RAT_FUNC "%6.3" "%" COEFFS 0. 65536. 0. 0. 0. 200. /end COMPU_METHOD
/begin COMPU_METHOD _CNV_R_R_Def_eta_sw_628_CM "Def_eta_sw_q0p00305" RAT_FUNC "%6.3" "%" COEFFS 0. 32767. 0. 0. 0. 100. /end COMPU_METHOD
/begin COMPU_METHOD _CNV_R_R_Def_f_uw_b_632_CM "Def_f_uw_b256" RAT_FUNC "%6.3" "-" COEFFS 0. 65536. 0. 0. 0. 256. /end COMPU_METHOD
/begin COMPU_METHOD _CNV_R_R_Def_strv_u_643_CM "Def_strv_uw_b512" RAT_FUNC "%6.3" "1/m" COEFFS 0. 65536. 0. 0. 0. 512. /end COMPU_METHOD
/begin COMPU_METHOD _CNV_R_R_Def_i_ub_q_645_CM "Def_i_ub_q0p125" RAT_FUNC "%6.3" "A" COEFFS 0. 8. 0. 0. 0. 1. /end COMPU_METHOD
/begin COMPU_METHOD _CNV_R_R_Def_i_sw_q_650_CM "Def_i_sw_q0p001" RAT_FUNC "%6.3" "A" COEFFS 0. 1000. 0. 0. 0. 1. /end COMPU_METHOD
/begin COMPU_METHOD _CNV_R_R_Def_i_ub_q_651_CM "Def_i_ub_q10" RAT_FUNC "%6.3" "A" COEFFS 0. 1. 0. 0. 0. 10. /end COMPU_METHOD
/begin COMPU_METHOD _CNV_R_R_Def_f_sb_b_655_CM "Def_f_sb_b0p125" RAT_FUNC "%6.3" "-" COEFFS 0. 1024. 0. 0. 0. 1. /end COMPU_METHOD
/begin COMPU_METHOD _CNV_R_R_Def_md_rel_660_CM "Def_md_rel_q0p1" RAT_FUNC "%6.3" "%" COEFFS 0. 10. 0. 0. 0. 1. /end COMPU_METHOD
/begin COMPU_METHOD _CNV_R_R_Def_lm_uw__663_CM "Def_lm_uw_q0p000444" RAT_FUNC "%6.3" "kg" COEFFS 0. 2250. 0. 0. 0. 1. /end COMPU_METHOD
/begin COMPU_METHOD _CNV_R_R_Def_ms_uw__665_CM "Def_ms_uw_q0p00039" RAT_FUNC "%6.3" "kg/h" COEFFS 0. 65536. 0. 0. 0. 25.6 /end COMPU_METHOD
/begin COMPU_METHOD _CNV_R_R_Def_dez_ub_667_CM "Def_dez_ub_q0p5" RAT_FUNC "%6.3" "-" COEFFS 0. 2. 0. 0. 0. 1. /end COMPU_METHOD
/begin COMPU_METHOD _CNV_R_R_Def_ngrd_s_668_CM "Def_ngrd_sb_q32p0" RAT_FUNC "%6.3" "Upm/s" COEFFS 0. 1. 0. 0. 0. 32. /end COMPU_METHOD
/begin COMPU_METHOD _CNV_R_R_Def_f_ub_b_670_CM "Def_f_ub_b4" RAT_FUNC "%6.3" "-" COEFFS 0. 256. 0. 0. 0. 4. /end COMPU_METHOD
/begin COMPU_METHOD _CNV_R_R_Def_tn_uw__671_CM "Def_tn_uw_q1" RAT_FUNC "%6.3" "min" COEFFS 0. 1. 0. 0. 0. 1. /end COMPU_METHOD
/begin COMPU_METHOD _CNV_R_R_Def_lf_ub__675_CM "Def_lf_ub_q0p01" RAT_FUNC "%6.3" "-" COEFFS 0. 100. 0. 0. 0. 1. /end COMPU_METHOD
/begin COMPU_METHOD _CNV_R_R_Def_td_uw__679_CM "Def_td_uw_q0p01" RAT_FUNC "%6.3" "s" COEFFS 0. 100. 0. 0. 0. 1. /end COMPU_METHOD
/begin COMPU_METHOD _CNV_R_R_Def_td_uw__682_CM "Def_td_uw_q1" RAT_FUNC "%6.3" "s" COEFFS 0. 1. 0. 0. 0. 1. /end COMPU_METHOD
/begin COMPU_METHOD _CNV_R_R_Def_p_sw_q_683_CM "Def_p_sw_q1" RAT_FUNC "%6.3" "hPa" COEFFS 0. 1. 0. 0. 0. 1. /end COMPU_METHOD
/begin COMPU_METHOD _CNV_R_R_Def_p_ub_q_684_CM "Def_p_ub_q32" RAT_FUNC "%6.3" "hPa" COEFFS 0. 1. 0. 0. 0. 32. /end COMPU_METHOD
/begin COMPU_METHOD _CNV_R_R_Def_p_uw_q_685_CM "Def_p_uw_q0p0061" RAT_FUNC "%6.3" "MPa" COEFFS 0. 65536. 0. 0. 0. 40. /end COMPU_METHOD
/begin COMPU_METHOD _CNV_R_R_Def_p_ub_q_686_CM "Def_p_ub_q0p39" RAT_FUNC "%6.3" "Bar" COEFFS 0. 256. 0. 0. 0. 100. /end COMPU_METHOD
/begin COMPU_METHOD _CNV_R_R_Def_wdk_sw_691_CM "Def_wdk_sw_q0p0244" RAT_FUNC "%6.3" "%" COEFFS 0. 4096. 0. 0. 0. 100. /end COMPU_METHOD
/begin COMPU_METHOD _CNV_R_R_Def_f_ub_b_695_CM "Def_f_ub_b32" RAT_FUNC "%6.3" "-" COEFFS 0. 256. 0. 0. 0. 32. /end COMPU_METHOD
/begin COMPU_METHOD _CNV_R_R_Def_rk_uw__696_CM "Def_rk_uw_b16" RAT_FUNC "%6.3" "-" COEFFS 0. 2048. 0. 0. 0. 1. /end COMPU_METHOD
/begin COMPU_METHOD _CNV_R_R_Def_rk_sw__697_CM "Def_rk_sw_b1600" RAT_FUNC "%6.3" "%" COEFFS 0. 2048. 0. 0. 0. 100. /end COMPU_METHOD
/begin COMPU_METHOD _CNV_R_R_Def_rk_sw__698_CM "Def_rk_sw_b16" RAT_FUNC "%6.3" "-" COEFFS 0. 32768. 0. 0. 0. 16. /end COMPU_METHOD
/begin COMPU_METHOD _CNV_S_2_Def_bit_ub_700_CM "Def_bit_ub_0" TAB_VERB "%6.3" "-" COMPU_TAB_REF _CNV_S_2_Def_bit_ub_700 /end COMPU_METHOD
/begin COMPU_VTAB _CNV_S_2_Def_bit_ub_700 "Def_bit_ub_0" TAB_VERB 2 0 "FALSE" 1 "TRUE" /end COMPU_VTAB
/begin COMPU_METHOD _CNV_S_2_Def_bit_ub_701_CM "Def_bit_ub_1" TAB_VERB "%6.3" "-" COMPU_TAB_REF _CNV_S_2_Def_bit_ub_701 /end COMPU_METHOD
/begin COMPU_VTAB _CNV_S_2_Def_bit_ub_701 "Def_bit_ub_1" TAB_VERB 2 0 "FALSE" 2 "TRUE" /end COMPU_VTAB
/begin COMPU_METHOD _CNV_S_2_Def_bit_ub_702_CM "Def_bit_ub_2" TAB_VERB "%6.3" "-" COMPU_TAB_REF _CNV_S_2_Def_bit_ub_702 /end COMPU_METHOD
/begin COMPU_VTAB _CNV_S_2_Def_bit_ub_702 "Def_bit_ub_2" TAB_VERB 2 0 "FALSE" 4 "TRUE" /end COMPU_VTAB
/begin COMPU_METHOD _CNV_S_2_Def_bit_ub_703_CM "Def_bit_ub_3" TAB_VERB "%6.3" "-" COMPU_TAB_REF _CNV_S_2_Def_bit_ub_703 /end COMPU_METHOD
/begin COMPU_VTAB _CNV_S_2_Def_bit_ub_703 "Def_bit_ub_3" TAB_VERB 2 0 "FALSE" 8 "TRUE" /end COMPU_VTAB
/begin COMPU_METHOD _CNV_S_2_Def_bit_ub_704_CM "Def_bit_ub_4" TAB_VERB "%6.3" "-" COMPU_TAB_REF _CNV_S_2_Def_bit_ub_704 /end COMPU_METHOD
/begin COMPU_VTAB _CNV_S_2_Def_bit_ub_704 "Def_bit_ub_4" TAB_VERB 2 0 "FALSE" 16 "TRUE" /end COMPU_VTAB
/begin COMPU_METHOD _CNV_S_2_Def_bit_ub_705_CM "Def_bit_ub_5" TAB_VERB "%6.3" "-" COMPU_TAB_REF _CNV_S_2_Def_bit_ub_705 /end COMPU_METHOD
/begin COMPU_VTAB _CNV_S_2_Def_bit_ub_705 "Def_bit_ub_5" TAB_VERB 2 0 "FALSE" 32 "TRUE" /end COMPU_VTAB
/begin COMPU_METHOD _CNV_S_2_Def_bit_ub_706_CM "Def_bit_ub_6" TAB_VERB "%6.3" "-" COMPU_TAB_REF _CNV_S_2_Def_bit_ub_706 /end COMPU_METHOD
/begin COMPU_VTAB _CNV_S_2_Def_bit_ub_706 "Def_bit_ub_6" TAB_VERB 2 0 "FALSE" 64 "TRUE" /end COMPU_VTAB
/begin COMPU_METHOD _CNV_S_2_Def_bit_ub_707_CM "Def_bit_ub_7" TAB_VERB "%6.3" "-" COMPU_TAB_REF _CNV_S_2_Def_bit_ub_707 /end COMPU_METHOD
/begin COMPU_VTAB _CNV_S_2_Def_bit_ub_707 "Def_bit_ub_7" TAB_VERB 2 0 "FALSE" 128 "TRUE" /end COMPU_VTAB
/begin COMPU_METHOD _CNV_S_2_Def_bit_uw_708_CM "Def_bit_uw_8" TAB_VERB "%6.3" "-" COMPU_TAB_REF _CNV_S_2_Def_bit_uw_708 /end COMPU_METHOD
/begin COMPU_VTAB _CNV_S_2_Def_bit_uw_708 "Def_bit_uw_8" TAB_VERB 2 0 "FALSE" 256 "TRUE" /end COMPU_VTAB
/begin COMPU_METHOD _CNV_S_2_Def_bit_uw_709_CM "Def_bit_uw_9" TAB_VERB "%6.3" "-" COMPU_TAB_REF _CNV_S_2_Def_bit_uw_709 /end COMPU_METHOD
/begin COMPU_VTAB _CNV_S_2_Def_bit_uw_709 "Def_bit_uw_9" TAB_VERB 2 0 "FALSE" 512 "TRUE" /end COMPU_VTAB
/begin COMPU_METHOD _CNV_R_R_Def_ti_uw__721_CM "Def_ti_uw_q0p0128" RAT_FUNC "%6.3" "ms" COEFFS 0. 78.125 0. 0. 0. 1. /end COMPU_METHOD
/begin COMPU_METHOD _CNV_R_R_Def_u_uw_q_731_CM "Def_u_uw_q0p1" RAT_FUNC "%6.3" "V" COEFFS 0. 10. 0. 0. 0. 1. /end COMPU_METHOD
/begin COMPU_METHOD _CNV_R_R_Def_u_sw_b_732_CM "Def_u_sw_b128" RAT_FUNC "%6.3" "V" COEFFS 0. 256. 0. 0. 0. 1. /end COMPU_METHOD
/begin COMPU_METHOD _CNV_R_R_Def_u_uw_q_734_CM "Def_u_uw_q0p00488" RAT_FUNC "%6.3" "V" COEFFS 0. 1024. 0. 0. 0. 5. /end COMPU_METHOD
/begin COMPU_METHOD _CNV_R_R_Def_v_uw_q_737_CM "Def_v_uw_q1p0" RAT_FUNC "%6.3" "km/h" COEFFS 0. 1. 0. 0. 0. 1. /end COMPU_METHOD
/begin COMPU_METHOD _CNV_R_R_Def_v_uw_q_738_CM "Def_v_uw_q0p1" RAT_FUNC "%6.3" "km/h" COEFFS 0. 10. 0. 0. 0. 1. /end COMPU_METHOD
/begin COMPU_METHOD _CNV_R_R_Def_kw_uw__741_CM "Def_kw_uw_q0p8_o128" RAT_FUNC "%6.3" "°KW" COEFFS 0. 1. 128. 0. 0. 0.8 /end COMPU_METHOD
/begin COMPU_METHOD _CNV_S_4_Def_schalt_779_CM "Def_schalt_hinweis" TAB_VERB "%6.3" "-" COMPU_TAB_REF _CNV_S_4_Def_schalt_779 /end COMPU_METHOD
/begin COMPU_VTAB _CNV_S_4_Def_schalt_779 "Def_schalt_hinweis" TAB_VERB 4 0 "Vorgabe deaktiviert" 1 "Hochschalthinweis" 2 "Rueckschalthinweis" 3 "Kein Schalthinweis" /end COMPU_VTAB
/begin RECORD_LAYOUT _REC_VAL_20_u1 FNC_VALUES 1 UBYTE COLUMN_DIR DIRECT /end RECORD_LAYOUT
/begin RECORD_LAYOUT _REC_VAL_20_u2 FNC_VALUES 1 UWORD COLUMN_DIR DIRECT /end RECORD_LAYOUT
/begin RECORD_LAYOUT _REC_VAL_20_s2 FNC_VALUES 1 SWORD COLUMN_DIR DIRECT /end RECORD_LAYOUT
/begin RECORD_LAYOUT _REC_MAP_52_u1_s2_s2 NO_AXIS_PTS_X 1 UBYTE NO_AXIS_PTS_Y 2 UBYTE AXIS_PTS_X 3 SWORD INDEX_INCR DIRECT AXIS_PTS_Y 4 SWORD INDEX_INCR DIRECT FNC_VALUES 5 UBYTE COLUMN_DIR DIRECT /end RECORD_LAYOUT
/begin RECORD_LAYOUT _REC_MAP_52_UBYTE_s2_u2_s2 NO_AXIS_PTS_X 1 UBYTE NO_AXIS_PTS_Y 2 UBYTE AXIS_PTS_X 3 UWORD INDEX_INCR DIRECT AXIS_PTS_Y 4 SWORD INDEX_INCR DIRECT FNC_VALUES 5 SWORD COLUMN_DIR DIRECT /end RECORD_LAYOUT
/begin RECORD_LAYOUT _REC_MAP_52_u1_u1_s2 NO_AXIS_PTS_X 1 UBYTE NO_AXIS_PTS_Y 2 UBYTE AXIS_PTS_X 3 UBYTE INDEX_INCR DIRECT AXIS_PTS_Y 4 SWORD INDEX_INCR DIRECT FNC_VALUES 5 UBYTE COLUMN_DIR DIRECT /end RECORD_LAYOUT
/begin RECORD_LAYOUT _REC_MAP_52_u1_s2_u2 NO_AXIS_PTS_X 1 UBYTE NO_AXIS_PTS_Y 2 UBYTE AXIS_PTS_X 3 SWORD INDEX_INCR DIRECT AXIS_PTS_Y 4 UWORD INDEX_INCR DIRECT FNC_VALUES 5 UBYTE COLUMN_DIR DIRECT /end RECORD_LAYOUT
/begin RECORD_LAYOUT _REC_CUR_TKL_UW_VV__u2_u2 NO_AXIS_PTS_X 1 UBYTE RESERVED 2 BYTE AXIS_PTS_X 3 UWORD INDEX_INCR DIRECT FNC_VALUES 4 UWORD COLUMN_DIR DIRECT /end RECORD_LAYOUT
/begin RECORD_LAYOUT _REC_CUR_TKL_UW_VV__u1_s2 NO_AXIS_PTS_X 1 UBYTE RESERVED 2 BYTE AXIS_PTS_X 3 SWORD INDEX_INCR DIRECT FNC_VALUES 4 UBYTE COLUMN_DIR DIRECT /end RECORD_LAYOUT
/begin RECORD_LAYOUT _REC_CUR_TKL_UW_VV__s2_s2 NO_AXIS_PTS_X 1 UBYTE RESERVED 2 BYTE AXIS_PTS_X 3 SWORD INDEX_INCR DIRECT FNC_VALUES 4 SWORD COLUMN_DIR DIRECT /end RECORD_LAYOUT
/begin RECORD_LAYOUT _REC_CUR_TKL_UW_VV__S4_S4 NO_AXIS_PTS_X 1 UBYTE RESERVED 2 BYTE AXIS_PTS_X 3 FLOAT32_IEEE INDEX_INCR DIRECT FNC_VALUES 4 FLOAT32_IEEE COLUMN_DIR DIRECT /end RECORD_LAYOUT
/begin RECORD_LAYOUT _REC_CUR_TKL_UW_VV__s1_u1 NO_AXIS_PTS_X 1 UBYTE RESERVED 2 BYTE AXIS_PTS_X 3 UBYTE INDEX_INCR DIRECT FNC_VALUES 4 SBYTE COLUMN_DIR DIRECT /end RECORD_LAYOUT
/begin FUNCTION LAYER ""
 /begin OUT_MEASUREMENT A_quer Acfzgl Acfzgq Agrpos Ba_ist_ewp Batt_class Batt_coort Bordnetz Bosbtvfbkt Bosfxid2r Bosid2r Bosjzielr Bosjzielt Bosmzielr Bosmzielt Bosprog2r Bosprog2t Bosrlsmr Bosrlsmt Bosrw2r Bosrw2t Bosv Bsdcontrol Bsddata Bsdgencv Bsdgenregv Bsdregadr Ctr_genms D_la_sa1 D_la_sa2 Dfgrob Dfsiggen Disa_ist Dlahi1 Dlahi2 Dpsr Dpsr_seg Drfkh_s Dwesb3_kh_s Dwese2_kh_h Dzw_agr_kor Dzw_kh_s Dzw_kr Dzw_mkr Dzw_mkrad Eta_lambda_bas Eta_zw_ist1 Eta_zw_ist2 Eta_zw_min Eta_zw_mint Eta_zw_ve Eta_zwve_m Eta_zyl_aus Eta_zylaus_sp Eta_zylausbas Ewp_manufak Ewp_typkenn F_lakor1 F_lakor2 F_nox_alter F_rk_ad1 F_rk_ad2 F_roz_ad F_start F_tizyl F_uevns_kh F_vst Fahrzeug Fho Ftbr Gangi Gen_manufak Gen_typkenn I_eff_gs I_ewp Id_bosrst Id_bosrtt Id_bosrtw Ierr Ierr_grenz_ext Ierrfgrenz Ikurz_ogr Ikurz_ugr Iwakeupgr Km_st Km_st_1 Km_st_old Kvaverbr L_pwmout La_bszuli1 La_bszuli2 La_desu1 La_desu2 La_desu_kh1 La_desu_kh2 La_es La_ist_1 La_ist_2 La_kh1 La_kh2 La_pruef1 La_pruef2 La_puls1 La_puls2 La_rgn1 La_rgn2 La_rgn_rpu1 La_rgn_rpu2 Lam_son1 Lam_son2 Lur Md_anfhi Md_getriebe Md_na_ac Md_na_ars Md_na_defrost Md_na_el Md_na_ewapu Md_na_ext Md_na_mlad Md_na_sl Md_na_sls Md_na_thermo Md_rad_soll Md_res_anfhi Mdi_accl_plus Mdi_accs_plus Mdi_asr_l Mdi_asr_s Mdi_bas Mdi_gsl_minus Mdi_gsl_plus Mdi_gss_minus Mdi_gss_plus Mdi_katschutz Mdi_llri Mdi_llrp Mdi_llrzw Mdi_msr_l Mdi_msr_s Mdi_nmax Mdi_opt_kor Mdi_pmax Mdi_reib Mdi_res_ac Mdi_res_afs Mdi_res_gs Mdi_res_heiz Mdi_res_kh Mdi_res_llmn Mdi_res_llmx Mdi_res_sl Mdi_res_st Mdi_res_tev Mdi_siko_l Mdi_siko_s Mdi_smgl_minus Mdi_smgl_plus Mdi_smgs_minus Mdi_smgs_plus Mdi_vmax Mdk_ist Mdk_min Mdr_wunsch Ms_sl Msbkvup Mshfm_ist Mshfm_m Mslui Mste N_idlms N_pmstart N_zylab1 N_zylab2 Nelueft_klima Nelueft_lenk Newp_dif Newp_ist Nkw Nkw_disa_1 Nkw_disa_2 Nkw_grad Nkw_soll Nkw_zahn Nmax_var Nsll_kh Nsllm Nstat Nturb Nwa1_pos Nwa1_time Nwe Nwe1_pos Nwe1_time Oz_datstat Oz_lf1c Oz_lf2c Oz_nivr Oz_permr Oz_resetr Oz_status Oz_tempr P_oel_ist P_oelsol_tst P_rail_kh Pbrems Pe_ist_ewp Pmsv Prail_ist Prio_katman1 Prio_katman2 Ps_abs Pu Pvagr Pvdkds Pvld1 Pvld2 Pwg_ist Pwg_max Qs_anf_klima Rk2_kh_h Rk3_kh_s Rk_1 Rk_2 Rk_add_ad1 Rk_add_ad2 Rk_nz_ist Rk_vz_ist Rktev Segakt St_agr St_agr.B_agr_ktrl St_anf_prail St_anf_prail.B_aprail_hom St_anf_prail.B_aprail_ndnotl St_anf_prail.B_prail_h St_anf_prail.B_prailvcv_h St_anf_prail.B_prailvfd_h St_anman1 St_anman1.B_ldm_ena St_anman1.B_ldm_nofil St_anman1.B_nosa St_ba St_ba.B_vb_hmm St_ba.B_vb_sch St_bls St_bls.B_bls St_blsdisa1 St_blsdisa1.B_disa_akt St_bsd St_btvns St_btvns.B_btvsa St_btvns.B_btvse St_ckl15 St_ckl15.B_ckl30 St_ckl15.B_ckl50 St_ckl15.B_cklr St_clc St_clc.B_hmm_clc St_clc.B_sch_clc St_cybl St_cybl.B_gl_ad St_cybl.B_gl_adder St_cybl.B_gl_adz St_cybl.B_gl_faker St_cybl.B_gl_hz St_cybl.B_gl_wg1 St_cybl.B_gl_wg2 St_cybl.B_gl_zsk St_cybl.B_gl_zsw St_cybl.B_gl_zswz St_ddss St_ddss.B_bkddss St_ddss.B_bkpddss St_desul St_desul.B_desu_fett St_desul.B_desu_puls St_desul.B_desul_akt St_devxdetec St_devxdetec.B_dev0detec St_devxdetec.B_dev1detec St_devxdetec.B_dev2detec St_devxdetec.B_dev3detec St_devxdetec.B_dev4detec St_devxdetec.B_dev5detec St_devxdetec.B_dev6detec St_devxdetec.B_dev7detec St_dk_diag St_dk_diag.B_dkerr_2pot St_dk_diag.B_nlf St_dk_diag.B_ska St_dk_notl St_dkratio St_dkratio.B_dkratio_h St_dtev St_dtev.B_dtev_aktiv St_egs St_egs.B_egs_khl1 St_egs.B_egs_khl2 St_egs.B_fs St_ekp St_ekp.B_dkpu St_elu St_elu.B_elu600 St_ewp St_ewp.B_ewp_dblk St_ewp.B_ewp_noff St_fdc St_fdc.B_sport St_fgr St_fgr.B_fgr_akt St_fzg_1 St_fzg_2 St_fzg_ass St_gen_ext St_gen_ext.B_gen_ext St_gen_ext.B_ierr_ext St_gen_ext.B_loadre_ext St_genallg St_genallg.B_abliactiv St_genallg.B_bsdprot1 St_genallg.B_bsdprot2 St_genallg.B_iliactiv St_genallg.B_rd_gentyp St_generator St_generator.B_crashgen St_generator.B_genactiv St_generator.B_genfbsd St_generator.B_genfel St_generator.B_genfht St_generator.B_genfme St_genll St_genll.B_lrfoff St_genll.B_lrreg1ak St_getriebe St_getriebe.B_autget St_gglsu2 St_gglsu2.B_sbblsu St_gglsu2.B_sbblsu2 St_gw St_gw.B_gw St_ibs St_ibs.B_ibsdetec St_inf St_inf.B_inf St_instr3_1 St_kath St_kath.B_hsplit_kh St_kath.B_kh St_kath.B_nesps_kh St_kath.B_nlast_kh St_kath.B_nst_kh St_kath.B_so2p_kh St_kath.B_zw_kh St_kath_anf1 St_kath_anf1.B_akh_h1 St_kath_anf1.B_akh_nesps1 St_kath_anf1.B_akh_splith1 St_kath_anf2 St_kath_anf2.B_akh_h2 St_kath_anf2.B_akh_nesps2 St_kath_anf2.B_akh_splith2 St_katueb St_katueb.B_kathom St_katueb.B_nk_hom St_katueb.B_rgnkat St_katueb.B_rgnkat_hla1 St_kh_allg St_kh_allg.B_ess_kh St_kh_allg.B_la_kh St_kh_allg.B_md_kh St_kh_vanons St_kh_vanons.B_vanos_kh St_kl15 St_kl15.B_kl15_ep St_kl15.B_kl15_vorab St_klopfen St_klopfen.B_klopfen St_kr St_kr.B_clradkr St_kr.B_krdws St_kr.B_krndy St_kr.B_zwkraa St_kr1 St_kr1.B_krakt St_ksdiag St_ksdiag.B_tstkvs St_kupp_smg St_la_rpu St_la_rpu.B_largnrpu1 St_la_rpu.B_largnrpu2 St_la_rpu.B_noxrpu St_lareg St_lareg.B_lrr St_lareg.B_lrr2 St_lklps St_ll St_ll.B_llr_on St_llr St_llr.B_llrein St_mdpruef St_mdpruef.B_mdpruef St_mdpruef.B_mdpruef_akt St_mkwchn St_mkwchn.B_kwdreht St_motzustd St_motzustd.B_ll_roh St_motzustd.B_vl St_nachlauf St_nachlauf.B_nachlauf St_nst St_nst.B_nst St_nwf St_nwf.B_nwa1flanke St_nwf.B_nwe1flanke St_oz St_oz.B_anhang St_oz.B_ozfbsd St_oz_i St_oz_i.B_td_og St_oz_i.B_td_ogok St_oz_i.B_toel St_pmbnstab St_pmbnstab.B_nachlend St_pmi St_pmi.B_fabttreg St_pmi.B_fahisrst St_pmi_nv St_pmi_nv.B_fapmmess St_pmi_nv.B_ulcp St_poelreg1 St_poelreg1.B_poelsoltst St_pruef St_pruef.B_pruef1 St_pruef.B_pruef2 St_ptc_pwr St_pwf St_pwf.B_pwf St_sawe St_sawe.B_sa St_sawe.B_sae St_sk St_sk.B_sk_homla1 St_slp St_slp.B_fasls St_slp.B_genslp St_sls St_sls.B_sls St_start St_start.B_sta St_start.B_start St_start.B_startende St_start.B_wst St_szboost St_szboost.B_fofu St_szboost.B_kath St_szboost.B_kath_sch St_szboost.B_warml St_tank St_tank.B_betankt St_tank.B_taleer St_tevanst St_tevanst.B_tev_zu St_tevein St_tevein.B_te St_tevein.B_te_la1 St_tevein.B_teblg St_tevein.B_tev_erf St_ti St_ti.B_dosp_akt St_tp St_tp.B_atm_tpvk St_tp.B_atm_tpvk1 St_tp.B_atm_tpvk2 St_tum St_tum.B_tumers St_vsa3 St_vsa3.B_vsaadpokext St_vse3 St_vse3.B_vseadpokext St_wk St_wm St_wm.B_hz St_wm.B_korel St_wm.B_lklps_kl1 St_wm.B_lklps_kl2 St_wm.B_nkmtemp St_zwbts St_zwbts.B_atm_tpnk1 St_zwbts.B_atm_tpnk2 St_zwbts.B_bsakt_zuli1 St_zwbts.B_bsakt_zuli2 St_zwktibs St_zwktibs.B_ibsactiv St_zylab St_zylab.B_zylab1 St_zylab.B_zylab2 Status_kwnot Status_kwnot.B_kwnotl T_jahr T_mdpruef T_monate T_tag Tabg_sens1 Tabg_sens2 Tans Tchip Td_f_ierr Td_og_cnt Td_og_icnt Td_og_tk Td_og_tr Td_og_tv Td_og_uplcnt Td_rdgenreg2 Tewp_el Tget Ti_1_homext Ti_2_homext Tka Tkat_mod Tlrfgen Tlrgen_ext Tmot Tmot_abstell Tmot_start Tn_abstell Tn_abstellm Tn_start_10 Toel_getr Toel_mdl Tsg Tumg Tumg_can Tv_av_heizkrist Tv_av_status Tv_kft_ext Tvld U_fgen U_gen_ext U_gen_slp U_gensollpm Ub Ulams_1 Ulams_2 Uregnom V V_can Vsa_adp_ext Vsa_btsoll Vsa_sprs_kh Vse_adp_ext Vse_btsoll Vse_sprs_kh W_ub Wdk_ist Wesb1kh_h Wese Zr_seg_nstart Zrbosr Zrbosrt Ztageabs Zw_kr_bas Zw_md Zw_min Zw_out Zw_out_mw Zw_ve Zyl_akt /end OUT_MEASUREMENT
/end FUNCTION
/begin FUNCTION LBATTCAL ""
 /begin DEF_CHARACTERISTIC CW_BATTCOD KL_BATTLSTR KL_EXPALH KL_EXPALV KL_EXPBETAV KL_LADEKENNL K_APPTBATINI K_BATTHTAUVG K_BATTHTAUVK K_BATTORT0 K_BATTORT2 K_BATTVTAUVG K_BATTVTAUVK K_BATT_ALFAH K_BATT_ALFAV K_BATT_BETAV K_BATVFZGTAU K_DTANSKOR K_ILMINUMG K_LBATTMAXK K_LBATTMAXM K_LBATTMIN K_LBATTTUMG K_LBATTTUMGBA K_MCOBATTORT K_NMINUMG K_OFTUMGCAN K_OFULADE K_PLBATTUMG K_RLEITUNGK K_RLEITUNGM K_TBATINIMAN K_TBATTFTAUV K_TBATTTAUFH K_TIMERDLY K_TUMGINI K_TUMGTAU K_UBATTNORM K_UKOMPK K_UKOMPM K_ULADE_TAU K_VMINUMG S_LBATT1 S_LBATT2 S_LBATTAPPL /end DEF_CHARACTERISTIC
 /begin OUT_MEASUREMENT Batt_ort Batt_tfil St_lbattcal0 St_lbattcal0.B_dly_tbi St_lbattcal0.B_lbatteinih St_lbattcal0.B_lbatteiniv St_lbattcal0.B_lbattenh St_lbattcal0.B_lbattenv St_lbattcal0.B_lbattinit T_batstiniv T_batt_ini T_batt_lb T_batt_zw T_batt_zw2 T_batt_zw3 T_battabst Tumg_abst Tumg_battab Tumg_dt Tumg_ers Tumg_tp U_gensollm U_kompk U_kompm U_lade /end OUT_MEASUREMENT
/end FUNCTION
/begin FUNCTION LDSTGEN ""
 /begin DEF_CHARACTERISTIC KL_GENLDST K_APPUPLLDST K_DFMODE K_DFS_MAX K_DFS_MIN K_DFS_MITT K_GENLDDFMAX K_IERRFIL K_TNNSTART K_UB_GRENZST S_PMSTRTMOD S_STRTNKWMOD /end DEF_CHARACTERISTIC
 /begin OUT_MEASUREMENT Dffgen Dfmonitor Dfpropval Dfsumme Dfwanzahl Ierr_fil N_nstart St_bldstg St_bldstg.B_ubeb_start St_ldstgen Ub_old_st /end OUT_MEASUREMENT
/end FUNCTION
/begin FUNCTION LLPMCTRL ""
 /begin DEF_CHARACTERISTIC K_DFLLMIN K_DFMAX K_DSOCHYST K_DSOCLLANH K_LLANHAPP K_LLPMAPP K_NLLMIN S_N_IDLIBS /end DEF_CHARACTERISTIC
 /begin OUT_MEASUREMENT N_idlibs /end OUT_MEASUREMENT
/end FUNCTION
/begin FUNCTION LLRANH "" /begin DEF_CHARACTERISTIC K_APP_LLAH K_GENLLAHAPP K_NSUBO K_NSUBU /end DEF_CHARACTERISTIC
 /begin OUT_MEASUREMENT Nslb St_llranh0 St_llranh0.B_idl_tp St_llranh0.B_idlgspec St_llranh0.B_nsub /end OUT_MEASUREMENT
/end FUNCTION
/begin FUNCTION LOADRESP ""
 /begin DEF_CHARACTERISTIC CW_BNS_LR KF_LORESP KF_LRMAXG KF_ZLRESOF KF_ZLRRESOFV KL_LORESPM K_APPLROFF K_BGAPP K_DMDGEN_SCHMN K_DMDGEN_SCHMX K_DSOCMIN K_ENAPPLGOFF K_ENAPPLRESP K_FHOGNMN K_LRBNS K_LRESPAPP K_MDGNHYS K_MDGNMAX K_MGMAXAPP K_NGENOFMN K_NGENOFMX K_NKW_SCH K_NMXGENOF K_RLMXGENOF K_TABSTGNMN K_TABSTGNMX K_TATMGENOF K_TDMDGEN_VERZAUS K_TDMDGEN_VERZEIN K_TGENOFMN K_TGENOFMX K_TGENOFVL K_TLORESPST K_TMOTABGNMN K_TUMGGNMN K_TUMGGNMX K_TVLOFHYST K_VGENOFMN K_VGENOGMX K_VZLORESOFV S_LORESLL S_MGAPP S_SAPP S_TLACTIV /end DEF_CHARACTERISTIC
 /begin OUT_MEASUREMENT Loadresp Md_grenz St_dmdblock St_dmdblock.B_dmd_frei St_dmdblock.B_timmax St_dmdblock.B_timmin St_loadresp St_loadresp.B_lroff St_loadresp.B_lroff2 St_loadresp0 St_loadresp0.B_fub St_loadresp0.B_genoffmd St_loadresp0.B_genoffst St_loadresp10ms St_loadresp10ms.B_mdgrenz St_loadresp_nv0 St_loadresp_nv0.B_genoffvl Tlrgen Tlrgen2 Z_dmdblock /end OUT_MEASUREMENT
/end FUNCTION
/begin FUNCTION LOLIMOT "" /begin DEF_CHARACTERISTIC KL_E_FUNKTION /end DEF_CHARACTERISTIC /end FUNCTION
/begin FUNCTION MDANMAN ""
 /begin DEF_CHARACTERISTIC KF_MDR_ABV KL_MDMAX KL_NMAXGRAD_KUP K_ETA_GETR K_IEFFGS_KFS K_IEFF_GSMN K_IEFF_GSMX K_I_1GANG K_I_1GANGAT K_I_HA K_I_HAAT K_I_LGANG K_I_LGANGAT K_LDM_BREMST K_NAB_MN K_NKW_PEMAX K_NMAX_WARN K_NMIN_LDMAUS K_NMIN_WARN K_R_DYN K_R_DYNLDM K_SCHALT_KOMB K_TDHSCHALT K_TDKEIN_GANG K_TDRSCHALT K_TD_KUPPEXT K_TD_LDMAUS K_TD_LDMAUS1 K_T_ENTPRGANG K_V2NAB K_ZK_NKWGRAD S_GANGWECHSEL_AN S_IEFF_GS S_IPM_06 S_IPM_BSPORT S_IPM_HS S_LDMAUSHS_AKT S_LDMAUSRS_AKT S_LDMBREMS_AUS /end DEF_CHARACTERISTIC
 /begin OUT_MEASUREMENT Gangi_alt Gangi_buf Gangi_entpr Gangi_entpr_alt I_eff I_ges I_ges_at I_ges_hs I_opt Md_ab_max Md_ab_min Md_ab_wunsch Md_rad_ist Md_rad_ksoll Md_rad_max Md_rad_min Md_rad_minti Md_rad_wunsch Mdi_minti Mdk_wunsch_ipm Mdk_wunsch_rad Mdr_ab_max Mdr_ab_virt Mdr_ab_wunsch N_ab Nkw_grad_fpt1 Nkw_opt Nmax_hschalt Nmin_hschalt St_anman St_anman.B_2fl_gangi St_anman.B_antieb St_anman.B_antieb_starr St_anman.B_kein_gang St_anman.B_kupp_int St_anman.B_ldm_bremst St_anman.B_ldm_mdrad St_ldm_kupp T_entpr_gang Td_kein_gang Td_kupp_ext Td_ldm_aus Td_ldm_aus1 Tdhschalt Tdrschalt Var_hs Var_ldm Var_smg /end OUT_MEASUREMENT
/end FUNCTION
/end MODULE
/end PROJECT
