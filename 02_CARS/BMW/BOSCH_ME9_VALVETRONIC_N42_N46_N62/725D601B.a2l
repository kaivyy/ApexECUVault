ASAP2_VERSION 1 3
/begin PROJECT _725D601B "725D601B"
/begin HEADER "" VERSION "_725D601B" PROJECT_NO _725D601B /end HEADER
/begin MODULE DIM ""
/begin MOD_COMMON "" BYTE_ORDER MSB_FIRST ALIGNMENT_BYTE 1 ALIGNMENT_WORD 2 ALIGNMENT_LONG 2 ALIGNMENT_FLOAT32_IEEE 4 /end MOD_COMMON
/begin CHARACTERISTIC ABKORROVER "" VALUE 0xFCC138 KwWU16 262.140 fak_q0p004_o100 -100.000 162.140 /end CHARACTERISTIC
/begin CHARACTERISTIC AESNLP "Anzahl Entprellsynchros Notlauf Phasengeber" VALUE 0xFCFA34 KwWU8 255.0 dez 0.00 255.0 FORMAT "%5.1" /end CHARACTERISTIC
/begin CHARACTERISTIC ANZEAUS "Anzahl der auszublendenden Einspritzungen" VALUE 0xFCFA35 KwWU8 255.0 dez 0.00 255.0 FORMAT "%5.1" /end CHARACTERISTIC
/begin CHARACTERISTIC ANZMDM "Anzahl more detected misfires" VALUE 0xFC1DFB KwWU8 3.000 dez 0.00 3.000 FORMAT "%5.3" /end CHARACTERISTIC
/begin CHARACTERISTIC BATTINDAPP "" VALUE 0xFCC154 KwWU8 255.0 DEZ 0.00 255.0 FORMAT "%5.1" /end CHARACTERISTIC
/begin CHARACTERISTIC BATTREGAPP "" VALUE 0xFCC155 KwWU8 255.0 DEZ 0.00 255.0 FORMAT "%5.1" /end CHARACTERISTIC
/begin CHARACTERISTIC BNSCLRAPP "" VALUE 0xFCC10E KwWU8 255.0 DEZ 0.00 255.0 FORMAT "%5.1" /end CHARACTERISTIC
/begin CHARACTERISTIC BNSMAX "" VALUE 0xFCC10F KwWU8 255.0 DEZ 0.00 255.0 FORMAT "%5.1" /end CHARACTERISTIC
/begin CHARACTERISTIC BNS_CTRINC "" VALUE 0xFCC110 KwWU8 255.0 DEZ 0.00 255.0 FORMAT "%5.1" /end CHARACTERISTIC
/begin CHARACTERISTIC BNS_SCHW1 "" VALUE 0xFCC111 KwWU8 255.0 DEZ 0.00 255.0 FORMAT "%5.1" /end CHARACTERISTIC
/begin CHARACTERISTIC BNS_UBMAX "" VALUE 0xFCC112 KwWU8 24.02 spg_ubatt 0.00 24.02 FORMAT "%5.2" /end CHARACTERISTIC
/begin CHARACTERISTIC BNS_UBMIN "" VALUE 0xFCC113 KwWU8 24.02 spg_ubatt 0.00 24.02 FORMAT "%5.2" /end CHARACTERISTIC
/begin CHARACTERISTIC BNS_VFZG "" VALUE 0xFCC114 KwWU8 318.8 vfzg_ub_q1p25 0.00 318.8 FORMAT "%5.1" /end CHARACTERISTIC
/begin CHARACTERISTIC CBATTAPP "Untere Kurzschlussgrenze" VALUE 0xFCC156 KwWU8 255.000 cbatt_ub_b1 0.00 255.000 /end CHARACTERISTIC
/begin CHARACTERISTIC CCMELDMASK "" VALUE 0xFCC157 KwWU8 255.0 DEZ 0.00 255.0 FORMAT "%5.1" /end CHARACTERISTIC
/begin CHARACTERISTIC CCPRIOSET "" VALUE 0xFCC158 KwWU8 7.000 DEZ 0.00 7.000 FORMAT "%5.3" /end CHARACTERISTIC
/begin CHARACTERISTIC CCPRIOTIME "" VALUE 0xFCC159 KwWU8 25.50 t_q0p1 0.00 25.50 FORMAT "%5.2" /end CHARACTERISTIC
/begin CHARACTERISTIC CCPWRSET "" VALUE 0xFCC13A KwWU16 65535.00 DEZ 0.00 65535.00 FORMAT "%8.2" /end CHARACTERISTIC
/begin CHARACTERISTIC CLASS2IND "" CURVE 0xFCC116 KlAxU8SstxU8WU8 255.0 DEZ 0.00 255.0 FORMAT "%5.1"
 /begin AXIS_DESCR STD_AXIS batt_class dez 8 0.00 255.0 FORMAT "%5.1" DEPOSIT ABSOLUTE /end AXIS_DESCR
/end CHARACTERISTIC
/begin CHARACTERISTIC CLASS2NENN "" CURVE 0xFCC127 KlAxU8SstxU8WU8 255.000 cbatt_ub_b1 0.00 255.000
 /begin AXIS_DESCR STD_AXIS batt_class dez 8 0.00 255.0 FORMAT "%5.1" DEPOSIT ABSOLUTE /end AXIS_DESCR
/end CHARACTERISTIC
/begin CHARACTERISTIC CNFMDVER "Codewort zur Konfiguration von MDVER" VALUE 0xFD32D8 KwUb 255.0 dez 0.00 255.0 FORMAT "%5.1" /end CHARACTERISTIC
/begin CHARACTERISTIC CNFMDWAN "Codewort f¸r die Einberechnung von MDWAN in der LLR" VALUE 0xFC8D95 KwUb 255.0 dez 0.00 255.0 FORMAT "%5.1" /end CHARACTERISTIC
/begin CHARACTERISTIC CWADBGL "Codewort zum Vergleich mit Bankabgleich" VALUE 0xFC5EB0 KwWU8 255.0 dez 0.00 255.0 FORMAT "%5.1" /end CHARACTERISTIC
/begin CHARACTERISTIC CWMDSL "" VALUE 0xFD3348 KwUb 255.0 dez 0.00 255.0 FORMAT "%5.1" /end CHARACTERISTIC
/begin CHARACTERISTIC CWMDZUL "Codewort in MDZUL f¸r die Momentenbegrenzung" VALUE 0xFCA084 KwUb 255.0 dez 0.00 255.0 FORMAT "%5.1" /end CHARACTERISTIC
/begin CHARACTERISTIC CWNLPH "Freigabe der jeweiligen Phasengebernotlauffunktion" VALUE 0xFC1DFC KwWU8 255.0 dez 0.00 255.0 FORMAT "%5.1" /end CHARACTERISTIC
/begin CHARACTERISTIC CWNWREF "Nockenwellenverhalten im Start" VALUE 0xFC1DF4 KwWU8 255.0 dez 0.00 255.0 FORMAT "%5.1" /end CHARACTERISTIC
/begin CHARACTERISTIC CWVEELUE "Variantenerkennung E-L¸fter" VALUE 0xFD5568 KwUb 255.0 dez 0.00 255.0 FORMAT "%5.1" /end CHARACTERISTIC
/begin CHARACTERISTIC CW_MAXCTR "L‰nge des Diagnose-PWM-Signals" VALUE 0xFD5569 KwUb 255.0 dez 0.00 255.0 FORMAT "%5.1" /end CHARACTERISTIC
/begin CHARACTERISTIC CW_OZ "Codewort zum Freischalten der OZS-Funktionalit‰t (Bit 0 = true)" VALUE 0xFD4066 KwWU16 65535.00 DEZ 0.00 65535.00 FORMAT "%8.2" /end CHARACTERISTIC
/begin CHARACTERISTIC DELTAGVMX "Maximalwert f¸r gefiltertes deltagvfi" VALUE 0xFC5E84 KwWS16 127.9980 fak_sw_b64 -64.00000 63.99805 FORMAT "%8.5" /end CHARACTERISTIC
/begin CHARACTERISTIC DMADFK "Maximal adaptierbares Delta-Verlustmoment pro Adaptionsphase Fahrst.+Kompr." VALUE 0xFD332A KwUb 24.90 rel_ub_b24p9 0.00 24.90 FORMAT "%5.2" /end CHARACTERISTIC
/begin CHARACTERISTIC DMADFS "Maximal adaptierbares Delta-Verlustmoment pro Adaptionsphase mit Fahrstufe ein" VALUE 0xFD332B KwUb 24.90 rel_ub_b24p9 0.00 24.90 FORMAT "%5.2" /end CHARACTERISTIC
/begin CHARACTERISTIC DMADKO "Maximal adaptierbares Delta-Verlustmoment pro Adaptionsphase Kompr.ein" VALUE 0xFD332C KwUb 24.90 rel_ub_b24p9 0.00 24.90 FORMAT "%5.2" /end CHARACTERISTIC
/begin CHARACTERISTIC DMADLL "Maximal adaptierbares Delta-Verlustmoment pro Adaptionsphase ohne Last" VALUE 0xFD332D KwUb 24.90 rel_ub_b24p9 0.00 24.90 FORMAT "%5.2" /end CHARACTERISTIC
/begin CHARACTERISTIC DMADMNFK "Minimal adaptierbares Delta-Verlustmoment Fahrstufe eingelegt + Kompressor ein" VALUE 0xFD332E KwUb 24.90 rel_ub_bn24p9 -24.90 0.00 FORMAT "%5.2" /end CHARACTERISTIC
/begin CHARACTERISTIC DMADMNFS "Minimal adaptierbares Delta-Verlustmoment Fahrstufe eingelegt" VALUE 0xFD332F KwUb 24.90 rel_ub_bn24p9 -24.90 0.00 FORMAT "%5.2" /end CHARACTERISTIC
/begin CHARACTERISTIC DMADMNKO "Minimal adaptierbares Delta-Verlustmoment Klimakompressor ein" VALUE 0xFD3330 KwUb 24.90 rel_ub_bn24p9 -24.90 0.00 FORMAT "%5.2" /end CHARACTERISTIC
/begin CHARACTERISTIC DMADMNLL "Minimal adaptierbares Delta-Verlustmoment ohne Last" VALUE 0xFD3331 KwUb 24.90 rel_ub_bn24p9 -24.90 0.00 FORMAT "%5.2" /end CHARACTERISTIC
/begin CHARACTERISTIC DMADMXFK "Maximal adaptierbares Delta-Verlustmoment Farstufe + Klimakompressor ein" VALUE 0xFD3332 KwUb 24.90 rel_ub_b24p9 0.00 24.90 FORMAT "%5.2" /end CHARACTERISTIC
/begin CHARACTERISTIC DMADMXFS "Maximal adaptierbares Delta-Verlustmoment Farstufe ein" VALUE 0xFD3333 KwUb 24.90 rel_ub_b24p9 0.00 24.90 FORMAT "%5.2" /end CHARACTERISTIC
/begin CHARACTERISTIC DMADMXKO "Maximal adaptierbares Delta-Verlustmoment Klimakompressor ein" VALUE 0xFD3334 KwUb 24.90 rel_ub_b24p9 0.00 24.90 FORMAT "%5.2" /end CHARACTERISTIC
/begin CHARACTERISTIC DMADMXLL "Maximal adaptierbares Delta-Verlustmoment ohne Last" VALUE 0xFD3335 KwUb 24.90 rel_ub_b24p9 0.00 24.90 FORMAT "%5.2" /end CHARACTERISTIC
/begin CHARACTERISTIC DMAUFN "Delta-Moment Aufregelung nach Drehmomenteingriff" CURVE 0xFD525A KlAUwSstUwWUw 99.99847 rel_uw_b100 0.00 99.99847 FORMAT "%8.5"
 /begin AXIS_DESCR STD_AXIS nmot_w nmot_uw_q0p25 8 0.00 16383.75 FORMAT "%8.2" DEPOSIT ABSOLUTE /end AXIS_DESCR
/end CHARACTERISTIC
/begin CHARACTERISTIC DMDKOE "Anfangswert Momentenfilter bei Klimakompressor Einschalten" CURVE 0xFD3349 KlAUbSstUbWUb 49.73 rel_ub_b49p725 0.00 49.73 FORMAT "%5.2"
 /begin AXIS_DESCR STD_AXIS nmot nmot_ub_q40 6 0.00 10200. FORMAT "%5.0" DEPOSIT ABSOLUTE /end AXIS_DESCR
/end CHARACTERISTIC
/begin CHARACTERISTIC DMDNSM "Delta Moment zur Nachstartkompensation" CURVE 0xFD32D9 KlAUbSstUbWUb 99.61 rel_ub_b99p6 0.00 99.61 FORMAT "%5.2"
 /begin AXIS_DESCR STD_AXIS tmot temp_ub_q0p75_o48 8 -48.00 143.3 FORMAT "%5.1" DEPOSIT ABSOLUTE /end AXIS_DESCR
/end CHARACTERISTIC
/begin CHARACTERISTIC DMDNSMVT "Delta Moment zur Nachstartkompensation (VVT)" CURVE 0xFD32EA KlAUbSstUbWUb 99.61 rel_ub_b99p6 0.00 99.61 FORMAT "%5.2"
 /begin AXIS_DESCR STD_AXIS tmot temp_ub_q0p75_o48 8 -48.00 143.3 FORMAT "%5.1" DEPOSIT ABSOLUTE /end AXIS_DESCR
/end CHARACTERISTIC
/begin CHARACTERISTIC DMDWHYS "Hysterese f¸r Bildung D-Anteil-Wandlermoment" VALUE 0xFC8D96 KwUb 99.61 rel_ub_b99p6 0.00 99.61 FORMAT "%5.2" /end CHARACTERISTIC
/begin CHARACTERISTIC DMDWM "D-Anteil Wandlermoment bei Einlegen der Fahrstufe" CURVE 0xFD33BC GklWUb 99.61 rel_ub_b99p6 0.00 99.61 FORMAT "%5.2"
 /begin AXIS_DESCR COM_AXIS tmot temp_ub_q0p75_o48 8 -48.00 143.3 FORMAT "%5.1" AXIS_PTS_REF STM08MDUB /end AXIS_DESCR
/end CHARACTERISTIC
/begin CHARACTERISTIC DMOFK "LLR Adaptionsoffset bei FK" VALUE 0xFD3338 KwSw 199.9969 rel_sw_b100 -100.0000 99.99695 FORMAT "%8.4" /end CHARACTERISTIC
/begin CHARACTERISTIC DMOFS "LLR Adaptionsoffset bei FS" VALUE 0xFD333A KwSw 199.9969 rel_sw_b100 -100.0000 99.99695 FORMAT "%8.4" /end CHARACTERISTIC
/begin CHARACTERISTIC DMOKO "LLR Adaptionsoffset bei KO" VALUE 0xFD333C KwSw 199.9969 rel_sw_b100 -100.0000 99.99695 FORMAT "%8.4" /end CHARACTERISTIC
/begin CHARACTERISTIC DMOLL "LLR Adaptionsoffset bei LL" VALUE 0xFD333E KwSw 199.9969 rel_sw_b100 -100.0000 99.99695 FORMAT "%8.4" /end CHARACTERISTIC
/begin CHARACTERISTIC DNHYOFFNMX "Drehzahlhysterese" VALUE 0xFD3E42 KwUw 16383.75 nmot_uw_q0p25 0.00 16383.75 FORMAT "%8.2" /end CHARACTERISTIC
/begin CHARACTERISTIC DNMAXHG "gangabh‰ngige Hystherese f¸r harte Drehzahlbegrenzung" CURVE 0xFCA20C GklWUw 16383.75 nmot_uw_q0p25 0.00 16383.75 FORMAT "%8.2"
 /begin AXIS_DESCR COM_AXIS gangi dez 8 0.00 255.0 FORMAT "%5.1" AXIS_PTS_REF SGA08MDUB /end AXIS_DESCR
/end CHARACTERISTIC
/begin CHARACTERISTIC DNMAXLR "Hysterese f¸r harte Drehzahlbegrenzung bei Low Range" VALUE 0xFD3E44 KwUw 16383.75 nmot_uw_q0p25 0.00 16383.75 FORMAT "%8.2" /end CHARACTERISTIC
/begin CHARACTERISTIC DNMXOFFTG "Delta Drehzahloffset f¸r NMAX-Korrektur" CURVE 0xFCA21C GklWUw 16383.75 nmot_uw_q0p25 0.00 16383.75 FORMAT "%8.2"
 /begin AXIS_DESCR COM_AXIS gangi dez 8 0.00 255.0 FORMAT "%5.1" AXIS_PTS_REF SGA08MDUB /end AXIS_DESCR
/end CHARACTERISTIC
/begin CHARACTERISTIC DSOCHYSTCC "" VALUE 0xFCC13C KwWU16 200.000 fak_q0p004_o100 -100.000 100.000 /end CHARACTERISTIC
/begin CHARACTERISTIC DSOCLOW "" VALUE 0xFCC13E KwWU16 200.000 fak_q0p004_o100 -100.000 100.000 /end CHARACTERISTIC
/begin CHARACTERISTIC DTANSTDEW "" VALUE 0xFC5EBA KwUb 141.8 temp_ub_q0p75_o48 0.00 141.8 FORMAT "%5.1" /end CHARACTERISTIC
/begin CHARACTERISTIC DTOLTDEW "" VALUE 0xFC5EBB KwUb 141.8 temp_ub_q0p75_o48 0.00 141.8 FORMAT "%5.1" /end CHARACTERISTIC
/begin CHARACTERISTIC DYNMXNL "Schwellwert f¸r Dynamikbewertung -> hohe Dynamik" VALUE 0xFC1DF0 KwWU16 40000.00 t5usxus_q5 0.00 40000.00 FORMAT "%8.2" /end CHARACTERISTIC
/begin CHARACTERISTIC DZWQ2DZW "Deltaz¸ndwinkel" CURVE 0xFCD9BE FklWSb 191.3 zw_sb_q0p75 -96.00 95.25 FORMAT "%5.2"
 /begin AXIS_DESCR FIX_AXIS dzwssq kwq_ub_q0p35576 201 0.00 71.15 FORMAT "%5.2" FIX_AXIS_PAR 0 0 201 /end AXIS_DESCR
/end CHARACTERISTIC
/begin CHARACTERISTIC DZWQ2DZWL "Deltaz¸ndwinkel unterer Bereich" CURVE 0xFCDA87 FklWSb 191.3 zw_sb_q0p75 -96.00 95.25 FORMAT "%5.2"
 /begin AXIS_DESCR FIX_AXIS dzwssql kwq_ub_q0p04447 64 0.00 2.802 FORMAT "%5.3" FIX_AXIS_PAR 0 0 64 /end AXIS_DESCR
/end CHARACTERISTIC
/begin CHARACTERISTIC EGSZWS "Temperaturschwelle Zwangsumschaltung" VALUE 0xFD0554 KwUw 49151.25 temp_ub_q0p75_o48 -48.00000 49103.25 FORMAT "%8.2" /end CHARACTERISTIC
/begin CHARACTERISTIC EGSZWS_1 "" VALUE 0xFD0556 KwUw 49151.25 temp_ub_q0p75_o48 -48.00000 49103.25 FORMAT "%8.2" /end CHARACTERISTIC
/begin CHARACTERISTIC FABMDKO "Anfangsfaktor Klimakompressor-Lastabregelung" VALUE 0xFD3356 KwUb 7.969 fak_ub_b8 0.00 7.969 FORMAT "%5.3" /end CHARACTERISTIC
/begin CHARACTERISTIC FABMDWA "Faktor zur Absteuerung des Wandlermoments abh‰ngig von nturb/nsol" CURVE 0xFC8D97 KlAUbSstUbWUb 0.9961 fak_ub_b1 0.00 0.9961
 /begin AXIS_DESCR STD_AXIS qntns fak_ub_b8 6 0.00 7.969 FORMAT "%5.3" DEPOSIT ABSOLUTE /end AXIS_DESCR
/end CHARACTERISTIC
/begin CHARACTERISTIC FDMDWAN "Wichtungsfaktor f¸r Einrechnung D-Anteil in Wandlermoment" VALUE 0xFC8DA4 KwUb 0.9961 fak_ub_b1 0.00 0.9961 /end CHARACTERISTIC
/begin CHARACTERISTIC FIRNLIGN "Mindestwert f¸r Winkelfehler nach der ersten Z¸ndung" VALUE 0xFC1DF5 KwWU8 255.0 kw_q1 0.00 255.0 FORMAT "%5.1" /end CHARACTERISTIC
/begin CHARACTERISTIC FMDWAT "Faktor zur Berechnung des Wandlermoments abh. von der ÷ltemperatur des Wandlers" CURVE 0xFD33C4 GklWUb 0.000119850000 fak_ub_q4p7Em7 0.00 0.000119850000 FORMAT "%14.12"
 /begin AXIS_DESCR COM_AXIS tmot temp_ub_q0p75_o48 8 -48.00 143.3 FORMAT "%5.1" AXIS_PTS_REF STM08MDUB /end AXIS_DESCR
/end CHARACTERISTIC
/begin CHARACTERISTIC FMLVFZG "Korrekturfaktor E-L¸fter-Tastverh‰ltnis aus vfzg" CURVE 0xFD556A KlAUbSstUbWUb 0.9961 fak_ub_b1 0.00 0.9961
 /begin AXIS_DESCR STD_AXIS vfzg vfzg_ub_q1p25 10 0.00 318.8 FORMAT "%5.1" DEPOSIT ABSOLUTE /end AXIS_DESCR
/end CHARACTERISTIC
/begin CHARACTERISTIC FNLMI0 "Bewertungsfaktor von tsegph(k) f¸r gleitenden Mittelwert" VALUE 0xFC1DF6 KwWU8 7.969 fak_ub_b8 0.00 7.969 FORMAT "%5.3" /end CHARACTERISTIC
/begin CHARACTERISTIC FNLMI1 "Bewertungsfaktor von tsegph(k-1) f¸r gleitenden Mittelwert" VALUE 0xFC1DF7 KwWU8 7.969 fak_ub_b8 0.00 7.969 FORMAT "%5.3" /end CHARACTERISTIC
/begin CHARACTERISTIC FNLMI2 "Bewertungsfaktor von tsegph(k-2) f¸r gleitenden Mittelwert" VALUE 0xFC1DF8 KwWU8 7.969 fak_ub_b8 0.00 7.969 FORMAT "%5.3" /end CHARACTERISTIC
/begin CHARACTERISTIC FNRAD "Faktor zwischen Raddrehzahl und Geschwindigkeit f(Radumfang)" VALUE 0xFC8DA5 KwUb 15.94 fak_ub_b16 0.00 15.94 FORMAT "%5.2" /end CHARACTERISTIC
/begin CHARACTERISTIC FVDMDWAN "Verst‰rkungsfaktor zur Bildung D-Ateil-Wandlermomnet" VALUE 0xFC8DA6 KwUb 7.969 fak_ub_b8 0.00 7.969 FORMAT "%5.3" /end CHARACTERISTIC
/begin CHARACTERISTIC GANGZWGS "Gangschwelle f¸r Zwangsumschaltung" VALUE 0xFD0542 KwUb 255.0 dez 0.00 255.0 FORMAT "%5.1" /end CHARACTERISTIC
/begin CHARACTERISTIC GANGZWGS_1 "" VALUE 0xFD0543 KwUb 255.0 dez 0.00 255.0 FORMAT "%5.1" /end CHARACTERISTIC
/begin CHARACTERISTIC GANGZWGS_2 "" VALUE 0xFD0544 KwUb 255.0 dez 0.00 255.0 FORMAT "%5.1" /end CHARACTERISTIC
/begin CHARACTERISTIC GANGZWGS_3 "" VALUE 0xFD0545 KwUb 255.0 dez 0.00 255.0 FORMAT "%5.1" /end CHARACTERISTIC
/begin CHARACTERISTIC GVRI "Zeitkonstante Integrator" VALUE 0xFC5E86 KwWU16 0.9999847 fak_uw_b1 0.00 0.9999847 FORMAT "%9.7" /end CHARACTERISTIC
/begin CHARACTERISTIC HISTDMERST "Manueller Reset d. Histogramm in der DME" VALUE 0xFCC15A KwWU8 255.0 DEZ 0.00 255.0 FORMAT "%5.1" /end CHARACTERISTIC
/begin CHARACTERISTIC HISTIBSRST "Manueller Histogramm Reset in IBS" VALUE 0xFCC15B KwWU8 255.0 DEZ 0.00 255.0 FORMAT "%5.1" /end CHARACTERISTIC
/begin CHARACTERISTIC HYSTEGSZWS "Hysteresetemperatur Zwangsumschaltung" VALUE 0xFD0558 KwUw 49151.25 temp_ub_b191p25 0.00 49151.25 FORMAT "%8.2" /end CHARACTERISTIC
/begin CHARACTERISTIC HYSTEGSZ_1 "" VALUE 0xFD055A KwUw 49151.25 temp_ub_b191p25 0.00 49151.25 FORMAT "%8.2" /end CHARACTERISTIC
/begin CHARACTERISTIC HYSTTMZS "" VALUE 0xFD0546 KwUb 191.3 temp_ub_b191p25 0.00 191.3 FORMAT "%5.1" /end CHARACTERISTIC
/begin CHARACTERISTIC HYSTTMZS_1 "" VALUE 0xFD0547 KwUb 191.3 temp_ub_b191p25 0.00 191.3 FORMAT "%5.1" /end CHARACTERISTIC
/begin CHARACTERISTIC HYSTVFZZWS "Fahrzeuggeschwindigkeits-Hysterese Zwangshochschaltung" VALUE 0xFD0548 KwUb 318.8 vfzg_ub_q1p25 0.00 318.8 FORMAT "%5.1" /end CHARACTERISTIC
/begin CHARACTERISTIC HYSTVFZZ_1 "" VALUE 0xFD0549 KwUb 318.8 vfzg_ub_q1p25 0.00 318.8 FORMAT "%5.1" /end CHARACTERISTIC
/begin CHARACTERISTIC HYSTVFZZ_2 "" VALUE 0xFD054A KwUb 318.8 vfzg_ub_q1p25 0.00 318.8 FORMAT "%5.1" /end CHARACTERISTIC
/begin CHARACTERISTIC HYSTVFZZ_3 "" VALUE 0xFD054B KwUb 318.8 vfzg_ub_q1p25 0.00 318.8 FORMAT "%5.1" /end CHARACTERISTIC
/begin CHARACTERISTIC IWAKEAPP "" VALUE 0xFCC15C KwWU8 0.255000 i_ub_q1p25em3 0.00 0.255000 FORMAT "%8.6" /end CHARACTERISTIC
/begin CHARACTERISTIC KFDMP "Kennfeld f¸r pedalabh‰ngigen Teil der Verlustmomente" MAP 0xFCA085 GkfWUb 99.61 rel_ub_b99p6 0.00 99.61 FORMAT "%5.2"
 /begin AXIS_DESCR COM_AXIS wped relPED_ub_b100 8 0.00 100.0 FORMAT "%5.1" AXIS_PTS_REF SWP08MFUB /end AXIS_DESCR
 /begin AXIS_DESCR COM_AXIS nmot nmot_ub_q40 8 0.00 10200. FORMAT "%5.0" AXIS_PTS_REF SNM08MFUB /end AXIS_DESCR
/end CHARACTERISTIC
/begin CHARACTERISTIC KFDMT "Kennfeld zur Ber¸cksichtigung temperaturabh‰ngiger Momente (Ebene 1)" MAP 0xFCA0C5 GkfWUb 99.61 rel_ub_b99p6 0.00 99.61 FORMAT "%5.2"
 /begin AXIS_DESCR COM_AXIS tmotmn temp_ub_q0p75_o48 8 -48.00 143.3 FORMAT "%5.1" AXIS_PTS_REF STM08MFUB /end AXIS_DESCR
 /begin AXIS_DESCR COM_AXIS nmot nmot_ub_q40 8 0.00 10200. FORMAT "%5.0" AXIS_PTS_REF SNM08MFUB /end AXIS_DESCR
/end CHARACTERISTIC
/begin CHARACTERISTIC KFMDGEN "Drehmomentenaufnahme Generator" MAP 0xFC8D2E KfAxU8AyU8SstxU16SstyU16WU16 1.999969 fak_uw_b2 0.00 1.999969 FORMAT "%8.6"
 /begin AXIS_DESCR STD_AXIS nmot_w nmot_uw_q0p25 6 0.00 16383.75 FORMAT "%8.2" DEPOSIT ABSOLUTE /end AXIS_DESCR
 /begin AXIS_DESCR STD_AXIS mdgenvfs_w rel_uw_b100 6 0.00 99.99847 FORMAT "%8.5" DEPOSIT ABSOLUTE /end AXIS_DESCR
/end CHARACTERISTIC
/begin CHARACTERISTIC KFMDKO "Drehmomentaufnahme Klimakompressor" MAP 0xFD3357 KfAxUbAyUbSstxUbSstyUbWUb 49.73 rel_ub_b49p725 0.00 49.73 FORMAT "%5.2"
 /begin AXIS_DESCR STD_AXIS nmot nmot_ub_q40 6 0.00 10200. FORMAT "%5.0" DEPOSIT ABSOLUTE /end AXIS_DESCR
 /begin AXIS_DESCR STD_AXIS kopwm rel_ub_b99p6 6 0.00 99.61 FORMAT "%5.2" DEPOSIT ABSOLUTE /end AXIS_DESCR
/end CHARACTERISTIC
/begin CHARACTERISTIC KFMDKOG "Drehmomentaufnahme geregelter Klimakompressor" MAP 0xFD3389 KfAxUbAyUbSstxUbSstyUbWUb 49.73 rel_ub_b49p725 0.00 49.73 FORMAT "%5.2"
 /begin AXIS_DESCR STD_AXIS nmot nmot_ub_q40 6 0.00 10200. FORMAT "%5.0" DEPOSIT ABSOLUTE /end AXIS_DESCR
 /begin AXIS_DESCR STD_AXIS mdkog md_ub_q1 6 0.00 255.0 FORMAT "%5.1" DEPOSIT ABSOLUTE /end AXIS_DESCR
/end CHARACTERISTIC
/begin CHARACTERISTIC KFMDS "Schleppmoment Drehzahl- und Lastabh‰ngigkeit" MAP 0xFC8B7E KfAxUwAyUwSstxUwSstyUwWUw 99.99847 rel_uw_b100 0.00 99.99847 FORMAT "%8.5"
 /begin AXIS_DESCR STD_AXIS nmot_w nmot_uw_q0p25 10 0.00 16383.75 FORMAT "%8.2" DEPOSIT ABSOLUTE /end AXIS_DESCR
 /begin AXIS_DESCR STD_AXIS rl_w rel_uw_q0p0234 12 0.00 1535.977 FORMAT "%8.3" DEPOSIT ABSOLUTE /end AXIS_DESCR
/end CHARACTERISTIC
/begin CHARACTERISTIC KFMDSM "Schleppmoment Temperaturanteil" MAP 0xFC8C9E KfAxUbAyUbSstxUbSstyUwWUw 99.99847 rel_uw_b100 0.00 99.99847 FORMAT "%8.5"
 /begin AXIS_DESCR STD_AXIS tmot temp_ub_q0p75_o48 6 -48.00 143.3 FORMAT "%5.1" DEPOSIT ABSOLUTE /end AXIS_DESCR
 /begin AXIS_DESCR STD_AXIS tol temp_ub_q0p75_o48 6 -48.00 143.3 FORMAT "%5.1" DEPOSIT ABSOLUTE /end AXIS_DESCR
/end CHARACTERISTIC
/begin CHARACTERISTIC KFMDWMX "Max. Begrenzung f¸r Drehmomentaufnahme des Wandlers" MAP 0xFC8DA7 KfAxUbAyUbSstxUbSstyUbWUb 99.61 rel_ub_b99p6 0.00 99.61 FORMAT "%5.2"
 /begin AXIS_DESCR STD_AXIS vfzg vfzg_ub_q1p25 6 0.00 318.8 FORMAT "%5.1" DEPOSIT ABSOLUTE /end AXIS_DESCR
 /begin AXIS_DESCR STD_AXIS tmot temp_ub_q0p75_o48 8 -48.00 143.3 FORMAT "%5.1" DEPOSIT ABSOLUTE /end AXIS_DESCR
/end CHARACTERISTIC
/begin CHARACTERISTIC KFMIRED1 "Kennfeld Abregelmoment f¸r NMAX Regelung" MAP 0xFD3E46 KfAxUbAyUbSstxUwSstyUbWUb 99.61 rel_ub_b99p6 0.00 99.61 FORMAT "%5.2"
 /begin AXIS_DESCR STD_AXIS miist_w rel_uw_b100 4 0.00 99.99847 FORMAT "%8.5" DEPOSIT ABSOLUTE /end AXIS_DESCR
 /begin AXIS_DESCR STD_AXIS gangi dez 6 0.00 255.0 FORMAT "%5.1" DEPOSIT ABSOLUTE /end AXIS_DESCR
/end CHARACTERISTIC
/begin CHARACTERISTIC KFMLSTGVF "Kennfeld f¸r Motorl¸ftersteuerung von Getriebetemperatur u Fahrzeuggeschwindigke" MAP 0xFD557F KfAxUbAyUbSstxUbSstyUbWUb 99.61 rel_ub_b100 0.00 99.61 FORMAT "%5.2"
 /begin AXIS_DESCR STD_AXIS tgetmls temp_ub_q0p75_o48 5 -48.00 143.3 FORMAT "%5.1" DEPOSIT ABSOLUTE /end AXIS_DESCR
 /begin AXIS_DESCR STD_AXIS vfzg vfzg_ub_q1p25 6 0.00 318.8 FORMAT "%5.1" DEPOSIT ABSOLUTE /end AXIS_DESCR
/end CHARACTERISTIC
/begin CHARACTERISTIC KFMOF "Kennfeld f¸r Offset-Toleranz in Abh‰ngigkeit vom zul‰ssigen Moment (Ebene 1)" MAP 0xFCA105 GkfWUb 99.61 rel_ub_b99p6 0.00 99.61 FORMAT "%5.2"
 /begin AXIS_DESCR COM_AXIS mizuvfil rel_ub_b99p6 8 0.00 99.61 FORMAT "%5.2" AXIS_PTS_REF SMO08MFUB /end AXIS_DESCR
 /begin AXIS_DESCR COM_AXIS nmot nmot_ub_q40 8 0.00 10200. FORMAT "%5.0" AXIS_PTS_REF SNM08MFUB /end AXIS_DESCR
/end CHARACTERISTIC
/begin CHARACTERISTIC KFMTOL1 "Kennfeld zu Initialisierung Modelltemperaturanteil aus tmot" MAP 0xFC2172 KfAxU8AyU8SstxU8SstyU8WU8 191.3 temp_ub_q0p75_o48 -48.00 143.3 FORMAT "%5.1"
 /begin AXIS_DESCR STD_AXIS m_tolab temp_ub_q0p75_o48 6 -48.00 143.3 FORMAT "%5.1" DEPOSIT ABSOLUTE /end AXIS_DESCR
 /begin AXIS_DESCR STD_AXIS abtim_b dez 6 0.00 255.0 FORMAT "%5.1" DEPOSIT ABSOLUTE /end AXIS_DESCR
/end CHARACTERISTIC
/begin CHARACTERISTIC KFMTOL2 "Kennfeld Filtereingang Modelltemperaturanteil aus n_mot und rl" MAP 0xFC21A4 KfAxU8AyU8SstxU8SstyU8WU8 191.3 temp_ub_q0p75_o48 -48.00 143.3 FORMAT "%5.1"
 /begin AXIS_DESCR STD_AXIS nmot nmot_ub_q40 6 0.00 10200. FORMAT "%5.0" DEPOSIT ABSOLUTE /end AXIS_DESCR
 /begin AXIS_DESCR STD_AXIS rl rel_ub_q0p75 6 0.00 191.3 FORMAT "%5.1" DEPOSIT ABSOLUTE /end AXIS_DESCR
/end CHARACTERISTIC
/begin CHARACTERISTIC KFMTOL3 "Kennfeld Filtereingang Modelltemperaturanteil aus tumg und vfz" MAP 0xFC21D6 KfAxU8AyU8SstxU8SstyU8WU8 191.3 temp_ub_q0p75_o48 -48.00 143.3 FORMAT "%5.1"
 /begin AXIS_DESCR STD_AXIS tumg temp_ub_q0p75_o48 6 -48.00 143.3 FORMAT "%5.1" DEPOSIT ABSOLUTE /end AXIS_DESCR
 /begin AXIS_DESCR STD_AXIS vfzg vfzg_ub_q1p25 6 0.00 318.8 FORMAT "%5.1" DEPOSIT ABSOLUTE /end AXIS_DESCR
/end CHARACTERISTIC
/begin CHARACTERISTIC KFPZU "Kennfeld f¸r rel. zul.  Moment aus der Pedalstellung in der Momentenbegrenzung" MAP 0xFCA145 GkfWUb 99.61 rel_ub_b99p6 0.00 99.61 FORMAT "%5.2"
 /begin AXIS_DESCR COM_AXIS wped relPED_ub_b100 8 0.00 100.0 FORMAT "%5.1" AXIS_PTS_REF SWP08MFUB /end AXIS_DESCR
 /begin AXIS_DESCR COM_AXIS nmot nmot_ub_q40 8 0.00 10200. FORMAT "%5.0" AXIS_PTS_REF SNM08MFUB /end AXIS_DESCR
/end CHARACTERISTIC
/begin CHARACTERISTIC KFTDOFFN "KF zur berechnung von minhubfak" MAP 0xFC5EC0 KfAxUbAyUbSstxUwSstyUbWUb 1.992 fak_ub_b2 0.00 1.992 FORMAT "%5.3"
 /begin AXIS_DESCR STD_AXIS nmot_w nmot_uw_q0p25 4 0.00 16383.75 FORMAT "%8.2" DEPOSIT ABSOLUTE /end AXIS_DESCR
 /begin AXIS_DESCR STD_AXIS nstat nmot_ub_q10 4 0.00 2550. FORMAT "%5.0" DEPOSIT ABSOLUTE /end AXIS_DESCR
/end CHARACTERISTIC
/begin CHARACTERISTIC KFWDMVAD "Wichtung der Leerlaufadaption dmvad_w" MAP 0xFC8CFA KfAxU8AyU8SstxU16SstyU16WU16 0.9999847 fak_uw_b1 0.00 0.9999847 FORMAT "%9.7"
 /begin AXIS_DESCR STD_AXIS rl_w rel_uw_q0p0234 4 0.00 1535.977 FORMAT "%8.3" DEPOSIT ABSOLUTE /end AXIS_DESCR
 /begin AXIS_DESCR STD_AXIS nmot_w nmot_uw_q0p25 4 0.00 16383.75 FORMAT "%8.2" DEPOSIT ABSOLUTE /end AXIS_DESCR
/end CHARACTERISTIC
/begin CHARACTERISTIC KLDIFSEG "Festwertkennlinie eines Gewichtungsfaktors f¸r den Winkelfehler" CURVE 0xFC1DA2 FklWU8 0.9961 fak_q0p0039 0.00 0.9961
 /begin AXIS_DESCR FIX_AXIS wnwiade1_w kw_q0p0039 16 -128.0000 112.0000 FORMAT "%8.4" FIX_AXIS_PAR -32768 12 16 /end AXIS_DESCR
/end CHARACTERISTIC
/begin CHARACTERISTIC KLDMMX "Maximal zul‰ssige Momentenreserven" CURVE 0xFCA185 GklWUb 99.61 rel_ub_b99p6 0.00 99.61 FORMAT "%5.2"
 /begin AXIS_DESCR COM_AXIS nmot nmot_ub_q40 8 0.00 10200. FORMAT "%5.0" AXIS_PTS_REF SNM08MFUB /end AXIS_DESCR
/end CHARACTERISTIC
/begin CHARACTERISTIC KLDTPH "Festwertkennlinie eines Gewichtungsfaktors f¸r die Dynamikbewertung" CURVE 0xFC1DB2 FklWU8 0.9961 fak_q0p0039 0.00 0.9961
 /begin AXIS_DESCR FIX_AXIS dtsegph_w t5usxus_q5 16 -40960.00 35840.00 FORMAT "%8.2" FIX_AXIS_PAR -8192 10 16 /end AXIS_DESCR
/end CHARACTERISTIC
/begin CHARACTERISTIC KLDTPHST "Festwertkennlinie eines Gewichtungsfaktors f¸r Motorstart" CURVE 0xFC1DC2 FklWU8 0.9961 fak_q0p0039 0.00 0.9961
 /begin AXIS_DESCR FIX_AXIS dtsegph_w t5usxus_q5 16 -40960.00 35840.00 FORMAT "%8.2" FIX_AXIS_PAR -8192 10 16 /end AXIS_DESCR
/end CHARACTERISTIC
/begin CHARACTERISTIC KLDYNCOR "Wert f¸r Dynamikkorrektur nach der ersten Z¸ndung" CURVE 0xFC1DE2 KlAxU8SstxU8WU16 60000.00 t5usxus_q5 0.00 60000.00 FORMAT "%8.2"
 /begin AXIS_DESCR STD_AXIS tmot temp_ub_q0p75_o48 4 -48.00 143.3 FORMAT "%5.1" DEPOSIT ABSOLUTE /end AXIS_DESCR
/end CHARACTERISTIC
/begin CHARACTERISTIC KLGVSOLL "Kennlinie f¸r Sollwert Laufunruhe" CURVE 0xFD1412 KlAUwSstUwWSw 127.9980 fak_sw_b64 -64.00000 63.99805 FORMAT "%8.5"
 /begin AXIS_DESCR STD_AXIS nstat nmot_ub_q10 4 0.00 2550. FORMAT "%5.0" DEPOSIT ABSOLUTE /end AXIS_DESCR
/end CHARACTERISTIC
/begin CHARACTERISTIC KLLLRZU "Kennlinie f¸r zul‰ssiges Moment der Leerlaufregelung" CURVE 0xFCA18D GklWUb 99.61 rel_ub_b99p6 0.00 99.61 FORMAT "%5.2"
 /begin AXIS_DESCR COM_AXIS nmot nmot_ub_q40 8 0.00 10200. FORMAT "%5.0" AXIS_PTS_REF SNM08MFUB /end AXIS_DESCR
/end CHARACTERISTIC
/begin CHARACTERISTIC KLMDHUB "Hubabhaengiger Anteil des Schleppmoments" CURVE 0xFC8B38 KlAxU8SstxU16WU16 99.99847 rel_uw_b100 0.00 99.99847 FORMAT "%8.5"
 /begin AXIS_DESCR STD_AXIS evhubi_w hub_uw_q0p001 8 0.00 65.53500 FORMAT "%8.5" DEPOSIT ABSOLUTE /end AXIS_DESCR
/end CHARACTERISTIC
/begin CHARACTERISTIC KLMDNMOT "Drehzahlabhaengiger Anteil des Schleppmoments" CURVE 0xFC8B5A KlAxU8SstxU16WU16 99.99847 rel_uw_b100 0.00 99.99847 FORMAT "%8.5"
 /begin AXIS_DESCR STD_AXIS nmot_w nmot_uw_q0p25 8 0.00 16383.75 FORMAT "%8.2" DEPOSIT ABSOLUTE /end AXIS_DESCR
/end CHARACTERISTIC
/begin CHARACTERISTIC KLMIMAX "Kennlinie f¸r maximales indiziertes Moment" CURVE 0xFCA195 GklWUb 99.61 rel_ub_b99p6 0.00 99.61 FORMAT "%5.2"
 /begin AXIS_DESCR COM_AXIS nmot nmot_ub_q40 8 0.00 10200. FORMAT "%5.0" AXIS_PTS_REF SNM08MFUB /end AXIS_DESCR
/end CHARACTERISTIC
/begin CHARACTERISTIC KLMIMIN "Kennliie f¸r minimales indiziertes Moment" CURVE 0xFCA1D0 GklWUw 99.99847 rel_uw_b100 0.00 99.99847 FORMAT "%8.5"
 /begin AXIS_DESCR COM_AXIS nmot nmot_ub_q40 8 0.00 10200. FORMAT "%5.0" AXIS_PTS_REF SNM08MFUB /end AXIS_DESCR
/end CHARACTERISTIC
/begin CHARACTERISTIC KLMNHUBST "Kennlinie Minhub im Start" CURVE 0xFD1424 KlAUbSstUbWUw 65.53500 hub_uw_q0p001 0.00 65.53500 FORMAT "%8.5"
 /begin AXIS_DESCR STD_AXIS tmst temp_ub_q0p75_o48 5 -48.00 143.3 FORMAT "%5.1" DEPOSIT ABSOLUTE /end AXIS_DESCR
/end CHARACTERISTIC
/begin CHARACTERISTIC KLMZUMN "Kennlinie f¸r drehzahlabh‰ngiges zul. Moment" CURVE 0xFCA19D GklWUb 99.61 rel_ub_b99p6 0.00 99.61 FORMAT "%5.2"
 /begin AXIS_DESCR COM_AXIS nmot nmot_ub_q40 8 0.00 10200. FORMAT "%5.0" AXIS_PTS_REF SNM08MFUB /end AXIS_DESCR
/end CHARACTERISTIC
/begin CHARACTERISTIC KLTDOFFM "Kennlinie zur Berechnung von minhubfak" CURVE 0xFD13FE KlAUbSstUbWUb 1.992 fak_ub_b2 0.00 1.992 FORMAT "%5.3"
 /begin AXIS_DESCR STD_AXIS tmot temp_ub_q0p75_o48 4 -48.00 143.3 FORMAT "%5.1" DEPOSIT ABSOLUTE /end AXIS_DESCR
/end CHARACTERISTIC
/begin CHARACTERISTIC KLWNWPAS "Festwertkennlinie eines Gewichtungsfaktors f¸r den Winkelfehler" CURVE 0xFC1DD2 FklWU8 1.000 fak_ub_q0p01 0.5000 1.500 FORMAT "%5.3"
 /begin AXIS_DESCR FIX_AXIS wnwipas_w kw_q0p1 16 -102.4000 89.60000 FORMAT "%8.4" FIX_AXIS_PAR -1024 7 16 /end AXIS_DESCR
/end CHARACTERISTIC
/begin CHARACTERISTIC KSOGRZAPP "Obere Kurzschlussgrenze" VALUE 0xFCC15D KwWU8 998.4 i_ub_q5p12 0.00 998.4 FORMAT "%5.0" /end CHARACTERISTIC
/begin CHARACTERISTIC KSUGRZAPP "Untere Kurzschlussgrenze" VALUE 0xFCC15E KwWU8 998.4 i_ub_q5p12 0.00 998.4 FORMAT "%5.0" /end CHARACTERISTIC
/begin CHARACTERISTIC MADRDYTL "Schwelle zum starten Timer f¸r minadrdy" VALUE 0xFC5E88 KwWU16 65.53500 hub_uw_q0p001 0.00 65.53500 FORMAT "%8.5" /end CHARACTERISTIC
/begin CHARACTERISTIC MADRDYTM "Verzˆgerungszeit des Timers f¸r minadrdy" VALUE 0xFC5E8A KwWU16 6553.500 t100msxs_uw_b6553p5 0.00 6553.500 FORMAT "%8.3" /end CHARACTERISTIC
/begin CHARACTERISTIC MDATNM "Drehmomentaufnahme AT-Getriebe in Fahrstufe N/P" CURVE 0xFD33EC GklWSw 99.99695 rel_sw_b100 0.00 99.99695 FORMAT "%8.5"
 /begin AXIS_DESCR COM_AXIS tmot temp_ub_q0p75_o48 8 -48.00 143.3 FORMAT "%5.1" AXIS_PTS_REF STM08MDUB /end AXIS_DESCR
/end CHARACTERISTIC
/begin CHARACTERISTIC MDATRM "Drehmomentanteil (Pumpenanteil) AT-Getriebe in Fahrstufe R" CURVE 0xFD33FC GklWSw 99.99695 rel_sw_b100 0.00 99.99695 FORMAT "%8.5"
 /begin AXIS_DESCR COM_AXIS tmot temp_ub_q0p75_o48 8 -48.00 143.3 FORMAT "%5.1" AXIS_PTS_REF STM08MDUB /end AXIS_DESCR
/end CHARACTERISTIC
/begin CHARACTERISTIC MDIMX "Maximales indiziertes Motormoment" VALUE 0xFCA1E6 KwUb 99.61 rel_ub_b99p6 0.00 99.61 FORMAT "%5.2" /end CHARACTERISTIC
/begin CHARACTERISTIC MDSH "Hˆhenabh‰ngiger Anteil des Schleppmomentes" CURVE 0xFD331D KlAUbSstUbWSb 49.90 rel_q0p1957 -25.05 24.85 FORMAT "%5.2"
 /begin AXIS_DESCR STD_AXIS fho fak_ub_b4 6 0.00 3.984 FORMAT "%5.3" DEPOSIT ABSOLUTE /end AXIS_DESCR
/end CHARACTERISTIC
/begin CHARACTERISTIC MDSL "Momentenanforderung der Servolenkung" VALUE 0xFC8D92 KwUb 49.73 rel_ub_b49p725 0.00 49.73 FORMAT "%5.2" /end CHARACTERISTIC
/begin CHARACTERISTIC MDWANER "Ersatzwert fur mdwan_w bei Fehler" VALUE 0xFC8DE7 KwUb 99.61 rel_ub_b99p6 0.00 99.61 FORMAT "%5.2" /end CHARACTERISTIC
/begin CHARACTERISTIC MINHUB "" VALUE 0xFC5E8C KwWU16 65.53500 hub_uw_q0p001 0.00 65.53500 FORMAT "%8.5" /end CHARACTERISTIC
/begin CHARACTERISTIC MINHUBFAD "" VALUE 0xFC5E8E KwWU16 1.999969 fak_uw_b2 0.00 1.999969 FORMAT "%8.6" /end CHARACTERISTIC
/begin CHARACTERISTIC MINHUBFG "" VALUE 0xFC5E90 KwWU16 65.53500 hub_uw_q0p001 0.00 65.53500 FORMAT "%8.5" /end CHARACTERISTIC
/begin CHARACTERISTIC MINHUBMN "Minimaler Hub aus Integrator" VALUE 0xFC5E92 KwWU16 65.53500 hub_uw_q0p001 0.00 65.53500 FORMAT "%8.5" /end CHARACTERISTIC
/begin CHARACTERISTIC MINHUBMX "Maximaler Hub aus Integrator" VALUE 0xFC5E94 KwWU16 65.53500 hub_uw_q0p001 0.00 65.53500 FORMAT "%8.5" /end CHARACTERISTIC
/begin CHARACTERISTIC MINHUBMXO "Schwelle zur Berechnung B_lltdoff" VALUE 0xFC5E96 KwWS16 65.53500 hub_uw_q0p001 -32.76800 32.76700 FORMAT "%8.5" /end CHARACTERISTIC
/begin CHARACTERISTIC MINHUBMXU "Schwelle zur Berechnung B_ssll" VALUE 0xFC5E98 KwWS16 65.53500 hub_uw_q0p001 -32.76800 32.76700 FORMAT "%8.5" /end CHARACTERISTIC
/begin CHARACTERISTIC MINHUBMXVS "Maximalwert f¸r minhubvsi" VALUE 0xFC5E9A KwWU16 65.53500 hub_uw_q0p001 0.00 65.53500 FORMAT "%8.5" /end CHARACTERISTIC
/begin CHARACTERISTIC MINHUBSW "Schwelle f¸r Minhub-Anhebung" VALUE 0xFC5E9C KwWU16 65.53500 hub_uw_q0p001 0.00 65.53500 FORMAT "%8.5" /end CHARACTERISTIC
/begin CHARACTERISTIC MINHUBSWOF "Offset, um den evhubs_kf grˆﬂer als MINHUBSW sein muﬂ" VALUE 0xFC5E9E KwWU16 65.53500 hub_uw_q0p001 0.00 65.53500 FORMAT "%8.5" /end CHARACTERISTIC
/begin CHARACTERISTIC MNHBFSTINI "Initialisierungswert minhubfst" VALUE 0xFC5EB1 KwWU8 1.000 fak_ub_b2 0.00 1.000 FORMAT "%5.3" /end CHARACTERISTIC
/begin CHARACTERISTIC MOFBSSLL "" VALUE 0xFC5EA0 KwWU16 65.53500 hub_uw_q0p001 0.00 65.53500 FORMAT "%8.5" /end CHARACTERISTIC
/begin CHARACTERISTIC MXNLFEHL "Maximale Anzahl von Fehlern der Synchronisations¸berwachung bei hoher Dynamik" VALUE 0xFC1DF9 KwWU8 8.000 dez 0.00 8.000 FORMAT "%5.3" /end CHARACTERISTIC
/begin CHARACTERISTIC MZFFIL "Filter-Zeitkonstante f¸r verzˆgertes Moment in der Momentenbegrenzung" VALUE 0xFCA1E0 KwUw 655.34999985 zk10msxs_uw_b655 0.010000152590 655.36000000 FORMAT "%12.8" /end CHARACTERISTIC
/begin CHARACTERISTIC MZFTV "Verzugszeit f¸r zul‰ssiges Moment in der Momentenbegrenzung" VALUE 0xFCA1E2 KwUw 327.67000000 tz10msxs_uw_b327p68 0.010000000000 327.68000000 FORMAT "%12.8" /end CHARACTERISTIC
/begin CHARACTERISTIC NMAXGA "Maximal zul‰ssige Motordrehzahl (station‰r)" CURVE 0xFCA22C GklWUw 16383.75 nmot_uw_q0p25 0.00 16383.75 FORMAT "%8.2"
 /begin AXIS_DESCR COM_AXIS gangi dez 8 0.00 255.0 FORMAT "%5.1" AXIS_PTS_REF SGA08MDUB /end AXIS_DESCR
/end CHARACTERISTIC
/begin CHARACTERISTIC NMAXKRDWS "Drehzahlgrenze bei Klopfregelung- Notlauf" VALUE 0xFCA23C KwUw 16383.75 nmot_uw_q0p25 0.00 16383.75 FORMAT "%8.2" /end CHARACTERISTIC
/begin CHARACTERISTIC NMAXLR "Drehzahlbegrenzung bei Low Range Betrieb" VALUE 0xFCA23E KwUw 16383.75 nmot_uw_q0p25 0.00 16383.75 FORMAT "%8.2" /end CHARACTERISTIC
/begin CHARACTERISTIC NMAXNL "Drehzahlgrenze bei Drehzahlgeber-Notlauf" VALUE 0xFCA240 KwUw 16383.75 nmot_uw_q0p25 0.00 16383.75 FORMAT "%8.2" /end CHARACTERISTIC
/begin CHARACTERISTIC NMAXPG "gangabh‰ngiges P-Glied bei NMAX Regelung" CURVE 0xFCA1E7 GklWUb 0.9961 relnmot_q0p0039 0.00 0.9961
 /begin AXIS_DESCR COM_AXIS gangi dez 8 0.00 255.0 FORMAT "%5.1" AXIS_PTS_REF SGA08MDUB /end AXIS_DESCR
/end CHARACTERISTIC
/begin CHARACTERISTIC NMAXPLR "P-Glied bei NMAX-Regelung und Low Range Betrieb" VALUE 0xFD3E3E KwUb 0.9961 relnmot_q0p0039 0.00 0.9961 /end CHARACTERISTIC
/begin CHARACTERISTIC NMOTMLSNML "Drehzahlschwelle Erkennung langer Leerlauf f¸r E-L¸fteransteuerung" VALUE 0xFD55AA KwUb 10200. nmot_ub_q40 0.00 10200. FORMAT "%5.0" /end CHARACTERISTIC
/begin CHARACTERISTIC NMXDAEF "Maximaldrehzahl bei Drosselklappen-Antrieb-Ersatzbetrieb" CURVE 0xFCA1EF KlAUbSstUbWUb 10200. nmot_ub_q40 0.00 10200. FORMAT "%5.0"
 /begin AXIS_DESCR STD_AXIS wped relPED_ub_b100 6 0.00 100.0 FORMAT "%5.1" DEPOSIT ABSOLUTE /end AXIS_DESCR
/end CHARACTERISTIC
/begin CHARACTERISTIC NMXDKPU "Maximaldrehzahl bei Sicherheitskraftstoffabschaltung (SKA)" VALUE 0xFCA242 KwUw 16383.75 nmot_uw_q0p25 0.00 16383.75 FORMAT "%8.2" /end CHARACTERISTIC
/begin CHARACTERISTIC NMXMSG "Maximaldrehzahl bei Drosselklappen-Fehler in anderem Motor-Steuerger‰t" VALUE 0xFD3E6E KwUw 16383.75 nmot_uw_q0p25 0.00 16383.75 FORMAT "%8.2" /end CHARACTERISTIC
/begin CHARACTERISTIC NPHERKMN "minimale Motordrehzahl f¸r Phasensuche" VALUE 0xFC1DFD KwWU8 10200. nmot_ub_q40 0.00 10200. FORMAT "%5.0" /end CHARACTERISTIC
/begin CHARACTERISTIC NPHERKMX "maximale Motordrehzahl f¸r Phasensuche" VALUE 0xFC1DFE KwWU8 10200. nmot_ub_q40 0.00 10200. FORMAT "%5.0" /end CHARACTERISTIC
/begin CHARACTERISTIC NSTART "Motordrehzahlschwelle f¸r Unterdrehzahl-Ausstieg bei Nachstartaufweitung" VALUE 0xFCA1A5 KwUb 10200. nmot_ub_q40 0.00 10200. FORMAT "%5.0" /end CHARACTERISTIC
/begin CHARACTERISTIC NSTEND "Motordrehzahlschwelle f¸r Start Ende bei Nachstartaufweitung" VALUE 0xFCA1A6 KwUb 10200. nmot_ub_q40 0.00 10200. FORMAT "%5.0" /end CHARACTERISTIC
/begin CHARACTERISTIC OSPGAPP "Oberspannungsschwelle" VALUE 0xFCC140 KwWU16 16.383750 spg_uw_q0p25em3_o6 6.0000000 22.383750 FORMAT "%9.6" /end CHARACTERISTIC
/begin CHARACTERISTIC OSPGHYST "Unterspannungshysterese" VALUE 0xFCC142 KwWU16 16.383750 spg_q0p25em3 0.00 16.383750 FORMAT "%9.6" /end CHARACTERISTIC
/begin CHARACTERISTIC OSPGPRELLZ "Anzahl der Entprellungen f¸r Oberspannungsfehlereintrag" VALUE 0xFCC15F KwWU8 255.0 DEZ 0.00 255.0 FORMAT "%5.1" /end CHARACTERISTIC
/begin CHARACTERISTIC OSPRELLDEC "Dekrement auf Entprellcounter Oberspannung" VALUE 0xFCC160 KwWU8 255.0 DEZ 0.00 255.0 FORMAT "%5.1" /end CHARACTERISTIC
/begin CHARACTERISTIC OSPRELLINC "Inkrement auf Entprellcounter Oberspannung" VALUE 0xFCC161 KwWU8 255.0 DEZ 0.00 255.0 FORMAT "%5.1" /end CHARACTERISTIC
/begin CHARACTERISTIC OZANFANZ "Anfangsanzeigewert Restlaufstrecke" VALUE 0xFD40B2 KwWU16 655350.0 km_uw_q10 0.00 655350.0 FORMAT "%8.1" /end CHARACTERISTIC
/begin CHARACTERISTIC OZBZKMSTK1 "Bezugsintervall" VALUE 0xFD40B4 KwWU16 655350.0 km_uw_q10 0.00 655350.0 FORMAT "%8.1" /end CHARACTERISTIC
/begin CHARACTERISTIC OZKMMAXK11 "Maximalintervall" VALUE 0xFD40B6 KwWU16 655350.0 km_sw_q10 0.00 655350.0 FORMAT "%8.1" /end CHARACTERISTIC
/begin CHARACTERISTIC OZKMUPL "Ung¸ltigkeitswert f¸r Kilometerstand" VALUE 0xFD409E KwWU16 655350.0 km_uw_q10 0.00 655350.0 FORMAT "%8.1" /end CHARACTERISTIC
/begin CHARACTERISTIC OZKVB96 "Typpr¸fkraftstoffverbrauch" VALUE 0xFD40C6 KwWU8 25.50 fuel96_ub 0.00 25.50 FORMAT "%5.2" /end CHARACTERISTIC
/begin CHARACTERISTIC OZKVBMXK18 "maximal zul‰ssige Gesamtkraftstoffbonusmenge" VALUE 0xFD40B8 KwWU16 1200.000 fuel_uw_q1 0.00 1200.000 FORMAT "%8.3" /end CHARACTERISTIC
/begin CHARACTERISTIC OZKVBOK16 "Kraftstoffbonusmenge in [l] je 0,5l ÷lnachf¸llung" VALUE 0xFD40BA KwWU16 1000.000 fuel_uw_q1 0.00 1000.000 FORMAT "%8.3" /end CHARACTERISTIC
/begin CHARACTERISTIC OZLANGLIM1 "Schwelle f¸r langen Mittelwert ÷lniveau (Vebrauchswarnung)" VALUE 0xFD404A KwWU8 74.71 niv_ub_b75 0.00 74.71 FORMAT "%5.2" /end CHARACTERISTIC
/begin CHARACTERISTIC OZLANGLIM2 "Schwelle f¸r langen Mittelwert ÷lniveau (Verlustwarnung)" VALUE 0xFD404B KwWU8 74.71 niv_ub_b75 0.00 74.71 FORMAT "%5.2" /end CHARACTERISTIC
/begin CHARACTERISTIC OZLF1 "L‰nderfaktor 1" VALUE 0xFD40C7 KwWU8 2.550 lf_ub 0.00 2.550 FORMAT "%5.3" /end CHARACTERISTIC
/begin CHARACTERISTIC OZLF2 "L‰nderfaktor 2" VALUE 0xFD40C8 KwWU8 2.550 lf_ub 0.00 2.550 FORMAT "%5.3" /end CHARACTERISTIC
/begin CHARACTERISTIC OZLIM1HEAL "Schwelle f¸r R¸cknahme der ÷lniveauwarnung Verbrauch" VALUE 0xFD404C KwWU8 74.71 niv_ub_b75 0.00 74.71 FORMAT "%5.2" /end CHARACTERISTIC
/begin CHARACTERISTIC OZLIM2HEAL "Schwelle f¸r R¸cknahme der ÷lniveauwarnung Verlust" VALUE 0xFD404D KwWU8 74.71 niv_ub_b75 0.00 74.71 FORMAT "%5.2" /end CHARACTERISTIC
/begin CHARACTERISTIC OZMNKMBO "Wegstrecke ab der eine Bonuszuteilung erfolgt" VALUE 0xFD40BC KwWU16 655350.0 km_uw_q10 0.00 655350.0 FORMAT "%8.1" /end CHARACTERISTIC
/begin CHARACTERISTIC OZMWK "Anzahl der Meﬂwerte f¸r Kurzzeit-Mittelwert/Orientierungsmessung Niveau" VALUE 0xFD408F KwWU8 254.0 DEZ 1.000 255.0 FORMAT "%5.1" /end CHARACTERISTIC
/begin CHARACTERISTIC OZMWL "Anzahl der Meﬂwerte f¸r Langzeit-Mittelwert Niveau" VALUE 0xFD4090 KwWU8 254.0 DEZ 1.000 255.0 FORMAT "%5.1" /end CHARACTERISTIC
/begin CHARACTERISTIC OZMWOR "Anzahl der Messwerte f¸r Orientierungsmessung" VALUE 0xFD4091 KwWU8 254.0 DEZ 1.000 255.0 FORMAT "%5.1" /end CHARACTERISTIC
/begin CHARACTERISTIC OZMWV "Anzahl der Meﬂwerte f¸r vorgezogenen Mittelwert Niveau" VALUE 0xFD4092 KwWU8 254.0 DEZ 1.000 255.0 FORMAT "%5.1" /end CHARACTERISTIC
/begin CHARACTERISTIC OZMXOHK15 "maximale ÷llaufzeit in [s]" VALUE 0xFD40BE KwWU16 65535.00 t1mxm_ul_q1 0.00 65535.00 FORMAT "%8.2" /end CHARACTERISTIC
/begin CHARACTERISTIC OZNFCNT "Anzahl Werte f¸r Nachf¸llerkennung" VALUE 0xFD4093 KwWU8 254.0 DEZ 1.000 255.0 FORMAT "%5.1" /end CHARACTERISTIC
/begin CHARACTERISTIC OZNFTMPMAX "obere Temperaturgrenze f¸r Nachf¸llerkennung" VALUE 0xFD4094 KwWU8 255.0 temp_ub_q1_o48 -48.00 207.0 FORMAT "%5.1" /end CHARACTERISTIC
/begin CHARACTERISTIC OZNFTMPMIN "untere Temperaturgrenze f¸r Nachf¸llerkennung" VALUE 0xFD4095 KwWU8 255.0 temp_ub_q1_o48 -48.00 207.0 FORMAT "%5.1" /end CHARACTERISTIC
/begin CHARACTERISTIC OZNIVKL "Skalierungskennlinie Niveau" CURVE 0xFD405C KlAxU8SstxU8WU8 74.71 niv_ub_b75 0.00 74.71 FORMAT "%5.2"
 /begin AXIS_DESCR STD_AXIS oznivt DEZ 2 0.00 255.0 FORMAT "%5.1" DEPOSIT ABSOLUTE /end AXIS_DESCR
/end CHARACTERISTIC
/begin CHARACTERISTIC OZNIVMMLIT "Umrechnungsfaktor f¸r ÷lniveau von mm in Liter in [l/mm]" VALUE 0xFD4096 KwWU8 0.9961 fak_ub_b1 0.00 0.9961 /end CHARACTERISTIC
/begin CHARACTERISTIC OZNIVNFM05 "Niveauschwelle f¸r Erkennung 0,5 Liter nachgef¸llt in [l]" VALUE 0xFD4097 KwWU8 7.969 nivmmxl_ub_b8 0.00 7.969 FORMAT "%5.3" /end CHARACTERISTIC
/begin CHARACTERISTIC OZNIVNFM10 "Niveauschwelle f¸r Erkennung 1,0 Liter nachgef¸llt in [l]" VALUE 0xFD4098 KwWU8 7.969 nivmmxl_ub_b8 0.00 7.969 FORMAT "%5.3" /end CHARACTERISTIC
/begin CHARACTERISTIC OZNMNIVKL "Kennline f¸r Drehzahlkorrektur des Niveaus" CURVE 0xFD406E KlAxU8SstxU8WS8 74.71 niv_sb_b37p5 -37.50 37.21 FORMAT "%5.2"
 /begin AXIS_DESCR STD_AXIS oznmotmw nmot_ub_q40 16 0.00 10200. FORMAT "%5.0" DEPOSIT ABSOLUTE /end AXIS_DESCR
/end CHARACTERISTIC
/begin CHARACTERISTIC OZNMOTMAX "Obere Drehzahlgrenze f¸r drehzahlkorrigierten Niveaumittelwert" VALUE 0xFD4099 KwWU8 10200. nmot_ub_q40 0.00 10200. FORMAT "%5.0" /end CHARACTERISTIC
/begin CHARACTERISTIC OZNMOTMIN "Untere Drehzahlgrenze f¸r drehzahlkorrigierten Niveaumittelwert" VALUE 0xFD409A KwWU8 10200. nmot_ub_q40 0.00 10200. FORMAT "%5.0" /end CHARACTERISTIC
/begin CHARACTERISTIC OZOELKMPL "gefahrene Strecke nach ÷lwechsel, ab wo Er-Auswertung erfolgt" VALUE 0xFD40AC KwWU8 2550. km_uw_q10 0.00 2550. FORMAT "%5.0" /end CHARACTERISTIC
/begin CHARACTERISTIC OZORLIM2 "Schwelle f¸r Orientierungswert ÷lniveau (Vebrauchswarnung)" VALUE 0xFD404E KwWU8 74.71 niv_ub_b75 0.00 74.71 FORMAT "%5.2" /end CHARACTERISTIC
/begin CHARACTERISTIC OZPERBOK17 "Er-Bonusbetrag je 0,5l ÷lnachf¸llung" VALUE 0xFD40C0 KwWU16 0.2000427 perm_uw_b6 0.00 0.2000427 FORMAT "%9.7" /end CHARACTERISTIC
/begin CHARACTERISTIC OZPERBRK14 "Begrenzungsfaktor f¸r Restweg aus der Permittivit‰t" VALUE 0xFD40C9 KwWU8 3.984 fak_ub_b4 0.00 3.984 FORMAT "%5.3" /end CHARACTERISTIC
/begin CHARACTERISTIC OZPERMCOK5 "minimale Anzahl der Meﬂwerte f¸r einen g¸ltigen Permittivit‰tswert" VALUE 0xFD40A0 KwWU16 65535.00 DEZ 0.00 65535.00 FORMAT "%8.2" /end CHARACTERISTIC
/begin CHARACTERISTIC OZPERMKL "Skalierungskennlinie Permittivit‰t" CURVE 0xFD4052 KlAxU8SstxU16WU16 5.999908 perm_uw_b6 0.00 5.999908 FORMAT "%8.6"
 /begin AXIS_DESCR STD_AXIS ozpermt DEZ 2 0.00 1024.000 FORMAT "%8.3" DEPOSIT ABSOLUTE /end AXIS_DESCR
/end CHARACTERISTIC
/begin CHARACTERISTIC OZPERMMIN "minimaler Permittivit‰tswert f¸r g¸ltige Auswertung" VALUE 0xFD40A2 KwWU16 5.999908 perm_uw_b6 0.00 5.999908 FORMAT "%8.6" /end CHARACTERISTIC
/begin CHARACTERISTIC OZPERMMNIV "Niveauschwelle f¸r g¸ltige Permittivit‰tsauswertung" VALUE 0xFD40AD KwWU8 74.71 niv_ub_b75 0.00 74.71 FORMAT "%5.2" /end CHARACTERISTIC
/begin CHARACTERISTIC OZPERMNK3 "Drehzahlschwelle1 f¸r Er-Ausblendung" VALUE 0xFD40AE KwWU8 10200. nmot_ub_q40 0.00 10200. FORMAT "%5.0" /end CHARACTERISTIC
/begin CHARACTERISTIC OZPERMRMIN "min. Er-Rohwert f¸r Niveau-Ausblendung" VALUE 0xFD4068 KwWU16 1024.000 DEZ 0.00 1024.000 FORMAT "%8.3" /end CHARACTERISTIC
/begin CHARACTERISTIC OZPERMTIK6 "Mittelungszeitraum Permittivit‰t" VALUE 0xFD40A4 KwWU16 65535.00 t1sxs_uw_b65535 0.00 65535.00 FORMAT "%8.2" /end CHARACTERISTIC
/begin CHARACTERISTIC OZPERMTIK8 "Ausheizzeit" VALUE 0xFD40A6 KwWU16 65535.00 t1sxs_uw_b65535 0.00 65535.00 FORMAT "%8.2" /end CHARACTERISTIC
/begin CHARACTERISTIC OZPERMTIK9 "Kaltzeitschwelle" VALUE 0xFD40A8 KwWU16 65535.00 t1sxs_uw_b65535 0.00 65535.00 FORMAT "%8.2" /end CHARACTERISTIC
/begin CHARACTERISTIC OZPERMTK12 "Untere Temperaturgrenze Meﬂfenster Permittivit‰t" VALUE 0xFD40AF KwWU8 255.0 temp_ub_q1_o48 -48.00 207.0 FORMAT "%5.1" /end CHARACTERISTIC
/begin CHARACTERISTIC OZPERMTK13 "Obere Temperaturgrenze Meﬂfenster Permittivit‰t" VALUE 0xFD40B0 KwWU8 255.0 temp_ub_q1_o48 -48.00 207.0 FORMAT "%5.1" /end CHARACTERISTIC
/begin CHARACTERISTIC OZPERMTK4 "Abklingzeit Drehzahlschwelle1" VALUE 0xFD40AA KwWU16 65535.00 t1sxs_uw_b65535 0.00 65535.00 FORMAT "%8.2" /end CHARACTERISTIC
/begin CHARACTERISTIC OZPERMTK7 "Ausheiztemperatur" VALUE 0xFD40B1 KwWU8 255.0 temp_ub_q1_o48 -48.00 207.0 FORMAT "%5.1" /end CHARACTERISTIC
/begin CHARACTERISTIC OZPERXK10 "zul‰ssige Permitivit‰ts‰nderung im ÷lwechselintervall" VALUE 0xFD40C2 KwWU16 1.000031 perm_uw_b6 0.00 1.000031 FORMAT "%8.6" /end CHARACTERISTIC
/begin CHARACTERISTIC OZPRREFMAX "Maximum f¸r g¸ltigen Permittivit‰tsersatzwert" VALUE 0xFD406A KwWU16 1024.000 DEZ 0.00 1024.000 FORMAT "%8.3" /end CHARACTERISTIC
/begin CHARACTERISTIC OZPRREFMIN "Minimum f¸r g¸ltigen Permittivit‰tsersatzwert" VALUE 0xFD406C KwWU16 1024.000 DEZ 0.00 1024.000 FORMAT "%8.3" /end CHARACTERISTIC
/begin CHARACTERISTIC OZTAGCTERR "Fehlerkennung f¸r Tagez‰hler" VALUE 0xFD40C4 KwWU16 65535.00 DEZ 0.00 65535.00 FORMAT "%8.2" /end CHARACTERISTIC
/begin CHARACTERISTIC OZTEMPBW "Temperaturschwelle ÷ltemperatur Motor betriebswarm" VALUE 0xFD409B KwWU8 255.0 temp_ub_q1_o48 -48.00 207.0 FORMAT "%5.1" /end CHARACTERISTIC
/begin CHARACTERISTIC OZTEMPKL "Skalierungskennlinie Temperatur" CURVE 0xFD4061 KlAxU8SstxU8WU8 255.0 temp_ub_q1_o48 -48.00 207.0 FORMAT "%5.1"
 /begin AXIS_DESCR STD_AXIS oztempt DEZ 2 0.00 255.0 FORMAT "%5.1" DEPOSIT ABSOLUTE /end AXIS_DESCR
/end CHARACTERISTIC
/begin CHARACTERISTIC OZTEMPORR "Temperaturschwelle f¸r Orientierungsmessung" VALUE 0xFD409C KwWU8 255.0 temp_ub_q1_o48 -48.00 207.0 FORMAT "%5.1" /end CHARACTERISTIC
/begin CHARACTERISTIC OZVORLIM1 "Schwelle f¸r vorgezogenen Mittelwert ÷lniveau (Vebrauchswarnung)" VALUE 0xFD404F KwWU8 74.71 niv_ub_b75 0.00 74.71 FORMAT "%5.2" /end CHARACTERISTIC
/begin CHARACTERISTIC OZVORLIM2 "Schwelle f¸r vorgezogenen Mittelwert ÷lniveau (Verlustwarnung)" VALUE 0xFD4050 KwWU8 74.71 niv_ub_b75 0.00 74.71 FORMAT "%5.2" /end CHARACTERISTIC
/begin CHARACTERISTIC OZZEITFAKT "Faktor zum Ausblenden der Zeit zu Beginn der Auswertung" VALUE 0xFD40CA KwWU8 2.550 lf_ub 0.00 2.550 FORMAT "%5.3" /end CHARACTERISTIC
/begin CHARACTERISTIC PHZAHN "Schwelle zur Unterscheidung f¸r langes oder kurzes NW Muster" VALUE 0xFC1DFA KwWU8 255.0 dez 0.00 255.0 FORMAT "%5.1" /end CHARACTERISTIC
/begin CHARACTERISTIC PMDEFMASK "" VALUE 0xFCC162 KwWU8 255.0 DEZ 0.00 255.0 FORMAT "%5.1" /end CHARACTERISTIC
/begin CHARACTERISTIC PMMASKDFP "" VALUE 0xFCC163 KwWU8 255.0 DEZ 0.00 255.0 FORMAT "%5.1" /end CHARACTERISTIC
/begin CHARACTERISTIC RLPHERKMN "minimale Last f¸r Phasensuche" VALUE 0xFC1DFF KwWU8 191.3 rel_ub_q0p75 0.00 191.3 FORMAT "%5.1" /end CHARACTERISTIC
/begin CHARACTERISTIC RLPHERKMX "maximale Last f¸r Phasensuche" VALUE 0xFC1E00 KwWU8 191.3 rel_ub_q0p75 0.00 191.3 FORMAT "%5.1" /end CHARACTERISTIC
/begin CHARACTERISTIC RUHVERMODE "" VALUE 0xFCC164 KwWU8 255.0 DEZ 0.00 255.0 FORMAT "%5.1" /end CHARACTERISTIC
/begin AXIS_PTS SGA08MDUB "St¸tzstellenverteilung Ist Gang 8 Sst." 0xFCF807 gangi SstAUbSstUb 255.0 dez 8 0.00 255.0 FORMAT "%5.1" DEPOSIT ABSOLUTE /end AXIS_PTS
/begin AXIS_PTS SMO08MFUB "St¸tzstellenverteilung f¸r zul‰ssiges Moment mizuvfil" 0xFCA1A7 mizuvfil SstAUbSstUb 99.61 rel_ub_b99p6 8 0.00 99.61 FORMAT "%5.2" DEPOSIT ABSOLUTE /end AXIS_PTS
/begin AXIS_PTS SNM08MFUB "St¸tzstellenverteilung f¸r Motorderhzahl" 0xFCA1B0 nmot SstAUbSstUb 10200. nmot_ub_q40 8 0.00 10200. FORMAT "%5.0" DEPOSIT ABSOLUTE /end AXIS_PTS
/begin CHARACTERISTIC SOCFITLOW "" VALUE 0xFCC144 KwWU16 99.99847 rel_uw_b100 0.00 99.99847 FORMAT "%8.5" /end CHARACTERISTIC
/begin CHARACTERISTIC SSLLLIM "Schwellwert fuer Fehlereintrag in minhubad" VALUE 0xFC5EB2 KwWU8 255.0 dez 0.00 255.0 FORMAT "%5.1" /end CHARACTERISTIC
/begin AXIS_PTS STM08MDUB "St¸tzstellenverteilung: tmot f¸r Drehmomentwandler" 0xFCF889 tmot SstAUbSstUb 191.3 temp_ub_q0p75_o48 8 -48.00 143.3 FORMAT "%5.1" DEPOSIT ABSOLUTE /end AXIS_PTS
/begin AXIS_PTS STM08MFUB "St¸tzstellenverteilung f¸r Motortemperatur tmotmn" 0xFCA1B9 tmotmn SstAUbSstUb 191.3 temp_ub_q0p75_o48 8 -48.00 143.3 FORMAT "%5.1" DEPOSIT ABSOLUTE /end AXIS_PTS
/begin AXIS_PTS SWP08MFUB "St¸tzstellenverteilung f¸r wped" 0xFCA1C2 wped SstAUbSstUb 100.0 relPED_ub_b100 8 0.00 100.0 FORMAT "%5.1" DEPOSIT ABSOLUTE /end AXIS_PTS
/begin CHARACTERISTIC S_BFORUN "Schalter zur alternativen Aktivierung von B_forun in minhubad" VALUE 0xFD1407 KwUb 255.0 dez 0.00 255.0 FORMAT "%5.1" /end CHARACTERISTIC
/begin CHARACTERISTIC S_BMDERK "Schalter zur alternativen Aktivierung von B_mderk in minhubad" VALUE 0xFD1408 KwUb 255.0 dez 0.00 255.0 FORMAT "%5.1" /end CHARACTERISTIC
/begin CHARACTERISTIC S_btdob "" VALUE 0xFC5EBC KwUb 255.0 dez 0.00 255.0 FORMAT "%5.1" /end CHARACTERISTIC
/begin CHARACTERISTIC S_EMD "Schalter zur alternativen Aktivierung von !E_MDxx in minhubad" VALUE 0xFD1409 KwUb 255.0 dez 0.00 255.0 FORMAT "%5.1" /end CHARACTERISTIC
/begin CHARACTERISTIC S_mdversta "Umschalter f¸r Einrechnung Verbrauchermomente in mimin_w" VALUE 0xFC8B7C KwUb 255.0 dez 0.00 255.0 FORMAT "%5.1" /end CHARACTERISTIC
/begin CHARACTERISTIC S_MOEL_ON "Schalter zwischen tol/m_tol; 0=tol" VALUE 0xFD054C KwUb 255.0 dez 0.00 255.0 FORMAT "%5.1" /end CHARACTERISTIC
/begin CHARACTERISTIC S_slldecak "" VALUE 0xFD140A KwUb 255.0 dez 0.00 255.0 FORMAT "%5.1" /end CHARACTERISTIC
/begin CHARACTERISTIC S_TDADAP "Funktion MINHUBAD aktiv" VALUE 0xFD140B KwUb 255.0 dez 0.00 255.0 FORMAT "%5.1" /end CHARACTERISTIC
/begin CHARACTERISTIC S_TDFBA1 "" VALUE 0xFD140C KwUb 255.0 dez 0.00 255.0 FORMAT "%5.1" /end CHARACTERISTIC
/begin CHARACTERISTIC S_TDFBA2 "" VALUE 0xFD140D KwUb 255.0 dez 0.00 255.0 FORMAT "%5.1" /end CHARACTERISTIC
/begin CHARACTERISTIC S_TDFILTER "Umschaltung auf PT1-Filter deltagv" VALUE 0xFD140E KwUb 255.0 dez 0.00 255.0 FORMAT "%5.1" /end CHARACTERISTIC
/begin CHARACTERISTIC S_TDOFFTM "Schalter zur Auswahl Temperaturfaktor aus Rampe oder Kennlinie" VALUE 0xFD140F KwUb 255.0 dez 0.00 255.0 FORMAT "%5.1" /end CHARACTERISTIC
/begin CHARACTERISTIC S_TDSWITCH "Umschaltung zwischen Integrator und Stufenanhebung Minhub" VALUE 0xFD1410 KwUb 255.0 dez 0.00 255.0 FORMAT "%5.1" /end CHARACTERISTIC
/begin CHARACTERISTIC T1PMINFO "" VALUE 0xFCC165 KwWU8 25.50 t_q0p1 0.00 25.50 FORMAT "%5.2" /end CHARACTERISTIC
/begin CHARACTERISTIC T2PMINFO "" VALUE 0xFCC146 KwWU16 6553.500 t_q0p1 0.00 6553.500 FORMAT "%8.3" /end CHARACTERISTIC
/begin CHARACTERISTIC T3PMINFO "" VALUE 0xFCC148 KwWU16 6553.500 t_q0p1 0.00 6553.500 FORMAT "%8.3" /end CHARACTERISTIC
/begin CHARACTERISTIC TALUNL "Tastverh‰ltnis f¸r EC-L¸fternachlaufsteuerung bei 10 Hz" VALUE 0xFD55AB KwUb 99.61 rel_ub_b100 0.00 99.61 FORMAT "%5.2" /end CHARACTERISTIC
/begin CHARACTERISTIC TAMHYS "Tastverh‰ltnis E-L¸fter Hysterese" VALUE 0xFD55AC KwUb 99.61 rel_ub_b100 0.00 99.61 FORMAT "%5.2" /end CHARACTERISTIC
/begin CHARACTERISTIC TAMLAC "Anforderung E-L¸fter-Tastverh‰ltnis von Klimaanlage" CURVE 0xFD55AD KlAUbSstUbWUb 99.61 rel_ub_b100 0.00 99.61 FORMAT "%5.2"
 /begin AXIS_DESCR STD_AXIS stmlac dez 10 0.00 255.0 FORMAT "%5.1" DEPOSIT ABSOLUTE /end AXIS_DESCR
/end CHARACTERISTIC
/begin CHARACTERISTIC TAMLSMN "Minimales Tastverh‰ltnis Ansteuerung Motorl¸fter" VALUE 0xFD55C2 KwUb 99.61 rel_ub_b100 0.00 99.61 FORMAT "%5.2" /end CHARACTERISTIC
/begin CHARACTERISTIC TAMLSMX "Maximales Tastverh‰ltnis Ansteuerung Motorl¸fter" VALUE 0xFD55C3 KwUb 99.61 rel_ub_b100 0.00 99.61 FORMAT "%5.2" /end CHARACTERISTIC
/begin CHARACTERISTIC TAMLSNH "Anforderung E-L¸fter-Tastverh‰ltnis nach Hysterese" CURVE 0xFD55C4 KlAUbSstUbWUb 99.61 rel_ub_b100 0.00 99.61 FORMAT "%5.2"
 /begin AXIS_DESCR STD_AXIS tamlausab rel_ub_b100 8 0.00 99.61 FORMAT "%5.2" DEPOSIT ABSOLUTE /end AXIS_DESCR
/end CHARACTERISTIC
/begin CHARACTERISTIC TAMLSNML "Tastverh‰ltnis E-L¸fter bei langem Motorleerlauf" VALUE 0xFD55D5 KwUb 99.61 rel_ub_b100 0.00 99.61 FORMAT "%5.2" /end CHARACTERISTIC
/begin CHARACTERISTIC TAMLTKA "Anforderung E-L¸fter-Tastverh‰ltnis aus K¸hlerausgangstemperatur" CURVE 0xFD55D6 KlAUbSstUbWUb 99.61 rel_ub_b100 0.00 99.61 FORMAT "%5.2"
 /begin AXIS_DESCR STD_AXIS tka temp_ub_q0p75_o48 10 -48.00 143.3 FORMAT "%5.1" DEPOSIT ABSOLUTE /end AXIS_DESCR
/end CHARACTERISTIC
/begin CHARACTERISTIC TAMLU "Unempfindlichkeitsschwelle E-L¸fter-Tastverh‰ltnis" VALUE 0xFD55EB KwUb 99.61 rel_ub_b100 0.00 99.61 FORMAT "%5.2" /end CHARACTERISTIC
/begin CHARACTERISTIC TAMLUOFF "Unempfindlichkeitsschwelle E-L¸fter-Tastverh‰ltnis aus" VALUE 0xFD55EC KwUb 99.61 rel_ub_b100 0.00 99.61 FORMAT "%5.2" /end CHARACTERISTIC
/begin CHARACTERISTIC TANSMN "Ansauglufttemperaturschwelle zur Nachstartaufweitung" VALUE 0xFCA1CB KwUb 191.3 temp_ub_q0p75_o48 -48.00 143.3 FORMAT "%5.1" /end CHARACTERISTIC
/begin CHARACTERISTIC TANSTDENW "" VALUE 0xFC5EBD KwUb 191.3 temp_ub_q0p75_o48 -48.00 143.3 FORMAT "%5.1" /end CHARACTERISTIC
/begin CHARACTERISTIC TBATNACHL "" VALUE 0xFCC14A KwWU16 6553.500 t_q0p1 0.00 6553.500 FORMAT "%8.3" /end CHARACTERISTIC
/begin CHARACTERISTIC TCALCN "Zeit in 10ms bis nmot Berechnung abgeschlossen ist" VALUE 0xFC1E03 KwUb 2.540 t10msxs_ub_b2p55 0.01000 2.550 FORMAT "%5.3" /end CHARACTERISTIC
/begin CHARACTERISTIC TCODIERPM "" VALUE 0xFCC166 KwWU8 25.50 t_q0p1 0.00 25.50 FORMAT "%5.2" /end CHARACTERISTIC
/begin CHARACTERISTIC TDADNMOT "Kennwert untere Drehzahlschwelle" VALUE 0xFC5EA2 KwWU16 16383.75 nmot_uw_q0p25 0.00 16383.75 FORMAT "%8.2" /end CHARACTERISTIC
/begin CHARACTERISTIC TDADON "Verzˆgerungszeit f¸r Bedingung Leerlauf in 100ms Schritten" VALUE 0xFC5EA4 KwWU16 65535.00 dez 0.00 65535.00 FORMAT "%8.2" /end CHARACTERISTIC
/begin CHARACTERISTIC TDADTMOT "Kennwert obere Temperaturschwelle" VALUE 0xFC5EB3 KwWU8 191.3 temp_ub_q0p75_o48 -48.00 143.3 FORMAT "%5.1" /end CHARACTERISTIC
/begin CHARACTERISTIC TDADVFZ "Schwelle zum Setzen B_tdadon (Vergleich mit vfzg)" VALUE 0xFC5EB4 KwWU8 318.8 vfzg_ub_q1p25 0.00 318.8 FORMAT "%5.1" /end CHARACTERISTIC
/begin CHARACTERISTIC TDELTAGV "" VALUE 0xFC5EA6 KwWU16 99.99847 rel_uw_b100 0.00 99.99847 FORMAT "%8.5" /end CHARACTERISTIC
/begin CHARACTERISTIC TDGANGMX "Schwelle zum Setzen B_tdadon (Vergleich mit gangi)" VALUE 0xFC5EB5 KwWU8 255.0 dez 0.00 255.0 FORMAT "%5.1" /end CHARACTERISTIC
/begin CHARACTERISTIC TDMNHT0 "Integratorsteigung ‹bergang minhubfak_w 1 -> 0" VALUE 0xFC5EA8 KwWS16 1.999969 fak_uw_b2 -1.000000 0.9999695 FORMAT "%8.6" /end CHARACTERISTIC
/begin CHARACTERISTIC TDMNHT1 "Integratorsteigung ‹bergang minhubfak_w 0 -> 1" VALUE 0xFC5EAA KwWS16 1.999969 fak_uw_b2 -1.000000 0.9999695 FORMAT "%8.6" /end CHARACTERISTIC
/begin CHARACTERISTIC TDNSOLDIFF "Kennwert untere Solldrehzahlschwelle" VALUE 0xFC5EAC KwWU16 16383.75 nmot_uw_q0p25 0.00 16383.75 FORMAT "%8.2" /end CHARACTERISTIC
/begin CHARACTERISTIC TDOFFT "tmot-Schwelle f¸r ‹bergang minhubfak_w 0 -> 1" VALUE 0xFC5EB6 KwWU8 191.3 temp_ub_q0p75_o48 -48.00 143.3 FORMAT "%5.1" /end CHARACTERISTIC
/begin CHARACTERISTIC TDOFFTDF "" VALUE 0xFC5EB7 KwWU8 191.3 temp_ub_q0p75_o48 -48.00 143.3 FORMAT "%5.1" /end CHARACTERISTIC
/begin CHARACTERISTIC TDRMNHUBST "Additionswert fuer minhubfst" VALUE 0xFC5EB8 KwWU8 1.992 fak_ub_b2 0.00 1.992 FORMAT "%5.3" /end CHARACTERISTIC
/begin CHARACTERISTIC TGETERSMLS "Ersatzwert der Getriebetemperatur f¸r die Motorl¸ftersteuerung" VALUE 0xFD55ED KwUb 255.0 temp_ub_q0p75_o48 0.00 255.0 FORMAT "%5.1" /end CHARACTERISTIC
/begin CHARACTERISTIC TKAMLSNML "K¸hlertemperaturschwelle zur E-L¸fter-Ansteuerung bei langem Leerlauf" VALUE 0xFD55EE KwUb 191.3 temp_ub_q0p75 0.00 191.3 FORMAT "%5.1" /end CHARACTERISTIC
/begin CHARACTERISTIC TMBST "Zeitdauer spezielle Momentenbegrenzung w‰hrend Start und kurz nach Start" VALUE 0xFCA1CC KwUb 2.550 t10msxs_ub_b2p55 0.00 2.550 FORMAT "%5.3" /end CHARACTERISTIC
/begin CHARACTERISTIC TMDMAD "Motortemperaturschwelle f¸r Freigabe der Adaption des Verlustmoments" VALUE 0xFD3336 KwUb 191.3 temp_ub_q0p75_o48 -48.00 143.3 FORMAT "%5.1" /end CHARACTERISTIC
/begin CHARACTERISTIC TMINHUBMX "Timer fuer maximale Zeit minhub_w am oberen Anschlag" VALUE 0xFC5EB9 KwWU8 255.0 t100msxs_ub_b255 0.00 255.0 FORMAT "%5.1" /end CHARACTERISTIC
/begin CHARACTERISTIC TMLSNML "Zeitschwelle zur Erkennung langer Leerlauf zur E-L¸fteransteuerung" VALUE 0xFD55F2 KwUw 13107.00 t_q0p2 0.00 13107.00 FORMAT "%8.2" /end CHARACTERISTIC
/begin CHARACTERISTIC TMMLN "Temperaturschwelle f¸r Motorl¸fter im Nachlauf" VALUE 0xFD55EF KwUb 255.0 temp_ub_q0p75_o48 0.00 255.0 FORMAT "%5.1" /end CHARACTERISTIC
/begin CHARACTERISTIC TMNSMN "Motortemperaturschwelle f¸r die Nachstartaufweitung" VALUE 0xFCA1CD KwUb 191.3 temp_ub_q0p75_o48 -48.00 143.3 FORMAT "%5.1" /end CHARACTERISTIC
/begin CHARACTERISTIC TMOMIN "Minimal mˆgliche Motortemperatur bei warmem Motor" VALUE 0xFCA1CE KwUb 191.3 temp_ub_q0p75_o48 -48.00 143.3 FORMAT "%5.1" /end CHARACTERISTIC
/begin CHARACTERISTIC TMOTMLSNML "Motortemperaturschwelle zur E-L¸fter-Ansteuerung bei langem Leerlauf" VALUE 0xFD55F0 KwUb 191.3 temp_ub_q0p75_o48 -48.00 143.3 FORMAT "%5.1" /end CHARACTERISTIC
/begin CHARACTERISTIC TMZWS "" VALUE 0xFD054D KwUb 191.3 temp_ub_q0p75_o48 -48.00 143.3 FORMAT "%5.1" /end CHARACTERISTIC
/begin CHARACTERISTIC TMZWS_1 "" VALUE 0xFD054E KwUb 191.3 temp_ub_q0p75_o48 -48.00 143.3 FORMAT "%5.1" /end CHARACTERISTIC
/begin CHARACTERISTIC TNLSGMN "Minimale Zeit f¸r SG-Nachlauf" VALUE 0xFD403E KwUw 6553.300 t100msxs_uw_b6553p6 0.2000000 6553.500 FORMAT "%8.3" /end CHARACTERISTIC
/begin CHARACTERISTIC TNLSGMX "Maximale Zeit f¸r SG-Nachlauf" VALUE 0xFD4040 KwUw 6553.500 t100msxs_uw_b6553p6 0.00 6553.500 FORMAT "%8.3" /end CHARACTERISTIC
/begin CHARACTERISTIC TNLSYNMX "Minimalwert der Phasenperiodendauer f¸r Synchronisationsfreigabe" VALUE 0xFC1DF2 KwWU16 500.0000 t_q0p04_ms 0.00 500.0000 FORMAT "%8.4" /end CHARACTERISTIC
/begin CHARACTERISTIC TNMXOFF "zul‰ssige Zeit in der nmot_w grˆsser nsber_w sein darf" VALUE 0xFD3E70 KwUw 655.3500 t_q0p01 0.00 655.3500 FORMAT "%8.4" /end CHARACTERISTIC
/begin CHARACTERISTIC TNMXPRG "gangabh‰ngiger Drehzahl-Pr‰diktionshorizont f¸r NMAX-Regelung" CURVE 0xFCA1FC GklWUb 2.550 t10msxs_ub_b2p55 0.00 2.550 FORMAT "%5.3"
 /begin AXIS_DESCR COM_AXIS gangi dez 8 0.00 255.0 FORMAT "%5.1" AXIS_PTS_REF SGA08MDUB /end AXIS_DESCR
/end CHARACTERISTIC
/begin CHARACTERISTIC TNMXPRLR "Drehzahl-Pr‰diktionshorizont f¸r NMAX-Regelung bei Low Range" VALUE 0xFD3E3F KwUb 2.550 t10msxs_ub_b2p55 0.00 2.550 FORMAT "%5.3" /end CHARACTERISTIC
/begin CHARACTERISTIC TNSC "Nachstart¸berwachungszeit" VALUE 0xFCA1E4 KwUw 1310.700 t20msxs_uw_q0p02 0.00 1310.700 FORMAT "%8.3" /end CHARACTERISTIC
/begin CHARACTERISTIC TNSEMLSNML "Zeit nach Motorstart zur E-L¸fter-Ansteuerung bei langem Leerlauf" VALUE 0xFD55F4 KwUw 6553.500 t100msxs_uw_b6553p5 0.00 6553.500 FORMAT "%8.3" /end CHARACTERISTIC
/begin CHARACTERISTIC TNSOF "Entprellzeit zur Abschaltung der Nachstartaufweitung" VALUE 0xFCA1CF KwUb 5.100 t20msxs_ub_b5p1 0.00 5.100 FORMAT "%5.3" /end CHARACTERISTIC
/begin CHARACTERISTIC TOLREV "Temperaturschwelle fuer B_oelh" VALUE 0xFD054F KwUb 191.3 temp_ub_q0p75_o48 -48.00 143.3 FORMAT "%5.1" /end CHARACTERISTIC
/begin CHARACTERISTIC TOLTDENW "" VALUE 0xFC5EBE KwUb 191.3 temp_ub_q0p75_o48 -48.00 143.3 FORMAT "%5.1" /end CHARACTERISTIC
/begin CHARACTERISTIC TPHERKMN "minimale Motortemperatur f¸r Phasensuche" VALUE 0xFC1E01 KwWU8 191.3 temp_ub_q0p75_o48 -48.00 143.3 FORMAT "%5.1" /end CHARACTERISTIC
/begin CHARACTERISTIC TPHPL "Zeit [10ms] zur Plausibilisierung zwischen Nocken- und Kurbelwelle" VALUE 0xFC1E04 KwUb 255.0 dez 0.00 255.0 FORMAT "%5.1" /end CHARACTERISTIC
/begin CHARACTERISTIC TPHSSP "Sperrzeit f¸r Phasensuche nach erfolgloser Suche" VALUE 0xFCFA36 KwWU8 255.0 t_q1 0.00 255.0 FORMAT "%5.1" /end CHARACTERISTIC
/begin CHARACTERISTIC TRUHEVERL "" VALUE 0xFCC14C KwWU16 15359.766 txhistiruh 0.00 15359.766 FORMAT "%9.3" /end CHARACTERISTIC
/begin CHARACTERISTIC TVFSAM "Temperaturabh‰ngige Verzˆgerungszeit f¸r Fahrstufe AUS" CURVE 0xFD33CC GklWUb 5.100 t20msxs_ub_b5p1 0.00 5.100 FORMAT "%5.3"
 /begin AXIS_DESCR COM_AXIS tmot temp_ub_q0p75_o48 8 -48.00 143.3 FORMAT "%5.1" AXIS_PTS_REF STM08MDUB /end AXIS_DESCR
/end CHARACTERISTIC
/begin CHARACTERISTIC TVFSEM "Temperaturabh‰ngige Verzˆgerungszeit f¸r Fahrstufe EIN" CURVE 0xFD33D4 GklWUb 5.100 t20msxs_ub_b5p1 0.00 5.100 FORMAT "%5.3"
 /begin AXIS_DESCR COM_AXIS tmot temp_ub_q0p75_o48 8 -48.00 143.3 FORMAT "%5.1" AXIS_PTS_REF STM08MDUB /end AXIS_DESCR
/end CHARACTERISTIC
/begin CHARACTERISTIC TVFSRAM "motortemperaturabh‰ngige Verzˆgerungszeit f¸r Fahrstufe aus (R)" CURVE 0xFD33DC GklWUb 5.100 t20msxs_ub_b5p1 0.00 5.100 FORMAT "%5.3"
 /begin AXIS_DESCR COM_AXIS tmot temp_ub_q0p75_o48 8 -48.00 143.3 FORMAT "%5.1" AXIS_PTS_REF STM08MDUB /end AXIS_DESCR
/end CHARACTERISTIC
/begin CHARACTERISTIC TVFSREM "motortemperaturabh‰ngige Verzˆgerungszeit f¸r Fahrstufe ein (R)" CURVE 0xFD33E4 GklWUb 5.100 t20msxs_ub_b5p1 0.00 5.100 FORMAT "%5.3"
 /begin AXIS_DESCR COM_AXIS tmot temp_ub_q0p75_o48 8 -48.00 143.3 FORMAT "%5.1" AXIS_PTS_REF STM08MDUB /end AXIS_DESCR
/end CHARACTERISTIC
/begin CHARACTERISTIC TVFUE "Verzˆgerungszeit f¸r den Aufbau der F¸llung" VALUE 0xFC8DE8 KwUb 5.100 t20msxs_ub_b5p1 0.00 5.100 FORMAT "%5.3" /end CHARACTERISTIC
/begin CHARACTERISTIC TWDMAD "Wartezeit bis Freigabe der Adaption des Verlustmoments" VALUE 0xFD3337 KwUb 51.00 t200msxs_ub_b51 0.00 51.00 FORMAT "%5.2" /end CHARACTERISTIC
/begin CHARACTERISTIC T_CCRUHVER "" VALUE 0xFCC14E KwWU16 6553.500 t_q0p1 0.00 6553.500 FORMAT "%8.3" /end CHARACTERISTIC
/begin CHARACTERISTIC T_OSPGRSET "Zeit f¸r 1x Oberspannungsentprellungr¸cknahme" VALUE 0xFCC167 KwWU8 25.50 t_q0p1 0.00 25.50 FORMAT "%5.2" /end CHARACTERISTIC
/begin CHARACTERISTIC T_OSPGSET "Entrpellzeit FS_oberspannungserkennung" VALUE 0xFCC168 KwWU8 25.50 t_q0p1 0.00 25.50 FORMAT "%5.2" /end CHARACTERISTIC
/begin CHARACTERISTIC T_USPGRSET "Uterspannung Resetzeit" VALUE 0xFCC169 KwWU8 25.50 t_q0p1 0.00 25.50 FORMAT "%5.2" /end CHARACTERISTIC
/begin CHARACTERISTIC T_USPGSET "Zeit f¸r 1x Unterspannungsentprellung" VALUE 0xFCC16A KwWU8 25.50 t_q0p1 0.00 25.50 FORMAT "%5.2" /end CHARACTERISTIC
/begin CHARACTERISTIC UEVERG "‹bersetzungsverh‰ltnis abh. vom eingelegten Gang" CURVE 0xFC8DE9 FklWUb 15.94 fak_ub_b16 0.00 15.94 FORMAT "%5.2"
 /begin AXIS_DESCR FIX_AXIS gangi dez 8 0.00 7.000 FORMAT "%5.3" FIX_AXIS_PAR 0 0 8 /end AXIS_DESCR
/end CHARACTERISTIC
/begin CHARACTERISTIC UKWNMAXG "gangabh‰ngiger NW-Umdrehungsz‰hler f¸r NMAX Regelung" CURVE 0xFCA244 GklWUw 65535.00 dez 0.00 65535.00 FORMAT "%8.2"
 /begin AXIS_DESCR COM_AXIS gangi dez 8 0.00 255.0 FORMAT "%5.1" AXIS_PTS_REF SGA08MDUB /end AXIS_DESCR
/end CHARACTERISTIC
/begin CHARACTERISTIC USPGAPP "Unterspannungschwelle" VALUE 0xFCC150 KwWU16 16.383750 spg_uw_q0p25em3_o6 6.0000000 22.383750 FORMAT "%9.6" /end CHARACTERISTIC
/begin CHARACTERISTIC USPGHYST "Unterspannungshysterese" VALUE 0xFCC152 KwWU16 16.383750 spg_q0p25em3 0.00 16.383750 FORMAT "%9.6" /end CHARACTERISTIC
/begin CHARACTERISTIC USPGPRELLZ "Anzahl der FS_uspg Entprellungen f¸r Fehlereintrag" VALUE 0xFCC16B KwWU8 255.0 DEZ 0.00 255.0 FORMAT "%5.1" /end CHARACTERISTIC
/begin CHARACTERISTIC USPRELLDEC "Dekrement auf Entprellcounter Unterspannung" VALUE 0xFCC16C KwWU8 255.0 DEZ 0.00 255.0 FORMAT "%5.1" /end CHARACTERISTIC
/begin CHARACTERISTIC USPRELLINC "Inkrement auf Entprellcounter Unterspannung" VALUE 0xFCC16D KwWU8 255.0 DEZ 0.00 255.0 FORMAT "%5.1" /end CHARACTERISTIC
/begin CHARACTERISTIC UWNMAXLR "NW-Umdrehungsz‰hler f¸r NMAX Regelung bei Low Range" VALUE 0xFD3E72 KwUw 65535.00 dez 0.00 65535.00 FORMAT "%8.2" /end CHARACTERISTIC
/begin CHARACTERISTIC VFZZWS "Fahrzeuggeschwindigkeits-Schwelle Zwangshochschaltung" VALUE 0xFD0550 KwUb 318.8 vfzg_ub_q1p25 0.00 318.8 FORMAT "%5.1" /end CHARACTERISTIC
/begin CHARACTERISTIC VFZZWS_1 "" VALUE 0xFD0551 KwUb 318.8 vfzg_ub_q1p25 0.00 318.8 FORMAT "%5.1" /end CHARACTERISTIC
/begin CHARACTERISTIC VFZZWS_2 "" VALUE 0xFD0552 KwUb 318.8 vfzg_ub_q1p25 0.00 318.8 FORMAT "%5.1" /end CHARACTERISTIC
/begin CHARACTERISTIC VFZZWS_3 "" VALUE 0xFD0553 KwUb 318.8 vfzg_ub_q1p25 0.00 318.8 FORMAT "%5.1" /end CHARACTERISTIC
/begin CHARACTERISTIC ZFMDVERL "Zeitkonstante f¸r Filterung Verlustmoment" VALUE 0xFC8B7D KwUb 2.53000 zk20msxs_ub_b5p1 0.0200000 2.55000 FORMAT "%7.5" /end CHARACTERISTIC
/begin CHARACTERISTIC ZINMAXG "gangabh‰ngige I-Steigung f¸r NMAX-Regelung" CURVE 0xFCA204 GklWUb 2.54000 zk10msxs_ub_b2p55 0.0100000 2.55000 FORMAT "%7.5"
 /begin AXIS_DESCR COM_AXIS gangi dez 8 0.00 255.0 FORMAT "%5.1" AXIS_PTS_REF SGA08MDUB /end AXIS_DESCR
/end CHARACTERISTIC
/begin CHARACTERISTIC ZINMAXLR "I-Steigung f¸r NMAX-Regelung bei Low Range Betrieb" VALUE 0xFD3E40 KwUb 2.54000 zk10msxs_ub_b2p55 0.0100000 2.55000 FORMAT "%7.5" /end CHARACTERISTIC
/begin CHARACTERISTIC ZKDMADFK "Zeitkonstante f¸r Adaption des Verlustmoments Fahrstufe und Kompressor ein" VALUE 0xFD3340 KwUw 815.98754883 zk200msxs_uw_b13107 3.1999511719 819.18750000 FORMAT "%12.8" /end CHARACTERISTIC
/begin CHARACTERISTIC ZKDMADFS "Zeitkonstante f¸r Adaption des Verlustmoments Fahrstufe ein" VALUE 0xFD3342 KwUw 815.98754883 zk200msxs_uw_b13107 3.1999511719 819.18750000 FORMAT "%12.8" /end CHARACTERISTIC
/begin CHARACTERISTIC ZKDMADKO "Zeitkonstante f¸r Adaption des Verlustmoments Klimakompressor ein" VALUE 0xFD3344 KwUw 815.98754883 zk200msxs_uw_b13107 3.1999511719 819.18750000 FORMAT "%12.8" /end CHARACTERISTIC
/begin CHARACTERISTIC ZKDMADLL "Zeitkonstante f¸r Adaption des Verlustmoments ohne Last" VALUE 0xFD3346 KwUw 815.98754883 zk200msxs_uw_b13107 3.1999511719 819.18750000 FORMAT "%12.8" /end CHARACTERISTIC
/begin CHARACTERISTIC ZKDMDW "Zeitkonstante f¸r Abregelung D-Anteil Wandlermoment" VALUE 0xFC8DF1 KwUb 5.08000 zk20msxs_ub_b5p1 0.0200000 5.10000 FORMAT "%7.5" /end CHARACTERISTIC
/begin CHARACTERISTIC ZKMDGEN "Zeitkonstante Generator-Lastabregelung" VALUE 0xFC8D93 KwUb 5.08000 zk20msxs_ub_b5p1 0.0200000 5.10000 FORMAT "%7.5" /end CHARACTERISTIC
/begin CHARACTERISTIC ZKMDKO "Zeitkonstante Klimakompressor-Lastabregelung" VALUE 0xFC8D94 KwUb 5.08000 zk20msxs_ub_b5p1 0.0200000 5.10000 FORMAT "%7.5" /end CHARACTERISTIC
/begin CHARACTERISTIC ZKMDWAB "Zeitkonstante f¸r Abregelung der  Drehmomentaufnahme des Wandlers" VALUE 0xFC8DF2 KwUb 5.08000 zk20msxs_ub_b5p1 0.0200000 5.10000 FORMAT "%7.5" /end CHARACTERISTIC
/begin CHARACTERISTIC ZKMDWAUF "Zeitkonstante f¸r Aufregelung der  Drehmomentaufnahme des Wandlers" VALUE 0xFC8DF3 KwUb 5.08000 zk20msxs_ub_b5p1 0.0200000 5.10000 FORMAT "%7.5" /end CHARACTERISTIC
/begin CHARACTERISTIC ZKMDWF "Zeitkonstante f¸r Filterung Wandlermoment zur Bildung D-Anteil" VALUE 0xFC8DF4 KwUb 5.08000 zk20msxs_ub_b5p1 0.0200000 5.10000 FORMAT "%7.5" /end CHARACTERISTIC
/begin CHARACTERISTIC ZKUEVERG "Filterzeitkonstante: Turbinendrehzahl bei Gangwechsel" VALUE 0xFC8DF5 KwUb 5.08000 zk20msxs_ub_b5p1 0.0200000 5.10000 FORMAT "%7.5" /end CHARACTERISTIC
/begin CHARACTERISTIC ZLUTBGL "Filterkonstante zur Filterung Laufunruhegrˆssen f¸r Bankabgleich" VALUE 0xFC5EAE KwWU16 99.99847 rel_uw_b100 0.00 99.99847 FORMAT "%8.5" /end CHARACTERISTIC
/begin CHARACTERISTIC ZMDNSM "Zeitkonstante zur Abrgelung des Nachstart-Momentenoffset" CURVE 0xFD32FB KlAUbSstUbWUb 50.9992 zk200msxs_ub_b51p2 0.200784 51.2000 FORMAT "%7.4"
 /begin AXIS_DESCR STD_AXIS tmot temp_ub_q0p75_o48 8 -48.00 143.3 FORMAT "%5.1" DEPOSIT ABSOLUTE /end AXIS_DESCR
/end CHARACTERISTIC
/begin CHARACTERISTIC ZMDNSMVT "Zeitkonstante zur Abrgelung des Nachstart-Momentenoffset (VVT)" CURVE 0xFD330C KlAUbSstUbWUb 50.9992 zk200msxs_ub_b51p2 0.200784 51.2000 FORMAT "%7.4"
 /begin AXIS_DESCR STD_AXIS tmot temp_ub_q0p75_o48 8 -48.00 143.3 FORMAT "%5.1" DEPOSIT ABSOLUTE /end AXIS_DESCR
/end CHARACTERISTIC
/begin CHARACTERISTIC ZYLEAUS "auszublendender Zylinder" VALUE 0xFC1E02 KwWU8 255.0 dez 0.00 255.0 FORMAT "%5.1" /end CHARACTERISTIC
/begin CHARACTERISTIC Z_OEL1 "Zeitkonstante Modelltemperaturanteil aus tmot" VALUE 0xFC2208 KwWU16 99.99847 rel_uw_b100 0.00 99.99847 FORMAT "%8.5" /end CHARACTERISTIC
/begin CHARACTERISTIC Z_OEL2 "Zeitkonstante Modelltemperaturanteil aus n_mot und rl" VALUE 0xFC220A KwWU16 99.99847 rel_uw_b100 0.00 99.99847 FORMAT "%8.5" /end CHARACTERISTIC
/begin CHARACTERISTIC Z_OEL3 "Zeitkonstante Modelltemperaturanteil aus tumg und vfz" VALUE 0xFC220C KwWU16 99.99847 rel_uw_b100 0.00 99.99847 FORMAT "%8.5" /end CHARACTERISTIC
/begin MEASUREMENT abtim_b "Abstellzeit" UBYTE dez 1 100 0 255 FORMAT "%5.1" ECU_ADDRESS 0x4038C4 /end MEASUREMENT
/begin MEASUREMENT anzeausb "Anzahl der auszublendenen Einspritzungen; begrenzt zwischen 4 und 7" UBYTE dez 1 100 0 200 FORMAT "%5.1" ECU_ADDRESS 0x4038B9 /end MEASUREMENT
/begin MEASUREMENT anzkwu_w "Anzahl KW-Umdrehungen" UWORD dez 1 100 0 65535 FORMAT "%8.2" ECU_ADDRESS 0x404226 /end MEASUREMENT
/begin MEASUREMENT batt_index "" UBYTE DEZ 1 100 0 255 FORMAT "%5.1" ECU_ADDRESS 0x4033B6 /end MEASUREMENT
/begin MEASUREMENT bnctrmx1s "" UBYTE DEZ 1 100 0 255 FORMAT "%5.1" ECU_ADDRESS 0x40339B /end MEASUREMENT
/begin MEASUREMENT bnsctr "Counter Bordnetzspannungsplausibilisierung" UBYTE DEZ 1 100 0 255 FORMAT "%5.1" ECU_ADDRESS 0x3FE230 /end MEASUREMENT
/begin MEASUREMENT bnsctrant0 "Counter 1sec Anteile ohne Grenzwertueberschreitung" ULONG t_q1 1 100 0 4.29497e+009 FORMAT "%13.2" ECU_ADDRESS 0x3FE22C /end MEASUREMENT
/begin MEASUREMENT bnsctrant1 "Counter 1sec Anteile 1ter Bereich" UWORD t_q1 1 100 0 65535 FORMAT "%8.2" ECU_ADDRESS 0x3FE226 /end MEASUREMENT
/begin MEASUREMENT bnsctrant2 "Counter 1sec Anteile 2ter Bereich" UWORD t_q1 1 100 0 65535 FORMAT "%8.2" ECU_ADDRESS 0x3FE228 /end MEASUREMENT
/begin MEASUREMENT bnsctrant3 "Counter 1sec Anteile 3ter Bereich" UWORD t_q1 1 100 0 65535 FORMAT "%8.2" ECU_ADDRESS 0x3FE22A /end MEASUREMENT
/begin MEASUREMENT bos01_w "BOS ÷lqualit‰t" SWORD km_sw_q10 1 100 -327680 327670 FORMAT "%8.1" ECU_ADDRESS 0x3FE96C /end MEASUREMENT
/begin MEASUREMENT bosbtvfbk "BOS-Bauteilverf¸gbarkeit" UBYTE rel_ub_q1 1 100 0 255 FORMAT "%5.1" ECU_ADDRESS 0x3FE96E /end MEASUREMENT
/begin MEASUREMENT bosbtvfbkt "Verf¸gbarkeit vom Tester" UBYTE DEZ 1 100 0 255 FORMAT "%5.1" ECU_ADDRESS 0x40311C /end MEASUREMENT
/begin MEASUREMENT bosstate "BOS-Status Einheit" UBYTE DEZ 1 100 0 255 FORMAT "%5.1" ECU_ADDRESS 0x403110 /end MEASUREMENT
/begin MEASUREMENT bttregind "" UBYTE DEZ 1 100 0 255 FORMAT "%5.1" ECU_ADDRESS 0x4033B7 /end MEASUREMENT
/begin MEASUREMENT B_3ph "Bedingung, daﬂ dritte Phasenflankeninformation vorliegt" UBYTE B_TRUE 1 100 0 1 BIT_MASK 0x1 FORMAT "%13.11" ECU_ADDRESS 0x3FBF78 /end MEASUREMENT
/begin MEASUREMENT B_4ph "Bedingung, daﬂ vierte Phasenflankeninformation vorliegt" UBYTE B_TRUE 1 100 0 1 BIT_MASK 0x1 FORMAT "%13.11" ECU_ADDRESS 0x3FBF79 /end MEASUREMENT
/begin MEASUREMENT B_adwfk "Bedingung Adaptionswert Fahrstufe und Kompressor ein verwenden" UBYTE B_TRUE 1 100 0 1 BIT_MASK 0x1 FORMAT "%13.11" ECU_ADDRESS 0x3FC234 /end MEASUREMENT
/begin MEASUREMENT B_adwfs "Bedingung Adaptionswert Fahrstufe ein verwenden" UBYTE B_TRUE 1 100 0 1 BIT_MASK 0x1 FORMAT "%13.11" ECU_ADDRESS 0x3FC235 /end MEASUREMENT
/begin MEASUREMENT B_adwko "Bedingung Adaptionswert Klimakompressor ein verwenden" UBYTE B_TRUE 1 100 0 1 BIT_MASK 0x1 FORMAT "%13.11" ECU_ADDRESS 0x3FC236 /end MEASUREMENT
/begin MEASUREMENT B_blkfb "MIL-Ansteuerung blinkend fremdbestimmt durch externes SG" UBYTE B_TRUE 1 100 0 1 BIT_MASK 0x1 FORMAT "%13.11" ECU_ADDRESS 0x3FBEFB /end MEASUREMENT
/begin MEASUREMENT B_bns "Bit Bordnetzspannungsplausibilisierung" UBYTE B_TRUE 1 100 0 1 FORMAT "%13.11" ECU_ADDRESS 0x3FE224 /end MEASUREMENT
/begin MEASUREMENT B_bosmsgc "Bedingung ƒnderung im BOS" UBYTE B_TRUE 1 100 0 1 BIT_MASK 0x8 FORMAT "%13.11" ECU_ADDRESS 0x403113 /end MEASUREMENT
/begin MEASUREMENT B_calcdper "Bedingung f¸r Berechnung Restweg aus Er" UBYTE B_TRUE 1 100 0 1 BIT_MASK 0x2 FORMAT "%13.11" ECU_ADDRESS 0x3FE9F6 /end MEASUREMENT
/begin MEASUREMENT B_ccbtnach "Batterie nachladen" UBYTE B_TRUE 1 100 0 1 FORMAT "%13.11" ECU_ADDRESS 0x40339E /end MEASUREMENT
/begin MEASUREMENT B_ccbttdfk "Batterie pr¸fen" UBYTE B_TRUE 1 100 0 1 FORMAT "%13.11" ECU_ADDRESS 0x40339F /end MEASUREMENT
/begin MEASUREMENT B_ccbttknt "Batteriekontakt /-anschl¸sse pr¸fen!" UBYTE B_TRUE 1 100 0 1 FORMAT "%13.11" ECU_ADDRESS 0x4033A0 /end MEASUREMENT
/begin MEASUREMENT B_ccpmerr "Batterie¸berwachung ausgefallen" UBYTE B_TRUE 1 100 0 1 FORMAT "%13.11" ECU_ADDRESS 0x4033A1 /end MEASUREMENT
/begin MEASUREMENT B_ccprio "Komfortverbraucher eingeschr‰nkt" UBYTE B_TRUE 1 100 0 1 FORMAT "%13.11" ECU_ADDRESS 0x4033A2 /end MEASUREMENT
/begin MEASUREMENT B_ccruhver "Erhˆhte Batterieentladung im Stand" UBYTE B_TRUE 1 100 0 1 FORMAT "%13.11" ECU_ADDRESS 0x4033A3 /end MEASUREMENT
/begin MEASUREMENT B_clradllr "Bedingung:  Adaptionswerte LL-Regelung selektiv loeschen" UBYTE B_TRUE 1 100 0 1 BIT_MASK 0x1 FORMAT "%13.11" ECU_ADDRESS 0x3FC237 /end MEASUREMENT
/begin MEASUREMENT B_clradmhb "Bedingung: Adaptionswerte Min.-Hub VVT selektiv loeschen" UBYTE B_TRUE 1 100 0 1 FORMAT "%13.11" ECU_ADDRESS 0x40379F /end MEASUREMENT
/begin MEASUREMENT B_codierpm "Bedingung Sendeanforderung Anfrage Codierung PWM" UBYTE B_TRUE 1 100 0 1 FORMAT "%13.11" ECU_ADDRESS 0x4033A4 /end MEASUREMENT
/begin MEASUREMENT B_dmeini "Bedingung f¸r neue noch nicht initialisierte DME" UBYTE B_TRUE 1 100 0 1 BIT_MASK 0x2 FORMAT "%13.11" ECU_ADDRESS 0x3FE9A4 /end MEASUREMENT
/begin MEASUREMENT B_dmewech "Bedingung f¸r getauschte DME zur Aktualisierung der BOS-Werte" UBYTE B_TRUE 1 100 0 1 BIT_MASK 0x1 FORMAT "%13.11" ECU_ADDRESS 0x3FE9A4 /end MEASUREMENT
/begin MEASUREMENT B_dmrwan "Bedingung Aufbau Momentenreserve f¸r Wandlermoment" UBYTE B_TRUE 1 100 0 1 BIT_MASK 0x1 FORMAT "%13.11" ECU_ADDRESS 0x3FC23D /end MEASUREMENT
/begin MEASUREMENT B_dopzue "Bedingung doppelte Z¸ndausgabe(Phasengebernotlauf)" UBYTE B_TRUE 1 100 0 1 BIT_MASK 0x1 FORMAT "%13.11" ECU_ADDRESS 0x4038BA /end MEASUREMENT
/begin MEASUREMENT B_egszwgs "EGS-Zwangschaltung wegen hoher tmot" UBYTE B_TRUE 1 100 0 1 BIT_MASK 0x1 FORMAT "%13.11" ECU_ADDRESS 0x3FC047 /end MEASUREMENT
/begin MEASUREMENT B_ensynnl "Freigabe der Synchronisation f¸r Notlauf-Drehzahlgeber" UBYTE B_TRUE 1 100 0 1 BIT_MASK 0x1 FORMAT "%13.11" ECU_ADDRESS 0x3FBF7A /end MEASUREMENT
/begin MEASUREMENT B_fsu "Bedingung Fahrstufe, Umschaltung" UBYTE B_TRUE 1 100 0 1 BIT_MASK 0x1 FORMAT "%13.11" ECU_ADDRESS 0x3FC23E /end MEASUREMENT
/begin MEASUREMENT B_histrset "IBS Histrogramm darf gelˆscht werden." UBYTE B_TRUE 1 100 0 1 FORMAT "%13.11" ECU_ADDRESS 0x4033A5 /end MEASUREMENT
/begin MEASUREMENT B_inidtf "Bedingung Initialisierung Filter" UBYTE B_TRUE 1 100 0 1 BIT_MASK 0x1 FORMAT "%13.11" ECU_ADDRESS 0x3FC268 /end MEASUREMENT
/begin MEASUREMENT B_lltdoff "Bedingung fuer Teildrosselung nicht mehr aktiv" UBYTE B_TRUE 1 100 0 1 FORMAT "%13.11" ECU_ADDRESS 0x4037A0 /end MEASUREMENT
/begin MEASUREMENT B_llum "" UBYTE B_TRUE 1 100 0 1 FORMAT "%13.11" ECU_ADDRESS 0x4037A1 /end MEASUREMENT
/begin MEASUREMENT B_madfk "Bedingung Momentenadaption Fahrstufe und Klimakompressor ein" UBYTE B_TRUE 1 100 0 1 BIT_MASK 0x1 FORMAT "%13.11" ECU_ADDRESS 0x3FC238 /end MEASUREMENT
/begin MEASUREMENT B_madfs "Bedingung Momentenadaption Fahrstufe ein" UBYTE B_TRUE 1 100 0 1 BIT_MASK 0x1 FORMAT "%13.11" ECU_ADDRESS 0x3FC239 /end MEASUREMENT
/begin MEASUREMENT B_madko "Bedingung Momentenadaption Klimakompressor ein" UBYTE B_TRUE 1 100 0 1 BIT_MASK 0x1 FORMAT "%13.11" ECU_ADDRESS 0x3FC23A /end MEASUREMENT
/begin MEASUREMENT B_madll "Bedingung Momentenadaption ohne Last" UBYTE B_TRUE 1 100 0 1 BIT_MASK 0x1 FORMAT "%13.11" ECU_ADDRESS 0x3FC23B /end MEASUREMENT
/begin MEASUREMENT B_madstp "Bedingung Momentenadaption durch Fehler im System gestoppt" UBYTE B_TRUE 1 100 0 1 BIT_MASK 0x1 FORMAT "%13.11" ECU_ADDRESS 0x3FC23C /end MEASUREMENT
/begin MEASUREMENT B_mbst "Bedingung spezielle Momentenbegrenzung w‰hrend Start und kurz nach Start" UBYTE B_TRUE 1 100 0 1 BIT_MASK 0x1 FORMAT "%13.11" ECU_ADDRESS 0x3FC269 /end MEASUREMENT
/begin MEASUREMENT B_mdbglst "Bedingung: St‰ndige Begrenzung milsol_w auf miszull_w im Schicht" UBYTE B_TRUE 1 100 0 1 BIT_MASK 0x1 FORMAT "%13.11" ECU_ADDRESS 0x3FC26A /end MEASUREMENT
/begin MEASUREMENT B_mdblst "Bedingung: St‰ndige Begrenzung des Luftsollmoments milsol_w auf miszull_w" UBYTE B_TRUE 1 100 0 1 BIT_MASK 0x1 FORMAT "%13.11" ECU_ADDRESS 0x3FC26B /end MEASUREMENT
/begin MEASUREMENT B_mdbresl "Bedingung: Restierung B_mibeg nur bei inaktiver Luftbegrenzung" UBYTE B_TRUE 1 100 0 1 BIT_MASK 0x1 FORMAT "%13.11" ECU_ADDRESS 0x3FC26C /end MEASUREMENT
/begin MEASUREMENT B_mdbza "Bedingung: Z¸ndwinkeleingriff bei B_mibeg freigegeben" UBYTE B_TRUE 1 100 0 1 BIT_MASK 0x1 FORMAT "%13.11" ECU_ADDRESS 0x3FC26D /end MEASUREMENT
/begin MEASUREMENT B_milfb "MIL-Ansteuerung fremdbestimmt durch externes SG" UBYTE B_TRUE 1 100 0 1 BIT_MASK 0x1 FORMAT "%13.11" ECU_ADDRESS 0x3FBEFC /end MEASUREMENT
/begin MEASUREMENT B_minhub1 "" UBYTE B_TRUE 1 100 0 1 FORMAT "%13.11" ECU_ADDRESS 0x4037A2 /end MEASUREMENT
/begin MEASUREMENT B_minhub2 "" UBYTE B_TRUE 1 100 0 1 FORMAT "%13.11" ECU_ADDRESS 0x4037A3 /end MEASUREMENT
/begin MEASUREMENT B_minhubvs "Bedingung fuer Adaptionswerte werden geloescht" UBYTE B_TRUE 1 100 0 1 FORMAT "%13.11" ECU_ADDRESS 0x4037A4 /end MEASUREMENT
/begin MEASUREMENT B_mnfaktiv "Bedingung fuer Hochlaufen mnfaktiv" UBYTE B_TRUE 1 100 0 1 FORMAT "%13.11" ECU_ADDRESS 0x4037A5 /end MEASUREMENT
/begin MEASUREMENT B_mol_vb "Bedingung ÷lverbrauchswarnung" UBYTE B_TRUE 1 100 0 1 BIT_MASK 0x2 FORMAT "%13.11" ECU_ADDRESS 0x403113 /end MEASUREMENT
/begin MEASUREMENT B_mol_vl "Bedingung ÷lverlustwarnung" UBYTE B_TRUE 1 100 0 1 BIT_MASK 0x4 FORMAT "%13.11" ECU_ADDRESS 0x403113 /end MEASUREMENT
/begin MEASUREMENT B_mtol_ini "Merker erste 100ms zur Initialisierung" UBYTE dez 1 100 0 255 FORMAT "%5.1" ECU_ADDRESS 0x4038C5 /end MEASUREMENT
/begin MEASUREMENT B_mzns "Nachstartaufweitung des zul. Moments aktiv" UBYTE B_TRUE 1 100 0 1 BIT_MASK 0x1 FORMAT "%13.11" ECU_ADDRESS 0x3FC26E /end MEASUREMENT
/begin MEASUREMENT B_nachl "Steuerung SG-Nachlauf" UWORD B_TRUE 1 100 0 1 BIT_MASK 0x8000 FORMAT "%13.11" ECU_ADDRESS 0x3FE1F0 /end MEASUREMENT
/begin MEASUREMENT B_nachlend "Bedingung SG-Nachlauf regul‰r beendet" UWORD B_TRUE 1 100 0 1 BIT_MASK 0x4000 FORMAT "%13.11" ECU_ADDRESS 0x3FE1F0 /end MEASUREMENT
/begin MEASUREMENT B_nachln "Steuerung SG-Nachlauf nach n > NMIN" UBYTE B_TRUE 1 100 0 1 BIT_MASK 0x2 FORMAT "%13.11" ECU_ADDRESS 0x403D5D /end MEASUREMENT
/begin MEASUREMENT B_nachlnd7 "" UBYTE B_TRUE 1 100 0 1 FORMAT "%13.11" ECU_ADDRESS 0x40339A /end MEASUREMENT
/begin MEASUREMENT B_nachlram "Steuerung SG-Nachlauf mit Systemcheck" UBYTE B_TRUE 1 100 0 1 BIT_MASK 0x1 FORMAT "%13.11" ECU_ADDRESS 0x3FC277 /end MEASUREMENT
/begin MEASUREMENT B_nl10 "Bedingung EC-L¸fternachlaufsteuerung mit 10 Hz" UBYTE B_TRUE 1 100 0 1 BIT_MASK 0x1 FORMAT "%13.11" ECU_ADDRESS 0x403D5D /end MEASUREMENT
/begin MEASUREMENT B_nlacls "Anforderung Steuerger‰tenachlauf von AC-L¸ftersteuerung" UWORD B_TRUE 1 100 0 1 BIT_MASK 0x2 FORMAT "%13.11" ECU_ADDRESS 0x3FE1F0 /end MEASUREMENT
/begin MEASUREMENT B_nlale "Anforderung Steuerger‰tenachlauf von Funktion ALE" UWORD B_TRUE 1 100 0 1 BIT_MASK 0x1 FORMAT "%13.11" ECU_ADDRESS 0x3FE1F0 /end MEASUREMENT
/begin MEASUREMENT B_nlatm "Anforderung Steuerger‰tenachlauf f¸r Abgastemp.Modell Sondenschutz" UWORD B_TRUE 1 100 0 1 BIT_MASK 0x400 FORMAT "%13.11" ECU_ADDRESS 0x3FE1F0 /end MEASUREMENT
/begin MEASUREMENT B_nlcan "Bedingung f¸r SG-Nachlauf von CAN" UWORD B_TRUE 1 100 0 1 BIT_MASK 0x200 FORMAT "%13.11" ECU_ADDRESS 0x3FE1F0 /end MEASUREMENT
/begin MEASUREMENT B_nldte_motaus "" UWORD B_TRUE 1 100 0 1 BIT_MASK 0x100 FORMAT "%13.11" ECU_ADDRESS 0x3FE1F0 /end MEASUREMENT
/begin MEASUREMENT B_nlEEPR "Bedingung Nachlauf EEPROM schreiben" UWORD B_TRUE 1 100 0 1 BIT_MASK 0x20 FORMAT "%13.11" ECU_ADDRESS 0x3FE1F0 /end MEASUREMENT
/begin MEASUREMENT B_nlmls "Anforderung Steuerger‰tenachlauf von Motor-L¸ftersteuerung" UWORD B_TRUE 1 100 0 1 BIT_MASK 0x8 FORMAT "%13.11" ECU_ADDRESS 0x3FE1F0 /end MEASUREMENT
/begin MEASUREMENT B_nlobd "Anforderung Steuerger‰tenachlauf von OBD" UWORD B_TRUE 1 100 0 1 BIT_MASK 0x10 FORMAT "%13.11" ECU_ADDRESS 0x3FE1F0 /end MEASUREMENT
/begin MEASUREMENT B_nlph "Bedingung kein Phasensignal von den Phasengebern" UBYTE B_TRUE 1 100 0 1 BIT_MASK 0x2 FORMAT "%13.11" ECU_ADDRESS 0x4038BA /end MEASUREMENT
/begin MEASUREMENT B_nlsgls "Anforderung Steuerger‰tenachlauf von Steuerger‰te-L¸ftersteuerung" UWORD B_TRUE 1 100 0 1 BIT_MASK 0x40 FORMAT "%13.11" ECU_ADDRESS 0x3FE1F0 /end MEASUREMENT
/begin MEASUREMENT B_nlsiko "Bedingung Nachlauf EGAS-‹berwachung" UWORD B_TRUE 1 100 0 1 BIT_MASK 0x80 FORMAT "%13.11" ECU_ADDRESS 0x3FE1F0 /end MEASUREMENT
/begin MEASUREMENT B_nlvvtchk "Bedingung Anforderung Steuerger‰tenachlauf f¸r Anschlagadaption VVT" UWORD B_TRUE 1 100 0 1 BIT_MASK 0x800 FORMAT "%13.11" ECU_ADDRESS 0x3FE1F0 /end MEASUREMENT
/begin MEASUREMENT B_nlwst "Anforderung Steuerger‰tenachlauf f¸r Wiederholstarterkennung" UWORD B_TRUE 1 100 0 1 BIT_MASK 0x4 FORMAT "%13.11" ECU_ADDRESS 0x3FE1F0 /end MEASUREMENT
/begin MEASUREMENT B_nmax "Bedingung Drehzahlbegrenzung aktiv" UBYTE B_TRUE 1 100 0 1 BIT_MASK 0x1 FORMAT "%13.11" ECU_ADDRESS 0x3FC271 /end MEASUREMENT
/begin MEASUREMENT B_nmaxd "Bedingung Drehzahlbegrenzung mit Einspritzausblendung an allen Zylindern" UBYTE B_TRUE 1 100 0 1 BIT_MASK 0x1 FORMAT "%13.11" ECU_ADDRESS 0x3FC272 /end MEASUREMENT
/begin MEASUREMENT B_nmberror "Netzwerk-Management-Bus gestˆrt" UBYTE B_TRUE 1 100 0 1 BIT_MASK 0x1 FORMAT "%13.11" ECU_ADDRESS 0x402840 /end MEASUREMENT
/begin MEASUREMENT B_nmbsleep "Netzwerk-Management-Bus eingeschlafen" UBYTE B_TRUE 1 100 0 1 BIT_MASK 0x1 FORMAT "%13.11" ECU_ADDRESS 0x402841 /end MEASUREMENT
/begin MEASUREMENT B_nmotok "Motordrehzahl nmot=0 ist plausibel" UBYTE B_TRUE 1 100 0 1 BIT_MASK 0x1 FORMAT "%13.11" ECU_ADDRESS 0x3FBF7E /end MEASUREMENT
/begin MEASUREMENT B_noknldg "Drehzahl ist in zul‰ssigem Fenster f¸r Synchronisation im Notlauf" UBYTE B_TRUE 1 100 0 1 BIT_MASK 0x1 FORMAT "%13.11" ECU_ADDRESS 0x3FBF7B /end MEASUREMENT
/begin MEASUREMENT B_nozwe "Bedingung kein Z¸ndwinkeleingriff der Drehmomentstruktur" UBYTE B_TRUE 1 100 0 1 BIT_MASK 0x1 FORMAT "%13.11" ECU_ADDRESS 0x3FC373 /end MEASUREMENT
/begin MEASUREMENT B_nsakt "Nachstart aktiv f¸r Nachstartaufweitung" UBYTE B_TRUE 1 100 0 1 BIT_MASK 0x1 FORMAT "%13.11" ECU_ADDRESS 0x3FC26F /end MEASUREMENT
/begin MEASUREMENT B_nsend "Nachstart¸berwachungszeit abgelaufen" UBYTE B_TRUE 1 100 0 1 BIT_MASK 0x1 FORMAT "%13.11" ECU_ADDRESS 0x3FC270 /end MEASUREMENT
/begin MEASUREMENT B_nwmoff "Bedingung Netzwerkmanagement aus, von CAN empfangen" UBYTE B_TRUE 1 100 0 1 BIT_MASK 0x1 FORMAT "%13.11" ECU_ADDRESS 0x402842 /end MEASUREMENT
/begin MEASUREMENT B_nwref "Nockenwelle ist definiert in Referenzposition" UBYTE B_TRUE 1 100 0 1 BIT_MASK 0x1 FORMAT "%13.11" ECU_ADDRESS 0x3FBF7C /end MEASUREMENT
/begin MEASUREMENT B_oelh "Oeltemp. groesser TOLREV" UBYTE dez 1 100 0 255 FORMAT "%5.1" ECU_ADDRESS 0x4038C6 /end MEASUREMENT
/begin MEASUREMENT B_oeltemp "Bedingung f¸r CAN-Ausgabe der ÷ltemperatur" UBYTE B_TRUE 1 100 0 1 BIT_MASK 0x1 FORMAT "%13.11" ECU_ADDRESS 0x403113 /end MEASUREMENT
/begin MEASUREMENT B_oelwech "Bedingung ÷lwechsel erfolgt" UBYTE B_TRUE 1 100 0 1 BIT_MASK 0x2 FORMAT "%13.11" ECU_ADDRESS 0x40311E /end MEASUREMENT
/begin MEASUREMENT B_optpherk "Bedingung geeigneter Motorbetriebszustand f¸r Phasenerkennung" UBYTE B_TRUE 1 100 0 1 BIT_MASK 0x4 FORMAT "%13.11" ECU_ADDRESS 0x4038BA /end MEASUREMENT
/begin MEASUREMENT B_ozcntini "Bedingung f¸r Initialisierung ÷lzeitz‰hler" UBYTE B_TRUE 1 100 0 1 BIT_MASK 0x1 FORMAT "%13.11" ECU_ADDRESS 0x3FEA0A /end MEASUREMENT
/begin MEASUREMENT B_ozdperm "Bedingung Delta Er-Ermittlung aktiv" UBYTE B_TRUE 1 100 0 1 BIT_MASK 0x1 FORMAT "%13.11" ECU_ADDRESS 0x3FE9F5 /end MEASUREMENT
/begin MEASUREMENT B_ozer0ok "Bedingung Permittivit‰t beim letztem ÷lwechsel endg¸ltig berechnet" UBYTE B_TRUE 1 100 0 1 BIT_MASK 0x2 FORMAT "%13.11" ECU_ADDRESS 0x3FE9F5 /end MEASUREMENT
/begin MEASUREMENT B_ozeranz "Bedingung f¸r Anzeige Restweg aus Er" UBYTE B_TRUE 1 100 0 1 BIT_MASK 0x10 FORMAT "%13.11" ECU_ADDRESS 0x3FE9F5 /end MEASUREMENT
/begin MEASUREMENT B_ozerplt "Bedingung Ausheizzeit erf¸llt" UBYTE B_TRUE 1 100 0 1 BIT_MASK 0x4 FORMAT "%13.11" ECU_ADDRESS 0x3FE9F5 /end MEASUREMENT
/begin MEASUREMENT B_ozkl15 "Merker f¸r Einschalten Kl. 15" UBYTE B_TRUE 1 100 0 1 BIT_MASK 0x1 FORMAT "%13.11" ECU_ADDRESS 0x3FE96F /end MEASUREMENT
/begin MEASUREMENT B_ozkrzkor "Bedingung drehzahlkorrigierter Kurzzeit Niveaumittelwert berechnet" UBYTE B_TRUE 1 100 0 1 BIT_MASK 0x1 FORMAT "%13.11" ECU_ADDRESS 0x40312B /end MEASUREMENT
/begin MEASUREMENT B_ozlangmw "Bedingung langzeitiger Mittelwert berechnet" UBYTE B_TRUE 1 100 0 1 BIT_MASK 0x1 FORMAT "%13.11" ECU_ADDRESS 0x3FE9A9 /end MEASUREMENT
/begin MEASUREMENT B_ozlw1 "Bedingung mindestens 1 g¸ltiger Langzeitmittelwert war vorhanden" UBYTE B_TRUE 1 100 0 1 BIT_MASK 0x1 FORMAT "%13.11" ECU_ADDRESS 0x3FE9A8 /end MEASUREMENT
/begin MEASUREMENT B_ozlw2 "Bedingung 1 Langzeitwert vorhanden und 2. Motorstart" UBYTE B_TRUE 1 100 0 1 BIT_MASK 0x2 FORMAT "%13.11" ECU_ADDRESS 0x40312B /end MEASUREMENT
/begin MEASUREMENT B_oznferk "Bedingung Nachf¸llerkennung durchgef¸hrt" UBYTE B_TRUE 1 100 0 1 BIT_MASK 0x4 FORMAT "%13.11" ECU_ADDRESS 0x40312B /end MEASUREMENT
/begin MEASUREMENT B_ozniv "Bedingung Niveausignal in Ordnung" UBYTE B_TRUE 1 100 0 1 BIT_MASK 0x10 FORMAT "%13.11" ECU_ADDRESS 0x40311E /end MEASUREMENT
/begin MEASUREMENT B_ozor "Bedingung Orientierungsmessung erfolgt" UBYTE B_TRUE 1 100 0 1 BIT_MASK 0x1 FORMAT "%13.11" ECU_ADDRESS 0x40312C /end MEASUREMENT
/begin MEASUREMENT B_ozper0ok "Bedingung, dass g¸ltiger Start-Permittivit‰tswert vorliegt" UBYTE B_TRUE 1 100 0 1 BIT_MASK 0x1 FORMAT "%13.11" ECU_ADDRESS 0x3FE9F6 /end MEASUREMENT
/begin MEASUREMENT B_ozperm "Bedingung Permittivit‰tssignal in Ordnung" UBYTE B_TRUE 1 100 0 1 BIT_MASK 0x4 FORMAT "%13.11" ECU_ADDRESS 0x40311E /end MEASUREMENT
/begin MEASUREMENT B_ozpermgl "Bedingung g¸ltiger Permittivit‰tsmittelwert vorhanden" UBYTE B_TRUE 1 100 0 1 BIT_MASK 0x1 FORMAT "%13.11" ECU_ADDRESS 0x403154 /end MEASUREMENT
/begin MEASUREMENT B_ozpermpl "Bedingung Permittivit‰tsmittelwertbildung aktivieren" UBYTE B_TRUE 1 100 0 1 BIT_MASK 0x2 FORMAT "%13.11" ECU_ADDRESS 0x403154 /end MEASUREMENT
/begin MEASUREMENT B_ozregstg "Bedingung Schieberegistersteuerung" UBYTE B_TRUE 1 100 0 1 BIT_MASK 0x8 FORMAT "%13.11" ECU_ADDRESS 0x3FE9F5 /end MEASUREMENT
/begin MEASUREMENT B_oztemp "Bedingung Temperatursignal in Ordnung" UBYTE B_TRUE 1 100 0 1 BIT_MASK 0x8 FORMAT "%13.11" ECU_ADDRESS 0x40311E /end MEASUREMENT
/begin MEASUREMENT B_ozvfchg "Bedingung f¸r ge‰nderte eingepr‰gte Verf¸gbarkeit" UBYTE B_TRUE 1 100 0 1 BIT_MASK 0x20 FORMAT "%13.11" ECU_ADDRESS 0x40311E /end MEASUREMENT
/begin MEASUREMENT B_ozvormw "Bedingung vorgezogener Mittelwert berechnet" UBYTE B_TRUE 1 100 0 1 BIT_MASK 0x2 FORMAT "%13.11" ECU_ADDRESS 0x40312C /end MEASUREMENT
/begin MEASUREMENT B_pcoschg "PMPRSVCALC darf ctrpcos ‰ndern." UBYTE B_TRUE 1 100 0 1 FORMAT "%13.11" ECU_ADDRESS 0x4033A6 /end MEASUREMENT
/begin MEASUREMENT B_phsnl "Bedingung Phasensuche w‰hrend PG-Notlauf" UBYTE B_TRUE 1 100 0 1 BIT_MASK 0x8 FORMAT "%13.11" ECU_ADDRESS 0x4038BA /end MEASUREMENT
/begin MEASUREMENT B_phsnlab "Bedingung Phasensuche w‰hrend PG-Notlauf abgeschlossen" UBYTE B_TRUE 1 100 0 1 BIT_MASK 0x1 FORMAT "%13.11" ECU_ADDRESS 0x4038BB /end MEASUREMENT
/begin MEASUREMENT B_phsnlinv "Bedingung Phaselage invertieren" UBYTE B_TRUE 1 100 0 1 BIT_MASK 0x10 FORMAT "%13.11" ECU_ADDRESS 0x4038BA /end MEASUREMENT
/begin MEASUREMENT B_phsnlok "Bedingung Phasensuche w‰hrend PG-Notlauf erfolgreich" UBYTE B_TRUE 1 100 0 1 BIT_MASK 0x20 FORMAT "%13.11" ECU_ADDRESS 0x4038BA /end MEASUREMENT
/begin MEASUREMENT B_phsnls "Bedingung Start der Notlauf Phasensuche" UBYTE B_TRUE 1 100 0 1 BIT_MASK 0x2 FORMAT "%13.11" ECU_ADDRESS 0x4038BB /end MEASUREMENT
/begin MEASUREMENT B_resetsyn "R¸cksetzbedingung f¸r die Notlaufsynchronisation" UBYTE B_TRUE 1 100 0 1 BIT_MASK 0x1 FORMAT "%13.11" ECU_ADDRESS 0x3FBF7D /end MEASUREMENT
/begin MEASUREMENT B_rgang "Bedingung R¸ckw‰rtsgang eingelegt" UBYTE B_TRUE 1 100 0 1 BIT_MASK 0x1 FORMAT "%13.11" ECU_ADDRESS 0x3FC23F /end MEASUREMENT
/begin MEASUREMENT B_rwanz0 "Bedingung f¸r Restweganzeige = Null" UBYTE B_TRUE 1 100 0 1 BIT_MASK 0x2 FORMAT "%13.11" ECU_ADDRESS 0x3FEA0A /end MEASUREMENT
/begin MEASUREMENT B_ssll "Bedingung f¸r minub_w f¸r TMINHUBMX am oberen Anschlag" UBYTE B_TRUE 1 100 0 1 FORMAT "%13.11" ECU_ADDRESS 0x4037A6 /end MEASUREMENT
/begin MEASUREMENT B_svcntchg "Bedingung f¸r ¸ber Tester ge‰nderten Servicez‰hler" UBYTE B_TRUE 1 100 0 1 BIT_MASK 0x1 FORMAT "%13.11" ECU_ADDRESS 0x40311E /end MEASUREMENT
/begin MEASUREMENT B_synnot "Verbot der Einspritzung wenn Phasensynchronisation nicht gefunden werden kann" UBYTE B_TRUE 1 100 0 1 BIT_MASK 0x80 FORMAT "%13.11" ECU_ADDRESS 0x4038BA /end MEASUREMENT
/begin MEASUREMENT B_tamlu "Bedingung Umschaltung min. Tastverh‰ltnis Ansteuerung Motorl¸fter" UBYTE B_TRUE 1 100 0 1 BIT_MASK 0x4 FORMAT "%13.11" ECU_ADDRESS 0x403D5D /end MEASUREMENT
/begin MEASUREMENT B_tdadon "Minhub-Adaption aktiv" UBYTE B_TRUE 1 100 0 1 FORMAT "%13.11" ECU_ADDRESS 0x4037A7 /end MEASUREMENT
/begin MEASUREMENT B_tdadontp "" UBYTE B_TRUE 1 100 0 1 FORMAT "%13.11" ECU_ADDRESS 0x4037A8 /end MEASUREMENT
/begin MEASUREMENT B_tdadrold "" UBYTE B_TRUE 1 100 0 1 FORMAT "%13.11" ECU_ADDRESS 0x4037A9 /end MEASUREMENT
/begin MEASUREMENT B_tdadrst "Reset f¸r Integrator" UBYTE B_TRUE 1 100 0 1 FORMAT "%13.11" ECU_ADDRESS 0x4037AA /end MEASUREMENT
/begin MEASUREMENT B_tdfba "" UBYTE B_TRUE 1 100 0 1 FORMAT "%13.11" ECU_ADDRESS 0x4037AB /end MEASUREMENT
/begin MEASUREMENT B_tdfba1 "" UBYTE B_TRUE 1 100 0 1 FORMAT "%13.11" ECU_ADDRESS 0x4037AC /end MEASUREMENT
/begin MEASUREMENT B_tdfba2 "" UBYTE B_TRUE 1 100 0 1 FORMAT "%13.11" ECU_ADDRESS 0x4037AD /end MEASUREMENT
/begin MEASUREMENT B_tdlurkor "Anhebung des Aussetzerschwellwertes oder ‹bergang von ungedr. auf teilgedr." UBYTE B_TRUE 1 100 0 1 FORMAT "%13.11" ECU_ADDRESS 0x4037AE /end MEASUREMENT
/begin MEASUREMENT B_tdmfden "Zwischenwert f¸r Freigabe B_tdadon" UBYTE B_TRUE 1 100 0 1 FORMAT "%13.11" ECU_ADDRESS 0x4037AF /end MEASUREMENT
/begin MEASUREMENT B_tdsigerr "Signalfehler, Druck kann nicht gestellt werden" UBYTE B_TRUE 1 100 0 1 FORMAT "%13.11" ECU_ADDRESS 0x4037B0 /end MEASUREMENT
/begin MEASUREMENT B_tiefrset "" UBYTE B_TRUE 1 100 0 1 FORMAT "%13.11" ECU_ADDRESS 0x4033A7 /end MEASUREMENT
/begin MEASUREMENT B_timminad "" UBYTE B_TRUE 1 100 0 1 FORMAT "%13.11" ECU_ADDRESS 0x4037B1 /end MEASUREMENT
/begin MEASUREMENT B_tzprel "Z‰hler f¸r nmot Warten ist abgelaufen" UBYTE B_TRUE 1 100 0 1 BIT_MASK 0x1 FORMAT "%13.11" ECU_ADDRESS 0x4038C0 /end MEASUREMENT
/begin MEASUREMENT B_watched "Z‰hler f¸r Warten auf TPU Entprellung abgelaufen" UBYTE B_TRUE 1 100 0 1 BIT_MASK 0x2 FORMAT "%13.11" ECU_ADDRESS 0x4038C0 /end MEASUREMENT
/begin MEASUREMENT B_xff "Bedingung externer Freeze Frame" UBYTE B_TRUE 1 100 0 1 BIT_MASK 0x1 FORMAT "%13.11" ECU_ADDRESS 0x3FDEF9 /end MEASUREMENT
/begin MEASUREMENT B_zwvzm "" UBYTE B_TRUE 1 100 0 1 BIT_MASK 0x1 FORMAT "%13.11" ECU_ADDRESS 0x3FC374 /end MEASUREMENT
/begin MEASUREMENT cbattnenn "Nennkapazit‰t Batterie" UBYTE cbatt_ub_b1 1 100 0 255 ECU_ADDRESS 0x4033B8 /end MEASUREMENT
/begin MEASUREMENT cntdec "" UBYTE dez 1 100 0 255 FORMAT "%5.1" ECU_ADDRESS 0x3FC3AD /end MEASUREMENT
/begin MEASUREMENT codiercnt "" UBYTE t_q0p1 1 100 0 25.5 FORMAT "%5.2" ECU_ADDRESS 0x4033B9 /end MEASUREMENT
/begin MEASUREMENT daycntr "" UBYTE DEZ 1 100 0 255 FORMAT "%5.1" ECU_ADDRESS 0x4033BA /end MEASUREMENT
/begin MEASUREMENT deltagv "" SWORD fak_sw_b64 1 100 -64 63.998 FORMAT "%8.5" ECU_ADDRESS 0x4045EE /end MEASUREMENT
/begin MEASUREMENT deltagvfi "deltagv nach PT1-Filter" SWORD fak_sw_b64 1 100 -64 63.998 FORMAT "%8.5" ECU_ADDRESS 0x4045F0 /end MEASUREMENT
/begin MEASUREMENT dmaufr_w "Delta Aufregelmoment" UWORD rel_uw_b100 1 100 0 99.9985 FORMAT "%8.5" ECU_ADDRESS 0x40435A /end MEASUREMENT
/begin MEASUREMENT dmdwan_w "D-Anteil Wandlermoment bei Fahrstufe einlegen" UWORD rel_uw_b200 1 100 0 199.997 FORMAT "%8.4" ECU_ADDRESS 0x404144 /end MEASUREMENT
/begin MEASUREMENT dmnmxi_w "Drehmoment aus Integralanteil der NMAX-Regelung" SWORD rel_sw_b100 1 100 -100 99.9969 FORMAT "%8.4" ECU_ADDRESS 0x404228 /end MEASUREMENT
/begin MEASUREMENT dmnmxp_w "Drehmoment aus Proportionalanteil der NMAX-Regelung" SWORD rel_sw_b100 1 100 -100 99.9969 FORMAT "%8.4" ECU_ADDRESS 0x40422A /end MEASUREMENT
/begin MEASUREMENT dmrac "Reservemoment f¸r AC-Kompressor" UBYTE rel_ub_b99p6 1 100 0 99.6094 FORMAT "%5.2" ECU_ADDRESS 0x403CAF /end MEASUREMENT
/begin MEASUREMENT dmrwan "Momentreserve f¸r Drehmomentaufnahme des Wandlers" UBYTE rel_ub_b99p6 1 100 0 99.6094 FORMAT "%5.2" ECU_ADDRESS 0x403CB3 /end MEASUREMENT
/begin MEASUREMENT dmvadfk_w "Delta-Motordrehmoment aus Verlustmoment-Adaption (B_fs=1 & B_ko=1)" SWORD rel_sw_b100 1 100 -100 99.9969 FORMAT "%8.4" ECU_ADDRESS 0x3FE92A /end MEASUREMENT
/begin MEASUREMENT dmvadfs_w "Delta-Motordrehmoment aus Verlustmoment-Adaption (B_fs=1)" SWORD rel_sw_b100 1 100 -100 99.9969 FORMAT "%8.4" ECU_ADDRESS 0x3FE92C /end MEASUREMENT
/begin MEASUREMENT dmvadko_w "Delta-Motordrehmoment aus Verlustmoment-Adaption (B_ko=1)" SWORD rel_sw_b100 1 100 -100 99.9969 FORMAT "%8.4" ECU_ADDRESS 0x3FE92E /end MEASUREMENT
/begin MEASUREMENT dmvadll_w "Delta-Motordrehmoment aus Verlustmoment-Adaption (B_ll=1)" SWORD rel_sw_b100 1 100 -100 99.9969 FORMAT "%8.4" ECU_ADDRESS 0x3FE930 /end MEASUREMENT
/begin MEASUREMENT dmvad_w "Delta-Motordrehmoment aus Verlustmoment-Adaption" SWORD rel_sw_b100 1 100 -100 99.9969 FORMAT "%8.4" ECU_ADDRESS 0x4030B2 /end MEASUREMENT
/begin MEASUREMENT dmvamnfk_w "Minimalbegrenzung der Verlustmomentadaption (B_fs=1 & B_ko=1)" SWORD rel_sw_b100 1 100 -100 99.9969 FORMAT "%8.4" ECU_ADDRESS 0x4030B4 /end MEASUREMENT
/begin MEASUREMENT dmvamnfs_w "Minimalbegrenzung der Verlustmomentadaption (B_fs=1)" SWORD rel_sw_b100 1 100 -100 99.9969 FORMAT "%8.4" ECU_ADDRESS 0x4030B6 /end MEASUREMENT
/begin MEASUREMENT dmvamnko_w "Minimalbegrenzung der Verlustmomentadaption (B_ko=1)" SWORD rel_sw_b100 1 100 -100 99.9969 FORMAT "%8.4" ECU_ADDRESS 0x4030B8 /end MEASUREMENT
/begin MEASUREMENT dmvamnll_w "Minimalbegrenzung der Verlustmomentadaption (B_ll=1)" SWORD rel_sw_b100 1 100 -100 99.9969 FORMAT "%8.4" ECU_ADDRESS 0x4030BA /end MEASUREMENT
/begin MEASUREMENT dmvamxfk_w "0aximalbegrenzung der Verlustmomentadaption (B_fs=1 & B_ko=1)" SWORD rel_sw_b100 1 100 -100 99.9969 FORMAT "%8.4" ECU_ADDRESS 0x4030BC /end MEASUREMENT
/begin MEASUREMENT dmvamxfs_w "Maximalbegrenzung der Verlustmomentadaption (B_fs=1)" SWORD rel_sw_b100 1 100 -100 99.9969 FORMAT "%8.4" ECU_ADDRESS 0x4030BE /end MEASUREMENT
/begin MEASUREMENT dmvamxko_w "Maximalbegrenzung der Verlustmomentadaption (B_ko=1)" SWORD rel_sw_b100 1 100 -100 99.9969 FORMAT "%8.4" ECU_ADDRESS 0x4030C0 /end MEASUREMENT
/begin MEASUREMENT dmvamxll_w "Maximalbegrenzung der Verlustmomentadaption (B_ll=1)" SWORD rel_sw_b100 1 100 -100 99.9969 FORMAT "%8.4" ECU_ADDRESS 0x4030C2 /end MEASUREMENT
/begin MEASUREMENT dmverl_w "Verlustmoment nach DT1-Filter" SWORD rel_sw_b100 1 100 -100 99.9969 FORMAT "%8.4" ECU_ADDRESS 0x404132 /end MEASUREMENT
/begin MEASUREMENT dnmxoff_w "Delta Drehzahloffset f¸r NMAX-Korrektur" UWORD nmot_uw_q0p25 1 100 0 16383.8 FORMAT "%8.2" ECU_ADDRESS 0x40422C /end MEASUREMENT
/begin MEASUREMENT dnsi_w "Differenz zwischen Soll- und Ist-Motordrehzahl" SWORD nmot_sw_q0p25 1 100 -8192 8191.75 FORMAT "%8.3" ECU_ADDRESS 0x40422E /end MEASUREMENT
/begin MEASUREMENT dnturb_w "Turbinendrehzahldifferenz des Wandlers" SWORD nmot_q0p125 1 100 -4096 4095.88 FORMAT "%8.3" ECU_ADDRESS 0x404146 /end MEASUREMENT
/begin MEASUREMENT dqelad7 "" UWORD qlad_uw_q0p29127 1 100 0 19088.5 FORMAT "%9.3" ECU_ADDRESS 0x4033AA /end MEASUREMENT
/begin MEASUREMENT dqlad7 "" UWORD qlad_uw_q0p29127 1 100 0 19088.5 FORMAT "%9.3" ECU_ADDRESS 0x4033AC /end MEASUREMENT
/begin MEASUREMENT dtsegph_w "Faktor zur Bewertung der Motordynamik" SWORD t5usxus_q5 1 100 -163840 163835 FORMAT "%8.1" ECU_ADDRESS 0x4044A2 /end MEASUREMENT
/begin MEASUREMENT dzws "Delta Z¸ndwinekl zwischen zwopt und zwsol" SBYTE zw_sb_q0p75 1 100 -96 95.25 FORMAT "%5.2" ECU_ADDRESS 0x403D26 /end MEASUREMENT
/begin MEASUREMENT dzwssq "Delta Z¸ndwinkel (quadratisch) zwischen zwopt und zwsol" UBYTE kwq_ub_q0p35576 1 100 0 90.72 FORMAT "%5.2" ECU_ADDRESS 0x4036FE /end MEASUREMENT
/begin MEASUREMENT dzwssql "Delta Z¸ndwinkel (quadratisch) zwischen zwopt und zwsol unterer Bereich" UBYTE kwq_ub_q0p04447 1 100 0 11.34 FORMAT "%5.2" ECU_ADDRESS 0x4036FF /end MEASUREMENT
/begin MEASUREMENT d_tol1 "Modelltemperaturanteil aus tmot" UWORD temp_uw_q0p75_o12288 1 100 -12288 36863.3 FORMAT "%8.2" ECU_ADDRESS 0x4044D6 /end MEASUREMENT
/begin MEASUREMENT d_tol2 "Modelltemperaturanteil aus n_mot und rl" UWORD temp_uw_q0p75_o12288 1 100 -12288 36863.3 FORMAT "%8.2" ECU_ADDRESS 0x4044D8 /end MEASUREMENT
/begin MEASUREMENT d_tol3 "Modelltemperaturanteil aus tumg und vfz" UWORD temp_uw_q0p75_o12288 1 100 -12288 36863.3 FORMAT "%8.2" ECU_ADDRESS 0x4044DA /end MEASUREMENT
/begin MEASUREMENT eluectr "Z‰hler Variantenerkennung E-L¸fter (Wiederholung)" UBYTE dez 1 100 0 255 FORMAT "%5.1" ECU_ADDRESS 0x403752 /end MEASUREMENT
/begin MEASUREMENT eluedctr "Z‰hler Aktivsteuerung f. Variantenerkennung E-L¸fter" UBYTE dez 1 100 0 255 FORMAT "%5.1" ECU_ADDRESS 0x403753 /end MEASUREMENT
/begin MEASUREMENT esst_smo08mfub "" ULONG dez 1 100 0 4.29497e+009 FORMAT "%13.2" ECU_ADDRESS 0x404AF0 /end MEASUREMENT
/begin MEASUREMENT esst_snm08mfub "" ULONG dez 1 100 0 4.29497e+009 FORMAT "%13.2" ECU_ADDRESS 0x404AF4 /end MEASUREMENT
/begin MEASUREMENT esst_stm08mfub "" ULONG dez 1 100 0 4.29497e+009 FORMAT "%13.2" ECU_ADDRESS 0x404AF8 /end MEASUREMENT
/begin MEASUREMENT esst_swp08mfub "" ULONG dez 1 100 0 4.29497e+009 FORMAT "%13.2" ECU_ADDRESS 0x404AFC /end MEASUREMENT
/begin MEASUREMENT etazws "Sollz¸ndwinkelwirkungsgrad" UBYTE rel_ub_b127p5 1 100 0 127.5 FORMAT "%5.1" ECU_ADDRESS 0x403D27 /end MEASUREMENT
/begin MEASUREMENT E_ssll "Fehler f¸r sehr schlechten Leerlauf" UBYTE B_TRUE 1 100 0 1 FORMAT "%13.11" ECU_ADDRESS 0x3FE142 /end MEASUREMENT
/begin MEASUREMENT flutabs_hw "Betragswerte von Differenz der flutbgl_w Werte zweier folgender Zylinder" SWORD fak_sw_b64 1 100 -64 63.998 FORMAT "%8.5" ARRAY_SIZE 8 ECU_ADDRESS 0x4045F2 /end MEASUREMENT
/begin MEASUREMENT flutbgl_w "Array gefilterte Laufunruhewerte f¸r Bankabgleich" SWORD fak_sw_b8 1 100 -8 7.99976 FORMAT "%8.6" ARRAY_SIZE 8 ECU_ADDRESS 0x402D14 /end MEASUREMENT
/begin MEASUREMENT flutdiff_hw "" SWORD fak_sw_b64 1 100 -64 63.998 FORMAT "%8.5" ARRAY_SIZE 8 ECU_ADDRESS 0x404602 /end MEASUREMENT
/begin MEASUREMENT flut_hmaxw "" SWORD fak_sw_b64 1 100 -64 63.998 FORMAT "%8.5" ECU_ADDRESS 0x403FDE /end MEASUREMENT
/begin MEASUREMENT fqml "TA-Frequenz E-L¸fter" UBYTE freq_q1 1 100 0 255 FORMAT "%5.1" ECU_ADDRESS 0x403754 /end MEASUREMENT
/begin MEASUREMENT fs_pm "Fehlerspeicher Powermanagement, Bitcodiert" UBYTE DEZ 1 100 0 255 FORMAT "%5.1" ECU_ADDRESS 0x3FE23A /end MEASUREMENT
/begin MEASUREMENT gvist "Istwert Laufunruhe" SWORD fak_sw_b64 1 100 -64 63.998 FORMAT "%8.5" ECU_ADDRESS 0x404612 /end MEASUREMENT
/begin MEASUREMENT gvsoll "Sollwert Laufunruhe" SWORD fak_sw_b64 1 100 -64 63.998 FORMAT "%8.5" ECU_ADDRESS 0x403FE0 /end MEASUREMENT
/begin MEASUREMENT histindex "" UBYTE DEZ 1 100 0 255 FORMAT "%5.1" ECU_ADDRESS 0x4033BB /end MEASUREMENT
/begin MEASUREMENT ibsbor_hb "" UBYTE DEZ 1 100 0 255 FORMAT "%5.1" ECU_ADDRESS 0x4033BC /end MEASUREMENT
/begin MEASUREMENT idbosmsg "ID BOS-Message" UBYTE DEZ 1 100 0 255 FORMAT "%5.1" ECU_ADDRESS 0x403111 /end MEASUREMENT
/begin MEASUREMENT idfbosmgt "Kennung f¸r BOS-Meldung vom Tester" UBYTE DEZ 1 100 0 255 FORMAT "%5.1" ECU_ADDRESS 0x403112 /end MEASUREMENT
/begin MEASUREMENT idfbosmg_w "ID Funktion-BOS-Message" UWORD DEZ 1 100 0 65535 FORMAT "%8.2" ECU_ADDRESS 0x40310A /end MEASUREMENT
/begin MEASUREMENT idfbosrtt "Kennung vom Tester f¸r ÷lservice" UBYTE DEZ 1 100 0 255 FORMAT "%5.1" ECU_ADDRESS 0x40311D /end MEASUREMENT
/begin MEASUREMENT ikurz_ogrz "Obere Grenze Kurzschluﬂstrom" UBYTE i_ub_q5p12 1 100 0 998.4 FORMAT "%5.0" ECU_ADDRESS 0x4033BD /end MEASUREMENT
/begin MEASUREMENT ikurz_ugrz "Untere Grenze Kurzschluﬂstrom" UBYTE i_ub_q5p12 1 100 0 998.4 FORMAT "%5.0" ECU_ADDRESS 0x4033BE /end MEASUREMENT
/begin MEASUREMENT inmax "Initialisierungswert Integrator f¸r NMAX-Regelung" SBYTE rel_sb_q0p78 1 100 -99.84 99.06 FORMAT "%5.2" ECU_ADDRESS 0x403CDA /end MEASUREMENT
/begin MEASUREMENT iwakeupgrz "Ruhestromverletzungsgrenze ab dem der IBS den Bus weckt." UBYTE i_ub_q1p25em3 1 100 0 0.255 FORMAT "%8.6" ECU_ADDRESS 0x4033BF /end MEASUREMENT
/begin MEASUREMENT kf_out2 "KFMTOL2-Ausgang" UBYTE temp_ub_q0p75_o48 1 100 -48 143.25 FORMAT "%5.1" ECU_ADDRESS 0x4038C7 /end MEASUREMENT
/begin MEASUREMENT kf_out3 "KFMTOL3-Ausgang" UBYTE temp_ub_q0p75_o48 1 100 -48 143.25 FORMAT "%5.1" ECU_ADDRESS 0x4038C8 /end MEASUREMENT
/begin MEASUREMENT kldyncor_w "Zus‰tzliche Dynamikkorrektur nach erster Verbrennung" UWORD t5usxus_q5 1 100 0 327675 FORMAT "%8.1" ECU_ADDRESS 0x4044A4 /end MEASUREMENT
/begin MEASUREMENT kmind "" UBYTE DEZ 1 100 0 255 FORMAT "%5.1" ECU_ADDRESS 0x4033C0 /end MEASUREMENT
/begin MEASUREMENT kvaverl "Kraftstoffverbrauch um einen Abtastwert verzˆgert" UWORD fuel_uw_b65535 1 100 0 65535 FORMAT "%8.2" ECU_ADDRESS 0x403158 /end MEASUREMENT
/begin MEASUREMENT lutsbgl_w "Array Laufunruhewerte Bankabgleich in physikalischer Zylinderreihenfolge" SWORD fak_sw_b8 1 100 -8 7.99976 FORMAT "%8.6" ARRAY_SIZE 8 ECU_ADDRESS 0x402D24 /end MEASUREMENT
/begin MEASUREMENT madrdycnt "Zaehler fuer Timer mit MADRDYTM" UWORD t100msxs_uw_b6553p5 1 100 0 6553.5 FORMAT "%8.3" ECU_ADDRESS 0x404614 /end MEASUREMENT
/begin MEASUREMENT mdatxm_w "Drehmomentaufnahme des Wandlers bei B_fs = false" UWORD rel_uw_b200 1 100 0 199.997 FORMAT "%8.4" ECU_ADDRESS 0x404148 /end MEASUREMENT
/begin MEASUREMENT mdgen "Momentenaufnahme Generator" UBYTE rel_ub_b99p6 1 100 0 99.6094 FORMAT "%5.2" ECU_ADDRESS 0x403CB0 /end MEASUREMENT
/begin MEASUREMENT mdgenvfs_w "Summe vom mdgenvf_w und mdgenvf2_w bei 2. Geberator" UWORD rel_uw_b100 1 100 0 99.9985 FORMAT "%8.5" ECU_ADDRESS 0x4030C4 /end MEASUREMENT
/begin MEASUREMENT mdgen_w "Generatormoment" UWORD rel_uw_b100 1 100 0 99.9985 FORMAT "%8.5" ECU_ADDRESS 0x404140 /end MEASUREMENT
/begin MEASUREMENT mdko "Momentenaufnahme Klimakompressor" UBYTE rel_ub_b99p6 1 100 0 99.6094 FORMAT "%5.2" ECU_ADDRESS 0x403CB1 /end MEASUREMENT
/begin MEASUREMENT mdsh_aus "" SBYTE rel_q0p1957 1 100 -25.0489 24.8532 FORMAT "%5.2" ECU_ADDRESS 0x403CAE /end MEASUREMENT
/begin MEASUREMENT mdsm_w "Schleppmoment Temperatur-Anteil" UWORD rel_uw_b100 1 100 0 99.9985 FORMAT "%8.5" ECU_ADDRESS 0x404134 /end MEASUREMENT
/begin MEASUREMENT mdsvad_w "" UWORD rel_uw_b100 1 100 0 99.9985 FORMAT "%8.5" ECU_ADDRESS 0x404136 /end MEASUREMENT
/begin MEASUREMENT mdsw_w "Motorschleppmoment" UWORD rel_uw_b100 1 100 0 99.9985 FORMAT "%8.5" ECU_ADDRESS 0x404138 /end MEASUREMENT
/begin MEASUREMENT mds_w "Motorschleppmoment" UWORD rel_uw_b100 1 100 0 99.9985 FORMAT "%8.5" ECU_ADDRESS 0x40413A /end MEASUREMENT
/begin MEASUREMENT mdverb "Momentenbedarf der Nebenaggregate" UBYTE rel_ub_b99p6 1 100 0 99.6094 FORMAT "%5.2" ECU_ADDRESS 0x403CB2 /end MEASUREMENT
/begin MEASUREMENT mdverbmx_w "Maximales Motor-Verlustmoment" UWORD rel_uw_b100 1 100 0 99.9985 FORMAT "%8.5" ECU_ADDRESS 0x404218 /end MEASUREMENT
/begin MEASUREMENT mdverb_w "Momentenbedarf der Nebenaggregate" UWORD rel_uw_b100 1 100 0 99.9985 FORMAT "%8.5" ECU_ADDRESS 0x404142 /end MEASUREMENT
/begin MEASUREMENT mdverf_w "Gefiltertes Verlustmoment" UWORD rel_uw_b100 1 100 0 99.9985 FORMAT "%8.5" ECU_ADDRESS 0x40413C /end MEASUREMENT
/begin MEASUREMENT mdverl_w "Motor-Verlustmoment" UWORD rel_uw_b100 1 100 0 99.9985 FORMAT "%8.5" ECU_ADDRESS 0x40413E /end MEASUREMENT
/begin MEASUREMENT mdwanvf_w "Drehmomentaufnahme des Wandlers vor Filterung" UWORD rel_uw_b200 1 100 0 199.997 FORMAT "%8.4" ECU_ADDRESS 0x40414A /end MEASUREMENT
/begin MEASUREMENT mdwan_w "Drehmomentaufnahme des Wandlers" UWORD rel_uw_b200 1 100 0 199.997 FORMAT "%8.4" ECU_ADDRESS 0x40414C /end MEASUREMENT
/begin MEASUREMENT minadrdy "Feld zum Anzeigen ob Minhubadaption l‰uft oder abgeschlossen ist" UBYTE dez 1 100 0 255 FORMAT "%5.1" ECU_ADDRESS 0x3FC3AE /end MEASUREMENT
/begin MEASUREMENT minadrdy_o "" UBYTE dez 1 100 0 255 FORMAT "%5.1" ECU_ADDRESS 0x3FC3AF /end MEASUREMENT
/begin MEASUREMENT minhubadiv "Initialisierungswert Integrator" UWORD hub_uw_q0p001 1 100 0 65.535 FORMAT "%8.5" ECU_ADDRESS 0x3FE144 /end MEASUREMENT
/begin MEASUREMENT minhubad_w "Minimalhub am Integratorausgang" UWORD hub_uw_q0p001 1 100 0 65.535 FORMAT "%8.5" ECU_ADDRESS 0x404616 /end MEASUREMENT
/begin MEASUREMENT minhubdiff "Differenz zwischen altem und neuem minhubad_w" UWORD hub_uw_q0p001 1 100 0 65.535 FORMAT "%8.5" ECU_ADDRESS 0x404618 /end MEASUREMENT
/begin MEASUREMENT minhubfak "Faktor zur Gewichtung von minhubad_w" UWORD fak_uw_b2 1 100 0 1.99997 FORMAT "%8.6" ECU_ADDRESS 0x40461A /end MEASUREMENT
/begin MEASUREMENT minhubfns "Rampe zum Verschleifen von Minimalhub und Minhub-Kennfeld beim Start" UBYTE fak_ub_b2 1 100 0 1.99219 FORMAT "%5.3" ECU_ADDRESS 0x403BBD /end MEASUREMENT
/begin MEASUREMENT minhubfst "Rampe zum Hochlaufen von minhubfak" UBYTE fak_ub_b2 1 100 0 1.99219 FORMAT "%5.3" ECU_ADDRESS 0x403BBE /end MEASUREMENT
/begin MEASUREMENT minhuboldold "" UWORD hub_uw_q0p001 1 100 0 65.535 FORMAT "%8.5" ECU_ADDRESS 0x40461C /end MEASUREMENT
/begin MEASUREMENT minhubst "Minhub f¸r Start aus Kennlinie" UWORD hub_uw_q0p001 1 100 0 65.535 FORMAT "%8.5" ECU_ADDRESS 0x40461E /end MEASUREMENT
/begin MEASUREMENT minhubvs "Vorgabe Minhub ¸ber Tester" UWORD hub_uw_q0p001 1 100 0 65.535 FORMAT "%8.5" ECU_ADDRESS 0x404620 /end MEASUREMENT
/begin MEASUREMENT minhubvsi "‹ber Tester vorgegebener Minhub" UWORD hub_uw_q0p001 1 100 0 65.535 FORMAT "%8.5" ECU_ADDRESS 0x404622 /end MEASUREMENT
/begin MEASUREMENT minhub_old "Alter minhub_w Wert" UWORD hub_uw_q0p001 1 100 0 65.535 FORMAT "%8.5" ECU_ADDRESS 0x404624 /end MEASUREMENT
/begin MEASUREMENT minhub_roh "Tats‰chlich verwendeter Minhub" UWORD hub_uw_q0p001 1 100 0 65.535 FORMAT "%8.5" ECU_ADDRESS 0x404626 /end MEASUREMENT
/begin MEASUREMENT minhub_w "Minimal-Hub bei Teildrosselung" UWORD hub_uw_q0p001 1 100 0 65.535 FORMAT "%8.5" ECU_ADDRESS 0x404628 /end MEASUREMENT
/begin MEASUREMENT minmxb_w "indiziertes Soll-Moment f¸r NMAX-Begrenzung ohne Begrenzung" SWORD rel_sw_b100 1 100 -100 99.9969 FORMAT "%8.4" ECU_ADDRESS 0x404230 /end MEASUREMENT
/begin MEASUREMENT minmxs "ind. Soll-Motormoment zur Integratorinitialisierung NMAX-Regelung" SBYTE rel_sb_q0p78 1 100 -99.84 99.06 FORMAT "%5.2" ECU_ADDRESS 0x403CDB /end MEASUREMENT
/begin MEASUREMENT minmx_w "Momentenanforderung der Drehzahlbegrenzung" UWORD rel_uw_b100 1 100 0 99.9985 FORMAT "%8.5" ECU_ADDRESS 0x404232 /end MEASUREMENT
/begin MEASUREMENT mired1 "Indiziertes Reduktionsmoment zur NMAX-Regelung" UBYTE rel_ub_b99p6 1 100 0 99.6094 FORMAT "%5.2" ECU_ADDRESS 0x403CDC /end MEASUREMENT
/begin MEASUREMENT miszullb_w "Maximal zul‰ssiges indiziertes Moment f¸r Luftpfad (begrenzt)" UWORD rel_uw_b100 1 100 0 99.9985 FORMAT "%8.5" ECU_ADDRESS 0x40421A /end MEASUREMENT
/begin MEASUREMENT miszull_w "Maximal zul‰ssiges indiziertes Moment f¸r Luftpfad" UWORD rel_uw_b100 1 100 0 99.9985 FORMAT "%8.5" ECU_ADDRESS 0x40421C /end MEASUREMENT
/begin MEASUREMENT miszul_w "Maximal zul‰ssiges indiziertes Moment" UWORD rel_uw_b100 1 100 0 99.9985 FORMAT "%8.5" ECU_ADDRESS 0x40421E /end MEASUREMENT
/begin MEASUREMENT mizufil_w "Zul‰ssiges indiziertes Moment nach Filter" UWORD rel_uw_b100 1 100 0 99.9985 FORMAT "%8.5" ECU_ADDRESS 0x404220 /end MEASUREMENT
/begin MEASUREMENT mizuofil "Zul‰ssiges indiziertes Moment ohne Filter" UBYTE rel_ub_b99p6 1 100 0 99.6094 FORMAT "%5.2" ECU_ADDRESS 0x403CD6 /end MEASUREMENT
/begin MEASUREMENT mizutmp_w "Temperaturabh‰ngiger Anteil des zul‰ssigen Moments" UWORD rel_uw_b100 1 100 0 99.9985 FORMAT "%8.5" ECU_ADDRESS 0x404222 /end MEASUREMENT
/begin MEASUREMENT mizuvfil "Zul‰ssiges indiziertes Moment vor Filter" UBYTE rel_ub_b99p6 1 100 0 99.6094 FORMAT "%5.2" ECU_ADDRESS 0x403CD7 /end MEASUREMENT
/begin MEASUREMENT mtsegph_w "Gleitender Mittelwert der Phasenperiodendauer" UWORD t_q0p04_ms 1 100 0 2621.4 FORMAT "%8.3" ECU_ADDRESS 0x4044A6 /end MEASUREMENT
/begin MEASUREMENT m_tol "Toel Modelltemperatur" UBYTE temp_ub_q0p75_o48 1 100 -48 143.25 FORMAT "%5.1" ECU_ADDRESS 0x4038C9 /end MEASUREMENT
/begin MEASUREMENT m_tolab "Toel Modelltemperatur beim Abstellen des Motors" UBYTE temp_ub_q0p75_o48 1 100 -48 143.25 FORMAT "%5.1" ECU_ADDRESS 0x3FE0B8 /end MEASUREMENT
/begin MEASUREMENT ndcdis_w "Drehzahlgrenze bei Abgeschalteter DK durch ‹berwachung" UWORD nmot_uw_q0p25 1 100 0 16383.8 FORMAT "%8.2" ECU_ADDRESS 0x404234 /end MEASUREMENT
/begin MEASUREMENT netstate "" UBYTE dez 1 100 0 255 FORMAT "%5.1" ECU_ADDRESS 0x402843 /end MEASUREMENT
/begin MEASUREMENT nlphAusBitsSyn1 "" UBYTE dez 1 100 0 255 FORMAT "%5.1" ECU_ADDRESS 0x4038BA /end MEASUREMENT
/begin MEASUREMENT nlphLokBitsSyn "" UBYTE dez 1 100 0 255 FORMAT "%5.1" ECU_ADDRESS 0x4038BB /end MEASUREMENT
/begin MEASUREMENT nmotpr_w "Pr‰dizierte Motordrehzahl f¸r NMAX-Regelung" UWORD nmot_uw_q0p25 1 100 0 16383.8 FORMAT "%8.2" ECU_ADDRESS 0x404236 /end MEASUREMENT
/begin MEASUREMENT nmxgang_w "max. zul‰ssige Drehzahl, in Abh‰ngigkeit vom Gang" UWORD nmot_uw_q0p25 1 100 0 16383.8 FORMAT "%8.2" ECU_ADDRESS 0x404238 /end MEASUREMENT
/begin MEASUREMENT nsber2_w "Solldrehzahl f¸r NMAX-Regelung nach Korrektur" UWORD nmot_uw_q0p25 1 100 0 16383.8 FORMAT "%8.2" ECU_ADDRESS 0x40423A /end MEASUREMENT
/begin MEASUREMENT nsber_w "Solldrehzahl f¸r NMAX-Regelung" UWORD nmot_uw_q0p25 1 100 0 16383.8 FORMAT "%8.2" ECU_ADDRESS 0x40423C /end MEASUREMENT
/begin MEASUREMENT nturbv_w "Vorraussichtliche Turbinendrehzahl des Wandlers" UWORD nmot_q0p125 1 100 0 8191.88 FORMAT "%8.3" ECU_ADDRESS 0x40414E /end MEASUREMENT
/begin MEASUREMENT nturb_w "Turbinendrehzahl des Wandlers" UWORD nmot_q0p125 1 100 0 8191.88 FORMAT "%8.3" ECU_ADDRESS 0x404150 /end MEASUREMENT
/begin MEASUREMENT obdsteuer "f¸r CAN-Signal OBD_STEUER aufbereitete Grˆﬂe von ME" UBYTE dez 1 100 0 255 FORMAT "%5.1" ECU_ADDRESS 0x3FDEF8 /end MEASUREMENT
/begin MEASUREMENT ospgcnt "fs_Oberspannungscounter" UBYTE t_q0p1 1 100 0 25.5 FORMAT "%5.2" ECU_ADDRESS 0x4033C1 /end MEASUREMENT
/begin MEASUREMENT ospgprell "Anzahl der entprellten FS_Oberspannungserkennung" UBYTE DEZ 1 100 0 255 FORMAT "%5.1" ECU_ADDRESS 0x4033C2 /end MEASUREMENT
/begin MEASUREMENT ospgstat "Status Oberspannungserkennung" UBYTE DEZ 1 100 0 255 FORMAT "%5.1" ECU_ADDRESS 0x4033C3 /end MEASUREMENT
/begin MEASUREMENT ozbgBits1_1s "" UBYTE dez 1 100 0 255 FORMAT "%5.1" ECU_ADDRESS 0x403113 /end MEASUREMENT
/begin MEASUREMENT ozbgBits2_1s "" UBYTE dez 1 100 0 255 FORMAT "%5.1" ECU_ADDRESS 0x3FE96F /end MEASUREMENT
/begin MEASUREMENT ozcttagini "Initialwert f¸r ÷lzeitz‰hler" SWORD DEZ 1 100 -32767 32767 FORMAT "%8.2" ECU_ADDRESS 0x3FE9F8 /end MEASUREMENT
/begin MEASUREMENT ozdindex "Z‰hler f¸r Permittivit‰taufbereitung (>= 6 -> Auswertung)" UBYTE DEZ 1 100 0 255 FORMAT "%5.1" ECU_ADDRESS 0x40314E /end MEASUREMENT
/begin MEASUREMENT ozdkvb "Kraftstoffverbrauch innerhalb der letzten Sekunde" UWORD fuel_uw_b65535 1 100 0 65535 FORMAT "%8.2" ECU_ADDRESS 0x40315A /end MEASUREMENT
/begin MEASUREMENT ozdperm "Delta-Er" SWORD perm_sw_b6 1 100 -6 5.99982 FORMAT "%8.6" ECU_ADDRESS 0x403134 /end MEASUREMENT
/begin MEASUREMENT ozdpermsi "Index des letzten Kilometerstandes bei dem noch sicher keine Nachf¸llung vorlag" SBYTE DEZ 1 100 -128 127 FORMAT "%5.1" ECU_ADDRESS 0x40314F /end MEASUREMENT
/begin MEASUREMENT ozeranzp1 "Anzahl Punkte P1" UBYTE DEZ 1 100 0 255 FORMAT "%5.1" ECU_ADDRESS 0x403150 /end MEASUREMENT
/begin MEASUREMENT ozeranzp2 "Anzahl Punkte P2" UBYTE DEZ 1 100 0 255 FORMAT "%5.1" ECU_ADDRESS 0x403151 /end MEASUREMENT
/begin MEASUREMENT ozeranzprf "Anzahl Punkte Pruefpunkt" UBYTE DEZ 1 100 0 255 FORMAT "%5.1" ECU_ADDRESS 0x403152 /end MEASUREMENT
/begin MEASUREMENT ozggBits1_1s "" UBYTE dez 1 100 0 255 FORMAT "%5.1" ECU_ADDRESS 0x40311E /end MEASUREMENT
/begin MEASUREMENT ozggBits2_1s "" UBYTE dez 1 100 0 255 FORMAT "%5.1" ECU_ADDRESS 0x3FE9A4 /end MEASUREMENT
/begin MEASUREMENT ozgwfnbo "Gewichtungsfaktor Nachf¸llbonus" UBYTE fak_ub_b1 1 100 0 0.996094 ECU_ADDRESS 0x4031A0 /end MEASUREMENT
/begin MEASUREMENT ozkmlow "Kilometerstand letzter ÷lwechsel" SWORD km_sw_q10 1 100 -327670 327670 FORMAT "%8.1" ECU_ADDRESS 0x3FE9AA /end MEASUREMENT
/begin MEASUREMENT ozkmpermgl "Kilometerstand bei g¸ltigem Permittivit‰tsmittelwert" UWORD km_uw_q10 1 100 0 655350 FORMAT "%8.1" ECU_ADDRESS 0x403136 /end MEASUREMENT
/begin MEASUREMENT ozkmreg "Schieberegister Kilometerstand" UWORD km_uw_q10 1 100 0 655350 FORMAT "%8.1" ARRAY_SIZE 15 ECU_ADDRESS 0x3FE9AC /end MEASUREMENT
/begin MEASUREMENT ozkmstrw0 "Kilometerstand bei Restweg = Null" UWORD km_sw_q10 1 100 0 655350 FORMAT "%8.1" ECU_ADDRESS 0x3FE9FA /end MEASUREMENT
/begin MEASUREMENT ozkrzcnt "BMW" UBYTE DEZ 1 100 0 255 FORMAT "%5.1" ECU_ADDRESS 0x403126 /end MEASUREMENT
/begin MEASUREMENT ozkrzmw "kurzzeitiger Mittelwert Niveau" UBYTE niv_ub_b75 1 100 0 74.707 FORMAT "%5.2" ECU_ADDRESS 0x403127 /end MEASUREMENT
/begin MEASUREMENT ozkrzmwkor "kurzzeitiger drehzahlkorrigierter Mittelwert Niveau" UBYTE niv_ub_b75 1 100 0 74.707 FORMAT "%5.2" ECU_ADDRESS 0x403128 /end MEASUREMENT
/begin MEASUREMENT ozkrzor "kurzzeitiger Mittelwert Orientierungsmessung Niveau" UBYTE niv_ub_b75 1 100 0 74.707 FORMAT "%5.2" ECU_ADDRESS 0x403129 /end MEASUREMENT
/begin MEASUREMENT ozkvbbgw "gewichteter Bonus Kraftstoffverbrauch" UWORD fuel_uw_q1 1 100 0 2000 FORMAT "%8.3" ECU_ADDRESS 0x40315C /end MEASUREMENT
/begin MEASUREMENT ozkvbdmew "Kraftstoffverbrauch durch vorgegebene Verf¸gbarkeit" UWORD fuel_uw_q1 1 100 0 9200 FORMAT "%8.3" ECU_ADDRESS 0x40315E /end MEASUREMENT
/begin MEASUREMENT ozkvbmx "Zwischengrˆﬂe Restwegberechnung Kraftstoffverbrauch" UWORD fuel_uw_q1 1 100 500 9200 FORMAT "%8.3" ECU_ADDRESS 0x403160 /end MEASUREMENT
/begin MEASUREMENT ozkvbog "zugeteilte Bonuskraftstoffmenge" UWORD fuel_uw_q1 1 100 0 1200 FORMAT "%8.3" ECU_ADDRESS 0x3FE9FC /end MEASUREMENT
/begin MEASUREMENT ozkvbogw "additiver Term Nachf¸llbonus Kraftstoffverbrauch gewichtet" UWORD fuel_uw_q1 1 100 0 1200 FORMAT "%8.3" ECU_ADDRESS 0x403162 /end MEASUREMENT
/begin MEASUREMENT ozkvbsm_ul "Kraftstoffverbrauch seit letztem ÷lwechsel" ULONG fuel_ul_q0p000122 1 100 0 10000 FORMAT "%13.7" ECU_ADDRESS 0x3FEA04 /end MEASUREMENT
/begin MEASUREMENT ozkvbtmp1 "Zwischengrˆﬂe f¸r Restweg aus Kraftstoffverbrauch" UWORD lf_ub 1 100 0 655.35 FORMAT "%8.4" ECU_ADDRESS 0x403164 /end MEASUREMENT
/begin MEASUREMENT ozkvbtmp2 "Zwischengrˆﬂe f¸r Restweg aus Kraftstoffverbrauch" ULONG km_uw_q10 1 100 0 4.29497e+010 FORMAT "%13.1" ECU_ADDRESS 0x403190 /end MEASUREMENT
/begin MEASUREMENT ozkvbtmp3 "Zwischengrˆﬂe f¸r Restweg aus Kraftstoffverbrauch" UWORD DEZ 1 100 0 50000 FORMAT "%8.2" ECU_ADDRESS 0x403166 /end MEASUREMENT
/begin MEASUREMENT ozkvbtmp4 "Zwischengrˆﬂe f¸r Restweg aus Kraftstoffverbrauch" SLONG DEZ 1 100 -32768 5.12e+007 FORMAT "%13.4" ECU_ADDRESS 0x403194 /end MEASUREMENT
/begin MEASUREMENT ozkvbtmp5 "Zwischengrˆﬂe f¸r Restweg aus Kraftstoffverbrauch" UBYTE lf_ub 1 100 0 2.55 FORMAT "%5.3" ECU_ADDRESS 0x4031A1 /end MEASUREMENT
/begin MEASUREMENT ozkvbtmp6 "Zwischengrˆﬂe f¸r Restweg aus Kraftstoffverbrauch" UWORD fuel_uw_q1 1 100 0 65535 FORMAT "%8.2" ECU_ADDRESS 0x403168 /end MEASUREMENT
/begin MEASUREMENT ozlangmw "Langzeitmittelwert berechnet" UBYTE niv_ub_b75 1 100 0 74.707 FORMAT "%5.2" ECU_ADDRESS 0x3FE9A7 /end MEASUREMENT
/begin MEASUREMENT ozlaufvar "Schleifenz‰hler Punkteberechnung" UBYTE DEZ 1 100 0 255 FORMAT "%5.1" ECU_ADDRESS 0x403153 /end MEASUREMENT
/begin MEASUREMENT ozlf1c "L‰nderfaktor 1 codiert" UBYTE lf_ub 1 100 0 2.55 FORMAT "%5.3" ECU_ADDRESS 0x3FE932 /end MEASUREMENT
/begin MEASUREMENT ozlf1t "L‰nderfaktor 1" UBYTE lf_ub 1 100 0 2.55 FORMAT "%5.3" ECU_ADDRESS 0x3FEA08 /end MEASUREMENT
/begin MEASUREMENT ozlf2c "L‰nderfaktor 2 codiert" UBYTE lf_ub 1 100 0 2.55 FORMAT "%5.3" ECU_ADDRESS 0x3FE933 /end MEASUREMENT
/begin MEASUREMENT ozlf2t "L‰nderfaktor 2" UBYTE lf_ub 1 100 0 2.55 FORMAT "%5.3" ECU_ADDRESS 0x3FEA09 /end MEASUREMENT
/begin MEASUREMENT ozlgmwcnt "BMW" UBYTE DEZ 1 100 0 255 FORMAT "%5.1" ECU_ADDRESS 0x40312A /end MEASUREMENT
/begin MEASUREMENT ozlowcnt "Z‰hler zur Sicherung der ÷lwechselinformationen" UBYTE DEZ 1 100 0 255 FORMAT "%5.1" ECU_ADDRESS 0x3FE9A5 /end MEASUREMENT
/begin MEASUREMENT ozlowkm "Register f¸r KM-Stand beim ÷lwechsel" UWORD km_sw_q10 1 100 0 655350 FORMAT "%8.1" ARRAY_SIZE 6 ECU_ADDRESS 0x3FE972 /end MEASUREMENT
/begin MEASUREMENT ozlowperex "Register f¸r extrapoliertes Er beim ÷lwechsel" UWORD perm_uw_b6 1 100 0 5.99991 FORMAT "%8.6" ARRAY_SIZE 6 ECU_ADDRESS 0x3FE97E /end MEASUREMENT
/begin MEASUREMENT ozlowperm0 "Register f¸r Er nach ÷lwechsel" UWORD perm_uw_b6 1 100 0 5.99991 FORMAT "%8.6" ARRAY_SIZE 6 ECU_ADDRESS 0x3FE98A /end MEASUREMENT
/begin MEASUREMENT ozlowrwanz "Register f¸r Restweganzeige beim ÷lwechsel" SWORD km_sw_q10 1 100 -327680 327670 FORMAT "%8.1" ARRAY_SIZE 6 ECU_ADDRESS 0x3FE996 /end MEASUREMENT
/begin MEASUREMENT ozniv "÷lniveau ungefiltert in [mm]" UBYTE niv_ub_b75 1 100 0 74.707 FORMAT "%5.2" ECU_ADDRESS 0x40311F /end MEASUREMENT
/begin MEASUREMENT oznivBits1_1s "" UBYTE dez 1 100 0 255 FORMAT "%5.1" ECU_ADDRESS 0x40312B /end MEASUREMENT
/begin MEASUREMENT oznivBits2_1s "" UBYTE dez 1 100 0 255 FORMAT "%5.1" ECU_ADDRESS 0x3FE9A8 /end MEASUREMENT
/begin MEASUREMENT oznivBits3_1s "" UBYTE dez 1 100 0 255 FORMAT "%5.1" ECU_ADDRESS 0x40312C /end MEASUREMENT
/begin MEASUREMENT oznivBits4_1s "" UBYTE dez 1 100 0 255 FORMAT "%5.1" ECU_ADDRESS 0x3FE9A9 /end MEASUREMENT
/begin MEASUREMENT oznivkm "letzter Kilometerstand mit neuem Langzeitmittelwert ohne ÷lnachf¸llung" UWORD km_uw_q10 1 100 0 655350 FORMAT "%8.1" ECU_ADDRESS 0x3FE9CA /end MEASUREMENT
/begin MEASUREMENT oznivlgalt "Langzeitmittelwert Niveau beim Starten des Motors (B_kl15 steigende Flanke)" UBYTE niv_ub_b75 1 100 0 74.707 FORMAT "%5.2" ECU_ADDRESS 0x40312D /end MEASUREMENT
/begin MEASUREMENT oznivlgneu "aktuell g¸ltiger Langzeitmittelwert Niveau" UBYTE niv_ub_b75 1 100 0 74.707 FORMAT "%5.2" ECU_ADDRESS 0x40312E /end MEASUREMENT
/begin MEASUREMENT oznivnflit "" SBYTE nivmmxl_ub_q27p067 1 100 -13.5467 13.5467 FORMAT "%5.2" ECU_ADDRESS 0x40312F /end MEASUREMENT
/begin MEASUREMENT oznivnfm "Nachf¸llmenge in [l]" UBYTE nivmmxl_ub_b8 1 100 0 7.96875 FORMAT "%5.3" ECU_ADDRESS 0x403130 /end MEASUREMENT
/begin MEASUREMENT oznivrers "Ersatzrohwert f¸r ÷lniveau" UBYTE DEZ 1 100 0 255 FORMAT "%5.1" ECU_ADDRESS 0x403120 /end MEASUREMENT
/begin MEASUREMENT oznivt "limitierter Niveaurohwert" UBYTE DEZ 1 100 0 255 FORMAT "%5.1" ECU_ADDRESS 0x403121 /end MEASUREMENT
/begin MEASUREMENT oznmotmw "kurzzeitiger Mittelwert Drehzahl" UBYTE nmot_ub_q40 1 100 0 10200 FORMAT "%5.0" ECU_ADDRESS 0x403131 /end MEASUREMENT
/begin MEASUREMENT ozoelkm "÷lkilometer" UWORD km_uw_q10 1 100 0 655350 FORMAT "%8.1" ECU_ADDRESS 0x3FE9CC /end MEASUREMENT
/begin MEASUREMENT ozoelzeit "÷llaufzeit" UWORD DEZ 1 100 0 65535 FORMAT "%8.2" ECU_ADDRESS 0x40316A /end MEASUREMENT
/begin MEASUREMENT ozpermanz "Anzahl der Messwerte im Schieberegister" SBYTE DEZ 1 100 -128 127 FORMAT "%5.1" ECU_ADDRESS 0x3FE9F4 /end MEASUREMENT
/begin MEASUREMENT ozpermbgw "gewichteter Bonus Permittivit‰t" UWORD perm_uw_b6 1 100 0 0.399994 FORMAT "%9.7" ECU_ADDRESS 0x40316C /end MEASUREMENT
/begin MEASUREMENT ozpermBits1_1s "" UBYTE dez 1 100 0 255 FORMAT "%5.1" ECU_ADDRESS 0x3FE9F5 /end MEASUREMENT
/begin MEASUREMENT ozpermBits2_1s "" UBYTE dez 1 100 0 255 FORMAT "%5.1" ECU_ADDRESS 0x403154 /end MEASUREMENT
/begin MEASUREMENT ozpermBits3_1s "" UBYTE dez 1 100 0 255 FORMAT "%5.1" ECU_ADDRESS 0x3FE9F6 /end MEASUREMENT
/begin MEASUREMENT ozpermbog "zugeteilter Permittivit‰tsbonus" UWORD perm_uw_b6 1 100 0 1.99997 FORMAT "%8.6" ECU_ADDRESS 0x3FE9FE /end MEASUREMENT
/begin MEASUREMENT ozpermbogw "additiver Term Nachf¸llbonus Permittivit‰t gewichtet" UWORD perm_uw_b6 1 100 0 5.99991 FORMAT "%8.6" ECU_ADDRESS 0x40316E /end MEASUREMENT
/begin MEASUREMENT ozpermerp1 "Permittivit‰t Punkt P1" UWORD perm_uw_b6 1 100 0 5.99991 FORMAT "%8.6" ECU_ADDRESS 0x403138 /end MEASUREMENT
/begin MEASUREMENT ozpermerp2 "Permittivit‰t Punkt P2" UWORD perm_uw_b6 1 100 0 5.99991 FORMAT "%8.6" ECU_ADDRESS 0x40313A /end MEASUREMENT
/begin MEASUREMENT ozpermerpr "Permittivit‰t Pruefpunkt" UWORD perm_uw_b6 1 100 0 5.99991 FORMAT "%8.6" ECU_ADDRESS 0x40313C /end MEASUREMENT
/begin MEASUREMENT ozpermex "Permittivit‰t f¸r Bewertung aufbereitet (extrapoliert)" UWORD perm_uw_b6 1 100 0 5.99991 FORMAT "%8.6" ECU_ADDRESS 0x3FE9CE /end MEASUREMENT
/begin MEASUREMENT ozpermkmp1 "Kilometerstand Punkt P1" UWORD km_uw_q10 1 100 0 655350 FORMAT "%8.1" ECU_ADDRESS 0x40313E /end MEASUREMENT
/begin MEASUREMENT ozpermkmp2 "Kilometerstand Punkt P2" UWORD km_uw_q10 1 100 0 655350 FORMAT "%8.1" ECU_ADDRESS 0x403140 /end MEASUREMENT
/begin MEASUREMENT ozpermkmpr "Kilometerstand Pruefpunkt" UWORD km_uw_q10 1 100 0 655350 FORMAT "%8.1" ECU_ADDRESS 0x403142 /end MEASUREMENT
/begin MEASUREMENT ozpermko_w "korrigierter g¸ltiger Permittivit‰tswert" UWORD perm_uw_b6 1 100 0 5.99991 FORMAT "%8.6" ECU_ADDRESS 0x403144 /end MEASUREMENT
/begin MEASUREMENT ozpermlow "aufbereitete Permittivit‰t bei letztem ÷lwechsel" UWORD perm_uw_b6 1 100 0 5.99991 FORMAT "%8.6" ECU_ADDRESS 0x3FE9D0 /end MEASUREMENT
/begin MEASUREMENT ozpermma "maximal zul‰ssiges Delta-Er im ÷lwechselintervall mit Bonus ber¸cksichtigt" UWORD perm_uw_b6 1 100 0 5.99991 FORMAT "%8.6" ECU_ADDRESS 0x403170 /end MEASUREMENT
/begin MEASUREMENT ozpermoff "Offset f¸r Permittivit‰tskorrektur" SWORD perm_sw_b6 1 100 -6 5.99982 FORMAT "%8.6" ECU_ADDRESS 0x3FE9D2 /end MEASUREMENT
/begin MEASUREMENT ozpermpl_w "g¸ltiger Permittivit‰tsmittelwert" UWORD perm_uw_b6 1 100 0 5.99991 FORMAT "%8.6" ECU_ADDRESS 0x403146 /end MEASUREMENT
/begin MEASUREMENT ozpermreg "Schieberegister Permittivit‰t" UWORD perm_uw_b6 1 100 0 5.99991 FORMAT "%8.6" ARRAY_SIZE 15 ECU_ADDRESS 0x3FE9D4 /end MEASUREMENT
/begin MEASUREMENT ozpermt "limitierter Permittivit‰tsrohwert" UWORD DEZ 1 100 0 1024 FORMAT "%8.3" ECU_ADDRESS 0x403118 /end MEASUREMENT
/begin MEASUREMENT ozpermtmp1 "Zwischengrˆﬂe f¸r Restweg aus Permittivit‰t" SWORD DEZ 1 100 -32768 32767 FORMAT "%8.2" ECU_ADDRESS 0x403172 /end MEASUREMENT
/begin MEASUREMENT ozpermtmp2 "Zwischengrˆﬂe f¸r Restweg aus Permittivit‰t" ULONG fuel_ul_q0p000122 1 100 0 524288 FORMAT "%13.6" ECU_ADDRESS 0x403198 /end MEASUREMENT
/begin MEASUREMENT ozpermtmp3 "Zwischengrˆﬂe f¸r Restweg aus Permittivit‰t" UWORD DEZ 1 100 0 65535 FORMAT "%8.2" ECU_ADDRESS 0x403174 /end MEASUREMENT
/begin MEASUREMENT ozperm_w "Permittivit‰t ungefiltert" UWORD perm_uw_b6 1 100 0 5.99991 FORMAT "%8.6" ECU_ADDRESS 0x40311A /end MEASUREMENT
/begin MEASUREMENT ozprfstrg "Z‰hler f¸r Delta Er-Ermittlung" UBYTE DEZ 1 100 0 255 FORMAT "%5.1" ECU_ADDRESS 0x3FE9F7 /end MEASUREMENT
/begin MEASUREMENT ozprref_w "Referenz-Rohwert Permittivit‰t" UWORD DEZ 1 100 0 1024 FORMAT "%8.3" ECU_ADDRESS 0x3FE9A2 /end MEASUREMENT
/begin MEASUREMENT ozrestkmBits_1s "" UBYTE dez 1 100 0 255 FORMAT "%5.1" ECU_ADDRESS 0x3FEA0A /end MEASUREMENT
/begin MEASUREMENT ozrwanz "anzuzeigender Restweg" SWORD km_sw_q10 1 100 -327680 327670 FORMAT "%8.1" ECU_ADDRESS 0x3FEA00 /end MEASUREMENT
/begin MEASUREMENT ozrwanzt "letzter Wert der Restweganzeige" SWORD km_sw_q10 1 100 -327680 327670 FORMAT "%8.1" ECU_ADDRESS 0x40310C /end MEASUREMENT
/begin MEASUREMENT ozrwkvb "Restweg aus Kraftstoffverbrauch abgeleitet" SWORD km_sw_q10 1 100 -327680 327670 FORMAT "%8.1" ECU_ADDRESS 0x403176 /end MEASUREMENT
/begin MEASUREMENT ozrwkvba "absoluter Restweg aus Kraftstoffverbrauch" SWORD km_sw_q10 1 100 -327680 327670 FORMAT "%8.1" ECU_ADDRESS 0x403178 /end MEASUREMENT
/begin MEASUREMENT ozrwkvbr "relativer Restweg aus Kraftstoffverbrauch" SLONG DEZ 1 100 -32768 50000 FORMAT "%13.7" ECU_ADDRESS 0x40319C /end MEASUREMENT
/begin MEASUREMENT ozrwp "Zwischengrˆﬂe Restwegberechnung" SWORD km_sw_q10 1 100 -327680 327670 FORMAT "%8.1" ECU_ADDRESS 0x40317A /end MEASUREMENT
/begin MEASUREMENT ozrwperm "Restweg aus Permittivit‰t abgeleitet" SWORD km_sw_q10 1 100 -327680 327670 FORMAT "%8.1" ECU_ADDRESS 0x40317C /end MEASUREMENT
/begin MEASUREMENT ozrwperma "absoluter Restweg aus Er" SWORD km_sw_q10 1 100 -327680 327670 FORMAT "%8.1" ECU_ADDRESS 0x40317E /end MEASUREMENT
/begin MEASUREMENT ozrwpermr "relativer Restweg aus Er" SWORD km_sw_q10 1 100 -327680 327670 FORMAT "%8.1" ECU_ADDRESS 0x403180 /end MEASUREMENT
/begin MEASUREMENT ozrwzeit "Restweg aus Zeit" SWORD km_sw_q10 1 100 -327680 327670 FORMAT "%8.1" ECU_ADDRESS 0x403182 /end MEASUREMENT
/begin MEASUREMENT ozrwzeita "absoluter Restweg aus Zeit" SWORD km_sw_q10 1 100 -327680 327670 FORMAT "%8.1" ECU_ADDRESS 0x403184 /end MEASUREMENT
/begin MEASUREMENT ozrwzeitr "relativer Restweg aus Zeit" SWORD km_sw_q10 1 100 -327680 327670 FORMAT "%8.1" ECU_ADDRESS 0x403186 /end MEASUREMENT
/begin MEASUREMENT ozshift "Schleifenz‰hler f¸r Schieberegister" UBYTE DEZ 1 100 0 255 FORMAT "%5.1" ECU_ADDRESS 0x403155 /end MEASUREMENT
/begin MEASUREMENT ozsvcntchg "ge‰nderter Servicez‰hler" UBYTE DEZ 1 100 0 255 FORMAT "%5.1" ECU_ADDRESS 0x403122 /end MEASUREMENT
/begin MEASUREMENT oztemp "÷ltemperatur ungefiltert in [∞C]" UBYTE temp_ub_q1_o48 1 100 -48 207 FORMAT "%5.1" ECU_ADDRESS 0x403123 /end MEASUREMENT
/begin MEASUREMENT oztempf "÷ltemperatur gefiltert in [∞C]" UBYTE temp_ub_q1_o48 1 100 -48 207 FORMAT "%5.1" ECU_ADDRESS 0x4031A5 /end MEASUREMENT
/begin MEASUREMENT oztempt "limitierter Temperaturrohwert" UBYTE DEZ 1 100 0 255 FORMAT "%5.1" ECU_ADDRESS 0x403124 /end MEASUREMENT
/begin MEASUREMENT oztv1 "Zwischenvariable1 Permittivit‰tsaufbereitung" SWORD km_uw_q10 1 100 -327680 327670 FORMAT "%8.1" ECU_ADDRESS 0x403148 /end MEASUREMENT
/begin MEASUREMENT oztv2 "Zwischenvariable2 Permittivit‰tsaufbereitung" SWORD km_uw_q10 1 100 -327680 327670 FORMAT "%8.1" ECU_ADDRESS 0x40314A /end MEASUREMENT
/begin MEASUREMENT oztv3 "Zwischenvariable3 Permittivit‰tsaufbereitung" UWORD perm_uw_b6 1 100 0 5.99991 FORMAT "%8.6" ECU_ADDRESS 0x40314C /end MEASUREMENT
/begin MEASUREMENT ozvfanz "anzuzeigende Verf¸gbarkeit" UBYTE lf_ub 1 100 0 2.55 FORMAT "%5.3" ECU_ADDRESS 0x4031A2 /end MEASUREMENT
/begin MEASUREMENT ozvfbdmew "Verf¸gbarkeit aus Kombi bei DME-Wechsel" UBYTE DEZ 1 100 0 255 FORMAT "%5.1" ECU_ADDRESS 0x3FE9A6 /end MEASUREMENT
/begin MEASUREMENT ozvfbfak "" UBYTE lf_ub 1 100 0 2.55 FORMAT "%5.3" ECU_ADDRESS 0x403156 /end MEASUREMENT
/begin MEASUREMENT ozvfkvb "Verf¸gbarkeit aus Kraftstoffverbrauch" UBYTE lf_ub 1 100 0 2.55 FORMAT "%5.3" ECU_ADDRESS 0x4031A3 /end MEASUREMENT
/begin MEASUREMENT ozvfkvbt "Verf¸gbarkeit aus Kraftstoffverbrauch" UWORD fuel_ul_q0p000122 1 100 0 7.99988 FORMAT "%8.6" ECU_ADDRESS 0x403188 /end MEASUREMENT
/begin MEASUREMENT ozvftmp "begrenzte Verf¸gbarkeit" UBYTE lf_ub 1 100 0 2.55 FORMAT "%5.3" ECU_ADDRESS 0x403114 /end MEASUREMENT
/begin MEASUREMENT ozvfzeit "Verf¸gbarkeit aus Zeit" UBYTE lf_ub 1 100 0 2.55 FORMAT "%5.3" ECU_ADDRESS 0x4031A4 /end MEASUREMENT
/begin MEASUREMENT ozvormw "vorgezogener Mittelwert Niveau" UBYTE niv_ub_b75 1 100 0 74.707 FORMAT "%5.2" ECU_ADDRESS 0x403132 /end MEASUREMENT
/begin MEASUREMENT ozvormwcnt "BMW" UBYTE DEZ 1 100 0 255 FORMAT "%5.1" ECU_ADDRESS 0x403133 /end MEASUREMENT
/begin MEASUREMENT ozzeittmp1 "Zwischengrˆﬂe f¸r Restweg aus Zeit" UWORD DEZ 1 100 0 65535 FORMAT "%8.2" ECU_ADDRESS 0x40318A /end MEASUREMENT
/begin MEASUREMENT ozzeittmp2 "Zwischengrˆﬂe f¸r Restweg aus Zeit" UWORD fuel_ul_q0p000122 1 100 0 7.99988 FORMAT "%8.6" ECU_ADDRESS 0x40318C /end MEASUREMENT
/begin MEASUREMENT ozzeittmp3 "Zwischengrˆﬂe f¸r Restweg aus Zeit" UWORD lf_ub 1 100 0 655.35 FORMAT "%8.4" ECU_ADDRESS 0x40318E /end MEASUREMENT
/begin MEASUREMENT phnm10ms "Z‰hler 10ms zwischen 2 aktiven Phasenflanken" UBYTE dez 1 100 0 255 FORMAT "%5.1" ECU_ADDRESS 0x403B35 /end MEASUREMENT
/begin MEASUREMENT pminfo1 "" UWORD DEZ 1 100 0 65535 FORMAT "%8.2" ARRAY_SIZE 37 ECU_ADDRESS 0x3FDE4C /end MEASUREMENT
/begin MEASUREMENT pminfo2 "" UBYTE DEZ 1 100 0 255 FORMAT "%5.1" ARRAY_SIZE 29 ECU_ADDRESS 0x3FE23B /end MEASUREMENT
/begin MEASUREMENT qeladold7 "" UWORD qlad_uw_q0p0182 1 100 0 1193.03 FORMAT "%6.1" ECU_ADDRESS 0x3FE234 /end MEASUREMENT
/begin MEASUREMENT qeladzwsp7 "" UWORD DEZ 1 100 0 65535 FORMAT "%8.2" ECU_ADDRESS 0x4033AE /end MEASUREMENT
/begin MEASUREMENT qladold7 "" UWORD qlad_uw_q0p0182 1 100 0 1193.03 FORMAT "%6.1" ECU_ADDRESS 0x3FE236 /end MEASUREMENT
/begin MEASUREMENT qladzwsp7 "" UWORD DEZ 1 100 0 65535 FORMAT "%8.2" ECU_ADDRESS 0x4033B0 /end MEASUREMENT
/begin MEASUREMENT qntns "Quotient aus Turbinendrehzahl des Wandlers und Solldrehzahl der LLR" UBYTE fak_ub_b8 1 100 0 7.96875 FORMAT "%5.3" ECU_ADDRESS 0x403CB4 /end MEASUREMENT
/begin MEASUREMENT ruhverl "" UBYTE B_TRUE 1 100 0 1 FORMAT "%13.11" ECU_ADDRESS 0x3FE232 /end MEASUREMENT
/begin MEASUREMENT segkorr_w "Array mit Korrekturfaktoren f¸r Nockenwellensegmente" UWORD fak_uw_q0p001 1 100 0 65.535 FORMAT "%8.5" ARRAY_SIZE 4 ECU_ADDRESS 0x4044AE /end MEASUREMENT
/begin MEASUREMENT ssllcnt "Z‰hler f¸r Resets der Minhubadaption" UBYTE dez 1 100 0 255 FORMAT "%5.1" ECU_ADDRESS 0x3FE143 /end MEASUREMENT
/begin MEASUREMENT stflank "" UBYTE dez 1 100 0 255 FORMAT "%5.1" ECU_ADDRESS 0x402D34 /end MEASUREMENT
/begin MEASUREMENT svaus "" UBYTE B_TRUE 1 100 0 1 FORMAT "%13.11" ECU_ADDRESS 0x4033A8 /end MEASUREMENT
/begin MEASUREMENT swOffDlBits "" UWORD dez 1 100 0 65535 FORMAT "%8.2" ECU_ADDRESS 0x3FE1F0 /end MEASUREMENT
/begin MEASUREMENT S_VSMNHB "Schalter f¸r Testereingriff" UBYTE B_TRUE 1 100 0 1 FORMAT "%13.11" ECU_ADDRESS 0x4037B2 /end MEASUREMENT
/begin MEASUREMENT t1pmcntr "" UBYTE t_q0p1 1 100 0 25.5 FORMAT "%5.2" ECU_ADDRESS 0x4033C4 /end MEASUREMENT
/begin MEASUREMENT t2pmcntr "" UWORD t_q0p1 1 100 0 6553.5 FORMAT "%8.3" ECU_ADDRESS 0x4033B2 /end MEASUREMENT
/begin MEASUREMENT t3pmcntr "" UWORD t_q0p1 1 100 0 6553.5 FORMAT "%8.3" ECU_ADDRESS 0x4033B4 /end MEASUREMENT
/begin MEASUREMENT taml "Tastverh‰ltnis E-L¸fter" UBYTE rel_ub_b100 1 100 0 99.6094 FORMAT "%5.2" ECU_ADDRESS 0x403755 /end MEASUREMENT
/begin MEASUREMENT tamlaus "Tastverh‰ltnis Motorl¸fter nach Normierung" UBYTE rel_ub_b100 1 100 0 99.6094 FORMAT "%5.2" ECU_ADDRESS 0x403756 /end MEASUREMENT
/begin MEASUREMENT tamlausab "Tastverh‰ltnis Motorl¸fter nach Normierung und Abschaltbedingung" UBYTE rel_ub_b100 1 100 0 99.6094 FORMAT "%5.2" ECU_ADDRESS 0x403757 /end MEASUREMENT
/begin MEASUREMENT tamlausab2 "Tastverh‰ltnis Motorl¸fter nach Normierung und Absch.bed. f¸r zweiten L¸fter Sla" UBYTE rel_ub_b100 1 100 0 99.6094 FORMAT "%5.2" ECU_ADDRESS 0x403758 /end MEASUREMENT
/begin MEASUREMENT tamlnh "Tastverh‰ltnis E-L¸fter nach Hysterese (prozentuale L¸fterleistung)" UBYTE rel_ub_b100 1 100 0 99.6094 FORMAT "%5.2" ECU_ADDRESS 0x403759 /end MEASUREMENT
/begin MEASUREMENT tamlnl "Tastverh‰ltnis E-L¸fter im L¸fternachlauf" UBYTE rel_ub_b100 1 100 0 99.6094 FORMAT "%5.2" ECU_ADDRESS 0x40375A /end MEASUREMENT
/begin MEASUREMENT tamls "Tastverh‰ltnis (prozentuale L¸fterleistung)" UBYTE rel_ub_b100 1 100 0 99.6094 FORMAT "%5.2" ECU_ADDRESS 0x40375B /end MEASUREMENT
/begin MEASUREMENT tamlstget "Anforderung Tastverh‰ltnis Motorl¸ftersteuerung durch Getriebeetemperatur" UBYTE rel_ub_b100 1 100 0 99.6094 FORMAT "%5.2" ECU_ADDRESS 0x40375C /end MEASUREMENT
/begin MEASUREMENT tdmnhtf "tmot-abh‰ngiger Faktor f¸r TD Ein-/Ausblendung" UWORD fak_uw_b2 1 100 0 1.99997 FORMAT "%8.6" ECU_ADDRESS 0x40462A /end MEASUREMENT
/begin MEASUREMENT tgetmls "Getriebetemperatur in %MLS u.U. Ersatztempertur" UBYTE temp_ub_q0p75_o48 1 100 -48 143.25 FORMAT "%5.1" ECU_ADDRESS 0x40375D /end MEASUREMENT
/begin MEASUREMENT timminad "" UWORD dez 1 100 0 65535 FORMAT "%8.2" ECU_ADDRESS 0x40462C /end MEASUREMENT
/begin MEASUREMENT tkastend "Temperatur K¸hlerauslass bei Startende" UBYTE temp_ub_q0p75_o48 1 100 -48 143.25 FORMAT "%5.1" ECU_ADDRESS 0x40375E /end MEASUREMENT
/begin MEASUREMENT tmotmn "Minimal plausible Motortemperatur" UBYTE temp_ub_q0p75_o48 1 100 -48 143.25 FORMAT "%5.1" ECU_ADDRESS 0x403CD8 /end MEASUREMENT
/begin MEASUREMENT tnachl_w "SG-Nachlaufzeit" UWORD t100msxs_uw_b6553p6 1 100 0 6553.5 FORMAT "%8.3" ECU_ADDRESS 0x3FE1F2 /end MEASUREMENT
/begin MEASUREMENT tnphsp_w "Zahnzeit f¸r Zahngenerierung im Notlauf nach Korrektur an passiver NW-Flanke" UWORD t_q0p001_ms 1 100 0 65.535 FORMAT "%8.5" ECU_ADDRESS 0x4044B6 /end MEASUREMENT
/begin MEASUREMENT tnphs_w "Zahnzeit f¸r Zahngenerierung im Notlauf nach Korrektur an aktiver NW-Flanke" UWORD t_q0p001_ms 1 100 0 65.535 FORMAT "%8.5" ECU_ADDRESS 0x4044B8 /end MEASUREMENT
/begin MEASUREMENT tnscCtr_w "Nachstartzeitz‰hler f¸r die Nachstart Momentenaufweitung" UWORD t20msxs_uw_q0p02 1 100 0 1310.7 FORMAT "%8.3" ECU_ADDRESS 0x404224 /end MEASUREMENT
/begin MEASUREMENT tnsofCtr "" UBYTE t20msxs_ub_b5p1 1 100 0 5.1 FORMAT "%5.3" ECU_ADDRESS 0x403CD9 /end MEASUREMENT
/begin MEASUREMENT todeltime "Z‰hler Ausheizzeit (nichtfl¸chtig)" SWORD t1sxs_uw_b65535 1 100 -32768 32767 FORMAT "%8.2" ECU_ADDRESS 0x3FE9F2 /end MEASUREMENT
/begin MEASUREMENT toeloz "Ausgabewert Motorˆltemperatur" UBYTE temp_ub_q1_o48 1 100 -48 207 FORMAT "%5.1" ECU_ADDRESS 0x403115 /end MEASUREMENT
/begin MEASUREMENT toel_w "Oeltemperatur nach Filter" UWORD temp_ub_q0p75_o48 1 100 -48 200.25 FORMAT "%8.4" ECU_ADDRESS 0x40310E /end MEASUREMENT
/begin MEASUREMENT tol "Motor-÷L-Temperatur" UBYTE temp_ub_q0p75_o48 1 100 -48 143.25 FORMAT "%5.1" ECU_ADDRESS 0x403116 /end MEASUREMENT
/begin MEASUREMENT ttnmxoff_w "Timer, Motordrehzahl grˆsser als unkorrigierte nsber_w" UWORD t_q0p01 1 100 0 655.35 FORMAT "%8.4" ECU_ADDRESS 0x40423E /end MEASUREMENT
/begin MEASUREMENT uspgcnt "FS_Unterspannungscounter" UBYTE t_q0p1 1 100 0 25.5 FORMAT "%5.2" ECU_ADDRESS 0x4033C5 /end MEASUREMENT
/begin MEASUREMENT uspgprell "Anzahl der entprellten FS_Unterspannungserkennung." UBYTE DEZ 1 100 0 255 FORMAT "%5.1" ECU_ADDRESS 0x4033C6 /end MEASUREMENT
/begin MEASUREMENT uspgstat "FS_Unterspannungsstatus" UBYTE DEZ 1 100 0 255 FORMAT "%5.1" ECU_ADDRESS 0x4033C7 /end MEASUREMENT
/begin MEASUREMENT wnwipas_w "Winkeldifferenz zwischen Soll- und aktueller Position der passiven NW-Flanke" SWORD kw_q0p1 1 100 -3276.8 3276.7 FORMAT "%8.3" ECU_ADDRESS 0x4044BA /end MEASUREMENT
/begin MEASUREMENT wnwkwpas_w "Position der passiven Nockenwellenflanke bezogen zur Kurbelwelle" UWORD kw_q0p1 1 100 0 6553.5 FORMAT "%8.3" ECU_ADDRESS 0x4044BC /end MEASUREMENT
/begin MEASUREMENT wnwslpas_w "Array mit Sollpositionen der passiven Nockenwellenflanken" UWORD kw_q0p1 1 100 0 6553.5 FORMAT "%8.3" ARRAY_SIZE 4 ECU_ADDRESS 0x4044BE /end MEASUREMENT
/begin MEASUREMENT zacodfzg "Zustandsbyte Fahrzeugvariante" UBYTE dez 1 100 0 255 FORMAT "%5.1" ECU_ADDRESS 0x40339C /end MEASUREMENT
/begin MEASUREMENT znlphausf "Z‰hler f¸r erkannte Aussetzer an falscher Position" UBYTE dez 1 100 0 255 FORMAT "%5.1" ECU_ADDRESS 0x4038BC /end MEASUREMENT
/begin MEASUREMENT znlphausr "Z‰hler f¸r erkannte Aussetzer an richtiger Position" UBYTE dez 1 100 0 255 FORMAT "%5.1" ECU_ADDRESS 0x4038BD /end MEASUREMENT
/begin MEASUREMENT znlphrange "Z‰hler Bereich der Phasensuche" UBYTE dez 1 100 0 255 FORMAT "%5.1" ECU_ADDRESS 0x4038BE /end MEASUREMENT
/begin MEASUREMENT zrbosmld "Z‰hler R¸ckstellung BOS-Meldung" UBYTE DEZ 1 100 0 255 FORMAT "%5.1" ECU_ADDRESS 0x3FE970 /end MEASUREMENT
/begin MEASUREMENT zrbosrt "Servicez‰hlerwert vom Tester" UBYTE DEZ 1 100 0 255 FORMAT "%5.1" ECU_ADDRESS 0x403125 /end MEASUREMENT
/begin MEASUREMENT ztagedelta "" UBYTE DEZ 1 100 0 10 FORMAT "%5.2" ECU_ADDRESS 0x4033C8 /end MEASUREMENT
/begin MEASUREMENT ztageold "" UWORD DEZ 1 100 0 65535 FORMAT "%8.2" ECU_ADDRESS 0x3FE238 /end MEASUREMENT
/begin MEASUREMENT zwsol "Soll-Z¸ndwinkel aus Momenteneingriff" SBYTE zw_sb_q0p75 1 100 -96 95.25 FORMAT "%5.2" ECU_ADDRESS 0x403D29 /end MEASUREMENT
/begin MEASUREMENT zyleausb "auszublendender Zylinder; bin‰re Darstellung" UBYTE dez 1 100 0 255 FORMAT "%5.1" ECU_ADDRESS 0x4038BF /end MEASUREMENT
/begin FUNCTION MDVER "13.90     Motor-Verlustmoment"
 /begin DEF_CHARACTERISTIC CNFMDVER DMDNSM DMDNSMVT KFMDS KFMDSM KFWDMVAD KLMDHUB KLMDNMOT MDSH S_mdversta ZFMDVERL ZMDNSM ZMDNSMVT /end DEF_CHARACTERISTIC
 /begin IN_MEASUREMENT B_gd B_gdst B_gen2 B_llrein B_sa dmvad_w esst_stm06__ub evhubi_w fho mdgen mdko mdverb_w mdwan_w nmot_w rl_w tmot tol /end IN_MEASUREMENT
 /begin OUT_MEASUREMENT dmverl_w mdsh_aus mdsm_w mdsvad_w mdsw_w mdverf_w mdverl_w /end OUT_MEASUREMENT
 /begin LOC_MEASUREMENT mds_w /end LOC_MEASUREMENT
/end FUNCTION
/begin FUNCTION MDVERAD "10.70     Adaption Verlustmoment"
 /begin DEF_CHARACTERISTIC DMADFK DMADFS DMADKO DMADLL DMADMNFK DMADMNFS DMADMNKO DMADMNLL DMADMXFK DMADMXFS DMADMXKO DMADMXLL DMOFK DMOFS DMOKO DMOLL TMDMAD TWDMAD ZKDMADFK ZKDMADFS ZKDMADKO ZKDMADLL /end DEF_CHARACTERISTIC
 /begin IN_MEASUREMENT B_dknolu B_dkpu B_dtes B_edkvs B_edkvs2 B_eemrdy B_eepdif B_eepwf B_eev B_evloc B_fs B_koe B_llr B_llrein B_mdarv B_nswo1 B_vllr dmllri_w tmot /end IN_MEASUREMENT
 /begin OUT_MEASUREMENT B_clradllr dmvadfk_w dmvadfs_w dmvadko_w dmvadll_w dmvad_w /end OUT_MEASUREMENT
 /begin LOC_MEASUREMENT B_adwfk B_adwfs B_adwko B_madfk B_madfs B_madko B_madll B_madstp dmvamnfk_w dmvamnfs_w dmvamnko_w dmvamnll_w dmvamxfk_w dmvamxfs_w dmvamxko_w dmvamxll_w /end LOC_MEASUREMENT
/end FUNCTION
/begin FUNCTION MDVERB "13.80     Momentenbedarf der Nebenaggregate (z.B. Klimaanlage, sonst. Verbraucher)"
 /begin DEF_CHARACTERISTIC CWMDSL DMDKOE FABMDKO KFMDGEN KFMDKO KFMDKOG MDSL ZKMDGEN ZKMDKO /end DEF_CHARACTERISTIC
 /begin IN_MEASUREMENT B_acres B_gen1 B_gene B_koe B_koger B_sl kopwm mdafsp_w mdarsp_w mdgenvf_2w mdgenvf_w mdkog nmot nmot_w tans /end IN_MEASUREMENT
 /begin OUT_MEASUREMENT dmrac mdgen mdgenvfs_w mdgen_w mdko mdverb mdverb_w /end OUT_MEASUREMENT
/end FUNCTION
/begin FUNCTION MDWAN "6.70      Drehmomentaufnahme des Wandlers"
 /begin DEF_CHARACTERISTIC CNFMDWAN DMDWHYS DMDWM FABMDWA FDMDWAN FMDWAT FNRAD FVDMDWAN KFMDWMX MDATNM MDATRM MDWANER TVFSAM TVFSEM TVFSRAM TVFSREM TVFUE UEVERG ZKDMDW ZKMDWAB ZKMDWAUF ZKMDWF ZKUEVERG /end DEF_CHARACTERISTIC
 /begin REF_CHARACTERISTIC STM08MDUB /end REF_CHARACTERISTIC
 /begin IN_MEASUREMENT B_autget B_fs B_mdwaner esst_stm08mdub gangi mdwancan nstat nturbc_w tmot vfzg vfzg_w /end IN_MEASUREMENT
 /begin OUT_MEASUREMENT B_dmrwan dmdwan_w dmrwan mdwanvf_w mdwan_w /end OUT_MEASUREMENT
 /begin LOC_MEASUREMENT B_fsu B_rgang dnturb_w mdatxm_w nturbv_w nturb_w qntns /end LOC_MEASUREMENT
/end FUNCTION
/begin FUNCTION MDZUL "4.90      Maximal zul‰ssiges Moment"
 /begin DEF_CHARACTERISTIC CWMDZUL KFDMP KFDMT KFMOF KFPZU KLDMMX KLLLRZU KLMIMAX KLMIMIN KLMZUMN MZFFIL MZFTV NSTART NSTEND SMO08MFUB SNM08MFUB STM08MFUB SWP08MFUB TANSMN TMBST TMNSMN TMOMIN TNSC TNSOF /end DEF_CHARACTERISTIC
 /begin REF_CHARACTERISTIC MDIMX /end REF_CHARACTERISTIC
 /begin IN_MEASUREMENT B_fgr B_klmzu_um B_mrakt B_msr B_mzns_um B_sgs dmllrl_w dmrmx_w etazwbm etazwmn fnstab_w mdslw_w mdverf_w mdvervf_w nmot tans tmot tnst_w wped /end IN_MEASUREMENT
 /begin OUT_MEASUREMENT B_mdbglst B_mdblst B_mdbresl B_mdbza miszull_w miszul_w /end OUT_MEASUREMENT
 /begin LOC_MEASUREMENT B_inidtf B_mbst B_mzns B_nsakt B_nsend esst_smo08mfub esst_snm08mfub esst_stm08mfub esst_swp08mfub mdverbmx_w miszullb_w mizufil_w mizuofil mizutmp_w mizuvfil tmotmn tnscCtr_w tnsofCtr /end LOC_MEASUREMENT
/end FUNCTION
/begin FUNCTION MDZW "6.30      Berechnung Moment in Sollz¸ndwinkel" /begin DEF_CHARACTERISTIC DMAUFN DZWQ2DZW DZWQ2DZWL /end DEF_CHARACTERISTIC
 /begin IN_MEASUREMENT B_zwvs B_zwvz dzwkoef etazaist mibas_w miopt_w misol_w mizsol_w mizwmn_w nmot_w redist zwopt /end IN_MEASUREMENT
 /begin OUT_MEASUREMENT B_nozwe dmaufr_w etazws zwsol /end OUT_MEASUREMENT
 /begin LOC_MEASUREMENT B_zwvzm dzws dzwssq dzwssql /end LOC_MEASUREMENT
/end FUNCTION
/begin FUNCTION MINHUBAD "1.150     Adaption des minimalen VVT-Hubs aus den Laufunruhewerten"
 /begin DEF_CHARACTERISTIC CWADBGL DELTAGVMX DTANSTDEW DTOLTDEW GVRI KFTDOFFN KLGVSOLL KLMNHUBST KLTDOFFM MADRDYTL MADRDYTM MINHUB MINHUBFAD MINHUBFG MINHUBMN MINHUBMX MINHUBMXO MINHUBMXU MINHUBMXVS MINHUBSW MINHUBSWOF MNHBFSTINI MOFBSSLL SSLLLIM S_BFORUN S_BMDERK S_btdob S_EMD S_slldecak S_TDADAP S_TDFBA1 S_TDFBA2 S_TDFILTER S_TDOFFTM S_TDSWITCH TANSTDENW TDADNMOT TDADON TDADTMOT TDADVFZ TDELTAGV TDGANGMX TDMNHT0 TDMNHT1 TDNSOLDIFF TDOFFT TDOFFTDF TDRMNHUBST TMINHUBMX TOLTDENW ZLUTBGL /end DEF_CHARACTERISTIC
 /begin REF_CHARACTERISTIC S_LLTD /end REF_CHARACTERISTIC
 /begin IN_MEASUREMENT bgladrdy B_bgl B_bgmszs B_dtes B_erkat B_fa B_fbgl B_forun B_gd B_gdvhub B_llr B_lltd B_mderk B_mdstop B_pwf B_sa B_stend evhubi_w evhubs_kf flutszyl_f fofstat gangi luts_f minhubvsnv mnhubfte_w nmot_w nstat S_VSMNHBNV tans tmot tmst tol vfzg zzyllfb /end IN_MEASUREMENT
 /begin OUT_MEASUREMENT B_clradmhb B_minhubvs B_tdlurkor deltagvfi E_ssll flutbgl_w gvsoll madrdycnt minadrdy minhubadiv minhubvs minhubvsi minhub_roh minhub_w stflank S_VSMNHB /end OUT_MEASUREMENT
 /begin LOC_MEASUREMENT B_lltdoff B_llum B_minhub1 B_minhub2 B_mnfaktiv B_ssll B_tdadon B_tdadontp B_tdadrold B_tdadrst B_tdfba B_tdfba1 B_tdfba2 B_tdmfden B_tdsigerr B_timminad cntdec deltagv flutabs_hw flutdiff_hw flut_hmaxw gvist lutsbgl_w minadrdy_o minhubad_w minhubdiff minhubfak minhubfns minhubfst minhuboldold minhubst minhub_old ssllcnt tdmnhtf timminad /end LOC_MEASUREMENT
/end FUNCTION
/begin FUNCTION MLS "82.20     Motorl¸fter-Steuerung"
 /begin DEF_CHARACTERISTIC CWVEELUE CW_MAXCTR FMLVFZG KFMLSTGVF NMOTMLSNML TALUNL TAMHYS TAMLAC TAMLSMN TAMLSMX TAMLSNH TAMLSNML TAMLTKA TAMLU TAMLUOFF TGETERSMLS TKAMLSNML TMLSNML TMMLN TMOTMLSNML TNSEMLSNML /end DEF_CHARACTERISTIC
 /begin REF_CHARACTERISTIC TNLSGMN /end REF_CHARACTERISTIC
 /begin IN_MEASUREMENT B_clvar B_eepwf B_egs1cok B_egs2cok B_elue600 B_eluedet B_eluevar B_famls B_nachl B_nmin B_pwf B_stend B_velueakt eluekctr nmot stmlac tamldia tget tka tmot tnachl_w tnse_w ubsqf vfzg /end IN_MEASUREMENT
 /begin OUT_MEASUREMENT B_nachln B_nl10 B_tamlu eluectr fqml taml tamlaus tamlausab tamlausab2 tamlnl tamls tgetmls /end OUT_MEASUREMENT
 /begin LOC_MEASUREMENT eluedctr tamlnh tamlstget tkastend /end LOC_MEASUREMENT
/end FUNCTION
/begin FUNCTION MOTAUS "11.20     Motor-Abstellen" /begin DEF_CHARACTERISTIC TNLSGMN TNLSGMX /end DEF_CHARACTERISTIC /begin IN_MEASUREMENT B_kl15 B_nldte B_nmin B_pwf /end IN_MEASUREMENT
 /begin OUT_MEASUREMENT B_nachl B_nachlend B_nachlram B_nlacls B_nlale B_nlatm B_nlcan B_nldte_motaus B_nlEEPR B_nlmls B_nlobd B_nlsgls B_nlsiko B_nlvvtchk B_nlwst swOffDlBits tnachl_w /end OUT_MEASUREMENT
/end FUNCTION
/begin FUNCTION M_TOEL "1.80"
 /begin DEF_CHARACTERISTIC EGSZWS EGSZWS_1 GANGZWGS GANGZWGS_1 GANGZWGS_2 GANGZWGS_3 HYSTEGSZWS HYSTEGSZ_1 HYSTTMZS HYSTTMZS_1 HYSTVFZZWS HYSTVFZZ_1 HYSTVFZZ_2 HYSTVFZZ_3 KFMTOL1 KFMTOL2 KFMTOL3 S_MOEL_ON TMZWS TMZWS_1 TOLREV VFZZWS VFZZWS_1 VFZZWS_2 VFZZWS_3 Z_OEL1 Z_OEL2 Z_OEL3 /end DEF_CHARACTERISTIC
 /begin IN_MEASUREMENT B_pwf gangi nmot rl tabst_w tmot tmotab toel_w tol tumg vfzg /end IN_MEASUREMENT
 /begin OUT_MEASUREMENT abtim_b B_egszwgs B_mtol_ini B_oelh d_tol1 d_tol2 d_tol3 kf_out2 kf_out3 m_tol m_tolab /end OUT_MEASUREMENT
/end FUNCTION
/begin FUNCTION NLDG "4.30      Notlauf Drehzahlgeber"
 /begin DEF_CHARACTERISTIC CWNWREF DYNMXNL FIRNLIGN FNLMI0 FNLMI1 FNLMI2 KLDIFSEG KLDTPH KLDTPHST KLDYNCOR KLWNWPAS MXNLFEHL PHZAHN TNLSYNMX /end DEF_CHARACTERISTIC
 /begin REF_CHARACTERISTIC NWSIGNAL /end REF_CHARACTERISTIC
 /begin IN_MEASUREMENT anzburst B_nldg B_st B_synnldg B_wnwinla B_wnwinla2 B_wnwinle B_wnwinle2 nlindex pgmaster synid tmot tnphslin_w tsegph_l wnwiada1_w wnwiada2_w wnwiade1_w wnwiade2_w wnwspa2_w wnwspa_w wnwspe2_w wnwspe_w zrph2_l zrph3_l zrph4_l zrph_l /end IN_MEASUREMENT
 /begin OUT_MEASUREMENT B_ensynnl B_noknldg B_resetsyn dtsegph_w mtsegph_w tnphsp_w tnphs_w wnwipas_w wnwkwpas_w /end OUT_MEASUREMENT
 /begin LOC_MEASUREMENT B_3ph B_4ph B_nwref kldyncor_w segkorr_w wnwslpas_w /end LOC_MEASUREMENT
/end FUNCTION
/begin FUNCTION NLPH "9.10      Notlauf Phasengeber"
 /begin DEF_CHARACTERISTIC AESNLP ANZEAUS ANZMDM CWNLPH NPHERKMN NPHERKMX RLPHERKMN RLPHERKMX TPHERKMN TPHSSP ZYLEAUS /end DEF_CHARACTERISTIC
 /begin IN_MEASUREMENT B_ll B_luerk B_lustop B_nldg B_synph nmot rl stateaevab synstate tmot zzyl zzyllfb /end IN_MEASUREMENT
 /begin OUT_MEASUREMENT anzeausb B_dopzue B_nlph B_optpherk B_phsnl B_phsnlinv B_phsnlok B_synnot nlphAusBitsSyn1 znlphausf znlphausr znlphrange zyleausb /end OUT_MEASUREMENT
 /begin LOC_MEASUREMENT B_phsnlab B_phsnls nlphLokBitsSyn /end LOC_MEASUREMENT
/end FUNCTION
/begin FUNCTION NMAXMD "17.100    Drehzahlbegrenzung"
 /begin DEF_CHARACTERISTIC DNHYOFFNMX DNMAXHG DNMAXLR DNMXOFFTG KFMIRED1 MDIMX NMAXGA NMAXKRDWS NMAXLR NMAXNL NMAXPG NMAXPLR NMXDAEF NMXDKPU NMXMSG TNMXOFF TNMXPRG TNMXPRLR UKWNMAXG UWNMAXLR ZINMAXG ZINMAXLR /end DEF_CHARACTERISTIC
 /begin REF_CHARACTERISTIC SGA08MDUB /end REF_CHARACTERISTIC
 /begin IN_MEASUREMENT B_dknolu B_dkpu B_krdws B_lowra B_nldg dvvtnmx esst_sga08mdub gangi mifab_w miist_w ngfil_w nmaxssg_w nmot_w uzkw_w wped /end IN_MEASUREMENT
 /begin OUT_MEASUREMENT B_nmax B_nmaxd minmx_w nsber2_w /end OUT_MEASUREMENT
 /begin LOC_MEASUREMENT anzkwu_w dmnmxi_w dmnmxp_w dnmxoff_w dnsi_w inmax minmxb_w minmxs mired1 ndcdis_w nmotpr_w nmxgang_w nsber_w ttnmxoff_w /end LOC_MEASUREMENT
/end FUNCTION
/begin FUNCTION NPLAUS "1.40      Plausibilisierung Motordrehzahl" /begin DEF_CHARACTERISTIC TCALCN TPHPL /end DEF_CHARACTERISTIC /begin REF_CHARACTERISTIC DZZST TPREL /end REF_CHARACTERISTIC /begin IN_MEASUREMENT B_nmot B_zprel pgmaster /end IN_MEASUREMENT /begin OUT_MEASUREMENT B_nmotok /end OUT_MEASUREMENT /begin LOC_MEASUREMENT B_tzprel B_watched phnm10ms /end LOC_MEASUREMENT /end FUNCTION
/begin FUNCTION NWMOFF "1.20      Abschaltung Netzwerkmanagment" /begin IN_MEASUREMENT codcan /end IN_MEASUREMENT /begin OUT_MEASUREMENT B_nmberror B_nmbsleep B_nwmoff /end OUT_MEASUREMENT /begin LOC_MEASUREMENT netstate /end LOC_MEASUREMENT /end FUNCTION
/begin FUNCTION OBDSV "3.20      OBD-Statusverwaltung" /begin IN_MEASUREMENT bbdcy bbwuc B_eepwf B_egs2cok codcan ffzdfp obdstegs /end IN_MEASUREMENT /begin OUT_MEASUREMENT B_blkfb B_milfb B_xff obdsteuer /end OUT_MEASUREMENT /end FUNCTION
/begin FUNCTION OZBG "3.10      Ausgabe Fahrerinformation ÷lzustandssensor"
 /begin DEF_CHARACTERISTIC OZLANGLIM1 OZLANGLIM2 OZLIM1HEAL OZLIM2HEAL OZORLIM2 OZVORLIM1 OZVORLIM2 /end DEF_CHARACTERISTIC
 /begin REF_CHARACTERISTIC CW_OZ /end REF_CHARACTERISTIC
 /begin IN_MEASUREMENT B_dmeini B_oelwech B_ozlangmw B_ozor B_oztemp B_ozvfchg B_ozvormw B_svcntchg ozggBits1_1s ozggBits2_1s ozkrzor ozlangmw oznivBits3_1s oznivBits4_1s ozrwanz ozsvcntchg oztempf ozvfanz ozvormw /end IN_MEASUREMENT
 /begin OUT_MEASUREMENT bos01_w bosbtvfbk bosstate B_bosmsgc B_mol_vb B_mol_vl B_oeltemp idbosmsg idfbosmgt idfbosmg_w ozbgBits1_1s toeloz toel_w tol zrbosmld /end OUT_MEASUREMENT
 /begin LOC_MEASUREMENT B_ozkl15 ozbgBits2_1s ozrwanzt ozvftmp /end LOC_MEASUREMENT
/end FUNCTION
/begin FUNCTION OZGG "3.21      Gebergrˆssen ÷lzustandssensor"
 /begin DEF_CHARACTERISTIC CW_OZ OZNIVKL OZPERMKL OZPERMRMIN OZPRREFMAX OZPRREFMIN OZTEMPKL /end DEF_CHARACTERISTIC
 /begin REF_CHARACTERISTIC OZKMUPL OZSTZYK /end REF_CHARACTERISTIC
 /begin IN_MEASUREMENT B_ozlerr B_ozqerr B_oztemic B_ozterr dqltBits2_1s idbosrst idfbosrt_w kmstand oznivr ozpermerrz ozpermex ozpermlow ozpermr_w ozrwanz oztempr vbost zrbosr /end IN_MEASUREMENT
 /begin OUT_MEASUREMENT bosbtvfbkt B_dmeini B_dmewech B_oelwech B_ozniv B_ozperm B_oztemp B_ozvfchg B_svcntchg idfbosrtt ozggBits1_1s ozggBits2_1s ozlowcnt ozlowkm ozlowperex ozlowperm0 ozlowrwanz ozniv ozperm_w ozprref_w ozsvcntchg oztemp ozvfbdmew zrbosrt /end OUT_MEASUREMENT
 /begin LOC_MEASUREMENT oznivrers oznivt ozpermt oztempt /end LOC_MEASUREMENT
/end FUNCTION
/begin FUNCTION OZNIV "3.10      Auswertung ÷lniveau"
 /begin DEF_CHARACTERISTIC OZMWK OZMWL OZMWOR OZMWV OZNFCNT OZNFTMPMAX OZNFTMPMIN OZNIVMMLIT OZNIVNFM05 OZNIVNFM10 OZNMNIVKL OZNMOTMAX OZNMOTMIN OZTEMPBW OZTEMPORR /end DEF_CHARACTERISTIC
 /begin REF_CHARACTERISTIC CW_OZ /end REF_CHARACTERISTIC
 /begin IN_MEASUREMENT B_kl15 B_ozniv B_sa nmot ozggBits1_1s ozniv oztempf /end IN_MEASUREMENT
 /begin OUT_MEASUREMENT B_ozlangmw B_ozor B_ozvormw ozkrzor ozlangmw oznivBits3_1s oznivBits4_1s oznivnfm ozvormw /end OUT_MEASUREMENT
 /begin LOC_MEASUREMENT B_ozkrzkor B_ozlw1 B_ozlw2 B_oznferk ozkrzcnt ozkrzmw ozkrzmwkor ozlgmwcnt oznivBits1_1s oznivBits2_1s oznivlgalt oznivlgneu oznivnflit oznmotmw ozvormwcnt /end LOC_MEASUREMENT
/end FUNCTION
/begin FUNCTION OZPERM "3.10      Auswertung Permittivit‰t"
 /begin DEF_CHARACTERISTIC OZKMUPL OZOELKMPL OZPERMCOK5 OZPERMMIN OZPERMMNIV OZPERMNK3 OZPERMTIK6 OZPERMTIK8 OZPERMTIK9 OZPERMTK12 OZPERMTK13 OZPERMTK4 OZPERMTK7 /end DEF_CHARACTERISTIC
 /begin REF_CHARACTERISTIC OZBZKMSTK1 /end REF_CHARACTERISTIC
 /begin IN_MEASUREMENT B_eepinioz B_oelwech B_ozlangmw B_ozperm B_oztemic B_ozvfchg dqltBits2_1s kmstand nmot ozggBits1_1s ozlf1t ozniv oznivBits4_1s oznivnfm ozperm_w oztempf ozvfbdmew /end IN_MEASUREMENT
 /begin OUT_MEASUREMENT B_calcdper B_ozper0ok ozkmlow ozkmreg oznivkm ozoelkm ozpermanz ozpermBits3_1s ozpermex ozpermlow ozpermoff ozpermreg ozprfstrg todeltime /end OUT_MEASUREMENT
 /begin LOC_MEASUREMENT B_ozdperm B_ozer0ok B_ozeranz B_ozerplt B_ozpermgl B_ozpermpl B_ozregstg ozdindex ozdperm ozdpermsi ozeranzp1 ozeranzp2 ozeranzprf ozkmpermgl ozlaufvar ozpermBits1_1s ozpermBits2_1s ozpermerp1 ozpermerp2 ozpermerpr ozpermkmp1 ozpermkmp2 ozpermkmpr ozpermko_w ozpermpl_w ozshift oztv1 oztv2 oztv3 ozvfbfak /end LOC_MEASUREMENT
/end FUNCTION
/begin FUNCTION OZRESTKM "3.50      Berechnung ÷l-Restlaufstrecke"
 /begin DEF_CHARACTERISTIC OZANFANZ OZBZKMSTK1 OZKMMAXK11 OZKVB96 OZKVBMXK18 OZKVBOK16 OZLF1 OZLF2 OZMNKMBO OZMXOHK15 OZPERBOK17 OZPERBRK14 OZPERXK10 OZTAGCTERR OZZEITFAKT /end DEF_CHARACTERISTIC
 /begin REF_CHARACTERISTIC CW_OZ OZKMUPL /end REF_CHARACTERISTIC
 /begin IN_MEASUREMENT B_calcdper B_dmewech B_eepinioz B_kl15 B_oelwech B_ozper0ok B_oztemic B_ozvfchg kmstand kvaverbr oznivnfm ozoelkm ozpermex ozpermlow ozvfbdmew ztageabs_w /end IN_MEASUREMENT
 /begin OUT_MEASUREMENT ozlf1t ozrwanz ozvfanz /end OUT_MEASUREMENT
 /begin LOC_MEASUREMENT B_ozcntini B_rwanz0 kvaverl ozcttagini ozdkvb ozgwfnbo ozkmstrw0 ozkvbbgw ozkvbdmew ozkvbmx ozkvbog ozkvbogw ozkvbsm_ul ozkvbtmp1 ozkvbtmp2 ozkvbtmp3 ozkvbtmp4 ozkvbtmp5 ozkvbtmp6 ozlf1c ozlf2c ozlf2t ozoelzeit ozpermbgw ozpermbog ozpermbogw ozpermma ozpermtmp1 ozpermtmp2 ozpermtmp3 ozrestkmBits_1s ozrwkvb ozrwkvba ozrwkvbr ozrwp ozrwperm ozrwperma ozrwpermr ozrwzeit ozrwzeita ozrwzeitr ozvfkvb ozvfkvbt ozvfzeit ozzeittmp1 ozzeittmp2 ozzeittmp3 /end LOC_MEASUREMENT
/end FUNCTION
/begin FUNCTION OZTEMP "3.10      Aufbereitung ÷ltemperatur" /begin IN_MEASUREMENT B_oztemp m_tol ozggBits1_1s oztemp /end IN_MEASUREMENT /begin OUT_MEASUREMENT oztempf /end OUT_MEASUREMENT /end FUNCTION
/begin FUNCTION PMBNSTAB "1.10"
 /begin DEF_CHARACTERISTIC BNSCLRAPP BNSMAX BNS_CTRINC BNS_SCHW1 BNS_UBMAX BNS_UBMIN BNS_VFZG /end DEF_CHARACTERISTIC
 /begin IN_MEASUREMENT B_kl15 B_nachlend B_nmot B_stend vfzg wub /end IN_MEASUREMENT
 /begin OUT_MEASUREMENT bnctrmx1s bnsctr bnsctrant0 bnsctrant1 bnsctrant2 bnsctrant3 B_bns /end OUT_MEASUREMENT
 /begin LOC_MEASUREMENT B_nachlnd7 /end LOC_MEASUREMENT
/end FUNCTION
/begin FUNCTION PMCON "1.70" /begin IN_MEASUREMENT B_ulcp codcan codfzg /end IN_MEASUREMENT /begin OUT_MEASUREMENT zacodfzg /end OUT_MEASUREMENT /end FUNCTION
/begin FUNCTION PMDIAG "1.60"
 /begin DEF_CHARACTERISTIC ABKORROVER BATTINDAPP BATTREGAPP CBATTAPP CCMELDMASK CCPRIOSET CCPRIOTIME CCPWRSET CLASS2IND CLASS2NENN DSOCHYSTCC DSOCLOW HISTDMERST HISTIBSRST IWAKEAPP KSOGRZAPP KSUGRZAPP OSPGAPP OSPGHYST OSPGPRELLZ OSPRELLDEC OSPRELLINC PMDEFMASK PMMASKDFP RUHVERMODE SOCFITLOW T1PMINFO T2PMINFO T3PMINFO TBATNACHL TCODIERPM TRUHEVERL T_CCRUHVER T_OSPGRSET T_OSPGSET T_USPGRSET T_USPGSET USPGAPP USPGHYST USPGPRELLZ USPRELLDEC USPRELLINC /end DEF_CHARACTERISTIC
 /begin REF_CHARACTERISTIC T1SCHWELLE T2SCHWELLE T3SCHWELLE TSLEEPRUH T_UTIEFSET UTIEFAPP /end REF_CHARACTERISTIC
 /begin IN_MEASUREMENT absch_korr batt_class B_bns B_fabttreg B_fahisrst B_ibfbsd B_ibspwf B_ifbsak B_ifisak B_ifsysak B_iftempak B_ifuplak B_ifusak B_kl15 B_nmot B_soc_npl B_tiefset B_ulcp ctrpcos7 ctrprio ctrpriocf ctrpwrcos d_soc ibsborctr ibsderrs1 ibsderrs2 ibsdncsctr ibseromctr ibsporctr ibspromctr ibsptyctr ibsramctr ibswdtctr ibs_msgind ibs_msgsta ibs_msgwri ibs_start ikurz_ogr ikurz_ugr iwakeupgr kalevcnt kmstand ktupcsctr pmsv qelad qlad rqpcos soc_fit soc_quali soc_rel soc_stfgk S_ckl50 S_cklr t1histiruh t2histiruh t3histiruh t4histiruh tabsmn_w tbatt t_saison ubatt_w ztageabs_w /end IN_MEASUREMENT
 /begin OUT_MEASUREMENT batt_index B_ccbtnach B_ccbttdfk B_ccbttknt B_ccpmerr B_ccprio B_ccruhver B_codierpm B_pcoschg B_tiefrset cbattnenn fs_pm ikurz_ogrz ikurz_ugrz iwakeupgrz pminfo1 pminfo2 /end OUT_MEASUREMENT
 /begin LOC_MEASUREMENT bttregind B_histrset codiercnt daycntr dqelad7 dqlad7 histindex ibsbor_hb kmind ospgcnt ospgprell ospgstat qeladold7 qeladzwsp7 qladold7 qladzwsp7 ruhverl svaus t1pmcntr t2pmcntr t3pmcntr uspgcnt uspgprell uspgstat ztagedelta ztageold /end LOC_MEASUREMENT
/end FUNCTION
/begin COMPU_METHOD B_TRUE "boolsche Zust‰nde, positive Logik" TAB_VERB "%6.3" "" COMPU_TAB_REF B_TRUE /end COMPU_METHOD
/begin COMPU_VTAB B_TRUE "boolsche Zust‰nde, positive Logik" TAB_VERB 2 0 "----" 1 "TRUE" /end COMPU_VTAB
/begin COMPU_METHOD cbatt_ub_b1 "" RAT_FUNC "%7.3" "Ah" COEFFS 0 1 0 0 0 1 /end COMPU_METHOD
/begin COMPU_METHOD DEZ "1 : 1 Umrechnug (dez/hex)" RAT_FUNC "%6.2" "" COEFFS 0 1 0 0 0 1 /end COMPU_METHOD
/begin COMPU_METHOD dez "1 : 1 Umrechnug (dez/hex)" RAT_FUNC "%6.2" "" COEFFS 0 1 0 0 0 1 /end COMPU_METHOD
/begin COMPU_METHOD fak_q0p0039 "" RAT_FUNC "%6.4" "-" COEFFS 0 256 0 0 0 1 /end COMPU_METHOD
/begin COMPU_METHOD fak_q0p004_o100 "" RAT_FUNC "%7.3" "%" COEFFS 0 1 100 0 0 0.004 /end COMPU_METHOD
/begin COMPU_METHOD fak_sw_b64 "" RAT_FUNC "%6.4" "-" COEFFS 0 65536 0 0 0 128 /end COMPU_METHOD
/begin COMPU_METHOD fak_sw_b8 "" RAT_FUNC "%6.5" "-" COEFFS 0 65536 0 0 0 16 /end COMPU_METHOD
/begin COMPU_METHOD fak_ub_b1 "" RAT_FUNC "%6.4" "-" COEFFS 0 256 0 0 0 1 /end COMPU_METHOD
/begin COMPU_METHOD fak_ub_b16 "" RAT_FUNC "%6.4" "-" COEFFS 0 256 0 0 0 16 /end COMPU_METHOD
/begin COMPU_METHOD fak_ub_b2 "" RAT_FUNC "%6.4" "-" COEFFS 0 256 0 0 0 2 /end COMPU_METHOD
/begin COMPU_METHOD fak_ub_b4 "" RAT_FUNC "%6.4" "-" COEFFS 0 256 0 0 0 4 /end COMPU_METHOD
/begin COMPU_METHOD fak_ub_b8 "" RAT_FUNC "%6.4" "-" COEFFS 0 256 0 0 0 8 /end COMPU_METHOD
/begin COMPU_METHOD fak_ub_q0p01 "" RAT_FUNC "%6.4" "-" COEFFS 0 1 0 0 0 0.01 /end COMPU_METHOD
/begin COMPU_METHOD fak_ub_q4p7Em7 "" RAT_FUNC "%11.10" "-" COEFFS 0 1 0 0 0 4.7e-007 /end COMPU_METHOD
/begin COMPU_METHOD fak_uw_b1 "" RAT_FUNC "%7.6" "-" COEFFS 0 65536 0 0 0 1 /end COMPU_METHOD
/begin COMPU_METHOD fak_uw_b2 "" RAT_FUNC "%7.6" "-" COEFFS 0 65536 0 0 0 2 /end COMPU_METHOD
/begin COMPU_METHOD fak_uw_q0p001 "" RAT_FUNC "%6.5" "-" COEFFS 0 65536 0 0 0 65.536 /end COMPU_METHOD
/begin COMPU_METHOD freq_q1 "" RAT_FUNC "%6.2" "1/s" COEFFS 0 1 0 0 0 1 /end COMPU_METHOD
/begin COMPU_METHOD fuel96_ub "" RAT_FUNC "%6.3" "l" COEFFS 0 10 0 0 0 1 /end COMPU_METHOD
/begin COMPU_METHOD fuel_ul_q0p000122 "" RAT_FUNC "%6.5" "" COEFFS 0 8192 0 0 0 1 /end COMPU_METHOD
/begin COMPU_METHOD fuel_uw_b65535 "" RAT_FUNC "%6.2" "ul" COEFFS 0 1 0 0 0 1 /end COMPU_METHOD
/begin COMPU_METHOD fuel_uw_q1 "" RAT_FUNC "%6.2" "" COEFFS 0 1 0 0 0 1 /end COMPU_METHOD
/begin COMPU_METHOD hub_uw_q0p001 "" RAT_FUNC "%6.5" "mm" COEFFS 0 1000 0 0 0 1 /end COMPU_METHOD
/begin COMPU_METHOD i_ub_q1p25em3 "" RAT_FUNC "%7.5" "" COEFFS 0 1000 0 0 0 1.25 /end COMPU_METHOD
/begin COMPU_METHOD i_ub_q5p12 "" RAT_FUNC "%5.2" "A" COEFFS 0 100 0 0 0 512 /end COMPU_METHOD
/begin COMPU_METHOD km_sw_q10 "" RAT_FUNC "%6.1" "" COEFFS 0 0.1 0 0 0 1 /end COMPU_METHOD
/begin COMPU_METHOD km_uw_q10 "" RAT_FUNC "%6.1" "km" COEFFS 0 1 0 0 0 10 /end COMPU_METHOD
/begin COMPU_METHOD kwq_ub_q0p04447 "" RAT_FUNC "%6.4" "Grad KWQ" COEFFS 0 25500 0 0 0 1134 /end COMPU_METHOD
/begin COMPU_METHOD kwq_ub_q0p35576 "" RAT_FUNC "%6.3" "Grad KWQ" COEFFS 0 25500 0 0 0 9072 /end COMPU_METHOD
/begin COMPU_METHOD kw_q0p0039 "" RAT_FUNC "%6.4" "Grad KW" COEFFS 0 256 0 0 0 1 /end COMPU_METHOD
/begin COMPU_METHOD kw_q0p1 "" RAT_FUNC "%6.3" "Grad KW" COEFFS 0 10 0 0 0 1 /end COMPU_METHOD
/begin COMPU_METHOD kw_q1 "" RAT_FUNC "%6.2" "Grad KW" COEFFS 0 1 0 0 0 1 /end COMPU_METHOD
/begin COMPU_METHOD lf_ub "" RAT_FUNC "%6.4" "" COEFFS 0 100 0 0 0 1 /end COMPU_METHOD
/begin COMPU_METHOD md_ub_q1 "" RAT_FUNC "%6.2" "Nm" COEFFS 0 1 0 0 0 1 /end COMPU_METHOD
/begin COMPU_METHOD nivmmxl_ub_b8 "" RAT_FUNC "%6.4" "" COEFFS 0 32 0 0 0 1 /end COMPU_METHOD
/begin COMPU_METHOD nivmmxl_ub_q27p067 "" RAT_FUNC "%6.4" "" COEFFS 0 75 0 0 0 1 /end COMPU_METHOD
/begin COMPU_METHOD niv_sb_b37p5 "" RAT_FUNC "%6.3" "" COEFFS 0 256 0 0 0 75 /end COMPU_METHOD
/begin COMPU_METHOD niv_ub_b75 "" RAT_FUNC "%6.3" "" COEFFS 0 256 0 0 0 75 /end COMPU_METHOD
/begin COMPU_METHOD nmot_q0p125 "" RAT_FUNC "%6.3" "1/min" COEFFS 0 8 0 0 0 1 /end COMPU_METHOD
/begin COMPU_METHOD nmot_sw_q0p25 "" RAT_FUNC "%6.3" "1/min" COEFFS 0 1 0 0 0 0.25 /end COMPU_METHOD
/begin COMPU_METHOD nmot_ub_q10 "" RAT_FUNC "%6.1" "1/min" COEFFS 0 1 0 0 0 10 /end COMPU_METHOD
/begin COMPU_METHOD nmot_ub_q40 "" RAT_FUNC "%6.1" "1/min" COEFFS 0 1 0 0 0 40 /end COMPU_METHOD
/begin COMPU_METHOD nmot_uw_q0p25 "" RAT_FUNC "%6.3" "1/min" COEFFS 0 1 0 0 0 0.25 /end COMPU_METHOD
/begin COMPU_METHOD perm_sw_b6 "" RAT_FUNC "%6.5" "" COEFFS 0 32768 0 0 0 6 /end COMPU_METHOD
/begin COMPU_METHOD perm_uw_b6 "" RAT_FUNC "%7.6" "" COEFFS 0 65536 0 0 0 6 /end COMPU_METHOD
/begin COMPU_METHOD qlad_uw_q0p0182 "" RAT_FUNC "%6.4" "Ah" COEFFS 0 3600000 0 0 0 65536 /end COMPU_METHOD
/begin COMPU_METHOD qlad_uw_q0p29127 "" RAT_FUNC "%9.4" "Ah" COEFFS 0 3600000 0 0 0 1048576 /end COMPU_METHOD
/begin COMPU_METHOD relnmot_q0p0039 "" RAT_FUNC "%6.4" "%/(1/min)" COEFFS 0 256 0 0 0 1 /end COMPU_METHOD
/begin COMPU_METHOD relPED_ub_b100 "" RAT_FUNC "%6.3" "%PED" COEFFS 0 255 0 0 0 100 /end COMPU_METHOD
/begin COMPU_METHOD rel_q0p1957 "" RAT_FUNC "%6.3" "%" COEFFS 0 511 0 0 0 100 /end COMPU_METHOD
/begin COMPU_METHOD rel_sb_q0p78 "" RAT_FUNC "%6.3" "%" COEFFS 0 1 0 0 0 0.78 /end COMPU_METHOD
/begin COMPU_METHOD rel_sw_b100 "" RAT_FUNC "%6.4" "%" COEFFS 0 32768 0 0 0 100 /end COMPU_METHOD
/begin COMPU_METHOD rel_ub_b100 "" RAT_FUNC "%6.3" "%" COEFFS 0 256 0 0 0 100 /end COMPU_METHOD
/begin COMPU_METHOD rel_ub_b127p5 "" RAT_FUNC "%6.3" "%" COEFFS 0 2 0 0 0 1 /end COMPU_METHOD
/begin COMPU_METHOD rel_ub_b24p9 "" RAT_FUNC "%6.3" "%" COEFFS 0 255 0 0 0 24.9 /end COMPU_METHOD
/begin COMPU_METHOD rel_ub_b49p725 "" RAT_FUNC "%6.3" "%" COEFFS 0 255 0 0 0 49.725 /end COMPU_METHOD
/begin COMPU_METHOD rel_ub_b99p6 "" RAT_FUNC "%6.3" "%" COEFFS 0 256 0 0 0 100 /end COMPU_METHOD
/begin COMPU_METHOD rel_ub_bn24p9 "" RAT_FUNC "%6.5" "%" COEFFS 0 -255 0 0 0 24.9 /end COMPU_METHOD
/begin COMPU_METHOD rel_ub_q0p75 "" RAT_FUNC "%6.3" "%" COEFFS 0 1 0 0 0 0.75 /end COMPU_METHOD
/begin COMPU_METHOD rel_ub_q1 "" RAT_FUNC "%6.2" "%" COEFFS 0 1 0 0 0 1 /end COMPU_METHOD
/begin COMPU_METHOD rel_uw_b100 "" RAT_FUNC "%6.4" "%" COEFFS 0 65536 0 0 0 100 /end COMPU_METHOD
/begin COMPU_METHOD rel_uw_b200 "" RAT_FUNC "%6.4" "%" COEFFS 0 65536 0 0 0 200 /end COMPU_METHOD
/begin COMPU_METHOD rel_uw_q0p0234 "" RAT_FUNC "%6.4" "%" COEFFS 0 32 0 0 0 0.75 /end COMPU_METHOD
/begin COMPU_METHOD spg_q0p25em3 "" RAT_FUNC "%9.7" "V" COEFFS 0 1 0 0 0 0.00025 /end COMPU_METHOD
/begin COMPU_METHOD spg_ubatt "" RAT_FUNC "%6.3" "V" COEFFS 0 1 0 0 0 0.0942 /end COMPU_METHOD
/begin COMPU_METHOD spg_uw_q0p25em3_o6 "" RAT_FUNC "%9.5" "V" COEFFS 0 1 -6 0 0 0.00025 /end COMPU_METHOD
/begin COMPU_METHOD t100msxs_ub_b255 "" RAT_FUNC "%6.2" "s" COEFFS 0 1 0 0 0 1 /end COMPU_METHOD
/begin COMPU_METHOD t100msxs_uw_b6553p5 "" RAT_FUNC "%6.3" "s" COEFFS 0 1 0 0 0 0.1 /end COMPU_METHOD
/begin COMPU_METHOD t100msxs_uw_b6553p6 "" RAT_FUNC "%6.3" "s" COEFFS 0 10 0 0 0 1 /end COMPU_METHOD
/begin COMPU_METHOD t10msxs_ub_b2p55 "" RAT_FUNC "%6.4" "s" COEFFS 0 1 0 0 0 0.01 /end COMPU_METHOD
/begin COMPU_METHOD t1mxm_ul_q1 "" RAT_FUNC "%6.2" "min" COEFFS 0 1 0 0 0 1 /end COMPU_METHOD
/begin COMPU_METHOD t1sxs_uw_b65535 "" RAT_FUNC "%6.2" "s" COEFFS 0 1 0 0 0 1 /end COMPU_METHOD
/begin COMPU_METHOD t200msxs_ub_b51 "" RAT_FUNC "%6.3" "s" COEFFS 0 1 0 0 0 0.2 /end COMPU_METHOD
/begin COMPU_METHOD t20msxs_ub_b5p1 "" RAT_FUNC "%6.4" "s" COEFFS 0 1 0 0 0 0.02 /end COMPU_METHOD
/begin COMPU_METHOD t20msxs_uw_q0p02 "" RAT_FUNC "%6.4" "s" COEFFS 0 1 0 0 0 0.02 /end COMPU_METHOD
/begin COMPU_METHOD t5usxus_q5 "" RAT_FUNC "%6.2" "us" COEFFS 0 1 0 0 0 5 /end COMPU_METHOD
/begin COMPU_METHOD temp_ub_b191p25 "" RAT_FUNC "%6.3" "Grad C" COEFFS 0 1 0 0 0 0.75 /end COMPU_METHOD
/begin COMPU_METHOD temp_ub_q0p75 "" RAT_FUNC "%6.3" "Grad C" COEFFS 0 1 0 0 0 0.75 /end COMPU_METHOD
/begin COMPU_METHOD temp_ub_q0p75_o48 "" RAT_FUNC "%6.2" "Grad C" COEFFS 0 1 48 0 0 0.75 /end COMPU_METHOD
/begin COMPU_METHOD temp_ub_q1_o48 "" RAT_FUNC "%6.2" "" COEFFS 0 1 48 0 0 1 /end COMPU_METHOD
/begin COMPU_METHOD temp_uw_q0p75_o12288 "" RAT_FUNC "%7.0" "Grad C" COEFFS 0 1 12288 0 0 0.75 /end COMPU_METHOD
/begin COMPU_METHOD txhistiruh "" RAT_FUNC "%9.4" "min" COEFFS 0 65536 0 0 0 15360 /end COMPU_METHOD
/begin COMPU_METHOD tz10msxs_uw_b327p68 "" RAT_FUNC "%6.2" "s" COEFFS 0 0 327.68 0 1 0 /end COMPU_METHOD
/begin COMPU_METHOD t_q0p001_ms "" RAT_FUNC "%6.5" "ms" COEFFS 0 1 0 0 0 0.001 /end COMPU_METHOD
/begin COMPU_METHOD t_q0p01 "" RAT_FUNC "%6.4" "s" COEFFS 0 100 0 0 0 1 /end COMPU_METHOD
/begin COMPU_METHOD t_q0p04_ms "" RAT_FUNC "%6.4" "ms" COEFFS 0 1 0 0 0 0.04 /end COMPU_METHOD
/begin COMPU_METHOD t_q0p1 "" RAT_FUNC "%6.3" "s" COEFFS 0 10 0 0 0 1 /end COMPU_METHOD
/begin COMPU_METHOD t_q0p2 "" RAT_FUNC "%6.3" "s" COEFFS 0 10 0 0 0 2 /end COMPU_METHOD
/begin COMPU_METHOD t_q1 "" RAT_FUNC "%6.2" "s" COEFFS 0 1 0 0 0 1 /end COMPU_METHOD
/begin COMPU_METHOD vfzg_ub_q1p25 "" RAT_FUNC "%6.2" "km/h" COEFFS 0 1 0 0 0 1.25 /end COMPU_METHOD
/begin COMPU_METHOD zk10msxs_ub_b2p55 "" RAT_FUNC "%6.4" "s" COEFFS 0 0 255 0 100 0 /end COMPU_METHOD
/begin COMPU_METHOD zk10msxs_uw_b655 "" RAT_FUNC "%6.2" "s" COEFFS 0 0 65536 0 100 0 /end COMPU_METHOD
/begin COMPU_METHOD zk200msxs_ub_b51p2 "" RAT_FUNC "%6.3" "s" COEFFS 0 0 51.2 0 1 0 /end COMPU_METHOD
/begin COMPU_METHOD zk200msxs_uw_b13107 "" RAT_FUNC "%6.0" "s" COEFFS 0 0 13107 0 1 0 /end COMPU_METHOD
/begin COMPU_METHOD zk20msxs_ub_b5p1 "" RAT_FUNC "%6.4" "s" COEFFS 0 0 5.1 0 1 0 /end COMPU_METHOD
/begin COMPU_METHOD zw_sb_q0p75 "" RAT_FUNC "%6.3" "Grad KW" COEFFS 0 255 0 0 0 191.25 /end COMPU_METHOD
/begin RECORD_LAYOUT FklWSb FNC_VALUES 1 SBYTE COLUMN_DIR DIRECT /end RECORD_LAYOUT
/begin RECORD_LAYOUT FklWU8 FNC_VALUES 1 UBYTE COLUMN_DIR DIRECT /end RECORD_LAYOUT
/begin RECORD_LAYOUT FklWUb FNC_VALUES 1 UBYTE COLUMN_DIR DIRECT /end RECORD_LAYOUT
/begin RECORD_LAYOUT GkfWUb FNC_VALUES 1 UBYTE COLUMN_DIR DIRECT /end RECORD_LAYOUT
/begin RECORD_LAYOUT GklWSw FNC_VALUES 1 SWORD COLUMN_DIR DIRECT /end RECORD_LAYOUT
/begin RECORD_LAYOUT GklWUb FNC_VALUES 1 UBYTE COLUMN_DIR DIRECT /end RECORD_LAYOUT
/begin RECORD_LAYOUT GklWUw FNC_VALUES 1 UWORD COLUMN_DIR DIRECT /end RECORD_LAYOUT
/begin RECORD_LAYOUT KfAxU8AyU8SstxU16SstyU16WU16 NO_AXIS_PTS_X 1 UWORD NO_AXIS_PTS_Y 2 UWORD AXIS_PTS_X 3 UWORD INDEX_INCR DIRECT AXIS_PTS_Y 4 UWORD INDEX_INCR DIRECT FNC_VALUES 5 UWORD COLUMN_DIR DIRECT /end RECORD_LAYOUT
/begin RECORD_LAYOUT KfAxU8AyU8SstxU8SstyU8WU8 NO_AXIS_PTS_X 1 UBYTE NO_AXIS_PTS_Y 2 UBYTE AXIS_PTS_X 3 UBYTE INDEX_INCR DIRECT AXIS_PTS_Y 4 UBYTE INDEX_INCR DIRECT FNC_VALUES 5 UBYTE COLUMN_DIR DIRECT /end RECORD_LAYOUT
/begin RECORD_LAYOUT KfAxUbAyUbSstxUbSstyUbWUb NO_AXIS_PTS_X 1 UBYTE NO_AXIS_PTS_Y 2 UBYTE AXIS_PTS_X 3 UBYTE INDEX_INCR DIRECT AXIS_PTS_Y 4 UBYTE INDEX_INCR DIRECT FNC_VALUES 5 UBYTE COLUMN_DIR DIRECT /end RECORD_LAYOUT
/begin RECORD_LAYOUT KfAxUbAyUbSstxUbSstyUwWUw NO_AXIS_PTS_X 1 UBYTE NO_AXIS_PTS_Y 2 UBYTE AXIS_PTS_X 3 UBYTE INDEX_INCR DIRECT AXIS_PTS_Y 4 UWORD INDEX_INCR DIRECT FNC_VALUES 5 UWORD COLUMN_DIR DIRECT /end RECORD_LAYOUT
/begin RECORD_LAYOUT KfAxUbAyUbSstxUwSstyUbWUb NO_AXIS_PTS_X 1 UBYTE NO_AXIS_PTS_Y 2 UBYTE AXIS_PTS_X 3 UWORD INDEX_INCR DIRECT AXIS_PTS_Y 4 UBYTE INDEX_INCR DIRECT FNC_VALUES 5 UBYTE COLUMN_DIR DIRECT /end RECORD_LAYOUT
/begin RECORD_LAYOUT KfAxUwAyUwSstxUwSstyUwWUw NO_AXIS_PTS_X 1 UWORD NO_AXIS_PTS_Y 2 UWORD AXIS_PTS_X 3 UWORD INDEX_INCR DIRECT AXIS_PTS_Y 4 UWORD INDEX_INCR DIRECT FNC_VALUES 5 UWORD COLUMN_DIR DIRECT /end RECORD_LAYOUT
/begin RECORD_LAYOUT KlAUbSstUbWSb NO_AXIS_PTS_X 1 UBYTE AXIS_PTS_X 2 UBYTE INDEX_INCR DIRECT FNC_VALUES 3 SBYTE COLUMN_DIR DIRECT /end RECORD_LAYOUT
/begin RECORD_LAYOUT KlAUbSstUbWUb NO_AXIS_PTS_X 1 UBYTE AXIS_PTS_X 2 UBYTE INDEX_INCR DIRECT FNC_VALUES 3 UBYTE COLUMN_DIR DIRECT /end RECORD_LAYOUT
/begin RECORD_LAYOUT KlAUbSstUbWUw NO_AXIS_PTS_X 1 UBYTE AXIS_PTS_X 2 UBYTE INDEX_INCR DIRECT FNC_VALUES 3 UWORD COLUMN_DIR DIRECT /end RECORD_LAYOUT
/begin RECORD_LAYOUT KlAUwSstUwWSw NO_AXIS_PTS_X 1 UWORD AXIS_PTS_X 2 UWORD INDEX_INCR DIRECT FNC_VALUES 3 SWORD COLUMN_DIR DIRECT /end RECORD_LAYOUT
/begin RECORD_LAYOUT KlAUwSstUwWUw NO_AXIS_PTS_X 1 UWORD AXIS_PTS_X 2 UWORD INDEX_INCR DIRECT FNC_VALUES 3 UWORD COLUMN_DIR DIRECT /end RECORD_LAYOUT
/begin RECORD_LAYOUT KlAxU8SstxU16WU16 NO_AXIS_PTS_X 1 UWORD AXIS_PTS_X 2 UWORD INDEX_INCR DIRECT FNC_VALUES 3 UWORD COLUMN_DIR DIRECT /end RECORD_LAYOUT
/begin RECORD_LAYOUT KlAxU8SstxU8WS8 NO_AXIS_PTS_X 1 UBYTE AXIS_PTS_X 2 UBYTE INDEX_INCR DIRECT FNC_VALUES 3 SBYTE COLUMN_DIR DIRECT /end RECORD_LAYOUT
/begin RECORD_LAYOUT KlAxU8SstxU8WU16 NO_AXIS_PTS_X 1 UBYTE AXIS_PTS_X 2 UBYTE INDEX_INCR DIRECT FNC_VALUES 3 UWORD COLUMN_DIR DIRECT /end RECORD_LAYOUT
/begin RECORD_LAYOUT KlAxU8SstxU8WU8 NO_AXIS_PTS_X 1 UBYTE AXIS_PTS_X 2 UBYTE INDEX_INCR DIRECT FNC_VALUES 3 UBYTE COLUMN_DIR DIRECT /end RECORD_LAYOUT
/begin RECORD_LAYOUT KwSw FNC_VALUES 1 SWORD COLUMN_DIR DIRECT /end RECORD_LAYOUT
/begin RECORD_LAYOUT KwUb FNC_VALUES 1 UBYTE COLUMN_DIR DIRECT /end RECORD_LAYOUT
/begin RECORD_LAYOUT KwUw FNC_VALUES 1 UWORD COLUMN_DIR DIRECT /end RECORD_LAYOUT
/begin RECORD_LAYOUT KwWS16 FNC_VALUES 1 SWORD COLUMN_DIR DIRECT /end RECORD_LAYOUT
/begin RECORD_LAYOUT KwWU16 FNC_VALUES 1 UWORD COLUMN_DIR DIRECT /end RECORD_LAYOUT
/begin RECORD_LAYOUT KwWU8 FNC_VALUES 1 UBYTE COLUMN_DIR DIRECT /end RECORD_LAYOUT
/begin RECORD_LAYOUT SstAUbSstUb NO_AXIS_PTS_X 1 UBYTE AXIS_PTS_X 2 UBYTE INDEX_INCR DIRECT /end RECORD_LAYOUT
/end MODULE
/end PROJECT
