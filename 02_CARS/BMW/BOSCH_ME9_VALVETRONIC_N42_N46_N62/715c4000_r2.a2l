ASAP2_VERSION 1 3
/begin PROJECT _715C4000_r2 "basisme9"
/begin HEADER "" VERSION "_715C4000_r2" PROJECT_NO _715C4000_r2 /end HEADER
/begin MODULE DIM ""
/begin MOD_COMMON "" BYTE_ORDER MSB_FIRST ALIGNMENT_BYTE 1 ALIGNMENT_WORD 2 ALIGNMENT_LONG 2 ALIGNMENT_FLOAT32_IEEE 4 /end MOD_COMMON
/begin CHARACTERISTIC ABAOVMX "Max. Anzahl Beschleunigungsvorg‰nge ohne Adaptionswertr¸ckstellung" VALUE 0xFC4DFC KwUb 254.0 dez 1.000 255.0 FORMAT "%5.1" /end CHARACTERISTIC
/begin CHARACTERISTIC ADCY "Anzahl DCY zum Initialisieren der Dauerlaufz‰hler" VALUE 0xFC1A92 KwWU8 255.0 dez 0.00 255.0 FORMAT "%5.1" /end CHARACTERISTIC
/begin CHARACTERISTIC AHEAGW "Aussetzerh‰ufigkeit zum Erreichen der gesetzlichen Abgaslimits" VALUE 0xFC1A84 KwWU16 65535.00 dez 0.00 65535.00 FORMAT "%8.2" /end CHARACTERISTIC
/begin CHARACTERISTIC AHEAGWS "Aussetzerh‰ufigkeit zum Erreichen der gesetzlichen Abgaslimits" VALUE 0xFC1A86 KwWU16 65535.00 dez 0.00 65535.00 FORMAT "%8.2" /end CHARACTERISTIC
/begin CHARACTERISTIC AHEARV "Aussetzerh‰ufigkeit zum Erreichen der Ausblendung weiterer Funktionen" VALUE 0xFC1A88 KwWU16 65535.00 dez 0.00 65535.00 FORMAT "%8.2" /end CHARACTERISTIC
/begin CHARACTERISTIC AHEKABB "Aussetzerh‰ufigkeit pro Bank zum Erreichen einer Kraftstoffabschaltung" VAL_BLK 0xFC1A76 KwbWU16 65535.00 dez 0.00 65535.00 FORMAT "%8.2" NUMBER 4 /end CHARACTERISTIC
/begin CHARACTERISTIC AHEKS1B1 "Aussetzerh‰ufigkeit zum Erreichen einer Katsch‰digung im 1. Intervall Bank 1" VALUE 0xFC1A8A KwWU16 65535.00 dez 0.00 65535.00 FORMAT "%8.2" /end CHARACTERISTIC
/begin CHARACTERISTIC AHEKS1B2 "Aussetzerh‰ufigkeit zum Erreichen einer Katsch‰digung im 1. Intervall Bank 2" VALUE 0xFC1A8C KwWU16 65535.00 dez 0.00 65535.00 FORMAT "%8.2" /end CHARACTERISTIC
/begin CHARACTERISTIC AHEKSB1 "Aussetzerh‰ufigkeit zum Erreichen einer Katalysatorsch‰digung Bank 1" VALUE 0xFC1A8E KwWU16 65535.00 dez 0.00 65535.00 FORMAT "%8.2" /end CHARACTERISTIC
/begin CHARACTERISTIC AHEKSB2 "Aussetzerh‰ufigkeit zum Erreichen einer Katalysatorsch‰digung Bank 2" VALUE 0xFC1A90 KwWU16 65535.00 dez 0.00 65535.00 FORMAT "%8.2" /end CHARACTERISTIC
/begin CHARACTERISTIC AIMDTED "Schwelle f¸r Stˆrerkennung Verlustmoment" VALUE 0xFC9B38 KwUw 99.99847 rel_uw_b100 0.00 99.99847 FORMAT "%8.5" /end CHARACTERISTIC
/begin CHARACTERISTIC AINTKAN "Anzahl Intervalle mit Katsch‰digung f¸r Ti-Abschaltung" CURVE 0xFC1A3C GklWU8 255.0 dez 0.00 255.0 FORMAT "%5.1"
 /begin AXIS_DESCR COM_AXIS nmot nmot_ub_q40 8 0.00 10200. FORMAT "%5.0" AXIS_PTS_REF SNM08DMUB /end AXIS_DESCR
/end CHARACTERISTIC
/begin CHARACTERISTIC AIODTEX "Maximale Anzahl der i.O.-Pr¸fungen bei Tankentl¸ftungsdiagnose" VALUE 0xFCFC96 KwUb 255.0 dez 0.00 255.0 FORMAT "%5.1" /end CHARACTERISTIC
/begin CHARACTERISTIC AMNUUKA "Minimalanzahl Sondenspr¸nge zwischen 2 Adaptionsvorg‰ngen (‹K-Adaption)" VALUE 0xFC4DFD KwUb 253.0 dez 2.000 255.0 FORMAT "%5.1" /end CHARACTERISTIC
/begin CHARACTERISTIC ANZTIBMX "Begrenzung ti-Einspritzz‰hler ""anztib_w""" VALUE 0xFC4B06 KwUw 50176.00 dez 0.00 50176.00 FORMAT "%8.2" /end CHARACTERISTIC
/begin CHARACTERISTIC ANZTIWS "Anzahl Einspritzungen f¸r Wiederholstarterkennung" VALUE 0xFC4C28 KwUb 255.0 dez 0.00 255.0 FORMAT "%5.1" /end CHARACTERISTIC
/begin CHARACTERISTIC APDTEX "max. Anzahl Pr¸fungen bei Tankentl¸ftungsdiagnose" VALUE 0xFCFC97 KwUb 255.0 dez 0.00 255.0 FORMAT "%5.1" /end CHARACTERISTIC
/begin CHARACTERISTIC ASPUUKA "Anzahl Sondenspr¸nge f¸r Verbot der ‹K-Adaption" VALUE 0xFC4DFE KwUb 253.0 dez 2.000 255.0 FORMAT "%5.1" /end CHARACTERISTIC
/begin CHARACTERISTIC ASP_ADPWF "Adaptionswert Anschlag Auslasspreizung bei Powerfail" VALUE 0xFCFFA2 KwUw 6554. sprzi_q0p1 0.00 6554. FORMAT "%4.0" /end CHARACTERISTIC
/begin CHARACTERISTIC ASP_ADTV "Adaptionstastverh‰ltnis Auslasspreizung variable NWS" VALUE 0xFCFF96 KwUb 255.0 dez 0.00 255.0 FORMAT "%5.1" /end CHARACTERISTIC
/begin CHARACTERISTIC ASP_BA "Betriebsartenwahlschalter Auslasspreizung variable NWS" VALUE 0xFCFF97 KwUb 255.0 dez 0.00 255.0 FORMAT "%5.1" /end CHARACTERISTIC
/begin CHARACTERISTIC ASP_TVHB "Ausgabe-Tastverh‰ltnis bei Handbetrieb f¸r Auslasspreizung variable NWS" VALUE 0xFCFF98 KwUb 255.0 dez 0.00 255.0 FORMAT "%5.1" /end CHARACTERISTIC
/begin CHARACTERISTIC ASP_WNWS "Sollspreizung bei Handbetrieb f¸r Auslasspreizung variable NWS" VALUE 0xFCFFA4 KwUw 6554. sprzi_q0p1 0.00 6554. FORMAT "%4.0" /end CHARACTERISTIC
/begin CHARACTERISTIC AVAOVMX "Max. Anzahl Verzˆgerungsvorg‰nge ohne Adaptionswertr¸ckstellung" VALUE 0xFC4DFF KwUb 254.0 dez 1.000 255.0 FORMAT "%5.1" /end CHARACTERISTIC
/begin CHARACTERISTIC AVRALU "Anzahl NW-Umdr./Verbrenng. f. Reaktivierung Aussetzererkennung nach Ausblendung" VALUE 0xFC1AC8 KwWU8 255.0 DEZ 0.00 255.0 FORMAT "%5.1" /end CHARACTERISTIC
/begin CHARACTERISTIC AZSTLU "Verl‰ngerung der Ausblendanforderung bei Motorstart in Anzahl Z¸ndungen" VALUE 0xFC1AC9 KwWU8 255.0 DEZ 0.00 255.0 FORMAT "%5.1" /end CHARACTERISTIC
/begin CHARACTERISTIC AZSTPON "Umschaltung von Ausblendanforderung nach Motorstart in Anzahl Z¸ndungen" VALUE 0xFC1ACA KwWU8 255.0 DEZ 0.00 255.0 FORMAT "%5.1" /end CHARACTERISTIC
/begin CHARACTERISTIC AZYTIABB "Max. Anzahl von Zylindern mit Ti-Abschaltung aufgrund von Aussetzern, pro Bank" VAL_BLK 0xFC1A80 KwbWU8 255.0 dez 0.00 255.0 FORMAT "%5.1" NUMBER 4 /end CHARACTERISTIC
/begin CHARACTERISTIC CUKA "Codewort ‹K-Adaption" VALUE 0xFC4E00 KwUb 255.0 dez 0.00 255.0 FORMAT "%5.1" /end CHARACTERISTIC
/begin CHARACTERISTIC CWDALA "Codewort DMDMIL Dauerlaufz‰hler" VALUE 0xFC1A93 KwWU8 255.0 dez 0.00 255.0 FORMAT "%5.1" /end CHARACTERISTIC
/begin CHARACTERISTIC CWDMDE "Codewort f¸r EOBD-Appl. DMDMIL (Heilung ohne Fensterabd.)" VALUE 0xFC1A94 KwWU8 255.0 dez 0.00 255.0 FORMAT "%5.1" /end CHARACTERISTIC
/begin CHARACTERISTIC CWDMDZAG "Codewort DMDZAG Konfiguration" VALUE 0xFC1DAE KwWU8 255.0 DEZ 0.00 255.0 FORMAT "%5.1" /end CHARACTERISTIC
/begin CHARACTERISTIC CWDSLSA "" VALUE 0xFD04A4 KwUb 255.0 dez 0.00 255.0 FORMAT "%5.1" /end CHARACTERISTIC
/begin CHARACTERISTIC CWDSLSY "Codewort in der Diagnose Sekund‰rluftsystem" VALUE 0xFD04A5 KwUb 255.0 dez 0.00 255.0 FORMAT "%5.1" /end CHARACTERISTIC
/begin CHARACTERISTIC CWESSTT "Codewort zum setzen der Bits B_vbemg und B_wks" VALUE 0xFC4C29 KwUb 255.0 dez 0.00 255.0 FORMAT "%5.1" /end CHARACTERISTIC
/begin CHARACTERISTIC CWMILCOD "Codewort MIL-Codierung aktiv" VALUE 0xFC118A KwUb 255.0 dez 0.00 255.0 FORMAT "%5.1" /end CHARACTERISTIC
/begin CHARACTERISTIC CWNOMIL "Codewort MIL-Ansteuerung nicht aktiv" VALUE 0xFC118B KwUb 255.0 dez 0.00 255.0 FORMAT "%5.1" /end CHARACTERISTIC
/begin CHARACTERISTIC CWPSMLE "Codewort f¸r L¸fterendstufe" VALUE 0xFCCD6C KwWU8 255.0 dez 0.00 255.0 FORMAT "%5.1" /end CHARACTERISTIC
/begin CHARACTERISTIC CWPSNWSAE "Kodewort zum Abschalten der Endstufediagnose NWS Auslass" VALUE 0xFCCD82 KwWU8 255.0 dez 0.00 255.0 FORMAT "%5.1" /end CHARACTERISTIC
/begin CHARACTERISTIC CWPSNWSEE "Kodewort zum Abschalten der Endstufediagnose NWS Einlass" VALUE 0xFCCD7C KwWU8 255.0 dez 0.00 255.0 FORMAT "%5.1" /end CHARACTERISTIC
/begin CHARACTERISTIC CWPSSLPE "Kodewort zum Abschalten der Endstufediagnose" VALUE 0xFCCD6F KwWU8 255.0 dez 0.00 255.0 FORMAT "%5.1" /end CHARACTERISTIC
/begin CHARACTERISTIC CWPSSUE "Codewort f¸r Endstufendiagnose Saugrohrumschaltung" VALUE 0xFC203C KwWU8 255.0 dez 0.00 255.0 FORMAT "%5.1" /end CHARACTERISTIC
/begin CHARACTERISTIC CWPSTEVE "Kodewort zum Abschalten der Endstufediagnose" VALUE 0xFCCD76 KwWU8 255.0 dez 0.00 255.0 FORMAT "%5.1" /end CHARACTERISTIC
/begin CHARACTERISTIC CWSTDMD "Codewort zur Auswahl Startfreigabe: 1 -> B_st, 0 -> nmot" VALUE 0xFC1ACB KwWU8 255.0 DEZ 0.00 255.0 FORMAT "%5.1" /end CHARACTERISTIC
/begin CHARACTERISTIC CWSTPCNF "Codewort Ausblendkriterien 1 -> Kriterium aktiv" VALUE 0xFC1ACC KwWU8 255.0 DEZ 0.00 255.0 FORMAT "%5.1" /end CHARACTERISTIC
/begin CHARACTERISTIC CW_DR_ERR1 "" VALUE 0xFD1424 KwWU16 65535.00 dez 0.00 65535.00 FORMAT "%8.2" /end CHARACTERISTIC
/begin CHARACTERISTIC CW_DR_ERR2 "" VALUE 0xFD1426 KwWU16 65535.00 dez 0.00 65535.00 FORMAT "%8.2" /end CHARACTERISTIC
/begin CHARACTERISTIC CW_DR_ERR_ID "" VALUE 0xFD1428 KwWU8 255.0 dez 0.00 255.0 FORMAT "%5.1" /end CHARACTERISTIC
/begin CHARACTERISTIC CW_DZKU "Codewort Z¸ndkreis¸berwachung" VALUE 0xFCB14C KwWU8 255.0 dez 0.00 255.0 FORMAT "%5.1" /end CHARACTERISTIC
/begin CHARACTERISTIC CW_VNSABST "CW Verhinderung der Verriegelung durch Abstand vom Anschlag" VALUE 0xFCFF99 KwUb 255.0 dez 0.00 255.0 FORMAT "%5.1" /end CHARACTERISTIC
/begin CHARACTERISTIC CW_VNSDYN "Verhinderung der Verriegelung durch adapt. Druckvorsteuerung" VALUE 0xFCFF9A KwUb 255.0 dez 0.00 255.0 FORMAT "%5.1" /end CHARACTERISTIC
/begin CHARACTERISTIC DELTA_AN "" VAL_BLK 0xFC9BFA KwbWU16 6554. sprzi_q0p1 0.00 6554. FORMAT "%4.0" NUMBER 4 /end CHARACTERISTIC
/begin CHARACTERISTIC DFRBAF "Delta Lambdaregler zur Erkennung BA fett" VALUE 0xFC4E0E KwSw 1.999969 fak_sw_b1 -1.000000 0.9999695 FORMAT "%8.6" /end CHARACTERISTIC
/begin CHARACTERISTIC DFRBAM "Delta Lambdaregler zur Erkennung BA mager" VALUE 0xFC4E10 KwSw 1.999969 fak_sw_b1 -1.000000 0.9999695 FORMAT "%8.6" /end CHARACTERISTIC
/begin CHARACTERISTIC DFRMOFNX "frm-Offset-Schwelle (negativ): Kontrolle Vorsteuerproblem" VALUE 0xFD04DA KwSw 1.999969 fak_sw_b1 -1.000000 0.9999695 FORMAT "%8.6" /end CHARACTERISTIC
/begin CHARACTERISTIC DFRMOFNXKT "" VALUE 0xFD04DC KwSw 1.999969 fak_sw_b1 -1.000000 0.9999695 FORMAT "%8.6" /end CHARACTERISTIC
/begin CHARACTERISTIC DFRMOFPX "frm-Offset-Schwelle (positiv): Kontrolle Vorsteuerproblem" VALUE 0xFD04DE KwSw 1.999969 fak_sw_b1 -1.000000 0.9999695 FORMAT "%8.6" /end CHARACTERISTIC
/begin CHARACTERISTIC DFRMOFPXKT "" VALUE 0xFD04E0 KwSw 1.999969 fak_sw_b1 -1.000000 0.9999695 FORMAT "%8.6" /end CHARACTERISTIC
/begin CHARACTERISTIC DFRVAF "Delta Lambdaregler zur Erkennung VA fett" VALUE 0xFC4E12 KwSw 1.999969 fak_sw_b1 -1.000000 0.9999695 FORMAT "%8.6" /end CHARACTERISTIC
/begin CHARACTERISTIC DFRVAM "Delta Lambdaregler zur Erkennung VA mager" VALUE 0xFC4E14 KwSw 1.999969 fak_sw_b1 -1.000000 0.9999695 FORMAT "%8.6" /end CHARACTERISTIC
/begin CHARACTERISTIC DMDSEGL "Segmentl‰nge f¸r Aussetzererkennung" VALUE 0xFC6364 KwWU16 393210.0 kw_q6 0.00 393210.0 FORMAT "%8.1" /end CHARACTERISTIC
/begin CHARACTERISTIC DMITED "Delta Schwelle F¸llungswunsch" VALUE 0xFC9B3A KwUw 99.99847 rel_uw_b100 0.00 99.99847 FORMAT "%8.5" /end CHARACTERISTIC
/begin CHARACTERISTIC DMSLIFTMN "" VALUE 0xFD04E2 KwUw 1638.375 m_q0p025 0.00 1638.375 FORMAT "%8.3" /end CHARACTERISTIC
/begin CHARACTERISTIC DNSTED "Schwelle Delta Nsoll f¸r Abbruch Diagnose Tankentl¸ftung" VALUE 0xFC9B34 KwUb 2550. nmot_ub_q10 0.00 2550. FORMAT "%5.0" /end CHARACTERISTIC
/begin CHARACTERISTIC DPSUKAO "Abstand max. Saugrohrdruck zu ps-Obergrenze f¸r ‹K-Adaption" VALUE 0xFCDADA KwUw 2559.961 p_uw_q0p039 0.00 2559.961 FORMAT "%8.3" /end CHARACTERISTIC
/begin CHARACTERISTIC DRLSOLA "Misfire Detection : Schwelle Lastdynamik f¸r Ausblendung" CURVE 0xFC1A9C GklWS16 1535.977 relNWU_q0p0234 -768.0000 767.9766 FORMAT "%8.4"
 /begin AXIS_DESCR COM_AXIS rl rel_ub_q0p75 8 0.00 191.3 FORMAT "%5.1" AXIS_PTS_REF SRL08DMUB /end AXIS_DESCR
/end CHARACTERISTIC
/begin CHARACTERISTIC DRLSOLST "Misfire Detection : Schwelle Lastdynamik f¸r Ausblendung nach Start" VALUE 0xFC1AC4 KwWS16 1535.977 relNWU_q0p0234 -768.0000 767.9766 FORMAT "%8.4" /end CHARACTERISTIC
/begin CHARACTERISTIC DRLSPMN "Min. Last‰nderung zwischen 2 Sondenspr¸ngen f¸r ‹K-Adaption" VALUE 0xFC4E01 KwSb 95.25 rel_sb_q0p75 0.00 95.25 FORMAT "%5.2" /end CHARACTERISTIC
/begin CHARACTERISTIC DSLVFZMN "" VALUE 0xFD04A6 KwUb 318.8 vfzg_ub_q1p25 0.00 318.8 FORMAT "%5.1" /end CHARACTERISTIC
/begin CHARACTERISTIC DTEBLEIN "Hystherese f¸r Temperaturschwelle f¸r E-Box L¸fter Ansteuerung" VALUE 0xFD050A KwUb 191.3 temp_ub_q0p75_o48 -48.00 143.3 FORMAT "%5.1" /end CHARACTERISTIC
/begin CHARACTERISTIC DTMWUC "Delta Motortemperaturschwelle f¸r Erf¸llung 'warm up cycle'" VALUE 0xFC118E KwUb 191.3 temp_ub_b191p25 0.00 191.3 FORMAT "%5.1" /end CHARACTERISTIC
/begin CHARACTERISTIC DTOG_UBMIN "Ub Schwelle Toens" VALUE 0xFC5646 KwWU8 24.02 spg_ubatt 0.00 24.02 FORMAT "%5.2" /end CHARACTERISTIC
/begin CHARACTERISTIC DUF_T "Zeit f¸rs Setzen der Zyklusflags der Funktions¸berwachungs-Diagnose" VALUE 0xFC0E9E KwUb 25.50 t100msxs_ub_b25p5 0.00 25.50 FORMAT "%5.2" /end CHARACTERISTIC
/begin CHARACTERISTIC DUKK "Schwelle f¸r Kurzzeitanteil" VALUE 0xFC4DBE KwSw 12287.81 rel_sw_q0p1875 -6144.000 6143.813 FORMAT "%8.3" /end CHARACTERISTIC
/begin CHARACTERISTIC DVNS_CLR "Label zum Loeschen der Umgebungsbedingungen (INI)" VALUE 0xFC9C02 KwWU8 255.0 dez 0.00 255.0 FORMAT "%5.1" /end CHARACTERISTIC
/begin CHARACTERISTIC DZKDMDZL "Schwellwert Entprellz‰hler Aussetzererkennung" VALUE 0xFCB14D KwWU8 255.0 dez 0.00 255.0 FORMAT "%5.1" /end CHARACTERISTIC
/begin CHARACTERISTIC DZKDUB "Maximale Spannungsschwankung" VALUE 0xFCB14E KwWU8 19.41 spg_ubatt 0.00 19.41 FORMAT "%5.2" /end CHARACTERISTIC
/begin CHARACTERISTIC DZKSUB_DZKU_IMPL "" VALUE 0xFCB14F KwWU8 255.0 dez 0.00 255.0 FORMAT "%5.1" READ_ONLY /end CHARACTERISTIC
/begin CHARACTERISTIC DZOTPERR_DZKU_IMPL "" VALUE 0xFCB150 KwWU8 255.0 dez 0.00 255.0 FORMAT "%5.1" READ_ONLY /end CHARACTERISTIC
/begin CHARACTERISTIC DZPHKSUB "Entprelltiefe harter Z¸ndkreiskurzschluss" VALUE 0xFCB151 KwWU8 255.0 dez 0.00 255.0 FORMAT "%5.1" /end CHARACTERISTIC
/begin CHARACTERISTIC DZPKSMS "Z‰hldauer des Entprellz‰hlers KS nach Masse" VALUE 0xFCB152 KwWU8 255.0 dez 0.00 255.0 FORMAT "%5.1" /end CHARACTERISTIC
/begin CHARACTERISTIC DZPKSMSR "Entprelltiefe Massekurzschluss" VALUE 0xFCB153 KwWU8 255.0 dez 0.00 255.0 FORMAT "%5.1" /end CHARACTERISTIC
/begin CHARACTERISTIC DZPKSUB "Z‰hldauer des Entprellz‰hlers KS nach UB" VALUE 0xFCB154 KwWU8 255.0 dez 0.00 255.0 FORMAT "%5.1" /end CHARACTERISTIC
/begin CHARACTERISTIC DZPKSUBR "Entprelltiefe niederimpedanter Z¸ndkreis" VALUE 0xFCB155 KwWU8 255.0 dez 0.00 255.0 FORMAT "%5.1" /end CHARACTERISTIC
/begin CHARACTERISTIC DZPOTP "Schwellwert Entprellz‰hler OTP Fehler" VALUE 0xFCB156 KwWU8 255.0 dez 0.00 255.0 FORMAT "%5.1" /end CHARACTERISTIC
/begin CHARACTERISTIC DZPSP "Z‰hldauer des Entprellz‰hlers des Spannungsfehlers" VALUE 0xFCB157 KwWU8 255.0 dez 0.00 255.0 FORMAT "%5.1" /end CHARACTERISTIC
/begin CHARACTERISTIC DZPTIM "Z‰hldauer des Entprellz‰hlers des Timoutfehlers" VALUE 0xFCB158 KwWU8 255.0 dez 0.00 255.0 FORMAT "%5.1" /end CHARACTERISTIC
/begin CHARACTERISTIC DZRELFAK "Assymetriefaktor Ta-Zeit Verh‰ltnis" VALUE 0xFCB159 KwWU8 15.00 dez 0.00 15.00 FORMAT "%5.2" /end CHARACTERISTIC
/begin CHARACTERISTIC ESP_ADPWF "Adaptionswert Anschlag Einlasspreizung bei Powerfail" VALUE 0xFCFFA6 KwUw 6554. sprzi_q0p1 0.00 6554. FORMAT "%4.0" /end CHARACTERISTIC
/begin CHARACTERISTIC ESP_ADTV "Adaptionstastverh‰ltnis Einlasspreizung variable NWS" VALUE 0xFCFF9B KwUb 255.0 dez 0.00 255.0 FORMAT "%5.1" /end CHARACTERISTIC
/begin CHARACTERISTIC ESP_BA "Betriebsartenwahlschalter Einlasspreizung variable NWS" VALUE 0xFCFF9C KwUb 255.0 dez 0.00 255.0 FORMAT "%5.1" /end CHARACTERISTIC
/begin CHARACTERISTIC ESP_TVHB "ausgegebenes Tastverh‰ltnis bei Handbetrieb f¸r Einlasspreizung variable NWS" VALUE 0xFCFF9D KwUb 255.0 dez 0.00 255.0 FORMAT "%5.1" /end CHARACTERISTIC
/begin CHARACTERISTIC ESP_WNWS "Sollspreizung bei Handbetrieb f¸r Einlasspreizung variable NWS" VALUE 0xFCFFA8 KwUw 6554. sprzi_q0p1 0.00 6554. FORMAT "%4.0" /end CHARACTERISTIC
/begin CHARACTERISTIC FABSALU "Abregelfaktor Beschleunigungssignal bei Schlechtwegstrecken-Erkennung" VALUE 0xFC1F7C KwUb 553.4 accgrd_ub_b555p55 0.00 553.4 FORMAT "%5.1" /end CHARACTERISTIC
/begin CHARACTERISTIC FAINTEN "Anzahl Intervalle zur Freigabe Ti - Abschaltung" VALUE 0xFC1A95 KwWU8 255.0 dez 0.00 255.0 FORMAT "%5.1" /end CHARACTERISTIC
/begin CHARACTERISTIC FASKIV1 "Faktor f¸r Verl‰ngerung 1. KAT-Intervall, Aussetzererkennung" VALUE 0xFC1A96 KwWU8 255.0 dez 0.00 255.0 FORMAT "%5.1" /end CHARACTERISTIC
/begin CHARACTERISTIC FHODSL "minimaler Hˆhenfaktor f¸r DSLS" VALUE 0xFD04E4 KwUw 3.999939 fak_uw_b4 0.00 3.999939 FORMAT "%8.6" /end CHARACTERISTIC
/begin CHARACTERISTIC FHSTT "Faktor Heiﬂstart" CURVE 0xFC4C2C KlAUbSstUbWUb 63.75 fak_ub_b64 0.00 63.75 FORMAT "%5.2"
 /begin AXIS_DESCR STD_AXIS tans temp_ub_q0p75_o48 6 -48.00 143.3 FORMAT "%5.1" DEPOSIT ABSOLUTE /end AXIS_DESCR
/end CHARACTERISTIC
/begin CHARACTERISTIC FIBSALU "Filterfaktor Beschleunigungssignal bei Schlechtwegstrecken-Erkennung" VALUE 0xFC1F7D KwUb 0.9961 fak_ub_b1 0.00 0.9961 /end CHARACTERISTIC
/begin CHARACTERISTIC FKSTT "Faktor Kaltstart" CURVE 0xFC4C3C KlAUbSstUbWUb 63.75 fak_ub_b64 0.00 63.75 FORMAT "%5.2"
 /begin AXIS_DESCR STD_AXIS tmst temp_ub_q0p75_o48 12 -48.00 143.3 FORMAT "%5.1" DEPOSIT ABSOLUTE /end AXIS_DESCR
/end CHARACTERISTIC
/begin CHARACTERISTIC FMSLAMN "minimaler Adaptionsfaktor Sekund‰rluftmasse" VALUE 0xFD04A7 KwUb 1.992 fak_ub_b2 0.00 1.992 FORMAT "%5.3" /end CHARACTERISTIC
/begin CHARACTERISTIC FMSLAMX "maximaler Adaptionsfaktor Sekund‰rluftmasse" VALUE 0xFD04A8 KwUb 1.992 fak_ub_b2 0.00 1.992 FORMAT "%5.3" /end CHARACTERISTIC
/begin CHARACTERISTIC FNSA "Nachstartanhebung" CURVE 0xFCD8D4 GklWUb 1.992 fak_ub_b2 0.00 1.992 FORMAT "%5.3"
 /begin AXIS_DESCR COM_AXIS tans temp_ub_q0p75_o48 6 -48.00 143.3 FORMAT "%5.1" AXIS_PTS_REF STA06ESUB /end AXIS_DESCR
/end CHARACTERISTIC
/begin CHARACTERISTIC FNSHO "Wichtung Nachstartanhebung" CURVE 0xFCD8DC KlAUbSstUbWUb 1.992 fak_ub_b2 0.00 1.992 FORMAT "%5.3"
 /begin AXIS_DESCR STD_AXIS fho fak_ub_b4 4 0.00 3.984 FORMAT "%5.3" DEPOSIT ABSOLUTE /end AXIS_DESCR
/end CHARACTERISTIC
/begin CHARACTERISTIC FNSSM "Nachstartanhebung" CURVE 0xFCD8E8 GklWUb 1.992 fak_ub_b2 0.00 1.992 FORMAT "%5.3"
 /begin AXIS_DESCR COM_AXIS tmst temp_ub_q0p75_o48 12 -48.00 143.3 FORMAT "%5.1" AXIS_PTS_REF STS12ESUB /end AXIS_DESCR
/end CHARACTERISTIC
/begin CHARACTERISTIC FRHOKRST "Kraftstofftemperatur abh‰ngiger Einspritzkorrekturfaktor" CURVE 0xFC4A90 KlAxU8SstxU8WU8 0.4980 fak_ub_b1p25_o0p75 0.7500 1.248 FORMAT "%5.3"
 /begin AXIS_DESCR STD_AXIS tkrst temp_ub_q0p75_o48 9 -48.00 143.3 FORMAT "%5.1" DEPOSIT ABSOLUTE /end AXIS_DESCR
/end CHARACTERISTIC
/begin CHARACTERISTIC FRKAP "Faktor relative Kraftstoffmasse f¸r Applikation" VALUE 0xFCD7F0 KwUb 1.992 fak_ub_b2 0.00 1.992 FORMAT "%5.3" /end CHARACTERISTIC
/begin CHARACTERISTIC FSTHO "Wichtung Startfaktor" CURVE 0xFC4C58 KlAUbSstUbWUb 1.992 fak_ub_b2 0.00 1.992 FORMAT "%5.3"
 /begin AXIS_DESCR STD_AXIS fho fak_ub_b4 4 0.00 3.984 FORMAT "%5.3" DEPOSIT ABSOLUTE /end AXIS_DESCR
/end CHARACTERISTIC
/begin CHARACTERISTIC FSWALUV "Erkennungsschwelle Schlechtwegstrecke abh‰ngig von Fz.geschwindigkeit" CURVE 0xFC1F80 KlAUbSstUbWUb 55.34 acc_ub_b55p55 0.00 55.34 FORMAT "%5.2"
 /begin AXIS_DESCR STD_AXIS vfzg vfzg_ub_q1p25 4 0.00 318.8 FORMAT "%5.1" DEPOSIT ABSOLUTE /end AXIS_DESCR
/end CHARACTERISTIC
/begin CHARACTERISTIC FTETEDF "Beladungsschwelle Fettkorrektur f¸r Pr¸fung i.O." VALUE 0xFCFC9C KwSw 127.9980 fak_sw_b64 -64.00000 63.99805 FORMAT "%8.5" /end CHARACTERISTIC
/begin CHARACTERISTIC FTETEDM "Beladungsschwelle Magerkorrektur f¸r Pr¸fung i.O." VALUE 0xFCFC9E KwSw 127.9980 fak_sw_b64 -64.00000 63.99805 FORMAT "%8.5" /end CHARACTERISTIC
/begin CHARACTERISTIC FUKABAKI "Init.-Wert adaptiver ‹K-Korrekturfaktor BA f¸r kalten Motor" VALUE 0xFC4E02 KwUb 3.984 fak_ub_b4 0.00 3.984 FORMAT "%5.3" /end CHARACTERISTIC
/begin CHARACTERISTIC FUKABAKO "Obergrenze adaptiver ‹K-Korrekturfaktor BA bei kaltem Motor" VALUE 0xFCDAD2 KwUb 3.984 fak_ub_b4 0.00 3.984 FORMAT "%5.3" /end CHARACTERISTIC
/begin CHARACTERISTIC FUKABAKU "Untergrenze adaptiver ‹K-Korrekturfaktor BA bei kaltem Motor" VALUE 0xFCDAD3 KwUb 3.891 fak_ub_b4 0.09375 3.984 FORMAT "%5.3" /end CHARACTERISTIC
/begin CHARACTERISTIC FUKABAWI "Init.-Wert adaptiver ‹K-Korrekturfaktor BA f¸r warmen Motor" VALUE 0xFC4E03 KwUb 3.984 fak_ub_b4 0.00 3.984 FORMAT "%5.3" /end CHARACTERISTIC
/begin CHARACTERISTIC FUKABAWO "Obergrenze adaptiver ‹K-Korrekturfaktor BA bei warmem Motor" VALUE 0xFCDAD4 KwUb 3.984 fak_ub_b4 0.00 3.984 FORMAT "%5.3" /end CHARACTERISTIC
/begin CHARACTERISTIC FUKABAWU "Untergrenze adaptiver ‹K-Korrekturfaktor BA bei warmem Motor" VALUE 0xFCDAD5 KwUb 3.891 fak_ub_b4 0.09375 3.984 FORMAT "%5.3" /end CHARACTERISTIC
/begin CHARACTERISTIC FUKAVAKI "Init.-Wert adaptiver ‹K-Korrekturfaktor VA f¸r kalten Motor" VALUE 0xFC4E04 KwUb 3.984 fak_ub_b4 0.00 3.984 FORMAT "%5.3" /end CHARACTERISTIC
/begin CHARACTERISTIC FUKAVAKO "Obergrenze adaptiver ‹K-Korrekturfaktor VA bei kaltem Motor" VALUE 0xFCDAD6 KwUb 3.984 fak_ub_b4 0.00 3.984 FORMAT "%5.3" /end CHARACTERISTIC
/begin CHARACTERISTIC FUKAVAKU "Untergrenze adaptiver ‹K-Korrekturfaktor VA bei kaltem Motor" VALUE 0xFCDAD7 KwUb 3.891 fak_ub_b4 0.09375 3.984 FORMAT "%5.3" /end CHARACTERISTIC
/begin CHARACTERISTIC FUKAVAWI "Init.-Wert adaptiver ‹K-Korrekturfaktor VA f¸r warmen Motor" VALUE 0xFC4E05 KwUb 3.984 fak_ub_b4 0.00 3.984 FORMAT "%5.3" /end CHARACTERISTIC
/begin CHARACTERISTIC FUKAVAWO "Obergrenze adaptiver ‹K-Korrekturfaktor VA bei warmem Motor" VALUE 0xFCDAD8 KwUb 3.984 fak_ub_b4 0.00 3.984 FORMAT "%5.3" /end CHARACTERISTIC
/begin CHARACTERISTIC FUKAVAWU "Untergrenze adaptiver ‹K-Korrekturfaktor VA bei warmem Motor" VALUE 0xFCDAD9 KwUb 3.891 fak_ub_b4 0.09375 3.984 FORMAT "%5.3" /end CHARACTERISTIC
/begin CHARACTERISTIC FUKE "Faktor ‹K-Ersatzwert" VALUE 0xFC4DC0 KwUw 7.999878 fak_uw_b8 0.00 7.999878 FORMAT "%8.6" /end CHARACTERISTIC
/begin CHARACTERISTIC FUKNSTM "Startwert Faktor ‹K im Nachstart" CURVE 0xFCD984 KlAUbSstUbWUb 3.984 fak_ub_b4 0.00 3.984 FORMAT "%5.3"
 /begin AXIS_DESCR STD_AXIS tmst temp_ub_q0p75_o48 9 -48.00 143.3 FORMAT "%5.1" DEPOSIT ABSOLUTE /end AXIS_DESCR
/end CHARACTERISTIC
/begin CHARACTERISTIC FVANST "Gewichtungsfaktor VA im Nachstart" VALUE 0xFC4DBA KwUb 1.992 fak_ub_b2 0.00 1.992 FORMAT "%5.3" /end CHARACTERISTIC
/begin CHARACTERISTIC FWFN "Faktor Wandfilm Drehzahleinfluss" VALUE 0xFC4DBB KwUb 1.494 rel_ub_b1p4941 0.00 1.494 FORMAT "%5.3" /end CHARACTERISTIC
/begin CHARACTERISTIC FWSTAA1 "Wichtung Nachstart" CURVE 0xFC4AA4 GklWUb 1.992 fak_ub_b2 0.00 1.992 FORMAT "%5.3"
 /begin AXIS_DESCR COM_AXIS kstaa fak_ub_b2 6 0.00 1.992 FORMAT "%5.3" AXIS_PTS_REF SKS06ESUB /end AXIS_DESCR
/end CHARACTERISTIC
/begin CHARACTERISTIC FWSTAA2 "Wichtung Nachstart Umschaltschwelle" CURVE 0xFC4AAC GklWUb 1.992 fak_ub_b2 0.00 1.992 FORMAT "%5.3"
 /begin AXIS_DESCR COM_AXIS kstaa fak_ub_b2 6 0.00 1.992 FORMAT "%5.3" AXIS_PTS_REF SKS06ESUB /end AXIS_DESCR
/end CHARACTERISTIC
/begin CHARACTERISTIC FWSTAA3 "Wichtung Nachstart Abregelung Bereich 1" CURVE 0xFC4AB4 GklWUb 1.992 fak_ub_b2 0.00 1.992 FORMAT "%5.3"
 /begin AXIS_DESCR COM_AXIS kstaa fak_ub_b2 6 0.00 1.992 FORMAT "%5.3" AXIS_PTS_REF SKS06ESUB /end AXIS_DESCR
/end CHARACTERISTIC
/begin CHARACTERISTIC FWSTAA4 "Wichtung Nachstart Abregelung Bereich 2" CURVE 0xFC4ABC GklWUb 1.992 fak_ub_b2 0.00 1.992 FORMAT "%5.3"
 /begin AXIS_DESCR COM_AXIS kstaa fak_ub_b2 6 0.00 1.992 FORMAT "%5.3" AXIS_PTS_REF SKS06ESUB /end AXIS_DESCR
/end CHARACTERISTIC
/begin CHARACTERISTIC FZALIM "Schwelle des Fehlerz‰hlers der Aussetzererkennung f¸r DZK Freigabe" VALUE 0xFCB142 KwWU16 65535.00 dez 0.00 65535.00 FORMAT "%8.2" /end CHARACTERISTIC
/begin CHARACTERISTIC FZANSSA1 "Faktor f¸r z¸ndsynchrone Abregelung des Nachstartfaktors bei Heiﬂstart Bereich 1" CURVE 0xFCD8F4 GklWUb 0.249023438 fak_ub_b0p25 0.00 0.249023438 FORMAT "%11.9"
 /begin AXIS_DESCR COM_AXIS tans temp_ub_q0p75_o48 6 -48.00 143.3 FORMAT "%5.1" AXIS_PTS_REF STA06ESUB /end AXIS_DESCR
/end CHARACTERISTIC
/begin CHARACTERISTIC FZANSSA2 "Faktor f¸r z¸ndsynchrone Abregelung des Nachstartfaktors bei Heiﬂstart Bereich 2" CURVE 0xFCD8FC GklWUb 0.249023438 fak_ub_b0p25 0.00 0.249023438 FORMAT "%11.9"
 /begin AXIS_DESCR COM_AXIS tans temp_ub_q0p75_o48 6 -48.00 143.3 FORMAT "%5.1" AXIS_PTS_REF STA06ESUB /end AXIS_DESCR
/end CHARACTERISTIC
/begin CHARACTERISTIC FZANSSM1 "Faktor f¸r z¸ndsynchrone Abregelung des Nachstartfaktors oberhalb Schwelle" CURVE 0xFCD904 GklWUb 0.249023438 fak_ub_b0p25 0.00 0.249023438 FORMAT "%11.9"
 /begin AXIS_DESCR COM_AXIS tmst temp_ub_q0p75_o48 12 -48.00 143.3 FORMAT "%5.1" AXIS_PTS_REF STS12ESUB /end AXIS_DESCR
/end CHARACTERISTIC
/begin CHARACTERISTIC FZANSSM2 "Faktor f¸r z¸ndsynchrone Abregelung des Nachstartfaktors unterhalb Schwelle" CURVE 0xFCD910 GklWUb 0.249023438 fak_ub_b0p25 0.00 0.249023438 FORMAT "%11.9"
 /begin AXIS_DESCR COM_AXIS tmst temp_ub_q0p75_o48 12 -48.00 143.3 FORMAT "%5.1" AXIS_PTS_REF STS12ESUB /end AXIS_DESCR
/end CHARACTERISTIC
/begin CHARACTERISTIC FZLIMUB "Schwelle f¸r Aussetzerz‰hler f¸r Freigabe Niederpedanzerkennung" VALUE 0xFCB144 KwWU16 65535.00 dez 0.00 65535.00 FORMAT "%8.2" /end CHARACTERISTIC
/begin CHARACTERISTIC HTEDU "Untere Hˆhenschwelle f¸r Durchf¸hrung Tankentl¸ftungsdiagnose" VALUE 0xFCFC98 KwUb 3.984 fak_ub_b4 0.00 3.984 FORMAT "%5.3" /end CHARACTERISTIC
/begin CHARACTERISTIC IMLATDSL "min. Luftmassenfluﬂ f¸r Adaption/Zusatzdiagnose" VALUE 0xFD04E6 KwUw 23.30133 m_uw_b23p3 0.00 23.30133 FORMAT "%8.5" /end CHARACTERISTIC
/begin CHARACTERISTIC IMLATDSLK "min. Luftmassenfluﬂ f¸r Kurztest" VALUE 0xFD04E8 KwUw 23.30133 m_uw_b23p3 0.00 23.30133 FORMAT "%8.5" /end CHARACTERISTIC
/begin CHARACTERISTIC IMLDSL "minimale durchgestrˆmte Luftmasse" VALUE 0xFD04A9 KwUb 0.9961 fak_ub_b1 0.00 0.9961 /end CHARACTERISTIC
/begin CHARACTERISTIC IMLHS "Luftmassenintegral Heiﬂstart" VALUE 0xFC4C61 KwUb 23.21 m_ub_b23p3 0.00 23.21 FORMAT "%5.2" /end CHARACTERISTIC
/begin CHARACTERISTIC IMSLADAP "Schwelle Luftmassenintegral f¸r Wiederholung Adaption" VALUE 0xFD04EA KwUw 4660.267 m_uw_b4660 0.00 4660.267 FORMAT "%8.3" /end CHARACTERISTIC
/begin CHARACTERISTIC INTEDO "obere Schwelle Drehzahlintegral bei TEV-Diagnose" VALUE 0xFC9B3C KwSw 16383.75 nmot_sw_q0p25 -8192.000 8191.750 FORMAT "%8.3" /end CHARACTERISTIC
/begin CHARACTERISTIC INTEDU "untere Schwelle Drehzahlintegral bei TEV-Diagnose" VALUE 0xFC9B3E KwSw 16383.75 nmot_sw_q0p25 -8192.000 8191.750 FORMAT "%8.3" /end CHARACTERISTIC
/begin CHARACTERISTIC KAMFZ "Segment- bzw. Messfensterbeginn bei Segmentzeiterfassung Aussetzererkennung" VALUE 0xFC6366 KwWU16 393210.0 kw_q6 0.00 393210.0 FORMAT "%8.1" /end CHARACTERISTIC
/begin CHARACTERISTIC KFABAK "Aufteilungsfaktor Wandfilm bei BA" MAP 0xFCD998 GkfWUb 0.9961 fak_ub_b1 0.00 0.9961
 /begin AXIS_DESCR COM_AXIS tmot temp_ub_q0p75_o48 9 -48.00 143.3 FORMAT "%5.1" AXIS_PTS_REF STM09ESUB /end AXIS_DESCR
 /begin AXIS_DESCR COM_AXIS nmot nmot_ub_q40 7 0.00 10200. FORMAT "%5.0" AXIS_PTS_REF SNM07ESUB /end AXIS_DESCR
/end CHARACTERISTIC
/begin CHARACTERISTIC KFAVAK "Aufteilungsfaktor Wandfilm bei VA" MAP 0xFCD9D8 GkfWUb 0.9961 fak_ub_b1 0.00 0.9961
 /begin AXIS_DESCR COM_AXIS tmot temp_ub_q0p75_o48 9 -48.00 143.3 FORMAT "%5.1" AXIS_PTS_REF STM09ESUB /end AXIS_DESCR
 /begin AXIS_DESCR COM_AXIS nmot nmot_ub_q40 7 0.00 10200. FORMAT "%5.0" AXIS_PTS_REF SNM07ESUB /end AXIS_DESCR
/end CHARACTERISTIC
/begin CHARACTERISTIC KFBAKL "Faktor Beschleunigungsanreicherung (K+L-Anteil)" MAP 0xFCDA18 GkfWUb 15.94 fak_ub_b16 0.00 15.94 FORMAT "%5.2"
 /begin AXIS_DESCR COM_AXIS tmot temp_ub_q0p75_o48 9 -48.00 143.3 FORMAT "%5.1" AXIS_PTS_REF STM09ESUB /end AXIS_DESCR
 /begin AXIS_DESCR COM_AXIS nmot nmot_ub_q40 7 0.00 10200. FORMAT "%5.0" AXIS_PTS_REF SNM07ESUB /end AXIS_DESCR
/end CHARACTERISTIC
/begin CHARACTERISTIC KFFWST "Faktor Wiederholstart" MAP 0xFC4D3E KfAxUbAyUbSstxUwSstyUbWUb 0.9961 fak_ub_b1 0.00 0.9961
 /begin AXIS_DESCR STD_AXIS tmlauf_w t100msxs_uw_b6553p6 8 0.00 6553.500 FORMAT "%8.3" DEPOSIT ABSOLUTE /end AXIS_DESCR
 /begin AXIS_DESCR STD_AXIS tmotab temp_ub_q0p75_o48 8 -48.00 143.3 FORMAT "%5.1" DEPOSIT ABSOLUTE /end AXIS_DESCR
/end CHARACTERISTIC
/begin CHARACTERISTIC KFKSWF "Kennfeld f¸r Kat.-Schutz-Wichtungsfaktoren" MAP 0xFC1A44 KfAxU8AyU8SstxU8SstyU8WU8 255.0 dez 0.00 255.0 FORMAT "%5.1"
 /begin AXIS_DESCR STD_AXIS rl rel_ub_q0p75 6 0.00 191.3 FORMAT "%5.1" DEPOSIT ABSOLUTE /end AXIS_DESCR
 /begin AXIS_DESCR STD_AXIS nmot nmot_ub_q40 6 0.00 10200. FORMAT "%5.0" DEPOSIT ABSOLUTE /end AXIS_DESCR
/end CHARACTERISTIC
/begin CHARACTERISTIC KFLANS "Kennfeld Lambda-Motor-Beschreibung im Nachstart" MAP 0xFC4B08 GkfWUw 15.89990 fak_uw_b16 0.09985352 15.99976 FORMAT "%8.5"
 /begin AXIS_DESCR COM_AXIS tmst temp_ub_q0p75_o48 12 -48.00 143.3 FORMAT "%5.1" AXIS_PTS_REF STS12ESUB /end AXIS_DESCR
 /begin AXIS_DESCR COM_AXIS anztib_w dez 12 0.00 65535.00 FORMAT "%8.2" AXIS_PTS_REF SAN12ESUW /end AXIS_DESCR
/end CHARACTERISTIC
/begin CHARACTERISTIC KFLF "Lambdakennfeld bei Teillast" MAP 0xFCD7F4 KfAxUbAyUbSstxUbSstyUbWUb 1.992 fak_ub_b2 0.00 1.992 FORMAT "%5.3"
 /begin AXIS_DESCR STD_AXIS nmot nmot_ub_q40 12 0.00 10200. FORMAT "%5.0" DEPOSIT ABSOLUTE /end AXIS_DESCR
 /begin AXIS_DESCR STD_AXIS rl rel_ub_q0p75 16 0.00 191.3 FORMAT "%5.1" DEPOSIT ABSOLUTE /end AXIS_DESCR
/end CHARACTERISTIC
/begin CHARACTERISTIC KFMODI "Kennfeld f¸r Aussetzermodi und deren Parameter" MAP 0xFC1D2C KfAxU8AyU8SstxU16SstyU16WU16 65535.00 DEZ 0.00 65535.00 FORMAT "%8.2"
 /begin AXIS_DESCR STD_AXIS xkfmodi DEZ 6 0.00 65535. FORMAT "%5.0" DEPOSIT ABSOLUTE /end AXIS_DESCR
 /begin AXIS_DESCR STD_AXIS ykfmodi DEZ 8 0.00 65535. FORMAT "%5.0" DEPOSIT ABSOLUTE /end AXIS_DESCR
/end CHARACTERISTIC
/begin CHARACTERISTIC KFNSWRL "Wichtung Nachstartanhebung" MAP 0xFC4AC4 KfAxUbAyUbSstxUbSstyUbWUb 1.992 fak_ub_b2 0.00 1.992 FORMAT "%5.3"
 /begin AXIS_DESCR STD_AXIS tmst temp_ub_q0p75_o48 8 -48.00 143.3 FORMAT "%5.1" DEPOSIT ABSOLUTE /end AXIS_DESCR
 /begin AXIS_DESCR STD_AXIS rl rel_ub_q0p75 6 0.00 191.3 FORMAT "%5.1" DEPOSIT ABSOLUTE /end AXIS_DESCR
/end CHARACTERISTIC
/begin CHARACTERISTIC KFVAKL "Faktor Verzˆgerungsabmagerung (K+L-Anteil)" MAP 0xFCDA58 GkfWUb 15.94 fak_ub_b16 0.00 15.94 FORMAT "%5.2"
 /begin AXIS_DESCR COM_AXIS tmot temp_ub_q0p75_o48 9 -48.00 143.3 FORMAT "%5.1" AXIS_PTS_REF STM09ESUB /end AXIS_DESCR
 /begin AXIS_DESCR COM_AXIS nmot nmot_ub_q40 7 0.00 10200. FORMAT "%5.0" AXIS_PTS_REF SNM07ESUB /end AXIS_DESCR
/end CHARACTERISTIC
/begin CHARACTERISTIC KFWHSTT "Wichtungskennfeld Heiﬂstart" MAP 0xFC4C64 KfAxUbAyUbSstxUbSstyUbWUb 1.992 fak_ub_b2 0.00 1.992 FORMAT "%5.3"
 /begin AXIS_DESCR STD_AXIS tans temp_ub_q0p75_o48 6 -48.00 143.3 FORMAT "%5.1" DEPOSIT ABSOLUTE /end AXIS_DESCR
 /begin AXIS_DESCR STD_AXIS anztist dez 6 0.00 255.0 FORMAT "%5.1" DEPOSIT ABSOLUTE /end AXIS_DESCR
/end CHARACTERISTIC
/begin CHARACTERISTIC KFWKSTN "Wichtungskennfeld Kaltstart" MAP 0xFC4C98 KfAxUbAyUbSstxUbSstyUbWUb 0.9961 fak_ub_b1 0.00 0.9961
 /begin AXIS_DESCR STD_AXIS tmst temp_ub_q0p75_o48 4 -48.00 143.3 FORMAT "%5.1" DEPOSIT ABSOLUTE /end AXIS_DESCR
 /begin AXIS_DESCR STD_AXIS nmot nmot_ub_q40 4 0.00 10200. FORMAT "%5.0" DEPOSIT ABSOLUTE /end AXIS_DESCR
/end CHARACTERISTIC
/begin CHARACTERISTIC KFWKSTT "Wichtungskennfeld Kaltstart" MAP 0xFC4CB4 KfAxUbAyUbSstxUbSstyUbWUb 1.992 fak_ub_b2 0.00 1.992 FORMAT "%5.3"
 /begin AXIS_DESCR STD_AXIS tmst temp_ub_q0p75_o48 12 -48.00 143.3 FORMAT "%5.1" DEPOSIT ABSOLUTE /end AXIS_DESCR
 /begin AXIS_DESCR STD_AXIS anztist dez 6 0.00 255.0 FORMAT "%5.1" DEPOSIT ABSOLUTE /end AXIS_DESCR
/end CHARACTERISTIC
/begin CHARACTERISTIC KFWWNS "Wiederholstartzeitfaktor" MAP 0xFCD928 KfAxUbAyUbSstxUwSstyUbWUb 1.992 fak_ub_b2 0.00 1.992 FORMAT "%5.3"
 /begin AXIS_DESCR STD_AXIS tabst_w t1sxs_uw_q1 8 0.00 65535.00 FORMAT "%8.2" DEPOSIT ABSOLUTE /end AXIS_DESCR
 /begin AXIS_DESCR STD_AXIS tmst temp_ub_q0p75_o48 8 -48.00 143.3 FORMAT "%5.1" DEPOSIT ABSOLUTE /end AXIS_DESCR
/end CHARACTERISTIC
/begin CHARACTERISTIC KLFWST "Faktor Wiederholstart" CURVE 0xFC4D98 KlAUwSstUwWUw 0.9999847 fak_uw_b1 0.00 0.9999847 FORMAT "%9.7"
 /begin AXIS_DESCR STD_AXIS tabst_w t1sxs_uw_q1 8 0.00 65535.00 FORMAT "%8.2" DEPOSIT ABSOLUTE /end AXIS_DESCR
/end CHARACTERISTIC
/begin CHARACTERISTIC KLIREGTMOT "Initialisierung I-Regler (tmot)" CURVE 0xFC9C32 KlAUwSstUwWUw 199.997 vnstv_q0p00305s32768 -100.000 99.9969
 /begin AXIS_DESCR STD_AXIS tmot temp_ub_q0p75_o48 8 -48.00 143.3 FORMAT "%5.1" DEPOSIT ABSOLUTE /end AXIS_DESCR
/end CHARACTERISTIC
/begin CHARACTERISTIC KLRANWI "Kennlinie Regler I-Anteil Auslasspreizung variable NWS" CURVE 0xFC9C54 KlAUwSstUwWUw 199.997 vnstv_q0p00305s32768 -100.000 99.9969
 /begin AXIS_DESCR STD_AXIS Vsadwnwkl sprzi_q0p1s32768 16 -3276.80 3276.70 FORMAT "%7.2" DEPOSIT ABSOLUTE /end AXIS_DESCR
/end CHARACTERISTIC
/begin CHARACTERISTIC KLRANWP "Kennlinie Regler P-Anteil Auslasspreizung variable NWS" CURVE 0xFC9C96 KlAUwSstUwWUw 199.997 vnstv_q0p00305s32768 -100.000 99.9969
 /begin AXIS_DESCR STD_AXIS Vsadwnwkl sprzi_q0p1s32768 16 -3276.80 3276.70 FORMAT "%7.2" DEPOSIT ABSOLUTE /end AXIS_DESCR
/end CHARACTERISTIC
/begin CHARACTERISTIC KLRENWI "Kennlinie Regler I-Anteil Einlasspreizung variable NWS" CURVE 0xFC9CD8 KlAUwSstUwWUw 199.997 vnstv_q0p00305s32768 -100.000 99.9969
 /begin AXIS_DESCR STD_AXIS Vsedwnwkl sprzi_q0p1s32768 16 -3276.80 3276.70 FORMAT "%7.2" DEPOSIT ABSOLUTE /end AXIS_DESCR
/end CHARACTERISTIC
/begin CHARACTERISTIC KLRENWP "Kennlinie Regler P-Anteil Einlasspreizung variable NWS" CURVE 0xFC9D1A KlAUwSstUwWUw 199.997 vnstv_q0p00305s32768 -100.000 99.9969
 /begin AXIS_DESCR STD_AXIS Vsedwnwkl sprzi_q0p1s32768 16 -3276.80 3276.70 FORMAT "%7.2" DEPOSIT ABSOLUTE /end AXIS_DESCR
/end CHARACTERISTIC
/begin CHARACTERISTIC KLRTAMN "Schwellwert f¸r die Erkennung auf Kurzschluﬂ nach Ubatt" CURVE 0xFCB0F4 KlAxU8SstxU8WU16 1.000000 rel_uw_q0p125 0.00 1.000000 FORMAT "%8.6"
 /begin AXIS_DESCR STD_AXIS ub spg_ubatt 8 0.00 19.41 FORMAT "%5.2" DEPOSIT ABSOLUTE /end AXIS_DESCR
/end CHARACTERISTIC
/begin CHARACTERISTIC KLTALUST "Zeitdauer Ausblendung der Aussetzererkennung nach Motorstart" CURVE 0xFCC98C KlAxU8SstxU8WU16 655.3500 t10msxs_uw_b655p35 0.00 655.3500 FORMAT "%8.4"
 /begin AXIS_DESCR STD_AXIS tmst temp_ub_q0p75_o48 4 -48.00 143.3 FORMAT "%5.1" DEPOSIT ABSOLUTE /end AXIS_DESCR
/end CHARACTERISTIC
/begin CHARACTERISTIC KLTAMN "Schwellwert f¸r die Erkennung auf Kurzschluﬂ nach Ubatt" CURVE 0xFCB10E KlAxU8SstxU8WU16 65.53500 txms_uw_q0p001 0.00 65.53500 FORMAT "%8.5"
 /begin AXIS_DESCR STD_AXIS ub spg_ubatt 8 0.00 19.41 FORMAT "%5.2" DEPOSIT ABSOLUTE /end AXIS_DESCR
/end CHARACTERISTIC
/begin CHARACTERISTIC KLTAMX "Schwellwert f¸r die Erkennung auf Kurzschluﬂ nach Ubatt" CURVE 0xFCB128 KlAxU8SstxU8WU16 65.53500 txms_uw_q0p001 0.00 65.53500 FORMAT "%8.5"
 /begin AXIS_DESCR STD_AXIS ub spg_ubatt 8 0.00 19.41 FORMAT "%5.2" DEPOSIT ABSOLUTE /end AXIS_DESCR
/end CHARACTERISTIC
/begin CHARACTERISTIC KLVNSTMOT "Korrekturkennlinie P-Anteil (tmot)" CURVE 0xFC9C14 KlAUbSstUbWUb 1.992 fak_ub_b2 0.00 1.992 FORMAT "%5.3"
 /begin AXIS_DESCR STD_AXIS tmot temp_ub_q0p75_o48 6 -48.00 143.3 FORMAT "%5.1" DEPOSIT ABSOLUTE /end AXIS_DESCR
/end CHARACTERISTIC
/begin CHARACTERISTIC KLVNSTVUB "Kennlinie ub-Abh‰ngigkeit Tastverh‰ltnis variable NWS" CURVE 0xFC9C24 KlAUbSstUbWUb 1.992 fak_ub_b2 0.00 1.992 FORMAT "%5.3"
 /begin AXIS_DESCR STD_AXIS ub spg_ubatt 6 0.00 24.02 FORMAT "%5.2" DEPOSIT ABSOLUTE /end AXIS_DESCR
/end CHARACTERISTIC
/begin CHARACTERISTIC LAMDSLMX "" VALUE 0xFD04EC KwUw 15.99976 fak_uw_b16 0.00 15.99976 FORMAT "%8.5" /end CHARACTERISTIC
/begin CHARACTERISTIC MILANTI "MIL ist bei ti-Abschaltung an, auch im 1.dcy" VALUE 0xFC1A97 KwWU8 255.0 dez 0.00 255.0 FORMAT "%5.1" /end CHARACTERISTIC
/begin CHARACTERISTIC MLWDSLAMN "" VALUE 0xFD04EE KwUw 6553.500 m_uw_b6553p5 0.00 6553.500 FORMAT "%8.3" /end CHARACTERISTIC
/begin CHARACTERISTIC MLWDSLAMX "" VALUE 0xFD04F0 KwUw 6553.500 m_uw_b6553p5 0.00 6553.500 FORMAT "%8.3" /end CHARACTERISTIC
/begin CHARACTERISTIC MLWDSLKMN "" VALUE 0xFD04F2 KwUw 6553.500 m_uw_b6553p5 0.00 6553.500 FORMAT "%8.3" /end CHARACTERISTIC
/begin CHARACTERISTIC MLWDSLKMX "" VALUE 0xFD04F4 KwUw 6553.500 m_uw_b6553p5 0.00 6553.500 FORMAT "%8.3" /end CHARACTERISTIC
/begin CHARACTERISTIC MLWDSLMN "" VALUE 0xFD04F6 KwUw 6553.500 m_uw_b6553p5 0.00 6553.500 FORMAT "%8.3" /end CHARACTERISTIC
/begin CHARACTERISTIC MLWDSLMX "" VALUE 0xFD04F8 KwUw 6553.500 m_uw_b6553p5 0.00 6553.500 FORMAT "%8.3" /end CHARACTERISTIC
/begin CHARACTERISTIC MLWDSLOMN "" VALUE 0xFD04FA KwUw 6553.500 m_uw_b6553p5 0.00 6553.500 FORMAT "%8.3" /end CHARACTERISTIC
/begin CHARACTERISTIC MLWDSLOMX "" VALUE 0xFD04FC KwUw 6553.500 m_uw_b6553p5 0.00 6553.500 FORMAT "%8.3" /end CHARACTERISTIC
/begin CHARACTERISTIC MSLBAS "Ini.- Sekund‰rluftmasse" VALUE 0xFD04AA KwUb 102.0 m_q0p4 0.00 102.0 FORMAT "%5.1" /end CHARACTERISTIC
/begin CHARACTERISTIC MSLVMX "Diagnoseschwelle f¸r Ventildichtheitspr¸fung" VALUE 0xFD04FE KwUw 102.3984 m_q0p0015625 0.00 102.3984 FORMAT "%8.4" /end CHARACTERISTIC
/begin CHARACTERISTIC MSLVMXK "" VALUE 0xFD0500 KwUw 102.3984 m_q0p0015625 0.00 102.3984 FORMAT "%8.4" /end CHARACTERISTIC
/begin CHARACTERISTIC MSLVMXX "" VALUE 0xFD0502 KwUw 102.3984 m_q0p0015625 0.00 102.3984 FORMAT "%8.4" /end CHARACTERISTIC
/begin CHARACTERISTIC MSLVMXXK "" VALUE 0xFD0504 KwUw 102.3984 m_q0p0015625 0.00 102.3984 FORMAT "%8.4" /end CHARACTERISTIC
/begin CHARACTERISTIC NDSLMN "" VALUE 0xFD04AB KwUb 10200. nmot_ub_q40 0.00 10200. FORMAT "%5.0" /end CHARACTERISTIC
/begin CHARACTERISTIC NDSLMX "" VALUE 0xFD04AC KwUb 10200. nmot_ub_q40 0.00 10200. FORMAT "%5.0" /end CHARACTERISTIC
/begin CHARACTERISTIC NDV "Fehlererkennung Tachosignal / Drehzahlschwelle minimal" VALUE 0xFCCD58 KwUb 10200. nmot_ub_q40 0.00 10200. FORMAT "%5.0" /end CHARACTERISTIC
/begin CHARACTERISTIC NDVO "Fehlererkennung Fz-Geschwindigkeitssignal, obere Drehzahlgrenze" VALUE 0xFCCD59 KwUb 10200. nmot_ub_q40 0.00 10200. FORMAT "%5.0" /end CHARACTERISTIC
/begin CHARACTERISTIC NGALUN "Misfire Detection : Schwelle Drehzahl‰nderung f¸r Ausblendung" CURVE 0xFC1AAC GklWS16 25599.94 nmotg_sw_q0p39 -12800.16 12799.77 FORMAT "%8.2"
 /begin AXIS_DESCR COM_AXIS nmot nmot_ub_q40 8 0.00 10200. FORMAT "%5.0" AXIS_PTS_REF SNM08DMUB /end AXIS_DESCR
/end CHARACTERISTIC
/begin CHARACTERISTIC NGALUST "Misfire Detection : Schwelle Drehzahl‰nderung f¸r Ausblendung nach Start" VALUE 0xFC1AC6 KwWS16 25599.94 nmotg_sw_q0p39 -12800.16 12799.77 FORMAT "%8.2" /end CHARACTERISTIC
/begin CHARACTERISTIC NMIALU "Min. Drehzahl f¸r Ausblendung der Aussetzererkennung" VALUE 0xFC1ACD KwWU8 10200. nmot_ub_q40 0.00 10200. FORMAT "%5.0" /end CHARACTERISTIC
/begin CHARACTERISTIC NMN_DUF "Drehzahl-Schwelle f¸rs Setzen der Zyklusflags der Funktions¸berwachungs-Diagnose" VALUE 0xFC0E9F KwUb 10200. nmot_ub_q40 0.00 10200. FORMAT "%5.0" /end CHARACTERISTIC
/begin CHARACTERISTIC NMOTVNSAD "Drehrahl unterhalb der die Adaption verboten ist" VALUE 0xFCFF9E KwUb 10200. nmot_ub_q40 0.00 10200. FORMAT "%5.0" /end CHARACTERISTIC
/begin CHARACTERISTIC NMXALU "Max. Drehzahl f¸r Ausblendung der Aussetzererkennung" VALUE 0xFC1ACE KwWU8 10200. nmot_ub_q40 0.00 10200. FORMAT "%5.0" /end CHARACTERISTIC
/begin CHARACTERISTIC NOTAERR_DZKU_IMPL "" VALUE 0xFCB15A KwWU8 255.0 dez 0.00 255.0 FORMAT "%5.1" READ_ONLY /end CHARACTERISTIC
/begin CHARACTERISTIC NSTDMD "Max. Drehzahl f¸r Ausblendung der Aussetzererkennung nach Start" VALUE 0xFC1ACF KwWU8 10200. nmot_ub_q40 0.00 10200. FORMAT "%5.0" /end CHARACTERISTIC
/begin CHARACTERISTIC NSTEDMX "Maximale Solldrehzahl-Schwelle f¸r Tankentl¸ftungsdiagnose" VALUE 0xFC9B35 KwUb 2550. nmot_ub_q10 0.00 2550. FORMAT "%5.0" /end CHARACTERISTIC
/begin CHARACTERISTIC NUKAO "obere Drehzahlgrenze f¸r ‹K-Adaption" VALUE 0xFC4E06 KwUb 10200. nmot_ub_q40 0.00 10200. FORMAT "%5.0" /end CHARACTERISTIC
/begin CHARACTERISTIC NUKAU "untere Drehzahlgrenze f¸r ‹K-Adaption" VALUE 0xFC4E07 KwUb 10200. nmot_ub_q40 0.00 10200. FORMAT "%5.0" /end CHARACTERISTIC
/begin CHARACTERISTIC NW_MIN "Minimale Nockenwellenposition Rohwert" VAL_BLK 0xFC9C04 KwbUw 6554. sprzi_q0p1 0.00 6554. FORMAT "%4.0" NUMBER 4 /end CHARACTERISTIC
/begin CHARACTERISTIC NZDIAGH "Obere Drehzahlschwelle der Diagnosefreigabe" VALUE 0xFCB146 KwWU16 16383.75 nmot_uw_q0p25 0.00 16383.75 FORMAT "%8.2" /end CHARACTERISTIC
/begin CHARACTERISTIC NZDIAGL "Untere Drehzahlschwelle der Diagnosefreigabe" VALUE 0xFCB148 KwWU16 16383.75 nmot_uw_q0p25 0.00 16383.75 FORMAT "%8.2" /end CHARACTERISTIC
/begin CHARACTERISTIC PGPRIO "Array mit Priorisierung der Phasengeber f¸r Synchronisation" VAL_BLK 0xFC1DD8 KwbWU8 255.0 dez 0.00 255.0 FORMAT "%5.1" NUMBER 4 /end CHARACTERISTIC
/begin CHARACTERISTIC PHBM "Obergrenze f¸r die Entprellung der Bezugsmarkenfehler" VALUE 0xFC1DDC KwWU8 125.0 dez 0.00 125.0 FORMAT "%5.1" /end CHARACTERISTIC
/begin CHARACTERISTIC PHNOKA "Anfangswert f¸r Z‰hler Phasensignal nicht ok" VALUE 0xFC1DDD KwWU8 125.0 dez 0.00 125.0 FORMAT "%5.1" /end CHARACTERISTIC
/begin CHARACTERISTIC PHPOSERR "Obergrenze f¸r die Entprellung der Phasenflankenfehler" VALUE 0xFC1DDE KwWU8 125.0 dez 0.00 125.0 FORMAT "%5.1" /end CHARACTERISTIC
/begin CHARACTERISTIC RANDSEED "Startwert Zufallsgenerator" VALUE 0xFC1DAC KwWU16 65535.00 DEZ 0.00 65535.00 FORMAT "%8.2" /end CHARACTERISTIC
/begin CHARACTERISTIC RKBAUM "rk-Schwelle f¸r BA-Anzeige" CURVE 0xFCDAAE GklWSw 6143.813 rel_sw_q0p1875 0.00 6143.813 FORMAT "%8.3"
 /begin AXIS_DESCR COM_AXIS tmot temp_ub_q0p75_o48 9 -48.00 143.3 FORMAT "%5.1" AXIS_PTS_REF STM09ESUB /end AXIS_DESCR
/end CHARACTERISTIC
/begin CHARACTERISTIC RKUKKLU "Schwelle Summe Kurz-/Langzeitanteil" VALUE 0xFC4DC2 KwSw 12287.81 rel_sw_q0p1875 -6144.000 6143.813 FORMAT "%8.3" /end CHARACTERISTIC
/begin CHARACTERISTIC RKVAUM "rk-Schwelle f¸r VA-Anzeige" CURVE 0xFCDAC0 GklWSw 6144.000 rel_sw_q0p1875 -6144.000 0.00 FORMAT "%8.3"
 /begin AXIS_DESCR COM_AXIS tmot temp_ub_q0p75_o48 9 -48.00 143.3 FORMAT "%5.1" AXIS_PTS_REF STM09ESUB /end AXIS_DESCR
/end CHARACTERISTIC
/begin CHARACTERISTIC RLDSLMN "" VALUE 0xFD04AD KwUb 191.3 rel_ub_q0p75 0.00 191.3 FORMAT "%5.1" /end CHARACTERISTIC
/begin CHARACTERISTIC RLDSLMX "" VALUE 0xFD04AE KwUb 191.3 rel_ub_q0p75 0.00 191.3 FORMAT "%5.1" /end CHARACTERISTIC
/begin CHARACTERISTIC RLSALULL "Lastschwelle zur Schuberkennung f¸r Ausblendung der Aussetzererkennung im LL" VALUE 0xFC1AD0 KwWU8 191.3 rel_ub_q0p75 0.00 191.3 FORMAT "%5.1" /end CHARACTERISTIC
/begin CHARACTERISTIC RLSALUN "Lastschwelle zur Schuberkennung f¸r Ausblendung der Aussetzererkennung" CURVE 0xFC1ABC GklWU8 191.3 rel_ub_q0p75 0.00 191.3 FORMAT "%5.1"
 /begin AXIS_DESCR COM_AXIS nmot nmot_ub_q40 8 0.00 10200. FORMAT "%5.0" AXIS_PTS_REF SNM08DMUB /end AXIS_DESCR
/end CHARACTERISTIC
/begin CHARACTERISTIC RLTEDMX "Maximale rl-Schwelle f¸r Tankentl¸ftungsdiagnose" VALUE 0xFC9B36 KwUb 191.3 rel_ub_q0p75 0.00 191.3 FORMAT "%5.1" /end CHARACTERISTIC
/begin CHARACTERISTIC RLUKAU "untere Lastgrenze f¸r ‹K-Adaption" VALUE 0xFC4E08 KwUb 191.3 rel_ub_q0p75 0.00 191.3 FORMAT "%5.1" /end CHARACTERISTIC
/begin CHARACTERISTIC RMSLADA "Diagnoseschwelle f¸r Adaption" VALUE 0xFD04AF KwUb 1.992 fak_ub_b2 0.00 1.992 FORMAT "%5.3" /end CHARACTERISTIC
/begin CHARACTERISTIC RMSLMN "Diagnoseschwelle: verringerte Sekund‰rluftmasse (Fehlerhaft)" VALUE 0xFD04B0 KwUb 1.992 fak_ub_b2 0.00 1.992 FORMAT "%5.3" /end CHARACTERISTIC
/begin CHARACTERISTIC RMSLMNK "" VALUE 0xFD04B1 KwUb 1.992 fak_ub_b2 0.00 1.992 FORMAT "%5.3" /end CHARACTERISTIC
/begin CHARACTERISTIC RMSLTMN "Schwelle: sehr geringe Sekund‰rluftmasse, ohne Offset" VALUE 0xFD04B2 KwUb 1.992 fak_ub_b2 0.00 1.992 FORMAT "%5.3" /end CHARACTERISTIC
/begin CHARACTERISTIC SALUNKH "dmrkh-abh. Nullastfaktoren bei Katheizen" CURVE 0xFCC99C KlAxU8SstxU8WU8 1.992 fak_ub_b2 0.00 1.992 FORMAT "%5.3"
 /begin AXIS_DESCR STD_AXIS dmrkh rel_ub_b99p6 4 0.00 99.61 FORMAT "%5.2" DEPOSIT ABSOLUTE /end AXIS_DESCR
/end CHARACTERISTIC
/begin AXIS_PTS SAN12ESUW "SST-Verteilung f¸r den begrenzten Einspritzz‰hler anztib_w" 0xFC1122 anztib_w SstAUwSstUw 65535.00 dez 12 0.00 65535.00 FORMAT "%8.2" DEPOSIT ABSOLUTE /end AXIS_PTS
/begin CHARACTERISTIC SFONTM "Schwellwert tmot f¸r fuel-on Adaption aktiv" VALUE 0xFCC9A5 KwWU8 191.3 temp_ub_q0p75_o48 -48.00 143.3 FORMAT "%5.1" /end CHARACTERISTIC
/begin AXIS_PTS SKS06ESUB "SST-Verteilung f¸r den Startadaptionsfaktor kstaa" 0xFC0F78 kstaa SstAUbSstUb 1.992 fak_ub_b2 6 0.00 1.992 FORMAT "%5.3" DEPOSIT ABSOLUTE /end AXIS_PTS
/begin AXIS_PTS SNM07ESUB "St¸tzstellenverteilung Drehzahl, 7 Sst." 0xFCC850 nmot SstAUbSstUb 10200. nmot_ub_q40 7 0.00 10200. FORMAT "%5.0" DEPOSIT ABSOLUTE /end AXIS_PTS
/begin AXIS_PTS SNM08DMUB "SST-Verteilung in DMD, 8 Drehzahl-SST" 0xFC0FB8 nmot SstAUbSstUb 10200. nmot_ub_q40 8 0.00 10200. FORMAT "%5.0" DEPOSIT ABSOLUTE /end AXIS_PTS
/begin CHARACTERISTIC SPRZG_AN "Position der Anschlagspreizung variable NWS" VAL_BLK 0xFC9C0C KwbUw 6554. sprzi_q0p1 0.00 6554. FORMAT "%4.0" NUMBER 4 /end CHARACTERISTIC
/begin AXIS_PTS SRL08DMUB "SST-Verteilung in DMD, 8 Last-SST" 0xFC1098 rl SstAUbSstUb 191.3 rel_ub_q0p75 8 0.00 191.3 FORMAT "%5.1" DEPOSIT ABSOLUTE /end AXIS_PTS
/begin AXIS_PTS STA06ESUB "SST-Verteilung f¸r die Ansauglufttemperatur" 0xFCC8B4 tans SstAUbSstUb 191.3 temp_ub_q0p75_o48 6 -48.00 143.3 FORMAT "%5.1" DEPOSIT ABSOLUTE /end AXIS_PTS
/begin AXIS_PTS STM09ESUB "St¸tzstellenverteilung Motortemperatur, 9 Sst." 0xFCC900 tmot SstAUbSstUb 191.3 temp_ub_q0p75_o48 9 -48.00 143.3 FORMAT "%5.1" DEPOSIT ABSOLUTE /end AXIS_PTS
/begin AXIS_PTS STS12ESUB "SST-Verteilung f¸r Motorstarttemperatur" 0xFC1108 tmst SstAUbSstUb 191.3 temp_ub_q0p75_o48 12 -48.00 143.3 FORMAT "%5.1" DEPOSIT ABSOLUTE /end AXIS_PTS
/begin CHARACTERISTIC SZANSSM "Absteuerungsfaktorumschaltschwelle f¸r Nachstartfaktor" CURVE 0xFCD91C GklWUb 0.9961 fak_ub_b1 0.00 0.9961
 /begin AXIS_DESCR COM_AXIS tmst temp_ub_q0p75_o48 12 -48.00 143.3 FORMAT "%5.1" AXIS_PTS_REF STS12ESUB /end AXIS_DESCR
/end CHARACTERISTIC
/begin CHARACTERISTIC TABGMSLAD "Abgas Temperaturschwelle f¸r Auslˆsung Adaption" VALUE 0xFD04B3 KwUb 1275. temp_ub_q5_o50 -50.00 1225. FORMAT "%5.0" /end CHARACTERISTIC
/begin CHARACTERISTIC TAINI "Initialisierungswert der 2A-Zeit" VALUE 0xFCB14A KwWU16 65.53500 txms_uw_q0p001 0.00 65.53500 FORMAT "%8.5" /end CHARACTERISTIC
/begin CHARACTERISTIC TAMIALU "Minimale Ansauglufttemperatur f¸r Ausblendung der Aussetzererkennung" VALUE 0xFCC9A6 KwWU8 191.3 temp_ub_q0p75_o48 -48.00 143.3 FORMAT "%5.1" /end CHARACTERISTIC
/begin CHARACTERISTIC TANDSLMN "min. Ansauglufttemperatur f¸r SL- Diagnose" VALUE 0xFD04B4 KwUb 191.3 temp_ub_q0p75_o48 -48.00 143.3 FORMAT "%5.1" /end CHARACTERISTIC
/begin CHARACTERISTIC TANDSLMX "max. Ansauglufttemperatur f¸r SL- Diagnose" VALUE 0xFD04B5 KwUb 191.3 temp_ub_q0p75_o48 -48.00 143.3 FORMAT "%5.1" /end CHARACTERISTIC
/begin CHARACTERISTIC TANDT "Schwelle Temperaturdifferenz Ansaugluft f¸r Heiﬂstart" CURVE 0xFC4D10 KlAUbSstUbWUb 191.3 temp_ub_b191p25 0.00 191.3 FORMAT "%5.1"
 /begin AXIS_DESCR STD_AXIS tansab temp_ub_q0p75_o48 8 -48.00 143.3 FORMAT "%5.1" DEPOSIT ABSOLUTE /end AXIS_DESCR
/end CHARACTERISTIC
/begin CHARACTERISTIC TANWASTMN "minimales Tastverh‰ltnis f¸r setzen Zyklusflag Endstufendiagnose Nockenwelle" VALUE 0xFCCD7E KwWU16 655.350 vnstv_q0p01 0.00 655.350 FORMAT "%7.3" /end CHARACTERISTIC
/begin CHARACTERISTIC TANWASTMX "maximales Tastverh‰ltnis f¸r setzen Zyklusflag Endstufendiagnose Nockenwelle" VALUE 0xFCCD80 KwWU16 655.350 vnstv_q0p01 0.00 655.350 FORMAT "%7.3" /end CHARACTERISTIC
/begin CHARACTERISTIC TANWESTMN "minimales Tastverh‰ltnis f¸r setzen Zyklusflag Endstufendiagnose Nockenwelle" VALUE 0xFCCD78 KwWU16 655.350 vnstv_q0p01 0.00 655.350 FORMAT "%7.3" /end CHARACTERISTIC
/begin CHARACTERISTIC TANWESTMX "maximales Tastverh‰ltnis f¸r setzen Zyklusflag Endstufendiagnose Nockenwelle" VALUE 0xFCCD7A KwWU16 655.350 vnstv_q0p01 0.00 655.350 FORMAT "%7.3" /end CHARACTERISTIC
/begin CHARACTERISTIC TBTEVIO "Verzˆgerungszeit f¸r Beladungpr¸fung TEV i.O. Erkennung" VALUE 0xFCFC99 KwUb 25.50 t100msxs_ub_b25p5 0.00 25.50 FORMAT "%5.2" /end CHARACTERISTIC
/begin CHARACTERISTIC TC6CSL "Mode 6: Component ID f¸r Pr¸fung Sekund‰rluftsystem" VALUE 0xFD04B6 KwUb 127.0 dez 0.00 127.0 FORMAT "%5.1" /end CHARACTERISTIC
/begin CHARACTERISTIC TC6CSLK "" VALUE 0xFD04B7 KwUb 127.0 dez 0.00 127.0 FORMAT "%5.1" /end CHARACTERISTIC
/begin CHARACTERISTIC TC6CSLN "Mode 6: Component ID f¸r Pr¸fung minimale Sekund‰rluft in Phase 1" VALUE 0xFD04B8 KwUb 127.0 dez 0.00 127.0 FORMAT "%5.1" /end CHARACTERISTIC
/begin CHARACTERISTIC TC6CSLV "Mode 6: Component ID f¸r Pr¸fung Dichtheit SL-Ventil" VALUE 0xFD04B9 KwUb 127.0 dez 0.00 127.0 FORMAT "%5.1" /end CHARACTERISTIC
/begin CHARACTERISTIC TDDMSLIFT "" VALUE 0xFD04BA KwUb 25.50 t100msxs_ub_b25p5 0.00 25.50 FORMAT "%5.2" /end CHARACTERISTIC
/begin CHARACTERISTIC TDDNWSHL "Entprellzeit f¸r Heilung des Fehler NWS" VALUE 0xFC9BF6 KwWU8 25.50 t100msxs_ub_b25p5 0.00 25.50 FORMAT "%5.2" /end CHARACTERISTIC
/begin CHARACTERISTIC TDDNWSMN "Entprellzeit f¸r Setzen des min.-Fehlers der NWS" VALUE 0xFC9BF7 KwWU8 25.50 t100msxs_ub_b25p5 0.00 25.50 FORMAT "%5.2" /end CHARACTERISTIC
/begin CHARACTERISTIC TDDNWSNP "Entprellzeit f¸r Setzen des Fehlers f¸r unplausible Stellung d.NW" VALUE 0xFC9BF8 KwWU8 25.50 t100msxs_ub_b25p5 0.00 25.50 FORMAT "%5.2" /end CHARACTERISTIC
/begin CHARACTERISTIC TDFRDSLS "" VALUE 0xFD04BB KwUb 25.50 t100msxs_ub_b25p5 0.00 25.50 FORMAT "%5.2" /end CHARACTERISTIC
/begin CHARACTERISTIC TDMES4OFF "" VALUE 0xFD04BC KwUb 25.50 t100msxs_ub_b25p5 0.00 25.50 FORMAT "%5.2" /end CHARACTERISTIC
/begin CHARACTERISTIC TDMSLMN1 "Mindestmeﬂzeit Sekund‰rluftmasse, Phase 1" VALUE 0xFD04BD KwUb 25.50 t100msxs_ub_b25p5 0.00 25.50 FORMAT "%5.2" /end CHARACTERISTIC
/begin CHARACTERISTIC TDMSLMN4 "Mindestmeﬂzeit Sekund‰rluftmasse, Phase 4" VALUE 0xFD04BE KwUb 25.50 t100msxs_ub_b25p5 0.00 25.50 FORMAT "%5.2" /end CHARACTERISTIC
/begin CHARACTERISTIC TDMSLMNK "Mindestmeﬂzeit Sekund‰rluftmasse, Phase 1 bei Kurztest" VALUE 0xFD04BF KwUb 25.50 t100msxs_ub_b25p5 0.00 25.50 FORMAT "%5.2" /end CHARACTERISTIC
/begin CHARACTERISTIC TDMSLOF3 "Meﬂzeit Offset Sekund‰rluftmasse, Phase 3" VALUE 0xFD04C0 KwUb 25.50 t100msxs_ub_b25p5 0.00 25.50 FORMAT "%5.2" /end CHARACTERISTIC
/begin CHARACTERISTIC TDMSLOF5 "Meﬂzeit Offset sekund‰rluftmasse, Phase 5" VALUE 0xFD04C1 KwUb 25.50 t100msxs_ub_b25p5 0.00 25.50 FORMAT "%5.2" /end CHARACTERISTIC
/begin CHARACTERISTIC TDMSLOFK "Meﬂzeit Offset Sekund‰rluftmasse, Phase 3 bei Kurztest" VALUE 0xFD04C2 KwUb 25.50 t100msxs_ub_b25p5 0.00 25.50 FORMAT "%5.2" /end CHARACTERISTIC
/begin CHARACTERISTIC TDMSLV "Messzeit f¸r Ventildichtheitspr¸fung" VALUE 0xFD04C3 KwUb 25.50 t100msxs_ub_b25p5 0.00 25.50 FORMAT "%5.2" /end CHARACTERISTIC
/begin CHARACTERISTIC TDMSLVK "Meﬂzeit f¸r Ventildichtheitspr¸fung bei Kurztest" VALUE 0xFD04C4 KwUb 25.50 t100msxs_ub_b25p5 0.00 25.50 FORMAT "%5.2" /end CHARACTERISTIC
/begin CHARACTERISTIC TDPH2SLOF "" VALUE 0xFD04C5 KwUb 25.50 t100msxs_ub_b25p5 0.00 25.50 FORMAT "%5.2" /end CHARACTERISTIC
/begin CHARACTERISTIC TDPHSLOF "Zeit Einschaltverzˆgerung Bit B_slsoff in Phase 2, 3 und 5 nach" VALUE 0xFD04C6 KwUb 25.50 t100msxs_ub_b25p5 0.00 25.50 FORMAT "%5.2" /end CHARACTERISTIC
/begin CHARACTERISTIC TDSLMVBA "Einschaltverzˆgerung BA-/VA-Sperre bei Bildung B_dslmes" VALUE 0xFD04C7 KwUb 25.50 t100msxs_ub_b25p5 0.00 25.50 FORMAT "%5.2" /end CHARACTERISTIC
/begin CHARACTERISTIC TDSUE "Wartezeit bis Fehlereintrag Endstufe Saugrohrmschaltung" VALUE 0xFC203D KwWU8 25.50 t100msxs_ub_b25p5 0.00 25.50 FORMAT "%5.2" /end CHARACTERISTIC
/begin CHARACTERISTIC TDSUEH "Wartezeit bis Fehlerheilung Endstufe Saugrohrmschaltung" VALUE 0xFC203E KwWU8 25.50 t100msxs_ub_b25p5 0.00 25.50 FORMAT "%5.2" /end CHARACTERISTIC
/begin CHARACTERISTIC TDSUEMN "Wartezeit bis min. Tastverhaeltnis  Saugrohrumschaltung gueltig" VALUE 0xFC203F KwWU8 25.50 t100msxs_ub_b25p5 0.00 25.50 FORMAT "%5.2" /end CHARACTERISTIC
/begin CHARACTERISTIC TDSUEMX "Wartezeit bis max. Tastverhaeltnis  Saugrohrumschaltung gueltig" VALUE 0xFC2040 KwWU8 25.50 t100msxs_ub_b25p5 0.00 25.50 FORMAT "%5.2" /end CHARACTERISTIC
/begin CHARACTERISTIC TDV "Fehlererkennung Tachosignal / Zeitdauer f¸r Abfrage" VALUE 0xFCCD5A KwUb 12.75 t50msxs_ub_b12p75 0.00 12.75 FORMAT "%5.2" /end CHARACTERISTIC
/begin CHARACTERISTIC TEBLEIN "Temperaturschwelle f¸r E-Box L¸fter Ansteuerung" VALUE 0xFD050B KwUb 191.3 temp_ub_q0p75_o48 -48.00 143.3 FORMAT "%5.1" /end CHARACTERISTIC
/begin CHARACTERISTIC TFIMSLI "Zeitkonstante f¸r msli- und msln-Filter" VALUE 0xFD04C8 KwUb 12.6996 zk100msxs_ub_b25p5 0.100392 12.8000 FORMAT "%7.4" /end CHARACTERISTIC
/begin CHARACTERISTIC TFIMSLIK "Zeitkonstante f¸r msli- und msln-Filter bei Kurztest" VALUE 0xFD04C9 KwUb 12.6996 zk100msxs_ub_b25p5 0.100392 12.8000 FORMAT "%7.4" /end CHARACTERISTIC
/begin CHARACTERISTIC TFIMSLO "Zeitkonstante f¸r mslo- Filter" VALUE 0xFD04CA KwUb 12.6996 zk100msxs_ub_b25p5 0.100392 12.8000 FORMAT "%7.4" /end CHARACTERISTIC
/begin CHARACTERISTIC TFIMSLOK "Zeitkonstante f¸r mslo- Filter bei Kurztest" VALUE 0xFD04CB KwUb 12.6996 zk100msxs_ub_b25p5 0.100392 12.8000 FORMAT "%7.4" /end CHARACTERISTIC
/begin CHARACTERISTIC TFIMSLV "Zeitkonstante f¸r mslv- Filter" VALUE 0xFD04CC KwUb 12.6996 zk100msxs_ub_b25p5 0.100392 12.8000 FORMAT "%7.4" /end CHARACTERISTIC
/begin CHARACTERISTIC TFIMSLVK "Zeitkonstante f¸r mslv- Filter bei Kurztest" VALUE 0xFD04CD KwUb 12.6996 zk100msxs_ub_b25p5 0.100392 12.8000 FORMAT "%7.4" /end CHARACTERISTIC
/begin CHARACTERISTIC THP "" VALUE 0xFCCD6D KwUb 24.50 t_q0p1 1.000 25.50 FORMAT "%5.2" /end CHARACTERISTIC
/begin CHARACTERISTIC TKATDSL "maximale Katalysatortemperatur f¸r Freigabe SLS-Diagnose" VALUE 0xFD04CE KwUb 1275. temp_ub_q5_o50 -50.00 1225. FORMAT "%5.0" /end CHARACTERISTIC
/begin CHARACTERISTIC TLAED "Wartezeit bis Fehlerlampe aus nach Start" VALUE 0xFC118C KwUb 51.00 t200msxs_ub_b51 0.00 51.00 FORMAT "%5.2" /end CHARACTERISTIC
/begin CHARACTERISTIC TLAEDI "Wartezeit bis Fehlerlampe aus nach INI" VALUE 0xFC118D KwUb 51.00 t200msxs_ub_b51 0.00 51.00 FORMAT "%5.2" /end CHARACTERISTIC
/begin CHARACTERISTIC TMASKIV1 "Temperaturschwelle f¸r Verl‰gerung 1. KAT-Intervall, Aussetzererkennung" VALUE 0xFC1A98 KwWU8 191.3 temp_ub_q0p75_o48 -48.00 143.3 FORMAT "%5.1" /end CHARACTERISTIC
/begin CHARACTERISTIC TMDSLAMN "min. Motortemperatur f¸r Zusatzdiagnose" VALUE 0xFD04CF KwUb 191.3 temp_ub_q0p75_o48 -48.00 143.3 FORMAT "%5.1" /end CHARACTERISTIC
/begin CHARACTERISTIC TMDSLMN "min. Motortemperatur f¸r DSLS" VALUE 0xFD04D0 KwUb 191.3 temp_ub_q0p75_o48 -48.00 143.3 FORMAT "%5.1" /end CHARACTERISTIC
/begin CHARACTERISTIC TMDSLMX "max. Motortemperatur f¸r DSLS" VALUE 0xFD04D1 KwUb 191.3 temp_ub_q0p75_o48 -48.00 143.3 FORMAT "%5.1" /end CHARACTERISTIC
/begin CHARACTERISTIC TMDV "Motortemperaturschwelle f¸r Freigabe Fz-Geschwindigkeits-Diagnose" VALUE 0xFCCD5B KwUb 191.3 temp_ub_q0p75_o48 -48.00 143.3 FORMAT "%5.1" /end CHARACTERISTIC
/begin CHARACTERISTIC TMH "Motortemperatur - Schwelle heiﬂ" VALUE 0xFC4D21 KwUb 191.3 temp_ub_q0p75_o48 -48.00 143.3 FORMAT "%5.1" /end CHARACTERISTIC
/begin CHARACTERISTIC TMHSG "Motortemperatur Heiﬂstartgrenze" VALUE 0xFC4D22 KwUb 191.3 temp_ub_q0p75_o48 -48.00 143.3 FORMAT "%5.1" /end CHARACTERISTIC
/begin CHARACTERISTIC TMTED "Tmot-Schwelle f¸r Tankentl¸ftungsdiagnose" VALUE 0xFCFC9A KwUb 191.3 temp_ub_q0p75_o48 -48.00 143.3 FORMAT "%5.1" /end CHARACTERISTIC
/begin CHARACTERISTIC TMUKAK "Temperaturbereich kalter Motor f¸r ‹K-Adaption" VALUE 0xFC4E09 KwUb 191.3 temp_ub_q0p75_o48 -48.00 143.3 FORMAT "%5.1" /end CHARACTERISTIC
/begin CHARACTERISTIC TMUKAU "untere Motortemperatur-Grenze f¸r ‹K-Adaption" VALUE 0xFC4E0A KwUb 191.3 temp_ub_q0p75_o48 -48.00 143.3 FORMAT "%5.1" /end CHARACTERISTIC
/begin CHARACTERISTIC TMUKAW "Temperaturbereich warmer Motor f¸r ‹K-Adaption" VALUE 0xFC4E0B KwUb 191.3 temp_ub_q0p75_o48 -48.00 143.3 FORMAT "%5.1" /end CHARACTERISTIC
/begin CHARACTERISTIC TMWUC "Motortemperaturschwelle f¸r Erf¸llung 'warm up cycle'" VALUE 0xFC118F KwUb 191.3 temp_ub_q0p75_o48 -48.00 143.3 FORMAT "%5.1" /end CHARACTERISTIC
/begin CHARACTERISTIC TMWUCST "max. Motortemperatur im Start f¸r Erf¸llung 'warm up cycle'" VALUE 0xFC1190 KwUb 191.3 temp_ub_q0p75_o48 -48.00 143.3 FORMAT "%5.1" /end CHARACTERISTIC
/begin CHARACTERISTIC TNODTEV "Zeit nach Motorstart f¸r Verbot DTEV" VALUE 0xFCFCA0 KwUw 6553.500 t100msxs_uw_b6553p5 0.00 6553.500 FORMAT "%8.3" /end CHARACTERISTIC
/begin CHARACTERISTIC TNODTEVT "Zeit f¸r Verbot DTEV bei Testerbetrieb" VALUE 0xFCFCA2 KwUw 6553.500 t100msxs_uw_b6553p5 0.00 6553.500 FORMAT "%8.3" /end CHARACTERISTIC
/begin CHARACTERISTIC TNOMF2 "zul‰ssige Zeit auﬂerhalb Meﬂfenster, Phase 2" VALUE 0xFD04D2 KwUb 25.50 t100msxs_ub_b25p5 0.00 25.50 FORMAT "%5.2" /end CHARACTERISTIC
/begin CHARACTERISTIC TNOMF3 "zul‰ssige Zeit auﬂerhalb Meﬂfenster, Phase 3" VALUE 0xFD04D3 KwUb 25.50 t100msxs_ub_b25p5 0.00 25.50 FORMAT "%5.2" /end CHARACTERISTIC
/begin CHARACTERISTIC TNOMF5 "zul‰ssige Zeit auﬂerhalb Meﬂfenster, Phase 5" VALUE 0xFD04D4 KwUb 25.50 t100msxs_ub_b25p5 0.00 25.50 FORMAT "%5.2" /end CHARACTERISTIC
/begin CHARACTERISTIC TNSTDSL "" VALUE 0xFD0506 KwUw 6553.500 t100msxs_uw_b6553p5 0.00 6553.500 FORMAT "%8.3" /end CHARACTERISTIC
/begin CHARACTERISTIC TNSUUK "Zeit UK-Unterdr¸ckung im Nachstart" VALUE 0xFC4DBC KwUb 25.50 t100msxs_ub_b25p5 0.00 25.50 FORMAT "%5.2" /end CHARACTERISTIC
/begin CHARACTERISTIC TNSUUKA "Verbotszeit ‹K-Adaption im Nachstart" VALUE 0xFC4E16 KwUw 655.3500 t10msxs_uw_b655p35 0.00 655.3500 FORMAT "%8.4" /end CHARACTERISTIC
/begin CHARACTERISTIC TOGMAXUNPL "Maximale Anzahl unplausiebler Meﬂwerte" VALUE 0xFC5647 KwWU8 251.0 dez 4.000 255.0 FORMAT "%5.1" /end CHARACTERISTIC
/begin CHARACTERISTIC TOG_CNTMAX "Max. Zeit ohne Tog Flanken" VALUE 0xFC5644 KwWU16 655.3500 t10msxs_ub_b2p55 0.00 655.3500 FORMAT "%8.4" /end CHARACTERISTIC
/begin CHARACTERISTIC TSBINVALID "Anzahl der Synchros mit Initialisierungswert von tsroh_f" VALUE 0xFC6368 KwWU8 255.0 dez 0.00 255.0 FORMAT "%5.1" /end CHARACTERISTIC
/begin CHARACTERISTIC TSBSEGINI "Initialisierungswert der Segmentzeit bezogen auf 360 Grad KW" VALUE 0xFC636C KwWR32 2.000000000000E+037 fak_r32_1 -1.000000000000E+037 1.000000000000E+037 FORMAT "%43.4" /end CHARACTERISTIC
/begin CHARACTERISTIC TTEBL "Zeitdauer der Ansteuerung des E-Box L¸fters nach Start" VALUE 0xFD050C KwUb 25.40 t100msxs_ub_b25p5 0.1000 25.50 FORMAT "%5.2" /end CHARACTERISTIC
/begin CHARACTERISTIC TTEDA "Zeitdauer der Aufsteuerung des TEV bei TEV-Diagnose" VALUE 0xFC9B40 KwUw 1310.70 t20msxs_uw_b1310 0.00 1310.70 FORMAT "%7.2" /end CHARACTERISTIC
/begin CHARACTERISTIC TTEDBA "Zeitschwelle f¸r Beginn der TEV-Aufsteuerung bei Tankentl¸ftungsdiagnose" VALUE 0xFC9B42 KwUw 1310.70 t20msxs_uw_b1310 0.00 1310.70 FORMAT "%7.2" /end CHARACTERISTIC
/begin CHARACTERISTIC TTEDIV "Verzˆgerungszeit f¸r Integratorstart Drehzahl-Auswertung" VALUE 0xFC9B44 KwUw 1310.70 t20msxs_uw_b1310 0.00 1310.70 FORMAT "%7.2" /end CHARACTERISTIC
/begin CHARACTERISTIC TTEDN "Zeitdauer der Drehzahl-Auswertung bei TEV-Diagnose" VALUE 0xFC9B46 KwUw 1310.70 t20msxs_uw_b1310 0.00 1310.70 FORMAT "%7.2" /end CHARACTERISTIC
/begin CHARACTERISTIC TVP "Verzˆgerungszeit Fehlerverifizierung Endstufendiagnose ME(D) 9" VALUE 0xFCCD6E KwUb 25.00 t_q0p1 0.5000 25.50 FORMAT "%5.2" /end CHARACTERISTIC
/begin CHARACTERISTIC TVRDISAMN "minimales Tastverh‰ltnis DISA geregelt" VALUE 0xFCCD70 KwSw 199.997 vnstv_q0p00305 -100.000 99.9969 FORMAT "%7.3" /end CHARACTERISTIC
/begin CHARACTERISTIC TVRDISAMX "maximales Tastverh‰ltnis DISA geregelt" VALUE 0xFCCD72 KwSw 199.997 vnstv_q0p00305 -100.000 99.9969 FORMAT "%7.3" /end CHARACTERISTIC
/begin CHARACTERISTIC TVSDISAMN "minimales Tastverh‰ltnis DISA geschaltet" VALUE 0xFC203A KwWU16 655.3500 di_uw_q0p01 0.00 655.3500 FORMAT "%8.4" /end CHARACTERISTIC
/begin CHARACTERISTIC TVSDISAMX "maximales Tastverh‰ltnis DISA geschaltet" VALUE 0xFCCD74 KwUw 655.3500 di_uw_q0p01 0.00 655.3500 FORMAT "%8.4" /end CHARACTERISTIC
/begin CHARACTERISTIC TWHLSLP "Wartezeit f¸r Hochlauf Sekund‰rluftpumpe" VALUE 0xFD04D5 KwUb 25.50 t100msxs_ub_b25p5 0.00 25.50 FORMAT "%5.2" /end CHARACTERISTIC
/begin CHARACTERISTIC TWKODTE "Wartezeit nach Kompressor schalten f¸r DTEVN" VALUE 0xFCFC9B KwUb 25.50 t100msxs_ub_b25p5 0.00 25.50 FORMAT "%5.2" /end CHARACTERISTIC
/begin CHARACTERISTIC TWMLFE "Mindestzeit f¸r ml im Diagnosebereich" VALUE 0xFD04D6 KwUb 25.50 t100msxs_ub_b25p5 0.00 25.50 FORMAT "%5.2" /end CHARACTERISTIC
/begin CHARACTERISTIC TWMSLMIN "Entprellzeit f¸r Fehlermeldung B_mslmin" VALUE 0xFD04D7 KwUb 25.50 t100msxs_ub_b25p5 0.00 25.50 FORMAT "%5.2" /end CHARACTERISTIC
/begin CHARACTERISTIC TWSLPSLA "" VALUE 0xFD0508 KwUw 1535.977 temp_q0p0234_o273 -273.1500 1262.827 FORMAT "%8.3" /end CHARACTERISTIC
/begin CHARACTERISTIC TWSTT "Schwelle Abstellzeit f¸r Wiederholstart" CURVE 0xFC4D24 KlAUbSstUbWUb 255.0 t1sxs_ub_b255 0.00 255.0 FORMAT "%5.1"
 /begin AXIS_DESCR STD_AXIS tmotab temp_ub_q0p75_o48 12 -48.00 143.3 FORMAT "%5.1" DEPOSIT ABSOLUTE /end AXIS_DESCR
/end CHARACTERISTIC
/begin CHARACTERISTIC UBDZMN "Mindestschwelle f¸r die Berechnung der DZKU" VALUE 0xFCB15B KwWU8 19.41 spg_ubatt 0.00 19.41 FORMAT "%5.2" /end CHARACTERISTIC
/begin CHARACTERISTIC UBDZMX "Maximalschwelle f¸r die Berechnung der DZKU" VALUE 0xFCB15C KwWU8 19.41 spg_ubatt 0.00 19.41 FORMAT "%5.2" /end CHARACTERISTIC
/begin CHARACTERISTIC VDMN "Geschwindigkeitsschwelle; Fehlererkennung Geschwindigkeitssignal" VALUE 0xFCCD5C KwUw 511.9922 vfzg_uw_b512 0.00 511.9922 FORMAT "%8.4" /end CHARACTERISTIC
/begin CHARACTERISTIC VNSKRITLOC "Fangbereich des Verriegelungspins" VALUE 0xFCFF9F KwUb 25.5 sprzi_q0p1 0.00 25.5 FORMAT "%4.1" /end CHARACTERISTIC
/begin CHARACTERISTIC VNSNMIN "Minimaldrehzahl zur Abstellerkennung" VALUE 0xFC9C03 KwWU8 10200. nmot_ub_q40 0.00 10200. FORMAT "%5.0" /end CHARACTERISTIC
/begin CHARACTERISTIC VNSNMOTAN "Drehzahl unterhalb der die Einheiten Verriegeln koennen (Fliehkraefte zu klein)" VALUE 0xFCFFA0 KwUb 10200. nmot_ub_q40 0.00 10200. FORMAT "%5.0" /end CHARACTERISTIC
/begin CHARACTERISTIC VNSRTVIMN "Reglerbegrenzung Tastverh‰ltnis I-Anteil min" VALUE 0xFCFFAA KwUw 199.997 vnstv_q0p00305s32768 -100.000 99.9969 /end CHARACTERISTIC
/begin CHARACTERISTIC VNSRTVIMX "Reglerbegrenzung Tastverh‰ltnis I-Anteil max" VALUE 0xFCFFAC KwUw 199.997 vnstv_q0p00305s32768 -100.000 99.9969 /end CHARACTERISTIC
/begin CHARACTERISTIC VNSRTVMN "Reglerbegrenzung Tastverh‰ltnis min" VALUE 0xFCFFAE KwSw 199.997 vnstv_q0p00305 -100.000 99.9969 FORMAT "%7.3" /end CHARACTERISTIC
/begin CHARACTERISTIC VNSRTVMX "Reglerbegrenzung Tastverh‰ltnis max" VALUE 0xFCFFB0 KwSw 199.997 vnstv_q0p00305 -100.000 99.9969 FORMAT "%7.3" /end CHARACTERISTIC
/begin CHARACTERISTIC VNSTVIABDY "Ablschlag vom I-Regleranteil fuer adapt. Druckvorsteuerung" VALUE 0xFCFFB2 KwUw 99.9969 vnstv_q0p00305s32768 0.00 99.9969 FORMAT "%7.4" /end CHARACTERISTIC
/begin CHARACTERISTIC VNS_ADEND " Zeit in der die Adaption abgeschlossen sein sollte (> VNS_ADT)" VALUE 0xFCFFB4 KwUw 655.3500 t100msxs_sb_q0p01 0.00 655.3500 FORMAT "%8.4" /end CHARACTERISTIC
/begin CHARACTERISTIC VNS_ADT "Adaptionszeit variable NWS" VALUE 0xFCFFB6 KwUw 655.3500 t100msxs_sb_q0p01 0.00 655.3500 FORMAT "%8.4" /end CHARACTERISTIC
/begin CHARACTERISTIC VNS_ANAB "Abstand vom Anschlag" VALUE 0xFCFFA1 KwUb 25.5 sprzi_q0p1 0.00 25.5 FORMAT "%4.1" /end CHARACTERISTIC
/begin CHARACTERISTIC VNS_DYN "Aenderungsbegrenzung des TV (Druckanstiegsgeschwindigkeitsbegrenzung)" VALUE 0xFCFFB8 KwUw 655.350 vnstv_q0p01 0.00 655.350 FORMAT "%7.3" /end CHARACTERISTIC
/begin CHARACTERISTIC WFRL "Kraftstoffwandfilmkennlinie" CURVE 0xFC4DC4 FklWUw 6143.906 rel_uw_b6144 0.00 6143.906 FORMAT "%8.3"
 /begin AXIS_DESCR FIX_AXIS rlp_w rel_uw_q0p0234 26 0.00 150.0000 FORMAT "%8.4" FIX_AXIS_PAR 0 8 26 /end AXIS_DESCR
/end CHARACTERISTIC
/begin CHARACTERISTIC ZAGRUN "Start des Aussetzergenerators" VALUE 0xFC1DAF KwWU8 255.0 DEZ 0.00 255.0 FORMAT "%5.1" /end CHARACTERISTIC
/begin CHARACTERISTIC ZBALM "Abregelfaktor L-Speicher (tmot) BA" CURVE 0xFCDA98 GklWUb 0.1245 fak_ub_b0p125 0.00 0.1245 FORMAT "%6.4"
 /begin AXIS_DESCR COM_AXIS tmot temp_ub_q0p75_o48 9 -48.00 143.3 FORMAT "%5.1" AXIS_PTS_REF STM09ESUB /end AXIS_DESCR
/end CHARACTERISTIC
/begin CHARACTERISTIC ZDGZA1 "Z¸ndungszahl Abregelung Bereich 1" VALUE 0xFC4B04 KwUb 255.0 dez 0.00 255.0 FORMAT "%5.1" /end CHARACTERISTIC
/begin CHARACTERISTIC ZDGZA2 "Z¸ndungszahl Abregelung Bereich 2" VALUE 0xFC4B05 KwUb 255.0 dez 0.00 255.0 FORMAT "%5.1" /end CHARACTERISTIC
/begin CHARACTERISTIC ZDSLAMX "" VALUE 0xFD04D8 KwUb 255.0 dez 0.00 255.0 FORMAT "%5.1" /end CHARACTERISTIC
/begin CHARACTERISTIC ZFUKA "ƒnderungsrate adaptiver ‹K-Korrekturfaktor" VALUE 0xFC4E0C KwUb 1.992 fak_ub_b2 0.00 1.992 FORMAT "%5.3" /end CHARACTERISTIC
/begin CHARACTERISTIC ZMVDTE "Zeitkonstante ‹berwachung Verlustmoment" VALUE 0xFC9B48 KwUw 3276.7499992 zk50msxs_uw_b3276p8 0.050000762951 3276.8000000 FORMAT "%12.7" /end CHARACTERISTIC
/begin CHARACTERISTIC ZNTED "Zeitkonstante Drehzahlfilterung bei TEV-Diagnose" VALUE 0xFC9B4A KwUw 655.34999985 zk10msxs_uw_b655 0.010000152590 655.36000000 FORMAT "%12.8" /end CHARACTERISTIC
/begin CHARACTERISTIC ZUKE "Zeitkonstante ‹K-Ersatzwert" VALUE 0xFC4DF8 KwUw 655.34999985 zk10msxs_uw_b655 0.010000152590 655.36000000 FORMAT "%12.8" /end CHARACTERISTIC
/begin CHARACTERISTIC ZUKK "Abregelfaktor Kurzzeitanteil" VALUE 0xFC4DBD KwUb 0.9961 fak_ub_b1 0.00 0.9961 /end CHARACTERISTIC
/begin CHARACTERISTIC ZUKNST "Abregelzeitkonstante ‹K-Faktor im Nachstart" VALUE 0xFC4DFA KwUw 6553.50000 zk100msxs_uw_b6553 0.100001526 6553.60000 FORMAT "%10.5" /end CHARACTERISTIC
/begin CHARACTERISTIC ZVALM "Abregelfaktor L-Speicher (tmot) VA" CURVE 0xFCDAA4 GklWUb 0.1245 fak_ub_b0p125 0.00 0.1245 FORMAT "%6.4"
 /begin AXIS_DESCR COM_AXIS tmot temp_ub_q0p75_o48 9 -48.00 143.3 FORMAT "%5.1" AXIS_PTS_REF STM09ESUB /end AXIS_DESCR
/end CHARACTERISTIC
/begin CHARACTERISTIC ZYLKOR "Wert zur Zylinderkorrektur (tsroh zu zzyldmd)" VALUE 0xFC6369 KwWU8 255.0 dez 0.00 255.0 FORMAT "%5.1" /end CHARACTERISTIC
/begin MEASUREMENT abak "Aufteilungsfaktor Wandfilm bei BA" UBYTE fak_ub_b1 1 100 0 0.996094 ECU_ADDRESS 0x5B873C /end MEASUREMENT
/begin MEASUREMENT abaov "Anzahl Beschleunigungsvorg‰nge ohne Adaptionswertverstellung" UBYTE dez 1 100 0 255 FORMAT "%5.1" ECU_ADDRESS 0x5B8EAD /end MEASUREMENT
/begin MEASUREMENT abgsmw_w "" UWORD dez 1 100 0 12000 FORMAT "%8.2" ECU_ADDRESS 0x5B853A /end MEASUREMENT
/begin MEASUREMENT abmbuf "" UBYTE dez 1 100 0 255 FORMAT "%5.1" ECU_ADDRESS 0x5B8D08 /end MEASUREMENT
/begin MEASUREMENT abmznd "Einspritzausblendmuster bei Z¸ndkreisfehler" UBYTE dez 1 100 0 255 FORMAT "%5.1" ECU_ADDRESS 0x5B8D09 /end MEASUREMENT
/begin MEASUREMENT afnmn "Bereichsfenster Aussetzer, minimale Drehzahl" UBYTE nmot_ub_q40 1 100 0 10200 FORMAT "%5.0" ECU_ADDRESS 0x3FD830 /end MEASUREMENT
/begin MEASUREMENT afnmx "Bereichsfenster Aussetzer, maximale Drehzahl" UBYTE nmot_ub_q40 1 100 0 10200 FORMAT "%5.0" ECU_ADDRESS 0x3FD831 /end MEASUREMENT
/begin MEASUREMENT afrlmn "Bereichsfenster Aussetzer, minimale Last" UBYTE rel_ub_q0p75 1 100 0 191.25 FORMAT "%5.1" ECU_ADDRESS 0x3FD832 /end MEASUREMENT
/begin MEASUREMENT afrlmx "Bereichsfenster Aussetzer, maximale Last" UBYTE rel_ub_q0p75 1 100 0 191.25 FORMAT "%5.1" ECU_ADDRESS 0x3FD833 /end MEASUREMENT
/begin MEASUREMENT aftnmn "Bereichsfenster Aussetzer, minimale Drehzahl, tempor‰r" UBYTE nmot_ub_q40 1 100 0 10200 FORMAT "%5.0" ECU_ADDRESS 0x5B8BBC /end MEASUREMENT
/begin MEASUREMENT aftnmx "Bereichsfenster Aussetzer, maximale Drehzahl, tempor‰r" UBYTE nmot_ub_q40 1 100 0 10200 FORMAT "%5.0" ECU_ADDRESS 0x5B8BBD /end MEASUREMENT
/begin MEASUREMENT aftrlmn "Bereichsfenster Aussetzer, minimale Last, tempor‰r" UBYTE rel_ub_q0p75 1 100 0 191.25 FORMAT "%5.1" ECU_ADDRESS 0x5B8BBE /end MEASUREMENT
/begin MEASUREMENT aftrlmx "Bereichsfenster Aussetzer, maximale Last, tempor‰r" UBYTE rel_ub_q0p75 1 100 0 191.25 FORMAT "%5.1" ECU_ADDRESS 0x5B8BBF /end MEASUREMENT
/begin MEASUREMENT ahearv_w "Aussetzerh‰ufigkeit zum Erreichen der Ausblendung anderer Funktionen (aus AHEARV" UWORD dez 1 100 0 65535 FORMAT "%8.2" ECU_ADDRESS 0x5B853C /end MEASUREMENT
/begin MEASUREMENT ainkba "Anzahl Inkrement-W¸nsche BA" SBYTE dez 1 100 -128 127 FORMAT "%5.1" ECU_ADDRESS 0x5B8EAE /end MEASUREMENT
/begin MEASUREMENT ainkva "Anzahl Inkrement-W¸nsche VA" SBYTE dez 1 100 -128 127 FORMAT "%5.1" ECU_ADDRESS 0x5B8EAF /end MEASUREMENT
/begin MEASUREMENT aint_zyl "" UBYTE dez 1 100 0 255 FORMAT "%5.1" ARRAY_SIZE 12 ECU_ADDRESS 0x5B8BC0 /end MEASUREMENT
/begin MEASUREMENT anzinten "" UBYTE dez 1 100 0 255 FORMAT "%5.1" ECU_ADDRESS 0x5B8BCC /end MEASUREMENT
/begin MEASUREMENT anztib_w "ti-Einspritzz‰hler mit Begrenzung" UWORD dez 1 100 0 65535 FORMAT "%8.2" ECU_ADDRESS 0x5B9198 /end MEASUREMENT
/begin MEASUREMENT anztis "Anzahl vom CIFI initialisierter ti's (Synchro-Abtastung)" UBYTE dez 1 100 0 255 FORMAT "%5.1" ECU_ADDRESS 0x5B8EAC /end MEASUREMENT
/begin MEASUREMENT anztist "ti-Einspritzz‰hler im Start" UBYTE dez 1 100 0 255 FORMAT "%5.1" ECU_ADDRESS 0x5B8EA3 /end MEASUREMENT
/begin MEASUREMENT aspuka "Z‰hler f¸r Sondenspr¸nge bei ‹K-Adaptionsverbot" UBYTE dez 1 100 0 255 FORMAT "%5.1" ECU_ADDRESS 0x5B8EB0 /end MEASUREMENT
/begin MEASUREMENT avak "Aufteilungsfaktor Wandfilm bei VA" UBYTE fak_ub_b1 1 100 0 0.996094 ECU_ADDRESS 0x5B873D /end MEASUREMENT
/begin MEASUREMENT avaov "Anzahl Verzˆgerungsvorg‰nge ohne Adaptionswertverstellung" UBYTE dez 1 100 0 255 FORMAT "%5.1" ECU_ADDRESS 0x5B8EB1 /end MEASUREMENT
/begin MEASUREMENT azycntb "" UBYTE dez 1 100 0 255 FORMAT "%5.1" ARRAY_SIZE 4 ECU_ADDRESS 0x5B8BD0 /end MEASUREMENT
/begin MEASUREMENT bbsp1 "Byte f¸r Bedingung B_sp1 als Triggerevent in DCLA" UBYTE dez 1 100 0 255 FORMAT "%5.1" ECU_ADDRESS 0x5B8E2B /end MEASUREMENT
/begin MEASUREMENT bbsp2 "Byte f¸r Bedingung B_sp2 als Triggerevent in DCLA" UBYTE dez 1 100 0 255 FORMAT "%5.1" ECU_ADDRESS 0x5B8E2C /end MEASUREMENT
/begin MEASUREMENT bbwuc "Byte f¸r Bedingung B_wuc als Triggerevent in DCLA" UBYTE dez 1 100 0 255 FORMAT "%5.1" ECU_ADDRESS 0x5B8E2A /end MEASUREMENT
/begin MEASUREMENT bfnmn "Bereichsfenster Motorbetrieb, minimale Drehzahl" UBYTE nmot_ub_q40 1 100 0 10200 FORMAT "%5.0" ECU_ADDRESS 0x5B8544 /end MEASUREMENT
/begin MEASUREMENT bfnmx "Bereichsfenster Motorbetrieb, maximale Drehzahl" UBYTE nmot_ub_q40 1 100 0 10200 FORMAT "%5.0" ECU_ADDRESS 0x5B8545 /end MEASUREMENT
/begin MEASUREMENT bfrlmn "Bereichsfenster Motorbetrieb, minimale Last" UBYTE rel_ub_q0p75 1 100 0 191.25 FORMAT "%5.1" ECU_ADDRESS 0x5B8546 /end MEASUREMENT
/begin MEASUREMENT bfrlmx "Bereichsfenster Motorbetrieb, maximale Last" UBYTE rel_ub_q0p75 1 100 0 191.25 FORMAT "%5.1" ECU_ADDRESS 0x5B8547 /end MEASUREMENT
/begin MEASUREMENT bssp "Speicherwert Signal Beschleunigungssensor" UWORD acc_uw_b55p55 1 100 0 55.5547 FORMAT "%8.5" ECU_ADDRESS 0x5B90DC /end MEASUREMENT
/begin MEASUREMENT B_afklt "Bereichsfenster Aussetzer, Bedingung kalt, TMOT<TMWUC" UBYTE B_TRUE 1 100 0 1 BIT_MASK 0x1 FORMAT "%13.11" ECU_ADDRESS 0x3FD810 /end MEASUREMENT
/begin MEASUREMENT B_aftklt "Bereichsfenster Aussetzer, tempor‰r, Bedingung kalt, TMOT<TMWUC" UBYTE B_TRUE 1 100 0 1 BIT_MASK 0x1 FORMAT "%13.11" ECU_ADDRESS 0x5B8AEA /end MEASUREMENT
/begin MEASUREMENT B_aftwrm "Bereichsfenster Aussetzer, tempor‰r, Bedingung warm, TMOT>TMWUC" UBYTE B_TRUE 1 100 0 1 BIT_MASK 0x1 FORMAT "%13.11" ECU_ADDRESS 0x5B8AEB /end MEASUREMENT
/begin MEASUREMENT B_afwrm "Bereichsfenster Aussetzer, Bedingung warm, TMOT>TMWUC" UBYTE B_TRUE 1 100 0 1 BIT_MASK 0x1 FORMAT "%13.11" ECU_ADDRESS 0x3FD811 /end MEASUREMENT
/begin MEASUREMENT B_ainten "" UBYTE B_TRUE 1 100 0 1 BIT_MASK 0x1 FORMAT "%13.11" ECU_ADDRESS 0x5B8AEC /end MEASUREMENT
/begin MEASUREMENT B_amnuka "Bedingung: Minimale Anzahl Sondenspr¸nge zwischen Adaptionsvorg‰nge abgelaufen" UBYTE B_TRUE 1 100 0 1 BIT_MASK 0x1 FORMAT "%13.11" ECU_ADDRESS 0x3FBD70 /end MEASUREMENT
/begin MEASUREMENT B_asla "Anforderung Sekund‰rluftadaption Bank 1" UBYTE B_TRUE 1 100 0 1 BIT_MASK 0x20 FORMAT "%13.11" ECU_ADDRESS 0x5B9035 /end MEASUREMENT
/begin MEASUREMENT B_asla2 "Anforderung Sekund‰rluftadaption Bank 2" UBYTE B_TRUE 1 100 0 1 BIT_MASK 0x40 FORMAT "%13.11" ECU_ADDRESS 0x5B9035 /end MEASUREMENT
/begin MEASUREMENT B_ba "Bedingung Beschleunigungsanreicherung (Anzeige)" UBYTE B_TRUE 1 100 0 1 BIT_MASK 0x1 FORMAT "%13.11" ECU_ADDRESS 0x3FBD62 /end MEASUREMENT
/begin MEASUREMENT B_bag "Bedingung starke Beschleunigungsanreicherung" UBYTE B_TRUE 1 100 0 1 BIT_MASK 0x1 FORMAT "%13.11" ECU_ADDRESS 0x3FBD63 /end MEASUREMENT
/begin MEASUREMENT B_bfklt "Bereichsfenster Motorbetrieb, Bedingung kalt, TMOT<TMWUC" UBYTE B_TRUE 1 100 0 1 BIT_MASK 0x1 FORMAT "%13.11" ECU_ADDRESS 0x5B8AED /end MEASUREMENT
/begin MEASUREMENT B_bfwrm "Bereichsfenster Motorbetrieb, Bedingung warm, TMOT>TMWUC" UBYTE B_TRUE 1 100 0 1 BIT_MASK 0x1 FORMAT "%13.11" ECU_ADDRESS 0x5B8AEE /end MEASUREMENT
/begin MEASUREMENT B_blkeb "MIL-Ansteuerung blinkend eigenbestimmt" UBYTE B_TRUE 1 100 0 1 BIT_MASK 0x4 FORMAT "%13.11" ECU_ADDRESS 0x5B8E28 /end MEASUREMENT
/begin MEASUREMENT B_blkmd "MIL-Ansteuerung blinkend durch Aussetzererkennung" UBYTE B_TRUE 1 100 0 1 BIT_MASK 0x1 FORMAT "%13.11" ECU_ADDRESS 0x5B8AEF /end MEASUREMENT
/begin MEASUREMENT B_cfukaba "Bedingung UK-Adaptionsfaktor BA berechnen" UBYTE B_TRUE 1 100 0 1 BIT_MASK 0x1 FORMAT "%13.11" ECU_ADDRESS 0x3FBD71 /end MEASUREMENT
/begin MEASUREMENT B_cfukava "Bedingung UK-Adaptionsfaktor VA berechnen" UBYTE B_TRUE 1 100 0 1 BIT_MASK 0x1 FORMAT "%13.11" ECU_ADDRESS 0x3FBD72 /end MEASUREMENT
/begin MEASUREMENT B_com1 "Allgemeine Stopbits f¸r LU und FON" UBYTE B_TRUE 1 100 0 1 BIT_MASK 0x1 FORMAT "%13.11" ECU_ADDRESS 0x5B8AFF /end MEASUREMENT
/begin MEASUREMENT B_com2 "Allgemeine Stopbits f¸r LU, FON und FOF" UBYTE B_TRUE 1 100 0 1 BIT_MASK 0x1 FORMAT "%13.11" ECU_ADDRESS 0x5B8B00 /end MEASUREMENT
/begin MEASUREMENT B_cwdslt "Bedingung: Freigabe Ventildichtheitspr¸fung" UBYTE B_TRUE 1 100 0 1 BIT_MASK 0x1 FORMAT "%13.11" ECU_ADDRESS 0x5B9032 /end MEASUREMENT
/begin MEASUREMENT B_cwsla "Bedingung: Freigabe der Adaptionsphase/Zusatzdiagnose" UBYTE B_TRUE 1 100 0 1 BIT_MASK 0x20 FORMAT "%13.11" ECU_ADDRESS 0x5B9037 /end MEASUREMENT
/begin MEASUREMENT B_danws "Aktive Diagnose: Nockenwellensteuerung (Auslaﬂseite, Bank1)" UBYTE B_TRUE 1 100 0 1 BIT_MASK 0x1 FORMAT "%13.11" ECU_ADDRESS 0x5B8A42 /end MEASUREMENT
/begin MEASUREMENT B_danws2 "Aktive Diagnose: Nockenwellensteuerung (Auslaﬂseite, Bank2)" UBYTE B_TRUE 1 100 0 1 BIT_MASK 0x2 FORMAT "%13.11" ECU_ADDRESS 0x5B8A42 /end MEASUREMENT
/begin MEASUREMENT B_decay2 "Rover" UBYTE B_TRUE 1 100 0 1 BIT_MASK 0x1 FORMAT "%13.11" ECU_ADDRESS 0x3FBD5C /end MEASUREMENT
/begin MEASUREMENT B_denws "Aktive Diagnose: Nockenwellensteuerung (Einlaﬂseite, Bank1)" UBYTE B_TRUE 1 100 0 1 BIT_MASK 0x1 FORMAT "%13.11" ECU_ADDRESS 0x5B8A43 /end MEASUREMENT
/begin MEASUREMENT B_denws2 "Aktive Diagnose: Nockenwellensteuerung (Einlaﬂseite, Bank2)" UBYTE B_TRUE 1 100 0 1 BIT_MASK 0x2 FORMAT "%13.11" ECU_ADDRESS 0x5B8A43 /end MEASUREMENT
/begin MEASUREMENT B_dfrmoff "frm-Offset-Schwelle ¸berschritten: zeigt Vorsteuerproblem" UBYTE B_TRUE 1 100 0 1 BIT_MASK 0x8 FORMAT "%13.11" ECU_ADDRESS 0x5B9037 /end MEASUREMENT
/begin MEASUREMENT B_dfrmoff2 "frm-Offset-Schwelle ¸berschritten: zeigt Vorsteuerproblem Bank 2" UBYTE B_TRUE 1 100 0 1 BIT_MASK 0x10 FORMAT "%13.11" ECU_ADDRESS 0x5B9037 /end MEASUREMENT
/begin MEASUREMENT B_dfukaba "Bedingung: Adaptionsfaktor BA dekrementieren" UBYTE B_TRUE 1 100 0 1 BIT_MASK 0x1 FORMAT "%13.11" ECU_ADDRESS 0x3FBD73 /end MEASUREMENT
/begin MEASUREMENT B_dfukava "Bedingung: Adaptionsfaktor VA dekrementieren" UBYTE B_TRUE 1 100 0 1 BIT_MASK 0x1 FORMAT "%13.11" ECU_ADDRESS 0x3FBD74 /end MEASUREMENT
/begin MEASUREMENT B_disae "Bedingung Fehler Endstufe Saugrohrumschaltung" UBYTE B_TRUE 1 100 0 1 BIT_MASK 0x1 FORMAT "%13.11" ECU_ADDRESS 0x5B86A0 /end MEASUREMENT
/begin MEASUREMENT B_disaok "Bedingung DISA-Signal ok" UBYTE B_TRUE 1 100 0 1 BIT_MASK 0x2 FORMAT "%13.11" ECU_ADDRESS 0x5B86A0 /end MEASUREMENT
/begin MEASUREMENT B_dsl "Bedingung Diagnoseanforderung" UBYTE B_TRUE 1 100 0 1 BIT_MASK 0x40 FORMAT "%13.11" ECU_ADDRESS 0x5B9033 /end MEASUREMENT
/begin MEASUREMENT B_dsl1 "Diagnose Phase 1: Bestimmung Sekund‰rluftmasse" UBYTE B_TRUE 1 100 0 1 BIT_MASK 0x1 FORMAT "%13.11" ECU_ADDRESS 0x3FBFFA /end MEASUREMENT
/begin MEASUREMENT B_dsl1ab "Diagnose Phase 1: Abbruch Phase 1" UBYTE B_TRUE 1 100 0 1 BIT_MASK 0x20 FORMAT "%13.11" ECU_ADDRESS 0x5B9034 /end MEASUREMENT
/begin MEASUREMENT B_dsl1e "Diagnose Phase 1, Meﬂfreigabe Sekund‰rluftmasse" UBYTE B_TRUE 1 100 0 1 BIT_MASK 0x40 FORMAT "%13.11" ECU_ADDRESS 0x5B9034 /end MEASUREMENT
/begin MEASUREMENT B_dsl2 "Diagnose Phase 2: Ventildichtheit" UBYTE B_TRUE 1 100 0 1 BIT_MASK 0x80 FORMAT "%13.11" ECU_ADDRESS 0x5B9034 /end MEASUREMENT
/begin MEASUREMENT B_dsl2ab "Diagnose Phase 2: Abbruch Phase 2" UBYTE B_TRUE 1 100 0 1 BIT_MASK 0x1 FORMAT "%13.11" ECU_ADDRESS 0x5B9035 /end MEASUREMENT
/begin MEASUREMENT B_dsl2e "Diagnose Phase 2: Freigabe Messung" UBYTE B_TRUE 1 100 0 1 BIT_MASK 0x2 FORMAT "%13.11" ECU_ADDRESS 0x5B9035 /end MEASUREMENT
/begin MEASUREMENT B_dsl3 "Diagnose Phase3: Offset Sekund‰rluftmasse" UBYTE B_TRUE 1 100 0 1 BIT_MASK 0x4 FORMAT "%13.11" ECU_ADDRESS 0x5B9035 /end MEASUREMENT
/begin MEASUREMENT B_dsl3ab "Diagnose Phase 3: Abbruch" UBYTE B_TRUE 1 100 0 1 BIT_MASK 0x8 FORMAT "%13.11" ECU_ADDRESS 0x5B9035 /end MEASUREMENT
/begin MEASUREMENT B_dsl3e "Diagnose Phase 3: Freigabe Messung" UBYTE B_TRUE 1 100 0 1 BIT_MASK 0x10 FORMAT "%13.11" ECU_ADDRESS 0x5B9035 /end MEASUREMENT
/begin MEASUREMENT B_dsl4 "Bedingung Phase 4: Sekund‰rluftmasse aus Adaption/Zusatzdiagnose" UBYTE B_TRUE 1 100 0 1 BIT_MASK 0x1 FORMAT "%13.11" ECU_ADDRESS 0x3FBFFB /end MEASUREMENT
/begin MEASUREMENT B_dsl45 "" UBYTE B_TRUE 1 100 0 1 BIT_MASK 0x8 FORMAT "%13.11" ECU_ADDRESS 0x5B9036 /end MEASUREMENT
/begin MEASUREMENT B_dsl4ab "Bedingung: Abbruch Phase 4" UBYTE B_TRUE 1 100 0 1 BIT_MASK 0x2 FORMAT "%13.11" ECU_ADDRESS 0x5B9036 /end MEASUREMENT
/begin MEASUREMENT B_dsl4e "Bedingung: Phase 4 Freigabe Messung" UBYTE B_TRUE 1 100 0 1 BIT_MASK 0x4 FORMAT "%13.11" ECU_ADDRESS 0x5B9036 /end MEASUREMENT
/begin MEASUREMENT B_dsl5 "Diagnose Phase 5: Offset Sekund‰rluftmasse" UBYTE B_TRUE 1 100 0 1 BIT_MASK 0x10 FORMAT "%13.11" ECU_ADDRESS 0x5B9036 /end MEASUREMENT
/begin MEASUREMENT B_dsl5ab "Diagnose Phase 5: Abbruch" UBYTE B_TRUE 1 100 0 1 BIT_MASK 0x20 FORMAT "%13.11" ECU_ADDRESS 0x5B9036 /end MEASUREMENT
/begin MEASUREMENT B_dsl5dly "" UBYTE B_TRUE 1 100 0 1 BIT_MASK 0x2 FORMAT "%13.11" ECU_ADDRESS 0x5B9038 /end MEASUREMENT
/begin MEASUREMENT B_dsl5e "Diagnose Phase 5: Freigabe Messung" UBYTE B_TRUE 1 100 0 1 BIT_MASK 0x40 FORMAT "%13.11" ECU_ADDRESS 0x5B9036 /end MEASUREMENT
/begin MEASUREMENT B_dsla "Adaptionsphase: Bestimmung Sekund‰rluftmasse" UBYTE B_TRUE 1 100 0 1 BIT_MASK 0x1 FORMAT "%13.11" ECU_ADDRESS 0x3FBFFC /end MEASUREMENT
/begin MEASUREMENT B_dslerr "Zusammenfassung Abbruchmerkmale Sekund‰rluftdiagnose" UBYTE B_TRUE 1 100 0 1 BIT_MASK 0x8 FORMAT "%13.11" ECU_ADDRESS 0x5B9032 /end MEASUREMENT
/begin MEASUREMENT B_dslfa "Bedingung: Anforderung SL-System f¸r Kurztest" UBYTE B_TRUE 1 100 0 1 BIT_MASK 0x1 FORMAT "%13.11" ECU_ADDRESS 0x3FBFFD /end MEASUREMENT
/begin MEASUREMENT B_dslm "Diagnose Sekund‰rluftmasse" UBYTE B_TRUE 1 100 0 1 BIT_MASK 0x10 FORMAT "%13.11" ECU_ADDRESS 0x5B9032 /end MEASUREMENT
/begin MEASUREMENT B_dslmab "Diagnose Sekund‰rluftmasse, Meﬂabbruch" UBYTE B_TRUE 1 100 0 1 BIT_MASK 0x20 FORMAT "%13.11" ECU_ADDRESS 0x5B9032 /end MEASUREMENT
/begin MEASUREMENT B_dslme "Diagnose Sekund‰rluftmasse, Meﬂfreigabe" UBYTE B_TRUE 1 100 0 1 BIT_MASK 0x40 FORMAT "%13.11" ECU_ADDRESS 0x5B9032 /end MEASUREMENT
/begin MEASUREMENT B_dslmes "Bedingung: Freigabe Meﬂfenster" UBYTE B_TRUE 1 100 0 1 BIT_MASK 0x80 FORMAT "%13.11" ECU_ADDRESS 0x5B9032 /end MEASUREMENT
/begin MEASUREMENT B_dslo "Diagnose Sekund‰rluftmassenoffset" UBYTE B_TRUE 1 100 0 1 BIT_MASK 0x1 FORMAT "%13.11" ECU_ADDRESS 0x5B9033 /end MEASUREMENT
/begin MEASUREMENT B_dsloab "Diagnose Sekund‰rluftoffset, Meﬂabbruch" UBYTE B_TRUE 1 100 0 1 BIT_MASK 0x2 FORMAT "%13.11" ECU_ADDRESS 0x5B9033 /end MEASUREMENT
/begin MEASUREMENT B_dsloe "Diagnose Sekund‰rluftoffset, Meﬂfreigabe" UBYTE B_TRUE 1 100 0 1 BIT_MASK 0x4 FORMAT "%13.11" ECU_ADDRESS 0x5B9033 /end MEASUREMENT
/begin MEASUREMENT B_dslp4 "" UBYTE B_TRUE 1 100 0 1 BIT_MASK 0x80 FORMAT "%13.11" ECU_ADDRESS 0x5B9038 /end MEASUREMENT
/begin MEASUREMENT B_dsls "Aktive Diagnose: Sekund‰rluft-System" UBYTE B_TRUE 1 100 0 1 BIT_MASK 0x1 FORMAT "%13.11" ECU_ADDRESS 0x3FBFFE /end MEASUREMENT
/begin MEASUREMENT B_dslsp4 "Bedingung: Anforderung SL-System f¸r Sekund‰rluftadaption/Zusatzdiagnose" UBYTE B_TRUE 1 100 0 1 BIT_MASK 0x1 FORMAT "%13.11" ECU_ADDRESS 0x3FBFFF /end MEASUREMENT
/begin MEASUREMENT B_dslt "Diagnose Dichtheit Sekund‰rluftventi" UBYTE B_TRUE 1 100 0 1 BIT_MASK 0x8 FORMAT "%13.11" ECU_ADDRESS 0x5B9033 /end MEASUREMENT
/begin MEASUREMENT B_dsltab "Diagnose Ventilichtheit, Meﬂabbruch" UBYTE B_TRUE 1 100 0 1 BIT_MASK 0x1 FORMAT "%13.11" ECU_ADDRESS 0x5B9034 /end MEASUREMENT
/begin MEASUREMENT B_dslte "Diagnose Ventildichtheit, Meﬂfreigabe" UBYTE B_TRUE 1 100 0 1 BIT_MASK 0x2 FORMAT "%13.11" ECU_ADDRESS 0x5B9034 /end MEASUREMENT
/begin MEASUREMENT B_dspe "Bedingung Diagnose Sekund‰rluft ein" UBYTE B_TRUE 1 100 0 1 BIT_MASK 0x1 FORMAT "%13.11" ECU_ADDRESS 0x3FC000 /end MEASUREMENT
/begin MEASUREMENT B_dsper "Bedingung R¸cksetzen ESP ein" UBYTE B_TRUE 1 100 0 1 BIT_MASK 0x4 FORMAT "%13.11" ECU_ADDRESS 0x5B9034 /end MEASUREMENT
/begin MEASUREMENT B_dspes "Bedingung Setzen ESP ein" UBYTE B_TRUE 1 100 0 1 BIT_MASK 0x8 FORMAT "%13.11" ECU_ADDRESS 0x5B9034 /end MEASUREMENT
/begin MEASUREMENT B_dteaa "Bedingung Aufsteuerpr¸fung f¸r TEV Diagnose aktiv" UBYTE B_TRUE 1 100 0 1 BIT_MASK 0x1 FORMAT "%13.11" ECU_ADDRESS 0x3FBFC0 /end MEASUREMENT
/begin MEASUREMENT B_dteabr "Abbruch der TE-Diagnose durch Stˆreinfl¸sse (Beschreibungsvariable)" UBYTE B_TRUE 1 100 0 1 BIT_MASK 0x1 FORMAT "%13.11" ECU_ADDRESS 0x5B8A20 /end MEASUREMENT
/begin MEASUREMENT B_dtean "Abbruch TE-Diagnose wegen ƒnderung der Solldrehzahl" UBYTE B_TRUE 1 100 0 1 BIT_MASK 0x2 FORMAT "%13.11" ECU_ADDRESS 0x5B8A20 /end MEASUREMENT
/begin MEASUREMENT B_dteaq "Abbruch TE-Diagnose wegen ƒnderung der Vorsteuerluft" UBYTE B_TRUE 1 100 0 1 BIT_MASK 0x4 FORMAT "%13.11" ECU_ADDRESS 0x5B8A20 /end MEASUREMENT
/begin MEASUREMENT B_dtebel "Eingangsbedingungen der Beladungspr¸fung erf¸llt" UBYTE B_TRUE 1 100 0 1 BIT_MASK 0x8 FORMAT "%13.11" ECU_ADDRESS 0x5B8A20 /end MEASUREMENT
/begin MEASUREMENT B_dtebn "Beginn der Drehzahlpr¸fung" UBYTE B_TRUE 1 100 0 1 BIT_MASK 0x1 FORMAT "%13.11" ECU_ADDRESS 0x3FBFC1 /end MEASUREMENT
/begin MEASUREMENT B_dtei "Steuerbit f¸r Integrator bei Tankentl¸ftungsdiagnose" UBYTE B_TRUE 1 100 0 1 BIT_MASK 0x1 FORMAT "%13.11" ECU_ADDRESS 0x3FBFC2 /end MEASUREMENT
/begin MEASUREMENT B_dtes "Aktive Diagnose: Tankentl¸ftungssystem" UBYTE B_TRUE 1 100 0 1 BIT_MASK 0x1 FORMAT "%13.11" ECU_ADDRESS 0x3FBFC3 /end MEASUREMENT
/begin MEASUREMENT B_dtesq "Abbruch der TE-Diagnose wegen Stˆrungen der Solluft" UBYTE B_TRUE 1 100 0 1 BIT_MASK 0x10 FORMAT "%13.11" ECU_ADDRESS 0x5B8A20 /end MEASUREMENT
/begin MEASUREMENT B_dtest "Start f¸r TEV-Ansteuerung" UBYTE B_TRUE 1 100 0 1 BIT_MASK 0x1 FORMAT "%13.11" ECU_ADDRESS 0x3FBFC4 /end MEASUREMENT
/begin MEASUREMENT B_dtevio "Bedingung TEV i.O. (Beschreibungsvariable)" UBYTE B_TRUE 1 100 0 1 BIT_MASK 0x20 FORMAT "%13.11" ECU_ADDRESS 0x5B8A20 /end MEASUREMENT
/begin MEASUREMENT B_dzack "Bedingung Daten von HW Schale empfangen" UBYTE B_TRUE 1 100 0 1 BIT_MASK 0x1 FORMAT "%13.11" ECU_ADDRESS 0x5B8B7C /end MEASUREMENT
/begin MEASUREMENT B_dzappl "Bedingung unplausible Schlieﬂzeitapplikation" UBYTE default 1 100 0 1 FORMAT "%5.3" ARRAY_SIZE 8 ECU_ADDRESS 0x5B8D0C /end MEASUREMENT
/begin MEASUREMENT B_dzdmden "Bedingung Freigabe Z¸ndungsdiagnose durch Aussetzererkennung" UBYTE B_TRUE 1 100 0 1 BIT_MASK 0x1 FORMAT "%13.11" ECU_ADDRESS 0x5B8B7D /end MEASUREMENT
/begin MEASUREMENT B_dzdmdub "Bedingung Freigabe Erkennung niederimpedanter Prim‰rkreis" UBYTE default 1 100 0 1 FORMAT "%5.3" ARRAY_SIZE 8 ECU_ADDRESS 0x5B8D14 /end MEASUREMENT
/begin MEASUREMENT B_dzenable "Bedingung f¸r aktive Z¸ndkreisdiagnose" UBYTE B_TRUE 1 100 0 1 BIT_MASK 0x1 FORMAT "%13.11" ECU_ADDRESS 0x5B8B7E /end MEASUREMENT
/begin MEASUREMENT B_dzhksub "Bedingung harter Z¸ndkreiskurzschluﬂ nach ub" UBYTE default 1 100 0 1 FORMAT "%5.3" ARRAY_SIZE 8 ECU_ADDRESS 0x5B8D1C /end MEASUREMENT
/begin MEASUREMENT B_dzkdmd "Bedingung : Aussetzer werden signalisiert" UBYTE default 1 100 0 1 FORMAT "%5.3" ARRAY_SIZE 8 ECU_ADDRESS 0x5B8D24 /end MEASUREMENT
/begin MEASUREMENT B_dzkprl "Bedingung : Auswerteentprellung f¸r Aussetzersignal" UBYTE B_TRUE 1 100 0 1 BIT_MASK 0x1 FORMAT "%13.11" ECU_ADDRESS 0x5B8B7F /end MEASUREMENT
/begin MEASUREMENT B_dzksms "Bedingung Kurzschluﬂ nach Masse am Z¸ndkreis" UBYTE default 1 100 0 1 FORMAT "%5.3" ARRAY_SIZE 8 ECU_ADDRESS 0x5B8D2C /end MEASUREMENT
/begin MEASUREMENT B_dzksub "Bedingung Kurzschluﬂ nach Ub am Z¸ndkreis" UBYTE default 1 100 0 1 FORMAT "%5.3" ARRAY_SIZE 8 ECU_ADDRESS 0x5B8D34 /end MEASUREMENT
/begin MEASUREMENT B_dzkub "Bedingung Kurzschluﬂ nach Ub am Z¸ndkreis" UBYTE B_TRUE 1 100 0 1 BIT_MASK 0x1 FORMAT "%13.11" ECU_ADDRESS 0x5B8B80 /end MEASUREMENT
/begin MEASUREMENT B_dzmnen "‹berpr¸fung Kurzschluss Ub Verh‰tniss aktiv" UBYTE B_TRUE 1 100 0 1 BIT_MASK 0x1 FORMAT "%13.11" ECU_ADDRESS 0x5B8B81 /end MEASUREMENT
/begin MEASUREMENT B_dzmnrel "Bedingung Kurzschluﬂ nach Ub am Z¸ndkreis ¸ber Verh‰ltnisbildung erkannt" UBYTE B_TRUE 1 100 0 1 BIT_MASK 0x1 FORMAT "%13.11" ECU_ADDRESS 0x5B8B82 /end MEASUREMENT
/begin MEASUREMENT B_dzmxen "Bedingung Fehlerverdacht Kurzschluﬂ nach Ubatt" UBYTE B_TRUE 1 100 0 1 BIT_MASK 0x1 FORMAT "%13.11" ECU_ADDRESS 0x5B8B83 /end MEASUREMENT
/begin MEASUREMENT B_dzmxrel "Bedingung Kurzschluﬂ nach Masse am Z¸ndkreis ¸ber Verh‰ltnisbildung erkannt" UBYTE B_TRUE 1 100 0 1 BIT_MASK 0x1 FORMAT "%13.11" ECU_ADDRESS 0x5B8B84 /end MEASUREMENT
/begin MEASUREMENT B_dzotp "Bedingung ‹bertemperaturfehler erkannt" UBYTE default 1 100 0 1 FORMAT "%5.3" ARRAY_SIZE 8 ECU_ADDRESS 0x5B8D3C /end MEASUREMENT
/begin MEASUREMENT B_dzzyk "Bedingung Z¸ndkreisdiagnosezyklen gleich Schwellwert" UBYTE B_TRUE 1 100 0 1 BIT_MASK 0x1 FORMAT "%13.11" ECU_ADDRESS 0x5B8B85 /end MEASUREMENT
/begin MEASUREMENT B_ebl "Bedingung Ansteuerung E-Box L¸fter" UBYTE B_TRUE 1 100 0 1 BIT_MASK 0x1 FORMAT "%13.11" ECU_ADDRESS 0x3FC004 /end MEASUREMENT
/begin MEASUREMENT B_edges "" UBYTE B_TRUE 1 100 0 1 BIT_MASK 0x1 FORMAT "%13.11" ECU_ADDRESS 0x5B8B01 /end MEASUREMENT
/begin MEASUREMENT B_eepdif "Plausibilit‰tspr¸fung EEPROM und FLASH-Daten" UBYTE B_TRUE 1 100 0 1 BIT_MASK 0x1 FORMAT "%13.11" ECU_ADDRESS 0x3FBC84 /end MEASUREMENT
/begin MEASUREMENT B_enph2bm "Freigabe der Phasenpegel¸berwachung an BM f¸r PG2 (nur Master)" UBYTE B_TRUE 1 100 0 1 BIT_MASK 0x1 FORMAT "%13.11" ECU_ADDRESS 0x5B8C0E /end MEASUREMENT
/begin MEASUREMENT B_enph3bm "Freigabe der Phasenpegel¸berwachung an BM f¸r PG3 (nur Master)" UBYTE B_TRUE 1 100 0 1 BIT_MASK 0x1 FORMAT "%13.11" ECU_ADDRESS 0x5B8C0F /end MEASUREMENT
/begin MEASUREMENT B_enph4bm "Freigabe der Phasenpegel¸berwachung an BM f¸r PG4 (nur Master)" UBYTE B_TRUE 1 100 0 1 BIT_MASK 0x1 FORMAT "%13.11" ECU_ADDRESS 0x5B8C10 /end MEASUREMENT
/begin MEASUREMENT B_enphbm "Freigabe der Phasenpegel¸berwachung an BM f¸r PG1 (nur Master)" UBYTE B_TRUE 1 100 0 1 BIT_MASK 0x1 FORMAT "%13.11" ECU_ADDRESS 0x5B8C0D /end MEASUREMENT
/begin MEASUREMENT B_enws "Bedingung Fehler Nockenwellenansteuerung liegt vor" UBYTE B_TRUE 1 100 0 1 BIT_MASK 0x1 FORMAT "%13.11" ECU_ADDRESS 0x5B8B79 /end MEASUREMENT
/begin MEASUREMENT B_enwsa "Bedingung Error Nockenwelle (Auslaﬂsietig)" UBYTE B_TRUE 1 100 0 1 BIT_MASK 0x1 FORMAT "%13.11" ECU_ADDRESS 0x5B8B7A /end MEASUREMENT
/begin MEASUREMENT B_enwse "Bedingung Error Nockenwelle (Einlaﬂseitig)" UBYTE B_TRUE 1 100 0 1 BIT_MASK 0x1 FORMAT "%13.11" ECU_ADDRESS 0x5B8B7B /end MEASUREMENT
/begin MEASUREMENT B_errofs "Bedingung: zul‰ssige Sekund‰rluftmassen-Offset ¸berschritten" UBYTE B_TRUE 1 100 0 1 BIT_MASK 0x10 FORMAT "%13.11" ECU_ADDRESS 0x5B9034 /end MEASUREMENT
/begin MEASUREMENT B_errofs2 "Bedingung: max. zul‰ssiger Offsetwert ¸berschritten, Bank 2" UBYTE B_TRUE 1 100 0 1 BIT_MASK 0x10 FORMAT "%13.11" ECU_ADDRESS 0x5B9033 /end MEASUREMENT
/begin MEASUREMENT B_error1 "" UBYTE B_TRUE 1 100 0 1 BIT_MASK 0x1 FORMAT "%13.11" ECU_ADDRESS 0x5B855C /end MEASUREMENT
/begin MEASUREMENT B_error26 "" UBYTE B_TRUE 1 100 0 1 BIT_MASK 0x1 FORMAT "%13.11" ECU_ADDRESS 0x5B855D /end MEASUREMENT
/begin MEASUREMENT B_error3 "" UBYTE B_TRUE 1 100 0 1 BIT_MASK 0x1 FORMAT "%13.11" ECU_ADDRESS 0x5B855E /end MEASUREMENT
/begin MEASUREMENT B_error5 "" UBYTE B_TRUE 1 100 0 1 BIT_MASK 0x1 FORMAT "%13.11" ECU_ADDRESS 0x5B855F /end MEASUREMENT
/begin MEASUREMENT B_error7 "" UBYTE B_TRUE 1 100 0 1 BIT_MASK 0x1 FORMAT "%13.11" ECU_ADDRESS 0x5B8560 /end MEASUREMENT
/begin MEASUREMENT B_esls "Bedingung Falschluft durch Fehler im Sekund‰rluftsystem" UBYTE B_TRUE 1 100 0 1 BIT_MASK 0x1 FORMAT "%13.11" ECU_ADDRESS 0x3FC001 /end MEASUREMENT
/begin MEASUREMENT B_faslarq "Bedingung: lokale Anforderung Testdurchlauf Sekund‰rluft starten" UBYTE B_TRUE 1 100 0 1 BIT_MASK 0x2 FORMAT "%13.11" ECU_ADDRESS 0x5B9037 /end MEASUREMENT
/begin MEASUREMENT B_fofstp "Bedingung fuel-off Adaption gestoppt" UBYTE B_TRUE 1 100 0 1 BIT_MASK 0x1 FORMAT "%13.11" ECU_ADDRESS 0x5B8B02 /end MEASUREMENT
/begin MEASUREMENT B_fokstp "Bedingung fuel-on Adaption gestoppt (Adaption + Korrektur)" UBYTE B_TRUE 1 100 0 1 BIT_MASK 0x1 FORMAT "%13.11" ECU_ADDRESS 0x5B8B03 /end MEASUREMENT
/begin MEASUREMENT B_fonstp "Bedingung fuel-on Adaption gestoppt" UBYTE B_TRUE 1 100 0 1 BIT_MASK 0x1 FORMAT "%13.11" ECU_ADDRESS 0x5B8B04 /end MEASUREMENT
/begin MEASUREMENT B_fontm "Motortemperatur gen¸gend hoch f¸r fuel-on-Adaption" UBYTE B_TRUE 1 100 0 1 BIT_MASK 0x1 FORMAT "%13.11" ECU_ADDRESS 0x5B8561 /end MEASUREMENT
/begin MEASUREMENT B_fph1bm "Fehler des Phasenpegels an der Bezugsmarke von PG1" UBYTE B_TRUE 1 100 0 1 BIT_MASK 0x4 FORMAT "%13.11" ECU_ADDRESS 0x5B8631 /end MEASUREMENT
/begin MEASUREMENT B_fph2bm "Fehler des Phasenpegels an der Bezugsmarke von PG2" UBYTE B_TRUE 1 100 0 1 BIT_MASK 0x8 FORMAT "%13.11" ECU_ADDRESS 0x5B8631 /end MEASUREMENT
/begin MEASUREMENT B_fph3bm "Fehler des Phasenpegels an der Bezugsmarke von PG3" UBYTE B_TRUE 1 100 0 1 BIT_MASK 0x10 FORMAT "%13.11" ECU_ADDRESS 0x5B8631 /end MEASUREMENT
/begin MEASUREMENT B_fph4bm "Fehler des Phasenpegels an der Bezugsmarke von PG4" UBYTE B_TRUE 1 100 0 1 BIT_MASK 0x20 FORMAT "%13.11" ECU_ADDRESS 0x5B8631 /end MEASUREMENT
/begin MEASUREMENT B_hst "Bedingung Heiﬂstart" UBYTE B_TRUE 1 100 0 1 BIT_MASK 0x1 FORMAT "%13.11" ECU_ADDRESS 0x3FDC20 /end MEASUREMENT
/begin MEASUREMENT B_ifukaba "Bedingung: Adaptionsfaktor BA inkrementieren" UBYTE B_TRUE 1 100 0 1 BIT_MASK 0x1 FORMAT "%13.11" ECU_ADDRESS 0x3FBD75 /end MEASUREMENT
/begin MEASUREMENT B_ifukava "Bedingung: Adaptionsfaktor VA inkrementieren" UBYTE B_TRUE 1 100 0 1 BIT_MASK 0x1 FORMAT "%13.11" ECU_ADDRESS 0x3FBD76 /end MEASUREMENT
/begin MEASUREMENT B_ivzabg1 "" UBYTE B_TRUE 1 100 0 1 BIT_MASK 0x1 FORMAT "%13.11" ECU_ADDRESS 0x5B8AF0 /end MEASUREMENT
/begin MEASUREMENT B_ivzkat1 "" UBYTE B_TRUE 1 100 0 1 BIT_MASK 0x1 FORMAT "%13.11" ECU_ADDRESS 0x5B8AF1 /end MEASUREMENT
/begin MEASUREMENT B_kmmil "MIL-Ansteuerung mit Relevanz zu Kilometererfassung" UBYTE B_TRUE 1 100 0 1 BIT_MASK 0x1 FORMAT "%13.11" ECU_ADDRESS 0x3FBC3D /end MEASUREMENT
/begin MEASUREMENT B_lamnse "Bedingung Ende lamns_w-Berechnung" UBYTE B_TRUE 1 100 0 1 BIT_MASK 0x1 FORMAT "%13.11" ECU_ADDRESS 0x3FBD5D /end MEASUREMENT
/begin MEASUREMENT B_lcmnanw "lokales Bit f¸r min.Fehler der NWS (Auslaﬂ, Bank1)" UBYTE B_TRUE 1 100 0 1 BIT_MASK 0x4 FORMAT "%13.11" ECU_ADDRESS 0x5B8A42 /end MEASUREMENT
/begin MEASUREMENT B_lcmnanw2 "lokales Bit f¸r min.Fehler der NWS (Auslaﬂ, Bank2)" UBYTE B_TRUE 1 100 0 1 BIT_MASK 0x10 FORMAT "%13.11" ECU_ADDRESS 0x5B8A42 /end MEASUREMENT
/begin MEASUREMENT B_lcmnenw "lokales Bit f¸r min.Fehler der NWS (Einlaﬂ, Bank1)" UBYTE B_TRUE 1 100 0 1 BIT_MASK 0x4 FORMAT "%13.11" ECU_ADDRESS 0x5B8A43 /end MEASUREMENT
/begin MEASUREMENT B_lcmnenw2 "lokales Bit f¸r min.Fehler der NWS (Einlaﬂ, Bank2)" UBYTE B_TRUE 1 100 0 1 BIT_MASK 0x10 FORMAT "%13.11" ECU_ADDRESS 0x5B8A43 /end MEASUREMENT
/begin MEASUREMENT B_lcnpanw "lokales Bit f¸r NP-Fehler der NWS (Auslaﬂ, Bank1)" UBYTE B_TRUE 1 100 0 1 BIT_MASK 0x8 FORMAT "%13.11" ECU_ADDRESS 0x5B8A42 /end MEASUREMENT
/begin MEASUREMENT B_lcnpanw2 "lokales Bit f¸r NP-Fehler der NWS (Auslaﬂ, Bank2)" UBYTE B_TRUE 1 100 0 1 BIT_MASK 0x20 FORMAT "%13.11" ECU_ADDRESS 0x5B8A42 /end MEASUREMENT
/begin MEASUREMENT B_lcnpenw "lokales Bit f¸r NP-Fehler der NWS (Einlaﬂ, Bank1)" UBYTE B_TRUE 1 100 0 1 BIT_MASK 0x8 FORMAT "%13.11" ECU_ADDRESS 0x5B8A43 /end MEASUREMENT
/begin MEASUREMENT B_lcnpenw2 "lokales Bit f¸r NP-Fehler der NWS (Einlaﬂ, Bank2)" UBYTE B_TRUE 1 100 0 1 BIT_MASK 0x20 FORMAT "%13.11" ECU_ADDRESS 0x5B8A43 /end MEASUREMENT
/begin MEASUREMENT B_lustop "Laufunruhe-Berechnung gesperrt" UBYTE B_TRUE 1 100 0 1 BIT_MASK 0x1 FORMAT "%13.11" ECU_ADDRESS 0x5B8B05 /end MEASUREMENT
/begin MEASUREMENT B_lustops "Laufunruhe-Berechnung gesperrt, nicht synchronisiert mit luts delay" UBYTE B_TRUE 1 100 0 1 BIT_MASK 0x1 FORMAT "%13.11" ECU_ADDRESS 0x5B8B06 /end MEASUREMENT
/begin MEASUREMENT B_mdarv "kritische Aussetzerrate vorhanden" UBYTE B_TRUE 1 100 0 1 BIT_MASK 0x1 FORMAT "%13.11" ECU_ADDRESS 0x5B8AF2 /end MEASUREMENT
/begin MEASUREMENT B_mddrla "Bedingung Misfire Detection Lastgradient f¸r Aussetzererkennung" UBYTE B_TRUE 1 100 0 1 BIT_MASK 0x1 FORMAT "%13.11" ECU_ADDRESS 0x5B8B07 /end MEASUREMENT
/begin MEASUREMENT B_mdkat "Katsch‰digende Aussetzerrate ¸berschritten (zur Ausblendung anderer Funktionen)" UBYTE B_TRUE 1 100 0 1 BIT_MASK 0x1 FORMAT "%13.11" ECU_ADDRESS 0x5B8AF3 /end MEASUREMENT
/begin MEASUREMENT B_mdng "Bedingung Misfire Detection Drehzahlgradient f¸r Aussetzererkennung" UBYTE B_TRUE 1 100 0 1 BIT_MASK 0x1 FORMAT "%13.11" ECU_ADDRESS 0x5B8B08 /end MEASUREMENT
/begin MEASUREMENT B_mdnmn "Bedingung Misfire Detection untere Drehzahlgrenze" UBYTE B_TRUE 1 100 0 1 BIT_MASK 0x1 FORMAT "%13.11" ECU_ADDRESS 0x5B8B09 /end MEASUREMENT
/begin MEASUREMENT B_mdnmx "Bedingung Misfire Detection obere Drehzahlgrenze" UBYTE B_TRUE 1 100 0 1 BIT_MASK 0x1 FORMAT "%13.11" ECU_ADDRESS 0x5B8B0A /end MEASUREMENT
/begin MEASUREMENT B_mdrl "Bedingung Misfire Detection untere Lastgrenze" UBYTE B_TRUE 1 100 0 1 BIT_MASK 0x1 FORMAT "%13.11" ECU_ADDRESS 0x5B8B0B /end MEASUREMENT
/begin MEASUREMENT B_mdstop "Misfire Detection gesperrt" UBYTE B_TRUE 1 100 0 1 BIT_MASK 0x1 FORMAT "%13.11" ECU_ADDRESS 0x5B8B0C /end MEASUREMENT
/begin MEASUREMENT B_mdtnst "Bedingung Misfire Detection Zeit nach Startende" UBYTE B_TRUE 1 100 0 1 BIT_MASK 0x1 FORMAT "%13.11" ECU_ADDRESS 0x5B8562 /end MEASUREMENT
/begin MEASUREMENT B_mdzag "Bedingung Aussetzer angefordert, Stimuli-Signal vom SW - Aussetzergenerator" UBYTE B_TRUE 1 100 0 1 BIT_MASK 0x1 FORMAT "%13.11" ECU_ADDRESS 0x5B8B3C /end MEASUREMENT
/begin MEASUREMENT B_mdzgstp "Aussetzererkennung und Zylindergleichstellung gesperrt" UBYTE B_TRUE 1 100 0 1 BIT_MASK 0x1 FORMAT "%13.11" ECU_ADDRESS 0x5B8B0D /end MEASUREMENT
/begin MEASUREMENT B_mealam "" UBYTE B_TRUE 1 100 0 1 BIT_MASK 0x4 FORMAT "%13.11" ECU_ADDRESS 0x5B9038 /end MEASUREMENT
/begin MEASUREMENT B_meaoper "" UBYTE B_TRUE 1 100 0 1 BIT_MASK 0x8 FORMAT "%13.11" ECU_ADDRESS 0x5B9038 /end MEASUREMENT
/begin MEASUREMENT B_mil "MIL-Ansteuerung" UBYTE B_TRUE 1 100 0 1 BIT_MASK 0x1 FORMAT "%13.11" ECU_ADDRESS 0x3FBC3E /end MEASUREMENT
/begin MEASUREMENT B_milblk "MIL-Ansteuerung blinkend" UBYTE B_TRUE 1 100 0 1 BIT_MASK 0x8 FORMAT "%13.11" ECU_ADDRESS 0x5B8E28 /end MEASUREMENT
/begin MEASUREMENT B_mileb "MIL-Ansteuerung eigenbestimmt" UBYTE B_TRUE 1 100 0 1 BIT_MASK 0x2 FORMAT "%13.11" ECU_ADDRESS 0x5B8E28 /end MEASUREMENT
/begin MEASUREMENT B_milmd "MIL-Ansteuerung an durch Aussetzererkennung, bei ti-Abschaltung" UBYTE B_TRUE 1 100 0 1 BIT_MASK 0x1 FORMAT "%13.11" ECU_ADDRESS 0x5B8AF4 /end MEASUREMENT
/begin MEASUREMENT B_milst "MIL-Ansteuerung Prueffunktion bei Start" UBYTE B_TRUE 1 100 0 1 BIT_MASK 0x1 FORMAT "%13.11" ECU_ADDRESS 0x5B8E28 /end MEASUREMENT
/begin MEASUREMENT B_milstat "MIL - Status f¸r Scan Tool Mode $01 PID $01" UBYTE B_TRUE 1 100 0 1 BIT_MASK 0x1 FORMAT "%13.11" ECU_ADDRESS 0x3FBC3F /end MEASUREMENT
/begin MEASUREMENT B_milstp "Auswertung Aussetzererkennung (%DMDMIL) gesperrt" UBYTE B_TRUE 1 100 0 1 BIT_MASK 0x1 FORMAT "%13.11" ECU_ADDRESS 0x5B8B0E /end MEASUREMENT
/begin MEASUREMENT B_milstps "Auswertung Aussetzererkennung (%DMDMIL) gesperrt, nicht synchronisiert mit luts" UBYTE B_TRUE 1 100 0 1 BIT_MASK 0x1 FORMAT "%13.11" ECU_ADDRESS 0x5B8B0F /end MEASUREMENT
/begin MEASUREMENT B_mslmin "Bedingung sehr geringe Sekund‰rluftmasse aus Meﬂphase" UBYTE B_TRUE 1 100 0 1 BIT_MASK 0x2 FORMAT "%13.11" ECU_ADDRESS 0x5B9032 /end MEASUREMENT
/begin MEASUREMENT B_mslmin2 "Bedingung sehr geringe Sekund‰rluftmasse aus Meﬂphase (Bank 2)" UBYTE B_TRUE 1 100 0 1 BIT_MASK 0x4 FORMAT "%13.11" ECU_ADDRESS 0x5B9032 /end MEASUREMENT
/begin MEASUREMENT B_mslmn "Bedingung zu wenig Sekund‰rluftmasse" UBYTE B_TRUE 1 100 0 1 BIT_MASK 0x1 FORMAT "%13.11" ECU_ADDRESS 0x3FC002 /end MEASUREMENT
/begin MEASUREMENT B_mslnini "" UBYTE B_TRUE 1 100 0 1 BIT_MASK 0x80 FORMAT "%13.11" ECU_ADDRESS 0x5B9035 /end MEASUREMENT
/begin MEASUREMENT B_mslrdy "" UBYTE B_TRUE 1 100 0 1 BIT_MASK 0x1 FORMAT "%13.11" ECU_ADDRESS 0x5B9038 /end MEASUREMENT
/begin MEASUREMENT B_mslrdyb "" UBYTE B_TRUE 1 100 0 1 BIT_MASK 0x40 FORMAT "%13.11" ECU_ADDRESS 0x5B9037 /end MEASUREMENT
/begin MEASUREMENT B_mslrdyb2 "" UBYTE B_TRUE 1 100 0 1 BIT_MASK 0x80 FORMAT "%13.11" ECU_ADDRESS 0x5B9037 /end MEASUREMENT
/begin MEASUREMENT B_mslt "" UBYTE B_TRUE 1 100 0 1 BIT_MASK 0x10 FORMAT "%13.11" ECU_ADDRESS 0x5B9038 /end MEASUREMENT
/begin MEASUREMENT B_mslt2 "" UBYTE B_TRUE 1 100 0 1 BIT_MASK 0x20 FORMAT "%13.11" ECU_ADDRESS 0x5B9038 /end MEASUREMENT
/begin MEASUREMENT B_msltini "" UBYTE B_TRUE 1 100 0 1 BIT_MASK 0x1 FORMAT "%13.11" ECU_ADDRESS 0x5B9036 /end MEASUREMENT
/begin MEASUREMENT B_msltini2 "" UBYTE B_TRUE 1 100 0 1 BIT_MASK 0x40 FORMAT "%13.11" ECU_ADDRESS 0x5B9038 /end MEASUREMENT
/begin MEASUREMENT B_nomil "MIL-Ansteuerung verriegelt" UBYTE B_TRUE 1 100 0 1 BIT_MASK 0x1 FORMAT "%13.11" ECU_ADDRESS 0x3FBC40 /end MEASUREMENT
/begin MEASUREMENT B_nopg "Kein Phasengeber funktionst¸chtig" UBYTE B_TRUE 1 100 0 1 BIT_MASK 0x1 FORMAT "%13.11" ECU_ADDRESS 0x5B8631 /end MEASUREMENT
/begin MEASUREMENT B_nowuc "Bedingung 'kein warm up cycle' erkannt" UBYTE B_TRUE 1 100 0 1 BIT_MASK 0x1 FORMAT "%13.11" ECU_ADDRESS 0x3FBC41 /end MEASUREMENT
/begin MEASUREMENT B_npos0dyn "Bedingung Fehler NW-Flanke > 720 Grad KW dynamisch E-NW 1" UBYTE B_TRUE 1 100 0 1 BIT_MASK 0x80 FORMAT "%13.11" ECU_ADDRESS 0x3FDCFC /end MEASUREMENT
/begin MEASUREMENT B_npos1dyn "Bedingung Fehler NW-Flanke > 720 Grad KW dynamisch A-NW 1" UBYTE B_TRUE 1 100 0 1 BIT_MASK 0x80 FORMAT "%13.11" ECU_ADDRESS 0x3FDCF4 /end MEASUREMENT
/begin MEASUREMENT B_nvnsad "0: Vanosadaption ist mˆglich/ 1: Vanosadaption ist gesperrt" UBYTE B_TRUE 1 100 0 1 FORMAT "%13.11" ECU_ADDRESS 0x5B8A44 /end MEASUREMENT
/begin MEASUREMENT B_nvrbupok "Erfolgreiches NVRAM-Backup im Flash" UBYTE B_TRUE 1 100 0 1 BIT_MASK 0x1 FORMAT "%13.11" ECU_ADDRESS 0x3FBFBE /end MEASUREMENT
/begin MEASUREMENT B_ph2flok "Keine Abweichung der Phasenflanken im Arbeitsspiel f¸r PG2" UBYTE B_TRUE 1 100 0 1 BIT_MASK 0x1 FORMAT "%13.11" ECU_ADDRESS 0x5B8C0C /end MEASUREMENT
/begin MEASUREMENT B_ph3flok "Keine Abweichung der Phasenflanken im Arbeitsspiel f¸r PG3" UBYTE B_TRUE 1 100 0 1 BIT_MASK 0x2 FORMAT "%13.11" ECU_ADDRESS 0x5B8C0C /end MEASUREMENT
/begin MEASUREMENT B_ph4flok "Keine Abweichung der Phasenflanken im Arbeitsspiel f¸r PG4" UBYTE B_TRUE 1 100 0 1 BIT_MASK 0x4 FORMAT "%13.11" ECU_ADDRESS 0x5B8C0C /end MEASUREMENT
/begin MEASUREMENT B_phflok "Keine Abweichung der Phasenflanken im Arbeitsspiel f¸r PG1" UBYTE B_TRUE 1 100 0 1 BIT_MASK 0x8 FORMAT "%13.11" ECU_ADDRESS 0x5B8C0C /end MEASUREMENT
/begin MEASUREMENT B_range "" UBYTE B_TRUE 1 100 0 1 BIT_MASK 0x1 FORMAT "%13.11" ECU_ADDRESS 0x5B8B10 /end MEASUREMENT
/begin MEASUREMENT B_redkl "Freigabe Reduzierung ‹K-K- und -L-Anteil" UBYTE B_TRUE 1 100 0 1 BIT_MASK 0x1 FORMAT "%13.11" ECU_ADDRESS 0x3FBD64 /end MEASUREMENT
/begin MEASUREMENT B_reini "Bedingung Reinitialisierung des Aussetzergenerators" UBYTE B_TRUE 1 100 0 1 BIT_MASK 0x1 FORMAT "%13.11" ECU_ADDRESS 0x5B862E /end MEASUREMENT
/begin MEASUREMENT B_rst1ph "Heilung f¸r Phasenfehler PG1 (falsche Anzahl Flanken/AS)" UBYTE B_TRUE 1 100 0 1 BIT_MASK 0x1 FORMAT "%13.11" ECU_ADDRESS 0x5B8C11 /end MEASUREMENT
/begin MEASUREMENT B_rst1ph2 "Heilung f¸r Phasenfehler PG2 (falsche Anzahl Flanken/AS)" UBYTE B_TRUE 1 100 0 1 BIT_MASK 0x2 FORMAT "%13.11" ECU_ADDRESS 0x5B8C11 /end MEASUREMENT
/begin MEASUREMENT B_rst1ph3 "Heilung f¸r Phasenfehler PG3 (falsche Anzahl Flanken/AS)" UBYTE B_TRUE 1 100 0 1 BIT_MASK 0x4 FORMAT "%13.11" ECU_ADDRESS 0x5B8C11 /end MEASUREMENT
/begin MEASUREMENT B_rst1ph4 "Heilung f¸r Phasenfehler PG4 (falsche Anzahl Flanken/AS)" UBYTE B_TRUE 1 100 0 1 BIT_MASK 0x8 FORMAT "%13.11" ECU_ADDRESS 0x5B8C11 /end MEASUREMENT
/begin MEASUREMENT B_rst3ph "Heilung f¸r Phasenfehler PG1 (falscher Pegel an BM)" UBYTE B_TRUE 1 100 0 1 BIT_MASK 0x2 FORMAT "%13.11" ECU_ADDRESS 0x5B8C0D /end MEASUREMENT
/begin MEASUREMENT B_rst3ph2 "Heilung f¸r Phasenfehler PG2 (falscher Pegel an BM)" UBYTE B_TRUE 1 100 0 1 BIT_MASK 0x2 FORMAT "%13.11" ECU_ADDRESS 0x5B8C0E /end MEASUREMENT
/begin MEASUREMENT B_rst3ph3 "Heilung f¸r Phasenfehler PG3 (falscher Pegel an BM)" UBYTE B_TRUE 1 100 0 1 BIT_MASK 0x2 FORMAT "%13.11" ECU_ADDRESS 0x5B8C0F /end MEASUREMENT
/begin MEASUREMENT B_rst3ph4 "Heilung f¸r Phasenfehler PG4 (falscher Pegel an BM)" UBYTE B_TRUE 1 100 0 1 BIT_MASK 0x2 FORMAT "%13.11" ECU_ADDRESS 0x5B8C10 /end MEASUREMENT
/begin MEASUREMENT B_sla "Anforderung Sekund‰rluftadaptionsphase" UBYTE B_TRUE 1 100 0 1 BIT_MASK 0x1 FORMAT "%13.11" ECU_ADDRESS 0x3FC003 /end MEASUREMENT
/begin MEASUREMENT B_slar "Anforderung Sekund‰rluftadaptionsphase zur¸cksetzen" UBYTE B_TRUE 1 100 0 1 BIT_MASK 0x1 FORMAT "%13.11" ECU_ADDRESS 0x5B9037 /end MEASUREMENT
/begin MEASUREMENT B_slarq "" UBYTE B_TRUE 1 100 0 1 BIT_MASK 0x80 FORMAT "%13.11" ECU_ADDRESS 0x5B9033 /end MEASUREMENT
/begin MEASUREMENT B_slas "Anforderung Sekund‰rluftadaptionsphase setzen" UBYTE B_TRUE 1 100 0 1 BIT_MASK 0x80 FORMAT "%13.11" ECU_ADDRESS 0x5B9036 /end MEASUREMENT
/begin MEASUREMENT B_slsofw "" UBYTE B_TRUE 1 100 0 1 BIT_MASK 0x4 FORMAT "%13.11" ECU_ADDRESS 0x5B9037 /end MEASUREMENT
/begin MEASUREMENT B_sp1 "FLC-Trigger der Aussetzererkennung" UBYTE B_TRUE 1 100 0 1 BIT_MASK 0x1 FORMAT "%13.11" ECU_ADDRESS 0x5B8E2B /end MEASUREMENT
/begin MEASUREMENT B_sp2 "HLC-Trigger der Aussetzererkennung" UBYTE B_TRUE 1 100 0 1 BIT_MASK 0x1 FORMAT "%13.11" ECU_ADDRESS 0x5B8E2C /end MEASUREMENT
/begin MEASUREMENT B_stdmd "Bedingung Aussetzererkennung w‰hrend Starthochlauf gesperrt" UBYTE B_TRUE 1 100 0 1 BIT_MASK 0x1 FORMAT "%13.11" ECU_ADDRESS 0x5B8B11 /end MEASUREMENT
/begin MEASUREMENT B_stimhelp "Z¸ndungs-Aussetzer eingestellt, Stimuli-Signal vom Aussetzergenerator" UBYTE B_TRUE 1 100 0 1 BIT_MASK 0x1 FORMAT "%13.11" ECU_ADDRESS 0x5B8B4B /end MEASUREMENT
/begin MEASUREMENT B_stpon "Bedingung Umschaltung nach Start aktiv (Startgradienten)" UBYTE B_TRUE 1 100 0 1 BIT_MASK 0x1 FORMAT "%13.11" ECU_ADDRESS 0x5B8B12 /end MEASUREMENT
/begin MEASUREMENT B_swe "Bedingung Schlechtwegstrecke erkannt" UBYTE B_TRUE 1 100 0 1 BIT_MASK 0x1 FORMAT "%13.11" ECU_ADDRESS 0x5B8B13 /end MEASUREMENT
/begin MEASUREMENT B_swe_c "Bedingung Schlechtwegstrecke erkannt aus %DSWEC" UBYTE B_TRUE 1 100 0 1 BIT_MASK 0x1 FORMAT "%13.11" ECU_ADDRESS 0x3FBD06 /end MEASUREMENT
/begin MEASUREMENT B_synph "Bedingung Synchronisation Phase" UBYTE B_TRUE 1 100 0 1 BIT_MASK 0x2 FORMAT "%13.11" ECU_ADDRESS 0x5B8631 /end MEASUREMENT
/begin MEASUREMENT B_synphab "Synchronisation abgeschlossen" UBYTE B_TRUE 1 100 0 1 BIT_MASK 0x2 FORMAT "%13.11" ECU_ADDRESS 0x5B8632 /end MEASUREMENT
/begin MEASUREMENT B_szsls "Bedingung Diagnose Sekund‰rluftsystem durchgef¸hrt, Summe" UBYTE B_TRUE 1 100 0 1 BIT_MASK 0x20 FORMAT "%13.11" ECU_ADDRESS 0x5B9033 /end MEASUREMENT
/begin MEASUREMENT B_taini "Bedingung 2A Zeit gleich Initialisierungswert" UBYTE default 1 100 0 1 FORMAT "%5.3" ARRAY_SIZE 8 ECU_ADDRESS 0x5B8D44 /end MEASUREMENT
/begin MEASUREMENT B_ti1stamp "" UBYTE B_TRUE 1 100 0 1 BIT_MASK 0x1 FORMAT "%13.11" ECU_ADDRESS 0x5B8B4C /end MEASUREMENT
/begin MEASUREMENT B_ti2stamp "" UBYTE B_TRUE 1 100 0 1 BIT_MASK 0x1 FORMAT "%13.11" ECU_ADDRESS 0x5B8B4D /end MEASUREMENT
/begin MEASUREMENT B_trfasla "" UBYTE B_TRUE 1 100 0 1 BIT_MASK 0x1 FORMAT "%13.11" ECU_ADDRESS 0x5B9039 /end MEASUREMENT
/begin MEASUREMENT B_ts1delay "" UBYTE B_TRUE 1 100 0 1 BIT_MASK 0x1 FORMAT "%13.11" ECU_ADDRESS 0x5B8B4E /end MEASUREMENT
/begin MEASUREMENT B_tsbcalc "" UBYTE B_TRUE 1 100 0 1 BIT_MASK 0x1 FORMAT "%13.11" ECU_ADDRESS 0x5B8B4F /end MEASUREMENT
/begin MEASUREMENT B_tsbready "Bedingung Segmentzeit g¸ltig" UBYTE B_TRUE 1 100 0 1 BIT_MASK 0x1 FORMAT "%13.11" ECU_ADDRESS 0x5B8B50 /end MEASUREMENT
/begin MEASUREMENT B_uk1 "Einschaltbedingung ‹bergangskompensation" UBYTE B_TRUE 1 100 0 1 BIT_MASK 0x1 FORMAT "%13.11" ECU_ADDRESS 0x3FBD65 /end MEASUREMENT
/begin MEASUREMENT B_uka "Freigabebedingung ‹K-Adaption" UBYTE B_TRUE 1 100 0 1 BIT_MASK 0x1 FORMAT "%13.11" ECU_ADDRESS 0x3FBD77 /end MEASUREMENT
/begin MEASUREMENT B_ukab "Bedingung g¸ltiger Betriebsbereich f¸r adaptive ‹K" UBYTE B_TRUE 1 100 0 1 BIT_MASK 0x1 FORMAT "%13.11" ECU_ADDRESS 0x3FBD78 /end MEASUREMENT
/begin MEASUREMENT B_ukaba "Bedingung Beschleunigung (‹K-Adaption)" UBYTE B_TRUE 1 100 0 1 BIT_MASK 0x1 FORMAT "%13.11" ECU_ADDRESS 0x3FBD79 /end MEASUREMENT
/begin MEASUREMENT B_ukabaf "Bedingung: BA fett" UBYTE B_TRUE 1 100 0 1 BIT_MASK 0x1 FORMAT "%13.11" ECU_ADDRESS 0x3FBD7A /end MEASUREMENT
/begin MEASUREMENT B_ukabah "Bedingung BA erhˆht durch ‹K-Adaption" UBYTE B_TRUE 1 100 0 1 BIT_MASK 0x1 FORMAT "%13.11" ECU_ADDRESS 0x3FBD7B /end MEASUREMENT
/begin MEASUREMENT B_ukabal "Bedingung BA verringert durch ‹K-Adaption" UBYTE B_TRUE 1 100 0 1 BIT_MASK 0x1 FORMAT "%13.11" ECU_ADDRESS 0x3FBD7C /end MEASUREMENT
/begin MEASUREMENT B_ukabam "Bedingung: BA mager" UBYTE B_TRUE 1 100 0 1 BIT_MASK 0x1 FORMAT "%13.11" ECU_ADDRESS 0x3FBD7D /end MEASUREMENT
/begin MEASUREMENT B_ukadba "Dekrement-Wunsch adaptive ‹K bei BA" UBYTE B_TRUE 1 100 0 1 BIT_MASK 0x1 FORMAT "%13.11" ECU_ADDRESS 0x3FBD7E /end MEASUREMENT
/begin MEASUREMENT B_ukadva "Dekrement-Wunsch adaptive ‹K bei VA" UBYTE B_TRUE 1 100 0 1 BIT_MASK 0x1 FORMAT "%13.11" ECU_ADDRESS 0x3FBD7F /end MEASUREMENT
/begin MEASUREMENT B_ukaiba "Inkrement-Wunsch BA adaptive ‹K" UBYTE B_TRUE 1 100 0 1 BIT_MASK 0x1 FORMAT "%13.11" ECU_ADDRESS 0x3FBD80 /end MEASUREMENT
/begin MEASUREMENT B_ukaiva "Inkrement-Wunsch VA adaptive ‹K" UBYTE B_TRUE 1 100 0 1 BIT_MASK 0x1 FORMAT "%13.11" ECU_ADDRESS 0x3FBD81 /end MEASUREMENT
/begin MEASUREMENT B_ukat "Bedingung Timer f¸r ‹K-Adaptionsverbot abgelaufen" UBYTE B_TRUE 1 100 0 1 BIT_MASK 0x1 FORMAT "%13.11" ECU_ADDRESS 0x3FBD82 /end MEASUREMENT
/begin MEASUREMENT B_ukava "Bedingung Verzˆgerung (‹K-Adaption)" UBYTE B_TRUE 1 100 0 1 BIT_MASK 0x1 FORMAT "%13.11" ECU_ADDRESS 0x3FBD83 /end MEASUREMENT
/begin MEASUREMENT B_ukavaf "Bedingung: VA fett" UBYTE B_TRUE 1 100 0 1 BIT_MASK 0x1 FORMAT "%13.11" ECU_ADDRESS 0x3FBD84 /end MEASUREMENT
/begin MEASUREMENT B_ukavah "Bedingung VA erhˆht durch ‹K-Adaption" UBYTE B_TRUE 1 100 0 1 BIT_MASK 0x1 FORMAT "%13.11" ECU_ADDRESS 0x3FBD85 /end MEASUREMENT
/begin MEASUREMENT B_ukaval "Bedingung VA verringert durch ‹K-Adaption" UBYTE B_TRUE 1 100 0 1 BIT_MASK 0x1 FORMAT "%13.11" ECU_ADDRESS 0x3FBD86 /end MEASUREMENT
/begin MEASUREMENT B_ukavam "Bedingung: VA mager" UBYTE B_TRUE 1 100 0 1 BIT_MASK 0x1 FORMAT "%13.11" ECU_ADDRESS 0x3FBD87 /end MEASUREMENT
/begin MEASUREMENT B_uke "Einschaltbedingung ‹K-Ersatzwert" UBYTE B_TRUE 1 100 0 1 BIT_MASK 0x1 FORMAT "%13.11" ECU_ADDRESS 0x3FBD66 /end MEASUREMENT
/begin MEASUREMENT B_ukg "Bedingung ‹k wirkt stark" UBYTE B_TRUE 1 100 0 1 BIT_MASK 0x1 FORMAT "%13.11" ECU_ADDRESS 0x3FBD67 /end MEASUREMENT
/begin MEASUREMENT B_ukk "Einschaltbedingung ‹K Kurzzeit-Anteil" UBYTE B_TRUE 1 100 0 1 BIT_MASK 0x1 FORMAT "%13.11" ECU_ADDRESS 0x3FBD68 /end MEASUREMENT
/begin MEASUREMENT B_ukns "Einschaltbedingung ‹K nach Start" UBYTE B_TRUE 1 100 0 1 BIT_MASK 0x1 FORMAT "%13.11" ECU_ADDRESS 0x3FBD69 /end MEASUREMENT
/begin MEASUREMENT B_va "Bedingung Verzˆgerungsabmagerung (Anzeige)" UBYTE B_TRUE 1 100 0 1 BIT_MASK 0x1 FORMAT "%13.11" ECU_ADDRESS 0x3FBD6A /end MEASUREMENT
/begin MEASUREMENT B_vaau "Bedingung Verzˆgerungsabmagerung Aufteilung" UBYTE B_TRUE 1 100 0 1 BIT_MASK 0x1 FORMAT "%13.11" ECU_ADDRESS 0x3FBD6B /end MEASUREMENT
/begin MEASUREMENT B_vag "Bedingung starke Verzˆgerungsabmagerung" UBYTE B_TRUE 1 100 0 1 BIT_MASK 0x1 FORMAT "%13.11" ECU_ADDRESS 0x3FBD6C /end MEASUREMENT
/begin MEASUREMENT B_vakl "Bedingung Verzˆgerungsabmagerung L- und K-Anteil" UBYTE B_TRUE 1 100 0 1 BIT_MASK 0x1 FORMAT "%13.11" ECU_ADDRESS 0x3FBD6D /end MEASUREMENT
/begin MEASUREMENT B_val "Bedingung Verzˆgerungsabmagerung L-Anteil" UBYTE B_TRUE 1 100 0 1 BIT_MASK 0x1 FORMAT "%13.11" ECU_ADDRESS 0x3FBD6E /end MEASUREMENT
/begin MEASUREMENT B_vbemg "Bedingung Verbrennungserkennung mˆglich" UBYTE B_TRUE 1 100 0 1 BIT_MASK 0x1 FORMAT "%13.11" ECU_ADDRESS 0x3FBD5E /end MEASUREMENT
/begin MEASUREMENT B_vbmg "Bedingung Verbrennung mˆglich" UBYTE B_TRUE 1 100 0 1 BIT_MASK 0x1 FORMAT "%13.11" ECU_ADDRESS 0x3FBD5F /end MEASUREMENT
/begin MEASUREMENT B_vsaadnok "Bedingung Anschlagadaption Auslasspreizung n.i.O." UBYTE B_TRUE 1 100 0 1 BIT_MASK 0x10 FORMAT "%13.11" ECU_ADDRESS 0x3FDCF4 /end MEASUREMENT
/begin MEASUREMENT B_vsaadok "" UBYTE B_TRUE 1 100 0 1 BIT_MASK 0x40 FORMAT "%13.11" ECU_ADDRESS 0x3FDCF4 /end MEASUREMENT
/begin MEASUREMENT B_vsaadp "Bedingung Anschlagadaption Auslasspreizung" UBYTE B_TRUE 1 100 0 1 BIT_MASK 0x1 FORMAT "%13.11" ECU_ADDRESS 0x3FDCF4 /end MEASUREMENT
/begin MEASUREMENT B_vsaflan "Bedingung neue NW-Flanke Auslasspreizung" UBYTE B_TRUE 1 100 0 1 BIT_MASK 0x20 FORMAT "%13.11" ECU_ADDRESS 0x3FDCF4 /end MEASUREMENT
/begin MEASUREMENT B_vsanwerr "Bedingung Fehler von der HW-Schale Auslasspreizung" UBYTE B_TRUE 1 100 0 1 BIT_MASK 0x2 FORMAT "%13.11" ECU_ADDRESS 0x3FDCF4 /end MEASUREMENT
/begin MEASUREMENT B_vsa_an "" UBYTE B_TRUE 1 100 0 1 BIT_MASK 0x1 FORMAT "%13.11" ECU_ADDRESS 0x3FBFD0 /end MEASUREMENT
/begin MEASUREMENT B_vsa_nv "" UBYTE B_TRUE 1 100 0 1 BIT_MASK 0x1 FORMAT "%13.11" ECU_ADDRESS 0x3FBFD1 /end MEASUREMENT
/begin MEASUREMENT B_vseadnok "Bedingung Anschlagadaption Einlasspreizung n.i.O." UBYTE B_TRUE 1 100 0 1 BIT_MASK 0x10 FORMAT "%13.11" ECU_ADDRESS 0x3FDCFC /end MEASUREMENT
/begin MEASUREMENT B_vseadok "Adaptionsendetimer abgelaufen" UBYTE B_TRUE 1 100 0 1 BIT_MASK 0x40 FORMAT "%13.11" ECU_ADDRESS 0x3FDCFC /end MEASUREMENT
/begin MEASUREMENT B_vseadp "Bedingung Anschlagadaption Einlasspreizung" UBYTE B_TRUE 1 100 0 1 BIT_MASK 0x1 FORMAT "%13.11" ECU_ADDRESS 0x3FDCFC /end MEASUREMENT
/begin MEASUREMENT B_vseflan "Bedingung neue NW-Flanke Einlasspreizung" UBYTE B_TRUE 1 100 0 1 BIT_MASK 0x20 FORMAT "%13.11" ECU_ADDRESS 0x3FDCFC /end MEASUREMENT
/begin MEASUREMENT B_vsenwerr "Bedingung Fehler von der HW-Schale Einlasspreizung" UBYTE B_TRUE 1 100 0 1 BIT_MASK 0x2 FORMAT "%13.11" ECU_ADDRESS 0x3FDCFC /end MEASUREMENT
/begin MEASUREMENT B_vse_an "Bedingung: E-Vanos am Anschlag" UBYTE B_TRUE 1 100 0 1 BIT_MASK 0x1 FORMAT "%13.11" ECU_ADDRESS 0x3FBFD2 /end MEASUREMENT
/begin MEASUREMENT B_vse_nv "Flag fuer Abspeicherung der Umgebungsbedingungen" UBYTE B_TRUE 1 100 0 1 BIT_MASK 0x1 FORMAT "%13.11" ECU_ADDRESS 0x3FBFD3 /end MEASUREMENT
/begin MEASUREMENT B_wf "Bedingung Wandfilmberechnung" UBYTE B_TRUE 1 100 0 1 BIT_MASK 0x1 FORMAT "%13.11" ECU_ADDRESS 0x3FBD6F /end MEASUREMENT
/begin MEASUREMENT B_wks "Bedingung Wiederholkaltstart" UBYTE B_TRUE 1 100 0 1 BIT_MASK 0x1 FORMAT "%13.11" ECU_ADDRESS 0x3FBD60 /end MEASUREMENT
/begin MEASUREMENT B_wst "Bedingung Wiederholstart" UBYTE B_TRUE 1 100 0 1 BIT_MASK 0x1 FORMAT "%13.11" ECU_ADDRESS 0x3FBD61 /end MEASUREMENT
/begin MEASUREMENT B_wuc "Bedingung 'warm up cycle' erkannt" UBYTE B_TRUE 1 100 0 1 BIT_MASK 0x1 FORMAT "%13.11" ECU_ADDRESS 0x5B8E2A /end MEASUREMENT
/begin MEASUREMENT B_zagrun "Bedingung Start des Aussetzergenerators" UBYTE B_TRUE 1 100 0 1 BIT_MASK 0x2 FORMAT "%13.11" ECU_ADDRESS 0x5B862E /end MEASUREMENT
/begin MEASUREMENT B_zagstp "Bedingung Aussetzergenerator gestoppt" UBYTE B_TRUE 1 100 0 1 BIT_MASK 0x1 FORMAT "%13.11" ECU_ADDRESS 0x5B8B3D /end MEASUREMENT
/begin MEASUREMENT B_zkhimp "Bedingung : Bedingung hohe Impedanz im Z¸ndkreis" UBYTE default 1 100 0 1 FORMAT "%5.3" ARRAY_SIZE 8 ECU_ADDRESS 0x5B8D4C /end MEASUREMENT
/begin MEASUREMENT B_zkrlhmp "Bedingung hochimpedanter Z¸ndkreis relativ zu benachbarten Z¸ndkreisen" UBYTE default 1 100 0 1 FORMAT "%5.3" ARRAY_SIZE 8 ECU_ADDRESS 0x5B8D54 /end MEASUREMENT
/begin MEASUREMENT B_zkrlksub "Bedingung niederimpedanter Z¸ndkreis relativ zu benachbarten Z¸ndkreisen" UBYTE default 1 100 0 1 FORMAT "%5.3" ARRAY_SIZE 8 ECU_ADDRESS 0x5B8D5C /end MEASUREMENT
/begin MEASUREMENT cdcy "" UBYTE dez 1 100 0 255 FORMAT "%5.1" ECU_ADDRESS 0x3FD834 /end MEASUREMENT
/begin MEASUREMENT cycle "Zykluszaehler Z¸ndungsdiagnose" UWORD dez 1 100 0 65535 FORMAT "%8.2" ECU_ADDRESS 0x5B97D8 /end MEASUREMENT
/begin MEASUREMENT dfrmoff_w "frm-Offset: zur Kontrolle von Problemen der Vorsteuerung" SWORD fak_sw_b1 1 100 -1 0.999969 FORMAT "%8.6" ECU_ADDRESS 0x5B8AA8 /end MEASUREMENT
/begin MEASUREMENT dmdappBits_100ms "" UBYTE dez 1 100 0 255 FORMAT "%5.1" ECU_ADDRESS 0x5B862E /end MEASUREMENT
/begin MEASUREMENT dmdsegl_w "Segmentl‰nge f¸r Aussetzererkennung" UWORD kw_q6 1 100 0 393210 FORMAT "%8.1" ECU_ADDRESS 0x5B9684 /end MEASUREMENT
/begin MEASUREMENT dmdstpBits1_100ms "" UWORD dez 1 100 0 65535 FORMAT "%8.2" ECU_ADDRESS 0x5B856A /end MEASUREMENT
/begin MEASUREMENT dmidte "F¸llungs‰nderung bezogen auf Referenzwert" UWORD rel_uw_b100 1 100 0 99.9985 FORMAT "%8.5" ECU_ADDRESS 0x5B945A /end MEASUREMENT
/begin MEASUREMENT dmslift_w "" UWORD m_q0p025 1 100 0 1638.38 FORMAT "%8.3" ECU_ADDRESS 0x5B8AAA /end MEASUREMENT
/begin MEASUREMENT dndte "Delta n bei Tankentl¸ftungsdiagnose" SWORD nmot_sw_q0p25 1 100 -8192 8191.75 FORMAT "%8.3" ECU_ADDRESS 0x5B945C /end MEASUREMENT
/begin MEASUREMENT dnsdte "ƒnderung der Solldrehzahl bezogen auf Referenzwert" UBYTE nmot_ub_q10 1 100 0 2550 FORMAT "%5.0" ECU_ADDRESS 0x5B8FE2 /end MEASUREMENT
/begin MEASUREMENT dnwsausBits_100ms "" UBYTE dez 1 100 0 255 FORMAT "%5.1" ECU_ADDRESS 0x5B8A42 /end MEASUREMENT
/begin MEASUREMENT dnwseinBits_100ms "" UBYTE dez 1 100 0 255 FORMAT "%5.1" ECU_ADDRESS 0x5B8A43 /end MEASUREMENT
/begin MEASUREMENT dphBits2_200ms "" UBYTE dez 1 100 0 255 FORMAT "%5.1" ECU_ADDRESS 0x5B8631 /end MEASUREMENT
/begin MEASUREMENT dphBits2_syn "" UBYTE dez 1 100 0 255 FORMAT "%5.1" ECU_ADDRESS 0x5B8C0C /end MEASUREMENT
/begin MEASUREMENT dphBits3_syn "" UWORD dez 1 100 0 65535 FORMAT "%8.2" ECU_ADDRESS 0x5B9580 /end MEASUREMENT
/begin MEASUREMENT dphBits_200ms "" UBYTE dez 1 100 0 255 FORMAT "%5.1" ECU_ADDRESS 0x5B8632 /end MEASUREMENT
/begin MEASUREMENT dphBits_ph1 "" UBYTE dez 1 100 0 255 FORMAT "%5.1" ECU_ADDRESS 0x5B8C0D /end MEASUREMENT
/begin MEASUREMENT dphBits_ph2 "" UBYTE dez 1 100 0 255 FORMAT "%5.1" ECU_ADDRESS 0x5B8C0E /end MEASUREMENT
/begin MEASUREMENT dphBits_ph3 "" UBYTE dez 1 100 0 255 FORMAT "%5.1" ECU_ADDRESS 0x5B8C0F /end MEASUREMENT
/begin MEASUREMENT dphBits_ph4 "" UBYTE dez 1 100 0 255 FORMAT "%5.1" ECU_ADDRESS 0x5B8C10 /end MEASUREMENT
/begin MEASUREMENT dphBits_syn "" UBYTE dez 1 100 0 255 FORMAT "%5.1" ECU_ADDRESS 0x5B8C11 /end MEASUREMENT
/begin MEASUREMENT drkuke_w "Delta relative Kraftstoffmasse Ersatzwert" UWORD rel_uw_q0p1875 1 100 0 12287.8 FORMAT "%8.2" ECU_ADDRESS 0x5B91AE /end MEASUREMENT
/begin MEASUREMENT drlsp "Last‰nderung zwischen zwei Sondenspr¸ngen" SBYTE rel_sb_q0p75 1 100 -96 95.25 FORMAT "%5.2" ECU_ADDRESS 0x5B8EB2 /end MEASUREMENT
/begin MEASUREMENT dr_errArray "" UWORD dez 1 100 0 65535 FORMAT "%8.2" ARRAY_SIZE 22 ECU_ADDRESS 0x5BB0EA /end MEASUREMENT
/begin MEASUREMENT dr_errCounter "" UWORD dez 1 100 0 65535 FORMAT "%8.2" ECU_ADDRESS 0x3FB65E /end MEASUREMENT
/begin MEASUREMENT dr_errId "" UWORD dez 1 100 0 65535 FORMAT "%8.2" ECU_ADDRESS 0x3FB660 /end MEASUREMENT
/begin MEASUREMENT dr_errInfoh "" UWORD dez 1 100 0 65535 FORMAT "%8.2" ECU_ADDRESS 0x5BB0E2 /end MEASUREMENT
/begin MEASUREMENT dr_errInfol "" UWORD dez 1 100 0 65535 FORMAT "%8.2" ECU_ADDRESS 0x5BB0E4 /end MEASUREMENT
/begin MEASUREMENT dr_errMin "" UWORD tmin_uw_q1 1 100 0 65535 FORMAT "%8.2" ECU_ADDRESS 0x5BB0E6 /end MEASUREMENT
/begin MEASUREMENT dr_errSec "" UWORD t_q0p1 1 100 0 6553.5 FORMAT "%8.3" ECU_ADDRESS 0x5BB0E8 /end MEASUREMENT
/begin MEASUREMENT dr_errType "" UWORD dez 1 100 0 65535 FORMAT "%8.2" ECU_ADDRESS 0x3FB662 /end MEASUREMENT
/begin MEASUREMENT dsueBits "" UBYTE dez 1 100 0 255 FORMAT "%5.1" ECU_ADDRESS 0x5B86A0 /end MEASUREMENT
/begin MEASUREMENT DTEVNbits "" UBYTE dez 1 100 0 255 FORMAT "%5.1" ECU_ADDRESS 0x5B8A20 /end MEASUREMENT
/begin MEASUREMENT dtevphc_w "" UWORD t100msxs_uw_b6553p5 1 100 0 6553.5 FORMAT "%8.3" ECU_ADDRESS 0x5B8A26 /end MEASUREMENT
/begin MEASUREMENT duf_c "Zeitz‰hler f¸rs Setzen der Zyklusflags der Funktions¸berwachungs-Diagnose" UBYTE t100msxs_ub_b25p5 1 100 0 25.5 FORMAT "%5.2" ECU_ADDRESS 0x5B8DE2 /end MEASUREMENT
/begin MEASUREMENT dwfk_w "Wandfilmmengendifferenz Kurzzeitanteil" SWORD rel_sw_q0p1875 1 100 -6144 6143.81 FORMAT "%8.3" ECU_ADDRESS 0x5B91B0 /end MEASUREMENT
/begin MEASUREMENT dwfl_w "Wandfilmmengendifferenz Langzeitanteil" SWORD rel_sw_q0p1875 1 100 -6144 6143.81 FORMAT "%8.3" ECU_ADDRESS 0x5B91B2 /end MEASUREMENT
/begin MEASUREMENT dwf_w "Wandfilmmengendifferenz" SWORD rel_sw_q0p1875 1 100 -6144 6143.81 FORMAT "%8.3" ECU_ADDRESS 0x5B91B4 /end MEASUREMENT
/begin MEASUREMENT dzadrbuf0 "Adresspuffer 0 Entprellung Z¸ndungsdiagnose" UBYTE default 1 100 0 255 FORMAT "%5.1" ECU_ADDRESS 0x5B8D64 /end MEASUREMENT
/begin MEASUREMENT dzdmdzhl "Pufferwert des Aussetzerz‰hlers" SWORD dez 1 100 -32767 32767 FORMAT "%8.2" ARRAY_SIZE 8 ECU_ADDRESS 0x5B97DA /end MEASUREMENT
/begin MEASUREMENT dzhksubzl "Entprellz‰hler harte Ub Kurzschluss" UBYTE dez 1 100 0 255 FORMAT "%5.1" ARRAY_SIZE 8 ECU_ADDRESS 0x5B8D68 /end MEASUREMENT
/begin MEASUREMENT dzkanal "Aktuelle Z¸ndkreisnummer" UBYTE dez 1 100 0 255 FORMAT "%5.1" ECU_ADDRESS 0x5B8D70 /end MEASUREMENT
/begin MEASUREMENT dzksubzl "Entprellz‰hler Kurzschluﬂ nach Ub" UBYTE dez 1 100 0 255 FORMAT "%5.1" ARRAY_SIZE 8 ECU_ADDRESS 0x5B8D74 /end MEASUREMENT
/begin MEASUREMENT dzksubzlrl "Entprellz‰hler niederimpedanter Prim‰rkreis relativ zu Nachbarstromkreisen" UBYTE dez 1 100 0 255 FORMAT "%5.1" ARRAY_SIZE 8 ECU_ADDRESS 0x5B8D7C /end MEASUREMENT
/begin MEASUREMENT dzkub "Pufferwert von Ub" UBYTE spg_ubatt 1 100 0 19.4052 FORMAT "%5.2" ECU_ADDRESS 0x5B8D84 /end MEASUREMENT
/begin MEASUREMENT dzotpzhl "Entprellz‰hler ‹bertemperaturfehler" UBYTE dez 1 100 0 255 FORMAT "%5.1" ARRAY_SIZE 8 ECU_ADDRESS 0x5B8D88 /end MEASUREMENT
/begin MEASUREMENT dztimzhl "Entprellz‰hler timeout Fehler" UBYTE dez 1 100 0 255 FORMAT "%5.1" ARRAY_SIZE 8 ECU_ADDRESS 0x5B8D90 /end MEASUREMENT
/begin MEASUREMENT egaspfad "EGAS-Pfad als Umweltbedingung f¸r Funktions¸berwachungs-Diagnoseeintrag" UBYTE dez 1 100 0 255 FORMAT "%5.1" ECU_ADDRESS 0x5B8DE3 /end MEASUREMENT
/begin MEASUREMENT ei_dufska "Diagnose ‹berwachungsfunktion hat den 1. Fehler irreversible SKA gespeichert" UWORD B_TRUE 1 100 0 1 BIT_MASK 0x1 FORMAT "%13.11" ECU_ADDRESS 0x3FBBFD /end MEASUREMENT
/begin MEASUREMENT ESSTTbits "Bits zur Funktion Start" UBYTE dez 1 100 0 255 FORMAT "%5.1" ECU_ADDRESS 0x3FDC20 /end MEASUREMENT
/begin MEASUREMENT E_abg_zyl "" UBYTE default 1 100 0 1 FORMAT "%5.3" ARRAY_SIZE 12 ECU_ADDRESS 0x5B854C /end MEASUREMENT
/begin MEASUREMENT E_OS_LIMIT_ctr "" ULONG dez 1 100 0 4.29497e+009 FORMAT "%13.2" ECU_ADDRESS 0x5B983C /end MEASUREMENT
/begin MEASUREMENT favralu_w "" UWORD DEZ 1 100 0 65535 FORMAT "%8.2" ECU_ADDRESS 0x5B953C /end MEASUREMENT
/begin MEASUREMENT fbakl_w "Faktor K- und L-Anteil der ‹K bei BA" SWORD fak_sw_b256 1 100 -256 255.992 FORMAT "%8.4" ECU_ADDRESS 0x5B8742 /end MEASUREMENT
/begin MEASUREMENT fbans "Nachstartfaktor der ‹K bei BA" UBYTE fak_ub_b8 1 100 0 7.96875 FORMAT "%5.3" ECU_ADDRESS 0x5B873E /end MEASUREMENT
/begin MEASUREMENT fbans_w "Nachstartfaktor der ‹K bei BA" UWORD fak_uw_b8 1 100 0 7.99988 FORMAT "%8.6" ECU_ADDRESS 0x5B8744 /end MEASUREMENT
/begin MEASUREMENT fbavst_w "Faktor ‹K-Verstellung bei Beschleunigungsanreicherung" SWORD fak_sw_b256 1 100 -256 255.992 FORMAT "%8.4" ECU_ADDRESS 0x5B8746 /end MEASUREMENT
/begin MEASUREMENT ffzdfp "Fehlerpfadidentifikationsnummer (dfp) zum Freeze-Frame Zero" UBYTE dez 1 100 0 255 FORMAT "%5.1" ECU_ADDRESS 0x5B8E29 /end MEASUREMENT
/begin MEASUREMENT fgru "Faktor Grundvorsteuerung" UBYTE fak_ub_b2 1 100 0 1.99219 FORMAT "%5.3" ECU_ADDRESS 0x5B873A /end MEASUREMENT
/begin MEASUREMENT fivzabg "Intervallz‰hler abgasrelevante Aussetzer" UBYTE dez 1 100 0 255 FORMAT "%5.1" ECU_ADDRESS 0x5B8559 /end MEASUREMENT
/begin MEASUREMENT fkstt0 "Rover" UBYTE fak_ub_b64 1 100 0 63.75 FORMAT "%5.2" ECU_ADDRESS 0x5B8EA4 /end MEASUREMENT
/begin MEASUREMENT fktns "Nachstartanhebung" UBYTE fak_ub_b4 1 100 0 3.98438 FORMAT "%5.3" ECU_ADDRESS 0x5B8E94 /end MEASUREMENT
/begin MEASUREMENT fktns0_w "Rover" UWORD fak_uw_b512 1 100 0 511.992 FORMAT "%8.4" ECU_ADDRESS 0x5B919A /end MEASUREMENT
/begin MEASUREMENT fktns1_w "Rover" UWORD fak_uw_b1024 1 100 0 1023.98 FORMAT "%8.3" ECU_ADDRESS 0x5B919C /end MEASUREMENT
/begin MEASUREMENT flgkat_w "Statusflag kat.sch‰digende Aussetzerraten oder ti-Abschaltung" UWORD dez 1 100 0 65535 FORMAT "%8.2" ECU_ADDRESS 0x5B94F4 /end MEASUREMENT
/begin MEASUREMENT flgstign_w "flagword f¸r stimulierte Z¸ndaussetzer" UWORD DEZ 1 100 0 65535 FORMAT "%8.2" ECU_ADDRESS 0x5B9542 /end MEASUREMENT
/begin MEASUREMENT flgstinj_w "flagword f¸r stimulierte Einspritzaussetzer" UWORD DEZ 1 100 0 65535 FORMAT "%8.2" ECU_ADDRESS 0x5B9544 /end MEASUREMENT
/begin MEASUREMENT flgst_w "flagword f¸r stimulierten Aussetzer" UWORD DEZ 1 100 0 65535 FORMAT "%8.2" ECU_ADDRESS 0x5B9546 /end MEASUREMENT
/begin MEASUREMENT flgtiab "Statusflag ti-Abschaltung bei kat.sch‰digenden Aussetzerraten" UBYTE dez 1 100 0 255 FORMAT "%5.1" ECU_ADDRESS 0x5B8BD5 /end MEASUREMENT
/begin MEASUREMENT flgtiabm "" UBYTE dez 1 100 0 255 FORMAT "%5.1" ECU_ADDRESS 0x5B8BD6 /end MEASUREMENT
/begin MEASUREMENT fmsla "Korrekturfaktor Sekund‰rluftmasse adaptiv" UBYTE fak_ub_b2 1 100 0 1.99219 FORMAT "%5.3" ECU_ADDRESS 0x5B8AA0 /end MEASUREMENT
/begin MEASUREMENT fmslav "Adaptionsfaktor Sekund‰rluftmasse" UBYTE fak_ub_b2 1 100 0 1.99219 FORMAT "%5.3" ECU_ADDRESS 0x3FDD08 /end MEASUREMENT
/begin MEASUREMENT fns "Faktor Nachstart" UBYTE fak_ub_b4 1 100 0 3.98438 FORMAT "%5.3" ECU_ADDRESS 0x5B8E95 /end MEASUREMENT
/begin MEASUREMENT fnsa0 "Rover" UBYTE fak_ub_b2 1 100 0 1.99219 FORMAT "%5.3" ECU_ADDRESS 0x5B8E96 /end MEASUREMENT
/begin MEASUREMENT fnsho0 "Rover" UBYTE fak_ub_b2 1 100 0 1.99219 FORMAT "%5.3" ECU_ADDRESS 0x5B8E97 /end MEASUREMENT
/begin MEASUREMENT fnssm0 "Rover" UBYTE fak_ub_b2 1 100 0 1.99219 FORMAT "%5.3" ECU_ADDRESS 0x5B8E98 /end MEASUREMENT
/begin MEASUREMENT fsalunkh "Faktor Korrektur Nullastausblendung bei Katheizen" UBYTE fak_ub_b2 1 100 0 1.99219 FORMAT "%5.3" ECU_ADDRESS 0x5B856C /end MEASUREMENT
/begin MEASUREMENT fst0_w "Vorgesteuerter Startfaktor 16 Bit" UWORD fak_uw_b64 1 100 0 63.999 FORMAT "%8.5" ECU_ADDRESS 0x5B91A4 /end MEASUREMENT
/begin MEASUREMENT fst_w "Faktor Starteinspritzung" UWORD fak_uw_b64 1 100 0 63.999 FORMAT "%8.5" ECU_ADDRESS 0x5B91A6 /end MEASUREMENT
/begin MEASUREMENT fswares "Erkennungsschwellwert Schlechtwegstrecke (aus einer KL)" UBYTE acc_ub_b55p55 1 100 0 55.335 FORMAT "%5.2" ECU_ADDRESS 0x5B8E78 /end MEASUREMENT
/begin MEASUREMENT fukabak_w "‹K-Adaptionsfaktor (kalter Motor) BA" UWORD fak_uw_b4 1 100 0 3.99994 FORMAT "%8.6" ECU_ADDRESS 0x3FDC24 /end MEASUREMENT
/begin MEASUREMENT fukabaw_w "‹K-Adaptionsfaktor (warmer Motor) BA" UWORD fak_uw_b4 1 100 0 3.99994 FORMAT "%8.6" ECU_ADDRESS 0x3FDC26 /end MEASUREMENT
/begin MEASUREMENT fukaba_w "‹K-Adaptions-Faktor BA" UWORD fak_uw_b4 1 100 0 3.99994 FORMAT "%8.6" ECU_ADDRESS 0x5B874C /end MEASUREMENT
/begin MEASUREMENT fukavak_w "‹K-Adaptionsfaktor (kalter Motor) VA" UWORD fak_uw_b4 1 100 0 3.99994 FORMAT "%8.6" ECU_ADDRESS 0x3FDC28 /end MEASUREMENT
/begin MEASUREMENT fukavaw_w "‹K-Adaptionsfaktor (warmer Motor) VA" UWORD fak_uw_b4 1 100 0 3.99994 FORMAT "%8.6" ECU_ADDRESS 0x3FDC2A /end MEASUREMENT
/begin MEASUREMENT fukava_w "‹K-Adaptions-Faktor VA" UWORD fak_uw_b4 1 100 0 3.99994 FORMAT "%8.6" ECU_ADDRESS 0x5B874E /end MEASUREMENT
/begin MEASUREMENT fvakl_w "Faktor K- und L-Anteil der ‹K bei VA" SWORD fak_sw_b256 1 100 -256 255.992 FORMAT "%8.4" ECU_ADDRESS 0x5B8748 /end MEASUREMENT
/begin MEASUREMENT fvans "Nachstartfaktor der ‹K bei VA" UBYTE fak_ub_b8 1 100 0 7.96875 FORMAT "%5.3" ECU_ADDRESS 0x5B873F /end MEASUREMENT
/begin MEASUREMENT fvavst_w "Faktor ‹K-Verstellung bei Verzˆgerungsabmagerung" SWORD fak_sw_b256 1 100 -256 255.992 FORMAT "%8.4" ECU_ADDRESS 0x5B874A /end MEASUREMENT
/begin MEASUREMENT fwnssm_w "Rover" UWORD fak_uw_b512 1 100 0 511.992 FORMAT "%8.4" ECU_ADDRESS 0x5B919E /end MEASUREMENT
/begin MEASUREMENT fwst "Korrekturfaktor Wiederholstart f¸r Start-ti-Berechnung" UBYTE fak_ub_b2 1 100 0 1.99219 FORMAT "%5.3" ECU_ADDRESS 0x5B8EA5 /end MEASUREMENT
/begin MEASUREMENT fwst0_w "Rover" UWORD fak_uw_b1 1 100 0 0.999985 FORMAT "%9.7" ECU_ADDRESS 0x5B91A8 /end MEASUREMENT
/begin MEASUREMENT fwst1 "Rover" UBYTE fak_ub_b1 1 100 0 0.996094 ECU_ADDRESS 0x5B8EA6 /end MEASUREMENT
/begin MEASUREMENT fzabgs_w "Fehlerz‰hler Summe, z‰hlt abgasrelevante Aussetzer ¸ber alle Zylinder" UWORD dez 1 100 0 65535 FORMAT "%8.2" ECU_ADDRESS 0x5B94F6 /end MEASUREMENT
/begin MEASUREMENT fzabgzyl_w "Aussetzerz‰hler" UWORD dez 1 100 0 65535 FORMAT "%8.2" ARRAY_SIZE 12 ECU_ADDRESS 0x5B94F8 /end MEASUREMENT
/begin MEASUREMENT fzans1 "Faktor Abregelung Nachstart ohne Ber¸cksichtigung des Startmengenadaptionswerts" UBYTE fak_ub_b0p25 1 100 0 0.249023 FORMAT "%11.9" ECU_ADDRESS 0x5B8E99 /end MEASUREMENT
/begin MEASUREMENT fzans2 "Faktor Abregelung Nachstart mit Ber¸cksichtigung des Startmengenadaptionswerts" UBYTE fak_ub_b0p25 1 100 0 0.249023 FORMAT "%11.9" ECU_ADDRESS 0x5B8E9A /end MEASUREMENT
/begin MEASUREMENT fzaold_w "Pufferwert des DMD Z‰hlers" UWORD dez 1 100 0 1000 FORMAT "%8.3" ARRAY_SIZE 8 ECU_ADDRESS 0x5B97EA /end MEASUREMENT
/begin MEASUREMENT fzarv_w "Fehlerz‰hler, z‰hlt Aussetzer ¸ber alle Zylinder" UWORD dez 1 100 0 65535 FORMAT "%8.2" ECU_ADDRESS 0x5B9510 /end MEASUREMENT
/begin MEASUREMENT fzkats1_w "Fehlerz‰hler Summe Bank 1, z‰hlt katsch‰digende Aussetzer ¸ber alle Zyl. Bank 1" UWORD dez 1 100 0 65535 FORMAT "%8.2" ECU_ADDRESS 0x5B9512 /end MEASUREMENT
/begin MEASUREMENT fzkats2_w "Fehlerz‰hler Summe Bank 2, z‰hlt katsch‰digende Aussetzer ¸ber alle Zyl. Bank 2" UWORD dez 1 100 0 65535 FORMAT "%8.2" ECU_ADDRESS 0x5B9514 /end MEASUREMENT
/begin MEASUREMENT fzkats_w "Fehlerz‰hler Summe, z‰hlt katsch‰digende Aussetzer ¸ber alle Zylinder" UWORD dez 1 100 0 65535 FORMAT "%8.2" ECU_ADDRESS 0x5B9516 /end MEASUREMENT
/begin MEASUREMENT fzkatzyl_w "" UWORD dez 1 100 0 65535 FORMAT "%8.2" ARRAY_SIZE 12 ECU_ADDRESS 0x5B9518 /end MEASUREMENT
/begin MEASUREMENT fzmdzyl_w "Array  f¸r Anzahl der Aussetzer pro Zylinder" UWORD dez 1 100 0 65535 FORMAT "%8.2" ARRAY_SIZE 12 ECU_ADDRESS 0x3FD812 /end MEASUREMENT
/begin MEASUREMENT hsst_w "Rover" UWORD fak_uw_b64 1 100 0 63.999 FORMAT "%8.5" ECU_ADDRESS 0x5B91AA /end MEASUREMENT
/begin MEASUREMENT hstt0 "" UBYTE fak_ub_b64 1 100 0 63.75 FORMAT "%5.2" ECU_ADDRESS 0x5B8EA7 /end MEASUREMENT
/begin MEASUREMENT ignitioz_w "Anzahl Z¸ndung, ‹bergabe an Zustandsautomat" UWORD DEZ 1 100 0 65535 FORMAT "%8.2" ECU_ADDRESS 0x5B9548 /end MEASUREMENT
/begin MEASUREMENT indte "Integrierte Drehzahl‰nderung" SWORD nmot_sw_q0p25 1 100 -8192 8191.75 FORMAT "%8.3" ECU_ADDRESS 0x5B945E /end MEASUREMENT
/begin MEASUREMENT ivzabg_w "Intervallz‰hler f¸r abgasrelevante Aussetzer (0-1000 KW-Umdr. bzw. 0-500 NW-Um.)" UWORD dez 1 100 0 65535 FORMAT "%8.2" ECU_ADDRESS 0x5B9530 /end MEASUREMENT
/begin MEASUREMENT ivzaint_w "Intervallz‰hler f¸r Freigabe ti-Abschaltung (0-200 Kw-Umdr.)" UWORD dez 1 100 0 65535 FORMAT "%8.2" ECU_ADDRESS 0x5B9532 /end MEASUREMENT
/begin MEASUREMENT ivzarv_w "Intervallz‰hler f¸r Aussetzer (0-60 KW-Umdr.), zur Ausblendung weiterer Funktion" UWORD dez 1 100 0 65535 FORMAT "%8.2" ECU_ADDRESS 0x5B9534 /end MEASUREMENT
/begin MEASUREMENT ivzkat_w "Intervallz‰hler f¸r katsch‰digende Aussetzer (0-200 Kw-Umdr. bzw. 0-100 NW-Um.)" UWORD dez 1 100 0 65535 FORMAT "%8.2" ECU_ADDRESS 0x5B9536 /end MEASUREMENT
/begin MEASUREMENT kamfz_w "" UWORD kw_q6 1 100 0 393210 FORMAT "%8.1" ECU_ADDRESS 0x5B9686 /end MEASUREMENT
/begin MEASUREMENT kswf "Kat.-Schutz-Wichtungsfaktoren, aus KFKSWF" UBYTE dez 1 100 0 255 FORMAT "%5.1" ECU_ADDRESS 0x5B855A /end MEASUREMENT
/begin MEASUREMENT lamns_w "Lambda-Motor-Soll f¸r Nachstart" UWORD fak_uw_b16 1 100 0 15.9998 FORMAT "%8.5" ECU_ADDRESS 0x5B91A0 /end MEASUREMENT
/begin MEASUREMENT lans_w "Rover" UWORD fak_uw_b16 1 100 0 15.9998 FORMAT "%8.5" ECU_ADDRESS 0x5B91A2 /end MEASUREMENT
/begin MEASUREMENT lastmodz_w "Status letzter Modus im Durchlauf des Aussetzerprogrammes" UWORD DEZ 1 100 0 65535 FORMAT "%8.2" ECU_ADDRESS 0x5B954A /end MEASUREMENT
/begin MEASUREMENT m6amsl "Mode 6 - Speicher: Anzahl Werteblˆcke bei Pr¸fung Sekund‰rluftmasse" UBYTE dez 1 100 0 255 FORMAT "%5.1" ECU_ADDRESS 0x3FDD09 /end MEASUREMENT
/begin MEASUREMENT m6cmsl "Mode 6 - Speicher: Component ID f¸r Pr¸fung Sekund‰rluftsystem" UBYTE dez 1 100 0 255 FORMAT "%5.1" ECU_ADDRESS 0x3FDD0A /end MEASUREMENT
/begin MEASUREMENT m6cmslv "Mode 6 - Speicher: Component ID f¸r Pr¸fung Dichtheit Sekund‰rluftsystem" UBYTE dez 1 100 0 255 FORMAT "%5.1" ECU_ADDRESS 0x3FDD0B /end MEASUREMENT
/begin MEASUREMENT m6smslv_w "Mode 6 - Speicher: Schwellwert bei Ventildichtheitspr¸fung" UWORD dez 1 100 0 65535 FORMAT "%8.2" ECU_ADDRESS 0x3FDD0E /end MEASUREMENT
/begin MEASUREMENT m6smsl_w "Mode 6 - Speicher: Schwellwert bei Pr¸fung Sekund‰rluftmasse" UWORD dez 1 100 0 65535 FORMAT "%8.2" ECU_ADDRESS 0x3FDD10 /end MEASUREMENT
/begin MEASUREMENT m6wmslv_w "Mode 6 - Speicher: Messwert Ventildichtheit" UWORD dez 1 100 0 65535 FORMAT "%8.2" ECU_ADDRESS 0x3FDD12 /end MEASUREMENT
/begin MEASUREMENT m6wmsl_w "Mode 6 - Speicher: Messwert Sekund‰rluftmasse bei SL-Einblasung" UWORD dez 1 100 0 65535 FORMAT "%8.2" ECU_ADDRESS 0x3FDD14 /end MEASUREMENT
/begin MEASUREMENT midter "" UWORD rel_uw_b100 1 100 0 99.9985 FORMAT "%8.5" ECU_ADDRESS 0x5B9460 /end MEASUREMENT
/begin MEASUREMENT milstat "" UBYTE dez 1 100 0 255 FORMAT "%5.1" ECU_ADDRESS 0x5B8E28 /end MEASUREMENT
/begin MEASUREMENT misfirez_w "Anzahl Aussetzer, ‹bergabe an Zustandsautomat" UWORD DEZ 1 100 0 65535 FORMAT "%8.2" ECU_ADDRESS 0x5B954C /end MEASUREMENT
/begin MEASUREMENT mi_duf "Istmoment beim Ansprechen des Momentenvergleichs in der Funktions¸berwachung" UBYTE rel_ub_b99p6 1 100 0 99.6094 FORMAT "%5.2" ECU_ADDRESS 0x5B8DE4 /end MEASUREMENT
/begin MEASUREMENT modez_w "aktuell abgearbeiteter Aussetzermode" UWORD DEZ 1 100 0 65535 FORMAT "%8.2" ECU_ADDRESS 0x5B954E /end MEASUREMENT
/begin MEASUREMENT mpfad "Momenten-Pfad in Funktion und Funktions¸berwachung als Umweltbedingung f¸r Diag." UBYTE dez 1 100 0 255 FORMAT "%5.1" ECU_ADDRESS 0x5B8DE5 /end MEASUREMENT
/begin MEASUREMENT mslift "Istwert Sekund‰rluftmasse, gefiltert, tempor‰r" UBYTE m_q0p4 1 100 0 102 FORMAT "%5.1" ECU_ADDRESS 0x5B8AA1 /end MEASUREMENT
/begin MEASUREMENT mslift_w "" UWORD m_q0p025 1 100 0 1638.38 FORMAT "%8.3" ECU_ADDRESS 0x5B8AAC /end MEASUREMENT
/begin MEASUREMENT mslnenn "Nennwert Sekund‰rluftmasse" UBYTE m_q0p4 1 100 0 102 FORMAT "%5.1" ECU_ADDRESS 0x3FDD0C /end MEASUREMENT
/begin MEASUREMENT mslnf "Nenn-Sekund‰rluftmasse, gefiltert" UBYTE m_q0p4 1 100 0 102 FORMAT "%5.1" ECU_ADDRESS 0x5B8AA2 /end MEASUREMENT
/begin MEASUREMENT mslnt "Nenn-Sekund‰rluftmasse, tempor‰r" UBYTE m_q0p4 1 100 0 102 FORMAT "%5.1" ECU_ADDRESS 0x5B8AA3 /end MEASUREMENT
/begin MEASUREMENT msltb_w "" UWORD m_uw_b6553p5 1 100 0 6553.5 FORMAT "%8.3" ECU_ADDRESS 0x5B8AAE /end MEASUREMENT
/begin MEASUREMENT msltini "" UBYTE m_q0p4 1 100 0 102 FORMAT "%5.1" ECU_ADDRESS 0x5B8AA4 /end MEASUREMENT
/begin MEASUREMENT mslt_w "tempor‰re Sekund‰rluftmasse" UWORD m_uw_b6553p5 1 100 0 6553.5 FORMAT "%8.3" ECU_ADDRESS 0x5B8AB0 /end MEASUREMENT
/begin MEASUREMENT mslvft_w "" SWORD m_q0p0015625 1 100 -51.2 51.1984 FORMAT "%8.5" ECU_ADDRESS 0x5B8AB2 /end MEASUREMENT
/begin MEASUREMENT mslvt_w "tempor‰re Ventilleckage" SWORD m_sw_q0p1 1 100 -3276.8 3276.7 FORMAT "%8.3" ECU_ADDRESS 0x5B8AB4 /end MEASUREMENT
/begin MEASUREMENT mslv_w "" UWORD m_q0p0015625 1 100 0 102.398 FORMAT "%8.4" ECU_ADDRESS 0x5B8AB6 /end MEASUREMENT
/begin MEASUREMENT mvdtehp "Hochpaﬂgefiltertes Verlustmoment" UWORD rel_uw_b100 1 100 0 99.9985 FORMAT "%8.5" ECU_ADDRESS 0x5B9462 /end MEASUREMENT
/begin MEASUREMENT nsactr "Nachstartcounter" UBYTE fak_ub_b2 1 100 0 1.99219 FORMAT "%5.3" ECU_ADDRESS 0x5B8E9B /end MEASUREMENT
/begin MEASUREMENT nsactr1 "Nachstartcounter ohne Ber¸cksichtigung des Startmengenadaptionswerts" UBYTE fak_ub_b2 1 100 0 1.99219 FORMAT "%5.3" ECU_ADDRESS 0x5B8E9C /end MEASUREMENT
/begin MEASUREMENT nsactr2 "Nachstartcounter mit Ber¸cksichtigung des Startmengenadaptionswerts" UBYTE fak_ub_b2 1 100 0 1.99219 FORMAT "%5.3" ECU_ADDRESS 0x5B8E9D /end MEASUREMENT
/begin MEASUREMENT nsdter "Solldrehzahl Referenz" UBYTE nmot_ub_q10 1 100 0 2550 FORMAT "%5.0" ECU_ADDRESS 0x5B8FE3 /end MEASUREMENT
/begin MEASUREMENT nswrl "Ausgang KF KFNSWRL Wichtung Nachstartanhebung" UBYTE fak_ub_b2 1 100 0 1.99219 FORMAT "%5.3" ECU_ADDRESS 0x5B8E9E /end MEASUREMENT
/begin MEASUREMENT ntpdte "Tiefpaﬂgefilterte Drehzahl" UWORD nmot_uw_q0p25 1 100 0 16383.8 FORMAT "%8.2" ECU_ADDRESS 0x5B9464 /end MEASUREMENT
/begin MEASUREMENT ntpdter "Tiefpaﬂgefilterte Drehzahl, Referenzwert" UWORD nmot_uw_q0p25 1 100 0 16383.8 FORMAT "%8.2" ECU_ADDRESS 0x5B9466 /end MEASUREMENT
/begin MEASUREMENT nwnumbz_w "Anzahl Nockenwellenumdrehungen, ‹bergabe an Zustandsautomat" UWORD DEZ 1 100 0 65535 FORMAT "%8.2" ECU_ADDRESS 0x5B9550 /end MEASUREMENT
/begin MEASUREMENT Nw_pos "Nockenwellenposition variable NWS" UWORD sprzi_q0p1 1 100 0 6553.5 FORMAT "%4.0" ARRAY_SIZE 4 ECU_ADDRESS 0x5B8A48 /end MEASUREMENT
/begin MEASUREMENT pausez_w "Anzahl Pausensegmente, ‹bergabe an Zustandsautomat" UWORD DEZ 1 100 0 65535 FORMAT "%8.2" ECU_ADDRESS 0x5B9552 /end MEASUREMENT
/begin MEASUREMENT pgmaster "Nummer des Phasengebers welcher Master ist" UBYTE dez 1 100 0 255 FORMAT "%5.1" ECU_ADDRESS 0x3FDB9A /end MEASUREMENT
/begin MEASUREMENT ph1edpos_w "Array mit Phasenflankenwinkeln des PG1 vom Hardwaretreiber" UWORD kw_q0p1 1 100 0 6553.5 FORMAT "%8.3" ARRAY_SIZE 9 ECU_ADDRESS 0x5B958E /end MEASUREMENT
/begin MEASUREMENT ph2bmerr "Summierer f¸r falschen Phasenpegel an BM bei PG2" UBYTE fak_q0p5 1 100 0 127.5 FORMAT "%5.1" ECU_ADDRESS 0x3FDB9B /end MEASUREMENT
/begin MEASUREMENT ph2edpos_w "Array mit Phasenflankenwinkeln des PG2 vom Hardwaretreiber" UWORD kw_q0p1 1 100 0 6553.5 FORMAT "%8.3" ARRAY_SIZE 9 ECU_ADDRESS 0x5B95A0 /end MEASUREMENT
/begin MEASUREMENT ph3bmerr "Summierer f¸r falschen Phasenpegel an BM bei PG3" UBYTE fak_q0p5 1 100 0 127.5 FORMAT "%5.1" ECU_ADDRESS 0x3FDB9C /end MEASUREMENT
/begin MEASUREMENT ph3edpos_w "Array mit Phasenflankenwinkeln des PG3 vom Hardwaretreiber" UWORD kw_q0p1 1 100 0 6553.5 FORMAT "%8.3" ARRAY_SIZE 9 ECU_ADDRESS 0x5B95B2 /end MEASUREMENT
/begin MEASUREMENT ph4bmerr "Summierer f¸r falschen Phasenpegel an BM bei PG4" UBYTE fak_q0p5 1 100 0 127.5 FORMAT "%5.1" ECU_ADDRESS 0x3FDB9D /end MEASUREMENT
/begin MEASUREMENT ph4edpos_w "Array mit Phasenflankenwinkeln des PG4 vom Hardwaretreiber" UWORD kw_q0p1 1 100 0 6553.5 FORMAT "%8.3" ARRAY_SIZE 9 ECU_ADDRESS 0x5B95C4 /end MEASUREMENT
/begin MEASUREMENT phbmerr "Summierer f¸r falschen Phasenpegel an BM bei PG1" UBYTE fak_q0p5 1 100 0 127.5 FORMAT "%5.1" ECU_ADDRESS 0x3FDB9E /end MEASUREMENT
/begin MEASUREMENT psukao_w "obere Grenze Saugrohrdruck ‹K-Adaption" UWORD p_uw_q0p039 1 100 0 2559.96 FORMAT "%8.3" ECU_ADDRESS 0x5B8750 /end MEASUREMENT
/begin MEASUREMENT randreg_w "Startwert Zufallsgenerator" UWORD DEZ 1 100 0 65535 FORMAT "%8.2" ECU_ADDRESS 0x5B9554 /end MEASUREMENT
/begin MEASUREMENT rkuke_w "rel. Kraftstoffmasse ‹bergangskompensation Ersatzwert" SWORD rel_sw_q0p1875 1 100 -6144 6143.81 FORMAT "%8.3" ECU_ADDRESS 0x5B91B6 /end MEASUREMENT
/begin MEASUREMENT rkukg_w "rel. Kraftstoffmasse ‹bergangskompensation" SWORD rel_sw_b1536 1 100 -1536 1535.95 FORMAT "%8.3" ECU_ADDRESS 0x5B91B8 /end MEASUREMENT
/begin MEASUREMENT rkukkl_w "Kurz- und Langzeitanteil der UK" SWORD rel_sw_q0p1875 1 100 -6144 6143.81 FORMAT "%8.3" ECU_ADDRESS 0x5B91BA /end MEASUREMENT
/begin MEASUREMENT rkukk_w "rk-Kurzzeitanteil der UK" SWORD rel_sw_q0p1875 1 100 -6144 6143.81 FORMAT "%8.3" ECU_ADDRESS 0x5B91BC /end MEASUREMENT
/begin MEASUREMENT rkukl_w "rk-Langzeitanteil der UK" SWORD rel_sw_q0p1875 1 100 -6144 6143.81 FORMAT "%8.3" ECU_ADDRESS 0x5B91BE /end MEASUREMENT
/begin MEASUREMENT rkuk_w "rel. Kraftstoffmasse ‹bergangskompensation ohne Verstelleingriffe" SWORD rel_sw_q0p1875 1 100 -6144 6143.81 FORMAT "%8.3" ECU_ADDRESS 0x5B91C0 /end MEASUREMENT
/begin MEASUREMENT rlsp "Lastsignal im Sondensprung" UBYTE rel_ub_q0p75 1 100 0 191.25 FORMAT "%5.1" ECU_ADDRESS 0x5B8EB3 /end MEASUREMENT
/begin MEASUREMENT rmsl "relative Sekund‰rluftmasse" UBYTE fak_ub_b2 1 100 0 1.99219 FORMAT "%5.3" ECU_ADDRESS 0x5B8AA5 /end MEASUREMENT
/begin MEASUREMENT rmslt "relative Sekund‰rluftmasse ohne Offset- Korrektur" UBYTE fak_ub_b2 1 100 0 1.99219 FORMAT "%5.3" ECU_ADDRESS 0x5B8AA6 /end MEASUREMENT
/begin MEASUREMENT rstMon_um "" UWORD dez 1 100 0 65535 FORMAT "%8.2" ECU_ADDRESS 0x3F98CE /end MEASUREMENT
/begin MEASUREMENT rstpfad "Reset-Pfad als Umweltbedingung f¸r Rechner¸berwachungs-Diagnoseeintrag" UBYTE dez 1 100 0 255 FORMAT "%5.1" ECU_ADDRESS 0x5B8DE1 /end MEASUREMENT
/begin MEASUREMENT sdwfk_w "Speicherinhalt der Wandfilmdifferenz f¸r Kurzzeitanteil" SWORD rel_sw_q0p1875 1 100 -6144 6143.81 FORMAT "%8.3" ECU_ADDRESS 0x5B91C2 /end MEASUREMENT
/begin MEASUREMENT sdwfl_w "Speicherinhalt der Wandfilmdifferenz f¸r Langzeitanteil" SWORD rel_sw_q0p1875 1 100 -6144 6143.81 FORMAT "%8.3" ECU_ADDRESS 0x5B91C4 /end MEASUREMENT
/begin MEASUREMENT seg1BegD_w "" UWORD kw_q6 1 100 0 393210 FORMAT "%8.1" ECU_ADDRESS 0x5B9688 /end MEASUREMENT
/begin MEASUREMENT seg2BegD_w "" UWORD kw_q6 1 100 0 393210 FORMAT "%8.1" ECU_ADDRESS 0x5B968A /end MEASUREMENT
/begin MEASUREMENT SfpMin_EVzyl "" UBYTE default 1 100 0 1 FORMAT "%5.3" ARRAY_SIZE 8 ECU_ADDRESS 0x5B8BD8 /end MEASUREMENT
/begin MEASUREMENT skapfad "SKA-Pfad als Umweltbedingung f¸r Funktions¸berwachungs-Diagnoseeintrag" UBYTE dez 1 100 0 255 FORMAT "%5.1" ECU_ADDRESS 0x5B8DE6 /end MEASUREMENT
/begin MEASUREMENT sph2flok "Summierer f¸r Phasenflanken an richtiger Position bei PG2" UBYTE fak_q0p5 1 100 0 127.5 FORMAT "%5.1" ECU_ADDRESS 0x5B8C21 /end MEASUREMENT
/begin MEASUREMENT sph3flok "Summierer f¸r Phasenflanken an richtiger Position bei PG3" UBYTE fak_q0p5 1 100 0 127.5 FORMAT "%5.1" ECU_ADDRESS 0x5B8C22 /end MEASUREMENT
/begin MEASUREMENT sph4flok "Summierer f¸r Phasenflanken an richtiger Position bei PG4" UBYTE fak_q0p5 1 100 0 127.5 FORMAT "%5.1" ECU_ADDRESS 0x5B8C23 /end MEASUREMENT
/begin MEASUREMENT sphflok "Summierer f¸r Phasenflanken an richtiger Position bei PG1" UBYTE fak_q0p5 1 100 0 127.5 FORMAT "%5.1" ECU_ADDRESS 0x5B8C24 /end MEASUREMENT
/begin MEASUREMENT szanssm0 "Rover" UBYTE fak_ub_b1 1 100 0 0.996094 ECU_ADDRESS 0x5B8E9F /end MEASUREMENT
/begin MEASUREMENT tadtea "TEV-Tastverh‰ltnis aus Tankentl¸ftungsdiagnose" UBYTE rel_ub_b100 1 100 0 100 FORMAT "%5.1" ECU_ADDRESS 0x5B8A21 /end MEASUREMENT
/begin MEASUREMENT tamn "Min. Wert von Ta" UWORD txms_uw_q0p001 1 100 0 65.535 FORMAT "%8.5" ECU_ADDRESS 0x5B97FA /end MEASUREMENT
/begin MEASUREMENT tamx "Max. Wert von Ta" UWORD txms_uw_q0p001 1 100 0 65.535 FORMAT "%8.5" ECU_ADDRESS 0x5B97FC /end MEASUREMENT
/begin MEASUREMENT tandt0 "Rover" UBYTE temp_ub_b191p25 1 100 0 191.25 FORMAT "%5.1" ECU_ADDRESS 0x5B8EA8 /end MEASUREMENT
/begin MEASUREMENT taold_w "Alter Wert von ta" UWORD txms_uw_q0p001 1 100 0 65.535 FORMAT "%8.5" ECU_ADDRESS 0x5B97FE /end MEASUREMENT
/begin MEASUREMENT tarlmn "Min. Schwelle des ta Verh‰ltnisses" UWORD rel_uw_q0p125 1 100 0 1 FORMAT "%8.6" ECU_ADDRESS 0x5B9800 /end MEASUREMENT
/begin MEASUREMENT tarlmx "Max. Schwelle des ta Verh‰ltnisses" UBYTE rel_uw_q0p125 1 100 0 1 FORMAT "%5.3" ECU_ADDRESS 0x5B8D98 /end MEASUREMENT
/begin MEASUREMENT tbtevio_c "" UBYTE t100msxs_ub_b25p5 1 100 0 25.5 FORMAT "%5.2" ECU_ADDRESS 0x5B8A22 /end MEASUREMENT
/begin MEASUREMENT tc6tesc "Ausgabe-Code SCAN-Tool Mode 6 aus TES-Diagnose" UBYTE dez 1 100 0 255 FORMAT "%5.1" ECU_ADDRESS 0x3FDCC0 /end MEASUREMENT
/begin MEASUREMENT tc6tess "Ausgabe Schwellwert SCAN-Tool Mode 6 aus TES-Diagnose" UWORD dez 1 100 0 65535 FORMAT "%8.2" ECU_ADDRESS 0x3FDCC2 /end MEASUREMENT
/begin MEASUREMENT tc6tesw "Ausgabe Pr¸fwert SCAN-Tool Mode 6 aus TES-Diagnose" UWORD dez 1 100 0 65535 FORMAT "%8.2" ECU_ADDRESS 0x3FDCC4 /end MEASUREMENT
/begin MEASUREMENT tdsuectr "" UBYTE t100msxs_ub_b25p5 1 100 0 25.5 FORMAT "%5.2" ECU_ADDRESS 0x5B86A1 /end MEASUREMENT
/begin MEASUREMENT tdsuehctr "" UBYTE t100msxs_ub_b25p5 1 100 0 25.5 FORMAT "%5.2" ECU_ADDRESS 0x5B86A2 /end MEASUREMENT
/begin MEASUREMENT tdsuemnctr "" UBYTE t100msxs_ub_b25p5 1 100 0 25.5 FORMAT "%5.2" ECU_ADDRESS 0x5B86A3 /end MEASUREMENT
/begin MEASUREMENT tdsuemxctr "" UBYTE t100msxs_ub_b25p5 1 100 0 25.5 FORMAT "%5.2" ECU_ADDRESS 0x5B86A4 /end MEASUREMENT
/begin MEASUREMENT tdten_w "Berechnungszeit f¸r Drehzahlcheck" UWORD t20msxs_uw_b1310 1 100 0 1310.7 FORMAT "%7.2" ECU_ADDRESS 0x5B8A28 /end MEASUREMENT
/begin MEASUREMENT tesstat "Funktionsstatus DTES bei Anforderung Systemcheck" UBYTE dez 1 100 0 255 FORMAT "%5.1" ECU_ADDRESS 0x5B8A23 /end MEASUREMENT
/begin MEASUREMENT tmlauf_w "Motorlaufzeit vor dem Abstellen" UWORD t100msxs_uw_b6553p6 1 100 0 6553.5 FORMAT "%8.3" ECU_ADDRESS 0x3FDC22 /end MEASUREMENT
/begin MEASUREMENT tmstem "Motortemperatur bei Startende in Memory" UBYTE temp_ub_q0p75_o48 1 100 -48 143.25 FORMAT "%5.1" ECU_ADDRESS 0x5B8506 /end MEASUREMENT
/begin MEASUREMENT top_w "Operating time seit powerfail" UWORD t6minxmin_q6 1 100 0 393210 FORMAT "%8.1" ECU_ADDRESS 0x5B8504 /end MEASUREMENT
/begin MEASUREMENT tsbsyctr "Synchroz‰hler f¸r DMDTSB (Wertebereich TSBINVALID + 1)" UBYTE dez 1 100 0 255 FORMAT "%5.1" ECU_ADDRESS 0x5B8C52 /end MEASUREMENT
/begin MEASUREMENT tsegDmd_l "" ULONG dez 1 100 0 4.29497e+009 FORMAT "%13.2" ECU_ADDRESS 0x5B9A30 /end MEASUREMENT
/begin MEASUREMENT tSlave1_l "" ULONG dez 1 100 0 4.29497e+009 FORMAT "%13.2" ECU_ADDRESS 0x5B9A34 /end MEASUREMENT
/begin MEASUREMENT tSlave2_l "" ULONG dez 1 100 0 4.29497e+009 FORMAT "%13.2" ECU_ADDRESS 0x5B9A38 /end MEASUREMENT
/begin MEASUREMENT tsroh_f "Segmentzeit unkorrigiert" FLOAT32_IEEE fak_r32_1 1 100 -1e+010 1e+010 FORMAT "%43.31" ECU_ADDRESS 0x3FAE04 /end MEASUREMENT
/begin MEASUREMENT tstlauf_w "Zeit seit B_st auf 1" UWORD t100msxs_uw_b6553p6 1 100 0 6553.5 FORMAT "%8.3" ECU_ADDRESS 0x5B91AC /end MEASUREMENT
/begin MEASUREMENT twkodte_c "" UBYTE t100msxs_ub_b25p5 1 100 0 25.5 FORMAT "%5.2" ECU_ADDRESS 0x5B8A24 /end MEASUREMENT
/begin MEASUREMENT Vnsfaktmot "" UBYTE fak_ub_b2 1 100 0 1.99219 FORMAT "%5.3" ECU_ADDRESS 0x5B8A45 /end MEASUREMENT
/begin MEASUREMENT Vnsfaktvub "ausgegebenes variable NWS Tastverh‰ltnis ub-abh‰ngig" UBYTE fak_ub_b2 1 100 0 1.99219 FORMAT "%5.3" ECU_ADDRESS 0x5B8A46 /end MEASUREMENT
/begin MEASUREMENT Vsadwnwkl "Delta Kennlinie Auslasspreizung variable NWS" UWORD sprzi_q0p1s32768 1 100 -3276.8 3276.7 FORMAT "%7.2" ECU_ADDRESS 0x5B8A50 /end MEASUREMENT
/begin MEASUREMENT Vsadwnwv "" UWORD sprzi_q0p1s32768 1 100 -3276.8 3276.7 FORMAT "%7.2" ECU_ADDRESS 0x5B8A52 /end MEASUREMENT
/begin MEASUREMENT Vsaspris "gesch‰tzter Istwert Auslasspreizung variable NWS" UWORD sprzi_q0p1 1 100 0 6553.5 FORMAT "%4.0" ECU_ADDRESS 0x5B8A54 /end MEASUREMENT
/begin MEASUREMENT Vsa_adp "Adaptionswert Anschlag Auslasspreizung variable NWS" UWORD sprzi_q0p1 1 100 0 6553.5 FORMAT "%4.0" ECU_ADDRESS 0x3FDCFE /end MEASUREMENT
/begin MEASUREMENT Vsa_adp_fl "Flankenindividuelle Adaption Auslasspreizung variable NWS" SBYTE sprzi_q0p05 1 100 -6.4 6.35 FORMAT "%3.1" ARRAY_SIZE 4 ECU_ADDRESS 0x3FDCF0 /end MEASUREMENT
/begin MEASUREMENT Vsa_anz "" UBYTE dez 1 100 0 255 FORMAT "%5.1" ECU_ADDRESS 0x3FDCDC /end MEASUREMENT
/begin MEASUREMENT Vsa_km "" UWORD km_uw_q10 1 100 0 655350 FORMAT "%8.1" ARRAY_SIZE 5 ECU_ADDRESS 0x3FDCC8 /end MEASUREMENT
/begin MEASUREMENT Vsa_spri "Istwert Auslasspreizung variable NWS" UWORD sprzi_q0p1 1 100 0 6553.5 FORMAT "%4.0" ECU_ADDRESS 0x5B8A56 /end MEASUREMENT
/begin MEASUREMENT Vsa_sprs "Sollwert Auslasspreizung variable NWS" UWORD sprzi_q0p1 1 100 0 6553.5 FORMAT "%4.0" ECU_ADDRESS 0x5B8A58 /end MEASUREMENT
/begin MEASUREMENT Vsa_stat "Status Auslasspreizung variable NWS" UBYTE dez 1 100 0 255 FORMAT "%5.1" ECU_ADDRESS 0x3FDCF4 /end MEASUREMENT
/begin MEASUREMENT Vsa_tmot "" UBYTE temp_ub_q0p75_o48 1 100 -48 143.25 FORMAT "%5.1" ARRAY_SIZE 5 ECU_ADDRESS 0x3FDCE0 /end MEASUREMENT
/begin MEASUREMENT Vsa_tv "Tastverh‰ltnis Auslasspreizung variable NWS" UWORD vnstv_q0p01 1 100 0 655.35 FORMAT "%7.3" ECU_ADDRESS 0x5B8A5A /end MEASUREMENT
/begin MEASUREMENT Vsa_tv_i "Reglerausgang I-Regler Auslasspreizung variable NWS" UWORD vnstv_q0p00305s32768 1 100 -100 99.9969 ECU_ADDRESS 0x5B8A5C /end MEASUREMENT
/begin MEASUREMENT Vsa_tv_p "Reglerausgang P-Regler Auslasspreizung variable NWS" UWORD vnstv_q0p00305s32768 1 100 -100 99.9969 ECU_ADDRESS 0x5B8A5E /end MEASUREMENT
/begin MEASUREMENT Vsa_vg "Verstellgeschwindigkeit Auslasspreizung variable NWS" SWORD sprzivg_q0p781 1 100 -25600 25599.2 FORMAT "%8.2" ECU_ADDRESS 0x5B8A60 /end MEASUREMENT
/begin MEASUREMENT Vsa_zeig "" UBYTE dez 1 100 0 255 FORMAT "%5.1" ECU_ADDRESS 0x3FDCE5 /end MEASUREMENT
/begin MEASUREMENT Vse2adp "Adaptionswert Anschlag Einlasspreizung variable NWS Bank 2" UWORD sprzi_q0p1 1 100 0 6553.5 FORMAT "%4.0" ECU_ADDRESS 0x3FDD00 /end MEASUREMENT
/begin MEASUREMENT Vsedwnwkl "Delta Kennlinie Einlasspreizung variable NWS" UWORD sprzi_q0p1s32768 1 100 -3276.8 3276.7 FORMAT "%7.2" ECU_ADDRESS 0x5B8A62 /end MEASUREMENT
/begin MEASUREMENT Vsedwnwv "" UWORD sprzi_q0p1s32768 1 100 -3276.8 3276.7 FORMAT "%7.2" ECU_ADDRESS 0x5B8A64 /end MEASUREMENT
/begin MEASUREMENT Vsespris "gesch‰tzter Istwert Einlasspreizung variable NWS" UWORD sprzi_q0p1 1 100 0 6553.5 FORMAT "%4.0" ECU_ADDRESS 0x5B8A66 /end MEASUREMENT
/begin MEASUREMENT Vse_adp "Adaptionswert Anschlag Einlasspreizung variable NWS" UWORD sprzi_q0p1 1 100 0 6553.5 FORMAT "%4.0" ECU_ADDRESS 0x3FDD02 /end MEASUREMENT
/begin MEASUREMENT Vse_adp_fl "Flankenindividuelle Adaption Einlasspreizung variable NWS" SBYTE sprzi_q0p05 1 100 -6.4 6.35 FORMAT "%3.1" ARRAY_SIZE 4 ECU_ADDRESS 0x3FDCF8 /end MEASUREMENT
/begin MEASUREMENT Vse_anz "Array fuer Anzahl der unverriegelten Abstellungen" UBYTE dez 1 100 0 255 FORMAT "%5.1" ECU_ADDRESS 0x3FDCE6 /end MEASUREMENT
/begin MEASUREMENT Vse_km "Array fuer Umgebungsbedingung km-Stand" UWORD km_uw_q10 1 100 0 655350 FORMAT "%8.1" ARRAY_SIZE 5 ECU_ADDRESS 0x3FDCD2 /end MEASUREMENT
/begin MEASUREMENT Vse_spri "Istwert Einlasspreizung variable NWS" UWORD sprzi_q0p1 1 100 0 6553.5 FORMAT "%4.0" ECU_ADDRESS 0x5B8A68 /end MEASUREMENT
/begin MEASUREMENT Vse_sprs "Sollwert Einlasspreizung variable NWS" UWORD sprzi_q0p1 1 100 0 6553.5 FORMAT "%4.0" ECU_ADDRESS 0x5B8A6A /end MEASUREMENT
/begin MEASUREMENT Vse_stat "Status Einlasspreizung variable NWS" UBYTE dez 1 100 0 255 FORMAT "%5.1" ECU_ADDRESS 0x3FDCFC /end MEASUREMENT
/begin MEASUREMENT Vse_tmot "Array fuer Umgebungsbedingung tmot" UBYTE temp_ub_q0p75_o48 1 100 -48 143.25 FORMAT "%5.1" ARRAY_SIZE 5 ECU_ADDRESS 0x3FDCE8 /end MEASUREMENT
/begin MEASUREMENT Vse_tv "Tastverh‰ltnis Einlasspreizung variable NWS" UWORD vnstv_q0p01 1 100 0 655.35 FORMAT "%7.3" ECU_ADDRESS 0x5B8A6C /end MEASUREMENT
/begin MEASUREMENT Vse_tv_i "Reglerausgang I-Regler Einlasspreizung variable NWS" UWORD vnstv_q0p00305s32768 1 100 -100 99.9969 ECU_ADDRESS 0x5B8A6E /end MEASUREMENT
/begin MEASUREMENT Vse_tv_p "Reglerausgang P-Regler Einlasspreizung variable NWS" UWORD vnstv_q0p00305s32768 1 100 -100 99.9969 ECU_ADDRESS 0x5B8A70 /end MEASUREMENT
/begin MEASUREMENT Vse_vg "Verstellgeschwindigkeit Einlasspreizung variable NWS" SWORD sprzivg_q0p781 1 100 -25600 25599.2 FORMAT "%8.2" ECU_ADDRESS 0x5B8A72 /end MEASUREMENT
/begin MEASUREMENT Vse_zeig "Zeiger auf zuletzt abgelegte Umgebungsbedingungen" UBYTE dez 1 100 0 255 FORMAT "%5.1" ECU_ADDRESS 0x3FDCED /end MEASUREMENT
/begin MEASUREMENT wf_w "Wandfilmmenge" SWORD rel_sw_q0p1875 1 100 -6144 6143.81 FORMAT "%8.3" ECU_ADDRESS 0x5B91C6 /end MEASUREMENT
/begin MEASUREMENT whstt "Rover" UBYTE fak_ub_b2 1 100 0 1.99219 FORMAT "%5.3" ECU_ADDRESS 0x5B8EA9 /end MEASUREMENT
/begin MEASUREMENT wkfmodi_w "Statusword Aussetzermodi aus KFMODI" UWORD DEZ 1 100 0 65535 FORMAT "%8.2" ECU_ADDRESS 0x5B862C /end MEASUREMENT
/begin MEASUREMENT wkstn "Rover" UBYTE fak_ub_b1 1 100 0 0.996094 ECU_ADDRESS 0x5B8EAA /end MEASUREMENT
/begin MEASUREMENT wkstt "Rover" UBYTE fak_ub_b2 1 100 0 1.99219 FORMAT "%5.3" ECU_ADDRESS 0x5B8EAB /end MEASUREMENT
/begin MEASUREMENT wnwi_w "Istwinkel f¸r Nockenwelle (word)" SWORD wkw_sw_b128 1 100 -128 127.996 FORMAT "%7.3" ECU_ADDRESS 0x5B9492 /end MEASUREMENT
/begin MEASUREMENT wuccnt "Warm-up cycle - counter" UBYTE dez 1 100 0 255 FORMAT "%5.1" ECU_ADDRESS 0x3FD809 /end MEASUREMENT
/begin MEASUREMENT wwns "Rover" UBYTE fak_ub_b2 1 100 0 1.99219 FORMAT "%5.3" ECU_ADDRESS 0x5B8EA0 /end MEASUREMENT
/begin MEASUREMENT xkfmodi "Parameterkoordinate f¸r die Aussetzermodi in KFMODI" UBYTE DEZ 1 100 0 255 FORMAT "%5.1" ECU_ADDRESS 0x5B862F /end MEASUREMENT
/begin MEASUREMENT ykfmodi "Modekoordinate der Aussetzermodi in KFMODI" UBYTE DEZ 1 100 0 255 FORMAT "%5.1" ECU_ADDRESS 0x5B8630 /end MEASUREMENT
/begin MEASUREMENT zanssa "Rover" UBYTE fak_ub_b0p25 1 100 0 0.249023 FORMAT "%11.9" ECU_ADDRESS 0x5B8EA1 /end MEASUREMENT
/begin MEASUREMENT zanssm "Rover" UBYTE fak_ub_b0p25 1 100 0 0.249023 FORMAT "%11.9" ECU_ADDRESS 0x5B8EA2 /end MEASUREMENT
/begin MEASUREMENT zbale "Abregelfaktor Langzeitanteil bei BA" UBYTE fak_ub_b0p125 1 100 0 0.124512 FORMAT "%6.4" ECU_ADDRESS 0x5B8740 /end MEASUREMENT
/begin MEASUREMENT zdteio "I.O.-Z‰hler f¸r Tankentl¸ftungsdiagnose" UBYTE dez 1 100 0 255 FORMAT "%5.1" ECU_ADDRESS 0x5B8FE4 /end MEASUREMENT
/begin MEASUREMENT zdtev "Pr¸fungsz‰hler f¸r TEV-Diagnose" UBYTE dez 1 100 0 255 FORMAT "%5.1" ECU_ADDRESS 0x5B8A25 /end MEASUREMENT
/begin MEASUREMENT zkhimpzl "Entprellz‰hler Hochimpedanzfehler" UBYTE dez 1 100 0 255 FORMAT "%5.1" ARRAY_SIZE 8 ECU_ADDRESS 0x5B8D9C /end MEASUREMENT
/begin MEASUREMENT zkhimpzlrl "Entprellz‰hler hochimpedanter Prim‰rkreis relativ zu Nachbarstromkreisen" UBYTE dez 1 100 0 255 FORMAT "%5.1" ARRAY_SIZE 8 ECU_ADDRESS 0x5B8DA4 /end MEASUREMENT
/begin MEASUREMENT zphnok "Z‰hler Fehler auf Phasensignal" UBYTE dez 1 100 0 255 FORMAT "%5.1" ECU_ADDRESS 0x5B8C25 /end MEASUREMENT
/begin MEASUREMENT zphnok2 "Z‰hler Fehler auf Phasensignal 2" UBYTE dez 1 100 0 255 FORMAT "%5.1" ECU_ADDRESS 0x5B8C26 /end MEASUREMENT
/begin MEASUREMENT zphnok3 "Z‰hler Fehler auf Phasensignal 3" UBYTE dez 1 100 0 255 FORMAT "%5.1" ECU_ADDRESS 0x5B8C27 /end MEASUREMENT
/begin MEASUREMENT zphnok4 "Z‰hler Fehler auf Phasensignal 4" UBYTE dez 1 100 0 255 FORMAT "%5.1" ECU_ADDRESS 0x5B8C28 /end MEASUREMENT
/begin MEASUREMENT zrph2diff0 "Phasenflanken im Arbeitsspiel bei PG2" UBYTE dez 1 100 0 255 FORMAT "%5.1" ECU_ADDRESS 0x5B8C29 /end MEASUREMENT
/begin MEASUREMENT zrph3diff0 "Phasenflanken im Arbeitsspiel bei PG3" UBYTE dez 1 100 0 255 FORMAT "%5.1" ECU_ADDRESS 0x5B8C2A /end MEASUREMENT
/begin MEASUREMENT zrph4diff0 "Phasenflanken im Arbeitsspiel bei PG4" UBYTE dez 1 100 0 255 FORMAT "%5.1" ECU_ADDRESS 0x5B8C2B /end MEASUREMENT
/begin MEASUREMENT zrphdiff0 "Phasenflanken im Arbeitsspiel bei PG1" UBYTE dez 1 100 0 255 FORMAT "%5.1" ECU_ADDRESS 0x5B8C2C /end MEASUREMENT
/begin MEASUREMENT zvale "Abregelfaktor Langzeitanteil bei VA" UBYTE fak_ub_b0p125 1 100 0 0.124512 FORMAT "%6.4" ECU_ADDRESS 0x5B8741 /end MEASUREMENT
/begin MEASUREMENT zzuend_l "Z¸ndungsz‰hler" ULONG dez 1 100 0 4.29497e+009 FORMAT "%13.2" ECU_ADDRESS 0x3FD82C /end MEASUREMENT
/begin MEASUREMENT zzyldmd "SW-Zylinderz‰hler f¸r DMD" SBYTE dez_sb 1 100 -128 127 FORMAT "%4.0" ECU_ADDRESS 0x5B8802 /end MEASUREMENT
/begin MEASUREMENT zzyldmd_f "SW-Zylinderz‰hler f¸r DMD" FLOAT32_IEEE fak_r32_1 1 100 -1e+010 1e+010 FORMAT "%43.31" ECU_ADDRESS 0x3FAE08 /end MEASUREMENT
/begin MEASUREMENT zzylzag "SW-Zylinderz‰hler f¸r DMDZAG" UBYTE DEZ 1 100 0 255 FORMAT "%5.1" ECU_ADDRESS 0x5B8BF9 /end MEASUREMENT
/begin FUNCTION DMDMIL "DMDMIL.exportedFehlerbehandlung der Aussetzererkennung, Ansteuerung der MIL und Heilung"
 /begin DEF_CHARACTERISTIC ADCY AHEAGW AHEAGWS AHEARV AHEKABB AHEKS1B1 AHEKS1B2 AHEKSB1 AHEKSB2 AINTKAN AZYTIABB CWDALA CWDMDE FAINTEN FASKIV1 KFKSWF MILANTI TMASKIV1 /end DEF_CHARACTERISTIC
 /begin REF_CHARACTERISTIC SNM08DMUB TMWUC /end REF_CHARACTERISTIC
 /begin IN_MEASUREMENT bbdcy B_mderk B_mdstop B_milstp B_pwf B_synph esst_snm08dmub nmot nsllm rl tmot zzyllfb /end IN_MEASUREMENT
 /begin OUT_MEASUREMENT ahearv_w bbsp1 bbsp2 B_blkmd B_mdarv B_mdkat B_milmd B_sp1 B_sp2 flgtiab fzabgs_w fzabgzyl_w /end OUT_MEASUREMENT
 /begin LOC_MEASUREMENT abgsmw_w afnmn afnmx afrlmn afrlmx aftnmn aftnmx aftrlmn aftrlmx aint_zyl anzinten azycntb bfnmn bfnmx bfrlmn bfrlmx B_afklt B_aftklt B_aftwrm B_afwrm B_ainten B_bfklt B_bfwrm B_ivzabg1 B_ivzkat1 cdcy E_abg_zyl fivzabg flgkat_w flgtiabm fzarv_w fzkats1_w fzkats2_w fzkats_w fzkatzyl_w fzmdzyl_w ivzabg_w ivzaint_w ivzarv_w ivzkat_w kswf SfpMin_EVzyl zzuend_l /end LOC_MEASUREMENT
 /begin SUB_FUNCTION DFPM_DMDMIL INDEX_DMDMIL /end SUB_FUNCTION
/end FUNCTION
/begin FUNCTION DMDSTP "DMDSTP.   Diagnose Misfire Detection; Stopbedingungen"
 /begin DEF_CHARACTERISTIC AVRALU AZSTLU AZSTPON CWSTDMD CWSTPCNF DRLSOLA DRLSOLST KLTALUST NGALUN NGALUST NMIALU NMXALU NSTDMD RLSALULL RLSALUN SALUNKH SFONTM TAMIALU /end DEF_CHARACTERISTIC
 /begin REF_CHARACTERISTIC SNM08DMUB SRL08DMUB /end REF_CHARACTERISTIC
 /begin IN_MEASUREMENT B_asc_reg B_autget B_cdmd B_dkpu B_dtest B_edkvs B_eev B_enws B_evasel B_evloc B_fbm B_fomod B_fonrset B_koe B_kuppl B_ll B_mdarv B_mdein B_mderk B_nldg B_nws B_phsnl B_readap B_sa B_st B_su B_swe_c B_synph B_tehb B_tsbready B_wk B_wkr dmrkh esst_snm08dmub esst_srl08dmub ngfil_w nmot rl rlgas_w tans tmot tmst tnst_w tskdelay vfzg /end IN_MEASUREMENT
 /begin OUT_MEASUREMENT B_fofstp B_fokstp B_fonstp B_lustop B_mdstop B_mdzgstp B_milstp B_stpon B_swe dmdstpBits1_100ms /end OUT_MEASUREMENT
 /begin LOC_MEASUREMENT B_com1 B_com2 B_edges B_error1 B_error26 B_error3 B_error5 B_error7 B_fontm B_lustops B_mddrla B_mdng B_mdnmn B_mdnmx B_mdrl B_mdtnst B_milstps B_range B_stdmd favralu_w fsalunkh /end LOC_MEASUREMENT
/end FUNCTION
/begin FUNCTION DMDTSB "Diagnosis Misfire Detection Segmentzeitbildung" /begin DEF_CHARACTERISTIC DMDSEGL KAMFZ TSBINVALID TSBSEGINI ZYLKOR /end DEF_CHARACTERISTIC /begin IN_MEASUREMENT zzyl /end IN_MEASUREMENT
 /begin OUT_MEASUREMENT B_stimhelp B_ti1stamp B_ti2stamp B_ts1delay B_tsbcalc B_tsbready dmdsegl_w kamfz_w seg1BegD_w seg2BegD_w tsbsyctr tsegDmd_l tSlave1_l tSlave2_l tsroh_f zzyldmd zzyldmd_f /end OUT_MEASUREMENT
/end FUNCTION
/begin FUNCTION DMDZAG "DMDZAG.exportedDiagnose misfire detection: Aussetzergenerator" /begin DEF_CHARACTERISTIC CWDMDZAG KFMODI RANDSEED ZAGRUN /end DEF_CHARACTERISTIC /begin IN_MEASUREMENT zzyl /end IN_MEASUREMENT
 /begin OUT_MEASUREMENT B_mdzag B_reini B_zagrun B_zagstp dmdappBits_100ms flgstign_w flgstinj_w flgst_w ignitioz_w lastmodz_w misfirez_w modez_w nwnumbz_w pausez_w randreg_w zzylzag /end OUT_MEASUREMENT
 /begin LOC_MEASUREMENT wkfmodi_w xkfmodi ykfmodi /end LOC_MEASUREMENT
/end FUNCTION
/begin FUNCTION DMIL "OBDII; MIL-Ansteuerung" /begin DEF_CHARACTERISTIC CWMILCOD CWNOMIL TLAED TLAEDI /end DEF_CHARACTERISTIC
 /begin IN_MEASUREMENT B_blkfb B_blkmd B_bt B_btemil B_btmil B_milfb B_milmd B_nmot B_nokatfz dfpmMilState /end IN_MEASUREMENT
 /begin OUT_MEASUREMENT B_kmmil B_mil B_milblk B_milst B_milstat B_nomil milstat /end OUT_MEASUREMENT
 /begin LOC_MEASUREMENT B_blkeb B_mileb /end LOC_MEASUREMENT
/end FUNCTION
/begin FUNCTION DMLSE "Diagnose; Endstufenpr¸fung elektrischer Motorl¸fter" /begin DEF_CHARACTERISTIC CWPSMLE /end DEF_CHARACTERISTIC /begin REF_CHARACTERISTIC TAMLSMN TAMLSMX TVP /end REF_CHARACTERISTIC /begin IN_MEASUREMENT B_desee taml /end IN_MEASUREMENT /begin SUB_FUNCTION DFPM_DMLSE /end SUB_FUNCTION /end FUNCTION
/begin FUNCTION DMYDFPM "Dummy_DFPM (Softwareadapter f¸r Fehlerspeicher)" /end FUNCTION
/begin FUNCTION DNVRBUP "Diagnose NVRAM Backup" /begin IN_MEASUREMENT B_eepwf B_pwf B_restore eeeExitStatus /end IN_MEASUREMENT /begin OUT_MEASUREMENT B_nvrbupok /end OUT_MEASUREMENT /end FUNCTION
/begin FUNCTION DNWSAUS "DNWSAUS.exportedDiagnose Nockenwellensteuerung (Auslaﬂseitig)" /begin REF_CHARACTERISTIC SPRZG_AN TDDNWSHL TDDNWSMN TDDNWSNP /end REF_CHARACTERISTIC
 /begin IN_MEASUREMENT B_anwmn B_anwmn2 B_anwpnp B_anwpnp2 B_cdanws B_fanwsaa B_phad3 B_phad4 Vsa_sprs /end IN_MEASUREMENT
 /begin OUT_MEASUREMENT B_danws B_danws2 dnwsausBits_100ms /end OUT_MEASUREMENT
 /begin LOC_MEASUREMENT B_lcmnanw B_lcmnanw2 B_lcnpanw B_lcnpanw2 /end LOC_MEASUREMENT
 /begin SUB_FUNCTION DFPM_DNWSAUS INDEX_DNWSAUS /end SUB_FUNCTION
/end FUNCTION
/begin FUNCTION DNWSEAUS "Diagnose: Endstufe Nockenwellensteuerung (Auslaﬂseitig)" /begin DEF_CHARACTERISTIC CWPSNWSAE TANWASTMN TANWASTMX /end DEF_CHARACTERISTIC /begin REF_CHARACTERISTIC TVP /end REF_CHARACTERISTIC /begin IN_MEASUREMENT B_desee Vsa_tv /end IN_MEASUREMENT /begin SUB_FUNCTION DFPM_DNWSEAUS /end SUB_FUNCTION /end FUNCTION
/begin FUNCTION DNWSEEIN "Diagnose der Nockenwellenendstufe (einlaﬂseitig)" /begin DEF_CHARACTERISTIC CWPSNWSEE TANWESTMN TANWESTMX /end DEF_CHARACTERISTIC /begin REF_CHARACTERISTIC TVP /end REF_CHARACTERISTIC /begin IN_MEASUREMENT B_desee Vse_tv /end IN_MEASUREMENT /begin SUB_FUNCTION DFPM_DNWSEEIN /end SUB_FUNCTION /end FUNCTION
/begin FUNCTION DNWSEIN "DNWSEIN.exportedDiagnose Nockenwellensteuerung (Einlaﬂseitig)" /begin DEF_CHARACTERISTIC TDDNWSHL TDDNWSMN TDDNWSNP /end DEF_CHARACTERISTIC /begin REF_CHARACTERISTIC SPRZG_AN /end REF_CHARACTERISTIC
 /begin IN_MEASUREMENT B_cdenws B_enwmn B_enwmn2 B_enwpnp B_enwpnp2 B_fanwsea B_phad B_phad2 Vse_sprs /end IN_MEASUREMENT
 /begin OUT_MEASUREMENT B_denws B_denws2 dnwseinBits_100ms /end OUT_MEASUREMENT
 /begin LOC_MEASUREMENT B_lcmnenw B_lcmnenw2 B_lcnpenw B_lcnpenw2 /end LOC_MEASUREMENT
 /begin SUB_FUNCTION DFPM_DNWSEIN INDEX_DNWSEIN /end SUB_FUNCTION
/end FUNCTION
/begin FUNCTION DNWSZF "Diagnose Nockenwellensteuerung Fehlerzusammenfassung" /begin IN_MEASUREMENT B_lcmnanw B_lcmnenw B_lcnpanw B_lcnpenw /end IN_MEASUREMENT /begin OUT_MEASUREMENT B_enws B_enwsa B_enwse /end OUT_MEASUREMENT /end FUNCTION
/begin FUNCTION DPH "DPH.      Diagnose; Plausibilit‰tspr¸fung Phasensensor" /begin DEF_CHARACTERISTIC PGPRIO PHBM PHNOKA PHPOSERR /end DEF_CHARACTERISTIC /begin REF_CHARACTERISTIC CWPG1 CWPG2 CWPG3 CWPG4 /end REF_CHARACTERISTIC
 /begin IN_MEASUREMENT B_checkpg B_checkpg2 B_checkpg3 B_checkpg4 B_st inisynmon uzkw_w zphfl2ct_w zphfl3ct_w zphfl4ct_w zphflct_w zrph2_l zrph3_l zrph4_l zrph_l zzyl /end IN_MEASUREMENT
 /begin OUT_MEASUREMENT B_fph1bm B_fph2bm B_fph3bm B_fph4bm B_nopg B_ph2flok B_ph3flok B_ph4flok B_phflok B_synph dphBits2_200ms dphBits2_syn dphBits3_syn dphBits_200ms dphBits_ph1 dphBits_ph2 dphBits_ph3 dphBits_ph4 dphBits_syn pgmaster /end OUT_MEASUREMENT
 /begin LOC_MEASUREMENT B_enph2bm B_enph3bm B_enph4bm B_enphbm B_rst1ph B_rst1ph2 B_rst1ph3 B_rst1ph4 B_rst3ph B_rst3ph2 B_rst3ph3 B_rst3ph4 B_synphab ph1edpos_w ph2bmerr ph2edpos_w ph3bmerr ph3edpos_w ph4bmerr ph4edpos_w phbmerr sph2flok sph3flok sph4flok sphflok zphnok zphnok2 zphnok3 zphnok4 zrph2diff0 zrph3diff0 zrph4diff0 zrphdiff0 /end LOC_MEASUREMENT
 /begin SUB_FUNCTION DFPM_DPH INDEX_DPH /end SUB_FUNCTION
/end FUNCTION
/begin FUNCTION DPS_TMP "" /begin DEF_CHARACTERISTIC THP TVP /end DEF_CHARACTERISTIC /end FUNCTION
/begin FUNCTION dr_showerr "" /begin DEF_CHARACTERISTIC CW_DR_ERR1 CW_DR_ERR2 CW_DR_ERR_ID /end DEF_CHARACTERISTIC
 /begin OUT_MEASUREMENT dr_errArray dr_errCounter dr_errId dr_errInfoh dr_errInfol dr_errMin dr_errSec dr_errType /end OUT_MEASUREMENT
/end FUNCTION
/begin FUNCTION DSLPE "Diagnose; Sekund‰rluftpumpe Endstufe" /begin DEF_CHARACTERISTIC CWPSSLPE /end DEF_CHARACTERISTIC /begin REF_CHARACTERISTIC TVP /end REF_CHARACTERISTIC /begin IN_MEASUREMENT B_desee B_slp /end IN_MEASUREMENT /begin SUB_FUNCTION DFPM_DSLPE /end SUB_FUNCTION /end FUNCTION
/begin FUNCTION DSLSLR "Diagnose Sekund‰rluftsystem mit Zweipunkt-Lambdaregelung"
 /begin DEF_CHARACTERISTIC CWDSLSA CWDSLSY DFRMOFNX DFRMOFNXKT DFRMOFPX DFRMOFPXKT DMSLIFTMN DSLVFZMN FHODSL FMSLAMN FMSLAMX IMLATDSL IMLATDSLK IMLDSL IMSLADAP LAMDSLMX MLWDSLAMN MLWDSLAMX MLWDSLKMN MLWDSLKMX MLWDSLMN MLWDSLMX MLWDSLOMN MLWDSLOMX MSLBAS MSLVMX MSLVMXK MSLVMXX MSLVMXXK NDSLMN NDSLMX RLDSLMN RLDSLMX RMSLADA RMSLMN RMSLMNK RMSLTMN TABGMSLAD TANDSLMN TANDSLMX TC6CSL TC6CSLK TC6CSLN TC6CSLV TDDMSLIFT TDFRDSLS TDMES4OFF TDMSLMN1 TDMSLMN4 TDMSLMNK TDMSLOF3 TDMSLOF5 TDMSLOFK TDMSLV TDMSLVK TDPH2SLOF TDPHSLOF TDSLMVBA TFIMSLI TFIMSLIK TFIMSLO TFIMSLOK TFIMSLV TFIMSLVK TKATDSL TMDSLAMN TMDSLMN TMDSLMX TNOMF2 TNOMF3 TNOMF5 TNSTDSL TWHLSLP TWMLFE TWMSLMIN TWSLPSLA ZDSLAMX /end DEF_CHARACTERISTIC
 /begin IN_MEASUREMENT B_bag B_cdsls B_edkvs B_evloc B_fa B_fasla B_hag B_kh B_kha B_ll B_lrnd B_lrnda B_mdarv B_nmot B_pwf B_slp B_slpoff B_sls B_slsadap B_slsfz B_slsoff B_stend B_te B_vag fho_w frm_w fr_w imlatm_w imlpr lamkh_w lamsbg_w lamsons_w mlbb_w ml_w msabg_w msl nmot rl tabgm tans tkatm tmot tnse_w twslp_w vfzg /end IN_MEASUREMENT
 /begin OUT_MEASUREMENT B_dsl1 B_dsl4 B_dsla B_dslfa B_dsls B_dslsp4 B_dspe B_esls B_mslmn B_sla dfrmoff_w fmsla m6amsl m6cmsl m6cmslv m6smslv_w m6smsl_w m6wmslv_w m6wmsl_w /end OUT_MEASUREMENT
 /begin LOC_MEASUREMENT B_asla B_asla2 B_cwdslt B_cwsla B_dfrmoff B_dfrmoff2 B_dsl B_dsl1ab B_dsl1e B_dsl2 B_dsl2ab B_dsl2e B_dsl3 B_dsl3ab B_dsl3e B_dsl45 B_dsl4ab B_dsl4e B_dsl5 B_dsl5ab B_dsl5dly B_dsl5e B_dslerr B_dslm B_dslmab B_dslme B_dslmes B_dslo B_dsloab B_dsloe B_dslp4 B_dslt B_dsltab B_dslte B_dsper B_dspes B_errofs B_errofs2 B_faslarq B_mealam B_meaoper B_mslmin B_mslmin2 B_mslnini B_mslrdy B_mslrdyb B_mslrdyb2 B_mslt B_mslt2 B_msltini B_msltini2 B_slar B_slarq B_slas B_slsofw B_szsls B_trfasla dmslift_w fmslav mslift mslift_w mslnenn mslnf mslnt msltb_w msltini mslt_w mslvft_w mslvt_w mslv_w rmsl rmslt /end LOC_MEASUREMENT
/end FUNCTION
/begin FUNCTION DSUE "Diagnose; Saugrohrumschaltung Endstufe"
 /begin DEF_CHARACTERISTIC CWPSSUE TDSUE TDSUEH TDSUEMN TDSUEMX TVRDISAMN TVRDISAMX TVSDISAMN TVSDISAMX /end DEF_CHARACTERISTIC
 /begin REF_CHARACTERISTIC DI_SCHALT /end REF_CHARACTERISTIC
 /begin IN_MEASUREMENT Disaaus_w Ditv_aus ES_sfdisa /end IN_MEASUREMENT
 /begin OUT_MEASUREMENT B_disae B_disaok dsueBits tdsuectr tdsuehctr tdsuemnctr tdsuemxctr /end OUT_MEASUREMENT
/end FUNCTION
/begin FUNCTION DSWEC "Schlechtwegerk. aus Rad-Beschl.,-> mittels CAN von ABS SG zu Motronic" /begin DEF_CHARACTERISTIC FABSALU FIBSALU FSWALUV /end DEF_CHARACTERISTIC /begin IN_MEASUREMENT bsc B_cdswe cd_bits1_w vfzg /end IN_MEASUREMENT /begin OUT_MEASUREMENT B_swe_c /end OUT_MEASUREMENT /begin LOC_MEASUREMENT bssp fswares /end LOC_MEASUREMENT /end FUNCTION
/begin FUNCTION DTEVE "Diagnose; Tankentl¸ftungsventil - Endstufe" /begin DEF_CHARACTERISTIC CWPSTEVE /end DEF_CHARACTERISTIC /begin REF_CHARACTERISTIC TVP /end REF_CHARACTERISTIC /begin IN_MEASUREMENT B_desee tateist_w /end IN_MEASUREMENT /begin SUB_FUNCTION DFPM_DTEVE /end SUB_FUNCTION /end FUNCTION
/begin FUNCTION DTEVN "Diagnose Tankentl¸ftungsventil (OBDII)"
 /begin DEF_CHARACTERISTIC AIMDTED AIODTEX APDTEX DMITED DNSTED FTETEDF FTETEDM HTEDU INTEDO INTEDU NSTEDMX RLTEDMX TBTEVIO TMTED TNODTEV TNODTEVT TTEDA TTEDBA TTEDIV TTEDN TWKODTE ZMVDTE ZNTED /end DEF_CHARACTERISTIC
 /begin REF_CHARACTERISTIC TTEGAI TTEINI /end REF_CHARACTERISTIC
 /begin IN_MEASUREMENT B_cdtes B_dmtltz B_druck B_dsls B_edkvs B_enws B_fa B_fates B_frao B_frau B_kh B_ko B_kw B_ll B_lowra B_lr B_mdarv B_pwf B_rkat B_rkaz B_stend B_tei cd_bits1_w fho ftead_w mdverl_w milsol_w mstesoll_w nmot_w nsol rl tmot vfzg /end IN_MEASUREMENT
 /begin OUT_MEASUREMENT B_dteaa B_dtebel B_dtebn B_dtes B_dtest tadtea tbtevio_c tc6tesc tc6tess tc6tesw tesstat twkodte_c zdteio zdtev /end OUT_MEASUREMENT
 /begin LOC_MEASUREMENT B_dteabr B_dtean B_dteaq B_dtei B_dtesq B_dtevio dmidte dndte dnsdte DTEVNbits dtevphc_w indte midter mvdtehp nsdter ntpdte ntpdter tdten_w /end LOC_MEASUREMENT
/end FUNCTION
/begin FUNCTION DTIP "OBDII; Tester-Interface Package" /begin IN_MEASUREMENT cw_erfil fcmEnd FCMTab /end IN_MEASUREMENT /begin OUT_MEASUREMENT ffzdfp /end OUT_MEASUREMENT /end FUNCTION
/begin FUNCTION DTOENS "Diagnose Temperatur, ÷lniveau-Sensor" /begin DEF_CHARACTERISTIC DTOG_UBMIN TOGMAXUNPL TOG_CNTMAX /end DEF_CHARACTERISTIC /begin REF_CHARACTERISTIC TOG_VERS /end REF_CHARACTERISTIC
 /begin IN_MEASUREMENT B_oelverl B_togerr B_togok B_togupl Tog_cnt Tog_icnt Tog_st Tog_state Tog_uplcnt ub /end IN_MEASUREMENT
/end FUNCTION
/begin FUNCTION DTOP "Diagnose; Betriebszeit" /begin IN_MEASUREMENT B_eemrdy B_eepwf B_nmot /end IN_MEASUREMENT /begin OUT_MEASUREMENT top_w /end OUT_MEASUREMENT /end FUNCTION
/begin FUNCTION DTRIG "OBDII; Ausw‰hlbare Trigger f¸r Fehlerpfad-Management" /begin IN_MEASUREMENT bbdcy bbno bbsp1 bbsp2 bbsp3 bbtim bbwuc /end IN_MEASUREMENT /end FUNCTION
/begin FUNCTION DUF "Diagnose aus der Funktions¸berwachung" /begin DEF_CHARACTERISTIC DUF_T NMN_DUF /end DEF_CHARACTERISTIC
 /begin IN_MEASUREMENT B_ehfs B_fgr B_fgr_um B_i_ska_um B_mibeg B_msr B_nomsr_um B_nosgs_um B_notlu_fr B_pwgnotfr B_sgs B_sp1s B_sp2s B_spsmin B_ub_ok B_wdk2sel ei_adcc_um ei_ipa_um ei_mver_um ei_nc_um ei_reac_um ei_rlc_um ei_rlip_um ei_spsc_um ei_tpu_um ei_zwc_um mi_um nmot_um /end IN_MEASUREMENT
 /begin OUT_MEASUREMENT duf_c egaspfad skapfad /end OUT_MEASUREMENT
 /begin LOC_MEASUREMENT ei_dufska mi_duf mpfad /end LOC_MEASUREMENT
/end FUNCTION
/begin FUNCTION DUMWEX "Diagose; Erweiterte Umweltbedingumgen" /begin IN_MEASUREMENT kmstand /end IN_MEASUREMENT /end FUNCTION
/begin FUNCTION DUR "Diagnose aus der Rechner¸berwachung" /begin OUT_MEASUREMENT rstpfad /end OUT_MEASUREMENT /begin LOC_MEASUREMENT rstMon_um /end LOC_MEASUREMENT /end FUNCTION
/begin FUNCTION DVANOS "Diagnose VANOS" /begin DEF_CHARACTERISTIC DELTA_AN DVNS_CLR VNSNMIN /end DEF_CHARACTERISTIC /begin REF_CHARACTERISTIC SPRZG_AN /end REF_CHARACTERISTIC /begin IN_MEASUREMENT B_pwf kmstand nmot tmot Vsa_spri Vse_spri /end IN_MEASUREMENT
 /begin OUT_MEASUREMENT B_vsa_an B_vsa_nv B_vse_an B_vse_nv Vsa_anz Vsa_km Vsa_tmot Vsa_zeig Vse_anz Vse_km Vse_tmot Vse_zeig /end OUT_MEASUREMENT
/end FUNCTION
/begin FUNCTION DVFZ "Diagnose: Plausibilit‰tspr¸fung Fahrzeuggeschwindigkeit" /begin DEF_CHARACTERISTIC NDV NDVO TDV TMDV VDMN /end DEF_CHARACTERISTIC /begin IN_MEASUREMENT B_sa nmot tmot vfzroh_w /end IN_MEASUREMENT /end FUNCTION
/begin FUNCTION DWUC "OBDII; Erf¸llung Bedingung 'warm up cycle'" /begin DEF_CHARACTERISTIC DTMWUC TMWUC TMWUCST /end DEF_CHARACTERISTIC /begin IN_MEASUREMENT B_pwf B_stend tmot /end IN_MEASUREMENT /begin OUT_MEASUREMENT bbwuc B_nowuc B_wuc wuccnt /end OUT_MEASUREMENT /begin LOC_MEASUREMENT tmstem /end LOC_MEASUREMENT /end FUNCTION
/begin FUNCTION DZKU "Diagnose: Z¸ndkreis¸berwachung"
 /begin DEF_CHARACTERISTIC CW_DZKU DZKDMDZL DZKDUB DZKSUB_DZKU_IMPL DZOTPERR_DZKU_IMPL DZPHKSUB DZPKSMS DZPKSMSR DZPKSUB DZPKSUBR DZPOTP DZPSP DZPTIM DZRELFAK FZALIM FZLIMUB KLRTAMN KLTAMN KLTAMX NOTAERR_DZKU_IMPL NZDIAGH NZDIAGL TAINI UBDZMN UBDZMX /end DEF_CHARACTERISTIC
 /begin IN_MEASUREMENT B_dzrts B_ff B_stend dzkflag fzabgzyl_w nmot nmot_w ta_w ub /end IN_MEASUREMENT
 /begin OUT_MEASUREMENT abmznd B_dzack B_dzenable /end OUT_MEASUREMENT
 /begin LOC_MEASUREMENT abmbuf B_dzappl B_dzdmden B_dzdmdub B_dzhksub B_dzkdmd B_dzkprl B_dzksms B_dzksub B_dzkub B_dzmnen B_dzmnrel B_dzmxen B_dzmxrel B_dzotp B_dzzyk B_taini B_zkhimp B_zkrlhmp B_zkrlksub cycle dzadrbuf0 dzdmdzhl dzhksubzl dzkanal dzksubzl dzksubzlrl dzkub dzotpzhl dztimzhl fzaold_w tamn tamx taold_w tarlmn tarlmx zkhimpzl zkhimpzlrl /end LOC_MEASUREMENT
 /begin SUB_FUNCTION DFPM_DZKU /end SUB_FUNCTION
/end FUNCTION
/begin FUNCTION EAVANOS "Ein-/Auslassvanos (BMW)"
 /begin DEF_CHARACTERISTIC ASP_ADPWF ASP_ADTV ASP_BA ASP_TVHB ASP_WNWS CW_VNSABST CW_VNSDYN ESP_ADPWF ESP_ADTV ESP_BA ESP_TVHB ESP_WNWS KLIREGTMOT KLRANWI KLRANWP KLRENWI KLRENWP KLVNSTMOT KLVNSTVUB NMOTVNSAD NW_MIN SPRZG_AN VNSKRITLOC VNSNMOTAN VNSRTVIMN VNSRTVIMX VNSRTVMN VNSRTVMX VNSTVIABDY VNS_ADEND VNS_ADT VNS_ANAB VNS_DYN /end DEF_CHARACTERISTIC
 /begin IN_MEASUREMENT Aspr B_nmot B_pwf B_st Espr nmot tmot ub /end IN_MEASUREMENT
 /begin OUT_MEASUREMENT B_npos0dyn B_npos1dyn B_nvnsad B_vsaadnok B_vsaadok B_vsaadp B_vsaflan B_vsanwerr B_vseadnok B_vseadok B_vseadp B_vseflan B_vsenwerr Nw_pos Vnsfaktmot Vnsfaktvub Vsadwnwkl Vsadwnwv Vsaspris Vsa_adp Vsa_adp_fl Vsa_spri Vsa_sprs Vsa_stat Vsa_tv Vsa_tv_i Vsa_tv_p Vsa_vg Vse2adp Vsedwnwkl Vsedwnwv Vsespris Vse_adp Vse_adp_fl Vse_spri Vse_sprs Vse_stat Vse_tv Vse_tv_i Vse_tv_p Vse_vg wnwi_w /end OUT_MEASUREMENT
/end FUNCTION
/begin FUNCTION EEDAT "Daten im EEPROM" /begin IN_MEASUREMENT B_eemrdy B_eepwf cobattort /end IN_MEASUREMENT /begin OUT_MEASUREMENT B_eepdif /end OUT_MEASUREMENT /end FUNCTION
/begin FUNCTION ELS "E-Box L¸fter Steuerung" /begin DEF_CHARACTERISTIC DTEBLEIN TEBLEIN TTEBL /end DEF_CHARACTERISTIC /begin IN_MEASUREMENT B_nmot tsg /end IN_MEASUREMENT /begin OUT_MEASUREMENT B_ebl /end OUT_MEASUREMENT /end FUNCTION
/begin FUNCTION ERCO_ERR "" /begin OUT_MEASUREMENT E_OS_LIMIT_ctr /end OUT_MEASUREMENT /end FUNCTION
/begin FUNCTION ESGRU "Grundeinspritzungen" /begin DEF_CHARACTERISTIC FRHOKRST FRKAP KFLF /end DEF_CHARACTERISTIC /begin IN_MEASUREMENT nmot rl tkrst vsfrk /end IN_MEASUREMENT /begin OUT_MEASUREMENT fgru /end OUT_MEASUREMENT /end FUNCTION
/begin FUNCTION ESNST "Einspritzung Nachstart"
 /begin DEF_CHARACTERISTIC ANZTIBMX FNSA FNSHO FNSSM FWSTAA1 FWSTAA2 FWSTAA3 FWSTAA4 FZANSSA1 FZANSSA2 FZANSSM1 FZANSSM2 KFLANS KFNSWRL KFWWNS SZANSSM ZDGZA1 ZDGZA2 /end DEF_CHARACTERISTIC
 /begin REF_CHARACTERISTIC SAN12ESUW SKS06ESUB STA06ESUB STS12ESUB /end REF_CHARACTERISTIC
 /begin IN_MEASUREMENT anzti_w B_hst B_st B_staa B_stend B_wks ESSTTbits esst_san12esuw esst_sks06esub esst_sta06esub esst_sts12esub fho kstaa rl tabst_w tans tmst /end IN_MEASUREMENT
 /begin OUT_MEASUREMENT anztib_w B_decay2 B_lamnse fktns0_w fktns1_w fns fnsa0 fnsho0 fnssm0 fwnssm_w lamns_w lans_w nswrl szanssm0 wwns zanssa zanssm /end OUT_MEASUREMENT
 /begin LOC_MEASUREMENT fktns fzans1 fzans2 nsactr nsactr1 nsactr2 /end LOC_MEASUREMENT
/end FUNCTION
/begin FUNCTION ESSTT "Einspritzzeit Start"
 /begin DEF_CHARACTERISTIC ANZTIWS CWESSTT FHSTT FKSTT FSTHO IMLHS KFFWST KFWHSTT KFWKSTN KFWKSTT KLFWST TANDT TMH TMHSG TWSTT /end DEF_CHARACTERISTIC
 /begin IN_MEASUREMENT anzti_w B_pwf B_st B_stend fho imlatm kstaa nmot tabst_w tans tansab tistzyl tmotab tmst tnse_w zzyl /end IN_MEASUREMENT
 /begin OUT_MEASUREMENT B_hst B_vbemg B_wks B_wst ESSTTbits fkstt0 fst_w fwst fwst0_w fwst1 hsst_w hstt0 tandt0 tmlauf_w whstt wkstn wkstt /end OUT_MEASUREMENT
 /begin LOC_MEASUREMENT anztist B_vbmg fst0_w tstlauf_w /end LOC_MEASUREMENT
/end FUNCTION
/begin FUNCTION ESUK ""
 /begin DEF_CHARACTERISTIC DUKK FUKE FUKNSTM FVANST FWFN KFABAK KFAVAK KFBAKL KFVAKL RKBAUM RKUKKLU RKVAUM TNSUUK WFRL ZBALM ZUKE ZUKK ZUKNST ZVALM /end DEF_CHARACTERISTIC
 /begin REF_CHARACTERISTIC SNM07ESUB STM09ESUB /end REF_CHARACTERISTIC
 /begin IN_MEASUREMENT anzti B_ll B_nswo2 B_sa B_st B_stend drlp_w esst_snm07esub esst_stm09esub fukaba_w fukava_w nmot nmot_w rlp_w tmot tmst /end IN_MEASUREMENT
 /begin OUT_MEASUREMENT B_ba B_bag B_ukg B_va B_vag rkukg_w rkukk_w /end OUT_MEASUREMENT
 /begin LOC_MEASUREMENT abak anztis avak B_redkl B_uk1 B_uke B_ukk B_ukns B_vaau B_vakl B_val B_wf drkuke_w dwfk_w dwfl_w dwf_w fbakl_w fbans fbans_w fbavst_w fvakl_w fvans fvavst_w rkuke_w rkukkl_w rkukl_w rkuk_w sdwfk_w sdwfl_w wf_w zbale zvale /end LOC_MEASUREMENT
/end FUNCTION
/begin FUNCTION ESUKA "Adaptive ‹bergangskompensation (basierend auf Zweipunkt-Regelung)"
 /begin DEF_CHARACTERISTIC ABAOVMX AMNUUKA ASPUUKA AVAOVMX CUKA DFRBAF DFRBAM DFRVAF DFRVAM DPSUKAO DRLSPMN FUKABAKI FUKABAKO FUKABAKU FUKABAWI FUKABAWO FUKABAWU FUKAVAKI FUKAVAKO FUKAVAKU FUKAVAWI FUKAVAWO FUKAVAWU NUKAO NUKAU RLUKAU TMUKAK TMUKAU TMUKAW TNSUUKA ZFUKA /end DEF_CHARACTERISTIC
 /begin IN_MEASUREMENT B_dfrf B_dfrm B_frmax B_frmin B_lr B_lrsp B_nswo1 B_pwf B_te B_tehb dfrsp_w dfrst_w nmot psmx_w ps_w rl tmot tnst_w /end IN_MEASUREMENT
 /begin OUT_MEASUREMENT fukaba_w fukava_w /end OUT_MEASUREMENT
 /begin LOC_MEASUREMENT abaov ainkba ainkva aspuka avaov B_amnuka B_cfukaba B_cfukava B_dfukaba B_dfukava B_ifukaba B_ifukava B_uka B_ukab B_ukaba B_ukabaf B_ukabah B_ukabal B_ukabam B_ukadba B_ukadva B_ukaiba B_ukaiva B_ukat B_ukava B_ukavaf B_ukavah B_ukaval B_ukavam drlsp fukabak_w fukabaw_w fukavak_w fukavaw_w psukao_w rlsp /end LOC_MEASUREMENT
/end FUNCTION
/begin COMPU_METHOD accgrd_ub_b555p55 "" RAT_FUNC "%6.2" "m/(s^3)" COEFFS 0 1 0 0 0 2.17 /end COMPU_METHOD
/begin COMPU_METHOD acc_ub_b55p55 "" RAT_FUNC "%6.3" "m/(s^2)" COEFFS 0 1 0 0 0 0.217 /end COMPU_METHOD
/begin COMPU_METHOD acc_uw_b55p55 "" RAT_FUNC "%6.5" "m/(s^2)" COEFFS 0 147456 0 0 0 125 /end COMPU_METHOD
/begin COMPU_METHOD B_TRUE "boolsche Zust‰nde, positive Logik" TAB_VERB "%6.3" "" COMPU_TAB_REF B_TRUE /end COMPU_METHOD
/begin COMPU_VTAB B_TRUE "boolsche Zust‰nde, positive Logik" TAB_VERB 2 0 "----" 1 "TRUE" /end COMPU_VTAB
/begin COMPU_METHOD DEZ "1 : 1 Umrechnug (dez/hex)" RAT_FUNC "%6.2" "" COEFFS 0 1 0 0 0 1 /end COMPU_METHOD
/begin COMPU_METHOD dez "1 : 1 Umrechnug (dez/hex)" RAT_FUNC "%6.2" "" COEFFS 0 1 0 0 0 1 /end COMPU_METHOD
/begin COMPU_METHOD dez_sb "" RAT_FUNC "%4.1" "Anzahl" COEFFS 0 1 0 0 0 1 /end COMPU_METHOD
/begin COMPU_METHOD di_uw_q0p01 "" RAT_FUNC "%6.4" "" COEFFS 0 100 0 0 0 1 /end COMPU_METHOD
/begin COMPU_METHOD fak_q0p5 "" RAT_FUNC "%6.3" "-" COEFFS 0 1 0 0 0 0.5 /end COMPU_METHOD
/begin COMPU_METHOD fak_r32_1 "" RAT_FUNC "%43.21" "-" COEFFS 0 1 0 0 0 1 /end COMPU_METHOD
/begin COMPU_METHOD fak_sw_b1 "" RAT_FUNC "%7.6" "-" COEFFS 0 65536 0 0 0 2 /end COMPU_METHOD
/begin COMPU_METHOD fak_sw_b256 "" RAT_FUNC "%6.4" "-" COEFFS 0 65536 0 0 0 512 /end COMPU_METHOD
/begin COMPU_METHOD fak_sw_b64 "" RAT_FUNC "%6.4" "-" COEFFS 0 65536 0 0 0 128 /end COMPU_METHOD
/begin COMPU_METHOD fak_ub_b0p125 "" RAT_FUNC "%6.5" "-" COEFFS 0 256 0 0 0 0.125 /end COMPU_METHOD
/begin COMPU_METHOD fak_ub_b0p25 "" RAT_FUNC "%10.7" "-" COEFFS 0 256 0 0 0 0.25 /end COMPU_METHOD
/begin COMPU_METHOD fak_ub_b1 "" RAT_FUNC "%6.4" "-" COEFFS 0 256 0 0 0 1 /end COMPU_METHOD
/begin COMPU_METHOD fak_ub_b16 "" RAT_FUNC "%6.4" "-" COEFFS 0 256 0 0 0 16 /end COMPU_METHOD
/begin COMPU_METHOD fak_ub_b1p25_o0p75 "" RAT_FUNC "%6.3" "-" COEFFS 0 1 -0.75 0 0 0.00195313 /end COMPU_METHOD
/begin COMPU_METHOD fak_ub_b2 "" RAT_FUNC "%6.4" "-" COEFFS 0 256 0 0 0 2 /end COMPU_METHOD
/begin COMPU_METHOD fak_ub_b4 "" RAT_FUNC "%6.4" "-" COEFFS 0 256 0 0 0 4 /end COMPU_METHOD
/begin COMPU_METHOD fak_ub_b64 "" RAT_FUNC "%6.3" "-" COEFFS 0 256 0 0 0 64 /end COMPU_METHOD
/begin COMPU_METHOD fak_ub_b8 "" RAT_FUNC "%6.4" "-" COEFFS 0 256 0 0 0 8 /end COMPU_METHOD
/begin COMPU_METHOD fak_uw_b1 "" RAT_FUNC "%7.6" "-" COEFFS 0 65536 0 0 0 1 /end COMPU_METHOD
/begin COMPU_METHOD fak_uw_b1024 "" RAT_FUNC "%6.4" "-" COEFFS 0 65536 0 0 0 1024 /end COMPU_METHOD
/begin COMPU_METHOD fak_uw_b16 "" RAT_FUNC "%6.5" "-" COEFFS 0 65536 0 0 0 16 /end COMPU_METHOD
/begin COMPU_METHOD fak_uw_b4 "" RAT_FUNC "%7.6" "-" COEFFS 0 65536 0 0 0 4 /end COMPU_METHOD
/begin COMPU_METHOD fak_uw_b512 "" RAT_FUNC "%6.4" "-" COEFFS 0 65536 0 0 0 512 /end COMPU_METHOD
/begin COMPU_METHOD fak_uw_b64 "" RAT_FUNC "%6.5" "-" COEFFS 0 65536 0 0 0 64 /end COMPU_METHOD
/begin COMPU_METHOD fak_uw_b8 "" RAT_FUNC "%6.5" "-" COEFFS 0 65536 0 0 0 8 /end COMPU_METHOD
/begin COMPU_METHOD km_uw_q10 "" RAT_FUNC "%6.1" "km" COEFFS 0 1 0 0 0 10 /end COMPU_METHOD
/begin COMPU_METHOD kw_q0p1 "" RAT_FUNC "%6.3" "Grad KW" COEFFS 0 10 0 0 0 1 /end COMPU_METHOD
/begin COMPU_METHOD kw_q6 "" RAT_FUNC "%6.2" "Grad KW" COEFFS 0 1 0 0 0 6 /end COMPU_METHOD
/begin COMPU_METHOD m_q0p0015625 "" RAT_FUNC "%6.4" "kg/h" COEFFS 0 640 0 0 0 1 /end COMPU_METHOD
/begin COMPU_METHOD m_q0p025 "" RAT_FUNC "%6.4" "kg/h" COEFFS 0 1 0 0 0 0.025 /end COMPU_METHOD
/begin COMPU_METHOD m_q0p4 "" RAT_FUNC "%6.3" "kg/h" COEFFS 0 1 0 0 0 0.4 /end COMPU_METHOD
/begin COMPU_METHOD m_sw_q0p1 "" RAT_FUNC "%6.3" "kg/h" COEFFS 0 1 0 0 0 0.1 /end COMPU_METHOD
/begin COMPU_METHOD m_ub_b23p3 "" RAT_FUNC "%6.3" "kg" COEFFS 0 2812.5 0 0 0 256 /end COMPU_METHOD
/begin COMPU_METHOD m_uw_b23p3 "" RAT_FUNC "%6.5" "kg" COEFFS 0 2812.5 0 0 0 1 /end COMPU_METHOD
/begin COMPU_METHOD m_uw_b4660 "" RAT_FUNC "%6.4" "g" COEFFS 0 3600 0 0 0 256 /end COMPU_METHOD
/begin COMPU_METHOD m_uw_b6553p5 "" RAT_FUNC "%6.3" "kg/h" COEFFS 0 1 0 0 0 0.1 /end COMPU_METHOD
/begin COMPU_METHOD nmotg_sw_q0p39 "" RAT_FUNC "%6.3" "1/min/s" COEFFS 0 1 0 0 0 0.39063 /end COMPU_METHOD
/begin COMPU_METHOD nmot_sw_q0p25 "" RAT_FUNC "%6.3" "1/min" COEFFS 0 1 0 0 0 0.25 /end COMPU_METHOD
/begin COMPU_METHOD nmot_ub_q10 "" RAT_FUNC "%6.1" "1/min" COEFFS 0 1 0 0 0 10 /end COMPU_METHOD
/begin COMPU_METHOD nmot_ub_q40 "" RAT_FUNC "%6.1" "1/min" COEFFS 0 1 0 0 0 40 /end COMPU_METHOD
/begin COMPU_METHOD nmot_uw_q0p25 "" RAT_FUNC "%6.3" "1/min" COEFFS 0 1 0 0 0 0.25 /end COMPU_METHOD
/begin COMPU_METHOD p_uw_q0p039 "" RAT_FUNC "%6.4" "hPa" COEFFS 0 256 0 0 0 10 /end COMPU_METHOD
/begin COMPU_METHOD relNWU_q0p0234 "" RAT_FUNC "%6.4" "%/NWU" COEFFS 0 32 0 0 0 0.75 /end COMPU_METHOD
/begin COMPU_METHOD rel_sb_q0p75 "" RAT_FUNC "%6.3" "%" COEFFS 0 1 0 0 0 0.75 /end COMPU_METHOD
/begin COMPU_METHOD rel_sw_b1536 "" RAT_FUNC "%6.4" "%" COEFFS 0 65536 0 0 0 3072 /end COMPU_METHOD
/begin COMPU_METHOD rel_sw_q0p1875 "" RAT_FUNC "%6.3" "%" COEFFS 0 65536 0 0 0 12288 /end COMPU_METHOD
/begin COMPU_METHOD rel_ub_b100 "" RAT_FUNC "%6.3" "%" COEFFS 0 255 0 0 0 100 /end COMPU_METHOD
/begin COMPU_METHOD rel_ub_b1p4941 "" RAT_FUNC "%6.4" "%" COEFFS 0 256 0 0 0 1.5 /end COMPU_METHOD
/begin COMPU_METHOD rel_ub_b99p6 "" RAT_FUNC "%6.3" "%" COEFFS 0 256 0 0 0 100 /end COMPU_METHOD
/begin COMPU_METHOD rel_ub_q0p75 "" RAT_FUNC "%6.3" "%" COEFFS 0 1 0 0 0 0.75 /end COMPU_METHOD
/begin COMPU_METHOD rel_uw_b100 "" RAT_FUNC "%6.4" "%" COEFFS 0 65536 0 0 0 100 /end COMPU_METHOD
/begin COMPU_METHOD rel_uw_b6144 "" RAT_FUNC "%6.3" "%" COEFFS 0 65536 0 0 0 6144 /end COMPU_METHOD
/begin COMPU_METHOD rel_uw_q0p0234 "" RAT_FUNC "%6.4" "%" COEFFS 0 32 0 0 0 0.75 /end COMPU_METHOD
/begin COMPU_METHOD rel_uw_q0p125 "" RAT_FUNC "%6.3" "%" COEFFS 0 8 0 0 0 1 /end COMPU_METHOD
/begin COMPU_METHOD rel_uw_q0p1875 "" RAT_FUNC "%6.3" "%" COEFFS 0 65536 0 0 0 12288 /end COMPU_METHOD
/begin COMPU_METHOD spg_ubatt "" RAT_FUNC "%6.3" "V" COEFFS 0 1 0 0 0 0.0942 /end COMPU_METHOD
/begin COMPU_METHOD sprzivg_q0p781 "" RAT_FUNC "%6.3" "Grad KW/s" COEFFS 0 1.28 0 0 0 1 /end COMPU_METHOD
/begin COMPU_METHOD sprzi_q0p05 "" RAT_FUNC "%3.2" "Grad KW" COEFFS 0 20 0 0 0 1 /end COMPU_METHOD
/begin COMPU_METHOD sprzi_q0p1 "" RAT_FUNC "%4.2" "Grad KW" COEFFS 0 10 0 0 0 1 /end COMPU_METHOD
/begin COMPU_METHOD sprzi_q0p1s32768 "" RAT_FUNC "%7.1" "Grad KW" COEFFS 0 10 32768 0 0 1 /end COMPU_METHOD
/begin COMPU_METHOD t100msxs_sb_q0p01 "" RAT_FUNC "%6.4" "s" COEFFS 0 1 0 0 0 0.01 /end COMPU_METHOD
/begin COMPU_METHOD t100msxs_ub_b25p5 "" RAT_FUNC "%6.3" "s" COEFFS 0 1 0 0 0 0.1 /end COMPU_METHOD
/begin COMPU_METHOD t100msxs_uw_b6553p5 "" RAT_FUNC "%6.3" "s" COEFFS 0 1 0 0 0 0.1 /end COMPU_METHOD
/begin COMPU_METHOD t100msxs_uw_b6553p6 "" RAT_FUNC "%6.3" "s" COEFFS 0 10 0 0 0 1 /end COMPU_METHOD
/begin COMPU_METHOD t10msxs_ub_b2p55 "" RAT_FUNC "%6.4" "s" COEFFS 0 1 0 0 0 0.01 /end COMPU_METHOD
/begin COMPU_METHOD t10msxs_uw_b655p35 "" RAT_FUNC "%6.4" "s" COEFFS 0 1 0 0 0 0.01 /end COMPU_METHOD
/begin COMPU_METHOD t1sxs_ub_b255 "" RAT_FUNC "%6.2" "s" COEFFS 0 1 0 0 0 1 /end COMPU_METHOD
/begin COMPU_METHOD t1sxs_uw_q1 "" RAT_FUNC "%6.2" "s" COEFFS 0 1 0 0 0 1 /end COMPU_METHOD
/begin COMPU_METHOD t200msxs_ub_b51 "" RAT_FUNC "%6.3" "s" COEFFS 0 1 0 0 0 0.2 /end COMPU_METHOD
/begin COMPU_METHOD t20msxs_uw_b1310 "" RAT_FUNC "%7.4" "s" COEFFS 0 1 0 0 0 0.02 /end COMPU_METHOD
/begin COMPU_METHOD t50msxs_ub_b12p75 "" RAT_FUNC "%6.4" "s" COEFFS 0 1 0 0 0 0.05 /end COMPU_METHOD
/begin COMPU_METHOD t6minxmin_q6 "" RAT_FUNC "%6.2" "min" COEFFS 0 1 0 0 0 6 /end COMPU_METHOD
/begin COMPU_METHOD temp_q0p0234_o273 "" RAT_FUNC "%6.1" "Grad C" COEFFS 0 1 273.15 0 0 0.0234375 /end COMPU_METHOD
/begin COMPU_METHOD temp_ub_b191p25 "" RAT_FUNC "%6.3" "Grad C" COEFFS 0 1 0 0 0 0.75 /end COMPU_METHOD
/begin COMPU_METHOD temp_ub_q0p75_o48 "" RAT_FUNC "%6.2" "Grad C" COEFFS 0 1 48 0 0 0.75 /end COMPU_METHOD
/begin COMPU_METHOD temp_ub_q5_o50 "" RAT_FUNC "%6.2" "Grad C" COEFFS 0 1 50 0 0 5 /end COMPU_METHOD
/begin COMPU_METHOD tmin_uw_q1 "" RAT_FUNC "%6.2" "min" COEFFS 0 1 0 0 0 1 /end COMPU_METHOD
/begin COMPU_METHOD txms_uw_q0p001 "" RAT_FUNC "%6.5" "ms" COEFFS 0 1000 0 0 0 1 /end COMPU_METHOD
/begin COMPU_METHOD t_q0p1 "" RAT_FUNC "%6.3" "s" COEFFS 0 10 0 0 0 1 /end COMPU_METHOD
/begin COMPU_METHOD vfzg_ub_q1p25 "" RAT_FUNC "%6.2" "km/h" COEFFS 0 1 0 0 0 1.25 /end COMPU_METHOD
/begin COMPU_METHOD vfzg_uw_b512 "" RAT_FUNC "%6.4" "km/h" COEFFS 0 65536 0 0 0 512 /end COMPU_METHOD
/begin COMPU_METHOD vnstv_q0p00305 "" RAT_FUNC "%7.5" "%" COEFFS 0 327.68 0 0 0 1 /end COMPU_METHOD
/begin COMPU_METHOD vnstv_q0p00305s32768 "" RAT_FUNC "%7.3" "%" COEFFS 0 327.68 32768 0 0 1 /end COMPU_METHOD
/begin COMPU_METHOD vnstv_q0p01 "" RAT_FUNC "%7.5" "%" COEFFS 0 100 0 0 0 1 /end COMPU_METHOD
/begin COMPU_METHOD wkw_sw_b128 "" RAT_FUNC "%7.5" "Grad KW" COEFFS 0 256 0 0 0 1 /end COMPU_METHOD
/begin COMPU_METHOD zk100msxs_ub_b25p5 "" RAT_FUNC "%6.3" "s" COEFFS 0 0 256 0 10 0 /end COMPU_METHOD
/begin COMPU_METHOD zk100msxs_uw_b6553 "" RAT_FUNC "%10.3" "s" COEFFS 0 0 65536 0 10 0 /end COMPU_METHOD
/begin COMPU_METHOD zk10msxs_uw_b655 "" RAT_FUNC "%6.2" "s" COEFFS 0 0 65536 0 100 0 /end COMPU_METHOD
/begin COMPU_METHOD zk50msxs_uw_b3276p8 "" RAT_FUNC "%6.1" "s" COEFFS 0 0 65536 0 20 0 /end COMPU_METHOD
/begin COMPU_METHOD default "" RAT_FUNC "%6.2" "" COEFFS 0 1 0 0 0 1 /end COMPU_METHOD
/begin RECORD_LAYOUT FklWUw FNC_VALUES 1 UWORD COLUMN_DIR DIRECT /end RECORD_LAYOUT
/begin RECORD_LAYOUT GkfWUb FNC_VALUES 1 UBYTE COLUMN_DIR DIRECT /end RECORD_LAYOUT
/begin RECORD_LAYOUT GkfWUw FNC_VALUES 1 UWORD COLUMN_DIR DIRECT /end RECORD_LAYOUT
/begin RECORD_LAYOUT GklWS16 FNC_VALUES 1 SWORD COLUMN_DIR DIRECT /end RECORD_LAYOUT
/begin RECORD_LAYOUT GklWSw FNC_VALUES 1 SWORD COLUMN_DIR DIRECT /end RECORD_LAYOUT
/begin RECORD_LAYOUT GklWU8 FNC_VALUES 1 UBYTE COLUMN_DIR DIRECT /end RECORD_LAYOUT
/begin RECORD_LAYOUT GklWUb FNC_VALUES 1 UBYTE COLUMN_DIR DIRECT /end RECORD_LAYOUT
/begin RECORD_LAYOUT KfAxU8AyU8SstxU16SstyU16WU16 NO_AXIS_PTS_X 1 UWORD NO_AXIS_PTS_Y 2 UWORD AXIS_PTS_X 3 UWORD INDEX_INCR DIRECT AXIS_PTS_Y 4 UWORD INDEX_INCR DIRECT FNC_VALUES 5 UWORD COLUMN_DIR DIRECT /end RECORD_LAYOUT
/begin RECORD_LAYOUT KfAxU8AyU8SstxU8SstyU8WU8 NO_AXIS_PTS_X 1 UBYTE NO_AXIS_PTS_Y 2 UBYTE AXIS_PTS_X 3 UBYTE INDEX_INCR DIRECT AXIS_PTS_Y 4 UBYTE INDEX_INCR DIRECT FNC_VALUES 5 UBYTE COLUMN_DIR DIRECT /end RECORD_LAYOUT
/begin RECORD_LAYOUT KfAxUbAyUbSstxUbSstyUbWUb NO_AXIS_PTS_X 1 UBYTE NO_AXIS_PTS_Y 2 UBYTE AXIS_PTS_X 3 UBYTE INDEX_INCR DIRECT AXIS_PTS_Y 4 UBYTE INDEX_INCR DIRECT FNC_VALUES 5 UBYTE COLUMN_DIR DIRECT /end RECORD_LAYOUT
/begin RECORD_LAYOUT KfAxUbAyUbSstxUwSstyUbWUb NO_AXIS_PTS_X 1 UBYTE NO_AXIS_PTS_Y 2 UBYTE AXIS_PTS_X 3 UWORD INDEX_INCR DIRECT AXIS_PTS_Y 4 UBYTE INDEX_INCR DIRECT FNC_VALUES 5 UBYTE COLUMN_DIR DIRECT /end RECORD_LAYOUT
/begin RECORD_LAYOUT KlAUbSstUbWUb NO_AXIS_PTS_X 1 UBYTE AXIS_PTS_X 2 UBYTE INDEX_INCR DIRECT FNC_VALUES 3 UBYTE COLUMN_DIR DIRECT /end RECORD_LAYOUT
/begin RECORD_LAYOUT KlAUwSstUwWUw NO_AXIS_PTS_X 1 UWORD AXIS_PTS_X 2 UWORD INDEX_INCR DIRECT FNC_VALUES 3 UWORD COLUMN_DIR DIRECT /end RECORD_LAYOUT
/begin RECORD_LAYOUT KlAxU8SstxU8WU16 NO_AXIS_PTS_X 1 UBYTE AXIS_PTS_X 2 UBYTE INDEX_INCR DIRECT FNC_VALUES 3 UWORD COLUMN_DIR DIRECT /end RECORD_LAYOUT
/begin RECORD_LAYOUT KlAxU8SstxU8WU8 NO_AXIS_PTS_X 1 UBYTE AXIS_PTS_X 2 UBYTE INDEX_INCR DIRECT FNC_VALUES 3 UBYTE COLUMN_DIR DIRECT /end RECORD_LAYOUT
/begin RECORD_LAYOUT KwbUw FNC_VALUES 1 UWORD COLUMN_DIR DIRECT /end RECORD_LAYOUT
/begin RECORD_LAYOUT KwbWU16 FNC_VALUES 1 UWORD COLUMN_DIR DIRECT /end RECORD_LAYOUT
/begin RECORD_LAYOUT KwbWU8 FNC_VALUES 1 UBYTE COLUMN_DIR DIRECT /end RECORD_LAYOUT
/begin RECORD_LAYOUT KwSb FNC_VALUES 1 SBYTE COLUMN_DIR DIRECT /end RECORD_LAYOUT
/begin RECORD_LAYOUT KwSw FNC_VALUES 1 SWORD COLUMN_DIR DIRECT /end RECORD_LAYOUT
/begin RECORD_LAYOUT KwUb FNC_VALUES 1 UBYTE COLUMN_DIR DIRECT /end RECORD_LAYOUT
/begin RECORD_LAYOUT KwUw FNC_VALUES 1 UWORD COLUMN_DIR DIRECT /end RECORD_LAYOUT
/begin RECORD_LAYOUT KwWR32 FNC_VALUES 1 FLOAT32_IEEE COLUMN_DIR DIRECT /end RECORD_LAYOUT
/begin RECORD_LAYOUT KwWS16 FNC_VALUES 1 SWORD COLUMN_DIR DIRECT /end RECORD_LAYOUT
/begin RECORD_LAYOUT KwWU16 FNC_VALUES 1 UWORD COLUMN_DIR DIRECT /end RECORD_LAYOUT
/begin RECORD_LAYOUT KwWU8 FNC_VALUES 1 UBYTE COLUMN_DIR DIRECT /end RECORD_LAYOUT
/begin RECORD_LAYOUT SstAUbSstUb NO_AXIS_PTS_X 1 UBYTE AXIS_PTS_X 2 UBYTE INDEX_INCR DIRECT /end RECORD_LAYOUT
/begin RECORD_LAYOUT SstAUwSstUw NO_AXIS_PTS_X 1 UWORD AXIS_PTS_X 2 UWORD INDEX_INCR DIRECT /end RECORD_LAYOUT
/end MODULE
/end PROJECT
