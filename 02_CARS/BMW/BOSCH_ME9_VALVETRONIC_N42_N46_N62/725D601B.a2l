ASAP2_VERSION 1 3
/begin PROJECT _725D601B "725D601B"
/begin HEADER "" VERSION "_725D601B" PROJECT_NO _725D601B /end HEADER
/begin MODULE DIM ""
/begin MOD_COMMON "" BYTE_ORDER MSB_FIRST ALIGNMENT_BYTE 1 ALIGNMENT_WORD 2 ALIGNMENT_LONG 2 ALIGNMENT_FLOAT32_IEEE 4 /end MOD_COMMON
/begin CHARACTERISTIC BZULSGSV "max. zul‰ssige Fahrzeugl‰ngsbeschleunigung w‰hrend eines SGS-Eingriffs" CURVE 0xFD04E2 KlAUwSstUwWSw 1638.375 acc_sw_b819p1875 -819.2000 819.1750 FORMAT "%8.4"
 /begin AXIS_DESCR STD_AXIS vfzgv1f_w vfzg_uw_b512 3 0.00 511.9922 FORMAT "%8.4" DEPOSIT ABSOLUTE /end AXIS_DESCR
/end CHARACTERISTIC
/begin CHARACTERISTIC COXLEAN "Mager-Schwelle f¸r Sauerstoff-Konzentration" VALUE 0xFCFE6E KwSw 15.99976 fak_sw_b8 -8.000000 7.999756 FORMAT "%8.6" /end CHARACTERISTIC
/begin CHARACTERISTIC COXRICH "Fett-Schwelle f¸r Sauerstoff-Konzentration" VALUE 0xFCFE70 KwSw 15.99976 fak_sw_b8 -8.000000 7.999756 FORMAT "%8.6" /end CHARACTERISTIC
/begin CHARACTERISTIC CRENGOF "Offset f¸r Strombedarf Motor" VALUE 0xFCA47A KwWU8 127.0 i_vvt_ub_q0p50_om63p50 -63.50 63.50 FORMAT "%5.2" /end CHARACTERISTIC
/begin CHARACTERISTIC CRVVTNOT "" VALUE 0xFCA47B KwWU8 127.5 i_vvt_ub_q0p50_om63p50 -63.50 64.00 FORMAT "%5.2" /end CHARACTERISTIC
/begin CHARACTERISTIC CRVVTOF "Stromoffset VVT" VALUE 0xFCA47C KwWU8 64.00 i_vvt_ub_q0p50_om63p50 0.00 64.00 FORMAT "%5.2" /end CHARACTERISTIC
/begin CHARACTERISTIC CWBGACC "Codewort zur Konfiguration der BGACC" VALUE 0xFD046E KwUb 255.0 dez 0.00 255.0 FORMAT "%5.1" /end CHARACTERISTIC
/begin CHARACTERISTIC CWBGANZNMX "Codewort zur Konfiguration der Eingangsgrˆsse f¸r die KL" VALUE 0xFD04CC KwWU8 255.0 dez 0.00 255.0 FORMAT "%5.1" /end CHARACTERISTIC
/begin CHARACTERISTIC CWBGELSV "Codewort f¸r berechnete Grˆﬂe  Fehler LSV" VALUE 0xFCFE68 KwWU8 255.0 dez 0.00 255.0 FORMAT "%5.1" /end CHARACTERISTIC
/begin CHARACTERISTIC CWCCAPP "Applikationscodewort zum Test der CC-Funktionalit‰t" VALUE 0xFD04D4 KwWU32 4294967295.00 DEZ 0.00 4294967295.00 FORMAT "%13.2" /end CHARACTERISTIC
/begin CHARACTERISTIC CWCCFG "Codewort zur Freigabe der CC-Meldungen" VALUE 0xFD04D8 KwWU32 4294967295.00 DEZ 0.00 4294967295.00 FORMAT "%13.2" /end CHARACTERISTIC
/begin CHARACTERISTIC CWCCMASKNL "Codewort zur Freigabe bzw. R¸cksetzen der CC-Meldungen im Nachlauf" VALUE 0xFD04DC KwWU32 4294967295.00 DEZ 0.00 4294967295.00 FORMAT "%13.2" /end CHARACTERISTIC
/begin CHARACTERISTIC CWDVEFO "Codeword ˆffnende Federpr¸fung" VALUE 0xFC1F00 KwUb 255.0 dez 0.00 255.0 FORMAT "%5.1" /end CHARACTERISTIC
/begin CHARACTERISTIC CWLAMABM "Codewort Modellierung Lambda im Abgastrakt" VALUE 0xFC1F92 KwUb 255.0 dez 0.00 255.0 FORMAT "%5.1" /end CHARACTERISTIC
/begin CHARACTERISTIC CWOSCME "Codewort f¸r Optionen f¸r OSC-Messung in Funktion BGLAMABM" VALUE 0xFC1F93 KwUb 255.0 dez 0.00 255.0 FORMAT "%5.1" /end CHARACTERISTIC
/begin CHARACTERISTIC CW_BGKUPPL "" VALUE 0xFC215C KwWU8 1.000 dez 0.00 1.000 FORMAT "%5.3" /end CHARACTERISTIC
/begin CHARACTERISTIC DFRUTYP "DF-R¸ckschaltungstyp f¸r LLR-Anhebung" VALUE 0xFCA70D KwWU8 255.0 dez 0.00 255.0 FORMAT "%5.1" /end CHARACTERISTIC
/begin CHARACTERISTIC DFTEDS "Hysteresebreite Beladung f¸r Umschaltung auf Dauertankentl¸ftung" VALUE 0xFD1A28 KwSw 127.9980 fak_sw_b64 -64.00000 63.99805 FORMAT "%8.5" /end CHARACTERISTIC
/begin CHARACTERISTIC DKPSTGMIN "min. Steigung des DK-Poti zur Umr. abs. auf rel. Winkel im worst case" VALUE 0xFC1F18 KwUw 39.99939 rel_uw_b40 0.00 39.99939 FORMAT "%8.5" /end CHARACTERISTIC
/begin CHARACTERISTIC DLRPIDSTMN "min. Schwelle f¸r PWM-Tastverh‰ltnis des DLR bei temp. UMA-Adapt." VALUE 0xFC1F1A KwUw 99.99847 rel_uw_b100 0.00 99.99847 FORMAT "%8.5" /end CHARACTERISTIC
/begin CHARACTERISTIC DMAUFASC "Deltamoment Aufregelung nach ASC-Fehler" VALUE 0xFC20DA KwWU16 99.99847 rel_uw_b100 0.00 99.99847 FORMAT "%8.5" /end CHARACTERISTIC
/begin CHARACTERISTIC DMRFATE "Hysterese Hochlasterkennung" VALUE 0xFD1A1A KwUb 99.61 rel_ub_b99p6 0.00 99.61 FORMAT "%5.2" /end CHARACTERISTIC
/begin CHARACTERISTIC DMRSSGE "Delta Moment f¸r Rampenabregelung im SSG-Fehlerfall (nach erhˆhendem Eingriff)" VALUE 0xFC20F0 KwWU16 99.99847 rel_uw_b100 0.00 99.99847 FORMAT "%8.5" /end CHARACTERISTIC
/begin CHARACTERISTIC DMRSSGR "Delta Moment f¸r Rampenaufregelung im SSG-Fehlerfall (nach reduzier. Eingriff)" VALUE 0xFC20F2 KwWU16 99.99847 rel_uw_b100 0.00 99.99847 FORMAT "%8.5" /end CHARACTERISTIC
/begin CHARACTERISTIC DNSAH "Delta n SA high bezogen auf nWE" VALUE 0xFC8738 KwUb 5080. nmot_ub_q40 0.00 5080. FORMAT "%5.0" /end CHARACTERISTIC
/begin CHARACTERISTIC DNSAHZDV "Delta n SA high bezogen auf nWE DVFZ aktiv Z_vfz false" VALUE 0xFC8739 KwUb 5080. nmot_ub_q40 0.00 5080. FORMAT "%5.0" /end CHARACTERISTIC
/begin CHARACTERISTIC DNSAL "Delta n SA low bezogen auf nWE" VALUE 0xFC873A KwUb 5080. nmot_ub_q40 0.00 5080. FORMAT "%5.0" /end CHARACTERISTIC
/begin CHARACTERISTIC DNSALZDV "Delta n SA low bezogen auf nWE  DVFZ aktiv Z_vfz false" VALUE 0xFC873B KwUb 5080. nmot_ub_q40 0.00 5080. FORMAT "%5.0" /end CHARACTERISTIC
/begin CHARACTERISTIC DNSLL "Schubabschalte-Hysterese bei WE im Leerlauf" VALUE 0xFC873C KwUb 10200. nmot_ub_q40 0.00 10200. FORMAT "%5.0" /end CHARACTERISTIC
/begin CHARACTERISTIC DNSLLZDV "Schubabschalte-Hysterese bei WE im Leerlauf DVFZ aktiv Z_vfz false" VALUE 0xFC873D KwUb 10200. nmot_ub_q40 0.00 10200. FORMAT "%5.0" /end CHARACTERISTIC
/begin CHARACTERISTIC DNVSA "Schubabschaltedrehzahlanhebung bei kleiner Geschwindigkeit" VALUE 0xFC873E KwUb 10200. nmot_ub_q40 0.00 10200. FORMAT "%5.0" /end CHARACTERISTIC
/begin CHARACTERISTIC DNVSAZDV "Schubabschaltedrehzahlanhebung bei kleiner Geschwindigkeit DVFZ Aktiv Z_vfz fals" VALUE 0xFC873F KwUb 10200. nmot_ub_q40 0.00 10200. FORMAT "%5.0" /end CHARACTERISTIC
/begin CHARACTERISTIC DNWEK "Delta n f¸r WE bei Klima (AC)" VALUE 0xFC8740 KwUb 10200. nmot_ub_q40 0.00 10200. FORMAT "%5.0" /end CHARACTERISTIC
/begin CHARACTERISTIC DNWEKZDV "Delta n f¸r WE bei Klima (AC) DVFZ aktiv Z_vfz false" VALUE 0xFC8741 KwUb 10200. nmot_ub_q40 0.00 10200. FORMAT "%5.0" /end CHARACTERISTIC
/begin CHARACTERISTIC DOXSG "Maximale Differenz Sauerstoff-F¸llstandes von Integratorgrenze f¸r B_oscmeb" VALUE 0xFCFE72 KwUw 6553.500 m_q0p1_mg 0.00 6553.500 FORMAT "%8.3" /end CHARACTERISTIC
/begin CHARACTERISTIC DUDKNLPO "Toleranzband f¸r NLP nach oben (inkl. R¸)" VALUE 0xFC1F1C KwUw 4.998779 spg_uw_q0p001222 0.00 4.998779 FORMAT "%8.6" /end CHARACTERISTIC
/begin CHARACTERISTIC DUDKNLPU "Toleranzband f¸r NLP nach unten" VALUE 0xFC1F1E KwUw 4.998779 spg_uw_q0p001222 0.00 4.998779 FORMAT "%8.6" /end CHARACTERISTIC
/begin CHARACTERISTIC DUDKPTMP "Delta eines Rampenschrittes bei der temp. UMA-Adaption" VALUE 0xFC1F20 KwUw 79.99390 spg_uw_q0p001222 0.004882813 79.99878 FORMAT "%8.5" /end CHARACTERISTIC
/begin CHARACTERISTIC DVSA "delta Geschwindigkeitsschwelle f¸r SA-Drehzahlanhebung" VALUE 0xFC8742 KwUb 318.8 vfzg_ub_q1p25 0.00 318.8 FORMAT "%5.1" /end CHARACTERISTIC
/begin CHARACTERISTIC DYNLSULAU "Schwelle f¸r dynlsu_w f¸r Umschaltung auf Soll-Lambda f¸r Lambda-Modellierung" VALUE 0xFC1F94 KwUw 15.99976 fak_uw_b16 0.00 15.99976 FORMAT "%8.5" /end CHARACTERISTIC
/begin CHARACTERISTIC ENASAG "Freigabe SA gangabhaengig" VALUE 0xFC8743 KwUb 255.0 dez 0.00 255.0 FORMAT "%5.1" /end CHARACTERISTIC
/begin CHARACTERISTIC FCOSCHKIN "Initialisierungswert f¸r OSC-Korrekturfaktor f¸r den Hauptkatalysator" VALUE 0xFCFE6A KwUb 1.992 fak_ub_b2 0.00 1.992 FORMAT "%5.3" /end CHARACTERISTIC
/begin CHARACTERISTIC FCOSCHKIN2 "Initialisierungswert f¸r OSC-Korrekturfaktor f¸r den Hauptkatalysator, Bank 2" VALUE 0xFCFE6B KwUb 1.992 fak_ub_b2 0.00 1.992 FORMAT "%5.3" /end CHARACTERISTIC
/begin CHARACTERISTIC FFCOSC "Ereignisfilterkonstante f¸r OSC-Korrekturfaktor" VALUE 0xFCFE74 KwUw 0.9999847 fak_uw_b1 0.00 0.9999847 FORMAT "%9.7" /end CHARACTERISTIC
/begin CHARACTERISTIC FKEEV0N "Korrekturfaktor zur Einspritzzeitkorrektur Ev1" CURVE 0xFC6883 GklWU8 1.992 fak_ub_b2 0.00 1.992 FORMAT "%5.3"
 /begin AXIS_DESCR COM_AXIS nmot nmot_ub_q40 8 0.00 10200. FORMAT "%5.0" AXIS_PTS_REF SNM08GKUB /end AXIS_DESCR
/end CHARACTERISTIC
/begin CHARACTERISTIC FKEEV1N "Korrekturfaktor zur Einspritzzeitkorrektur Ev2" CURVE 0xFC688B GklWU8 1.992 fak_ub_b2 0.00 1.992 FORMAT "%5.3"
 /begin AXIS_DESCR COM_AXIS nmot nmot_ub_q40 8 0.00 10200. FORMAT "%5.0" AXIS_PTS_REF SNM08GKUB /end AXIS_DESCR
/end CHARACTERISTIC
/begin CHARACTERISTIC FKEEV2N "Korrekturfaktor zur Einspritzzeitkorrektur Ev3" CURVE 0xFC6893 GklWU8 1.992 fak_ub_b2 0.00 1.992 FORMAT "%5.3"
 /begin AXIS_DESCR COM_AXIS nmot nmot_ub_q40 8 0.00 10200. FORMAT "%5.0" AXIS_PTS_REF SNM08GKUB /end AXIS_DESCR
/end CHARACTERISTIC
/begin CHARACTERISTIC FKEEV3N "Korrekturfaktor zur Einspritzzeitkorrektur Ev4" CURVE 0xFC689B GklWU8 1.992 fak_ub_b2 0.00 1.992 FORMAT "%5.3"
 /begin AXIS_DESCR COM_AXIS nmot nmot_ub_q40 8 0.00 10200. FORMAT "%5.0" AXIS_PTS_REF SNM08GKUB /end AXIS_DESCR
/end CHARACTERISTIC
/begin CHARACTERISTIC FKEEV4N "Korrekturfaktor zur Einspritzzeitkorrektur Ev5" CURVE 0xFC68A3 GklWU8 1.992 fak_ub_b2 0.00 1.992 FORMAT "%5.3"
 /begin AXIS_DESCR COM_AXIS nmot nmot_ub_q40 8 0.00 10200. FORMAT "%5.0" AXIS_PTS_REF SNM08GKUB /end AXIS_DESCR
/end CHARACTERISTIC
/begin CHARACTERISTIC FKEEV5N "Korrekturfaktor zur Einspritzzeitkorrektur Ev6" CURVE 0xFC68AB GklWU8 1.992 fak_ub_b2 0.00 1.992 FORMAT "%5.3"
 /begin AXIS_DESCR COM_AXIS nmot nmot_ub_q40 8 0.00 10200. FORMAT "%5.0" AXIS_PTS_REF SNM08GKUB /end AXIS_DESCR
/end CHARACTERISTIC
/begin CHARACTERISTIC FKEEV6N "Korrekturfaktor zur Einspritzzeitkorrektur Ev7" CURVE 0xFC68B3 GklWU8 1.992 fak_ub_b2 0.00 1.992 FORMAT "%5.3"
 /begin AXIS_DESCR COM_AXIS nmot nmot_ub_q40 8 0.00 10200. FORMAT "%5.0" AXIS_PTS_REF SNM08GKUB /end AXIS_DESCR
/end CHARACTERISTIC
/begin CHARACTERISTIC FKEEV7N "Korrekturfaktor zur Einspritzzeitkorrektur Ev8" CURVE 0xFC68BB GklWU8 1.992 fak_ub_b2 0.00 1.992 FORMAT "%5.3"
 /begin AXIS_DESCR COM_AXIS nmot nmot_ub_q40 8 0.00 10200. FORMAT "%5.0" AXIS_PTS_REF SNM08GKUB /end AXIS_DESCR
/end CHARACTERISTIC
/begin CHARACTERISTIC FMRFAZTE "Gewichtung der Drehzahl um jetzige Leistung zu berechnen" CURVE 0xFD1A1B KlAUbSstUbWUb 3.984 fak_ub_b4 0.00 3.984 FORMAT "%5.3"
 /begin AXIS_DESCR STD_AXIS nmot nmot_ub_q40 4 0.00 10200. FORMAT "%5.0" DEPOSIT ABSOLUTE /end AXIS_DESCR
/end CHARACTERISTIC
/begin CHARACTERISTIC FPRAT "Ansauglufttemperaturschwelle f¸r DV-E-Federpr¸fung" VALUE 0xFC1F01 KwUb 191.3 temp_ub_q0p75_o48 -48.00 143.3 FORMAT "%5.1" /end CHARACTERISTIC
/begin CHARACTERISTIC FPRMT "Motortemperaturschwelle f¸r DV-E-Federpr¸fung" VALUE 0xFC1F02 KwUb 191.3 temp_ub_q0p75_o48 -48.00 143.3 FORMAT "%5.1" /end CHARACTERISTIC
/begin CHARACTERISTIC FPRNMAX "Motordrehzahlschwelle f¸r DV-E-Federpr¸fung" VALUE 0xFC1F03 KwUb 2550. nmot_ub_q10 0.00 2550. FORMAT "%5.0" /end CHARACTERISTIC
/begin CHARACTERISTIC FPRTIM1_T "DV-E-Federpr¸fung, Wartezeit in Pr¸fschritt 1" VALUE 0xFC1F04 KwUb 2.540 t10msxs_ub_b2p55 0.01000 2.550 FORMAT "%5.3" /end CHARACTERISTIC
/begin CHARACTERISTIC FPRTIM2_T "DV-E-Federpr¸fung, Wartezeit in Pr¸fschritt 2" VALUE 0xFC1F05 KwUb 2.540 t10msxs_ub_b2p55 0.01000 2.550 FORMAT "%5.3" /end CHARACTERISTIC
/begin CHARACTERISTIC FPRTIM3_T "DV-E-Federpr¸fung: Wartezeit in Pr¸fschritt 5" VALUE 0xFC1F06 KwUb 2.540 t10msxs_ub_b2p55 0.01000 2.550 FORMAT "%5.3" /end CHARACTERISTIC
/begin CHARACTERISTIC FPRTIM4_T "DV-E-Federpr¸fung: Wartezeit in Pr¸fschritt 6" VALUE 0xFC1F07 KwUb 2.540 t10msxs_ub_b2p55 0.01000 2.550 FORMAT "%5.3" /end CHARACTERISTIC
/begin CHARACTERISTIC FTEADZU "Schwelle Beladung f¸r Unterbrechung TE-Phase f¸r Diagnose Funktionen" VALUE 0xFD1A2A KwSw 127.9980 fak_sw_b64 -64.00000 63.99805 FORMAT "%8.5" /end CHARACTERISTIC
/begin CHARACTERISTIC FTEDS "Schwelle Beladung f¸r Umschaltung auf Dauertankentl¸ftung" VALUE 0xFD1A2C KwSw 127.9980 fak_sw_b64 -64.00000 63.99805 FORMAT "%8.5" /end CHARACTERISTIC
/begin CHARACTERISTIC FWAFSNWE "Momentenschwelle AFS f¸r nwe" VALUE 0xFC874A KwUw 99.99847 rel_uw_b100 0.00 99.99847 FORMAT "%8.5" /end CHARACTERISTIC
/begin CHARACTERISTIC FWARSNWE "Momentenschwelle ARS f¸r nwe" VALUE 0xFC874C KwUw 99.99847 rel_uw_b100 0.00 99.99847 FORMAT "%8.5" /end CHARACTERISTIC
/begin CHARACTERISTIC IGENLLRANH "Generatorstromabstand f¸r LL-Anhebung" VALUE 0xFCA70E KwWU8 254.0 igen_ub_q1 0.00 254.0 FORMAT "%5.1" /end CHARACTERISTIC
/begin CHARACTERISTIC KDCOXRHK "Kennfeld Sauerstoff-Speicher-Korrektur Hauptkat" MAP 0xFCFE76 KfAxUwAyUwSstxUwSstyUwWSw 15.99976 fak_sw_b8 -8.000000 7.999756 FORMAT "%8.6"
 /begin AXIS_DESCR STD_AXIS ushk_w spg_uw_q0p00488_o1 7 -1.000000 318.9951 FORMAT "%8.4" DEPOSIT ABSOLUTE /end AXIS_DESCR
 /begin AXIS_DESCR STD_AXIS rolhkdl_w fak_uw_b2 7 0.00 1.999969 FORMAT "%8.6" DEPOSIT ABSOLUTE /end AXIS_DESCR
/end CHARACTERISTIC
/begin CHARACTERISTIC KFDFIGEN0 "" MAP 0xFCA47D KfAxU8AyU8SstxU8SstyU8WU8 99.61 PCENT 0.00 99.61 FORMAT "%5.2"
 /begin AXIS_DESCR STD_AXIS genitemp2 igen_ub_q1 8 0.00 255.0 FORMAT "%5.1" DEPOSIT ABSOLUTE /end AXIS_DESCR
 /begin AXIS_DESCR STD_AXIS igenrllrah igen_ub_q1 8 0.00 255.0 FORMAT "%5.1" DEPOSIT ABSOLUTE /end AXIS_DESCR
/end CHARACTERISTIC
/begin CHARACTERISTIC KFDFIGEN1 "" MAP 0xFCA4CF KfAxU8AyU8SstxU8SstyU8WU8 99.61 PCENT 0.00 99.61 FORMAT "%5.2"
 /begin AXIS_DESCR STD_AXIS genitemp2 igen_ub_q1 8 0.00 255.0 FORMAT "%5.1" DEPOSIT ABSOLUTE /end AXIS_DESCR
 /begin AXIS_DESCR STD_AXIS igenrllrah igen_ub_q1 8 0.00 255.0 FORMAT "%5.1" DEPOSIT ABSOLUTE /end AXIS_DESCR
/end CHARACTERISTIC
/begin CHARACTERISTIC KFDFIGEN2 "" MAP 0xFCA521 KfAxU8AyU8SstxU8SstyU8WU8 99.61 PCENT 0.00 99.61 FORMAT "%5.2"
 /begin AXIS_DESCR STD_AXIS genitemp2 igen_ub_q1 8 0.00 255.0 FORMAT "%5.1" DEPOSIT ABSOLUTE /end AXIS_DESCR
 /begin AXIS_DESCR STD_AXIS igenrllrah igen_ub_q1 8 0.00 255.0 FORMAT "%5.1" DEPOSIT ABSOLUTE /end AXIS_DESCR
/end CHARACTERISTIC
/begin CHARACTERISTIC KFDFIGEN3 "" MAP 0xFCA573 KfAxU8AyU8SstxU8SstyU8WU8 99.61 PCENT 0.00 99.61 FORMAT "%5.2"
 /begin AXIS_DESCR STD_AXIS genitemp2 igen_ub_q1 8 0.00 255.0 FORMAT "%5.1" DEPOSIT ABSOLUTE /end AXIS_DESCR
 /begin AXIS_DESCR STD_AXIS igenrllrah igen_ub_q1 8 0.00 255.0 FORMAT "%5.1" DEPOSIT ABSOLUTE /end AXIS_DESCR
/end CHARACTERISTIC
/begin CHARACTERISTIC KFDFIGEN4 "" MAP 0xFCA5C5 KfAxU8AyU8SstxU8SstyU8WU8 99.61 PCENT 0.00 99.61 FORMAT "%5.2"
 /begin AXIS_DESCR STD_AXIS genitemp2 igen_ub_q1 8 0.00 255.0 FORMAT "%5.1" DEPOSIT ABSOLUTE /end AXIS_DESCR
 /begin AXIS_DESCR STD_AXIS igenrllrah igen_ub_q1 8 0.00 255.0 FORMAT "%5.1" DEPOSIT ABSOLUTE /end AXIS_DESCR
/end CHARACTERISTIC
/begin CHARACTERISTIC KFDFIGEN5 "" MAP 0xFCA617 KfAxU8AyU8SstxU8SstyU8WU8 99.61 PCENT 0.00 99.61 FORMAT "%5.2"
 /begin AXIS_DESCR STD_AXIS genitemp2 igen_ub_q1 8 0.00 255.0 FORMAT "%5.1" DEPOSIT ABSOLUTE /end AXIS_DESCR
 /begin AXIS_DESCR STD_AXIS igenrllrah igen_ub_q1 8 0.00 255.0 FORMAT "%5.1" DEPOSIT ABSOLUTE /end AXIS_DESCR
/end CHARACTERISTIC
/begin CHARACTERISTIC KFDFIGEN6 "" MAP 0xFCA669 KfAxU8AyU8SstxU8SstyU8WU8 99.61 PCENT 0.00 99.61 FORMAT "%5.2"
 /begin AXIS_DESCR STD_AXIS genitemp2 igen_ub_q1 8 0.00 255.0 FORMAT "%5.1" DEPOSIT ABSOLUTE /end AXIS_DESCR
 /begin AXIS_DESCR STD_AXIS igenrllrah igen_ub_q1 8 0.00 255.0 FORMAT "%5.1" DEPOSIT ABSOLUTE /end AXIS_DESCR
/end CHARACTERISTIC
/begin CHARACTERISTIC KFDFIGEN7 "" MAP 0xFCA6BB KfAxU8AyU8SstxU8SstyU8WU8 99.61 PCENT 0.00 99.61 FORMAT "%5.2"
 /begin AXIS_DESCR STD_AXIS genitemp2 igen_ub_q1 8 0.00 255.0 FORMAT "%5.1" DEPOSIT ABSOLUTE /end AXIS_DESCR
 /begin AXIS_DESCR STD_AXIS igenrllrah igen_ub_q1 8 0.00 255.0 FORMAT "%5.1" DEPOSIT ABSOLUTE /end AXIS_DESCR
/end CHARACTERISTIC
/begin CHARACTERISTIC KFELUPWM39 "" MAP 0xFCA30C KfAxU8AyU8SstxU16SstyU16WU16 64.00000 i_eluft_q0p0625 0.00 64.00000 FORMAT "%8.5"
 /begin AXIS_DESCR STD_AXIS taml_tmp rel_ub_b100 7 0.00 100.0000 FORMAT "%8.4" DEPOSIT ABSOLUTE /end AXIS_DESCR
 /begin AXIS_DESCR STD_AXIS vfzg_tmp vfzg_ub_q1p25 7 0.00 318.7500 FORMAT "%8.4" DEPOSIT ABSOLUTE /end AXIS_DESCR
/end CHARACTERISTIC
/begin CHARACTERISTIC KFELUPWM60 "" MAP 0xFCA38E KfAxU8AyU8SstxU16SstyU16WU16 64.00000 i_eluft_q0p0625 0.00 64.00000 FORMAT "%8.5"
 /begin AXIS_DESCR STD_AXIS taml_tmp rel_ub_b100 7 0.00 100.0000 FORMAT "%8.4" DEPOSIT ABSOLUTE /end AXIS_DESCR
 /begin AXIS_DESCR STD_AXIS vfzg_tmp vfzg_ub_q1p25 7 0.00 318.7500 FORMAT "%8.4" DEPOSIT ABSOLUTE /end AXIS_DESCR
/end CHARACTERISTIC
/begin CHARACTERISTIC KFLAMSLS "Kennfeld Lambda-Korrektur bei Sekund‰rluft" MAP 0xFC1F96 KfAxUbAyUbSstxUbSstyUbWUb 1.992 fak_ub_b2 0.00 1.992 FORMAT "%5.3"
 /begin AXIS_DESCR STD_AXIS nmot nmot_ub_q40 8 0.00 10200. FORMAT "%5.0" DEPOSIT ABSOLUTE /end AXIS_DESCR
 /begin AXIS_DESCR STD_AXIS rl rel_ub_q0p75 8 0.00 191.3 FORMAT "%5.1" DEPOSIT ABSOLUTE /end AXIS_DESCR
/end CHARACTERISTIC
/begin CHARACTERISTIC KFOSCHN "Kennfeld Sauerstoff-Speicherf‰higkeit eines neuen Hauptkatalysators" MAP 0xFCFEF8 KfAxUwAyUwSstxUwSstyUwWUw 6553.500 m_q0p1_mg 0.00 6553.500 FORMAT "%8.3"
 /begin AXIS_DESCR STD_AXIS tkihkm_w temp_q0p0234_o273 8 -273.1500 1262.827 FORMAT "%8.3" DEPOSIT ABSOLUTE /end AXIS_DESCR
 /begin AXIS_DESCR STD_AXIS msabvhk_w m_uw_b6553p5 8 0.00 6553.500 FORMAT "%8.3" DEPOSIT ABSOLUTE /end AXIS_DESCR
/end CHARACTERISTIC
/begin CHARACTERISTIC KFOSCHN2 "Kennfeld Sauerstoff-Speicherf‰higkeit eines neuen Hauptkatalysators, Bank 2" MAP 0xFCFF9C KfAxUwAyUwSstxUwSstyUwWUw 6553.500 m_q0p1_mg 0.00 6553.500 FORMAT "%8.3"
 /begin AXIS_DESCR STD_AXIS tkihkm2_w temp_q0p0234_o273 8 -273.1500 1262.827 FORMAT "%8.3" DEPOSIT ABSOLUTE /end AXIS_DESCR
 /begin AXIS_DESCR STD_AXIS msabvhk2_w m_uw_b6553p5 8 0.00 6553.500 FORMAT "%8.3" DEPOSIT ABSOLUTE /end AXIS_DESCR
/end CHARACTERISTIC
/begin CHARACTERISTIC KFTVSA "Verzˆgerungszeit f¸r Schubabschalten" MAP 0xFD30A4 GkfWUb 5.100 t20msxs_ub_b5p1 0.00 5.100 FORMAT "%5.3"
 /begin AXIS_DESCR COM_AXIS tmot temp_ub_q0p75_o48 5 -48.00 143.3 FORMAT "%5.1" AXIS_PTS_REF STM05SAUB /end AXIS_DESCR
 /begin AXIS_DESCR COM_AXIS nmot nmot_ub_q40 8 0.00 10200. FORMAT "%5.0" AXIS_PTS_REF SNM08__UB /end AXIS_DESCR
/end CHARACTERISTIC
/begin CHARACTERISTIC KFTVSAM "Verzˆgerungszeit f¸r Schubabschalten" MAP 0xFD30CC GkfWUb 5.100 t20msxs_ub_b5p1 0.00 5.100 FORMAT "%5.3"
 /begin AXIS_DESCR COM_AXIS tmot temp_ub_q0p75_o48 5 -48.00 143.3 FORMAT "%5.1" AXIS_PTS_REF STM05SAUB /end AXIS_DESCR
 /begin AXIS_DESCR COM_AXIS nmot nmot_ub_q40 8 0.00 10200. FORMAT "%5.0" AXIS_PTS_REF SNM08__UB /end AXIS_DESCR
/end CHARACTERISTIC
/begin CHARACTERISTIC KLAOBT "Kennlinie Anfang oranger Bereich Drehzahlmesser" CURVE 0xFD0492 KlAxU8SstxU8WU16 16383.75 nmot_uw_q0p25 0.00 16383.75 FORMAT "%8.2"
 /begin AXIS_DESCR STD_AXIS tmottol temp_ub_q0p75_o48 6 -48.00 143.3 FORMAT "%5.1" DEPOSIT ABSOLUTE /end AXIS_DESCR
/end CHARACTERISTIC
/begin CHARACTERISTIC KLARBT "Kennlinie Anfang roter Bereich Drehzahlmesser" CURVE 0xFD04A6 KlAxU8SstxU8WU16 16383.75 nmot_uw_q0p25 0.00 16383.75 FORMAT "%8.2"
 /begin AXIS_DESCR STD_AXIS tmottol temp_ub_q0p75_o48 6 -48.00 143.3 FORMAT "%5.1" DEPOSIT ABSOLUTE /end AXIS_DESCR
/end CHARACTERISTIC
/begin CHARACTERISTIC KLELSLP "" CURVE 0xFCA470 KlAxU8SstxU8WU16 255.0000 i_eluft_q0p0625 0.00 255.0000 FORMAT "%8.4"
 /begin AXIS_DESCR STD_AXIS ub_tmp spg_ubatt 3 0.00 24.02100 FORMAT "%8.5" DEPOSIT ABSOLUTE /end AXIS_DESCR
/end CHARACTERISTIC
/begin CHARACTERISTIC KLELTEMP39 "" CURVE 0xFCA410 KlAxU8SstxU16WU16 1.992188 fak_ub_b2 0.00 1.992188 FORMAT "%8.6"
 /begin AXIS_DESCR STD_AXIS tans_tmp temp_ub_q0p75_o48 6 -48.00000 143.2500 FORMAT "%8.4" DEPOSIT ABSOLUTE /end AXIS_DESCR
/end CHARACTERISTIC
/begin CHARACTERISTIC KLELTEMP60 "" CURVE 0xFCA42A KlAxU8SstxU16WU16 1.992188 fak_ub_b2 0.00 1.992188 FORMAT "%8.6"
 /begin AXIS_DESCR STD_AXIS tans_tmp temp_ub_q0p75_o48 6 -48.00000 143.2500 FORMAT "%8.4" DEPOSIT ABSOLUTE /end AXIS_DESCR
/end CHARACTERISTIC
/begin CHARACTERISTIC KLELUB39 "" CURVE 0xFCA444 KlAxU8SstxU16WU16 1.992188 fak_ub_b2 0.00 1.992188 FORMAT "%8.6"
 /begin AXIS_DESCR STD_AXIS ub_tmp spg_ubatt 5 0.00 24.02100 FORMAT "%8.5" DEPOSIT ABSOLUTE /end AXIS_DESCR
/end CHARACTERISTIC
/begin CHARACTERISTIC KLELUB60 "" CURVE 0xFCA45A KlAxU8SstxU16WU16 1.992188 fak_ub_b2 0.00 1.992188 FORMAT "%8.6"
 /begin AXIS_DESCR STD_AXIS ub_tmp spg_ubatt 5 0.00 24.02100 FORMAT "%8.5" DEPOSIT ABSOLUTE /end AXIS_DESCR
/end CHARACTERISTIC
/begin CHARACTERISTIC KLMACCKUPP "Kennlinie f¸r Ersatzwert ACC-Moment aus nmot" CURVE 0xFD0472 KlAUwSstUwWSw 200.0000 md_q0p5 -100.0000 100.0000 FORMAT "%8.4"
 /begin AXIS_DESCR STD_AXIS nmot_w nmot_uw_q0p25 6 0.00 16383.75 FORMAT "%8.2" DEPOSIT ABSOLUTE /end AXIS_DESCR
/end CHARACTERISTIC
/begin CHARACTERISTIC KLTMOTKALT "Kennlinie Anzahl Segmente des Drehzahlvorwarnfeldes aktiv" CURVE 0xFD04BA KlAxU8SstxU8WU8 4.000 dez 0.00 4.000 FORMAT "%5.3"
 /begin AXIS_DESCR STD_AXIS tmottol temp_ub_q0p75_o48 5 -48.00 143.3 FORMAT "%5.1" DEPOSIT ABSOLUTE /end AXIS_DESCR
/end CHARACTERISTIC
/begin CHARACTERISTIC KSDCMS "Kennlinie massenstromabh‰ngiger Skalierungsfaktor Sauerstoff-Speicher-Korrektur" CURVE 0xFD0040 KlAUwSstUwWUb 1.992 fak_ub_b2 0.00 1.992 FORMAT "%5.3"
 /begin AXIS_DESCR STD_AXIS msaovvk_w m_uw_b6553p5 4 0.00 6553.500 FORMAT "%8.3" DEPOSIT ABSOLUTE /end AXIS_DESCR
/end CHARACTERISTIC
/begin CHARACTERISTIC KSDCOSC "Kennlinie OSC-abh‰ngiger Skalierungsfaktor Sauerstoff-Speicher-Korrektur" CURVE 0xFD004E KlAUwSstUwWUb 1.992 fak_ub_b2 0.00 1.992 FORMAT "%5.3"
 /begin AXIS_DESCR STD_AXIS oscfkm_w m_q0p1_mg 5 0.00 6553.500 FORMAT "%8.3" DEPOSIT ABSOLUTE /end AXIS_DESCR
/end CHARACTERISTIC
/begin CHARACTERISTIC LALIO "Kennlinie lambda = f(O2)" CURVE 0xFC1FE8 KlAUwSstSwWUw 15.99976 fak_uw_b16 0.00 15.99976 FORMAT "%8.5"
 /begin AXIS_DESCR STD_AXIS o2adap_w relO2_q9p765Em4 25 -32.00000 31.99902 FORMAT "%8.5" DEPOSIT ABSOLUTE /end AXIS_DESCR
/end CHARACTERISTIC
/begin CHARACTERISTIC LLRABS_DF "DF-Schwelle f¸r LL-Absenkung" VALUE 0xFCA70F KwWU8 99.61 PCENT 0.00 99.61 FORMAT "%5.2" /end CHARACTERISTIC
/begin CHARACTERISTIC LLRANH_DF "DF-Schwelle f¸r LL-Anhebung" VALUE 0xFCA710 KwWU8 99.61 PCENT 0.00 99.61 FORMAT "%5.2" /end CHARACTERISTIC
/begin CHARACTERISTIC LRNST1_T "Wartezeit in Lernschritt 1" VALUE 0xFC1F08 KwUb 5.080 t20msxs_ub_b5p1 0.02000 5.100 FORMAT "%5.3" /end CHARACTERISTIC
/begin CHARACTERISTIC LRNST3_T "Wartezeit in Lernschritt 3" VALUE 0xFC1F09 KwUb 5.080 t20msxs_ub_b5p1 0.02000 5.100 FORMAT "%5.3" /end CHARACTERISTIC
/begin CHARACTERISTIC LRNST7_T "Wartezeit in Lernschritt 7" VALUE 0xFC1F0A KwUb 5.080 t20msxs_ub_b5p1 0.02000 5.100 FORMAT "%5.3" /end CHARACTERISTIC
/begin CHARACTERISTIC LRNST9_T "Wartezeit in Lernschritt 9" VALUE 0xFC1F0B KwUb 5.080 t20msxs_ub_b5p1 0.02000 5.100 FORMAT "%5.3" /end CHARACTERISTIC
/begin CHARACTERISTIC LRNVB_T "Lernverbotszeit f¸r 'normales Lernen'" VALUE 0xFC1F22 KwUw 1310.700 t20msxs_uw_q0p02 0.00 1310.700 FORMAT "%8.3" /end CHARACTERISTIC
/begin CHARACTERISTIC MABSTCRHK "Abgasmassenschwelle f¸r Freigabe Sauerstoff-Korrektur nach Hauptkat-Ausr‰umen" VALUE 0xFD0060 KwUw 1164.982 m_q0p01777_g 0.00 1164.982 FORMAT "%8.3" /end CHARACTERISTIC
/begin CHARACTERISTIC MAXBITPOS "Max. Anzahl der CC-Meldungen und damit der Bitpositionen" VALUE 0xFCF548 KwWU8 255.0 dez 0.00 255.0 FORMAT "%5.1" /end CHARACTERISTIC
/begin CHARACTERISTIC MDIAGMX "Festwert max. erlaubtes ind. Motormoment (bei AG) bei CAN-Timeout" VALUE 0xFC20F4 KwWU16 99.99847 rel_uw_b100 0.00 99.99847 FORMAT "%8.5" /end CHARACTERISTIC
/begin CHARACTERISTIC MDNORM "Maximales indiziertes Motormoment f¸r Moment-Normierung" VALUE 0xFC8F46 KwUb 1008. md_ub_q16 0.00 1008. FORMAT "%5.0" /end CHARACTERISTIC
/begin CHARACTERISTIC MDWANMXT "max. zul‰ssiges Wandleraufnahme-Moment" CURVE 0xFC20FF KlAUbSstUbWUb 99.61 rel_ub_b100 0.00 99.61 FORMAT "%5.2"
 /begin AXIS_DESCR STD_AXIS tmot temp_ub_q0p75_o48 4 -48.00 143.3 FORMAT "%5.1" DEPOSIT ABSOLUTE /end AXIS_DESCR
/end CHARACTERISTIC
/begin CHARACTERISTIC MIFAVLN "Vollasterkennung ¸ber Momentenanforderung" CURVE 0xFCA25A KlAUwSstUwWUw 199.9969 rel_uw_b200 0.00 199.9969 FORMAT "%8.4"
 /begin AXIS_DESCR STD_AXIS nmot_w nmot_uw_q0p25 14 0.00 16383.75 FORMAT "%8.2" DEPOSIT ABSOLUTE /end AXIS_DESCR
/end CHARACTERISTIC
/begin CHARACTERISTIC MIFAVLNHYS "Hysterese f¸r Vollasterkennung ¸ber Momenentanforderung" VALUE 0xFCA254 KwWU16 199.9969 rel_uw_b200 0.00 199.9969 FORMAT "%8.4" /end CHARACTERISTIC
/begin CHARACTERISTIC MIMSRMXN "Maximal zul‰ssiges MSR-Moment" CURVE 0xFC20DE KlAUwSstUwWUw 99.99847 rel_uw_b100 0.00 99.99847 FORMAT "%8.5"
 /begin AXIS_DESCR STD_AXIS nmot_w nmot_uw_q0p25 4 0.00 16383.75 FORMAT "%8.2" DEPOSIT ABSOLUTE /end AXIS_DESCR
/end CHARACTERISTIC
/begin CHARACTERISTIC MKSGSMXN "max. zul‰ssiges Sollmoment w‰hrend eines SGS-Eingriffs" CURVE 0xFD04F0 KlAUwSstUwWSw 32767.50 md_q0p5 -16384.00 16383.50 FORMAT "%8.2"
 /begin AXIS_DESCR STD_AXIS nmot_w nmot_uw_q0p25 5 0.00 16383.75 FORMAT "%8.2" DEPOSIT ABSOLUTE /end AXIS_DESCR
/end CHARACTERISTIC
/begin CHARACTERISTIC MOXFULLH "Sauerstoffmasse f¸r Erkennung Hauptkatalysator gef¸llt" VALUE 0xFD0062 KwSw 6553.500 m_q0p1_mg -3276.800 3276.700 FORMAT "%8.3" /end CHARACTERISTIC
/begin CHARACTERISTIC MRACCMAX "Maximalwert f¸r relatives Moment aus ACC" VALUE 0xFD048C KwUw 199.9969 rel_uw_b200 0.00 199.9969 FORMAT "%8.4" /end CHARACTERISTIC
/begin CHARACTERISTIC MRFABNTE "Schwelle zur Erkennung von Dauer-Hochlastfahrt" VALUE 0xFD1A24 KwUb 99.61 rel_ub_b99p6 0.00 99.61 FORMAT "%5.2" /end CHARACTERISTIC
/begin CHARACTERISTIC MRFAVLN "Vollasterkennungsschwelle des relativen Fahrerwunsches" CURVE 0xFCA294 KlAUwSstUwWUw 199.9969 rel_uw_b200 0.00 199.9969 FORMAT "%8.4"
 /begin AXIS_DESCR STD_AXIS nmot_w nmot_uw_q0p25 14 0.00 16383.75 FORMAT "%8.2" DEPOSIT ABSOLUTE /end AXIS_DESCR
/end CHARACTERISTIC
/begin CHARACTERISTIC MRFAVLNHYS "Hysterese f¸r Vollasterkennung Fahrerwunsch" VALUE 0xFCA256 KwWU16 199.9969 rel_uw_b200 0.00 199.9969 FORMAT "%8.4" /end CHARACTERISTIC
/begin CHARACTERISTIC NGDNSA "Drehzahlgradient beim Absteuern der Schubabschalthysterese" VALUE 0xFC874E KwSw 10239.84 nmotg_sw_q0p15625 -5120.000 5119.844 FORMAT "%8.3" /end CHARACTERISTIC
/begin CHARACTERISTIC NLPST1T "Wartezeit 1 im NLP-Lernen" VALUE 0xFC1F0C KwUb 2.540 t10msxs_ub_b2p55 0.01000 2.550 FORMAT "%5.3" /end CHARACTERISTIC
/begin CHARACTERISTIC NLPST2T "Wartezeit 2 im NLP-Lernen" VALUE 0xFC1F0D KwUb 2.540 t10msxs_ub_b2p55 0.01000 2.550 FORMAT "%5.3" /end CHARACTERISTIC
/begin CHARACTERISTIC NNSTA "Drehzahl¸bergang Normal -> Start" CURVE 0xFC20CC KlAUbSstUbWUb 1000. nmot_ub_q40 0.00 1000. FORMAT "%5.0"
 /begin AXIS_DESCR STD_AXIS tans temp_ub_q0p75_o48 3 -48.00 143.3 FORMAT "%5.1" DEPOSIT ABSOLUTE /end AXIS_DESCR
/end CHARACTERISTIC
/begin CHARACTERISTIC NSTNM "‹bergang Start -> Normal" CURVE 0xFC20D3 KlAUbSstUbWUb 1520. nmot_ub_q40 0.00 1520. FORMAT "%5.0"
 /begin AXIS_DESCR STD_AXIS tmot temp_ub_q0p75_o48 3 -48.00 143.3 FORMAT "%5.1" DEPOSIT ABSOLUTE /end AXIS_DESCR
/end CHARACTERISTIC
/begin CHARACTERISTIC NTWBGLLGEN "Notlaufwert Leerlaufanhebung bei Generatorfehler" VALUE 0xFCA711 KwWU8 1.000 dez 0.00 1.000 FORMAT "%5.3" /end CHARACTERISTIC
/begin CHARACTERISTIC NV "" CURVE 0xFC2108 FklWU16 511.9922 qnv_uw_b512 0.00 511.9922 FORMAT "%8.4"
 /begin AXIS_DESCR FIX_AXIS gangctr dez 6 0.00 5.000 FORMAT "%5.3" FIX_AXIS_PAR 0 0 6 /end AXIS_DESCR
/end CHARACTERISTIC
/begin CHARACTERISTIC NVGMN "Minimales NV-Verh‰ltnis" CURVE 0xFC2114 FklWS16 25599.94 nmotg_sw_q0p39 -12800.16 12799.77 FORMAT "%8.2"
 /begin AXIS_DESCR FIX_AXIS gangctr dez 6 0.00 5.000 FORMAT "%5.3" FIX_AXIS_PAR 0 0 6 /end AXIS_DESCR
/end CHARACTERISTIC
/begin CHARACTERISTIC NVGMX "Maximales NV-Verh‰ltnis" CURVE 0xFC2120 FklWS16 25599.94 nmotg_sw_q0p39 -12800.16 12799.77 FORMAT "%8.2"
 /begin AXIS_DESCR FIX_AXIS gangctr dez 6 0.00 5.000 FORMAT "%5.3" FIX_AXIS_PAR 0 0 6 /end AXIS_DESCR
/end CHARACTERISTIC
/begin CHARACTERISTIC NVO "n/v Schwelle f¸r Z¸ndwinkelsp‰tziehen  oberer Gang" CURVE 0xFC212C FklWU16 511.9922 qnv_uw_b512 0.00 511.9922 FORMAT "%8.4"
 /begin AXIS_DESCR FIX_AXIS gangctr dez 6 0.00 5.000 FORMAT "%5.3" FIX_AXIS_PAR 0 0 6 /end AXIS_DESCR
/end CHARACTERISTIC
/begin CHARACTERISTIC NVV "" CURVE 0xFC2138 FklWU16 81918.75 vfzg_ub_q1p25 0.00 81918.75 FORMAT "%8.2"
 /begin AXIS_DESCR FIX_AXIS gangctr dez 6 0.00 5.000 FORMAT "%5.3" FIX_AXIS_PAR 0 0 6 /end AXIS_DESCR
/end CHARACTERISTIC
/begin CHARACTERISTIC NWARNORINI "Initialwert Beginn oranger Bereich des Drehzahlmessers" VALUE 0xFD04C6 KwWU16 16383.75 nmot_uw_q0p25 0.00 16383.75 FORMAT "%8.2" /end CHARACTERISTIC
/begin CHARACTERISTIC NWARNRTINI "Initialwert Beginn roter Bereich des Drehzahlmessers" VALUE 0xFD04C8 KwWU16 16383.75 nmot_uw_q0p25 0.00 16383.75 FORMAT "%8.2" /end CHARACTERISTIC
/begin CHARACTERISTIC NWEAFS "Wiedereinsetzdrehzahl AFS" VALUE 0xFC8744 KwUb 10200. nmot_ub_q40 0.00 10200. FORMAT "%5.0" /end CHARACTERISTIC
/begin CHARACTERISTIC NWEAFSZDV "Wiedereinsetzdrehzahl AFS DVFZ aktiv Z_vfz false" VALUE 0xFC8745 KwUb 10200. nmot_ub_q40 0.00 10200. FORMAT "%5.0" /end CHARACTERISTIC
/begin CHARACTERISTIC NWEARS "Wiedereinsetzdrehzahl ARS" VALUE 0xFC8746 KwUb 10200. nmot_ub_q40 0.00 10200. FORMAT "%5.0" /end CHARACTERISTIC
/begin CHARACTERISTIC NWEARSZDV "Wiedereinsetzdrehzahl ARS DVFZ aktiv Z_vfz false" VALUE 0xFC8747 KwUb 10200. nmot_ub_q40 0.00 10200. FORMAT "%5.0" /end CHARACTERISTIC
/begin CHARACTERISTIC NWEM "Wiedereinsetzdrehzahl" CURVE 0xFD30F4 GklWUb 10200. nmot_ub_q40 0.00 10200. FORMAT "%5.0"
 /begin AXIS_DESCR COM_AXIS tmot temp_ub_q0p75_o48 5 -48.00 143.3 FORMAT "%5.1" AXIS_PTS_REF STM05SAUB /end AXIS_DESCR
/end CHARACTERISTIC
/begin CHARACTERISTIC NWEMT "Wiedereinsetzdrehzahl gedrosselt" CURVE 0xFD30F9 GklWUb 10200. nmot_ub_q40 0.00 10200. FORMAT "%5.0"
 /begin AXIS_DESCR COM_AXIS tmot temp_ub_q0p75_o48 5 -48.00 143.3 FORMAT "%5.1" AXIS_PTS_REF STM05SAUB /end AXIS_DESCR
/end CHARACTERISTIC
/begin CHARACTERISTIC NWENG "Wiedereinsetzdrehzahl" CURVE 0xFC8750 KlAUbSstSbWUb 10200. nmot_ub_q40 0.00 10200. FORMAT "%5.0"
 /begin AXIS_DESCR STD_AXIS ngfil nmotg_sb_q100 5 -12800. 12700. FORMAT "%5.0" DEPOSIT ABSOLUTE /end AXIS_DESCR
/end CHARACTERISTIC
/begin CHARACTERISTIC NWENGZDV "Wiedereinsetzdrehzah DVFZ aktiv Z_vfz false" CURVE 0xFC875B KlAUbSstSbWUb 10200. nmot_ub_q40 0.00 10200. FORMAT "%5.0"
 /begin AXIS_DESCR STD_AXIS ngfil nmotg_sb_q100 5 -12800. 12700. FORMAT "%5.0" DEPOSIT ABSOLUTE /end AXIS_DESCR
/end CHARACTERISTIC
/begin CHARACTERISTIC NWRNHTOL2 "Kennwert Drehzahlbegrenzungsanzeige bei hohem tOel" VALUE 0xFD04CA KwWU16 16383.75 nmot_uw_q0p25 0.00 16383.75 FORMAT "%8.2" /end CHARACTERISTIC
/begin CHARACTERISTIC OSCMXHK "Maximalwert der OSC des Hauptkatalysator, f¸r Plausibilit‰tspr¸fung" VALUE 0xFD0064 KwSw 6553.500 m_q0p1_mg -3276.800 3276.700 FORMAT "%8.3" /end CHARACTERISTIC
/begin CHARACTERISTIC PRELLDFAH "Prellzeit f¸r LLR-Anhebung" VALUE 0xFCA712 KwWU8 25.50 t100msxs_ub_b25p5 0.00 25.50 FORMAT "%5.2" /end CHARACTERISTIC
/begin CHARACTERISTIC PRELLDFRF "Prellzeit f¸r LLR-Absenkung" VALUE 0xFCA713 KwWU8 25.50 t100msxs_ub_b25p5 0.00 25.50 FORMAT "%5.2" /end CHARACTERISTIC
/begin CHARACTERISTIC ROSCZHK "Relativer OSC-Wert f¸r Zentrierung des Sauerstoff-Integrals des Hauptkats" VALUE 0xFCFE6C KwUb 0.9961 fak_ub_b1 0.00 0.9961 /end CHARACTERISTIC
/begin CHARACTERISTIC SGSMDTMX "Grˆﬂte zul‰ssige Momenten-Zeit-Fl‰che bei der SGS-Topfplausibilisierung" VALUE 0xFC20F6 KwWS16 32767.50 md_q0p5 -16384.00 16383.50 FORMAT "%8.2" /end CHARACTERISTIC
/begin AXIS_PTS SNM08GKUB "St¸tzstellenverteilung Gemischkontrolle 8 nmot St¸tzstellen" 0xFC135D nmot SstAU8SstU8 10200. nmot_ub_q40 8 0.00 10200. FORMAT "%5.0" DEPOSIT ABSOLUTE /end AXIS_PTS
/begin AXIS_PTS SNM08__UB "St¸tzstellenverteilung Drehzahl, 8 Sst." 0xFC1394 nmot SstAUbSstUb 10200. nmot_ub_q40 8 0.00 10200. FORMAT "%5.0" DEPOSIT ABSOLUTE /end AXIS_PTS
/begin AXIS_PTS STM05SAUB "St¸tzstellenverteilung" 0xFCF86E tmot SstAUbSstUb 191.3 temp_ub_q0p75_o48 5 -48.00 143.3 FORMAT "%5.1" DEPOSIT ABSOLUTE /end AXIS_PTS
/begin CHARACTERISTIC TACCCTR "Wert f¸r Filterlaufzeitz‰hlerACC-Moment" VALUE 0xFD046F KwUb 5.100 t_q0p02 0.00 5.100 FORMAT "%5.3" /end CHARACTERISTIC
/begin CHARACTERISTIC TATELL "tans- Schwelle f¸r Tankentl¸fung bei B_ll = 1" VALUE 0xFD1A25 KwUb 191.3 temp_ub_q0p75_o48 -48.00 143.3 FORMAT "%5.1" /end CHARACTERISTIC
/begin CHARACTERISTIC TAUFRASC "max. zul‰ssige Zeit Aufregelung des ASC-Momentes" VALUE 0xFC20DC KwWU8 5.100 t20msxs_ub_b5p1 0.00 5.100 FORMAT "%5.3" /end CHARACTERISTIC
/begin CHARACTERISTIC TDKNACH "Zeit im Nachlauf bis stromlose DK im NLP einschwingt" VALUE 0xFC1F24 KwUw 655.3500 t10msxs_uw_b655p35 0.00 655.3500 FORMAT "%8.4" /end CHARACTERISTIC
/begin CHARACTERISTIC TDLRPIDMX "max. Zeit f¸r PWM-Tastverh‰ltnis des DLR bei temp. UMA-Adapt." VALUE 0xFC1F0E KwUb 12.75 t50msxs_q0p05 0.00 12.75 FORMAT "%5.2" /end CHARACTERISTIC
/begin CHARACTERISTIC TDNVAUS "Verzˆgerungszeit NV-Verh‰ltnis auﬂerhalb Band" CURVE 0xFC2144 FklWU16 655.3500 t10msxs_uw_b655p35 0.00 655.3500 FORMAT "%8.4"
 /begin AXIS_DESCR FIX_AXIS gangctr dez 6 0.00 5.000 FORMAT "%5.3" FIX_AXIS_PAR 0 0 6 /end AXIS_DESCR
/end CHARACTERISTIC
/begin CHARACTERISTIC TDNVEIN "Verzˆgerungszeit NV-Verh‰ltnis innerhalb Band" CURVE 0xFC2150 FklWU16 655.3500 t10msxs_uw_b655p35 0.00 655.3500 FORMAT "%8.4"
 /begin AXIS_DESCR FIX_AXIS gangctr dez 6 0.00 5.000 FORMAT "%5.3" FIX_AXIS_PAR 0 0 6 /end AXIS_DESCR
/end CHARACTERISTIC
/begin CHARACTERISTIC TFUSFK "Wartezeit vor Setzen Unplausibilit‰ts-Flag f¸r Lambdasonde hinter Vorkat" VALUE 0xFD0066 KwUw 1310.700 t20msxs_uw_b1310 0.00 1310.700 FORMAT "%8.3" /end CHARACTERISTIC
/begin CHARACTERISTIC TKATSAN "Katalysator-Temperaturschwelle f¸r Schubabschalten f(nmot)" CURVE 0xFD30FE KlAUbSstUbWUb 1275. temp_ub_q5_o50 -50.00 1225. FORMAT "%5.0"
 /begin AXIS_DESCR STD_AXIS nmot nmot_ub_q40 4 0.00 10200. FORMAT "%5.0" DEPOSIT ABSOLUTE /end AXIS_DESCR
/end CHARACTERISTIC
/begin CHARACTERISTIC TKIHKMEMN "Minimale Temperatur des Hauptkatalysators f¸r OSC-Messung" VALUE 0xFD0068 KwUw 1535.977 temp_q0p0234_o273 -273.1500 1262.827 FORMAT "%8.3" /end CHARACTERISTIC
/begin CHARACTERISTIC TKL15ON "Timeoutzeit f¸r S_kl15 ein" VALUE 0xFCC9D4 KwWU16 655.3500 t10msxs_uw_b655p35 0.00 655.3500 FORMAT "%8.4" /end CHARACTERISTIC
/begin CHARACTERISTIC TKUPPCTR "Wert f¸r Z‰hler Ersatzwert aktiv" VALUE 0xFD0470 KwUb 5.100 t_q0p02 0.00 5.100 FORMAT "%5.3" /end CHARACTERISTIC
/begin CHARACTERISTIC TMACCF "Zeitkonstante f¸r ACC- Moment-Filterung" VALUE 0xFD0471 KwUb 5.08000 zk20msxs_ub_b5p1 0.0200000 5.10000 FORMAT "%7.5" /end CHARACTERISTIC
/begin CHARACTERISTIC TMCCGBH "Motortemperatur Schwelle CC-Meldung Gelb ""Motortemperatur ¸berhitzt"" High" VALUE 0xFD04E0 KwWU8 191.3 temp_ub_q0p75_o48 -48.00 143.3 FORMAT "%5.1" /end CHARACTERISTIC
/begin CHARACTERISTIC TMCCGBL "Motortemperatur Schwelle CC-Meldung Gelb ""Motortemperatur ¸berhitzt"" Low" VALUE 0xFD04E1 KwWU8 191.3 temp_ub_q0p75_o48 -48.00 143.3 FORMAT "%5.1" /end CHARACTERISTIC
/begin CHARACTERISTIC TMSGSGTMN "min. Zeit zwischen zwei Botschaften G_T" VALUE 0xFC11ED KwWU8 5.100 t20msxs_ub_b5p1 0.00 5.100 FORMAT "%5.3" /end CHARACTERISTIC
/begin CHARACTERISTIC TMSKLH "Motortemperaturschwelle f¸r kurze LRA-Anfangsphase bei Heiﬂstart" VALUE 0xFD1A26 KwUb 191.3 temp_ub_q0p75_o48 -48.00 143.3 FORMAT "%5.1" /end CHARACTERISTIC
/begin CHARACTERISTIC TMSNOGA "Schwelle tms f¸r Dauersp¸len nach Fahrzyklus mit erfolgter Gemischadaption" VALUE 0xFD1A27 KwUb 191.3 temp_ub_q0p75_o48 -48.00 143.3 FORMAT "%5.1" /end CHARACTERISTIC
/begin CHARACTERISTIC TMSUTMUMA "untere Tmot-Schwelle f¸r tempor‰re UMA-Adaption" VALUE 0xFC1F0F KwUb 191.3 temp_ub_q0p75_o48 -48.00 143.3 FORMAT "%5.1" /end CHARACTERISTIC
/begin CHARACTERISTIC TNKL15DC "Zeit nach KL15 ein zur Freigabe der CAN-Diagnosen." VALUE 0xFCF54A KwWU8 25.50 t_q0p1 0.00 25.50 FORMAT "%5.2" /end CHARACTERISTIC
/begin CHARACTERISTIC TNSTACC "Entprellzeit nach Startende zur Ausgabe des internen DME-Fehlers" VALUE 0xFD048E KwUw 6553.500 t100msxs_uw_b6553p5 0.00 6553.500 FORMAT "%8.3" /end CHARACTERISTIC
/begin CHARACTERISTIC TSCMEMXH "Zeitfenster f¸r OSC-Messung Hauptkatalysator" VALUE 0xFD006A KwUw 1310.700 t20msxs_uw_b1310 0.00 1310.700 FORMAT "%8.3" /end CHARACTERISTIC
/begin CHARACTERISTIC TSGSAMX "max. Dauer eines SGS-Eingriffs" VALUE 0xFC20FA KwWU8 2.540 t10msxs_ub_b2p55 0.00 2.540 FORMAT "%5.3" /end CHARACTERISTIC
/begin CHARACTERISTIC TSGSNAMN "min. Wartezeit nach einem SGS-Eingriff" VALUE 0xFC20FB KwWU8 2.540 t10msxs_ub_b2p55 0.00 2.540 FORMAT "%5.3" /end CHARACTERISTIC
/begin CHARACTERISTIC TTE "Zeit f¸r Tankentl¸ftungsphase" VALUE 0xFD1A2E KwUw 6553.500 t100msxs_uw_b6553p6 0.00 6553.500 FORMAT "%8.3" /end CHARACTERISTIC
/begin CHARACTERISTIC TTEAE "Zeit f¸r Tankentl¸ftungsphase bei eingeschwungener Gemischadaption" VALUE 0xFD1A30 KwUw 6553.500 t100msxs_uw_b6553p6 0.00 6553.500 FORMAT "%8.3" /end CHARACTERISTIC
/begin CHARACTERISTIC TTEBSTP "Maximal Zeit f¸r TE-Stop im Leerlauf bei nicht gesetzten Zyklusflags" VALUE 0xFD1A32 KwUw 6553.500 t100msxs_uw_b6553p6 0.00 6553.500 FORMAT "%8.3" /end CHARACTERISTIC
/begin CHARACTERISTIC TTEGA "Zeit bei der Tankentl¸ftung f¸r Grundadaption" VALUE 0xFD1A34 KwUw 6553.500 t100msxs_uw_b6553p6 0.00 6553.500 FORMAT "%8.3" /end CHARACTERISTIC
/begin CHARACTERISTIC TTEGAI "Zeitdauer der ersten  Gemischadaptionsphase" VALUE 0xFD1A36 KwUw 6553.500 t100msxs_uw_b6553p6 0.00 6553.500 FORMAT "%8.3" /end CHARACTERISTIC
/begin CHARACTERISTIC TTEGAIH "Zeitdauer der ersten  Gemischadaptionsphase bei Heiﬂstart" VALUE 0xFD1A38 KwUw 6553.500 t100msxs_uw_b6553p6 0.00 6553.500 FORMAT "%8.3" /end CHARACTERISTIC
/begin CHARACTERISTIC TTEGAZO "Zeit f¸r Tankentl¸ftungsstop wg. Gemischadaption, obere Schwelle" VALUE 0xFD1A3A KwUw 6553.500 t100msxs_uw_b6553p6 0.00 6553.500 FORMAT "%8.3" /end CHARACTERISTIC
/begin CHARACTERISTIC TTEGAZU "Zeit f¸r Tankentl¸ftungsstop wg. Gemischadaption, untere Schwelle" VALUE 0xFD1A3C KwUw 6553.500 t100msxs_uw_b6553p6 0.00 6553.500 FORMAT "%8.3" /end CHARACTERISTIC
/begin CHARACTERISTIC TTEINI "Zeit f¸r Tankentl¸ftung in erster TE-Phase nach Initialisierung (B_ini)" VALUE 0xFD1A3E KwUw 6553.500 t100msxs_uw_b6553p6 0.00 6553.500 FORMAT "%8.3" /end CHARACTERISTIC
/begin CHARACTERISTIC TTEMN "Zeit f¸r Tankentl¸ftungsphase minimal" VALUE 0xFD1A40 KwUw 6553.500 t100msxs_uw_b6553p6 0.00 6553.500 FORMAT "%8.3" /end CHARACTERISTIC
/begin CHARACTERISTIC TTEPRIO "Zeit ab Start f¸r Umschalten auf Dauertankentl¸ftung" VALUE 0xFD1A42 KwUw 6553.500 t100msxs_uw_b6553p6 0.00 6553.500 FORMAT "%8.3" /end CHARACTERISTIC
/begin CHARACTERISTIC TTEZAO "Zeit f¸r Tankentl¸ftung Daueraktivierung, obere Schwelle" VALUE 0xFD1A44 KwUw 6553.500 t100msxs_uw_b6553p6 0.00 6553.500 FORMAT "%8.3" /end CHARACTERISTIC
/begin CHARACTERISTIC TTEZAU "Zeit f¸r Tankentl¸ftung Daueraktivierung, untere Schwelle" VALUE 0xFD1A46 KwUw 6553.500 t100msxs_uw_b6553p6 0.00 6553.500 FORMAT "%8.3" /end CHARACTERISTIC
/begin CHARACTERISTIC TTMUMASTA "Zeitdauer f¸r Station‰rzustand bei temp. UMA-Adaption" VALUE 0xFC1F26 KwUw 3276.750 t50msxs_q0p05 0.00 3276.750 FORMAT "%8.3" /end CHARACTERISTIC
/begin CHARACTERISTIC TVBZULSGS "Verzˆgerungszeit (Entprellzeit) bei zu hoher L‰ngsbeschleunigung" VALUE 0xFC20FC KwWU8 2.550 t10msxs_ub_b2p55 0.00 2.550 FORMAT "%5.3" /end CHARACTERISTIC
/begin CHARACTERISTIC TVCCGB "Verzˆgerungszeit nach Startende f¸r Anzeige CC-ID 257 bei tmot > Motortemp. ¸ber" VALUE 0xFD04D0 KwWU16 6553.500 t100msxs_uw_b6553p5 0.00 6553.500 FORMAT "%8.3" /end CHARACTERISTIC
/begin CHARACTERISTIC TVMKSGSMX "Verzˆgerungszeit (Entprellzeit) bei zu hohem Sollmoment (SGS-Eingriff)" VALUE 0xFC20FD KwWU8 2.550 t10msxs_ub_b2p55 0.00 2.550 FORMAT "%5.3" /end CHARACTERISTIC
/begin CHARACTERISTIC TVSATM "Sperrzeit Schubabschalten nach Startende" CURVE 0xFD3107 GklWUb 255.0 t1sxs_ub_b255 0.00 255.0 FORMAT "%5.1"
 /begin AXIS_DESCR COM_AXIS tmot temp_ub_q0p75_o48 5 -48.00 143.3 FORMAT "%5.1" AXIS_PTS_REF STM05SAUB /end AXIS_DESCR
/end CHARACTERISTIC
/begin CHARACTERISTIC TVSGSMNV "Verzˆgerungszeit (Entprellzeit) bei zu kleiner Fahrzeuggeschwindigkeit SGS-Eing." VALUE 0xFC20FE KwWU8 2.550 t10msxs_ub_b2p55 0.00 2.550 FORMAT "%5.3" /end CHARACTERISTIC
/begin CHARACTERISTIC UANAUFRP "Schrittweite f¸r AUF-Rampe" VALUE 0xFC1F28 KwUw 0.9994659 relDK_uw_b100 0.00 0.9994659 FORMAT "%9.7" /end CHARACTERISTIC
/begin CHARACTERISTIC UANNMAX "Motordrehzahlschwelle f¸r Freigabe UMA-Lernen und Verst‰rkerabgleich" VALUE 0xFC1F10 KwUb 2550. nmot_ub_q10 0.00 2550. FORMAT "%5.0" /end CHARACTERISTIC
/begin CHARACTERISTIC UANPEDMAX "Pedalschwelle f¸r UMA-Lernen erlaubt" VALUE 0xFC1F11 KwUb 100.0 relDK_ub_b100 0.00 100.0 FORMAT "%5.1" /end CHARACTERISTIC
/begin CHARACTERISTIC UANPIDMIN "Abbruchschwelle PID-Summe f¸r ZU-Rampe" VALUE 0xFC1F2A KwUw 99.99847 rel_uw_b100 0.00 99.99847 FORMAT "%8.5" /end CHARACTERISTIC
/begin CHARACTERISTIC UANPIDMINA "Abbruchschwelle PID-Summe f¸r AUF-Rampe" VALUE 0xFC1F2C KwUw 99.99847 rel_uw_b100 0.00 99.99847 FORMAT "%8.5" /end CHARACTERISTIC
/begin CHARACTERISTIC UANUATS "untere Ansauglufttemperaturschwelle f¸r Lernfreigabe" VALUE 0xFC1F12 KwUb 191.3 temp_ub_q0p75_o48 -48.00 143.3 FORMAT "%5.1" /end CHARACTERISTIC
/begin CHARACTERISTIC UANVFZG "Geschwindigkeitssschelle f¸r DV-E-Pr¸fung/Lernroutine" VALUE 0xFC1F13 KwUb 318.8 vfzg_ub_q1p25 0.00 318.8 FORMAT "%5.1" /end CHARACTERISTIC
/begin CHARACTERISTIC UANZURP "Schrittweite f¸r ZU-Rampe" VALUE 0xFC1F2E KwUw 0.05004883 spg_uw_q0p001222 0.00 0.05004883 FORMAT "%10.8" /end CHARACTERISTIC
/begin CHARACTERISTIC UAN_O_MT "obere Motortemperaturschwelle f¸r Anschlag" VALUE 0xFC1F14 KwUb 191.3 temp_ub_q0p75_o48 -48.00 143.3 FORMAT "%5.1" /end CHARACTERISTIC
/begin CHARACTERISTIC UAN_STORE "Schwelle f¸r Abspeicherung neuer Lernwerte" VALUE 0xFC1F30 KwUw 0.05004883 spg_uw_q0p001222 0.00 0.05004883 FORMAT "%10.8" /end CHARACTERISTIC
/begin CHARACTERISTIC UAN_U_MT "untere Motortemperaturschwelle f¸r Lernfreigabe" VALUE 0xFC1F15 KwUb 191.3 temp_ub_q0p75_o48 -48.00 143.3 FORMAT "%5.1" /end CHARACTERISTIC
/begin CHARACTERISTIC UBDCAN "UBatt-Schwelle f¸r Diagnose CAN-Timeout" VALUE 0xFCF54B KwWU8 24.02 spg_ubatt 0.00 24.02 FORMAT "%5.2" /end CHARACTERISTIC
/begin CHARACTERISTIC UB_UANL "Batteriespannungsschwelle f¸r Lernfreigabe" VALUE 0xFC1F16 KwUb 24.02 spg_ubatt 0.00 24.02 FORMAT "%5.2" /end CHARACTERISTIC
/begin CHARACTERISTIC UDKNLP1N "Nennwert-Spannung DK-Poti 1 in NLP-Stellung" VALUE 0xFC1F32 KwUw 4.998779 spg_uw_q0p001222 0.00 4.998779 FORMAT "%8.6" /end CHARACTERISTIC
/begin CHARACTERISTIC UDKNLP2N "Nennwert-Spannung DK-Poti 2 in NLP-Stellung" VALUE 0xFC1F34 KwUw 4.998779 spg_uw_q0p001222 0.00 4.998779 FORMAT "%8.6" /end CHARACTERISTIC
/begin CHARACTERISTIC UDKP1AMAX "max. Spannung DK-Poti 1 am unteren DK-Anschlag" VALUE 0xFC1F36 KwUw 4.998779 spg_uw_q0p001222 0.00 4.998779 FORMAT "%8.6" /end CHARACTERISTIC
/begin CHARACTERISTIC UDKP1AMIN "min. Spannung DK-Poti 1 am unteren DK-Anschlag" VALUE 0xFC1F38 KwUw 4.998779 spg_uw_q0p001222 0.00 4.998779 FORMAT "%8.6" /end CHARACTERISTIC
/begin CHARACTERISTIC UDKP1AURI "Spannung DK-Poti 1 am unt. DK-Anschlag, Initial. Wert" VALUE 0xFC1F3A KwUw 4.998779 spg_uw_q0p001222 0.00 4.998779 FORMAT "%8.6" /end CHARACTERISTIC
/begin CHARACTERISTIC UDKP1DUS "Nennumschaltschwelle zur DK-Poti-1-Umschaltung" VALUE 0xFC1F17 KwUb 4.980 spg_ub_b5 0.00 4.980 FORMAT "%5.3" /end CHARACTERISTIC
/begin CHARACTERISTIC UDKP1NHUB "Nennhub der Drosselklappe im DV-E, (Poti 1)" VALUE 0xFC1F3C KwUw 4.998779 spg_uw_q0p001222 0.00 4.998779 FORMAT "%8.6" /end CHARACTERISTIC
/begin CHARACTERISTIC UDKP1VID "Nennverst‰rkung f¸r DK-Poti 1" VALUE 0xFC1F3E KwUw 7.996094 fak_q0p0039 0.00 7.996094 FORMAT "%8.6" /end CHARACTERISTIC
/begin CHARACTERISTIC UDKP1VOMA "max. Offsetfehler f¸r DK-Poti-1-Verst‰rker" VALUE 0xFC1F40 KwSw 5.004090 spg_sw_q0p001222 0.00 5.004090 FORMAT "%8.6" /end CHARACTERISTIC
/begin CHARACTERISTIC UDKP1VOMI "min. Offsetfehler f¸r DK-Poti-1-Verst‰rker" VALUE 0xFC1F42 KwSw 5.004090 spg_sw_q0p001222 -5.004090 0.00 FORMAT "%8.6" /end CHARACTERISTIC
/begin CHARACTERISTIC UDKP1VVMA "ob. Wert Verst‰rkungsfehler f¸r Verst‰rker" VALUE 0xFC1F44 KwUw 7.996094 fak_q0p0039 0.00 7.996094 FORMAT "%8.6" /end CHARACTERISTIC
/begin CHARACTERISTIC UDKP1VVMI "unt. Wert Verst‰rkungsfehler f¸r Verst‰rker" VALUE 0xFC1F46 KwUw 7.996094 fak_q0p0039 0.00 7.996094 FORMAT "%8.6" /end CHARACTERISTIC
/begin CHARACTERISTIC UDKP2AMAX "max. Spannung DK-Poti 2 am unteren DK-Anschlag" VALUE 0xFC1F48 KwUw 4.998779 spg_uw_q0p001222 0.00 4.998779 FORMAT "%8.6" /end CHARACTERISTIC
/begin CHARACTERISTIC UDKP2AMIN "min. Spannung DK-Poti 2 am unteren DK-Anschlag" VALUE 0xFC1F4A KwUw 4.998779 spg_uw_q0p001222 0.00 4.998779 FORMAT "%8.6" /end CHARACTERISTIC
/begin CHARACTERISTIC UDKP2AURI "Spannung DK-Poti 2 am unt. DK-Anschlag, Initial. Wert" VALUE 0xFC1F4C KwUw 4.998779 spg_uw_q0p001222 0.00 4.998779 FORMAT "%8.6" /end CHARACTERISTIC
/begin CHARACTERISTIC UDKPALOS "Spannungsoffset zur Erkennung des Loslˆsens" VALUE 0xFC1F4E KwUw 0.4003906 spg_uw_q0p001222 0.00 0.4003906 FORMAT "%9.7" /end CHARACTERISTIC
/begin CHARACTERISTIC UDKPAOFF "Spannungsoffset am unteren Anschlag" VALUE 0xFC1F50 KwUw 0.05004883 spg_uw_q0p001222 0.00 0.05004883 FORMAT "%10.8" /end CHARACTERISTIC
/begin CHARACTERISTIC UDKPATMX "max. mˆglicher Offset der temp. UMA-Adaption" VALUE 0xFC1F52 KwUw 4.998779 spg_uw_q0p001222 0.00 4.998779 FORMAT "%8.6" /end CHARACTERISTIC
/begin CHARACTERISTIC UPVGNENN "Nennwert f¸r DV-E Potiversorgungsspannung" VALUE 0xFCFA44 KwUw 1.000000 dez 65534.00 65535.00 FORMAT "%8.2" /end CHARACTERISTIC
/begin CHARACTERISTIC USLEER "Schwelle Hinterkat-Sondenspannung f¸r definierten Katzustand leer" VALUE 0xFD006C KwUw 319.9951 spg_uw_q0p00488_o1 -1.000000 318.9951 FORMAT "%8.4" /end CHARACTERISTIC
/begin CHARACTERISTIC USVOLL "Schwelle Hinterkat-Sondenspannung f¸r definierten Katzustand voll" VALUE 0xFD006E KwUw 319.9951 spg_uw_q0p00488_o1 -1.000000 318.9951 FORMAT "%8.4" /end CHARACTERISTIC
/begin CHARACTERISTIC VNVKVHK "Volumen zwischen Auslass Vorkat und Einlass Hauptkat" VALUE 0xFD0070 KwUw 19999.69 vol_q0p306_cme3 0.00 19999.69 FORMAT "%8.2" /end CHARACTERISTIC
/begin CHARACTERISTIC VNVKVHK2 "Volumen zwischen Auslass Vorkat und Einlass Hauptkat, Bank 2" VALUE 0xFD0072 KwUw 19999.69 vol_q0p306_cme3 0.00 19999.69 FORMAT "%8.2" /end CHARACTERISTIC
/begin CHARACTERISTIC VOLHK "Gasvolumen im Hauptkatalysator" VALUE 0xFD0074 KwUw 19999.69 vol_q0p306_cme3 0.00 19999.69 FORMAT "%8.2" /end CHARACTERISTIC
/begin CHARACTERISTIC VOLHK2 "Gasvolumen im Hauptkatalysator, Bank 2" VALUE 0xFD0076 KwUw 19999.69 vol_q0p306_cme3 0.00 19999.69 FORMAT "%8.2" /end CHARACTERISTIC
/begin CHARACTERISTIC VSAA "Geschwindigkeitsschwelle f¸r SA-Drehzahlanhebung" VALUE 0xFC8748 KwUb 318.8 vfzg_ub_q1p25 0.00 318.8 FORMAT "%5.1" /end CHARACTERISTIC
/begin CHARACTERISTIC VSGSMN "minimale Fahrzeuggeschwindigkeit bei SGS-Anforderung" VALUE 0xFC20F8 KwWU16 511.9922 vfzg_uw_b512 0.00 511.9922 FORMAT "%8.4" /end CHARACTERISTIC
/begin CHARACTERISTIC WDKFPRO2 "Pr¸fschwelle DK-Istwert f¸r ˆffnende DV-E-Federpr¸fung" VALUE 0xFC1F54 KwSw 1599.976 relDK_q0p02441 -800.0000 799.9756 FORMAT "%8.4" /end CHARACTERISTIC
/begin CHARACTERISTIC WDKFPROO "Obere Abschaltschwelle DK-Istwert f¸r ˆffnende DV-E-Federpr¸fung" VALUE 0xFC1F56 KwSw 1599.976 relDK_q0p02441 -800.0000 799.9756 FORMAT "%8.4" /end CHARACTERISTIC
/begin CHARACTERISTIC WDKFPROU "Untere Abschaltschwelle DK-Istwert f¸r ˆffnende DV-E-Federpr¸fung" VALUE 0xFC1F58 KwSw 1599.976 relDK_q0p02441 -800.0000 799.9756 FORMAT "%8.4" /end CHARACTERISTIC
/begin CHARACTERISTIC WDKFPRZ1 "Abschaltschwelle DK-Istwert f¸r DV-E-R¸ckstellfederpr¸fung" VALUE 0xFC1F5A KwUw 100.0000 relDK_uw_b100 0.00 100.0000 FORMAT "%8.4" /end CHARACTERISTIC
/begin CHARACTERISTIC WDKFPRZ2 "Pr¸fschwelle DK-Istwert f¸r DV-E-R¸ckstellfederpr¸fung" VALUE 0xFC1F5C KwUw 100.0000 relDK_uw_b100 0.00 100.0000 FORMAT "%8.4" /end CHARACTERISTIC
/begin CHARACTERISTIC WDKNLPMA "oberer erlaubter Istwert f¸r NLP-Stellung" VALUE 0xFC1F5E KwUw 100.0000 relDK_uw_b100 0.00 100.0000 FORMAT "%8.4" /end CHARACTERISTIC
/begin CHARACTERISTIC WDKNLPMI "unterer erlaubter Istwert f¸r NLP-Stellung" VALUE 0xFC1F60 KwUw 100.0000 relDK_uw_b100 0.00 100.0000 FORMAT "%8.4" /end CHARACTERISTIC
/begin CHARACTERISTIC WDKNPLAUS "Schwelle rechnerische Plausibilisierung NLP wdknlp_w in Ini2" VALUE 0xFC1F62 KwUw 100.0000 relDK_uw_b100 0.00 100.0000 FORMAT "%8.4" /end CHARACTERISTIC
/begin CHARACTERISTIC WDKNSTORE "Schwelle Abspeichern neuer Lernwerte relativer NLP" VALUE 0xFC1F64 KwUw 100.0000 relDK_uw_b100 0.00 100.0000 FORMAT "%8.4" /end CHARACTERISTIC
/begin CHARACTERISTIC WDKSFPR "DK-Sollwert f¸r DV-E-R¸ckstellfederpr¸fung" VALUE 0xFC1F66 KwUw 100.0000 relDK_uw_b100 0.00 100.0000 FORMAT "%8.4" /end CHARACTERISTIC
/begin CHARACTERISTIC WDKSFPRO "DK-Sollwert f¸r ˆffnende DV-E-Federpr¸fung" VALUE 0xFC1F68 KwUw 100.0000 relDK_uw_b100 0.00 100.0000 FORMAT "%8.4" /end CHARACTERISTIC
/begin CHARACTERISTIC WDKSTMUMA "DK-Winkel-Schwelle f¸r tempor‰re UMA-Adaption" VALUE 0xFC1F6A KwUw 100.0000 relDK_uw_b100 0.00 100.0000 FORMAT "%8.4" /end CHARACTERISTIC
/begin CHARACTERISTIC WDKVLN "Drosselklappenwinkelschwelle f¸r Vollasterkennung" CURVE 0xFCA2CE KlAUwSstUwWUw 1599.976 relDK_q0p02441 0.00 1599.976 FORMAT "%8.3"
 /begin AXIS_DESCR STD_AXIS nmot_w nmot_uw_q0p25 14 0.00 16383.75 FORMAT "%8.2" DEPOSIT ABSOLUTE /end AXIS_DESCR
/end CHARACTERISTIC
/begin CHARACTERISTIC WDKVLNHYS "Hysterese f¸r Drosselklappenwinkelschwelle" VALUE 0xFCA258 KwWU16 1599.976 relDK_q0p02441 0.00 1599.976 FORMAT "%8.3" /end CHARACTERISTIC
/begin CHARACTERISTIC WPEDVIRMX "max. virtueller Fahrpedalwinkel bei FGR/ACC-Betrieb" VALUE 0xFD0490 KwUw 99.99847 rel_uw_b100 0.00 99.99847 FORMAT "%8.5" /end CHARACTERISTIC
/begin CHARACTERISTIC ZCCCYLMX "Zykluszeit f¸r das Versenden einer aktiven CC-Meldung" VALUE 0xFCF549 KwWU8 200.0 dez 0.00 200.0 FORMAT "%5.1" /end CHARACTERISTIC
/begin CHARACTERISTIC ZMRFABN "berechnet aktuelle Zeitkonstante des Tiefpaﬂ (Dauerhochlast) mrfabnf_w" CURVE 0xFD1A48 KlAUwSstSwWUw 6553.4999985 zk100msxs_uw_b6553 0.10000152590 6553.6000000 FORMAT "%12.7"
 /begin AXIS_DESCR STD_AXIS dmrfabn_w rel_sw_b100 5 -100.0000 99.99695 FORMAT "%8.4" DEPOSIT ABSOLUTE /end AXIS_DESCR
/end CHARACTERISTIC
/begin CHARACTERISTIC ZYLANZB "Zylinderanzahl Bank 1" VALUE 0xFD0078 KwWU16 5.000000 fak_uw_b16 1.000000 6.000000 FORMAT "%8.6" /end CHARACTERISTIC
/begin CHARACTERISTIC ZYLANZB2 "Zylinderanzahl Bank 2" VALUE 0xFD007A KwWU16 5.000000 fak_uw_b16 1.000000 6.000000 FORMAT "%8.6" /end CHARACTERISTIC
/begin MEASUREMENT anztid "Differenz Einspritzzeahler im Berechnungsraster" UBYTE dez 1 100 0 255 FORMAT "%5.1" ECU_ADDRESS 0x402BCE /end MEASUREMENT
/begin MEASUREMENT AS_hr "" UBYTE B_TRUE 1 100 0 1 BIT_MASK 0x1 FORMAT "%13.11" ECU_ADDRESS 0x3FC333 /end MEASUREMENT
/begin MEASUREMENT AS_nl "" UBYTE B_TRUE 1 100 0 1 BIT_MASK 0x1 FORMAT "%13.11" ECU_ADDRESS 0x3FC334 /end MEASUREMENT
/begin MEASUREMENT AS_psoff "" UBYTE B_TRUE 1 100 0 1 BIT_MASK 0x1 FORMAT "%13.11" ECU_ADDRESS 0x3FC335 /end MEASUREMENT
/begin MEASUREMENT BBSAWElokbits "" UBYTE dez 1 100 0 255 FORMAT "%5.1" ECU_ADDRESS 0x403C97 /end MEASUREMENT
/begin MEASUREMENT BGBNausbits0 "" UBYTE dez 1 100 0 255 FORMAT "%5.1" ECU_ADDRESS 0x403D53 /end MEASUREMENT
/begin MEASUREMENT bgccmLokBits "" UBYTE dez 1 100 0 255 FORMAT "%5.1" ECU_ADDRESS 0x402BCC /end MEASUREMENT
/begin MEASUREMENT bgccmLokNov1 "" UBYTE dez 1 100 0 255 FORMAT "%5.1" ECU_ADDRESS 0x3FE0AA /end MEASUREMENT
/begin MEASUREMENT bgcmsgccAUSBit1 "" UBYTE dez 1 100 0 255 FORMAT "%5.1" ECU_ADDRESS 0x402810 /end MEASUREMENT
/begin MEASUREMENT bgcmsgccLokBits "" UBYTE dez 1 100 0 255 FORMAT "%5.1" ECU_ADDRESS 0x402811 /end MEASUREMENT
/begin MEASUREMENT BGCVNausbits "" UBYTE dez 1 100 0 255 FORMAT "%5.1" ECU_ADDRESS 0x3FE95B /end MEASUREMENT
/begin MEASUREMENT BGDVEintbits "" UBYTE dez 1 100 0 255 FORMAT "%5.1" ECU_ADDRESS 0x3FE914 /end MEASUREMENT
/begin MEASUREMENT bgelsvAusBitsKoop "" UBYTE dez 1 100 0 255 FORMAT "%5.1" ECU_ADDRESS 0x4029D0 /end MEASUREMENT
/begin MEASUREMENT bgelsvAusBitsNovKoop "" UBYTE dez 1 100 0 255 FORMAT "%5.1" ECU_ADDRESS 0x3FE076 /end MEASUREMENT
/begin MEASUREMENT bgelsvLokBitsKoop "" UBYTE dez 1 100 0 255 FORMAT "%5.1" ECU_ADDRESS 0x4029D1 /end MEASUREMENT
/begin MEASUREMENT bgfdcanAUSBits "" UBYTE dez 1 100 0 255 FORMAT "%5.1" ECU_ADDRESS 0x40281A /end MEASUREMENT
/begin MEASUREMENT BGKVbits "" UBYTE dez 1 100 0 255 FORMAT "%5.1" ECU_ADDRESS 0x402BCF /end MEASUREMENT
/begin MEASUREMENT bglamzh "Zustandsanzeiger des Zustandsautomaten OSC-Messung Hauptkat" UBYTE dez 1 100 0 255 FORMAT "%5.1" ECU_ADDRESS 0x403B5B /end MEASUREMENT
/begin MEASUREMENT bglamzh2 "Zustandsanzeiger des Zustandsautomaten OSC-Messung Hauptkat, Bank 2" UBYTE dez 1 100 0 255 FORMAT "%5.1" ECU_ADDRESS 0x403B5C /end MEASUREMENT
/begin MEASUREMENT B_abgle "Bedingung: Fehler beim Verst‰rkerabgleich" UBYTE B_TRUE 1 100 0 1 BIT_MASK 0x1 FORMAT "%13.11" ECU_ADDRESS 0x3FBF97 /end MEASUREMENT
/begin MEASUREMENT B_accab "Bedingung: ACC-Abschaltung aus Funktionsebene" UBYTE B_TRUE 1 100 0 1 BIT_MASK 0x1 FORMAT "%13.11" ECU_ADDRESS 0x3FC02B /end MEASUREMENT
/begin MEASUREMENT B_acckupp "Umschaltung auf ACC-Ersatzmoment bei Kupplung" UBYTE B_TRUE 1 100 0 1 BIT_MASK 0x2 FORMAT "%13.11" ECU_ADDRESS 0x403BA3 /end MEASUREMENT
/begin MEASUREMENT B_acmsggts "Bed. min. Zeit in der keine Bt gesendet wurde ist verstrichen + Ereignis aufgetr" UBYTE B_TRUE 1 100 0 1 BIT_MASK 0x1 FORMAT "%13.11" ECU_ADDRESS 0x3FBEE7 /end MEASUREMENT
/begin MEASUREMENT B_asrext "Bedingung f¸r externe ASR-Anforderung" UBYTE B_TRUE 1 100 0 1 BIT_MASK 0x1 FORMAT "%13.11" ECU_ADDRESS 0x3FC035 /end MEASUREMENT
/begin MEASUREMENT B_backwu "SG-Bedingung: zur¸ck in  wake up Betrieb" UBYTE B_TRUE 1 100 0 1 BIT_MASK 0x1 FORMAT "%13.11" ECU_ADDRESS 0x40380C /end MEASUREMENT
/begin MEASUREMENT B_bevab "Bedingung EV-Abschaltung auf Bank/Bank1" UBYTE B_TRUE 1 100 0 1 BIT_MASK 0x1 FORMAT "%13.11" ECU_ADDRESS 0x3FC092 /end MEASUREMENT
/begin MEASUREMENT B_bevab2 "Bedingung EV-Abschaltung auf Bank2" UBYTE B_TRUE 1 100 0 1 BIT_MASK 0x1 FORMAT "%13.11" ECU_ADDRESS 0x3FC093 /end MEASUREMENT
/begin MEASUREMENT B_bvhfm "Bedingung: Bordnetzversorgung HFM" UBYTE B_TRUE 1 100 0 1 BIT_MASK 0x1 FORMAT "%13.11" ECU_ADDRESS 0x403D53 /end MEASUREMENT
/begin MEASUREMENT B_bvhls "Bedingung: Bordnetzversorgung Lambdasondenheizung" UBYTE B_TRUE 1 100 0 1 BIT_MASK 0x2 FORMAT "%13.11" ECU_ADDRESS 0x403D53 /end MEASUREMENT
/begin MEASUREMENT B_bzulsgs "Bedingung zul‰ssige Beschleunigung w‰hrend SGS-Eingriffs ¸berschritten" UBYTE B_TRUE 1 100 0 1 BIT_MASK 0x1 FORMAT "%13.11" ECU_ADDRESS 0x3FC038 /end MEASUREMENT
/begin MEASUREMENT B_ccevent "Bedingung Checkcontrol-Botschaft ereignissgesteuert" UBYTE B_TRUE 1 100 0 1 BIT_MASK 0x10 FORMAT "%13.11" ECU_ADDRESS 0x402810 /end MEASUREMENT
/begin MEASUREMENT B_ccevsdan "Bedingung ereignissgesteuerte (event) Sendeanforderung der Checkcontrol-Botschaf" UBYTE B_TRUE 1 100 0 1 BIT_MASK 0x40 FORMAT "%13.11" ECU_ADDRESS 0x402810 /end MEASUREMENT
/begin MEASUREMENT B_ccid155 "Bedingung Checkcontrol-Meldung 155" ULONG B_TRUE 1 100 0 1 BIT_MASK 0x4000 FORMAT "%13.11" ECU_ADDRESS 0x402BC8 /end MEASUREMENT
/begin MEASUREMENT B_ccid182 "Bedingung Checkcontrol-Meldung 182" ULONG B_TRUE 1 100 0 1 BIT_MASK 0x2000 FORMAT "%13.11" ECU_ADDRESS 0x402BC8 /end MEASUREMENT
/begin MEASUREMENT B_ccid212 "Bedingung Checkcontrol-Meldung 212" ULONG B_TRUE 1 100 0 1 BIT_MASK 0x8 FORMAT "%13.11" ECU_ADDRESS 0x402BC8 /end MEASUREMENT
/begin MEASUREMENT B_ccid213 "Bedingung Checkcontrol-Meldung 213" ULONG B_TRUE 1 100 0 1 BIT_MASK 0x80 FORMAT "%13.11" ECU_ADDRESS 0x402BC8 /end MEASUREMENT
/begin MEASUREMENT B_ccid214 "Bedingung Checkcontrol-Meldung 214" ULONG B_TRUE 1 100 0 1 BIT_MASK 0x40 FORMAT "%13.11" ECU_ADDRESS 0x402BC8 /end MEASUREMENT
/begin MEASUREMENT B_ccid220 "Bedingung Checkcontrol-Meldung 220" ULONG B_TRUE 1 100 0 1 BIT_MASK 0x10000 FORMAT "%13.11" ECU_ADDRESS 0x402BC8 /end MEASUREMENT
/begin MEASUREMENT B_ccid229 "Bedingung Checkcontrol-Meldung 229" ULONG B_TRUE 1 100 0 1 BIT_MASK 0x20000 FORMAT "%13.11" ECU_ADDRESS 0x402BC8 /end MEASUREMENT
/begin MEASUREMENT B_ccid247 "Bedingung Checkcontrol-Meldung 247" ULONG B_TRUE 1 100 0 1 BIT_MASK 0x40000 FORMAT "%13.11" ECU_ADDRESS 0x402BC8 /end MEASUREMENT
/begin MEASUREMENT B_ccid257 "Bedingung Checkcontrol-Meldung 257" ULONG B_TRUE 1 100 0 1 BIT_MASK 0x8000 FORMAT "%13.11" ECU_ADDRESS 0x402BC8 /end MEASUREMENT
/begin MEASUREMENT B_ccid26 "Bedingung Checkcontrol-Meldung 26" ULONG B_TRUE 1 100 0 1 BIT_MASK 0x400 FORMAT "%13.11" ECU_ADDRESS 0x402BC8 /end MEASUREMENT
/begin MEASUREMENT B_ccid27 "Bedingung Checkcontrol-Meldung 27" ULONG B_TRUE 1 100 0 1 BIT_MASK 0x1000 FORMAT "%13.11" ECU_ADDRESS 0x402BC8 /end MEASUREMENT
/begin MEASUREMENT B_ccid276 "Bedingung Checkcontrol-Meldung 276" ULONG B_TRUE 1 100 0 1 BIT_MASK 0x400000 FORMAT "%13.11" ECU_ADDRESS 0x402BC8 /end MEASUREMENT
/begin MEASUREMENT B_ccid28 "Bedingung Checkcontrol-Meldung 28" ULONG B_TRUE 1 100 0 1 BIT_MASK 0x200 FORMAT "%13.11" ECU_ADDRESS 0x402BC8 /end MEASUREMENT
/begin MEASUREMENT B_ccid29 "Bedingung Checkcontrol-Meldung 29" ULONG B_TRUE 1 100 0 1 BIT_MASK 0x20 FORMAT "%13.11" ECU_ADDRESS 0x402BC8 /end MEASUREMENT
/begin MEASUREMENT B_ccid30 "Bedingung Checkcontrol-Meldung 30" ULONG B_TRUE 1 100 0 1 BIT_MASK 0x100 FORMAT "%13.11" ECU_ADDRESS 0x402BC8 /end MEASUREMENT
/begin MEASUREMENT B_ccid304 "Bedingung Checkcontrol-Meldung 304" ULONG B_TRUE 1 100 0 1 BIT_MASK 0x80000 FORMAT "%13.11" ECU_ADDRESS 0x402BC8 /end MEASUREMENT
/begin MEASUREMENT B_ccid305 "Bedingung Checkcontrol-Meldung 305" ULONG B_TRUE 1 100 0 1 BIT_MASK 0x100000 FORMAT "%13.11" ECU_ADDRESS 0x402BC8 /end MEASUREMENT
/begin MEASUREMENT B_ccid306 "Bedingung Checkcontrol-Meldung 306" ULONG B_TRUE 1 100 0 1 BIT_MASK 0x200000 FORMAT "%13.11" ECU_ADDRESS 0x402BC8 /end MEASUREMENT
/begin MEASUREMENT B_ccid31 "Bedingung Checkcontrol-Meldung 31" ULONG B_TRUE 1 100 0 1 BIT_MASK 0x2 FORMAT "%13.11" ECU_ADDRESS 0x402BC8 /end MEASUREMENT
/begin MEASUREMENT B_ccid32 "Bedingung Checkcontrol-Meldung 32" ULONG B_TRUE 1 100 0 1 BIT_MASK 0x800 FORMAT "%13.11" ECU_ADDRESS 0x402BC8 /end MEASUREMENT
/begin MEASUREMENT B_ccid33 "Bedingung Checkcontrol-Meldung 33" ULONG B_TRUE 1 100 0 1 BIT_MASK 0x1 FORMAT "%13.11" ECU_ADDRESS 0x402BC8 /end MEASUREMENT
/begin MEASUREMENT B_ccid34 "Bedingung Checkcontrol-Meldung 34" ULONG B_TRUE 1 100 0 1 BIT_MASK 0x4 FORMAT "%13.11" ECU_ADDRESS 0x402BC8 /end MEASUREMENT
/begin MEASUREMENT B_ccid39 "Bedingung Checkcontrol-Meldung 39" ULONG B_TRUE 1 100 0 1 BIT_MASK 0x10 FORMAT "%13.11" ECU_ADDRESS 0x402BC8 /end MEASUREMENT
/begin MEASUREMENT B_cclampe "Bedingung  CC-Lampe ein" UBYTE B_TRUE 1 100 0 1 BIT_MASK 0x4 FORMAT "%13.11" ECU_ADDRESS 0x402810 /end MEASUREMENT
/begin MEASUREMENT B_cclblink "Bedingung  CC-Lampe soll blinken" UBYTE B_TRUE 1 100 0 1 BIT_MASK 0x2 FORMAT "%13.11" ECU_ADDRESS 0x402810 /end MEASUREMENT
/begin MEASUREMENT B_ccsdanf "Bedingung Sendeanforderung der Checkcontrol-Botschaft" UBYTE B_TRUE 1 100 0 1 BIT_MASK 0x8 FORMAT "%13.11" ECU_ADDRESS 0x402810 /end MEASUREMENT
/begin MEASUREMENT B_cksbrdy "Checksummemberechnung ist fertig (ready)" UBYTE B_TRUE 1 100 0 1 BIT_MASK 0x1 FORMAT "%13.11" ECU_ADDRESS 0x3FE95B /end MEASUREMENT
/begin MEASUREMENT B_cksbrdy2 "2. Checksummemberechnung ist fertig (ready)" UBYTE B_TRUE 1 100 0 1 BIT_MASK 0x2 FORMAT "%13.11" ECU_ADDRESS 0x3FE95B /end MEASUREMENT
/begin MEASUREMENT B_cmsggts "Bedingung CAN-Botschaft G_T wird versendet" UBYTE B_TRUE 1 100 0 1 BIT_MASK 0x1 FORMAT "%13.11" ECU_ADDRESS 0x3FBEE8 /end MEASUREMENT
/begin MEASUREMENT B_dcdisr "Bedingung: DV-E-Endstufenabschaltung wird angefordert" UBYTE B_TRUE 1 100 0 1 BIT_MASK 0x1 FORMAT "%13.11" ECU_ADDRESS 0x3FBF98 /end MEASUREMENT
/begin MEASUREMENT B_dkaden "Bedingung: DK-Sollwert aus DK-Adaption und -Pr¸fung verwenden" UBYTE B_TRUE 1 100 0 1 BIT_MASK 0x1 FORMAT "%13.11" ECU_ADDRESS 0x3FBF99 /end MEASUREMENT
/begin MEASUREMENT B_dknach "Dauer-RAM, Bedingung: DK im Nachlauf stromlos und in NLP" UBYTE B_TRUE 1 100 0 1 BIT_MASK 0x8 FORMAT "%13.11" ECU_ADDRESS 0x3FE914 /end MEASUREMENT
/begin MEASUREMENT B_dlrien "Bedingung: keine temp. Begrenzung des I-Anteils im DLR durchf¸hren" UBYTE B_TRUE 1 100 0 1 BIT_MASK 0x1 FORMAT "%13.11" ECU_ADDRESS 0x3FBF9A /end MEASUREMENT
/begin MEASUREMENT B_dmefacca "Bedingung: ACC relevanter Motronic-Fehler" UBYTE B_TRUE 1 100 0 1 BIT_MASK 0x1 FORMAT "%13.11" ECU_ADDRESS 0x3FC02C /end MEASUREMENT
/begin MEASUREMENT B_dnsll "Bedingung SA-Drehzahl-Hysterese DNSLL" UBYTE B_TRUE 1 100 0 1 BIT_MASK 0x1 FORMAT "%13.11" ECU_ADDRESS 0x403C97 /end MEASUREMENT
/begin MEASUREMENT B_dveada "Bedingung: DV-E-Adaption sperrt Einspritzung" UBYTE B_TRUE 1 100 0 1 BIT_MASK 0x1 FORMAT "%13.11" ECU_ADDRESS 0x3FBF9B /end MEASUREMENT
/begin MEASUREMENT B_dvetv "Bedingung: Verriegelungsbit erweiterte Stellertauscherkennung" UBYTE B_TRUE 1 100 0 1 BIT_MASK 0x1 FORMAT "%13.11" ECU_ADDRESS 0x3FBF9C /end MEASUREMENT
/begin MEASUREMENT B_elsv "Globaler Sammelfehler: Lambdasonde (LSU) vor dem Vorkatalysator" UBYTE B_TRUE 1 100 0 1 BIT_MASK 0x1 FORMAT "%13.11" ECU_ADDRESS 0x3FE076 /end MEASUREMENT
/begin MEASUREMENT B_elsv2 "Fehler Bank 2: Lambdasonde (LSU) vor dem Vorkatalysator" UBYTE B_TRUE 1 100 0 1 BIT_MASK 0x2 FORMAT "%13.11" ECU_ADDRESS 0x3FE076 /end MEASUREMENT
/begin MEASUREMENT B_ergacgt "Bedingung Ereignis (ƒnderung) bei Stufentempomat aufgetreten" UBYTE B_TRUE 1 100 0 1 BIT_MASK 0x1 FORMAT "%13.11" ECU_ADDRESS 0x3FBEE9 /end MEASUREMENT
/begin MEASUREMENT B_ESrdy "DK-Endstufe freigegeben" UBYTE B_TRUE 1 100 0 1 BIT_MASK 0x1 FORMAT "%13.11" ECU_ADDRESS 0x3FBF9D /end MEASUREMENT
/begin MEASUREMENT B_evakt "Bedingung alle Einspritzventile aktiv/angesteuert" UBYTE B_TRUE 1 100 0 1 BIT_MASK 0x1 FORMAT "%13.11" ECU_ADDRESS 0x3FC094 /end MEASUREMENT
/begin MEASUREMENT B_evloc "Status: alle lokalen Einspritzventile werden angesteuert, = B_EVTOT bei einem SG" UBYTE B_TRUE 1 100 0 1 BIT_MASK 0x1 FORMAT "%13.11" ECU_ADDRESS 0x3FC095 /end MEASUREMENT
/begin MEASUREMENT B_fahrerut "Bedingung Fahrer ¸bertreten" UBYTE B_TRUE 1 100 0 1 BIT_MASK 0x1 FORMAT "%13.11" ECU_ADDRESS 0x3FC02D /end MEASUREMENT
/begin MEASUREMENT B_fgdcan "Bedingung CAN Diagnosen freigegeben" UBYTE B_TRUE 1 100 0 1 BIT_MASK 0x1 FORMAT "%13.11" ECU_ADDRESS 0x40281A /end MEASUREMENT
/begin MEASUREMENT B_fgdcana "Bedingung CAN-A Diagnosen freigegeben" UBYTE B_TRUE 1 100 0 1 BIT_MASK 0x2 FORMAT "%13.11" ECU_ADDRESS 0x40281A /end MEASUREMENT
/begin MEASUREMENT B_fgdcanb "Bedingung CANB Diagnosen freigegeben" UBYTE B_TRUE 1 100 0 1 BIT_MASK 0x4 FORMAT "%13.11" ECU_ADDRESS 0x40281A /end MEASUREMENT
/begin MEASUREMENT B_fklsol "Bedingung Anforderung Verst‰rkungsumschaltung Fettkennlinie LSU/CJ125" UBYTE B_TRUE 1 100 0 1 BIT_MASK 0x1 FORMAT "%13.11" ECU_ADDRESS 0x3FBFD8 /end MEASUREMENT
/begin MEASUREMENT B_fklsol2 "Bedingung Anforderung Verst‰rkungsumschaltung Fettkennlinie LSU2/CJ125" UBYTE B_TRUE 1 100 0 1 BIT_MASK 0x1 FORMAT "%13.11" ECU_ADDRESS 0x3FBFD9 /end MEASUREMENT
/begin MEASUREMENT B_fprakt "DK-R¸ckstellfeder-Pr¸fung aktiv" UBYTE B_TRUE 1 100 0 1 BIT_MASK 0x1 FORMAT "%13.11" ECU_ADDRESS 0x3FBF9E /end MEASUREMENT
/begin MEASUREMENT B_fproab "Bedingung: DV-E-Pr¸fung ˆffnende Feder Abbruch, Feder ˆffnet nicht" UBYTE B_TRUE 1 100 0 1 BIT_MASK 0x1 FORMAT "%13.11" ECU_ADDRESS 0x3FBF9F /end MEASUREMENT
/begin MEASUREMENT B_fproe "Bedingung: ÷ffnende Federpr¸fung Fehler" UBYTE B_TRUE 1 100 0 1 BIT_MASK 0x1 FORMAT "%13.11" ECU_ADDRESS 0x3FBFA0 /end MEASUREMENT
/begin MEASUREMENT B_fprook "Bedingung: ˆffnende Federpr¸fung i.O." UBYTE B_TRUE 1 100 0 1 BIT_MASK 0x1 FORMAT "%13.11" ECU_ADDRESS 0x3FBFA1 /end MEASUREMENT
/begin MEASUREMENT B_fprordy "Bedingung: ÷ffnende Federpr¸fung fertig" UBYTE B_TRUE 1 100 0 1 BIT_MASK 0x1 FORMAT "%13.11" ECU_ADDRESS 0x3FBFA2 /end MEASUREMENT
/begin MEASUREMENT B_fprovb "Bedingung: ÷ffnende Federpr¸fung verboten" UBYTE B_TRUE 1 100 0 1 BIT_MASK 0x1 FORMAT "%13.11" ECU_ADDRESS 0x3FBFA3 /end MEASUREMENT
/begin MEASUREMENT B_fprrdy "DK-R¸ckstellfeder-Pr¸fung beendet" UBYTE B_TRUE 1 100 0 1 BIT_MASK 0x1 FORMAT "%13.11" ECU_ADDRESS 0x3FBFA4 /end MEASUREMENT
/begin MEASUREMENT B_fprzab "Bedingung: DV-E-R¸ckstellfederpr¸fung Abbruch, Feder schlieﬂt nicht" UBYTE B_TRUE 1 100 0 1 BIT_MASK 0x1 FORMAT "%13.11" ECU_ADDRESS 0x3FBFA5 /end MEASUREMENT
/begin MEASUREMENT B_fprze "Bedingung: Fehler in der DV-E-R¸ckstellfederpr¸fung" UBYTE B_TRUE 1 100 0 1 BIT_MASK 0x1 FORMAT "%13.11" ECU_ADDRESS 0x3FBFA6 /end MEASUREMENT
/begin MEASUREMENT B_fprzok "Bedingung: DV-E-R¸ckstellfederpr¸fung i.O." UBYTE B_TRUE 1 100 0 1 BIT_MASK 0x1 FORMAT "%13.11" ECU_ADDRESS 0x3FBFA7 /end MEASUREMENT
/begin MEASUREMENT B_fprzvb "Bedingung: DV-E-R¸ckstellfederpr¸fung verboten" UBYTE B_TRUE 1 100 0 1 BIT_MASK 0x1 FORMAT "%13.11" ECU_ADDRESS 0x3FBFA8 /end MEASUREMENT
/begin MEASUREMENT B_fraoan "Anforderung TEV schnell schlieﬂen zur Aktivierung der Gemischadaption" UBYTE B_TRUE 1 100 0 1 BIT_MASK 0x1 FORMAT "%13.11" ECU_ADDRESS 0x3FC084 /end MEASUREMENT
/begin MEASUREMENT B_fushkl "Flag Sonde hinter Hauptkat unplausibel bei von Sauerstoff geleertem Hauptkat" UBYTE B_TRUE 1 100 0 1 BIT_MASK 0x10 FORMAT "%13.11" ECU_ADDRESS 0x403B5A /end MEASUREMENT
/begin MEASUREMENT B_fushkl2 "Flag Sonde hinter Hauptkat unplausibel bei von Sauerstoff geleertem Hauptkat, B2" UBYTE B_TRUE 1 100 0 1 BIT_MASK 0x20 FORMAT "%13.11" ECU_ADDRESS 0x403B5A /end MEASUREMENT
/begin MEASUREMENT B_fushkv "Flag Sonde hinter Hauptkat unplausibel bei von Sauerstoff gef¸lltem Hauptkat" UBYTE B_TRUE 1 100 0 1 BIT_MASK 0x40 FORMAT "%13.11" ECU_ADDRESS 0x403B5A /end MEASUREMENT
/begin MEASUREMENT B_fushkv2 "Flag Sonde hinter Hauptkat unplausibel bei von Sauerstoff gef¸lltem Hauptkat, B2" UBYTE B_TRUE 1 100 0 1 BIT_MASK 0x80 FORMAT "%13.11" ECU_ADDRESS 0x403B5A /end MEASUREMENT
/begin MEASUREMENT B_gap "Bedingung Gemischadaptionsphase aktiv" UBYTE B_TRUE 1 100 0 1 BIT_MASK 0x1 FORMAT "%13.11" ECU_ADDRESS 0x3FC085 /end MEASUREMENT
/begin MEASUREMENT B_hkleer "Bit Hauptkatalysator von Sauerstoff geleert" UBYTE B_TRUE 1 100 0 1 BIT_MASK 0x10 FORMAT "%13.11" ECU_ADDRESS 0x403B52 /end MEASUREMENT
/begin MEASUREMENT B_hkleer2 "Bit Hauptkatalysator von Sauerstoff geleert, Bank 2" UBYTE B_TRUE 1 100 0 1 BIT_MASK 0x20 FORMAT "%13.11" ECU_ADDRESS 0x403B52 /end MEASUREMENT
/begin MEASUREMENT B_hklosm "Flag Speichermodell zeigt an, dass Hauptkat von Sauerstoff geleert" UBYTE B_TRUE 1 100 0 1 BIT_MASK 0x1 FORMAT "%13.11" ECU_ADDRESS 0x403B57 /end MEASUREMENT
/begin MEASUREMENT B_hklosm2 "Flag Speichermodell zeigt an, dass Hauptkat von Sauerstoff geleert, Bank 2" UBYTE B_TRUE 1 100 0 1 BIT_MASK 0x2 FORMAT "%13.11" ECU_ADDRESS 0x403B57 /end MEASUREMENT
/begin MEASUREMENT B_hklush "Flag Sonde zeigt an, dass Hauptkat von Sauerstoff geleert" UBYTE B_TRUE 1 100 0 1 BIT_MASK 0x4 FORMAT "%13.11" ECU_ADDRESS 0x403B57 /end MEASUREMENT
/begin MEASUREMENT B_hklush2 "Flag Sonde zeigt an, dass Hauptkat von Sauerstoff geleert, Bank 2" UBYTE B_TRUE 1 100 0 1 BIT_MASK 0x8 FORMAT "%13.11" ECU_ADDRESS 0x403B57 /end MEASUREMENT
/begin MEASUREMENT B_hkvoll "Bit Hauptkatalysator mit Sauerstoff gef¸llt" UBYTE B_TRUE 1 100 0 1 BIT_MASK 0x40 FORMAT "%13.11" ECU_ADDRESS 0x403B52 /end MEASUREMENT
/begin MEASUREMENT B_hkvoll2 "Bit Hauptkatalysator mit Sauerstoff gef¸llt, Bank 2" UBYTE B_TRUE 1 100 0 1 BIT_MASK 0x80 FORMAT "%13.11" ECU_ADDRESS 0x403B52 /end MEASUREMENT
/begin MEASUREMENT B_hkvosm "Flag Speichermodell zeigt an, dass Hauptkat mit Sauerstoff gef¸llt" UBYTE B_TRUE 1 100 0 1 BIT_MASK 0x10 FORMAT "%13.11" ECU_ADDRESS 0x403B57 /end MEASUREMENT
/begin MEASUREMENT B_hkvosm2 "Flag Speichermodell zeigt an, dass Hauptkat mit Sauerstoff gef¸llt, Bank 2" UBYTE B_TRUE 1 100 0 1 BIT_MASK 0x20 FORMAT "%13.11" ECU_ADDRESS 0x403B57 /end MEASUREMENT
/begin MEASUREMENT B_hkvush "Flag Sonde zeigt an, dass Vorkat mit Sauerstoff gef¸llt" UBYTE B_TRUE 1 100 0 1 BIT_MASK 0x40 FORMAT "%13.11" ECU_ADDRESS 0x403B57 /end MEASUREMENT
/begin MEASUREMENT B_hkvush2 "Flag Sonde zeigt an, dass Vorkat mit Sauerstoff gef¸llt, Bank 2" UBYTE B_TRUE 1 100 0 1 BIT_MASK 0x80 FORMAT "%13.11" ECU_ADDRESS 0x403B57 /end MEASUREMENT
/begin MEASUREMENT B_hr "Bedingung Hauptrelais ein" UBYTE B_TRUE 1 100 0 1 BIT_MASK 0x1 FORMAT "%13.11" ECU_ADDRESS 0x40380D /end MEASUREMENT
/begin MEASUREMENT B_hysllrah "Bedingung LL-Anhebunghysterese" UBYTE B_TRUE 1 100 0 1 FORMAT "%13.11" ECU_ADDRESS 0x4031C4 /end MEASUREMENT
/begin MEASUREMENT B_idmef "Bedingung: interner Motronic-Fehler" UBYTE B_TRUE 1 100 0 1 BIT_MASK 0x1 FORMAT "%13.11" ECU_ADDRESS 0x3FC02E /end MEASUREMENT
/begin MEASUREMENT B_imskahk "Bit Abgasmassendurchsatz nach Kat-Ausr‰umen f¸r Korrektur-Freigabe Hauptkat" UBYTE B_TRUE 1 100 0 1 BIT_MASK 0x4 FORMAT "%13.11" ECU_ADDRESS 0x403B58 /end MEASUREMENT
/begin MEASUREMENT B_imskahk2 "Bit Abgasmassendurchsatz nach Kat-Ausr‰umen f¸r Korrektur-Freigabe Hauptkat, B.2" UBYTE B_TRUE 1 100 0 1 BIT_MASK 0x8 FORMAT "%13.11" ECU_ADDRESS 0x403B58 /end MEASUREMENT
/begin MEASUREMENT B_intzwv "Bedingung ZW-Verstellung durch MD-Struktur aktiv" UBYTE B_TRUE 1 100 0 1 BIT_MASK 0x1 FORMAT "%13.11" ECU_ADDRESS 0x3FC273 /end MEASUREMENT
/begin MEASUREMENT B_kl15 "Bedingung Klemme 15" UBYTE B_TRUE 1 100 0 1 BIT_MASK 0x1 FORMAT "%13.11" ECU_ADDRESS 0x3FE965 /end MEASUREMENT
/begin MEASUREMENT B_kupplmod "Bedingung Kupplung bet‰tigt aus Modell" UBYTE B_TRUE 1 100 0 1 FORMAT "%13.11" ECU_ADDRESS 0x40378C /end MEASUREMENT
/begin MEASUREMENT B_kvta "Bedingung verbrauchter Kraftstoff groesser max. Tankinhalt" UBYTE B_TRUE 1 100 0 1 BIT_MASK 0x1 FORMAT "%13.11" ECU_ADDRESS 0x402BCF /end MEASUREMENT
/begin MEASUREMENT B_lrnakt "Lernaktiv Bit" UBYTE B_TRUE 1 100 0 1 BIT_MASK 0x1 FORMAT "%13.11" ECU_ADDRESS 0x3FBFA9 /end MEASUREMENT
/begin MEASUREMENT B_lrnerf "Lernerfolg Bit" UBYTE B_TRUE 1 100 0 1 BIT_MASK 0x2 FORMAT "%13.11" ECU_ADDRESS 0x3FE914 /end MEASUREMENT
/begin MEASUREMENT B_lrnfg "Lernfreigabe Bit" UBYTE B_TRUE 1 100 0 1 BIT_MASK 0x1 FORMAT "%13.11" ECU_ADDRESS 0x3FBFAA /end MEASUREMENT
/begin MEASUREMENT B_lrnrdy "Lernen ist beendet" UBYTE B_TRUE 1 100 0 1 BIT_MASK 0x1 FORMAT "%13.11" ECU_ADDRESS 0x3FBFAB /end MEASUREMENT
/begin MEASUREMENT B_lrntesa "Bedingung: UMA-Lernen u. Verst.abgl wegen Tester-Anford. aktiviert" UBYTE B_TRUE 1 100 0 1 BIT_MASK 0x1 FORMAT "%13.11" ECU_ADDRESS 0x3FBFAC /end MEASUREMENT
/begin MEASUREMENT B_lrnvb "Lernverbot Bit" UBYTE B_TRUE 1 100 0 1 BIT_MASK 0x1 FORMAT "%13.11" ECU_ADDRESS 0x3FBFAD /end MEASUREMENT
/begin MEASUREMENT B_lrnws "Lernwertspeicherung Bit" UBYTE B_TRUE 1 100 0 1 BIT_MASK 0x1 FORMAT "%13.11" ECU_ADDRESS 0x3FE914 /end MEASUREMENT
/begin MEASUREMENT B_miext "Bedingung externer Momenteneingriff" UBYTE B_TRUE 1 100 0 1 BIT_MASK 0x1 FORMAT "%13.11" ECU_ADDRESS 0x3FC274 /end MEASUREMENT
/begin MEASUREMENT B_mksgsmx "Bedingung zul‰ssiges Sollmoment w‰hrend SGS-Eingriffs ¸berschritten" UBYTE B_TRUE 1 100 0 1 BIT_MASK 0x1 FORMAT "%13.11" ECU_ADDRESS 0x3FC039 /end MEASUREMENT
/begin MEASUREMENT B_mnbfmder "Bedingung min. befeuertes Moment erreicht" UBYTE B_TRUE 1 100 0 1 BIT_MASK 0x1 FORMAT "%13.11" ECU_ADDRESS 0x3FC02F /end MEASUREMENT
/begin MEASUREMENT B_mrkvff "Bedingung:  Merker das B_mrkv (Marker ver‰nderung) gesetzt war" UBYTE B_TRUE 1 100 0 1 BIT_MASK 0x1 FORMAT "%13.11" ECU_ADDRESS 0x3FBEEA /end MEASUREMENT
/begin MEASUREMENT B_msrext "Bedingung f¸r externe Anforderung MSR" UBYTE B_TRUE 1 100 0 1 BIT_MASK 0x1 FORMAT "%13.11" ECU_ADDRESS 0x3FC036 /end MEASUREMENT
/begin MEASUREMENT B_nachlauf "Steuerung SG-Nachlauf" UBYTE B_TRUE 1 100 0 1 BIT_MASK 0x1 FORMAT "%13.11" ECU_ADDRESS 0x40380E /end MEASUREMENT
/begin MEASUREMENT B_nftev "Bedingung Drehzahlanhebung f¸r erhˆhte TE-Sp¸lrate" UBYTE B_TRUE 1 100 0 1 BIT_MASK 0x1 FORMAT "%13.11" ECU_ADDRESS 0x3FC086 /end MEASUREMENT
/begin MEASUREMENT B_nloff "Bedingung: Schalter SG aus" UBYTE B_TRUE 1 100 0 1 BIT_MASK 0x1 FORMAT "%13.11" ECU_ADDRESS 0x40380F /end MEASUREMENT
/begin MEASUREMENT B_nlpe "Bedingung: Fehler in NLP-Pr¸fung u. -Lernen" UBYTE B_TRUE 1 100 0 1 BIT_MASK 0x1 FORMAT "%13.11" ECU_ADDRESS 0x3FBFAE /end MEASUREMENT
/begin MEASUREMENT B_nlperf "Dauer-RAM, Bedingung: NLP-Erfassung erfolgreich" UBYTE B_TRUE 1 100 0 1 BIT_MASK 0x4 FORMAT "%13.11" ECU_ADDRESS 0x3FE914 /end MEASUREMENT
/begin MEASUREMENT B_nlpnew "Bedingung: NLP-Position ist noch nicht bekannt" UBYTE B_TRUE 1 100 0 1 BIT_MASK 0x1 FORMAT "%13.11" ECU_ADDRESS 0x3FBFAF /end MEASUREMENT
/begin MEASUREMENT B_nlpreq "Bedingung: NLP-Lernen anfordern" UBYTE B_TRUE 1 100 0 1 BIT_MASK 0x1 FORMAT "%13.11" ECU_ADDRESS 0x3FBFB0 /end MEASUREMENT
/begin MEASUREMENT B_noacc_fr "Bedingung keine ‹bernahme des ACC-Momentes aus Funktionsebene" UBYTE B_TRUE 1 100 0 1 BIT_MASK 0x1 FORMAT "%13.11" ECU_ADDRESS 0x3FC030 /end MEASUREMENT
/begin MEASUREMENT B_noccm257 "Bedingung keine ‹bertemperatur im Nachlauf" UBYTE B_TRUE 1 100 0 1 BIT_MASK 0x1 FORMAT "%13.11" ECU_ADDRESS 0x3FE0AA /end MEASUREMENT
/begin MEASUREMENT B_nomsr_fr "kein ASR-/MSR-Eingriff vom FR" UBYTE B_TRUE 1 100 0 1 BIT_MASK 0x1 FORMAT "%13.11" ECU_ADDRESS 0x3FC037 /end MEASUREMENT
/begin MEASUREMENT B_norm "SG-Bedingung normaler Motorsteuerungsbetrieb" UBYTE B_TRUE 1 100 0 1 BIT_MASK 0x1 FORMAT "%13.11" ECU_ADDRESS 0x403810 /end MEASUREMENT
/begin MEASUREMENT B_normtmp "Bedingung ‹bergang vom Wakeup ind den Normbetrieb im n‰chsten 10er Raster" UBYTE B_TRUE 1 100 0 1 BIT_MASK 0x1 FORMAT "%13.11" ECU_ADDRESS 0x403811 /end MEASUREMENT
/begin MEASUREMENT B_nosgs "SGS-Eingriff von der Ebene 2 nicht erlaubt" UBYTE B_TRUE 1 100 0 1 BIT_MASK 0x1 FORMAT "%13.11" ECU_ADDRESS 0x3FC03A /end MEASUREMENT
/begin MEASUREMENT B_nosgs_fr "kein SGS-Eingriff vom FR" UBYTE B_TRUE 1 100 0 1 BIT_MASK 0x1 FORMAT "%13.11" ECU_ADDRESS 0x3F9931 /end MEASUREMENT
/begin MEASUREMENT B_omnhaku "Bit untere Grenze f¸r Sauerstoff-Speicherf‰higkeit Hauptkat gemessen" UBYTE B_TRUE 1 100 0 1 BIT_MASK 0x2 FORMAT "%13.11" ECU_ADDRESS 0x403B53 /end MEASUREMENT
/begin MEASUREMENT B_omnhaku2 "Bit untere Grenze f¸r Sauerstoff-Speicherf‰higkeit Hauptkat gemessen, Bank 2" UBYTE B_TRUE 1 100 0 1 BIT_MASK 0x2 FORMAT "%13.11" ECU_ADDRESS 0x403B54 /end MEASUREMENT
/begin MEASUREMENT B_oschaku "Bit aktuelle Sauerstoff-Speicherf‰higkeit Hauptkat gemessen" UBYTE B_TRUE 1 100 0 1 BIT_MASK 0x8 FORMAT "%13.11" ECU_ADDRESS 0x403B53 /end MEASUREMENT
/begin MEASUREMENT B_oschaku2 "Bit aktuelle Sauerstoff-Speicherf‰higkeit Hauptkat gemessen, Bank 2" UBYTE B_TRUE 1 100 0 1 BIT_MASK 0x8 FORMAT "%13.11" ECU_ADDRESS 0x403B54 /end MEASUREMENT
/begin MEASUREMENT B_oxrsthk "Bit Reset Sauerstoff-Integrator Hauptkat" UBYTE B_TRUE 1 100 0 1 BIT_MASK 0x40 FORMAT "%13.11" ECU_ADDRESS 0x403B58 /end MEASUREMENT
/begin MEASUREMENT B_oxrsthk2 "Bit Reset Sauerstoff-Integrator Hauptkat, Bank 2" UBYTE B_TRUE 1 100 0 1 BIT_MASK 0x80 FORMAT "%13.11" ECU_ADDRESS 0x403B58 /end MEASUREMENT
/begin MEASUREMENT B_qaccair "Bedingung Quittierung ACC Abschaltung irreversibel" UBYTE B_TRUE 1 100 0 1 BIT_MASK 0x1 FORMAT "%13.11" ECU_ADDRESS 0x3FC031 /end MEASUREMENT
/begin MEASUREMENT B_qaccar "Bedingung Quittierung ACC Abschaltung reversibel" UBYTE B_TRUE 1 100 0 1 BIT_MASK 0x1 FORMAT "%13.11" ECU_ADDRESS 0x3FC032 /end MEASUREMENT
/begin MEASUREMENT B_qaccsyof "Bedingung Quittierung der ACC Systemabschaltung" UBYTE B_TRUE 1 100 0 1 BIT_MASK 0x1 FORMAT "%13.11" ECU_ADDRESS 0x3FC033 /end MEASUREMENT
/begin MEASUREMENT B_rmnhaku "Bit untere Grenze Sauerstoff-Speicherf‰higkeit Hauptkat gemessen mager-fett" UBYTE B_TRUE 1 100 0 1 BIT_MASK 0x20 FORMAT "%13.11" ECU_ADDRESS 0x403B53 /end MEASUREMENT
/begin MEASUREMENT B_rmnhaku2 "Bit untere Grenze Sauerstoff-Speicherf‰higkeit Hauptkat gemessen mager-fett, B.2" UBYTE B_TRUE 1 100 0 1 BIT_MASK 0x20 FORMAT "%13.11" ECU_ADDRESS 0x403B54 /end MEASUREMENT
/begin MEASUREMENT B_rschaku "Bit aktuelle Sauerstoff-Speicherf‰higkeit Hauptkat gemessen mager-fett" UBYTE B_TRUE 1 100 0 1 BIT_MASK 0x80 FORMAT "%13.11" ECU_ADDRESS 0x403B53 /end MEASUREMENT
/begin MEASUREMENT B_rschaku2 "Bit aktuelle Sauerstoff-Speicherf‰higkeit Hauptkat gemessen mager-fett, Bank 2" UBYTE B_TRUE 1 100 0 1 BIT_MASK 0x80 FORMAT "%13.11" ECU_ADDRESS 0x403B54 /end MEASUREMENT
/begin MEASUREMENT B_sab "Bedingung Schubabschaltebereitschaft" UBYTE B_TRUE 1 100 0 1 BIT_MASK 0x1 FORMAT "%13.11" ECU_ADDRESS 0x3FC221 /end MEASUREMENT
/begin MEASUREMENT B_sabt "Bedingung Schubabschaltebereitschaft" UBYTE B_TRUE 1 100 0 1 BIT_MASK 0x2 FORMAT "%13.11" ECU_ADDRESS 0x403C97 /end MEASUREMENT
/begin MEASUREMENT B_savacc "Bedingung: Schubabschalteverbot von ACC" UBYTE B_TRUE 1 100 0 1 BIT_MASK 0x1 FORMAT "%13.11" ECU_ADDRESS 0x3FC034 /end MEASUREMENT
/begin MEASUREMENT B_sbbvk "Bedingung Sonde betriebsbereit vor Kat" UBYTE B_TRUE 1 100 0 1 BIT_MASK 0x1 FORMAT "%13.11" ECU_ADDRESS 0x3FBFDA /end MEASUREMENT
/begin MEASUREMENT B_sbbvk2 "Bedingung Sonde betriebsbereit vor Kat, Bank 2" UBYTE B_TRUE 1 100 0 1 BIT_MASK 0x1 FORMAT "%13.11" ECU_ADDRESS 0x3FBFDB /end MEASUREMENT
/begin MEASUREMENT B_scmebhk "Flag Bereitschaft f¸r OSC-Messung des Hauptkatalysators" UBYTE B_TRUE 1 100 0 1 BIT_MASK 0x4 FORMAT "%13.11" ECU_ADDRESS 0x403B55 /end MEASUREMENT
/begin MEASUREMENT B_scmebhk2 "Flag Bereitschaft f¸r OSC-Messung des Hauptkatalysators, Bank2" UBYTE B_TRUE 1 100 0 1 BIT_MASK 0x8 FORMAT "%13.11" ECU_ADDRESS 0x403B55 /end MEASUREMENT
/begin MEASUREMENT B_sgsamx "Bedingung zul‰ssige SGS-Eingriffs Zeit ¸berschritten" UBYTE B_TRUE 1 100 0 1 BIT_MASK 0x1 FORMAT "%13.11" ECU_ADDRESS 0x3FC03B /end MEASUREMENT
/begin MEASUREMENT B_sgsanf "Bedingung SGS-Soll-Eingriff aktiv" UBYTE B_TRUE 1 100 0 1 BIT_MASK 0x1 FORMAT "%13.11" ECU_ADDRESS 0x3FC03C /end MEASUREMENT
/begin MEASUREMENT B_sgsmdt "Bedingung zul‰ssiges SGS-Momenten-Zeit-Integral ¸berschritten" UBYTE B_TRUE 1 100 0 1 BIT_MASK 0x1 FORMAT "%13.11" ECU_ADDRESS 0x3FC03D /end MEASUREMENT
/begin MEASUREMENT B_sgsnamn "Bedingung Wartezeit nach SGS-Eingriff nicht abgelaufen" UBYTE B_TRUE 1 100 0 1 BIT_MASK 0x1 FORMAT "%13.11" ECU_ADDRESS 0x3FC03E /end MEASUREMENT
/begin MEASUREMENT B_sgspnpl "Bedingung positiver SGS-Eingriff unplausibel" UBYTE B_TRUE 1 100 0 1 BIT_MASK 0x1 FORMAT "%13.11" ECU_ADDRESS 0x3FC03F /end MEASUREMENT
/begin MEASUREMENT B_st "Bedingung Start" UBYTE B_TRUE 1 100 0 1 BIT_MASK 0x1 FORMAT "%13.11" ECU_ADDRESS 0x3FC029 /end MEASUREMENT
/begin MEASUREMENT B_stcrhk "Bit Sauerstoff-Integrator-Korrektur Hauptkat freigegeben" UBYTE B_TRUE 1 100 0 1 BIT_MASK 0x4 FORMAT "%13.11" ECU_ADDRESS 0x403B59 /end MEASUREMENT
/begin MEASUREMENT B_stcrhk2 "Bit Sauerstoff-Integrator-Korrektur Hauptkat freigegeben, Bank 2" UBYTE B_TRUE 1 100 0 1 BIT_MASK 0x8 FORMAT "%13.11" ECU_ADDRESS 0x403B59 /end MEASUREMENT
/begin MEASUREMENT B_stend "Bedingung Startende erreicht" UBYTE B_TRUE 1 100 0 1 BIT_MASK 0x1 FORMAT "%13.11" ECU_ADDRESS 0x3FC02A /end MEASUREMENT
/begin MEASUREMENT B_tedtev "Bedingung Tankentl¸ftung zum Sp¸len vor TEV-Diagnose" UBYTE B_TRUE 1 100 0 1 BIT_MASK 0x1 FORMAT "%13.11" ECU_ADDRESS 0x3FC087 /end MEASUREMENT
/begin MEASUREMENT B_tehbxf "Bedingung Beladungsintegrator ftead am Maximalanschlag, gefiltert" UBYTE B_TRUE 1 100 0 1 BIT_MASK 0x1 FORMAT "%13.11" ECU_ADDRESS 0x3FC088 /end MEASUREMENT
/begin MEASUREMENT B_tep "Bedingung Tankentl¸ftungsphase" UBYTE B_TRUE 1 100 0 1 BIT_MASK 0x1 FORMAT "%13.11" ECU_ADDRESS 0x3FC089 /end MEASUREMENT
/begin MEASUREMENT B_tepi "Bedingung TE-Phase intern aktiv" UBYTE B_TRUE 1 100 0 1 BIT_MASK 0x1 FORMAT "%13.11" ECU_ADDRESS 0x3FC08A /end MEASUREMENT
/begin MEASUREMENT B_tepzhl "Bedingung Tankentl¸ftungphase zus‰tzlich wegen Dauerhochlast" UBYTE B_TRUE 1 100 0 1 BIT_MASK 0x1 FORMAT "%13.11" ECU_ADDRESS 0x3FC08B /end MEASUREMENT
/begin MEASUREMENT B_tepzus "Bedingung zus‰tzliche Tankentl¸ftungsphase" UBYTE B_TRUE 1 100 0 1 BIT_MASK 0x1 FORMAT "%13.11" ECU_ADDRESS 0x3FC08C /end MEASUREMENT
/begin MEASUREMENT B_tesstp "Bedingung Tankentl¸ftung schnell stoppen" UBYTE B_TRUE 1 100 0 1 BIT_MASK 0x1 FORMAT "%13.11" ECU_ADDRESS 0x3FC08D /end MEASUREMENT
/begin MEASUREMENT B_testop "Bedingung Tankentl¸ftung stoppen" UBYTE B_TRUE 1 100 0 1 BIT_MASK 0x1 FORMAT "%13.11" ECU_ADDRESS 0x3FC08E /end MEASUREMENT
/begin MEASUREMENT B_tezstp "Bedingung Tankentl¸ftung zwang stoppen" UBYTE B_TRUE 1 100 0 1 BIT_MASK 0x1 FORMAT "%13.11" ECU_ADDRESS 0x3FC08F /end MEASUREMENT
/begin MEASUREMENT B_tteae "Bedingung Umschaltung auf lange TE-Phase" UBYTE B_TRUE 1 100 0 1 BIT_MASK 0x1 FORMAT "%13.11" ECU_ADDRESS 0x3FC090 /end MEASUREMENT
/begin MEASUREMENT B_ttegais "Bedingung erste GA-Phase ist kurz" UBYTE B_TRUE 1 100 0 1 BIT_MASK 0x1 FORMAT "%13.11" ECU_ADDRESS 0x3FC091 /end MEASUREMENT
/begin MEASUREMENT B_umae "Bedingung: Fehler beim UMA-Lernen" UBYTE B_TRUE 1 100 0 1 BIT_MASK 0x1 FORMAT "%13.11" ECU_ADDRESS 0x3FBFB1 /end MEASUREMENT
/begin MEASUREMENT B_umauab "Bedingung: UMA-Lernen w‰hrend Urinitialisierung abgebrochen (SKA)" UBYTE B_TRUE 1 100 0 1 BIT_MASK 0x1 FORMAT "%13.11" ECU_ADDRESS 0x3FBFB2 /end MEASUREMENT
/begin MEASUREMENT B_upuew "Bedingung Umschaltung auf Pedal¸berweg" UBYTE B_TRUE 1 100 0 1 BIT_MASK 0x1 FORMAT "%13.11" ECU_ADDRESS 0x403BA3 /end MEASUREMENT
/begin MEASUREMENT B_ushknp "Bit Spannung Lambdasonde hinter Hauptkatalysator nicht plausibel" UBYTE B_TRUE 1 100 0 1 BIT_MASK 0x10 FORMAT "%13.11" ECU_ADDRESS 0x403B55 /end MEASUREMENT
/begin MEASUREMENT B_ushknp2 "Bit Spannung Lambdasonde hinter Hauptkatalysator nicht plausibel, Bank 2" UBYTE B_TRUE 1 100 0 1 BIT_MASK 0x20 FORMAT "%13.11" ECU_ADDRESS 0x403B55 /end MEASUREMENT
/begin MEASUREMENT B_vl "Bedingung Vollast" UBYTE dez 1 100 0 255 FORMAT "%5.1" ECU_ADDRESS 0x4037FA /end MEASUREMENT
/begin MEASUREMENT B_vlb "Vollastbereitschaft vom Fahrerwunsch" UBYTE dez 1 100 0 255 FORMAT "%5.1" ECU_ADDRESS 0x4037FB /end MEASUREMENT
/begin MEASUREMENT B_vlmi "Vollasterkennung ¸ber Momentenanforderung" UBYTE dez 1 100 0 255 FORMAT "%5.1" ECU_ADDRESS 0x4037FC /end MEASUREMENT
/begin MEASUREMENT B_vsgsmn "Bedingung Fzg.-Geschwindigkeit unterhalb Schwelle w‰hrend des SGS-Eingriff" UBYTE B_TRUE 1 100 0 1 BIT_MASK 0x1 FORMAT "%13.11" ECU_ADDRESS 0x3FC040 /end MEASUREMENT
/begin MEASUREMENT B_wakeup "SG-Bedingung: wake up Betrieb" UBYTE B_TRUE 1 100 0 1 BIT_MASK 0x1 FORMAT "%13.11" ECU_ADDRESS 0x403812 /end MEASUREMENT
/begin MEASUREMENT B_wdaactiv "Bedingung WDA-Abschaltung aktiv" UBYTE B_TRUE 1 100 0 1 BIT_MASK 0x1 FORMAT "%13.11" ECU_ADDRESS 0x3FC336 /end MEASUREMENT
/begin MEASUREMENT B_zdv "Diagnose Fz-Geschwindigkeit aktiv Z_vfz noch false" UBYTE B_TRUE 1 100 0 1 BIT_MASK 0x4 FORMAT "%13.11" ECU_ADDRESS 0x403C97 /end MEASUREMENT
/begin MEASUREMENT B_zlsv "Globales Sammelzyklusflag: Lambdasonde (LSU) vor dem Vorkatalysator" UBYTE B_TRUE 1 100 0 1 BIT_MASK 0x1 FORMAT "%13.11" ECU_ADDRESS 0x4029D0 /end MEASUREMENT
/begin MEASUREMENT B_zlsv2 "Globales Sammelzyklusflag: Lambdasonde (LSU) vor dem Vorkatalysator, Bank 2" UBYTE B_TRUE 1 100 0 1 BIT_MASK 0x2 FORMAT "%13.11" ECU_ADDRESS 0x4029D0 /end MEASUREMENT
/begin MEASUREMENT CALIBID1 "Calibration ID 1 zur SG Identifikation f¸r Mode $09" UBYTE dez 1 100 0 255 FORMAT "%5.1" ARRAY_SIZE 12 ECU_ADDRESS 0x403046 /end MEASUREMENT
/begin MEASUREMENT CALIBID2 "Calibration ID 2 zur SG Identifikation f¸r Mode $09" UBYTE dez 1 100 0 255 FORMAT "%5.1" ARRAY_SIZE 12 ECU_ADDRESS 0x403052 /end MEASUREMENT
/begin MEASUREMENT ccbitpos "Bitposition im CC-Kontrollflag" UBYTE dez 1 100 0 255 FORMAT "%5.1" ECU_ADDRESS 0x402812 /end MEASUREMENT
/begin MEASUREMENT ccflags_l "Flag in dem alle CC-Meldungen enthalten sind" ULONG DEZ 1 100 0 4.29497e+009 FORMAT "%13.2" ECU_ADDRESS 0x402BC8 /end MEASUREMENT
/begin MEASUREMENT ccoldflg_l "Flag in dem die CC-Meldungen enthalten sind die bereits gesendet wurden" ULONG dez 1 100 0 4.29497e+009 FORMAT "%13.2" ECU_ADDRESS 0x40280C /end MEASUREMENT
/begin MEASUREMENT coxinhk2_w "Sauerstoffkonzentration des in den Hauptkatalysator strˆmenden Gases, Bank 2" SWORD fak_sw_b8 1 100 -8 7.99976 FORMAT "%8.6" ECU_ADDRESS 0x403E12 /end MEASUREMENT
/begin MEASUREMENT coxinhk_w "Sauerstoffkonzentration des in den Hauptkatalysator strˆmenden Gases" SWORD fak_sw_b8 1 100 -8 7.99976 FORMAT "%8.6" ECU_ADDRESS 0x403E14 /end MEASUREMENT
/begin MEASUREMENT cvn "auszugebende Checksumme (CVN) entsprechend SAE J1979 Mode $09" UBYTE dez 1 100 0 255 FORMAT "%5.1" ARRAY_SIZE 4 ECU_ADDRESS 0x3FE95C /end MEASUREMENT
/begin MEASUREMENT cvn2 "zweite auszugebende Checksumme (CVN) entsprechend SAE J1979 Mode $09" UBYTE dez 1 100 0 255 FORMAT "%5.1" ARRAY_SIZE 4 ECU_ADDRESS 0x3FE960 /end MEASUREMENT
/begin MEASUREMENT cvn_temp "" UBYTE dez 1 100 0 255 FORMAT "%5.1" ARRAY_SIZE 4 ECU_ADDRESS 0x40305E /end MEASUREMENT
/begin MEASUREMENT dcoxhk2_w "F¸llstandskorrektur Hauptkatalysator, Bank 2" SWORD fak_sw_b8 1 100 -8 7.99976 FORMAT "%8.6" ECU_ADDRESS 0x403E16 /end MEASUREMENT
/begin MEASUREMENT dcoxhk_w "F¸llstandskorrektur Hauptkatalysator" SWORD fak_sw_b8 1 100 -8 7.99976 FORMAT "%8.6" ECU_ADDRESS 0x403E18 /end MEASUREMENT
/begin MEASUREMENT dkpstg_w "Steigung DK-Poti (% DK / V)" UWORD rel_uw_b40 1 100 0 39.9994 FORMAT "%8.5" ECU_ADDRESS 0x403DD8 /end MEASUREMENT
/begin MEASUREMENT dlaoffs2_w "Lambda-Offset der Breitband-Lambdasonde, Bank 2" SWORD fak_sw_b1 1 100 -1 0.999969 FORMAT "%8.6" ECU_ADDRESS 0x403E1A /end MEASUREMENT
/begin MEASUREMENT dlaoffs_w "Lambda-Offset der Breitband-Lambdasonde" SWORD fak_sw_b1 1 100 -1 0.999969 FORMAT "%8.6" ECU_ADDRESS 0x403E1C /end MEASUREMENT
/begin MEASUREMENT dlrmxt "timer f¸r DLR im UMA in der Begrenzung" UBYTE t50msxs_q0p05 1 100 0 12.75 FORMAT "%5.2" ECU_ADDRESS 0x403B38 /end MEASUREMENT
/begin MEASUREMENT dmrfabn_w "Aktuelle gewichtete Leistung um Schwelle MRFABNTE verschoben" SWORD rel_sw_b100 1 100 -100 99.9969 FORMAT "%8.4" ECU_ADDRESS 0x402D42 /end MEASUREMENT
/begin MEASUREMENT dnsa "Zeitabh‰ngige Schubhysterese" UBYTE nmot_ub_q40 1 100 0 10200 FORMAT "%5.0" ECU_ADDRESS 0x403C98 /end MEASUREMENT
/begin MEASUREMENT dtnxtccmsg "Deltazeit bis zur n‰chsten CC-Botschaft" UBYTE dez 1 100 0 255 FORMAT "%5.1" ECU_ADDRESS 0x402813 /end MEASUREMENT
/begin MEASUREMENT dveadchst "DV-E-Adaption: Status Pr¸fbedingungen" UBYTE dez 1 100 0 255 FORMAT "%5.1" ECU_ADDRESS 0x403B39 /end MEASUREMENT
/begin MEASUREMENT etazabas "Ist-Zylinderausblendungswirkungsgrad (ohne ext. Ausblendungsanforderung)" UBYTE rel_ub_b127p5 1 100 0 127.5 FORMAT "%5.1" ECU_ADDRESS 0x403CDD /end MEASUREMENT
/begin MEASUREMENT etxdmtk "Fehlerart-Erweiterungsbyte: Diagnosestatus Tankentl¸ftungssystem Grob- oder Fein" UBYTE dez 1 100 0 255 FORMAT "%5.1" ECU_ADDRESS 0x40284F /end MEASUREMENT
/begin MEASUREMENT etxdmtknm "Fehlerart-Erweiterungsbyte: Diagnosestatus Tankentl¸ftungssystem Kleinstleck (ni" UBYTE dez 1 100 0 255 FORMAT "%5.1" ECU_ADDRESS 0x402850 /end MEASUREMENT
/begin MEASUREMENT etxdmtl "Fehlerart-Erweiterungsbyte: Diagnosestatus Tankleckdiagnose mit DM-TL Modul" UBYTE dez 1 100 0 255 FORMAT "%5.1" ECU_ADDRESS 0x402851 /end MEASUREMENT
/begin MEASUREMENT etxdvef "Fehlerart-Erweiterungsbyte: Diagnosestatus DV-E Fehler bei Federpr¸fung" UBYTE dez 1 100 0 255 FORMAT "%5.1" ECU_ADDRESS 0x402852 /end MEASUREMENT
/begin MEASUREMENT etxdvefo "Fehlerart-Erweiterungsbyte: Diagnosestatus  DV-E Fehler bei Federpr¸fung ""offen""" UBYTE dez 1 100 0 255 FORMAT "%5.1" ECU_ADDRESS 0x402853 /end MEASUREMENT
/begin MEASUREMENT etxdven "Fehlerart-Erweiterungsbyte: Diagnosestatus  DV-E Fehler bei Pr¸fung Notluftposit" UBYTE dez 1 100 0 255 FORMAT "%5.1" ECU_ADDRESS 0x402854 /end MEASUREMENT
/begin MEASUREMENT etxdveu "Fehlerart-Erweiterungsbyte: Diagnosestatus DV-E Fehler beim UMA-Lernen" UBYTE dez 1 100 0 255 FORMAT "%5.1" ECU_ADDRESS 0x402855 /end MEASUREMENT
/begin MEASUREMENT etxdveuw "Fehlerart-Erweiterungsbyte: Diagnosestatus Fehler bei UMA-Wiederlernen" UBYTE dez 1 100 0 255 FORMAT "%5.1" ECU_ADDRESS 0x402856 /end MEASUREMENT
/begin MEASUREMENT etxdvev "Fehlerart-Erweiterungsbyte: Diagnosestatus DV-E Fehler bei Verst‰rkerabgleich" UBYTE dez 1 100 0 255 FORMAT "%5.1" ECU_ADDRESS 0x402857 /end MEASUREMENT
/begin MEASUREMENT etxfrao "Fehlerart-Erweiterungsbyte: Diagnosestatus LR-Adaption oberer multiplikativer Be" UBYTE dez 1 100 0 255 FORMAT "%5.1" ECU_ADDRESS 0x402858 /end MEASUREMENT
/begin MEASUREMENT etxfrao2 "Fehlerart-Erweiterungsbyte: Diagnosestatus LR-Adaption oberer multiplikativer Be" UBYTE dez 1 100 0 255 FORMAT "%5.1" ECU_ADDRESS 0x402859 /end MEASUREMENT
/begin MEASUREMENT etxfrau "Fehlerart-Erweiterungsbyte: Diagnosestatus  LR-Adaption unterer multiplikativer" UBYTE dez 1 100 0 255 FORMAT "%5.1" ECU_ADDRESS 0x40285A /end MEASUREMENT
/begin MEASUREMENT etxfrau2 "Fehlerart-Erweiterungsbyte: Diagnosestatus LR-Adaption unterer multiplikativer B" UBYTE dez 1 100 0 255 FORMAT "%5.1" ECU_ADDRESS 0x40285B /end MEASUREMENT
/begin MEASUREMENT etxhsh "Fehlerart-Erweiterungsbyte: Diagnosestatus Heizung Lambdasonde hinter Kat" UBYTE dez 1 100 0 255 FORMAT "%5.1" ECU_ADDRESS 0x40285C /end MEASUREMENT
/begin MEASUREMENT etxhsh2 "Fehlerart-Erweiterungsbyte: Diagnosestatus Heizung Lambdasonde h.Kat 2" UBYTE dez 1 100 0 255 FORMAT "%5.1" ECU_ADDRESS 0x40285D /end MEASUREMENT
/begin MEASUREMENT etxhsv "Fehlerart-Erweiterungsbyte: Diagnosestatus Heizung Lambdasonde v.Kat" UBYTE dez 1 100 0 255 FORMAT "%5.1" ECU_ADDRESS 0x40285E /end MEASUREMENT
/begin MEASUREMENT etxhsv2 "Fehlerart-Erweiterungsbyte: Diagnosestatus Heizung Lambdasonde v.Kat 2" UBYTE dez 1 100 0 255 FORMAT "%5.1" ECU_ADDRESS 0x40285F /end MEASUREMENT
/begin MEASUREMENT etxhsvsa "Fehlerart-Erweiterungsbyte: Diagnosestatus Heizung/Kennlinie Lambdasonde v.Kat" UBYTE dez 1 100 0 255 FORMAT "%5.1" ECU_ADDRESS 0x402860 /end MEASUREMENT
/begin MEASUREMENT etxhsvsa2 "Fehlerart-Erweiterungsbyte: Diagnosestatus Heizung/Kennlinie Lambdasonde v.K. 2" UBYTE dez 1 100 0 255 FORMAT "%5.1" ECU_ADDRESS 0x402861 /end MEASUREMENT
/begin MEASUREMENT etxkatsp "" UBYTE dez 1 100 0 255 FORMAT "%5.1" ECU_ADDRESS 0x402862 /end MEASUREMENT
/begin MEASUREMENT etxkatsp2 "" UBYTE dez 1 100 0 255 FORMAT "%5.1" ECU_ADDRESS 0x402863 /end MEASUREMENT
/begin MEASUREMENT etxlash "Fehlerart-Erweiterungsbyte: Diagnosestatus Lambda-Sondenalterung hinter Kat." UBYTE dez 1 100 0 255 FORMAT "%5.1" ECU_ADDRESS 0x402864 /end MEASUREMENT
/begin MEASUREMENT etxlash2 "Fehlerart-Erweiterungsbyte: Diagnosestatus Lambda-Sondenalterung hinter Kat. (Ba" UBYTE dez 1 100 0 255 FORMAT "%5.1" ECU_ADDRESS 0x402865 /end MEASUREMENT
/begin MEASUREMENT etxlsh "Fehlerart-Erweiterungsbyte: Diagnosestatus Lambda-Sonde hinter Kat" UBYTE dez 1 100 0 255 FORMAT "%5.1" ECU_ADDRESS 0x402866 /end MEASUREMENT
/begin MEASUREMENT etxlsh2 "Fehlerart-Erweiterungsbyte: Diagnosestatus Lambda-Sonde hinter Kat Bank 2" UBYTE dez 1 100 0 255 FORMAT "%5.1" ECU_ADDRESS 0x402867 /end MEASUREMENT
/begin MEASUREMENT etxlsv "Fehlerart-Erweiterungsbyte: Diagnosestatus  Lambda-Sonde vor Kat" UBYTE dez 1 100 0 255 FORMAT "%5.1" ECU_ADDRESS 0x402868 /end MEASUREMENT
/begin MEASUREMENT etxlsv2 "Fehlerart-Erweiterungsbyte: Diagnosestatus  Lambda-Sonde vor Kat (Bank 2)" UBYTE dez 1 100 0 255 FORMAT "%5.1" ECU_ADDRESS 0x402869 /end MEASUREMENT
/begin MEASUREMENT etxlsvv "Fehlerart-Erweiterungsbyte: Diagnosestatus Vertauschte Lambda-Sonden vor Kat" UBYTE dez 1 100 0 255 FORMAT "%5.1" ECU_ADDRESS 0x40286A /end MEASUREMENT
/begin MEASUREMENT etxrkat "Fehlerart-Erweiterungsbyte: Diagnosestatus  DKVS (additive Korrektur pro Zeit)" UBYTE dez 1 100 0 255 FORMAT "%5.1" ECU_ADDRESS 0x40286B /end MEASUREMENT
/begin MEASUREMENT etxrkat2 "Fehlerart-Erweiterungsbyte: Diagnosestatus  DKVS (additive Korrektur pro Zeit Ba" UBYTE dez 1 100 0 255 FORMAT "%5.1" ECU_ADDRESS 0x40286C /end MEASUREMENT
/begin MEASUREMENT etxrkaz "Fehlerart-Erweiterungsbyte: Diagnosestatus DKVS (additive Korrektur pro Z¸ndung)" UBYTE dez 1 100 0 255 FORMAT "%5.1" ECU_ADDRESS 0x40286D /end MEASUREMENT
/begin MEASUREMENT etxrkaz2 "Fehlerart-Erweiterungsbyte: Diagnosestatus DKVS (additive Korrektur pro Z¸ndung" UBYTE dez 1 100 0 255 FORMAT "%5.1" ECU_ADDRESS 0x40286E /end MEASUREMENT
/begin MEASUREMENT etxsls "Fehlerart-Erweiterungsbyte: Diagnosestatus Sekund‰rluft-System" UBYTE dez 1 100 0 255 FORMAT "%5.1" ECU_ADDRESS 0x40286F /end MEASUREMENT
/begin MEASUREMENT etxsls2 "Fehlerart-Erweiterungsbyte: Diagnosestatus Sekund‰rluft-System, Bank 2" UBYTE dez 1 100 0 255 FORMAT "%5.1" ECU_ADDRESS 0x402870 /end MEASUREMENT
/begin MEASUREMENT etxslv "Fehlerart-Erweiterungsbyte: Diagnosestatus Sekund‰rluft-Ventil" UBYTE dez 1 100 0 255 FORMAT "%5.1" ECU_ADDRESS 0x402871 /end MEASUREMENT
/begin MEASUREMENT etxslv2 "Fehlerart-Erweiterungsbyte: Diagnosestatus Sekund‰rluft-Ventil, Bank 2" UBYTE dez 1 100 0 255 FORMAT "%5.1" ECU_ADDRESS 0x402872 /end MEASUREMENT
/begin MEASUREMENT etxtes "Fehlerart-Erweiterungsbyte: Diagnosestatus" UBYTE dez 1 100 0 255 FORMAT "%5.1" ECU_ADDRESS 0x402873 /end MEASUREMENT
/begin MEASUREMENT fakttansel "Ansaugluftfaktor E-L¸fterstrom" UWORD fak_ub_b2 1 100 0 1.99219 FORMAT "%8.6" ECU_ADDRESS 0x4031A6 /end MEASUREMENT
/begin MEASUREMENT faktubel "" UWORD fak_ub_b2 1 100 0 1.99219 FORMAT "%8.6" ECU_ADDRESS 0x4031A8 /end MEASUREMENT
/begin MEASUREMENT fcoschk "OSC-Korrekturfaktor des Hauptkats" UBYTE fak_ub_b2 1 100 0 1.99219 FORMAT "%5.3" ECU_ADDRESS 0x3FE077 /end MEASUREMENT
/begin MEASUREMENT fcoschk2 "OSC-Korrekturfaktor des Hauptkats, Bank 2" UBYTE fak_ub_b2 1 100 0 1.99219 FORMAT "%5.3" ECU_ADDRESS 0x3FE078 /end MEASUREMENT
/begin MEASUREMENT fcoschmn_w "Minimum der Korrekturfaktoren OSC Hauptkat von Bank 1 und Bank 2" UWORD fak_uw_b2 1 100 0 1.99997 FORMAT "%8.6" ECU_ADDRESS 0x403E1E /end MEASUREMENT
/begin MEASUREMENT fcosrhk "Rohwert des OSC-Korrekturfaktors Hauptkat aus OSC-Messung" UBYTE fak_ub_b2 1 100 0 1.99219 FORMAT "%5.3" ECU_ADDRESS 0x403B5D /end MEASUREMENT
/begin MEASUREMENT fcosrhk2 "Rohwert des OSC-Korrekturfaktors Hauptkat aus OSC-Messung, Bank 2" UBYTE fak_ub_b2 1 100 0 1.99219 FORMAT "%5.3" ECU_ADDRESS 0x403B5E /end MEASUREMENT
/begin MEASUREMENT fgr_stat "Status Fahrgeschwindigkeitsregler" UBYTE dez 1 100 0 255 FORMAT "%5.1" ECU_ADDRESS 0x4038C1 /end MEASUREMENT
/begin MEASUREMENT fkez "Faktor Korrektur Einspritzzeit zylinderindividuell" UBYTE fak_ub_b2 1 100 0 1.99219 FORMAT "%5.3" ARRAY_SIZE 8 ECU_ADDRESS 0x4038F7 /end MEASUREMENT
/begin MEASUREMENT flamagr "Faktor Lambda‰nderung durch Abgasr¸ckf¸hrung" UBYTE fak_ub_b2 1 100 0 1.99219 FORMAT "%5.3" ECU_ADDRESS 0x403B61 /end MEASUREMENT
/begin MEASUREMENT flamagr2 "Faktor Lambda‰nderung durch Abgasr¸ckf¸hrung, Bank2" UBYTE fak_ub_b2 1 100 0 1.99219 FORMAT "%5.3" ECU_ADDRESS 0x403B62 /end MEASUREMENT
/begin MEASUREMENT flamsls "Faktor Lambda‰nderung durch Sekund‰rluft" UBYTE fak_ub_b2 1 100 0 1.99219 FORMAT "%5.3" ECU_ADDRESS 0x403B63 /end MEASUREMENT
/begin MEASUREMENT flamsls2 "Faktor Lambda‰nderung durch Sekund‰rluft, Bank2" UBYTE fak_ub_b2 1 100 0 1.99219 FORMAT "%5.3" ECU_ADDRESS 0x403B64 /end MEASUREMENT
/begin MEASUREMENT flamslsi "Faktor Lambda‰nderung durch Sekund‰rluft (intern)" UBYTE fak_ub_b2 1 100 0 1.99219 FORMAT "%5.3" ECU_ADDRESS 0x403B65 /end MEASUREMENT
/begin MEASUREMENT fmiacc_w "Faktor rel. zu ind. Moment" UWORD rel_uw_b200 1 100 0 199.997 FORMAT "%8.4" ECU_ADDRESS 0x403ED6 /end MEASUREMENT
/begin MEASUREMENT fprstep_c "Schrittz‰hler DK-R¸ckstellfeder-Pr¸fung" UBYTE dez 1 100 0 255 FORMAT "%5.1" ECU_ADDRESS 0x403B3A /end MEASUREMENT
/begin MEASUREMENT fprtim_c "Zeitz‰hler DK-R¸ckstellfeder-Pr¸fung" UBYTE t10msxs_ub_b2p55 1 100 0 2.55 FORMAT "%5.3" ECU_ADDRESS 0x403B3B /end MEASUREMENT
/begin MEASUREMENT fqepmdn "Faktor Quotient  100 % zu MDNORM" UWORD relmd_q327p68 1 100 0 199.997 FORMAT "%8.4" ECU_ADDRESS 0x404178 /end MEASUREMENT
/begin MEASUREMENT fqmdnep "Faktor Quotient MDNORM zu 100 %" UBYTE mdrel_q0p16 1 100 0 40.8 FORMAT "%5.2" ECU_ADDRESS 0x403CBD /end MEASUREMENT
/begin MEASUREMENT gangctr "tempor‰rer Gangz‰hler" UBYTE dez 1 100 0 255 FORMAT "%5.1" ECU_ADDRESS 0x403BAB /end MEASUREMENT
/begin MEASUREMENT gendfvorhs "DF-Signal Vorhersage" UBYTE PCENT 1 100 0 99.6094 FORMAT "%5.2" ECU_ADDRESS 0x4031C5 /end MEASUREMENT
/begin MEASUREMENT genikaltmp "tempor‰rer Kaltstrom" UBYTE igen_ub_q1 1 100 0 255 FORMAT "%5.1" ECU_ADDRESS 0x4031C6 /end MEASUREMENT
/begin MEASUREMENT genitemp2 "tempor‰rer Warmstrom" UBYTE igen_ub_q1 1 100 0 255 FORMAT "%5.1" ECU_ADDRESS 0x4031C7 /end MEASUREMENT
/begin MEASUREMENT id2ccmsg "ID2 Checkkontrol-Meldung-Standard" UBYTE dez 1 100 0 255 FORMAT "%5.1" ECU_ADDRESS 0x402814 /end MEASUREMENT
/begin MEASUREMENT idcclampe "Identifier der CC-Lampe" UWORD dez 1 100 0 65535 FORMAT "%8.2" ECU_ADDRESS 0x402804 /end MEASUREMENT
/begin MEASUREMENT igenrllrah "Generatorstrom mit Vorlaufreserve" UBYTE igen_ub_q1 1 100 0 254 FORMAT "%5.1" ECU_ADDRESS 0x4031C8 /end MEASUREMENT
/begin MEASUREMENT indexcccyl "rollierender index der zyklischen CC-Meldungen" UBYTE dez 1 100 0 255 FORMAT "%5.1" ECU_ADDRESS 0x402815 /end MEASUREMENT
/begin MEASUREMENT indexmrst "Index der drei zu ¸bertragenden Geschwindigkeitsmarken" UBYTE dez 1 100 0 255 FORMAT "%5.1" ECU_ADDRESS 0x403823 /end MEASUREMENT
/begin MEASUREMENT i_eluefter "" UWORD i_eluft_q0p0625 1 100 0 128 FORMAT "%8.4" ECU_ADDRESS 0x4031AA /end MEASUREMENT
/begin MEASUREMENT i_elupwm "" UWORD i_eluft_q0p0625 1 100 0 64 FORMAT "%8.5" ECU_ADDRESS 0x4031AC /end MEASUREMENT
/begin MEASUREMENT i_eluvfzg "" UWORD i_eluft_q0p0625 1 100 0 128 FORMAT "%8.4" ECU_ADDRESS 0x4031AE /end MEASUREMENT
/begin MEASUREMENT i_elu_vvt "Strom E-L¸fter und VVT-System" UWORD i_vvt_q0p0625 1 100 0 4095.94 FORMAT "%8.3" ECU_ADDRESS 0x4031B0 /end MEASUREMENT
/begin MEASUREMENT i_slp "berechnete Groesse Strombedarf Sekundˆrluftpumpe" UWORD i_eluft_q0p0625 1 100 0 255 FORMAT "%8.4" ECU_ADDRESS 0x4031B2 /end MEASUREMENT
/begin MEASUREMENT kmstmil_w "Zur¸ckgelegte Fahrstrecke mit MIL on" UWORD s_q1_km 1 100 0 65535 FORMAT "%8.2" ECU_ADDRESS 0x3FDED4 /end MEASUREMENT
/begin MEASUREMENT kmst_w "Zur¸ckgelegte Fahrstrecke seit Powerfail" UWORD s_q6_km 1 100 0 393210 FORMAT "%8.1" ECU_ADDRESS 0x3FDED6 /end MEASUREMENT
/begin MEASUREMENT kryptoCounter "" UWORD dez 1 100 0 65535 FORMAT "%8.2" ECU_ADDRESS 0x403062 /end MEASUREMENT
/begin MEASUREMENT kvb_w "verbrauchter Kraftstoff" UWORD vol_q3p90625Em3_l 1 100 0 255.996 FORMAT "%8.4" ECU_ADDRESS 0x402BD0 /end MEASUREMENT
/begin MEASUREMENT lalsuvj2_w "Lambda-Istwert Bank2 f¸r Scan Tool" UWORD fak_uw_b2 1 100 0 1.99997 FORMAT "%8.6" ECU_ADDRESS 0x403E82 /end MEASUREMENT
/begin MEASUREMENT lalsuvj_w "Lambda-Istwert f¸r Scan TOOL" UWORD fak_uw_b2 1 100 0 1.99997 FORMAT "%8.6" ECU_ADDRESS 0x403E84 /end MEASUREMENT
/begin MEASUREMENT lamsonb2_w "Basis-Lambda Istwert Bank2" UWORD fak_uw_b16 1 100 0 15.9998 FORMAT "%8.5" ECU_ADDRESS 0x403E86 /end MEASUREMENT
/begin MEASUREMENT lamsonb_w "Basis-Lambda Istwert" UWORD fak_uw_b16 1 100 0 15.9998 FORMAT "%8.5" ECU_ADDRESS 0x403E88 /end MEASUREMENT
/begin MEASUREMENT lamsoni2_w "Lambda-Istwert Bank2" UWORD fak_uw_b16 1 100 0 15.9998 FORMAT "%8.5" ECU_ADDRESS 0x403E8A /end MEASUREMENT
/begin MEASUREMENT lamsoni_w "Lambda-Istwert" UWORD fak_uw_b16 1 100 0 15.9998 FORMAT "%8.5" ECU_ADDRESS 0x403E8C /end MEASUREMENT
/begin MEASUREMENT lamsonk2_w "Sondenlambda korrigiert um Sonden-Offset, Bank 2" UWORD fak_uw_b16 1 100 0 15.9998 FORMAT "%8.5" ECU_ADDRESS 0x403E20 /end MEASUREMENT
/begin MEASUREMENT lamsonk_w "Sondenlambda korrigiert um Sonden-Offset" UWORD fak_uw_b16 1 100 0 15.9998 FORMAT "%8.5" ECU_ADDRESS 0x403E22 /end MEASUREMENT
/begin MEASUREMENT lanvkm2_w "Lambda hinter Vorkat modelliert, Bank 2" UWORD fak_uw_b16 1 100 0 15.9998 FORMAT "%8.5" ECU_ADDRESS 0x403E24 /end MEASUREMENT
/begin MEASUREMENT lanvkm_w "Lambda hinter Vorkat modelliert" UWORD fak_uw_b16 1 100 0 15.9998 FORMAT "%8.5" ECU_ADDRESS 0x403E26 /end MEASUREMENT
/begin MEASUREMENT lavhkm2_w "Abgaslambda vor Hauptkatalysator, modelliert, Bank2" UWORD fak_uw_b16 1 100 0 15.9998 FORMAT "%8.5" ECU_ADDRESS 0x403E28 /end MEASUREMENT
/begin MEASUREMENT lavhkm_w "Abgaslambda vor Hauptkatalysator, modelliert" UWORD fak_uw_b16 1 100 0 15.9998 FORMAT "%8.5" ECU_ADDRESS 0x403E2A /end MEASUREMENT
/begin MEASUREMENT lavvkm2_w "Lambda vor Vorkat modelliert, bank 2" UWORD fak_uw_b16 1 100 0 15.9998 FORMAT "%8.5" ECU_ADDRESS 0x403E2C /end MEASUREMENT
/begin MEASUREMENT lavvkmm2_w "Lambda vor Vorkat modelliert, langsameres Raster, Bank 2" UWORD fak_uw_b16 1 100 0 15.9998 FORMAT "%8.5" ECU_ADDRESS 0x403E2E /end MEASUREMENT
/begin MEASUREMENT lavvkmm_w "Lambda vor Vorkat modelliert, langsameres Raster" UWORD fak_uw_b16 1 100 0 15.9998 FORMAT "%8.5" ECU_ADDRESS 0x403E30 /end MEASUREMENT
/begin MEASUREMENT lavvkm_w "Lambda vor Vorkat modelliert" UWORD fak_uw_b16 1 100 0 15.9998 FORMAT "%8.5" ECU_ADDRESS 0x403E32 /end MEASUREMENT
/begin MEASUREMENT lrnstat "Statusbyte DV-E-Adaption f¸r Testerkommunikation" UBYTE dez 1 100 0 255 FORMAT "%5.1" ECU_ADDRESS 0x403B3C /end MEASUREMENT
/begin MEASUREMENT lrnstep_c "Z‰hler f¸r Lerndauer eines Lernsteps" UBYTE dez 1 100 0 255 FORMAT "%5.1" ECU_ADDRESS 0x403B3D /end MEASUREMENT
/begin MEASUREMENT lrntim_c "Zeitz‰hler f¸r Wartezeit in den Lernschritten" UBYTE t20msxs_ub_b5p1 1 100 0 5.1 FORMAT "%5.3" ECU_ADDRESS 0x403B3E /end MEASUREMENT
/begin MEASUREMENT lrnvb_c "Lernverbotsz‰hler (Wartezeit)" UWORD t20msxs_uw_q0p02 1 100 0 1310.7 FORMAT "%8.3" ECU_ADDRESS 0x403DDA /end MEASUREMENT
/begin MEASUREMENT mabghks2_w "Abgasmassenstrom [kg/s] im Rohr vor Haupt Kat (Word), Bank 2" UWORD m_q2p777Em5 1 100 0 1.82042 FORMAT "%8.6" ECU_ADDRESS 0x4029D6 /end MEASUREMENT
/begin MEASUREMENT mabghks_w "Abgasmassenstrom [kg/s] im Rohr vor Haupt Kat (Word), Bank 1" UWORD m_q2p777Em5 1 100 0 1.82042 FORMAT "%8.6" ECU_ADDRESS 0x4029D8 /end MEASUREMENT
/begin MEASUREMENT mabikrs2_w "Massenstrom Abgas im Kr¸mmer in kg/s, Bank2" UWORD m_q2p777Em5 1 100 0 1.82042 FORMAT "%8.6" ECU_ADDRESS 0x4029DA /end MEASUREMENT
/begin MEASUREMENT mabikrs_w "Massenstrom Abgas im Kr¸mmer in kg/s" UWORD m_q2p777Em5 1 100 0 1.82042 FORMAT "%8.6" ECU_ADDRESS 0x4029DC /end MEASUREMENT
/begin MEASUREMENT mabnavs2_w "Abgasmassenstr. [kg/s] h. Auslassventilen korrigiert um Kraftstoffanteil, Bank 2" UWORD m_q2p777Em5 1 100 0 1.82042 FORMAT "%8.6" ECU_ADDRESS 0x4029DE /end MEASUREMENT
/begin MEASUREMENT mabnavs_w "Abgasmassenstr. [kg/s] h. Auslassventilen korr. um Kraftstoffanteil, Bank 1" UWORD m_q2p777Em5 1 100 0 1.82042 FORMAT "%8.6" ECU_ADDRESS 0x4029E0 /end MEASUREMENT
/begin MEASUREMENT mabnhks2_w "Massenstrom Abgas nach Hauptkatalysator in kg/s, Bank 2" UWORD m_q2p777Em5 1 100 0 1.82042 FORMAT "%8.6" ECU_ADDRESS 0x4029E2 /end MEASUREMENT
/begin MEASUREMENT mabnhks_w "Massenstrom Abgas nach Hauptkatalysator in kg/s" UWORD m_q2p777Em5 1 100 0 1.82042 FORMAT "%8.6" ECU_ADDRESS 0x4029E4 /end MEASUREMENT
/begin MEASUREMENT mabnvks2_w "Massenstrom Abgas nach Vorkatalysator in kg/s, Bank 2" UWORD m_q2p777Em5 1 100 0 1.82042 FORMAT "%8.6" ECU_ADDRESS 0x4029E6 /end MEASUREMENT
/begin MEASUREMENT mabnvks_w "Massenstrom Abgas nach Vorkatalysator in kg/s" UWORD m_q2p777Em5 1 100 0 1.82042 FORMAT "%8.6" ECU_ADDRESS 0x4029E8 /end MEASUREMENT
/begin MEASUREMENT mabvhks2_w "Massenstrom Abgas vor Hauptkat in kg/s, Bank2" UWORD m_q2p777Em5 1 100 0 1.82042 FORMAT "%8.6" ECU_ADDRESS 0x4029EA /end MEASUREMENT
/begin MEASUREMENT mabvhks_w "Massenstrom Abgas vor Hauptkat in kg/s" UWORD m_q2p777Em5 1 100 0 1.82042 FORMAT "%8.6" ECU_ADDRESS 0x4029EC /end MEASUREMENT
/begin MEASUREMENT mabvvks2_w "Massenstrom Abdas vor Vorkat in kg/s (Bank2)" UWORD m_q2p777Em5 1 100 0 1.82042 FORMAT "%8.6" ECU_ADDRESS 0x4029EE /end MEASUREMENT
/begin MEASUREMENT mabvvks_w "Massenstrom Abgas vor Frontkat in kg/s" UWORD m_q2p777Em5 1 100 0 1.82042 FORMAT "%8.6" ECU_ADDRESS 0x4029F0 /end MEASUREMENT
/begin MEASUREMENT macckupp_w "ACC-Ersatzmoment bei Kupplung" SWORD md_q0p5 1 100 -16384 16383.5 FORMAT "%8.2" ECU_ADDRESS 0x403ED8 /end MEASUREMENT
/begin MEASUREMENT mdindegs_w "indiziertes Motormoment; R¸ckmeldung an Getriebesteuerung" UWORD rel_uw_b100 1 100 0 99.9985 FORMAT "%8.5" ECU_ADDRESS 0x404244 /end MEASUREMENT
/begin MEASUREMENT mdindetc_w "indiziertes Motormoment; R¸ckmeldung ans EGS  (temp. RAM-Zelle f¸r CAN-MD ber.)" UWORD rel_uw_b100 1 100 0 99.9985 FORMAT "%8.5" ECU_ADDRESS 0x40417A /end MEASUREMENT
/begin MEASUREMENT mdindlm_w "indiziertes Motormoment; R¸ckmeldung an ASR" UWORD rel_uw_b100 1 100 0 99.9985 FORMAT "%8.5" ECU_ADDRESS 0x404246 /end MEASUREMENT
/begin MEASUREMENT mdindltc_w "indiziertes Motormoment; R¸ckmeldung ans DSC (temp. RAM-Zelle f¸r CAN-MD ber.)" UWORD rel_uw_b100 1 100 0 99.9985 FORMAT "%8.5" ECU_ADDRESS 0x40417C /end MEASUREMENT
/begin MEASUREMENT mdverltc_w "Motor-Verlustmoment (temp. RAM-Zelle f¸r Ermittlung abs. CAN- Momente)" UWORD rel_uw_b100 1 100 0 99.9985 FORMAT "%8.5" ECU_ADDRESS 0x40417E /end MEASUREMENT
/begin MEASUREMENT mdwancan "Drehmomentaufnahme des Wandlers ¸ber CAN" UBYTE rel_ub_b99p6 1 100 0 99.6094 FORMAT "%5.2" ECU_ADDRESS 0x403BA8 /end MEASUREMENT
/begin MEASUREMENT miacc_w "Momentenanforderung vom ACC, indiziertes Moment" UWORD rel_uw_b100 1 100 0 99.9985 FORMAT "%8.5" ECU_ADDRESS 0x403EDA /end MEASUREMENT
/begin MEASUREMENT miasrl_w "Indiziertes Soll-Motormoment ASR f¸r langsamen Eingriff" UWORD rel_uw_b100 1 100 0 99.9985 FORMAT "%8.5" ECU_ADDRESS 0x403EE0 /end MEASUREMENT
/begin MEASUREMENT miasrsv_w "Indiziertes vorl‰ufiges Soll-Motormoment ASR f¸r schnellen Eingriff" UWORD rel_uw_b100 1 100 0 99.9985 FORMAT "%8.5" ECU_ADDRESS 0x403EE2 /end MEASUREMENT
/begin MEASUREMENT miasrs_w "Indiziertes Soll-Motormoment ASR f¸r schnellen Eingriff" UWORD rel_uw_b100 1 100 0 99.9985 FORMAT "%8.5" ECU_ADDRESS 0x403EE4 /end MEASUREMENT
/begin MEASUREMENT miges_w "Indiziertes Soll-Motormoment f¸r Getriebeschutz" UWORD rel_uw_b100 1 100 0 99.9985 FORMAT "%8.5" ECU_ADDRESS 0x403EE8 /end MEASUREMENT
/begin MEASUREMENT migsl_w "Inneres Soll-Motormoment zur F¸llungsbegrenzung bei GSf" UWORD rel_uw_b100 1 100 0 99.9985 FORMAT "%8.5" ECU_ADDRESS 0x403EEA /end MEASUREMENT
/begin MEASUREMENT migs_w "Indiziertes Soll-Motormoment GS f¸r schnellen Eingriff" UWORD rel_uw_b100 1 100 0 99.9985 FORMAT "%8.5" ECU_ADDRESS 0x403EEC /end MEASUREMENT
/begin MEASUREMENT miint1_w "Berechnetes Ist-Moment;interne Eingriffe mit AR, LLR, MDBEG" UWORD rel_uw_b100 1 100 0 99.9985 FORMAT "%8.5" ECU_ADDRESS 0x404248 /end MEASUREMENT
/begin MEASUREMENT miint2_w "Berechnetes Ist-Moment; Begrenzung auf mizwmn" UWORD rel_uw_b100 1 100 0 99.9985 FORMAT "%8.5" ECU_ADDRESS 0x40424A /end MEASUREMENT
/begin MEASUREMENT miint3_w "Berechnetes Ist-Moment; Begrenzung auf mibas, miszul" UWORD rel_uw_b100 1 100 0 99.9985 FORMAT "%8.5" ECU_ADDRESS 0x40424C /end MEASUREMENT
/begin MEASUREMENT miintegs_w "Berechnetes Ist-Moment Getriebe" UWORD rel_uw_b100 1 100 0 99.9985 FORMAT "%8.5" ECU_ADDRESS 0x40424E /end MEASUREMENT
/begin MEASUREMENT miintv_w "Berechnetes Ist-Moment;interne Eingriffe ohne AR, LLR, MDBEG" UWORD rel_uw_b100 1 100 0 99.9985 FORMAT "%8.5" ECU_ADDRESS 0x404250 /end MEASUREMENT
/begin MEASUREMENT miint_w "Berechnetes Ist-Moment mit allen internen Eingriffen" UWORD rel_uw_b100 1 100 0 99.9985 FORMAT "%8.5" ECU_ADDRESS 0x404252 /end MEASUREMENT
/begin MEASUREMENT miisttc_w "ind. Ist-Motormoment (temp. RAM-Zelle f¸r CAN-MD Berechnung)" UWORD rel_uw_b100 1 100 0 99.9985 FORMAT "%8.5" ECU_ADDRESS 0x404180 /end MEASUREMENT
/begin MEASUREMENT milmxvl_w "gefordertes Moment bezogen auf das maximale Moment aus MDMAX" UWORD rel_uw_b200 1 100 0 199.997 FORMAT "%8.4" ECU_ADDRESS 0x404240 /end MEASUREMENT
/begin MEASUREMENT mimaxtc_w "maximal erreichbares indiziertes Moment f¸r CAN" UWORD rel_uw_b100 1 100 0 99.9985 FORMAT "%8.5" ECU_ADDRESS 0x404182 /end MEASUREMENT
/begin MEASUREMENT mimsr "Indiziertes Soll-Motormoment MSR" UBYTE rel_ub_q0p3906 1 100 0 99.6094 FORMAT "%5.2" ECU_ADDRESS 0x403BA6 /end MEASUREMENT
/begin MEASUREMENT mimsrcpl "Komplement des Indiziertes Soll-Motormoment MSR" UBYTE rel_ub_q0p3906 1 100 0 99.6094 FORMAT "%5.2" ECU_ADDRESS 0x403BA7 /end MEASUREMENT
/begin MEASUREMENT mimsr_w "Indiziertes Soll-Motormoment MSR" UWORD rel_uw_b100 1 100 0 99.9985 FORMAT "%8.5" ECU_ADDRESS 0x403EE6 /end MEASUREMENT
/begin MEASUREMENT misgs "Indiziertes Motormoment SGS" UBYTE rel_ub_b99p6 1 100 0 99.6094 FORMAT "%5.2" ECU_ADDRESS 0x403BA9 /end MEASUREMENT
/begin MEASUREMENT misgscpl "Komplement des Indizierten Motormoments SGS" UBYTE rel_ub_b99p6 1 100 0 99.6094 FORMAT "%5.2" ECU_ADDRESS 0x403BAA /end MEASUREMENT
/begin MEASUREMENT misgsl_w "Inneres Soll-Motormoment luftseitig f¸r Drehzahlsynchr. bei Getriebeschaltung" UWORD rel_uw_b100 1 100 0 99.9985 FORMAT "%8.5" ECU_ADDRESS 0x403EEE /end MEASUREMENT
/begin MEASUREMENT misgs_w "Inneres Soll-Motormoment f¸r Drehzahlsynchronisation bei Getriebeschaltung" UWORD rel_uw_b100 1 100 0 99.9985 FORMAT "%8.5" ECU_ADDRESS 0x403EF0 /end MEASUREMENT
/begin MEASUREMENT mivbegtc_w "Indi. Moment vor ƒ.-Begrenzung (temp. RAM-Zelle f¸r Ermittlung abs. CAN- MD)" UWORD rel_uw_b100 1 100 0 99.9985 FORMAT "%8.5" ECU_ADDRESS 0x404184 /end MEASUREMENT
/begin MEASUREMENT mizwmntc_w "indiziertes Motormoment beim sp‰testen Z¸ndwinkel  f¸r CAN" UWORD rel_uw_b100 1 100 0 99.9985 FORMAT "%8.5" ECU_ADDRESS 0x404186 /end MEASUREMENT
/begin MEASUREMENT mkindegs_w "Kupplungsmotormoment; R¸ckmeldung an EGS" SWORD md_q0p5 1 100 -16384 16383.5 FORMAT "%8.2" ECU_ADDRESS 0x404188 /end MEASUREMENT
/begin MEASUREMENT mkindlm_w "Kupplungsmotormoment; R¸ckmeldung an DSC" SWORD md_q0p5 1 100 -16384 16383.5 FORMAT "%8.2" ECU_ADDRESS 0x40418A /end MEASUREMENT
/begin MEASUREMENT mkist_w "Kupplungsmotormoment Istwert" SWORD md_q0p5 1 100 -16384 16383.5 FORMAT "%8.2" ECU_ADDRESS 0x40418C /end MEASUREMENT
/begin MEASUREMENT mkmax_w "maximal erreichbares Kupplungsmotormoment" SWORD md_q0p5 1 100 -16384 16383.5 FORMAT "%8.2" ECU_ADDRESS 0x40418E /end MEASUREMENT
/begin MEASUREMENT mksaccf_w "Resultierendes Kupplungsmoment ACC Betrieb" SWORD md_q0p5 1 100 -16384 16383.5 FORMAT "%8.2" ECU_ADDRESS 0x403EDC /end MEASUREMENT
/begin MEASUREMENT mkvbeg_w "Fahrerwunschmoment (Kupplung) vor ƒnderungsbegrenzung" SWORD md_q0p5 1 100 -16384 16383.5 FORMAT "%8.2" ECU_ADDRESS 0x404190 /end MEASUREMENT
/begin MEASUREMENT mkverl_w "Verlustmoment" SWORD md_q0p5 1 100 -16384 16383.5 FORMAT "%8.2" ECU_ADDRESS 0x404192 /end MEASUREMENT
/begin MEASUREMENT mkzwmn_w "Kupplungsmotormoment beim sp‰testen Z¸ndwinkel" SWORD md_q0p5 1 100 -16384 16383.5 FORMAT "%8.2" ECU_ADDRESS 0x404194 /end MEASUREMENT
/begin MEASUREMENT mlbb2_w "Luftmassenfluﬂ gefiltert (Word), Bank2 bezogen" UWORD m_uw_b6553p5 1 100 0 6553.5 FORMAT "%8.3" ECU_ADDRESS 0x4029F2 /end MEASUREMENT
/begin MEASUREMENT mlbb_w "Luftmassenfluﬂ gefiltert (Word), Bank1 bezogen" UWORD m_uw_b6553p5 1 100 0 6553.5 FORMAT "%8.3" ECU_ADDRESS 0x4029F4 /end MEASUREMENT
/begin MEASUREMENT mracc_w "Relativer Momentenwunsch von ACC" UWORD rel_uw_b200 1 100 0 199.997 FORMAT "%8.4" ECU_ADDRESS 0x403EDE /end MEASUREMENT
/begin MEASUREMENT mrfabn "aktuelle gewichtete Leistung (f¸r Dauer-Hochlasterkennung)" UBYTE rel_ub_b100 1 100 0 99.6094 FORMAT "%5.2" ECU_ADDRESS 0x402D40 /end MEASUREMENT
/begin MEASUREMENT mrfabnf "Tiefpaﬂ-gefilterte gewichtete Leistung - DauerHochlasterkenung" UBYTE rel_ub_b100 1 100 0 99.6094 FORMAT "%5.2" ECU_ADDRESS 0x402D41 /end MEASUREMENT
/begin MEASUREMENT msabg "Abgasmassenfluﬂ gefiltert, Bank 1" UBYTE m_ub_b1020 1 100 0 1020 FORMAT "%5.0" ECU_ADDRESS 0x402A2A /end MEASUREMENT
/begin MEASUREMENT msabg2 "Abgasmassenfluﬂ gefiltert, Bank 2" UBYTE m_ub_b1020 1 100 0 1020 FORMAT "%5.0" ECU_ADDRESS 0x402A2B /end MEASUREMENT
/begin MEASUREMENT msabg2_w "Abgasmassenfluﬂ gefiltert (Word), Bank 2" UWORD m_uw_b6553p5 1 100 0 6553.5 FORMAT "%8.3" ECU_ADDRESS 0x4029F6 /end MEASUREMENT
/begin MEASUREMENT msabghk2_w "Abgasmassenstrom im Rohr vor Haupt Kat (Word), Bank 2" UWORD m_uw_b6553p5 1 100 0 6553.5 FORMAT "%8.3" ECU_ADDRESS 0x4029F8 /end MEASUREMENT
/begin MEASUREMENT msabghk_w "Abgasmassenstrom im Rohr vor Haupt Kat (Word), Bank 1" UWORD m_uw_b6553p5 1 100 0 6553.5 FORMAT "%8.3" ECU_ADDRESS 0x4029FA /end MEASUREMENT
/begin MEASUREMENT msabgs2_w "Abgasmassenfluﬂ gefiltert in kg/s, Bank2" UWORD m_q2p777Em5 1 100 0 1.82042 FORMAT "%8.6" ECU_ADDRESS 0x4029FC /end MEASUREMENT
/begin MEASUREMENT msabgs_w "Abgasmassenfluﬂ gefiltert in kg/s" UWORD m_q2p777Em5 1 100 0 1.82042 FORMAT "%8.6" ECU_ADDRESS 0x4029FE /end MEASUREMENT
/begin MEASUREMENT msabg_w "Abgasmassenstrom gefiltert (Word), Bank 1" UWORD m_uw_b6553p5 1 100 0 6553.5 FORMAT "%8.3" ECU_ADDRESS 0x402A00 /end MEASUREMENT
/begin MEASUREMENT msabikr2_w "Massenstrom Abgas im Kr¸mmer Bank2" UWORD m_uw_b6553p5 1 100 0 6553.5 FORMAT "%8.3" ECU_ADDRESS 0x402A02 /end MEASUREMENT
/begin MEASUREMENT msabikr_w "Massenstrom Abgas im Kr¸mmer" UWORD m_uw_b6553p5 1 100 0 6553.5 FORMAT "%8.3" ECU_ADDRESS 0x402A04 /end MEASUREMENT
/begin MEASUREMENT msabnav2_w "Abgasmassenstrom hinter Auslassventilen korrigiert um Kraftstoffanteil, Bank 2" UWORD m_uw_b6553p5 1 100 0 6553.5 FORMAT "%8.3" ECU_ADDRESS 0x402A06 /end MEASUREMENT
/begin MEASUREMENT msabnav_w "Abgasmassenstrom hinter Auslassventilen korrigiert um Kraftstoffanteil, Bank 1" UWORD m_uw_b6553p5 1 100 0 6553.5 FORMAT "%8.3" ECU_ADDRESS 0x402A08 /end MEASUREMENT
/begin MEASUREMENT msabnhk2_w "Abgasmassenfluﬂ 2" UWORD m_uw_b6553p5 1 100 0 6553.5 FORMAT "%8.3" ECU_ADDRESS 0x402A0A /end MEASUREMENT
/begin MEASUREMENT msabnhk_w "Abgasmassenfluﬂ" UWORD m_uw_b6553p5 1 100 0 6553.5 FORMAT "%8.3" ECU_ADDRESS 0x402A0C /end MEASUREMENT
/begin MEASUREMENT msabnvk2_w "Massenstrom Abgas nach Vorkatalysator, Bank 2" UWORD m_uw_b6553p5 1 100 0 6553.5 FORMAT "%8.3" ECU_ADDRESS 0x402A0E /end MEASUREMENT
/begin MEASUREMENT msabnvk_w "Massenstrom Abgas nach Vorkatalysator" UWORD m_uw_b6553p5 1 100 0 6553.5 FORMAT "%8.3" ECU_ADDRESS 0x402A10 /end MEASUREMENT
/begin MEASUREMENT msabvhk2_w "Massenstrom Abgas vor Hauptkat Bank 2" UWORD m_uw_b6553p5 1 100 0 6553.5 FORMAT "%8.3" ECU_ADDRESS 0x402A12 /end MEASUREMENT
/begin MEASUREMENT msabvhk_w "Massenstrom Abgas vor Hauptkat" UWORD m_uw_b6553p5 1 100 0 6553.5 FORMAT "%8.3" ECU_ADDRESS 0x402A14 /end MEASUREMENT
/begin MEASUREMENT msabvvk2_w "Massenstrom Abgas vor Vorkat (Bank2)" UWORD m_uw_b6553p5 1 100 0 6553.5 FORMAT "%8.3" ECU_ADDRESS 0x402A16 /end MEASUREMENT
/begin MEASUREMENT msabvvk_w "Massenstrom Abgas vor Frontkat" UWORD m_uw_b6553p5 1 100 0 6553.5 FORMAT "%8.3" ECU_ADDRESS 0x402A18 /end MEASUREMENT
/begin MEASUREMENT msaovhk2_w "Massenstrom Abgas ohne Kraftstoffanteil vor Hauptkatalysator, Bank 2" UWORD m_uw_b6553p5 1 100 0 6553.5 FORMAT "%8.3" ECU_ADDRESS 0x402A1A /end MEASUREMENT
/begin MEASUREMENT msaovhk_w "Massenstrom Abgas ohne Kraftstoffanteil vor Hauptkatalysator" UWORD m_uw_b6553p5 1 100 0 6553.5 FORMAT "%8.3" ECU_ADDRESS 0x402A1C /end MEASUREMENT
/begin MEASUREMENT msaovvk2_w "Massenstrom Abgas ohne Kraftstoffanteil vor Vorkat, Bank 2" UWORD m_uw_b6553p5 1 100 0 6553.5 FORMAT "%8.3" ECU_ADDRESS 0x402A1E /end MEASUREMENT
/begin MEASUREMENT msaovvk_w "Massenstrom Abgas ohne Kraftstoffanteil vor Vorkat" UWORD m_uw_b6553p5 1 100 0 6553.5 FORMAT "%8.3" ECU_ADDRESS 0x402A20 /end MEASUREMENT
/begin MEASUREMENT mskgb2_w "Kraftstoff Massenstrom, Bank 2" UWORD m_uw_b6553p5 1 100 0 6553.5 FORMAT "%8.3" ECU_ADDRESS 0x402A22 /end MEASUREMENT
/begin MEASUREMENT mskgb_w "Kraftstoff Massenstrom, Bank 1" UWORD m_uw_b6553p5 1 100 0 6553.5 FORMAT "%8.3" ECU_ADDRESS 0x402A24 /end MEASUREMENT
/begin MEASUREMENT ngsllm "Generatorleerlaufdrehzahl" UWORD ngen_uw_q0p5 1 100 0 32767.5 FORMAT "%8.2" ECU_ADDRESS 0x4031C2 /end MEASUREMENT
/begin MEASUREMENT nlp1tim "Zeitz‰hler f¸r Wartezeit 1 im NLP-Lernen" UBYTE t10msxs_ub_b2p55 1 100 0 2.55 FORMAT "%5.3" ECU_ADDRESS 0x403B3F /end MEASUREMENT
/begin MEASUREMENT nsa "Drehzahl Schub" UBYTE nmot_ub_q40 1 100 0 10200 FORMAT "%5.0" ECU_ADDRESS 0x403C99 /end MEASUREMENT
/begin MEASUREMENT nwarnor "Begin Drehzahlmesser Orangefeld" UWORD nmot_uw_q0p25 1 100 0 16383.8 FORMAT "%8.2" ECU_ADDRESS 0x402BBE /end MEASUREMENT
/begin MEASUREMENT nwarnrt "Begin Drehzahlmesser Rotfeld" UWORD nmot_uw_q0p25 1 100 0 16383.8 FORMAT "%8.2" ECU_ADDRESS 0x402BC0 /end MEASUREMENT
/begin MEASUREMENT nwe "Wiedereinsetzdrehzahl" UBYTE nmot_ub_q40 1 100 0 10200 FORMAT "%5.0" ECU_ADDRESS 0x403C9A /end MEASUREMENT
/begin MEASUREMENT nwem_out "Ausgangsgrˆﬂe von NWEM" UBYTE nmot_ub_q40 1 100 0 10200 FORMAT "%5.0" ECU_ADDRESS 0x403C9B /end MEASUREMENT
/begin MEASUREMENT n_idlgspec "Drehzahl Leerlaufvorgabe (Anforderung Leerlauf-Solldrehzahl-Anhebung)" UBYTE dez 1 100 0 255 FORMAT "%5.1" ECU_ADDRESS 0x4031C9 /end MEASUREMENT
/begin MEASUREMENT oigoxhk2_w "Obere Grenze Sauerstoffintegrator Hauptkatalysator, Bank 2" SWORD m_q0p1_mg 1 100 -3276.8 3276.7 FORMAT "%8.3" ECU_ADDRESS 0x403E34 /end MEASUREMENT
/begin MEASUREMENT oigoxhk_w "Obere Grenze Sauerstoffintegrator Hauptkat" SWORD m_q0p1_mg 1 100 -3276.8 3276.7 FORMAT "%8.3" ECU_ADDRESS 0x403E36 /end MEASUREMENT
/begin MEASUREMENT oscfkm_w "Sauerstoff-Speicherf‰higkeit Vorkat modelliert" UWORD m_q0p1_mg 1 100 0 6553.5 FORMAT "%8.3" ECU_ADDRESS 0x403E38 /end MEASUREMENT
/begin MEASUREMENT oschkm2_w "Sauerstoff-Speicherf‰higkeit Hauptkat modelliert, Bank 2" UWORD m_q0p1_mg 1 100 0 6553.5 FORMAT "%8.3" ECU_ADDRESS 0x403E3A /end MEASUREMENT
/begin MEASUREMENT oschkm_w "Sauerstoff-Speicherf‰higkeit Hauptkat modelliert" UWORD m_q0p1_mg 1 100 0 6553.5 FORMAT "%8.3" ECU_ADDRESS 0x403E3C /end MEASUREMENT
/begin MEASUREMENT oschme2_w "Gemessene Sauerstoff-Speicherkapazit‰t des Hauptkatalysator, Bank 2" UWORD m_q0p1_mg 1 100 0 6553.5 FORMAT "%8.3" ECU_ADDRESS 0x403E3E /end MEASUREMENT
/begin MEASUREMENT oschme_w "Gemessene Sauerstoff-Speicherkapazit‰t des Hauptkats" UWORD m_q0p1_mg 1 100 0 6553.5 FORMAT "%8.3" ECU_ADDRESS 0x403E40 /end MEASUREMENT
/begin MEASUREMENT oschn2_w "Sauerstoffspeicherf‰higkeit eines neuen Hauptkatalysators bei gleichem BP, B. 2" UWORD m_q0p1_mg 1 100 0 6553.5 FORMAT "%8.3" ECU_ADDRESS 0x4029D2 /end MEASUREMENT
/begin MEASUREMENT oschn_w "Sauerstoffspeicherf‰higkeit eines neuen Hauptkatalysators bei gleichem BP" UWORD m_q0p1_mg 1 100 0 6553.5 FORMAT "%8.3" ECU_ADDRESS 0x4029D4 /end MEASUREMENT
/begin MEASUREMENT oscmnhk2_w "Gemessene untere Grenze f¸r Sauerstoff-Speicherkapazit‰t des Hauptkats, Bank 2" UWORD m_q0p1_mg 1 100 0 6553.5 FORMAT "%8.3" ECU_ADDRESS 0x403E42 /end MEASUREMENT
/begin MEASUREMENT oscmnhk_w "Gemessene untere Grenze f¸r Sauerstoff-Speicherkapazit‰t des Hauptkats" UWORD m_q0p1_mg 1 100 0 6553.5 FORMAT "%8.3" ECU_ADDRESS 0x403E44 /end MEASUREMENT
/begin MEASUREMENT oxhkini2_w "Initialisierungswert f¸r Sauerstoffspeicher Hauptkat, Bank 2" SWORD m_q0p1_mg 1 100 -3276.8 3276.7 FORMAT "%8.3" ECU_ADDRESS 0x403E46 /end MEASUREMENT
/begin MEASUREMENT oxhkini_w "Initialisierungswert f¸r Sauerstoffspeicher Hauptkat" SWORD m_q0p1_mg 1 100 -3276.8 3276.7 FORMAT "%8.3" ECU_ADDRESS 0x403E48 /end MEASUREMENT
/begin MEASUREMENT oxinhk2_w "Sauerstoffmassenfluss in Hauptkatalysator, Bank 2" SWORD m_q0p1_mgs 1 100 -3276.8 3276.7 FORMAT "%8.3" ECU_ADDRESS 0x403E4A /end MEASUREMENT
/begin MEASUREMENT oxinhk_w "Sauerstoffmassenfluss in Hauptkat" SWORD m_q0p1_mgs 1 100 -3276.8 3276.7 FORMAT "%8.3" ECU_ADDRESS 0x403E4C /end MEASUREMENT
/begin MEASUREMENT oxplhk2_w "Sauerstoff-Integral f¸r die Plausibilit‰tspr¸fung Sonde hinter Hauptkat, B. 2" SWORD m_q0p1_mg 1 100 -3276.8 3276.7 FORMAT "%8.3" ECU_ADDRESS 0x403E4E /end MEASUREMENT
/begin MEASUREMENT oxplhk_w "Sauerstoff-Integral f¸r die Plausibilit‰tspr¸fung der Sonde hinter Hauptkat" SWORD m_q0p1_mg 1 100 -3276.8 3276.7 FORMAT "%8.3" ECU_ADDRESS 0x403E50 /end MEASUREMENT
/begin MEASUREMENT oxszahk2_w "Sauerstoff-Integral f¸r OSC-Messung Hauptkatalysator, Bank 2" SWORD m_q0p1_mg 1 100 -3276.8 3276.7 FORMAT "%8.3" ECU_ADDRESS 0x403E52 /end MEASUREMENT
/begin MEASUREMENT oxszahk_w "Sauerstoff-Integral f¸r OSC-Messung Hauptkatalysator" SWORD m_q0p1_mg 1 100 -3276.8 3276.7 FORMAT "%8.3" ECU_ADDRESS 0x403E54 /end MEASUREMENT
/begin MEASUREMENT oxszhk2_w "Sauerstoff-Speicherstand im Hauptkat, zentriert, Bank 2" SWORD m_q0p1_mg 1 100 -3276.8 3276.7 FORMAT "%8.3" ECU_ADDRESS 0x403E56 /end MEASUREMENT
/begin MEASUREMENT oxszhk_w "Sauerstoff-Speicherstand im Hauptkat, zentriert" SWORD m_q0p1_mg 1 100 -3276.8 3276.7 FORMAT "%8.3" ECU_ADDRESS 0x403E58 /end MEASUREMENT
/begin MEASUREMENT oxysthk2_w "Sauerstoff-Speicherstand im Hauptkat, Bank 2" UWORD m_q0p1_mg 1 100 0 6553.5 FORMAT "%8.3" ECU_ADDRESS 0x403E5A /end MEASUREMENT
/begin MEASUREMENT oxysthk_w "Sauerstoff-Speicherstand im Hauptkat" UWORD m_q0p1_mg 1 100 0 6553.5 FORMAT "%8.3" ECU_ADDRESS 0x403E5C /end MEASUREMENT
/begin MEASUREMENT redbas "Basis-Reduzierstufe" UBYTE dez 1 100 0 255 FORMAT "%5.1" ECU_ADDRESS 0x403BC9 /end MEASUREMENT
/begin MEASUREMENT redist "Ist-Reduzierstufe" UBYTE dez 1 100 0 255 FORMAT "%5.1" ECU_ADDRESS 0x403BCA /end MEASUREMENT
/begin MEASUREMENT redistb1 "Ist-Reduzierstufe Bank 1" UBYTE dez 1 100 0 255 FORMAT "%5.1" ECU_ADDRESS 0x403BCB /end MEASUREMENT
/begin MEASUREMENT redistb2 "Ist-Reduzierstufe Bank 2" UBYTE dez 1 100 0 255 FORMAT "%5.1" ECU_ADDRESS 0x403BCC /end MEASUREMENT
/begin MEASUREMENT rlvwvugd_w "geforderter Luftvolumenstrom bezogen auf maximalen Volumenstrom" UWORD rel_uw_b200 1 100 0 199.997 FORMAT "%8.4" ECU_ADDRESS 0x404242 /end MEASUREMENT
/begin MEASUREMENT rolhk2_w "Relativer Sauerstoff-F¸llstand im Hauptkat, Bank 2" UWORD fak_uw_b2 1 100 0 1.99997 FORMAT "%8.6" ECU_ADDRESS 0x403E5E /end MEASUREMENT
/begin MEASUREMENT rolhkdl2_w "Relativer Sauerstoff-F¸llstand im Hauptkat, totzeitverzˆgert, Bank 2" UWORD fak_uw_b2 1 100 0 1.99997 FORMAT "%8.6" ECU_ADDRESS 0x403E60 /end MEASUREMENT
/begin MEASUREMENT rolhkdl_w "Relativer Sauerstoff-F¸llstand im Hauptkat, totzeitverzˆgert" UWORD fak_uw_b2 1 100 0 1.99997 FORMAT "%8.6" ECU_ADDRESS 0x403E62 /end MEASUREMENT
/begin MEASUREMENT rolhk_w "Relativer Sauerstoff-F¸llstand im Hauptkat" UWORD fak_uw_b2 1 100 0 1.99997 FORMAT "%8.6" ECU_ADDRESS 0x403E64 /end MEASUREMENT
/begin MEASUREMENT rschme2_w "Gemessene Sauerstoff-Speicherkapazit‰t des Hauptkatalysators, Bank 2" UWORD m_q0p1_mg 1 100 0 6553.5 FORMAT "%8.3" ECU_ADDRESS 0x403E66 /end MEASUREMENT
/begin MEASUREMENT rschme_w "Gemessene Sauerstoff-Speicherkapazit‰t des Hauptkatalysators" UWORD m_q0p1_mg 1 100 0 6553.5 FORMAT "%8.3" ECU_ADDRESS 0x403E68 /end MEASUREMENT
/begin MEASUREMENT rscmnhk2_w "Gemessene untere Grenze Sauerstoff-Speicherkapazit‰t Hauptkat, mager-fett, B. 2" UWORD m_q0p1_mg 1 100 0 6553.5 FORMAT "%8.3" ECU_ADDRESS 0x403E6A /end MEASUREMENT
/begin MEASUREMENT rscmnhk_w "Gemessene untere Grenze Sauerstoff-Speicherkapazit‰t Hauptkat, mager-fett" UWORD m_q0p1_mg 1 100 0 6553.5 FORMAT "%8.3" ECU_ADDRESS 0x403E6C /end MEASUREMENT
/begin MEASUREMENT sdcosch "OSC-abh‰ngiger Skalierungsfaktor Sauerstoff-Speicher-Korrektur Hauptkat" UBYTE fak_ub_b2 1 100 0 1.99219 FORMAT "%5.3" ECU_ADDRESS 0x403B5F /end MEASUREMENT
/begin MEASUREMENT sdcosch2 "OSC-abh‰ngiger Skalierungsfaktor Sauerstoff-Speicher-Korrektur Hauptkat, Bank 2" UBYTE fak_ub_b2 1 100 0 1.99219 FORMAT "%5.3" ECU_ADDRESS 0x403B60 /end MEASUREMENT
/begin MEASUREMENT sdcoxhk2_w "Skalierungsfaktor Sauerstoff-Speicher-Korrektur Hauptkat, Bank 2" UWORD fak_uw_b4 1 100 0 3.99994 FORMAT "%8.6" ECU_ADDRESS 0x403E6E /end MEASUREMENT
/begin MEASUREMENT sdcoxhk_w "Skalierungsfaktor Sauerstoff-Speicher-Korrektur Hauptkat" UWORD fak_uw_b4 1 100 0 3.99994 FORMAT "%8.6" ECU_ADDRESS 0x403E70 /end MEASUREMENT
/begin MEASUREMENT sgsmdt_w "Inhalt des SGS_Plausibilit‰tstopfes" SWORD md_q0p5 1 100 -16384 16383.5 FORMAT "%8.2" ECU_ADDRESS 0x403EF2 /end MEASUREMENT
/begin MEASUREMENT stat_md_e "CAN-Signal: Status Momenteneingriff" UBYTE dez 1 100 0 255 FORMAT "%5.1" ECU_ADDRESS 0x4038C2 /end MEASUREMENT
/begin MEASUREMENT stdmeacc "Status Fehlerr¸ckmeldung DME an ACC-SG" UBYTE DEZ 1 100 0 255 FORMAT "%5.1" ECU_ADDRESS 0x402816 /end MEASUREMENT
/begin MEASUREMENT stdmears "Status Fehlerr¸ckmeldung DME an ARS-SG" UBYTE DEZ 1 100 0 255 FORMAT "%5.1" ECU_ADDRESS 0x402817 /end MEASUREMENT
/begin MEASUREMENT stdmedsc "Status Fehlerr¸ckmeldung DME an DSC-SG" UBYTE DEZ 1 100 0 255 FORMAT "%5.1" ECU_ADDRESS 0x402818 /end MEASUREMENT
/begin MEASUREMENT stdmeegs "Status Fehlerr¸ckmeldung DME an EGS-SG" UBYTE DEZ 1 100 0 255 FORMAT "%5.1" ECU_ADDRESS 0x402819 /end MEASUREMENT
/begin MEASUREMENT sttdnvvaus "" UBYTE dez 1 100 0 255 FORMAT "%5.1" ECU_ADDRESS 0x403BAC /end MEASUREMENT
/begin MEASUREMENT sttdnvvein "" UBYTE dez 1 100 0 255 FORMAT "%5.1" ECU_ADDRESS 0x403BAD /end MEASUREMENT
/begin MEASUREMENT sttmotkalt "status des Drehzahlvorwarnfeldes (Anzahl Segmente aktiv)" UBYTE dez 1 100 0 255 FORMAT "%5.1" ECU_ADDRESS 0x402BC3 /end MEASUREMENT
/begin MEASUREMENT st_craweng "Strombedarf Motor" UBYTE igen_ub_q1 1 100 0 254 FORMAT "%5.1" ECU_ADDRESS 0x4031C0 /end MEASUREMENT
/begin MEASUREMENT taml_tmp "Tastverh‰ltnis E-L¸fter (TMP)" UWORD rel_ub_b100 1 100 0 100 FORMAT "%8.4" ECU_ADDRESS 0x4031B4 /end MEASUREMENT
/begin MEASUREMENT tans_tmp "Ansaugtemperatur (TMP)" UWORD temp_ub_q0p75_o48 1 100 -48 143.25 FORMAT "%8.4" ECU_ADDRESS 0x4031B6 /end MEASUREMENT
/begin MEASUREMENT tdknach_w "Zeitz‰hler im Nachlauf bis stromlose DK in NLP einschwingt" UWORD t10msxs_uw_b655p35 1 100 0 655.35 FORMAT "%8.4" ECU_ADDRESS 0x403DDC /end MEASUREMENT
/begin MEASUREMENT tephc "Phasenz‰hler Grundadaption / Tankentl¸ftung" UWORD t100msxs_uw_b6553p6 1 100 0 6553.5 FORMAT "%8.3" ECU_ADDRESS 0x402D44 /end MEASUREMENT
/begin MEASUREMENT tKl15OnCtr "" UWORD t10msxs_uw_b655p35 1 100 0 655.35 FORMAT "%8.4" ECU_ADDRESS 0x40482E /end MEASUREMENT
/begin MEASUREMENT tloop_w "Ringz‰hler f¸r Zeitdifferenzmessungen" UWORD t50msxs_q0p05 1 100 0 3276.75 FORMAT "%8.3" ECU_ADDRESS 0x403DDE /end MEASUREMENT
/begin MEASUREMENT tmottol "Motor-÷l bzw. Wasser Temperatur" UBYTE temp_ub_q0p75_o48 1 100 -48 143.25 FORMAT "%5.1" ECU_ADDRESS 0x402BC4 /end MEASUREMENT
/begin MEASUREMENT tmpumast "Status f¸r tempor‰re UMA-Adaption" UBYTE dez 1 100 0 255 FORMAT "%5.1" ECU_ADDRESS 0x403B40 /end MEASUREMENT
/begin MEASUREMENT tnomgs60ms "Zeit in der keine CAN-Botschaft G_T versendet wurde" UBYTE t20msxs_ub_b5p1 1 100 0 5.1 FORMAT "%5.3" ECU_ADDRESS 0x403824 /end MEASUREMENT
/begin MEASUREMENT tnse_w "Zeitz‰hler ab Startende (16bit)" UWORD t100msxs_uw_b6553p5 1 100 0 6553.5 FORMAT "%8.3" ECU_ADDRESS 0x402BB8 /end MEASUREMENT
/begin MEASUREMENT tnst_w "Zeit nach Startende" UWORD t10msxs_uw_b655p35 1 100 0 655.35 FORMAT "%8.4" ECU_ADDRESS 0x403ED4 /end MEASUREMENT
/begin MEASUREMENT tnvkvhk2_w "Abgaslaufzeit von Vorkatalysator bis Hauptkatalysator, Bank 2" UWORD t20msxs_uw_b1310 1 100 0 1310.7 FORMAT "%8.3" ECU_ADDRESS 0x403E72 /end MEASUREMENT
/begin MEASUREMENT tnvkvhk_w "Abgaslaufzeit von Vorkatalysator bis Hauptkatalysator" UWORD t20msxs_uw_b1310 1 100 0 1310.7 FORMAT "%8.3" ECU_ADDRESS 0x403E74 /end MEASUREMENT
/begin MEASUREMENT ttmumad_w "Zeitdifferenz f¸r temor‰re UMA-Adaption" UWORD t50msxs_q0p05 1 100 0 3276.75 FORMAT "%8.3" ECU_ADDRESS 0x403DE0 /end MEASUREMENT
/begin MEASUREMENT ttrhk2_w "Abgaslaufzeit durch Hauptkatalysator, Bank 2" UWORD t20msxs_uw_b1310 1 100 0 1310.7 FORMAT "%8.3" ECU_ADDRESS 0x403E76 /end MEASUREMENT
/begin MEASUREMENT ttrhk_w "Abgaslaufzeit durch Hauptkatalysator" UWORD t20msxs_uw_b1310 1 100 0 1310.7 FORMAT "%8.3" ECU_ADDRESS 0x403E78 /end MEASUREMENT
/begin MEASUREMENT ub_tmp "Batteriespannung (TMP)" UWORD spg_ubatt 1 100 0 24.021 FORMAT "%8.5" ECU_ADDRESS 0x4031B8 /end MEASUREMENT
/begin MEASUREMENT udknlp1 "Spannung DK-Poti 1 im NLP" UWORD spg_uw_q0p001222 1 100 0 79.9988 FORMAT "%8.5" ECU_ADDRESS 0x403DE2 /end MEASUREMENT
/begin MEASUREMENT udknlp1r "Dauer-RAM: Spannung DK-Poti 1 im NLP" UWORD spg_uw_q0p001222 1 100 0 79.9988 FORMAT "%8.5" ECU_ADDRESS 0x3FE904 /end MEASUREMENT
/begin MEASUREMENT udknlp2 "Spannung DK-Poti 2 im NLP" UWORD spg_uw_q0p001222 1 100 0 79.9988 FORMAT "%8.5" ECU_ADDRESS 0x403DE4 /end MEASUREMENT
/begin MEASUREMENT udknlp2r "Dauer-RAM: Spannung DK-Poti 2 im NLP" UWORD spg_uw_q0p001222 1 100 0 79.9988 FORMAT "%8.5" ECU_ADDRESS 0x3FE906 /end MEASUREMENT
/begin MEASUREMENT udkp1a "Spannung Drosselklappen-Poti 1 am (unteren) Anschlag" UBYTE spg_ub_b5 1 100 0 4.98047 FORMAT "%5.3" ECU_ADDRESS 0x403B41 /end MEASUREMENT
/begin MEASUREMENT udkp1aalt "temp. Spannung DK-Poti 1 am unteren DK-Anschlag" UWORD spg_uw_q0p001222 1 100 0 79.9988 FORMAT "%8.5" ECU_ADDRESS 0x403DE6 /end MEASUREMENT
/begin MEASUREMENT udkp1asr_w "Dauer-RAM: Spannung DK-Poti 1 am unteren DK-Anschlag, station‰rer Anteil" UWORD spg_uw_q0p001222 1 100 0 79.9988 FORMAT "%8.5" ECU_ADDRESS 0x3FE908 /end MEASUREMENT
/begin MEASUREMENT udkp1as_w "Spannung DK-Poti 1 am unteren Anschlag, station‰rer Anteil" UWORD spg_uw_q0p001222 1 100 0 79.9988 FORMAT "%8.5" ECU_ADDRESS 0x403DE8 /end MEASUREMENT
/begin MEASUREMENT udkp1a_w "Spannung DK-Poti 1 am unteren Anschlag" UWORD spg_uw_q0p001222 1 100 0 79.9988 FORMAT "%8.5" ECU_ADDRESS 0x403DEA /end MEASUREMENT
/begin MEASUREMENT udkp1rob "realer DK-Poti-1-Wert am ob. Abgleichpkt." UWORD spg_uw_q0p00488 1 100 0 319.995 FORMAT "%8.4" ECU_ADDRESS 0x403DEC /end MEASUREMENT
/begin MEASUREMENT udkp1run "realer DK-Poti-1-Wert am unt. Abgleichpkt." UWORD spg_uw_q0p00488 1 100 0 319.995 FORMAT "%8.4" ECU_ADDRESS 0x403DEE /end MEASUREMENT
/begin MEASUREMENT udkp1sv "Maximalwert DK-Poti 1 f¸r Verwendung des verst‰rkten Signals" UBYTE spg_ub_b5 1 100 0 4.98047 FORMAT "%5.3" ECU_ADDRESS 0x403B42 /end MEASUREMENT
/begin MEASUREMENT udkp1vor "Dauer-RAM: Spannungsoffset bei DK-Poti-1-Verst‰rkung" SWORD spg_sw_q0p001222 1 100 -40.0425 40.0413 FORMAT "%8.5" ECU_ADDRESS 0x3FE90A /end MEASUREMENT
/begin MEASUREMENT udkp1vou "Diagnose: 8 Bit Kopie von udkp1vo_w als Umweltgrˆﬂe" SBYTE spg_q0p00977 1 100 -1.25 1.24023 FORMAT "%5.3" ECU_ADDRESS 0x40298A /end MEASUREMENT
/begin MEASUREMENT udkp1vo_w "Spannungsoffset Verst‰rker DK-Poti 1" SWORD spg_sw_q0p001222 1 100 -40.0425 40.0413 FORMAT "%8.5" ECU_ADDRESS 0x403DF0 /end MEASUREMENT
/begin MEASUREMENT udkp1vrob "realer verst‰rkter DK-Poti-1-Wert am ob. Abgleichpkt." UWORD spg_uw_q0p00488 1 100 0 319.995 FORMAT "%8.4" ECU_ADDRESS 0x403DF2 /end MEASUREMENT
/begin MEASUREMENT udkp1vrun "realer verst‰rkter DK-Poti-1-Wert am unt. Abgleichpkt." UWORD spg_uw_q0p00488 1 100 0 319.995 FORMAT "%8.4" ECU_ADDRESS 0x403DF4 /end MEASUREMENT
/begin MEASUREMENT udkp1vv "Diagnose: 8 Bit Kopie von udkp1vv_w als Umweltgrˆﬂe" UBYTE spg_q0p03125 1 100 0 7.96875 FORMAT "%5.3" ECU_ADDRESS 0x40298B /end MEASUREMENT
/begin MEASUREMENT udkp1vvr "Dauer-RAM: Verst‰rkung bei DK-Poti-1-Verst‰rkung" UWORD fak_q0p0039 1 100 0 255.996 FORMAT "%8.4" ECU_ADDRESS 0x3FE90C /end MEASUREMENT
/begin MEASUREMENT udkp1vv_w "Verst‰rkung DK-Poti 1" UWORD fak_q0p0039 1 100 0 255.996 FORMAT "%8.4" ECU_ADDRESS 0x403DF6 /end MEASUREMENT
/begin MEASUREMENT udkp2a "Spannung Drosselklappen-Poti 2 am (unteren) Anschlag" UBYTE spg_ub_b5 1 100 0 4.98047 FORMAT "%5.3" ECU_ADDRESS 0x403B43 /end MEASUREMENT
/begin MEASUREMENT udkp2aalt "temp. Spannung DK-Poti 2 am unteren DK-Anschlag" UWORD spg_uw_q0p001222 1 100 0 79.9988 FORMAT "%8.5" ECU_ADDRESS 0x403DF8 /end MEASUREMENT
/begin MEASUREMENT udkp2asr_w "Dauer-RAM: Spannung DK-Poti 2 am unteren DK-Anschlag, station‰rer Anteil" UWORD spg_uw_q0p001222 1 100 0 79.9988 FORMAT "%8.5" ECU_ADDRESS 0x3FE90E /end MEASUREMENT
/begin MEASUREMENT udkp2as_w "Spannung DK-Poti 2 am unteren Anschlag, station‰rer Anteil" UWORD spg_uw_q0p001222 1 100 0 79.9988 FORMAT "%8.5" ECU_ADDRESS 0x3FE910 /end MEASUREMENT
/begin MEASUREMENT udkp2a_w "Spannung DK-Poti 2 am unteren Anschlag" UWORD spg_uw_q0p001222 1 100 0 79.9988 FORMAT "%8.5" ECU_ADDRESS 0x403DFA /end MEASUREMENT
/begin MEASUREMENT udkpat_w "tempor‰rer UEA-Offset des DK-Poti" UWORD spg_uw_q0p001222 1 100 0 79.9988 FORMAT "%8.5" ECU_ADDRESS 0x403DFC /end MEASUREMENT
/begin MEASUREMENT ufgentmp2 "tempor‰rer Generatorspannungsollwert" UBYTE spg_ugen 1 100 10.6 36.1 FORMAT "%5.2" ECU_ADDRESS 0x4031CA /end MEASUREMENT
/begin MEASUREMENT uigoxhk2_w "Untere Grenze Sauerstoffintegrator Hauptkatalysator, Bank 2" SWORD m_q0p1_mg 1 100 -3276.8 3276.7 FORMAT "%8.3" ECU_ADDRESS 0x403E7A /end MEASUREMENT
/begin MEASUREMENT uigoxhk_w "Untere Grenze Sauerstoffintegrator Hauptkat" SWORD m_q0p1_mg 1 100 -3276.8 3276.7 FORMAT "%8.3" ECU_ADDRESS 0x403E7C /end MEASUREMENT
/begin MEASUREMENT verhmsb2_w "durch Anz. der Zylinder bestimmter Aufteilungsfaktor der Massenstrˆme f¸r Bank 1" UWORD fak_uw_b2 1 100 0 1 FORMAT "%8.6" ECU_ADDRESS 0x402A26 /end MEASUREMENT
/begin MEASUREMENT verhmsb_w "durch Anz. der Zylinder bestimmter Aufteilungsfaktor der Massenstrˆme f¸r Bank 1" UWORD fak_uw_b2 1 100 0 1 FORMAT "%8.6" ECU_ADDRESS 0x402A28 /end MEASUREMENT
/begin MEASUREMENT vfzg_tmp "Fahrzeuggeschwindigkeit (TMP)" UWORD vfzg_ub_q1p25 1 100 0 318.75 FORMAT "%8.4" ECU_ADDRESS 0x4031BA /end MEASUREMENT
/begin MEASUREMENT vmrki1_w "Geschwindigkeit Marker Index 1" UWORD vfzg_uw_b512 1 100 0 511.992 FORMAT "%8.4" ECU_ADDRESS 0x404374 /end MEASUREMENT
/begin MEASUREMENT vmrki2_w "Geschwindigkeit Marker Index 2" UWORD vfzg_uw_b512 1 100 0 511.992 FORMAT "%8.4" ECU_ADDRESS 0x404376 /end MEASUREMENT
/begin MEASUREMENT vmrki3_w "Geschwindigkeit Marker Index 3" UWORD vfzg_uw_b512 1 100 0 511.992 FORMAT "%8.4" ECU_ADDRESS 0x404378 /end MEASUREMENT
/begin MEASUREMENT vsabvhk2_w "Abgasvolumenstrom vor Hauptkatalysator, Bank 2" UWORD vs_q6p1 1 100 0 399994 FORMAT "%8.1" ECU_ADDRESS 0x403E7E /end MEASUREMENT
/begin MEASUREMENT vsabvhk_w "Abgasvolumenstrom vor Vorkatalysator" UWORD vs_q6p1 1 100 0 399994 FORMAT "%8.1" ECU_ADDRESS 0x403E80 /end MEASUREMENT
/begin MEASUREMENT vsks_w "Volumenstrom Kraftstoff in L/s" UWORD vol_q5p96Em8_l 1 100 0 0.00390619 FORMAT "%11.9" ECU_ADDRESS 0x402BD2 /end MEASUREMENT
/begin MEASUREMENT vvt_ib1_2 "Gesamtstrom VVT Bank1 bzw 4Zyl. und Bank2" UWORD i_vvt_ub_q0p50_om63p50 1 100 0 128 FORMAT "%8.4" ECU_ADDRESS 0x4031BC /end MEASUREMENT
/begin MEASUREMENT vvt_iges "Strombedarf des gesamten VVT-Systems" UWORD i_vvt_q0p0625 1 100 0 192 FORMAT "%8.4" ECU_ADDRESS 0x4031BE /end MEASUREMENT
/begin MEASUREMENT wdaacpat_l "" ULONG dez 1 100 0 4.29497e+009 FORMAT "%13.2" ECU_ADDRESS 0x3FE294 /end MEASUREMENT
/begin MEASUREMENT wdaoffdeb_u16 "" UWORD dez 1 100 0 65535 FORMAT "%8.2" ECU_ADDRESS 0x404830 /end MEASUREMENT
/begin MEASUREMENT wdaondeb_u16 "" UWORD dez 1 100 0 65535 FORMAT "%8.2" ECU_ADDRESS 0x404832 /end MEASUREMENT
/begin MEASUREMENT wdaovpat_l "" ULONG dez 1 100 0 4.29497e+009 FORMAT "%13.2" ECU_ADDRESS 0x3FE298 /end MEASUREMENT
/begin MEASUREMENT wdastate_l "" ULONG dez 1 100 0 4.29497e+009 FORMAT "%13.2" ECU_ADDRESS 0x404C0C /end MEASUREMENT
/begin MEASUREMENT wdkada_w "Sollwert DK-Winkel, aus DV-E Adaption- und Pr¸ffunktion" UWORD relDK_uw_b100 1 100 0 100 FORMAT "%8.4" ECU_ADDRESS 0x403DFE /end MEASUREMENT
/begin MEASUREMENT wdknlp "Diagnose: 8 Bit Kopie von wdknlp_w als Umweltgrˆﬂe" UBYTE relDK_q0p3922 1 100 0 100 FORMAT "%5.1" ECU_ADDRESS 0x40298C /end MEASUREMENT
/begin MEASUREMENT wdknlpr "Diagnose: 8 Bit Kopie von wdknlpr_w als Umweltgrˆﬂe" UBYTE relDK_q0p3922 1 100 0 100 FORMAT "%5.1" ECU_ADDRESS 0x40298D /end MEASUREMENT
/begin MEASUREMENT wdknlpr_w "Dauer-RAM: Sollwert DK-Winkel in NLP-Stellung, bez. auf UMA" UWORD relDK_uw_b100 1 100 0 100 FORMAT "%8.4" ECU_ADDRESS 0x3FE912 /end MEASUREMENT
/begin MEASUREMENT wdknlp_w "DK-Winkel der Notluftposition" UWORD relDK_uw_b100 1 100 0 100 FORMAT "%8.4" ECU_ADDRESS 0x403E00 /end MEASUREMENT
/begin MEASUREMENT wdkvabob "DK-Sollwert f¸r oberen Abgleichpunkt" UWORD relDK_uw_b100 1 100 0 100 FORMAT "%8.4" ECU_ADDRESS 0x403E02 /end MEASUREMENT
/begin MEASUREMENT wdkvabub "DK-Sollwert f¸r unteren Abgleichpunkt" UWORD relDK_uw_b100 1 100 0 100 FORMAT "%8.4" ECU_ADDRESS 0x403E04 /end MEASUREMENT
/begin MEASUREMENT wpedvf "Virtueller oder wahrer Pedalwert f¸r ACC- und FGR-Betrieb, ¸ber CAN versendet" UBYTE rel_ub_b99p6 1 100 0 99.6094 FORMAT "%5.2" ECU_ADDRESS 0x403BA5 /end MEASUREMENT
/begin FUNCTION BBSAWE "32.90     Betriebsbereich Schubabschalten/Wiedereinsetzen"
 /begin DEF_CHARACTERISTIC DNSAH DNSAHZDV DNSAL DNSALZDV DNSLL DNSLLZDV DNVSA DNVSAZDV DNWEK DNWEKZDV DVSA ENASAG FWAFSNWE FWARSNWE KFTVSA KFTVSAM NGDNSA NWEAFS NWEAFSZDV NWEARS NWEARSZDV NWEM NWEMT NWENG NWENGZDV TKATSAN TVSATM VSAA /end DEF_CHARACTERISTIC
 /begin REF_CHARACTERISTIC SNM08__UB STM05SAUB TMDV /end REF_CHARACTERISTIC
 /begin IN_MEASUREMENT B_cvt B_dash B_dsls B_falls B_kh B_koe B_kuppl B_ll B_llrein B_sacvt B_savfgr B_stend B_tevchkon dpsfak esst_snm08__ub esst_stm05saub gangi mdafsp_w mdarsp_w ngfil nmot tkatm tmot tmst vfzg /end IN_MEASUREMENT
 /begin OUT_MEASUREMENT BBSAWElokbits B_dnsll B_sab B_sabt B_zdv nsa nwe nwem_out /end OUT_MEASUREMENT
 /begin LOC_MEASUREMENT dnsa /end LOC_MEASUREMENT
/end FUNCTION
/begin FUNCTION BBSTT "11.20     Betriebsbereich: Start" /begin DEF_CHARACTERISTIC NNSTA NSTNM /end DEF_CHARACTERISTIC /begin IN_MEASUREMENT B_nmot nmot tans tmot /end IN_MEASUREMENT /begin OUT_MEASUREMENT B_st B_stend tnse_w tnst_w /end OUT_MEASUREMENT /end FUNCTION
/begin FUNCTION BBTEGA "9.30      Phasensteuerung f¸r Tankentl¸ftung und Gemischadaption"
 /begin DEF_CHARACTERISTIC DFTEDS DMRFATE FMRFAZTE FTEADZU FTEDS MRFABNTE TATELL TMSKLH TMSNOGA TTE TTEAE TTEBSTP TTEGA TTEGAI TTEGAIH TTEGAZO TTEGAZU TTEINI TTEMN TTEPRIO TTEZAO TTEZAU ZMRFABN /end DEF_CHARACTERISTIC
 /begin IN_MEASUREMENT B_dktb B_dldpte B_dtes B_edkvs B_edkvs2 B_frao B_gae B_gaefra B_gaefra2 B_gasp B_grdst B_ll B_lr B_lr2 B_masterhw B_nmot B_te B_teabb B_tehbx B_teza B_tldinfo B_tldobd ftead_w mrfa_w nmot tans tmst tnse_w /end IN_MEASUREMENT
 /begin OUT_MEASUREMENT B_fraoan B_gap B_nftev B_tep /end OUT_MEASUREMENT
 /begin LOC_MEASUREMENT B_tedtev B_tehbxf B_tepi B_tepzhl B_tepzus B_tesstp B_testop B_tezstp B_tteae B_ttegais dmrfabn_w mrfabn mrfabnf tephc /end LOC_MEASUREMENT
/end FUNCTION
/begin FUNCTION BBVL "2.90      Betriebsbereich Vollast" /begin DEF_CHARACTERISTIC MIFAVLN MIFAVLNHYS MRFAVLN MRFAVLNHYS WDKVLN WDKVLNHYS /end DEF_CHARACTERISTIC
 /begin IN_MEASUREMENT B_dkunb B_ll B_mibeg B_mrfavl B_temxon milsol_w mimax_w mrfa_w nmot_w rlvugd rlvw_w wdkba_w /end IN_MEASUREMENT
 /begin OUT_MEASUREMENT B_vl milmxvl_w rlvwvugd_w /end OUT_MEASUREMENT
 /begin LOC_MEASUREMENT B_vlb B_vlmi /end LOC_MEASUREMENT
/end FUNCTION
/begin FUNCTION BBWAKEUP "1.110     Betriebsbereich SG im wake up Zustand" /begin DEF_CHARACTERISTIC TKL15ON /end DEF_CHARACTERISTIC
 /begin IN_MEASUREMENT B_cascok B_immoff B_nachl B_nwmoff B_pwf codcan S_ckl15 S_kl15 /end IN_MEASUREMENT
 /begin OUT_MEASUREMENT AS_hr AS_nl AS_psoff B_backwu B_hr B_kl15 B_nachlauf B_nloff B_norm B_normtmp B_wakeup tKl15OnCtr /end OUT_MEASUREMENT
/end FUNCTION
/begin FUNCTION BBWDA "1.40      Betriebsbereich WDA-Abschaltung" /begin IN_MEASUREMENT B_ausc_act umerr_c_um /end IN_MEASUREMENT
 /begin OUT_MEASUREMENT B_wdaactiv wdaacpat_l wdaoffdeb_u16 wdaondeb_u16 wdaovpat_l wdastate_l /end OUT_MEASUREMENT
/end FUNCTION
/begin FUNCTION BGACC "1.50"
 /begin DEF_CHARACTERISTIC CWBGACC KLMACCKUPP MRACCMAX TACCCTR TKUPPCTR TMACCF TNSTACC WPEDVIRMX /end DEF_CHARACTERISTIC
 /begin REF_CHARACTERISTIC KFMRMI /end REF_CHARACTERISTIC
 /begin IN_MEASUREMENT acccod accctr_um accsyof_um B_dknolu B_dknot B_fgren B_fgrkf B_fgrtbe B_fgrtve B_fgr_um B_i_ska_fr B_i_ska_um B_kd B_kuppl B_mdacc_um B_mncacc B_mxcacc B_nldg B_npcacc B_savac_um B_tpdn B_tpup B_wiauf codcan codget dmllri_w eevx fqepmdn mdverltc_w mill_w mimax_w mimxl1_w minbeg_w mksacc_um mrfgr_w mrped_w nmot_w rlmin_w rlsol_w tnse_w wped_w wpfgr_w zwout zwspae /end IN_MEASUREMENT
 /begin OUT_MEASUREMENT B_accab B_dmefacca B_fahrerut B_idmef B_mnbfmder B_noacc_fr B_qaccair B_qaccar B_qaccsyof B_savacc fgr_stat miacc_w mracc_w stat_md_e wpedvf /end OUT_MEASUREMENT
 /begin LOC_MEASUREMENT B_acckupp B_upuew fmiacc_w macckupp_w mksaccf_w /end LOC_MEASUREMENT
/end FUNCTION
/begin FUNCTION BGANZNMX "1.60      Berechnete Grˆﬂe Anzeige Nmax"
 /begin DEF_CHARACTERISTIC CWBGANZNMX KLAOBT KLARBT KLTMOTKALT NWARNORINI NWARNRTINI NWRNHTOL2 /end DEF_CHARACTERISTIC
 /begin IN_MEASUREMENT B_toelh2 tmot tol /end IN_MEASUREMENT
 /begin OUT_MEASUREMENT nwarnor nwarnrt sttmotkalt /end OUT_MEASUREMENT
 /begin LOC_MEASUREMENT tmottol /end LOC_MEASUREMENT
/end FUNCTION
/begin FUNCTION BGBN "1.10      Berechnete Grˆﬂe Bordnetzversorgung" /begin IN_MEASUREMENT B_airbag /end IN_MEASUREMENT /begin OUT_MEASUREMENT BGBNausbits0 B_bvhfm B_bvhls /end OUT_MEASUREMENT /end FUNCTION
/begin FUNCTION BGCCM "1.130     Berechnete Grˆﬂe CheckControl Meldung" /begin DEF_CHARACTERISTIC CWCCAPP CWCCFG CWCCMASKNL TMCCGBH TMCCGBL TVCCGB /end DEF_CHARACTERISTIC
 /begin IN_MEASUREMENT B_acc B_ccbtnach B_ccbttdfk B_ccbttknt B_ccpmerr B_ccprio B_ccruhver B_egszwgs B_epcl B_fgrai B_mil B_milblk B_milst B_mol_sf B_mol_vb B_mol_vl B_nomil B_oeldran B_tankd B_toelh1cc B_toelh2 B_toelhgh B_uetm st_gen tmot tnse_w /end IN_MEASUREMENT
 /begin OUT_MEASUREMENT bgccmLokNov1 B_ccid155 B_ccid182 B_ccid212 B_ccid213 B_ccid214 B_ccid220 B_ccid229 B_ccid247 B_ccid257 B_ccid26 B_ccid27 B_ccid276 B_ccid28 B_ccid29 B_ccid30 B_ccid304 B_ccid305 B_ccid306 B_ccid31 B_ccid32 B_ccid33 B_ccid34 B_ccid39 B_noccm257 ccflags_l /end OUT_MEASUREMENT
 /begin LOC_MEASUREMENT bgccmLokBits /end LOC_MEASUREMENT
/end FUNCTION
/begin FUNCTION BGCMSGCC "1.80      Berechnete Grˆsse CAN-Botschaft Checkcontrol" /begin DEF_CHARACTERISTIC MAXBITPOS ZCCCYLMX /end DEF_CHARACTERISTIC /begin IN_MEASUREMENT B_ccevsok B_ccsdok B_kl15 B_milblk B_nomil ccflags_l /end IN_MEASUREMENT
 /begin OUT_MEASUREMENT bgcmsgccAUSBit1 B_ccevent B_ccevsdan B_cclampe B_cclblink B_ccsdanf ccoldflg_l dtnxtccmsg id2ccmsg idcclampe indexcccyl /end OUT_MEASUREMENT
 /begin LOC_MEASUREMENT bgcmsgccLokBits ccbitpos /end LOC_MEASUREMENT
/end FUNCTION
/begin FUNCTION BGCMSGGTS "1.10      Berechnete Grˆsse sende CAN-Message Geschwindigkeit_Tempomat" /begin DEF_CHARACTERISTIC TMSGSGTMN /end DEF_CHARACTERISTIC
 /begin IN_MEASUREMENT B_acc B_kl15 B_mrkein B_mrkv mrknrc mrknrcan mrkstut_w statvza vzielak_w /end IN_MEASUREMENT
 /begin OUT_MEASUREMENT B_cmsggts indexmrst vmrki1_w vmrki2_w vmrki3_w /end OUT_MEASUREMENT
 /begin LOC_MEASUREMENT B_acmsggts B_ergacgt B_mrkvff tnomgs60ms /end LOC_MEASUREMENT
/end FUNCTION
/begin FUNCTION BGCRENG "1.60      Berechnete Grˆﬂe Strombedarf Motor"
 /begin DEF_CHARACTERISTIC CRENGOF CRVVTNOT CRVVTOF KFELUPWM39 KFELUPWM60 KLELSLP KLELTEMP39 KLELTEMP60 KLELUB39 KLELUB60 /end DEF_CHARACTERISTIC
 /begin IN_MEASUREMENT B_elue600 B_kl15 B_masterhw B_slp taml tans ub vfzg vvt_es vvt_es2 /end IN_MEASUREMENT
 /begin OUT_MEASUREMENT fakttansel faktubel i_eluefter i_elupwm i_elu_vvt i_slp st_craweng taml_tmp tans_tmp ub_tmp vfzg_tmp vvt_ib1_2 vvt_iges /end OUT_MEASUREMENT
 /begin LOC_MEASUREMENT i_eluvfzg /end LOC_MEASUREMENT
/end FUNCTION
/begin FUNCTION BGCRMDME "1.20      Berechnete Grˆssen f¸r CAN-R¸ckmeldungen der DME" /begin IN_MEASUREMENT B_acc B_arsvar codget /end IN_MEASUREMENT /begin OUT_MEASUREMENT stdmeacc stdmears stdmedsc stdmeegs /end OUT_MEASUREMENT /end FUNCTION
/begin FUNCTION BGCVN "7.20      Berechnete Grˆﬂe Calibration Verification Number CVN"
 /begin OUT_MEASUREMENT BGCVNausbits B_cksbrdy B_cksbrdy2 CALIBID1 CALIBID2 cvn cvn2 cvn_temp kryptoCounter /end OUT_MEASUREMENT
/end FUNCTION
/begin FUNCTION BGDETX "1.50      Kundenspez. Fehlerart-Erweiterungs-Byte (Status Diagnosefunktion)" /begin REF_CHARACTERISTIC TADHMNH TADHMXH UBDHLSHMN UBDHLSHMX UBDHLSUMN UBDHLSUMX /end REF_CHARACTERISTIC
 /begin IN_MEASUREMENT B_admtll B_atmtpk B_atmtpk2 B_cddmtl B_cdhsh B_cdhsv B_cdhsvsa B_cdkatsp B_cdkvs B_cdlash B_cdlsh B_cdlsv B_cdlsvv B_cdsls B_cdtes B_cwdslt B_dktb B_dktb2 B_dktsbs B_dktsbs2 B_dkvsf B_dmtklm B_dmtlhe B_dshen B_dshen2 B_dsl2e B_dslerr B_dslo B_dsloab B_dsls B_dtebel B_dtebn B_dtekfa B_elsu B_elsu2 B_elsuv B_fadmtl B_fakat B_fasla B_fates B_fprakt B_fprovb B_fprzvb B_frao B_frau B_hsv B_hsv2 B_lra B_lra2 B_lrnakt B_lrnvb B_lrs B_lrs2 B_nmot B_nofra B_nomilkl B_norkat B_norkaz B_rinh B_rinh2 B_rkat B_rkaz B_slsfz B_stend tahsom2_w tahsom_w ubsq_w /end IN_MEASUREMENT
 /begin OUT_MEASUREMENT etxdmtk etxdmtknm etxdmtl etxdvef etxdvefo etxdven etxdveu etxdveuw etxdvev etxfrao etxfrao2 etxfrau etxfrau2 etxhsh etxhsh2 etxhsv etxhsv2 etxhsvsa etxhsvsa2 etxkatsp etxkatsp2 etxlash etxlash2 etxlsh etxlsh2 etxlsv etxlsv2 etxlsvv etxrkat etxrkat2 etxrkaz etxrkaz2 etxsls etxsls2 etxslv etxslv2 etxtes /end OUT_MEASUREMENT
/end FUNCTION
/begin FUNCTION BGDSC "1.10" /begin DEF_CHARACTERISTIC DMAUFASC MIMSRMXN TAUFRASC /end DEF_CHARACTERISTIC
 /begin IN_MEASUREMENT B_dsc2cok B_nomsr_um B_npdsc_um B_sidsc_um codcan dscstat_um fqepmdn mdverltc_w miasrl_um miasrs_um mimsr_um mksasrl_um mksasrs_um nmot_w tnodscnew /end IN_MEASUREMENT
 /begin OUT_MEASUREMENT B_asrext B_msrext B_nomsr_fr miasrl_w miasrs_w mimsr mimsrcpl mimsr_w /end OUT_MEASUREMENT
 /begin LOC_MEASUREMENT miasrsv_w /end LOC_MEASUREMENT
/end FUNCTION
/begin FUNCTION BGDVE "3.140     Grˆﬂen f¸r DV-E-Ansteuerung aus Lern- und Pr¸froutinen"
 /begin DEF_CHARACTERISTIC CWDVEFO DKPSTGMIN DLRPIDSTMN DUDKNLPO DUDKNLPU DUDKPTMP FPRAT FPRMT FPRNMAX FPRTIM1_T FPRTIM2_T FPRTIM3_T FPRTIM4_T LRNST1_T LRNST3_T LRNST7_T LRNST9_T LRNVB_T NLPST1T NLPST2T TDKNACH TDLRPIDMX TMSUTMUMA TTMUMASTA UANAUFRP UANNMAX UANPEDMAX UANPIDMIN UANPIDMINA UANUATS UANVFZG UANZURP UAN_O_MT UAN_STORE UAN_U_MT UB_UANL UDKNLP1N UDKNLP2N UDKP1AMAX UDKP1AMIN UDKP1AURI UDKP1DUS UDKP1NHUB UDKP1VID UDKP1VOMA UDKP1VOMI UDKP1VVMA UDKP1VVMI UDKP2AMAX UDKP2AMIN UDKP2AURI UDKPALOS UDKPAOFF UDKPATMX UPVGNENN WDKFPRO2 WDKFPROO WDKFPROU WDKFPRZ1 WDKFPRZ2 WDKNLPMA WDKNLPMI WDKNPLAUS WDKNSTORE WDKSFPR WDKSFPRO WDKSTMUMA /end DEF_CHARACTERISTIC
 /begin REF_CHARACTERISTIC DUDKP1HY /end REF_CHARACTERISTIC
 /begin IN_MEASUREMENT B_dcdisfr B_dknolu B_dknot B_dkp1e B_dkp2e B_dkpiu B_dlrspid B_dvete B_eemrdy B_eepwf B_i_ska_um B_lrndia B_stend B_ubdve B_wdk2sel dlrspid_w nmotll tans tmot ub udkp1v_w udkp1_w udkp2_w vfzg wdkba_w wdks_w wped /end IN_MEASUREMENT
 /begin OUT_MEASUREMENT B_abgle B_dcdisr B_dkaden B_dknach B_dlrien B_dveada B_dvetv B_ESrdy B_fprakt B_fproab B_fproe B_fprook B_fprordy B_fprovb B_fprrdy B_fprzab B_fprze B_fprzok B_fprzvb B_lrnakt B_lrnerf B_lrnfg B_lrnrdy B_lrnvb B_lrnws B_nlpe B_nlperf B_nlpnew B_umae B_umauab dkpstg_w dlrmxt dveadchst fprstep_c lrnstat lrnstep_c tdknach_w tloop_w tmpumast ttmumad_w udknlp1 udknlp2 udkp1a udkp1asr_w udkp1as_w udkp1a_w udkp1sv udkp1vou udkp1vo_w udkp1vv udkp1vv_w udkp2a udkp2asr_w udkp2as_w udkp2a_w udkpat_w wdkada_w wdknlp wdknlpr wdknlpr_w wdknlp_w /end OUT_MEASUREMENT
 /begin LOC_MEASUREMENT BGDVEintbits B_lrntesa B_nlpreq fprtim_c lrntim_c lrnvb_c nlp1tim udknlp1r udknlp2r udkp1aalt udkp1rob udkp1run udkp1vor udkp1vrob udkp1vrun udkp1vvr udkp2aalt wdkvabob wdkvabub /end LOC_MEASUREMENT
/end FUNCTION
/begin FUNCTION BGELSV "1.50      Berechnete Grˆﬂe Fehler LSV" /begin DEF_CHARACTERISTIC CWBGELSV /end DEF_CHARACTERISTIC /begin IN_MEASUREMENT B_pwf /end IN_MEASUREMENT
 /begin OUT_MEASUREMENT bgelsvAusBitsKoop bgelsvAusBitsNovKoop B_elsv B_elsv2 B_zlsv B_zlsv2 /end OUT_MEASUREMENT
 /begin LOC_MEASUREMENT bgelsvLokBitsKoop /end LOC_MEASUREMENT
 /begin SUB_FUNCTION DFPM_BGELSV /end SUB_FUNCTION
/end FUNCTION
/begin FUNCTION BGEVAB "1.60      Berechnung der tats‰chlichen Reduzierstufe durch EV-Abschaltung" /begin IN_MEASUREMENT abmf evz_austot stateaevab zzbank /end IN_MEASUREMENT
 /begin OUT_MEASUREMENT B_bevab B_bevab2 B_evakt B_evloc redbas redist redistb1 redistb2 /end OUT_MEASUREMENT
/end FUNCTION
/begin FUNCTION BGFDCAN "1.20      Berechnete Grˆsse Freigabe CAN-Diagnose" /begin DEF_CHARACTERISTIC TNKL15DC UBDCAN /end DEF_CHARACTERISTIC /begin IN_MEASUREMENT B_cdiagoff B_kl15 ub /end IN_MEASUREMENT /begin OUT_MEASUREMENT bgfdcanAUSBits B_fgdcan B_fgdcana B_fgdcanb /end OUT_MEASUREMENT /end FUNCTION
/begin FUNCTION BGFKEZ "1.10      Berechnete Grˆﬂe zylinderidividuelle Faktoren zur Kraftstoffkorrektur"
 /begin DEF_CHARACTERISTIC FKEEV0N FKEEV1N FKEEV2N FKEEV3N FKEEV4N FKEEV5N FKEEV6N FKEEV7N /end DEF_CHARACTERISTIC
 /begin REF_CHARACTERISTIC SNM08GKUB /end REF_CHARACTERISTIC
 /begin IN_MEASUREMENT esst_snm08gkub nmot /end IN_MEASUREMENT
 /begin OUT_MEASUREMENT fkez /end OUT_MEASUREMENT
/end FUNCTION
/begin FUNCTION BGGET "1.30"
 /begin DEF_CHARACTERISTIC BZULSGSV DMRSSGE DMRSSGR MDIAGMX MDWANMXT MKSGSMXN SGSMDTMX TSGSAMX TSGSNAMN TVBZULSGS TVMKSGSMX TVSGSMNV VSGSMN /end DEF_CHARACTERISTIC
 /begin IN_MEASUREMENT bfzgldsc_w B_nosgs_um B_npegs_um B_sgs B_siegs_um codcan codget egsstat_um fqepmdn mdverltc_w mdwanc migs migslm mksges_um mksgs_um mkswand_um mkverl_w nmot_w stegsmd stssgerr tmot vfzgv1f_w /end IN_MEASUREMENT
 /begin OUT_MEASUREMENT B_nosgs B_nosgs_fr B_sgsanf B_sgsnamn B_sgspnpl mdwancan miges_w migsl_w migs_w misgs misgscpl misgsl_w misgs_w sgsmdt_w /end OUT_MEASUREMENT
 /begin LOC_MEASUREMENT B_bzulsgs B_mksgsmx B_sgsamx B_sgsmdt B_vsgsmn /end LOC_MEASUREMENT
/end FUNCTION
/begin FUNCTION BGKMST "5.10      Berechnete Grˆﬂe: Kilometerstand" /begin IN_MEASUREMENT B_ins2cok B_kmmil B_pwf fcmEnd FCMTab kmstand vfzg_u /end IN_MEASUREMENT /begin OUT_MEASUREMENT kmstmil_w kmst_w /end OUT_MEASUREMENT /end FUNCTION
/begin FUNCTION BGKUPPL "1.10      Berechnete Grˆﬂe Kupplungssignal" /begin DEF_CHARACTERISTIC CW_BGKUPPL NV NVGMN NVGMX NVO NVV TDNVAUS TDNVEIN /end DEF_CHARACTERISTIC /begin IN_MEASUREMENT B_stend ngfil_w nvquot_w vfzg /end IN_MEASUREMENT /begin OUT_MEASUREMENT B_kupplmod gangctr sttdnvvaus sttdnvvein /end OUT_MEASUREMENT /end FUNCTION
/begin FUNCTION BGKV "1.20      Berechnungsgroesse verbrauchter Kraftstoff" /begin REF_CHARACTERISTIC FSTTMX KUMSRL /end REF_CHARACTERISTIC /begin IN_MEASUREMENT anzti rk2_w rkte_w rk_w /end IN_MEASUREMENT /begin OUT_MEASUREMENT BGKVbits B_kvta kvb_w vsks_w /end OUT_MEASUREMENT /begin LOC_MEASUREMENT anztid /end LOC_MEASUREMENT /end FUNCTION
/begin FUNCTION BGLAMABM "5.10      Berechnete Grˆﬂe Lambda im Abgas Modell"
 /begin DEF_CHARACTERISTIC COXLEAN COXRICH CWLAMABM CWOSCME DOXSG DYNLSULAU FCOSCHKIN FCOSCHKIN2 FFCOSC KDCOXRHK KFOSCHN KFOSCHN2 KSDCMS KSDCOSC MABSTCRHK MOXFULLH OSCMXHK ROSCZHK TFUSFK TKIHKMEMN TSCMEMXH USLEER USVOLL VNVKVHK VNVKVHK2 VOLHK VOLHK2 /end DEF_CHARACTERISTIC
 /begin IN_MEASUREMENT B_lrhkp B_lrhkp2 B_lrka B_lrka2 B_pwf B_sbbhk B_sbbhk2 B_sbblsu B_sbblsu2 dlaso dlaso2 dlatrmi2_w dlatrmi_w dynlsu2_w dynlsu_w lamsoni2_w lamsoni_w lamsons2_w lamsons_w lamzak2_w lamzak_w msabvhk2_w msabvhk_w msaovhk2_w msaovhk_w msaovvk_w pabvhk2_w pabvhk_w tavhkmm2_w tavhkmm_w tkihkm2_w tkihkm_w ushk2_w ushk_w /end IN_MEASUREMENT
 /begin OUT_MEASUREMENT B_hkleer B_hkleer2 B_hkvoll B_hkvoll2 B_omnhaku B_omnhaku2 B_oschaku B_oschaku2 B_rmnhaku B_rmnhaku2 B_rschaku B_rschaku2 B_scmebhk B_scmebhk2 B_ushknp B_ushknp2 fcoschk fcoschk2 fcoschmn_w fcosrhk fcosrhk2 lamsonk2_w lamsonk_w lanvkm2_w lanvkm_w lavhkm2_w lavhkm_w lavvkm2_w lavvkm_w oschme2_w oschme_w oscmnhk2_w oscmnhk_w oxinhk2_w oxinhk_w oxysthk2_w oxysthk_w rschme2_w rschme_w rscmnhk2_w rscmnhk_w /end OUT_MEASUREMENT
 /begin LOC_MEASUREMENT bglamzh bglamzh2 B_fushkl B_fushkl2 B_fushkv B_fushkv2 B_hklosm B_hklosm2 B_hklush B_hklush2 B_hkvosm B_hkvosm2 B_hkvush B_hkvush2 B_imskahk B_imskahk2 B_oxrsthk B_oxrsthk2 B_stcrhk B_stcrhk2 coxinhk2_w coxinhk_w dcoxhk2_w dcoxhk_w dlaoffs2_w dlaoffs_w lavvkmm2_w lavvkmm_w oigoxhk2_w oigoxhk_w oscfkm_w oschkm2_w oschkm_w oschn2_w oschn_w oxhkini2_w oxhkini_w oxplhk2_w oxplhk_w oxszahk2_w oxszahk_w oxszhk2_w oxszhk_w rolhk2_w rolhkdl2_w rolhkdl_w rolhk_w sdcosch sdcosch2 sdcoxhk2_w sdcoxhk_w tnvkvhk2_w tnvkvhk_w ttrhk2_w ttrhk_w uigoxhk2_w uigoxhk_w vsabvhk2_w vsabvhk_w /end LOC_MEASUREMENT
/end FUNCTION
/begin FUNCTION BGLAMBDA "1.20      Berechnete Grˆﬂe Lambda aus Sauerstoffsignal LSU" /begin DEF_CHARACTERISTIC KFLAMSLS LALIO /end DEF_CHARACTERISTIC
 /begin IN_MEASUREMENT B_sbblsu B_sbblsu2 B_sls lamsons2_w lamsons_w nmot o2adap2_w o2adap_w rl /end IN_MEASUREMENT
 /begin OUT_MEASUREMENT B_fklsol B_fklsol2 B_sbbvk B_sbbvk2 lalsuvj2_w lalsuvj_w lamsonb2_w lamsonb_w lamsoni2_w lamsoni_w /end OUT_MEASUREMENT
 /begin LOC_MEASUREMENT flamagr flamagr2 flamsls flamsls2 flamslsi /end LOC_MEASUREMENT
/end FUNCTION
/begin FUNCTION BGLLGEN "1.30      Berechnete Grˆﬂe Leerlaufdrehzahlanhebung Generator"
 /begin DEF_CHARACTERISTIC DFRUTYP IGENLLRANH KFDFIGEN0 KFDFIGEN1 KFDFIGEN2 KFDFIGEN3 KFDFIGEN4 KFDFIGEN5 KFDFIGEN6 KFDFIGEN7 LLRABS_DF LLRANH_DF NTWBGLLGEN PRELLDFAH PRELLDFRF /end DEF_CHARACTERISTIC
 /begin REF_CHARACTERISTIC GENUEBSETZ0 GENUEBSETZ1 GENUEBSETZ2 GENUEBSETZ3 GENUEBSETZ4 GENUEBSETZ5 GENUEBSETZ6 GENUEBSETZ7 KFIGENKA0 KFIGENKA1 KFIGENKA2 KFIGENKA3 KFIGENKA4 KFIGENKA5 KFIGENKA6 KFIGENKA7 KFIGENWA0 KFIGENWA1 KFIGENWA2 KFIGENWA3 KFIGENWA4 KFIGENWA5 KFIGENWA6 KFIGENWA7 /end REF_CHARACTERISTIC
 /begin IN_MEASUREMENT B_genfprl B_ll dffgen genawnumm gentempend nsllm st_i_gen ufgen /end IN_MEASUREMENT
 /begin OUT_MEASUREMENT B_hysllrah n_idlgspec /end OUT_MEASUREMENT
 /begin LOC_MEASUREMENT gendfvorhs genikaltmp genitemp2 igenrllrah ngsllm ufgentmp2 /end LOC_MEASUREMENT
/end FUNCTION
/begin FUNCTION BGMDLM "2.20      Berechnete Grˆﬂe Motormoment mit Momenteneingriffen" /begin REF_CHARACTERISTIC CWZWVMX /end REF_CHARACTERISTIC
 /begin IN_MEASUREMENT B_allzwe B_dash B_fil B_msr B_sgs dmar_w dmllr_w dmrkt_w miasrs_w mibas_w mibeg_w mibgr_w miext_w mifa_w miist_w mims_w minmx_w miszul_w mivmx_w mizsol_w mizwmn_w redbas synchroCtr /end IN_MEASUREMENT
 /begin OUT_MEASUREMENT B_intzwv B_miext mdindegs_w mdindlm_w miint1_w miint2_w miint3_w miintegs_w miintv_w miint_w /end OUT_MEASUREMENT
 /begin LOC_MEASUREMENT etazabas /end LOC_MEASUREMENT
/end FUNCTION
/begin FUNCTION BGMIMK "1.50      Berechnete Grˆﬂe in ind. Moment in  Kupplungsmoment" /begin DEF_CHARACTERISTIC MDNORM /end DEF_CHARACTERISTIC
 /begin IN_MEASUREMENT B_sa dmllri_w mdindegs_w mdindlm_w mdverl_w miist_w mimax_w mivbeg_w mizwmn_w /end IN_MEASUREMENT
 /begin OUT_MEASUREMENT fqepmdn fqmdnep mdindetc_w mdindltc_w mdverltc_w miisttc_w mimaxtc_w mivbegtc_w mizwmntc_w mkindegs_w mkindlm_w mkist_w mkmax_w mkvbeg_w mkverl_w mkzwmn_w /end OUT_MEASUREMENT
/end FUNCTION
/begin FUNCTION BGMSABG "7.40      Berechnung Abgasmassenstrom - bankabh‰ngig" /begin DEF_CHARACTERISTIC ZYLANZB ZYLANZB2 /end DEF_CHARACTERISTIC /begin IN_MEASUREMENT msfabr_w msl2_w msl_w rkg2_w rkg_w umsrln_w /end IN_MEASUREMENT
 /begin OUT_MEASUREMENT mabghks2_w mabghks_w mabikrs2_w mabikrs_w mabnavs2_w mabnavs_w mabnhks2_w mabnhks_w mabnvks2_w mabnvks_w mabvhks2_w mabvhks_w mabvvks2_w mabvvks_w mlbb2_w mlbb_w msabg msabg2 msabg2_w msabghk2_w msabghk_w msabgs2_w msabgs_w msabg_w msabikr2_w msabikr_w msabnav2_w msabnav_w msabnhk2_w msabnhk_w msabnvk2_w msabnvk_w msabvhk2_w msabvhk_w msabvvk2_w msabvvk_w msaovhk2_w msaovhk_w msaovvk2_w msaovvk_w verhmsb2_w verhmsb_w /end OUT_MEASUREMENT
 /begin LOC_MEASUREMENT mskgb2_w mskgb_w /end LOC_MEASUREMENT
/end FUNCTION
/begin COMPU_METHOD acc_sw_b819p1875 "" RAT_FUNC "%6.4" "m/(s^2)" COEFFS 0 65535 0 0 0 1638.375 /end COMPU_METHOD
/begin COMPU_METHOD B_TRUE "boolsche Zust‰nde, positive Logik" TAB_VERB "%6.3" "" COMPU_TAB_REF B_TRUE /end COMPU_METHOD
/begin COMPU_VTAB B_TRUE "boolsche Zust‰nde, positive Logik" TAB_VERB 2 0 "----" 1 "TRUE" /end COMPU_VTAB
/begin COMPU_METHOD DEZ "1 : 1 Umrechnug (dez/hex)" RAT_FUNC "%6.2" "" COEFFS 0 1 0 0 0 1 /end COMPU_METHOD
/begin COMPU_METHOD dez "1 : 1 Umrechnug (dez/hex)" RAT_FUNC "%6.2" "" COEFFS 0 1 0 0 0 1 /end COMPU_METHOD
/begin COMPU_METHOD fak_q0p0039 "" RAT_FUNC "%6.4" "-" COEFFS 0 256 0 0 0 1 /end COMPU_METHOD
/begin COMPU_METHOD fak_sw_b1 "" RAT_FUNC "%7.6" "-" COEFFS 0 65536 0 0 0 2 /end COMPU_METHOD
/begin COMPU_METHOD fak_sw_b64 "" RAT_FUNC "%6.4" "-" COEFFS 0 65536 0 0 0 128 /end COMPU_METHOD
/begin COMPU_METHOD fak_sw_b8 "" RAT_FUNC "%6.5" "-" COEFFS 0 65536 0 0 0 16 /end COMPU_METHOD
/begin COMPU_METHOD fak_ub_b1 "" RAT_FUNC "%6.4" "-" COEFFS 0 256 0 0 0 1 /end COMPU_METHOD
/begin COMPU_METHOD fak_ub_b2 "" RAT_FUNC "%6.4" "-" COEFFS 0 256 0 0 0 2 /end COMPU_METHOD
/begin COMPU_METHOD fak_ub_b4 "" RAT_FUNC "%6.4" "-" COEFFS 0 256 0 0 0 4 /end COMPU_METHOD
/begin COMPU_METHOD fak_uw_b1 "" RAT_FUNC "%7.6" "-" COEFFS 0 65536 0 0 0 1 /end COMPU_METHOD
/begin COMPU_METHOD fak_uw_b16 "" RAT_FUNC "%6.5" "-" COEFFS 0 65536 0 0 0 16 /end COMPU_METHOD
/begin COMPU_METHOD fak_uw_b2 "" RAT_FUNC "%7.6" "-" COEFFS 0 65536 0 0 0 2 /end COMPU_METHOD
/begin COMPU_METHOD fak_uw_b4 "" RAT_FUNC "%7.6" "-" COEFFS 0 65536 0 0 0 4 /end COMPU_METHOD
/begin COMPU_METHOD igen_ub_q1 "" RAT_FUNC "%6.2" "" COEFFS 0 1 0 0 0 1 /end COMPU_METHOD
/begin COMPU_METHOD i_eluft_q0p0625 "" RAT_FUNC "%6.4" "" COEFFS 0 65536 0 0 0 4096 /end COMPU_METHOD
/begin COMPU_METHOD i_vvt_q0p0625 "" RAT_FUNC "%6.4" "" COEFFS 0 65536 0 0 0 4096 /end COMPU_METHOD
/begin COMPU_METHOD i_vvt_ub_q0p50_om63p50 "" RAT_FUNC "%6.4" "" COEFFS 0 1 63.5 0 0 0.5 /end COMPU_METHOD
/begin COMPU_METHOD mdrel_q0p16 "" RAT_FUNC "%6.3" "Nm/%" COEFFS 0 100 0 0 0 16 /end COMPU_METHOD
/begin COMPU_METHOD md_q0p5 "" RAT_FUNC "%6.3" "Nm" COEFFS 0 1 0 0 0 0.5 /end COMPU_METHOD
/begin COMPU_METHOD md_ub_q16 "" RAT_FUNC "%6.1" "Nm" COEFFS 0 1 0 0 0 16 /end COMPU_METHOD
/begin COMPU_METHOD m_q0p01777_g "" RAT_FUNC "%6.4" "g" COEFFS 0 65536 0 0 0 1165 /end COMPU_METHOD
/begin COMPU_METHOD m_q0p1_mg "" RAT_FUNC "%6.3" "mg" COEFFS 0 1 0 0 0 0.1 /end COMPU_METHOD
/begin COMPU_METHOD m_q0p1_mgs "" RAT_FUNC "%6.3" "mg/s" COEFFS 0 1 0 0 0 0.1 /end COMPU_METHOD
/begin COMPU_METHOD m_q2p777Em5 "" RAT_FUNC "%7.6" "kg/s" COEFFS 0 3600 0 0 0 0.1 /end COMPU_METHOD
/begin COMPU_METHOD m_ub_b1020 "" RAT_FUNC "%6.2" "kg/h" COEFFS 0 1 0 0 0 4 /end COMPU_METHOD
/begin COMPU_METHOD m_uw_b6553p5 "" RAT_FUNC "%6.3" "kg/h" COEFFS 0 1 0 0 0 0.1 /end COMPU_METHOD
/begin COMPU_METHOD ngen_uw_q0p5 "" RAT_FUNC "%6.3" "" COEFFS 0 1 0 0 0 0.5 /end COMPU_METHOD
/begin COMPU_METHOD nmotg_sb_q100 "" RAT_FUNC "%6.0" "1/min/s" COEFFS 0 1 0 0 0 100 /end COMPU_METHOD
/begin COMPU_METHOD nmotg_sw_q0p15625 "" RAT_FUNC "%6.3" "1/min/s" COEFFS 0 1 0 0 0 0.15625 /end COMPU_METHOD
/begin COMPU_METHOD nmotg_sw_q0p39 "" RAT_FUNC "%6.3" "1/min/s" COEFFS 0 1 0 0 0 0.39063 /end COMPU_METHOD
/begin COMPU_METHOD nmot_ub_q10 "" RAT_FUNC "%6.1" "1/min" COEFFS 0 1 0 0 0 10 /end COMPU_METHOD
/begin COMPU_METHOD nmot_ub_q40 "" RAT_FUNC "%6.1" "1/min" COEFFS 0 1 0 0 0 40 /end COMPU_METHOD
/begin COMPU_METHOD nmot_uw_q0p25 "" RAT_FUNC "%6.3" "1/min" COEFFS 0 1 0 0 0 0.25 /end COMPU_METHOD
/begin COMPU_METHOD PCENT "Prozent" RAT_FUNC "%6.3" "%" COEFFS 0 256 0 0 0 100 /end COMPU_METHOD
/begin COMPU_METHOD qnv_uw_b512 "" RAT_FUNC "%6.4" "(1/min) / (km/h)" COEFFS 0 65536 0 0 0 512 /end COMPU_METHOD
/begin COMPU_METHOD relDK_q0p02441 "" RAT_FUNC "%6.4" "%DK" COEFFS 0 65536 0 0 0 1600 /end COMPU_METHOD
/begin COMPU_METHOD relDK_q0p3922 "" RAT_FUNC "%6.3" "%DK" COEFFS 0 255 0 0 0 100 /end COMPU_METHOD
/begin COMPU_METHOD relDK_ub_b100 "" RAT_FUNC "%6.3" "%DK" COEFFS 0 255 0 0 0 100 /end COMPU_METHOD
/begin COMPU_METHOD relDK_uw_b100 "" RAT_FUNC "%6.4" "%DK" COEFFS 0 65535 0 0 0 100 /end COMPU_METHOD
/begin COMPU_METHOD relmd_q327p68 "" RAT_FUNC "%6.4" "%/Nm" COEFFS 0 32768 0 0 0 100 /end COMPU_METHOD
/begin COMPU_METHOD relO2_q9p765Em4 "" RAT_FUNC "%6.5" "% O2" COEFFS 0 1024 0 0 0 1 /end COMPU_METHOD
/begin COMPU_METHOD rel_sw_b100 "" RAT_FUNC "%6.4" "%" COEFFS 0 32768 0 0 0 100 /end COMPU_METHOD
/begin COMPU_METHOD rel_ub_b100 "" RAT_FUNC "%6.3" "%" COEFFS 0 256 0 0 0 100 /end COMPU_METHOD
/begin COMPU_METHOD rel_ub_b127p5 "" RAT_FUNC "%6.3" "%" COEFFS 0 2 0 0 0 1 /end COMPU_METHOD
/begin COMPU_METHOD rel_ub_b99p6 "" RAT_FUNC "%6.3" "%" COEFFS 0 256 0 0 0 100 /end COMPU_METHOD
/begin COMPU_METHOD rel_ub_q0p3906 "" RAT_FUNC "%6.3" "%" COEFFS 0 256 0 0 0 100 /end COMPU_METHOD
/begin COMPU_METHOD rel_ub_q0p75 "" RAT_FUNC "%6.3" "%" COEFFS 0 1 0 0 0 0.75 /end COMPU_METHOD
/begin COMPU_METHOD rel_uw_b100 "" RAT_FUNC "%6.4" "%" COEFFS 0 65536 0 0 0 100 /end COMPU_METHOD
/begin COMPU_METHOD rel_uw_b200 "" RAT_FUNC "%6.4" "%" COEFFS 0 65536 0 0 0 200 /end COMPU_METHOD
/begin COMPU_METHOD rel_uw_b40 "" RAT_FUNC "%6.5" "%" COEFFS 0 65536 0 0 0 40 /end COMPU_METHOD
/begin COMPU_METHOD spg_q0p00977 "" RAT_FUNC "%6.4" "V" COEFFS 0 256 0 0 0 2.5 /end COMPU_METHOD
/begin COMPU_METHOD spg_q0p03125 "" RAT_FUNC "%6.4" "V" COEFFS 0 256 0 0 0 8 /end COMPU_METHOD
/begin COMPU_METHOD spg_sw_q0p001222 "" RAT_FUNC "%6.4" "V" COEFFS 0 1 0 0 0 0.001222 /end COMPU_METHOD
/begin COMPU_METHOD spg_ubatt "" RAT_FUNC "%6.3" "V" COEFFS 0 1 0 0 0 0.0942 /end COMPU_METHOD
/begin COMPU_METHOD spg_ub_b5 "" RAT_FUNC "%6.4" "V" COEFFS 0 256 0 0 0 5 /end COMPU_METHOD
/begin COMPU_METHOD spg_ugen "" RAT_FUNC "%6.2" "V" COEFFS 0 10 -106 0 0 1 /end COMPU_METHOD
/begin COMPU_METHOD spg_uw_q0p001222 "" RAT_FUNC "%6.4" "V" COEFFS 0 65536 0 0 0 80 /end COMPU_METHOD
/begin COMPU_METHOD spg_uw_q0p00488 "" RAT_FUNC "%6.4" "V" COEFFS 0 1024 0 0 0 5 /end COMPU_METHOD
/begin COMPU_METHOD spg_uw_q0p00488_o1 "" RAT_FUNC "%6.3" "V" COEFFS 0 1024 1024 0 0 5 /end COMPU_METHOD
/begin COMPU_METHOD s_q1_km "" RAT_FUNC "%6.2" "km" COEFFS 0 1 0 0 0 1 /end COMPU_METHOD
/begin COMPU_METHOD s_q6_km "" RAT_FUNC "%6.2" "km" COEFFS 0 1 0 0 0 6 /end COMPU_METHOD
/begin COMPU_METHOD t100msxs_ub_b25p5 "" RAT_FUNC "%6.3" "s" COEFFS 0 1 0 0 0 0.1 /end COMPU_METHOD
/begin COMPU_METHOD t100msxs_uw_b6553p5 "" RAT_FUNC "%6.3" "s" COEFFS 0 1 0 0 0 0.1 /end COMPU_METHOD
/begin COMPU_METHOD t100msxs_uw_b6553p6 "" RAT_FUNC "%6.3" "s" COEFFS 0 10 0 0 0 1 /end COMPU_METHOD
/begin COMPU_METHOD t10msxs_ub_b2p55 "" RAT_FUNC "%6.4" "s" COEFFS 0 1 0 0 0 0.01 /end COMPU_METHOD
/begin COMPU_METHOD t10msxs_uw_b655p35 "" RAT_FUNC "%6.4" "s" COEFFS 0 1 0 0 0 0.01 /end COMPU_METHOD
/begin COMPU_METHOD t1sxs_ub_b255 "" RAT_FUNC "%6.2" "s" COEFFS 0 1 0 0 0 1 /end COMPU_METHOD
/begin COMPU_METHOD t20msxs_ub_b5p1 "" RAT_FUNC "%6.4" "s" COEFFS 0 1 0 0 0 0.02 /end COMPU_METHOD
/begin COMPU_METHOD t20msxs_uw_b1310 "" RAT_FUNC "%6.4" "s" COEFFS 0 1 0 0 0 0.02 /end COMPU_METHOD
/begin COMPU_METHOD t20msxs_uw_q0p02 "" RAT_FUNC "%6.4" "s" COEFFS 0 1 0 0 0 0.02 /end COMPU_METHOD
/begin COMPU_METHOD t50msxs_q0p05 "" RAT_FUNC "%6.4" "s" COEFFS 0 1 0 0 0 0.05 /end COMPU_METHOD
/begin COMPU_METHOD temp_q0p0234_o273 "" RAT_FUNC "%6.1" "Grad C" COEFFS 0 1 273.15 0 0 0.0234375 /end COMPU_METHOD
/begin COMPU_METHOD temp_ub_q0p75_o48 "" RAT_FUNC "%6.2" "Grad C" COEFFS 0 1 48 0 0 0.75 /end COMPU_METHOD
/begin COMPU_METHOD temp_ub_q5_o50 "" RAT_FUNC "%6.2" "Grad C" COEFFS 0 1 50 0 0 5 /end COMPU_METHOD
/begin COMPU_METHOD t_q0p02 "" RAT_FUNC "%6.4" "s" COEFFS 0 100 0 0 0 2 /end COMPU_METHOD
/begin COMPU_METHOD t_q0p1 "" RAT_FUNC "%6.3" "s" COEFFS 0 10 0 0 0 1 /end COMPU_METHOD
/begin COMPU_METHOD vfzg_ub_q1p25 "" RAT_FUNC "%6.2" "km/h" COEFFS 0 1 0 0 0 1.25 /end COMPU_METHOD
/begin COMPU_METHOD vfzg_uw_b512 "" RAT_FUNC "%6.4" "km/h" COEFFS 0 65536 0 0 0 512 /end COMPU_METHOD
/begin COMPU_METHOD vol_q0p306_cme3 "" RAT_FUNC "%6.3" "cm^3" COEFFS 0 6.5536 0 0 0 2 /end COMPU_METHOD
/begin COMPU_METHOD vol_q3p90625Em3_l "" RAT_FUNC "%6.4" "l" COEFFS 0 65536 0 0 0 256 /end COMPU_METHOD
/begin COMPU_METHOD vol_q5p96Em8_l "" RAT_FUNC "%10.9" "l" COEFFS 0 65536 0 0 0 0.00390625 /end COMPU_METHOD
/begin COMPU_METHOD vs_q6p1 "" RAT_FUNC "%6.2" "cm^3/s" COEFFS 0 65536 0 0 0 400000 /end COMPU_METHOD
/begin COMPU_METHOD zk100msxs_uw_b6553 "" RAT_FUNC "%6.1" "s" COEFFS 0 0 65536 0 10 0 /end COMPU_METHOD
/begin COMPU_METHOD zk20msxs_ub_b5p1 "" RAT_FUNC "%6.4" "s" COEFFS 0 0 5.1 0 1 0 /end COMPU_METHOD
/begin RECORD_LAYOUT FklWS16 FNC_VALUES 1 SWORD COLUMN_DIR DIRECT /end RECORD_LAYOUT
/begin RECORD_LAYOUT FklWU16 FNC_VALUES 1 UWORD COLUMN_DIR DIRECT /end RECORD_LAYOUT
/begin RECORD_LAYOUT GkfWUb FNC_VALUES 1 UBYTE COLUMN_DIR DIRECT /end RECORD_LAYOUT
/begin RECORD_LAYOUT GklWU8 FNC_VALUES 1 UBYTE COLUMN_DIR DIRECT /end RECORD_LAYOUT
/begin RECORD_LAYOUT GklWUb FNC_VALUES 1 UBYTE COLUMN_DIR DIRECT /end RECORD_LAYOUT
/begin RECORD_LAYOUT KfAxU8AyU8SstxU16SstyU16WU16 NO_AXIS_PTS_X 1 UWORD NO_AXIS_PTS_Y 2 UWORD AXIS_PTS_X 3 UWORD INDEX_INCR DIRECT AXIS_PTS_Y 4 UWORD INDEX_INCR DIRECT FNC_VALUES 5 UWORD COLUMN_DIR DIRECT /end RECORD_LAYOUT
/begin RECORD_LAYOUT KfAxU8AyU8SstxU8SstyU8WU8 NO_AXIS_PTS_X 1 UBYTE NO_AXIS_PTS_Y 2 UBYTE AXIS_PTS_X 3 UBYTE INDEX_INCR DIRECT AXIS_PTS_Y 4 UBYTE INDEX_INCR DIRECT FNC_VALUES 5 UBYTE COLUMN_DIR DIRECT /end RECORD_LAYOUT
/begin RECORD_LAYOUT KfAxUbAyUbSstxUbSstyUbWUb NO_AXIS_PTS_X 1 UBYTE NO_AXIS_PTS_Y 2 UBYTE AXIS_PTS_X 3 UBYTE INDEX_INCR DIRECT AXIS_PTS_Y 4 UBYTE INDEX_INCR DIRECT FNC_VALUES 5 UBYTE COLUMN_DIR DIRECT /end RECORD_LAYOUT
/begin RECORD_LAYOUT KfAxUwAyUwSstxUwSstyUwWSw NO_AXIS_PTS_X 1 UWORD NO_AXIS_PTS_Y 2 UWORD AXIS_PTS_X 3 UWORD INDEX_INCR DIRECT AXIS_PTS_Y 4 UWORD INDEX_INCR DIRECT FNC_VALUES 5 SWORD COLUMN_DIR DIRECT /end RECORD_LAYOUT
/begin RECORD_LAYOUT KfAxUwAyUwSstxUwSstyUwWUw NO_AXIS_PTS_X 1 UWORD NO_AXIS_PTS_Y 2 UWORD AXIS_PTS_X 3 UWORD INDEX_INCR DIRECT AXIS_PTS_Y 4 UWORD INDEX_INCR DIRECT FNC_VALUES 5 UWORD COLUMN_DIR DIRECT /end RECORD_LAYOUT
/begin RECORD_LAYOUT KlAUbSstSbWUb NO_AXIS_PTS_X 1 UBYTE AXIS_PTS_X 2 SBYTE INDEX_INCR DIRECT FNC_VALUES 3 UBYTE COLUMN_DIR DIRECT /end RECORD_LAYOUT
/begin RECORD_LAYOUT KlAUbSstUbWUb NO_AXIS_PTS_X 1 UBYTE AXIS_PTS_X 2 UBYTE INDEX_INCR DIRECT FNC_VALUES 3 UBYTE COLUMN_DIR DIRECT /end RECORD_LAYOUT
/begin RECORD_LAYOUT KlAUwSstSwWUw NO_AXIS_PTS_X 1 UWORD AXIS_PTS_X 2 SWORD INDEX_INCR DIRECT FNC_VALUES 3 UWORD COLUMN_DIR DIRECT /end RECORD_LAYOUT
/begin RECORD_LAYOUT KlAUwSstUwWSw NO_AXIS_PTS_X 1 UWORD AXIS_PTS_X 2 UWORD INDEX_INCR DIRECT FNC_VALUES 3 SWORD COLUMN_DIR DIRECT /end RECORD_LAYOUT
/begin RECORD_LAYOUT KlAUwSstUwWUb NO_AXIS_PTS_X 1 UWORD AXIS_PTS_X 2 UWORD INDEX_INCR DIRECT FNC_VALUES 3 UBYTE COLUMN_DIR DIRECT /end RECORD_LAYOUT
/begin RECORD_LAYOUT KlAUwSstUwWUw NO_AXIS_PTS_X 1 UWORD AXIS_PTS_X 2 UWORD INDEX_INCR DIRECT FNC_VALUES 3 UWORD COLUMN_DIR DIRECT /end RECORD_LAYOUT
/begin RECORD_LAYOUT KlAxU8SstxU16WU16 NO_AXIS_PTS_X 1 UWORD AXIS_PTS_X 2 UWORD INDEX_INCR DIRECT FNC_VALUES 3 UWORD COLUMN_DIR DIRECT /end RECORD_LAYOUT
/begin RECORD_LAYOUT KlAxU8SstxU8WU16 NO_AXIS_PTS_X 1 UBYTE AXIS_PTS_X 2 UBYTE INDEX_INCR DIRECT FNC_VALUES 3 UWORD COLUMN_DIR DIRECT /end RECORD_LAYOUT
/begin RECORD_LAYOUT KlAxU8SstxU8WU8 NO_AXIS_PTS_X 1 UBYTE AXIS_PTS_X 2 UBYTE INDEX_INCR DIRECT FNC_VALUES 3 UBYTE COLUMN_DIR DIRECT /end RECORD_LAYOUT
/begin RECORD_LAYOUT KwSw FNC_VALUES 1 SWORD COLUMN_DIR DIRECT /end RECORD_LAYOUT
/begin RECORD_LAYOUT KwUb FNC_VALUES 1 UBYTE COLUMN_DIR DIRECT /end RECORD_LAYOUT
/begin RECORD_LAYOUT KwUw FNC_VALUES 1 UWORD COLUMN_DIR DIRECT /end RECORD_LAYOUT
/begin RECORD_LAYOUT KwWS16 FNC_VALUES 1 SWORD COLUMN_DIR DIRECT /end RECORD_LAYOUT
/begin RECORD_LAYOUT KwWU16 FNC_VALUES 1 UWORD COLUMN_DIR DIRECT /end RECORD_LAYOUT
/begin RECORD_LAYOUT KwWU32 FNC_VALUES 1 ULONG COLUMN_DIR DIRECT /end RECORD_LAYOUT
/begin RECORD_LAYOUT KwWU8 FNC_VALUES 1 UBYTE COLUMN_DIR DIRECT /end RECORD_LAYOUT
/begin RECORD_LAYOUT SstAU8SstU8 NO_AXIS_PTS_X 1 UBYTE AXIS_PTS_X 2 UBYTE INDEX_INCR DIRECT /end RECORD_LAYOUT
/begin RECORD_LAYOUT SstAUbSstUb NO_AXIS_PTS_X 1 UBYTE AXIS_PTS_X 2 UBYTE INDEX_INCR DIRECT /end RECORD_LAYOUT
/end MODULE
/end PROJECT
