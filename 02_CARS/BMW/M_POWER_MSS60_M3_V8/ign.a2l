ASAP2_VERSION 1 30
/begin PROJECT MSS65-ign "Generiert am 14.10.05 um 09:57:47"
/begin HEADER "" VERSION "R341" /end HEADER
/begin MODULE _MSS65-ign "Generiert am 14.10.05 um 09:57:47"
/begin MOD_COMMON "" BYTE_ORDER MSB_FIRST ALIGNMENT_BYTE 1 ALIGNMENT_WORD 2 ALIGNMENT_LONG 4 ALIGNMENT_FLOAT32_IEEE 4 ALIGNMENT_FLOAT64_IEEE 8 /end MOD_COMMON
/begin CHARACTERISTIC K_AFZ_A0 "applizierbarer Adaptionswert" VALUE 0x702A6 TKW_VV_VV_SW 100.0 FORMULA_0454 -50.0 50.0 FORMAT "%5.2" /end CHARACTERISTIC
/begin CHARACTERISTIC K_AFZ_A0_CNT_MAX "Zaehlerwert zum Beenden der Adaption" VALUE 0x702A8 TKW_VV_VV_UB 100.0 FORMULA_0003 0.0 255.0 /end CHARACTERISTIC
/begin CHARACTERISTIC K_AFZ_A0_MAX "maximaler Nullpunktadaptionwert" VALUE 0x70298 TKW_VV_VV_SW 100.0 FORMULA_0114 0.0 1023.0 /end CHARACTERISTIC
/begin CHARACTERISTIC K_AFZ_A0_MIN "minimaler Nullpunktadaptionwert" VALUE 0x70296 TKW_VV_VV_SW 100.0 FORMULA_0114 0.0 1023.0 /end CHARACTERISTIC
/begin CHARACTERISTIC K_AFZ_DIAG_AX "Bandgrenze Beschl. Fzg - Beschl. DSC" VALUE 0x7029E TKW_VV_VV_SW 100.0 FORMULA_0123 -50.0 50.0 FORMAT "%5.2" /end CHARACTERISTIC
/begin CHARACTERISTIC K_AFZ_DIAG_MAX "elektrische Diagnoseschwelle short-to-ub" VALUE 0x7029C TKW_VV_VV_SW 100.0 FORMULA_0114 0.0 1023.0 /end CHARACTERISTIC
/begin CHARACTERISTIC K_AFZ_DIAG_MIN "elektrische Diagnoseschwelle short-to-gnd" VALUE 0x7029A TKW_VV_VV_SW 100.0 FORMULA_0114 0.0 1023.0 /end CHARACTERISTIC
/begin CHARACTERISTIC K_AFZ_DIAG_T "Timergrenze, um Diagnose zu beenden" VALUE 0x702A0 TKW_VV_VV_UW 100.0 FORMULA_0021 0.0 655.0 FORMAT "%5.2" /end CHARACTERISTIC
/begin CHARACTERISTIC K_AFZ_F_KONV_NENNER "Konvertierungsfaktor Nenner AD-Wert nach Beschleunigung" VALUE 0x702A4 TKW_VV_VV_SW 100.0 FORMULA_0010 -32768.0 32767.0 /end CHARACTERISTIC
/begin CHARACTERISTIC K_AFZ_F_KONV_ZAEHLER "Konvertierungsfaktor Zaehler AD-Wert nach Beschleunigung" VALUE 0x702A2 TKW_VV_VV_SW 100.0 FORMULA_0010 -32768.0 32767.0 /end CHARACTERISTIC
/begin CHARACTERISTIC K_AFZ_TAU "Filterkonstante fuer die Beschleunigung Fahrzeug" VALUE 0x70294 TKW_VV_VV_UB 100.0 FORMULA_0455 1.009999960660934e-002 2.559999942779541 /end CHARACTERISTIC
/begin CHARACTERISTIC K_AG_TZ_ANZ "Anzahl der unmittelbar aufeinanderfolgenden Ausblendungen." VALUE 0x702AE TKW_VV_VV_UW 100.0 FORMULA_0010 0.0 65535.0 /end CHARACTERISTIC
/begin CHARACTERISTIC K_AG_TZ_CFG "Welcher Aussetzergenerator" VALUE 0x702AA TKW_VV_VV_UB 100.0 FORMULA_0457 0.0 3.0 /end CHARACTERISTIC
/begin CHARACTERISTIC K_AG_TZ_PAUSE "Anzahl der Arbeitsspiele zwischen Ausblendungen." VALUE 0x702B0 TKW_VV_VV_UW 100.0 FORMULA_0010 0.0 65535.0 /end CHARACTERISTIC
/begin CHARACTERISTIC K_AG_TZ_V_MIN "Minimale Geschwindigkeitsschwelle." VALUE 0x702B2 TKW_VV_VV_SW 100.0 FORMULA_0076 -80.0 360.0 FORMAT "%4.1" /end CHARACTERISTIC
/begin CHARACTERISTIC K_AG_TZ_ZYL "Statisches Ausblendmuster." VALUE 0x702AC TKW_VV_VV_UW 100.0 FORMULA_0010 0.0 65535.0 /end CHARACTERISTIC
/begin CHARACTERISTIC K_AQ_DK_ABW_T_MIN "Zeitschwelle fuer DK eingeregelt" VALUE 0x702B9 TKW_VV_VV_UB 100.0 FORMULA_0357 0.0 1.274999976158142 /end CHARACTERISTIC
/begin CHARACTERISTIC K_AQ_DK0_DK_IST_SCHW "DkIst-Schwelle fuer DK0-Erkennung" VALUE 0x702B5 TKW_VV_VV_UB 100.0 FORMULA_0471 0.0 25.5 /end CHARACTERISTIC
/begin CHARACTERISTIC K_AQ_DK0_LLS_AQ_SCHW "AqLLS-Schwelle fuer DK0-Erkennung" VALUE 0x702BA TKW_VV_VV_UW 100.0 FORMULA_0143 0.0 6500.0 FORMAT "%4.1" /end CHARACTERISTIC
/begin CHARACTERISTIC K_AQ_DR_REL_GRAD_TAU "TAU fuer dr_rel Gradienten" VALUE 0x702B4 TKW_VV_VV_UB 100.0 FORMULA_0470 5.100000184029341e-003 1.279999971389771 /end CHARACTERISTIC
/begin CHARACTERISTIC K_AQ_LLS_ABW_T_MIN "Zeitschwelle fuer LLS eingeregelt" VALUE 0x702B8 TKW_VV_VV_UB 100.0 FORMULA_0357 0.0 1.274999976158142 /end CHARACTERISTIC
/begin CHARACTERISTIC K_AQ_RF_RG_KORR_FAK "Korrektur der Restgasmenge" VALUE 0x702B6 TKW_VV_VV_UW 100.0 FORMULA_0073 0.0 4.0 FORMAT "%6.3" /end CHARACTERISTIC
/begin CHARACTERISTIC K_AUSS_ASP_SA_CNT "Min Anzahl Arbeitspiele waehren SA vor Adaption." VALUE 0x7075E TKW_VV_VV_UW 100.0 FORMULA_0010 0.0 65535.0 /end CHARACTERISTIC
/begin CHARACTERISTIC K_AUSS_ED_LP_INT_MIN "Aussetzer-Integralschwelle bei Fehler Verstaerkungsumschaltung." VALUE 0x70724 TKW_VV_VV_SW 100.0 FORMULA_0227 0.0 4.0 FORMAT "%5.2" /end CHARACTERISTIC
/begin CHARACTERISTIC K_AUSS_ED_WICHT_SPARK "Gewichtungsfaktors fuer Fehlereintrag Zuendauss." VALUE 0x7074C TKW_VV_VV_UW 100.0 FORMULA_0568 0.0 255.9960021972656 FORMAT "%5.2" /end CHARACTERISTIC
/begin CHARACTERISTIC K_AUSS_FETRAWE_N "Drehzahlgrenze bei Abschaltung im FeTraWe-Mode." VALUE 0x7076A TKW_VV_VV_SW 100.0 FORMULA_0006 0.0 10000.0 /end CHARACTERISTIC
/begin CHARACTERISTIC K_AUSS_FETRAWE_RF "Lastgrenze bei Abschaltung im FeTraWe-Mode." VALUE 0x7076C TKW_VV_VV_SW 100.0 FORMULA_0007 0.0 2.0 FORMAT "%6.3" /end CHARACTERISTIC
/begin CHARACTERISTIC K_AUSS_FETRAWE_TIME_ML "Zeitgrenze bei Abschaltung im FeTraWe-Mode." VALUE 0x70770 TKW_VV_VV_UL 100.0 FORMULA_0147 0.0 42949672.95 FORMAT "%5.2" /end CHARACTERISTIC
/begin CHARACTERISTIC K_AUSS_INT_START_FAKTOR_KOR "Faktor-Korrekturwert waerend Startphase." VALUE 0x70764 TKW_VV_VV_SW 100.0 FORMULA_0561 0.0 199.9938049316406 FORMAT "%5.2" /end CHARACTERISTIC
/begin CHARACTERISTIC K_AUSS_LP_COEF "Tief-Pass Filter zur Aussetzererkennung." VAL_BLK 0x70774 TKW_VV_VV_SF 100.0 FORMULA_0570 -3.402823466385289e+038 3.402823466385289e+038 FORMAT "%7.4" NUMBER 40 /end CHARACTERISTIC
/begin CHARACTERISTIC K_AUSS_LP_MAX_OFFSET "Maximal zul. Offset des Tiefpassgefilterteren Leitwertes." VALUE 0x70726 TKW_VV_VV_SW 100.0 FORMULA_0442 0.0 3.299999952316284 FORMAT "%5.2" /end CHARACTERISTIC
/begin CHARACTERISTIC K_AUSS_LP_MIN_BEGR "Minimalbegrenzung Aussetzer-Integralschwelle." VALUE 0x70722 TKW_VV_VV_SW 100.0 FORMULA_0227 0.0 4.0 FORMAT "%5.2" /end CHARACTERISTIC
/begin CHARACTERISTIC K_AUSS_LP_MIN_NV_TREPP "Stufe fuer zuruecklernen von auss_lp_min_sa_max_nv." VALUE 0x7072A TKW_VV_VV_SW 100.0 FORMULA_0564 0.0 3.299999952316284 FORMAT "%7.4" /end CHARACTERISTIC
/begin CHARACTERISTIC K_AUSS_LP_MIN_SA_MAX_INI "Initialwert vom max Offset im Aussetzerfenster bei SA." VALUE 0x70768 TKW_VV_VV_SW 100.0 FORMULA_0442 0.0 3.299999952316284 FORMAT "%5.2" /end CHARACTERISTIC
/begin CHARACTERISTIC K_AUSS_LP_NV_OFFSET "Offset zu auss_lp_min_sa_max_nv." VALUE 0x70728 TKW_VV_VV_SW 100.0 FORMULA_0442 0.0 3.299999952316284 FORMAT "%5.2" /end CHARACTERISTIC
/begin CHARACTERISTIC K_AUSS_MAX_OFFSET_CFG "Schalter Minimalwertbegrenzung" VALUE 0x7072D TKW_VV_VV_UB 100.0 FORMULA_0566 0.0 255.0 /end CHARACTERISTIC
/begin CHARACTERISTIC K_AUSS_MIN_LAM "Minimal zul. Lambda" VALUE 0x70748 TKW_VV_VV_UW 100.0 FORMULA_0025 0.0 3.999000072479248 FORMAT "%6.3" /end CHARACTERISTIC
/begin CHARACTERISTIC K_AUSS_NS_MAX_ASP "Anzahl Arbeitspiele nach Start zur Aktivierung der Nebenschlusserkennung." VALUE 0x7074A TKW_VV_VV_UW 100.0 FORMULA_0010 0.0 65535.0 /end CHARACTERISTIC
/begin CHARACTERISTIC K_AUSS_NS_TIME_MAX_0 "Maximal zulaessige Nebenschlusszeit im Aussetzerfenster." VALUE 0x70736 TKW_VV_VV_UW 100.0 FORMULA_0446 0.0 24.57600021362305 FORMAT "%5.2" /end CHARACTERISTIC
/begin CHARACTERISTIC K_AUSS_NS_TIME_MAX_1 "Maximal zulaessige Nebenschlusszeit im Aussetzerfenster." VALUE 0x70738 TKW_VV_VV_UW 100.0 FORMULA_0446 0.0 24.57600021362305 FORMAT "%5.2" /end CHARACTERISTIC
/begin CHARACTERISTIC K_AUSS_NS_TIME_MAX_2 "Maximal zulaessige Nebenschlusszeit im Aussetzerfenster." VALUE 0x7073A TKW_VV_VV_UW 100.0 FORMULA_0446 0.0 24.57600021362305 FORMAT "%5.2" /end CHARACTERISTIC
/begin CHARACTERISTIC K_AUSS_NS_TIME_MAX_3 "Maximal zulaessige Nebenschlusszeit im Aussetzerfenster." VALUE 0x7073C TKW_VV_VV_UW 100.0 FORMULA_0446 0.0 24.57600021362305 FORMAT "%5.2" /end CHARACTERISTIC
/begin CHARACTERISTIC K_AUSS_NS_TIME_MAX_4 "Maximal zulaessige Nebenschlusszeit im Aussetzerfenster." VALUE 0x7073E TKW_VV_VV_UW 100.0 FORMULA_0446 0.0 24.57600021362305 FORMAT "%5.2" /end CHARACTERISTIC
/begin CHARACTERISTIC K_AUSS_NS_TIME_MAX_5 "Maximal zulaessige Nebenschlusszeit im Aussetzerfenster." VALUE 0x70740 TKW_VV_VV_UW 100.0 FORMULA_0446 0.0 24.57600021362305 FORMAT "%5.2" /end CHARACTERISTIC
/begin CHARACTERISTIC K_AUSS_NS_TIME_MAX_6 "Maximal zulaessige Nebenschlusszeit im Aussetzerfenster." VALUE 0x70742 TKW_VV_VV_UW 100.0 FORMULA_0446 0.0 24.57600021362305 FORMAT "%5.2" /end CHARACTERISTIC
/begin CHARACTERISTIC K_AUSS_NS_TIME_MAX_7 "Maximal zulaessige Nebenschlusszeit im Aussetzerfenster." VALUE 0x70744 TKW_VV_VV_UW 100.0 FORMULA_0446 0.0 24.57600021362305 FORMAT "%5.2" /end CHARACTERISTIC
/begin CHARACTERISTIC K_AUSS_NS_TIME_MAX_8 "Maximal zulaessige Nebenschlusszeit im Aussetzerfenster." VALUE 0x70746 TKW_VV_VV_UW 100.0 FORMULA_0446 0.0 24.57600021362305 FORMAT "%5.2" /end CHARACTERISTIC
/begin CHARACTERISTIC K_AUSS_OBD_ABG_1 "Schwelle Aussetzer Abgas 1.Intervall." VALUE 0x7072F TKW_VV_VV_UB 100.0 FORMULA_0003 0.0 255.0 /end CHARACTERISTIC
/begin CHARACTERISTIC K_AUSS_OBD_ABG_4 "Schwelle Aussetzer je 1000er Intervall." VALUE 0x70730 TKW_VV_VV_UB 100.0 FORMULA_0003 0.0 255.0 /end CHARACTERISTIC
/begin CHARACTERISTIC K_AUSS_OBD_ABG_WORST_CYL "Schwelle schlechtester Zylinder." VALUE 0x70766 TKW_VV_VV_SW 100.0 FORMULA_0561 0.0 199.9938049316406 FORMAT "%5.2" /end CHARACTERISTIC
/begin CHARACTERISTIC K_AUSS_OBD_CFG "Schalter Freigabe Aussetzererkennung: 0 = Aus; 1 = Aktiv" VALUE 0x7072C TKW_VV_VV_UB 100.0 FORMULA_0565 0.0 1.0 /end CHARACTERISTIC
/begin CHARACTERISTIC K_AUSS_OBD_N_MAX "Obere Aktivierungsdrehzahlschwelle." VALUE 0x70754 TKW_VV_VV_SW 100.0 FORMULA_0006 0.0 10000.0 /end CHARACTERISTIC
/begin CHARACTERISTIC K_AUSS_OBD_N_MIN "Untere Aktivierungsdrehzahlschwelle." VALUE 0x70756 TKW_VV_VV_SW 100.0 FORMULA_0006 0.0 10000.0 /end CHARACTERISTIC
/begin CHARACTERISTIC K_AUSS_OBD_RATE_ABG_ZYL "Rate Aussetzer je Zylinder Abgas." VALUE 0x7072E TKW_VV_VV_UB 100.0 FORMULA_0003 0.0 255.0 /end CHARACTERISTIC
/begin CHARACTERISTIC K_AUSS_OBD_SA_CNT "Anzahl der SA-Bereiche fuer Wiedereinsetzen." VALUE 0x70731 TKW_VV_VV_UB 100.0 FORMULA_0003 0.0 255.0 /end CHARACTERISTIC
/begin CHARACTERISTIC K_AUSS_OBD_SA_T_MIN "Min. Dauer fuer SA-Bereiche fuer Wiedereinsetzen." VALUE 0x70732 TKW_VV_VV_UB 100.0 FORMULA_0492 0.0 25.5 /end CHARACTERISTIC
/begin CHARACTERISTIC K_AUSS_OBD_SUM_KAT "Schwelle Katschaedigen." VALUE 0x7075C TKW_VV_VV_UW 100.0 FORMULA_0563 0.0 257.0 FORMAT "%5.2" /end CHARACTERISTIC
/begin CHARACTERISTIC K_AUSS_OBD_T_IDLE "Zeit seit Deaktivierungsbedingung." VALUE 0x70758 TKW_VV_VV_UW 100.0 FORMULA_0021 0.0 655.0 FORMAT "%5.2" /end CHARACTERISTIC
/begin CHARACTERISTIC K_AUSS_OBD_T_MIN_LAM "Maximale Abschaltzeit wegen Lamda-Unterschreitung." VALUE 0x7075A TKW_VV_VV_UW 100.0 FORMULA_0021 0.0 655.0 FORMAT "%5.2" /end CHARACTERISTIC
/begin CHARACTERISTIC K_AUSS_OBD_WICHT_EV "Gewichtungsfaktors fuer Einspritzauss." VALUE 0x70752 TKW_VV_VV_UW 100.0 FORMULA_0568 0.0 255.9960021972656 FORMAT "%5.2" /end CHARACTERISTIC
/begin CHARACTERISTIC K_AUSS_OBD_WICHT_NS "Gewichtungsfaktors fuer Nebenschluss." VALUE 0x70750 TKW_VV_VV_UW 100.0 FORMULA_0568 0.0 255.9960021972656 FORMAT "%5.2" /end CHARACTERISTIC
/begin CHARACTERISTIC K_AUSS_OBD_WICHT_SPARK "Gewichtungsfaktors fuer Zuendauss." VALUE 0x7074E TKW_VV_VV_UW 100.0 FORMULA_0568 0.0 255.9960021972656 FORMAT "%5.2" /end CHARACTERISTIC
/begin CHARACTERISTIC K_AUSS_RF_TAU "Tau fuer auss_rf_fil" VALUE 0x70733 TKW_VV_VV_UB 100.0 FORMULA_0455 1.009999960660934e-002 2.559999942779541 /end CHARACTERISTIC
/begin CHARACTERISTIC K_AUSS_SPARK_LEV "Schwelle Ausschwingen Zuendspule." VALUE 0x70762 TKW_VV_VV_SW 100.0 FORMULA_0569 0.0 99.97550201416016 FORMAT "%5.2" /end CHARACTERISTIC
/begin CHARACTERISTIC K_AUSS_SPARK_SIZE "Breite erstes Ausschwingen Zuendspule." VALUE 0x70760 TKW_VV_VV_SW 100.0 FORMULA_0560 4.0 508.0 /end CHARACTERISTIC
/begin CHARACTERISTIC K_AUSS_SPARK_TIME_MIN "Min zulaessige Funkenbrenndauer bei Verbrennungsaussetzer" VALUE 0x70720 TKW_VV_VV_SW 100.0 FORMULA_0445 0.0 4.681000232696533 FORMAT "%5.2" /end CHARACTERISTIC
/begin CHARACTERISTIC K_AUSS_SPARK_TIME_TAU "Tau fuer auss_spark_time_fil" VALUE 0x70734 TKW_VV_VV_UB 100.0 FORMULA_0567 4.000000189989805e-003 0.9959999918937683 /end CHARACTERISTIC
/begin CHARACTERISTIC K_DEBUG_READ_ADR "Read Address" VALUE 0x70C30 TKW_VV_VV_UL 100.0 FORMULA_0044 0.0 4294967295.0 FORMAT "%5.2" /end CHARACTERISTIC
/begin CHARACTERISTIC K_DEBUG_RW_LENGTH "Read/-Write Length" VALUE 0x70C3C TKW_VV_VV_UB 100.0 FORMULA_0037 0.0 255.0 /end CHARACTERISTIC
/begin CHARACTERISTIC K_DEBUG_WRITE_ADR "Write Address" VALUE 0x70C34 TKW_VV_VV_UL 100.0 FORMULA_0044 0.0 4294967295.0 FORMAT "%5.2" /end CHARACTERISTIC
/begin CHARACTERISTIC K_DEBUG_WRITE_VALUE "Write VALUE" VALUE 0x70C38 TKW_VV_VV_UL 100.0 FORMULA_0044 0.0 4294967295.0 FORMAT "%5.2" /end CHARACTERISTIC
/begin CHARACTERISTIC K_DIAG_TR_MAX_ERR "erlaubte Fehler bis zum Eintrag als SG-Interner" VALUE 0x70C40 TKW_VV_VV_UB 100.0 FORMULA_0003 0.0 255.0 /end CHARACTERISTIC
/begin CHARACTERISTIC K_DIAG_TR_UB_MIN "UB-Schwelle ab der die Treiberdiagnose beginnen" VALUE 0x70C3E TKW_VV_VV_SW 100.0 FORMULA_0008 0.0 28.0 FORMAT "%4.1" /end CHARACTERISTIC
/begin CHARACTERISTIC K_DKG_CFG_EINGR "Konfiguration CAN-Eingriff" VALUE 0x70C43 TKW_VV_VV_UB 100.0 FORMULA_0574 0.0 255.0 /end CHARACTERISTIC
/begin CHARACTERISTIC K_DKG_KRIECH_RAMPE "Steigung Kriech-Rampe" VALUE 0x70C4C TKW_VV_VV_SW 100.0 FORMULA_0562 -5000.0 5000.0 /end CHARACTERISTIC
/begin CHARACTERISTIC K_DKG_KUPP_KRIECH_MAX "max. Kriechmoment der Kupplung" VALUE 0x70C44 TKW_VV_VV_SW 100.0 FORMULA_0009 -100.0 1000.0 FORMAT "%4.1" /end CHARACTERISTIC
/begin CHARACTERISTIC K_DKG_KUPP_SCHLEIF_MAX "max. Verlustmoment der Kupplung" VALUE 0x70C46 TKW_VV_VV_SW 100.0 FORMULA_0009 -100.0 1000.0 FORMAT "%4.1" /end CHARACTERISTIC
/begin CHARACTERISTIC K_DKG_MD_ML_RAMPE "Steigung ML-Rampe" VALUE 0x70C48 TKW_VV_VV_SW 100.0 FORMULA_0562 -5000.0 5000.0 /end CHARACTERISTIC
/begin CHARACTERISTIC K_DKG_MD_TZ_RAMPE "Steigung TZ-Rampe" VALUE 0x70C4A TKW_VV_VV_SW 100.0 FORMULA_0562 -5000.0 5000.0 /end CHARACTERISTIC
/begin CHARACTERISTIC K_DKG_SPERR_ST "Konfiguration Sperre" VALUE 0x70C42 TKW_VV_VV_UB 100.0 FORMULA_0573 0.0 255.0 /end CHARACTERISTIC
/begin CHARACTERISTIC K_DKG_T_WAIT "Wartezeit vor DKG-Rampe" VALUE 0x70C4E TKW_VV_VV_UW 100.0 FORMULA_0109 0.0 10.0 FORMAT "%5.2" /end CHARACTERISTIC
/begin CHARACTERISTIC K_N_E2_DELTA "Max zulaessige Drehzahl fuer Ebene 2" VALUE 0x7B4D2 TKW_VV_VV_SW 100.0 FORMULA_0006 0.0 10000.0 /end CHARACTERISTIC
/begin CHARACTERISTIC K_N_E2_T_MAX "Maximale Fehlerzeit der Drehzahl fuer Ebene 2" VALUE 0x7B4D4 TKW_VV_VV_UW 100.0 FORMULA_0021 0.0 655.0 FORMAT "%5.2" /end CHARACTERISTIC
/begin CHARACTERISTIC K_N_MIN_FREEZE "Minimale Eintrittsdrehzahl fuer Drehzahl-Freeze" VALUE 0x78324 TKW_VV_VV_SW 100.0 FORMULA_0006 0.0 10000.0 /end CHARACTERISTIC
/begin CHARACTERISTIC K_N_OBERGRENZE "Plausibilitaetsgrenze fuer die n-Erfassung" VALUE 0x78322 TKW_VV_VV_SW 100.0 FORMULA_0006 0.0 20000.0 /end CHARACTERISTIC
/begin CHARACTERISTIC K_N_ZEIT_STOERUNG "Einfrierzeit Drehzahlerfassung nach TPU Stoerung" VALUE 0x78320 TKW_VV_VV_SB 100.0 FORMULA_0306 0.0 1.269999980926514 /end CHARACTERISTIC
/begin CHARACTERISTIC K_UB_DIAG_GRAD_INT_MAX "Diagnoseschwelle Integreal" VALUE 0x7AE66 TKW_VV_VV_SW 100.0 FORMULA_0261 0.0 50.0 FORMAT "%6.3" /end CHARACTERISTIC
/begin CHARACTERISTIC K_UB_DIAG_KL87_MAX_SPERRE "Max. Sperrzeit der Diagnose nach KL87 aus" VALUE 0x7AE6B TKW_VV_VV_UB 100.0 FORMULA_0584 5.0 1275.0 /end CHARACTERISTIC
/begin CHARACTERISTIC K_UB_DIAG_MAX "Obere Grenze Bordspannung" VALUE 0x7AE5E TKW_VV_VV_SW 100.0 FORMULA_0261 0.0 28.0 FORMAT "%6.3" /end CHARACTERISTIC
/begin CHARACTERISTIC K_UB_DIAG_MIN "Untere Grenze Bordspannung" VALUE 0x7AE5C TKW_VV_VV_SW 100.0 FORMULA_0261 0.0 28.0 FORMAT "%6.3" /end CHARACTERISTIC
/begin CHARACTERISTIC K_UB_ERSATZ "Ersatzwert Bordspannung" VALUE 0x7AE62 TKW_VV_VV_SW 100.0 FORMULA_0261 0.0 28.0 FORMAT "%6.3" /end CHARACTERISTIC
/begin CHARACTERISTIC K_UB_GRAD_INT_REDUKTION "Integralreduktion pro Druchlauf" VALUE 0x7AE68 TKW_VV_VV_SW 100.0 FORMULA_1032 0.0 50.0 FORMAT "%6.3" /end CHARACTERISTIC
/begin CHARACTERISTIC K_UB_GRAD_MAX "Endanschlag des Integrals" VALUE 0x7AE64 TKW_VV_VV_SW 100.0 FORMULA_0261 0.0 50.0 FORMAT "%6.3" /end CHARACTERISTIC
/begin CHARACTERISTIC K_UB_ML_MIN "Untere Grenze Bordspannung bei laufendem Motor" VALUE 0x7AE60 TKW_VV_VV_SW 100.0 FORMULA_0261 0.0 28.0 FORMAT "%6.3" /end CHARACTERISTIC
/begin CHARACTERISTIC K_UB_START_TIME "Ansprechzeit der Plausibilitaet" VALUE 0x7AE6A TKW_VV_VV_UB 100.0 FORMULA_0214 0.0 255.0 /end CHARACTERISTIC
/begin CHARACTERISTIC K_UB_TAU "Filterkonstante Bordspannungserfassung" VALUE 0x7AE5A TKW_VV_VV_UB 100.0 FORMULA_0470 5.100000184029341e-003 1.279999971389771 /end CHARACTERISTIC
/begin CHARACTERISTIC K_UB_TAU_START "Filterkonstante Bordspannungserfassung beim Start" VALUE 0x7AE5B TKW_VV_VV_UB 100.0 FORMULA_0470 5.100000184029341e-003 1.279999971389771 /end CHARACTERISTIC
/begin CHARACTERISTIC KF_AUSS_LP_INT_MIN "Minimales Ionenleitwertintegral zur Aussetzererkennung." MAP 0x709A6 TKF_SW_SW_SW 100.0 FORMULA_0227 0.0 4.0 FORMAT "%5.2" /begin AXIS_DESCR STD_AXIS n FORMULA_0006 16 0.0 10000.0 MAX_GRAD 0.0 /end AXIS_DESCR
 /begin AXIS_DESCR STD_AXIS rf FORMULA_0007 10 0.0 2.0 MAX_GRAD 0.0 FORMAT "%6.3" /end AXIS_DESCR
/end CHARACTERISTIC
/begin CHARACTERISTIC KF_AUSS_OBD_DTZ_MAX "Maximal zul. delta Zuendwinkel." MAP 0x70B60 TKF_SW_SW_SW 100.0 FORMULA_0102 -50.0 60.0 FORMAT "%4.1" /begin AXIS_DESCR STD_AXIS n FORMULA_0006 8 0.0 10000.0 MAX_GRAD 0.0 /end AXIS_DESCR
 /begin AXIS_DESCR STD_AXIS rf FORMULA_0007 5 0.0 2.0 MAX_GRAD 0.0 FORMAT "%6.3" /end AXIS_DESCR
/end CHARACTERISTIC
/begin CHARACTERISTIC KF_AUSS_OBD_WICHT_KAT "Gewichtung Katschaedigen." MAP 0x70B1C TKF_SW_SW_UB 100.0 FORMULA_0493 0.0 1.0 /begin AXIS_DESCR STD_AXIS n FORMULA_0006 8 0.0 10000.0 MAX_GRAD 0.0 /end AXIS_DESCR
 /begin AXIS_DESCR STD_AXIS rf FORMULA_0007 5 0.0 2.0 MAX_GRAD 0.0 FORMAT "%6.3" /end AXIS_DESCR
/end CHARACTERISTIC
/begin CHARACTERISTIC KF_AUSS_SPARK_TIME_MAX "Max zulaessige Funkenbrenndauer." MAP 0x70986 TKF_SW_SW_SW 100.0 FORMULA_0445 0.0 4.681000232696533 FORMAT "%5.2" /begin AXIS_DESCR STD_AXIS n FORMULA_0006 3 0.0 10000.0 MAX_GRAD 0.0 /end AXIS_DESCR
 /begin AXIS_DESCR STD_AXIS rf FORMULA_0007 3 0.0 2.0 MAX_GRAD 0.0 FORMAT "%6.3" /end AXIS_DESCR
/end CHARACTERISTIC
/begin CHARACTERISTIC KF_AUSS_SPARK_TIME_MIN "Min zulaessige Funkenbrenndauer." MAP 0x70966 TKF_SW_SW_SW 100.0 FORMULA_0445 0.0 4.681000232696533 FORMAT "%5.2" /begin AXIS_DESCR STD_AXIS n FORMULA_0006 3 0.0 10000.0 MAX_GRAD 0.0 /end AXIS_DESCR
 /begin AXIS_DESCR STD_AXIS rf FORMULA_0007 3 0.0 2.0 MAX_GRAD 0.0 FORMAT "%6.3" /end AXIS_DESCR
/end CHARACTERISTIC
/begin CHARACTERISTIC KF_AUSS_TZ_OFFS "Ausetzerfensterstart (Offsetzeit nach Zuendzeitpunkt)." MAP 0x70BCC TKF_SW_SW_SW 100.0 FORMULA_0446 4.000000189989805e-003 8.187999725341797 FORMAT "%5.2" /begin AXIS_DESCR STD_AXIS n FORMULA_0006 6 0.0 10000.0 MAX_GRAD 0.0 /end AXIS_DESCR
 /begin AXIS_DESCR STD_AXIS rf FORMULA_0007 6 0.0 2.0 MAX_GRAD 0.0 FORMAT "%6.3" /end AXIS_DESCR
/end CHARACTERISTIC
/begin CHARACTERISTIC KL_AQ_ABS_DK "Oeffnungsquerschnitt DK (Bank)" CURVE 0x702DE TKL_SW_VV_UW 100.0 FORMULA_0143 0.0 6500.0 FORMAT "%4.1"
 /begin AXIS_DESCR STD_AXIS wdk FORMULA_0001 8 -10.0 120.0 MAX_GRAD 0.0 FORMAT "%4.1" /end AXIS_DESCR
/end CHARACTERISTIC
/begin CHARACTERISTIC KL_AQ_ABS_DK_ABW_MAX "Schwelle fuer DK eingeregelt" CURVE 0x70328 TKL_UW_VV_UW 100.0 FORMULA_0143 0.0 6500.0 FORMAT "%4.1"
 /begin AXIS_DESCR STD_AXIS aq_soll_dk FORMULA_0143 4 0.0 6500.0 MAX_GRAD 0.0 FORMAT "%4.1" /end AXIS_DESCR
/end CHARACTERISTIC
/begin CHARACTERISTIC KL_AQ_ABS_LLS "Oeffnungquerschnitt LLS (Bank)" CURVE 0x702BC TKL_SW_VV_UW 100.0 FORMULA_0143 0.0 6500.0 FORMAT "%4.1"
 /begin AXIS_DESCR STD_AXIS wdk FORMULA_0001 8 -10.0 120.0 MAX_GRAD 0.0 FORMAT "%4.1" /end AXIS_DESCR
/end CHARACTERISTIC
/begin CHARACTERISTIC KL_AQ_ABS_LLS_ABW_MAX "Schwelle fuer LLS eingeregelt" CURVE 0x70316 TKL_UW_VV_UW 100.0 FORMULA_0143 0.0 6500.0 FORMAT "%4.1"
 /begin AXIS_DESCR STD_AXIS aq_soll_lls FORMULA_0143 4 0.0 6500.0 MAX_GRAD 0.0 FORMAT "%4.1" /end AXIS_DESCR
/end CHARACTERISTIC
/begin CHARACTERISTIC KL_AQ_IST_RF_TAU "Tau fuer aq_rf Filter" CURVE 0x70300 TKL_SW_VV_UW 100.0 FORMULA_0472 4.999999888241291e-003 327.6700134277344 FORMAT "%6.3"
 /begin AXIS_DESCR STD_AXIS egas_aq_soll_grad FORMULA_0020 5 -30000.0 30000.0 MAX_GRAD 0.0 /end AXIS_DESCR
/end CHARACTERISTIC
/begin CHARACTERISTIC KL_AQ_MAX "MAX AQ" CURVE 0x7033A TKL_SW_VV_UW 100.0 FORMULA_0143 0.0 6500.0 FORMAT "%4.1" /begin AXIS_DESCR STD_AXIS n FORMULA_0006 10 0.0 10000.0 MAX_GRAD 0.0 /end AXIS_DESCR /end CHARACTERISTIC
/begin CHARACTERISTIC KL_AUSS_INT_DTZ_FAKTOR "Korrekturfaktor ueber Rueckziehwinkel." CURVE 0x708D8 TKL_SW_VV_SW 100.0 FORMULA_0561 0.0 199.9938049316406 FORMAT "%5.2"
 /begin AXIS_DESCR STD_AXIS tz FORMULA_0102 8 -50.0 60.0 MAX_GRAD 0.0 FORMAT "%4.1" /end AXIS_DESCR
/end CHARACTERISTIC
/begin CHARACTERISTIC KL_AUSS_INT_TMOT_FAKTOR "Korrekturfaktor ueber Tmot." CURVE 0x708B6 TKL_SW_VV_SW 100.0 FORMULA_0561 0.0 199.9938049316406 FORMAT "%5.2"
 /begin AXIS_DESCR STD_AXIS tmot FORMULA_0023 8 -50.0 170.0 MAX_GRAD 0.0 FORMAT "%4.1" /end AXIS_DESCR
/end CHARACTERISTIC
/begin CHARACTERISTIC KL_AUSS_MIN_AVG_SAMPLES "Anzahl Messpunkte Minimalintegral." CURVE 0x7094C TKL_SW_VV_UW 100.0 FORMULA_0560 4.0 4092.0 /begin AXIS_DESCR STD_AXIS n FORMULA_0006 6 0.0 10000.0 MAX_GRAD 0.0 /end AXIS_DESCR /end CHARACTERISTIC
/begin CHARACTERISTIC KL_AUSS_OBD_MD_MIN "Minimales Moment an der Kupplung zur Aktivierung." CURVE 0x708FA TKL_SW_VV_SW 100.0 FORMULA_0009 -1000.0 1000.0 FORMAT "%4.1" /begin AXIS_DESCR STD_AXIS n FORMULA_0006 8 0.0 10000.0 MAX_GRAD 0.0 /end AXIS_DESCR /end CHARACTERISTIC
/begin CHARACTERISTIC KL_AUSS_OBD_NEG_MD_DYN "Minimale zul. neg. Dynamik." CURVE 0x70868 TKL_SW_VV_SW 100.0 FORMULA_0562 -5000.0 5000.0
 /begin AXIS_DESCR STD_AXIS rf FORMULA_0007 6 0.0 2.0 MAX_GRAD 0.0 FORMAT "%6.3" /end AXIS_DESCR
/end CHARACTERISTIC
/begin CHARACTERISTIC KL_AUSS_OBD_NEG_MD_DYN_KH "Minimale zul. neg. Dynamik im Katheizen." CURVE 0x7089C TKL_SW_VV_SW 100.0 FORMULA_0562 -5000.0 5000.0
 /begin AXIS_DESCR STD_AXIS rf FORMULA_0007 6 0.0 2.0 MAX_GRAD 0.0 FORMAT "%6.3" /end AXIS_DESCR
/end CHARACTERISTIC
/begin CHARACTERISTIC KL_AUSS_OBD_POS_MD_DYN "Maximal zul. pos. Dynamik." CURVE 0x7084E TKL_SW_VV_SW 100.0 FORMULA_0562 -5000.0 5000.0
 /begin AXIS_DESCR STD_AXIS rf FORMULA_0007 6 0.0 2.0 MAX_GRAD 0.0 FORMAT "%6.3" /end AXIS_DESCR
/end CHARACTERISTIC
/begin CHARACTERISTIC KL_AUSS_OBD_POS_MD_DYN_KH "Maximal zul. pos. Dynamik im Katheizen." CURVE 0x70882 TKL_SW_VV_SW 100.0 FORMULA_0562 -5000.0 5000.0
 /begin AXIS_DESCR STD_AXIS rf FORMULA_0007 6 0.0 2.0 MAX_GRAD 0.0 FORMAT "%6.3" /end AXIS_DESCR
/end CHARACTERISTIC
/begin CHARACTERISTIC KL_AUSS_OBD_RF_MIN "Minimale RF-Aktivierungsschwelle." CURVE 0x7091C TKL_SW_VV_SW 100.0 FORMULA_0007 -1.0 2.0 FORMAT "%6.3" /begin AXIS_DESCR STD_AXIS n FORMULA_0006 8 0.0 10000.0 MAX_GRAD 0.0 /end AXIS_DESCR /end CHARACTERISTIC
/begin CHARACTERISTIC KL_AUSS_OBD_TZ_GRAD "Deaktivierungsschwelle fuer tz_grad." CURVE 0x70814 TKL_SW_VV_SW 100.0 FORMULA_0231 -100.0 100.0 FORMAT "%6.3" /begin AXIS_DESCR STD_AXIS n FORMULA_0006 4 0.0 10000.0 MAX_GRAD 0.0 /end AXIS_DESCR /end CHARACTERISTIC
/begin CHARACTERISTIC KL_AUSS_OBD_WICHT_KAT "Gewichtung Kattemperatur fuer Katschaedigung." CURVE 0x7093E TKL_SW_VV_UB 100.0 FORMULA_0493 0.0 1.0
 /begin AXIS_DESCR STD_AXIS tabg_mkat FORMULA_0023 4 -50.0 1250.0 MAX_GRAD 0.0 FORMAT "%4.1" /end AXIS_DESCR
/end CHARACTERISTIC
/begin CHARACTERISTIC KL_AUSS_PUMG_FAKTOR "Korrektur ueber pumg." CURVE 0x70826 TKL_SW_VV_SW 100.0 FORMULA_0561 0.0 199.9938049316406 FORMAT "%5.2"
 /begin AXIS_DESCR STD_AXIS pumg FORMULA_0075 4 400.0 1200.0 MAX_GRAD 0.0 FORMAT "%4.1" /end AXIS_DESCR
/end CHARACTERISTIC
/begin CHARACTERISTIC KL_AUSS_START_FAKTOR "Korrekturfaktor waerend Startphase von auss_lp_int_min." CURVE 0x70838 TKL_SW_VV_SW 100.0 FORMULA_0561 0.0 199.9938049316406 FORMAT "%5.2"
 /begin AXIS_DESCR STD_AXIS tmot FORMULA_0023 5 -50.0 170.0 MAX_GRAD 0.0 FORMAT "%4.1" /end AXIS_DESCR
/end CHARACTERISTIC
/begin MEASUREMENT afz "Laengsbeschleunigung Fahrzeug" SWORD FORMULA_0123 0 0.0 -50.0 50.0 READ_WRITE ECU_ADDRESS 0x3FB1C4 /end MEASUREMENT
/begin MEASUREMENT afz_a0_cnt "Zaehler zum Starten/Beenden der Adaption" UBYTE FORMULA_0003 0 0.0 0.0 255.0 READ_WRITE ECU_ADDRESS 0x3FB1BE /end MEASUREMENT
/begin MEASUREMENT afz_a0_sum "Zwischensumme zum Berechnen des Adaptionswertes" SWORD FORMULA_0010 0 0.0 -32768.0 32767.0 READ_WRITE ECU_ADDRESS 0x3FB1C0 /end MEASUREMENT
/begin MEASUREMENT afz_ad "AD-Wert fuer Laengsbeschleunigung Fahrzeug" SWORD FORMULA_0114 0 0.0 0.0 1023.0 READ_WRITE ECU_ADDRESS 0x3FB1B4 /end MEASUREMENT
/begin MEASUREMENT afz_berech "Laengsbeschleunigung Fahrzeug, berechnet" SWORD FORMULA_0123 0 0.0 -50.0 50.0 READ_WRITE ECU_ADDRESS 0x3FB1BC /end MEASUREMENT
/begin MEASUREMENT afz_can_ax_fil "Laengsbeschleunigung DSC, gefiltert" SWORD FORMULA_0123 0 0.0 -50.0 50.0 READ_WRITE ECU_ADDRESS 0x3FB1C2 /end MEASUREMENT
/begin MEASUREMENT afz_diag_timer "Diagnosetimer Laengsbeschleunigung Fahrzeug" UWORD FORMULA_0021 0 0.0 0.0 655.0 READ_WRITE ECU_ADDRESS 0x3FB1B8 /end MEASUREMENT
/begin MEASUREMENT afz_fil "Gefilterter Messwert der Laengsbeschleunigung Fahrzeug" SWORD FORMULA_0454 0 0.0 -50.0 50.0 READ_WRITE ECU_ADDRESS 0x3FB1BA /end MEASUREMENT
/begin MEASUREMENT afz_roh "entspr. Versorgungsspg korrigierte Laengsbeschleunigung" SWORD FORMULA_0114 0 0.0 0.0 1023.0 READ_WRITE ECU_ADDRESS 0x3FB1B6 /end MEASUREMENT
/begin MEASUREMENT ag_tz_anz "Zaehler der unmittelbar aufeinanderfolgenden Ausblendungen." UWORD FORMULA_0010 0 0.0 0.0 65535.0 READ_WRITE ECU_ADDRESS 0x3FB1D0 /end MEASUREMENT
/begin MEASUREMENT ag_tz_anz_ctrl "Anzahl der unmittelbar aufeinanderfolgenden Ausblendungen." UWORD FORMULA_0010 0 0.0 0.0 65535.0 READ_WRITE ECU_ADDRESS 0x3FB1CC /end MEASUREMENT
/begin MEASUREMENT ag_tz_cfg_ctrl "Welcher Aussetzergenerator" UBYTE FORMULA_0457 0 0.0 0.0 3.0 READ_WRITE ECU_ADDRESS 0x3FB1C8 /end MEASUREMENT
/begin MEASUREMENT ag_tz_exd_state "Exd-State." UBYTE FORMULA_0456 0 0.0 0.0 255.0 READ_WRITE ECU_ADDRESS 0x3FB1C7 /end MEASUREMENT
/begin MEASUREMENT ag_tz_mask "Status Aussetzergenerator." UWORD FORMULA_0458 0 0.0 0.0 4095.0 READ_WRITE ECU_ADDRESS 0x3FB1D4 /end MEASUREMENT
/begin MEASUREMENT ag_tz_mask_zyl1 "Ausblendung Zylinder 1." UWORD FORMULA_0459 0 0 0.0 255.0 READ_WRITE BIT_MASK 0x1 ECU_ADDRESS 0x3FB1D4 /end MEASUREMENT
/begin MEASUREMENT ag_tz_mask_zyl10 "Ausblendung Zylinder 10." UWORD FORMULA_0468 0 0 0.0 255.0 READ_WRITE BIT_MASK 0x200 ECU_ADDRESS 0x3FB1D4 /end MEASUREMENT
/begin MEASUREMENT ag_tz_mask_zyl2 "Ausblendung Zylinder 2." UWORD FORMULA_0460 0 0 0.0 255.0 READ_WRITE BIT_MASK 0x2 ECU_ADDRESS 0x3FB1D4 /end MEASUREMENT
/begin MEASUREMENT ag_tz_mask_zyl3 "Ausblendung Zylinder 3." UWORD FORMULA_0461 0 0 0.0 255.0 READ_WRITE BIT_MASK 0x4 ECU_ADDRESS 0x3FB1D4 /end MEASUREMENT
/begin MEASUREMENT ag_tz_mask_zyl4 "Ausblendung Zylinder 4." UWORD FORMULA_0462 0 0 0.0 255.0 READ_WRITE BIT_MASK 0x8 ECU_ADDRESS 0x3FB1D4 /end MEASUREMENT
/begin MEASUREMENT ag_tz_mask_zyl5 "Ausblendung Zylinder 5." UWORD FORMULA_0463 0 0 0.0 255.0 READ_WRITE BIT_MASK 0x10 ECU_ADDRESS 0x3FB1D4 /end MEASUREMENT
/begin MEASUREMENT ag_tz_mask_zyl6 "Ausblendung Zylinder 6." UWORD FORMULA_0464 0 0 0.0 255.0 READ_WRITE BIT_MASK 0x20 ECU_ADDRESS 0x3FB1D4 /end MEASUREMENT
/begin MEASUREMENT ag_tz_mask_zyl7 "Ausblendung Zylinder 7." UWORD FORMULA_0465 0 0 0.0 255.0 READ_WRITE BIT_MASK 0x40 ECU_ADDRESS 0x3FB1D4 /end MEASUREMENT
/begin MEASUREMENT ag_tz_mask_zyl8 "Ausblendung Zylinder 8." UWORD FORMULA_0466 0 0 0.0 255.0 READ_WRITE BIT_MASK 0x80 ECU_ADDRESS 0x3FB1D4 /end MEASUREMENT
/begin MEASUREMENT ag_tz_mask_zyl9 "Ausblendung Zylinder 9." UWORD FORMULA_0467 0 0 0.0 255.0 READ_WRITE BIT_MASK 0x100 ECU_ADDRESS 0x3FB1D4 /end MEASUREMENT
/begin MEASUREMENT ag_tz_pause "Zaehler der Arbeitsspiele zwischen Ausblendungen." UWORD FORMULA_0010 0 0.0 0.0 65535.0 READ_WRITE ECU_ADDRESS 0x3FB1D2 /end MEASUREMENT
/begin MEASUREMENT ag_tz_pause_ctrl "Anzahl der Arbeitsspiele zwischen Ausblendungen." UWORD FORMULA_0010 0 0.0 0.0 65535.0 READ_WRITE ECU_ADDRESS 0x3FB1CE /end MEASUREMENT
/begin MEASUREMENT ag_tz_zyl "Naechster Zylinder der ausgeblendet wird." UBYTE FORMULA_0408 0 0.0 1.0 12.0 READ_WRITE ECU_ADDRESS 0x3FB1C6 /end MEASUREMENT
/begin MEASUREMENT ag_tz_zyl_ctrl "Statisches Ausblendmuster." UWORD FORMULA_0010 0 0.0 0.0 65535.0 READ_WRITE ECU_ADDRESS 0x3FB1CA /end MEASUREMENT
/begin MEASUREMENT aq_abs_b1 "Abs. Oeffnungsquerschnitt" UWORD FORMULA_0143 0 0.0 0.0 6500.0 READ_WRITE ECU_ADDRESS 0x3FB1D6 /end MEASUREMENT
/begin MEASUREMENT aq_abs_b2 "Abs. Oeffnungsquerschnitt" UWORD FORMULA_0143 0 0.0 0.0 6500.0 READ_WRITE ECU_ADDRESS 0x3FB1D8 /end MEASUREMENT
/begin MEASUREMENT aq_abs_dk_b1 "Abs. Oeffnungsquerschnitt Drosselklappen" UWORD FORMULA_0143 0 0.0 0.0 6500.0 READ_WRITE ECU_ADDRESS 0x3FB1DE /end MEASUREMENT
/begin MEASUREMENT aq_abs_dk_b2 "Abs. Oeffnungsquerschnitt Drosselklappen" UWORD FORMULA_0143 0 0.0 0.0 6500.0 READ_WRITE ECU_ADDRESS 0x3FB1E0 /end MEASUREMENT
/begin MEASUREMENT aq_abs_lls_b1 "Abs. Oeffnungsquerschnitt Leerlaufsystem" UWORD FORMULA_0143 0 0.0 0.0 6500.0 READ_WRITE ECU_ADDRESS 0x3FB1E2 /end MEASUREMENT
/begin MEASUREMENT aq_abs_lls_b2 "Abs. Oeffnungsquerschnitt Leerlaufsystem" UWORD FORMULA_0143 0 0.0 0.0 6500.0 READ_WRITE ECU_ADDRESS 0x3FB1E4 /end MEASUREMENT
/begin MEASUREMENT aq_abs_max_dk "Max. abs. Oeffnungsquerschnitt Drosselklappen" UWORD FORMULA_0143 0 0.0 0.0 6500.0 READ_WRITE ECU_ADDRESS 0x3FB1E8 /end MEASUREMENT
/begin MEASUREMENT aq_abs_max_lls "Max. abs. Oeffnungsquerschnitt Leerlaufsystem" UWORD FORMULA_0143 0 0.0 0.0 6500.0 READ_WRITE ECU_ADDRESS 0x3FB1E6 /end MEASUREMENT
/begin MEASUREMENT aq_abs_roh_b1 "Abs.roh Oeffnungsquerschnitt ohne sek. Einfluesse" UWORD FORMULA_0143 0 0.0 0.0 6500.0 READ_WRITE ECU_ADDRESS 0x3FB1DA /end MEASUREMENT
/begin MEASUREMENT aq_abs_roh_b2 "Abs.roh Oeffnungsquerschnitt ohne sek. Einfluesse" UWORD FORMULA_0143 0 0.0 0.0 6500.0 READ_WRITE ECU_ADDRESS 0x3FB1DC /end MEASUREMENT
/begin MEASUREMENT aq_max_kf "aq_max_kf aus KF_AQ_MAX" UWORD FORMULA_0143 0 0.0 0.0 6500.0 READ_WRITE ECU_ADDRESS 0x3FB20E /end MEASUREMENT
/begin MEASUREMENT aq_rf_inv_b1 "Istfuellung Korrigiert mit FR+FRA+EGAS_AQ_WL" SWORD FORMULA_0007 0 0.0 0.0 2.0 READ_WRITE ECU_ADDRESS 0x3FB206 /end MEASUREMENT
/begin MEASUREMENT aq_rf_inv_b2 "Istfuellung Korrigiert mit FR+FRA+EGAS_AQ_WL" SWORD FORMULA_0007 0 0.0 0.0 2.0 READ_WRITE ECU_ADDRESS 0x3FB208 /end MEASUREMENT
/begin MEASUREMENT aq_rf_roh_fil_b1 "Fuellung aus Inv. Ipol gefiltert und rg korregiert" SWORD FORMULA_0007 0 0.0 0.0 2.0 READ_WRITE ECU_ADDRESS 0x3FB1F2 /end MEASUREMENT
/begin MEASUREMENT aq_rf_roh_fil_b2 "Fuellung aus Inv. Ipol gefiltert und rg korregiert" SWORD FORMULA_0007 0 0.0 0.0 2.0 READ_WRITE ECU_ADDRESS 0x3FB1F4 /end MEASUREMENT
/begin MEASUREMENT aq_rf_roh_inv_b1 "Fuellung aus Inv. Ipol.nicht gefiltert und keine korrektur" SWORD FORMULA_0007 0 0.0 0.0 2.0 READ_WRITE ECU_ADDRESS 0x3FB202 /end MEASUREMENT
/begin MEASUREMENT aq_rf_roh_inv_b2 "Fuellung aus Inv. Ipol.nicht gefiltert und keine korrektur" SWORD FORMULA_0007 0 0.0 0.0 2.0 READ_WRITE ECU_ADDRESS 0x3FB204 /end MEASUREMENT
/begin MEASUREMENT aq_rf_van_inv_b1 "Istfuellung Korrigiert mit FR+FRA+EGAS_AQ_WL+VANOS" SWORD FORMULA_0007 0 0.0 0.0 2.0 READ_WRITE ECU_ADDRESS 0x3FB20A /end MEASUREMENT
/begin MEASUREMENT aq_rf_van_inv_b2 "Istfuellung Korrigiert mit FR+FRA+EGAS_AQ_WL+VANOS" SWORD FORMULA_0007 0 0.0 0.0 2.0 READ_WRITE ECU_ADDRESS 0x3FB20C /end MEASUREMENT
/begin MEASUREMENT aq_tau_b1 "Filterkonstante fuer dr_rel und aq_rf" UWORD FORMULA_0469 0 0.0 4.999999888241291e-003 327.6700134277344 READ_WRITE ECU_ADDRESS 0x3FB1FA /end MEASUREMENT
/begin MEASUREMENT aq_tau_b2 "Filterkonstante fuer dr_rel und aq_rf" UWORD FORMULA_0469 0 0.0 4.999999888241291e-003 327.6700134277344 READ_WRITE ECU_ADDRESS 0x3FB1FC /end MEASUREMENT
/begin MEASUREMENT auss_asp_sa_cnt "Arbeitspielzaehler waehren SA." UWORD FORMULA_0010 0 0.0 0.0 65535.0 READ_WRITE ECU_ADDRESS 0x3FB388 /end MEASUREMENT
/begin MEASUREMENT auss_dtz_st "Status delta Rueckziehwinkel." UWORD FORMULA_0549 0 0.0 0.0 4095.0 READ_WRITE ECU_ADDRESS 0x3FB382 /end MEASUREMENT
/begin MEASUREMENT auss_dtz_st_zyl1 "dtz Zylinder 1." UWORD FORMULA_0550 0 0 0.0 255.0 READ_WRITE BIT_MASK 0x1 ECU_ADDRESS 0x3FB382 /end MEASUREMENT
/begin MEASUREMENT auss_dtz_st_zyl10 "dtz Zylinder 10." UWORD FORMULA_0559 0 0 0.0 255.0 READ_WRITE BIT_MASK 0x200 ECU_ADDRESS 0x3FB382 /end MEASUREMENT
/begin MEASUREMENT auss_dtz_st_zyl2 "dtz Zylinder 2." UWORD FORMULA_0551 0 0 0.0 255.0 READ_WRITE BIT_MASK 0x2 ECU_ADDRESS 0x3FB382 /end MEASUREMENT
/begin MEASUREMENT auss_dtz_st_zyl3 "dtz Zylinder 3." UWORD FORMULA_0552 0 0 0.0 255.0 READ_WRITE BIT_MASK 0x4 ECU_ADDRESS 0x3FB382 /end MEASUREMENT
/begin MEASUREMENT auss_dtz_st_zyl4 "dtz Zylinder 4." UWORD FORMULA_0553 0 0 0.0 255.0 READ_WRITE BIT_MASK 0x8 ECU_ADDRESS 0x3FB382 /end MEASUREMENT
/begin MEASUREMENT auss_dtz_st_zyl5 "dtz Zylinder 5." UWORD FORMULA_0554 0 0 0.0 255.0 READ_WRITE BIT_MASK 0x10 ECU_ADDRESS 0x3FB382 /end MEASUREMENT
/begin MEASUREMENT auss_dtz_st_zyl6 "dtz Zylinder 6." UWORD FORMULA_0555 0 0 0.0 255.0 READ_WRITE BIT_MASK 0x20 ECU_ADDRESS 0x3FB382 /end MEASUREMENT
/begin MEASUREMENT auss_dtz_st_zyl7 "dtz Zylinder 7." UWORD FORMULA_0556 0 0 0.0 255.0 READ_WRITE BIT_MASK 0x40 ECU_ADDRESS 0x3FB382 /end MEASUREMENT
/begin MEASUREMENT auss_dtz_st_zyl8 "dtz Zylinder 8." UWORD FORMULA_0557 0 0 0.0 255.0 READ_WRITE BIT_MASK 0x80 ECU_ADDRESS 0x3FB382 /end MEASUREMENT
/begin MEASUREMENT auss_dtz_st_zyl9 "dtz Zylinder 9." UWORD FORMULA_0558 0 0 0.0 255.0 READ_WRITE BIT_MASK 0x100 ECU_ADDRESS 0x3FB382 /end MEASUREMENT
/begin MEASUREMENT auss_erk_kl15_zyl1 "Zaehler Aussetzer waerend KL15-Zyklus." UWORD FORMULA_0010 0 0.0 0.0 65535.0 READ_WRITE ECU_ADDRESS 0x3FB512 /end MEASUREMENT
/begin MEASUREMENT auss_erk_kl15_zyl10 "Zaehler Aussetzer waerend KL15-Zyklus." UWORD FORMULA_0010 0 0.0 0.0 65535.0 READ_WRITE ECU_ADDRESS 0x3FB524 /end MEASUREMENT
/begin MEASUREMENT auss_erk_kl15_zyl2 "Zaehler Aussetzer waerend KL15-Zyklus." UWORD FORMULA_0010 0 0.0 0.0 65535.0 READ_WRITE ECU_ADDRESS 0x3FB514 /end MEASUREMENT
/begin MEASUREMENT auss_erk_kl15_zyl3 "Zaehler Aussetzer waerend KL15-Zyklus." UWORD FORMULA_0010 0 0.0 0.0 65535.0 READ_WRITE ECU_ADDRESS 0x3FB516 /end MEASUREMENT
/begin MEASUREMENT auss_erk_kl15_zyl4 "Zaehler Aussetzer waerend KL15-Zyklus." UWORD FORMULA_0010 0 0.0 0.0 65535.0 READ_WRITE ECU_ADDRESS 0x3FB518 /end MEASUREMENT
/begin MEASUREMENT auss_erk_kl15_zyl5 "Zaehler Aussetzer waerend KL15-Zyklus." UWORD FORMULA_0010 0 0.0 0.0 65535.0 READ_WRITE ECU_ADDRESS 0x3FB51A /end MEASUREMENT
/begin MEASUREMENT auss_erk_kl15_zyl6 "Zaehler Aussetzer waerend KL15-Zyklus." UWORD FORMULA_0010 0 0.0 0.0 65535.0 READ_WRITE ECU_ADDRESS 0x3FB51C /end MEASUREMENT
/begin MEASUREMENT auss_erk_kl15_zyl7 "Zaehler Aussetzer waerend KL15-Zyklus." UWORD FORMULA_0010 0 0.0 0.0 65535.0 READ_WRITE ECU_ADDRESS 0x3FB51E /end MEASUREMENT
/begin MEASUREMENT auss_erk_kl15_zyl8 "Zaehler Aussetzer waerend KL15-Zyklus." UWORD FORMULA_0010 0 0.0 0.0 65535.0 READ_WRITE ECU_ADDRESS 0x3FB520 /end MEASUREMENT
/begin MEASUREMENT auss_erk_kl15_zyl9 "Zaehler Aussetzer waerend KL15-Zyklus." UWORD FORMULA_0010 0 0.0 0.0 65535.0 READ_WRITE ECU_ADDRESS 0x3FB522 /end MEASUREMENT
/begin MEASUREMENT auss_erk_ns "Status Nebenschluss Zuendkerze." UWORD FORMULA_0516 0 0.0 0.0 4095.0 READ_WRITE ECU_ADDRESS 0x3FB37C /end MEASUREMENT
/begin MEASUREMENT auss_erk_ns_zyl1 "Status Nebenschluss Zuendkerze 1." UWORD FORMULA_0517 0 0 0.0 255.0 READ_WRITE BIT_MASK 0x1 ECU_ADDRESS 0x3FB37C /end MEASUREMENT
/begin MEASUREMENT auss_erk_ns_zyl10 "Status Nebenschluss Zuendkerze 10." UWORD FORMULA_0526 0 0 0.0 255.0 READ_WRITE BIT_MASK 0x200 ECU_ADDRESS 0x3FB37C /end MEASUREMENT
/begin MEASUREMENT auss_erk_ns_zyl2 "Status Nebenschluss Zuendkerze 2." UWORD FORMULA_0518 0 0 0.0 255.0 READ_WRITE BIT_MASK 0x2 ECU_ADDRESS 0x3FB37C /end MEASUREMENT
/begin MEASUREMENT auss_erk_ns_zyl3 "Status Nebenschluss Zuendkerze 3." UWORD FORMULA_0519 0 0 0.0 255.0 READ_WRITE BIT_MASK 0x4 ECU_ADDRESS 0x3FB37C /end MEASUREMENT
/begin MEASUREMENT auss_erk_ns_zyl4 "Status Nebenschluss Zuendkerze 4." UWORD FORMULA_0520 0 0 0.0 255.0 READ_WRITE BIT_MASK 0x8 ECU_ADDRESS 0x3FB37C /end MEASUREMENT
/begin MEASUREMENT auss_erk_ns_zyl5 "Status Nebenschluss Zuendkerze 5." UWORD FORMULA_0521 0 0 0.0 255.0 READ_WRITE BIT_MASK 0x10 ECU_ADDRESS 0x3FB37C /end MEASUREMENT
/begin MEASUREMENT auss_erk_ns_zyl6 "Status Nebenschluss Zuendkerze 6." UWORD FORMULA_0522 0 0 0.0 255.0 READ_WRITE BIT_MASK 0x20 ECU_ADDRESS 0x3FB37C /end MEASUREMENT
/begin MEASUREMENT auss_erk_ns_zyl7 "Status Nebenschluss Zuendkerze 7." UWORD FORMULA_0523 0 0 0.0 255.0 READ_WRITE BIT_MASK 0x40 ECU_ADDRESS 0x3FB37C /end MEASUREMENT
/begin MEASUREMENT auss_erk_ns_zyl8 "Status Nebenschluss Zuendkerze 8." UWORD FORMULA_0524 0 0 0.0 255.0 READ_WRITE BIT_MASK 0x80 ECU_ADDRESS 0x3FB37C /end MEASUREMENT
/begin MEASUREMENT auss_erk_ns_zyl9 "Status Nebenschluss Zuendkerze 9." UWORD FORMULA_0525 0 0 0.0 255.0 READ_WRITE BIT_MASK 0x100 ECU_ADDRESS 0x3FB37C /end MEASUREMENT
/begin MEASUREMENT auss_erk_ti "Status Verbrennungsaussetzer." UWORD FORMULA_0505 0 0.0 0.0 4095.0 READ_WRITE ECU_ADDRESS 0x3FB37A /end MEASUREMENT
/begin MEASUREMENT auss_erk_ti_zyl1 "Status Verbrennung Zylinder 1." UWORD FORMULA_0506 0 0 0.0 255.0 READ_WRITE BIT_MASK 0x1 ECU_ADDRESS 0x3FB37A /end MEASUREMENT
/begin MEASUREMENT auss_erk_ti_zyl10 "Status Verbrennung Zylinder 10." UWORD FORMULA_0515 0 0 0.0 255.0 READ_WRITE BIT_MASK 0x200 ECU_ADDRESS 0x3FB37A /end MEASUREMENT
/begin MEASUREMENT auss_erk_ti_zyl2 "Status Verbrennung Zylinder 2." UWORD FORMULA_0507 0 0 0.0 255.0 READ_WRITE BIT_MASK 0x2 ECU_ADDRESS 0x3FB37A /end MEASUREMENT
/begin MEASUREMENT auss_erk_ti_zyl3 "Status Verbrennung Zylinder 3." UWORD FORMULA_0508 0 0 0.0 255.0 READ_WRITE BIT_MASK 0x4 ECU_ADDRESS 0x3FB37A /end MEASUREMENT
/begin MEASUREMENT auss_erk_ti_zyl4 "Status Verbrennung Zylinder 4." UWORD FORMULA_0509 0 0 0.0 255.0 READ_WRITE BIT_MASK 0x8 ECU_ADDRESS 0x3FB37A /end MEASUREMENT
/begin MEASUREMENT auss_erk_ti_zyl5 "Status Verbrennung Zylinder 5." UWORD FORMULA_0510 0 0 0.0 255.0 READ_WRITE BIT_MASK 0x10 ECU_ADDRESS 0x3FB37A /end MEASUREMENT
/begin MEASUREMENT auss_erk_ti_zyl6 "Status Verbrennung Zylinder 6." UWORD FORMULA_0511 0 0 0.0 255.0 READ_WRITE BIT_MASK 0x20 ECU_ADDRESS 0x3FB37A /end MEASUREMENT
/begin MEASUREMENT auss_erk_ti_zyl7 "Status Verbrennung Zylinder 7." UWORD FORMULA_0512 0 0 0.0 255.0 READ_WRITE BIT_MASK 0x40 ECU_ADDRESS 0x3FB37A /end MEASUREMENT
/begin MEASUREMENT auss_erk_ti_zyl8 "Status Verbrennung Zylinder 8." UWORD FORMULA_0513 0 0 0.0 255.0 READ_WRITE BIT_MASK 0x80 ECU_ADDRESS 0x3FB37A /end MEASUREMENT
/begin MEASUREMENT auss_erk_ti_zyl9 "Status Verbrennung Zylinder 9." UWORD FORMULA_0514 0 0 0.0 255.0 READ_WRITE BIT_MASK 0x100 ECU_ADDRESS 0x3FB37A /end MEASUREMENT
/begin MEASUREMENT auss_erk_tz "Status Ausschwingen Zuendspule." UWORD FORMULA_0494 0 0.0 0.0 4095.0 READ_WRITE ECU_ADDRESS 0x3FB378 /end MEASUREMENT
/begin MEASUREMENT auss_erk_tz_zyl1 "Status Ausschwingen Zuendspule 1." UWORD FORMULA_0495 0 0 0.0 255.0 READ_WRITE BIT_MASK 0x1 ECU_ADDRESS 0x3FB378 /end MEASUREMENT
/begin MEASUREMENT auss_erk_tz_zyl10 "Status Ausschwingen Zuendspule 10." UWORD FORMULA_0504 0 0 0.0 255.0 READ_WRITE BIT_MASK 0x200 ECU_ADDRESS 0x3FB378 /end MEASUREMENT
/begin MEASUREMENT auss_erk_tz_zyl2 "Status Ausschwingen Zuendspule 2." UWORD FORMULA_0496 0 0 0.0 255.0 READ_WRITE BIT_MASK 0x2 ECU_ADDRESS 0x3FB378 /end MEASUREMENT
/begin MEASUREMENT auss_erk_tz_zyl3 "Status Ausschwingen Zuendspule 3." UWORD FORMULA_0497 0 0 0.0 255.0 READ_WRITE BIT_MASK 0x4 ECU_ADDRESS 0x3FB378 /end MEASUREMENT
/begin MEASUREMENT auss_erk_tz_zyl4 "Status Ausschwingen Zuendspule 4." UWORD FORMULA_0498 0 0 0.0 255.0 READ_WRITE BIT_MASK 0x8 ECU_ADDRESS 0x3FB378 /end MEASUREMENT
/begin MEASUREMENT auss_erk_tz_zyl5 "Status Ausschwingen Zuendspule 5." UWORD FORMULA_0499 0 0 0.0 255.0 READ_WRITE BIT_MASK 0x10 ECU_ADDRESS 0x3FB378 /end MEASUREMENT
/begin MEASUREMENT auss_erk_tz_zyl6 "Status Ausschwingen Zuendspule 6." UWORD FORMULA_0500 0 0 0.0 255.0 READ_WRITE BIT_MASK 0x20 ECU_ADDRESS 0x3FB378 /end MEASUREMENT
/begin MEASUREMENT auss_erk_tz_zyl7 "Status Ausschwingen Zuendspule 7." UWORD FORMULA_0501 0 0 0.0 255.0 READ_WRITE BIT_MASK 0x40 ECU_ADDRESS 0x3FB378 /end MEASUREMENT
/begin MEASUREMENT auss_erk_tz_zyl8 "Status Ausschwingen Zuendspule 8." UWORD FORMULA_0502 0 0 0.0 255.0 READ_WRITE BIT_MASK 0x80 ECU_ADDRESS 0x3FB378 /end MEASUREMENT
/begin MEASUREMENT auss_erk_tz_zyl9 "Status Ausschwingen Zuendspule 9." UWORD FORMULA_0503 0 0 0.0 255.0 READ_WRITE BIT_MASK 0x100 ECU_ADDRESS 0x3FB378 /end MEASUREMENT
/begin MEASUREMENT auss_int_start_faktor "Aktueller Faktor-Korrekturwert waerend Startphase." SWORD FORMULA_0561 0 0.0 0.0 199.9938049316406 READ_WRITE ECU_ADDRESS 0x3FB38A /end MEASUREMENT
/begin MEASUREMENT auss_int_tmot_faktor "Korrekturfaktor ueber Tmot." SWORD FORMULA_0561 0 0.0 0.0 199.9938049316406 READ_WRITE ECU_ADDRESS 0x3FB38E /end MEASUREMENT
/begin MEASUREMENT auss_lp_int_ed_ns_zyl1 "Integral fuer Fehlereintrag Nebenschluss." SWORD FORMULA_0227 0 0.0 0.0 4.0 READ_WRITE ECU_ADDRESS 0x3FB44A /end MEASUREMENT
/begin MEASUREMENT auss_lp_int_ed_ns_zyl10 "Integral fuer Fehlereintrag Nebenschluss." SWORD FORMULA_0227 0 0.0 0.0 4.0 READ_WRITE ECU_ADDRESS 0x3FB45C /end MEASUREMENT
/begin MEASUREMENT auss_lp_int_ed_ns_zyl2 "Integral fuer Fehlereintrag Nebenschluss." SWORD FORMULA_0227 0 0.0 0.0 4.0 READ_WRITE ECU_ADDRESS 0x3FB44C /end MEASUREMENT
/begin MEASUREMENT auss_lp_int_ed_ns_zyl3 "Integral fuer Fehlereintrag Nebenschluss." SWORD FORMULA_0227 0 0.0 0.0 4.0 READ_WRITE ECU_ADDRESS 0x3FB44E /end MEASUREMENT
/begin MEASUREMENT auss_lp_int_ed_ns_zyl4 "Integral fuer Fehlereintrag Nebenschluss." SWORD FORMULA_0227 0 0.0 0.0 4.0 READ_WRITE ECU_ADDRESS 0x3FB450 /end MEASUREMENT
/begin MEASUREMENT auss_lp_int_ed_ns_zyl5 "Integral fuer Fehlereintrag Nebenschluss." SWORD FORMULA_0227 0 0.0 0.0 4.0 READ_WRITE ECU_ADDRESS 0x3FB452 /end MEASUREMENT
/begin MEASUREMENT auss_lp_int_ed_ns_zyl6 "Integral fuer Fehlereintrag Nebenschluss." SWORD FORMULA_0227 0 0.0 0.0 4.0 READ_WRITE ECU_ADDRESS 0x3FB454 /end MEASUREMENT
/begin MEASUREMENT auss_lp_int_ed_ns_zyl7 "Integral fuer Fehlereintrag Nebenschluss." SWORD FORMULA_0227 0 0.0 0.0 4.0 READ_WRITE ECU_ADDRESS 0x3FB456 /end MEASUREMENT
/begin MEASUREMENT auss_lp_int_ed_ns_zyl8 "Integral fuer Fehlereintrag Nebenschluss." SWORD FORMULA_0227 0 0.0 0.0 4.0 READ_WRITE ECU_ADDRESS 0x3FB458 /end MEASUREMENT
/begin MEASUREMENT auss_lp_int_ed_ns_zyl9 "Integral fuer Fehlereintrag Nebenschluss." SWORD FORMULA_0227 0 0.0 0.0 4.0 READ_WRITE ECU_ADDRESS 0x3FB45A /end MEASUREMENT
/begin MEASUREMENT auss_lp_int_ed_ti_zyl1 "Integral fuer Fehlereintrag Verbrennungsaussetzer." SWORD FORMULA_0227 0 0.0 0.0 4.0 READ_WRITE ECU_ADDRESS 0x3FB436 /end MEASUREMENT
/begin MEASUREMENT auss_lp_int_ed_ti_zyl10 "Integral fuer Fehlereintrag Verbrennungsaussetzer." SWORD FORMULA_0227 0 0.0 0.0 4.0 READ_WRITE ECU_ADDRESS 0x3FB448 /end MEASUREMENT
/begin MEASUREMENT auss_lp_int_ed_ti_zyl2 "Integral fuer Fehlereintrag Verbrennungsaussetzer." SWORD FORMULA_0227 0 0.0 0.0 4.0 READ_WRITE ECU_ADDRESS 0x3FB438 /end MEASUREMENT
/begin MEASUREMENT auss_lp_int_ed_ti_zyl3 "Integral fuer Fehlereintrag Verbrennungsaussetzer." SWORD FORMULA_0227 0 0.0 0.0 4.0 READ_WRITE ECU_ADDRESS 0x3FB43A /end MEASUREMENT
/begin MEASUREMENT auss_lp_int_ed_ti_zyl4 "Integral fuer Fehlereintrag Verbrennungsaussetzer." SWORD FORMULA_0227 0 0.0 0.0 4.0 READ_WRITE ECU_ADDRESS 0x3FB43C /end MEASUREMENT
/begin MEASUREMENT auss_lp_int_ed_ti_zyl5 "Integral fuer Fehlereintrag Verbrennungsaussetzer." SWORD FORMULA_0227 0 0.0 0.0 4.0 READ_WRITE ECU_ADDRESS 0x3FB43E /end MEASUREMENT
/begin MEASUREMENT auss_lp_int_ed_ti_zyl6 "Integral fuer Fehlereintrag Verbrennungsaussetzer." SWORD FORMULA_0227 0 0.0 0.0 4.0 READ_WRITE ECU_ADDRESS 0x3FB440 /end MEASUREMENT
/begin MEASUREMENT auss_lp_int_ed_ti_zyl7 "Integral fuer Fehlereintrag Verbrennungsaussetzer." SWORD FORMULA_0227 0 0.0 0.0 4.0 READ_WRITE ECU_ADDRESS 0x3FB442 /end MEASUREMENT
/begin MEASUREMENT auss_lp_int_ed_ti_zyl8 "Integral fuer Fehlereintrag Verbrennungsaussetzer." SWORD FORMULA_0227 0 0.0 0.0 4.0 READ_WRITE ECU_ADDRESS 0x3FB444 /end MEASUREMENT
/begin MEASUREMENT auss_lp_int_ed_ti_zyl9 "Integral fuer Fehlereintrag Verbrennungsaussetzer." SWORD FORMULA_0227 0 0.0 0.0 4.0 READ_WRITE ECU_ADDRESS 0x3FB446 /end MEASUREMENT
/begin MEASUREMENT auss_lp_int_ed_zyl1 "Integral fuer Fehlereintrag." SWORD FORMULA_0227 0 0.0 0.0 4.0 READ_WRITE ECU_ADDRESS 0x3FB422 /end MEASUREMENT
/begin MEASUREMENT auss_lp_int_ed_zyl10 "Integral fuer Fehlereintrag." SWORD FORMULA_0227 0 0.0 0.0 4.0 READ_WRITE ECU_ADDRESS 0x3FB434 /end MEASUREMENT
/begin MEASUREMENT auss_lp_int_ed_zyl2 "Integral fuer Fehlereintrag." SWORD FORMULA_0227 0 0.0 0.0 4.0 READ_WRITE ECU_ADDRESS 0x3FB424 /end MEASUREMENT
/begin MEASUREMENT auss_lp_int_ed_zyl3 "Integral fuer Fehlereintrag." SWORD FORMULA_0227 0 0.0 0.0 4.0 READ_WRITE ECU_ADDRESS 0x3FB426 /end MEASUREMENT
/begin MEASUREMENT auss_lp_int_ed_zyl4 "Integral fuer Fehlereintrag." SWORD FORMULA_0227 0 0.0 0.0 4.0 READ_WRITE ECU_ADDRESS 0x3FB428 /end MEASUREMENT
/begin MEASUREMENT auss_lp_int_ed_zyl5 "Integral fuer Fehlereintrag." SWORD FORMULA_0227 0 0.0 0.0 4.0 READ_WRITE ECU_ADDRESS 0x3FB42A /end MEASUREMENT
/begin MEASUREMENT auss_lp_int_ed_zyl6 "Integral fuer Fehlereintrag." SWORD FORMULA_0227 0 0.0 0.0 4.0 READ_WRITE ECU_ADDRESS 0x3FB42C /end MEASUREMENT
/begin MEASUREMENT auss_lp_int_ed_zyl7 "Integral fuer Fehlereintrag." SWORD FORMULA_0227 0 0.0 0.0 4.0 READ_WRITE ECU_ADDRESS 0x3FB42E /end MEASUREMENT
/begin MEASUREMENT auss_lp_int_ed_zyl8 "Integral fuer Fehlereintrag." SWORD FORMULA_0227 0 0.0 0.0 4.0 READ_WRITE ECU_ADDRESS 0x3FB430 /end MEASUREMENT
/begin MEASUREMENT auss_lp_int_ed_zyl9 "Integral fuer Fehlereintrag." SWORD FORMULA_0227 0 0.0 0.0 4.0 READ_WRITE ECU_ADDRESS 0x3FB432 /end MEASUREMENT
/begin MEASUREMENT auss_lp_int_min_zyl1 "Minimale TP-Leitwertintegralschwelle." SWORD FORMULA_0227 0 0.0 0.0 4.0 READ_WRITE ECU_ADDRESS 0x3FB3BE /end MEASUREMENT
/begin MEASUREMENT auss_lp_int_min_zyl10 "Minimale TP-Leitwertintegralschwelle." SWORD FORMULA_0227 0 0.0 0.0 4.0 READ_WRITE ECU_ADDRESS 0x3FB3D0 /end MEASUREMENT
/begin MEASUREMENT auss_lp_int_min_zyl2 "Minimale TP-Leitwertintegralschwelle." SWORD FORMULA_0227 0 0.0 0.0 4.0 READ_WRITE ECU_ADDRESS 0x3FB3C0 /end MEASUREMENT
/begin MEASUREMENT auss_lp_int_min_zyl3 "Minimale TP-Leitwertintegralschwelle." SWORD FORMULA_0227 0 0.0 0.0 4.0 READ_WRITE ECU_ADDRESS 0x3FB3C2 /end MEASUREMENT
/begin MEASUREMENT auss_lp_int_min_zyl4 "Minimale TP-Leitwertintegralschwelle." SWORD FORMULA_0227 0 0.0 0.0 4.0 READ_WRITE ECU_ADDRESS 0x3FB3C4 /end MEASUREMENT
/begin MEASUREMENT auss_lp_int_min_zyl5 "Minimale TP-Leitwertintegralschwelle." SWORD FORMULA_0227 0 0.0 0.0 4.0 READ_WRITE ECU_ADDRESS 0x3FB3C6 /end MEASUREMENT
/begin MEASUREMENT auss_lp_int_min_zyl6 "Minimale TP-Leitwertintegralschwelle." SWORD FORMULA_0227 0 0.0 0.0 4.0 READ_WRITE ECU_ADDRESS 0x3FB3C8 /end MEASUREMENT
/begin MEASUREMENT auss_lp_int_min_zyl7 "Minimale TP-Leitwertintegralschwelle." SWORD FORMULA_0227 0 0.0 0.0 4.0 READ_WRITE ECU_ADDRESS 0x3FB3CA /end MEASUREMENT
/begin MEASUREMENT auss_lp_int_min_zyl8 "Minimale TP-Leitwertintegralschwelle." SWORD FORMULA_0227 0 0.0 0.0 4.0 READ_WRITE ECU_ADDRESS 0x3FB3CC /end MEASUREMENT
/begin MEASUREMENT auss_lp_int_min_zyl9 "Minimale TP-Leitwertintegralschwelle." SWORD FORMULA_0227 0 0.0 0.0 4.0 READ_WRITE ECU_ADDRESS 0x3FB3CE /end MEASUREMENT
/begin MEASUREMENT auss_lp_int_zyl1 "TP-Integral-Leitwert im Aussetzerfenster." SWORD FORMULA_0227 0 0.0 0.0 4.0 READ_WRITE ECU_ADDRESS 0x3FB49A /end MEASUREMENT
/begin MEASUREMENT auss_lp_int_zyl10 "TP-Integral-Leitwert im Aussetzerfenster." SWORD FORMULA_0227 0 0.0 0.0 4.0 READ_WRITE ECU_ADDRESS 0x3FB4AC /end MEASUREMENT
/begin MEASUREMENT auss_lp_int_zyl2 "TP-Integral-Leitwert im Aussetzerfenster." SWORD FORMULA_0227 0 0.0 0.0 4.0 READ_WRITE ECU_ADDRESS 0x3FB49C /end MEASUREMENT
/begin MEASUREMENT auss_lp_int_zyl3 "TP-Integral-Leitwert im Aussetzerfenster." SWORD FORMULA_0227 0 0.0 0.0 4.0 READ_WRITE ECU_ADDRESS 0x3FB49E /end MEASUREMENT
/begin MEASUREMENT auss_lp_int_zyl4 "TP-Integral-Leitwert im Aussetzerfenster." SWORD FORMULA_0227 0 0.0 0.0 4.0 READ_WRITE ECU_ADDRESS 0x3FB4A0 /end MEASUREMENT
/begin MEASUREMENT auss_lp_int_zyl5 "TP-Integral-Leitwert im Aussetzerfenster." SWORD FORMULA_0227 0 0.0 0.0 4.0 READ_WRITE ECU_ADDRESS 0x3FB4A2 /end MEASUREMENT
/begin MEASUREMENT auss_lp_int_zyl6 "TP-Integral-Leitwert im Aussetzerfenster." SWORD FORMULA_0227 0 0.0 0.0 4.0 READ_WRITE ECU_ADDRESS 0x3FB4A4 /end MEASUREMENT
/begin MEASUREMENT auss_lp_int_zyl7 "TP-Integral-Leitwert im Aussetzerfenster." SWORD FORMULA_0227 0 0.0 0.0 4.0 READ_WRITE ECU_ADDRESS 0x3FB4A6 /end MEASUREMENT
/begin MEASUREMENT auss_lp_int_zyl8 "TP-Integral-Leitwert im Aussetzerfenster." SWORD FORMULA_0227 0 0.0 0.0 4.0 READ_WRITE ECU_ADDRESS 0x3FB4A8 /end MEASUREMENT
/begin MEASUREMENT auss_lp_int_zyl9 "TP-Integral-Leitwert im Aussetzerfenster." SWORD FORMULA_0227 0 0.0 0.0 4.0 READ_WRITE ECU_ADDRESS 0x3FB4AA /end MEASUREMENT
/begin MEASUREMENT auss_lp_min_zyl1 "Offset Leitwert im Aussetzerfenster." SWORD FORMULA_0442 0 0.0 0.0 0.6000000238418579 READ_WRITE ECU_ADDRESS 0x3FB486 /end MEASUREMENT
/begin MEASUREMENT auss_lp_min_zyl10 "Offset Leitwert im Aussetzerfenster." SWORD FORMULA_0442 0 0.0 0.0 0.6000000238418579 READ_WRITE ECU_ADDRESS 0x3FB498 /end MEASUREMENT
/begin MEASUREMENT auss_lp_min_zyl2 "Offset Leitwert im Aussetzerfenster." SWORD FORMULA_0442 0 0.0 0.0 0.6000000238418579 READ_WRITE ECU_ADDRESS 0x3FB488 /end MEASUREMENT
/begin MEASUREMENT auss_lp_min_zyl3 "Offset Leitwert im Aussetzerfenster." SWORD FORMULA_0442 0 0.0 0.0 0.6000000238418579 READ_WRITE ECU_ADDRESS 0x3FB48A /end MEASUREMENT
/begin MEASUREMENT auss_lp_min_zyl4 "Offset Leitwert im Aussetzerfenster." SWORD FORMULA_0442 0 0.0 0.0 0.6000000238418579 READ_WRITE ECU_ADDRESS 0x3FB48C /end MEASUREMENT
/begin MEASUREMENT auss_lp_min_zyl5 "Offset Leitwert im Aussetzerfenster." SWORD FORMULA_0442 0 0.0 0.0 0.6000000238418579 READ_WRITE ECU_ADDRESS 0x3FB48E /end MEASUREMENT
/begin MEASUREMENT auss_lp_min_zyl6 "Offset Leitwert im Aussetzerfenster." SWORD FORMULA_0442 0 0.0 0.0 0.6000000238418579 READ_WRITE ECU_ADDRESS 0x3FB490 /end MEASUREMENT
/begin MEASUREMENT auss_lp_min_zyl7 "Offset Leitwert im Aussetzerfenster." SWORD FORMULA_0442 0 0.0 0.0 0.6000000238418579 READ_WRITE ECU_ADDRESS 0x3FB492 /end MEASUREMENT
/begin MEASUREMENT auss_lp_min_zyl8 "Offset Leitwert im Aussetzerfenster." SWORD FORMULA_0442 0 0.0 0.0 0.6000000238418579 READ_WRITE ECU_ADDRESS 0x3FB494 /end MEASUREMENT
/begin MEASUREMENT auss_lp_min_zyl9 "Offset Leitwert im Aussetzerfenster." SWORD FORMULA_0442 0 0.0 0.0 0.6000000238418579 READ_WRITE ECU_ADDRESS 0x3FB496 /end MEASUREMENT
/begin MEASUREMENT auss_min_avg_samples "Anzahl Messpunkte Minimalintegral." UWORD FORMULA_0560 0 0.0 4.0 4092.0 READ_WRITE ECU_ADDRESS 0x3FB386 /end MEASUREMENT
/begin MEASUREMENT auss_n_ed "n fuer Fehlereintrag." SWORD FORMULA_0006 0 0.0 0.0 10000.0 READ_WRITE ECU_ADDRESS 0x3FB392 /end MEASUREMENT
/begin MEASUREMENT auss_n_ed_ns "n fuer Fehlereintrag Nebenschluss." SWORD FORMULA_0006 0 0.0 0.0 10000.0 READ_WRITE ECU_ADDRESS 0x3FB396 /end MEASUREMENT
/begin MEASUREMENT auss_n_ed_ti "n fuer Fehlereintrag Verbrennungsaussetzer." SWORD FORMULA_0006 0 0.0 0.0 10000.0 READ_WRITE ECU_ADDRESS 0x3FB394 /end MEASUREMENT
/begin MEASUREMENT auss_ns_time_zyl1 "Nebenschlusszeit im Aussetzerfenster." UWORD FORMULA_0446 0 0.0 0.0 24.57600021362305 READ_WRITE ECU_ADDRESS 0x3FB3D2 /end MEASUREMENT
/begin MEASUREMENT auss_ns_time_zyl10 "Nebenschlusszeit im Aussetzerfenster." UWORD FORMULA_0446 0 0.0 0.0 24.57600021362305 READ_WRITE ECU_ADDRESS 0x3FB3E4 /end MEASUREMENT
/begin MEASUREMENT auss_ns_time_zyl2 "Nebenschlusszeit im Aussetzerfenster." UWORD FORMULA_0446 0 0.0 0.0 24.57600021362305 READ_WRITE ECU_ADDRESS 0x3FB3D4 /end MEASUREMENT
/begin MEASUREMENT auss_ns_time_zyl3 "Nebenschlusszeit im Aussetzerfenster." UWORD FORMULA_0446 0 0.0 0.0 24.57600021362305 READ_WRITE ECU_ADDRESS 0x3FB3D6 /end MEASUREMENT
/begin MEASUREMENT auss_ns_time_zyl4 "Nebenschlusszeit im Aussetzerfenster." UWORD FORMULA_0446 0 0.0 0.0 24.57600021362305 READ_WRITE ECU_ADDRESS 0x3FB3D8 /end MEASUREMENT
/begin MEASUREMENT auss_ns_time_zyl5 "Nebenschlusszeit im Aussetzerfenster." UWORD FORMULA_0446 0 0.0 0.0 24.57600021362305 READ_WRITE ECU_ADDRESS 0x3FB3DA /end MEASUREMENT
/begin MEASUREMENT auss_ns_time_zyl6 "Nebenschlusszeit im Aussetzerfenster." UWORD FORMULA_0446 0 0.0 0.0 24.57600021362305 READ_WRITE ECU_ADDRESS 0x3FB3DC /end MEASUREMENT
/begin MEASUREMENT auss_ns_time_zyl7 "Nebenschlusszeit im Aussetzerfenster." UWORD FORMULA_0446 0 0.0 0.0 24.57600021362305 READ_WRITE ECU_ADDRESS 0x3FB3DE /end MEASUREMENT
/begin MEASUREMENT auss_ns_time_zyl8 "Nebenschlusszeit im Aussetzerfenster." UWORD FORMULA_0446 0 0.0 0.0 24.57600021362305 READ_WRITE ECU_ADDRESS 0x3FB3E0 /end MEASUREMENT
/begin MEASUREMENT auss_ns_time_zyl9 "Nebenschlusszeit im Aussetzerfenster." UWORD FORMULA_0446 0 0.0 0.0 24.57600021362305 READ_WRITE ECU_ADDRESS 0x3FB3E2 /end MEASUREMENT
/begin MEASUREMENT auss_obd_abg "Status Aussetzer Abgas." UWORD FORMULA_0538 0 0.0 0.0 4095.0 READ_WRITE ECU_ADDRESS 0x3FB380 /end MEASUREMENT
/begin MEASUREMENT auss_obd_abg_dreh_cnt "Arbeitsspielzaehler Abgas." ULONG FORMULA_0000 0 0.0 0.0 4294967295.0 READ_WRITE ECU_ADDRESS 0x3FB52C /end MEASUREMENT
/begin MEASUREMENT auss_obd_abg_ueberschr "Intervalle mit Abgasschwellen-Ueberschr in diesem DC." UBYTE FORMULA_0003 0 0.0 0.0 255.0 READ_WRITE ECU_ADDRESS 0x3FB373 /end MEASUREMENT
/begin MEASUREMENT auss_obd_abg_zyl1 "Aussetzererkennung Zylinder 1." UWORD FORMULA_0539 0 0 0.0 255.0 READ_WRITE BIT_MASK 0x1 ECU_ADDRESS 0x3FB380 /end MEASUREMENT
/begin MEASUREMENT auss_obd_abg_zyl10 "Aussetzererkennung Zylinder 10." UWORD FORMULA_0548 0 0 0.0 255.0 READ_WRITE BIT_MASK 0x200 ECU_ADDRESS 0x3FB380 /end MEASUREMENT
/begin MEASUREMENT auss_obd_abg_zyl2 "Aussetzererkennung Zylinder 2." UWORD FORMULA_0540 0 0 0.0 255.0 READ_WRITE BIT_MASK 0x2 ECU_ADDRESS 0x3FB380 /end MEASUREMENT
/begin MEASUREMENT auss_obd_abg_zyl3 "Aussetzererkennung Zylinder 3." UWORD FORMULA_0541 0 0 0.0 255.0 READ_WRITE BIT_MASK 0x4 ECU_ADDRESS 0x3FB380 /end MEASUREMENT
/begin MEASUREMENT auss_obd_abg_zyl4 "Aussetzererkennung Zylinder 4." UWORD FORMULA_0542 0 0 0.0 255.0 READ_WRITE BIT_MASK 0x8 ECU_ADDRESS 0x3FB380 /end MEASUREMENT
/begin MEASUREMENT auss_obd_abg_zyl5 "Aussetzererkennung Zylinder 5." UWORD FORMULA_0543 0 0 0.0 255.0 READ_WRITE BIT_MASK 0x10 ECU_ADDRESS 0x3FB380 /end MEASUREMENT
/begin MEASUREMENT auss_obd_abg_zyl6 "Aussetzererkennung Zylinder 6." UWORD FORMULA_0544 0 0 0.0 255.0 READ_WRITE BIT_MASK 0x20 ECU_ADDRESS 0x3FB380 /end MEASUREMENT
/begin MEASUREMENT auss_obd_abg_zyl7 "Aussetzererkennung Zylinder 7." UWORD FORMULA_0545 0 0 0.0 255.0 READ_WRITE BIT_MASK 0x40 ECU_ADDRESS 0x3FB380 /end MEASUREMENT
/begin MEASUREMENT auss_obd_abg_zyl8 "Aussetzererkennung Zylinder 8." UWORD FORMULA_0546 0 0 0.0 255.0 READ_WRITE BIT_MASK 0x80 ECU_ADDRESS 0x3FB380 /end MEASUREMENT
/begin MEASUREMENT auss_obd_abg_zyl9 "Aussetzererkennung Zylinder 9." UWORD FORMULA_0547 0 0 0.0 255.0 READ_WRITE BIT_MASK 0x100 ECU_ADDRESS 0x3FB380 /end MEASUREMENT
/begin MEASUREMENT auss_obd_dtz_max "Maximal zul. delta Zuendwinkel." SWORD FORMULA_0102 0 0.0 -50.0 60.0 READ_WRITE ECU_ADDRESS 0x3FB390 /end MEASUREMENT
/begin MEASUREMENT auss_obd_kat "Status Aussetzer Kat." UWORD FORMULA_0527 0 0.0 0.0 4095.0 READ_WRITE ECU_ADDRESS 0x3FB37E /end MEASUREMENT
/begin MEASUREMENT auss_obd_kat_dreh_cnt "Arbeitsspielzaehler Katschutz." ULONG FORMULA_0000 0 0.0 0.0 4294967295.0 READ_WRITE ECU_ADDRESS 0x3FB528 /end MEASUREMENT
/begin MEASUREMENT auss_obd_kat_zyl1 "Aussetzererkennung Zylinder 1." UWORD FORMULA_0528 0 0 0.0 255.0 READ_WRITE BIT_MASK 0x1 ECU_ADDRESS 0x3FB37E /end MEASUREMENT
/begin MEASUREMENT auss_obd_kat_zyl10 "Aussetzererkennung Zylinder 10." UWORD FORMULA_0537 0 0 0.0 255.0 READ_WRITE BIT_MASK 0x200 ECU_ADDRESS 0x3FB37E /end MEASUREMENT
/begin MEASUREMENT auss_obd_kat_zyl2 "Aussetzererkennung Zylinder 2." UWORD FORMULA_0529 0 0 0.0 255.0 READ_WRITE BIT_MASK 0x2 ECU_ADDRESS 0x3FB37E /end MEASUREMENT
/begin MEASUREMENT auss_obd_kat_zyl3 "Aussetzererkennung Zylinder 3." UWORD FORMULA_0530 0 0 0.0 255.0 READ_WRITE BIT_MASK 0x4 ECU_ADDRESS 0x3FB37E /end MEASUREMENT
/begin MEASUREMENT auss_obd_kat_zyl4 "Aussetzererkennung Zylinder 4." UWORD FORMULA_0531 0 0 0.0 255.0 READ_WRITE BIT_MASK 0x8 ECU_ADDRESS 0x3FB37E /end MEASUREMENT
/begin MEASUREMENT auss_obd_kat_zyl5 "Aussetzererkennung Zylinder 5." UWORD FORMULA_0532 0 0 0.0 255.0 READ_WRITE BIT_MASK 0x10 ECU_ADDRESS 0x3FB37E /end MEASUREMENT
/begin MEASUREMENT auss_obd_kat_zyl6 "Aussetzererkennung Zylinder 6." UWORD FORMULA_0533 0 0 0.0 255.0 READ_WRITE BIT_MASK 0x20 ECU_ADDRESS 0x3FB37E /end MEASUREMENT
/begin MEASUREMENT auss_obd_kat_zyl7 "Aussetzererkennung Zylinder 7." UWORD FORMULA_0534 0 0 0.0 255.0 READ_WRITE BIT_MASK 0x40 ECU_ADDRESS 0x3FB37E /end MEASUREMENT
/begin MEASUREMENT auss_obd_kat_zyl8 "Aussetzererkennung Zylinder 8." UWORD FORMULA_0535 0 0 0.0 255.0 READ_WRITE BIT_MASK 0x80 ECU_ADDRESS 0x3FB37E /end MEASUREMENT
/begin MEASUREMENT auss_obd_kat_zyl9 "Aussetzererkennung Zylinder 9." UWORD FORMULA_0536 0 0 0.0 255.0 READ_WRITE BIT_MASK 0x100 ECU_ADDRESS 0x3FB37E /end MEASUREMENT
/begin MEASUREMENT auss_obd_md_min "Minimales Moment an der Kupplung zur Aktivierung." SWORD FORMULA_0009 0 0.0 -100.0 1000.0 READ_WRITE ECU_ADDRESS 0x3FB398 /end MEASUREMENT
/begin MEASUREMENT auss_obd_neg_md_dyn_b1 "Maximal zul. neg. Dynamik." SWORD FORMULA_0562 0 0.0 -5000.0 5000.0 READ_WRITE ECU_ADDRESS 0x3FB3B2 /end MEASUREMENT
/begin MEASUREMENT auss_obd_neg_md_dyn_b2 "Maximal zul. neg. Dynamik." SWORD FORMULA_0562 0 0.0 -5000.0 5000.0 READ_WRITE ECU_ADDRESS 0x3FB3B4 /end MEASUREMENT
/begin MEASUREMENT auss_obd_phase "OBD-Phase." UBYTE FORMULA_0491 0 0.0 0.0 255.0 READ_WRITE ECU_ADDRESS 0x3FB371 /end MEASUREMENT
/begin MEASUREMENT auss_obd_pos_md_dyn_b1 "Maximal zul. pos. Dynamik." SWORD FORMULA_0562 0 0.0 -5000.0 5000.0 READ_WRITE ECU_ADDRESS 0x3FB3AE /end MEASUREMENT
/begin MEASUREMENT auss_obd_pos_md_dyn_b2 "Maximal zul. pos. Dynamik." SWORD FORMULA_0562 0 0.0 -5000.0 5000.0 READ_WRITE ECU_ADDRESS 0x3FB3B0 /end MEASUREMENT
/begin MEASUREMENT auss_obd_rf_min_b1 "Minimale RF-Aktivierungsschwelle." SWORD FORMULA_0007 0 0.0 0.0 2.0 READ_WRITE ECU_ADDRESS 0x3FB3AA /end MEASUREMENT
/begin MEASUREMENT auss_obd_rf_min_b2 "Minimale RF-Aktivierungsschwelle." SWORD FORMULA_0007 0 0.0 0.0 2.0 READ_WRITE ECU_ADDRESS 0x3FB3AC /end MEASUREMENT
/begin MEASUREMENT auss_obd_sa_cnt "Anzahl der SA-Bereiche fuer Wiedereinsetzen." UBYTE FORMULA_0003 0 0.0 0.0 255.0 READ_WRITE ECU_ADDRESS 0x3FB370 /end MEASUREMENT
/begin MEASUREMENT auss_obd_sa_time "Timer fuer SA-Dauer Wiedereinsetzen." UBYTE FORMULA_0492 0 0.0 0.0 25.5 READ_WRITE ECU_ADDRESS 0x3FB374 /end MEASUREMENT
/begin MEASUREMENT auss_obd_scdn_st "Status Betriebsfensterbildung." UBYTE FORMULA_0003 0 0.0 0.0 255.0 READ_WRITE ECU_ADDRESS 0x3FB372 /end MEASUREMENT
/begin MEASUREMENT auss_obd_sum_abg_ev_zyl1 "Summe Einspritzauss. Abgas in 1000 Umdrehungen." UWORD FORMULA_0010 0 0.0 0.0 65535.0 READ_WRITE ECU_ADDRESS 0x3FB4C2 /end MEASUREMENT
/begin MEASUREMENT auss_obd_sum_abg_ev_zyl10 "Summe Einspritzauss. Abgas in 1000 Umdrehungen." UWORD FORMULA_0010 0 0.0 0.0 65535.0 READ_WRITE ECU_ADDRESS 0x3FB4D4 /end MEASUREMENT
/begin MEASUREMENT auss_obd_sum_abg_ev_zyl2 "Summe Einspritzauss. Abgas in 1000 Umdrehungen." UWORD FORMULA_0010 0 0.0 0.0 65535.0 READ_WRITE ECU_ADDRESS 0x3FB4C4 /end MEASUREMENT
/begin MEASUREMENT auss_obd_sum_abg_ev_zyl3 "Summe Einspritzauss. Abgas in 1000 Umdrehungen." UWORD FORMULA_0010 0 0.0 0.0 65535.0 READ_WRITE ECU_ADDRESS 0x3FB4C6 /end MEASUREMENT
/begin MEASUREMENT auss_obd_sum_abg_ev_zyl4 "Summe Einspritzauss. Abgas in 1000 Umdrehungen." UWORD FORMULA_0010 0 0.0 0.0 65535.0 READ_WRITE ECU_ADDRESS 0x3FB4C8 /end MEASUREMENT
/begin MEASUREMENT auss_obd_sum_abg_ev_zyl5 "Summe Einspritzauss. Abgas in 1000 Umdrehungen." UWORD FORMULA_0010 0 0.0 0.0 65535.0 READ_WRITE ECU_ADDRESS 0x3FB4CA /end MEASUREMENT
/begin MEASUREMENT auss_obd_sum_abg_ev_zyl6 "Summe Einspritzauss. Abgas in 1000 Umdrehungen." UWORD FORMULA_0010 0 0.0 0.0 65535.0 READ_WRITE ECU_ADDRESS 0x3FB4CC /end MEASUREMENT
/begin MEASUREMENT auss_obd_sum_abg_ev_zyl7 "Summe Einspritzauss. Abgas in 1000 Umdrehungen." UWORD FORMULA_0010 0 0.0 0.0 65535.0 READ_WRITE ECU_ADDRESS 0x3FB4CE /end MEASUREMENT
/begin MEASUREMENT auss_obd_sum_abg_ev_zyl8 "Summe Einspritzauss. Abgas in 1000 Umdrehungen." UWORD FORMULA_0010 0 0.0 0.0 65535.0 READ_WRITE ECU_ADDRESS 0x3FB4D0 /end MEASUREMENT
/begin MEASUREMENT auss_obd_sum_abg_ev_zyl9 "Summe Einspritzauss. Abgas in 1000 Umdrehungen." UWORD FORMULA_0010 0 0.0 0.0 65535.0 READ_WRITE ECU_ADDRESS 0x3FB4D2 /end MEASUREMENT
/begin MEASUREMENT auss_obd_sum_abg_spark_zyl1 "Summe Zuendauss. Abgas in 1000 Umdrehungen." UWORD FORMULA_0010 0 0.0 0.0 65535.0 READ_WRITE ECU_ADDRESS 0x3FB4AE /end MEASUREMENT
/begin MEASUREMENT auss_obd_sum_abg_spark_zyl10 "Summe Zuendauss. Abgas in 1000 Umdrehungen." UWORD FORMULA_0010 0 0.0 0.0 65535.0 READ_WRITE ECU_ADDRESS 0x3FB4C0 /end MEASUREMENT
/begin MEASUREMENT auss_obd_sum_abg_spark_zyl2 "Summe Zuendauss. Abgas in 1000 Umdrehungen." UWORD FORMULA_0010 0 0.0 0.0 65535.0 READ_WRITE ECU_ADDRESS 0x3FB4B0 /end MEASUREMENT
/begin MEASUREMENT auss_obd_sum_abg_spark_zyl3 "Summe Zuendauss. Abgas in 1000 Umdrehungen." UWORD FORMULA_0010 0 0.0 0.0 65535.0 READ_WRITE ECU_ADDRESS 0x3FB4B2 /end MEASUREMENT
/begin MEASUREMENT auss_obd_sum_abg_spark_zyl4 "Summe Zuendauss. Abgas in 1000 Umdrehungen." UWORD FORMULA_0010 0 0.0 0.0 65535.0 READ_WRITE ECU_ADDRESS 0x3FB4B4 /end MEASUREMENT
/begin MEASUREMENT auss_obd_sum_abg_spark_zyl5 "Summe Zuendauss. Abgas in 1000 Umdrehungen." UWORD FORMULA_0010 0 0.0 0.0 65535.0 READ_WRITE ECU_ADDRESS 0x3FB4B6 /end MEASUREMENT
/begin MEASUREMENT auss_obd_sum_abg_spark_zyl6 "Summe Zuendauss. Abgas in 1000 Umdrehungen." UWORD FORMULA_0010 0 0.0 0.0 65535.0 READ_WRITE ECU_ADDRESS 0x3FB4B8 /end MEASUREMENT
/begin MEASUREMENT auss_obd_sum_abg_spark_zyl7 "Summe Zuendauss. Abgas in 1000 Umdrehungen." UWORD FORMULA_0010 0 0.0 0.0 65535.0 READ_WRITE ECU_ADDRESS 0x3FB4BA /end MEASUREMENT
/begin MEASUREMENT auss_obd_sum_abg_spark_zyl8 "Summe Zuendauss. Abgas in 1000 Umdrehungen." UWORD FORMULA_0010 0 0.0 0.0 65535.0 READ_WRITE ECU_ADDRESS 0x3FB4BC /end MEASUREMENT
/begin MEASUREMENT auss_obd_sum_abg_spark_zyl9 "Summe Zuendauss. Abgas in 1000 Umdrehungen." UWORD FORMULA_0010 0 0.0 0.0 65535.0 READ_WRITE ECU_ADDRESS 0x3FB4BE /end MEASUREMENT
/begin MEASUREMENT auss_obd_sum_kat_ev_zyl1 "Gew. Summe kat. Einspritzauss. in 200 Umdrehungen." UWORD FORMULA_0563 0 0.0 0.0 257.0 READ_WRITE ECU_ADDRESS 0x3FB4FE /end MEASUREMENT
/begin MEASUREMENT auss_obd_sum_kat_ev_zyl10 "Gew. Summe kat. Einspritzauss. in 200 Umdrehungen." UWORD FORMULA_0563 0 0.0 0.0 257.0 READ_WRITE ECU_ADDRESS 0x3FB510 /end MEASUREMENT
/begin MEASUREMENT auss_obd_sum_kat_ev_zyl2 "Gew. Summe kat. Einspritzauss. in 200 Umdrehungen." UWORD FORMULA_0563 0 0.0 0.0 257.0 READ_WRITE ECU_ADDRESS 0x3FB500 /end MEASUREMENT
/begin MEASUREMENT auss_obd_sum_kat_ev_zyl3 "Gew. Summe kat. Einspritzauss. in 200 Umdrehungen." UWORD FORMULA_0563 0 0.0 0.0 257.0 READ_WRITE ECU_ADDRESS 0x3FB502 /end MEASUREMENT
/begin MEASUREMENT auss_obd_sum_kat_ev_zyl4 "Gew. Summe kat. Einspritzauss. in 200 Umdrehungen." UWORD FORMULA_0563 0 0.0 0.0 257.0 READ_WRITE ECU_ADDRESS 0x3FB504 /end MEASUREMENT
/begin MEASUREMENT auss_obd_sum_kat_ev_zyl5 "Gew. Summe kat. Einspritzauss. in 200 Umdrehungen." UWORD FORMULA_0563 0 0.0 0.0 257.0 READ_WRITE ECU_ADDRESS 0x3FB506 /end MEASUREMENT
/begin MEASUREMENT auss_obd_sum_kat_ev_zyl6 "Gew. Summe kat. Einspritzauss. in 200 Umdrehungen." UWORD FORMULA_0563 0 0.0 0.0 257.0 READ_WRITE ECU_ADDRESS 0x3FB508 /end MEASUREMENT
/begin MEASUREMENT auss_obd_sum_kat_ev_zyl7 "Gew. Summe kat. Einspritzauss. in 200 Umdrehungen." UWORD FORMULA_0563 0 0.0 0.0 257.0 READ_WRITE ECU_ADDRESS 0x3FB50A /end MEASUREMENT
/begin MEASUREMENT auss_obd_sum_kat_ev_zyl8 "Gew. Summe kat. Einspritzauss. in 200 Umdrehungen." UWORD FORMULA_0563 0 0.0 0.0 257.0 READ_WRITE ECU_ADDRESS 0x3FB50C /end MEASUREMENT
/begin MEASUREMENT auss_obd_sum_kat_ev_zyl9 "Gew. Summe kat. Einspritzauss. in 200 Umdrehungen." UWORD FORMULA_0563 0 0.0 0.0 257.0 READ_WRITE ECU_ADDRESS 0x3FB50E /end MEASUREMENT
/begin MEASUREMENT auss_obd_sum_kat_ns_zyl1 "Gew. Summe kat. Nebenschlussauss. in 200 Umdrehungen." UWORD FORMULA_0563 0 0.0 0.0 257.0 READ_WRITE ECU_ADDRESS 0x3FB4EA /end MEASUREMENT
/begin MEASUREMENT auss_obd_sum_kat_ns_zyl10 "Gew. Summe kat. Nebenschlussauss. in 200 Umdrehungen." UWORD FORMULA_0563 0 0.0 0.0 257.0 READ_WRITE ECU_ADDRESS 0x3FB4FC /end MEASUREMENT
/begin MEASUREMENT auss_obd_sum_kat_ns_zyl2 "Gew. Summe kat. Nebenschlussauss. in 200 Umdrehungen." UWORD FORMULA_0563 0 0.0 0.0 257.0 READ_WRITE ECU_ADDRESS 0x3FB4EC /end MEASUREMENT
/begin MEASUREMENT auss_obd_sum_kat_ns_zyl3 "Gew. Summe kat. Nebenschlussauss. in 200 Umdrehungen." UWORD FORMULA_0563 0 0.0 0.0 257.0 READ_WRITE ECU_ADDRESS 0x3FB4EE /end MEASUREMENT
/begin MEASUREMENT auss_obd_sum_kat_ns_zyl4 "Gew. Summe kat. Nebenschlussauss. in 200 Umdrehungen." UWORD FORMULA_0563 0 0.0 0.0 257.0 READ_WRITE ECU_ADDRESS 0x3FB4F0 /end MEASUREMENT
/begin MEASUREMENT auss_obd_sum_kat_ns_zyl5 "Gew. Summe kat. Nebenschlussauss. in 200 Umdrehungen." UWORD FORMULA_0563 0 0.0 0.0 257.0 READ_WRITE ECU_ADDRESS 0x3FB4F2 /end MEASUREMENT
/begin MEASUREMENT auss_obd_sum_kat_ns_zyl6 "Gew. Summe kat. Nebenschlussauss. in 200 Umdrehungen." UWORD FORMULA_0563 0 0.0 0.0 257.0 READ_WRITE ECU_ADDRESS 0x3FB4F4 /end MEASUREMENT
/begin MEASUREMENT auss_obd_sum_kat_ns_zyl7 "Gew. Summe kat. Nebenschlussauss. in 200 Umdrehungen." UWORD FORMULA_0563 0 0.0 0.0 257.0 READ_WRITE ECU_ADDRESS 0x3FB4F6 /end MEASUREMENT
/begin MEASUREMENT auss_obd_sum_kat_ns_zyl8 "Gew. Summe kat. Nebenschlussauss. in 200 Umdrehungen." UWORD FORMULA_0563 0 0.0 0.0 257.0 READ_WRITE ECU_ADDRESS 0x3FB4F8 /end MEASUREMENT
/begin MEASUREMENT auss_obd_sum_kat_ns_zyl9 "Gew. Summe kat. Nebenschlussauss. in 200 Umdrehungen." UWORD FORMULA_0563 0 0.0 0.0 257.0 READ_WRITE ECU_ADDRESS 0x3FB4FA /end MEASUREMENT
/begin MEASUREMENT auss_obd_sum_kat_spark_zyl1 "Gew. Summe kat. Zuendauss. in 200 Umdrehungen." UWORD FORMULA_0563 0 0.0 0.0 257.0 READ_WRITE ECU_ADDRESS 0x3FB4D6 /end MEASUREMENT
/begin MEASUREMENT auss_obd_sum_kat_spark_zyl10 "Gew. Summe kat. Zuendauss. in 200 Umdrehungen." UWORD FORMULA_0563 0 0.0 0.0 257.0 READ_WRITE ECU_ADDRESS 0x3FB4E8 /end MEASUREMENT
/begin MEASUREMENT auss_obd_sum_kat_spark_zyl2 "Gew. Summe kat. Zuendauss. in 200 Umdrehungen." UWORD FORMULA_0563 0 0.0 0.0 257.0 READ_WRITE ECU_ADDRESS 0x3FB4D8 /end MEASUREMENT
/begin MEASUREMENT auss_obd_sum_kat_spark_zyl3 "Gew. Summe kat. Zuendauss. in 200 Umdrehungen." UWORD FORMULA_0563 0 0.0 0.0 257.0 READ_WRITE ECU_ADDRESS 0x3FB4DA /end MEASUREMENT
/begin MEASUREMENT auss_obd_sum_kat_spark_zyl4 "Gew. Summe kat. Zuendauss. in 200 Umdrehungen." UWORD FORMULA_0563 0 0.0 0.0 257.0 READ_WRITE ECU_ADDRESS 0x3FB4DC /end MEASUREMENT
/begin MEASUREMENT auss_obd_sum_kat_spark_zyl5 "Gew. Summe kat. Zuendauss. in 200 Umdrehungen." UWORD FORMULA_0563 0 0.0 0.0 257.0 READ_WRITE ECU_ADDRESS 0x3FB4DE /end MEASUREMENT
/begin MEASUREMENT auss_obd_sum_kat_spark_zyl6 "Gew. Summe kat. Zuendauss. in 200 Umdrehungen." UWORD FORMULA_0563 0 0.0 0.0 257.0 READ_WRITE ECU_ADDRESS 0x3FB4E0 /end MEASUREMENT
/begin MEASUREMENT auss_obd_sum_kat_spark_zyl7 "Gew. Summe kat. Zuendauss. in 200 Umdrehungen." UWORD FORMULA_0563 0 0.0 0.0 257.0 READ_WRITE ECU_ADDRESS 0x3FB4E2 /end MEASUREMENT
/begin MEASUREMENT auss_obd_sum_kat_spark_zyl8 "Gew. Summe kat. Zuendauss. in 200 Umdrehungen." UWORD FORMULA_0563 0 0.0 0.0 257.0 READ_WRITE ECU_ADDRESS 0x3FB4E4 /end MEASUREMENT
/begin MEASUREMENT auss_obd_sum_kat_spark_zyl9 "Gew. Summe kat. Zuendauss. in 200 Umdrehungen." UWORD FORMULA_0563 0 0.0 0.0 257.0 READ_WRITE ECU_ADDRESS 0x3FB4E6 /end MEASUREMENT
/begin MEASUREMENT auss_obd_t_idle_b1 "Zeit seit Deaktivierungsbedingung." UWORD FORMULA_0021 0 0.0 0.0 655.0 READ_WRITE ECU_ADDRESS 0x3FB3B6 /end MEASUREMENT
/begin MEASUREMENT auss_obd_t_idle_b2 "Zeit seit Deaktivierungsbedingung." UWORD FORMULA_0021 0 0.0 0.0 655.0 READ_WRITE ECU_ADDRESS 0x3FB3B8 /end MEASUREMENT
/begin MEASUREMENT auss_obd_t_min_lam_b1 "Abschaltzeit wegen Lamda-Unterschreitung." UWORD FORMULA_0021 0 0.0 0.0 655.0 READ_WRITE ECU_ADDRESS 0x3FB3BA /end MEASUREMENT
/begin MEASUREMENT auss_obd_t_min_lam_b2 "Abschaltzeit wegen Lamda-Unterschreitung." UWORD FORMULA_0021 0 0.0 0.0 655.0 READ_WRITE ECU_ADDRESS 0x3FB3BC /end MEASUREMENT
/begin MEASUREMENT auss_obd_tz_grad "Deaktivierungsschwelle fuer tz_grad." SWORD FORMULA_0231 0 0.0 -100.0 100.0 READ_WRITE ECU_ADDRESS 0x3FB384 /end MEASUREMENT
/begin MEASUREMENT auss_obd_wicht_kat_b1 "Gewichtungsfaktors fuer Katschaedigung." UBYTE FORMULA_0493 0 0.0 0.0 1.0 READ_WRITE ECU_ADDRESS 0x3FB375 /end MEASUREMENT
/begin MEASUREMENT auss_obd_wicht_kat_b2 "Gewichtungsfaktors fuer Katschaedigung." UBYTE FORMULA_0493 0 0.0 0.0 1.0 READ_WRITE ECU_ADDRESS 0x3FB376 /end MEASUREMENT
/begin MEASUREMENT auss_pumg_faktor "Korrektur ueber pumg." SWORD FORMULA_0561 0 0.0 0.0 199.9938049316406 READ_WRITE ECU_ADDRESS 0x3FB38C /end MEASUREMENT
/begin MEASUREMENT auss_rf_ed_b1 "rf fuer Fehlereintrag." SWORD FORMULA_0007 0 0.0 0.0 2.0 READ_WRITE ECU_ADDRESS 0x3FB39A /end MEASUREMENT
/begin MEASUREMENT auss_rf_ed_b2 "rf fuer Fehlereintrag." SWORD FORMULA_0007 0 0.0 0.0 2.0 READ_WRITE ECU_ADDRESS 0x3FB39C /end MEASUREMENT
/begin MEASUREMENT auss_rf_ed_ns_b1 "rf fuer Fehlereintrag Nebenschluss." SWORD FORMULA_0007 0 0.0 0.0 2.0 READ_WRITE ECU_ADDRESS 0x3FB3A2 /end MEASUREMENT
/begin MEASUREMENT auss_rf_ed_ns_b2 "rf fuer Fehlereintrag Nebenschluss." SWORD FORMULA_0007 0 0.0 0.0 2.0 READ_WRITE ECU_ADDRESS 0x3FB3A4 /end MEASUREMENT
/begin MEASUREMENT auss_rf_ed_ti_b1 "rf fuer Fehlereintrag Verbrennungsaussetzer." SWORD FORMULA_0007 0 0.0 0.0 2.0 READ_WRITE ECU_ADDRESS 0x3FB39E /end MEASUREMENT
/begin MEASUREMENT auss_rf_ed_ti_b2 "rf fuer Fehlereintrag Verbrennungsaussetzer." SWORD FORMULA_0007 0 0.0 0.0 2.0 READ_WRITE ECU_ADDRESS 0x3FB3A0 /end MEASUREMENT
/begin MEASUREMENT auss_rf_fil_b1 "gefiltertes rf fuer Aussetzerekennung" SWORD FORMULA_0007 0 0.0 0.0 2.0 READ_WRITE ECU_ADDRESS 0x3FB530 /end MEASUREMENT
/begin MEASUREMENT auss_rf_fil_b2 "gefiltertes rf fuer Aussetzerekennung" SWORD FORMULA_0007 0 0.0 0.0 2.0 READ_WRITE ECU_ADDRESS 0x3FB532 /end MEASUREMENT
/begin MEASUREMENT auss_spark_time_fil_zyl1 "Funkenbrenndauer." SWORD FORMULA_0445 0 0.0 0.0 4.681000232696533 READ_WRITE ECU_ADDRESS 0x3FB472 /end MEASUREMENT
/begin MEASUREMENT auss_spark_time_fil_zyl10 "Funkenbrenndauer." SWORD FORMULA_0445 0 0.0 0.0 4.681000232696533 READ_WRITE ECU_ADDRESS 0x3FB484 /end MEASUREMENT
/begin MEASUREMENT auss_spark_time_fil_zyl2 "Funkenbrenndauer." SWORD FORMULA_0445 0 0.0 0.0 4.681000232696533 READ_WRITE ECU_ADDRESS 0x3FB474 /end MEASUREMENT
/begin MEASUREMENT auss_spark_time_fil_zyl3 "Funkenbrenndauer." SWORD FORMULA_0445 0 0.0 0.0 4.681000232696533 READ_WRITE ECU_ADDRESS 0x3FB476 /end MEASUREMENT
/begin MEASUREMENT auss_spark_time_fil_zyl4 "Funkenbrenndauer." SWORD FORMULA_0445 0 0.0 0.0 4.681000232696533 READ_WRITE ECU_ADDRESS 0x3FB478 /end MEASUREMENT
/begin MEASUREMENT auss_spark_time_fil_zyl5 "Funkenbrenndauer." SWORD FORMULA_0445 0 0.0 0.0 4.681000232696533 READ_WRITE ECU_ADDRESS 0x3FB47A /end MEASUREMENT
/begin MEASUREMENT auss_spark_time_fil_zyl6 "Funkenbrenndauer." SWORD FORMULA_0445 0 0.0 0.0 4.681000232696533 READ_WRITE ECU_ADDRESS 0x3FB47C /end MEASUREMENT
/begin MEASUREMENT auss_spark_time_fil_zyl7 "Funkenbrenndauer." SWORD FORMULA_0445 0 0.0 0.0 4.681000232696533 READ_WRITE ECU_ADDRESS 0x3FB47E /end MEASUREMENT
/begin MEASUREMENT auss_spark_time_fil_zyl8 "Funkenbrenndauer." SWORD FORMULA_0445 0 0.0 0.0 4.681000232696533 READ_WRITE ECU_ADDRESS 0x3FB480 /end MEASUREMENT
/begin MEASUREMENT auss_spark_time_fil_zyl9 "Funkenbrenndauer." SWORD FORMULA_0445 0 0.0 0.0 4.681000232696533 READ_WRITE ECU_ADDRESS 0x3FB482 /end MEASUREMENT
/begin MEASUREMENT auss_spark_time_max_b1 "Max zulaessige Funkenbrenndauer" SWORD FORMULA_0445 0 0.0 0.0 4.681000232696533 READ_WRITE ECU_ADDRESS 0x3FB538 /end MEASUREMENT
/begin MEASUREMENT auss_spark_time_max_b2 "Max zulaessige Funkenbrenndauer" SWORD FORMULA_0445 0 0.0 0.0 4.681000232696533 READ_WRITE ECU_ADDRESS 0x3FB53A /end MEASUREMENT
/begin MEASUREMENT auss_spark_time_min_b1 "Min zulaessige Funkenbrenndauer" SWORD FORMULA_0445 0 0.0 0.0 4.681000232696533 READ_WRITE ECU_ADDRESS 0x3FB534 /end MEASUREMENT
/begin MEASUREMENT auss_spark_time_min_b2 "Min zulaessige Funkenbrenndauer" SWORD FORMULA_0445 0 0.0 0.0 4.681000232696533 READ_WRITE ECU_ADDRESS 0x3FB536 /end MEASUREMENT
/begin MEASUREMENT auss_spark_time_zyl1 "Funkenbrenndauer." SWORD FORMULA_0445 0 0.0 0.0 4.681000232696533 READ_WRITE ECU_ADDRESS 0x3FB45E /end MEASUREMENT
/begin MEASUREMENT auss_spark_time_zyl10 "Funkenbrenndauer." SWORD FORMULA_0445 0 0.0 0.0 4.681000232696533 READ_WRITE ECU_ADDRESS 0x3FB470 /end MEASUREMENT
/begin MEASUREMENT auss_spark_time_zyl2 "Funkenbrenndauer." SWORD FORMULA_0445 0 0.0 0.0 4.681000232696533 READ_WRITE ECU_ADDRESS 0x3FB460 /end MEASUREMENT
/begin MEASUREMENT auss_spark_time_zyl3 "Funkenbrenndauer." SWORD FORMULA_0445 0 0.0 0.0 4.681000232696533 READ_WRITE ECU_ADDRESS 0x3FB462 /end MEASUREMENT
/begin MEASUREMENT auss_spark_time_zyl4 "Funkenbrenndauer." SWORD FORMULA_0445 0 0.0 0.0 4.681000232696533 READ_WRITE ECU_ADDRESS 0x3FB464 /end MEASUREMENT
/begin MEASUREMENT auss_spark_time_zyl5 "Funkenbrenndauer." SWORD FORMULA_0445 0 0.0 0.0 4.681000232696533 READ_WRITE ECU_ADDRESS 0x3FB466 /end MEASUREMENT
/begin MEASUREMENT auss_spark_time_zyl6 "Funkenbrenndauer." SWORD FORMULA_0445 0 0.0 0.0 4.681000232696533 READ_WRITE ECU_ADDRESS 0x3FB468 /end MEASUREMENT
/begin MEASUREMENT auss_spark_time_zyl7 "Funkenbrenndauer." SWORD FORMULA_0445 0 0.0 0.0 4.681000232696533 READ_WRITE ECU_ADDRESS 0x3FB46A /end MEASUREMENT
/begin MEASUREMENT auss_spark_time_zyl8 "Funkenbrenndauer." SWORD FORMULA_0445 0 0.0 0.0 4.681000232696533 READ_WRITE ECU_ADDRESS 0x3FB46C /end MEASUREMENT
/begin MEASUREMENT auss_spark_time_zyl9 "Funkenbrenndauer." SWORD FORMULA_0445 0 0.0 0.0 4.681000232696533 READ_WRITE ECU_ADDRESS 0x3FB46E /end MEASUREMENT
/begin MEASUREMENT auss_tz_ed_ns_zyl1 "tz fuer Fehlereintrag Nebenschluss." SWORD FORMULA_0102 0 0.0 -50.0 60.0 READ_WRITE ECU_ADDRESS 0x3FB40E /end MEASUREMENT
/begin MEASUREMENT auss_tz_ed_ns_zyl10 "tz fuer Fehlereintrag Nebenschluss." SWORD FORMULA_0102 0 0.0 -50.0 60.0 READ_WRITE ECU_ADDRESS 0x3FB420 /end MEASUREMENT
/begin MEASUREMENT auss_tz_ed_ns_zyl2 "tz fuer Fehlereintrag Nebenschluss." SWORD FORMULA_0102 0 0.0 -50.0 60.0 READ_WRITE ECU_ADDRESS 0x3FB410 /end MEASUREMENT
/begin MEASUREMENT auss_tz_ed_ns_zyl3 "tz fuer Fehlereintrag Nebenschluss." SWORD FORMULA_0102 0 0.0 -50.0 60.0 READ_WRITE ECU_ADDRESS 0x3FB412 /end MEASUREMENT
/begin MEASUREMENT auss_tz_ed_ns_zyl4 "tz fuer Fehlereintrag Nebenschluss." SWORD FORMULA_0102 0 0.0 -50.0 60.0 READ_WRITE ECU_ADDRESS 0x3FB414 /end MEASUREMENT
/begin MEASUREMENT auss_tz_ed_ns_zyl5 "tz fuer Fehlereintrag Nebenschluss." SWORD FORMULA_0102 0 0.0 -50.0 60.0 READ_WRITE ECU_ADDRESS 0x3FB416 /end MEASUREMENT
/begin MEASUREMENT auss_tz_ed_ns_zyl6 "tz fuer Fehlereintrag Nebenschluss." SWORD FORMULA_0102 0 0.0 -50.0 60.0 READ_WRITE ECU_ADDRESS 0x3FB418 /end MEASUREMENT
/begin MEASUREMENT auss_tz_ed_ns_zyl7 "tz fuer Fehlereintrag Nebenschluss." SWORD FORMULA_0102 0 0.0 -50.0 60.0 READ_WRITE ECU_ADDRESS 0x3FB41A /end MEASUREMENT
/begin MEASUREMENT auss_tz_ed_ns_zyl8 "tz fuer Fehlereintrag Nebenschluss." SWORD FORMULA_0102 0 0.0 -50.0 60.0 READ_WRITE ECU_ADDRESS 0x3FB41C /end MEASUREMENT
/begin MEASUREMENT auss_tz_ed_ns_zyl9 "tz fuer Fehlereintrag Nebenschluss." SWORD FORMULA_0102 0 0.0 -50.0 60.0 READ_WRITE ECU_ADDRESS 0x3FB41E /end MEASUREMENT
/begin MEASUREMENT auss_tz_ed_ti_zyl1 "tz fuer Fehlereintrag Verbrennungsaussetzer." SWORD FORMULA_0102 0 0.0 -50.0 60.0 READ_WRITE ECU_ADDRESS 0x3FB3FA /end MEASUREMENT
/begin MEASUREMENT auss_tz_ed_ti_zyl10 "tz fuer Fehlereintrag Verbrennungsaussetzer." SWORD FORMULA_0102 0 0.0 -50.0 60.0 READ_WRITE ECU_ADDRESS 0x3FB40C /end MEASUREMENT
/begin MEASUREMENT auss_tz_ed_ti_zyl2 "tz fuer Fehlereintrag Verbrennungsaussetzer." SWORD FORMULA_0102 0 0.0 -50.0 60.0 READ_WRITE ECU_ADDRESS 0x3FB3FC /end MEASUREMENT
/begin MEASUREMENT auss_tz_ed_ti_zyl3 "tz fuer Fehlereintrag Verbrennungsaussetzer." SWORD FORMULA_0102 0 0.0 -50.0 60.0 READ_WRITE ECU_ADDRESS 0x3FB3FE /end MEASUREMENT
/begin MEASUREMENT auss_tz_ed_ti_zyl4 "tz fuer Fehlereintrag Verbrennungsaussetzer." SWORD FORMULA_0102 0 0.0 -50.0 60.0 READ_WRITE ECU_ADDRESS 0x3FB400 /end MEASUREMENT
/begin MEASUREMENT auss_tz_ed_ti_zyl5 "tz fuer Fehlereintrag Verbrennungsaussetzer." SWORD FORMULA_0102 0 0.0 -50.0 60.0 READ_WRITE ECU_ADDRESS 0x3FB402 /end MEASUREMENT
/begin MEASUREMENT auss_tz_ed_ti_zyl6 "tz fuer Fehlereintrag Verbrennungsaussetzer." SWORD FORMULA_0102 0 0.0 -50.0 60.0 READ_WRITE ECU_ADDRESS 0x3FB404 /end MEASUREMENT
/begin MEASUREMENT auss_tz_ed_ti_zyl7 "tz fuer Fehlereintrag Verbrennungsaussetzer." SWORD FORMULA_0102 0 0.0 -50.0 60.0 READ_WRITE ECU_ADDRESS 0x3FB406 /end MEASUREMENT
/begin MEASUREMENT auss_tz_ed_ti_zyl8 "tz fuer Fehlereintrag Verbrennungsaussetzer." SWORD FORMULA_0102 0 0.0 -50.0 60.0 READ_WRITE ECU_ADDRESS 0x3FB408 /end MEASUREMENT
/begin MEASUREMENT auss_tz_ed_ti_zyl9 "tz fuer Fehlereintrag Verbrennungsaussetzer." SWORD FORMULA_0102 0 0.0 -50.0 60.0 READ_WRITE ECU_ADDRESS 0x3FB40A /end MEASUREMENT
/begin MEASUREMENT auss_tz_ed_zyl1 "tz fuer Fehlereintrag." SWORD FORMULA_0102 0 0.0 -50.0 60.0 READ_WRITE ECU_ADDRESS 0x3FB3E6 /end MEASUREMENT
/begin MEASUREMENT auss_tz_ed_zyl10 "tz fuer Fehlereintrag." SWORD FORMULA_0102 0 0.0 -50.0 60.0 READ_WRITE ECU_ADDRESS 0x3FB3F8 /end MEASUREMENT
/begin MEASUREMENT auss_tz_ed_zyl2 "tz fuer Fehlereintrag." SWORD FORMULA_0102 0 0.0 -50.0 60.0 READ_WRITE ECU_ADDRESS 0x3FB3E8 /end MEASUREMENT
/begin MEASUREMENT auss_tz_ed_zyl3 "tz fuer Fehlereintrag." SWORD FORMULA_0102 0 0.0 -50.0 60.0 READ_WRITE ECU_ADDRESS 0x3FB3EA /end MEASUREMENT
/begin MEASUREMENT auss_tz_ed_zyl4 "tz fuer Fehlereintrag." SWORD FORMULA_0102 0 0.0 -50.0 60.0 READ_WRITE ECU_ADDRESS 0x3FB3EC /end MEASUREMENT
/begin MEASUREMENT auss_tz_ed_zyl5 "tz fuer Fehlereintrag." SWORD FORMULA_0102 0 0.0 -50.0 60.0 READ_WRITE ECU_ADDRESS 0x3FB3EE /end MEASUREMENT
/begin MEASUREMENT auss_tz_ed_zyl6 "tz fuer Fehlereintrag." SWORD FORMULA_0102 0 0.0 -50.0 60.0 READ_WRITE ECU_ADDRESS 0x3FB3F0 /end MEASUREMENT
/begin MEASUREMENT auss_tz_ed_zyl7 "tz fuer Fehlereintrag." SWORD FORMULA_0102 0 0.0 -50.0 60.0 READ_WRITE ECU_ADDRESS 0x3FB3F2 /end MEASUREMENT
/begin MEASUREMENT auss_tz_ed_zyl8 "tz fuer Fehlereintrag." SWORD FORMULA_0102 0 0.0 -50.0 60.0 READ_WRITE ECU_ADDRESS 0x3FB3F4 /end MEASUREMENT
/begin MEASUREMENT auss_tz_ed_zyl9 "tz fuer Fehlereintrag." SWORD FORMULA_0102 0 0.0 -50.0 60.0 READ_WRITE ECU_ADDRESS 0x3FB3F6 /end MEASUREMENT
/begin MEASUREMENT auss_tz_offs_b1 "Offsets vom Aussetzerfenster." SWORD FORMULA_0446 0 0.0 4.000000189989805e-003 8.187999725341797 READ_WRITE ECU_ADDRESS 0x3FB3A6 /end MEASUREMENT
/begin MEASUREMENT auss_tz_offs_b2 "Offsets vom Aussetzerfenster." SWORD FORMULA_0446 0 0.0 4.000000189989805e-003 8.187999725341797 READ_WRITE ECU_ADDRESS 0x3FB3A8 /end MEASUREMENT
/begin MEASUREMENT bgTaskCtr "Counter" UWORD FORMULA_0010 0 0.0 0.0 65535.0 READ_WRITE ECU_ADDRESS 0x3FB578 /end MEASUREMENT
/begin MEASUREMENT cana_ctBoffDbounce "BusOff-Counter" UBYTE FORMULA_0003 0 0.0 0.0 255.0 READ_WRITE ECU_ADDRESS 0x3FB57A /end MEASUREMENT
/begin MEASUREMENT canb_ctBoffDbounce "BusOff-Counter" UBYTE FORMULA_0003 0 0.0 0.0 255.0 READ_WRITE ECU_ADDRESS 0x3FB57B /end MEASUREMENT
/begin MEASUREMENT crc32_boot "Booter-CRC" ULONG FORMULA_0000 0 0.0 0.0 4294967295.0 READ_WRITE ECU_ADDRESS 0x3FB55C /end MEASUREMENT
/begin MEASUREMENT crc32_boot_st "Status CRC-Berechnung" UBYTE FORMULA_0043 0 0.0 0.0 255.0 READ_WRITE ECU_ADDRESS 0x3FB55B /end MEASUREMENT
/begin MEASUREMENT crc32_data "Daten-CRC" ULONG FORMULA_0000 0 0.0 0.0 4294967295.0 READ_WRITE ECU_ADDRESS 0x3FB564 /end MEASUREMENT
/begin MEASUREMENT crc32_data_st "Status CRC-Berechnung" UBYTE FORMULA_0043 0 0.0 0.0 255.0 READ_WRITE ECU_ADDRESS 0x3FB559 /end MEASUREMENT
/begin MEASUREMENT crc32_prog "Programm-CRC" ULONG FORMULA_0000 0 0.0 0.0 4294967295.0 READ_WRITE ECU_ADDRESS 0x3FB560 /end MEASUREMENT
/begin MEASUREMENT crc32_prog_st "Status CRC-Berechnung" UBYTE FORMULA_0043 0 0.0 0.0 255.0 READ_WRITE ECU_ADDRESS 0x3FB55A /end MEASUREMENT
/begin MEASUREMENT crc32_result "Ergebnis der CRC-Berechnungen" UBYTE FORMULA_0042 0 0.0 0.0 255.0 READ_WRITE ECU_ADDRESS 0x3FB558 /end MEASUREMENT
/begin MEASUREMENT debug_rw_result "Result Read/-Write Operation" ULONG FORMULA_0000 0 0.0 0.0 4294967295.0 READ_WRITE ECU_ADDRESS 0x3FB57C /end MEASUREMENT
/begin MEASUREMENT diag_st_atic29_ion1_spg "Diagnosestatus ATIC29 Treiber Queue IGN" UBYTE FORMULA_0209 0 0.0 0.0 15.0 READ_WRITE BIT_MASK 0xF ECU_ADDRESS 0x3FB585 /end MEASUREMENT
/begin MEASUREMENT diag_st_atic29_ion1_verst "Diagnosestatus ATIC29 Treiber Queue IGN" UBYTE FORMULA_0209 0 0.0 0.0 15.0 READ_WRITE BIT_MASK 0xF ECU_ADDRESS 0x3FB584 /end MEASUREMENT
/begin MEASUREMENT diag_st_atic29_ion2_spg "Diagnosestatus ATIC29 Treiber Queue IGN" UBYTE FORMULA_0209 0 0.0 0.0 15.0 READ_WRITE BIT_MASK 0xF ECU_ADDRESS 0x3FB587 /end MEASUREMENT
/begin MEASUREMENT diag_st_atic29_ion2_verst "Diagnosestatus ATIC29 Treiber Queue IGN" UBYTE FORMULA_0209 0 0.0 0.0 15.0 READ_WRITE BIT_MASK 0xF ECU_ADDRESS 0x3FB586 /end MEASUREMENT
/begin MEASUREMENT diag_st_atic29_nn "Diagnosestatus ATIC29 Treiber Queue IGN" UBYTE FORMULA_0209 0 0.0 0.0 15.0 READ_WRITE BIT_MASK 0xF ECU_ADDRESS 0x3FB583 /end MEASUREMENT
/begin MEASUREMENT diag_tr_atic29_error "Error Zaheler Atic29" UBYTE FORMULA_0037 0 0.0 0.0 255.0 READ_WRITE ECU_ADDRESS 0x3FB582 /end MEASUREMENT
/begin MEASUREMENT diag_tr_atic29_st "Diagnosetreiberstatus" UBYTE FORMULA_0571 0 0.0 0.0 255.0 READ_WRITE ECU_ADDRESS 0x3FB588 /end MEASUREMENT
/begin MEASUREMENT diag_tr_atic29_tx_cnt "Checkbyte fuer die Queue" UBYTE FORMULA_0037 0 0.0 0.0 255.0 READ_WRITE ECU_ADDRESS 0x3FB581 /end MEASUREMENT
/begin MEASUREMENT dkg_kupp_kriech "Kriechmoment der Kupplung" SWORD FORMULA_0009 0 0.0 -100.0 1000.0 READ_WRITE ECU_ADDRESS 0x3FB59A /end MEASUREMENT
/begin MEASUREMENT dkg_kupp_schleif "Verlustmoment der Kupplung" SWORD FORMULA_0009 0 0.0 -100.0 1000.0 READ_WRITE ECU_ADDRESS 0x3FB598 /end MEASUREMENT
/begin MEASUREMENT dkg_md_kupp_begr "DKG-Begrenzung" SWORD FORMULA_0009 0 0.0 -100.0 1000.0 READ_WRITE ECU_ADDRESS 0x3FB596 /end MEASUREMENT
/begin MEASUREMENT dkg_md_ml_erh "DKG-Eingriff Luft erh." SWORD FORMULA_0009 0 0.0 -100.0 1000.0 READ_WRITE ECU_ADDRESS 0x3FB592 /end MEASUREMENT
/begin MEASUREMENT dkg_md_ml_red "DKG-Eingriff Luft red." SWORD FORMULA_0009 0 0.0 -100.0 1000.0 READ_WRITE ECU_ADDRESS 0x3FB58E /end MEASUREMENT
/begin MEASUREMENT dkg_md_n_reg_ml "DKG-nRegler Luft" SWORD FORMULA_0009 0 0.0 -100.0 1000.0 READ_WRITE ECU_ADDRESS 0x3FB58A /end MEASUREMENT
/begin MEASUREMENT dkg_md_n_reg_tz "DKG-nRegler TZ" SWORD FORMULA_0009 0 0.0 -100.0 1000.0 READ_WRITE ECU_ADDRESS 0x3FB58C /end MEASUREMENT
/begin MEASUREMENT dkg_md_tz_erh "DKG-Eingriff TZ erh." SWORD FORMULA_0009 0 0.0 -100.0 1000.0 READ_WRITE ECU_ADDRESS 0x3FB594 /end MEASUREMENT
/begin MEASUREMENT dkg_md_tz_red "DKG-Eingriff TZ red." SWORD FORMULA_0009 0 0.0 -100.0 1000.0 READ_WRITE ECU_ADDRESS 0x3FB590 /end MEASUREMENT
/begin MEASUREMENT dkg_n_getr_ziel "Getriebezieldrehzahl" SWORD FORMULA_0006 0 0.0 0.0 10000.0 READ_WRITE ECU_ADDRESS 0x3FB59C /end MEASUREMENT
/begin MEASUREMENT dkg_sperr_st "DKG-Sperre" UBYTE FORMULA_0572 0 0.0 0.0 255.0 READ_WRITE ECU_ADDRESS 0x3FB5A2 /end MEASUREMENT
/begin MEASUREMENT dkg_t_wait "Wartezeit vor DKG-Rampe" UWORD FORMULA_0109 0 0.0 0.0 10.0 READ_WRITE ECU_ADDRESS 0x3FB5A0 /end MEASUREMENT
/begin MEASUREMENT dkg_timer "DKG-Timer" UWORD FORMULA_0109 0 0.0 0.0 325.0 READ_WRITE ECU_ADDRESS 0x3FB59E /end MEASUREMENT
/begin MEASUREMENT dr_rel_roh_b1 "relative Drosselung Roh (ohne Filterung)" SWORD FORMULA_0106 0 0.0 0.0 199.9938049316406 READ_WRITE ECU_ADDRESS 0x3FB1FE /end MEASUREMENT
/begin MEASUREMENT dr_rel_roh_b2 "relative Drosselung Roh (ohne Filterung)" SWORD FORMULA_0106 0 0.0 0.0 199.9938049316406 READ_WRITE ECU_ADDRESS 0x3FB200 /end MEASUREMENT
/begin MEASUREMENT hwTaskCtr "Counter" UWORD FORMULA_0010 0 0.0 0.0 65535.0 READ_WRITE ECU_ADDRESS 0x3FB568 /end MEASUREMENT
/begin MEASUREMENT n_e2_st "Status Drehzahl fuer Ebene 2" UBYTE FORMULA_0814 0 0.0 0.0 255.0 READ_WRITE ECU_ADDRESS 0x3FC8A8 /end MEASUREMENT
/begin MEASUREMENT n_e2_t "Fehlerzeit der Drehzahl fuer Ebene 2" UWORD FORMULA_0021 0 0.0 0.0 655.0 READ_WRITE ECU_ADDRESS 0x3FC8AA /end MEASUREMENT
/begin MEASUREMENT n_proz "Ersatzdrehzahl des jeweiligen Prozessors." SWORD FORMULA_0006 0 0.0 0.0 10000.0 READ_WRITE ECU_ADDRESS 0x3FC218 /end MEASUREMENT
/begin MEASUREMENT n_segm_a "Drehzahl aus Segmentabstand." SWORD FORMULA_0006 0 0.0 0.0 10000.0 READ_WRITE ECU_ADDRESS 0x3FC21E /end MEASUREMENT
/begin MEASUREMENT n_segm_b "Drehzahl aus Segmentabstand." SWORD FORMULA_0006 0 0.0 0.0 10000.0 READ_WRITE ECU_ADDRESS 0x3FC220 /end MEASUREMENT
/begin MEASUREMENT n_st_a "Status Drehzahlerfassung" UBYTE FORMULA_0353 0 0.0 0.0 255.0 READ_WRITE ECU_ADDRESS 0x3FC214 /end MEASUREMENT
/begin MEASUREMENT n_st_b "Status Drehzahlerfassung" UBYTE FORMULA_0353 0 0.0 0.0 255.0 READ_WRITE ECU_ADDRESS 0x3FC215 /end MEASUREMENT
/begin MEASUREMENT n_t_segm_a "Segmentzeit." UWORD FORMULA_0354 0 0.0 0.0 104.8560028076172 READ_WRITE ECU_ADDRESS 0x3FC222 /end MEASUREMENT
/begin MEASUREMENT n_t_segm_b "Segmentzeit." UWORD FORMULA_0354 0 0.0 0.0 104.8560028076172 READ_WRITE ECU_ADDRESS 0x3FC224 /end MEASUREMENT
/begin MEASUREMENT n_t_segm_start_a "Segmentstartzeit." ULONG FORMULA_0017 0 0.0 0.0 2396.745 READ_WRITE ECU_ADDRESS 0x3FC228 /end MEASUREMENT
/begin MEASUREMENT n_t_segm_start_b "Segmentstartzeit." ULONG FORMULA_0017 0 0.0 0.0 2396.745 READ_WRITE ECU_ADDRESS 0x3FC22C /end MEASUREMENT
/begin MEASUREMENT n_timer_stoerung_a "Zeitzaehler fuer Freeze Drehzahlerfassung" SBYTE FORMULA_0306 0 0.0 -1.279999971389771 1.269999980926514 READ_WRITE ECU_ADDRESS 0x3FC216 /end MEASUREMENT
/begin MEASUREMENT n_timer_stoerung_b "Zeitzaehler fuer Freeze Drehzahlerfassung" SBYTE FORMULA_0306 0 0.0 -1.279999971389771 1.269999980926514 READ_WRITE ECU_ADDRESS 0x3FC217 /end MEASUREMENT
/begin MEASUREMENT n_zahn_a "Drehzahl aus Zahnabstand" SWORD FORMULA_0006 0 0.0 0.0 10000.0 READ_WRITE ECU_ADDRESS 0x3FC21A /end MEASUREMENT
/begin MEASUREMENT n_zahn_b "Drehzahl aus Zahnabstand" SWORD FORMULA_0006 0 0.0 0.0 10000.0 READ_WRITE ECU_ADDRESS 0x3FC21C /end MEASUREMENT
/begin MEASUREMENT os_err.addr "OS-Err: Adresse" ULONG FORMULA_0000 0 0.0 0.0 4294967295.0 READ_WRITE ECU_ADDRESS 0x3FC28C /end MEASUREMENT
/begin MEASUREMENT os_err.deadline.cnt "OS-Err: Deadline" UBYTE FORMULA_0003 0 0.0 0.0 255.0 READ_WRITE ECU_ADDRESS 0x3FC288 /end MEASUREMENT
/begin MEASUREMENT os_err.deadline.task "OS-Err: Deadline" UBYTE FORMULA_0355 0 0.0 0.0 255.0 READ_WRITE ECU_ADDRESS 0x3FC289 /end MEASUREMENT
/begin MEASUREMENT os_err.dflt.cnt "OS-Err: Default" UBYTE FORMULA_0003 0 0.0 0.0 255.0 READ_WRITE ECU_ADDRESS 0x3FC28A /end MEASUREMENT
/begin MEASUREMENT os_err.dflt.task "OS-Err: Default" UBYTE FORMULA_0355 0 0.0 0.0 255.0 READ_WRITE ECU_ADDRESS 0x3FC28B /end MEASUREMENT
/begin MEASUREMENT os_err.fifo.cnt "OS-Err: FIFO full" UBYTE FORMULA_0003 0 0.0 0.0 255.0 READ_WRITE ECU_ADDRESS 0x3FC284 /end MEASUREMENT
/begin MEASUREMENT os_err.fifo.task "OS-Err: FIFO full" UBYTE FORMULA_0355 0 0.0 0.0 255.0 READ_WRITE ECU_ADDRESS 0x3FC285 /end MEASUREMENT
/begin MEASUREMENT os_err.id.cnt "OS-Err: ID" UBYTE FORMULA_0003 0 0.0 0.0 255.0 READ_WRITE ECU_ADDRESS 0x3FC278 /end MEASUREMENT
/begin MEASUREMENT os_err.id.task "OS-Err: ID" UBYTE FORMULA_0355 0 0.0 0.0 255.0 READ_WRITE ECU_ADDRESS 0x3FC279 /end MEASUREMENT
/begin MEASUREMENT os_err.limit.cnt "OS-Err: Limit" UBYTE FORMULA_0003 0 0.0 0.0 255.0 READ_WRITE ECU_ADDRESS 0x3FC27A /end MEASUREMENT
/begin MEASUREMENT os_err.limit.task "OS-Err: Limit" UBYTE FORMULA_0355 0 0.0 0.0 255.0 READ_WRITE ECU_ADDRESS 0x3FC27B /end MEASUREMENT
/begin MEASUREMENT os_err.no_fnc.cnt "OS-Err: No Fkt" UBYTE FORMULA_0003 0 0.0 0.0 255.0 READ_WRITE ECU_ADDRESS 0x3FC27E /end MEASUREMENT
/begin MEASUREMENT os_err.no_fnc.task "OS-Err: No Fkt" UBYTE FORMULA_0355 0 0.0 0.0 255.0 READ_WRITE ECU_ADDRESS 0x3FC27F /end MEASUREMENT
/begin MEASUREMENT os_err.stack.cnt "OS-Err: Stack" UBYTE FORMULA_0003 0 0.0 0.0 255.0 READ_WRITE ECU_ADDRESS 0x3FC282 /end MEASUREMENT
/begin MEASUREMENT os_err.stack.task "OS-Err: Stack" UBYTE FORMULA_0355 0 0.0 0.0 255.0 READ_WRITE ECU_ADDRESS 0x3FC283 /end MEASUREMENT
/begin MEASUREMENT os_err.sum_cnt "OS-Err: Summe" UBYTE FORMULA_0003 0 0.0 0.0 255.0 READ_WRITE ECU_ADDRESS 0x3FC290 /end MEASUREMENT
/begin MEASUREMENT os_err.tt_act.cnt "OS-Err: TT aktiv" UBYTE FORMULA_0003 0 0.0 0.0 255.0 READ_WRITE ECU_ADDRESS 0x3FC27C /end MEASUREMENT
/begin MEASUREMENT os_err.tt_act.task "OS-Err: TT aktiv" UBYTE FORMULA_0355 0 0.0 0.0 255.0 READ_WRITE ECU_ADDRESS 0x3FC27D /end MEASUREMENT
/begin MEASUREMENT os_err.tt_miss.cnt "OS-Err: TT missing" UBYTE FORMULA_0003 0 0.0 0.0 255.0 READ_WRITE ECU_ADDRESS 0x3FC280 /end MEASUREMENT
/begin MEASUREMENT os_err.tt_miss.task "OS-Err: TT missing" UBYTE FORMULA_0355 0 0.0 0.0 255.0 READ_WRITE ECU_ADDRESS 0x3FC281 /end MEASUREMENT
/begin MEASUREMENT os_err.type "Fehlertyp" UBYTE FORMULA_0356 0 0.0 0.0 255.0 READ_WRITE ECU_ADDRESS 0x3FC291 /end MEASUREMENT
/begin MEASUREMENT os_err.value.cnt "OS-Err: Value" UBYTE FORMULA_0003 0 0.0 0.0 255.0 READ_WRITE ECU_ADDRESS 0x3FC286 /end MEASUREMENT
/begin MEASUREMENT os_err.value.task "OS-Err: Value" UBYTE FORMULA_0355 0 0.0 0.0 255.0 READ_WRITE ECU_ADDRESS 0x3FC287 /end MEASUREMENT
/begin MEASUREMENT r100msTaskCtr "Counter" UWORD FORMULA_0010 0 0.0 0.0 65535.0 READ_WRITE ECU_ADDRESS 0x3FB574 /end MEASUREMENT
/begin MEASUREMENT r10msTaskCtr "Counter" ULONG FORMULA_0000 0 0.0 0.0 4294967295.0 READ_WRITE ECU_ADDRESS 0x3FB570 /end MEASUREMENT
/begin MEASUREMENT r1msTaskCtr "Counter" UWORD FORMULA_0010 0 0.0 0.0 65535.0 READ_WRITE ECU_ADDRESS 0x3FB56C /end MEASUREMENT
/begin MEASUREMENT r1sTaskCtr "Counter" UWORD FORMULA_0010 0 0.0 0.0 65535.0 READ_WRITE ECU_ADDRESS 0x3FB576 /end MEASUREMENT
/begin MEASUREMENT r5msTaskCtr "Counter" UWORD FORMULA_0010 0 0.0 0.0 65535.0 READ_WRITE ECU_ADDRESS 0x3FB56E /end MEASUREMENT
/begin MEASUREMENT syncTaskCtr "Counter" UWORD FORMULA_0010 0 0.0 0.0 65535.0 READ_WRITE ECU_ADDRESS 0x3FB56A /end MEASUREMENT
/begin MEASUREMENT ub_ad "AD-Wert der U_KL87-Erfassung" SWORD FORMULA_0114 0 0.0 0.0 1023.0 READ_WRITE ECU_ADDRESS 0x3FC718 /end MEASUREMENT
/begin MEASUREMENT ub_diag_kl87_sperre "Sperre der Diagnose nach KL87 aus" UBYTE FORMULA_0584 0 0.0 0.0 1275.0 READ_WRITE ECU_ADDRESS 0x3FC720 /end MEASUREMENT
/begin MEASUREMENT ub_filter "Gefilterter Messwert der U_KL87-Erfassung" SWORD FORMULA_0261 0 0.0 0.0 28.0 READ_WRITE ECU_ADDRESS 0x3FC71A /end MEASUREMENT
/begin MEASUREMENT ub_grad_int "Integral des Gradienten" SWORD FORMULA_0261 0 0.0 0.0 50.0 READ_WRITE ECU_ADDRESS 0x3FC71E /end MEASUREMENT
/begin MEASUREMENT ub_old "UB bei der letzten Erfassung" SWORD FORMULA_0261 0 0.0 0.0 28.0 READ_WRITE ECU_ADDRESS 0x3FC71C /end MEASUREMENT
/begin COMPU_METHOD FORMULA_0000 "FORMULA_0000" RAT_FUNC "%7.0" "-" COEFFS 0 1 0 0 0 1 /end COMPU_METHOD
/begin COMPU_METHOD FORMULA_0001 "FORMULA_0001" RAT_FUNC "%6.1" "%" COEFFS 0 10.0 0.0 0 0.0 1.0 /end COMPU_METHOD
/begin COMPU_METHOD FORMULA_0003 "FORMULA_0003" RAT_FUNC "%3.0" "-" COEFFS 0 1 0 0 0 1 /end COMPU_METHOD
/begin COMPU_METHOD FORMULA_0006 "FORMULA_0006" RAT_FUNC "%5.0" "Upm" COEFFS 0 1 0 0 0 1 /end COMPU_METHOD
/begin COMPU_METHOD FORMULA_0007 "FORMULA_0007" RAT_FUNC "%8.3" "-" COEFFS 0 10000.0 0.0 0 0.0 1.0 /end COMPU_METHOD
/begin COMPU_METHOD FORMULA_0008 "FORMULA_0008" RAT_FUNC "%6.1" "V" COEFFS 0 10.0 0.0 0 0.0 1.0 /end COMPU_METHOD
/begin COMPU_METHOD FORMULA_0009 "FORMULA_0009" RAT_FUNC "%6.1" "Nm" COEFFS 0 10.0 0.0 0 0.0 1.0 /end COMPU_METHOD
/begin COMPU_METHOD FORMULA_0010 "FORMULA_0010" RAT_FUNC "%5.0" "-" COEFFS 0 1 0 0 0 1 /end COMPU_METHOD
/begin COMPU_METHOD FORMULA_0017 "FORMULA_0017" RAT_FUNC "%9.2" "ms" COEFFS 0 7000.0 0.0 0 0.0 1.0 /end COMPU_METHOD
/begin COMPU_METHOD FORMULA_0020 "FORMULA_0020" RAT_FUNC "%5.0" "qmm/s" COEFFS 0 5.e-002 0.0 0 0.0 1.0 /end COMPU_METHOD
/begin COMPU_METHOD FORMULA_0021 "FORMULA_0021" RAT_FUNC "%7.2" "s" COEFFS 0 100.0 0.0 0 0.0 1.0 /end COMPU_METHOD
/begin COMPU_METHOD FORMULA_0023 "FORMULA_0023" RAT_FUNC "%6.1" "°C" COEFFS 0 10.0 2732.0 0 0.0 1.0 /end COMPU_METHOD
/begin COMPU_METHOD FORMULA_0025 "FORMULA_0025" RAT_FUNC "%8.3" "-" COEFFS 0 16384.0 0.0 0 0.0 1.0 /end COMPU_METHOD
/begin COMPU_METHOD FORMULA_0037 "FORMULA_0037" RAT_FUNC "%5.2" "-" COEFFS 0 1 0 0 0 1 /end COMPU_METHOD
/begin COMPU_METHOD FORMULA_0042 "FORMULA_0042" TAB_VERB "%3.0" "-" COMPU_TAB_REF FORMULA_0042_VTAB /end COMPU_METHOD
/begin COMPU_METHOD FORMULA_0043 "FORMULA_0043" TAB_VERB "%3.0" "-" COMPU_TAB_REF FORMULA_0043_VTAB /end COMPU_METHOD
/begin COMPU_METHOD FORMULA_0044 "FORMULA_0044" RAT_FUNC "%9.2" "-" COEFFS 0 1 0 0 0 1 /end COMPU_METHOD
/begin COMPU_METHOD FORMULA_0073 "FORMULA_0073" RAT_FUNC "%8.3" "-" COEFFS 0 1024.0 0.0 0 0.0 1.0 /end COMPU_METHOD
/begin COMPU_METHOD FORMULA_0075 "FORMULA_0075" RAT_FUNC "%6.1" "mbar" COEFFS 0 16.0 0.0 0 0.0 1.0 /end COMPU_METHOD
/begin COMPU_METHOD FORMULA_0076 "FORMULA_0076" RAT_FUNC "%6.1" "km/h" COEFFS 0 16.0 0.0 0 0.0 1.0 /end COMPU_METHOD
/begin COMPU_METHOD FORMULA_0102 "FORMULA_0102" RAT_FUNC "%6.1" "°KW" COEFFS 0 10.0 0.0 0 0.0 1.0 /end COMPU_METHOD
/begin COMPU_METHOD FORMULA_0106 "FORMULA_0106" RAT_FUNC "%7.2" "%" COEFFS 0 163.84 0.0 0 0.0 1.0 /end COMPU_METHOD
/begin COMPU_METHOD FORMULA_0109 "FORMULA_0109" RAT_FUNC "%7.2" "s" COEFFS 0 200.0 0.0 0 0.0 1.0 /end COMPU_METHOD
/begin COMPU_METHOD FORMULA_0114 "FORMULA_0114" RAT_FUNC "%5.0" "digit" COEFFS 0 1 0 0 0 1 /end COMPU_METHOD
/begin COMPU_METHOD FORMULA_0123 "FORMULA_0123" RAT_FUNC "%7.2" "m/(s*s)" COEFFS 0 40.0 0.0 0 0.0 1.0 /end COMPU_METHOD
/begin COMPU_METHOD FORMULA_0143 "FORMULA_0143" RAT_FUNC "%6.1" "qmm" COEFFS 0 10.0 0.0 0 0.0 1.0 /end COMPU_METHOD
/begin COMPU_METHOD FORMULA_0147 "FORMULA_0147" RAT_FUNC "%9.2" "s" COEFFS 0 100.0 0.0 0 0.0 1.0 /end COMPU_METHOD
/begin COMPU_METHOD FORMULA_0209 "FORMULA_0209" TAB_VERB "%5.2" "-" COMPU_TAB_REF FORMULA_0209_VTAB /end COMPU_METHOD
/begin COMPU_METHOD FORMULA_0214 "FORMULA_0214" RAT_FUNC "%3.0" "s" COEFFS 0 1 0 0 0 1 /end COMPU_METHOD
/begin COMPU_METHOD FORMULA_0227 "FORMULA_0227" RAT_FUNC "%7.2" "nSs" COEFFS 0 51.22410237444204 0.0 0 0.0 1.0 /end COMPU_METHOD
/begin COMPU_METHOD FORMULA_0231 "FORMULA_0231" RAT_FUNC "%8.3" "°KW/Segm" COEFFS 0 10.0 0.0 0 0.0 1.0 /end COMPU_METHOD
/begin COMPU_METHOD FORMULA_0261 "FORMULA_0261" RAT_FUNC "%8.3" "V" COEFFS 0 641.469735457881 0.0 0 0.0 1.0 /end COMPU_METHOD
/begin COMPU_METHOD FORMULA_0306 "FORMULA_0306" RAT_FUNC "%5.2" "s" COEFFS 0 100.0 0.0 0 0.0 1.0 /end COMPU_METHOD
/begin COMPU_METHOD FORMULA_0353 "FORMULA_0353" TAB_VERB "%3.0" "-" COMPU_TAB_REF FORMULA_0353_VTAB /end COMPU_METHOD
/begin COMPU_METHOD FORMULA_0354 "FORMULA_0354" RAT_FUNC "%7.2" "ms" COEFFS 0 625.0 0.0 0 0.0 1.0 /end COMPU_METHOD
/begin COMPU_METHOD FORMULA_0355 "FORMULA_0355" TAB_VERB "%3.0" "-" COMPU_TAB_REF FORMULA_0355_VTAB /end COMPU_METHOD
/begin COMPU_METHOD FORMULA_0356 "FORMULA_0356" TAB_VERB "%3.0" "-" COMPU_TAB_REF FORMULA_0356_VTAB /end COMPU_METHOD
/begin COMPU_METHOD FORMULA_0357 "FORMULA_0357" RAT_FUNC "%5.2" "s" COEFFS 0 200.0 0.0 0 0.0 1.0 /end COMPU_METHOD
/begin COMPU_METHOD FORMULA_0408 "FORMULA_0408" RAT_FUNC "%3.0" "-" COEFFS 0 1.0 -1.0 0 0.0 1.0 /end COMPU_METHOD
/begin COMPU_METHOD FORMULA_0442 "FORMULA_0442" RAT_FUNC "%7.2" "V" COEFFS 0 1241.21837996177 0.0 0 0.0 1.0 /end COMPU_METHOD
/begin COMPU_METHOD FORMULA_0445 "FORMULA_0445" RAT_FUNC "%7.2" "ms" COEFFS 0 7000.0 0.0 0 0.0 1.0 /end COMPU_METHOD
/begin COMPU_METHOD FORMULA_0446 "FORMULA_0446" RAT_FUNC "%7.2" "ms" COEFFS 0 250.0 0.0 0 0.0 1.0 /end COMPU_METHOD
/begin COMPU_METHOD FORMULA_0454 "FORMULA_0454" RAT_FUNC "%7.2" "m/(s*s)" COEFFS 0 14.61887523581298 0.0 0 0.0 1.0 /end COMPU_METHOD
/begin COMPU_METHOD FORMULA_0455 "FORMULA_0455" RAT_FUNC "%5.2" "s" COEFFS 0 0 2.56 0 1 0 /end COMPU_METHOD
/begin COMPU_METHOD FORMULA_0456 "FORMULA_0456" TAB_VERB "%3.0" "-" COMPU_TAB_REF FORMULA_0456_VTAB /end COMPU_METHOD
/begin COMPU_METHOD FORMULA_0457 "FORMULA_0457" TAB_VERB "%3.0" "-" COMPU_TAB_REF FORMULA_0457_VTAB /end COMPU_METHOD
/begin COMPU_METHOD FORMULA_0458 "FORMULA_0458" TAB_VERB "%5.0" "-" COMPU_TAB_REF FORMULA_0458_VTAB /end COMPU_METHOD
/begin COMPU_METHOD FORMULA_0459 "FORMULA_0459" TAB_VERB "%5.0" "-" COMPU_TAB_REF FORMULA_0459_VTAB /end COMPU_METHOD
/begin COMPU_METHOD FORMULA_0460 "FORMULA_0460" TAB_VERB "%5.0" "-" COMPU_TAB_REF FORMULA_0460_VTAB /end COMPU_METHOD
/begin COMPU_METHOD FORMULA_0461 "FORMULA_0461" TAB_VERB "%5.0" "-" COMPU_TAB_REF FORMULA_0461_VTAB /end COMPU_METHOD
/begin COMPU_METHOD FORMULA_0462 "FORMULA_0462" TAB_VERB "%5.0" "-" COMPU_TAB_REF FORMULA_0462_VTAB /end COMPU_METHOD
/begin COMPU_METHOD FORMULA_0463 "FORMULA_0463" TAB_VERB "%5.0" "-" COMPU_TAB_REF FORMULA_0463_VTAB /end COMPU_METHOD
/begin COMPU_METHOD FORMULA_0464 "FORMULA_0464" TAB_VERB "%5.0" "-" COMPU_TAB_REF FORMULA_0464_VTAB /end COMPU_METHOD
/begin COMPU_METHOD FORMULA_0465 "FORMULA_0465" TAB_VERB "%5.0" "-" COMPU_TAB_REF FORMULA_0465_VTAB /end COMPU_METHOD
/begin COMPU_METHOD FORMULA_0466 "FORMULA_0466" TAB_VERB "%5.0" "-" COMPU_TAB_REF FORMULA_0466_VTAB /end COMPU_METHOD
/begin COMPU_METHOD FORMULA_0467 "FORMULA_0467" TAB_VERB "%5.0" "-" COMPU_TAB_REF FORMULA_0467_VTAB /end COMPU_METHOD
/begin COMPU_METHOD FORMULA_0468 "FORMULA_0468" TAB_VERB "%5.0" "-" COMPU_TAB_REF FORMULA_0468_VTAB /end COMPU_METHOD
/begin COMPU_METHOD FORMULA_0469 "FORMULA_0469" RAT_FUNC "%7.2" "s" COEFFS 0 0 327.67 0 1 0 /end COMPU_METHOD
/begin COMPU_METHOD FORMULA_0470 "FORMULA_0470" RAT_FUNC "%6.3" "s" COEFFS 0 0 1.28 0 1 0 /end COMPU_METHOD
/begin COMPU_METHOD FORMULA_0471 "FORMULA_0471" RAT_FUNC "%4.1" "%" COEFFS 0 10.0 0.0 0 0.0 1.0 /end COMPU_METHOD
/begin COMPU_METHOD FORMULA_0472 "FORMULA_0472" RAT_FUNC "%8.3" "s" COEFFS 0 0 327.67 0 1 0 /end COMPU_METHOD
/begin COMPU_METHOD FORMULA_0491 "FORMULA_0491" TAB_VERB "%3.0" "-" COMPU_TAB_REF FORMULA_0491_VTAB /end COMPU_METHOD
/begin COMPU_METHOD FORMULA_0492 "FORMULA_0492" RAT_FUNC "%4.1" "s" COEFFS 0 10.0 0.0 0 0.0 1.0 /end COMPU_METHOD
/begin COMPU_METHOD FORMULA_0493 "FORMULA_0493" RAT_FUNC "%5.2" "-" COEFFS 0 255.0 0.0 0 0.0 1.0 /end COMPU_METHOD
/begin COMPU_METHOD FORMULA_0494 "FORMULA_0494" TAB_VERB "%5.0" "-" COMPU_TAB_REF FORMULA_0494_VTAB /end COMPU_METHOD
/begin COMPU_METHOD FORMULA_0495 "FORMULA_0495" TAB_VERB "%5.0" "-" COMPU_TAB_REF FORMULA_0495_VTAB /end COMPU_METHOD
/begin COMPU_METHOD FORMULA_0496 "FORMULA_0496" TAB_VERB "%5.0" "-" COMPU_TAB_REF FORMULA_0496_VTAB /end COMPU_METHOD
/begin COMPU_METHOD FORMULA_0497 "FORMULA_0497" TAB_VERB "%5.0" "-" COMPU_TAB_REF FORMULA_0497_VTAB /end COMPU_METHOD
/begin COMPU_METHOD FORMULA_0498 "FORMULA_0498" TAB_VERB "%5.0" "-" COMPU_TAB_REF FORMULA_0498_VTAB /end COMPU_METHOD
/begin COMPU_METHOD FORMULA_0499 "FORMULA_0499" TAB_VERB "%5.0" "-" COMPU_TAB_REF FORMULA_0499_VTAB /end COMPU_METHOD
/begin COMPU_METHOD FORMULA_0500 "FORMULA_0500" TAB_VERB "%5.0" "-" COMPU_TAB_REF FORMULA_0500_VTAB /end COMPU_METHOD
/begin COMPU_METHOD FORMULA_0501 "FORMULA_0501" TAB_VERB "%5.0" "-" COMPU_TAB_REF FORMULA_0501_VTAB /end COMPU_METHOD
/begin COMPU_METHOD FORMULA_0502 "FORMULA_0502" TAB_VERB "%5.0" "-" COMPU_TAB_REF FORMULA_0502_VTAB /end COMPU_METHOD
/begin COMPU_METHOD FORMULA_0503 "FORMULA_0503" TAB_VERB "%5.0" "-" COMPU_TAB_REF FORMULA_0503_VTAB /end COMPU_METHOD
/begin COMPU_METHOD FORMULA_0504 "FORMULA_0504" TAB_VERB "%5.0" "-" COMPU_TAB_REF FORMULA_0504_VTAB /end COMPU_METHOD
/begin COMPU_METHOD FORMULA_0505 "FORMULA_0505" TAB_VERB "%5.0" "-" COMPU_TAB_REF FORMULA_0505_VTAB /end COMPU_METHOD
/begin COMPU_METHOD FORMULA_0506 "FORMULA_0506" TAB_VERB "%5.0" "-" COMPU_TAB_REF FORMULA_0506_VTAB /end COMPU_METHOD
/begin COMPU_METHOD FORMULA_0507 "FORMULA_0507" TAB_VERB "%5.0" "-" COMPU_TAB_REF FORMULA_0507_VTAB /end COMPU_METHOD
/begin COMPU_METHOD FORMULA_0508 "FORMULA_0508" TAB_VERB "%5.0" "-" COMPU_TAB_REF FORMULA_0508_VTAB /end COMPU_METHOD
/begin COMPU_METHOD FORMULA_0509 "FORMULA_0509" TAB_VERB "%5.0" "-" COMPU_TAB_REF FORMULA_0509_VTAB /end COMPU_METHOD
/begin COMPU_METHOD FORMULA_0510 "FORMULA_0510" TAB_VERB "%5.0" "-" COMPU_TAB_REF FORMULA_0510_VTAB /end COMPU_METHOD
/begin COMPU_METHOD FORMULA_0511 "FORMULA_0511" TAB_VERB "%5.0" "-" COMPU_TAB_REF FORMULA_0511_VTAB /end COMPU_METHOD
/begin COMPU_METHOD FORMULA_0512 "FORMULA_0512" TAB_VERB "%5.0" "-" COMPU_TAB_REF FORMULA_0512_VTAB /end COMPU_METHOD
/begin COMPU_METHOD FORMULA_0513 "FORMULA_0513" TAB_VERB "%5.0" "-" COMPU_TAB_REF FORMULA_0513_VTAB /end COMPU_METHOD
/begin COMPU_METHOD FORMULA_0514 "FORMULA_0514" TAB_VERB "%5.0" "-" COMPU_TAB_REF FORMULA_0514_VTAB /end COMPU_METHOD
/begin COMPU_METHOD FORMULA_0515 "FORMULA_0515" TAB_VERB "%5.0" "-" COMPU_TAB_REF FORMULA_0515_VTAB /end COMPU_METHOD
/begin COMPU_METHOD FORMULA_0516 "FORMULA_0516" TAB_VERB "%5.0" "-" COMPU_TAB_REF FORMULA_0516_VTAB /end COMPU_METHOD
/begin COMPU_METHOD FORMULA_0517 "FORMULA_0517" TAB_VERB "%5.0" "-" COMPU_TAB_REF FORMULA_0517_VTAB /end COMPU_METHOD
/begin COMPU_METHOD FORMULA_0518 "FORMULA_0518" TAB_VERB "%5.0" "-" COMPU_TAB_REF FORMULA_0518_VTAB /end COMPU_METHOD
/begin COMPU_METHOD FORMULA_0519 "FORMULA_0519" TAB_VERB "%5.0" "-" COMPU_TAB_REF FORMULA_0519_VTAB /end COMPU_METHOD
/begin COMPU_METHOD FORMULA_0520 "FORMULA_0520" TAB_VERB "%5.0" "-" COMPU_TAB_REF FORMULA_0520_VTAB /end COMPU_METHOD
/begin COMPU_METHOD FORMULA_0521 "FORMULA_0521" TAB_VERB "%5.0" "-" COMPU_TAB_REF FORMULA_0521_VTAB /end COMPU_METHOD
/begin COMPU_METHOD FORMULA_0522 "FORMULA_0522" TAB_VERB "%5.0" "-" COMPU_TAB_REF FORMULA_0522_VTAB /end COMPU_METHOD
/begin COMPU_METHOD FORMULA_0523 "FORMULA_0523" TAB_VERB "%5.0" "-" COMPU_TAB_REF FORMULA_0523_VTAB /end COMPU_METHOD
/begin COMPU_METHOD FORMULA_0524 "FORMULA_0524" TAB_VERB "%5.0" "-" COMPU_TAB_REF FORMULA_0524_VTAB /end COMPU_METHOD
/begin COMPU_METHOD FORMULA_0525 "FORMULA_0525" TAB_VERB "%5.0" "-" COMPU_TAB_REF FORMULA_0525_VTAB /end COMPU_METHOD
/begin COMPU_METHOD FORMULA_0526 "FORMULA_0526" TAB_VERB "%5.0" "-" COMPU_TAB_REF FORMULA_0526_VTAB /end COMPU_METHOD
/begin COMPU_METHOD FORMULA_0527 "FORMULA_0527" TAB_VERB "%5.0" "-" COMPU_TAB_REF FORMULA_0527_VTAB /end COMPU_METHOD
/begin COMPU_METHOD FORMULA_0528 "FORMULA_0528" TAB_VERB "%5.0" "-" COMPU_TAB_REF FORMULA_0528_VTAB /end COMPU_METHOD
/begin COMPU_METHOD FORMULA_0529 "FORMULA_0529" TAB_VERB "%5.0" "-" COMPU_TAB_REF FORMULA_0529_VTAB /end COMPU_METHOD
/begin COMPU_METHOD FORMULA_0530 "FORMULA_0530" TAB_VERB "%5.0" "-" COMPU_TAB_REF FORMULA_0530_VTAB /end COMPU_METHOD
/begin COMPU_METHOD FORMULA_0531 "FORMULA_0531" TAB_VERB "%5.0" "-" COMPU_TAB_REF FORMULA_0531_VTAB /end COMPU_METHOD
/begin COMPU_METHOD FORMULA_0532 "FORMULA_0532" TAB_VERB "%5.0" "-" COMPU_TAB_REF FORMULA_0532_VTAB /end COMPU_METHOD
/begin COMPU_METHOD FORMULA_0533 "FORMULA_0533" TAB_VERB "%5.0" "-" COMPU_TAB_REF FORMULA_0533_VTAB /end COMPU_METHOD
/begin COMPU_METHOD FORMULA_0534 "FORMULA_0534" TAB_VERB "%5.0" "-" COMPU_TAB_REF FORMULA_0534_VTAB /end COMPU_METHOD
/begin COMPU_METHOD FORMULA_0535 "FORMULA_0535" TAB_VERB "%5.0" "-" COMPU_TAB_REF FORMULA_0535_VTAB /end COMPU_METHOD
/begin COMPU_METHOD FORMULA_0536 "FORMULA_0536" TAB_VERB "%5.0" "-" COMPU_TAB_REF FORMULA_0536_VTAB /end COMPU_METHOD
/begin COMPU_METHOD FORMULA_0537 "FORMULA_0537" TAB_VERB "%5.0" "-" COMPU_TAB_REF FORMULA_0537_VTAB /end COMPU_METHOD
/begin COMPU_METHOD FORMULA_0538 "FORMULA_0538" TAB_VERB "%5.0" "-" COMPU_TAB_REF FORMULA_0538_VTAB /end COMPU_METHOD
/begin COMPU_METHOD FORMULA_0539 "FORMULA_0539" TAB_VERB "%5.0" "-" COMPU_TAB_REF FORMULA_0539_VTAB /end COMPU_METHOD
/begin COMPU_METHOD FORMULA_0540 "FORMULA_0540" TAB_VERB "%5.0" "-" COMPU_TAB_REF FORMULA_0540_VTAB /end COMPU_METHOD
/begin COMPU_METHOD FORMULA_0541 "FORMULA_0541" TAB_VERB "%5.0" "-" COMPU_TAB_REF FORMULA_0541_VTAB /end COMPU_METHOD
/begin COMPU_METHOD FORMULA_0542 "FORMULA_0542" TAB_VERB "%5.0" "-" COMPU_TAB_REF FORMULA_0542_VTAB /end COMPU_METHOD
/begin COMPU_METHOD FORMULA_0543 "FORMULA_0543" TAB_VERB "%5.0" "-" COMPU_TAB_REF FORMULA_0543_VTAB /end COMPU_METHOD
/begin COMPU_METHOD FORMULA_0544 "FORMULA_0544" TAB_VERB "%5.0" "-" COMPU_TAB_REF FORMULA_0544_VTAB /end COMPU_METHOD
/begin COMPU_METHOD FORMULA_0545 "FORMULA_0545" TAB_VERB "%5.0" "-" COMPU_TAB_REF FORMULA_0545_VTAB /end COMPU_METHOD
/begin COMPU_METHOD FORMULA_0546 "FORMULA_0546" TAB_VERB "%5.0" "-" COMPU_TAB_REF FORMULA_0546_VTAB /end COMPU_METHOD
/begin COMPU_METHOD FORMULA_0547 "FORMULA_0547" TAB_VERB "%5.0" "-" COMPU_TAB_REF FORMULA_0547_VTAB /end COMPU_METHOD
/begin COMPU_METHOD FORMULA_0548 "FORMULA_0548" TAB_VERB "%5.0" "-" COMPU_TAB_REF FORMULA_0548_VTAB /end COMPU_METHOD
/begin COMPU_METHOD FORMULA_0549 "FORMULA_0549" TAB_VERB "%5.0" "-" COMPU_TAB_REF FORMULA_0549_VTAB /end COMPU_METHOD
/begin COMPU_METHOD FORMULA_0550 "FORMULA_0550" TAB_VERB "%5.0" "-" COMPU_TAB_REF FORMULA_0550_VTAB /end COMPU_METHOD
/begin COMPU_METHOD FORMULA_0551 "FORMULA_0551" TAB_VERB "%5.0" "-" COMPU_TAB_REF FORMULA_0551_VTAB /end COMPU_METHOD
/begin COMPU_METHOD FORMULA_0552 "FORMULA_0552" TAB_VERB "%5.0" "-" COMPU_TAB_REF FORMULA_0552_VTAB /end COMPU_METHOD
/begin COMPU_METHOD FORMULA_0553 "FORMULA_0553" TAB_VERB "%5.0" "-" COMPU_TAB_REF FORMULA_0553_VTAB /end COMPU_METHOD
/begin COMPU_METHOD FORMULA_0554 "FORMULA_0554" TAB_VERB "%5.0" "-" COMPU_TAB_REF FORMULA_0554_VTAB /end COMPU_METHOD
/begin COMPU_METHOD FORMULA_0555 "FORMULA_0555" TAB_VERB "%5.0" "-" COMPU_TAB_REF FORMULA_0555_VTAB /end COMPU_METHOD
/begin COMPU_METHOD FORMULA_0556 "FORMULA_0556" TAB_VERB "%5.0" "-" COMPU_TAB_REF FORMULA_0556_VTAB /end COMPU_METHOD
/begin COMPU_METHOD FORMULA_0557 "FORMULA_0557" TAB_VERB "%5.0" "-" COMPU_TAB_REF FORMULA_0557_VTAB /end COMPU_METHOD
/begin COMPU_METHOD FORMULA_0558 "FORMULA_0558" TAB_VERB "%5.0" "-" COMPU_TAB_REF FORMULA_0558_VTAB /end COMPU_METHOD
/begin COMPU_METHOD FORMULA_0559 "FORMULA_0559" TAB_VERB "%5.0" "-" COMPU_TAB_REF FORMULA_0559_VTAB /end COMPU_METHOD
/begin COMPU_METHOD FORMULA_0560 "FORMULA_0560" RAT_FUNC "%5.0" "us" COEFFS 0 0.25 0.0 0 0.0 1.0 /end COMPU_METHOD
/begin COMPU_METHOD FORMULA_0561 "FORMULA_0561" RAT_FUNC "%7.2" "%" COEFFS 0 163.84 0.0 0 0.0 1.0 /end COMPU_METHOD
/begin COMPU_METHOD FORMULA_0562 "FORMULA_0562" RAT_FUNC "%5.0" "Nm/s" COEFFS 0 5.e-002 0.0 0 0.0 1.0 /end COMPU_METHOD
/begin COMPU_METHOD FORMULA_0563 "FORMULA_0563" RAT_FUNC "%7.2" "-" COEFFS 0 255.0 0.0 0 0.0 1.0 /end COMPU_METHOD
/begin COMPU_METHOD FORMULA_0564 "FORMULA_0564" RAT_FUNC "%9.4" "V" COEFFS 0 1241.21837996177 0.0 0 0.0 1.0 /end COMPU_METHOD
/begin COMPU_METHOD FORMULA_0565 "FORMULA_0565" TAB_VERB "%3.0" "-" COMPU_TAB_REF FORMULA_0565_VTAB /end COMPU_METHOD
/begin COMPU_METHOD FORMULA_0566 "FORMULA_0566" TAB_VERB "%3.0" "-" COMPU_TAB_REF FORMULA_0566_VTAB /end COMPU_METHOD
/begin COMPU_METHOD FORMULA_0567 "FORMULA_0567" RAT_FUNC "%6.3" "-/asp" COEFFS 0 256.0 0.0 0 0.0 1.0 /end COMPU_METHOD
/begin COMPU_METHOD FORMULA_0568 "FORMULA_0568" RAT_FUNC "%7.2" "-" COEFFS 0 256.0 0.0 0 0.0 1.0 /end COMPU_METHOD
/begin COMPU_METHOD FORMULA_0569 "FORMULA_0569" RAT_FUNC "%7.2" "%" COEFFS 0 40.96 0.0 0 0.0 1.0 /end COMPU_METHOD
/begin COMPU_METHOD FORMULA_0570 "FORMULA_0570" RAT_FUNC "%11.4" "-" COEFFS 0 1 0 0 0 1 /end COMPU_METHOD
/begin COMPU_METHOD FORMULA_0571 "FORMULA_0571" TAB_VERB "%5.2" "-" COMPU_TAB_REF FORMULA_0571_VTAB /end COMPU_METHOD
/begin COMPU_METHOD FORMULA_0572 "FORMULA_0572" TAB_VERB "%3.0" "-" COMPU_TAB_REF FORMULA_0572_VTAB /end COMPU_METHOD
/begin COMPU_METHOD FORMULA_0573 "FORMULA_0573" TAB_VERB "%5.2" "-" COMPU_TAB_REF FORMULA_0573_VTAB /end COMPU_METHOD
/begin COMPU_METHOD FORMULA_0574 "FORMULA_0574" TAB_VERB "%5.2" "-" COMPU_TAB_REF FORMULA_0574_VTAB /end COMPU_METHOD
/begin COMPU_METHOD FORMULA_0584 "FORMULA_0584" RAT_FUNC "%3.0" "ms" COEFFS 0 0.2 0.0 0 0.0 1.0 /end COMPU_METHOD
/begin COMPU_METHOD FORMULA_0814 "FORMULA_0814" TAB_VERB "%5.2" "-" COMPU_TAB_REF FORMULA_0814_VTAB /end COMPU_METHOD
/begin COMPU_METHOD FORMULA_1032 "FORMULA_1032" RAT_FUNC "%8.3" "V/5ms" COEFFS 0 641.469735457881 0.0 0 0.0 1.0 /end COMPU_METHOD
/begin COMPU_VTAB FORMULA_0042_VTAB "FORMULA_0042_VTAB" TAB_VERB 4 0 "CRC iO" 1 "Daten falsch" 2 "Prog falsch" 4 "Booter falsch" DEFAULT_VALUE "Mehrfachfehler" /end COMPU_VTAB
/begin COMPU_VTAB FORMULA_0043_VTAB "FORMULA_0043_VTAB" TAB_VERB 4 0 "Inaktiv" 1 "Start" 2 "Aktiv" 3 "Ende" DEFAULT_VALUE "undef" /end COMPU_VTAB
/begin COMPU_VTAB FORMULA_0209_VTAB "FORMULA_0209_VTAB" TAB_VERB 16 0 "O.K." 1 "SH_TO_UB" 2 "SH_TO_GND" 3 "UB+GND" 4 "OPENLOAD" 5 "UB+OL" 6 "GND+OL" 7 "UB+GND+OL" 8 "UNPLAUSI" 9 "UB+UP" 10 "GND+UP" 11 "UB+GND+UP" 12 "OL+UP" 13 "UB+OL+UP" 14 "GND+OL+UP" 15 "UB+GND+OL+UP" /end COMPU_VTAB
/begin COMPU_VTAB FORMULA_0353_VTAB "FORMULA_0353_VTAB" TAB_VERB 6 0 "Initialisierung" 1 "Zahndrehzahl" 3 "noch Zahndrehzahl" 7 "Segmentdrehzahl" 16 "Stoerung" 17 "Stoerung" DEFAULT_VALUE "Eingefroren" /end COMPU_VTAB
/begin COMPU_VTAB FORMULA_0355_VTAB "FORMULA_0355_VTAB" TAB_VERB 11 0 "Ok" 1 "Sync1" 2 "Sync2" 3 "SyncMS" 4 "1ms-Task" 5 "5ms-Task" 6 "10ms-Task" 7 "100ms-Task" 8 "1s-Task" 9 "Bgnd-Task" 10 "undef" /end COMPU_VTAB
/begin COMPU_VTAB FORMULA_0356_VTAB "FORMULA_0356_VTAB" TAB_VERB 13 0 "Ok" 1 "Access" 2 "Level" 3 "ID" 4 "Limit" 5 "NoFnc" 6 "Resource" 7 "State" 8 "Value" 9 "TT missing" 10 "TT active" 11 "Overrun" 14 "Stack" /end COMPU_VTAB
/begin COMPU_VTAB FORMULA_0456_VTAB "FORMULA_0456_VTAB" TAB_VERB 5 0 "Inaktiv" 1 "Key" 5 "Aktiv" 8 "Fehler" 9 "Beendet" DEFAULT_VALUE "undefined" /end COMPU_VTAB
/begin COMPU_VTAB FORMULA_0457_VTAB "FORMULA_0457_VTAB" TAB_VERB 4 0 "Aus" 1 "Statisch" 2 "Sequentiell" 3 "Sporadisch" DEFAULT_VALUE "undefined" /end COMPU_VTAB
/begin COMPU_VTAB FORMULA_0458_VTAB "FORMULA_0458_VTAB" TAB_VERB 1 0 "keine Ausblendung." DEFAULT_VALUE "Ausblendungen aktiv." /end COMPU_VTAB
/begin COMPU_VTAB FORMULA_0459_VTAB "FORMULA_0459_VTAB" TAB_VERB 1 0 "Zyl. 1 an." DEFAULT_VALUE "Zyl. 1 aus." /end COMPU_VTAB
/begin COMPU_VTAB FORMULA_0460_VTAB "FORMULA_0460_VTAB" TAB_VERB 1 0 "Zyl. 2 an." DEFAULT_VALUE "Zyl. 2 aus." /end COMPU_VTAB
/begin COMPU_VTAB FORMULA_0461_VTAB "FORMULA_0461_VTAB" TAB_VERB 1 0 "Zyl. 3 an." DEFAULT_VALUE "Zyl. 3 aus." /end COMPU_VTAB
/begin COMPU_VTAB FORMULA_0462_VTAB "FORMULA_0462_VTAB" TAB_VERB 1 0 "Zyl. 4 an." DEFAULT_VALUE "Zyl. 4 aus." /end COMPU_VTAB
/begin COMPU_VTAB FORMULA_0463_VTAB "FORMULA_0463_VTAB" TAB_VERB 1 0 "Zyl. 5 an." DEFAULT_VALUE "Zyl. 5 aus." /end COMPU_VTAB
/begin COMPU_VTAB FORMULA_0464_VTAB "FORMULA_0464_VTAB" TAB_VERB 1 0 "Zyl. 6 an." DEFAULT_VALUE "Zyl. 6 aus." /end COMPU_VTAB
/begin COMPU_VTAB FORMULA_0465_VTAB "FORMULA_0465_VTAB" TAB_VERB 1 0 "Zyl. 7 an." DEFAULT_VALUE "Zyl. 7 aus." /end COMPU_VTAB
/begin COMPU_VTAB FORMULA_0466_VTAB "FORMULA_0466_VTAB" TAB_VERB 1 0 "Zyl. 8 an." DEFAULT_VALUE "Zyl. 8 aus." /end COMPU_VTAB
/begin COMPU_VTAB FORMULA_0467_VTAB "FORMULA_0467_VTAB" TAB_VERB 1 0 "Zyl. 9 an." DEFAULT_VALUE "Zyl. 9 aus." /end COMPU_VTAB
/begin COMPU_VTAB FORMULA_0468_VTAB "FORMULA_0468_VTAB" TAB_VERB 1 0 "Zyl. 10 an." DEFAULT_VALUE "Zyl. 10 aus." /end COMPU_VTAB
/begin COMPU_VTAB FORMULA_0491_VTAB "FORMULA_0491_VTAB" TAB_VERB 1 0 "Erster Intervall 1" DEFAULT_VALUE "Folge Intervalle" /end COMPU_VTAB
/begin COMPU_VTAB FORMULA_0494_VTAB "FORMULA_0494_VTAB" TAB_VERB 1 0 "Ausschwingen ok." DEFAULT_VALUE "Fehler Ausschwingen." /end COMPU_VTAB
/begin COMPU_VTAB FORMULA_0495_VTAB "FORMULA_0495_VTAB" TAB_VERB 1 0 "Zyl. 1 ok." DEFAULT_VALUE "Fehler Ausschw. Zyl. 1." /end COMPU_VTAB
/begin COMPU_VTAB FORMULA_0496_VTAB "FORMULA_0496_VTAB" TAB_VERB 1 0 "Zyl. 2 ok." DEFAULT_VALUE "Fehler Ausschw. Zyl. 2." /end COMPU_VTAB
/begin COMPU_VTAB FORMULA_0497_VTAB "FORMULA_0497_VTAB" TAB_VERB 1 0 "Zyl. 3 ok." DEFAULT_VALUE "Fehler Ausschw. Zyl. 3." /end COMPU_VTAB
/begin COMPU_VTAB FORMULA_0498_VTAB "FORMULA_0498_VTAB" TAB_VERB 1 0 "Zyl. 4 ok." DEFAULT_VALUE "Fehler Ausschw. Zyl. 4." /end COMPU_VTAB
/begin COMPU_VTAB FORMULA_0499_VTAB "FORMULA_0499_VTAB" TAB_VERB 1 0 "Zyl. 5 ok." DEFAULT_VALUE "Fehler Ausschw. Zyl. 5." /end COMPU_VTAB
/begin COMPU_VTAB FORMULA_0500_VTAB "FORMULA_0500_VTAB" TAB_VERB 1 0 "Zyl. 6 ok." DEFAULT_VALUE "Fehler Ausschw. Zyl. 6." /end COMPU_VTAB
/begin COMPU_VTAB FORMULA_0501_VTAB "FORMULA_0501_VTAB" TAB_VERB 1 0 "Zyl. 7 ok." DEFAULT_VALUE "Fehler Ausschw. Zyl. 7." /end COMPU_VTAB
/begin COMPU_VTAB FORMULA_0502_VTAB "FORMULA_0502_VTAB" TAB_VERB 1 0 "Zyl. 8 ok." DEFAULT_VALUE "Fehler Ausschw. Zyl. 8." /end COMPU_VTAB
/begin COMPU_VTAB FORMULA_0503_VTAB "FORMULA_0503_VTAB" TAB_VERB 1 0 "Zyl. 9 ok." DEFAULT_VALUE "Fehler Ausschw. Zyl. 9." /end COMPU_VTAB
/begin COMPU_VTAB FORMULA_0504_VTAB "FORMULA_0504_VTAB" TAB_VERB 1 0 "Zyl. 10 ok." DEFAULT_VALUE "Fehler Ausschw. Zyl. 10." /end COMPU_VTAB
/begin COMPU_VTAB FORMULA_0505_VTAB "FORMULA_0505_VTAB" TAB_VERB 1 0 "Verbrennung ok." DEFAULT_VALUE "Fehler Verbrennung." /end COMPU_VTAB
/begin COMPU_VTAB FORMULA_0506_VTAB "FORMULA_0506_VTAB" TAB_VERB 1 0 "Zyl. 1 ok." DEFAULT_VALUE "Fehler Verbr. Zyl. 1." /end COMPU_VTAB
/begin COMPU_VTAB FORMULA_0507_VTAB "FORMULA_0507_VTAB" TAB_VERB 1 0 "Zyl. 2 ok." DEFAULT_VALUE "Fehler Verbr. Zyl. 2." /end COMPU_VTAB
/begin COMPU_VTAB FORMULA_0508_VTAB "FORMULA_0508_VTAB" TAB_VERB 1 0 "Zyl. 3 ok." DEFAULT_VALUE "Fehler Verbr. Zyl. 3." /end COMPU_VTAB
/begin COMPU_VTAB FORMULA_0509_VTAB "FORMULA_0509_VTAB" TAB_VERB 1 0 "Zyl. 4 ok." DEFAULT_VALUE "Fehler Verbr. Zyl. 4." /end COMPU_VTAB
/begin COMPU_VTAB FORMULA_0510_VTAB "FORMULA_0510_VTAB" TAB_VERB 1 0 "Zyl. 5 ok." DEFAULT_VALUE "Fehler Verbr. Zyl. 5." /end COMPU_VTAB
/begin COMPU_VTAB FORMULA_0511_VTAB "FORMULA_0511_VTAB" TAB_VERB 1 0 "Zyl. 6 ok." DEFAULT_VALUE "Fehler Verbr. Zyl. 6." /end COMPU_VTAB
/begin COMPU_VTAB FORMULA_0512_VTAB "FORMULA_0512_VTAB" TAB_VERB 1 0 "Zyl. 7 ok." DEFAULT_VALUE "Fehler Verbr. Zyl. 7." /end COMPU_VTAB
/begin COMPU_VTAB FORMULA_0513_VTAB "FORMULA_0513_VTAB" TAB_VERB 1 0 "Zyl. 8 ok." DEFAULT_VALUE "Fehler Verbr. Zyl. 8." /end COMPU_VTAB
/begin COMPU_VTAB FORMULA_0514_VTAB "FORMULA_0514_VTAB" TAB_VERB 1 0 "Zyl. 9 ok." DEFAULT_VALUE "Fehler Verbr. Zyl. 9." /end COMPU_VTAB
/begin COMPU_VTAB FORMULA_0515_VTAB "FORMULA_0515_VTAB" TAB_VERB 1 0 "Zyl. 10 ok." DEFAULT_VALUE "Fehler Verbr. Zyl. 10." /end COMPU_VTAB
/begin COMPU_VTAB FORMULA_0516_VTAB "FORMULA_0516_VTAB" TAB_VERB 1 0 "Kein Nebenschluss." DEFAULT_VALUE "Fehler Nebenschluss." /end COMPU_VTAB
/begin COMPU_VTAB FORMULA_0517_VTAB "FORMULA_0517_VTAB" TAB_VERB 1 0 "Zyl. 1 ok." DEFAULT_VALUE "Nebenschluss. Zyl. 1." /end COMPU_VTAB
/begin COMPU_VTAB FORMULA_0518_VTAB "FORMULA_0518_VTAB" TAB_VERB 1 0 "Zyl. 2 ok." DEFAULT_VALUE "Nebenschluss. Zyl. 2." /end COMPU_VTAB
/begin COMPU_VTAB FORMULA_0519_VTAB "FORMULA_0519_VTAB" TAB_VERB 1 0 "Zyl. 3 ok." DEFAULT_VALUE "Nebenschluss. Zyl. 3." /end COMPU_VTAB
/begin COMPU_VTAB FORMULA_0520_VTAB "FORMULA_0520_VTAB" TAB_VERB 1 0 "Zyl. 4 ok." DEFAULT_VALUE "Nebenschluss. Zyl. 4." /end COMPU_VTAB
/begin COMPU_VTAB FORMULA_0521_VTAB "FORMULA_0521_VTAB" TAB_VERB 1 0 "Zyl. 5 ok." DEFAULT_VALUE "Nebenschluss. Zyl. 5." /end COMPU_VTAB
/begin COMPU_VTAB FORMULA_0522_VTAB "FORMULA_0522_VTAB" TAB_VERB 1 0 "Zyl. 6 ok." DEFAULT_VALUE "Nebenschluss. Zyl. 6." /end COMPU_VTAB
/begin COMPU_VTAB FORMULA_0523_VTAB "FORMULA_0523_VTAB" TAB_VERB 1 0 "Zyl. 7 ok." DEFAULT_VALUE "Nebenschluss. Zyl. 7." /end COMPU_VTAB
/begin COMPU_VTAB FORMULA_0524_VTAB "FORMULA_0524_VTAB" TAB_VERB 1 0 "Zyl. 8 ok." DEFAULT_VALUE "Nebenschluss. Zyl. 8." /end COMPU_VTAB
/begin COMPU_VTAB FORMULA_0525_VTAB "FORMULA_0525_VTAB" TAB_VERB 1 0 "Zyl. 9 ok." DEFAULT_VALUE "Nebenschluss. Zyl. 9." /end COMPU_VTAB
/begin COMPU_VTAB FORMULA_0526_VTAB "FORMULA_0526_VTAB" TAB_VERB 1 0 "Zyl. 10 ok." DEFAULT_VALUE "Nebenschluss. Zyl. 10." /end COMPU_VTAB
/begin COMPU_VTAB FORMULA_0527_VTAB "FORMULA_0527_VTAB" TAB_VERB 1 0 "kein Kat-Aussetzer" DEFAULT_VALUE "Kat-Aussetzer erkannt" /end COMPU_VTAB
/begin COMPU_VTAB FORMULA_0528_VTAB "FORMULA_0528_VTAB" TAB_VERB 1 0 "Zyl. 1 ok." DEFAULT_VALUE "Kat-Auss. Zyl. 1." /end COMPU_VTAB
/begin COMPU_VTAB FORMULA_0529_VTAB "FORMULA_0529_VTAB" TAB_VERB 1 0 "Zyl. 2 ok." DEFAULT_VALUE "Kat-Auss. Zyl. 2." /end COMPU_VTAB
/begin COMPU_VTAB FORMULA_0530_VTAB "FORMULA_0530_VTAB" TAB_VERB 1 0 "Zyl. 3 ok." DEFAULT_VALUE "Kat-Auss. Zyl. 3." /end COMPU_VTAB
/begin COMPU_VTAB FORMULA_0531_VTAB "FORMULA_0531_VTAB" TAB_VERB 1 0 "Zyl. 4 ok." DEFAULT_VALUE "Kat-Auss. Zyl. 4." /end COMPU_VTAB
/begin COMPU_VTAB FORMULA_0532_VTAB "FORMULA_0532_VTAB" TAB_VERB 1 0 "Zyl. 5 ok." DEFAULT_VALUE "Kat-Auss. Zyl. 5." /end COMPU_VTAB
/begin COMPU_VTAB FORMULA_0533_VTAB "FORMULA_0533_VTAB" TAB_VERB 1 0 "Zyl. 6 ok." DEFAULT_VALUE "Kat-Auss. Zyl. 6." /end COMPU_VTAB
/begin COMPU_VTAB FORMULA_0534_VTAB "FORMULA_0534_VTAB" TAB_VERB 1 0 "Zyl. 7 ok." DEFAULT_VALUE "Kat-Auss. Zyl. 7." /end COMPU_VTAB
/begin COMPU_VTAB FORMULA_0535_VTAB "FORMULA_0535_VTAB" TAB_VERB 1 0 "Zyl. 8 ok." DEFAULT_VALUE "Kat-Auss. Zyl. 8." /end COMPU_VTAB
/begin COMPU_VTAB FORMULA_0536_VTAB "FORMULA_0536_VTAB" TAB_VERB 1 0 "Zyl. 9 ok." DEFAULT_VALUE "Kat-Auss. Zyl. 9." /end COMPU_VTAB
/begin COMPU_VTAB FORMULA_0537_VTAB "FORMULA_0537_VTAB" TAB_VERB 1 0 "Zyl. 10 ok." DEFAULT_VALUE "Kat-Auss. Zyl. 10." /end COMPU_VTAB
/begin COMPU_VTAB FORMULA_0538_VTAB "FORMULA_0538_VTAB" TAB_VERB 1 0 "kein Abgas-Aussetzer" DEFAULT_VALUE "Abgas-Aussetzer erkannt" /end COMPU_VTAB
/begin COMPU_VTAB FORMULA_0539_VTAB "FORMULA_0539_VTAB" TAB_VERB 1 0 "Zyl. 1 ok." DEFAULT_VALUE "Abgas-Auss. Zyl. 1." /end COMPU_VTAB
/begin COMPU_VTAB FORMULA_0540_VTAB "FORMULA_0540_VTAB" TAB_VERB 1 0 "Zyl. 2 ok." DEFAULT_VALUE "Abgas-Auss. Zyl. 2." /end COMPU_VTAB
/begin COMPU_VTAB FORMULA_0541_VTAB "FORMULA_0541_VTAB" TAB_VERB 1 0 "Zyl. 3 ok." DEFAULT_VALUE "Abgas-Auss. Zyl. 3." /end COMPU_VTAB
/begin COMPU_VTAB FORMULA_0542_VTAB "FORMULA_0542_VTAB" TAB_VERB 1 0 "Zyl. 4 ok." DEFAULT_VALUE "Abgas-Auss. Zyl. 4." /end COMPU_VTAB
/begin COMPU_VTAB FORMULA_0543_VTAB "FORMULA_0543_VTAB" TAB_VERB 1 0 "Zyl. 5 ok." DEFAULT_VALUE "Abgas-Auss. Zyl. 5." /end COMPU_VTAB
/begin COMPU_VTAB FORMULA_0544_VTAB "FORMULA_0544_VTAB" TAB_VERB 1 0 "Zyl. 6 ok." DEFAULT_VALUE "Abgas-Auss. Zyl. 6." /end COMPU_VTAB
/begin COMPU_VTAB FORMULA_0545_VTAB "FORMULA_0545_VTAB" TAB_VERB 1 0 "Zyl. 7 ok." DEFAULT_VALUE "Abgas-Auss. Zyl. 7." /end COMPU_VTAB
/begin COMPU_VTAB FORMULA_0546_VTAB "FORMULA_0546_VTAB" TAB_VERB 1 0 "Zyl. 8 ok." DEFAULT_VALUE "Abgas-Auss. Zyl. 8." /end COMPU_VTAB
/begin COMPU_VTAB FORMULA_0547_VTAB "FORMULA_0547_VTAB" TAB_VERB 1 0 "Zyl. 9 ok." DEFAULT_VALUE "Abgas-Auss. Zyl. 9." /end COMPU_VTAB
/begin COMPU_VTAB FORMULA_0548_VTAB "FORMULA_0548_VTAB" TAB_VERB 1 0 "Zyl. 10 ok." DEFAULT_VALUE "Abgas-Auss. Zyl. 10." /end COMPU_VTAB
/begin COMPU_VTAB FORMULA_0549_VTAB "FORMULA_0549_VTAB" TAB_VERB 1 0 "dtz ok" DEFAULT_VALUE "dtz zu gross" /end COMPU_VTAB
/begin COMPU_VTAB FORMULA_0550_VTAB "FORMULA_0550_VTAB" TAB_VERB 1 0 "Zyl. 1 ok." DEFAULT_VALUE "dtz zu gross Zyl. 1." /end COMPU_VTAB
/begin COMPU_VTAB FORMULA_0551_VTAB "FORMULA_0551_VTAB" TAB_VERB 1 0 "Zyl. 2 ok." DEFAULT_VALUE "dtz zu gross Zyl. 2." /end COMPU_VTAB
/begin COMPU_VTAB FORMULA_0552_VTAB "FORMULA_0552_VTAB" TAB_VERB 1 0 "Zyl. 3 ok." DEFAULT_VALUE "dtz zu gross Zyl. 3." /end COMPU_VTAB
/begin COMPU_VTAB FORMULA_0553_VTAB "FORMULA_0553_VTAB" TAB_VERB 1 0 "Zyl. 4 ok." DEFAULT_VALUE "dtz zu gross Zyl. 4." /end COMPU_VTAB
/begin COMPU_VTAB FORMULA_0554_VTAB "FORMULA_0554_VTAB" TAB_VERB 1 0 "Zyl. 5 ok." DEFAULT_VALUE "dtz zu gross Zyl. 5." /end COMPU_VTAB
/begin COMPU_VTAB FORMULA_0555_VTAB "FORMULA_0555_VTAB" TAB_VERB 1 0 "Zyl. 6 ok." DEFAULT_VALUE "dtz zu gross Zyl. 6." /end COMPU_VTAB
/begin COMPU_VTAB FORMULA_0556_VTAB "FORMULA_0556_VTAB" TAB_VERB 1 0 "Zyl. 7 ok." DEFAULT_VALUE "dtz zu gross Zyl. 7." /end COMPU_VTAB
/begin COMPU_VTAB FORMULA_0557_VTAB "FORMULA_0557_VTAB" TAB_VERB 1 0 "Zyl. 8 ok." DEFAULT_VALUE "dtz zu gross Zyl. 8." /end COMPU_VTAB
/begin COMPU_VTAB FORMULA_0558_VTAB "FORMULA_0558_VTAB" TAB_VERB 1 0 "Zyl. 9 ok." DEFAULT_VALUE "dtz zu gross Zyl. 9." /end COMPU_VTAB
/begin COMPU_VTAB FORMULA_0559_VTAB "FORMULA_0559_VTAB" TAB_VERB 1 0 "Zyl. 10 ok." DEFAULT_VALUE "dtz zu gross Zyl. 10." /end COMPU_VTAB
/begin COMPU_VTAB FORMULA_0565_VTAB "FORMULA_0565_VTAB" TAB_VERB 2 0 "Aus" 1 "Ein" DEFAULT_VALUE "undefiniert" /end COMPU_VTAB
/begin COMPU_VTAB FORMULA_0566_VTAB "FORMULA_0566_VTAB" TAB_VERB 2 0 "Fest" 1 "Adaptiert" DEFAULT_VALUE "undefiniert" /end COMPU_VTAB
/begin COMPU_VTAB FORMULA_0571_VTAB "FORMULA_0571_VTAB" TAB_VERB 4 0 "Aus" 1 "readDummy" 2 "An" 4 "Stop" DEFAULT_VALUE "undef" /end COMPU_VTAB
/begin COMPU_VTAB FORMULA_0572_VTAB "FORMULA_0572_VTAB" TAB_VERB 7 0 "frei" 1 "CAN sperrt" 2 "DME sperrt" 3 "CAN/DME" 4 "DKG sperrt" 8 "nReg sperrt" 16 "Md sperrt" DEFAULT_VALUE "Mehrfach" /end COMPU_VTAB
/begin COMPU_VTAB FORMULA_0573_VTAB "FORMULA_0573_VTAB" TAB_VERB 7 0 "Inaktiv" 1 "CAN" 2 "DME" 4 "DKG" 8 "nReg" 16 "Md" 255 "Alle" /end COMPU_VTAB
/begin COMPU_VTAB FORMULA_0574_VTAB "FORMULA_0574_VTAB" TAB_VERB 2 0 "Alt" 1 "Neu" /end COMPU_VTAB
/begin COMPU_VTAB FORMULA_0814_VTAB "FORMULA_0814_VTAB" TAB_VERB 2 0 "Ok" 1 "Fehler" DEFAULT_VALUE "undefined" /end COMPU_VTAB
/begin FUNCTION aq ""
 /begin DEF_CHARACTERISTIC K_AQ_DK_ABW_T_MIN K_AQ_DK0_DK_IST_SCHW K_AQ_DK0_LLS_AQ_SCHW K_AQ_DR_REL_GRAD_TAU K_AQ_LLS_ABW_T_MIN K_AQ_RF_RG_KORR_FAK KL_AQ_ABS_DK KL_AQ_ABS_DK_ABW_MAX KL_AQ_ABS_LLS KL_AQ_ABS_LLS_ABW_MAX KL_AQ_IST_RF_TAU KL_AQ_MAX /end DEF_CHARACTERISTIC
 /begin OUT_MEASUREMENT aq_abs_b1 aq_abs_b2 aq_abs_dk_b1 aq_abs_dk_b2 aq_abs_lls_b1 aq_abs_lls_b2 aq_abs_max_dk aq_abs_max_lls aq_abs_roh_b1 aq_abs_roh_b2 aq_max_kf aq_rf_inv_b1 aq_rf_inv_b2 aq_rf_roh_fil_b1 aq_rf_roh_fil_b2 aq_rf_roh_inv_b1 aq_rf_roh_inv_b2 aq_rf_van_inv_b1 aq_rf_van_inv_b2 aq_tau_b1 aq_tau_b2 dr_rel_roh_b1 dr_rel_roh_b2 /end OUT_MEASUREMENT
/end FUNCTION
/begin FUNCTION Aussetzererkennung ""
 /begin DEF_CHARACTERISTIC K_AG_TZ_ANZ K_AG_TZ_CFG K_AG_TZ_PAUSE K_AG_TZ_V_MIN K_AG_TZ_ZYL K_AUSS_ASP_SA_CNT K_AUSS_ED_LP_INT_MIN K_AUSS_ED_WICHT_SPARK K_AUSS_FETRAWE_N K_AUSS_FETRAWE_RF K_AUSS_FETRAWE_TIME_ML K_AUSS_INT_START_FAKTOR_KOR K_AUSS_LP_COEF K_AUSS_LP_MAX_OFFSET K_AUSS_LP_MIN_BEGR K_AUSS_LP_MIN_NV_TREPP K_AUSS_LP_MIN_SA_MAX_INI K_AUSS_LP_NV_OFFSET K_AUSS_MAX_OFFSET_CFG K_AUSS_MIN_LAM K_AUSS_NS_MAX_ASP K_AUSS_NS_TIME_MAX_0 K_AUSS_NS_TIME_MAX_1 K_AUSS_NS_TIME_MAX_2 K_AUSS_NS_TIME_MAX_3 K_AUSS_NS_TIME_MAX_4 K_AUSS_NS_TIME_MAX_5 K_AUSS_NS_TIME_MAX_6 K_AUSS_NS_TIME_MAX_7 K_AUSS_NS_TIME_MAX_8 K_AUSS_OBD_ABG_1 K_AUSS_OBD_ABG_4 K_AUSS_OBD_ABG_WORST_CYL K_AUSS_OBD_CFG K_AUSS_OBD_N_MAX K_AUSS_OBD_N_MIN K_AUSS_OBD_RATE_ABG_ZYL K_AUSS_OBD_SA_CNT K_AUSS_OBD_SA_T_MIN K_AUSS_OBD_SUM_KAT K_AUSS_OBD_T_IDLE K_AUSS_OBD_T_MIN_LAM K_AUSS_OBD_WICHT_EV K_AUSS_OBD_WICHT_NS K_AUSS_OBD_WICHT_SPARK K_AUSS_RF_TAU K_AUSS_SPARK_LEV K_AUSS_SPARK_SIZE K_AUSS_SPARK_TIME_MIN K_AUSS_SPARK_TIME_TAU KF_AUSS_LP_INT_MIN KF_AUSS_OBD_DTZ_MAX KF_AUSS_OBD_WICHT_KAT KF_AUSS_SPARK_TIME_MAX KF_AUSS_SPARK_TIME_MIN KF_AUSS_TZ_OFFS KL_AUSS_INT_DTZ_FAKTOR KL_AUSS_INT_TMOT_FAKTOR KL_AUSS_MIN_AVG_SAMPLES KL_AUSS_OBD_MD_MIN KL_AUSS_OBD_NEG_MD_DYN KL_AUSS_OBD_NEG_MD_DYN_KH KL_AUSS_OBD_POS_MD_DYN KL_AUSS_OBD_POS_MD_DYN_KH KL_AUSS_OBD_RF_MIN KL_AUSS_OBD_TZ_GRAD KL_AUSS_OBD_WICHT_KAT KL_AUSS_PUMG_FAKTOR KL_AUSS_START_FAKTOR /end DEF_CHARACTERISTIC
 /begin OUT_MEASUREMENT ag_tz_anz ag_tz_anz_ctrl ag_tz_cfg_ctrl ag_tz_exd_state ag_tz_mask ag_tz_mask_zyl1 ag_tz_mask_zyl10 ag_tz_mask_zyl2 ag_tz_mask_zyl3 ag_tz_mask_zyl4 ag_tz_mask_zyl5 ag_tz_mask_zyl6 ag_tz_mask_zyl7 ag_tz_mask_zyl8 ag_tz_mask_zyl9 ag_tz_pause ag_tz_pause_ctrl ag_tz_zyl ag_tz_zyl_ctrl auss_asp_sa_cnt auss_dtz_st auss_dtz_st_zyl1 auss_dtz_st_zyl10 auss_dtz_st_zyl2 auss_dtz_st_zyl3 auss_dtz_st_zyl4 auss_dtz_st_zyl5 auss_dtz_st_zyl6 auss_dtz_st_zyl7 auss_dtz_st_zyl8 auss_dtz_st_zyl9 auss_erk_kl15_zyl1 auss_erk_kl15_zyl10 auss_erk_kl15_zyl2 auss_erk_kl15_zyl3 auss_erk_kl15_zyl4 auss_erk_kl15_zyl5 auss_erk_kl15_zyl6 auss_erk_kl15_zyl7 auss_erk_kl15_zyl8 auss_erk_kl15_zyl9 auss_erk_ns auss_erk_ns_zyl1 auss_erk_ns_zyl10 auss_erk_ns_zyl2 auss_erk_ns_zyl3 auss_erk_ns_zyl4 auss_erk_ns_zyl5 auss_erk_ns_zyl6 auss_erk_ns_zyl7 auss_erk_ns_zyl8 auss_erk_ns_zyl9 auss_erk_ti auss_erk_ti_zyl1 auss_erk_ti_zyl10 auss_erk_ti_zyl2 auss_erk_ti_zyl3 auss_erk_ti_zyl4 auss_erk_ti_zyl5 auss_erk_ti_zyl6 auss_erk_ti_zyl7 auss_erk_ti_zyl8 auss_erk_ti_zyl9 auss_erk_tz auss_erk_tz_zyl1 auss_erk_tz_zyl10 auss_erk_tz_zyl2 auss_erk_tz_zyl3 auss_erk_tz_zyl4 auss_erk_tz_zyl5 auss_erk_tz_zyl6 auss_erk_tz_zyl7 auss_erk_tz_zyl8 auss_erk_tz_zyl9 auss_int_start_faktor auss_int_tmot_faktor auss_lp_int_ed_ns_zyl1 auss_lp_int_ed_ns_zyl10 auss_lp_int_ed_ns_zyl2 auss_lp_int_ed_ns_zyl3 auss_lp_int_ed_ns_zyl4 auss_lp_int_ed_ns_zyl5 auss_lp_int_ed_ns_zyl6 auss_lp_int_ed_ns_zyl7 auss_lp_int_ed_ns_zyl8 auss_lp_int_ed_ns_zyl9 auss_lp_int_ed_ti_zyl1 auss_lp_int_ed_ti_zyl10 auss_lp_int_ed_ti_zyl2 auss_lp_int_ed_ti_zyl3 auss_lp_int_ed_ti_zyl4 auss_lp_int_ed_ti_zyl5 auss_lp_int_ed_ti_zyl6 auss_lp_int_ed_ti_zyl7 auss_lp_int_ed_ti_zyl8 auss_lp_int_ed_ti_zyl9 auss_lp_int_ed_zyl1 auss_lp_int_ed_zyl10 auss_lp_int_ed_zyl2 auss_lp_int_ed_zyl3 auss_lp_int_ed_zyl4 auss_lp_int_ed_zyl5 auss_lp_int_ed_zyl6 auss_lp_int_ed_zyl7 auss_lp_int_ed_zyl8 auss_lp_int_ed_zyl9 auss_lp_int_min_zyl1 auss_lp_int_min_zyl10 auss_lp_int_min_zyl2 auss_lp_int_min_zyl3 auss_lp_int_min_zyl4 auss_lp_int_min_zyl5 auss_lp_int_min_zyl6 auss_lp_int_min_zyl7 auss_lp_int_min_zyl8 auss_lp_int_min_zyl9 auss_lp_int_zyl1 auss_lp_int_zyl10 auss_lp_int_zyl2 auss_lp_int_zyl3 auss_lp_int_zyl4 auss_lp_int_zyl5 auss_lp_int_zyl6 auss_lp_int_zyl7 auss_lp_int_zyl8 auss_lp_int_zyl9 auss_lp_min_zyl1 auss_lp_min_zyl10 auss_lp_min_zyl2 auss_lp_min_zyl3 auss_lp_min_zyl4 auss_lp_min_zyl5 auss_lp_min_zyl6 auss_lp_min_zyl7 auss_lp_min_zyl8 auss_lp_min_zyl9 auss_min_avg_samples auss_n_ed auss_n_ed_ns auss_n_ed_ti auss_ns_time_zyl1 auss_ns_time_zyl10 auss_ns_time_zyl2 auss_ns_time_zyl3 auss_ns_time_zyl4 auss_ns_time_zyl5 auss_ns_time_zyl6 auss_ns_time_zyl7 auss_ns_time_zyl8 auss_ns_time_zyl9 auss_obd_abg auss_obd_abg_dreh_cnt auss_obd_abg_ueberschr auss_obd_abg_zyl1 auss_obd_abg_zyl10 auss_obd_abg_zyl2 auss_obd_abg_zyl3 auss_obd_abg_zyl4 auss_obd_abg_zyl5 auss_obd_abg_zyl6 auss_obd_abg_zyl7 auss_obd_abg_zyl8 auss_obd_abg_zyl9 auss_obd_dtz_max auss_obd_kat auss_obd_kat_dreh_cnt auss_obd_kat_zyl1 auss_obd_kat_zyl10 auss_obd_kat_zyl2 auss_obd_kat_zyl3 auss_obd_kat_zyl4 auss_obd_kat_zyl5 auss_obd_kat_zyl6 auss_obd_kat_zyl7 auss_obd_kat_zyl8 auss_obd_kat_zyl9 auss_obd_md_min auss_obd_neg_md_dyn_b1 auss_obd_neg_md_dyn_b2 auss_obd_phase auss_obd_pos_md_dyn_b1 auss_obd_pos_md_dyn_b2 auss_obd_rf_min_b1 auss_obd_rf_min_b2 auss_obd_sa_cnt auss_obd_sa_time auss_obd_scdn_st auss_obd_sum_abg_ev_zyl1 auss_obd_sum_abg_ev_zyl10 auss_obd_sum_abg_ev_zyl2 auss_obd_sum_abg_ev_zyl3 auss_obd_sum_abg_ev_zyl4 auss_obd_sum_abg_ev_zyl5 auss_obd_sum_abg_ev_zyl6 auss_obd_sum_abg_ev_zyl7 auss_obd_sum_abg_ev_zyl8 auss_obd_sum_abg_ev_zyl9 auss_obd_sum_abg_spark_zyl1 auss_obd_sum_abg_spark_zyl10 auss_obd_sum_abg_spark_zyl2 auss_obd_sum_abg_spark_zyl3 auss_obd_sum_abg_spark_zyl4 auss_obd_sum_abg_spark_zyl5 auss_obd_sum_abg_spark_zyl6 auss_obd_sum_abg_spark_zyl7 auss_obd_sum_abg_spark_zyl8 auss_obd_sum_abg_spark_zyl9 auss_obd_sum_kat_ev_zyl1 auss_obd_sum_kat_ev_zyl10 auss_obd_sum_kat_ev_zyl2 auss_obd_sum_kat_ev_zyl3 auss_obd_sum_kat_ev_zyl4 auss_obd_sum_kat_ev_zyl5 auss_obd_sum_kat_ev_zyl6 auss_obd_sum_kat_ev_zyl7 auss_obd_sum_kat_ev_zyl8 auss_obd_sum_kat_ev_zyl9 auss_obd_sum_kat_ns_zyl1 auss_obd_sum_kat_ns_zyl10 auss_obd_sum_kat_ns_zyl2 auss_obd_sum_kat_ns_zyl3 auss_obd_sum_kat_ns_zyl4 auss_obd_sum_kat_ns_zyl5 auss_obd_sum_kat_ns_zyl6 auss_obd_sum_kat_ns_zyl7 auss_obd_sum_kat_ns_zyl8 auss_obd_sum_kat_ns_zyl9 auss_obd_sum_kat_spark_zyl1 auss_obd_sum_kat_spark_zyl10 auss_obd_sum_kat_spark_zyl2 auss_obd_sum_kat_spark_zyl3 auss_obd_sum_kat_spark_zyl4 auss_obd_sum_kat_spark_zyl5 auss_obd_sum_kat_spark_zyl6 auss_obd_sum_kat_spark_zyl7 auss_obd_sum_kat_spark_zyl8 auss_obd_sum_kat_spark_zyl9 auss_obd_t_idle_b1 auss_obd_t_idle_b2 auss_obd_t_min_lam_b1 auss_obd_t_min_lam_b2 auss_obd_tz_grad auss_obd_wicht_kat_b1 auss_obd_wicht_kat_b2 auss_pumg_faktor auss_rf_ed_b1 auss_rf_ed_b2 auss_rf_ed_ns_b1 auss_rf_ed_ns_b2 auss_rf_ed_ti_b1 auss_rf_ed_ti_b2 auss_rf_fil_b1 auss_rf_fil_b2 auss_spark_time_fil_zyl1 auss_spark_time_fil_zyl10 auss_spark_time_fil_zyl2 auss_spark_time_fil_zyl3 auss_spark_time_fil_zyl4 auss_spark_time_fil_zyl5 auss_spark_time_fil_zyl6 auss_spark_time_fil_zyl7 auss_spark_time_fil_zyl8 auss_spark_time_fil_zyl9 auss_spark_time_max_b1 auss_spark_time_max_b2 auss_spark_time_min_b1 auss_spark_time_min_b2 auss_spark_time_zyl1 auss_spark_time_zyl10 auss_spark_time_zyl2 auss_spark_time_zyl3 auss_spark_time_zyl4 auss_spark_time_zyl5 auss_spark_time_zyl6 auss_spark_time_zyl7 auss_spark_time_zyl8 auss_spark_time_zyl9 auss_tz_ed_ns_zyl1 auss_tz_ed_ns_zyl10 auss_tz_ed_ns_zyl2 auss_tz_ed_ns_zyl3 auss_tz_ed_ns_zyl4 auss_tz_ed_ns_zyl5 auss_tz_ed_ns_zyl6 auss_tz_ed_ns_zyl7 auss_tz_ed_ns_zyl8 auss_tz_ed_ns_zyl9 auss_tz_ed_ti_zyl1 auss_tz_ed_ti_zyl10 auss_tz_ed_ti_zyl2 auss_tz_ed_ti_zyl3 auss_tz_ed_ti_zyl4 auss_tz_ed_ti_zyl5 auss_tz_ed_ti_zyl6 auss_tz_ed_ti_zyl7 auss_tz_ed_ti_zyl8 auss_tz_ed_ti_zyl9 auss_tz_ed_zyl1 auss_tz_ed_zyl10 auss_tz_ed_zyl2 auss_tz_ed_zyl3 auss_tz_ed_zyl4 auss_tz_ed_zyl5 auss_tz_ed_zyl6 auss_tz_ed_zyl7 auss_tz_ed_zyl8 auss_tz_ed_zyl9 auss_tz_offs_b1 auss_tz_offs_b2 /end OUT_MEASUREMENT
/end FUNCTION
/begin FUNCTION Beschleunigung ""
 /begin DEF_CHARACTERISTIC K_AFZ_A0 K_AFZ_A0_CNT_MAX K_AFZ_A0_MAX K_AFZ_A0_MIN K_AFZ_DIAG_AX K_AFZ_DIAG_MAX K_AFZ_DIAG_MIN K_AFZ_DIAG_T K_AFZ_F_KONV_NENNER K_AFZ_F_KONV_ZAEHLER K_AFZ_TAU /end DEF_CHARACTERISTIC
 /begin OUT_MEASUREMENT afz afz_a0_cnt afz_a0_sum afz_ad afz_berech afz_can_ax_fil afz_diag_timer afz_fil afz_roh /end OUT_MEASUREMENT
/end FUNCTION
/begin FUNCTION Betriebssystem ""
 /begin OUT_MEASUREMENT os_err.addr os_err.deadline.cnt os_err.deadline.task os_err.dflt.cnt os_err.dflt.task os_err.fifo.cnt os_err.fifo.task os_err.id.cnt os_err.id.task os_err.limit.cnt os_err.limit.task os_err.no_fnc.cnt os_err.no_fnc.task os_err.stack.cnt os_err.stack.task os_err.sum_cnt os_err.tt_act.cnt os_err.tt_act.task os_err.tt_miss.cnt os_err.tt_miss.task os_err.type os_err.value.cnt os_err.value.task /end OUT_MEASUREMENT
/end FUNCTION
/begin FUNCTION Bordspannung ""
 /begin DEF_CHARACTERISTIC K_UB_DIAG_GRAD_INT_MAX K_UB_DIAG_KL87_MAX_SPERRE K_UB_DIAG_MAX K_UB_DIAG_MIN K_UB_ERSATZ K_UB_GRAD_INT_REDUKTION K_UB_GRAD_MAX K_UB_ML_MIN K_UB_START_TIME K_UB_TAU K_UB_TAU_START /end DEF_CHARACTERISTIC
 /begin OUT_MEASUREMENT ub_ad ub_diag_kl87_sperre ub_filter ub_grad_int ub_old /end OUT_MEASUREMENT
/end FUNCTION
/begin FUNCTION Checksumme ""
 /begin OUT_MEASUREMENT crc32_boot crc32_boot_st crc32_data crc32_data_st crc32_prog crc32_prog_st crc32_result /end OUT_MEASUREMENT
/end FUNCTION
/begin FUNCTION Debugging ""
 /begin DEF_CHARACTERISTIC K_DEBUG_READ_ADR K_DEBUG_RW_LENGTH K_DEBUG_WRITE_ADR K_DEBUG_WRITE_VALUE /end DEF_CHARACTERISTIC
 /begin IN_MEASUREMENT cana_estat canb_estat qadca_qasr0 qadca_qasr1 qadcb_qasr0 qadcb_qasr1 /end IN_MEASUREMENT
 /begin OUT_MEASUREMENT bgTaskCtr cana_ctBoffDbounce canb_ctBoffDbounce debug_rw_result hwTaskCtr r100msTaskCtr r10msTaskCtr r1msTaskCtr r1sTaskCtr r5msTaskCtr syncTaskCtr /end OUT_MEASUREMENT
/end FUNCTION
/begin FUNCTION Diag_tr "" /begin DEF_CHARACTERISTIC K_DIAG_TR_UB_MIN /end DEF_CHARACTERISTIC /end FUNCTION
/begin FUNCTION diag_tr_ign "" /begin DEF_CHARACTERISTIC K_DIAG_TR_MAX_ERR /end DEF_CHARACTERISTIC
 /begin OUT_MEASUREMENT diag_st_atic29_ion1_spg diag_st_atic29_ion1_verst diag_st_atic29_ion2_spg diag_st_atic29_ion2_verst diag_st_atic29_nn diag_tr_atic29_error diag_tr_atic29_st diag_tr_atic29_tx_cnt /end OUT_MEASUREMENT
/end FUNCTION
/begin FUNCTION DKG ""
 /begin DEF_CHARACTERISTIC K_DKG_CFG_EINGR K_DKG_KRIECH_RAMPE K_DKG_KUPP_KRIECH_MAX K_DKG_KUPP_SCHLEIF_MAX K_DKG_MD_ML_RAMPE K_DKG_MD_TZ_RAMPE K_DKG_SPERR_ST K_DKG_T_WAIT /end DEF_CHARACTERISTIC
 /begin OUT_MEASUREMENT dkg_kupp_kriech dkg_kupp_schleif dkg_md_kupp_begr dkg_md_ml_erh dkg_md_ml_red dkg_md_n_reg_ml dkg_md_n_reg_tz dkg_md_tz_erh dkg_md_tz_red dkg_n_getr_ziel dkg_sperr_st dkg_t_wait dkg_timer /end OUT_MEASUREMENT
/end FUNCTION
/begin FUNCTION Drehzahl-Ebene_2 "" /begin DEF_CHARACTERISTIC K_N_E2_DELTA K_N_E2_T_MAX /end DEF_CHARACTERISTIC /begin OUT_MEASUREMENT n_e2_st n_e2_t /end OUT_MEASUREMENT /end FUNCTION
/begin FUNCTION Drehzahlerfassung "" /begin DEF_CHARACTERISTIC K_N_MIN_FREEZE K_N_OBERGRENZE K_N_ZEIT_STOERUNG /end DEF_CHARACTERISTIC
 /begin OUT_MEASUREMENT n_proz n_segm_a n_segm_b n_st_a n_st_b n_t_segm_a n_t_segm_b n_t_segm_start_a n_t_segm_start_b n_timer_stoerung_a n_timer_stoerung_b n_zahn_a n_zahn_b /end OUT_MEASUREMENT
/end FUNCTION
/begin RECORD_LAYOUT TKF_SW_SW_SW FNC_VALUES 5 SWORD COLUMN_DIR DIRECT AXIS_PTS_X 3 SWORD INDEX_INCR DIRECT AXIS_PTS_Y 4 SWORD INDEX_INCR DIRECT NO_AXIS_PTS_X 1 UBYTE NO_AXIS_PTS_Y 2 UBYTE /end RECORD_LAYOUT
/begin RECORD_LAYOUT TKF_SW_SW_UB FNC_VALUES 5 UBYTE COLUMN_DIR DIRECT AXIS_PTS_X 3 SWORD INDEX_INCR DIRECT AXIS_PTS_Y 4 SWORD INDEX_INCR DIRECT NO_AXIS_PTS_X 1 UBYTE NO_AXIS_PTS_Y 2 UBYTE /end RECORD_LAYOUT
/begin RECORD_LAYOUT TKL_SW_VV_SW FNC_VALUES 4 SWORD COLUMN_DIR DIRECT AXIS_PTS_X 3 SWORD INDEX_INCR DIRECT NO_AXIS_PTS_X 1 UBYTE RESERVED 2 BYTE /end RECORD_LAYOUT
/begin RECORD_LAYOUT TKL_SW_VV_UB FNC_VALUES 4 UBYTE COLUMN_DIR DIRECT AXIS_PTS_X 3 SWORD INDEX_INCR DIRECT NO_AXIS_PTS_X 1 UBYTE RESERVED 2 BYTE /end RECORD_LAYOUT
/begin RECORD_LAYOUT TKL_SW_VV_UW FNC_VALUES 4 UWORD COLUMN_DIR DIRECT AXIS_PTS_X 3 SWORD INDEX_INCR DIRECT NO_AXIS_PTS_X 1 UBYTE RESERVED 2 BYTE /end RECORD_LAYOUT
/begin RECORD_LAYOUT TKL_UW_VV_UW FNC_VALUES 4 UWORD COLUMN_DIR DIRECT AXIS_PTS_X 3 UWORD INDEX_INCR DIRECT NO_AXIS_PTS_X 1 UBYTE RESERVED 2 BYTE /end RECORD_LAYOUT
/begin RECORD_LAYOUT TKW_VV_VV_SB FNC_VALUES 1 SBYTE COLUMN_DIR DIRECT /end RECORD_LAYOUT
/begin RECORD_LAYOUT TKW_VV_VV_SF FNC_VALUES 1 FLOAT32_IEEE COLUMN_DIR DIRECT /end RECORD_LAYOUT
/begin RECORD_LAYOUT TKW_VV_VV_SW FNC_VALUES 1 SWORD COLUMN_DIR DIRECT /end RECORD_LAYOUT
/begin RECORD_LAYOUT TKW_VV_VV_UB FNC_VALUES 1 UBYTE COLUMN_DIR DIRECT /end RECORD_LAYOUT
/begin RECORD_LAYOUT TKW_VV_VV_UL FNC_VALUES 1 ULONG COLUMN_DIR DIRECT /end RECORD_LAYOUT
/begin RECORD_LAYOUT TKW_VV_VV_UW FNC_VALUES 1 UWORD COLUMN_DIR DIRECT /end RECORD_LAYOUT
/end MODULE
/end PROJECT
