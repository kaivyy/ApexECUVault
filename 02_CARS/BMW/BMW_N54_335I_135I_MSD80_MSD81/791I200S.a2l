ASAP2_VERSION 1 41
/begin PROJECT MSD85 "Spray Guided DI-System with Piezo Injectors for 8-Cylinder"
/begin HEADER "_default_HeaderComment" PROJECT_NO _91 /end HEADER
/begin MODULE _default_ModuleName "_default_ModuleLongIdentifier"
/begin MOD_COMMON "_default_ModCommonComment" DEPOSIT ABSOLUTE BYTE_ORDER MSB_LAST ALIGNMENT_BYTE 1 ALIGNMENT_WORD 2 ALIGNMENT_LONG 2 ALIGNMENT_FLOAT32_IEEE 2 ALIGNMENT_FLOAT64_IEEE 4 /end MOD_COMMON
/begin MEASUREMENT lv_inh_diag_ebox_cfa "E-Box cooling fan diagnosis: application incidence to inhibit the diagnosis" UBYTE _CNV_S_2_RANGE__0___1_CM 1 100. 0. 1. DISPLAY_IDENTIFIER LV_INH_DIAG_EBOX_CFA ECU_ADDRESS 0xd0008de8 BIT_MASK 0x1 /end MEASUREMENT
/begin CHARACTERISTIC c_amp_dmtl_max "lower altitude threshold for DMTL function / upper ambient pressure for DMTL function" VALUE 0xa080ba86 _REC_VAL_20_u2 5434.25976563 _CNV_A_R_LINEAR_____146_CM 0. 5434.25976563 DISPLAY_IDENTIFIER C_AMP_DMTL_MAX FORMAT "%7.2" /end CHARACTERISTIC
/begin CHARACTERISTIC c_cod_2_dmtl "2nd  application code word of DMTL function" VALUE 0xa080bab0 _REC_VAL_20_u1 255. _CNV_A_R_LINEAR_____0_CM 0. 255. DISPLAY_IDENTIFIER C_COD_2_DMTL FORMAT "%3.0" /end CHARACTERISTIC
/begin CHARACTERISTIC c_crlc_cur_dmtl_fil "Time constant of pump current filtering" VALUE 0xa080bac4 _REC_VAL_20_u2 0.9999847412109381 _CNV_A_R_LINEAR_____89_CM 0. 0.9999847412109381 DISPLAY_IDENTIFIER C_CRLC_CUR_DMTL_FIL FORMAT "%7.5" /end CHARACTERISTIC
/begin CHARACTERISTIC c_crlc_cur_dmtl_fil_lim "Time constant at the beginning of pump current filtering" VALUE 0xa080bac6 _REC_VAL_20_u2 0.9999847412109381 _CNV_A_R_LINEAR_____89_CM 0. 0.9999847412109381 DISPLAY_IDENTIFIER C_CRLC_CUR_DMTL_FIL_LIM FORMAT "%7.5" /end CHARACTERISTIC
/begin CHARACTERISTIC c_crlc_cur_dmtl_fil_refu "Correlation constant at the beginning of pump current filtering" VALUE 0xa080bac8 _REC_VAL_20_u2 0.9999847412109381 _CNV_A_R_LINEAR_____89_CM 0. 0.9999847412109381 DISPLAY_IDENTIFIER C_CRLC_CUR_DMTL_FIL_REFU FORMAT "%7.5" /end CHARACTERISTIC
/begin CHARACTERISTIC c_crlc_vb_dmtl_fil "Time constant of VB filtering" VALUE 0xa080bb18 _REC_VAL_20_u2 0.9999847412109381 _CNV_A_R_LINEAR_____89_CM 0. 0.9999847412109381 DISPLAY_IDENTIFIER C_CRLC_VB_DMTL_FIL FORMAT "%7.5" /end CHARACTERISTIC
/begin CHARACTERISTIC c_crlc_vb_dmtl_fil_lim "Time constant at the beginning of VB filtering" VALUE 0xa080bb1a _REC_VAL_20_u2 0.9999847412109381 _CNV_A_R_LINEAR_____89_CM 0. 0.9999847412109381 DISPLAY_IDENTIFIER C_CRLC_VB_DMTL_FIL_LIM FORMAT "%7.5" /end CHARACTERISTIC
/begin CHARACTERISTIC c_cur_dmtl_cor_fil_ofs_amp "Pump current offset in case of ambient pressure" VALUE 0xa080bc0c _REC_VAL_20_s2 399.9938 _CNV_A_R_LINEAR_____147_CM -200. 199.9938 DISPLAY_IDENTIFIER C_CUR_DMTL_COR_FIL_OFS_AMP FORMAT "%8.3" /end CHARACTERISTIC
/begin CHARACTERISTIC c_cur_dmtl_dif_cur_dmtl_stat "Delta pump current for pump current" VALUE 0xa080bc0e _REC_VAL_20_u2 400. _CNV_A_R_LINEAR_____148_CM 0. 400. DISPLAY_IDENTIFIER C_CUR_DMTL_DIF_CUR_DMTL_STAT FORMAT "%7.3" /end CHARACTERISTIC
/begin CHARACTERISTIC c_cur_dmtl_ref_leak_max "upper threshold of pump current for reference measurement" VALUE 0xa080bc18 _REC_VAL_20_u2 400. _CNV_A_R_LINEAR_____148_CM 0. 400. DISPLAY_IDENTIFIER C_CUR_DMTL_REF_LEAK_MAX FORMAT "%7.3" /end CHARACTERISTIC
/begin CHARACTERISTIC c_cur_dmtl_ref_leak_min "lower threshold of pump current for reference measurement" VALUE 0xa080bc1a _REC_VAL_20_u2 400. _CNV_A_R_LINEAR_____148_CM 0. 400. DISPLAY_IDENTIFIER C_CUR_DMTL_REF_LEAK_MIN FORMAT "%7.3" /end CHARACTERISTIC
/begin CHARACTERISTIC c_cur_dmtl_ref_ofs "Reference pump current offset" VALUE 0xa080bc1c _REC_VAL_20_u2 400. _CNV_A_R_LINEAR_____148_CM 0. 400. DISPLAY_IDENTIFIER C_CUR_DMTL_REF_OFS FORMAT "%7.3" /end CHARACTERISTIC
/begin CHARACTERISTIC c_ena_fco_diag "Threshold consumed fuel for diagnosis enable" VALUE 0xa080bc98 _REC_VAL_20_u2 4294.9 _CNV_A_R_LINEAR_____149_CM 0. 4294.9 DISPLAY_IDENTIFIER C_ENA_FCO_DIAG FORMAT "%7.2" /end CHARACTERISTIC
/begin CHARACTERISTIC c_fco_diag_max "Upper tolerance variable for level sensor diagnosis" VALUE 0xa080bd2a _REC_VAL_20_s1 255. _CNV_A_R_LINEAR_____75_CM -128. 127. DISPLAY_IDENTIFIER C_FCO_DIAG_MAX FORMAT "%4.0" /end CHARACTERISTIC
/begin CHARACTERISTIC c_fco_diag_min "Lower tolerance variable for level sensor diagnosis" VALUE 0xa080bd2b _REC_VAL_20_s1 255. _CNV_A_R_LINEAR_____75_CM -128. 127. DISPLAY_IDENTIFIER C_FCO_DIAG_MIN FORMAT "%4.0" /end CHARACTERISTIC
/begin CHARACTERISTIC c_ftl_dec_ftl_diag_min "minimum level decrease for refueling detection" VALUE 0xa080bd34 _REC_VAL_20_s1 255. _CNV_A_R_LINEAR_____75_CM -128. 127. DISPLAY_IDENTIFIER C_FTL_DEC_FTL_DIAG_MIN FORMAT "%4.0" /end CHARACTERISTIC
/begin CHARACTERISTIC c_ftl_diag_max "maximum tank level" VALUE 0xa080bd38 _REC_VAL_20_u2 126. _CNV_A_R_LINEAR_____150_CM 0. 126. DISPLAY_IDENTIFIER C_FTL_DIAG_MAX FORMAT "%6.2" /end CHARACTERISTIC
/begin CHARACTERISTIC c_ftl_diag_min "minimum fuel tank volume for refueling detection" VALUE 0xa080bd3a _REC_VAL_20_s1 255. _CNV_A_R_LINEAR_____75_CM -128. 127. DISPLAY_IDENTIFIER C_FTL_DIAG_MIN FORMAT "%4.0" /end CHARACTERISTIC
/begin CHARACTERISTIC c_ftl_dmtl_max "max. tank level for DMTL function" VALUE 0xa080bd3b _REC_VAL_20_u1 5.04 _CNV_A_R_LINEAR_____75_CM 0. 126. DISPLAY_IDENTIFIER C_FTL_DMTL_MAX FORMAT "%3.0" /end CHARACTERISTIC
/begin CHARACTERISTIC c_ftl_dmtl_min "min. tank level for DMTL function" VALUE 0xa080bd3c _REC_VAL_20_u1 5.04 _CNV_A_R_LINEAR_____75_CM 0. 126. DISPLAY_IDENTIFIER C_FTL_DMTL_MIN FORMAT "%3.0" /end CHARACTERISTIC
/begin CHARACTERISTIC c_hys_ftl_dmtl "hysteresis for tank level bit for DMTL function" VALUE 0xa080bdac _REC_VAL_20_u1 5.04 _CNV_A_R_LINEAR_____75_CM 0. 126. DISPLAY_IDENTIFIER C_HYS_FTL_DMTL FORMAT "%3.0" /end CHARACTERISTIC
/begin CHARACTERISTIC c_r_dmtl "Resistance of pump current measurement" VALUE 0xa080c09c _REC_VAL_20_u1 50. _CNV_A_R_LINEAR_____151_CM 0. 50. DISPLAY_IDENTIFIER C_R_DMTL /end CHARACTERISTIC
/begin CHARACTERISTIC c_sum_rep_leak_mes_fuc_max "maximum number of repeated check filler cap checks" VALUE 0xa080c10a _REC_VAL_20_u1 255. _CNV_A_R_LINEAR_____0_CM 0. 255. DISPLAY_IDENTIFIER C_SUM_REP_LEAK_MES_FUC_MAX FORMAT "%3.0" /end CHARACTERISTIC
/begin CHARACTERISTIC c_t_cur_dmtl_rough_leak_max "max. time pump current check in rough leak phase" VALUE 0xa080c14c _REC_VAL_20_u2 6553.5 _CNV_A_R_LINEAR_____4_CM 0. 6553.5 DISPLAY_IDENTIFIER C_T_CUR_DMTL_ROUGH_LEAK_MAX FORMAT "%6.1" /end CHARACTERISTIC
/begin CHARACTERISTIC c_t_cur_dmtl_rough_leak_min "min. time pump current check in rough leak phase" VALUE 0xa080c14e _REC_VAL_20_u2 6553.5 _CNV_A_R_LINEAR_____4_CM 0. 6553.5 DISPLAY_IDENTIFIER C_T_CUR_DMTL_ROUGH_LEAK_MIN FORMAT "%6.1" /end CHARACTERISTIC
/begin CHARACTERISTIC c_t_cur_dmtl_stat "Time for pump current stable" VALUE 0xa080c150 _REC_VAL_20_u2 6553.5 _CNV_A_R_LINEAR_____4_CM 0. 6553.5 DISPLAY_IDENTIFIER C_T_CUR_DMTL_STAT FORMAT "%6.1" /end CHARACTERISTIC
/begin CHARACTERISTIC c_t_dly_cur_dmtl_dif_mes "Current decrease detection delay during measurement" VALUE 0xa080c16a _REC_VAL_20_u2 6553.5 _CNV_A_R_LINEAR_____4_CM 0. 6553.5 DISPLAY_IDENTIFIER C_T_DLY_CUR_DMTL_DIF_MES FORMAT "%6.1" /end CHARACTERISTIC
/begin CHARACTERISTIC c_t_dly_det_refu "Wait period of refueling detection" VALUE 0xa080c16c _REC_VAL_20_u2 655.35 _CNV_A_R_LINEAR_____3_CM 0. 655.35 DISPLAY_IDENTIFIER C_T_DLY_DET_REFU FORMAT "%6.2" /end CHARACTERISTIC
/begin CHARACTERISTIC c_t_dly_dmtls "Waiting time after change-over of solenoid valve" VALUE 0xa080c16e _REC_VAL_20_u1 25.5 _CNV_A_R_LINEAR_____4_CM 0. 25.5 DISPLAY_IDENTIFIER C_T_DLY_DMTLS FORMAT "%4.1" /end CHARACTERISTIC
/begin CHARACTERISTIC c_t_dly_es_pwl "Post-operating wait period until start of DMTL function" VALUE 0xa080c16f _REC_VAL_20_u1 25.5 _CNV_A_R_LINEAR_____4_CM 0. 25.5 DISPLAY_IDENTIFIER C_T_DLY_ES_PWL FORMAT "%4.1" /end CHARACTERISTIC
/begin CHARACTERISTIC c_t_dly_fuc_can_off "Delay time with which Check filler Cap - light is switched off" VALUE 0xa080c172 _REC_VAL_20_u2 6553.5 _CNV_A_R_LINEAR_____4_CM 0. 6553.5 DISPLAY_IDENTIFIER C_T_DLY_FUC_CAN_OFF FORMAT "%6.1" /end CHARACTERISTIC
/begin CHARACTERISTIC c_t_dly_fuc_can_on "Delay time with which Check filler Cap - light is switched on" VALUE 0xa080c174 _REC_VAL_20_u2 6553.5 _CNV_A_R_LINEAR_____4_CM 0. 6553.5 DISPLAY_IDENTIFIER C_T_DLY_FUC_CAN_ON FORMAT "%6.1" /end CHARACTERISTIC
/begin CHARACTERISTIC c_t_dly_igk_ftl "Minimum time for which LV_IGK must be = 1 to issue a validated level" VALUE 0xa080c176 _REC_VAL_20_u1 1.02 _CNV_A_R_LINEAR_____4_CM 0. 25.5 DISPLAY_IDENTIFIER C_T_DLY_IGK_FTL FORMAT "%4.1" /end CHARACTERISTIC
/begin CHARACTERISTIC c_t_dly_req_pwl_dmtl "Post-operating time after no request for extending the post-operating phase is present any longer" VALUE 0xa080c186 _REC_VAL_20_u1 25.5 _CNV_A_R_LINEAR_____4_CM 0. 25.5 DISPLAY_IDENTIFIER C_T_DLY_REQ_PWL_DMTL FORMAT "%4.1" /end CHARACTERISTIC
/begin CHARACTERISTIC c_t_dmtl_eol_max "Max. time for end of line diagnosis after test unit initiation" VALUE 0xa080c194 _REC_VAL_20_u2 6553.5 _CNV_A_R_LINEAR_____4_CM 0. 6553.5 DISPLAY_IDENTIFIER C_T_DMTL_EOL_MAX FORMAT "%6.1" /end CHARACTERISTIC
/begin CHARACTERISTIC c_t_dmtl_max "Maximum time for DMTL diagnosis" VALUE 0xa080c196 _REC_VAL_20_u2 6553.5 _CNV_A_R_LINEAR_____4_CM 0. 6553.5 DISPLAY_IDENTIFIER C_T_DMTL_MAX FORMAT "%6.1" /end CHARACTERISTIC
/begin CHARACTERISTIC c_t_ref_leak_mes_max "Time for reference leakage measurement" VALUE 0xa080c264 _REC_VAL_20_u2 6553.5 _CNV_A_R_LINEAR_____4_CM 0. 6553.5 DISPLAY_IDENTIFIER C_T_REF_LEAK_MES_MAX FORMAT "%6.1" /end CHARACTERISTIC
/begin CHARACTERISTIC c_t_ref_leak_mes_rep_max "Time for repeat reference leakage measurement" VALUE 0xa080c266 _REC_VAL_20_u2 6553.5 _CNV_A_R_LINEAR_____4_CM 0. 6553.5 DISPLAY_IDENTIFIER C_T_REF_LEAK_MES_REP_MAX FORMAT "%6.1" /end CHARACTERISTIC
/begin CHARACTERISTIC c_t_vb_dly_dmtl "Time delay for Vbat monitoring" VALUE 0xa080c292 _REC_VAL_20_u2 6553.5 _CNV_A_R_LINEAR_____4_CM 0. 6553.5 DISPLAY_IDENTIFIER C_T_VB_DLY_DMTL FORMAT "%6.1" /end CHARACTERISTIC
/begin CHARACTERISTIC c_tam_dmtl_min "lower temperature threshold for the DMTL function" VALUE 0xa080c2af _REC_VAL_20_u1 190.5 _CNV_A_R_LINEAR_____17_CM -48. 142.5 DISPLAY_IDENTIFIER C_TAM_DMTL_MIN FORMAT "%5.1" /end CHARACTERISTIC
/begin CHARACTERISTIC c_tco_st_dmtl_min "min. TCO_ST for DMTL enable" VALUE 0xa080c2df _REC_VAL_20_u1 190.5 _CNV_A_R_LINEAR_____17_CM -48. 142.5 DISPLAY_IDENTIFIER C_TCO_ST_DMTL_MIN FORMAT "%5.1" /end CHARACTERISTIC
/begin CHARACTERISTIC c_trt_dmtl_eol_max "" VALUE 0xa080c3b6 _REC_VAL_20_u4 119304.6471 _CNV_A_R_LINEAR_____152_CM 0. 119304.6471 DISPLAY_IDENTIFIER C_TRT_DMTL_EOL_MAX FORMAT "%12.5" /end CHARACTERISTIC
/begin CHARACTERISTIC c_vb_dmtl_asa_max "Maximum battery threshold at end of line for DMTL" VALUE 0xa080c416 _REC_VAL_20_u1 26. _CNV_A_R_LINEAR_____37_CM 0. 26. DISPLAY_IDENTIFIER C_VB_DMTL_ASA_MAX FORMAT "%4.1" /end CHARACTERISTIC
/begin CHARACTERISTIC c_vb_dmtl_asa_min "Minimum battery threshold at end of line for DMTL" VALUE 0xa080c417 _REC_VAL_20_u1 26. _CNV_A_R_LINEAR_____37_CM 0. 26. DISPLAY_IDENTIFIER C_VB_DMTL_ASA_MIN FORMAT "%4.1" /end CHARACTERISTIC
/begin CHARACTERISTIC c_vb_dmtl_max "maximum battery threshold for the DMTL function" VALUE 0xa080c41e _REC_VAL_20_u1 26. _CNV_A_R_LINEAR_____37_CM 0. 26. DISPLAY_IDENTIFIER C_VB_DMTL_MAX FORMAT "%4.1" /end CHARACTERISTIC
/begin CHARACTERISTIC c_vs_ftl_diag_max "" VALUE 0xa080c4c0 _REC_VAL_20_u1 255. _CNV_A_R_LINEAR_____6_CM 0. 255. DISPLAY_IDENTIFIER C_VS_FTL_DIAG_MAX FORMAT "%3.0" /end CHARACTERISTIC
/begin MEASUREMENT ctr_cnl_rough_leak_mes_fuc "Number of aborted check filler cap checks" UBYTE _CNV_A_R_LINEAR_____0_CM 1 100. 0. 255. DISPLAY_IDENTIFIER CTR_CNL_ROUGH_LEAK_MES_FUC ECU_ADDRESS 0xd0008e18 FORMAT "%3.0" /end MEASUREMENT
/begin MEASUREMENT ctr_cur_dmtl_ref_dif_max "Number of aborted measurements due to current fluctuation" UWORD _CNV_A_R_LINEAR_____0_CM 1 100. 0. 65535. DISPLAY_IDENTIFIER CTR_CUR_DMTL_REF_DIF_MAX ECU_ADDRESS 0xd000aa92 FORMAT "%5.0" /end MEASUREMENT
/begin MEASUREMENT ctr_rep_rough_leak_mes_fuc "Number of repeated check filler cap checks" UBYTE _CNV_A_R_LINEAR_____0_CM 1 100. 0. 255. DISPLAY_IDENTIFIER CTR_REP_ROUGH_LEAK_MES_FUC ECU_ADDRESS 0xd0008e1a FORMAT "%3.0" /end MEASUREMENT
/begin MEASUREMENT cur_dmtl "Pump current tank leakage diagnosis" UWORD _CNV_A_R_LINEAR_____148_CM 1 100. 0. 400. DISPLAY_IDENTIFIER CUR_DMTL ECU_ADDRESS 0xd000aa94 FORMAT "%7.3" /end MEASUREMENT
/begin MEASUREMENT cur_dmtl_comp_rough_leak "Pump current comparision in case of rough leak measurement" UWORD _CNV_A_R_LINEAR_____148_CM 1 100. 0. 400. DISPLAY_IDENTIFIER CUR_DMTL_COMP_ROUGH_LEAK ECU_ADDRESS 0xd0000942 FORMAT "%7.3" /end MEASUREMENT
/begin MEASUREMENT cur_dmtl_comp_small_leak_len "Pump current comparision in case of 2. miniature leak measurement" UWORD _CNV_A_R_LINEAR_____148_CM 1 100. 0. 400. DISPLAY_IDENTIFIER CUR_DMTL_COMP_SMALL_LEAK_LEN ECU_ADDRESS 0xd0000944 FORMAT "%7.3" /end MEASUREMENT
/begin MEASUREMENT cur_dmtl_cor_fil_max "Maximum pump current during reference leka measurement" UWORD _CNV_A_R_LINEAR_____148_CM 1 100. 0. 400. DISPLAY_IDENTIFIER CUR_DMTL_COR_FIL_MAX ECU_ADDRESS 0xd0000948 FORMAT "%7.3" /end MEASUREMENT
/begin MEASUREMENT cur_dmtl_cor_fil_min "Minimum pump current during reference leak  measurement" UWORD _CNV_A_R_LINEAR_____148_CM 1 100. 0. 400. DISPLAY_IDENTIFIER CUR_DMTL_COR_FIL_MIN ECU_ADDRESS 0xd000094c FORMAT "%7.3" /end MEASUREMENT
/begin MEASUREMENT cur_dmtl_cor_fil_refu_hpf "corrected, high-pass filtered pump current" SWORD _CNV_A_R_LINEAR_____147_CM 1 100. -200. 199.9938 DISPLAY_IDENTIFIER CUR_DMTL_COR_FIL_REFU_HPF ECU_ADDRESS 0xd0000974 FORMAT "%8.3" /end MEASUREMENT
/begin MEASUREMENT cur_dmtl_dif "Differential pump current" UWORD _CNV_A_R_LINEAR_____148_CM 1 100. 0. 400. DISPLAY_IDENTIFIER CUR_DMTL_DIF ECU_ADDRESS 0xd000094e FORMAT "%7.3" /end MEASUREMENT
/begin MEASUREMENT cur_dmtl_dif_ref_rough_leak "Difference, pump current  between reference and min. in case of rough leak check" UWORD _CNV_A_R_LINEAR_____148_CM 1 100. 0. 400. DISPLAY_IDENTIFIER CUR_DMTL_DIF_REF_ROUGH_LEAK ECU_ADDRESS 0xd000aa96 FORMAT "%7.3" /end MEASUREMENT
/begin MEASUREMENT cur_dmtl_ref_leak "Pump current reference leakage" UWORD _CNV_A_R_LINEAR_____148_CM 1 100. 0. 400. DISPLAY_IDENTIFIER CUR_DMTL_REF_LEAK ECU_ADDRESS 0xd000aa9c FORMAT "%7.3" /end MEASUREMENT
/begin MEASUREMENT cur_dmtl_rough_leak_len_end "Pump current at the end of the rough leak measurement extension" UWORD _CNV_A_R_LINEAR_____148_CM 1 100. 0. 400. DISPLAY_IDENTIFIER CUR_DMTL_ROUGH_LEAK_LEN_END ECU_ADDRESS 0xd0000954 FORMAT "%7.3" /end MEASUREMENT
/begin MEASUREMENT cur_dmtl_rough_leak_min "Min. pump current in case of rough leak measurement" UWORD _CNV_A_R_LINEAR_____148_CM 1 100. 0. 400. DISPLAY_IDENTIFIER CUR_DMTL_ROUGH_LEAK_MIN ECU_ADDRESS 0xd000aaa0 FORMAT "%7.3" /end MEASUREMENT
/begin MEASUREMENT cur_dmtl_thd_rough_leak_len "Pump current threshold in case of rough leak measurement extension" UWORD _CNV_A_R_LINEAR_____148_CM 1 100. 0. 400. DISPLAY_IDENTIFIER CUR_DMTL_THD_ROUGH_LEAK_LEN ECU_ADDRESS 0xd000095c FORMAT "%7.3" /end MEASUREMENT
/begin MEASUREMENT fco_av_dmtl "currently consumed fuel" UWORD _CNV_A_R_LINEAR_____149_CM 1 100. 0. 4294.9 DISPLAY_IDENTIFIER FCO_AV_DMTL ECU_ADDRESS 0xd000aaa4 FORMAT "%7.2" /end MEASUREMENT
/begin MEASUREMENT state_dmtl "DMTL state" UBYTE _CNV_S_13_STATE_DMTL_153_CM 1 100. 0. 12. DISPLAY_IDENTIFIER STATE_DMTL ECU_ADDRESS 0xd0008e1e /end MEASUREMENT
/begin MEASUREMENT t_act_cur_dmtl_stat "Current time, pump current stable" UWORD _CNV_A_R_LINEAR_____4_CM 1 100. 0. 6553.5 DISPLAY_IDENTIFIER T_ACT_CUR_DMTL_STAT ECU_ADDRESS 0xd0000960 FORMAT "%6.1" /end MEASUREMENT
/begin MEASUREMENT t_act_leak_mes "Current time, leakage measurement" UWORD _CNV_A_R_LINEAR_____4_CM 1 100. 0. 6553.5 DISPLAY_IDENTIFIER T_ACT_LEAK_MES ECU_ADDRESS 0xd000aaae FORMAT "%6.1" /end MEASUREMENT
/begin MEASUREMENT t_act_ref_leak_mes "Current time, reference leakage measurement" UWORD _CNV_A_R_LINEAR_____4_CM 1 100. 0. 6553.5 DISPLAY_IDENTIFIER T_ACT_REF_LEAK_MES ECU_ADDRESS 0xd0000962 FORMAT "%6.1" /end MEASUREMENT
/begin MEASUREMENT cur_dmtl_dmtls_test "pump current during pump test" UWORD _CNV_A_R_LINEAR_____148_CM 1 100. 0. 400. DISPLAY_IDENTIFIER CUR_DMTL_DMTLS_TEST ECU_ADDRESS 0xd000aa98 FORMAT "%7.3" /end MEASUREMENT
/begin MEASUREMENT cur_dmtl_thd_rough_leak "Pump current threshold in case of rough leak measurement" UWORD _CNV_A_R_LINEAR_____148_CM 1 100. 0. 400. DISPLAY_IDENTIFIER CUR_DMTL_THD_ROUGH_LEAK ECU_ADDRESS 0xd000095a FORMAT "%7.3" /end MEASUREMENT
/begin MEASUREMENT cur_dmtl_thd_dmtls_test "Pump current threshold in case of DMTL valve check" UWORD _CNV_A_R_LINEAR_____148_CM 1 100. 0. 400. DISPLAY_IDENTIFIER CUR_DMTL_THD_DMTLS_TEST ECU_ADDRESS 0xd0000958 FORMAT "%7.3" /end MEASUREMENT
/begin CHARACTERISTIC c_t_act_small_leak "Time for miniature leak measurement" VALUE 0xa080c112 _REC_VAL_20_u2 6553.2 _CNV_A_R_LINEAR_____4_CM 0.3 6553.5 DISPLAY_IDENTIFIER C_T_ACT_SMALL_LEAK FORMAT "%6.1" /end CHARACTERISTIC
/begin CHARACTERISTIC ip_t_act_small_leak__ftl "Time for miniature leak measurement" CURVE 0xa080b3dc _REC_CUR_20_u2_u1 655.35 _CNV_A_R_LINEAR_____4_CM 0. 6553.5 DISPLAY_IDENTIFIER IP_T_ACT_SMALL_LEAK__FTL FORMAT "%6.1"
 /begin AXIS_DESCR COM_AXIS ftl _CNV_A_R_LINEAR_____75_CM 5 0. 126. FORMAT "%3.0" AXIS_PTS_REF ldp_ftl__t_small_leak_test /end AXIS_DESCR
/end CHARACTERISTIC
/begin CHARACTERISTIC ip_fac_cur_dmtl_ref "Factor delta pump current for rouh leak detection concerning reference" CURVE 0xa080a2f4 _REC_CUR_20_u2_u2 0.9999847412109381 _CNV_A_R_LINEAR_____89_CM 0. 0.9999847412109381 DISPLAY_IDENTIFIER IP_FAC_CUR_DMTL_REF FORMAT "%7.5"
 /begin AXIS_DESCR COM_AXIS cur_dmtl_dif_ref_rough_leak _CNV_A_R_LINEAR_____148_CM 8 0. 400. FORMAT "%7.3" AXIS_PTS_REF ldpm_cur_dmtldifrefroughleak_1 /end AXIS_DESCR
/end CHARACTERISTIC
/begin CHARACTERISTIC ip_t_cur_dmtl_stat "Time for pump current stable" MAP 0xa0815dbc _REC_MAP_20_u2_u2_u1 655.35 _CNV_A_R_LINEAR_____4_CM 0. 6553.5 DISPLAY_IDENTIFIER IP_T_CUR_DMTL_STAT FORMAT "%6.1"
 /begin AXIS_DESCR COM_AXIS cur_dmtl_dif_ref_rough_leak _CNV_A_R_LINEAR_____148_CM 8 0. 400. FORMAT "%7.3" AXIS_PTS_REF ldpm_cur_dmtldifrefroughleak_1 /end AXIS_DESCR
 /begin AXIS_DESCR COM_AXIS ftl _CNV_A_R_LINEAR_____75_CM 8 0. 126. FORMAT "%3.0" AXIS_PTS_REF ldp_ftl__t_cur_dmtl_stat /end AXIS_DESCR
/end CHARACTERISTIC
/begin CHARACTERISTIC c_t_ref_test_rough_leak "Time for reference test in case of rough leak check" VALUE 0xa080c268 _REC_VAL_20_u2 6553.5 _CNV_A_R_LINEAR_____4_CM 0. 6553.5 DISPLAY_IDENTIFIER C_T_REF_TEST_ROUGH_LEAK FORMAT "%6.1" /end CHARACTERISTIC
/begin CHARACTERISTIC c_fac_t_cur_dmtl_stat_len "Factor for 2. stabilization" VALUE 0xa080bcee _REC_VAL_20_u2 0.9999847412109381 _CNV_A_R_LINEAR_____89_CM 0. 0.9999847412109381 DISPLAY_IDENTIFIER C_FAC_T_CUR_DMTL_STAT_LEN FORMAT "%7.5" /end CHARACTERISTIC
/begin MEASUREMENT cur_dmtl_cor "Corrected pump current" UWORD _CNV_A_R_LINEAR_____148_CM 1 100. 0. 400. DISPLAY_IDENTIFIER CUR_DMTL_COR ECU_ADDRESS 0xd0000946 FORMAT "%7.3" /end MEASUREMENT
/begin MEASUREMENT cur_dmtl_cor_fil "corrected and filtered pump current" ULONG _CNV_A_R_LINEAR_____154_CM 1 100. 0. 400. DISPLAY_IDENTIFIER CUR_DMTL_COR_FIL ECU_ADDRESS 0xd000ba48 FORMAT "%7.3" /end MEASUREMENT
/begin CHARACTERISTIC ip_fac_cur_dmtl "Battery-voltage dependent correction factor for the pump current" CURVE 0xa080a2de _REC_CUR_20_u1_u2 1.9921875 _CNV_A_R_LINEAR_____103_CM 0. 1.9921875 DISPLAY_IDENTIFIER IP_FAC_CUR_DMTL FORMAT "%5.3"
 /begin AXIS_DESCR COM_AXIS vb_dmtl_fil _CNV_A_R_LINEAR_____155_CM 6 0. 26. FORMAT "%7.4" AXIS_PTS_REF ldp_vb_dmtl_fil__fac_cur_dmtl /end AXIS_DESCR
/end CHARACTERISTIC
/begin MEASUREMENT vb_dmtl_ref "Filtered battery voltage on transition to refeence leak measurement" UWORD _CNV_A_R_LINEAR_____155_CM 1 100. 0. 26. DISPLAY_IDENTIFIER VB_DMTL_REF ECU_ADDRESS 0xd0000972 FORMAT "%7.4" /end MEASUREMENT
/begin MEASUREMENT vb_dmtl_fil "Filtered battery voltage" UWORD _CNV_A_R_LINEAR_____155_CM 1 100. 0. 26. DISPLAY_IDENTIFIER VB_DMTL_FIL ECU_ADDRESS 0xd000aab4 FORMAT "%7.4" /end MEASUREMENT
/begin CHARACTERISTIC c_cl_dmtl_max "maximum loading degree for the DMTL function" VALUE 0xa080baa4 _REC_VAL_20_u2 1.99996948242188 _CNV_A_R_LINEAR_____9_CM 0. 1.99996948242188 DISPLAY_IDENTIFIER C_CL_DMTL_MAX FORMAT "%7.5" /end CHARACTERISTIC
/begin CHARACTERISTIC c_vs_fuc_can_min "Minimum speed for activation Check filler cap" VALUE 0xa080c4c1 _REC_VAL_20_u1 255. _CNV_A_R_LINEAR_____6_CM 0. 255. DISPLAY_IDENTIFIER C_VS_FUC_CAN_MIN FORMAT "%3.0" /end CHARACTERISTIC
/begin CHARACTERISTIC c_vs_dmtl_max "max. vehicle speed" VALUE 0xa080c4b6 _REC_VAL_20_u1 255. _CNV_A_R_LINEAR_____6_CM 0. 255. DISPLAY_IDENTIFIER C_VS_DMTL_MAX FORMAT "%3.0" /end CHARACTERISTIC
/begin MEASUREMENT ftl_ini "Ini value level for diagnostic cycle" UBYTE _CNV_A_R_LINEAR_____75_CM 1 100. 0. 126. DISPLAY_IDENTIFIER FTL_INI ECU_ADDRESS 0xd0008e1c FORMAT "%3.0" /end MEASUREMENT
/begin MEASUREMENT ftl_old "FTL for plausibility check" UBYTE _CNV_A_R_LINEAR_____75_CM 1 100. 0. 126. DISPLAY_IDENTIFIER FTL_OLD ECU_ADDRESS 0xd0008e1d FORMAT "%3.0" /end MEASUREMENT
/begin CHARACTERISTIC c_sum_cnl_leak_mes_fuc_max "maximum number of aborted check filler cap checks" VALUE 0xa080c0fe _REC_VAL_20_u1 255. _CNV_A_R_LINEAR_____0_CM 0. 255. DISPLAY_IDENTIFIER C_SUM_CNL_LEAK_MES_FUC_MAX FORMAT "%3.0" /end CHARACTERISTIC
/begin CHARACTERISTIC c_sum_cnl_small_leak_mes_max "Max. number of aborted miniature leak  checks due to current fluctuations" VALUE 0xa080c0ff _REC_VAL_20_u1 255. _CNV_A_R_LINEAR_____0_CM 0. 255. DISPLAY_IDENTIFIER C_SUM_CNL_SMALL_LEAK_MES_MAX FORMAT "%3.0" /end CHARACTERISTIC
/begin CHARACTERISTIC c_cur_dmtl_ref_dif_max "Upper threshold of the Delta pump current" VALUE 0xa080bc16 _REC_VAL_20_u2 400. _CNV_A_R_LINEAR_____148_CM 0. 400. DISPLAY_IDENTIFIER C_CUR_DMTL_REF_DIF_MAX FORMAT "%7.3" /end CHARACTERISTIC
/begin CHARACTERISTIC c_cur_dmtl_dif_thd_refu "Threshold pump current change for refueling detection" VALUE 0xa080bc14 _REC_VAL_20_s2 399.9938 _CNV_A_R_LINEAR_____147_CM -200. 199.9938 DISPLAY_IDENTIFIER C_CUR_DMTL_DIF_THD_REFU FORMAT "%8.3" /end CHARACTERISTIC
/begin CHARACTERISTIC c_cur_dmtl_dif_thd_fuc "Threshold pump current change for refueling detection" VALUE 0xa080bc10 _REC_VAL_20_s2 399.9938 _CNV_A_R_LINEAR_____147_CM -200. 199.9938 DISPLAY_IDENTIFIER C_CUR_DMTL_DIF_THD_FUC FORMAT "%8.3" /end CHARACTERISTIC
/begin CHARACTERISTIC c_cur_dmtl_dif_thd_mes "Current decrease threshold during measurement" VALUE 0xa080bc12 _REC_VAL_20_u2 400. _CNV_A_R_LINEAR_____148_CM 0. 400. DISPLAY_IDENTIFIER C_CUR_DMTL_DIF_THD_MES FORMAT "%7.3" /end CHARACTERISTIC
/begin CHARACTERISTIC c_dist_refu_rough_leak_min "lower threshold of distance covered between refueling and rough leak suspicion" VALUE 0xa080bc4a _REC_VAL_20_u2 65535. _CNV_A_R_LINEAR_____156_CM 0. 65535. DISPLAY_IDENTIFIER C_DIST_REFU_ROUGH_LEAK_MIN FORMAT "%5.0" /end CHARACTERISTIC
/begin AXIS_PTS ldp_ftl__t_cur_dmtl_stat "" 0xa0808698 ftl _REC_AXS_20_u1 126. _CNV_A_R_LINEAR_____75_CM 8 0. 126. FORMAT "%3.0" /end AXIS_PTS
/begin AXIS_PTS ldp_ftl__t_small_leak_test "" 0xa08086a8 ftl _REC_AXS_20_u1 126. _CNV_A_R_LINEAR_____75_CM 5 0. 126. FORMAT "%3.0" /end AXIS_PTS
/begin AXIS_PTS ldp_vb_dmtl_fil__fac_cur_dmtl "" 0xa0809100 vb_dmtl_fil _REC_AXS_20_u2 26. _CNV_A_R_LINEAR_____155_CM 6 0. 26. FORMAT "%7.4" /end AXIS_PTS
/begin AXIS_PTS ldpm_cur_dmtldifrefroughleak_1 "" 0xa0809360 cur_dmtl_dif_ref_rough_leak _REC_AXS_20_u2 400. _CNV_A_R_LINEAR_____148_CM 8 0. 400. FORMAT "%7.3" /end AXIS_PTS
/begin AXIS_PTS ldp_ftl__t_rough_leak_test "" 0xa08086a2 ftl _REC_AXS_20_u1 126. _CNV_A_R_LINEAR_____75_CM 5 0. 126. FORMAT "%3.0" /end AXIS_PTS
/begin MEASUREMENT dmtl_priv_state_1.bitfield.lv_cur_dmtl_dmtls_test "Pump current threshold reached in case of  DMTL-valve check" ULONG _CNV_S_2_RANGE______76_CM 1 100. 0. 1. DISPLAY_IDENTIFIER LV_CUR_DMTL_DMTLS_TEST ECU_ADDRESS 0xd0000980 BIT_MASK 0x40 /end MEASUREMENT
/begin MEASUREMENT dmtl_priv_state_1.bitfield.lv_cur_dmtl_ref_mes_max "Upper pump current threshold reached during reference measurement" ULONG _CNV_S_2_RANGE______76_CM 1 100. 0. 1. DISPLAY_IDENTIFIER LV_CUR_DMTL_REF_MES_MAX ECU_ADDRESS 0xd0000980 BIT_MASK 0x80 /end MEASUREMENT
/begin MEASUREMENT dmtl_priv_state_1.bitfield.lv_cur_dmtl_ref_mes_min "Lower pump current threshold reached during reference measurement" ULONG _CNV_S_2_RANGE______76_CM 1 100. 0. 1. DISPLAY_IDENTIFIER LV_CUR_DMTL_REF_MES_MIN ECU_ADDRESS 0xd0000980 BIT_MASK 0x100 /end MEASUREMENT
/begin MEASUREMENT dmtl_priv_state_1.bitfield.lv_dist_dmtl "Minimum distance after suspected rough leak or refueling" ULONG _CNV_S_2_RANGE______76_CM 1 100. 0. 1. DISPLAY_IDENTIFIER LV_DIST_DMTL ECU_ADDRESS 0xd0000980 BIT_MASK 0x2000 /end MEASUREMENT
/begin MEASUREMENT dmtl_priv_state_1.bitfield.lv_dmtl_asa "Factory test active" ULONG _CNV_S_2_RANGE______76_CM 1 100. 0. 1. DISPLAY_IDENTIFIER LV_DMTL_ASA ECU_ADDRESS 0xd0000980 BIT_MASK 0x4000 /end MEASUREMENT
/begin MEASUREMENT dmtl_priv_state_1.bitfield.lv_dmtl_eol "End of line test active" ULONG _CNV_S_2_RANGE______76_CM 1 100. 0. 1. DISPLAY_IDENTIFIER LV_DMTL_EOL ECU_ADDRESS 0xd0000980 BIT_MASK 0x8000 /end MEASUREMENT
/begin MEASUREMENT dmtl_priv_state_1.bitfield.lv_dmtl_pump_on "DMTL pump motor on" ULONG _CNV_S_2_RANGE______76_CM 1 100. 0. 1. DISPLAY_IDENTIFIER LV_DMTL_PUMP_ON ECU_ADDRESS 0xd0000982 BIT_MASK 0x4 /end MEASUREMENT
/begin MEASUREMENT dmtl_priv_state_1.bitfield.lv_dmtl_rst_rough_leak "inhibit small leak diagnosis" ULONG _CNV_S_2_RANGE______76_CM 1 100. 0. 1. DISPLAY_IDENTIFIER LV_DMTL_RST_ROUGH_LEAK ECU_ADDRESS 0xd0000982 BIT_MASK 0x8 /end MEASUREMENT
/begin MEASUREMENT dmtl_priv_state_1.bitfield.lv_dmtls_on "DMTL valve on" ULONG _CNV_S_2_RANGE______76_CM 1 100. 0. 1. DISPLAY_IDENTIFIER LV_DMTLS_ON ECU_ADDRESS 0xd0000982 BIT_MASK 0x10 /end MEASUREMENT
/begin MEASUREMENT dmtl_priv_state_1.bitfield.lv_dr_dmtl "Enabling the output stages of the DMTL module" ULONG _CNV_S_2_RANGE______76_CM 1 100. 0. 1. DISPLAY_IDENTIFIER LV_DR_DMTL ECU_ADDRESS 0xd0000982 BIT_MASK 0x20 /end MEASUREMENT
/begin MEASUREMENT dmtl_priv_state_1.bitfield.lv_dr_dmtl_pump "DMTL pump activation" ULONG _CNV_S_2_RANGE______76_CM 1 100. 0. 1. DISPLAY_IDENTIFIER LV_DR_DMTL_PUMP ECU_ADDRESS 0xd0000982 BIT_MASK 0x40 /end MEASUREMENT
/begin MEASUREMENT dmtl_priv_state_1.bitfield.lv_ena_fco_diag "Consumption diagnosis enable" ULONG _CNV_S_2_RANGE______76_CM 1 100. 0. 1. DISPLAY_IDENTIFIER LV_ENA_FCO_DIAG ECU_ADDRESS 0xd0000982 BIT_MASK 0x80 /end MEASUREMENT
/begin MEASUREMENT dmtl_priv_state_1.bitfield.lv_ena_ftl_diag "Fuel level diagnosis enable" ULONG _CNV_S_2_RANGE______76_CM 1 100. 0. 1. DISPLAY_IDENTIFIER LV_ENA_FTL_DIAG ECU_ADDRESS 0xd0000982 BIT_MASK 0x100 /end MEASUREMENT
/begin MEASUREMENT dmtl_priv_state_2.bitfield.lv_ena_fuc_rough_leak_mes "Enable rough leak measurement due to Check Filler Cap" ULONG _CNV_S_2_RANGE______76_CM 1 100. 0. 1. DISPLAY_IDENTIFIER LV_ENA_FUC_ROUGH_LEAK_MES ECU_ADDRESS 0xd0000984 BIT_MASK 0x1 /end MEASUREMENT
/begin MEASUREMENT dmtl_priv_state_2.bitfield.lv_ena_main_dmtl "DMTL main enabling" ULONG _CNV_S_2_RANGE______76_CM 1 100. 0. 1. DISPLAY_IDENTIFIER LV_ENA_MAIN_DMTL ECU_ADDRESS 0xd0000984 BIT_MASK 0x2 /end MEASUREMENT
/begin MEASUREMENT dmtl_priv_state_2.bitfield.lv_ena_main_dmtl_fuc "Main enabling DMTL Check Filler Cap" ULONG _CNV_S_2_RANGE______76_CM 1 100. 0. 1. DISPLAY_IDENTIFIER LV_ENA_MAIN_DMTL_FUC ECU_ADDRESS 0xd0000984 BIT_MASK 0x4 /end MEASUREMENT
/begin MEASUREMENT dmtl_priv_state_2.bitfield.lv_ena_rough_leak_1 "Auxiliary bit enable condition for rough leak check is present" ULONG _CNV_S_2_RANGE______76_CM 1 100. 0. 1. DISPLAY_IDENTIFIER LV_ENA_ROUGH_LEAK_1 ECU_ADDRESS 0xd0000984 BIT_MASK 0x8 /end MEASUREMENT
/begin MEASUREMENT dmtl_priv_state_2.bitfield.lv_ena_rough_leak_2 "Auxiliary bit enabling rough leak check through manual activation" ULONG _CNV_S_2_RANGE______76_CM 1 100. 0. 1. DISPLAY_IDENTIFIER LV_ENA_ROUGH_LEAK_2 ECU_ADDRESS 0xd0000984 BIT_MASK 0x10 /end MEASUREMENT
/begin MEASUREMENT dmtl_priv_state_2.bitfield.lv_ena_rough_leak_3 "Auxiliary bit interruption of rough leak check" ULONG _CNV_S_2_RANGE______76_CM 1 100. 0. 1. DISPLAY_IDENTIFIER LV_ENA_ROUGH_LEAK_3 ECU_ADDRESS 0xd0000984 BIT_MASK 0x20 /end MEASUREMENT
/begin MEASUREMENT dmtl_priv_state_2.bitfield.lv_ena_rough_leak_mes "Enabling rough leak measurement" ULONG _CNV_S_2_RANGE______76_CM 1 100. 0. 1. DISPLAY_IDENTIFIER LV_ENA_ROUGH_LEAK_MES ECU_ADDRESS 0xd0000984 BIT_MASK 0x100 /end MEASUREMENT
/begin MEASUREMENT dmtl_priv_state_2.bitfield.lv_ena_rough_leak_mes_only "Enable only rough leak measurement" ULONG _CNV_S_2_RANGE______76_CM 1 100. 0. 1. DISPLAY_IDENTIFIER LV_ENA_ROUGH_LEAK_MES_ONLY ECU_ADDRESS 0xd0000984 BIT_MASK 0x200 /end MEASUREMENT
/begin MEASUREMENT dmtl_priv_state_2.bitfield.lv_ena_small_leak_1 "Enable for miniature leak check via test unit intervention" ULONG _CNV_S_2_RANGE______76_CM 1 100. 0. 1. DISPLAY_IDENTIFIER LV_ENA_SMALL_LEAK_1 ECU_ADDRESS 0xd0000984 BIT_MASK 0x800 /end MEASUREMENT
/begin MEASUREMENT dmtl_priv_state_2.bitfield.lv_ena_small_leak_mes_end "End of enable miniature leak measurement" ULONG _CNV_S_2_RANGE______76_CM 1 100. 0. 1. DISPLAY_IDENTIFIER LV_ENA_SMALL_LEAK_MES_END ECU_ADDRESS 0xd0000984 BIT_MASK 0x1000 /end MEASUREMENT
/begin MEASUREMENT dmtl_priv_state_2.bitfield.lv_fco_diag_max "Upper consumption diagnosis threshold" ULONG _CNV_S_2_RANGE______76_CM 1 100. 0. 1. DISPLAY_IDENTIFIER LV_FCO_DIAG_MAX ECU_ADDRESS 0xd0000986 BIT_MASK 0x1 /end MEASUREMENT
/begin MEASUREMENT dmtl_priv_state_2.bitfield.lv_fco_diag_min "Lower consumption diagnosis threshold" ULONG _CNV_S_2_RANGE______76_CM 1 100. 0. 1. DISPLAY_IDENTIFIER LV_FCO_DIAG_MIN ECU_ADDRESS 0xd0000986 BIT_MASK 0x2 /end MEASUREMENT
/begin MEASUREMENT dmtl_priv_state_2.bitfield.lv_fco_h_ftl "Consumed fuel greater than tank level" ULONG _CNV_S_2_RANGE______76_CM 1 100. 0. 1. DISPLAY_IDENTIFIER LV_FCO_H_FTL ECU_ADDRESS 0xd0000986 BIT_MASK 0x4 /end MEASUREMENT
/begin MEASUREMENT dmtl_priv_state_2.bitfield.lv_ftl_dec "Tank volume has decreased" ULONG _CNV_S_2_RANGE______76_CM 1 100. 0. 1. DISPLAY_IDENTIFIER LV_FTL_DEC ECU_ADDRESS 0xd0000986 BIT_MASK 0x80 /end MEASUREMENT
/begin MEASUREMENT dmtl_priv_state_2.bitfield.lv_ftl_dec_igk_on "Tank filling volume has decreased in case of ignition key ON" ULONG _CNV_S_2_RANGE______76_CM 1 100. 0. 1. DISPLAY_IDENTIFIER LV_FTL_DEC_IGK_ON ECU_ADDRESS 0xd0000986 BIT_MASK 0x100 /end MEASUREMENT
/begin MEASUREMENT dmtl_priv_state_2.bitfield.lv_ftl_dmtl_max "max. tank level for DMTL function" ULONG _CNV_S_2_RANGE______76_CM 1 100. 0. 1. DISPLAY_IDENTIFIER LV_FTL_DMTL_MAX ECU_ADDRESS 0xd0000986 BIT_MASK 0x400 /end MEASUREMENT
/begin MEASUREMENT dmtl_priv_state_2.bitfield.lv_ftl_dmtl_min "min. tank level for DMTL function" ULONG _CNV_S_2_RANGE______76_CM 1 100. 0. 1. DISPLAY_IDENTIFIER LV_FTL_DMTL_MIN ECU_ADDRESS 0xd0000986 BIT_MASK 0x800 /end MEASUREMENT
/begin MEASUREMENT dmtl_priv_state_3.bitfield.lv_ftl_dyn "Level dynamics due to refueling" ULONG _CNV_S_2_RANGE______76_CM 1 100. 0. 1. DISPLAY_IDENTIFIER LV_FTL_DYN ECU_ADDRESS 0xd0000988 BIT_MASK 0x1 /end MEASUREMENT
/begin MEASUREMENT dmtl_priv_state_3.bitfield.lv_ftl_inc "Tank volume has increased" ULONG _CNV_S_2_RANGE______76_CM 1 100. 0. 1. DISPLAY_IDENTIFIER LV_FTL_INC ECU_ADDRESS 0xd0000988 BIT_MASK 0x2 /end MEASUREMENT
/begin MEASUREMENT dmtl_priv_state_3.bitfield.lv_ftl_inc_igk_on "Tank filling volume has increased in case of ignition key ON" ULONG _CNV_S_2_RANGE______76_CM 1 100. 0. 1. DISPLAY_IDENTIFIER LV_FTL_INC_IGK_ON ECU_ADDRESS 0xd0000988 BIT_MASK 0x4 /end MEASUREMENT
/begin MEASUREMENT dmtl_priv_state_3.bitfield.lv_no_purge_dr_dmtl "Pulse width modulation of canister-purge" ULONG _CNV_S_2_RANGE______76_CM 1 100. 0. 1. DISPLAY_IDENTIFIER LV_NO_PURGE_DR_DMTL ECU_ADDRESS 0xd0000988 BIT_MASK 0x80 /end MEASUREMENT
/begin MEASUREMENT dmtl_priv_state_3.bitfield.lv_no_purge_dmtl_rough_leak "request bit for no_purge" ULONG _CNV_S_2_RANGE______76_CM 1 100. 0. 1. DISPLAY_IDENTIFIER LV_NO_PURGE_DMTL_ROUGH_LEAK ECU_ADDRESS 0xd0000988 BIT_MASK 0x100 /end MEASUREMENT
/begin MEASUREMENT dmtl_priv_state_3.bitfield.lv_no_purge_dmtl_small_leak "request bit for no_purge" ULONG _CNV_S_2_RANGE______76_CM 1 100. 0. 1. DISPLAY_IDENTIFIER LV_NO_PURGE_DMTL_SMALL_LEAK ECU_ADDRESS 0xd0000988 BIT_MASK 0x200 /end MEASUREMENT
/begin MEASUREMENT dmtl_priv_state_4.bitfield.lv_ref_leak_rough_leak_susp "Condition, second reference measurement due to \"rough leak suspected\"" ULONG _CNV_S_2_RANGE______76_CM 1 100. 0. 1. DISPLAY_IDENTIFIER LV_REF_LEAK_ROUGH_LEAK_SUSP ECU_ADDRESS 0xd000098c BIT_MASK 0x8 /end MEASUREMENT
/begin MEASUREMENT dmtl_priv_state_4.bitfield.lv_refu_1 "Refueling process, internal" ULONG _CNV_S_2_RANGE______76_CM 1 100. 0. 1. DISPLAY_IDENTIFIER LV_REFU_1 ECU_ADDRESS 0xd000098c BIT_MASK 0x10 /end MEASUREMENT
/begin MEASUREMENT dmtl_priv_state_4.bitfield.lv_refu_end "Refueling finished" ULONG _CNV_S_2_RANGE______76_CM 1 100. 0. 1. DISPLAY_IDENTIFIER LV_REFU_END ECU_ADDRESS 0xd000098c BIT_MASK 0x20 /end MEASUREMENT
/begin MEASUREMENT dmtl_priv_state_4.bitfield.lv_refu_rls_diag "Refueling diagnosis possible" ULONG _CNV_S_2_RANGE______76_CM 1 100. 0. 1. DISPLAY_IDENTIFIER LV_REFU_RLS_DIAG ECU_ADDRESS 0xd000098c BIT_MASK 0x100 /end MEASUREMENT
/begin MEASUREMENT dmtl_priv_state_4.bitfield.lv_refu_val_1 "Refueling bit valid, internal" ULONG _CNV_S_2_RANGE______76_CM 1 100. 0. 1. DISPLAY_IDENTIFIER LV_REFU_VAL_1 ECU_ADDRESS 0xd000098c BIT_MASK 0x200 /end MEASUREMENT
/begin MEASUREMENT dmtl_priv_state_4.bitfield.lv_req_ena_rough_leak "Request rough leak measurement" ULONG _CNV_S_2_RANGE______76_CM 1 100. 0. 1. DISPLAY_IDENTIFIER LV_REQ_ENA_ROUGH_LEAK ECU_ADDRESS 0xd000098c BIT_MASK 0x800 /end MEASUREMENT
/begin MEASUREMENT dmtl_priv_state_4.bitfield.lv_req_pwl_rough_leak "Request of STG off delay, rough leak diagnosis" ULONG _CNV_S_2_RANGE______76_CM 1 100. 0. 1. DISPLAY_IDENTIFIER LV_REQ_PWL_ROUGH_LEAK ECU_ADDRESS 0xd000098c BIT_MASK 0x2000 /end MEASUREMENT
/begin MEASUREMENT dmtl_priv_state_4.bitfield.lv_req_pwl_small_leak "Request of STG off delay, miniature leak test" ULONG _CNV_S_2_RANGE______76_CM 1 100. 0. 1. DISPLAY_IDENTIFIER LV_REQ_PWL_SMALL_LEAK ECU_ADDRESS 0xd000098c BIT_MASK 0x4000 /end MEASUREMENT
/begin MEASUREMENT dmtl_priv_state_4.bitfield.lv_req_rough_leak "Request rough leak measurement (low volatile fuel)" ULONG _CNV_S_2_RANGE______76_CM 1 100. 0. 1. DISPLAY_IDENTIFIER LV_REQ_ROUGH_LEAK ECU_ADDRESS 0xd000098c BIT_MASK 0x8000 /end MEASUREMENT
/begin MEASUREMENT dmtl_priv_state_4.bitfield.lv_small_leak_mes_len "Condition, extension miniature leak measurement" ULONG _CNV_S_2_RANGE______76_CM 1 100. 0. 1. DISPLAY_IDENTIFIER LV_SMALL_LEAK_MES_LEN ECU_ADDRESS 0xd000098e BIT_MASK 0x200 /end MEASUREMENT
/begin MEASUREMENT dmtl_priv_state_4.bitfield.lv_t_dly_dmtl_pwl "Waiting time DMTL start finished" ULONG _CNV_S_2_RANGE______76_CM 1 100. 0. 1. DISPLAY_IDENTIFIER LV_T_DLY_DMTL_PWL ECU_ADDRESS 0xd000098e BIT_MASK 0x400 /end MEASUREMENT
/begin MEASUREMENT dmtl_glob_state_1.bitfield.lv_ctr_cnl_small_leak_mes "Threshold of aborted miniature leak measurements due to current fluctuations exceeded" ULONG _CNV_S_2_RANGE______76_CM 1 100. 0. 1. DISPLAY_IDENTIFIER LV_CTR_CNL_SMALL_LEAK_MES ECU_ADDRESS 0xd000ba4c BIT_MASK 0x1 /end MEASUREMENT
/begin MEASUREMENT dmtl_glob_state_1.bitfield.lv_cur_dmtl_ref_dif_max "Condition \"delta reference current\" exceeded" ULONG _CNV_S_2_RANGE______76_CM 1 100. 0. 1. DISPLAY_IDENTIFIER LV_CUR_DMTL_REF_DIF_MAX ECU_ADDRESS 0xd000ba4c BIT_MASK 0x2 /end MEASUREMENT
/begin MEASUREMENT dmtl_glob_state_1.bitfield.lv_cur_dmtl_thd_dif_mes "Decreasing pump current during measurement" ULONG _CNV_S_2_RANGE______76_CM 1 100. 0. 1. DISPLAY_IDENTIFIER LV_CUR_DMTL_THD_DIF_MES ECU_ADDRESS 0xd000ba4c BIT_MASK 0x4 /end MEASUREMENT
/begin MEASUREMENT dmtl_glob_state_1.bitfield.lv_det_fuc_open "Detection of fuel cap open" ULONG _CNV_S_2_RANGE______76_CM 1 100. 0. 1. DISPLAY_IDENTIFIER LV_DET_FUC_OPEN ECU_ADDRESS 0xd000ba4c BIT_MASK 0x8 /end MEASUREMENT
/begin MEASUREMENT dmtl_glob_state_1.bitfield.lv_det_refu "Detection of refueling" ULONG _CNV_S_2_RANGE______76_CM 1 100. 0. 1. DISPLAY_IDENTIFIER LV_DET_REFU ECU_ADDRESS 0xd000ba4c BIT_MASK 0x10 /end MEASUREMENT
/begin MEASUREMENT dmtl_glob_state_1.bitfield.lv_dist_det_rough_leak "Distance covered since rough leak detection" ULONG _CNV_S_2_RANGE______76_CM 1 100. 0. 1. DISPLAY_IDENTIFIER LV_DIST_DET_ROUGH_LEAK ECU_ADDRESS 0xd000ba4c BIT_MASK 0x20 /end MEASUREMENT
/begin MEASUREMENT dmtl_glob_state_1.bitfield.lv_dmtl_act "DMTL state machine running" ULONG _CNV_S_2_RANGE______76_CM 1 100. 0. 1. DISPLAY_IDENTIFIER LV_DMTL_ACT ECU_ADDRESS 0xd000ba4c BIT_MASK 0x40 /end MEASUREMENT
/begin MEASUREMENT dmtl_glob_state_1.bitfield.lv_dmtl_stop "Abnormal termination of DMTL function" ULONG _CNV_S_2_RANGE______76_CM 1 100. 0. 1. DISPLAY_IDENTIFIER LV_DMTL_STOP ECU_ADDRESS 0xd000ba4c BIT_MASK 0x100 /end MEASUREMENT
/begin MEASUREMENT dmtl_glob_state_1.bitfield.lv_ena_fuc "Request check filler cap" ULONG _CNV_S_2_RANGE______76_CM 1 100. 0. 1. DISPLAY_IDENTIFIER LV_ENA_FUC ECU_ADDRESS 0xd000ba4c BIT_MASK 0x200 /end MEASUREMENT
/begin MEASUREMENT dmtl_glob_state_1.bitfield.lv_ena_leak_dmtl "Enabling function request, coarse / miniature leakage measurement" ULONG _CNV_S_2_RANGE______76_CM 1 100. 0. 1. DISPLAY_IDENTIFIER LV_ENA_LEAK_DMTL ECU_ADDRESS 0xd000ba4c BIT_MASK 0x400 /end MEASUREMENT
/begin MEASUREMENT dmtl_glob_state_1.bitfield.lv_ena_small_leak_mes "Enable miniature leak measurement" ULONG _CNV_S_2_RANGE______76_CM 1 100. 0. 1. DISPLAY_IDENTIFIER LV_ENA_SMALL_LEAK_MES ECU_ADDRESS 0xd000ba4c BIT_MASK 0x1000 /end MEASUREMENT
/begin MEASUREMENT dmtl_glob_state_1.bitfield.lv_err_det_dmtl_max "Error maximum value DMTL" ULONG _CNV_S_2_RANGE______76_CM 1 100. 0. 1. DISPLAY_IDENTIFIER LV_ERR_DET_DMTL_MAX ECU_ADDRESS 0xd000ba4c BIT_MASK 0x2000 /end MEASUREMENT
/begin MEASUREMENT dmtl_glob_state_1.bitfield.lv_err_det_dmtl_min "Error, minimum value detected in DMTL module" ULONG _CNV_S_2_RANGE______76_CM 1 100. 0. 1. DISPLAY_IDENTIFIER LV_ERR_DET_DMTL_MIN ECU_ADDRESS 0xd000ba4c BIT_MASK 0x4000 /end MEASUREMENT
/begin MEASUREMENT dmtl_glob_state_1.bitfield.lv_err_det_rough_leak_min "Rough leak error" ULONG _CNV_S_2_RANGE______76_CM 1 100. 0. 1. DISPLAY_IDENTIFIER LV_ERR_DET_ROUGH_LEAK_MIN ECU_ADDRESS 0xd000ba4c BIT_MASK 0x8000 /end MEASUREMENT
/begin MEASUREMENT dmtl_glob_state_1.bitfield.lv_err_ftl_int "Tank level error" ULONG _CNV_S_2_RANGE______76_CM 1 100. 0. 1. DISPLAY_IDENTIFIER LV_ERR_FTL ECU_ADDRESS 0xd000ba4e BIT_MASK 0x1 /end MEASUREMENT
/begin MEASUREMENT dmtl_glob_state_1.bitfield.lv_err_ftl_plaus_int "Tank level plausibility error" ULONG _CNV_S_2_RANGE______76_CM 1 100. 0. 1. DISPLAY_IDENTIFIER LV_ERR_FTL_PLAUS ECU_ADDRESS 0xd000ba4e BIT_MASK 0x2 /end MEASUREMENT
/begin MEASUREMENT dmtl_glob_state_1.bitfield.lv_err_sig_dmtl "Error signal DMTL" ULONG _CNV_S_2_RANGE______76_CM 1 100. 0. 1. DISPLAY_IDENTIFIER LV_ERR_SIG_DMTL ECU_ADDRESS 0xd000ba4e BIT_MASK 0x4 /end MEASUREMENT
/begin MEASUREMENT dmtl_glob_state_1.bitfield.lv_ftl_diag "Level sensor diagnosis" ULONG _CNV_S_2_RANGE______76_CM 1 100. 0. 1. DISPLAY_IDENTIFIER LV_FTL_DIAG ECU_ADDRESS 0xd000ba4e BIT_MASK 0x8 /end MEASUREMENT
/begin MEASUREMENT dmtl_glob_state_1.bitfield.lv_fuc_can "Tank cap open - display" ULONG _CNV_S_2_RANGE______76_CM 1 100. 0. 1. DISPLAY_IDENTIFIER LV_FUC_CAN ECU_ADDRESS 0xd000ba4e BIT_MASK 0x10 /end MEASUREMENT
/begin MEASUREMENT dmtl_glob_state_1.bitfield.lv_fuc_open "Filler cap open" ULONG _CNV_S_2_RANGE______76_CM 1 100. 0. 1. DISPLAY_IDENTIFIER LV_FUC_OPEN ECU_ADDRESS 0xd000ba4e BIT_MASK 0x20 /end MEASUREMENT
/begin MEASUREMENT dmtl_glob_state_1.bitfield.lv_no_purge_dmtl "request for no_purge of the evap.-system" ULONG _CNV_S_2_RANGE______76_CM 1 100. 0. 1. DISPLAY_IDENTIFIER LV_NO_PURGE_DMTL ECU_ADDRESS 0xd000ba4e BIT_MASK 0x40 /end MEASUREMENT
/begin MEASUREMENT dmtl_glob_state_1.bitfield.lv_refu_dmtl "Condition refueling" ULONG _CNV_S_2_RANGE______76_CM 1 100. 0. 1. DISPLAY_IDENTIFIER LV_REFU_DMTL ECU_ADDRESS 0xd000ba4e BIT_MASK 0x100 /end MEASUREMENT
/begin MEASUREMENT dmtl_glob_state_1.bitfield.lv_rough_leak_susp_int "Rough leak suspected" ULONG _CNV_S_2_RANGE______76_CM 1 100. 0. 1. DISPLAY_IDENTIFIER LV_ROUGH_LEAK_SUSP ECU_ADDRESS 0xd000ba4e BIT_MASK 0x200 /end MEASUREMENT
/begin MEASUREMENT dmtl_glob_state_1.bitfield.lv_chk_dmtl_cur_dmtl_vld "Virtuel check of component concerning valid pump current" ULONG _CNV_S_2_RANGE______76_CM 1 100. 0. 1. DISPLAY_IDENTIFIER LV_CHK_DMTL_CUR_DMTL_VLD ECU_ADDRESS 0xd000ba4e BIT_MASK 0x1000 /end MEASUREMENT
/begin MEASUREMENT dmtl_glob_state_1.bitfield.lv_chk_dmtl_vld "Check of components on current fluctuations valid" ULONG _CNV_S_2_RANGE______76_CM 1 100. 0. 1. DISPLAY_IDENTIFIER LV_CHK_DMTL_VLD ECU_ADDRESS 0xd000ba4e BIT_MASK 0x2000 /end MEASUREMENT
/begin MEASUREMENT dmtl_glob_state_1.bitfield.lv_err_det_small_leak_min "Error, minimum value detected, miniature leakage" ULONG _CNV_S_2_RANGE______76_CM 1 100. 0. 1. DISPLAY_IDENTIFIER LV_ERR_DET_SMALL_LEAK_MIN ECU_ADDRESS 0xd000ba4e BIT_MASK 0x800 /end MEASUREMENT
/begin MEASUREMENT dmtl_glob_state_1.bitfield.lv_ftl_dmtl_val "validated tank level for DMTL function" ULONG _CNV_S_2_RANGE______76_CM 1 100. 0. 1. DISPLAY_IDENTIFIER LV_FTL_DMTL_VAL ECU_ADDRESS 0xd000ba4e BIT_MASK 0x4000 /end MEASUREMENT
/begin MEASUREMENT dmtl_glob_state_1.bitfield.lv_cyc_rough_leak_susp_int "Cycle flag, rough leak suspected" ULONG _CNV_S_2_RANGE______76_CM 1 100. 0. 1. DISPLAY_IDENTIFIER LV_CYC_ROUGH_LEAK_SUSP ECU_ADDRESS 0xd000ba4e BIT_MASK 0x400 /end MEASUREMENT
/begin MEASUREMENT dmtl_glob_state_2.bitfield.lv_req_pwl_dmtl "Request of STG off delay, tank leakage diagnosis" ULONG _CNV_S_2_RANGE______76_CM 1 100. 0. 1. DISPLAY_IDENTIFIER LV_REQ_PWL_DMTL ECU_ADDRESS 0xd000ba50 BIT_MASK 0x1 /end MEASUREMENT
/begin MEASUREMENT dmtl_glob_state_2.bitfield.lv_rough_leak_susp_set "Rough leak suspicion with cycle bit rough leak suspicion present" ULONG _CNV_S_2_RANGE______76_CM 1 100. 0. 1. DISPLAY_IDENTIFIER LV_ROUGH_LEAK_SUSP_SET ECU_ADDRESS 0xd000ba50 BIT_MASK 0x4 /end MEASUREMENT
/begin MEASUREMENT dmtl_glob_state_2.bitfield.lv_sdr_dmtl "Error plausibility DMTL" ULONG _CNV_S_2_RANGE______76_CM 1 100. 0. 1. DISPLAY_IDENTIFIER LV_SDR_DMTL ECU_ADDRESS 0xd000ba50 BIT_MASK 0x8 /end MEASUREMENT
/begin MEASUREMENT dmtl_glob_state_2.bitfield.lv_t_dmtl_max "max. time for DMTL" ULONG _CNV_S_2_RANGE______76_CM 1 100. 0. 1. DISPLAY_IDENTIFIER LV_T_DMTL_MAX ECU_ADDRESS 0xd000ba50 BIT_MASK 0x10 /end MEASUREMENT
/begin MEASUREMENT dmtl_glob_state_2.bitfield.lv_vb_dif_max "high battery voltage deviation" ULONG _CNV_S_2_RANGE______76_CM 1 100. 0. 1. DISPLAY_IDENTIFIER LV_VB_DIF_MAX ECU_ADDRESS 0xd000ba50 BIT_MASK 0x20 /end MEASUREMENT
/begin MEASUREMENT dmtl_glob_state_2.bitfield.lv_dr_dmtls "DMTL solenoid valve activation" ULONG _CNV_S_2_RANGE______76_CM 1 100. 0. 1. DISPLAY_IDENTIFIER LV_DR_DMTLS ECU_ADDRESS 0xd000ba50 BIT_MASK 0x40 /end MEASUREMENT
/begin MEASUREMENT dmtl_glob_state_2.bitfield.lv_vb_range_dmtl "DMTL does not start because battery is out of band width" ULONG _CNV_S_2_RANGE______76_CM 1 100. 0. 1. DISPLAY_IDENTIFIER LV_VB_RANGE_DMTL ECU_ADDRESS 0xd000ba50 BIT_MASK 0x4000 /end MEASUREMENT
/begin MEASUREMENT dmtl_glob_state_2.bitfield.lv_cyc_rough_leak_mode6 "Cycle flag, rough leak error" ULONG _CNV_S_2_RANGE______76_CM 1 100. 0. 1. DISPLAY_IDENTIFIER LV_CYC_ROUGH_LEAK_MODE6 ECU_ADDRESS 0xd000ba50 BIT_MASK 0x80 /end MEASUREMENT
/begin MEASUREMENT dmtl_glob_state_2.bitfield.lv_rough_leak_mes_len "Condition, extension rough leak measurement" ULONG _CNV_S_2_RANGE______76_CM 1 100. 0. 1. DISPLAY_IDENTIFIER LV_ROUGH_LEAK_MES_LEN ECU_ADDRESS 0xd000ba50 BIT_MASK 0x100 /end MEASUREMENT
/begin MEASUREMENT dmtl_glob_state_2.bitfield.lv_cyc_small_leak_mode6 "Cycle flag, miniature leak" ULONG _CNV_S_2_RANGE______76_CM 1 100. 0. 1. DISPLAY_IDENTIFIER LV_CYC_SMALL_LEAK_MODE6 ECU_ADDRESS 0xd000ba50 BIT_MASK 0x200 /end MEASUREMENT
/begin MEASUREMENT dmtl_glob_state_2.bitfield.lv_refu_int "Refueling" ULONG _CNV_S_2_RANGE______76_CM 1 100. 0. 1. DISPLAY_IDENTIFIER LV_REFU ECU_ADDRESS 0xd000ba50 BIT_MASK 0x400 /end MEASUREMENT
/begin MEASUREMENT dmtl_glob_state_2.bitfield.lv_refu_val_int "Refueling bit valid, internal" ULONG _CNV_S_2_RANGE______76_CM 1 100. 0. 1. DISPLAY_IDENTIFIER LV_REFU_VAL ECU_ADDRESS 0xd000ba50 BIT_MASK 0x800 /end MEASUREMENT
/begin MEASUREMENT dmtl_glob_state_2.bitfield.lv_ena_chk_fuc_rough_leak "Enable rough leak measurement due to check filler cap" ULONG _CNV_S_2_RANGE______76_CM 1 100. 0. 1. DISPLAY_IDENTIFIER LV_ENA_CHK_FUC_ROUGH_LEAK ECU_ADDRESS 0xd000ba50 BIT_MASK 0x1000 /end MEASUREMENT
/begin MEASUREMENT cur_dmtl_small_leak_end "Pump current at the end of the miniature leak measurement" UWORD _CNV_A_R_LINEAR_____148_CM 1 100. 0. 400. DISPLAY_IDENTIFIER CUR_DMTL_SMALL_LEAK_END ECU_ADDRESS 0xd0000956 FORMAT "%7.3" /end MEASUREMENT
/begin MEASUREMENT cur_dmtl_ref_dif_max "???" UWORD _CNV_A_R_LINEAR_____148_CM 1 100. 0. 400. DISPLAY_IDENTIFIER CUR_DMTL_REF_DIF_MAX ECU_ADDRESS 0xd0000950 FORMAT "%7.3" /end MEASUREMENT
/begin CHARACTERISTIC c_t_dly_stop_refu "Delay time stop before refueling" VALUE 0xa080c188 _REC_VAL_20_u2 65535. _CNV_A_R_LINEAR_____36_CM 0. 65535. DISPLAY_IDENTIFIER C_T_DLY_STOP_REFU FORMAT "%5.0" /end CHARACTERISTIC
/begin CHARACTERISTIC c_t_ena_dr_dmtl_max "max. time for function request DMTL output stages" VALUE 0xa080c1ae _REC_VAL_20_u2 6553.5 _CNV_A_R_LINEAR_____4_CM 0. 6553.5 DISPLAY_IDENTIFIER C_T_ENA_DR_DMTL_MAX FORMAT "%6.1" /end CHARACTERISTIC
/begin CHARACTERISTIC ip_t_act_rough_leak "Time for rough leak measurement" CURVE 0xa080b3c4 _REC_CUR_20_u2_u1 655.35 _CNV_A_R_LINEAR_____4_CM 0. 6553.5 DISPLAY_IDENTIFIER IP_T_ACT_ROUGH_LEAK FORMAT "%6.1"
 /begin AXIS_DESCR COM_AXIS ftl _CNV_A_R_LINEAR_____75_CM 5 0. 126. FORMAT "%3.0" AXIS_PTS_REF ldp_ftl__t_rough_leak_test /end AXIS_DESCR
/end CHARACTERISTIC
/begin CHARACTERISTIC ip_t_act_rough_leak_chk_fuc "Time for rough leak measurement in case of check filler cap and error FTL" CURVE 0xa080b3d0 _REC_CUR_20_u2_u1 655.35 _CNV_A_R_LINEAR_____4_CM 0. 6553.5 DISPLAY_IDENTIFIER IP_T_ACT_ROUGH_LEAK_CHK_FUC FORMAT "%6.1"
 /begin AXIS_DESCR COM_AXIS ftl _CNV_A_R_LINEAR_____75_CM 5 0. 126. FORMAT "%3.0" AXIS_PTS_REF ldp_ftl__t_rough_leak_test /end AXIS_DESCR
/end CHARACTERISTIC
/begin CHARACTERISTIC c_t_act_rough_leak "Time for rough leak measurement" VALUE 0xa080c10e _REC_VAL_20_u2 6553.2 _CNV_A_R_LINEAR_____4_CM 0.3 6553.5 DISPLAY_IDENTIFIER C_T_ACT_ROUGH_LEAK FORMAT "%6.1" /end CHARACTERISTIC
/begin CHARACTERISTIC c_t_act_rough_leak_chk_fuc "Time for rough leak measurement in case of check filler cap" VALUE 0xa080c110 _REC_VAL_20_u2 6553.2 _CNV_A_R_LINEAR_____4_CM 0.3 6553.5 DISPLAY_IDENTIFIER C_T_ACT_ROUGH_LEAK_CHK_FUC FORMAT "%6.1" /end CHARACTERISTIC
/begin CHARACTERISTIC c_vb_dmtl_dif "Delta VB threshold for DMTL" VALUE 0xa080c41a _REC_VAL_20_u2 25.999603 _CNV_A_R_LINEAR_____157_CM 0. 25.999603 DISPLAY_IDENTIFIER C_VB_DMTL_DIF FORMAT "%7.4" /end CHARACTERISTIC
/begin CHARACTERISTIC c_vb_dmtl_dif_chk_fuc "Delta VB threshold for DMTL in case of check filler cap" VALUE 0xa080c41c _REC_VAL_20_u2 25.999603 _CNV_A_R_LINEAR_____157_CM 0. 25.999603 DISPLAY_IDENTIFIER C_VB_DMTL_DIF_CHK_FUC FORMAT "%7.4" /end CHARACTERISTIC
/begin MEASUREMENT ctr_cnl_small_leak_mes "Number of aborted miniature leak measurements due to current fluctuations" UBYTE _CNV_A_R_LINEAR_____0_CM 1 100. 0. 255. DISPLAY_IDENTIFIER CTR_CNL_SMALL_LEAK_MES ECU_ADDRESS 0xd0008e19 FORMAT "%3.0" /end MEASUREMENT
/begin MEASUREMENT ctr_ena_dmtl_chk_fuc "Number of enabled check filler cap checks" UBYTE _CNV_A_R_LINEAR_____0_CM 1 100. 0. 255. DISPLAY_IDENTIFIER CTR_ENA_DMTL_CHK_FUC ECU_ADDRESS 0xd000099b FORMAT "%3.0" /end MEASUREMENT
/begin CHARACTERISTIC c_t_ast_dmtl_max "min. post-starting period for canister purge diagnosis" VALUE 0xa080c120 _REC_VAL_20_u2 6553.2 _CNV_A_R_LINEAR_____4_CM 0.3 6553.5 DISPLAY_IDENTIFIER C_T_AST_DMTL_MAX FORMAT "%6.1" /end CHARACTERISTIC
/begin CHARACTERISTIC c_t_ast_dmtl_chk_fuc "minimum time after start for enabling check filler cap check" VALUE 0xa080c11e _REC_VAL_20_u2 6553.5 _CNV_A_R_LINEAR_____4_CM 0. 6553.5 DISPLAY_IDENTIFIER C_T_AST_DMTL_CHK_FUC FORMAT "%6.1" /end CHARACTERISTIC
/begin CHARACTERISTIC c_t_ena_dmtl_chk_fuc "minimum time between two check filler cap checks" VALUE 0xa080c1ac _REC_VAL_20_u2 6553.5 _CNV_A_R_LINEAR_____4_CM 0. 6553.5 DISPLAY_IDENTIFIER C_T_ENA_DMTL_CHK_FUC FORMAT "%6.1" /end CHARACTERISTIC
/begin CHARACTERISTIC c_tam_dmtl_max "upper temperature threshold for the DMTL function" VALUE 0xa080c2ae _REC_VAL_20_u1 190.5 _CNV_A_R_LINEAR_____17_CM -48. 142.5 DISPLAY_IDENTIFIER C_TAM_DMTL_MAX FORMAT "%5.1" /end CHARACTERISTIC
/begin CHARACTERISTIC c_tam_dmtl_chk_fuc_min "minimum ambient temperature for enabling check filler cap check" VALUE 0xa080c2ad _REC_VAL_20_u1 190.5 _CNV_A_R_LINEAR_____17_CM -48. 142.5 DISPLAY_IDENTIFIER C_TAM_DMTL_CHK_FUC_MIN FORMAT "%5.1" /end CHARACTERISTIC
/begin CHARACTERISTIC c_vb_dmtl_min "minimum battery threshold for the DMTL function" VALUE 0xa080c41f _REC_VAL_20_u1 26. _CNV_A_R_LINEAR_____37_CM 0. 26. DISPLAY_IDENTIFIER C_VB_DMTL_MIN FORMAT "%4.1" /end CHARACTERISTIC
/begin CHARACTERISTIC c_vb_dmtl_chk_fuc_min "minimum battery threshold for enabling check filler cap check" VALUE 0xa080c419 _REC_VAL_20_u1 26. _CNV_A_R_LINEAR_____37_CM 0. 26. DISPLAY_IDENTIFIER C_VB_DMTL_CHK_FUC_MIN FORMAT "%4.1" /end CHARACTERISTIC
/begin CHARACTERISTIC c_vb_dmtl_chk_fuc_max "maximum battery threshold for enabling check filler cap check" VALUE 0xa080c418 _REC_VAL_20_u1 26. _CNV_A_R_LINEAR_____37_CM 0. 26. DISPLAY_IDENTIFIER C_VB_DMTL_CHK_FUC_MAX FORMAT "%4.1" /end CHARACTERISTIC
/begin CHARACTERISTIC c_ctr_ena_dmtl_chk_fuc "maximum number of enabled check filler cap checks" VALUE 0xa080bb88 _REC_VAL_20_u1 255. _CNV_A_R_LINEAR_____0_CM 0. 255. DISPLAY_IDENTIFIER C_CTR_ENA_DMTL_CHK_FUC FORMAT "%3.0" /end CHARACTERISTIC
/begin CHARACTERISTIC ip_fac_cur_dmtl_rough "Factor delta pump current for rough leak detection" CURVE 0xa080a304 _REC_CUR_20_u2_u2 0.9999847412109381 _CNV_A_R_LINEAR_____89_CM 0. 0.9999847412109381 DISPLAY_IDENTIFIER IP_FAC_CUR_DMTL_ROUGH FORMAT "%7.5"
 /begin AXIS_DESCR COM_AXIS cur_dmtl_dif_ref_rough_leak _CNV_A_R_LINEAR_____148_CM 8 0. 400. FORMAT "%7.3" AXIS_PTS_REF ldpm_cur_dmtldifrefroughleak_1 /end AXIS_DESCR
/end CHARACTERISTIC
/begin CHARACTERISTIC ip_fac_cur_dmtl_chk_fuc_rough "Factor delta pump current for rough leak detection concerning reference in case of check filler cap test" CURVE 0xa080a2e4 _REC_CUR_20_u2_u2 0.9999847412109381 _CNV_A_R_LINEAR_____89_CM 0. 0.9999847412109381 DISPLAY_IDENTIFIER IP_FAC_CUR_DMTL_CHK_FUC_ROUGH FORMAT "%7.5"
 /begin AXIS_DESCR COM_AXIS cur_dmtl_dif_ref_rough_leak _CNV_A_R_LINEAR_____148_CM 8 0. 400. FORMAT "%7.3" AXIS_PTS_REF ldpm_cur_dmtldifrefroughleak_1 /end AXIS_DESCR
/end CHARACTERISTIC
/begin MEASUREMENT dist_dmtl "Distance covered for DMTL function" ULONG _CNV_A_R_LINEAR_____158_CM 1 100. 0. 65535. DISPLAY_IDENTIFIER DIST_DMTL ECU_ADDRESS 0xd000ba44 FORMAT "%5.0" /end MEASUREMENT
/begin MEASUREMENT cur_dmtl_rough_leak_min_eol "Min. pump current in case of rough leak measurement for tester tool" UWORD _CNV_A_R_LINEAR_____148_CM 1 100. 0. 400. DISPLAY_IDENTIFIER CUR_DMTL_ROUGH_LEAK_MIN_EOL ECU_ADDRESS 0xd000aaa2 FORMAT "%7.3" /end MEASUREMENT
/begin MEASUREMENT cur_dmtl_cor_fil_eol "corrected and filtered pump current for tester tool" UWORD _CNV_A_R_LINEAR_____148_CM 1 100. 0. 400. DISPLAY_IDENTIFIER CUR_DMTL_COR_FIL_EOL ECU_ADDRESS 0xd000aa9a FORMAT "%7.3" /end MEASUREMENT
/begin MEASUREMENT lv_err_rough_leak "Error rough leak" UBYTE _CNV_S_2_RANGE__0___1_CM 1 100. 0. 1. DISPLAY_IDENTIFIER LV_ERR_ROUGH_LEAK ECU_ADDRESS 0xd0007f82 BIT_MASK 0x1 /end MEASUREMENT
/begin MEASUREMENT lv_err_small_leak "Error small leak" UBYTE _CNV_S_2_RANGE__0___1_CM 1 100. 0. 1. DISPLAY_IDENTIFIER LV_ERR_SMALL_LEAK ECU_ADDRESS 0xd0007f83 BIT_MASK 0x1 /end MEASUREMENT
/begin MEASUREMENT lv_dmtls "DMTL valve" UBYTE _CNV_S_2_RANGE__0___1_CM 1 100. 0. 1. DISPLAY_IDENTIFIER LV_DMTLS ECU_ADDRESS 0xd0008e21 BIT_MASK 0x1 /end MEASUREMENT
/begin MEASUREMENT lv_hdmtl_on "DMTL Heater" UBYTE _CNV_S_2_RANGE__0___1_CM 1 100. 0. 1. DISPLAY_IDENTIFIER LV_HDMTL_ON ECU_ADDRESS 0xd0008e22 BIT_MASK 0x1 /end MEASUREMENT
/begin MEASUREMENT lv_dmtl_pump "DMTL Pump" UBYTE _CNV_S_2_RANGE__0___1_CM 1 100. 0. 1. DISPLAY_IDENTIFIER LV_DMTL_PUMP ECU_ADDRESS 0xd0008e23 BIT_MASK 0x1 /end MEASUREMENT
/begin MEASUREMENT lv_tco_st_dmtl "Coldstart condition for DMTL fulfilled" UBYTE _CNV_S_2_RANGE__0___1_CM 1 100. 0. 1. DISPLAY_IDENTIFIER LV_TCO_ST_DMTL ECU_ADDRESS 0xd0008e24 BIT_MASK 0x1 /end MEASUREMENT
/begin CHARACTERISTIC c_cod_dmtl "Calibrationconstant" VALUE 0xa080bab1 _REC_VAL_20_u1 255. _CNV_A_R_LINEAR_____0_CM 0. 255. DISPLAY_IDENTIFIER C_COD_DMTL FORMAT "%3.0" /end CHARACTERISTIC
/begin CHARACTERISTIC c_tco_st_dmtl_cold "TCO_ST offset of TAM to enable a DMTL diagnosis" VALUE 0xa080c2de _REC_VAL_20_s1 191.25 _CNV_A_R_LINEAR_____25_CM -96. 95.25 DISPLAY_IDENTIFIER C_TCO_ST_DMTL_COLD FORMAT "%6.2" /end CHARACTERISTIC
/begin CHARACTERISTIC c_ctr_tco_st_dmtl_min "Threshold of recognized cold start for DMTL small leak test" VALUE 0xa080bbde _REC_VAL_20_u1 255. _CNV_A_R_LINEAR_____0_CM 0. 255. DISPLAY_IDENTIFIER C_CTR_TCO_ST_DMTL_MIN FORMAT "%3.0" /end CHARACTERISTIC
/begin MEASUREMENT ctr_tco_st_dmtl "Counter of recognized cold starts for DMTL small leak test" UBYTE _CNV_A_R_LINEAR_____0_CM 1 100. 0. 255. DISPLAY_IDENTIFIER CTR_TCO_ST_DMTL ECU_ADDRESS 0xd0008e20 FORMAT "%3.0" /end MEASUREMENT
/begin MEASUREMENT lv_inh_diagcps "activation condition for Functional check CPS, irreversible" UBYTE _CNV_S_2_RANGE__0___1_CM 1 100. 0. 1. DISPLAY_IDENTIFIER LV_INH_DIAGCPS ECU_ADDRESS 0xd0008600 BIT_MASK 0x1 /end MEASUREMENT
/begin MEASUREMENT lv_di_diagcps "activation condition for Functional check CPS, reversible" UBYTE _CNV_S_2_RANGE__0___1_CM 1 100. 0. 1. DISPLAY_IDENTIFIER LV_DI_DIAGCPS ECU_ADDRESS 0xd0008601 BIT_MASK 0x1 /end MEASUREMENT
/begin CHARACTERISTIC c_tco_min_diagcps_1 "min. temperature for FC CPS/ Step1 (CL diagnosis)" VALUE 0xa080c2cf _REC_VAL_20_u1 190.5 _CNV_A_R_LINEAR_____17_CM -48. 142.5 DISPLAY_IDENTIFIER C_TCO_MIN_DIAGCPS_1 FORMAT "%5.1" /end CHARACTERISTIC
/begin MEASUREMENT state_rbm_diagcps "Interface of DIAGCPS monitor with the Rate-Based Monitoring statistics" UBYTE _CNV_A_R_LINEAR_____0_CM 1 100. 0. 255. DISPLAY_IDENTIFIER STATE_RBM_DIAGCPS ECU_ADDRESS 0xd0008602 FORMAT "%3.0" /end MEASUREMENT
/begin MEASUREMENT lv_inh_diag_rbm_diagcps "flag to inhibit catalyst diagnosis function if there is a OBD failure" UBYTE _CNV_S_2_RANGE__0___1_CM 1 100. 0. 1. DISPLAY_IDENTIFIER LV_INH_DIAG_RBM_DIAGCPS ECU_ADDRESS 0xd0000c50 BIT_MASK 0x1 /end MEASUREMENT
/begin MEASUREMENT opm_av_diagcps "Operation mode DIAGCPS" UBYTE _CNV_A_R_LINEAR_____0_CM 1 100. 0. 2. DISPLAY_IDENTIFIER OPM_AV_DIAGCPS ECU_ADDRESS 0xd0008603 FORMAT "%2.0" /end MEASUREMENT
/begin CHARACTERISTIC id_opm_av_diagcps "Operation mode for which DIAGCPS is enabled (0H = never, 1H = UGD, 2H = GD)" CURVE 0xa0809d9c _REC_CUR_20_u1_u1 2. _CNV_A_R_LINEAR_____0_CM 0. 2. DISPLAY_IDENTIFIER ID_OPM_AV_DIAGCPS FORMAT "%2.0"
 /begin AXIS_DESCR COM_AXIS opm_av _CNV_A_R_LINEAR_____0_CM 8 0. 8. FORMAT "%1.0" AXIS_PTS_REF ldpm_opm_av /end AXIS_DESCR
/end CHARACTERISTIC
/begin MEASUREMENT flow_sp_cp_diagcps "Flow setpoint through the CPS during Functional check CPS" UWORD _CNV_A_R_LINEAR_____162_CM 1 100. 0. 7.9998779296875 DISPLAY_IDENTIFIER FLOW_SP_CP_DIAGCPS ECU_ADDRESS 0xd000a0dc FORMAT "%7.4" /end MEASUREMENT
/begin MEASUREMENT lv_act_diagcps "Indication for Functional check cps (step 2 or 3) being activated" UBYTE _CNV_S_2_RANGE__0___1_CM 1 100. 0. 1. DISPLAY_IDENTIFIER LV_ACT_DIAGCPS ECU_ADDRESS 0xd000860b BIT_MASK 0x1 /end MEASUREMENT
/begin MEASUREMENT lv_maf_diagcps_0 "Auxiliary bit for step 3 - Functional check CPS" UBYTE _CNV_S_2_RANGE__0___1_CM 1 100. 0. 1. DISPLAY_IDENTIFIER LV_MAF_DIAGCPS_0 ECU_ADDRESS 0xd0000c7d BIT_MASK 0x1 /end MEASUREMENT
/begin MEASUREMENT lv_supp_accin_diagcps "Bit to suppress the air conditioning compressor request signal - Functional check CPS" UBYTE _CNV_S_2_RANGE__0___1_CM 1 100. 0. 1. DISPLAY_IDENTIFIER LV_SUPP_ACCIN_DIAGCPS ECU_ADDRESS 0xd000860d BIT_MASK 0x1 /end MEASUREMENT
/begin MEASUREMENT maf_diagcps "MAF value on start of step 3 - Functional check CPS" UWORD _CNV_A_R_LINEAR_____111_CM 1 100. 0. 1389. DISPLAY_IDENTIFIER MAF_DIAGCPS ECU_ADDRESS 0xd0000c56 FORMAT "%7.2" /end MEASUREMENT
/begin MEASUREMENT n_diagcps "N value on starting the time C_T_DIAGCPS_N_2" UWORD _CNV_A_R_LINEAR_____14_CM 1 100. 0. 8160. DISPLAY_IDENTIFIER N_DIAGCPS ECU_ADDRESS 0xd0000c58 FORMAT "%4.0" /end MEASUREMENT
/begin MEASUREMENT sum_flow_sp_diagcps_eol "Number of step 2 loops which have been passed if EOL-Test is active - fuctional check CPS" UBYTE _CNV_A_R_LINEAR_____163_CM 1 100. 0. 255. DISPLAY_IDENTIFIER SUM_FLOW_SP_DIAGCPS_EOL ECU_ADDRESS 0xd0008606 FORMAT "%3.0" /end MEASUREMENT
/begin MEASUREMENT sum_flow_sp_diagcps "Number of step 2 loops which have been passed - Functional check CPS" UBYTE _CNV_A_R_LINEAR_____163_CM 1 100. 0. 255. DISPLAY_IDENTIFIER SUM_FLOW_SP_DIAGCPS ECU_ADDRESS 0xd0000c6c FORMAT "%3.0" /end MEASUREMENT
/begin MEASUREMENT sum_diag_diagcps_eol "Number of diagnoses if EOL-Test is active - Functional check CPS" UBYTE _CNV_A_R_LINEAR_____163_CM 1 100. 0. 255. DISPLAY_IDENTIFIER SUM_DIAG_DIAGCPS_EOL ECU_ADDRESS 0xd0008607 FORMAT "%3.0" /end MEASUREMENT
/begin MEASUREMENT sum_diag_diagcps "Number of diagnoses - Functional check CPS" UBYTE _CNV_A_R_LINEAR_____163_CM 1 100. 0. 255. DISPLAY_IDENTIFIER SUM_DIAG_DIAGCPS ECU_ADDRESS 0xd0000c6d FORMAT "%3.0" /end MEASUREMENT
/begin MEASUREMENT t_diagcps_dly "Delay time - Functional check CPS" UBYTE _CNV_A_R_LINEAR_____4_CM 1 100. 0.1 25.5 DISPLAY_IDENTIFIER T_DIAGCPS_DLY ECU_ADDRESS 0xd0000c73 FORMAT "%4.1" /end MEASUREMENT
/begin MEASUREMENT t_diagcps_maf "Time for active FLOW_SP offset - Functional check CPS" UBYTE _CNV_A_R_LINEAR_____4_CM 1 100. 0.1 25.5 DISPLAY_IDENTIFIER T_DIAGCPS_MAF ECU_ADDRESS 0xd0000c74 FORMAT "%4.1" /end MEASUREMENT
/begin MEASUREMENT maf_sp_tqi_mmv_diagcps "Moving mean value of MAF_SP_TQI (RAM cell) - Functional check CPS" UWORD _CNV_A_R_LINEAR_____111_CM 1 100. 0. 1389. DISPLAY_IDENTIFIER MAF_SP_TQI_MMV_DIAGCPS ECU_ADDRESS 0xd000a0e4 FORMAT "%7.2" /end MEASUREMENT
/begin MEASUREMENT lv_maf_sp_tqi_dyw_diagcps "Indication for limited dynamic condition - Functional check CPS" UBYTE _CNV_S_2_RANGE__0___1_CM 1 100. 0. 1. DISPLAY_IDENTIFIER LV_MAF_SP_TQI_DYW_DIAGCPS ECU_ADDRESS 0xd000860e BIT_MASK 0x1 /end MEASUREMENT
/begin CHARACTERISTIC c_cl_mmv_diagcps "Moving mean value of canister load for Functional check CPS" VALUE 0xa080baa6 _REC_VAL_20_u2 1.99996948242188 _CNV_A_R_LINEAR_____9_CM 0. 1.99996948242188 DISPLAY_IDENTIFIER C_CL_MMV_DIAGCPS FORMAT "%7.5" /end CHARACTERISTIC
/begin CHARACTERISTIC c_flow_sp_diagcps_maf "Flow setpoint offset in step 3 - Functional check CPS " VALUE 0xa080bd30 _REC_VAL_20_u2 7.9998779296875 _CNV_A_R_LINEAR_____162_CM 0. 7.9998779296875 DISPLAY_IDENTIFIER C_FLOW_SP_DIAGCPS_MAF FORMAT "%7.4" /end CHARACTERISTIC
/begin CHARACTERISTIC c_flow_sp_diagcps_n "Flow setpoint offset in step 2 - Functional check CPS " VALUE 0xa080bd32 _REC_VAL_20_u2 7.9998779296875 _CNV_A_R_LINEAR_____162_CM 0. 7.9998779296875 DISPLAY_IDENTIFIER C_FLOW_SP_DIAGCPS_N FORMAT "%7.4" /end CHARACTERISTIC
/begin CHARACTERISTIC c_lgrd_flow_sp_neg_diagcps "Limitation gradient for closing the CPS- funtional check CPS" VALUE 0xa080be02 _REC_VAL_20_u2 7.99987793 _CNV_A_R_LINEAR_____164_CM 0. 7.99987793 DISPLAY_IDENTIFIER C_LGRD_FLOW_SP_NEG_DIAGCPS FORMAT "%7.4" /end CHARACTERISTIC
/begin CHARACTERISTIC c_lgrd_flow_sp_pos_diagcps "Limitation gradient for opening the CPS- funtional check CPS" VALUE 0xa080be04 _REC_VAL_20_u2 7.99987793 _CNV_A_R_LINEAR_____164_CM 0. 7.99987793 DISPLAY_IDENTIFIER C_LGRD_FLOW_SP_POS_DIAGCPS FORMAT "%7.4" /end CHARACTERISTIC
/begin CHARACTERISTIC c_n_dif_diagcps "Condition for IS engine speed difference - Functional check CPS" VALUE 0xa080bf1e _REC_VAL_20_u2 8159. _CNV_A_R_LINEAR_____14_CM 1. 8160. DISPLAY_IDENTIFIER C_N_DIF_DIAGCPS FORMAT "%4.0" /end CHARACTERISTIC
/begin CHARACTERISTIC c_sum_flow_sp_diagcps_max "Max. number of step 2 loops which have been passed - Functional check CPS" VALUE 0xa080c102 _REC_VAL_20_u1 255. _CNV_A_R_LINEAR_____163_CM 0. 255. DISPLAY_IDENTIFIER C_SUM_FLOW_SP_DIAGCPS_MAX FORMAT "%3.0" /end CHARACTERISTIC
/begin CHARACTERISTIC c_sum_diagcps_max "Counter limit of C_SUM_DIAGCPS - funtional check CPS" VALUE 0xa080c101 _REC_VAL_20_u1 255. _CNV_A_R_LINEAR_____163_CM 0. 255. DISPLAY_IDENTIFIER C_SUM_DIAGCPS_MAX FORMAT "%3.0" /end CHARACTERISTIC
/begin CHARACTERISTIC c_t_diagcps_maf "Time for active FLOW_SP offset C_FLOW_SP_DIAGCPS_MAF - Functional check CPS" VALUE 0xa080c163 _REC_VAL_20_u1 25.4 _CNV_A_R_LINEAR_____4_CM 0.1 25.5 DISPLAY_IDENTIFIER C_T_DIAGCPS_MAF FORMAT "%4.1" /end CHARACTERISTIC
/begin CHARACTERISTIC c_t_diagcps_dly "Delay time - Functional check CPS" VALUE 0xa080c162 _REC_VAL_20_u1 25.4 _CNV_A_R_LINEAR_____4_CM 0.1 25.5 DISPLAY_IDENTIFIER C_T_DIAGCPS_DLY FORMAT "%3.1" /end CHARACTERISTIC
/begin CHARACTERISTIC c_crlc_maf_sp_tqi_diagcps "Correlation constant for calculation of MAF_SP_TQI_MMV_DIAGCPS" VALUE 0xa080bafc _REC_VAL_20_u2 1. _CNV_A_R_LINEAR_____165_CM 0. 1. DISPLAY_IDENTIFIER C_CRLC_MAF_SP_TQI_DIAGCPS FORMAT "%7.5" /end CHARACTERISTIC
/begin CHARACTERISTIC c_maf_sp_tqi_dyw_diagcps "Dynamic window around MAF_SP_TQI_MMV_DIAGCPS" VALUE 0xa080be52 _REC_VAL_20_u2 1389. _CNV_A_R_LINEAR_____111_CM 0. 1389. DISPLAY_IDENTIFIER C_MAF_SP_TQI_DYW_DIAGCPS FORMAT "%7.2" /end CHARACTERISTIC
/begin CHARACTERISTIC c_maf_max_diagcps "MAF condition functional check CPS" VALUE 0xa080be3a _REC_VAL_20_u2 1389. _CNV_A_R_LINEAR_____111_CM 0. 1389. DISPLAY_IDENTIFIER C_MAF_MAX_DIAGCPS FORMAT "%7.2" /end CHARACTERISTIC
/begin MEASUREMENT flow_sp_cps_old "Last EVAP calculated flow set point through the CPS before start of FC CPS" UWORD _CNV_A_R_LINEAR_____162_CM 1 100. 0. 7.9998779296875 DISPLAY_IDENTIFIER FLOW_SP_CPS_OLD ECU_ADDRESS 0xd0000c54 FORMAT "%7.4" /end MEASUREMENT
/begin MEASUREMENT sum_diag_diagcps_sae "Output mode06h -  Step 2" UBYTE _CNV_A_R_LINEAR_____163_CM 1 100. 0. 255. DISPLAY_IDENTIFIER SUM_DIAG_DIAGCPS_SAE ECU_ADDRESS 0xd0008608 FORMAT "%3.0" /end MEASUREMENT
/begin MEASUREMENT maf_diagcps_sae "Output mode06h - Step 3" UWORD _CNV_A_R_LINEAR_____111_CM 1 100. 0. 1389. DISPLAY_IDENTIFIER MAF_DIAGCPS_SAE ECU_ADDRESS 0xd000a0e0 FORMAT "%4.0" /end MEASUREMENT
/begin MEASUREMENT maf_diagcps_thd_sae "Output mode06h - Step 3" UWORD _CNV_A_R_LINEAR_____111_CM 1 100. 0. 1389. DISPLAY_IDENTIFIER MAF_DIAGCPS_THD_SAE ECU_ADDRESS 0xd000a0e2 FORMAT "%4.0" /end MEASUREMENT
/begin MEASUREMENT cl_mmv_sae "Output mode06h -  Step 1" UWORD _CNV_A_R_LINEAR_____9_CM 1 100. 0. 1.99996948242188 DISPLAY_IDENTIFIER CL_MMV_SAE ECU_ADDRESS 0xd000a0de FORMAT "%7.5" /end MEASUREMENT
/begin CHARACTERISTIC c_tco_min_diagcps "min. temperature for Functional check CPS" VALUE 0xa080c2ce _REC_VAL_20_u1 190.5 _CNV_A_R_LINEAR_____17_CM -48. 142.5 DISPLAY_IDENTIFIER C_TCO_MIN_DIAGCPS FORMAT "%5.1" /end CHARACTERISTIC
/begin CHARACTERISTIC c_sum_diagcps_eol "EOL-test: Counter limit of SUM_DIAGCPS_EOL - functional check CPS" VALUE 0xa080c100 _REC_VAL_20_u1 255. _CNV_A_R_LINEAR_____163_CM 0. 255. DISPLAY_IDENTIFIER C_SUM_DIAGCPS_EOL FORMAT "%3.0" /end CHARACTERISTIC
/begin MEASUREMENT lv_eol_cps_err "LV indicating error of functional check CPS (step 2) after EOL - test" UBYTE _CNV_S_2_RANGE__0___1_CM 1 100. 0. 1. DISPLAY_IDENTIFIER LV_EOL_CPS_ERR ECU_ADDRESS 0xd000860c BIT_MASK 0x1 /end MEASUREMENT
/begin MEASUREMENT lv_err_diagcps "Indication for faulty functions - functioanl check CPS" UBYTE _CNV_S_2_RANGE__0___1_CM 1 100. 0. 1. DISPLAY_IDENTIFIER LV_ERR_DIAGCPS ECU_ADDRESS 0xd0007f8c BIT_MASK 0x1 /end MEASUREMENT
/begin MEASUREMENT lv_n_dif_diagcps "Auxiliary bit for step 2 - Functional check CPS" UBYTE _CNV_S_2_RANGE__0___1_CM 1 100. 0. 1. DISPLAY_IDENTIFIER LV_N_DIF_DIAGCPS ECU_ADDRESS 0xd0000c7f BIT_MASK 0x1 /end MEASUREMENT
/begin MEASUREMENT lv_end_rbm_diagcps "Indication for RBM that all three steps have been executed - functional check CPS" UBYTE _CNV_S_2_RANGE__0___1_CM 1 100. 0. 1. DISPLAY_IDENTIFIER LV_END_RBM_DIAGCPS ECU_ADDRESS 0xd000860f BIT_MASK 0x1 /end MEASUREMENT
/begin MEASUREMENT lv_map_dif_diagcps "Auxiliary bit for step 2 - Functional check CPS" UBYTE _CNV_S_2_RANGE__0___1_CM 1 100. 0. 1. DISPLAY_IDENTIFIER LV_MAP_DIF_DIAGCPS ECU_ADDRESS 0xd0000c83 BIT_MASK 0x1 /end MEASUREMENT
/begin MEASUREMENT lv_inh_map_ctl_diagcps "Inhibition of Map-control during step 2 - Functional check CPS" UBYTE _CNV_S_2_RANGE__0___1_CM 1 100. 0. 1. DISPLAY_IDENTIFIER LV_INH_MAP_CTL_DIAGCPS ECU_ADDRESS 0xd0008610 BIT_MASK 0x1 /end MEASUREMENT
/begin MEASUREMENT lv_lam_diagcps "Auxiliary bit for step 2 - Functional check CPS" UBYTE _CNV_S_2_RANGE__0___1_CM 1 100. 0. 1. DISPLAY_IDENTIFIER LV_LAM_DIAGCPS ECU_ADDRESS 0xd0000c85 BIT_MASK 0x1 /end MEASUREMENT
/begin MEASUREMENT lv_lam_sum_diagcps "Auxiliary bit for step 2 - Functional check CPS" UBYTE _CNV_S_2_RANGE__0___1_CM 1 100. 0. 1. DISPLAY_IDENTIFIER LV_LAM_SUM_DIAGCPS ECU_ADDRESS 0xd0000c86 BIT_MASK 0x1 /end MEASUREMENT
/begin MEASUREMENT map_diagcps "Map value on starting the time C_T_DIAGCPS_N_2" UWORD _CNV_A_R_LINEAR_____27_CM 1 100. 0. 5434. DISPLAY_IDENTIFIER MAP_DIAGCPS ECU_ADDRESS 0xd0000c5a FORMAT "%7.2" /end MEASUREMENT
/begin MEASUREMENT sum_n_diag_diagcps "Number of diagnoses results N - functional check CPS" UBYTE _CNV_A_R_LINEAR_____163_CM 1 100. 0. 255. DISPLAY_IDENTIFIER SUM_N_DIAG_DIAGCPS ECU_ADDRESS 0xd0000c6e FORMAT "%3.0" /end MEASUREMENT
/begin MEASUREMENT t_diagcps_lam_1 "1st time interval for LAM-Diagnosis - functional check CPS" UBYTE _CNV_A_R_LINEAR_____4_CM 1 100. 0.1 25.5 DISPLAY_IDENTIFIER T_DIAGCPS_LAM_1 ECU_ADDRESS 0xd0000c78 FORMAT "%4.1" /end MEASUREMENT
/begin CHARACTERISTIC c_t_inh_map_ctl_diagcps "Time threshold for inhibition of MAP-control - Functional check CPS" VALUE 0xa080c1d5 _REC_VAL_20_u1 25.4 _CNV_A_R_LINEAR_____4_CM 0.1 25.5 DISPLAY_IDENTIFIER C_T_INH_MAP_CTL_DIAGCPS FORMAT "%4.1" /end CHARACTERISTIC
/begin CHARACTERISTIC c_ti_lam_diagcps_dif "min. TI_LAM_COR_i - differernce while CPS-opening STEP 2 - Functional check CPS" VALUE 0xa080c322 _REC_VAL_20_s2 99.99847412109381 _CNV_A_R_LINEAR_____113_CM -50. 49.9984741210938 DISPLAY_IDENTIFIER C_TI_LAM_DIAGCPS_DIF FORMAT "%7.3" /end CHARACTERISTIC
/begin CHARACTERISTIC c_map_diagcps_1 "Threshold for map difference in step 2 - functional check CPS" VALUE 0xa080be56 _REC_VAL_20_u2 5434. _CNV_A_R_LINEAR_____27_CM 0. 5434. DISPLAY_IDENTIFIER C_MAP_DIAGCPS_1 FORMAT "%7.2" /end CHARACTERISTIC
/begin MEASUREMENT ti_lam_diagcps_dif[0] "TI_LAM_COR_1 - difference while CPS-opening during STEP2 - functional check CPS" SWORD _CNV_A_R_LINEAR_____113_CM 1 100. -50. 49.9984741210938 DISPLAY_IDENTIFIER TI_LAM_DIAGCPS_DIF[0] ECU_ADDRESS 0xd0000c5c FORMAT "%5.4" /end MEASUREMENT
/begin MEASUREMENT ti_lam_diagcps_dif[1] "TI_LAM_COR_2 - difference while CPS-opening during STEP2 - functional check CPS" SWORD _CNV_A_R_LINEAR_____113_CM 1 100. -50. 49.9984741210938 DISPLAY_IDENTIFIER TI_LAM_DIAGCPS_DIF[1] ECU_ADDRESS 0xd0000c5e FORMAT "%5.4" /end MEASUREMENT
/begin MEASUREMENT ti_lam_diagcps_max[0] "TI_LAM_COR_1 - max-value while CPS-opening during STEP2 - functional check CPS" SWORD _CNV_A_R_LINEAR_____113_CM 1 100. -50. 49.9984741210938 DISPLAY_IDENTIFIER TI_LAM_DIAGCPS_MAX[0] ECU_ADDRESS 0xd0000c64 FORMAT "%5.4" /end MEASUREMENT
/begin MEASUREMENT ti_lam_diagcps_max[1] "TI_LAM_COR_2 - max-value while CPS-opening during STEP2 - functional check CPS" SWORD _CNV_A_R_LINEAR_____113_CM 1 100. -50. 49.9984741210938 DISPLAY_IDENTIFIER TI_LAM_DIAGCPS_MAX[1] ECU_ADDRESS 0xd0000c66 FORMAT "%5.4" /end MEASUREMENT
/begin MEASUREMENT ti_lam_diagcps_min[0] "TI_LAM_COR_1 - min-value while CPS-opening during STEP2 - functional check CPS" SWORD _CNV_A_R_LINEAR_____113_CM 1 100. -50. 49.9984741210938 DISPLAY_IDENTIFIER TI_LAM_DIAGCPS_MIN[0] ECU_ADDRESS 0xd0000c60 FORMAT "%5.4" /end MEASUREMENT
/begin MEASUREMENT ti_lam_diagcps_min[1] "TI_LAM_COR_2 - min-value while CPS-opening during STEP2 - functional check CPS" SWORD _CNV_A_R_LINEAR_____113_CM 1 100. -50. 49.9984741210938 DISPLAY_IDENTIFIER TI_LAM_DIAGCPS_MIN[1] ECU_ADDRESS 0xd0000c62 FORMAT "%5.4" /end MEASUREMENT
/begin CHARACTERISTIC c_maf_diagcps_2 "Delta MAF for MAF decrease - Functional check CPS" VALUE 0xa080be20 _REC_VAL_20_u2 1389. _CNV_A_R_LINEAR_____111_CM 0. 1389. DISPLAY_IDENTIFIER C_MAF_DIAGCPS_2 FORMAT "%7.2" /end CHARACTERISTIC
/begin CHARACTERISTIC c_map_diagcps_2 "Threshold for map difference in step 2 - functional check CPS" VALUE 0xa080be58 _REC_VAL_20_u2 5434. _CNV_A_R_LINEAR_____27_CM 0. 5434. DISPLAY_IDENTIFIER C_MAP_DIAGCPS_2 FORMAT "%7.2" /end CHARACTERISTIC
/begin MEASUREMENT state_diagcps "State - Functional check CPS" UBYTE _CNV_S_6_STATE_DIAG_166_CM 1 100. 0. 5. DISPLAY_IDENTIFIER STATE_DIAGCPS ECU_ADDRESS 0xd0008604 /end MEASUREMENT
/begin MEASUREMENT state_diagcps_rbm "State - Functional check CPS" UBYTE _CNV_S_6_STATE_DIAG_166_CM 1 100. 0. 5. DISPLAY_IDENTIFIER STATE_DIAGCPS_RBM ECU_ADDRESS 0xd0008605 /end MEASUREMENT
/begin MEASUREMENT sum_map_diag_diagcps "Number of diagnoses results MAP - functional check CPS" UBYTE _CNV_A_R_LINEAR_____163_CM 1 100. 0. 255. DISPLAY_IDENTIFIER SUM_MAP_DIAG_DIAGCPS ECU_ADDRESS 0xd0000c6f FORMAT "%3.0" /end MEASUREMENT
/begin MEASUREMENT sum_n_diag_diagcps_ofs "Number of diagnoses results N within 1 offset - functional check CPS" UBYTE _CNV_A_R_LINEAR_____163_CM 1 100. 0. 255. DISPLAY_IDENTIFIER SUM_N_DIAG_DIAGCPS_OFS ECU_ADDRESS 0xd0000c70 FORMAT "%3.0" /end MEASUREMENT
/begin MEASUREMENT sum_map_diag_diagcps_ofs "Number of diagnoses results MAP - functional check CPS" UBYTE _CNV_A_R_LINEAR_____163_CM 1 100. 0. 255. DISPLAY_IDENTIFIER SUM_MAP_DIAG_DIAGCPS_OFS ECU_ADDRESS 0xd0000c71 FORMAT "%3.0" /end MEASUREMENT
/begin MEASUREMENT sum_maf_diag_diagcps_ofs "Number of diagnoses results MAF - functional check CPS" UBYTE _CNV_A_R_LINEAR_____163_CM 1 100. 0. 255. DISPLAY_IDENTIFIER SUM_MAF_DIAG_DIAGCPS_OFS ECU_ADDRESS 0xd0000c72 FORMAT "%3.0" /end MEASUREMENT
/begin MEASUREMENT t_diagcps_n_map_1 "1st time interval for N-DIF-Diagnosis - Functional check CPS" UBYTE _CNV_A_R_LINEAR_____4_CM 1 100. 0.1 25.5 DISPLAY_IDENTIFIER T_DIAGCPS_N_MAP_1 ECU_ADDRESS 0xd0000c75 FORMAT "%4.1" /end MEASUREMENT
/begin MEASUREMENT t_diagcps_n_map_2 "2nd time interval for N-DIF-Diagnosis - Functional check CPS" UBYTE _CNV_A_R_LINEAR_____4_CM 1 100. 0.1 25.5 DISPLAY_IDENTIFIER T_DIAGCPS_N_MAP_2 ECU_ADDRESS 0xd0000c76 FORMAT "%4.1" /end MEASUREMENT
/begin MEASUREMENT t_diagcps_n_map_3 "3rd time interval for N-DIF-Diagnosis - Functional check CPS" UBYTE _CNV_A_R_LINEAR_____4_CM 1 100. 0.1 25.5 DISPLAY_IDENTIFIER T_DIAGCPS_N_MAP_3 ECU_ADDRESS 0xd0000c77 FORMAT "%4.1" /end MEASUREMENT
/begin CHARACTERISTIC c_t_diagcps_n_map_1 "Time interval after expiry of which the cycle of step 2 is repeated - Functional check CPS" VALUE 0xa080c164 _REC_VAL_20_u1 25.4 _CNV_A_R_LINEAR_____4_CM 0.1 25.5 DISPLAY_IDENTIFIER C_T_DIAGCPS_N_MAP_1 FORMAT "%4.1" /end CHARACTERISTIC
/begin CHARACTERISTIC c_t_diagcps_n_map_2 "Time as from setting C_FLOW_SP_DIAGCPS_N - Functional check CPS" VALUE 0xa080c165 _REC_VAL_20_u1 25.4 _CNV_A_R_LINEAR_____4_CM 0.1 25.5 DISPLAY_IDENTIFIER C_T_DIAGCPS_N_MAP_2 FORMAT "%4.1" /end CHARACTERISTIC
/begin CHARACTERISTIC c_t_diagcps_n_map_3 "Time for increasing FLOW_SP - Functional check CPS" VALUE 0xa080c166 _REC_VAL_20_u1 25.4 _CNV_A_R_LINEAR_____4_CM 0.1 25.5 DISPLAY_IDENTIFIER C_T_DIAGCPS_N_MAP_3 FORMAT "%4.1" /end CHARACTERISTIC
/begin CHARACTERISTIC c_t_diagcps_n_map_4 "Time for evaluation of N,MAP reaction - functional CPS" VALUE 0xa080c167 _REC_VAL_20_u1 25.4 _CNV_A_R_LINEAR_____4_CM 0.1 25.5 DISPLAY_IDENTIFIER C_T_DIAGCPS_N_MAP_4 FORMAT "%4.1" /end CHARACTERISTIC
/begin CHARACTERISTIC lc_diagcps_map_act_opm_2 "MAP monitoring activated during STEP_2 - throttled mode" VALUE 0xa080c54d _REC_VAL_20_u1 1. _CNV_A_R_LINEAR_____0_CM 0. 1. DISPLAY_IDENTIFIER LC_DIAGCPS_MAP_ACT_OPM_2 FORMAT "%2.0" /end CHARACTERISTIC
/begin CHARACTERISTIC c_n_diagcps_2 "Threshold for engine speed increase in step 2 - Functional check CPS" VALUE 0xa080bf18 _REC_VAL_20_u2 8159. _CNV_A_R_LINEAR_____14_CM 1. 8160. DISPLAY_IDENTIFIER C_N_DIAGCPS_2 FORMAT "%4.0" /end CHARACTERISTIC
/begin CHARACTERISTIC c_sum_n_diag_diagcps_ofs "Counter for n-events per offset during STEP_2- functional check CPS" VALUE 0xa080c105 _REC_VAL_20_u1 255. _CNV_A_R_LINEAR_____163_CM 0. 255. DISPLAY_IDENTIFIER C_SUM_N_DIAG_DIAGCPS_OFS FORMAT "%3.0" /end CHARACTERISTIC
/begin CHARACTERISTIC c_sum_map_diag_diagcps_ofs "Counter for MAP-events per offset during STEP_2- functional check CPS" VALUE 0xa080c104 _REC_VAL_20_u1 255. _CNV_A_R_LINEAR_____163_CM 0. 255. DISPLAY_IDENTIFIER C_SUM_MAP_DIAG_DIAGCPS_OFS FORMAT "%3.0" /end CHARACTERISTIC
/begin CHARACTERISTIC c_sum_maf_diag_diagcps_ofs "Counter for MAF-events per offset during STEP_2 - functional check CPS" VALUE 0xa080c103 _REC_VAL_20_u1 255. _CNV_A_R_LINEAR_____163_CM 0. 255. DISPLAY_IDENTIFIER C_SUM_MAF_DIAG_DIAGCPS_OFS FORMAT "%3.0" /end CHARACTERISTIC
/begin MEASUREMENT lv_maf_diagcps_1 "Auxiliary bit for step 3 - Functional check CPS" UBYTE _CNV_S_2_RANGE__0___1_CM 1 100. 0. 1. DISPLAY_IDENTIFIER LV_MAF_DIAGCPS_1 ECU_ADDRESS 0xd0000c7e BIT_MASK 0x1 /end MEASUREMENT
/begin MEASUREMENT lv_opm_av_diagcps_p_thr "LV indicating change of operation mode within OPM_AV = 1" UBYTE _CNV_S_2_RANGE__0___1_CM 1 100. 0. 1. DISPLAY_IDENTIFIER LV_OPM_AV_DIAGCPS_P_THR ECU_ADDRESS 0xd0000c88 BIT_MASK 0x1 /end MEASUREMENT
/begin CHARACTERISTIC c_map_dip_sp_mmv_diagcps "Threshold for map difference in step - 2- functional check CPS" VALUE 0xa080be5a _REC_VAL_20_s2 2559.9609375 _CNV_A_R_LINEAR_____167_CM -1280. 1279.9609375 DISPLAY_IDENTIFIER C_MAP_DIP_SP_MMV_DIAGCPS FORMAT "%8.2" /end CHARACTERISTIC
/begin MEASUREMENT t_cl_mmv_diagcps "Timer to count how long the CL_MMV has been above the threshold in Step 1 for ENG_MODE_0" UBYTE _CNV_A_R_LINEAR_____4_CM 1 100. 0. 25.5 DISPLAY_IDENTIFIER T_CL_MMV_DIAGCPS ECU_ADDRESS 0xd0008609 FORMAT "%4.1" /end MEASUREMENT
/begin MEASUREMENT t_cl_mmv_diagcps_2 "Timer to count how long the CL_MMV has been above the threshold in Step 1" UBYTE _CNV_A_R_LINEAR_____4_CM 1 100. 0. 25.5 DISPLAY_IDENTIFIER T_CL_MMV_DIAGCPS_2 ECU_ADDRESS 0xd000860a FORMAT "%4.1" /end MEASUREMENT
/begin CHARACTERISTIC c_t_cl_mmv_diagcps "Timer to count how long the CL_MMV has been above the threshold in Step 1 for ENG_MODE_0" VALUE 0xa080c142 _REC_VAL_20_u1 25.5 _CNV_A_R_LINEAR_____4_CM 0. 25.5 DISPLAY_IDENTIFIER C_T_CL_MMV_DIAGCPS FORMAT "%4.1" /end CHARACTERISTIC
/begin CHARACTERISTIC c_t_cl_mmv_diagcps_2 "Timer to count how long the CL_MMV has been above the threshold in Step 1" VALUE 0xa080c143 _REC_VAL_20_u1 25.5 _CNV_A_R_LINEAR_____4_CM 0. 25.5 DISPLAY_IDENTIFIER C_T_CL_MMV_DIAGCPS_2 FORMAT "%4.1" /end CHARACTERISTIC
/begin CHARACTERISTIC c_n_ofs_acc_dri_min "idle speed setpoint offset minimum threshold at LV_ACIN = 1 and LV_DRI = 1" VALUE 0xa080bfa1 _REC_VAL_20_s1 510. _CNV_A_R_LINEAR_____233_CM -256. 254. DISPLAY_IDENTIFIER C_N_OFS_ACC_DRI_MIN FORMAT "%4.0" /end CHARACTERISTIC
/begin CHARACTERISTIC c_n_ofs_dri_max "idle speed setpoint offset maximum threshold at LV_ACIN = 0 and LV_DRI = 1" VALUE 0xa080bfa4 _REC_VAL_20_s1 510. _CNV_A_R_LINEAR_____233_CM -256. 254. DISPLAY_IDENTIFIER C_N_OFS_DRI_MAX FORMAT "%4.0" /end CHARACTERISTIC
/begin CHARACTERISTIC c_n_ofs_dri_min "idle speed setpoint offset minimum threshold at LV_ACIN = 0 and LV_DRI = 1" VALUE 0xa080bfa5 _REC_VAL_20_s1 510. _CNV_A_R_LINEAR_____233_CM -256. 254. DISPLAY_IDENTIFIER C_N_OFS_DRI_MIN FORMAT "%4.0" /end CHARACTERISTIC
/begin CHARACTERISTIC c_n_ofs_max "idle speed setpoint offset maximum threshold at LV_ACIN = 0 and LV_DRI = 0" VALUE 0xa080bfa6 _REC_VAL_20_s1 510. _CNV_A_R_LINEAR_____233_CM -256. 254. DISPLAY_IDENTIFIER C_N_OFS_MAX FORMAT "%4.0" /end CHARACTERISTIC
/begin CHARACTERISTIC c_n_ofs_min "idle speed setpoint offset minimum threshold at LV_ACIN = 0 and LV_DRI = 0" VALUE 0xa080bfa7 _REC_VAL_20_s1 510. _CNV_A_R_LINEAR_____233_CM -256. 254. DISPLAY_IDENTIFIER C_N_OFS_MIN FORMAT "%4.0" /end CHARACTERISTIC
/begin CHARACTERISTIC c_n_ofs_acc_max "idle speed setpoint offset maximum threshold at LV_ACIN = 1 and LV_DRI = 0" VALUE 0xa080bfa2 _REC_VAL_20_s1 510. _CNV_A_R_LINEAR_____233_CM -256. 254. DISPLAY_IDENTIFIER C_N_OFS_ACC_MAX FORMAT "%4.0" /end CHARACTERISTIC
/begin CHARACTERISTIC c_n_ofs_acc_min "idle speed setpoint offset minimum threshold at LV_ACIN = 1 and LV_DRI = 0" VALUE 0xa080bfa3 _REC_VAL_20_s1 510. _CNV_A_R_LINEAR_____233_CM -256. 254. DISPLAY_IDENTIFIER C_N_OFS_ACC_MIN FORMAT "%4.0" /end CHARACTERISTIC
/begin CHARACTERISTIC c_n_ofs_vb_max "idle speed setpoint offset maximum threshold at battery charging is active" VALUE 0xa080bfa8 _REC_VAL_20_s1 510. _CNV_A_R_LINEAR_____233_CM -256. 254. DISPLAY_IDENTIFIER C_N_OFS_VB_MAX FORMAT "%4.0" /end CHARACTERISTIC
/begin MEASUREMENT n_kwp_ofs_acc "idle speed setpoint offset at LV_ACIN = 1 and LV_DRI = 0" SBYTE _CNV_A_R_LINEAR_____233_CM 1 100. -256. 254. DISPLAY_IDENTIFIER N_KWP_OFS_ACC ECU_ADDRESS 0xd0008f1c FORMAT "%4.0" /end MEASUREMENT
/begin MEASUREMENT n_kwp_ofs "idle speed setpoint offset at LV_ACIN = 0 and LV_DRI = 0" SBYTE _CNV_A_R_LINEAR_____233_CM 1 100. -256. 254. DISPLAY_IDENTIFIER N_KWP_OFS ECU_ADDRESS 0xd0008f1b FORMAT "%4.0" /end MEASUREMENT
/begin MEASUREMENT n_kwp_ofs_vb_nvmy "idle speed setpoint offset at battery charging is active stored in non volatile memory" SBYTE _CNV_A_R_LINEAR_____233_CM 1 100. -256. 254. DISPLAY_IDENTIFIER N_KWP_OFS_VB_NVMY ECU_ADDRESS 0xd0008f18 FORMAT "%4.0" /end MEASUREMENT
/begin MEASUREMENT n_kwp_ofs_acc_nvmy "idle speed setpoint offset at LV_ACIN = 1 and LV_DRI = 0 stored in non volatile memory" SBYTE _CNV_A_R_LINEAR_____233_CM 1 100. -256. 254. DISPLAY_IDENTIFIER N_KWP_OFS_ACC_NVMY ECU_ADDRESS 0xd0008f17 FORMAT "%4.0" /end MEASUREMENT
/begin MEASUREMENT n_kwp_ofs_nvmy "idle speed setpoint offset at LV_ACIN = 0 and LV_DRI = 0 stored in non volatile memory" SBYTE _CNV_A_R_LINEAR_____233_CM 1 100. -256. 254. DISPLAY_IDENTIFIER N_KWP_OFS_NVMY ECU_ADDRESS 0xd0008f16 FORMAT "%4.0" /end MEASUREMENT
/begin MEASUREMENT n_kwp_ofs_dri_nvmy "idle speed setpoint offset at LV_ACIN = 0 and LV_DRI = 1 stored in non volatile memory" SBYTE _CNV_A_R_LINEAR_____233_CM 1 100. -256. 254. DISPLAY_IDENTIFIER N_KWP_OFS_DRI_NVMY ECU_ADDRESS 0xd0008f15 FORMAT "%4.0" /end MEASUREMENT
/begin MEASUREMENT n_kwp_ofs_acc_dri_nvmy "idle speed setpoint offset at LV_ACIN = 1 and LV_DRI = 1 stored in non volatile memory" SBYTE _CNV_A_R_LINEAR_____233_CM 1 100. -256. 254. DISPLAY_IDENTIFIER N_KWP_OFS_ACC_DRI_NVMY ECU_ADDRESS 0xd0008f14 FORMAT "%4.0" /end MEASUREMENT
/begin CHARACTERISTIC c_n_ofs_vb_min "idle speed setpoint offset minimum threshold at battery charging is active" VALUE 0xa080bfa9 _REC_VAL_20_s1 510. _CNV_A_R_LINEAR_____233_CM -256. 254. DISPLAY_IDENTIFIER C_N_OFS_VB_MIN FORMAT "%4.0" /end CHARACTERISTIC
/begin CHARACTERISTIC c_tco_min_n_ofs_kwp "minimum TCO threshold for idle speed setpoint offset by tester" VALUE 0xa080c2d9 _REC_VAL_20_u1 190.5 _CNV_A_R_LINEAR_____17_CM -48. 142.5 DISPLAY_IDENTIFIER C_TCO_MIN_N_OFS_KWP FORMAT "%5.1" /end CHARACTERISTIC
/begin CHARACTERISTIC lc_n_ofs_kwp_disable "disable bit for idle speed setpoint offset by tester" VALUE 0xa080c5b7 _REC_VAL_20_u1 1. _CNV_A_R_LINEAR_____0_CM 0. 1. DISPLAY_IDENTIFIER LC_N_OFS_KWP_DISABLE FORMAT "%2.0" /end CHARACTERISTIC
/begin CHARACTERISTIC c_cha_cdn_bat_kwp_min "minimum threshold for active battery charging due to enable conditions of idle speed offset by tester" VALUE 0xa080baa3 _REC_VAL_20_u1 127. _CNV_A_R_LINEAR_____234_CM 0. 127. DISPLAY_IDENTIFIER C_CHA_CDN_BAT_KWP_MIN FORMAT "%5.1" /end CHARACTERISTIC
/begin CHARACTERISTIC c_n_ofs_acc_dri_max "idle speed setpoint offset maximum threshold at LV_ACIN = 1 and LV_DRI = 1" VALUE 0xa080bfa0 _REC_VAL_20_s1 510. _CNV_A_R_LINEAR_____233_CM -256. 254. DISPLAY_IDENTIFIER C_N_OFS_ACC_DRI_MAX FORMAT "%4.0" /end CHARACTERISTIC
/begin MEASUREMENT lv_kwp_ena "logical variable for idle speed setpoint offset by tester enabled" UBYTE _CNV_S_2_RANGE__0___1_CM 1 100. 0. 1. DISPLAY_IDENTIFIER LV_KWP_ENA ECU_ADDRESS 0xd0008f1f BIT_MASK 0x1 /end MEASUREMENT
/begin MEASUREMENT n_sp_ofs_kwp "idle speed setpoint offset by tester" SBYTE _CNV_A_R_LINEAR_____233_CM 1 100. -256. 254. DISPLAY_IDENTIFIER N_SP_OFS_KWP ECU_ADDRESS 0xd0008f1e FORMAT "%4.0" /end MEASUREMENT
/begin MEASUREMENT n_kwp_ofs_acc_dri "idle speed setpoint offset at LV_ACIN = 1 and LV_DRI = 1" SBYTE _CNV_A_R_LINEAR_____233_CM 1 100. -256. 254. DISPLAY_IDENTIFIER N_KWP_OFS_ACC_DRI ECU_ADDRESS 0xd0008f19 FORMAT "%4.0" /end MEASUREMENT
/begin MEASUREMENT n_kwp_ofs_dri "idle speed setpoint offset at LV_ACIN = 0 and LV_DRI = 1" SBYTE _CNV_A_R_LINEAR_____233_CM 1 100. -256. 254. DISPLAY_IDENTIFIER N_KWP_OFS_DRI ECU_ADDRESS 0xd0008f1a FORMAT "%4.0" /end MEASUREMENT
/begin MEASUREMENT n_kwp_ofs_vb "idle speed setpoint offset at battery charging is active" SBYTE _CNV_A_R_LINEAR_____233_CM 1 100. -256. 254. DISPLAY_IDENTIFIER N_KWP_OFS_VB ECU_ADDRESS 0xd0008f1d FORMAT "%4.0" /end MEASUREMENT
/begin MEASUREMENT lv_act_n_sp_is_bas_ext_adj "switch off idle speed uplift - function active = 1" UBYTE _CNV_S_2_RANGE__0___1_CM 1 100. 0. 1. DISPLAY_IDENTIFIER LV_ACT_N_SP_IS_BAS_EXT_ADJ ECU_ADDRESS 0xd0008f20 BIT_MASK 0x1 /end MEASUREMENT
/begin CHARACTERISTIC c_saf_diag_max "Error detection threshold for maximum deviation" VALUE 0xa080c0b0 _REC_VAL_20_u2 255. _CNV_A_R_LINEAR_____242_CM 0. 255. DISPLAY_IDENTIFIER C_SAF_DIAG_MAX FORMAT "%7.3" /end CHARACTERISTIC
/begin CHARACTERISTIC c_saf_diag_min "Error detection threshold for minimum deviation" VALUE 0xa080c0b2 _REC_VAL_20_u2 255. _CNV_A_R_LINEAR_____242_CM 0. 255. DISPLAY_IDENTIFIER C_SAF_DIAG_MIN FORMAT "%7.3" /end CHARACTERISTIC
/begin MEASUREMENT lv_err_dmtlm "error DMTL module" UBYTE _CNV_S_2_RANGE__0___1_CM 1 100. 0. 1. DISPLAY_IDENTIFIER LV_ERR_DMTLM ECU_ADDRESS 0xd0007f81 BIT_MASK 0x1 /end MEASUREMENT
/begin MEASUREMENT fac_fco_kwp "correction factor for consumption" SBYTE _CNV_A_R_LINEAR_____422_CM 1 100. -0.128 0.127 DISPLAY_IDENTIFIER FAC_FCO_KWP ECU_ADDRESS 0xd0007ece FORMAT "%5.3" /end MEASUREMENT
/begin MEASUREMENT eol_ram[0] "State variable for EOL - CPS_CHECK" UBYTE _CNV_S_10_STATE_EOL__423_CM 1 100. 0. 9. DISPLAY_IDENTIFIER STATE_EOL_KWP_CPS ECU_ADDRESS 0xd0008fec /end MEASUREMENT
/begin MEASUREMENT eol_ram[1] "State variable for EOL - DMTL" UBYTE _CNV_S_10_STATE_EOL__423_CM 1 100. 0. 9. DISPLAY_IDENTIFIER STATE_EOL_KWP_DMTL ECU_ADDRESS 0xd0008fed /end MEASUREMENT
/begin MEASUREMENT eol_ram[2] "State variable for EOL - lambda sensors wrong wired/confused" UBYTE _CNV_S_10_STATE_EOL__423_CM 1 100. 0. 9. DISPLAY_IDENTIFIER STATE_EOL_KWP_VLS ECU_ADDRESS 0xd0008fee /end MEASUREMENT
/begin MEASUREMENT eol_ram[3] "State variable for EOL - displace N_SP_IS" UBYTE _CNV_S_10_STATE_EOL__423_CM 1 100. 0. 9. DISPLAY_IDENTIFIER STATE_EOL_KWP_N_SP_IS ECU_ADDRESS 0xd0008fef /end MEASUREMENT
/begin MEASUREMENT eol_ram[4] "State variable for EOL - SA diagnosis" UBYTE _CNV_S_10_STATE_EOL__423_CM 1 100. 0. 9. DISPLAY_IDENTIFIER STATE_EOL_KWP_SA ECU_ADDRESS 0xd0008ff0 /end MEASUREMENT
/begin MEASUREMENT eol_ram[5] "State variable for EOL - VVL adaptation" UBYTE _CNV_S_10_STATE_EOL__423_CM 1 100. 0. 9. DISPLAY_IDENTIFIER STATE_EOL_KWP_VVL_AD ECU_ADDRESS 0xd0008ff1 /end MEASUREMENT
/begin MEASUREMENT eol_ram[6] "State variable for EOL - ECRAS system test" UBYTE _CNV_S_10_STATE_EOL__423_CM 1 100. 0. 9. DISPLAY_IDENTIFIER STATE_EOL_KWP_ECRAS ECU_ADDRESS 0xd0008ff2 /end MEASUREMENT
/begin MEASUREMENT n_sp_is_ext_adj "idle speed setpoint from the tester" UWORD _CNV_A_R_LINEAR_____14_CM 1 100. 0. 8160. DISPLAY_IDENTIFIER N_SP_IS_EXT_ADJ ECU_ADDRESS 0xd000ac48 FORMAT "%4.0" /end MEASUREMENT
/begin MEASUREMENT lv_act_n_sp_is_ext_adj "LV for displace N_SP_IS" UBYTE _CNV_S_2_RANGE__0___1_CM 1 100. 0. 1. DISPLAY_IDENTIFIER LV_ACT_N_SP_IS_EXT_ADJ ECU_ADDRESS 0xd0008ff1 BIT_MASK 0x1 /end MEASUREMENT
/begin MEASUREMENT lv_eol_cps "LV for the end of line test CPS" UBYTE _CNV_S_2_RANGE__0___1_CM 1 100. 0. 1. DISPLAY_IDENTIFIER LV_EOL_CPS ECU_ADDRESS 0xd0008ff2 BIT_MASK 0x1 /end MEASUREMENT
/begin MEASUREMENT lv_act_vls_eol_ext_adj "Activation bit for lambda sensor EOL diagnos confused wired" UBYTE _CNV_S_2_RANGE__0___1_CM 1 100. 0. 1. DISPLAY_IDENTIFIER LV_ACT_VLS_EOL_EXT_ADJ ECU_ADDRESS 0xd0008ff3 BIT_MASK 0x1 /end MEASUREMENT
/begin MEASUREMENT lv_pow_mng_mes_mod "set default values PM for BN-SS - set default vaule=01h" UBYTE _CNV_S_2_RANGE__0___1_CM 1 100. 0. 1. DISPLAY_IDENTIFIER LV_POW_MNG_MES_MOD ECU_ADDRESS 0xd0008ff6 BIT_MASK 0x1 /end MEASUREMENT
/begin MEASUREMENT lv_pow_mng_his_rst "conditions for function request  parking power (for MSx70)" UBYTE _CNV_S_2_RANGE__0___1_CM 1 100. 0. 1. DISPLAY_IDENTIFIER LV_POW_MNG_HIS_RST ECU_ADDRESS 0xd0007ecd BIT_MASK 0x1 /end MEASUREMENT
/begin MEASUREMENT lv_pow_mng_bat_chg "condition for  function requested of powermanagement register" UBYTE _CNV_S_2_RANGE__0___1_CM 1 100. 0. 1. DISPLAY_IDENTIFIER LV_POW_MNG_BAT_CHG ECU_ADDRESS 0xd0007ecc BIT_MASK 0x1 /end MEASUREMENT
/begin CHARACTERISTIC id_idx_act_ds_conf "" MAP 0xa0813dcc _REC_MAP_20_u2_u1_u1 65535. _CNV_A_R_LINEAR_____0_CM 0. 65535. DISPLAY_IDENTIFIER ID_IDX_ACT_DS_CONF FORMAT "%5.0"
 /begin AXIS_DESCR COM_AXIS online_dummy _CNV_A_R_LINEAR_____0_CM 99 0. 255. FORMAT "%3.0" AXIS_PTS_REF ldp_idx_ds_id_idx_act_ds_conf /end AXIS_DESCR
 /begin AXIS_DESCR COM_AXIS online_dummy _CNV_A_R_LINEAR_____0_CM 4 0. 255. FORMAT "%3.0" AXIS_PTS_REF ldp_idx_envd_id_idx_act_ds_conf /end AXIS_DESCR
/end CHARACTERISTIC
/begin AXIS_PTS ldp_idx_envd_id_idx_act_ds_conf "" 0xa08087ba online_dummy _REC_AXS_20_u1 255. _CNV_A_R_LINEAR_____0_CM 4 0. 255. FORMAT "%3.0" /end AXIS_PTS
/begin AXIS_PTS ldp_idx_ds_id_idx_act_ds_conf "" 0xa08138c4 online_dummy _REC_AXS_20_u1 255. _CNV_A_R_LINEAR_____0_CM 99 0. 255. FORMAT "%3.0" /end AXIS_PTS
/begin CHARACTERISTIC c_n_max_kwp "max engine speed for accepting a KWP2000(*) service" VALUE 0xa080bf8c _REC_VAL_20_u2 8160. _CNV_A_R_LINEAR_____14_CM 0. 8160. DISPLAY_IDENTIFIER C_N_MAX_KWP FORMAT "%4.0" /end CHARACTERISTIC
/begin CHARACTERISTIC c_n_min_kwp "min engine speed for accepting a KWP2000(*) service" VALUE 0xa080bf9c _REC_VAL_20_u2 8160. _CNV_A_R_LINEAR_____14_CM 0. 8160. DISPLAY_IDENTIFIER C_N_MIN_KWP FORMAT "%4.0" /end CHARACTERISTIC
/begin CHARACTERISTIC c_tco_max_kwp "maximum TCO threshold for activation of external adjustment" VALUE 0xa080c2cb _REC_VAL_20_u1 190.5 _CNV_A_R_LINEAR_____17_CM -48. 142.5 DISPLAY_IDENTIFIER C_TCO_MAX_KWP FORMAT "%5.1" /end CHARACTERISTIC
/begin CHARACTERISTIC c_tco_min_kwp "minimum TCO threshold for activation of external adjustment" VALUE 0xa080c2d7 _REC_VAL_20_u1 190.5 _CNV_A_R_LINEAR_____17_CM -48. 142.5 DISPLAY_IDENTIFIER C_TCO_MIN_KWP FORMAT "%5.1" /end CHARACTERISTIC
/begin CHARACTERISTIC c_vs_max_kwp "maximum vehicle speed for accepting the service" VALUE 0xa080c4d0 _REC_VAL_20_u1 255. _CNV_A_R_LINEAR_____6_CM 0. 255. DISPLAY_IDENTIFIER C_VS_MAX_KWP FORMAT "%3.0" /end CHARACTERISTIC
/begin CHARACTERISTIC c_vb_min_kwp "Battery Voltage" VALUE 0xa080c42d _REC_VAL_20_u1 25.8984375 _CNV_A_R_LINEAR_____272_CM 0. 25.8984375 DISPLAY_IDENTIFIER C_VB_MIN_KWP FORMAT "%9.6" /end CHARACTERISTIC
/begin MEASUREMENT lv_fhw_rst "boolean for reset of wrong used pedal unit" UBYTE _CNV_S_2_RANGE__0___1_CM 1 100. 0. 1. DISPLAY_IDENTIFIER LV_FHW_RST ECU_ADDRESS 0xd0009088 BIT_MASK 0x1 /end MEASUREMENT
/begin MEASUREMENT lv_poil_sp_ext_adj "activation of external adjustment by InputOutputControl" UBYTE _CNV_S_2_RANGE__0___1_CM 1 100. 0. 1. DISPLAY_IDENTIFIER LV_POIL_SP_EXT_ADJ ECU_ADDRESS 0xd0009022 BIT_MASK 0x1 /end MEASUREMENT
/begin MEASUREMENT lv_poil_pwm_ext_adj "activation of external adjustment by InputOutputControl" UBYTE _CNV_S_2_RANGE__0___1_CM 1 100. 0. 1. DISPLAY_IDENTIFIER LV_POIL_PWM_EXT_ADJ ECU_ADDRESS 0xd0009020 BIT_MASK 0x1 /end MEASUREMENT
/begin MEASUREMENT lv_rly_crcv_heat_ext_adj "Request of tester for external adjustment of crankcase ventilation heater relay" UBYTE _CNV_S_2_RANGE__0___1_CM 1 100. 0. 1. DISPLAY_IDENTIFIER LV_RLY_CRCV_HEAT_EXT_ADJ ECU_ADDRESS 0xd000901e BIT_MASK 0x1 /end MEASUREMENT
/begin MEASUREMENT lv_act_rly_crcv_heat_ext_adj "Command from tester for switching crankcase ventilation heater relay (0 = off, 1 = on)" UBYTE _CNV_S_2_RANGE__0___1_CM 1 100. 0. 1. DISPLAY_IDENTIFIER LV_ACT_RLY_CRCV_HEAT_EXT_ADJ ECU_ADDRESS 0xd000901f BIT_MASK 0x1 /end MEASUREMENT
/begin MEASUREMENT lv_rly_main_ext_adj "Request of tester for main relay adjustment" UBYTE _CNV_S_2_RANGE__0___1_CM 1 100. 0. 1. DISPLAY_IDENTIFIER LV_RLY_MAIN_EXT_ADJ ECU_ADDRESS 0xd000900c BIT_MASK 0x1 /end MEASUREMENT
/begin MEASUREMENT lv_act_rly_main_ext_adj "Command from tester for switching main relay (0 = off, 1 = on)" UBYTE _CNV_S_2_RANGE__0___1_CM 1 100. 0. 1. DISPLAY_IDENTIFIER LV_ACT_RLY_MAIN_EXT_ADJ ECU_ADDRESS 0xd000900d BIT_MASK 0x1 /end MEASUREMENT
/begin MEASUREMENT lv_tps_ext_adj "Logical variable for throttle actuator test, set if request from service tool is accepted" UBYTE _CNV_S_2_RANGE__0___1_CM 1 100. 0. 1. DISPLAY_IDENTIFIER LV_TPS_EXT_ADJ ECU_ADDRESS 0xd000901c BIT_MASK 0x1 /end MEASUREMENT
/begin MEASUREMENT lv_v_alter_sp_ext_adj "activation of external adjustment by InputOutputControl" UBYTE _CNV_S_2_RANGE__0___1_CM 1 100. 0. 1. DISPLAY_IDENTIFIER LV_V_ALTER_SP_EXT_ADJ ECU_ADDRESS 0xd000901d BIT_MASK 0x1 /end MEASUREMENT
/begin MEASUREMENT v_alter_sp_ext_adj "adjustment value for alternator voltage setpoint" UWORD _CNV_A_R_LINEAR_____425_CM 1 100. 0. 6553.5 DISPLAY_IDENTIFIER V_ALTER_SP_EXT_ADJ ECU_ADDRESS 0xd000ac50 FORMAT "%6.1" /end MEASUREMENT
/begin MEASUREMENT lv_n_rel_cwp_sp_ext_adj "activation of external adjustment by InputOutputControl" UBYTE _CNV_S_2_RANGE__0___1_CM 1 100. 0. 1. DISPLAY_IDENTIFIER LV_N_REL_CWP_SP_EXT_ADJ ECU_ADDRESS 0xd0009023 BIT_MASK 0x1 /end MEASUREMENT
/begin MEASUREMENT n_rel_cwp_sp_ext_adj "adjustment value for speed of electrical water pump" UBYTE _CNV_A_R_LINEAR_____5_CM 1 100. 0. 99.609375 DISPLAY_IDENTIFIER N_REL_CWP_SP_EXT_ADJ ECU_ADDRESS 0xd0009024 FORMAT "%5.1" /end MEASUREMENT
/begin MEASUREMENT lv_ef_ext_adj "Activation of external adjustment by InputOutputControl" UBYTE _CNV_S_2_RANGE__0___1_CM 1 100. 0. 1. DISPLAY_IDENTIFIER LV_EF_EXT_ADJ ECU_ADDRESS 0xd0009025 BIT_MASK 0x1 /end MEASUREMENT
/begin MEASUREMENT lv_act_ef_ext_adj "adjustment value for Exhaust Flap 0=off, 1=on" UBYTE _CNV_S_2_RANGE__0___1_CM 1 100. 0. 1. DISPLAY_IDENTIFIER LV_ACT_EF_EXT_ADJ ECU_ADDRESS 0xd0009026 BIT_MASK 0x1 /end MEASUREMENT
/begin MEASUREMENT lv_sof_ext_adj "activation of external adjustment by InputOutputControl" UBYTE _CNV_S_2_RANGE__0___1_CM 1 100. 0. 1. DISPLAY_IDENTIFIER LV_SOF_EXT_ADJ ECU_ADDRESS 0xd0009027 BIT_MASK 0x1 /end MEASUREMENT
/begin MEASUREMENT lv_act_sof_ext_adj "adjustment value for sound flap 0 = off, 1 = on" UBYTE _CNV_S_2_RANGE__0___1_CM 1 100. 0. 1. DISPLAY_IDENTIFIER LV_ACT_SOF_EXT_ADJ ECU_ADDRESS 0xd0009028 BIT_MASK 0x1 /end MEASUREMENT
/begin MEASUREMENT lv_ecras_up_ext_adj "Bit indicating that external adjustment of ECRAS_UP is active" UBYTE _CNV_S_2_RANGE__0___1_CM 1 100. 0. 1. DISPLAY_IDENTIFIER LV_ECRAS_UP_EXT_ADJ ECU_ADDRESS 0xd0009029 BIT_MASK 0x1 /end MEASUREMENT
/begin MEASUREMENT lv_act_ecras_up_ext_adj "Bit used to determine ECRASPWM by external adjustment" UBYTE _CNV_S_2_RANGE__0___1_CM 1 100. 0. 1. DISPLAY_IDENTIFIER LV_ACT_ECRAS_UP_EXT_ADJ ECU_ADDRESS 0xd000902a BIT_MASK 0x1 /end MEASUREMENT
/begin MEASUREMENT lv_rly_st_ext_adj "activation of external adjustment by InputOutputControl" UBYTE _CNV_S_2_RANGE__0___1_CM 1 100. 0. 1. DISPLAY_IDENTIFIER LV_RLY_ST_EXT_ADJ ECU_ADDRESS 0xd000902d BIT_MASK 0x1 /end MEASUREMENT
/begin MEASUREMENT lv_act_rly_st_ext_adj "adjustment value for starter relay 0 = off, 1 = on" UBYTE _CNV_S_2_RANGE__0___1_CM 1 100. 0. 1. DISPLAY_IDENTIFIER LV_ACT_RLY_ST_EXT_ADJ ECU_ADDRESS 0xd000902e BIT_MASK 0x1 /end MEASUREMENT
/begin MEASUREMENT lv_accout_rly_ext_adj "activation of external adjustment by InputOutputControl" UBYTE _CNV_S_2_RANGE__0___1_CM 1 100. 0. 1. DISPLAY_IDENTIFIER LV_ACCOUT_RLY_EXT_ADJ ECU_ADDRESS 0xd000902f BIT_MASK 0x1 /end MEASUREMENT
/begin MEASUREMENT lv_act_accout_rly_ext_adj "adjustment value for ACC-Relay  0=off, 1=on" UBYTE _CNV_S_2_RANGE__0___1_CM 1 100. 0. 1. DISPLAY_IDENTIFIER LV_ACT_ACCOUT_RLY_EXT_ADJ ECU_ADDRESS 0xd0009030 BIT_MASK 0x1 /end MEASUREMENT
/begin MEASUREMENT lv_ebox_cfa_ext_adj "activation of external adjustment by InputOutputControl" UBYTE _CNV_S_2_RANGE__0___1_CM 1 100. 0. 1. DISPLAY_IDENTIFIER LV_EBOX_CFA_EXT_ADJ ECU_ADDRESS 0xd0009031 BIT_MASK 0x1 /end MEASUREMENT
/begin MEASUREMENT lv_act_ebox_cfa_ext_adj "adjustment value for ebox cooling fan  0 = off, 1 = on" UBYTE _CNV_S_2_RANGE__0___1_CM 1 100. 0. 1. DISPLAY_IDENTIFIER LV_ACT_EBOX_CFA_EXT_ADJ ECU_ADDRESS 0xd0009032 BIT_MASK 0x1 /end MEASUREMENT
/begin MEASUREMENT lv_ectpwm_ext_adj "activation of  the external adjustment by InputOutputControl" UBYTE _CNV_S_2_RANGE__0___1_CM 1 100. 0. 1. DISPLAY_IDENTIFIER LV_ECTPWM_EXT_ADJ ECU_ADDRESS 0xd0009033 BIT_MASK 0x1 /end MEASUREMENT
/begin MEASUREMENT ectpwm_ext_adj "PWM output signal for the electronic controlled thermostat in case of external adjustment" UBYTE _CNV_A_R_LINEAR_____5_CM 1 100. 0. 99.609375 DISPLAY_IDENTIFIER ECTPWM_EXT_ADJ ECU_ADDRESS 0xd0009034 FORMAT "%5.1" /end MEASUREMENT
/begin MEASUREMENT lv_sav_ext_adj "activation of external adjustment by InputOutputControl" UBYTE _CNV_S_2_RANGE__0___1_CM 1 100. 0. 1. DISPLAY_IDENTIFIER LV_SAV_EXT_ADJ ECU_ADDRESS 0xd0009035 BIT_MASK 0x1 /end MEASUREMENT
/begin MEASUREMENT lv_act_sav_ext_adj "adjustment value for SAV  0 = off, 1 = on" UBYTE _CNV_S_2_RANGE__0___1_CM 1 100. 0. 1. DISPLAY_IDENTIFIER LV_ACT_SAV_EXT_ADJ ECU_ADDRESS 0xd0009036 BIT_MASK 0x1 /end MEASUREMENT
/begin MEASUREMENT lv_sap_ext_adj "activation of external adjustment by InputOutputControl" UBYTE _CNV_S_2_RANGE__0___1_CM 1 100. 0. 1. DISPLAY_IDENTIFIER LV_SAP_EXT_ADJ ECU_ADDRESS 0xd0009037 BIT_MASK 0x1 /end MEASUREMENT
/begin MEASUREMENT lv_act_sap_ext_adj "adjustment value for SAP  0 = off, 1 = on" UBYTE _CNV_S_2_RANGE__0___1_CM 1 100. 0. 1. DISPLAY_IDENTIFIER LV_ACT_SAP_EXT_ADJ ECU_ADDRESS 0xd0009038 BIT_MASK 0x1 /end MEASUREMENT
/begin MEASUREMENT lv_dmtl_pump_ext_adj "activation of external adjustment by InputOutputControl" UBYTE _CNV_S_2_RANGE__0___1_CM 1 100. 0. 1. DISPLAY_IDENTIFIER LV_DMTL_PUMP_EXT_ADJ ECU_ADDRESS 0xd0009039 BIT_MASK 0x1 /end MEASUREMENT
/begin MEASUREMENT lv_act_dmtl_pump_ext_adj "adjustment value for DMTL pump  0 = off, 1 = on" UBYTE _CNV_S_2_RANGE__0___1_CM 1 100. 0. 1. DISPLAY_IDENTIFIER LV_ACT_DMTL_PUMP_EXT_ADJ ECU_ADDRESS 0xd000903a BIT_MASK 0x1 /end MEASUREMENT
/begin MEASUREMENT lv_dmtls_ext_adj "activation of external adjustment by InputOutputControl" UBYTE _CNV_S_2_RANGE__0___1_CM 1 100. 0. 1. DISPLAY_IDENTIFIER LV_DMTLS_EXT_ADJ ECU_ADDRESS 0xd000903b BIT_MASK 0x1 /end MEASUREMENT
/begin MEASUREMENT lv_act_dmtls_ext_adj "adjustment value for DMTL solenoid  0 = off, 1 = on" UBYTE _CNV_S_2_RANGE__0___1_CM 1 100. 0. 1. DISPLAY_IDENTIFIER LV_ACT_DMTLS_EXT_ADJ ECU_ADDRESS 0xd000903c BIT_MASK 0x1 /end MEASUREMENT
/begin MEASUREMENT lv_dmtlh_ext_adj "activation of external adjustment by InputOutputControl" UBYTE _CNV_S_2_RANGE__0___1_CM 1 100. 0. 1. DISPLAY_IDENTIFIER LV_DMTLH_EXT_ADJ ECU_ADDRESS 0xd000903d BIT_MASK 0x1 /end MEASUREMENT
/begin MEASUREMENT lv_act_dmtlh_ext_adj "adjustment value for DMTL heater  0 = off, 1 = on" UBYTE _CNV_S_2_RANGE__0___1_CM 1 100. 0. 1. DISPLAY_IDENTIFIER LV_ACT_DMTLH_EXT_ADJ ECU_ADDRESS 0xd000903e BIT_MASK 0x1 /end MEASUREMENT
/begin MEASUREMENT lv_cppwm_ext_adj "activation of external adjustment by InputOutputControl" UBYTE _CNV_S_2_RANGE__0___1_CM 1 100. 0. 1. DISPLAY_IDENTIFIER LV_CPPWM_EXT_ADJ ECU_ADDRESS 0xd000903f BIT_MASK 0x1 /end MEASUREMENT
/begin MEASUREMENT cppwm_ext_adj "adjustment value for canister purge valve" UBYTE _CNV_A_R_LINEAR_____5_CM 1 100. 0. 99.609375 DISPLAY_IDENTIFIER CPPWM_EXT_ADJ ECU_ADDRESS 0xd0009040 FORMAT "%5.1" /end MEASUREMENT
/begin MEASUREMENT lv_lshpwm_up_ext_adj[0] "activation of external adjustment by InputOutputControl" UBYTE _CNV_S_2_RANGE__0___1_CM 1 100. 0. 1. DISPLAY_IDENTIFIER LV_LSHPWM_UP_EXT_ADJ[1] ECU_ADDRESS 0xd0009042 /end MEASUREMENT
/begin MEASUREMENT lv_lshpwm_up_ext_adj[1] "activation of external adjustment by InputOutputControl" UBYTE _CNV_S_2_RANGE__0___1_CM 1 100. 0. 1. DISPLAY_IDENTIFIER LV_LSHPWM_UP_EXT_ADJ[2] ECU_ADDRESS 0xd0009043 /end MEASUREMENT
/begin MEASUREMENT lshpwm_up_ext_adj[0] "adjustment value for Lambda" UBYTE _CNV_A_R_LINEAR_____5_CM 1 100. 0. 99.609375 DISPLAY_IDENTIFIER LSHPWM_UP_EXT_ADJ[1] ECU_ADDRESS 0xd0009044 FORMAT "%5.1" /end MEASUREMENT
/begin MEASUREMENT lshpwm_up_ext_adj[1] "adjustment value for Lambda" UBYTE _CNV_A_R_LINEAR_____5_CM 1 100. 0. 99.609375 DISPLAY_IDENTIFIER LSHPWM_UP_EXT_ADJ[2] ECU_ADDRESS 0xd0009045 FORMAT "%5.1" /end MEASUREMENT
/begin MEASUREMENT lv_lshpwm_down_ext_adj[0] "activation of external adjustment by InputOutputControl" UBYTE _CNV_S_2_RANGE__0___1_CM 1 100. 0. 1. DISPLAY_IDENTIFIER LV_LSHPWM_DOWN_EXT_ADJ[1] ECU_ADDRESS 0xd0009046 /end MEASUREMENT
/begin MEASUREMENT lv_lshpwm_down_ext_adj[1] "activation of external adjustment by InputOutputControl" UBYTE _CNV_S_2_RANGE__0___1_CM 1 100. 0. 1. DISPLAY_IDENTIFIER LV_LSHPWM_DOWN_EXT_ADJ[2] ECU_ADDRESS 0xd0009047 /end MEASUREMENT
/begin MEASUREMENT lshpwm_down_ext_adj[0] "adjustment value for Lambda" UBYTE _CNV_A_R_LINEAR_____5_CM 1 100. 0. 99.609375 DISPLAY_IDENTIFIER LSHPWM_DOWN_EXT_ADJ[1] ECU_ADDRESS 0xd0009048 FORMAT "%5.1" /end MEASUREMENT
/begin MEASUREMENT lshpwm_down_ext_adj[1] "adjustment value for Lambda" UBYTE _CNV_A_R_LINEAR_____5_CM 1 100. 0. 99.609375 DISPLAY_IDENTIFIER LSHPWM_DOWN_EXT_ADJ[2] ECU_ADDRESS 0xd0009049 FORMAT "%5.1" /end MEASUREMENT
/begin MEASUREMENT lv_mil_ext_adj "activation of external adjustment by InputOutputControl" UBYTE _CNV_S_2_RANGE__0___1_CM 1 100. 0. 1. DISPLAY_IDENTIFIER LV_MIL_EXT_ADJ ECU_ADDRESS 0xd0008150 BIT_MASK 0x1 /end MEASUREMENT
/begin MEASUREMENT lv_act_mil_ext_adj "adjustment value for MIL  1 = active 0 = inactive" UBYTE _CNV_S_2_RANGE__0___1_CM 1 100. 0. 1. DISPLAY_IDENTIFIER LV_ACT_MIL_EXT_ADJ ECU_ADDRESS 0xd0008151 BIT_MASK 0x1 /end MEASUREMENT
/begin MEASUREMENT lv_cru_ext_adj "activation of external adjustment by InputOutputControl" UBYTE _CNV_S_2_RANGE__0___1_CM 1 100. 0. 1. DISPLAY_IDENTIFIER LV_CRU_EXT_ADJ ECU_ADDRESS 0xd000904a BIT_MASK 0x1 /end MEASUREMENT
/begin MEASUREMENT lv_act_cru_ext_adj "switch for the function InputOutputControl 1 = active 0 = deactive" UBYTE _CNV_S_2_RANGE__0___1_CM 1 100. 0. 1. DISPLAY_IDENTIFIER LV_ACT_CRU_EXT_ADJ ECU_ADDRESS 0xd000904b BIT_MASK 0x1 /end MEASUREMENT
/begin MEASUREMENT lv_wal_1_ext_adj "activation of external adjustment by InputOutputControl" UBYTE _CNV_S_2_RANGE__0___1_CM 1 100. 0. 1. DISPLAY_IDENTIFIER LV_WAL_1_EXT_ADJ ECU_ADDRESS 0xd000904c BIT_MASK 0x1 /end MEASUREMENT
/begin MEASUREMENT lv_act_wal_1_ext_adj "adjustment value for SAP  0 = off, 1 = on" UBYTE _CNV_S_2_RANGE__0___1_CM 1 100. 0. 1. DISPLAY_IDENTIFIER LV_ACT_WAL_1_EXT_ADJ ECU_ADDRESS 0xd000904d BIT_MASK 0x1 /end MEASUREMENT
/begin MEASUREMENT lv_efp_ext_adj "activation of external adjustment by InputOutputControl" UBYTE _CNV_S_2_RANGE__0___1_CM 1 100. 0. 1. DISPLAY_IDENTIFIER LV_EFP_EXT_ADJ ECU_ADDRESS 0xd000904e BIT_MASK 0x1 /end MEASUREMENT
/begin MEASUREMENT efppwm_ext_adj "Electric fuel pump PWM-signal for the function InputOutputControl" UBYTE _CNV_A_R_LINEAR_____5_CM 1 100. 0. 99.609375 DISPLAY_IDENTIFIER EFPPWM_EXT_ADJ ECU_ADDRESS 0xd000904f FORMAT "%5.1" /end MEASUREMENT
/begin MEASUREMENT lv_ecfpwm_ecf_ext_adj "activation of external adjustment by InputOutputControl" UBYTE _CNV_S_2_RANGE__0___1_CM 1 100. 0. 1. DISPLAY_IDENTIFIER LV_ECFPWM_ECF_EXT_ADJ ECU_ADDRESS 0xd0009050 BIT_MASK 0x1 /end MEASUREMENT
/begin MEASUREMENT ecfpwm_ecf_ext_adj "Electric fan control PWM-signal for the function InputOutputControl" UBYTE _CNV_A_R_LINEAR_____5_CM 1 100. 0. 99.609375 DISPLAY_IDENTIFIER ECFPWM_ECF_EXT_ADJ ECU_ADDRESS 0xd0009051 FORMAT "%5.1" /end MEASUREMENT
/begin MEASUREMENT lv_rly_vvl_ext_adj "activation of external adjustment by InputOutputControl" UBYTE _CNV_S_2_RANGE__0___1_CM 1 100. 0. 1. DISPLAY_IDENTIFIER LV_RLY_VVL_EXT_ADJ ECU_ADDRESS 0xd0009052 BIT_MASK 0x1 /end MEASUREMENT
/begin MEASUREMENT lv_act_rly_vvl_ext_adj "adjustment value for VVL relay  0 = off, 1 = on" UBYTE _CNV_S_2_RANGE__0___1_CM 1 100. 0. 1. DISPLAY_IDENTIFIER LV_ACT_RLY_VVL_EXT_ADJ ECU_ADDRESS 0xd0009053 BIT_MASK 0x1 /end MEASUREMENT
/begin MEASUREMENT lv_iv_ext_adj[0] "activation of external adjustment by InputOutputControl" UBYTE _CNV_S_2_RANGE__0___1_CM 1 100. 0. 1. DISPLAY_IDENTIFIER LV_IV_EXT_ADJ[0] ECU_ADDRESS 0xd0009058 BIT_MASK 0x1 /end MEASUREMENT
/begin MEASUREMENT lv_iv_ext_adj[1] "activation of external adjustment by InputOutputControl" UBYTE _CNV_S_2_RANGE__0___1_CM 1 100. 0. 1. DISPLAY_IDENTIFIER LV_IV_EXT_ADJ[1] ECU_ADDRESS 0xd0009059 BIT_MASK 0x1 /end MEASUREMENT
/begin MEASUREMENT lv_iv_ext_adj[2] "activation of external adjustment by InputOutputControl" UBYTE _CNV_S_2_RANGE__0___1_CM 1 100. 0. 1. DISPLAY_IDENTIFIER LV_IV_EXT_ADJ[2] ECU_ADDRESS 0xd000905a BIT_MASK 0x1 /end MEASUREMENT
/begin MEASUREMENT lv_iv_ext_adj[3] "activation of external adjustment by InputOutputControl" UBYTE _CNV_S_2_RANGE__0___1_CM 1 100. 0. 1. DISPLAY_IDENTIFIER LV_IV_EXT_ADJ[3] ECU_ADDRESS 0xd000905b BIT_MASK 0x1 /end MEASUREMENT
/begin MEASUREMENT lv_iv_ext_adj[4] "activation of external adjustment by InputOutputControl" UBYTE _CNV_S_2_RANGE__0___1_CM 1 100. 0. 1. DISPLAY_IDENTIFIER LV_IV_EXT_ADJ[4] ECU_ADDRESS 0xd000905c BIT_MASK 0x1 /end MEASUREMENT
/begin MEASUREMENT lv_iv_ext_adj[5] "activation of external adjustment by InputOutputControl" UBYTE _CNV_S_2_RANGE__0___1_CM 1 100. 0. 1. DISPLAY_IDENTIFIER LV_IV_EXT_ADJ[5] ECU_ADDRESS 0xd000905d BIT_MASK 0x1 /end MEASUREMENT
/begin MEASUREMENT lv_iv_ext_adj[6] "activation of external adjustment by InputOutputControl" UBYTE _CNV_S_2_RANGE__0___1_CM 1 100. 0. 1. DISPLAY_IDENTIFIER LV_IV_EXT_ADJ[6] ECU_ADDRESS 0xd000905e BIT_MASK 0x1 /end MEASUREMENT
/begin MEASUREMENT lv_iv_ext_adj[7] "activation of external adjustment by InputOutputControl" UBYTE _CNV_S_2_RANGE__0___1_CM 1 100. 0. 1. DISPLAY_IDENTIFIER LV_IV_EXT_ADJ[7] ECU_ADDRESS 0xd000905f BIT_MASK 0x1 /end MEASUREMENT
/begin MEASUREMENT iv_per_ext_adj[0] "Injection time cylinder individual at external adjustment" UBYTE _CNV_A_R_LINEAR_____20_CM 1 100. 0. 2550. DISPLAY_IDENTIFIER IV_PER_EXT_ADJ[0] ECU_ADDRESS 0xd0009060 FORMAT "%4.0" /end MEASUREMENT
/begin MEASUREMENT iv_per_ext_adj[1] "Injection time cylinder individual at external adjustment" UBYTE _CNV_A_R_LINEAR_____20_CM 1 100. 0. 2550. DISPLAY_IDENTIFIER IV_PER_EXT_ADJ[1] ECU_ADDRESS 0xd0009061 FORMAT "%4.0" /end MEASUREMENT
/begin MEASUREMENT iv_per_ext_adj[2] "Injection time cylinder individual at external adjustment" UBYTE _CNV_A_R_LINEAR_____20_CM 1 100. 0. 2550. DISPLAY_IDENTIFIER IV_PER_EXT_ADJ[2] ECU_ADDRESS 0xd0009062 FORMAT "%4.0" /end MEASUREMENT
/begin MEASUREMENT iv_per_ext_adj[3] "Injection time cylinder individual at external adjustment" UBYTE _CNV_A_R_LINEAR_____20_CM 1 100. 0. 2550. DISPLAY_IDENTIFIER IV_PER_EXT_ADJ[3] ECU_ADDRESS 0xd0009063 FORMAT "%4.0" /end MEASUREMENT
/begin MEASUREMENT iv_per_ext_adj[4] "Injection time cylinder individual at external adjustment" UBYTE _CNV_A_R_LINEAR_____20_CM 1 100. 0. 2550. DISPLAY_IDENTIFIER IV_PER_EXT_ADJ[4] ECU_ADDRESS 0xd0009064 FORMAT "%4.0" /end MEASUREMENT
/begin MEASUREMENT iv_per_ext_adj[5] "Injection time cylinder individual at external adjustment" UBYTE _CNV_A_R_LINEAR_____20_CM 1 100. 0. 2550. DISPLAY_IDENTIFIER IV_PER_EXT_ADJ[5] ECU_ADDRESS 0xd0009065 FORMAT "%4.0" /end MEASUREMENT
/begin MEASUREMENT iv_per_ext_adj[6] "Injection time cylinder individual at external adjustment" UBYTE _CNV_A_R_LINEAR_____20_CM 1 100. 0. 2550. DISPLAY_IDENTIFIER IV_PER_EXT_ADJ[6] ECU_ADDRESS 0xd0009066 FORMAT "%4.0" /end MEASUREMENT
/begin MEASUREMENT iv_per_ext_adj[7] "Injection time cylinder individual at external adjustment" UBYTE _CNV_A_R_LINEAR_____20_CM 1 100. 0. 2550. DISPLAY_IDENTIFIER IV_PER_EXT_ADJ[7] ECU_ADDRESS 0xd0009067 FORMAT "%4.0" /end MEASUREMENT
/begin MEASUREMENT iv_ext_adj[0] "Injection time cylinder individual at external adjustment" UBYTE _CNV_A_R_LINEAR_____426_CM 1 100. 0. 20.4 DISPLAY_IDENTIFIER IV_EXT_ADJ[0] ECU_ADDRESS 0xd0009068 FORMAT "%5.2" /end MEASUREMENT
/begin MEASUREMENT iv_ext_adj[1] "Injection time cylinder individual at external adjustment" UBYTE _CNV_A_R_LINEAR_____426_CM 1 100. 0. 20.4 DISPLAY_IDENTIFIER IV_EXT_ADJ[1] ECU_ADDRESS 0xd0009069 FORMAT "%5.2" /end MEASUREMENT
/begin MEASUREMENT iv_ext_adj[2] "Injection time cylinder individual at external adjustment" UBYTE _CNV_A_R_LINEAR_____426_CM 1 100. 0. 20.4 DISPLAY_IDENTIFIER IV_EXT_ADJ[2] ECU_ADDRESS 0xd000906a FORMAT "%5.2" /end MEASUREMENT
/begin MEASUREMENT iv_ext_adj[3] "Injection time cylinder individual at external adjustment" UBYTE _CNV_A_R_LINEAR_____426_CM 1 100. 0. 20.4 DISPLAY_IDENTIFIER IV_EXT_ADJ[3] ECU_ADDRESS 0xd000906b FORMAT "%5.2" /end MEASUREMENT
/begin MEASUREMENT iv_ext_adj[4] "Injection time cylinder individual at external adjustment" UBYTE _CNV_A_R_LINEAR_____426_CM 1 100. 0. 20.4 DISPLAY_IDENTIFIER IV_EXT_ADJ[4] ECU_ADDRESS 0xd000906c FORMAT "%5.2" /end MEASUREMENT
/begin MEASUREMENT iv_ext_adj[5] "Injection time cylinder individual at external adjustment" UBYTE _CNV_A_R_LINEAR_____426_CM 1 100. 0. 20.4 DISPLAY_IDENTIFIER IV_EXT_ADJ[5] ECU_ADDRESS 0xd000906d FORMAT "%5.2" /end MEASUREMENT
/begin MEASUREMENT iv_ext_adj[6] "Injection time cylinder individual at external adjustment" UBYTE _CNV_A_R_LINEAR_____426_CM 1 100. 0. 20.4 DISPLAY_IDENTIFIER IV_EXT_ADJ[6] ECU_ADDRESS 0xd000906e FORMAT "%5.2" /end MEASUREMENT
/begin MEASUREMENT iv_ext_adj[7] "Injection time cylinder individual at external adjustment" UBYTE _CNV_A_R_LINEAR_____426_CM 1 100. 0. 20.4 DISPLAY_IDENTIFIER IV_EXT_ADJ[7] ECU_ADDRESS 0xd000906f FORMAT "%5.2" /end MEASUREMENT
/begin MEASUREMENT lv_cam_sp_in_ext_adj "activation of external adjustment by InputOutputControl" UBYTE _CNV_S_2_RANGE__0___1_CM 1 100. 0. 1. DISPLAY_IDENTIFIER LV_CAM_SP_IN_EXT_ADJ ECU_ADDRESS 0xd0009070 BIT_MASK 0x1 /end MEASUREMENT
/begin MEASUREMENT cam_sp_in_ext_adj "Output signal from the module actuator diagnosis to the function" UWORD _CNV_A_R_LINEAR_____427_CM 1 100. -128. 52300. DISPLAY_IDENTIFIER CAM_SP_IN_EXT_ADJ ECU_ADDRESS 0xd000ac52 FORMAT "%7.1" /end MEASUREMENT
/begin MEASUREMENT lv_cam_sp_ex_ext_adj "activation of external adjustment by InputOutputControl" UBYTE _CNV_S_2_RANGE__0___1_CM 1 100. 0. 1. DISPLAY_IDENTIFIER LV_CAM_SP_EX_EXT_ADJ ECU_ADDRESS 0xd0009071 BIT_MASK 0x1 /end MEASUREMENT
/begin MEASUREMENT cam_sp_ex_ext_adj "Output signal from the module actuator diagnosis to the function" UWORD _CNV_A_R_LINEAR_____427_CM 1 100. -128. 52300. DISPLAY_IDENTIFIER CAM_SP_EX_EXT_ADJ ECU_ADDRESS 0xd000ac54 FORMAT "%7.1" /end MEASUREMENT
/begin MEASUREMENT lv_ad_dis_ext_adj "boolean for disable adaptions while active external adjust" UBYTE _CNV_S_2_RANGE__0___1_CM 1 100. 0. 1. DISPLAY_IDENTIFIER LV_AD_DIS_EXT_ADJ ECU_ADDRESS 0xd0009008 BIT_MASK 0x1 /end MEASUREMENT
/begin MEASUREMENT lv_inh_lam_kwp "Switch off condition for lambda control via KWP2000  /  01= disabled 00=enabled" UBYTE _CNV_S_2_RANGE__0___1_CM 1 100. 0. 1. DISPLAY_IDENTIFIER LV_INH_LAM_KWP ECU_ADDRESS 0xd0008ff9 BIT_MASK 0x1 /end MEASUREMENT
/begin MEASUREMENT qoil_ds_rst_kwp_1 "Reset oil quality via tester" UBYTE _CNV_A_R_LINEAR_____0_CM 1 100. 0. 255. DISPLAY_IDENTIFIER QOIL_DS_RST_KWP_1 ECU_ADDRESS 0xd0009080 FORMAT "%3.0" /end MEASUREMENT
/begin MEASUREMENT qoil_ds_rst_kwp_2 "Reset availability via tester" UBYTE _CNV_A_R_LINEAR_____0_CM 1 100. 0. 255. DISPLAY_IDENTIFIER QOIL_DS_RST_KWP_2 ECU_ADDRESS 0xd0009081 FORMAT "%3.0" /end MEASUREMENT
/begin MEASUREMENT qoil_ds_rst_kwp_3 "Reset number of services via tester" UBYTE _CNV_A_R_LINEAR_____0_CM 1 100. 0. 255. DISPLAY_IDENTIFIER QOIL_DS_RST_KWP_3 ECU_ADDRESS 0xd0009082 FORMAT "%3.0" /end MEASUREMENT
/begin MEASUREMENT qoil_ds_rst_kwp_4 "Reset rest distance via tester" SWORD _CNV_R_R_Def_km_sw__68_CM 1 100. -327680. 327670. DISPLAY_IDENTIFIER QOIL_DS_RST_KWP_4 ECU_ADDRESS 0xd000ac68 FORMAT "%6.1" /end MEASUREMENT
/begin MEASUREMENT qoil_ds_rst_kwp_5 "Reset forecast way clearance via tester" UBYTE _CNV_R_R_Def_km_ub__428_CM 1 100. 0. 255000. DISPLAY_IDENTIFIER QOIL_DS_RST_KWP_5 ECU_ADDRESS 0xd0009083 FORMAT "%3.0" /end MEASUREMENT
/begin MEASUREMENT qoil_ds_rst_kwp_6 "Reset target month via tester" UBYTE _CNV_A_R_LINEAR_____0_CM 1 100. 0. 255. DISPLAY_IDENTIFIER QOIL_DS_RST_KWP_6 ECU_ADDRESS 0xd0009084 FORMAT "%3.0" /end MEASUREMENT
/begin MEASUREMENT qoil_ds_rst_kwp_7 "Reset target year via tester" UBYTE _CNV_A_R_LINEAR_____0_CM 1 100. 0. 255. DISPLAY_IDENTIFIER QOIL_DS_RST_KWP_7 ECU_ADDRESS 0xd0009085 FORMAT "%3.0" /end MEASUREMENT
/begin MEASUREMENT qoil_ds_rst_kwp_8 "Reset forecast time clearance via tester" UBYTE _CNV_A_R_LINEAR_____0_CM 1 100. 0. 255. DISPLAY_IDENTIFIER QOIL_DS_RST_KWP_8 ECU_ADDRESS 0xd0009086 FORMAT "%3.0" /end MEASUREMENT
/begin MEASUREMENT qoil_ds_rst_kwp_9 "Unit base for service clear via tester" UBYTE _CNV_A_R_LINEAR_____0_CM 1 100. 0. 255. DISPLAY_IDENTIFIER QOIL_DS_RST_KWP_9 ECU_ADDRESS 0xd0009087 FORMAT "%3.0" /end MEASUREMENT
/begin MEASUREMENT fac_oil_ext_req_1 "Country dependant factor for oil change intervall via tester" UBYTE _CNV_A_R_EGCP_LINEA_354_CM 1 100. 0. 2.55 DISPLAY_IDENTIFIER FAC_OIL_EXT_REQ_1 ECU_ADDRESS 0xd0008b4f /end MEASUREMENT
/begin MEASUREMENT fac_oil_ext_req_2 "Country dependant factor for oil change intervall via tester" UBYTE _CNV_A_R_EGCP_LINEA_354_CM 1 100. 0. 2.55 DISPLAY_IDENTIFIER FAC_OIL_EXT_REQ_2 ECU_ADDRESS 0xd0008b50 /end MEASUREMENT
/begin MEASUREMENT state_cmb_ctl_kwp "carrier byte state combustion control" UBYTE _CNV_A_R_LINEAR_____0_CM 1 100. 0. 255. DISPLAY_IDENTIFIER STATE_CMB_CTL_KWP ECU_ADDRESS 0xd000907e FORMAT "%3.0" /end MEASUREMENT
/begin MEASUREMENT state_cmb_ctl_nvmy_kwp "carrier byte state combustion control non volatile saved" UBYTE _CNV_A_R_LINEAR_____0_CM 1 100. 0. 255. DISPLAY_IDENTIFIER STATE_CMB_CTL_NVMY_KWP ECU_ADDRESS 0xd000907f FORMAT "%3.0" /end MEASUREMENT
/begin MEASUREMENT lv_alter_ctl_ext_adj "Set alternator control passiv" UBYTE _CNV_S_2_RANGE__0___1_CM 1 100. 0. 1. DISPLAY_IDENTIFIER LV_ALTER_CTL_EXT_ADJ ECU_ADDRESS 0xd0008ffa BIT_MASK 0x1 /end MEASUREMENT
/begin MEASUREMENT lv_alter_ctl_ena "Intelligent alternator control activated" UBYTE _CNV_S_2_RANGE__0___1_CM 1 100. 0. 1. DISPLAY_IDENTIFIER LV_ALTER_CTL_ENA ECU_ADDRESS 0xd0008b51 BIT_MASK 0x1 /end MEASUREMENT
/begin MEASUREMENT lv_ltg_gas_ena "xenon-filled headlights mounted" UBYTE _CNV_S_2_RANGE__0___1_CM 1 100. 0. 1. DISPLAY_IDENTIFIER LV_LTG_GAS_ENA ECU_ADDRESS 0xd0008b52 BIT_MASK 0x1 /end MEASUREMENT
/begin MEASUREMENT lv_ecras_down_ext_adj "Bit indicating that external adjustment of ECRAS_DOWN is active" UBYTE _CNV_S_2_RANGE__0___1_CM 1 100. 0. 1. DISPLAY_IDENTIFIER LV_ECRAS_DOWN_EXT_ADJ ECU_ADDRESS 0xd000902b BIT_MASK 0x1 /end MEASUREMENT
/begin MEASUREMENT lv_act_ecras_down_ext_adj "Bit used to determine ECRASPWM by external adjustment" UBYTE _CNV_S_2_RANGE__0___1_CM 1 100. 0. 1. DISPLAY_IDENTIFIER LV_ACT_ECRAS_DOWN_EXT_ADJ ECU_ADDRESS 0xd000902c BIT_MASK 0x1 /end MEASUREMENT
/begin MEASUREMENT lv_act_ecras_eol_ext_adj "Bit indicating activated ECRAS system test" UBYTE _CNV_S_2_RANGE__0___1_CM 1 100. 0. 1. DISPLAY_IDENTIFIER LV_ACT_ECRAS_EOL_EXT_ADJ ECU_ADDRESS 0xd0008f2c BIT_MASK 0x1 /end MEASUREMENT
/begin CHARACTERISTIC c_n_min_kwp_poil "minimum engine speed for external adjustment  with poil dependence" VALUE 0xa080bf9e _REC_VAL_20_u2 8160. _CNV_A_R_LINEAR_____14_CM 0. 8160. DISPLAY_IDENTIFIER C_N_MIN_KWP_POIL FORMAT "%4.0" /end CHARACTERISTIC
/begin CHARACTERISTIC c_n_max_kwp_poil "maximum engine speed for external adjustment with poil dependence" VALUE 0xa080bf8e _REC_VAL_20_u2 8160. _CNV_A_R_LINEAR_____14_CM 0. 8160. DISPLAY_IDENTIFIER C_N_MAX_KWP_POIL FORMAT "%4.0" /end CHARACTERISTIC
/begin CHARACTERISTIC c_fup_min_kwp "minimum fuel pressure for external adjustment" VALUE 0xa080bd80 _REC_VAL_20_u2 347776. _CNV_A_R_LINEAR_____171_CM 0. 347776. DISPLAY_IDENTIFIER C_FUP_MIN_KWP FORMAT "%6.0" /end CHARACTERISTIC
/begin CHARACTERISTIC c_fup_max_kwp "maximum fuel pressure for external adjustment" VALUE 0xa080bd7c _REC_VAL_20_u2 347776. _CNV_A_R_LINEAR_____171_CM 0. 347776. DISPLAY_IDENTIFIER C_FUP_MAX_KWP FORMAT "%6.0" /end CHARACTERISTIC
/begin MEASUREMENT wgpwm_ext_adj[0] "PWM output wastegate[NC_CBK_EX_NR]" UWORD _CNV_A_R_LINEAR_____8_CM 1 100. 0. 99.99847412109381 DISPLAY_IDENTIFIER WGPWM_EXT_ADJ[0] ECU_ADDRESS 0xd000ac5a /end MEASUREMENT
/begin MEASUREMENT wgpwm_ext_adj[1] "PWM output wastegate[NC_CBK_EX_NR]" UWORD _CNV_A_R_LINEAR_____8_CM 1 100. 0. 99.99847412109381 DISPLAY_IDENTIFIER WGPWM_EXT_ADJ[1] ECU_ADDRESS 0xd000ac5c /end MEASUREMENT
/begin MEASUREMENT lv_wgpwm_ext_adj[0] "activation of external adjustment Ladedrucksteller ansteuern" UBYTE _CNV_S_2_RANGE__0___1_CM 1 100. 0. 1. DISPLAY_IDENTIFIER LV_WGPWM_EXT_ADJ[0] ECU_ADDRESS 0xd000900a BIT_MASK 0x1 /end MEASUREMENT
/begin MEASUREMENT lv_wgpwm_ext_adj[1] "activation of external adjustment Ladedrucksteller ansteuern" UBYTE _CNV_S_2_RANGE__0___1_CM 1 100. 0. 1. DISPLAY_IDENTIFIER LV_WGPWM_EXT_ADJ[1] ECU_ADDRESS 0xd000900b BIT_MASK 0x1 /end MEASUREMENT
/begin MEASUREMENT lv_swi_aeb_act_ext_adj "activation of external adjustment by InputOutputControl" UBYTE _CNV_S_2_RANGE__0___1_CM 1 100. 0. 1. DISPLAY_IDENTIFIER LV_SWI_AEB_ACT_EXT_ADJ ECU_ADDRESS 0xd0009018 BIT_MASK 0x1 /end MEASUREMENT
/begin MEASUREMENT lv_swi_aeb_ext_adj "active engine bracket ( 0 - off , 1 - on )" UBYTE _CNV_S_2_RANGE__0___1_CM 1 100. 0. 1. DISPLAY_IDENTIFIER LV_SWI_AEB_EXT_ADJ ECU_ADDRESS 0xd0009019 BIT_MASK 0x1 /end MEASUREMENT
/begin MEASUREMENT lv_fup_sp_req_ext_adj "activation of external adjustment by InputOutputControl" UBYTE _CNV_S_2_RANGE__0___1_CM 1 100. 0. 1. DISPLAY_IDENTIFIER LV_FUP_SP_REQ_EXT_ADJ ECU_ADDRESS 0xd000901a BIT_MASK 0x1 /end MEASUREMENT
/begin MEASUREMENT fup_sp_ext_adj "fuel pressure setpoint requested via KWP" UWORD _CNV_A_R_LINEAR_____171_CM 1 100. 0. 347776. DISPLAY_IDENTIFIER FUP_SP_EXT_ADJ ECU_ADDRESS 0xd000ac56 FORMAT "%6.0" /end MEASUREMENT
/begin MEASUREMENT lv_opg_sp_acr_ext_adj "activation of external adjustment by InputOutputContro" UBYTE _CNV_S_2_RANGE__0___1_CM 1 100. 0. 1. DISPLAY_IDENTIFIER LV_OPG_SP_ACR_EXT_ADJ ECU_ADDRESS 0xd000901b BIT_MASK 0x1 /end MEASUREMENT
/begin MEASUREMENT opg_sp_acr_ext_adj "External position setpoint for actuator position control  via KWP" UWORD _CNV_A_R_ACRC_LINEA_431_CM 1 100. 0. 99.9755859375 DISPLAY_IDENTIFIER OPG_SP_ACR_EXT_ADJ ECU_ADDRESS 0xd000ac58 FORMAT "%5.2" /end MEASUREMENT
/begin MEASUREMENT state_hom_afs_req_ext_adj "raw operation mode request from tester" UWORD _CNV_A_R_LINEAR_____0_CM 1 100. 0. 65535. DISPLAY_IDENTIFIER STATE_HOM_AFS_REQ_EXT_ADJ ECU_ADDRESS 0xd000ac64 FORMAT "%5.0" /end MEASUREMENT
/begin CHARACTERISTIC c_prot_conf_idx_ext_req "init value for selected data transmission protocol  via tester( 0-- 15765, change with tester allowed 1 -15765, change with tester not allowed2 -14230, change with tester not allowed )" VALUE 0xa080c084 _REC_VAL_20_u1 2. _CNV_A_R_LINEAR_____0_CM 0. 2. DISPLAY_IDENTIFIER C_PROT_CONF_IDX_EXT_REQ FORMAT "%1.0" /end CHARACTERISTIC
/begin MEASUREMENT lv_var_obdc_can "Variable to activate OBD communication on CAN (=1)" UBYTE _CNV_S_2_RANGE__0___1_CM 1 100. 0. 1. DISPLAY_IDENTIFIER LV_VAR_OBDC_CAN ECU_ADDRESS 0xd0008b4e BIT_MASK 0x1 /end MEASUREMENT
/begin MEASUREMENT egy_sp_iv_ext_adj[0] "external adjusted injection valve EGY setpoint value (high flow)" UWORD _CNV_A_R_INJR_LINEA_432_CM 1 100. 0. 255. DISPLAY_IDENTIFIER EGY_SP_IV_EXT_ADJ[0] ECU_ADDRESS 0xd000ac6c FORMAT "%7.3" /end MEASUREMENT
/begin MEASUREMENT egy_sp_iv_ext_adj[1] "external adjusted injection valve EGY setpoint value (high flow)" UWORD _CNV_A_R_INJR_LINEA_432_CM 1 100. 0. 255. DISPLAY_IDENTIFIER EGY_SP_IV_EXT_ADJ[1] ECU_ADDRESS 0xd000ac6e FORMAT "%7.3" /end MEASUREMENT
/begin MEASUREMENT egy_sp_iv_ext_adj[2] "external adjusted injection valve EGY setpoint value (high flow)" UWORD _CNV_A_R_INJR_LINEA_432_CM 1 100. 0. 255. DISPLAY_IDENTIFIER EGY_SP_IV_EXT_ADJ[2] ECU_ADDRESS 0xd000ac70 FORMAT "%7.3" /end MEASUREMENT
/begin MEASUREMENT egy_sp_iv_ext_adj[3] "external adjusted injection valve EGY setpoint value (high flow)" UWORD _CNV_A_R_INJR_LINEA_432_CM 1 100. 0. 255. DISPLAY_IDENTIFIER EGY_SP_IV_EXT_ADJ[3] ECU_ADDRESS 0xd000ac72 FORMAT "%7.3" /end MEASUREMENT
/begin MEASUREMENT egy_sp_iv_ext_adj[4] "external adjusted injection valve EGY setpoint value (high flow)" UWORD _CNV_A_R_INJR_LINEA_432_CM 1 100. 0. 255. DISPLAY_IDENTIFIER EGY_SP_IV_EXT_ADJ[4] ECU_ADDRESS 0xd000ac74 FORMAT "%7.3" /end MEASUREMENT
/begin MEASUREMENT egy_sp_iv_ext_adj[5] "external adjusted injection valve EGY setpoint value (high flow)" UWORD _CNV_A_R_INJR_LINEA_432_CM 1 100. 0. 255. DISPLAY_IDENTIFIER EGY_SP_IV_EXT_ADJ[5] ECU_ADDRESS 0xd000ac76 FORMAT "%7.3" /end MEASUREMENT
/begin MEASUREMENT egy_sp_iv_ext_adj[6] "external adjusted injection valve EGY setpoint value (high flow)" UWORD _CNV_A_R_INJR_LINEA_432_CM 1 100. 0. 255. DISPLAY_IDENTIFIER EGY_SP_IV_EXT_ADJ[6] ECU_ADDRESS 0xd000ac78 FORMAT "%7.3" /end MEASUREMENT
/begin MEASUREMENT egy_sp_iv_ext_adj[7] "external adjusted injection valve EGY setpoint value (high flow)" UWORD _CNV_A_R_INJR_LINEA_432_CM 1 100. 0. 255. DISPLAY_IDENTIFIER EGY_SP_IV_EXT_ADJ[7] ECU_ADDRESS 0xd000ac7a FORMAT "%7.3" /end MEASUREMENT
/begin MEASUREMENT mff_absv_iv_ext_adj[0] "external adjusted injection valve additive MFF correction value( low flow)" UWORD _CNV_A_R_LINEAR_____111_CM 1 100. 0. 1389. DISPLAY_IDENTIFIER MFF_ABSV_IV_EXT_ADJ[0] ECU_ADDRESS 0xd000ac7c FORMAT "%7.2" /end MEASUREMENT
/begin MEASUREMENT mff_absv_iv_ext_adj[1] "external adjusted injection valve additive MFF correction value( low flow)" UWORD _CNV_A_R_LINEAR_____111_CM 1 100. 0. 1389. DISPLAY_IDENTIFIER MFF_ABSV_IV_EXT_ADJ[1] ECU_ADDRESS 0xd000ac7e FORMAT "%7.2" /end MEASUREMENT
/begin MEASUREMENT mff_absv_iv_ext_adj[2] "external adjusted injection valve additive MFF correction value( low flow)" UWORD _CNV_A_R_LINEAR_____111_CM 1 100. 0. 1389. DISPLAY_IDENTIFIER MFF_ABSV_IV_EXT_ADJ[2] ECU_ADDRESS 0xd000ac80 FORMAT "%7.2" /end MEASUREMENT
/begin MEASUREMENT mff_absv_iv_ext_adj[3] "external adjusted injection valve additive MFF correction value( low flow)" UWORD _CNV_A_R_LINEAR_____111_CM 1 100. 0. 1389. DISPLAY_IDENTIFIER MFF_ABSV_IV_EXT_ADJ[3] ECU_ADDRESS 0xd000ac82 FORMAT "%7.2" /end MEASUREMENT
/begin MEASUREMENT mff_absv_iv_ext_adj[4] "external adjusted injection valve additive MFF correction value( low flow)" UWORD _CNV_A_R_LINEAR_____111_CM 1 100. 0. 1389. DISPLAY_IDENTIFIER MFF_ABSV_IV_EXT_ADJ[4] ECU_ADDRESS 0xd000ac84 FORMAT "%7.2" /end MEASUREMENT
/begin MEASUREMENT mff_absv_iv_ext_adj[5] "external adjusted injection valve additive MFF correction value( low flow)" UWORD _CNV_A_R_LINEAR_____111_CM 1 100. 0. 1389. DISPLAY_IDENTIFIER MFF_ABSV_IV_EXT_ADJ[5] ECU_ADDRESS 0xd000ac86 FORMAT "%7.2" /end MEASUREMENT
/begin MEASUREMENT mff_absv_iv_ext_adj[6] "external adjusted injection valve additive MFF correction value( low flow)" UWORD _CNV_A_R_LINEAR_____111_CM 1 100. 0. 1389. DISPLAY_IDENTIFIER MFF_ABSV_IV_EXT_ADJ[6] ECU_ADDRESS 0xd000ac88 FORMAT "%7.2" /end MEASUREMENT
/begin MEASUREMENT mff_absv_iv_ext_adj[7] "external adjusted injection valve additive MFF correction value( low flow)" UWORD _CNV_A_R_LINEAR_____111_CM 1 100. 0. 1389. DISPLAY_IDENTIFIER MFF_ABSV_IV_EXT_ADJ[7] ECU_ADDRESS 0xd000ac8a FORMAT "%7.2" /end MEASUREMENT
/begin MEASUREMENT lv_bos_read_ena "Flag indicating start transmitting of BOS data to tester" UBYTE _CNV_S_2_RANGE__0___1_CM 1 100. 0. 1. DISPLAY_IDENTIFIER LV_BOS_READ_ENA ECU_ADDRESS 0xd0009078 BIT_MASK 0x1 /end MEASUREMENT
/begin MEASUREMENT lv_cyl_bal_ad_dc_ext_adj "request to clear flags for cylinder balancing lambda adaptation at active driving cycle" UBYTE _CNV_S_2_RANGE__0___1_CM 1 100. 0. 1. DISPLAY_IDENTIFIER LV_CYL_BAL_AD_DC_EXT_ADJ ECU_ADDRESS 0xd0008ffe BIT_MASK 0x1 /end MEASUREMENT
/begin MEASUREMENT lv_mff_fac_ad_er_bal_ext_adj "request to clear multiple adaptation value for cylinder balancing via ti intervention" UBYTE _CNV_S_2_RANGE__0___1_CM 1 100. 0. 1. DISPLAY_IDENTIFIER LV_MFF_FAC_AD_ER_BAL_EXT_ADJ ECU_ADDRESS 0xd0008fff BIT_MASK 0x1 /end MEASUREMENT
/begin MEASUREMENT lv_mff_add_ad_er_bal_ext_adj "request to clear additive adaptation value for cylinder balancing via ti intervention" UBYTE _CNV_S_2_RANGE__0___1_CM 1 100. 0. 1. DISPLAY_IDENTIFIER LV_MFF_ADD_AD_ER_BAL_EXT_ADJ ECU_ADDRESS 0xd0009000 BIT_MASK 0x1 /end MEASUREMENT
/begin MEASUREMENT lv_lam_cyl_sel_adj_rst_iv_ext[0] "external adjustment to reset the  injector speciific lambda  adaptation values" UBYTE _CNV_S_2_RANGE__0___1_CM 1 100. 0. 1. DISPLAY_IDENTIFIER LV_LAM_CYL_SEL_ADJ_RST_IV_EXT[0] ECU_ADDRESS 0xd0009002 BIT_MASK 0x1 /end MEASUREMENT
/begin MEASUREMENT lv_lam_cyl_sel_adj_rst_iv_ext[1] "external adjustment to reset the  injector speciific lambda  adaptation values" UBYTE _CNV_S_2_RANGE__0___1_CM 1 100. 0. 1. DISPLAY_IDENTIFIER LV_LAM_CYL_SEL_ADJ_RST_IV_EXT[1] ECU_ADDRESS 0xd0009003 BIT_MASK 0x1 /end MEASUREMENT
/begin MEASUREMENT lv_crk_cyl_lam_delta_rst_ls_ext[0] "external adjustment to reset the  bank selective lambda  adaptation values" UBYTE _CNV_S_2_RANGE__0___1_CM 1 100. 0. 1. DISPLAY_IDENTIFIER LV_CRK_CYL_LAM_DELTA_RST_LS_EXT[0] ECU_ADDRESS 0xd0009004 BIT_MASK 0x1 /end MEASUREMENT
/begin MEASUREMENT lv_crk_cyl_lam_delta_rst_ls_ext[1] "external adjustment to reset the  bank selective lambda  adaptation values" UBYTE _CNV_S_2_RANGE__0___1_CM 1 100. 0. 1. DISPLAY_IDENTIFIER LV_CRK_CYL_LAM_DELTA_RST_LS_EXT[1] ECU_ADDRESS 0xd0009005 BIT_MASK 0x1 /end MEASUREMENT
/begin MEASUREMENT lv_cyl_bal_ad_eol_ext_adj "request to clear flags for cylinder balancing lambda adaptation at end of line" UBYTE _CNV_S_2_RANGE__0___1_CM 1 100. 0. 1. DISPLAY_IDENTIFIER LV_CYL_BAL_AD_EOL_EXT_ADJ ECU_ADDRESS 0xd0008ffd BIT_MASK 0x1 /end MEASUREMENT
/begin MEASUREMENT lv_rough_leak_susp_chk_fuc "evap emission system suspects rough leak" UBYTE _CNV_S_2_RANGE__0___1_CM 1 100. 0. 1. DISPLAY_IDENTIFIER LV_ROUGH_LEAK_SUSP_CHK_FUC ECU_ADDRESS 0xd0008e15 BIT_MASK 0x1 /end MEASUREMENT
/begin MEASUREMENT lv_ctr_dc_chk_fuc "indicator of driving cycle counter enabled" UBYTE _CNV_S_2_RANGE__0___1_CM 1 100. 0. 1. DISPLAY_IDENTIFIER LV_CTR_DC_CHK_FUC ECU_ADDRESS 0xd0008e16 BIT_MASK 0x1 /end MEASUREMENT
/begin MEASUREMENT lv_ena_chk_fuc_refu "valid refilling recognized" UBYTE _CNV_S_2_RANGE__0___1_CM 1 100. 0. 1. DISPLAY_IDENTIFIER LV_ENA_CHK_FUC_REFU ECU_ADDRESS 0xd0008e17 BIT_MASK 0x1 /end MEASUREMENT
/begin MEASUREMENT lv_ena_chk_fuc_rough_leak_mes "valid refilling recognized" UBYTE _CNV_S_2_RANGE__0___1_CM 1 100. 0. 1. DISPLAY_IDENTIFIER LV_ENA_CHK_FUC_ROUGH_LEAK_MES ECU_ADDRESS 0xd0008e0c BIT_MASK 0x1 /end MEASUREMENT
/begin MEASUREMENT lv_chk_fuc_close "filler cap close" UBYTE _CNV_S_2_RANGE__0___1_CM 1 100. 0. 1. DISPLAY_IDENTIFIER LV_CHK_FUC_CLOSE ECU_ADDRESS 0xd0008e0d BIT_MASK 0x1 /end MEASUREMENT
/begin MEASUREMENT lv_chk_fuc_open "filler cap open" UBYTE _CNV_S_2_RANGE__0___1_CM 1 100. 0. 1. DISPLAY_IDENTIFIER LV_CHK_FUC_OPEN ECU_ADDRESS 0xd0008e12 BIT_MASK 0x1 /end MEASUREMENT
/begin MEASUREMENT lv_chk_fuc_end "test filler cap ended" UBYTE _CNV_S_2_RANGE__0___1_CM 1 100. 0. 1. DISPLAY_IDENTIFIER LV_CHK_FUC_END ECU_ADDRESS 0xd0008e0e BIT_MASK 0x1 /end MEASUREMENT
/begin MEASUREMENT lv_t_vs_chk_fuc_open_can "min. vehicle speed for control cfc lamp reached" UBYTE _CNV_S_2_RANGE__0___1_CM 1 100. 0. 1. DISPLAY_IDENTIFIER LV_T_VS_CHK_FUC_OPEN_CAN ECU_ADDRESS 0xd00004d0 BIT_MASK 0x1 /end MEASUREMENT
/begin MEASUREMENT lv_t_vs_chk_fuc_open_max "recognized vehicle stops" UBYTE _CNV_S_2_RANGE__0___1_CM 1 100. 0. 1. DISPLAY_IDENTIFIER LV_T_VS_CHK_FUC_OPEN_MAX ECU_ADDRESS 0xd00004d1 BIT_MASK 0x1 /end MEASUREMENT
/begin MEASUREMENT lv_chk_fuc_open_act "set check filler cap lamp was already set" UBYTE _CNV_S_2_RANGE__0___1_CM 1 100. 0. 1. DISPLAY_IDENTIFIER LV_CHK_FUC_OPEN_ACT ECU_ADDRESS 0xd0008e13 BIT_MASK 0x1 /end MEASUREMENT
/begin MEASUREMENT lv_rep_chk_fuc "healing test enabled" UBYTE _CNV_S_2_RANGE__0___1_CM 1 100. 0. 1. DISPLAY_IDENTIFIER LV_REP_CHK_FUC ECU_ADDRESS 0xd0008e14 BIT_MASK 0x1 /end MEASUREMENT
/begin MEASUREMENT lv_chk_fuc_open_can "set check filler cap lampin the ICL" UBYTE _CNV_S_2_RANGE__0___1_CM 1 100. 0. 1. DISPLAY_IDENTIFIER LV_CHK_FUC_OPEN_CAN ECU_ADDRESS 0xd0008e0f BIT_MASK 0x1 /end MEASUREMENT
/begin MEASUREMENT lv_err_chk_fuc "error flag check filler cap (open filler cap)" UBYTE _CNV_S_2_RANGE__0___1_CM 1 100. 0. 1. DISPLAY_IDENTIFIER LV_ERR_CHK_FUC ECU_ADDRESS 0xd0007f84 BIT_MASK 0x1 /end MEASUREMENT
/begin MEASUREMENT ctr_chk_fuc_open "number of tests cfc with result filler cap open" UBYTE _CNV_A_R_LINEAR_____0_CM 1 100. 0. 255. DISPLAY_IDENTIFIER CTR_CHK_FUC_OPEN ECU_ADDRESS 0xd0008e11 FORMAT "%3.0" /end MEASUREMENT
/begin CHARACTERISTIC lc_cod_chk_fuc "calibration codebyte for check filler cap test" VALUE 0xa080c53c _REC_VAL_20_u1 255. _CNV_A_R_LINEAR_____0_CM 0. 255. DISPLAY_IDENTIFIER LC_COD_CHK_FUC FORMAT "%3.0" /end CHARACTERISTIC
/begin CHARACTERISTIC c_vs_ena_chk_fuc_open_max "max. vehicle speed to enable cfc test" VALUE 0xa080c4b8 _REC_VAL_20_u1 255. _CNV_A_R_LINEAR_____6_CM 0. 255. DISPLAY_IDENTIFIER C_VS_ENA_CHK_FUC_OPEN_MAX FORMAT "%3.0" /end CHARACTERISTIC
/begin CHARACTERISTIC c_vs_delta_chk_fuc_max "max. difference between two consecutive VS" VALUE 0xa080c48f _REC_VAL_20_u1 255. _CNV_A_R_LINEAR_____6_CM 0. 255. DISPLAY_IDENTIFIER C_VS_DELTA_CHK_FUC_MAX FORMAT "%3.0" /end CHARACTERISTIC
/begin CHARACTERISTIC c_ftl_delta_chk_fuc_max "max. difference between two consecutive FTL" VALUE 0xa080bd35 _REC_VAL_20_u1 126. _CNV_A_R_LINEAR_____75_CM 0. 126. DISPLAY_IDENTIFIER C_FTL_DELTA_CHK_FUC_MAX FORMAT "%3.0" /end CHARACTERISTIC
/begin CHARACTERISTIC c_ctr_dc_ena_chk_fuc_max "threshold for number of DC since CFC request" VALUE 0xa080bb40 _REC_VAL_20_u1 255. _CNV_A_R_LINEAR_____0_CM 0. 255. DISPLAY_IDENTIFIER C_CTR_DC_ENA_CHK_FUC_MAX FORMAT "%3.0" /end CHARACTERISTIC
/begin CHARACTERISTIC c_ctr_chk_fuc_open_max "threshold for number of tests cfc with result filler cap open" VALUE 0xa080bb23 _REC_VAL_20_u1 255. _CNV_A_R_LINEAR_____0_CM 0. 255. DISPLAY_IDENTIFIER C_CTR_CHK_FUC_OPEN_MAX FORMAT "%3.0" /end CHARACTERISTIC
/begin CHARACTERISTIC c_vs_chk_fuc_open_can_min "minimum vehicle speed for setting cfc lamp" VALUE 0xa080c48c _REC_VAL_20_u1 255. _CNV_A_R_LINEAR_____6_CM 0. 255. DISPLAY_IDENTIFIER C_VS_CHK_FUC_OPEN_CAN_MIN FORMAT "%3.0" /end CHARACTERISTIC
/begin CHARACTERISTIC c_vs_chk_fuc_open_max "maximum vehicle speed for setting the healing" VALUE 0xa080c48d _REC_VAL_20_u1 255. _CNV_A_R_LINEAR_____6_CM 0. 255. DISPLAY_IDENTIFIER C_VS_CHK_FUC_OPEN_MAX FORMAT "%3.0" /end CHARACTERISTIC
/begin CHARACTERISTIC c_t_vs_chk_fuc_open_can_min "maximum time for vehicle speed higher than threshold" VALUE 0xa080c298 _REC_VAL_20_u2 6553.5 _CNV_A_R_LINEAR_____4_CM 0. 6553.5 DISPLAY_IDENTIFIER C_T_VS_CHK_FUC_OPEN_CAN_MIN FORMAT "%6.1" /end CHARACTERISTIC
/begin CHARACTERISTIC c_t_vs_chk_fuc_open_min "maximum time for vehicle speed higher than threshold" VALUE 0xa080c29a _REC_VAL_20_u2 6553.5 _CNV_A_R_LINEAR_____4_CM 0. 6553.5 DISPLAY_IDENTIFIER C_T_VS_CHK_FUC_OPEN_MIN FORMAT "%6.1" /end CHARACTERISTIC
/begin CHARACTERISTIC c_t_chk_fuc_open_can "duration of setting the cfc lamp" VALUE 0xa080c140 _REC_VAL_20_u2 6553.5 _CNV_A_R_LINEAR_____4_CM 0. 6553.5 DISPLAY_IDENTIFIER C_T_CHK_FUC_OPEN_CAN FORMAT "%6.1" /end CHARACTERISTIC
/begin CHARACTERISTIC c_vs_ena_chk_fuc_open_min "min. vehicle speed to enable cfc test" VALUE 0xa080c4b9 _REC_VAL_20_u1 255. _CNV_A_R_LINEAR_____6_CM 0. 255. DISPLAY_IDENTIFIER C_VS_ENA_CHK_FUC_OPEN_MIN FORMAT "%3.0" /end CHARACTERISTIC
/begin CHARACTERISTIC c_amp_chk_fuc_max "max. delta ampient pressure for check filler cap" VALUE 0xa080ba82 _REC_VAL_20_u2 5434. _CNV_A_R_LINEAR_____27_CM 0. 5434. DISPLAY_IDENTIFIER C_AMP_CHK_FUC_MAX FORMAT "%7.2" /end CHARACTERISTIC
/begin MEASUREMENT ctr_dc_ena_chk_fuc "number of DC since CFC request" UBYTE _CNV_A_R_LINEAR_____0_CM 1 100. 0. 255. DISPLAY_IDENTIFIER CTR_DC_ENA_CHK_FUC ECU_ADDRESS 0xd0008e10 FORMAT "%3.0" /end MEASUREMENT
/begin MEASUREMENT amp_chk_fuc "" UWORD _CNV_A_R_LINEAR_____27_CM 1 100. 0. 5434. DISPLAY_IDENTIFIER AMP_CHK_FUC ECU_ADDRESS 0xd00004ce FORMAT "%7.2" /end MEASUREMENT
/begin MEASUREMENT load_clc "Calculated load" UBYTE _CNV_A_R_LINEAR_____5_CM 1 100. 0. 99.609375 DISPLAY_IDENTIFIER LOAD_CLC ECU_ADDRESS 0xd000812c FORMAT "%4.1" /end MEASUREMENT
/begin AXIS_PTS ldp_amp_ip_load_clc_amp "" 0xa08028dc amp _REC_AXS_20_u2 5434. _CNV_A_R_LINEAR_____27_CM 6 0. 5434. FORMAT "%7.2" /end AXIS_PTS
/begin AXIS_PTS ldp_n_32_ip_load_clc "" 0xa080290c n_32 _REC_AXS_20_u1 8160. _CNV_A_R_LINEAR_____10_CM 8 0. 8160. FORMAT "%4.0" /end AXIS_PTS
/begin AXIS_PTS ldp_maf_ip_load_clc "" 0xa08028f8 maf _REC_AXS_20_u2 1389. _CNV_A_R_LINEAR_____111_CM 8 0. 1389. FORMAT "%7.2" /end AXIS_PTS
/begin CHARACTERISTIC ip_load_clc_amp__amp "Atmospheric pressure ratio" CURVE 0xa0804eb0 _REC_CUR_20_u1_u2 1.99220002 _CNV_A_R_LINEAR_____100_CM 0. 1.99220002 DISPLAY_IDENTIFIER IP_LOAD_CLC_AMP__AMP FORMAT "%5.3"
 /begin AXIS_DESCR COM_AXIS amp _CNV_A_R_LINEAR_____27_CM 6 0. 5434. FORMAT "%7.2" AXIS_PTS_REF ldp_amp_ip_load_clc_amp /end AXIS_DESCR
/end CHARACTERISTIC
/begin CHARACTERISTIC ip_load_clc__n_32__maf "Airflow ratio" MAP 0xa0804e70 _REC_MAP_20_u1_u1_u2 0.99609375 _CNV_A_R_LINEAR_____28_CM 0. 0.99609375 DISPLAY_IDENTIFIER IP_LOAD_CLC__N_32__MAF FORMAT "%5.3"
 /begin AXIS_DESCR COM_AXIS n_32 _CNV_A_R_LINEAR_____10_CM 8 0. 8160. FORMAT "%4.0" AXIS_PTS_REF ldp_n_32_ip_load_clc /end AXIS_DESCR
 /begin AXIS_DESCR COM_AXIS maf _CNV_A_R_LINEAR_____111_CM 8 0. 1389. FORMAT "%7.2" AXIS_PTS_REF ldp_maf_ip_load_clc /end AXIS_DESCR
/end CHARACTERISTIC
/begin MEASUREMENT obd_tps_sp "Commanded throttle position" UBYTE _CNV_A_R_LINEAR_____5_CM 1 100. 0. 99.609375 DISPLAY_IDENTIFIER OBD_TPS_SP ECU_ADDRESS 0xd0008136 FORMAT "%4.1" /end MEASUREMENT
/begin MEASUREMENT obd_tps_rel "Relative throttle position" UBYTE _CNV_A_R_LINEAR_____5_CM 1 100. 0. 99.609375 DISPLAY_IDENTIFIER OBD_TPS_REL ECU_ADDRESS 0xd0008135 FORMAT "%4.1" /end MEASUREMENT
/begin MEASUREMENT obd_tps_2 "Absolute throttle position sensor 2" UBYTE _CNV_A_R_LINEAR_____5_CM 1 100. 0. 99.609375 DISPLAY_IDENTIFIER OBD_TPS_2 ECU_ADDRESS 0xd0008134 FORMAT "%4.1" /end MEASUREMENT
/begin MEASUREMENT obd_tps_1 "Absolute throttle position sensor 1" UBYTE _CNV_A_R_LINEAR_____5_CM 1 100. 0. 99.609375 DISPLAY_IDENTIFIER OBD_TPS_1 ECU_ADDRESS 0xd0008133 FORMAT "%4.1" /end MEASUREMENT
/begin MEASUREMENT obd_pv_2 "Accelerator pedal position (sensor 2)" UBYTE _CNV_A_R_LINEAR_____5_CM 1 100. 0. 99.609375 DISPLAY_IDENTIFIER OBD_PV_2 ECU_ADDRESS 0xd0008132 FORMAT "%4.1" /end MEASUREMENT
/begin MEASUREMENT obd_pv_1 "Accelerator pedal position (sensor 1)" UBYTE _CNV_A_R_LINEAR_____5_CM 1 100. 0. 99.609375 DISPLAY_IDENTIFIER OBD_PV_1 ECU_ADDRESS 0xd0008131 FORMAT "%4.1" /end MEASUREMENT
/begin CHARACTERISTIC c_ftl_ref_obd "Maximum possible FTL in the vehicle" VALUE 0xa080bd3f _REC_VAL_20_u1 126. _CNV_A_R_LINEAR_____75_CM 0. 126. DISPLAY_IDENTIFIER C_FTL_REF_OBD FORMAT "%3.0" /end CHARACTERISTIC
/begin CHARACTERISTIC c_maf_ref_obd "Maximum air mass concerning cyclinder displacement" VALUE 0xa080be4c _REC_VAL_20_u2 1389. _CNV_A_R_LINEAR_____111_CM 0. 1389. DISPLAY_IDENTIFIER C_MAF_REF_OBD FORMAT "%4.0" /end CHARACTERISTIC
/begin MEASUREMENT load_absv "Absolute load" UWORD _CNV_A_R_LINEAR_____475_CM 1 100. 0. 25700. DISPLAY_IDENTIFIER LOAD_ABSV ECU_ADDRESS 0xd000812a FORMAT "%8.2" /end MEASUREMENT
/begin MEASUREMENT obd_ftl "Fuel level input" UBYTE _CNV_A_R_LINEAR_____5_CM 1 100. 0. 99.609375 DISPLAY_IDENTIFIER OBD_FTL ECU_ADDRESS 0xd0008130 FORMAT "%4.1" /end MEASUREMENT
/begin MEASUREMENT obd_egr_dif "EGR actual - EGR commanded" UBYTE _CNV_A_R_LINEAR_____5_CM 1 100. 0. 99.609375 DISPLAY_IDENTIFIER OBD_EGR_DIF ECU_ADDRESS 0xd000812f FORMAT "%4.1" /end MEASUREMENT
/begin MEASUREMENT cat_max_diag_mod_6 "Actually threshold for Scantool Mod 6 Output" UBYTE _CNV_A_R_LINEAR_____266_CM 1 100. 0. 1.984375 DISPLAY_IDENTIFIER CAT_MAX_DIAG_MOD_6 ECU_ADDRESS 0xd0008702 FORMAT "%8.6" /end MEASUREMENT
/begin AXIS_PTS ldpm_opm_av "" 0xa0809750 opm_av _REC_AXS_20_u1 8. _CNV_A_R_LINEAR_____0_CM 8 0. 8. FORMAT "%1.0" /end AXIS_PTS
/begin MEASUREMENT lv_inh_diag_rbm_dmtl "Flag to inhibit DMTL diagnosis function if there is a OBD failure" UBYTE _CNV_S_2_RANGE__0___1_CM 1 100. 0. 1. DISPLAY_IDENTIFIER LV_INH_DIAG_RBM_DMTL ECU_ADDRESS 0xd0008e28 BIT_MASK 0x1 /end MEASUREMENT
/begin MEASUREMENT lv_chk_dmtl_cur_dmtl_vld_virt "Virtuel check of component concerning valid pump current" UBYTE _CNV_S_2_RANGE__0___1_CM 1 100. 0. 1. DISPLAY_IDENTIFIER LV_CHK_DMTL_CUR_DMTL_VLD_VIRT ECU_ADDRESS 0xd0008e2a BIT_MASK 0x1 /end MEASUREMENT
/begin MEASUREMENT lv_det_no_rough_leak "Condition leak check done and no rough leak detected" UBYTE _CNV_S_2_RANGE__0___1_CM 1 100. 0. 1. DISPLAY_IDENTIFIER LV_DET_NO_ROUGH_LEAK ECU_ADDRESS 0xd0008e2d BIT_MASK 0x1 /end MEASUREMENT
/begin MEASUREMENT t_ast_dmtl_rbm "Cumulative time since engine start for incrementation of the evaporative system monitor denominator" UWORD _CNV_A_R_LINEAR_____4_CM 1 100. 0. 6553.5 DISPLAY_IDENTIFIER T_AST_DMTL_RBM ECU_ADDRESS 0xd000aab8 FORMAT "%6.1" /end MEASUREMENT
/begin MEASUREMENT state_rbm_dmtlm "Interface of DMTLM  monitor with the Rate_based Monitoring statistics Bit 0, Bit1, Bit2" UBYTE _CNV_A_R_LINEAR_____0_CM 1 100. 0. 7. DISPLAY_IDENTIFIER STATE_RBM_DMTLM ECU_ADDRESS 0xd0008e2e FORMAT "%2.0" /end MEASUREMENT
/begin MEASUREMENT state_rbm_rough_leak "Interface of DMTLM  monitor with the Rate_based Monitoring statistics Bit 0, Bit1, Bit2" UBYTE _CNV_A_R_LINEAR_____0_CM 1 100. 0. 7. DISPLAY_IDENTIFIER STATE_RBM_ROUGH_LEAK ECU_ADDRESS 0xd0008e2f FORMAT "%2.0" /end MEASUREMENT
/begin MEASUREMENT state_rbm_small_leak "Interface of DMTLM  monitor with the Rate_based Monitoring statistics Bit 0, Bit1, Bit2" UBYTE _CNV_A_R_LINEAR_____0_CM 1 100. 0. 7. DISPLAY_IDENTIFIER STATE_RBM_SMALL_LEAK ECU_ADDRESS 0xd0008e30 FORMAT "%2.0" /end MEASUREMENT
/begin CHARACTERISTIC c_t_dly_ftl_dmtl_val "Delay time for a valid FTL for DML_RBM" VALUE 0xa080c170 _REC_VAL_20_u2 6553.5 _CNV_A_R_LINEAR_____4_CM 0. 6553.5 DISPLAY_IDENTIFIER C_T_DLY_FTL_DMTL_VAL FORMAT "%6.1" /end CHARACTERISTIC
/begin CHARACTERISTIC c_t_es_dmtl_diag_max "Maximum time for a DMTL diagnosis" VALUE 0xa080c1b4 _REC_VAL_20_u2 65535. _CNV_A_R_LINEAR_____84_CM 0. 65535. DISPLAY_IDENTIFIER C_T_ES_DMTL_DIAG_MAX FORMAT "%5.0" /end CHARACTERISTIC
/begin CHARACTERISTIC c_tam_max_dmtl_rbm "Maximum ambient temperature threshold for DMTL_RBM" VALUE 0xa080c2b2 _REC_VAL_20_u1 190.5 _CNV_A_R_LINEAR_____17_CM -48. 142.5 DISPLAY_IDENTIFIER C_TAM_MAX_DMTL_RBM FORMAT "%6.2" /end CHARACTERISTIC
/begin CHARACTERISTIC c_tam_st_hys_dmtl_rbm "Ambient temperature hysteresis for DMTL_RBM" VALUE 0xa080c2bb _REC_VAL_20_s1 191.25 _CNV_A_R_LINEAR_____25_CM -96. 95.25 DISPLAY_IDENTIFIER C_TAM_ST_HYS_DMTL_RBM FORMAT "%6.2" /end CHARACTERISTIC
/begin CHARACTERISTIC c_tco_st_min_dmtl_rbm "Minimum engine start temperature threshold for DMTL_RBM" VALUE 0xa080c2e3 _REC_VAL_20_u1 190.5 _CNV_A_R_LINEAR_____17_CM -48. 142.5 DISPLAY_IDENTIFIER C_TCO_ST_MIN_DMTL_RBM FORMAT "%6.2" /end CHARACTERISTIC
/begin CHARACTERISTIC c_tco_st_max_dmtl_rbm "Maximum engine start temperature threshold for DMTL_RBM" VALUE 0xa080c2e1 _REC_VAL_20_u1 190.5 _CNV_A_R_LINEAR_____17_CM -48. 142.5 DISPLAY_IDENTIFIER C_TCO_ST_MAX_DMTL_RBM FORMAT "%6.2" /end CHARACTERISTIC
/begin MEASUREMENT ctr_cnl_small_leak_mes_virt "Virtuel number of aborted miniature leak measurements dur to current fluctuations" UBYTE _CNV_A_R_LINEAR_____0_CM 1 100. 0. 255. DISPLAY_IDENTIFIER CTR_CNL_SMALL_LEAK_MES_VIRT ECU_ADDRESS 0xd0008e31 FORMAT "%3.0" /end MEASUREMENT
/begin CHARACTERISTIC c_t_ast_dmtl_rbm "Minimum comulative time since engine start for incrementation of the evaporative system monitor denominator" VALUE 0xa080c122 _REC_VAL_20_u2 6553.5 _CNV_A_R_LINEAR_____4_CM 0. 6553.5 DISPLAY_IDENTIFIER C_T_AST_DMTL_RBM FORMAT "%6.1" /end CHARACTERISTIC
/begin MEASUREMENT lv_ctr_cnl_small_leak_virt "Virtuel aborted miniature leak measurements due to current fluctuations exceeded" UBYTE _CNV_S_2_RANGE__0___1_CM 1 100. 0. 1. DISPLAY_IDENTIFIER LV_CTR_CNL_SMALL_LEAK_VIRT ECU_ADDRESS 0xd0008e29 BIT_MASK 0x1 /end MEASUREMENT
/begin MEASUREMENT lv_det_small_leak "Stored bit, that in the last DC small leak was recognized " UBYTE _CNV_S_2_RANGE__0___1_CM 1 100. 0. 1. DISPLAY_IDENTIFIER LV_DET_SMALL_LEAK ECU_ADDRESS 0xd0008e2b BIT_MASK 0x1 /end MEASUREMENT
/begin MEASUREMENT lv_det_no_small_leak "Stored bit, that in the last DC no small leak was recognized" UBYTE _CNV_S_2_RANGE__0___1_CM 1 100. 0. 1. DISPLAY_IDENTIFIER LV_DET_NO_SMALL_LEAK ECU_ADDRESS 0xd0008e2c BIT_MASK 0x1 /end MEASUREMENT
/begin CHARACTERISTIC c_tam_min_dmtl_rbm "Minimum ambient temperature threshold for DMTL_RBM" VALUE 0xa080c2b5 _REC_VAL_20_u1 190.5 _CNV_A_R_LINEAR_____17_CM -48. 142.5 DISPLAY_IDENTIFIER C_TAM_MIN_DMTL_RBM FORMAT "%6.2" /end CHARACTERISTIC
/begin CHARACTERISTIC c_cod_dmtl_rbm "configuration byte for DMTL RBM" VALUE 0xa080bab2 _REC_VAL_20_u1 255. _CNV_A_R_LINEAR_____0_CM 0. 255. DISPLAY_IDENTIFIER C_COD_DMTL_RBM FORMAT "%3.0" /end CHARACTERISTIC
/begin MEASUREMENT lv_inh_fup_mfp_plaus "Boolean flag to stop the plausibility check of FUP/MFP" UBYTE _CNV_S_2_RANGE__0___1_CM 1 100. 0. 1. DISPLAY_IDENTIFIER LV_INH_FUP_MFP_PLAUS ECU_ADDRESS 0xd00088a9 BIT_MASK 0x1 /end MEASUREMENT
/begin MEASUREMENT lv_inh_h_prs_sys "Boolean flag to stop the high pressure system monitoring" UBYTE _CNV_S_2_RANGE__0___1_CM 1 100. 0. 1. DISPLAY_IDENTIFIER LV_INH_H_PRS_SYS ECU_ADDRESS 0xd00088a8 BIT_MASK 0x1 /end MEASUREMENT
/begin MEASUREMENT lv_inh_vcv_plaus "Boolean flag to stop the VCV_PLAUS check" UBYTE _CNV_S_2_RANGE__0___1_CM 1 100. 0. 1. DISPLAY_IDENTIFIER LV_INH_VCV_PLAUS ECU_ADDRESS 0xd00088aa BIT_MASK 0x1 /end MEASUREMENT
/begin CHARACTERISTIC c_t_ast_h_prs_diag_inh "Inhibit time for deactivation of the high pressure system diagnosis" VALUE 0xa080c12e _REC_VAL_20_u2 6553.5 _CNV_A_R_LINEAR_____4_CM 0. 6553.5 DISPLAY_IDENTIFIER C_T_AST_H_PRS_DIAG_INH FORMAT "%6.1" /end CHARACTERISTIC
/begin CHARACTERISTIC c_abc_inc_fup_mfp_plaus "Increment of the plausibility check of FUP/MFP anti-bounce counter" VALUE 0xa080b940 _REC_VAL_20_u1 255. _CNV_A_R_LINEAR_____0_CM 0. 255. DISPLAY_IDENTIFIER C_ABC_INC_FUP_MFP_PLAUS FORMAT "%3.0" /end CHARACTERISTIC
/begin CHARACTERISTIC c_abc_inc_h_prs_sys "Increment of high pressure system monitoring anti-bounce counter" VALUE 0xa080b94c _REC_VAL_20_u1 255. _CNV_A_R_LINEAR_____0_CM 0. 255. DISPLAY_IDENTIFIER C_ABC_INC_H_PRS_SYS FORMAT "%3.0" /end CHARACTERISTIC
/begin CHARACTERISTIC c_abc_inc_vcv_plaus "Increment of the VCV adaptation check anti-bounce counter" VALUE 0xa080b996 _REC_VAL_20_u1 255. _CNV_A_R_LINEAR_____0_CM 0. 255. DISPLAY_IDENTIFIER C_ABC_INC_VCV_PLAUS FORMAT "%3.0" /end CHARACTERISTIC
/begin CHARACTERISTIC c_abc_max_vcv_plaus "Threshold to be reached, before VCV adaptation check error" VALUE 0xa080ba5f _REC_VAL_20_u1 254. _CNV_A_R_LINEAR_____0_CM 1. 255. DISPLAY_IDENTIFIER C_ABC_MAX_VCV_PLAUS FORMAT "%3.0" /end CHARACTERISTIC
/begin CHARACTERISTIC c_abc_max_fup_mfp_plaus "Threshold to be reached, before plausibility check error of FUP/MFP" VALUE 0xa080ba08 _REC_VAL_20_u1 254. _CNV_A_R_LINEAR_____0_CM 1. 255. DISPLAY_IDENTIFIER C_ABC_MAX_FUP_MFP_PLAUS FORMAT "%3.0" /end CHARACTERISTIC
/begin CHARACTERISTIC c_abc_max_h_prs_sys "Threshold to be reached, before permanently activating high pressure system monitoring error" VALUE 0xa080ba14 _REC_VAL_20_u1 254. _CNV_A_R_LINEAR_____0_CM 1. 255. DISPLAY_IDENTIFIER C_ABC_MAX_H_PRS_SYS FORMAT "%3.0" /end CHARACTERISTIC
/begin MEASUREMENT lv_err_fup_mfp_plaus "Boolean that indicates inconsistencies between fuel pressure and mass fuel pump" UBYTE _CNV_S_2_RANGE__0___1_CM 1 100. 0. 1. DISPLAY_IDENTIFIER LV_ERR_FUP_MFP_PLAUS ECU_ADDRESS 0xd000802d BIT_MASK 0x1 /end MEASUREMENT
/begin MEASUREMENT lv_err_h_prs_sys "Boolean that indicates abnormal fuel pressure value in fuel system" UBYTE _CNV_S_2_RANGE__0___1_CM 1 100. 0. 1. DISPLAY_IDENTIFIER LV_ERR_H_PRS_SYS ECU_ADDRESS 0xd000802e BIT_MASK 0x1 /end MEASUREMENT
/begin CHARACTERISTIC c_fup_bol_1 "Bottom fuel pressure threshold 1" VALUE 0xa080bd4c _REC_VAL_20_u2 347776. _CNV_A_R_LINEAR_____171_CM 0. 347776. DISPLAY_IDENTIFIER C_FUP_BOL_1 FORMAT "%6.0" /end CHARACTERISTIC
/begin CHARACTERISTIC c_fup_tol_1 "Top fuel pressure threshold 1" VALUE 0xa080bda0 _REC_VAL_20_u2 347776. _CNV_A_R_LINEAR_____171_CM 0. 347776. DISPLAY_IDENTIFIER C_FUP_TOL_1 FORMAT "%6.0" /end CHARACTERISTIC
/begin CHARACTERISTIC c_fup_tol_2 "Top fuel pressure threshold 2" VALUE 0xa080bda2 _REC_VAL_20_u2 347776. _CNV_A_R_LINEAR_____171_CM 0. 347776. DISPLAY_IDENTIFIER C_FUP_TOL_2 FORMAT "%6.0" /end CHARACTERISTIC
/begin CHARACTERISTIC c_n_32_fup_diag "Minimum engine speed for FUP/FPAPWM plausibility check (Default value 800)" VALUE 0xa080befc _REC_VAL_20_u1 8160. _CNV_A_R_LINEAR_____10_CM 0. 8160. DISPLAY_IDENTIFIER C_N_32_FUP_DIAG FORMAT "%4.0" /end CHARACTERISTIC
/begin CHARACTERISTIC c_n_32_fup_mfp_plaus_max "Maximum engine speed for the plausibility check" VALUE 0xa080beff _REC_VAL_20_u1 8160. _CNV_A_R_LINEAR_____10_CM 0. 8160. DISPLAY_IDENTIFIER C_N_32_FUP_MFP_PLAUS_MAX FORMAT "%4.0" /end CHARACTERISTIC
/begin CHARACTERISTIC c_n_32_fup_mfp_plaus_min "Minimum engine speed for the plausibility check" VALUE 0xa080bf00 _REC_VAL_20_u1 8160. _CNV_A_R_LINEAR_____10_CM 0. 8160. DISPLAY_IDENTIFIER C_N_32_FUP_MFP_PLAUS_MIN FORMAT "%4.0" /end CHARACTERISTIC
/begin CHARACTERISTIC c_prs_i_ctl_diag_min "Minimum threshold for integral part of the controller" VALUE 0xa080c088 _REC_VAL_20_s2 32.7675 _CNV_A_R_LINEAR_____801_CM -16.384 16.3835 DISPLAY_IDENTIFIER C_PRS_I_CTL_DIAG_MIN FORMAT "%8.4" /end CHARACTERISTIC
/begin CHARACTERISTIC c_prs_i_ctl_diag_max "Maximum threshold for integral part of the controller" VALUE 0xa080c086 _REC_VAL_20_s2 32.7675 _CNV_A_R_LINEAR_____801_CM -16.384 16.3835 DISPLAY_IDENTIFIER C_PRS_I_CTL_DIAG_MAX FORMAT "%8.4" /end CHARACTERISTIC
/begin MEASUREMENT vs_max_sel_ext_req "Selected maximum vehicle speed code via tester" UBYTE _CNV_A_R_LINEAR_____0_CM 1 100. 0. 3. DISPLAY_IDENTIFIER VS_MAX_SEL_EXT_REQ ECU_ADDRESS 0xd0008b4b FORMAT "%2.0" /end MEASUREMENT
/begin MEASUREMENT lv_err_amp_plaus "Boolean for detected error Ambient pressure plausibility diagnosis" UBYTE _CNV_S_2_RANGE__0___1_CM 1 100. 0. 1. DISPLAY_IDENTIFIER LV_ERR_AMP_PLAUS ECU_ADDRESS 0xd0007f0d BIT_MASK 0x1 /end MEASUREMENT
/begin MEASUREMENT amp_mmv_plaus "Mean moving value of AMP_MES" UWORD _CNV_A_R_LINEAR_____27_CM 1 100. 0. 5434. DISPLAY_IDENTIFIER AMP_MMV_PLAUS ECU_ADDRESS 0xd000036c FORMAT "%7.2" /end MEASUREMENT
/begin CHARACTERISTIC c_amp_plaus_dif_err "Maximum allowed offset to detect a unplausible AMP_MES" VALUE 0xa080ba8c _REC_VAL_20_u2 5434. _CNV_A_R_LINEAR_____27_CM 0. 5434. DISPLAY_IDENTIFIER C_AMP_PLAUS_DIF_ERR FORMAT "%7.2" /end CHARACTERISTIC
/begin AXIS_PTS ldp_vs_ip_clrc_amp_plaus "" 0xa08092ee vs _REC_AXS_20_u1 255. _CNV_A_R_LINEAR_____6_CM 4 0. 255. FORMAT "%3.0" /end AXIS_PTS
/begin CHARACTERISTIC ip_clrc_amp_plaus "Filter constant for mean moving calculation of AMP_MES" CURVE 0xa0809fa4 _REC_CUR_20_u2_u1 0.9999847412109381 _CNV_A_R_LINEAR_____89_CM 0. 0.9999847412109381 DISPLAY_IDENTIFIER IP_CLRC_AMP_PLAUS FORMAT "%7.6"
 /begin AXIS_DESCR COM_AXIS vs _CNV_A_R_LINEAR_____6_CM 4 0. 255. FORMAT "%3.0" AXIS_PTS_REF ldp_vs_ip_clrc_amp_plaus /end AXIS_DESCR
/end CHARACTERISTIC
/begin AXIS_PTS ldpm_state_pid_srv_1_2_obdc "" 0xa0808158 NO_INPUT_QUANTITY _REC_AXS_20_u1 255. _CNV_A_R_LINEAR_____50_CM 12 0. 255. /end AXIS_PTS
/begin CHARACTERISTIC c_n_32_max_clr_fmy_srv_4 "" VALUE 0xa08081b4 _REC_VAL_20_u1 8160. _CNV_A_R_LINEAR_____810_CM 0. 8160. DISPLAY_IDENTIFIER C_N_32_MAX_CLR_FMY_SRV_4 /end CHARACTERISTIC
/begin CHARACTERISTIC id_state_srv_1_pid "" CURVE 0xa0808168 _REC_CUR_20_u1_u1 255. _CNV_A_R_LINEAR_____50_CM 0. 255. DISPLAY_IDENTIFIER ID_STATE_SRV_1_PID
 /begin AXIS_DESCR COM_AXIS NO_INPUT_QUANTITY _CNV_A_R_LINEAR_____50_CM 12 0. 255. AXIS_PTS_REF ldpm_state_pid_srv_1_2_obdc /end AXIS_DESCR
/end CHARACTERISTIC
/begin CHARACTERISTIC id_state_srv_2_pid "" CURVE 0xa0808174 _REC_CUR_20_u1_u1 255. _CNV_A_R_LINEAR_____50_CM 0. 255. DISPLAY_IDENTIFIER ID_STATE_SRV_2_PID
 /begin AXIS_DESCR COM_AXIS NO_INPUT_QUANTITY _CNV_A_R_LINEAR_____50_CM 12 0. 255. AXIS_PTS_REF ldpm_state_pid_srv_1_2_obdc /end AXIS_DESCR
/end CHARACTERISTIC
/begin CHARACTERISTIC c_vls_down_afl_afr_sae "" VALUE 0xa08081b6 _REC_VAL_20_u2 4.9951171875 _CNV_A_R_LINEAR_____2_CM 0. 4.9951171875 DISPLAY_IDENTIFIER C_VLS_DOWN_AFL_AFR_SAE FORMAT "%5.3" /end CHARACTERISTIC
/begin CHARACTERISTIC c_vls_down_afr_afl_sae "" VALUE 0xa08081b8 _REC_VAL_20_u2 4.9951171875 _CNV_A_R_LINEAR_____2_CM 0. 4.9951171875 DISPLAY_IDENTIFIER C_VLS_DOWN_AFR_AFL_SAE FORMAT "%5.3" /end CHARACTERISTIC
/begin AXIS_PTS ldp_state_tid_id_state_srv_6 "" 0xa0808120 NO_INPUT_QUANTITY _REC_AXS_20_u1 255. _CNV_A_R_LINEAR_____50_CM 43 0. 255. /end AXIS_PTS
/begin CHARACTERISTIC id_state_srv_6_tid "Table of bytes which defines the OBDMIDs and TIDs supported by the service 06h - ISO 15765-4" CURVE 0xa0808180 _REC_CUR_20_u1_u1 255. _CNV_A_R_LINEAR_____50_CM 0. 255. DISPLAY_IDENTIFIER ID_STATE_SRV_6_TID
 /begin AXIS_DESCR COM_AXIS NO_INPUT_QUANTITY _CNV_A_R_LINEAR_____50_CM 43 0. 255. AXIS_PTS_REF ldp_state_tid_id_state_srv_6 /end AXIS_DESCR
/end CHARACTERISTIC
/begin AXIS_PTS ldp_state_tid_id_state_srv_8 "" 0xa080814c NO_INPUT_QUANTITY _REC_AXS_20_u1 255. _CNV_A_R_LINEAR_____50_CM 4 0. 255. /end AXIS_PTS
/begin CHARACTERISTIC id_state_srv_8_tid "" CURVE 0xa08081ac _REC_CUR_20_u1_u1 255. _CNV_A_R_LINEAR_____50_CM 0. 255. DISPLAY_IDENTIFIER ID_STATE_SRV_8_TID
 /begin AXIS_DESCR COM_AXIS NO_INPUT_QUANTITY _CNV_A_R_LINEAR_____50_CM 4 0. 255. AXIS_PTS_REF ldp_state_tid_id_state_srv_8 /end AXIS_DESCR
/end CHARACTERISTIC
/begin AXIS_PTS ldp_state_vit_id_state_srv_9 "" 0xa0808152 NO_INPUT_QUANTITY _REC_AXS_20_u1 255. _CNV_A_R_LINEAR_____50_CM 4 0. 255. /end AXIS_PTS
/begin CHARACTERISTIC id_state_srv_9_can_vit "" CURVE 0xa08081b0 _REC_CUR_20_u1_u1 255. _CNV_A_R_LINEAR_____50_CM 0. 255. DISPLAY_IDENTIFIER ID_STATE_SRV_9_CAN_VIT
 /begin AXIS_DESCR COM_AXIS NO_INPUT_QUANTITY _CNV_A_R_LINEAR_____50_CM 4 0. 255. AXIS_PTS_REF ldp_state_vit_id_state_srv_9 /end AXIS_DESCR
/end CHARACTERISTIC
/begin MEASUREMENT lv_err_efppwm_plaus "Boolean that indicates inconsistencies of the EFPPWM signal" UBYTE _CNV_S_2_RANGE__0___1_CM 1 100. 0. 1. DISPLAY_IDENTIFIER LV_ERR_EFPPWM_PLAUS ECU_ADDRESS 0xd0008033 BIT_MASK 0x1 /end MEASUREMENT
/begin MEASUREMENT lv_err_l_prs_sys "Boolean that indicates abnormal fuel pressure value in low pressure fuel system" UBYTE _CNV_S_2_RANGE__0___1_CM 1 100. 0. 1. DISPLAY_IDENTIFIER LV_ERR_L_PRS_SYS ECU_ADDRESS 0xd0008034 BIT_MASK 0x1 /end MEASUREMENT
/begin CHARACTERISTIC c_n_32_fup_efp_diag "Minimum engine speed for EFPPWM plausibility check (Default value 800)" VALUE 0xa080befe _REC_VAL_20_u1 8160. _CNV_A_R_LINEAR_____10_CM 0. 8160. DISPLAY_IDENTIFIER C_N_32_FUP_EFP_DIAG FORMAT "%4.0" /end CHARACTERISTIC
/begin CHARACTERISTIC c_fup_efp_bol_1 "Bottom fuel pressure threshold 1 " VALUE 0xa080bd54 _REC_VAL_20_u2 173888. _CNV_A_R_LINEAR_____173_CM 0. 173888. DISPLAY_IDENTIFIER C_FUP_EFP_BOL_1 FORMAT "%8.1" /end CHARACTERISTIC
/begin CHARACTERISTIC c_fup_efp_tol_1 "Top fuel pressure threshold 1" VALUE 0xa080bd76 _REC_VAL_20_u2 173888. _CNV_A_R_LINEAR_____173_CM 0. 173888. DISPLAY_IDENTIFIER C_FUP_EFP_TOL_1 FORMAT "%8.1" /end CHARACTERISTIC
/begin CHARACTERISTIC c_fup_efp_tol_2 "Top fuel pressure threshold 2" VALUE 0xa080bd78 _REC_VAL_20_u2 173888. _CNV_A_R_LINEAR_____173_CM 0. 173888. DISPLAY_IDENTIFIER C_FUP_EFP_TOL_2 FORMAT "%8.1" /end CHARACTERISTIC
/begin CHARACTERISTIC c_n_32_max_efppwm_plaus "Maximum engine speed for the plausibility check" VALUE 0xa080bf01 _REC_VAL_20_u1 8160. _CNV_A_R_LINEAR_____10_CM 0. 8160. DISPLAY_IDENTIFIER C_N_32_MAX_EFPPWM_PLAUS FORMAT "%4.0" /end CHARACTERISTIC
/begin CHARACTERISTIC c_n_32_min_efppwm_plaus "Minimum engine speed for the plausibility check" VALUE 0xa080bf07 _REC_VAL_20_u1 8160. _CNV_A_R_LINEAR_____10_CM 0. 8160. DISPLAY_IDENTIFIER C_N_32_MIN_EFPPWM_PLAUS FORMAT "%4.0" /end CHARACTERISTIC
/begin CHARACTERISTIC c_n_32_max_l_prs_sys "Maximum engine speed for the plausibility check" VALUE 0xa080bf04 _REC_VAL_20_u1 8160. _CNV_A_R_LINEAR_____10_CM 0. 8160. DISPLAY_IDENTIFIER C_N_32_MAX_L_PRS_SYS FORMAT "%4.0" /end CHARACTERISTIC
/begin CHARACTERISTIC c_n_32_min_l_prs_sys "Minimum engine speed for the plausibility check" VALUE 0xa080bf0a _REC_VAL_20_u1 8160. _CNV_A_R_LINEAR_____10_CM 0. 8160. DISPLAY_IDENTIFIER C_N_32_MIN_L_PRS_SYS FORMAT "%4.0" /end CHARACTERISTIC
/begin CHARACTERISTIC c_efppwm_i_diag_min "Minimum threshold for I-part of the EFPPWM" VALUE 0xa080bc72 _REC_VAL_20_s2 99.99847412109381 _CNV_A_R_LINEAR_____113_CM -50. 49.9984741210938 DISPLAY_IDENTIFIER C_EFPPWM_I_DIAG_MIN FORMAT "%7.3" /end CHARACTERISTIC
/begin CHARACTERISTIC c_efppwm_i_diag_max "Maximum threshold for I-part of the EFPPWM" VALUE 0xa080bc70 _REC_VAL_20_s2 99.99847412109381 _CNV_A_R_LINEAR_____113_CM -50. 49.9984741210938 DISPLAY_IDENTIFIER C_EFPPWM_I_DIAG_MAX FORMAT "%7.3" /end CHARACTERISTIC
/begin CHARACTERISTIC c_efppwm_i_ad_diag_min "Minimum threshold for adaptive I-part of the EFPPWM" VALUE 0xa080bc6a _REC_VAL_20_s2 99.99847412109381 _CNV_A_R_LINEAR_____113_CM -50. 49.9984741210938 DISPLAY_IDENTIFIER C_EFPPWM_I_AD_DIAG_MIN FORMAT "%7.3" /end CHARACTERISTIC
/begin CHARACTERISTIC c_efppwm_i_ad_diag_max "Maximum threshold for adaptive I-part of the EFPPWM" VALUE 0xa080bc68 _REC_VAL_20_s2 99.99847412109381 _CNV_A_R_LINEAR_____113_CM -50. 49.9984741210938 DISPLAY_IDENTIFIER C_EFPPWM_I_AD_DIAG_MAX FORMAT "%7.3" /end CHARACTERISTIC
/begin CHARACTERISTIC c_efppwm_min_ad_diag_min "Minimum threshold for adaptive minimum EFPPWM" VALUE 0xa080bc88 _REC_VAL_20_u2 99.99847412109381 _CNV_A_R_LINEAR_____8_CM 0. 99.99847412109381 DISPLAY_IDENTIFIER C_EFPPWM_MIN_AD_DIAG_MIN /end CHARACTERISTIC
/begin CHARACTERISTIC c_efppwm_min_ad_diag_max "Minimum threshold for adaptive minimum EFPPWM" VALUE 0xa080bc86 _REC_VAL_20_u2 99.99847412109381 _CNV_A_R_LINEAR_____8_CM 0. 99.99847412109381 DISPLAY_IDENTIFIER C_EFPPWM_MIN_AD_DIAG_MAX /end CHARACTERISTIC
/begin CHARACTERISTIC lc_efppwm_min_ena "Logical constant for enabling of the minimum EFPPWM" VALUE 0xa080c556 _REC_VAL_20_u1 1. _CNV_A_R_LINEAR_____0_CM 0. 1. DISPLAY_IDENTIFIER LC_EFPPWM_MIN_ENA FORMAT "%1.0" /end CHARACTERISTIC
/begin CHARACTERISTIC lc_efppwm_i_ad_ena "Logical constant for enabling of the I-Part adaptive" VALUE 0xa080c554 _REC_VAL_20_u1 1. _CNV_A_R_LINEAR_____0_CM 0. 1. DISPLAY_IDENTIFIER LC_EFPPWM_I_AD_ENA FORMAT "%1.0" /end CHARACTERISTIC
/begin CHARACTERISTIC c_tco_max_efppwm_plaus "Maximum temperature for the plausibility check" VALUE 0xa080c2ca _REC_VAL_20_u1 190.5 _CNV_A_R_LINEAR_____17_CM -48. 142.5 DISPLAY_IDENTIFIER C_TCO_MAX_EFPPWM_PLAUS FORMAT "%6.2" /end CHARACTERISTIC
/begin CHARACTERISTIC c_tco_min_efppwm_plaus "Minimum temperature for the plausibility check" VALUE 0xa080c2d1 _REC_VAL_20_u1 190.5 _CNV_A_R_LINEAR_____17_CM -48. 142.5 DISPLAY_IDENTIFIER C_TCO_MIN_EFPPWM_PLAUS FORMAT "%6.2" /end CHARACTERISTIC
/begin CHARACTERISTIC c_t_ast_fup_efp_diag "Time for inhibit diagnosis for the low pressure system" VALUE 0xa080c128 _REC_VAL_20_u2 6553.5 _CNV_A_R_LINEAR_____4_CM 0. 6553.5 DISPLAY_IDENTIFIER C_T_AST_FUP_EFP_DIAG FORMAT "%6.1" /end CHARACTERISTIC
/begin CHARACTERISTIC c_ftl_min_efppwm_plaus_diag "Minimum fuel tank level for the EFPPWM plausibility diagnosis" VALUE 0xa080bd3d _REC_VAL_20_u1 127. _CNV_A_R_LINEAR_____75_CM 0. 127. DISPLAY_IDENTIFIER C_FTL_MIN_EFPPWM_PLAUS_DIAG FORMAT "%3.0" /end CHARACTERISTIC
/begin CHARACTERISTIC c_ftl_min_l_prs_sys_diag "Minimum fuel tank level for the low pressure system diagnosis" VALUE 0xa080bd3e _REC_VAL_20_u1 127. _CNV_A_R_LINEAR_____75_CM 0. 127. DISPLAY_IDENTIFIER C_FTL_MIN_L_PRS_SYS_DIAG FORMAT "%3.0" /end CHARACTERISTIC
/begin CHARACTERISTIC c_abc_inc_efppwm_plaus "Increment of the plausibility check of EFPPWM anti-bounce counter" VALUE 0xa080b93a _REC_VAL_20_u1 255. _CNV_A_R_LINEAR_____0_CM 0. 255. DISPLAY_IDENTIFIER C_ABC_INC_EFPPWM_PLAUS FORMAT "%3.0" /end CHARACTERISTIC
/begin CHARACTERISTIC c_abc_inc_l_prs_sys "Increment of low pressure system monitoring anti-bounce counter" VALUE 0xa080b954 _REC_VAL_20_u1 255. _CNV_A_R_LINEAR_____0_CM 0. 255. DISPLAY_IDENTIFIER C_ABC_INC_L_PRS_SYS FORMAT "%3.0" /end CHARACTERISTIC
/begin CHARACTERISTIC c_abc_max_efppwm_plaus "Threshold to be reached, before plausibility check error of EFPPWM" VALUE 0xa080ba02 _REC_VAL_20_u1 254. _CNV_A_R_LINEAR_____0_CM 1. 255. DISPLAY_IDENTIFIER C_ABC_MAX_EFPPWM_PLAUS FORMAT "%3.0" /end CHARACTERISTIC
/begin CHARACTERISTIC c_abc_max_l_prs_sys "Threshold to be reached, before permanently activating low pressure system monitoring error " VALUE 0xa080ba1c _REC_VAL_20_u1 254. _CNV_A_R_LINEAR_____0_CM 1. 255. DISPLAY_IDENTIFIER C_ABC_MAX_L_PRS_SYS FORMAT "%3.0" /end CHARACTERISTIC
/begin CHARACTERISTIC c_vls_down_cyc_min_sae "" VALUE 0xa080c45f _REC_VAL_20_u1 1.275 _CNV_A_R_LINEAR_____926_CM 0. 1.275 DISPLAY_IDENTIFIER C_VLS_DOWN_CYC_MIN_SAE FORMAT "%5.3" /end CHARACTERISTIC
/begin CHARACTERISTIC c_vls_down_cyc_max_sae "" VALUE 0xa080c45e _REC_VAL_20_u1 1.275 _CNV_A_R_LINEAR_____926_CM 0. 1.275 DISPLAY_IDENTIFIER C_VLS_DOWN_CYC_MAX_SAE FORMAT "%5.3" /end CHARACTERISTIC
/begin CHARACTERISTIC c_n_max_clc_MDBAPRIO_10MS "Engine speed threshold for runtime reduction on funktion call MDBAPRIO_10MS" VALUE 0xa080bf6e _REC_VAL_20_u2 8160. _CNV_A_R_LINEAR_____14_CM 0. 8160. DISPLAY_IDENTIFIER C_N_MAX_CLC_MDBAPRIO_10MS FORMAT "%4.0" /end CHARACTERISTIC
/begin CHARACTERISTIC c_n_hys_clc_MDBAPRIO_10MS "Engine speed hysteresis for runtime reduction on funktion call MDBAPRIO_10MS" VALUE 0xa080bf42 _REC_VAL_20_u2 8160. _CNV_A_R_LINEAR_____14_CM 0. 8160. DISPLAY_IDENTIFIER C_N_HYS_CLC_MDBAPRIO_10MS FORMAT "%4.0" /end CHARACTERISTIC
/begin CHARACTERISTIC c_n_max_clc_AUSY_TURB_SEG "Engine speed threshold for runtime reduction on funktion call AUSY_TURB_SEG" VALUE 0xa080bf64 _REC_VAL_20_u2 8160. _CNV_A_R_LINEAR_____14_CM 0. 8160. DISPLAY_IDENTIFIER C_N_MAX_CLC_AUSY_TURB_SEG FORMAT "%4.0" /end CHARACTERISTIC
/begin CHARACTERISTIC c_n_hys_clc_AUSY_TURB_SEG "Engine speed hysteresis for runtime reduction on funktion call AUSY_TURB_SEG" VALUE 0xa080bf38 _REC_VAL_20_u2 8160. _CNV_A_R_LINEAR_____14_CM 0. 8160. DISPLAY_IDENTIFIER C_N_HYS_CLC_AUSY_TURB_SEG FORMAT "%4.0" /end CHARACTERISTIC
/begin CHARACTERISTIC c_n_max_clc_WESE_SEG "Engine speed threshold for runtime reduction on funktion call WESE_SEG" VALUE 0xa080bf78 _REC_VAL_20_u2 8160. _CNV_A_R_LINEAR_____14_CM 0. 8160. DISPLAY_IDENTIFIER C_N_MAX_CLC_WESE_SEG FORMAT "%4.0" /end CHARACTERISTIC
/begin CHARACTERISTIC c_n_hys_clc_WESE_SEG "Engine speed hysteresis for runtime reduction on funktion call WESE_SEG" VALUE 0xa080bf4c _REC_VAL_20_u2 8160. _CNV_A_R_LINEAR_____14_CM 0. 8160. DISPLAY_IDENTIFIER C_N_HYS_CLC_WESE_SEG FORMAT "%4.0" /end CHARACTERISTIC
/begin CHARACTERISTIC c_n_max_clc_MDRK_SEG "Engine speed threshold for runtime reduction on funktion call MDRK_SEG" VALUE 0xa080bf70 _REC_VAL_20_u2 8160. _CNV_A_R_LINEAR_____14_CM 0. 8160. DISPLAY_IDENTIFIER C_N_MAX_CLC_MDRK_SEG FORMAT "%4.0" /end CHARACTERISTIC
/begin CHARACTERISTIC c_n_hys_clc_MDRK_SEG "Engine speed hysteresis for runtime reduction on funktion call MDRK_SEG" VALUE 0xa080bf44 _REC_VAL_20_u2 8160. _CNV_A_R_LINEAR_____14_CM 0. 8160. DISPLAY_IDENTIFIER C_N_HYS_CLC_MDRK_SEG FORMAT "%4.0" /end CHARACTERISTIC
/begin CHARACTERISTIC c_n_max_clc_KLANN_20MS "Engine speed threshold for runtime reduction on funktion call KLANN_20MS" VALUE 0xa080bf68 _REC_VAL_20_u2 8160. _CNV_A_R_LINEAR_____14_CM 0. 8160. DISPLAY_IDENTIFIER C_N_MAX_CLC_KLANN_20MS FORMAT "%4.0" /end CHARACTERISTIC
/begin CHARACTERISTIC c_n_hys_clc_KLANN_20MS "Engine speed hysteresis for runtime reduction on funktion call KLANN_20MS" VALUE 0xa080bf3c _REC_VAL_20_u2 8160. _CNV_A_R_LINEAR_____14_CM 0. 8160. DISPLAY_IDENTIFIER C_N_HYS_CLC_KLANN_20MS FORMAT "%4.0" /end CHARACTERISTIC
/begin CHARACTERISTIC c_n_max_clc_EISY_VERD_SEG "Engine speed threshold for runtime reduction on funktion call EISY_VERD_SEG" VALUE 0xa080bf66 _REC_VAL_20_u2 8160. _CNV_A_R_LINEAR_____14_CM 0. 8160. DISPLAY_IDENTIFIER C_N_MAX_CLC_EISY_VERD_SEG FORMAT "%4.0" /end CHARACTERISTIC
/begin CHARACTERISTIC c_n_hys_clc_EISY_VERD_SEG "Engine speed hysteresis for runtime reduction on funktion call EISY_VERD_SEG" VALUE 0xa080bf3a _REC_VAL_20_u2 8160. _CNV_A_R_LINEAR_____14_CM 0. 8160. DISPLAY_IDENTIFIER C_N_HYS_CLC_EISY_VERD_SEG FORMAT "%4.0" /end CHARACTERISTIC
/begin CHARACTERISTIC c_n_max_clc_MDBAFAK_10MS "Engine speed threshold for runtime reduction on funktion call MDBAFAK_10MS" VALUE 0xa080bf6a _REC_VAL_20_u2 8160. _CNV_A_R_LINEAR_____14_CM 0. 8160. DISPLAY_IDENTIFIER C_N_MAX_CLC_MDBAFAK_10MS FORMAT "%4.0" /end CHARACTERISTIC
/begin CHARACTERISTIC c_n_hys_clc_MDBAFAK_10MS "Engine speed hysteresis for runtime reduction on funktion call MDBAFAK_10MS" VALUE 0xa080bf3e _REC_VAL_20_u2 8160. _CNV_A_R_LINEAR_____14_CM 0. 8160. DISPLAY_IDENTIFIER C_N_HYS_CLC_MDBAFAK_10MS FORMAT "%4.0" /end CHARACTERISTIC
/begin CHARACTERISTIC c_n_max_clc_MDBANL_10MS "Engine speed threshold for runtime reduction on funktion call MDBANL_10MS" VALUE 0xa080bf6c _REC_VAL_20_u2 8160. _CNV_A_R_LINEAR_____14_CM 0. 8160. DISPLAY_IDENTIFIER C_N_MAX_CLC_MDBANL_10MS FORMAT "%4.0" /end CHARACTERISTIC
/begin CHARACTERISTIC c_n_hys_clc_MDBANL_10MS "Engine speed hysteresis for runtime reduction on funktion call MDBANL_10MS" VALUE 0xa080bf40 _REC_VAL_20_u2 8160. _CNV_A_R_LINEAR_____14_CM 0. 8160. DISPLAY_IDENTIFIER C_N_HYS_CLC_MDBANL_10MS FORMAT "%4.0" /end CHARACTERISTIC
/begin CHARACTERISTIC c_n_max_clc_ULVREG_10MS "Engine speed threshold for runtime reduction on funktion call ULVREG_10MS" VALUE 0xa080bf76 _REC_VAL_20_u2 8160. _CNV_A_R_LINEAR_____14_CM 0. 8160. DISPLAY_IDENTIFIER C_N_MAX_CLC_ULVREG_10MS FORMAT "%4.0" /end CHARACTERISTIC
/begin CHARACTERISTIC c_n_hys_clc_ULVREG_10MS "Engine speed hysteresis for runtime reduction on funktion call ULVREG_10MS" VALUE 0xa080bf4a _REC_VAL_20_u2 8160. _CNV_A_R_LINEAR_____14_CM 0. 8160. DISPLAY_IDENTIFIER C_N_HYS_CLC_ULVREG_10MS FORMAT "%4.0" /end CHARACTERISTIC
/begin CHARACTERISTIC c_n_max_clc_RAILKO_10MS "Engine speed threshold for runtime reduction on funktion call RAILKO_10MS" VALUE 0xa080bf72 _REC_VAL_20_u2 8160. _CNV_A_R_LINEAR_____14_CM 0. 8160. DISPLAY_IDENTIFIER C_N_MAX_CLC_RAILKO_10MS FORMAT "%4.0" /end CHARACTERISTIC
/begin CHARACTERISTIC c_n_hys_clc_RAILKO_10MS "Engine speed hysteresis for runtime reduction on funktion call RAILKO_10MS" VALUE 0xa080bf46 _REC_VAL_20_u2 8160. _CNV_A_R_LINEAR_____14_CM 0. 8160. DISPLAY_IDENTIFIER C_N_HYS_CLC_RAILKO_10MS FORMAT "%4.0" /end CHARACTERISTIC
/begin CHARACTERISTIC c_n_max_clc_ULVOUT_10MS "Engine speed threshold for runtime reduction on funktion call ULVOUT_10MS" VALUE 0xa080bf74 _REC_VAL_20_u2 8160. _CNV_A_R_LINEAR_____14_CM 0. 8160. DISPLAY_IDENTIFIER C_N_MAX_CLC_ULVOUT_10MS FORMAT "%4.0" /end CHARACTERISTIC
/begin CHARACTERISTIC c_n_hys_clc_ULVOUT_10MS "Engine speed hysteresis for runtime reduction on funktion call ULVOUT_10MS" VALUE 0xa080bf48 _REC_VAL_20_u2 8160. _CNV_A_R_LINEAR_____14_CM 0. 8160. DISPLAY_IDENTIFIER C_N_HYS_CLC_ULVOUT_10MS FORMAT "%4.0" /end CHARACTERISTIC
/begin COMPU_METHOD _CNV_A_R_LINEAR_____0_CM "" RAT_FUNC "%6.3" "-" COEFFS 0 1. 0. 0 0 1 /end COMPU_METHOD
/begin COMPU_METHOD _CNV_S_2_RANGE__0___1_CM "" TAB_VERB "%6.3" "-" COMPU_TAB_REF _CNV_S_2_RANGE__0___1 /end COMPU_METHOD
/begin COMPU_VTAB _CNV_S_2_RANGE__0___1 "" TAB_VERB 2 0 "0" 1 "1" /end COMPU_VTAB
/begin COMPU_METHOD _CNV_A_R_LINEAR_____2_CM "" RAT_FUNC "%6.3" "V" COEFFS 0 204.8 0. 0 0 1 /end COMPU_METHOD
/begin COMPU_METHOD _CNV_A_R_LINEAR_____3_CM "" RAT_FUNC "%6.3" "s" COEFFS 0 100. 0. 0 0 1 /end COMPU_METHOD
/begin COMPU_METHOD _CNV_A_R_LINEAR_____4_CM "" RAT_FUNC "%6.3" "s" COEFFS 0 10. 0. 0 0 1 /end COMPU_METHOD
/begin COMPU_METHOD _CNV_A_R_LINEAR_____5_CM "" RAT_FUNC "%6.3" "%" COEFFS 0 2.56 0. 0 0 1 /end COMPU_METHOD
/begin COMPU_METHOD _CNV_A_R_LINEAR_____6_CM "" RAT_FUNC "%6.3" "km/h" COEFFS 0 1. 0. 0 0 1 /end COMPU_METHOD
/begin COMPU_METHOD _CNV_A_R_LINEAR_____8_CM "" RAT_FUNC "%6.3" "%" COEFFS 0 655.3599999999997 0. 0 0 1 /end COMPU_METHOD
/begin COMPU_METHOD _CNV_A_R_LINEAR_____9_CM "" RAT_FUNC "%6.3" "-" COEFFS 0 32767.99999999992 0. 0 0 1 /end COMPU_METHOD
/begin COMPU_METHOD _CNV_A_R_LINEAR_____10_CM "" RAT_FUNC "%6.3" "rpm" COEFFS 0 3.125e-002 0. 0 0 1 /end COMPU_METHOD
/begin COMPU_METHOD _CNV_A_R_LINEAR_____14_CM "" RAT_FUNC "%6.3" "rpm" COEFFS 0 1. 0. 0 0 1 /end COMPU_METHOD
/begin COMPU_METHOD _CNV_A_R_LINEAR_____17_CM "" RAT_FUNC "%6.3" "°C" COEFFS 0 1.333333333333333 64. 0 0 1 /end COMPU_METHOD
/begin COMPU_METHOD _CNV_A_R_LINEAR_____20_CM "" RAT_FUNC "%6.3" "ms" COEFFS 0 0.1 0. 0 0 1 /end COMPU_METHOD
/begin COMPU_METHOD _CNV_A_R_LINEAR_____25_CM "" RAT_FUNC "%6.3" "°C" COEFFS 0 1.333333333333333 0. 0 0 1 /end COMPU_METHOD
/begin COMPU_METHOD _CNV_A_R_LINEAR_____27_CM "" RAT_FUNC "%6.3" "hPa" COEFFS 0 12.06017666543982 0. 0 0 1 /end COMPU_METHOD
/begin COMPU_METHOD _CNV_A_R_LINEAR_____28_CM "" RAT_FUNC "%6.3" "-" COEFFS 0 256. 0. 0 0 1 /end COMPU_METHOD
/begin COMPU_METHOD _CNV_A_R_LINEAR_____36_CM "" RAT_FUNC "%6.3" "s" COEFFS 0 1. 0. 0 0 1 /end COMPU_METHOD
/begin COMPU_METHOD _CNV_A_R_LINEAR_____37_CM "" RAT_FUNC "%6.3" "V" COEFFS 0 9.807692307692308 0. 0 0 1 /end COMPU_METHOD
/begin COMPU_METHOD _CNV_A_R_LINEAR_____50_CM "" RAT_FUNC "%6.3" "" COEFFS 0 1. 0. 0 0 1 /end COMPU_METHOD
/begin COMPU_METHOD _CNV_R_R_Def_km_sw__68_CM "Def_km_sw_q10" RAT_FUNC "%6.3" "km" COEFFS 0. 1. 0. 0. 0. 10. /end COMPU_METHOD
/begin COMPU_METHOD _CNV_A_R_LINEAR_____75_CM "" RAT_FUNC "%6.3" "l" COEFFS 0 1. 0. 0 0 1 /end COMPU_METHOD
/begin COMPU_METHOD _CNV_S_2_RANGE______76_CM "" TAB_VERB "%6.3" "" COMPU_TAB_REF _CNV_S_2_RANGE______76 /end COMPU_METHOD
/begin COMPU_VTAB _CNV_S_2_RANGE______76 "" TAB_VERB 2 0 "0" 1 "1" /end COMPU_VTAB
/begin COMPU_METHOD _CNV_A_R_LINEAR_____84_CM "" RAT_FUNC "%6.3" "min" COEFFS 0 1. 0. 0 0 1 /end COMPU_METHOD
/begin COMPU_METHOD _CNV_A_R_LINEAR_____89_CM "" RAT_FUNC "%6.3" "-" COEFFS 0 65535.99999999996 0. 0 0 1 /end COMPU_METHOD
/begin COMPU_METHOD _CNV_A_R_LINEAR_____100_CM "" RAT_FUNC "%6.3" "-" COEFFS 0 127.9991955827809 0. 0 0 1 /end COMPU_METHOD
/begin COMPU_METHOD _CNV_A_R_LINEAR_____103_CM "" RAT_FUNC "%6.3" "-" COEFFS 0 128. 0. 0 0 1 /end COMPU_METHOD
/begin COMPU_METHOD _CNV_A_R_LINEAR_____111_CM "" RAT_FUNC "%6.3" "mg/stk" COEFFS 0 47.18142548596112 0. 0 0 1 /end COMPU_METHOD
/begin COMPU_METHOD _CNV_A_R_LINEAR_____113_CM "" RAT_FUNC "%6.3" "%" COEFFS 0 655.3599999999997 -1.455191522836685e-011 0 0 1 /end COMPU_METHOD
/begin COMPU_METHOD _CNV_A_R_LINEAR_____146_CM "" RAT_FUNC "%6.3" "hPa" COEFFS 0 12.05960017121163 0. 0 0 1 /end COMPU_METHOD
/begin COMPU_METHOD _CNV_A_R_LINEAR_____147_CM "" RAT_FUNC "%6.3" "mA" COEFFS 0 163.8400395206126 7.904122518084478e-003 0 0 1 /end COMPU_METHOD
/begin COMPU_METHOD _CNV_A_R_LINEAR_____148_CM "" RAT_FUNC "%6.3" "mA" COEFFS 0 163.8375 0. 0 0 1 /end COMPU_METHOD
/begin COMPU_METHOD _CNV_A_R_LINEAR_____149_CM "" RAT_FUNC "%6.3" "l" COEFFS 0 15.25879531537405 0. 0 0 1 /end COMPU_METHOD
/begin COMPU_METHOD _CNV_A_R_LINEAR_____150_CM "" RAT_FUNC "%6.3" "l" COEFFS 0 15.26190476190476 0. 0 0 1 /end COMPU_METHOD
/begin COMPU_METHOD _CNV_A_R_LINEAR_____151_CM "" RAT_FUNC "%6.3" "ohm" COEFFS 0 5.1 0. 0 0 1 /end COMPU_METHOD
/begin COMPU_METHOD _CNV_A_R_LINEAR_____152_CM "" RAT_FUNC "%6.3" "h" COEFFS 0 35999.99999497086 0. 0 0 1 /end COMPU_METHOD
/begin COMPU_METHOD _CNV_S_13_STATE_DMTL_153_CM "" TAB_VERB "%6.3" "-" COMPU_TAB_REF _CNV_S_13_STATE_DMTL_153 /end COMPU_METHOD
/begin COMPU_VTAB _CNV_S_13_STATE_DMTL_153 "" TAB_VERB 13 0 "START" 1 "REF_LEAK_MES" 2 "ROUGH_LEAK_MES" 3 "ROUGH_LEAK_MES_LEN" 4 "ROUGH_LEAK_MES_END" 5 "SMALL_LEAK_MES" 6 "SMALL_LEAK_MES_LEN" 7 "2.REF_LEAK_MES" 8 "TANK_PROOFED" 9 "SMALL_LEAK" 10 "ROUGH_LEAK" 11 "MODULE_ERROR" 12 "END" /end COMPU_VTAB
/begin COMPU_METHOD _CNV_A_R_LINEAR_____154_CM "" RAT_FUNC "%6.3" "mA" COEFFS 0 10737418.2375 0. 0 0 1 /end COMPU_METHOD
/begin COMPU_METHOD _CNV_A_R_LINEAR_____155_CM "" RAT_FUNC "%6.3" "V" COEFFS 0 2510.769230769231 0. 0 0 1 /end COMPU_METHOD
/begin COMPU_METHOD _CNV_A_R_LINEAR_____156_CM "" RAT_FUNC "%6.3" "m" COEFFS 0 1. 0. 0 0 1 /end COMPU_METHOD
/begin COMPU_METHOD _CNV_A_R_LINEAR_____157_CM "" RAT_FUNC "%6.3" "V" COEFFS 0 2520.615410935313 0. 0 0 1 /end COMPU_METHOD
/begin COMPU_METHOD _CNV_A_R_LINEAR_____158_CM "" RAT_FUNC "%6.3" "m" COEFFS 0 65537. 0. 0 0 1 /end COMPU_METHOD
/begin COMPU_METHOD _CNV_A_R_LINEAR_____162_CM "" RAT_FUNC "%6.3" "kg/h" COEFFS 0 8192. 0. 0 0 1 /end COMPU_METHOD
/begin COMPU_METHOD _CNV_A_R_LINEAR_____163_CM "" RAT_FUNC "%6.3" "cyc" COEFFS 0 1. 0. 0 0 1 /end COMPU_METHOD
/begin COMPU_METHOD _CNV_A_R_LINEAR_____164_CM "" RAT_FUNC "%6.3" "kg/h" COEFFS 0 8191.874997772622 1. 0 0 1 /end COMPU_METHOD
/begin COMPU_METHOD _CNV_A_R_LINEAR_____165_CM "" RAT_FUNC "%6.3" "-" COEFFS 0 65535. 0. 0 0 1 /end COMPU_METHOD
/begin COMPU_METHOD _CNV_S_6_STATE_DIAG_166_CM "" TAB_VERB "%6.3" "-" COMPU_TAB_REF _CNV_S_6_STATE_DIAG_166 /end COMPU_METHOD
/begin COMPU_VTAB _CNV_S_6_STATE_DIAG_166 "" TAB_VERB 6 0 "STEP_INIT" 1 "STEP_1" 2 "STEP_2" 3 "STEP_3" 4 "CPS_RAMP" 5 "LOCK_STEP" /end COMPU_VTAB
/begin COMPU_METHOD _CNV_A_R_LINEAR_____167_CM "" RAT_FUNC "%6.3" "hPa" COEFFS 0 25.6 0. 0 0 1 /end COMPU_METHOD
/begin COMPU_METHOD _CNV_A_R_LINEAR_____171_CM "" RAT_FUNC "%6.3" "hPa" COEFFS 0 0.1884402603974972 0. 0 0 1 /end COMPU_METHOD
/begin COMPU_METHOD _CNV_A_R_LINEAR_____173_CM "" RAT_FUNC "%6.3" "hPa" COEFFS 0 0.3768805207949945 0. 0 0 1 /end COMPU_METHOD
/begin COMPU_METHOD _CNV_A_R_LINEAR_____233_CM "" RAT_FUNC "%6.3" "rpm" COEFFS 0 0.5 0. 0 0 1 /end COMPU_METHOD
/begin COMPU_METHOD _CNV_A_R_LINEAR_____234_CM "" RAT_FUNC "%6.3" "Ah" COEFFS 0 2.007874015748032 0. 0 0 1 /end COMPU_METHOD
/begin COMPU_METHOD _CNV_A_R_LINEAR_____242_CM "" RAT_FUNC "%6.3" "kg/h" COEFFS 0 256. 0. 0 0 1 /end COMPU_METHOD
/begin COMPU_METHOD _CNV_A_R_LINEAR_____266_CM "" RAT_FUNC "%6.3" "-" COEFFS 0 64. 0. 0 0 1 /end COMPU_METHOD
/begin COMPU_METHOD _CNV_A_R_LINEAR_____272_CM "Battery voltage" RAT_FUNC "%6.3" "V" COEFFS 0 9.846153846153847 0. 0 0 1 /end COMPU_METHOD
/begin COMPU_METHOD _CNV_A_R_EGCP_LINEA_354_CM "" RAT_FUNC "%6.3" "-" COEFFS 0 100. 0. 0 0 1 /end COMPU_METHOD
/begin COMPU_METHOD _CNV_A_R_LINEAR_____422_CM "" RAT_FUNC "%6.3" "-" COEFFS 0 1000. 0. 0 0 1 /end COMPU_METHOD
/begin COMPU_METHOD _CNV_S_10_STATE_EOL__423_CM "" TAB_VERB "%6.3" "" COMPU_TAB_REF _CNV_S_10_STATE_EOL__423 /end COMPU_METHOD
/begin COMPU_VTAB _CNV_S_10_STATE_EOL__423 "" TAB_VERB 10 0 "ACT" 1 "ST_INH" 2 "PAR_NOT_PLAUS" 3 "WAIT_REL" 4 "UNDEF" 5 "NOT_START" 6 "END_WOUT_RESULT" 7 "ABORTED" 8 "END_WOUT_ERR" 9 "END_WITH_ERR" /end COMPU_VTAB
/begin COMPU_METHOD _CNV_A_R_LINEAR_____425_CM "" RAT_FUNC "%6.3" "V" COEFFS 0 10. 0. 0 0 1 /end COMPU_METHOD
/begin COMPU_METHOD _CNV_A_R_LINEAR_____426_CM "" RAT_FUNC "%6.3" "ms" COEFFS 0 12.5 0. 0 0 1 /end COMPU_METHOD
/begin COMPU_METHOD _CNV_A_R_LINEAR_____427_CM "" RAT_FUNC "%6.3" "°CRK" COEFFS 0 1.25 160. 0 0 1 /end COMPU_METHOD
/begin COMPU_METHOD _CNV_R_R_Def_km_ub__428_CM "Def_km_ub_q1000" RAT_FUNC "%6.3" "km" COEFFS 0. 1. 0. 0. 0. 1000. /end COMPU_METHOD
/begin COMPU_METHOD _CNV_A_R_ACRC_LINEA_431_CM "" RAT_FUNC "%6.3" "%" COEFFS 0 40.96 0. 0 0 1 /end COMPU_METHOD
/begin COMPU_METHOD _CNV_A_R_INJR_LINEA_432_CM "" RAT_FUNC "%6.3" "mJ" COEFFS 0 257. 0. 0 0 1 /end COMPU_METHOD
/begin COMPU_METHOD _CNV_A_R_LINEAR_____475_CM "" RAT_FUNC "%6.3" "%" COEFFS 0 2.55 0. 0 0 1 /end COMPU_METHOD
/begin COMPU_METHOD _CNV_A_R_LINEAR_____801_CM "" RAT_FUNC "%6.3" "MPa" COEFFS 0 2000. 0. 0 0 1 /end COMPU_METHOD
/begin COMPU_METHOD _CNV_A_R_LINEAR_____810_CM "" RAT_FUNC "%6.3" "rev" COEFFS 0 3.125e-002 0. 0 0 1 /end COMPU_METHOD
/begin COMPU_METHOD _CNV_A_R_LINEAR_____926_CM "" RAT_FUNC "%6.3" "V" COEFFS 0 200. 0. 0 0 1 /end COMPU_METHOD
/begin RECORD_LAYOUT _REC_VAL_20_u1 FNC_VALUES 1 UBYTE COLUMN_DIR DIRECT /end RECORD_LAYOUT
/begin RECORD_LAYOUT _REC_VAL_20_u2 FNC_VALUES 1 UWORD COLUMN_DIR DIRECT /end RECORD_LAYOUT
/begin RECORD_LAYOUT _REC_AXS_20_u1 NO_AXIS_PTS_X 1 UBYTE AXIS_PTS_X 2 UBYTE INDEX_INCR DIRECT /end RECORD_LAYOUT
/begin RECORD_LAYOUT _REC_MAP_20_u2_u1_u1 FNC_VALUES 1 UWORD COLUMN_DIR DIRECT /end RECORD_LAYOUT
/begin RECORD_LAYOUT _REC_CUR_20_u1_u1 FNC_VALUES 1 UBYTE COLUMN_DIR DIRECT /end RECORD_LAYOUT
/begin RECORD_LAYOUT _REC_VAL_20_s2 FNC_VALUES 1 SWORD COLUMN_DIR DIRECT /end RECORD_LAYOUT
/begin RECORD_LAYOUT _REC_MAP_20_u2_u2_u1 FNC_VALUES 1 UWORD COLUMN_DIR DIRECT /end RECORD_LAYOUT
/begin RECORD_LAYOUT _REC_AXS_20_u2 NO_AXIS_PTS_X 1 UWORD AXIS_PTS_X 2 UWORD INDEX_INCR DIRECT /end RECORD_LAYOUT
/begin RECORD_LAYOUT _REC_CUR_20_u2_u1 FNC_VALUES 1 UWORD COLUMN_DIR DIRECT /end RECORD_LAYOUT
/begin RECORD_LAYOUT _REC_CUR_20_u2_u2 FNC_VALUES 1 UWORD COLUMN_DIR DIRECT /end RECORD_LAYOUT
/begin RECORD_LAYOUT _REC_VAL_20_s1 FNC_VALUES 1 SBYTE COLUMN_DIR DIRECT /end RECORD_LAYOUT
/begin RECORD_LAYOUT _REC_CUR_20_u1_u2 FNC_VALUES 1 UBYTE COLUMN_DIR DIRECT /end RECORD_LAYOUT
/begin RECORD_LAYOUT _REC_VAL_20_u4 FNC_VALUES 1 ULONG COLUMN_DIR DIRECT /end RECORD_LAYOUT
/begin RECORD_LAYOUT _REC_MAP_20_u1_u1_u2 FNC_VALUES 1 UBYTE COLUMN_DIR DIRECT /end RECORD_LAYOUT
/begin FUNCTION OBD_Tank_leakage_diagnosis_based_on_DMTL "_Tank leakage diagnosis based on DMTL"
 /begin DEF_CHARACTERISTIC c_amp_dmtl_max c_cod_2_dmtl c_crlc_cur_dmtl_fil c_crlc_cur_dmtl_fil_lim c_crlc_cur_dmtl_fil_refu c_crlc_vb_dmtl_fil c_crlc_vb_dmtl_fil_lim c_cur_dmtl_cor_fil_ofs_amp c_cur_dmtl_dif_cur_dmtl_stat c_cur_dmtl_ref_leak_max c_cur_dmtl_ref_leak_min c_cur_dmtl_ref_ofs c_ena_fco_diag c_fco_diag_max c_fco_diag_min c_ftl_dec_ftl_diag_min c_ftl_diag_max c_ftl_diag_min c_ftl_dmtl_max c_ftl_dmtl_min c_hys_ftl_dmtl c_r_dmtl c_sum_rep_leak_mes_fuc_max c_t_cur_dmtl_rough_leak_max c_t_cur_dmtl_rough_leak_min c_t_cur_dmtl_stat c_t_dly_cur_dmtl_dif_mes c_t_dly_det_refu c_t_dly_dmtls c_t_dly_es_pwl c_t_dly_fuc_can_off c_t_dly_fuc_can_on c_t_dly_igk_ftl c_t_dly_req_pwl_dmtl c_t_dmtl_eol_max c_t_dmtl_max c_t_ref_leak_mes_max c_t_ref_leak_mes_rep_max c_t_vb_dly_dmtl c_tam_dmtl_min c_tco_st_dmtl_min c_trt_dmtl_eol_max c_vb_dmtl_asa_max c_vb_dmtl_asa_min c_vb_dmtl_max c_vs_ftl_diag_max c_t_act_small_leak ip_t_act_small_leak__ftl ip_fac_cur_dmtl_ref ip_t_cur_dmtl_stat c_t_ref_test_rough_leak c_fac_t_cur_dmtl_stat_len ip_fac_cur_dmtl c_cl_dmtl_max c_vs_fuc_can_min c_vs_dmtl_max c_sum_cnl_leak_mes_fuc_max c_sum_cnl_small_leak_mes_max c_cur_dmtl_ref_dif_max c_cur_dmtl_dif_thd_refu c_cur_dmtl_dif_thd_fuc c_cur_dmtl_dif_thd_mes c_dist_refu_rough_leak_min c_t_dly_stop_refu c_t_ena_dr_dmtl_max ip_t_act_rough_leak ip_t_act_rough_leak_chk_fuc c_t_act_rough_leak c_t_act_rough_leak_chk_fuc c_vb_dmtl_dif c_vb_dmtl_dif_chk_fuc c_t_ast_dmtl_max c_t_ast_dmtl_chk_fuc c_t_ena_dmtl_chk_fuc c_tam_dmtl_max c_tam_dmtl_chk_fuc_min c_vb_dmtl_min c_vb_dmtl_chk_fuc_min c_vb_dmtl_chk_fuc_max ip_fac_cur_dmtl_rough ip_fac_cur_dmtl_chk_fuc_rough c_cod_dmtl c_tco_st_dmtl_cold c_ctr_tco_st_dmtl_min /end DEF_CHARACTERISTIC
 /begin OUT_MEASUREMENT ctr_cnl_rough_leak_mes_fuc ctr_cur_dmtl_ref_dif_max ctr_rep_rough_leak_mes_fuc cur_dmtl cur_dmtl_comp_rough_leak cur_dmtl_comp_small_leak_len cur_dmtl_cor_fil_max cur_dmtl_cor_fil_min cur_dmtl_cor_fil_refu_hpf cur_dmtl_dif cur_dmtl_dif_ref_rough_leak cur_dmtl_ref_leak cur_dmtl_rough_leak_len_end cur_dmtl_rough_leak_min cur_dmtl_thd_rough_leak_len fco_av_dmtl state_dmtl t_act_cur_dmtl_stat t_act_leak_mes t_act_ref_leak_mes cur_dmtl_dmtls_test cur_dmtl_thd_rough_leak cur_dmtl_thd_dmtls_test cur_dmtl_cor cur_dmtl_cor_fil vb_dmtl_ref vb_dmtl_fil ftl_ini ftl_old dmtl_priv_state_1.bitfield.lv_cur_dmtl_dmtls_test dmtl_priv_state_1.bitfield.lv_cur_dmtl_ref_mes_max dmtl_priv_state_1.bitfield.lv_cur_dmtl_ref_mes_min dmtl_priv_state_1.bitfield.lv_dist_dmtl dmtl_priv_state_1.bitfield.lv_dmtl_asa dmtl_priv_state_1.bitfield.lv_dmtl_eol dmtl_priv_state_1.bitfield.lv_dmtl_pump_on dmtl_priv_state_1.bitfield.lv_dmtl_rst_rough_leak dmtl_priv_state_1.bitfield.lv_dmtls_on dmtl_priv_state_1.bitfield.lv_dr_dmtl dmtl_priv_state_1.bitfield.lv_dr_dmtl_pump dmtl_priv_state_1.bitfield.lv_ena_fco_diag dmtl_priv_state_1.bitfield.lv_ena_ftl_diag dmtl_priv_state_2.bitfield.lv_ena_fuc_rough_leak_mes dmtl_priv_state_2.bitfield.lv_ena_main_dmtl dmtl_priv_state_2.bitfield.lv_ena_main_dmtl_fuc dmtl_priv_state_2.bitfield.lv_ena_rough_leak_1 dmtl_priv_state_2.bitfield.lv_ena_rough_leak_2 dmtl_priv_state_2.bitfield.lv_ena_rough_leak_3 dmtl_priv_state_2.bitfield.lv_ena_rough_leak_mes dmtl_priv_state_2.bitfield.lv_ena_rough_leak_mes_only dmtl_priv_state_2.bitfield.lv_ena_small_leak_1 dmtl_priv_state_2.bitfield.lv_ena_small_leak_mes_end dmtl_priv_state_2.bitfield.lv_fco_diag_max dmtl_priv_state_2.bitfield.lv_fco_diag_min dmtl_priv_state_2.bitfield.lv_fco_h_ftl dmtl_priv_state_2.bitfield.lv_ftl_dec dmtl_priv_state_2.bitfield.lv_ftl_dec_igk_on dmtl_priv_state_2.bitfield.lv_ftl_dmtl_max dmtl_priv_state_2.bitfield.lv_ftl_dmtl_min dmtl_priv_state_3.bitfield.lv_ftl_dyn dmtl_priv_state_3.bitfield.lv_ftl_inc dmtl_priv_state_3.bitfield.lv_ftl_inc_igk_on dmtl_priv_state_3.bitfield.lv_no_purge_dr_dmtl dmtl_priv_state_3.bitfield.lv_no_purge_dmtl_rough_leak dmtl_priv_state_3.bitfield.lv_no_purge_dmtl_small_leak dmtl_priv_state_4.bitfield.lv_ref_leak_rough_leak_susp dmtl_priv_state_4.bitfield.lv_refu_1 dmtl_priv_state_4.bitfield.lv_refu_end dmtl_priv_state_4.bitfield.lv_refu_rls_diag dmtl_priv_state_4.bitfield.lv_refu_val_1 dmtl_priv_state_4.bitfield.lv_req_ena_rough_leak dmtl_priv_state_4.bitfield.lv_req_pwl_rough_leak dmtl_priv_state_4.bitfield.lv_req_pwl_small_leak dmtl_priv_state_4.bitfield.lv_req_rough_leak dmtl_priv_state_4.bitfield.lv_small_leak_mes_len dmtl_priv_state_4.bitfield.lv_t_dly_dmtl_pwl dmtl_glob_state_1.bitfield.lv_ctr_cnl_small_leak_mes dmtl_glob_state_1.bitfield.lv_cur_dmtl_ref_dif_max dmtl_glob_state_1.bitfield.lv_cur_dmtl_thd_dif_mes dmtl_glob_state_1.bitfield.lv_det_fuc_open dmtl_glob_state_1.bitfield.lv_det_refu dmtl_glob_state_1.bitfield.lv_dist_det_rough_leak dmtl_glob_state_1.bitfield.lv_dmtl_act dmtl_glob_state_1.bitfield.lv_dmtl_stop dmtl_glob_state_1.bitfield.lv_ena_fuc dmtl_glob_state_1.bitfield.lv_ena_leak_dmtl dmtl_glob_state_1.bitfield.lv_ena_small_leak_mes dmtl_glob_state_1.bitfield.lv_err_det_dmtl_max dmtl_glob_state_1.bitfield.lv_err_det_dmtl_min dmtl_glob_state_1.bitfield.lv_err_det_rough_leak_min dmtl_glob_state_1.bitfield.lv_err_ftl_int dmtl_glob_state_1.bitfield.lv_err_ftl_plaus_int dmtl_glob_state_1.bitfield.lv_err_sig_dmtl dmtl_glob_state_1.bitfield.lv_ftl_diag dmtl_glob_state_1.bitfield.lv_fuc_can dmtl_glob_state_1.bitfield.lv_fuc_open dmtl_glob_state_1.bitfield.lv_no_purge_dmtl dmtl_glob_state_1.bitfield.lv_refu_dmtl dmtl_glob_state_1.bitfield.lv_rough_leak_susp_int dmtl_glob_state_1.bitfield.lv_chk_dmtl_cur_dmtl_vld dmtl_glob_state_1.bitfield.lv_chk_dmtl_vld dmtl_glob_state_1.bitfield.lv_err_det_small_leak_min dmtl_glob_state_1.bitfield.lv_ftl_dmtl_val dmtl_glob_state_1.bitfield.lv_cyc_rough_leak_susp_int dmtl_glob_state_2.bitfield.lv_req_pwl_dmtl dmtl_glob_state_2.bitfield.lv_rough_leak_susp_set dmtl_glob_state_2.bitfield.lv_sdr_dmtl dmtl_glob_state_2.bitfield.lv_t_dmtl_max dmtl_glob_state_2.bitfield.lv_vb_dif_max dmtl_glob_state_2.bitfield.lv_dr_dmtls dmtl_glob_state_2.bitfield.lv_vb_range_dmtl dmtl_glob_state_2.bitfield.lv_cyc_rough_leak_mode6 dmtl_glob_state_2.bitfield.lv_rough_leak_mes_len dmtl_glob_state_2.bitfield.lv_cyc_small_leak_mode6 dmtl_glob_state_2.bitfield.lv_refu_int dmtl_glob_state_2.bitfield.lv_refu_val_int dmtl_glob_state_2.bitfield.lv_ena_chk_fuc_rough_leak cur_dmtl_small_leak_end cur_dmtl_ref_dif_max ctr_cnl_small_leak_mes ctr_ena_dmtl_chk_fuc dist_dmtl cur_dmtl_rough_leak_min_eol cur_dmtl_cor_fil_eol lv_err_rough_leak lv_err_small_leak lv_dmtls lv_hdmtl_on lv_dmtl_pump lv_tco_st_dmtl ctr_tco_st_dmtl lv_err_dmtlm /end OUT_MEASUREMENT
/end FUNCTION
/begin FUNCTION OBD_Application_incidence_catalyst_efficiency_diagnosis__OSC_Method_ "_Application incidence catalyst efficiency diagnosis (OSC Method)" /end FUNCTION
/begin FUNCTION OBD_Application_incidences_for_fuel_system_diagnosis "_Application incidences for fuel system diagnosis" /end FUNCTION
/begin FUNCTION OBD_Environmental_Data "_Environmental Data" /end FUNCTION
/begin FUNCTION OBD_Failure_class "_Failure class" /end FUNCTION
/begin FUNCTION OBD_Diagnostic_Trouble_Code "_Diagnostic Trouble Code" /end FUNCTION
/begin FUNCTION OBD_Functional_Check_CPS "_Functional Check CPS"
 /begin DEF_CHARACTERISTIC c_tco_min_diagcps_1 id_opm_av_diagcps c_cl_mmv_diagcps c_flow_sp_diagcps_maf c_flow_sp_diagcps_n c_lgrd_flow_sp_neg_diagcps c_lgrd_flow_sp_pos_diagcps c_n_dif_diagcps c_sum_flow_sp_diagcps_max c_sum_diagcps_max c_t_diagcps_maf c_t_diagcps_dly c_crlc_maf_sp_tqi_diagcps c_maf_sp_tqi_dyw_diagcps c_maf_max_diagcps c_tco_min_diagcps c_sum_diagcps_eol c_t_inh_map_ctl_diagcps c_ti_lam_diagcps_dif c_map_diagcps_1 c_maf_diagcps_2 c_map_diagcps_2 c_t_diagcps_n_map_1 c_t_diagcps_n_map_2 c_t_diagcps_n_map_3 c_t_diagcps_n_map_4 lc_diagcps_map_act_opm_2 c_n_diagcps_2 c_sum_n_diag_diagcps_ofs c_sum_map_diag_diagcps_ofs c_sum_maf_diag_diagcps_ofs c_map_dip_sp_mmv_diagcps c_t_cl_mmv_diagcps c_t_cl_mmv_diagcps_2 /end DEF_CHARACTERISTIC
 /begin OUT_MEASUREMENT lv_inh_diagcps lv_di_diagcps state_rbm_diagcps lv_inh_diag_rbm_diagcps opm_av_diagcps flow_sp_cp_diagcps lv_act_diagcps lv_maf_diagcps_0 lv_supp_accin_diagcps maf_diagcps n_diagcps sum_flow_sp_diagcps_eol sum_flow_sp_diagcps sum_diag_diagcps_eol sum_diag_diagcps t_diagcps_dly t_diagcps_maf maf_sp_tqi_mmv_diagcps lv_maf_sp_tqi_dyw_diagcps flow_sp_cps_old sum_diag_diagcps_sae maf_diagcps_sae maf_diagcps_thd_sae cl_mmv_sae lv_eol_cps_err lv_err_diagcps lv_n_dif_diagcps lv_end_rbm_diagcps lv_map_dif_diagcps lv_inh_map_ctl_diagcps lv_lam_diagcps lv_lam_sum_diagcps map_diagcps sum_n_diag_diagcps t_diagcps_lam_1 ti_lam_diagcps_dif[0] ti_lam_diagcps_dif[1] ti_lam_diagcps_max[0] ti_lam_diagcps_max[1] ti_lam_diagcps_min[0] ti_lam_diagcps_min[1] state_diagcps state_diagcps_rbm sum_map_diag_diagcps sum_n_diag_diagcps_ofs sum_map_diag_diagcps_ofs sum_maf_diag_diagcps_ofs t_diagcps_n_map_1 t_diagcps_n_map_2 t_diagcps_n_map_3 lv_maf_diagcps_1 lv_opm_av_diagcps_p_thr t_cl_mmv_diagcps t_cl_mmv_diagcps_2 /end OUT_MEASUREMENT
/end FUNCTION
/begin FUNCTION OBD_SA_system_diagnosis_through_SAF___determination "_SA system diagnosis through SAF - determination"
 /begin DEF_CHARACTERISTIC c_saf_diag_max c_saf_diag_min c_n_max_clc_MDBAPRIO_10MS c_n_hys_clc_MDBAPRIO_10MS c_n_max_clc_AUSY_TURB_SEG c_n_hys_clc_AUSY_TURB_SEG c_n_max_clc_WESE_SEG c_n_hys_clc_WESE_SEG c_n_max_clc_MDRK_SEG c_n_hys_clc_MDRK_SEG c_n_max_clc_KLANN_20MS c_n_hys_clc_KLANN_20MS c_n_max_clc_EISY_VERD_SEG c_n_hys_clc_EISY_VERD_SEG c_n_max_clc_MDBAFAK_10MS c_n_hys_clc_MDBAFAK_10MS c_n_max_clc_MDBANL_10MS c_n_hys_clc_MDBANL_10MS c_n_max_clc_ULVREG_10MS c_n_hys_clc_ULVREG_10MS c_n_max_clc_RAILKO_10MS c_n_hys_clc_RAILKO_10MS c_n_max_clc_ULVOUT_10MS c_n_hys_clc_ULVOUT_10MS /end DEF_CHARACTERISTIC
/end FUNCTION
/begin FUNCTION OBD_Application_incidences_for_SA_system_monitoring_through_SAFM "_Application incidences for SA system monitoring through SAFM" /begin OUT_MEASUREMENT lv_inh_diag_ebox_cfa /end OUT_MEASUREMENT /end FUNCTION
/begin FUNCTION OBD_Application_incidence_environmental_data "_Application incidence environmental data"
 /begin DEF_CHARACTERISTIC ip_load_clc_amp__amp ip_load_clc__n_32__maf c_ftl_ref_obd c_maf_ref_obd /end DEF_CHARACTERISTIC
 /begin OUT_MEASUREMENT load_clc obd_tps_sp obd_tps_rel obd_tps_2 obd_tps_1 obd_pv_2 obd_pv_1 load_absv obd_ftl obd_egr_dif /end OUT_MEASUREMENT
/end FUNCTION
/begin FUNCTION OBD_Check_filler_cap___conditions_and_failure "_Check filler cap - conditions and failure"
 /begin DEF_CHARACTERISTIC c_ctr_ena_dmtl_chk_fuc lc_cod_chk_fuc c_vs_ena_chk_fuc_open_max c_vs_delta_chk_fuc_max c_ftl_delta_chk_fuc_max c_ctr_dc_ena_chk_fuc_max c_ctr_chk_fuc_open_max c_vs_chk_fuc_open_can_min c_vs_chk_fuc_open_max c_t_vs_chk_fuc_open_can_min c_t_vs_chk_fuc_open_min c_t_chk_fuc_open_can c_vs_ena_chk_fuc_open_min c_amp_chk_fuc_max /end DEF_CHARACTERISTIC
 /begin OUT_MEASUREMENT lv_rough_leak_susp_chk_fuc lv_ctr_dc_chk_fuc lv_ena_chk_fuc_refu lv_ena_chk_fuc_rough_leak_mes lv_chk_fuc_close lv_chk_fuc_open lv_chk_fuc_end lv_t_vs_chk_fuc_open_can lv_t_vs_chk_fuc_open_max lv_chk_fuc_open_act lv_rep_chk_fuc lv_chk_fuc_open_can lv_err_chk_fuc ctr_chk_fuc_open ctr_dc_ena_chk_fuc amp_chk_fuc /end OUT_MEASUREMENT
/end FUNCTION
/begin FUNCTION OBD_Application_incidences_of_tank_leakage_diagnosis ""
 /begin DEF_CHARACTERISTIC c_t_dly_ftl_dmtl_val c_t_es_dmtl_diag_max c_tam_max_dmtl_rbm c_tam_st_hys_dmtl_rbm c_tco_st_min_dmtl_rbm c_tco_st_max_dmtl_rbm c_t_ast_dmtl_rbm c_tam_min_dmtl_rbm c_cod_dmtl_rbm /end DEF_CHARACTERISTIC
 /begin OUT_MEASUREMENT lv_inh_diag_rbm_dmtl lv_chk_dmtl_cur_dmtl_vld_virt lv_det_no_rough_leak t_ast_dmtl_rbm state_rbm_dmtlm state_rbm_rough_leak state_rbm_small_leak ctr_cnl_small_leak_mes_virt lv_ctr_cnl_small_leak_virt lv_det_small_leak lv_det_no_small_leak /end OUT_MEASUREMENT
/end FUNCTION
/begin FUNCTION OBD_Ambient_pressure_plausibility_diagnosis "_Ambient pressure plausibility diagnosis" /begin DEF_CHARACTERISTIC c_amp_plaus_dif_err ip_clrc_amp_plaus /end DEF_CHARACTERISTIC /begin OUT_MEASUREMENT lv_err_amp_plaus amp_mmv_plaus /end OUT_MEASUREMENT /end FUNCTION
/begin FUNCTION OBD_Fuel_sys_pres_diag "_Fuel_sys_pres_diag"
 /begin DEF_CHARACTERISTIC c_fup_bol_1 c_fup_tol_1 c_fup_tol_2 c_n_32_fup_diag c_n_32_fup_mfp_plaus_max c_n_32_fup_mfp_plaus_min c_prs_i_ctl_diag_min c_prs_i_ctl_diag_max /end DEF_CHARACTERISTIC
 /begin OUT_MEASUREMENT lv_err_fup_mfp_plaus lv_err_h_prs_sys /end OUT_MEASUREMENT
/end FUNCTION
/begin FUNCTION OBD_Fuel_sys_pres_diag_AI "_Fuel_sys_pres_diag_AI"
 /begin DEF_CHARACTERISTIC c_t_ast_h_prs_diag_inh c_abc_inc_fup_mfp_plaus c_abc_inc_h_prs_sys c_abc_inc_vcv_plaus c_abc_max_vcv_plaus c_abc_max_fup_mfp_plaus c_abc_max_h_prs_sys /end DEF_CHARACTERISTIC
 /begin OUT_MEASUREMENT lv_inh_fup_mfp_plaus lv_inh_h_prs_sys lv_inh_vcv_plaus /end OUT_MEASUREMENT
/end FUNCTION
/begin FUNCTION OBD_FUP_EFP_Diag ""
 /begin DEF_CHARACTERISTIC c_n_32_fup_efp_diag c_fup_efp_bol_1 c_fup_efp_tol_1 c_fup_efp_tol_2 c_n_32_max_efppwm_plaus c_n_32_min_efppwm_plaus c_n_32_max_l_prs_sys c_n_32_min_l_prs_sys c_efppwm_i_diag_min c_efppwm_i_diag_max c_efppwm_i_ad_diag_min c_efppwm_i_ad_diag_max c_efppwm_min_ad_diag_min c_efppwm_min_ad_diag_max lc_efppwm_min_ena lc_efppwm_i_ad_ena c_tco_max_efppwm_plaus c_tco_min_efppwm_plaus c_t_ast_fup_efp_diag c_ftl_min_efppwm_plaus_diag c_ftl_min_l_prs_sys_diag /end DEF_CHARACTERISTIC
 /begin OUT_MEASUREMENT lv_err_efppwm_plaus lv_err_l_prs_sys /end OUT_MEASUREMENT
/end FUNCTION
/begin FUNCTION OBD_FUP_EFP_Diag__AI ""
 /begin DEF_CHARACTERISTIC c_abc_inc_efppwm_plaus c_abc_inc_l_prs_sys c_abc_max_efppwm_plaus c_abc_max_l_prs_sys /end DEF_CHARACTERISTIC
/end FUNCTION
/begin FUNCTION C_I_SEC "C_I_SEC"
 /begin SUB_FUNCTION SEC_Idle_Speed_Setpoint_offset_by_tester__KWP_ SEC_Input_Output_Control SEC_Constants_for_EOBD SEC_Immobilizer /end SUB_FUNCTION
/end FUNCTION
/begin FUNCTION SEC_Idle_Speed_Setpoint_offset_by_tester__KWP_ "_Idle Speed Setpoint offset by tester (KWP)"
 /begin DEF_CHARACTERISTIC c_n_ofs_acc_dri_min c_n_ofs_dri_max c_n_ofs_dri_min c_n_ofs_max c_n_ofs_min c_n_ofs_acc_max c_n_ofs_acc_min c_n_ofs_vb_max c_n_ofs_vb_min c_tco_min_n_ofs_kwp lc_n_ofs_kwp_disable c_cha_cdn_bat_kwp_min c_n_ofs_acc_dri_max /end DEF_CHARACTERISTIC
 /begin OUT_MEASUREMENT n_kwp_ofs_acc n_kwp_ofs n_kwp_ofs_vb_nvmy n_kwp_ofs_acc_nvmy n_kwp_ofs_nvmy n_kwp_ofs_dri_nvmy n_kwp_ofs_acc_dri_nvmy lv_kwp_ena n_sp_ofs_kwp n_kwp_ofs_acc_dri n_kwp_ofs_dri n_kwp_ofs_vb lv_act_n_sp_is_bas_ext_adj /end OUT_MEASUREMENT
/end FUNCTION
/begin FUNCTION SEC_Input_Output_Control "_Input Output Control"
 /begin DEF_CHARACTERISTIC id_idx_act_ds_conf ldp_idx_envd_id_idx_act_ds_conf ldp_idx_ds_id_idx_act_ds_conf c_n_max_kwp c_n_min_kwp c_tco_max_kwp c_tco_min_kwp c_vs_max_kwp c_vb_min_kwp c_n_min_kwp_poil c_n_max_kwp_poil c_fup_min_kwp c_fup_max_kwp c_prot_conf_idx_ext_req /end DEF_CHARACTERISTIC
 /begin OUT_MEASUREMENT fac_fco_kwp eol_ram[0] eol_ram[1] eol_ram[2] eol_ram[3] eol_ram[4] eol_ram[5] eol_ram[6] n_sp_is_ext_adj lv_act_n_sp_is_ext_adj lv_eol_cps lv_act_vls_eol_ext_adj lv_pow_mng_mes_mod lv_pow_mng_his_rst lv_pow_mng_bat_chg lv_fhw_rst lv_poil_sp_ext_adj lv_poil_pwm_ext_adj lv_rly_crcv_heat_ext_adj lv_act_rly_crcv_heat_ext_adj lv_rly_main_ext_adj lv_act_rly_main_ext_adj lv_tps_ext_adj lv_v_alter_sp_ext_adj v_alter_sp_ext_adj lv_n_rel_cwp_sp_ext_adj n_rel_cwp_sp_ext_adj lv_ef_ext_adj lv_act_ef_ext_adj lv_sof_ext_adj lv_act_sof_ext_adj lv_ecras_up_ext_adj lv_act_ecras_up_ext_adj lv_rly_st_ext_adj lv_act_rly_st_ext_adj lv_accout_rly_ext_adj lv_act_accout_rly_ext_adj lv_ebox_cfa_ext_adj lv_act_ebox_cfa_ext_adj lv_ectpwm_ext_adj ectpwm_ext_adj lv_sav_ext_adj lv_act_sav_ext_adj lv_sap_ext_adj lv_act_sap_ext_adj lv_dmtl_pump_ext_adj lv_act_dmtl_pump_ext_adj lv_dmtls_ext_adj lv_act_dmtls_ext_adj lv_dmtlh_ext_adj lv_act_dmtlh_ext_adj lv_cppwm_ext_adj cppwm_ext_adj lv_lshpwm_up_ext_adj[0] lv_lshpwm_up_ext_adj[1] lshpwm_up_ext_adj[0] lshpwm_up_ext_adj[1] lv_lshpwm_down_ext_adj[0] lv_lshpwm_down_ext_adj[1] lshpwm_down_ext_adj[0] lshpwm_down_ext_adj[1] lv_mil_ext_adj lv_act_mil_ext_adj lv_cru_ext_adj lv_act_cru_ext_adj lv_wal_1_ext_adj lv_act_wal_1_ext_adj lv_efp_ext_adj efppwm_ext_adj lv_ecfpwm_ecf_ext_adj ecfpwm_ecf_ext_adj lv_rly_vvl_ext_adj lv_act_rly_vvl_ext_adj lv_iv_ext_adj[0] lv_iv_ext_adj[1] lv_iv_ext_adj[2] lv_iv_ext_adj[3] lv_iv_ext_adj[4] lv_iv_ext_adj[5] lv_iv_ext_adj[6] lv_iv_ext_adj[7] iv_per_ext_adj[0] iv_per_ext_adj[1] iv_per_ext_adj[2] iv_per_ext_adj[3] iv_per_ext_adj[4] iv_per_ext_adj[5] iv_per_ext_adj[6] iv_per_ext_adj[7] iv_ext_adj[0] iv_ext_adj[1] iv_ext_adj[2] iv_ext_adj[3] iv_ext_adj[4] iv_ext_adj[5] iv_ext_adj[6] iv_ext_adj[7] lv_cam_sp_in_ext_adj cam_sp_in_ext_adj lv_cam_sp_ex_ext_adj cam_sp_ex_ext_adj lv_ad_dis_ext_adj lv_inh_lam_kwp qoil_ds_rst_kwp_1 qoil_ds_rst_kwp_2 qoil_ds_rst_kwp_3 qoil_ds_rst_kwp_4 qoil_ds_rst_kwp_5 qoil_ds_rst_kwp_6 qoil_ds_rst_kwp_7 qoil_ds_rst_kwp_8 qoil_ds_rst_kwp_9 fac_oil_ext_req_1 fac_oil_ext_req_2 state_cmb_ctl_kwp state_cmb_ctl_nvmy_kwp lv_alter_ctl_ext_adj lv_alter_ctl_ena lv_ltg_gas_ena lv_ecras_down_ext_adj lv_act_ecras_down_ext_adj lv_act_ecras_eol_ext_adj wgpwm_ext_adj[0] wgpwm_ext_adj[1] lv_wgpwm_ext_adj[0] lv_wgpwm_ext_adj[1] lv_swi_aeb_act_ext_adj lv_swi_aeb_ext_adj lv_fup_sp_req_ext_adj fup_sp_ext_adj lv_opg_sp_acr_ext_adj opg_sp_acr_ext_adj state_hom_afs_req_ext_adj lv_var_obdc_can egy_sp_iv_ext_adj[0] egy_sp_iv_ext_adj[1] egy_sp_iv_ext_adj[2] egy_sp_iv_ext_adj[3] egy_sp_iv_ext_adj[4] egy_sp_iv_ext_adj[5] egy_sp_iv_ext_adj[6] egy_sp_iv_ext_adj[7] mff_absv_iv_ext_adj[0] mff_absv_iv_ext_adj[1] mff_absv_iv_ext_adj[2] mff_absv_iv_ext_adj[3] mff_absv_iv_ext_adj[4] mff_absv_iv_ext_adj[5] mff_absv_iv_ext_adj[6] mff_absv_iv_ext_adj[7] lv_bos_read_ena lv_cyl_bal_ad_dc_ext_adj lv_mff_fac_ad_er_bal_ext_adj lv_mff_add_ad_er_bal_ext_adj lv_lam_cyl_sel_adj_rst_iv_ext[0] lv_lam_cyl_sel_adj_rst_iv_ext[1] lv_crk_cyl_lam_delta_rst_ls_ext[0] lv_crk_cyl_lam_delta_rst_ls_ext[1] lv_cyl_bal_ad_eol_ext_adj vs_max_sel_ext_req /end OUT_MEASUREMENT
/end FUNCTION
/begin FUNCTION SEC_Constants_for_EOBD "_Constants for EOBD"
 /begin DEF_CHARACTERISTIC ldpm_state_pid_srv_1_2_obdc c_n_32_max_clr_fmy_srv_4 id_state_srv_1_pid id_state_srv_2_pid c_vls_down_afl_afr_sae c_vls_down_afr_afl_sae ldp_state_tid_id_state_srv_6 id_state_srv_6_tid ldp_state_tid_id_state_srv_8 id_state_srv_8_tid id_state_srv_9_can_vit c_vls_down_cyc_min_sae c_vls_down_cyc_max_sae /end DEF_CHARACTERISTIC
 /begin OUT_MEASUREMENT cat_max_diag_mod_6 /end OUT_MEASUREMENT
/end FUNCTION
/begin FUNCTION SEC_Immobilizer "_Immobilizer" /end FUNCTION
/begin FUNCTION C_4_SYS "C_4_SYS"
 /begin SUB_FUNCTION SYS_Engine_speed_setpoint_calculation SYS_Engine_speed_limit_coordination SYS_Mass_airflow_variables SYS_Intake_manifold_model SYS_Pressure_decrease_in_the_air_filter SYS_Volumetric_efficiency SYS_Vehicle_speed_variables SYS_Battery_voltage SYS_Air_temperature SYS_Exhaust_temperature_variables SYS_Determination_of_accelerator_pedal_value SYS_Infinitely_Variable_Valve_Timing_IVVT_Variables SYS_Gear_ratio_detection SYS_Drive_train_engaged SYS_Clutch_switch_detection SYS_Input_messages SYS_Oil_temperature SYS_Ambient_pressure_variables SYS_System_variables_in_the_exhaust_pipe SYS_Detection_of_Driver_Passive SYS_System_variables_for_and_from_CUS SYS_ECU_state SYS_Pressure_Variables SYS_Engine_off_duration SYS_Total_running_time SYS_Determination_of_Throttle_Position _Intake_manifold_model SYS_ECU_Temperature SYS_Output_signals_of_the_DME_to_the_CAN_bus SYS_Check_Sum_Calculation SYS_Multiplexed_segment_synchronous_output_variables SYS_NOx_Sensor_Interface SYS_Application_Incidences_NOx_Sensor_Interface SYS_BN2000_interface_torque_distribution SYS_Driving_off_assistance SYS_Power_Steering_acquisition_variable SYS_Acquisition_of_exhaust_gas_temperature_downstream_of_pre_catalyst SYS_Fuel_pressure SYS_Modeled_Fuel_Temperature SYS_Fuel_pres_acq_ele_fuel_pump SYS_Exhaust_gas_temperature /end SUB_FUNCTION
/end FUNCTION
/end MODULE
/end PROJECT
