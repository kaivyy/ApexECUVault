ASAP2_VERSION 1 3
/begin PROJECT P390 "BMW DDE6.2 6-Zylinder VR0.1 15.03.2004 CAN11/12H"
/begin HEADER "" VERSION "VR0.1_6Z_CAN11/12H" PROJECT_NO P390 /end HEADER
/begin MODULE DIM ""
/begin MOD_COMMON "" BYTE_ORDER MSB_FIRST ALIGNMENT_BYTE 1 ALIGNMENT_WORD 2 ALIGNMENT_LONG 4 ALIGNMENT_FLOAT32_IEEE 4 /end MOD_COMMON
/begin CHARACTERISTIC K_OZKMUPL "" VALUE 0x000C217A TKW_VV_VV_UW 100.0 Def_km_uw_q10 0.0 655350.0000 /begin FUNCTION_LIST OZGG /end FUNCTION_LIST /end CHARACTERISTIC
/begin CHARACTERISTIC K_OZBZKMSTK1 "Bezugsintervall" VALUE 0x000C2182 TKW_VV_VV_UB 100.0 Def_km_ub_q1000 0.0 255000.0000 /begin FUNCTION_LIST OZGG /end FUNCTION_LIST /end CHARACTERISTIC
/begin CHARACTERISTIC K_OZPERMRMIN "Grenze für Niveauberechnung aus Permittivität" VALUE 0x000C217C TKW_VV_VV_UW 100.0 Def_dez_uw_q1 0.0 65535.0000 /begin FUNCTION_LIST OZGG /end FUNCTION_LIST /end CHARACTERISTIC
/begin CHARACTERISTIC K_OZPRREFMAX "Maximum für Referenzpermittivität" VALUE 0x000C217E TKW_VV_VV_UW 100.0 Def_dez_uw_q1 0.0 1024.0000 /begin FUNCTION_LIST OZGG /end FUNCTION_LIST /end CHARACTERISTIC
/begin CHARACTERISTIC K_OZPRREFMIN "Minimum für Referenzpermittivität" VALUE 0x000C2180 TKW_VV_VV_UW 100.0 Def_dez_uw_q1 0.0 1024.0000 /begin FUNCTION_LIST OZGG /end FUNCTION_LIST /end CHARACTERISTIC
/begin CHARACTERISTIC K_OZNIVKL "" VALUE 0x000C2183 TKW_VV_VV_UB 100.0 Def_niv_ub_b75 0.0 74.7070 /begin FUNCTION_LIST OZGG /end FUNCTION_LIST /end CHARACTERISTIC
/begin CHARACTERISTIC K_OZRESBOST "Delay für die Rücksetzung der Tester-Bos-Anforderung" VALUE 0x000C2184 TKW_VV_VV_UB 100.0 Def_dez_ub_q1 0.0 255.0000 /begin FUNCTION_LIST OZGG /end FUNCTION_LIST /end CHARACTERISTIC
/begin CHARACTERISTIC K_OZSTZYK "" VALUE 0x000C2185 TKW_VV_VV_UB 100.0 Def_dez_ub_q1 0.0 255.0000 /begin FUNCTION_LIST OZGG /end FUNCTION_LIST /end CHARACTERISTIC
/begin CHARACTERISTIC KL_OZPERMKL "Skalierungskennlinie Permittivität" CURVE 0x000C2186 TKL_UW_VV_UW 100.0 Def_perm_uw_b6 0.0 5.9999 /begin FUNCTION_LIST OZGG /end FUNCTION_LIST /begin AXIS_DESCR STD_AXIS Oz_permt Def_dez_uw_q1 2 0.0 65535.0000 /end AXIS_DESCR /end CHARACTERISTIC
/begin CHARACTERISTIC KL_OZTEMPKL "" CURVE 0x000C2190 TKL_UW_VV_SW 100.0 Def_t_sw_q0p1 -3276.8000 3276.7000 /begin FUNCTION_LIST OZGG /end FUNCTION_LIST /begin AXIS_DESCR STD_AXIS Oz_tempt Def_dez_uw_q1 2 0.0 65535.0000 /end AXIS_DESCR FORMAT "%4.1" /end CHARACTERISTIC
/begin CHARACTERISTIC K_CW_OZ "" VALUE 0x000C21A0 TKW_VV_VV_UW 100.0 Def_dez_uw_q1 0.0 65535.0000 /begin FUNCTION_LIST OZNIVDL /end FUNCTION_LIST /end CHARACTERISTIC
/begin CHARACTERISTIC K_OZNFCNT "Anzahl Werte für Nachfüllerkennung" VALUE 0x000C219C TKW_VV_VV_UL 100.0 Def_dez_ul_q1 0.0 4294967295.0000 /begin FUNCTION_LIST OZNIVDL /end FUNCTION_LIST /end CHARACTERISTIC
/begin CHARACTERISTIC K_OZNFTMPMAX "obere Temperaturgrenze für Nachfüllerkennung" VALUE 0x000C21A2 TKW_VV_VV_SW 100.0 Def_t_sw_q0p1 -3276.8000 3276.7000 /begin FUNCTION_LIST OZNIVDL /end FUNCTION_LIST FORMAT "%4.1" /end CHARACTERISTIC
/begin CHARACTERISTIC K_OZNFTMPMIN "untere Temperaturgrenze für Nachfüllerkennung" VALUE 0x000C21A4 TKW_VV_VV_SW 100.0 Def_t_sw_q0p1 -3276.8000 3276.7000 /begin FUNCTION_LIST OZNIVDL /end FUNCTION_LIST FORMAT "%4.1" /end CHARACTERISTIC
/begin CHARACTERISTIC K_OZNMOTMAX "obere Drehzahlgrenze für drehzahlkorrigierten Niveaumittelwert" VALUE 0x000C21A6 TKW_VV_VV_SW 100.0 Def_n_sw_q1p0 -32768.0000 32767.0000 /begin FUNCTION_LIST OZNIVDL /end FUNCTION_LIST /end CHARACTERISTIC
/begin CHARACTERISTIC K_OZNMOTMIN "untere Drehzahlgrenze für drehzahlkorrigierten Niveaumittelwert" VALUE 0x000C21A8 TKW_VV_VV_SW 100.0 Def_n_sw_q1p0 -32768.0000 32767.0000 /begin FUNCTION_LIST OZNIVDL /end FUNCTION_LIST /end CHARACTERISTIC
/begin CHARACTERISTIC K_OZTEMPBW "Temperaturschwelle Öltemperatur Motor betriebswarm" VALUE 0x000C21AA TKW_VV_VV_SW 100.0 Def_t_sw_q0p1 -3276.8000 3276.7000 /begin FUNCTION_LIST OZNIVDL /end FUNCTION_LIST FORMAT "%4.1" /end CHARACTERISTIC
/begin CHARACTERISTIC K_OZTORMAX "Temperaturschwelle für Orientierungsmessung" VALUE 0x000C21AC TKW_VV_VV_SW 100.0 Def_t_sw_q0p1 -3276.8000 3276.7000 /begin FUNCTION_LIST OZNIVDL /end FUNCTION_LIST FORMAT "%4.1" /end CHARACTERISTIC
/begin CHARACTERISTIC K_OZTORMIN "Mindest Temperatur für OrientierungMw QLT" VALUE 0x000C21AE TKW_VV_VV_SW 100.0 Def_t_sw_q0p01 -327.6800 327.6700 /begin FUNCTION_LIST OZNIVDL /end FUNCTION_LIST FORMAT "%5.2" /end CHARACTERISTIC
/begin CHARACTERISTIC K_OZVORMV "Korrektur von Vormw für Peilstab" VALUE 0x000C21B0 TKW_VV_VV_SW 100.0 Def_f_sw_b32 -32.0000 31.9990 /begin FUNCTION_LIST OZNIVDL /end FUNCTION_LIST FORMAT "%7.4" /end CHARACTERISTIC
/begin CHARACTERISTIC K_TOGNMAX "" VALUE 0x000C21B2 TKW_VV_VV_SW 100.0 Def_n_sw_q1p0 -32768.0000 32767.0000 /begin FUNCTION_LIST OZNIVDL /end FUNCTION_LIST /end CHARACTERISTIC
/begin CHARACTERISTIC K_TOGNMIN "" VALUE 0x000C21B4 TKW_VV_VV_SW 100.0 Def_n_sw_q1p0 -32768.0000 32767.0000 /begin FUNCTION_LIST OZNIVDL /end FUNCTION_LIST /end CHARACTERISTIC
/begin CHARACTERISTIC K_TOGTMORIMAX "Tmot Schwelle Orientierungsmessung" VALUE 0x000C21B6 TKW_VV_VV_SW 100.0 Def_t_sw_q0p01 -327.6800 327.6700 /begin FUNCTION_LIST OZNIVDL /end FUNCTION_LIST FORMAT "%5.2" /end CHARACTERISTIC
/begin CHARACTERISTIC K_TOGTMORIMIN "Mindest Temperatur für OrientirungMw Töns" VALUE 0x000C21B8 TKW_VV_VV_SW 100.0 Def_t_sw_q0p01 -327.6800 327.6700 /begin FUNCTION_LIST OZNIVDL /end FUNCTION_LIST FORMAT "%5.2" /end CHARACTERISTIC
/begin CHARACTERISTIC K_TOGTMOT "" VALUE 0x000C21BA TKW_VV_VV_SW 100.0 Def_t_sw_q0p01 -327.6800 327.6700 /begin FUNCTION_LIST OZNIVDL /end FUNCTION_LIST FORMAT "%5.2" /end CHARACTERISTIC
/begin CHARACTERISTIC K_OZALTANZABZ "Abstellzeit für die Ausgabe der letzten Anzeige nach dem Ölcheck" VALUE 0x000C21BC TKW_VV_VV_UW 100.0 Def_tn_uw_q1 0.0 65535.0000 /begin FUNCTION_LIST OZNIVDL /end FUNCTION_LIST FORMAT "%5.2" /end CHARACTERISTIC
/begin CHARACTERISTIC K_OZLUFTMAX "Plausibel max luftsprung" VALUE 0x000C21BE TKW_VV_VV_UW 100.0 Def_p_uw_q039 0.0 2559.9609 /begin FUNCTION_LIST OZNIVDL /end FUNCTION_LIST FORMAT "%6.3" /end CHARACTERISTIC
/begin CHARACTERISTIC K_OZMWL "Anzahl der Messwerte für Langzeit-Mittelwert Niveau" VALUE 0x000C21C0 TKW_VV_VV_UW 100.0 Def_dez_uw_q1 0.0 65535.0000 /begin FUNCTION_LIST OZNIVDL /end FUNCTION_LIST /end CHARACTERISTIC
/begin CHARACTERISTIC K_OZMWOR "Anzahl der Messwerte für Orientierungsmessung" VALUE 0x000C21C2 TKW_VV_VV_UW 100.0 Def_dez_uw_q1 0.0 65535.0000 /begin FUNCTION_LIST OZNIVDL /end FUNCTION_LIST /end CHARACTERISTIC
/begin CHARACTERISTIC K_OZMWV "Anzahl der Messwerte für vorgezogenen Mittelwert Niveau" VALUE 0x000C21C4 TKW_VV_VV_UW 100.0 Def_dez_uw_q1 0.0 65535.0000 /begin FUNCTION_LIST OZNIVDL /end FUNCTION_LIST /end CHARACTERISTIC
/begin CHARACTERISTIC K_OZOELCABZ "Minimale Abstellzeit für den ÖlCheck" VALUE 0x000C21C6 TKW_VV_VV_UW 100.0 Def_tn_uw_q1 0.0 65535.0000 /begin FUNCTION_LIST OZNIVDL /end FUNCTION_LIST FORMAT "%5.2" /end CHARACTERISTIC
/begin CHARACTERISTIC K_OZOELVERB "Ölverbrauch" VALUE 0x000C21C8 TKW_VV_VV_UW 100.0 Def_dez_uw_q1 0.0 65535.0000 /begin FUNCTION_LIST OZNIVDL /end FUNCTION_LIST /end CHARACTERISTIC
/begin CHARACTERISTIC K_OZSTMINW "Minimale Strecke für die Steigungserkennung" VALUE 0x000C21CA TKW_VV_VV_UW 100.0 Def_f_uw_b10 0.0 9.9998 /begin FUNCTION_LIST OZNIVDL /end FUNCTION_LIST FORMAT "%7.4" /end CHARACTERISTIC
/begin CHARACTERISTIC K_OZVERBDKM "Delta km für die Ölverbrauch-Berechnung" VALUE 0x000C21CC TKW_VV_VV_UW 100.0 Def_km_uw_q10 0.0 655350.0000 /begin FUNCTION_LIST OZNIVDL /end FUNCTION_LIST /end CHARACTERISTIC
/begin CHARACTERISTIC K_PT1TOEL "Konstant für Lowpass Filter ÖltemperaturTöns" VALUE 0x000C21CE TKW_VV_VV_UW 100.0 Def_f_uw_b100 0.0 99.9984 /begin FUNCTION_LIST OZNIVDL /end FUNCTION_LIST FORMAT "%6.3" /end CHARACTERISTIC
/begin CHARACTERISTIC K_TOGANZ "" VALUE 0x000C21D0 TKW_VV_VV_UW 100.0 Def_dez_uw_q1 1.0000 3000.0000 /begin FUNCTION_LIST OZNIVDL /end FUNCTION_LIST /end CHARACTERISTIC
/begin CHARACTERISTIC K_TOGKURZANZ "" VALUE 0x000C21D2 TKW_VV_VV_UW 100.0 Def_dez_uw_q1 1.0000 1000.0000 /begin FUNCTION_LIST OZNIVDL /end FUNCTION_LIST /end CHARACTERISTIC
/begin CHARACTERISTIC K_TOGSTARTVERZ "Töns Start Verzögerung nach Drehzal" VALUE 0x000C21D4 TKW_VV_VV_UW 100.0 Def_dez_uw_q1 0.0 65535.0000 /begin FUNCTION_LIST OZNIVDL /end FUNCTION_LIST /end CHARACTERISTIC
/begin CHARACTERISTIC K_TRTYP "" VALUE 0x000C21D6 TKW_VV_VV_UW 100.0 Def_td_uw_q0p01 0.0 655.3500 /begin FUNCTION_LIST OZNIVDL /end FUNCTION_LIST FORMAT "%5.2" /end CHARACTERISTIC
/begin CHARACTERISTIC K_OZLBESCHN "Negative Längsbeschleunigung Ausblendung-Schwelle " VALUE 0x000C21D8 TKW_VV_VV_SB 100.0 Def_ac_sb_q0p25 -32.0000 31.7500 /begin FUNCTION_LIST OZNIVDL /end FUNCTION_LIST /end CHARACTERISTIC
/begin CHARACTERISTIC K_OZLBESCHP "Positive Längsbeschleunigung Ausblendung-Schwelle " VALUE 0x000C21D9 TKW_VV_VV_SB 100.0 Def_ac_sb_q0p25 -32.0000 31.7500 /begin FUNCTION_LIST OZNIVDL /end FUNCTION_LIST /end CHARACTERISTIC
/begin CHARACTERISTIC K_OZLBESCHS "Längsbeschleunigung Ausblendung-Schwelle im Stand" VALUE 0x000C21DA TKW_VV_VV_SB 100.0 Def_ac_sb_q0p25 -32.0000 31.7500 /begin FUNCTION_LIST OZNIVDL /end FUNCTION_LIST /end CHARACTERISTIC
/begin CHARACTERISTIC K_OZQBESCHN "Negative Querbeschleunigung Ausblendung-Schwelle " VALUE 0x000C21DB TKW_VV_VV_SB 100.0 Def_ac_sb_q0p25 -32.0000 31.7500 /begin FUNCTION_LIST OZNIVDL /end FUNCTION_LIST /end CHARACTERISTIC
/begin CHARACTERISTIC K_OZQBESCHP "Positive Querbeschleunigung Ausblendung-Schwelle " VALUE 0x000C21DC TKW_VV_VV_SB 100.0 Def_ac_sb_q0p25 -32.0000 31.7500 /begin FUNCTION_LIST OZNIVDL /end FUNCTION_LIST /end CHARACTERISTIC
/begin CHARACTERISTIC K_OZQBESCHS "Querbeschleunigung Ausblendung-Schwelle im Stand" VALUE 0x000C21DD TKW_VV_VV_SB 100.0 Def_ac_sb_q0p25 -32.0000 31.7500 /begin FUNCTION_LIST OZNIVDL /end FUNCTION_LIST /end CHARACTERISTIC
/begin CHARACTERISTIC K_DOLNIV "Hysteresis Töns oelverb und oelverl" VALUE 0x000C21DE TKW_VV_VV_UB 100.0 Def_td_ub_q0p5 0.0 127.5000 /begin FUNCTION_LIST OZNIVDL /end FUNCTION_LIST /end CHARACTERISTIC
/begin CHARACTERISTIC K_NACHFUELL12 "Nachfüll Erste Balken von Peistab" VALUE 0x000C21DF TKW_VV_VV_UB 100.0 Def_dez_ub_q1 0.0 255.0000 /begin FUNCTION_LIST OZNIVDL /end FUNCTION_LIST /end CHARACTERISTIC
/begin CHARACTERISTIC K_NACHFUELL25 "Nachfüll Zweite Balken von Peistab" VALUE 0x000C21E0 TKW_VV_VV_UB 100.0 Def_dez_ub_q1 0.0 255.0000 /begin FUNCTION_LIST OZNIVDL /end FUNCTION_LIST /end CHARACTERISTIC
/begin CHARACTERISTIC K_NACHFUELL38 "Nachfüll Dritte Balken von Peistab" VALUE 0x000C21E1 TKW_VV_VV_UB 100.0 Def_dez_ub_q1 0.0 255.0000 /begin FUNCTION_LIST OZNIVDL /end FUNCTION_LIST /end CHARACTERISTIC
/begin CHARACTERISTIC K_NACHFUELL53 "Nachfüll Vierte Balken von Peistab" VALUE 0x000C21E2 TKW_VV_VV_UB 100.0 Def_dez_ub_q1 0.0 255.0000 /begin FUNCTION_LIST OZNIVDL /end FUNCTION_LIST /end CHARACTERISTIC
/begin CHARACTERISTIC K_NACHFUELL69 "Nachfüll Fünfte Balken von Peistab" VALUE 0x000C21E3 TKW_VV_VV_UB 100.0 Def_dez_ub_q1 0.0 255.0000 /begin FUNCTION_LIST OZNIVDL /end FUNCTION_LIST /end CHARACTERISTIC
/begin CHARACTERISTIC K_NACHFUELL85 "Nachfüll Sechte Balken von Peistab" VALUE 0x000C21E4 TKW_VV_VV_UB 100.0 Def_dez_ub_q1 0.0 255.0000 /begin FUNCTION_LIST OZNIVDL /end FUNCTION_LIST /end CHARACTERISTIC
/begin CHARACTERISTIC K_NACHFUELL95 "Nachfüll Siebte Balken von Peistab" VALUE 0x000C21E5 TKW_VV_VV_UB 100.0 Def_dez_ub_q1 0.0 255.0000 /begin FUNCTION_LIST OZNIVDL /end FUNCTION_LIST /end CHARACTERISTIC
/begin CHARACTERISTIC K_OZALTLANG "Erlaubte Differenz Schwelle (letze 3 Langmw)" VALUE 0x000C21E6 TKW_VV_VV_UB 100.0 Def_niv_ub_b75 0.0 74.7070 /begin FUNCTION_LIST OZNIVDL /end FUNCTION_LIST /end CHARACTERISTIC
/begin CHARACTERISTIC K_OZBESCHAUS "Zahl Ausgeblendet bei Lengsbescheunigung" VALUE 0x000C21E7 TKW_VV_VV_UB 100.0 Def_dez_ub_q1 0.0 255.0000 /begin FUNCTION_LIST OZNIVDL /end FUNCTION_LIST /end CHARACTERISTIC
/begin CHARACTERISTIC K_OZKEINLUFT "1 = Luftausblendung deaktiviert" VALUE 0x000C21E8 TKW_VV_VV_UB 100.0 Def_dez_ub_q1 0.0 255.0000 /begin FUNCTION_LIST OZNIVDL /end FUNCTION_LIST /end CHARACTERISTIC
/begin CHARACTERISTIC K_OZKRZORTZ "Toleranz für Orientierungsmessung " VALUE 0x000C21E9 TKW_VV_VV_UB 100.0 Def_f_ub_b2 0.0 1.9921 /begin FUNCTION_LIST OZNIVDL /end FUNCTION_LIST /end CHARACTERISTIC
/begin CHARACTERISTIC K_OZMWK "Anzahl der Messwerte für Kurzzeit-Mittelwert Niveau" VALUE 0x000C21EA TKW_VV_VV_UB 100.0 Def_dez_ub_q1 0.0 255.0000 /begin FUNCTION_LIST OZNIVDL /end FUNCTION_LIST /end CHARACTERISTIC
/begin CHARACTERISTIC K_OZMXSLOPE "Maximale erlaubt Steigung" VALUE 0x000C21EB TKW_VV_VV_UB 100.0 Def_f_ub_b0p5 0.0 0.4980 /begin FUNCTION_LIST OZNIVDL /end FUNCTION_LIST /end CHARACTERISTIC
/begin CHARACTERISTIC K_OZNFDELTA "Niveaudelta für die Nachfüllerkennung Peilstab" VALUE 0x000C21EC TKW_VV_VV_UB 100.0 Def_niv_ub_b75 0.0 74.7070 /begin FUNCTION_LIST OZNIVDL /end FUNCTION_LIST /end CHARACTERISTIC
/begin CHARACTERISTIC K_OZNFERR "Nachfüllmengenanzeige bei PreCheck OK" VALUE 0x000C21ED TKW_VV_VV_UB 100.0 Def_dez_ub_q1 0.0 255.0000 /begin FUNCTION_LIST OZNIVDL /end FUNCTION_LIST /end CHARACTERISTIC
/begin CHARACTERISTIC K_OZNFML "Nachfüllmengenanzeige bei " VALUE 0x000C21EE TKW_VV_VV_UB 100.0 Def_dez_ub_q1 0.0 255.0000 /begin FUNCTION_LIST OZNIVDL /end FUNCTION_LIST /end CHARACTERISTIC
/begin CHARACTERISTIC K_OZNFOELCKO "Nachfüllmengenanzeige bei PreCheck KO" VALUE 0x000C21EF TKW_VV_VV_UB 100.0 Def_dez_ub_q1 0.0 255.0000 /begin FUNCTION_LIST OZNIVDL /end FUNCTION_LIST /end CHARACTERISTIC
/begin CHARACTERISTIC K_OZNFOELCOK "Nachfüllmengenanzeige bei PreCheck OK" VALUE 0x000C21F0 TKW_VV_VV_UB 100.0 Def_dez_ub_q1 0.0 255.0000 /begin FUNCTION_LIST OZNIVDL /end FUNCTION_LIST /end CHARACTERISTIC
/begin CHARACTERISTIC K_OZNIVMMLIT "Umrechnungsfaktor für Ölniveau von mm in Liter" VALUE 0x000C21F1 TKW_VV_VV_UB 100.0 Def_f_ub_b0p25 0.0 0.2490 /begin FUNCTION_LIST OZNIVDL /end FUNCTION_LIST /end CHARACTERISTIC
/begin CHARACTERISTIC K_OZNIVNFM05 "Niveauschwelle für Erkennung 0,5 Liter nachgefüllt" VALUE 0x000C21F2 TKW_VV_VV_UB 100.0 Def_f_ub_b8 0.0 7.9687 /begin FUNCTION_LIST OZNIVDL /end FUNCTION_LIST /end CHARACTERISTIC
/begin CHARACTERISTIC K_OZNIVNFM10 "Niveauschwelle für Erkennung 1,0 Liter nachgefüllt" VALUE 0x000C21F3 TKW_VV_VV_UB 100.0 Def_f_ub_b8 0.0 7.9687 /begin FUNCTION_LIST OZNIVDL /end FUNCTION_LIST /end CHARACTERISTIC
/begin CHARACTERISTIC K_OZOELCOK "PreDriveCheck-Schwelle" VALUE 0x000C21F4 TKW_VV_VV_UB 100.0 Def_niv_ub_b75 0.0 74.7070 /begin FUNCTION_LIST OZNIVDL /end FUNCTION_LIST /end CHARACTERISTIC
/begin CHARACTERISTIC K_OZPEIL12 "Erste Balken von Peistab" VALUE 0x000C21F5 TKW_VV_VV_UB 100.0 Def_niv_ub_b75 0.0 74.7070 /begin FUNCTION_LIST OZNIVDL /end FUNCTION_LIST /end CHARACTERISTIC
/begin CHARACTERISTIC K_OZPEIL25 "Zweite Balken von Peistab" VALUE 0x000C21F6 TKW_VV_VV_UB 100.0 Def_niv_ub_b75 0.0 74.7070 /begin FUNCTION_LIST OZNIVDL /end FUNCTION_LIST /end CHARACTERISTIC
/begin CHARACTERISTIC K_OZPEIL38 "Dritte Balken von Peistab" VALUE 0x000C21F7 TKW_VV_VV_UB 100.0 Def_niv_ub_b75 0.0 74.7070 /begin FUNCTION_LIST OZNIVDL /end FUNCTION_LIST /end CHARACTERISTIC
/begin CHARACTERISTIC K_OZPEIL53 "Vierte Balken von Peistab" VALUE 0x000C21F8 TKW_VV_VV_UB 100.0 Def_niv_ub_b75 0.0 74.7070 /begin FUNCTION_LIST OZNIVDL /end FUNCTION_LIST /end CHARACTERISTIC
/begin CHARACTERISTIC K_OZPEIL69 "Fünfte Balken von Peistab" VALUE 0x000C21F9 TKW_VV_VV_UB 100.0 Def_niv_ub_b75 0.0 74.7070 /begin FUNCTION_LIST OZNIVDL /end FUNCTION_LIST /end CHARACTERISTIC
/begin CHARACTERISTIC K_OZPEIL85 "Sechte Balken von Peistab" VALUE 0x000C21FA TKW_VV_VV_UB 100.0 Def_niv_ub_b75 0.0 74.7070 /begin FUNCTION_LIST OZNIVDL /end FUNCTION_LIST /end CHARACTERISTIC
/begin CHARACTERISTIC K_OZPEIL95 "Siebte Balken von Peistab" VALUE 0x000C21FB TKW_VV_VV_UB 100.0 Def_niv_ub_b75 0.0 74.7070 /begin FUNCTION_LIST OZNIVDL /end FUNCTION_LIST /end CHARACTERISTIC
/begin CHARACTERISTIC K_OZPEILDO "Delta + Hysteresis Langmw Peilstab" VALUE 0x000C21FC TKW_VV_VV_UB 100.0 Def_niv_ub_b75 0.0 74.7070 /begin FUNCTION_LIST OZNIVDL /end FUNCTION_LIST /end CHARACTERISTIC
/begin CHARACTERISTIC K_OZPEILDU "Delta - Hysteresis Langmw Peilstab" VALUE 0x000C21FD TKW_VV_VV_UB 100.0 Def_niv_ub_b75 0.0 74.7070 /begin FUNCTION_LIST OZNIVDL /end FUNCTION_LIST /end CHARACTERISTIC
/begin CHARACTERISTIC K_OZPEILERR "Balkenanzeige im Fehlerfall" VALUE 0x000C21FE TKW_VV_VV_UB 100.0 Def_dez_ub_q1 0.0 255.0000 /begin FUNCTION_LIST OZNIVDL /end FUNCTION_LIST /end CHARACTERISTIC
/begin CHARACTERISTIC K_OZPEILLP85 "Bankenanzeige für Niveau bei 85%" VALUE 0x000C21FF TKW_VV_VV_UB 100.0 Def_dez_ub_q1 0.0 255.0000 /begin FUNCTION_LIST OZNIVDL /end FUNCTION_LIST /end CHARACTERISTIC
/begin CHARACTERISTIC K_OZPEILML "Balkenanzeige bei Messung läuft" VALUE 0x000C2200 TKW_VV_VV_UB 100.0 Def_dez_ub_q1 0.0 255.0000 /begin FUNCTION_LIST OZNIVDL /end FUNCTION_LIST /end CHARACTERISTIC
/begin CHARACTERISTIC K_OZPEILOELCKO "Balkenanzeige bei ÖlCheck KO" VALUE 0x000C2201 TKW_VV_VV_UB 100.0 Def_dez_ub_q1 0.0 255.0000 /begin FUNCTION_LIST OZNIVDL /end FUNCTION_LIST /end CHARACTERISTIC
/begin CHARACTERISTIC K_OZPEILOELCOK "Balkenanzeige bei ÖlCheck OK" VALUE 0x000C2202 TKW_VV_VV_UB 100.0 Def_dez_ub_q1 0.0 255.0000 /begin FUNCTION_LIST OZNIVDL /end FUNCTION_LIST /end CHARACTERISTIC
/begin CHARACTERISTIC K_OZSTARTVERZ "QLT Start Verzögerung nach Drehzal" VALUE 0x000C2203 TKW_VV_VV_UB 100.0 Def_dez_ub_q1 0.0 255.0000 /begin FUNCTION_LIST OZNIVDL /end FUNCTION_LIST /end CHARACTERISTIC
/begin CHARACTERISTIC K_OZVERBFAK "Faktor für die Anpassung des Ölverbrauches" VALUE 0x000C2204 TKW_VV_VV_UB 100.0 Def_f_ub_b8 0.0 7.9687 /begin FUNCTION_LIST OZNIVDL /end FUNCTION_LIST /end CHARACTERISTIC
/begin CHARACTERISTIC K_OZVERZERRBSD "Verzögerung für Peilstab-Fehlerfall beim BSD-Fehler" VALUE 0x000C2205 TKW_VV_VV_UB 100.0 Def_dez_ub_q1 0.0 255.0000 /begin FUNCTION_LIST OZNIVDL /end FUNCTION_LIST /end CHARACTERISTIC
/begin CHARACTERISTIC K_OZZEITST "Delta Zeit für Luftdruck messsung" VALUE 0x000C2206 TKW_VV_VV_UB 100.0 Def_td_ub_q1 0.0 255.0000 /begin FUNCTION_LIST OZNIVDL /end FUNCTION_LIST /end CHARACTERISTIC
/begin CHARACTERISTIC K_PT1NMOT "Konstant für Lowpass Filter Drehzahl Töns" VALUE 0x000C2207 TKW_VV_VV_UB 100.0 Def_f_ub_b100 0.0 99.6093 /begin FUNCTION_LIST OZNIVDL /end FUNCTION_LIST /end CHARACTERISTIC
/begin CHARACTERISTIC K_TOGMWK "" VALUE 0x000C2208 TKW_VV_VV_UB 100.0 Def_dez_ub_q1 1.0000 100.0000 /begin FUNCTION_LIST OZNIVDL /end FUNCTION_LIST /end CHARACTERISTIC
/begin CHARACTERISTIC K_TOGORIANZ "" VALUE 0x000C2209 TKW_VV_VV_UB 100.0 Def_dez_ub_q1 1.0000 255.0000 /begin FUNCTION_LIST OZNIVDL /end FUNCTION_LIST /end CHARACTERISTIC
/begin CHARACTERISTIC K_TOGVERBKZ "" VALUE 0x000C220A TKW_VV_VV_UB 100.0 Def_td_ub_q0p5 0.0 127.5000 /begin FUNCTION_LIST OZNIVDL /end FUNCTION_LIST /end CHARACTERISTIC
/begin CHARACTERISTIC K_TOGVERBNOR "" VALUE 0x000C220B TKW_VV_VV_UB 100.0 Def_td_ub_q0p5 0.0 127.5000 /begin FUNCTION_LIST OZNIVDL /end FUNCTION_LIST /end CHARACTERISTIC
/begin CHARACTERISTIC K_TOGVERLKZ "" VALUE 0x000C220C TKW_VV_VV_UB 100.0 Def_td_ub_q0p5 0.0 127.5000 /begin FUNCTION_LIST OZNIVDL /end FUNCTION_LIST /end CHARACTERISTIC
/begin CHARACTERISTIC K_TOGVERLNOR "" VALUE 0x000C220D TKW_VV_VV_UB 100.0 Def_td_ub_q0p5 0.0 127.5000 /begin FUNCTION_LIST OZNIVDL /end FUNCTION_LIST /end CHARACTERISTIC
/begin CHARACTERISTIC K_TOGVERLORI "" VALUE 0x000C220E TKW_VV_VV_UB 100.0 Def_niv_ub_b75 0.0 74.7070 /begin FUNCTION_LIST OZNIVDL /end FUNCTION_LIST /end CHARACTERISTIC
/begin CHARACTERISTIC K_TOGVERZOEG "" VALUE 0x000C220F TKW_VV_VV_UB 100.0 Def_dez_ub_q1 0.0 255.0000 /begin FUNCTION_LIST OZNIVDL /end FUNCTION_LIST /end CHARACTERISTIC
/begin CHARACTERISTIC KL_OZLN "y = ln x" CURVE 0x000C2210 TKL_UW_VV_SW 100.0 Def_f_sw_b1 -1.0000 9.99969482421875e-1 /begin FUNCTION_LIST OZNIVDL /end FUNCTION_LIST /begin AXIS_DESCR STD_AXIS Oz_pzdivp Def_f_uw_b2 6 0.0 1.9999 /end AXIS_DESCR /end CHARACTERISTIC
/begin CHARACTERISTIC KL_OZNMNIVKL "Kennlinie für Drehzahlkorrektur des Niveaus" CURVE 0x000C222A TKL_SW_VV_SB 100.0 Def_niv_sb_b37p5 -37.5000 37.2070 /begin FUNCTION_LIST OZNIVDL /end FUNCTION_LIST /begin AXIS_DESCR STD_AXIS N_ozmw Def_n_sw_q1p0 16 -32768.0000 32767.0000 /end AXIS_DESCR /end CHARACTERISTIC
/begin CHARACTERISTIC KL_TKTOENIV "Umstetzung Tk -> Oelnivau" CURVE 0x000C225C TKL_UW_VV_UW 100.0 Def_td_uw_q0p1 0.0 6553.5000 /begin FUNCTION_LIST OZNIVDL /end FUNCTION_LIST
 /begin AXIS_DESCR STD_AXIS Td_og_tk Def_td_uw_q0p1 7 0.0 6553.5000 FORMAT "%4.1" /end AXIS_DESCR
 FORMAT "%4.1" /end CHARACTERISTIC
/begin CHARACTERISTIC KL_OZBEFKL "Befüllkennlinie" CURVE 0x000C227A TKL_UW_VV_UW 100.0 Def_niv_uw_q0p1 0.0 25.5000 /begin FUNCTION_LIST OZNIVDL /end FUNCTION_LIST
 /begin AXIS_DESCR STD_AXIS Oz_nivkrzt Def_niv_uw_b75 5 0.0 19199.7070 FORMAT "%5.2" /end AXIS_DESCR
 FORMAT "%4.1" /end CHARACTERISTIC
/begin CHARACTERISTIC KL_TVTOEL "" CURVE 0x000C2290 TKL_UW_VV_SW 100.0 Def_t_sw_q0p1 -3276.8000 3276.7000 /begin FUNCTION_LIST OZNIVDL /end FUNCTION_LIST
 /begin AXIS_DESCR STD_AXIS NO_INPUT_QUANTITY Def_td_uw_q0p1 7 0.0 6553.5000 FORMAT "%4.1" /end AXIS_DESCR
 FORMAT "%4.1" /end CHARACTERISTIC
/begin CHARACTERISTIC KL_TOGNKOR "" CURVE 0x000C22AE TKL_SW_VV_SB 100.0 Def_niv_sb_b37p5 -37.5000 37.2070 /begin FUNCTION_LIST OZNIVDL /end FUNCTION_LIST /begin AXIS_DESCR STD_AXIS Oz_nmotfm Def_n_sw_q1p0 16 -32768.0000 32767.0000 /end AXIS_DESCR /end CHARACTERISTIC
/begin CHARACTERISTIC KF_OZKORRORI "Kennfeld für die Korrektur des OriMw mit Abstellzeit und Öltemperatur" MAP 0x000C22E0 TKF_UW_SW_SW 100.0 Def_niv_sw_b37p5 -37.5000 37.2070 /begin FUNCTION_LIST OZNIVDL /end FUNCTION_LIST
 /begin AXIS_DESCR STD_AXIS Toel Def_t_sw_q0p1 4 -3276.8000 3276.7000 FORMAT "%4.1" /end AXIS_DESCR
 /begin AXIS_DESCR STD_AXIS Tn_abstellm Def_tn_uw_q1 3 0.0 65535.0000 FORMAT "%5.2" /end AXIS_DESCR
 FORMAT "%5.2" /end CHARACTERISTIC
/begin CHARACTERISTIC K_OZPERMNK3 "Drehzahlschwelle für Er-Ausblendung" VALUE 0x000C2308 TKW_VV_VV_SW 100.0 Def_n_sw_q1p0 -32768.0000 32767.0000 /begin FUNCTION_LIST OZPERM /end FUNCTION_LIST /end CHARACTERISTIC
/begin CHARACTERISTIC K_OZPERMTK12 "Untere Temperaturgrenze Messfenster Permittivität" VALUE 0x000C230A TKW_VV_VV_SW 100.0 Def_t_sw_q0p1 -3276.8000 3276.7000 /begin FUNCTION_LIST OZPERM /end FUNCTION_LIST FORMAT "%4.1" /end CHARACTERISTIC
/begin CHARACTERISTIC K_OZPERMTK13 "Obere Temperaturgrenze Messfenster Permittivität" VALUE 0x000C230C TKW_VV_VV_SW 100.0 Def_t_sw_q0p1 -3276.8000 3276.7000 /begin FUNCTION_LIST OZPERM /end FUNCTION_LIST FORMAT "%4.1" /end CHARACTERISTIC
/begin CHARACTERISTIC K_OZPERMTK7 "Ausheiztemperatur" VALUE 0x000C230E TKW_VV_VV_SW 100.0 Def_t_sw_q0p1 -3276.8000 3276.7000 /begin FUNCTION_LIST OZPERM /end FUNCTION_LIST FORMAT "%4.1" /end CHARACTERISTIC
/begin CHARACTERISTIC K_OZOELKMPL "gefahrene Strecke nach Ölwechsel, ab wo Er-Auswertung erfolgt" VALUE 0x000C2310 TKW_VV_VV_UW 100.0 Def_km_uw_q10 0.0 655350.0000 /begin FUNCTION_LIST OZPERM /end FUNCTION_LIST /end CHARACTERISTIC
/begin CHARACTERISTIC K_OZPERMCOK5 "minimale Anzahl der Messwerte für einen gültigen Permittivitätswert" VALUE 0x000C2312 TKW_VV_VV_UW 100.0 Def_dez_uw_q1 0.0 65535.0000 /begin FUNCTION_LIST OZPERM /end FUNCTION_LIST /end CHARACTERISTIC
/begin CHARACTERISTIC K_OZPERMMIN "minimaler Permittivitätswert für gültige Auswertung" VALUE 0x000C2314 TKW_VV_VV_UW 100.0 Def_perm_uw_b6 0.0 5.9999 /begin FUNCTION_LIST OZPERM /end FUNCTION_LIST /end CHARACTERISTIC
/begin CHARACTERISTIC K_OZPERMTIK6 "Mittelungszeitraum Permittivität" VALUE 0x000C2316 TKW_VV_VV_UW 100.0 Def_td_uw_q1 0.0 65535.0000 /begin FUNCTION_LIST OZPERM /end FUNCTION_LIST /end CHARACTERISTIC
/begin CHARACTERISTIC K_OZPERMTIK8 "Ausheizzeit" VALUE 0x000C2318 TKW_VV_VV_UW 100.0 Def_td_uw_q1 0.0 65535.0000 /begin FUNCTION_LIST OZPERM /end FUNCTION_LIST /end CHARACTERISTIC
/begin CHARACTERISTIC K_OZPERMTIK9 "maximale Zeit nach B_ozpermpl = true, Neustart und oztempf < OZPERMTI in der eine gültige Messung erfolgen kann (Kaltzeitschwelle)" VALUE 0x000C231A TKW_VV_VV_UW 100.0 Def_td_uw_q1 0.0 65535.0000 /begin FUNCTION_LIST OZPERM /end FUNCTION_LIST /end CHARACTERISTIC
/begin CHARACTERISTIC K_OZPERMTK4 "Abklingzeit Drehzahlschwelle" VALUE 0x000C231C TKW_VV_VV_UW 100.0 Def_td_uw_q1 0.0 65535.0000 /begin FUNCTION_LIST OZPERM /end FUNCTION_LIST /end CHARACTERISTIC
/begin CHARACTERISTIC K_OZPERMMNIV "Niveauschwelle für gültige Permittivitätsauswertung" VALUE 0x000C231E TKW_VV_VV_UB 100.0 Def_niv_ub_b75 0.0 74.7070 /begin FUNCTION_LIST OZPERM /end FUNCTION_LIST /end CHARACTERISTIC
/begin CHARACTERISTIC K_OZZEITFAKT "Bereich der gesamten Laufstrecke wo die Berechnung des Zeit-RW Beainfluss hat" VALUE 0x000C2334 TKW_VV_VV_UB 100.0 Def_f_ub_b1 0.0 0.9960 /begin FUNCTION_LIST OZRESTKM /end FUNCTION_LIST /end CHARACTERISTIC
/begin CHARACTERISTIC K_OZUEBERTEMP "Schwelle für die Ölsübertemperatur-Kontrolle" VALUE 0x000C2320 TKW_VV_VV_SW 100.0 Def_t_sw_q0p1 -3276.8000 3276.7000 /begin FUNCTION_LIST OZRESTKM /end FUNCTION_LIST FORMAT "%4.1" /end CHARACTERISTIC
/begin CHARACTERISTIC K_OZANFANZ "BOS-Startanzeigewert Restlaufstrecke" VALUE 0x000C2322 TKW_VV_VV_UW 100.0 Def_km_uw_q10 0.0 655350.0000 /begin FUNCTION_LIST OZRESTKM /end FUNCTION_LIST /end CHARACTERISTIC
/begin CHARACTERISTIC K_OZKMMAXK11 "Maximalintervall" VALUE 0x000C2324 TKW_VV_VV_UW 100.0 Def_km_uw_q10 0.0 655350.0000 /begin FUNCTION_LIST OZRESTKM /end FUNCTION_LIST /end CHARACTERISTIC
/begin CHARACTERISTIC K_OZKVBMXK18 "maximal zulässige Gesamtkraftstoffbonusmenge" VALUE 0x000C2326 TKW_VV_VV_UW 100.0 Def_dez_uw_q1 0.0 65535.0000 /begin FUNCTION_LIST OZRESTKM /end FUNCTION_LIST /end CHARACTERISTIC
/begin CHARACTERISTIC K_OZKVBOK16 "Kraftstoffbonusmenge in [l] je 0,5l Ölnachfüllung" VALUE 0x000C2328 TKW_VV_VV_UW 100.0 Def_dez_uw_q1 0.0 65535.0000 /begin FUNCTION_LIST OZRESTKM /end FUNCTION_LIST /end CHARACTERISTIC
/begin CHARACTERISTIC K_OZMNKMBO "Wegstrecke ab der eine Bonuszuteilung erfolgt" VALUE 0x000C232A TKW_VV_VV_UW 100.0 Def_km_uw_q10 0.0 655350.0000 /begin FUNCTION_LIST OZRESTKM /end FUNCTION_LIST /end CHARACTERISTIC
/begin CHARACTERISTIC K_OZMXOHK15 "Max Tage für den Ölservice" VALUE 0x000C232C TKW_VV_VV_UW 100.0 Def_dez_uw_q1 0.0 65535.0000 /begin FUNCTION_LIST OZRESTKM /end FUNCTION_LIST /end CHARACTERISTIC
/begin CHARACTERISTIC K_OZPERBOK17 "Er-Bonusbetrag je 0,5l Ölnachfüllung" VALUE 0x000C232E TKW_VV_VV_UW 100.0 Def_perm_uw_b6 0.0 5.9999 /begin FUNCTION_LIST OZRESTKM /end FUNCTION_LIST /end CHARACTERISTIC
/begin CHARACTERISTIC K_OZPERXK10 "zulässige Permittivitätsänderung im Ölwechselintervall" VALUE 0x000C2330 TKW_VV_VV_UW 100.0 Def_perm_uw_b6 0.0 5.9999 /begin FUNCTION_LIST OZRESTKM /end FUNCTION_LIST /end CHARACTERISTIC
/begin CHARACTERISTIC K_OZTAGCTERR "Wert für unplausibel Tagezähler" VALUE 0x000C2332 TKW_VV_VV_UW 100.0 Def_dez_uw_q1 0.0 65535.0000 /begin FUNCTION_LIST OZRESTKM /end FUNCTION_LIST /end CHARACTERISTIC
/begin CHARACTERISTIC K_OZDAEMPF "" VALUE 0x000C2335 TKW_VV_VV_UB 100.0 Def_f_ub_b0p25 0.0 0.2490 /begin FUNCTION_LIST OZRESTKM /end FUNCTION_LIST /end CHARACTERISTIC
/begin CHARACTERISTIC K_OZKVB96 "Typprüfkraftstoffverbrauch" VALUE 0x000C2336 TKW_VV_VV_UB 100.0 Def_f_ub_b32 0.0 31.8750 /begin FUNCTION_LIST OZRESTKM /end FUNCTION_LIST /end CHARACTERISTIC
/begin CHARACTERISTIC K_OZKVB96A "Typprüfkraftstoffverbrauch Automatikgetriebe" VALUE 0x000C2337 TKW_VV_VV_UB 100.0 Def_f_ub_b32 0.0 31.8750 /begin FUNCTION_LIST OZRESTKM /end FUNCTION_LIST /end CHARACTERISTIC
/begin CHARACTERISTIC K_OZLF1 "Länderfaktor 1 Festwert" VALUE 0x000C2338 TKW_VV_VV_UB 100.0 Def_lf_ub_q0p01 0.0 2.5500 /begin FUNCTION_LIST OZRESTKM /end FUNCTION_LIST /end CHARACTERISTIC
/begin CHARACTERISTIC K_OZLF2 "Länderfaktor 2 Festwert" VALUE 0x000C2339 TKW_VV_VV_UB 100.0 Def_lf_ub_q0p01 0.0 2.5500 /begin FUNCTION_LIST OZRESTKM /end FUNCTION_LIST /end CHARACTERISTIC
/begin CHARACTERISTIC K_OZPERBRK14 "Begrenzungsfaktor für Restweg aus der Permittivität" VALUE 0x000C233A TKW_VV_VV_UB 100.0 Def_kw_ub_q0p0234 0.0 5.9765 /begin FUNCTION_LIST OZRESTKM /end FUNCTION_LIST /end CHARACTERISTIC
/begin CHARACTERISTIC K_OZUTFAK "Faktor für den Kraftstoffverbrauch bei Übertemperatur" VALUE 0x000C233B TKW_VV_VV_UB 100.0 Def_dez_ub_q1 0.0 255.0000 /begin FUNCTION_LIST OZRESTKM /end FUNCTION_LIST /end CHARACTERISTIC
/begin CHARACTERISTIC K_OZZEITINT "Zeitintervall für Ölwechsel in Monate (CBS4)" VALUE 0x000C233C TKW_VV_VV_UB 100.0 Def_dez_ub_q1 0.0 255.0000 /begin FUNCTION_LIST OZRESTKM /end FUNCTION_LIST /end CHARACTERISTIC
/begin CHARACTERISTIC K_BNS_VFZG "Schwelle Geschwindigkeit fuer BNS" VALUE 0x000C233E TKW_VV_VV_UW 100.0 Def_v_uw_q1p0 0.0 65535.0000 /begin FUNCTION_LIST PMBNSTAB /end FUNCTION_LIST /end CHARACTERISTIC
/begin CHARACTERISTIC K_BNSMAX "Bordnetz Instabil Schwelle" VALUE 0x000C2340 TKW_VV_VV_UB 100.0 Def_dez_ub_q1 0.0 255.0000 /begin FUNCTION_LIST PMBNSTAB /end FUNCTION_LIST /end CHARACTERISTIC
/begin CHARACTERISTIC K_BNS_CTRINC "bnsctr inkrement" VALUE 0x000C2341 TKW_VV_VV_UB 100.0 Def_dez_ub_q1 0.0 255.0000 /begin FUNCTION_LIST PMBNSTAB /end FUNCTION_LIST /end CHARACTERISTIC
/begin CHARACTERISTIC K_BNS_SCHW1 "BN Instabilitätsschwelle 1" VALUE 0x000C2342 TKW_VV_VV_UB 100.0 Def_dez_ub_q1 0.0 255.0000 /begin FUNCTION_LIST PMBNSTAB /end FUNCTION_LIST /end CHARACTERISTIC
/begin CHARACTERISTIC K_BNS_UBMAX "BN Spg. max. Schwelle" VALUE 0x000C2343 TKW_VV_VV_UB 100.0 Def_u_ub_q0p0942 0.0 24.0210 /begin FUNCTION_LIST PMBNSTAB /end FUNCTION_LIST /end CHARACTERISTIC
/begin CHARACTERISTIC K_BNS_UBMIN "BN Spg. untere Schwelle" VALUE 0x000C2344 TKW_VV_VV_UB 100.0 Def_u_ub_q0p0942 0.0 24.0210 /begin FUNCTION_LIST PMBNSTAB /end FUNCTION_LIST /end CHARACTERISTIC
/begin CHARACTERISTIC K_T_BNSDELAY "Delayzeit nach Motorstartende für BNS Überwachung" VALUE 0x000C2345 TKW_VV_VV_UB 100.0 Def_td_ub_q1 0.0 255.0000 /begin FUNCTION_LIST PMBNSTAB /end FUNCTION_LIST /end CHARACTERISTIC
/begin CHARACTERISTIC S_BNSCLRAPP "BNS Daten löschen" VALUE 0x000C2346 TKW_VV_VV_UB 100.0 Def_dez_ub_q1 0.0 255.0000 /begin FUNCTION_LIST PMBNSTAB /end FUNCTION_LIST /end CHARACTERISTIC
/begin CHARACTERISTIC K_ABKORROVER "schlechter absch_korr Schwelle ueberschritten" VALUE 0x000C2348 TKW_VV_VV_SW 100.0 Def_f_sw_q0p00153 -50.0000 49.9984 /begin FUNCTION_LIST PMDIAG /end FUNCTION_LIST FORMAT "%6.3" /end CHARACTERISTIC
/begin CHARACTERISTIC K_DSOCHYSTCC "DSOC Hyst. fuer B_ccbtnach reset " VALUE 0x000C234A TKW_VV_VV_SW 100.0 Def_f_sw_b100 -100.0000 99.9969 /begin FUNCTION_LIST PMDIAG /end FUNCTION_LIST FORMAT "%6.3" /end CHARACTERISTIC
/begin CHARACTERISTIC K_DSOCLOW "DSOC Grenze f. CCmeld Batt Nachladen" VALUE 0x000C234C TKW_VV_VV_SW 100.0 Def_f_sw_b100 -100.0000 99.9969 /begin FUNCTION_LIST PMDIAG /end FUNCTION_LIST FORMAT "%6.3" /end CHARACTERISTIC
/begin CHARACTERISTIC K_OSPGHYST "Unterspannungshysterese" VALUE 0x000C234E TKW_VV_VV_SW 100.0 Def_u_sw_q0p00025 -8.1920 8.1917 /begin FUNCTION_LIST PMDIAG /end FUNCTION_LIST FORMAT "%7.4" /end CHARACTERISTIC
/begin CHARACTERISTIC K_USPGHYST "Unterspannungshysterese" VALUE 0x000C2350 TKW_VV_VV_SW 100.0 Def_u_sw_q0p00025 -8.1920 8.1917 /begin FUNCTION_LIST PMDIAG /end FUNCTION_LIST FORMAT "%7.4" /end CHARACTERISTIC
/begin CHARACTERISTIC K_CCPWRSET "ctrpwrcos Schwelle ab dem CC Meldung aktiviert wird. " VALUE 0x000C2352 TKW_VV_VV_UW 100.0 Def_dez_uw_q1 0.0 65535.0000 /begin FUNCTION_LIST PMDIAG /end FUNCTION_LIST /end CHARACTERISTIC
/begin CHARACTERISTIC K_OSPGAPP "Oberspannungsschwelle" VALUE 0x000C2354 TKW_VV_VV_UW 100.0 Def_u_uw_q0p25em3_o6 6.0000 22.3837 /begin FUNCTION_LIST PMDIAG /end FUNCTION_LIST FORMAT "%7.4" /end CHARACTERISTIC
/begin CHARACTERISTIC K_T2PMINFO "T2 Zykluszeit fuer PM Fehlerinfo" VALUE 0x000C2356 TKW_VV_VV_UW 100.0 Def_td_uw_q0p1 0.0 6553.5000 /begin FUNCTION_LIST PMDIAG /end FUNCTION_LIST FORMAT "%4.1" /end CHARACTERISTIC
/begin CHARACTERISTIC K_T3PMINFO "T3 Zykluszeit fuer PM Fehlerinfo" VALUE 0x000C2358 TKW_VV_VV_UW 100.0 Def_td_uw_q0p1 0.0 6553.5000 /begin FUNCTION_LIST PMDIAG /end FUNCTION_LIST FORMAT "%4.1" /end CHARACTERISTIC
/begin CHARACTERISTIC K_TBATNACHL "B_ccbtnach wird nach dieser Zeit aktiviert" VALUE 0x000C235A TKW_VV_VV_UW 100.0 Def_td_uw_q0p1 0.0 6553.5000 /begin FUNCTION_LIST PMDIAG /end FUNCTION_LIST FORMAT "%4.1" /end CHARACTERISTIC
/begin CHARACTERISTIC K_T_CCRUHVER "Dauer fuer CC-Meld. erhoehter Ruhestrom" VALUE 0x000C235C TKW_VV_VV_UW 100.0 Def_td_uw_q0p1 0.0 6553.5000 /begin FUNCTION_LIST PMDIAG /end FUNCTION_LIST FORMAT "%4.1" /end CHARACTERISTIC
/begin CHARACTERISTIC K_T_KMSHIFT "Delayzeit für Km_st Info-shift" VALUE 0x000C235E TKW_VV_VV_UW 100.0 Def_td_uw_q0p1 0.0 6553.5000 /begin FUNCTION_LIST PMDIAG /end FUNCTION_LIST FORMAT "%4.1" /end CHARACTERISTIC
/begin CHARACTERISTIC K_USPGAPP "Unterspannungschwelle" VALUE 0x000C2360 TKW_VV_VV_UW 100.0 Def_u_uw_q0p25em3_o6 6.0000 22.3837 /begin FUNCTION_LIST PMDIAG /end FUNCTION_LIST FORMAT "%7.4" /end CHARACTERISTIC
/begin CHARACTERISTIC CW_CCMASK "CC-Meldung Maske" VALUE 0x000C2362 TKW_VV_VV_UB 100.0 Def_dez_ub_q1 0.0 255.0000 /begin FUNCTION_LIST PMDIAG /end FUNCTION_LIST /end CHARACTERISTIC
/begin CHARACTERISTIC CW_PMDEFMASK "Bitcodierte Maske zum Setzen von PM Defekt" VALUE 0x000C2363 TKW_VV_VV_UB 100.0 Def_dez_ub_q1 0.0 255.0000 /begin FUNCTION_LIST PMDIAG /end FUNCTION_LIST /end CHARACTERISTIC
/begin CHARACTERISTIC K_BATTINDAPP "batt_index appl." VALUE 0x000C2364 TKW_VV_VV_UB 100.0 Def_dez_ub_q1 0.0 255.0000 /begin FUNCTION_LIST PMDIAG /end FUNCTION_LIST /end CHARACTERISTIC
/begin CHARACTERISTIC K_BATTREGAPP "Batterietauschregristrieren App" VALUE 0x000C2365 TKW_VV_VV_UB 100.0 Def_dez_ub_q1 0.0 255.0000 /begin FUNCTION_LIST PMDIAG /end FUNCTION_LIST /end CHARACTERISTIC
/begin CHARACTERISTIC K_CBATTAPP "Cbattnenn appl." VALUE 0x000C2366 TKW_VV_VV_UB 100.0 Def_ql_ub_q1 0.0 255.0000 /begin FUNCTION_LIST PMDIAG /end FUNCTION_LIST /end CHARACTERISTIC
/begin CHARACTERISTIC K_CCPRIOSET "Schwelle von E65Prios ab dem ccmeldung aktiv ist." VALUE 0x000C2367 TKW_VV_VV_UB 100.0 Def_dez_ub_q1 0.0 7.0000 /begin FUNCTION_LIST PMDIAG /end FUNCTION_LIST /end CHARACTERISTIC
/begin CHARACTERISTIC K_CCPRIOTIME "Zeitverschiebung bis ccmeldung gesetzt wird." VALUE 0x000C2368 TKW_VV_VV_UB 100.0 Def_td_ub_q0p1 0.0 25.5000 /begin FUNCTION_LIST PMDIAG /end FUNCTION_LIST /end CHARACTERISTIC
/begin CHARACTERISTIC K_HISTDMERST "Manueller Reset d. Histogramm in der DME" VALUE 0x000C2369 TKW_VV_VV_UB 100.0 Def_dez_ub_q1 0.0 255.0000 /begin FUNCTION_LIST PMDIAG /end FUNCTION_LIST /end CHARACTERISTIC
/begin CHARACTERISTIC K_HISTIBSRST "Manueller Histogramm Reset in IBS" VALUE 0x000C236A TKW_VV_VV_UB 100.0 Def_dez_ub_q1 0.0 255.0000 /begin FUNCTION_LIST PMDIAG /end FUNCTION_LIST /end CHARACTERISTIC
/begin CHARACTERISTIC K_IWAKEAPP "Wakeupgrenze Appl." VALUE 0x000C236B TKW_VV_VV_UB 100.0 Def_i_ub_q0p00125 0.0 0.2550 /begin FUNCTION_LIST PMDIAG /end FUNCTION_LIST /end CHARACTERISTIC
/begin CHARACTERISTIC K_KSOGRZAPP "Ikurz_ogrz appl." VALUE 0x000C236C TKW_VV_VV_UB 100.0 Def_i_ub_q5p12 0.0 998.4000 /begin FUNCTION_LIST PMDIAG /end FUNCTION_LIST /end CHARACTERISTIC
/begin CHARACTERISTIC K_KSUGRZAPP "Ikurz_ugrz Appl." VALUE 0x000C236D TKW_VV_VV_UB 100.0 Def_i_ub_q5p12 0.0 1000.0000 /begin FUNCTION_LIST PMDIAG /end FUNCTION_LIST /end CHARACTERISTIC
/begin CHARACTERISTIC K_OSPGPRELLZ "Anzahl der Entprellungen für Oberspannungsfehlereintrag" VALUE 0x000C236E TKW_VV_VV_UB 100.0 Def_dez_ub_q1 0.0 255.0000 /begin FUNCTION_LIST PMDIAG /end FUNCTION_LIST /end CHARACTERISTIC
/begin CHARACTERISTIC K_OSPRELLDEC "Dekrement auf Entprellcounter Oberspannung" VALUE 0x000C236F TKW_VV_VV_UB 100.0 Def_dez_ub_q1 0.0 255.0000 /begin FUNCTION_LIST PMDIAG /end FUNCTION_LIST /end CHARACTERISTIC
/begin CHARACTERISTIC K_OSPRELLINC "Inkrement auf Entprellcounter Oberspannung" VALUE 0x000C2370 TKW_VV_VV_UB 100.0 Def_dez_ub_q1 0.0 255.0000 /begin FUNCTION_LIST PMDIAG /end FUNCTION_LIST /end CHARACTERISTIC
/begin CHARACTERISTIC K_RUHVERMODE "Ruhestromverletzungserkennungsmode" VALUE 0x000C2371 TKW_VV_VV_UB 100.0 Def_dez_ub_q1 0.0 255.0000 /begin FUNCTION_LIST PMDIAG /end FUNCTION_LIST /end CHARACTERISTIC
/begin CHARACTERISTIC K_T1PMINFO "T1 Zykluszeit fuer PM Fehlerinfo" VALUE 0x000C2372 TKW_VV_VV_UB 100.0 Def_td_ub_q0p1 0.0 25.5000 /begin FUNCTION_LIST PMDIAG /end FUNCTION_LIST /end CHARACTERISTIC
/begin CHARACTERISTIC K_TCODIERPM "T1 Zyklus fuer Fehlerinfo" VALUE 0x000C2373 TKW_VV_VV_UB 100.0 Def_td_ub_q0p1 0.0 25.5000 /begin FUNCTION_LIST PMDIAG /end FUNCTION_LIST /end CHARACTERISTIC
/begin CHARACTERISTIC K_TRINGSHIFT "Ruhezeit nachdem der Ruhestrom-Ringspeicher eingetragen wird." VALUE 0x000C2374 TKW_VV_VV_UB 100.0 Def_td_ub_q0p9333 0.0 238.0000 /begin FUNCTION_LIST PMDIAG /end FUNCTION_LIST /end CHARACTERISTIC
/begin CHARACTERISTIC K_T_OSPGRSET "Zeit für 1x Oberspannungsentprellungrücknahme" VALUE 0x000C2375 TKW_VV_VV_UB 100.0 Def_td_ub_q0p1 0.0 25.5000 /begin FUNCTION_LIST PMDIAG /end FUNCTION_LIST /end CHARACTERISTIC
/begin CHARACTERISTIC K_T_OSPGSET "Entrpellzeit FS_oberspannungserkennung" VALUE 0x000C2376 TKW_VV_VV_UB 100.0 Def_td_ub_q0p1 0.0 25.5000 /begin FUNCTION_LIST PMDIAG /end FUNCTION_LIST /end CHARACTERISTIC
/begin CHARACTERISTIC K_T_RUHAUSW "Minimal verstrichene Zeit für Ruheverl. Auswertung" VALUE 0x000C2377 TKW_VV_VV_UB 100.0 Def_td_ub_q0p9333 0.0 238.0000 /begin FUNCTION_LIST PMDIAG /end FUNCTION_LIST /end CHARACTERISTIC
/begin CHARACTERISTIC K_T_SQSHIFT "Delayzeit für Soc_quali Info-shift" VALUE 0x000C2378 TKW_VV_VV_UB 100.0 Def_td_ub_q0p1 0.0 25.5000 /begin FUNCTION_LIST PMDIAG /end FUNCTION_LIST /end CHARACTERISTIC
/begin CHARACTERISTIC K_T_USPGRSET "Uterspannung Resetzeit" VALUE 0x000C2379 TKW_VV_VV_UB 100.0 Def_td_ub_q0p1 0.0 25.5000 /begin FUNCTION_LIST PMDIAG /end FUNCTION_LIST /end CHARACTERISTIC
/begin CHARACTERISTIC K_T_USPGSET "Zeit für 1x Unterspannungsentprellung" VALUE 0x000C237A TKW_VV_VV_UB 100.0 Def_td_ub_q0p1 0.0 25.5000 /begin FUNCTION_LIST PMDIAG /end FUNCTION_LIST /end CHARACTERISTIC
/begin CHARACTERISTIC K_USPGPRELLZ "Anzahl der FS_uspg Entprellungen für Fehlereintrag" VALUE 0x000C237B TKW_VV_VV_UB 100.0 Def_dez_ub_q1 0.0 255.0000 /begin FUNCTION_LIST PMDIAG /end FUNCTION_LIST /end CHARACTERISTIC
/begin CHARACTERISTIC K_USPRELLDEC "Dekrement auf Entprellcounter Unterspannung" VALUE 0x000C237C TKW_VV_VV_UB 100.0 Def_dez_ub_q1 0.0 255.0000 /begin FUNCTION_LIST PMDIAG /end FUNCTION_LIST /end CHARACTERISTIC
/begin CHARACTERISTIC K_USPRELLINC "Inkrement auf Entprellcounter Unterspannung" VALUE 0x000C237D TKW_VV_VV_UB 100.0 Def_dez_ub_q1 0.0 255.0000 /begin FUNCTION_LIST PMDIAG /end FUNCTION_LIST /end CHARACTERISTIC
/begin CHARACTERISTIC S_PMSV_HEIZ "Standheizen wird für Nibble-historie ausgewertet" VALUE 0x000C237E TKW_VV_VV_UB 100.0 Identity 0.0 1.0000 /begin FUNCTION_LIST PMDIAG /end FUNCTION_LIST /end CHARACTERISTIC
/begin CHARACTERISTIC S_PMSV_KLIMA "Standklimatisierung wird für Nibble-historie ausgewertet" VALUE 0x000C237F TKW_VV_VV_UB 100.0 Identity 0.0 1.0000 /begin FUNCTION_LIST PMDIAG /end FUNCTION_LIST /end CHARACTERISTIC
/begin CHARACTERISTIC S_PMSV_LUFT "Standlueften wird für Nibble-historie ausgewertet" VALUE 0x000C2380 TKW_VV_VV_UB 100.0 Identity 0.0 1.0000 /begin FUNCTION_LIST PMDIAG /end FUNCTION_LIST /end CHARACTERISTIC
/begin CHARACTERISTIC KL_T4RELMXRG "Max Toleranzzeit von T4 Ringshift" CURVE 0x000C2382 TKL_UW_VV_UW 100.0 Def_td_uw_q14 0.0 917490.0000 /begin FUNCTION_LIST PMDIAG /end FUNCTION_LIST
 /begin AXIS_DESCR STD_AXIS T_histsum Def_td_uw_q56 6 0.0 3669960.0000 FORMAT "%5.2" /end AXIS_DESCR
 FORMAT "%5.2" /end CHARACTERISTIC
/begin CHARACTERISTIC KL_CLASS2NENN "Batterieklasse -> Batteriegroesse" CURVE 0x000C239C TKL_UB_VV_UB 100.0 Def_ql_ub_q1 0.0 255.0000 /begin FUNCTION_LIST PMDIAG /end FUNCTION_LIST /begin AXIS_DESCR STD_AXIS Batt_class Def_dez_ub_q1 8 0.0 255.0000 /end AXIS_DESCR /end CHARACTERISTIC
/begin CHARACTERISTIC KL_T2RELMXRG "Max Toleranzzeit von T2 Ringshift" CURVE 0x000C23AE TKL_UW_VV_UW 100.0 Def_td_uw_q14 0.0 917490.0000 /begin FUNCTION_LIST PMDIAG /end FUNCTION_LIST
 /begin AXIS_DESCR STD_AXIS T_histsum Def_td_uw_q56 6 0.0 3669960.0000 FORMAT "%5.2" /end AXIS_DESCR
 FORMAT "%5.2" /end CHARACTERISTIC
/begin CHARACTERISTIC KL_T2RELMAX "Max Toleranzzeit von T2" CURVE 0x000C23C8 TKL_UW_VV_UW 100.0 Def_td_uw_q14 0.0 917490.0000 /begin FUNCTION_LIST PMDIAG /end FUNCTION_LIST
 /begin AXIS_DESCR STD_AXIS T_histsum Def_td_uw_q56 6 0.0 3669960.0000 FORMAT "%5.2" /end AXIS_DESCR
 FORMAT "%5.2" /end CHARACTERISTIC
/begin CHARACTERISTIC KL_T3RELMAX "Max Toleranzzeit von T3" CURVE 0x000C23E2 TKL_UW_VV_UW 100.0 Def_td_uw_q14 0.0 917490.0000 /begin FUNCTION_LIST PMDIAG /end FUNCTION_LIST
 /begin AXIS_DESCR STD_AXIS T_histsum Def_td_uw_q56 6 0.0 3669960.0000 FORMAT "%5.2" /end AXIS_DESCR
 FORMAT "%5.2" /end CHARACTERISTIC
/begin CHARACTERISTIC KL_CLASS2IND "Batterieklasse -> Batterieindex" CURVE 0x000C23FC TKL_UB_VV_UB 100.0 Def_dez_ub_q1 0.0 255.0000 /begin FUNCTION_LIST PMDIAG /end FUNCTION_LIST /begin AXIS_DESCR STD_AXIS Batt_class Def_dez_ub_q1 8 0.0 255.0000 /end AXIS_DESCR /end CHARACTERISTIC
/begin CHARACTERISTIC KL_T3RELMXRG "Max Toleranzzeit von T3 Ringshift" CURVE 0x000C240E TKL_UW_VV_UW 100.0 Def_td_uw_q14 0.0 917490.0000 /begin FUNCTION_LIST PMDIAG /end FUNCTION_LIST
 /begin AXIS_DESCR STD_AXIS T_histsum Def_td_uw_q56 6 0.0 3669960.0000 FORMAT "%5.2" /end AXIS_DESCR
 FORMAT "%5.2" /end CHARACTERISTIC
/begin CHARACTERISTIC KL_T4RELMAX "Max Toleranzzeit von T4" CURVE 0x000C2428 TKL_UW_VV_UW 100.0 Def_td_uw_q14 0.0 917490.0000 /begin FUNCTION_LIST PMDIAG /end FUNCTION_LIST
 /begin AXIS_DESCR STD_AXIS T_histsum Def_td_uw_q56 6 0.0 3669960.0000 FORMAT "%5.2" /end AXIS_DESCR
 FORMAT "%5.2" /end CHARACTERISTIC
/begin CHARACTERISTIC CW_PMMASKDFP "Powermanagement Fehlerpseicher Maske" VALUE 0x000C2381 TKW_VV_VV_UB 100.0 Def_dez_ub_q1 0.0 255.0000 /begin FUNCTION_LIST PMDIAG /end FUNCTION_LIST /end CHARACTERISTIC
/begin CHARACTERISTIC K_DSOCPCOS "dsoc, unterhalb derer die Standverbraucher deaktiviert werden." VALUE 0x000C2442 TKW_VV_VV_SW 100.0 Def_f_sw_b100 -100.0000 99.9969 /begin FUNCTION_LIST PMPRSVCALC /end FUNCTION_LIST FORMAT "%6.3" /end CHARACTERISTIC
/begin CHARACTERISTIC K_NKW2HIPTC "Nkw i.O. PTC darf zugeschaltet werden." VALUE 0x000C2444 TKW_VV_VV_SW 100.0 Def_n_sw_q1p0 -32768.0000 32767.0000 /begin FUNCTION_LIST PMPRSVCALC /end FUNCTION_LIST /end CHARACTERISTIC
/begin CHARACTERISTIC K_NKW2LOWPTC "Nkw zu niedrig, PTC wird abgeschaltet" VALUE 0x000C2446 TKW_VV_VV_SW 100.0 Def_n_sw_q1p0 -32768.0000 32767.0000 /begin FUNCTION_LIST PMPRSVCALC /end FUNCTION_LIST /end CHARACTERISTIC
/begin CHARACTERISTIC K_DUDTPTCAUS "K-Faktor für dudt-PTC Abschaltung" VALUE 0x000C2448 TKW_VV_VV_UW 100.0 Def_f_uw_b1 0.0 9.99984741210938e-1 /begin FUNCTION_LIST PMPRSVCALC /end FUNCTION_LIST /end CHARACTERISTIC
/begin CHARACTERISTIC K_IPMPMDEC "Prio-dekrementfaktor aufgrund IPM" VALUE 0x000C244A TKW_VV_VV_UW 100.0 Def_f_uw_q0p25 0.0 450.0000 /begin FUNCTION_LIST PMPRSVCALC /end FUNCTION_LIST FORMAT "%6.3" /end CHARACTERISTIC
/begin CHARACTERISTIC K_IPMPMINC "Prio-Inkrementfaktor aufgrund IPM" VALUE 0x000C244C TKW_VV_VV_UW 100.0 Def_f_uw_q0p25 0.0 450.0000 /begin FUNCTION_LIST PMPRSVCALC /end FUNCTION_LIST FORMAT "%6.3" /end CHARACTERISTIC
/begin CHARACTERISTIC K_MN_PTCPI "Minimalwert des PI-Reglers PTC Ansteuerung" VALUE 0x000C244E TKW_VV_VV_UW 100.0 Def_f_uw_b512 0.0 511.9921 /begin FUNCTION_LIST PMPRSVCALC /end FUNCTION_LIST FORMAT "%6.3" /end CHARACTERISTIC
/begin CHARACTERISTIC K_MN_PWRDFPI "Minimaler Wert PI-Regler df Prio" VALUE 0x000C2450 TKW_VV_VV_UW 100.0 Def_f_uw_b512 0.0 511.9921 /begin FUNCTION_LIST PMPRSVCALC /end FUNCTION_LIST FORMAT "%6.3" /end CHARACTERISTIC
/begin CHARACTERISTIC K_MX_PTCPI "Maximalwert des PI-Reglers PTC Ansteuerung" VALUE 0x000C2452 TKW_VV_VV_UW 100.0 Def_f_uw_b512 0.0 511.9921 /begin FUNCTION_LIST PMPRSVCALC /end FUNCTION_LIST FORMAT "%6.3" /end CHARACTERISTIC
/begin CHARACTERISTIC K_PWRCOS15 "PWRCOS bei Kl.15, Motor aus" VALUE 0x000C2454 TKW_VV_VV_UW 100.0 Def_dez_uw_q1 0.0 65535.0000 /begin FUNCTION_LIST PMPRSVCALC /end FUNCTION_LIST /end CHARACTERISTIC
/begin CHARACTERISTIC K_PWRCOSAPP "Steuerung Leistung Verbraucher bitcodiert Applikationsgroesse" VALUE 0x000C2456 TKW_VV_VV_UW 100.0 Def_dez_uw_q1 0.0 65535.0000 /begin FUNCTION_LIST PMPRSVCALC /end FUNCTION_LIST /end CHARACTERISTIC
/begin CHARACTERISTIC K_PWRCOSHT "ctrpwrcos-Wert bei Generator Hochtemperatur" VALUE 0x000C2458 TKW_VV_VV_UW 100.0 Def_dez_uw_q1 0.0 65535.0000 /begin FUNCTION_LIST PMPRSVCALC /end FUNCTION_LIST /end CHARACTERISTIC
/begin CHARACTERISTIC K_PWRCOSULEV "Bitcodierte ctrpwrcos Zuschaltung bei Sulev" VALUE 0x000C245A TKW_VV_VV_UW 100.0 Def_dez_uw_q1 0.0 65535.0000 /begin FUNCTION_LIST PMPRSVCALC /end FUNCTION_LIST /end CHARACTERISTIC
/begin CHARACTERISTIC K_PWRCOS_R "PowerCos Bitcodiert bei Kl.R" VALUE 0x000C245C TKW_VV_VV_UW 100.0 Def_dez_uw_q1 0.0 65535.0000 /begin FUNCTION_LIST PMPRSVCALC /end FUNCTION_LIST /end CHARACTERISTIC
/begin CHARACTERISTIC K_PWRCSGNDEF "ctrpwrcos-Wert bei Gen. mechn. el. Fehler" VALUE 0x000C245E TKW_VV_VV_UW 100.0 Def_dez_uw_q1 0.0 65535.0000 /begin FUNCTION_LIST PMPRSVCALC /end FUNCTION_LIST /end CHARACTERISTIC
/begin CHARACTERISTIC K_PWRCSKOMM "ctrpwrcos Wert bei Gen. Komm. Fehler" VALUE 0x000C2460 TKW_VV_VV_UW 100.0 Def_dez_uw_q1 0.0 65535.0000 /begin FUNCTION_LIST PMPRSVCALC /end FUNCTION_LIST /end CHARACTERISTIC
/begin CHARACTERISTIC K_TD_PWRDFPI "K-Faktor des PI Reglers zur Berechnung von ctrpwrdf" VALUE 0x000C2462 TKW_VV_VV_UW 100.0 Def_td_uw_q0p1 0.1000 6553.5000 /begin FUNCTION_LIST PMPRSVCALC /end FUNCTION_LIST FORMAT "%4.1" /end CHARACTERISTIC
/begin CHARACTERISTIC K_T_PTCPI "T-Faktor des PI-Reglers für PTC-Ansteuerung" VALUE 0x000C2464 TKW_VV_VV_UW 100.0 Def_td_uw_q0p1 0.1000 6553.5000 /begin FUNCTION_LIST PMPRSVCALC /end FUNCTION_LIST FORMAT "%4.1" /end CHARACTERISTIC
/begin CHARACTERISTIC K_T_SULEVON "Zeit für SULEV-ctrpwrcos-prios nach Motorstart" VALUE 0x000C2466 TKW_VV_VV_UW 100.0 Def_td_uw_q0p1 0.0 6553.5000 /begin FUNCTION_LIST PMPRSVCALC /end FUNCTION_LIST FORMAT "%4.1" /end CHARACTERISTIC
/begin CHARACTERISTIC K_UBAT_LP "K-Faktor des ubatt-tiefpass Filters zur Berechnung von ctrpwrdf" VALUE 0x000C2468 TKW_VV_VV_UW 100.0 Def_f_uw_b1 0.0 9.99984741210938e-1 /begin FUNCTION_LIST PMPRSVCALC /end FUNCTION_LIST /end CHARACTERISTIC
/begin CHARACTERISTIC K_UBPTC_LP "K-Faktor des ubatt-Tiefpass Filters zur Berechnung von PTC" VALUE 0x000C246A TKW_VV_VV_UW 100.0 Def_f_uw_b1 0.0 9.99984741210938e-1 /begin FUNCTION_LIST PMPRSVCALC /end FUNCTION_LIST /end CHARACTERISTIC
/begin CHARACTERISTIC K_UBTAPP "Batteriespannung Applikationsgroesse" VALUE 0x000C246C TKW_VV_VV_UW 100.0 Def_u_uw_q0p015 0.0 61.4250 /begin FUNCTION_LIST PMPRSVCALC /end FUNCTION_LIST FORMAT "%6.3" /end CHARACTERISTIC
/begin CHARACTERISTIC K_UBTLOWMAX "Obere Unterspannungsgrenze" VALUE 0x000C246E TKW_VV_VV_UW 100.0 Def_u_uw_q0p25em3_o6 6.0000 16.0000 /begin FUNCTION_LIST PMPRSVCALC /end FUNCTION_LIST FORMAT "%7.4" /end CHARACTERISTIC
/begin CHARACTERISTIC K_UBTLOWMIN "Untere Unterspannungsgrenze" VALUE 0x000C2470 TKW_VV_VV_UW 100.0 Def_u_uw_q0p25em3_o6 6.0000 16.0000 /begin FUNCTION_LIST PMPRSVCALC /end FUNCTION_LIST FORMAT "%7.4" /end CHARACTERISTIC
/begin CHARACTERISTIC K_CTRCBRA "" VALUE 0x000C249C TKW_VV_VV_UB 100.0 Def_dez_ub_q1 0.0 255.0000 /begin FUNCTION_LIST PMPRSVCALC /end FUNCTION_LIST /end CHARACTERISTIC
/begin CHARACTERISTIC K_CTRCBRAPP "Steuerung Stromzweige Applikationsgroesse" VALUE 0x000C249D TKW_VV_VV_UB 100.0 Def_dez_ub_q1 0.0 255.0000 /begin FUNCTION_LIST PMPRSVCALC /end FUNCTION_LIST /end CHARACTERISTIC
/begin CHARACTERISTIC K_CTRCBRKBM "CTRCBR APP bei B_startfgk" VALUE 0x000C249E TKW_VV_VV_UB 100.0 Def_dez_ub_q1 0.0 255.0000 /begin FUNCTION_LIST PMPRSVCALC /end FUNCTION_LIST /end CHARACTERISTIC
/begin CHARACTERISTIC K_CTRPCOSAPP "Steuerung Standverbraucher Applikationsgroesse" VALUE 0x000C249F TKW_VV_VV_UB 100.0 Def_dez_ub_q1 0.0 3.0000 /begin FUNCTION_LIST PMPRSVCALC /end FUNCTION_LIST /end CHARACTERISTIC
/begin CHARACTERISTIC K_CTRPRIOAPP "Steuerung Spitzenreduzierung Prioritaet Applikationsgroesse" VALUE 0x000C24A0 TKW_VV_VV_UB 100.0 Def_dez_ub_q1 0.0 7.0000 /begin FUNCTION_LIST PMPRSVCALC /end FUNCTION_LIST /end CHARACTERISTIC
/begin CHARACTERISTIC K_DFFILTAPP "Schalter, um dffgenfilt auf DFFILT_APP umzustellen" VALUE 0x000C24A1 TKW_VV_VV_UB 100.0 Def_f_ub_b100 0.0 99.6093 /begin FUNCTION_LIST PMPRSVCALC /end FUNCTION_LIST /end CHARACTERISTIC
/begin CHARACTERISTIC K_DFKOMMERR "Ersatzwert Dffgen bei Gen. Komm. Fehler" VALUE 0x000C24A2 TKW_VV_VV_UB 100.0 Def_f_ub_b100 0.0 99.6093 /begin FUNCTION_LIST PMPRSVCALC /end FUNCTION_LIST /end CHARACTERISTIC
/begin CHARACTERISTIC K_DFPTC_LP "K-Faktor des df-Tiefpass Filters zur Berechnung von PTC" VALUE 0x000C24A3 TKW_VV_VV_UB 100.0 Def_f_ub_b1 0.0 0.9960 /begin FUNCTION_LIST PMPRSVCALC /end FUNCTION_LIST /end CHARACTERISTIC
/begin CHARACTERISTIC K_DF_LP "K-Faktor des df-Tiefpass Filters zur Berechnung von ctrpwrdf" VALUE 0x000C24A4 TKW_VV_VV_UB 100.0 Def_f_ub_b1 0.0 0.9960 /begin FUNCTION_LIST PMPRSVCALC /end FUNCTION_LIST /end CHARACTERISTIC
/begin CHARACTERISTIC K_IBSWAKEAPP "Bit, ob IBS Bus wecken darf oder nicht. Applikationsgroesse." VALUE 0x000C24A5 TKW_VV_VV_UB 100.0 Def_dez_ub_q1 0.0 255.0000 /begin FUNCTION_LIST PMPRSVCALC /end FUNCTION_LIST /end CHARACTERISTIC
/begin CHARACTERISTIC K_KBMCNT_APP "Zeit, indem KBM alle Straenge einschalten soll." VALUE 0x000C24A6 TKW_VV_VV_UB 100.0 Def_td_ub_q0p1 0.0 25.5000 /begin FUNCTION_LIST PMPRSVCALC /end FUNCTION_LIST /end CHARACTERISTIC
/begin CHARACTERISTIC K_LLPMFILTK "Filterkonstante : Tiefpassfilter DF-Signal" VALUE 0x000C24A7 TKW_VV_VV_UB 100.0 Def_f_ub_b1 0.0 0.9960 /begin FUNCTION_LIST PMPRSVCALC /end FUNCTION_LIST /end CHARACTERISTIC
/begin CHARACTERISTIC K_PM_IPMON "IPM Massnahmen bzgl. PM aktiviert" VALUE 0x000C24A8 TKW_VV_VV_UB 100.0 Def_dez_ub_q1 0.0 3.0000 /begin FUNCTION_LIST PMPRSVCALC /end FUNCTION_LIST /end CHARACTERISTIC
/begin CHARACTERISTIC K_PRIO15 "Prios bei Kl.15, Motor aus" VALUE 0x000C24A9 TKW_VV_VV_UB 100.0 Def_dez_ub_q1 0.0 7.0000 /begin FUNCTION_LIST PMPRSVCALC /end FUNCTION_LIST /end CHARACTERISTIC
/begin CHARACTERISTIC K_PRIOCF15 "PrioCF bei kl.15, Motor aus" VALUE 0x000C24AA TKW_VV_VV_UB 100.0 Def_dez_ub_q1 0.0 7.0000 /begin FUNCTION_LIST PMPRSVCALC /end FUNCTION_LIST /end CHARACTERISTIC
/begin CHARACTERISTIC K_PRIOCFAPP "Steuerung Spitzenreduzierung Prioritaet Komfort App" VALUE 0x000C24AB TKW_VV_VV_UB 100.0 Def_dez_ub_q1 0.0 7.0000 /begin FUNCTION_LIST PMPRSVCALC /end FUNCTION_LIST /end CHARACTERISTIC
/begin CHARACTERISTIC K_PRIOCF_R "Prio Comfort Bei Kl.R" VALUE 0x000C24AC TKW_VV_VV_UB 100.0 Def_dez_ub_q1 0.0 7.0000 /begin FUNCTION_LIST PMPRSVCALC /end FUNCTION_LIST /end CHARACTERISTIC
/begin CHARACTERISTIC K_PRIO_R "Prio Bei Kl.R" VALUE 0x000C24AD TKW_VV_VV_UB 100.0 Def_dez_ub_q1 0.0 7.0000 /begin FUNCTION_LIST PMPRSVCALC /end FUNCTION_LIST /end CHARACTERISTIC
/begin CHARACTERISTIC K_PTCPWRAPP "Ansteuerung PWM-Ausgang für PTC-Zuheizer. Applikationsgroesse." VALUE 0x000C24AE TKW_VV_VV_UB 100.0 Def_f_ub_b127p5 0.0 127.5000 /begin FUNCTION_LIST PMPRSVCALC /end FUNCTION_LIST /end CHARACTERISTIC
/begin CHARACTERISTIC K_PTC_PI "K-Faktor des PI-Reglers PTC-Ansteuerung" VALUE 0x000C24AF TKW_VV_VV_UB 100.0 Def_f_ub_b1 0.0 0.9960 /begin FUNCTION_LIST PMPRSVCALC /end FUNCTION_LIST /end CHARACTERISTIC
/begin CHARACTERISTIC K_PWRDF_PI "K-Faktor des PI Reglers zur Berechnung von ctrpwrdf" VALUE 0x000C24B0 TKW_VV_VV_UB 100.0 Def_f_ub_b1 0.0 0.9960 /begin FUNCTION_LIST PMPRSVCALC /end FUNCTION_LIST /end CHARACTERISTIC
/begin CHARACTERISTIC K_RESET_PI "PI-Reset-Zeit bei steigender Kl.15" VALUE 0x000C24B1 TKW_VV_VV_UB 100.0 Def_td_ub_q0p1 0.0 25.5000 /begin FUNCTION_LIST PMPRSVCALC /end FUNCTION_LIST /end CHARACTERISTIC
/begin CHARACTERISTIC K_RQPCOSA "Parameter für SV-Anmeldung" VALUE 0x000C24B2 TKW_VV_VV_UB 100.0 Def_dez_ub_q1 0.0 3.0000 /begin FUNCTION_LIST PMPRSVCALC /end FUNCTION_LIST /end CHARACTERISTIC
/begin CHARACTERISTIC K_RQPCOSAPP "Anforderung Standverbraucher Applikationsgroesse" VALUE 0x000C24B3 TKW_VV_VV_UB 100.0 Def_dez_ub_q1 0.0 255.0000 /begin FUNCTION_LIST PMPRSVCALC /end FUNCTION_LIST /end CHARACTERISTIC
/begin CHARACTERISTIC K_RQULCP "RQPCOS Master umschalter" VALUE 0x000C24B4 TKW_VV_VV_UB 100.0 Def_dez_ub_q1 0.0 4.0000 /begin FUNCTION_LIST PMPRSVCALC /end FUNCTION_LIST /end CHARACTERISTIC
/begin CHARACTERISTIC K_SELSPCOSA "Spezialverbraucher" VALUE 0x000C24B5 TKW_VV_VV_UB 100.0 Def_dez_ub_q1 0.0 15.0000 /begin FUNCTION_LIST PMPRSVCALC /end FUNCTION_LIST /end CHARACTERISTIC
/begin CHARACTERISTIC K_SELSPCSAPP "Auswahl Sonderverbraucher Applikationsgroesse" VALUE 0x000C24B6 TKW_VV_VV_UB 100.0 Def_dez_ub_q1 0.0 15.0000 /begin FUNCTION_LIST PMPRSVCALC /end FUNCTION_LIST /end CHARACTERISTIC
/begin CHARACTERISTIC K_STPCOSAPP "Status Standverbraucher Applikationsgroesse" VALUE 0x000C24B7 TKW_VV_VV_UB 100.0 Def_dez_ub_q1 0.0 3.0000 /begin FUNCTION_LIST PMPRSVCALC /end FUNCTION_LIST /end CHARACTERISTIC
/begin CHARACTERISTIC K_T_IPMPRIO "max. Zeit, indem Prio aufgrund IPM gesteuert wird" VALUE 0x000C24B8 TKW_VV_VV_UB 100.0 Def_td_ub_q0p1 0.0 25.5000 /begin FUNCTION_LIST PMPRSVCALC /end FUNCTION_LIST /end CHARACTERISTIC
/begin CHARACTERISTIC K_T_NKPTCAUS "Zeit PTC aus aufgrund NKW zu niedrig." VALUE 0x000C24B9 TKW_VV_VV_UB 100.0 Def_td_ub_q0p1 0.0 25.5000 /begin FUNCTION_LIST PMPRSVCALC /end FUNCTION_LIST /end CHARACTERISTIC
/begin CHARACTERISTIC K_T_PMBS "Zeit bis zum nächsten zyklischen senden" VALUE 0x000C24BA TKW_VV_VV_UB 100.0 Def_td_ub_q1 0.0 255.0000 /begin FUNCTION_LIST PMPRSVCALC /end FUNCTION_LIST /end CHARACTERISTIC
/begin CHARACTERISTIC K_T_PMVS "Zeit zwischen zwei zyklischen Sendungen von 3b3 " VALUE 0x000C24BB TKW_VV_VV_UB 100.0 Def_td_ub_q1 0.0 255.0000 /begin FUNCTION_LIST PMPRSVCALC /end FUNCTION_LIST /end CHARACTERISTIC
/begin CHARACTERISTIC K_T_PTCKWAN "PTC-Ein Wartezeit nach Motor an." VALUE 0x000C24BC TKW_VV_VV_UB 100.0 Def_td_ub_q0p1 0.0 25.5000 /begin FUNCTION_LIST PMPRSVCALC /end FUNCTION_LIST /end CHARACTERISTIC
/begin CHARACTERISTIC K_ULEVA "Spannungslevel" VALUE 0x000C24BD TKW_VV_VV_UB 100.0 Def_dez_ub_q1 0.0 255.0000 /begin FUNCTION_LIST PMPRSVCALC /end FUNCTION_LIST /end CHARACTERISTIC
/begin CHARACTERISTIC K_ULEVAPP "Spannungsebene Applikationsgroesse" VALUE 0x000C24BE TKW_VV_VV_UB 100.0 Def_dez_ub_q1 0.0 15.0000 /begin FUNCTION_LIST PMPRSVCALC /end FUNCTION_LIST /end CHARACTERISTIC
/begin CHARACTERISTIC K_ULOWSETAPP "Entrpellzeit zentrale Unterspannung" VALUE 0x000C24BF TKW_VV_VV_UB 100.0 Def_td_ub_q0p1 0.0 25.5000 /begin FUNCTION_LIST PMPRSVCALC /end FUNCTION_LIST /end CHARACTERISTIC
/begin CHARACTERISTIC S_DFKOMMERR "Maßnahmen bei Gen. Komm. Fehler aktiv" VALUE 0x000C24C0 TKW_VV_VV_UB 100.0 Identity 0.0 1.0000 /begin FUNCTION_LIST PMPRSVCALC /end FUNCTION_LIST /end CHARACTERISTIC
/begin CHARACTERISTIC S_IPMPTC "PTC Einschränkung aufgrund IPM" VALUE 0x000C24C1 TKW_VV_VV_UB 100.0 Identity 0.0 1.0000 /begin FUNCTION_LIST PMPRSVCALC /end FUNCTION_LIST /end CHARACTERISTIC
/begin CHARACTERISTIC S_PMMESS "Schalter Messemode aktiv" VALUE 0x000C24C2 TKW_VV_VV_UB 100.0 Identity 0.0 1.0000 /begin FUNCTION_LIST PMPRSVCALC /end FUNCTION_LIST /end CHARACTERISTIC
/begin CHARACTERISTIC S_PRIOCFENA "" VALUE 0x000C24C3 TKW_VV_VV_UB 100.0 Identity 0.0 1.0000 /begin FUNCTION_LIST PMPRSVCALC /end FUNCTION_LIST /end CHARACTERISTIC
/begin CHARACTERISTIC S_PRIOMANUAL "Manueller Schalter fuer E60/E65-Can Botschaften" VALUE 0x000C24C4 TKW_VV_VV_UB 100.0 Def_dez_ub_q1 0.0 255.0000 /begin FUNCTION_LIST PMPRSVCALC /end FUNCTION_LIST /end CHARACTERISTIC
/begin CHARACTERISTIC S_PTCKOOR "Schalter Aktivierung PTC Koordinator im PMPRSVCALC" VALUE 0x000C24C5 TKW_VV_VV_UB 100.0 Identity 0.0 1.0000 /begin FUNCTION_LIST PMPRSVCALC /end FUNCTION_LIST /end CHARACTERISTIC
/begin CHARACTERISTIC S_PTCMANUAL "Schalter manueller PTC Wert aktivieren." VALUE 0x000C24C6 TKW_VV_VV_UB 100.0 Identity 0.0 1.0000 /begin FUNCTION_LIST PMPRSVCALC /end FUNCTION_LIST /end CHARACTERISTIC
/begin CHARACTERISTIC S_PWRCFENA "" VALUE 0x000C24C7 TKW_VV_VV_UB 100.0 Identity 0.0 1.0000 /begin FUNCTION_LIST PMPRSVCALC /end FUNCTION_LIST /end CHARACTERISTIC
/begin CHARACTERISTIC K_CTRPWRCF "" VAL_BLK 0x000C2472 TKW_VV_VV_UW 100.0 Def_dez_uw_q1 0.0 65535.0000 /begin FUNCTION_LIST PMPRSVCALC /end FUNCTION_LIST NUMBER 7 /end CHARACTERISTIC
/begin CHARACTERISTIC K_CTRPWRDF "" VAL_BLK 0x000C2480 TKW_VV_VV_UW 100.0 Def_dez_uw_q1 0.0 65535.0000 /begin FUNCTION_LIST PMPRSVCALC /end FUNCTION_LIST NUMBER 14 /end CHARACTERISTIC
/begin CHARACTERISTIC K_CTRPRIOCF "" VAL_BLK 0x000C24C8 TKW_VV_VV_UB 100.0 Def_dez_ub_q1 0.0 255.0000 /begin FUNCTION_LIST PMPRSVCALC /end FUNCTION_LIST NUMBER 7 /end CHARACTERISTIC
/begin CHARACTERISTIC K_PRIODF "" VAL_BLK 0x000C24D0 TKW_VV_VV_UB 100.0 Def_dez_ub_q1 0.0 255.0000 /begin FUNCTION_LIST PMPRSVCALC /end FUNCTION_LIST NUMBER 7 /end CHARACTERISTIC
/begin CHARACTERISTIC KL_UB_PTC "UBatt-Kennlinie für Ansteuerung PTC" CURVE 0x000C24D8 TKL_SW_VV_SW 100.0 Def_f_sw_p0q25 -100.0000 100.0000 /begin FUNCTION_LIST PMPRSVCALC /end FUNCTION_LIST
 /begin AXIS_DESCR STD_AXIS Ubtpt1ptc Def_f_sw_b32 6 -32.0000 31.9990 FORMAT "%7.4" /end AXIS_DESCR
 FORMAT "%5.2" /end CHARACTERISTIC
/begin CHARACTERISTIC KL_PTC "PWM-Übersetzer für PTC-Ansteuerung" CURVE 0x000C24F2 TKL_UW_VV_UB 100.0 Def_f_ub_b127p5 0.0 127.5000 /begin FUNCTION_LIST PMPRSVCALC /end FUNCTION_LIST
 /begin AXIS_DESCR STD_AXIS Allptcfilt Def_f_uw_q0p25 5 0.0 16383.7500 FORMAT "%6.3" /end AXIS_DESCR
/end CHARACTERISTIC
/begin CHARACTERISTIC KL_I2PTC "I-Delta Übersetzer zu PTC Ansteuerung" CURVE 0x000C2504 TKL_UW_VV_SW 100.0 Def_f_sw_p0q25 -100.0000 100.0000 /begin FUNCTION_LIST PMPRSVCALC /end FUNCTION_LIST
 /begin AXIS_DESCR STD_AXIS Isolldiff Def_i_uw_q0p08_o200 6 -200.0000 5042.8000 FORMAT "%6.3" /end AXIS_DESCR
 FORMAT "%5.2" /end CHARACTERISTIC
/begin CHARACTERISTIC KL_PRIOCF "" CURVE 0x000C251E TKL_SW_VV_UB 100.0 Def_dez_ub_q1 0.0 6.0000 /begin FUNCTION_LIST PMPRSVCALC /end FUNCTION_LIST
 /begin AXIS_DESCR STD_AXIS Dsoc2pi Def_f_sw_p0q25 7 -8192.0000 8191.7500 FORMAT "%5.2" /end AXIS_DESCR
/end CHARACTERISTIC
/begin CHARACTERISTIC KL_PWRCF "" CURVE 0x000C2536 TKL_SW_VV_UB 100.0 Def_dez_ub_q1 0.0 6.0000 /begin FUNCTION_LIST PMPRSVCALC /end FUNCTION_LIST
 /begin AXIS_DESCR STD_AXIS Dsoc2pi Def_f_sw_p0q25 7 -8192.0000 8191.7500 FORMAT "%5.2" /end AXIS_DESCR
/end CHARACTERISTIC
/begin CHARACTERISTIC KL_WUBPTC "KL Multiplikationsfaktor W_ub bei SpgEinbruch" CURVE 0x000C254E TKL_UW_VV_UB 100.0 Def_f_ub_b4 0.0 3.9843 /begin FUNCTION_LIST PMPRSVCALC /end FUNCTION_LIST /begin AXIS_DESCR STD_AXIS Ub Def_u_uw_q0p0942 5 0.0 6173.3970 FORMAT "%4.1" /end AXIS_DESCR /end CHARACTERISTIC
/begin CHARACTERISTIC KL_DFPTC "Gefiltertes dffgen -> Prio_Gewichtung -Übersetzer" CURVE 0x000C2560 TKL_UB_VV_SW 100.0 Def_f_sw_p0q25 -100.0000 100.0000 /begin FUNCTION_LIST PMPRSVCALC /end FUNCTION_LIST /begin AXIS_DESCR STD_AXIS Dfpt1ptc Def_f_ub_b100 6 0.0 99.6093 /end AXIS_DESCR FORMAT "%5.2" /end CHARACTERISTIC
/begin CHARACTERISTIC KL_PWRDF "" CURVE 0x000C2574 TKL_UW_VV_UB 100.0 Def_dez_ub_q1 0.0 13.0000 /begin FUNCTION_LIST PMPRSVCALC /end FUNCTION_LIST
 /begin AXIS_DESCR STD_AXIS Dfprio Def_f_uw_q0p25 14 0.0 16383.7500 FORMAT "%6.3" /end AXIS_DESCR
/end CHARACTERISTIC
/begin CHARACTERISTIC KL_PRIO2PTC "Gewichtung der Prios auf Gewichtung fuer PTC Ansteuerung" CURVE 0x000C25A0 TKL_UW_VV_SW 100.0 Def_f_sw_p0q25 -100.0000 100.0000 /begin FUNCTION_LIST PMPRSVCALC /end FUNCTION_LIST
 /begin AXIS_DESCR STD_AXIS Dfprio Def_f_uw_q0p25 5 0.0 16383.7500 FORMAT "%6.3" /end AXIS_DESCR
 FORMAT "%5.2" /end CHARACTERISTIC
/begin CHARACTERISTIC KL_SOCPRIO "dsoc -> Prio Übersetzer" CURVE 0x000C25B6 TKL_SW_VV_SW 100.0 Def_f_sw_p0q25 -150.0000 150.0000 /begin FUNCTION_LIST PMPRSVCALC /end FUNCTION_LIST
 /begin AXIS_DESCR STD_AXIS D_soc Def_f_sw_b100 4 -100.0000 99.9969 FORMAT "%6.3" /end AXIS_DESCR
 FORMAT "%5.2" /end CHARACTERISTIC
/begin CHARACTERISTIC KL_DFPRIO "Dffgen Prio Übersetzer" CURVE 0x000C25C8 TKL_UB_VV_SW 100.0 Def_f_sw_p0q25 -100.0000 100.0000 /begin FUNCTION_LIST PMPRSVCALC /end FUNCTION_LIST /begin AXIS_DESCR STD_AXIS Dfpt1filt Def_f_ub_b100 6 0.0 99.6093 /end AXIS_DESCR FORMAT "%5.2" /end CHARACTERISTIC
/begin CHARACTERISTIC KL_UBTPRIO "Delta-Spannung -> Prio Übersetzer" CURVE 0x000C25DC TKL_SW_VV_SW 100.0 Def_f_sw_p0q25 -100.0000 100.0000 /begin FUNCTION_LIST PMPRSVCALC /end FUNCTION_LIST
 /begin AXIS_DESCR STD_AXIS Ubdiffilt Def_f_sw_b32 6 -32.0000 31.9990 FORMAT "%7.4" /end AXIS_DESCR
 FORMAT "%5.2" /end CHARACTERISTIC
/begin CHARACTERISTIC KL_IREST "Noch verfuegbare Restleistung vom Generator." CURVE 0x000C25F6 TKL_UW_VV_SW 100.0 Def_f_sw_p0q25 -100.0000 100.0000 /begin FUNCTION_LIST PMPRSVCALC /end FUNCTION_LIST
 /begin AXIS_DESCR STD_AXIS Pgenrest Def_f_uw_q0p25 10 0.0 16383.7500 FORMAT "%6.3" /end AXIS_DESCR
 FORMAT "%5.2" /end CHARACTERISTIC
/begin CHARACTERISTIC KL_DUDTPTC "Übersetzer dudtmul -> PTC Add. Gewichtung" CURVE 0x000C2620 TKL_SW_VV_UW 100.0 Def_f_uw_q0p25 0.0 550.0000 /begin FUNCTION_LIST PMPRSVCALC /end FUNCTION_LIST
 /begin AXIS_DESCR STD_AXIS Dudtmul Def_f_sw_q0p000147 5 -48.2304 48.2289 FORMAT "%7.4" /end AXIS_DESCR
 FORMAT "%6.3" /end CHARACTERISTIC
/begin CHARACTERISTIC KL_DSOCPTC "Kennlinie dsoc auf PTC-Ansteuerung Übersetzer" CURVE 0x000C2636 TKL_SW_VV_SW 100.0 Def_f_sw_p0q25 -150.0000 150.0000 /begin FUNCTION_LIST PMPRSVCALC /end FUNCTION_LIST
 /begin AXIS_DESCR STD_AXIS D_soc Def_f_sw_b100 4 -100.0000 99.9969 FORMAT "%6.3" /end AXIS_DESCR
 FORMAT "%5.2" /end CHARACTERISTIC
/begin CHARACTERISTIC KL_ISOLLPR "Delta-I -> Prio Übersetzer" CURVE 0x000C2648 TKL_UW_VV_SW 100.0 Def_f_sw_p0q25 -100.0000 100.0000 /begin FUNCTION_LIST PMPRSVCALC /end FUNCTION_LIST
 /begin AXIS_DESCR STD_AXIS Ibtdiff Def_i_uw_q0p08_o200 6 -200.0000 5042.8000 FORMAT "%6.3" /end AXIS_DESCR
 FORMAT "%5.2" /end CHARACTERISTIC
/begin CHARACTERISTIC KL_DSOCPRIO "" CURVE 0x000C2662 TKL_SW_VV_UW 100.0 Def_f_uw_b512 0.0 511.9921 /begin FUNCTION_LIST PMPRSVCALC /end FUNCTION_LIST
 /begin AXIS_DESCR STD_AXIS D_soc Def_f_sw_b100 5 -100.0000 99.9969 FORMAT "%6.3" /end AXIS_DESCR
 FORMAT "%6.3" /end CHARACTERISTIC
/begin CHARACTERISTIC KL_PRIODF "" CURVE 0x000C2678 TKL_UW_VV_UB 100.0 Def_dez_ub_q1 0.0 6.0000 /begin FUNCTION_LIST PMPRSVCALC /end FUNCTION_LIST
 /begin AXIS_DESCR STD_AXIS Dfprio Def_f_uw_q0p25 7 0.0 16383.7500 FORMAT "%6.3" /end AXIS_DESCR
/end CHARACTERISTIC
/begin CHARACTERISTIC KF_IBTSOLL "KFSollstrom aufgrund von Batterietemperatur und Ladezustand." MAP 0x000C2690 TKF_SW_SW_UW 100.0 Def_i_uw_q0p08_o200 -200.0000 5042.8000 /begin FUNCTION_LIST PMPRSVCALC /end FUNCTION_LIST
 /begin AXIS_DESCR STD_AXIS T_batt Def_t_sw_q0p1 5 -3276.8000 3276.7000 FORMAT "%4.1" /end AXIS_DESCR
 /begin AXIS_DESCR STD_AXIS D_soc Def_f_sw_b100 6 -100.0000 99.9969 FORMAT "%6.3" /end AXIS_DESCR
 FORMAT "%6.3" /end CHARACTERISTIC
/begin CHARACTERISTIC K_Q_BILAPWF "Defaultwert für q_bila nach Powerfail" VALUE 0x000C26E4 TKW_VV_VV_UW 100.0 Def_ql_uw_q0p0182 0.0 1193.0282 /begin FUNCTION_LIST PMSOCCALC /end FUNCTION_LIST FORMAT "%6.3" /end CHARACTERISTIC
/begin CHARACTERISTIC K_SOC_BILAWA "Applikationswert soc_bila" VALUE 0x000C26E6 TKW_VV_VV_UW 100.0 Def_f_uw_b100 0.0 99.9984 /begin FUNCTION_LIST PMSOCCALC /end FUNCTION_LIST FORMAT "%6.3" /end CHARACTERISTIC
/begin CHARACTERISTIC K_SOC_QPWF "Ladezustandsqualität nach Powerfail" VALUE 0x000C26E8 TKW_VV_VV_UW 100.0 Def_ql_uw_q0p0182 0.0 1193.0282 /begin FUNCTION_LIST PMSOCCALC /end FUNCTION_LIST FORMAT "%6.3" /end CHARACTERISTIC
/begin CHARACTERISTIC K_SOC_QUALIA "Applikationswert soc_quali" VALUE 0x000C26EA TKW_VV_VV_UW 100.0 Def_ql_uw_q0p0182 0.0 1193.0282 /begin FUNCTION_LIST PMSOCCALC /end FUNCTION_LIST FORMAT "%6.3" /end CHARACTERISTIC
/begin CHARACTERISTIC CBATT_DEF "Ersatzwert Batteriekapazität" VALUE 0x000C26EC TKW_VV_VV_UB 100.0 Def_ql_ub_q1 1.0000 255.0000 /begin FUNCTION_LIST PMSOCCALC /end FUNCTION_LIST /end CHARACTERISTIC
/begin CHARACTERISTIC K_IB_COMMVAL "Anzahl Taskaufrufe zwischen periodischer Abfrage qlad und qelad" VALUE 0x000C26ED TKW_VV_VV_UB 100.0 Def_dez_ub_q1 0.0 255.0000 /begin FUNCTION_LIST PMSOCCALC /end FUNCTION_LIST /end CHARACTERISTIC
/begin CHARACTERISTIC K_PMQ_UX "Ruhespannung Extrapolationsteiler" VALUE 0x000C26EE TKW_VV_VV_UB 100.0 Def_f_ub_b8 0.0313 7.9687 /begin FUNCTION_LIST PMSOCCALC /end FUNCTION_LIST /end CHARACTERISTIC
/begin CHARACTERISTIC S_BSOCCALC "Enable Rücksetzten Ruhespannungen IBS" VALUE 0x000C26EF TKW_VV_VV_UB 100.0 Def_dez_ub_q1 0.0 255.0000 /begin FUNCTION_LIST PMSOCCALC /end FUNCTION_LIST /end CHARACTERISTIC
/begin CHARACTERISTIC S_SOC_BILA "Schalter für Applik. soc_bila" VALUE 0x000C26F0 TKW_VV_VV_UB 100.0 Def_dez_ub_q1 0.0 255.0000 /begin FUNCTION_LIST PMSOCCALC /end FUNCTION_LIST /end CHARACTERISTIC
/begin CHARACTERISTIC S_SOC_QUAL "Schalter für Applik. soc_quali" VALUE 0x000C26F1 TKW_VV_VV_UB 100.0 Def_dez_ub_q1 0.0 255.0000 /begin FUNCTION_LIST PMSOCCALC /end FUNCTION_LIST /end CHARACTERISTIC
/begin CHARACTERISTIC KL_SOC0TEMP "Temperaturabhängige Stromkorrektur für Ruhespannungsmessung" CURVE 0x000C26F2 TKL_SW_VV_UB 100.0 Def_f_ub_b2 0.0 1.9921 /begin FUNCTION_LIST PMSOCCALC /end FUNCTION_LIST
 /begin AXIS_DESCR STD_AXIS Tsocloc Def_t_sw_q0p1 5 -3276.8000 3276.7000 FORMAT "%4.1" /end AXIS_DESCR
/end CHARACTERISTIC
/begin CHARACTERISTIC KF_SOCLF "Ladefaktor in Abhängigkeit von Temperatur und Ladezustand" MAP 0x000C2704 TKF_UW_SW_UB 100.0 Def_f_ub_b4 0.0157 3.9843 /begin FUNCTION_LIST PMSOCCALC /end FUNCTION_LIST
 /begin AXIS_DESCR STD_AXIS T_batt Def_t_sw_q0p1 3 -3276.8000 3276.7000 FORMAT "%4.1" /end AXIS_DESCR
 /begin AXIS_DESCR STD_AXIS Soc_b_loc Def_ql_uw_q0p0182 3 0.0 1192.7502 FORMAT "%6.3" /end AXIS_DESCR
/end CHARACTERISTIC
/begin CHARACTERISTIC KF_SOC0UBIB "" MAP 0x000C271C TKF_SW_UW_UW 100.0 Def_ql_uw_q0p0182 0.0 1193.0282 /begin FUNCTION_LIST PMSOCCALC /end FUNCTION_LIST
 /begin AXIS_DESCR STD_AXIS Ubatt0 Def_u_uw_q0p25em3_o6 3 6.0000 22.3837 FORMAT "%7.4" /end AXIS_DESCR
 /begin AXIS_DESCR STD_AXIS Isoc0loc Def_i_sw_q0p02 5 -655.3600 655.3400 FORMAT "%6.3" /end AXIS_DESCR
 FORMAT "%6.3" /end CHARACTERISTIC
/begin CHARACTERISTIC K_I_FITAUSW "Grenzwert Fitstrom" VALUE 0x000C274C TKW_VV_VV_UW 100.0 Def_i_uw_q0p08_o200 -200.0000 5042.8000 /begin FUNCTION_LIST PMSOCFIT /end FUNCTION_LIST FORMAT "%6.3" /end CHARACTERISTIC
/begin CHARACTERISTIC K_SOCFITAPP "Applikationwert Soc aus der Fitberechnung" VALUE 0x000C274E TKW_VV_VV_UW 100.0 Def_f_uw_b100 0.0 99.9984 /begin FUNCTION_LIST PMSOCFIT /end FUNCTION_LIST FORMAT "%6.3" /end CHARACTERISTIC
/begin CHARACTERISTIC ZK_PMSOC "Zeitfaktor" VALUE 0x000C2750 TKW_VV_VV_UW 100.0 Def_f_uw_b1 0.0 9.99984741210938e-1 /begin FUNCTION_LIST PMSOCFIT /end FUNCTION_LIST /end CHARACTERISTIC
/begin CHARACTERISTIC S_PMSOCFIT "Schalter zur Applikation SoC aus der Fitberechnung" VALUE 0x000C2752 TKW_VV_VV_UB 100.0 Def_dez_ub_q1 0.0 255.0000 /begin FUNCTION_LIST PMSOCFIT /end FUNCTION_LIST /end CHARACTERISTIC
/begin CHARACTERISTIC KL_PMSOCVU "SoC-Wert aus der Fitberechnung" CURVE 0x000C2754 TKL_UW_VV_UW 100.0 Def_f_uw_b100 0.0 99.9984 /begin FUNCTION_LIST PMSOCFIT /end FUNCTION_LIST
 /begin AXIS_DESCR STD_AXIS Ubatts2 Def_u_uw_q0p25em3_o6 3 6.0000 22.3837 FORMAT "%7.4" /end AXIS_DESCR
 FORMAT "%6.3" /end CHARACTERISTIC
/begin CHARACTERISTIC KF_PMRIBAT8 "Kennfeld Innenwiderstand Batterie8" MAP 0x000C2762 TKF_UW_SW_UB 100.0 Def_f_ub_q0p001 0.0 0.2550 /begin FUNCTION_LIST PMSOCFIT /end FUNCTION_LIST
 /begin AXIS_DESCR STD_AXIS T_batt Def_t_sw_q0p1 4 -3276.8000 3276.7000 FORMAT "%4.1" /end AXIS_DESCR
 /begin AXIS_DESCR STD_AXIS I_batt Def_i_uw_q0p08_o200 6 -200.0000 5042.8000 FORMAT "%6.3" /end AXIS_DESCR
/end CHARACTERISTIC
/begin CHARACTERISTIC KF_PMRIBAT6 "Kennfeld Innenwiderstand Batterie6" MAP 0x000C2790 TKF_UW_SW_UB 100.0 Def_f_ub_q0p001 0.0 0.2550 /begin FUNCTION_LIST PMSOCFIT /end FUNCTION_LIST
 /begin AXIS_DESCR STD_AXIS T_batt Def_t_sw_q0p1 4 -3276.8000 3276.7000 FORMAT "%4.1" /end AXIS_DESCR
 /begin AXIS_DESCR STD_AXIS I_batt Def_i_uw_q0p08_o200 6 -200.0000 5042.8000 FORMAT "%6.3" /end AXIS_DESCR
/end CHARACTERISTIC
/begin CHARACTERISTIC KF_PMRIBAT5 "Kennfeld Innenwiderstand Batterie5" MAP 0x000C27BE TKF_UW_SW_UB 100.0 Def_f_ub_q0p001 0.0 0.2550 /begin FUNCTION_LIST PMSOCFIT /end FUNCTION_LIST
 /begin AXIS_DESCR STD_AXIS T_batt Def_t_sw_q0p1 4 -3276.8000 3276.7000 FORMAT "%4.1" /end AXIS_DESCR
 /begin AXIS_DESCR STD_AXIS I_batt Def_i_uw_q0p08_o200 6 -200.0000 5042.8000 FORMAT "%6.3" /end AXIS_DESCR
/end CHARACTERISTIC
/begin CHARACTERISTIC KF_PMRIBAT3 "Kennfeld Innenwiderstand Batterie3" MAP 0x000C27EC TKF_UW_SW_UB 100.0 Def_f_ub_q0p001 0.0 0.2550 /begin FUNCTION_LIST PMSOCFIT /end FUNCTION_LIST
 /begin AXIS_DESCR STD_AXIS T_batt Def_t_sw_q0p1 4 -3276.8000 3276.7000 FORMAT "%4.1" /end AXIS_DESCR
 /begin AXIS_DESCR STD_AXIS I_batt Def_i_uw_q0p08_o200 6 -200.0000 5042.8000 FORMAT "%6.3" /end AXIS_DESCR
/end CHARACTERISTIC
/begin CHARACTERISTIC KF_PMRIBAT4 "Kennfeld Innenwiderstand Batterie4" MAP 0x000C281A TKF_UW_SW_UB 100.0 Def_f_ub_q0p001 0.0 0.2550 /begin FUNCTION_LIST PMSOCFIT /end FUNCTION_LIST
 /begin AXIS_DESCR STD_AXIS T_batt Def_t_sw_q0p1 4 -3276.8000 3276.7000 FORMAT "%4.1" /end AXIS_DESCR
 /begin AXIS_DESCR STD_AXIS I_batt Def_i_uw_q0p08_o200 6 -200.0000 5042.8000 FORMAT "%6.3" /end AXIS_DESCR
/end CHARACTERISTIC
/begin CHARACTERISTIC KF_PMRIBAT2 "Kennfeld Innenwiderstand Batterie2" MAP 0x000C2848 TKF_UW_SW_UB 100.0 Def_f_ub_q0p001 0.0 0.2550 /begin FUNCTION_LIST PMSOCFIT /end FUNCTION_LIST
 /begin AXIS_DESCR STD_AXIS T_batt Def_t_sw_q0p1 4 -3276.8000 3276.7000 FORMAT "%4.1" /end AXIS_DESCR
 /begin AXIS_DESCR STD_AXIS I_batt Def_i_uw_q0p08_o200 6 -200.0000 5042.8000 FORMAT "%6.3" /end AXIS_DESCR
/end CHARACTERISTIC
/begin CHARACTERISTIC KF_PMRIBAT1 "Kennfeld Innenwiderstand Batterie" MAP 0x000C2876 TKF_UW_SW_UB 100.0 Def_f_ub_q0p001 0.0 0.2550 /begin FUNCTION_LIST PMSOCFIT /end FUNCTION_LIST
 /begin AXIS_DESCR STD_AXIS T_batt Def_t_sw_q0p1 4 -3276.8000 3276.7000 FORMAT "%4.1" /end AXIS_DESCR
 /begin AXIS_DESCR STD_AXIS I_batt Def_i_uw_q0p08_o200 6 -200.0000 5042.8000 FORMAT "%6.3" /end AXIS_DESCR
/end CHARACTERISTIC
/begin CHARACTERISTIC KF_PMRIBAT7 "Kennfeld Innenwiderstand Batterie7" MAP 0x000C28A4 TKF_UW_SW_UB 100.0 Def_f_ub_q0p001 0.0 0.2550 /begin FUNCTION_LIST PMSOCFIT /end FUNCTION_LIST
 /begin AXIS_DESCR STD_AXIS T_batt Def_t_sw_q0p1 4 -3276.8000 3276.7000 FORMAT "%4.1" /end AXIS_DESCR
 /begin AXIS_DESCR STD_AXIS I_batt Def_i_uw_q0p08_o200 6 -200.0000 5042.8000 FORMAT "%6.3" /end AXIS_DESCR
/end CHARACTERISTIC
/begin CHARACTERISTIC K_ABSCHKORA "Applikationswert für Korrektur Abschaltung" VALUE 0x000C28D2 TKW_VV_VV_SW 100.0 Def_f_sw_q0p00153 -50.0000 49.9984 /begin FUNCTION_LIST PMSOCKOR /end FUNCTION_LIST FORMAT "%6.3" /end CHARACTERISTIC
/begin CHARACTERISTIC K_DAB_KORR1 "Korrekturkonstante 1 für Abschaltung" VALUE 0x000C28D4 TKW_VV_VV_SW 100.0 Def_f_sw_q0p00153 -50.0000 49.9984 /begin FUNCTION_LIST PMSOCKOR /end FUNCTION_LIST FORMAT "%6.3" /end CHARACTERISTIC
/begin CHARACTERISTIC K_DAB_KORR2 "Korrekturkonstante 2 für Abschaltung" VALUE 0x000C28D6 TKW_VV_VV_SW 100.0 Def_f_sw_q0p00153 -50.0000 49.9984 /begin FUNCTION_LIST PMSOCKOR /end FUNCTION_LIST FORMAT "%6.3" /end CHARACTERISTIC
/begin CHARACTERISTIC K_DAB_KORR3 "Korrekturkonstante 3 für Abschaltung" VALUE 0x000C28D8 TKW_VV_VV_SW 100.0 Def_f_sw_q0p00153 -50.0000 49.9984 /begin FUNCTION_LIST PMSOCKOR /end FUNCTION_LIST FORMAT "%6.3" /end CHARACTERISTIC
/begin CHARACTERISTIC K_DSOCA "Applikationsgrösse für d_soc" VALUE 0x000C28DA TKW_VV_VV_SW 100.0 Def_f_sw_b100 -100.0000 99.9969 /begin FUNCTION_LIST PMSOCKOR /end FUNCTION_LIST FORMAT "%6.3" /end CHARACTERISTIC
/begin CHARACTERISTIC K_DSOCABSCH "Applikationsgrösse für d_soc" VALUE 0x000C28DC TKW_VV_VV_SW 100.0 Def_f_sw_b100 -100.0000 99.9969 /begin FUNCTION_LIST PMSOCKOR /end FUNCTION_LIST FORMAT "%6.3" /end CHARACTERISTIC
/begin CHARACTERISTIC K_TSAISPWF "Defaultwert Saison Temp bei DME Powerfail" VALUE 0x000C28DE TKW_VV_VV_SW 100.0 Def_t_sw_q0p1 -3276.8000 3276.7000 /begin FUNCTION_LIST PMSOCKOR /end FUNCTION_LIST FORMAT "%4.1" /end CHARACTERISTIC
/begin CHARACTERISTIC K_BILA_OGRZ "Grenzwert oberhalb dessen eine Apassung durch soc_kor nicht zulässig ist" VALUE 0x000C28E0 TKW_VV_VV_UW 100.0 Def_f_uw_b100 0.0 99.9984 /begin FUNCTION_LIST PMSOCKOR /end FUNCTION_LIST FORMAT "%6.3" /end CHARACTERISTIC
/begin CHARACTERISTIC K_BILA_UGRZ "" VALUE 0x000C28E2 TKW_VV_VV_UW 100.0 Def_f_uw_b100 0.0 99.9984 /begin FUNCTION_LIST PMSOCKOR /end FUNCTION_LIST FORMAT "%6.3" /end CHARACTERISTIC
/begin CHARACTERISTIC K_PMTIMERSQ1 "Startwert Timer für soc_quali" VALUE 0x000C28E4 TKW_VV_VV_UW 100.0 Def_st_uw_q1 0.0 65535.0000 /begin FUNCTION_LIST PMSOCKOR /end FUNCTION_LIST /end CHARACTERISTIC
/begin CHARACTERISTIC K_PM_TABSMN "Applikationsgrösse für Abstellzeit tabsmn_w" VALUE 0x000C28E6 TKW_VV_VV_UW 100.0 Def_td_uw_q1 0.0 65535.0000 /begin FUNCTION_LIST PMSOCKOR /end FUNCTION_LIST /end CHARACTERISTIC
/begin CHARACTERISTIC K_QSOCCL1 "Grenze zur Ladezustandsqualitätsklasse1" VALUE 0x000C28E8 TKW_VV_VV_UW 100.0 Def_ql_uw_q0p0182 0.0 1193.0282 /begin FUNCTION_LIST PMSOCKOR /end FUNCTION_LIST FORMAT "%6.3" /end CHARACTERISTIC
/begin CHARACTERISTIC K_QSOCCL2 "Grenze zur Ladezustandsqualitätsklasse2" VALUE 0x000C28EA TKW_VV_VV_UW 100.0 Def_ql_uw_q0p0182 0.0 1193.0282 /begin FUNCTION_LIST PMSOCKOR /end FUNCTION_LIST FORMAT "%6.3" /end CHARACTERISTIC
/begin CHARACTERISTIC K_QSOCCL3 "Grenze zur Ladezustandsqualitätsklasse3" VALUE 0x000C28EC TKW_VV_VV_UW 100.0 Def_ql_uw_q0p0182 0.0 1193.0282 /begin FUNCTION_LIST PMSOCKOR /end FUNCTION_LIST FORMAT "%6.3" /end CHARACTERISTIC
/begin CHARACTERISTIC K_QSTARTFGA "Applikationswert für q_startfgk" VALUE 0x000C28EE TKW_VV_VV_UW 100.0 Def_ql_uw_q0p0182 0.0 1193.0282 /begin FUNCTION_LIST PMSOCKOR /end FUNCTION_LIST FORMAT "%6.3" /end CHARACTERISTIC
/begin CHARACTERISTIC K_SOCFITGRZ "Grenzwert für soc_fit" VALUE 0x000C28F0 TKW_VV_VV_UW 100.0 Def_f_uw_b100 0.0 99.9984 /begin FUNCTION_LIST PMSOCKOR /end FUNCTION_LIST FORMAT "%6.3" /end CHARACTERISTIC
/begin CHARACTERISTIC K_SOCFITLIMH "Applikationskonstante zur Verbesserung SoC aus der Fitberechnung" VALUE 0x000C28F2 TKW_VV_VV_UW 100.0 Def_f_uw_b100 0.0 99.9984 /begin FUNCTION_LIST PMSOCKOR /end FUNCTION_LIST FORMAT "%6.3" /end CHARACTERISTIC
/begin CHARACTERISTIC K_SOCFITLIML "Applikationskonstante zur Abwertung SoC aus der Fitberechnung" VALUE 0x000C28F4 TKW_VV_VV_UW 100.0 Def_f_uw_b100 0.0 99.9984 /begin FUNCTION_LIST PMSOCKOR /end FUNCTION_LIST FORMAT "%6.3" /end CHARACTERISTIC
/begin CHARACTERISTIC K_SOC_STAFGA "Applikationswert für SoC aus der Startfähigkeit" VALUE 0x000C28F6 TKW_VV_VV_UW 100.0 Def_f_uw_b100 0.0 99.9984 /begin FUNCTION_LIST PMSOCKOR /end FUNCTION_LIST FORMAT "%6.3" /end CHARACTERISTIC
/begin CHARACTERISTIC K_TSAISONFIL "Filterkonstante für t_saison" VALUE 0x000C28F8 TKW_VV_VV_UW 100.0 Def_dez_uw_q1 1.0000 65535.0000 /begin FUNCTION_LIST PMSOCKOR /end FUNCTION_LIST /end CHARACTERISTIC
/begin CHARACTERISTIC S_ABSCHK "Schalter für Applikationswert absch_korr" VALUE 0x000C28FA TKW_VV_VV_UB 100.0 Def_dez_ub_q1 0.0 255.0000 /begin FUNCTION_LIST PMSOCKOR /end FUNCTION_LIST /end CHARACTERISTIC
/begin CHARACTERISTIC S_DSOCS "Schalter für Applikationswert Delta SoC" VALUE 0x000C28FB TKW_VV_VV_UB 100.0 Def_dez_ub_q1 0.0 255.0000 /begin FUNCTION_LIST PMSOCKOR /end FUNCTION_LIST /end CHARACTERISTIC
/begin CHARACTERISTIC S_PMTABSMN "Schalter für Applikation der Abstellzeit tabsmn_w" VALUE 0x000C28FC TKW_VV_VV_UB 100.0 Def_dez_ub_q1 0.0 255.0000 /begin FUNCTION_LIST PMSOCKOR /end FUNCTION_LIST /end CHARACTERISTIC
/begin CHARACTERISTIC S_QSTARTFK "Schalter für Applikation q_startfgk" VALUE 0x000C28FD TKW_VV_VV_UB 100.0 Def_dez_ub_q1 0.0 255.0000 /begin FUNCTION_LIST PMSOCKOR /end FUNCTION_LIST /end CHARACTERISTIC
/begin CHARACTERISTIC S_SOCSTAFK "Schalter für Applikation SoC aus der Startfähigkeit" VALUE 0x000C28FE TKW_VV_VV_UB 100.0 Def_dez_ub_q1 0.0 255.0000 /begin FUNCTION_LIST PMSOCKOR /end FUNCTION_LIST /end CHARACTERISTIC
/begin CHARACTERISTIC KL_FITGRZ "Grenzwert für soc_fit" CURVE 0x000C2900 TKL_SW_VV_UW 100.0 Def_f_uw_b100 0.0 99.9984 /begin FUNCTION_LIST PMSOCKOR /end FUNCTION_LIST
 /begin AXIS_DESCR STD_AXIS T_saison Def_t_sw_q0p1 4 -3276.8000 3276.7000 FORMAT "%4.1" /end AXIS_DESCR
 FORMAT "%6.3" /end CHARACTERISTIC
/begin CHARACTERISTIC KL_SSOC "soc_s in Abh. von tsaison" CURVE 0x000C2912 TKL_SW_VV_UW 100.0 Def_f_uw_b100 0.0 99.9984 /begin FUNCTION_LIST PMSOCKOR /end FUNCTION_LIST
 /begin AXIS_DESCR STD_AXIS T_saison Def_t_sw_q0p1 4 -3276.8000 3276.7000 FORMAT "%4.1" /end AXIS_DESCR
 FORMAT "%6.3" /end CHARACTERISTIC
/begin CHARACTERISTIC K_TIME_START "Zeittriggerschwelle nach Motorstart" VALUE 0x000C2924 TKW_VV_VV_UW 100.0 Def_td_uw_q0p01 0.0 655.3500 /begin FUNCTION_LIST PMSOCSTART /end FUNCTION_LIST FORMAT "%5.2" /end CHARACTERISTIC
/begin CHARACTERISTIC K_UB_GRENZ "Grenzwert Gradient d. Bordnetzspannung" VALUE 0x000C2926 TKW_VV_VV_UW 100.0 Def_u_uw_q0p0942 0.0 6173.3970 /begin FUNCTION_LIST PMSOCSTART /end FUNCTION_LIST FORMAT "%4.1" /end CHARACTERISTIC
/begin CHARACTERISTIC K_USTARTGRZ "Spannungsgrenzwert für Startauswertung " VALUE 0x000C2928 TKW_VV_VV_UW 100.0 Def_u_uw_q0p25em3_o6 6.0000 22.3837 /begin FUNCTION_LIST PMSOCSTART /end FUNCTION_LIST FORMAT "%7.4" /end CHARACTERISTIC
/begin CHARACTERISTIC K_RIN_GRENZ1 "Grenzwert Innenwiderstand Batterie1" VALUE 0x000C292A TKW_VV_VV_UB 100.0 Def_f_ub_b32 0.0 31.8750 /begin FUNCTION_LIST PMSOCSTART /end FUNCTION_LIST /end CHARACTERISTIC
/begin CHARACTERISTIC K_RIN_GRENZ2 "Grenzwert Innenwiderstand Batterie2" VALUE 0x000C292B TKW_VV_VV_UB 100.0 Def_f_ub_b32 0.0 31.8750 /begin FUNCTION_LIST PMSOCSTART /end FUNCTION_LIST /end CHARACTERISTIC
/begin CHARACTERISTIC K_RIN_GRENZ3 "Grenzwert Innenwiderstand Batterie3" VALUE 0x000C292C TKW_VV_VV_UB 100.0 Def_f_ub_b32 0.0 31.8750 /begin FUNCTION_LIST PMSOCSTART /end FUNCTION_LIST /end CHARACTERISTIC
/begin CHARACTERISTIC K_RIN_GRENZ4 "Grenzwert Innenwiderstand Batterie4" VALUE 0x000C292D TKW_VV_VV_UB 100.0 Def_f_ub_b32 0.0 31.8750 /begin FUNCTION_LIST PMSOCSTART /end FUNCTION_LIST /end CHARACTERISTIC
/begin CHARACTERISTIC K_RIN_GRENZ5 "Grenzwert Innenwiderstand Batterie5" VALUE 0x000C292E TKW_VV_VV_UB 100.0 Def_f_ub_b32 0.0 31.8750 /begin FUNCTION_LIST PMSOCSTART /end FUNCTION_LIST /end CHARACTERISTIC
/begin CHARACTERISTIC K_RIN_GRENZ6 "Grenzwert Innenwiderstand Batterie6" VALUE 0x000C292F TKW_VV_VV_UB 100.0 Def_f_ub_b32 0.0 31.8750 /begin FUNCTION_LIST PMSOCSTART /end FUNCTION_LIST /end CHARACTERISTIC
/begin CHARACTERISTIC K_RIN_GRENZ7 "Grenzwert Innenwiderstand Batterie7" VALUE 0x000C2930 TKW_VV_VV_UB 100.0 Def_f_ub_b32 0.0 31.8750 /begin FUNCTION_LIST PMSOCSTART /end FUNCTION_LIST /end CHARACTERISTIC
/begin CHARACTERISTIC K_RIN_GRENZ8 "Grenzwert Innenwiderstand Batterie8" VALUE 0x000C2931 TKW_VV_VV_UB 100.0 Def_f_ub_b32 0.0 31.8750 /begin FUNCTION_LIST PMSOCSTART /end FUNCTION_LIST /end CHARACTERISTIC
/begin CHARACTERISTIC S_NKWITNSTRT "0 = Nkw-Auswertung, 1=Itnstart Auswertung" VALUE 0x000C2932 TKW_VV_VV_UB 100.0 Identity 0.0 1.0000 /begin FUNCTION_LIST PMSOCSTART /end FUNCTION_LIST /end CHARACTERISTIC
/begin CHARACTERISTIC S_PMSTARTQ "Applikationsschalter f. B_pmstartq" VALUE 0x000C2933 TKW_VV_VV_UB 100.0 Def_dez_ub_q1 0.0 255.0000 /begin FUNCTION_LIST PMSOCSTART /end FUNCTION_LIST /end CHARACTERISTIC
/begin CHARACTERISTIC S_PM_TEST1 "Applikationsschalter um die Startberechnung zu erzwingen" VALUE 0x000C2934 TKW_VV_VV_UB 100.0 Def_dez_ub_q1 0.0 255.0000 /begin FUNCTION_LIST PMSOCSTART /end FUNCTION_LIST /end CHARACTERISTIC
/begin CHARACTERISTIC S_RIN "Schalter Applikation Innenwiderstandsprüfung" VALUE 0x000C2935 TKW_VV_VV_UB 100.0 Def_dez_ub_q1 0.0 255.0000 /begin FUNCTION_LIST PMSOCSTART /end FUNCTION_LIST /end CHARACTERISTIC
/begin CHARACTERISTIC S_STARTAW "Startauswertung fertig" VALUE 0x000C2936 TKW_VV_VV_UB 100.0 Def_dez_ub_q1 0.0 255.0000 /begin FUNCTION_LIST PMSOCSTART /end FUNCTION_LIST /end CHARACTERISTIC
/begin CHARACTERISTIC KL_UNSTART "Startspannung abhängig v.Motordrehzahl" CURVE 0x000C2938 TKL_SW_VV_UW 100.0 Def_u_uw_q0p25em3_o6 6.0000 22.3837 /begin FUNCTION_LIST PMSOCSTART /end FUNCTION_LIST /begin AXIS_DESCR STD_AXIS Nnmstart Def_n_sw_q1p0 2 -32768.0000 32767.0000 /end AXIS_DESCR FORMAT "%7.4" /end CHARACTERISTIC
/begin CHARACTERISTIC KL_ITNSTART "Startspannung abh. vom Itnstart" CURVE 0x000C2942 TKL_UB_VV_UW 100.0 Def_u_uw_q0p25em3_o6 6.0000 22.3837 /begin FUNCTION_LIST PMSOCSTART /end FUNCTION_LIST /begin AXIS_DESCR STD_AXIS NO_INPUT_QUANTITY Def_i_ub_b1000 4 0.0 996.0937 /end AXIS_DESCR FORMAT "%7.4" /end CHARACTERISTIC
/begin CHARACTERISTIC KL_UTSTART "Startspannung in Abhängigkeit von Temperatur Batterie" CURVE 0x000C2950 TKL_SW_VV_SW 100.0 Def_u_sw_q0p00025 -8.1920 8.1917 /begin FUNCTION_LIST PMSOCSTART /end FUNCTION_LIST
 /begin AXIS_DESCR STD_AXIS T_batt Def_t_sw_q0p1 3 -3276.8000 3276.7000 FORMAT "%4.1" /end AXIS_DESCR
 FORMAT "%7.4" /end CHARACTERISTIC
/begin CHARACTERISTIC K_IGRDETEC "U_gsoll - U_ibs Max für Freeze" VALUE 0x000C295E TKW_VV_VV_SW 100.0 Def_u_sw_b128 -128.0000 127.9960 /begin FUNCTION_LIST PMUGENCALC /end FUNCTION_LIST FORMAT "%6.3" /end CHARACTERISTIC
/begin CHARACTERISTIC K_PMUGEN_MAX "Max zugelassene Generatorspg" VALUE 0x000C2960 TKW_VV_VV_SW 100.0 Def_u_sw_b128 -128.0000 127.9960 /begin FUNCTION_LIST PMUGENCALC /end FUNCTION_LIST FORMAT "%6.3" /end CHARACTERISTIC
/begin CHARACTERISTIC K_PMUGEN_MIN "Min zugelassene Generatorspg" VALUE 0x000C2962 TKW_VV_VV_SW 100.0 Def_u_sw_b128 -128.0000 127.9960 /begin FUNCTION_LIST PMUGENCALC /end FUNCTION_LIST FORMAT "%6.3" /end CHARACTERISTIC
/begin CHARACTERISTIC K_UGENNORM "Generator Normspannung" VALUE 0x000C2964 TKW_VV_VV_SW 100.0 Def_u_sw_b128 -128.0000 127.9960 /begin FUNCTION_LIST PMUGENCALC /end FUNCTION_LIST FORMAT "%6.3" /end CHARACTERISTIC
/begin CHARACTERISTIC K_UIBSAPP "Manueller Applikationswert von Uibs an UGENKOR" VALUE 0x000C2966 TKW_VV_VV_SW 100.0 Def_u_sw_b128 -128.0000 127.9960 /begin FUNCTION_LIST PMUGENCALC /end FUNCTION_LIST FORMAT "%6.3" /end CHARACTERISTIC
/begin CHARACTERISTIC K_USTEPMIN "Min. Delta zw. Battsollspg und Battspg damit uibs veraendert wird." VALUE 0x000C2968 TKW_VV_VV_SW 100.0 Def_u_sw_b128 -128.0000 127.9960 /begin FUNCTION_LIST PMUGENCALC /end FUNCTION_LIST FORMAT "%6.3" /end CHARACTERISTIC
/begin CHARACTERISTIC K_PMUBAT_MAX "Max. zugelassene Batteriespg " VALUE 0x000C296A TKW_VV_VV_UW 100.0 Def_u_uw_q0p25em3_o6 6.0000 22.3837 /begin FUNCTION_LIST PMUGENCALC /end FUNCTION_LIST FORMAT "%7.4" /end CHARACTERISTIC
/begin CHARACTERISTIC K_PMUBAT_MIN "Min. zugelassene Batteriespg" VALUE 0x000C296C TKW_VV_VV_UW 100.0 Def_u_uw_q0p25em3_o6 6.0000 22.3837 /begin FUNCTION_LIST PMUGENCALC /end FUNCTION_LIST FORMAT "%7.4" /end CHARACTERISTIC
/begin CHARACTERISTIC K_DFOVERRIDE "Schwellwert wann Generator als ueberlastet erkannt wird" VALUE 0x000C296E TKW_VV_VV_UB 100.0 Def_f_ub_b100 0.0 99.6093 /begin FUNCTION_LIST PMUGENCALC /end FUNCTION_LIST /end CHARACTERISTIC
/begin CHARACTERISTIC K_TD_BNMOT "Zeit nach Motorlauf, wo die stufenweise (USTEPMIN) Berechnung von uibs aktiviert wird." VALUE 0x000C296F TKW_VV_VV_UB 100.0 Def_td_ub_q1 0.0 255.0000 /begin FUNCTION_LIST PMUGENCALC /end FUNCTION_LIST /end CHARACTERISTIC
/begin CHARACTERISTIC K_TD_PMUGEN "Taskzeit von PMUGENCALC, = Zeit wo die stufenweise Setzung von uibs berechnet wird." VALUE 0x000C2970 TKW_VV_VV_UB 100.0 Def_td_ub_q1 0.0 255.0000 /begin FUNCTION_LIST PMUGENCALC /end FUNCTION_LIST /end CHARACTERISTIC
/begin CHARACTERISTIC S_UIBS "Schalter für UIBS, wenn True dann uibs=UIBSAPP" VALUE 0x000C2971 TKW_VV_VV_UB 100.0 Identity 0.0 1.0000 /begin FUNCTION_LIST PMUGENCALC /end FUNCTION_LIST /end CHARACTERISTIC
/begin CHARACTERISTIC KL_USOLL "Batteriesollspannung aufgrund von tbatt" CURVE 0x000C2972 TKL_SW_VV_UW 100.0 Def_u_uw_q0p25em3_o6 6.0000 22.3837 /begin FUNCTION_LIST PMUGENCALC /end FUNCTION_LIST
 /begin AXIS_DESCR STD_AXIS T_batt Def_t_sw_q0p1 3 -3276.8000 3276.7000 FORMAT "%4.1" /end AXIS_DESCR
 FORMAT "%7.4" /end CHARACTERISTIC
/begin CHARACTERISTIC KF_USOLL "Batteriesollspannung aufgrund der Temperatur und soc." MAP 0x000C2980 TKF_UW_SW_UW 100.0 Def_u_uw_q0p25em3_o6 6.0000 22.3837 /begin FUNCTION_LIST PMUGENCALC /end FUNCTION_LIST
 /begin AXIS_DESCR STD_AXIS T_batt Def_t_sw_q0p1 3 -3276.8000 3276.7000 FORMAT "%4.1" /end AXIS_DESCR
 /begin AXIS_DESCR STD_AXIS Soc_rel Def_f_uw_b100 3 0.0 99.9984 FORMAT "%6.3" /end AXIS_DESCR
 FORMAT "%7.4" /end CHARACTERISTIC
/begin CHARACTERISTIC K_GENOFFTIME "maximale Generatorauszeit" VALUE 0x000C29A6 TKW_VV_VV_UW 100.0 Def_td_uw_q0p1 0.0 6553.5000 /begin FUNCTION_LIST UGENKOR /end FUNCTION_LIST FORMAT "%4.1" /end CHARACTERISTIC
/begin CHARACTERISTIC K_GENUMAX "maximale Generatorspannung" VALUE 0x000C29A8 TKW_VV_VV_UW 100.0 Def_u_uw_q0p1 0.0 6553.5000 /begin FUNCTION_LIST UGENKOR /end FUNCTION_LIST FORMAT "%6.3" /end CHARACTERISTIC
/begin CHARACTERISTIC K_GENURAMP "Spannungsinkrement fuer Rampe" VALUE 0x000C29AA TKW_VV_VV_UW 100.0 Def_u_uw_q0p1 0.0 6553.5000 /begin FUNCTION_LIST UGENKOR /end FUNCTION_LIST FORMAT "%6.3" /end CHARACTERISTIC
/begin CHARACTERISTIC K_GENURAMPOF "Spannungsinkrement fuer Rampe, Generator ausschalten" VALUE 0x000C29AC TKW_VV_VV_UW 100.0 Def_u_uw_q0p1 0.0 6553.5000 /begin FUNCTION_LIST UGENKOR /end FUNCTION_LIST FORMAT "%6.3" /end CHARACTERISTIC
/begin CHARACTERISTIC K_GEN_APPUG "Manuelle Generatorspannungsvorgabe" VALUE 0x000C29AE TKW_VV_VV_UW 100.0 Def_u_uw_q0p1 0.0 6553.5000 /begin FUNCTION_LIST UGENKOR /end FUNCTION_LIST FORMAT "%6.3" /end CHARACTERISTIC
/begin CHARACTERISTIC K_PMSA_RST "" VALUE 0x000C29B0 TKW_VV_VV_UW 100.0 Def_dez_uw_q1 0.0 65535.0000 /begin FUNCTION_LIST UGENKOR /end FUNCTION_LIST /end CHARACTERISTIC
/begin CHARACTERISTIC K_PMSA_SET "" VALUE 0x000C29B2 TKW_VV_VV_UW 100.0 Def_dez_uw_q1 0.0 65535.0000 /begin FUNCTION_LIST UGENKOR /end FUNCTION_LIST /end CHARACTERISTIC
/begin CHARACTERISTIC K_T_IGRNACHL "" VALUE 0x000C29B4 TKW_VV_VV_UW 100.0 Def_td_uw_q0p1 0.0 6553.5000 /begin FUNCTION_LIST UGENKOR /end FUNCTION_LIST FORMAT "%4.1" /end CHARACTERISTIC
/begin CHARACTERISTIC K_UBNS "" VALUE 0x000C29B6 TKW_VV_VV_UW 100.0 Def_u_uw_q0p1 0.0 6553.5000 /begin FUNCTION_LIST UGENKOR /end FUNCTION_LIST FORMAT "%6.3" /end CHARACTERISTIC
/begin CHARACTERISTIC K_UGENDELTA "" VALUE 0x000C29B8 TKW_VV_VV_UW 100.0 Def_u_uw_q0p1 0.0 6553.5000 /begin FUNCTION_LIST UGENKOR /end FUNCTION_LIST FORMAT "%6.3" /end CHARACTERISTIC
/begin CHARACTERISTIC K_UGENMAXE65 "" VALUE 0x000C29BA TKW_VV_VV_UW 100.0 Def_u_uw_q0p1 0.0 6553.5000 /begin FUNCTION_LIST UGENKOR /end FUNCTION_LIST FORMAT "%6.3" /end CHARACTERISTIC
/begin CHARACTERISTIC K_UGENOFF "Generatorauschaltspannung bei vfzg = 0" VALUE 0x000C29BC TKW_VV_VV_UW 100.0 Def_u_uw_q0p1 0.0 6553.5000 /begin FUNCTION_LIST UGENKOR /end FUNCTION_LIST FORMAT "%6.3" /end CHARACTERISTIC
/begin CHARACTERISTIC K_UGENOFFSTA "Generatorausschaltspannung im Start" VALUE 0x000C29BE TKW_VV_VV_UW 100.0 Def_u_uw_q0p1 0.0 6553.5000 /begin FUNCTION_LIST UGENKOR /end FUNCTION_LIST FORMAT "%6.3" /end CHARACTERISTIC
/begin CHARACTERISTIC K_UGENOFFV0 "Generatorauschaltspannung bei vfzg != 0" VALUE 0x000C29C0 TKW_VV_VV_UW 100.0 Def_u_uw_q0p1 0.0 6553.5000 /begin FUNCTION_LIST UGENKOR /end FUNCTION_LIST FORMAT "%6.3" /end CHARACTERISTIC
/begin CHARACTERISTIC K_U_BNMAX "" VALUE 0x000C29C2 TKW_VV_VV_UW 100.0 Def_u_uw_q0p1 0.0 6553.5000 /begin FUNCTION_LIST UGENKOR /end FUNCTION_LIST FORMAT "%6.3" /end CHARACTERISTIC
/begin CHARACTERISTIC K_U_IGRRAMP "" VALUE 0x000C29C4 TKW_VV_VV_UW 100.0 Def_u_uw_q0p1 0.0 6553.5000 /begin FUNCTION_LIST UGENKOR /end FUNCTION_LIST FORMAT "%6.3" /end CHARACTERISTIC
/begin CHARACTERISTIC CW_BNSUMAX "Freischatung Berücksichtigung Bordnetzstabilität" VALUE 0x000C29C6 TKW_VV_VV_UB 100.0 Def_st_ub_q1 0.0 255.0000 /begin FUNCTION_LIST UGENKOR /end FUNCTION_LIST /end CHARACTERISTIC
/begin CHARACTERISTIC CW_GENOFFSLP "Codewort zum Sperren Eingriff Sekundärluftpumpe" VALUE 0x000C29C7 TKW_VV_VV_UB 100.0 Identity 0.0 1.0000 /begin FUNCTION_LIST UGENKOR /end FUNCTION_LIST /end CHARACTERISTIC
/begin CHARACTERISTIC K_APP_UGEN "Umschaltung auf manuelle Generatorspannungsvorgabe" VALUE 0x000C29C8 TKW_VV_VV_UB 100.0 Def_st_ub_q1 0.0 255.0000 /begin FUNCTION_LIST UGENKOR /end FUNCTION_LIST /end CHARACTERISTIC
/begin CHARACTERISTIC K_ENGENTOGGL "Freigabe Generatortoggeln" VALUE 0x000C29C9 TKW_VV_VV_UB 100.0 Identity 0.0 1.0000 /begin FUNCTION_LIST UGENKOR /end FUNCTION_LIST /end CHARACTERISTIC
/begin CHARACTERISTIC K_PMSA_DEC "" VALUE 0x000C29CA TKW_VV_VV_UB 100.0 Def_dez_ub_q1 0.0 255.0000 /begin FUNCTION_LIST UGENKOR /end FUNCTION_LIST /end CHARACTERISTIC
/begin CHARACTERISTIC K_PMSA_INC "" VALUE 0x000C29CB TKW_VV_VV_UB 100.0 Def_dez_ub_q1 0.0 255.0000 /begin FUNCTION_LIST UGENKOR /end FUNCTION_LIST /end CHARACTERISTIC
/begin CHARACTERISTIC K_T_VERBON "Verzugszeit Verbraucherzuschaltung nach Aufhebung Genertorreduzierung" VALUE 0x000C29CC TKW_VV_VV_UB 100.0 Def_td_ub_q0p1 0.0 25.5000 /begin FUNCTION_LIST UGENKOR /end FUNCTION_LIST /end CHARACTERISTIC
/begin CHARACTERISTIC S_GOFFRAMP "Schalter Sprung auf 10,6V unverzoegert" VALUE 0x000C29CD TKW_VV_VV_UB 100.0 Def_st_ub_q1 0.0 255.0000 /begin FUNCTION_LIST UGENKOR /end FUNCTION_LIST /end CHARACTERISTIC
/begin CHARACTERISTIC S_IGRLOW "" VALUE 0x000C29CE TKW_VV_VV_UB 100.0 Identity 0.0 1.0000 /begin FUNCTION_LIST UGENKOR /end FUNCTION_LIST /end CHARACTERISTIC
/begin CHARACTERISTIC S_UGENOFST "Schalter ein: eigene Abschaltspannung im Start wirksam" VALUE 0x000C29CF TKW_VV_VV_UB 100.0 Identity 0.0 1.0000 /begin FUNCTION_LIST UGENKOR /end FUNCTION_LIST /end CHARACTERISTIC
/begin MEASUREMENT St_ozgg0.B_oelwech "Bedingung Ölwechsel erfolgt" UBYTE Def_bit_ub_0 0 0 0.0 255.0 ECU_ADDRESS 0x007FCC8E /begin FUNCTION_LIST OZGG /end FUNCTION_LIST BIT_MASK 0x1 /end MEASUREMENT
/begin MEASUREMENT St_ozgg0.B_ozniv "Bedingung Niveausignal in Ordnung" UBYTE Def_bit_ub_1 0 0 0.0 255.0 ECU_ADDRESS 0x007FCC8E /begin FUNCTION_LIST OZGG /end FUNCTION_LIST BIT_MASK 0x2 /end MEASUREMENT
/begin MEASUREMENT St_ozgg0.B_ozperm "Bedingung Permittivitätssignal in Ordnung" UBYTE Def_bit_ub_2 0 0 0.0 255.0 ECU_ADDRESS 0x007FCC8E /begin FUNCTION_LIST OZGG /end FUNCTION_LIST BIT_MASK 0x4 /end MEASUREMENT
/begin MEASUREMENT St_ozgg0.B_oztemp "Bedingung Temperatursignal in Ordnung" UBYTE Def_bit_ub_3 0 0 0.0 255.0 ECU_ADDRESS 0x007FCC8E /begin FUNCTION_LIST OZGG /end FUNCTION_LIST BIT_MASK 0x8 /end MEASUREMENT
/begin MEASUREMENT St_ozgg0.B_ozvfchg "Bedingung für geänderte Verfügbarkeit" UBYTE Def_bit_ub_4 0 0 0.0 255.0 ECU_ADDRESS 0x007FCC8E /begin FUNCTION_LIST OZGG /end FUNCTION_LIST BIT_MASK 0x10 /end MEASUREMENT
/begin MEASUREMENT St_ozgg0.B_svcntchg "Bedingung für über Tester geänderten Servicezähler" UBYTE Def_bit_ub_5 0 0 0.0 255.0 ECU_ADDRESS 0x007FCC8E /begin FUNCTION_LIST OZGG /end FUNCTION_LIST BIT_MASK 0x20 /end MEASUREMENT
/begin MEASUREMENT St_ozgg0.B_ozvfchgt "" UBYTE Def_bit_ub_6 0 0 0.0 255.0 ECU_ADDRESS 0x007FCC8E /begin FUNCTION_LIST OZGG /end FUNCTION_LIST BIT_MASK 0x40 /end MEASUREMENT
/begin MEASUREMENT St_ozgg0.B_ozzeitdmew "" UBYTE Def_bit_ub_7 0 0 0.0 255.0 ECU_ADDRESS 0x007FCC8E /begin FUNCTION_LIST OZGG /end FUNCTION_LIST BIT_MASK 0x80 /end MEASUREMENT
/begin MEASUREMENT St_ozgg0 "Statuswort" UBYTE Def_st_ub_q1 0 0 0.0 255.0000 ECU_ADDRESS 0x007FCC8E /begin FUNCTION_LIST OZGG /end FUNCTION_LIST /end MEASUREMENT
/begin MEASUREMENT St_ozgg1.B_ozvfchgc "Bedingung für geänderte Verfügbarkeit vom Kombi über Restweg" UBYTE Def_bit_ub_0 0 0 0.0 255.0 ECU_ADDRESS 0x007FCC8F /begin FUNCTION_LIST OZGG /end FUNCTION_LIST BIT_MASK 0x1 /end MEASUREMENT
/begin MEASUREMENT St_ozgg1.B_ozvfchgcc "Bedingung für geänderte Verfügbarkeit vom Kombi" UBYTE Def_bit_ub_1 0 0 0.0 255.0 ECU_ADDRESS 0x007FCC8F /begin FUNCTION_LIST OZGG /end FUNCTION_LIST BIT_MASK 0x2 /end MEASUREMENT
/begin MEASUREMENT St_ozgg1.B_ozmanip "" UBYTE Def_bit_ub_2 0 0 0.0 255.0 ECU_ADDRESS 0x007FCC8F /begin FUNCTION_LIST OZGG /end FUNCTION_LIST BIT_MASK 0x4 /end MEASUREMENT
/begin MEASUREMENT St_ozgg1.B_ozresett "Reset vom Tester" UBYTE Def_bit_ub_3 0 0 0.0 255.0 ECU_ADDRESS 0x007FCC8F /begin FUNCTION_LIST OZGG /end FUNCTION_LIST BIT_MASK 0x8 /end MEASUREMENT
/begin MEASUREMENT St_ozgg1.B_ozresetcan "Reset BOS vom Kombi (CAN)" UBYTE Def_bit_ub_4 0 0 0.0 255.0 ECU_ADDRESS 0x007FCC8F /begin FUNCTION_LIST OZGG /end FUNCTION_LIST BIT_MASK 0x10 /end MEASUREMENT
/begin MEASUREMENT St_ozgg1.B_ozreset "BOS Reset (Ölwechsel)" UBYTE Def_bit_ub_5 0 0 0.0 255.0 ECU_ADDRESS 0x007FCC8F /begin FUNCTION_LIST OZGG /end FUNCTION_LIST BIT_MASK 0x20 /end MEASUREMENT
/begin MEASUREMENT St_ozgg1 "Statuswort" UBYTE Def_st_ub_q1 0 0 0.0 255.0000 ECU_ADDRESS 0x007FCC8F /begin FUNCTION_LIST OZGG /end FUNCTION_LIST /end MEASUREMENT
/begin MEASUREMENT St_ozgg_nv0.B_dmeini "Bedingung für neue noch nicht initialisierte DME" UBYTE Def_bit_ub_0 0 0 0.0 255.0 ECU_ADDRESS 0x0080104E /begin FUNCTION_LIST OZGG /end FUNCTION_LIST BIT_MASK 0x1 /end MEASUREMENT
/begin MEASUREMENT St_ozgg_nv0.B_dmewech "Bedingung für getauschte DME zur Aktualisierung der BOS-Werte" UBYTE Def_bit_ub_1 0 0 0.0 255.0 ECU_ADDRESS 0x0080104E /begin FUNCTION_LIST OZGG /end FUNCTION_LIST BIT_MASK 0x2 /end MEASUREMENT
/begin MEASUREMENT St_ozgg_nv0.B_factoryres "" UBYTE Def_bit_ub_2 0 0 0.0 255.0 ECU_ADDRESS 0x0080104E /begin FUNCTION_LIST OZGG /end FUNCTION_LIST BIT_MASK 0x4 /end MEASUREMENT
/begin MEASUREMENT St_ozgg_nv0 "Statuswort" UBYTE Def_st_ub_q1 0 0 0.0 255.0000 ECU_ADDRESS 0x0080104E /begin FUNCTION_LIST OZGG /end FUNCTION_LIST /end MEASUREMENT
/begin MEASUREMENT Oz_rwrueck "" SWORD Def_km_sw_q10 0 0 -327680.0000 327670.0000 ECU_ADDRESS 0x0080103A /begin FUNCTION_LIST OZGG /end FUNCTION_LIST /end MEASUREMENT
/begin MEASUREMENT Oz_temp "Öltemperatur ungefiltert" SWORD Def_t_sw_q0p1 0 0 -3276.8000 3276.7000 ECU_ADDRESS 0x0080103C /begin FUNCTION_LIST OZGG /end FUNCTION_LIST /end MEASUREMENT
/begin MEASUREMENT Oz_perm "Permittivität ungefiltert" UWORD Def_perm_uw_b6 0 0 0.0 5.9999 ECU_ADDRESS 0x0080103E /begin FUNCTION_LIST OZGG /end FUNCTION_LIST /end MEASUREMENT
/begin MEASUREMENT Oz_permakt "Permittivität für den Tester" UWORD Def_perm_uw_b6 0 0 0.0 5.9999 ECU_ADDRESS 0x00801040 /begin FUNCTION_LIST OZGG /end FUNCTION_LIST /end MEASUREMENT
/begin MEASUREMENT Oz_manip "geänderter Servicezähler" UBYTE Def_dez_ub_q1 0 0 0.0 255.0000 ECU_ADDRESS 0x00801046 /begin FUNCTION_LIST OZGG /end FUNCTION_LIST /end MEASUREMENT
/begin MEASUREMENT Oz_niv "Ölniveau ungefiltert" UBYTE Def_niv_ub_b75 0 0 0.0 74.7070 ECU_ADDRESS 0x00801047 /begin FUNCTION_LIST OZGG /end FUNCTION_LIST /end MEASUREMENT
/begin MEASUREMENT Oz_svcntchg "geänderter Servicezähler" UBYTE Def_dez_ub_q1 0 0 0.0 255.0000 ECU_ADDRESS 0x00801048 /begin FUNCTION_LIST OZGG /end FUNCTION_LIST /end MEASUREMENT
/begin MEASUREMENT Oz_zjbdmew "" UBYTE Def_dez_ub_q1 0 0 0.0 255.0000 ECU_ADDRESS 0x00801049 /begin FUNCTION_LIST OZGG /end FUNCTION_LIST /end MEASUREMENT
/begin MEASUREMENT Oz_zmbdmew "" UBYTE Def_dez_ub_q1 0 0 0.0 255.0000 ECU_ADDRESS 0x0080104A /begin FUNCTION_LIST OZGG /end FUNCTION_LIST /end MEASUREMENT
/begin MEASUREMENT Oz_kmlow "Kilometerstand letzter Ölwechsel" SWORD Def_km_sw_q10 0 0 -327680.0000 327670.0000 ECU_ADDRESS 0x00801050 /begin FUNCTION_LIST OZGG /end FUNCTION_LIST /end MEASUREMENT
/begin MEASUREMENT Oz_lowrwanz "Register für Restweganzeige beim Ölwechsel" SWORD Def_km_sw_q10 0 0 -327680.0000 327670.0000 ECU_ADDRESS 0x00801052 ARRAY_SIZE 6 /begin FUNCTION_LIST OZGG /end FUNCTION_LIST /end MEASUREMENT
/begin MEASUREMENT Oz_lowkm "Register für KM-Stand beim Ölwechsel" UWORD Def_km_uw_q10 0 0 0.0 655350.0000 ECU_ADDRESS 0x0080105E ARRAY_SIZE 6 /begin FUNCTION_LIST OZGG /end FUNCTION_LIST /end MEASUREMENT
/begin MEASUREMENT Oz_lowperex "Register für extrapoliertes Er beim Ölwechsel" UWORD Def_perm_uw_b6 0 0 0.0 5.9999 ECU_ADDRESS 0x0080106A ARRAY_SIZE 6 /begin FUNCTION_LIST OZGG /end FUNCTION_LIST /end MEASUREMENT
/begin MEASUREMENT Oz_lowperm0 "Register für Er nach Ölwechsel" UWORD Def_perm_uw_b6 0 0 0.0 5.9999 ECU_ADDRESS 0x00801076 ARRAY_SIZE 6 /begin FUNCTION_LIST OZGG /end FUNCTION_LIST /end MEASUREMENT
/begin MEASUREMENT Oz_oelkm "Ölkilometer" UWORD Def_km_uw_q10 0 0 0.0 655350.0000 ECU_ADDRESS 0x00801082 /begin FUNCTION_LIST OZGG /end FUNCTION_LIST /end MEASUREMENT
/begin MEASUREMENT Oz_perref "Ersatzpermittivität" UWORD Def_dez_uw_q1 0 0 0.0 1024.0000 ECU_ADDRESS 0x00801084 /begin FUNCTION_LIST OZGG /end FUNCTION_LIST /end MEASUREMENT
/begin MEASUREMENT Oz_vfbdmew "Verfügbarkeit aus Kombi bei DME-Wechsel" SBYTE Def_dez_sb_q1 0 0 -128.0000 127.0000 ECU_ADDRESS 0x00801086 /begin FUNCTION_LIST OZGG /end FUNCTION_LIST /end MEASUREMENT
/begin MEASUREMENT Oz_lowcnt "Zähler zur Sicherung der Ölwechselinformationen" UBYTE Def_dez_ub_q1 0 0 0.0 255.0000 ECU_ADDRESS 0x00801087 /begin FUNCTION_LIST OZGG /end FUNCTION_LIST /end MEASUREMENT
/begin MEASUREMENT Oz_manipt "Manipulation" UBYTE Def_dez_ub_q1 0 0 0.0 255.0000 ECU_ADDRESS 0x00801088 /begin FUNCTION_LIST OZGG /end FUNCTION_LIST /end MEASUREMENT
/begin MEASUREMENT Oz_rwprueck "" UBYTE Def_km_ub_q1000 0 0 0.0 255000.0000 ECU_ADDRESS 0x00801089 /begin FUNCTION_LIST OZGG /end FUNCTION_LIST /end MEASUREMENT
/begin MEASUREMENT Oz_permt "begrenzter Permittivitäts-Rohwert" UWORD Def_dez_uw_q1 0 0 0.0 1024.0000 ECU_ADDRESS 0x00801042 /begin FUNCTION_LIST OZGG /end FUNCTION_LIST /end MEASUREMENT
/begin MEASUREMENT Oz_tempt "begrenzter Temperatur-Rohwert" UWORD Def_dez_uw_q1 0 0 0.0 65535.0000 ECU_ADDRESS 0x00801044 /begin FUNCTION_LIST OZGG /end FUNCTION_LIST /end MEASUREMENT
/begin MEASUREMENT Oz_nivrers "Ersatzniveau-Rohwert" UBYTE Def_dez_ub_q1 0 0 0.0 255.0000 ECU_ADDRESS 0x0080104B /begin FUNCTION_LIST OZGG /end FUNCTION_LIST /end MEASUREMENT
/begin MEASUREMENT Oz_nivt "begrenzter Niveau-Rohwert" UBYTE Def_dez_ub_q1 0 0 0.0 255.0000 ECU_ADDRESS 0x0080104C /begin FUNCTION_LIST OZGG /end FUNCTION_LIST /end MEASUREMENT
/begin MEASUREMENT Oz_leit_dum "" UBYTE Def_dez_ub_q1 0 0 0.0 255.0000 ECU_ADDRESS 0x007FCC90 /begin FUNCTION_LIST OZLEIT /end FUNCTION_LIST /end MEASUREMENT
/begin MEASUREMENT St_oznivdl0.B_oznivb "" UBYTE Def_bit_ub_0 0 0 0.0 255.0 ECU_ADDRESS 0x007FCC92 /begin FUNCTION_LIST OZNIVDL /end FUNCTION_LIST BIT_MASK 0x1 /end MEASUREMENT
/begin MEASUREMENT St_oznivdl0.B_ozkrzkor "Bedingung drehzahlkorrigierter Kurzzeit Niveaumittelwert berechnet" UBYTE Def_bit_ub_1 0 0 0.0 255.0 ECU_ADDRESS 0x007FCC92 /begin FUNCTION_LIST OZNIVDL /end FUNCTION_LIST BIT_MASK 0x2 /end MEASUREMENT
/begin MEASUREMENT St_oznivdl0.B_ozlangmw "Bedingung Langzeit-Mittelwert berechnet" UBYTE Def_bit_ub_2 0 0 0.0 255.0 ECU_ADDRESS 0x007FCC92 /begin FUNCTION_LIST OZNIVDL /end FUNCTION_LIST BIT_MASK 0x4 /end MEASUREMENT
/begin MEASUREMENT St_oznivdl0.B_ozor "Bedingung Orientierungsmessung erfolgt" UBYTE Def_bit_ub_3 0 0 0.0 255.0 ECU_ADDRESS 0x007FCC92 /begin FUNCTION_LIST OZNIVDL /end FUNCTION_LIST BIT_MASK 0x8 /end MEASUREMENT
/begin MEASUREMENT St_oznivdl0.B_ozvormw "Bedingung vorgezogener Mittelwert berechnet" UBYTE Def_bit_ub_4 0 0 0.0 255.0 ECU_ADDRESS 0x007FCC92 /begin FUNCTION_LIST OZNIVDL /end FUNCTION_LIST BIT_MASK 0x10 /end MEASUREMENT
/begin MEASUREMENT St_oznivdl0.B_ozkrzlkor "" UBYTE Def_bit_ub_5 0 0 0.0 255.0 ECU_ADDRESS 0x007FCC92 /begin FUNCTION_LIST OZNIVDL /end FUNCTION_LIST BIT_MASK 0x20 /end MEASUREMENT
/begin MEASUREMENT St_oznivdl0.B_oelnivnorm "" UBYTE Def_bit_ub_6 0 0 0.0 255.0 ECU_ADDRESS 0x007FCC92 /begin FUNCTION_LIST OZNIVDL /end FUNCTION_LIST BIT_MASK 0x40 /end MEASUREMENT
/begin MEASUREMENT St_oznivdl0.B_ozkrzl "" UBYTE Def_bit_ub_7 0 0 0.0 255.0 ECU_ADDRESS 0x007FCC92 /begin FUNCTION_LIST OZNIVDL /end FUNCTION_LIST BIT_MASK 0x80 /end MEASUREMENT
/begin MEASUREMENT St_oznivdl0 "Statuswort" UBYTE Def_st_ub_q1 0 0 0.0 255.0000 ECU_ADDRESS 0x007FCC92 /begin FUNCTION_LIST OZNIVDL /end FUNCTION_LIST /end MEASUREMENT
/begin MEASUREMENT St_oznivdl1.B_ozkrzkor2 "Ein Mittelwert von zwei KurzMw ist da" UBYTE Def_bit_ub_0 0 0 0.0 255.0 ECU_ADDRESS 0x007FCC91 /begin FUNCTION_LIST OZNIVDL /end FUNCTION_LIST BIT_MASK 0x1 /end MEASUREMENT
/begin MEASUREMENT St_oznivdl1.B_ozkrzkornb "Bedingung drehzahlkorrigierter Kurzzeit Niveaumittelwert und nicht drehzahlbegrenzt berechnet" UBYTE Def_bit_ub_1 0 0 0.0 255.0 ECU_ADDRESS 0x007FCC91 /begin FUNCTION_LIST OZNIVDL /end FUNCTION_LIST BIT_MASK 0x2 /end MEASUREMENT
/begin MEASUREMENT St_oznivdl1 "Statuswort" UBYTE Def_st_ub_q1 0 0 0.0 255.0000 ECU_ADDRESS 0x007FCC91 /begin FUNCTION_LIST OZNIVDL /end FUNCTION_LIST /end MEASUREMENT
/begin MEASUREMENT St_oznivdl_nv0.B_ozlw1 "Bedingung mindestens 1 gültiger Langzeitmittelwert war vorhanden" UBYTE Def_bit_ub_0 0 0 0.0 255.0 ECU_ADDRESS 0x008010BA /begin FUNCTION_LIST OZNIVDL /end FUNCTION_LIST BIT_MASK 0x1 /end MEASUREMENT
/begin MEASUREMENT St_oznivdl_nv0.B_ozpeilerr "" UBYTE Def_bit_ub_1 0 0 0.0 255.0 ECU_ADDRESS 0x008010BA /begin FUNCTION_LIST OZNIVDL /end FUNCTION_LIST BIT_MASK 0x2 /end MEASUREMENT
/begin MEASUREMENT St_oznivdl_nv0 "Statuswort" UBYTE Def_st_ub_q1 0 0 0.0 255.0000 ECU_ADDRESS 0x008010BA /begin FUNCTION_LIST OZNIVDL /end FUNCTION_LIST /end MEASUREMENT
/begin MEASUREMENT Oz_testtoel2 "" SWORD Def_t_sw_q0p1 0 0 -3276.8000 3276.7000 ECU_ADDRESS 0x0080108A /begin FUNCTION_LIST OZNIVDL /end FUNCTION_LIST /end MEASUREMENT
/begin MEASUREMENT Oz_krzor "kurzzeitiger Mittelwert Orientierungsmessung Niveau" UBYTE Def_niv_ub_b75 0 0 0.0 74.7070 ECU_ADDRESS 0x0080109E /begin FUNCTION_LIST OZNIVDL /end FUNCTION_LIST /end MEASUREMENT
/begin MEASUREMENT Oz_lp "oz level picture" UBYTE Def_dez_ub_q1 0 0 0.0 255.0000 ECU_ADDRESS 0x0080109F /begin FUNCTION_LIST OZNIVDL /end FUNCTION_LIST /end MEASUREMENT
/begin MEASUREMENT Oz_lv "oz level value" UBYTE Def_dez_ub_q1 0 0 0.0 255.0000 ECU_ADDRESS 0x008010A0 /begin FUNCTION_LIST OZNIVDL /end FUNCTION_LIST /end MEASUREMENT
/begin MEASUREMENT Oz_nivakt "Aktuelles Niveau für den Tester" UBYTE Def_niv_ub_b75 0 0 0.0 74.7070 ECU_ADDRESS 0x008010A1 /begin FUNCTION_LIST OZNIVDL /end FUNCTION_LIST /end MEASUREMENT
/begin MEASUREMENT Oz_nivkrzt "Kurzmittelwert-Niveau für den Tester" UBYTE Def_niv_ub_b75 0 0 0.0 74.7070 ECU_ADDRESS 0x008010A2 /begin FUNCTION_LIST OZNIVDL /end FUNCTION_LIST /end MEASUREMENT
/begin MEASUREMENT Oz_nivnfm "Nachfüllmenge" UBYTE Def_niv_ub_b8 0 0 0.0 7.9687 ECU_ADDRESS 0x008010A3 /begin FUNCTION_LIST OZNIVDL /end FUNCTION_LIST /end MEASUREMENT
/begin MEASUREMENT Oz_orikor "OriMw korrigiert" UBYTE Def_niv_ub_b75 0 0 0.0 74.7070 ECU_ADDRESS 0x008010A4 /begin FUNCTION_LIST OZNIVDL /end FUNCTION_LIST /end MEASUREMENT
/begin MEASUREMENT Oz_vormw "vorgezogener Mittelwert Niveau" UBYTE Def_niv_ub_b75 0 0 0.0 74.7070 ECU_ADDRESS 0x008010A5 /begin FUNCTION_LIST OZNIVDL /end FUNCTION_LIST /end MEASUREMENT
/begin MEASUREMENT Oz_rwpeil "Restweg laut Peilstab" SWORD Def_km_sw_q10 0 0 -327680.0000 327670.0000 ECU_ADDRESS 0x008010BC /begin FUNCTION_LIST OZNIVDL /end FUNCTION_LIST /end MEASUREMENT
/begin MEASUREMENT Oz_oelverbr "Berechneter Ölverbrauch" UWORD Def_dez_uw_q1 0 0 0.0 65535.0000 ECU_ADDRESS 0x008010BE /begin FUNCTION_LIST OZNIVDL /end FUNCTION_LIST /end MEASUREMENT
/begin MEASUREMENT Oz_peilkmalt "Km Stand beim 1. Sensorfehler" UWORD Def_km_uw_q10 0 0 0.0 655350.0000 ECU_ADDRESS 0x008010C0 /begin FUNCTION_LIST OZNIVDL /end FUNCTION_LIST /end MEASUREMENT
/begin MEASUREMENT Oz_verbkmalt "Km-Stand letzter Ölverbrauch-Berechnung" UWORD Def_km_uw_q10 0 0 0.0 655350.0000 ECU_ADDRESS 0x008010C2 /begin FUNCTION_LIST OZNIVDL /end FUNCTION_LIST /end MEASUREMENT
/begin MEASUREMENT Oz_langmw "Langzeitmittelwert berechnet" UBYTE Def_niv_ub_b75 0 0 0.0 74.7070 ECU_ADDRESS 0x008010C4 /begin FUNCTION_LIST OZNIVDL /end FUNCTION_LIST /end MEASUREMENT
/begin MEASUREMENT Oz_nivlangt "Langmittelwert für den Tester" UBYTE Def_niv_ub_b75 0 0 0.0 74.7070 ECU_ADDRESS 0x008010C5 /begin FUNCTION_LIST OZNIVDL /end FUNCTION_LIST /end MEASUREMENT
/begin MEASUREMENT Oz_peilaltanz "" UBYTE Def_niv_ub_b75 0 0 0.0 74.7070 ECU_ADDRESS 0x008010C6 /begin FUNCTION_LIST OZNIVDL /end FUNCTION_LIST /end MEASUREMENT
/begin MEASUREMENT Oz_verbnivalt "Ölniveau letzter Ölverbrauch-Berechnung" UBYTE Def_niv_ub_b75 0 0 0.0 74.7070 ECU_ADDRESS 0x008010C7 /begin FUNCTION_LIST OZNIVDL /end FUNCTION_LIST /end MEASUREMENT
/begin MEASUREMENT N_ozmw "kurzzeitiger Mittelwert Drehzahl" SWORD Def_n_sw_q1p0 0 0 -32767.0000 32767.0000 ECU_ADDRESS 0x0080108C /begin FUNCTION_LIST OZNIVDL /end FUNCTION_LIST /end MEASUREMENT
/begin MEASUREMENT Oz_hoehe "" SWORD Def_f_sw_b8 0 0 -8.0000 7.9997 ECU_ADDRESS 0x0080108E /begin FUNCTION_LIST OZNIVDL /end FUNCTION_LIST /end MEASUREMENT
/begin MEASUREMENT Oz_nmotf "" SWORD Def_n_sw_q1p0 0 0 -32768.0000 32767.0000 ECU_ADDRESS 0x00801090 /begin FUNCTION_LIST OZNIVDL /end FUNCTION_LIST /end MEASUREMENT
/begin MEASUREMENT Oz_nmotfm "Drehzehlmittelwert Töns" SWORD Def_n_sw_q1p0 0 0 -32768.0000 32767.0000 ECU_ADDRESS 0x00801092 /begin FUNCTION_LIST OZNIVDL /end FUNCTION_LIST /end MEASUREMENT
/begin MEASUREMENT Oz_steigung "" SWORD Def_f_sw_b64 0 0 -64.0000 63.9980 ECU_ADDRESS 0x00801094 /begin FUNCTION_LIST OZNIVDL /end FUNCTION_LIST /end MEASUREMENT
/begin MEASUREMENT Oz_dkm "" UWORD Def_f_uw_b10 0 0 0.0 9.9998 ECU_ADDRESS 0x00801096 /begin FUNCTION_LIST OZNIVDL /end FUNCTION_LIST /end MEASUREMENT
/begin MEASUREMENT Oz_nivlit "Ölniveau in Liter" UWORD Def_niv_uw_q0p1 0 0 0.0 25.5000 ECU_ADDRESS 0x00801098 /begin FUNCTION_LIST OZNIVDL /end FUNCTION_LIST /end MEASUREMENT
/begin MEASUREMENT Oz_peilkm "Max Ziel km im Fehlerfall" UWORD Def_km_uw_q10 0 0 0.0 655350.0000 ECU_ADDRESS 0x0080109A /begin FUNCTION_LIST OZNIVDL /end FUNCTION_LIST /end MEASUREMENT
/begin MEASUREMENT Oz_pzdivp "Verhältnis oz_luftalt/oz_luftneu" UWORD Def_f_uw_b2 0 0 0.0 1.9999 ECU_ADDRESS 0x0080109C /begin FUNCTION_LIST OZNIVDL /end FUNCTION_LIST /end MEASUREMENT
/begin MEASUREMENT Oz_krzcnt "" UBYTE Def_dez_ub_q1 0 0 0.0 255.0000 ECU_ADDRESS 0x008010A6 /begin FUNCTION_LIST OZNIVDL /end FUNCTION_LIST /end MEASUREMENT
/begin MEASUREMENT Oz_krzkor2 "Mittelwert von zwei KurzMw" UBYTE Def_niv_ub_b75 0 0 0.0 74.7070 ECU_ADDRESS 0x008010A7 /begin FUNCTION_LIST OZNIVDL /end FUNCTION_LIST /end MEASUREMENT
/begin MEASUREMENT Oz_krzmw "" UBYTE Def_niv_ub_b75 0 0 0.0 74.7070 ECU_ADDRESS 0x008010A8 /begin FUNCTION_LIST OZNIVDL /end FUNCTION_LIST /end MEASUREMENT
/begin MEASUREMENT Oz_krzmwkor "" UBYTE Def_niv_ub_b75 0 0 0.0 74.7070 ECU_ADDRESS 0x008010A9 /begin FUNCTION_LIST OZNIVDL /end FUNCTION_LIST /end MEASUREMENT
/begin MEASUREMENT Oz_lgmwcnt "" UBYTE Def_dez_ub_q1 0 0 0.0 255.0000 ECU_ADDRESS 0x008010AA /begin FUNCTION_LIST OZNIVDL /end FUNCTION_LIST /end MEASUREMENT
/begin MEASUREMENT Oz_oelnivak "" UBYTE Def_td_ub_q0p5 0 0 0.0 127.5000 ECU_ADDRESS 0x008010AB /begin FUNCTION_LIST OZNIVDL /end FUNCTION_LIST /end MEASUREMENT
/begin MEASUREMENT Oz_oelnivaknk "" UBYTE Def_td_ub_q0p5 0 0 0.0 127.5000 ECU_ADDRESS 0x008010AC /begin FUNCTION_LIST OZNIVDL /end FUNCTION_LIST /end MEASUREMENT
/begin MEASUREMENT Oz_oelnivkurz "" UBYTE Def_td_ub_q0p5 0 0 0.0 127.5000 ECU_ADDRESS 0x008010AD /begin FUNCTION_LIST OZNIVDL /end FUNCTION_LIST /end MEASUREMENT
/begin MEASUREMENT Oz_oelnivm "10er Mittelwert Töns nicht korrigiet" UBYTE Def_td_ub_q0p5 0 0 0.0 127.5000 ECU_ADDRESS 0x008010AE /begin FUNCTION_LIST OZNIVDL /end FUNCTION_LIST /end MEASUREMENT
/begin MEASUREMENT Oz_oelnivnorm "" UBYTE Def_td_ub_q0p5 0 0 0.0 127.5000 ECU_ADDRESS 0x008010AF /begin FUNCTION_LIST OZNIVDL /end FUNCTION_LIST /end MEASUREMENT
/begin MEASUREMENT Oz_oelnivori "" UBYTE Def_td_ub_q0p5 0 0 0.0 127.5000 ECU_ADDRESS 0x008010B0 /begin FUNCTION_LIST OZNIVDL /end FUNCTION_LIST /end MEASUREMENT
/begin MEASUREMENT Oz_peil "" UBYTE Def_niv_ub_b75 0 0 0.0 74.7070 ECU_ADDRESS 0x008010B1 /begin FUNCTION_LIST OZNIVDL /end FUNCTION_LIST /end MEASUREMENT
/begin MEASUREMENT Oz_peilalt "" UBYTE Def_niv_ub_b75 0 0 0.0 74.7070 ECU_ADDRESS 0x008010B2 /begin FUNCTION_LIST OZNIVDL /end FUNCTION_LIST /end MEASUREMENT
/begin MEASUREMENT Oz_peilalt1 "" UBYTE Def_niv_ub_b75 0 0 0.0 74.7070 ECU_ADDRESS 0x008010B3 /begin FUNCTION_LIST OZNIVDL /end FUNCTION_LIST /end MEASUREMENT
/begin MEASUREMENT Oz_peilalt2 "" UBYTE Def_niv_ub_b75 0 0 0.0 74.7070 ECU_ADDRESS 0x008010B4 /begin FUNCTION_LIST OZNIVDL /end FUNCTION_LIST /end MEASUREMENT
/begin MEASUREMENT Oz_tog_i "" UBYTE Def_dez_ub_q1 0 0 0.0 255.0000 ECU_ADDRESS 0x008010B5 /begin FUNCTION_LIST OZNIVDL /end FUNCTION_LIST /end MEASUREMENT
/begin MEASUREMENT Oz_togbwi "" UBYTE Def_dez_ub_q1 0 0 0.0 255.0000 ECU_ADDRESS 0x008010B6 /begin FUNCTION_LIST OZNIVDL /end FUNCTION_LIST /end MEASUREMENT
/begin MEASUREMENT Oz_togki "" UBYTE Def_dez_ub_q1 0 0 0.0 255.0000 ECU_ADDRESS 0x008010B7 /begin FUNCTION_LIST OZNIVDL /end FUNCTION_LIST /end MEASUREMENT
/begin MEASUREMENT Oz_vormwcnt "" UBYTE Def_dez_ub_q1 0 0 0.0 255.0000 ECU_ADDRESS 0x008010B8 /begin FUNCTION_LIST OZNIVDL /end FUNCTION_LIST /end MEASUREMENT
/begin MEASUREMENT St_ozperm0.B_calcdper "" UBYTE Def_bit_ub_0 0 0 0.0 255.0 ECU_ADDRESS 0x007FCC93 /begin FUNCTION_LIST OZPERM /end FUNCTION_LIST BIT_MASK 0x1 /end MEASUREMENT
/begin MEASUREMENT St_ozperm0.B_ozpermgl "" UBYTE Def_bit_ub_1 0 0 0.0 255.0 ECU_ADDRESS 0x007FCC93 /begin FUNCTION_LIST OZPERM /end FUNCTION_LIST BIT_MASK 0x2 /end MEASUREMENT
/begin MEASUREMENT St_ozperm0.B_ozpermpl "" UBYTE Def_bit_ub_2 0 0 0.0 255.0 ECU_ADDRESS 0x007FCC93 /begin FUNCTION_LIST OZPERM /end FUNCTION_LIST BIT_MASK 0x4 /end MEASUREMENT
/begin MEASUREMENT St_ozperm0.B_ozpermpld "Bedingung für Berechnung Restweg aus Er" UBYTE Def_bit_ub_3 0 0 0.0 255.0 ECU_ADDRESS 0x007FCC93 /begin FUNCTION_LIST OZPERM /end FUNCTION_LIST BIT_MASK 0x8 /end MEASUREMENT
/begin MEASUREMENT St_ozperm0 "Statuswort" UBYTE Def_st_ub_q1 0 0 0.0 255.0000 ECU_ADDRESS 0x007FCC93 /begin FUNCTION_LIST OZPERM /end FUNCTION_LIST /end MEASUREMENT
/begin MEASUREMENT St_ozperm_nv0.B_ozper0ok "Bedingung, dass gültiger Start-Permittivitätswert vorliegt" UBYTE Def_bit_ub_0 0 0 0.0 255.0 ECU_ADDRESS 0x008010CC /begin FUNCTION_LIST OZPERM /end FUNCTION_LIST BIT_MASK 0x1 /end MEASUREMENT
/begin MEASUREMENT St_ozperm_nv0.B_ozeranz "Bedingung für Anzeige Restweg aus Er" UBYTE Def_bit_ub_1 0 0 0.0 255.0 ECU_ADDRESS 0x008010CC /begin FUNCTION_LIST OZPERM /end FUNCTION_LIST BIT_MASK 0x2 /end MEASUREMENT
/begin MEASUREMENT St_ozperm_nv0.B_ozregstg "Bedingung Schieberegistersteuerung" UBYTE Def_bit_ub_2 0 0 0.0 255.0 ECU_ADDRESS 0x008010CC /begin FUNCTION_LIST OZPERM /end FUNCTION_LIST BIT_MASK 0x4 /end MEASUREMENT
/begin MEASUREMENT St_ozperm_nv0.B_ozer0ok "Bedingung Permittivität beim letztem Ölwechsel endgültig berechnet" UBYTE Def_bit_ub_3 0 0 0.0 255.0 ECU_ADDRESS 0x008010CC /begin FUNCTION_LIST OZPERM /end FUNCTION_LIST BIT_MASK 0x8 /end MEASUREMENT
/begin MEASUREMENT St_ozperm_nv0.B_ozdperm "Bedingung Delta Er-Ermittlung aktiv" UBYTE Def_bit_ub_4 0 0 0.0 255.0 ECU_ADDRESS 0x008010CC /begin FUNCTION_LIST OZPERM /end FUNCTION_LIST BIT_MASK 0x10 /end MEASUREMENT
/begin MEASUREMENT St_ozperm_nv0.B_ozerplt "Bedingung Ausheizzeit erfüllt" UBYTE Def_bit_ub_5 0 0 0.0 255.0 ECU_ADDRESS 0x008010CC /begin FUNCTION_LIST OZPERM /end FUNCTION_LIST BIT_MASK 0x20 /end MEASUREMENT
/begin MEASUREMENT St_ozperm_nv0 "Statuswort" UBYTE Def_st_ub_q1 0 0 0.0 255.0000 ECU_ADDRESS 0x008010CC /begin FUNCTION_LIST OZPERM /end FUNCTION_LIST /end MEASUREMENT
/begin MEASUREMENT Oz_permoff "Offset für Permittivitätskorrektur" UWORD Def_perm_uw_b6 0 0 0.0 5.9999 ECU_ADDRESS 0x008010C8 /begin FUNCTION_LIST OZPERM /end FUNCTION_LIST /end MEASUREMENT
/begin MEASUREMENT Oz_permoff_oz "Offset für Permittivitätskorrektur" SWORD Def_perm_sw_b6 0 0 -6.0000 5.9998 ECU_ADDRESS 0x008010CE /begin FUNCTION_LIST OZPERM /end FUNCTION_LIST /end MEASUREMENT
/begin MEASUREMENT Oz_kmreg "Schieberegister Kilometerstand" UWORD Def_km_uw_q10 0 0 0.0 655350.0000 ECU_ADDRESS 0x008010D0 ARRAY_SIZE 15 /begin FUNCTION_LIST OZPERM /end FUNCTION_LIST /end MEASUREMENT
/begin MEASUREMENT Oz_nivkm "letzter Kilometerstand bei dem ein neuer Langzeitmittelwert Niveau vorlag und kein Öl nachgefüllt wurde" UWORD Def_km_uw_q10 0 0 0.0 655350.0000 ECU_ADDRESS 0x008010EE /begin FUNCTION_LIST OZPERM /end FUNCTION_LIST /end MEASUREMENT
/begin MEASUREMENT Oz_permex "Permittivität für Bewertung aufbereitet (extrapoliert)" UWORD Def_perm_uw_b6 0 0 0.0 5.9999 ECU_ADDRESS 0x008010F0 /begin FUNCTION_LIST OZPERM /end FUNCTION_LIST /end MEASUREMENT
/begin MEASUREMENT Oz_permlow "aufbereitete Permittivität bei letztem Ölwechsel" UWORD Def_perm_uw_b6 0 0 0.0 5.9999 ECU_ADDRESS 0x008010F2 /begin FUNCTION_LIST OZPERM /end FUNCTION_LIST /end MEASUREMENT
/begin MEASUREMENT Oz_permreg "Schieberegister Permittivität" UWORD Def_perm_uw_b6 0 0 0.0 5.9999 ECU_ADDRESS 0x008010F4 ARRAY_SIZE 15 /begin FUNCTION_LIST OZPERM /end FUNCTION_LIST /end MEASUREMENT
/begin MEASUREMENT Oz_prfstrg "Zähler für Delta Er-Ermittlung" UWORD Def_dez_uw_q1 0 0 0.0 65535.0000 ECU_ADDRESS 0x00801112 /begin FUNCTION_LIST OZPERM /end FUNCTION_LIST /end MEASUREMENT
/begin MEASUREMENT Oz_todeltime "Zähler Ausheizzeit (nichtflüchtig)" UWORD Def_td_uw_q1 0 0 0.0 65535.0000 ECU_ADDRESS 0x00801114 /begin FUNCTION_LIST OZPERM /end FUNCTION_LIST /end MEASUREMENT
/begin MEASUREMENT Oz_permanz "Anzahl der Messwerte im Schieberegister" SBYTE Def_dez_sb_q1 0 0 -128.0000 127.0000 ECU_ADDRESS 0x00801116 /begin FUNCTION_LIST OZPERM /end FUNCTION_LIST /end MEASUREMENT
/begin MEASUREMENT Oz_dpermsi "" SBYTE Def_dez_sb_q1 0 0 -128.0000 127.0000 ECU_ADDRESS 0x008010CA /begin FUNCTION_LIST OZPERM /end FUNCTION_LIST /end MEASUREMENT
/begin MEASUREMENT St_ozrestkm_0.B_oznoperm "Keine Berechnung von Permittivität für die Restlaufstrecke" UBYTE Def_bit_ub_0 0 0 0.0 255.0 ECU_ADDRESS 0x007FCCC4 /begin FUNCTION_LIST OZRESTKM /end FUNCTION_LIST BIT_MASK 0x1 /end MEASUREMENT
/begin MEASUREMENT St_ozrestkm_0 "Statuswort" UBYTE Def_st_ub_q1 0 0 0.0 255.0000 ECU_ADDRESS 0x007FCCC4 /begin FUNCTION_LIST OZRESTKM /end FUNCTION_LIST /end MEASUREMENT
/begin MEASUREMENT St_ozrestkm_nv0.B_rwanz0 "Bedingung für Restweganzeige = Null" UBYTE Def_bit_ub_0 0 0 0.0 255.0 ECU_ADDRESS 0x00801140 /begin FUNCTION_LIST OZRESTKM /end FUNCTION_LIST BIT_MASK 0x1 /end MEASUREMENT
/begin MEASUREMENT St_ozrestkm_nv0.B_ozvfk "Prognose und KVB aus der Kombi-Verfügbarkeit berechnet " UBYTE Def_bit_ub_1 0 0 0.0 255.0 ECU_ADDRESS 0x00801140 /begin FUNCTION_LIST OZRESTKM /end FUNCTION_LIST BIT_MASK 0x2 /end MEASUREMENT
/begin MEASUREMENT St_ozrestkm_nv0.B_ozini "" UBYTE Def_bit_ub_2 0 0 0.0 255.0 ECU_ADDRESS 0x00801140 /begin FUNCTION_LIST OZRESTKM /end FUNCTION_LIST BIT_MASK 0x4 /end MEASUREMENT
/begin MEASUREMENT St_ozrestkm_nv0.B_ozcntini "Tageberechnung initialisiert" UBYTE Def_bit_ub_3 0 0 0.0 255.0 ECU_ADDRESS 0x00801140 /begin FUNCTION_LIST OZRESTKM /end FUNCTION_LIST BIT_MASK 0x8 /end MEASUREMENT
/begin MEASUREMENT St_ozrestkm_nv0 "Statuswort" UBYTE Def_st_ub_q1 0 0 0.0 255.0000 ECU_ADDRESS 0x00801140 /begin FUNCTION_LIST OZRESTKM /end FUNCTION_LIST /end MEASUREMENT
/begin MEASUREMENT Oz_rwkvb "" SWORD Def_km_sw_q10 0 0 -327680.0000 327670.0000 ECU_ADDRESS 0x00801120 /begin FUNCTION_LIST OZRESTKM /end FUNCTION_LIST /end MEASUREMENT
/begin MEASUREMENT Oz_rwperm "Restweg aus Permittivität abgeleitet" SWORD Def_km_sw_q10 0 0 -327680.0000 327670.0000 ECU_ADDRESS 0x00801122 /begin FUNCTION_LIST OZRESTKM /end FUNCTION_LIST /end MEASUREMENT
/begin MEASUREMENT Oz_rwzeit "Restweg laut Zeitverlauf" SWORD Def_km_sw_q10 0 0 -327680.0000 327670.0000 ECU_ADDRESS 0x00801124 /begin FUNCTION_LIST OZRESTKM /end FUNCTION_LIST /end MEASUREMENT
/begin MEASUREMENT Oz_oelzeit "Öl-Alter in Monate" UWORD Def_dez_uw_q1 0 0 0.0 65535.0000 ECU_ADDRESS 0x00801126 /begin FUNCTION_LIST OZRESTKM /end FUNCTION_LIST /end MEASUREMENT
/begin MEASUREMENT Oz_oelzeitt "Öl-Alter in Tage" UWORD Def_dez_uw_q1 0 0 0.0 65535.0000 ECU_ADDRESS 0x00801128 /begin FUNCTION_LIST OZRESTKM /end FUNCTION_LIST /end MEASUREMENT
/begin MEASUREMENT Oz_rwprog "Prognose_Intervall_Weg_BOS_Meldung_2" UWORD Def_km_uw_q10 0 0 0.0 655350.0000 ECU_ADDRESS 0x0080112A /begin FUNCTION_LIST OZRESTKM /end FUNCTION_LIST /end MEASUREMENT
/begin MEASUREMENT Oz_intprog "Prognose_Intervall_Zeit_BOS_Meldung_2" UBYTE Def_dez_ub_q1 0 0 0.0 255.0000 ECU_ADDRESS 0x00801138 /begin FUNCTION_LIST OZRESTKM /end FUNCTION_LIST /end MEASUREMENT
/begin MEASUREMENT Oz_vfanz "anzuzeigende Verfügbarkeit" UBYTE Def_lf_ub_q0p01 0 0 0.0 2.5500 ECU_ADDRESS 0x00801139 /begin FUNCTION_LIST OZRESTKM /end FUNCTION_LIST /end MEASUREMENT
/begin MEASUREMENT Oz_kvbmw "" ULONG Def_fuel_ul_q0p000122 0 0 0.0 100.0000 ECU_ADDRESS 0x00801144 /begin FUNCTION_LIST OZRESTKM /end FUNCTION_LIST /end MEASUREMENT
/begin MEASUREMENT Oz_kvbsm_ul "" ULONG Def_fuel_ul_q0p000122 0 0 0.0 524287.9998 ECU_ADDRESS 0x00801148 /begin FUNCTION_LIST OZRESTKM /end FUNCTION_LIST /end MEASUREMENT
/begin MEASUREMENT Oz_cttagini "Tag beim Ölwechsel" SWORD Def_dez_sw_q1 0 0 -32768.0000 32767.0000 ECU_ADDRESS 0x0080114C /begin FUNCTION_LIST OZRESTKM /end FUNCTION_LIST /end MEASUREMENT
/begin MEASUREMENT Oz_rwanz "anzuzeigender Restweg" SWORD Def_km_sw_q10 0 0 -327680.0000 327670.0000 ECU_ADDRESS 0x0080114E /begin FUNCTION_LIST OZRESTKM /end FUNCTION_LIST /end MEASUREMENT
/begin MEASUREMENT Oz_kmstrw0 "Kilometerstand bei Restweg = Null" UWORD Def_km_uw_q10 0 0 0.0 655350.0000 ECU_ADDRESS 0x00801150 /begin FUNCTION_LIST OZRESTKM /end FUNCTION_LIST /end MEASUREMENT
/begin MEASUREMENT Oz_kvbog "zugeteilte Bonuskraftstoffmenge" UWORD Def_dez_uw_q1 0 0 0.0 65535.0000 ECU_ADDRESS 0x00801152 /begin FUNCTION_LIST OZRESTKM /end FUNCTION_LIST /end MEASUREMENT
/begin MEASUREMENT Oz_permbog "zugeteilter Permittivitätsbonus" UWORD Def_perm_uw_b6 0 0 0.0 5.9999 ECU_ADDRESS 0x00801154 /begin FUNCTION_LIST OZRESTKM /end FUNCTION_LIST /end MEASUREMENT
/begin MEASUREMENT Oz_utzeit "Zeit Öl in Übertemperatur" UWORD Def_dez_uw_q1 0 0 0.0 65535.0000 ECU_ADDRESS 0x00801156 /begin FUNCTION_LIST OZRESTKM /end FUNCTION_LIST /end MEASUREMENT
/begin MEASUREMENT Oz_lf1t "Länderfaktor 1" UBYTE Def_lf_ub_q0p01 0 0 0.0 2.5500 ECU_ADDRESS 0x00801158 /begin FUNCTION_LIST OZRESTKM /end FUNCTION_LIST /end MEASUREMENT
/begin MEASUREMENT Oz_lf2t "Länderfaktor 2" UBYTE Def_lf_ub_q0p01 0 0 0.0 2.5500 ECU_ADDRESS 0x00801159 /begin FUNCTION_LIST OZRESTKM /end FUNCTION_LIST /end MEASUREMENT
/begin MEASUREMENT Oz_zieljahr "" UBYTE Def_dez_ub_q1 0 0 0.0 255.0000 ECU_ADDRESS 0x0080115A /begin FUNCTION_LIST OZRESTKM /end FUNCTION_LIST /end MEASUREMENT
/begin MEASUREMENT Oz_zielmon "" UBYTE Def_dez_ub_q1 0 0 0.0 255.0000 ECU_ADDRESS 0x0080115B /begin FUNCTION_LIST OZRESTKM /end FUNCTION_LIST /end MEASUREMENT
/begin MEASUREMENT Oz_kvbdiff "" ULONG Def_fuel_ul_q0p000122 0 0 0.0 100.0000 ECU_ADDRESS 0x00801118 /begin FUNCTION_LIST OZRESTKM /end FUNCTION_LIST /end MEASUREMENT
/begin MEASUREMENT Oz_kvbsm "" ULONG Def_fuel_ul_q0p000122 0 0 0.0 10000.0000 ECU_ADDRESS 0x0080111C /begin FUNCTION_LIST OZRESTKM /end FUNCTION_LIST /end MEASUREMENT
/begin MEASUREMENT Oz_rwp "Zwischengröße Restwegberechnung" SWORD Def_km_sw_q10 0 0 -327680.0000 327670.0000 ECU_ADDRESS 0x0080112C /begin FUNCTION_LIST OZRESTKM /end FUNCTION_LIST /end MEASUREMENT
/begin MEASUREMENT Oz_kvbmwtmp "" UWORD Def_f_uw_b64 0 0 0.0 63.9990 ECU_ADDRESS 0x0080112E /begin FUNCTION_LIST OZRESTKM /end FUNCTION_LIST /end MEASUREMENT
/begin MEASUREMENT Oz_kvbmx "" UWORD Def_dez_uw_q1 0 0 0.0 65535.0000 ECU_ADDRESS 0x00801130 /begin FUNCTION_LIST OZRESTKM /end FUNCTION_LIST /end MEASUREMENT
/begin MEASUREMENT Oz_kvbtmp2 "" UWORD Def_km_uw_q10 0 0 0.0 655350.0000 ECU_ADDRESS 0x00801132 /begin FUNCTION_LIST OZRESTKM /end FUNCTION_LIST /end MEASUREMENT
/begin MEASUREMENT Oz_litges "Gesamtverbrauch für Ölwechsel" UWORD Def_dez_uw_q1 0 0 0.0 65535.0000 ECU_ADDRESS 0x00801134 /begin FUNCTION_LIST OZRESTKM /end FUNCTION_LIST /end MEASUREMENT
/begin MEASUREMENT Oz_litgesk "Gesamtverbrauch für Ölwechsel" UWORD Def_dez_uw_q1 0 0 0.0 65535.0000 ECU_ADDRESS 0x00801136 /begin FUNCTION_LIST OZRESTKM /end FUNCTION_LIST /end MEASUREMENT
/begin MEASUREMENT Oz_vfkvb "Verfügbarkeit aus Kraftstoffverbrauch" UBYTE Def_lf_ub_q0p01 0 0 0.0 2.5500 ECU_ADDRESS 0x0080113A /begin FUNCTION_LIST OZRESTKM /end FUNCTION_LIST /end MEASUREMENT
/begin MEASUREMENT Oz_vfperm "Verfügbarkeit aus der Permittivität" UBYTE Def_lf_ub_q0p01 0 0 0.0 2.5500 ECU_ADDRESS 0x0080113B /begin FUNCTION_LIST OZRESTKM /end FUNCTION_LIST /end MEASUREMENT
/begin MEASUREMENT Oz_vfzeit "Verfügbarkeit aus Zeit" UBYTE Def_lf_ub_q0p01 0 0 0.0 2.5500 ECU_ADDRESS 0x0080113C /begin FUNCTION_LIST OZRESTKM /end FUNCTION_LIST /end MEASUREMENT
/begin MEASUREMENT Oz_tempf "" SWORD Def_t_sw_q0p1 0 0 -3276.8000 3276.7000 ECU_ADDRESS 0x007FCD04 /begin FUNCTION_LIST OZTEMP /end FUNCTION_LIST /end MEASUREMENT
/begin MEASUREMENT St_bns2.B_nachlnd7 "Bordnetzstabilitätsmaßnahmen aktiv" UBYTE Def_bit_ub_0 0 0 0.0 255.0 ECU_ADDRESS 0x007FCEDA /begin FUNCTION_LIST PMBNSTAB /end FUNCTION_LIST BIT_MASK 0x1 /end MEASUREMENT
/begin MEASUREMENT St_bns2 "Statuswort" UBYTE Def_st_ub_q1 0 0 0.0 255.0000 ECU_ADDRESS 0x007FCEDA /begin FUNCTION_LIST PMBNSTAB /end FUNCTION_LIST /end MEASUREMENT
/begin MEASUREMENT St_bns.B_bns "lokales B_nachlaufende" UBYTE Def_bit_ub_0 0 0 0.0 255.0 ECU_ADDRESS 0x00801160 /begin FUNCTION_LIST PMBNSTAB /end FUNCTION_LIST BIT_MASK 0x1 /end MEASUREMENT
/begin MEASUREMENT St_bns "Statuswort" UBYTE Def_st_ub_q1 0 0 0.0 255.0000 ECU_ADDRESS 0x00801160 /begin FUNCTION_LIST PMBNSTAB /end FUNCTION_LIST /end MEASUREMENT
/begin MEASUREMENT Bnctrmx1s "" UBYTE Def_dez_ub_q1 0 0 0.0 255.0000 ECU_ADDRESS 0x0080115C /begin FUNCTION_LIST PMBNSTAB /end FUNCTION_LIST /end MEASUREMENT
/begin MEASUREMENT Bnsctrant0 "Counter 1 sec-Anteile ohne Grenzwertüberschreitung" ULONG Def_dez_ul_q1 0 0 0.0 4294967295.0000 ECU_ADDRESS 0x00801164 /begin FUNCTION_LIST PMBNSTAB /end FUNCTION_LIST /end MEASUREMENT
/begin MEASUREMENT Bnsctrant1 "Counter 1 sec-Anteile 1. Bereich" UWORD Def_dez_uw_q1 0 0 0.0 65535.0000 ECU_ADDRESS 0x00801168 /begin FUNCTION_LIST PMBNSTAB /end FUNCTION_LIST /end MEASUREMENT
/begin MEASUREMENT Bnsctrant2 "Counter 1 sec-Anteile 2. Bereich" UWORD Def_dez_uw_q1 0 0 0.0 65535.0000 ECU_ADDRESS 0x0080116A /begin FUNCTION_LIST PMBNSTAB /end FUNCTION_LIST /end MEASUREMENT
/begin MEASUREMENT Bnsctrant3 "Counter 1 sec-Anteile 3. Bereich" UWORD Def_dez_uw_q1 0 0 0.0 65535.0000 ECU_ADDRESS 0x0080116C /begin FUNCTION_LIST PMBNSTAB /end FUNCTION_LIST /end MEASUREMENT
/begin MEASUREMENT Bnsctr "Counter Bordnetzspannungsplausibilisierung" UBYTE Def_dez_ub_q1 0 0 0.0 255.0000 ECU_ADDRESS 0x0080116E /begin FUNCTION_LIST PMBNSTAB /end FUNCTION_LIST /end MEASUREMENT
/begin MEASUREMENT St_pmdiag0.B_codierpm "Q_elad 1. Takt vorbei " UBYTE Def_bit_ub_0 0 0 0.0 255.0 ECU_ADDRESS 0x007FCF34 /begin FUNCTION_LIST PMDIAG /end FUNCTION_LIST BIT_MASK 0x1 /end MEASUREMENT
/begin MEASUREMENT St_pmdiag0.B_ccprio "Anfrage an CAS die Codierdaten erneut fuer PM zu senden." UBYTE Def_bit_ub_1 0 0 0.0 255.0 ECU_ADDRESS 0x007FCF34 /begin FUNCTION_LIST PMDIAG /end FUNCTION_LIST BIT_MASK 0x2 /end MEASUREMENT
/begin MEASUREMENT St_pmdiag0.B_ccbttdfk "CC Meldung : Komfortverbraucher eingeschraenkt" UBYTE Def_bit_ub_2 0 0 0.0 255.0 ECU_ADDRESS 0x007FCF34 /begin FUNCTION_LIST PMDIAG /end FUNCTION_LIST BIT_MASK 0x4 /end MEASUREMENT
/begin MEASUREMENT St_pmdiag0.B_ccpmerr "CC Meldung : Batterie Nachladen" UBYTE Def_bit_ub_3 0 0 0.0 255.0 ECU_ADDRESS 0x007FCF34 /begin FUNCTION_LIST PMDIAG /end FUNCTION_LIST BIT_MASK 0x8 /end MEASUREMENT
/begin MEASUREMENT St_pmdiag0.B_ccbttknt "Ruhestromverletzung derzeit vorhanden." UBYTE Def_bit_ub_4 0 0 0.0 255.0 ECU_ADDRESS 0x007FCF34 /begin FUNCTION_LIST PMDIAG /end FUNCTION_LIST BIT_MASK 0x10 /end MEASUREMENT
/begin MEASUREMENT St_pmdiag0.B_pcoschg "IBS Histrogramm darf gelöscht werden." UBYTE Def_bit_ub_5 0 0 0.0 255.0 ECU_ADDRESS 0x007FCF34 /begin FUNCTION_LIST PMDIAG /end FUNCTION_LIST BIT_MASK 0x20 /end MEASUREMENT
/begin MEASUREMENT St_pmdiag0.B_ccbtnach "IHKA Standverbraucher aktiv" UBYTE Def_bit_ub_6 0 0 0.0 255.0 ECU_ADDRESS 0x007FCF34 /begin FUNCTION_LIST PMDIAG /end FUNCTION_LIST BIT_MASK 0x40 /end MEASUREMENT
/begin MEASUREMENT St_pmdiag0.B_tiefrset "CC Meldung : Batterie verschlissen" UBYTE Def_bit_ub_7 0 0 0.0 255.0 ECU_ADDRESS 0x007FCF34 /begin FUNCTION_LIST PMDIAG /end FUNCTION_LIST BIT_MASK 0x80 /end MEASUREMENT
/begin MEASUREMENT St_pmdiag0 "Statuswort" UBYTE Def_st_ub_q1 0 0 0.0 255.0000 ECU_ADDRESS 0x007FCF34 /begin FUNCTION_LIST PMDIAG /end FUNCTION_LIST /end MEASUREMENT
/begin MEASUREMENT St_pmdiag1.B_ccruhver "CC Meldung : Powermgm ausser Betrieb" UBYTE Def_bit_ub_0 0 0 0.0 255.0 ECU_ADDRESS 0x007FCF35 /begin FUNCTION_LIST PMDIAG /end FUNCTION_LIST BIT_MASK 0x1 /end MEASUREMENT
/begin MEASUREMENT St_pmdiag1.B_histrset "CC Meldung : Batteriekontakt pruefen" UBYTE Def_bit_ub_1 0 0 0.0 255.0 ECU_ADDRESS 0x007FCF35 /begin FUNCTION_LIST PMDIAG /end FUNCTION_LIST BIT_MASK 0x2 /end MEASUREMENT
/begin MEASUREMENT St_pmdiag1.B_timer_rst "Bed. SVstatus darf geändert werden." UBYTE Def_bit_ub_2 0 0 0.0 255.0 ECU_ADDRESS 0x007FCF35 /begin FUNCTION_LIST PMDIAG /end FUNCTION_LIST BIT_MASK 0x4 /end MEASUREMENT
/begin MEASUREMENT St_pmdiag1.B_sv_ihka "Dient zum Aufziehen des internen Delay Timers" UBYTE Def_bit_ub_3 0 0 0.0 255.0 ECU_ADDRESS 0x007FCF35 /begin FUNCTION_LIST PMDIAG /end FUNCTION_LIST BIT_MASK 0x8 /end MEASUREMENT
/begin MEASUREMENT St_pmdiag1.B_ruhverl7 "Tiefentladungsbit, B_tiefset, im IBS löschen." UBYTE Def_bit_ub_4 0 0 0.0 255.0 ECU_ADDRESS 0x007FCF35 /begin FUNCTION_LIST PMDIAG /end FUNCTION_LIST BIT_MASK 0x10 /end MEASUREMENT
/begin MEASUREMENT St_pmdiag1.B_qelad1step "CC Meldung : erhoehter Ruhestrom" UBYTE Def_bit_ub_5 0 0 0.0 255.0 ECU_ADDRESS 0x007FCF35 /begin FUNCTION_LIST PMDIAG /end FUNCTION_LIST BIT_MASK 0x20 /end MEASUREMENT
/begin MEASUREMENT St_pmdiag1 "Statuswort" UBYTE Def_st_ub_q1 0 0 0.0 255.0000 ECU_ADDRESS 0x007FCF35 /begin FUNCTION_LIST PMDIAG /end FUNCTION_LIST /end MEASUREMENT
/begin MEASUREMENT St_pmdiagnv.B_ruhverl "ruhestromverletzung vorhanden" UBYTE Def_bit_ub_0 0 0 0.0 255.0 ECU_ADDRESS 0x008011A0 /begin FUNCTION_LIST PMDIAG /end FUNCTION_LIST BIT_MASK 0x1 /end MEASUREMENT
/begin MEASUREMENT St_pmdiagnv "Statuswort" UBYTE Def_st_ub_q1 0 0 0.0 255.0000 ECU_ADDRESS 0x008011A0 /begin FUNCTION_LIST PMDIAG /end FUNCTION_LIST /end MEASUREMENT
/begin MEASUREMENT Dqelad7 "diff = qelad-qeladold7" UWORD Def_ql_uw_q0p29127 0 0 0.0 19088.4522 ECU_ADDRESS 0x00801170 /begin FUNCTION_LIST PMDIAG /end FUNCTION_LIST /end MEASUREMENT
/begin MEASUREMENT Dqlad7 "diff = qlad-qladold7" UWORD Def_ql_uw_q0p29127 0 0 0.0 19088.4522 ECU_ADDRESS 0x00801172 /begin FUNCTION_LIST PMDIAG /end FUNCTION_LIST /end MEASUREMENT
/begin MEASUREMENT Qladzwsp7 "qlad uebertragspeicher" UWORD Def_dez_uw_q1 0 0 0.0 65535.0000 ECU_ADDRESS 0x00801174 /begin FUNCTION_LIST PMDIAG /end FUNCTION_LIST /end MEASUREMENT
/begin MEASUREMENT Stat_sv_reg "Status Standverbraucher registriert" UWORD Def_dez_uw_q1 0 0 0.0 65535.0000 ECU_ADDRESS 0x00801176 /begin FUNCTION_LIST PMDIAG /end FUNCTION_LIST /end MEASUREMENT
/begin MEASUREMENT T2pmcntr "T2PMINFO countdowncounter" UWORD Def_td_uw_q0p1 0 0 0.0 6553.5000 ECU_ADDRESS 0x00801178 /begin FUNCTION_LIST PMDIAG /end FUNCTION_LIST /end MEASUREMENT
/begin MEASUREMENT T3pmcntr "T3PMINFO countdowncounter" UWORD Def_td_uw_q0p1 0 0 0.0 6553.5000 ECU_ADDRESS 0x0080117A /begin FUNCTION_LIST PMDIAG /end FUNCTION_LIST /end MEASUREMENT
/begin MEASUREMENT T_histsum "Txhistiruh Summe" UWORD Def_td_uw_q56 0 0 0.0 3669960.0000 ECU_ADDRESS 0x0080117C /begin FUNCTION_LIST PMDIAG /end FUNCTION_LIST /end MEASUREMENT
/begin MEASUREMENT T_histsummin "Summe der Txhistiruh in Minuten" UWORD Def_td_uw_q0p933 0 0 0.0 61166.0000 ECU_ADDRESS 0x0080117E /begin FUNCTION_LIST PMDIAG /end FUNCTION_LIST /end MEASUREMENT
/begin MEASUREMENT T2hist "T2histitruh in sek." UWORD Def_td_uw_q14 0 0 0.0 917490.0000 ECU_ADDRESS 0x00801180 /begin FUNCTION_LIST PMDIAG /end FUNCTION_LIST /end MEASUREMENT
/begin MEASUREMENT T3hist "T3histiruh in Sek" UWORD Def_td_uw_q14 0 0 0.0 917490.0000 ECU_ADDRESS 0x00801182 /begin FUNCTION_LIST PMDIAG /end FUNCTION_LIST /end MEASUREMENT
/begin MEASUREMENT T4hist "T4histiruh in Sek" UWORD Def_td_uw_q14 0 0 0.0 917490.0000 ECU_ADDRESS 0x00801184 /begin FUNCTION_LIST PMDIAG /end FUNCTION_LIST /end MEASUREMENT
/begin MEASUREMENT Batt_index "Batterie Index" UBYTE Def_dez_ub_q1 0 0 0.0 255.0000 ECU_ADDRESS 0x00801186 /begin FUNCTION_LIST PMDIAG /end FUNCTION_LIST /end MEASUREMENT
/begin MEASUREMENT C_battnenn "Batteriekapazitaet" UBYTE Def_ql_ub_q1 0 0 0.0 255.0000 ECU_ADDRESS 0x00801187 /begin FUNCTION_LIST PMDIAG /end FUNCTION_LIST /end MEASUREMENT
/begin MEASUREMENT Codiercnt "Internet Zaehler fuer Anfrage Codierung" UBYTE Def_td_ub_q0p1 0 0 0.0 25.5000 ECU_ADDRESS 0x00801188 /begin FUNCTION_LIST PMDIAG /end FUNCTION_LIST /end MEASUREMENT
/begin MEASUREMENT Ibsbor_hb "highbyte ibsborctr" UBYTE Def_dez_ub_q1 0 0 0.0 255.0000 ECU_ADDRESS 0x00801189 /begin FUNCTION_LIST PMDIAG /end FUNCTION_LIST /end MEASUREMENT
/begin MEASUREMENT Ikurz_ogrz "Obere Grenze Kurzschlußstrom" UBYTE Def_i_ub_q10 0 0 0.0 2550.0000 ECU_ADDRESS 0x0080118A /begin FUNCTION_LIST PMDIAG /end FUNCTION_LIST /end MEASUREMENT
/begin MEASUREMENT Ikurz_ugrz "Untere Grenze Kurzschlußstrom" UBYTE Def_i_ub_q10 0 0 0.0 2550.0000 ECU_ADDRESS 0x0080118B /begin FUNCTION_LIST PMDIAG /end FUNCTION_LIST /end MEASUREMENT
/begin MEASUREMENT Iwakeupgrz "Ruhestromverletzungsgrenze, ab hier weckt u.U. das IBS." UBYTE Def_i_ub_q0p00125 0 0 0.0 0.2550 ECU_ADDRESS 0x0080118C /begin FUNCTION_LIST PMDIAG /end FUNCTION_LIST /end MEASUREMENT
/begin MEASUREMENT Ospgcnt "fs_Oberspannungscounter" UBYTE Def_td_ub_q0p1 0 0 0.0 25.5000 ECU_ADDRESS 0x0080118D /begin FUNCTION_LIST PMDIAG /end FUNCTION_LIST /end MEASUREMENT
/begin MEASUREMENT Ospgprell "Anzahl der entprellten FS_Oberspannungserkennung" UBYTE Def_dez_ub_q1 0 0 0.0 255.0000 ECU_ADDRESS 0x0080118E /begin FUNCTION_LIST PMDIAG /end FUNCTION_LIST /end MEASUREMENT
/begin MEASUREMENT Ospgstat "Status Oberspannungserkennung" UBYTE Def_dez_ub_q1 0 0 0.0 255.0000 ECU_ADDRESS 0x0080118F /begin FUNCTION_LIST PMDIAG /end FUNCTION_LIST /end MEASUREMENT
/begin MEASUREMENT Pm_klemmstat "Umweltbed. Klemmenstatus" UBYTE Def_dez_ub_q1 0 0 0.0 255.0000 ECU_ADDRESS 0x00801190 /begin FUNCTION_LIST PMDIAG /end FUNCTION_LIST /end MEASUREMENT
/begin MEASUREMENT Stat_sv_reg1 "LoByte Stat_sv_reg für Umweltbedingungen" UBYTE Def_dez_ub_q1 0 0 0.0 255.0000 ECU_ADDRESS 0x00801191 /begin FUNCTION_LIST PMDIAG /end FUNCTION_LIST /end MEASUREMENT
/begin MEASUREMENT Stat_sv_reg2 "HiByte Stat_sv_reg für Umweltbedinung" UBYTE Def_dez_ub_q1 0 0 0.0 255.0000 ECU_ADDRESS 0x00801192 /begin FUNCTION_LIST PMDIAG /end FUNCTION_LIST /end MEASUREMENT
/begin MEASUREMENT Svaus "Status Standverbraucher sind aus " UBYTE Identity 0 0 0.0 1.0000 ECU_ADDRESS 0x00801193 /begin FUNCTION_LIST PMDIAG /end FUNCTION_LIST /end MEASUREMENT
/begin MEASUREMENT T1histshort "T1 Histogramm in 14.9333 MIn. Quantisiert" UBYTE Def_td_ub_q14p9333 0 0 0.0 3808.0000 ECU_ADDRESS 0x00801194 /begin FUNCTION_LIST PMDIAG /end FUNCTION_LIST /end MEASUREMENT
/begin MEASUREMENT T1pmcntr "T1PMINFO countdowncounter" UBYTE Def_td_ub_q0p1 0 0 0.0 25.5000 ECU_ADDRESS 0x00801195 /begin FUNCTION_LIST PMDIAG /end FUNCTION_LIST /end MEASUREMENT
/begin MEASUREMENT T2histshort "T2 Histogramm als Umweltbed. bei Ruhestromverletzung" UBYTE Def_td_ub_q14p9333 0 0 0.0 3808.0000 ECU_ADDRESS 0x00801196 /begin FUNCTION_LIST PMDIAG /end FUNCTION_LIST /end MEASUREMENT
/begin MEASUREMENT T3histshort "T3 Histogramm als Umweltbed. bei Ruhestromverletzung" UBYTE Def_td_ub_q14p9333 0 0 0.0 3808.0000 ECU_ADDRESS 0x00801197 /begin FUNCTION_LIST PMDIAG /end FUNCTION_LIST /end MEASUREMENT
/begin MEASUREMENT T4histshort "T4 Histogramm als Umweltbed. bei Ruhestromverletzung" UBYTE Def_td_ub_q14p9333 0 0 0.0 3808.0000 ECU_ADDRESS 0x00801198 /begin FUNCTION_LIST PMDIAG /end FUNCTION_LIST /end MEASUREMENT
/begin MEASUREMENT T_saismem "T Saison zw. speicher" UBYTE Def_dez_ub_q1 0 0 0.0 255.0000 ECU_ADDRESS 0x00801199 /begin FUNCTION_LIST PMDIAG /end FUNCTION_LIST /end MEASUREMENT
/begin MEASUREMENT Uspgcnt "FS_Unterspannungscounter" UBYTE Def_td_ub_q0p1 0 0 0.0 25.5000 ECU_ADDRESS 0x0080119A /begin FUNCTION_LIST PMDIAG /end FUNCTION_LIST /end MEASUREMENT
/begin MEASUREMENT Uspgprell "Anzahl der entprellten FS_Unterspannungserkennung." UBYTE Def_dez_ub_q1 0 0 0.0 255.0000 ECU_ADDRESS 0x0080119B /begin FUNCTION_LIST PMDIAG /end FUNCTION_LIST /end MEASUREMENT
/begin MEASUREMENT Uspgstat "FS_Unterspannungsstatus" UBYTE Def_dez_ub_q1 0 0 0.0 255.0000 ECU_ADDRESS 0x0080119C /begin FUNCTION_LIST PMDIAG /end FUNCTION_LIST /end MEASUREMENT
/begin MEASUREMENT Ztagedelta "verstrichene Tage" UBYTE Def_dez_ub_q1 0 0 0.0 10.0000 ECU_ADDRESS 0x0080119D /begin FUNCTION_LIST PMDIAG /end FUNCTION_LIST /end MEASUREMENT
/begin MEASUREMENT Ztagestate "Tageswechsel Statemachine Ctr" UBYTE Def_dez_ub_q1 0 0 0.0 255.0000 ECU_ADDRESS 0x0080119E /begin FUNCTION_LIST PMDIAG /end FUNCTION_LIST /end MEASUREMENT
/begin MEASUREMENT Pminfo1 "Infospeicher 1 vom Powermanagement" UWORD Def_dez_uw_q1 0 0 0.0 65535.0000 ECU_ADDRESS 0x008011A2 ARRAY_SIZE 37 /begin FUNCTION_LIST PMDIAG /end FUNCTION_LIST /end MEASUREMENT
/begin MEASUREMENT Qeladold7 "zuletzt gesp. qelad" UWORD Def_ql_uw_q0p0182 0 0 0.0 1193.0282 ECU_ADDRESS 0x008011EC /begin FUNCTION_LIST PMDIAG /end FUNCTION_LIST /end MEASUREMENT
/begin MEASUREMENT Qladold7 "zuletzt gesp. qlad" UWORD Def_ql_uw_q0p0182 0 0 0.0 1193.0282 ECU_ADDRESS 0x008011EE /begin FUNCTION_LIST PMDIAG /end FUNCTION_LIST /end MEASUREMENT
/begin MEASUREMENT Ztageold "letzter Wert von ztageabs_w" UWORD Def_dez_uw_q1 0 0 0.0 65535.0000 ECU_ADDRESS 0x008011F0 /begin FUNCTION_LIST PMDIAG /end FUNCTION_LIST /end MEASUREMENT
/begin MEASUREMENT Fs_pm "Fehlerspeicher Powermanagement, Bitcodiert" UBYTE Def_dez_ub_q1 0 0 0.0 255.0000 ECU_ADDRESS 0x008011F2 /begin FUNCTION_LIST PMDIAG /end FUNCTION_LIST /end MEASUREMENT
/begin MEASUREMENT Pminfo2 "Fehlerinfo2 vom Powermanagement" UBYTE Def_dez_ub_q1 0 0 0.0 255.0000 ECU_ADDRESS 0x008011F4 ARRAY_SIZE 29 /begin FUNCTION_LIST PMDIAG /end FUNCTION_LIST /end MEASUREMENT
/begin MEASUREMENT St_pmprsvcalc.B_ubtlow "Bedingung Batterie in Unterspannungszustand" UBYTE Def_bit_ub_0 0 0 0.0 255.0 ECU_ADDRESS 0x007FCF3A /begin FUNCTION_LIST PMPRSVCALC /end FUNCTION_LIST BIT_MASK 0x1 /end MEASUREMENT
/begin MEASUREMENT St_pmprsvcalc.B_uloreset "Bedingung Batterie nicht mehr in Unterspannungszustand" UBYTE Def_bit_ub_1 0 0 0.0 255.0 ECU_ADDRESS 0x007FCF3A /begin FUNCTION_LIST PMPRSVCALC /end FUNCTION_LIST BIT_MASK 0x2 /end MEASUREMENT
/begin MEASUREMENT St_pmprsvcalc.B_ipmtimer "IPM Timer für Prios aktiv" UBYTE Def_bit_ub_2 0 0 0.0 255.0 ECU_ADDRESS 0x007FCF3A /begin FUNCTION_LIST PMPRSVCALC /end FUNCTION_LIST BIT_MASK 0x4 /end MEASUREMENT
/begin MEASUREMENT St_pmprsvcalc.B_ipmaktiv "IPM Massnahmen bzgl. Prios aktiviert" UBYTE Def_bit_ub_3 0 0 0.0 255.0 ECU_ADDRESS 0x007FCF3A /begin FUNCTION_LIST PMPRSVCALC /end FUNCTION_LIST BIT_MASK 0x8 /end MEASUREMENT
/begin MEASUREMENT St_pmprsvcalc.B_kwdr_old "Dient zur Erkennung einer steigender Flanke B_kl15" UBYTE Def_bit_ub_4 0 0 0.0 255.0 ECU_ADDRESS 0x007FCF3A /begin FUNCTION_LIST PMPRSVCALC /end FUNCTION_LIST BIT_MASK 0x10 /end MEASUREMENT
/begin MEASUREMENT St_pmprsvcalc.B_gendef "Bedingung Generator defekt während Motorbetrieb" UBYTE Def_bit_ub_5 0 0 0.0 255.0 ECU_ADDRESS 0x007FCF3A /begin FUNCTION_LIST PMPRSVCALC /end FUNCTION_LIST BIT_MASK 0x20 /end MEASUREMENT
/begin MEASUREMENT St_pmprsvcalc.B_nkwptcio "NKW status für PTC i.o." UBYTE Def_bit_ub_6 0 0 0.0 255.0 ECU_ADDRESS 0x007FCF3A /begin FUNCTION_LIST PMPRSVCALC /end FUNCTION_LIST BIT_MASK 0x40 /end MEASUREMENT
/begin MEASUREMENT St_pmprsvcalc.B_ptckoor "PTC Koordinator Maßnahmen Aktiv" UBYTE Def_bit_ub_7 0 0 0.0 255.0 ECU_ADDRESS 0x007FCF3A /begin FUNCTION_LIST PMPRSVCALC /end FUNCTION_LIST BIT_MASK 0x80 /end MEASUREMENT
/begin MEASUREMENT St_pmprsvcalc "Statuswort" UBYTE Def_st_ub_q1 0 0 0.0 255.0000 ECU_ADDRESS 0x007FCF3A /begin FUNCTION_LIST PMPRSVCALC /end FUNCTION_LIST /end MEASUREMENT
/begin MEASUREMENT St_pmprsvcalc1.B_enwakeup "Bit, ob IBS Bus wecken darf oder nicht." UBYTE Def_bit_ub_0 0 0 0.0 255.0 ECU_ADDRESS 0x007FCF3C /begin FUNCTION_LIST PMPRSVCALC /end FUNCTION_LIST BIT_MASK 0x1 /end MEASUREMENT
/begin MEASUREMENT St_pmprsvcalc1.B_dubt "Bedg., ob dubt > 100mV" UBYTE Def_bit_ub_1 0 0 0.0 255.0 ECU_ADDRESS 0x007FCF3C /begin FUNCTION_LIST PMPRSVCALC /end FUNCTION_LIST BIT_MASK 0x2 /end MEASUREMENT
/begin MEASUREMENT St_pmprsvcalc1.B_pmvsdanf "Bedg., ob 3b3 versendet wird" UBYTE Def_bit_ub_2 0 0 0.0 255.0 ECU_ADDRESS 0x007FCF3C /begin FUNCTION_LIST PMPRSVCALC /end FUNCTION_LIST BIT_MASK 0x4 /end MEASUREMENT
/begin MEASUREMENT St_pmprsvcalc1.B_pmbsdanf "Bedg. ob 3b4 versendet wird" UBYTE Def_bit_ub_4 0 0 0.0 255.0 ECU_ADDRESS 0x007FCF3C /begin FUNCTION_LIST PMPRSVCALC /end FUNCTION_LIST BIT_MASK 0x10 /end MEASUREMENT
/begin MEASUREMENT St_pmprsvcalc1.B_limcalc "Bedg. begrenzte Berechnung" UBYTE Def_bit_ub_5 0 0 0.0 255.0 ECU_ADDRESS 0x007FCF3C /begin FUNCTION_LIST PMPRSVCALC /end FUNCTION_LIST BIT_MASK 0x20 /end MEASUREMENT
/begin MEASUREMENT St_pmprsvcalc1.B_notprsv "Bed.Notlauf aufg.Batt-Unterspg, Generatorstat und B_kl15 in PMPRSVCALC" UBYTE Def_bit_ub_6 0 0 0.0 255.0 ECU_ADDRESS 0x007FCF3C /begin FUNCTION_LIST PMPRSVCALC /end FUNCTION_LIST BIT_MASK 0x40 /end MEASUREMENT
/begin MEASUREMENT St_pmprsvcalc1.B_pireset "Bedingung für PI-Reset" UBYTE Def_bit_ub_7 0 0 0.0 255.0 ECU_ADDRESS 0x007FCF3C /begin FUNCTION_LIST PMPRSVCALC /end FUNCTION_LIST BIT_MASK 0x80 /end MEASUREMENT
/begin MEASUREMENT St_pmprsvcalc1 "Statuswort" UBYTE Def_st_ub_q1 0 0 0.0 255.0000 ECU_ADDRESS 0x007FCF3C /begin FUNCTION_LIST PMPRSVCALC /end FUNCTION_LIST /end MEASUREMENT
/begin MEASUREMENT St_pmprsvcalc2.B_kwdrise "Motorstart Rising" UBYTE Def_bit_ub_0 0 0 0.0 255.0 ECU_ADDRESS 0x007FCF3B /begin FUNCTION_LIST PMPRSVCALC /end FUNCTION_LIST BIT_MASK 0x1 /end MEASUREMENT
/begin MEASUREMENT St_pmprsvcalc2.B_pmsulevon "PM Sulev Maßnahmen aktiv" UBYTE Def_bit_ub_1 0 0 0.0 255.0 ECU_ADDRESS 0x007FCF3B /begin FUNCTION_LIST PMPRSVCALC /end FUNCTION_LIST BIT_MASK 0x2 /end MEASUREMENT
/begin MEASUREMENT St_pmprsvcalc2.B_genkommerr "Nur Gen. Komm. Fehler vorhanden" UBYTE Def_bit_ub_2 0 0 0.0 255.0 ECU_ADDRESS 0x007FCF3B /begin FUNCTION_LIST PMPRSVCALC /end FUNCTION_LIST BIT_MASK 0x4 /end MEASUREMENT
/begin MEASUREMENT St_pmprsvcalc2 "Statuswort" UBYTE Def_st_ub_q1 0 0 0.0 255.0000 ECU_ADDRESS 0x007FCF3B /begin FUNCTION_LIST PMPRSVCALC /end FUNCTION_LIST /end MEASUREMENT
/begin MEASUREMENT St_pmprsv_nv.B_enwake7 "lokales B_enwake" UBYTE Def_bit_ub_0 0 0 0.0 255.0 ECU_ADDRESS 0x0080129E /begin FUNCTION_LIST PMPRSVCALC /end FUNCTION_LIST BIT_MASK 0x1 /end MEASUREMENT
/begin MEASUREMENT St_pmprsv_nv "Statuswort" UBYTE Def_st_ub_q1 0 0 0.0 255.0000 ECU_ADDRESS 0x0080129E /begin FUNCTION_LIST PMPRSVCALC /end FUNCTION_LIST /end MEASUREMENT
/begin MEASUREMENT Priopizw1 "Pi-Regler zw1" SLONG Def_f_sl_q0p007 0 0 -512.0000 512.0000 ECU_ADDRESS 0x00801214 /begin FUNCTION_LIST PMPRSVCALC /end FUNCTION_LIST /end MEASUREMENT
/begin MEASUREMENT Priopizw2 "Pi-Regler zw2" SLONG Def_f_sl_q0p007 0 0 -512.0000 512.0000 ECU_ADDRESS 0x00801218 /begin FUNCTION_LIST PMPRSVCALC /end FUNCTION_LIST /end MEASUREMENT
/begin MEASUREMENT Ptcpizw1 "PTC PI Regler zw1" SLONG Def_f_sl_q0p007 0 0 -512.0000 512.0000 ECU_ADDRESS 0x0080121C /begin FUNCTION_LIST PMPRSVCALC /end FUNCTION_LIST /end MEASUREMENT
/begin MEASUREMENT Ptcpizw2 "PTC PI zw2" SLONG Def_f_sl_q0p007 0 0 -512.0000 512.0000 ECU_ADDRESS 0x00801220 /begin FUNCTION_LIST PMPRSVCALC /end FUNCTION_LIST /end MEASUREMENT
/begin MEASUREMENT All2ptc "Gesamtgewichtung für PTC-Ansteuerung" SWORD Def_f_sw_p0q25 0 0 -500.0000 550.0000 ECU_ADDRESS 0x00801224 /begin FUNCTION_LIST PMPRSVCALC /end FUNCTION_LIST /end MEASUREMENT
/begin MEASUREMENT Df2pi "DF-Gewichtung auf Prios" SWORD Def_f_sw_p0q25 0 0 -100.0000 100.0000 ECU_ADDRESS 0x00801226 /begin FUNCTION_LIST PMPRSVCALC /end FUNCTION_LIST /end MEASUREMENT
/begin MEASUREMENT Dfall2pi "Gesamtgewichtung auf Prios" SWORD Def_f_sw_p0q25 0 0 -500.0000 500.0000 ECU_ADDRESS 0x00801228 /begin FUNCTION_LIST PMPRSVCALC /end FUNCTION_LIST /end MEASUREMENT
/begin MEASUREMENT Dfpi2ptc "Gewichtung der Prios -> Gewichtung für PTC Ansteuerung" SWORD Def_f_sw_p0q25 0 0 -100.0000 100.0000 ECU_ADDRESS 0x0080122A /begin FUNCTION_LIST PMPRSVCALC /end FUNCTION_LIST /end MEASUREMENT
/begin MEASUREMENT Dfpt1_2ptc "gefiltertes dffgen Gewichtung auf PTC-Ansteuerung" SWORD Def_f_sw_p0q25 0 0 -100.0000 100.0000 ECU_ADDRESS 0x0080122C /begin FUNCTION_LIST PMPRSVCALC /end FUNCTION_LIST /end MEASUREMENT
/begin MEASUREMENT Dsoc2pi "Batterieladezustand-Gewichtung auf Prios" SWORD Def_f_sw_p0q25 0 0 -150.0000 150.0000 ECU_ADDRESS 0x0080122E /begin FUNCTION_LIST PMPRSVCALC /end FUNCTION_LIST /end MEASUREMENT
/begin MEASUREMENT Dsoc2ptc "dsoc Gewichtung auf PTC-Ansteuerung" SWORD Def_f_sw_p0q25 0 0 -150.0000 150.0000 ECU_ADDRESS 0x00801230 /begin FUNCTION_LIST PMPRSVCALC /end FUNCTION_LIST /end MEASUREMENT
/begin MEASUREMENT Dudtmul "PTC dudt : gewichtetes Dudt" SWORD Def_f_sw_q0p000147 0 0 -48.2304 48.2289 ECU_ADDRESS 0x00801232 /begin FUNCTION_LIST PMPRSVCALC /end FUNCTION_LIST /end MEASUREMENT
/begin MEASUREMENT Ibtdiff2pi "Batterie-soll-strom Gewichtung auf Prios" SWORD Def_f_sw_p0q25 0 0 -100.0000 100.0000 ECU_ADDRESS 0x00801234 /begin FUNCTION_LIST PMPRSVCALC /end FUNCTION_LIST /end MEASUREMENT
/begin MEASUREMENT Idiff2ptc "idiff Gewichtung auf die PTC-Ansteuerung" SWORD Def_f_sw_p0q25 0 0 -100.0000 100.0000 ECU_ADDRESS 0x00801236 /begin FUNCTION_LIST PMPRSVCALC /end FUNCTION_LIST /end MEASUREMENT
/begin MEASUREMENT Pgen2ptc "Gewichtung der Generatorrestleistung für PTC-Ansteuerung" SWORD Def_f_sw_p0q25 0 0 -100.0000 100.0000 ECU_ADDRESS 0x00801238 /begin FUNCTION_LIST PMPRSVCALC /end FUNCTION_LIST /end MEASUREMENT
/begin MEASUREMENT Ubdiff "ubattsoll - ubatt_w" SWORD Def_f_sw_b32 0 0 -32.0000 31.9990 ECU_ADDRESS 0x0080123A /begin FUNCTION_LIST PMPRSVCALC /end FUNCTION_LIST /end MEASUREMENT
/begin MEASUREMENT Ubdiff2pi "Ubatt-Differenz-Gewichtung auf Prios" SWORD Def_f_sw_p0q25 0 0 -100.0000 100.0000 ECU_ADDRESS 0x0080123C /begin FUNCTION_LIST PMPRSVCALC /end FUNCTION_LIST /end MEASUREMENT
/begin MEASUREMENT Ubt7mem "resultierendes ubt" SWORD Def_u_sw_b128 0 0 -128.0000 127.9960 ECU_ADDRESS 0x0080123E /begin FUNCTION_LIST PMPRSVCALC /end FUNCTION_LIST /end MEASUREMENT
/begin MEASUREMENT Ubtpt12ptc "Ubatt Gewichtung für PTC Ansteuerung" SWORD Def_f_sw_p0q25 0 0 -100.0000 100.0000 ECU_ADDRESS 0x00801240 /begin FUNCTION_LIST PMPRSVCALC /end FUNCTION_LIST /end MEASUREMENT
/begin MEASUREMENT Udeltac "inkrementierte Differenz zwischen altem und neuem ubt" SWORD Def_u_sw_b128 0 0 -128.0000 127.9960 ECU_ADDRESS 0x00801242 /begin FUNCTION_LIST PMPRSVCALC /end FUNCTION_LIST /end MEASUREMENT
/begin MEASUREMENT Ubdiffilt "Wert nach Ubdiff-Tiefpass Prio" SWORD Def_f_sw_b32 0 0 -32.0000 31.9990 ECU_ADDRESS 0x00801274 /begin FUNCTION_LIST PMPRSVCALC /end FUNCTION_LIST /end MEASUREMENT
/begin MEASUREMENT Ubdiffptc "Delta Usoll-Ubatt PTC" SWORD Def_f_sw_b32 0 0 -32.0000 31.9990 ECU_ADDRESS 0x00801276 /begin FUNCTION_LIST PMPRSVCALC /end FUNCTION_LIST /end MEASUREMENT
/begin MEASUREMENT Ubtpt1ptc "Ubdiffptc gefiltert" SWORD Def_f_sw_b32 0 0 -32.0000 31.9990 ECU_ADDRESS 0x00801278 /begin FUNCTION_LIST PMPRSVCALC /end FUNCTION_LIST /end MEASUREMENT
/begin MEASUREMENT Allptcfilt "pi-geregelte Gewichtung für PTC-Ansteuerung" UWORD Def_f_uw_q0p25 0 0 0.0 550.0000 ECU_ADDRESS 0x00801244 /begin FUNCTION_LIST PMPRSVCALC /end FUNCTION_LIST /end MEASUREMENT
/begin MEASUREMENT Ctrpwrcf "Komfort-Teil von ctrpwrcos" UWORD Def_dez_uw_q1 0 0 0.0 65535.0000 ECU_ADDRESS 0x00801246 /begin FUNCTION_LIST PMPRSVCALC /end FUNCTION_LIST /end MEASUREMENT
/begin MEASUREMENT Ctrpwrcos "Steuerung_Leistung_Verbraucher" UWORD Def_dez_uw_q1 0 0 0.0 65535.0000 ECU_ADDRESS 0x00801248 /begin FUNCTION_LIST PMPRSVCALC /end FUNCTION_LIST /end MEASUREMENT
/begin MEASUREMENT Ctrpwrcos7 "lokales ctrpwrcos" UWORD Def_dez_uw_q1 0 0 0.0 65535.0000 ECU_ADDRESS 0x0080124A /begin FUNCTION_LIST PMPRSVCALC /end FUNCTION_LIST /end MEASUREMENT
/begin MEASUREMENT Ctrpwrdf "df-Teil von ctrpwrcos" UWORD Def_dez_uw_q1 0 0 0.0 65535.0000 ECU_ADDRESS 0x0080124C /begin FUNCTION_LIST PMPRSVCALC /end FUNCTION_LIST /end MEASUREMENT
/begin MEASUREMENT Ctrpwrmem "altes ctrpwrcos" UWORD Def_dez_uw_q1 0 0 0.0 65535.0000 ECU_ADDRESS 0x0080124E /begin FUNCTION_LIST PMPRSVCALC /end FUNCTION_LIST /end MEASUREMENT
/begin MEASUREMENT Dfallpi "PI-Geregelte Gesamtgewichtung auf Prios" UWORD Def_f_uw_q0p25 0 0 0.0 450.0000 ECU_ADDRESS 0x00801250 /begin FUNCTION_LIST PMPRSVCALC /end FUNCTION_LIST /end MEASUREMENT
/begin MEASUREMENT Dfprio "" UWORD Def_f_uw_q0p25 0 0 0.0 450.0000 ECU_ADDRESS 0x00801252 /begin FUNCTION_LIST PMPRSVCALC /end FUNCTION_LIST /end MEASUREMENT
/begin MEASUREMENT F_dudtptc "Inkrement auf Ptc_pwr aufgrund du/dt" UWORD Def_f_uw_q0p25 0 0 0.0 550.0000 ECU_ADDRESS 0x00801254 /begin FUNCTION_LIST PMPRSVCALC /end FUNCTION_LIST /end MEASUREMENT
/begin MEASUREMENT Ibtdiff "Delta Ibtsoll-Ibatt" UWORD Def_i_uw_q0p08_o200 0 0 -200.0000 5042.8000 ECU_ADDRESS 0x00801256 /begin FUNCTION_LIST PMPRSVCALC /end FUNCTION_LIST /end MEASUREMENT
/begin MEASUREMENT Ibtsoll "Sollstrom aufgrund von tbatt und dsoc" UWORD Def_i_uw_q0p08_o200 0 0 -200.0000 5042.8000 ECU_ADDRESS 0x00801258 /begin FUNCTION_LIST PMPRSVCALC /end FUNCTION_LIST /end MEASUREMENT
/begin MEASUREMENT Ipmdfprio "lokale Prioberechnungsvariable bei IPM aktiv" UWORD Def_f_uw_q0p25 0 0 0.0 450.0000 ECU_ADDRESS 0x0080125A /begin FUNCTION_LIST PMPRSVCALC /end FUNCTION_LIST /end MEASUREMENT
/begin MEASUREMENT Isolldiff "Differenz isoll - ibatt_w für PTC Ansteuerung" UWORD Def_i_uw_q0p08_o200 0 0 -200.0000 5042.8000 ECU_ADDRESS 0x0080125C /begin FUNCTION_LIST PMPRSVCALC /end FUNCTION_LIST /end MEASUREMENT
/begin MEASUREMENT Memprio1 "memory 1 PI-Regler dfall2pi E60Prio" UWORD Def_f_uw_b512 0 0 0.0 511.9921 ECU_ADDRESS 0x0080125E /begin FUNCTION_LIST PMPRSVCALC /end FUNCTION_LIST /end MEASUREMENT
/begin MEASUREMENT Memprio2 "memory 2 PI-Regler dfall2pi E60Prio" UWORD Def_f_uw_b512 0 0 0.0 511.9921 ECU_ADDRESS 0x00801260 /begin FUNCTION_LIST PMPRSVCALC /end FUNCTION_LIST /end MEASUREMENT
/begin MEASUREMENT Memptc1 "memory 1 PI-Regler all2ptc PTC" UWORD Def_f_uw_b512 0 0 0.0 511.9921 ECU_ADDRESS 0x00801262 /begin FUNCTION_LIST PMPRSVCALC /end FUNCTION_LIST /end MEASUREMENT
/begin MEASUREMENT Memptc2 "memory 2 PI-Regler all2ptc PTC" UWORD Def_f_uw_b512 0 0 0.0 511.9921 ECU_ADDRESS 0x00801264 /begin FUNCTION_LIST PMPRSVCALC /end FUNCTION_LIST /end MEASUREMENT
/begin MEASUREMENT Pgenrest "Generatorrestleistung (igenrest*ubatt_w)" UWORD Def_f_uw_q0p25 0 0 0.0 6400.0000 ECU_ADDRESS 0x00801266 /begin FUNCTION_LIST PMPRSVCALC /end FUNCTION_LIST /end MEASUREMENT
/begin MEASUREMENT Ptcadd "Wg. Spgeinbruch zu addierender PTC Faktor" UWORD Def_f_uw_q0p25 0 0 0.0 550.0000 ECU_ADDRESS 0x00801268 /begin FUNCTION_LIST PMPRSVCALC /end FUNCTION_LIST /end MEASUREMENT
/begin MEASUREMENT Ubold7 "PTC dudt : alter Ub Wert zur Differenzbildung" UWORD Def_u_uw_q0p0942 0 0 0.0 6173.3970 ECU_ADDRESS 0x0080126A /begin FUNCTION_LIST PMPRSVCALC /end FUNCTION_LIST /end MEASUREMENT
/begin MEASUREMENT Ubt "Batteriespannung" UWORD Def_u_uw_q0p015 0 0 0.0 983.0250 ECU_ADDRESS 0x0080126C /begin FUNCTION_LIST PMPRSVCALC /end FUNCTION_LIST /end MEASUREMENT
/begin MEASUREMENT Ubt7 "Lokale Batteriespannung" UWORD Def_u_uw_q0p015 0 0 0.0 61.4250 ECU_ADDRESS 0x0080126E /begin FUNCTION_LIST PMPRSVCALC /end FUNCTION_LIST /end MEASUREMENT
/begin MEASUREMENT Ubt7old "altes ubt" UWORD Def_u_uw_q0p015 0 0 0.0 61.4250 ECU_ADDRESS 0x00801270 /begin FUNCTION_LIST PMPRSVCALC /end FUNCTION_LIST /end MEASUREMENT
/begin MEASUREMENT Udeltaabsc "absoluter Wert von udelta" UWORD Def_u_uw_q0p015 0 0 0.0 61.4250 ECU_ADDRESS 0x00801272 /begin FUNCTION_LIST PMPRSVCALC /end FUNCTION_LIST /end MEASUREMENT
/begin MEASUREMENT D_udtptc "Spannungsdifferenz in 10ms" SBYTE Def_u_sb_q0p0942 0 0 -12.0576 11.9634 ECU_ADDRESS 0x0080127A /begin FUNCTION_LIST PMPRSVCALC /end FUNCTION_LIST /end MEASUREMENT
/begin MEASUREMENT Ctrcbr "Steuerung_Stromzweige" UBYTE Def_dez_ub_q1 0 0 0.0 255.0000 ECU_ADDRESS 0x0080127B /begin FUNCTION_LIST PMPRSVCALC /end FUNCTION_LIST /end MEASUREMENT
/begin MEASUREMENT Ctrcbr7 "lokales ctrcbr" UBYTE Def_dez_ub_q1 0 0 0.0 255.0000 ECU_ADDRESS 0x0080127C /begin FUNCTION_LIST PMPRSVCALC /end FUNCTION_LIST /end MEASUREMENT
/begin MEASUREMENT Ctrcbrmem "altes ctrbr" UBYTE Def_dez_ub_q1 0 0 0.0 255.0000 ECU_ADDRESS 0x0080127D /begin FUNCTION_LIST PMPRSVCALC /end FUNCTION_LIST /end MEASUREMENT
/begin MEASUREMENT Ctrpcos "Steuerung_Standverbraucher" UBYTE Def_dez_ub_q1 0 0 0.0 3.0000 ECU_ADDRESS 0x0080127E /begin FUNCTION_LIST PMPRSVCALC /end FUNCTION_LIST /end MEASUREMENT
/begin MEASUREMENT Ctrpcosmem "altes ctrpcos" UBYTE Def_dez_ub_q1 0 0 0.0 3.0000 ECU_ADDRESS 0x0080127F /begin FUNCTION_LIST PMPRSVCALC /end FUNCTION_LIST /end MEASUREMENT
/begin MEASUREMENT Ctrprio "Steuerung_Spitzenreduzierung_Priorität" UBYTE Def_dez_ub_q1 0 0 0.0 7.0000 ECU_ADDRESS 0x00801280 /begin FUNCTION_LIST PMPRSVCALC /end FUNCTION_LIST /end MEASUREMENT
/begin MEASUREMENT Ctrprio7 "lokales ctrprio" UBYTE Def_dez_ub_q1 0 0 0.0 7.0000 ECU_ADDRESS 0x00801281 /begin FUNCTION_LIST PMPRSVCALC /end FUNCTION_LIST /end MEASUREMENT
/begin MEASUREMENT Ctrpriocf "Steuerung_Spitzenreduzierung_Priorität_Komfort" UBYTE Def_dez_ub_q1 0 0 0.0 7.0000 ECU_ADDRESS 0x00801282 /begin FUNCTION_LIST PMPRSVCALC /end FUNCTION_LIST /end MEASUREMENT
/begin MEASUREMENT Ctrpriocf7 "lokales ctrpriocf" UBYTE Def_dez_ub_q1 0 0 0.0 7.0000 ECU_ADDRESS 0x00801283 /begin FUNCTION_LIST PMPRSVCALC /end FUNCTION_LIST /end MEASUREMENT
/begin MEASUREMENT Ctrpriocfm "altes ctrpriocf" UBYTE Def_dez_ub_q1 0 0 0.0 7.0000 ECU_ADDRESS 0x00801284 /begin FUNCTION_LIST PMPRSVCALC /end FUNCTION_LIST /end MEASUREMENT
/begin MEASUREMENT Ctrpriomem "altes ctrprio" UBYTE Def_dez_ub_q1 0 0 0.0 7.0000 ECU_ADDRESS 0x00801285 /begin FUNCTION_LIST PMPRSVCALC /end FUNCTION_LIST /end MEASUREMENT
/begin MEASUREMENT Ctrpwspcos "Steuerung_Leistung_Sonderverbraucher" UBYTE Def_f_ub_b127p5 0 0 0.0 127.5000 ECU_ADDRESS 0x00801286 /begin FUNCTION_LIST PMPRSVCALC /end FUNCTION_LIST /end MEASUREMENT
/begin MEASUREMENT Dff_filt7 "lokales dffgenflit" UBYTE Def_f_ub_b100 0 0 0.0 99.6093 ECU_ADDRESS 0x00801287 /begin FUNCTION_LIST PMPRSVCALC /end FUNCTION_LIST /end MEASUREMENT
/begin MEASUREMENT Dfgenfilt "Über PT-1 gefiltertes dffgen-Signal" UBYTE Def_f_ub_b100 0 0 0.0 99.6093 ECU_ADDRESS 0x00801288 /begin FUNCTION_LIST PMPRSVCALC /end FUNCTION_LIST /end MEASUREMENT
/begin MEASUREMENT Picntr "Counter fuer PI-Reset" UBYTE Def_td_ub_q0p1 0 0 0.0 25.5000 ECU_ADDRESS 0x00801289 /begin FUNCTION_LIST PMPRSVCALC /end FUNCTION_LIST /end MEASUREMENT
/begin MEASUREMENT Pmbscount "zyklisches Senden entspricht 5 sek" UBYTE Def_dez_ub_q1 0 0 0.0 255.0000 ECU_ADDRESS 0x0080128A /begin FUNCTION_LIST PMPRSVCALC /end FUNCTION_LIST /end MEASUREMENT
/begin MEASUREMENT Pmvscount "Zähler bis zum nächsten zyklischen Senden von 3b3" UBYTE Def_dez_ub_q1 0 0 0.0 255.0000 ECU_ADDRESS 0x0080128B /begin FUNCTION_LIST PMPRSVCALC /end FUNCTION_LIST /end MEASUREMENT
/begin MEASUREMENT Ptc_pwr "Maximale Leistung, die der PTC einstellen darf." UBYTE Def_f_ub_b127p5 0 0 0.0 127.5000 ECU_ADDRESS 0x0080128C /begin FUNCTION_LIST PMPRSVCALC /end FUNCTION_LIST /end MEASUREMENT
/begin MEASUREMENT Ptc_pwr7 "lokales ptc_pwr" UBYTE Def_f_ub_b127p5 0 0 0.0 127.5000 ECU_ADDRESS 0x0080128D /begin FUNCTION_LIST PMPRSVCALC /end FUNCTION_LIST /end MEASUREMENT
/begin MEASUREMENT Pwrspmem "altes ctrpwspcos" UBYTE Def_f_ub_b127p5 0 0 0.0 127.5000 ECU_ADDRESS 0x0080128E /begin FUNCTION_LIST PMPRSVCALC /end FUNCTION_LIST /end MEASUREMENT
/begin MEASUREMENT Rqpcos "Anforderung_Standverbraucher" UBYTE Def_dez_ub_q1 0 0 0.0 3.0000 ECU_ADDRESS 0x0080128F /begin FUNCTION_LIST PMPRSVCALC /end FUNCTION_LIST /end MEASUREMENT
/begin MEASUREMENT Rqpcos7 "lokales rqpcos" UBYTE Def_dez_ub_q1 0 0 0.0 3.0000 ECU_ADDRESS 0x00801290 /begin FUNCTION_LIST PMPRSVCALC /end FUNCTION_LIST /end MEASUREMENT
/begin MEASUREMENT Rqpcosmem "altes rqpcos" UBYTE Def_dez_ub_q1 0 0 0.0 3.0000 ECU_ADDRESS 0x00801291 /begin FUNCTION_LIST PMPRSVCALC /end FUNCTION_LIST /end MEASUREMENT
/begin MEASUREMENT Selspcos "Auswahl_Sonderverbraucher" UBYTE Def_dez_ub_q1 0 0 0.0 15.0000 ECU_ADDRESS 0x00801292 /begin FUNCTION_LIST PMPRSVCALC /end FUNCTION_LIST /end MEASUREMENT
/begin MEASUREMENT Selspcosme "altes selspcos" UBYTE Def_dez_ub_q1 0 0 0.0 15.0000 ECU_ADDRESS 0x00801293 /begin FUNCTION_LIST PMPRSVCALC /end FUNCTION_LIST /end MEASUREMENT
/begin MEASUREMENT Stpcos "Status_Standverbraucher" UBYTE Def_dez_ub_q1 0 0 0.0 3.0000 ECU_ADDRESS 0x00801294 /begin FUNCTION_LIST PMPRSVCALC /end FUNCTION_LIST /end MEASUREMENT
/begin MEASUREMENT Stpcosmem "altes stpcos" UBYTE Def_dez_ub_q1 0 0 0.0 3.0000 ECU_ADDRESS 0x00801295 /begin FUNCTION_LIST PMPRSVCALC /end FUNCTION_LIST /end MEASUREMENT
/begin MEASUREMENT Ulev "Spannungsebene" UBYTE Def_dez_ub_q1 0 0 0.0 15.0000 ECU_ADDRESS 0x00801296 /begin FUNCTION_LIST PMPRSVCALC /end FUNCTION_LIST /end MEASUREMENT
/begin MEASUREMENT Ulevmem "altes ulev" UBYTE Def_dez_ub_q1 0 0 0.0 15.0000 ECU_ADDRESS 0x00801297 /begin FUNCTION_LIST PMPRSVCALC /end FUNCTION_LIST /end MEASUREMENT
/begin MEASUREMENT Ulow "Unterspannungsstatus : 0=i.O, 1=in between, 2=unterspannung" UBYTE Def_dez_ub_q1 0 0 0.0 255.0000 ECU_ADDRESS 0x00801298 /begin FUNCTION_LIST PMPRSVCALC /end FUNCTION_LIST /end MEASUREMENT
/begin MEASUREMENT Ulowtimer "Zeit zur Unterspannungserkennung * Taskzeit (50*100ms = 5sec)" UBYTE Def_td_ub_q0p1 0 0 0.0 25.5000 ECU_ADDRESS 0x00801299 /begin FUNCTION_LIST PMPRSVCALC /end FUNCTION_LIST /end MEASUREMENT
/begin MEASUREMENT kbmcount "Counter, gesetzt von KBMCNT_APP" UBYTE Def_td_ub_q0p1 0 0 0.0 25.5000 ECU_ADDRESS 0x0080129A /begin FUNCTION_LIST PMPRSVCALC /end FUNCTION_LIST /end MEASUREMENT
/begin MEASUREMENT Dfpt1filt "Wert nach DF-Tiefpass Prio" UBYTE Def_f_ub_b100 0 0 0.0 99.6093 ECU_ADDRESS 0x0080129B /begin FUNCTION_LIST PMPRSVCALC /end FUNCTION_LIST /end MEASUREMENT
/begin MEASUREMENT Dfpt1ptc "Wert nach DFFGEN-Filter PTC" UBYTE Def_f_ub_b100 0 0 0.0 99.6093 ECU_ADDRESS 0x0080129C /begin FUNCTION_LIST PMPRSVCALC /end FUNCTION_LIST /end MEASUREMENT
/begin MEASUREMENT Igenrest "Generatorreststrom modelliert" UBYTE Def_i_ub_q1 0 0 0.0 255.0000 ECU_ADDRESS 0x0080129D /begin FUNCTION_LIST PMPRSVCALC /end FUNCTION_LIST /end MEASUREMENT
/begin MEASUREMENT Ctrpcos7 "lokales ctrpcos" UBYTE Def_dez_ub_q1 0 0 0.0 3.0000 ECU_ADDRESS 0x0080129F /begin FUNCTION_LIST PMPRSVCALC /end FUNCTION_LIST /end MEASUREMENT
/begin MEASUREMENT Stpcos7 "lokales stpcos" UBYTE Def_dez_ub_q1 0 0 0.0 3.0000 ECU_ADDRESS 0x008012A0 /begin FUNCTION_LIST PMPRSVCALC /end FUNCTION_LIST /end MEASUREMENT
/begin MEASUREMENT St_pmsoccalc.B_soc_pwf "Uo Kalibrierung durchgeführt" UBYTE Def_bit_ub_1 0 0 0.0 255.0 ECU_ADDRESS 0x007FCF6C /begin FUNCTION_LIST PMSOCCALC /end FUNCTION_LIST BIT_MASK 0x2 /end MEASUREMENT
/begin MEASUREMENT St_pmsoccalc.B_soccalc "Uo Kalibrierung durchgeführt" UBYTE Def_bit_ub_2 0 0 0.0 255.0 ECU_ADDRESS 0x007FCF6C /begin FUNCTION_LIST PMSOCCALC /end FUNCTION_LIST BIT_MASK 0x4 /end MEASUREMENT
/begin MEASUREMENT St_pmsoccalc "Statuswort" UBYTE Def_st_ub_q1 0 0 0.0 255.0000 ECU_ADDRESS 0x007FCF6C /begin FUNCTION_LIST PMSOCCALC /end FUNCTION_LIST /end MEASUREMENT
/begin MEASUREMENT St_pmsocalc1.B_ibspwf_e "Bedingung Powerfail IBS erkannt" UBYTE Def_bit_ub_0 0 0 0.0 255.0 ECU_ADDRESS 0x008012B0 /begin FUNCTION_LIST PMSOCCALC /end FUNCTION_LIST BIT_MASK 0x1 /end MEASUREMENT
/begin MEASUREMENT St_pmsocalc1 "Statuswort" UBYTE Def_st_ub_q1 0 0 0.0 255.0000 ECU_ADDRESS 0x008012B0 /begin FUNCTION_LIST PMSOCCALC /end FUNCTION_LIST /end MEASUREMENT
/begin MEASUREMENT D_qelad "Delta Kapazität entladen" UWORD Def_ql_uw_q0p0182 0 0 0.0 1193.0282 ECU_ADDRESS 0x008012A2 /begin FUNCTION_LIST PMSOCCALC /end FUNCTION_LIST /end MEASUREMENT
/begin MEASUREMENT D_qlad "Delta Kapazität geladen" UWORD Def_ql_uw_q0p0182 0 0 0.0 1193.0282 ECU_ADDRESS 0x008012A4 /begin FUNCTION_LIST PMSOCCALC /end FUNCTION_LIST /end MEASUREMENT
/begin MEASUREMENT Soc_bila "Ladezustand durch Bilanzierung und Ruhespannungsmessung ermittelt" UWORD Def_f_uw_b100 0 0 0.0 99.9984 ECU_ADDRESS 0x008012A6 /begin FUNCTION_LIST PMSOCCALC /end FUNCTION_LIST /end MEASUREMENT
/begin MEASUREMENT Soc_quali "Zähler Genauigkeit Ladeztustandsbestimmung" UWORD Def_ql_uw_q0p0182 0 0 0.0 1193.0282 ECU_ADDRESS 0x008012A8 /begin FUNCTION_LIST PMSOCCALC /end FUNCTION_LIST /end MEASUREMENT
/begin MEASUREMENT Ubatt0 "Aus Wertetripel ausgewählter Ruhespannungswert" UWORD Def_u_uw_q0p25em3_o6 0 0 6.0000 22.3837 ECU_ADDRESS 0x008012AA /begin FUNCTION_LIST PMSOCCALC /end FUNCTION_LIST /end MEASUREMENT
/begin MEASUREMENT Cbatt_lo "Nennkapazität Batterie, lokal" UBYTE Def_ql_ub_q1 0 0 1.0000 255.0000 ECU_ADDRESS 0x008012AC /begin FUNCTION_LIST PMSOCCALC /end FUNCTION_LIST /end MEASUREMENT
/begin MEASUREMENT Ib_commcnt "Zähler Taskaufrufe zwischen periodischer Abfrage qlad und qelad" UBYTE Def_dez_ub_q1 0 0 0.0 255.0000 ECU_ADDRESS 0x008012AD /begin FUNCTION_LIST PMSOCCALC /end FUNCTION_LIST /end MEASUREMENT
/begin MEASUREMENT Ib_commsta "Statemaschine zeiger zur Abfrage qlad und qelad" UBYTE Def_dez_ub_q1 0 0 0.0 255.0000 ECU_ADDRESS 0x008012AE /begin FUNCTION_LIST PMSOCCALC /end FUNCTION_LIST /end MEASUREMENT
/begin MEASUREMENT Kalevcnt "Anzahl der Ruhespannungsmessungen" UBYTE Def_dez_ub_q1 0 0 0.0 255.0000 ECU_ADDRESS 0x008012AF /begin FUNCTION_LIST PMSOCCALC /end FUNCTION_LIST /end MEASUREMENT
/begin MEASUREMENT Q_bila "Kapazität Batterie (long)" ULONG Def_ql_ul_q2p7Em7 0 0 0.0 1193.0464 ECU_ADDRESS 0x008012B4 /begin FUNCTION_LIST PMSOCCALC /end FUNCTION_LIST /end MEASUREMENT
/begin MEASUREMENT Qeladold "Kapazität Entladen vor Abstellen" UWORD Def_ql_uw_q0p0182 0 0 0.0 1193.0282 ECU_ADDRESS 0x008012B8 /begin FUNCTION_LIST PMSOCCALC /end FUNCTION_LIST /end MEASUREMENT
/begin MEASUREMENT Qladold "Kapazität Getladen vor Abstellen" UWORD Def_ql_uw_q0p0182 0 0 0.0 1193.0282 ECU_ADDRESS 0x008012BA /begin FUNCTION_LIST PMSOCCALC /end FUNCTION_LIST /end MEASUREMENT
/begin MEASUREMENT Soc_b_loc "lokal soc_bila f. KFSOCLF" UWORD Def_f_uw_b100 0 0 0.0 99.9984 ECU_ADDRESS 0x008012BC /begin FUNCTION_LIST PMSOCCALC /end FUNCTION_LIST /end MEASUREMENT
/begin MEASUREMENT Soc_q_loc "lokaler Zähler Genauigkeit Ladeztustandsbestimmung" UWORD Def_ql_uw_q0p0182 0 0 0.0 1193.0282 ECU_ADDRESS 0x008012BE /begin FUNCTION_LIST PMSOCCALC /end FUNCTION_LIST /end MEASUREMENT
/begin MEASUREMENT Isoc0loc "Batteriestrom zum Zeitpunkt der Ruhespannungsmessung (lokal)" SWORD Def_i_sw_q0p02 0 0 -655.3600 655.3400 ECU_ADDRESS 0x007FCF68 /begin FUNCTION_LIST PMSOCCALC /end FUNCTION_LIST /end MEASUREMENT
/begin MEASUREMENT Tsocloc "Batterietemperatur zum Zeitpunkt der Ruhespannungsmessung (lokal)" SWORD Def_t_sw_q0p1 0 0 -3276.8000 3276.7000 ECU_ADDRESS 0x007FCF6A /begin FUNCTION_LIST PMSOCCALC /end FUNCTION_LIST /end MEASUREMENT
/begin MEASUREMENT Soc_fit_temp "" UWORD Def_f_uw_b100 0 0 0.0 99.9984 ECU_ADDRESS 0x008012C0 /begin FUNCTION_LIST PMSOCFIT /end FUNCTION_LIST /end MEASUREMENT
/begin MEASUREMENT Ubatts2 "Hilfswert2 Spannung aus Fitberechnung" UWORD Def_u_uw_q0p25em3_o6 0 0 6.0000 16.0000 ECU_ADDRESS 0x008012C2 /begin FUNCTION_LIST PMSOCFIT /end FUNCTION_LIST /end MEASUREMENT
/begin MEASUREMENT Soc_fit "SoC aus der Fitformel" UWORD Def_f_uw_b100 0 0 0.0 99.9984 ECU_ADDRESS 0x008012C4 /begin FUNCTION_LIST PMSOCFIT /end FUNCTION_LIST /end MEASUREMENT
/begin MEASUREMENT St_pmsockor0.B_soc_npl "Bedingung Hilfsvariable Fit 3" UBYTE Def_bit_ub_0 0 0 0.0 255.0 ECU_ADDRESS 0x007FCF74 /begin FUNCTION_LIST PMSOCKOR /end FUNCTION_LIST BIT_MASK 0x1 /end MEASUREMENT
/begin MEASUREMENT St_pmsockor0.B_pm_fit2 "Bedingung SoC-Wert nicht plausibel" UBYTE Def_bit_ub_1 0 0 0.0 255.0 ECU_ADDRESS 0x007FCF74 /begin FUNCTION_LIST PMSOCKOR /end FUNCTION_LIST BIT_MASK 0x2 /end MEASUREMENT
/begin MEASUREMENT St_pmsockor0.B_pm_fit3 "Bedingung Hilfsvariable Fit 2" UBYTE Def_bit_ub_2 0 0 0.0 255.0 ECU_ADDRESS 0x007FCF74 /begin FUNCTION_LIST PMSOCKOR /end FUNCTION_LIST BIT_MASK 0x4 /end MEASUREMENT
/begin MEASUREMENT St_pmsockor0.B_pmsocini "Bedingung Startqualität vollständig berechnet" UBYTE Def_bit_ub_3 0 0 0.0 255.0 ECU_ADDRESS 0x007FCF74 /begin FUNCTION_LIST PMSOCKOR /end FUNCTION_LIST BIT_MASK 0x8 /end MEASUREMENT
/begin MEASUREMENT St_pmsockor0.B_q_start "wird beim INIT wahr um den Timer zurückzusetzen" UBYTE Def_bit_ub_4 0 0 0.0 255.0 ECU_ADDRESS 0x007FCF74 /begin FUNCTION_LIST PMSOCKOR /end FUNCTION_LIST BIT_MASK 0x10 /end MEASUREMENT
/begin MEASUREMENT St_pmsockor0.B_abschfit "Bedingung Korrektur Startfähigkeitsgrenze durchgeführt" UBYTE Def_bit_ub_5 0 0 0.0 255.0 ECU_ADDRESS 0x007FCF74 /begin FUNCTION_LIST PMSOCKOR /end FUNCTION_LIST BIT_MASK 0x20 /end MEASUREMENT
/begin MEASUREMENT St_pmsockor0 "Statuswort" UBYTE Def_st_ub_q1 0 0 0.0 255.0000 ECU_ADDRESS 0x007FCF74 /begin FUNCTION_LIST PMSOCKOR /end FUNCTION_LIST /end MEASUREMENT
/begin MEASUREMENT D_socw "Delta SoC" SWORD Def_f_sw_b100 0 0 -100.0000 99.9969 ECU_ADDRESS 0x008012C6 /begin FUNCTION_LIST PMSOCKOR /end FUNCTION_LIST /end MEASUREMENT
/begin MEASUREMENT T_saisonalt "letzter Wert Saisontemperatur" SWORD Def_t_sw_q0p1 0 0 -3276.8000 3276.7000 ECU_ADDRESS 0x008012C8 /begin FUNCTION_LIST PMSOCKOR /end FUNCTION_LIST /end MEASUREMENT
/begin MEASUREMENT Soc_stfgkw "SoC Startfähigkeit" UWORD Def_f_uw_b100 0 0 0.0 99.9984 ECU_ADDRESS 0x008012CA /begin FUNCTION_LIST PMSOCKOR /end FUNCTION_LIST /end MEASUREMENT
/begin MEASUREMENT Absch_korr "Korrekturwert Abschaltung" SWORD Def_f_sw_q0p00153 0 0 -40.0000 40.0000 ECU_ADDRESS 0x008012D2 /begin FUNCTION_LIST PMSOCKOR /end FUNCTION_LIST /end MEASUREMENT
/begin MEASUREMENT D_soc "Abstand zur Startfähigkeitsgrenze" SWORD Def_f_sw_b100 0 0 -100.0000 99.9969 ECU_ADDRESS 0x008012D4 /begin FUNCTION_LIST PMSOCKOR /end FUNCTION_LIST /end MEASUREMENT
/begin MEASUREMENT Soc_korr "Korrekturwert soc_bila" SWORD Def_f_sw_b100 0 0 -100.0000 99.9969 ECU_ADDRESS 0x008012D6 /begin FUNCTION_LIST PMSOCKOR /end FUNCTION_LIST /end MEASUREMENT
/begin MEASUREMENT T_saison "Saison -Temperatur" SWORD Def_t_sw_q0p1 0 0 -3276.8000 3276.7000 ECU_ADDRESS 0x008012D8 /begin FUNCTION_LIST PMSOCKOR /end FUNCTION_LIST /end MEASUREMENT
/begin MEASUREMENT Q_startfgk "Abstand zur Startfähigkeitsgrenze" UWORD Def_ql_uw_q0p0182 0 0 0.0 1193.0282 ECU_ADDRESS 0x008012DA /begin FUNCTION_LIST PMSOCKOR /end FUNCTION_LIST /end MEASUREMENT
/begin MEASUREMENT Soc_q_kor "Korrekturwert Genauigkeit Ladezustandsbestimmung" UWORD Def_ql_uw_q0p0182 0 0 0.0 1193.0282 ECU_ADDRESS 0x008012DC /begin FUNCTION_LIST PMSOCKOR /end FUNCTION_LIST /end MEASUREMENT
/begin MEASUREMENT Soc_rel "Relativzähler für Ladezustand SoC" UWORD Def_f_uw_b100 0 0 0.0 99.9984 ECU_ADDRESS 0x008012DE /begin FUNCTION_LIST PMSOCKOR /end FUNCTION_LIST /end MEASUREMENT
/begin MEASUREMENT Soc_stfgk "Startfähigkeitsgrenze" UWORD Def_f_uw_b100 0 0 0.0 99.9984 ECU_ADDRESS 0x008012E0 /begin FUNCTION_LIST PMSOCKOR /end FUNCTION_LIST /end MEASUREMENT
/begin MEASUREMENT Pm_tsrdy "Status Berechnung Tsaison" UBYTE Identity 0 0 0.0 1.0000 ECU_ADDRESS 0x008012E2 /begin FUNCTION_LIST PMSOCKOR /end FUNCTION_LIST /end MEASUREMENT
/begin MEASUREMENT St_pmsocstart0.B_pmstart7 "Bed. Motorstart für Startauswertung PM" UBYTE Def_bit_ub_0 0 0 0.0 255.0 ECU_ADDRESS 0x007FCF7A /begin FUNCTION_LIST PMSOCSTART /end FUNCTION_LIST BIT_MASK 0x1 /end MEASUREMENT
/begin MEASUREMENT St_pmsocstart0.B_resetsta "Bedingung Reset Startauswertung" UBYTE Def_bit_ub_1 0 0 0.0 255.0 ECU_ADDRESS 0x007FCF7A /begin FUNCTION_LIST PMSOCSTART /end FUNCTION_LIST BIT_MASK 0x2 /end MEASUREMENT
/begin MEASUREMENT St_pmsocstart0.B_rstdatardy "Motor aus erkannt, Startwerte im IBS bereit zum löschen." UBYTE Def_bit_ub_2 0 0 0.0 255.0 ECU_ADDRESS 0x007FCF7A /begin FUNCTION_LIST PMSOCSTART /end FUNCTION_LIST BIT_MASK 0x4 /end MEASUREMENT
/begin MEASUREMENT St_pmsocstart0 "Statuswort" UBYTE Def_st_ub_q1 0 0 0.0 255.0000 ECU_ADDRESS 0x007FCF7A /begin FUNCTION_LIST PMSOCSTART /end FUNCTION_LIST /end MEASUREMENT
/begin MEASUREMENT St_pmsocstart_nv0.B_pmstartq "Bedingung Startqualität" UBYTE Def_bit_ub_0 0 0 0.0 255.0 ECU_ADDRESS 0x008012F1 /begin FUNCTION_LIST PMSOCSTART /end FUNCTION_LIST BIT_MASK 0x1 /end MEASUREMENT
/begin MEASUREMENT St_pmsocstart_nv0.B_pmsqrdy "kt_ibs.dat" UBYTE Def_bit_ub_1 0 0 0.0 255.0 ECU_ADDRESS 0x008012F1 /begin FUNCTION_LIST PMSOCSTART /end FUNCTION_LIST BIT_MASK 0x2 /end MEASUREMENT
/begin MEASUREMENT St_pmsocstart_nv0 "Statuswort" UBYTE Def_st_ub_q1 0 0 0.0 255.0000 ECU_ADDRESS 0x008012F1 /begin FUNCTION_LIST PMSOCSTART /end FUNCTION_LIST /end MEASUREMENT
/begin MEASUREMENT Nnmstart "Motordrehzahl nach Motorstart" SWORD Def_n_sw_q1p0 0 0 -32768.0000 32767.0000 ECU_ADDRESS 0x008012E4 /begin FUNCTION_LIST PMSOCSTART /end FUNCTION_LIST /end MEASUREMENT
/begin MEASUREMENT U_startausw "U_tnstart - ugrenz" SWORD Def_u_sw_q0p00025 0 0 -8.1920 8.1917 ECU_ADDRESS 0x008012E6 /begin FUNCTION_LIST PMSOCSTART /end FUNCTION_LIST /end MEASUREMENT
/begin MEASUREMENT Ideltaabs "Differenz der Startströme" UWORD Def_i_uw_q0p02 0 0 0.0200 1310.7000 ECU_ADDRESS 0x008012E8 /begin FUNCTION_LIST PMSOCSTART /end FUNCTION_LIST /end MEASUREMENT
/begin MEASUREMENT U_grenz "Grenzwert Spannung" UWORD Def_u_uw_q0p25em3_o6 0 0 6.0000 22.3837 ECU_ADDRESS 0x008012EA /begin FUNCTION_LIST PMSOCSTART /end FUNCTION_LIST /end MEASUREMENT
/begin MEASUREMENT Ub_old "letzter Wert Batteriespannung" UWORD Def_u_uw_q0p0942 0 0 0.0 6173.3970 ECU_ADDRESS 0x008012EC /begin FUNCTION_LIST PMSOCSTART /end FUNCTION_LIST /end MEASUREMENT
/begin MEASUREMENT Pmstartsta "Schalter für Ablaufsteuerung" UBYTE Def_dez_ub_q1 0 0 0.0 255.0000 ECU_ADDRESS 0x008012EE /begin FUNCTION_LIST PMSOCSTART /end FUNCTION_LIST /end MEASUREMENT
/begin MEASUREMENT Rin_grenzh "Batt.Innenwiderstand Grenze" UBYTE Def_f_ub_b32 0 0 0.0 31.8750 ECU_ADDRESS 0x008012EF /begin FUNCTION_LIST PMSOCSTART /end FUNCTION_LIST /end MEASUREMENT
/begin MEASUREMENT Rin_start "Innenwiderstand Batterie beim Start" UBYTE Def_f_ub_b32 0 0 0.0 31.8750 ECU_ADDRESS 0x008012F0 /begin FUNCTION_LIST PMSOCSTART /end FUNCTION_LIST /end MEASUREMENT
/begin MEASUREMENT St_pmugencalc.B_genclcon "Wird auf true gesetzt wenn Motor und Generator bereits T_B_NMOT-Sekunden laufen." UBYTE Def_bit_ub_0 0 0 0.0 255.0 ECU_ADDRESS 0x007FCF88 /begin FUNCTION_LIST PMUGENCALC /end FUNCTION_LIST BIT_MASK 0x1 /end MEASUREMENT
/begin MEASUREMENT St_pmugencalc "Statuswort" UBYTE Def_st_ub_q1 0 0 0.0 255.0000 ECU_ADDRESS 0x007FCF88 /begin FUNCTION_LIST PMUGENCALC /end FUNCTION_LIST /end MEASUREMENT
/begin MEASUREMENT U_ibs "Generatorspannungsvorgabe von IBS" SWORD Def_u_sw_b128 0 0 -128.0000 127.9960 ECU_ADDRESS 0x008012F2 /begin FUNCTION_LIST PMUGENCALC /end FUNCTION_LIST /end MEASUREMENT
/begin MEASUREMENT U_igrdetec "U_gsoll - U_ibs für IGRLOW Detektierung" SWORD Def_u_sw_b128 0 0 -128.0000 127.9960 ECU_ADDRESS 0x008012F4 /begin FUNCTION_LIST PMUGENCALC /end FUNCTION_LIST /end MEASUREMENT
/begin MEASUREMENT Udelta "Delta zw. Battsollspg und Battspg" SWORD Def_u_sw_q0p00025 0 0 -8.1920 8.1917 ECU_ADDRESS 0x008012F6 /begin FUNCTION_LIST PMUGENCALC /end FUNCTION_LIST /end MEASUREMENT
/begin MEASUREMENT Udeltaabs "Absolutwert von udelta" SWORD Def_u_sw_q0p00025 0 0 0.0 8.1917 ECU_ADDRESS 0x008012F8 /begin FUNCTION_LIST PMUGENCALC /end FUNCTION_LIST /end MEASUREMENT
/begin MEASUREMENT Ubattsoll "Batteriesollspannung aufgrund Batterietemperatur und Batt.-ladezustand. Weitere Nutzung in PMPRSVCALC." UWORD Def_u_uw_q0p25em3_o6 0 0 6.0000 22.3837 ECU_ADDRESS 0x008012FA /begin FUNCTION_LIST PMUGENCALC /end FUNCTION_LIST /end MEASUREMENT
/begin MEASUREMENT Ubattsoll7 "lokales ubattsoll" UWORD Def_u_uw_q0p25em3_o6 0 0 6.0000 22.3837 ECU_ADDRESS 0x008012FC /begin FUNCTION_LIST PMUGENCALC /end FUNCTION_LIST /end MEASUREMENT
/begin MEASUREMENT T_bnmotakt "Zeit nachdem der Motor laeuft, hoert nach T_B_NMOT Sekunden auf." UBYTE Def_td_ub_q1 0 0 0.0 255.0000 ECU_ADDRESS 0x00801300 /begin FUNCTION_LIST PMUGENCALC /end FUNCTION_LIST /end MEASUREMENT
/begin MEASUREMENT T_delta "Zeit, die seit letzem Prozessaufruf verstrichen ist. Dient zur Taskkompatibilitaet." UBYTE Def_td_ub_q1 0 0 0.0 255.0000 ECU_ADDRESS 0x00801301 /begin FUNCTION_LIST PMUGENCALC /end FUNCTION_LIST /end MEASUREMENT
/begin MEASUREMENT Uibs7 "lokales uibs" SWORD Def_u_sw_b128 0 0 -128.0000 127.9960 ECU_ADDRESS 0x008012FE /begin FUNCTION_LIST PMUGENCALC /end FUNCTION_LIST /end MEASUREMENT
/begin MEASUREMENT St_ugenkor0.B_1stugen "Modulspezifische Bedingung für Schubabschalten" UBYTE Def_bit_ub_0 0 0 0.0 255.0 ECU_ADDRESS 0x007FD67C /begin FUNCTION_LIST UGENKOR /end FUNCTION_LIST BIT_MASK 0x1 /end MEASUREMENT
/begin MEASUREMENT St_ugenkor0.B_genoffout "Freigabe für modulspezifisches Schubabschalten" UBYTE Def_bit_ub_1 0 0 0.0 255.0 ECU_ADDRESS 0x007FD67C /begin FUNCTION_LIST UGENKOR /end FUNCTION_LIST BIT_MASK 0x2 /end MEASUREMENT
/begin MEASUREMENT St_ugenkor0.B_ugenini "Bedingung ctrgenutar noch nicht gueltig" UBYTE Def_bit_ub_2 0 0 0.0 255.0 ECU_ADDRESS 0x007FD67C /begin FUNCTION_LIST UGENKOR /end FUNCTION_LIST BIT_MASK 0x4 /end MEASUREMENT
/begin MEASUREMENT St_ugenkor0.B_genoff "Bedingung Abschaltung Generator" UBYTE Def_bit_ub_3 0 0 0.0 255.0 ECU_ADDRESS 0x007FD67C /begin FUNCTION_LIST UGENKOR /end FUNCTION_LIST BIT_MASK 0x8 /end MEASUREMENT
/begin MEASUREMENT St_ugenkor0.B_genoff2 "Initialisierung Generatorspannung" UBYTE Def_bit_ub_4 0 0 0.0 255.0 ECU_ADDRESS 0x007FD67C /begin FUNCTION_LIST UGENKOR /end FUNCTION_LIST BIT_MASK 0x10 /end MEASUREMENT
/begin MEASUREMENT St_ugenkor0.B_genoffok "Bedingung Generator ausgeschaltet" UBYTE Def_bit_ub_5 0 0 0.0 255.0 ECU_ADDRESS 0x007FD67C /begin FUNCTION_LIST UGENKOR /end FUNCTION_LIST BIT_MASK 0x20 /end MEASUREMENT
/begin MEASUREMENT St_ugenkor0.B_noctrgen "Bedingung Generator2 ausgeschaltet" UBYTE Def_bit_ub_6 0 0 0.0 255.0 ECU_ADDRESS 0x007FD67C /begin FUNCTION_LIST UGENKOR /end FUNCTION_LIST BIT_MASK 0x40 /end MEASUREMENT
/begin MEASUREMENT St_ugenkor0.B_verb_off "Bedingung Generatorabschaltfreigabe Sicherheitstimer" UBYTE Def_bit_ub_7 0 0 0.0 255.0 ECU_ADDRESS 0x007FD67C /begin FUNCTION_LIST UGENKOR /end FUNCTION_LIST BIT_MASK 0x80 /end MEASUREMENT
/begin MEASUREMENT St_ugenkor0 "Statuswort" UBYTE Def_st_ub_q1 0 0 0.0 255.0000 ECU_ADDRESS 0x007FD67C /begin FUNCTION_LIST UGENKOR /end FUNCTION_LIST /end MEASUREMENT
/begin MEASUREMENT St_ugenkor2.B_saaktiv "Bedingung elektr. Verbraucher AUS" UBYTE Def_bit_ub_0 0 0 0.0 255.0 ECU_ADDRESS 0x0080131C /begin FUNCTION_LIST UGENKOR /end FUNCTION_LIST BIT_MASK 0x1 /end MEASUREMENT
/begin MEASUREMENT St_ugenkor2.B_saset "Bedindung Toggel Generatorauswahl" UBYTE Def_bit_ub_1 0 0 0.0 255.0 ECU_ADDRESS 0x0080131C /begin FUNCTION_LIST UGENKOR /end FUNCTION_LIST BIT_MASK 0x2 /end MEASUREMENT
/begin MEASUREMENT St_ugenkor2 "Statuswort" UBYTE Def_st_ub_q1 0 0 0.0 255.0000 ECU_ADDRESS 0x0080131C /begin FUNCTION_LIST UGENKOR /end FUNCTION_LIST /end MEASUREMENT
/begin MEASUREMENT St_ugenkor1.B_gentoggl "Bedingung Ladespannungvorgabe ignoriert" UBYTE Def_bit_ub_0 0 0 0.0 255.0 ECU_ADDRESS 0x0080131D /begin FUNCTION_LIST UGENKOR /end FUNCTION_LIST BIT_MASK 0x1 /end MEASUREMENT
/begin MEASUREMENT St_ugenkor1 "Statuswort" UBYTE Def_st_ub_q1 0 0 0.0 255.0000 ECU_ADDRESS 0x0080131D /begin FUNCTION_LIST UGENKOR /end FUNCTION_LIST /end MEASUREMENT
/begin MEASUREMENT T_batt "Batterietemperatur" SWORD Def_t_sw_q0p1 0 0 -3276.8000 3276.7000 ECU_ADDRESS 0x007FD678 /begin FUNCTION_LIST UGENKOR /end FUNCTION_LIST /end MEASUREMENT
/begin MEASUREMENT U_gen "Sollwert Generatorspannung" UWORD Def_u_uw_q0p1 0 0 0.0 6553.5000 ECU_ADDRESS 0x00801308 /begin FUNCTION_LIST UGENKOR /end FUNCTION_LIST /end MEASUREMENT
/begin MEASUREMENT U_gen2 "Generatosspannungssollwert für Generator2" UWORD Def_u_uw_q0p1 0 0 0.0 16.0000 ECU_ADDRESS 0x0080130A /begin FUNCTION_LIST UGENKOR /end FUNCTION_LIST /end MEASUREMENT
/begin MEASUREMENT U_gsoll "Generatorsollspannung Basis" UWORD Def_u_uw_q0p1 0 0 0.0 6553.5000 ECU_ADDRESS 0x0080130C /begin FUNCTION_LIST UGENKOR /end FUNCTION_LIST /end MEASUREMENT
/begin MEASUREMENT U_gsoll_off "Generatorsollspannung Basis" UWORD Def_u_uw_q0p1 0 0 0.0 6553.5000 ECU_ADDRESS 0x0080130E /begin FUNCTION_LIST UGENKOR /end FUNCTION_LIST /end MEASUREMENT
/begin MEASUREMENT U_gsoll_tp "Generatorsollspannung Basis" UWORD Def_u_uw_q0p1 0 0 0.0 6553.5000 ECU_ADDRESS 0x00801310 /begin FUNCTION_LIST UGENKOR /end FUNCTION_LIST /end MEASUREMENT
/begin MEASUREMENT Pmigrlowctr "" UWORD Def_dez_uw_q1 0 0 0.0 65535.0000 ECU_ADDRESS 0x00801312 /begin FUNCTION_LIST UGENKOR /end FUNCTION_LIST /end MEASUREMENT
/begin MEASUREMENT U_gen_igr "" UWORD Def_u_uw_q0p1 0 0 0.0 6553.5000 ECU_ADDRESS 0x00801314 /begin FUNCTION_LIST UGENKOR /end FUNCTION_LIST /end MEASUREMENT
/begin MEASUREMENT U_gsoll_tp2 "Generatorsollspannung Basis" UWORD Def_u_uw_q0p1 0 0 0.0 6553.5000 ECU_ADDRESS 0x00801316 /begin FUNCTION_LIST UGENKOR /end FUNCTION_LIST /end MEASUREMENT
/begin MEASUREMENT U_gsollred "reduzierte Generatorsollspannung" UWORD Def_u_uw_q0p1 0 0 0.0 6553.5000 ECU_ADDRESS 0x00801318 /begin FUNCTION_LIST UGENKOR /end FUNCTION_LIST /end MEASUREMENT
/begin MEASUREMENT U_gsolltmp "reduzierte Zwischengeneratorsollspannung" UWORD Def_u_uw_q0p1 0 0 0.0 6553.5000 ECU_ADDRESS 0x007FD67A /begin FUNCTION_LIST UGENKOR /end FUNCTION_LIST /end MEASUREMENT
/begin FUNCTION OZGG "OZGG" /end FUNCTION
/begin FUNCTION OZLEIT "OZLEIT" /end FUNCTION
/begin FUNCTION OZNIVDL "OZNIVDL" /end FUNCTION
/begin FUNCTION OZPERM "OZPERM" /end FUNCTION
/begin FUNCTION OZRESTKM "OZRESTKM" /end FUNCTION
/begin FUNCTION OZTEMP "OZTEMP" /end FUNCTION
/begin FUNCTION PMBNSTAB "PMBNSTAB" /end FUNCTION
/begin FUNCTION PMDIAG "PMDIAG" /end FUNCTION
/begin FUNCTION PMPRSVCALC "PMPRSVCALC" /end FUNCTION
/begin FUNCTION PMSOCCALC "PMSOCCALC" /end FUNCTION
/begin FUNCTION PMSOCFIT "PMSOCFIT" /end FUNCTION
/begin FUNCTION PMSOCKOR "PMSOCKOR" /end FUNCTION
/begin FUNCTION PMSOCSTART "PMSOCSTART" /end FUNCTION
/begin FUNCTION PMUGENCALC "PMUGENCALC" /end FUNCTION
/begin FUNCTION UGENKOR "UGENKOR" /end FUNCTION
/begin COMPU_METHOD Def_f_uw_b512 "Def_f_uw_b512" RAT_FUNC "%8.3" "-" COEFFS 0 65536 0 0 0 512 /end COMPU_METHOD
/begin COMPU_METHOD Def_t_sw_q0p1 "Def_t_sw_q0p1" RAT_FUNC "%6.1" "°C" COEFFS 0 10 0 0 0 1 /end COMPU_METHOD
/begin COMPU_METHOD Def_u_uw_q0p0942 "Def_u_uw_q0p0942" RAT_FUNC "%6.1" "V" COEFFS 0 1 0 0 0 0.0942 /end COMPU_METHOD
/begin COMPU_METHOD Def_f_ub_b8 "Def_f_ub_b8" RAT_FUNC "%5.2" "-" COEFFS 0 256 0 0 0 8 /end COMPU_METHOD
/begin COMPU_METHOD Def_v_uw_q1p0 "Def_v_uw_q1p0" RAT_FUNC "%5.0" "km/h" COEFFS 0 1 0 0 0 1 /end COMPU_METHOD
/begin COMPU_METHOD Def_bit_ub_0 "Def_bit_ub_0" TAB_VERB "%5.2" "-" COMPU_TAB_REF Def_bit_ub_0_VTAB /end COMPU_METHOD
/begin COMPU_METHOD Def_st_ub_q1 "Def_st_ub_q1" RAT_FUNC "%3.0" "-" COEFFS 0 1 0 0 0 1 /end COMPU_METHOD
/begin COMPU_METHOD Def_n_sw_q1p0 "Def_n_sw_q1p0" RAT_FUNC "%5.0" "Upm" COEFFS 0 1 0 0 0 1 /end COMPU_METHOD
/begin COMPU_METHOD Def_f_ub_b100 "Def_f_ub_b100" RAT_FUNC "%5.2" "%" COEFFS 0 256 0 0 0 100 /end COMPU_METHOD
/begin COMPU_METHOD Def_i_ub_q1 "Def_i_ub_q1" RAT_FUNC "%6.3" "" COEFFS 0 1 0 0 0 1 /end COMPU_METHOD
/begin COMPU_METHOD Def_td_ub_q0p1 "Def_td_ub_q0p1" RAT_FUNC "%4.1" "s" COEFFS 0 10 0 0 0 1 /end COMPU_METHOD
/begin COMPU_METHOD Def_bit_ub_1 "Def_bit_ub_1" TAB_VERB "%5.2" "-" COMPU_TAB_REF Def_bit_ub_1_VTAB /end COMPU_METHOD
/begin COMPU_METHOD Def_bit_ub_2 "Def_bit_ub_2" TAB_VERB "%5.2" "-" COMPU_TAB_REF Def_bit_ub_2_VTAB /end COMPU_METHOD
/begin COMPU_METHOD Def_bit_ub_3 "Def_bit_ub_3" TAB_VERB "%5.2" "-" COMPU_TAB_REF Def_bit_ub_3_VTAB /end COMPU_METHOD
/begin COMPU_METHOD Def_bit_ub_4 "Def_bit_ub_4" TAB_VERB "%5.2" "-" COMPU_TAB_REF Def_bit_ub_4_VTAB /end COMPU_METHOD
/begin COMPU_METHOD Def_bit_ub_5 "Def_bit_ub_5" TAB_VERB "%5.2" "-" COMPU_TAB_REF Def_bit_ub_5_VTAB /end COMPU_METHOD
/begin COMPU_METHOD Def_bit_ub_6 "Def_bit_ub_6" TAB_VERB "%5.2" "-" COMPU_TAB_REF Def_bit_ub_6_VTAB /end COMPU_METHOD
/begin COMPU_METHOD Def_bit_ub_7 "Def_bit_ub_7" TAB_VERB "%5.2" "-" COMPU_TAB_REF Def_bit_ub_7_VTAB /end COMPU_METHOD
/begin COMPU_METHOD Def_st_uw_q1 "Def_st_uw_q1" RAT_FUNC "%5.0" "-" COEFFS 0 1 0 0 0 1 /end COMPU_METHOD
/begin COMPU_METHOD Def_dez_uw_q1 "Def_dez_uw_q1" RAT_FUNC "%5.0" "-" COEFFS 0 1 0 0 0 1 /end COMPU_METHOD
/begin COMPU_METHOD Def_dez_ub_q1 "Def_dez_ub_q1" RAT_FUNC "%3.0" "-" COEFFS 0 1 0 0 0 1 /end COMPU_METHOD
/begin COMPU_METHOD Identity "Identity" RAT_FUNC "%4.1" "-" COEFFS 0 1 0 0 0 1 /end COMPU_METHOD
/begin COMPU_METHOD Def_dez_ul_q1 "Def_dez_ul_q1" RAT_FUNC "%7.0" "-" COEFFS 0 1 0 0 0 1 /end COMPU_METHOD
/begin COMPU_METHOD Def_f_uw_b100 "Def_f_uw_b100" RAT_FUNC "%8.3" "%" COEFFS 0 65536 0 0 0 100 /end COMPU_METHOD
/begin COMPU_METHOD Def_f_ub_b4 "Def_f_ub_b4" RAT_FUNC "%5.2" "-" COEFFS 0 256 0 0 0 4 /end COMPU_METHOD
/begin COMPU_METHOD Def_u_uw_q0p1 "Def_u_uw_q0p1" RAT_FUNC "%8.3" "V" COEFFS 0 10 0 0 0 1 /end COMPU_METHOD
/begin COMPU_METHOD Def_f_uw_b1 "Def_f_uw_b1" RAT_FUNC "%14.5" "-" COEFFS 0 65536 0 0 0 1 /end COMPU_METHOD
/begin COMPU_METHOD Def_f_ub_b1 "Def_f_ub_b1" RAT_FUNC "%6.3" "-" COEFFS 0 256 0 0 0 1 /end COMPU_METHOD
/begin COMPU_METHOD Def_td_ub_q1 "Def_td_ub_q1" RAT_FUNC "%5.2" "s" COEFFS 0 1 0 0 0 1 /end COMPU_METHOD
/begin COMPU_METHOD Def_f_ub_b2 "Def_f_ub_b2" RAT_FUNC "%6.3" "-" COEFFS 0 256 0 0 0 2 /end COMPU_METHOD
/begin COMPU_METHOD Def_f_uw_b2 "Def_f_uw_b2" RAT_FUNC "%14.5" "-" COEFFS 0 65536 0 0 0 2 /end COMPU_METHOD
/begin COMPU_METHOD Def_f_uw_b64 "Def_f_uw_b64" RAT_FUNC "%9.4" "-" COEFFS 0 65536 0 0 0 64 /end COMPU_METHOD
/begin COMPU_METHOD Def_i_uw_q0p08_o200 "Def_i_uw_q0p08_o200" RAT_FUNC "%8.3" "" COEFFS 0 25 5000 0 0 2 /end COMPU_METHOD
/begin COMPU_METHOD Def_u_uw_q0p25em3_o6 "Def_u_uw_q0p25em3_o6" RAT_FUNC "%9.4" "" COEFFS 0 -4000 24000 0 0 -1 /end COMPU_METHOD
/begin COMPU_METHOD Def_ql_uw_q0p0182 "Def_ql_uw_q0p0182" RAT_FUNC "%8.3" "Ah" COEFFS 0 989 0 0 0 18 /end COMPU_METHOD
/begin COMPU_METHOD Def_i_sw_q0p02 "Def_i_sw_q0p02" RAT_FUNC "%8.3" "A" COEFFS 0 50 0 0 0 1 /end COMPU_METHOD
/begin COMPU_METHOD Def_i_uw_q0p02 "Def_i_uw_q0p02" RAT_FUNC "%8.3" "A" COEFFS 0 1 0 0 0 0.02 /end COMPU_METHOD
/begin COMPU_METHOD Def_i_ub_q5p12 "Def_i_ub_q5p12" RAT_FUNC "%5.2" "" COEFFS 0 25 0 0 0 128 /end COMPU_METHOD
/begin COMPU_METHOD Def_ac_sb_q0p25 "Def_ac_sb_q0p25" RAT_FUNC "%4.1" "-" COEFFS 0 4 0 0 0 1 /end COMPU_METHOD
/begin COMPU_METHOD Def_km_sw_q10 "Def_km_sw_q10" RAT_FUNC "%6.1" "km" COEFFS 0 1 0 0 0 10 /end COMPU_METHOD
/begin COMPU_METHOD Def_km_ub_q1000 "Def_km_ub_q1000" RAT_FUNC "%3.0" "km" COEFFS 0 1 0 0 0 1000 /end COMPU_METHOD
/begin COMPU_METHOD Def_km_uw_q10 "Def_km_uw_q10" RAT_FUNC "%5.0" "km" COEFFS 0 1 0 0 0 10 /end COMPU_METHOD
/begin COMPU_METHOD Def_f_ub_b127p5 "Def_f_ub_b127p5" RAT_FUNC "%5.2" "%" COEFFS 0 2 0 0 0 1 /end COMPU_METHOD
/begin COMPU_METHOD Def_td_uw_q0p01 "Def_td_uw_q0p01" RAT_FUNC "%7.2" "s" COEFFS 0 100 0 0 0 1 /end COMPU_METHOD
/begin COMPU_METHOD Def_td_uw_q0p1 "Def_td_uw_q0p1" RAT_FUNC "%6.1" "s" COEFFS 0 10 0 0 0 1 /end COMPU_METHOD
/begin COMPU_METHOD Def_t_sw_q0p01 "Def_t_sw_q0p01" RAT_FUNC "%7.2" "°C" COEFFS 0 100 0 0 0 1 /end COMPU_METHOD
/begin COMPU_METHOD Def_u_sw_b128 "Def_u_sw_b128" RAT_FUNC "%8.3" "V" COEFFS 0 256 0 0 0 1 /end COMPU_METHOD
/begin COMPU_METHOD Def_u_ub_q0p0942 "Def_u_ub_q0p0942" RAT_FUNC "%7.4" "V" COEFFS 0 1 0 0 0 0.0942 /end COMPU_METHOD
/begin COMPU_METHOD Def_i_ub_q10 "Def_i_ub_q10" RAT_FUNC "%5.2" "A" COEFFS 0 1 0 0 0 10 /end COMPU_METHOD
/begin COMPU_METHOD Def_lf_ub_q0p01 "Def_lf_ub_q0p01" RAT_FUNC "%5.2" "-" COEFFS 0 100 0 0 0 1 /end COMPU_METHOD
/begin COMPU_METHOD Def_tn_uw_q1 "Def_tn_uw_q1" RAT_FUNC "%7.2" "min" COEFFS 0 1 0 0 0 1 /end COMPU_METHOD
/begin COMPU_METHOD Def_f_ub_b32 "Def_f_ub_b32" RAT_FUNC "%5.2" "-" COEFFS 0 256 0 0 0 32 /end COMPU_METHOD
/begin COMPU_METHOD Def_f_sw_b100 "Def_f_sw_b100" RAT_FUNC "%8.3" "-" COEFFS 0 32768 0 0 0 100 /end COMPU_METHOD
/begin COMPU_METHOD Def_p_uw_q039 "Def_p_uw_q039" RAT_FUNC "%8.3" "hPa" COEFFS 0 256 0 0 0 10 /end COMPU_METHOD
/begin COMPU_METHOD Def_dez_sw_q1 "Def_dez_sw_q1" RAT_FUNC "%5.0" "-" COEFFS 0 1 0 0 0 1 /end COMPU_METHOD
/begin COMPU_METHOD Def_niv_ub_b75 "Def_niv_ub_b75" RAT_FUNC "%5.2" "" COEFFS 0 256 0 0 0 75 /end COMPU_METHOD
/begin COMPU_METHOD Def_perm_uw_b6 "Def_perm_uw_b6" RAT_FUNC "%14.5" "-" COEFFS 0 65536 0 0 0 6 /end COMPU_METHOD
/begin COMPU_METHOD Def_dez_sb_q1 "Def_dez_sb_q1" RAT_FUNC "%3.0" "-" COEFFS 0 1 0 0 0 1 /end COMPU_METHOD
/begin COMPU_METHOD Def_niv_ub_b8 "Def_niv_ub_b8" RAT_FUNC "%5.2" "" COEFFS 0 256 0 0 0 8 /end COMPU_METHOD
/begin COMPU_METHOD Def_f_sw_b8 "Def_f_sw_b8" RAT_FUNC "%9.4" "-" COEFFS 0 32768 0 0 0 8 /end COMPU_METHOD
/begin COMPU_METHOD Def_f_sw_b64 "Def_f_sw_b64" RAT_FUNC "%8.3" "-" COEFFS 0 65536 0 0 0 128 /end COMPU_METHOD
/begin COMPU_METHOD Def_f_uw_b10 "Def_f_uw_b10" RAT_FUNC "%9.4" "%" COEFFS 0 65536 0 0 0 10 /end COMPU_METHOD
/begin COMPU_METHOD Def_niv_uw_q0p1 "Def_niv_uw_q0p1" RAT_FUNC "%6.1" "l" COEFFS 0 10 0 0 0 1 /end COMPU_METHOD
/begin COMPU_METHOD Def_td_ub_q0p5 "Def_td_ub_q0p5" RAT_FUNC "%6.3" "s" COEFFS 0 2 0 0 0 1 /end COMPU_METHOD
/begin COMPU_METHOD Def_f_sw_b32 "Def_f_sw_b32" RAT_FUNC "%9.4" "-" COEFFS 0 32768 0 0 0 32 /end COMPU_METHOD
/begin COMPU_METHOD Def_f_ub_b0p5 "Def_f_ub_b0p5" RAT_FUNC "%6.3" "-" COEFFS 0 256 0 0 0 0.5 /end COMPU_METHOD
/begin COMPU_METHOD Def_f_ub_b0p25 "Def_f_ub_b0p25" RAT_FUNC "%7.4" "-" COEFFS 0 256 0 0 0 0.25 /end COMPU_METHOD
/begin COMPU_METHOD Def_f_sw_b1 "Def_f_sw_b1" RAT_FUNC "%14.5" "-" COEFFS 0 65536 0 0 0 2 /end COMPU_METHOD
/begin COMPU_METHOD Def_niv_sb_b37p5 "Def_niv_sb_b37p5" RAT_FUNC "%5.2" "" COEFFS 0 256 0 0 0 75 /end COMPU_METHOD
/begin COMPU_METHOD Def_niv_uw_b75 "Def_niv_uw_b75" RAT_FUNC "%7.2" "mm" COEFFS 0 256 0 0 0 75 /end COMPU_METHOD
/begin COMPU_METHOD Def_niv_sw_b37p5 "Def_niv_sw_b37p5" RAT_FUNC "%7.2" "" COEFFS 0 256 0 0 0 75 /end COMPU_METHOD
/begin COMPU_METHOD Def_perm_sw_b6 "Def_perm_sw_b6" RAT_FUNC "%9.4" "-" COEFFS 0 65536 0 0 0 12 /end COMPU_METHOD
/begin COMPU_METHOD Def_td_uw_q1 "Def_td_uw_q1" RAT_FUNC "%5.0" "s" COEFFS 0 1 0 0 0 1 /end COMPU_METHOD
/begin COMPU_METHOD Def_fuel_ul_q0p000122 "Def_fuel_ul_q0p000122" RAT_FUNC "%11.4" "" COEFFS 0 8192 0 0 0 1 /end COMPU_METHOD
/begin COMPU_METHOD Def_kw_ub_q0p0234 "Def_kw_ub_q0p0234" RAT_FUNC "%6.3" "°KW" COEFFS 0 256 0 0 0 6 /end COMPU_METHOD
/begin COMPU_METHOD Def_ql_uw_q0p29127 "Def_ql_uw_q0p29127" RAT_FUNC "%7.2" "" COEFFS 0 103 0 0 0 30 /end COMPU_METHOD
/begin COMPU_METHOD Def_td_uw_q56 "Def_td_uw_q56" RAT_FUNC "%7.2" "s" COEFFS 0 1 0 0 0 56 /end COMPU_METHOD
/begin COMPU_METHOD Def_td_uw_q0p933 "Def_td_uw_q0p933" RAT_FUNC "%7.2" "min" COEFFS 0 15 0 0 0 14 /end COMPU_METHOD
/begin COMPU_METHOD Def_td_uw_q14 "Def_td_uw_q14" RAT_FUNC "%7.2" "s" COEFFS 0 1 0 0 0 14 /end COMPU_METHOD
/begin COMPU_METHOD Def_ql_ub_q1 "Def_ql_ub_q1" RAT_FUNC "%4.1" "" COEFFS 0 1 0 0 0 1 /end COMPU_METHOD
/begin COMPU_METHOD Def_i_ub_q0p00125 "Def_i_ub_q0p00125" RAT_FUNC "%6.3" "" COEFFS 0 800 0 0 0 1 /end COMPU_METHOD
/begin COMPU_METHOD Def_td_ub_q14p9333 "Def_td_ub_q14p9333" RAT_FUNC "%5.2" "min" COEFFS 0 15 0 0 0 224 /end COMPU_METHOD
/begin COMPU_METHOD Def_f_sw_q0p00153 "Def_f_sw_q0p00153" RAT_FUNC "%8.3" "-" COEFFS 0 32768 0 0 0 50 /end COMPU_METHOD
/begin COMPU_METHOD Def_u_sw_q0p00025 "Def_u_sw_q0p00025" RAT_FUNC "%9.4" "" COEFFS 0 4000 0 0 0 1 /end COMPU_METHOD
/begin COMPU_METHOD Def_td_ub_q0p9333 "Def_td_ub_q0p9333" RAT_FUNC "%7.4" "min" COEFFS 0 15 0 0 0 14 /end COMPU_METHOD
/begin COMPU_METHOD Def_f_sl_q0p007 "Def_f_sl_q0p007" RAT_FUNC "%10.3" "" COEFFS 0 65536 0 0 0 512 /end COMPU_METHOD
/begin COMPU_METHOD Def_f_sw_p0q25 "Def_f_sw_p0q25" RAT_FUNC "%7.2" "" COEFFS 0 4 0 0 0 1 /end COMPU_METHOD
/begin COMPU_METHOD Def_f_sw_q0p000147 "Def_f_sw_q0p000147" RAT_FUNC "%9.4" "-" COEFFS 0 64 0 0 0 0.0942 /end COMPU_METHOD
/begin COMPU_METHOD Def_f_uw_q0p25 "Def_f_uw_q0p25" RAT_FUNC "%8.3" "" COEFFS 0 4 0 0 0 1 /end COMPU_METHOD
/begin COMPU_METHOD Def_u_uw_q0p015 "Def_u_uw_q0p015" RAT_FUNC "%8.3" "V" COEFFS 0 200 0 0 0 3 /end COMPU_METHOD
/begin COMPU_METHOD Def_u_sb_q0p0942 "Def_u_sb_q0p0942" RAT_FUNC "%7.4" "V" COEFFS 0 1 0 0 0 0.0942 /end COMPU_METHOD
/begin COMPU_METHOD Def_ql_ul_q2p7Em7 "Def_ql_ul_q2p7Em7" RAT_FUNC "%11.4" "Ah" COEFFS 0 3600000 0 0 0 1 /end COMPU_METHOD
/begin COMPU_METHOD Def_f_ub_q0p001 "Def_f_ub_q0p001" RAT_FUNC "%6.3" "" COEFFS 0 1000 0 0 0 1 /end COMPU_METHOD
/begin COMPU_METHOD Def_i_ub_b1000 "Def_i_ub_b1000" RAT_FUNC "%6.3" "A" COEFFS 0 256 0 0 0 1000 /end COMPU_METHOD
/begin COMPU_VTAB Def_bit_ub_0_VTAB "Def_bit_ub_0_VTAB" TAB_VERB 2 0 "FALSE" 1 "TRUE" /end COMPU_VTAB
/begin COMPU_VTAB Def_bit_ub_1_VTAB "Def_bit_ub_1_VTAB" TAB_VERB 2 0 "FALSE" 1 "TRUE" /end COMPU_VTAB
/begin COMPU_VTAB Def_bit_ub_2_VTAB "Def_bit_ub_2_VTAB" TAB_VERB 2 0 "FALSE" 1 "TRUE" /end COMPU_VTAB
/begin COMPU_VTAB Def_bit_ub_3_VTAB "Def_bit_ub_3_VTAB" TAB_VERB 2 0 "FALSE" 1 "TRUE" /end COMPU_VTAB
/begin COMPU_VTAB Def_bit_ub_4_VTAB "Def_bit_ub_4_VTAB" TAB_VERB 2 0 "FALSE" 1 "TRUE" /end COMPU_VTAB
/begin COMPU_VTAB Def_bit_ub_5_VTAB "Def_bit_ub_5_VTAB" TAB_VERB 2 0 "FALSE" 1 "TRUE" /end COMPU_VTAB
/begin COMPU_VTAB Def_bit_ub_6_VTAB "Def_bit_ub_6_VTAB" TAB_VERB 2 0 "FALSE" 1 "TRUE" /end COMPU_VTAB
/begin COMPU_VTAB Def_bit_ub_7_VTAB "Def_bit_ub_7_VTAB" TAB_VERB 2 0 "FALSE" 1 "TRUE" /end COMPU_VTAB
/begin COMPU_METHOD volAdd_ml_fine "feinere Auflösung des Additivvolumen [ml]" RAT_FUNC "%6.5" "ml" COEFFS 0 1000 0 0 0 1 /end COMPU_METHOD
/begin RECORD_LAYOUT TKW_VV_VV_UW FNC_VALUES 1 UWORD COLUMN_DIR DIRECT /end RECORD_LAYOUT
/begin RECORD_LAYOUT TKW_VV_VV_SW FNC_VALUES 1 SWORD COLUMN_DIR DIRECT /end RECORD_LAYOUT
/begin RECORD_LAYOUT TKL_UW_VV_UB NO_AXIS_PTS_X 1 UBYTE RESERVED 2 BYTE AXIS_PTS_X 3 UWORD INDEX_INCR DIRECT FNC_VALUES 4 UBYTE COLUMN_DIR DIRECT /end RECORD_LAYOUT
/begin RECORD_LAYOUT TKL_UW_VV_UW NO_AXIS_PTS_X 1 UBYTE RESERVED 2 BYTE AXIS_PTS_X 3 UWORD INDEX_INCR DIRECT FNC_VALUES 4 UWORD COLUMN_DIR DIRECT /end RECORD_LAYOUT
/begin RECORD_LAYOUT TKL_SW_VV_UW NO_AXIS_PTS_X 1 UBYTE RESERVED 2 BYTE AXIS_PTS_X 3 SWORD INDEX_INCR DIRECT FNC_VALUES 4 UWORD COLUMN_DIR DIRECT /end RECORD_LAYOUT
/begin RECORD_LAYOUT TKW_VV_VV_UB FNC_VALUES 1 UBYTE COLUMN_DIR DIRECT /end RECORD_LAYOUT
/begin RECORD_LAYOUT TKW_VV_VV_UL FNC_VALUES 1 ULONG COLUMN_DIR DIRECT /end RECORD_LAYOUT
/begin RECORD_LAYOUT TKL_UB_VV_UB NO_AXIS_PTS_X 1 UBYTE RESERVED 2 BYTE AXIS_PTS_X 3 UBYTE INDEX_INCR DIRECT FNC_VALUES 4 UBYTE COLUMN_DIR DIRECT /end RECORD_LAYOUT
/begin RECORD_LAYOUT TKL_UW_VV_SW NO_AXIS_PTS_X 1 UBYTE RESERVED 2 BYTE AXIS_PTS_X 3 UWORD INDEX_INCR DIRECT FNC_VALUES 4 SWORD COLUMN_DIR DIRECT /end RECORD_LAYOUT
/begin RECORD_LAYOUT TKL_SW_VV_UB NO_AXIS_PTS_X 1 UBYTE RESERVED 2 BYTE AXIS_PTS_X 3 SWORD INDEX_INCR DIRECT FNC_VALUES 4 UBYTE COLUMN_DIR DIRECT /end RECORD_LAYOUT
/begin RECORD_LAYOUT TKF_SW_SW_UW NO_AXIS_PTS_X 1 UBYTE NO_AXIS_PTS_Y 2 UBYTE AXIS_PTS_X 3 SWORD INDEX_INCR DIRECT AXIS_PTS_Y 4 SWORD INDEX_INCR DIRECT FNC_VALUES 5 UWORD COLUMN_DIR DIRECT /end RECORD_LAYOUT
/begin RECORD_LAYOUT TKL_SW_VV_SW NO_AXIS_PTS_X 1 UBYTE RESERVED 2 BYTE AXIS_PTS_X 3 SWORD INDEX_INCR DIRECT FNC_VALUES 4 SWORD COLUMN_DIR DIRECT /end RECORD_LAYOUT
/begin RECORD_LAYOUT TKF_UW_SW_UB NO_AXIS_PTS_X 1 UBYTE NO_AXIS_PTS_Y 2 UBYTE AXIS_PTS_X 3 SWORD INDEX_INCR DIRECT AXIS_PTS_Y 4 UWORD INDEX_INCR DIRECT FNC_VALUES 5 UBYTE COLUMN_DIR DIRECT /end RECORD_LAYOUT
/begin RECORD_LAYOUT TKW_VV_VV_SB FNC_VALUES 1 SBYTE COLUMN_DIR DIRECT /end RECORD_LAYOUT
/begin RECORD_LAYOUT TKL_SW_VV_SB NO_AXIS_PTS_X 1 UBYTE RESERVED 2 BYTE AXIS_PTS_X 3 SWORD INDEX_INCR DIRECT FNC_VALUES 4 SBYTE COLUMN_DIR DIRECT /end RECORD_LAYOUT
/begin RECORD_LAYOUT TKF_UW_SW_SW NO_AXIS_PTS_X 1 UBYTE NO_AXIS_PTS_Y 2 UBYTE AXIS_PTS_X 3 SWORD INDEX_INCR DIRECT AXIS_PTS_Y 4 UWORD INDEX_INCR DIRECT FNC_VALUES 5 SWORD COLUMN_DIR DIRECT /end RECORD_LAYOUT
/begin RECORD_LAYOUT TKL_UB_VV_SW NO_AXIS_PTS_X 1 UBYTE RESERVED 2 BYTE AXIS_PTS_X 3 UBYTE INDEX_INCR DIRECT FNC_VALUES 4 SWORD COLUMN_DIR DIRECT /end RECORD_LAYOUT
/begin RECORD_LAYOUT TKF_SW_UW_UW NO_AXIS_PTS_X 1 UBYTE NO_AXIS_PTS_Y 2 UBYTE AXIS_PTS_X 3 UWORD INDEX_INCR DIRECT AXIS_PTS_Y 4 SWORD INDEX_INCR DIRECT FNC_VALUES 5 UWORD COLUMN_DIR DIRECT /end RECORD_LAYOUT
/begin RECORD_LAYOUT TKL_UB_VV_UW NO_AXIS_PTS_X 1 UBYTE RESERVED 2 BYTE AXIS_PTS_X 3 UBYTE INDEX_INCR DIRECT FNC_VALUES 4 UWORD COLUMN_DIR DIRECT /end RECORD_LAYOUT
/begin RECORD_LAYOUT TKF_UW_SW_UW NO_AXIS_PTS_X 1 UBYTE NO_AXIS_PTS_Y 2 UBYTE AXIS_PTS_X 3 SWORD INDEX_INCR DIRECT AXIS_PTS_Y 4 UWORD INDEX_INCR DIRECT FNC_VALUES 5 UWORD COLUMN_DIR DIRECT /end RECORD_LAYOUT
/end MODULE
/end PROJECT
