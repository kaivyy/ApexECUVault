ASAP2_VERSION 1 3
/begin PROJECT P389 "BMW DDE6.0 4-Zylinder V70.2 30.03.2004"
/begin HEADER "" VERSION "V70.2_4Z" PROJECT_NO P389 /end HEADER
/begin MODULE DIM ""
/begin MOD_COMMON "" BYTE_ORDER MSB_FIRST ALIGNMENT_BYTE 1 ALIGNMENT_WORD 2 ALIGNMENT_LONG 4 ALIGNMENT_FLOAT32_IEEE 4 /end MOD_COMMON
/begin CHARACTERISTIC DSM_SdwDfp_Layer_TANS_C "Enprellzeit Shadow Zustand für Fehlerpfad Dfp_Layer_TANS" VALUE 0xCCE5A Kw_Wu16 655350.0 Time_ms 0.00 655350.0 FORMAT "%8.1" /end CHARACTERISTIC
/begin CHARACTERISTIC DSM_SdwDfp_ACCDCmpr_C "Enprellzeit Shadow Zustand für Fehlerpfad Dfp_ACCDCmpr" VALUE 0xCCE5C Kw_Wu16 655350.0 Time_ms 0.00 655350.0 FORMAT "%8.1" /end CHARACTERISTIC
/begin CHARACTERISTIC DSM_SdwDfp_ACCDPres_C "Enprellzeit Shadow Zustand für Fehlerpfad Dfp_ACCDPres" VALUE 0xCCE5E Kw_Wu16 655350.0 Time_ms 0.00 655350.0 FORMAT "%8.1" /end CHARACTERISTIC
/begin CHARACTERISTIC DSM_SdwDfp_ACCDPres1_C "Enprellzeit Shadow Zustand für Fehlerpfad Dfp_ACCDPres1" VALUE 0xCCE60 Kw_Wu16 655350.0 Time_ms 0.00 655350.0 FORMAT "%8.1" /end CHARACTERISTIC
/begin CHARACTERISTIC DSM_SdwDfp_ACCDPresAna_C "Enprellzeit Shadow Zustand für Fehlerpfad Dfp_ACCDPresAna" VALUE 0xCCE62 Kw_Wu16 655350.0 Time_ms 0.00 655350.0 FORMAT "%8.1" /end CHARACTERISTIC
/begin CHARACTERISTIC DSM_SdwDfp_ACCDSwtin_C "Enprellzeit Shadow Zustand für Fehlerpfad Dfp_ACCDSwtin" VALUE 0xCCE64 Kw_Wu16 655350.0 Time_ms 0.00 655350.0 FORMAT "%8.1" /end CHARACTERISTIC
/begin CHARACTERISTIC DSM_SdwDfp_ACC_PlausTrqDes_C "Enprellzeit Shadow Zustand für Fehlerpfad Dfp_ACC_PlausTrqDes" VALUE 0xCCE66 Kw_Wu16 655350.0 Time_ms 0.00 655350.0 FORMAT "%8.1" /end CHARACTERISTIC
/begin CHARACTERISTIC DSM_SdwDfp_ACC_trqInr_C "Enprellzeit Shadow Zustand für Fehlerpfad Dfp_ACC_trqInr" VALUE 0xCCE68 Kw_Wu16 655350.0 Time_ms 0.00 655350.0 FORMAT "%8.1" /end CHARACTERISTIC
/begin CHARACTERISTIC DSM_SdwDfp_ACTrq_C "Enprellzeit Shadow Zustand für Fehlerpfad Dfp_ACTrq" VALUE 0xCCE6A Kw_Wu16 655350.0 Time_ms 0.00 655350.0 FORMAT "%8.1" /end CHARACTERISTIC
/begin CHARACTERISTIC DSM_SdwDfp_ADCMon_C "Enprellzeit Shadow Zustand für Fehlerpfad Dfp_ADCMon" VALUE 0xCCE6C Kw_Wu16 655350.0 Time_ms 0.00 655350.0 FORMAT "%8.1" /end CHARACTERISTIC
/begin CHARACTERISTIC DSM_SdwDfp_AFSCDIdlAdjVal_C "Enprellzeit Shadow Zustand für Fehlerpfad Dfp_AFSCDIdlAdjVal" VALUE 0xCCE6E Kw_Wu16 655350.0 Time_ms 0.00 655350.0 FORMAT "%8.1" /end CHARACTERISTIC
/begin CHARACTERISTIC DSM_SdwDfp_AFSCDLdAdjVal_C "Enprellzeit Shadow Zustand für Fehlerpfad Dfp_AFSCDLdAdjVal" VALUE 0xCCE70 Kw_Wu16 655350.0 Time_ms 0.00 655350.0 FORMAT "%8.1" /end CHARACTERISTIC
/begin CHARACTERISTIC DSM_SdwDfp_AFSCD_AirTempDcyc_C "Enprellzeit Shadow Zustand für Fehlerpfad Dfp_AFSCD_AirTempDcyc" VALUE 0xCCE72 Kw_Wu16 655350.0 Time_ms 0.00 655350.0 FORMAT "%8.1" /end CHARACTERISTIC
/begin CHARACTERISTIC DSM_SdwDfp_AFSCD_PlOffsDrft_C "Enprellzeit Shadow Zustand für Fehlerpfad Dfp_AFSCD_PlOffsDrft" VALUE 0xCCE74 Kw_Wu16 655350.0 Time_ms 0.00 655350.0 FORMAT "%8.1" /end CHARACTERISTIC
/begin CHARACTERISTIC DSM_SdwDfp_AFSCD_PlSetyDrft_C "Enprellzeit Shadow Zustand für Fehlerpfad Dfp_AFSCD_PlSetyDrft" VALUE 0xCCE76 Kw_Wu16 655350.0 Time_ms 0.00 655350.0 FORMAT "%8.1" /end CHARACTERISTIC
/begin CHARACTERISTIC DSM_SdwDfp_AFSCD_SRCAirTemp_C "Enprellzeit Shadow Zustand für Fehlerpfad Dfp_AFSCD_SRCAirTemp" VALUE 0xCCE78 Kw_Wu16 655350.0 Time_ms 0.00 655350.0 FORMAT "%8.1" /end CHARACTERISTIC
/begin CHARACTERISTIC DSM_SdwDfp_AFSCD_SRCBatt_C "Enprellzeit Shadow Zustand für Fehlerpfad Dfp_AFSCD_SRCBatt" VALUE 0xCCE7A Kw_Wu16 655350.0 Time_ms 0.00 655350.0 FORMAT "%8.1" /end CHARACTERISTIC
/begin CHARACTERISTIC DSM_SdwDfp_AFSCD_SRCCorrAirm_C "Enprellzeit Shadow Zustand für Fehlerpfad Dfp_AFSCD_SRCCorrAirm" VALUE 0xCCE7C Kw_Wu16 655350.0 Time_ms 0.00 655350.0 FORMAT "%8.1" /end CHARACTERISTIC
/begin CHARACTERISTIC DSM_SdwDfp_AFSCD_SRCRawAirm_C "Enprellzeit Shadow Zustand für Fehlerpfad Dfp_AFSCD_SRCRawAirm" VALUE 0xCCE7E Kw_Wu16 655350.0 Time_ms 0.00 655350.0 FORMAT "%8.1" /end CHARACTERISTIC
/begin CHARACTERISTIC DSM_SdwDfp_Layer_TUMG_C "Enprellzeit Shadow Zustand für Fehlerpfad Dfp_Layer_TUMG" VALUE 0xCCE80 Kw_Wu16 655350.0 Time_ms 0.00 655350.0 FORMAT "%8.1" /end CHARACTERISTIC
/begin CHARACTERISTIC DSM_SdwDfp_AFSCD_SRCRefSigPer_C "Enprellzeit Shadow Zustand für Fehlerpfad Dfp_AFSCD_SRCRefSigPer" VALUE 0xCCE82 Kw_Wu16 655350.0 Time_ms 0.00 655350.0 FORMAT "%8.1" /end CHARACTERISTIC
/begin CHARACTERISTIC DSM_SdwDfp_AOHtCD_C "Enprellzeit Shadow Zustand für Fehlerpfad Dfp_AOHtCD" VALUE 0xCCE84 Kw_Wu16 655350.0 Time_ms 0.00 655350.0 FORMAT "%8.1" /end CHARACTERISTIC
/begin CHARACTERISTIC DSM_SdwDfp_Layer_GEN_C "Enprellzeit Shadow Zustand für Fehlerpfad Dfp_Layer_GEN" VALUE 0xCCE86 Kw_Wu16 655350.0 Time_ms 0.00 655350.0 FORMAT "%8.1" /end CHARACTERISTIC
/begin CHARACTERISTIC DSM_SdwDfp_Layer_BSD_C "Enprellzeit Shadow Zustand für Fehlerpfad Dfp_Layer_BSD" VALUE 0xCCE88 Kw_Wu16 655350.0 Time_ms 0.00 655350.0 FORMAT "%8.1" /end CHARACTERISTIC
/begin CHARACTERISTIC DSM_SdwDfp_AOHtCD_AOHtDia1_C "Enprellzeit Shadow Zustand für Fehlerpfad Dfp_AOHtCD_AOHtDia1" VALUE 0xCCE8A Kw_Wu16 655350.0 Time_ms 0.00 655350.0 FORMAT "%8.1" /end CHARACTERISTIC
/begin CHARACTERISTIC DSM_SdwDfp_AOHtCD_AOHtDia2_C "Enprellzeit Shadow Zustand für Fehlerpfad Dfp_AOHtCD_AOHtDia2" VALUE 0xCCE8C Kw_Wu16 655350.0 Time_ms 0.00 655350.0 FORMAT "%8.1" /end CHARACTERISTIC
/begin CHARACTERISTIC DSM_SdwDfp_AOHtCD_AOHtDia3_C "Enprellzeit Shadow Zustand für Fehlerpfad Dfp_AOHtCD_AOHtDia3" VALUE 0xCCE8E Kw_Wu16 655350.0 Time_ms 0.00 655350.0 FORMAT "%8.1" /end CHARACTERISTIC
/begin CHARACTERISTIC DSM_SdwDfp_APP1_C "Enprellzeit Shadow Zustand für Fehlerpfad Dfp_APP1" VALUE 0xCCE90 Kw_Wu16 655350.0 Time_ms 0.00 655350.0 FORMAT "%8.1" /end CHARACTERISTIC
/begin CHARACTERISTIC DSM_SdwDfp_APP2_C "#SSD Enprellzeit Shadow Zustand für Fehlerpfad Dfp_APP2" VALUE 0xCCE92 Kw_Wu16 655350.0 Time_ms 0.00 655350.0 FORMAT "%8.1" /end CHARACTERISTIC
/begin CHARACTERISTIC DSM_SdwDfp_APPSync_C "Enprellzeit Shadow Zustand für Fehlerpfad Dfp_APPSync" VALUE 0xCCE94 Kw_Wu16 655350.0 Time_ms 0.00 655350.0 FORMAT "%8.1" /end CHARACTERISTIC
/begin CHARACTERISTIC DSM_SdwDfp_APSCD_C "Enprellzeit Shadow Zustand für Fehlerpfad Dfp_APSCD" VALUE 0xCCE96 Kw_Wu16 655350.0 Time_ms 0.00 655350.0 FORMAT "%8.1" /end CHARACTERISTIC
/begin CHARACTERISTIC DSM_SdwDfp_ARS_C "Enprellzeit Shadow Zustand für Fehlerpfad Dfp_ARS" VALUE 0xCCE98 Kw_Wu16 655350.0 Time_ms 0.00 655350.0 FORMAT "%8.1" /end CHARACTERISTIC
/begin CHARACTERISTIC DSM_SdwDfp_AccPedPlausBrk_C "Enprellzeit Shadow Zustand für Fehlerpfad Dfp_AccPedPlausBrk" VALUE 0xCCE9A Kw_Wu16 655350.0 Time_ms 0.00 655350.0 FORMAT "%8.1" /end CHARACTERISTIC
/begin CHARACTERISTIC DSM_SdwDfp_AirCtlGvnrDvtRgnMax_C "Enprellzeit Shadow Zustand für Fehlerpfad Dfp_AirCtlGvnrDvtRgnMax" VALUE 0xCCE9C Kw_Wu16 655350.0 Time_ms 0.00 655350.0 FORMAT "%8.1" /end CHARACTERISTIC
/begin CHARACTERISTIC DSM_SdwDfp_Layer_QLT_C "Enprellzeit Shadow Zustand für Fehlerpfad Dfp_Layer_QLT" VALUE 0xCCE9E Kw_Wu16 655350.0 Time_ms 0.00 655350.0 FORMAT "%8.1" /end CHARACTERISTIC
/begin CHARACTERISTIC DSM_SdwDfp_AirCtlGvnrDvtRgnMax2_C "" VALUE 0xCCEA0 Kw_Wu16 655350.0 Time_ms 0.00 655350.0 FORMAT "%8.1" /end CHARACTERISTIC
/begin CHARACTERISTIC DSM_SdwDfp_Layer_IBS1_C "Enprellzeit Shadow Zustand für Fehlerpfad Dfp_Layer_IBS1" VALUE 0xCCEA2 Kw_Wu16 655350.0 Time_ms 0.00 655350.0 FORMAT "%8.1" /end CHARACTERISTIC
/begin CHARACTERISTIC DSM_SdwDfp_Layer_IBS2_C "Enprellzeit Shadow Zustand für Fehlerpfad Dfp_Layer_IBS2" VALUE 0xCCEA4 Kw_Wu16 655350.0 Time_ms 0.00 655350.0 FORMAT "%8.1" /end CHARACTERISTIC
/begin CHARACTERISTIC DSM_SdwDfp_Layer_IBS3_C "Enprellzeit Shadow Zustand für Fehlerpfad Dfp_Layer_IBS3" VALUE 0xCCEA6 Kw_Wu16 655350.0 Time_ms 0.00 655350.0 FORMAT "%8.1" /end CHARACTERISTIC
/begin CHARACTERISTIC DSM_SdwDfp_Layer_PMBN_C "Enprellzeit Shadow Zustand für Fehlerpfad Dfp_Layer_PMBN" VALUE 0xCCEA8 Kw_Wu16 655350.0 Time_ms 0.00 655350.0 FORMAT "%8.1" /end CHARACTERISTIC
/begin CHARACTERISTIC DSM_SdwDfp_Layer_PMBATT_C "Enprellzeit Shadow Zustand für Fehlerpfad Dfp_Layer_PMBATT" VALUE 0xCCEAA Kw_Wu16 655350.0 Time_ms 0.00 655350.0 FORMAT "%8.1" /end CHARACTERISTIC
/begin CHARACTERISTIC DSM_SdwDfp_AirCtlGvnrDvtRgnMin_C "Enprellzeit Shadow Zustand für Fehlerpfad Dfp_AirCtlGvnrDvtRgnMin" VALUE 0xCCEAC Kw_Wu16 655350.0 Time_ms 0.00 655350.0 FORMAT "%8.1" /end CHARACTERISTIC
/begin CHARACTERISTIC DSM_SdwDfp_AirCtlGvnrDvtRgnMin2_C "" VALUE 0xCCEAE Kw_Wu16 655350.0 Time_ms 0.00 655350.0 FORMAT "%8.1" /end CHARACTERISTIC
/begin CHARACTERISTIC DSM_SdwDfp_AirCtlPlateBreak_C "DSM variable for Dfp_AirCtlPlateBreak_mp" VALUE 0xCCEB0 Kw_Wu16 655350.0 Time_ms 0.00 655350.0 FORMAT "%8.1" /end CHARACTERISTIC
/begin CHARACTERISTIC DSM_SdwDfp_AirCtlRmpTO_C "Enprellzeit Shadow Zustand für Fehlerpfad Dfp_AirCtlRmpTO" VALUE 0xCCEB2 Kw_Wu16 655350.0 Time_ms 0.00 655350.0 FORMAT "%8.1" /end CHARACTERISTIC
/begin CHARACTERISTIC DSM_SdwDfp_AirCtl_GovNegDev_C "Enprellzeit Shadow Zustand für Fehlerpfad Dfp_AirCtl_GovNegDev" VALUE 0xCCEB4 Kw_Wu16 655350.0 Time_ms 0.00 655350.0 FORMAT "%8.1" /end CHARACTERISTIC
/begin CHARACTERISTIC DSM_SdwDfp_AirCtl_GovNegDev2_C "Enprellzeit Shadow Zustand für Fehlerpfad Dfp_AirCtl_GovNegDev2" VALUE 0xCCEB6 Kw_Wu16 655350.0 Time_ms 0.00 655350.0 FORMAT "%8.1" /end CHARACTERISTIC
/begin CHARACTERISTIC DSM_SdwDfp_AirCtl_GovPosDev_C "Enprellzeit Shadow Zustand für Fehlerpfad Dfp_AirCtl_GovPosDev" VALUE 0xCCEB8 Kw_Wu16 655350.0 Time_ms 0.00 655350.0 FORMAT "%8.1" /end CHARACTERISTIC
/begin CHARACTERISTIC DSM_SdwDfp_AirCtl_GovPosDev2_C "Enprellzeit Shadow Zustand für Fehlerpfad Dfp_AirCtl_GovPosDev2" VALUE 0xCCEBA Kw_Wu16 655350.0 Time_ms 0.00 655350.0 FORMAT "%8.1" /end CHARACTERISTIC
/begin CHARACTERISTIC DSM_SdwDfp_AltCD_C "Enprellzeit Shadow Zustand für Fehlerpfad Dfp_AltCD" VALUE 0xCCEBC Kw_Wu16 655350.0 Time_ms 0.00 655350.0 FORMAT "%8.1" /end CHARACTERISTIC
/begin CHARACTERISTIC DSM_SdwDfp_AltCD_Load_C "Enprellzeit Shadow Zustand für Fehlerpfad Dfp_AltCD_Load" VALUE 0xCCEBE Kw_Wu16 655350.0 Time_ms 0.00 655350.0 FORMAT "%8.1" /end CHARACTERISTIC
/begin CHARACTERISTIC DSM_SdwDfp_BPACD_BPADia1_C "Enprellzeit Shadow Zustand für Fehlerpfad Dfp_BPACD_BPADia1" VALUE 0xCCEC0 Kw_Wu16 655350.0 Time_ms 0.00 655350.0 FORMAT "%8.1" /end CHARACTERISTIC
/begin CHARACTERISTIC DSM_SdwDfp_BPACD_BPADia2_C "Enprellzeit Shadow Zustand für Fehlerpfad Dfp_BPACD_BPADia2" VALUE 0xCCEC2 Kw_Wu16 655350.0 Time_ms 0.00 655350.0 FORMAT "%8.1" /end CHARACTERISTIC
/begin CHARACTERISTIC DSM_SdwDfp_BPACD_BPADia3_C "Enprellzeit Shadow Zustand für Fehlerpfad Dfp_BPACD_BPADia3" VALUE 0xCCEC4 Kw_Wu16 655350.0 Time_ms 0.00 655350.0 FORMAT "%8.1" /end CHARACTERISTIC
/begin CHARACTERISTIC DSM_SdwDfp_BPACD_Max_C "Enprellzeit Shadow Zustand für Fehlerpfad Dfp_BPACD_Max" VALUE 0xCCEC6 Kw_Wu16 655350.0 Time_ms 0.00 655350.0 FORMAT "%8.1" /end CHARACTERISTIC
/begin CHARACTERISTIC DSM_SdwDfp_BPACD_Min_C "Enprellzeit Shadow Zustand für Fehlerpfad Dfp_BPACD_Min" VALUE 0xCCEC8 Kw_Wu16 655350.0 Time_ms 0.00 655350.0 FORMAT "%8.1" /end CHARACTERISTIC
/begin CHARACTERISTIC DSM_SdwDfp_BPACD_SigNpl_C "Enprellzeit Shadow Zustand für Fehlerpfad Dfp_BPACD_SigNpl" VALUE 0xCCECA Kw_Wu16 655350.0 Time_ms 0.00 655350.0 FORMAT "%8.1" /end CHARACTERISTIC
/begin CHARACTERISTIC DSM_SdwDfp_BPSCD_C "Enprellzeit Shadow Zustand für Fehlerpfad Dfp_BPSCD" VALUE 0xCCECC Kw_Wu16 655350.0 Time_ms 0.00 655350.0 FORMAT "%8.1" /end CHARACTERISTIC
/begin CHARACTERISTIC DSM_SdwDfp_BattCD_C "Enprellzeit Shadow Zustand für Fehlerpfad Dfp_BattCD" VALUE 0xCCECE Kw_Wu16 655350.0 Time_ms 0.00 655350.0 FORMAT "%8.1" /end CHARACTERISTIC
/begin CHARACTERISTIC DSM_SdwDfp_BrkCD_C "Enprellzeit Shadow Zustand für Fehlerpfad Dfp_BrkCD" VALUE 0xCCED0 Kw_Wu16 655350.0 Time_ms 0.00 655350.0 FORMAT "%8.1" /end CHARACTERISTIC
/begin CHARACTERISTIC DSM_SdwDfp_Bss_C "Enprellzeit Shadow Zustand für Fehlerpfad Dfp_Bss" VALUE 0xCCED2 Kw_Wu16 655350.0 Time_ms 0.00 655350.0 FORMAT "%8.1" /end CHARACTERISTIC
/begin CHARACTERISTIC DSM_SdwDfp_CBACD_C "Enprellzeit Shadow Zustand für Fehlerpfad Dfp_CBACD" VALUE 0xCCED4 Kw_Wu16 655350.0 Time_ms 0.00 655350.0 FORMAT "%8.1" /end CHARACTERISTIC
/begin CHARACTERISTIC DSM_SdwDfp_CTSCD_C "Enprellzeit Shadow Zustand für Fehlerpfad Dfp_CTSCD" VALUE 0xCCED6 Kw_Wu16 655350.0 Time_ms 0.00 655350.0 FORMAT "%8.1" /end CHARACTERISTIC
/begin CHARACTERISTIC DSM_SdwDfp_Clg_DynTst_C "Enprellzeit Shadow Zustand für Fehlerpfad Dfp_Clg_DynTst" VALUE 0xCCED8 Kw_Wu16 655350.0 Time_ms 0.00 655350.0 FORMAT "%8.1" /end CHARACTERISTIC
/begin CHARACTERISTIC DSM_SdwDfp_CmbChbMisfire1_C "Enprellzeit Shadow Zustand für Fehlerpfad Dfp_CmbChbMisfire1" VALUE 0xCCEDA Kw_Wu16 655350.0 Time_ms 0.00 655350.0 FORMAT "%8.1" /end CHARACTERISTIC
/begin CHARACTERISTIC DSM_SdwDfp_CmbChbMisfire2_C "Enprellzeit Shadow Zustand für Fehlerpfad Dfp_CmbChbMisfire2" VALUE 0xCCEDC Kw_Wu16 655350.0 Time_ms 0.00 655350.0 FORMAT "%8.1" /end CHARACTERISTIC
/begin CHARACTERISTIC DSM_SdwDfp_CmbChbMisfire3_C "Enprellzeit Shadow Zustand für Fehlerpfad Dfp_CmbChbMisfire3" VALUE 0xCCEDE Kw_Wu16 655350.0 Time_ms 0.00 655350.0 FORMAT "%8.1" /end CHARACTERISTIC
/begin CHARACTERISTIC DSM_SdwDfp_CmbChbMisfire4_C "Enprellzeit Shadow Zustand für Fehlerpfad Dfp_CmbChbMisfire4" VALUE 0xCCEE0 Kw_Wu16 655350.0 Time_ms 0.00 655350.0 FORMAT "%8.1" /end CHARACTERISTIC
/begin CHARACTERISTIC DSM_SdwDfp_CmbChbMisfire5_C "Enprellzeit Shadow Zustand für Fehlerpfad Dfp_CmbChbMisfire5" VALUE 0xCCEE2 Kw_Wu16 655350.0 Time_ms 0.00 655350.0 FORMAT "%8.1" /end CHARACTERISTIC
/begin CHARACTERISTIC DSM_SdwDfp_CmbChbMisfire6_C "Enprellzeit Shadow Zustand für Fehlerpfad Dfp_CmbChbMisfire6" VALUE 0xCCEE4 Kw_Wu16 655350.0 Time_ms 0.00 655350.0 FORMAT "%8.1" /end CHARACTERISTIC
/begin CHARACTERISTIC DSM_SdwDfp_CmbChbMisfireMul_C "Enprellzeit Shadow Zustand für Fehlerpfad Dfp_CmbChbMisfireMul" VALUE 0xCCEE6 Kw_Wu16 655350.0 Time_ms 0.00 655350.0 FORMAT "%8.1" /end CHARACTERISTIC
/begin CHARACTERISTIC DSM_SdwDfp_CoVMDCSh_C "Enprellzeit Shadow Zustand für Fehlerpfad Dfp_CoVMDCSh" VALUE 0xCCEE8 Kw_Wu16 655350.0 Time_ms 0.00 655350.0 FORMAT "%8.1" /end CHARACTERISTIC
/begin CHARACTERISTIC DSM_SdwDfp_ConvCD_C "Enprellzeit Shadow Zustand für Fehlerpfad Dfp_ConvCD" VALUE 0xCCEEA Kw_Wu16 655350.0 Time_ms 0.00 655350.0 FORMAT "%8.1" /end CHARACTERISTIC
/begin CHARACTERISTIC DSM_SdwDfp_Layer_PMRUHVERL_C "Enprellzeit Shadow Zustand für Fehlerpfad Dfp_Layer_PMRUHVERL" VALUE 0xCCEEC Kw_Wu16 655350.0 Time_ms 0.00 655350.0 FORMAT "%8.1" /end CHARACTERISTIC
/begin CHARACTERISTIC DSM_SdwDfp_CrCCDMFL_C "Enprellzeit Shadow Zustand für Fehlerpfad Dfp_CrCCDMFL" VALUE 0xCCEEE Kw_Wu16 655350.0 Time_ms 0.00 655350.0 FORMAT "%8.1" /end CHARACTERISTIC
/begin CHARACTERISTIC DSM_SdwDfp_CrCtl_vCrCtl_C "Enprellzeit Shadow Zustand für Fehlerpfad Dfp_CrCtl_vCrCtl" VALUE 0xCCEF0 Kw_Wu16 655350.0 Time_ms 0.00 655350.0 FORMAT "%8.1" /end CHARACTERISTIC
/begin CHARACTERISTIC DSM_SdwDfp_DCC_PlausTrqDes_C "Enprellzeit Shadow Zustand für Fehlerpfad Dfp_DCC_PlausTrqDes" VALUE 0xCCEF2 Kw_Wu16 655350.0 Time_ms 0.00 655350.0 FORMAT "%8.1" /end CHARACTERISTIC
/begin CHARACTERISTIC DSM_SdwDfp_Dummy1_C "Enprellzeit Shadow Zustand für Fehlerpfad Dfp_Dummy1" VALUE 0xCCEF4 Kw_Wu16 655350.0 Time_ms 0.00 655350.0 FORMAT "%8.1" /end CHARACTERISTIC
/begin CHARACTERISTIC DSM_SdwDfp_Layer_TOENS_C "Enprellzeit Shadow Zustand für Fehlerpfad Dfp_Layer_TOENS" VALUE 0xCCEF6 Kw_Wu16 655350.0 Time_ms 0.00 655350.0 FORMAT "%8.1" /end CHARACTERISTIC
/begin CHARACTERISTIC DSM_SdwDfp_Layer_MANHYDR_C "Enprellzeit Shadow Zustand für Fehlerpfad Dfp_Layer_MANHYDR" VALUE 0xCCEF8 Kw_Wu16 655350.0 Time_ms 0.00 655350.0 FORMAT "%8.1" /end CHARACTERISTIC
/begin CHARACTERISTIC DSM_SdwDfp_Layer_MANLUFT_C "Enprellzeit Shadow Zustand für Fehlerpfad Dfp_Layer_MANLUFT" VALUE 0xCCEFA Kw_Wu16 655350.0 Time_ms 0.00 655350.0 FORMAT "%8.1" /end CHARACTERISTIC
/begin CHARACTERISTIC DSM_SdwDfp_EATSCD_C "Enprellzeit Shadow Zustand für Fehlerpfad Dfp_EATSCD" VALUE 0xCCEFC Kw_Wu16 655350.0 Time_ms 0.00 655350.0 FORMAT "%8.1" /end CHARACTERISTIC
/begin CHARACTERISTIC DSM_SdwDfp_EBAFCD_C "Enprellzeit Shadow Zustand für Fehlerpfad Dfp_EBAFCD" VALUE 0xCCEFE Kw_Wu16 655350.0 Time_ms 0.00 655350.0 FORMAT "%8.1" /end CHARACTERISTIC
/begin CHARACTERISTIC DSM_SdwDfp_EBFCD_C "Enprellzeit Shadow Zustand für Fehlerpfad Dfp_EBFCD" VALUE 0xCCF00 Kw_Wu16 655350.0 Time_ms 0.00 655350.0 FORMAT "%8.1" /end CHARACTERISTIC
/begin CHARACTERISTIC DSM_SdwDfp_EBTSCD_C "Enprellzeit Shadow Zustand für Fehlerpfad Dfp_EBTSCD" VALUE 0xCCF02 Kw_Wu16 655350.0 Time_ms 0.00 655350.0 FORMAT "%8.1" /end CHARACTERISTIC
/begin CHARACTERISTIC DSM_SdwDfp_EBTSCD_OvrTemp_C "Enprellzeit Shadow Zustand für Fehlerpfad Dfp_EBTSCD_OvrTemp" VALUE 0xCCF04 Kw_Wu16 655350.0 Time_ms 0.00 655350.0 FORMAT "%8.1" /end CHARACTERISTIC
/begin CHARACTERISTIC DSM_SdwDfp_EEPCDVarMng_C "Enprellzeit Shadow Zustand für Fehlerpfad Dfp_EEPCDVarMng" VALUE 0xCCF06 Kw_Wu16 655350.0 Time_ms 0.00 655350.0 FORMAT "%8.1" /end CHARACTERISTIC
/begin CHARACTERISTIC DSM_SdwDfp_EGPpCD_C "Enprellzeit Shadow Zustand für Fehlerpfad Dfp_EGPpCD" VALUE 0xCCF08 Kw_Wu16 655350.0 Time_ms 0.00 655350.0 FORMAT "%8.1" /end CHARACTERISTIC
/begin CHARACTERISTIC DSM_SdwDfp_EGPpCDTPreTrbn_C "Enprellzeit Shadow Zustand für Fehlerpfad Dfp_EgPpCDTPreTrbn" VALUE 0xCCF0A Kw_Wu16 655350.0 Time_ms 0.00 655350.0 FORMAT "%8.1" /end CHARACTERISTIC
/begin CHARACTERISTIC DSM_SdwDfp_EGRCD_Max_C "Enprellzeit Shadow Zustand für Fehlerpfad Dfp_EGRCD_Max" VALUE 0xCCF0C Kw_Wu16 655350.0 Time_ms 0.00 655350.0 FORMAT "%8.1" /end CHARACTERISTIC
/begin CHARACTERISTIC DSM_SdwDfp_EGRCD_Min_C "Enprellzeit Shadow Zustand für Fehlerpfad Dfp_EGRCD_Min" VALUE 0xCCF0E Kw_Wu16 655350.0 Time_ms 0.00 655350.0 FORMAT "%8.1" /end CHARACTERISTIC
/begin CHARACTERISTIC DSM_SdwDfp_EGRCD_SigNpl_C "Enprellzeit Shadow Zustand für Fehlerpfad Dfp_EGRCD_SigNpl" VALUE 0xCCF10 Kw_Wu16 655350.0 Time_ms 0.00 655350.0 FORMAT "%8.1" /end CHARACTERISTIC
/begin CHARACTERISTIC DSM_SdwDfp_EGTRgnOilDil_C "Enprellzeit Shadow Zustand für Fehlerpfad Dfp_EGTRgnOilDil" VALUE 0xCCF12 Kw_Wu16 655350.0 Time_ms 0.00 655350.0 FORMAT "%8.1" /end CHARACTERISTIC
/begin CHARACTERISTIC DSM_SdwDfp_EMCCDNoLoad1_C "Enprellzeit Shadow Zustand für Fehlerpfad Dfp_EMCCDNoLoad1" VALUE 0xCCF14 Kw_Wu16 655350.0 Time_ms 0.00 655350.0 FORMAT "%8.1" /end CHARACTERISTIC
/begin CHARACTERISTIC DSM_SdwDfp_EMCCDNoLoad2_C "Enprellzeit Shadow Zustand für Fehlerpfad Dfp_EMCCDNoLoad2" VALUE 0xCCF16 Kw_Wu16 655350.0 Time_ms 0.00 655350.0 FORMAT "%8.1" /end CHARACTERISTIC
/begin CHARACTERISTIC DSM_SdwDfp_EMCCDSCBat1_C "Enprellzeit Shadow Zustand für Fehlerpfad Dfp_EMCCDSCBat1" VALUE 0xCCF18 Kw_Wu16 655350.0 Time_ms 0.00 655350.0 FORMAT "%8.1" /end CHARACTERISTIC
/begin CHARACTERISTIC DSM_SdwDfp_EMCCDSCBat2_C "Enprellzeit Shadow Zustand für Fehlerpfad Dfp_EMCCDSCBat2" VALUE 0xCCF1A Kw_Wu16 655350.0 Time_ms 0.00 655350.0 FORMAT "%8.1" /end CHARACTERISTIC
/begin CHARACTERISTIC DSM_SdwDfp_EMCCDSCGnd1_C "Enprellzeit Shadow Zustand für Fehlerpfad Dfp_EMCCDSCGnd1" VALUE 0xCCF1C Kw_Wu16 655350.0 Time_ms 0.00 655350.0 FORMAT "%8.1" /end CHARACTERISTIC
/begin CHARACTERISTIC DSM_SdwDfp_EMCCDSCGnd2_C "Enprellzeit Shadow Zustand für Fehlerpfad Dfp_EMCCDSCGnd2" VALUE 0xCCF1E Kw_Wu16 655350.0 Time_ms 0.00 655350.0 FORMAT "%8.1" /end CHARACTERISTIC
/begin CHARACTERISTIC DSM_SdwDfp_EMCCD_ADC1_C "Enprellzeit Shadow Zustand für Fehlerpfad Dfp_EMCCD_ADC1" VALUE 0xCCF20 Kw_Wu16 655350.0 Time_ms 0.00 655350.0 FORMAT "%8.1" /end CHARACTERISTIC
/begin CHARACTERISTIC DSM_SdwDfp_EMCCD_ADC2_C "Enprellzeit Shadow Zustand für Fehlerpfad Dfp_EMCCD_ADC2" VALUE 0xCCF22 Kw_Wu16 655350.0 Time_ms 0.00 655350.0 FORMAT "%8.1" /end CHARACTERISTIC
/begin CHARACTERISTIC DSM_SdwDfp_ETClbETFltInj1_C "Enprellzeit Shadow Zustand für Fehlerpfad Dfp_ETClbETFltInj1" VALUE 0xCCF24 Kw_Wu16 655350.0 Time_ms 0.00 655350.0 FORMAT "%8.1" /end CHARACTERISTIC
/begin CHARACTERISTIC DSM_SdwDfp_ETClbETFltInj2_C "Enprellzeit Shadow Zustand für Fehlerpfad Dfp_ETClbETFltInj2" VALUE 0xCCF26 Kw_Wu16 655350.0 Time_ms 0.00 655350.0 FORMAT "%8.1" /end CHARACTERISTIC
/begin CHARACTERISTIC DSM_SdwDfp_ETClbETFltInj3_C "Enprellzeit Shadow Zustand für Fehlerpfad Dfp_ETClbETFltInj3" VALUE 0xCCF28 Kw_Wu16 655350.0 Time_ms 0.00 655350.0 FORMAT "%8.1" /end CHARACTERISTIC
/begin CHARACTERISTIC DSM_SdwDfp_ETClbETFltInj4_C "Enprellzeit Shadow Zustand für Fehlerpfad Dfp_ETClbETFltInj4" VALUE 0xCCF2A Kw_Wu16 655350.0 Time_ms 0.00 655350.0 FORMAT "%8.1" /end CHARACTERISTIC
/begin CHARACTERISTIC DSM_SdwDfp_ETClbETFltInj5_C "Enprellzeit Shadow Zustand für Fehlerpfad Dfp_ETClbETFltInj5" VALUE 0xCCF2C Kw_Wu16 655350.0 Time_ms 0.00 655350.0 FORMAT "%8.1" /end CHARACTERISTIC
/begin CHARACTERISTIC DSM_SdwDfp_ETClbETFltInj6_C "Enprellzeit Shadow Zustand für Fehlerpfad Dfp_ETClbETFltInj6" VALUE 0xCCF2E Kw_Wu16 655350.0 Time_ms 0.00 655350.0 FORMAT "%8.1" /end CHARACTERISTIC
/begin CHARACTERISTIC DSM_SdwDfp_ETClbInj1_C "Enprellzeit Shadow Zustand für Fehlerpfad Dfp_ETClbInj1" VALUE 0xCCF30 Kw_Wu16 655350.0 Time_ms 0.00 655350.0 FORMAT "%8.1" /end CHARACTERISTIC
/begin CHARACTERISTIC DSM_SdwDfp_ETClbInj2_C "Enprellzeit Shadow Zustand für Fehlerpfad Dfp_ETClbInj2" VALUE 0xCCF32 Kw_Wu16 655350.0 Time_ms 0.00 655350.0 FORMAT "%8.1" /end CHARACTERISTIC
/begin CHARACTERISTIC DSM_SdwDfp_ETClbInj3_C "Enprellzeit Shadow Zustand für Fehlerpfad Dfp_ETClbInj3" VALUE 0xCCF34 Kw_Wu16 655350.0 Time_ms 0.00 655350.0 FORMAT "%8.1" /end CHARACTERISTIC
/begin CHARACTERISTIC DSM_SdwDfp_ETClbInj4_C "Enprellzeit Shadow Zustand für Fehlerpfad Dfp_ETClbInj4" VALUE 0xCCF36 Kw_Wu16 655350.0 Time_ms 0.00 655350.0 FORMAT "%8.1" /end CHARACTERISTIC
/begin CHARACTERISTIC DSM_SdwDfp_ETClbInj5_C "Enprellzeit Shadow Zustand für Fehlerpfad Dfp_ETClbInj5" VALUE 0xCCF38 Kw_Wu16 655350.0 Time_ms 0.00 655350.0 FORMAT "%8.1" /end CHARACTERISTIC
/begin CHARACTERISTIC DSM_SdwDfp_ETClbInj6_C "Enprellzeit Shadow Zustand für Fehlerpfad Dfp_ETClbInj6" VALUE 0xCCF3A Kw_Wu16 655350.0 Time_ms 0.00 655350.0 FORMAT "%8.1" /end CHARACTERISTIC
/begin CHARACTERISTIC DSM_SdwDfp_EngMCaS1_C "Enprellzeit Shadow Zustand für Fehlerpfad Dfp_EngMCaS1" VALUE 0xCCF3C Kw_Wu16 655350.0 Time_ms 0.00 655350.0 FORMAT "%8.1" /end CHARACTERISTIC
/begin CHARACTERISTIC DSM_SdwDfp_EngMCrS1_C "Enprellzeit Shadow Zustand für Fehlerpfad Dfp_EngMCrS1" VALUE 0xCCF3E Kw_Wu16 655350.0 Time_ms 0.00 655350.0 FORMAT "%8.1" /end CHARACTERISTIC
/begin CHARACTERISTIC DSM_SdwDfp_EngMOfsCaSCrS_C "Enprellzeit Shadow Zustand für Fehlerpfad Dfp_EngMOfsCaSCrS" VALUE 0xCCF40 Kw_Wu16 655350.0 Time_ms 0.00 655350.0 FORMAT "%8.1" /end CHARACTERISTIC
/begin CHARACTERISTIC DSM_SdwDfp_EngPrtFWODet_C "Enprellzeit Shadow Zustand für Fehlerpfad Dfp_EngPrtFWODet" VALUE 0xCCF42 Kw_Wu16 655350.0 Time_ms 0.00 655350.0 FORMAT "%8.1" /end CHARACTERISTIC
/begin CHARACTERISTIC DSM_SdwDfp_FBCqDvt_C "Enprellzeit Shadow Zustand für Fehlerpfad Dfp_FBCqDvt" VALUE 0xCCF44 Kw_Wu16 655350.0 Time_ms 0.00 655350.0 FORMAT "%8.1" /end CHARACTERISTIC
/begin CHARACTERISTIC DSM_SdwDfp_FMTC_NonMonotonMap_C "Enprellzeit Shadow Zustand für Fehlerpfad Dfp_FMTC_NonMonotonMap" VALUE 0xCCF46 Kw_Wu16 655350.0 Time_ms 0.00 655350.0 FORMAT "%8.1" /end CHARACTERISTIC
/begin CHARACTERISTIC DSM_SdwDfp_FTSCD_C "Enprellzeit Shadow Zustand für Fehlerpfad Dfp_FTSCD" VALUE 0xCCF48 Kw_Wu16 655350.0 Time_ms 0.00 655350.0 FORMAT "%8.1" /end CHARACTERISTIC
/begin CHARACTERISTIC DSM_SdwDfp_FanCD_C "Enprellzeit Shadow Zustand für Fehlerpfad Dfp_FanCD" VALUE 0xCCF4A Kw_Wu16 655350.0 Time_ms 0.00 655350.0 FORMAT "%8.1" /end CHARACTERISTIC
/begin CHARACTERISTIC DSM_SdwDfp_FanCD_FanCtlr1_C "Enprellzeit Shadow Zustand für Fehlerpfad Dfp_FanCD_FanCtlr1" VALUE 0xCCF4C Kw_Wu16 655350.0 Time_ms 0.00 655350.0 FORMAT "%8.1" /end CHARACTERISTIC
/begin CHARACTERISTIC DSM_SdwDfp_FanCD_FanCtlr2_C "Enprellzeit Shadow Zustand für Fehlerpfad Dfp_FanCD_FanCtlr2" VALUE 0xCCF4E Kw_Wu16 655350.0 Time_ms 0.00 655350.0 FORMAT "%8.1" /end CHARACTERISTIC
/begin CHARACTERISTIC DSM_SdwDfp_FanCD_FanCtlr3_C "Enprellzeit Shadow Zustand für Fehlerpfad Dfp_FanCD_FanCtlr3" VALUE 0xCCF50 Kw_Wu16 655350.0 Time_ms 0.00 655350.0 FORMAT "%8.1" /end CHARACTERISTIC
/begin CHARACTERISTIC DSM_SdwDfp_FlFCD_C "Enprellzeit Shadow Zustand für Fehlerpfad Dfp_FlFCD" VALUE 0xCCF52 Kw_Wu16 655350.0 Time_ms 0.00 655350.0 FORMAT "%8.1" /end CHARACTERISTIC
/begin CHARACTERISTIC DSM_SdwDfp_FlMngSmkDefect_C "Enprellzeit Shadow Zustand für Fehlerpfad Dfp_FlMngSmkDefect" VALUE 0xCCF54 Kw_Wu16 655350.0 Time_ms 0.00 655350.0 FORMAT "%8.1" /end CHARACTERISTIC
/begin CHARACTERISTIC DSM_SdwDfp_FrmMngANFRADMOMPT_C "Enprellzeit Shadow Zustand für Fehlerpfad Dfp_FrmMngANFRADMOMPT" VALUE 0xCCF56 Kw_Wu16 655350.0 Time_ms 0.00 655350.0 FORMAT "%8.1" /end CHARACTERISTIC
/begin CHARACTERISTIC DSM_SdwDfp_FrmMngASC1_C "Enprellzeit Shadow Zustand für Fehlerpfad Dfp_FrmMngASC1" VALUE 0xCCF58 Kw_Wu16 655350.0 Time_ms 0.00 655350.0 FORMAT "%8.1" /end CHARACTERISTIC
/begin CHARACTERISTIC DSM_SdwDfp_FrmMngASC2_C "Enprellzeit Shadow Zustand für Fehlerpfad Dfp_FrmMngASC2" VALUE 0xCCF5A Kw_Wu16 655350.0 Time_ms 0.00 655350.0 FORMAT "%8.1" /end CHARACTERISTIC
/begin CHARACTERISTIC DSM_SdwDfp_FrmMngASC3_C "Enprellzeit Shadow Zustand für Fehlerpfad Dfp_FrmMngASC3" VALUE 0xCCF5C Kw_Wu16 655350.0 Time_ms 0.00 655350.0 FORMAT "%8.1" /end CHARACTERISTIC
/begin CHARACTERISTIC DSM_SdwDfp_FrmMngASC4_C "Enprellzeit Shadow Zustand für Fehlerpfad Dfp_FrmMngASC4" VALUE 0xCCF5E Kw_Wu16 655350.0 Time_ms 0.00 655350.0 FORMAT "%8.1" /end CHARACTERISTIC
/begin CHARACTERISTIC DSM_SdwDfp_FrmMngBOS_RESET_C "Enprellzeit Shadow Zustand für Fehlerpfad Dfp_FrmMngBOS_RESET" VALUE 0xCCF60 Kw_Wu16 655350.0 Time_ms 0.00 655350.0 FORMAT "%8.1" /end CHARACTERISTIC
/begin CHARACTERISTIC DSM_SdwDfp_FrmMngBOS_RESET_2_C "" VALUE 0xCCF62 Kw_Wu16 655350.0 Time_ms 0.00 655350.0 FORMAT "%8.1" /end CHARACTERISTIC
/begin CHARACTERISTIC DSM_SdwDfp_FrmMngDMANFAFS_C "Enprellzeit Shadow Zustand für Fehlerpfad Dfp_FrmMngDMANFAFS" VALUE 0xCCF64 Kw_Wu16 655350.0 Time_ms 0.00 655350.0 FORMAT "%8.1" /end CHARACTERISTIC
/begin CHARACTERISTIC DSM_SdwDfp_FrmMngDRMANFSSG_C "#SSD Enprellzeit Shadow Zustand für Fehlerpfad Dfp_FrmMngDRMANFSSG" VALUE 0xCCF66 Kw_Wu16 655350.0 Time_ms 0.00 655350.0 FORMAT "%8.1" /end CHARACTERISTIC
/begin CHARACTERISTIC DSM_SdwDfp_FrmMngEGS1_C "Enprellzeit Shadow Zustand für Fehlerpfad Dfp_FrmMngEGS1" VALUE 0xCCF68 Kw_Wu16 655350.0 Time_ms 0.00 655350.0 FORMAT "%8.1" /end CHARACTERISTIC
/begin CHARACTERISTIC DSM_SdwDfp_FrmMngEGS2_C "Enprellzeit Shadow Zustand für Fehlerpfad Dfp_FrmMngEGS2" VALUE 0xCCF6A Kw_Wu16 655350.0 Time_ms 0.00 655350.0 FORMAT "%8.1" /end CHARACTERISTIC
/begin CHARACTERISTIC DSM_SdwDfp_FrmMngGEARBX_DATA_C "Enprellzeit Shadow Zustand für Fehlerpfad Dfp_FrmMngGEARBX_DATA" VALUE 0xCCF6C Kw_Wu16 655350.0 Time_ms 0.00 655350.0 FORMAT "%8.1" /end CHARACTERISTIC
/begin CHARACTERISTIC DSM_SdwDfp_FrmMngGEARBX_DATA2_C "Enprellzeit Shadow Zustand für Fehlerpfad Dfp_FrmMngGEARBX_DATA2" VALUE 0xCCF6E Kw_Wu16 655350.0 Time_ms 0.00 655350.0 FORMAT "%8.1" /end CHARACTERISTIC
/begin CHARACTERISTIC DSM_SdwDfp_FrmMngHEAT_AC_C "Enprellzeit Shadow Zustand für Fehlerpfad Dfp_FrmMngHEAT_AC" VALUE 0xCCF70 Kw_Wu16 655350.0 Time_ms 0.00 655350.0 FORMAT "%8.1" /end CHARACTERISTIC
/begin CHARACTERISTIC DSM_SdwDfp_FrmMngINSTR2_C "Enprellzeit Shadow Zustand für Fehlerpfad Dfp_FrmMngINSTR2" VALUE 0xCCF72 Kw_Wu16 655350.0 Time_ms 0.00 655350.0 FORMAT "%8.1" /end CHARACTERISTIC
/begin CHARACTERISTIC DSM_SdwDfp_FrmMngINSTR3_C "Enprellzeit Shadow Zustand für Fehlerpfad Dfp_FrmMngINSTR3" VALUE 0xCCF74 Kw_Wu16 655350.0 Time_ms 0.00 655350.0 FORMAT "%8.1" /end CHARACTERISTIC
/begin CHARACTERISTIC DSM_SdwDfp_FrmMngLENKRADWINKEL_C "Enprellzeit Shadow Zustand für Fehlerpfad Dfp_FrmMngLENKRADWINKEL" VALUE 0xCCF76 Kw_Wu16 655350.0 Time_ms 0.00 655350.0 FORMAT "%8.1" /end CHARACTERISTIC
/begin CHARACTERISTIC DSM_SdwDfp_FrmMngMILEAGE_RANGE_C "Enprellzeit Shadow Zustand für Fehlerpfad Dfp_FrmMngMILEAGE_RANGE" VALUE 0xCCF78 Kw_Wu16 655350.0 Time_ms 0.00 655350.0 FORMAT "%8.1" /end CHARACTERISTIC
/begin CHARACTERISTIC DSM_SdwDfp_FrmMngOPCRCTLACC_C "#SSD Enprellzeit Shadow Zustand für Fehlerpfad Dfp_FrmMngOPCRCTLACC" VALUE 0xCCF7A Kw_Wu16 655350.0 Time_ms 0.00 655350.0 FORMAT "%8.1" /end CHARACTERISTIC
/begin CHARACTERISTIC DSM_SdwDfp_FrmMngPRGG_CCTR_C "Enprellzeit Shadow Zustand für Fehlerpfad Dfp_FrmMngPRGG_CCTR" VALUE 0xCCF7C Kw_Wu16 655350.0 Time_ms 0.00 655350.0 FORMAT "%8.1" /end CHARACTERISTIC
/begin CHARACTERISTIC DSM_SdwDfp_FrmMngPWRMNG_LOADV_C "Enprellzeit Shadow Zustand für Fehlerpfad Dfp_FrmMngPWRMNG_LOADV" VALUE 0xCCF7E Kw_Wu16 655350.0 Time_ms 0.00 655350.0 FORMAT "%8.1" /end CHARACTERISTIC
/begin CHARACTERISTIC DSM_SdwDfp_FrmMngParkConsumer_C "Entprellzeit Shadow Zusand für Fehlerpfad Dfp_FrmMngParkConsumer" VALUE 0xCCF80 Kw_Wu16 655350.0 Time_ms 0.00 655350.0 FORMAT "%8.1" /end CHARACTERISTIC
/begin CHARACTERISTIC DSM_SdwDfp_FrmMngRQSTGEFAN_C "RQ_STG_EFAN - CAN-message related errors" VALUE 0xCCF82 Kw_Wu16 655350.0 Time_ms 0.00 655350.0 FORMAT "%8.1" /end CHARACTERISTIC
/begin CHARACTERISTIC DSM_SdwDfp_FrmMngSSGErr_C "Enprellzeit Shadow Zustand für Fehlerpfad Dfp_FrmMngSSGErr" VALUE 0xCCF84 Kw_Wu16 655350.0 Time_ms 0.00 655350.0 FORMAT "%8.1" /end CHARACTERISTIC
/begin CHARACTERISTIC DSM_SdwDfp_FrmMngSSGShOff_C "Enprellzeit Shadow Zustand für Fehlerpfad Dfp_FrmMngSSGShOff" VALUE 0xCCF86 Kw_Wu16 655350.0 Time_ms 0.00 655350.0 FORMAT "%8.1" /end CHARACTERISTIC
/begin CHARACTERISTIC DSM_SdwDfp_FrmMngSTAT_ANH_C "Enprellzeit Shadow Zustand für Fehlerpfad Dfp_FrmMngSTAT_ANH" VALUE 0xCCF88 Kw_Wu16 655350.0 Time_ms 0.00 655350.0 FORMAT "%8.1" /end CHARACTERISTIC
/begin CHARACTERISTIC DSM_SdwDfp_FrmMngSTAT_ARS_C "Enprellzeit Shadow Zustand für Fehlerpfad Dfp_FrmMngSTAT_ARS" VALUE 0xCCF8A Kw_Wu16 655350.0 Time_ms 0.00 655350.0 FORMAT "%8.1" /end CHARACTERISTIC
/begin CHARACTERISTIC DSM_SdwDfp_FrmMngSTAT_DSC_C "Enprellzeit Shadow Zustand für Fehlerpfad Dfp_FrmMngSTAT_DSC" VALUE 0xCCF8C Kw_Wu16 655350.0 Time_ms 0.00 655350.0 FORMAT "%8.1" /end CHARACTERISTIC
/begin CHARACTERISTIC DSM_SdwDfp_FrmMngSTAT_EKP_C "Enprellzeit Shadow Zustand für Fehlerpfad Dfp_FrmMngSTAT_EKP" VALUE 0xCCF8E Kw_Wu16 655350.0 Time_ms 0.00 655350.0 FORMAT "%8.1" /end CHARACTERISTIC
/begin CHARACTERISTIC DSM_SdwDfp_FrmMngSTAT_KOMBI_C "Enprellzeit Shadow Zustand für Fehlerpfad Dfp_FrmMngSTAT_KOMBI" VALUE 0xCCF90 Kw_Wu16 655350.0 Time_ms 0.00 655350.0 FORMAT "%8.1" /end CHARACTERISTIC
/begin CHARACTERISTIC DSM_SdwDfp_FrmMngSTAT_SITZ_C "Enprellzeit Shadow Zustand für Fehlerpfad Dfp_FrmMngSTAT_SITZ" VALUE 0xCCF92 Kw_Wu16 655350.0 Time_ms 0.00 655350.0 FORMAT "%8.1" /end CHARACTERISTIC
/begin CHARACTERISTIC DSM_SdwDfp_FrmMngStOBDGbxMilOf_C "Enprellzeit Shadow Zustand für Fehlerpfad Dfp_FrmMngStOBDGbxMilOf" VALUE 0xCCF94 Kw_Wu16 655350.0 Time_ms 0.00 655350.0 FORMAT "%8.1" /end CHARACTERISTIC
/begin CHARACTERISTIC DSM_SdwDfp_FrmMngStOBDGbxMilOn_C "Enprellzeit Shadow Zustand für Fehlerpfad Dfp_FrmMngStOBDGbxMilOn" VALUE 0xCCF96 Kw_Wu16 655350.0 Time_ms 0.00 655350.0 FORMAT "%8.1" /end CHARACTERISTIC
/begin CHARACTERISTIC DSM_SdwDfp_FrmMngTEMPRELTIME_C "Enprellzeit Shadow Zustand für Fehlerpfad Dfp_FrmMngTEMPRELTIME" VALUE 0xCCF98 Kw_Wu16 655350.0 Time_ms 0.00 655350.0 FORMAT "%8.1" /end CHARACTERISTIC
/begin CHARACTERISTIC DSM_SdwDfp_FrmMngTERMINAL_C "Enprellzeit Shadow Zustand für Fehlerpfad Dfp_FrmMngTERMINAL" VALUE 0xCCF9A Kw_Wu16 655350.0 Time_ms 0.00 655350.0 FORMAT "%8.1" /end CHARACTERISTIC
/begin CHARACTERISTIC DSM_SdwDfp_FrmMngTIME_DATE_C "Enprellzeit Shadow Zustand für Fehlerpfad Dfp_FrmMngTIME_DATE" VALUE 0xCCF9C Kw_Wu16 655350.0 Time_ms 0.00 655350.0 FORMAT "%8.1" /end CHARACTERISTIC
/begin CHARACTERISTIC DSM_SdwDfp_FrmMngTORQUE_DSC_C "#SSD Enprellzeit Shadow Zustand für Fehlerpfad Dfp_FrmMngTORQUE_DSC" VALUE 0xCCF9E Kw_Wu16 655350.0 Time_ms 0.00 655350.0 FORMAT "%8.1" /end CHARACTERISTIC
/begin CHARACTERISTIC DSM_SdwDfp_FrmMngTORQUE_GEARBX_C "#SSD Enprellzeit Shadow Zustand für Fehlerpfad Dfp_FrmMngTORQUE_GEARBX" VALUE 0xCCFA0 Kw_Wu16 655350.0 Time_ms 0.00 655350.0 FORMAT "%8.1" /end CHARACTERISTIC
/begin CHARACTERISTIC DSM_SdwDfp_FrmMngTrq_ReqACC_C "#SSD Enprellzeit Shadow Zustand für Fehlerpfad Dfp_FrmMngTrq_ReqACC" VALUE 0xCCFA2 Kw_Wu16 655350.0 Time_ms 0.00 655350.0 FORMAT "%8.1" /end CHARACTERISTIC
/begin CHARACTERISTIC DSM_SdwDfp_FrmMngVEH_MOD_C "VEH_MOD - CAN-message related errors" VALUE 0xCCFA4 Kw_Wu16 655350.0 Time_ms 0.00 655350.0 FORMAT "%8.1" /end CHARACTERISTIC
/begin CHARACTERISTIC DSM_SdwDfp_FrmMngVELOCITY_C "Enprellzeit Shadow Zustand für Fehlerpfad Dfp_FrmMngVELOCITY" VALUE 0xCCFA6 Kw_Wu16 655350.0 Time_ms 0.00 655350.0 FORMAT "%8.1" /end CHARACTERISTIC
/begin CHARACTERISTIC DSM_SdwDfp_FrmMngWHEEL_SPEED_C "Enprellzeit Shadow Zustand für Fehlerpfad Dfp_FrmMngWHEEL_SPEED" VALUE 0xCCFA8 Kw_Wu16 655350.0 Time_ms 0.00 655350.0 FORMAT "%8.1" /end CHARACTERISTIC
/begin CHARACTERISTIC DSM_SdwDfp_FrmMngstCurr_C "Entprellzeit für Dfp_FrmMngstCurr" VALUE 0xCCFAA Kw_Wu16 655350.0 Time_ms 0.00 655350.0 FORMAT "%8.1" /end CHARACTERISTIC
/begin CHARACTERISTIC DSM_SdwDfp_FrmMngswtPSPOff_C "Entprellzeit für Dfp_FrmMngswtPSPOff" VALUE 0xCCFAC Kw_Wu16 655350.0 Time_ms 0.00 655350.0 FORMAT "%8.1" /end CHARACTERISTIC
/begin CHARACTERISTIC DSM_SdwDfp_GearbxIncMax_C "Enprellzeit Shadow Zustand für Fehlerpfad Dfp_GearbxIncMax" VALUE 0xCCFAE Kw_Wu16 655350.0 Time_ms 0.00 655350.0 FORMAT "%8.1" /end CHARACTERISTIC
/begin CHARACTERISTIC DSM_SdwDfp_GlwCD_C "Enprellzeit Shadow Zustand für Fehlerpfad Dfp_GlwCD" VALUE 0xCCFB0 Kw_Wu16 655350.0 Time_ms 0.00 655350.0 FORMAT "%8.1" /end CHARACTERISTIC
/begin CHARACTERISTIC DSM_SdwDfp_GlwCDGlwCirc1_C "Enprellzeit Shadow Zustand für Fehlerpfad Dfp_GlwCDGlwCirc1" VALUE 0xCCFB2 Kw_Wu16 655350.0 Time_ms 0.00 655350.0 FORMAT "%8.1" /end CHARACTERISTIC
/begin CHARACTERISTIC DSM_SdwDfp_GlwCDGlwCirc2_C "Enprellzeit Shadow Zustand für Fehlerpfad Dfp_GlwCDGlwCirc2" VALUE 0xCCFB4 Kw_Wu16 655350.0 Time_ms 0.00 655350.0 FORMAT "%8.1" /end CHARACTERISTIC
/begin CHARACTERISTIC DSM_SdwDfp_GlwCDGlwCirc3_C "Enprellzeit Shadow Zustand für Fehlerpfad Dfp_GlwCDGlwCirc3" VALUE 0xCCFB6 Kw_Wu16 655350.0 Time_ms 0.00 655350.0 FORMAT "%8.1" /end CHARACTERISTIC
/begin CHARACTERISTIC DSM_SdwDfp_GlwCDGlwCirc4_C "Enprellzeit Shadow Zustand für Fehlerpfad Dfp_GlwCDGlwCirc4" VALUE 0xCCFB8 Kw_Wu16 655350.0 Time_ms 0.00 655350.0 FORMAT "%8.1" /end CHARACTERISTIC
/begin CHARACTERISTIC DSM_SdwDfp_GlwCDGlwCirc5_C "Enprellzeit Shadow Zustand für Fehlerpfad Dfp_GlwCDGlwCirc5" VALUE 0xCCFBA Kw_Wu16 655350.0 Time_ms 0.00 655350.0 FORMAT "%8.1" /end CHARACTERISTIC
/begin CHARACTERISTIC DSM_SdwDfp_GlwCDGlwCirc6_C "Enprellzeit Shadow Zustand für Fehlerpfad Dfp_GlwCDGlwCirc6" VALUE 0xCCFBC Kw_Wu16 655350.0 Time_ms 0.00 655350.0 FORMAT "%8.1" /end CHARACTERISTIC
/begin CHARACTERISTIC DSM_SdwDfp_GlwCDGlwCirc7_C "Enprellzeit Shadow Zustand für Fehlerpfad Dfp_GlwCDGlwCirc7" VALUE 0xCCFBE Kw_Wu16 655350.0 Time_ms 0.00 655350.0 FORMAT "%8.1" /end CHARACTERISTIC
/begin CHARACTERISTIC DSM_SdwDfp_GlwCDGlwCirc8_C "Enprellzeit Shadow Zustand für Fehlerpfad Dfp_GlwCDGlwCirc8" VALUE 0xCCFC0 Kw_Wu16 655350.0 Time_ms 0.00 655350.0 FORMAT "%8.1" /end CHARACTERISTIC
/begin CHARACTERISTIC DSM_SdwDfp_GlwCtl_C "Enprellzeit Shadow Zustand für Fehlerpfad Dfp_GlwCtl" VALUE 0xCCFC2 Kw_Wu16 655350.0 Time_ms 0.00 655350.0 FORMAT "%8.1" /end CHARACTERISTIC
/begin CHARACTERISTIC DSM_SdwDfp_HWEMonCom_C "Enprellzeit Shadow Zustand für Fehlerpfad Dfp_HWEMonCom" VALUE 0xCCFC4 Kw_Wu16 655350.0 Time_ms 0.00 655350.0 FORMAT "%8.1" /end CHARACTERISTIC
/begin CHARACTERISTIC DSM_SdwDfp_HWEMonEEPROM_C "Enprellzeit Shadow Zustand für Fehlerpfad Dfp_HWEMonEEPROM" VALUE 0xCCFC6 Kw_Wu16 655350.0 Time_ms 0.00 655350.0 FORMAT "%8.1" /end CHARACTERISTIC
/begin CHARACTERISTIC DSM_SdwDfp_HWEMonRcyLocked_C "Enprellzeit Shadow Zustand für Fehlerpfad Dfp_HWEMonRcyLocked" VALUE 0xCCFC8 Kw_Wu16 655350.0 Time_ms 0.00 655350.0 FORMAT "%8.1" /end CHARACTERISTIC
/begin CHARACTERISTIC DSM_SdwDfp_HWEMonRcySuppressed_C "Enprellzeit Shadow Zustand für Fehlerpfad Dfp_HWEMonRcySuppressed" VALUE 0xCCFCA Kw_Wu16 655350.0 Time_ms 0.00 655350.0 FORMAT "%8.1" /end CHARACTERISTIC
/begin CHARACTERISTIC DSM_SdwDfp_HWEMonRcyVisible_C "Enprellzeit Shadow Zustand für Fehlerpfad Dfp_HWEMonRcyVisible" VALUE 0xCCFCC Kw_Wu16 655350.0 Time_ms 0.00 655350.0 FORMAT "%8.1" /end CHARACTERISTIC
/begin CHARACTERISTIC DSM_SdwDfp_HWEMonUMaxSupply_C "Enprellzeit Shadow Zustand für Fehlerpfad Dfp_HWEMonUMaxSupply" VALUE 0xCCFCE Kw_Wu16 655350.0 Time_ms 0.00 655350.0 FORMAT "%8.1" /end CHARACTERISTIC
/begin CHARACTERISTIC DSM_SdwDfp_HWEMonUMinSupply_C "Enprellzeit Shadow Zustand für Fehlerpfad Dfp_HWEMonUMinSupply" VALUE 0xCCFD0 Kw_Wu16 655350.0 Time_ms 0.00 655350.0 FORMAT "%8.1" /end CHARACTERISTIC
/begin CHARACTERISTIC DSM_SdwDfp_IATSCD_C "Enprellzeit Shadow Zustand für Fehlerpfad Dfp_IATSCD" VALUE 0xCCFD2 Kw_Wu16 655350.0 Time_ms 0.00 655350.0 FORMAT "%8.1" /end CHARACTERISTIC
/begin CHARACTERISTIC DSM_SdwDfp_IATSCD_CATS_C "Enprellzeit Shadow Zustand für Fehlerpfad Dfp_IATSCD_CATS" VALUE 0xCCFD4 Kw_Wu16 655350.0 Time_ms 0.00 655350.0 FORMAT "%8.1" /end CHARACTERISTIC
/begin CHARACTERISTIC DSM_SdwDfp_ImmCtlImmCD_C "Enprellzeit Shadow Zustand für Fehlerpfad Dfp_ImmCtlImmCD" VALUE 0xCCFD6 Kw_Wu16 655350.0 Time_ms 0.00 655350.0 FORMAT "%8.1" /end CHARACTERISTIC
/begin CHARACTERISTIC DSM_SdwDfp_ImmCtlImmEep_C "Enprellzeit Shadow Zustand für Fehlerpfad Dfp_ImmCtlImmEep" VALUE 0xCCFD8 Kw_Wu16 655350.0 Time_ms 0.00 655350.0 FORMAT "%8.1" /end CHARACTERISTIC
/begin CHARACTERISTIC DSM_SdwDfp_ImmCtlMpl_C "Enprellzeit Shadow Zustand für Fehlerpfad Dfp_ImmCtlMpl" VALUE 0xCCFDA Kw_Wu16 655350.0 Time_ms 0.00 655350.0 FORMAT "%8.1" /end CHARACTERISTIC
/begin CHARACTERISTIC DSM_SdwDfp_IndSys1_C "Enprellzeit Shadow Zustand für Fehlerpfad Dfp_IndSys1" VALUE 0xCCFDC Kw_Wu16 655350.0 Time_ms 0.00 655350.0 FORMAT "%8.1" /end CHARACTERISTIC
/begin CHARACTERISTIC DSM_SdwDfp_IndSys2_C "Enprellzeit Shadow Zustand für Fehlerpfad Dfp_IndSys2" VALUE 0xCCFDE Kw_Wu16 655350.0 Time_ms 0.00 655350.0 FORMAT "%8.1" /end CHARACTERISTIC
/begin CHARACTERISTIC DSM_SdwDfp_InjCrv_InjLim_C "Enprellzeit Shadow Zustand für Fehlerpfad Dfp_InjCrv_InjLim" VALUE 0xCCFE0 Kw_Wu16 655350.0 Time_ms 0.00 655350.0 FORMAT "%8.1" /end CHARACTERISTIC
/begin CHARACTERISTIC DSM_SdwDfp_InjCtlAdjQnt_C "Enprellzeit Shadow Zustand für Fehlerpfad Dfp_InjCtlAdjQnt" VALUE 0xCCFE2 Kw_Wu16 655350.0 Time_ms 0.00 655350.0 FORMAT "%8.1" /end CHARACTERISTIC
/begin CHARACTERISTIC DSM_SdwDfp_InjCtlDrift_C "Enprellzeit Shadow Zustand für Fehlerpfad Dfp_InjCtlDrift" VALUE 0xCCFE4 Kw_Wu16 655350.0 Time_ms 0.00 655350.0 FORMAT "%8.1" /end CHARACTERISTIC
/begin CHARACTERISTIC DSM_SdwDfp_InjVlvBnk1A_C "Enprellzeit Shadow Zustand für Fehlerpfad Dfp_InjVlvBnk1A" VALUE 0xCCFE6 Kw_Wu16 655350.0 Time_ms 0.00 655350.0 FORMAT "%8.1" /end CHARACTERISTIC
/begin CHARACTERISTIC DSM_SdwDfp_InjVlvBnk1B_C "Enprellzeit Shadow Zustand für Fehlerpfad Dfp_InjVlvBnk1B" VALUE 0xCCFE8 Kw_Wu16 655350.0 Time_ms 0.00 655350.0 FORMAT "%8.1" /end CHARACTERISTIC
/begin CHARACTERISTIC DSM_SdwDfp_InjVlvBnk2A_C "Enprellzeit Shadow Zustand für Fehlerpfad Dfp_InjVlvBnk2A" VALUE 0xCCFEA Kw_Wu16 655350.0 Time_ms 0.00 655350.0 FORMAT "%8.1" /end CHARACTERISTIC
/begin CHARACTERISTIC DSM_SdwDfp_InjVlvBnk2B_C "Enprellzeit Shadow Zustand für Fehlerpfad Dfp_InjVlvBnk2B" VALUE 0xCCFEC Kw_Wu16 655350.0 Time_ms 0.00 655350.0 FORMAT "%8.1" /end CHARACTERISTIC
/begin CHARACTERISTIC DSM_SdwDfp_InjVlvChipA_C "Enprellzeit Shadow Zustand für Fehlerpfad Dfp_InjVlvChipA" VALUE 0xCCFEE Kw_Wu16 655350.0 Time_ms 0.00 655350.0 FORMAT "%8.1" /end CHARACTERISTIC
/begin CHARACTERISTIC DSM_SdwDfp_InjVlvChipB_C "Enprellzeit Shadow Zustand für Fehlerpfad Dfp_InjVlvChipB" VALUE 0xCCFF0 Kw_Wu16 655350.0 Time_ms 0.00 655350.0 FORMAT "%8.1" /end CHARACTERISTIC
/begin CHARACTERISTIC DSM_SdwDfp_InjVlvCyl1A_C "Enprellzeit Shadow Zustand für Fehlerpfad Dfp_InjVlvCyl1A" VALUE 0xCCFF2 Kw_Wu16 655350.0 Time_ms 0.00 655350.0 FORMAT "%8.1" /end CHARACTERISTIC
/begin CHARACTERISTIC DSM_SdwDfp_InjVlvCyl1B_C "Enprellzeit Shadow Zustand für Fehlerpfad Dfp_InjVlvCyl1B" VALUE 0xCCFF4 Kw_Wu16 655350.0 Time_ms 0.00 655350.0 FORMAT "%8.1" /end CHARACTERISTIC
/begin CHARACTERISTIC DSM_SdwDfp_InjVlvCyl2A_C "Enprellzeit Shadow Zustand für Fehlerpfad Dfp_InjVlvCyl2A" VALUE 0xCCFF6 Kw_Wu16 655350.0 Time_ms 0.00 655350.0 FORMAT "%8.1" /end CHARACTERISTIC
/begin CHARACTERISTIC DSM_SdwDfp_InjVlvCyl2B_C "Enprellzeit Shadow Zustand für Fehlerpfad Dfp_InjVlvCyl2B" VALUE 0xCCFF8 Kw_Wu16 655350.0 Time_ms 0.00 655350.0 FORMAT "%8.1" /end CHARACTERISTIC
/begin CHARACTERISTIC DSM_SdwDfp_InjVlvCyl3A_C "Enprellzeit Shadow Zustand für Fehlerpfad Dfp_InjVlvCyl3A" VALUE 0xCCFFA Kw_Wu16 655350.0 Time_ms 0.00 655350.0 FORMAT "%8.1" /end CHARACTERISTIC
/begin CHARACTERISTIC DSM_SdwDfp_InjVlvCyl3B_C "Enprellzeit Shadow Zustand für Fehlerpfad Dfp_InjVlvCyl3B" VALUE 0xCCFFC Kw_Wu16 655350.0 Time_ms 0.00 655350.0 FORMAT "%8.1" /end CHARACTERISTIC
/begin CHARACTERISTIC DSM_SdwDfp_InjVlvCyl4A_C "Enprellzeit Shadow Zustand für Fehlerpfad Dfp_InjVlvCyl4A" VALUE 0xCCFFE Kw_Wu16 655350.0 Time_ms 0.00 655350.0 FORMAT "%8.1" /end CHARACTERISTIC
/begin CHARACTERISTIC DSM_SdwDfp_InjVlvCyl4B_C "Enprellzeit Shadow Zustand für Fehlerpfad Dfp_InjVlvCyl4B" VALUE 0xCD000 Kw_Wu16 655350.0 Time_ms 0.00 655350.0 FORMAT "%8.1" /end CHARACTERISTIC
/begin CHARACTERISTIC DSM_SdwDfp_InjVlvCyl5A_C "Enprellzeit Shadow Zustand für Fehlerpfad Dfp_InjVlvCyl5A" VALUE 0xCD002 Kw_Wu16 655350.0 Time_ms 0.00 655350.0 FORMAT "%8.1" /end CHARACTERISTIC
/begin CHARACTERISTIC DSM_SdwDfp_InjVlvCyl5B_C "Enprellzeit Shadow Zustand für Fehlerpfad Dfp_InjVlvCyl5B" VALUE 0xCD004 Kw_Wu16 655350.0 Time_ms 0.00 655350.0 FORMAT "%8.1" /end CHARACTERISTIC
/begin CHARACTERISTIC DSM_SdwDfp_InjVlvCyl6A_C "Enprellzeit Shadow Zustand für Fehlerpfad Dfp_InjVlvCyl6A" VALUE 0xCD006 Kw_Wu16 655350.0 Time_ms 0.00 655350.0 FORMAT "%8.1" /end CHARACTERISTIC
/begin CHARACTERISTIC DSM_SdwDfp_InjVlvCyl6B_C "Enprellzeit Shadow Zustand für Fehlerpfad Dfp_InjVlvCyl6B" VALUE 0xCD008 Kw_Wu16 655350.0 Time_ms 0.00 655350.0 FORMAT "%8.1" /end CHARACTERISTIC
/begin CHARACTERISTIC DSM_SdwDfp_LPACD_Max_C "Enprellzeit Shadow Zustand für Fehlerpfad Dfp_LPACD_Max" VALUE 0xCD00A Kw_Wu16 655350.0 Time_ms 0.00 655350.0 FORMAT "%8.1" /end CHARACTERISTIC
/begin CHARACTERISTIC DSM_SdwDfp_LPACD_Min_C "Enprellzeit Shadow Zustand für Fehlerpfad Dfp_LPACD_Min" VALUE 0xCD00C Kw_Wu16 655350.0 Time_ms 0.00 655350.0 FORMAT "%8.1" /end CHARACTERISTIC
/begin CHARACTERISTIC DSM_SdwDfp_LPACD_SigNpl_C "Enprellzeit Shadow Zustand für Fehlerpfad Dfp_LPACD_SigNpl" VALUE 0xCD00E Kw_Wu16 655350.0 Time_ms 0.00 655350.0 FORMAT "%8.1" /end CHARACTERISTIC
/begin CHARACTERISTIC DSM_SdwDfp_LSUCDCircNernst0_C "Enprellzeit Shadow Zustand für Fehlerpfad Dfp_LSUCDCircNernst0" VALUE 0xCD010 Kw_Wu16 655350.0 Time_ms 0.00 655350.0 FORMAT "%8.1" /end CHARACTERISTIC
/begin CHARACTERISTIC DSM_SdwDfp_LSUCDCircPumpCur0_C "Enprellzeit Shadow Zustand für Fehlerpfad Dfp_LSUCDCircPumpCur0" VALUE 0xCD012 Kw_Wu16 655350.0 Time_ms 0.00 655350.0 FORMAT "%8.1" /end CHARACTERISTIC
/begin CHARACTERISTIC DSM_SdwDfp_LSUCDCircVirtGnd0_C "Enprellzeit Shadow Zustand für Fehlerpfad Dfp_LSUCDCircVirtGnd0" VALUE 0xCD014 Kw_Wu16 655350.0 Time_ms 0.00 655350.0 FORMAT "%8.1" /end CHARACTERISTIC
/begin CHARACTERISTIC DSM_SdwDfp_LSUCDHeater0_C "Enprellzeit Shadow Zustand für Fehlerpfad Dfp_LSUCDHeater0" VALUE 0xCD016 Kw_Wu16 655350.0 Time_ms 0.00 655350.0 FORMAT "%8.1" /end CHARACTERISTIC
/begin CHARACTERISTIC DSM_SdwDfp_LSUCDHtCoup0_C "Enprellzeit Shadow Zustand für Fehlerpfad Dfp_LSUCDHtCoup0" VALUE 0xCD018 Kw_Wu16 655350.0 Time_ms 0.00 655350.0 FORMAT "%8.1" /end CHARACTERISTIC
/begin CHARACTERISTIC DSM_SdwDfp_LSUCDO20_C "Enprellzeit Shadow Zustand für Fehlerpfad Dfp_LSUCDO20" VALUE 0xCD01A Kw_Wu16 655350.0 Time_ms 0.00 655350.0 FORMAT "%8.1" /end CHARACTERISTIC
/begin CHARACTERISTIC DSM_SdwDfp_LSUCDO2Clb0_C "Enprellzeit Shadow Zustand für Fehlerpfad Dfp_LSUCDO2Clb0" VALUE 0xCD01C Kw_Wu16 655350.0 Time_ms 0.00 655350.0 FORMAT "%8.1" /end CHARACTERISTIC
/begin CHARACTERISTIC DSM_SdwDfp_LSUCDRiClb0_C "Enprellzeit Shadow Zustand für Fehlerpfad Dfp_LSUCDRiClb0" VALUE 0xCD01E Kw_Wu16 655350.0 Time_ms 0.00 655350.0 FORMAT "%8.1" /end CHARACTERISTIC
/begin CHARACTERISTIC DSM_SdwDfp_LSUCDSPI0_C "Enprellzeit Shadow Zustand für Fehlerpfad Dfp_LSUCDSPI0" VALUE 0xCD020 Kw_Wu16 655350.0 Time_ms 0.00 655350.0 FORMAT "%8.1" /end CHARACTERISTIC
/begin CHARACTERISTIC DSM_SdwDfp_LSUCDSPIBattLow0_C "Enprellzeit Shadow Zustand für Fehlerpfad Dfp_LSUCDSPIBattLow0" VALUE 0xCD022 Kw_Wu16 655350.0 Time_ms 0.00 655350.0 FORMAT "%8.1" /end CHARACTERISTIC
/begin CHARACTERISTIC DSM_SdwDfp_LSUCDWireIP0_C "Enprellzeit Shadow Zustand für Fehlerpfad Dfp_LSUCDWireIP0" VALUE 0xCD024 Kw_Wu16 655350.0 Time_ms 0.00 655350.0 FORMAT "%8.1" /end CHARACTERISTIC
/begin CHARACTERISTIC DSM_SdwDfp_LSUCtlRiExc0_C "Enprellzeit Shadow Zustand für Fehlerpfad Dfp_LSUCtlRiExc0" VALUE 0xCD026 Kw_Wu16 655350.0 Time_ms 0.00 655350.0 FORMAT "%8.1" /end CHARACTERISTIC
/begin CHARACTERISTIC DSM_SdwDfp_LSUMon1Sens_C "Enprellzeit Shadow Zustand für Fehlerpfad Dfp_LSUMon1Sens" VALUE 0xCD028 Kw_Wu16 655350.0 Time_ms 0.00 655350.0 FORMAT "%8.1" /end CHARACTERISTIC
/begin CHARACTERISTIC DSM_SdwDfp_LSUMon2Sens_C "Enprellzeit Shadow Zustand für Fehlerpfad Dfp_LSUMon2Sens" VALUE 0xCD02A Kw_Wu16 655350.0 Time_ms 0.00 655350.0 FORMAT "%8.1" /end CHARACTERISTIC
/begin CHARACTERISTIC DSM_SdwDfp_MIL_C "Enprellzeit Shadow Zustand für Fehlerpfad Dfp_MIL" VALUE 0xCD02C Kw_Wu16 655350.0 Time_ms 0.00 655350.0 FORMAT "%8.1" /end CHARACTERISTIC
/begin CHARACTERISTIC DSM_SdwDfp_MRlyCD_C "Enprellzeit Shadow Zustand für Fehlerpfad Dfp_MRlyCD" VALUE 0xCD02E Kw_Wu16 655350.0 Time_ms 0.00 655350.0 FORMAT "%8.1" /end CHARACTERISTIC
/begin CHARACTERISTIC DSM_SdwDfp_MSidCD_Comm_C "Enprellzeit Shadow Zustand für Fehlerpfad Dfp_MSidCD_Comm" VALUE 0xCD030 Kw_Wu16 655350.0 Time_ms 0.00 655350.0 FORMAT "%8.1" /end CHARACTERISTIC
/begin CHARACTERISTIC DSM_SdwDfp_MSidCD_Pin_C "Enprellzeit Shadow Zustand für Fehlerpfad Dfp_MSidCD_Pin" VALUE 0xCD032 Kw_Wu16 655350.0 Time_ms 0.00 655350.0 FORMAT "%8.1" /end CHARACTERISTIC
/begin CHARACTERISTIC DSM_SdwDfp_MSidCD_Sel_INI_C "Enprellzeit Shadow Zustand für Fehlerpfad Dfp_MSidCD_Sel_INI" VALUE 0xCD034 Kw_Wu16 655350.0 Time_ms 0.00 655350.0 FORMAT "%8.1" /end CHARACTERISTIC
/begin CHARACTERISTIC DSM_SdwDfp_MSidCD_Select_C "Enprellzeit Shadow Zustand für Fehlerpfad Dfp_MSidCD_Select" VALUE 0xCD036 Kw_Wu16 655350.0 Time_ms 0.00 655350.0 FORMAT "%8.1" /end CHARACTERISTIC
/begin CHARACTERISTIC DSM_SdwDfp_MeUnCDNoLoad_C "Enprellzeit Shadow Zustand für Fehlerpfad Dfp_MeUnCDNoLoad" VALUE 0xCD038 Kw_Wu16 655350.0 Time_ms 0.00 655350.0 FORMAT "%8.1" /end CHARACTERISTIC
/begin CHARACTERISTIC DSM_SdwDfp_MeUnCDSCBat_C "Enprellzeit Shadow Zustand für Fehlerpfad Dfp_MeUnCDSCBat" VALUE 0xCD03A Kw_Wu16 655350.0 Time_ms 0.00 655350.0 FORMAT "%8.1" /end CHARACTERISTIC
/begin CHARACTERISTIC DSM_SdwDfp_MeUnCDSCGnd_C "Enprellzeit Shadow Zustand für Fehlerpfad Dfp_MeUnCDSCGnd" VALUE 0xCD03C Kw_Wu16 655350.0 Time_ms 0.00 655350.0 FORMAT "%8.1" /end CHARACTERISTIC
/begin CHARACTERISTIC DSM_SdwDfp_MeUnCD_ADC_C "Enprellzeit Shadow Zustand für Fehlerpfad Dfp_MeUnCD_ADC" VALUE 0xCD03E Kw_Wu16 655350.0 Time_ms 0.00 655350.0 FORMAT "%8.1" /end CHARACTERISTIC
/begin CHARACTERISTIC DSM_SdwDfp_MeUnCD_SigTst_C "Enprellzeit Shadow Zustand für Fehlerpfad Dfp_MeUnCD_SigTst" VALUE 0xCD040 Kw_Wu16 655350.0 Time_ms 0.00 655350.0 FORMAT "%8.1" /end CHARACTERISTIC
/begin CHARACTERISTIC DSM_SdwDfp_Montr_C "Enprellzeit Shadow Zustand für Fehlerpfad Dfp_Montr" VALUE 0xCD042 Kw_Wu16 655350.0 Time_ms 0.00 655350.0 FORMAT "%8.1" /end CHARACTERISTIC
/begin CHARACTERISTIC DSM_SdwDfp_NetMngDeviceA_C "Enprellzeit Shadow Zustand für Fehlerpfad Dfp_NetMngDeviceA" VALUE 0xCD044 Kw_Wu16 655350.0 Time_ms 0.00 655350.0 FORMAT "%8.1" /end CHARACTERISTIC
/begin CHARACTERISTIC DSM_SdwDfp_NetMngDeviceB_C "Enprellzeit Shadow Zustand für Fehlerpfad Dfp_NetMngDeviceB" VALUE 0xCD046 Kw_Wu16 655350.0 Time_ms 0.00 655350.0 FORMAT "%8.1" /end CHARACTERISTIC
/begin CHARACTERISTIC DSM_SdwDfp_NetMngDeviceC_C "Enprellzeit Shadow Zustand für Fehlerpfad Dfp_NetMngDeviceC" VALUE 0xCD048 Kw_Wu16 655350.0 Time_ms 0.00 655350.0 FORMAT "%8.1" /end CHARACTERISTIC
/begin CHARACTERISTIC DSM_SdwDfp_OPSCD_Lamp_C "Enprellzeit Shadow Zustand für Fehlerpfad Dfp_OPSCD_Lamp" VALUE 0xCD04A Kw_Wu16 655350.0 Time_ms 0.00 655350.0 FORMAT "%8.1" /end CHARACTERISTIC
/begin CHARACTERISTIC DSM_SdwDfp_OPSCD_anain_C "Enprellzeit Shadow Zustand für Fehlerpfad Dfp_OPSCD_anain" VALUE 0xCD04C Kw_Wu16 655350.0 Time_ms 0.00 655350.0 FORMAT "%8.1" /end CHARACTERISTIC
/begin CHARACTERISTIC DSM_SdwDfp_OTSCD_C "Enprellzeit Shadow Zustand für Fehlerpfad Dfp_OTSCD" VALUE 0xCD04E Kw_Wu16 655350.0 Time_ms 0.00 655350.0 FORMAT "%8.1" /end CHARACTERISTIC
/begin CHARACTERISTIC DSM_SdwDfp_OvRMon_C "Enprellzeit Shadow Zustand für Fehlerpfad Dfp_OvRMon" VALUE 0xCD050 Kw_Wu16 655350.0 Time_ms 0.00 655350.0 FORMAT "%8.1" /end CHARACTERISTIC
/begin CHARACTERISTIC DSM_SdwDfp_OvRMonBrk_C "Enprellzeit Shadow Zustand für Fehlerpfad Dfp_OvRMonBrk" VALUE 0xCD052 Kw_Wu16 655350.0 Time_ms 0.00 655350.0 FORMAT "%8.1" /end CHARACTERISTIC
/begin CHARACTERISTIC DSM_SdwDfp_OvRMonSigA_C "Enprellzeit Shadow Zustand für Fehlerpfad Dfp_OvRMonSigA" VALUE 0xCD054 Kw_Wu16 655350.0 Time_ms 0.00 655350.0 FORMAT "%8.1" /end CHARACTERISTIC
/begin CHARACTERISTIC DSM_SdwDfp_OxiCCDTPre_C "Enprellzeit Shadow Zustand für Fehlerpfad Dfp_OxiCCDTPre" VALUE 0xCD056 Kw_Wu16 655350.0 Time_ms 0.00 655350.0 FORMAT "%8.1" /end CHARACTERISTIC
/begin CHARACTERISTIC DSM_SdwDfp_PCR_GovDevNeg_C "Enprellzeit Shadow Zustand für Fehlerpfad Dfp_PCR_GovDevNeg" VALUE 0xCD058 Kw_Wu16 655350.0 Time_ms 0.00 655350.0 FORMAT "%8.1" /end CHARACTERISTIC
/begin CHARACTERISTIC DSM_SdwDfp_PCR_GovDevPos_C "Enprellzeit Shadow Zustand für Fehlerpfad Dfp_PCR_GovDevPos" VALUE 0xCD05A Kw_Wu16 655350.0 Time_ms 0.00 655350.0 FORMAT "%8.1" /end CHARACTERISTIC
/begin CHARACTERISTIC DSM_SdwDfp_PCR_LPGvnrDvtNeg_C "Enprellzeit Shadow Zustand für Fehlerpfad Dfp_PCR_LPGvnrDvtNeg" VALUE 0xCD05C Kw_Wu16 655350.0 Time_ms 0.00 655350.0 FORMAT "%8.1" /end CHARACTERISTIC
/begin CHARACTERISTIC DSM_SdwDfp_PCR_LPGvnrDvtPos_C "Enprellzeit Shadow Zustand für Fehlerpfad Dfp_PCR_LPGvnrDvtPos" VALUE 0xCD05E Kw_Wu16 655350.0 Time_ms 0.00 655350.0 FORMAT "%8.1" /end CHARACTERISTIC
/begin CHARACTERISTIC DSM_SdwDfp_PCVCDNoLoad_C "Enprellzeit Shadow Zustand für Fehlerpfad Dfp_PCVCDNoLoad" VALUE 0xCD060 Kw_Wu16 655350.0 Time_ms 0.00 655350.0 FORMAT "%8.1" /end CHARACTERISTIC
/begin CHARACTERISTIC DSM_SdwDfp_PCVCDSCBat_C "Enprellzeit Shadow Zustand für Fehlerpfad Dfp_PCVCDSCBat" VALUE 0xCD062 Kw_Wu16 655350.0 Time_ms 0.00 655350.0 FORMAT "%8.1" /end CHARACTERISTIC
/begin CHARACTERISTIC DSM_SdwDfp_PCVCDSCGnd_C "Enprellzeit Shadow Zustand für Fehlerpfad Dfp_PCVCDSCGnd" VALUE 0xCD064 Kw_Wu16 655350.0 Time_ms 0.00 655350.0 FORMAT "%8.1" /end CHARACTERISTIC
/begin CHARACTERISTIC DSM_SdwDfp_PCVCD_ADC_C "Enprellzeit Shadow Zustand für Fehlerpfad Dfp_PCVCD_ADC" VALUE 0xCD066 Kw_Wu16 655350.0 Time_ms 0.00 655350.0 FORMAT "%8.1" /end CHARACTERISTIC
/begin CHARACTERISTIC DSM_SdwDfp_PCVCD_SigTst_C "Enprellzeit Shadow Zustand für Fehlerpfad Dfp_PCVCD_SigTst" VALUE 0xCD068 Kw_Wu16 655350.0 Time_ms 0.00 655350.0 FORMAT "%8.1" /end CHARACTERISTIC
/begin CHARACTERISTIC DSM_SdwDfp_PFltAPSPlaus_C "Enprellzeit Shadow Zustand für Fehlerpfad Dfp_PFltAPSPlaus" VALUE 0xCD06A Kw_Wu16 655350.0 Time_ms 0.00 655350.0 FORMAT "%8.1" /end CHARACTERISTIC
/begin CHARACTERISTIC DSM_SdwDfp_PFltAPSens_C "Enprellzeit Shadow Zustand für Fehlerpfad Dfp_PFltAPSens" VALUE 0xCD06C Kw_Wu16 655350.0 Time_ms 0.00 655350.0 FORMAT "%8.1" /end CHARACTERISTIC
/begin CHARACTERISTIC DSM_SdwDfp_PFltBPSPlaus_C "Enprellzeit Shadow Zustand für Fehlerpfad Dfp_PFltBPSPlaus" VALUE 0xCD06E Kw_Wu16 655350.0 Time_ms 0.00 655350.0 FORMAT "%8.1" /end CHARACTERISTIC
/begin CHARACTERISTIC DSM_SdwDfp_PFltCDPPre_C "Enprellzeit Shadow Zustand für Fehlerpfad Dfp_PFltCDPPre" VALUE 0xCD070 Kw_Wu16 655350.0 Time_ms 0.00 655350.0 FORMAT "%8.1" /end CHARACTERISTIC
/begin CHARACTERISTIC DSM_SdwDfp_PFltCDTempPre_C "Enprellzeit Shadow Zustand für Fehlerpfad Dfp_PFltCDTempPre" VALUE 0xCD072 Kw_Wu16 655350.0 Time_ms 0.00 655350.0 FORMAT "%8.1" /end CHARACTERISTIC
/begin CHARACTERISTIC DSM_SdwDfp_PFltChar_C "Enprellzeit Shadow Zustand für Fehlerpfad Dfp_PFltChar" VALUE 0xCD074 Kw_Wu16 655350.0 Time_ms 0.00 655350.0 FORMAT "%8.1" /end CHARACTERISTIC
/begin CHARACTERISTIC DSM_SdwDfp_PFltEngPrt_C "Enprellzeit Shadow Zustand für Fehlerpfad Dfp_PFltEngPrt" VALUE 0xCD076 Kw_Wu16 655350.0 Time_ms 0.00 655350.0 FORMAT "%8.1" /end CHARACTERISTIC
/begin CHARACTERISTIC DSM_SdwDfp_PFltPresDynPlaus_C "Enprellzeit Shadow Zustand für Fehlerpfad Dfp_PFltPresDynPlaus" VALUE 0xCD078 Kw_Wu16 655350.0 Time_ms 0.00 655350.0 FORMAT "%8.1" /end CHARACTERISTIC
/begin CHARACTERISTIC DSM_SdwDfp_PFltPresPlaus_C "Enprellzeit Shadow Zustand für Fehlerpfad Dfp_PFltPresPlaus" VALUE 0xCD07A Kw_Wu16 655350.0 Time_ms 0.00 655350.0 FORMAT "%8.1" /end CHARACTERISTIC
/begin CHARACTERISTIC DSM_SdwDfp_PFltPresSens_C "Enprellzeit Shadow Zustand für Fehlerpfad Dfp_PFltPresSens" VALUE 0xCD07C Kw_Wu16 655350.0 Time_ms 0.00 655350.0 FORMAT "%8.1" /end CHARACTERISTIC
/begin CHARACTERISTIC DSM_SdwDfp_PFltPresSensFrz_C "Enprellzeit Shadow Zustand für Fehlerpfad Dfp_PFltPresSensFrz" VALUE 0xCD07E Kw_Wu16 655350.0 Time_ms 0.00 655350.0 FORMAT "%8.1" /end CHARACTERISTIC
/begin CHARACTERISTIC DSM_SdwDfp_PFltPresSensHsLn_C "Enprellzeit Shadow Zustand für Fehlerpfad Dfp_PFltPresSensHsLn" VALUE 0xCD080 Kw_Wu16 655350.0 Time_ms 0.00 655350.0 FORMAT "%8.1" /end CHARACTERISTIC
/begin CHARACTERISTIC DSM_SdwDfp_PFltPresSensSot_C "Enprellzeit Shadow Zustand für Fehlerpfad Dfp_PFltPresSensSot" VALUE 0xCD082 Kw_Wu16 655350.0 Time_ms 0.00 655350.0 FORMAT "%8.1" /end CHARACTERISTIC
/begin CHARACTERISTIC DSM_SdwDfp_PFltRgnPerm_C "Enprellzeit Shadow Zustand für Fehlerpfad Dfp_PFltRgnPerm" VALUE 0xCD084 Kw_Wu16 655350.0 Time_ms 0.00 655350.0 FORMAT "%8.1" /end CHARACTERISTIC
/begin CHARACTERISTIC DSM_SdwDfp_PFltTempDwnStrm_C "Enprellzeit Shadow Zustand für Fehlerpfad Dfp_PFltTempDwnStrm" VALUE 0xCD086 Kw_Wu16 655350.0 Time_ms 0.00 655350.0 FORMAT "%8.1" /end CHARACTERISTIC
/begin CHARACTERISTIC DSM_SdwDfp_PFltTempSens_C "Enprellzeit Shadow Zustand für Fehlerpfad Dfp_PFltTempSens" VALUE 0xCD088 Kw_Wu16 655350.0 Time_ms 0.00 655350.0 FORMAT "%8.1" /end CHARACTERISTIC
/begin CHARACTERISTIC DSM_SdwDfp_PFltTempUpStrm_C "Enprellzeit Shadow Zustand für Fehlerpfad Dfp_PFltTempUpStrm" VALUE 0xCD08A Kw_Wu16 655350.0 Time_ms 0.00 655350.0 FORMAT "%8.1" /end CHARACTERISTIC
/begin CHARACTERISTIC DSM_SdwDfp_PFltmSotDiffMax_C "Enprellzeit Shadow Zustand für Fehlerpfad Dfp_PFltmSotDiffMax" VALUE 0xCD08C Kw_Wu16 655350.0 Time_ms 0.00 655350.0 FORMAT "%8.1" /end CHARACTERISTIC
/begin CHARACTERISTIC DSM_SdwDfp_PSPCD_Actr_C "Enprellzeit Shadow Zustand für Fehlerpfad Dfp_PSPCD_Actr" VALUE 0xCD08E Kw_Wu16 655350.0 Time_ms 0.00 655350.0 FORMAT "%8.1" /end CHARACTERISTIC
/begin CHARACTERISTIC DSM_SdwDfp_PresPlausDblDef_C "Enprellzeit Shadow Zustand für Fehlerpfad Dfp_PresPlausDblDef" VALUE 0xCD090 Kw_Wu16 655350.0 Time_ms 0.00 655350.0 FORMAT "%8.1" /end CHARACTERISTIC
/begin CHARACTERISTIC DSM_SdwDfp_QLTCD_C "Enprellzeit Shadow Zustand für Fehlerpfad Dfp_QLTCD" VALUE 0xCD092 Kw_Wu16 655350.0 Time_ms 0.00 655350.0 FORMAT "%8.1" /end CHARACTERISTIC
/begin CHARACTERISTIC DSM_SdwDfp_RailCD_C "Enprellzeit Shadow Zustand für Fehlerpfad Dfp_RailCD" VALUE 0xCD094 Kw_Wu16 655350.0 Time_ms 0.00 655350.0 FORMAT "%8.1" /end CHARACTERISTIC
/begin CHARACTERISTIC DSM_SdwDfp_RailCDOfsTst_C "Enprellzeit Shadow Zustand für Fehlerpfad Dfp_RailCDOfsTst" VALUE 0xCD096 Kw_Wu16 655350.0 Time_ms 0.00 655350.0 FORMAT "%8.1" /end CHARACTERISTIC
/begin CHARACTERISTIC DSM_SdwDfp_RailCD_PMonStrt_C "Enprellzeit Shadow Zustand für Fehlerpfad Dfp_RailCD_PMonStrt" VALUE 0xCD098 Kw_Wu16 655350.0 Time_ms 0.00 655350.0 FORMAT "%8.1" /end CHARACTERISTIC
/begin CHARACTERISTIC DSM_SdwDfp_RailCtlModeMeUnDiag_C "Enprellzeit Shadow Zustand für Fehlerpfad Dfp_RailCtlModeMeUnDiag" VALUE 0xCD09A Kw_Wu16 655350.0 Time_ms 0.00 655350.0 FORMAT "%8.1" /end CHARACTERISTIC
/begin CHARACTERISTIC DSM_SdwDfp_RailCtlModePCVDiag_C "Enprellzeit Shadow Zustand für Fehlerpfad Dfp_RailCtlModePCVDiag" VALUE 0xCD09C Kw_Wu16 655350.0 Time_ms 0.00 655350.0 FORMAT "%8.1" /end CHARACTERISTIC
/begin CHARACTERISTIC DSM_SdwDfp_RailMeUn0_C "Enprellzeit Shadow Zustand für Fehlerpfad Dfp_RailMeUn0" VALUE 0xCD09E Kw_Wu16 655350.0 Time_ms 0.00 655350.0 FORMAT "%8.1" /end CHARACTERISTIC
/begin CHARACTERISTIC DSM_SdwDfp_RailMeUn1_C "Enprellzeit Shadow Zustand für Fehlerpfad Dfp_RailMeUn1" VALUE 0xCD0A0 Kw_Wu16 655350.0 Time_ms 0.00 655350.0 FORMAT "%8.1" /end CHARACTERISTIC
/begin CHARACTERISTIC DSM_SdwDfp_RailMeUn2_C "Enprellzeit Shadow Zustand für Fehlerpfad Dfp_RailMeUn2" VALUE 0xCD0A2 Kw_Wu16 655350.0 Time_ms 0.00 655350.0 FORMAT "%8.1" /end CHARACTERISTIC
/begin CHARACTERISTIC DSM_SdwDfp_RailMeUn3_C "Enprellzeit Shadow Zustand für Fehlerpfad Dfp_RailMeUn3" VALUE 0xCD0A4 Kw_Wu16 655350.0 Time_ms 0.00 655350.0 FORMAT "%8.1" /end CHARACTERISTIC
/begin CHARACTERISTIC DSM_SdwDfp_RailMeUn4_C "Enprellzeit Shadow Zustand für Fehlerpfad Dfp_RailMeUn4" VALUE 0xCD0A6 Kw_Wu16 655350.0 Time_ms 0.00 655350.0 FORMAT "%8.1" /end CHARACTERISTIC
/begin CHARACTERISTIC DSM_SdwDfp_RailPCV0_C "Enprellzeit Shadow Zustand für Fehlerpfad Dfp_RailPCV0" VALUE 0xCD0A8 Kw_Wu16 655350.0 Time_ms 0.00 655350.0 FORMAT "%8.1" /end CHARACTERISTIC
/begin CHARACTERISTIC DSM_SdwDfp_RailPCV1_C "Enprellzeit Shadow Zustand für Fehlerpfad Dfp_RailPCV1" VALUE 0xCD0AA Kw_Wu16 655350.0 Time_ms 0.00 655350.0 FORMAT "%8.1" /end CHARACTERISTIC
/begin CHARACTERISTIC DSM_SdwDfp_RailPCV2_C "Enprellzeit Shadow Zustand für Fehlerpfad Dfp_RailPCV2" VALUE 0xCD0AC Kw_Wu16 655350.0 Time_ms 0.00 655350.0 FORMAT "%8.1" /end CHARACTERISTIC
/begin CHARACTERISTIC DSM_SdwDfp_RailPCV3_C "Enprellzeit Shadow Zustand für Fehlerpfad Dfp_RailPCV3" VALUE 0xCD0AE Kw_Wu16 655350.0 Time_ms 0.00 655350.0 FORMAT "%8.1" /end CHARACTERISTIC
/begin CHARACTERISTIC DSM_SdwDfp_RailPCV4_C "Enprellzeit Shadow Zustand für Fehlerpfad Dfp_RailPCV4" VALUE 0xCD0B0 Kw_Wu16 655350.0 Time_ms 0.00 655350.0 FORMAT "%8.1" /end CHARACTERISTIC
/begin CHARACTERISTIC DSM_SdwDfp_RailPCV5_C "Enprellzeit Shadow Zustand für Fehlerpfad Dfp_RailPCV5" VALUE 0xCD0B2 Kw_Wu16 655350.0 Time_ms 0.00 655350.0 FORMAT "%8.1" /end CHARACTERISTIC
/begin CHARACTERISTIC DSM_SdwDfp_SOPTst_C "Enprellzeit Shadow Zustand für Fehlerpfad Dfp_SOPTst" VALUE 0xCD0B4 Kw_Wu16 655350.0 Time_ms 0.00 655350.0 FORMAT "%8.1" /end CHARACTERISTIC
/begin CHARACTERISTIC DSM_SdwDfp_SSpMon1_C "Enprellzeit Shadow Zustand für Fehlerpfad Dfp_SSpMon1" VALUE 0xCD0B6 Kw_Wu16 655350.0 Time_ms 0.00 655350.0 FORMAT "%8.1" /end CHARACTERISTIC
/begin CHARACTERISTIC DSM_SdwDfp_SSpMon2_C "Enprellzeit Shadow Zustand für Fehlerpfad Dfp_SSpMon2" VALUE 0xCD0B8 Kw_Wu16 655350.0 Time_ms 0.00 655350.0 FORMAT "%8.1" /end CHARACTERISTIC
/begin CHARACTERISTIC DSM_SdwDfp_SSpMon3_C "Enprellzeit Shadow Zustand für Fehlerpfad Dfp_SSpMon3" VALUE 0xCD0BA Kw_Wu16 655350.0 Time_ms 0.00 655350.0 FORMAT "%8.1" /end CHARACTERISTIC
/begin CHARACTERISTIC DSM_SdwDfp_SWChk_CycSigChkDat_C "Enprellzeit Shadow Zustand für Fehlerpfad Dfp_SWChk_CycSigChkDat" VALUE 0xCD0BC Kw_Wu16 655350.0 Time_ms 0.00 655350.0 FORMAT "%8.1" /end CHARACTERISTIC
/begin CHARACTERISTIC DSM_SdwDfp_SWChk_CycSigChkPrg_C "Enprellzeit Shadow Zustand für Fehlerpfad Dfp_SWChk_CycSigChkPrg" VALUE 0xCD0BE Kw_Wu16 655350.0 Time_ms 0.00 655350.0 FORMAT "%8.1" /end CHARACTERISTIC
/begin CHARACTERISTIC DSM_SdwDfp_ShutCD_C "Enprellzeit Shadow Zustand für Fehlerpfad Dfp_ShutCD" VALUE 0xCD0C0 Kw_Wu16 655350.0 Time_ms 0.00 655350.0 FORMAT "%8.1" /end CHARACTERISTIC
/begin CHARACTERISTIC DSM_SdwDfp_ShutCDMax_C "Enprellzeit Shadow Zustand für Fehlerpfad Dfp_ShutCDMax" VALUE 0xCD0C2 Kw_Wu16 655350.0 Time_ms 0.00 655350.0 FORMAT "%8.1" /end CHARACTERISTIC
/begin CHARACTERISTIC DSM_SdwDfp_ShutCDMin_C "Enprellzeit Shadow Zustand für Fehlerpfad Dfp_ShutCDMin" VALUE 0xCD0C4 Kw_Wu16 655350.0 Time_ms 0.00 655350.0 FORMAT "%8.1" /end CHARACTERISTIC
/begin CHARACTERISTIC DSM_SdwDfp_ShutCDSigNpl_C "Enprellzeit Shadow Zustand für Fehlerpfad Dfp_ShutCDSigNpl" VALUE 0xCD0C6 Kw_Wu16 655350.0 Time_ms 0.00 655350.0 FORMAT "%8.1" /end CHARACTERISTIC
/begin CHARACTERISTIC DSM_SdwDfp_StSysTrqShutOff_C "Enprellzeit Shadow Zustand für Fehlerpfad Dfp_StSysTrqShutOff" VALUE 0xCD0C8 Kw_Wu16 655350.0 Time_ms 0.00 655350.0 FORMAT "%8.1" /end CHARACTERISTIC
/begin CHARACTERISTIC DSM_SdwDfp_StrtCD_Actr_C "Enprellzeit Shadow Zustand für Fehlerpfad Dfp_StrtCD_Actr" VALUE 0xCD0CA Kw_Wu16 655350.0 Time_ms 0.00 655350.0 FORMAT "%8.1" /end CHARACTERISTIC
/begin CHARACTERISTIC DSM_SdwDfp_SysLamp_C "Enprellzeit Shadow Zustand für Fehlerpfad Dfp_SysLamp" VALUE 0xCD0CC Kw_Wu16 655350.0 Time_ms 0.00 655350.0 FORMAT "%8.1" /end CHARACTERISTIC
/begin CHARACTERISTIC DSM_SdwDfp_T15CD_C "Enprellzeit Shadow Zustand für Fehlerpfad Dfp_T15CD" VALUE 0xCD0CE Kw_Wu16 655350.0 Time_ms 0.00 655350.0 FORMAT "%8.1" /end CHARACTERISTIC
/begin CHARACTERISTIC DSM_SdwDfp_TGearbx_C "Enprellzeit Shadow Zustand für Fehlerpfad Dfp_TGearbx" VALUE 0xCD0D0 Kw_Wu16 655350.0 Time_ms 0.00 655350.0 FORMAT "%8.1" /end CHARACTERISTIC
/begin CHARACTERISTIC DSM_SdwDfp_TPUMon_C "Enprellzeit Shadow Zustand für Fehlerpfad Dfp_TPUMon" VALUE 0xCD0D2 Kw_Wu16 655350.0 Time_ms 0.00 655350.0 FORMAT "%8.1" /end CHARACTERISTIC
/begin CHARACTERISTIC DSM_SdwDfp_TVACD_Max_C "Enprellzeit Shadow Zustand für Fehlerpfad Dfp_TVACD_Max" VALUE 0xCD0D4 Kw_Wu16 655350.0 Time_ms 0.00 655350.0 FORMAT "%8.1" /end CHARACTERISTIC
/begin CHARACTERISTIC DSM_SdwDfp_TVACD_Min_C "Enprellzeit Shadow Zustand für Fehlerpfad Dfp_TVACD_Min" VALUE 0xCD0D6 Kw_Wu16 655350.0 Time_ms 0.00 655350.0 FORMAT "%8.1" /end CHARACTERISTIC
/begin CHARACTERISTIC DSM_SdwDfp_TVACD_SigNpl_C "Enprellzeit Shadow Zustand für Fehlerpfad Dfp_TVACD_SigNpl" VALUE 0xCD0D8 Kw_Wu16 655350.0 Time_ms 0.00 655350.0 FORMAT "%8.1" /end CHARACTERISTIC
/begin CHARACTERISTIC DSM_SdwDfp_TVACD_TVADia1_C "Enprellzeit Shadow Zustand für Fehlerpfad Dfp_TVACD_TVADia1" VALUE 0xCD0DA Kw_Wu16 655350.0 Time_ms 0.00 655350.0 FORMAT "%8.1" /end CHARACTERISTIC
/begin CHARACTERISTIC DSM_SdwDfp_TVACD_TVADia2_C "Enprellzeit Shadow Zustand für Fehlerpfad Dfp_TVACD_TVADia2" VALUE 0xCD0DC Kw_Wu16 655350.0 Time_ms 0.00 655350.0 FORMAT "%8.1" /end CHARACTERISTIC
/begin CHARACTERISTIC DSM_SdwDfp_TVACD_TVADia3_C "Enprellzeit Shadow Zustand für Fehlerpfad Dfp_TVACD_TVADia3" VALUE 0xCD0DE Kw_Wu16 655350.0 Time_ms 0.00 655350.0 FORMAT "%8.1" /end CHARACTERISTIC
/begin CHARACTERISTIC DSM_SdwDfp_TVACD_TVADia4_C "Enprellzeit Shadow Zustand für Fehlerpfad Dfp_TVACD_TVADia4" VALUE 0xCD0E0 Kw_Wu16 655350.0 Time_ms 0.00 655350.0 FORMAT "%8.1" /end CHARACTERISTIC
/begin CHARACTERISTIC DSM_SdwDfp_VSACD_DioInDia1_C "Enprellzeit Shadow Zustand für Fehlerpfad Dfp_VSACD_DioInDia1" VALUE 0xCD0E2 Kw_Wu16 655350.0 Time_ms 0.00 655350.0 FORMAT "%8.1" /end CHARACTERISTIC
/begin CHARACTERISTIC DSM_SdwDfp_VSACD_DioInDia2_C "Enprellzeit Shadow Zustand für Fehlerpfad Dfp_VSACD_DioInDia2" VALUE 0xCD0E4 Kw_Wu16 655350.0 Time_ms 0.00 655350.0 FORMAT "%8.1" /end CHARACTERISTIC
/begin CHARACTERISTIC DSM_SdwDfp_VSACD_DioInDia3_C "Enprellzeit Shadow Zustand für Fehlerpfad Dfp_VSACD_DioInDia3" VALUE 0xCD0E6 Kw_Wu16 655350.0 Time_ms 0.00 655350.0 FORMAT "%8.1" /end CHARACTERISTIC
/begin CHARACTERISTIC DSM_SdwDfp_VSACD_DioInDia4_C "Enprellzeit Shadow Zustand für Fehlerpfad Dfp_VSACD_DioInDia4" VALUE 0xCD0E8 Kw_Wu16 655350.0 Time_ms 0.00 655350.0 FORMAT "%8.1" /end CHARACTERISTIC
/begin CHARACTERISTIC DSM_SdwDfp_VSACD_DioInMin_C "Enprellzeit Shadow Zustand für Fehlerpfad Dfp_VSACD_DioInMin" VALUE 0xCD0EA Kw_Wu16 655350.0 Time_ms 0.00 655350.0 FORMAT "%8.1" /end CHARACTERISTIC
/begin CHARACTERISTIC DSM_SdwDfp_VSACD_Max_C "Enprellzeit Shadow Zustand für Fehlerpfad Dfp_VSACD_Max" VALUE 0xCD0EC Kw_Wu16 655350.0 Time_ms 0.00 655350.0 FORMAT "%8.1" /end CHARACTERISTIC
/begin CHARACTERISTIC DSM_SdwDfp_VSACD_Min_C "Enprellzeit Shadow Zustand für Fehlerpfad Dfp_VSACD_Min" VALUE 0xCD0EE Kw_Wu16 655350.0 Time_ms 0.00 655350.0 FORMAT "%8.1" /end CHARACTERISTIC
/begin CHARACTERISTIC DSM_SdwDfp_VSACD_SigNpl_C "Enprellzeit Shadow Zustand für Fehlerpfad Dfp_VSACD_SigNpl" VALUE 0xCD0F0 Kw_Wu16 655350.0 Time_ms 0.00 655350.0 FORMAT "%8.1" /end CHARACTERISTIC
/begin CHARACTERISTIC DSM_SdwDfp_VSACD_VSADia1_C "Enprellzeit Shadow Zustand für Fehlerpfad Dfp_VSACD_VSADia1" VALUE 0xCD0F2 Kw_Wu16 655350.0 Time_ms 0.00 655350.0 FORMAT "%8.1" /end CHARACTERISTIC
/begin CHARACTERISTIC DSM_SdwDfp_VSACD_VSADia2_C "Enprellzeit Shadow Zustand für Fehlerpfad Dfp_VSACD_VSADia2" VALUE 0xCD0F4 Kw_Wu16 655350.0 Time_ms 0.00 655350.0 FORMAT "%8.1" /end CHARACTERISTIC
/begin CHARACTERISTIC DSM_SdwDfp_VSACD_VSADia3_C "Enprellzeit Shadow Zustand für Fehlerpfad Dfp_VSACD_VSADia3" VALUE 0xCD0F6 Kw_Wu16 655350.0 Time_ms 0.00 655350.0 FORMAT "%8.1" /end CHARACTERISTIC
/begin CHARACTERISTIC DSM_SdwDfp_VSACD_VSADia4_C "Enprellzeit Shadow Zustand für Fehlerpfad Dfp_VSACD_VSADia4" VALUE 0xCD0F8 Kw_Wu16 655350.0 Time_ms 0.00 655350.0 FORMAT "%8.1" /end CHARACTERISTIC
/begin CHARACTERISTIC DSM_SdwDfp_VSSCD1_C "Enprellzeit Shadow Zustand für Fehlerpfad Dfp_VSSCD1" VALUE 0xCD0FA Kw_Wu16 655350.0 Time_ms 0.00 655350.0 FORMAT "%8.1" /end CHARACTERISTIC
/begin CHARACTERISTIC DSM_SdwDfp_VSSCD2_C "Enprellzeit Shadow Zustand für Fehlerpfad Dfp_VSSCD2" VALUE 0xCD0FC Kw_Wu16 655350.0 Time_ms 0.00 655350.0 FORMAT "%8.1" /end CHARACTERISTIC
/begin CHARACTERISTIC DSM_SdwDfp_WdCom_C "Enprellzeit Shadow Zustand für Fehlerpfad Dfp_WdCom" VALUE 0xCD0FE Kw_Wu16 655350.0 Time_ms 0.00 655350.0 FORMAT "%8.1" /end CHARACTERISTIC
/begin CHARACTERISTIC DSM_TypDfp_Layer_TANS_C "Konvertierung der Fehlertypen auf der Diagnoseschnittstelle fuer Fehlerpfad Dfp_Layer_TANS" VAL_BLK 0xCD100 Kwb_Wu8 255.0 OneToOne 0.00 255.0 FORMAT "%5.1" NUMBER 4 /end CHARACTERISTIC
/begin CHARACTERISTIC DSM_TypDfp_ACCDCmpr_C "Konvertierung der Fehlertypen auf der Diagnoseschnittstelle fuer Fehlerpfad Dfp_ACCDCmpr" VAL_BLK 0xCD104 Kwb_Wu8 255.0 OneToOne 0.00 255.0 FORMAT "%5.1" NUMBER 4 /end CHARACTERISTIC
/begin CHARACTERISTIC DSM_TypDfp_ACCDPres_C "Konvertierung der Fehlertypen auf der Diagnoseschnittstelle fuer Fehlerpfad Dfp_ACCDPres" VAL_BLK 0xCD108 Kwb_Wu8 255.0 OneToOne 0.00 255.0 FORMAT "%5.1" NUMBER 4 /end CHARACTERISTIC
/begin CHARACTERISTIC DSM_TypDfp_ACCDPres1_C "Konvertierung der Fehlertypen auf der Diagnoseschnittstelle fuer Fehlerpfad Dfp_ACCDPres1" VAL_BLK 0xCD10C Kwb_Wu8 255.0 OneToOne 0.00 255.0 FORMAT "%5.1" NUMBER 4 /end CHARACTERISTIC
/begin CHARACTERISTIC DSM_TypDfp_ACCDPresAna_C "Konvertierung der Fehlertypen auf der Diagnoseschnittstelle fuer Fehlerpfad Dfp_ACCDPresAna" VAL_BLK 0xCD110 Kwb_Wu8 255.0 OneToOne 0.00 255.0 FORMAT "%5.1" NUMBER 4 /end CHARACTERISTIC
/begin CHARACTERISTIC DSM_TypDfp_ACCDSwtin_C "Konvertierung der Fehlertypen auf der Diagnoseschnittstelle fuer Fehlerpfad Dfp_ACCDSwtin" VAL_BLK 0xCD114 Kwb_Wu8 255.0 OneToOne 0.00 255.0 FORMAT "%5.1" NUMBER 4 /end CHARACTERISTIC
/begin CHARACTERISTIC DSM_TypDfp_ACC_PlausTrqDes_C "Konvertierung der Fehlertypen auf der Diagnoseschnittstelle fuer Fehlerpfad Dfp_ACC_PlausTrqDes" VAL_BLK 0xCD118 Kwb_Wu8 255.0 OneToOne 0.00 255.0 FORMAT "%5.1" NUMBER 4 /end CHARACTERISTIC
/begin CHARACTERISTIC DSM_TypDfp_ACC_trqInr_C "Konvertierung der Fehlertypen auf der Diagnoseschnittstelle fuer Fehlerpfad Dfp_ACC_trqInr" VAL_BLK 0xCD11C Kwb_Wu8 255.0 OneToOne 0.00 255.0 FORMAT "%5.1" NUMBER 4 /end CHARACTERISTIC
/begin CHARACTERISTIC DSM_TypDfp_ACTrq_C "Konvertierung der Fehlertypen auf der Diagnoseschnittstelle fuer Fehlerpfad Dfp_ACTrq" VAL_BLK 0xCD120 Kwb_Wu8 255.0 OneToOne 0.00 255.0 FORMAT "%5.1" NUMBER 4 /end CHARACTERISTIC
/begin CHARACTERISTIC DSM_TypDfp_ADCMon_C "Konvertierung der Fehlertypen auf der Diagnoseschnittstelle fuer Fehlerpfad Dfp_ADCMon" VAL_BLK 0xCD124 Kwb_Wu8 255.0 OneToOne 0.00 255.0 FORMAT "%5.1" NUMBER 4 /end CHARACTERISTIC
/begin CHARACTERISTIC DSM_TypDfp_AFSCDIdlAdjVal_C "Konvertierung der Fehlertypen auf der Diagnoseschnittstelle fuer Fehlerpfad Dfp_AFSCDIdlAdjVal" VAL_BLK 0xCD128 Kwb_Wu8 255.0 OneToOne 0.00 255.0 FORMAT "%5.1" NUMBER 4 /end CHARACTERISTIC
/begin CHARACTERISTIC DSM_TypDfp_AFSCDLdAdjVal_C "Konvertierung der Fehlertypen auf der Diagnoseschnittstelle fuer Fehlerpfad Dfp_AFSCDLdAdjVal" VAL_BLK 0xCD12C Kwb_Wu8 255.0 OneToOne 0.00 255.0 FORMAT "%5.1" NUMBER 4 /end CHARACTERISTIC
/begin CHARACTERISTIC DSM_TypDfp_AFSCD_AirTempDcyc_C "Konvertierung der Fehlertypen auf der Diagnoseschnittstelle fuer Fehlerpfad Dfp_AFSCD_AirTempDcyc" VAL_BLK 0xCD130 Kwb_Wu8 255.0 OneToOne 0.00 255.0 FORMAT "%5.1" NUMBER 4 /end CHARACTERISTIC
/begin CHARACTERISTIC DSM_TypDfp_AFSCD_PlOffsDrft_C "Konvertierung der Fehlertypen auf der Diagnoseschnittstelle fuer Fehlerpfad Dfp_AFSCD_PlOffsDrft" VAL_BLK 0xCD134 Kwb_Wu8 255.0 OneToOne 0.00 255.0 FORMAT "%5.1" NUMBER 4 /end CHARACTERISTIC
/begin CHARACTERISTIC DSM_TypDfp_AFSCD_PlSetyDrft_C "Konvertierung der Fehlertypen auf der Diagnoseschnittstelle fuer Fehlerpfad Dfp_AFSCD_PlSetyDrft" VAL_BLK 0xCD138 Kwb_Wu8 255.0 OneToOne 0.00 255.0 FORMAT "%5.1" NUMBER 4 /end CHARACTERISTIC
/begin CHARACTERISTIC DSM_TypDfp_AFSCD_SRCAirTemp_C "Konvertierung der Fehlertypen auf der Diagnoseschnittstelle fuer Fehlerpfad Dfp_AFSCD_SRCAirTemp" VAL_BLK 0xCD13C Kwb_Wu8 255.0 OneToOne 0.00 255.0 FORMAT "%5.1" NUMBER 4 /end CHARACTERISTIC
/begin CHARACTERISTIC DSM_TypDfp_AFSCD_SRCBatt_C "Konvertierung der Fehlertypen auf der Diagnoseschnittstelle fuer Fehlerpfad Dfp_AFSCD_SRCBatt" VAL_BLK 0xCD140 Kwb_Wu8 255.0 OneToOne 0.00 255.0 FORMAT "%5.1" NUMBER 4 /end CHARACTERISTIC
/begin CHARACTERISTIC DSM_TypDfp_AFSCD_SRCCorrAirm_C "Konvertierung der Fehlertypen auf der Diagnoseschnittstelle fuer Fehlerpfad Dfp_AFSCD_SRCCorrAirm" VAL_BLK 0xCD144 Kwb_Wu8 255.0 OneToOne 0.00 255.0 FORMAT "%5.1" NUMBER 4 /end CHARACTERISTIC
/begin CHARACTERISTIC DSM_TypDfp_AFSCD_SRCRawAirm_C "Konvertierung der Fehlertypen auf der Diagnoseschnittstelle fuer Fehlerpfad Dfp_AFSCD_SRCRawAirm" VAL_BLK 0xCD148 Kwb_Wu8 255.0 OneToOne 0.00 255.0 FORMAT "%5.1" NUMBER 4 /end CHARACTERISTIC
/begin CHARACTERISTIC DSM_TypDfp_Layer_TUMG_C "Konvertierung der Fehlertypen auf der Diagnoseschnittstelle fuer Fehlerpfad Dfp_Layer_TUMG" VAL_BLK 0xCD14C Kwb_Wu8 255.0 OneToOne 0.00 255.0 FORMAT "%5.1" NUMBER 4 /end CHARACTERISTIC
/begin CHARACTERISTIC DSM_TypDfp_AFSCD_SRCRefSigPer_C "Konvertierung der Fehlertypen auf der Diagnoseschnittstelle fuer Fehlerpfad Dfp_AFSCD_SRCRefSigPer" VAL_BLK 0xCD150 Kwb_Wu8 255.0 OneToOne 0.00 255.0 FORMAT "%5.1" NUMBER 4 /end CHARACTERISTIC
/begin CHARACTERISTIC DSM_TypDfp_AOHtCD_C "Konvertierung der Fehlertypen auf der Diagnoseschnittstelle fuer Fehlerpfad Dfp_AOHtCD" VAL_BLK 0xCD154 Kwb_Wu8 255.0 OneToOne 0.00 255.0 FORMAT "%5.1" NUMBER 4 /end CHARACTERISTIC
/begin CHARACTERISTIC DSM_TypDfp_Layer_GEN_C "Konvertierung der Fehlertypen auf der Diagnoseschnittstelle fuer Fehlerpfad Dfp_Layer_GEN" VAL_BLK 0xCD158 Kwb_Wu8 255.0 OneToOne 0.00 255.0 FORMAT "%5.1" NUMBER 4 /end CHARACTERISTIC
/begin CHARACTERISTIC DSM_TypDfp_Layer_BSD_C "Konvertierung der Fehlertypen auf der Diagnoseschnittstelle fuer Fehlerpfad Dfp_Layer_BSD" VAL_BLK 0xCD15C Kwb_Wu8 255.0 OneToOne 0.00 255.0 FORMAT "%5.1" NUMBER 4 /end CHARACTERISTIC
/begin CHARACTERISTIC DSM_TypDfp_AOHtCD_AOHtDia1_C "Konvertierung der Fehlertypen auf der Diagnoseschnittstelle fuer Fehlerpfad Dfp_AOHtCD_AOHtDia1" VAL_BLK 0xCD160 Kwb_Wu8 255.0 OneToOne 0.00 255.0 FORMAT "%5.1" NUMBER 4 /end CHARACTERISTIC
/begin CHARACTERISTIC DSM_TypDfp_AOHtCD_AOHtDia2_C "Konvertierung der Fehlertypen auf der Diagnoseschnittstelle fuer Fehlerpfad Dfp_AOHtCD_AOHtDia2" VAL_BLK 0xCD164 Kwb_Wu8 255.0 OneToOne 0.00 255.0 FORMAT "%5.1" NUMBER 4 /end CHARACTERISTIC
/begin CHARACTERISTIC DSM_TypDfp_AOHtCD_AOHtDia3_C "Konvertierung der Fehlertypen auf der Diagnoseschnittstelle fuer Fehlerpfad Dfp_AOHtCD_AOHtDia3" VAL_BLK 0xCD168 Kwb_Wu8 255.0 OneToOne 0.00 255.0 FORMAT "%5.1" NUMBER 4 /end CHARACTERISTIC
/begin CHARACTERISTIC DSM_TypDfp_APP1_C "Konvertierung der Fehlertypen auf der Diagnoseschnittstelle fuer Fehlerpfad Dfp_APP1" VAL_BLK 0xCD16C Kwb_Wu8 255.0 OneToOne 0.00 255.0 FORMAT "%5.1" NUMBER 4 /end CHARACTERISTIC
/begin CHARACTERISTIC DSM_TypDfp_APP2_C "Konvertierung der Fehlertypen auf der Diagnoseschnittstelle fuer Fehlerpfad Dfp_APP2" VAL_BLK 0xCD170 Kwb_Wu8 255.0 OneToOne 0.00 255.0 FORMAT "%5.1" NUMBER 4 /end CHARACTERISTIC
/begin CHARACTERISTIC DSM_TypDfp_APPSync_C "Konvertierung der Fehlertypen auf der Diagnoseschnittstelle fuer Fehlerpfad Dfp_APPSync" VAL_BLK 0xCD174 Kwb_Wu8 255.0 OneToOne 0.00 255.0 FORMAT "%5.1" NUMBER 4 /end CHARACTERISTIC
/begin CHARACTERISTIC DSM_TypDfp_APSCD_C "Konvertierung der Fehlertypen auf der Diagnoseschnittstelle fuer Fehlerpfad Dfp_APSCD" VAL_BLK 0xCD178 Kwb_Wu8 255.0 OneToOne 0.00 255.0 FORMAT "%5.1" NUMBER 4 /end CHARACTERISTIC
/begin CHARACTERISTIC DSM_TypDfp_ARS_C "Konvertierung der Fehlertypen auf der Diagnoseschnittstelle fuer Fehlerpfad Dfp_ARS" VAL_BLK 0xCD17C Kwb_Wu8 255.0 OneToOne 0.00 255.0 FORMAT "%5.1" NUMBER 4 /end CHARACTERISTIC
/begin CHARACTERISTIC DSM_TypDfp_AccPedPlausBrk_C "Konvertierung der Fehlertypen auf der Diagnoseschnittstelle fuer Fehlerpfad Dfp_AccPedPlausBrk" VAL_BLK 0xCD180 Kwb_Wu8 255.0 OneToOne 0.00 255.0 FORMAT "%5.1" NUMBER 4 /end CHARACTERISTIC
/begin CHARACTERISTIC DSM_TypDfp_AirCtlGvnrDvtRgnMax_C "Konvertierung der Fehlertypen auf der Diagnoseschnittstelle fuer Fehlerpfad Dfp_AirCtlGvnrDvtRgnMax" VAL_BLK 0xCD184 Kwb_Wu8 255.0 OneToOne 0.00 255.0 FORMAT "%5.1" NUMBER 4 /end CHARACTERISTIC
/begin CHARACTERISTIC DSM_TypDfp_Layer_QLT_C "Konvertierung der Fehlertypen auf der Diagnoseschnittstelle fuer Fehlerpfad Dfp_Layer_QLT" VAL_BLK 0xCD188 Kwb_Wu8 255.0 OneToOne 0.00 255.0 FORMAT "%5.1" NUMBER 4 /end CHARACTERISTIC
/begin CHARACTERISTIC DSM_TypDfp_AirCtlGvnrDvtRgnMax2_C "" VAL_BLK 0xCD18C Kwb_Wu8 255.0 OneToOne 0.00 255.0 FORMAT "%5.1" NUMBER 4 /end CHARACTERISTIC
/begin CHARACTERISTIC DSM_TypDfp_Layer_IBS1_C "Konvertierung der Fehlertypen auf der Diagnoseschnittstelle fuer Fehlerpfad Dfp_Layer_IBS1" VAL_BLK 0xCD190 Kwb_Wu8 255.0 OneToOne 0.00 255.0 FORMAT "%5.1" NUMBER 4 /end CHARACTERISTIC
/begin CHARACTERISTIC DSM_TypDfp_Layer_IBS2_C "Konvertierung der Fehlertypen auf der Diagnoseschnittstelle fuer Fehlerpfad Dfp_Layer_IBS2" VAL_BLK 0xCD194 Kwb_Wu8 255.0 OneToOne 0.00 255.0 FORMAT "%5.1" NUMBER 4 /end CHARACTERISTIC
/begin CHARACTERISTIC DSM_TypDfp_Layer_IBS3_C "Konvertierung der Fehlertypen auf der Diagnoseschnittstelle fuer Fehlerpfad Dfp_Layer_IBS3" VAL_BLK 0xCD198 Kwb_Wu8 255.0 OneToOne 0.00 255.0 FORMAT "%5.1" NUMBER 4 /end CHARACTERISTIC
/begin CHARACTERISTIC DSM_TypDfp_Layer_PMBN_C "Konvertierung der Fehlertypen auf der Diagnoseschnittstelle fuer Fehlerpfad Dfp_Layer_PMBN" VAL_BLK 0xCD19C Kwb_Wu8 255.0 OneToOne 0.00 255.0 FORMAT "%5.1" NUMBER 4 /end CHARACTERISTIC
/begin CHARACTERISTIC DSM_TypDfp_Layer_PMBATT_C "Konvertierung der Fehlertypen auf der Diagnoseschnittstelle fuer Fehlerpfad Dfp_Layer_PMBATT" VAL_BLK 0xCD1A0 Kwb_Wu8 255.0 OneToOne 0.00 255.0 FORMAT "%5.1" NUMBER 4 /end CHARACTERISTIC
/begin CHARACTERISTIC DSM_TypDfp_AirCtlGvnrDvtRgnMin_C "Konvertierung der Fehlertypen auf der Diagnoseschnittstelle fuer Fehlerpfad Dfp_AirCtlGvnrDvtRgnMin" VAL_BLK 0xCD1A4 Kwb_Wu8 255.0 OneToOne 0.00 255.0 FORMAT "%5.1" NUMBER 4 /end CHARACTERISTIC
/begin CHARACTERISTIC DSM_TypDfp_AirCtlGvnrDvtRgnMin2_C "" VAL_BLK 0xCD1A8 Kwb_Wu8 255.0 OneToOne 0.00 255.0 FORMAT "%5.1" NUMBER 4 /end CHARACTERISTIC
/begin CHARACTERISTIC DSM_TypDfp_AirCtlPlateBreak_C "DSM variable for Dfp_AirCtlPlateBreak_mp" VAL_BLK 0xCD1AC Kwb_Wu8 255.0 OneToOne 0.00 255.0 FORMAT "%5.1" NUMBER 4 /end CHARACTERISTIC
/begin CHARACTERISTIC DSM_TypDfp_AirCtlRmpTO_C "Konvertierung der Fehlertypen auf der Diagnoseschnittstelle fuer Fehlerpfad Dfp_AirCtlRmpTO" VAL_BLK 0xCD1B0 Kwb_Wu8 255.0 OneToOne 0.00 255.0 FORMAT "%5.1" NUMBER 4 /end CHARACTERISTIC
/begin CHARACTERISTIC DSM_TypDfp_AirCtl_GovNegDev_C "Konvertierung der Fehlertypen auf der Diagnoseschnittstelle fuer Fehlerpfad Dfp_AirCtl_GovNegDev" VAL_BLK 0xCD1B4 Kwb_Wu8 255.0 OneToOne 0.00 255.0 FORMAT "%5.1" NUMBER 4 /end CHARACTERISTIC
/begin CHARACTERISTIC DSM_TypDfp_AirCtl_GovNegDev2_C "Konvertierung der Fehlertypen auf der Diagnoseschnittstelle fuer Fehlerpfad Dfp_AirCtl_GovNegDev2" VAL_BLK 0xCD1B8 Kwb_Wu8 255.0 OneToOne 0.00 255.0 FORMAT "%5.1" NUMBER 4 /end CHARACTERISTIC
/begin CHARACTERISTIC DSM_TypDfp_AirCtl_GovPosDev_C "Konvertierung der Fehlertypen auf der Diagnoseschnittstelle fuer Fehlerpfad Dfp_AirCtl_GovPosDev" VAL_BLK 0xCD1BC Kwb_Wu8 255.0 OneToOne 0.00 255.0 FORMAT "%5.1" NUMBER 4 /end CHARACTERISTIC
/begin CHARACTERISTIC DSM_TypDfp_AirCtl_GovPosDev2_C "Konvertierung der Fehlertypen auf der Diagnoseschnittstelle fuer Fehlerpfad Dfp_AirCtl_GovPosDev2" VAL_BLK 0xCD1C0 Kwb_Wu8 255.0 OneToOne 0.00 255.0 FORMAT "%5.1" NUMBER 4 /end CHARACTERISTIC
/begin CHARACTERISTIC DSM_TypDfp_AltCD_C "Konvertierung der Fehlertypen auf der Diagnoseschnittstelle fuer Fehlerpfad Dfp_AltCD" VAL_BLK 0xCD1C4 Kwb_Wu8 255.0 OneToOne 0.00 255.0 FORMAT "%5.1" NUMBER 4 /end CHARACTERISTIC
/begin CHARACTERISTIC DSM_TypDfp_AltCD_Load_C "Konvertierung der Fehlertypen auf der Diagnoseschnittstelle fuer Fehlerpfad Dfp_AltCD_Load" VAL_BLK 0xCD1C8 Kwb_Wu8 255.0 OneToOne 0.00 255.0 FORMAT "%5.1" NUMBER 4 /end CHARACTERISTIC
/begin CHARACTERISTIC DSM_TypDfp_BPACD_BPADia1_C "Konvertierung der Fehlertypen auf der Diagnoseschnittstelle fuer Fehlerpfad Dfp_BPACD_BPADia1" VAL_BLK 0xCD1CC Kwb_Wu8 255.0 OneToOne 0.00 255.0 FORMAT "%5.1" NUMBER 4 /end CHARACTERISTIC
/begin CHARACTERISTIC DSM_TypDfp_BPACD_BPADia2_C "Konvertierung der Fehlertypen auf der Diagnoseschnittstelle fuer Fehlerpfad Dfp_BPACD_BPADia2" VAL_BLK 0xCD1D0 Kwb_Wu8 255.0 OneToOne 0.00 255.0 FORMAT "%5.1" NUMBER 4 /end CHARACTERISTIC
/begin CHARACTERISTIC DSM_TypDfp_BPACD_BPADia3_C "Konvertierung der Fehlertypen auf der Diagnoseschnittstelle fuer Fehlerpfad Dfp_BPACD_BPADia3" VAL_BLK 0xCD1D4 Kwb_Wu8 255.0 OneToOne 0.00 255.0 FORMAT "%5.1" NUMBER 4 /end CHARACTERISTIC
/begin CHARACTERISTIC DSM_TypDfp_BPACD_Max_C "Konvertierung der Fehlertypen auf der Diagnoseschnittstelle fuer Fehlerpfad Dfp_BPACD_Max" VAL_BLK 0xCD1D8 Kwb_Wu8 255.0 OneToOne 0.00 255.0 FORMAT "%5.1" NUMBER 4 /end CHARACTERISTIC
/begin CHARACTERISTIC DSM_TypDfp_BPACD_Min_C "Konvertierung der Fehlertypen auf der Diagnoseschnittstelle fuer Fehlerpfad Dfp_BPACD_Min" VAL_BLK 0xCD1DC Kwb_Wu8 255.0 OneToOne 0.00 255.0 FORMAT "%5.1" NUMBER 4 /end CHARACTERISTIC
/begin CHARACTERISTIC DSM_TypDfp_BPACD_SigNpl_C "Konvertierung der Fehlertypen auf der Diagnoseschnittstelle fuer Fehlerpfad Dfp_BPACD_SigNpl" VAL_BLK 0xCD1E0 Kwb_Wu8 255.0 OneToOne 0.00 255.0 FORMAT "%5.1" NUMBER 4 /end CHARACTERISTIC
/begin CHARACTERISTIC DSM_TypDfp_BPSCD_C "Konvertierung der Fehlertypen auf der Diagnoseschnittstelle fuer Fehlerpfad Dfp_BPSCD" VAL_BLK 0xCD1E4 Kwb_Wu8 255.0 OneToOne 0.00 255.0 FORMAT "%5.1" NUMBER 4 /end CHARACTERISTIC
/begin CHARACTERISTIC DSM_TypDfp_BattCD_C "Konvertierung der Fehlertypen auf der Diagnoseschnittstelle fuer Fehlerpfad Dfp_BattCD" VAL_BLK 0xCD1E8 Kwb_Wu8 255.0 OneToOne 0.00 255.0 FORMAT "%5.1" NUMBER 4 /end CHARACTERISTIC
/begin CHARACTERISTIC DSM_TypDfp_BrkCD_C "Konvertierung der Fehlertypen auf der Diagnoseschnittstelle fuer Fehlerpfad Dfp_BrkCD" VAL_BLK 0xCD1EC Kwb_Wu8 255.0 OneToOne 0.00 255.0 FORMAT "%5.1" NUMBER 4 /end CHARACTERISTIC
/begin CHARACTERISTIC DSM_TypDfp_Bss_C "Konvertierung der Fehlertypen auf der Diagnoseschnittstelle fuer Fehlerpfad Dfp_Bss" VAL_BLK 0xCD1F0 Kwb_Wu8 255.0 OneToOne 0.00 255.0 FORMAT "%5.1" NUMBER 4 /end CHARACTERISTIC
/begin CHARACTERISTIC DSM_TypDfp_CBACD_C "Konvertierung der Fehlertypen auf der Diagnoseschnittstelle fuer Fehlerpfad Dfp_CBACD" VAL_BLK 0xCD1F4 Kwb_Wu8 255.0 OneToOne 0.00 255.0 FORMAT "%5.1" NUMBER 4 /end CHARACTERISTIC
/begin CHARACTERISTIC DSM_TypDfp_CTSCD_C "Konvertierung der Fehlertypen auf der Diagnoseschnittstelle fuer Fehlerpfad Dfp_CTSCD" VAL_BLK 0xCD1F8 Kwb_Wu8 255.0 OneToOne 0.00 255.0 FORMAT "%5.1" NUMBER 4 /end CHARACTERISTIC
/begin CHARACTERISTIC DSM_TypDfp_Clg_DynTst_C "Konvertierung der Fehlertypen auf der Diagnoseschnittstelle fuer Fehlerpfad Dfp_Clg_DynTst" VAL_BLK 0xCD1FC Kwb_Wu8 255.0 OneToOne 0.00 255.0 FORMAT "%5.1" NUMBER 4 /end CHARACTERISTIC
/begin CHARACTERISTIC DSM_TypDfp_CmbChbMisfire1_C "Konvertierung der Fehlertypen auf der Diagnoseschnittstelle fuer Fehlerpfad Dfp_CmbChbMisfire1" VAL_BLK 0xCD200 Kwb_Wu8 255.0 OneToOne 0.00 255.0 FORMAT "%5.1" NUMBER 4 /end CHARACTERISTIC
/begin CHARACTERISTIC DSM_TypDfp_CmbChbMisfire2_C "Konvertierung der Fehlertypen auf der Diagnoseschnittstelle fuer Fehlerpfad Dfp_CmbChbMisfire2" VAL_BLK 0xCD204 Kwb_Wu8 255.0 OneToOne 0.00 255.0 FORMAT "%5.1" NUMBER 4 /end CHARACTERISTIC
/begin CHARACTERISTIC DSM_TypDfp_CmbChbMisfire3_C "Konvertierung der Fehlertypen auf der Diagnoseschnittstelle fuer Fehlerpfad Dfp_CmbChbMisfire3" VAL_BLK 0xCD208 Kwb_Wu8 255.0 OneToOne 0.00 255.0 FORMAT "%5.1" NUMBER 4 /end CHARACTERISTIC
/begin CHARACTERISTIC DSM_TypDfp_CmbChbMisfire4_C "Konvertierung der Fehlertypen auf der Diagnoseschnittstelle fuer Fehlerpfad Dfp_CmbChbMisfire4" VAL_BLK 0xCD20C Kwb_Wu8 255.0 OneToOne 0.00 255.0 FORMAT "%5.1" NUMBER 4 /end CHARACTERISTIC
/begin CHARACTERISTIC DSM_TypDfp_CmbChbMisfire5_C "Konvertierung der Fehlertypen auf der Diagnoseschnittstelle fuer Fehlerpfad Dfp_CmbChbMisfire5" VAL_BLK 0xCD210 Kwb_Wu8 255.0 OneToOne 0.00 255.0 FORMAT "%5.1" NUMBER 4 /end CHARACTERISTIC
/begin CHARACTERISTIC DSM_TypDfp_CmbChbMisfire6_C "Konvertierung der Fehlertypen auf der Diagnoseschnittstelle fuer Fehlerpfad Dfp_CmbChbMisfire6" VAL_BLK 0xCD214 Kwb_Wu8 255.0 OneToOne 0.00 255.0 FORMAT "%5.1" NUMBER 4 /end CHARACTERISTIC
/begin CHARACTERISTIC DSM_TypDfp_CmbChbMisfireMul_C "Konvertierung der Fehlertypen auf der Diagnoseschnittstelle fuer Fehlerpfad Dfp_CmbChbMisfireMul" VAL_BLK 0xCD218 Kwb_Wu8 255.0 OneToOne 0.00 255.0 FORMAT "%5.1" NUMBER 4 /end CHARACTERISTIC
/begin CHARACTERISTIC DSM_TypDfp_CoVMDCSh_C "Konvertierung der Fehlertypen auf der Diagnoseschnittstelle fuer Fehlerpfad Dfp_CoVMDCSh" VAL_BLK 0xCD21C Kwb_Wu8 255.0 OneToOne 0.00 255.0 FORMAT "%5.1" NUMBER 4 /end CHARACTERISTIC
/begin CHARACTERISTIC DSM_TypDfp_ConvCD_C "Konvertierung der Fehlertypen auf der Diagnoseschnittstelle fuer Fehlerpfad Dfp_ConvCD" VAL_BLK 0xCD220 Kwb_Wu8 255.0 OneToOne 0.00 255.0 FORMAT "%5.1" NUMBER 4 /end CHARACTERISTIC
/begin CHARACTERISTIC DSM_TypDfp_Layer_PMRUHVERL_C "Konvertierung der Fehlertypen auf der Diagnoseschnittstelle fuer Fehlerpfad Dfp_Layer_PMRUHVERL" VAL_BLK 0xCD224 Kwb_Wu8 255.0 OneToOne 0.00 255.0 FORMAT "%5.1" NUMBER 4 /end CHARACTERISTIC
/begin CHARACTERISTIC DSM_TypDfp_CrCCDMFL_C "Konvertierung der Fehlertypen auf der Diagnoseschnittstelle fuer Fehlerpfad Dfp_CrCCDMFL" VAL_BLK 0xCD228 Kwb_Wu8 255.0 OneToOne 0.00 255.0 FORMAT "%5.1" NUMBER 4 /end CHARACTERISTIC
/begin CHARACTERISTIC DSM_TypDfp_CrCtl_vCrCtl_C "Konvertierung der Fehlertypen auf der Diagnoseschnittstelle fuer Fehlerpfad Dfp_CrCtl_vCrCtl" VAL_BLK 0xCD22C Kwb_Wu8 255.0 OneToOne 0.00 255.0 FORMAT "%5.1" NUMBER 4 /end CHARACTERISTIC
/begin CHARACTERISTIC DSM_TypDfp_DCC_PlausTrqDes_C "Konvertierung der Fehlertypen auf der Diagnoseschnittstelle fuer Fehlerpfad Dfp_DCC_PlausTrqDes" VAL_BLK 0xCD230 Kwb_Wu8 255.0 OneToOne 0.00 255.0 FORMAT "%5.1" NUMBER 4 /end CHARACTERISTIC
/begin CHARACTERISTIC DSM_TypDfp_Dummy1_C "Konvertierung der Fehlertypen auf der Diagnoseschnittstelle fuer Fehlerpfad Dfp_Dummy1" VAL_BLK 0xCD234 Kwb_Wu8 255.0 OneToOne 0.00 255.0 FORMAT "%5.1" NUMBER 4 /end CHARACTERISTIC
/begin CHARACTERISTIC DSM_TypDfp_Layer_TOENS_C "Konvertierung der Fehlertypen auf der Diagnoseschnittstelle fuer Fehlerpfad Dfp_Layer_TOENS" VAL_BLK 0xCD238 Kwb_Wu8 255.0 OneToOne 0.00 255.0 FORMAT "%5.1" NUMBER 4 /end CHARACTERISTIC
/begin CHARACTERISTIC DSM_TypDfp_Layer_MANHYDR_C "Konvertierung der Fehlertypen auf der Diagnoseschnittstelle fuer Fehlerpfad Dfp_Layer_MANHYDR" VAL_BLK 0xCD23C Kwb_Wu8 255.0 OneToOne 0.00 255.0 FORMAT "%5.1" NUMBER 4 /end CHARACTERISTIC
/begin CHARACTERISTIC DSM_TypDfp_Layer_MANLUFT_C "Konvertierung der Fehlertypen auf der Diagnoseschnittstelle fuer Fehlerpfad Dfp_Layer_MANLUFT" VAL_BLK 0xCD240 Kwb_Wu8 255.0 OneToOne 0.00 255.0 FORMAT "%5.1" NUMBER 4 /end CHARACTERISTIC
/begin CHARACTERISTIC DSM_TypDfp_EATSCD_C "Konvertierung der Fehlertypen auf der Diagnoseschnittstelle fuer Fehlerpfad Dfp_EATSCD" VAL_BLK 0xCD244 Kwb_Wu8 255.0 OneToOne 0.00 255.0 FORMAT "%5.1" NUMBER 4 /end CHARACTERISTIC
/begin CHARACTERISTIC DSM_TypDfp_EBAFCD_C "Konvertierung der Fehlertypen auf der Diagnoseschnittstelle fuer Fehlerpfad Dfp_EBAFCD" VAL_BLK 0xCD248 Kwb_Wu8 255.0 OneToOne 0.00 255.0 FORMAT "%5.1" NUMBER 4 /end CHARACTERISTIC
/begin CHARACTERISTIC DSM_TypDfp_EBFCD_C "Konvertierung der Fehlertypen auf der Diagnoseschnittstelle fuer Fehlerpfad Dfp_EBFCD" VAL_BLK 0xCD24C Kwb_Wu8 255.0 OneToOne 0.00 255.0 FORMAT "%5.1" NUMBER 4 /end CHARACTERISTIC
/begin CHARACTERISTIC DSM_TypDfp_EBTSCD_C "Konvertierung der Fehlertypen auf der Diagnoseschnittstelle fuer Fehlerpfad Dfp_EBTSCD" VAL_BLK 0xCD250 Kwb_Wu8 255.0 OneToOne 0.00 255.0 FORMAT "%5.1" NUMBER 4 /end CHARACTERISTIC
/begin CHARACTERISTIC DSM_TypDfp_EBTSCD_OvrTemp_C "Konvertierung der Fehlertypen auf der Diagnoseschnittstelle fuer Fehlerpfad Dfp_EBTSCD_OvrTemp" VAL_BLK 0xCD254 Kwb_Wu8 255.0 OneToOne 0.00 255.0 FORMAT "%5.1" NUMBER 4 /end CHARACTERISTIC
/begin CHARACTERISTIC DSM_TypDfp_EEPCDVarMng_C "Konvertierung der Fehlertypen auf der Diagnoseschnittstelle fuer Fehlerpfad Dfp_EEPCDVarMng" VAL_BLK 0xCD258 Kwb_Wu8 255.0 OneToOne 0.00 255.0 FORMAT "%5.1" NUMBER 4 /end CHARACTERISTIC
/begin CHARACTERISTIC DSM_TypDfp_EGPpCD_C "Konvertierung der Fehlertypen auf der Diagnoseschnittstelle fuer Fehlerpfad Dfp_EGPpCD" VAL_BLK 0xCD25C Kwb_Wu8 255.0 OneToOne 0.00 255.0 FORMAT "%5.1" NUMBER 4 /end CHARACTERISTIC
/begin CHARACTERISTIC DSM_TypDfp_EGPpCDTPreTrbn_C "Konvertierung der Fehlertypen auf der Diagnoseschnittstelle fuer Fehlerpfad Dfp_EgPpCDTPreTrbn" VAL_BLK 0xCD260 Kwb_Wu8 255.0 OneToOne 0.00 255.0 FORMAT "%5.1" NUMBER 4 /end CHARACTERISTIC
/begin CHARACTERISTIC DSM_TypDfp_EGRCD_Max_C "Konvertierung der Fehlertypen auf der Diagnoseschnittstelle fuer Fehlerpfad Dfp_EGRCD_Max" VAL_BLK 0xCD264 Kwb_Wu8 255.0 OneToOne 0.00 255.0 FORMAT "%5.1" NUMBER 4 /end CHARACTERISTIC
/begin CHARACTERISTIC DSM_TypDfp_EGRCD_Min_C "Konvertierung der Fehlertypen auf der Diagnoseschnittstelle fuer Fehlerpfad Dfp_EGRCD_Min" VAL_BLK 0xCD268 Kwb_Wu8 255.0 OneToOne 0.00 255.0 FORMAT "%5.1" NUMBER 4 /end CHARACTERISTIC
/begin CHARACTERISTIC DSM_TypDfp_EGRCD_SigNpl_C "Konvertierung der Fehlertypen auf der Diagnoseschnittstelle fuer Fehlerpfad Dfp_EGRCD_SigNpl" VAL_BLK 0xCD26C Kwb_Wu8 255.0 OneToOne 0.00 255.0 FORMAT "%5.1" NUMBER 4 /end CHARACTERISTIC
/begin CHARACTERISTIC DSM_TypDfp_EGTRgnOilDil_C "Konvertierung der Fehlertypen auf der Diagnoseschnittstelle fuer Fehlerpfad Dfp_EGTRgnOilDil" VAL_BLK 0xCD270 Kwb_Wu8 255.0 OneToOne 0.00 255.0 FORMAT "%5.1" NUMBER 4 /end CHARACTERISTIC
/begin CHARACTERISTIC DSM_TypDfp_EMCCDNoLoad1_C "Konvertierung der Fehlertypen auf der Diagnoseschnittstelle fuer Fehlerpfad Dfp_EMCCDNoLoad1" VAL_BLK 0xCD274 Kwb_Wu8 255.0 OneToOne 0.00 255.0 FORMAT "%5.1" NUMBER 4 /end CHARACTERISTIC
/begin CHARACTERISTIC DSM_TypDfp_EMCCDNoLoad2_C "Konvertierung der Fehlertypen auf der Diagnoseschnittstelle fuer Fehlerpfad Dfp_EMCCDNoLoad2" VAL_BLK 0xCD278 Kwb_Wu8 255.0 OneToOne 0.00 255.0 FORMAT "%5.1" NUMBER 4 /end CHARACTERISTIC
/begin CHARACTERISTIC DSM_TypDfp_EMCCDSCBat1_C "Konvertierung der Fehlertypen auf der Diagnoseschnittstelle fuer Fehlerpfad Dfp_EMCCDSCBat1" VAL_BLK 0xCD27C Kwb_Wu8 255.0 OneToOne 0.00 255.0 FORMAT "%5.1" NUMBER 4 /end CHARACTERISTIC
/begin CHARACTERISTIC DSM_TypDfp_EMCCDSCBat2_C "Konvertierung der Fehlertypen auf der Diagnoseschnittstelle fuer Fehlerpfad Dfp_EMCCDSCBat2" VAL_BLK 0xCD280 Kwb_Wu8 255.0 OneToOne 0.00 255.0 FORMAT "%5.1" NUMBER 4 /end CHARACTERISTIC
/begin CHARACTERISTIC DSM_TypDfp_EMCCDSCGnd1_C "Konvertierung der Fehlertypen auf der Diagnoseschnittstelle fuer Fehlerpfad Dfp_EMCCDSCGnd1" VAL_BLK 0xCD284 Kwb_Wu8 255.0 OneToOne 0.00 255.0 FORMAT "%5.1" NUMBER 4 /end CHARACTERISTIC
/begin CHARACTERISTIC DSM_TypDfp_EMCCDSCGnd2_C "Konvertierung der Fehlertypen auf der Diagnoseschnittstelle fuer Fehlerpfad Dfp_EMCCDSCGnd2" VAL_BLK 0xCD288 Kwb_Wu8 255.0 OneToOne 0.00 255.0 FORMAT "%5.1" NUMBER 4 /end CHARACTERISTIC
/begin CHARACTERISTIC DSM_TypDfp_EMCCD_ADC1_C "Konvertierung der Fehlertypen auf der Diagnoseschnittstelle fuer Fehlerpfad Dfp_EMCCD_ADC1" VAL_BLK 0xCD28C Kwb_Wu8 255.0 OneToOne 0.00 255.0 FORMAT "%5.1" NUMBER 4 /end CHARACTERISTIC
/begin CHARACTERISTIC DSM_TypDfp_EMCCD_ADC2_C "Konvertierung der Fehlertypen auf der Diagnoseschnittstelle fuer Fehlerpfad Dfp_EMCCD_ADC2" VAL_BLK 0xCD290 Kwb_Wu8 255.0 OneToOne 0.00 255.0 FORMAT "%5.1" NUMBER 4 /end CHARACTERISTIC
/begin CHARACTERISTIC DSM_TypDfp_ETClbETFltInj1_C "Konvertierung der Fehlertypen auf der Diagnoseschnittstelle fuer Fehlerpfad Dfp_ETClbETFltInj1" VAL_BLK 0xCD294 Kwb_Wu8 255.0 OneToOne 0.00 255.0 FORMAT "%5.1" NUMBER 4 /end CHARACTERISTIC
/begin CHARACTERISTIC DSM_TypDfp_ETClbETFltInj2_C "Konvertierung der Fehlertypen auf der Diagnoseschnittstelle fuer Fehlerpfad Dfp_ETClbETFltInj2" VAL_BLK 0xCD298 Kwb_Wu8 255.0 OneToOne 0.00 255.0 FORMAT "%5.1" NUMBER 4 /end CHARACTERISTIC
/begin CHARACTERISTIC DSM_TypDfp_ETClbETFltInj3_C "Konvertierung der Fehlertypen auf der Diagnoseschnittstelle fuer Fehlerpfad Dfp_ETClbETFltInj3" VAL_BLK 0xCD29C Kwb_Wu8 255.0 OneToOne 0.00 255.0 FORMAT "%5.1" NUMBER 4 /end CHARACTERISTIC
/begin CHARACTERISTIC DSM_TypDfp_ETClbETFltInj4_C "Konvertierung der Fehlertypen auf der Diagnoseschnittstelle fuer Fehlerpfad Dfp_ETClbETFltInj4" VAL_BLK 0xCD2A0 Kwb_Wu8 255.0 OneToOne 0.00 255.0 FORMAT "%5.1" NUMBER 4 /end CHARACTERISTIC
/begin CHARACTERISTIC DSM_TypDfp_ETClbETFltInj5_C "Konvertierung der Fehlertypen auf der Diagnoseschnittstelle fuer Fehlerpfad Dfp_ETClbETFltInj5" VAL_BLK 0xCD2A4 Kwb_Wu8 255.0 OneToOne 0.00 255.0 FORMAT "%5.1" NUMBER 4 /end CHARACTERISTIC
/begin CHARACTERISTIC DSM_TypDfp_ETClbETFltInj6_C "Konvertierung der Fehlertypen auf der Diagnoseschnittstelle fuer Fehlerpfad Dfp_ETClbETFltInj6" VAL_BLK 0xCD2A8 Kwb_Wu8 255.0 OneToOne 0.00 255.0 FORMAT "%5.1" NUMBER 4 /end CHARACTERISTIC
/begin CHARACTERISTIC DSM_TypDfp_ETClbInj1_C "Konvertierung der Fehlertypen auf der Diagnoseschnittstelle fuer Fehlerpfad Dfp_ETClbInj1" VAL_BLK 0xCD2AC Kwb_Wu8 255.0 OneToOne 0.00 255.0 FORMAT "%5.1" NUMBER 4 /end CHARACTERISTIC
/begin CHARACTERISTIC DSM_TypDfp_ETClbInj2_C "Konvertierung der Fehlertypen auf der Diagnoseschnittstelle fuer Fehlerpfad Dfp_ETClbInj2" VAL_BLK 0xCD2B0 Kwb_Wu8 255.0 OneToOne 0.00 255.0 FORMAT "%5.1" NUMBER 4 /end CHARACTERISTIC
/begin CHARACTERISTIC DSM_TypDfp_ETClbInj3_C "Konvertierung der Fehlertypen auf der Diagnoseschnittstelle fuer Fehlerpfad Dfp_ETClbInj3" VAL_BLK 0xCD2B4 Kwb_Wu8 255.0 OneToOne 0.00 255.0 FORMAT "%5.1" NUMBER 4 /end CHARACTERISTIC
/begin CHARACTERISTIC DSM_TypDfp_ETClbInj4_C "Konvertierung der Fehlertypen auf der Diagnoseschnittstelle fuer Fehlerpfad Dfp_ETClbInj4" VAL_BLK 0xCD2B8 Kwb_Wu8 255.0 OneToOne 0.00 255.0 FORMAT "%5.1" NUMBER 4 /end CHARACTERISTIC
/begin CHARACTERISTIC DSM_TypDfp_ETClbInj5_C "Konvertierung der Fehlertypen auf der Diagnoseschnittstelle fuer Fehlerpfad Dfp_ETClbInj5" VAL_BLK 0xCD2BC Kwb_Wu8 255.0 OneToOne 0.00 255.0 FORMAT "%5.1" NUMBER 4 /end CHARACTERISTIC
/begin CHARACTERISTIC DSM_TypDfp_ETClbInj6_C "Konvertierung der Fehlertypen auf der Diagnoseschnittstelle fuer Fehlerpfad Dfp_ETClbInj6" VAL_BLK 0xCD2C0 Kwb_Wu8 255.0 OneToOne 0.00 255.0 FORMAT "%5.1" NUMBER 4 /end CHARACTERISTIC
/begin CHARACTERISTIC DSM_TypDfp_EngMCaS1_C "Konvertierung der Fehlertypen auf der Diagnoseschnittstelle fuer Fehlerpfad Dfp_EngMCaS1" VAL_BLK 0xCD2C4 Kwb_Wu8 255.0 OneToOne 0.00 255.0 FORMAT "%5.1" NUMBER 4 /end CHARACTERISTIC
/begin CHARACTERISTIC DSM_TypDfp_EngMCrS1_C "Konvertierung der Fehlertypen auf der Diagnoseschnittstelle fuer Fehlerpfad Dfp_EngMCrS1" VAL_BLK 0xCD2C8 Kwb_Wu8 255.0 OneToOne 0.00 255.0 FORMAT "%5.1" NUMBER 4 /end CHARACTERISTIC
/begin CHARACTERISTIC DSM_TypDfp_EngMOfsCaSCrS_C "Konvertierung der Fehlertypen auf der Diagnoseschnittstelle fuer Fehlerpfad Dfp_EngMOfsCaSCrS" VAL_BLK 0xCD2CC Kwb_Wu8 255.0 OneToOne 0.00 255.0 FORMAT "%5.1" NUMBER 4 /end CHARACTERISTIC
/begin CHARACTERISTIC DSM_TypDfp_EngPrtFWODet_C "Konvertierung der Fehlertypen auf der Diagnoseschnittstelle fuer Fehlerpfad Dfp_EngPrtFWODet" VAL_BLK 0xCD2D0 Kwb_Wu8 255.0 OneToOne 0.00 255.0 FORMAT "%5.1" NUMBER 4 /end CHARACTERISTIC
/begin CHARACTERISTIC DSM_TypDfp_FBCqDvt_C "Konvertierung der Fehlertypen auf der Diagnoseschnittstelle fuer Fehlerpfad Dfp_FBCqDvt" VAL_BLK 0xCD2D4 Kwb_Wu8 255.0 OneToOne 0.00 255.0 FORMAT "%5.1" NUMBER 4 /end CHARACTERISTIC
/begin CHARACTERISTIC DSM_TypDfp_FMTC_NonMonotonMap_C "Konvertierung der Fehlertypen auf der Diagnoseschnittstelle fuer Fehlerpfad Dfp_FMTC_NonMonotonMap" VAL_BLK 0xCD2D8 Kwb_Wu8 255.0 OneToOne 0.00 255.0 FORMAT "%5.1" NUMBER 4 /end CHARACTERISTIC
/begin CHARACTERISTIC DSM_TypDfp_FTSCD_C "Konvertierung der Fehlertypen auf der Diagnoseschnittstelle fuer Fehlerpfad Dfp_FTSCD" VAL_BLK 0xCD2DC Kwb_Wu8 255.0 OneToOne 0.00 255.0 FORMAT "%5.1" NUMBER 4 /end CHARACTERISTIC
/begin CHARACTERISTIC DSM_TypDfp_FanCD_C "Konvertierung der Fehlertypen auf der Diagnoseschnittstelle fuer Fehlerpfad Dfp_FanCD" VAL_BLK 0xCD2E0 Kwb_Wu8 255.0 OneToOne 0.00 255.0 FORMAT "%5.1" NUMBER 4 /end CHARACTERISTIC
/begin CHARACTERISTIC DSM_TypDfp_FanCD_FanCtlr1_C "Konvertierung der Fehlertypen auf der Diagnoseschnittstelle fuer Fehlerpfad Dfp_FanCD_FanCtlr1" VAL_BLK 0xCD2E4 Kwb_Wu8 255.0 OneToOne 0.00 255.0 FORMAT "%5.1" NUMBER 4 /end CHARACTERISTIC
/begin CHARACTERISTIC DSM_TypDfp_FanCD_FanCtlr2_C "Konvertierung der Fehlertypen auf der Diagnoseschnittstelle fuer Fehlerpfad Dfp_FanCD_FanCtlr2" VAL_BLK 0xCD2E8 Kwb_Wu8 255.0 OneToOne 0.00 255.0 FORMAT "%5.1" NUMBER 4 /end CHARACTERISTIC
/begin CHARACTERISTIC DSM_TypDfp_FanCD_FanCtlr3_C "Konvertierung der Fehlertypen auf der Diagnoseschnittstelle fuer Fehlerpfad Dfp_FanCD_FanCtlr3" VAL_BLK 0xCD2EC Kwb_Wu8 255.0 OneToOne 0.00 255.0 FORMAT "%5.1" NUMBER 4 /end CHARACTERISTIC
/begin CHARACTERISTIC DSM_TypDfp_FlFCD_C "Konvertierung der Fehlertypen auf der Diagnoseschnittstelle fuer Fehlerpfad Dfp_FlFCD" VAL_BLK 0xCD2F0 Kwb_Wu8 255.0 OneToOne 0.00 255.0 FORMAT "%5.1" NUMBER 4 /end CHARACTERISTIC
/begin CHARACTERISTIC DSM_TypDfp_FlMngSmkDefect_C "Konvertierung der Fehlertypen auf der Diagnoseschnittstelle fuer Fehlerpfad Dfp_FlMngSmkDefect" VAL_BLK 0xCD2F4 Kwb_Wu8 255.0 OneToOne 0.00 255.0 FORMAT "%5.1" NUMBER 4 /end CHARACTERISTIC
/begin CHARACTERISTIC DSM_TypDfp_FrmMngANFRADMOMPT_C "Konvertierung der Fehlertypen auf der Diagnoseschnittstelle fuer Fehlerpfad Dfp_FrmMngANFRADMOMPT" VAL_BLK 0xCD2F8 Kwb_Wu8 255.0 OneToOne 0.00 255.0 FORMAT "%5.1" NUMBER 4 /end CHARACTERISTIC
/begin CHARACTERISTIC DSM_TypDfp_FrmMngASC1_C "Konvertierung der Fehlertypen auf der Diagnoseschnittstelle fuer Fehlerpfad Dfp_FrmMngASC1" VAL_BLK 0xCD2FC Kwb_Wu8 255.0 OneToOne 0.00 255.0 FORMAT "%5.1" NUMBER 4 /end CHARACTERISTIC
/begin CHARACTERISTIC DSM_TypDfp_FrmMngASC2_C "Konvertierung der Fehlertypen auf der Diagnoseschnittstelle fuer Fehlerpfad Dfp_FrmMngASC2" VAL_BLK 0xCD300 Kwb_Wu8 255.0 OneToOne 0.00 255.0 FORMAT "%5.1" NUMBER 4 /end CHARACTERISTIC
/begin CHARACTERISTIC DSM_TypDfp_FrmMngASC3_C "Konvertierung der Fehlertypen auf der Diagnoseschnittstelle fuer Fehlerpfad Dfp_FrmMngASC3" VAL_BLK 0xCD304 Kwb_Wu8 255.0 OneToOne 0.00 255.0 FORMAT "%5.1" NUMBER 4 /end CHARACTERISTIC
/begin CHARACTERISTIC DSM_TypDfp_FrmMngASC4_C "Konvertierung der Fehlertypen auf der Diagnoseschnittstelle fuer Fehlerpfad Dfp_FrmMngASC4" VAL_BLK 0xCD308 Kwb_Wu8 255.0 OneToOne 0.00 255.0 FORMAT "%5.1" NUMBER 4 /end CHARACTERISTIC
/begin CHARACTERISTIC DSM_TypDfp_FrmMngBOS_RESET_C "Konvertierung der Fehlertypen auf der Diagnoseschnittstelle fuer Fehlerpfad Dfp_FrmMngBOS_RESET" VAL_BLK 0xCD30C Kwb_Wu8 255.0 OneToOne 0.00 255.0 FORMAT "%5.1" NUMBER 4 /end CHARACTERISTIC
/begin CHARACTERISTIC DSM_TypDfp_FrmMngBOS_RESET_2_C "" VAL_BLK 0xCD310 Kwb_Wu8 255.0 OneToOne 0.00 255.0 FORMAT "%5.1" NUMBER 4 /end CHARACTERISTIC
/begin CHARACTERISTIC DSM_TypDfp_FrmMngDMANFAFS_C "Konvertierung der Fehlertypen auf der Diagnoseschnittstelle fuer Fehlerpfad Dfp_FrmMngDMANFAFS" VAL_BLK 0xCD314 Kwb_Wu8 255.0 OneToOne 0.00 255.0 FORMAT "%5.1" NUMBER 4 /end CHARACTERISTIC
/begin CHARACTERISTIC DSM_TypDfp_FrmMngDRMANFSSG_C "Konvertierung der Fehlertypen auf der Diagnoseschnittstelle fuer Fehlerpfad Dfp_FrmMngDRMANFSSG" VAL_BLK 0xCD318 Kwb_Wu8 255.0 OneToOne 0.00 255.0 FORMAT "%5.1" NUMBER 4 /end CHARACTERISTIC
/begin CHARACTERISTIC DSM_TypDfp_FrmMngEGS1_C "Konvertierung der Fehlertypen auf der Diagnoseschnittstelle fuer Fehlerpfad Dfp_FrmMngEGS1" VAL_BLK 0xCD31C Kwb_Wu8 255.0 OneToOne 0.00 255.0 FORMAT "%5.1" NUMBER 4 /end CHARACTERISTIC
/begin CHARACTERISTIC DSM_TypDfp_FrmMngEGS2_C "Konvertierung der Fehlertypen auf der Diagnoseschnittstelle fuer Fehlerpfad Dfp_FrmMngEGS2" VAL_BLK 0xCD320 Kwb_Wu8 255.0 OneToOne 0.00 255.0 FORMAT "%5.1" NUMBER 4 /end CHARACTERISTIC
/begin CHARACTERISTIC DSM_TypDfp_FrmMngGEARBX_DATA_C "type for faults in path" VAL_BLK 0xCD324 Kwb_Wu8 255.0 OneToOne 0.00 255.0 FORMAT "%5.1" NUMBER 4 /end CHARACTERISTIC
/begin CHARACTERISTIC DSM_TypDfp_FrmMngGEARBX_DATA2_C "Konvertierung der Fehlertypen auf der Diagnoseschnittstelle fuer Fehlerpfad Dfp_FrmMngGEARBX_DATA2" VAL_BLK 0xCD328 Kwb_Wu8 255.0 OneToOne 0.00 255.0 FORMAT "%5.1" NUMBER 4 /end CHARACTERISTIC
/begin CHARACTERISTIC DSM_TypDfp_FrmMngHEAT_AC_C "type for faults in path" VAL_BLK 0xCD32C Kwb_Wu8 255.0 OneToOne 0.00 255.0 FORMAT "%5.1" NUMBER 4 /end CHARACTERISTIC
/begin CHARACTERISTIC DSM_TypDfp_FrmMngINSTR2_C "Konvertierung der Fehlertypen auf der Diagnoseschnittstelle fuer Fehlerpfad Dfp_FrmMngINSTR2" VAL_BLK 0xCD330 Kwb_Wu8 255.0 OneToOne 0.00 255.0 FORMAT "%5.1" NUMBER 4 /end CHARACTERISTIC
/begin CHARACTERISTIC DSM_TypDfp_FrmMngINSTR3_C "Konvertierung der Fehlertypen auf der Diagnoseschnittstelle fuer Fehlerpfad Dfp_FrmMngINSTR3" VAL_BLK 0xCD334 Kwb_Wu8 255.0 OneToOne 0.00 255.0 FORMAT "%5.1" NUMBER 4 /end CHARACTERISTIC
/begin CHARACTERISTIC DSM_TypDfp_FrmMngLENKRADWINKEL_C "Konvertierung der Fehlertypen auf der Diagnoseschnittstelle fuer Fehlerpfad Dfp_FrmMngLENKRADWINKEL" VAL_BLK 0xCD338 Kwb_Wu8 255.0 OneToOne 0.00 255.0 FORMAT "%5.1" NUMBER 4 /end CHARACTERISTIC
/begin CHARACTERISTIC DSM_TypDfp_FrmMngMILEAGE_RANGE_C "Konvertierung der Fehlertypen auf der Diagnoseschnittstelle fuer Fehlerpfad Dfp_FrmMngMILEAGE_RANGE" VAL_BLK 0xCD33C Kwb_Wu8 255.0 OneToOne 0.00 255.0 FORMAT "%5.1" NUMBER 4 /end CHARACTERISTIC
/begin CHARACTERISTIC DSM_TypDfp_FrmMngOPCRCTLACC_C "Konvertierung der Fehlertypen auf der Diagnoseschnittstelle fuer Fehlerpfad Dfp_FrmMngOPCRCTLACC" VAL_BLK 0xCD340 Kwb_Wu8 255.0 OneToOne 0.00 255.0 FORMAT "%5.1" NUMBER 4 /end CHARACTERISTIC
/begin CHARACTERISTIC DSM_TypDfp_FrmMngPRGG_CCTR_C "Konvertierung der Fehlertypen auf der Diagnoseschnittstelle fuer Fehlerpfad Dfp_FrmMngPRGG_CCTR" VAL_BLK 0xCD344 Kwb_Wu8 255.0 OneToOne 0.00 255.0 FORMAT "%5.1" NUMBER 4 /end CHARACTERISTIC
/begin CHARACTERISTIC DSM_TypDfp_FrmMngPWRMNG_LOADV_C "Konvertierung der Fehlertypen auf der Diagnoseschnittstelle fuer Fehlerpfad Dfp_FrmMngPWRMNG_LOADV" VAL_BLK 0xCD348 Kwb_Wu8 255.0 OneToOne 0.00 255.0 FORMAT "%5.1" NUMBER 4 /end CHARACTERISTIC
/begin CHARACTERISTIC DSM_TypDfp_FrmMngParkConsumer_C "Konvertierung der Fehlertypen auf der Diagnoseschnittstelle fuer Fehlerpfad Dfp_FrmMngParkConsumer" VAL_BLK 0xCD34C Kwb_Wu8 255.0 OneToOne 0.00 255.0 FORMAT "%5.1" NUMBER 4 /end CHARACTERISTIC
/begin CHARACTERISTIC DSM_TypDfp_FrmMngRQSTGEFAN_C "RQ_STG_EFAN - CAN-message related errors" VAL_BLK 0xCD350 Kwb_Wu8 255.0 OneToOne 0.00 255.0 FORMAT "%5.1" NUMBER 4 /end CHARACTERISTIC
/begin CHARACTERISTIC DSM_TypDfp_FrmMngSSGErr_C "Konvertierung der Fehlertypen auf der Diagnoseschnittstelle fuer Fehlerpfad Dfp_FrmMngSSGErr" VAL_BLK 0xCD354 Kwb_Wu8 255.0 OneToOne 0.00 255.0 FORMAT "%5.1" NUMBER 4 /end CHARACTERISTIC
/begin CHARACTERISTIC DSM_TypDfp_FrmMngSSGShOff_C "Konvertierung der Fehlertypen auf der Diagnoseschnittstelle fuer Fehlerpfad Dfp_FrmMngSSGShOff" VAL_BLK 0xCD358 Kwb_Wu8 255.0 OneToOne 0.00 255.0 FORMAT "%5.1" NUMBER 4 /end CHARACTERISTIC
/begin CHARACTERISTIC DSM_TypDfp_FrmMngSTAT_ANH_C "Konvertierung der Fehlertypen auf der Diagnoseschnittstelle fuer Fehlerpfad Dfp_FrmMngSTAT_ANH" VAL_BLK 0xCD35C Kwb_Wu8 255.0 OneToOne 0.00 255.0 FORMAT "%5.1" NUMBER 4 /end CHARACTERISTIC
/begin CHARACTERISTIC DSM_TypDfp_FrmMngSTAT_ARS_C "type for faults in path" VAL_BLK 0xCD360 Kwb_Wu8 255.0 OneToOne 0.00 255.0 FORMAT "%5.1" NUMBER 4 /end CHARACTERISTIC
/begin CHARACTERISTIC DSM_TypDfp_FrmMngSTAT_DSC_C "type for faults in path" VAL_BLK 0xCD364 Kwb_Wu8 255.0 OneToOne 0.00 255.0 FORMAT "%5.1" NUMBER 4 /end CHARACTERISTIC
/begin CHARACTERISTIC DSM_TypDfp_FrmMngSTAT_EKP_C "Konvertierung der Fehlertypen auf der Diagnoseschnittstelle fuer Fehlerpfad Dfp_FrmMngSTAT_EKP" VAL_BLK 0xCD368 Kwb_Wu8 255.0 OneToOne 0.00 255.0 FORMAT "%5.1" NUMBER 4 /end CHARACTERISTIC
/begin CHARACTERISTIC DSM_TypDfp_FrmMngSTAT_KOMBI_C "Konvertierung der Fehlertypen auf der Diagnoseschnittstelle fuer Fehlerpfad Dfp_FrmMngSTAT_KOMBI" VAL_BLK 0xCD36C Kwb_Wu8 255.0 OneToOne 0.00 255.0 FORMAT "%5.1" NUMBER 4 /end CHARACTERISTIC
/begin CHARACTERISTIC DSM_TypDfp_FrmMngSTAT_SITZ_C "Konvertierung der Fehlertypen auf der Diagnoseschnittstelle fuer Fehlerpfad Dfp_FrmMngSTAT_SITZ" VAL_BLK 0xCD370 Kwb_Wu8 255.0 OneToOne 0.00 255.0 FORMAT "%5.1" NUMBER 4 /end CHARACTERISTIC
/begin CHARACTERISTIC DSM_TypDfp_FrmMngStOBDGbxMilOf_C "Konvertierung der Fehlertypen auf der Diagnoseschnittstelle fuer Fehlerpfad Dfp_FrmMngStOBDGbxMilOf" VAL_BLK 0xCD374 Kwb_Wu8 255.0 OneToOne 0.00 255.0 FORMAT "%5.1" NUMBER 4 /end CHARACTERISTIC
/begin CHARACTERISTIC DSM_TypDfp_FrmMngStOBDGbxMilOn_C "Konvertierung der Fehlertypen auf der Diagnoseschnittstelle fuer Fehlerpfad Dfp_FrmMngStOBDGbxMilOn" VAL_BLK 0xCD378 Kwb_Wu8 255.0 OneToOne 0.00 255.0 FORMAT "%5.1" NUMBER 4 /end CHARACTERISTIC
/begin CHARACTERISTIC DSM_TypDfp_FrmMngTEMPRELTIME_C "Konvertierung der Fehlertypen auf der Diagnoseschnittstelle fuer Fehlerpfad Dfp_FrmMngTEMPRELTIME" VAL_BLK 0xCD37C Kwb_Wu8 255.0 OneToOne 0.00 255.0 FORMAT "%5.1" NUMBER 4 /end CHARACTERISTIC
/begin CHARACTERISTIC DSM_TypDfp_FrmMngTERMINAL_C "type for faults in path" VAL_BLK 0xCD380 Kwb_Wu8 255.0 OneToOne 0.00 255.0 FORMAT "%5.1" NUMBER 4 /end CHARACTERISTIC
/begin CHARACTERISTIC DSM_TypDfp_FrmMngTIME_DATE_C "Konvertierung der Fehlertypen auf der Diagnoseschnittstelle fuer Fehlerpfad Dfp_FrmMngTIME_DATE" VAL_BLK 0xCD384 Kwb_Wu8 255.0 OneToOne 0.00 255.0 FORMAT "%5.1" NUMBER 4 /end CHARACTERISTIC
/begin CHARACTERISTIC DSM_TypDfp_FrmMngTORQUE_DSC_C "type for faults in path" VAL_BLK 0xCD388 Kwb_Wu8 255.0 OneToOne 0.00 255.0 FORMAT "%5.1" NUMBER 4 /end CHARACTERISTIC
/begin CHARACTERISTIC DSM_TypDfp_FrmMngTORQUE_GEARBX_C "type for faults in path" VAL_BLK 0xCD38C Kwb_Wu8 255.0 OneToOne 0.00 255.0 FORMAT "%5.1" NUMBER 4 /end CHARACTERISTIC
/begin CHARACTERISTIC DSM_TypDfp_FrmMngTrq_ReqACC_C "Konvertierung der Fehlertypen auf der Diagnoseschnittstelle fuer Fehlerpfad Dfp_FrmMngTrq_ReqACC" VAL_BLK 0xCD390 Kwb_Wu8 255.0 OneToOne 0.00 255.0 FORMAT "%5.1" NUMBER 4 /end CHARACTERISTIC
/begin CHARACTERISTIC DSM_TypDfp_FrmMngVEH_MOD_C "VEH_MOD - CAN-message related errors" VAL_BLK 0xCD394 Kwb_Wu8 255.0 OneToOne 0.00 255.0 FORMAT "%5.1" NUMBER 4 /end CHARACTERISTIC
/begin CHARACTERISTIC DSM_TypDfp_FrmMngVELOCITY_C "type for faults in path" VAL_BLK 0xCD398 Kwb_Wu8 255.0 OneToOne 0.00 255.0 FORMAT "%5.1" NUMBER 4 /end CHARACTERISTIC
/begin CHARACTERISTIC DSM_TypDfp_FrmMngWHEEL_SPEED_C "Konvertierung der Fehlertypen auf der Diagnoseschnittstelle fuer Fehlerpfad Dfp_FrmMngWHEEL_SPEED" VAL_BLK 0xCD39C Kwb_Wu8 255.0 OneToOne 0.00 255.0 FORMAT "%5.1" NUMBER 4 /end CHARACTERISTIC
/begin CHARACTERISTIC DSM_TypDfp_FrmMngstCurr_C "Fehlertyp Feld für Dfp_FrmMngstCurr" VAL_BLK 0xCD3A0 Kwb_Wu8 255.0 OneToOne 0.00 255.0 FORMAT "%5.1" NUMBER 4 /end CHARACTERISTIC
/begin CHARACTERISTIC DSM_TypDfp_FrmMngswtPSPOff_C "Fehlertyp Feld für Dfp_FrmMngswtPSPOff" VAL_BLK 0xCD3A4 Kwb_Wu8 255.0 OneToOne 0.00 255.0 FORMAT "%5.1" NUMBER 4 /end CHARACTERISTIC
/begin CHARACTERISTIC DSM_TypDfp_GearbxIncMax_C "Konvertierung der Fehlertypen auf der Diagnoseschnittstelle fuer Fehlerpfad Dfp_GearbxIncMax" VAL_BLK 0xCD3A8 Kwb_Wu8 255.0 OneToOne 0.00 255.0 FORMAT "%5.1" NUMBER 4 /end CHARACTERISTIC
/begin CHARACTERISTIC DSM_TypDfp_GlwCD_C "Konvertierung der Fehlertypen auf der Diagnoseschnittstelle fuer Fehlerpfad Dfp_GlwCD" VAL_BLK 0xCD3AC Kwb_Wu8 255.0 OneToOne 0.00 255.0 FORMAT "%5.1" NUMBER 4 /end CHARACTERISTIC
/begin CHARACTERISTIC DSM_TypDfp_GlwCDGlwCirc1_C "Konvertierung der Fehlertypen auf der Diagnoseschnittstelle fuer Fehlerpfad Dfp_GlwCDGlwCirc1" VAL_BLK 0xCD3B0 Kwb_Wu8 255.0 OneToOne 0.00 255.0 FORMAT "%5.1" NUMBER 4 /end CHARACTERISTIC
/begin CHARACTERISTIC DSM_TypDfp_GlwCDGlwCirc2_C "Konvertierung der Fehlertypen auf der Diagnoseschnittstelle fuer Fehlerpfad Dfp_GlwCDGlwCirc2" VAL_BLK 0xCD3B4 Kwb_Wu8 255.0 OneToOne 0.00 255.0 FORMAT "%5.1" NUMBER 4 /end CHARACTERISTIC
/begin CHARACTERISTIC DSM_TypDfp_GlwCDGlwCirc3_C "Konvertierung der Fehlertypen auf der Diagnoseschnittstelle fuer Fehlerpfad Dfp_GlwCDGlwCirc3" VAL_BLK 0xCD3B8 Kwb_Wu8 255.0 OneToOne 0.00 255.0 FORMAT "%5.1" NUMBER 4 /end CHARACTERISTIC
/begin CHARACTERISTIC DSM_TypDfp_GlwCDGlwCirc4_C "Konvertierung der Fehlertypen auf der Diagnoseschnittstelle fuer Fehlerpfad Dfp_GlwCDGlwCirc4" VAL_BLK 0xCD3BC Kwb_Wu8 255.0 OneToOne 0.00 255.0 FORMAT "%5.1" NUMBER 4 /end CHARACTERISTIC
/begin CHARACTERISTIC DSM_TypDfp_GlwCDGlwCirc5_C "Konvertierung der Fehlertypen auf der Diagnoseschnittstelle fuer Fehlerpfad Dfp_GlwCDGlwCirc5" VAL_BLK 0xCD3C0 Kwb_Wu8 255.0 OneToOne 0.00 255.0 FORMAT "%5.1" NUMBER 4 /end CHARACTERISTIC
/begin CHARACTERISTIC DSM_TypDfp_GlwCDGlwCirc6_C "Konvertierung der Fehlertypen auf der Diagnoseschnittstelle fuer Fehlerpfad Dfp_GlwCDGlwCirc6" VAL_BLK 0xCD3C4 Kwb_Wu8 255.0 OneToOne 0.00 255.0 FORMAT "%5.1" NUMBER 4 /end CHARACTERISTIC
/begin CHARACTERISTIC DSM_TypDfp_GlwCDGlwCirc7_C "Konvertierung der Fehlertypen auf der Diagnoseschnittstelle fuer Fehlerpfad Dfp_GlwCDGlwCirc7" VAL_BLK 0xCD3C8 Kwb_Wu8 255.0 OneToOne 0.00 255.0 FORMAT "%5.1" NUMBER 4 /end CHARACTERISTIC
/begin CHARACTERISTIC DSM_TypDfp_GlwCDGlwCirc8_C "Konvertierung der Fehlertypen auf der Diagnoseschnittstelle fuer Fehlerpfad Dfp_GlwCDGlwCirc8" VAL_BLK 0xCD3CC Kwb_Wu8 255.0 OneToOne 0.00 255.0 FORMAT "%5.1" NUMBER 4 /end CHARACTERISTIC
/begin CHARACTERISTIC DSM_TypDfp_GlwCtl_C "Konvertierung der Fehlertypen auf der Diagnoseschnittstelle fuer Fehlerpfad Dfp_GlwCtl" VAL_BLK 0xCD3D0 Kwb_Wu8 255.0 OneToOne 0.00 255.0 FORMAT "%5.1" NUMBER 4 /end CHARACTERISTIC
/begin CHARACTERISTIC DSM_TypDfp_HWEMonCom_C "Konvertierung der Fehlertypen auf der Diagnoseschnittstelle fuer Fehlerpfad Dfp_HWEMonCom" VAL_BLK 0xCD3D4 Kwb_Wu8 255.0 OneToOne 0.00 255.0 FORMAT "%5.1" NUMBER 4 /end CHARACTERISTIC
/begin CHARACTERISTIC DSM_TypDfp_HWEMonEEPROM_C "Konvertierung der Fehlertypen auf der Diagnoseschnittstelle fuer Fehlerpfad Dfp_HWEMonEEPROM" VAL_BLK 0xCD3D8 Kwb_Wu8 255.0 OneToOne 0.00 255.0 FORMAT "%5.1" NUMBER 4 /end CHARACTERISTIC
/begin CHARACTERISTIC DSM_TypDfp_HWEMonRcyLocked_C "Konvertierung der Fehlertypen auf der Diagnoseschnittstelle fuer Fehlerpfad Dfp_HWEMonRcyLocked" VAL_BLK 0xCD3DC Kwb_Wu8 255.0 OneToOne 0.00 255.0 FORMAT "%5.1" NUMBER 4 /end CHARACTERISTIC
/begin CHARACTERISTIC DSM_TypDfp_HWEMonRcySuppressed_C "Konvertierung der Fehlertypen auf der Diagnoseschnittstelle fuer Fehlerpfad Dfp_HWEMonRcySuppressed" VAL_BLK 0xCD3E0 Kwb_Wu8 255.0 OneToOne 0.00 255.0 FORMAT "%5.1" NUMBER 4 /end CHARACTERISTIC
/begin CHARACTERISTIC DSM_TypDfp_HWEMonRcyVisible_C "Konvertierung der Fehlertypen auf der Diagnoseschnittstelle fuer Fehlerpfad Dfp_HWEMonRcyVisible" VAL_BLK 0xCD3E4 Kwb_Wu8 255.0 OneToOne 0.00 255.0 FORMAT "%5.1" NUMBER 4 /end CHARACTERISTIC
/begin CHARACTERISTIC DSM_TypDfp_HWEMonUMaxSupply_C "Konvertierung der Fehlertypen auf der Diagnoseschnittstelle fuer Fehlerpfad Dfp_HWEMonUMaxSupply" VAL_BLK 0xCD3E8 Kwb_Wu8 255.0 OneToOne 0.00 255.0 FORMAT "%5.1" NUMBER 4 /end CHARACTERISTIC
/begin CHARACTERISTIC DSM_TypDfp_HWEMonUMinSupply_C "Konvertierung der Fehlertypen auf der Diagnoseschnittstelle fuer Fehlerpfad Dfp_HWEMonUMinSupply" VAL_BLK 0xCD3EC Kwb_Wu8 255.0 OneToOne 0.00 255.0 FORMAT "%5.1" NUMBER 4 /end CHARACTERISTIC
/begin CHARACTERISTIC DSM_TypDfp_IATSCD_C "Konvertierung der Fehlertypen auf der Diagnoseschnittstelle fuer Fehlerpfad Dfp_IATSCD" VAL_BLK 0xCD3F0 Kwb_Wu8 255.0 OneToOne 0.00 255.0 FORMAT "%5.1" NUMBER 4 /end CHARACTERISTIC
/begin CHARACTERISTIC DSM_TypDfp_IATSCD_CATS_C "Konvertierung der Fehlertypen auf der Diagnoseschnittstelle fuer Fehlerpfad Dfp_IATSCD_CATS" VAL_BLK 0xCD3F4 Kwb_Wu8 255.0 OneToOne 0.00 255.0 FORMAT "%5.1" NUMBER 4 /end CHARACTERISTIC
/begin CHARACTERISTIC DSM_TypDfp_ImmCtlImmCD_C "Konvertierung der Fehlertypen auf der Diagnoseschnittstelle fuer Fehlerpfad Dfp_ImmCtlImmCD" VAL_BLK 0xCD3F8 Kwb_Wu8 255.0 OneToOne 0.00 255.0 FORMAT "%5.1" NUMBER 4 /end CHARACTERISTIC
/begin CHARACTERISTIC DSM_TypDfp_ImmCtlImmEep_C "Konvertierung der Fehlertypen auf der Diagnoseschnittstelle fuer Fehlerpfad Dfp_ImmCtlImmEep" VAL_BLK 0xCD3FC Kwb_Wu8 255.0 OneToOne 0.00 255.0 FORMAT "%5.1" NUMBER 4 /end CHARACTERISTIC
/begin CHARACTERISTIC DSM_TypDfp_ImmCtlMpl_C "Konvertierung der Fehlertypen auf der Diagnoseschnittstelle fuer Fehlerpfad Dfp_ImmCtlMpl" VAL_BLK 0xCD400 Kwb_Wu8 255.0 OneToOne 0.00 255.0 FORMAT "%5.1" NUMBER 4 /end CHARACTERISTIC
/begin CHARACTERISTIC DSM_TypDfp_IndSys1_C "Konvertierung der Fehlertypen auf der Diagnoseschnittstelle fuer Fehlerpfad Dfp_IndSys1" VAL_BLK 0xCD404 Kwb_Wu8 255.0 OneToOne 0.00 255.0 FORMAT "%5.1" NUMBER 4 /end CHARACTERISTIC
/begin CHARACTERISTIC DSM_TypDfp_IndSys2_C "Konvertierung der Fehlertypen auf der Diagnoseschnittstelle fuer Fehlerpfad Dfp_IndSys2" VAL_BLK 0xCD408 Kwb_Wu8 255.0 OneToOne 0.00 255.0 FORMAT "%5.1" NUMBER 4 /end CHARACTERISTIC
/begin CHARACTERISTIC DSM_TypDfp_InjCrv_InjLim_C "Konvertierung der Fehlertypen auf der Diagnoseschnittstelle fuer Fehlerpfad Dfp_InjCrv_InjLim" VAL_BLK 0xCD40C Kwb_Wu8 255.0 OneToOne 0.00 255.0 FORMAT "%5.1" NUMBER 4 /end CHARACTERISTIC
/begin CHARACTERISTIC DSM_TypDfp_InjCtlAdjQnt_C "Konvertierung der Fehlertypen auf der Diagnoseschnittstelle fuer Fehlerpfad Dfp_InjCtlAdjQnt" VAL_BLK 0xCD410 Kwb_Wu8 255.0 OneToOne 0.00 255.0 FORMAT "%5.1" NUMBER 4 /end CHARACTERISTIC
/begin CHARACTERISTIC DSM_TypDfp_InjCtlDrift_C "Konvertierung der Fehlertypen auf der Diagnoseschnittstelle fuer Fehlerpfad Dfp_InjCtlDrift" VAL_BLK 0xCD414 Kwb_Wu8 255.0 OneToOne 0.00 255.0 FORMAT "%5.1" NUMBER 4 /end CHARACTERISTIC
/begin CHARACTERISTIC DSM_TypDfp_InjVlvBnk1A_C "Konvertierung der Fehlertypen auf der Diagnoseschnittstelle fuer Fehlerpfad Dfp_InjVlvBnk1A" VAL_BLK 0xCD418 Kwb_Wu8 255.0 OneToOne 0.00 255.0 FORMAT "%5.1" NUMBER 4 /end CHARACTERISTIC
/begin CHARACTERISTIC DSM_TypDfp_InjVlvBnk1B_C "Konvertierung der Fehlertypen auf der Diagnoseschnittstelle fuer Fehlerpfad Dfp_InjVlvBnk1B" VAL_BLK 0xCD41C Kwb_Wu8 255.0 OneToOne 0.00 255.0 FORMAT "%5.1" NUMBER 4 /end CHARACTERISTIC
/begin CHARACTERISTIC DSM_TypDfp_InjVlvBnk2A_C "Konvertierung der Fehlertypen auf der Diagnoseschnittstelle fuer Fehlerpfad Dfp_InjVlvBnk2A" VAL_BLK 0xCD420 Kwb_Wu8 255.0 OneToOne 0.00 255.0 FORMAT "%5.1" NUMBER 4 /end CHARACTERISTIC
/begin CHARACTERISTIC DSM_TypDfp_InjVlvBnk2B_C "Konvertierung der Fehlertypen auf der Diagnoseschnittstelle fuer Fehlerpfad Dfp_InjVlvBnk2B" VAL_BLK 0xCD424 Kwb_Wu8 255.0 OneToOne 0.00 255.0 FORMAT "%5.1" NUMBER 4 /end CHARACTERISTIC
/begin CHARACTERISTIC DSM_TypDfp_InjVlvChipA_C "Konvertierung der Fehlertypen auf der Diagnoseschnittstelle fuer Fehlerpfad Dfp_InjVlvChipA" VAL_BLK 0xCD428 Kwb_Wu8 255.0 OneToOne 0.00 255.0 FORMAT "%5.1" NUMBER 4 /end CHARACTERISTIC
/begin CHARACTERISTIC DSM_TypDfp_InjVlvChipB_C "Konvertierung der Fehlertypen auf der Diagnoseschnittstelle fuer Fehlerpfad Dfp_InjVlvChipB" VAL_BLK 0xCD42C Kwb_Wu8 255.0 OneToOne 0.00 255.0 FORMAT "%5.1" NUMBER 4 /end CHARACTERISTIC
/begin CHARACTERISTIC DSM_TypDfp_InjVlvCyl1A_C "Konvertierung der Fehlertypen auf der Diagnoseschnittstelle fuer Fehlerpfad Dfp_InjVlvCyl1A" VAL_BLK 0xCD430 Kwb_Wu8 255.0 OneToOne 0.00 255.0 FORMAT "%5.1" NUMBER 4 /end CHARACTERISTIC
/begin CHARACTERISTIC DSM_TypDfp_InjVlvCyl1B_C "Konvertierung der Fehlertypen auf der Diagnoseschnittstelle fuer Fehlerpfad Dfp_InjVlvCyl1B" VAL_BLK 0xCD434 Kwb_Wu8 255.0 OneToOne 0.00 255.0 FORMAT "%5.1" NUMBER 4 /end CHARACTERISTIC
/begin CHARACTERISTIC DSM_TypDfp_InjVlvCyl2A_C "Konvertierung der Fehlertypen auf der Diagnoseschnittstelle fuer Fehlerpfad Dfp_InjVlvCyl2A" VAL_BLK 0xCD438 Kwb_Wu8 255.0 OneToOne 0.00 255.0 FORMAT "%5.1" NUMBER 4 /end CHARACTERISTIC
/begin CHARACTERISTIC DSM_TypDfp_InjVlvCyl2B_C "Konvertierung der Fehlertypen auf der Diagnoseschnittstelle fuer Fehlerpfad Dfp_InjVlvCyl2B" VAL_BLK 0xCD43C Kwb_Wu8 255.0 OneToOne 0.00 255.0 FORMAT "%5.1" NUMBER 4 /end CHARACTERISTIC
/begin CHARACTERISTIC DSM_TypDfp_InjVlvCyl3A_C "Konvertierung der Fehlertypen auf der Diagnoseschnittstelle fuer Fehlerpfad Dfp_InjVlvCyl3A" VAL_BLK 0xCD440 Kwb_Wu8 255.0 OneToOne 0.00 255.0 FORMAT "%5.1" NUMBER 4 /end CHARACTERISTIC
/begin CHARACTERISTIC DSM_TypDfp_InjVlvCyl3B_C "Konvertierung der Fehlertypen auf der Diagnoseschnittstelle fuer Fehlerpfad Dfp_InjVlvCyl3B" VAL_BLK 0xCD444 Kwb_Wu8 255.0 OneToOne 0.00 255.0 FORMAT "%5.1" NUMBER 4 /end CHARACTERISTIC
/begin CHARACTERISTIC DSM_TypDfp_InjVlvCyl4A_C "Konvertierung der Fehlertypen auf der Diagnoseschnittstelle fuer Fehlerpfad Dfp_InjVlvCyl4A" VAL_BLK 0xCD448 Kwb_Wu8 255.0 OneToOne 0.00 255.0 FORMAT "%5.1" NUMBER 4 /end CHARACTERISTIC
/begin CHARACTERISTIC DSM_TypDfp_InjVlvCyl4B_C "Konvertierung der Fehlertypen auf der Diagnoseschnittstelle fuer Fehlerpfad Dfp_InjVlvCyl4B" VAL_BLK 0xCD44C Kwb_Wu8 255.0 OneToOne 0.00 255.0 FORMAT "%5.1" NUMBER 4 /end CHARACTERISTIC
/begin CHARACTERISTIC DSM_TypDfp_InjVlvCyl5A_C "Konvertierung der Fehlertypen auf der Diagnoseschnittstelle fuer Fehlerpfad Dfp_InjVlvCyl5A" VAL_BLK 0xCD450 Kwb_Wu8 255.0 OneToOne 0.00 255.0 FORMAT "%5.1" NUMBER 4 /end CHARACTERISTIC
/begin CHARACTERISTIC DSM_TypDfp_InjVlvCyl5B_C "Konvertierung der Fehlertypen auf der Diagnoseschnittstelle fuer Fehlerpfad Dfp_InjVlvCyl5B" VAL_BLK 0xCD454 Kwb_Wu8 255.0 OneToOne 0.00 255.0 FORMAT "%5.1" NUMBER 4 /end CHARACTERISTIC
/begin CHARACTERISTIC DSM_TypDfp_InjVlvCyl6A_C "Konvertierung der Fehlertypen auf der Diagnoseschnittstelle fuer Fehlerpfad Dfp_InjVlvCyl6A" VAL_BLK 0xCD458 Kwb_Wu8 255.0 OneToOne 0.00 255.0 FORMAT "%5.1" NUMBER 4 /end CHARACTERISTIC
/begin CHARACTERISTIC DSM_TypDfp_InjVlvCyl6B_C "Konvertierung der Fehlertypen auf der Diagnoseschnittstelle fuer Fehlerpfad Dfp_InjVlvCyl6B" VAL_BLK 0xCD45C Kwb_Wu8 255.0 OneToOne 0.00 255.0 FORMAT "%5.1" NUMBER 4 /end CHARACTERISTIC
/begin CHARACTERISTIC DSM_TypDfp_LPACD_Max_C "Konvertierung der Fehlertypen auf der Diagnoseschnittstelle fuer Fehlerpfad Dfp_LPACD_Max" VAL_BLK 0xCD460 Kwb_Wu8 255.0 OneToOne 0.00 255.0 FORMAT "%5.1" NUMBER 4 /end CHARACTERISTIC
/begin CHARACTERISTIC DSM_TypDfp_LPACD_Min_C "Konvertierung der Fehlertypen auf der Diagnoseschnittstelle fuer Fehlerpfad Dfp_LPACD_Min" VAL_BLK 0xCD464 Kwb_Wu8 255.0 OneToOne 0.00 255.0 FORMAT "%5.1" NUMBER 4 /end CHARACTERISTIC
/begin CHARACTERISTIC DSM_TypDfp_LPACD_SigNpl_C "Konvertierung der Fehlertypen auf der Diagnoseschnittstelle fuer Fehlerpfad Dfp_LPACD_SigNpl" VAL_BLK 0xCD468 Kwb_Wu8 255.0 OneToOne 0.00 255.0 FORMAT "%5.1" NUMBER 4 /end CHARACTERISTIC
/begin CHARACTERISTIC DSM_TypDfp_LSUCDCircNernst0_C "Konvertierung der Fehlertypen auf der Diagnoseschnittstelle fuer Fehlerpfad Dfp_LSUCDCircNernst0" VAL_BLK 0xCD46C Kwb_Wu8 255.0 OneToOne 0.00 255.0 FORMAT "%5.1" NUMBER 4 /end CHARACTERISTIC
/begin CHARACTERISTIC DSM_TypDfp_LSUCDCircPumpCur0_C "Konvertierung der Fehlertypen auf der Diagnoseschnittstelle fuer Fehlerpfad Dfp_LSUCDCircPumpCur0" VAL_BLK 0xCD470 Kwb_Wu8 255.0 OneToOne 0.00 255.0 FORMAT "%5.1" NUMBER 4 /end CHARACTERISTIC
/begin CHARACTERISTIC DSM_TypDfp_LSUCDCircVirtGnd0_C "Konvertierung der Fehlertypen auf der Diagnoseschnittstelle fuer Fehlerpfad Dfp_LSUCDCircVirtGnd0" VAL_BLK 0xCD474 Kwb_Wu8 255.0 OneToOne 0.00 255.0 FORMAT "%5.1" NUMBER 4 /end CHARACTERISTIC
/begin CHARACTERISTIC DSM_TypDfp_LSUCDHeater0_C "Konvertierung der Fehlertypen auf der Diagnoseschnittstelle fuer Fehlerpfad Dfp_LSUCDHeater0" VAL_BLK 0xCD478 Kwb_Wu8 255.0 OneToOne 0.00 255.0 FORMAT "%5.1" NUMBER 4 /end CHARACTERISTIC
/begin CHARACTERISTIC DSM_TypDfp_LSUCDHtCoup0_C "Konvertierung der Fehlertypen auf der Diagnoseschnittstelle fuer Fehlerpfad Dfp_LSUCDHtCoup0" VAL_BLK 0xCD47C Kwb_Wu8 255.0 OneToOne 0.00 255.0 FORMAT "%5.1" NUMBER 4 /end CHARACTERISTIC
/begin CHARACTERISTIC DSM_TypDfp_LSUCDO20_C "Konvertierung der Fehlertypen auf der Diagnoseschnittstelle fuer Fehlerpfad Dfp_LSUCDO20" VAL_BLK 0xCD480 Kwb_Wu8 255.0 OneToOne 0.00 255.0 FORMAT "%5.1" NUMBER 4 /end CHARACTERISTIC
/begin CHARACTERISTIC DSM_TypDfp_LSUCDO2Clb0_C "Konvertierung der Fehlertypen auf der Diagnoseschnittstelle fuer Fehlerpfad Dfp_LSUCDO2Clb0" VAL_BLK 0xCD484 Kwb_Wu8 255.0 OneToOne 0.00 255.0 FORMAT "%5.1" NUMBER 4 /end CHARACTERISTIC
/begin CHARACTERISTIC DSM_TypDfp_LSUCDRiClb0_C "Konvertierung der Fehlertypen auf der Diagnoseschnittstelle fuer Fehlerpfad Dfp_LSUCDRiClb0" VAL_BLK 0xCD488 Kwb_Wu8 255.0 OneToOne 0.00 255.0 FORMAT "%5.1" NUMBER 4 /end CHARACTERISTIC
/begin CHARACTERISTIC DSM_TypDfp_LSUCDSPI0_C "Konvertierung der Fehlertypen auf der Diagnoseschnittstelle fuer Fehlerpfad Dfp_LSUCDSPI0" VAL_BLK 0xCD48C Kwb_Wu8 255.0 OneToOne 0.00 255.0 FORMAT "%5.1" NUMBER 4 /end CHARACTERISTIC
/begin CHARACTERISTIC DSM_TypDfp_LSUCDSPIBattLow0_C "Konvertierung der Fehlertypen auf der Diagnoseschnittstelle fuer Fehlerpfad Dfp_LSUCDSPIBattLow0" VAL_BLK 0xCD490 Kwb_Wu8 255.0 OneToOne 0.00 255.0 FORMAT "%5.1" NUMBER 4 /end CHARACTERISTIC
/begin CHARACTERISTIC DSM_TypDfp_LSUCDWireIP0_C "Konvertierung der Fehlertypen auf der Diagnoseschnittstelle fuer Fehlerpfad Dfp_LSUCDWireIP0" VAL_BLK 0xCD494 Kwb_Wu8 255.0 OneToOne 0.00 255.0 FORMAT "%5.1" NUMBER 4 /end CHARACTERISTIC
/begin CHARACTERISTIC DSM_TypDfp_LSUCtlRiExc0_C "Konvertierung der Fehlertypen auf der Diagnoseschnittstelle fuer Fehlerpfad Dfp_LSUCtlRiExc0" VAL_BLK 0xCD498 Kwb_Wu8 255.0 OneToOne 0.00 255.0 FORMAT "%5.1" NUMBER 4 /end CHARACTERISTIC
/begin CHARACTERISTIC DSM_TypDfp_LSUMon1Sens_C "Konvertierung der Fehlertypen auf der Diagnoseschnittstelle fuer Fehlerpfad Dfp_LSUMon1Sens" VAL_BLK 0xCD49C Kwb_Wu8 255.0 OneToOne 0.00 255.0 FORMAT "%5.1" NUMBER 4 /end CHARACTERISTIC
/begin CHARACTERISTIC DSM_TypDfp_LSUMon2Sens_C "Konvertierung der Fehlertypen auf der Diagnoseschnittstelle fuer Fehlerpfad Dfp_LSUMon2Sens" VAL_BLK 0xCD4A0 Kwb_Wu8 255.0 OneToOne 0.00 255.0 FORMAT "%5.1" NUMBER 4 /end CHARACTERISTIC
/begin CHARACTERISTIC DSM_TypDfp_MIL_C "Konvertierung der Fehlertypen auf der Diagnoseschnittstelle fuer Fehlerpfad Dfp_MIL" VAL_BLK 0xCD4A4 Kwb_Wu8 255.0 OneToOne 0.00 255.0 FORMAT "%5.1" NUMBER 4 /end CHARACTERISTIC
/begin CHARACTERISTIC DSM_TypDfp_MRlyCD_C "Konvertierung der Fehlertypen auf der Diagnoseschnittstelle fuer Fehlerpfad Dfp_MRlyCD" VAL_BLK 0xCD4A8 Kwb_Wu8 255.0 OneToOne 0.00 255.0 FORMAT "%5.1" NUMBER 4 /end CHARACTERISTIC
/begin CHARACTERISTIC DSM_TypDfp_MSidCD_Comm_C "Konvertierung der Fehlertypen auf der Diagnoseschnittstelle fuer Fehlerpfad Dfp_MSidCD_Comm" VAL_BLK 0xCD4AC Kwb_Wu8 255.0 OneToOne 0.00 255.0 FORMAT "%5.1" NUMBER 4 /end CHARACTERISTIC
/begin CHARACTERISTIC DSM_TypDfp_MSidCD_Pin_C "Konvertierung der Fehlertypen auf der Diagnoseschnittstelle fuer Fehlerpfad Dfp_MSidCD_Pin" VAL_BLK 0xCD4B0 Kwb_Wu8 255.0 OneToOne 0.00 255.0 FORMAT "%5.1" NUMBER 4 /end CHARACTERISTIC
/begin CHARACTERISTIC DSM_TypDfp_MSidCD_Sel_INI_C "Konvertierung der Fehlertypen auf der Diagnoseschnittstelle fuer Fehlerpfad Dfp_MSidCD_Sel_INI" VAL_BLK 0xCD4B4 Kwb_Wu8 255.0 OneToOne 0.00 255.0 FORMAT "%5.1" NUMBER 4 /end CHARACTERISTIC
/begin CHARACTERISTIC DSM_TypDfp_MSidCD_Select_C "Konvertierung der Fehlertypen auf der Diagnoseschnittstelle fuer Fehlerpfad Dfp_MSidCD_Select" VAL_BLK 0xCD4B8 Kwb_Wu8 255.0 OneToOne 0.00 255.0 FORMAT "%5.1" NUMBER 4 /end CHARACTERISTIC
/begin CHARACTERISTIC DSM_TypDfp_MeUnCDNoLoad_C "Konvertierung der Fehlertypen auf der Diagnoseschnittstelle fuer Fehlerpfad Dfp_MeUnCDNoLoad" VAL_BLK 0xCD4BC Kwb_Wu8 255.0 OneToOne 0.00 255.0 FORMAT "%5.1" NUMBER 4 /end CHARACTERISTIC
/begin CHARACTERISTIC DSM_TypDfp_MeUnCDSCBat_C "Konvertierung der Fehlertypen auf der Diagnoseschnittstelle fuer Fehlerpfad Dfp_MeUnCDSCBat" VAL_BLK 0xCD4C0 Kwb_Wu8 255.0 OneToOne 0.00 255.0 FORMAT "%5.1" NUMBER 4 /end CHARACTERISTIC
/begin CHARACTERISTIC DSM_TypDfp_MeUnCDSCGnd_C "Konvertierung der Fehlertypen auf der Diagnoseschnittstelle fuer Fehlerpfad Dfp_MeUnCDSCGnd" VAL_BLK 0xCD4C4 Kwb_Wu8 255.0 OneToOne 0.00 255.0 FORMAT "%5.1" NUMBER 4 /end CHARACTERISTIC
/begin CHARACTERISTIC DSM_TypDfp_MeUnCD_ADC_C "Konvertierung der Fehlertypen auf der Diagnoseschnittstelle fuer Fehlerpfad Dfp_MeUnCD_ADC" VAL_BLK 0xCD4C8 Kwb_Wu8 255.0 OneToOne 0.00 255.0 FORMAT "%5.1" NUMBER 4 /end CHARACTERISTIC
/begin CHARACTERISTIC DSM_TypDfp_MeUnCD_SigTst_C "Konvertierung der Fehlertypen auf der Diagnoseschnittstelle fuer Fehlerpfad Dfp_MeUnCD_SigTst" VAL_BLK 0xCD4CC Kwb_Wu8 255.0 OneToOne 0.00 255.0 FORMAT "%5.1" NUMBER 4 /end CHARACTERISTIC
/begin CHARACTERISTIC DSM_TypDfp_Montr_C "Konvertierung der Fehlertypen auf der Diagnoseschnittstelle fuer Fehlerpfad Dfp_Montr" VAL_BLK 0xCD4D0 Kwb_Wu8 255.0 OneToOne 0.00 255.0 FORMAT "%5.1" NUMBER 4 /end CHARACTERISTIC
/begin CHARACTERISTIC DSM_TypDfp_NetMngDeviceA_C "Konvertierung der Fehlertypen auf der Diagnoseschnittstelle fuer Fehlerpfad Dfp_NetMngDeviceA" VAL_BLK 0xCD4D4 Kwb_Wu8 255.0 OneToOne 0.00 255.0 FORMAT "%5.1" NUMBER 4 /end CHARACTERISTIC
/begin CHARACTERISTIC DSM_TypDfp_NetMngDeviceB_C "Konvertierung der Fehlertypen auf der Diagnoseschnittstelle fuer Fehlerpfad Dfp_NetMngDeviceB" VAL_BLK 0xCD4D8 Kwb_Wu8 255.0 OneToOne 0.00 255.0 FORMAT "%5.1" NUMBER 4 /end CHARACTERISTIC
/begin CHARACTERISTIC DSM_TypDfp_NetMngDeviceC_C "Konvertierung der Fehlertypen auf der Diagnoseschnittstelle fuer Fehlerpfad Dfp_NetMngDeviceC" VAL_BLK 0xCD4DC Kwb_Wu8 255.0 OneToOne 0.00 255.0 FORMAT "%5.1" NUMBER 4 /end CHARACTERISTIC
/begin CHARACTERISTIC DSM_TypDfp_OPSCD_Lamp_C "Konvertierung der Fehlertypen auf der Diagnoseschnittstelle fuer Fehlerpfad Dfp_OPSCD_Lamp" VAL_BLK 0xCD4E0 Kwb_Wu8 255.0 OneToOne 0.00 255.0 FORMAT "%5.1" NUMBER 4 /end CHARACTERISTIC
/begin CHARACTERISTIC DSM_TypDfp_OPSCD_anain_C "Konvertierung der Fehlertypen auf der Diagnoseschnittstelle fuer Fehlerpfad Dfp_OPSCD_anain" VAL_BLK 0xCD4E4 Kwb_Wu8 255.0 OneToOne 0.00 255.0 FORMAT "%5.1" NUMBER 4 /end CHARACTERISTIC
/begin CHARACTERISTIC DSM_TypDfp_OTSCD_C "Konvertierung der Fehlertypen auf der Diagnoseschnittstelle fuer Fehlerpfad Dfp_OTSCD" VAL_BLK 0xCD4E8 Kwb_Wu8 255.0 OneToOne 0.00 255.0 FORMAT "%5.1" NUMBER 4 /end CHARACTERISTIC
/begin CHARACTERISTIC DSM_TypDfp_OvRMon_C "Konvertierung der Fehlertypen auf der Diagnoseschnittstelle fuer Fehlerpfad Dfp_OvRMon" VAL_BLK 0xCD4EC Kwb_Wu8 255.0 OneToOne 0.00 255.0 FORMAT "%5.1" NUMBER 4 /end CHARACTERISTIC
/begin CHARACTERISTIC DSM_TypDfp_OvRMonBrk_C "conversion of fault types for diagnostic interface for fault path Dfp_OvRMonBrk" VAL_BLK 0xCD4F0 Kwb_Wu8 255.0 OneToOne 0.00 255.0 FORMAT "%5.1" NUMBER 4 /end CHARACTERISTIC
/begin CHARACTERISTIC DSM_TypDfp_OvRMonSigA_C "Konvertierung der Fehlertypen auf der Diagnoseschnittstelle fuer Fehlerpfad Dfp_OvRMonSigA" VAL_BLK 0xCD4F4 Kwb_Wu8 255.0 OneToOne 0.00 255.0 FORMAT "%5.1" NUMBER 4 /end CHARACTERISTIC
/begin CHARACTERISTIC DSM_TypDfp_OxiCCDTPre_C "Konvertierung der Fehlertypen auf der Diagnoseschnittstelle fuer Fehlerpfad Dfp_OxiCCDTPre" VAL_BLK 0xCD4F8 Kwb_Wu8 255.0 OneToOne 0.00 255.0 FORMAT "%5.1" NUMBER 4 /end CHARACTERISTIC
/begin CHARACTERISTIC DSM_TypDfp_PCR_GovDevNeg_C "Konvertierung der Fehlertypen auf der Diagnoseschnittstelle fuer Fehlerpfad Dfp_PCR_GovDevNeg" VAL_BLK 0xCD4FC Kwb_Wu8 255.0 OneToOne 0.00 255.0 FORMAT "%5.1" NUMBER 4 /end CHARACTERISTIC
/begin CHARACTERISTIC DSM_TypDfp_PCR_GovDevPos_C "Konvertierung der Fehlertypen auf der Diagnoseschnittstelle fuer Fehlerpfad Dfp_PCR_GovDevPos" VAL_BLK 0xCD500 Kwb_Wu8 255.0 OneToOne 0.00 255.0 FORMAT "%5.1" NUMBER 4 /end CHARACTERISTIC
/begin CHARACTERISTIC DSM_TypDfp_PCR_LPGvnrDvtNeg_C "Konvertierung der Fehlertypen auf der Diagnoseschnittstelle fuer Fehlerpfad Dfp_PCR_LPGvnrDvtNeg" VAL_BLK 0xCD504 Kwb_Wu8 255.0 OneToOne 0.00 255.0 FORMAT "%5.1" NUMBER 4 /end CHARACTERISTIC
/begin CHARACTERISTIC DSM_TypDfp_PCR_LPGvnrDvtPos_C "Konvertierung der Fehlertypen auf der Diagnoseschnittstelle fuer Fehlerpfad Dfp_PCR_LPGvnrDvtPos" VAL_BLK 0xCD508 Kwb_Wu8 255.0 OneToOne 0.00 255.0 FORMAT "%5.1" NUMBER 4 /end CHARACTERISTIC
/begin CHARACTERISTIC DSM_TypDfp_PCVCDNoLoad_C "Konvertierung der Fehlertypen auf der Diagnoseschnittstelle fuer Fehlerpfad Dfp_PCVCDNoLoad" VAL_BLK 0xCD50C Kwb_Wu8 255.0 OneToOne 0.00 255.0 FORMAT "%5.1" NUMBER 4 /end CHARACTERISTIC
/begin CHARACTERISTIC DSM_TypDfp_PCVCDSCBat_C "Konvertierung der Fehlertypen auf der Diagnoseschnittstelle fuer Fehlerpfad Dfp_PCVCDSCBat" VAL_BLK 0xCD510 Kwb_Wu8 255.0 OneToOne 0.00 255.0 FORMAT "%5.1" NUMBER 4 /end CHARACTERISTIC
/begin CHARACTERISTIC DSM_TypDfp_PCVCDSCGnd_C "Konvertierung der Fehlertypen auf der Diagnoseschnittstelle fuer Fehlerpfad Dfp_PCVCDSCGnd" VAL_BLK 0xCD514 Kwb_Wu8 255.0 OneToOne 0.00 255.0 FORMAT "%5.1" NUMBER 4 /end CHARACTERISTIC
/begin CHARACTERISTIC DSM_TypDfp_PCVCD_ADC_C "Konvertierung der Fehlertypen auf der Diagnoseschnittstelle fuer Fehlerpfad Dfp_PCVCD_ADC" VAL_BLK 0xCD518 Kwb_Wu8 255.0 OneToOne 0.00 255.0 FORMAT "%5.1" NUMBER 4 /end CHARACTERISTIC
/begin CHARACTERISTIC DSM_TypDfp_PCVCD_SigTst_C "Konvertierung der Fehlertypen auf der Diagnoseschnittstelle fuer Fehlerpfad Dfp_PCVCD_SigTst" VAL_BLK 0xCD51C Kwb_Wu8 255.0 OneToOne 0.00 255.0 FORMAT "%5.1" NUMBER 4 /end CHARACTERISTIC
/begin CHARACTERISTIC DSM_TypDfp_PFltAPSPlaus_C "Konvertierung der Fehlertypen auf der Diagnoseschnittstelle fuer Fehlerpfad Dfp_PFltAPSPlaus" VAL_BLK 0xCD520 Kwb_Wu8 255.0 OneToOne 0.00 255.0 FORMAT "%5.1" NUMBER 4 /end CHARACTERISTIC
/begin CHARACTERISTIC DSM_TypDfp_PFltAPSens_C "Konvertierung der Fehlertypen auf der Diagnoseschnittstelle fuer Fehlerpfad Dfp_PFltAPSens" VAL_BLK 0xCD524 Kwb_Wu8 255.0 OneToOne 0.00 255.0 FORMAT "%5.1" NUMBER 4 /end CHARACTERISTIC
/begin CHARACTERISTIC DSM_TypDfp_PFltBPSPlaus_C "Konvertierung der Fehlertypen auf der Diagnoseschnittstelle fuer Fehlerpfad Dfp_PFltBPSPlaus" VAL_BLK 0xCD528 Kwb_Wu8 255.0 OneToOne 0.00 255.0 FORMAT "%5.1" NUMBER 4 /end CHARACTERISTIC
/begin CHARACTERISTIC DSM_TypDfp_PFltCDPPre_C "Konvertierung der Fehlertypen auf der Diagnoseschnittstelle fuer Fehlerpfad Dfp_PFltCDPPre" VAL_BLK 0xCD52C Kwb_Wu8 255.0 OneToOne 0.00 255.0 FORMAT "%5.1" NUMBER 4 /end CHARACTERISTIC
/begin CHARACTERISTIC DSM_TypDfp_PFltCDTempPre_C "Konvertierung der Fehlertypen auf der Diagnoseschnittstelle fuer Fehlerpfad Dfp_PFltCDTempPre" VAL_BLK 0xCD530 Kwb_Wu8 255.0 OneToOne 0.00 255.0 FORMAT "%5.1" NUMBER 4 /end CHARACTERISTIC
/begin CHARACTERISTIC DSM_TypDfp_PFltChar_C "Konvertierung der Fehlertypen auf der Diagnoseschnittstelle fuer Fehlerpfad Dfp_PFltChar" VAL_BLK 0xCD534 Kwb_Wu8 255.0 OneToOne 0.00 255.0 FORMAT "%5.1" NUMBER 4 /end CHARACTERISTIC
/begin CHARACTERISTIC DSM_TypDfp_PFltEngPrt_C "Konvertierung der Fehlertypen auf der Diagnoseschnittstelle fuer Fehlerpfad Dfp_PFltEngPrt" VAL_BLK 0xCD538 Kwb_Wu8 255.0 OneToOne 0.00 255.0 FORMAT "%5.1" NUMBER 4 /end CHARACTERISTIC
/begin CHARACTERISTIC DSM_TypDfp_PFltPresDynPlaus_C "Konvertierung der Fehlertypen auf der Diagnoseschnittstelle fuer Fehlerpfad Dfp_PFltPresDynPlaus" VAL_BLK 0xCD53C Kwb_Wu8 255.0 OneToOne 0.00 255.0 FORMAT "%5.1" NUMBER 4 /end CHARACTERISTIC
/begin CHARACTERISTIC DSM_TypDfp_PFltPresPlaus_C "Konvertierung der Fehlertypen auf der Diagnoseschnittstelle fuer Fehlerpfad Dfp_PFltPresPlaus" VAL_BLK 0xCD540 Kwb_Wu8 255.0 OneToOne 0.00 255.0 FORMAT "%5.1" NUMBER 4 /end CHARACTERISTIC
/begin CHARACTERISTIC DSM_TypDfp_PFltPresSens_C "Konvertierung der Fehlertypen auf der Diagnoseschnittstelle fuer Fehlerpfad Dfp_PFltPresSens" VAL_BLK 0xCD544 Kwb_Wu8 255.0 OneToOne 0.00 255.0 FORMAT "%5.1" NUMBER 4 /end CHARACTERISTIC
/begin CHARACTERISTIC DSM_TypDfp_PFltPresSensFrz_C "Konvertierung der Fehlertypen auf der Diagnoseschnittstelle fuer Fehlerpfad Dfp_PFltPresSensFrz" VAL_BLK 0xCD548 Kwb_Wu8 255.0 OneToOne 0.00 255.0 FORMAT "%5.1" NUMBER 4 /end CHARACTERISTIC
/begin CHARACTERISTIC DSM_TypDfp_PFltPresSensHsLn_C "Konvertierung der Fehlertypen auf der Diagnoseschnittstelle fuer Fehlerpfad Dfp_PFltPresSensHsLn" VAL_BLK 0xCD54C Kwb_Wu8 255.0 OneToOne 0.00 255.0 FORMAT "%5.1" NUMBER 4 /end CHARACTERISTIC
/begin CHARACTERISTIC DSM_TypDfp_PFltPresSensSot_C "Konvertierung der Fehlertypen auf der Diagnoseschnittstelle fuer Fehlerpfad Dfp_PFltPresSensSot" VAL_BLK 0xCD550 Kwb_Wu8 255.0 OneToOne 0.00 255.0 FORMAT "%5.1" NUMBER 4 /end CHARACTERISTIC
/begin CHARACTERISTIC DSM_TypDfp_PFltRgnPerm_C "Konvertierung der Fehlertypen auf der Diagnoseschnittstelle fuer Fehlerpfad Dfp_PFltRgnPerm" VAL_BLK 0xCD554 Kwb_Wu8 255.0 OneToOne 0.00 255.0 FORMAT "%5.1" NUMBER 4 /end CHARACTERISTIC
/begin CHARACTERISTIC DSM_TypDfp_PFltTempDwnStrm_C "Konvertierung der Fehlertypen auf der Diagnoseschnittstelle fuer Fehlerpfad Dfp_PFltTempDwnStrm" VAL_BLK 0xCD558 Kwb_Wu8 255.0 OneToOne 0.00 255.0 FORMAT "%5.1" NUMBER 4 /end CHARACTERISTIC
/begin CHARACTERISTIC DSM_TypDfp_PFltTempSens_C "Konvertierung der Fehlertypen auf der Diagnoseschnittstelle fuer Fehlerpfad Dfp_PFltTempSens" VAL_BLK 0xCD55C Kwb_Wu8 255.0 OneToOne 0.00 255.0 FORMAT "%5.1" NUMBER 4 /end CHARACTERISTIC
/begin CHARACTERISTIC DSM_TypDfp_PFltTempUpStrm_C "Konvertierung der Fehlertypen auf der Diagnoseschnittstelle fuer Fehlerpfad Dfp_PFltTempUpStrm" VAL_BLK 0xCD560 Kwb_Wu8 255.0 OneToOne 0.00 255.0 FORMAT "%5.1" NUMBER 4 /end CHARACTERISTIC
/begin CHARACTERISTIC DSM_TypDfp_PFltmSotDiffMax_C "Konvertierung der Fehlertypen auf der Diagnoseschnittstelle fuer Fehlerpfad Dfp_PFltmSotDiffMax" VAL_BLK 0xCD564 Kwb_Wu8 255.0 OneToOne 0.00 255.0 FORMAT "%5.1" NUMBER 4 /end CHARACTERISTIC
/begin CHARACTERISTIC DSM_TypDfp_PSPCD_Actr_C "Konvertierung der Fehlertypen auf der Diagnoseschnittstelle fuer Fehlerpfad Dfp_PSPCD_Actr" VAL_BLK 0xCD568 Kwb_Wu8 255.0 OneToOne 0.00 255.0 FORMAT "%5.1" NUMBER 4 /end CHARACTERISTIC
/begin CHARACTERISTIC DSM_TypDfp_PresPlausDblDef_C "Konvertierung der Fehlertypen auf der Diagnoseschnittstelle fuer Fehlerpfad Dfp_PresPlausDblDef" VAL_BLK 0xCD56C Kwb_Wu8 255.0 OneToOne 0.00 255.0 FORMAT "%5.1" NUMBER 4 /end CHARACTERISTIC
/begin CHARACTERISTIC DSM_TypDfp_QLTCD_C "Konvertierung der Fehlertypen auf der Diagnoseschnittstelle fuer Fehlerpfad Dfp_QLTCD" VAL_BLK 0xCD570 Kwb_Wu8 255.0 OneToOne 0.00 255.0 FORMAT "%5.1" NUMBER 4 /end CHARACTERISTIC
/begin CHARACTERISTIC DSM_TypDfp_RailCD_C "Konvertierung der Fehlertypen auf der Diagnoseschnittstelle fuer Fehlerpfad Dfp_RailCD" VAL_BLK 0xCD574 Kwb_Wu8 255.0 OneToOne 0.00 255.0 FORMAT "%5.1" NUMBER 4 /end CHARACTERISTIC
/begin CHARACTERISTIC DSM_TypDfp_RailCDOfsTst_C "Konvertierung der Fehlertypen auf der Diagnoseschnittstelle fuer Fehlerpfad Dfp_RailCDOfsTst" VAL_BLK 0xCD578 Kwb_Wu8 255.0 OneToOne 0.00 255.0 FORMAT "%5.1" NUMBER 4 /end CHARACTERISTIC
/begin CHARACTERISTIC DSM_TypDfp_RailCD_PMonStrt_C "Konvertierung der Fehlertypen auf der Diagnoseschnittstelle fuer Fehlerpfad Dfp_RailCD_PMonStrt" VAL_BLK 0xCD57C Kwb_Wu8 255.0 OneToOne 0.00 255.0 FORMAT "%5.1" NUMBER 4 /end CHARACTERISTIC
/begin CHARACTERISTIC DSM_TypDfp_RailCtlModeMeUnDiag_C "Konvertierung der Fehlertypen auf der Diagnoseschnittstelle fuer Fehlerpfad Dfp_RailCtlModeMeUnDiag" VAL_BLK 0xCD580 Kwb_Wu8 255.0 OneToOne 0.00 255.0 FORMAT "%5.1" NUMBER 4 /end CHARACTERISTIC
/begin CHARACTERISTIC DSM_TypDfp_RailCtlModePCVDiag_C "Konvertierung der Fehlertypen auf der Diagnoseschnittstelle fuer Fehlerpfad Dfp_RailCtlModePCVDiag" VAL_BLK 0xCD584 Kwb_Wu8 255.0 OneToOne 0.00 255.0 FORMAT "%5.1" NUMBER 4 /end CHARACTERISTIC
/begin CHARACTERISTIC DSM_TypDfp_RailMeUn0_C "Konvertierung der Fehlertypen auf der Diagnoseschnittstelle fuer Fehlerpfad Dfp_RailMeUn0" VAL_BLK 0xCD588 Kwb_Wu8 255.0 OneToOne 0.00 255.0 FORMAT "%5.1" NUMBER 4 /end CHARACTERISTIC
/begin CHARACTERISTIC DSM_TypDfp_RailMeUn1_C "Konvertierung der Fehlertypen auf der Diagnoseschnittstelle fuer Fehlerpfad Dfp_RailMeUn1" VAL_BLK 0xCD58C Kwb_Wu8 255.0 OneToOne 0.00 255.0 FORMAT "%5.1" NUMBER 4 /end CHARACTERISTIC
/begin CHARACTERISTIC DSM_TypDfp_RailMeUn2_C "Konvertierung der Fehlertypen auf der Diagnoseschnittstelle fuer Fehlerpfad Dfp_RailMeUn2" VAL_BLK 0xCD590 Kwb_Wu8 255.0 OneToOne 0.00 255.0 FORMAT "%5.1" NUMBER 4 /end CHARACTERISTIC
/begin CHARACTERISTIC DSM_TypDfp_RailMeUn3_C "Konvertierung der Fehlertypen auf der Diagnoseschnittstelle fuer Fehlerpfad Dfp_RailMeUn3" VAL_BLK 0xCD594 Kwb_Wu8 255.0 OneToOne 0.00 255.0 FORMAT "%5.1" NUMBER 4 /end CHARACTERISTIC
/begin CHARACTERISTIC DSM_TypDfp_RailMeUn4_C "Konvertierung der Fehlertypen auf der Diagnoseschnittstelle fuer Fehlerpfad Dfp_RailMeUn4" VAL_BLK 0xCD598 Kwb_Wu8 255.0 OneToOne 0.00 255.0 FORMAT "%5.1" NUMBER 4 /end CHARACTERISTIC
/begin CHARACTERISTIC DSM_TypDfp_RailPCV0_C "Konvertierung der Fehlertypen auf der Diagnoseschnittstelle fuer Fehlerpfad Dfp_RailPCV0" VAL_BLK 0xCD59C Kwb_Wu8 255.0 OneToOne 0.00 255.0 FORMAT "%5.1" NUMBER 4 /end CHARACTERISTIC
/begin CHARACTERISTIC DSM_TypDfp_RailPCV1_C "Konvertierung der Fehlertypen auf der Diagnoseschnittstelle fuer Fehlerpfad Dfp_RailPCV1" VAL_BLK 0xCD5A0 Kwb_Wu8 255.0 OneToOne 0.00 255.0 FORMAT "%5.1" NUMBER 4 /end CHARACTERISTIC
/begin CHARACTERISTIC DSM_TypDfp_RailPCV2_C "Konvertierung der Fehlertypen auf der Diagnoseschnittstelle fuer Fehlerpfad Dfp_RailPCV2" VAL_BLK 0xCD5A4 Kwb_Wu8 255.0 OneToOne 0.00 255.0 FORMAT "%5.1" NUMBER 4 /end CHARACTERISTIC
/begin CHARACTERISTIC DSM_TypDfp_RailPCV3_C "Konvertierung der Fehlertypen auf der Diagnoseschnittstelle fuer Fehlerpfad Dfp_RailPCV3" VAL_BLK 0xCD5A8 Kwb_Wu8 255.0 OneToOne 0.00 255.0 FORMAT "%5.1" NUMBER 4 /end CHARACTERISTIC
/begin CHARACTERISTIC DSM_TypDfp_RailPCV4_C "Konvertierung der Fehlertypen auf der Diagnoseschnittstelle fuer Fehlerpfad Dfp_RailPCV4" VAL_BLK 0xCD5AC Kwb_Wu8 255.0 OneToOne 0.00 255.0 FORMAT "%5.1" NUMBER 4 /end CHARACTERISTIC
/begin CHARACTERISTIC DSM_TypDfp_RailPCV5_C "Konvertierung der Fehlertypen auf der Diagnoseschnittstelle fuer Fehlerpfad Dfp_RailPCV5" VAL_BLK 0xCD5B0 Kwb_Wu8 255.0 OneToOne 0.00 255.0 FORMAT "%5.1" NUMBER 4 /end CHARACTERISTIC
/begin CHARACTERISTIC DSM_TypDfp_SOPTst_C "Konvertierung der Fehlertypen auf der Diagnoseschnittstelle fuer Fehlerpfad Dfp_SOPTst" VAL_BLK 0xCD5B4 Kwb_Wu8 255.0 OneToOne 0.00 255.0 FORMAT "%5.1" NUMBER 4 /end CHARACTERISTIC
/begin CHARACTERISTIC DSM_TypDfp_SSpMon1_C "Konvertierung der Fehlertypen auf der Diagnoseschnittstelle fuer Fehlerpfad Dfp_SSpMon1" VAL_BLK 0xCD5B8 Kwb_Wu8 255.0 OneToOne 0.00 255.0 FORMAT "%5.1" NUMBER 4 /end CHARACTERISTIC
/begin CHARACTERISTIC DSM_TypDfp_SSpMon2_C "Konvertierung der Fehlertypen auf der Diagnoseschnittstelle fuer Fehlerpfad Dfp_SSpMon2" VAL_BLK 0xCD5BC Kwb_Wu8 255.0 OneToOne 0.00 255.0 FORMAT "%5.1" NUMBER 4 /end CHARACTERISTIC
/begin CHARACTERISTIC DSM_TypDfp_SSpMon3_C "Konvertierung der Fehlertypen auf der Diagnoseschnittstelle fuer Fehlerpfad Dfp_SSpMon3" VAL_BLK 0xCD5C0 Kwb_Wu8 255.0 OneToOne 0.00 255.0 FORMAT "%5.1" NUMBER 4 /end CHARACTERISTIC
/begin CHARACTERISTIC DSM_TypDfp_SWChk_CycSigChkDat_C "Konvertierung der Fehlertypen auf der Diagnoseschnittstelle fuer Fehlerpfad Dfp_SWChk_CycSigChkDat" VAL_BLK 0xCD5C4 Kwb_Wu8 255.0 OneToOne 0.00 255.0 FORMAT "%5.1" NUMBER 4 /end CHARACTERISTIC
/begin CHARACTERISTIC DSM_TypDfp_SWChk_CycSigChkPrg_C "Konvertierung der Fehlertypen auf der Diagnoseschnittstelle fuer Fehlerpfad Dfp_SWChk_CycSigChkPrg" VAL_BLK 0xCD5C8 Kwb_Wu8 255.0 OneToOne 0.00 255.0 FORMAT "%5.1" NUMBER 4 /end CHARACTERISTIC
/begin CHARACTERISTIC DSM_TypDfp_ShutCD_C "Konvertierung der Fehlertypen auf der Diagnoseschnittstelle fuer Fehlerpfad Dfp_ShutCD" VAL_BLK 0xCD5CC Kwb_Wu8 255.0 OneToOne 0.00 255.0 FORMAT "%5.1" NUMBER 4 /end CHARACTERISTIC
/begin CHARACTERISTIC DSM_TypDfp_ShutCDMax_C "Konvertierung der Fehlertypen auf der Diagnoseschnittstelle fuer Fehlerpfad Dfp_ShutCDMax" VAL_BLK 0xCD5D0 Kwb_Wu8 255.0 OneToOne 0.00 255.0 FORMAT "%5.1" NUMBER 4 /end CHARACTERISTIC
/begin CHARACTERISTIC DSM_TypDfp_ShutCDMin_C "Konvertierung der Fehlertypen auf der Diagnoseschnittstelle fuer Fehlerpfad Dfp_ShutCDMin" VAL_BLK 0xCD5D4 Kwb_Wu8 255.0 OneToOne 0.00 255.0 FORMAT "%5.1" NUMBER 4 /end CHARACTERISTIC
/begin CHARACTERISTIC DSM_TypDfp_ShutCDSigNpl_C "Konvertierung der Fehlertypen auf der Diagnoseschnittstelle fuer Fehlerpfad Dfp_ShutCDSigNpl" VAL_BLK 0xCD5D8 Kwb_Wu8 255.0 OneToOne 0.00 255.0 FORMAT "%5.1" NUMBER 4 /end CHARACTERISTIC
/begin CHARACTERISTIC DSM_TypDfp_StSysTrqShutOff_C "Konvertierung der Fehlertypen auf der Diagnoseschnittstelle fuer Fehlerpfad Dfp_StSysTrqShutOff" VAL_BLK 0xCD5DC Kwb_Wu8 255.0 OneToOne 0.00 255.0 FORMAT "%5.1" NUMBER 4 /end CHARACTERISTIC
/begin CHARACTERISTIC DSM_TypDfp_StrtCD_Actr_C "Konvertierung der Fehlertypen auf der Diagnoseschnittstelle fuer Fehlerpfad Dfp_StrtCD_Actr" VAL_BLK 0xCD5E0 Kwb_Wu8 255.0 OneToOne 0.00 255.0 FORMAT "%5.1" NUMBER 4 /end CHARACTERISTIC
/begin CHARACTERISTIC DSM_TypDfp_SysLamp_C "Konvertierung der Fehlertypen auf der Diagnoseschnittstelle fuer Fehlerpfad Dfp_SysLamp" VAL_BLK 0xCD5E4 Kwb_Wu8 255.0 OneToOne 0.00 255.0 FORMAT "%5.1" NUMBER 4 /end CHARACTERISTIC
/begin CHARACTERISTIC DSM_TypDfp_T15CD_C "Konvertierung der Fehlertypen auf der Diagnoseschnittstelle fuer Fehlerpfad Dfp_T15CD" VAL_BLK 0xCD5E8 Kwb_Wu8 255.0 OneToOne 0.00 255.0 FORMAT "%5.1" NUMBER 4 /end CHARACTERISTIC
/begin CHARACTERISTIC DSM_TypDfp_TGearbx_C "Konvertierung der Fehlertypen auf der Diagnoseschnittstelle fuer Fehlerpfad Dfp_TGearbx" VAL_BLK 0xCD5EC Kwb_Wu8 255.0 OneToOne 0.00 255.0 FORMAT "%5.1" NUMBER 4 /end CHARACTERISTIC
/begin CHARACTERISTIC DSM_TypDfp_TPUMon_C "Konvertierung der Fehlertypen auf der Diagnoseschnittstelle fuer Fehlerpfad Dfp_TPUMon" VAL_BLK 0xCD5F0 Kwb_Wu8 255.0 OneToOne 0.00 255.0 FORMAT "%5.1" NUMBER 4 /end CHARACTERISTIC
/begin CHARACTERISTIC DSM_TypDfp_TVACD_Max_C "Konvertierung der Fehlertypen auf der Diagnoseschnittstelle fuer Fehlerpfad Dfp_TVACD_Max" VAL_BLK 0xCD5F4 Kwb_Wu8 255.0 OneToOne 0.00 255.0 FORMAT "%5.1" NUMBER 4 /end CHARACTERISTIC
/begin CHARACTERISTIC DSM_TypDfp_TVACD_Min_C "Konvertierung der Fehlertypen auf der Diagnoseschnittstelle fuer Fehlerpfad Dfp_TVACD_Min" VAL_BLK 0xCD5F8 Kwb_Wu8 255.0 OneToOne 0.00 255.0 FORMAT "%5.1" NUMBER 4 /end CHARACTERISTIC
/begin CHARACTERISTIC DSM_TypDfp_TVACD_SigNpl_C "Konvertierung der Fehlertypen auf der Diagnoseschnittstelle fuer Fehlerpfad Dfp_TVACD_SigNpl" VAL_BLK 0xCD5FC Kwb_Wu8 255.0 OneToOne 0.00 255.0 FORMAT "%5.1" NUMBER 4 /end CHARACTERISTIC
/begin CHARACTERISTIC DSM_TypDfp_TVACD_TVADia1_C "Konvertierung der Fehlertypen auf der Diagnoseschnittstelle fuer Fehlerpfad Dfp_TVACD_TVADia1" VAL_BLK 0xCD600 Kwb_Wu8 255.0 OneToOne 0.00 255.0 FORMAT "%5.1" NUMBER 4 /end CHARACTERISTIC
/begin CHARACTERISTIC DSM_TypDfp_TVACD_TVADia2_C "Konvertierung der Fehlertypen auf der Diagnoseschnittstelle fuer Fehlerpfad Dfp_TVACD_TVADia2" VAL_BLK 0xCD604 Kwb_Wu8 255.0 OneToOne 0.00 255.0 FORMAT "%5.1" NUMBER 4 /end CHARACTERISTIC
/begin CHARACTERISTIC DSM_TypDfp_TVACD_TVADia3_C "Konvertierung der Fehlertypen auf der Diagnoseschnittstelle fuer Fehlerpfad Dfp_TVACD_TVADia3" VAL_BLK 0xCD608 Kwb_Wu8 255.0 OneToOne 0.00 255.0 FORMAT "%5.1" NUMBER 4 /end CHARACTERISTIC
/begin CHARACTERISTIC DSM_TypDfp_TVACD_TVADia4_C "Konvertierung der Fehlertypen auf der Diagnoseschnittstelle fuer Fehlerpfad Dfp_TVACD_TVADia4" VAL_BLK 0xCD60C Kwb_Wu8 255.0 OneToOne 0.00 255.0 FORMAT "%5.1" NUMBER 4 /end CHARACTERISTIC
/begin CHARACTERISTIC DSM_TypDfp_VSACD_DioInDia1_C "Konvertierung der Fehlertypen auf der Diagnoseschnittstelle fuer Fehlerpfad Dfp_VSACD_DioInDia1" VAL_BLK 0xCD610 Kwb_Wu8 255.0 OneToOne 0.00 255.0 FORMAT "%5.1" NUMBER 4 /end CHARACTERISTIC
/begin CHARACTERISTIC DSM_TypDfp_VSACD_DioInDia2_C "Konvertierung der Fehlertypen auf der Diagnoseschnittstelle fuer Fehlerpfad Dfp_VSACD_DioInDia2" VAL_BLK 0xCD614 Kwb_Wu8 255.0 OneToOne 0.00 255.0 FORMAT "%5.1" NUMBER 4 /end CHARACTERISTIC
/begin CHARACTERISTIC DSM_TypDfp_VSACD_DioInDia3_C "Konvertierung der Fehlertypen auf der Diagnoseschnittstelle fuer Fehlerpfad Dfp_VSACD_DioInDia3" VAL_BLK 0xCD618 Kwb_Wu8 255.0 OneToOne 0.00 255.0 FORMAT "%5.1" NUMBER 4 /end CHARACTERISTIC
/begin CHARACTERISTIC DSM_TypDfp_VSACD_DioInDia4_C "Konvertierung der Fehlertypen auf der Diagnoseschnittstelle fuer Fehlerpfad Dfp_VSACD_DioInDia4" VAL_BLK 0xCD61C Kwb_Wu8 255.0 OneToOne 0.00 255.0 FORMAT "%5.1" NUMBER 4 /end CHARACTERISTIC
/begin CHARACTERISTIC DSM_TypDfp_VSACD_DioInMin_C "Konvertierung der Fehlertypen auf der Diagnoseschnittstelle fuer Fehlerpfad Dfp_VSACD_DioInMin" VAL_BLK 0xCD620 Kwb_Wu8 255.0 OneToOne 0.00 255.0 FORMAT "%5.1" NUMBER 4 /end CHARACTERISTIC
/begin CHARACTERISTIC DSM_TypDfp_VSACD_Max_C "Konvertierung der Fehlertypen auf der Diagnoseschnittstelle fuer Fehlerpfad Dfp_VSACD_Max" VAL_BLK 0xCD624 Kwb_Wu8 255.0 OneToOne 0.00 255.0 FORMAT "%5.1" NUMBER 4 /end CHARACTERISTIC
/begin CHARACTERISTIC DSM_TypDfp_VSACD_Min_C "Konvertierung der Fehlertypen auf der Diagnoseschnittstelle fuer Fehlerpfad Dfp_VSACD_Min" VAL_BLK 0xCD628 Kwb_Wu8 255.0 OneToOne 0.00 255.0 FORMAT "%5.1" NUMBER 4 /end CHARACTERISTIC
/begin CHARACTERISTIC DSM_TypDfp_VSACD_SigNpl_C "Konvertierung der Fehlertypen auf der Diagnoseschnittstelle fuer Fehlerpfad Dfp_VSACD_SigNpl" VAL_BLK 0xCD62C Kwb_Wu8 255.0 OneToOne 0.00 255.0 FORMAT "%5.1" NUMBER 4 /end CHARACTERISTIC
/begin CHARACTERISTIC DSM_TypDfp_VSACD_VSADia1_C "Konvertierung der Fehlertypen auf der Diagnoseschnittstelle fuer Fehlerpfad Dfp_VSACD_VSADia1" VAL_BLK 0xCD630 Kwb_Wu8 255.0 OneToOne 0.00 255.0 FORMAT "%5.1" NUMBER 4 /end CHARACTERISTIC
/begin CHARACTERISTIC DSM_TypDfp_VSACD_VSADia2_C "Konvertierung der Fehlertypen auf der Diagnoseschnittstelle fuer Fehlerpfad Dfp_VSACD_VSADia2" VAL_BLK 0xCD634 Kwb_Wu8 255.0 OneToOne 0.00 255.0 FORMAT "%5.1" NUMBER 4 /end CHARACTERISTIC
/begin CHARACTERISTIC DSM_TypDfp_VSACD_VSADia3_C "Konvertierung der Fehlertypen auf der Diagnoseschnittstelle fuer Fehlerpfad Dfp_VSACD_VSADia3" VAL_BLK 0xCD638 Kwb_Wu8 255.0 OneToOne 0.00 255.0 FORMAT "%5.1" NUMBER 4 /end CHARACTERISTIC
/begin CHARACTERISTIC DSM_TypDfp_VSACD_VSADia4_C "Konvertierung der Fehlertypen auf der Diagnoseschnittstelle fuer Fehlerpfad Dfp_VSACD_VSADia4" VAL_BLK 0xCD63C Kwb_Wu8 255.0 OneToOne 0.00 255.0 FORMAT "%5.1" NUMBER 4 /end CHARACTERISTIC
/begin CHARACTERISTIC DSM_TypDfp_VSSCD1_C "Konvertierung der Fehlertypen auf der Diagnoseschnittstelle fuer Fehlerpfad Dfp_VSSCD1" VAL_BLK 0xCD640 Kwb_Wu8 255.0 OneToOne 0.00 255.0 FORMAT "%5.1" NUMBER 4 /end CHARACTERISTIC
/begin CHARACTERISTIC DSM_TypDfp_VSSCD2_C "Konvertierung der Fehlertypen auf der Diagnoseschnittstelle fuer Fehlerpfad Dfp_VSSCD2" VAL_BLK 0xCD644 Kwb_Wu8 255.0 OneToOne 0.00 255.0 FORMAT "%5.1" NUMBER 4 /end CHARACTERISTIC
/begin CHARACTERISTIC DSM_TypDfp_WdCom_C "Konvertierung der Fehlertypen auf der Diagnoseschnittstelle fuer Fehlerpfad Dfp_WdCom" VAL_BLK 0xCD648 Kwb_Wu8 255.0 OneToOne 0.00 255.0 FORMAT "%5.1" NUMBER 4 /end CHARACTERISTIC
/begin FUNCTION dsm_auto_sdw ""
 /begin DEF_CHARACTERISTIC DSM_SdwDfp_Layer_TANS_C DSM_SdwDfp_ACCDCmpr_C DSM_SdwDfp_ACCDPres_C DSM_SdwDfp_ACCDPres1_C DSM_SdwDfp_ACCDPresAna_C DSM_SdwDfp_ACCDSwtin_C DSM_SdwDfp_ACC_PlausTrqDes_C DSM_SdwDfp_ACC_trqInr_C DSM_SdwDfp_ACTrq_C DSM_SdwDfp_ADCMon_C DSM_SdwDfp_AFSCDIdlAdjVal_C DSM_SdwDfp_AFSCDLdAdjVal_C DSM_SdwDfp_AFSCD_AirTempDcyc_C DSM_SdwDfp_AFSCD_PlOffsDrft_C DSM_SdwDfp_AFSCD_PlSetyDrft_C DSM_SdwDfp_AFSCD_SRCAirTemp_C DSM_SdwDfp_AFSCD_SRCBatt_C DSM_SdwDfp_AFSCD_SRCCorrAirm_C DSM_SdwDfp_AFSCD_SRCRawAirm_C DSM_SdwDfp_Layer_TUMG_C DSM_SdwDfp_AFSCD_SRCRefSigPer_C DSM_SdwDfp_AOHtCD_C DSM_SdwDfp_Layer_GEN_C DSM_SdwDfp_Layer_BSD_C DSM_SdwDfp_AOHtCD_AOHtDia1_C DSM_SdwDfp_AOHtCD_AOHtDia2_C DSM_SdwDfp_AOHtCD_AOHtDia3_C DSM_SdwDfp_APP1_C DSM_SdwDfp_APP2_C DSM_SdwDfp_APPSync_C DSM_SdwDfp_APSCD_C DSM_SdwDfp_ARS_C DSM_SdwDfp_AccPedPlausBrk_C DSM_SdwDfp_AirCtlGvnrDvtRgnMax_C DSM_SdwDfp_Layer_QLT_C DSM_SdwDfp_AirCtlGvnrDvtRgnMax2_C DSM_SdwDfp_Layer_IBS1_C DSM_SdwDfp_Layer_IBS2_C DSM_SdwDfp_Layer_IBS3_C DSM_SdwDfp_Layer_PMBN_C DSM_SdwDfp_Layer_PMBATT_C DSM_SdwDfp_AirCtlGvnrDvtRgnMin_C DSM_SdwDfp_AirCtlGvnrDvtRgnMin2_C DSM_SdwDfp_AirCtlPlateBreak_C DSM_SdwDfp_AirCtlRmpTO_C DSM_SdwDfp_AirCtl_GovNegDev_C DSM_SdwDfp_AirCtl_GovNegDev2_C DSM_SdwDfp_AirCtl_GovPosDev_C DSM_SdwDfp_AirCtl_GovPosDev2_C DSM_SdwDfp_AltCD_C DSM_SdwDfp_AltCD_Load_C DSM_SdwDfp_BPACD_BPADia1_C DSM_SdwDfp_BPACD_BPADia2_C DSM_SdwDfp_BPACD_BPADia3_C DSM_SdwDfp_BPACD_Max_C DSM_SdwDfp_BPACD_Min_C DSM_SdwDfp_BPACD_SigNpl_C DSM_SdwDfp_BPSCD_C DSM_SdwDfp_BattCD_C DSM_SdwDfp_BrkCD_C DSM_SdwDfp_Bss_C DSM_SdwDfp_CBACD_C DSM_SdwDfp_CTSCD_C DSM_SdwDfp_Clg_DynTst_C DSM_SdwDfp_CmbChbMisfire1_C DSM_SdwDfp_CmbChbMisfire2_C DSM_SdwDfp_CmbChbMisfire3_C DSM_SdwDfp_CmbChbMisfire4_C DSM_SdwDfp_CmbChbMisfire5_C DSM_SdwDfp_CmbChbMisfire6_C DSM_SdwDfp_CmbChbMisfireMul_C DSM_SdwDfp_CoVMDCSh_C DSM_SdwDfp_ConvCD_C DSM_SdwDfp_Layer_PMRUHVERL_C DSM_SdwDfp_CrCCDMFL_C DSM_SdwDfp_CrCtl_vCrCtl_C DSM_SdwDfp_DCC_PlausTrqDes_C DSM_SdwDfp_Dummy1_C DSM_SdwDfp_Layer_TOENS_C DSM_SdwDfp_Layer_MANHYDR_C DSM_SdwDfp_Layer_MANLUFT_C DSM_SdwDfp_EATSCD_C DSM_SdwDfp_EBAFCD_C DSM_SdwDfp_EBFCD_C DSM_SdwDfp_EBTSCD_C DSM_SdwDfp_EBTSCD_OvrTemp_C DSM_SdwDfp_EEPCDVarMng_C DSM_SdwDfp_EGPpCD_C DSM_SdwDfp_EGPpCDTPreTrbn_C DSM_SdwDfp_EGRCD_Max_C DSM_SdwDfp_EGRCD_Min_C DSM_SdwDfp_EGRCD_SigNpl_C DSM_SdwDfp_EGTRgnOilDil_C DSM_SdwDfp_EMCCDNoLoad1_C DSM_SdwDfp_EMCCDNoLoad2_C DSM_SdwDfp_EMCCDSCBat1_C DSM_SdwDfp_EMCCDSCBat2_C DSM_SdwDfp_EMCCDSCGnd1_C DSM_SdwDfp_EMCCDSCGnd2_C DSM_SdwDfp_EMCCD_ADC1_C DSM_SdwDfp_EMCCD_ADC2_C DSM_SdwDfp_ETClbETFltInj1_C DSM_SdwDfp_ETClbETFltInj2_C DSM_SdwDfp_ETClbETFltInj3_C DSM_SdwDfp_ETClbETFltInj4_C DSM_SdwDfp_ETClbETFltInj5_C DSM_SdwDfp_ETClbETFltInj6_C DSM_SdwDfp_ETClbInj1_C DSM_SdwDfp_ETClbInj2_C DSM_SdwDfp_ETClbInj3_C DSM_SdwDfp_ETClbInj4_C DSM_SdwDfp_ETClbInj5_C DSM_SdwDfp_ETClbInj6_C DSM_SdwDfp_EngMCaS1_C DSM_SdwDfp_EngMCrS1_C DSM_SdwDfp_EngMOfsCaSCrS_C DSM_SdwDfp_EngPrtFWODet_C DSM_SdwDfp_FBCqDvt_C DSM_SdwDfp_FMTC_NonMonotonMap_C DSM_SdwDfp_FTSCD_C DSM_SdwDfp_FanCD_C DSM_SdwDfp_FanCD_FanCtlr1_C DSM_SdwDfp_FanCD_FanCtlr2_C DSM_SdwDfp_FanCD_FanCtlr3_C DSM_SdwDfp_FlFCD_C DSM_SdwDfp_FlMngSmkDefect_C DSM_SdwDfp_FrmMngANFRADMOMPT_C DSM_SdwDfp_FrmMngASC1_C DSM_SdwDfp_FrmMngASC2_C DSM_SdwDfp_FrmMngASC3_C DSM_SdwDfp_FrmMngASC4_C DSM_SdwDfp_FrmMngBOS_RESET_C DSM_SdwDfp_FrmMngBOS_RESET_2_C DSM_SdwDfp_FrmMngDMANFAFS_C DSM_SdwDfp_FrmMngDRMANFSSG_C DSM_SdwDfp_FrmMngEGS1_C DSM_SdwDfp_FrmMngEGS2_C DSM_SdwDfp_FrmMngGEARBX_DATA_C DSM_SdwDfp_FrmMngGEARBX_DATA2_C DSM_SdwDfp_FrmMngHEAT_AC_C DSM_SdwDfp_FrmMngINSTR2_C DSM_SdwDfp_FrmMngINSTR3_C DSM_SdwDfp_FrmMngLENKRADWINKEL_C DSM_SdwDfp_FrmMngMILEAGE_RANGE_C DSM_SdwDfp_FrmMngOPCRCTLACC_C DSM_SdwDfp_FrmMngPRGG_CCTR_C DSM_SdwDfp_FrmMngPWRMNG_LOADV_C DSM_SdwDfp_FrmMngParkConsumer_C DSM_SdwDfp_FrmMngRQSTGEFAN_C DSM_SdwDfp_FrmMngSSGErr_C DSM_SdwDfp_FrmMngSSGShOff_C DSM_SdwDfp_FrmMngSTAT_ANH_C DSM_SdwDfp_FrmMngSTAT_ARS_C DSM_SdwDfp_FrmMngSTAT_DSC_C DSM_SdwDfp_FrmMngSTAT_EKP_C DSM_SdwDfp_FrmMngSTAT_KOMBI_C DSM_SdwDfp_FrmMngSTAT_SITZ_C DSM_SdwDfp_FrmMngStOBDGbxMilOf_C DSM_SdwDfp_FrmMngStOBDGbxMilOn_C DSM_SdwDfp_FrmMngTEMPRELTIME_C DSM_SdwDfp_FrmMngTERMINAL_C DSM_SdwDfp_FrmMngTIME_DATE_C DSM_SdwDfp_FrmMngTORQUE_DSC_C DSM_SdwDfp_FrmMngTORQUE_GEARBX_C DSM_SdwDfp_FrmMngTrq_ReqACC_C DSM_SdwDfp_FrmMngVEH_MOD_C DSM_SdwDfp_FrmMngVELOCITY_C DSM_SdwDfp_FrmMngWHEEL_SPEED_C DSM_SdwDfp_FrmMngstCurr_C DSM_SdwDfp_FrmMngswtPSPOff_C DSM_SdwDfp_GearbxIncMax_C DSM_SdwDfp_GlwCD_C DSM_SdwDfp_GlwCDGlwCirc1_C DSM_SdwDfp_GlwCDGlwCirc2_C DSM_SdwDfp_GlwCDGlwCirc3_C DSM_SdwDfp_GlwCDGlwCirc4_C DSM_SdwDfp_GlwCDGlwCirc5_C DSM_SdwDfp_GlwCDGlwCirc6_C DSM_SdwDfp_GlwCDGlwCirc7_C DSM_SdwDfp_GlwCDGlwCirc8_C DSM_SdwDfp_GlwCtl_C DSM_SdwDfp_HWEMonCom_C DSM_SdwDfp_HWEMonEEPROM_C DSM_SdwDfp_HWEMonRcyLocked_C DSM_SdwDfp_HWEMonRcySuppressed_C DSM_SdwDfp_HWEMonRcyVisible_C DSM_SdwDfp_HWEMonUMaxSupply_C DSM_SdwDfp_HWEMonUMinSupply_C DSM_SdwDfp_IATSCD_C DSM_SdwDfp_IATSCD_CATS_C DSM_SdwDfp_ImmCtlImmCD_C DSM_SdwDfp_ImmCtlImmEep_C DSM_SdwDfp_ImmCtlMpl_C DSM_SdwDfp_IndSys1_C DSM_SdwDfp_IndSys2_C DSM_SdwDfp_InjCrv_InjLim_C DSM_SdwDfp_InjCtlAdjQnt_C DSM_SdwDfp_InjCtlDrift_C DSM_SdwDfp_InjVlvBnk1A_C DSM_SdwDfp_InjVlvBnk1B_C DSM_SdwDfp_InjVlvBnk2A_C DSM_SdwDfp_InjVlvBnk2B_C DSM_SdwDfp_InjVlvChipA_C DSM_SdwDfp_InjVlvChipB_C DSM_SdwDfp_InjVlvCyl1A_C DSM_SdwDfp_InjVlvCyl1B_C DSM_SdwDfp_InjVlvCyl2A_C DSM_SdwDfp_InjVlvCyl2B_C DSM_SdwDfp_InjVlvCyl3A_C DSM_SdwDfp_InjVlvCyl3B_C DSM_SdwDfp_InjVlvCyl4A_C DSM_SdwDfp_InjVlvCyl4B_C DSM_SdwDfp_InjVlvCyl5A_C DSM_SdwDfp_InjVlvCyl5B_C DSM_SdwDfp_InjVlvCyl6A_C DSM_SdwDfp_InjVlvCyl6B_C DSM_SdwDfp_LPACD_Max_C DSM_SdwDfp_LPACD_Min_C DSM_SdwDfp_LPACD_SigNpl_C DSM_SdwDfp_LSUCDCircNernst0_C DSM_SdwDfp_LSUCDCircPumpCur0_C DSM_SdwDfp_LSUCDCircVirtGnd0_C DSM_SdwDfp_LSUCDHeater0_C DSM_SdwDfp_LSUCDHtCoup0_C DSM_SdwDfp_LSUCDO20_C DSM_SdwDfp_LSUCDO2Clb0_C DSM_SdwDfp_LSUCDRiClb0_C DSM_SdwDfp_LSUCDSPI0_C DSM_SdwDfp_LSUCDSPIBattLow0_C DSM_SdwDfp_LSUCDWireIP0_C DSM_SdwDfp_LSUCtlRiExc0_C DSM_SdwDfp_LSUMon1Sens_C DSM_SdwDfp_LSUMon2Sens_C DSM_SdwDfp_MIL_C DSM_SdwDfp_MRlyCD_C DSM_SdwDfp_MSidCD_Comm_C DSM_SdwDfp_MSidCD_Pin_C DSM_SdwDfp_MSidCD_Sel_INI_C DSM_SdwDfp_MSidCD_Select_C DSM_SdwDfp_MeUnCDNoLoad_C DSM_SdwDfp_MeUnCDSCBat_C DSM_SdwDfp_MeUnCDSCGnd_C DSM_SdwDfp_MeUnCD_ADC_C DSM_SdwDfp_MeUnCD_SigTst_C DSM_SdwDfp_Montr_C DSM_SdwDfp_NetMngDeviceA_C DSM_SdwDfp_NetMngDeviceB_C DSM_SdwDfp_NetMngDeviceC_C DSM_SdwDfp_OPSCD_Lamp_C DSM_SdwDfp_OPSCD_anain_C DSM_SdwDfp_OTSCD_C DSM_SdwDfp_OvRMon_C DSM_SdwDfp_OvRMonBrk_C DSM_SdwDfp_OvRMonSigA_C DSM_SdwDfp_OxiCCDTPre_C DSM_SdwDfp_PCR_GovDevNeg_C DSM_SdwDfp_PCR_GovDevPos_C DSM_SdwDfp_PCR_LPGvnrDvtNeg_C DSM_SdwDfp_PCR_LPGvnrDvtPos_C DSM_SdwDfp_PCVCDNoLoad_C DSM_SdwDfp_PCVCDSCBat_C DSM_SdwDfp_PCVCDSCGnd_C DSM_SdwDfp_PCVCD_ADC_C DSM_SdwDfp_PCVCD_SigTst_C DSM_SdwDfp_PFltAPSPlaus_C DSM_SdwDfp_PFltAPSens_C DSM_SdwDfp_PFltBPSPlaus_C DSM_SdwDfp_PFltCDPPre_C DSM_SdwDfp_PFltCDTempPre_C DSM_SdwDfp_PFltChar_C DSM_SdwDfp_PFltEngPrt_C DSM_SdwDfp_PFltPresDynPlaus_C DSM_SdwDfp_PFltPresPlaus_C DSM_SdwDfp_PFltPresSens_C DSM_SdwDfp_PFltPresSensFrz_C DSM_SdwDfp_PFltPresSensHsLn_C DSM_SdwDfp_PFltPresSensSot_C DSM_SdwDfp_PFltRgnPerm_C DSM_SdwDfp_PFltTempDwnStrm_C DSM_SdwDfp_PFltTempSens_C DSM_SdwDfp_PFltTempUpStrm_C DSM_SdwDfp_PFltmSotDiffMax_C DSM_SdwDfp_PSPCD_Actr_C DSM_SdwDfp_PresPlausDblDef_C DSM_SdwDfp_QLTCD_C DSM_SdwDfp_RailCD_C DSM_SdwDfp_RailCDOfsTst_C DSM_SdwDfp_RailCD_PMonStrt_C DSM_SdwDfp_RailCtlModeMeUnDiag_C DSM_SdwDfp_RailCtlModePCVDiag_C DSM_SdwDfp_RailMeUn0_C DSM_SdwDfp_RailMeUn1_C DSM_SdwDfp_RailMeUn2_C DSM_SdwDfp_RailMeUn3_C DSM_SdwDfp_RailMeUn4_C DSM_SdwDfp_RailPCV0_C DSM_SdwDfp_RailPCV1_C DSM_SdwDfp_RailPCV2_C DSM_SdwDfp_RailPCV3_C DSM_SdwDfp_RailPCV4_C DSM_SdwDfp_RailPCV5_C DSM_SdwDfp_SOPTst_C DSM_SdwDfp_SSpMon1_C DSM_SdwDfp_SSpMon2_C DSM_SdwDfp_SSpMon3_C DSM_SdwDfp_SWChk_CycSigChkDat_C DSM_SdwDfp_SWChk_CycSigChkPrg_C DSM_SdwDfp_ShutCD_C DSM_SdwDfp_ShutCDMax_C DSM_SdwDfp_ShutCDMin_C DSM_SdwDfp_ShutCDSigNpl_C DSM_SdwDfp_StSysTrqShutOff_C DSM_SdwDfp_StrtCD_Actr_C DSM_SdwDfp_SysLamp_C DSM_SdwDfp_T15CD_C DSM_SdwDfp_TGearbx_C DSM_SdwDfp_TPUMon_C DSM_SdwDfp_TVACD_Max_C DSM_SdwDfp_TVACD_Min_C DSM_SdwDfp_TVACD_SigNpl_C DSM_SdwDfp_TVACD_TVADia1_C DSM_SdwDfp_TVACD_TVADia2_C DSM_SdwDfp_TVACD_TVADia3_C DSM_SdwDfp_TVACD_TVADia4_C DSM_SdwDfp_VSACD_DioInDia1_C DSM_SdwDfp_VSACD_DioInDia2_C DSM_SdwDfp_VSACD_DioInDia3_C DSM_SdwDfp_VSACD_DioInDia4_C DSM_SdwDfp_VSACD_DioInMin_C DSM_SdwDfp_VSACD_Max_C DSM_SdwDfp_VSACD_Min_C DSM_SdwDfp_VSACD_SigNpl_C DSM_SdwDfp_VSACD_VSADia1_C DSM_SdwDfp_VSACD_VSADia2_C DSM_SdwDfp_VSACD_VSADia3_C DSM_SdwDfp_VSACD_VSADia4_C DSM_SdwDfp_VSSCD1_C DSM_SdwDfp_VSSCD2_C DSM_SdwDfp_WdCom_C /end DEF_CHARACTERISTIC
/end FUNCTION
/begin FUNCTION dsm_auto_trans ""
 /begin DEF_CHARACTERISTIC DSM_TypDfp_Layer_TANS_C DSM_TypDfp_ACCDCmpr_C DSM_TypDfp_ACCDPres_C DSM_TypDfp_ACCDPres1_C DSM_TypDfp_ACCDPresAna_C DSM_TypDfp_ACCDSwtin_C DSM_TypDfp_ACC_PlausTrqDes_C DSM_TypDfp_ACC_trqInr_C DSM_TypDfp_ACTrq_C DSM_TypDfp_ADCMon_C DSM_TypDfp_AFSCDIdlAdjVal_C DSM_TypDfp_AFSCDLdAdjVal_C DSM_TypDfp_AFSCD_AirTempDcyc_C DSM_TypDfp_AFSCD_PlOffsDrft_C DSM_TypDfp_AFSCD_PlSetyDrft_C DSM_TypDfp_AFSCD_SRCAirTemp_C DSM_TypDfp_AFSCD_SRCBatt_C DSM_TypDfp_AFSCD_SRCCorrAirm_C DSM_TypDfp_AFSCD_SRCRawAirm_C DSM_TypDfp_Layer_TUMG_C DSM_TypDfp_AFSCD_SRCRefSigPer_C DSM_TypDfp_AOHtCD_C DSM_TypDfp_Layer_GEN_C DSM_TypDfp_Layer_BSD_C DSM_TypDfp_AOHtCD_AOHtDia1_C DSM_TypDfp_AOHtCD_AOHtDia2_C DSM_TypDfp_AOHtCD_AOHtDia3_C DSM_TypDfp_APP1_C DSM_TypDfp_APP2_C DSM_TypDfp_APPSync_C DSM_TypDfp_APSCD_C DSM_TypDfp_ARS_C DSM_TypDfp_AccPedPlausBrk_C DSM_TypDfp_AirCtlGvnrDvtRgnMax_C DSM_TypDfp_Layer_QLT_C DSM_TypDfp_AirCtlGvnrDvtRgnMax2_C DSM_TypDfp_Layer_IBS1_C DSM_TypDfp_Layer_IBS2_C DSM_TypDfp_Layer_IBS3_C DSM_TypDfp_Layer_PMBN_C DSM_TypDfp_Layer_PMBATT_C DSM_TypDfp_AirCtlGvnrDvtRgnMin_C DSM_TypDfp_AirCtlGvnrDvtRgnMin2_C DSM_TypDfp_AirCtlPlateBreak_C DSM_TypDfp_AirCtlRmpTO_C DSM_TypDfp_AirCtl_GovNegDev_C DSM_TypDfp_AirCtl_GovNegDev2_C DSM_TypDfp_AirCtl_GovPosDev_C DSM_TypDfp_AirCtl_GovPosDev2_C DSM_TypDfp_AltCD_C DSM_TypDfp_AltCD_Load_C DSM_TypDfp_BPACD_BPADia1_C DSM_TypDfp_BPACD_BPADia2_C DSM_TypDfp_BPACD_BPADia3_C DSM_TypDfp_BPACD_Max_C DSM_TypDfp_BPACD_Min_C DSM_TypDfp_BPACD_SigNpl_C DSM_TypDfp_BPSCD_C DSM_TypDfp_BattCD_C DSM_TypDfp_BrkCD_C DSM_TypDfp_Bss_C DSM_TypDfp_CBACD_C DSM_TypDfp_CTSCD_C DSM_TypDfp_Clg_DynTst_C DSM_TypDfp_CmbChbMisfire1_C DSM_TypDfp_CmbChbMisfire2_C DSM_TypDfp_CmbChbMisfire3_C DSM_TypDfp_CmbChbMisfire4_C DSM_TypDfp_CmbChbMisfire5_C DSM_TypDfp_CmbChbMisfire6_C DSM_TypDfp_CmbChbMisfireMul_C DSM_TypDfp_CoVMDCSh_C DSM_TypDfp_ConvCD_C DSM_TypDfp_Layer_PMRUHVERL_C DSM_TypDfp_CrCCDMFL_C DSM_TypDfp_CrCtl_vCrCtl_C DSM_TypDfp_DCC_PlausTrqDes_C DSM_TypDfp_Dummy1_C DSM_TypDfp_Layer_TOENS_C DSM_TypDfp_Layer_MANHYDR_C DSM_TypDfp_Layer_MANLUFT_C DSM_TypDfp_EATSCD_C DSM_TypDfp_EBAFCD_C DSM_TypDfp_EBFCD_C DSM_TypDfp_EBTSCD_C DSM_TypDfp_EBTSCD_OvrTemp_C DSM_TypDfp_EEPCDVarMng_C DSM_TypDfp_EGPpCD_C DSM_TypDfp_EGPpCDTPreTrbn_C DSM_TypDfp_EGRCD_Max_C DSM_TypDfp_EGRCD_Min_C DSM_TypDfp_EGRCD_SigNpl_C DSM_TypDfp_EGTRgnOilDil_C DSM_TypDfp_EMCCDNoLoad1_C DSM_TypDfp_EMCCDNoLoad2_C DSM_TypDfp_EMCCDSCBat1_C DSM_TypDfp_EMCCDSCBat2_C DSM_TypDfp_EMCCDSCGnd1_C DSM_TypDfp_EMCCDSCGnd2_C DSM_TypDfp_EMCCD_ADC1_C DSM_TypDfp_EMCCD_ADC2_C DSM_TypDfp_ETClbETFltInj1_C DSM_TypDfp_ETClbETFltInj2_C DSM_TypDfp_ETClbETFltInj3_C DSM_TypDfp_ETClbETFltInj4_C DSM_TypDfp_ETClbETFltInj5_C DSM_TypDfp_ETClbETFltInj6_C DSM_TypDfp_ETClbInj1_C DSM_TypDfp_ETClbInj2_C DSM_TypDfp_ETClbInj3_C DSM_TypDfp_ETClbInj4_C DSM_TypDfp_ETClbInj5_C DSM_TypDfp_ETClbInj6_C DSM_TypDfp_EngMCaS1_C DSM_TypDfp_EngMCrS1_C DSM_TypDfp_EngMOfsCaSCrS_C DSM_TypDfp_EngPrtFWODet_C DSM_TypDfp_FBCqDvt_C DSM_TypDfp_FMTC_NonMonotonMap_C DSM_TypDfp_FTSCD_C DSM_TypDfp_FanCD_C DSM_TypDfp_FanCD_FanCtlr1_C DSM_TypDfp_FanCD_FanCtlr2_C DSM_TypDfp_FanCD_FanCtlr3_C DSM_TypDfp_FlFCD_C DSM_TypDfp_FlMngSmkDefect_C DSM_TypDfp_FrmMngANFRADMOMPT_C DSM_TypDfp_FrmMngASC1_C DSM_TypDfp_FrmMngASC2_C DSM_TypDfp_FrmMngASC3_C DSM_TypDfp_FrmMngASC4_C DSM_TypDfp_FrmMngBOS_RESET_C DSM_TypDfp_FrmMngBOS_RESET_2_C DSM_TypDfp_FrmMngDMANFAFS_C DSM_TypDfp_FrmMngDRMANFSSG_C DSM_TypDfp_FrmMngEGS1_C DSM_TypDfp_FrmMngEGS2_C DSM_TypDfp_FrmMngGEARBX_DATA_C DSM_TypDfp_FrmMngGEARBX_DATA2_C DSM_TypDfp_FrmMngHEAT_AC_C DSM_TypDfp_FrmMngINSTR2_C DSM_TypDfp_FrmMngINSTR3_C DSM_TypDfp_FrmMngLENKRADWINKEL_C DSM_TypDfp_FrmMngMILEAGE_RANGE_C DSM_TypDfp_FrmMngOPCRCTLACC_C DSM_TypDfp_FrmMngPRGG_CCTR_C DSM_TypDfp_FrmMngPWRMNG_LOADV_C DSM_TypDfp_FrmMngParkConsumer_C DSM_TypDfp_FrmMngRQSTGEFAN_C DSM_TypDfp_FrmMngSSGErr_C DSM_TypDfp_FrmMngSSGShOff_C DSM_TypDfp_FrmMngSTAT_ANH_C DSM_TypDfp_FrmMngSTAT_ARS_C DSM_TypDfp_FrmMngSTAT_DSC_C DSM_TypDfp_FrmMngSTAT_EKP_C DSM_TypDfp_FrmMngSTAT_KOMBI_C DSM_TypDfp_FrmMngSTAT_SITZ_C DSM_TypDfp_FrmMngStOBDGbxMilOf_C DSM_TypDfp_FrmMngStOBDGbxMilOn_C DSM_TypDfp_FrmMngTEMPRELTIME_C DSM_TypDfp_FrmMngTERMINAL_C DSM_TypDfp_FrmMngTIME_DATE_C DSM_TypDfp_FrmMngTORQUE_DSC_C DSM_TypDfp_FrmMngTORQUE_GEARBX_C DSM_TypDfp_FrmMngTrq_ReqACC_C DSM_TypDfp_FrmMngVEH_MOD_C DSM_TypDfp_FrmMngVELOCITY_C DSM_TypDfp_FrmMngWHEEL_SPEED_C DSM_TypDfp_FrmMngstCurr_C DSM_TypDfp_FrmMngswtPSPOff_C DSM_TypDfp_GearbxIncMax_C DSM_TypDfp_GlwCD_C DSM_TypDfp_GlwCDGlwCirc1_C DSM_TypDfp_GlwCDGlwCirc2_C DSM_TypDfp_GlwCDGlwCirc3_C DSM_TypDfp_GlwCDGlwCirc4_C DSM_TypDfp_GlwCDGlwCirc5_C DSM_TypDfp_GlwCDGlwCirc6_C DSM_TypDfp_GlwCDGlwCirc7_C DSM_TypDfp_GlwCDGlwCirc8_C DSM_TypDfp_GlwCtl_C DSM_TypDfp_HWEMonCom_C DSM_TypDfp_HWEMonEEPROM_C DSM_TypDfp_HWEMonRcyLocked_C DSM_TypDfp_HWEMonRcySuppressed_C DSM_TypDfp_HWEMonRcyVisible_C DSM_TypDfp_HWEMonUMaxSupply_C DSM_TypDfp_HWEMonUMinSupply_C DSM_TypDfp_IATSCD_C DSM_TypDfp_IATSCD_CATS_C DSM_TypDfp_ImmCtlImmCD_C DSM_TypDfp_ImmCtlImmEep_C DSM_TypDfp_ImmCtlMpl_C DSM_TypDfp_IndSys1_C DSM_TypDfp_IndSys2_C DSM_TypDfp_InjCrv_InjLim_C DSM_TypDfp_InjCtlAdjQnt_C DSM_TypDfp_InjCtlDrift_C DSM_TypDfp_InjVlvBnk1A_C DSM_TypDfp_InjVlvBnk1B_C DSM_TypDfp_InjVlvBnk2A_C DSM_TypDfp_InjVlvBnk2B_C DSM_TypDfp_InjVlvChipA_C DSM_TypDfp_InjVlvChipB_C DSM_TypDfp_InjVlvCyl1A_C DSM_TypDfp_InjVlvCyl1B_C DSM_TypDfp_InjVlvCyl2A_C DSM_TypDfp_InjVlvCyl2B_C DSM_TypDfp_InjVlvCyl3A_C DSM_TypDfp_InjVlvCyl3B_C DSM_TypDfp_InjVlvCyl4A_C DSM_TypDfp_InjVlvCyl4B_C DSM_TypDfp_InjVlvCyl5A_C DSM_TypDfp_InjVlvCyl5B_C DSM_TypDfp_InjVlvCyl6A_C DSM_TypDfp_InjVlvCyl6B_C DSM_TypDfp_LPACD_Max_C DSM_TypDfp_LPACD_Min_C DSM_TypDfp_LPACD_SigNpl_C DSM_TypDfp_LSUCDCircNernst0_C DSM_TypDfp_LSUCDCircPumpCur0_C DSM_TypDfp_LSUCDCircVirtGnd0_C DSM_TypDfp_LSUCDHeater0_C DSM_TypDfp_LSUCDHtCoup0_C DSM_TypDfp_LSUCDO20_C DSM_TypDfp_LSUCDO2Clb0_C DSM_TypDfp_LSUCDRiClb0_C DSM_TypDfp_LSUCDSPI0_C DSM_TypDfp_LSUCDSPIBattLow0_C DSM_TypDfp_LSUCDWireIP0_C DSM_TypDfp_LSUCtlRiExc0_C DSM_TypDfp_LSUMon1Sens_C DSM_TypDfp_LSUMon2Sens_C DSM_TypDfp_MIL_C DSM_TypDfp_MRlyCD_C DSM_TypDfp_MSidCD_Comm_C DSM_TypDfp_MSidCD_Pin_C DSM_TypDfp_MSidCD_Sel_INI_C DSM_TypDfp_MSidCD_Select_C DSM_TypDfp_MeUnCDNoLoad_C DSM_TypDfp_MeUnCDSCBat_C DSM_TypDfp_MeUnCDSCGnd_C DSM_TypDfp_MeUnCD_ADC_C DSM_TypDfp_MeUnCD_SigTst_C DSM_TypDfp_Montr_C DSM_TypDfp_NetMngDeviceA_C DSM_TypDfp_NetMngDeviceB_C DSM_TypDfp_NetMngDeviceC_C DSM_TypDfp_OPSCD_Lamp_C DSM_TypDfp_OPSCD_anain_C DSM_TypDfp_OTSCD_C DSM_TypDfp_OvRMon_C DSM_TypDfp_OvRMonBrk_C DSM_TypDfp_OvRMonSigA_C DSM_TypDfp_OxiCCDTPre_C DSM_TypDfp_PCR_GovDevNeg_C DSM_TypDfp_PCR_GovDevPos_C DSM_TypDfp_PCR_LPGvnrDvtNeg_C DSM_TypDfp_PCR_LPGvnrDvtPos_C DSM_TypDfp_PCVCDNoLoad_C DSM_TypDfp_PCVCDSCBat_C DSM_TypDfp_PCVCDSCGnd_C DSM_TypDfp_PCVCD_ADC_C DSM_TypDfp_PCVCD_SigTst_C DSM_TypDfp_PFltAPSPlaus_C DSM_TypDfp_PFltAPSens_C DSM_TypDfp_PFltBPSPlaus_C DSM_TypDfp_PFltCDPPre_C DSM_TypDfp_PFltCDTempPre_C DSM_TypDfp_PFltChar_C DSM_TypDfp_PFltEngPrt_C DSM_TypDfp_PFltPresDynPlaus_C DSM_TypDfp_PFltPresPlaus_C DSM_TypDfp_PFltPresSens_C DSM_TypDfp_PFltPresSensFrz_C DSM_TypDfp_PFltPresSensHsLn_C DSM_TypDfp_PFltPresSensSot_C DSM_TypDfp_PFltRgnPerm_C DSM_TypDfp_PFltTempDwnStrm_C DSM_TypDfp_PFltTempSens_C DSM_TypDfp_PFltTempUpStrm_C DSM_TypDfp_PFltmSotDiffMax_C DSM_TypDfp_PSPCD_Actr_C DSM_TypDfp_PresPlausDblDef_C DSM_TypDfp_QLTCD_C DSM_TypDfp_RailCD_C DSM_TypDfp_RailCDOfsTst_C DSM_TypDfp_RailCD_PMonStrt_C DSM_TypDfp_RailCtlModeMeUnDiag_C DSM_TypDfp_RailCtlModePCVDiag_C DSM_TypDfp_RailMeUn0_C DSM_TypDfp_RailMeUn1_C DSM_TypDfp_RailMeUn2_C DSM_TypDfp_RailMeUn3_C DSM_TypDfp_RailMeUn4_C DSM_TypDfp_RailPCV0_C DSM_TypDfp_RailPCV1_C DSM_TypDfp_RailPCV2_C DSM_TypDfp_RailPCV3_C DSM_TypDfp_RailPCV4_C DSM_TypDfp_RailPCV5_C DSM_TypDfp_SOPTst_C DSM_TypDfp_SSpMon1_C DSM_TypDfp_SSpMon2_C DSM_TypDfp_SSpMon3_C DSM_TypDfp_SWChk_CycSigChkDat_C DSM_TypDfp_SWChk_CycSigChkPrg_C DSM_TypDfp_ShutCD_C DSM_TypDfp_ShutCDMax_C DSM_TypDfp_ShutCDMin_C DSM_TypDfp_ShutCDSigNpl_C DSM_TypDfp_StSysTrqShutOff_C DSM_TypDfp_StrtCD_Actr_C DSM_TypDfp_SysLamp_C DSM_TypDfp_T15CD_C DSM_TypDfp_TGearbx_C DSM_TypDfp_TPUMon_C DSM_TypDfp_TVACD_Max_C DSM_TypDfp_TVACD_Min_C DSM_TypDfp_TVACD_SigNpl_C DSM_TypDfp_TVACD_TVADia1_C DSM_TypDfp_TVACD_TVADia2_C DSM_TypDfp_TVACD_TVADia3_C DSM_TypDfp_TVACD_TVADia4_C DSM_TypDfp_VSACD_DioInDia1_C DSM_TypDfp_VSACD_DioInDia2_C DSM_TypDfp_VSACD_DioInDia3_C DSM_TypDfp_VSACD_DioInDia4_C DSM_TypDfp_VSACD_DioInMin_C DSM_TypDfp_VSACD_Max_C DSM_TypDfp_VSACD_Min_C DSM_TypDfp_VSACD_SigNpl_C DSM_TypDfp_VSACD_VSADia1_C DSM_TypDfp_VSACD_VSADia2_C DSM_TypDfp_VSACD_VSADia3_C DSM_TypDfp_VSACD_VSADia4_C DSM_TypDfp_VSSCD1_C DSM_TypDfp_VSSCD2_C DSM_TypDfp_WdCom_C /end DEF_CHARACTERISTIC
/end FUNCTION
/begin COMPU_METHOD OneToOne "eins zu eins (physikalischer Wert ist gleich dem internen Wert)" RAT_FUNC "%6.2" "-" COEFFS 0 1 0 0 0 1 /end COMPU_METHOD
/begin COMPU_METHOD Time_ms "Zeit in ms für Fehlerentprellung (DSM) und SW-Timer" RAT_FUNC "%6.1" "ms" COEFFS 0 0.1 0 0 0 1 /end COMPU_METHOD
/begin RECORD_LAYOUT Kwb_Wu8 FNC_VALUES 1 UBYTE COLUMN_DIR DIRECT /end RECORD_LAYOUT
/begin RECORD_LAYOUT Kw_Wu16 FNC_VALUES 1 UWORD COLUMN_DIR DIRECT /end RECORD_LAYOUT
/end MODULE
/end PROJECT
