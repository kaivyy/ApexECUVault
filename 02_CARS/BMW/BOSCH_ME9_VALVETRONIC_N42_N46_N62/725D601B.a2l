ASAP2_VERSION 1 3
/begin PROJECT _725D601B "725D601B"
/begin HEADER "" VERSION "_725D601B" PROJECT_NO _725D601B /end HEADER
/begin MODULE DIM ""
/begin MOD_COMMON "" BYTE_ORDER MSB_FIRST ALIGNMENT_BYTE 1 ALIGNMENT_WORD 2 ALIGNMENT_LONG 2 ALIGNMENT_FLOAT32_IEEE 4 /end MOD_COMMON
/begin CHARACTERISTIC ABKTWSLP "Abk¸hlkurve f¸r Temperatur der SLP-wicklung in Abh. von der Abstellzeit" CURVE 0xFCEBB6 KlAxU8SstxU16WU16 0.9960938 fak_ub_b1 0.00 0.9960938 FORMAT "%9.7"
 /begin AXIS_DESCR STD_AXIS tabst_w t1sxs_uw_q1 6 0.00 65535.00 FORMAT "%8.2" DEPOSIT ABSOLUTE /end AXIS_DESCR
/end CHARACTERISTIC
/begin CHARACTERISTIC ADBGLHYST "Hysterese f¸r Adaption Bankabgleich" VALUE 0xFC8766 KwWU16 65.53500 hub_uw_q0p001 0.00 65.53500 FORMAT "%8.5" /end CHARACTERISTIC
/begin CHARACTERISTIC ANZMRKAUS "Anzahl der Ausschaltungen beim Blinken der Markenanzeige" VALUE 0xFD059E KwWU8 255.0 dez 0.00 255.0 FORMAT "%5.1" /end CHARACTERISTIC
/begin CHARACTERISTIC ANZMRKMX "Maximal zul‰ssige Anzahl von Geschwindigkeits-Marken beim Stufentempomat" VALUE 0xFD059F KwWU8 10.00 dez 0.00 10.00 FORMAT "%5.2" /end CHARACTERISTIC
/begin CHARACTERISTIC AVZUNAS "Winkel AV schliesst nach Auslass-Spreizung" VALUE 0xFC4022 KwWU16 6553.500 sprzi_q0p1 0.00 6553.500 FORMAT "%8.3" /end CHARACTERISTIC
/begin CHARACTERISTIC AVZUNAS2 "Auslassventil schliesst nach Auslass-Spreizung Bank 2" VALUE 0xFC4024 KwWU16 6553.500 sprzi_q0p1 0.00 6553.500 FORMAT "%8.3" /end CHARACTERISTIC
/begin CHARACTERISTIC BGMSDKDPS "Umschaltung UGD->UG ueber dpsfak" VALUE 0xFC2A90 KwUb 1.000 fak_ub_q0p00392 0.00 1.000 FORMAT "%5.3" /end CHARACTERISTIC
/begin CHARACTERISTIC BGMSVVTDPS "Umschaltung GD->UGD ueber dpsfak" VALUE 0xFC2A91 KwUb 1.000 fak_ub_q0p00392 0.00 1.000 FORMAT "%5.3" /end CHARACTERISTIC
/begin CHARACTERISTIC BGWDKDPSGR "Grenzwert dp f¸r Berechnung DK-Winkel aus HFM-Signal ungedrosselt" VALUE 0xFC1F6C KwWS16 2559.961 p_q0p039 -1280.000 1279.961 FORMAT "%8.3" /end CHARACTERISTIC
/begin CHARACTERISTIC BREITE "Breite der Zugehoerigkeitskunktion [Grad]" VAL_BLK 0xFC2DB0 KwbWR32 200000.00000000000 fak_r32_1 -100000.00000000000 100000.00000000000 FORMAT "%27.20" NUMBER 3 /end CHARACTERISTIC
/begin CHARACTERISTIC CLEARBGL "Steuerwort Bankabgleich" VALUE 0xFC87AA KwWU8 255.0 DEZ 0.00 255.0 FORMAT "%5.1" /end CHARACTERISTIC
/begin CHARACTERISTIC CWACOFF "Codewort Drehzahlanhebung fuer KK nur ausserhalb LL zuruecksetzen" VALUE 0xFC7FE0 KwWU8 255.0 dez 0.00 255.0 FORMAT "%5.1" /end CHARACTERISTIC
/begin CHARACTERISTIC CWBGSTUT "Codewort BGSTUT" VALUE 0xFD05A0 KwWU8 255.0 dez 0.00 255.0 FORMAT "%5.1" /end CHARACTERISTIC
/begin CHARACTERISTIC CWBGVFGR "Codewort f¸r BGVFGR" VALUE 0xFC2390 KwUb 255.0 dez 0.00 255.0 FORMAT "%5.1" /end CHARACTERISTIC
/begin CHARACTERISTIC CWCCNOMILC "Codewort zur Unterdr¸cken der R¸ckmeldung" VALUE 0xFD264C KwWU32 4294967295.00 DEZ 0.00 4294967295.00 FORMAT "%13.2" /end CHARACTERISTIC
/begin CHARACTERISTIC CWFABR "Codewort Fahrer bremst" VALUE 0xFC7FC2 KwUb 255.0 dez 0.00 255.0 FORMAT "%5.1" /end CHARACTERISTIC
/begin CHARACTERISTIC CWODS "Codewort Oeldruckanzeige Signal" VALUE 0xFD050A KwWU8 255.0 dez 0.00 255.0 FORMAT "%5.1" /end CHARACTERISTIC
/begin CHARACTERISTIC CWRECZGD "Codewort Aufzeichnung Z-Flags und General Denominator" VALUE 0xFCF92C KwUb 255.0 dez 0.00 255.0 FORMAT "%5.1" /end CHARACTERISTIC
/begin CHARACTERISTIC CWTEMPK "Codeword f¸r Adressierung FWFTBRTA (tans/evtmod)" VALUE 0xFD0CF8 KwUb 255.0 dez 0.00 255.0 FORMAT "%5.1" /end CHARACTERISTIC
/begin CHARACTERISTIC CWX5HP "Codewort X5HP" VALUE 0xFD2662 KwUb 255.0 dez 0.00 255.0 FORMAT "%5.1" /end CHARACTERISTIC
/begin CHARACTERISTIC CW_CCPAKTIV "" VALUE 0xFC11EE KwWU8 255.0 default 0.00 255.0 FORMAT "%5.1" /end CHARACTERISTIC
/begin CHARACTERISTIC CW_DPSMSZS "Code-Wort Umschaltung dps_w / dpssol_w" VALUE 0xFC2A92 KwUb 255.0 dez 0.00 255.0 FORMAT "%5.1" /end CHARACTERISTIC
/begin CHARACTERISTIC CW_FABGL "Codewort Freigabe Testerexenteroffsetwinkel ueber Kennwert vorgeben" VALUE 0xFC87AB KwWU8 255.0 DEZ 0.00 255.0 FORMAT "%5.1" /end CHARACTERISTIC
/begin CHARACTERISTIC CW_NNMSZS "Codewort Temperatureingang f¸r Multilineare Regession 0=tmot,1=tmoel,2=toel" VALUE 0xFC2A93 KwUb 255.0 dez 0.00 255.0 FORMAT "%5.1" /end CHARACTERISTIC
/begin CHARACTERISTIC DEVTMAGR "Offset f¸r evtmod abh‰ngig von tsges_w bei hoher tans verursacht d. AGR" CURVE 0xFD0DA6 KlASwSstSwWSw 49151.25 temp_sw_q0p75 -24576.00 24575.25 FORMAT "%8.2"
 /begin AXIS_DESCR STD_AXIS tsges_w temp_sw_q0p75 8 -24576.00 24575.25 FORMAT "%8.2" DEPOSIT ABSOLUTE /end AXIS_DESCR
/end CHARACTERISTIC
/begin CHARACTERISTIC DFKMSMN "Delta FKMSDKMN zum R¸cksetzen von B_fkmsmn" VALUE 0xFC2A94 KwUb 3.984 fak_ub_b4 0.00 3.984 FORMAT "%5.3" /end CHARACTERISTIC
/begin CHARACTERISTIC DFKMSMX "Delta FKMSDKMX zum R¸cksetzen von B_fkmsmx" VALUE 0xFC2A95 KwUb 3.984 fak_ub_b4 0.00 3.984 FORMAT "%5.3" /end CHARACTERISTIC
/begin CHARACTERISTIC DFKPVMN "Delta FKPVDKMN zum R¸cksetzen von B_fkpvmn" VALUE 0xFC2A96 KwUb 3.984 fak_ub_b4 0.00 3.984 FORMAT "%5.3" /end CHARACTERISTIC
/begin CHARACTERISTIC DFKPVMX "Delta FKPVDKMX zum R¸cksetzen von B_fkpvmx" VALUE 0xFC2A97 KwUb 3.984 fak_ub_b4 0.00 3.984 FORMAT "%5.3" /end CHARACTERISTIC
/begin CHARACTERISTIC DFLUBGLM "Schwelle maximal zul‰ssige Abweichung flutbgl_w vom Bankmittelwert" VALUE 0xFC8768 KwWU16 15.99976 fak_sw_b8 0.00 15.99976 FORMAT "%8.5" /end CHARACTERISTIC
/begin CHARACTERISTIC DLTDPSMN "Minimale Begrenzung Differenzdruck‰nderung im Saugrohr" VALUE 0xFC4026 KwWS16 2559.961 p_sw_q0p039 -1280.000 1279.961 FORMAT "%8.3" /end CHARACTERISTIC
/begin CHARACTERISTIC DLTDPSMX "Maximale Begrenzung Differenzdruck‰nderung im Saugrohr" VALUE 0xFC4028 KwWS16 2559.961 p_sw_q0p039 -1280.000 1279.961 FORMAT "%8.3" /end CHARACTERISTIC
/begin CHARACTERISTIC DLUBBGLALL "Schwelle f¸r Differenz aus Laufunruhen im Leerlauf, Regelung ein" VALUE 0xFC876A KwWU16 15.99976 fak_sw_b8 0.00 15.99976 FORMAT "%8.5" /end CHARACTERISTIC
/begin CHARACTERISTIC DLUBBGLATL "Schwelle f¸r Differenz aus Laufunruhen in Teillast, Regelung ein" VALUE 0xFC876C KwWU16 15.99976 fak_sw_b8 0.00 15.99976 FORMAT "%8.5" /end CHARACTERISTIC
/begin CHARACTERISTIC DLUBBGLPLL "Schwelle f¸r Differenz aus Laufunruhen im Leerlauf, Regelung aus" VALUE 0xFC876E KwWU16 15.99976 fak_sw_b8 0.00 15.99976 FORMAT "%8.5" /end CHARACTERISTIC
/begin CHARACTERISTIC DLUBBGLPTL "Schwelle f¸r Differenz aus Laufunruhen in Teillast, Regelung aus" VALUE 0xFC8770 KwWU16 15.99976 fak_sw_b8 0.00 15.99976 FORMAT "%8.5" /end CHARACTERISTIC
/begin CHARACTERISTIC DNMXSSGDR "Drehzahloffset  f¸r SSG-NMAX-Regelung (w‰hrend SSG-Drehzahlregelung)" VALUE 0xFC7FDE KwUw 16383.75 nmot_uw_q0p25 0.00 16383.75 FORMAT "%8.2" /end CHARACTERISTIC
/begin CHARACTERISTIC DPSSOLBGL "Differenzdruckschwelle zum sperren des Bankabgleichs" VALUE 0xFC8772 KwWS16 2559.961 p_q0p039 -1280.000 1279.961 FORMAT "%8.3" /end CHARACTERISTIC
/begin CHARACTERISTIC DPSTDMN "" VALUE 0xFC2AC0 KwUw 2559.961 p_q0p039 0.00 2559.961 FORMAT "%8.3" /end CHARACTERISTIC
/begin CHARACTERISTIC DTUHRPL "zul. Zeitdifferenz bei Gleichlaufpr¸fung der CAN-Uhr zu Motronic-Timer" VALUE 0xFD1A6E KwUw 65535.00 t1sxs_q1 0.00 65535.00 FORMAT "%8.2" /end CHARACTERISTIC
/begin CHARACTERISTIC DVMARK "Mindestabstand von Geschwindigkeits-Marken beim Stufentempomat" VALUE 0xFD058E KwWU16 511.9922 vfzg_uw_q0p0078125 0.00 511.9922 FORMAT "%8.4" /end CHARACTERISTIC
/begin CHARACTERISTIC DVMARKMI "dvmark_w f¸r mph-Tacho" VALUE 0xFD0590 KwWU16 511.9922 vfzg_uw_q0p0078125 0.00 511.9922 FORMAT "%8.4" /end CHARACTERISTIC
/begin CHARACTERISTIC DVMINJMP "Stufentempomat Geschwindigkeitsdifferenz f¸r Sprung Zielgeschwindigkeit" VALUE 0xFD0592 KwWU16 511.9922 vfzg_uw_q0p0078125 0.00 511.9922 FORMAT "%8.4" /end CHARACTERISTIC
/begin CHARACTERISTIC DVPRG "Schrittweite bei Anzeige der Regelgeschwindigkeit im Programmiermodus" VALUE 0xFD0594 KwWU16 511.9844 vfzg_uw_q0p0078125 0.007812500 511.9922 FORMAT "%8.4" /end CHARACTERISTIC
/begin CHARACTERISTIC DVPRGMI "dvprg_w f¸r mph-Tacho" VALUE 0xFD0596 KwWU16 511.9844 vfzg_uw_q0p0078125 0.007812500 511.9922 FORMAT "%8.4" /end CHARACTERISTIC
/begin CHARACTERISTIC DVSTUTOM "Schrittweite f¸r Verstellung der Zielgeschwindigkeit ohne programmierte Marken" VALUE 0xFD0598 KwWU16 509.9922 vfzg_uw_q0p0078125 2.000000 511.9922 FORMAT "%8.4" /end CHARACTERISTIC
/begin CHARACTERISTIC DVSTUTOMMI "dvstutom_w f¸r mph-Tacho" VALUE 0xFD059A KwWU16 509.9922 vfzg_uw_q0p0078125 2.000000 511.9922 FORMAT "%8.4" /end CHARACTERISTIC
/begin CHARACTERISTIC ETA_BGMSZS "Lernrate" VALUE 0xFC2DC8 KwWR32 200000.00000000000 fak_r32_1 -100000.00000000000 100000.00000000000 FORMAT "%27.20" /end CHARACTERISTIC
/begin CHARACTERISTIC EVHUBADBGL "" VAL_BLK 0xFC8774 KwbWU16 65.53500 hub_uw_q0p001 0.00 65.53500 FORMAT "%8.5" NUMBER 6 /end CHARACTERISTIC
/begin CHARACTERISTIC EVHUBBGL "Schwelle, unter welchen VVT-Isthub der Bankabgleich erlaubt ist" VALUE 0xFC8780 KwWU16 65.53500 hub_uw_q0p001 0.00 65.53500 FORMAT "%8.5" /end CHARACTERISTIC
/begin CHARACTERISTIC EVTMODO "Offset f¸r evtmod abh‰ngig von gefilterter Motortemperatur" CURVE 0xFD0CF9 KlAUbSstUbWUb 191.3 temp_ub_q0p75_o48 -48.00 143.3 FORMAT "%5.1"
 /begin AXIS_DESCR STD_AXIS tmotfil temp_ub_q0p75_o48 12 -48.00 143.3 FORMAT "%5.1" DEPOSIT ABSOLUTE /end AXIS_DESCR
/end CHARACTERISTIC
/begin CHARACTERISTIC E_FUNKTION "E-Funktion" CURVE 0xFC2D44 KlAxU8SstxR32WR32 200000.00000000000 fak_r32_1 -100000.00000000000 100000.00000000000 FORMAT "%27.20"
 /begin AXIS_DESCR STD_AXIS t_cm_bm fak_r32_1 13 -100000.00000000000 100000.00000000000 FORMAT "%27.20" DEPOSIT ABSOLUTE /end AXIS_DESCR
/end CHARACTERISTIC
/begin CHARACTERISTIC FAK_BGMSZS "Skalierungsfaktor fuer lineare Adaption" VALUE 0xFC2DCC KwWR32 200000.00000000000 fak_r32_1 -100000.00000000000 100000.00000000000 FORMAT "%27.20" /end CHARACTERISTIC
/begin CHARACTERISTIC FAOFWNKTST "Testerexenteroffsetwinkel ueber Kennwert vorgeben" VALUE 0xFC8782 KwWS16 6.000000 wink_uw_q0p1 -3.000000 3.000000 FORMAT "%8.6" /end CHARACTERISTIC
/begin CHARACTERISTIC FDVANS "Temperaturfaktor f¸r Drosselventildurchfluﬂ" CURVE 0xFD0D12 KlAUbSstUbWUb 1.992 fak_ub_b2 0.00 1.992 FORMAT "%5.3"
 /begin AXIS_DESCR STD_AXIS tans temp_ub_q0p75_o48 8 -48.00 143.3 FORMAT "%5.1" DEPOSIT ABSOLUTE /end AXIS_DESCR
/end CHARACTERISTIC
/begin CHARACTERISTIC FKMSDKMN "min.Korrekturfaktor schneller Massenstromabgleich" VALUE 0xFC2A98 KwUb 3.984 fak_ub_b4 0.00 3.984 FORMAT "%5.3" /end CHARACTERISTIC
/begin CHARACTERISTIC FKMSDKMX "max.Korrekturfaktor schneller Massenstromabgleich" VALUE 0xFC2A99 KwUb 3.984 fak_ub_b4 0.00 3.984 FORMAT "%5.3" /end CHARACTERISTIC
/begin CHARACTERISTIC FKMSVVTMN "min. Korrekturfaktor schneller Massenstromabgleich ungedrosselt" VALUE 0xFC2A9A KwUb 3.984 fak_ub_b4 0.00 3.984 FORMAT "%5.3" /end CHARACTERISTIC
/begin CHARACTERISTIC FKMSVVTMX "max. Korrekturfaktor schneller Massenstromabgleich ungedrosselt" VALUE 0xFC2A9B KwUb 3.984 fak_ub_b4 0.00 3.984 FORMAT "%5.3" /end CHARACTERISTIC
/begin CHARACTERISTIC FKPVDKE "Initialisierungswert f¸r Integrator Korrekturfaktor Massenstromabgleich" VALUE 0xFC2A9C KwUb 3.984 fak_ub_b4 0.00 3.984 FORMAT "%5.3" /end CHARACTERISTIC
/begin CHARACTERISTIC FKPVDKMN "Minimaler Korrekturfaktor langsamer Massenstomabgleich" VALUE 0xFC2A9D KwUb 3.984 fak_ub_b4 0.00 3.984 FORMAT "%5.3" /end CHARACTERISTIC
/begin CHARACTERISTIC FKPVDKMX "Maximaler Korrekturfaktor langsamer Massenstomabgleich" VALUE 0xFC2A9E KwUb 3.984 fak_ub_b4 0.00 3.984 FORMAT "%5.3" /end CHARACTERISTIC
/begin CHARACTERISTIC FKPVVVTMN "Minimaler Korrekturfaktor langsamer Massenstomabgleich ungedrosselt" VALUE 0xFC2A9F KwUb 3.984 fak_ub_b4 0.00 3.984 FORMAT "%5.3" /end CHARACTERISTIC
/begin CHARACTERISTIC FKPVVVTMX "Maximaler Korrekturfaktor langsamer Massenstomabgleich ungedrosselt" VALUE 0xFC2AA0 KwUb 3.984 fak_ub_b4 0.00 3.984 FORMAT "%5.3" /end CHARACTERISTIC
/begin CHARACTERISTIC FKV1FVMX "Korrekturfaktor Fahrzeuggeschwindigkeit V1 f¸r VMAX-Regelung" VALUE 0xFC2391 KwUb 2.000 fak_q0p007843 0.00 2.000 FORMAT "%5.3" /end CHARACTERISTIC
/begin CHARACTERISTIC FK_A2 "Filterkoeffizient f¸r Butterworth-Filter" VALUE 0xFC402C KwWU8 0.9961 fak_ub_b1 0.00 0.9961 /end CHARACTERISTIC
/begin CHARACTERISTIC FMLZKRST "Faktor 1/(Rho Kraftstoff[kg/l] * 14,7)  [l/kg]" VALUE 0xFD5406 KwUb 0.9961 fak_ub_b1 0.00 0.9961 /end CHARACTERISTIC
/begin CHARACTERISTIC FMTEVEIN "Faktor Massenstrom durch TEV abh‰ngig von der Ansteuerzeit" CURVE 0xFCC9E4 KlAUwSstUwWUw 0.9999847 fak_uw_b1 0.00 0.9999847 FORMAT "%9.7"
 /begin AXIS_DESCR STD_AXIS ttevein_tp t128ms_uw 10 0.00 127.9980 FORMAT "%8.4" DEPOSIT ABSOLUTE /end AXIS_DESCR
/end CHARACTERISTIC
/begin CHARACTERISTIC FPVMXN "Faktor maximales Druckverh‰ltnis mit Hauptlastsignal" CURVE 0xFD0C90 KlAUwSstUwWUw 1.999969 fak_uw_b2 0.00 1.999969 FORMAT "%8.6"
 /begin AXIS_DESCR STD_AXIS nmot_w nmot_uw_q0p25 6 0.00 16383.75 FORMAT "%8.2" DEPOSIT ABSOLUTE /end AXIS_DESCR
/end CHARACTERISTIC
/begin CHARACTERISTIC FPVMXN2 "Faktor maximales Druckverh‰ltnis mit Nebenlastsignal" CURVE 0xFD0CAA KlAUwSstUwWUw 1.999969 fak_uw_b2 0.00 1.999969 FORMAT "%8.6"
 /begin AXIS_DESCR STD_AXIS nmot_w nmot_uw_q0p25 6 0.00 16383.75 FORMAT "%8.2" DEPOSIT ABSOLUTE /end AXIS_DESCR
/end CHARACTERISTIC
/begin CHARACTERISTIC FRAUBGL "Schwelle multipl. Gemischadaptionsfaktor unt. mult. Bereich" VALUE 0xFC8784 KwWU16 1.999969 fak_uw_b2 0.00 1.999969 FORMAT "%8.6" /end CHARACTERISTIC
/begin CHARACTERISTIC FRMBGL "Schwelle schneller Mittelwert des Lambdaregelfaktors" VALUE 0xFC8786 KwWU16 1.999969 fak_uw_b2 0.00 1.999969 FORMAT "%8.6" /end CHARACTERISTIC
/begin CHARACTERISTIC FUMRMV "Faktor Dichte der Luft" VALUE 0xFCC9E2 KwUb 1.992 dichte_ub_b2 0.00 1.992 FORMAT "%5.3" /end CHARACTERISTIC
/begin CHARACTERISTIC FWFTBRTA "Wichtung ftbr in Abh‰ngigkeit von tans" CURVE 0xFD0D23 KlAUbSstUbWUb 1.992 fak_ub_b2 0.00 1.992 FORMAT "%5.3"
 /begin AXIS_DESCR STD_AXIS tempin temp_ub_q0p75_o48 14 -48.00 143.3 FORMAT "%5.1" DEPOSIT ABSOLUTE /end AXIS_DESCR
/end CHARACTERISTIC
/begin CHARACTERISTIC FWTMTU "Faktor zur Wichtung zwischen Motortemperatur und Umgebungstemperatur" VALUE 0xFD5400 KwUb 0.9961 fak_ub_b1 0.00 0.9961 /end CHARACTERISTIC
/begin CHARACTERISTIC GKN "" VALUE 0xFC2DD0 KwWR32 200000.00000000000 fak_r32_1 -100000.00000000000 100000.00000000000 FORMAT "%27.20" /end CHARACTERISTIC
/begin CHARACTERISTIC HUBFMAON "max.Hub Schwelle Freigabe der mult. Adaption" CURVE 0xFD0948 KlAUbSstUbWUw 65.53500 hub_uw_q0p001 0.00 65.53500 FORMAT "%8.5"
 /begin AXIS_DESCR STD_AXIS nmot nmot_ub_q40 4 0.00 10200. FORMAT "%5.0" DEPOSIT ABSOLUTE /end AXIS_DESCR
/end CHARACTERISTIC
/begin CHARACTERISTIC HUBFMAUN "min.Hub Schwelle Freigabe der mult. Adaption" CURVE 0xFD0956 KlAUbSstUbWUw 65.53500 hub_uw_q0p001 0.00 65.53500 FORMAT "%8.5"
 /begin AXIS_DESCR STD_AXIS nmot nmot_ub_q40 4 0.00 10200. FORMAT "%5.0" DEPOSIT ABSOLUTE /end AXIS_DESCR
/end CHARACTERISTIC
/begin CHARACTERISTIC HUBMSON "min.Hub Schwelle Freigabe der addi. Adaption" CURVE 0xFD0964 KlAUbSstUbWUw 65.53500 hub_uw_q0p001 0.00 65.53500 FORMAT "%8.5"
 /begin AXIS_DESCR STD_AXIS nmot nmot_ub_q40 4 0.00 10200. FORMAT "%5.0" DEPOSIT ABSOLUTE /end AXIS_DESCR
/end CHARACTERISTIC
/begin CHARACTERISTIC KFDKMS "Massenstrom ¸ber DK abh‰ngig von Druckverh‰ltnis und DK Winkel" MAP 0xFD0972 KfAxUwAyUwSstxSwSstyUwWUw 6553.500 m_uw_b6553p5 0.00 6553.500 FORMAT "%8.3"
 /begin AXIS_DESCR STD_AXIS wdkbab_w relDK_q0p02441 21 -800.0000 799.9756 FORMAT "%8.4" DEPOSIT ABSOLUTE /end AXIS_DESCR
 /begin AXIS_DESCR STD_AXIS dpipol_aus fak_uw_b2 8 0.00 1.999969 FORMAT "%8.6" DEPOSIT ABSOLUTE /end AXIS_DESCR
/end CHARACTERISTIC
/begin CHARACTERISTIC KFDLTDPSF "Kennfeld f¸r Korrektur gefilterter dps" MAP 0xFC2ED2 KfAxU8AyU8SstxS16SstyS16WS16 3.999939 fak_sw_b2 -2.000000 1.999939 FORMAT "%8.6"
 /begin AXIS_DESCR STD_AXIS dltdpsff_w p_sw_q0p039 12 -1280.000 1279.961 FORMAT "%8.3" DEPOSIT ABSOLUTE /end AXIS_DESCR
 /begin AXIS_DESCR STD_AXIS nmot nmot_ub_q40 6 0.00 10200. FORMAT "%5.0" DEPOSIT ABSOLUTE /end AXIS_DESCR
/end CHARACTERISTIC
/begin CHARACTERISTIC KFDPRG "Offsetkorr. Abgaspartialdruck abh‰ngig von NW-Verstellung bei B_su=0" MAP 0xFC2F8A KfAxU8AyU8SstxU16SstyU16WU16 2559.961 p_uw_q0p039 0.00 2559.961 FORMAT "%8.3"
 /begin AXIS_DESCR STD_AXIS nmot_w nmot_uw_q0p25 16 0.00 16383.75 FORMAT "%8.2" DEPOSIT ABSOLUTE /end AXIS_DESCR
 /begin AXIS_DESCR STD_AXIS spuef_s16 sprzi_q0p1s32768 10 -3276.80 3276.70 FORMAT "%7.2" DEPOSIT ABSOLUTE /end AXIS_DESCR
/end CHARACTERISTIC
/begin CHARACTERISTIC KFDPRGSU "Offsetkorr. Abgaspartialdruck abh‰ngig von NW-Verstellung bei B_su=1" MAP 0xFC3102 KfAxU8AyU8SstxU16SstyU16WU16 2559.961 p_uw_q0p039 0.00 2559.961 FORMAT "%8.3"
 /begin AXIS_DESCR STD_AXIS nmot_w nmot_uw_q0p25 16 0.00 16383.75 FORMAT "%8.2" DEPOSIT ABSOLUTE /end AXIS_DESCR
 /begin AXIS_DESCR STD_AXIS spuef_s16 sprzi_q0p1s32768 10 -3276.80 3276.70 FORMAT "%7.2" DEPOSIT ABSOLUTE /end AXIS_DESCR
/end CHARACTERISTIC
/begin CHARACTERISTIC KFEHUBIV "Inverses Hubkennfeld gerechnet aus KFEHUB" MAP 0xFC242C KfAxU8AyU8SstxU16SstyU16WU16 1535.977 rel_uw_q0p0234 0.00 1535.977 FORMAT "%8.3"
 /begin AXIS_DESCR STD_AXIS nmot_w nmot_uw_q0p25 16 0.00 16383.75 FORMAT "%8.2" DEPOSIT ABSOLUTE /end AXIS_DESCR
 /begin AXIS_DESCR STD_AXIS evhubin_w hub_uw_q0p001 24 0.00 65.53500 FORMAT "%8.5" DEPOSIT ABSOLUTE /end AXIS_DESCR
/end CHARACTERISTIC
/begin CHARACTERISTIC KFEHUBLLIV "Inverses Hubkennfeld gerechnet aus KFEHUBLL" MAP 0xFC2780 KfAxU8AyU8SstxU16SstyU16WU16 1638.375 m_uw_b1638p4 0.00 1638.375 FORMAT "%8.3"
 /begin AXIS_DESCR STD_AXIS evhubin_w hub_uw_q0p001 21 0.00 65.53500 FORMAT "%8.5" DEPOSIT ABSOLUTE /end AXIS_DESCR
 /begin AXIS_DESCR STD_AXIS nmot_w nmot_uw_q0p25 6 0.00 16383.75 FORMAT "%8.2" DEPOSIT ABSOLUTE /end AXIS_DESCR
/end CHARACTERISTIC
/begin CHARACTERISTIC KFEHUBLLKI "" MAP 0xFC28B6 KfAxU8AyU8SstxU16SstyU16WU16 1638.375 m_uw_b1638p4 0.00 1638.375 FORMAT "%8.3"
 /begin AXIS_DESCR STD_AXIS evhubin_w hub_uw_q0p001 21 0.00 65.53500 FORMAT "%8.5" DEPOSIT ABSOLUTE /end AXIS_DESCR
 /begin AXIS_DESCR STD_AXIS nmot_w nmot_uw_q0p25 6 0.00 16383.75 FORMAT "%8.2" DEPOSIT ABSOLUTE /end AXIS_DESCR
/end CHARACTERISTIC
/begin CHARACTERISTIC KFEHUBNS "Kennfeld f¸r Hubvorsteuerung im Nachstart" MAP 0xFC29EC KfAxU8AyU8SstxU16SstyU16WU16 1638.375 m_uw_b1638p4 0.00 1638.375 FORMAT "%8.3"
 /begin AXIS_DESCR STD_AXIS evhubin_w hub_uw_q0p001 8 0.00 65.53500 FORMAT "%8.5" DEPOSIT ABSOLUTE /end AXIS_DESCR
 /begin AXIS_DESCR STD_AXIS nmot_w nmot_uw_q0p25 8 0.00 16383.75 FORMAT "%8.2" DEPOSIT ABSOLUTE /end AXIS_DESCR
/end CHARACTERISTIC
/begin CHARACTERISTIC KFFAKSRM "Saugrohrvolumenkonstante bei Saugrohrmodell mit dps-Messung" MAP 0xFC4032 KfAxUbAyUbSstxUbSstyUwWUb 7.969 fak_ub_b8 0.00 7.969 FORMAT "%5.3"
 /begin AXIS_DESCR STD_AXIS tans temp_ub_q0p75_o48 8 -48.00 143.3 FORMAT "%5.1" DEPOSIT ABSOLUTE /end AXIS_DESCR
 /begin AXIS_DESCR STD_AXIS dps_w p_sw_q0p039 8 -1280.000 1279.961 FORMAT "%8.3" DEPOSIT ABSOLUTE /end AXIS_DESCR
/end CHARACTERISTIC
/begin CHARACTERISTIC KFFWTBR "Wichtungsfaktor Tans/Tmot f¸r Brennraumtemperaturmodell" MAP 0xFD0D40 KfAxUbAyUbSstxUbSstyUbWUb 0.9961 fak_ub_b1 0.00 0.9961
 /begin AXIS_DESCR STD_AXIS rl rel_ub_q0p75 10 0.00 191.3 FORMAT "%5.1" DEPOSIT ABSOLUTE /end AXIS_DESCR
 /begin AXIS_DESCR STD_AXIS nmot nmot_ub_q40 8 0.00 10200. FORMAT "%5.0" DEPOSIT ABSOLUTE /end AXIS_DESCR
/end CHARACTERISTIC
/begin CHARACTERISTIC KFMSNVVT "Massenstrom ¸ber VVT im Start" MAP 0xFC2AC2 KfAxUwAyUwSstxUwSstyUwWUw 6553.500 m_uw_b6553p5 0.00 6553.500 FORMAT "%8.3"
 /begin AXIS_DESCR STD_AXIS evhubs_w hub_uw_q0p001 16 0.00 65.53500 FORMAT "%8.5" DEPOSIT ABSOLUTE /end AXIS_DESCR
 /begin AXIS_DESCR STD_AXIS nmot_w nmot_uw_q0p25 6 0.00 16383.75 FORMAT "%8.2" DEPOSIT ABSOLUTE /end AXIS_DESCR
/end CHARACTERISTIC
/begin CHARACTERISTIC KFMSNWDK "Kennfeld normierter Massenstrom ¸ber DK" MAP 0xFD0B00 KfAxUwAyUwSstxSwSstyUwWUw 6553.500 m_uw_b6553p5 0.00 6553.500 FORMAT "%8.3"
 /begin AXIS_DESCR STD_AXIS wdkbab_w relDK_q0p02441 16 -800.0000 799.9756 FORMAT "%8.4" DEPOSIT ABSOLUTE /end AXIS_DESCR
 /begin AXIS_DESCR STD_AXIS nmot_w nmot_uw_q0p25 6 0.00 16383.75 FORMAT "%8.2" DEPOSIT ABSOLUTE /end AXIS_DESCR
/end CHARACTERISTIC
/begin CHARACTERISTIC KFMTEDPML "" MAP 0xFD474C KfAxUwAyUwSstxUwSstyUwWUw 25.59961 m_uw_b25p6 0.00 25.59961 FORMAT "%8.5"
 /begin AXIS_DESCR STD_AXIS dps_uw p_q0p039s32768 12 -1280.00 1279.96 FORMAT "%7.2" DEPOSIT ABSOLUTE /end AXIS_DESCR
 /begin AXIS_DESCR STD_AXIS ml_w m_uw_b6553p5 8 0.00 6553.500 FORMAT "%8.3" DEPOSIT ABSOLUTE /end AXIS_DESCR
/end CHARACTERISTIC
/begin CHARACTERISTIC KFPRG "interner Abgaspartialdruck abh‰ngig von NW-Verstellung bei sumode=0" MAP 0xFC327A KfAxU8AyU8SstxU16SstyU16WU16 2559.961 p_uw_q0p039 0.00 2559.961 FORMAT "%8.3"
 /begin AXIS_DESCR STD_AXIS nmot_w nmot_uw_q0p25 16 0.00 16383.75 FORMAT "%8.2" DEPOSIT ABSOLUTE /end AXIS_DESCR
 /begin AXIS_DESCR STD_AXIS uefl_w flae_uw_q0p016 10 0.00 1048.560 FORMAT "%8.3" DEPOSIT ABSOLUTE /end AXIS_DESCR
/end CHARACTERISTIC
/begin CHARACTERISTIC KFPRGSU "interner Abgaspartialdruck abh‰ngig von NW-Verstellung bei sumode=1" MAP 0xFC33F2 KfAxU8AyU8SstxU16SstyU16WU16 2559.961 p_uw_q0p039 0.00 2559.961 FORMAT "%8.3"
 /begin AXIS_DESCR STD_AXIS nmot_w nmot_uw_q0p25 16 0.00 16383.75 FORMAT "%8.2" DEPOSIT ABSOLUTE /end AXIS_DESCR
 /begin AXIS_DESCR STD_AXIS uefl_w flae_uw_q0p016 10 0.00 1048.560 FORMAT "%8.3" DEPOSIT ABSOLUTE /end AXIS_DESCR
/end CHARACTERISTIC
/begin CHARACTERISTIC KFRLHP "Kennfeld Zeitkonstante Tiefpaﬂfilterung rlhp" MAP 0xFC356A KfAxU8AyU8SstxU16SstyU16WU16 1.000000 fak_uw_b256 0.00 1.000000 FORMAT "%8.6"
 /begin AXIS_DESCR STD_AXIS minhub_w hub_uw_q0p001 6 0.00 65.53500 FORMAT "%8.5" DEPOSIT ABSOLUTE /end AXIS_DESCR
 /begin AXIS_DESCR STD_AXIS nmot_w nmot_uw_q0p25 6 0.00 16383.75 FORMAT "%8.2" DEPOSIT ABSOLUTE /end AXIS_DESCR
/end CHARACTERISTIC
/begin CHARACTERISTIC KFRLHPFAK "Kennfeld Faktor Zeitkonstante Tiefpaﬂfilterung rlhp" MAP 0xFC35CE KfAxU8AyU8SstxU16SstyU16WU16 10.00000 fak_uw_b256 0.00 10.00000 FORMAT "%8.5"
 /begin AXIS_DESCR STD_AXIS dpssol_uw p_q0p039 6 0.00 2559.961 FORMAT "%8.3" DEPOSIT ABSOLUTE /end AXIS_DESCR
 /begin AXIS_DESCR STD_AXIS nmot_w nmot_uw_q0p25 6 0.00 16383.75 FORMAT "%8.2" DEPOSIT ABSOLUTE /end AXIS_DESCR
/end CHARACTERISTIC
/begin CHARACTERISTIC KFSPUEF "Schwerpunkt Ueberschneidungsfl. nach EV oeffnet" MAP 0xFC3632 KfAxU8AyU8SstxU16SstyU16WU16 6553.500 sprzi_q0p1 0.00 6553.500 FORMAT "%8.3"
 /begin AXIS_DESCR STD_AXIS evhubi_w hub_uw_q0p001 16 0.00 65.53500 FORMAT "%8.5" DEPOSIT ABSOLUTE /end AXIS_DESCR
 /begin AXIS_DESCR STD_AXIS spr_sum sprzi_q0p1 12 0.00 6553.500 FORMAT "%8.3" DEPOSIT ABSOLUTE /end AXIS_DESCR
/end CHARACTERISTIC
/begin CHARACTERISTIC KFSTTANKR "Verst‰rkungsfaktor f¸r K-TP Filterung Tankf¸llstand rechts" VALUE 0xFD5407 KwUb 0.9961 fak_ub_b1 0.00 0.9961 /end CHARACTERISTIC
/begin CHARACTERISTIC KFTWSLP "Wicklungstemperatur der SLP in Abh‰ngigkeit von der Batteriespannung" MAP 0xFCEB8C KfAxU8AyU8SstxU16SstyU16WU16 1535.977 temp_q0p0234_o273 -273.1500 1262.827 FORMAT "%8.3"
 /begin AXIS_DESCR STD_AXIS twslpst_w temp_q0p0234_o273 4 -273.1500 1262.827 FORMAT "%8.3" DEPOSIT ABSOLUTE /end AXIS_DESCR
 /begin AXIS_DESCR STD_AXIS ubsqf_w spg_q0p00039 3 0.00 25.59961 FORMAT "%8.5" DEPOSIT ABSOLUTE /end AXIS_DESCR
/end CHARACTERISTIC
/begin CHARACTERISTIC KFUEF "Ventilueberschneidungsflaeche" MAP 0xFC37EE KfAxU8AyU8SstxU16SstyU16WU16 1048.560 flae_uw_q0p016 0.00 1048.560 FORMAT "%8.3"
 /begin AXIS_DESCR STD_AXIS evhubi_w hub_uw_q0p001 16 0.00 65.53500 FORMAT "%8.5" DEPOSIT ABSOLUTE /end AXIS_DESCR
 /begin AXIS_DESCR STD_AXIS spr_sum sprzi_q0p1 12 0.00 6553.500 FORMAT "%8.3" DEPOSIT ABSOLUTE /end AXIS_DESCR
/end CHARACTERISTIC
/begin CHARACTERISTIC KFURL "Umrechnungsfaktor von ps->rl abh‰ngig von NW-Verstellung bei sumode=0" MAP 0xFC39AA KfAxU8AyU8SstxU16SstyU16WU16 0.2999954 rel_uw_b0p3 0.00 0.2999954 FORMAT "%9.7"
 /begin AXIS_DESCR STD_AXIS nmot_w nmot_uw_q0p25 16 0.00 16383.75 FORMAT "%8.2" DEPOSIT ABSOLUTE /end AXIS_DESCR
 /begin AXIS_DESCR STD_AXIS uefl_w flae_uw_q0p016 10 0.00 1048.560 FORMAT "%8.3" DEPOSIT ABSOLUTE /end AXIS_DESCR
/end CHARACTERISTIC
/begin CHARACTERISTIC KFURLF "Rover" MAP 0xFC3B22 KfAxU8AyU8SstxU16SstyU16WU16 1.999969 fak_uw_b2 0.00 1.999969 FORMAT "%8.6"
 /begin AXIS_DESCR STD_AXIS nmot_w nmot_uw_q0p25 16 0.00 16383.75 FORMAT "%8.2" DEPOSIT ABSOLUTE /end AXIS_DESCR
 /begin AXIS_DESCR STD_AXIS spuef_s16 sprzi_q0p1s32768 10 -3276.80 3276.70 FORMAT "%7.2" DEPOSIT ABSOLUTE /end AXIS_DESCR
/end CHARACTERISTIC
/begin CHARACTERISTIC KFURLFSU "Korrekturfaktor f¸r Umrechnung ps->rl abh‰ngig von NW-Verstellung bei B_su=1" MAP 0xFC3C9A KfAxU8AyU8SstxU16SstyU16WU16 1.999969 fak_uw_b2 0.00 1.999969 FORMAT "%8.6"
 /begin AXIS_DESCR STD_AXIS nmot_w nmot_uw_q0p25 16 0.00 16383.75 FORMAT "%8.2" DEPOSIT ABSOLUTE /end AXIS_DESCR
 /begin AXIS_DESCR STD_AXIS spuef_s16 sprzi_q0p1s32768 10 -3276.80 3276.70 FORMAT "%7.2" DEPOSIT ABSOLUTE /end AXIS_DESCR
/end CHARACTERISTIC
/begin CHARACTERISTIC KFURLSU "Umrechnungsfaktor von ps->rl abh‰ngig von NW-Verstellung bei sumode=1" MAP 0xFC3E12 KfAxU8AyU8SstxU16SstyU16WU16 0.2999954 rel_uw_b0p3 0.00 0.2999954 FORMAT "%9.7"
 /begin AXIS_DESCR STD_AXIS nmot_w nmot_uw_q0p25 16 0.00 16383.75 FORMAT "%8.2" DEPOSIT ABSOLUTE /end AXIS_DESCR
 /begin AXIS_DESCR STD_AXIS uefl_w flae_uw_q0p016 10 0.00 1048.560 FORMAT "%8.3" DEPOSIT ABSOLUTE /end AXIS_DESCR
/end CHARACTERISTIC
/begin CHARACTERISTIC KFWTSEG "Faktor f¸r Wichtung der Segmentzeit" MAP 0xFD0C26 KfAxUwAyUwSstxUwSstyUwWUw 15.99976 fak_uw_b16 0.00 15.99976 FORMAT "%8.5"
 /begin AXIS_DESCR STD_AXIS nmot_w nmot_uw_q0p25 6 0.00 16383.75 FORMAT "%8.2" DEPOSIT ABSOLUTE /end AXIS_DESCR
 /begin AXIS_DESCR STD_AXIS rktseg_w rel_uw_b3072 6 0.00 3071.953 FORMAT "%8.3" DEPOSIT ABSOLUTE /end AXIS_DESCR
/end CHARACTERISTIC
/begin CHARACTERISTIC KFZKMSVT "Zeitkonstante f¸r schnellen Massenstromabgleich" MAP 0xFC2BB2 KfAxUwAyUwSstxUwSstyUwWUw 15.62478 mk10ms_uw_q2p384e5n 0.00 15.62478 FORMAT "%8.5"
 /begin AXIS_DESCR STD_AXIS rlvw_w rel_uw_q0p0234 10 0.00 1535.977 FORMAT "%8.3" DEPOSIT ABSOLUTE /end AXIS_DESCR
 /begin AXIS_DESCR STD_AXIS nmot_w nmot_uw_q0p25 10 0.00 16383.75 FORMAT "%8.2" DEPOSIT ABSOLUTE /end AXIS_DESCR
/end CHARACTERISTIC
/begin CHARACTERISTIC KIMSA "Beiwert f¸r Leerlaufluftmassenintegrator f¸r E-Gas" VALUE 0xFD0912 KwUb 0.1660 m_ub_b0p166 0.00 0.1660 FORMAT "%6.4" /end CHARACTERISTIC
/begin CHARACTERISTIC KIMSALL "Beiwert f¸r Leerlaufluftmassenintegrator f¸r E-Gas" VALUE 0xFD0913 KwUb 10.58 m_ub_q0p0415 0.00 10.58 FORMAT "%5.2" /end CHARACTERISTIC
/begin CHARACTERISTIC KIMSALLVT "Beiwert f¸r Leerlaufluftmassenintegrator f¸r VVT" VALUE 0xFD0914 KwUb 10.58 m_ub_q0p0415 0.00 10.58 FORMAT "%5.2" /end CHARACTERISTIC
/begin CHARACTERISTIC KIMSAVT "Beiwert f¸r Leerlaufluftmassenintegrator f¸r VVT" VALUE 0xFD0915 KwUb 0.1660 m_ub_b0p166 0.00 0.1660 FORMAT "%6.4" /end CHARACTERISTIC
/begin CHARACTERISTIC KIMSNLL "Beiwert f¸r Leerlaufwinkelintegrator" VALUE 0xFD0916 KwUb 10.58 m_ub_q0p0415 0.00 10.58 FORMAT "%5.2" /end CHARACTERISTIC
/begin CHARACTERISTIC KLEOVES "EV oeffnet vor Einlass-Spreizung" CURVE 0xFC3F8A KlAxU8SstxU16WU16 6553.500 sprzi_q0p1 0.00 6553.500 FORMAT "%8.3"
 /begin AXIS_DESCR STD_AXIS evhubi_w hub_uw_q0p001 16 0.00 65.53500 FORMAT "%8.5" DEPOSIT ABSOLUTE /end AXIS_DESCR
/end CHARACTERISTIC
/begin CHARACTERISTIC KLFDPS "" CURVE 0xFD0CC4 KlAUbSstUwWUb 0.9961 fak_ub_b1 0.00 0.9961
 /begin AXIS_DESCR STD_AXIS nmot_w nmot_uw_q0p25 8 0.00 16383.75 FORMAT "%8.2" DEPOSIT ABSOLUTE /end AXIS_DESCR
/end CHARACTERISTIC
/begin CHARACTERISTIC KLFVISRMST "" CURVE 0xFC4000 KlAxU8SstxU8WU16 31.99951 p_uw_b32 0.00 31.99951 FORMAT "%8.5"
 /begin AXIS_DESCR STD_AXIS tmst temp_ub_q0p75_o48 6 -48.00 143.3 FORMAT "%5.1" DEPOSIT ABSOLUTE /end AXIS_DESCR
/end CHARACTERISTIC
/begin CHARACTERISTIC KLKISRM "Integratorbeiwert f¸r Saugrohrmodell bei B_su=0" CURVE 0xFC3FCC KlAxU8SstxU16WU16 0.9999847 fak_uw_b1 0.00 0.9999847 FORMAT "%9.7"
 /begin AXIS_DESCR STD_AXIS nmot_w nmot_uw_q0p25 6 0.00 16383.75 FORMAT "%8.2" DEPOSIT ABSOLUTE /end AXIS_DESCR
/end CHARACTERISTIC
/begin CHARACTERISTIC KLKISRMSU "Faktor Saugrohrkonstante gedrosselt bei SU" CURVE 0xFC3FE6 KlAxU8SstxU16WU16 0.9999847 fak_uw_b1 0.00 0.9999847 FORMAT "%9.7"
 /begin AXIS_DESCR STD_AXIS nmot_w nmot_uw_q0p25 6 0.00 16383.75 FORMAT "%8.2" DEPOSIT ABSOLUTE /end AXIS_DESCR
/end CHARACTERISTIC
/begin CHARACTERISTIC KLMSNVTOM "Korrektur Luftmasse bei VVT im LL abh‰ngig von trefvvt" CURVE 0xFD0BF0 KlAUwSstUwWSw 6553.500 m_uw_b6553p5 -3276.800 3276.700 FORMAT "%8.3"
 /begin AXIS_DESCR STD_AXIS trefvvto temp_ub_q0p75_o48 12 -48.00000 49103.25 FORMAT "%8.2" DEPOSIT ABSOLUTE /end AXIS_DESCR
/end CHARACTERISTIC
/begin CHARACTERISTIC KLPAVHK "Kennlinie Abgasgegendruck vor Hauptkat" CURVE 0xFD007C KlAUwSstUwWUw 2559.961 p_uw_q0p039 0.00 2559.961 FORMAT "%8.3"
 /begin AXIS_DESCR STD_AXIS msabvhk_w m_uw_b6553p5 8 0.00 6553.500 FORMAT "%8.3" DEPOSIT ABSOLUTE /end AXIS_DESCR
/end CHARACTERISTIC
/begin CHARACTERISTIC KLPAVTL "Kennlinie Abgasgegendruck vor turbolader" CURVE 0xFD009E KlAUwSstUwWUw 2559.961 p_uw_q0p039 0.00 2559.961 FORMAT "%8.3"
 /begin AXIS_DESCR STD_AXIS msabikr_w m_uw_b6553p5 8 0.00 6553.500 FORMAT "%8.3" DEPOSIT ABSOLUTE /end AXIS_DESCR
/end CHARACTERISTIC
/begin CHARACTERISTIC KLPAVVK "Kennlinie Abgasgegendruck vor Vorkat" CURVE 0xFD00C0 KlAUwSstUwWUw 2559.961 p_uw_q0p039 0.00 2559.961 FORMAT "%8.3"
 /begin AXIS_DESCR STD_AXIS msabg_w m_uw_b6553p5 8 0.00 6553.500 FORMAT "%8.3" DEPOSIT ABSOLUTE /end AXIS_DESCR
/end CHARACTERISTIC
/begin CHARACTERISTIC KLRGMDPS "Korrekturfaktor fuer Differenzdruck" CURVE 0xFC2E8C KlAxU8SstxU8WU8 0.00009500 rgfak_ub_q0p00000037 0.00 0.00009500 FORMAT "%10.8"
 /begin AXIS_DESCR STD_AXIS nmot nmot_ub_q40 10 0.00 10200. FORMAT "%5.0" DEPOSIT ABSOLUTE /end AXIS_DESCR
/end CHARACTERISTIC
/begin CHARACTERISTIC KLRGMN "drehzahlabh‰ngiger Verst‰rkungsfaktor f¸r Restgas" CURVE 0xFC2EA1 KlAxU8SstxU8WU8 1.992 fak_ub_b2 0.00 1.992 FORMAT "%5.3"
 /begin AXIS_DESCR STD_AXIS nmot nmot_ub_q40 10 0.00 10200. FORMAT "%5.0" DEPOSIT ABSOLUTE /end AXIS_DESCR
/end CHARACTERISTIC
/begin CHARACTERISTIC KLRGMOF "Offset-Korrektur fuer Drehzahl" CURVE 0xFC2EB6 KlAxU8SstxU8WU8 1.992 fak_ub_b2 0.00 1.992 FORMAT "%5.3"
 /begin AXIS_DESCR STD_AXIS nmot nmot_ub_q40 10 0.00 10200. FORMAT "%5.0" DEPOSIT ABSOLUTE /end AXIS_DESCR
/end CHARACTERISTIC
/begin CHARACTERISTIC KLSRMKOR "Kennlinie zur Ausblendung Druckeinrechnung in rl-Berechnung" CURVE 0xFD0CDE KlAUbSstUwWUb 0.9961 fak_ub_b1 0.00 0.9961
 /begin AXIS_DESCR STD_AXIS nmot_w nmot_uw_q0p25 8 0.00 16383.75 FORMAT "%8.2" DEPOSIT ABSOLUTE /end AXIS_DESCR
/end CHARACTERISTIC
/begin CHARACTERISTIC KLTDSTEND "Kennlinie: Verzugszeit f¸r Bit B_stend abh‰ngig von tmst" CURVE 0xFD0917 KlAUbSstUbWUb 2.550 t10msxs_ub_b2p55 0.00 2.550 FORMAT "%5.3"
 /begin AXIS_DESCR STD_AXIS tmst temp_ub_q0p75_o48 4 -48.00 143.3 FORMAT "%5.1" DEPOSIT ABSOLUTE /end AXIS_DESCR
/end CHARACTERISTIC
/begin CHARACTERISTIC KLZKBGMSDK "Zeitkonstante Korrekturwerte GD Betrieb" CURVE 0xFC2CA6 KlAUwSstUwWUw 0.9999847 fak_uw_b1 0.00 0.9999847 FORMAT "%9.7"
 /begin AXIS_DESCR STD_AXIS dpsfak fak_ub_q0p00392 8 0.00 1.000 FORMAT "%5.3" DEPOSIT ABSOLUTE /end AXIS_DESCR
/end CHARACTERISTIC
/begin CHARACTERISTIC KLZKDPSSRM "Zeitkonstante Tiefpaﬂfilterung dpssrm" CURVE 0xFC408C KlAUwSstUwWUw 0.9999847 fak_uw_b1 0.00 0.9999847 FORMAT "%9.7"
 /begin AXIS_DESCR STD_AXIS nmot_w nmot_uw_q0p25 6 0.00 16383.75 FORMAT "%8.2" DEPOSIT ABSOLUTE /end AXIS_DESCR
/end CHARACTERISTIC
/begin CHARACTERISTIC KLZYLN "normiertes Zylindervolumen ueber Kurbelwellenwinkel" CURVE 0xFC2DE4 KlAxU8SstxS16WS16 0.9960938 fak_ub_b1 0.00 0.9960938 FORMAT "%9.7"
 /begin AXIS_DESCR STD_AXIS avs_w sprzi_q0p1 10 -3276.800 3276.700 FORMAT "%8.3" DEPOSIT ABSOLUTE /end AXIS_DESCR
/end CHARACTERISTIC
/begin CHARACTERISTIC KLZYLN2 "normiertes Zylindervolumen ueber Kurbelwellenwinkel Bank 2" CURVE 0xFC2E0E KlAxU8SstxS16WS16 0.9960938 fak_ub_b1 0.00 0.9960938 FORMAT "%9.7"
 /begin AXIS_DESCR STD_AXIS avs2_w sprzi_q0p1 10 -3276.800 3276.700 FORMAT "%8.3" DEPOSIT ABSOLUTE /end AXIS_DESCR
/end CHARACTERISTIC
/begin CHARACTERISTIC KLZYLU "normiertes Zylindervolumen invertiert" CURVE 0xFC2E38 KlAxU8SstxS16WS16 0.9960938 fak_ub_b1 0.00 0.9960938 FORMAT "%9.7"
 /begin AXIS_DESCR STD_AXIS spuefot_w sprzi_q0p1 10 -3276.800 3276.700 FORMAT "%8.3" DEPOSIT ABSOLUTE /end AXIS_DESCR
/end CHARACTERISTIC
/begin CHARACTERISTIC KLZYLU2 "normiertes Zylindervolumen invertiert Bank 2" CURVE 0xFC2E62 KlAxU8SstxS16WS16 0.9960938 fak_ub_b1 0.00 0.9960938 FORMAT "%9.7"
 /begin AXIS_DESCR STD_AXIS spuefot2_w sprzi_q0p1 10 -3276.800 3276.700 FORMAT "%8.3" DEPOSIT ABSOLUTE /end AXIS_DESCR
/end CHARACTERISTIC
/begin CHARACTERISTIC KUMSRL "Umrechnungskonstante von Massenstrom in relative Luftf¸llung" VALUE 0xFC2AA1 KwUb 0.00199218750 kumsrl_ub_b0p002 0.00 0.00199218750 FORMAT "%13.11" /end CHARACTERISTIC
/begin CHARACTERISTIC KVLAD "Konstante f¸r Umrechnung von Ladedruck in Luftmasse" VALUE 0xFC2AA2 KwUb 1.992 rel_ub_b2p0 0.00 1.992 FORMAT "%5.3" /end CHARACTERISTIC
/begin CHARACTERISTIC LADFIL "Ladedruckfilterung" VALUE 0xFC2AA3 KwUb 0.9961 fak_ub_b1 0.00 0.9961 /end CHARACTERISTIC
/begin CHARACTERISTIC LAMSONIBGL "Schwelle Differenz Lambda Istwert" VALUE 0xFC8788 KwWU16 15.99976 fak_uw_b16 0.00 15.99976 FORMAT "%8.5" /end CHARACTERISTIC
/begin CHARACTERISTIC LNXQTM "Nat¸rlicher Logarithmus aus Temperaturquotient" CURVE 0xFD1A70 KlAUwSstUwWUw 3.999939 fak_uw_b4 0.00 3.999939 FORMAT "%8.6"
 /begin AXIS_DESCR STD_AXIS xqtm_w fak_uw_b16 12 0.00 15.99976 FORMAT "%8.5" DEPOSIT ABSOLUTE /end AXIS_DESCR
/end CHARACTERISTIC
/begin CHARACTERISTIC MAXANDADBG "Aenderungsbegrenzung bei Winkeladaption" VALUE 0xFC878A KwWU16 3276.700 wink_uw_q0p1 0.00 3276.700 FORMAT "%8.3" /end CHARACTERISTIC
/begin CHARACTERISTIC MKKOMX "Maximal zul‰ssiges Kompressormoment (Kupplungsmoment)" VALUE 0xFD2648 KwUb 127.5 md_q0p5 0.00 127.5 FORMAT "%5.1" /end CHARACTERISTIC
/begin CHARACTERISTIC MLFKMSDK "Luftmassenstromschwelle f¸r multipl. Abgleich von HFM- und DK-Massenstrom" VALUE 0xFC2CC8 KwUw 6553.500 m_uw_b6553p5 0.00 6553.500 FORMAT "%8.3" /end CHARACTERISTIC
/begin CHARACTERISTIC MSALLMN "Minimale Leerlaufluftmassenadaption f¸r E-Gas" VALUE 0xFC2AA4 KwSb 25.50 m_ub_q0p1 -12.80 12.70 FORMAT "%5.2" /end CHARACTERISTIC
/begin CHARACTERISTIC MSALLMX "Maximale Leerlaufluftmassenadaption f¸r E-Gas" VALUE 0xFC2AA5 KwSb 25.50 m_ub_q0p1 -12.80 12.70 FORMAT "%5.2" /end CHARACTERISTIC
/begin CHARACTERISTIC MSLG "Massenstrom Leckluft gesamt" VALUE 0xFC2AA6 KwSb 25.50 m_ub_q0p1 -12.80 12.70 FORMAT "%5.2" /end CHARACTERISTIC
/begin CHARACTERISTIC NMOTBGL "Schwelle, bis zu welcher Motordrehzahl der Bankabgleich erlaubt ist" VALUE 0xFC87AC KwWU8 10200. nmot_ub_q40 0.00 10200. FORMAT "%5.0" /end CHARACTERISTIC
/begin CHARACTERISTIC NMOTOEL1 "Drehzahlschwelle 1 f¸r ÷ldruckanzeige" VALUE 0xFD0506 KwWU16 16383.75 nmot_uw_q0p25 0.00 16383.75 FORMAT "%8.2" /end CHARACTERISTIC
/begin CHARACTERISTIC NMOTOEL2 "Drehzahlschwelle 2 f¸r ÷ldruckanzeige" VALUE 0xFD0508 KwWU16 16383.75 nmot_uw_q0p25 0.00 16383.75 FORMAT "%8.2" /end CHARACTERISTIC
/begin CHARACTERISTIC NMSNDKO "Drehzahlschwelle f¸r Integratorfreigabe zur Adaption der Leckluft" VALUE 0xFC2AA7 KwUb 10200. nmot_ub_q40 0.00 10200. FORMAT "%5.0" /end CHARACTERISTIC
/begin CHARACTERISTIC NMSNVTO "Drehzahlschwelle f¸r Integratorfreigabe zur Adaption der Leckluft VVT" VALUE 0xFC2AA8 KwUb 10200. nmot_ub_q40 0.00 10200. FORMAT "%5.0" /end CHARACTERISTIC
/begin CHARACTERISTIC NMUHRPL "max. zul. Motordrehzahl f¸r Uhr-Gleichlaufpr¸fung" VALUE 0xFD1A5E KwUb 10200. nmot_ub_q40 0.00 10200. FORMAT "%5.0" /end CHARACTERISTIC
/begin CHARACTERISTIC NRLMNIST "Drehzahlwert f¸r konstantes rl im Start" VALUE 0xFC2CCA KwUw 16383.75 nmot_uw_q0p25 0.00 16383.75 FORMAT "%8.2" /end CHARACTERISTIC
/begin CHARACTERISTIC NTIMDRED "Minimaldrehzahl fuer RL-Begrenzung" VALUE 0xFC2ED0 KwWU16 16383.75 nmot_uw_q0p25 0.00 16383.75 FORMAT "%8.2" /end CHARACTERISTIC
/begin CHARACTERISTIC NTLUGEN "Ersatzwert f¸r Regelspannungsvorgabe Generator" VALUE 0xFC7FE1 KwWU8 6.375 spg_gencan 10.60 16.98 FORMAT "%5.2" /end CHARACTERISTIC
/begin CHARACTERISTIC OFWNKMX "Schwelle maximale Exzenterwinkelverstellung durch Bankabgleich" VALUE 0xFC878C KwWU16 6553.500 wink_uw_q0p1 0.00 6553.500 FORMAT "%8.3" /end CHARACTERISTIC
/begin CHARACTERISTIC PFABR "Schwelle Bremsdruck bei Fahrer bremst" VALUE 0xFC7FC3 KwUb 255.0 dez 0.00 255.0 FORMAT "%5.1" /end CHARACTERISTIC
/begin CHARACTERISTIC PMAX1013 "Referenzdruck 1013 hPa" VALUE 0xFC402A KwWU16 2559.961 p_uw_q0p039 0.00 2559.961 FORMAT "%8.3" /end CHARACTERISTIC
/begin CHARACTERISTIC PSPVDKUGN "Verh‰ltnis pspvdk ungedrosselt" CURVE 0xFC2CCC KlAUwSstUwWUw 1.999969 fak_uw_b2 0.00 1.999969 FORMAT "%8.6"
 /begin AXIS_DESCR STD_AXIS nmot_w nmot_uw_q0p25 12 0.00 16383.75 FORMAT "%8.2" DEPOSIT ABSOLUTE /end AXIS_DESCR
/end CHARACTERISTIC
/begin CHARACTERISTIC QTEBGLA "Schwelle, ab welchen fqtebgl_w der Bankabgleich aktiv wird (B_dqtebgla)" VALUE 0xFC878E KwWU16 1.999969 fak_uw_b2 0.00 1.999969 FORMAT "%8.6" /end CHARACTERISTIC
/begin CHARACTERISTIC QTEBGLP "Schwelle, ab welchen fqtebgl_w der Bankabgleich passiv wird (B_dqtebglp)" VALUE 0xFC8790 KwWU16 1.999969 fak_uw_b2 0.00 1.999969 FORMAT "%8.6" /end CHARACTERISTIC
/begin CHARACTERISTIC RGNFAK "Korrekturfaktor fuer Drehzahl" VALUE 0xFC2ECE KwWU8 0.9961 fak_ub_b1 0.00 0.9961 /end CHARACTERISTIC
/begin CHARACTERISTIC RGNFAK2 "Korrekturfaktor fuer Drehzahl Bank 2" VALUE 0xFC2ECC KwWU16 639.9902 rgfak_uw_q0p009766 0.00 639.9902 FORMAT "%8.4" /end CHARACTERISTIC
/begin CHARACTERISTIC RKATBGL "Schwelle additive Gemischkorrektur (pro Zt) der Gemischadaption" VALUE 0xFC8792 KwWU16 3071.953 rel_sw_b1536 0.00 3071.953 FORMAT "%8.3" /end CHARACTERISTIC
/begin CHARACTERISTIC RLMXFMN "untere Faktorgrenze" VALUE 0xFD0C8A KwUw 1.999969 fak_uw_b2 0.00 1.999969 FORMAT "%8.6" /end CHARACTERISTIC
/begin CHARACTERISTIC RLMXLESS "negative Regeldifferenz" VALUE 0xFD0C8C KwUw 1.999969 fak_uw_b2 0.00 1.999969 FORMAT "%8.6" /end CHARACTERISTIC
/begin CHARACTERISTIC RLMXPLUS "positive Regeldifferenz" VALUE 0xFD0C8E KwUw 1.999969 fak_uw_b2 0.00 1.999969 FORMAT "%8.6" /end CHARACTERISTIC
/begin CHARACTERISTIC RLMXTEHYST "Hysterese f¸r Einspritzfaktor" VALUE 0xFD0C24 KwUb 1.992 fak_ub_b2 0.00 1.992 FORMAT "%5.3" /end CHARACTERISTIC
/begin CHARACTERISTIC RLNOT "Notlauf rl bei E_DK und E_LM" CURVE 0xFC2AA9 KlAUbSstUbWUb 191.3 rel_ub_q0p75 0.00 191.3 FORMAT "%5.1"
 /begin AXIS_DESCR STD_AXIS nmot nmot_ub_q40 6 0.00 10200. FORMAT "%5.0" DEPOSIT ABSOLUTE /end AXIS_DESCR
/end CHARACTERISTIC
/begin CHARACTERISTIC SKFFAKSRM "Umschalter Eingang KFFAKSRM zwischen dps_w und dpssyn_w" VALUE 0xFC402D KwWU8 1.000 dez 0.00 1.000 FORMAT "%5.3" /end CHARACTERISTIC
/begin CHARACTERISTIC STIGEN2APP "pplizierbarer Wert f¸r ST_I_GEN an das Powermodul bei 2 Generator" VALUE 0xFD2649 KwUb 255.0 igen_ub_q1 0.00 255.0 FORMAT "%5.1" /end CHARACTERISTIC
/begin CHARACTERISTIC STM_ERR "L¸fteranforderung bei CAN-INST3-Ausfall" VALUE 0xFD2650 KwUb 15.00 dez 0.00 15.00 FORMAT "%5.2" /end CHARACTERISTIC
/begin CHARACTERISTIC STM_ERR2 "L¸fteranforderung bei AFS/EPS-Ausfall w‰hrend aktiver Anforderung" VALUE 0xFD2651 KwUb 15.00 dez 0.00 15.00 FORMAT "%5.2" /end CHARACTERISTIC
/begin CHARACTERISTIC S_HUBINST "Umschaltung evhubs_w / evhubin_w f¸r KFMSNVVT" VALUE 0xFC2AB6 KwUb 255.0 dez 0.00 255.0 FORMAT "%5.1" /end CHARACTERISTIC
/begin CHARACTERISTIC S_MSDKIST "Umschaltung Nebenlastsignal unabh‰ngig von B_stend" VALUE 0xFC2AB7 KwUb 255.0 dez 0.00 255.0 FORMAT "%5.1" /end CHARACTERISTIC
/begin CHARACTERISTIC S_NNADAP "Einschalten multilineare Regression im LL (1)" VALUE 0xFC2AB8 KwUb 255.0 dez 0.00 255.0 FORMAT "%5.1" /end CHARACTERISTIC
/begin CHARACTERISTIC S_RLWAHL "Auswahl Saugrohrmodell 0-auto 1-ps-model 2-dps-gemessen" VALUE 0xFC402E KwWU8 2.000 dez 0.00 2.000 FORMAT "%5.3" /end CHARACTERISTIC
/begin CHARACTERISTIC S_SRMFILT "Schalter RL und DPS Filter bei DPS Saugrohrmodell" VALUE 0xFC402F KwWU8 1.000 dez 0.00 1.000 FORMAT "%5.3" /end CHARACTERISTIC
/begin CHARACTERISTIC TABSTST "Start-Abstellzeit bei unpl. Modell und Min. oder Sek.-Signal ung¸ltig" VALUE 0xFD1AA2 KwUw 65535.00 t1sxs_uw_q1 0.00 65535.00 FORMAT "%8.2" /end CHARACTERISTIC
/begin CHARACTERISTIC TBBGL "Verzoegerung B_bgl" VALUE 0xFC8794 KwWU16 65535.00 t1sxs_uw_b65535 0.00 65535.00 FORMAT "%8.2" /end CHARACTERISTIC
/begin CHARACTERISTIC TBGLAD "Sperrzeit ab Bereichswechsel" VALUE 0xFC8796 KwWU16 6553.500 t100msxs_uw_b6553p5 0.00 6553.500 FORMAT "%8.3" /end CHARACTERISTIC
/begin CHARACTERISTIC TBGLADRDY "Sperrzeit fuer Readymeldung der Adaptionsbereiche" VALUE 0xFC8798 KwWU16 65535.00 t1sxs_uw_b65535 0.00 65535.00 FORMAT "%8.2" /end CHARACTERISTIC
/begin CHARACTERISTIC TBGLLR "Zeitverzˆgerung nach Lambdaregler aktiv" VALUE 0xFC879A KwWU16 65535.00 t1sxs_uw_b65535 0.00 65535.00 FORMAT "%8.2" /end CHARACTERISTIC
/begin CHARACTERISTIC TBGLRDY "Sperrzeit f¸r Readymeldung" VALUE 0xFC879C KwWU16 65535.00 t1sxs_uw_b65535 0.00 65535.00 FORMAT "%8.2" /end CHARACTERISTIC
/begin CHARACTERISTIC TBGLST "Zeitverzˆgerung nach Startende" VALUE 0xFC879E KwWU16 65535.00 t1sxs_uw_b65535 0.00 65535.00 FORMAT "%8.2" /end CHARACTERISTIC
/begin CHARACTERISTIC TDCIDX0B6H "Entprellzeit Diagnose f¸r CAN-ID 0x0B6" VALUE 0xFC7FC4 KwUb 5.100 t_q0p02 0.00 5.100 FORMAT "%5.3" /end CHARACTERISTIC
/begin CHARACTERISTIC TDCIDX0B9H "Entprellzeit Diagnose f¸r CAN-ID 0xB9" VALUE 0xFD2641 KwUb 5.100 t_q0p02 0.00 5.100 FORMAT "%5.3" /end CHARACTERISTIC
/begin CHARACTERISTIC TDCIDX0C4H "Entprellzeit Diagnose f¸r CAN-ID 0x0C4" VALUE 0xFC7FC5 KwUb 5.100 t_q0p02 0.00 5.100 FORMAT "%5.3" /end CHARACTERISTIC
/begin CHARACTERISTIC TDCIDX0CEH "Entprellzeit Diagnose f¸r CAN-ID 0x0CE" VALUE 0xFC7FC6 KwUb 5.100 t_q0p02 0.00 5.100 FORMAT "%5.3" /end CHARACTERISTIC
/begin CHARACTERISTIC TDCIDX130H "Entprellzeit Diagnose f¸r CAN-ID 0x130" VALUE 0xFD2645 KwUb 2.550 t_q0p01 0.00 2.550 FORMAT "%5.3" /end CHARACTERISTIC
/begin CHARACTERISTIC TDCIDX135H "Entprellzeit CAN-Botschafts-Diagnose f¸r CAN-ID 0x135" VALUE 0xFD2660 KwUw 6553.500 t_q0p1 0.00 6553.500 FORMAT "%8.3" /end CHARACTERISTIC
/begin CHARACTERISTIC TDCIDX153H "Entprellzeit Diagnose f¸r CAN-ID 0x153" VALUE 0xFC7FC7 KwUb 5.100 t_q0p02 0.00 5.100 FORMAT "%5.3" /end CHARACTERISTIC
/begin CHARACTERISTIC TDCIDX194H "Entprellzeit Diagnose f¸r CAN-ID 0x194" VALUE 0xFC7FE6 KwUb 5.100 t_q0p02 0.00 5.100 FORMAT "%5.3" /end CHARACTERISTIC
/begin CHARACTERISTIC TDCIDX19EH "Entprellzeit Diagnose f¸r CAN-ID 0x19E" VALUE 0xFC7FC8 KwUb 5.100 t_q0p02 0.00 5.100 FORMAT "%5.3" /end CHARACTERISTIC
/begin CHARACTERISTIC TDCIDX1A0H "Entprellzeit Diagnose f¸r CAN-ID 0x1A0" VALUE 0xFC7FC9 KwUb 5.100 t_q0p02 0.00 5.100 FORMAT "%5.3" /end CHARACTERISTIC
/begin CHARACTERISTIC TDCIDX1A2H "Entprellzeit Diagnose f¸r CAN-ID 0x1A2" VALUE 0xFC7FD4 KwUb 5.100 t_q0p02 0.00 5.100 FORMAT "%5.3" /end CHARACTERISTIC
/begin CHARACTERISTIC TDCIDX1ACH "Entprellzeit Diagnose f¸r CAN-ID 0x1AC" VALUE 0xFD2643 KwUb 5.100 t_q0p02 0.00 5.100 FORMAT "%5.3" /end CHARACTERISTIC
/begin CHARACTERISTIC TDCIDX1B4H "Entprellzeit Diagnose f¸r CAN-ID 0x1B4" VALUE 0xFD2652 KwUb 25.50 t_q0p1 0.00 25.50 FORMAT "%5.2" /end CHARACTERISTIC
/begin CHARACTERISTIC TDCIDX1B5H "Entprellzeit Diagnose f¸r CAN-ID 0x1B5" VALUE 0xFD2653 KwUb 25.50 t_q0p1 0.00 25.50 FORMAT "%5.2" /end CHARACTERISTIC
/begin CHARACTERISTIC TDCIDX1F0H "Entprellzeit Diagnose f¸r CAN-ID 0x1F0" VALUE 0xFC7FCA KwUb 5.100 t_q0p02 0.00 5.100 FORMAT "%5.3" /end CHARACTERISTIC
/begin CHARACTERISTIC TDCIDX1F3H "Entprellzeit Diagnose f¸r CAN-ID 0x1F3" VALUE 0xFC7FCB KwUb 5.100 t_q0p02 0.00 5.100 FORMAT "%5.3" /end CHARACTERISTIC
/begin CHARACTERISTIC TDCIDX1F5H "Entprellzeit Diagnose f¸r CAN-ID 0x1F5" VALUE 0xFC7FCC KwUb 5.100 t_q0p02 0.00 5.100 FORMAT "%5.3" /end CHARACTERISTIC
/begin CHARACTERISTIC TDCIDX310H "Entprellzeit Diagnose f¸r CAN-ID 0x310" VALUE 0xFD2654 KwUb 25.50 t_q0p1 0.00 25.50 FORMAT "%5.2" /end CHARACTERISTIC
/begin CHARACTERISTIC TDCIDX315H "Entprellzeit Diagnose f¸r CAN-ID 0x315" VALUE 0xFD2663 KwUb 25.50 t_q0p1 0.00 25.50 FORMAT "%5.2" /end CHARACTERISTIC
/begin CHARACTERISTIC TDCIDX330H "Entprellzeit Diagnose f¸r CAN-ID 0x330" VALUE 0xFD2655 KwUb 25.50 t_q0p1 0.00 25.50 FORMAT "%5.2" /end CHARACTERISTIC
/begin CHARACTERISTIC TDCIDX334H "Entprellzeit, Diagnose f¸r CAN-ID 0x334" VALUE 0xFC7FE2 KwWU8 25.50 t_q0p1 0.00 25.50 FORMAT "%5.2" /end CHARACTERISTIC
/begin CHARACTERISTIC TDCIDX3B0H "Entprellzeit Diagnose f¸r CAN-ID 0x3B0" VALUE 0xFD2664 KwUb 25.50 t_q0p1 0.00 25.50 FORMAT "%5.2" /end CHARACTERISTIC
/begin CHARACTERISTIC TDCIDX3B4H "Entprellzeit, Diagnose f¸r CAN-ID 0x3B4" VALUE 0xFC7FE3 KwWU8 25.50 t_q0p1 0.00 25.50 FORMAT "%5.2" /end CHARACTERISTIC
/begin CHARACTERISTIC TDCIDX43BH "Entprellzeit Diagnose f¸r CAN-ID 0x43B" VALUE 0xFC7FD5 KwUb 5.100 t_q0p02 0.00 5.100 FORMAT "%5.3" /end CHARACTERISTIC
/begin CHARACTERISTIC TDCIDX43FH "Entprellzeit Diagnose f¸r CAN-ID 0x43F" VALUE 0xFC7FD6 KwUb 2.550 t_q0p01 0.00 2.550 FORMAT "%5.3" /end CHARACTERISTIC
/begin CHARACTERISTIC TDCIDX613H "Entprellzeit Diagnose f¸r CAN-ID 0x613" VALUE 0xFD2656 KwUb 25.50 t_q0p1 0.00 25.50 FORMAT "%5.2" /end CHARACTERISTIC
/begin CHARACTERISTIC TDCIDX615H "Entprellzeit Diagnose f¸r CAN-ID 0x615" VALUE 0xFD2657 KwUb 25.50 t_q0p1 0.00 25.50 FORMAT "%5.2" /end CHARACTERISTIC
/begin CHARACTERISTIC TDCIDXB5H "Entprellzeit Diagnose f¸r CAN-ID 0xB5" VALUE 0xFC7FD7 KwUb 2.550 t_q0p01 0.00 2.550 FORMAT "%5.3" /end CHARACTERISTIC
/begin CHARACTERISTIC TDCIDXB7H "Entprellzeit Diagnose f¸r CAN-ID 0xB7" VALUE 0xFD263E KwUb 5.100 t_q0p02 0.00 5.100 FORMAT "%5.3" /end CHARACTERISTIC
/begin CHARACTERISTIC TDCIDXBAH "Entprellzeit Diagnose f¸r CAN-ID 0xBA" VALUE 0xFC7FD8 KwUb 5.100 t_q0p02 0.00 5.100 FORMAT "%5.3" /end CHARACTERISTIC
/begin CHARACTERISTIC TDCIDXBDH "Entprellzeit Diagnose f¸r CAN-ID 0xBD" VALUE 0xFC7FD9 KwUb 2.550 t_q0p01 0.00 2.550 FORMAT "%5.3" /end CHARACTERISTIC
/begin CHARACTERISTIC TDCIDXMLS "Entprellzeit Timeout f¸r Dienstenachricht L¸fteransteuerung" VALUE 0xFD2658 KwUb 25.50 t_q0p1 0.00 25.50 FORMAT "%5.2" /end CHARACTERISTIC
/begin CHARACTERISTIC TDCUHR1 "Entprellzeit zur Plausibilisierung des rel. CAN-Timers" VALUE 0xFD1A5F KwUb 255.0 t1sxs_q1 0.00 255.0 FORMAT "%5.1" /end CHARACTERISTIC
/begin CHARACTERISTIC TDCUHRH "Heilungszeit, Plausibilisierung des rel. CAN-Timers" VALUE 0xFD1AA4 KwUw 6553.500 t100msxs_uw_b6553p5 0.00 6553.500 FORMAT "%8.3" /end CHARACTERISTIC
/begin CHARACTERISTIC TDENDAUFH "Zeit bis Aufheizphase f¸r max.Temp. d. SLP nach abschalten dieser erreicht ist" VALUE 0xFD5401 KwUb 255.0 t_q1 0.00 255.0 FORMAT "%5.1" /end CHARACTERISTIC
/begin CHARACTERISTIC TDSECSEG "Diagnosesegmentzeit f¸r rel. Sekundenz‰hler" VALUE 0xFD1AA6 KwUw 65535.00 t1sxs_uw_q1 0.00 65535.00 FORMAT "%8.2" /end CHARACTERISTIC
/begin CHARACTERISTIC TDUNPLACC "Entprellzeit Alive-bzw- Checksummenfehler CAN-Botschaft ACC" VALUE 0xFD263F KwUb 5.100 t_q0p02 0.00 5.100 FORMAT "%5.3" /end CHARACTERISTIC
/begin CHARACTERISTIC TDUNPLDSC2 "Entprellzeit Alive-Check CAN-Botschaft DSC2" VALUE 0xFC7FCD KwUb 5.100 t_q0p02 0.00 5.100 FORMAT "%5.3" /end CHARACTERISTIC
/begin CHARACTERISTIC TDUNPLEGS2 "Entprellzeit vom Alive.- bzw- Checksummenfehler" VALUE 0xFC7FDA KwUb 2.550 t_q0p01 0.00 2.550 FORMAT "%5.3" /end CHARACTERISTIC
/begin CHARACTERISTIC TDUNPLINS4 "Entprellzeit Alive-Check CAN-Botschaft INS4" VALUE 0xFD2659 KwUb 25.50 t_q0p1 0.00 25.50 FORMAT "%5.2" /end CHARACTERISTIC
/begin CHARACTERISTIC TIMSA "Integratorsteigung f¸r multi. Adaption" VALUE 0xFD0920 KwUb 51.00 t200msxs_ub_b51 0.00 51.00 FORMAT "%5.2" /end CHARACTERISTIC
/begin CHARACTERISTIC TIMSALL "Integratorsteigung f¸r multi. Adaption  (langsam)" VALUE 0xFD0921 KwUb 51.00 t200msxs_ub_b51 0.00 51.00 FORMAT "%5.2" /end CHARACTERISTIC
/begin CHARACTERISTIC TIMSALLVT "Integratorsteigung f¸r multi. Adaption  (langsam) VVT" VALUE 0xFD0922 KwUb 51.00 t200msxs_ub_b51 0.00 51.00 FORMAT "%5.2" /end CHARACTERISTIC
/begin CHARACTERISTIC TIMSAON "Zeitverzoegerung BGMSZS Abgleich" VALUE 0xFD0C22 KwUw 655.3500 t10msxs_uw_b655p35 0.00 655.3500 FORMAT "%8.4" /end CHARACTERISTIC
/begin CHARACTERISTIC TIMSAVT "Integratorsteigung f¸r multi. Adaption VVT" VALUE 0xFD0923 KwUb 51.00 t200msxs_ub_b51 0.00 51.00 FORMAT "%5.2" /end CHARACTERISTIC
/begin CHARACTERISTIC TMARK "Verzˆgerungszeit f¸r Ein- und Ausblenden der Marken mit Tipschalter Aus" VALUE 0xFD05A1 KwWU8 5.100 t20msxs_ub_b5p1 0.00 5.100 FORMAT "%5.3" /end CHARACTERISTIC
/begin CHARACTERISTIC TMFKMSDKA "Mot.-Temperaturschwelle f¸r multi. Adaption" VALUE 0xFC2AB9 KwUb 191.3 temp_ub_q0p75_o48 -48.00 143.3 FORMAT "%5.1" /end CHARACTERISTIC
/begin CHARACTERISTIC TMFKMSVTA "Mot.-Temperaturschwelle f¸r multi. Adaption VVT" VALUE 0xFC2ABA KwUb 191.3 temp_ub_q0p75_o48 -48.00 143.3 FORMAT "%5.1" /end CHARACTERISTIC
/begin CHARACTERISTIC TMMIMRK "Trigger zur ‹bernahme der MMI-Zielgeschwindigkeiten" VALUE 0xFD2665 KwUb 255.0 dez 0.00 255.0 FORMAT "%5.1" /end CHARACTERISTIC
/begin CHARACTERISTIC TMNABSTM "min. Abstellzeit vom Modell" VALUE 0xFD1AA8 KwUw 65535.00 t1sxs_uw_q1 0.00 65535.00 FORMAT "%8.2" /end CHARACTERISTIC
/begin CHARACTERISTIC TMNIDLEGD "Mindestzeitdauer im Leerlauf f. Berechn. Gen. Denom." VALUE 0xFCF92E KwUw 65535.00 t_q1 0.00 65535.00 FORMAT "%8.2" /end CHARACTERISTIC
/begin CHARACTERISTIC TMNTRIPGD "Mindestzeitdauer des Fahrzyklus f¸r Berechnung General Denominator" VALUE 0xFCF930 KwUw 65535.00 t_q1 0.00 65535.00 FORMAT "%8.2" /end CHARACTERISTIC
/begin CHARACTERISTIC TMNVFZGD "Mindestzeitdauer oberhalb einer Geschwindigkeitsgrenze f. Berechn. Gen. Denom." VALUE 0xFCF932 KwUw 65535.00 t_q1 0.00 65535.00 FORMAT "%8.2" /end CHARACTERISTIC
/begin CHARACTERISTIC TMOTBGL "Schwelle, ab welcher K¸hlwassertemperatur der Bankabgleich erlaubt ist" VALUE 0xFC87AD KwWU8 191.3 temp_ub_q0p75_o48 -48.00 143.3 FORMAT "%5.1" /end CHARACTERISTIC
/begin CHARACTERISTIC TMRKBLI "Zeit f¸r Ein- und Ausschaltung beim Blinken der Markenanzeige" VALUE 0xFD05A2 KwWU8 5.100 t20msxs_ub_b5p1 0.00 5.100 FORMAT "%5.3" /end CHARACTERISTIC
/begin CHARACTERISTIC TMVDBS "Entprellzeit Beschleunigungssignaldiagnose" VALUE 0xFC215E KwUb 25.50 t100msxs_ub_b25p5 0.00 25.50 FORMAT "%5.2" /end CHARACTERISTIC
/begin CHARACTERISTIC TMWLC "Zeitschwelle f¸r Motor-Warmlauf-Erkennung" VALUE 0xFD264A KwUw 6553.500 t_q0p1 0.00 6553.500 FORMAT "%8.3" /end CHARACTERISTIC
/begin CHARACTERISTIC TNLSGM "Nachlaufzeit f¸r SG abschalten" CURVE 0xFD1A60 KlAUbSstUbWUb 255.0 t1sxs_ub_b255 0.00 255.0 FORMAT "%5.1"
 /begin AXIS_DESCR STD_AXIS tmotab temp_ub_q0p75_o48 6 -48.00 143.3 FORMAT "%5.1" DEPOSIT ABSOLUTE /end AXIS_DESCR
/end CHARACTERISTIC
/begin CHARACTERISTIC TNSTRTUE "Entprellzeit nach Startende zur ¸bernahme des rel. Zeitgebers" VALUE 0xFD1AAA KwUw 6553.500 t100msxs_uw_b6553p5 0.00 6553.500 FORMAT "%8.3" /end CHARACTERISTIC
/begin CHARACTERISTIC TSELO "Verzˆgerungszeit f¸r das Setzen und Lˆschen von Marken" VALUE 0xFD05A3 KwWU8 5.100 t20msxs_ub_b5p1 0.00 5.100 FORMAT "%5.3" /end CHARACTERISTIC
/begin CHARACTERISTIC TSRACC "Senderaster der CAN-Botschaft ACC plus Toleranz" VALUE 0xFD2640 KwUb 5.100 t_q0p02 0.00 5.100 FORMAT "%5.3" /end CHARACTERISTIC
/begin CHARACTERISTIC TSRAFS1 "Senderaster der CAN-Botschaft AFS plus Toleranz" VALUE 0xFD2642 KwUb 5.100 t_q0p02 0.00 5.100 FORMAT "%5.3" /end CHARACTERISTIC
/begin CHARACTERISTIC TSRARS1 "Senderaster CAN-Botschaft ARS1 plus Toleranz" VALUE 0xFD2644 KwUb 5.100 t_q0p02 0.00 5.100 FORMAT "%5.3" /end CHARACTERISTIC
/begin CHARACTERISTIC TSRCAS1 "Senderaster CAN-Botschaft CAS1 plus Toleranz" VALUE 0xFD2646 KwUb 2.550 t_q0p01 0.00 2.550 FORMAT "%5.3" /end CHARACTERISTIC
/begin CHARACTERISTIC TSRDSC1 "Senderaster CAN-Botschaft DSC1 plus Toleranz" VALUE 0xFC7FCE KwUb 5.100 t_q0p02 0.00 5.100 FORMAT "%5.3" /end CHARACTERISTIC
/begin CHARACTERISTIC TSRDSC2 "Senderaster CAN-Botschaft DSC2 plus Toleranz" VALUE 0xFC7FCF KwUb 5.100 t_q0p02 0.00 5.100 FORMAT "%5.3" /end CHARACTERISTIC
/begin CHARACTERISTIC TSRDSC3 "Senderaster CAN-Botschaft DSC3 plus Toleranz" VALUE 0xFC7FD0 KwUb 5.100 t_q0p02 0.00 5.100 FORMAT "%5.3" /end CHARACTERISTIC
/begin CHARACTERISTIC TSRDSC4 "Senderaster CAN-Botschaft DSC4 plus Toleranz" VALUE 0xFC7FD1 KwUb 5.100 t_q0p02 0.00 5.100 FORMAT "%5.3" /end CHARACTERISTIC
/begin CHARACTERISTIC TSRDSC5 "Senderaster CAN-Botschaft DSC5 plus Toleranz" VALUE 0xFC7FD2 KwUb 5.100 t_q0p02 0.00 5.100 FORMAT "%5.3" /end CHARACTERISTIC
/begin CHARACTERISTIC TSREGS1 "Senderaster der CAN-Botschaft plus Toleranz" VALUE 0xFC7FDB KwUb 5.100 t_q0p02 0.00 5.100 FORMAT "%5.3" /end CHARACTERISTIC
/begin CHARACTERISTIC TSREGS2 "Senderaster der CAN-Botschaft plus Toleranz" VALUE 0xFC7FDC KwUb 2.550 t_q0p01 0.00 2.550 FORMAT "%5.3" /end CHARACTERISTIC
/begin CHARACTERISTIC TSREGS3 "Senderaster der CAN-Botschaft plus Toleranz" VALUE 0xFC7FDD KwUb 5.100 t_q0p02 0.00 5.100 FORMAT "%5.3" /end CHARACTERISTIC
/begin CHARACTERISTIC TSRINS1 "Senderaster CAN-Botschaft INS1 plus Toleranz" VALUE 0xFD265A KwUb 25.50 t_q0p1 0.00 25.50 FORMAT "%5.2" /end CHARACTERISTIC
/begin CHARACTERISTIC TSRINS2 "Senderaster CAN-Botschaft INS2 plus Toleranz" VALUE 0xFD265B KwUb 25.50 t_q0p1 0.00 25.50 FORMAT "%5.2" /end CHARACTERISTIC
/begin CHARACTERISTIC TSRINS3 "Senderaster CAN-Botschaft INS3 plus Toleranz" VALUE 0xFD265C KwUb 25.50 t_q0p1 0.00 25.50 FORMAT "%5.2" /end CHARACTERISTIC
/begin CHARACTERISTIC TSRINS4 "Senderaster CAN-Botschaft INS4 plus Toleranz" VALUE 0xFD265D KwUb 25.50 t_q0p1 0.00 25.50 FORMAT "%5.2" /end CHARACTERISTIC
/begin CHARACTERISTIC TSRINS5 "Senderaster CAN-Botschaft plus Toleranz" VALUE 0xFD265E KwUb 25.50 t_q0p1 0.00 25.50 FORMAT "%5.2" /end CHARACTERISTIC
/begin CHARACTERISTIC TSRLM1 "Senderaster CAN-Botschaft LM1  plus Toleranz" VALUE 0xFD2666 KwUb 25.50 t_q0p1 0.00 25.50 FORMAT "%5.2" /end CHARACTERISTIC
/begin CHARACTERISTIC TSRPWML1 "Zeit f¸r ein Senderaster der CAN-Botschaft PWML1 plus Toleranz" VALUE 0xFC7FE4 KwWU8 25.50 t_q0p1 0.00 25.50 FORMAT "%5.2" /end CHARACTERISTIC
/begin CHARACTERISTIC TSRPWML2 "Zeit f¸r ein Senderaster der CAN-Botschaft PWML2 plus Toleranz" VALUE 0xFC7FE5 KwWU8 25.50 t_q0p1 0.00 25.50 FORMAT "%5.2" /end CHARACTERISTIC
/begin CHARACTERISTIC TSRSZL1 "Senderaster CAN-Botschaft SZL1  plus Toleranz" VALUE 0xFC7FE7 KwUb 5.100 t_q0p02 0.00 5.100 FORMAT "%5.3" /end CHARACTERISTIC
/begin CHARACTERISTIC TSRSZM1 "Senderaster CAN-Botschaft SZM1 plus Toleranz" VALUE 0xFD2667 KwUb 25.50 t_q0p1 0.00 25.50 FORMAT "%5.2" /end CHARACTERISTIC
/begin CHARACTERISTIC TVPOELAN1 "Verzˆgerungszeit 1 f¸r ÷ldruckanzeige (hohe Drehzahl)" VALUE 0xFD050B KwWU8 25.50 t_q0p1 0.00 25.50 FORMAT "%5.2" /end CHARACTERISTIC
/begin CHARACTERISTIC TVPOELAN2 "Verzˆgerungszeit 2 f¸r ÷ldruckanzeige (niedrige Drehzahl)" VALUE 0xFD050C KwWU8 25.50 t_q0p1 0.00 25.50 FORMAT "%5.2" /end CHARACTERISTIC
/begin CHARACTERISTIC TVSTUTK "Verzˆgerungszeit kurz f¸r Verstellung bei gehaltener Taste" VALUE 0xFD05A4 KwWU8 5.100 t20msxs_ub_b5p1 0.00 5.100 FORMAT "%5.3" /end CHARACTERISTIC
/begin CHARACTERISTIC TVSTUTL "Verzˆgerungszeit lang f¸r Verstellung bei gehaltener Taste" VALUE 0xFD05A5 KwWU8 5.100 t20msxs_ub_b5p1 0.00 5.100 FORMAT "%5.3" /end CHARACTERISTIC
/begin CHARACTERISTIC TWSLPPWF "Initialisierungswert der Wicklungstemperatur der SLP bei Powerfail" VALUE 0xFD5402 KwUw 1535.977 temp_q0p0234_o273 -273.1500 1262.827 FORMAT "%8.3" /end CHARACTERISTIC
/begin CHARACTERISTIC VASRM "Geschwindigkeitsschwelle f¸r Schlechtwegerkennung" VALUE 0xFC215F KwUb 318.8 vfzg_ub_q1p25 0.00 318.8 FORMAT "%5.1" /end CHARACTERISTIC
/begin CHARACTERISTIC VBSMX "obere Plausibilit‰tsschwelle f¸r Radgeschwindigkeit" VALUE 0xFC2160 KwUw 4095.938 vfzg_uw_q0p0625 0.00 4095.938 FORMAT "%8.3" /end CHARACTERISTIC
/begin CHARACTERISTIC VFGRPRG "Geschwindigkeitsschwelle f¸r Aktivierung Programmiermodus Stufentempomat" VALUE 0xFD059C KwWU16 511.9922 vfzg_uw_q0p0078125 0.00 511.9922 FORMAT "%8.4" /end CHARACTERISTIC
/begin CHARACTERISTIC VFZMNGD "Geschwindigkeitsgrenze f¸r Berechnung General Denominator" VALUE 0xFCF934 KwUw 511.9922 vfzg_uw_q0p00781 0.00 511.9922 FORMAT "%8.4" /end CHARACTERISTIC
/begin CHARACTERISTIC VFZMXIDGD "Geschwindigkeitsgrenze f¸r Berechnung Leerlauf f. General Denominator" VALUE 0xFCF936 KwUw 511.9922 vfzg_uw_q0p00781 0.00 511.9922 FORMAT "%8.4" /end CHARACTERISTIC
/begin CHARACTERISTIC VSEKPMXN "Kennlinie Kraftstoff-Sollvolumenstrom bei Vollast abh‰ngig von der Drehzahl" CURVE 0xFD5408 KlAUbSstUbWUb 255.0 fuel_ub_q1 0.00 255.0 FORMAT "%5.1"
 /begin AXIS_DESCR STD_AXIS nmot nmot_ub_q40 5 0.00 10200. FORMAT "%5.0" DEPOSIT ABSOLUTE /end AXIS_DESCR
/end CHARACTERISTIC
/begin CHARACTERISTIC VSSSPE "Ersatzwert f¸r Sollvolumenstrom f¸r SSP" VALUE 0xFD5413 KwUb 255.0 fuel_ub_q1 0.00 255.0 FORMAT "%5.1" /end CHARACTERISTIC
/begin CHARACTERISTIC VSSSPTAIRL "KL Kraftstoff-Sollvolumenstrom f¸r die SSP abh. von dem F¸llstand" CURVE 0xFD5414 KlAUbSstUbWUb 255.0 fuel_ub_q1 0.00 255.0 FORMAT "%5.1"
 /begin AXIS_DESCR STD_AXIS fsttankrf fuel_ub_q0p5 4 0.00 127.5 FORMAT "%5.1" DEPOSIT ABSOLUTE /end AXIS_DESCR
/end CHARACTERISTIC
/begin CHARACTERISTIC VTBGL "Verzˆgerung 1000ms Zeitscheube Bankabgleich" VALUE 0xFC87A0 KwWU16 65535.00 t1sxs_uw_b65535 0.00 65535.00 FORMAT "%8.2" /end CHARACTERISTIC
/begin CHARACTERISTIC VVTALLMN "Minimale additive Luftmassenadaption VVT Betrieb" VALUE 0xFC2ABB KwSb 25.50 m_ub_q0p1 -12.80 12.70 FORMAT "%5.2" /end CHARACTERISTIC
/begin CHARACTERISTIC VVTALLMX "Maximale additive Luftmassenadaption VVT Betrieb" VALUE 0xFC2ABC KwSb 25.50 m_ub_q0p1 -12.80 12.70 FORMAT "%5.2" /end CHARACTERISTIC
/begin CHARACTERISTIC VVTNLLMN "Minimale Offsetadaption" VALUE 0xFC2ABD KwSb 25.50 m_ub_q0p1 -12.80 12.70 FORMAT "%5.2" /end CHARACTERISTIC
/begin CHARACTERISTIC VVTNLLMX "Maximale Leerlaufwinkeladaption" VALUE 0xFC2ABE KwSb 25.50 m_ub_q0p1 -12.80 12.70 FORMAT "%5.2" /end CHARACTERISTIC
/begin CHARACTERISTIC W1_MAX "Max Begrenzung fuer lin. Netzparameter" VALUE 0xFC2DD4 KwWR32 6.805647338000E+021 fak_r32_1 -3.402823669000E+021 3.402823669000E+021 FORMAT "%27.4" /end CHARACTERISTIC
/begin CHARACTERISTIC W1_MIN "Min Begrenzung fuer lin. Netzparameter" VALUE 0xFC2DD8 KwWR32 6.805647338000E+021 fak_r32_1 -3.402823669000E+021 3.402823669000E+021 FORMAT "%27.4" /end CHARACTERISTIC
/begin CHARACTERISTIC W2_MAX "Max Begrenzung fuer aditive Netzparameter" VALUE 0xFC2DDC KwWR32 6.805647338000E+021 fak_r32_1 -3.402823669000E+021 3.402823669000E+021 FORMAT "%27.4" /end CHARACTERISTIC
/begin CHARACTERISTIC W2_MIN "Min Begrenzung fuer aditive Netzparameter" VALUE 0xFC2DE0 KwWR32 6.805647338000E+021 fak_r32_1 -3.402823669000E+021 3.402823669000E+021 FORMAT "%27.4" /end CHARACTERISTIC
/begin CHARACTERISTIC WDKFMAON "min. Schwelle Freigabe der mult. Adaption" CURVE 0xFD0924 KlAUbSstUbWUb 100.0 relDK_ub_b100 0.00 100.0 FORMAT "%5.1"
 /begin AXIS_DESCR STD_AXIS nmot nmot_ub_q40 4 0.00 10200. FORMAT "%5.0" DEPOSIT ABSOLUTE /end AXIS_DESCR
/end CHARACTERISTIC
/begin CHARACTERISTIC WDKFMAUN "max. Schwelle Freigabe der multi. Adaption" CURVE 0xFD092D KlAUbSstUbWUb 100.0 relDK_ub_b100 0.00 100.0 FORMAT "%5.1"
 /begin AXIS_DESCR STD_AXIS nmot nmot_ub_q40 4 0.00 10200. FORMAT "%5.0" DEPOSIT ABSOLUTE /end AXIS_DESCR
/end CHARACTERISTIC
/begin CHARACTERISTIC WDKMSON "min. Schwelle Freigabe der addi. Adaption" CURVE 0xFD0936 KlAUbSstUbWUb 100.0 relDK_ub_b100 0.00 100.0 FORMAT "%5.1"
 /begin AXIS_DESCR STD_AXIS nmot nmot_ub_q40 4 0.00 10200. FORMAT "%5.0" DEPOSIT ABSOLUTE /end AXIS_DESCR
/end CHARACTERISTIC
/begin CHARACTERISTIC WDKMSONTD "min. Schwelle Freigabe der addi. Adaption bei Teildrosselung" CURVE 0xFD093F KlAUbSstUbWUb 100.0 relDK_ub_b100 0.00 100.0 FORMAT "%5.1"
 /begin AXIS_DESCR STD_AXIS nmot nmot_ub_q40 4 0.00 10200. FORMAT "%5.0" DEPOSIT ABSOLUTE /end AXIS_DESCR
/end CHARACTERISTIC
/begin CHARACTERISTIC ZBGLOFWLL "Winkel Inkrement 1 (Leerlauf) f. Integrator" VALUE 0xFC87A2 KwWU16 6553.300 wink_uw_q0p1 0.2000000 6553.500 FORMAT "%8.3" /end CHARACTERISTIC
/begin CHARACTERISTIC ZBGLOFWTL "Winkel Inkrement 2 (Teillast) f. Integrator" VALUE 0xFC87A4 KwWU16 6553.300 wink_uw_q0p1 0.2000000 6553.500 FORMAT "%8.3" /end CHARACTERISTIC
/begin CHARACTERISTIC ZBRT "Zeitkonstante f¸r Brennraumtempmodell" VALUE 0xFD0DA4 KwUb 25.4996 zk100msxs_ub_b25p5 0.100392 25.6000 FORMAT "%7.4" /end CHARACTERISTIC
/begin CHARACTERISTIC ZDLTDPSF "" VALUE 0xFC40A6 KwUw 655.34999985 zk10msxs_uw_b655 0.010000152590 655.36000000 FORMAT "%12.8" /end CHARACTERISTIC
/begin CHARACTERISTIC ZENTRUM "Zentrum der Zugehoerigkeitsfunktion [Grad]" VAL_BLK 0xFC2DBC KwbWR32 200000.00000000000 fak_r32_1 -100000.00000000000 100000.00000000000 FORMAT "%27.20" NUMBER 3 /end CHARACTERISTIC
/begin CHARACTERISTIC ZFLUBBGL "Zeitkonstante Laufunruhe PT1" VALUE 0xFC87A6 KwWU16 99.99847 rel_uw_b100 0.00 99.99847 FORMAT "%8.5" /end CHARACTERISTIC
/begin CHARACTERISTIC ZFMVRV "Zeitkonstante f¸r Filterung des Geschwindigkeitssignals" VALUE 0xFC2392 KwUb 5.08000 zk20msxs_ub_b5p1 0.0200000 5.10000 FORMAT "%7.5" /end CHARACTERISTIC
/begin CHARACTERISTIC ZFVISRMST "" CURVE 0xFC4014 KlAxU8SstxU8WU8 5.100 t20msxs_ub_b5p1 0.00 5.100 FORMAT "%5.3"
 /begin AXIS_DESCR STD_AXIS tmst temp_ub_q0p75_o48 6 -48.00 143.3 FORMAT "%5.1" DEPOSIT ABSOLUTE /end AXIS_DESCR
/end CHARACTERISTIC
/begin CHARACTERISTIC ZKABKTWSLP "Zeitkonstante f¸r die Abk¸hlung der Wicklungstemperatur der SLP" VALUE 0xFD5404 KwUw 65534.000000 zk1sxs_uw_b65535 1.0000000000 65535.000000 FORMAT "%12.6" /end CHARACTERISTIC
/begin CHARACTERISTIC ZKDATV "Zeitkonstante f¸r Filterung differenz Tacho zu Istgeschwindigkeit" VALUE 0xFC2394 KwUw 1309.9800107 zk20msxs_uw_b1310 0.019989318685 1310.0000000 FORMAT "%12.7" /end CHARACTERISTIC
/begin CHARACTERISTIC ZKMSDK "Zeitkonstante schnelle Massenstromadaption" CURVE 0xFC2CFE KlAUwSstUwWUw 7.812269 mk10ms_uw_q2p384e5n 0.00 7.812269 FORMAT "%8.6"
 /begin AXIS_DESCR STD_AXIS dpsvbgms_w fak_uw_b2 8 0.00 1.999969 FORMAT "%8.6" DEPOSIT ABSOLUTE /end AXIS_DESCR
/end CHARACTERISTIC
/begin CHARACTERISTIC ZKMSDKTD "Zeitkonstante schnelle Massenstromadaption teilgedrosselt" CURVE 0xFC2D20 KlAUwSstUwWUw 7.812269 mk10ms_uw_q2p384e5n 0.00 7.812269 FORMAT "%8.6"
 /begin AXIS_DESCR STD_AXIS dpsvbgms_w fak_uw_b2 8 0.00 1.999969 FORMAT "%8.6" DEPOSIT ABSOLUTE /end AXIS_DESCR
/end CHARACTERISTIC
/begin CHARACTERISTIC ZKTABTU "Zeitkonstante f¸r Motorabk¸hlung" CURVE 0xFD1AAC KlAUwSstUwWUw 65535.00 t1sxs_uw_q1 0.00 65535.00 FORMAT "%8.2"
 /begin AXIS_DESCR STD_AXIS tumg temp_ub_q0p75_o48 4 -48.00 143.3 FORMAT "%5.1" DEPOSIT ABSOLUTE /end AXIS_DESCR
/end CHARACTERISTIC
/begin CHARACTERISTIC ZKTWSLPUB "Zeitkonstante f¸r Wicklungstemperatur der SLP" CURVE 0xFCEBD0 KlAxU8SstxU16WU16 65534.000000 zk1sxs_uw_b65535 1.0000000000 65535.000000 FORMAT "%12.6"
 /begin AXIS_DESCR STD_AXIS ub_w spg_ubatt 4 0.00 6173.397 FORMAT "%8.3" DEPOSIT ABSOLUTE /end AXIS_DESCR
/end CHARACTERISTIC
/begin CHARACTERISTIC ZNGFIL "Zeitkonstante f¸r Drehzahlgradient-Filter" VALUE 0xFC1D96 KwUw 655.34999985 zk10msxs_uw_b655 0.010000152590 655.36000000 FORMAT "%12.8" /end CHARACTERISTIC
/begin CHARACTERISTIC ZQTEBGL "Zeitkonstante PT1-Filterung qtebgl_w" VALUE 0xFC87A8 KwWU16 99.99847 rel_uw_b100 0.00 99.99847 FORMAT "%8.5" /end CHARACTERISTIC
/begin CHARACTERISTIC ZTDAGR "Zeitkonstante Temperaturdynamik bei AGR Auf- Abschaltung" VALUE 0xFD0DC8 KwUw 6553.4999985 zk100msxs_uw_b6553 0.10000152590 6553.6000000 FORMAT "%12.7" /end CHARACTERISTIC
/begin CHARACTERISTIC ZTMMBR "Zeitkonstante Motortemperatur f¸r Brennraumtempmodell" VALUE 0xFD0DCA KwUw 6553.4999985 zk100msxs_uw_b6553 0.10000152590 6553.6000000 FORMAT "%12.7" /end CHARACTERISTIC
/begin CHARACTERISTIC ZVTPRGSU "Zeitkonstante Tiefpaﬂfilterung bei Saugrohrklappendynamik" VALUE 0xFC4030 KwUb 5.08000 zk20msxs_ub_b5p1 0.0200000 5.10000 FORMAT "%7.5" /end CHARACTERISTIC
/begin CHARACTERISTIC ZWDKM1 "1. Zeitkonstante Dk-Modell" VALUE 0xFC68C4 KwUw 2.550000 zk10msxs_uw_b2p55T 0.00 2.550000 FORMAT "%8.6" /end CHARACTERISTIC
/begin CHARACTERISTIC ZWDKM2 "2. Zeitkonstante Dk-Modell" VALUE 0xFC68C6 KwUw 2.550000 zk10msxs_uw_b2p55T 0.00 2.550000 FORMAT "%8.6" /end CHARACTERISTIC
/begin MEASUREMENT acccod "Automatische ACC-SG Erkennung" UBYTE dez 1 100 0 255 FORMAT "%5.1" ECU_ADDRESS 0x3FE928 /end MEASUREMENT
/begin MEASUREMENT adbereich "Adaptionsbereich Bankabgleich" UBYTE dez 1 100 0 255 FORMAT "%5.1" ECU_ADDRESS 0x4030A0 /end MEASUREMENT
/begin MEASUREMENT afs1errctr "AFS1-Botschaftserror-Z‰hler (Drehmoment_ANF_AFS)" UBYTE dez 1 100 0 255 FORMAT "%5.1" ECU_ADDRESS 0x402EBC /end MEASUREMENT
/begin MEASUREMENT agrr "Abgasr¸ckf¸hrrate" UBYTE rel_ub_b99p6 1 100 0 99.6094 FORMAT "%5.2" ECU_ADDRESS 0x403BBA /end MEASUREMENT
/begin MEASUREMENT agrr_w "Abgasr¸ckf¸hrrate word" UWORD rel_uw_b100 1 100 0 99.9985 FORMAT "%8.5" ECU_ADDRESS 0x403F76 /end MEASUREMENT
/begin MEASUREMENT anzmark "Anzahl Geschwindigkeits-Marken Stufentempomat" UBYTE dez 1 100 0 255 FORMAT "%5.1" ECU_ADDRESS 0x3FE0DE /end MEASUREMENT
/begin MEASUREMENT arscod "Automatische ARS-SG Erkennung" UBYTE dez 1 100 0 255 FORMAT "%5.1" ECU_ADDRESS 0x3FE1A3 /end MEASUREMENT
/begin MEASUREMENT asccod "Automatische ASC-SG Erkennung" UBYTE dez 1 100 0 255 FORMAT "%5.1" ECU_ADDRESS 0x3FE1A4 /end MEASUREMENT
/begin MEASUREMENT ausg_nn "" FLOAT32_IEEE fak_r32_1 1 100 -3.40282e+024 3.40282e+024 FORMAT "%27.1" ECU_ADDRESS 0x3FAE58 /end MEASUREMENT
/begin MEASUREMENT avs2_w "Winkel Auslassventil schliesst bez. auf OT Bank 2" SWORD sprzi_q0p1 1 100 -3276.8 3276.7 FORMAT "%8.3" ECU_ADDRESS 0x404508 /end MEASUREMENT
/begin MEASUREMENT avs_w "Ueberschneidungsflaeche: AV schliesst nach OT" SWORD sprzi_q0p1 1 100 -3276.8 3276.7 FORMAT "%8.3" ECU_ADDRESS 0x40450A /end MEASUREMENT
/begin MEASUREMENT batt_class "Klassifizierung der in diesem Fzg. eingebauten Batterie" UBYTE dez 1 100 0 255 FORMAT "%5.1" ECU_ADDRESS 0x3FE1AA /end MEASUREMENT
/begin MEASUREMENT bfzgldsc_w "Fahrzeugl‰ngsbeschleunigung bereitgestellt vom DSC-SG" SWORD bfzg_q0p025 1 100 -819.2 819.175 FORMAT "%8.4" ECU_ADDRESS 0x402ED6 /end MEASUREMENT
/begin MEASUREMENT bfzglfgr "Fahrzeugl‰ngsbeschleunigung" SBYTE bfzg_sb_q0p217 1 100 -27.776 27.559 FORMAT "%5.2" ECU_ADDRESS 0x403BB7 /end MEASUREMENT
/begin MEASUREMENT bfzgqars_w "Fahrzeugquerbeschleunigung" UWORD bfzg_q0p025 1 100 0 1638.38 FORMAT "%8.3" ECU_ADDRESS 0x402ED8 /end MEASUREMENT
/begin MEASUREMENT bgladrdy "Entsprechender Adaptionsbereich Bankabgleich fertig gelernt" UBYTE dez 1 100 0 255 FORMAT "%5.1" ECU_ADDRESS 0x4030A1 /end MEASUREMENT
/begin MEASUREMENT bgl_adrdy_count "" UWORD t1sxs_uw_b65535 1 100 0 65535 FORMAT "%8.2" ECU_ADDRESS 0x40307E /end MEASUREMENT
/begin MEASUREMENT bgl_ad_count "" UWORD t1sxs_uw_b65535 1 100 0 65535 FORMAT "%8.2" ECU_ADDRESS 0x403080 /end MEASUREMENT
/begin MEASUREMENT Bgl_flags1 "Status Sperren Bankabgleich" UBYTE dez 1 100 0 255 FORMAT "%5.1" ECU_ADDRESS 0x4030A2 /end MEASUREMENT
/begin MEASUREMENT Bgl_flags2 "Status Sperren durch andere Funktionen / Diagnose" UBYTE dez 1 100 0 255 FORMAT "%5.1" ECU_ADDRESS 0x4030A3 /end MEASUREMENT
/begin MEASUREMENT Bgl_flags3 "Freigabe Flag 3" UBYTE dez 1 100 0 255 FORMAT "%5.1" ECU_ADDRESS 0x4030A4 /end MEASUREMENT
/begin MEASUREMENT Bgl_flags4 "Freigabe Flag 4" UBYTE dez 1 100 0 255 FORMAT "%5.1" ECU_ADDRESS 0x4030A5 /end MEASUREMENT
/begin MEASUREMENT bgl_lr_count "" UWORD t1sxs_uw_b65535 1 100 0 65535 FORMAT "%8.2" ECU_ADDRESS 0x403082 /end MEASUREMENT
/begin MEASUREMENT bgl_rdy_count "" UWORD t1sxs_uw_b65535 1 100 0 65535 FORMAT "%8.2" ECU_ADDRESS 0x403084 /end MEASUREMENT
/begin MEASUREMENT bgl_start_count "" UWORD t1sxs_uw_b65535 1 100 0 65535 FORMAT "%8.2" ECU_ADDRESS 0x403086 /end MEASUREMENT
/begin MEASUREMENT bgstutLokBits0 "" UBYTE dez 1 100 0 255 FORMAT "%5.1" ECU_ADDRESS 0x402C14 /end MEASUREMENT
/begin MEASUREMENT bgstutLokBits1 "" UBYTE dez 1 100 0 255 FORMAT "%5.1" ECU_ADDRESS 0x402C15 /end MEASUREMENT
/begin MEASUREMENT BgtabstNvBits "" UBYTE dez 1 100 0 255 FORMAT "%5.1" ECU_ADDRESS 0x3FE15C /end MEASUREMENT
/begin MEASUREMENT bsc "Radbeschleunigungssignal aus ABS-Sensorsignal berechnet" UBYTE acc_ub_b55p55 1 100 0 55.335 FORMAT "%5.2" ECU_ADDRESS 0x403BAE /end MEASUREMENT
/begin MEASUREMENT B_ac "Bedingung Lastaufschaltung Klimaanlage" UBYTE B_TRUE 1 100 0 1 BIT_MASK 0x1 FORMAT "%13.11" ECU_ADDRESS 0x402EFC /end MEASUREMENT
/begin MEASUREMENT B_ac2 "Bedingung Eco-(B_AC2=0) oder Normal-Betrieb (B_AC2=1) aus CAN-Matrix" UBYTE B_TRUE 1 100 0 1 BIT_MASK 0x2 FORMAT "%13.11" ECU_ADDRESS 0x402EFC /end MEASUREMENT
/begin MEASUREMENT B_acc "Bedingung: ACC-Steuerger‰t vorhanden" UBYTE B_TRUE 1 100 0 1 BIT_MASK 0x1 FORMAT "%13.11" ECU_ADDRESS 0x3FC113 /end MEASUREMENT
/begin MEASUREMENT B_acccok "Bedingung CAN-Botschaft-ACC1 vorhanden" UBYTE B_TRUE 1 100 0 1 BIT_MASK 0x1 FORMAT "%13.11" ECU_ADDRESS 0x3FC114 /end MEASUREMENT
/begin MEASUREMENT B_accnew "Bedingung CAN-ACC-Botschaft i.O. empfangen" UBYTE B_TRUE 1 100 0 1 BIT_MASK 0x1 FORMAT "%13.11" ECU_ADDRESS 0x3FC115 /end MEASUREMENT
/begin MEASUREMENT B_afs1cok "Bedingung: CAN-Botschaft ASF vorhanden" UBYTE B_TRUE 1 100 0 1 BIT_MASK 0x1 FORMAT "%13.11" ECU_ADDRESS 0x403BF3 /end MEASUREMENT
/begin MEASUREMENT B_afs1csao "Checksummen- und Alivepr¸fung der Botschaft Drehmoment_ANF_AFS  in Ordnung" UBYTE B_TRUE 1 100 0 1 BIT_MASK 0x4 FORMAT "%13.11" ECU_ADDRESS 0x403BF3 /end MEASUREMENT
/begin MEASUREMENT B_afs1new "Bedingung: CAN-Botschaft ASF  i.O. empfangen" UBYTE B_TRUE 1 100 0 1 BIT_MASK 0x2 FORMAT "%13.11" ECU_ADDRESS 0x403BF3 /end MEASUREMENT
/begin MEASUREMENT B_afsron "AFS-Regelung aktiv" UBYTE B_TRUE 1 100 0 1 BIT_MASK 0x8 FORMAT "%13.11" ECU_ADDRESS 0x403BF3 /end MEASUREMENT
/begin MEASUREMENT B_afsvar "Bedingung AFS-Modul(Aktive Lenkung)  vorhanden" UBYTE B_TRUE 1 100 0 1 BIT_MASK 0x1 FORMAT "%13.11" ECU_ADDRESS 0x3FE1A2 /end MEASUREMENT
/begin MEASUREMENT B_ars1cok "Bedingung CAN-Botschaft-ARS  vorhanden" UBYTE B_TRUE 1 100 0 1 BIT_MASK 0x1 FORMAT "%13.11" ECU_ADDRESS 0x3FC117 /end MEASUREMENT
/begin MEASUREMENT B_ars1new "Bedingung CAN-ARS1-Botschaft  i.O. empfangen" UBYTE B_TRUE 1 100 0 1 BIT_MASK 0x1 FORMAT "%13.11" ECU_ADDRESS 0x3FC118 /end MEASUREMENT
/begin MEASUREMENT B_arsron "ARS-Regelung aktiv" UBYTE B_TRUE 1 100 0 1 BIT_MASK 0x1 FORMAT "%13.11" ECU_ADDRESS 0x3FC119 /end MEASUREMENT
/begin MEASUREMENT B_arsvar "Bedingung ARS-Modul(Aktive Rollstabilisierung)  vorhanden" UBYTE B_TRUE 1 100 0 1 BIT_MASK 0x1 FORMAT "%13.11" ECU_ADDRESS 0x3FC11A /end MEASUREMENT
/begin MEASUREMENT B_ascpkw "Bedingung Fahrzeug mit ASC erkannt und CAN-Botschaft nicht unterbrochen" UBYTE B_TRUE 1 100 0 1 BIT_MASK 0x1 FORMAT "%13.11" ECU_ADDRESS 0x403BFC /end MEASUREMENT
/begin MEASUREMENT B_asc_reg "CAN-Botschaft: ASC regelt (mit Bremsen-Eingriff)" UBYTE B_TRUE 1 100 0 1 BIT_MASK 0x2 FORMAT "%13.11" ECU_ADDRESS 0x403BFC /end MEASUREMENT
/begin MEASUREMENT B_autget "Bedingung Automatikgetriebe" UBYTE B_TRUE 1 100 0 1 BIT_MASK 0x4 FORMAT "%13.11" ECU_ADDRESS 0x3FE1A5 /end MEASUREMENT
/begin MEASUREMENT B_begr "Freigabe Berechnung Momentenbegrenzung" UBYTE B_TRUE 1 100 0 1 FORMAT "%13.11" ECU_ADDRESS 0x40306E /end MEASUREMENT
/begin MEASUREMENT B_beveh "Bedingung Halten der Beschleunigen- oder Verzˆgern-Taste" UBYTE B_TRUE 1 100 0 1 BIT_MASK 0x1 FORMAT "%13.11" ECU_ADDRESS 0x402C14 /end MEASUREMENT
/begin MEASUREMENT B_bgl "Bedingung Bankabgleich aktiv" UBYTE B_TRUE 1 100 0 1 FORMAT "%13.11" ECU_ADDRESS 0x40306F /end MEASUREMENT
/begin MEASUREMENT B_bglb2 "Bedingung Eingriff auf Bank2" UBYTE B_TRUE 1 100 0 1 FORMAT "%13.11" ECU_ADDRESS 0x403070 /end MEASUREMENT
/begin MEASUREMENT B_bgllub2 "Bank 2 ausgew‰hlt ¸ber Laufunruhebewertung" UBYTE B_TRUE 1 100 0 1 FORMAT "%13.11" ECU_ADDRESS 0x403071 /end MEASUREMENT
/begin MEASUREMENT B_bglp "Passivbedingung Bankabgleich" UBYTE B_TRUE 1 100 0 1 FORMAT "%13.11" ECU_ADDRESS 0x403072 /end MEASUREMENT
/begin MEASUREMENT B_bglrdy "Bedingung Bankabgleich abgeschlossen" UBYTE B_TRUE 1 100 0 1 FORMAT "%13.11" ECU_ADDRESS 0x403073 /end MEASUREMENT
/begin MEASUREMENT B_bglteb2 "Bank 2 ausgew‰hlt ¸ber Einspritzzeitverh‰ltniss Bank1/Bank2" UBYTE B_TRUE 1 100 0 1 FORMAT "%13.11" ECU_ADDRESS 0x403074 /end MEASUREMENT
/begin MEASUREMENT b_bgl_count "" UWORD t1sxs_uw_b65535 1 100 0 65535 FORMAT "%8.2" ECU_ADDRESS 0x403088 /end MEASUREMENT
/begin MEASUREMENT B_bgmsdk "Bedingung Freigabe GD Betrieb Adaption" UBYTE dez 1 100 0 255 FORMAT "%5.1" ECU_ADDRESS 0x402CA6 /end MEASUREMENT
/begin MEASUREMENT B_bgmszs "Bedindung Freigabe Adaption" UBYTE dez 1 100 0 255 FORMAT "%5.1" ECU_ADDRESS 0x402CA7 /end MEASUREMENT
/begin MEASUREMENT B_bgmszsi "Initialisierung schneller Luftmassenabgleich" UBYTE dez 1 100 0 255 FORMAT "%5.1" ECU_ADDRESS 0x402CA8 /end MEASUREMENT
/begin MEASUREMENT B_bv1 "Bedingung Bediensignal Stufentempomat Beschleunigen oder Verzˆgern 1. Stufe" UBYTE B_TRUE 1 100 0 1 BIT_MASK 0x2 FORMAT "%13.11" ECU_ADDRESS 0x402C14 /end MEASUREMENT
/begin MEASUREMENT B_bv2 "Bedingung Bediensignal Stufentempomat Beschleunigen oder Verzˆgern 2. Stufe" UBYTE B_TRUE 1 100 0 1 BIT_MASK 0x4 FORMAT "%13.11" ECU_ADDRESS 0x402C14 /end MEASUREMENT
/begin MEASUREMENT B_caccnpv "Bedingung Alive-oder Checksumme vom ACC-SG  fehlerhaft" UBYTE B_TRUE 1 100 0 1 BIT_MASK 0x1 FORMAT "%13.11" ECU_ADDRESS 0x3FC116 /end MEASUREMENT
/begin MEASUREMENT B_cas1csao "Checksummen.- und Alivepr¸fung der Botschaft Klemmenstatus in Ordnung" UBYTE B_TRUE 1 100 0 1 BIT_MASK 0x1 FORMAT "%13.11" ECU_ADDRESS 0x3FC11B /end MEASUREMENT
/begin MEASUREMENT B_cascok "Bedingung Car-Accessbotschaft CAN empfangen" UBYTE B_TRUE 1 100 0 1 BIT_MASK 0x1 FORMAT "%13.11" ECU_ADDRESS 0x3FC11C /end MEASUREMENT
/begin MEASUREMENT B_casnew "Bedingung: CAN-Botschaft CAS i.O. empfangen" UBYTE B_TRUE 1 100 0 1 BIT_MASK 0x1 FORMAT "%13.11" ECU_ADDRESS 0x3FC11D /end MEASUREMENT
/begin MEASUREMENT B_ccsdok "Bedingung CC-Sendeanforderung wurde erfolgreich umgesetzt" UBYTE B_TRUE 1 100 0 1 BIT_MASK 0x1 FORMAT "%13.11" ECU_ADDRESS 0x3FC121 /end MEASUREMENT
/begin MEASUREMENT B_cdscnpv "Bedingung Alive-oder Checksumme vom DSC fehlerhaft" UBYTE B_TRUE 1 100 0 1 BIT_MASK 0x4 FORMAT "%13.11" ECU_ADDRESS 0x403BFC /end MEASUREMENT
/begin MEASUREMENT B_cegs2npv "Bedingung Alive-oder Checksumme vom EGS/SSG  fehlerhaft" UBYTE B_TRUE 1 100 0 1 BIT_MASK 0x1 FORMAT "%13.11" ECU_ADDRESS 0x3FC122 /end MEASUREMENT
/begin MEASUREMENT B_cinsnvp "" UBYTE B_TRUE 1 100 0 1 BIT_MASK 0x4 FORMAT "%13.11" ECU_ADDRESS 0x402EFC /end MEASUREMENT
/begin MEASUREMENT B_cntgd "Bedingung ""General Denominator"" in dieser Fahrt inkrementiert" UBYTE B_TRUE 1 100 0 1 BIT_MASK 0x1 FORMAT "%13.11" ECU_ADDRESS 0x3FBEEF /end MEASUREMENT
/begin MEASUREMENT B_cnticy "Bedingung ""Ignition Cycle Counter"" in dieser Fahrt inkrementiert" UBYTE B_TRUE 1 100 0 1 BIT_MASK 0x1 FORMAT "%13.11" ECU_ADDRESS 0x3FBEF0 /end MEASUREMENT
/begin MEASUREMENT B_dlubbgla "Aktivbedingung Bankabgleich ¸ber Laufunruhebewertung" UBYTE B_TRUE 1 100 0 1 FORMAT "%13.11" ECU_ADDRESS 0x403075 /end MEASUREMENT
/begin MEASUREMENT B_dlubbglp "Passivbedingung Bankabgleich ¸ber Laufunruhebewertung" UBYTE B_TRUE 1 100 0 1 FORMAT "%13.11" ECU_ADDRESS 0x403076 /end MEASUREMENT
/begin MEASUREMENT B_dpsmod "Berechnungsmode f¸r dpsbgms_w" UBYTE B_TRUE 1 100 0 1 BIT_MASK 0x1 FORMAT "%13.11" ECU_ADDRESS 0x402CB6 /end MEASUREMENT
/begin MEASUREMENT B_dsc1cok "Bedingung: CAN-Botschaft DSC vorhanden" UBYTE B_TRUE 1 100 0 1 BIT_MASK 0x8 FORMAT "%13.11" ECU_ADDRESS 0x403BFC /end MEASUREMENT
/begin MEASUREMENT B_dsc1new "Bedingung: CAN-Botschaft DSC  i.O. empfangen" UBYTE B_TRUE 1 100 0 1 BIT_MASK 0x10 FORMAT "%13.11" ECU_ADDRESS 0x403BFC /end MEASUREMENT
/begin MEASUREMENT B_dsc2cok "Bedingung: CAN-Botschaft DSC vorhanden" UBYTE B_TRUE 1 100 0 1 BIT_MASK 0x20 FORMAT "%13.11" ECU_ADDRESS 0x403BFC /end MEASUREMENT
/begin MEASUREMENT B_dsc2new "Bedingung: CAN-Botschaft DSC  i.O. empfangen" UBYTE B_TRUE 1 100 0 1 BIT_MASK 0x40 FORMAT "%13.11" ECU_ADDRESS 0x403BFC /end MEASUREMENT
/begin MEASUREMENT B_dsc3cok "Bedingung: CAN-Botschaft DSC vorhanden" UBYTE B_TRUE 1 100 0 1 BIT_MASK 0x80 FORMAT "%13.11" ECU_ADDRESS 0x403BFC /end MEASUREMENT
/begin MEASUREMENT B_dsc3new "Bedingung: CAN-Botschaft DSC  i.O. empfangen" UBYTE B_TRUE 1 100 0 1 BIT_MASK 0x1 FORMAT "%13.11" ECU_ADDRESS 0x403BFD /end MEASUREMENT
/begin MEASUREMENT B_dsc4cok "Bedingung: CAN-Botschaft DSC vorhanden" UBYTE B_TRUE 1 100 0 1 BIT_MASK 0x2 FORMAT "%13.11" ECU_ADDRESS 0x403BFD /end MEASUREMENT
/begin MEASUREMENT B_dsc4new "Bedingung: CAN-Botschaft DSC  i.O. empfangen" UBYTE B_TRUE 1 100 0 1 BIT_MASK 0x4 FORMAT "%13.11" ECU_ADDRESS 0x403BFD /end MEASUREMENT
/begin MEASUREMENT B_dsc5cok "Bedingung: CAN-Botschaft DSC vorhanden" UBYTE B_TRUE 1 100 0 1 BIT_MASK 0x8 FORMAT "%13.11" ECU_ADDRESS 0x403BFD /end MEASUREMENT
/begin MEASUREMENT B_dsc5new "Bedingung: CAN-Botschaft DSC  i.O. empfangen" UBYTE B_TRUE 1 100 0 1 BIT_MASK 0x10 FORMAT "%13.11" ECU_ADDRESS 0x403BFD /end MEASUREMENT
/begin MEASUREMENT B_dsc_reg "CAN-Botschaft: DSC regelt (Motor und Bremseingriffe)" UBYTE B_TRUE 1 100 0 1 BIT_MASK 0x20 FORMAT "%13.11" ECU_ADDRESS 0x403BFD /end MEASUREMENT
/begin MEASUREMENT B_dslvh "Bedingung Ladedrucksensor vorhanden" UBYTE dez 1 100 0 255 FORMAT "%5.1" ECU_ADDRESS 0x402CA9 /end MEASUREMENT
/begin MEASUREMENT B_dssv "Bedingung Saugrohr-Drucksensor vorhanden als Hauptlastsensor" UBYTE dez 1 100 0 255 FORMAT "%5.1" ECU_ADDRESS 0x402CAA /end MEASUREMENT
/begin MEASUREMENT B_egs1cok "Bedingung CAN-Botschaft EGS vorhanden" UBYTE B_TRUE 1 100 0 1 BIT_MASK 0x1 FORMAT "%13.11" ECU_ADDRESS 0x3FC123 /end MEASUREMENT
/begin MEASUREMENT B_egs1new "Bedingung CAN-Botschaft EGS i.O. empfangen" UBYTE B_TRUE 1 100 0 1 BIT_MASK 0x1 FORMAT "%13.11" ECU_ADDRESS 0x3FC124 /end MEASUREMENT
/begin MEASUREMENT B_egs2cok "Bedingung CAN-Botschaft EGS vorhanden" UBYTE B_TRUE 1 100 0 1 BIT_MASK 0x1 FORMAT "%13.11" ECU_ADDRESS 0x3FC125 /end MEASUREMENT
/begin MEASUREMENT B_egs2new "Bedingung CAN-Botschaft EGS i.O. empfangen" UBYTE B_TRUE 1 100 0 1 BIT_MASK 0x1 FORMAT "%13.11" ECU_ADDRESS 0x3FC126 /end MEASUREMENT
/begin MEASUREMENT B_egs3cok "Bedingung CAN-Botschaft EGS vorhanden" UBYTE B_TRUE 1 100 0 1 BIT_MASK 0x1 FORMAT "%13.11" ECU_ADDRESS 0x3FC127 /end MEASUREMENT
/begin MEASUREMENT B_egs3new "Bedingung CAN-Botschaft EGS i.O. empfangen" UBYTE B_TRUE 1 100 0 1 BIT_MASK 0x1 FORMAT "%13.11" ECU_ADDRESS 0x3FC128 /end MEASUREMENT
/begin MEASUREMENT B_egssbc "Bedingung SBC-Betrieb (Stand By Control)" UBYTE B_TRUE 1 100 0 1 BIT_MASK 0x1 FORMAT "%13.11" ECU_ADDRESS 0x3FC129 /end MEASUREMENT
/begin MEASUREMENT B_egsssc "Bedingung SSC-Betrieb (Sleeping Starter Clutch)" UBYTE B_TRUE 1 100 0 1 BIT_MASK 0x1 FORMAT "%13.11" ECU_ADDRESS 0x3FC12A /end MEASUREMENT
/begin MEASUREMENT B_elws "Bedingung Fehler Lenkradwinkel" UBYTE B_TRUE 1 100 0 1 BIT_MASK 0x1 FORMAT "%13.11" ECU_ADDRESS 0x403BFE /end MEASUREMENT
/begin MEASUREMENT B_emfbra "Bedingung EMF Bremsanforderung aktiv" UBYTE B_TRUE 1 100 0 1 BIT_MASK 0x40 FORMAT "%13.11" ECU_ADDRESS 0x403BFD /end MEASUREMENT
/begin MEASUREMENT B_endaufh "Bedingung Aufheizphase der Wicklungstemperatur der SLP erreicht" UBYTE B_TRUE 1 100 0 1 BIT_MASK 0x1 FORMAT "%13.11" ECU_ADDRESS 0x403820 /end MEASUREMENT
/begin MEASUREMENT B_envtwa "Bedingung FGR aktiv vor Bet‰tigung der Wiederaufnahme-Taste" UBYTE B_TRUE 1 100 0 1 BIT_MASK 0x8 FORMAT "%13.11" ECU_ADDRESS 0x402C14 /end MEASUREMENT
/begin MEASUREMENT B_evfzgv1 "Bedingung Fehler Geschwindigkeitssignal V1 (¸ber CAN)" UBYTE B_TRUE 1 100 0 1 BIT_MASK 0x80 FORMAT "%13.11" ECU_ADDRESS 0x403BFD /end MEASUREMENT
/begin MEASUREMENT B_fabr "Bedingung Fahrer bremst aus CAN-Botschaft" UBYTE B_TRUE 1 100 0 1 BIT_MASK 0x2 FORMAT "%13.11" ECU_ADDRESS 0x403BFE /end MEASUREMENT
/begin MEASUREMENT B_fbgl "Bedingung Freigabe Bankabgleich" UBYTE B_TRUE 1 100 0 1 FORMAT "%13.11" ECU_ADDRESS 0x403077 /end MEASUREMENT
/begin MEASUREMENT B_fgrabz "Bedingung zus‰tzliche FGR-Abschaltung" UBYTE B_TRUE 1 100 0 1 BIT_MASK 0x1 FORMAT "%13.11" ECU_ADDRESS 0x3FC069 /end MEASUREMENT
/begin MEASUREMENT B_fgrepa "Bedingung externe Programmierung des FGR aktiv" UBYTE B_TRUE 1 100 0 1 BIT_MASK 0x1 FORMAT "%13.11" ECU_ADDRESS 0x402C15 /end MEASUREMENT
/begin MEASUREMENT B_fkmsmn "schnelle Massenstromadaption fkmsdks im unteren Anschlag" UBYTE dez 1 100 0 255 FORMAT "%5.1" ECU_ADDRESS 0x402CAB /end MEASUREMENT
/begin MEASUREMENT B_fkmsmx "schnelle Massenstromadaption fkmsdks im oberen Anschlag" UBYTE dez 1 100 0 255 FORMAT "%5.1" ECU_ADDRESS 0x402CAC /end MEASUREMENT
/begin MEASUREMENT B_fkpvmn "langsame Massenstromadaption fkpvdk im unteren Anschlag" UBYTE dez 1 100 0 255 FORMAT "%5.1" ECU_ADDRESS 0x402CAD /end MEASUREMENT
/begin MEASUREMENT B_fkpvmx "langsame Massenstromadaption fkpvdk im oberen Anschlag" UBYTE dez 1 100 0 255 FORMAT "%5.1" ECU_ADDRESS 0x402CAE /end MEASUREMENT
/begin MEASUREMENT B_flub1 "Bedingung Abweichung flutbgl_w von Bank1 zum Mittelwert Bank1 zu gross" UBYTE B_TRUE 1 100 0 1 FORMAT "%13.11" ECU_ADDRESS 0x403078 /end MEASUREMENT
/begin MEASUREMENT B_flub2 "Bedingung Abweichung flutbgl_w von Bank2 zum Mittelwert Bank2 zu gross" UBYTE B_TRUE 1 100 0 1 FORMAT "%13.11" ECU_ADDRESS 0x403079 /end MEASUREMENT
/begin MEASUREMENT B_fobdegs "Bedingung OBD-Relevanter-Fehler im EGS eingetragen" UBYTE B_TRUE 1 100 0 1 BIT_MASK 0x1 FORMAT "%13.11" ECU_ADDRESS 0x3FC12B /end MEASUREMENT
/begin MEASUREMENT B_fofr1_old "" UBYTE B_TRUE 1 100 0 1 FORMAT "%13.11" ECU_ADDRESS 0x40307A /end MEASUREMENT
/begin MEASUREMENT B_fs "Bedingung Fahrstufe" UBYTE B_TRUE 1 100 0 1 BIT_MASK 0x1 FORMAT "%13.11" ECU_ADDRESS 0x3FC12C /end MEASUREMENT
/begin MEASUREMENT B_fstcanok "CAN: Bedingung Tankfuellstands-Message okay" UBYTE B_TRUE 1 100 0 1 BIT_MASK 0x8 FORMAT "%13.11" ECU_ADDRESS 0x402EFC /end MEASUREMENT
/begin MEASUREMENT B_fstpl "Bedingung Tankf¸llstand plausibel" UBYTE B_TRUE 1 100 0 1 BIT_MASK 0x1 FORMAT "%13.11" ECU_ADDRESS 0x3FC37E /end MEASUREMENT
/begin MEASUREMENT B_got "Bedingung Getriebeˆl_‹bertemperatur Stufe I" UBYTE B_TRUE 1 100 0 1 BIT_MASK 0x1 FORMAT "%13.11" ECU_ADDRESS 0x3FC12D /end MEASUREMENT
/begin MEASUREMENT B_got2 "Bedingung Getriebeˆl-‹bertemperatur Stufe II" UBYTE B_TRUE 1 100 0 1 BIT_MASK 0x1 FORMAT "%13.11" ECU_ADDRESS 0x3FC12E /end MEASUREMENT
/begin MEASUREMENT B_gts "Bedingung Getriebeschutz" UBYTE B_TRUE 1 100 0 1 BIT_MASK 0x1 FORMAT "%13.11" ECU_ADDRESS 0x3FC12F /end MEASUREMENT
/begin MEASUREMENT B_hfmv "Bedingung HFM vorhanden" UBYTE dez 1 100 0 255 FORMAT "%5.1" ECU_ADDRESS 0x402CAF /end MEASUREMENT
/begin MEASUREMENT B_hls "Bedingung Heizung Lambdasonde" UBYTE B_TRUE 1 100 0 1 BIT_MASK 0x10 FORMAT "%13.11" ECU_ADDRESS 0x402EFC /end MEASUREMENT
/begin MEASUREMENT B_hzl "Bedingung Anforderung Zuheizmaﬂnahme vom Klima-SG" UBYTE B_TRUE 1 100 0 1 BIT_MASK 0x20 FORMAT "%13.11" ECU_ADDRESS 0x402EFC /end MEASUREMENT
/begin MEASUREMENT B_ins1cok "Bedingung: CAN-Botschaft INSTR1 vorhanden" UBYTE B_TRUE 1 100 0 1 BIT_MASK 0x1 FORMAT "%13.11" ECU_ADDRESS 0x4037C8 /end MEASUREMENT
/begin MEASUREMENT B_ins1new "Bedingung: CAN-Botschaft INSTR1 vorhanden" UBYTE B_TRUE 1 100 0 1 BIT_MASK 0x1 FORMAT "%13.11" ECU_ADDRESS 0x4037C9 /end MEASUREMENT
/begin MEASUREMENT B_ins2cok "Bedingung: CAN-Botschaft INSTR2 vorhanden" UBYTE B_TRUE 1 100 0 1 BIT_MASK 0x1 FORMAT "%13.11" ECU_ADDRESS 0x4037CA /end MEASUREMENT
/begin MEASUREMENT B_ins2new "Bedingung CAN-Kombi-Botschaft 2 empfangen" UBYTE B_TRUE 1 100 0 1 BIT_MASK 0x1 FORMAT "%13.11" ECU_ADDRESS 0x4037CB /end MEASUREMENT
/begin MEASUREMENT B_ins3cok "Bedingung CAN-Botschaft-INST3 vorhanden" UBYTE B_TRUE 1 100 0 1 BIT_MASK 0x1 FORMAT "%13.11" ECU_ADDRESS 0x3FC139 /end MEASUREMENT
/begin MEASUREMENT B_ins3new "Bedingung CAN-Kombi-Botschaft 3 empfangen" UBYTE B_TRUE 1 100 0 1 BIT_MASK 0x1 FORMAT "%13.11" ECU_ADDRESS 0x3FC13A /end MEASUREMENT
/begin MEASUREMENT B_ins4cok "Bedingung CAN-Botschaft-4 vorhanden" UBYTE B_TRUE 1 100 0 1 BIT_MASK 0x1 FORMAT "%13.11" ECU_ADDRESS 0x4037CC /end MEASUREMENT
/begin MEASUREMENT B_ins4new "Bedingung CAN-Kombi-Botschaft 4  empfangen" UBYTE B_TRUE 1 100 0 1 BIT_MASK 0x1 FORMAT "%13.11" ECU_ADDRESS 0x4037CD /end MEASUREMENT
/begin MEASUREMENT B_ins5cok "Bedingung: CAN-Botschaft vorhanden" UBYTE B_TRUE 1 100 0 1 BIT_MASK 0x1 FORMAT "%13.11" ECU_ADDRESS 0x4037CE /end MEASUREMENT
/begin MEASUREMENT B_ins5new "Bedingung CAN-Botschaft empfangen" UBYTE B_TRUE 1 100 0 1 BIT_MASK 0x1 FORMAT "%13.11" ECU_ADDRESS 0x4037CF /end MEASUREMENT
/begin MEASUREMENT B_insfgre "Bedingung Fehler im INST-Kombi, FGR muss abgeschaltet werden" UBYTE B_TRUE 1 100 0 1 BIT_MASK 0x40 FORMAT "%13.11" ECU_ADDRESS 0x402EFC /end MEASUREMENT
/begin MEASUREMENT B_insmilon "Bedingung Fehlerlampe im Kombiinstrument an" UBYTE B_TRUE 1 100 0 1 BIT_MASK 0x80 FORMAT "%13.11" ECU_ADDRESS 0x402EFC /end MEASUREMENT
/begin MEASUREMENT B_kltdstend "" UBYTE dez 1 100 0 255 FORMAT "%5.1" ECU_ADDRESS 0x402CB0 /end MEASUREMENT
/begin MEASUREMENT B_km "Bedingung CAN-Kombi-Kodierung in km/h" UBYTE B_TRUE 1 100 0 1 BIT_MASK 0x1 FORMAT "%13.11" ECU_ADDRESS 0x402EFD /end MEASUREMENT
/begin MEASUREMENT B_ko "Bedingung Kompressor freigegeben" UBYTE B_TRUE 1 100 0 1 BIT_MASK 0x2 FORMAT "%13.11" ECU_ADDRESS 0x402EFD /end MEASUREMENT
/begin MEASUREMENT B_koger "Bedingung geregelter/ungeregelter Klimakompressor" UBYTE B_TRUE 1 100 0 1 BIT_MASK 0x4 FORMAT "%13.11" ECU_ADDRESS 0x3FE1A6 /end MEASUREMENT
/begin MEASUREMENT B_kovar "Variantenbit f¸r Klimakompressor vorhanden" UBYTE B_TRUE 1 100 0 1 BIT_MASK 0x8 FORMAT "%13.11" ECU_ADDRESS 0x3FE1A6 /end MEASUREMENT
/begin MEASUREMENT B_lm1cok "Bedingung CAN-Botschaft-LM vorhanden" UBYTE B_TRUE 1 100 0 1 BIT_MASK 0x1 FORMAT "%13.11" ECU_ADDRESS 0x403BFF /end MEASUREMENT
/begin MEASUREMENT B_lm1new "Bedingung CAN-Botschaft LM1 empfangen" UBYTE B_TRUE 1 100 0 1 BIT_MASK 0x2 FORMAT "%13.11" ECU_ADDRESS 0x403BFF /end MEASUREMENT
/begin MEASUREMENT B_mbegegs "Bedingung MD-Anfahrbegrenzung aktiv (AG-Getriebeschutz)" UBYTE B_TRUE 1 100 0 1 BIT_MASK 0x1 FORMAT "%13.11" ECU_ADDRESS 0x3FC130 /end MEASUREMENT
/begin MEASUREMENT B_mbegssg "Bedingung zur Begrenzung des Anfahrmoments durch SSG (Getriebeschutz)" UBYTE B_TRUE 1 100 0 1 BIT_MASK 0x1 FORMAT "%13.11" ECU_ADDRESS 0x3FC131 /end MEASUREMENT
/begin MEASUREMENT B_mmiena "Bedingung MMI Zielgeschwindigkeiten zur ‹bernahme g¸ltig" UBYTE B_TRUE 1 100 0 1 BIT_MASK 0x20 FORMAT "%13.11" ECU_ADDRESS 0x403BFF /end MEASUREMENT
/begin MEASUREMENT B_mrkbli "Bedingung Blinken der Markenanzeige beim Stufentempomat" UBYTE B_TRUE 1 100 0 1 BIT_MASK 0x10 FORMAT "%13.11" ECU_ADDRESS 0x402C14 /end MEASUREMENT
/begin MEASUREMENT B_mrkein "Bedingung Anzeige Geschwindigkeits-Marken im Kombi ein" UBYTE B_TRUE 1 100 0 1 BIT_MASK 0x1 FORMAT "%13.11" ECU_ADDRESS 0x3FC05A /end MEASUREMENT
/begin MEASUREMENT B_mrkeinvp "Bedingung Anzeige Geschwindigkeits-Marken im Kombi ein vor Programmiermodus" UBYTE B_TRUE 1 100 0 1 BIT_MASK 0x2 FORMAT "%13.11" ECU_ADDRESS 0x402C15 /end MEASUREMENT
/begin MEASUREMENT B_mrkv "Bedingung Ver‰nderung der Geschwindigkeits-Marken Stufentempomat" UBYTE B_TRUE 1 100 0 1 BIT_MASK 0x1 FORMAT "%13.11" ECU_ADDRESS 0x3FC05B /end MEASUREMENT
/begin MEASUREMENT B_mstpssgr "Bedingung Anforderung Motorstop vom SSG-SG" UBYTE B_TRUE 1 100 0 1 BIT_MASK 0x1 FORMAT "%13.11" ECU_ADDRESS 0x3FC132 /end MEASUREMENT
/begin MEASUREMENT B_ngasok "Bedingung Ringspeicher f¸r ngas-Berechnung ok" UBYTE B_TRUE 1 100 0 1 BIT_MASK 0x1 FORMAT "%13.11" ECU_ADDRESS 0x3FBF72 /end MEASUREMENT
/begin MEASUREMENT B_nlendabt "Bedingung nach dem regul‰ren SG-Nachlauf wurde noch kein Motorstart durchgef¸hrt" UBYTE B_TRUE 1 100 0 1 BIT_MASK 0x1 FORMAT "%13.11" ECU_ADDRESS 0x3FE15C /end MEASUREMENT
/begin MEASUREMENT B_nmin "Bedingung Unterdrehzahl: n < NMIN" UBYTE B_TRUE 1 100 0 1 BIT_MASK 0x1 FORMAT "%13.11" ECU_ADDRESS 0x3FBF74 /end MEASUREMENT
/begin MEASUREMENT B_nmot "Bedingung Motordrehzahl: n > NMIN" UBYTE B_TRUE 1 100 0 1 BIT_MASK 0x1 FORMAT "%13.11" ECU_ADDRESS 0x3FBF75 /end MEASUREMENT
/begin MEASUREMENT B_nstarttx "Bedingung Sendeanforderung STARTDREHZAHL" UBYTE B_TRUE 1 100 0 1 BIT_MASK 0x1 FORMAT "%13.11" ECU_ADDRESS 0x3FC13B /end MEASUREMENT
/begin MEASUREMENT B_ntkw "Bedingung Anforderung niedrige K¸hlmitteltemp. (W‰rmetauscherschutz)" UBYTE B_TRUE 1 100 0 1 BIT_MASK 0x10 FORMAT "%13.11" ECU_ADDRESS 0x402EFD /end MEASUREMENT
/begin MEASUREMENT B_oeldran "Bedingung ÷ldruckanzeige" UBYTE B_TRUE 1 100 0 1 BIT_MASK 0x1 FORMAT "%13.11" ECU_ADDRESS 0x3FC041 /end MEASUREMENT
/begin MEASUREMENT B_oelstmot "Bedingung Sendeanforderung ""Elektronischer Motorˆlmesstab""" UBYTE B_TRUE 1 100 0 1 BIT_MASK 0x8 FORMAT "%13.11" ECU_ADDRESS 0x402EFD /end MEASUREMENT
/begin MEASUREMENT B_pn "Bedingung f¸r Fahrstufe P oder N" UBYTE B_TRUE 1 100 0 1 BIT_MASK 0x1 FORMAT "%13.11" ECU_ADDRESS 0x3FC133 /end MEASUREMENT
/begin MEASUREMENT B_prgmod "Bedingung Programmiermodus Stufentempomat" UBYTE B_TRUE 1 100 0 1 BIT_MASK 0x20 FORMAT "%13.11" ECU_ADDRESS 0x402C14 /end MEASUREMENT
/begin MEASUREMENT B_pwml1cok "Bedingung: CAN-Botschaft PWML vorhanden" UBYTE B_TRUE 1 100 0 1 BIT_MASK 0x1 FORMAT "%13.11" ECU_ADDRESS 0x4037D0 /end MEASUREMENT
/begin MEASUREMENT B_pwml1new "Bedingung CAN-Botschaft PWML i.O. empfangen" UBYTE B_TRUE 1 100 0 1 BIT_MASK 0x1 FORMAT "%13.11" ECU_ADDRESS 0x4037D1 /end MEASUREMENT
/begin MEASUREMENT B_pwml2cok "Bedingung: CAN-Botschaft PWML vorhanden" UBYTE B_TRUE 1 100 0 1 BIT_MASK 0x1 FORMAT "%13.11" ECU_ADDRESS 0x4037D2 /end MEASUREMENT
/begin MEASUREMENT B_pwml2new "Bedingung CAN-Botschaft PWML i.O. empfangen" UBYTE B_TRUE 1 100 0 1 BIT_MASK 0x1 FORMAT "%13.11" ECU_ADDRESS 0x4037D3 /end MEASUREMENT
/begin MEASUREMENT B_qtebgla "Aktivbedingung Bankabgleich ¸ber Einspritzzeitverh‰ltniss Bank1/Bank2" UBYTE B_TRUE 1 100 0 1 FORMAT "%13.11" ECU_ADDRESS 0x40307B /end MEASUREMENT
/begin MEASUREMENT B_qtebglp "Passivbedingung Bankabgleich ¸ber Einspritzzeitverh‰ltniss Bank1/Bank2" UBYTE B_TRUE 1 100 0 1 FORMAT "%13.11" ECU_ADDRESS 0x40307C /end MEASUREMENT
/begin MEASUREMENT B_rlh "Bedingung Saugrohrmodell mit PS-Modell" UBYTE dez 1 100 0 255 FORMAT "%5.1" ECU_ADDRESS 0x40378D /end MEASUREMENT
/begin MEASUREMENT B_sbhspwml "Batteriehauptschalter ˆffnet sich" UBYTE B_TRUE 1 100 0 1 BIT_MASK 0x1 FORMAT "%13.11" ECU_ADDRESS 0x3FC13C /end MEASUREMENT
/begin MEASUREMENT B_ssghyp "Status Hydraulikpumpe" UBYTE B_TRUE 1 100 0 1 BIT_MASK 0x1 FORMAT "%13.11" ECU_ADDRESS 0x3FC134 /end MEASUREMENT
/begin MEASUREMENT B_ssgschlt "Bedingung Schaltvorgang aktiv" UBYTE B_TRUE 1 100 0 1 BIT_MASK 0x1 FORMAT "%13.11" ECU_ADDRESS 0x3FC135 /end MEASUREMENT
/begin MEASUREMENT B_ssgspmod "Steuerung (deaktivierung) Sportmodus" UBYTE B_TRUE 1 100 0 1 BIT_MASK 0x1 FORMAT "%13.11" ECU_ADDRESS 0x3FC136 /end MEASUREMENT
/begin MEASUREMENT B_ssgvar "Bedingung SSG (Sequentielles Schaltgetriebe) verbaut" UBYTE B_TRUE 1 100 0 1 BIT_MASK 0x2 FORMAT "%13.11" ECU_ADDRESS 0x3FE1A5 /end MEASUREMENT
/begin MEASUREMENT B_startini "Startbit f¸r Erkennung der ersten Synchronisation nach KL15 ein" UBYTE B_TRUE 1 100 0 1 BIT_MASK 0x1 FORMAT "%13.11" ECU_ADDRESS 0x3FBF76 /end MEASUREMENT
/begin MEASUREMENT B_stdhakt "Bedingung Standheizung aktiv" UBYTE B_TRUE 1 100 0 1 BIT_MASK 0x1 FORMAT "%13.11" ECU_ADDRESS 0x3FE1A6 /end MEASUREMENT
/begin MEASUREMENT B_suini "Bedingung Abschaltung Tiefpaﬂfilter f¸r pirg_w und fupsrl_w" UBYTE B_TRUE 1 100 0 1 BIT_MASK 0x1 FORMAT "%13.11" ECU_ADDRESS 0x3FC06E /end MEASUREMENT
/begin MEASUREMENT B_swokl30 "Bedingung Abschaltung durch das Power-Modul erfolgt" UBYTE B_TRUE 1 100 0 1 BIT_MASK 0x1 FORMAT "%13.11" ECU_ADDRESS 0x3FC13D /end MEASUREMENT
/begin MEASUREMENT B_szl1cok "Bedingung CAN-Botschaft-SZL1  vorhanden" UBYTE B_TRUE 1 100 0 1 BIT_MASK 0x1 FORMAT "%13.11" ECU_ADDRESS 0x3FC13E /end MEASUREMENT
/begin MEASUREMENT B_szl1new "Bedingung CAN-SZL1-Botschaft  i.O. empfangen" UBYTE B_TRUE 1 100 0 1 BIT_MASK 0x1 FORMAT "%13.11" ECU_ADDRESS 0x3FC13F /end MEASUREMENT
/begin MEASUREMENT B_szm1cok "Bedingung CAN-Botschaft-SZM1 vorhanden" UBYTE B_TRUE 1 100 0 1 BIT_MASK 0x4 FORMAT "%13.11" ECU_ADDRESS 0x403BFF /end MEASUREMENT
/begin MEASUREMENT B_szm1csao "Checksummen- und Alivepr¸fung der CAN-Botschaft SZM1 in Ordnung" UBYTE B_TRUE 1 100 0 1 BIT_MASK 0x8 FORMAT "%13.11" ECU_ADDRESS 0x403BFF /end MEASUREMENT
/begin MEASUREMENT B_szm1new "Bedingung CAN-Botschaft SZM1 empfangen" UBYTE B_TRUE 1 100 0 1 BIT_MASK 0x10 FORMAT "%13.11" ECU_ADDRESS 0x403BFF /end MEASUREMENT
/begin MEASUREMENT B_tabunpl "Bedingung Abstellzeit unplausibel" UBYTE B_TRUE 1 100 0 1 BIT_MASK 0x1 FORMAT "%13.11" ECU_ADDRESS 0x3FC096 /end MEASUREMENT
/begin MEASUREMENT B_talcan "Bedingung Tank leer aus Kombi-Botschaft" UBYTE B_TRUE 1 100 0 1 BIT_MASK 0x2 FORMAT "%13.11" ECU_ADDRESS 0x3FE1A6 /end MEASUREMENT
/begin MEASUREMENT B_temxon "RL Begrenzung aktiv" UBYTE B_TRUE 1 100 0 1 BIT_MASK 0x1 FORMAT "%13.11" ECU_ADDRESS 0x3FC06D /end MEASUREMENT
/begin MEASUREMENT B_tidlegd "Bedingung ""Ausreichender Betrieb im LL f. Berechn. General Denominator"" erf¸llt" UBYTE B_TRUE 1 100 0 1 BIT_MASK 0x1 FORMAT "%13.11" ECU_ADDRESS 0x3FBEF1 /end MEASUREMENT
/begin MEASUREMENT B_timsa "Bedingung Integrator f¸r multip. Adaption freigegeben" UBYTE dez 1 100 0 255 FORMAT "%5.1" ECU_ADDRESS 0x402CB1 /end MEASUREMENT
/begin MEASUREMENT B_timsall "Bedingung Integrator f¸r additive Adaption freigegeben" UBYTE dez 1 100 0 255 FORMAT "%5.1" ECU_ADDRESS 0x402CB2 /end MEASUREMENT
/begin MEASUREMENT B_timsallv "Freigabe langsame Faktoradaption VVT" UBYTE dez 1 100 0 255 FORMAT "%5.1" ECU_ADDRESS 0x402CB3 /end MEASUREMENT
/begin MEASUREMENT B_timsavvt "Freigabe Aditiveadaption VVT" UBYTE dez 1 100 0 255 FORMAT "%5.1" ECU_ADDRESS 0x402CB4 /end MEASUREMENT
/begin MEASUREMENT B_timsvvt "Bedingung schneller Massenstromabgleich aktiv VVT Betrieb" UBYTE dez 1 100 0 255 FORMAT "%5.1" ECU_ADDRESS 0x402CB5 /end MEASUREMENT
/begin MEASUREMENT B_tmark "Bedingung Taste Aus f¸r die Zeit TMARK bet‰tigt" UBYTE B_TRUE 1 100 0 1 BIT_MASK 0x40 FORMAT "%13.11" ECU_ADDRESS 0x402C14 /end MEASUREMENT
/begin MEASUREMENT B_tmrkbli "Bedingung Triggerung Blinken der Markenanzeige" UBYTE B_TRUE 1 100 0 1 BIT_MASK 0x80 FORMAT "%13.11" ECU_ADDRESS 0x402C14 /end MEASUREMENT
/begin MEASUREMENT B_tns "Bedingung aus Schalter Tag-/Nachtbeleuchtung" UBYTE B_TRUE 1 100 0 1 BIT_MASK 0x20 FORMAT "%13.11" ECU_ADDRESS 0x402EFD /end MEASUREMENT
/begin MEASUREMENT B_ttripgd "Bedingung ""Ausreichende Fahrzeit f¸r Berechnung General Denominator"" erf¸llt" UBYTE B_TRUE 1 100 0 1 BIT_MASK 0x1 FORMAT "%13.11" ECU_ADDRESS 0x3FBEF2 /end MEASUREMENT
/begin MEASUREMENT B_tvfzgd "Bedingung ""Ausreichender Betrieb oberhalb VFZ-Limit f. Gen. Denominator"" erf¸llt" UBYTE B_TRUE 1 100 0 1 BIT_MASK 0x1 FORMAT "%13.11" ECU_ADDRESS 0x3FBEF3 /end MEASUREMENT
/begin MEASUREMENT B_twslpoff "Bedingung: Auschalten der Sekund‰rluftpumpe wegen zu hoher Wicklungstemperatur" UBYTE B_TRUE 1 100 0 1 BIT_MASK 0x1 FORMAT "%13.11" ECU_ADDRESS 0x3FC37D /end MEASUREMENT
/begin MEASUREMENT B_uhrrnpl "Bedingung Uhr mit relativem Minutenz‰hler unplausibel" UBYTE B_TRUE 1 100 0 1 BIT_MASK 0x2 FORMAT "%13.11" ECU_ADDRESS 0x3FE15C /end MEASUREMENT
/begin MEASUREMENT B_vziels "Bedingung ‹bernahme berechnete Zielgeschwindigkeit" UBYTE B_TRUE 1 100 0 1 BIT_MASK 0x1 FORMAT "%13.11" ECU_ADDRESS 0x3FC05C /end MEASUREMENT
/begin MEASUREMENT B_wdkhfu "Bdg: Berechnung  Winkels DK aus Signal des HF-Sensors ungedrosselt" UBYTE B_TRUE 1 100 0 1 FORMAT "%13.11" ECU_ADDRESS 0x40378B /end MEASUREMENT
/begin MEASUREMENT B_wk "Bedingung: Wandlerkupplung ¸berbr¸ckt" UBYTE B_TRUE 1 100 0 1 BIT_MASK 0x1 FORMAT "%13.11" ECU_ADDRESS 0x3FC137 /end MEASUREMENT
/begin MEASUREMENT B_wkr "Bedingung f¸r Wandlerkupplung geregelt" UBYTE B_TRUE 1 100 0 1 BIT_MASK 0x1 FORMAT "%13.11" ECU_ADDRESS 0x3FC138 /end MEASUREMENT
/begin MEASUREMENT caninsAusBitsNov1 "" UBYTE dez 1 100 0 255 FORMAT "%5.1" ECU_ADDRESS 0x3FE1A6 /end MEASUREMENT
/begin MEASUREMENT canzbl "Z‰hler f¸r Aus-/Ein-Schaltungen beim Blinken der Markenanzeige" UBYTE dez 1 100 0 255 FORMAT "%5.1" ECU_ADDRESS 0x402C19 /end MEASUREMENT
/begin MEASUREMENT cas1errct "" UBYTE dez 1 100 0 255 FORMAT "%5.1" ECU_ADDRESS 0x402EC7 /end MEASUREMENT
/begin MEASUREMENT chkcas1 "Checksumme f¸r Botschaft  Klemmenstatus" UBYTE dez 1 100 0 255 FORMAT "%5.1" ECU_ADDRESS 0x402EC8 /end MEASUREMENT
/begin MEASUREMENT chksafs1 "Checksumme f¸r Botschaft  Drehmomentanforderung AFS" UBYTE dez 1 100 0 255 FORMAT "%5.1" ECU_ADDRESS 0x402EBD /end MEASUREMENT
/begin MEASUREMENT chksszm1 "Checksumme f¸r CAN-Botschaft SZM1" UBYTE dez 1 100 0 255 FORMAT "%5.1" ECU_ADDRESS 0x402F24 /end MEASUREMENT
/begin MEASUREMENT chsdme1 "Checksumme der DME-Botschaft" UBYTE dez 1 100 0 255 FORMAT "%5.1" ECU_ADDRESS 0x403BF4 /end MEASUREMENT
/begin MEASUREMENT chsdme2 "Checksumme der DME-Botschaft" UBYTE dez 1 100 0 255 FORMAT "%5.1" ECU_ADDRESS 0x403BF5 /end MEASUREMENT
/begin MEASUREMENT chsdme3 "Checksumme der DME-Botschaft" UBYTE dez 1 100 0 255 FORMAT "%5.1" ECU_ADDRESS 0x403BF6 /end MEASUREMENT
/begin MEASUREMENT cntgd_w "Z‰hler ""General Denominator""" UWORD dez 1 100 0 65535 FORMAT "%8.2" ECU_ADDRESS 0x3FDEDC /end MEASUREMENT
/begin MEASUREMENT cnticy_w "Z‰hler ""Ignition Cycle Counter""" UWORD dez 1 100 0 65535 FORMAT "%8.2" ECU_ADDRESS 0x3FDEDE /end MEASUREMENT
/begin MEASUREMENT cntzd "Array Z‰hler Z-Flags, in dieser Fahrt inkrementiert" UBYTE dez 1 100 0 255 FORMAT "%5.1" ARRAY_SIZE 255 ECU_ADDRESS 0x4062E8 /end MEASUREMENT
/begin MEASUREMENT cntz_w "Array Z‰hler Z-Flags in einer Fahrt gesetzt" UWORD dez 1 100 0 65535 FORMAT "%8.2" ARRAY_SIZE 255 ECU_ADDRESS 0x3FCDEC /end MEASUREMENT
/begin MEASUREMENT codget "Automatische Erkennung HG / SSG / EGS - Variante" UBYTE dez 1 100 0 255 FORMAT "%5.1" ECU_ADDRESS 0x3FE1A5 /end MEASUREMENT
/begin MEASUREMENT ctblink "Zeitz‰hler f¸r Blinken der Markenanzeige" UBYTE t20msxs_ub_b5p1 1 100 0 5.1 FORMAT "%5.3" ECU_ADDRESS 0x402C1A /end MEASUREMENT
/begin MEASUREMENT ctrgenms "Generatorsollspannung vom Powermodul" UBYTE spg_gencan 1 100 10.6 16.975 FORMAT "%5.2" ECU_ADDRESS 0x402F20 /end MEASUREMENT
/begin MEASUREMENT dkatstat "Funktionsstatus DKATSP bei Anforderung Systemcheck" UBYTE DEZ 1 100 0 255 FORMAT "%5.1" ECU_ADDRESS 0x402A3C /end MEASUREMENT
/begin MEASUREMENT dkatstat2 "Funktionsstatus DKATSP Bank2 bei Anforderung Systemcheck" UBYTE DEZ 1 100 0 255 FORMAT "%5.1" ECU_ADDRESS 0x402A3D /end MEASUREMENT
/begin MEASUREMENT dkmsmszs "Ausgang aus KFDKMS" UWORD m_uw_b6553p5 1 100 0 6553.5 FORMAT "%8.3" ECU_ADDRESS 0x4044DE /end MEASUREMENT
/begin MEASUREMENT dltdpsff_w "" SWORD p_sw_q0p039 1 100 -1280 1279.96 FORMAT "%8.3" ECU_ADDRESS 0x40450C /end MEASUREMENT
/begin MEASUREMENT dltdpsf_w "Delta dps, nach Filterung" SWORD p_sw_q0p039 1 100 -1280 1279.96 FORMAT "%8.3" ECU_ADDRESS 0x40450E /end MEASUREMENT
/begin MEASUREMENT dltdps_w "Delta dps" SWORD p_sw_q0p039 1 100 -1280 1279.96 FORMAT "%8.3" ECU_ADDRESS 0x404510 /end MEASUREMENT
/begin MEASUREMENT dltrl_w "Delta rl_w, verbleibt im Saugroh" SWORD rel_sw_q0p0234 1 100 -768 767.977 FORMAT "%8.4" ECU_ADDRESS 0x404512 /end MEASUREMENT
/begin MEASUREMENT dlubbgl_w "Betrag Delta gefilterte Laufruhe Bankmittelwerte Bank1/Bank2" UWORD fak_sw_b8 1 100 0 15.9998 FORMAT "%8.5" ECU_ADDRESS 0x40308A /end MEASUREMENT
/begin MEASUREMENT dnmotas_w "Differenzdrehzahl ¸ber ein Arbeitsspiel" SWORD nmot_sw_q0p25 1 100 -8192 8191.75 FORMAT "%8.3" ECU_ADDRESS 0x403D9E /end MEASUREMENT
/begin MEASUREMENT dnmot_w "Differenzdrehzahl zwischen zwei folgenden Segmenten" SWORD nmot_sw_q0p25 1 100 -8192 8191.75 FORMAT "%8.3" ECU_ADDRESS 0x403DA0 /end MEASUREMENT
/begin MEASUREMENT dpipolmszs "Kennlinieninterpolation dp BGMSZS" UWORD fak_uw_b2 1 100 0 1.99997 FORMAT "%8.6" ECU_ADDRESS 0x4044E0 /end MEASUREMENT
/begin MEASUREMENT dpipol_aus "Kennlinieninterpolation dp BGMSZS aus" UWORD fak_uw_b2 1 100 0 1.99997 FORMAT "%8.6" ECU_ADDRESS 0x4044E2 /end MEASUREMENT
/begin MEASUREMENT dpipol_in "dpipolmszs umgerechnet f¸r Kennlinieninterpolation KLAF" UWORD fak_uw_q0p001 1 100 0 0.5 FORMAT "%9.7" ECU_ADDRESS 0x4044E4 /end MEASUREMENT
/begin MEASUREMENT dpipowdkhf "Kennlinieninterpolation aus dp f¸r BGWDKHF" UWORD fak_uw_b2 1 100 0 1.99997 FORMAT "%8.6" ECU_ADDRESS 0x4044C6 /end MEASUREMENT
/begin MEASUREMENT dpsbgms_w "Differenzdruck mit Massenstromabgleich" SWORD p_q0p039 1 100 -1280 1279.96 FORMAT "%8.3" ECU_ADDRESS 0x4044E6 /end MEASUREMENT
/begin MEASUREMENT dpsfak_w "normierter Faktor delta Saugrohrdruck" UWORD fuel_uw_b1 1 100 0 0.999985 FORMAT "%9.7" ECU_ADDRESS 0x404514 /end MEASUREMENT
/begin MEASUREMENT dpsfg_w "delta-Frischgaspartialdruck im Saugrohr" SWORD p_sw_q0p039 1 100 -1280 1279.96 FORMAT "%8.3" ECU_ADDRESS 0x403F78 /end MEASUREMENT
/begin MEASUREMENT dpsvbgms_w "Solldruckverhaeltnis vor Begrenzung" UWORD fak_uw_b2 1 100 0 1.99997 FORMAT "%8.6" ECU_ADDRESS 0x4044E8 /end MEASUREMENT
/begin MEASUREMENT dps_uw "Delta-Saugrohrdruck (unsigned word)" UWORD p_q0p039s32768 1 100 -1280 1279.96 FORMAT "%7.2" ECU_ADDRESS 0x404304 /end MEASUREMENT
/begin MEASUREMENT dpwdkhf_in "Eingang KL Interpolation f¸r BGWDKHF in Integer" UWORD fak_uw_q0p001 1 100 0 65.535 FORMAT "%8.5" ECU_ADDRESS 0x4044C8 /end MEASUREMENT
/begin MEASUREMENT dpwdkhf_w "Eingang KL Interpolation f¸r BGWDKHF" UWORD fak_uw_b2 1 100 0 0.999969 FORMAT "%9.7" ECU_ADDRESS 0x4044CA /end MEASUREMENT
/begin MEASUREMENT drlas_w "F¸llungs‰nderung pro Arbeitsspiel" SWORD relNWU_q0p0234 1 100 -768 767.977 FORMAT "%8.4" ECU_ADDRESS 0x403F5C /end MEASUREMENT
/begin MEASUREMENT drllad_w "Dynamikanteil der relativen F¸llung rl bei Laderdynamik" SWORD rel_sw_q0p0234 1 100 -768 767.977 FORMAT "%8.4" ECU_ADDRESS 0x403F34 /end MEASUREMENT
/begin MEASUREMENT drlp_w "delta-Einspritzberechnungs-Last aus Praediktion (Word)" SWORD rel_sw_q0p0234 1 100 -768 767.977 FORMAT "%8.4" ECU_ADDRESS 0x404516 /end MEASUREMENT
/begin MEASUREMENT drl_w "F¸llungs‰nderung (Word)" SWORD rel_sw_q0p0234 1 100 -768 767.977 FORMAT "%8.4" ECU_ADDRESS 0x403F7A /end MEASUREMENT
/begin MEASUREMENT dscstat "DSC-Status (CAN-Signal)" UBYTE dez 1 100 0 255 FORMAT "%5.1" ECU_ADDRESS 0x402ECC /end MEASUREMENT
/begin MEASUREMENT dtwslpum_w "Differenz zwischen Wicklungstemperatur der SLP und der SLP Umgebungstemperatur" SWORD temp_q0p0234 1 100 -768 767.977 FORMAT "%8.4" ECU_ADDRESS 0x40370A /end MEASUREMENT
/begin MEASUREMENT dvatv1_w "Geschwindigkeitsdelta f¸r Aufregelung der Differenz zwischen Tacho und Istgesch." SWORD vfzg_sw_q0p00781 1 100 -256 255.992 FORMAT "%8.4" ECU_ADDRESS 0x403F2A /end MEASUREMENT
/begin MEASUREMENT dvmark_w "Mindestabstand von Geschwindigkeitsmarken beim Stufentempomat" UWORD vfzg_uw_q0p0078125 1 100 0 511.992 FORMAT "%8.4" ECU_ADDRESS 0x402C06 /end MEASUREMENT
/begin MEASUREMENT dvprg_w "Schrittweite bei Anzeige der Regelgeschwindigkeit im Programmiermodus" UWORD vfzg_uw_q0p0078125 1 100 0.0078125 511.992 FORMAT "%8.4" ECU_ADDRESS 0x402C08 /end MEASUREMENT
/begin MEASUREMENT dvstutom_w "Schrittweite f¸r Verstellung der Zielgeschwindigkeit ohne programmierte Marken" UWORD vfzg_uw_q0p0078125 1 100 2 511.992 FORMAT "%8.4" ECU_ADDRESS 0x402C0A /end MEASUREMENT
/begin MEASUREMENT dv_lh "Radgeschwindigkeitsdifferenz links hinten" SWORD vfzg_uw_q0p0625 1 100 -2048 2047.94 FORMAT "%8.3" ECU_ADDRESS 0x403EF4 /end MEASUREMENT
/begin MEASUREMENT dv_lv "Radgeschwindigkeitsdifferenz links vorne" SWORD vfzg_uw_q0p0625 1 100 -2048 2047.94 FORMAT "%8.3" ECU_ADDRESS 0x403EF6 /end MEASUREMENT
/begin MEASUREMENT dv_rh "Radgeschwindigkeitsdifferenz rechts hinten" SWORD vfzg_uw_q0p0625 1 100 -2048 2047.94 FORMAT "%8.3" ECU_ADDRESS 0x403EF8 /end MEASUREMENT
/begin MEASUREMENT dv_rv "Radgeschwindigkeitsdifferenz rechts vorne" SWORD vfzg_uw_q0p0625 1 100 -2048 2047.94 FORMAT "%8.3" ECU_ADDRESS 0x403EFA /end MEASUREMENT
/begin MEASUREMENT ekpausc "CAN-Botschaft EKP-Abschaltung ¸ber Crash-Sensor Airbag-SG" UBYTE dez 1 100 0 3 FORMAT "%5.3" ECU_ADDRESS 0x402EFE /end MEASUREMENT
/begin MEASUREMENT errornn "vom Netz zu lernender Offset" FLOAT32_IEEE fak_r32_1 1 100 -3.40282e+024 3.40282e+024 FORMAT "%27.1" ECU_ADDRESS 0x3FAE5C /end MEASUREMENT
/begin MEASUREMENT evhubin2_w "Isthub aus Hubmodell Bank 2" UWORD hub_uw_q0p001 1 100 0 65.535 FORMAT "%8.5" ECU_ADDRESS 0x4044EA /end MEASUREMENT
/begin MEASUREMENT evhubin_w "Isthub aus Hubmodell" UWORD hub_uw_q0p001 1 100 0 65.535 FORMAT "%8.5" ECU_ADDRESS 0x4044EC /end MEASUREMENT
/begin MEASUREMENT evtmod "Einlaﬂventiltemperatur modelliert (Temperaturmodell)" UBYTE temp_ub_q0p75_o48 1 100 -48 143.25 FORMAT "%5.1" ECU_ADDRESS 0x402CCC /end MEASUREMENT
/begin MEASUREMENT faofwnkbgl "Von Tester vorgegebener Excenter Winkeloffset" SWORD wink_uw_q0p1 1 100 -3 3 FORMAT "%8.6" ECU_ADDRESS 0x3FE1D0 /end MEASUREMENT
/begin MEASUREMENT fdlubbgl_w "Differenz aus den Laufunruhen gefiltert" UWORD fak_sw_b8 1 100 0 15.9998 FORMAT "%8.5" ECU_ADDRESS 0x40308C /end MEASUREMENT
/begin MEASUREMENT fdpssrm_w "" UWORD p_sw_q0p039 1 100 0 2559.96 FORMAT "%8.3" ECU_ADDRESS 0x404518 /end MEASUREMENT
/begin MEASUREMENT ffrlhp "" UWORD fak_uw_b1 1 100 0 0.999985 FORMAT "%9.7" ECU_ADDRESS 0x40451A /end MEASUREMENT
/begin MEASUREMENT fkmsdka_w "Korrekturfaktor schneller Massenstromausgleich" UWORD fak_uw_b4 1 100 0 3.99994 FORMAT "%8.6" ECU_ADDRESS 0x3FE0EC /end MEASUREMENT
/begin MEASUREMENT fkmsdks_w "Korrekturfaktor schneller Massenstromabgleich" UWORD fak_uw_b4 1 100 0 3.99994 FORMAT "%8.6" ECU_ADDRESS 0x3FE0EE /end MEASUREMENT
/begin MEASUREMENT fkmsdk_w "Korrekturfaktor Massenstrom Nebenf¸llungssignal" UWORD fak_uw_b4 1 100 0 3.99994 FORMAT "%8.6" ECU_ADDRESS 0x3FE0F0 /end MEASUREMENT
/begin MEASUREMENT fkmsvvta_w "Faktor Massenstromabgleich langsam VVT" UWORD fak_uw_b4 1 100 0 3.99994 FORMAT "%8.6" ECU_ADDRESS 0x3FE0F2 /end MEASUREMENT
/begin MEASUREMENT fkmsvvts_w "Faktor Massenstromabgleich schnell VVT" UWORD fak_uw_b4 1 100 0 3.99994 FORMAT "%8.6" ECU_ADDRESS 0x3FE0F4 /end MEASUREMENT
/begin MEASUREMENT fkmsvvt_w "Faktor Massenstromabgleich gesamt VVT" UWORD fak_uw_b4 1 100 0 3.99994 FORMAT "%8.6" ECU_ADDRESS 0x3FE0F6 /end MEASUREMENT
/begin MEASUREMENT flub1_w "Mittelwert Laufunruhe gefiltert Bank1" SWORD fak_sw_b8 1 100 -8 7.99976 FORMAT "%8.6" ECU_ADDRESS 0x40308E /end MEASUREMENT
/begin MEASUREMENT flub2_w "Mittelwert Laufunruhe gefiltert Bank2" SWORD fak_sw_b8 1 100 -8 7.99976 FORMAT "%8.6" ECU_ADDRESS 0x403090 /end MEASUREMENT
/begin MEASUREMENT fmtate_w "Berechnung der Blendenˆffnung ¸ber Tastverh‰ltnis" UWORD fak_uw_b1 1 100 0 0.999985 FORMAT "%9.7" ECU_ADDRESS 0x404306 /end MEASUREMENT
/begin MEASUREMENT fmtev_w "Faktor Massenstrom durch TEV" UWORD fak_uw_b1 1 100 0 0.999985 FORMAT "%9.7" ECU_ADDRESS 0x404308 /end MEASUREMENT
/begin MEASUREMENT fpvdk "Korrekturfaktor Druck vor Drosselklappe" UBYTE fak_ub_b4 1 100 0 3.98438 FORMAT "%5.3" ECU_ADDRESS 0x403BB8 /end MEASUREMENT
/begin MEASUREMENT fpvdk_w "Korrekturfaktor Druck vor Drosselklappe 16-Bit" UWORD fak_uw_b4 1 100 0 3.99994 FORMAT "%8.6" ECU_ADDRESS 0x403F36 /end MEASUREMENT
/begin MEASUREMENT fqtebgl_w "Gefilterter Quotient Einspritzzeitverh‰ltniss Bank1/Bank2" UWORD fak_uw_b2 1 100 0 1.99997 FORMAT "%8.6" ECU_ADDRESS 0x403092 /end MEASUREMENT
/begin MEASUREMENT frhodk_w "Faktor Luftdichtekorrektur f¸r DK-Durchfluﬂ f(Ansauglufttemp.,Hˆhe) 16 Bit" UWORD fak_uw_b2 1 100 0 1.99997 FORMAT "%8.6" ECU_ADDRESS 0x403F38 /end MEASUREMENT
/begin MEASUREMENT fsttankl "F¸llstand der linken Tankh‰lfte" UBYTE fuel_ub_q0p5 1 100 0 127.5 FORMAT "%5.1" ECU_ADDRESS 0x402EFF /end MEASUREMENT
/begin MEASUREMENT fsttankr "F¸llstand der rechten Tankh‰lfte" UBYTE fuel_ub_q0p5 1 100 0 127.5 FORMAT "%5.1" ECU_ADDRESS 0x402F00 /end MEASUREMENT
/begin MEASUREMENT fsttankrf "F¸llstand der rechten Tankh‰lfte gefiltert" UBYTE fuel_ub_q0p5 1 100 0 127.5 FORMAT "%5.1" ECU_ADDRESS 0x403710 /end MEASUREMENT
/begin MEASUREMENT ftbr "Faktor Temperaturkorrektur im Brennraum" UBYTE fak_ub_b2 1 100 0 1.99219 FORMAT "%5.3" ECU_ADDRESS 0x402CCD /end MEASUREMENT
/begin MEASUREMENT ftbr_w "Faktor Temperaturkorrektur im Brennraum" UWORD fak_uw_b2 1 100 0 1.99997 FORMAT "%8.6" ECU_ADDRESS 0x402CD2 /end MEASUREMENT
/begin MEASUREMENT ftsr "Korrekturfaktor Lufttemperatur im Saugrohr" UBYTE fak_ub_b2 1 100 0 1.99219 FORMAT "%5.3" ECU_ADDRESS 0x403BBB /end MEASUREMENT
/begin MEASUREMENT ftu "Faktor Temperatur Umgebung" UBYTE fak_ub_b2 1 100 0 1.99219 FORMAT "%5.3" ECU_ADDRESS 0x402CCE /end MEASUREMENT
/begin MEASUREMENT ftvdk "Korrekturfaktor Temperatur vor Drosselklappe" UBYTE fak_ub_b2 1 100 0 1.99219 FORMAT "%5.3" ECU_ADDRESS 0x403BBC /end MEASUREMENT
/begin MEASUREMENT ftw "Faktor Temperaturgewichtung tmot, tans" UBYTE fak_ub_b1 1 100 0 0.996094 ECU_ADDRESS 0x402CCF /end MEASUREMENT
/begin MEASUREMENT fupsrl_w "Faktor systembezogene Umrechnung Druck auf F¸llung (16-Bit)" UWORD rel_uw_b0p3 1 100 0 0.299995 FORMAT "%9.7" ECU_ADDRESS 0x403F7C /end MEASUREMENT
/begin MEASUREMENT fvisrmst_w "" UWORD p_uw_b32 1 100 0 31.9995 FORMAT "%8.5" ECU_ADDRESS 0x403F7E /end MEASUREMENT
/begin MEASUREMENT fvisrm_w "Faktor Verst‰rkung Integrator Saugrohrmodell" UWORD p_uw_b32 1 100 0 31.9995 FORMAT "%8.5" ECU_ADDRESS 0x403F80 /end MEASUREMENT
/begin MEASUREMENT gangauti "bei Automatikgetriebe ¸ber CAN empfangener aktueller Gang" UBYTE dez 1 100 0 255 FORMAT "%5.1" ECU_ADDRESS 0x403915 /end MEASUREMENT
/begin MEASUREMENT idbosrst "ID BOS-Reset" UBYTE dez 1 100 0 255 FORMAT "%5.1" ECU_ADDRESS 0x402F01 /end MEASUREMENT
/begin MEASUREMENT idfbosrt_w "ID Funktion-BOS-Reset" UWORD dez 1 100 0 65535 FORMAT "%8.2" ECU_ADDRESS 0x402EE8 /end MEASUREMENT
/begin MEASUREMENT ikurz_ogr "Obere Grenze Kurzschlussstrom vom CAS" UBYTE i_ub_q10p0 1 100 0 2550 FORMAT "%5.0" ECU_ADDRESS 0x3FE1AB /end MEASUREMENT
/begin MEASUREMENT ikurz_ugr "Untere Grenze Kurzschlussstrom vom CAS" UBYTE i_ub_q10p0 1 100 0 2550 FORMAT "%5.0" ECU_ADDRESS 0x3FE1AC /end MEASUREMENT
/begin MEASUREMENT indxmmimrk "Index der ‹bertragenen MMI-Botschaft zur Bef¸llung der Zielgeschwi. ins Array" UBYTE dez 1 100 0 255 FORMAT "%5.1" ECU_ADDRESS 0x402F25 /end MEASUREMENT
/begin MEASUREMENT irspsyn "Index f¸r Ringspeicheradressierung tsegrsp_w, nmotrsp_w, rlrsp_w" UBYTE dez 1 100 0 255 FORMAT "%5.1" ECU_ADDRESS 0x403B31 /end MEASUREMENT
/begin MEASUREMENT irspsynold "Ein  Arbeitsspiel alter Index f¸r die Ringspeicheradressierung" UBYTE dez 1 100 0 255 FORMAT "%5.1" ECU_ADDRESS 0x403B32 /end MEASUREMENT
/begin MEASUREMENT iwakeupgr "Fahrzeugspezifischer Ruhestrom" UBYTE i_ub_q0p02 1 100 0 5.1 FORMAT "%7.5" ECU_ADDRESS 0x3FE1AD /end MEASUREMENT
/begin MEASUREMENT kmstand "Fahrstrecke des Fahrzeugs als Information ¸ber CAN" UWORD km_uw_q10 1 100 0 655350 FORMAT "%8.1" ECU_ADDRESS 0x402EEA /end MEASUREMENT
/begin MEASUREMENT kmstfsp_w "Umweltbedingung Kilometerstand f¸r Fehlerspeichereintrag" UWORD s_q8_km 1 100 0 524280 FORMAT "%8.1" ECU_ADDRESS 0x402EEC /end MEASUREMENT
/begin MEASUREMENT kmstold_w "Kilometerstand aus letztem Driving Cycle" UWORD km_uw_q10 1 100 0 655350 FORMAT "%8.1" ECU_ADDRESS 0x3FE1A8 /end MEASUREMENT
/begin MEASUREMENT lambrinv_w "invertiertes Lambda-Brennraum (rk_w/rl_w)" UWORD fak_uw_b16 1 100 0 15.9998 FORMAT "%8.5" ECU_ADDRESS 0x403718 /end MEASUREMENT
/begin MEASUREMENT lb_nll "Anforderung Leerlaufdrehzahlerhˆhung" UBYTE B_TRUE 1 100 0 1 BIT_MASK 0x40 FORMAT "%13.11" ECU_ADDRESS 0x402EFD /end MEASUREMENT
/begin MEASUREMENT lb_usoll "Regelspannungsvorgabe f¸r Generator" UBYTE spg_q0p1_o10p6 1 100 10.6 36.1 FORMAT "%5.2" ECU_ADDRESS 0x402F02 /end MEASUREMENT
/begin MEASUREMENT lws_w "Lenkwinkel" SWORD lws_q0p04375 1 100 -1433.6 1433.56 FORMAT "%8.3" ECU_ADDRESS 0x402EDA /end MEASUREMENT
/begin MEASUREMENT mdarsi "Delta-Ist-Moment ARS (CAN)" UBYTE md_q0p5 1 100 0 127.5 FORMAT "%5.1" ECU_ADDRESS 0x403912 /end MEASUREMENT
/begin MEASUREMENT mdarss "Delta-Soll-Moment ARS bei Solldruck" UBYTE md_q0p5 1 100 0 127.5 FORMAT "%5.1" ECU_ADDRESS 0x403913 /end MEASUREMENT
/begin MEASUREMENT mdkog "Momentenaufnahme geregelter Klimakompressor" UBYTE md_ub_q1 1 100 0 255 FORMAT "%5.1" ECU_ADDRESS 0x402F03 /end MEASUREMENT
/begin MEASUREMENT mdwanc "Drehmomentaufnahme des Wandlers ¸ber CAN" UBYTE rel_ub_b99p6 1 100 0 99.6094 FORMAT "%5.2" ECU_ADDRESS 0x403916 /end MEASUREMENT
/begin MEASUREMENT migs "Indiziertes Soll-Motormoment GS f¸r schnellen Eingriff" UBYTE rel_ub_b99p6 1 100 0 99.6094 FORMAT "%5.2" ECU_ADDRESS 0x403917 /end MEASUREMENT
/begin MEASUREMENT migslm "Indiziertes Soll-Motormoment GS f¸r langsamen Eingriff" UBYTE rel_ub_b99p6 1 100 0 99.6094 FORMAT "%5.2" ECU_ADDRESS 0x403918 /end MEASUREMENT
/begin MEASUREMENT miistc "indiziertes Motormoment Hochdruckphase Istwert f¸r Ausgabe auf CAN-Bus" UBYTE rel_ub_b100 1 100 0 99.6094 FORMAT "%5.2" ECU_ADDRESS 0x403BF7 /end MEASUREMENT
/begin MEASUREMENT mkiafs_w "AFS-Kupplungsmoment Istwert" SWORD md_q0p5 1 100 -16384 16383.5 FORMAT "%8.2" ECU_ADDRESS 0x402EC2 /end MEASUREMENT
/begin MEASUREMENT mksafs_w "angefordertes Kupplungsmoment vom AFS" SWORD md_q0p5 1 100 -16384 16383.5 FORMAT "%8.2" ECU_ADDRESS 0x402EC4 /end MEASUREMENT
/begin MEASUREMENT ml "Luftmassenfluﬂ" UBYTE m_ub_b1020 1 100 0 1020 FORMAT "%5.0" ECU_ADDRESS 0x3FC3A9 /end MEASUREMENT
/begin MEASUREMENT mlsolkori "rlvwvvti rueckwaerts aus Modell umgerechnet" UWORD m_uw_b1638p4 1 100 0 1638.38 FORMAT "%8.3" ECU_ADDRESS 0x4044EE /end MEASUREMENT
/begin MEASUREMENT mlwdknshf "normierter Luftmassenstrom f¸r DK-Winkel aus HFM-Signal" UWORD m_uw_b6553p5 1 100 0 6553.5 FORMAT "%8.3" ECU_ADDRESS 0x4044CC /end MEASUREMENT
/begin MEASUREMENT ml_w "Luftmassenfluﬂ gefiltert (Word)" UWORD m_uw_b6553p5 1 100 0 6553.5 FORMAT "%8.3" ECU_ADDRESS 0x3FC3F8 /end MEASUREMENT
/begin MEASUREMENT mmimrk_w "Geschwindigkeits-Marken vom MMI (Array)" UWORD vfzg_uw_b512 1 100 0 511.992 FORMAT "%8.4" ARRAY_SIZE 9 ECU_ADDRESS 0x402F2C /end MEASUREMENT
/begin MEASUREMENT mrknrc "Nummer ver‰nderte Geschwindigkeits-Marke f¸r schnelle CAN-‹bertragung" UBYTE dez 1 100 0 255 FORMAT "%5.1" ECU_ADDRESS 0x402C1B /end MEASUREMENT
/begin MEASUREMENT mrknrcan "Nummer Geschwindigkeits-Marken Stufentempomat f¸r CAN-‹bertragung" UBYTE dez 1 100 0 255 FORMAT "%5.1" ARRAY_SIZE 15 ECU_ADDRESS 0x402C1C /end MEASUREMENT
/begin MEASUREMENT mrknrint "Nummer Geschwindigkeits-Marken Stufentempomat intern" UBYTE dez 1 100 0 255 FORMAT "%5.1" ARRAY_SIZE 15 ECU_ADDRESS 0x402C2B /end MEASUREMENT
/begin MEASUREMENT mrkstut_w "Geschwindigkeits-Marken Stufentempomat" UWORD vfzg_uw_q0p0078125 1 100 0 511.992 FORMAT "%8.4" ARRAY_SIZE 15 ECU_ADDRESS 0x3FE0C0 /end MEASUREMENT
/begin MEASUREMENT msdif_w "Massenstromdifferenz mshfm_w - msdk_w" SWORD m_sw_q0p1 1 100 -3276.8 3276.7 FORMAT "%8.3" ECU_ADDRESS 0x403F3A /end MEASUREMENT
/begin MEASUREMENT msdkalm_w "Massenstrom ¸ber Drosselklappe (abgeglichen mit HFM Signal)" UWORD m_uw_b6553p5 1 100 0 6553.5 FORMAT "%8.3" ECU_ADDRESS 0x403F3C /end MEASUREMENT
/begin MEASUREMENT msdkroh_w "" UWORD m_uw_b6553p5 1 100 0 6553.5 FORMAT "%8.3" ECU_ADDRESS 0x403F3E /end MEASUREMENT
/begin MEASUREMENT msdk_w "Massenstrom ¸ber Drosselklappe" UWORD m_uw_b6553p5 1 100 0 6553.5 FORMAT "%8.3" ECU_ADDRESS 0x403F40 /end MEASUREMENT
/begin MEASUREMENT mshfmad "Luftmassenstrom korrigert f¸r Berechnung DK-Winkel aus HFM-Signal" UWORD m_uw_b6553p5 1 100 0 6553.5 FORMAT "%8.3" ECU_ADDRESS 0x4044CE /end MEASUREMENT
/begin MEASUREMENT mskorb_w "normierte Luftmasse aus Isthub incl. Massenstromabgleich" SWORD m_uw_b1638p4 1 100 -819.2 819.175 FORMAT "%8.4" ECU_ADDRESS 0x4044F0 /end MEASUREMENT
/begin MEASUREMENT msndko_w "normierter Leckluftmassenstrom ¸ber Drosselklappe (word)" SWORD m_uw_b6553p5 1 100 -3276.8 3276.7 FORMAT "%8.3" ECU_ADDRESS 0x3FE0F8 /end MEASUREMENT
/begin MEASUREMENT msndk_w "normierter Massenstrom ¸ber Drosselklappe (word)" UWORD m_uw_b6553p5 1 100 0 6553.5 FORMAT "%8.3" ECU_ADDRESS 0x403F42 /end MEASUREMENT
/begin MEASUREMENT msntevo_w "normierter, ¸berkritischer Massenstrom durch das 100% offene TEV" UWORD m_uw_b25p6 1 100 0 25.5996 FORMAT "%8.5" ECU_ADDRESS 0x4035DA /end MEASUREMENT
/begin MEASUREMENT msnvvtdnn "" SWORD m_uw_b6553p5 1 100 -3276.8 3276.7 FORMAT "%8.3" ECU_ADDRESS 0x4044F6 /end MEASUREMENT
/begin MEASUREMENT msnvvtoll "Massestrom von KIMSALL-Integrator + MSLG" SWORD m_uw_b6553p5 1 100 -3276.8 3276.7 FORMAT "%8.3" ECU_ADDRESS 0x3FE0FA /end MEASUREMENT
/begin MEASUREMENT msnvvtonn "Temperaturabh‰ngiger Offset Massenstrombagleich" SWORD m_uw_b6553p5 1 100 -3276.8 3276.7 FORMAT "%8.3" ECU_ADDRESS 0x4044F8 /end MEASUREMENT
/begin MEASUREMENT msnvvtonns "" SWORD m_uw_b6553p5 1 100 -3276.8 3276.7 FORMAT "%8.3" ECU_ADDRESS 0x4044FA /end MEASUREMENT
/begin MEASUREMENT msnvvto_w "gelerner Massenstromoffset ungedrosselt" SWORD m_uw_b6553p5 1 100 -3276.8 3276.7 FORMAT "%8.3" ECU_ADDRESS 0x3FE0FC /end MEASUREMENT
/begin MEASUREMENT msspkorr_w "" UWORD m_uw_b6553p5 1 100 0 6553.5 FORMAT "%8.3" ECU_ADDRESS 0x4044F2 /end MEASUREMENT
/begin MEASUREMENT mss_w "Massenstrom vom Sensor (Auswahl zwischen mshfm_w und ml_w)" UWORD m_uw_b6553p5 1 100 0 6553.5 FORMAT "%8.3" ECU_ADDRESS 0x403F44 /end MEASUREMENT
/begin MEASUREMENT mste "Massenstrom Tankentl¸ftung ins Saugrohr" UBYTE m_ub_b25p6 1 100 0 25.5 FORMAT "%5.2" ECU_ADDRESS 0x3FC3D8 /end MEASUREMENT
/begin MEASUREMENT mstedp_w "Normierter Massenstrom durch das TEV mit Zeitverhalten" UWORD m_uw_b25p6 1 100 0 25.5996 FORMAT "%8.5" ECU_ADDRESS 0x40430A /end MEASUREMENT
/begin MEASUREMENT mstedte "Massenstrom TEV f¸r DTEV" UBYTE m_ub_b25p6 1 100 0 25.5 FORMAT "%5.2" ECU_ADDRESS 0x403D0D /end MEASUREMENT
/begin MEASUREMENT mstedte_w "Massenstrom TEV f¸r DTEV (Word)" UWORD m_uw_b25p6 1 100 0 25.5996 FORMAT "%8.5" ECU_ADDRESS 0x40430C /end MEASUREMENT
/begin MEASUREMENT msteo_w "Massenstom durch das 100% offene TEV" UWORD m_uw_b25p6 1 100 0 25.5996 FORMAT "%8.5" ECU_ADDRESS 0x40430E /end MEASUREMENT
/begin MEASUREMENT mste_w "Massenstrom Tankentl¸ftung in das Saugrohr" UWORD m_uw_b25p6 1 100 0 25.5996 FORMAT "%8.5" ECU_ADDRESS 0x404310 /end MEASUREMENT
/begin MEASUREMENT mszsst "" UBYTE dez 1 100 0 255 FORMAT "%5.1" ECU_ADDRESS 0x402CB6 /end MEASUREMENT
/begin MEASUREMENT ngas_w "Drehzahlgradient ¸ber ein Arbeitsspiel" SWORD nmotg_sw_q0p39 1 100 -12800.2 12799.8 FORMAT "%8.2" ECU_ADDRESS 0x403DA2 /end MEASUREMENT
/begin MEASUREMENT ngfil "gefilterter Drehzahlgradient" SBYTE nmotg_sb_q100 1 100 -12800 12700 FORMAT "%5.0" ECU_ADDRESS 0x403B33 /end MEASUREMENT
/begin MEASUREMENT ngfil_w "gefilterter Drehzahlgradient" SWORD nmotg_sw_q0p39 1 100 -12800.2 12799.8 FORMAT "%8.2" ECU_ADDRESS 0x403DA4 /end MEASUREMENT
/begin MEASUREMENT nmaxssg_w "Max. Motordrehzahl w‰hrend der zweiten Phase des Schaltvorgangs" UWORD nmot_uw_q0p25 1 100 0 16383.8 FORMAT "%8.2" ECU_ADDRESS 0x40467E /end MEASUREMENT
/begin MEASUREMENT nmn10msctr "Z‰hler 10 ms Raster ohne Zahninterrupt" UBYTE dez 1 100 0 255 FORMAT "%5.1" ECU_ADDRESS 0x403891 /end MEASUREMENT
/begin MEASUREMENT nmot "Motordrehzahl" UBYTE nmot_ub_q40 1 100 0 10000 FORMAT "%5.0" ECU_ADDRESS 0x40388D /end MEASUREMENT
/begin MEASUREMENT nmotarr_w "Ringspeicher f¸r Drehzahlen" UWORD nmot_uw_q0p25 1 100 0 16383.8 FORMAT "%8.2" ARRAY_SIZE 10 ECU_ADDRESS 0x404422 /end MEASUREMENT
/begin MEASUREMENT nmotas_w "Motordrehzahl von 2 Umdrehungen (1 Arbeitsspiel) zuvor" UWORD nmot_uw_q0p25 1 100 0 16383.8 FORMAT "%8.2" ECU_ADDRESS 0x403DA6 /end MEASUREMENT
/begin MEASUREMENT nmotll "Motordrehzahl im Leerlaufbereich" UBYTE nmot_ub_q10 1 100 0 2550 FORMAT "%5.0" ECU_ADDRESS 0x40388E /end MEASUREMENT
/begin MEASUREMENT nmotllfil "Gefilterte Drehzahl nmotll" UBYTE nmot_ub_q10 1 100 0 2550 FORMAT "%5.0" ECU_ADDRESS 0x40388F /end MEASUREMENT
/begin MEASUREMENT nmotz "Motordrehzahl aus Zahnzeit im Start" UBYTE nmot_ub_q10 1 100 0 2550 FORMAT "%5.0" ECU_ADDRESS 0x403890 /end MEASUREMENT
/begin MEASUREMENT nmot_f "Motordrehzahl" FLOAT32_IEEE fak_r32_1 1 100 0 10000 FORMAT "%27.21" ECU_ADDRESS 0x3FACC0 /end MEASUREMENT
/begin MEASUREMENT nmot_w "Motordrehzahl" UWORD nmot_uw_q0p25 1 100 0 10000 FORMAT "%8.2" ECU_ADDRESS 0x404438 /end MEASUREMENT
/begin MEASUREMENT nn_w1 "Lineare Netzparameter" FLOAT32_IEEE fak_r32_1 1 100 -3.40282e+024 3.40282e+024 FORMAT "%27.1" ARRAY_SIZE 3 ECU_ADDRESS 0x3FE120 /end MEASUREMENT
/begin MEASUREMENT nn_w2 "Offset Netzparameter" FLOAT32_IEEE fak_r32_1 1 100 -3.40282e+024 3.40282e+024 FORMAT "%27.1" ARRAY_SIZE 3 ECU_ADDRESS 0x3FE12C /end MEASUREMENT
/begin MEASUREMENT nturbc_w "Wandler-Turbinendrehzahl ¸ber CAN" UWORD nmot_q0p125 1 100 0 8191.88 FORMAT "%8.3" ECU_ADDRESS 0x404680 /end MEASUREMENT
/begin MEASUREMENT n_idlms "Leerlaufdrehzahlanhebung von Powermodul" UBYTE dez 1 100 0 255 FORMAT "%5.1" ECU_ADDRESS 0x402F21 /end MEASUREMENT
/begin MEASUREMENT obdstegs "aus CAN-Signal OBD_STAT_GS aufbereitete Grˆﬂe f¸r ME" UBYTE dez 1 100 0 255 FORMAT "%5.1" ECU_ADDRESS 0x403919 /end MEASUREMENT
/begin MEASUREMENT offakdps "" UWORD fak_uw_b025o32768 1 100 -0.125 0.124996 FORMAT "%9.7" ECU_ADDRESS 0x404312 /end MEASUREMENT
/begin MEASUREMENT ofwnkadbg "Adaption Excenterwinkel" SWORD wink_uw_q0p1 1 100 -3276.8 3276.7 FORMAT "%8.3" ARRAY_SIZE 7 ECU_ADDRESS 0x3FE1D2 /end MEASUREMENT
/begin MEASUREMENT ofwnkbg "Offset VVT-Excenterwinkel" SWORD wink_uw_q0p1 1 100 -3276.8 3276.7 FORMAT "%8.3" ECU_ADDRESS 0x403094 /end MEASUREMENT
/begin MEASUREMENT ofwnkbg1 "Offset VVT-Exzenterwinkel f¸r Bank1 durch Bankabgleich" UWORD wink_uw_q0p1 1 100 0 6553.5 FORMAT "%8.3" ECU_ADDRESS 0x403096 /end MEASUREMENT
/begin MEASUREMENT ofwnkbg2 "Offset VVT-Exzenterwinkel f¸r Bank2 durch Bankabgleich" UWORD wink_uw_q0p1 1 100 0 6553.5 FORMAT "%8.3" ECU_ADDRESS 0x403098 /end MEASUREMENT
/begin MEASUREMENT ofwnkbg_temp "" SWORD wink_uw_q0p1 1 100 -3276.8 3276.7 FORMAT "%8.3" ECU_ADDRESS 0x40309A /end MEASUREMENT
/begin MEASUREMENT pa2_w "Abgasgegendruck Bank 2" UWORD p_uw_q0p039 1 100 0 2559.96 FORMAT "%8.3" ECU_ADDRESS 0x402A2C /end MEASUREMENT
/begin MEASUREMENT pabvhk2_w "Abgasgegendruck vor Hauptkat (Bank2)" UWORD p_uw_q0p039 1 100 0 2559.96 FORMAT "%8.3" ECU_ADDRESS 0x402A2E /end MEASUREMENT
/begin MEASUREMENT pabvhk_w "Abgasgegendruck vor Hauptkat" UWORD p_uw_q0p039 1 100 0 2559.96 FORMAT "%8.3" ECU_ADDRESS 0x402A30 /end MEASUREMENT
/begin MEASUREMENT pabvtl2_w "Abgasgegendruck vor Turbolader Bank 2" UWORD p_uw_q0p039 1 100 0 2559.96 FORMAT "%8.3" ECU_ADDRESS 0x402A32 /end MEASUREMENT
/begin MEASUREMENT pabvtl_w "Abgasgegendruck vor Turbolader" UWORD p_uw_q0p039 1 100 0 2559.96 FORMAT "%8.3" ECU_ADDRESS 0x402A34 /end MEASUREMENT
/begin MEASUREMENT pabvvk2_w "Abgasgegendruck vor Vorkat (Bank2)" UWORD p_uw_q0p039 1 100 0 2559.96 FORMAT "%8.3" ECU_ADDRESS 0x402A36 /end MEASUREMENT
/begin MEASUREMENT pabvvk_w "Abgasgegendruck vor Vorkat" UWORD p_uw_q0p039 1 100 0 2559.96 FORMAT "%8.3" ECU_ADDRESS 0x402A38 /end MEASUREMENT
/begin MEASUREMENT pa_w "Absolutdruck Abgassystem" UWORD p_uw_q0p039 1 100 0 2559.96 FORMAT "%8.3" ECU_ADDRESS 0x402A3A /end MEASUREMENT
/begin MEASUREMENT pbrems "aktueller Bremsdruck" UBYTE dez 1 100 0 255 FORMAT "%5.1" ECU_ADDRESS 0x402ECD /end MEASUREMENT
/begin MEASUREMENT pirgro_w "Rohwert Partialdruck Restgas internes AGR" UWORD p_uw_q0p039 1 100 0 2559.96 FORMAT "%8.3" ECU_ADDRESS 0x403F82 /end MEASUREMENT
/begin MEASUREMENT pirg_w "Partialdruck Restgas interne AGR (16-Bit)" UWORD p_uw_q0p039 1 100 0 2559.96 FORMAT "%8.3" ECU_ADDRESS 0x403F84 /end MEASUREMENT
/begin MEASUREMENT pmanzsvein "Anzahl angemeldeter Standverbraucher PWM" UBYTE dez 1 100 0 255 FORMAT "%5.1" ECU_ADDRESS 0x3FE1AE /end MEASUREMENT
/begin MEASUREMENT pmsv "Angemeldete Powermangment Standverbraucher" UBYTE dez 1 100 0 255 FORMAT "%5.1" ARRAY_SIZE 15 ECU_ADDRESS 0x3FE1AF /end MEASUREMENT
/begin MEASUREMENT psfg_w "Frischgaspartialdruck im Saugrohr (word)" UWORD p_uw_q0p039 1 100 0 2559.96 FORMAT "%8.3" ECU_ADDRESS 0x403F86 /end MEASUREMENT
/begin MEASUREMENT psmx_w "Saugrohrmaximaldruckbegrenzung f¸r modellierten Saugrohrdruck" UWORD p_uw_q0p039 1 100 0 2559.96 FORMAT "%8.3" ECU_ADDRESS 0x403F88 /end MEASUREMENT
/begin MEASUREMENT pspvdb_w "Quotient Saugrohrduck/Druck vor DK begrenzt (word)" UWORD fak_uw_b2 1 100 0 1.99997 FORMAT "%8.6" ECU_ADDRESS 0x403F46 /end MEASUREMENT
/begin MEASUREMENT pspvdkugn_w "" UWORD fak_uw_b2 1 100 0 1.99997 FORMAT "%8.6" ECU_ADDRESS 0x403F48 /end MEASUREMENT
/begin MEASUREMENT pspvdk_w "Quotient Saugrohrdruck/Druck vor Drosselklappe (word)" UWORD fak_uw_b2 1 100 0 1.99997 FORMAT "%8.6" ECU_ADDRESS 0x403F4A /end MEASUREMENT
/begin MEASUREMENT psrlro_w "Rohwert f¸r Faktor systembezogene Umrechnung Druck auf F¸llung" UWORD rel_uw_b0p3 1 100 0 0.299995 FORMAT "%9.7" ECU_ADDRESS 0x403F8A /end MEASUREMENT
/begin MEASUREMENT ps_w "Saugrohr-Absolutdruck (Word)" UWORD p_uw_q0p039 1 100 0 2559.96 FORMAT "%8.3" ECU_ADDRESS 0x3FC3FA /end MEASUREMENT
/begin MEASUREMENT pvdk "Druck vor Drosselklappe" UBYTE p_ub_q10 1 100 0 2550 FORMAT "%5.0" ECU_ADDRESS 0x403BB9 /end MEASUREMENT
/begin MEASUREMENT pvdk_w "Druck vor Drosselklappe 16-Bit" UWORD p_uw_q0p039 1 100 0 2559.96 FORMAT "%8.3" ECU_ADDRESS 0x403F4C /end MEASUREMENT
/begin MEASUREMENT qtebgl_w "Quotient Einspritzzeitverh‰ltniss Bank1/Bank2" UWORD fak_uw_b2 1 100 0 1.99997 FORMAT "%8.6" ECU_ADDRESS 0x40309C /end MEASUREMENT
/begin MEASUREMENT rfagr_w "relative F¸llung AGR (word)" UWORD rel_uw_q0p0234 1 100 0 1535.98 FORMAT "%8.3" ECU_ADDRESS 0x403F8C /end MEASUREMENT
/begin MEASUREMENT rfges_w "gesamte relative F¸llung (inclusive AGR) 16-Bit" UWORD rel_uw_q0p0234 1 100 0 1535.98 FORMAT "%8.3" ECU_ADDRESS 0x403F8E /end MEASUREMENT
/begin MEASUREMENT rgmdps "Korrekturfaktor fuer Differenzdruck" UBYTE rgfak_ub_q0p00000037 1 100 0 9.49951e-005 FORMAT "%10.8" ECU_ADDRESS 0x4038CC /end MEASUREMENT
/begin MEASUREMENT rgmn "" UBYTE fak_ub_b2 1 100 0 1.99219 FORMAT "%5.3" ECU_ADDRESS 0x4038CD /end MEASUREMENT
/begin MEASUREMENT rgmof "Offset-Korrektur fuer Drehzahl" UBYTE fak_ub_b2 1 100 0 1.99219 FORMAT "%5.3" ECU_ADDRESS 0x4038CE /end MEASUREMENT
/begin MEASUREMENT rg_avs2_w "Restgasanteil aus Auslassspreizung Bank 2" UWORD fak_uw_b1 1 100 0 0.999985 FORMAT "%9.7" ECU_ADDRESS 0x4044FC /end MEASUREMENT
/begin MEASUREMENT rg_avs_w "Restgasanteil aus Auslassspreizung" UWORD fak_uw_b1 1 100 0 0.999985 FORMAT "%9.7" ECU_ADDRESS 0x4044FE /end MEASUREMENT
/begin MEASUREMENT rg_proz2_w "prozentualer Restgasanteil im MotorBank 2" UWORD fak_uw_b1 1 100 0 0.999985 FORMAT "%9.7" ECU_ADDRESS 0x404500 /end MEASUREMENT
/begin MEASUREMENT rg_proz_w "prozentualer Restgasanteil im Motor" UWORD fak_uw_b1 1 100 0 0.999985 FORMAT "%9.7" ECU_ADDRESS 0x404502 /end MEASUREMENT
/begin MEASUREMENT rg_uef2_w "Restgasanteil aus Ventilueberschneidungsflaeche Bank 2" UWORD fak_uw_b1 1 100 0 0.999985 FORMAT "%9.7" ECU_ADDRESS 0x404504 /end MEASUREMENT
/begin MEASUREMENT rg_uef_w "Restgasanteil aus Ventilueberschneidungsflaeche" UWORD fak_uw_b1 1 100 0 0.999985 FORMAT "%9.7" ECU_ADDRESS 0x404506 /end MEASUREMENT
/begin MEASUREMENT rktseg_w "Maximum  der relative Kraftstoffmasse" UWORD rel_uw_b3072 1 100 0 3071.95 FORMAT "%8.3" ECU_ADDRESS 0x402CBA /end MEASUREMENT
/begin MEASUREMENT rl "relative Luftf¸llung" UBYTE rel_ub_q0p75 1 100 0 191.25 FORMAT "%5.1" ECU_ADDRESS 0x3FC3AA /end MEASUREMENT
/begin MEASUREMENT rldvs_w "relative Luftf¸llung durch Drosselventile am Saugrohr 16-Bit" UWORD rel_uw_q0p0234 1 100 0 1535.98 FORMAT "%8.3" ECU_ADDRESS 0x403F4E /end MEASUREMENT
/begin MEASUREMENT rlgas_w "F¸llungsgradient ¸ber ein Arbeitsspiel bestimmt" SWORD relNWU_q0p0234 1 100 -768 767.977 FORMAT "%8.4" ECU_ADDRESS 0x403F5E /end MEASUREMENT
/begin MEASUREMENT rlhpnf_w "rl_w, aus Saugrohr raus ungefiltert" UWORD rel_uw_q0p0234 1 100 0 1535.98 FORMAT "%8.3" ECU_ADDRESS 0x403F90 /end MEASUREMENT
/begin MEASUREMENT rlhp_w "rl_w, aus Saugrohr raus" UWORD rel_uw_q0p0234 1 100 0 1535.98 FORMAT "%8.3" ECU_ADDRESS 0x403F92 /end MEASUREMENT
/begin MEASUREMENT rlh_w "rl aus Saugrohrmodell mit ps-Modell" UWORD rel_uw_q0p0234 1 100 0 1535.98 FORMAT "%8.3" ECU_ADDRESS 0x3FC3FC /end MEASUREMENT
/begin MEASUREMENT rlmax_w "maximal erreichbare F¸llung bei Turbo" UWORD rel_uw_q0p0234 1 100 0 1535.98 FORMAT "%8.3" ECU_ADDRESS 0x402CBC /end MEASUREMENT
/begin MEASUREMENT rlmxfak_w "Faktor f¸r Reduzierung der ungedrosselten F¸llung" UWORD fak_uw_b2 1 100 0 1.99997 FORMAT "%8.6" ECU_ADDRESS 0x402CBE /end MEASUREMENT
/begin MEASUREMENT rlmxsoe_w "maximale Sollf¸llung ohne weitere Eingriffe" UWORD rel_uw_q0p0234 1 100 0 1535.98 FORMAT "%8.3" ECU_ADDRESS 0x402CC4 /end MEASUREMENT
/begin MEASUREMENT rlp "rel. Luftf¸llung praediziert f¸r Einspritzberechnung" UBYTE rel_ub_q0p75 1 100 0 191.25 FORMAT "%5.1" ECU_ADDRESS 0x4038CF /end MEASUREMENT
/begin MEASUREMENT rlp_w "rel. Luftf¸llung praediziert f¸r Einspritzberechnung (Word)" UWORD rel_uw_q0p0234 1 100 0 1535.98 FORMAT "%8.3" ECU_ADDRESS 0x40451C /end MEASUREMENT
/begin MEASUREMENT rlrohf_w "rel. Luftfuellung, nach Filterung" UWORD rel_uw_q0p0234 1 100 0 1535.98 FORMAT "%8.3" ECU_ADDRESS 0x403F94 /end MEASUREMENT
/begin MEASUREMENT rlroh_w "relative Luftf¸llung: Rohwert vom Lastsensor (word)" UWORD rel_uw_q0p0234 1 100 0 1535.98 FORMAT "%8.3" ECU_ADDRESS 0x403F50 /end MEASUREMENT
/begin MEASUREMENT rlrsp_w "Beginn Ringspeicher relative F¸llung" UWORD rel_uw_q0p0234 1 100 0 1535.98 FORMAT "%8.3" ARRAY_SIZE 10 ECU_ADDRESS 0x403F60 /end MEASUREMENT
/begin MEASUREMENT rltimx_w "Begrenztes RL bei RLMAX Begrenzung" UWORD rel_uw_q0p0234 1 100 0 1535.98 FORMAT "%8.3" ECU_ADDRESS 0x402CC0 /end MEASUREMENT
/begin MEASUREMENT rlumax_w "maximal erreichbare F¸llung bei Turbo" UWORD rel_uw_q0p0234 1 100 0 1535.98 FORMAT "%8.3" ECU_ADDRESS 0x402CC2 /end MEASUREMENT
/begin MEASUREMENT rlvwvvti "rlvwvvt aus inversem F¸llungsmodell Ausgang von KFEHUBIV" UWORD rel_uw_q0p0234 1 100 0 1535.98 FORMAT "%8.3" ECU_ADDRESS 0x4044F4 /end MEASUREMENT
/begin MEASUREMENT rl_f "relative Luftf¸llung (Float)" FLOAT32_IEEE fak_r32_1 1 100 0 1536 FORMAT "%27.22" ECU_ADDRESS 0x3FAE68 /end MEASUREMENT
/begin MEASUREMENT rl_w "Relative Luftf¸llung (Word)" UWORD rel_uw_q0p0234 1 100 0 1535.98 FORMAT "%8.3" ECU_ADDRESS 0x3FC3FE /end MEASUREMENT
/begin MEASUREMENT rml "relative Luftmasse (calc. load value) nach SAE J1979" UBYTE rel_ub_b99p6 1 100 0 99.6094 FORMAT "%5.2" ECU_ADDRESS 0x402CC6 /end MEASUREMENT
/begin MEASUREMENT s1fl2p04 "Schnittstelle f¸r Mode $01+$02 rml Wert f¸r PID $04" UBYTE dez 1 100 0 255 FORMAT "%5.1" ARRAY_SIZE 2 ECU_ADDRESS 0x402CC7 /end MEASUREMENT
/begin MEASUREMENT s1fl3p43 "Berechnung von ""Absolute Load Value""" UBYTE dez 1 100 0 255 FORMAT "%5.1" ARRAY_SIZE 3 ECU_ADDRESS 0x402CC9 /end MEASUREMENT
/begin MEASUREMENT slsstat "SLS-Status ¸ber CAN" UBYTE DEZ 1 100 0 255 FORMAT "%5.1" ECU_ADDRESS 0x403709 /end MEASUREMENT
/begin MEASUREMENT slsstatnv "nichtfl¸chtiger Sekund‰rluftdiagnose-Status" UBYTE DEZ 1 100 0 255 FORMAT "%5.1" ECU_ADDRESS 0x3FE38A /end MEASUREMENT
/begin MEASUREMENT spr2sum "Summe aus Ein- und Auslassspreizung Bank 2" UWORD sprzi_q0p1 1 100 0 6553.5 FORMAT "%8.3" ECU_ADDRESS 0x40451E /end MEASUREMENT
/begin MEASUREMENT spr_sum "Summe aus Ein- und Auslass-Istspreizung" UWORD sprzi_q0p1 1 100 0 6553.5 FORMAT "%8.3" ECU_ADDRESS 0x404520 /end MEASUREMENT
/begin MEASUREMENT spuefeo2_w "" UWORD sprzi_q0p1 1 100 0 6553.5 FORMAT "%8.3" ECU_ADDRESS 0x404522 /end MEASUREMENT
/begin MEASUREMENT spuefeo_w "Schwerpunkt Ueberschneidungsfl. nach EV oeffnet" UWORD sprzi_q0p1 1 100 0 6553.5 FORMAT "%8.3" ECU_ADDRESS 0x404524 /end MEASUREMENT
/begin MEASUREMENT spuefot2_w "Winkel Schwerpunkt der Ventilueberschneidungsflaeche Bank 2" SWORD sprzi_q0p1 1 100 -3276.8 3276.7 FORMAT "%8.3" ECU_ADDRESS 0x404526 /end MEASUREMENT
/begin MEASUREMENT spuefot_w "Schwerpunkt Ueberschneidungsfl. nach LOT" SWORD sprzi_q0p1 1 100 -3276.8 3276.7 FORMAT "%8.3" ECU_ADDRESS 0x404528 /end MEASUREMENT
/begin MEASUREMENT spuef_s16 "" UWORD sprzi_q0p1s32768 1 100 -3276.8 3276.7 FORMAT "%7.2" ECU_ADDRESS 0x40452A /end MEASUREMENT
/begin MEASUREMENT stafserr "Status Drehmoment AFS Fehler" UBYTE dez 1 100 0 255 FORMAT "%5.1" ECU_ADDRESS 0x402EBE /end MEASUREMENT
/begin MEASUREMENT stafsmd "Status Drehmoment Soll AFS" UBYTE dez 1 100 0 255 FORMAT "%5.1" ECU_ADDRESS 0x402EBF /end MEASUREMENT
/begin MEASUREMENT statetwslp "Status des Zustandsautomaten f¸r die Berechnung der SLP-Wicklungstemperatur" UBYTE dez 1 100 0 255 FORMAT "%5.1" ECU_ADDRESS 0x40370E /end MEASUREMENT
/begin MEASUREMENT statvza "Status Zielgeschwindigkeit f¸r Kombi-Anzeige Stufentempomat" UBYTE dez 1 100 0 255 FORMAT "%5.1" ECU_ADDRESS 0x402C3A /end MEASUREMENT
/begin MEASUREMENT stbrems "Status des aktuellen Bremsdruckes" UBYTE dez 1 100 0 255 FORMAT "%5.1" ECU_ADDRESS 0x402ECE /end MEASUREMENT
/begin MEASUREMENT stegsanzei "Status EGS-Schaltprogramm" UBYTE dez 1 100 0 255 FORMAT "%5.1" ECU_ADDRESS 0x40391A /end MEASUREMENT
/begin MEASUREMENT stegsmd "Status des EGS-Eingriffs" UBYTE dez 1 100 0 255 FORMAT "%5.1" ECU_ADDRESS 0x40391B /end MEASUREMENT
/begin MEASUREMENT stfabr "Status Fahrer bremst" UBYTE dez 1 100 0 255 FORMAT "%5.1" ECU_ADDRESS 0x402ECF /end MEASUREMENT
/begin MEASUREMENT stgangr "Status R¸ckw‰rtsgang" UBYTE dez 1 100 0 255 FORMAT "%5.1" ECU_ADDRESS 0x402F26 /end MEASUREMENT
/begin MEASUREMENT stmlac "Anforderungsstufe E-L¸fter von Klimaanlage" UBYTE dez 1 100 0 255 FORMAT "%5.1" ECU_ADDRESS 0x402F04 /end MEASUREMENT
/begin MEASUREMENT stmlscafs "Anforderungsstufe E-L¸fter vom AFS-SG" UBYTE dez 1 100 0 255 FORMAT "%5.1" ECU_ADDRESS 0x402F05 /end MEASUREMENT
/begin MEASUREMENT stmlsceps "Anforderungsstufe E-L¸fter vom EPS-SG" UBYTE dez 1 100 0 255 FORMAT "%5.1" ECU_ADDRESS 0x402F06 /end MEASUREMENT
/begin MEASUREMENT stmlscins "Anforderungsstufe E-L¸fter von Klimaanlage" UBYTE dez 1 100 0 255 FORMAT "%5.1" ECU_ADDRESS 0x402F07 /end MEASUREMENT
/begin MEASUREMENT stmodvec "Fahrzeugmodus" UBYTE dez 1 100 0 255 FORMAT "%5.1" ECU_ADDRESS 0x402F27 /end MEASUREMENT
/begin MEASUREMENT stsscsbc "Status Modus Getriebe SSC SBC" UBYTE dez 1 100 0 255 FORMAT "%5.1" ECU_ADDRESS 0x40391C /end MEASUREMENT
/begin MEASUREMENT stssgkpl "Status Kupplung" UBYTE dez 1 100 0 255 FORMAT "%5.1" ECU_ADDRESS 0x40391D /end MEASUREMENT
/begin MEASUREMENT stssgsv "Status Schaltvorgang SSG" UBYTE dez 1 100 0 255 FORMAT "%5.1" ECU_ADDRESS 0x40391E /end MEASUREMENT
/begin MEASUREMENT ststdheiz "Status der Standheizung" UBYTE dez 1 100 0 255 FORMAT "%5.1" ECU_ADDRESS 0x402F08 /end MEASUREMENT
/begin MEASUREMENT stvfzg "Status Fahrzeug Fahrzustand" UBYTE dez 1 100 0 255 FORMAT "%5.1" ECU_ADDRESS 0x402ED0 /end MEASUREMENT
/begin MEASUREMENT swv "Status Wasserventil CAN11h" UBYTE dez 1 100 0 255 FORMAT "%5.1" ECU_ADDRESS 0x402F09 /end MEASUREMENT
/begin MEASUREMENT synstate "Aktueller Synchronisierzustand" UBYTE dez 1 100 0 255 FORMAT "%5.1" ECU_ADDRESS 0x403892 /end MEASUREMENT
/begin MEASUREMENT szlbctr "Z‰hler SZL-Botschaften empfangen" UBYTE dez 1 100 0 255 FORMAT "%5.1" ECU_ADDRESS 0x402F3E /end MEASUREMENT
/begin MEASUREMENT szm1errctr "SZM1-Botschafts-Error-Z‰hler" UBYTE dez 1 100 0 255 FORMAT "%5.1" ECU_ADDRESS 0x402F28 /end MEASUREMENT
/begin MEASUREMENT S_ckl15 "Schalter Klemme 15 von CAN" UBYTE B_TRUE 1 100 0 1 BIT_MASK 0x1 FORMAT "%13.11" ECU_ADDRESS 0x3FC11E /end MEASUREMENT
/begin MEASUREMENT S_ckl50 "Schalter Klemme 50 von CAN" UBYTE B_TRUE 1 100 0 1 BIT_MASK 0x1 FORMAT "%13.11" ECU_ADDRESS 0x3FC11F /end MEASUREMENT
/begin MEASUREMENT S_cklr "Schalter in R-Stellung  von CAN" UBYTE B_TRUE 1 100 0 1 BIT_MASK 0x1 FORMAT "%13.11" ECU_ADDRESS 0x3FC120 /end MEASUREMENT
/begin MEASUREMENT tabkl50pm "Timer Abschaltung der Kl30 durch Powermodul" UBYTE t1sxs_ub_b255 1 100 0 255 FORMAT "%5.1" ECU_ADDRESS 0x402F18 /end MEASUREMENT
/begin MEASUREMENT tabsmn_w "Abstellzeit aus relativem Minutenz‰hler" UWORD t60s_uw_b65535 1 100 0 65535 FORMAT "%8.2" ECU_ADDRESS 0x402D50 /end MEASUREMENT
/begin MEASUREMENT tabsm_w "Abstellzeit aus relativem Minutenz‰hler" UWORD t1sxs_uw_q1 1 100 0 65535 FORMAT "%8.2" ECU_ADDRESS 0x402D52 /end MEASUREMENT
/begin MEASUREMENT tabsnl_w "Abstellzeit aus SG-Nachlauf" UWORD t1sxs_uw_q1 1 100 0 65535 FORMAT "%8.2" ECU_ADDRESS 0x3FE15E /end MEASUREMENT
/begin MEASUREMENT tabssc_w "Abstellzeit aus relativem Sekundenz‰hler" UWORD t1sxs_uw_q1 1 100 0 65535 FORMAT "%8.2" ECU_ADDRESS 0x402D54 /end MEASUREMENT
/begin MEASUREMENT tabstm_w "Abstellzeit aus Abk¸hlung des Motors" UWORD t1sxs_uw_q1 1 100 0 65535 FORMAT "%8.2" ECU_ADDRESS 0x402D56 /end MEASUREMENT
/begin MEASUREMENT tabst_w "Abstellzeit" UWORD t1sxs_uw_q1 1 100 0 65535 FORMAT "%8.2" ECU_ADDRESS 0x402D58 /end MEASUREMENT
/begin MEASUREMENT tas_w "Zeit ¸ber ein Arbeitsspiel f¸r rlgas_w" UWORD t_q16us 1 100 0 1.04856e+006 FORMAT "%8.0" ECU_ADDRESS 0x403F74 /end MEASUREMENT
/begin MEASUREMENT tbattpm "Batterietemperatur vom PWM-Modul" UBYTE temp_ub_q0p75_o48 1 100 -48 143.25 FORMAT "%5.1" ECU_ADDRESS 0x402F19 /end MEASUREMENT
/begin MEASUREMENT tdcuhr "Entprelltimer f¸r Diagnose CAN-Uhr" UBYTE t1sxs_q1 1 100 0 255 FORMAT "%5.1" ECU_ADDRESS 0x402D6C /end MEASUREMENT
/begin MEASUREMENT tefreq "" UBYTE freq2000_ub 1 100 0 199.219 FORMAT "%5.1" ECU_ADDRESS 0x403D0E /end MEASUREMENT
/begin MEASUREMENT tempin "Temperatur Eingang (Adressierung von FWFTBRTA)" UBYTE temp_ub_q0p75_o48 1 100 -48 143.25 FORMAT "%5.1" ECU_ADDRESS 0x402CD0 /end MEASUREMENT
/begin MEASUREMENT teqout "Einspritzverh‰ltnis zur Segmentzeit" UBYTE fak_ub_b2 1 100 0 1.99219 FORMAT "%5.3" ECU_ADDRESS 0x402CB8 /end MEASUREMENT
/begin MEASUREMENT tfst "Tankf¸llstand" UBYTE fuel_ub_q1 1 100 0 255 FORMAT "%5.1" ECU_ADDRESS 0x3FE1A7 /end MEASUREMENT
/begin MEASUREMENT tfvisrmst "" UBYTE t20msxs_ub_b5p1 1 100 0 5.1 FORMAT "%5.3" ECU_ADDRESS 0x3FC3AB /end MEASUREMENT
/begin MEASUREMENT tget "Getriebetemperatur" UBYTE temp_ub_q0p75_o48 1 100 -48 143.25 FORMAT "%5.1" ECU_ADDRESS 0x40391F /end MEASUREMENT
/begin MEASUREMENT tidlegd_w "Zeitz‰hler Betrieb im Leerlauf f. Berech. Gen. Denominator" UWORD dez 1 100 0 65535 FORMAT "%8.2" ECU_ADDRESS 0x402844 /end MEASUREMENT
/begin MEASUREMENT tmotfil "gefilterte Motortemperatur" UBYTE temp_ub_q0p75_o48 1 100 -48 143.25 FORMAT "%5.1" ECU_ADDRESS 0x3FE138 /end MEASUREMENT
/begin MEASUREMENT tnoaccnew "Timer keine neue ACC-Botschaft erhalten" UBYTE t_q0p02 1 100 0 5.1 FORMAT "%5.3" ECU_ADDRESS 0x402EBA /end MEASUREMENT
/begin MEASUREMENT tnoafs1 "Timer keine neue AFS-Botschaft1 erhalten" UBYTE t_q0p02 1 100 0 5.1 FORMAT "%5.3" ECU_ADDRESS 0x402EC0 /end MEASUREMENT
/begin MEASUREMENT tnoars1 "Timeout Z‰hler CAN-Botschaft ARS1" UBYTE t_q0p02 1 100 0 5.1 FORMAT "%5.3" ECU_ADDRESS 0x402EC6 /end MEASUREMENT
/begin MEASUREMENT tnocas1 "Timer keine neue CAS1-Botschaft erhalten" UBYTE t_q0p01 1 100 0 2.55 FORMAT "%5.3" ECU_ADDRESS 0x402ECA /end MEASUREMENT
/begin MEASUREMENT tnodsc1 "Timeout Z‰hler CAN-Botschaft DSC1" UBYTE t_q0p02 1 100 0 5.1 FORMAT "%5.3" ECU_ADDRESS 0x402ED1 /end MEASUREMENT
/begin MEASUREMENT tnodsc3 "Timeout Z‰hler CAN-Botschaft DSC3" UBYTE t_q0p02 1 100 0 5.1 FORMAT "%5.3" ECU_ADDRESS 0x402ED2 /end MEASUREMENT
/begin MEASUREMENT tnodsc4 "Timeout Z‰hler CAN-Botschaft DSC4" UBYTE t_q0p02 1 100 0 5.1 FORMAT "%5.3" ECU_ADDRESS 0x402ED3 /end MEASUREMENT
/begin MEASUREMENT tnodsc5 "Timeout Z‰hler CAN-Botschaft DSC5" UBYTE t_q0p02 1 100 0 5.1 FORMAT "%5.3" ECU_ADDRESS 0x402ED4 /end MEASUREMENT
/begin MEASUREMENT tnodscnew "Timer keine neue DSC-Botschaft erhalten" UBYTE t_q0p02 1 100 0 5.1 FORMAT "%5.3" ECU_ADDRESS 0x402ED5 /end MEASUREMENT
/begin MEASUREMENT tnoegs1 "Timer keine neue EGS-Botschaft erhalten" UBYTE t_q0p02 1 100 0 5.1 FORMAT "%5.3" ECU_ADDRESS 0x403920 /end MEASUREMENT
/begin MEASUREMENT tnoegs3 "Timer keine neue EGS-Botschaft erhalten" UBYTE t_q0p02 1 100 0 5.1 FORMAT "%5.3" ECU_ADDRESS 0x403921 /end MEASUREMENT
/begin MEASUREMENT tnoegsnew "Timer keine neue EGS-Botschaft erhalten" UBYTE t_q0p01 1 100 0 2.55 FORMAT "%5.3" ECU_ADDRESS 0x403922 /end MEASUREMENT
/begin MEASUREMENT tnoins1 "Timer keine neue INS1-Botschaft erhalten" UBYTE t_q0p1 1 100 0 25.5 FORMAT "%5.2" ECU_ADDRESS 0x402F0A /end MEASUREMENT
/begin MEASUREMENT tnoins2 "Timer keine neue INS2-Botschaft erhalten" UBYTE t_q0p1 1 100 0 25.5 FORMAT "%5.2" ECU_ADDRESS 0x402F0B /end MEASUREMENT
/begin MEASUREMENT tnoins3 "Timer keine neue INS3-Botschaft erhalten" UBYTE t_q0p1 1 100 0 25.5 FORMAT "%5.2" ECU_ADDRESS 0x402F0C /end MEASUREMENT
/begin MEASUREMENT tnoins4 "Timer keine neue INS4-Botschaft erhalten" UBYTE t_q0p1 1 100 0 25.5 FORMAT "%5.2" ECU_ADDRESS 0x402F0D /end MEASUREMENT
/begin MEASUREMENT tnoins5_w "Timer keine neue CAN-Botschaft erhalten" UWORD t_q0p1 1 100 0 6553.5 FORMAT "%8.3" ECU_ADDRESS 0x402EEE /end MEASUREMENT
/begin MEASUREMENT tnolm1 "Timeout Z‰hler CAN-Botschaft LM1" UBYTE t_q0p1 1 100 0 25.5 FORMAT "%5.2" ECU_ADDRESS 0x402F29 /end MEASUREMENT
/begin MEASUREMENT tnomlsc "Timer, keine neue CAN-Botschaft erhalten" UBYTE t_q0p1 1 100 0 25.5 FORMAT "%5.2" ECU_ADDRESS 0x402F0E /end MEASUREMENT
/begin MEASUREMENT tnopwml1 "Timeout Z‰hler CAN-Botschaft PWML1" UBYTE t_q0p1 1 100 0 25.5 FORMAT "%5.2" ECU_ADDRESS 0x402F22 /end MEASUREMENT
/begin MEASUREMENT tnopwml2 "Timeout Z‰hler CAN-Botschaft PWML2" UBYTE t_q0p1 1 100 0 25.5 FORMAT "%5.2" ECU_ADDRESS 0x402F23 /end MEASUREMENT
/begin MEASUREMENT tnoszlnew "Timer keine neue SZL-Botschaft erhalten" UBYTE t_q0p02 1 100 0 5.1 FORMAT "%5.3" ECU_ADDRESS 0x402F3F /end MEASUREMENT
/begin MEASUREMENT tnoszm1 "Timeout Z‰hler CAN-Botschaft SZM1" UBYTE t_q0p1 1 100 0 25.5 FORMAT "%5.2" ECU_ADDRESS 0x402F2A /end MEASUREMENT
/begin MEASUREMENT trefvvto "Referenztemperatur f¸r multilineare Regression" UWORD temp_ub_q0p75_o48 1 100 -48 49103.3 FORMAT "%8.2" ECU_ADDRESS 0x403F52 /end MEASUREMENT
/begin MEASUREMENT trminaus_w "Relative Zeit des Motorabstellens in Minuten" UWORD tmin_uw_q1 1 100 0 65535 FORMAT "%8.2" ECU_ADDRESS 0x3FE160 /end MEASUREMENT
/begin MEASUREMENT trminein_w "Relative Zeit des Motorstarts in Minuten" UWORD tmin_uw_q1 1 100 0 65535 FORMAT "%8.2" ECU_ADDRESS 0x402D5A /end MEASUREMENT
/begin MEASUREMENT trminOld_w "rel. Minutenz‰hler vor vorherigen Raster" UWORD tmin_uw_q1 1 100 0 65535 FORMAT "%8.2" ECU_ADDRESS 0x402D5C /end MEASUREMENT
/begin MEASUREMENT trmin_w "Relative Zeit in Minuten" UWORD tmin_uw_q1 1 100 0 65535 FORMAT "%8.2" ECU_ADDRESS 0x402EF0 /end MEASUREMENT
/begin MEASUREMENT trsdseg_w "Diagnosesegmentzeit f¸r rel. Sekundenz‰hler" UWORD t1sxs_uw_q1 1 100 0 65535 FORMAT "%8.2" ECU_ADDRESS 0x402D5E /end MEASUREMENT
/begin MEASUREMENT trsecaus_l "Relative Zeit des Motorabstellens in Sekunden" ULONG t1sxs_q1 1 100 0 4.29497e+009 FORMAT "%13.2" ECU_ADDRESS 0x3FE154 /end MEASUREMENT
/begin MEASUREMENT trsecein_l "Relative Zeit des Motorstarts in Sekunden" ULONG t1sxs_q1 1 100 0 4.29497e+009 FORMAT "%13.2" ECU_ADDRESS 0x3FE158 /end MEASUREMENT
/begin MEASUREMENT trsecpm_l "rel. Sekundenz‰hler vom Powermodul" ULONG t1sxs_q1 1 100 0 4.29497e+009 FORMAT "%13.2" ECU_ADDRESS 0x402F1C /end MEASUREMENT
/begin MEASUREMENT trsecTmp_l "rel. Sekundenz‰hler von verschiedenen CAN-Sg's" ULONG t1sxs_q1 1 100 0 4.29497e+009 FORMAT "%13.2" ECU_ADDRESS 0x402D64 /end MEASUREMENT
/begin MEASUREMENT trsec_l "Echtzeit in Sekunden" ULONG t1sxs_q1 1 100 0 4.29497e+009 FORMAT "%13.2" ECU_ADDRESS 0x402EF8 /end MEASUREMENT
/begin MEASUREMENT tsast_l "Zeit ¸ber ein Arbeitsspiel genau" ULONG t_q0p0001_ms 1 100 0 429497 FORMAT "%13.6" ECU_ADDRESS 0x404A00 /end MEASUREMENT
/begin MEASUREMENT tsas_w "Zeit ¸ber ein Arbeitsspiel f¸r ngas_w" UWORD t_q0p04_ms 1 100 0 2621.4 FORMAT "%8.3" ECU_ADDRESS 0x404436 /end MEASUREMENT
/begin MEASUREMENT tsegrsp_l "Array mit Segmentzeiten ¸ber das letzte Arbeitsspiel" ULONG t_q0p0001_ms 1 100 0 429497 FORMAT "%13.6" ARRAY_SIZE 10 ECU_ADDRESS 0x404A04 /end MEASUREMENT
/begin MEASUREMENT tsges_w "Saugrohrgesamttemperatur (nach AGR-Einleitung) (word)" SWORD temp_sw_q0p75 1 100 -24576 24575.3 FORMAT "%8.2" ECU_ADDRESS 0x402CD4 /end MEASUREMENT
/begin MEASUREMENT ttevein_tp "" UWORD t128ms_uw 1 100 0 127.998 FORMAT "%8.4" ECU_ADDRESS 0x404314 /end MEASUREMENT
/begin MEASUREMENT ttripgd_w "Zeitz‰hler Motorbetrieb f¸r Berechnung General Denominator" UWORD dez 1 100 0 65535 FORMAT "%8.2" ECU_ADDRESS 0x402846 /end MEASUREMENT
/begin MEASUREMENT tuhrplc_l "Motronicinterner Timer zur Plausibilisierung des rel. CAN-Timers" ULONG t1sxs_q1 1 100 0 4.29497e+009 FORMAT "%13.2" ECU_ADDRESS 0x402D68 /end MEASUREMENT
/begin MEASUREMENT tumgcan "Umgebungstemperatur empfangen von CAN-Kombiinstrument" SBYTE temp_q1 1 100 -128 127 FORMAT "%5.1" ECU_ADDRESS 0x402F0F /end MEASUREMENT
/begin MEASUREMENT tumgslp "Umgebungstemperatur der SLP (Auswahl zwischen tmot und tumg)" UBYTE temp_ub_q0p75_o48 1 100 -48 143.25 FORMAT "%5.1" ECU_ADDRESS 0x40370F /end MEASUREMENT
/begin MEASUREMENT tvfzgd_w "Zeitz‰hler Betrieb oberhalb Geschwindigkeitschwelle f. Berech. Gen. Denominator" UWORD dez 1 100 0 65535 FORMAT "%8.2" ECU_ADDRESS 0x402848 /end MEASUREMENT
/begin MEASUREMENT twslpst_w "berechnete Wicklungstemperatur der Sekund‰rluftpumpe bei Setzen von B_slp" UWORD temp_q0p0234_o273 1 100 -0.009375 65535 FORMAT "%8.2" ECU_ADDRESS 0x40370C /end MEASUREMENT
/begin MEASUREMENT twslp_w "berechnete Wicklungstemperatur der Sekund‰rluftpumpe" UWORD temp_q0p0234_o273 1 100 -273.15 1262.83 FORMAT "%8.3" ECU_ADDRESS 0x3FE38C /end MEASUREMENT
/begin MEASUREMENT t_cm_bm "Eingangswert E-Funktion" FLOAT32_IEEE fak_r32_1 1 100 -3.40282e+024 3.40282e+024 FORMAT "%27.1" ECU_ADDRESS 0x3FAE60 /end MEASUREMENT
/begin MEASUREMENT uefl2_w "Groesse der Ventilueberschneidungsflaeche Bank 2" UWORD flae_uw_q0p016 1 100 0 1048.56 FORMAT "%8.3" ECU_ADDRESS 0x40452C /end MEASUREMENT
/begin MEASUREMENT uefl_w "Groesse der Ventilueberschneidungsflaeche" UWORD flae_uw_q0p016 1 100 0 1048.56 FORMAT "%8.3" ECU_ADDRESS 0x40452E /end MEASUREMENT
/begin MEASUREMENT umsrln_w "Umrechnungsfaktor F¸llung in Massenstrom" UWORD m_uw_q0p0005 1 100 0 32.7675 FORMAT "%8.5" ECU_ADDRESS 0x403F54 /end MEASUREMENT
/begin MEASUREMENT vbost "Verf¸gbarkeit des ¸berwachten Verschleissteils (BOS-Meldung) in %" UBYTE dez 1 100 0 255 FORMAT "%5.1" ECU_ADDRESS 0x402F10 /end MEASUREMENT
/begin MEASUREMENT vfgrrf_w "Referenz-Fahrzeuggeschwindigkeit f¸r FGR" UWORD vfzg_uw_b512 1 100 0 511.992 FORMAT "%8.4" ECU_ADDRESS 0x403F2C /end MEASUREMENT
/begin MEASUREMENT vfgr_w "Fahrzeug-Ist-Geschwindigkeit f¸r FGR" UWORD vfzg_uw_b512 1 100 0 511.992 FORMAT "%8.4" ECU_ADDRESS 0x403F2E /end MEASUREMENT
/begin MEASUREMENT vfzgat_w "Am Tacho angezeigte Fahrzeuggeschwindigkeit" UWORD vfzg_uw_q0p00781 1 100 0 511.992 FORMAT "%8.4" ECU_ADDRESS 0x402EF2 /end MEASUREMENT
/begin MEASUREMENT vfzgk_w "Fahrzeuggeschwindigkeit, korrigiert" UWORD vfzg_uw_b512 1 100 0 511.992 FORMAT "%8.4" ECU_ADDRESS 0x403F30 /end MEASUREMENT
/begin MEASUREMENT vfzgv1f_w "Fahrzeuggeschwindigkeit, CAN-Signal V1 gefiltert" UWORD vfzg_uw_b512 1 100 0 511.992 FORMAT "%8.4" ECU_ADDRESS 0x403F32 /end MEASUREMENT
/begin MEASUREMENT vfzgv1_w "Fahrzeuggeschwindigkeit, CAN-Signal V1" UWORD vfzg_uw_b512 1 100 0 511.992 FORMAT "%8.4" ECU_ADDRESS 0x402EDC /end MEASUREMENT
/begin MEASUREMENT vlws_w "Lenkradwinkelgeschwindigkeit" SWORD lws_q0p04375 1 100 -1433.6 1433.56 FORMAT "%8.3" ECU_ADDRESS 0x402EDE /end MEASUREMENT
/begin MEASUREMENT vrad_lh "Radgeschwindigkeit links hinten" UWORD vfzg_uw_q0p0625 1 100 0 4095.94 FORMAT "%8.3" ECU_ADDRESS 0x402EE0 /end MEASUREMENT
/begin MEASUREMENT vrad_lv "Radgeschwindigkeit links vorne" UWORD vfzg_uw_q0p0625 1 100 0 4095.94 FORMAT "%8.3" ECU_ADDRESS 0x402EE2 /end MEASUREMENT
/begin MEASUREMENT vrad_rh "Radgeschwindigkeit rechts hinten" UWORD vfzg_uw_q0p0625 1 100 0 4095.94 FORMAT "%8.3" ECU_ADDRESS 0x402EE4 /end MEASUREMENT
/begin MEASUREMENT vrad_rv "Radgeschwindigkeit rechts vorne" UWORD vfzg_uw_q0p0625 1 100 0 4095.94 FORMAT "%8.3" ECU_ADDRESS 0x402EE6 /end MEASUREMENT
/begin MEASUREMENT vregdia_w "Volumenstrom Tankentl¸ftungsventil: Wert f¸r Diagnose Tankdichtheit" UWORD vs_uw_b25p6 1 100 0 25.5996 FORMAT "%8.5" ECU_ADDRESS 0x404316 /end MEASUREMENT
/begin MEASUREMENT vssekp "EKP-Sollvolumenstrom" UBYTE fuel_ub_q1 1 100 0 255 FORMAT "%5.1" ECU_ADDRESS 0x403711 /end MEASUREMENT
/begin MEASUREMENT vssgkrst "Kraftstoff-Sollvolumenstrom (Gesamtbedarf Motor + Saugstrahlpumpe)" UBYTE fuel_ub_q1 1 100 0 255 FORMAT "%5.1" ECU_ADDRESS 0x403712 /end MEASUREMENT
/begin MEASUREMENT vsskrst "Kraftstoff-Sollvolumenstrom (Betriebspunktabh‰ngiger Bedarf)" UBYTE fuel_ub_q1 1 100 0 255 FORMAT "%5.1" ECU_ADDRESS 0x403713 /end MEASUREMENT
/begin MEASUREMENT vsskrstl1 "Kraftstoff-Sollvolumenstrom f¸r Lambda=1" UBYTE fuel_ub_q1 1 100 0 255 FORMAT "%5.1" ECU_ADDRESS 0x403714 /end MEASUREMENT
/begin MEASUREMENT vssssp "Kraftstoff-Sollvolumenstrom f¸r die Saugstrahlpumpe" UBYTE fuel_ub_q1 1 100 0 255 FORMAT "%5.1" ECU_ADDRESS 0x403715 /end MEASUREMENT
/begin MEASUREMENT vssvlmx "Kraftstoff-Sollvolumenstrom bei Vollast" UBYTE fuel_ub_q1 1 100 0 255 FORMAT "%5.1" ECU_ADDRESS 0x403716 /end MEASUREMENT
/begin MEASUREMENT vtbgl_w "Vorteiler 1000ms Zeitschweibe f¸r Bankabgleich" UWORD t1sxs_uw_b65535 1 100 0 65535 FORMAT "%8.2" ECU_ADDRESS 0x40309E /end MEASUREMENT
/begin MEASUREMENT vzielak_w "Zielgeschwindigkeit f¸r Kombi-Anzeige Stufentempomat" UWORD vfzg_uw_q0p0078125 1 100 0 511.992 FORMAT "%8.4" ECU_ADDRESS 0x402C0C /end MEASUREMENT
/begin MEASUREMENT vzielold_w "FGR Zielgeschwindigkeit vor Einfrieren" UWORD vfzg_uw_q0p0078125 1 100 0 511.992 FORMAT "%8.4" ECU_ADDRESS 0x402C0E /end MEASUREMENT
/begin MEASUREMENT vziels_w "Berechnete Soll-Zielgeschwindigkeit f¸r FGR" UWORD vfzg_uw_q0p0078125 1 100 0 511.992 FORMAT "%8.4" ECU_ADDRESS 0x402C10 /end MEASUREMENT
/begin MEASUREMENT vzielvp_w "FGR Zielgeschwindigkeit f¸r Kombi-Anzeige Stufentempomat vor Eintritt in Program" UWORD vfzg_uw_q0p0078125 1 100 0 511.992 FORMAT "%8.4" ECU_ADDRESS 0x402C12 /end MEASUREMENT
/begin MEASUREMENT wdkbab_w "wdkba_w begrenzt (Minimalauswahl zwischen wdkba_w und wdkugd_w)" SWORD relDK_q0p02441 1 100 -800 799.976 FORMAT "%8.4" ECU_ADDRESS 0x403F56 /end MEASUREMENT
/begin MEASUREMENT wdkbap_w "fuer Einspritzung praedizierter Drosselklappenwinkel (Word)" UWORD rel_uw_b100 1 100 0 99.9985 FORMAT "%8.5" ECU_ADDRESS 0x403FE2 /end MEASUREMENT
/begin MEASUREMENT wdkhfu_w "DK-Winkel  ber. aus Massenstrom d. Haupf¸llungssensors ungedrosselt" UWORD rel_uw_b100 1 100 0 99.9985 FORMAT "%8.5" ECU_ADDRESS 0x4044D0 /end MEASUREMENT
/begin MEASUREMENT wdkhf_w "Berechneter Winkel der Drosselklappe aus dem Hauptf¸llungssignal" UWORD rel_uw_b100 1 100 0 99.9985 FORMAT "%8.5" ECU_ADDRESS 0x4044D2 /end MEASUREMENT
/begin MEASUREMENT wsanfihka "W‰rmestromanforderung Anforderung Klima" UBYTE dez 1 100 0 255 FORMAT "%5.1" ECU_ADDRESS 0x402F11 /end MEASUREMENT
/begin MEASUREMENT wsstatihka "W‰rmestromstatus Anforderung Klima" UBYTE dez 1 100 0 255 FORMAT "%5.1" ECU_ADDRESS 0x402F12 /end MEASUREMENT
/begin MEASUREMENT xqtm_w "Temperaturquotient" UWORD fak_uw_b16 1 100 0 15.9998 FORMAT "%8.5" ECU_ADDRESS 0x402D60 /end MEASUREMENT
/begin MEASUREMENT zalvafs1 "Aliverz‰hler AFS CAN-Botschaft 1" UBYTE dez 1 100 0 255 FORMAT "%5.1" ECU_ADDRESS 0x402EC1 /end MEASUREMENT
/begin MEASUREMENT zalvars "Alivez‰hler ARS-SG" UBYTE dez 1 100 0 255 FORMAT "%5.1" ECU_ADDRESS 0x403914 /end MEASUREMENT
/begin MEASUREMENT zalvcas1 "Aliverz‰hler CAS1-Botschaft" UBYTE dez 1 100 0 255 FORMAT "%5.1" ECU_ADDRESS 0x402EC9 /end MEASUREMENT
/begin MEASUREMENT zalvdme1 "Aliverz‰hler DME1-Botschaft" UBYTE dez 1 100 0 255 FORMAT "%5.1" ECU_ADDRESS 0x403BF8 /end MEASUREMENT
/begin MEASUREMENT zalvdme2 "Aliverz‰hler DME2-Botschaft" UBYTE dez 1 100 0 255 FORMAT "%5.1" ECU_ADDRESS 0x403BF9 /end MEASUREMENT
/begin MEASUREMENT zalvdme3 "Aliverz‰hler DME3-Botschaft" UBYTE dez 1 100 0 255 FORMAT "%5.1" ECU_ADDRESS 0x403BFA /end MEASUREMENT
/begin MEASUREMENT zalvdme4 "Aliverz‰hler DME4-Botschaft" UBYTE dez 1 100 0 255 FORMAT "%5.1" ECU_ADDRESS 0x403BFB /end MEASUREMENT
/begin MEASUREMENT zalvins "Alivez‰hler Kombiinstrument" UBYTE dez 1 100 0 255 FORMAT "%5.1" ECU_ADDRESS 0x402F13 /end MEASUREMENT
/begin MEASUREMENT zalvszm1 "Aliverz‰hler SZM1-Botschaft" UBYTE dez 1 100 0 255 FORMAT "%5.1" ECU_ADDRESS 0x402F2B /end MEASUREMENT
/begin MEASUREMENT zkbgmsdk "Zeitkonstante Korrekturwerte GD Betrieb" UWORD fak_uw_b1 1 100 0 0.999985 FORMAT "%9.7" ECU_ADDRESS 0x403F58 /end MEASUREMENT
/begin MEASUREMENT zkmsdk_w "" UWORD mk10ms_uw_q2p384e5n 1 100 0 15.6248 FORMAT "%8.5" ECU_ADDRESS 0x403F5A /end MEASUREMENT
/begin MEASUREMENT zrbosr "Z‰hler R¸ckstellung BOS" UBYTE dez 1 100 0 255 FORMAT "%5.1" ECU_ADDRESS 0x402F14 /end MEASUREMENT
/begin MEASUREMENT ztageabs_w "Z‰hler Tage absolut" UWORD dez 1 100 0 65535 FORMAT "%8.2" ECU_ADDRESS 0x402EF4 /end MEASUREMENT
/begin MEASUREMENT zylvirt "Stand Zylinderz‰hler vor Umsynchronisation aus Schnellstart" UBYTE dez 1 100 0 255 FORMAT "%5.1" ECU_ADDRESS 0x403894 /end MEASUREMENT
/begin FUNCTION BGMSZS "32.120    Berechnungsgrˆﬂe Massenstrˆme zum Saugrohr"
 /begin DEF_CHARACTERISTIC BGMSDKDPS BGMSVVTDPS CW_DPSMSZS CW_NNMSZS DFKMSMN DFKMSMX DFKPVMN DFKPVMX DPSTDMN FKMSDKMN FKMSDKMX FKMSVVTMN FKMSVVTMX FKPVDKE FKPVDKMN FKPVDKMX FKPVVVTMN FKPVVVTMX HUBFMAON HUBFMAUN HUBMSON KFDKMS KFEHUBIV KFEHUBLLIV KFEHUBLLKI KFEHUBNS KFMSNVVT KFMSNWDK KFZKMSVT KIMSA KIMSALL KIMSALLVT KIMSAVT KIMSNLL KLMSNVTOM KLTDSTEND KLZKBGMSDK KUMSRL KVLAD LADFIL MLFKMSDK MSALLMN MSALLMX MSLG NMSNDKO NMSNVTO NRLMNIST PSPVDKUGN RLNOT S_HUBINST S_MSDKIST S_NNADAP TIMSA TIMSALL TIMSALLVT TIMSAON TIMSAVT TMFKMSDKA TMFKMSVTA VVTALLMN VVTALLMX VVTNLLMN VVTNLLMX WDKFMAON WDKFMAUN WDKMSON WDKMSONTD ZKMSDK ZKMSDKTD /end DEF_CHARACTERISTIC
 /begin REF_CHARACTERISTIC KFFLAEAN KLAF KLDPIPOL KLDPSDKM MSNLG NOHUBMO /end REF_CHARACTERISTIC
 /begin IN_MEASUREMENT B_clradmsz B_ehfm B_gd B_gdst B_hfm B_ll B_llk B_llrein B_lltd B_nmot B_pwf B_rlh B_stend B_vl B_vvtnotl dpsfak dpssol_uw dpssol_w dps_w evhubi2_w evhubi_w evhubs_w fho fhubvnsi_w fhubwll_au fpups_w fpvdkds_w ftvdk ml_w mshfm_w msnvvtdnn msnvvtonn mssp_w mste m_tol nmot nmot_w ps_w pu_w pvdkds_w rlvugd rlvw_w tmot tmst toel_w Vse_spri Vse_sprn Vse_sprs wdkba wdkba_w wdkugd_w /end IN_MEASUREMENT
 /begin OUT_MEASUREMENT B_bgmsdk B_bgmszs B_bgmszsi B_dpsmod B_dslvh B_dssv B_fkmsmn B_fkmsmx B_fkpvmn B_fkpvmx B_hfmv B_kltdstend B_timsa B_timsall B_timsallv B_timsavvt B_timsvvt dpsbgms_w dpsvbgms_w evhubin2_w evhubin_w fkmsdka_w fkmsdks_w fkmsdk_w fkmsvvta_w fkmsvvts_w fkmsvvt_w fpvdk fpvdk_w frhodk_w mlsolkori msdif_w msdkalm_w msdkroh_w msdk_w mskorb_w msndko_w msndk_w msnvvtoll msnvvto_w mss_w mszsst pspvdb_w pspvdkugn_w pspvdk_w pvdk pvdk_w rldvs_w rlroh_w rlvwvvti trefvvto umsrln_w wdkbab_w zkbgmsdk zkmsdk_w /end OUT_MEASUREMENT
 /begin LOC_MEASUREMENT dkmsmszs dpipolmszs dpipol_aus dpipol_in drllad_w msspkorr_w /end LOC_MEASUREMENT
/end FUNCTION
/begin FUNCTION BGMSZSNN "1.10      Berechnung Luftmassenoffset LL ¸ber Temperatur"
 /begin DEF_CHARACTERISTIC BREITE ETA_BGMSZS E_FUNKTION FAK_BGMSZS GKN W1_MAX W1_MIN W2_MAX W2_MIN ZENTRUM /end DEF_CHARACTERISTIC
 /begin REF_CHARACTERISTIC S_NNADAP VVTNLLMN VVTNLLMX /end REF_CHARACTERISTIC
 /begin IN_MEASUREMENT B_llk B_pwf B_timsvvt fkmsvvts_w mlsolkor_w trefvvto /end IN_MEASUREMENT
 /begin OUT_MEASUREMENT msnvvtdnn msnvvtonn msnvvtonns /end OUT_MEASUREMENT
 /begin LOC_MEASUREMENT ausg_nn errornn nn_w1 nn_w2 t_cm_bm /end LOC_MEASUREMENT
/end FUNCTION
/begin FUNCTION BGNG "8.30      Berechnete Grˆﬂe Drehzahlgradient" /begin DEF_CHARACTERISTIC ZNGFIL /end DEF_CHARACTERISTIC /begin IN_MEASUREMENT inisynmon nmot_w tseg_l /end IN_MEASUREMENT
 /begin OUT_MEASUREMENT B_ngasok dnmotas_w dnmot_w irspsyn ngas_w ngfil ngfil_w tsegrsp_l /end OUT_MEASUREMENT
 /begin LOC_MEASUREMENT irspsynold nmotarr_w nmotas_w tsast_l tsas_w /end LOC_MEASUREMENT
/end FUNCTION
/begin FUNCTION BGNMOT "8.20      Berechnete Grˆﬂe Drehzahl" /begin IN_MEASUREMENT B_nmin synstate tseg_l /end IN_MEASUREMENT /begin OUT_MEASUREMENT nmot nmotll nmotllfil nmot_f nmot_w /end OUT_MEASUREMENT /end FUNCTION
/begin FUNCTION BGNMZ "1.20      Berechnete Grˆﬂe Drehzahl aus Zahnzeit" /begin IN_MEASUREMENT B_nmin nmot /end IN_MEASUREMENT /begin OUT_MEASUREMENT nmotz /end OUT_MEASUREMENT /end FUNCTION
/begin FUNCTION BGODS "1.20      Berechnete Grˆﬂe ÷ldruckschalter" /begin DEF_CHARACTERISTIC CWODS NMOTOEL1 NMOTOEL2 TVPOELAN1 TVPOELAN2 /end DEF_CHARACTERISTIC /begin IN_MEASUREMENT B_oeldr B_stend nmot_w /end IN_MEASUREMENT /begin OUT_MEASUREMENT B_oeldran /end OUT_MEASUREMENT /end FUNCTION
/begin FUNCTION BGPABG "1.10      Berechnete Groesse Abgasgegendruck" /begin DEF_CHARACTERISTIC KLPAVHK KLPAVTL KLPAVVK /end DEF_CHARACTERISTIC
 /begin IN_MEASUREMENT msabg2_w msabg_w msabikr2_w msabikr_w msabvhk2_w msabvhk_w pu_w /end IN_MEASUREMENT
 /begin OUT_MEASUREMENT pa2_w pabvhk2_w pabvhk_w pabvtl2_w pabvtl_w pabvvk2_w pabvvk_w pa_w /end OUT_MEASUREMENT
/end FUNCTION
/begin FUNCTION BGRBS "10.10     Berechnete Grˆﬂe Radbeschleunigung aus Raddrehzahl" /begin DEF_CHARACTERISTIC TMVDBS VASRM VBSMX /end DEF_CHARACTERISTIC
 /begin IN_MEASUREMENT B_cdswe B_dsc1cok codcan vfzg vrad_lh vrad_lv vrad_rh vrad_rv /end IN_MEASUREMENT
 /begin OUT_MEASUREMENT bsc /end OUT_MEASUREMENT
 /begin LOC_MEASUREMENT dv_lh dv_lv dv_rh dv_rv /end LOC_MEASUREMENT
/end FUNCTION
/begin FUNCTION BGRECZGD "1.20" /begin DEF_CHARACTERISTIC CWRECZGD TMNIDLEGD TMNTRIPGD TMNVFZGD VFZMNGD VFZMXIDGD /end DEF_CHARACTERISTIC /begin IN_MEASUREMENT B_ll B_stend vfzg_w /end IN_MEASUREMENT
 /begin OUT_MEASUREMENT B_cntgd B_cnticy B_tidlegd B_ttripgd B_tvfzgd cntgd_w cnticy_w cntzd cntz_w tidlegd_w ttripgd_w tvfzgd_w /end OUT_MEASUREMENT
/end FUNCTION
/begin FUNCTION BGRGM "1.20      Restgasmodell"
 /begin DEF_CHARACTERISTIC KLRGMDPS KLRGMN KLRGMOF KLZYLN KLZYLN2 KLZYLU KLZYLU2 RGNFAK RGNFAK2 /end DEF_CHARACTERISTIC
 /begin IN_MEASUREMENT avs2_w avs_w dps_w nmot spuefot2_w spuefot_w uefl2_w uefl_w /end IN_MEASUREMENT
 /begin OUT_MEASUREMENT rgmdps rgmn rgmof rg_avs2_w rg_avs_w rg_proz2_w rg_proz_w rg_uef2_w rg_uef_w /end OUT_MEASUREMENT
/end FUNCTION
/begin FUNCTION BGRL2SV "1.10" /begin IN_MEASUREMENT nmot rlmxs_w rl_w /end IN_MEASUREMENT /begin OUT_MEASUREMENT rlmxsoe_w rml s1fl2p04 s1fl3p43 /end OUT_MEASUREMENT /end FUNCTION
/begin FUNCTION BGRLG "2.10      Berechnete Grˆﬂe RL-GRADIENT" /begin IN_MEASUREMENT B_ngasok irspsyn rl_w tsegrsp_l /end IN_MEASUREMENT /begin OUT_MEASUREMENT drlas_w rlgas_w /end OUT_MEASUREMENT /begin LOC_MEASUREMENT rlrsp_w tas_w /end LOC_MEASUREMENT /end FUNCTION
/begin FUNCTION BGRLMAX "1.30      Maximale F¸llungsbegrenzung (BMW)" /begin DEF_CHARACTERISTIC KFWTSEG NTIMDRED RLMXFMN RLMXLESS RLMXPLUS RLMXTEHYST /end DEF_CHARACTERISTIC
 /begin IN_MEASUREMENT dvvtrlmx_w nmot_w rk2_w rk_w rlugdob_w te2_l te_l tseg_l tvu_w /end IN_MEASUREMENT
 /begin OUT_MEASUREMENT B_temxon rlmax_w rlmxfak_w rltimx_w rlumax_w teqout /end OUT_MEASUREMENT
 /begin LOC_MEASUREMENT rktseg_w /end LOC_MEASUREMENT
/end FUNCTION
/begin FUNCTION BGSRM "22.160    F¸llungserfassung Saugrohrmodell"
 /begin DEF_CHARACTERISTIC AVZUNAS AVZUNAS2 DLTDPSMN DLTDPSMX FK_A2 FPVMXN FPVMXN2 KFDLTDPSF KFDPRG KFDPRGSU KFFAKSRM KFPRG KFPRGSU KFRLHP KFRLHPFAK KFSPUEF KFUEF KFURL KFURLF KFURLFSU KFURLSU KLEOVES KLFDPS KLFVISRMST KLKISRM KLKISRMSU KLSRMKOR KLZKDPSSRM PMAX1013 SKFFAKSRM S_RLWAHL S_SRMFILT ZDLTDPSF ZFVISRMST ZVTPRGSU /end DEF_CHARACTERISTIC
 /begin REF_CHARACTERISTIC DHUBMX DI_SCHALT /end REF_CHARACTERISTIC
 /begin IN_MEASUREMENT B_gdvhub B_hfm B_kltdstend B_psger B_stend B_su dhubra_w Disa_ist dpsfak dpssol_uw dpssyn_w dps_w evhubi2_w evhubi_w fho_w ftbr_w ftsr minhub_w nmot nmot_w psagr_w pu_w pvdkds_w rlroh_w tans tmst umsrln_w Vsa2spri Vsa_spri Vse2spri Vse_spri /end IN_MEASUREMENT
 /begin OUT_MEASUREMENT agrr agrr_w avs2_w avs_w B_rlh dltdpsff_w dltdpsf_w dltdps_w dltrl_w dpsfak_w dpsfg_w drlp_w drl_w fdpssrm_w ffrlhp fupsrl_w fvisrmst_w fvisrm_w ml ml_w pirg_w psfg_w psmx_w ps_w rfagr_w rfges_w rl rlhpnf_w rlhp_w rlh_w rlp rlp_w rlrohf_w rl_f rl_w spr2sum spr_sum spuefeo2_w spuefeo_w spuefot2_w spuefot_w spuef_s16 tfvisrmst uefl2_w uefl_w /end OUT_MEASUREMENT
 /begin LOC_MEASUREMENT B_suini pirgro_w psrlro_w /end LOC_MEASUREMENT
/end FUNCTION
/begin FUNCTION BGSTDKAT "1.20      Berechnete Grˆﬂe Status Diagnose Katalysator bei Testeraufruf" /begin REF_CHARACTERISTIC TWDKATS /end REF_CHARACTERISTIC
 /begin IN_MEASUREMENT B_binsti B_dktb B_dktb2 B_dktens B_dktens2 B_fakat B_fakat2 B_vekat B_vekat2 /end IN_MEASUREMENT
 /begin OUT_MEASUREMENT dkatstat dkatstat2 /end OUT_MEASUREMENT
/end FUNCTION
/begin FUNCTION BGSTDSLS "2.10      Berechnete Grˆﬂe; Status Diagnose Sekund‰rluftsystem bei Systemtest" /begin REF_CHARACTERISTIC TMFASLMN TWSLPFA TWSLPOFF /end REF_CHARACTERISTIC
 /begin IN_MEASUREMENT B_awmslsum B_dfrmoff B_dfrmoff2 B_dsl B_dslerr B_dslfa B_dslm B_dslmab B_dslmes B_dslo B_dsloab B_eepwf B_fa B_fasla B_faslarq B_fasls B_kh B_meaoper B_mnslspr B_mnslspr2 B_mslmin B_mslmin2 B_mslmn B_rmslsmg B_sls B_slsoab B_te B_zslsp B_zslsp2 tmot twslp_w /end IN_MEASUREMENT
 /begin OUT_MEASUREMENT slsstat slsstatnv /end OUT_MEASUREMENT
 /begin LOC_MEASUREMENT B_twslpoff /end LOC_MEASUREMENT
/end FUNCTION
/begin FUNCTION BGSTUT "1.120     Berechnungsgrˆﬂen Stufentempomat"
 /begin DEF_CHARACTERISTIC ANZMRKAUS ANZMRKMX CWBGSTUT DVMARK DVMARKMI DVMINJMP DVPRG DVPRGMI DVSTUTOM DVSTUTOMMI TMARK TMRKBLI TSELO TVSTUTK TVSTUTL VFGRPRG /end DEF_CHARACTERISTIC
 /begin REF_CHARACTERISTIC TFGRTP /end REF_CHARACTERISTIC
 /begin IN_MEASUREMENT B_besch B_fgrat B_fgren B_fgresv B_fgrtb2 B_fgrtbe B_fgrtv2 B_fgrtve B_fgrtwa B_fgrvem B_insfgre B_km B_mmiena B_mrkvff mmimrk_w vfgr_w vreglmax_w vreglmin_w vziel_w /end IN_MEASUREMENT
 /begin OUT_MEASUREMENT B_mrkein B_mrkv B_vziels mrknrc mrknrcan mrknrint mrkstut_w statvza vzielak_w vziels_w /end OUT_MEASUREMENT
 /begin LOC_MEASUREMENT anzmark bgstutLokBits0 bgstutLokBits1 B_beveh B_bv1 B_bv2 B_envtwa B_fgrepa B_mrkbli B_mrkeinvp B_prgmod B_tmark B_tmrkbli canzbl ctblink dvmark_w dvprg_w dvstutom_w vzielold_w vzielvp_w /end LOC_MEASUREMENT
/end FUNCTION
/begin FUNCTION BGTABST "3.140     Berechnete Grˆﬂe Abstellzeit"
 /begin DEF_CHARACTERISTIC DTUHRPL LNXQTM NMUHRPL TABSTST TDCUHR1 TDCUHRH TDSECSEG TMNABSTM TNLSGM TNSTRTUE ZKTABTU /end DEF_CHARACTERISTIC
 /begin IN_MEASUREMENT B_abstnl B_nachl B_nachlend B_nlwst B_nmin B_pwf B_stend B_uhrrmin B_uhrrsec B_vbemg codcan codfzg nmot tmotab tmst tnse_w trmin_w trsec_l tumg /end IN_MEASUREMENT
 /begin OUT_MEASUREMENT B_nlendabt B_tabunpl B_uhrrnpl tabsmn_w tabsm_w tabsnl_w tabssc_w tabstm_w tabst_w trminaus_w trminein_w trsdseg_w trsecaus_l trsecein_l tuhrplc_l xqtm_w /end OUT_MEASUREMENT
 /begin LOC_MEASUREMENT BgtabstNvBits tdcuhr trminOld_w trsecTmp_l /end LOC_MEASUREMENT
/end FUNCTION
/begin FUNCTION BGTEMPK "10.30     F¸llungserfassung Berechnung Temperaturkompensation"
 /begin DEF_CHARACTERISTIC CWTEMPK DEVTMAGR EVTMODO FDVANS FWFTBRTA KFFWTBR ZBRT ZTDAGR ZTMMBR /end DEF_CHARACTERISTIC
 /begin IN_MEASUREMENT B_nmot nmot rl tans tmot /end IN_MEASUREMENT
 /begin OUT_MEASUREMENT evtmod ftbr ftbr_w ftsr ftu ftvdk ftw /end OUT_MEASUREMENT
 /begin LOC_MEASUREMENT tempin tmotfil tsges_w /end LOC_MEASUREMENT
/end FUNCTION
/begin FUNCTION BGTEV "6.70      Berechnungsgrˆﬂe Massenstrom TEV" /begin DEF_CHARACTERISTIC FMTEVEIN FUMRMV KFMTEDPML /end DEF_CHARACTERISTIC /begin REF_CHARACTERISTIC CWTEACFG /end REF_CHARACTERISTIC
 /begin IN_MEASUREMENT B_dteaa dpssol_w dps_w fho_w ftvdk ftvdkho_w ml_w ps_w pu_w tateist tevper ttevein /end IN_MEASUREMENT
 /begin OUT_MEASUREMENT dps_uw msntevo_w mste mstedte mstedte_w msteo_w mste_w tefreq ttevein_tp vregdia_w /end OUT_MEASUREMENT
 /begin LOC_MEASUREMENT fmtate_w fmtev_w mstedp_w offakdps /end LOC_MEASUREMENT
/end FUNCTION
/begin FUNCTION BGTWSLP "1.20      Berechnete Grˆﬂen f¸r Temperatur der SLP-Wicklung"
 /begin DEF_CHARACTERISTIC ABKTWSLP FWTMTU KFTWSLP TDENDAUFH TWSLPPWF ZKABKTWSLP ZKTWSLPUB /end DEF_CHARACTERISTIC
 /begin IN_MEASUREMENT B_eemrdy B_eepwf B_slp B_stend tabst_w tmot tumg ubsqf_w ub_w /end IN_MEASUREMENT
 /begin OUT_MEASUREMENT statetwslp twslp_w /end OUT_MEASUREMENT
 /begin LOC_MEASUREMENT B_endaufh dtwslpum_w tumgslp twslpst_w /end LOC_MEASUREMENT
/end FUNCTION
/begin FUNCTION BGVFGR "3.10      Berechnete Geschwindigkeit f¸r Fahrgeschwindigkeitsregler" /begin DEF_CHARACTERISTIC CWBGVFGR FKV1FVMX ZFMVRV ZKDATV /end DEF_CHARACTERISTIC /begin REF_CHARACTERISTIC TFGRVRAB VRFGRMN /end REF_CHARACTERISTIC
 /begin IN_MEASUREMENT bfzgldsc_w B_emfbra B_evfzgv1 B_fgren B_insfgre B_siins_fr codcan vfzgat_w vfzgv1_w vfzg_w /end IN_MEASUREMENT
 /begin OUT_MEASUREMENT bfzglfgr B_fgrabz dvatv1_w vfgrrf_w vfgr_w vfzgk_w /end OUT_MEASUREMENT
 /begin LOC_MEASUREMENT vfzgv1f_w /end LOC_MEASUREMENT
/end FUNCTION
/begin FUNCTION BGVSEKP "2.30      Berechnete Grˆﬂe Kraftstoff-Sollvolumenstrom f¸r bedarfsgesteuerte EKP" /begin DEF_CHARACTERISTIC FMLZKRST KFSTTANKR VSEKPMXN VSSSPE VSSSPTAIRL /end DEF_CHARACTERISTIC
 /begin IN_MEASUREMENT B_bt B_btekp B_ekp B_ekpet B_ekpvl B_ins2cok codcan fsttankl fsttankr ml_w nmot rk2_w rk_w rlp_w tfst /end IN_MEASUREMENT
 /begin OUT_MEASUREMENT lambrinv_w vssekp vssgkrst vsskrst vsskrstl1 vssssp vssvlmx /end OUT_MEASUREMENT
 /begin LOC_MEASUREMENT B_fstpl fsttankrf /end LOC_MEASUREMENT
/end FUNCTION
/begin FUNCTION BGWDKHF "2.20      Berechnung Winkel Drosselklappe aus Signal d. Hauptf¸llungssensors" /begin DEF_CHARACTERISTIC BGWDKDPSGR /end DEF_CHARACTERISTIC /begin REF_CHARACTERISTIC KFWDKDPS KFWDKMSN KLAF KLDPIPOL KLDPSDKM MSNLG /end REF_CHARACTERISTIC
 /begin IN_MEASUREMENT B_vl dpssol_w ftvdkho_w mshfm_w nmot_w pvdkds_w wdks_w wdkugd_w /end IN_MEASUREMENT
 /begin OUT_MEASUREMENT B_wdkhfu wdkhf_w /end OUT_MEASUREMENT
 /begin LOC_MEASUREMENT dpipowdkhf dpwdkhf_in dpwdkhf_w mlwdknshf mshfmad wdkhfu_w /end LOC_MEASUREMENT
/end FUNCTION
/begin FUNCTION BGWDKM "1.11      Berechnung Dk-Winkel Modell" /begin DEF_CHARACTERISTIC ZWDKM1 ZWDKM2 /end DEF_CHARACTERISTIC /begin IN_MEASUREMENT wdksp_w /end IN_MEASUREMENT /begin OUT_MEASUREMENT wdkbap_w /end OUT_MEASUREMENT /end FUNCTION
/begin FUNCTION BGWNE "1.90      Berechnete Basis-Grˆﬂen f¸r Winkel- und Drehzahlerfassung" /begin REF_CHARACTERISTIC NMIN /end REF_CHARACTERISTIC
 /begin IN_MEASUREMENT B_bm B_nachlauf B_nlph B_phsnlinv B_phsnlok B_tprel B_zprel sync_level tseg_l zzkwas_w zzvirt zzyl /end IN_MEASUREMENT
 /begin OUT_MEASUREMENT B_nmin B_nmot B_startini synstate zylvirt /end OUT_MEASUREMENT
 /begin LOC_MEASUREMENT nmn10msctr /end LOC_MEASUREMENT
/end FUNCTION
/begin FUNCTION BNKABG "1.120     Bankabgleich"
 /begin DEF_CHARACTERISTIC ADBGLHYST CLEARBGL CW_FABGL DFLUBGLM DLUBBGLALL DLUBBGLATL DLUBBGLPLL DLUBBGLPTL DPSSOLBGL EVHUBADBGL EVHUBBGL FAOFWNKTST FRAUBGL FRMBGL LAMSONIBGL MAXANDADBG NMOTBGL OFWNKMX QTEBGLA QTEBGLP RKATBGL TBBGL TBGLAD TBGLADRDY TBGLLR TBGLRDY TBGLST TMOTBGL VTBGL ZBGLOFWLL ZBGLOFWTL ZFLUBBGL ZQTEBGL /end DEF_CHARACTERISTIC
 /begin REF_CHARACTERISTIC S_TDFBA2 /end REF_CHARACTERISTIC
 /begin IN_MEASUREMENT B_dktb B_dktb2 B_dtes B_edkvs B_edkvs2 B_fa B_fofr1 B_ll B_lr B_lr2 B_lustop B_mdarv B_mdein B_nokatfz B_pwf B_sa B_stend B_te B_tehb B_vvtnlio B_vvtnotl dpssol_w evhubs_w flutbgl_w frau2_w frau_w frm2_w frm_w lamsoni2_w lamsoni_w minadrdy nmot ofwnktest rkat2_w rkat_w te2_l te_l tmot /end IN_MEASUREMENT
 /begin OUT_MEASUREMENT adbereich bgladrdy bgl_adrdy_count bgl_ad_count Bgl_flags1 Bgl_flags2 Bgl_flags3 Bgl_flags4 bgl_lr_count bgl_rdy_count bgl_start_count B_begr B_bgl B_bglb2 B_bgllub2 B_bglp B_bglrdy B_bglteb2 b_bgl_count B_dlubbgla B_dlubbglp B_fbgl B_flub1 B_flub2 B_fofr1_old B_qtebgla B_qtebglp dlubbgl_w faofwnkbgl fdlubbgl_w flub1_w flub2_w fqtebgl_w ofwnkadbg ofwnkbg ofwnkbg1 ofwnkbg2 ofwnkbg_temp qtebgl_w vtbgl_w /end OUT_MEASUREMENT
/end FUNCTION
/begin FUNCTION CANACC "5.10      CAN-Botschafts- und Signaldefinition ACC" /begin DEF_CHARACTERISTIC TDCIDXB7H TDUNPLACC TSRACC /end DEF_CHARACTERISTIC /begin IN_MEASUREMENT B_clvar B_eemrdy B_eepwf B_npacc_um B_siacc_um codcan /end IN_MEASUREMENT /begin OUT_MEASUREMENT acccod B_acc B_acccok B_accnew B_caccnpv tnoaccnew /end OUT_MEASUREMENT /end FUNCTION
/begin FUNCTION CANAFS "1.20" /begin DEF_CHARACTERISTIC TDCIDX0B9H TSRAFS1 /end DEF_CHARACTERISTIC /begin IN_MEASUREMENT B_clvar codcan codfzg /end IN_MEASUREMENT
 /begin OUT_MEASUREMENT afs1errctr B_afs1cok B_afs1csao B_afs1new B_afsron B_afsvar chksafs1 mkiafs_w mksafs_w stafserr stafsmd tnoafs1 zalvafs1 /end OUT_MEASUREMENT
/end FUNCTION
/begin FUNCTION CANARS "2.10      CAN-Signal und Botschaftsdefinition ARS-Modul" /begin DEF_CHARACTERISTIC TDCIDX1ACH TSRARS1 /end DEF_CHARACTERISTIC /begin IN_MEASUREMENT B_clvar B_pwf codcan /end IN_MEASUREMENT
 /begin OUT_MEASUREMENT arscod B_ars1cok B_ars1new B_arsron B_arsvar mdarsi mdarss tnoars1 zalvars /end OUT_MEASUREMENT
/end FUNCTION
/begin FUNCTION CANCAS "2.20      CAS CAN-Botschafts- und Sinaldefinition Car Access System" /begin DEF_CHARACTERISTIC TDCIDX130H TSRCAS1 /end DEF_CHARACTERISTIC /begin IN_MEASUREMENT codcan S_kl15 /end IN_MEASUREMENT
 /begin OUT_MEASUREMENT B_cas1csao B_cascok B_casnew chkcas1 S_ckl15 S_ckl50 S_cklr tnocas1 zalvcas1 /end OUT_MEASUREMENT
 /begin LOC_MEASUREMENT cas1errct /end LOC_MEASUREMENT
/end FUNCTION
/begin FUNCTION CANDME "12.80     DME CAN-Botschafts- und Signaldefinitionen" /begin DEF_CHARACTERISTIC MKKOMX STIGEN2APP TMWLC /end DEF_CHARACTERISTIC /begin REF_CHARACTERISTIC CWGEN MDNORM /end REF_CHARACTERISTIC
 /begin IN_MEASUREMENT bos01_w bosbtvfbk bosstate B_bl B_bosmsgc B_br B_brems B_cclampe B_cclblink B_ccsdanf B_cmsggts B_codierpm B_dmefacca B_egszwgs B_epcl B_falls B_fgrat B_fgrhe B_fgrhsa B_fgrtbe B_fgrtve B_fgrtwa B_kd B_kl15 B_kl61 B_ko B_koe B_kuppl B_ll B_masterhw B_mil B_mnbfmder B_mol_sf B_mol_vb B_mol_vl B_mrkein B_nivns B_nldg B_nmin B_nmot B_nmotok B_nstarttx B_oeldran B_oelstmot B_oeltemp B_pmbsdanf B_pmvsdanf B_qaccsyof B_sa B_st B_stend B_tankd B_uetmc codcan codfzg codget ctrcbr ctrpcos ctrprio ctrpriocf ctrpwrcos ctrpwspcos dffgen dffgen2 dtnxtccmsg ehz_pw etazaist fgr_stat id2ccmsg idbosmsg idcclampe idfbosmg_w indexmrst kvaverbr L_fgr mdindlm_w mdkomx mdverl_w miist_w mivbeg_w mkindegs_w mkindlm_w mkist_w mkmax_w mkvbeg_w mkverl_w mkzwmn_w nmot_w nnstart nstat nwarnor nwarnrt obdsteuer oelstandr pu rqpcos selspcos statvza stat_md_e stdmeacc stdmears stdmedsc stdmeegs stoelnfm stpcos sttmotkalt st_craweng st_gen st_i_gen st_i_gen2 st_ldstgen synchroCtr tmot tnse_w toeloz tvavhzkr ubt ulev vmrki1_w vmrki2_w vmrki3_w vssekp vzielak_w wped wpedvf wpfgr_w zrbosmld /end IN_MEASUREMENT
 /begin OUT_MEASUREMENT B_ccsdok chsdme1 chsdme2 chsdme3 miistc zalvdme1 zalvdme2 zalvdme3 zalvdme4 /end OUT_MEASUREMENT
/end FUNCTION
/begin FUNCTION CANDSC "2.70      DSC CAN-Botschafts- und Signaldefinition"
 /begin DEF_CHARACTERISTIC CWFABR PFABR TDCIDX0B6H TDCIDX0C4H TDCIDX0CEH TDCIDX153H TDCIDX19EH TDCIDX1A0H TDCIDX1F0H TDCIDX1F3H TDCIDX1F5H TDUNPLDSC2 TSRDSC1 TSRDSC2 TSRDSC3 TSRDSC4 TSRDSC5 /end DEF_CHARACTERISTIC
 /begin IN_MEASUREMENT B_clvar B_npdsc_um B_pwf B_sidsc_um codcan /end IN_MEASUREMENT
 /begin OUT_MEASUREMENT bfzgldsc_w bfzgqars_w B_ascpkw B_asc_reg B_cdscnpv B_dsc1cok B_dsc1new B_dsc2cok B_dsc2new B_dsc3cok B_dsc3new B_dsc4cok B_dsc4new B_dsc5cok B_dsc5new B_dsc_reg B_elws B_emfbra B_evfzgv1 B_fabr dscstat lws_w pbrems stbrems stfabr stvfzg tnodsc1 tnodsc3 tnodsc4 tnodsc5 tnodscnew vfzgv1_w vlws_w vrad_lh vrad_lv vrad_rh vrad_rv /end OUT_MEASUREMENT
 /begin LOC_MEASUREMENT asccod /end LOC_MEASUREMENT
/end FUNCTION
/begin FUNCTION CANEGS "8.50      CAN-Botschafts- und Signaldefinition Getriebesteuerung"
 /begin DEF_CHARACTERISTIC DNMXSSGDR TDCIDX1A2H TDCIDX43BH TDCIDX43FH TDCIDXB5H TDCIDXBAH TDCIDXBDH TDUNPLEGS2 TSREGS1 TSREGS2 TSREGS3 /end DEF_CHARACTERISTIC
 /begin IN_MEASUREMENT B_clvar B_npegs_um B_pwf B_siegs_um codcan stssgerr tmot /end IN_MEASUREMENT
 /begin OUT_MEASUREMENT B_autget B_cegs2npv B_egs1cok B_egs1new B_egs2cok B_egs2new B_egs3cok B_egs3new B_egssbc B_egsssc B_fobdegs B_fs B_got B_got2 B_gts B_mbegegs B_mbegssg B_mstpssgr B_pn B_ssghyp B_ssgschlt B_ssgspmod B_ssgvar B_wk B_wkr codget gangauti mdwanc migs migslm nmaxssg_w nturbc_w obdstegs stegsanzei stegsmd stsscsbc stssgkpl stssgsv tget tnoegs1 tnoegs3 tnoegsnew /end OUT_MEASUREMENT
/end FUNCTION
/begin FUNCTION CANINS "6.80      CAN-Botschafts- und Signaldefinition Kombiinstrument"
 /begin DEF_CHARACTERISTIC CWACOFF CWCCNOMILC STM_ERR STM_ERR2 TDCIDX135H TDCIDX1B4H TDCIDX1B5H TDCIDX310H TDCIDX330H TDCIDX613H TDCIDX615H TDCIDXMLS TDUNPLINS4 TSRINS1 TSRINS2 TSRINS3 TSRINS4 TSRINS5 /end DEF_CHARACTERISTIC
 /begin IN_MEASUREMENT B_clvar B_ll B_mil B_pwf B_stend ccflags_l codcan codfzg trsecpm_l /end IN_MEASUREMENT
 /begin OUT_MEASUREMENT B_ac B_ac2 B_cinsnvp B_fstcanok B_hls B_hzl B_ins1cok B_ins1new B_ins2cok B_ins2new B_ins3cok B_ins3new B_ins4cok B_ins4new B_ins5cok B_ins5new B_insfgre B_insmilon B_km B_ko B_koger B_kovar B_ntkw B_oelstmot B_stdhakt B_talcan B_tns caninsAusBitsNov1 ekpausc fsttankl fsttankr idbosrst idfbosrt_w kmstand kmstfsp_w kmstold_w lb_nll lb_usoll mdkog stmlac ststdheiz swv tfst tnoins1 tnoins2 tnoins3 tnoins4 tnoins5_w trmin_w trsec_l tumgcan vbost vfzgat_w wsanfihka wsstatihka zalvins zrbosr ztageabs_w /end OUT_MEASUREMENT
 /begin LOC_MEASUREMENT stmlscafs stmlsceps stmlscins tnomlsc /end LOC_MEASUREMENT
/end FUNCTION
/begin FUNCTION CANPWML "2.20      Powermanagement Ladespannung" /begin DEF_CHARACTERISTIC NTLUGEN TDCIDX334H TDCIDX3B4H TSRPWML1 TSRPWML2 /end DEF_CHARACTERISTIC /begin IN_MEASUREMENT B_kl15 B_pwf codcan codfzg tumg /end IN_MEASUREMENT
 /begin OUT_MEASUREMENT batt_class B_nstarttx B_pwml1cok B_pwml1new B_pwml2cok B_pwml2new B_sbhspwml B_swokl30 ctrgenms ikurz_ogr ikurz_ugr iwakeupgr n_idlms pmanzsvein pmsv tabkl50pm tbattpm tnopwml1 tnopwml2 trsecpm_l /end OUT_MEASUREMENT
/end FUNCTION
/begin FUNCTION CANRST "1.70" /begin DEF_CHARACTERISTIC CWX5HP TDCIDX315H TDCIDX3B0H TMMIMRK TSRLM1 TSRSZM1 /end DEF_CHARACTERISTIC /begin IN_MEASUREMENT B_egs1cok codcan codget gangauti stegsanzei /end IN_MEASUREMENT
 /begin OUT_MEASUREMENT B_lm1cok B_lm1new B_mmiena B_szm1cok B_szm1csao B_szm1new chksszm1 indxmmimrk mmimrk_w stgangr stmodvec szm1errctr tnolm1 tnoszm1 zalvszm1 /end OUT_MEASUREMENT
/end FUNCTION
/begin FUNCTION CANSZL "2.10      CAN-Botschafts- und Signaldefinition SZ-Lenks‰ule" /begin DEF_CHARACTERISTIC TDCIDX194H TSRSZL1 /end DEF_CHARACTERISTIC /begin IN_MEASUREMENT codcan /end IN_MEASUREMENT /begin OUT_MEASUREMENT B_szl1cok B_szl1new szlbctr tnoszlnew /end OUT_MEASUREMENT /end FUNCTION
/begin FUNCTION CAN_CONF "" /end FUNCTION
/begin FUNCTION CCP "2.30      ‹bertragungsprotokoll f¸r Applikationstools" /begin DEF_CHARACTERISTIC CW_CCPAKTIV /end DEF_CHARACTERISTIC /end FUNCTION
/begin FUNCTION CCP_CONF "" /end FUNCTION
/begin COMPU_METHOD acc_ub_b55p55 "" RAT_FUNC "%6.3" "m/(s^2)" COEFFS 0 1 0 0 0 0.217 /end COMPU_METHOD
/begin COMPU_METHOD bfzg_q0p025 "" RAT_FUNC "%6.4" "m/s^2" COEFFS 0 40 0 0 0 1 /end COMPU_METHOD
/begin COMPU_METHOD bfzg_sb_q0p217 "" RAT_FUNC "%6.3" "m/s^2" COEFFS 0 1 0 0 0 0.217 /end COMPU_METHOD
/begin COMPU_METHOD B_TRUE "boolsche Zust‰nde, positive Logik" TAB_VERB "%6.3" "" COMPU_TAB_REF B_TRUE /end COMPU_METHOD
/begin COMPU_VTAB B_TRUE "boolsche Zust‰nde, positive Logik" TAB_VERB 2 0 "----" 1 "TRUE" /end COMPU_VTAB
/begin COMPU_METHOD DEZ "1 : 1 Umrechnug (dez/hex)" RAT_FUNC "%6.2" "" COEFFS 0 1 0 0 0 1 /end COMPU_METHOD
/begin COMPU_METHOD dez "1 : 1 Umrechnug (dez/hex)" RAT_FUNC "%6.2" "" COEFFS 0 1 0 0 0 1 /end COMPU_METHOD
/begin COMPU_METHOD dichte_ub_b2 "" RAT_FUNC "%6.4" "kg/m^3" COEFFS 0 256 0 0 0 2 /end COMPU_METHOD
/begin COMPU_METHOD fak_q0p007843 "" RAT_FUNC "%6.4" "-" COEFFS 0 1 0 0 0 0.007843 /end COMPU_METHOD
/begin COMPU_METHOD fak_r32_1 "" RAT_FUNC "%27.13" "-" COEFFS 0 1 0 0 0 1 /end COMPU_METHOD
/begin COMPU_METHOD fak_sw_b2 "" RAT_FUNC "%7.6" "-" COEFFS 0 65536 0 0 0 4 /end COMPU_METHOD
/begin COMPU_METHOD fak_sw_b8 "" RAT_FUNC "%6.5" "-" COEFFS 0 65536 0 0 0 16 /end COMPU_METHOD
/begin COMPU_METHOD fak_ub_b1 "" RAT_FUNC "%6.4" "-" COEFFS 0 256 0 0 0 1 /end COMPU_METHOD
/begin COMPU_METHOD fak_ub_b2 "" RAT_FUNC "%6.4" "-" COEFFS 0 256 0 0 0 2 /end COMPU_METHOD
/begin COMPU_METHOD fak_ub_b4 "" RAT_FUNC "%6.4" "-" COEFFS 0 256 0 0 0 4 /end COMPU_METHOD
/begin COMPU_METHOD fak_ub_b8 "" RAT_FUNC "%6.4" "-" COEFFS 0 256 0 0 0 8 /end COMPU_METHOD
/begin COMPU_METHOD fak_ub_q0p00392 "" RAT_FUNC "%6.4" "-" COEFFS 0 255 0 0 0 1 /end COMPU_METHOD
/begin COMPU_METHOD fak_uw_b025o32768 "" RAT_FUNC "%8.4" "-" COEFFS 0 262144 32768 0 0 1 /end COMPU_METHOD
/begin COMPU_METHOD fak_uw_b1 "" RAT_FUNC "%7.6" "-" COEFFS 0 65536 0 0 0 1 /end COMPU_METHOD
/begin COMPU_METHOD fak_uw_b16 "" RAT_FUNC "%6.5" "-" COEFFS 0 65536 0 0 0 16 /end COMPU_METHOD
/begin COMPU_METHOD fak_uw_b2 "" RAT_FUNC "%7.6" "-" COEFFS 0 65536 0 0 0 2 /end COMPU_METHOD
/begin COMPU_METHOD fak_uw_b256 "" RAT_FUNC "%6.4" "-" COEFFS 0 65536 0 0 0 256 /end COMPU_METHOD
/begin COMPU_METHOD fak_uw_b4 "" RAT_FUNC "%7.6" "-" COEFFS 0 65536 0 0 0 4 /end COMPU_METHOD
/begin COMPU_METHOD fak_uw_q0p001 "" RAT_FUNC "%6.5" "-" COEFFS 0 65536 0 0 0 65.536 /end COMPU_METHOD
/begin COMPU_METHOD flae_uw_q0p016 "" RAT_FUNC "%6.4" "mm*gKW" COEFFS 0 1 0 0 0 0.016 /end COMPU_METHOD
/begin COMPU_METHOD freq2000_ub "" RAT_FUNC "%5.2" "1/s" COEFFS 0 256 0 0 0 200 /end COMPU_METHOD
/begin COMPU_METHOD fuel_ub_q0p5 "" RAT_FUNC "%6.3" "l" COEFFS 0 2 0 0 0 1 /end COMPU_METHOD
/begin COMPU_METHOD fuel_ub_q1 "" RAT_FUNC "%6.2" "l" COEFFS 0 1 0 0 0 1 /end COMPU_METHOD
/begin COMPU_METHOD fuel_uw_b1 "" RAT_FUNC "%7.6" "ul" COEFFS 0 65536 0 0 0 1 /end COMPU_METHOD
/begin COMPU_METHOD hub_uw_q0p001 "" RAT_FUNC "%6.5" "mm" COEFFS 0 1000 0 0 0 1 /end COMPU_METHOD
/begin COMPU_METHOD igen_ub_q1 "" RAT_FUNC "%6.2" "" COEFFS 0 1 0 0 0 1 /end COMPU_METHOD
/begin COMPU_METHOD i_ub_q0p02 "" RAT_FUNC "%7.4" "A" COEFFS 0 1 0 0 0 0.02 /end COMPU_METHOD
/begin COMPU_METHOD i_ub_q10p0 "" RAT_FUNC "%6.1" "A" COEFFS 0 1 0 0 0 10 /end COMPU_METHOD
/begin COMPU_METHOD km_uw_q10 "" RAT_FUNC "%6.1" "km" COEFFS 0 1 0 0 0 10 /end COMPU_METHOD
/begin COMPU_METHOD kumsrl_ub_b0p002 "" RAT_FUNC "%10.9" "(kg/h)/((1/min)*%)" COEFFS 0 128000 0 0 0 1 /end COMPU_METHOD
/begin COMPU_METHOD lws_q0p04375 "" RAT_FUNC "%6.4" "Grad" COEFFS 0 1 0 0 0 0.04375 /end COMPU_METHOD
/begin COMPU_METHOD md_q0p5 "" RAT_FUNC "%6.3" "Nm" COEFFS 0 1 0 0 0 0.5 /end COMPU_METHOD
/begin COMPU_METHOD md_ub_q1 "" RAT_FUNC "%6.2" "Nm" COEFFS 0 1 0 0 0 1 /end COMPU_METHOD
/begin COMPU_METHOD mk10ms_uw_q2p384e5n "" RAT_FUNC "%6.5" "h(kg*s)" COEFFS 0 41943 0 0 0 10 /end COMPU_METHOD
/begin COMPU_METHOD m_sw_q0p1 "" RAT_FUNC "%6.3" "kg/h" COEFFS 0 1 0 0 0 0.1 /end COMPU_METHOD
/begin COMPU_METHOD m_ub_b0p166 "" RAT_FUNC "%6.5" "1/s" COEFFS 0 255 0 0 0 0.166 /end COMPU_METHOD
/begin COMPU_METHOD m_ub_b1020 "" RAT_FUNC "%6.2" "kg/h" COEFFS 0 1 0 0 0 4 /end COMPU_METHOD
/begin COMPU_METHOD m_ub_b25p6 "" RAT_FUNC "%6.3" "kg/h" COEFFS 0 256 0 0 0 25.6 /end COMPU_METHOD
/begin COMPU_METHOD m_ub_q0p0415 "" RAT_FUNC "%6.4" "kg/(h*s)" COEFFS 0 1 0 0 0 0.0415 /end COMPU_METHOD
/begin COMPU_METHOD m_ub_q0p1 "" RAT_FUNC "%6.3" "kg/h" COEFFS 0 256 0 0 0 25.6 /end COMPU_METHOD
/begin COMPU_METHOD m_uw_b1638p4 "" RAT_FUNC "%6.4" "kg/h" COEFFS 0 1 0 0 0 0.025 /end COMPU_METHOD
/begin COMPU_METHOD m_uw_b25p6 "" RAT_FUNC "%6.5" "kg/h" COEFFS 0 65536 0 0 0 25.6 /end COMPU_METHOD
/begin COMPU_METHOD m_uw_b6553p5 "" RAT_FUNC "%6.3" "kg/h" COEFFS 0 1 0 0 0 0.1 /end COMPU_METHOD
/begin COMPU_METHOD m_uw_q0p0005 "" RAT_FUNC "%6.5" "kg/h" COEFFS 0 1 0 0 0 0.0005 /end COMPU_METHOD
/begin COMPU_METHOD nmotg_sb_q100 "" RAT_FUNC "%6.0" "1/min/s" COEFFS 0 1 0 0 0 100 /end COMPU_METHOD
/begin COMPU_METHOD nmotg_sw_q0p39 "" RAT_FUNC "%6.3" "1/min/s" COEFFS 0 1 0 0 0 0.39063 /end COMPU_METHOD
/begin COMPU_METHOD nmot_q0p125 "" RAT_FUNC "%6.3" "1/min" COEFFS 0 8 0 0 0 1 /end COMPU_METHOD
/begin COMPU_METHOD nmot_sw_q0p25 "" RAT_FUNC "%6.3" "1/min" COEFFS 0 1 0 0 0 0.25 /end COMPU_METHOD
/begin COMPU_METHOD nmot_ub_q10 "" RAT_FUNC "%6.1" "1/min" COEFFS 0 1 0 0 0 10 /end COMPU_METHOD
/begin COMPU_METHOD nmot_ub_q40 "" RAT_FUNC "%6.1" "1/min" COEFFS 0 1 0 0 0 40 /end COMPU_METHOD
/begin COMPU_METHOD nmot_uw_q0p25 "" RAT_FUNC "%6.3" "1/min" COEFFS 0 1 0 0 0 0.25 /end COMPU_METHOD
/begin COMPU_METHOD p_q0p039 "" RAT_FUNC "%6.4" "hPa" COEFFS 0 256 0 0 0 10 /end COMPU_METHOD
/begin COMPU_METHOD p_q0p039s32768 "" RAT_FUNC "%7.1" "hPa" COEFFS 0 256 327680 0 0 10 /end COMPU_METHOD
/begin COMPU_METHOD p_sw_q0p039 "" RAT_FUNC "%6.4" "hPa" COEFFS 0 256 0 0 0 10 /end COMPU_METHOD
/begin COMPU_METHOD p_ub_q10 "" RAT_FUNC "%6.1" "hPa" COEFFS 0 1 0 0 0 10 /end COMPU_METHOD
/begin COMPU_METHOD p_uw_b32 "" RAT_FUNC "%6.5" "hPa/%" COEFFS 0 65536 0 0 0 32 /end COMPU_METHOD
/begin COMPU_METHOD p_uw_q0p039 "" RAT_FUNC "%6.4" "hPa" COEFFS 0 256 0 0 0 10 /end COMPU_METHOD
/begin COMPU_METHOD relDK_q0p02441 "" RAT_FUNC "%6.4" "%DK" COEFFS 0 65536 0 0 0 1600 /end COMPU_METHOD
/begin COMPU_METHOD relDK_ub_b100 "" RAT_FUNC "%6.3" "%DK" COEFFS 0 255 0 0 0 100 /end COMPU_METHOD
/begin COMPU_METHOD relNWU_q0p0234 "" RAT_FUNC "%6.4" "%/NWU" COEFFS 0 32 0 0 0 0.75 /end COMPU_METHOD
/begin COMPU_METHOD rel_sw_b1536 "" RAT_FUNC "%6.4" "%" COEFFS 0 65536 0 0 0 3072 /end COMPU_METHOD
/begin COMPU_METHOD rel_sw_q0p0234 "" RAT_FUNC "%6.4" "%/seg" COEFFS 0 32 0 0 0 0.75 /end COMPU_METHOD
/begin COMPU_METHOD rel_ub_b100 "" RAT_FUNC "%6.3" "%" COEFFS 0 256 0 0 0 100 /end COMPU_METHOD
/begin COMPU_METHOD rel_ub_b2p0 "" RAT_FUNC "%6.4" "%" COEFFS 0 256 0 0 0 2 /end COMPU_METHOD
/begin COMPU_METHOD rel_ub_b99p6 "" RAT_FUNC "%6.3" "%" COEFFS 0 256 0 0 0 100 /end COMPU_METHOD
/begin COMPU_METHOD rel_ub_q0p75 "" RAT_FUNC "%6.3" "%" COEFFS 0 1 0 0 0 0.75 /end COMPU_METHOD
/begin COMPU_METHOD rel_uw_b0p3 "" RAT_FUNC "%8.7" "%/hPa" COEFFS 0 65536 0 0 0 0.3 /end COMPU_METHOD
/begin COMPU_METHOD rel_uw_b100 "" RAT_FUNC "%6.4" "%" COEFFS 0 65536 0 0 0 100 /end COMPU_METHOD
/begin COMPU_METHOD rel_uw_b3072 "" RAT_FUNC "%6.4" "%" COEFFS 0 65536 0 0 0 3072 /end COMPU_METHOD
/begin COMPU_METHOD rel_uw_q0p0234 "" RAT_FUNC "%6.4" "%" COEFFS 0 32 0 0 0 0.75 /end COMPU_METHOD
/begin COMPU_METHOD rgfak_ub_q0p00000037 "" RAT_FUNC "%9.8" "1/(mm*Grad KW*hPa)" COEFFS 0 2684350 0 0 0 1 /end COMPU_METHOD
/begin COMPU_METHOD rgfak_uw_q0p009766 "" RAT_FUNC "%6.4" "1/min" COEFFS 0 102.4 0 0 0 1 /end COMPU_METHOD
/begin COMPU_METHOD spg_gencan "" RAT_FUNC "%6.2" "V" COEFFS 0 40 -424 0 0 1 /end COMPU_METHOD
/begin COMPU_METHOD spg_q0p00039 "" RAT_FUNC "%6.5" "V" COEFFS 0 1 0 0 0 0.000390625 /end COMPU_METHOD
/begin COMPU_METHOD spg_q0p1_o10p6 "" RAT_FUNC "%6.2" "V" COEFFS 0 1 -10.6 0 0 0.1 /end COMPU_METHOD
/begin COMPU_METHOD spg_ubatt "" RAT_FUNC "%6.3" "V" COEFFS 0 1 0 0 0 0.0942 /end COMPU_METHOD
/begin COMPU_METHOD sprzi_q0p1 "" RAT_FUNC "%6.3" "Grad KW" COEFFS 0 10 0 0 0 1 /end COMPU_METHOD
/begin COMPU_METHOD sprzi_q0p1s32768 "" RAT_FUNC "%7.1" "Grad KW" COEFFS 0 10 32768 0 0 1 /end COMPU_METHOD
/begin COMPU_METHOD s_q8_km "" RAT_FUNC "%6.2" "km" COEFFS 0 1 0 0 0 8 /end COMPU_METHOD
/begin COMPU_METHOD t100msxs_ub_b25p5 "" RAT_FUNC "%6.3" "s" COEFFS 0 1 0 0 0 0.1 /end COMPU_METHOD
/begin COMPU_METHOD t100msxs_uw_b6553p5 "" RAT_FUNC "%6.3" "s" COEFFS 0 1 0 0 0 0.1 /end COMPU_METHOD
/begin COMPU_METHOD t10msxs_ub_b2p55 "" RAT_FUNC "%6.4" "s" COEFFS 0 1 0 0 0 0.01 /end COMPU_METHOD
/begin COMPU_METHOD t10msxs_uw_b655p35 "" RAT_FUNC "%6.4" "s" COEFFS 0 1 0 0 0 0.01 /end COMPU_METHOD
/begin COMPU_METHOD t128ms_uw "" RAT_FUNC "%6.4" "ms" COEFFS 0 512 0 0 0 1 /end COMPU_METHOD
/begin COMPU_METHOD t1sxs_q1 "" RAT_FUNC "%6.2" "s" COEFFS 0 1 0 0 0 1 /end COMPU_METHOD
/begin COMPU_METHOD t1sxs_ub_b255 "" RAT_FUNC "%6.2" "s" COEFFS 0 1 0 0 0 1 /end COMPU_METHOD
/begin COMPU_METHOD t1sxs_uw_b65535 "" RAT_FUNC "%6.2" "s" COEFFS 0 1 0 0 0 1 /end COMPU_METHOD
/begin COMPU_METHOD t1sxs_uw_q1 "" RAT_FUNC "%6.2" "s" COEFFS 0 1 0 0 0 1 /end COMPU_METHOD
/begin COMPU_METHOD t200msxs_ub_b51 "" RAT_FUNC "%6.3" "s" COEFFS 0 1 0 0 0 0.2 /end COMPU_METHOD
/begin COMPU_METHOD t20msxs_ub_b5p1 "" RAT_FUNC "%6.4" "s" COEFFS 0 1 0 0 0 0.02 /end COMPU_METHOD
/begin COMPU_METHOD t60s_uw_b65535 "" RAT_FUNC "%6.2" "min" COEFFS 0 1 0 0 0 1 /end COMPU_METHOD
/begin COMPU_METHOD temp_q0p0234 "" RAT_FUNC "%6.4" "K" COEFFS 0 256 0 0 0 6 /end COMPU_METHOD
/begin COMPU_METHOD temp_q0p0234_o273 "" RAT_FUNC "%6.1" "Grad C" COEFFS 0 1 273.15 0 0 0.0234375 /end COMPU_METHOD
/begin COMPU_METHOD temp_q1 "" RAT_FUNC "%6.2" "Grad C" COEFFS 0 1 0 0 0 1 /end COMPU_METHOD
/begin COMPU_METHOD temp_sw_q0p75 "" RAT_FUNC "%6.3" "Grad C" COEFFS 0 4 0 0 0 3 /end COMPU_METHOD
/begin COMPU_METHOD temp_ub_q0p75_o48 "" RAT_FUNC "%6.2" "Grad C" COEFFS 0 1 48 0 0 0.75 /end COMPU_METHOD
/begin COMPU_METHOD tmin_uw_q1 "" RAT_FUNC "%6.2" "min" COEFFS 0 1 0 0 0 1 /end COMPU_METHOD
/begin COMPU_METHOD t_q0p0001_ms "" RAT_FUNC "%7.6" "ms" COEFFS 0 1 0 0 0 0.0001 /end COMPU_METHOD
/begin COMPU_METHOD t_q0p01 "" RAT_FUNC "%6.4" "s" COEFFS 0 100 0 0 0 1 /end COMPU_METHOD
/begin COMPU_METHOD t_q0p02 "" RAT_FUNC "%6.4" "s" COEFFS 0 100 0 0 0 2 /end COMPU_METHOD
/begin COMPU_METHOD t_q0p04_ms "" RAT_FUNC "%6.4" "ms" COEFFS 0 1 0 0 0 0.04 /end COMPU_METHOD
/begin COMPU_METHOD t_q0p1 "" RAT_FUNC "%6.3" "s" COEFFS 0 10 0 0 0 1 /end COMPU_METHOD
/begin COMPU_METHOD t_q1 "" RAT_FUNC "%6.2" "s" COEFFS 0 1 0 0 0 1 /end COMPU_METHOD
/begin COMPU_METHOD t_q16us "" RAT_FUNC "%6.1" "us" COEFFS 0 1 0 0 0 16 /end COMPU_METHOD
/begin COMPU_METHOD vfzg_sw_q0p00781 "" RAT_FUNC "%6.4" "km/h" COEFFS 0 1 0 0 0 0.0078125 /end COMPU_METHOD
/begin COMPU_METHOD vfzg_ub_q1p25 "" RAT_FUNC "%6.2" "km/h" COEFFS 0 1 0 0 0 1.25 /end COMPU_METHOD
/begin COMPU_METHOD vfzg_uw_b512 "" RAT_FUNC "%6.4" "km/h" COEFFS 0 65536 0 0 0 512 /end COMPU_METHOD
/begin COMPU_METHOD vfzg_uw_q0p00781 "" RAT_FUNC "%6.4" "km/h" COEFFS 0 1 0 0 0 0.0078125 /end COMPU_METHOD
/begin COMPU_METHOD vfzg_uw_q0p0078125 "" RAT_FUNC "%6.4" "km/h" COEFFS 0 1 0 0 0 0.0078125 /end COMPU_METHOD
/begin COMPU_METHOD vfzg_uw_q0p0625 "" RAT_FUNC "%6.4" "km/h" COEFFS 0 1 0 0 0 0.0625 /end COMPU_METHOD
/begin COMPU_METHOD vs_uw_b25p6 "" RAT_FUNC "%6.5" "m^3/h" COEFFS 0 65536 0 0 0 25.6 /end COMPU_METHOD
/begin COMPU_METHOD wink_uw_q0p1 "" RAT_FUNC "%6.3" "Grad" COEFFS 0 10 0 0 0 1 /end COMPU_METHOD
/begin COMPU_METHOD zk100msxs_ub_b25p5 "" RAT_FUNC "%6.3" "s" COEFFS 0 0 256 0 10 0 /end COMPU_METHOD
/begin COMPU_METHOD zk100msxs_uw_b6553 "" RAT_FUNC "%6.1" "s" COEFFS 0 0 65536 0 10 0 /end COMPU_METHOD
/begin COMPU_METHOD zk10msxs_uw_b2p55T "" TAB_INTP "%6.3" "s" COMPU_TAB_REF zk10msxs_uw_b2p55T /end COMPU_METHOD
/begin COMPU_TAB zk10msxs_uw_b2p55T "" TAB_INTP 35 128 2.55 145 2.25 163 2 186 1.75 217 1.5 251 1.3 283 1.15 326 1 362 0.9 407 0.8 465 0.7 541 0.6 649 0.5 720 0.45 809 0.4 923 0.35 1074 0.3 1285 0.25 1524 0.21 1872 0.17 2259 0.14 2426 0.13 2620 0.12 2847 0.11 3118 0.1 3446 0.09 3850 0.08 4362 0.07 5030 0.06 5939 0.05 7248 0.04 9288 0.03 12893 0.02 20713 0.01 32767 0 /end COMPU_TAB
/begin COMPU_METHOD zk10msxs_uw_b655 "" RAT_FUNC "%6.2" "s" COEFFS 0 0 65536 0 100 0 /end COMPU_METHOD
/begin COMPU_METHOD zk1sxs_uw_b65535 "" RAT_FUNC "%6.0" "s" COEFFS 0 0 65535 0 1 0 /end COMPU_METHOD
/begin COMPU_METHOD zk20msxs_ub_b5p1 "" RAT_FUNC "%6.4" "s" COEFFS 0 0 5.1 0 1 0 /end COMPU_METHOD
/begin COMPU_METHOD zk20msxs_uw_b1310 "" RAT_FUNC "%6.1" "s" COEFFS 0 0 1310 0 1 0 /end COMPU_METHOD
/begin COMPU_METHOD default "" RAT_FUNC "%6.2" "" COEFFS 0 1 0 0 0 1 /end COMPU_METHOD
/begin RECORD_LAYOUT KfAxU8AyU8SstxS16SstyS16WS16 NO_AXIS_PTS_X 1 SWORD NO_AXIS_PTS_Y 2 SWORD AXIS_PTS_X 3 SWORD INDEX_INCR DIRECT AXIS_PTS_Y 4 SWORD INDEX_INCR DIRECT FNC_VALUES 5 SWORD COLUMN_DIR DIRECT /end RECORD_LAYOUT
/begin RECORD_LAYOUT KfAxU8AyU8SstxU16SstyU16WU16 NO_AXIS_PTS_X 1 UWORD NO_AXIS_PTS_Y 2 UWORD AXIS_PTS_X 3 UWORD INDEX_INCR DIRECT AXIS_PTS_Y 4 UWORD INDEX_INCR DIRECT FNC_VALUES 5 UWORD COLUMN_DIR DIRECT /end RECORD_LAYOUT
/begin RECORD_LAYOUT KfAxUbAyUbSstxUbSstyUbWUb NO_AXIS_PTS_X 1 UBYTE NO_AXIS_PTS_Y 2 UBYTE AXIS_PTS_X 3 UBYTE INDEX_INCR DIRECT AXIS_PTS_Y 4 UBYTE INDEX_INCR DIRECT FNC_VALUES 5 UBYTE COLUMN_DIR DIRECT /end RECORD_LAYOUT
/begin RECORD_LAYOUT KfAxUbAyUbSstxUbSstyUwWUb NO_AXIS_PTS_X 1 UBYTE NO_AXIS_PTS_Y 2 UBYTE AXIS_PTS_X 3 UBYTE INDEX_INCR DIRECT AXIS_PTS_Y 4 UWORD INDEX_INCR DIRECT FNC_VALUES 5 UBYTE COLUMN_DIR DIRECT /end RECORD_LAYOUT
/begin RECORD_LAYOUT KfAxUwAyUwSstxSwSstyUwWUw NO_AXIS_PTS_X 1 UWORD NO_AXIS_PTS_Y 2 UWORD AXIS_PTS_X 3 SWORD INDEX_INCR DIRECT AXIS_PTS_Y 4 UWORD INDEX_INCR DIRECT FNC_VALUES 5 UWORD COLUMN_DIR DIRECT /end RECORD_LAYOUT
/begin RECORD_LAYOUT KfAxUwAyUwSstxUwSstyUwWUw NO_AXIS_PTS_X 1 UWORD NO_AXIS_PTS_Y 2 UWORD AXIS_PTS_X 3 UWORD INDEX_INCR DIRECT AXIS_PTS_Y 4 UWORD INDEX_INCR DIRECT FNC_VALUES 5 UWORD COLUMN_DIR DIRECT /end RECORD_LAYOUT
/begin RECORD_LAYOUT KlASwSstSwWSw NO_AXIS_PTS_X 1 SWORD AXIS_PTS_X 2 SWORD INDEX_INCR DIRECT FNC_VALUES 3 SWORD COLUMN_DIR DIRECT /end RECORD_LAYOUT
/begin RECORD_LAYOUT KlAUbSstUbWUb NO_AXIS_PTS_X 1 UBYTE AXIS_PTS_X 2 UBYTE INDEX_INCR DIRECT FNC_VALUES 3 UBYTE COLUMN_DIR DIRECT /end RECORD_LAYOUT
/begin RECORD_LAYOUT KlAUbSstUbWUw NO_AXIS_PTS_X 1 UBYTE AXIS_PTS_X 2 UBYTE INDEX_INCR DIRECT FNC_VALUES 3 UWORD COLUMN_DIR DIRECT /end RECORD_LAYOUT
/begin RECORD_LAYOUT KlAUbSstUwWUb NO_AXIS_PTS_X 1 UBYTE AXIS_PTS_X 2 UWORD INDEX_INCR DIRECT FNC_VALUES 3 UBYTE COLUMN_DIR DIRECT /end RECORD_LAYOUT
/begin RECORD_LAYOUT KlAUwSstUwWSw NO_AXIS_PTS_X 1 UWORD AXIS_PTS_X 2 UWORD INDEX_INCR DIRECT FNC_VALUES 3 SWORD COLUMN_DIR DIRECT /end RECORD_LAYOUT
/begin RECORD_LAYOUT KlAUwSstUwWUw NO_AXIS_PTS_X 1 UWORD AXIS_PTS_X 2 UWORD INDEX_INCR DIRECT FNC_VALUES 3 UWORD COLUMN_DIR DIRECT /end RECORD_LAYOUT
/begin RECORD_LAYOUT KlAxU8SstxR32WR32 NO_AXIS_PTS_X 1 ULONG AXIS_PTS_X 2 FLOAT32_IEEE INDEX_INCR DIRECT FNC_VALUES 3 FLOAT32_IEEE COLUMN_DIR DIRECT /end RECORD_LAYOUT
/begin RECORD_LAYOUT KlAxU8SstxS16WS16 NO_AXIS_PTS_X 1 SWORD AXIS_PTS_X 2 SWORD INDEX_INCR DIRECT FNC_VALUES 3 SWORD COLUMN_DIR DIRECT /end RECORD_LAYOUT
/begin RECORD_LAYOUT KlAxU8SstxU16WU16 NO_AXIS_PTS_X 1 UWORD AXIS_PTS_X 2 UWORD INDEX_INCR DIRECT FNC_VALUES 3 UWORD COLUMN_DIR DIRECT /end RECORD_LAYOUT
/begin RECORD_LAYOUT KlAxU8SstxU8WU16 NO_AXIS_PTS_X 1 UBYTE AXIS_PTS_X 2 UBYTE INDEX_INCR DIRECT FNC_VALUES 3 UWORD COLUMN_DIR DIRECT /end RECORD_LAYOUT
/begin RECORD_LAYOUT KlAxU8SstxU8WU8 NO_AXIS_PTS_X 1 UBYTE AXIS_PTS_X 2 UBYTE INDEX_INCR DIRECT FNC_VALUES 3 UBYTE COLUMN_DIR DIRECT /end RECORD_LAYOUT
/begin RECORD_LAYOUT KwbWR32 FNC_VALUES 1 FLOAT32_IEEE COLUMN_DIR DIRECT /end RECORD_LAYOUT
/begin RECORD_LAYOUT KwbWU16 FNC_VALUES 1 UWORD COLUMN_DIR DIRECT /end RECORD_LAYOUT
/begin RECORD_LAYOUT KwSb FNC_VALUES 1 SBYTE COLUMN_DIR DIRECT /end RECORD_LAYOUT
/begin RECORD_LAYOUT KwUb FNC_VALUES 1 UBYTE COLUMN_DIR DIRECT /end RECORD_LAYOUT
/begin RECORD_LAYOUT KwUw FNC_VALUES 1 UWORD COLUMN_DIR DIRECT /end RECORD_LAYOUT
/begin RECORD_LAYOUT KwWR32 FNC_VALUES 1 FLOAT32_IEEE COLUMN_DIR DIRECT /end RECORD_LAYOUT
/begin RECORD_LAYOUT KwWS16 FNC_VALUES 1 SWORD COLUMN_DIR DIRECT /end RECORD_LAYOUT
/begin RECORD_LAYOUT KwWU16 FNC_VALUES 1 UWORD COLUMN_DIR DIRECT /end RECORD_LAYOUT
/begin RECORD_LAYOUT KwWU32 FNC_VALUES 1 ULONG COLUMN_DIR DIRECT /end RECORD_LAYOUT
/begin RECORD_LAYOUT KwWU8 FNC_VALUES 1 UBYTE COLUMN_DIR DIRECT /end RECORD_LAYOUT
/end MODULE
/end PROJECT
