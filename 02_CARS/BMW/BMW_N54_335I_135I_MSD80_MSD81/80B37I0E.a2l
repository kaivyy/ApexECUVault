ASAP2_VERSION 1 41
/begin PROJECT MSD70 "Spray Guided DI-System with Piezo Injectors for 6-Cylinder"
/begin HEADER "_default_HeaderComment" PROJECT_NO _0B /end HEADER
/begin MODULE _default_ModuleName "_default_ModuleLongIdentifier"
/begin MOD_COMMON "_default_ModCommonComment" DEPOSIT ABSOLUTE BYTE_ORDER MSB_LAST ALIGNMENT_BYTE 1 ALIGNMENT_WORD 2 ALIGNMENT_LONG 2 ALIGNMENT_FLOAT32_IEEE 2 ALIGNMENT_FLOAT64_IEEE 4 /end MOD_COMMON
/begin MEASUREMENT lv_inh_diag_ebox_cfa "E-Box cooling fan diagnosis: application incidence to inhibit the diagnosis" UBYTE _CNV_S_2_RANGE__0___1_CM 1 100. 0. 1. DISPLAY_IDENTIFIER LV_INH_DIAG_EBOX_CFA ECU_ADDRESS 0xd0003df8 BIT_MASK 0x1 /end MEASUREMENT
/begin CHARACTERISTIC c_amp_dmtl_max "lower altitude threshold for DMTL function / upper ambient pressure for DMTL function" VALUE 0xa102918e _REC_VAL_20_u2 5434.25976563 _CNV_A_R_LINEAR_____131_CM 0. 5434.25976563 DISPLAY_IDENTIFIER C_AMP_DMTL_MAX FORMAT "%7.2" /end CHARACTERISTIC
/begin CHARACTERISTIC c_cod_2_dmtl "2nd  application code word of DMTL function" VALUE 0xa10291c0 _REC_VAL_20_u1 255. _CNV_A_R_LINEAR_____0_CM 0. 255. DISPLAY_IDENTIFIER C_COD_2_DMTL FORMAT "%3.0" /end CHARACTERISTIC
/begin CHARACTERISTIC c_crlc_cur_dmtl_fil "Time constant of pump current filtering" VALUE 0xa10291d6 _REC_VAL_20_u2 0.9999847412109381 _CNV_A_R_LINEAR_____68_CM 0. 0.9999847412109381 DISPLAY_IDENTIFIER C_CRLC_CUR_DMTL_FIL FORMAT "%7.5" /end CHARACTERISTIC
/begin CHARACTERISTIC c_crlc_cur_dmtl_fil_lim "Time constant at the beginning of pump current filtering" VALUE 0xa10291d8 _REC_VAL_20_u2 0.9999847412109381 _CNV_A_R_LINEAR_____68_CM 0. 0.9999847412109381 DISPLAY_IDENTIFIER C_CRLC_CUR_DMTL_FIL_LIM FORMAT "%7.5" /end CHARACTERISTIC
/begin CHARACTERISTIC c_crlc_cur_dmtl_fil_refu "Correlation constant at the beginning of pump current filtering" VALUE 0xa10291da _REC_VAL_20_u2 0.9999847412109381 _CNV_A_R_LINEAR_____68_CM 0. 0.9999847412109381 DISPLAY_IDENTIFIER C_CRLC_CUR_DMTL_FIL_REFU FORMAT "%7.5" /end CHARACTERISTIC
/begin CHARACTERISTIC c_crlc_vb_dmtl_fil "Time constant of VB filtering" VALUE 0xa102923e _REC_VAL_20_u2 0.9999847412109381 _CNV_A_R_LINEAR_____68_CM 0. 0.9999847412109381 DISPLAY_IDENTIFIER C_CRLC_VB_DMTL_FIL FORMAT "%7.5" /end CHARACTERISTIC
/begin CHARACTERISTIC c_crlc_vb_dmtl_fil_lim "Time constant at the beginning of VB filtering" VALUE 0xa1029240 _REC_VAL_20_u2 0.9999847412109381 _CNV_A_R_LINEAR_____68_CM 0. 0.9999847412109381 DISPLAY_IDENTIFIER C_CRLC_VB_DMTL_FIL_LIM FORMAT "%7.5" /end CHARACTERISTIC
/begin CHARACTERISTIC c_cur_dmtl_cor_fil_ofs_amp "Pump current offset in case of ambient pressure" VALUE 0xa10292cc _REC_VAL_20_s2 399.9938 _CNV_A_R_LINEAR_____132_CM -200. 199.9938 DISPLAY_IDENTIFIER C_CUR_DMTL_COR_FIL_OFS_AMP FORMAT "%8.3" /end CHARACTERISTIC
/begin CHARACTERISTIC c_cur_dmtl_dif_cur_dmtl_stat "Delta pump current for pump current" VALUE 0xa10292ce _REC_VAL_20_u2 400. _CNV_A_R_LINEAR_____133_CM 0. 400. DISPLAY_IDENTIFIER C_CUR_DMTL_DIF_CUR_DMTL_STAT FORMAT "%7.3" /end CHARACTERISTIC
/begin CHARACTERISTIC c_cur_dmtl_ref_leak_max "upper threshold of pump current for reference measurement" VALUE 0xa10292d8 _REC_VAL_20_u2 400. _CNV_A_R_LINEAR_____133_CM 0. 400. DISPLAY_IDENTIFIER C_CUR_DMTL_REF_LEAK_MAX FORMAT "%7.3" /end CHARACTERISTIC
/begin CHARACTERISTIC c_cur_dmtl_ref_leak_min "lower threshold of pump current for reference measurement" VALUE 0xa10292da _REC_VAL_20_u2 400. _CNV_A_R_LINEAR_____133_CM 0. 400. DISPLAY_IDENTIFIER C_CUR_DMTL_REF_LEAK_MIN FORMAT "%7.3" /end CHARACTERISTIC
/begin CHARACTERISTIC c_cur_dmtl_ref_ofs "Reference pump current offset" VALUE 0xa10292dc _REC_VAL_20_u2 400. _CNV_A_R_LINEAR_____133_CM 0. 400. DISPLAY_IDENTIFIER C_CUR_DMTL_REF_OFS FORMAT "%7.3" /end CHARACTERISTIC
/begin CHARACTERISTIC c_ena_fco_diag "Threshold consumed fuel for diagnosis enable" VALUE 0xa1029356 _REC_VAL_20_u2 4294.9 _CNV_A_R_LINEAR_____134_CM 0. 4294.9 DISPLAY_IDENTIFIER C_ENA_FCO_DIAG FORMAT "%7.2" /end CHARACTERISTIC
/begin CHARACTERISTIC c_fco_diag_max "Upper tolerance variable for level sensor diagnosis" VALUE 0xa10293ce _REC_VAL_20_s1 255. _CNV_A_R_LINEAR_____76_CM -128. 127. DISPLAY_IDENTIFIER C_FCO_DIAG_MAX FORMAT "%4.0" /end CHARACTERISTIC
/begin CHARACTERISTIC c_fco_diag_min "Lower tolerance variable for level sensor diagnosis" VALUE 0xa10293cf _REC_VAL_20_s1 255. _CNV_A_R_LINEAR_____76_CM -128. 127. DISPLAY_IDENTIFIER C_FCO_DIAG_MIN FORMAT "%4.0" /end CHARACTERISTIC
/begin CHARACTERISTIC c_ftl_dec_ftl_diag_min "minimum level decrease for refueling detection" VALUE 0xa10293ee _REC_VAL_20_s1 255. _CNV_A_R_LINEAR_____76_CM -128. 127. DISPLAY_IDENTIFIER C_FTL_DEC_FTL_DIAG_MIN FORMAT "%4.0" /end CHARACTERISTIC
/begin CHARACTERISTIC c_ftl_diag_max "maximum tank level" VALUE 0xa10293f0 _REC_VAL_20_u2 126. _CNV_A_R_LINEAR_____135_CM 0. 126. DISPLAY_IDENTIFIER C_FTL_DIAG_MAX FORMAT "%6.2" /end CHARACTERISTIC
/begin CHARACTERISTIC c_ftl_diag_min "minimum fuel tank volume for refueling detection" VALUE 0xa10293f2 _REC_VAL_20_s1 255. _CNV_A_R_LINEAR_____76_CM -128. 127. DISPLAY_IDENTIFIER C_FTL_DIAG_MIN FORMAT "%4.0" /end CHARACTERISTIC
/begin CHARACTERISTIC c_ftl_dmtl_max "max. tank level for DMTL function" VALUE 0xa10293f3 _REC_VAL_20_u1 5.04 _CNV_A_R_LINEAR_____76_CM 0. 126. DISPLAY_IDENTIFIER C_FTL_DMTL_MAX FORMAT "%3.0" /end CHARACTERISTIC
/begin CHARACTERISTIC c_ftl_dmtl_min "min. tank level for DMTL function" VALUE 0xa10293f4 _REC_VAL_20_u1 5.04 _CNV_A_R_LINEAR_____76_CM 0. 126. DISPLAY_IDENTIFIER C_FTL_DMTL_MIN FORMAT "%3.0" /end CHARACTERISTIC
/begin CHARACTERISTIC c_hys_ftl_dmtl "hysteresis for tank level bit for DMTL function" VALUE 0xa1029498 _REC_VAL_20_u1 5.04 _CNV_A_R_LINEAR_____76_CM 0. 126. DISPLAY_IDENTIFIER C_HYS_FTL_DMTL FORMAT "%3.0" /end CHARACTERISTIC
/begin CHARACTERISTIC c_r_dmtl "Resistance of pump current measurement" VALUE 0xa102977e _REC_VAL_20_u1 50. _CNV_A_R_LINEAR_____136_CM 0. 50. DISPLAY_IDENTIFIER C_R_DMTL /end CHARACTERISTIC
/begin CHARACTERISTIC c_sum_rep_leak_mes_fuc_max "maximum number of repeated check filler cap checks" VALUE 0xa10297de _REC_VAL_20_u1 255. _CNV_A_R_LINEAR_____0_CM 0. 255. DISPLAY_IDENTIFIER C_SUM_REP_LEAK_MES_FUC_MAX FORMAT "%3.0" /end CHARACTERISTIC
/begin CHARACTERISTIC c_t_cur_dmtl_rough_leak_max "max. time pump current check in rough leak phase" VALUE 0xa1029828 _REC_VAL_20_u2 6553.5 _CNV_A_R_LINEAR_____4_CM 0. 6553.5 DISPLAY_IDENTIFIER C_T_CUR_DMTL_ROUGH_LEAK_MAX FORMAT "%6.1" /end CHARACTERISTIC
/begin CHARACTERISTIC c_t_cur_dmtl_rough_leak_min "min. time pump current check in rough leak phase" VALUE 0xa102982a _REC_VAL_20_u2 6553.5 _CNV_A_R_LINEAR_____4_CM 0. 6553.5 DISPLAY_IDENTIFIER C_T_CUR_DMTL_ROUGH_LEAK_MIN FORMAT "%6.1" /end CHARACTERISTIC
/begin CHARACTERISTIC c_t_cur_dmtl_stat "Time for pump current stable" VALUE 0xa102982c _REC_VAL_20_u2 6553.5 _CNV_A_R_LINEAR_____4_CM 0. 6553.5 DISPLAY_IDENTIFIER C_T_CUR_DMTL_STAT FORMAT "%6.1" /end CHARACTERISTIC
/begin CHARACTERISTIC c_t_dly_cur_dmtl_dif_mes "Current decrease detection delay during measurement" VALUE 0xa1029844 _REC_VAL_20_u2 6553.5 _CNV_A_R_LINEAR_____4_CM 0. 6553.5 DISPLAY_IDENTIFIER C_T_DLY_CUR_DMTL_DIF_MES FORMAT "%6.1" /end CHARACTERISTIC
/begin CHARACTERISTIC c_t_dly_det_refu "Wait period of refueling detection" VALUE 0xa1029846 _REC_VAL_20_u2 655.35 _CNV_A_R_LINEAR_____3_CM 0. 655.35 DISPLAY_IDENTIFIER C_T_DLY_DET_REFU FORMAT "%6.2" /end CHARACTERISTIC
/begin CHARACTERISTIC c_t_dly_dmtls "Waiting time after change-over of solenoid valve" VALUE 0xa1029848 _REC_VAL_20_u1 25.5 _CNV_A_R_LINEAR_____4_CM 0. 25.5 DISPLAY_IDENTIFIER C_T_DLY_DMTLS FORMAT "%4.1" /end CHARACTERISTIC
/begin CHARACTERISTIC c_t_dly_es_pwl "Post-operating wait period until start of DMTL function" VALUE 0xa102984c _REC_VAL_20_u1 25.5 _CNV_A_R_LINEAR_____4_CM 0. 25.5 DISPLAY_IDENTIFIER C_T_DLY_ES_PWL FORMAT "%4.1" /end CHARACTERISTIC
/begin CHARACTERISTIC c_t_dly_fuc_can_off "Delay time with which Check filler Cap - light is switched off" VALUE 0xa102985a _REC_VAL_20_u2 6553.5 _CNV_A_R_LINEAR_____4_CM 0. 6553.5 DISPLAY_IDENTIFIER C_T_DLY_FUC_CAN_OFF FORMAT "%6.1" /end CHARACTERISTIC
/begin CHARACTERISTIC c_t_dly_fuc_can_on "Delay time with which Check filler Cap - light is switched on" VALUE 0xa102985c _REC_VAL_20_u2 6553.5 _CNV_A_R_LINEAR_____4_CM 0. 6553.5 DISPLAY_IDENTIFIER C_T_DLY_FUC_CAN_ON FORMAT "%6.1" /end CHARACTERISTIC
/begin CHARACTERISTIC c_t_dly_igk_ftl "Minimum time for which LV_IGK must be = 1 to issue a validated level" VALUE 0xa1029860 _REC_VAL_20_u1 1.02 _CNV_A_R_LINEAR_____4_CM 0. 25.5 DISPLAY_IDENTIFIER C_T_DLY_IGK_FTL FORMAT "%4.1" /end CHARACTERISTIC
/begin CHARACTERISTIC c_t_dly_req_pwl_dmtl "Post-operating time after no request for extending the post-operating phase is present any longer" VALUE 0xa1029874 _REC_VAL_20_u1 25.5 _CNV_A_R_LINEAR_____4_CM 0. 25.5 DISPLAY_IDENTIFIER C_T_DLY_REQ_PWL_DMTL FORMAT "%4.1" /end CHARACTERISTIC
/begin CHARACTERISTIC c_t_dmtl_eol_max "Max. time for end of line diagnosis after test unit initiation" VALUE 0xa1029880 _REC_VAL_20_u2 6553.5 _CNV_A_R_LINEAR_____4_CM 0. 6553.5 DISPLAY_IDENTIFIER C_T_DMTL_EOL_MAX FORMAT "%6.1" /end CHARACTERISTIC
/begin CHARACTERISTIC c_t_dmtl_max "Maximum time for DMTL diagnosis" VALUE 0xa1029882 _REC_VAL_20_u2 6553.5 _CNV_A_R_LINEAR_____4_CM 0. 6553.5 DISPLAY_IDENTIFIER C_T_DMTL_MAX FORMAT "%6.1" /end CHARACTERISTIC
/begin CHARACTERISTIC c_t_ref_leak_mes_max "Time for reference leakage measurement" VALUE 0xa1029952 _REC_VAL_20_u2 6553.5 _CNV_A_R_LINEAR_____4_CM 0. 6553.5 DISPLAY_IDENTIFIER C_T_REF_LEAK_MES_MAX FORMAT "%6.1" /end CHARACTERISTIC
/begin CHARACTERISTIC c_t_ref_leak_mes_rep_max "Time for repeat reference leakage measurement" VALUE 0xa1029954 _REC_VAL_20_u2 6553.5 _CNV_A_R_LINEAR_____4_CM 0. 6553.5 DISPLAY_IDENTIFIER C_T_REF_LEAK_MES_REP_MAX FORMAT "%6.1" /end CHARACTERISTIC
/begin CHARACTERISTIC c_t_vb_dly_dmtl "Time delay for Vbat monitoring" VALUE 0xa1029990 _REC_VAL_20_u2 6553.5 _CNV_A_R_LINEAR_____4_CM 0. 6553.5 DISPLAY_IDENTIFIER C_T_VB_DLY_DMTL FORMAT "%6.1" /end CHARACTERISTIC
/begin CHARACTERISTIC c_tam_dmtl_min "lower temperature threshold for the DMTL function" VALUE 0xa10299ba _REC_VAL_20_u1 190.5 _CNV_A_R_LINEAR_____16_CM -48. 142.5 DISPLAY_IDENTIFIER C_TAM_DMTL_MIN FORMAT "%5.1" /end CHARACTERISTIC
/begin CHARACTERISTIC c_tco_st_dmtl_min "min. TCO_ST for DMTL enable" VALUE 0xa10299ed _REC_VAL_20_u1 190.5 _CNV_A_R_LINEAR_____16_CM -48. 142.5 DISPLAY_IDENTIFIER C_TCO_ST_DMTL_MIN FORMAT "%5.1" /end CHARACTERISTIC
/begin CHARACTERISTIC c_trt_dmtl_eol_max "" VALUE 0xa1029b4e _REC_VAL_20_u4 119304.6471 _CNV_A_R_LINEAR_____137_CM 0. 119304.6471 DISPLAY_IDENTIFIER C_TRT_DMTL_EOL_MAX FORMAT "%12.5" /end CHARACTERISTIC
/begin CHARACTERISTIC c_vb_dmtl_asa_max "Maximum battery threshold at end of line for DMTL" VALUE 0xa1029bc6 _REC_VAL_20_u1 26. _CNV_A_R_LINEAR_____36_CM 0. 26. DISPLAY_IDENTIFIER C_VB_DMTL_ASA_MAX FORMAT "%4.1" /end CHARACTERISTIC
/begin CHARACTERISTIC c_vb_dmtl_asa_min "Minimum battery threshold at end of line for DMTL" VALUE 0xa1029bc7 _REC_VAL_20_u1 26. _CNV_A_R_LINEAR_____36_CM 0. 26. DISPLAY_IDENTIFIER C_VB_DMTL_ASA_MIN FORMAT "%4.1" /end CHARACTERISTIC
/begin CHARACTERISTIC c_vb_dmtl_max "maximum battery threshold for the DMTL function" VALUE 0xa1029bce _REC_VAL_20_u1 26. _CNV_A_R_LINEAR_____36_CM 0. 26. DISPLAY_IDENTIFIER C_VB_DMTL_MAX FORMAT "%4.1" /end CHARACTERISTIC
/begin CHARACTERISTIC c_vs_ftl_diag_max "" VALUE 0xa1029c9a _REC_VAL_20_u1 255. _CNV_A_R_LINEAR_____6_CM 0. 255. DISPLAY_IDENTIFIER C_VS_FTL_DIAG_MAX FORMAT "%3.0" /end CHARACTERISTIC
/begin MEASUREMENT ctr_cnl_rough_leak_mes_fuc "Number of aborted check filler cap checks" UBYTE _CNV_A_R_LINEAR_____0_CM 1 100. 0. 255. DISPLAY_IDENTIFIER CTR_CNL_ROUGH_LEAK_MES_FUC ECU_ADDRESS 0xd0003e2c FORMAT "%3.0" /end MEASUREMENT
/begin MEASUREMENT ctr_cur_dmtl_ref_dif_max "Number of aborted measurements due to current fluctuation" UWORD _CNV_A_R_LINEAR_____0_CM 1 100. 0. 65535. DISPLAY_IDENTIFIER CTR_CUR_DMTL_REF_DIF_MAX ECU_ADDRESS 0xd0005248 FORMAT "%5.0" /end MEASUREMENT
/begin MEASUREMENT ctr_rep_rough_leak_mes_fuc "Number of repeated check filler cap checks" UBYTE _CNV_A_R_LINEAR_____0_CM 1 100. 0. 255. DISPLAY_IDENTIFIER CTR_REP_ROUGH_LEAK_MES_FUC ECU_ADDRESS 0xd0003e2e FORMAT "%3.0" /end MEASUREMENT
/begin MEASUREMENT cur_dmtl "Pump current tank leakage diagnosis" UWORD _CNV_A_R_LINEAR_____133_CM 1 100. 0. 400. DISPLAY_IDENTIFIER CUR_DMTL ECU_ADDRESS 0xd000524a FORMAT "%7.3" /end MEASUREMENT
/begin MEASUREMENT cur_dmtl_comp_rough_leak "Pump current comparision in case of rough leak measurement" UWORD _CNV_A_R_LINEAR_____133_CM 1 100. 0. 400. DISPLAY_IDENTIFIER CUR_DMTL_COMP_ROUGH_LEAK ECU_ADDRESS 0xc000050e FORMAT "%7.3" /end MEASUREMENT
/begin MEASUREMENT cur_dmtl_comp_small_leak_len "Pump current comparision in case of 2. miniature leak measurement" UWORD _CNV_A_R_LINEAR_____133_CM 1 100. 0. 400. DISPLAY_IDENTIFIER CUR_DMTL_COMP_SMALL_LEAK_LEN ECU_ADDRESS 0xc0000510 FORMAT "%7.3" /end MEASUREMENT
/begin MEASUREMENT cur_dmtl_cor_fil_max "Maximum pump current during reference leka measurement" UWORD _CNV_A_R_LINEAR_____133_CM 1 100. 0. 400. DISPLAY_IDENTIFIER CUR_DMTL_COR_FIL_MAX ECU_ADDRESS 0xc0000514 FORMAT "%7.3" /end MEASUREMENT
/begin MEASUREMENT cur_dmtl_cor_fil_min "Minimum pump current during reference leak  measurement" UWORD _CNV_A_R_LINEAR_____133_CM 1 100. 0. 400. DISPLAY_IDENTIFIER CUR_DMTL_COR_FIL_MIN ECU_ADDRESS 0xc0000518 FORMAT "%7.3" /end MEASUREMENT
/begin MEASUREMENT cur_dmtl_cor_fil_refu_hpf "corrected, high-pass filtered pump current" SWORD _CNV_A_R_LINEAR_____132_CM 1 100. -200. 199.9938 DISPLAY_IDENTIFIER CUR_DMTL_COR_FIL_REFU_HPF ECU_ADDRESS 0xc0000540 FORMAT "%8.3" /end MEASUREMENT
/begin MEASUREMENT cur_dmtl_dif "Differential pump current" UWORD _CNV_A_R_LINEAR_____133_CM 1 100. 0. 400. DISPLAY_IDENTIFIER CUR_DMTL_DIF ECU_ADDRESS 0xc000051a FORMAT "%7.3" /end MEASUREMENT
/begin MEASUREMENT cur_dmtl_dif_ref_rough_leak "Difference, pump current  between reference and min. in case of rough leak check" UWORD _CNV_A_R_LINEAR_____133_CM 1 100. 0. 400. DISPLAY_IDENTIFIER CUR_DMTL_DIF_REF_ROUGH_LEAK ECU_ADDRESS 0xd000524c FORMAT "%7.3" /end MEASUREMENT
/begin MEASUREMENT cur_dmtl_ref_leak "Pump current reference leakage" UWORD _CNV_A_R_LINEAR_____133_CM 1 100. 0. 400. DISPLAY_IDENTIFIER CUR_DMTL_REF_LEAK ECU_ADDRESS 0xd0005252 FORMAT "%7.3" /end MEASUREMENT
/begin MEASUREMENT cur_dmtl_rough_leak_len_end "Pump current at the end of the rough leak measurement extension" UWORD _CNV_A_R_LINEAR_____133_CM 1 100. 0. 400. DISPLAY_IDENTIFIER CUR_DMTL_ROUGH_LEAK_LEN_END ECU_ADDRESS 0xc0000520 FORMAT "%7.3" /end MEASUREMENT
/begin MEASUREMENT cur_dmtl_rough_leak_min "Min. pump current in case of rough leak measurement" UWORD _CNV_A_R_LINEAR_____133_CM 1 100. 0. 400. DISPLAY_IDENTIFIER CUR_DMTL_ROUGH_LEAK_MIN ECU_ADDRESS 0xd0005256 FORMAT "%7.3" /end MEASUREMENT
/begin MEASUREMENT cur_dmtl_thd_rough_leak_len "Pump current threshold in case of rough leak measurement extension" UWORD _CNV_A_R_LINEAR_____133_CM 1 100. 0. 400. DISPLAY_IDENTIFIER CUR_DMTL_THD_ROUGH_LEAK_LEN ECU_ADDRESS 0xc0000528 FORMAT "%7.3" /end MEASUREMENT
/begin MEASUREMENT fco_av_dmtl "currently consumed fuel" UWORD _CNV_A_R_LINEAR_____134_CM 1 100. 0. 4294.9 DISPLAY_IDENTIFIER FCO_AV_DMTL ECU_ADDRESS 0xd000525a FORMAT "%7.2" /end MEASUREMENT
/begin MEASUREMENT state_dmtl "DMTL state" UBYTE _CNV_S_13_STATE_DMTL_138_CM 1 100. 0. 12. DISPLAY_IDENTIFIER STATE_DMTL ECU_ADDRESS 0xd0003e32 /end MEASUREMENT
/begin MEASUREMENT t_act_cur_dmtl_stat "Current time, pump current stable" UWORD _CNV_A_R_LINEAR_____4_CM 1 100. 0. 6553.5 DISPLAY_IDENTIFIER T_ACT_CUR_DMTL_STAT ECU_ADDRESS 0xc000052c FORMAT "%6.1" /end MEASUREMENT
/begin MEASUREMENT t_act_leak_mes "Current time, leakage measurement" UWORD _CNV_A_R_LINEAR_____4_CM 1 100. 0. 6553.5 DISPLAY_IDENTIFIER T_ACT_LEAK_MES ECU_ADDRESS 0xd0005264 FORMAT "%6.1" /end MEASUREMENT
/begin MEASUREMENT t_act_ref_leak_mes "Current time, reference leakage measurement" UWORD _CNV_A_R_LINEAR_____4_CM 1 100. 0. 6553.5 DISPLAY_IDENTIFIER T_ACT_REF_LEAK_MES ECU_ADDRESS 0xc000052e FORMAT "%6.1" /end MEASUREMENT
/begin MEASUREMENT cur_dmtl_dmtls_test "pump current during pump test" UWORD _CNV_A_R_LINEAR_____133_CM 1 100. 0. 400. DISPLAY_IDENTIFIER CUR_DMTL_DMTLS_TEST ECU_ADDRESS 0xd000524e FORMAT "%7.3" /end MEASUREMENT
/begin MEASUREMENT cur_dmtl_thd_rough_leak "Pump current threshold in case of rough leak measurement" UWORD _CNV_A_R_LINEAR_____133_CM 1 100. 0. 400. DISPLAY_IDENTIFIER CUR_DMTL_THD_ROUGH_LEAK ECU_ADDRESS 0xc0000526 FORMAT "%7.3" /end MEASUREMENT
/begin MEASUREMENT cur_dmtl_thd_dmtls_test "Pump current threshold in case of DMTL valve check" UWORD _CNV_A_R_LINEAR_____133_CM 1 100. 0. 400. DISPLAY_IDENTIFIER CUR_DMTL_THD_DMTLS_TEST ECU_ADDRESS 0xc0000524 FORMAT "%7.3" /end MEASUREMENT
/begin CHARACTERISTIC c_t_act_small_leak "Time for miniature leak measurement" VALUE 0xa10297e6 _REC_VAL_20_u2 6553.2 _CNV_A_R_LINEAR_____4_CM 0.3 6553.5 DISPLAY_IDENTIFIER C_T_ACT_SMALL_LEAK FORMAT "%6.1" /end CHARACTERISTIC
/begin CHARACTERISTIC ip_t_act_small_leak__ftl "Time for miniature leak measurement" CURVE 0xa1027900 _REC_CUR_20_u2_u1 655.35 _CNV_A_R_LINEAR_____4_CM 0. 6553.5 DISPLAY_IDENTIFIER IP_T_ACT_SMALL_LEAK__FTL FORMAT "%6.1"
 /begin AXIS_DESCR COM_AXIS ftl _CNV_A_R_LINEAR_____76_CM 5 0. 126. FORMAT "%3.0" AXIS_PTS_REF ldp_ftl__t_small_leak_test /end AXIS_DESCR
/end CHARACTERISTIC
/begin CHARACTERISTIC ip_fac_cur_dmtl_ref "Factor delta pump current for rouh leak detection concerning reference" CURVE 0xa10234a4 _REC_CUR_20_u2_u2 0.9999847412109381 _CNV_A_R_LINEAR_____68_CM 0. 0.9999847412109381 DISPLAY_IDENTIFIER IP_FAC_CUR_DMTL_REF FORMAT "%7.5"
 /begin AXIS_DESCR COM_AXIS cur_dmtl_dif_ref_rough_leak _CNV_A_R_LINEAR_____133_CM 8 0. 400. FORMAT "%7.3" AXIS_PTS_REF ldpm_cur_dmtldifrefroughleak_1 /end AXIS_DESCR
/end CHARACTERISTIC
/begin CHARACTERISTIC ip_t_cur_dmtl_stat "Time for pump current stable" MAP 0xa1027ba4 _REC_MAP_20_u2_u2_u1 655.35 _CNV_A_R_LINEAR_____4_CM 0. 6553.5 DISPLAY_IDENTIFIER IP_T_CUR_DMTL_STAT FORMAT "%6.1"
 /begin AXIS_DESCR COM_AXIS cur_dmtl_dif_ref_rough_leak _CNV_A_R_LINEAR_____133_CM 8 0. 400. FORMAT "%7.3" AXIS_PTS_REF ldpm_cur_dmtldifrefroughleak_1 /end AXIS_DESCR
 /begin AXIS_DESCR COM_AXIS ftl _CNV_A_R_LINEAR_____76_CM 8 0. 126. FORMAT "%3.0" AXIS_PTS_REF ldp_ftl__t_cur_dmtl_stat /end AXIS_DESCR
/end CHARACTERISTIC
/begin CHARACTERISTIC c_t_ref_test_rough_leak "Time for reference test in case of rough leak check" VALUE 0xa1029956 _REC_VAL_20_u2 6553.5 _CNV_A_R_LINEAR_____4_CM 0. 6553.5 DISPLAY_IDENTIFIER C_T_REF_TEST_ROUGH_LEAK FORMAT "%6.1" /end CHARACTERISTIC
/begin CHARACTERISTIC c_fac_t_cur_dmtl_stat_len "Factor for 2. stabilization" VALUE 0xa102939e _REC_VAL_20_u2 0.9999847412109381 _CNV_A_R_LINEAR_____68_CM 0. 0.9999847412109381 DISPLAY_IDENTIFIER C_FAC_T_CUR_DMTL_STAT_LEN FORMAT "%7.5" /end CHARACTERISTIC
/begin MEASUREMENT cur_dmtl_cor "Corrected pump current" UWORD _CNV_A_R_LINEAR_____133_CM 1 100. 0. 400. DISPLAY_IDENTIFIER CUR_DMTL_COR ECU_ADDRESS 0xc0000512 FORMAT "%7.3" /end MEASUREMENT
/begin MEASUREMENT cur_dmtl_cor_fil "corrected and filtered pump current" ULONG _CNV_A_R_LINEAR_____139_CM 1 100. 0. 400. DISPLAY_IDENTIFIER CUR_DMTL_COR_FIL ECU_ADDRESS 0xd00057e4 FORMAT "%7.3" /end MEASUREMENT
/begin CHARACTERISTIC ip_fac_cur_dmtl "Battery-voltage dependent correction factor for the pump current" CURVE 0xa102348e _REC_CUR_20_u1_u2 1.9921875 _CNV_A_R_LINEAR_____100_CM 0. 1.9921875 DISPLAY_IDENTIFIER IP_FAC_CUR_DMTL FORMAT "%5.3"
 /begin AXIS_DESCR COM_AXIS vb_dmtl_fil _CNV_A_R_LINEAR_____140_CM 6 0. 26. FORMAT "%7.4" AXIS_PTS_REF ldp_vb_dmtl_fil__fac_cur_dmtl /end AXIS_DESCR
/end CHARACTERISTIC
/begin MEASUREMENT vb_dmtl_ref "Filtered battery voltage on transition to refeence leak measurement" UWORD _CNV_A_R_LINEAR_____140_CM 1 100. 0. 26. DISPLAY_IDENTIFIER VB_DMTL_REF ECU_ADDRESS 0xc000053e FORMAT "%7.4" /end MEASUREMENT
/begin MEASUREMENT vb_dmtl_fil "Filtered battery voltage" UWORD _CNV_A_R_LINEAR_____140_CM 1 100. 0. 26. DISPLAY_IDENTIFIER VB_DMTL_FIL ECU_ADDRESS 0xd000526a FORMAT "%7.4" /end MEASUREMENT
/begin CHARACTERISTIC c_cl_dmtl_max "maximum loading degree for the DMTL function" VALUE 0xa10291b4 _REC_VAL_20_u2 1.99996948242188 _CNV_A_R_LINEAR_____8_CM 0. 1.99996948242188 DISPLAY_IDENTIFIER C_CL_DMTL_MAX FORMAT "%7.5" /end CHARACTERISTIC
/begin CHARACTERISTIC c_vs_fuc_can_min "Minimum speed for activation Check filler cap" VALUE 0xa1029c9b _REC_VAL_20_u1 255. _CNV_A_R_LINEAR_____6_CM 0. 255. DISPLAY_IDENTIFIER C_VS_FUC_CAN_MIN FORMAT "%3.0" /end CHARACTERISTIC
/begin CHARACTERISTIC c_vs_dmtl_max "max. vehicle speed" VALUE 0xa1029c90 _REC_VAL_20_u1 255. _CNV_A_R_LINEAR_____6_CM 0. 255. DISPLAY_IDENTIFIER C_VS_DMTL_MAX FORMAT "%3.0" /end CHARACTERISTIC
/begin MEASUREMENT ftl_ini "Ini value level for diagnostic cycle" UBYTE _CNV_A_R_LINEAR_____76_CM 1 100. 0. 126. DISPLAY_IDENTIFIER FTL_INI ECU_ADDRESS 0xd0003e30 FORMAT "%3.0" /end MEASUREMENT
/begin MEASUREMENT ftl_old "FTL for plausibility check" UBYTE _CNV_A_R_LINEAR_____76_CM 1 100. 0. 126. DISPLAY_IDENTIFIER FTL_OLD ECU_ADDRESS 0xd0003e31 FORMAT "%3.0" /end MEASUREMENT
/begin CHARACTERISTIC c_sum_cnl_leak_mes_fuc_max "maximum number of aborted check filler cap checks" VALUE 0xa10297d2 _REC_VAL_20_u1 255. _CNV_A_R_LINEAR_____0_CM 0. 255. DISPLAY_IDENTIFIER C_SUM_CNL_LEAK_MES_FUC_MAX FORMAT "%3.0" /end CHARACTERISTIC
/begin CHARACTERISTIC c_sum_cnl_small_leak_mes_max "Max. number of aborted miniature leak  checks due to current fluctuations" VALUE 0xa10297d3 _REC_VAL_20_u1 255. _CNV_A_R_LINEAR_____0_CM 0. 255. DISPLAY_IDENTIFIER C_SUM_CNL_SMALL_LEAK_MES_MAX FORMAT "%3.0" /end CHARACTERISTIC
/begin CHARACTERISTIC c_cur_dmtl_ref_dif_max "Upper threshold of the Delta pump current" VALUE 0xa10292d6 _REC_VAL_20_u2 400. _CNV_A_R_LINEAR_____133_CM 0. 400. DISPLAY_IDENTIFIER C_CUR_DMTL_REF_DIF_MAX FORMAT "%7.3" /end CHARACTERISTIC
/begin CHARACTERISTIC c_cur_dmtl_dif_thd_refu "Threshold pump current change for refueling detection" VALUE 0xa10292d4 _REC_VAL_20_s2 399.9938 _CNV_A_R_LINEAR_____132_CM -200. 199.9938 DISPLAY_IDENTIFIER C_CUR_DMTL_DIF_THD_REFU FORMAT "%8.3" /end CHARACTERISTIC
/begin CHARACTERISTIC c_cur_dmtl_dif_thd_fuc "Threshold pump current change for refueling detection" VALUE 0xa10292d0 _REC_VAL_20_s2 399.9938 _CNV_A_R_LINEAR_____132_CM -200. 199.9938 DISPLAY_IDENTIFIER C_CUR_DMTL_DIF_THD_FUC FORMAT "%8.3" /end CHARACTERISTIC
/begin CHARACTERISTIC c_cur_dmtl_dif_thd_mes "Current decrease threshold during measurement" VALUE 0xa10292d2 _REC_VAL_20_u2 400. _CNV_A_R_LINEAR_____133_CM 0. 400. DISPLAY_IDENTIFIER C_CUR_DMTL_DIF_THD_MES FORMAT "%7.3" /end CHARACTERISTIC
/begin CHARACTERISTIC c_dist_refu_rough_leak_min "lower threshold of distance covered between refueling and rough leak suspicion" VALUE 0xa102930a _REC_VAL_20_u2 65535. _CNV_A_R_LINEAR_____141_CM 0. 65535. DISPLAY_IDENTIFIER C_DIST_REFU_ROUGH_LEAK_MIN FORMAT "%5.0" /end CHARACTERISTIC
/begin AXIS_PTS ldp_ftl__t_cur_dmtl_stat "" 0xa1020a38 ftl _REC_AXS_20_u1 126. _CNV_A_R_LINEAR_____76_CM 8 0. 126. FORMAT "%3.0" /end AXIS_PTS
/begin AXIS_PTS ldp_ftl__t_small_leak_test "" 0xa1020a48 ftl _REC_AXS_20_u1 126. _CNV_A_R_LINEAR_____76_CM 5 0. 126. FORMAT "%3.0" /end AXIS_PTS
/begin AXIS_PTS ldp_vb_dmtl_fil__fac_cur_dmtl "" 0xa102170c vb_dmtl_fil _REC_AXS_20_u2 26. _CNV_A_R_LINEAR_____140_CM 6 0. 26. FORMAT "%7.4" /end AXIS_PTS
/begin AXIS_PTS ldpm_cur_dmtldifrefroughleak_1 "" 0xa1021930 cur_dmtl_dif_ref_rough_leak _REC_AXS_20_u2 400. _CNV_A_R_LINEAR_____133_CM 8 0. 400. FORMAT "%7.3" /end AXIS_PTS
/begin AXIS_PTS ldp_ftl__t_rough_leak_test "" 0xa1020a42 ftl _REC_AXS_20_u1 126. _CNV_A_R_LINEAR_____76_CM 5 0. 126. FORMAT "%3.0" /end AXIS_PTS
/begin MEASUREMENT dmtl_priv_state_1.bitfield.lv_cur_dmtl_dmtls_test "Pump current threshold reached in case of  DMTL-valve check" ULONG _CNV_S_2_RANGE______75_CM 1 100. 0. 1. DISPLAY_IDENTIFIER LV_CUR_DMTL_DMTLS_TEST ECU_ADDRESS 0xc000054c BIT_MASK 0x40 /end MEASUREMENT
/begin MEASUREMENT dmtl_priv_state_1.bitfield.lv_cur_dmtl_ref_mes_max "Upper pump current threshold reached during reference measurement" ULONG _CNV_S_2_RANGE______75_CM 1 100. 0. 1. DISPLAY_IDENTIFIER LV_CUR_DMTL_REF_MES_MAX ECU_ADDRESS 0xc000054c BIT_MASK 0x80 /end MEASUREMENT
/begin MEASUREMENT dmtl_priv_state_1.bitfield.lv_cur_dmtl_ref_mes_min "Lower pump current threshold reached during reference measurement" ULONG _CNV_S_2_RANGE______75_CM 1 100. 0. 1. DISPLAY_IDENTIFIER LV_CUR_DMTL_REF_MES_MIN ECU_ADDRESS 0xc000054c BIT_MASK 0x100 /end MEASUREMENT
/begin MEASUREMENT dmtl_priv_state_1.bitfield.lv_dist_dmtl "Minimum distance after suspected rough leak or refueling" ULONG _CNV_S_2_RANGE______75_CM 1 100. 0. 1. DISPLAY_IDENTIFIER LV_DIST_DMTL ECU_ADDRESS 0xc000054c BIT_MASK 0x2000 /end MEASUREMENT
/begin MEASUREMENT dmtl_priv_state_1.bitfield.lv_dmtl_asa "Factory test active" ULONG _CNV_S_2_RANGE______75_CM 1 100. 0. 1. DISPLAY_IDENTIFIER LV_DMTL_ASA ECU_ADDRESS 0xc000054c BIT_MASK 0x4000 /end MEASUREMENT
/begin MEASUREMENT dmtl_priv_state_1.bitfield.lv_dmtl_eol "End of line test active" ULONG _CNV_S_2_RANGE______75_CM 1 100. 0. 1. DISPLAY_IDENTIFIER LV_DMTL_EOL ECU_ADDRESS 0xc000054c BIT_MASK 0x8000 /end MEASUREMENT
/begin MEASUREMENT dmtl_priv_state_1.bitfield.lv_dmtl_pump_on "DMTL pump motor on" ULONG _CNV_S_2_RANGE______75_CM 1 100. 0. 1. DISPLAY_IDENTIFIER LV_DMTL_PUMP_ON ECU_ADDRESS 0xc000054c BIT_MASK 0x40000 /end MEASUREMENT
/begin MEASUREMENT dmtl_priv_state_1.bitfield.lv_dmtl_rst_rough_leak "inhibit small leak diagnosis" ULONG _CNV_S_2_RANGE______75_CM 1 100. 0. 1. DISPLAY_IDENTIFIER LV_DMTL_RST_ROUGH_LEAK ECU_ADDRESS 0xc000054c BIT_MASK 0x80000 /end MEASUREMENT
/begin MEASUREMENT dmtl_priv_state_1.bitfield.lv_dmtls_on "DMTL valve on" ULONG _CNV_S_2_RANGE______75_CM 1 100. 0. 1. DISPLAY_IDENTIFIER LV_DMTLS_ON ECU_ADDRESS 0xc000054c BIT_MASK 0x100000 /end MEASUREMENT
/begin MEASUREMENT dmtl_priv_state_1.bitfield.lv_dr_dmtl "Enabling the output stages of the DMTL module" ULONG _CNV_S_2_RANGE______75_CM 1 100. 0. 1. DISPLAY_IDENTIFIER LV_DR_DMTL ECU_ADDRESS 0xc000054c BIT_MASK 0x200000 /end MEASUREMENT
/begin MEASUREMENT dmtl_priv_state_1.bitfield.lv_dr_dmtl_pump "DMTL pump activation" ULONG _CNV_S_2_RANGE______75_CM 1 100. 0. 1. DISPLAY_IDENTIFIER LV_DR_DMTL_PUMP ECU_ADDRESS 0xc000054c BIT_MASK 0x400000 /end MEASUREMENT
/begin MEASUREMENT dmtl_priv_state_1.bitfield.lv_ena_fco_diag "Consumption diagnosis enable" ULONG _CNV_S_2_RANGE______75_CM 1 100. 0. 1. DISPLAY_IDENTIFIER LV_ENA_FCO_DIAG ECU_ADDRESS 0xc000054c BIT_MASK 0x800000 /end MEASUREMENT
/begin MEASUREMENT dmtl_priv_state_1.bitfield.lv_ena_ftl_diag "Fuel level diagnosis enable" ULONG _CNV_S_2_RANGE______75_CM 1 100. 0. 1. DISPLAY_IDENTIFIER LV_ENA_FTL_DIAG ECU_ADDRESS 0xc000054c BIT_MASK 0x1000000 /end MEASUREMENT
/begin MEASUREMENT dmtl_priv_state_2.bitfield.lv_ena_fuc_rough_leak_mes "Enable rough leak measurement due to Check Filler Cap" ULONG _CNV_S_2_RANGE______75_CM 1 100. 0. 1. DISPLAY_IDENTIFIER LV_ENA_FUC_ROUGH_LEAK_MES ECU_ADDRESS 0xc0000550 BIT_MASK 0x1 /end MEASUREMENT
/begin MEASUREMENT dmtl_priv_state_2.bitfield.lv_ena_main_dmtl "DMTL main enabling" ULONG _CNV_S_2_RANGE______75_CM 1 100. 0. 1. DISPLAY_IDENTIFIER LV_ENA_MAIN_DMTL ECU_ADDRESS 0xc0000550 BIT_MASK 0x2 /end MEASUREMENT
/begin MEASUREMENT dmtl_priv_state_2.bitfield.lv_ena_main_dmtl_fuc "Main enabling DMTL Check Filler Cap" ULONG _CNV_S_2_RANGE______75_CM 1 100. 0. 1. DISPLAY_IDENTIFIER LV_ENA_MAIN_DMTL_FUC ECU_ADDRESS 0xc0000550 BIT_MASK 0x4 /end MEASUREMENT
/begin MEASUREMENT dmtl_priv_state_2.bitfield.lv_ena_rough_leak_1 "Auxiliary bit enable condition for rough leak check is present" ULONG _CNV_S_2_RANGE______75_CM 1 100. 0. 1. DISPLAY_IDENTIFIER LV_ENA_ROUGH_LEAK_1 ECU_ADDRESS 0xc0000550 BIT_MASK 0x8 /end MEASUREMENT
/begin MEASUREMENT dmtl_priv_state_2.bitfield.lv_ena_rough_leak_2 "Auxiliary bit enabling rough leak check through manual activation" ULONG _CNV_S_2_RANGE______75_CM 1 100. 0. 1. DISPLAY_IDENTIFIER LV_ENA_ROUGH_LEAK_2 ECU_ADDRESS 0xc0000550 BIT_MASK 0x10 /end MEASUREMENT
/begin MEASUREMENT dmtl_priv_state_2.bitfield.lv_ena_rough_leak_3 "Auxiliary bit interruption of rough leak check" ULONG _CNV_S_2_RANGE______75_CM 1 100. 0. 1. DISPLAY_IDENTIFIER LV_ENA_ROUGH_LEAK_3 ECU_ADDRESS 0xc0000550 BIT_MASK 0x20 /end MEASUREMENT
/begin MEASUREMENT dmtl_priv_state_2.bitfield.lv_ena_rough_leak_mes "Enabling rough leak measurement" ULONG _CNV_S_2_RANGE______75_CM 1 100. 0. 1. DISPLAY_IDENTIFIER LV_ENA_ROUGH_LEAK_MES ECU_ADDRESS 0xc0000550 BIT_MASK 0x100 /end MEASUREMENT
/begin MEASUREMENT dmtl_priv_state_2.bitfield.lv_ena_rough_leak_mes_only "Enable only rough leak measurement" ULONG _CNV_S_2_RANGE______75_CM 1 100. 0. 1. DISPLAY_IDENTIFIER LV_ENA_ROUGH_LEAK_MES_ONLY ECU_ADDRESS 0xc0000550 BIT_MASK 0x200 /end MEASUREMENT
/begin MEASUREMENT dmtl_priv_state_2.bitfield.lv_ena_small_leak_1 "Enable for miniature leak check via test unit intervention" ULONG _CNV_S_2_RANGE______75_CM 1 100. 0. 1. DISPLAY_IDENTIFIER LV_ENA_SMALL_LEAK_1 ECU_ADDRESS 0xc0000550 BIT_MASK 0x800 /end MEASUREMENT
/begin MEASUREMENT dmtl_priv_state_2.bitfield.lv_ena_small_leak_mes_end "End of enable miniature leak measurement" ULONG _CNV_S_2_RANGE______75_CM 1 100. 0. 1. DISPLAY_IDENTIFIER LV_ENA_SMALL_LEAK_MES_END ECU_ADDRESS 0xc0000550 BIT_MASK 0x1000 /end MEASUREMENT
/begin MEASUREMENT dmtl_priv_state_2.bitfield.lv_fco_diag_max "Upper consumption diagnosis threshold" ULONG _CNV_S_2_RANGE______75_CM 1 100. 0. 1. DISPLAY_IDENTIFIER LV_FCO_DIAG_MAX ECU_ADDRESS 0xc0000550 BIT_MASK 0x10000 /end MEASUREMENT
/begin MEASUREMENT dmtl_priv_state_2.bitfield.lv_fco_diag_min "Lower consumption diagnosis threshold" ULONG _CNV_S_2_RANGE______75_CM 1 100. 0. 1. DISPLAY_IDENTIFIER LV_FCO_DIAG_MIN ECU_ADDRESS 0xc0000550 BIT_MASK 0x20000 /end MEASUREMENT
/begin MEASUREMENT dmtl_priv_state_2.bitfield.lv_fco_h_ftl "Consumed fuel greater than tank level" ULONG _CNV_S_2_RANGE______75_CM 1 100. 0. 1. DISPLAY_IDENTIFIER LV_FCO_H_FTL ECU_ADDRESS 0xc0000550 BIT_MASK 0x40000 /end MEASUREMENT
/begin MEASUREMENT dmtl_priv_state_2.bitfield.lv_ftl_dec "Tank volume has decreased" ULONG _CNV_S_2_RANGE______75_CM 1 100. 0. 1. DISPLAY_IDENTIFIER LV_FTL_DEC ECU_ADDRESS 0xc0000550 BIT_MASK 0x800000 /end MEASUREMENT
/begin MEASUREMENT dmtl_priv_state_2.bitfield.lv_ftl_dec_igk_on "Tank filling volume has decreased in case of ignition key ON" ULONG _CNV_S_2_RANGE______75_CM 1 100. 0. 1. DISPLAY_IDENTIFIER LV_FTL_DEC_IGK_ON ECU_ADDRESS 0xc0000550 BIT_MASK 0x1000000 /end MEASUREMENT
/begin MEASUREMENT dmtl_priv_state_2.bitfield.lv_ftl_dmtl_max "max. tank level for DMTL function" ULONG _CNV_S_2_RANGE______75_CM 1 100. 0. 1. DISPLAY_IDENTIFIER LV_FTL_DMTL_MAX ECU_ADDRESS 0xc0000550 BIT_MASK 0x4000000 /end MEASUREMENT
/begin MEASUREMENT dmtl_priv_state_2.bitfield.lv_ftl_dmtl_min "min. tank level for DMTL function" ULONG _CNV_S_2_RANGE______75_CM 1 100. 0. 1. DISPLAY_IDENTIFIER LV_FTL_DMTL_MIN ECU_ADDRESS 0xc0000550 BIT_MASK 0x8000000 /end MEASUREMENT
/begin MEASUREMENT dmtl_priv_state_3.bitfield.lv_ftl_dyn "Level dynamics due to refueling" ULONG _CNV_S_2_RANGE______75_CM 1 100. 0. 1. DISPLAY_IDENTIFIER LV_FTL_DYN ECU_ADDRESS 0xc0000554 BIT_MASK 0x1 /end MEASUREMENT
/begin MEASUREMENT dmtl_priv_state_3.bitfield.lv_ftl_inc "Tank volume has increased" ULONG _CNV_S_2_RANGE______75_CM 1 100. 0. 1. DISPLAY_IDENTIFIER LV_FTL_INC ECU_ADDRESS 0xc0000554 BIT_MASK 0x2 /end MEASUREMENT
/begin MEASUREMENT dmtl_priv_state_3.bitfield.lv_ftl_inc_igk_on "Tank filling volume has increased in case of ignition key ON" ULONG _CNV_S_2_RANGE______75_CM 1 100. 0. 1. DISPLAY_IDENTIFIER LV_FTL_INC_IGK_ON ECU_ADDRESS 0xc0000554 BIT_MASK 0x4 /end MEASUREMENT
/begin MEASUREMENT dmtl_priv_state_3.bitfield.lv_no_purge_dr_dmtl "Pulse width modulation of canister-purge" ULONG _CNV_S_2_RANGE______75_CM 1 100. 0. 1. DISPLAY_IDENTIFIER LV_NO_PURGE_DR_DMTL ECU_ADDRESS 0xc0000554 BIT_MASK 0x80 /end MEASUREMENT
/begin MEASUREMENT dmtl_priv_state_3.bitfield.lv_no_purge_dmtl_rough_leak "request bit for no_purge" ULONG _CNV_S_2_RANGE______75_CM 1 100. 0. 1. DISPLAY_IDENTIFIER LV_NO_PURGE_DMTL_ROUGH_LEAK ECU_ADDRESS 0xc0000554 BIT_MASK 0x100 /end MEASUREMENT
/begin MEASUREMENT dmtl_priv_state_3.bitfield.lv_no_purge_dmtl_small_leak "request bit for no_purge" ULONG _CNV_S_2_RANGE______75_CM 1 100. 0. 1. DISPLAY_IDENTIFIER LV_NO_PURGE_DMTL_SMALL_LEAK ECU_ADDRESS 0xc0000554 BIT_MASK 0x200 /end MEASUREMENT
/begin MEASUREMENT dmtl_priv_state_4.bitfield.lv_ref_leak_rough_leak_susp "Condition, second reference measurement due to \"rough leak suspected\"" ULONG _CNV_S_2_RANGE______75_CM 1 100. 0. 1. DISPLAY_IDENTIFIER LV_REF_LEAK_ROUGH_LEAK_SUSP ECU_ADDRESS 0xc0000558 BIT_MASK 0x8 /end MEASUREMENT
/begin MEASUREMENT dmtl_priv_state_4.bitfield.lv_refu_1 "Refueling process, internal" ULONG _CNV_S_2_RANGE______75_CM 1 100. 0. 1. DISPLAY_IDENTIFIER LV_REFU_1 ECU_ADDRESS 0xc0000558 BIT_MASK 0x10 /end MEASUREMENT
/begin MEASUREMENT dmtl_priv_state_4.bitfield.lv_refu_end "Refueling finished" ULONG _CNV_S_2_RANGE______75_CM 1 100. 0. 1. DISPLAY_IDENTIFIER LV_REFU_END ECU_ADDRESS 0xc0000558 BIT_MASK 0x20 /end MEASUREMENT
/begin MEASUREMENT dmtl_priv_state_4.bitfield.lv_refu_rls_diag "Refueling diagnosis possible" ULONG _CNV_S_2_RANGE______75_CM 1 100. 0. 1. DISPLAY_IDENTIFIER LV_REFU_RLS_DIAG ECU_ADDRESS 0xc0000558 BIT_MASK 0x100 /end MEASUREMENT
/begin MEASUREMENT dmtl_priv_state_4.bitfield.lv_refu_val_1 "Refueling bit valid, internal" ULONG _CNV_S_2_RANGE______75_CM 1 100. 0. 1. DISPLAY_IDENTIFIER LV_REFU_VAL_1 ECU_ADDRESS 0xc0000558 BIT_MASK 0x200 /end MEASUREMENT
/begin MEASUREMENT dmtl_priv_state_4.bitfield.lv_req_ena_rough_leak "Request rough leak measurement" ULONG _CNV_S_2_RANGE______75_CM 1 100. 0. 1. DISPLAY_IDENTIFIER LV_REQ_ENA_ROUGH_LEAK ECU_ADDRESS 0xc0000558 BIT_MASK 0x800 /end MEASUREMENT
/begin MEASUREMENT dmtl_priv_state_4.bitfield.lv_req_pwl_rough_leak "Request of STG off delay, rough leak diagnosis" ULONG _CNV_S_2_RANGE______75_CM 1 100. 0. 1. DISPLAY_IDENTIFIER LV_REQ_PWL_ROUGH_LEAK ECU_ADDRESS 0xc0000558 BIT_MASK 0x2000 /end MEASUREMENT
/begin MEASUREMENT dmtl_priv_state_4.bitfield.lv_req_pwl_small_leak "Request of STG off delay, miniature leak test" ULONG _CNV_S_2_RANGE______75_CM 1 100. 0. 1. DISPLAY_IDENTIFIER LV_REQ_PWL_SMALL_LEAK ECU_ADDRESS 0xc0000558 BIT_MASK 0x4000 /end MEASUREMENT
/begin MEASUREMENT dmtl_priv_state_4.bitfield.lv_req_rough_leak "Request rough leak measurement (low volatile fuel)" ULONG _CNV_S_2_RANGE______75_CM 1 100. 0. 1. DISPLAY_IDENTIFIER LV_REQ_ROUGH_LEAK ECU_ADDRESS 0xc0000558 BIT_MASK 0x8000 /end MEASUREMENT
/begin MEASUREMENT dmtl_priv_state_4.bitfield.lv_small_leak_mes_len "Condition, extension miniature leak measurement" ULONG _CNV_S_2_RANGE______75_CM 1 100. 0. 1. DISPLAY_IDENTIFIER LV_SMALL_LEAK_MES_LEN ECU_ADDRESS 0xc0000558 BIT_MASK 0x2000000 /end MEASUREMENT
/begin MEASUREMENT dmtl_priv_state_4.bitfield.lv_t_dly_dmtl_pwl "Waiting time DMTL start finished" ULONG _CNV_S_2_RANGE______75_CM 1 100. 0. 1. DISPLAY_IDENTIFIER LV_T_DLY_DMTL_PWL ECU_ADDRESS 0xc0000558 BIT_MASK 0x4000000 /end MEASUREMENT
/begin MEASUREMENT dmtl_glob_state_1.bitfield.lv_ctr_cnl_small_leak_mes "Threshold of aborted miniature leak measurements due to current fluctuations exceeded" ULONG _CNV_S_2_RANGE______75_CM 1 100. 0. 1. DISPLAY_IDENTIFIER LV_CTR_CNL_SMALL_LEAK_MES ECU_ADDRESS 0xd00057e8 BIT_MASK 0x1 /end MEASUREMENT
/begin MEASUREMENT dmtl_glob_state_1.bitfield.lv_cur_dmtl_ref_dif_max "Condition \"delta reference current\" exceeded" ULONG _CNV_S_2_RANGE______75_CM 1 100. 0. 1. DISPLAY_IDENTIFIER LV_CUR_DMTL_REF_DIF_MAX ECU_ADDRESS 0xd00057e8 BIT_MASK 0x2 /end MEASUREMENT
/begin MEASUREMENT dmtl_glob_state_1.bitfield.lv_cur_dmtl_thd_dif_mes "Decreasing pump current during measurement" ULONG _CNV_S_2_RANGE______75_CM 1 100. 0. 1. DISPLAY_IDENTIFIER LV_CUR_DMTL_THD_DIF_MES ECU_ADDRESS 0xd00057e8 BIT_MASK 0x4 /end MEASUREMENT
/begin MEASUREMENT dmtl_glob_state_1.bitfield.lv_det_fuc_open "Detection of fuel cap open" ULONG _CNV_S_2_RANGE______75_CM 1 100. 0. 1. DISPLAY_IDENTIFIER LV_DET_FUC_OPEN ECU_ADDRESS 0xd00057e8 BIT_MASK 0x8 /end MEASUREMENT
/begin MEASUREMENT dmtl_glob_state_1.bitfield.lv_det_refu "Detection of refueling" ULONG _CNV_S_2_RANGE______75_CM 1 100. 0. 1. DISPLAY_IDENTIFIER LV_DET_REFU ECU_ADDRESS 0xd00057e8 BIT_MASK 0x10 /end MEASUREMENT
/begin MEASUREMENT dmtl_glob_state_1.bitfield.lv_dist_det_rough_leak "Distance covered since rough leak detection" ULONG _CNV_S_2_RANGE______75_CM 1 100. 0. 1. DISPLAY_IDENTIFIER LV_DIST_DET_ROUGH_LEAK ECU_ADDRESS 0xd00057e8 BIT_MASK 0x20 /end MEASUREMENT
/begin MEASUREMENT dmtl_glob_state_1.bitfield.lv_dmtl_act "DMTL state machine running" ULONG _CNV_S_2_RANGE______75_CM 1 100. 0. 1. DISPLAY_IDENTIFIER LV_DMTL_ACT ECU_ADDRESS 0xd00057e8 BIT_MASK 0x40 /end MEASUREMENT
/begin MEASUREMENT dmtl_glob_state_1.bitfield.lv_dmtl_stop "Abnormal termination of DMTL function" ULONG _CNV_S_2_RANGE______75_CM 1 100. 0. 1. DISPLAY_IDENTIFIER LV_DMTL_STOP ECU_ADDRESS 0xd00057e8 BIT_MASK 0x100 /end MEASUREMENT
/begin MEASUREMENT dmtl_glob_state_1.bitfield.lv_ena_fuc "Request check filler cap" ULONG _CNV_S_2_RANGE______75_CM 1 100. 0. 1. DISPLAY_IDENTIFIER LV_ENA_FUC ECU_ADDRESS 0xd00057e8 BIT_MASK 0x200 /end MEASUREMENT
/begin MEASUREMENT dmtl_glob_state_1.bitfield.lv_ena_leak_dmtl "Enabling function request, coarse / miniature leakage measurement" ULONG _CNV_S_2_RANGE______75_CM 1 100. 0. 1. DISPLAY_IDENTIFIER LV_ENA_LEAK_DMTL ECU_ADDRESS 0xd00057e8 BIT_MASK 0x400 /end MEASUREMENT
/begin MEASUREMENT dmtl_glob_state_1.bitfield.lv_ena_small_leak_mes "Enable miniature leak measurement" ULONG _CNV_S_2_RANGE______75_CM 1 100. 0. 1. DISPLAY_IDENTIFIER LV_ENA_SMALL_LEAK_MES ECU_ADDRESS 0xd00057e8 BIT_MASK 0x1000 /end MEASUREMENT
/begin MEASUREMENT dmtl_glob_state_1.bitfield.lv_err_det_dmtl_max "Error maximum value DMTL" ULONG _CNV_S_2_RANGE______75_CM 1 100. 0. 1. DISPLAY_IDENTIFIER LV_ERR_DET_DMTL_MAX ECU_ADDRESS 0xd00057e8 BIT_MASK 0x2000 /end MEASUREMENT
/begin MEASUREMENT dmtl_glob_state_1.bitfield.lv_err_det_dmtl_min "Error, minimum value detected in DMTL module" ULONG _CNV_S_2_RANGE______75_CM 1 100. 0. 1. DISPLAY_IDENTIFIER LV_ERR_DET_DMTL_MIN ECU_ADDRESS 0xd00057e8 BIT_MASK 0x4000 /end MEASUREMENT
/begin MEASUREMENT dmtl_glob_state_1.bitfield.lv_err_det_rough_leak_min "Rough leak error" ULONG _CNV_S_2_RANGE______75_CM 1 100. 0. 1. DISPLAY_IDENTIFIER LV_ERR_DET_ROUGH_LEAK_MIN ECU_ADDRESS 0xd00057e8 BIT_MASK 0x8000 /end MEASUREMENT
/begin MEASUREMENT dmtl_glob_state_1.bitfield.lv_err_ftl_int "Tank level error" ULONG _CNV_S_2_RANGE______75_CM 1 100. 0. 1. DISPLAY_IDENTIFIER LV_ERR_FTL ECU_ADDRESS 0xd00057e8 BIT_MASK 0x10000 /end MEASUREMENT
/begin MEASUREMENT dmtl_glob_state_1.bitfield.lv_err_ftl_plaus_int "Tank level plausibility error" ULONG _CNV_S_2_RANGE______75_CM 1 100. 0. 1. DISPLAY_IDENTIFIER LV_ERR_FTL_PLAUS ECU_ADDRESS 0xd00057e8 BIT_MASK 0x20000 /end MEASUREMENT
/begin MEASUREMENT dmtl_glob_state_1.bitfield.lv_err_sig_dmtl "Error signal DMTL" ULONG _CNV_S_2_RANGE______75_CM 1 100. 0. 1. DISPLAY_IDENTIFIER LV_ERR_SIG_DMTL ECU_ADDRESS 0xd00057e8 BIT_MASK 0x40000 /end MEASUREMENT
/begin MEASUREMENT dmtl_glob_state_1.bitfield.lv_ftl_diag "Level sensor diagnosis" ULONG _CNV_S_2_RANGE______75_CM 1 100. 0. 1. DISPLAY_IDENTIFIER LV_FTL_DIAG ECU_ADDRESS 0xd00057e8 BIT_MASK 0x80000 /end MEASUREMENT
/begin MEASUREMENT dmtl_glob_state_1.bitfield.lv_fuc_can "Tank cap open - display" ULONG _CNV_S_2_RANGE______75_CM 1 100. 0. 1. DISPLAY_IDENTIFIER LV_FUC_CAN ECU_ADDRESS 0xd00057e8 BIT_MASK 0x100000 /end MEASUREMENT
/begin MEASUREMENT dmtl_glob_state_1.bitfield.lv_fuc_open "Filler cap open" ULONG _CNV_S_2_RANGE______75_CM 1 100. 0. 1. DISPLAY_IDENTIFIER LV_FUC_OPEN ECU_ADDRESS 0xd00057e8 BIT_MASK 0x200000 /end MEASUREMENT
/begin MEASUREMENT dmtl_glob_state_1.bitfield.lv_no_purge_dmtl "request for no_purge of the evap.-system" ULONG _CNV_S_2_RANGE______75_CM 1 100. 0. 1. DISPLAY_IDENTIFIER LV_NO_PURGE_DMTL ECU_ADDRESS 0xd00057e8 BIT_MASK 0x400000 /end MEASUREMENT
/begin MEASUREMENT dmtl_glob_state_1.bitfield.lv_refu_dmtl "Condition refueling" ULONG _CNV_S_2_RANGE______75_CM 1 100. 0. 1. DISPLAY_IDENTIFIER LV_REFU_DMTL ECU_ADDRESS 0xd00057e8 BIT_MASK 0x1000000 /end MEASUREMENT
/begin MEASUREMENT dmtl_glob_state_1.bitfield.lv_rough_leak_susp_int "Rough leak suspected" ULONG _CNV_S_2_RANGE______75_CM 1 100. 0. 1. DISPLAY_IDENTIFIER LV_ROUGH_LEAK_SUSP ECU_ADDRESS 0xd00057e8 BIT_MASK 0x2000000 /end MEASUREMENT
/begin MEASUREMENT dmtl_glob_state_1.bitfield.lv_chk_dmtl_cur_dmtl_vld "Virtuel check of component concerning valid pump current" ULONG _CNV_S_2_RANGE______75_CM 1 100. 0. 1. DISPLAY_IDENTIFIER LV_CHK_DMTL_CUR_DMTL_VLD ECU_ADDRESS 0xd00057e8 BIT_MASK 0x10000000 /end MEASUREMENT
/begin MEASUREMENT dmtl_glob_state_1.bitfield.lv_chk_dmtl_vld "Check of components on current fluctuations valid" ULONG _CNV_S_2_RANGE______75_CM 1 100. 0. 1. DISPLAY_IDENTIFIER LV_CHK_DMTL_VLD ECU_ADDRESS 0xd00057e8 BIT_MASK 0x20000000 /end MEASUREMENT
/begin MEASUREMENT dmtl_glob_state_1.bitfield.lv_err_det_small_leak_min "Error, minimum value detected, miniature leakage" ULONG _CNV_S_2_RANGE______75_CM 1 100. 0. 1. DISPLAY_IDENTIFIER LV_ERR_DET_SMALL_LEAK_MIN ECU_ADDRESS 0xd00057e8 BIT_MASK 0x8000000 /end MEASUREMENT
/begin MEASUREMENT dmtl_glob_state_1.bitfield.lv_ftl_dmtl_val "validated tank level for DMTL function" ULONG _CNV_S_2_RANGE______75_CM 1 100. 0. 1. DISPLAY_IDENTIFIER LV_FTL_DMTL_VAL ECU_ADDRESS 0xd00057e8 BIT_MASK 0x40000000 /end MEASUREMENT
/begin MEASUREMENT dmtl_glob_state_1.bitfield.lv_cyc_rough_leak_susp_int "Cycle flag, rough leak suspected" ULONG _CNV_S_2_RANGE______75_CM 1 100. 0. 1. DISPLAY_IDENTIFIER LV_CYC_ROUGH_LEAK_SUSP ECU_ADDRESS 0xd00057e8 BIT_MASK 0x4000000 /end MEASUREMENT
/begin MEASUREMENT dmtl_glob_state_2.bitfield.lv_req_pwl_dmtl "Request of STG off delay, tank leakage diagnosis" ULONG _CNV_S_2_RANGE______75_CM 1 100. 0. 1. DISPLAY_IDENTIFIER LV_REQ_PWL_DMTL ECU_ADDRESS 0xd00057ec BIT_MASK 0x1 /end MEASUREMENT
/begin MEASUREMENT dmtl_glob_state_2.bitfield.lv_rough_leak_susp_set "Rough leak suspicion with cycle bit rough leak suspicion present" ULONG _CNV_S_2_RANGE______75_CM 1 100. 0. 1. DISPLAY_IDENTIFIER LV_ROUGH_LEAK_SUSP_SET ECU_ADDRESS 0xd00057ec BIT_MASK 0x4 /end MEASUREMENT
/begin MEASUREMENT dmtl_glob_state_2.bitfield.lv_sdr_dmtl "Error plausibility DMTL" ULONG _CNV_S_2_RANGE______75_CM 1 100. 0. 1. DISPLAY_IDENTIFIER LV_SDR_DMTL ECU_ADDRESS 0xd00057ec BIT_MASK 0x8 /end MEASUREMENT
/begin MEASUREMENT dmtl_glob_state_2.bitfield.lv_t_dmtl_max "max. time for DMTL" ULONG _CNV_S_2_RANGE______75_CM 1 100. 0. 1. DISPLAY_IDENTIFIER LV_T_DMTL_MAX ECU_ADDRESS 0xd00057ec BIT_MASK 0x10 /end MEASUREMENT
/begin MEASUREMENT dmtl_glob_state_2.bitfield.lv_vb_dif_max "high battery voltage deviation" ULONG _CNV_S_2_RANGE______75_CM 1 100. 0. 1. DISPLAY_IDENTIFIER LV_VB_DIF_MAX ECU_ADDRESS 0xd00057ec BIT_MASK 0x20 /end MEASUREMENT
/begin MEASUREMENT dmtl_glob_state_2.bitfield.lv_dr_dmtls "DMTL solenoid valve activation" ULONG _CNV_S_2_RANGE______75_CM 1 100. 0. 1. DISPLAY_IDENTIFIER LV_DR_DMTLS ECU_ADDRESS 0xd00057ec BIT_MASK 0x40 /end MEASUREMENT
/begin MEASUREMENT dmtl_glob_state_2.bitfield.lv_vb_range_dmtl "DMTL does not start because battery is out of band width" ULONG _CNV_S_2_RANGE______75_CM 1 100. 0. 1. DISPLAY_IDENTIFIER LV_VB_RANGE_DMTL ECU_ADDRESS 0xd00057ec BIT_MASK 0x4000 /end MEASUREMENT
/begin MEASUREMENT dmtl_glob_state_2.bitfield.lv_cyc_rough_leak_mode6 "Cycle flag, rough leak error" ULONG _CNV_S_2_RANGE______75_CM 1 100. 0. 1. DISPLAY_IDENTIFIER LV_CYC_ROUGH_LEAK_MODE6 ECU_ADDRESS 0xd00057ec BIT_MASK 0x80 /end MEASUREMENT
/begin MEASUREMENT dmtl_glob_state_2.bitfield.lv_rough_leak_mes_len "Condition, extension rough leak measurement" ULONG _CNV_S_2_RANGE______75_CM 1 100. 0. 1. DISPLAY_IDENTIFIER LV_ROUGH_LEAK_MES_LEN ECU_ADDRESS 0xd00057ec BIT_MASK 0x100 /end MEASUREMENT
/begin MEASUREMENT dmtl_glob_state_2.bitfield.lv_cyc_small_leak_mode6 "Cycle flag, miniature leak" ULONG _CNV_S_2_RANGE______75_CM 1 100. 0. 1. DISPLAY_IDENTIFIER LV_CYC_SMALL_LEAK_MODE6 ECU_ADDRESS 0xd00057ec BIT_MASK 0x200 /end MEASUREMENT
/begin MEASUREMENT dmtl_glob_state_2.bitfield.lv_refu_int "Refueling" ULONG _CNV_S_2_RANGE______75_CM 1 100. 0. 1. DISPLAY_IDENTIFIER LV_REFU ECU_ADDRESS 0xd00057ec BIT_MASK 0x400 /end MEASUREMENT
/begin MEASUREMENT dmtl_glob_state_2.bitfield.lv_refu_val_int "Refueling bit valid, internal" ULONG _CNV_S_2_RANGE______75_CM 1 100. 0. 1. DISPLAY_IDENTIFIER LV_REFU_VAL ECU_ADDRESS 0xd00057ec BIT_MASK 0x800 /end MEASUREMENT
/begin MEASUREMENT dmtl_glob_state_2.bitfield.lv_ena_chk_fuc_rough_leak "Enable rough leak measurement due to check filler cap" ULONG _CNV_S_2_RANGE______75_CM 1 100. 0. 1. DISPLAY_IDENTIFIER LV_ENA_CHK_FUC_ROUGH_LEAK ECU_ADDRESS 0xd00057ec BIT_MASK 0x1000 /end MEASUREMENT
/begin MEASUREMENT cur_dmtl_small_leak_end "Pump current at the end of the miniature leak measurement" UWORD _CNV_A_R_LINEAR_____133_CM 1 100. 0. 400. DISPLAY_IDENTIFIER CUR_DMTL_SMALL_LEAK_END ECU_ADDRESS 0xc0000522 FORMAT "%7.3" /end MEASUREMENT
/begin MEASUREMENT cur_dmtl_ref_dif_max "???" UWORD _CNV_A_R_LINEAR_____133_CM 1 100. 0. 400. DISPLAY_IDENTIFIER CUR_DMTL_REF_DIF_MAX ECU_ADDRESS 0xc000051c FORMAT "%7.3" /end MEASUREMENT
/begin CHARACTERISTIC c_t_dly_stop_refu "Delay time stop before refueling" VALUE 0xa1029876 _REC_VAL_20_u2 65535. _CNV_A_R_LINEAR_____35_CM 0. 65535. DISPLAY_IDENTIFIER C_T_DLY_STOP_REFU FORMAT "%5.0" /end CHARACTERISTIC
/begin CHARACTERISTIC c_t_ena_dr_dmtl_max "max. time for function request DMTL output stages" VALUE 0xa102988c _REC_VAL_20_u2 6553.5 _CNV_A_R_LINEAR_____4_CM 0. 6553.5 DISPLAY_IDENTIFIER C_T_ENA_DR_DMTL_MAX FORMAT "%6.1" /end CHARACTERISTIC
/begin CHARACTERISTIC ip_t_act_rough_leak "Time for rough leak measurement" CURVE 0xa10278e8 _REC_CUR_20_u2_u1 655.35 _CNV_A_R_LINEAR_____4_CM 0. 6553.5 DISPLAY_IDENTIFIER IP_T_ACT_ROUGH_LEAK FORMAT "%6.1"
 /begin AXIS_DESCR COM_AXIS ftl _CNV_A_R_LINEAR_____76_CM 5 0. 126. FORMAT "%3.0" AXIS_PTS_REF ldp_ftl__t_rough_leak_test /end AXIS_DESCR
/end CHARACTERISTIC
/begin CHARACTERISTIC ip_t_act_rough_leak_chk_fuc "Time for rough leak measurement in case of check filler cap and error FTL" CURVE 0xa10278f4 _REC_CUR_20_u2_u1 655.35 _CNV_A_R_LINEAR_____4_CM 0. 6553.5 DISPLAY_IDENTIFIER IP_T_ACT_ROUGH_LEAK_CHK_FUC FORMAT "%6.1"
 /begin AXIS_DESCR COM_AXIS ftl _CNV_A_R_LINEAR_____76_CM 5 0. 126. FORMAT "%3.0" AXIS_PTS_REF ldp_ftl__t_rough_leak_test /end AXIS_DESCR
/end CHARACTERISTIC
/begin CHARACTERISTIC c_t_act_rough_leak "Time for rough leak measurement" VALUE 0xa10297e2 _REC_VAL_20_u2 6553.2 _CNV_A_R_LINEAR_____4_CM 0.3 6553.5 DISPLAY_IDENTIFIER C_T_ACT_ROUGH_LEAK FORMAT "%6.1" /end CHARACTERISTIC
/begin CHARACTERISTIC c_t_act_rough_leak_chk_fuc "Time for rough leak measurement in case of check filler cap" VALUE 0xa10297e4 _REC_VAL_20_u2 6553.2 _CNV_A_R_LINEAR_____4_CM 0.3 6553.5 DISPLAY_IDENTIFIER C_T_ACT_ROUGH_LEAK_CHK_FUC FORMAT "%6.1" /end CHARACTERISTIC
/begin CHARACTERISTIC c_vb_dmtl_dif "Delta VB threshold for DMTL" VALUE 0xa1029bca _REC_VAL_20_u2 25.999603 _CNV_A_R_LINEAR_____142_CM 0. 25.999603 DISPLAY_IDENTIFIER C_VB_DMTL_DIF FORMAT "%7.4" /end CHARACTERISTIC
/begin CHARACTERISTIC c_vb_dmtl_dif_chk_fuc "Delta VB threshold for DMTL in case of check filler cap" VALUE 0xa1029bcc _REC_VAL_20_u2 25.999603 _CNV_A_R_LINEAR_____142_CM 0. 25.999603 DISPLAY_IDENTIFIER C_VB_DMTL_DIF_CHK_FUC FORMAT "%7.4" /end CHARACTERISTIC
/begin MEASUREMENT ctr_cnl_small_leak_mes "Number of aborted miniature leak measurements due to current fluctuations" UBYTE _CNV_A_R_LINEAR_____0_CM 1 100. 0. 255. DISPLAY_IDENTIFIER CTR_CNL_SMALL_LEAK_MES ECU_ADDRESS 0xd0003e2d FORMAT "%3.0" /end MEASUREMENT
/begin MEASUREMENT ctr_ena_dmtl_chk_fuc "Number of enabled check filler cap checks" UBYTE _CNV_A_R_LINEAR_____0_CM 1 100. 0. 255. DISPLAY_IDENTIFIER CTR_ENA_DMTL_CHK_FUC ECU_ADDRESS 0xc0000567 FORMAT "%3.0" /end MEASUREMENT
/begin CHARACTERISTIC c_t_ast_dmtl_max "min. post-starting period for canister purge diagnosis" VALUE 0xa1029800 _REC_VAL_20_u2 6553.2 _CNV_A_R_LINEAR_____4_CM 0.3 6553.5 DISPLAY_IDENTIFIER C_T_AST_DMTL_MAX FORMAT "%6.1" /end CHARACTERISTIC
/begin CHARACTERISTIC c_t_ast_dmtl_chk_fuc "minimum time after start for enabling check filler cap check" VALUE 0xa10297fe _REC_VAL_20_u2 6553.5 _CNV_A_R_LINEAR_____4_CM 0. 6553.5 DISPLAY_IDENTIFIER C_T_AST_DMTL_CHK_FUC FORMAT "%6.1" /end CHARACTERISTIC
/begin CHARACTERISTIC c_t_ena_dmtl_chk_fuc "minimum time between two check filler cap checks" VALUE 0xa102988a _REC_VAL_20_u2 6553.5 _CNV_A_R_LINEAR_____4_CM 0. 6553.5 DISPLAY_IDENTIFIER C_T_ENA_DMTL_CHK_FUC FORMAT "%6.1" /end CHARACTERISTIC
/begin CHARACTERISTIC c_tam_dmtl_max "upper temperature threshold for the DMTL function" VALUE 0xa10299b9 _REC_VAL_20_u1 190.5 _CNV_A_R_LINEAR_____16_CM -48. 142.5 DISPLAY_IDENTIFIER C_TAM_DMTL_MAX FORMAT "%5.1" /end CHARACTERISTIC
/begin CHARACTERISTIC c_tam_dmtl_chk_fuc_min "minimum ambient temperature for enabling check filler cap check" VALUE 0xa10299b8 _REC_VAL_20_u1 190.5 _CNV_A_R_LINEAR_____16_CM -48. 142.5 DISPLAY_IDENTIFIER C_TAM_DMTL_CHK_FUC_MIN FORMAT "%5.1" /end CHARACTERISTIC
/begin CHARACTERISTIC c_vb_dmtl_min "minimum battery threshold for the DMTL function" VALUE 0xa1029bcf _REC_VAL_20_u1 26. _CNV_A_R_LINEAR_____36_CM 0. 26. DISPLAY_IDENTIFIER C_VB_DMTL_MIN FORMAT "%4.1" /end CHARACTERISTIC
/begin CHARACTERISTIC c_vb_dmtl_chk_fuc_min "minimum battery threshold for enabling check filler cap check" VALUE 0xa1029bc9 _REC_VAL_20_u1 26. _CNV_A_R_LINEAR_____36_CM 0. 26. DISPLAY_IDENTIFIER C_VB_DMTL_CHK_FUC_MIN FORMAT "%4.1" /end CHARACTERISTIC
/begin CHARACTERISTIC c_vb_dmtl_chk_fuc_max "maximum battery threshold for enabling check filler cap check" VALUE 0xa1029bc8 _REC_VAL_20_u1 26. _CNV_A_R_LINEAR_____36_CM 0. 26. DISPLAY_IDENTIFIER C_VB_DMTL_CHK_FUC_MAX FORMAT "%4.1" /end CHARACTERISTIC
/begin CHARACTERISTIC c_ctr_ena_dmtl_chk_fuc "maximum number of enabled check filler cap checks" VALUE 0xa1029294 _REC_VAL_20_u1 255. _CNV_A_R_LINEAR_____0_CM 0. 255. DISPLAY_IDENTIFIER C_CTR_ENA_DMTL_CHK_FUC FORMAT "%3.0" /end CHARACTERISTIC
/begin CHARACTERISTIC ip_fac_cur_dmtl_rough "Factor delta pump current for rough leak detection" CURVE 0xa10234b4 _REC_CUR_20_u2_u2 0.9999847412109381 _CNV_A_R_LINEAR_____68_CM 0. 0.9999847412109381 DISPLAY_IDENTIFIER IP_FAC_CUR_DMTL_ROUGH FORMAT "%7.5"
 /begin AXIS_DESCR COM_AXIS cur_dmtl_dif_ref_rough_leak _CNV_A_R_LINEAR_____133_CM 8 0. 400. FORMAT "%7.3" AXIS_PTS_REF ldpm_cur_dmtldifrefroughleak_1 /end AXIS_DESCR
/end CHARACTERISTIC
/begin CHARACTERISTIC ip_fac_cur_dmtl_chk_fuc_rough "Factor delta pump current for rough leak detection concerning reference in case of check filler cap test" CURVE 0xa1023494 _REC_CUR_20_u2_u2 0.9999847412109381 _CNV_A_R_LINEAR_____68_CM 0. 0.9999847412109381 DISPLAY_IDENTIFIER IP_FAC_CUR_DMTL_CHK_FUC_ROUGH FORMAT "%7.5"
 /begin AXIS_DESCR COM_AXIS cur_dmtl_dif_ref_rough_leak _CNV_A_R_LINEAR_____133_CM 8 0. 400. FORMAT "%7.3" AXIS_PTS_REF ldpm_cur_dmtldifrefroughleak_1 /end AXIS_DESCR
/end CHARACTERISTIC
/begin MEASUREMENT dist_dmtl "Distance covered for DMTL function" ULONG _CNV_A_R_LINEAR_____143_CM 1 100. 0. 65535. DISPLAY_IDENTIFIER DIST_DMTL ECU_ADDRESS 0xd00057e0 FORMAT "%5.0" /end MEASUREMENT
/begin MEASUREMENT cur_dmtl_rough_leak_min_eol "Min. pump current in case of rough leak measurement for tester tool" UWORD _CNV_A_R_LINEAR_____133_CM 1 100. 0. 400. DISPLAY_IDENTIFIER CUR_DMTL_ROUGH_LEAK_MIN_EOL ECU_ADDRESS 0xd0005258 FORMAT "%7.3" /end MEASUREMENT
/begin MEASUREMENT cur_dmtl_cor_fil_eol "corrected and filtered pump current for tester tool" UWORD _CNV_A_R_LINEAR_____133_CM 1 100. 0. 400. DISPLAY_IDENTIFIER CUR_DMTL_COR_FIL_EOL ECU_ADDRESS 0xd0005250 FORMAT "%7.3" /end MEASUREMENT
/begin MEASUREMENT lv_err_rough_leak "Error rough leak" UBYTE _CNV_S_2_RANGE__0___1_CM 1 100. 0. 1. DISPLAY_IDENTIFIER LV_ERR_ROUGH_LEAK ECU_ADDRESS 0xd0003437 BIT_MASK 0x1 /end MEASUREMENT
/begin MEASUREMENT lv_err_small_leak "Error small leak" UBYTE _CNV_S_2_RANGE__0___1_CM 1 100. 0. 1. DISPLAY_IDENTIFIER LV_ERR_SMALL_LEAK ECU_ADDRESS 0xd0003438 BIT_MASK 0x1 /end MEASUREMENT
/begin MEASUREMENT lv_dmtls "DMTL valve" UBYTE _CNV_S_2_RANGE__0___1_CM 1 100. 0. 1. DISPLAY_IDENTIFIER LV_DMTLS ECU_ADDRESS 0xd0003e35 BIT_MASK 0x1 /end MEASUREMENT
/begin MEASUREMENT lv_hdmtl_on "DMTL Heater" UBYTE _CNV_S_2_RANGE__0___1_CM 1 100. 0. 1. DISPLAY_IDENTIFIER LV_HDMTL_ON ECU_ADDRESS 0xd0003e36 BIT_MASK 0x1 /end MEASUREMENT
/begin MEASUREMENT lv_dmtl_pump "DMTL Pump" UBYTE _CNV_S_2_RANGE__0___1_CM 1 100. 0. 1. DISPLAY_IDENTIFIER LV_DMTL_PUMP ECU_ADDRESS 0xd0003e37 BIT_MASK 0x1 /end MEASUREMENT
/begin MEASUREMENT lv_tco_st_dmtl "Coldstart condition for DMTL fulfilled" UBYTE _CNV_S_2_RANGE__0___1_CM 1 100. 0. 1. DISPLAY_IDENTIFIER LV_TCO_ST_DMTL ECU_ADDRESS 0xd0003e38 BIT_MASK 0x1 /end MEASUREMENT
/begin CHARACTERISTIC c_cod_dmtl "Calibrationconstant" VALUE 0xa10291c1 _REC_VAL_20_u1 255. _CNV_A_R_LINEAR_____0_CM 0. 255. DISPLAY_IDENTIFIER C_COD_DMTL FORMAT "%3.0" /end CHARACTERISTIC
/begin CHARACTERISTIC c_tco_st_dmtl_cold "TCO_ST offset of TAM to enable a DMTL diagnosis" VALUE 0xa10299ec _REC_VAL_20_s1 191.25 _CNV_A_R_LINEAR_____24_CM -96. 95.25 DISPLAY_IDENTIFIER C_TCO_ST_DMTL_COLD FORMAT "%6.2" /end CHARACTERISTIC
/begin CHARACTERISTIC c_ctr_tco_st_dmtl_min "Threshold of recognized cold start for DMTL small leak test" VALUE 0xa10292c6 _REC_VAL_20_u1 255. _CNV_A_R_LINEAR_____0_CM 0. 255. DISPLAY_IDENTIFIER C_CTR_TCO_ST_DMTL_MIN FORMAT "%3.0" /end CHARACTERISTIC
/begin MEASUREMENT ctr_tco_st_dmtl "Counter of recognized cold starts for DMTL small leak test" UBYTE _CNV_A_R_LINEAR_____0_CM 1 100. 0. 255. DISPLAY_IDENTIFIER CTR_TCO_ST_DMTL ECU_ADDRESS 0xd0003e34 FORMAT "%3.0" /end MEASUREMENT
/begin MEASUREMENT lv_inh_diagcps "activation condition for Functional check CPS, irreversible" UBYTE _CNV_S_2_RANGE__0___1_CM 1 100. 0. 1. DISPLAY_IDENTIFIER LV_INH_DIAGCPS ECU_ADDRESS 0xd0003764 BIT_MASK 0x1 /end MEASUREMENT
/begin MEASUREMENT lv_di_diagcps "activation condition for Functional check CPS, reversible" UBYTE _CNV_S_2_RANGE__0___1_CM 1 100. 0. 1. DISPLAY_IDENTIFIER LV_DI_DIAGCPS ECU_ADDRESS 0xd0003765 BIT_MASK 0x1 /end MEASUREMENT
/begin CHARACTERISTIC c_tco_min_diagcps_1 "min. temperature for FC CPS/ Step1 (CL diagnosis)" VALUE 0xa10299da _REC_VAL_20_u1 190.5 _CNV_A_R_LINEAR_____16_CM -48. 142.5 DISPLAY_IDENTIFIER C_TCO_MIN_DIAGCPS_1 FORMAT "%5.1" /end CHARACTERISTIC
/begin MEASUREMENT state_rbm_diagcps "Interface of DIAGCPS monitor with the Rate-Based Monitoring statistics" UBYTE _CNV_A_R_LINEAR_____0_CM 1 100. 0. 255. DISPLAY_IDENTIFIER STATE_RBM_DIAGCPS ECU_ADDRESS 0xd0003766 FORMAT "%3.0" /end MEASUREMENT
/begin MEASUREMENT lv_inh_diag_rbm_diagcps "flag to inhibit catalyst diagnosis function if there is a OBD failure" UBYTE _CNV_S_2_RANGE__0___1_CM 1 100. 0. 1. DISPLAY_IDENTIFIER LV_INH_DIAG_RBM_DIAGCPS ECU_ADDRESS 0xc0000628 BIT_MASK 0x1 /end MEASUREMENT
/begin MEASUREMENT flow_sp_cp_diagcps "Flow setpoint through the CPS during Functional check CPS" UWORD _CNV_A_R_LINEAR_____147_CM 1 100. 0. 7.9998779296875 DISPLAY_IDENTIFIER FLOW_SP_CP_DIAGCPS ECU_ADDRESS 0xd0004af0 FORMAT "%7.4" /end MEASUREMENT
/begin MEASUREMENT lv_act_diagcps "Indication for Functional check cps (step 2 or 3) being activated" UBYTE _CNV_S_2_RANGE__0___1_CM 1 100. 0. 1. DISPLAY_IDENTIFIER LV_ACT_DIAGCPS ECU_ADDRESS 0xd000376d BIT_MASK 0x1 /end MEASUREMENT
/begin MEASUREMENT lv_maf_diagcps_0 "Auxiliary bit for step 3 - Functional check CPS" UBYTE _CNV_S_2_RANGE__0___1_CM 1 100. 0. 1. DISPLAY_IDENTIFIER LV_MAF_DIAGCPS_0 ECU_ADDRESS 0xc0000656 BIT_MASK 0x1 /end MEASUREMENT
/begin MEASUREMENT lv_maf_diagcps_1 "Auxiliary bit for step 3 - Functional check CPS" UBYTE _CNV_S_2_RANGE__0___1_CM 1 100. 0. 1. DISPLAY_IDENTIFIER LV_MAF_DIAGCPS_1 ECU_ADDRESS 0xc0000657 BIT_MASK 0x1 /end MEASUREMENT
/begin MEASUREMENT lv_supp_accin_diagcps "Bit to suppress the air conditioning compressor request signal - Functional check CPS" UBYTE _CNV_S_2_RANGE__0___1_CM 1 100. 0. 1. DISPLAY_IDENTIFIER LV_SUPP_ACCIN_DIAGCPS ECU_ADDRESS 0xd000376f BIT_MASK 0x1 /end MEASUREMENT
/begin MEASUREMENT maf_diagcps "MAF value on start of step 3 - Functional check CPS" UWORD _CNV_A_R_LINEAR_____108_CM 1 100. 0. 1389. DISPLAY_IDENTIFIER MAF_DIAGCPS ECU_ADDRESS 0xc000062e FORMAT "%7.2" /end MEASUREMENT
/begin MEASUREMENT n_diagcps "N value on starting the time C_T_DIAGCPS_N_2" UWORD _CNV_A_R_LINEAR_____13_CM 1 100. 0. 8160. DISPLAY_IDENTIFIER N_DIAGCPS ECU_ADDRESS 0xc0000630 FORMAT "%4.0" /end MEASUREMENT
/begin MEASUREMENT sum_flow_sp_diagcps_eol "Number of step 2 loops which have been passed if EOL-Test is active - fuctional check CPS" UBYTE _CNV_A_R_LINEAR_____148_CM 1 100. 0. 255. DISPLAY_IDENTIFIER SUM_FLOW_SP_DIAGCPS_EOL ECU_ADDRESS 0xd000376a FORMAT "%3.0" /end MEASUREMENT
/begin MEASUREMENT sum_flow_sp_diagcps "Number of step 2 loops which have been passed - Functional check CPS" UBYTE _CNV_A_R_LINEAR_____148_CM 1 100. 0. 255. DISPLAY_IDENTIFIER SUM_FLOW_SP_DIAGCPS ECU_ADDRESS 0xc0000644 FORMAT "%3.0" /end MEASUREMENT
/begin MEASUREMENT sum_diag_diagcps_eol "Number of diagnoses if EOL-Test is active - Functional check CPS" UBYTE _CNV_A_R_LINEAR_____148_CM 1 100. 0. 255. DISPLAY_IDENTIFIER SUM_DIAG_DIAGCPS_EOL ECU_ADDRESS 0xd000376b FORMAT "%3.0" /end MEASUREMENT
/begin MEASUREMENT sum_diag_diagcps "Number of diagnoses - Functional check CPS" UBYTE _CNV_A_R_LINEAR_____148_CM 1 100. 0. 255. DISPLAY_IDENTIFIER SUM_DIAG_DIAGCPS ECU_ADDRESS 0xc0000645 FORMAT "%3.0" /end MEASUREMENT
/begin MEASUREMENT t_diagcps_dly "Delay time - Functional check CPS" UBYTE _CNV_A_R_LINEAR_____4_CM 1 100. 0.1 25.5 DISPLAY_IDENTIFIER T_DIAGCPS_DLY ECU_ADDRESS 0xc000064b FORMAT "%4.1" /end MEASUREMENT
/begin MEASUREMENT t_diagcps_maf "Time for active FLOW_SP offset - Functional check CPS" UBYTE _CNV_A_R_LINEAR_____4_CM 1 100. 0.1 25.5 DISPLAY_IDENTIFIER T_DIAGCPS_MAF ECU_ADDRESS 0xc000064c FORMAT "%4.1" /end MEASUREMENT
/begin MEASUREMENT maf_sp_tqi_mmv_diagcps "Moving mean value of MAF_SP_TQI (RAM cell) - Functional check CPS" UWORD _CNV_A_R_LINEAR_____108_CM 1 100. 0. 1389. DISPLAY_IDENTIFIER MAF_SP_TQI_MMV_DIAGCPS ECU_ADDRESS 0xd0004af8 FORMAT "%7.2" /end MEASUREMENT
/begin MEASUREMENT lv_maf_sp_tqi_dyw_diagcps "Indication for limited dynamic condition - Functional check CPS" UBYTE _CNV_S_2_RANGE__0___1_CM 1 100. 0. 1. DISPLAY_IDENTIFIER LV_MAF_SP_TQI_DYW_DIAGCPS ECU_ADDRESS 0xd0003770 BIT_MASK 0x1 /end MEASUREMENT
/begin CHARACTERISTIC c_cl_mmv_diagcps "Moving mean value of canister load for Functional check CPS" VALUE 0xa10291b6 _REC_VAL_20_u2 1.99996948242188 _CNV_A_R_LINEAR_____8_CM 0. 1.99996948242188 DISPLAY_IDENTIFIER C_CL_MMV_DIAGCPS FORMAT "%7.5" /end CHARACTERISTIC
/begin CHARACTERISTIC c_flow_sp_diagcps_maf "Flow setpoint offset in step 3 - Functional check CPS " VALUE 0xa10293d2 _REC_VAL_20_u2 7.9998779296875 _CNV_A_R_LINEAR_____147_CM 0. 7.9998779296875 DISPLAY_IDENTIFIER C_FLOW_SP_DIAGCPS_MAF FORMAT "%7.4" /end CHARACTERISTIC
/begin CHARACTERISTIC c_flow_sp_diagcps_n "Flow setpoint offset in step 2 - Functional check CPS " VALUE 0xa10293d4 _REC_VAL_20_u2 7.9998779296875 _CNV_A_R_LINEAR_____147_CM 0. 7.9998779296875 DISPLAY_IDENTIFIER C_FLOW_SP_DIAGCPS_N FORMAT "%7.4" /end CHARACTERISTIC
/begin CHARACTERISTIC c_lgrd_flow_sp_neg_diagcps "Limitation gradient for closing the CPS- funtional check CPS" VALUE 0xa1029516 _REC_VAL_20_u2 7.99987793 _CNV_A_R_LINEAR_____149_CM 0. 7.99987793 DISPLAY_IDENTIFIER C_LGRD_FLOW_SP_NEG_DIAGCPS FORMAT "%7.4" /end CHARACTERISTIC
/begin CHARACTERISTIC c_lgrd_flow_sp_pos_diagcps "Limitation gradient for opening the CPS- funtional check CPS" VALUE 0xa1029518 _REC_VAL_20_u2 7.99987793 _CNV_A_R_LINEAR_____149_CM 0. 7.99987793 DISPLAY_IDENTIFIER C_LGRD_FLOW_SP_POS_DIAGCPS FORMAT "%7.4" /end CHARACTERISTIC
/begin CHARACTERISTIC c_n_dif_diagcps "Condition for IS engine speed difference - Functional check CPS" VALUE 0xa10295de _REC_VAL_20_u2 8159. _CNV_A_R_LINEAR_____13_CM 1. 8160. DISPLAY_IDENTIFIER C_N_DIF_DIAGCPS FORMAT "%4.0" /end CHARACTERISTIC
/begin CHARACTERISTIC c_sum_flow_sp_diagcps_max "Max. number of step 2 loops which have been passed - Functional check CPS" VALUE 0xa10297d6 _REC_VAL_20_u1 255. _CNV_A_R_LINEAR_____148_CM 0. 255. DISPLAY_IDENTIFIER C_SUM_FLOW_SP_DIAGCPS_MAX FORMAT "%3.0" /end CHARACTERISTIC
/begin CHARACTERISTIC c_sum_diagcps_max "Counter limit of C_SUM_DIAGCPS - funtional check CPS" VALUE 0xa10297d5 _REC_VAL_20_u1 255. _CNV_A_R_LINEAR_____148_CM 0. 255. DISPLAY_IDENTIFIER C_SUM_DIAGCPS_MAX FORMAT "%3.0" /end CHARACTERISTIC
/begin CHARACTERISTIC c_t_diagcps_maf "Time for active FLOW_SP offset C_FLOW_SP_DIAGCPS_MAF - Functional check CPS" VALUE 0xa102983d _REC_VAL_20_u1 25.4 _CNV_A_R_LINEAR_____4_CM 0.1 25.5 DISPLAY_IDENTIFIER C_T_DIAGCPS_MAF FORMAT "%4.1" /end CHARACTERISTIC
/begin CHARACTERISTIC c_t_diagcps_dly "Delay time - Functional check CPS" VALUE 0xa102983c _REC_VAL_20_u1 25.4 _CNV_A_R_LINEAR_____4_CM 0.1 25.5 DISPLAY_IDENTIFIER C_T_DIAGCPS_DLY FORMAT "%3.1" /end CHARACTERISTIC
/begin CHARACTERISTIC c_crlc_maf_sp_tqi_diagcps "Correlation constant for calculation of MAF_SP_TQI_MMV_DIAGCPS" VALUE 0xa1029208 _REC_VAL_20_u2 1. _CNV_A_R_LINEAR_____150_CM 0. 1. DISPLAY_IDENTIFIER C_CRLC_MAF_SP_TQI_DIAGCPS FORMAT "%7.5" /end CHARACTERISTIC
/begin CHARACTERISTIC c_maf_sp_tqi_dyw_diagcps "Dynamic window around MAF_SP_TQI_MMV_DIAGCPS" VALUE 0xa102956a _REC_VAL_20_u2 1389. _CNV_A_R_LINEAR_____108_CM 0. 1389. DISPLAY_IDENTIFIER C_MAF_SP_TQI_DYW_DIAGCPS FORMAT "%7.2" /end CHARACTERISTIC
/begin CHARACTERISTIC c_maf_max_diagcps "MAF condition functional check CPS" VALUE 0xa1029554 _REC_VAL_20_u2 1389. _CNV_A_R_LINEAR_____108_CM 0. 1389. DISPLAY_IDENTIFIER C_MAF_MAX_DIAGCPS FORMAT "%7.2" /end CHARACTERISTIC
/begin MEASUREMENT flow_sp_cps_old "Last EVAP calculated flow set point through the CPS before start of FC CPS" UWORD _CNV_A_R_LINEAR_____147_CM 1 100. 0. 7.9998779296875 DISPLAY_IDENTIFIER FLOW_SP_CPS_OLD ECU_ADDRESS 0xc000062c FORMAT "%7.4" /end MEASUREMENT
/begin MEASUREMENT sum_diag_diagcps_sae "Output mode06h -  Step 2" UBYTE _CNV_A_R_LINEAR_____148_CM 1 100. 0. 255. DISPLAY_IDENTIFIER SUM_DIAG_DIAGCPS_SAE ECU_ADDRESS 0xd000376c FORMAT "%3.0" /end MEASUREMENT
/begin MEASUREMENT maf_diagcps_sae "Output mode06h - Step 3" UWORD _CNV_A_R_LINEAR_____108_CM 1 100. 0. 1389. DISPLAY_IDENTIFIER MAF_DIAGCPS_SAE ECU_ADDRESS 0xd0004af4 FORMAT "%4.0" /end MEASUREMENT
/begin MEASUREMENT maf_diagcps_thd_sae "Output mode06h - Step 3" UWORD _CNV_A_R_LINEAR_____108_CM 1 100. 0. 1389. DISPLAY_IDENTIFIER MAF_DIAGCPS_THD_SAE ECU_ADDRESS 0xd0004af6 FORMAT "%4.0" /end MEASUREMENT
/begin MEASUREMENT cl_mmv_sae "Output mode06h -  Step 1" UWORD _CNV_A_R_LINEAR_____8_CM 1 100. 0. 1.99996948242188 DISPLAY_IDENTIFIER CL_MMV_SAE ECU_ADDRESS 0xd0004af2 FORMAT "%7.5" /end MEASUREMENT
/begin CHARACTERISTIC c_tco_min_diagcps "min. temperature for Functional check CPS" VALUE 0xa10299d9 _REC_VAL_20_u1 190.5 _CNV_A_R_LINEAR_____16_CM -48. 142.5 DISPLAY_IDENTIFIER C_TCO_MIN_DIAGCPS FORMAT "%5.1" /end CHARACTERISTIC
/begin CHARACTERISTIC c_sum_diagcps_eol "EOL-test: Counter limit of SUM_DIAGCPS_EOL - functional check CPS" VALUE 0xa10297d4 _REC_VAL_20_u1 255. _CNV_A_R_LINEAR_____148_CM 0. 255. DISPLAY_IDENTIFIER C_SUM_DIAGCPS_EOL FORMAT "%3.0" /end CHARACTERISTIC
/begin MEASUREMENT lv_eol_cps_err "LV indicating error of functional check CPS (step 2) after EOL - test" UBYTE _CNV_S_2_RANGE__0___1_CM 1 100. 0. 1. DISPLAY_IDENTIFIER LV_EOL_CPS_ERR ECU_ADDRESS 0xd000376e BIT_MASK 0x1 /end MEASUREMENT
/begin MEASUREMENT lv_err_diagcps "Indication for faulty functions - functioanl check CPS" UBYTE _CNV_S_2_RANGE__0___1_CM 1 100. 0. 1. DISPLAY_IDENTIFIER LV_ERR_DIAGCPS ECU_ADDRESS 0xd0003441 BIT_MASK 0x1 /end MEASUREMENT
/begin MEASUREMENT lv_n_dif_diagcps "Auxiliary bit for step 2 - Functional check CPS" UBYTE _CNV_S_2_RANGE__0___1_CM 1 100. 0. 1. DISPLAY_IDENTIFIER LV_N_DIF_DIAGCPS ECU_ADDRESS 0xc0000658 BIT_MASK 0x1 /end MEASUREMENT
/begin MEASUREMENT lv_end_rbm_diagcps "Indication for RBM that all three steps have been executed - functional check CPS" UBYTE _CNV_S_2_RANGE__0___1_CM 1 100. 0. 1. DISPLAY_IDENTIFIER LV_END_RBM_DIAGCPS ECU_ADDRESS 0xd0003771 BIT_MASK 0x1 /end MEASUREMENT
/begin MEASUREMENT lv_map_dif_diagcps "Auxiliary bit for step 2 - Functional check CPS" UBYTE _CNV_S_2_RANGE__0___1_CM 1 100. 0. 1. DISPLAY_IDENTIFIER LV_MAP_DIF_DIAGCPS ECU_ADDRESS 0xc000065c BIT_MASK 0x1 /end MEASUREMENT
/begin MEASUREMENT lv_inh_map_ctl_diagcps "Inhibition of Map-control during step 2 - Functional check CPS" UBYTE _CNV_S_2_RANGE__0___1_CM 1 100. 0. 1. DISPLAY_IDENTIFIER LV_INH_MAP_CTL_DIAGCPS ECU_ADDRESS 0xd0003772 BIT_MASK 0x1 /end MEASUREMENT
/begin MEASUREMENT lv_lam_diagcps "Auxiliary bit for step 2 - Functional check CPS" UBYTE _CNV_S_2_RANGE__0___1_CM 1 100. 0. 1. DISPLAY_IDENTIFIER LV_LAM_DIAGCPS ECU_ADDRESS 0xc000065e BIT_MASK 0x1 /end MEASUREMENT
/begin MEASUREMENT lv_lam_sum_diagcps "Auxiliary bit for step 2 - Functional check CPS" UBYTE _CNV_S_2_RANGE__0___1_CM 1 100. 0. 1. DISPLAY_IDENTIFIER LV_LAM_SUM_DIAGCPS ECU_ADDRESS 0xc000065f BIT_MASK 0x1 /end MEASUREMENT
/begin MEASUREMENT map_diagcps "Map value on starting the time C_T_DIAGCPS_N_2" UWORD _CNV_A_R_LINEAR_____26_CM 1 100. 0. 5434. DISPLAY_IDENTIFIER MAP_DIAGCPS ECU_ADDRESS 0xc0000632 FORMAT "%7.2" /end MEASUREMENT
/begin MEASUREMENT sum_n_diag_diagcps "Number of diagnoses results N - functional check CPS" UBYTE _CNV_A_R_LINEAR_____148_CM 1 100. 0. 255. DISPLAY_IDENTIFIER SUM_N_DIAG_DIAGCPS ECU_ADDRESS 0xc0000646 FORMAT "%3.0" /end MEASUREMENT
/begin MEASUREMENT t_diagcps_lam_1 "1st time interval for LAM-Diagnosis - functional check CPS" UBYTE _CNV_A_R_LINEAR_____4_CM 1 100. 0.1 25.5 DISPLAY_IDENTIFIER T_DIAGCPS_LAM_1 ECU_ADDRESS 0xc0000650 FORMAT "%4.1" /end MEASUREMENT
/begin CHARACTERISTIC c_t_inh_map_ctl_diagcps "Time threshold for inhibition of MAP-control - Functional check CPS" VALUE 0xa10298ab _REC_VAL_20_u1 25.4 _CNV_A_R_LINEAR_____4_CM 0.1 25.5 DISPLAY_IDENTIFIER C_T_INH_MAP_CTL_DIAGCPS FORMAT "%4.1" /end CHARACTERISTIC
/begin CHARACTERISTIC c_ti_lam_diagcps_dif "min. TI_LAM_COR_i - differernce while CPS-opening STEP 2 - Functional check CPS" VALUE 0xa1029a48 _REC_VAL_20_s2 99.99847412109381 _CNV_A_R_LINEAR_____110_CM -50. 49.9984741210938 DISPLAY_IDENTIFIER C_TI_LAM_DIAGCPS_DIF FORMAT "%7.3" /end CHARACTERISTIC
/begin CHARACTERISTIC c_map_diagcps_1 "Threshold for map difference in step 2 - functional check CPS" VALUE 0xa1029570 _REC_VAL_20_u2 5434. _CNV_A_R_LINEAR_____26_CM 0. 5434. DISPLAY_IDENTIFIER C_MAP_DIAGCPS_1 FORMAT "%7.2" /end CHARACTERISTIC
/begin MEASUREMENT ti_lam_diagcps_dif[0] "TI_LAM_COR_1 - difference while CPS-opening during STEP2 - functional check CPS" SWORD _CNV_A_R_LINEAR_____110_CM 1 100. -50. 49.9984741210938 DISPLAY_IDENTIFIER TI_LAM_DIAGCPS_DIF[0] ECU_ADDRESS 0xc0000634 FORMAT "%5.4" /end MEASUREMENT
/begin MEASUREMENT ti_lam_diagcps_dif[1] "TI_LAM_COR_2 - difference while CPS-opening during STEP2 - functional check CPS" SWORD _CNV_A_R_LINEAR_____110_CM 1 100. -50. 49.9984741210938 DISPLAY_IDENTIFIER TI_LAM_DIAGCPS_DIF[1] ECU_ADDRESS 0xc0000636 FORMAT "%5.4" /end MEASUREMENT
/begin MEASUREMENT ti_lam_diagcps_max[0] "TI_LAM_COR_1 - max-value while CPS-opening during STEP2 - functional check CPS" SWORD _CNV_A_R_LINEAR_____110_CM 1 100. -50. 49.9984741210938 DISPLAY_IDENTIFIER TI_LAM_DIAGCPS_MAX[0] ECU_ADDRESS 0xc000063c FORMAT "%5.4" /end MEASUREMENT
/begin MEASUREMENT ti_lam_diagcps_max[1] "TI_LAM_COR_2 - max-value while CPS-opening during STEP2 - functional check CPS" SWORD _CNV_A_R_LINEAR_____110_CM 1 100. -50. 49.9984741210938 DISPLAY_IDENTIFIER TI_LAM_DIAGCPS_MAX[1] ECU_ADDRESS 0xc000063e FORMAT "%5.4" /end MEASUREMENT
/begin MEASUREMENT ti_lam_diagcps_min[0] "TI_LAM_COR_1 - min-value while CPS-opening during STEP2 - functional check CPS" SWORD _CNV_A_R_LINEAR_____110_CM 1 100. -50. 49.9984741210938 DISPLAY_IDENTIFIER TI_LAM_DIAGCPS_MIN[0] ECU_ADDRESS 0xc0000638 FORMAT "%5.4" /end MEASUREMENT
/begin MEASUREMENT ti_lam_diagcps_min[1] "TI_LAM_COR_2 - min-value while CPS-opening during STEP2 - functional check CPS" SWORD _CNV_A_R_LINEAR_____110_CM 1 100. -50. 49.9984741210938 DISPLAY_IDENTIFIER TI_LAM_DIAGCPS_MIN[1] ECU_ADDRESS 0xc000063a FORMAT "%5.4" /end MEASUREMENT
/begin CHARACTERISTIC c_maf_diagcps_2 "Delta MAF for MAF decrease - Functional check CPS" VALUE 0xa1029534 _REC_VAL_20_u2 1389. _CNV_A_R_LINEAR_____108_CM 0. 1389. DISPLAY_IDENTIFIER C_MAF_DIAGCPS_2 FORMAT "%7.2" /end CHARACTERISTIC
/begin CHARACTERISTIC c_map_diagcps_2 "Threshold for map difference in step 2 - functional check CPS" VALUE 0xa1029572 _REC_VAL_20_u2 5434. _CNV_A_R_LINEAR_____26_CM 0. 5434. DISPLAY_IDENTIFIER C_MAP_DIAGCPS_2 FORMAT "%7.2" /end CHARACTERISTIC
/begin MEASUREMENT state_diagcps "State - Functional check CPS" UBYTE _CNV_S_6_STATE_DIAG_151_CM 1 100. 0. 5. DISPLAY_IDENTIFIER STATE_DIAGCPS ECU_ADDRESS 0xd0003768 /end MEASUREMENT
/begin MEASUREMENT state_diagcps_rbm "State - Functional check CPS" UBYTE _CNV_S_6_STATE_DIAG_151_CM 1 100. 0. 5. DISPLAY_IDENTIFIER STATE_DIAGCPS_RBM ECU_ADDRESS 0xd0003769 /end MEASUREMENT
/begin MEASUREMENT sum_map_diag_diagcps "Number of diagnoses results MAP - functional check CPS" UBYTE _CNV_A_R_LINEAR_____148_CM 1 100. 0. 255. DISPLAY_IDENTIFIER SUM_MAP_DIAG_DIAGCPS ECU_ADDRESS 0xc0000647 FORMAT "%3.0" /end MEASUREMENT
/begin MEASUREMENT sum_n_diag_diagcps_ofs "Number of diagnoses results N within 1 offset - functional check CPS" UBYTE _CNV_A_R_LINEAR_____148_CM 1 100. 0. 255. DISPLAY_IDENTIFIER SUM_N_DIAG_DIAGCPS_OFS ECU_ADDRESS 0xc0000648 FORMAT "%3.0" /end MEASUREMENT
/begin MEASUREMENT sum_map_diag_diagcps_ofs "Number of diagnoses results MAP - functional check CPS" UBYTE _CNV_A_R_LINEAR_____148_CM 1 100. 0. 255. DISPLAY_IDENTIFIER SUM_MAP_DIAG_DIAGCPS_OFS ECU_ADDRESS 0xc0000649 FORMAT "%3.0" /end MEASUREMENT
/begin MEASUREMENT sum_maf_diag_diagcps_ofs "Number of diagnoses results MAF - functional check CPS" UBYTE _CNV_A_R_LINEAR_____148_CM 1 100. 0. 255. DISPLAY_IDENTIFIER SUM_MAF_DIAG_DIAGCPS_OFS ECU_ADDRESS 0xc000064a FORMAT "%3.0" /end MEASUREMENT
/begin MEASUREMENT t_diagcps_n_map_1 "1st time interval for N-DIF-Diagnosis - Functional check CPS" UBYTE _CNV_A_R_LINEAR_____4_CM 1 100. 0.1 25.5 DISPLAY_IDENTIFIER T_DIAGCPS_N_MAP_1 ECU_ADDRESS 0xc000064d FORMAT "%4.1" /end MEASUREMENT
/begin MEASUREMENT t_diagcps_n_map_2 "2nd time interval for N-DIF-Diagnosis - Functional check CPS" UBYTE _CNV_A_R_LINEAR_____4_CM 1 100. 0.1 25.5 DISPLAY_IDENTIFIER T_DIAGCPS_N_MAP_2 ECU_ADDRESS 0xc000064e FORMAT "%4.1" /end MEASUREMENT
/begin MEASUREMENT t_diagcps_n_map_3 "3rd time interval for N-DIF-Diagnosis - Functional check CPS" UBYTE _CNV_A_R_LINEAR_____4_CM 1 100. 0.1 25.5 DISPLAY_IDENTIFIER T_DIAGCPS_N_MAP_3 ECU_ADDRESS 0xc000064f FORMAT "%4.1" /end MEASUREMENT
/begin CHARACTERISTIC c_t_diagcps_n_map_1 "Time interval after expiry of which the cycle of step 2 is repeated - Functional check CPS" VALUE 0xa102983e _REC_VAL_20_u1 25.4 _CNV_A_R_LINEAR_____4_CM 0.1 25.5 DISPLAY_IDENTIFIER C_T_DIAGCPS_N_MAP_1 FORMAT "%4.1" /end CHARACTERISTIC
/begin CHARACTERISTIC c_t_diagcps_n_map_2 "Time as from setting C_FLOW_SP_DIAGCPS_N - Functional check CPS" VALUE 0xa102983f _REC_VAL_20_u1 25.4 _CNV_A_R_LINEAR_____4_CM 0.1 25.5 DISPLAY_IDENTIFIER C_T_DIAGCPS_N_MAP_2 FORMAT "%4.1" /end CHARACTERISTIC
/begin CHARACTERISTIC c_t_diagcps_n_map_3 "Time for increasing FLOW_SP - Functional check CPS" VALUE 0xa1029840 _REC_VAL_20_u1 25.4 _CNV_A_R_LINEAR_____4_CM 0.1 25.5 DISPLAY_IDENTIFIER C_T_DIAGCPS_N_MAP_3 FORMAT "%4.1" /end CHARACTERISTIC
/begin CHARACTERISTIC c_t_diagcps_n_map_4 "Time for increasing FLOW_SP - Functional check CPS" VALUE 0xa1029841 _REC_VAL_20_u1 25.4 _CNV_A_R_LINEAR_____4_CM 0.1 25.5 DISPLAY_IDENTIFIER C_T_DIAGCPS_N_MAP_4 FORMAT "%4.1" /end CHARACTERISTIC
/begin CHARACTERISTIC lc_diagcps_map_act_opm_2 "MAP monitoring activated during STEP_2 - throttled mode" VALUE 0xa1029d1a _REC_VAL_20_u1 1. _CNV_A_R_LINEAR_____0_CM 0. 1. DISPLAY_IDENTIFIER LC_DIAGCPS_MAP_ACT_OPM_2 FORMAT "%2.0" /end CHARACTERISTIC
/begin CHARACTERISTIC c_n_diagcps_2 "Threshold for engine speed increase in step 2 - Functional check CPS" VALUE 0xa10295d8 _REC_VAL_20_u2 8159. _CNV_A_R_LINEAR_____13_CM 1. 8160. DISPLAY_IDENTIFIER C_N_DIAGCPS_2 FORMAT "%4.0" /end CHARACTERISTIC
/begin CHARACTERISTIC c_sum_n_diag_diagcps_ofs "Counter for events per offset during STEP_2- functional check CPS" VALUE 0xa10297d9 _REC_VAL_20_u1 255. _CNV_A_R_LINEAR_____148_CM 0. 255. DISPLAY_IDENTIFIER C_SUM_N_DIAG_DIAGCPS_OFS FORMAT "%3.0" /end CHARACTERISTIC
/begin CHARACTERISTIC c_sum_map_diag_diagcps_ofs "" VALUE 0xa10297d8 _REC_VAL_20_u1 255. _CNV_A_R_LINEAR_____148_CM 0. 255. DISPLAY_IDENTIFIER C_SUM_MAP_DIAG_DIAGCPS_OFS FORMAT "%3.0" /end CHARACTERISTIC
/begin CHARACTERISTIC c_sum_maf_diag_diagcps_ofs "" VALUE 0xa10297d7 _REC_VAL_20_u1 255. _CNV_A_R_LINEAR_____148_CM 0. 255. DISPLAY_IDENTIFIER C_SUM_MAF_DIAG_DIAGCPS_OFS FORMAT "%3.0" /end CHARACTERISTIC
/begin MEASUREMENT lv_inh_diag_fsd_cp "Deactivation bit for fuel system diagnosis due to internal states of the CP-function" UBYTE _CNV_S_2_RANGE__0___1_CM 1 100. 0. 1. DISPLAY_IDENTIFIER LV_INH_DIAG_FSD_CP ECU_ADDRESS 0xd0003e81 BIT_MASK 0x1 /end MEASUREMENT
/begin CHARACTERISTIC lc_inh_fsd_man_deac "Manual deactivation of FSD inhibitation" VALUE 0xa1029d54 _REC_VAL_20_u1 1. _CNV_A_R_LINEAR_____50_CM 0. 1. DISPLAY_IDENTIFIER LC_INH_FSD_MAN_DEAC FORMAT "%2.0" /end CHARACTERISTIC
/begin CHARACTERISTIC c_cl_mmv_max_fsd "Maximum value for CL_MMV to permit FSD" VALUE 0xa10291ba _REC_VAL_20_u2 1.99996948242188 _CNV_A_R_LINEAR_____8_CM 0. 1.99996948242188 DISPLAY_IDENTIFIER C_CL_MMV_MAX_FSD FORMAT "%7.5" /end CHARACTERISTIC
/begin CHARACTERISTIC c_tco_min_fsd_pu "Minimum coolent tempeature for FSD stop during PU" VALUE 0xa10299e2 _REC_VAL_20_u1 190.5 _CNV_A_R_LINEAR_____16_CM -48. 142.5 DISPLAY_IDENTIFIER C_TCO_MIN_FSD_PU FORMAT "%5.1" /end CHARACTERISTIC
/begin CHARACTERISTIC c_t_dly_fsd_pu "Time after end of PU before restart of FSD" VALUE 0xa1029854 _REC_VAL_20_u2 1310.7 _CNV_A_R_LINEAR_____107_CM 0. 1310.7 DISPLAY_IDENTIFIER C_T_DLY_FSD_PU FORMAT "%7.2" /end CHARACTERISTIC
/begin CHARACTERISTIC c_t_dly_fsd_reac "Time after end of PUC before restart of FSD" VALUE 0xa1029856 _REC_VAL_20_u2 1310.7 _CNV_A_R_LINEAR_____107_CM 0. 1310.7 DISPLAY_IDENTIFIER C_T_DLY_FSD_REAC FORMAT "%7.2" /end CHARACTERISTIC
/begin MEASUREMENT lv_inh_diag_fsd "fuel system diagnosis: application incidence to inhibit the diagnosis" UBYTE _CNV_S_2_RANGE__0___1_CM 1 100. 0. 1. DISPLAY_IDENTIFIER LV_INH_DIAG_FSD ECU_ADDRESS 0xd0003e80 BIT_MASK 0x1 /end MEASUREMENT
/begin MEASUREMENT lv_err_det_fsd[0] "Error detection flag FSD diagnosis" UBYTE _CNV_S_2_RANGE__0___1_CM 1 100. 0. 1. DISPLAY_IDENTIFIER LV_ERR_DET_FSD[0] ECU_ADDRESS 0xd0003e82 BIT_MASK 0x1 /end MEASUREMENT
/begin MEASUREMENT lv_err_det_fsd[1] "Error detection flag FSD diagnosis" UBYTE _CNV_S_2_RANGE__0___1_CM 1 100. 0. 1. DISPLAY_IDENTIFIER LV_ERR_DET_FSD[1] ECU_ADDRESS 0xd0003e83 BIT_MASK 0x1 /end MEASUREMENT
/begin CHARACTERISTIC c_t_ramp_lim_i_dt_is "Time constant for ramp limit of I-controller output in case of idle speed controller passive and drive train engaged" VALUE 0xa1029946 _REC_VAL_20_u2 1310.7 _CNV_A_R_LINEAR_____107_CM 0. 1310.7 DISPLAY_IDENTIFIER C_T_RAMP_LIM_I_DT_IS FORMAT "%7.2" /end CHARACTERISTIC
/begin CHARACTERISTIC c_t_ramp_lim_p_d_dt_is "Time constant for ramp limit of P-, D-controller output in case of idle speed controller passive and LV_DT=1" VALUE 0xa102994a _REC_VAL_20_u2 655.35 _CNV_A_R_LINEAR_____3_CM 0. 655.35 DISPLAY_IDENTIFIER C_T_RAMP_LIM_P_D_DT_IS FORMAT "%5.2" /end CHARACTERISTIC
/begin CHARACTERISTIC c_t_ramp_lim_p_d_is "Time constant for ramp limit of P-, D-controller output in case of idle speed controller passive" VALUE 0xa102994c _REC_VAL_20_u2 655.35 _CNV_A_R_LINEAR_____3_CM 0. 655.35 DISPLAY_IDENTIFIER C_T_RAMP_LIM_P_D_IS FORMAT "%5.2" /end CHARACTERISTIC
/begin CHARACTERISTIC c_tq_bol_i_is "Bottom limit for I-controller output" VALUE 0xa1029af0 _REC_VAL_20_s2 2047.96875 _CNV_A_R_LINEAR_____30_CM -1024. 1023.96875 DISPLAY_IDENTIFIER C_TQ_BOL_I_IS FORMAT "%7.1" /end CHARACTERISTIC
/begin CHARACTERISTIC c_tq_tol_i_is "Top limit for I-controller output" VALUE 0xa1029b32 _REC_VAL_20_s2 2047.96875 _CNV_A_R_LINEAR_____30_CM -1024. 1023.96875 DISPLAY_IDENTIFIER C_TQ_TOL_I_IS FORMAT "%7.1" /end CHARACTERISTIC
/begin MEASUREMENT tq_dif_p_d_fast_is "TQ_DIF_P_D_IS for fast-path of torque coordination" SWORD _CNV_A_R_LINEAR_____30_CM 1 100. -1024. 1023.96875 DISPLAY_IDENTIFIER TQ_DIF_P_D_FAST_IS ECU_ADDRESS 0xd0005204 FORMAT "%6.2" /end MEASUREMENT
/begin MEASUREMENT tq_dif_i_is "I- controller output for idle speed control" SWORD _CNV_A_R_LINEAR_____30_CM 1 100. -1024. 1023.96875 DISPLAY_IDENTIFIER TQ_DIF_I_IS ECU_ADDRESS 0xd0005200 FORMAT "%6.2" /end MEASUREMENT
/begin MEASUREMENT tq_add_i_is "Incrememt of limited integrator" SWORD _CNV_A_R_LINEAR_____175_CM 1 100. -4. 3.99987793 DISPLAY_IDENTIFIER TQ_ADD_I_IS ECU_ADDRESS 0xc0000790 FORMAT "%7.4" /end MEASUREMENT
/begin CHARACTERISTIC lc_tq_dif_i_inh_as "Logical variable for ISCI I-part deactivation - default value at initialisation = 0" VALUE 0xa1029df8 _REC_VAL_20_u1 1. _CNV_A_R_LINEAR_____0_CM 0. 1. DISPLAY_IDENTIFIER LC_TQ_DIF_I_INH_AS FORMAT "%1.0" /end CHARACTERISTIC
/begin CHARACTERISTIC lc_tq_dif_p_d_inh_as "Logical variable for deactivation of TQ_DIF_P_D_IS -default value at initialisation = 0" VALUE 0xa1029df9 _REC_VAL_20_u1 1. _CNV_A_R_LINEAR_____0_CM 0. 1. DISPLAY_IDENTIFIER LC_TQ_DIF_P_D_INH_AS FORMAT "%1.0" /end CHARACTERISTIC
/begin MEASUREMENT n_grd_fil_is "Filtered engine speed gradient for ISC" SBYTE _CNV_A_R_LINEAR_____29_CM 1 100. -4096. 4064. DISPLAY_IDENTIFIER N_GRD_FIL_IS ECU_ADDRESS 0xc00007ea FORMAT "%4.0" /end MEASUREMENT
/begin MEASUREMENT n_grd_p_d_is "Filtered gradient for PD-part" SBYTE _CNV_A_R_LINEAR_____29_CM 1 100. -4096. 4064. DISPLAY_IDENTIFIER N_GRD_P_D_IS ECU_ADDRESS 0xc00007e9 FORMAT "%5.0" /end MEASUREMENT
/begin MEASUREMENT n_grd_i_is "Filtered gradient for I-part" SBYTE _CNV_A_R_LINEAR_____29_CM 1 100. -4096. 4064. DISPLAY_IDENTIFIER N_GRD_I_IS ECU_ADDRESS 0xc00007e8 FORMAT "%5.0" /end MEASUREMENT
/begin MEASUREMENT lv_pas_ramp_act_p_d_is "Logical value for PD-part passive ramp active" UBYTE _CNV_S_2_RANGE__0___1_CM 1 100. 0. 1. DISPLAY_IDENTIFIER LV_PAS_RAMP_ACT_P_D_IS ECU_ADDRESS 0xd0003daa BIT_MASK 0x1 /end MEASUREMENT
/begin MEASUREMENT tq_add_i_ramp "Increment of the I-part ramps" SWORD _CNV_A_R_LINEAR_____30_CM 1 100. -1024. 1023.96875 DISPLAY_IDENTIFIER TQ_ADD_I_RAMP ECU_ADDRESS 0xc0000792 FORMAT "%6.2" /end MEASUREMENT
/begin MEASUREMENT state_p_d_isc "State of the PD-part: P_D_PASSIVE, P_D_NORMAL, RAMP_TO_ZERO" UBYTE _CNV_S_3_STATE_P_D__176_CM 1 100. 0. 2. DISPLAY_IDENTIFIER STATE_P_D_ISC ECU_ADDRESS 0xc00007e4 /end MEASUREMENT
/begin MEASUREMENT state_i_isc "State of the integral part: I_PASSIVE, I_NORMAL, RAMP_TO_PAS, RAMP_TO_LIM" UBYTE _CNV_S_4_STATE_I_IS_177_CM 1 100. 0. 3. DISPLAY_IDENTIFIER STATE_I_ISC ECU_ADDRESS 0xc00007e7 /end MEASUREMENT
/begin CHARACTERISTIC lc_isc_inh "Bit for inhibiting the PD- and integral part - default value = 0" VALUE 0xa1029d6d _REC_VAL_20_u1 1. _CNV_A_R_LINEAR_____0_CM 0. 1. DISPLAY_IDENTIFIER LC_ISC_INH FORMAT "%1.0" /end CHARACTERISTIC
/begin CHARACTERISTIC lc_tq_add_i_inh_as "Logical variable for ISC I-part map output deactivation - default value at initialisation = 0" VALUE 0xa1029df4 _REC_VAL_20_u1 1. _CNV_A_R_LINEAR_____0_CM 0. 1. DISPLAY_IDENTIFIER LC_TQ_ADD_I_INH_AS FORMAT "%1.0" /end CHARACTERISTIC
/begin AXIS_PTS ldpm_tco_is_1 "" 0xa1022294 tco _REC_AXS_20_u1 190.5 _CNV_A_R_LINEAR_____16_CM 8 -48. 142.5 FORMAT "%5.1" /end AXIS_PTS
/begin AXIS_PTS ldpm_gr_mt_2 "" 0xa1021b10 gr_mt _REC_AXS_20_u1 255. _CNV_A_R_LINEAR_____0_CM 8 0. 255. FORMAT "%3.0" /end AXIS_PTS
/begin MEASUREMENT tq_dif_p_d_is_slow "PD-part before seperation into fast/slow path" SWORD _CNV_A_R_LINEAR_____30_CM 1 100. -1024. 1023.96875 DISPLAY_IDENTIFIER TQ_DIF_P_D_IS_SLOW ECU_ADDRESS 0xc00007ac FORMAT "%8.2" /end MEASUREMENT
/begin MEASUREMENT tq_dif_p_d_is_fast "PD-part before seperation into fast/slow path" SWORD _CNV_A_R_LINEAR_____30_CM 1 100. -1024. 1023.96875 DISPLAY_IDENTIFIER TQ_DIF_P_D_IS_FAST ECU_ADDRESS 0xc00007aa FORMAT "%8.2" /end MEASUREMENT
/begin MEASUREMENT tq_add_p_d_ramp_fast "Increment of the PD-part ramps ignition path" SWORD _CNV_A_R_LINEAR_____30_CM 1 100. -1024. 1023.96875 DISPLAY_IDENTIFIER TQ_ADD_P_D_RAMP_FAST ECU_ADDRESS 0xc00007a2 FORMAT "%8.2" /end MEASUREMENT
/begin MEASUREMENT tq_add_p_d_ramp_slow "Increment of the PD-part ramps air path" SWORD _CNV_A_R_LINEAR_____30_CM 1 100. -1024. 1023.96875 DISPLAY_IDENTIFIER TQ_ADD_P_D_RAMP_SLOW ECU_ADDRESS 0xc00007a4 FORMAT "%8.2" /end MEASUREMENT
/begin MEASUREMENT lv_tq_p_d_act_fast "Logical variable for PD-part fast active (STATE_P_D_ISC = P_D_NORMAL)" UBYTE _CNV_S_2_RANGE__0___1_CM 1 100. 0. 1. DISPLAY_IDENTIFIER LV_TQ_P_D_ACT_FAST ECU_ADDRESS 0xc00007f2 BIT_MASK 0x1 /end MEASUREMENT
/begin MEASUREMENT lv_tq_p_d_act_slow "Logical variable for PD-part air path active (STATE_P_D_ISC = P_D_NORMAL)" UBYTE _CNV_S_2_RANGE__0___1_CM 1 100. 0. 1. DISPLAY_IDENTIFIER LV_TQ_P_D_ACT_SLOW ECU_ADDRESS 0xc00007f3 BIT_MASK 0x1 /end MEASUREMENT
/begin CHARACTERISTIC id_fac_p_d_dt_is "Weighting factor for IP_P_D_DT_IS" CURVE 0xa102249c _REC_CUR_20_u2_u1 1.99996948242188 _CNV_A_R_LINEAR_____8_CM 0. 1.99996948242188 DISPLAY_IDENTIFIER ID_FAC_P_D_DT_IS FORMAT "%7.5"
 /begin AXIS_DESCR COM_AXIS gr_mt _CNV_A_R_LINEAR_____0_CM 8 0. 255. FORMAT "%3.0" AXIS_PTS_REF ldpm_gr_mt_2 /end AXIS_DESCR
/end CHARACTERISTIC
/begin CHARACTERISTIC id_fac_p_d_dt_is_slow "Weighting factor for IP_P_D_DT_IS_SLOW" CURVE 0xa10224ac _REC_CUR_20_u2_u1 1.99996948242188 _CNV_A_R_LINEAR_____8_CM 0. 1.99996948242188 DISPLAY_IDENTIFIER ID_FAC_P_D_DT_IS_SLOW FORMAT "%7.5"
 /begin AXIS_DESCR COM_AXIS gr_mt _CNV_A_R_LINEAR_____0_CM 8 0. 255. FORMAT "%3.0" AXIS_PTS_REF ldpm_gr_mt_2 /end AXIS_DESCR
/end CHARACTERISTIC
/begin AXIS_PTS ldpm_t_ast__fac_n_grd_is "" 0xa10221dc t_ast _REC_AXS_20_u2 6553.5 _CNV_A_R_LINEAR_____4_CM 8 0. 6553.5 FORMAT "%5.1" /end AXIS_PTS
/begin CHARACTERISTIC ip_fac_n_grd_is "Weighting factor N_GRD input for IP_P_D_IS" MAP 0xa1023b30 _REC_MAP_20_u1_u1_u2 1.9921875 _CNV_A_R_LINEAR_____100_CM 0. 1.9921875 DISPLAY_IDENTIFIER IP_FAC_N_GRD_IS FORMAT "%5.3"
 /begin AXIS_DESCR COM_AXIS tco _CNV_A_R_LINEAR_____16_CM 3 -48. 142.5 FORMAT "%6.2" AXIS_PTS_REF ldpm_tco__fac_n_grd_is /end AXIS_DESCR
 /begin AXIS_DESCR COM_AXIS t_ast _CNV_A_R_LINEAR_____4_CM 8 0. 6553.5 FORMAT "%5.1" AXIS_PTS_REF ldpm_t_ast__fac_n_grd_is /end AXIS_DESCR
/end CHARACTERISTIC
/begin CHARACTERISTIC lc_tq_p_d_slow_inh_as "Logical variable for deactivation of TQ_DIF_P_D_IS - default value at initialisation = 0" VALUE 0xa1029e04 _REC_VAL_20_u1 1. _CNV_A_R_LINEAR_____0_CM 0. 1. DISPLAY_IDENTIFIER LC_TQ_P_D_SLOW_INH_AS FORMAT "%1.0" /end CHARACTERISTIC
/begin CHARACTERISTIC lc_tq_p_d_fast_inh_as "Logical variable for deactivation of TQ_DIF_P_D_IS - default value at initialisation = 0" VALUE 0xa1029e03 _REC_VAL_20_u1 1. _CNV_A_R_LINEAR_____0_CM 0. 1. DISPLAY_IDENTIFIER LC_TQ_P_D_FAST_INH_AS FORMAT "%1.0" /end CHARACTERISTIC
/begin CHARACTERISTIC ip_fac_n_grd_is_slow "Weighting factor N_GRD input for IP_P_D_IS_SLOW" MAP 0xa1023b48 _REC_MAP_20_u1_u1_u2 1.9921875 _CNV_A_R_LINEAR_____100_CM 0. 1.9921875 DISPLAY_IDENTIFIER IP_FAC_N_GRD_IS_SLOW FORMAT "%5.3"
 /begin AXIS_DESCR COM_AXIS tco _CNV_A_R_LINEAR_____16_CM 3 -48. 142.5 FORMAT "%6.2" AXIS_PTS_REF ldpm_tco__fac_n_grd_is /end AXIS_DESCR
 /begin AXIS_DESCR COM_AXIS t_ast _CNV_A_R_LINEAR_____4_CM 8 0. 6553.5 FORMAT "%5.1" AXIS_PTS_REF ldpm_t_ast__fac_n_grd_is /end AXIS_DESCR
/end CHARACTERISTIC
/begin AXIS_PTS ldpm_tco__fac_n_grd_is "" 0xa102223a tco _REC_AXS_20_u1 190.5 _CNV_A_R_LINEAR_____16_CM 3 -48. 142.5 FORMAT "%6.2" /end AXIS_PTS
/begin CHARACTERISTIC ip_fac_t_ast_i_is_opm_1 "TQ_ADD_I_IS correction after start in operation mode 1" MAP 0xa1023fbc _REC_MAP_20_u2_u1_u2 0.999755 _CNV_A_R_LINEAR_____178_CM 0. 0.999755 DISPLAY_IDENTIFIER IP_FAC_T_AST_I_IS_OPM_1 FORMAT "%7.5"
 /begin AXIS_DESCR COM_AXIS tco _CNV_A_R_LINEAR_____16_CM 3 -48. 142.5 FORMAT "%6.2" AXIS_PTS_REF ldpm_tco__fac_n_grd_is /end AXIS_DESCR
 /begin AXIS_DESCR COM_AXIS t_ast _CNV_A_R_LINEAR_____4_CM 8 0. 6553.5 FORMAT "%5.1" AXIS_PTS_REF ldpm_t_ast__fac_n_grd_is /end AXIS_DESCR
/end CHARACTERISTIC
/begin CHARACTERISTIC c_t_ramp_lim_i_is "Time constant for ramp limit of I-controller output in case of idle speed controller passive" VALUE 0xa1029948 _REC_VAL_20_u2 1310.7 _CNV_A_R_LINEAR_____107_CM 0. 1310.7 DISPLAY_IDENTIFIER C_T_RAMP_LIM_I_IS FORMAT "%7.2" /end CHARACTERISTIC
/begin CHARACTERISTIC lc_p_d_slow_fast_sel_ena "Enable seperation of slow and fast path of TQ_DIF_P_D_IS - default value at initialisation = 0" VALUE 0xa1029db3 _REC_VAL_20_u1 1. _CNV_A_R_LINEAR_____0_CM 0. 1. DISPLAY_IDENTIFIER LC_P_D_SLOW_FAST_SEL_ENA FORMAT "%1.0" /end CHARACTERISTIC
/begin MEASUREMENT tq_dif_p_d_dt_is_1 "PD-part st drive train into fast path" SWORD _CNV_A_R_LINEAR_____30_CM 1 100. -1024. 1023.96875 DISPLAY_IDENTIFIER TQ_DIF_P_D_DT_IS_1 ECU_ADDRESS 0xc00007a6 FORMAT "%8.2" /end MEASUREMENT
/begin MEASUREMENT tq_dif_p_d_dt_is_1_slow "PD-part at drive train into slow path" SWORD _CNV_A_R_LINEAR_____30_CM 1 100. -1024. 1023.96875 DISPLAY_IDENTIFIER TQ_DIF_P_D_DT_IS_1_SLOW ECU_ADDRESS 0xc00007a8 FORMAT "%8.2" /end MEASUREMENT
/begin MEASUREMENT fac_n_grd_is "Factor in dependance of TCO and TOIL for weighting the speed gradient influence on the PD-part (for LV_DT=0)" UBYTE _CNV_A_R_LINEAR_____97_CM 1 100. 0. 1.99220002 DISPLAY_IDENTIFIER FAC_N_GRD_IS ECU_ADDRESS 0xc00007e5 FORMAT "%5.3" /end MEASUREMENT
/begin MEASUREMENT fac_n_grd_is_slow "Factor in dependance of TCO and TOIL for weighting the speed gradient influence on the PD-part (for LV_DT=0)" UBYTE _CNV_A_R_LINEAR_____97_CM 1 100. 0. 1.99220002 DISPLAY_IDENTIFIER FAC_N_GRD_IS_SLOW ECU_ADDRESS 0xc00007e6 FORMAT "%5.3" /end MEASUREMENT
/begin CHARACTERISTIC c_crlc_n_grd "Filter correlation constant" VALUE 0xa102920c _REC_VAL_20_u2 0.9999847412109381 _CNV_A_R_LINEAR_____68_CM 0. 0.9999847412109381 DISPLAY_IDENTIFIER C_CRLC_N_GRD FORMAT "%7.5" /end CHARACTERISTIC
/begin CHARACTERISTIC c_nr_buf_n_grd_fil "number of relevant buffer cells for N_GRD_FIL_1_IS" VALUE 0xa10296ba _REC_VAL_20_u1 5. _CNV_A_R_LINEAR_____0_CM 1. 6. DISPLAY_IDENTIFIER C_NR_BUF_N_GRD_FIL FORMAT "%2.0" /end CHARACTERISTIC
/begin CHARACTERISTIC lc_n_grd_fil_p_d_swi "Logical variable for switching between N_GRD_FIL_1_IS and N_GRD_FIL_IS" VALUE 0xa1029d80 _REC_VAL_20_u1 1. _CNV_A_R_LINEAR_____0_CM 0. 1. DISPLAY_IDENTIFIER LC_N_GRD_FIL_P_D_SWI FORMAT "%1.0" /end CHARACTERISTIC
/begin CHARACTERISTIC lc_n_grd_fil_i_swi "Logical variable for changing between N_GRD_FIL_1_IS and N_GRD_FIL_IS" VALUE 0xa1029d7f _REC_VAL_20_u1 1. _CNV_A_R_LINEAR_____0_CM 0. 1. DISPLAY_IDENTIFIER LC_N_GRD_FIL_I_SWI FORMAT "%1.0" /end CHARACTERISTIC
/begin CHARACTERISTIC c_tq_isc_i_max_tq_drof "I limitation at drive off" VALUE 0xa1029afe _REC_VAL_20_s2 2047.96875 _CNV_A_R_LINEAR_____30_CM -1024. 1023.96875 DISPLAY_IDENTIFIER C_TQ_ISC_I_MAX_TQ_DROF FORMAT "%7.1" /end CHARACTERISTIC
/begin CHARACTERISTIC c_tq_min_isc_tq_drof_slow "P_D limitation at drive off " VALUE 0xa1029b28 _REC_VAL_20_s2 2047.96875 _CNV_A_R_LINEAR_____30_CM -1024. 1023.96875 DISPLAY_IDENTIFIER C_TQ_MIN_ISC_TQ_DROF_SLOW FORMAT "%7.1" /end CHARACTERISTIC
/begin CHARACTERISTIC c_tq_max_isc_tq_drof_fast "P_D limitation at Drive off" VALUE 0xa1029b20 _REC_VAL_20_s2 2047.96875 _CNV_A_R_LINEAR_____30_CM -1024. 1023.96875 DISPLAY_IDENTIFIER C_TQ_MAX_ISC_TQ_DROF_FAST FORMAT "%7.1" /end CHARACTERISTIC
/begin CHARACTERISTIC c_tq_min_isc_tq_drof_fast "P_D limitation at Drive off" VALUE 0xa1029b26 _REC_VAL_20_s2 2047.96875 _CNV_A_R_LINEAR_____30_CM -1024. 1023.96875 DISPLAY_IDENTIFIER C_TQ_MIN_ISC_TQ_DROF_FAST FORMAT "%7.1" /end CHARACTERISTIC
/begin CHARACTERISTIC c_tq_isc_i_min_tq_drof "I limitation at drive off" VALUE 0xa1029b02 _REC_VAL_20_s2 2047.96875 _CNV_A_R_LINEAR_____30_CM -1024. 1023.96875 DISPLAY_IDENTIFIER C_TQ_ISC_I_MIN_TQ_DROF FORMAT "%7.1" /end CHARACTERISTIC
/begin CHARACTERISTIC c_tq_max_isc_tq_drof_slow "P_D limitation at Drive off" VALUE 0xa1029b22 _REC_VAL_20_s2 2047.96875 _CNV_A_R_LINEAR_____30_CM -1024. 1023.96875 DISPLAY_IDENTIFIER C_TQ_MAX_ISC_TQ_DROF_SLOW FORMAT "%7.1" /end CHARACTERISTIC
/begin MEASUREMENT tq_dif_i_is_2 "I part at normal but ramp operation" SWORD _CNV_A_R_LINEAR_____30_CM 1 100. -1024. 1023.96875 DISPLAY_IDENTIFIER TQ_DIF_I_IS_2 ECU_ADDRESS 0xc0000798 FORMAT "%6.2" /end MEASUREMENT
/begin MEASUREMENT tq_dif_i_is_1 "I part at normal out of calculation" SWORD _CNV_A_R_LINEAR_____30_CM 1 100. -1024. 1023.96875 DISPLAY_IDENTIFIER TQ_DIF_I_IS_1 ECU_ADDRESS 0xc0000796 FORMAT "%6.2" /end MEASUREMENT
/begin MEASUREMENT state_pas_ramp_act_p_d_is "Circular buffer for the logical value for PD part passive ramp active" UBYTE _CNV_A_R_LINEAR_____0_CM 1 100. 0. 255. DISPLAY_IDENTIFIER STATE_PAS_RAMP_ACT_P_D_IS ECU_ADDRESS 0xd0003da8 FORMAT "%3.0" /end MEASUREMENT
/begin MEASUREMENT state_pas_ramp_act_i_is "Circular buffer for the logical value for I part passive ramp active" UBYTE _CNV_A_R_LINEAR_____0_CM 1 100. 0. 255. DISPLAY_IDENTIFIER STATE_PAS_RAMP_ACT_I_IS ECU_ADDRESS 0xd0003da9 FORMAT "%3.0" /end MEASUREMENT
/begin CHARACTERISTIC ip_fac_tco_pas_i_is "TCO correction at entry in I share calculation" CURVE 0xa1024026 _REC_CUR_20_u1_u1 0.99609375 _CNV_A_R_LINEAR_____71_CM 0. 0.99609375 DISPLAY_IDENTIFIER IP_FAC_TCO_PAS_I_IS FORMAT "%5.3"
 /begin AXIS_DESCR COM_AXIS tco _CNV_A_R_LINEAR_____16_CM 4 -48. 142.5 FORMAT "%5.1" AXIS_PTS_REF ldp_tco__fac_tco_pas_i_is /end AXIS_DESCR
/end CHARACTERISTIC
/begin AXIS_PTS ldp_tco__fac_tco_pas_i_is "" 0xa1021270 tco _REC_AXS_20_u1 190.5 _CNV_A_R_LINEAR_____16_CM 4 -48. 142.5 FORMAT "%5.1" /end AXIS_PTS
/begin CHARACTERISTIC c_tq_bol_i_dt_is "Bottom limit for I-controller output and drive train closed" VALUE 0xa1029aee _REC_VAL_20_s2 2047.96875 _CNV_A_R_LINEAR_____30_CM -1024. 1023.96875 DISPLAY_IDENTIFIER C_TQ_BOL_I_DT_IS FORMAT "%7.1" /end CHARACTERISTIC
/begin CHARACTERISTIC c_thd_tq_add_pste_i_isc "TQ_ADD_PSTE threshold for calc of  I limitation threshold" VALUE 0xa1029a2e _REC_VAL_20_s2 2047.96875 _CNV_A_R_LINEAR_____30_CM -1024. 1023.96875 DISPLAY_IDENTIFIER C_THD_TQ_ADD_PSTE_I_ISC FORMAT "%7.1" /end CHARACTERISTIC
/begin CHARACTERISTIC c_thd_tq_loss_pste_i_isc "TQ_LOSS_PSTE threshold for calc of I limitation threshold" VALUE 0xa1029a32 _REC_VAL_20_s2 2047.96875 _CNV_A_R_LINEAR_____30_CM -1024. 1023.96875 DISPLAY_IDENTIFIER C_THD_TQ_LOSS_PSTE_I_ISC FORMAT "%7.1" /end CHARACTERISTIC
/begin CHARACTERISTIC c_thd_tq_add_pste_i_isc_hys "Hysteresis for TQ_ADD_PSTE threshold to leave I limitation" VALUE 0xa1029a30 _REC_VAL_20_s2 2047.96875 _CNV_A_R_LINEAR_____30_CM -1024. 1023.96875 DISPLAY_IDENTIFIER C_THD_TQ_ADD_PSTE_I_ISC_HYS FORMAT "%7.1" /end CHARACTERISTIC
/begin CHARACTERISTIC c_thd_tq_loss_pste_i_isc_hys "Hysteresis for TQ_LOSS_PSTE threshold to leave I limitation" VALUE 0xa1029a34 _REC_VAL_20_s2 2047.96875 _CNV_A_R_LINEAR_____30_CM -1024. 1023.96875 DISPLAY_IDENTIFIER C_THD_TQ_LOSS_PSTE_I_ISC_HYS FORMAT "%7.1" /end CHARACTERISTIC
/begin CHARACTERISTIC c_tq_isc_i_max_tq_pste "I limitation max value at  PSTE intervention" VALUE 0xa1029b00 _REC_VAL_20_s2 2047.96875 _CNV_A_R_LINEAR_____30_CM -1024. 1023.96875 DISPLAY_IDENTIFIER C_TQ_ISC_I_MAX_TQ_PSTE FORMAT "%7.1" /end CHARACTERISTIC
/begin CHARACTERISTIC c_tq_isc_i_min_tq_pste "I limitation min value at PSTE intervention" VALUE 0xa1029b04 _REC_VAL_20_s2 2047.96875 _CNV_A_R_LINEAR_____30_CM -1024. 1023.96875 DISPLAY_IDENTIFIER C_TQ_ISC_I_MIN_TQ_PSTE FORMAT "%7.1" /end CHARACTERISTIC
/begin CHARACTERISTIC c_t_tq_isc_i_tq_pste_lim "Delay time to reset the idle speed controller limitation due to PSTE" VALUE 0xa1029988 _REC_VAL_20_u2 1310.7 _CNV_A_R_LINEAR_____107_CM 0. 1310.7 DISPLAY_IDENTIFIER C_T_TQ_ISC_I_TQ_PSTE_LIM FORMAT "%7.2" /end CHARACTERISTIC
/begin MEASUREMENT lv_pas_ramp_act_i_is "Logical value for I-part passive ramp active" UBYTE _CNV_S_2_RANGE__0___1_CM 1 100. 0. 1. DISPLAY_IDENTIFIER LV_PAS_RAMP_ACT_I_IS ECU_ADDRESS 0xd0003dab BIT_MASK 0x1 /end MEASUREMENT
/begin MEASUREMENT lv_tq_isc_i_tq_pste "Logical value for limitation due to PSTE" UBYTE _CNV_S_2_RANGE__0___1_CM 1 100. 0. 1. DISPLAY_IDENTIFIER LV_TQ_ISC_I_TQ_PSTE ECU_ADDRESS 0xd0003dac BIT_MASK 0x1 /end MEASUREMENT
/begin CHARACTERISTIC ip_p_d_dt_is_opm_1 "P- and D-component for idle speed controller at closed drive train" MAP 0xa1027148 _REC_MAP_20_u2_u2_u1 2047.96875 _CNV_A_R_LINEAR_____65_CM -1024. 1023.96875 DISPLAY_IDENTIFIER IP_P_D_DT_IS_OPM_1 FORMAT "%6.2"
 /begin AXIS_DESCR COM_AXIS n_dif_cor _CNV_A_R_LINEAR_____172_CM 12 -32768. 32767. FORMAT "%6.0" AXIS_PTS_REF ldpm_n_dif_cor_p_d_dt_is_opm_1 /end AXIS_DESCR
 /begin AXIS_DESCR COM_AXIS n_grd _CNV_A_R_LINEAR_____28_CM 8 -4096. 4064. FORMAT "%5.0" AXIS_PTS_REF ldpm_n_grd_p_d_dt_is_opm_1 /end AXIS_DESCR
/end CHARACTERISTIC
/begin CHARACTERISTIC ip_p_d_dt_is_opm_2 "P- and D-component for idle speed controller at closed drive train" MAP 0xa1027208 _REC_MAP_20_u2_u2_u1 2047.96875 _CNV_A_R_LINEAR_____65_CM -1024. 1023.96875 DISPLAY_IDENTIFIER IP_P_D_DT_IS_OPM_2 FORMAT "%6.2"
 /begin AXIS_DESCR COM_AXIS n_dif_cor _CNV_A_R_LINEAR_____172_CM 10 -32768. 32767. FORMAT "%6.0" AXIS_PTS_REF ldpm_n_dif_cor_p_d_dt_is_opm_2 /end AXIS_DESCR
 /begin AXIS_DESCR COM_AXIS n_grd _CNV_A_R_LINEAR_____28_CM 8 -4096. 4064. FORMAT "%5.0" AXIS_PTS_REF ldpm_n_grd_p_d_dt_is_opm_2 /end AXIS_DESCR
/end CHARACTERISTIC
/begin CHARACTERISTIC ip_p_d_dt_is_slow_opm_1 "P- and D-component for idle speed controller at closed drive train" MAP 0xa10272a8 _REC_MAP_20_u2_u2_u1 2047.96875 _CNV_A_R_LINEAR_____65_CM -1024. 1023.96875 DISPLAY_IDENTIFIER IP_P_D_DT_IS_SLOW_OPM_1 FORMAT "%6.2"
 /begin AXIS_DESCR COM_AXIS n_dif_cor _CNV_A_R_LINEAR_____172_CM 12 -32768. 32767. FORMAT "%6.0" AXIS_PTS_REF ldpm_n_dif_cor_p_d_dt_is_opm_1 /end AXIS_DESCR
 /begin AXIS_DESCR COM_AXIS n_grd _CNV_A_R_LINEAR_____28_CM 8 -4096. 4064. FORMAT "%5.0" AXIS_PTS_REF ldpm_n_grd_p_d_dt_is_opm_1 /end AXIS_DESCR
/end CHARACTERISTIC
/begin CHARACTERISTIC ip_p_d_dt_is_slow_opm_2 "P- and D-component for idle speed controller at closed drive train" MAP 0xa1027368 _REC_MAP_20_u2_u2_u1 2047.96875 _CNV_A_R_LINEAR_____65_CM -1024. 1023.96875 DISPLAY_IDENTIFIER IP_P_D_DT_IS_SLOW_OPM_2 FORMAT "%6.2"
 /begin AXIS_DESCR COM_AXIS n_dif_cor _CNV_A_R_LINEAR_____172_CM 10 -32768. 32767. FORMAT "%6.0" AXIS_PTS_REF ldpm_n_dif_cor_p_d_dt_is_opm_2 /end AXIS_DESCR
 /begin AXIS_DESCR COM_AXIS n_grd _CNV_A_R_LINEAR_____28_CM 8 -4096. 4064. FORMAT "%5.0" AXIS_PTS_REF ldpm_n_grd_p_d_dt_is_opm_2 /end AXIS_DESCR
/end CHARACTERISTIC
/begin CHARACTERISTIC ip_p_d_is_opm_1 "P- and D-component for idle speed controller at open drive train" MAP 0xa1027408 _REC_MAP_20_u2_u2_u1 2047.96875 _CNV_A_R_LINEAR_____65_CM -1024. 1023.96875 DISPLAY_IDENTIFIER IP_P_D_IS_OPM_1 FORMAT "%6.2"
 /begin AXIS_DESCR COM_AXIS n_dif_cor _CNV_A_R_LINEAR_____172_CM 12 -32768. 32767. FORMAT "%6.0" AXIS_PTS_REF ldpm_n_dif_cor_p_d_is_opm_1 /end AXIS_DESCR
 /begin AXIS_DESCR COM_AXIS n_grd _CNV_A_R_LINEAR_____28_CM 8 -4096. 4064. FORMAT "%5.0" AXIS_PTS_REF ldpm_n_grd_p_d_is_opm_1 /end AXIS_DESCR
/end CHARACTERISTIC
/begin CHARACTERISTIC ip_p_d_is_opm_2 "P- and D-component for idle speed controller at open drive train" MAP 0xa10274c8 _REC_MAP_20_u2_u2_u1 2047.96875 _CNV_A_R_LINEAR_____65_CM -1024. 1023.96875 DISPLAY_IDENTIFIER IP_P_D_IS_OPM_2 FORMAT "%6.2"
 /begin AXIS_DESCR COM_AXIS n_dif_cor _CNV_A_R_LINEAR_____172_CM 10 -32768. 32767. FORMAT "%6.0" AXIS_PTS_REF ldpm_n_dif_cor_p_d_is_opm_2 /end AXIS_DESCR
 /begin AXIS_DESCR COM_AXIS n_grd _CNV_A_R_LINEAR_____28_CM 8 -4096. 4064. FORMAT "%5.0" AXIS_PTS_REF ldpm_n_grd_p_d_is_opm_2 /end AXIS_DESCR
/end CHARACTERISTIC
/begin CHARACTERISTIC ip_p_d_is_slow_opm_1 "P- and D-component for idle speed controller at open drive train" MAP 0xa1027568 _REC_MAP_20_u2_u2_u1 2047.96875 _CNV_A_R_LINEAR_____65_CM -1024. 1023.96875 DISPLAY_IDENTIFIER IP_P_D_IS_SLOW_OPM_1 FORMAT "%6.2"
 /begin AXIS_DESCR COM_AXIS n_dif_cor _CNV_A_R_LINEAR_____172_CM 12 -32768. 32767. FORMAT "%6.0" AXIS_PTS_REF ldpm_n_dif_cor_p_d_is_opm_1 /end AXIS_DESCR
 /begin AXIS_DESCR COM_AXIS n_grd _CNV_A_R_LINEAR_____28_CM 8 -4096. 4064. FORMAT "%5.0" AXIS_PTS_REF ldpm_n_grd_p_d_is_opm_1 /end AXIS_DESCR
/end CHARACTERISTIC
/begin CHARACTERISTIC ip_p_d_is_slow_opm_2 "P- and D-component for idle speed controller at open drive train" MAP 0xa1027628 _REC_MAP_20_u2_u2_u1 2047.96875 _CNV_A_R_LINEAR_____65_CM -1024. 1023.96875 DISPLAY_IDENTIFIER IP_P_D_IS_SLOW_OPM_2 FORMAT "%6.2"
 /begin AXIS_DESCR COM_AXIS n_dif_cor _CNV_A_R_LINEAR_____172_CM 10 -32768. 32767. FORMAT "%6.0" AXIS_PTS_REF ldpm_n_dif_cor_p_d_is_opm_2 /end AXIS_DESCR
 /begin AXIS_DESCR COM_AXIS n_grd _CNV_A_R_LINEAR_____28_CM 8 -4096. 4064. FORMAT "%5.0" AXIS_PTS_REF ldpm_n_grd_p_d_is_opm_2 /end AXIS_DESCR
/end CHARACTERISTIC
/begin CHARACTERISTIC ip_tq_i_is_opm_1 "I-component for idle speed controller at open drive train" MAP 0xa10287f0 _REC_MAP_20_u2_u2_u1 7.99987793 _CNV_A_R_LINEAR_____179_CM -4. 3.99987793 DISPLAY_IDENTIFIER IP_TQ_I_IS_OPM_1 FORMAT "%5.4"
 /begin AXIS_DESCR COM_AXIS n_dif_cor _CNV_A_R_LINEAR_____172_CM 12 -32768. 32767. FORMAT "%6.0" AXIS_PTS_REF ldpm_n_dif_cor_tq_i_is_1_opm_1 /end AXIS_DESCR
 /begin AXIS_DESCR COM_AXIS n_grd _CNV_A_R_LINEAR_____28_CM 8 -4096. 4064. FORMAT "%5.0" AXIS_PTS_REF ldpm_n_grd_tq_i_is_1_opm_1 /end AXIS_DESCR
/end CHARACTERISTIC
/begin CHARACTERISTIC ip_tq_i_is_opm_2 "I-component for idle speed controller at open drive train" MAP 0xa10288b0 _REC_MAP_20_u2_u2_u1 7.99987793 _CNV_A_R_LINEAR_____179_CM -4. 3.99987793 DISPLAY_IDENTIFIER IP_TQ_I_IS_OPM_2 FORMAT "%5.4"
 /begin AXIS_DESCR COM_AXIS n_dif_cor _CNV_A_R_LINEAR_____172_CM 12 -32768. 32767. FORMAT "%6.0" AXIS_PTS_REF ldpm_n_dif_cor_tq_i_is_1_opm_2 /end AXIS_DESCR
 /begin AXIS_DESCR COM_AXIS n_grd _CNV_A_R_LINEAR_____28_CM 8 -4096. 4064. FORMAT "%5.0" AXIS_PTS_REF ldpm_n_grd_tq_i_is_1_opm_2 /end AXIS_DESCR
/end CHARACTERISTIC
/begin CHARACTERISTIC ip_tq_i_dt_is_opm_1 "I-component for idle speed controller at closed drive train" CURVE 0xa10287c0 _REC_CUR_20_u2_u2 7.99987793 _CNV_A_R_LINEAR_____179_CM -4. 3.99987793 DISPLAY_IDENTIFIER IP_TQ_I_DT_IS_OPM_1 FORMAT "%6.5"
 /begin AXIS_DESCR COM_AXIS n_dif_cor _CNV_A_R_LINEAR_____172_CM 12 -32768. 32767. FORMAT "%6.0" AXIS_PTS_REF ldpm_n_dif_cor_tq_i_dt_is_opm_1 /end AXIS_DESCR
/end CHARACTERISTIC
/begin CHARACTERISTIC ip_tq_i_dt_is_opm_2 "I-component for idle speed controller at closed drive train" CURVE 0xa10287d8 _REC_CUR_20_u2_u2 7.99987793 _CNV_A_R_LINEAR_____179_CM -4. 3.99987793 DISPLAY_IDENTIFIER IP_TQ_I_DT_IS_OPM_2 FORMAT "%6.5"
 /begin AXIS_DESCR COM_AXIS n_dif_cor _CNV_A_R_LINEAR_____172_CM 12 -32768. 32767. FORMAT "%6.0" AXIS_PTS_REF ldpm_n_dif_cor_tq_i_dt_is_opm_2 /end AXIS_DESCR
/end CHARACTERISTIC
/begin CHARACTERISTIC ip_tq_pas_i_acc_is_opm_1 "I-component for idle speed controller at transition out of Passive with air condition" MAP 0xa1028cd0 _REC_MAP_20_u2_u2_u1 2047.96875 _CNV_A_R_LINEAR_____65_CM -1024. 1023.96875 DISPLAY_IDENTIFIER IP_TQ_PAS_I_ACC_IS_OPM_1 FORMAT "%6.2"
 /begin AXIS_DESCR COM_AXIS n_dif_cor _CNV_A_R_LINEAR_____172_CM 4 -32768. 32767. FORMAT "%6.0" AXIS_PTS_REF ldpm_n_dif_cor_tq_i_is_opm_1 /end AXIS_DESCR
 /begin AXIS_DESCR COM_AXIS n_grd _CNV_A_R_LINEAR_____180_CM 4 -4096. 4064. FORMAT "%5.0" AXIS_PTS_REF ldpm_n_grd_tq_i_is_opm_1 /end AXIS_DESCR
/end CHARACTERISTIC
/begin CHARACTERISTIC ip_tq_pas_i_acc_is_opm_2 "I-component for idle speed controller at transition out of Passive with air condition" MAP 0xa1028cf0 _REC_MAP_20_u2_u2_u1 2047.96875 _CNV_A_R_LINEAR_____65_CM -1024. 1023.96875 DISPLAY_IDENTIFIER IP_TQ_PAS_I_ACC_IS_OPM_2 FORMAT "%6.2"
 /begin AXIS_DESCR COM_AXIS n_dif_cor _CNV_A_R_LINEAR_____172_CM 4 -32768. 32767. FORMAT "%6.0" AXIS_PTS_REF ldpm_n_dif_cor_tq_i_is_opm_2 /end AXIS_DESCR
 /begin AXIS_DESCR COM_AXIS n_grd _CNV_A_R_LINEAR_____180_CM 4 -4096. 4064. FORMAT "%5.0" AXIS_PTS_REF ldpm_n_grd_tq_i_is_opm_2 /end AXIS_DESCR
/end CHARACTERISTIC
/begin CHARACTERISTIC ip_tq_pas_i_is_opm_1 "I-component for idle speed controller at transition out of Passive with air condition" MAP 0xa1028d10 _REC_MAP_20_u2_u2_u1 2047.96875 _CNV_A_R_LINEAR_____65_CM -1024. 1023.96875 DISPLAY_IDENTIFIER IP_TQ_PAS_I_IS_OPM_1 FORMAT "%6.2"
 /begin AXIS_DESCR COM_AXIS n_dif_cor _CNV_A_R_LINEAR_____172_CM 4 -32768. 32767. FORMAT "%6.0" AXIS_PTS_REF ldpm_n_dif_cor_tq_i_is_opm_1 /end AXIS_DESCR
 /begin AXIS_DESCR COM_AXIS n_grd _CNV_A_R_LINEAR_____180_CM 4 -4096. 4064. FORMAT "%5.0" AXIS_PTS_REF ldpm_n_grd_tq_i_is_opm_1 /end AXIS_DESCR
/end CHARACTERISTIC
/begin CHARACTERISTIC ip_tq_pas_i_is_opm_2 "I-component for idle speed controller at transition out of Passive with air condition" MAP 0xa1028d30 _REC_MAP_20_u2_u2_u1 2047.96875 _CNV_A_R_LINEAR_____65_CM -1024. 1023.96875 DISPLAY_IDENTIFIER IP_TQ_PAS_I_IS_OPM_2 FORMAT "%6.2"
 /begin AXIS_DESCR COM_AXIS n_dif_cor _CNV_A_R_LINEAR_____172_CM 4 -32768. 32767. FORMAT "%6.0" AXIS_PTS_REF ldpm_n_dif_cor_tq_i_is_opm_2 /end AXIS_DESCR
 /begin AXIS_DESCR COM_AXIS n_grd _CNV_A_R_LINEAR_____180_CM 4 -4096. 4064. FORMAT "%5.0" AXIS_PTS_REF ldpm_n_grd_tq_i_is_opm_2 /end AXIS_DESCR
/end CHARACTERISTIC
/begin MEASUREMENT tq_dif_p_d_slow_is "TQ_DIF_P_D_IS for slow-path of torque coordination" SWORD _CNV_A_R_LINEAR_____30_CM 1 100. -1024. 1023.96875 DISPLAY_IDENTIFIER TQ_DIF_P_D_SLOW_IS ECU_ADDRESS 0xd0005202 FORMAT "%6.2" /end MEASUREMENT
/begin MEASUREMENT tq_dif_p_d_dt_is_opm_1 "PD-part at drive train into fast path (mode1)" SWORD _CNV_A_R_LINEAR_____30_CM 1 100. -1024. 1023.96875 DISPLAY_IDENTIFIER TQ_DIF_P_D_DT_IS_OPM_1 ECU_ADDRESS 0xc00007ae FORMAT "%6.2" /end MEASUREMENT
/begin MEASUREMENT tq_dif_p_d_dt_is_opm_2 "PD-part at drive train into fast path (mode2)" SWORD _CNV_A_R_LINEAR_____30_CM 1 100. -1024. 1023.96875 DISPLAY_IDENTIFIER TQ_DIF_P_D_DT_IS_OPM_2 ECU_ADDRESS 0xc00007b0 FORMAT "%6.2" /end MEASUREMENT
/begin MEASUREMENT tq_dif_p_d_dt_is_sel "Resulting PD-part at drive train into fast path" SWORD _CNV_A_R_LINEAR_____30_CM 1 100. -1024. 1023.96875 DISPLAY_IDENTIFIER TQ_DIF_P_D_DT_IS_SEL ECU_ADDRESS 0xc00007b2 FORMAT "%6.2" /end MEASUREMENT
/begin MEASUREMENT tq_dif_p_d_dt_is_slow_opm_1 "PD-part at drive train into slow path (mode1)" SWORD _CNV_A_R_LINEAR_____30_CM 1 100. -1024. 1023.96875 DISPLAY_IDENTIFIER TQ_DIF_P_D_DT_IS_SLOW_OPM_1 ECU_ADDRESS 0xc00007b4 FORMAT "%6.2" /end MEASUREMENT
/begin MEASUREMENT tq_dif_p_d_dt_is_slow_opm_2 "PD-part at drive train into slow path (mode2)" SWORD _CNV_A_R_LINEAR_____30_CM 1 100. -1024. 1023.96875 DISPLAY_IDENTIFIER TQ_DIF_P_D_DT_IS_SLOW_OPM_2 ECU_ADDRESS 0xc00007b6 FORMAT "%6.2" /end MEASUREMENT
/begin MEASUREMENT tq_dif_p_d_dt_is_slow_sel "Resulting PD-part at drive train into slow path " SWORD _CNV_A_R_LINEAR_____30_CM 1 100. -1024. 1023.96875 DISPLAY_IDENTIFIER TQ_DIF_P_D_DT_IS_SLOW_SEL ECU_ADDRESS 0xc00007b8 FORMAT "%6.2" /end MEASUREMENT
/begin MEASUREMENT tq_dif_p_d_is_slow_opm_1 "PD-part before separation into fast/slow path" SWORD _CNV_A_R_LINEAR_____30_CM 1 100. -1024. 1023.96875 DISPLAY_IDENTIFIER TQ_DIF_P_D_IS_SLOW_OPM_1 ECU_ADDRESS 0xc00007ba FORMAT "%6.2" /end MEASUREMENT
/begin MEASUREMENT tq_dif_p_d_is_slow_sel "Resulting PD-part before separation into fast/slow path" SWORD _CNV_A_R_LINEAR_____30_CM 1 100. -1024. 1023.96875 DISPLAY_IDENTIFIER TQ_DIF_P_D_IS_SLOW_SEL ECU_ADDRESS 0xc00007be FORMAT "%6.2" /end MEASUREMENT
/begin MEASUREMENT tq_dif_p_d_is_slow_opm_2 "PD-part before separation into fast/slow path" SWORD _CNV_A_R_LINEAR_____30_CM 1 100. -1024. 1023.96875 DISPLAY_IDENTIFIER TQ_DIF_P_D_IS_SLOW_OPM_2 ECU_ADDRESS 0xc00007bc FORMAT "%6.2" /end MEASUREMENT
/begin MEASUREMENT tq_dif_p_d_is_opm_1 "PD-part before separation into fast/slow path" SWORD _CNV_A_R_LINEAR_____30_CM 1 100. -1024. 1023.96875 DISPLAY_IDENTIFIER TQ_DIF_P_D_IS_OPM_1 ECU_ADDRESS 0xc00007c0 FORMAT "%6.2" /end MEASUREMENT
/begin MEASUREMENT tq_dif_p_d_is_opm_2 "PD-part before separation into fast/slow path" SWORD _CNV_A_R_LINEAR_____30_CM 1 100. -1024. 1023.96875 DISPLAY_IDENTIFIER TQ_DIF_P_D_IS_OPM_2 ECU_ADDRESS 0xc00007c2 FORMAT "%6.2" /end MEASUREMENT
/begin MEASUREMENT tq_dif_p_d_is_sel "Resulting PD-part before separation into fast/slow path" SWORD _CNV_A_R_LINEAR_____30_CM 1 100. -1024. 1023.96875 DISPLAY_IDENTIFIER TQ_DIF_P_D_IS_SEL ECU_ADDRESS 0xc00007c4 FORMAT "%6.2" /end MEASUREMENT
/begin MEASUREMENT tq_i_is_opm_2 "I-part at normal out of calculation (mode2)" SWORD _CNV_A_R_LINEAR_____175_CM 1 100. -4. 3.99987793 DISPLAY_IDENTIFIER TQ_I_IS_OPM_2 ECU_ADDRESS 0xc00007c8 FORMAT "%6.2" /end MEASUREMENT
/begin MEASUREMENT tq_i_is_opm_1 "I-part at normal out of calculation (mode2)" SWORD _CNV_A_R_LINEAR_____175_CM 1 100. -4. 3.99987793 DISPLAY_IDENTIFIER TQ_I_IS_OPM_1 ECU_ADDRESS 0xc00007c6 FORMAT "%6.2" /end MEASUREMENT
/begin MEASUREMENT tq_i_is_sel "Resulting I-part at normal out of calculation" SWORD _CNV_A_R_LINEAR_____175_CM 1 100. -4. 3.99987793 DISPLAY_IDENTIFIER TQ_I_IS_SEL ECU_ADDRESS 0xc00007ca FORMAT "%6.2" /end MEASUREMENT
/begin MEASUREMENT tq_pas_i_is_opm_1 "I-component for idle speed controller at transition out of Passive with (mode1)" SWORD _CNV_A_R_LINEAR_____30_CM 1 100. -1024. 1023.96875 DISPLAY_IDENTIFIER TQ_PAS_I_IS_OPM_1 ECU_ADDRESS 0xc00007cc FORMAT "%6.2" /end MEASUREMENT
/begin MEASUREMENT tq_pas_i_is_opm_2 "I-component for idle speed controller at transition out of Passive with (mode2)" SWORD _CNV_A_R_LINEAR_____30_CM 1 100. -1024. 1023.96875 DISPLAY_IDENTIFIER TQ_PAS_I_IS_OPM_2 ECU_ADDRESS 0xc00007ce FORMAT "%6.2" /end MEASUREMENT
/begin MEASUREMENT tq_pas_i_is_sel "Resulting I-component for idle speed controller at transition out of Passive with" SWORD _CNV_A_R_LINEAR_____30_CM 1 100. -1024. 1023.96875 DISPLAY_IDENTIFIER TQ_PAS_I_IS_SEL ECU_ADDRESS 0xc00007d0 FORMAT "%6.2" /end MEASUREMENT
/begin MEASUREMENT tq_pas_i_acc_is_opm_1 "I-component for idle speed controller at transition out of Passive with air condition (mode1)" SWORD _CNV_A_R_LINEAR_____30_CM 1 100. -1024. 1023.96875 DISPLAY_IDENTIFIER TQ_PAS_I_ACC_IS_OPM_1 ECU_ADDRESS 0xc00007d2 FORMAT "%6.2" /end MEASUREMENT
/begin MEASUREMENT tq_pas_i_acc_is_opm_2 "I-component for idle speed controller at transition out of Passive with air condition (mode1)" SWORD _CNV_A_R_LINEAR_____30_CM 1 100. -1024. 1023.96875 DISPLAY_IDENTIFIER TQ_PAS_I_ACC_IS_OPM_2 ECU_ADDRESS 0xc00007d4 FORMAT "%6.2" /end MEASUREMENT
/begin MEASUREMENT tq_pas_i_acc_is_sel "Resulting I-component for idle speed controller at transition out of Passive with air condition" SWORD _CNV_A_R_LINEAR_____30_CM 1 100. -1024. 1023.96875 DISPLAY_IDENTIFIER TQ_PAS_I_ACC_IS_SEL ECU_ADDRESS 0xc00007d6 FORMAT "%6.2" /end MEASUREMENT
/begin MEASUREMENT tq_i_dt_is_opm_2 "I-part at closed drive train out of calculation (mode2)" SWORD _CNV_A_R_LINEAR_____175_CM 1 100. -4. 3.99987793 DISPLAY_IDENTIFIER TQ_I_DT_IS_OPM_2 ECU_ADDRESS 0xc00007da FORMAT "%6.2" /end MEASUREMENT
/begin MEASUREMENT tq_i_dt_is_opm_1 "I-part at closed drive train out of calculation (mode1)" SWORD _CNV_A_R_LINEAR_____175_CM 1 100. -4. 3.99987793 DISPLAY_IDENTIFIER TQ_I_DT_IS_OPM_1 ECU_ADDRESS 0xc00007d8 FORMAT "%6.2" /end MEASUREMENT
/begin MEASUREMENT tq_i_dt_is_sel "Resulting I-part at closed drive train out of calculation" SWORD _CNV_A_R_LINEAR_____175_CM 1 100. -4. 3.99987793 DISPLAY_IDENTIFIER TQ_I_DT_IS_SEL ECU_ADDRESS 0xc00007dc FORMAT "%6.2" /end MEASUREMENT
/begin MEASUREMENT lv_tq_dif_is_opm_sel_1 "Logical value for PD-part passive ramp active" UBYTE _CNV_S_2_RANGE__0___1_CM 1 100. 0. 1. DISPLAY_IDENTIFIER LV_TQ_DIF_IS_OPM_SEL_1 ECU_ADDRESS 0xc00007f9 BIT_MASK 0x1 /end MEASUREMENT
/begin MEASUREMENT lv_tq_dif_is_opm_sel_2 "Logical value for PD-part passive ramp active" UBYTE _CNV_S_2_RANGE__0___1_CM 1 100. 0. 1. DISPLAY_IDENTIFIER LV_TQ_DIF_IS_OPM_SEL_2 ECU_ADDRESS 0xc00007fa BIT_MASK 0x1 /end MEASUREMENT
/begin MEASUREMENT lv_tq_dif_is_opm_rls "Logical value for PD-part passive ramp active" UBYTE _CNV_S_2_RANGE__0___1_CM 1 100. 0. 1. DISPLAY_IDENTIFIER LV_TQ_DIF_IS_OPM_RLS ECU_ADDRESS 0xc00007fb BIT_MASK 0x1 /end MEASUREMENT
/begin AXIS_PTS ldpm_n_dif_cor_p_d_dt_is_opm_1 "" 0xa1021ea8 n_dif_cor _REC_AXS_20_u2 65535. _CNV_A_R_LINEAR_____172_CM 12 -32768. 32767. FORMAT "%6.0" /end AXIS_PTS
/begin AXIS_PTS ldpm_n_dif_cor_p_d_dt_is_opm_2 "" 0xa1021ec4 n_dif_cor _REC_AXS_20_u2 65535. _CNV_A_R_LINEAR_____172_CM 10 -32768. 32767. FORMAT "%6.0" /end AXIS_PTS
/begin AXIS_PTS ldpm_n_grd_p_d_dt_is_opm_1 "" 0xa1022038 n_grd _REC_AXS_20_u1 8160. _CNV_A_R_LINEAR_____28_CM 8 -4096. 4064. FORMAT "%5.0" /end AXIS_PTS
/begin AXIS_PTS ldpm_n_grd_p_d_dt_is_opm_2 "" 0xa1022044 n_grd _REC_AXS_20_u1 8160. _CNV_A_R_LINEAR_____28_CM 8 -4096. 4064. FORMAT "%5.0" /end AXIS_PTS
/begin AXIS_PTS ldpm_n_dif_cor_p_d_is_opm_1 "" 0xa1021edc n_dif_cor _REC_AXS_20_u2 65535. _CNV_A_R_LINEAR_____172_CM 12 -32768. 32767. FORMAT "%6.0" /end AXIS_PTS
/begin AXIS_PTS ldpm_n_dif_cor_p_d_is_opm_2 "" 0xa1021ef8 n_dif_cor _REC_AXS_20_u2 65535. _CNV_A_R_LINEAR_____172_CM 10 -32768. 32767. FORMAT "%6.0" /end AXIS_PTS
/begin AXIS_PTS ldpm_n_grd_p_d_is_opm_1 "" 0xa1022050 n_grd _REC_AXS_20_u1 8160. _CNV_A_R_LINEAR_____28_CM 8 -4096. 4064. FORMAT "%5.0" /end AXIS_PTS
/begin AXIS_PTS ldpm_n_grd_p_d_is_opm_2 "" 0xa102205c n_grd _REC_AXS_20_u1 8160. _CNV_A_R_LINEAR_____28_CM 8 -4096. 4064. FORMAT "%5.0" /end AXIS_PTS
/begin AXIS_PTS ldpm_n_dif_cor_tq_i_is_1_opm_1 "" 0xa1021f48 n_dif_cor _REC_AXS_20_u2 65535. _CNV_A_R_LINEAR_____172_CM 12 -32768. 32767. FORMAT "%6.0" /end AXIS_PTS
/begin AXIS_PTS ldpm_n_dif_cor_tq_i_is_1_opm_2 "" 0xa1021f64 n_dif_cor _REC_AXS_20_u2 65535. _CNV_A_R_LINEAR_____172_CM 12 -32768. 32767. FORMAT "%6.0" /end AXIS_PTS
/begin AXIS_PTS ldpm_n_grd_tq_i_is_1_opm_1 "" 0xa1022068 n_grd _REC_AXS_20_u1 8160. _CNV_A_R_LINEAR_____28_CM 8 -4096. 4064. FORMAT "%5.0" /end AXIS_PTS
/begin AXIS_PTS ldpm_n_grd_tq_i_is_1_opm_2 "" 0xa1022074 n_grd _REC_AXS_20_u1 8160. _CNV_A_R_LINEAR_____28_CM 8 -4096. 4064. FORMAT "%5.0" /end AXIS_PTS
/begin AXIS_PTS ldpm_n_dif_cor_tq_i_dt_is_opm_1 "" 0xa1021f10 n_dif_cor _REC_AXS_20_u2 65535. _CNV_A_R_LINEAR_____172_CM 12 -32768. 32767. FORMAT "%6.0" /end AXIS_PTS
/begin AXIS_PTS ldpm_n_dif_cor_tq_i_dt_is_opm_2 "" 0xa1021f2c n_dif_cor _REC_AXS_20_u2 65535. _CNV_A_R_LINEAR_____172_CM 12 -32768. 32767. FORMAT "%6.0" /end AXIS_PTS
/begin AXIS_PTS ldpm_n_dif_cor_tq_i_is_opm_1 "" 0xa1021f80 n_dif_cor _REC_AXS_20_u2 65535. _CNV_A_R_LINEAR_____172_CM 4 -32768. 32767. FORMAT "%6.0" /end AXIS_PTS
/begin AXIS_PTS ldpm_n_dif_cor_tq_i_is_opm_2 "" 0xa1021f8c n_dif_cor _REC_AXS_20_u2 65535. _CNV_A_R_LINEAR_____172_CM 4 -32768. 32767. FORMAT "%6.0" /end AXIS_PTS
/begin AXIS_PTS ldpm_n_grd_tq_i_is_opm_1 "" 0xa102207e n_grd _REC_AXS_20_u1 8160. _CNV_A_R_LINEAR_____180_CM 4 -4096. 4064. FORMAT "%5.0" /end AXIS_PTS
/begin AXIS_PTS ldpm_n_grd_tq_i_is_opm_2 "" 0xa1022084 n_grd _REC_AXS_20_u1 8160. _CNV_A_R_LINEAR_____180_CM 4 -4096. 4064. FORMAT "%5.0" /end AXIS_PTS
/begin CHARACTERISTIC ip_fac_p_d_fast_is "TCO and TQ_ADD_CH depending factor for fast-path of torque coordination" MAP 0xa1023bc0 _REC_MAP_20_u2_u1_u2 1.99996948242188 _CNV_A_R_LINEAR_____8_CM 0. 1.99996948242188 DISPLAY_IDENTIFIER IP_FAC_P_D_FAST_IS FORMAT "%7.5"
 /begin AXIS_DESCR COM_AXIS tco _CNV_A_R_LINEAR_____16_CM 8 -48. 142.5 FORMAT "%5.1" AXIS_PTS_REF ldpm_tco_is_1 /end AXIS_DESCR
 /begin AXIS_DESCR COM_AXIS tq_add_ch _CNV_A_R_LINEAR_____65_CM 6 -1024. 1023.96875 FORMAT "%11.5" AXIS_PTS_REF ldpm_tq_add_ch_is_1 /end AXIS_DESCR
/end CHARACTERISTIC
/begin CHARACTERISTIC ip_fac_p_d_slow_is "TCO and TQ_ADD_CH depending factor for slow-path of torque coordination" MAP 0xa1023c20 _REC_MAP_20_u2_u1_u2 1.99996948242188 _CNV_A_R_LINEAR_____8_CM 0. 1.99996948242188 DISPLAY_IDENTIFIER IP_FAC_P_D_SLOW_IS FORMAT "%7.5"
 /begin AXIS_DESCR COM_AXIS tco _CNV_A_R_LINEAR_____16_CM 8 -48. 142.5 FORMAT "%5.1" AXIS_PTS_REF ldpm_tco_is_1 /end AXIS_DESCR
 /begin AXIS_DESCR COM_AXIS tq_add_ch _CNV_A_R_LINEAR_____65_CM 6 -1024. 1023.96875 FORMAT "%11.5" AXIS_PTS_REF ldpm_tq_add_ch_is_1 /end AXIS_DESCR
/end CHARACTERISTIC
/begin AXIS_PTS ldpm_tq_add_ch_is_1 "" 0xa102236c tq_add_ch _REC_AXS_20_u2 2047.96875 _CNV_A_R_LINEAR_____65_CM 6 -1024. 1023.96875 FORMAT "%11.5" /end AXIS_PTS
/begin AXIS_PTS ldp_tco__fac_n_grd_is_thr "" 0xa102126a tco _REC_AXS_20_u1 190.5 _CNV_A_R_LINEAR_____16_CM 4 -48. 142.5 FORMAT "%6.2" /end AXIS_PTS
/begin AXIS_PTS ldp_t_ast__fac_n_grd_is_thr "" 0xa10211a4 t_ast _REC_AXS_20_u2 6553.5 _CNV_A_R_LINEAR_____4_CM 6 0. 6553.5 FORMAT "%5.1" /end AXIS_PTS
/begin CHARACTERISTIC ip_fac_t_ast_i_is_opm_2 "TQ_ADD_I_IS correction after start in operation mode 2" MAP 0xa1023fec _REC_MAP_20_u2_u1_u2 0.999755 _CNV_A_R_LINEAR_____178_CM 0. 0.999755 DISPLAY_IDENTIFIER IP_FAC_T_AST_I_IS_OPM_2 FORMAT "%7.5"
 /begin AXIS_DESCR COM_AXIS tco _CNV_A_R_LINEAR_____16_CM 4 -48. 142.5 FORMAT "%6.2" AXIS_PTS_REF ldp_tco__fac_n_grd_is_thr /end AXIS_DESCR
 /begin AXIS_DESCR COM_AXIS t_ast _CNV_A_R_LINEAR_____4_CM 6 0. 6553.5 FORMAT "%5.1" AXIS_PTS_REF ldp_t_ast__fac_n_grd_is_thr /end AXIS_DESCR
/end CHARACTERISTIC
/begin CHARACTERISTIC c_tq_tol_i_dt_is_opm_1 "Top limit for I-controller output and drive train closed in operation mode 1" VALUE 0xa1029b2e _REC_VAL_20_s2 2047.96875 _CNV_A_R_LINEAR_____30_CM -1024. 1023.96875 DISPLAY_IDENTIFIER C_TQ_TOL_I_DT_IS_OPM_1 FORMAT "%7.1" /end CHARACTERISTIC
/begin CHARACTERISTIC c_tq_tol_i_dt_is_opm_2 "Top limit for I-controller output and drive train closed in operation mode 2" VALUE 0xa1029b30 _REC_VAL_20_s2 2047.96875 _CNV_A_R_LINEAR_____30_CM -1024. 1023.96875 DISPLAY_IDENTIFIER C_TQ_TOL_I_DT_IS_OPM_2 FORMAT "%7.1" /end CHARACTERISTIC
/begin MEASUREMENT lv_req_isc "Logical variable for idle speed controller activatIon request" UBYTE _CNV_S_2_RANGE__0___1_CM 1 100. 0. 1. DISPLAY_IDENTIFIER LV_REQ_ISC ECU_ADDRESS 0xd0003db0 BIT_MASK 0x1 /end MEASUREMENT
/begin MEASUREMENT state_req_isc "actual state for ISC request" UBYTE _CNV_S_5_STATE_REQ__182_CM 1 100. 0. 4. DISPLAY_IDENTIFIER STATE_REQ_ISC ECU_ADDRESS 0xc000080c /end MEASUREMENT
/begin MEASUREMENT lv_neg_n_grd_fil_mem "Memory bit for falling gradient after start" UBYTE _CNV_S_2_RANGE__0___1_CM 1 100. 0. 1. DISPLAY_IDENTIFIER LV_NEG_N_GRD_FIL_MEM ECU_ADDRESS 0xc0000810 BIT_MASK 0x1 /end MEASUREMENT
/begin CHARACTERISTIC lc_isc_act_cdn_swi "Calibratible logical bit for switching between different activation conditions " VALUE 0xa1029d6c _REC_VAL_20_u1 1. _CNV_A_R_LINEAR_____0_CM 0. 1. DISPLAY_IDENTIFIER LC_ISC_ACT_CDN_SWI FORMAT "%2.0" /end CHARACTERISTIC
/begin CHARACTERISTIC lc_isc_act_ast_cdn_swi "Switch for using different after start ISC activation conditions" VALUE 0xa1029d6b _REC_VAL_20_u1 1. _CNV_A_R_LINEAR_____0_CM 0. 1. DISPLAY_IDENTIFIER LC_ISC_ACT_AST_CDN_SWI FORMAT "%2.0" /end CHARACTERISTIC
/begin CHARACTERISTIC c_n_dif_isc_act_ast "Additive term to define the low limit for ISC activation after start" VALUE 0xa10295e6 _REC_VAL_20_s2 65535. _CNV_A_R_LINEAR_____13_CM -32768. 32767. DISPLAY_IDENTIFIER C_N_DIF_ISC_ACT_AST FORMAT "%6.0" /end CHARACTERISTIC
/begin CHARACTERISTIC c_crlc_n_grd_fil_isc_act_ast "Filter correlation factor for speed gradient filtering in connection with after start activation of ISC" VALUE 0xa1029212 _REC_VAL_20_u2 0.9999847412109381 _CNV_A_R_LINEAR_____68_CM 0. 0.9999847412109381 DISPLAY_IDENTIFIER C_CRLC_N_GRD_FIL_ISC_ACT_AST FORMAT "%7.5" /end CHARACTERISTIC
/begin CHARACTERISTIC c_t_dly_isc_act_pu "Time limit for ISC activation in PU" VALUE 0xa1029862 _REC_VAL_20_u2 655.35 _CNV_A_R_LINEAR_____3_CM 0. 655.35 DISPLAY_IDENTIFIER C_T_DLY_ISC_ACT_PU FORMAT "%6.2" /end CHARACTERISTIC
/begin MEASUREMENT n_grd_fil_isc_act_ast "Filtered gradient for ISC after start activation" SBYTE _CNV_A_R_LINEAR_____29_CM 1 100. -4096. 4064. DISPLAY_IDENTIFIER N_GRD_FIL_ISC_ACT_AST ECU_ADDRESS 0xc000080d FORMAT "%5.0" /end MEASUREMENT
/begin MEASUREMENT t_ctr_pu_isc_act "Counter for delay of  LV_REQ_ISC during low engine speed decrease in state LV_PU=1" UWORD _CNV_A_R_LINEAR_____3_CM 1 100. 0. 655.35 DISPLAY_IDENTIFIER T_CTR_PU_ISC_ACT ECU_ADDRESS 0xd000520c FORMAT "%5.2" /end MEASUREMENT
/begin MEASUREMENT tq_add_is_bol "Filtered calculated torque reserve bottom limit at idle" SWORD _CNV_A_R_LINEAR_____30_CM 1 100. -1024. 1023.96875 DISPLAY_IDENTIFIER TQ_ADD_IS_BOL ECU_ADDRESS 0xd0005208 FORMAT "%8.2" /end MEASUREMENT
/begin MEASUREMENT tq_dif_add_is_tol "Idle speed torque reserve limitation for stabilization the ISC at high torque reserves" SWORD _CNV_A_R_LINEAR_____30_CM 1 100. -1024. 1023.96875 DISPLAY_IDENTIFIER TQ_DIF_ADD_IS_TOL ECU_ADDRESS 0xd000520a FORMAT "%8.2" /end MEASUREMENT
/begin CHARACTERISTIC c_tq_add_is_bol_crlc "Filter constant for torque reserve" VALUE 0xa1029ae4 _REC_VAL_20_u1 0.99609375 _CNV_A_R_LINEAR_____27_CM 0. 0.99609375 DISPLAY_IDENTIFIER C_TQ_ADD_IS_BOL_CRLC FORMAT "%5.3" /end CHARACTERISTIC
/begin MEASUREMENT tq_add_is_bol_opm_1 "Torque reserve at idle (mode 1)" SWORD _CNV_A_R_LINEAR_____30_CM 1 100. -1024. 1023.96875 DISPLAY_IDENTIFIER TQ_ADD_IS_BOL_OPM_1 ECU_ADDRESS 0xc0000826 FORMAT "%8.2" /end MEASUREMENT
/begin MEASUREMENT tq_add_is_bol_opm_2 "Torque reserve at idle (mode 2)" SWORD _CNV_A_R_LINEAR_____30_CM 1 100. -1024. 1023.96875 DISPLAY_IDENTIFIER TQ_ADD_IS_BOL_OPM_2 ECU_ADDRESS 0xc0000828 FORMAT "%8.2" /end MEASUREMENT
/begin MEASUREMENT tq_add_is_bol_sel "Calculated torque reserve bottom limit at idle" SWORD _CNV_A_R_LINEAR_____30_CM 1 100. -1024. 1023.96875 DISPLAY_IDENTIFIER TQ_ADD_IS_BOL_SEL ECU_ADDRESS 0xc0000824 FORMAT "%8.2" /end MEASUREMENT
/begin MEASUREMENT lv_tq_add_is_opm_sel_1 "Boolean for operation mode 1" UBYTE _CNV_S_2_RANGE__0___1_CM 1 100. 0. 1. DISPLAY_IDENTIFIER LV_TQ_ADD_IS_OPM_SEL_1 ECU_ADDRESS 0xc0000832 BIT_MASK 0x1 /end MEASUREMENT
/begin MEASUREMENT lv_tq_add_is_opm_sel_2 "Boolean for operation mode 2" UBYTE _CNV_S_2_RANGE__0___1_CM 1 100. 0. 1. DISPLAY_IDENTIFIER LV_TQ_ADD_IS_OPM_SEL_2 ECU_ADDRESS 0xc0000833 BIT_MASK 0x1 /end MEASUREMENT
/begin MEASUREMENT lv_tq_add_is_opm_rls "Boolean for internal error" UBYTE _CNV_S_2_RANGE__0___1_CM 1 100. 0. 1. DISPLAY_IDENTIFIER LV_TQ_ADD_IS_OPM_RLS ECU_ADDRESS 0xc0000834 BIT_MASK 0x1 /end MEASUREMENT
/begin CHARACTERISTIC ip_t_n_dif_ofs_pred_opm_2 "Time constant for calculation of predicted engine speed deviation (mode 2)" CURVE 0xa1027d90 _REC_CUR_20_u1_u2 7.96875 _CNV_A_R_LINEAR_____183_CM 0. 7.96875 DISPLAY_IDENTIFIER IP_T_N_DIF_OFS_PRED_OPM_2 FORMAT "%4.2"
 /begin AXIS_DESCR COM_AXIS n _CNV_A_R_LINEAR_____13_CM 8 0. 8160. FORMAT "%4.0" AXIS_PTS_REF ldpm_n_t_n_dif_ofs_pred /end AXIS_DESCR
/end CHARACTERISTIC
/begin CHARACTERISTIC id_tq_add_is_opm_av "Operation mode matrix (actual)" CURVE 0xa1022fc4 _REC_CUR_20_u1_u1 7. _CNV_A_R_LINEAR_____0_CM 1. 8. DISPLAY_IDENTIFIER ID_TQ_ADD_IS_OPM_AV FORMAT "%1.0"
 /begin AXIS_DESCR COM_AXIS opm_av _CNV_A_R_LINEAR_____0_CM 8 0. 8. FORMAT "%1.0" AXIS_PTS_REF ldpm_opm_av /end AXIS_DESCR
/end CHARACTERISTIC
/begin CHARACTERISTIC id_tq_add_is_opm_req "Operation mode matrix (requested)" CURVE 0xa1022fcc _REC_CUR_20_u1_u1 7. _CNV_A_R_LINEAR_____0_CM 1. 8. DISPLAY_IDENTIFIER ID_TQ_ADD_IS_OPM_REQ FORMAT "%1.0"
 /begin AXIS_DESCR COM_AXIS opm_req _CNV_A_R_LINEAR_____0_CM 8 0. 8. FORMAT "%1.0" AXIS_PTS_REF ldpm_opm_req /end AXIS_DESCR
/end CHARACTERISTIC
/begin MEASUREMENT n_dif_ofs_pred_opm_1 "Predicted engine speed difference for torque reserve calculation (mode 1)" SWORD _CNV_A_R_LINEAR_____13_CM 1 100. -32768. 32767. DISPLAY_IDENTIFIER N_DIF_OFS_PRED_OPM_1 ECU_ADDRESS 0xc000081c FORMAT "%6.0" /end MEASUREMENT
/begin MEASUREMENT n_dif_ofs_pred_cs_opm_1 "Predicted engine speed difference for torque reserve calculation at drive-off-support (mode 1)" SWORD _CNV_A_R_LINEAR_____13_CM 1 100. -32768. 32767. DISPLAY_IDENTIFIER N_DIF_OFS_PRED_CS_OPM_1 ECU_ADDRESS 0xc0000820 FORMAT "%6.0" /end MEASUREMENT
/begin MEASUREMENT n_dif_ofs_pred_opm_2 "Predicted engine speed difference for torque reserve calculation (mode 2)" SWORD _CNV_A_R_LINEAR_____13_CM 1 100. -32768. 32767. DISPLAY_IDENTIFIER N_DIF_OFS_PRED_OPM_2 ECU_ADDRESS 0xc000081e FORMAT "%6.0" /end MEASUREMENT
/begin MEASUREMENT n_dif_ofs_pred_cs_opm_2 "Predicted engine speed difference for torque reserve calculation at drive-off-support (mode 2)" SWORD _CNV_A_R_LINEAR_____13_CM 1 100. -32768. 32767. DISPLAY_IDENTIFIER N_DIF_OFS_PRED_CS_OPM_2 ECU_ADDRESS 0xc0000822 FORMAT "%6.0" /end MEASUREMENT
/begin MEASUREMENT t_n_dif_ofs_pred_opm_1 "Prediction time for engine speed difference (mode 1)" UBYTE _CNV_A_R_LINEAR_____183_CM 1 100. 0. 7.96875 DISPLAY_IDENTIFIER T_N_DIF_OFS_PRED_OPM_1 ECU_ADDRESS 0xc000082c FORMAT "%4.2" /end MEASUREMENT
/begin MEASUREMENT t_n_dif_ofs_pred_opm_2 "Prediction time for engine speed difference (mode 2)" UBYTE _CNV_A_R_LINEAR_____183_CM 1 100. 0. 7.96875 DISPLAY_IDENTIFIER T_N_DIF_OFS_PRED_OPM_2 ECU_ADDRESS 0xc000082d FORMAT "%4.2" /end MEASUREMENT
/begin MEASUREMENT t_n_dif_ofs_pred_cs_opm_2 "Prediction time for engine speed difference at drive-off-support (mode 2)" UBYTE _CNV_A_R_LINEAR_____183_CM 1 100. 0. 7.96875 DISPLAY_IDENTIFIER T_N_DIF_OFS_PRED_CS_OPM_2 ECU_ADDRESS 0xc000082f FORMAT "%4.2" /end MEASUREMENT
/begin MEASUREMENT n_dif_pred_opm_1 "Predicted idle speed control variable (mode 1)" SWORD _CNV_A_R_LINEAR_____13_CM 1 100. -32768. 32767. DISPLAY_IDENTIFIER N_DIF_PRED_OPM_1 ECU_ADDRESS 0xc0000814 FORMAT "%6.0" /end MEASUREMENT
/begin MEASUREMENT n_dif_pred_cs_opm_1 "Predicted idle speed control variable at drive-off-support (mode 2)" SWORD _CNV_A_R_LINEAR_____13_CM 1 100. -32768. 32767. DISPLAY_IDENTIFIER N_DIF_PRED_CS_OPM_1 ECU_ADDRESS 0xc0000818 FORMAT "%6.0" /end MEASUREMENT
/begin MEASUREMENT n_dif_pred_opm_2 "Predicted idle speed control variable (mode 2)" SWORD _CNV_A_R_LINEAR_____13_CM 1 100. -32768. 32767. DISPLAY_IDENTIFIER N_DIF_PRED_OPM_2 ECU_ADDRESS 0xc0000816 FORMAT "%6.0" /end MEASUREMENT
/begin MEASUREMENT n_dif_pred_cs_opm_2 "Predicted idle speed control variable at drive-off-support (mode 2)" SWORD _CNV_A_R_LINEAR_____13_CM 1 100. -32768. 32767. DISPLAY_IDENTIFIER N_DIF_PRED_CS_OPM_2 ECU_ADDRESS 0xc000081a FORMAT "%6.0" /end MEASUREMENT
/begin MEASUREMENT t_n_dif_ofs_pred_cs_opm_1 "Prediction time for engine speed difference at drive-off-support (mode 1)" UBYTE _CNV_A_R_LINEAR_____183_CM 1 100. 0. 7.96875 DISPLAY_IDENTIFIER T_N_DIF_OFS_PRED_CS_OPM_1 ECU_ADDRESS 0xc000082e FORMAT "%4.2" /end MEASUREMENT
/begin MEASUREMENT fac_tq_add_is_bol_opm_2 "Resulting factor for TQ_ADD_IS_BOL_BAS (mode 2)" UBYTE _CNV_A_R_LINEAR_____184_CM 1 100. 0. 7.96875 DISPLAY_IDENTIFIER FAC_TQ_ADD_IS_BOL_OPM_2 ECU_ADDRESS 0xc0000831 FORMAT "%4.2" /end MEASUREMENT
/begin MEASUREMENT fac_tq_add_is_bol_opm_1 "Resulting factor for TQ_ADD_IS_BOL_BAS (mode 1)" UBYTE _CNV_A_R_LINEAR_____184_CM 1 100. 0. 7.96875 DISPLAY_IDENTIFIER FAC_TQ_ADD_IS_BOL_OPM_1 ECU_ADDRESS 0xc0000830 FORMAT "%4.2" /end MEASUREMENT
/begin AXIS_PTS ldpm_n_sp_is_tq_add_is_bol_bas "" 0xa10220e4 n_sp_is _REC_AXS_20_u2 8160. _CNV_A_R_LINEAR_____13_CM 6 0. 8160. FORMAT "%4.0" /end AXIS_PTS
/begin AXIS_PTS ldp_n_sp_is_tq_add_is_bol_bas_opm_2 "" 0xa102101c n_sp_is _REC_AXS_20_u2 8160. _CNV_A_R_LINEAR_____13_CM 4 0. 8160. FORMAT "%4.0" /end AXIS_PTS
/begin AXIS_PTS ldpm_tco_tq_add_is_bol_bas "" 0xa10222de tco _REC_AXS_20_u1 190.5 _CNV_A_R_LINEAR_____16_CM 6 -48. 142.5 FORMAT "%5.1" /end AXIS_PTS
/begin AXIS_PTS ldp_tco_tq_add_is_bol_bas_opm_2 "" 0xa10212e2 tco _REC_AXS_20_u1 190.5 _CNV_A_R_LINEAR_____16_CM 4 -48. 142.5 FORMAT "%5.1" /end AXIS_PTS
/begin AXIS_PTS ldpm_toil_ip_fac_temp_tq_add_is "" 0xa1022356 toil _REC_AXS_20_u1 200. _CNV_A_R_LINEAR_____25_CM 6 -40. 160. FORMAT "%3.0" /end AXIS_PTS
/begin AXIS_PTS ldpm_tia_ip_fac_temp_tq_add_is "" 0xa1022314 tia _REC_AXS_20_u1 190.5 _CNV_A_R_LINEAR_____16_CM 6 -48. 142.5 FORMAT "%5.1" /end AXIS_PTS
/begin AXIS_PTS ldpm_maf_fac_tq_add_is "" 0xa1021c10 maf _REC_AXS_20_u2 1389. _CNV_A_R_LINEAR_____108_CM 6 0. 1389. FORMAT "%4.0" /end AXIS_PTS
/begin AXIS_PTS ldpm_maf_fac_tq_add_is_opm2 "" 0xa1021c1e maf _REC_AXS_20_u2 1389. _CNV_A_R_LINEAR_____108_CM 1 0. 1389. FORMAT "%4.0" /end AXIS_PTS
/begin AXIS_PTS ldpm_vs_fil_ip_fac_vs_tq_add_is "" 0xa10223f8 vs_fil _REC_AXS_20_u2 511.99218 _CNV_A_R_LINEAR_____66_CM 4 0. 511.99218 FORMAT "%7.3" /end AXIS_PTS
/begin AXIS_PTS ldp_maf_lgrd_tq_add_is_bol "" 0xa1020ccc maf _REC_AXS_20_u2 1389. _CNV_A_R_LINEAR_____108_CM 6 0. 1389. FORMAT "%4.0" /end AXIS_PTS
/begin CHARACTERISTIC ip_t_n_dif_ofs_pred_opm_1 "Time constant for calculation of predicted engine speed deviation (mode 1)" CURVE 0xa1027d88 _REC_CUR_20_u1_u2 7.96875 _CNV_A_R_LINEAR_____183_CM 0. 7.96875 DISPLAY_IDENTIFIER IP_T_N_DIF_OFS_PRED_OPM_1 FORMAT "%4.2"
 /begin AXIS_DESCR COM_AXIS n _CNV_A_R_LINEAR_____13_CM 8 0. 8160. FORMAT "%4.0" AXIS_PTS_REF ldpm_n_t_n_dif_ofs_pred /end AXIS_DESCR
/end CHARACTERISTIC
/begin CHARACTERISTIC ip_t_n_dif_ofs_pred_cs_opm_2 "Time constant for calculation of predicted engine speed deviation at drive-off-support (mode2)" CURVE 0xa1027d78 _REC_CUR_20_u1_u2 7.96875 _CNV_A_R_LINEAR_____183_CM 0. 7.96875 DISPLAY_IDENTIFIER IP_T_N_DIF_OFS_PRED_CS_OPM_2 FORMAT "%4.2"
 /begin AXIS_DESCR COM_AXIS n _CNV_A_R_LINEAR_____13_CM 8 0. 8160. FORMAT "%4.0" AXIS_PTS_REF ldpm_n_t_n_dif_ofs_pred /end AXIS_DESCR
/end CHARACTERISTIC
/begin CHARACTERISTIC ip_t_n_dif_ofs_pred_cs_opm_1 "Time constant for calculation of predicted engine speed deviation at drive-off-support (mode1)" CURVE 0xa1027d70 _REC_CUR_20_u1_u2 7.96875 _CNV_A_R_LINEAR_____183_CM 0. 7.96875 DISPLAY_IDENTIFIER IP_T_N_DIF_OFS_PRED_CS_OPM_1 FORMAT "%4.2"
 /begin AXIS_DESCR COM_AXIS n _CNV_A_R_LINEAR_____13_CM 8 0. 8160. FORMAT "%4.0" AXIS_PTS_REF ldpm_n_t_n_dif_ofs_pred /end AXIS_DESCR
/end CHARACTERISTIC
/begin CHARACTERISTIC ip_tq_add_is_bol_bas_opm_1 "Basis torque reserve at idle (mode1)" MAP 0xa10282c0 _REC_MAP_20_u2_u2_u1 1023.96875 _CNV_A_R_LINEAR_____30_CM 0. 1023.96875 DISPLAY_IDENTIFIER IP_TQ_ADD_IS_BOL_BAS_OPM_1 FORMAT "%7.2"
 /begin AXIS_DESCR COM_AXIS n_sp_is _CNV_A_R_LINEAR_____13_CM 6 0. 8160. FORMAT "%4.0" AXIS_PTS_REF ldpm_n_sp_is_tq_add_is_bol_bas /end AXIS_DESCR
 /begin AXIS_DESCR COM_AXIS tco _CNV_A_R_LINEAR_____16_CM 6 -48. 142.5 FORMAT "%5.1" AXIS_PTS_REF ldpm_tco_tq_add_is_bol_bas /end AXIS_DESCR
/end CHARACTERISTIC
/begin CHARACTERISTIC ip_tq_add_is_bol_bas_opm_2 "Basis torque reserve at idle (mode2)" MAP 0xa1028308 _REC_MAP_20_u2_u2_u1 1023.96875 _CNV_A_R_LINEAR_____30_CM 0. 1023.96875 DISPLAY_IDENTIFIER IP_TQ_ADD_IS_BOL_BAS_OPM_2 FORMAT "%7.2"
 /begin AXIS_DESCR COM_AXIS n_sp_is _CNV_A_R_LINEAR_____13_CM 4 0. 8160. FORMAT "%4.0" AXIS_PTS_REF ldp_n_sp_is_tq_add_is_bol_bas_opm_2 /end AXIS_DESCR
 /begin AXIS_DESCR COM_AXIS tco _CNV_A_R_LINEAR_____16_CM 4 -48. 142.5 FORMAT "%5.1" AXIS_PTS_REF ldp_tco_tq_add_is_bol_bas_opm_2 /end AXIS_DESCR
/end CHARACTERISTIC
/begin CHARACTERISTIC ip_fac_temp_tq_add_is_bas_opm_1 "Temperature correction for IP_TQ_ADD_IS_BOL_BAS (mode1)" MAP 0xa10240ac _REC_MAP_20_u1_u1_u1 1.9921875 _CNV_A_R_LINEAR_____100_CM 0. 1.9921875 DISPLAY_IDENTIFIER IP_FAC_TEMP_TQ_ADD_IS_BAS_OPM_1 FORMAT "%8.6"
 /begin AXIS_DESCR COM_AXIS tia _CNV_A_R_LINEAR_____16_CM 6 -48. 142.5 FORMAT "%5.1" AXIS_PTS_REF ldpm_tia_ip_fac_temp_tq_add_is /end AXIS_DESCR
 /begin AXIS_DESCR COM_AXIS toil _CNV_A_R_LINEAR_____25_CM 6 -40. 160. FORMAT "%3.0" AXIS_PTS_REF ldpm_toil_ip_fac_temp_tq_add_is /end AXIS_DESCR
/end CHARACTERISTIC
/begin CHARACTERISTIC ip_fac_temp_tq_add_is_bas_opm_2 "Temperature correction for IP_TQ_ADD_IS_BOL_BAS (mode2)" MAP 0xa10240d0 _REC_MAP_20_u1_u1_u1 1.9921875 _CNV_A_R_LINEAR_____100_CM 0. 1.9921875 DISPLAY_IDENTIFIER IP_FAC_TEMP_TQ_ADD_IS_BAS_OPM_2 FORMAT "%8.6"
 /begin AXIS_DESCR COM_AXIS tia _CNV_A_R_LINEAR_____16_CM 6 -48. 142.5 FORMAT "%5.1" AXIS_PTS_REF ldpm_tia_ip_fac_temp_tq_add_is /end AXIS_DESCR
 /begin AXIS_DESCR COM_AXIS toil _CNV_A_R_LINEAR_____25_CM 6 -40. 160. FORMAT "%3.0" AXIS_PTS_REF ldpm_toil_ip_fac_temp_tq_add_is /end AXIS_DESCR
/end CHARACTERISTIC
/begin CHARACTERISTIC ip_fac_tq_add_is_bol_opm_1 "Factor for basis torque reserve at idle due to N_DIF_PRED and load without drive (mode1)" MAP 0xa10243c4 _REC_MAP_20_u1_u2_u2 7.96875 _CNV_A_R_LINEAR_____184_CM 0. 7.96875 DISPLAY_IDENTIFIER IP_FAC_TQ_ADD_IS_BOL_OPM_1 FORMAT "%4.2"
 /begin AXIS_DESCR COM_AXIS n_dif_pred_pl_drof _CNV_A_R_LINEAR_____172_CM 8 -32768. 32767. FORMAT "%6.0" AXIS_PTS_REF ldpm_n_dif_pred_fac_tq_add_is /end AXIS_DESCR
 /begin AXIS_DESCR COM_AXIS maf _CNV_A_R_LINEAR_____108_CM 6 0. 1389. FORMAT "%4.0" AXIS_PTS_REF ldpm_maf_fac_tq_add_is /end AXIS_DESCR
/end CHARACTERISTIC
/begin CHARACTERISTIC ip_fac_tq_add_is_bol_cs_opm_1 "Factor for basis torque reserve at idle due to N_DIF_PRED and load for drive-off-support (mode1)" MAP 0xa1024354 _REC_MAP_20_u1_u2_u2 7.96875 _CNV_A_R_LINEAR_____184_CM 0. 7.96875 DISPLAY_IDENTIFIER IP_FAC_TQ_ADD_IS_BOL_CS_OPM_1 FORMAT "%4.2"
 /begin AXIS_DESCR COM_AXIS n_dif_pred_pl_drof _CNV_A_R_LINEAR_____172_CM 8 -32768. 32767. FORMAT "%6.0" AXIS_PTS_REF ldpm_n_dif_pred_fac_tq_add_is /end AXIS_DESCR
 /begin AXIS_DESCR COM_AXIS maf _CNV_A_R_LINEAR_____108_CM 6 0. 1389. FORMAT "%4.0" AXIS_PTS_REF ldpm_maf_fac_tq_add_is /end AXIS_DESCR
/end CHARACTERISTIC
/begin CHARACTERISTIC ip_fac_tq_add_is_bol_opm_2 "Factor for basis torque reserve at idle due to N_DIF_PRED and load without drive (mode2)" MAP 0xa10243f4 _REC_MAP_20_u1_u2_u2 7.96875 _CNV_A_R_LINEAR_____184_CM 0. 7.96875 DISPLAY_IDENTIFIER IP_FAC_TQ_ADD_IS_BOL_OPM_2 FORMAT "%4.2"
 /begin AXIS_DESCR COM_AXIS n_dif_pred_pl_drof _CNV_A_R_LINEAR_____172_CM 8 -32768. 32767. FORMAT "%6.0" AXIS_PTS_REF ldpm_n_dif_pred_fac_tq_add_is /end AXIS_DESCR
 /begin AXIS_DESCR COM_AXIS maf _CNV_A_R_LINEAR_____108_CM 1 0. 1389. FORMAT "%4.0" AXIS_PTS_REF ldpm_maf_fac_tq_add_is_opm2 /end AXIS_DESCR
/end CHARACTERISTIC
/begin CHARACTERISTIC ip_fac_tq_add_is_bol_cs_opm_2 "Factor for basis torque reserve at idle due to N_DIF_PRED and load for drive-off-support (mode2)" MAP 0xa1024384 _REC_MAP_20_u1_u2_u2 7.96875 _CNV_A_R_LINEAR_____184_CM 0. 7.96875 DISPLAY_IDENTIFIER IP_FAC_TQ_ADD_IS_BOL_CS_OPM_2 FORMAT "%4.2"
 /begin AXIS_DESCR COM_AXIS n_dif_pred_pl_drof _CNV_A_R_LINEAR_____172_CM 8 -32768. 32767. FORMAT "%6.0" AXIS_PTS_REF ldpm_n_dif_pred_fac_tq_add_is /end AXIS_DESCR
 /begin AXIS_DESCR COM_AXIS maf _CNV_A_R_LINEAR_____108_CM 1 0. 1389. FORMAT "%4.0" AXIS_PTS_REF ldpm_maf_fac_tq_add_is_opm2 /end AXIS_DESCR
/end CHARACTERISTIC
/begin CHARACTERISTIC ip_fac_vs_tq_add_is_bol_opm_1 "Factor for IP_FAC_TQ_ADD_IS_BOL_CS_OPM_1 (mode 1)" CURVE 0xa10249ca _REC_CUR_20_u1_u2 1.9921875 _CNV_A_R_LINEAR_____100_CM 0. 1.9921875 DISPLAY_IDENTIFIER IP_FAC_VS_TQ_ADD_IS_BOL_OPM_1 FORMAT "%5.3"
 /begin AXIS_DESCR COM_AXIS vs_fil _CNV_A_R_LINEAR_____66_CM 4 0. 511.99218 FORMAT "%7.3" AXIS_PTS_REF ldpm_vs_fil_ip_fac_vs_tq_add_is /end AXIS_DESCR
/end CHARACTERISTIC
/begin CHARACTERISTIC ip_fac_vs_tq_add_is_bol_opm_2 "Factor for IP_FAC_TQ_ADD_IS_BOL_CS_OPM_1 (mode 2)" CURVE 0xa10249ce _REC_CUR_20_u1_u2 1.9921875 _CNV_A_R_LINEAR_____100_CM 0. 1.9921875 DISPLAY_IDENTIFIER IP_FAC_VS_TQ_ADD_IS_BOL_OPM_2 FORMAT "%5.3"
 /begin AXIS_DESCR COM_AXIS vs_fil _CNV_A_R_LINEAR_____66_CM 4 0. 511.99218 FORMAT "%7.3" AXIS_PTS_REF ldpm_vs_fil_ip_fac_vs_tq_add_is /end AXIS_DESCR
/end CHARACTERISTIC
/begin CHARACTERISTIC ip_fac_tq_add_is_bol_dri_opm_1 "Factor for basis torque reserve at idle due to N_DIF_PRED and load with drive (mode 1)" MAP 0xa102438c _REC_MAP_20_u1_u2_u2 7.96875 _CNV_A_R_LINEAR_____184_CM 0. 7.96875 DISPLAY_IDENTIFIER IP_FAC_TQ_ADD_IS_BOL_DRI_OPM_1 FORMAT "%4.2"
 /begin AXIS_DESCR COM_AXIS n_dif_pred_pl_drof _CNV_A_R_LINEAR_____172_CM 8 -32768. 32767. FORMAT "%6.0" AXIS_PTS_REF ldpm_n_dif_pred_fac_tq_add_is /end AXIS_DESCR
 /begin AXIS_DESCR COM_AXIS maf _CNV_A_R_LINEAR_____108_CM 6 0. 1389. FORMAT "%4.0" AXIS_PTS_REF ldpm_maf_fac_tq_add_is /end AXIS_DESCR
/end CHARACTERISTIC
/begin CHARACTERISTIC ip_fac_tq_add_is_bol_dri_opm_2 "Factor for basis torque reserve at idle due to N_DIF_PRED and load with drive (mode 2)" MAP 0xa10243bc _REC_MAP_20_u1_u2_u2 7.96875 _CNV_A_R_LINEAR_____184_CM 0. 7.96875 DISPLAY_IDENTIFIER IP_FAC_TQ_ADD_IS_BOL_DRI_OPM_2 FORMAT "%4.2"
 /begin AXIS_DESCR COM_AXIS n_dif_pred_pl_drof _CNV_A_R_LINEAR_____172_CM 8 -32768. 32767. FORMAT "%6.0" AXIS_PTS_REF ldpm_n_dif_pred_fac_tq_add_is /end AXIS_DESCR
 /begin AXIS_DESCR COM_AXIS maf _CNV_A_R_LINEAR_____108_CM 1 0. 1389. FORMAT "%4.0" AXIS_PTS_REF ldpm_maf_fac_tq_add_is_opm2 /end AXIS_DESCR
/end CHARACTERISTIC
/begin AXIS_PTS ldp_vlft_min_ip_tq_add_is_cor "" 0xa102178c NO_INPUT_QUANTITY _REC_AXS_20_u2 65.535 _CNV_A_R_LINEAR_____185_CM 6 0. 65.535 /end AXIS_PTS
/begin AXIS_PTS ldp_map_dip_sp_mmv_ip_tq_add_is "" 0xa1020d18 NO_INPUT_QUANTITY _REC_AXS_20_u2 2559.9609375 _CNV_A_R_LINEAR_____186_CM 6 -1280. 1279.9609375 FORMAT "%8.2" /end AXIS_PTS
/begin CHARACTERISTIC ip_tq_add_is_cor_opm_1 "Additive torque reserve at idle at VVT-mode (mode 1)" MAP 0xa1028328 _REC_MAP_20_u2_u2_u2 1023.96875 _CNV_A_R_LINEAR_____30_CM 0. 1023.96875 DISPLAY_IDENTIFIER IP_TQ_ADD_IS_COR_OPM_1 FORMAT "%7.2"
 /begin AXIS_DESCR COM_AXIS NO_INPUT_QUANTITY _CNV_A_R_LINEAR_____185_CM 6 0. 65.535 AXIS_PTS_REF ldp_vlft_min_ip_tq_add_is_cor /end AXIS_DESCR
 /begin AXIS_DESCR COM_AXIS NO_INPUT_QUANTITY _CNV_A_R_LINEAR_____186_CM 6 -1280. 1279.9609375 FORMAT "%8.2" AXIS_PTS_REF ldp_map_dip_sp_mmv_ip_tq_add_is /end AXIS_DESCR
/end CHARACTERISTIC
/begin CHARACTERISTIC c_tq_dif_add_is_tol_opm_1 "Idle speed torque reserve limitation for stabilizing the ISC at high torque reserve in OPM 1" VALUE 0xa1029af2 _REC_VAL_20_u2 1023.96875 _CNV_A_R_LINEAR_____30_CM 0. 1023.96875 DISPLAY_IDENTIFIER C_TQ_DIF_ADD_IS_TOL_OPM_1 FORMAT "%7.2" /end CHARACTERISTIC
/begin CHARACTERISTIC c_tq_dif_add_is_tol_opm_2 "Idle speed torque reserve limitation for stabilizing the ISC at high torque reserve in OPM 2" VALUE 0xa1029af4 _REC_VAL_20_u2 1023.96875 _CNV_A_R_LINEAR_____30_CM 0. 1023.96875 DISPLAY_IDENTIFIER C_TQ_DIF_ADD_IS_TOL_OPM_2 FORMAT "%7.2" /end CHARACTERISTIC
/begin AXIS_PTS ldp_n_lgrd_tq_add_is_bol "" 0xa1020f90 n _REC_AXS_20_u2 8160. _CNV_A_R_LINEAR_____13_CM 6 0. 8160. FORMAT "%4.0" /end AXIS_PTS
/begin AXIS_PTS ldp_n_lgrd_tq_add_is_bol_opm_2 "" 0xa1020fa0 n _REC_AXS_20_u2 8160. _CNV_A_R_LINEAR_____13_CM 6 0. 8160. FORMAT "%4.0" /end AXIS_PTS
/begin CHARACTERISTIC ip_lgrd_tq_add_is_bol "Gradient for decrementation of the torque reserve at idle" MAP 0xa10260d0 _REC_MAP_20_u1_u2_u2 7.96875 _CNV_A_R_LINEAR_____184_CM 0. 7.96875 DISPLAY_IDENTIFIER IP_LGRD_TQ_ADD_IS_BOL FORMAT "%4.2"
 /begin AXIS_DESCR COM_AXIS n _CNV_A_R_LINEAR_____13_CM 6 0. 8160. FORMAT "%4.0" AXIS_PTS_REF ldp_n_lgrd_tq_add_is_bol /end AXIS_DESCR
 /begin AXIS_DESCR COM_AXIS maf _CNV_A_R_LINEAR_____108_CM 6 0. 1389. FORMAT "%4.0" AXIS_PTS_REF ldp_maf_lgrd_tq_add_is_bol /end AXIS_DESCR
/end CHARACTERISTIC
/begin CHARACTERISTIC ip_lgrd_tq_add_is_bol_opm_2 "Gradient for decrementation of the torque reserve at idle for OPM 2" CURVE 0xa10260f4 _REC_CUR_20_u1_u2 7.96875 _CNV_A_R_LINEAR_____184_CM 0. 7.96875 DISPLAY_IDENTIFIER IP_LGRD_TQ_ADD_IS_BOL_OPM_2 FORMAT "%4.2"
 /begin AXIS_DESCR COM_AXIS n _CNV_A_R_LINEAR_____13_CM 6 0. 8160. FORMAT "%4.0" AXIS_PTS_REF ldp_n_lgrd_tq_add_is_bol_opm_2 /end AXIS_DESCR
/end CHARACTERISTIC
/begin MEASUREMENT lam_bank_1.fsd_obd2.t_sum_max_fsd "Total duration over IP_FAC_LAMB_MAX_FDS" UWORD _CNV_A_R_LINEAR_____107_CM 1 100. 0. 1310.7 DISPLAY_IDENTIFIER T_SUM_MAX_FSD_1 ECU_ADDRESS 0xd00055e2 FORMAT "%7.2" /end MEASUREMENT
/begin MEASUREMENT lam_bank_1.fsd_obd2.t_sum_min_fsd "Total duration over IP_FAC_LAMB_MIN_FDS" UWORD _CNV_A_R_LINEAR_____107_CM 1 100. 0. 1310.7 DISPLAY_IDENTIFIER T_SUM_MIN_FSD_1 ECU_ADDRESS 0xd00055e4 FORMAT "%7.2" /end MEASUREMENT
/begin MEASUREMENT lam_bank_1.fsd_obd2.t_sum_end_diag_win_fsd "Time counter to set LV_END_DIAG_FSD_i" UWORD _CNV_A_R_LINEAR_____107_CM 1 100. 0. 1310.7 DISPLAY_IDENTIFIER T_SUM_END_DIAG_WIN_FSD_1 ECU_ADDRESS 0xd00055e6 FORMAT "%7.2" /end MEASUREMENT
/begin MEASUREMENT lam_bank_1.fsd_obd2.t_sum_end_ready_fsd "Second time counter to set LV_END_DIAG_FSD_i" UWORD _CNV_A_R_LINEAR_____107_CM 1 100. 0. 1310.7 DISPLAY_IDENTIFIER T_SUM_END_READY_FSD[1] ECU_ADDRESS 0xd00055e8 FORMAT "%7.2" /end MEASUREMENT
/begin MEASUREMENT lam_bank_1.fsd_obd2.t_sum_rst_fsd "Time counter to reset T_SUM_MAX_FSD_i and T_SUM_MIN_FSD_i" UWORD _CNV_A_R_LINEAR_____107_CM 1 100. 0. 1310.7 DISPLAY_IDENTIFIER T_SUM_RST_FSD_1 ECU_ADDRESS 0xd00055ea FORMAT "%7.2" /end MEASUREMENT
/begin MEASUREMENT lam_bank_2.fsd_obd2.t_sum_max_fsd "Total duration over IP_FAC_LAMB_MAX_FDS" UWORD _CNV_A_R_LINEAR_____107_CM 1 100. 0. 1310.7 DISPLAY_IDENTIFIER T_SUM_MAX_FSD_2 ECU_ADDRESS 0xd000567a FORMAT "%7.2" /end MEASUREMENT
/begin MEASUREMENT lam_bank_2.fsd_obd2.t_sum_min_fsd "Total duration over IP_FAC_LAMB_MIN_FDS" UWORD _CNV_A_R_LINEAR_____107_CM 1 100. 0. 1310.7 DISPLAY_IDENTIFIER T_SUM_MIN_FSD_2 ECU_ADDRESS 0xd000567c FORMAT "%7.2" /end MEASUREMENT
/begin MEASUREMENT lam_bank_2.fsd_obd2.t_sum_end_diag_win_fsd "Time counter to set LV_END_DIAG_FSD_i" UWORD _CNV_A_R_LINEAR_____107_CM 1 100. 0. 1310.7 DISPLAY_IDENTIFIER T_SUM_END_DIAG_WIN_FSD_2 ECU_ADDRESS 0xd000567e FORMAT "%7.2" /end MEASUREMENT
/begin MEASUREMENT lam_bank_2.fsd_obd2.t_sum_end_ready_fsd "Second time counter to set LV_END_DIAG_FSD_i" UWORD _CNV_A_R_LINEAR_____107_CM 1 100. 0. 1310.7 DISPLAY_IDENTIFIER T_SUM_END_READY_FSD[2] ECU_ADDRESS 0xd0005680 FORMAT "%7.2" /end MEASUREMENT
/begin MEASUREMENT lam_bank_2.fsd_obd2.t_sum_rst_fsd "Time counter to reset T_SUM_MAX_FSD_i and T_SUM_MIN_FSD_i" UWORD _CNV_A_R_LINEAR_____107_CM 1 100. 0. 1310.7 DISPLAY_IDENTIFIER T_SUM_RST_FSD_2 ECU_ADDRESS 0xd0005682 FORMAT "%7.2" /end MEASUREMENT
/begin CHARACTERISTIC c_saf_diag_max "Error detection threshold for maximum deviation" VALUE 0xa1029786 _REC_VAL_20_u2 255. _CNV_A_R_LINEAR_____244_CM 0. 255. DISPLAY_IDENTIFIER C_SAF_DIAG_MAX FORMAT "%7.3" /end CHARACTERISTIC
/begin CHARACTERISTIC c_saf_diag_min "Error detection threshold for minimum deviation" VALUE 0xa1029788 _REC_VAL_20_u2 255. _CNV_A_R_LINEAR_____244_CM 0. 255. DISPLAY_IDENTIFIER C_SAF_DIAG_MIN FORMAT "%7.3" /end CHARACTERISTIC
/begin MEASUREMENT lv_err_dmtlm "error DMTL module" UBYTE _CNV_S_2_RANGE__0___1_CM 1 100. 0. 1. DISPLAY_IDENTIFIER LV_ERR_DMTLM ECU_ADDRESS 0xd0003436 BIT_MASK 0x1 /end MEASUREMENT
/begin CHARACTERISTIC c_t_sum_max_max_fsd "Time counter threshold for T_SUM_MAX_FSD_i" VALUE 0xa1029966 _REC_VAL_20_u2 1310.68 _CNV_A_R_LINEAR_____107_CM 2.e-002 1310.7 DISPLAY_IDENTIFIER C_T_SUM_MAX_MAX_FSD FORMAT "%7.2" /end CHARACTERISTIC
/begin CHARACTERISTIC c_t_sum_min_max_fsd "Time counter threshold for T_SUM_MIN_FSD_i" VALUE 0xa1029968 _REC_VAL_20_u2 1310.68 _CNV_A_R_LINEAR_____107_CM 2.e-002 1310.7 DISPLAY_IDENTIFIER C_T_SUM_MIN_MAX_FSD FORMAT "%7.2" /end CHARACTERISTIC
/begin CHARACTERISTIC c_t_sum_rst_max_fsd "Time counter threshold for T_SUM_RST_FSD_i" VALUE 0xa102996c _REC_VAL_20_u2 1310.68 _CNV_A_R_LINEAR_____107_CM 2.e-002 1310.7 DISPLAY_IDENTIFIER C_T_SUM_RST_MAX_FSD FORMAT "%7.2" /end CHARACTERISTIC
/begin CHARACTERISTIC c_t_sum_max_err_fsd "Time ctr thresh. for T_SUM_MAX_FSD_i and T_SUM_MIN_FSD_i dur. T_SUM_END_READY_FSD_i" VALUE 0xa1029964 _REC_VAL_20_u2 1310.68 _CNV_A_R_LINEAR_____107_CM 2.e-002 1310.7 DISPLAY_IDENTIFIER C_T_SUM_MAX_ERR_FSD FORMAT "%7.2" /end CHARACTERISTIC
/begin CHARACTERISTIC c_t_sum_ready_fsd "Time counter threshold for T_SUM_END_READY_FSD_i" VALUE 0xa102996a _REC_VAL_20_u2 1310.68 _CNV_A_R_LINEAR_____107_CM 2.e-002 1310.7 DISPLAY_IDENTIFIER C_T_SUM_READY_FSD FORMAT "%7.2" /end CHARACTERISTIC
/begin CHARACTERISTIC c_n_min_fsd "Engine speed threshold for fuel system diagnosis" VALUE 0xa1029634 _REC_VAL_20_u1 8160. _CNV_A_R_LINEAR_____9_CM 0. 8160. DISPLAY_IDENTIFIER C_N_MIN_FSD FORMAT "%4.0" /end CHARACTERISTIC
/begin CHARACTERISTIC c_maf_min_fsd "Mass air flow threshold for fuel system diagnosis" VALUE 0xa1029558 _REC_VAL_20_u1 1389. _CNV_A_R_LINEAR_____14_CM 0. 1389. DISPLAY_IDENTIFIER C_MAF_MIN_FSD FORMAT "%4.0" /end CHARACTERISTIC
/begin CHARACTERISTIC c_tco_min_fsd "Minimum threshold of TCO for fuel system diagnosis" VALUE 0xa10299e1 _REC_VAL_20_u1 190.5 _CNV_A_R_LINEAR_____16_CM -48. 142.5 DISPLAY_IDENTIFIER C_TCO_MIN_FSD FORMAT "%5.1" /end CHARACTERISTIC
/begin CHARACTERISTIC id_stop_inc_fsd__tco_st "Increasing value for the debounce counter STOP_FSD" CURVE 0xa1022f24 _REC_CUR_20_u1_u1 255. _CNV_A_R_LINEAR_____0_CM 0. 255. DISPLAY_IDENTIFIER ID_STOP_INC_FSD__TCO_ST FORMAT "%3.0"
 /begin AXIS_DESCR COM_AXIS tco_st _CNV_A_R_LINEAR_____16_CM 4 -48. 142.5 FORMAT "%5.1" AXIS_PTS_REF ldp_tco_st__stop_inc_fsd /end AXIS_DESCR
/end CHARACTERISTIC
/begin CHARACTERISTIC id_stop_dec_fsd__toil_max "Decreasing value for the debounce counter STOP_FSD" CURVE 0xa1022f20 _REC_CUR_20_u1_u1 255. _CNV_A_R_LINEAR_____0_CM 0. 255. DISPLAY_IDENTIFIER ID_STOP_DEC_FSD__TOIL_MAX FORMAT "%3.0"
 /begin AXIS_DESCR COM_AXIS toil_max _CNV_A_R_LINEAR_____25_CM 4 -40. 160. FORMAT "%3.0" AXIS_PTS_REF ldp_toil_max__stop_dec_fsd /end AXIS_DESCR
/end CHARACTERISTIC
/begin MEASUREMENT toil_max "Maximum oil temperature from the last engine running" UBYTE _CNV_A_R_LINEAR_____25_CM 1 100. -40. 160. DISPLAY_IDENTIFIER TOIL_MAX ECU_ADDRESS 0xc0000b50 FORMAT "%3.0" /end MEASUREMENT
/begin MEASUREMENT ctr_stop_fsd "Counter value as a measure of the oil dilution under cold start conditions" UBYTE _CNV_A_R_LINEAR_____0_CM 1 100. 0. 255. DISPLAY_IDENTIFIER CTR_STOP_FSD ECU_ADDRESS 0xd0003e88 FORMAT "%3.0" /end MEASUREMENT
/begin CHARACTERISTIC c_stop_max_fsd "Maximum value for the debounce counter STOP_FSD" VALUE 0xa10297cc _REC_VAL_20_u1 255. _CNV_A_R_LINEAR_____0_CM 0. 255. DISPLAY_IDENTIFIER C_STOP_MAX_FSD FORMAT "%3.0" /end CHARACTERISTIC
/begin AXIS_PTS ldp_toil_max__stop_dec_fsd "" 0xa1021420 toil_max _REC_AXS_20_u1 200. _CNV_A_R_LINEAR_____25_CM 4 -40. 160. FORMAT "%3.0" /end AXIS_PTS
/begin AXIS_PTS ldp_tco_st__stop_inc_fsd "" 0xa10212be tco_st _REC_AXS_20_u1 190.5 _CNV_A_R_LINEAR_____16_CM 4 -48. 142.5 FORMAT "%5.1" /end AXIS_PTS
/begin AXIS_PTS ldpm_lamb_sp "" 0xa1021b60 online_dummy _REC_AXS_20_u2 31.9990234375 _CNV_A_R_LINEAR_____122_CM 6 0. 31.9990234375 FORMAT "%7.4" /end AXIS_PTS
/begin CHARACTERISTIC ip_fac_lamb_min_fsd_1 "Lambdacontroller minimum threshold for FSD dependent on LAMB_SP" CURVE 0xa1023ad0 _REC_CUR_20_u2_u2 199.99694824 _CNV_A_R_LINEAR_____225_CM -100. 99.99694824 DISPLAY_IDENTIFIER IP_FAC_LAMB_MIN_FSD_1 FORMAT "%8.3"
 /begin AXIS_DESCR COM_AXIS online_dummy _CNV_A_R_LINEAR_____122_CM 6 0. 31.9990234375 FORMAT "%7.4" AXIS_PTS_REF ldpm_lamb_sp /end AXIS_DESCR
/end CHARACTERISTIC
/begin CHARACTERISTIC ip_fac_lamb_min_fsd_2 "Lambdacontroller minimum threshold for FSD dependent on LAMB_SP" CURVE 0xa1023adc _REC_CUR_20_u2_u2 199.99694824 _CNV_A_R_LINEAR_____225_CM -100. 99.99694824 DISPLAY_IDENTIFIER IP_FAC_LAMB_MIN_FSD_2 FORMAT "%8.3"
 /begin AXIS_DESCR COM_AXIS online_dummy _CNV_A_R_LINEAR_____122_CM 6 0. 31.9990234375 FORMAT "%7.4" AXIS_PTS_REF ldpm_lamb_sp /end AXIS_DESCR
/end CHARACTERISTIC
/begin CHARACTERISTIC ip_fac_lamb_max_fsd_1 "Lambdacontroller maximum threshold for FSD dependent on LAMB_SP" CURVE 0xa1023ab8 _REC_CUR_20_u2_u2 199.99694824 _CNV_A_R_LINEAR_____225_CM -100. 99.99694824 DISPLAY_IDENTIFIER IP_FAC_LAMB_MAX_FSD_1 FORMAT "%8.3"
 /begin AXIS_DESCR COM_AXIS online_dummy _CNV_A_R_LINEAR_____122_CM 6 0. 31.9990234375 FORMAT "%7.4" AXIS_PTS_REF ldpm_lamb_sp /end AXIS_DESCR
/end CHARACTERISTIC
/begin CHARACTERISTIC ip_fac_lamb_max_fsd_2 "Lambdacontroller maximum threshold for FSD dependent on LAMB_SP" CURVE 0xa1023ac4 _REC_CUR_20_u2_u2 199.99694824 _CNV_A_R_LINEAR_____225_CM -100. 99.99694824 DISPLAY_IDENTIFIER IP_FAC_LAMB_MAX_FSD_2 FORMAT "%8.3"
 /begin AXIS_DESCR COM_AXIS online_dummy _CNV_A_R_LINEAR_____122_CM 6 0. 31.9990234375 FORMAT "%7.4" AXIS_PTS_REF ldpm_lamb_sp /end AXIS_DESCR
/end CHARACTERISTIC
/begin CHARACTERISTIC c_amp_min_fsd "Minimum ambient pressure threshold for fuel system diagnosis" VALUE 0xa1029194 _REC_VAL_20_u2 5434. _CNV_A_R_LINEAR_____26_CM 0. 5434. DISPLAY_IDENTIFIER C_AMP_MIN_FSD FORMAT "%7.2" /end CHARACTERISTIC
/begin CHARACTERISTIC c_tam_min_fsd "Minimum ambient temperature threshold for fuel system diagnosis" VALUE 0xa10299c1 _REC_VAL_20_u1 190.5 _CNV_A_R_LINEAR_____16_CM -48. 142.5 DISPLAY_IDENTIFIER C_TAM_MIN_FSD FORMAT "%5.1" /end CHARACTERISTIC
/begin CHARACTERISTIC c_t_min_maf_fsd "Minimum time at 'low load' for deactivating FSD" VALUE 0xa10298f8 _REC_VAL_20_u2 1310.68 _CNV_A_R_LINEAR_____107_CM 2.e-002 1310.7 DISPLAY_IDENTIFIER C_T_MIN_MAF_FSD FORMAT "%7.2" /end CHARACTERISTIC
/begin CHARACTERISTIC c_t_dly_maf_fsd "Minimum time at 'no low load' for deactivating FSD" VALUE 0xa102986e _REC_VAL_20_u2 1310.68 _CNV_A_R_LINEAR_____107_CM 2.e-002 1310.7 DISPLAY_IDENTIFIER C_T_DLY_MAF_FSD FORMAT "%7.2" /end CHARACTERISTIC
/begin CHARACTERISTIC c_n_min_mff_ad_add_fsd "Minimum engine speed for consideration of MFF_AD_ADD_MMV_REL_QUO" VALUE 0xa1029639 _REC_VAL_20_u1 8160. _CNV_A_R_LINEAR_____9_CM 0. 8160. DISPLAY_IDENTIFIER C_N_MIN_MFF_AD_ADD_FSD FORMAT "%4.0" /end CHARACTERISTIC
/begin CHARACTERISTIC c_maf_min_mff_ad_add_fsd "Minimum engine load for consideration of MFF_AD_ADD_MMV_REL_QUO" VALUE 0xa102955e _REC_VAL_20_u1 1389. _CNV_A_R_LINEAR_____14_CM 0. 1389. DISPLAY_IDENTIFIER C_MAF_MIN_MFF_AD_ADD_FSD FORMAT "%4.0" /end CHARACTERISTIC
/begin CHARACTERISTIC c_fac_cp_fsd "Velocity of time integration during canister purge phase" VALUE 0xa102937b _REC_VAL_20_u1 0.99610001 _CNV_A_R_LINEAR_____17_CM 0. 0.99610001 DISPLAY_IDENTIFIER C_FAC_CP_FSD FORMAT "%5.3" /end CHARACTERISTIC
/begin MEASUREMENT v_dmtl "???" UWORD _CNV_A_R_LINEAR_____2_CM 1 100. 0. 4.9951171875 DISPLAY_IDENTIFIER V_DMTL ECU_ADDRESS 0xd0004fdc FORMAT "%5.3" /end MEASUREMENT
/begin MEASUREMENT v_sof_swi "Voltage sound flap switch" UWORD _CNV_A_R_LINEAR_____2_CM 1 100. 0. 4.9951171875 DISPLAY_IDENTIFIER V_SOF_SWI ECU_ADDRESS 0xd0004fe0 FORMAT "%5.3" /end MEASUREMENT
/begin MEASUREMENT v_sof_swi_mon "Voltage sound flap switch" UWORD _CNV_A_R_LINEAR_____2_CM 1 100. 0. 4.9951171875 DISPLAY_IDENTIFIER V_SOF_SWI_MON ECU_ADDRESS 0xd0004fe2 FORMAT "%5.3" /end MEASUREMENT
/begin AXIS_PTS ldpm_n_t_n_dif_ofs_pred "" 0xa10220f4 n _REC_AXS_20_u2 8160. _CNV_A_R_LINEAR_____13_CM 8 0. 8160. FORMAT "%4.0" /end AXIS_PTS
/begin AXIS_PTS ldpm_n_dif_pred_fac_tq_add_is "" 0xa1021fe8 n_dif_pred_pl_drof _REC_AXS_20_u2 65535. _CNV_A_R_LINEAR_____172_CM 8 -32768. 32767. FORMAT "%6.0" /end AXIS_PTS
/begin MEASUREMENT lv_rough_leak_susp_chk_fuc "evap emission system suspects rough leak" UBYTE _CNV_S_2_RANGE__0___1_CM 1 100. 0. 1. DISPLAY_IDENTIFIER LV_ROUGH_LEAK_SUSP_CHK_FUC ECU_ADDRESS 0xd0003e29 BIT_MASK 0x1 /end MEASUREMENT
/begin MEASUREMENT lv_ctr_dc_chk_fuc "indicator of driving cycle counter enabled" UBYTE _CNV_S_2_RANGE__0___1_CM 1 100. 0. 1. DISPLAY_IDENTIFIER LV_CTR_DC_CHK_FUC ECU_ADDRESS 0xd0003e2a BIT_MASK 0x1 /end MEASUREMENT
/begin MEASUREMENT lv_ena_chk_fuc_refu "valid refilling recognized" UBYTE _CNV_S_2_RANGE__0___1_CM 1 100. 0. 1. DISPLAY_IDENTIFIER LV_ENA_CHK_FUC_REFU ECU_ADDRESS 0xd0003e2b BIT_MASK 0x1 /end MEASUREMENT
/begin MEASUREMENT lv_ena_chk_fuc_rough_leak_mes "valid refilling recognized" UBYTE _CNV_S_2_RANGE__0___1_CM 1 100. 0. 1. DISPLAY_IDENTIFIER LV_ENA_CHK_FUC_ROUGH_LEAK_MES ECU_ADDRESS 0xd0003e20 BIT_MASK 0x1 /end MEASUREMENT
/begin MEASUREMENT lv_chk_fuc_close "filler cap close" UBYTE _CNV_S_2_RANGE__0___1_CM 1 100. 0. 1. DISPLAY_IDENTIFIER LV_CHK_FUC_CLOSE ECU_ADDRESS 0xd0003e21 BIT_MASK 0x1 /end MEASUREMENT
/begin MEASUREMENT lv_chk_fuc_open "filler cap open" UBYTE _CNV_S_2_RANGE__0___1_CM 1 100. 0. 1. DISPLAY_IDENTIFIER LV_CHK_FUC_OPEN ECU_ADDRESS 0xd0003e26 BIT_MASK 0x1 /end MEASUREMENT
/begin MEASUREMENT lv_chk_fuc_end "test filler cap ended" UBYTE _CNV_S_2_RANGE__0___1_CM 1 100. 0. 1. DISPLAY_IDENTIFIER LV_CHK_FUC_END ECU_ADDRESS 0xd0003e22 BIT_MASK 0x1 /end MEASUREMENT
/begin MEASUREMENT lv_t_vs_chk_fuc_open_can "min. vehicle speed for control cfc lamp reached" UBYTE _CNV_S_2_RANGE__0___1_CM 1 100. 0. 1. DISPLAY_IDENTIFIER LV_T_VS_CHK_FUC_OPEN_CAN ECU_ADDRESS 0xc000020c BIT_MASK 0x1 /end MEASUREMENT
/begin MEASUREMENT lv_t_vs_chk_fuc_open_max "recognized vehicle stops" UBYTE _CNV_S_2_RANGE__0___1_CM 1 100. 0. 1. DISPLAY_IDENTIFIER LV_T_VS_CHK_FUC_OPEN_MAX ECU_ADDRESS 0xc000020d BIT_MASK 0x1 /end MEASUREMENT
/begin MEASUREMENT lv_chk_fuc_open_act "set check filler cap lamp was already set" UBYTE _CNV_S_2_RANGE__0___1_CM 1 100. 0. 1. DISPLAY_IDENTIFIER LV_CHK_FUC_OPEN_ACT ECU_ADDRESS 0xd0003e27 BIT_MASK 0x1 /end MEASUREMENT
/begin MEASUREMENT lv_rep_chk_fuc "healing test enabled" UBYTE _CNV_S_2_RANGE__0___1_CM 1 100. 0. 1. DISPLAY_IDENTIFIER LV_REP_CHK_FUC ECU_ADDRESS 0xd0003e28 BIT_MASK 0x1 /end MEASUREMENT
/begin MEASUREMENT lv_chk_fuc_open_can "set check filler cap lampin the ICL" UBYTE _CNV_S_2_RANGE__0___1_CM 1 100. 0. 1. DISPLAY_IDENTIFIER LV_CHK_FUC_OPEN_CAN ECU_ADDRESS 0xd0003e23 BIT_MASK 0x1 /end MEASUREMENT
/begin MEASUREMENT lv_err_chk_fuc "error flag check filler cap (open filler cap)" UBYTE _CNV_S_2_RANGE__0___1_CM 1 100. 0. 1. DISPLAY_IDENTIFIER LV_ERR_CHK_FUC ECU_ADDRESS 0xd0003439 BIT_MASK 0x1 /end MEASUREMENT
/begin MEASUREMENT ctr_chk_fuc_open "number of tests cfc with result filler cap open" UBYTE _CNV_A_R_LINEAR_____0_CM 1 100. 0. 255. DISPLAY_IDENTIFIER CTR_CHK_FUC_OPEN ECU_ADDRESS 0xd0003e25 FORMAT "%3.0" /end MEASUREMENT
/begin CHARACTERISTIC lc_cod_chk_fuc "calibration codebyte for check filler cap test" VALUE 0xa1029d0f _REC_VAL_20_u1 255. _CNV_A_R_LINEAR_____0_CM 0. 255. DISPLAY_IDENTIFIER LC_COD_CHK_FUC FORMAT "%3.0" /end CHARACTERISTIC
/begin CHARACTERISTIC c_vs_ena_chk_fuc_open_max "max. vehicle speed to enable cfc test" VALUE 0xa1029c92 _REC_VAL_20_u1 255. _CNV_A_R_LINEAR_____6_CM 0. 255. DISPLAY_IDENTIFIER C_VS_ENA_CHK_FUC_OPEN_MAX FORMAT "%3.0" /end CHARACTERISTIC
/begin CHARACTERISTIC c_vs_delta_chk_fuc_max "max. difference between two consecutive VS" VALUE 0xa1029c6a _REC_VAL_20_u1 255. _CNV_A_R_LINEAR_____6_CM 0. 255. DISPLAY_IDENTIFIER C_VS_DELTA_CHK_FUC_MAX FORMAT "%3.0" /end CHARACTERISTIC
/begin CHARACTERISTIC c_ftl_delta_chk_fuc_max "max. difference between two consecutive FTL" VALUE 0xa10293ef _REC_VAL_20_u1 126. _CNV_A_R_LINEAR_____76_CM 0. 126. DISPLAY_IDENTIFIER C_FTL_DELTA_CHK_FUC_MAX FORMAT "%3.0" /end CHARACTERISTIC
/begin CHARACTERISTIC c_t_ast_dc_chk_fuc "threshold for AST to detect a DC" VALUE 0xa10297fc _REC_VAL_20_u2 6553.5 _CNV_A_R_LINEAR_____4_CM 0. 6553.5 DISPLAY_IDENTIFIER C_T_AST_DC_CHK_FUC FORMAT "%5.1" /end CHARACTERISTIC
/begin CHARACTERISTIC c_ctr_dc_ena_chk_fuc_max "threshold for number of DC since CFC request" VALUE 0xa102925a _REC_VAL_20_u1 255. _CNV_A_R_LINEAR_____0_CM 0. 255. DISPLAY_IDENTIFIER C_CTR_DC_ENA_CHK_FUC_MAX FORMAT "%3.0" /end CHARACTERISTIC
/begin CHARACTERISTIC c_ctr_chk_fuc_open_max "threshold for number of tests cfc with result filler cap open" VALUE 0xa102924e _REC_VAL_20_u1 255. _CNV_A_R_LINEAR_____0_CM 0. 255. DISPLAY_IDENTIFIER C_CTR_CHK_FUC_OPEN_MAX FORMAT "%3.0" /end CHARACTERISTIC
/begin CHARACTERISTIC c_vs_chk_fuc_open_can_min "minimum vehicle speed for setting cfc lamp" VALUE 0xa1029c67 _REC_VAL_20_u1 255. _CNV_A_R_LINEAR_____6_CM 0. 255. DISPLAY_IDENTIFIER C_VS_CHK_FUC_OPEN_CAN_MIN FORMAT "%3.0" /end CHARACTERISTIC
/begin CHARACTERISTIC c_vs_chk_fuc_open_max "maximum vehicle speed for setting the healing" VALUE 0xa1029c68 _REC_VAL_20_u1 255. _CNV_A_R_LINEAR_____6_CM 0. 255. DISPLAY_IDENTIFIER C_VS_CHK_FUC_OPEN_MAX FORMAT "%3.0" /end CHARACTERISTIC
/begin CHARACTERISTIC c_t_vs_chk_fuc_open_can_min "maximum time for vehicle speed higher than threshold" VALUE 0xa10299a6 _REC_VAL_20_u2 6553.5 _CNV_A_R_LINEAR_____4_CM 0. 6553.5 DISPLAY_IDENTIFIER C_T_VS_CHK_FUC_OPEN_CAN_MIN FORMAT "%6.1" /end CHARACTERISTIC
/begin CHARACTERISTIC c_t_vs_chk_fuc_open_min "maximum time for vehicle speed higher than threshold" VALUE 0xa10299a8 _REC_VAL_20_u2 6553.5 _CNV_A_R_LINEAR_____4_CM 0. 6553.5 DISPLAY_IDENTIFIER C_T_VS_CHK_FUC_OPEN_MIN FORMAT "%6.1" /end CHARACTERISTIC
/begin CHARACTERISTIC c_t_chk_fuc_open_can "duration of setting the cfc lamp" VALUE 0xa102981c _REC_VAL_20_u2 6553.5 _CNV_A_R_LINEAR_____4_CM 0. 6553.5 DISPLAY_IDENTIFIER C_T_CHK_FUC_OPEN_CAN FORMAT "%6.1" /end CHARACTERISTIC
/begin CHARACTERISTIC c_vs_ena_chk_fuc_open_min "min. vehicle speed to enable cfc test" VALUE 0xa1029c93 _REC_VAL_20_u1 255. _CNV_A_R_LINEAR_____6_CM 0. 255. DISPLAY_IDENTIFIER C_VS_ENA_CHK_FUC_OPEN_MIN FORMAT "%3.0" /end CHARACTERISTIC
/begin CHARACTERISTIC c_amp_chk_fuc_max "max. delta ampient pressure for check filler cap" VALUE 0xa102918a _REC_VAL_20_u2 5434. _CNV_A_R_LINEAR_____26_CM 0. 5434. DISPLAY_IDENTIFIER C_AMP_CHK_FUC_MAX FORMAT "%7.2" /end CHARACTERISTIC
/begin MEASUREMENT ctr_dc_ena_chk_fuc "number of DC since CFC request" UBYTE _CNV_A_R_LINEAR_____0_CM 1 100. 0. 255. DISPLAY_IDENTIFIER CTR_DC_ENA_CHK_FUC ECU_ADDRESS 0xd0003e24 FORMAT "%3.0" /end MEASUREMENT
/begin MEASUREMENT amp_chk_fuc "" UWORD _CNV_A_R_LINEAR_____26_CM 1 100. 0. 5434. DISPLAY_IDENTIFIER AMP_CHK_FUC ECU_ADDRESS 0xc000020a FORMAT "%7.2" /end MEASUREMENT
/begin AXIS_PTS ldpm_opm_req "" 0xa1022198 opm_req _REC_AXS_20_u1 8. _CNV_A_R_LINEAR_____0_CM 8 0. 8. FORMAT "%1.0" /end AXIS_PTS
/begin AXIS_PTS ldpm_opm_av "" 0xa102218c opm_av _REC_AXS_20_u1 8. _CNV_A_R_LINEAR_____0_CM 8 0. 8. FORMAT "%1.0" /end AXIS_PTS
/begin MEASUREMENT load_clc "Calculated load" UBYTE _CNV_A_R_LINEAR_____5_CM 1 100. 0. 99.609375 DISPLAY_IDENTIFIER LOAD_CLC ECU_ADDRESS 0xd0003543 FORMAT "%4.1" /end MEASUREMENT
/begin AXIS_PTS ldp_amp_ip_load_clc_amp "" 0xa1003860 amp _REC_AXS_20_u2 5434. _CNV_A_R_LINEAR_____26_CM 6 0. 5434. FORMAT "%7.2" /end AXIS_PTS
/begin AXIS_PTS ldp_n_32_ip_load_clc "" 0xa1003890 n_32 _REC_AXS_20_u1 8160. _CNV_A_R_LINEAR_____9_CM 8 0. 8160. FORMAT "%4.0" /end AXIS_PTS
/begin AXIS_PTS ldp_maf_ip_load_clc "" 0xa100387c maf _REC_AXS_20_u2 1389. _CNV_A_R_LINEAR_____108_CM 8 0. 1389. FORMAT "%7.2" /end AXIS_PTS
/begin CHARACTERISTIC ip_load_clc_amp__amp "Atmospheric pressure ratio" CURVE 0xa10051b4 _REC_CUR_20_u1_u2 1.99220002 _CNV_A_R_LINEAR_____97_CM 0. 1.99220002 DISPLAY_IDENTIFIER IP_LOAD_CLC_AMP__AMP FORMAT "%5.3"
 /begin AXIS_DESCR COM_AXIS amp _CNV_A_R_LINEAR_____26_CM 6 0. 5434. FORMAT "%7.2" AXIS_PTS_REF ldp_amp_ip_load_clc_amp /end AXIS_DESCR
/end CHARACTERISTIC
/begin CHARACTERISTIC ip_load_clc__n_32__maf "Airflow ratio" MAP 0xa1005174 _REC_MAP_20_u1_u1_u2 0.99609375 _CNV_A_R_LINEAR_____27_CM 0. 0.99609375 DISPLAY_IDENTIFIER IP_LOAD_CLC__N_32__MAF FORMAT "%5.3"
 /begin AXIS_DESCR COM_AXIS n_32 _CNV_A_R_LINEAR_____9_CM 8 0. 8160. FORMAT "%4.0" AXIS_PTS_REF ldp_n_32_ip_load_clc /end AXIS_DESCR
 /begin AXIS_DESCR COM_AXIS maf _CNV_A_R_LINEAR_____108_CM 8 0. 1389. FORMAT "%7.2" AXIS_PTS_REF ldp_maf_ip_load_clc /end AXIS_DESCR
/end CHARACTERISTIC
/begin CHARACTERISTIC c_abc_dec_lam_cyl_sel_err "CILC - monitoring decrement constant of anti-bounce-counter" VALUE 0xa102904b _REC_VAL_20_u1 255. _CNV_A_R_LINEAR_____0_CM 0. 255. DISPLAY_IDENTIFIER C_ABC_DEC_LAM_CYL_SEL_ERR FORMAT "%3.0" /end CHARACTERISTIC
/begin CHARACTERISTIC c_abc_inc_lam_cyl_sel_err "CILC - monitoring increment constant of anti-bounce-counter" VALUE 0xa1029093 _REC_VAL_20_u1 255. _CNV_A_R_LINEAR_____0_CM 0. 255. DISPLAY_IDENTIFIER C_ABC_INC_LAM_CYL_SEL_ERR FORMAT "%3.0" /end CHARACTERISTIC
/begin CHARACTERISTIC c_abc_max_lam_cyl_sel_err "maximum value of CILC-monitoring anti-bounce-counter" VALUE 0xa102911e _REC_VAL_20_u1 254. _CNV_A_R_LINEAR_____0_CM 1. 255. DISPLAY_IDENTIFIER C_ABC_MAX_LAM_CYL_SEL_ERR FORMAT "%3.0" /end CHARACTERISTIC
/begin CHARACTERISTIC c_t_sum_thd_lam_cyl_sel_lim "timer threshold for detection of a valid diagnosed CILC outermost limitation" VALUE 0xa102996e _REC_VAL_20_u2 6553.400000000001 _CNV_A_R_LINEAR_____4_CM 0.1 6553.5 DISPLAY_IDENTIFIER C_T_SUM_THD_LAM_CYL_SEL_LIM FORMAT "%6.1" /end CHARACTERISTIC
/begin CHARACTERISTIC lc_abc_lam_cyl_sel_err_rst "anti-bounce-counter reset" VALUE 0xa1029ce0 _REC_VAL_20_u1 1. _CNV_A_R_LINEAR_____0_CM 0. 1. DISPLAY_IDENTIFIER LC_ABC_LAM_CYL_SEL_ERR_RST FORMAT "%1.0" /end CHARACTERISTIC
/begin MEASUREMENT cyl_diag_1.abc_lam_cyl_sel_err "Anti-bounce-counter for detected CILC errors up to current driving cycle" UBYTE _CNV_A_R_LINEAR_____0_CM 1 100. 0. 255. DISPLAY_IDENTIFIER ABC_LAM_CYL_SEL_ERR_1 ECU_ADDRESS 0xd0004f4a FORMAT "%3.0" /end MEASUREMENT
/begin MEASUREMENT cyl_diag_1.lv_err_lam_cyl_sel "CILC error detected over several driving cycles" UBYTE _CNV_S_2_RANGE__0___1_CM 1 100. 0. 1. DISPLAY_IDENTIFIER LV_ERR_LAM_CYL_SEL_1 ECU_ADDRESS 0xd0004f4b /end MEASUREMENT
/begin MEASUREMENT cyl_diag_1.lv_t_sum_thd_lam_cyl_lim "Time interval of detected CILC outermost limitation passed" UBYTE _CNV_S_2_RANGE__0___1_CM 1 100. 0. 1. DISPLAY_IDENTIFIER LV_T_SUM_THD_LAM_CYL_LIM_1 ECU_ADDRESS 0xd0004f4c /end MEASUREMENT
/begin MEASUREMENT cyl_diag_1.t_sum_lam_cyl_sel_lim "Timer for detected CILC outermost limitation" UWORD _CNV_A_R_LINEAR_____4_CM 1 100. 0. 6553.5 DISPLAY_IDENTIFIER T_SUM_LAM_CYL_SEL_LIM_1 ECU_ADDRESS 0xd0004f48 FORMAT "%6.1" /end MEASUREMENT
/begin MEASUREMENT cyl_diag_2.abc_lam_cyl_sel_err "Anti-bounce-counter for detected CILC errors up to current driving cycle" UBYTE _CNV_A_R_LINEAR_____0_CM 1 100. 0. 255. DISPLAY_IDENTIFIER ABC_LAM_CYL_SEL_ERR_2 ECU_ADDRESS 0xd0004f50 FORMAT "%3.0" /end MEASUREMENT
/begin MEASUREMENT cyl_diag_2.lv_err_lam_cyl_sel "CILC error detected over several driving cycles" UBYTE _CNV_S_2_RANGE__0___1_CM 1 100. 0. 1. DISPLAY_IDENTIFIER LV_ERR_LAM_CYL_SEL_2 ECU_ADDRESS 0xd0004f51 /end MEASUREMENT
/begin MEASUREMENT cyl_diag_2.lv_t_sum_thd_lam_cyl_lim "Time interval of detected CILC outermost limitation passed" UBYTE _CNV_S_2_RANGE__0___1_CM 1 100. 0. 1. DISPLAY_IDENTIFIER LV_T_SUM_THD_LAM_CYL_LIM_2 ECU_ADDRESS 0xd0004f52 /end MEASUREMENT
/begin MEASUREMENT cyl_diag_2.t_sum_lam_cyl_sel_lim "Timer for detected CILC outermost limitation" UWORD _CNV_A_R_LINEAR_____4_CM 1 100. 0. 6553.5 DISPLAY_IDENTIFIER T_SUM_LAM_CYL_SEL_LIM_2 ECU_ADDRESS 0xd0004f4e FORMAT "%6.1" /end MEASUREMENT
/begin CHARACTERISTIC lc_req_fsd_eol "Switch for external adjustment of  fuel-system diagnosis" VALUE 0xa1029dbf _REC_VAL_20_u1 1. _CNV_S_2_RANGE__0___1_CM 0. 1. DISPLAY_IDENTIFIER LC_REQ_FSD_EOL /end CHARACTERISTIC
/begin MEASUREMENT lv_inh_diag_rbm_dmtl "Flag to inhibit DMTL diagnosis function if there is a OBD failure" UBYTE _CNV_S_2_RANGE__0___1_CM 1 100. 0. 1. DISPLAY_IDENTIFIER LV_INH_DIAG_RBM_DMTL ECU_ADDRESS 0xd0003e3c BIT_MASK 0x1 /end MEASUREMENT
/begin MEASUREMENT lv_chk_dmtl_cur_dmtl_vld_virt "Virtuel check of component concerning valid pump current" UBYTE _CNV_S_2_RANGE__0___1_CM 1 100. 0. 1. DISPLAY_IDENTIFIER LV_CHK_DMTL_CUR_DMTL_VLD_VIRT ECU_ADDRESS 0xd0003e3e BIT_MASK 0x1 /end MEASUREMENT
/begin MEASUREMENT lv_det_no_rough_leak "Condition leak check done and no rough leak detected" UBYTE _CNV_S_2_RANGE__0___1_CM 1 100. 0. 1. DISPLAY_IDENTIFIER LV_DET_NO_ROUGH_LEAK ECU_ADDRESS 0xd0003e41 BIT_MASK 0x1 /end MEASUREMENT
/begin MEASUREMENT t_ast_dmtl_rbm "Cumulative time since engine start for incrementation of the evaporative system monitor denominator" UWORD _CNV_A_R_LINEAR_____4_CM 1 100. 0. 6553.5 DISPLAY_IDENTIFIER T_AST_DMTL_RBM ECU_ADDRESS 0xd000526c FORMAT "%6.1" /end MEASUREMENT
/begin MEASUREMENT state_rbm_dmtlm "Interface of DMTLM  monitor with the Rate_based Monitoring statistics Bit 0, Bit1, Bit2" UBYTE _CNV_A_R_LINEAR_____0_CM 1 100. 0. 7. DISPLAY_IDENTIFIER STATE_RBM_DMTLM ECU_ADDRESS 0xd0003e42 FORMAT "%2.0" /end MEASUREMENT
/begin MEASUREMENT state_rbm_rough_leak "Interface of DMTLM  monitor with the Rate_based Monitoring statistics Bit 0, Bit1, Bit2" UBYTE _CNV_A_R_LINEAR_____0_CM 1 100. 0. 7. DISPLAY_IDENTIFIER STATE_RBM_ROUGH_LEAK ECU_ADDRESS 0xd0003e43 FORMAT "%2.0" /end MEASUREMENT
/begin MEASUREMENT state_rbm_small_leak "Interface of DMTLM  monitor with the Rate_based Monitoring statistics Bit 0, Bit1, Bit2" UBYTE _CNV_A_R_LINEAR_____0_CM 1 100. 0. 7. DISPLAY_IDENTIFIER STATE_RBM_SMALL_LEAK ECU_ADDRESS 0xd0003e44 FORMAT "%2.0" /end MEASUREMENT
/begin CHARACTERISTIC c_t_dly_ftl_dmtl_val "Delay time for a valid FTL for DML_RBM" VALUE 0xa1029858 _REC_VAL_20_u2 6553.5 _CNV_A_R_LINEAR_____4_CM 0. 6553.5 DISPLAY_IDENTIFIER C_T_DLY_FTL_DMTL_VAL FORMAT "%6.1" /end CHARACTERISTIC
/begin CHARACTERISTIC c_t_es_dmtl_diag_max "Maximum time for a DMTL diagnosis" VALUE 0xa1029890 _REC_VAL_20_u2 65535. _CNV_A_R_LINEAR_____77_CM 0. 65535. DISPLAY_IDENTIFIER C_T_ES_DMTL_DIAG_MAX FORMAT "%5.0" /end CHARACTERISTIC
/begin CHARACTERISTIC c_tam_max_dmtl_rbm "Maximum ambient temperature threshold for DMTL_RBM" VALUE 0xa10299bd _REC_VAL_20_u1 190.5 _CNV_A_R_LINEAR_____16_CM -48. 142.5 DISPLAY_IDENTIFIER C_TAM_MAX_DMTL_RBM FORMAT "%6.2" /end CHARACTERISTIC
/begin CHARACTERISTIC c_tam_st_hys_dmtl_rbm "Ambient temperature hysteresis for DMTL_RBM" VALUE 0xa10299c6 _REC_VAL_20_s1 191.25 _CNV_A_R_LINEAR_____24_CM -96. 95.25 DISPLAY_IDENTIFIER C_TAM_ST_HYS_DMTL_RBM FORMAT "%6.2" /end CHARACTERISTIC
/begin CHARACTERISTIC c_tco_st_min_dmtl_rbm "Minimum engine start temperature threshold for DMTL_RBM" VALUE 0xa10299ef _REC_VAL_20_u1 190.5 _CNV_A_R_LINEAR_____16_CM -48. 142.5 DISPLAY_IDENTIFIER C_TCO_ST_MIN_DMTL_RBM FORMAT "%6.2" /end CHARACTERISTIC
/begin CHARACTERISTIC c_tco_st_max_dmtl_rbm "Maximum engine start temperature threshold for DMTL_RBM" VALUE 0xa10299ee _REC_VAL_20_u1 190.5 _CNV_A_R_LINEAR_____16_CM -48. 142.5 DISPLAY_IDENTIFIER C_TCO_ST_MAX_DMTL_RBM FORMAT "%6.2" /end CHARACTERISTIC
/begin MEASUREMENT ctr_cnl_small_leak_mes_virt "Virtuel number of aborted miniature leak measurements dur to current fluctuations" UBYTE _CNV_A_R_LINEAR_____0_CM 1 100. 0. 255. DISPLAY_IDENTIFIER CTR_CNL_SMALL_LEAK_MES_VIRT ECU_ADDRESS 0xd0003e45 FORMAT "%3.0" /end MEASUREMENT
/begin CHARACTERISTIC c_t_ast_dmtl_rbm "Minimum comulative time since engine start for incrementation of the evaporative system monitor denominator" VALUE 0xa1029802 _REC_VAL_20_u2 6553.5 _CNV_A_R_LINEAR_____4_CM 0. 6553.5 DISPLAY_IDENTIFIER C_T_AST_DMTL_RBM FORMAT "%6.1" /end CHARACTERISTIC
/begin MEASUREMENT lv_ctr_cnl_small_leak_virt "Virtuel aborted miniature leak measurements due to current fluctuations exceeded" UBYTE _CNV_S_2_RANGE__0___1_CM 1 100. 0. 1. DISPLAY_IDENTIFIER LV_CTR_CNL_SMALL_LEAK_VIRT ECU_ADDRESS 0xd0003e3d BIT_MASK 0x1 /end MEASUREMENT
/begin MEASUREMENT lv_det_small_leak "Stored bit, that in the last DC small leak was recognized " UBYTE _CNV_S_2_RANGE__0___1_CM 1 100. 0. 1. DISPLAY_IDENTIFIER LV_DET_SMALL_LEAK ECU_ADDRESS 0xd0003e3f BIT_MASK 0x1 /end MEASUREMENT
/begin MEASUREMENT lv_det_no_small_leak "Stored bit, that in the last DC no small leak was recognized" UBYTE _CNV_S_2_RANGE__0___1_CM 1 100. 0. 1. DISPLAY_IDENTIFIER LV_DET_NO_SMALL_LEAK ECU_ADDRESS 0xd0003e40 BIT_MASK 0x1 /end MEASUREMENT
/begin CHARACTERISTIC c_tam_min_dmtl_rbm "Minimum ambient temperature threshold for DMTL_RBM" VALUE 0xa10299c0 _REC_VAL_20_u1 190.5 _CNV_A_R_LINEAR_____16_CM -48. 142.5 DISPLAY_IDENTIFIER C_TAM_MIN_DMTL_RBM FORMAT "%6.2" /end CHARACTERISTIC
/begin CHARACTERISTIC c_cod_dmtl_rbm "configuration byte for DMTL RBM" VALUE 0xa10291c2 _REC_VAL_20_u1 255. _CNV_A_R_LINEAR_____0_CM 0. 255. DISPLAY_IDENTIFIER C_COD_DMTL_RBM FORMAT "%3.0" /end CHARACTERISTIC
/begin MEASUREMENT lv_err_amp_plaus "Boolean for detected error Ambient pressure plausibility diagnosis" UBYTE _CNV_S_2_RANGE__0___1_CM 1 100. 0. 1. DISPLAY_IDENTIFIER LV_ERR_AMP_PLAUS ECU_ADDRESS 0xd00033be BIT_MASK 0x1 /end MEASUREMENT
/begin MEASUREMENT amp_mmv_plaus "Mean moving value of AMP_MES" UWORD _CNV_A_R_LINEAR_____26_CM 1 100. 0. 5434. DISPLAY_IDENTIFIER AMP_MMV_PLAUS ECU_ADDRESS 0xc000007c FORMAT "%7.2" /end MEASUREMENT
/begin CHARACTERISTIC c_amp_plaus_dif_err "Maximum allowed offset to detect a unplausible AMP_MES" VALUE 0xa1029198 _REC_VAL_20_u2 5434. _CNV_A_R_LINEAR_____26_CM 0. 5434. DISPLAY_IDENTIFIER C_AMP_PLAUS_DIF_ERR FORMAT "%7.2" /end CHARACTERISTIC
/begin AXIS_PTS ldp_vs_ip_clrc_amp_plaus "" 0xa10218ae vs _REC_AXS_20_u1 255. _CNV_A_R_LINEAR_____6_CM 4 0. 255. FORMAT "%3.0" /end AXIS_PTS
/begin CHARACTERISTIC ip_clrc_amp_plaus "Filter constant for mean moving calculation of AMP_MES" CURVE 0xa1023088 _REC_CUR_20_u2_u1 0.9999847412109381 _CNV_A_R_LINEAR_____68_CM 0. 0.9999847412109381 DISPLAY_IDENTIFIER IP_CLRC_AMP_PLAUS FORMAT "%7.6"
 /begin AXIS_DESCR COM_AXIS vs _CNV_A_R_LINEAR_____6_CM 4 0. 255. FORMAT "%3.0" AXIS_PTS_REF ldp_vs_ip_clrc_amp_plaus /end AXIS_DESCR
/end CHARACTERISTIC
/begin COMPU_METHOD _CNV_A_R_LINEAR_____0_CM "" RAT_FUNC "%6.3" "-" COEFFS 0 1. 0. 0 0 1 /end COMPU_METHOD
/begin COMPU_METHOD _CNV_S_2_RANGE__0___1_CM "" TAB_VERB "%6.3" "-" COMPU_TAB_REF _CNV_S_2_RANGE__0___1 /end COMPU_METHOD
/begin COMPU_VTAB _CNV_S_2_RANGE__0___1 "" TAB_VERB 2 0 "0" 1 "1" /end COMPU_VTAB
/begin COMPU_METHOD _CNV_A_R_LINEAR_____2_CM "" RAT_FUNC "%6.3" "V" COEFFS 0 204.8 0. 0 0 1 /end COMPU_METHOD
/begin COMPU_METHOD _CNV_A_R_LINEAR_____3_CM "" RAT_FUNC "%6.3" "s" COEFFS 0 100. 0. 0 0 1 /end COMPU_METHOD
/begin COMPU_METHOD _CNV_A_R_LINEAR_____4_CM "" RAT_FUNC "%6.3" "s" COEFFS 0 10. 0. 0 0 1 /end COMPU_METHOD
/begin COMPU_METHOD _CNV_A_R_LINEAR_____5_CM "" RAT_FUNC "%6.3" "%" COEFFS 0 2.56 0. 0 0 1 /end COMPU_METHOD
/begin COMPU_METHOD _CNV_A_R_LINEAR_____6_CM "" RAT_FUNC "%6.3" "km/h" COEFFS 0 1. 0. 0 0 1 /end COMPU_METHOD
/begin COMPU_METHOD _CNV_A_R_LINEAR_____8_CM "" RAT_FUNC "%6.3" "-" COEFFS 0 32767.99999999992 0. 0 0 1 /end COMPU_METHOD
/begin COMPU_METHOD _CNV_A_R_LINEAR_____9_CM "" RAT_FUNC "%6.3" "rpm" COEFFS 0 3.125e-002 0. 0 0 1 /end COMPU_METHOD
/begin COMPU_METHOD _CNV_A_R_LINEAR_____13_CM "" RAT_FUNC "%6.3" "rpm" COEFFS 0 1. 0. 0 0 1 /end COMPU_METHOD
/begin COMPU_METHOD _CNV_A_R_LINEAR_____14_CM "" RAT_FUNC "%6.3" "mg/stk" COEFFS 0 0.183585313174946 0. 0 0 1 /end COMPU_METHOD
/begin COMPU_METHOD _CNV_A_R_LINEAR_____16_CM "" RAT_FUNC "%6.3" "°C" COEFFS 0 1.333333333333333 64. 0 0 1 /end COMPU_METHOD
/begin COMPU_METHOD _CNV_A_R_LINEAR_____17_CM "" RAT_FUNC "%6.3" "-" COEFFS 0 255.9983911655618 0. 0 0 1 /end COMPU_METHOD
/begin COMPU_METHOD _CNV_A_R_LINEAR_____24_CM "" RAT_FUNC "%6.3" "°C" COEFFS 0 1.333333333333333 0. 0 0 1 /end COMPU_METHOD
/begin COMPU_METHOD _CNV_A_R_LINEAR_____25_CM "" RAT_FUNC "%6.3" "°C" COEFFS 0 1. 40. 0 0 1 /end COMPU_METHOD
/begin COMPU_METHOD _CNV_A_R_LINEAR_____26_CM "" RAT_FUNC "%6.3" "hPa" COEFFS 0 12.06017666543982 0. 0 0 1 /end COMPU_METHOD
/begin COMPU_METHOD _CNV_A_R_LINEAR_____27_CM "" RAT_FUNC "%6.3" "-" COEFFS 0 256. 0. 0 0 1 /end COMPU_METHOD
/begin COMPU_METHOD _CNV_A_R_LINEAR_____28_CM "" RAT_FUNC "%6.3" "rpm/s" COEFFS 0 3.125e-002 128. 0 0 1 /end COMPU_METHOD
/begin COMPU_METHOD _CNV_A_R_LINEAR_____29_CM "" RAT_FUNC "%6.3" "rpm/s" COEFFS 0 3.125e-002 0. 0 0 1 /end COMPU_METHOD
/begin COMPU_METHOD _CNV_A_R_LINEAR_____30_CM "" RAT_FUNC "%6.3" "Nm" COEFFS 0 32. 0. 0 0 1 /end COMPU_METHOD
/begin COMPU_METHOD _CNV_A_R_LINEAR_____35_CM "" RAT_FUNC "%6.3" "s" COEFFS 0 1. 0. 0 0 1 /end COMPU_METHOD
/begin COMPU_METHOD _CNV_A_R_LINEAR_____36_CM "" RAT_FUNC "%6.3" "V" COEFFS 0 9.807692307692308 0. 0 0 1 /end COMPU_METHOD
/begin COMPU_METHOD _CNV_A_R_LINEAR_____50_CM "" RAT_FUNC "%6.3" "" COEFFS 0 1. 0. 0 0 1 /end COMPU_METHOD
/begin COMPU_METHOD _CNV_A_R_LINEAR_____65_CM "" RAT_FUNC "%6.3" "Nm" COEFFS 0 32. 32768. 0 0 1 /end COMPU_METHOD
/begin COMPU_METHOD _CNV_A_R_LINEAR_____66_CM "" RAT_FUNC "%6.3" "km/h" COEFFS 0 128.0000018750286 0. 0 0 1 /end COMPU_METHOD
/begin COMPU_METHOD _CNV_A_R_LINEAR_____68_CM "" RAT_FUNC "%6.3" "-" COEFFS 0 65535.99999999996 0. 0 0 1 /end COMPU_METHOD
/begin COMPU_METHOD _CNV_A_R_LINEAR_____71_CM "" RAT_FUNC "%6.3" "" COEFFS 0 256. 0. 0 0 1 /end COMPU_METHOD
/begin COMPU_METHOD _CNV_S_2_RANGE______75_CM "" TAB_VERB "%6.3" "" COMPU_TAB_REF _CNV_S_2_RANGE______75 /end COMPU_METHOD
/begin COMPU_VTAB _CNV_S_2_RANGE______75 "" TAB_VERB 2 0 "0" 1 "1" /end COMPU_VTAB
/begin COMPU_METHOD _CNV_A_R_LINEAR_____76_CM "" RAT_FUNC "%6.3" "l" COEFFS 0 1. 0. 0 0 1 /end COMPU_METHOD
/begin COMPU_METHOD _CNV_A_R_LINEAR_____77_CM "" RAT_FUNC "%6.3" "min" COEFFS 0 1. 0. 0 0 1 /end COMPU_METHOD
/begin COMPU_METHOD _CNV_A_R_LINEAR_____97_CM "" RAT_FUNC "%6.3" "-" COEFFS 0 127.9991955827809 0. 0 0 1 /end COMPU_METHOD
/begin COMPU_METHOD _CNV_A_R_LINEAR_____100_CM "" RAT_FUNC "%6.3" "-" COEFFS 0 128. 0. 0 0 1 /end COMPU_METHOD
/begin COMPU_METHOD _CNV_A_R_LINEAR_____107_CM "" RAT_FUNC "%6.3" "s" COEFFS 0 50. 0. 0 0 1 /end COMPU_METHOD
/begin COMPU_METHOD _CNV_A_R_LINEAR_____108_CM "" RAT_FUNC "%6.3" "mg/stk" COEFFS 0 47.18142548596112 0. 0 0 1 /end COMPU_METHOD
/begin COMPU_METHOD _CNV_A_R_LINEAR_____110_CM "" RAT_FUNC "%6.3" "%" COEFFS 0 655.3599999999997 -1.455191522836685e-011 0 0 1 /end COMPU_METHOD
/begin COMPU_METHOD _CNV_A_R_LINEAR_____122_CM "" RAT_FUNC "%6.3" "-" COEFFS 0 1024. 0. 0 0 1 /end COMPU_METHOD
/begin COMPU_METHOD _CNV_A_R_LINEAR_____131_CM "" RAT_FUNC "%6.3" "hPa" COEFFS 0 12.05960017121163 0. 0 0 1 /end COMPU_METHOD
/begin COMPU_METHOD _CNV_A_R_LINEAR_____132_CM "" RAT_FUNC "%6.3" "mA" COEFFS 0 163.8400395206126 7.904122518084478e-003 0 0 1 /end COMPU_METHOD
/begin COMPU_METHOD _CNV_A_R_LINEAR_____133_CM "" RAT_FUNC "%6.3" "mA" COEFFS 0 163.8375 0. 0 0 1 /end COMPU_METHOD
/begin COMPU_METHOD _CNV_A_R_LINEAR_____134_CM "" RAT_FUNC "%6.3" "l" COEFFS 0 15.25879531537405 0. 0 0 1 /end COMPU_METHOD
/begin COMPU_METHOD _CNV_A_R_LINEAR_____135_CM "" RAT_FUNC "%6.3" "l" COEFFS 0 15.26190476190476 0. 0 0 1 /end COMPU_METHOD
/begin COMPU_METHOD _CNV_A_R_LINEAR_____136_CM "" RAT_FUNC "%6.3" "ohm" COEFFS 0 5.1 0. 0 0 1 /end COMPU_METHOD
/begin COMPU_METHOD _CNV_A_R_LINEAR_____137_CM "" RAT_FUNC "%6.3" "h" COEFFS 0 35999.99999497086 0. 0 0 1 /end COMPU_METHOD
/begin COMPU_METHOD _CNV_S_13_STATE_DMTL_138_CM "" TAB_VERB "%6.3" "-" COMPU_TAB_REF _CNV_S_13_STATE_DMTL_138 /end COMPU_METHOD
/begin COMPU_VTAB _CNV_S_13_STATE_DMTL_138 "" TAB_VERB 13 0 "START" 1 "REF_LEAK_MES" 2 "ROUGH_LEAK_MES" 3 "ROUGH_LEAK_MES_LEN" 4 "ROUGH_LEAK_MES_END" 5 "SMALL_LEAK_MES" 6 "SMALL_LEAK_MES_LEN" 7 "2.REF_LEAK_MES" 8 "TANK_PROOFED" 9 "SMALL_LEAK" 10 "ROUGH_LEAK" 11 "MODULE_ERROR" 12 "END" /end COMPU_VTAB
/begin COMPU_METHOD _CNV_A_R_LINEAR_____139_CM "" RAT_FUNC "%6.3" "mA" COEFFS 0 10737418.2375 0. 0 0 1 /end COMPU_METHOD
/begin COMPU_METHOD _CNV_A_R_LINEAR_____140_CM "" RAT_FUNC "%6.3" "V" COEFFS 0 2510.769230769231 0. 0 0 1 /end COMPU_METHOD
/begin COMPU_METHOD _CNV_A_R_LINEAR_____141_CM "" RAT_FUNC "%6.3" "m" COEFFS 0 1. 0. 0 0 1 /end COMPU_METHOD
/begin COMPU_METHOD _CNV_A_R_LINEAR_____142_CM "" RAT_FUNC "%6.3" "V" COEFFS 0 2520.615410935313 0. 0 0 1 /end COMPU_METHOD
/begin COMPU_METHOD _CNV_A_R_LINEAR_____143_CM "" RAT_FUNC "%6.3" "m" COEFFS 0 65537. 0. 0 0 1 /end COMPU_METHOD
/begin COMPU_METHOD _CNV_A_R_LINEAR_____147_CM "" RAT_FUNC "%6.3" "kg/h" COEFFS 0 8192. 0. 0 0 1 /end COMPU_METHOD
/begin COMPU_METHOD _CNV_A_R_LINEAR_____148_CM "" RAT_FUNC "%6.3" "cyc" COEFFS 0 1. 0. 0 0 1 /end COMPU_METHOD
/begin COMPU_METHOD _CNV_A_R_LINEAR_____149_CM "" RAT_FUNC "%6.3" "kg/h" COEFFS 0 8191.874997772622 1. 0 0 1 /end COMPU_METHOD
/begin COMPU_METHOD _CNV_A_R_LINEAR_____150_CM "" RAT_FUNC "%6.3" "-" COEFFS 0 65535. 0. 0 0 1 /end COMPU_METHOD
/begin COMPU_METHOD _CNV_S_6_STATE_DIAG_151_CM "" TAB_VERB "%6.3" "-" COMPU_TAB_REF _CNV_S_6_STATE_DIAG_151 /end COMPU_METHOD
/begin COMPU_VTAB _CNV_S_6_STATE_DIAG_151 "" TAB_VERB 6 0 "STEP_INIT" 1 "STEP_1" 2 "STEP_2" 3 "STEP_3" 4 "CPS_RAMP" 5 "LOCK_STEP" /end COMPU_VTAB
/begin COMPU_METHOD _CNV_A_R_LINEAR_____172_CM "" RAT_FUNC "%6.3" "rpm" COEFFS 0 1. 32768. 0 0 1 /end COMPU_METHOD
/begin COMPU_METHOD _CNV_A_R_LINEAR_____175_CM "" RAT_FUNC "%6.3" "Nm" COEFFS 0 8191.999999679995 -1.280019205296412e-006 0 0 1 /end COMPU_METHOD
/begin COMPU_METHOD _CNV_S_3_STATE_P_D__176_CM "" TAB_VERB "%6.3" "" COMPU_TAB_REF _CNV_S_3_STATE_P_D__176 /end COMPU_METHOD
/begin COMPU_VTAB _CNV_S_3_STATE_P_D__176 "" TAB_VERB 3 0 "P_D_PASSIVE" 1 "P_D_NORMAL" 2 "RAMP_TO_ZERO" /end COMPU_VTAB
/begin COMPU_METHOD _CNV_S_4_STATE_I_IS_177_CM "" TAB_VERB "%6.3" "" COMPU_TAB_REF _CNV_S_4_STATE_I_IS_177 /end COMPU_METHOD
/begin COMPU_VTAB _CNV_S_4_STATE_I_IS_177 "" TAB_VERB 4 0 "I_PASSIVE" 1 "I_NORMAL" 2 "RAMP_TO_PAS" 3 "RAMP_TO_LIM" /end COMPU_VTAB
/begin COMPU_METHOD _CNV_A_R_LINEAR_____178_CM "" RAT_FUNC "%6.3" "-" COEFFS 0 65551.06000970239 0. 0 0 1 /end COMPU_METHOD
/begin COMPU_METHOD _CNV_A_R_LINEAR_____179_CM "" RAT_FUNC "%6.3" "Nm" COEFFS 0 8191.999999679995 32767.99999871998 0 0 1 /end COMPU_METHOD
/begin COMPU_METHOD _CNV_A_R_LINEAR_____180_CM "" RAT_FUNC "%6.3" "rpm" COEFFS 0 3.125e-002 128. 0 0 1 /end COMPU_METHOD
/begin COMPU_METHOD _CNV_S_5_STATE_REQ__182_CM "" TAB_VERB "%6.3" "" COMPU_TAB_REF _CNV_S_5_STATE_REQ__182 /end COMPU_METHOD
/begin COMPU_VTAB _CNV_S_5_STATE_REQ__182 "" TAB_VERB 5 0 "ISC_PASSIVE" 1 "AFTER_START" 2 "NORMAL" 3 "TRAILING_THR" 4 "PART_LOAD" /end COMPU_VTAB
/begin COMPU_METHOD _CNV_A_R_LINEAR_____183_CM "" RAT_FUNC "%6.3" "s" COEFFS 0 32. 0. 0 0 1 /end COMPU_METHOD
/begin COMPU_METHOD _CNV_A_R_LINEAR_____184_CM "" RAT_FUNC "%6.3" "-" COEFFS 0 32. 0. 0 0 1 /end COMPU_METHOD
/begin COMPU_METHOD _CNV_A_R_LINEAR_____185_CM "" RAT_FUNC "%6.3" "mm" COEFFS 0 1000. 0. 0 0 1 /end COMPU_METHOD
/begin COMPU_METHOD _CNV_A_R_LINEAR_____186_CM "" RAT_FUNC "%6.3" "hPa" COEFFS 0 25.6 32768. 0 0 1 /end COMPU_METHOD
/begin COMPU_METHOD _CNV_A_R_LINEAR_____225_CM "" RAT_FUNC "%6.3" "%" COEFFS 0 327.680000003584 32768.00000035841 0 0 1 /end COMPU_METHOD
/begin COMPU_METHOD _CNV_A_R_LINEAR_____244_CM "" RAT_FUNC "%6.3" "kg/h" COEFFS 0 256. 0. 0 0 1 /end COMPU_METHOD
/begin RECORD_LAYOUT _REC_VAL_20_u1 FNC_VALUES 1 UBYTE COLUMN_DIR DIRECT /end RECORD_LAYOUT
/begin RECORD_LAYOUT _REC_VAL_20_u2 FNC_VALUES 1 UWORD COLUMN_DIR DIRECT /end RECORD_LAYOUT
/begin RECORD_LAYOUT _REC_AXS_20_u1 NO_AXIS_PTS_X 1 UBYTE AXIS_PTS_X 2 UBYTE INDEX_INCR DIRECT /end RECORD_LAYOUT
/begin RECORD_LAYOUT _REC_CUR_20_u1_u1 FNC_VALUES 1 UBYTE COLUMN_DIR DIRECT /end RECORD_LAYOUT
/begin RECORD_LAYOUT _REC_VAL_20_s2 FNC_VALUES 1 SWORD COLUMN_DIR DIRECT /end RECORD_LAYOUT
/begin RECORD_LAYOUT _REC_MAP_20_u2_u2_u1 FNC_VALUES 1 UWORD COLUMN_DIR DIRECT /end RECORD_LAYOUT
/begin RECORD_LAYOUT _REC_AXS_20_u2 NO_AXIS_PTS_X 1 UWORD AXIS_PTS_X 2 UWORD INDEX_INCR DIRECT /end RECORD_LAYOUT
/begin RECORD_LAYOUT _REC_CUR_20_u2_u1 FNC_VALUES 1 UWORD COLUMN_DIR DIRECT /end RECORD_LAYOUT
/begin RECORD_LAYOUT _REC_CUR_20_u2_u2 FNC_VALUES 1 UWORD COLUMN_DIR DIRECT /end RECORD_LAYOUT
/begin RECORD_LAYOUT _REC_VAL_20_s1 FNC_VALUES 1 SBYTE COLUMN_DIR DIRECT /end RECORD_LAYOUT
/begin RECORD_LAYOUT _REC_MAP_20_u2_u1_u2 FNC_VALUES 1 UWORD COLUMN_DIR DIRECT /end RECORD_LAYOUT
/begin RECORD_LAYOUT _REC_CUR_20_u1_u2 FNC_VALUES 1 UBYTE COLUMN_DIR DIRECT /end RECORD_LAYOUT
/begin RECORD_LAYOUT _REC_MAP_20_u2_u2_u2 FNC_VALUES 1 UWORD COLUMN_DIR DIRECT /end RECORD_LAYOUT
/begin RECORD_LAYOUT _REC_MAP_20_u1_u2_u2 FNC_VALUES 1 UBYTE COLUMN_DIR DIRECT /end RECORD_LAYOUT
/begin RECORD_LAYOUT _REC_VAL_20_u4 FNC_VALUES 1 ULONG COLUMN_DIR DIRECT /end RECORD_LAYOUT
/begin RECORD_LAYOUT _REC_MAP_20_u1_u1_u1 FNC_VALUES 1 UBYTE COLUMN_DIR DIRECT /end RECORD_LAYOUT
/begin RECORD_LAYOUT _REC_MAP_20_u1_u1_u2 FNC_VALUES 1 UBYTE COLUMN_DIR DIRECT /end RECORD_LAYOUT
/begin FUNCTION ISC_Idle_speed_control "_Idle speed control"
 /begin DEF_CHARACTERISTIC c_t_ramp_lim_i_dt_is c_t_ramp_lim_p_d_dt_is c_t_ramp_lim_p_d_is c_tq_bol_i_is c_tq_tol_i_is lc_tq_dif_i_inh_as lc_tq_dif_p_d_inh_as lc_isc_inh lc_tq_add_i_inh_as id_fac_p_d_dt_is id_fac_p_d_dt_is_slow ip_fac_n_grd_is lc_tq_p_d_slow_inh_as lc_tq_p_d_fast_inh_as ip_fac_n_grd_is_slow ip_fac_t_ast_i_is_opm_1 c_t_ramp_lim_i_is lc_p_d_slow_fast_sel_ena c_crlc_n_grd c_nr_buf_n_grd_fil lc_n_grd_fil_p_d_swi lc_n_grd_fil_i_swi c_tq_isc_i_max_tq_drof c_tq_min_isc_tq_drof_slow c_tq_max_isc_tq_drof_fast c_tq_min_isc_tq_drof_fast c_tq_isc_i_min_tq_drof c_tq_max_isc_tq_drof_slow ip_fac_tco_pas_i_is c_tq_bol_i_dt_is c_thd_tq_add_pste_i_isc c_thd_tq_loss_pste_i_isc c_thd_tq_add_pste_i_isc_hys c_thd_tq_loss_pste_i_isc_hys c_tq_isc_i_max_tq_pste c_tq_isc_i_min_tq_pste c_t_tq_isc_i_tq_pste_lim ip_p_d_dt_is_opm_1 ip_p_d_dt_is_opm_2 ip_p_d_dt_is_slow_opm_1 ip_p_d_dt_is_slow_opm_2 ip_p_d_is_opm_1 ip_p_d_is_opm_2 ip_p_d_is_slow_opm_1 ip_p_d_is_slow_opm_2 ip_tq_i_is_opm_1 ip_tq_i_is_opm_2 ip_tq_i_dt_is_opm_1 ip_tq_i_dt_is_opm_2 ip_tq_pas_i_acc_is_opm_1 ip_tq_pas_i_acc_is_opm_2 ip_tq_pas_i_is_opm_1 ip_tq_pas_i_is_opm_2 ip_fac_p_d_fast_is ip_fac_p_d_slow_is ldpm_tq_add_ch_is_1 ip_fac_t_ast_i_is_opm_2 c_tq_tol_i_dt_is_opm_1 c_tq_tol_i_dt_is_opm_2 /end DEF_CHARACTERISTIC
 /begin OUT_MEASUREMENT tq_dif_p_d_fast_is tq_dif_i_is tq_add_i_is n_grd_fil_is n_grd_p_d_is n_grd_i_is lv_pas_ramp_act_p_d_is tq_add_i_ramp state_p_d_isc state_i_isc tq_dif_p_d_is_slow tq_dif_p_d_is_fast tq_add_p_d_ramp_fast tq_add_p_d_ramp_slow lv_tq_p_d_act_fast lv_tq_p_d_act_slow tq_dif_p_d_dt_is_1 tq_dif_p_d_dt_is_1_slow fac_n_grd_is fac_n_grd_is_slow tq_dif_i_is_2 tq_dif_i_is_1 state_pas_ramp_act_p_d_is state_pas_ramp_act_i_is lv_pas_ramp_act_i_is lv_tq_isc_i_tq_pste tq_dif_p_d_slow_is tq_dif_p_d_dt_is_opm_1 tq_dif_p_d_dt_is_opm_2 tq_dif_p_d_dt_is_sel tq_dif_p_d_dt_is_slow_opm_1 tq_dif_p_d_dt_is_slow_opm_2 tq_dif_p_d_dt_is_slow_sel tq_dif_p_d_is_slow_opm_1 tq_dif_p_d_is_slow_sel tq_dif_p_d_is_slow_opm_2 tq_dif_p_d_is_opm_1 tq_dif_p_d_is_opm_2 tq_dif_p_d_is_sel tq_i_is_opm_2 tq_i_is_opm_1 tq_i_is_sel tq_pas_i_is_opm_1 tq_pas_i_is_opm_2 tq_pas_i_is_sel tq_pas_i_acc_is_opm_1 tq_pas_i_acc_is_opm_2 tq_pas_i_acc_is_sel tq_i_dt_is_opm_2 tq_i_dt_is_opm_1 tq_i_dt_is_sel lv_tq_dif_is_opm_sel_1 lv_tq_dif_is_opm_sel_2 lv_tq_dif_is_opm_rls lv_req_isc /end OUT_MEASUREMENT
/end FUNCTION
/begin FUNCTION ISC_Idle_speed_torque_reserve "_Idle speed torque reserve"
 /begin DEF_CHARACTERISTIC c_tq_add_is_bol_crlc ip_t_n_dif_ofs_pred_opm_2 id_tq_add_is_opm_av id_tq_add_is_opm_req ip_t_n_dif_ofs_pred_opm_1 ip_t_n_dif_ofs_pred_cs_opm_2 ip_t_n_dif_ofs_pred_cs_opm_1 ip_tq_add_is_bol_bas_opm_1 ip_tq_add_is_bol_bas_opm_2 ip_fac_temp_tq_add_is_bas_opm_1 ip_fac_temp_tq_add_is_bas_opm_2 ip_fac_tq_add_is_bol_opm_1 ip_fac_tq_add_is_bol_cs_opm_1 ip_fac_tq_add_is_bol_opm_2 ip_fac_tq_add_is_bol_cs_opm_2 ip_fac_vs_tq_add_is_bol_opm_1 ip_fac_vs_tq_add_is_bol_opm_2 ip_fac_tq_add_is_bol_dri_opm_1 ip_fac_tq_add_is_bol_dri_opm_2 ip_tq_add_is_cor_opm_1 c_tq_dif_add_is_tol_opm_1 c_tq_dif_add_is_tol_opm_2 ip_lgrd_tq_add_is_bol ip_lgrd_tq_add_is_bol_opm_2 /end DEF_CHARACTERISTIC
 /begin OUT_MEASUREMENT tq_add_is_bol tq_dif_add_is_tol tq_add_is_bol_opm_1 tq_add_is_bol_opm_2 tq_add_is_bol_sel lv_tq_add_is_opm_sel_1 lv_tq_add_is_opm_sel_2 lv_tq_add_is_opm_rls n_dif_ofs_pred_opm_1 n_dif_ofs_pred_cs_opm_1 n_dif_ofs_pred_opm_2 n_dif_ofs_pred_cs_opm_2 t_n_dif_ofs_pred_opm_1 t_n_dif_ofs_pred_opm_2 t_n_dif_ofs_pred_cs_opm_2 n_dif_pred_opm_1 n_dif_pred_cs_opm_1 n_dif_pred_opm_2 n_dif_pred_cs_opm_2 t_n_dif_ofs_pred_cs_opm_1 fac_tq_add_is_bol_opm_2 fac_tq_add_is_bol_opm_1 /end OUT_MEASUREMENT
/end FUNCTION
/begin FUNCTION ISC_Application_Incidence_for_Idle_Speed_Control "_Application Incidence for Idle Speed Control"
 /begin DEF_CHARACTERISTIC lc_isc_act_cdn_swi lc_isc_act_ast_cdn_swi c_n_dif_isc_act_ast c_crlc_n_grd_fil_isc_act_ast c_t_dly_isc_act_pu /end DEF_CHARACTERISTIC
 /begin OUT_MEASUREMENT state_req_isc lv_neg_n_grd_fil_mem n_grd_fil_isc_act_ast t_ctr_pu_isc_act /end OUT_MEASUREMENT
/end FUNCTION
/begin FUNCTION C_B_OBD "C_B_OBD"
 /begin SUB_FUNCTION OBD_Fuel_system_diagnosis OBD_Activation_conditions_for_cat_eff_and_O2_sensor_diag OBD_Cat_Efficiency_Diagnosis__OSC_Method_ OBD_Limited_dynamic_for_catalyst_effiency_and_oxygen_sensor_diagnosis OBD_Tank_leakage_diagnosis_based_on_DMTL OBD_Application_incidence_catalyst_efficiency_diagnosis__OSC_Method_ OBD_Application_incidences_for_fuel_system_diagnosis OBD_Environmental_Data OBD_Failure_class OBD_Diagnostic_Trouble_Code OBD_Functional_Check_CPS OBD_SA_system_diagnosis_through_SAF___determination OBD_Application_incidences_for_SA_system_monitoring_through_SAFM OBD_Application_incidence_environmental_data OBD_Check_filler_cap___conditions_and_failure OBD_Cyl_Indiv_Lam_Control_Mon OBD_Application_incidences_of_tank_leakage_diagnosis OBD_Ambient_pressure_plausibility_diagnosis OBD_Fuel_sys_pres_diag OBD_Fuel_sys_pres_diag_AI OBD_FUP_EFP_Diag OBD_FUP_EFP_Diag__AI /end SUB_FUNCTION
/end FUNCTION
/begin FUNCTION OBD_Fuel_system_diagnosis "_Fuel system diagnosis"
 /begin DEF_CHARACTERISTIC c_t_sum_max_max_fsd c_t_sum_min_max_fsd c_t_sum_rst_max_fsd c_t_sum_max_err_fsd c_t_sum_ready_fsd c_n_min_fsd c_maf_min_fsd c_tco_min_fsd id_stop_inc_fsd__tco_st id_stop_dec_fsd__toil_max c_stop_max_fsd ip_fac_lamb_min_fsd_1 ip_fac_lamb_min_fsd_2 ip_fac_lamb_max_fsd_1 ip_fac_lamb_max_fsd_2 c_amp_min_fsd c_tam_min_fsd c_t_min_maf_fsd c_t_dly_maf_fsd c_n_min_mff_ad_add_fsd c_maf_min_mff_ad_add_fsd c_fac_cp_fsd lc_req_fsd_eol /end DEF_CHARACTERISTIC
 /begin OUT_MEASUREMENT lam_bank_1.fsd_obd2.t_sum_max_fsd lam_bank_1.fsd_obd2.t_sum_min_fsd lam_bank_1.fsd_obd2.t_sum_end_diag_win_fsd lam_bank_1.fsd_obd2.t_sum_end_ready_fsd lam_bank_1.fsd_obd2.t_sum_rst_fsd lam_bank_2.fsd_obd2.t_sum_max_fsd lam_bank_2.fsd_obd2.t_sum_min_fsd lam_bank_2.fsd_obd2.t_sum_end_diag_win_fsd lam_bank_2.fsd_obd2.t_sum_end_ready_fsd lam_bank_2.fsd_obd2.t_sum_rst_fsd toil_max ctr_stop_fsd /end OUT_MEASUREMENT
/end FUNCTION
/begin FUNCTION OBD_Activation_conditions_for_cat_eff_and_O2_sensor_diag "_Activation conditions for cat eff and O2 sensor diag" /end FUNCTION
/begin FUNCTION OBD_Cat_Efficiency_Diagnosis__OSC_Method_ "_Cat Efficiency Diagnosis (OSC Method)" /end FUNCTION
/begin FUNCTION OBD_Limited_dynamic_for_catalyst_effiency_and_oxygen_sensor_diagnosis "_Limited dynamic for catalyst effiency and oxygen sensor diagnosis" /end FUNCTION
/begin FUNCTION OBD_Tank_leakage_diagnosis_based_on_DMTL "_Tank leakage diagnosis based on DMTL"
 /begin DEF_CHARACTERISTIC c_amp_dmtl_max c_cod_2_dmtl c_crlc_cur_dmtl_fil c_crlc_cur_dmtl_fil_lim c_crlc_cur_dmtl_fil_refu c_crlc_vb_dmtl_fil c_crlc_vb_dmtl_fil_lim c_cur_dmtl_cor_fil_ofs_amp c_cur_dmtl_dif_cur_dmtl_stat c_cur_dmtl_ref_leak_max c_cur_dmtl_ref_leak_min c_cur_dmtl_ref_ofs c_ena_fco_diag c_fco_diag_max c_fco_diag_min c_ftl_dec_ftl_diag_min c_ftl_diag_max c_ftl_diag_min c_ftl_dmtl_max c_ftl_dmtl_min c_hys_ftl_dmtl c_r_dmtl c_sum_rep_leak_mes_fuc_max c_t_cur_dmtl_rough_leak_max c_t_cur_dmtl_rough_leak_min c_t_cur_dmtl_stat c_t_dly_cur_dmtl_dif_mes c_t_dly_det_refu c_t_dly_dmtls c_t_dly_es_pwl c_t_dly_fuc_can_off c_t_dly_fuc_can_on c_t_dly_igk_ftl c_t_dly_req_pwl_dmtl c_t_dmtl_eol_max c_t_dmtl_max c_t_ref_leak_mes_max c_t_ref_leak_mes_rep_max c_t_vb_dly_dmtl c_tam_dmtl_min c_tco_st_dmtl_min c_trt_dmtl_eol_max c_vb_dmtl_asa_max c_vb_dmtl_asa_min c_vb_dmtl_max c_vs_ftl_diag_max c_t_act_small_leak ip_t_act_small_leak__ftl ip_fac_cur_dmtl_ref ip_t_cur_dmtl_stat c_t_ref_test_rough_leak c_fac_t_cur_dmtl_stat_len ip_fac_cur_dmtl c_cl_dmtl_max c_vs_fuc_can_min c_vs_dmtl_max c_sum_cnl_leak_mes_fuc_max c_sum_cnl_small_leak_mes_max c_cur_dmtl_ref_dif_max c_cur_dmtl_dif_thd_refu c_cur_dmtl_dif_thd_fuc c_cur_dmtl_dif_thd_mes c_dist_refu_rough_leak_min c_t_dly_stop_refu c_t_ena_dr_dmtl_max ip_t_act_rough_leak ip_t_act_rough_leak_chk_fuc c_t_act_rough_leak c_t_act_rough_leak_chk_fuc c_vb_dmtl_dif c_vb_dmtl_dif_chk_fuc c_t_ast_dmtl_max c_t_ast_dmtl_chk_fuc c_t_ena_dmtl_chk_fuc c_tam_dmtl_max c_tam_dmtl_chk_fuc_min c_vb_dmtl_min c_vb_dmtl_chk_fuc_min c_vb_dmtl_chk_fuc_max ip_fac_cur_dmtl_rough ip_fac_cur_dmtl_chk_fuc_rough c_cod_dmtl c_tco_st_dmtl_cold c_ctr_tco_st_dmtl_min /end DEF_CHARACTERISTIC
 /begin OUT_MEASUREMENT ctr_cnl_rough_leak_mes_fuc ctr_cur_dmtl_ref_dif_max ctr_rep_rough_leak_mes_fuc cur_dmtl cur_dmtl_comp_rough_leak cur_dmtl_comp_small_leak_len cur_dmtl_cor_fil_max cur_dmtl_cor_fil_min cur_dmtl_cor_fil_refu_hpf cur_dmtl_dif cur_dmtl_dif_ref_rough_leak cur_dmtl_ref_leak cur_dmtl_rough_leak_len_end cur_dmtl_rough_leak_min cur_dmtl_thd_rough_leak_len fco_av_dmtl state_dmtl t_act_cur_dmtl_stat t_act_leak_mes t_act_ref_leak_mes cur_dmtl_dmtls_test cur_dmtl_thd_rough_leak cur_dmtl_thd_dmtls_test cur_dmtl_cor cur_dmtl_cor_fil vb_dmtl_ref vb_dmtl_fil ftl_ini ftl_old dmtl_priv_state_1.bitfield.lv_cur_dmtl_dmtls_test dmtl_priv_state_1.bitfield.lv_cur_dmtl_ref_mes_max dmtl_priv_state_1.bitfield.lv_cur_dmtl_ref_mes_min dmtl_priv_state_1.bitfield.lv_dist_dmtl dmtl_priv_state_1.bitfield.lv_dmtl_asa dmtl_priv_state_1.bitfield.lv_dmtl_eol dmtl_priv_state_1.bitfield.lv_dmtl_pump_on dmtl_priv_state_1.bitfield.lv_dmtl_rst_rough_leak dmtl_priv_state_1.bitfield.lv_dmtls_on dmtl_priv_state_1.bitfield.lv_dr_dmtl dmtl_priv_state_1.bitfield.lv_dr_dmtl_pump dmtl_priv_state_1.bitfield.lv_ena_fco_diag dmtl_priv_state_1.bitfield.lv_ena_ftl_diag dmtl_priv_state_2.bitfield.lv_ena_fuc_rough_leak_mes dmtl_priv_state_2.bitfield.lv_ena_main_dmtl dmtl_priv_state_2.bitfield.lv_ena_main_dmtl_fuc dmtl_priv_state_2.bitfield.lv_ena_rough_leak_1 dmtl_priv_state_2.bitfield.lv_ena_rough_leak_2 dmtl_priv_state_2.bitfield.lv_ena_rough_leak_3 dmtl_priv_state_2.bitfield.lv_ena_rough_leak_mes dmtl_priv_state_2.bitfield.lv_ena_rough_leak_mes_only dmtl_priv_state_2.bitfield.lv_ena_small_leak_1 dmtl_priv_state_2.bitfield.lv_ena_small_leak_mes_end dmtl_priv_state_2.bitfield.lv_fco_diag_max dmtl_priv_state_2.bitfield.lv_fco_diag_min dmtl_priv_state_2.bitfield.lv_fco_h_ftl dmtl_priv_state_2.bitfield.lv_ftl_dec dmtl_priv_state_2.bitfield.lv_ftl_dec_igk_on dmtl_priv_state_2.bitfield.lv_ftl_dmtl_max dmtl_priv_state_2.bitfield.lv_ftl_dmtl_min dmtl_priv_state_3.bitfield.lv_ftl_dyn dmtl_priv_state_3.bitfield.lv_ftl_inc dmtl_priv_state_3.bitfield.lv_ftl_inc_igk_on dmtl_priv_state_3.bitfield.lv_no_purge_dr_dmtl dmtl_priv_state_3.bitfield.lv_no_purge_dmtl_rough_leak dmtl_priv_state_3.bitfield.lv_no_purge_dmtl_small_leak dmtl_priv_state_4.bitfield.lv_ref_leak_rough_leak_susp dmtl_priv_state_4.bitfield.lv_refu_1 dmtl_priv_state_4.bitfield.lv_refu_end dmtl_priv_state_4.bitfield.lv_refu_rls_diag dmtl_priv_state_4.bitfield.lv_refu_val_1 dmtl_priv_state_4.bitfield.lv_req_ena_rough_leak dmtl_priv_state_4.bitfield.lv_req_pwl_rough_leak dmtl_priv_state_4.bitfield.lv_req_pwl_small_leak dmtl_priv_state_4.bitfield.lv_req_rough_leak dmtl_priv_state_4.bitfield.lv_small_leak_mes_len dmtl_priv_state_4.bitfield.lv_t_dly_dmtl_pwl dmtl_glob_state_1.bitfield.lv_ctr_cnl_small_leak_mes dmtl_glob_state_1.bitfield.lv_cur_dmtl_ref_dif_max dmtl_glob_state_1.bitfield.lv_cur_dmtl_thd_dif_mes dmtl_glob_state_1.bitfield.lv_det_fuc_open dmtl_glob_state_1.bitfield.lv_det_refu dmtl_glob_state_1.bitfield.lv_dist_det_rough_leak dmtl_glob_state_1.bitfield.lv_dmtl_act dmtl_glob_state_1.bitfield.lv_dmtl_stop dmtl_glob_state_1.bitfield.lv_ena_fuc dmtl_glob_state_1.bitfield.lv_ena_leak_dmtl dmtl_glob_state_1.bitfield.lv_ena_small_leak_mes dmtl_glob_state_1.bitfield.lv_err_det_dmtl_max dmtl_glob_state_1.bitfield.lv_err_det_dmtl_min dmtl_glob_state_1.bitfield.lv_err_det_rough_leak_min dmtl_glob_state_1.bitfield.lv_err_ftl_int dmtl_glob_state_1.bitfield.lv_err_ftl_plaus_int dmtl_glob_state_1.bitfield.lv_err_sig_dmtl dmtl_glob_state_1.bitfield.lv_ftl_diag dmtl_glob_state_1.bitfield.lv_fuc_can dmtl_glob_state_1.bitfield.lv_fuc_open dmtl_glob_state_1.bitfield.lv_no_purge_dmtl dmtl_glob_state_1.bitfield.lv_refu_dmtl dmtl_glob_state_1.bitfield.lv_rough_leak_susp_int dmtl_glob_state_1.bitfield.lv_chk_dmtl_cur_dmtl_vld dmtl_glob_state_1.bitfield.lv_chk_dmtl_vld dmtl_glob_state_1.bitfield.lv_err_det_small_leak_min dmtl_glob_state_1.bitfield.lv_ftl_dmtl_val dmtl_glob_state_1.bitfield.lv_cyc_rough_leak_susp_int dmtl_glob_state_2.bitfield.lv_req_pwl_dmtl dmtl_glob_state_2.bitfield.lv_rough_leak_susp_set dmtl_glob_state_2.bitfield.lv_sdr_dmtl dmtl_glob_state_2.bitfield.lv_t_dmtl_max dmtl_glob_state_2.bitfield.lv_vb_dif_max dmtl_glob_state_2.bitfield.lv_dr_dmtls dmtl_glob_state_2.bitfield.lv_vb_range_dmtl dmtl_glob_state_2.bitfield.lv_cyc_rough_leak_mode6 dmtl_glob_state_2.bitfield.lv_rough_leak_mes_len dmtl_glob_state_2.bitfield.lv_cyc_small_leak_mode6 dmtl_glob_state_2.bitfield.lv_refu_int dmtl_glob_state_2.bitfield.lv_refu_val_int dmtl_glob_state_2.bitfield.lv_ena_chk_fuc_rough_leak cur_dmtl_small_leak_end cur_dmtl_ref_dif_max ctr_cnl_small_leak_mes ctr_ena_dmtl_chk_fuc dist_dmtl cur_dmtl_rough_leak_min_eol cur_dmtl_cor_fil_eol lv_err_rough_leak lv_err_small_leak lv_dmtls lv_hdmtl_on lv_dmtl_pump lv_tco_st_dmtl ctr_tco_st_dmtl lv_err_dmtlm v_dmtl v_sof_swi v_sof_swi_mon /end OUT_MEASUREMENT
/end FUNCTION
/begin FUNCTION OBD_Application_incidence_catalyst_efficiency_diagnosis__OSC_Method_ "_Application incidence catalyst efficiency diagnosis (OSC Method)" /end FUNCTION
/begin FUNCTION OBD_Application_incidences_for_fuel_system_diagnosis "_Application incidences for fuel system diagnosis"
 /begin DEF_CHARACTERISTIC lc_inh_fsd_man_deac c_cl_mmv_max_fsd c_tco_min_fsd_pu c_t_dly_fsd_pu c_t_dly_fsd_reac /end DEF_CHARACTERISTIC
 /begin OUT_MEASUREMENT lv_inh_diag_fsd_cp lv_inh_diag_fsd lv_err_det_fsd[0] lv_err_det_fsd[1] /end OUT_MEASUREMENT
/end FUNCTION
/begin FUNCTION OBD_Environmental_Data "_Environmental Data" /end FUNCTION
/begin FUNCTION OBD_Failure_class "_Failure class" /end FUNCTION
/begin FUNCTION OBD_Diagnostic_Trouble_Code "_Diagnostic Trouble Code" /end FUNCTION
/begin FUNCTION OBD_Functional_Check_CPS "_Functional Check CPS"
 /begin DEF_CHARACTERISTIC c_tco_min_diagcps_1 c_cl_mmv_diagcps c_flow_sp_diagcps_maf c_flow_sp_diagcps_n c_lgrd_flow_sp_neg_diagcps c_lgrd_flow_sp_pos_diagcps c_n_dif_diagcps c_sum_flow_sp_diagcps_max c_sum_diagcps_max c_t_diagcps_maf c_t_diagcps_dly c_crlc_maf_sp_tqi_diagcps c_maf_sp_tqi_dyw_diagcps c_maf_max_diagcps c_tco_min_diagcps c_sum_diagcps_eol c_t_inh_map_ctl_diagcps c_ti_lam_diagcps_dif c_map_diagcps_1 c_maf_diagcps_2 c_map_diagcps_2 c_t_diagcps_n_map_1 c_t_diagcps_n_map_2 c_t_diagcps_n_map_3 c_t_diagcps_n_map_4 lc_diagcps_map_act_opm_2 c_n_diagcps_2 c_sum_n_diag_diagcps_ofs c_sum_map_diag_diagcps_ofs c_sum_maf_diag_diagcps_ofs /end DEF_CHARACTERISTIC
 /begin OUT_MEASUREMENT lv_inh_diagcps lv_di_diagcps state_rbm_diagcps lv_inh_diag_rbm_diagcps flow_sp_cp_diagcps lv_act_diagcps lv_maf_diagcps_0 lv_maf_diagcps_1 lv_supp_accin_diagcps maf_diagcps n_diagcps sum_flow_sp_diagcps_eol sum_flow_sp_diagcps sum_diag_diagcps_eol sum_diag_diagcps t_diagcps_dly t_diagcps_maf maf_sp_tqi_mmv_diagcps lv_maf_sp_tqi_dyw_diagcps flow_sp_cps_old sum_diag_diagcps_sae maf_diagcps_sae maf_diagcps_thd_sae cl_mmv_sae lv_eol_cps_err lv_err_diagcps lv_n_dif_diagcps lv_end_rbm_diagcps lv_map_dif_diagcps lv_inh_map_ctl_diagcps lv_lam_diagcps lv_lam_sum_diagcps map_diagcps sum_n_diag_diagcps t_diagcps_lam_1 ti_lam_diagcps_dif[0] ti_lam_diagcps_dif[1] ti_lam_diagcps_max[0] ti_lam_diagcps_max[1] ti_lam_diagcps_min[0] ti_lam_diagcps_min[1] state_diagcps state_diagcps_rbm sum_map_diag_diagcps sum_n_diag_diagcps_ofs sum_map_diag_diagcps_ofs sum_maf_diag_diagcps_ofs t_diagcps_n_map_1 t_diagcps_n_map_2 t_diagcps_n_map_3 /end OUT_MEASUREMENT
/end FUNCTION
/begin FUNCTION OBD_SA_system_diagnosis_through_SAF___determination "_SA system diagnosis through SAF - determination" /begin DEF_CHARACTERISTIC c_saf_diag_max c_saf_diag_min /end DEF_CHARACTERISTIC /end FUNCTION
/begin FUNCTION OBD_Application_incidences_for_SA_system_monitoring_through_SAFM "_Application incidences for SA system monitoring through SAFM" /begin OUT_MEASUREMENT lv_inh_diag_ebox_cfa /end OUT_MEASUREMENT /end FUNCTION
/begin FUNCTION OBD_Application_incidence_environmental_data "_Application incidence environmental data" /begin DEF_CHARACTERISTIC ip_load_clc_amp__amp ip_load_clc__n_32__maf /end DEF_CHARACTERISTIC /begin OUT_MEASUREMENT load_clc /end OUT_MEASUREMENT /end FUNCTION
/begin FUNCTION OBD_Check_filler_cap___conditions_and_failure "_Check filler cap - conditions and failure"
 /begin DEF_CHARACTERISTIC c_ctr_ena_dmtl_chk_fuc lc_cod_chk_fuc c_vs_ena_chk_fuc_open_max c_vs_delta_chk_fuc_max c_ftl_delta_chk_fuc_max c_t_ast_dc_chk_fuc c_ctr_dc_ena_chk_fuc_max c_ctr_chk_fuc_open_max c_vs_chk_fuc_open_can_min c_vs_chk_fuc_open_max c_t_vs_chk_fuc_open_can_min c_t_vs_chk_fuc_open_min c_t_chk_fuc_open_can c_vs_ena_chk_fuc_open_min c_amp_chk_fuc_max /end DEF_CHARACTERISTIC
 /begin OUT_MEASUREMENT lv_rough_leak_susp_chk_fuc lv_ctr_dc_chk_fuc lv_ena_chk_fuc_refu lv_ena_chk_fuc_rough_leak_mes lv_chk_fuc_close lv_chk_fuc_open lv_chk_fuc_end lv_t_vs_chk_fuc_open_can lv_t_vs_chk_fuc_open_max lv_chk_fuc_open_act lv_rep_chk_fuc lv_chk_fuc_open_can lv_err_chk_fuc ctr_chk_fuc_open ctr_dc_ena_chk_fuc amp_chk_fuc /end OUT_MEASUREMENT
/end FUNCTION
/begin FUNCTION OBD_Cyl_Indiv_Lam_Control_Mon "_Cyl_Indiv_Lam_Control_Mon"
 /begin DEF_CHARACTERISTIC c_abc_dec_lam_cyl_sel_err c_abc_inc_lam_cyl_sel_err c_abc_max_lam_cyl_sel_err c_t_sum_thd_lam_cyl_sel_lim lc_abc_lam_cyl_sel_err_rst /end DEF_CHARACTERISTIC
 /begin OUT_MEASUREMENT cyl_diag_1.abc_lam_cyl_sel_err cyl_diag_1.lv_err_lam_cyl_sel cyl_diag_1.lv_t_sum_thd_lam_cyl_lim cyl_diag_1.t_sum_lam_cyl_sel_lim cyl_diag_2.abc_lam_cyl_sel_err cyl_diag_2.lv_err_lam_cyl_sel cyl_diag_2.lv_t_sum_thd_lam_cyl_lim cyl_diag_2.t_sum_lam_cyl_sel_lim /end OUT_MEASUREMENT
/end FUNCTION
/begin FUNCTION OBD_Application_incidences_of_tank_leakage_diagnosis ""
 /begin DEF_CHARACTERISTIC c_t_dly_ftl_dmtl_val c_t_es_dmtl_diag_max c_tam_max_dmtl_rbm c_tam_st_hys_dmtl_rbm c_tco_st_min_dmtl_rbm c_tco_st_max_dmtl_rbm c_t_ast_dmtl_rbm c_tam_min_dmtl_rbm c_cod_dmtl_rbm /end DEF_CHARACTERISTIC
 /begin OUT_MEASUREMENT lv_inh_diag_rbm_dmtl lv_chk_dmtl_cur_dmtl_vld_virt lv_det_no_rough_leak t_ast_dmtl_rbm state_rbm_dmtlm state_rbm_rough_leak state_rbm_small_leak ctr_cnl_small_leak_mes_virt lv_ctr_cnl_small_leak_virt lv_det_small_leak lv_det_no_small_leak /end OUT_MEASUREMENT
/end FUNCTION
/begin FUNCTION OBD_Ambient_pressure_plausibility_diagnosis "_Ambient pressure plausibility diagnosis" /begin DEF_CHARACTERISTIC c_amp_plaus_dif_err ip_clrc_amp_plaus /end DEF_CHARACTERISTIC /begin OUT_MEASUREMENT lv_err_amp_plaus amp_mmv_plaus /end OUT_MEASUREMENT /end FUNCTION
/end MODULE
/end PROJECT
