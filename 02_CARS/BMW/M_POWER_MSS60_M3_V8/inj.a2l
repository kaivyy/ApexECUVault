ASAP2_VERSION 1 30
/begin PROJECT MSS65-inj "Generiert am 14.10.05 um 11:34:36"
/begin HEADER "" VERSION "R341" /end HEADER
/begin MODULE _MSS65-inj "Generiert am 14.10.05 um 11:34:36"
/begin MOD_COMMON "" BYTE_ORDER MSB_FIRST ALIGNMENT_BYTE 1 ALIGNMENT_WORD 2 ALIGNMENT_LONG 4 ALIGNMENT_FLOAT32_IEEE 4 ALIGNMENT_FLOAT64_IEEE 8 /end MOD_COMMON
/begin CHARACTERISTIC K_DIAG_TR_MAX_ERR "erlaubte Fehler bis zum Eintrag als SG-Interner" VALUE 0x7079C TKW_VV_VV_UB 100.0 FORMULA_0003 0.0 255.0 /end CHARACTERISTIC
/begin CHARACTERISTIC K_DIAG_TR_UB_MIN "UB-Schwelle ab der die Treiberdiagnose beginnen" VALUE 0x7079A TKW_VV_VV_SW 100.0 FORMULA_0008 0.0 28.0 FORMAT "%4.1" /end CHARACTERISTIC
/begin CHARACTERISTIC K_DWF_CFG "Konfiguration DWF-Anzeige" VALUE 0x70892 TKW_VV_VV_UW 100.0 FORMULA_0010 0.0 65535.0 /end CHARACTERISTIC
/begin CHARACTERISTIC K_DWF_ORANGE_OFF "Offset auf roten Bereich" VALUE 0x70894 TKW_VV_VV_SB 100.0 FORMULA_0657 -6400.0 6350.0 /end CHARACTERISTIC
/begin CHARACTERISTIC K_DWF_SHLI_AX_AKTIV "Aktivierungsschwelle" VALUE 0x708A0 TKW_VV_VV_SW 100.0 FORMULA_0123 -20.0 20.0 FORMAT "%5.2" /end CHARACTERISTIC
/begin CHARACTERISTIC K_DWF_SHLI_T_AKTIV "Aktivierungsschwelle" VALUE 0x7089A TKW_VV_VV_UW 100.0 FORMULA_0021 0.0 655.0 FORMAT "%5.2" /end CHARACTERISTIC
/begin CHARACTERISTIC K_DWF_SHLI_T_BL "Aktivierungsschwelle Blinken" VALUE 0x7089E TKW_VV_VV_UW 100.0 FORMULA_0109 0.0 325.0 FORMAT "%5.2" /end CHARACTERISTIC
/begin CHARACTERISTIC K_DWF_SHLI_T_FLS "Flash Segmentzeit" VALUE 0x70899 TKW_VV_VV_UB 100.0 FORMULA_0306 0.0 2.549999952316284 /end CHARACTERISTIC
/begin CHARACTERISTIC K_DWF_SHLI_T_INAKTIV "Deaktivierungsschwelle" VALUE 0x7089C TKW_VV_VV_UW 100.0 FORMULA_0021 0.0 655.0 FORMAT "%5.2" /end CHARACTERISTIC
/begin CHARACTERISTIC K_DWF_SHLI_T_TOT "Fahrertotzeit" VALUE 0x70897 TKW_VV_VV_UB 100.0 FORMULA_0306 0.0 2.549999952316284 /end CHARACTERISTIC
/begin CHARACTERISTIC K_DWF_SHLI_TAB_FAK "Einfluss Abregelzeit" VALUE 0x70898 TKW_VV_VV_UB 100.0 FORMULA_0659 0.0 0.9959999918937683 /end CHARACTERISTIC
/begin CHARACTERISTIC K_DWF_SHLI_TAU_DN "dn-Filter Shiflights" VALUE 0x70895 TKW_VV_VV_UB 100.0 FORMULA_0658 1.009999960660934e-002 2.559999942779541 /end CHARACTERISTIC
/begin CHARACTERISTIC K_DWF_SHLI_TAU_N "n-Filter Shiflights" VALUE 0x70896 TKW_VV_VV_UB 100.0 FORMULA_0658 1.009999960660934e-002 2.559999942779541 /end CHARACTERISTIC
/begin CHARACTERISTIC K_EBOX_ELU_EIN "Eischaltschwelle" VALUE 0x708CA TKW_VV_VV_SW 100.0 FORMULA_0023 -50.0 170.0 FORMAT "%4.1" /end CHARACTERISTIC
/begin CHARACTERISTIC K_EBOX_ELU_HYS "Ausschalt-Hysterese" VALUE 0x708CC TKW_VV_VV_SW 100.0 FORMULA_0074 0.0 1000.0 FORMAT "%4.1" /end CHARACTERISTIC
/begin CHARACTERISTIC K_EBOX_ELU_LOSBRECHEN "Eischaltdauer zum Losbrechen" VALUE 0x708CE TKW_VV_VV_UW 100.0 FORMULA_0021 0.0 655.0 FORMAT "%5.2" /end CHARACTERISTIC
/begin CHARACTERISTIC K_EGAS_CFG_DIAG "DK-Konfiguration elektr. Diagnose" VALUE 0x71FE8 TKW_VV_VV_UB 100.0 FORMULA_0663 0.0 255.0 /end CHARACTERISTIC
/begin CHARACTERISTIC K_FST_ABWEICHUNG "Zulaessige Abweichung Verbrauch/Fuellstand" VALUE 0x72300 TKW_VV_VV_UB 100.0 FORMULA_0559 0.0 127.5 /end CHARACTERISTIC
/begin CHARACTERISTIC K_FST_CAN_FEHLER "min. Dauer CAN-Fehler (65535s = aus)" VALUE 0x72302 TKW_VV_VV_UW 100.0 FORMULA_0593 0.0 65535.0 /end CHARACTERISTIC
/begin CHARACTERISTIC K_FST_FILT "Filter Geberwert Li/Re" VALUE 0x72305 TKW_VV_VV_UB 100.0 FORMULA_0715 1.003999948501587 256.0 /end CHARACTERISTIC
/begin CHARACTERISTIC K_FST_NACHTANK "Delta fuer Nachtankerkennung" VALUE 0x72304 TKW_VV_VV_UB 100.0 FORMULA_0559 0.0 127.5 /end CHARACTERISTIC
/begin CHARACTERISTIC K_FST_TANK_LEER_RECHTS "Fuellstand rechts Tank Leer Info" VALUE 0x72307 TKW_VV_VV_UB 100.0 FORMULA_0559 0.0 127.5 /end CHARACTERISTIC
/begin CHARACTERISTIC K_FST_TANK_LEER_SUM "Summenfuellstand Tank Leer Info" VALUE 0x72306 TKW_VV_VV_UB 100.0 FORMULA_0559 0.0 127.5 /end CHARACTERISTIC
/begin CHARACTERISTIC K_FST_V_BETANK_END "Geschw. fuer Tanken beendet" VALUE 0x7230A TKW_VV_VV_SW 100.0 FORMULA_0076 -80.0 360.0 FORMAT "%4.1" /end CHARACTERISTIC
/begin CHARACTERISTIC K_FST_VERBRAUCH "FST-Plausi, wenn soviel verbraucht" VALUE 0x7230C TKW_VV_VV_UB 100.0 FORMULA_0559 0.0 127.5 /end CHARACTERISTIC
/begin CHARACTERISTIC K_FST_VERBRAUCH_VOLL "Unplausibl. Verbrauch bei FST voll" VALUE 0x7230D TKW_VV_VV_UB 100.0 FORMULA_0559 0.0 127.5 /end CHARACTERISTIC
/begin CHARACTERISTIC K_FST_VOLL "Maximaler Fuellstand fuer Volldiagnose" VALUE 0x72308 TKW_VV_VV_UB 100.0 FORMULA_0559 0.0 127.5 /end CHARACTERISTIC
/begin CHARACTERISTIC K_N_BEGR_CFG "Konfiguration Begrenzer" VALUE 0x74EBC TKW_VV_VV_UW 100.0 FORMULA_0010 0.0 65535.0 /end CHARACTERISTIC
/begin CHARACTERISTIC K_N_BEGR_EGAS_HYS "Hysterese fuer N-Begrenzung ueber Egas" VALUE 0x74EAA TKW_VV_VV_SW 100.0 FORMULA_0006 0.0 500.0 /end CHARACTERISTIC
/begin CHARACTERISTIC K_N_BEGR_ERR_E2 "max. Fehler nmax Ebene 2" VALUE 0x79CB8 TKW_VV_VV_UB 100.0 FORMULA_0003 0.0 255.0 /end CHARACTERISTIC
/begin CHARACTERISTIC K_N_BEGR_FERTIGUNG "N-Max-Begrenzung fuer Fertigung" VALUE 0x74EB0 TKW_VV_VV_SW 100.0 FORMULA_0006 0.0 10000.0 /end CHARACTERISTIC
/begin CHARACTERISTIC K_N_BEGR_FETRAWE_WEG "zul. Kilometerstand fuer N-Max-Begrenzung im Fertigungs- bzw. Transportmode" VALUE 0x74EB6 TKW_VV_VV_UW 100.0 FORMULA_0613 0.0 65535.0 /end CHARACTERISTIC
/begin CHARACTERISTIC K_N_BEGR_FZG_STEHT "N-Max-Begrenzung fuer Fertigung" VALUE 0x74EBA TKW_VV_VV_SW 100.0 FORMULA_0006 0.0 10000.0 /end CHARACTERISTIC
/begin CHARACTERISTIC K_N_BEGR_OFF_E2 "Offset fuer Fehlererkennung Ebene 2" VALUE 0x79CBC TKW_VV_VV_SW 100.0 FORMULA_0006 0.0 10000.0 /end CHARACTERISTIC
/begin CHARACTERISTIC K_N_BEGR_SK_RAMPE "Rampe fuer SK-Begrenzung" VALUE 0x74EAF TKW_VV_VV_UB 100.0 FORMULA_0999 0.0 25500.0 /end CHARACTERISTIC
/begin CHARACTERISTIC K_N_BEGR_TGETR_AEBGR_DOWN "Änderungsbegrenzung Drehzahlbegr. nach unten, Tgetr" VALUE 0x74EC0 TKW_VV_VV_UW 100.0 FORMULA_1000 0.0 20000.0 FORMAT "%5.2" /end CHARACTERISTIC
/begin CHARACTERISTIC K_N_BEGR_TGETR_AEBGR_UP "Änderungsbegrenzung Drehzahlbegr. nach oben, Tgetr" VALUE 0x74EBE TKW_VV_VV_UW 100.0 FORMULA_1000 0.0 20000.0 FORMAT "%5.2" /end CHARACTERISTIC
/begin CHARACTERISTIC K_N_BEGR_TI_HYS "Hysterese fuer N-Begrenzung ueber TI" VALUE 0x74EAC TKW_VV_VV_SW 100.0 FORMULA_0006 0.0 500.0 /end CHARACTERISTIC
/begin CHARACTERISTIC K_N_BEGR_TI_MAX_E2 "max. nBegr-TI Ebene 2" VALUE 0x79CBA TKW_VV_VV_SW 100.0 FORMULA_0006 0.0 10000.0 /end CHARACTERISTIC
/begin CHARACTERISTIC K_N_BEGR_TI_OFF_RSS "N-Offset bei Rennstartschaltung" VALUE 0x74EA8 TKW_VV_VV_SW 100.0 FORMULA_0006 0.0 5000.0 /end CHARACTERISTIC
/begin CHARACTERISTIC K_N_BEGR_TRANSPORT "N-Max-Begrenzung fuer Fertigung" VALUE 0x74EB2 TKW_VV_VV_SW 100.0 FORMULA_0006 0.0 10000.0 /end CHARACTERISTIC
/begin CHARACTERISTIC K_N_BEGR_V_FEHLER "N-Max-Begrenzung fuer Fertigung" VALUE 0x74EB8 TKW_VV_VV_SW 100.0 FORMULA_0006 0.0 10000.0 /end CHARACTERISTIC
/begin CHARACTERISTIC K_N_BEGR_WERKSTATT "N-Max-Begrenzung fuer Fertigung" VALUE 0x74EB4 TKW_VV_VV_SW 100.0 FORMULA_0006 0.0 10000.0 /end CHARACTERISTIC
/begin CHARACTERISTIC K_N_MAX_FF_RESET "FF-Reset fuer meinen INCA-Spezl" VALUE 0x74EAE TKW_VV_VV_UB 100.0 FORMULA_0998 0.0 255.0 /end CHARACTERISTIC
/begin CHARACTERISTIC K_N_MIN_FREEZE "Minimale Eintrittsdrehzahl fuer Drehzahl-Freeze" VALUE 0x74EA0 TKW_VV_VV_SW 100.0 FORMULA_0006 0.0 10000.0 /end CHARACTERISTIC
/begin CHARACTERISTIC K_N_OBD_DYN_DELTA "Differenzdrehzahl fuer Dynamikerkennung" VALUE 0x74EA4 TKW_VV_VV_SW 100.0 FORMULA_0006 0.0 10000.0 /end CHARACTERISTIC
/begin CHARACTERISTIC K_N_OBD_DYN_T "Sperrzeit fuer Ruecknahme N-Dynamik" VALUE 0x74EA6 TKW_VV_VV_UW 100.0 FORMULA_0021 0.0 655.0 FORMAT "%5.2" /end CHARACTERISTIC
/begin CHARACTERISTIC K_N_OBD_DYN_TAU "Zeitkonstante für n-Filter Dynamikerkennung" VALUE 0x74EA2 TKW_VV_VV_UB 100.0 FORMULA_0658 1.009999960660934e-002 2.559999942779541 /end CHARACTERISTIC
/begin CHARACTERISTIC K_N_OBERGRENZE "Plausibilitaetsgrenze fuer die n-Erfassung" VALUE 0x74E9E TKW_VV_VV_SW 100.0 FORMULA_0006 0.0 20000.0 /end CHARACTERISTIC
/begin CHARACTERISTIC K_N_ZEIT_STOERUNG "Einfrierzeit Drehzahlerfassung nach TPU Stoerung" VALUE 0x74E9C TKW_VV_VV_SB 100.0 FORMULA_0306 0.0 1.269999980926514 /end CHARACTERISTIC
/begin CHARACTERISTIC K_TD_DIAG_CFG "Aktivierung der Fehlerarten." VALUE 0x771C2 TKW_VV_VV_UB 100.0 FORMULA_0209 0.0 15.0 BIT_MASK 0xF /end CHARACTERISTIC
/begin CHARACTERISTIC KL_DWF_SHLI_SEG "Rest-Segmente" CURVE 0x708BC TKL_SW_VV_UB 100.0 FORMULA_0003 0.0 10.0
 /begin AXIS_DESCR STD_AXIS dwf_shli_n FORMULA_0006 4 0.0 10000.0 MAX_GRAD 0.0 /end AXIS_DESCR
/end CHARACTERISTIC
/begin CHARACTERISTIC KL_DWF_SHLI_V_DIFF "max. Radschlupf" CURVE 0x708A2 TKL_SW_VV_SW 100.0 FORMULA_0076 -80.0 360.0 FORMAT "%4.1" /begin AXIS_DESCR STD_AXIS gang FORMULA_0660 6 -1.0 10.0 MAX_GRAD 0.0 /end AXIS_DESCR /end CHARACTERISTIC
/begin CHARACTERISTIC KL_N_BEGR_GANG "gangabhaengige Drehzahlbegrenzung" CURVE 0x74EC2 TKL_SW_VV_SW 100.0 FORMULA_0006 0.0 10000.0 /begin AXIS_DESCR STD_AXIS gang FORMULA_0660 8 -1.0 10.0 MAX_GRAD 0.0 /end AXIS_DESCR /end CHARACTERISTIC
/begin CHARACTERISTIC KL_N_BEGR_SK "Maximaldrehzahl bei SK-Fehler" CURVE 0x74EE4 TKL_UB_VV_SW 100.0 FORMULA_0006 0.0 10000.0 /begin AXIS_DESCR STD_AXIS Stufe FORMULA_0003 6 0.0 255.0 MAX_GRAD 0.0 /end AXIS_DESCR /end CHARACTERISTIC
/begin CHARACTERISTIC KL_N_BEGR_TGETR_HEISS "Begrenzung bei heissem Getriebeoel" CURVE 0x74F46 TKL_SW_VV_SW 100.0 FORMULA_0006 0.0 10000.0
 /begin AXIS_DESCR STD_AXIS tgetr FORMULA_0023 8 -50.0 170.0 MAX_GRAD 0.0 FORMAT "%4.1" /end AXIS_DESCR
/end CHARACTERISTIC
/begin CHARACTERISTIC KL_N_BEGR_TI_OFFSET "N-Offset auf Momenteneingriff" CURVE 0x74F68 TKL_SW_VV_SW 100.0 FORMULA_0006 0.0 10000.0
 /begin AXIS_DESCR STD_AXIS n_begr_egas FORMULA_0006 4 0.0 10000.0 MAX_GRAD 0.0 /end AXIS_DESCR
/end CHARACTERISTIC
/begin CHARACTERISTIC KL_N_BEGR_TMOT_HEISS "Begrenzung bei heissem Tmot" CURVE 0x74F2C TKL_SW_VV_SW 100.0 FORMULA_0006 0.0 10000.0
 /begin AXIS_DESCR STD_AXIS tmot FORMULA_0023 6 -50.0 170.0 MAX_GRAD 0.0 FORMAT "%4.1" /end AXIS_DESCR
/end CHARACTERISTIC
/begin CHARACTERISTIC KL_N_BEGR_TOEL_HEISS "Begrenzung bei heissem Oel" CURVE 0x74F12 TKL_SW_VV_SW 100.0 FORMULA_0006 0.0 10000.0
 /begin AXIS_DESCR STD_AXIS toel_wanne FORMULA_0023 6 -50.0 170.0 MAX_GRAD 0.0 FORMAT "%4.1" /end AXIS_DESCR
/end CHARACTERISTIC
/begin CHARACTERISTIC KL_N_BEGR_TOEL_KALT "Begrenzung bei kaltem Oel" CURVE 0x74EF8 TKL_SW_VV_SW 100.0 FORMULA_0006 0.0 10000.0
 /begin AXIS_DESCR STD_AXIS toel FORMULA_0023 6 -50.0 170.0 MAX_GRAD 0.0 FORMAT "%4.1" /end AXIS_DESCR
/end CHARACTERISTIC
/begin MEASUREMENT B_FST_CAN_FEHLERKENNUNG "Fehlerkennzeichnung = el. Fehler" UBYTE FORMULA_0711 0 0 0.0 255.0 READ_WRITE BIT_MASK 0x2 ECU_ADDRESS 0x3FBF5D /end MEASUREMENT
/begin MEASUREMENT B_FST_CAN_INIT "fst_li/re ist initialisiert" UBYTE FORMULA_0204 0 0 0.0 255.0 READ_WRITE BIT_MASK 0x10 ECU_ADDRESS 0x3FBF5D /end MEASUREMENT
/begin MEASUREMENT B_FST_KEIN_CAN "Kein CAN-Telegramm" UBYTE FORMULA_0712 0 0 0.0 255.0 READ_WRITE BIT_MASK 0x4 ECU_ADDRESS 0x3FBF5D /end MEASUREMENT
/begin MEASUREMENT B_FST_NACHTANK "Nachtanken erkannt fuer DMTL" UBYTE FORMULA_0206 0 0 0.0 255.0 READ_WRITE BIT_MASK 0x40 ECU_ADDRESS 0x3FBF5D /end MEASUREMENT
/begin MEASUREMENT B_FST_NACHTANK_LA "Nachtanken erkannt fuer LA-Diag" UBYTE FORMULA_0207 0 0 0.0 255.0 READ_WRITE BIT_MASK 0x80 ECU_ADDRESS 0x3FBF5D /end MEASUREMENT
/begin MEASUREMENT B_FST_UNPLAUSIBEL "Fuellstand unplausibel" UBYTE FORMULA_0713 0 0 0.0 255.0 READ_WRITE BIT_MASK 0x8 ECU_ADDRESS 0x3FBF5D /end MEASUREMENT
/begin MEASUREMENT diag_st_atic35_AKL "Diagnosestatus ATIC35 Treiber Queue INJ" UBYTE FORMULA_0209 0 0.0 0.0 15.0 READ_WRITE BIT_MASK 0xF ECU_ADDRESS 0x3FBE39 /end MEASUREMENT
/begin MEASUREMENT diag_st_atic35_EKP "Diagnosestatus ATIC35 Treiber Queue INJ" UBYTE FORMULA_0209 0 0.0 0.0 15.0 READ_WRITE BIT_MASK 0xF ECU_ADDRESS 0x3FBE3E /end MEASUREMENT
/begin MEASUREMENT diag_st_atic35_EVAP2 "Diagnosestatus ATIC35 Treiber Queue INJ" UBYTE FORMULA_0209 0 0.0 0.0 15.0 READ_WRITE BIT_MASK 0xF ECU_ADDRESS 0x3FBE3C /end MEASUREMENT
/begin MEASUREMENT diag_st_atic35_KLIMA "Diagnosestatus ATIC35 Treiber Queue INJ" UBYTE FORMULA_0209 0 0.0 0.0 15.0 READ_WRITE BIT_MASK 0xF ECU_ADDRESS 0x3FBE41 /end MEASUREMENT
/begin MEASUREMENT diag_st_atic35_nn "Diagnosestatus ATIC35 Treiber Queue INJ" UBYTE FORMULA_0209 0 0.0 0.0 15.0 READ_WRITE BIT_MASK 0xF ECU_ADDRESS 0x3FBE35 /end MEASUREMENT
/begin MEASUREMENT diag_st_atic35_NWA1 "Diagnosestatus ATIC35 Treiber Queue INJ" UBYTE FORMULA_0209 0 0.0 0.0 15.0 READ_WRITE BIT_MASK 0xF ECU_ADDRESS 0x3FBE37 /end MEASUREMENT
/begin MEASUREMENT diag_st_atic35_NWA2 "Diagnosestatus ATIC35 Treiber Queue INJ" UBYTE FORMULA_0209 0 0.0 0.0 15.0 READ_WRITE BIT_MASK 0xF ECU_ADDRESS 0x3FBE3B /end MEASUREMENT
/begin MEASUREMENT diag_st_atic35_NWE1 "Diagnosestatus ATIC35 Treiber Queue INJ" UBYTE FORMULA_0209 0 0.0 0.0 15.0 READ_WRITE BIT_MASK 0xF ECU_ADDRESS 0x3FBE36 /end MEASUREMENT
/begin MEASUREMENT diag_st_atic35_NWE2 "Diagnosestatus ATIC35 Treiber Queue INJ" UBYTE FORMULA_0209 0 0.0 0.0 15.0 READ_WRITE BIT_MASK 0xF ECU_ADDRESS 0x3FBE3A /end MEASUREMENT
/begin MEASUREMENT diag_st_atic35_SERVO_EVAP1 "Diagnosestatus ATIC35 Treiber Queue INJ" UBYTE FORMULA_0209 0 0.0 0.0 15.0 READ_WRITE BIT_MASK 0xF ECU_ADDRESS 0x3FBE3D /end MEASUREMENT
/begin MEASUREMENT diag_st_atic35_SPORTLED "Diagnosestatus ATIC35 Treiber Queue INJ" UBYTE FORMULA_0209 0 0.0 0.0 15.0 READ_WRITE BIT_MASK 0xF ECU_ADDRESS 0x3FBE40 /end MEASUREMENT
/begin MEASUREMENT diag_st_atic35_TD "Diagnosestatus ATIC35 Treiber Queue INJ" UBYTE FORMULA_0209 0 0.0 0.0 15.0 READ_WRITE BIT_MASK 0xF ECU_ADDRESS 0x3FBE3F /end MEASUREMENT
/begin MEASUREMENT diag_st_atic35_VANOSDSV "Diagnosestatus ATIC35 Treiber Queue INJ" UBYTE FORMULA_0209 0 0.0 0.0 15.0 READ_WRITE BIT_MASK 0xF ECU_ADDRESS 0x3FBE38 /end MEASUREMENT
/begin MEASUREMENT diag_st_atic39_DK1_ENABLE "Diagnosestatus ATIC39 Treiber Queue INJ" UBYTE FORMULA_0209 0 0.0 0.0 15.0 READ_WRITE BIT_MASK 0xF ECU_ADDRESS 0x3FBE2F /end MEASUREMENT
/begin MEASUREMENT diag_st_atic39_DK2_ENABLE "Diagnosestatus ATIC39 Treiber Queue INJ" UBYTE FORMULA_0209 0 0.0 0.0 15.0 READ_WRITE BIT_MASK 0xF ECU_ADDRESS 0x3FBE30 /end MEASUREMENT
/begin MEASUREMENT diag_st_atic39_DMTLH "Diagnosestatus ATIC39 Treiber Queue INJ" UBYTE FORMULA_0209 0 0.0 0.0 15.0 READ_WRITE BIT_MASK 0xF ECU_ADDRESS 0x3FBE11 /end MEASUREMENT
/begin MEASUREMENT diag_st_atic39_DMTLP "Diagnosestatus ATIC39 Treiber Queue INJ" UBYTE FORMULA_0209 0 0.0 0.0 15.0 READ_WRITE BIT_MASK 0xF ECU_ADDRESS 0x3FBE34 /end MEASUREMENT
/begin MEASUREMENT diag_st_atic39_DMTLV "Diagnosestatus ATIC39 Treiber Queue INJ" UBYTE FORMULA_0209 0 0.0 0.0 15.0 READ_WRITE BIT_MASK 0xF ECU_ADDRESS 0x3FBE13 /end MEASUREMENT
/begin MEASUREMENT diag_st_atic39_EBOXL "Diagnosestatus ATIC39 Treiber Queue INJ" UBYTE FORMULA_0209 0 0.0 0.0 15.0 READ_WRITE BIT_MASK 0xF ECU_ADDRESS 0x3FBE2D /end MEASUREMENT
/begin MEASUREMENT diag_st_atic39_ELUE "Diagnosestatus ATIC39 Treiber Queue INJ" UBYTE FORMULA_0209 0 0.0 0.0 15.0 READ_WRITE BIT_MASK 0xF ECU_ADDRESS 0x3FBE33 /end MEASUREMENT
/begin MEASUREMENT diag_st_atic39_ELUP1 "Diagnosestatus ATIC39 Treiber Queue INJ" UBYTE FORMULA_0209 0 0.0 0.0 15.0 READ_WRITE BIT_MASK 0xF ECU_ADDRESS 0x3FBE21 /end MEASUREMENT
/begin MEASUREMENT diag_st_atic39_ELUP2 "Diagnosestatus ATIC39 Treiber Queue INJ" UBYTE FORMULA_0209 0 0.0 0.0 15.0 READ_WRITE BIT_MASK 0xF ECU_ADDRESS 0x3FBE22 /end MEASUREMENT
/begin MEASUREMENT diag_st_atic39_ELUP3 "Diagnosestatus ATIC39 Treiber Queue INJ" UBYTE FORMULA_0209 0 0.0 0.0 15.0 READ_WRITE BIT_MASK 0xF ECU_ADDRESS 0x3FBE23 /end MEASUREMENT
/begin MEASUREMENT diag_st_atic39_EV1 "Diagnosestatus ATIC39 Treiber Queue INJ" UBYTE FORMULA_0209 0 0.0 0.0 15.0 READ_WRITE BIT_MASK 0xF ECU_ADDRESS 0x3FBE07 /end MEASUREMENT
/begin MEASUREMENT diag_st_atic39_EV10 "Diagnosestatus ATIC39 Treiber Queue INJ" UBYTE FORMULA_0209 0 0.0 0.0 15.0 READ_WRITE BIT_MASK 0xF ECU_ADDRESS 0x3FBE1A /end MEASUREMENT
/begin MEASUREMENT diag_st_atic39_EV2 "Diagnosestatus ATIC39 Treiber Queue INJ" UBYTE FORMULA_0209 0 0.0 0.0 15.0 READ_WRITE BIT_MASK 0xF ECU_ADDRESS 0x3FBE08 /end MEASUREMENT
/begin MEASUREMENT diag_st_atic39_EV3 "Diagnosestatus ATIC39 Treiber Queue INJ" UBYTE FORMULA_0209 0 0.0 0.0 15.0 READ_WRITE BIT_MASK 0xF ECU_ADDRESS 0x3FBE09 /end MEASUREMENT
/begin MEASUREMENT diag_st_atic39_EV4 "Diagnosestatus ATIC39 Treiber Queue INJ" UBYTE FORMULA_0209 0 0.0 0.0 15.0 READ_WRITE BIT_MASK 0xF ECU_ADDRESS 0x3FBE0A /end MEASUREMENT
/begin MEASUREMENT diag_st_atic39_EV5 "Diagnosestatus ATIC39 Treiber Queue INJ" UBYTE FORMULA_0209 0 0.0 0.0 15.0 READ_WRITE BIT_MASK 0xF ECU_ADDRESS 0x3FBE0B /end MEASUREMENT
/begin MEASUREMENT diag_st_atic39_EV6 "Diagnosestatus ATIC39 Treiber Queue INJ" UBYTE FORMULA_0209 0 0.0 0.0 15.0 READ_WRITE BIT_MASK 0xF ECU_ADDRESS 0x3FBE0C /end MEASUREMENT
/begin MEASUREMENT diag_st_atic39_EV7 "Diagnosestatus ATIC39 Treiber Queue INJ" UBYTE FORMULA_0209 0 0.0 0.0 15.0 READ_WRITE BIT_MASK 0xF ECU_ADDRESS 0x3FBE17 /end MEASUREMENT
/begin MEASUREMENT diag_st_atic39_EV8 "Diagnosestatus ATIC39 Treiber Queue INJ" UBYTE FORMULA_0209 0 0.0 0.0 15.0 READ_WRITE BIT_MASK 0xF ECU_ADDRESS 0x3FBE18 /end MEASUREMENT
/begin MEASUREMENT diag_st_atic39_EV9 "Diagnosestatus ATIC39 Treiber Queue INJ" UBYTE FORMULA_0209 0 0.0 0.0 15.0 READ_WRITE BIT_MASK 0xF ECU_ADDRESS 0x3FBE19 /end MEASUREMENT
/begin MEASUREMENT diag_st_atic39_IGC1 "Diagnosestatus ATIC39 Treiber Queue INJ" UBYTE FORMULA_0209 0 0.0 0.0 15.0 READ_WRITE BIT_MASK 0xF ECU_ADDRESS 0x3FBE0D /end MEASUREMENT
/begin MEASUREMENT diag_st_atic39_IGC10 "Diagnosestatus ATIC39 Treiber Queue INJ" UBYTE FORMULA_0209 0 0.0 0.0 15.0 READ_WRITE BIT_MASK 0xF ECU_ADDRESS 0x3FBE24 /end MEASUREMENT
/begin MEASUREMENT diag_st_atic39_IGC11 "Diagnosestatus ATIC39 Treiber Queue INJ" UBYTE FORMULA_0209 0 0.0 0.0 15.0 READ_WRITE BIT_MASK 0xF ECU_ADDRESS 0x3FBE12 /end MEASUREMENT
/begin MEASUREMENT diag_st_atic39_IGC2 "Diagnosestatus ATIC39 Treiber Queue INJ" UBYTE FORMULA_0209 0 0.0 0.0 15.0 READ_WRITE BIT_MASK 0xF ECU_ADDRESS 0x3FBE0E /end MEASUREMENT
/begin MEASUREMENT diag_st_atic39_IGC3 "Diagnosestatus ATIC39 Treiber Queue INJ" UBYTE FORMULA_0209 0 0.0 0.0 15.0 READ_WRITE BIT_MASK 0xF ECU_ADDRESS 0x3FBE0F /end MEASUREMENT
/begin MEASUREMENT diag_st_atic39_IGC4 "Diagnosestatus ATIC39 Treiber Queue INJ" UBYTE FORMULA_0209 0 0.0 0.0 15.0 READ_WRITE BIT_MASK 0xF ECU_ADDRESS 0x3FBE10 /end MEASUREMENT
/begin MEASUREMENT diag_st_atic39_IGC5 "Diagnosestatus ATIC39 Treiber Queue INJ" UBYTE FORMULA_0209 0 0.0 0.0 15.0 READ_WRITE BIT_MASK 0xF ECU_ADDRESS 0x3FBE14 /end MEASUREMENT
/begin MEASUREMENT diag_st_atic39_IGC6 "Diagnosestatus ATIC39 Treiber Queue INJ" UBYTE FORMULA_0209 0 0.0 0.0 15.0 READ_WRITE BIT_MASK 0xF ECU_ADDRESS 0x3FBE1D /end MEASUREMENT
/begin MEASUREMENT diag_st_atic39_IGC7 "Diagnosestatus ATIC39 Treiber Queue INJ" UBYTE FORMULA_0209 0 0.0 0.0 15.0 READ_WRITE BIT_MASK 0xF ECU_ADDRESS 0x3FBE1E /end MEASUREMENT
/begin MEASUREMENT diag_st_atic39_IGC8 "Diagnosestatus ATIC39 Treiber Queue INJ" UBYTE FORMULA_0209 0 0.0 0.0 15.0 READ_WRITE BIT_MASK 0xF ECU_ADDRESS 0x3FBE1F /end MEASUREMENT
/begin MEASUREMENT diag_st_atic39_IGC9 "Diagnosestatus ATIC39 Treiber Queue INJ" UBYTE FORMULA_0209 0 0.0 0.0 15.0 READ_WRITE BIT_MASK 0xF ECU_ADDRESS 0x3FBE20 /end MEASUREMENT
/begin MEASUREMENT diag_st_atic39_LHN1 "Diagnosestatus ATIC39 Treiber Queue INJ" UBYTE FORMULA_0209 0 0.0 0.0 15.0 READ_WRITE BIT_MASK 0xF ECU_ADDRESS 0x3FBE25 /end MEASUREMENT
/begin MEASUREMENT diag_st_atic39_LHN2 "Diagnosestatus ATIC39 Treiber Queue INJ" UBYTE FORMULA_0209 0 0.0 0.0 15.0 READ_WRITE BIT_MASK 0xF ECU_ADDRESS 0x3FBE26 /end MEASUREMENT
/begin MEASUREMENT diag_st_atic39_LHV1 "Diagnosestatus ATIC39 Treiber Queue INJ" UBYTE FORMULA_0209 0 0.0 0.0 15.0 READ_WRITE BIT_MASK 0xF ECU_ADDRESS 0x3FBE05 /end MEASUREMENT
/begin MEASUREMENT diag_st_atic39_LHV1_ "Diagnosestatus ATIC39 Treiber Queue INJ" UBYTE FORMULA_0209 0 0.0 0.0 15.0 READ_WRITE BIT_MASK 0xF ECU_ADDRESS 0x3FBE06 /end MEASUREMENT
/begin MEASUREMENT diag_st_atic39_LHV2 "Diagnosestatus ATIC39 Treiber Queue INJ" UBYTE FORMULA_0209 0 0.0 0.0 15.0 READ_WRITE BIT_MASK 0xF ECU_ADDRESS 0x3FBE15 /end MEASUREMENT
/begin MEASUREMENT diag_st_atic39_LHV2_ "Diagnosestatus ATIC39 Treiber Queue INJ" UBYTE FORMULA_0209 0 0.0 0.0 15.0 READ_WRITE BIT_MASK 0xF ECU_ADDRESS 0x3FBE16 /end MEASUREMENT
/begin MEASUREMENT diag_st_atic39_LLFSO "Diagnosestatus ATIC39 Treiber Queue INJ" UBYTE FORMULA_0209 0 0.0 0.0 15.0 READ_WRITE BIT_MASK 0xF ECU_ADDRESS 0x3FBE2B /end MEASUREMENT
/begin MEASUREMENT diag_st_atic39_LLFSS "Diagnosestatus ATIC39 Treiber Queue INJ" UBYTE FORMULA_0209 0 0.0 0.0 15.0 READ_WRITE BIT_MASK 0xF ECU_ADDRESS 0x3FBE2C /end MEASUREMENT
/begin MEASUREMENT diag_st_atic39_nn "Diagnosestatus ATIC39 Treiber Queue INJ" UBYTE FORMULA_0209 0 0.0 0.0 15.0 READ_WRITE BIT_MASK 0xF ECU_ADDRESS 0x3FBE04 /end MEASUREMENT
/begin MEASUREMENT diag_st_atic39_RLSLP "Diagnosestatus ATIC39 Treiber Queue INJ" UBYTE FORMULA_0209 0 0.0 0.0 15.0 READ_WRITE BIT_MASK 0xF ECU_ADDRESS 0x3FBE32 /end MEASUREMENT
/begin MEASUREMENT diag_st_atic39_RLSTART "Diagnosestatus ATIC39 Treiber Queue INJ" UBYTE FORMULA_0209 0 0.0 0.0 15.0 READ_WRITE BIT_MASK 0xF ECU_ADDRESS 0x3FBE31 /end MEASUREMENT
/begin MEASUREMENT diag_st_atic39_RLU87 "Diagnosestatus ATIC39 Treiber Queue INJ" UBYTE FORMULA_0209 0 0.0 0.0 15.0 READ_WRITE BIT_MASK 0xF ECU_ADDRESS 0x3FBE2E /end MEASUREMENT
/begin MEASUREMENT diag_st_atic39_SERVO1 "Diagnosestatus ATIC39 Treiber Queue INJ" UBYTE FORMULA_0209 0 0.0 0.0 15.0 READ_WRITE BIT_MASK 0xF ECU_ADDRESS 0x3FBE1B /end MEASUREMENT
/begin MEASUREMENT diag_st_atic39_SERVO2 "Diagnosestatus ATIC39 Treiber Queue INJ" UBYTE FORMULA_0209 0 0.0 0.0 15.0 READ_WRITE BIT_MASK 0xF ECU_ADDRESS 0x3FBE1C /end MEASUREMENT
/begin MEASUREMENT diag_st_atic39_SLV "Diagnosestatus ATIC39 Treiber Queue INJ" UBYTE FORMULA_0209 0 0.0 0.0 15.0 READ_WRITE BIT_MASK 0xF ECU_ADDRESS 0x3FBE29 /end MEASUREMENT
/begin MEASUREMENT diag_st_atic39_SLV_ "Diagnosestatus ATIC39 Treiber Queue INJ" UBYTE FORMULA_0209 0 0.0 0.0 15.0 READ_WRITE BIT_MASK 0xF ECU_ADDRESS 0x3FBE2A /end MEASUREMENT
/begin MEASUREMENT diag_st_atic39_TEV1 "Diagnosestatus ATIC39 Treiber Queue INJ" UBYTE FORMULA_0209 0 0.0 0.0 15.0 READ_WRITE BIT_MASK 0xF ECU_ADDRESS 0x3FBE27 /end MEASUREMENT
/begin MEASUREMENT diag_st_atic39_TEV2 "Diagnosestatus ATIC39 Treiber Queue INJ" UBYTE FORMULA_0209 0 0.0 0.0 15.0 READ_WRITE BIT_MASK 0xF ECU_ADDRESS 0x3FBE28 /end MEASUREMENT
/begin MEASUREMENT diag_tr_atic35_error "Error Zaheler Atic35" UBYTE FORMULA_0037 0 0.0 0.0 255.0 READ_WRITE ECU_ADDRESS 0x3FBE01 /end MEASUREMENT
/begin MEASUREMENT diag_tr_atic35_st "Diagnosetreiberstatus" UBYTE FORMULA_0629 0 0.0 0.0 255.0 READ_WRITE ECU_ADDRESS 0x3FBE43 /end MEASUREMENT
/begin MEASUREMENT diag_tr_atic35_tx_cnt "Checkbyte fuer die Queue" UBYTE FORMULA_0037 0 0.0 0.0 255.0 READ_WRITE ECU_ADDRESS 0x3FBE00 /end MEASUREMENT
/begin MEASUREMENT diag_tr_atic39_error "Error Zaheler Atic39" UBYTE FORMULA_0037 0 0.0 0.0 255.0 READ_WRITE ECU_ADDRESS 0x3FBE03 /end MEASUREMENT
/begin MEASUREMENT diag_tr_atic39_st "Diagnosetreiberstatus" UBYTE FORMULA_0629 0 0.0 0.0 255.0 READ_WRITE ECU_ADDRESS 0x3FBE42 /end MEASUREMENT
/begin MEASUREMENT diag_tr_atic39_tx_cnt "Checkbyte fuer die Queue" UBYTE FORMULA_0037 0 0.0 0.0 255.0 READ_WRITE ECU_ADDRESS 0x3FBE02 /end MEASUREMENT
/begin MEASUREMENT dwf_n_max "Maxwert von KL_N_BEGR_GANG" SWORD FORMULA_0006 0 0.0 0.0 10000.0 READ_WRITE ECU_ADDRESS 0x3FBE94 /end MEASUREMENT
/begin MEASUREMENT dwf_n_rot "roter Drehzahlbereich" UBYTE FORMULA_0166 0 0.0 0.0 12750.0 READ_WRITE ECU_ADDRESS 0x3FBE96 /end MEASUREMENT
/begin MEASUREMENT dwf_repeat "Wiederholzaehler" UBYTE FORMULA_0003 0 0.0 0.0 255.0 READ_WRITE ECU_ADDRESS 0x3FBE97 /end MEASUREMENT
/begin MEASUREMENT dwf_shli_dn "gefilt. Gradient" SWORD FORMULA_0105 0 0.0 -10000.0 10000.0 READ_WRITE ECU_ADDRESS 0x3FBE9A /end MEASUREMENT
/begin MEASUREMENT dwf_shli_n "gefilt. Drehzahl" SWORD FORMULA_0006 0 0.0 0.0 10000.0 READ_WRITE ECU_ADDRESS 0x3FBE9C /end MEASUREMENT
/begin MEASUREMENT dwf_shli_seg "angezeigte Segmente" UBYTE FORMULA_0656 0 0.0 0.0 10.0 READ_WRITE ECU_ADDRESS 0x3FBE99 /end MEASUREMENT
/begin MEASUREMENT dwf_shli_st "Status Shiftlights" UBYTE FORMULA_0003 0 0.0 0.0 255.0 READ_WRITE ECU_ADDRESS 0x3FBE98 /end MEASUREMENT
/begin MEASUREMENT dwf_shli_st_bl "Shiftlights Blinken" UBYTE FORMULA_0655 0 0 0.0 255.0 READ_WRITE BIT_MASK 0x4 ECU_ADDRESS 0x3FBE98 /end MEASUREMENT
/begin MEASUREMENT dwf_shli_st_fls "Shiftlights Flash Ein" UBYTE FORMULA_0654 0 0 0.0 255.0 READ_WRITE BIT_MASK 0x2 ECU_ADDRESS 0x3FBE98 /end MEASUREMENT
/begin MEASUREMENT dwf_shli_st_on "Shiftlights Ein" UBYTE FORMULA_0653 0 0 0.0 255.0 READ_WRITE BIT_MASK 0x1 ECU_ADDRESS 0x3FBE98 /end MEASUREMENT
/begin MEASUREMENT dwf_shli_tbegr "Zeit bis zum Begrenzer" UWORD FORMULA_0021 0 0.0 0.0 10.0 READ_WRITE ECU_ADDRESS 0x3FBE9E /end MEASUREMENT
/begin MEASUREMENT dwf_shli_tseg "Zeit fuer ein Segment" UWORD FORMULA_0021 0 0.0 0.0 10.0 READ_WRITE ECU_ADDRESS 0x3FBEA0 /end MEASUREMENT
/begin MEASUREMENT ebox_elu_exd_timeout "KWP-Ansteuerzeit" UBYTE FORMULA_0461 0 0.0 0.0 25.5 READ_WRITE ECU_ADDRESS 0x3FBEA3 /end MEASUREMENT
/begin MEASUREMENT ebox_elu_st "Status der E-Box E-Luefteransteuerung" UBYTE FORMULA_0661 0 0.0 0.0 255.0 READ_WRITE BIT_MASK 0x3 ECU_ADDRESS 0x3FBEA2 /end MEASUREMENT
/begin MEASUREMENT ed_css_time "Zeit fuer CSS-Denominator" UWORD FORMULA_0071 0 0.0 0.0 6553.5 READ_WRITE ECU_ADDRESS 0x3FBEA6 /end MEASUREMENT
/begin MEASUREMENT ed_debug_laufzeit "Laufzeitmessung" ULONG FORMULA_0072 0 0.0 0.0 4294967295.0 READ_WRITE ECU_ADDRESS 0x3FBEB0 /end MEASUREMENT
/begin MEASUREMENT ed_fil_appl_data_inj.art_aktuell_nv "Fehlerart und Statusbits" UWORD FORMULA_0052 0 0.0 0.0 65535.0 READ_WRITE BIT_MASK 0xB4F ECU_ADDRESS 0x3F9ACA /end MEASUREMENT
/begin MEASUREMENT ed_fil_appl_data_inj.fehler_aufrufe_nv "Gesamtzahl der Fehleraufrufe" UBYTE FORMULA_0003 0 0.0 0.0 255.0 READ_WRITE ECU_ADDRESS 0x3F9ACD /end MEASUREMENT
/begin MEASUREMENT ed_fil_appl_data_inj.filter_max_nv "Maximaler Fehlerfilterwert" UBYTE FORMULA_0003 0 0.0 0.0 255.0 READ_WRITE ECU_ADDRESS 0x3F9ACC /end MEASUREMENT
/begin MEASUREMENT ed_fil_appl_data_inj.filter_nv "Filterwert vor und nach Eintrag" UBYTE FORMULA_0003 0 0.0 0.0 255.0 READ_WRITE ECU_ADDRESS 0x3F9AC8 /end MEASUREMENT
/begin MEASUREMENT ed_fil_appl_data_inj.zyklus_filter_nv "Vorwaertsfilter zur Fehlerzustandsbestaetigung" UBYTE FORMULA_0003 0 0.0 0.0 255.0 READ_WRITE ECU_ADDRESS 0x3F9AC9 /end MEASUREMENT
/begin MEASUREMENT ed_fil_codierung.art_aktuell_nv "Fehlerart und Statusbits" UWORD FORMULA_0052 0 0.0 0.0 65535.0 READ_WRITE BIT_MASK 0xB4F ECU_ADDRESS 0x3F9BDE /end MEASUREMENT
/begin MEASUREMENT ed_fil_codierung.fehler_aufrufe_nv "Gesamtzahl der Fehleraufrufe" UBYTE FORMULA_0003 0 0.0 0.0 255.0 READ_WRITE ECU_ADDRESS 0x3F9BE1 /end MEASUREMENT
/begin MEASUREMENT ed_fil_codierung.filter_max_nv "Maximaler Fehlerfilterwert" UBYTE FORMULA_0003 0 0.0 0.0 255.0 READ_WRITE ECU_ADDRESS 0x3F9BE0 /end MEASUREMENT
/begin MEASUREMENT ed_fil_codierung.filter_nv "Filterwert vor und nach Eintrag" UBYTE FORMULA_0003 0 0.0 0.0 255.0 READ_WRITE ECU_ADDRESS 0x3F9BDC /end MEASUREMENT
/begin MEASUREMENT ed_fil_codierung.zyklus_filter_nv "Vorwaertsfilter zur Fehlerzustandsbestaetigung" UBYTE FORMULA_0003 0 0.0 0.0 255.0 READ_WRITE ECU_ADDRESS 0x3F9BDD /end MEASUREMENT
/begin MEASUREMENT ed_fil_dk1_enltg.art_aktuell_nv "Fehlerart und Statusbits" UWORD FORMULA_0052 0 0.0 0.0 65535.0 READ_WRITE BIT_MASK 0xB4F ECU_ADDRESS 0x3F9CA4 /end MEASUREMENT
/begin MEASUREMENT ed_fil_dk1_enltg.fehler_aufrufe_nv "Gesamtzahl der Fehleraufrufe" UBYTE FORMULA_0003 0 0.0 0.0 255.0 READ_WRITE ECU_ADDRESS 0x3F9CA7 /end MEASUREMENT
/begin MEASUREMENT ed_fil_dk1_enltg.filter_max_nv "Maximaler Fehlerfilterwert" UBYTE FORMULA_0003 0 0.0 0.0 255.0 READ_WRITE ECU_ADDRESS 0x3F9CA6 /end MEASUREMENT
/begin MEASUREMENT ed_fil_dk1_enltg.filter_nv "Filterwert vor und nach Eintrag" UBYTE FORMULA_0003 0 0.0 0.0 255.0 READ_WRITE ECU_ADDRESS 0x3F9CA2 /end MEASUREMENT
/begin MEASUREMENT ed_fil_dk1_enltg.zyklus_filter_nv "Vorwaertsfilter zur Fehlerzustandsbestaetigung" UBYTE FORMULA_0003 0 0.0 0.0 255.0 READ_WRITE ECU_ADDRESS 0x3F9CA3 /end MEASUREMENT
/begin MEASUREMENT ed_fil_dk2_enltg.art_aktuell_nv "Fehlerart und Statusbits" UWORD FORMULA_0052 0 0.0 0.0 65535.0 READ_WRITE BIT_MASK 0xB4F ECU_ADDRESS 0x3F9CAA /end MEASUREMENT
/begin MEASUREMENT ed_fil_dk2_enltg.fehler_aufrufe_nv "Gesamtzahl der Fehleraufrufe" UBYTE FORMULA_0003 0 0.0 0.0 255.0 READ_WRITE ECU_ADDRESS 0x3F9CAD /end MEASUREMENT
/begin MEASUREMENT ed_fil_dk2_enltg.filter_max_nv "Maximaler Fehlerfilterwert" UBYTE FORMULA_0003 0 0.0 0.0 255.0 READ_WRITE ECU_ADDRESS 0x3F9CAC /end MEASUREMENT
/begin MEASUREMENT ed_fil_dk2_enltg.filter_nv "Filterwert vor und nach Eintrag" UBYTE FORMULA_0003 0 0.0 0.0 255.0 READ_WRITE ECU_ADDRESS 0x3F9CA8 /end MEASUREMENT
/begin MEASUREMENT ed_fil_dk2_enltg.zyklus_filter_nv "Vorwaertsfilter zur Fehlerzustandsbestaetigung" UBYTE FORMULA_0003 0 0.0 0.0 255.0 READ_WRITE ECU_ADDRESS 0x3F9CA9 /end MEASUREMENT
/begin MEASUREMENT ed_fil_dmtl_deckel.art_aktuell_nv "Fehlerart und Statusbits" UWORD FORMULA_0052 0 0.0 0.0 65535.0 READ_WRITE BIT_MASK 0xB4F ECU_ADDRESS 0x3F9BC0 /end MEASUREMENT
/begin MEASUREMENT ed_fil_dmtl_deckel.fehler_aufrufe_nv "Gesamtzahl der Fehleraufrufe" UBYTE FORMULA_0003 0 0.0 0.0 255.0 READ_WRITE ECU_ADDRESS 0x3F9BC3 /end MEASUREMENT
/begin MEASUREMENT ed_fil_dmtl_deckel.filter_max_nv "Maximaler Fehlerfilterwert" UBYTE FORMULA_0003 0 0.0 0.0 255.0 READ_WRITE ECU_ADDRESS 0x3F9BC2 /end MEASUREMENT
/begin MEASUREMENT ed_fil_dmtl_deckel.filter_nv "Filterwert vor und nach Eintrag" UBYTE FORMULA_0003 0 0.0 0.0 255.0 READ_WRITE ECU_ADDRESS 0x3F9BBE /end MEASUREMENT
/begin MEASUREMENT ed_fil_dmtl_deckel.zyklus_filter_nv "Vorwaertsfilter zur Fehlerzustandsbestaetigung" UBYTE FORMULA_0003 0 0.0 0.0 255.0 READ_WRITE ECU_ADDRESS 0x3F9BBF /end MEASUREMENT
/begin MEASUREMENT ed_fil_dmtl_feinleck.art_aktuell_nv "Fehlerart und Statusbits" UWORD FORMULA_0052 0 0.0 0.0 65535.0 READ_WRITE BIT_MASK 0xB4F ECU_ADDRESS 0x3F9D70 /end MEASUREMENT
/begin MEASUREMENT ed_fil_dmtl_feinleck.fehler_aufrufe_nv "Gesamtzahl der Fehleraufrufe" UBYTE FORMULA_0003 0 0.0 0.0 255.0 READ_WRITE ECU_ADDRESS 0x3F9D73 /end MEASUREMENT
/begin MEASUREMENT ed_fil_dmtl_feinleck.filter_max_nv "Maximaler Fehlerfilterwert" UBYTE FORMULA_0003 0 0.0 0.0 255.0 READ_WRITE ECU_ADDRESS 0x3F9D72 /end MEASUREMENT
/begin MEASUREMENT ed_fil_dmtl_feinleck.filter_nv "Filterwert vor und nach Eintrag" UBYTE FORMULA_0003 0 0.0 0.0 255.0 READ_WRITE ECU_ADDRESS 0x3F9D6E /end MEASUREMENT
/begin MEASUREMENT ed_fil_dmtl_feinleck.zyklus_filter_nv "Vorwaertsfilter zur Fehlerzustandsbestaetigung" UBYTE FORMULA_0003 0 0.0 0.0 255.0 READ_WRITE ECU_ADDRESS 0x3F9D6F /end MEASUREMENT
/begin MEASUREMENT ed_fil_dmtl_feucht.art_aktuell_nv "Fehlerart und Statusbits" UWORD FORMULA_0052 0 0.0 0.0 65535.0 READ_WRITE BIT_MASK 0xB4F ECU_ADDRESS 0x3F9BBA /end MEASUREMENT
/begin MEASUREMENT ed_fil_dmtl_feucht.fehler_aufrufe_nv "Gesamtzahl der Fehleraufrufe" UBYTE FORMULA_0003 0 0.0 0.0 255.0 READ_WRITE ECU_ADDRESS 0x3F9BBD /end MEASUREMENT
/begin MEASUREMENT ed_fil_dmtl_feucht.filter_max_nv "Maximaler Fehlerfilterwert" UBYTE FORMULA_0003 0 0.0 0.0 255.0 READ_WRITE ECU_ADDRESS 0x3F9BBC /end MEASUREMENT
/begin MEASUREMENT ed_fil_dmtl_feucht.filter_nv "Filterwert vor und nach Eintrag" UBYTE FORMULA_0003 0 0.0 0.0 255.0 READ_WRITE ECU_ADDRESS 0x3F9BB8 /end MEASUREMENT
/begin MEASUREMENT ed_fil_dmtl_feucht.zyklus_filter_nv "Vorwaertsfilter zur Fehlerzustandsbestaetigung" UBYTE FORMULA_0003 0 0.0 0.0 255.0 READ_WRITE ECU_ADDRESS 0x3F9BB9 /end MEASUREMENT
/begin MEASUREMENT ed_fil_dmtl_grobleck.art_aktuell_nv "Fehlerart und Statusbits" UWORD FORMULA_0052 0 0.0 0.0 65535.0 READ_WRITE BIT_MASK 0xB4F ECU_ADDRESS 0x3F9BB4 /end MEASUREMENT
/begin MEASUREMENT ed_fil_dmtl_grobleck.fehler_aufrufe_nv "Gesamtzahl der Fehleraufrufe" UBYTE FORMULA_0003 0 0.0 0.0 255.0 READ_WRITE ECU_ADDRESS 0x3F9BB7 /end MEASUREMENT
/begin MEASUREMENT ed_fil_dmtl_grobleck.filter_max_nv "Maximaler Fehlerfilterwert" UBYTE FORMULA_0003 0 0.0 0.0 255.0 READ_WRITE ECU_ADDRESS 0x3F9BB6 /end MEASUREMENT
/begin MEASUREMENT ed_fil_dmtl_grobleck.filter_nv "Filterwert vor und nach Eintrag" UBYTE FORMULA_0003 0 0.0 0.0 255.0 READ_WRITE ECU_ADDRESS 0x3F9BB2 /end MEASUREMENT
/begin MEASUREMENT ed_fil_dmtl_grobleck.zyklus_filter_nv "Vorwaertsfilter zur Fehlerzustandsbestaetigung" UBYTE FORMULA_0003 0 0.0 0.0 255.0 READ_WRITE ECU_ADDRESS 0x3F9BB3 /end MEASUREMENT
/begin MEASUREMENT ed_fil_dmtl_h.art_aktuell_nv "Fehlerart und Statusbits" UWORD FORMULA_0052 0 0.0 0.0 65535.0 READ_WRITE BIT_MASK 0xB4F ECU_ADDRESS 0x3F9BAE /end MEASUREMENT
/begin MEASUREMENT ed_fil_dmtl_h.fehler_aufrufe_nv "Gesamtzahl der Fehleraufrufe" UBYTE FORMULA_0003 0 0.0 0.0 255.0 READ_WRITE ECU_ADDRESS 0x3F9BB1 /end MEASUREMENT
/begin MEASUREMENT ed_fil_dmtl_h.filter_max_nv "Maximaler Fehlerfilterwert" UBYTE FORMULA_0003 0 0.0 0.0 255.0 READ_WRITE ECU_ADDRESS 0x3F9BB0 /end MEASUREMENT
/begin MEASUREMENT ed_fil_dmtl_h.filter_nv "Filterwert vor und nach Eintrag" UBYTE FORMULA_0003 0 0.0 0.0 255.0 READ_WRITE ECU_ADDRESS 0x3F9BAC /end MEASUREMENT
/begin MEASUREMENT ed_fil_dmtl_h.zyklus_filter_nv "Vorwaertsfilter zur Fehlerzustandsbestaetigung" UBYTE FORMULA_0003 0 0.0 0.0 255.0 READ_WRITE ECU_ADDRESS 0x3F9BAD /end MEASUREMENT
/begin MEASUREMENT ed_fil_dmtl_p.art_aktuell_nv "Fehlerart und Statusbits" UWORD FORMULA_0052 0 0.0 0.0 65535.0 READ_WRITE BIT_MASK 0xB4F ECU_ADDRESS 0x3F9BA2 /end MEASUREMENT
/begin MEASUREMENT ed_fil_dmtl_p.fehler_aufrufe_nv "Gesamtzahl der Fehleraufrufe" UBYTE FORMULA_0003 0 0.0 0.0 255.0 READ_WRITE ECU_ADDRESS 0x3F9BA5 /end MEASUREMENT
/begin MEASUREMENT ed_fil_dmtl_p.filter_max_nv "Maximaler Fehlerfilterwert" UBYTE FORMULA_0003 0 0.0 0.0 255.0 READ_WRITE ECU_ADDRESS 0x3F9BA4 /end MEASUREMENT
/begin MEASUREMENT ed_fil_dmtl_p.filter_nv "Filterwert vor und nach Eintrag" UBYTE FORMULA_0003 0 0.0 0.0 255.0 READ_WRITE ECU_ADDRESS 0x3F9BA0 /end MEASUREMENT
/begin MEASUREMENT ed_fil_dmtl_p.zyklus_filter_nv "Vorwaertsfilter zur Fehlerzustandsbestaetigung" UBYTE FORMULA_0003 0 0.0 0.0 255.0 READ_WRITE ECU_ADDRESS 0x3F9BA1 /end MEASUREMENT
/begin MEASUREMENT ed_fil_dmtl_v.art_aktuell_nv "Fehlerart und Statusbits" UWORD FORMULA_0052 0 0.0 0.0 65535.0 READ_WRITE BIT_MASK 0xB4F ECU_ADDRESS 0x3F9BA8 /end MEASUREMENT
/begin MEASUREMENT ed_fil_dmtl_v.fehler_aufrufe_nv "Gesamtzahl der Fehleraufrufe" UBYTE FORMULA_0003 0 0.0 0.0 255.0 READ_WRITE ECU_ADDRESS 0x3F9BAB /end MEASUREMENT
/begin MEASUREMENT ed_fil_dmtl_v.filter_max_nv "Maximaler Fehlerfilterwert" UBYTE FORMULA_0003 0 0.0 0.0 255.0 READ_WRITE ECU_ADDRESS 0x3F9BAA /end MEASUREMENT
/begin MEASUREMENT ed_fil_dmtl_v.filter_nv "Filterwert vor und nach Eintrag" UBYTE FORMULA_0003 0 0.0 0.0 255.0 READ_WRITE ECU_ADDRESS 0x3F9BA6 /end MEASUREMENT
/begin MEASUREMENT ed_fil_dmtl_v.zyklus_filter_nv "Vorwaertsfilter zur Fehlerzustandsbestaetigung" UBYTE FORMULA_0003 0 0.0 0.0 255.0 READ_WRITE ECU_ADDRESS 0x3F9BA7 /end MEASUREMENT
/begin MEASUREMENT ed_fil_e2_inj.art_aktuell_nv "Fehlerart und Statusbits" UWORD FORMULA_0052 0 0.0 0.0 65535.0 READ_WRITE BIT_MASK 0xB4F ECU_ADDRESS 0x3F9CCE /end MEASUREMENT
/begin MEASUREMENT ed_fil_e2_inj.fehler_aufrufe_nv "Gesamtzahl der Fehleraufrufe" UBYTE FORMULA_0003 0 0.0 0.0 255.0 READ_WRITE ECU_ADDRESS 0x3F9CD1 /end MEASUREMENT
/begin MEASUREMENT ed_fil_e2_inj.filter_max_nv "Maximaler Fehlerfilterwert" UBYTE FORMULA_0003 0 0.0 0.0 255.0 READ_WRITE ECU_ADDRESS 0x3F9CD0 /end MEASUREMENT
/begin MEASUREMENT ed_fil_e2_inj.filter_nv "Filterwert vor und nach Eintrag" UBYTE FORMULA_0003 0 0.0 0.0 255.0 READ_WRITE ECU_ADDRESS 0x3F9CCC /end MEASUREMENT
/begin MEASUREMENT ed_fil_e2_inj.zyklus_filter_nv "Vorwaertsfilter zur Fehlerzustandsbestaetigung" UBYTE FORMULA_0003 0 0.0 0.0 255.0 READ_WRITE ECU_ADDRESS 0x3F9CCD /end MEASUREMENT
/begin MEASUREMENT ed_fil_ebox_elu.art_aktuell_nv "Fehlerart und Statusbits" UWORD FORMULA_0052 0 0.0 0.0 65535.0 READ_WRITE BIT_MASK 0xB4F ECU_ADDRESS 0x3F9C98 /end MEASUREMENT
/begin MEASUREMENT ed_fil_ebox_elu.fehler_aufrufe_nv "Gesamtzahl der Fehleraufrufe" UBYTE FORMULA_0003 0 0.0 0.0 255.0 READ_WRITE ECU_ADDRESS 0x3F9C9B /end MEASUREMENT
/begin MEASUREMENT ed_fil_ebox_elu.filter_max_nv "Maximaler Fehlerfilterwert" UBYTE FORMULA_0003 0 0.0 0.0 255.0 READ_WRITE ECU_ADDRESS 0x3F9C9A /end MEASUREMENT
/begin MEASUREMENT ed_fil_ebox_elu.filter_nv "Filterwert vor und nach Eintrag" UBYTE FORMULA_0003 0 0.0 0.0 255.0 READ_WRITE ECU_ADDRESS 0x3F9C96 /end MEASUREMENT
/begin MEASUREMENT ed_fil_ebox_elu.zyklus_filter_nv "Vorwaertsfilter zur Fehlerzustandsbestaetigung" UBYTE FORMULA_0003 0 0.0 0.0 255.0 READ_WRITE ECU_ADDRESS 0x3F9C97 /end MEASUREMENT
/begin MEASUREMENT ed_fil_ekp_pwm.art_aktuell_nv "Fehlerart und Statusbits" UWORD FORMULA_0052 0 0.0 0.0 65535.0 READ_WRITE BIT_MASK 0xB4F ECU_ADDRESS 0x3F9BD8 /end MEASUREMENT
/begin MEASUREMENT ed_fil_ekp_pwm.fehler_aufrufe_nv "Gesamtzahl der Fehleraufrufe" UBYTE FORMULA_0003 0 0.0 0.0 255.0 READ_WRITE ECU_ADDRESS 0x3F9BDB /end MEASUREMENT
/begin MEASUREMENT ed_fil_ekp_pwm.filter_max_nv "Maximaler Fehlerfilterwert" UBYTE FORMULA_0003 0 0.0 0.0 255.0 READ_WRITE ECU_ADDRESS 0x3F9BDA /end MEASUREMENT
/begin MEASUREMENT ed_fil_ekp_pwm.filter_nv "Filterwert vor und nach Eintrag" UBYTE FORMULA_0003 0 0.0 0.0 255.0 READ_WRITE ECU_ADDRESS 0x3F9BD6 /end MEASUREMENT
/begin MEASUREMENT ed_fil_ekp_pwm.zyklus_filter_nv "Vorwaertsfilter zur Fehlerzustandsbestaetigung" UBYTE FORMULA_0003 0 0.0 0.0 255.0 READ_WRITE ECU_ADDRESS 0x3F9BD7 /end MEASUREMENT
/begin MEASUREMENT ed_fil_elu.art_aktuell_nv "Fehlerart und Statusbits" UWORD FORMULA_0052 0 0.0 0.0 65535.0 READ_WRITE BIT_MASK 0xB4F ECU_ADDRESS 0x3F9D2E /end MEASUREMENT
/begin MEASUREMENT ed_fil_elu.fehler_aufrufe_nv "Gesamtzahl der Fehleraufrufe" UBYTE FORMULA_0003 0 0.0 0.0 255.0 READ_WRITE ECU_ADDRESS 0x3F9D31 /end MEASUREMENT
/begin MEASUREMENT ed_fil_elu.filter_max_nv "Maximaler Fehlerfilterwert" UBYTE FORMULA_0003 0 0.0 0.0 255.0 READ_WRITE ECU_ADDRESS 0x3F9D30 /end MEASUREMENT
/begin MEASUREMENT ed_fil_elu.filter_nv "Filterwert vor und nach Eintrag" UBYTE FORMULA_0003 0 0.0 0.0 255.0 READ_WRITE ECU_ADDRESS 0x3F9D2C /end MEASUREMENT
/begin MEASUREMENT ed_fil_elu.zyklus_filter_nv "Vorwaertsfilter zur Fehlerzustandsbestaetigung" UBYTE FORMULA_0003 0 0.0 0.0 255.0 READ_WRITE ECU_ADDRESS 0x3F9D2D /end MEASUREMENT
/begin MEASUREMENT ed_fil_elup.art_aktuell_nv "Fehlerart und Statusbits" UWORD FORMULA_0052 0 0.0 0.0 65535.0 READ_WRITE BIT_MASK 0xB4F ECU_ADDRESS 0x3F9D28 /end MEASUREMENT
/begin MEASUREMENT ed_fil_elup.fehler_aufrufe_nv "Gesamtzahl der Fehleraufrufe" UBYTE FORMULA_0003 0 0.0 0.0 255.0 READ_WRITE ECU_ADDRESS 0x3F9D2B /end MEASUREMENT
/begin MEASUREMENT ed_fil_elup.filter_max_nv "Maximaler Fehlerfilterwert" UBYTE FORMULA_0003 0 0.0 0.0 255.0 READ_WRITE ECU_ADDRESS 0x3F9D2A /end MEASUREMENT
/begin MEASUREMENT ed_fil_elup.filter_nv "Filterwert vor und nach Eintrag" UBYTE FORMULA_0003 0 0.0 0.0 255.0 READ_WRITE ECU_ADDRESS 0x3F9D26 /end MEASUREMENT
/begin MEASUREMENT ed_fil_elup.zyklus_filter_nv "Vorwaertsfilter zur Fehlerzustandsbestaetigung" UBYTE FORMULA_0003 0 0.0 0.0 255.0 READ_WRITE ECU_ADDRESS 0x3F9D27 /end MEASUREMENT
/begin MEASUREMENT ed_fil_ev1.art_aktuell_nv "Fehlerart und Statusbits" UWORD FORMULA_0052 0 0.0 0.0 65535.0 READ_WRITE BIT_MASK 0xB4F ECU_ADDRESS 0x3F9B48 /end MEASUREMENT
/begin MEASUREMENT ed_fil_ev1.fehler_aufrufe_nv "Gesamtzahl der Fehleraufrufe" UBYTE FORMULA_0003 0 0.0 0.0 255.0 READ_WRITE ECU_ADDRESS 0x3F9B4B /end MEASUREMENT
/begin MEASUREMENT ed_fil_ev1.filter_max_nv "Maximaler Fehlerfilterwert" UBYTE FORMULA_0003 0 0.0 0.0 255.0 READ_WRITE ECU_ADDRESS 0x3F9B4A /end MEASUREMENT
/begin MEASUREMENT ed_fil_ev1.filter_nv "Filterwert vor und nach Eintrag" UBYTE FORMULA_0003 0 0.0 0.0 255.0 READ_WRITE ECU_ADDRESS 0x3F9B46 /end MEASUREMENT
/begin MEASUREMENT ed_fil_ev1.zyklus_filter_nv "Vorwaertsfilter zur Fehlerzustandsbestaetigung" UBYTE FORMULA_0003 0 0.0 0.0 255.0 READ_WRITE ECU_ADDRESS 0x3F9B47 /end MEASUREMENT
/begin MEASUREMENT ed_fil_ev10.art_aktuell_nv "Fehlerart und Statusbits" UWORD FORMULA_0052 0 0.0 0.0 65535.0 READ_WRITE BIT_MASK 0xB4F ECU_ADDRESS 0x3F9B7E /end MEASUREMENT
/begin MEASUREMENT ed_fil_ev10.fehler_aufrufe_nv "Gesamtzahl der Fehleraufrufe" UBYTE FORMULA_0003 0 0.0 0.0 255.0 READ_WRITE ECU_ADDRESS 0x3F9B81 /end MEASUREMENT
/begin MEASUREMENT ed_fil_ev10.filter_max_nv "Maximaler Fehlerfilterwert" UBYTE FORMULA_0003 0 0.0 0.0 255.0 READ_WRITE ECU_ADDRESS 0x3F9B80 /end MEASUREMENT
/begin MEASUREMENT ed_fil_ev10.filter_nv "Filterwert vor und nach Eintrag" UBYTE FORMULA_0003 0 0.0 0.0 255.0 READ_WRITE ECU_ADDRESS 0x3F9B7C /end MEASUREMENT
/begin MEASUREMENT ed_fil_ev10.zyklus_filter_nv "Vorwaertsfilter zur Fehlerzustandsbestaetigung" UBYTE FORMULA_0003 0 0.0 0.0 255.0 READ_WRITE ECU_ADDRESS 0x3F9B7D /end MEASUREMENT
/begin MEASUREMENT ed_fil_ev2.art_aktuell_nv "Fehlerart und Statusbits" UWORD FORMULA_0052 0 0.0 0.0 65535.0 READ_WRITE BIT_MASK 0xB4F ECU_ADDRESS 0x3F9B4E /end MEASUREMENT
/begin MEASUREMENT ed_fil_ev2.fehler_aufrufe_nv "Gesamtzahl der Fehleraufrufe" UBYTE FORMULA_0003 0 0.0 0.0 255.0 READ_WRITE ECU_ADDRESS 0x3F9B51 /end MEASUREMENT
/begin MEASUREMENT ed_fil_ev2.filter_max_nv "Maximaler Fehlerfilterwert" UBYTE FORMULA_0003 0 0.0 0.0 255.0 READ_WRITE ECU_ADDRESS 0x3F9B50 /end MEASUREMENT
/begin MEASUREMENT ed_fil_ev2.filter_nv "Filterwert vor und nach Eintrag" UBYTE FORMULA_0003 0 0.0 0.0 255.0 READ_WRITE ECU_ADDRESS 0x3F9B4C /end MEASUREMENT
/begin MEASUREMENT ed_fil_ev2.zyklus_filter_nv "Vorwaertsfilter zur Fehlerzustandsbestaetigung" UBYTE FORMULA_0003 0 0.0 0.0 255.0 READ_WRITE ECU_ADDRESS 0x3F9B4D /end MEASUREMENT
/begin MEASUREMENT ed_fil_ev3.art_aktuell_nv "Fehlerart und Statusbits" UWORD FORMULA_0052 0 0.0 0.0 65535.0 READ_WRITE BIT_MASK 0xB4F ECU_ADDRESS 0x3F9B54 /end MEASUREMENT
/begin MEASUREMENT ed_fil_ev3.fehler_aufrufe_nv "Gesamtzahl der Fehleraufrufe" UBYTE FORMULA_0003 0 0.0 0.0 255.0 READ_WRITE ECU_ADDRESS 0x3F9B57 /end MEASUREMENT
/begin MEASUREMENT ed_fil_ev3.filter_max_nv "Maximaler Fehlerfilterwert" UBYTE FORMULA_0003 0 0.0 0.0 255.0 READ_WRITE ECU_ADDRESS 0x3F9B56 /end MEASUREMENT
/begin MEASUREMENT ed_fil_ev3.filter_nv "Filterwert vor und nach Eintrag" UBYTE FORMULA_0003 0 0.0 0.0 255.0 READ_WRITE ECU_ADDRESS 0x3F9B52 /end MEASUREMENT
/begin MEASUREMENT ed_fil_ev3.zyklus_filter_nv "Vorwaertsfilter zur Fehlerzustandsbestaetigung" UBYTE FORMULA_0003 0 0.0 0.0 255.0 READ_WRITE ECU_ADDRESS 0x3F9B53 /end MEASUREMENT
/begin MEASUREMENT ed_fil_ev4.art_aktuell_nv "Fehlerart und Statusbits" UWORD FORMULA_0052 0 0.0 0.0 65535.0 READ_WRITE BIT_MASK 0xB4F ECU_ADDRESS 0x3F9B5A /end MEASUREMENT
/begin MEASUREMENT ed_fil_ev4.fehler_aufrufe_nv "Gesamtzahl der Fehleraufrufe" UBYTE FORMULA_0003 0 0.0 0.0 255.0 READ_WRITE ECU_ADDRESS 0x3F9B5D /end MEASUREMENT
/begin MEASUREMENT ed_fil_ev4.filter_max_nv "Maximaler Fehlerfilterwert" UBYTE FORMULA_0003 0 0.0 0.0 255.0 READ_WRITE ECU_ADDRESS 0x3F9B5C /end MEASUREMENT
/begin MEASUREMENT ed_fil_ev4.filter_nv "Filterwert vor und nach Eintrag" UBYTE FORMULA_0003 0 0.0 0.0 255.0 READ_WRITE ECU_ADDRESS 0x3F9B58 /end MEASUREMENT
/begin MEASUREMENT ed_fil_ev4.zyklus_filter_nv "Vorwaertsfilter zur Fehlerzustandsbestaetigung" UBYTE FORMULA_0003 0 0.0 0.0 255.0 READ_WRITE ECU_ADDRESS 0x3F9B59 /end MEASUREMENT
/begin MEASUREMENT ed_fil_ev5.art_aktuell_nv "Fehlerart und Statusbits" UWORD FORMULA_0052 0 0.0 0.0 65535.0 READ_WRITE BIT_MASK 0xB4F ECU_ADDRESS 0x3F9B60 /end MEASUREMENT
/begin MEASUREMENT ed_fil_ev5.fehler_aufrufe_nv "Gesamtzahl der Fehleraufrufe" UBYTE FORMULA_0003 0 0.0 0.0 255.0 READ_WRITE ECU_ADDRESS 0x3F9B63 /end MEASUREMENT
/begin MEASUREMENT ed_fil_ev5.filter_max_nv "Maximaler Fehlerfilterwert" UBYTE FORMULA_0003 0 0.0 0.0 255.0 READ_WRITE ECU_ADDRESS 0x3F9B62 /end MEASUREMENT
/begin MEASUREMENT ed_fil_ev5.filter_nv "Filterwert vor und nach Eintrag" UBYTE FORMULA_0003 0 0.0 0.0 255.0 READ_WRITE ECU_ADDRESS 0x3F9B5E /end MEASUREMENT
/begin MEASUREMENT ed_fil_ev5.zyklus_filter_nv "Vorwaertsfilter zur Fehlerzustandsbestaetigung" UBYTE FORMULA_0003 0 0.0 0.0 255.0 READ_WRITE ECU_ADDRESS 0x3F9B5F /end MEASUREMENT
/begin MEASUREMENT ed_fil_ev6.art_aktuell_nv "Fehlerart und Statusbits" UWORD FORMULA_0052 0 0.0 0.0 65535.0 READ_WRITE BIT_MASK 0xB4F ECU_ADDRESS 0x3F9B66 /end MEASUREMENT
/begin MEASUREMENT ed_fil_ev6.fehler_aufrufe_nv "Gesamtzahl der Fehleraufrufe" UBYTE FORMULA_0003 0 0.0 0.0 255.0 READ_WRITE ECU_ADDRESS 0x3F9B69 /end MEASUREMENT
/begin MEASUREMENT ed_fil_ev6.filter_max_nv "Maximaler Fehlerfilterwert" UBYTE FORMULA_0003 0 0.0 0.0 255.0 READ_WRITE ECU_ADDRESS 0x3F9B68 /end MEASUREMENT
/begin MEASUREMENT ed_fil_ev6.filter_nv "Filterwert vor und nach Eintrag" UBYTE FORMULA_0003 0 0.0 0.0 255.0 READ_WRITE ECU_ADDRESS 0x3F9B64 /end MEASUREMENT
/begin MEASUREMENT ed_fil_ev6.zyklus_filter_nv "Vorwaertsfilter zur Fehlerzustandsbestaetigung" UBYTE FORMULA_0003 0 0.0 0.0 255.0 READ_WRITE ECU_ADDRESS 0x3F9B65 /end MEASUREMENT
/begin MEASUREMENT ed_fil_ev7.art_aktuell_nv "Fehlerart und Statusbits" UWORD FORMULA_0052 0 0.0 0.0 65535.0 READ_WRITE BIT_MASK 0xB4F ECU_ADDRESS 0x3F9B6C /end MEASUREMENT
/begin MEASUREMENT ed_fil_ev7.fehler_aufrufe_nv "Gesamtzahl der Fehleraufrufe" UBYTE FORMULA_0003 0 0.0 0.0 255.0 READ_WRITE ECU_ADDRESS 0x3F9B6F /end MEASUREMENT
/begin MEASUREMENT ed_fil_ev7.filter_max_nv "Maximaler Fehlerfilterwert" UBYTE FORMULA_0003 0 0.0 0.0 255.0 READ_WRITE ECU_ADDRESS 0x3F9B6E /end MEASUREMENT
/begin MEASUREMENT ed_fil_ev7.filter_nv "Filterwert vor und nach Eintrag" UBYTE FORMULA_0003 0 0.0 0.0 255.0 READ_WRITE ECU_ADDRESS 0x3F9B6A /end MEASUREMENT
/begin MEASUREMENT ed_fil_ev7.zyklus_filter_nv "Vorwaertsfilter zur Fehlerzustandsbestaetigung" UBYTE FORMULA_0003 0 0.0 0.0 255.0 READ_WRITE ECU_ADDRESS 0x3F9B6B /end MEASUREMENT
/begin MEASUREMENT ed_fil_ev8.art_aktuell_nv "Fehlerart und Statusbits" UWORD FORMULA_0052 0 0.0 0.0 65535.0 READ_WRITE BIT_MASK 0xB4F ECU_ADDRESS 0x3F9B72 /end MEASUREMENT
/begin MEASUREMENT ed_fil_ev8.fehler_aufrufe_nv "Gesamtzahl der Fehleraufrufe" UBYTE FORMULA_0003 0 0.0 0.0 255.0 READ_WRITE ECU_ADDRESS 0x3F9B75 /end MEASUREMENT
/begin MEASUREMENT ed_fil_ev8.filter_max_nv "Maximaler Fehlerfilterwert" UBYTE FORMULA_0003 0 0.0 0.0 255.0 READ_WRITE ECU_ADDRESS 0x3F9B74 /end MEASUREMENT
/begin MEASUREMENT ed_fil_ev8.filter_nv "Filterwert vor und nach Eintrag" UBYTE FORMULA_0003 0 0.0 0.0 255.0 READ_WRITE ECU_ADDRESS 0x3F9B70 /end MEASUREMENT
/begin MEASUREMENT ed_fil_ev8.zyklus_filter_nv "Vorwaertsfilter zur Fehlerzustandsbestaetigung" UBYTE FORMULA_0003 0 0.0 0.0 255.0 READ_WRITE ECU_ADDRESS 0x3F9B71 /end MEASUREMENT
/begin MEASUREMENT ed_fil_ev9.art_aktuell_nv "Fehlerart und Statusbits" UWORD FORMULA_0052 0 0.0 0.0 65535.0 READ_WRITE BIT_MASK 0xB4F ECU_ADDRESS 0x3F9B78 /end MEASUREMENT
/begin MEASUREMENT ed_fil_ev9.fehler_aufrufe_nv "Gesamtzahl der Fehleraufrufe" UBYTE FORMULA_0003 0 0.0 0.0 255.0 READ_WRITE ECU_ADDRESS 0x3F9B7B /end MEASUREMENT
/begin MEASUREMENT ed_fil_ev9.filter_max_nv "Maximaler Fehlerfilterwert" UBYTE FORMULA_0003 0 0.0 0.0 255.0 READ_WRITE ECU_ADDRESS 0x3F9B7A /end MEASUREMENT
/begin MEASUREMENT ed_fil_ev9.filter_nv "Filterwert vor und nach Eintrag" UBYTE FORMULA_0003 0 0.0 0.0 255.0 READ_WRITE ECU_ADDRESS 0x3F9B76 /end MEASUREMENT
/begin MEASUREMENT ed_fil_ev9.zyklus_filter_nv "Vorwaertsfilter zur Fehlerzustandsbestaetigung" UBYTE FORMULA_0003 0 0.0 0.0 255.0 READ_WRITE ECU_ADDRESS 0x3F9B77 /end MEASUREMENT
/begin MEASUREMENT ed_fil_ews_man.art_aktuell_nv "Fehlerart und Statusbits" UWORD FORMULA_0052 0 0.0 0.0 65535.0 READ_WRITE BIT_MASK 0xB4F ECU_ADDRESS 0x3F9C74 /end MEASUREMENT
/begin MEASUREMENT ed_fil_ews_man.fehler_aufrufe_nv "Gesamtzahl der Fehleraufrufe" UBYTE FORMULA_0003 0 0.0 0.0 255.0 READ_WRITE ECU_ADDRESS 0x3F9C77 /end MEASUREMENT
/begin MEASUREMENT ed_fil_ews_man.filter_max_nv "Maximaler Fehlerfilterwert" UBYTE FORMULA_0003 0 0.0 0.0 255.0 READ_WRITE ECU_ADDRESS 0x3F9C76 /end MEASUREMENT
/begin MEASUREMENT ed_fil_ews_man.filter_nv "Filterwert vor und nach Eintrag" UBYTE FORMULA_0003 0 0.0 0.0 255.0 READ_WRITE ECU_ADDRESS 0x3F9C72 /end MEASUREMENT
/begin MEASUREMENT ed_fil_ews_man.zyklus_filter_nv "Vorwaertsfilter zur Fehlerzustandsbestaetigung" UBYTE FORMULA_0003 0 0.0 0.0 255.0 READ_WRITE ECU_ADDRESS 0x3F9C73 /end MEASUREMENT
/begin MEASUREMENT ed_fil_ews_sci.art_aktuell_nv "Fehlerart und Statusbits" UWORD FORMULA_0052 0 0.0 0.0 65535.0 READ_WRITE BIT_MASK 0xB4F ECU_ADDRESS 0x3F9C6E /end MEASUREMENT
/begin MEASUREMENT ed_fil_ews_sci.fehler_aufrufe_nv "Gesamtzahl der Fehleraufrufe" UBYTE FORMULA_0003 0 0.0 0.0 255.0 READ_WRITE ECU_ADDRESS 0x3F9C71 /end MEASUREMENT
/begin MEASUREMENT ed_fil_ews_sci.filter_max_nv "Maximaler Fehlerfilterwert" UBYTE FORMULA_0003 0 0.0 0.0 255.0 READ_WRITE ECU_ADDRESS 0x3F9C70 /end MEASUREMENT
/begin MEASUREMENT ed_fil_ews_sci.filter_nv "Filterwert vor und nach Eintrag" UBYTE FORMULA_0003 0 0.0 0.0 255.0 READ_WRITE ECU_ADDRESS 0x3F9C6C /end MEASUREMENT
/begin MEASUREMENT ed_fil_ews_sci.zyklus_filter_nv "Vorwaertsfilter zur Fehlerzustandsbestaetigung" UBYTE FORMULA_0003 0 0.0 0.0 255.0 READ_WRITE ECU_ADDRESS 0x3F9C6D /end MEASUREMENT
/begin MEASUREMENT ed_fil_fetrawe.art_aktuell_nv "Fehlerart und Statusbits" UWORD FORMULA_0052 0 0.0 0.0 65535.0 READ_WRITE BIT_MASK 0xB4F ECU_ADDRESS 0x3F9D10 /end MEASUREMENT
/begin MEASUREMENT ed_fil_fetrawe.fehler_aufrufe_nv "Gesamtzahl der Fehleraufrufe" UBYTE FORMULA_0003 0 0.0 0.0 255.0 READ_WRITE ECU_ADDRESS 0x3F9D13 /end MEASUREMENT
/begin MEASUREMENT ed_fil_fetrawe.filter_max_nv "Maximaler Fehlerfilterwert" UBYTE FORMULA_0003 0 0.0 0.0 255.0 READ_WRITE ECU_ADDRESS 0x3F9D12 /end MEASUREMENT
/begin MEASUREMENT ed_fil_fetrawe.filter_nv "Filterwert vor und nach Eintrag" UBYTE FORMULA_0003 0 0.0 0.0 255.0 READ_WRITE ECU_ADDRESS 0x3F9D0E /end MEASUREMENT
/begin MEASUREMENT ed_fil_fetrawe.zyklus_filter_nv "Vorwaertsfilter zur Fehlerzustandsbestaetigung" UBYTE FORMULA_0003 0 0.0 0.0 255.0 READ_WRITE ECU_ADDRESS 0x3F9D0F /end MEASUREMENT
/begin MEASUREMENT ed_fil_fi_bsd.art_aktuell_nv "Fehlerart und Statusbits" UWORD FORMULA_0052 0 0.0 0.0 65535.0 READ_WRITE BIT_MASK 0xB4F ECU_ADDRESS 0x3F9C2C /end MEASUREMENT
/begin MEASUREMENT ed_fil_fi_bsd.fehler_aufrufe_nv "Gesamtzahl der Fehleraufrufe" UBYTE FORMULA_0003 0 0.0 0.0 255.0 READ_WRITE ECU_ADDRESS 0x3F9C2F /end MEASUREMENT
/begin MEASUREMENT ed_fil_fi_bsd.filter_max_nv "Maximaler Fehlerfilterwert" UBYTE FORMULA_0003 0 0.0 0.0 255.0 READ_WRITE ECU_ADDRESS 0x3F9C2E /end MEASUREMENT
/begin MEASUREMENT ed_fil_fi_bsd.filter_nv "Filterwert vor und nach Eintrag" UBYTE FORMULA_0003 0 0.0 0.0 255.0 READ_WRITE ECU_ADDRESS 0x3F9C2A /end MEASUREMENT
/begin MEASUREMENT ed_fil_fi_bsd.zyklus_filter_nv "Vorwaertsfilter zur Fehlerzustandsbestaetigung" UBYTE FORMULA_0003 0 0.0 0.0 255.0 READ_WRITE ECU_ADDRESS 0x3F9C2B /end MEASUREMENT
/begin MEASUREMENT ed_fil_fi_bsd_0.art_aktuell_nv "Fehlerart und Statusbits" UWORD FORMULA_0052 0 0.0 0.0 65535.0 READ_WRITE BIT_MASK 0xB4F ECU_ADDRESS 0x3F9C7A /end MEASUREMENT
/begin MEASUREMENT ed_fil_fi_bsd_0.fehler_aufrufe_nv "Gesamtzahl der Fehleraufrufe" UBYTE FORMULA_0003 0 0.0 0.0 255.0 READ_WRITE ECU_ADDRESS 0x3F9C7D /end MEASUREMENT
/begin MEASUREMENT ed_fil_fi_bsd_0.filter_max_nv "Maximaler Fehlerfilterwert" UBYTE FORMULA_0003 0 0.0 0.0 255.0 READ_WRITE ECU_ADDRESS 0x3F9C7C /end MEASUREMENT
/begin MEASUREMENT ed_fil_fi_bsd_0.filter_nv "Filterwert vor und nach Eintrag" UBYTE FORMULA_0003 0 0.0 0.0 255.0 READ_WRITE ECU_ADDRESS 0x3F9C78 /end MEASUREMENT
/begin MEASUREMENT ed_fil_fi_bsd_0.zyklus_filter_nv "Vorwaertsfilter zur Fehlerzustandsbestaetigung" UBYTE FORMULA_0003 0 0.0 0.0 255.0 READ_WRITE ECU_ADDRESS 0x3F9C79 /end MEASUREMENT
/begin MEASUREMENT ed_fil_fi_bsd_6.art_aktuell_nv "Fehlerart und Statusbits" UWORD FORMULA_0052 0 0.0 0.0 65535.0 READ_WRITE BIT_MASK 0xB4F ECU_ADDRESS 0x3F9C80 /end MEASUREMENT
/begin MEASUREMENT ed_fil_fi_bsd_6.fehler_aufrufe_nv "Gesamtzahl der Fehleraufrufe" UBYTE FORMULA_0003 0 0.0 0.0 255.0 READ_WRITE ECU_ADDRESS 0x3F9C83 /end MEASUREMENT
/begin MEASUREMENT ed_fil_fi_bsd_6.filter_max_nv "Maximaler Fehlerfilterwert" UBYTE FORMULA_0003 0 0.0 0.0 255.0 READ_WRITE ECU_ADDRESS 0x3F9C82 /end MEASUREMENT
/begin MEASUREMENT ed_fil_fi_bsd_6.filter_nv "Filterwert vor und nach Eintrag" UBYTE FORMULA_0003 0 0.0 0.0 255.0 READ_WRITE ECU_ADDRESS 0x3F9C7E /end MEASUREMENT
/begin MEASUREMENT ed_fil_fi_bsd_6.zyklus_filter_nv "Vorwaertsfilter zur Fehlerzustandsbestaetigung" UBYTE FORMULA_0003 0 0.0 0.0 255.0 READ_WRITE ECU_ADDRESS 0x3F9C7F /end MEASUREMENT
/begin MEASUREMENT ed_fil_fi_bsdglob.art_aktuell_nv "Fehlerart und Statusbits" UWORD FORMULA_0052 0 0.0 0.0 65535.0 READ_WRITE BIT_MASK 0xB4F ECU_ADDRESS 0x3F9C86 /end MEASUREMENT
/begin MEASUREMENT ed_fil_fi_bsdglob.fehler_aufrufe_nv "Gesamtzahl der Fehleraufrufe" UBYTE FORMULA_0003 0 0.0 0.0 255.0 READ_WRITE ECU_ADDRESS 0x3F9C89 /end MEASUREMENT
/begin MEASUREMENT ed_fil_fi_bsdglob.filter_max_nv "Maximaler Fehlerfilterwert" UBYTE FORMULA_0003 0 0.0 0.0 255.0 READ_WRITE ECU_ADDRESS 0x3F9C88 /end MEASUREMENT
/begin MEASUREMENT ed_fil_fi_bsdglob.filter_nv "Filterwert vor und nach Eintrag" UBYTE FORMULA_0003 0 0.0 0.0 255.0 READ_WRITE ECU_ADDRESS 0x3F9C84 /end MEASUREMENT
/begin MEASUREMENT ed_fil_fi_bsdglob.zyklus_filter_nv "Vorwaertsfilter zur Fehlerzustandsbestaetigung" UBYTE FORMULA_0003 0 0.0 0.0 255.0 READ_WRITE ECU_ADDRESS 0x3F9C85 /end MEASUREMENT
/begin MEASUREMENT ed_fil_fi_gen.art_aktuell_nv "Fehlerart und Statusbits" UWORD FORMULA_0052 0 0.0 0.0 65535.0 READ_WRITE BIT_MASK 0xB4F ECU_ADDRESS 0x3F9C26 /end MEASUREMENT
/begin MEASUREMENT ed_fil_fi_gen.fehler_aufrufe_nv "Gesamtzahl der Fehleraufrufe" UBYTE FORMULA_0003 0 0.0 0.0 255.0 READ_WRITE ECU_ADDRESS 0x3F9C29 /end MEASUREMENT
/begin MEASUREMENT ed_fil_fi_gen.filter_max_nv "Maximaler Fehlerfilterwert" UBYTE FORMULA_0003 0 0.0 0.0 255.0 READ_WRITE ECU_ADDRESS 0x3F9C28 /end MEASUREMENT
/begin MEASUREMENT ed_fil_fi_gen.filter_nv "Filterwert vor und nach Eintrag" UBYTE FORMULA_0003 0 0.0 0.0 255.0 READ_WRITE ECU_ADDRESS 0x3F9C24 /end MEASUREMENT
/begin MEASUREMENT ed_fil_fi_gen.zyklus_filter_nv "Vorwaertsfilter zur Fehlerzustandsbestaetigung" UBYTE FORMULA_0003 0 0.0 0.0 255.0 READ_WRITE ECU_ADDRESS 0x3F9C25 /end MEASUREMENT
/begin MEASUREMENT ed_fil_fi_ibs1.art_aktuell_nv "Fehlerart und Statusbits" UWORD FORMULA_0052 0 0.0 0.0 65535.0 READ_WRITE BIT_MASK 0xB4F ECU_ADDRESS 0x3F9C38 /end MEASUREMENT
/begin MEASUREMENT ed_fil_fi_ibs1.fehler_aufrufe_nv "Gesamtzahl der Fehleraufrufe" UBYTE FORMULA_0003 0 0.0 0.0 255.0 READ_WRITE ECU_ADDRESS 0x3F9C3B /end MEASUREMENT
/begin MEASUREMENT ed_fil_fi_ibs1.filter_max_nv "Maximaler Fehlerfilterwert" UBYTE FORMULA_0003 0 0.0 0.0 255.0 READ_WRITE ECU_ADDRESS 0x3F9C3A /end MEASUREMENT
/begin MEASUREMENT ed_fil_fi_ibs1.filter_nv "Filterwert vor und nach Eintrag" UBYTE FORMULA_0003 0 0.0 0.0 255.0 READ_WRITE ECU_ADDRESS 0x3F9C36 /end MEASUREMENT
/begin MEASUREMENT ed_fil_fi_ibs1.zyklus_filter_nv "Vorwaertsfilter zur Fehlerzustandsbestaetigung" UBYTE FORMULA_0003 0 0.0 0.0 255.0 READ_WRITE ECU_ADDRESS 0x3F9C37 /end MEASUREMENT
/begin MEASUREMENT ed_fil_fi_ibs2.art_aktuell_nv "Fehlerart und Statusbits" UWORD FORMULA_0052 0 0.0 0.0 65535.0 READ_WRITE BIT_MASK 0xB4F ECU_ADDRESS 0x3F9C3E /end MEASUREMENT
/begin MEASUREMENT ed_fil_fi_ibs2.fehler_aufrufe_nv "Gesamtzahl der Fehleraufrufe" UBYTE FORMULA_0003 0 0.0 0.0 255.0 READ_WRITE ECU_ADDRESS 0x3F9C41 /end MEASUREMENT
/begin MEASUREMENT ed_fil_fi_ibs2.filter_max_nv "Maximaler Fehlerfilterwert" UBYTE FORMULA_0003 0 0.0 0.0 255.0 READ_WRITE ECU_ADDRESS 0x3F9C40 /end MEASUREMENT
/begin MEASUREMENT ed_fil_fi_ibs2.filter_nv "Filterwert vor und nach Eintrag" UBYTE FORMULA_0003 0 0.0 0.0 255.0 READ_WRITE ECU_ADDRESS 0x3F9C3C /end MEASUREMENT
/begin MEASUREMENT ed_fil_fi_ibs2.zyklus_filter_nv "Vorwaertsfilter zur Fehlerzustandsbestaetigung" UBYTE FORMULA_0003 0 0.0 0.0 255.0 READ_WRITE ECU_ADDRESS 0x3F9C3D /end MEASUREMENT
/begin MEASUREMENT ed_fil_fi_ibs3.art_aktuell_nv "Fehlerart und Statusbits" UWORD FORMULA_0052 0 0.0 0.0 65535.0 READ_WRITE BIT_MASK 0xB4F ECU_ADDRESS 0x3F9C44 /end MEASUREMENT
/begin MEASUREMENT ed_fil_fi_ibs3.fehler_aufrufe_nv "Gesamtzahl der Fehleraufrufe" UBYTE FORMULA_0003 0 0.0 0.0 255.0 READ_WRITE ECU_ADDRESS 0x3F9C47 /end MEASUREMENT
/begin MEASUREMENT ed_fil_fi_ibs3.filter_max_nv "Maximaler Fehlerfilterwert" UBYTE FORMULA_0003 0 0.0 0.0 255.0 READ_WRITE ECU_ADDRESS 0x3F9C46 /end MEASUREMENT
/begin MEASUREMENT ed_fil_fi_ibs3.filter_nv "Filterwert vor und nach Eintrag" UBYTE FORMULA_0003 0 0.0 0.0 255.0 READ_WRITE ECU_ADDRESS 0x3F9C42 /end MEASUREMENT
/begin MEASUREMENT ed_fil_fi_ibs3.zyklus_filter_nv "Vorwaertsfilter zur Fehlerzustandsbestaetigung" UBYTE FORMULA_0003 0 0.0 0.0 255.0 READ_WRITE ECU_ADDRESS 0x3F9C43 /end MEASUREMENT
/begin MEASUREMENT ed_fil_fi_pmbatt.art_aktuell_nv "Fehlerart und Statusbits" UWORD FORMULA_0052 0 0.0 0.0 65535.0 READ_WRITE BIT_MASK 0xB4F ECU_ADDRESS 0x3F9C50 /end MEASUREMENT
/begin MEASUREMENT ed_fil_fi_pmbatt.fehler_aufrufe_nv "Gesamtzahl der Fehleraufrufe" UBYTE FORMULA_0003 0 0.0 0.0 255.0 READ_WRITE ECU_ADDRESS 0x3F9C53 /end MEASUREMENT
/begin MEASUREMENT ed_fil_fi_pmbatt.filter_max_nv "Maximaler Fehlerfilterwert" UBYTE FORMULA_0003 0 0.0 0.0 255.0 READ_WRITE ECU_ADDRESS 0x3F9C52 /end MEASUREMENT
/begin MEASUREMENT ed_fil_fi_pmbatt.filter_nv "Filterwert vor und nach Eintrag" UBYTE FORMULA_0003 0 0.0 0.0 255.0 READ_WRITE ECU_ADDRESS 0x3F9C4E /end MEASUREMENT
/begin MEASUREMENT ed_fil_fi_pmbatt.zyklus_filter_nv "Vorwaertsfilter zur Fehlerzustandsbestaetigung" UBYTE FORMULA_0003 0 0.0 0.0 255.0 READ_WRITE ECU_ADDRESS 0x3F9C4F /end MEASUREMENT
/begin MEASUREMENT ed_fil_fi_pmbn.art_aktuell_nv "Fehlerart und Statusbits" UWORD FORMULA_0052 0 0.0 0.0 65535.0 READ_WRITE BIT_MASK 0xB4F ECU_ADDRESS 0x3F9C4A /end MEASUREMENT
/begin MEASUREMENT ed_fil_fi_pmbn.fehler_aufrufe_nv "Gesamtzahl der Fehleraufrufe" UBYTE FORMULA_0003 0 0.0 0.0 255.0 READ_WRITE ECU_ADDRESS 0x3F9C4D /end MEASUREMENT
/begin MEASUREMENT ed_fil_fi_pmbn.filter_max_nv "Maximaler Fehlerfilterwert" UBYTE FORMULA_0003 0 0.0 0.0 255.0 READ_WRITE ECU_ADDRESS 0x3F9C4C /end MEASUREMENT
/begin MEASUREMENT ed_fil_fi_pmbn.filter_nv "Filterwert vor und nach Eintrag" UBYTE FORMULA_0003 0 0.0 0.0 255.0 READ_WRITE ECU_ADDRESS 0x3F9C48 /end MEASUREMENT
/begin MEASUREMENT ed_fil_fi_pmbn.zyklus_filter_nv "Vorwaertsfilter zur Fehlerzustandsbestaetigung" UBYTE FORMULA_0003 0 0.0 0.0 255.0 READ_WRITE ECU_ADDRESS 0x3F9C49 /end MEASUREMENT
/begin MEASUREMENT ed_fil_fi_pmruhverl.art_aktuell_nv "Fehlerart und Statusbits" UWORD FORMULA_0052 0 0.0 0.0 65535.0 READ_WRITE BIT_MASK 0xB4F ECU_ADDRESS 0x3F9C8C /end MEASUREMENT
/begin MEASUREMENT ed_fil_fi_pmruhverl.fehler_aufrufe_nv "Gesamtzahl der Fehleraufrufe" UBYTE FORMULA_0003 0 0.0 0.0 255.0 READ_WRITE ECU_ADDRESS 0x3F9C8F /end MEASUREMENT
/begin MEASUREMENT ed_fil_fi_pmruhverl.filter_max_nv "Maximaler Fehlerfilterwert" UBYTE FORMULA_0003 0 0.0 0.0 255.0 READ_WRITE ECU_ADDRESS 0x3F9C8E /end MEASUREMENT
/begin MEASUREMENT ed_fil_fi_pmruhverl.filter_nv "Filterwert vor und nach Eintrag" UBYTE FORMULA_0003 0 0.0 0.0 255.0 READ_WRITE ECU_ADDRESS 0x3F9C8A /end MEASUREMENT
/begin MEASUREMENT ed_fil_fi_pmruhverl.zyklus_filter_nv "Vorwaertsfilter zur Fehlerzustandsbestaetigung" UBYTE FORMULA_0003 0 0.0 0.0 255.0 READ_WRITE ECU_ADDRESS 0x3F9C8B /end MEASUREMENT
/begin MEASUREMENT ed_fil_fi_qlt.art_aktuell_nv "Fehlerart und Statusbits" UWORD FORMULA_0052 0 0.0 0.0 65535.0 READ_WRITE BIT_MASK 0xB4F ECU_ADDRESS 0x3F9C32 /end MEASUREMENT
/begin MEASUREMENT ed_fil_fi_qlt.fehler_aufrufe_nv "Gesamtzahl der Fehleraufrufe" UBYTE FORMULA_0003 0 0.0 0.0 255.0 READ_WRITE ECU_ADDRESS 0x3F9C35 /end MEASUREMENT
/begin MEASUREMENT ed_fil_fi_qlt.filter_max_nv "Maximaler Fehlerfilterwert" UBYTE FORMULA_0003 0 0.0 0.0 255.0 READ_WRITE ECU_ADDRESS 0x3F9C34 /end MEASUREMENT
/begin MEASUREMENT ed_fil_fi_qlt.filter_nv "Filterwert vor und nach Eintrag" UBYTE FORMULA_0003 0 0.0 0.0 255.0 READ_WRITE ECU_ADDRESS 0x3F9C30 /end MEASUREMENT
/begin MEASUREMENT ed_fil_fi_qlt.zyklus_filter_nv "Vorwaertsfilter zur Fehlerzustandsbestaetigung" UBYTE FORMULA_0003 0 0.0 0.0 255.0 READ_WRITE ECU_ADDRESS 0x3F9C31 /end MEASUREMENT
/begin MEASUREMENT ed_fil_fi_toens.art_aktuell_nv "Fehlerart und Statusbits" UWORD FORMULA_0052 0 0.0 0.0 65535.0 READ_WRITE BIT_MASK 0xB4F ECU_ADDRESS 0x3F9C92 /end MEASUREMENT
/begin MEASUREMENT ed_fil_fi_toens.fehler_aufrufe_nv "Gesamtzahl der Fehleraufrufe" UBYTE FORMULA_0003 0 0.0 0.0 255.0 READ_WRITE ECU_ADDRESS 0x3F9C95 /end MEASUREMENT
/begin MEASUREMENT ed_fil_fi_toens.filter_max_nv "Maximaler Fehlerfilterwert" UBYTE FORMULA_0003 0 0.0 0.0 255.0 READ_WRITE ECU_ADDRESS 0x3F9C94 /end MEASUREMENT
/begin MEASUREMENT ed_fil_fi_toens.filter_nv "Filterwert vor und nach Eintrag" UBYTE FORMULA_0003 0 0.0 0.0 255.0 READ_WRITE ECU_ADDRESS 0x3F9C90 /end MEASUREMENT
/begin MEASUREMENT ed_fil_fi_toens.zyklus_filter_nv "Vorwaertsfilter zur Fehlerzustandsbestaetigung" UBYTE FORMULA_0003 0 0.0 0.0 255.0 READ_WRITE ECU_ADDRESS 0x3F9C91 /end MEASUREMENT
/begin MEASUREMENT ed_fil_fplau1.art_aktuell_nv "Fehlerart und Statusbits" UWORD FORMULA_0052 0 0.0 0.0 65535.0 READ_WRITE BIT_MASK 0xB4F ECU_ADDRESS 0x3F9A28 /end MEASUREMENT
/begin MEASUREMENT ed_fil_fplau1.fehler_aufrufe_nv "Gesamtzahl der Fehleraufrufe" UBYTE FORMULA_0003 0 0.0 0.0 255.0 READ_WRITE ECU_ADDRESS 0x3F9A2B /end MEASUREMENT
/begin MEASUREMENT ed_fil_fplau1.filter_max_nv "Maximaler Fehlerfilterwert" UBYTE FORMULA_0003 0 0.0 0.0 255.0 READ_WRITE ECU_ADDRESS 0x3F9A2A /end MEASUREMENT
/begin MEASUREMENT ed_fil_fplau1.filter_nv "Filterwert vor und nach Eintrag" UBYTE FORMULA_0003 0 0.0 0.0 255.0 READ_WRITE ECU_ADDRESS 0x3F9A26 /end MEASUREMENT
/begin MEASUREMENT ed_fil_fplau1.zyklus_filter_nv "Vorwaertsfilter zur Fehlerzustandsbestaetigung" UBYTE FORMULA_0003 0 0.0 0.0 255.0 READ_WRITE ECU_ADDRESS 0x3F9A27 /end MEASUREMENT
/begin MEASUREMENT ed_fil_fplau2.art_aktuell_nv "Fehlerart und Statusbits" UWORD FORMULA_0052 0 0.0 0.0 65535.0 READ_WRITE BIT_MASK 0xB4F ECU_ADDRESS 0x3F9A2E /end MEASUREMENT
/begin MEASUREMENT ed_fil_fplau2.fehler_aufrufe_nv "Gesamtzahl der Fehleraufrufe" UBYTE FORMULA_0003 0 0.0 0.0 255.0 READ_WRITE ECU_ADDRESS 0x3F9A31 /end MEASUREMENT
/begin MEASUREMENT ed_fil_fplau2.filter_max_nv "Maximaler Fehlerfilterwert" UBYTE FORMULA_0003 0 0.0 0.0 255.0 READ_WRITE ECU_ADDRESS 0x3F9A30 /end MEASUREMENT
/begin MEASUREMENT ed_fil_fplau2.filter_nv "Filterwert vor und nach Eintrag" UBYTE FORMULA_0003 0 0.0 0.0 255.0 READ_WRITE ECU_ADDRESS 0x3F9A2C /end MEASUREMENT
/begin MEASUREMENT ed_fil_fplau2.zyklus_filter_nv "Vorwaertsfilter zur Fehlerzustandsbestaetigung" UBYTE FORMULA_0003 0 0.0 0.0 255.0 READ_WRITE ECU_ADDRESS 0x3F9A2D /end MEASUREMENT
/begin MEASUREMENT ed_fil_fst.art_aktuell_nv "Fehlerart und Statusbits" UWORD FORMULA_0052 0 0.0 0.0 65535.0 READ_WRITE BIT_MASK 0xB4F ECU_ADDRESS 0x3F9CF2 /end MEASUREMENT
/begin MEASUREMENT ed_fil_fst.fehler_aufrufe_nv "Gesamtzahl der Fehleraufrufe" UBYTE FORMULA_0003 0 0.0 0.0 255.0 READ_WRITE ECU_ADDRESS 0x3F9CF5 /end MEASUREMENT
/begin MEASUREMENT ed_fil_fst.filter_max_nv "Maximaler Fehlerfilterwert" UBYTE FORMULA_0003 0 0.0 0.0 255.0 READ_WRITE ECU_ADDRESS 0x3F9CF4 /end MEASUREMENT
/begin MEASUREMENT ed_fil_fst.filter_nv "Filterwert vor und nach Eintrag" UBYTE FORMULA_0003 0 0.0 0.0 255.0 READ_WRITE ECU_ADDRESS 0x3F9CF0 /end MEASUREMENT
/begin MEASUREMENT ed_fil_fst.zyklus_filter_nv "Vorwaertsfilter zur Fehlerzustandsbestaetigung" UBYTE FORMULA_0003 0 0.0 0.0 255.0 READ_WRITE ECU_ADDRESS 0x3F9CF1 /end MEASUREMENT
/begin MEASUREMENT ed_fil_fst_geber.art_aktuell_nv "Fehlerart und Statusbits" UWORD FORMULA_0052 0 0.0 0.0 65535.0 READ_WRITE BIT_MASK 0xB4F ECU_ADDRESS 0x3F9D5E /end MEASUREMENT
/begin MEASUREMENT ed_fil_fst_geber.fehler_aufrufe_nv "Gesamtzahl der Fehleraufrufe" UBYTE FORMULA_0003 0 0.0 0.0 255.0 READ_WRITE ECU_ADDRESS 0x3F9D61 /end MEASUREMENT
/begin MEASUREMENT ed_fil_fst_geber.filter_max_nv "Maximaler Fehlerfilterwert" UBYTE FORMULA_0003 0 0.0 0.0 255.0 READ_WRITE ECU_ADDRESS 0x3F9D60 /end MEASUREMENT
/begin MEASUREMENT ed_fil_fst_geber.filter_nv "Filterwert vor und nach Eintrag" UBYTE FORMULA_0003 0 0.0 0.0 255.0 READ_WRITE ECU_ADDRESS 0x3F9D5C /end MEASUREMENT
/begin MEASUREMENT ed_fil_fst_geber.zyklus_filter_nv "Vorwaertsfilter zur Fehlerzustandsbestaetigung" UBYTE FORMULA_0003 0 0.0 0.0 255.0 READ_WRITE ECU_ADDRESS 0x3F9D5D /end MEASUREMENT
/begin MEASUREMENT ed_fil_hfm1.art_aktuell_nv "Fehlerart und Statusbits" UWORD FORMULA_0052 0 0.0 0.0 65535.0 READ_WRITE BIT_MASK 0xB4F ECU_ADDRESS 0x3F994A /end MEASUREMENT
/begin MEASUREMENT ed_fil_hfm1.fehler_aufrufe_nv "Gesamtzahl der Fehleraufrufe" UBYTE FORMULA_0003 0 0.0 0.0 255.0 READ_WRITE ECU_ADDRESS 0x3F994D /end MEASUREMENT
/begin MEASUREMENT ed_fil_hfm1.filter_max_nv "Maximaler Fehlerfilterwert" UBYTE FORMULA_0003 0 0.0 0.0 255.0 READ_WRITE ECU_ADDRESS 0x3F994C /end MEASUREMENT
/begin MEASUREMENT ed_fil_hfm1.filter_nv "Filterwert vor und nach Eintrag" UBYTE FORMULA_0003 0 0.0 0.0 255.0 READ_WRITE ECU_ADDRESS 0x3F9948 /end MEASUREMENT
/begin MEASUREMENT ed_fil_hfm1.zyklus_filter_nv "Vorwaertsfilter zur Fehlerzustandsbestaetigung" UBYTE FORMULA_0003 0 0.0 0.0 255.0 READ_WRITE ECU_ADDRESS 0x3F9949 /end MEASUREMENT
/begin MEASUREMENT ed_fil_hfm2.art_aktuell_nv "Fehlerart und Statusbits" UWORD FORMULA_0052 0 0.0 0.0 65535.0 READ_WRITE BIT_MASK 0xB4F ECU_ADDRESS 0x3F9950 /end MEASUREMENT
/begin MEASUREMENT ed_fil_hfm2.fehler_aufrufe_nv "Gesamtzahl der Fehleraufrufe" UBYTE FORMULA_0003 0 0.0 0.0 255.0 READ_WRITE ECU_ADDRESS 0x3F9953 /end MEASUREMENT
/begin MEASUREMENT ed_fil_hfm2.filter_max_nv "Maximaler Fehlerfilterwert" UBYTE FORMULA_0003 0 0.0 0.0 255.0 READ_WRITE ECU_ADDRESS 0x3F9952 /end MEASUREMENT
/begin MEASUREMENT ed_fil_hfm2.filter_nv "Filterwert vor und nach Eintrag" UBYTE FORMULA_0003 0 0.0 0.0 255.0 READ_WRITE ECU_ADDRESS 0x3F994E /end MEASUREMENT
/begin MEASUREMENT ed_fil_hfm2.zyklus_filter_nv "Vorwaertsfilter zur Fehlerzustandsbestaetigung" UBYTE FORMULA_0003 0 0.0 0.0 255.0 READ_WRITE ECU_ADDRESS 0x3F994F /end MEASUREMENT
/begin MEASUREMENT ed_fil_index_135_inj.art_aktuell_nv "Fehlerart und Statusbits" UWORD FORMULA_0052 0 0.0 0.0 65535.0 READ_WRITE BIT_MASK 0xB4F ECU_ADDRESS 0x3F9C68 /end MEASUREMENT
/begin MEASUREMENT ed_fil_index_135_inj.fehler_aufrufe_nv "Gesamtzahl der Fehleraufrufe" UBYTE FORMULA_0003 0 0.0 0.0 255.0 READ_WRITE ECU_ADDRESS 0x3F9C6B /end MEASUREMENT
/begin MEASUREMENT ed_fil_index_135_inj.filter_max_nv "Maximaler Fehlerfilterwert" UBYTE FORMULA_0003 0 0.0 0.0 255.0 READ_WRITE ECU_ADDRESS 0x3F9C6A /end MEASUREMENT
/begin MEASUREMENT ed_fil_index_135_inj.filter_nv "Filterwert vor und nach Eintrag" UBYTE FORMULA_0003 0 0.0 0.0 255.0 READ_WRITE ECU_ADDRESS 0x3F9C66 /end MEASUREMENT
/begin MEASUREMENT ed_fil_index_135_inj.zyklus_filter_nv "Vorwaertsfilter zur Fehlerzustandsbestaetigung" UBYTE FORMULA_0003 0 0.0 0.0 255.0 READ_WRITE ECU_ADDRESS 0x3F9C67 /end MEASUREMENT
/begin MEASUREMENT ed_fil_index_15_inj.art_aktuell_nv "Fehlerart und Statusbits" UWORD FORMULA_0052 0 0.0 0.0 65535.0 READ_WRITE BIT_MASK 0xB4F ECU_ADDRESS 0x3F9998 /end MEASUREMENT
/begin MEASUREMENT ed_fil_index_15_inj.fehler_aufrufe_nv "Gesamtzahl der Fehleraufrufe" UBYTE FORMULA_0003 0 0.0 0.0 255.0 READ_WRITE ECU_ADDRESS 0x3F999B /end MEASUREMENT
/begin MEASUREMENT ed_fil_index_15_inj.filter_max_nv "Maximaler Fehlerfilterwert" UBYTE FORMULA_0003 0 0.0 0.0 255.0 READ_WRITE ECU_ADDRESS 0x3F999A /end MEASUREMENT
/begin MEASUREMENT ed_fil_index_15_inj.filter_nv "Filterwert vor und nach Eintrag" UBYTE FORMULA_0003 0 0.0 0.0 255.0 READ_WRITE ECU_ADDRESS 0x3F9996 /end MEASUREMENT
/begin MEASUREMENT ed_fil_index_15_inj.zyklus_filter_nv "Vorwaertsfilter zur Fehlerzustandsbestaetigung" UBYTE FORMULA_0003 0 0.0 0.0 255.0 READ_WRITE ECU_ADDRESS 0x3F9997 /end MEASUREMENT
/begin MEASUREMENT ed_fil_index_196_inj.art_aktuell_nv "Fehlerart und Statusbits" UWORD FORMULA_0052 0 0.0 0.0 65535.0 READ_WRITE BIT_MASK 0xB4F ECU_ADDRESS 0x3F9DD6 /end MEASUREMENT
/begin MEASUREMENT ed_fil_index_196_inj.fehler_aufrufe_nv "Gesamtzahl der Fehleraufrufe" UBYTE FORMULA_0003 0 0.0 0.0 255.0 READ_WRITE ECU_ADDRESS 0x3F9DD9 /end MEASUREMENT
/begin MEASUREMENT ed_fil_index_196_inj.filter_max_nv "Maximaler Fehlerfilterwert" UBYTE FORMULA_0003 0 0.0 0.0 255.0 READ_WRITE ECU_ADDRESS 0x3F9DD8 /end MEASUREMENT
/begin MEASUREMENT ed_fil_index_196_inj.filter_nv "Filterwert vor und nach Eintrag" UBYTE FORMULA_0003 0 0.0 0.0 255.0 READ_WRITE ECU_ADDRESS 0x3F9DD4 /end MEASUREMENT
/begin MEASUREMENT ed_fil_index_196_inj.zyklus_filter_nv "Vorwaertsfilter zur Fehlerzustandsbestaetigung" UBYTE FORMULA_0003 0 0.0 0.0 255.0 READ_WRITE ECU_ADDRESS 0x3F9DD5 /end MEASUREMENT
/begin MEASUREMENT ed_fil_index_197_inj.art_aktuell_nv "Fehlerart und Statusbits" UWORD FORMULA_0052 0 0.0 0.0 65535.0 READ_WRITE BIT_MASK 0xB4F ECU_ADDRESS 0x3F9DDC /end MEASUREMENT
/begin MEASUREMENT ed_fil_index_197_inj.fehler_aufrufe_nv "Gesamtzahl der Fehleraufrufe" UBYTE FORMULA_0003 0 0.0 0.0 255.0 READ_WRITE ECU_ADDRESS 0x3F9DDF /end MEASUREMENT
/begin MEASUREMENT ed_fil_index_197_inj.filter_max_nv "Maximaler Fehlerfilterwert" UBYTE FORMULA_0003 0 0.0 0.0 255.0 READ_WRITE ECU_ADDRESS 0x3F9DDE /end MEASUREMENT
/begin MEASUREMENT ed_fil_index_197_inj.filter_nv "Filterwert vor und nach Eintrag" UBYTE FORMULA_0003 0 0.0 0.0 255.0 READ_WRITE ECU_ADDRESS 0x3F9DDA /end MEASUREMENT
/begin MEASUREMENT ed_fil_index_197_inj.zyklus_filter_nv "Vorwaertsfilter zur Fehlerzustandsbestaetigung" UBYTE FORMULA_0003 0 0.0 0.0 255.0 READ_WRITE ECU_ADDRESS 0x3F9DDB /end MEASUREMENT
/begin MEASUREMENT ed_fil_index_198_inj.art_aktuell_nv "Fehlerart und Statusbits" UWORD FORMULA_0052 0 0.0 0.0 65535.0 READ_WRITE BIT_MASK 0xB4F ECU_ADDRESS 0x3F9DE2 /end MEASUREMENT
/begin MEASUREMENT ed_fil_index_198_inj.fehler_aufrufe_nv "Gesamtzahl der Fehleraufrufe" UBYTE FORMULA_0003 0 0.0 0.0 255.0 READ_WRITE ECU_ADDRESS 0x3F9DE5 /end MEASUREMENT
/begin MEASUREMENT ed_fil_index_198_inj.filter_max_nv "Maximaler Fehlerfilterwert" UBYTE FORMULA_0003 0 0.0 0.0 255.0 READ_WRITE ECU_ADDRESS 0x3F9DE4 /end MEASUREMENT
/begin MEASUREMENT ed_fil_index_198_inj.filter_nv "Filterwert vor und nach Eintrag" UBYTE FORMULA_0003 0 0.0 0.0 255.0 READ_WRITE ECU_ADDRESS 0x3F9DE0 /end MEASUREMENT
/begin MEASUREMENT ed_fil_index_198_inj.zyklus_filter_nv "Vorwaertsfilter zur Fehlerzustandsbestaetigung" UBYTE FORMULA_0003 0 0.0 0.0 255.0 READ_WRITE ECU_ADDRESS 0x3F9DE1 /end MEASUREMENT
/begin MEASUREMENT ed_fil_index_199_inj.art_aktuell_nv "Fehlerart und Statusbits" UWORD FORMULA_0052 0 0.0 0.0 65535.0 READ_WRITE BIT_MASK 0xB4F ECU_ADDRESS 0x3F9DE8 /end MEASUREMENT
/begin MEASUREMENT ed_fil_index_199_inj.fehler_aufrufe_nv "Gesamtzahl der Fehleraufrufe" UBYTE FORMULA_0003 0 0.0 0.0 255.0 READ_WRITE ECU_ADDRESS 0x3F9DEB /end MEASUREMENT
/begin MEASUREMENT ed_fil_index_199_inj.filter_max_nv "Maximaler Fehlerfilterwert" UBYTE FORMULA_0003 0 0.0 0.0 255.0 READ_WRITE ECU_ADDRESS 0x3F9DEA /end MEASUREMENT
/begin MEASUREMENT ed_fil_index_199_inj.filter_nv "Filterwert vor und nach Eintrag" UBYTE FORMULA_0003 0 0.0 0.0 255.0 READ_WRITE ECU_ADDRESS 0x3F9DE6 /end MEASUREMENT
/begin MEASUREMENT ed_fil_index_199_inj.zyklus_filter_nv "Vorwaertsfilter zur Fehlerzustandsbestaetigung" UBYTE FORMULA_0003 0 0.0 0.0 255.0 READ_WRITE ECU_ADDRESS 0x3F9DE7 /end MEASUREMENT
/begin MEASUREMENT ed_fil_index_200_inj.art_aktuell_nv "Fehlerart und Statusbits" UWORD FORMULA_0052 0 0.0 0.0 65535.0 READ_WRITE BIT_MASK 0xB4F ECU_ADDRESS 0x3F9DEE /end MEASUREMENT
/begin MEASUREMENT ed_fil_index_200_inj.fehler_aufrufe_nv "Gesamtzahl der Fehleraufrufe" UBYTE FORMULA_0003 0 0.0 0.0 255.0 READ_WRITE ECU_ADDRESS 0x3F9DF1 /end MEASUREMENT
/begin MEASUREMENT ed_fil_index_200_inj.filter_max_nv "Maximaler Fehlerfilterwert" UBYTE FORMULA_0003 0 0.0 0.0 255.0 READ_WRITE ECU_ADDRESS 0x3F9DF0 /end MEASUREMENT
/begin MEASUREMENT ed_fil_index_200_inj.filter_nv "Filterwert vor und nach Eintrag" UBYTE FORMULA_0003 0 0.0 0.0 255.0 READ_WRITE ECU_ADDRESS 0x3F9DEC /end MEASUREMENT
/begin MEASUREMENT ed_fil_index_200_inj.zyklus_filter_nv "Vorwaertsfilter zur Fehlerzustandsbestaetigung" UBYTE FORMULA_0003 0 0.0 0.0 255.0 READ_WRITE ECU_ADDRESS 0x3F9DED /end MEASUREMENT
/begin MEASUREMENT ed_fil_index_201_inj.art_aktuell_nv "Fehlerart und Statusbits" UWORD FORMULA_0052 0 0.0 0.0 65535.0 READ_WRITE BIT_MASK 0xB4F ECU_ADDRESS 0x3F9DF4 /end MEASUREMENT
/begin MEASUREMENT ed_fil_index_201_inj.fehler_aufrufe_nv "Gesamtzahl der Fehleraufrufe" UBYTE FORMULA_0003 0 0.0 0.0 255.0 READ_WRITE ECU_ADDRESS 0x3F9DF7 /end MEASUREMENT
/begin MEASUREMENT ed_fil_index_201_inj.filter_max_nv "Maximaler Fehlerfilterwert" UBYTE FORMULA_0003 0 0.0 0.0 255.0 READ_WRITE ECU_ADDRESS 0x3F9DF6 /end MEASUREMENT
/begin MEASUREMENT ed_fil_index_201_inj.filter_nv "Filterwert vor und nach Eintrag" UBYTE FORMULA_0003 0 0.0 0.0 255.0 READ_WRITE ECU_ADDRESS 0x3F9DF2 /end MEASUREMENT
/begin MEASUREMENT ed_fil_index_201_inj.zyklus_filter_nv "Vorwaertsfilter zur Fehlerzustandsbestaetigung" UBYTE FORMULA_0003 0 0.0 0.0 255.0 READ_WRITE ECU_ADDRESS 0x3F9DF3 /end MEASUREMENT
/begin MEASUREMENT ed_fil_index_202_inj.art_aktuell_nv "Fehlerart und Statusbits" UWORD FORMULA_0052 0 0.0 0.0 65535.0 READ_WRITE BIT_MASK 0xB4F ECU_ADDRESS 0x3F9DFA /end MEASUREMENT
/begin MEASUREMENT ed_fil_index_202_inj.fehler_aufrufe_nv "Gesamtzahl der Fehleraufrufe" UBYTE FORMULA_0003 0 0.0 0.0 255.0 READ_WRITE ECU_ADDRESS 0x3F9DFD /end MEASUREMENT
/begin MEASUREMENT ed_fil_index_202_inj.filter_max_nv "Maximaler Fehlerfilterwert" UBYTE FORMULA_0003 0 0.0 0.0 255.0 READ_WRITE ECU_ADDRESS 0x3F9DFC /end MEASUREMENT
/begin MEASUREMENT ed_fil_index_202_inj.filter_nv "Filterwert vor und nach Eintrag" UBYTE FORMULA_0003 0 0.0 0.0 255.0 READ_WRITE ECU_ADDRESS 0x3F9DF8 /end MEASUREMENT
/begin MEASUREMENT ed_fil_index_202_inj.zyklus_filter_nv "Vorwaertsfilter zur Fehlerzustandsbestaetigung" UBYTE FORMULA_0003 0 0.0 0.0 255.0 READ_WRITE ECU_ADDRESS 0x3F9DF9 /end MEASUREMENT
/begin MEASUREMENT ed_fil_index_203_inj.art_aktuell_nv "Fehlerart und Statusbits" UWORD FORMULA_0052 0 0.0 0.0 65535.0 READ_WRITE BIT_MASK 0xB4F ECU_ADDRESS 0x3F9E00 /end MEASUREMENT
/begin MEASUREMENT ed_fil_index_203_inj.fehler_aufrufe_nv "Gesamtzahl der Fehleraufrufe" UBYTE FORMULA_0003 0 0.0 0.0 255.0 READ_WRITE ECU_ADDRESS 0x3F9E03 /end MEASUREMENT
/begin MEASUREMENT ed_fil_index_203_inj.filter_max_nv "Maximaler Fehlerfilterwert" UBYTE FORMULA_0003 0 0.0 0.0 255.0 READ_WRITE ECU_ADDRESS 0x3F9E02 /end MEASUREMENT
/begin MEASUREMENT ed_fil_index_203_inj.filter_nv "Filterwert vor und nach Eintrag" UBYTE FORMULA_0003 0 0.0 0.0 255.0 READ_WRITE ECU_ADDRESS 0x3F9DFE /end MEASUREMENT
/begin MEASUREMENT ed_fil_index_203_inj.zyklus_filter_nv "Vorwaertsfilter zur Fehlerzustandsbestaetigung" UBYTE FORMULA_0003 0 0.0 0.0 255.0 READ_WRITE ECU_ADDRESS 0x3F9DFF /end MEASUREMENT
/begin MEASUREMENT ed_fil_index_204_inj.art_aktuell_nv "Fehlerart und Statusbits" UWORD FORMULA_0052 0 0.0 0.0 65535.0 READ_WRITE BIT_MASK 0xB4F ECU_ADDRESS 0x3F9E06 /end MEASUREMENT
/begin MEASUREMENT ed_fil_index_204_inj.fehler_aufrufe_nv "Gesamtzahl der Fehleraufrufe" UBYTE FORMULA_0003 0 0.0 0.0 255.0 READ_WRITE ECU_ADDRESS 0x3F9E09 /end MEASUREMENT
/begin MEASUREMENT ed_fil_index_204_inj.filter_max_nv "Maximaler Fehlerfilterwert" UBYTE FORMULA_0003 0 0.0 0.0 255.0 READ_WRITE ECU_ADDRESS 0x3F9E08 /end MEASUREMENT
/begin MEASUREMENT ed_fil_index_204_inj.filter_nv "Filterwert vor und nach Eintrag" UBYTE FORMULA_0003 0 0.0 0.0 255.0 READ_WRITE ECU_ADDRESS 0x3F9E04 /end MEASUREMENT
/begin MEASUREMENT ed_fil_index_204_inj.zyklus_filter_nv "Vorwaertsfilter zur Fehlerzustandsbestaetigung" UBYTE FORMULA_0003 0 0.0 0.0 255.0 READ_WRITE ECU_ADDRESS 0x3F9E05 /end MEASUREMENT
/begin MEASUREMENT ed_fil_index_205_inj.art_aktuell_nv "Fehlerart und Statusbits" UWORD FORMULA_0052 0 0.0 0.0 65535.0 READ_WRITE BIT_MASK 0xB4F ECU_ADDRESS 0x3F9E0C /end MEASUREMENT
/begin MEASUREMENT ed_fil_index_205_inj.fehler_aufrufe_nv "Gesamtzahl der Fehleraufrufe" UBYTE FORMULA_0003 0 0.0 0.0 255.0 READ_WRITE ECU_ADDRESS 0x3F9E0F /end MEASUREMENT
/begin MEASUREMENT ed_fil_index_205_inj.filter_max_nv "Maximaler Fehlerfilterwert" UBYTE FORMULA_0003 0 0.0 0.0 255.0 READ_WRITE ECU_ADDRESS 0x3F9E0E /end MEASUREMENT
/begin MEASUREMENT ed_fil_index_205_inj.filter_nv "Filterwert vor und nach Eintrag" UBYTE FORMULA_0003 0 0.0 0.0 255.0 READ_WRITE ECU_ADDRESS 0x3F9E0A /end MEASUREMENT
/begin MEASUREMENT ed_fil_index_205_inj.zyklus_filter_nv "Vorwaertsfilter zur Fehlerzustandsbestaetigung" UBYTE FORMULA_0003 0 0.0 0.0 255.0 READ_WRITE ECU_ADDRESS 0x3F9E0B /end MEASUREMENT
/begin MEASUREMENT ed_fil_index_206_inj.art_aktuell_nv "Fehlerart und Statusbits" UWORD FORMULA_0052 0 0.0 0.0 65535.0 READ_WRITE BIT_MASK 0xB4F ECU_ADDRESS 0x3F9E12 /end MEASUREMENT
/begin MEASUREMENT ed_fil_index_206_inj.fehler_aufrufe_nv "Gesamtzahl der Fehleraufrufe" UBYTE FORMULA_0003 0 0.0 0.0 255.0 READ_WRITE ECU_ADDRESS 0x3F9E15 /end MEASUREMENT
/begin MEASUREMENT ed_fil_index_206_inj.filter_max_nv "Maximaler Fehlerfilterwert" UBYTE FORMULA_0003 0 0.0 0.0 255.0 READ_WRITE ECU_ADDRESS 0x3F9E14 /end MEASUREMENT
/begin MEASUREMENT ed_fil_index_206_inj.filter_nv "Filterwert vor und nach Eintrag" UBYTE FORMULA_0003 0 0.0 0.0 255.0 READ_WRITE ECU_ADDRESS 0x3F9E10 /end MEASUREMENT
/begin MEASUREMENT ed_fil_index_206_inj.zyklus_filter_nv "Vorwaertsfilter zur Fehlerzustandsbestaetigung" UBYTE FORMULA_0003 0 0.0 0.0 255.0 READ_WRITE ECU_ADDRESS 0x3F9E11 /end MEASUREMENT
/begin MEASUREMENT ed_fil_index_207_inj.art_aktuell_nv "Fehlerart und Statusbits" UWORD FORMULA_0052 0 0.0 0.0 65535.0 READ_WRITE BIT_MASK 0xB4F ECU_ADDRESS 0x3F9E18 /end MEASUREMENT
/begin MEASUREMENT ed_fil_index_207_inj.fehler_aufrufe_nv "Gesamtzahl der Fehleraufrufe" UBYTE FORMULA_0003 0 0.0 0.0 255.0 READ_WRITE ECU_ADDRESS 0x3F9E1B /end MEASUREMENT
/begin MEASUREMENT ed_fil_index_207_inj.filter_max_nv "Maximaler Fehlerfilterwert" UBYTE FORMULA_0003 0 0.0 0.0 255.0 READ_WRITE ECU_ADDRESS 0x3F9E1A /end MEASUREMENT
/begin MEASUREMENT ed_fil_index_207_inj.filter_nv "Filterwert vor und nach Eintrag" UBYTE FORMULA_0003 0 0.0 0.0 255.0 READ_WRITE ECU_ADDRESS 0x3F9E16 /end MEASUREMENT
/begin MEASUREMENT ed_fil_index_207_inj.zyklus_filter_nv "Vorwaertsfilter zur Fehlerzustandsbestaetigung" UBYTE FORMULA_0003 0 0.0 0.0 255.0 READ_WRITE ECU_ADDRESS 0x3F9E17 /end MEASUREMENT
/begin MEASUREMENT ed_fil_index_208_inj.art_aktuell_nv "Fehlerart und Statusbits" UWORD FORMULA_0052 0 0.0 0.0 65535.0 READ_WRITE BIT_MASK 0xB4F ECU_ADDRESS 0x3F9E1E /end MEASUREMENT
/begin MEASUREMENT ed_fil_index_208_inj.fehler_aufrufe_nv "Gesamtzahl der Fehleraufrufe" UBYTE FORMULA_0003 0 0.0 0.0 255.0 READ_WRITE ECU_ADDRESS 0x3F9E21 /end MEASUREMENT
/begin MEASUREMENT ed_fil_index_208_inj.filter_max_nv "Maximaler Fehlerfilterwert" UBYTE FORMULA_0003 0 0.0 0.0 255.0 READ_WRITE ECU_ADDRESS 0x3F9E20 /end MEASUREMENT
/begin MEASUREMENT ed_fil_index_208_inj.filter_nv "Filterwert vor und nach Eintrag" UBYTE FORMULA_0003 0 0.0 0.0 255.0 READ_WRITE ECU_ADDRESS 0x3F9E1C /end MEASUREMENT
/begin MEASUREMENT ed_fil_index_208_inj.zyklus_filter_nv "Vorwaertsfilter zur Fehlerzustandsbestaetigung" UBYTE FORMULA_0003 0 0.0 0.0 255.0 READ_WRITE ECU_ADDRESS 0x3F9E1D /end MEASUREMENT
/begin MEASUREMENT ed_fil_index_209_inj.art_aktuell_nv "Fehlerart und Statusbits" UWORD FORMULA_0052 0 0.0 0.0 65535.0 READ_WRITE BIT_MASK 0xB4F ECU_ADDRESS 0x3F9E24 /end MEASUREMENT
/begin MEASUREMENT ed_fil_index_209_inj.fehler_aufrufe_nv "Gesamtzahl der Fehleraufrufe" UBYTE FORMULA_0003 0 0.0 0.0 255.0 READ_WRITE ECU_ADDRESS 0x3F9E27 /end MEASUREMENT
/begin MEASUREMENT ed_fil_index_209_inj.filter_max_nv "Maximaler Fehlerfilterwert" UBYTE FORMULA_0003 0 0.0 0.0 255.0 READ_WRITE ECU_ADDRESS 0x3F9E26 /end MEASUREMENT
/begin MEASUREMENT ed_fil_index_209_inj.filter_nv "Filterwert vor und nach Eintrag" UBYTE FORMULA_0003 0 0.0 0.0 255.0 READ_WRITE ECU_ADDRESS 0x3F9E22 /end MEASUREMENT
/begin MEASUREMENT ed_fil_index_209_inj.zyklus_filter_nv "Vorwaertsfilter zur Fehlerzustandsbestaetigung" UBYTE FORMULA_0003 0 0.0 0.0 255.0 READ_WRITE ECU_ADDRESS 0x3F9E23 /end MEASUREMENT
/begin MEASUREMENT ed_fil_index_210_inj.art_aktuell_nv "Fehlerart und Statusbits" UWORD FORMULA_0052 0 0.0 0.0 65535.0 READ_WRITE BIT_MASK 0xB4F ECU_ADDRESS 0x3F9E2A /end MEASUREMENT
/begin MEASUREMENT ed_fil_index_210_inj.fehler_aufrufe_nv "Gesamtzahl der Fehleraufrufe" UBYTE FORMULA_0003 0 0.0 0.0 255.0 READ_WRITE ECU_ADDRESS 0x3F9E2D /end MEASUREMENT
/begin MEASUREMENT ed_fil_index_210_inj.filter_max_nv "Maximaler Fehlerfilterwert" UBYTE FORMULA_0003 0 0.0 0.0 255.0 READ_WRITE ECU_ADDRESS 0x3F9E2C /end MEASUREMENT
/begin MEASUREMENT ed_fil_index_210_inj.filter_nv "Filterwert vor und nach Eintrag" UBYTE FORMULA_0003 0 0.0 0.0 255.0 READ_WRITE ECU_ADDRESS 0x3F9E28 /end MEASUREMENT
/begin MEASUREMENT ed_fil_index_210_inj.zyklus_filter_nv "Vorwaertsfilter zur Fehlerzustandsbestaetigung" UBYTE FORMULA_0003 0 0.0 0.0 255.0 READ_WRITE ECU_ADDRESS 0x3F9E29 /end MEASUREMENT
/begin MEASUREMENT ed_fil_index_211_inj.art_aktuell_nv "Fehlerart und Statusbits" UWORD FORMULA_0052 0 0.0 0.0 65535.0 READ_WRITE BIT_MASK 0xB4F ECU_ADDRESS 0x3F9E30 /end MEASUREMENT
/begin MEASUREMENT ed_fil_index_211_inj.fehler_aufrufe_nv "Gesamtzahl der Fehleraufrufe" UBYTE FORMULA_0003 0 0.0 0.0 255.0 READ_WRITE ECU_ADDRESS 0x3F9E33 /end MEASUREMENT
/begin MEASUREMENT ed_fil_index_211_inj.filter_max_nv "Maximaler Fehlerfilterwert" UBYTE FORMULA_0003 0 0.0 0.0 255.0 READ_WRITE ECU_ADDRESS 0x3F9E32 /end MEASUREMENT
/begin MEASUREMENT ed_fil_index_211_inj.filter_nv "Filterwert vor und nach Eintrag" UBYTE FORMULA_0003 0 0.0 0.0 255.0 READ_WRITE ECU_ADDRESS 0x3F9E2E /end MEASUREMENT
/begin MEASUREMENT ed_fil_index_211_inj.zyklus_filter_nv "Vorwaertsfilter zur Fehlerzustandsbestaetigung" UBYTE FORMULA_0003 0 0.0 0.0 255.0 READ_WRITE ECU_ADDRESS 0x3F9E2F /end MEASUREMENT
/begin MEASUREMENT ed_fil_index_212_inj.art_aktuell_nv "Fehlerart und Statusbits" UWORD FORMULA_0052 0 0.0 0.0 65535.0 READ_WRITE BIT_MASK 0xB4F ECU_ADDRESS 0x3F9E36 /end MEASUREMENT
/begin MEASUREMENT ed_fil_index_212_inj.fehler_aufrufe_nv "Gesamtzahl der Fehleraufrufe" UBYTE FORMULA_0003 0 0.0 0.0 255.0 READ_WRITE ECU_ADDRESS 0x3F9E39 /end MEASUREMENT
/begin MEASUREMENT ed_fil_index_212_inj.filter_max_nv "Maximaler Fehlerfilterwert" UBYTE FORMULA_0003 0 0.0 0.0 255.0 READ_WRITE ECU_ADDRESS 0x3F9E38 /end MEASUREMENT
/begin MEASUREMENT ed_fil_index_212_inj.filter_nv "Filterwert vor und nach Eintrag" UBYTE FORMULA_0003 0 0.0 0.0 255.0 READ_WRITE ECU_ADDRESS 0x3F9E34 /end MEASUREMENT
/begin MEASUREMENT ed_fil_index_212_inj.zyklus_filter_nv "Vorwaertsfilter zur Fehlerzustandsbestaetigung" UBYTE FORMULA_0003 0 0.0 0.0 255.0 READ_WRITE ECU_ADDRESS 0x3F9E35 /end MEASUREMENT
/begin MEASUREMENT ed_fil_index_213_inj.art_aktuell_nv "Fehlerart und Statusbits" UWORD FORMULA_0052 0 0.0 0.0 65535.0 READ_WRITE BIT_MASK 0xB4F ECU_ADDRESS 0x3F9E3C /end MEASUREMENT
/begin MEASUREMENT ed_fil_index_213_inj.fehler_aufrufe_nv "Gesamtzahl der Fehleraufrufe" UBYTE FORMULA_0003 0 0.0 0.0 255.0 READ_WRITE ECU_ADDRESS 0x3F9E3F /end MEASUREMENT
/begin MEASUREMENT ed_fil_index_213_inj.filter_max_nv "Maximaler Fehlerfilterwert" UBYTE FORMULA_0003 0 0.0 0.0 255.0 READ_WRITE ECU_ADDRESS 0x3F9E3E /end MEASUREMENT
/begin MEASUREMENT ed_fil_index_213_inj.filter_nv "Filterwert vor und nach Eintrag" UBYTE FORMULA_0003 0 0.0 0.0 255.0 READ_WRITE ECU_ADDRESS 0x3F9E3A /end MEASUREMENT
/begin MEASUREMENT ed_fil_index_213_inj.zyklus_filter_nv "Vorwaertsfilter zur Fehlerzustandsbestaetigung" UBYTE FORMULA_0003 0 0.0 0.0 255.0 READ_WRITE ECU_ADDRESS 0x3F9E3B /end MEASUREMENT
/begin MEASUREMENT ed_fil_index_214_inj.art_aktuell_nv "Fehlerart und Statusbits" UWORD FORMULA_0052 0 0.0 0.0 65535.0 READ_WRITE BIT_MASK 0xB4F ECU_ADDRESS 0x3F9E42 /end MEASUREMENT
/begin MEASUREMENT ed_fil_index_214_inj.fehler_aufrufe_nv "Gesamtzahl der Fehleraufrufe" UBYTE FORMULA_0003 0 0.0 0.0 255.0 READ_WRITE ECU_ADDRESS 0x3F9E45 /end MEASUREMENT
/begin MEASUREMENT ed_fil_index_214_inj.filter_max_nv "Maximaler Fehlerfilterwert" UBYTE FORMULA_0003 0 0.0 0.0 255.0 READ_WRITE ECU_ADDRESS 0x3F9E44 /end MEASUREMENT
/begin MEASUREMENT ed_fil_index_214_inj.filter_nv "Filterwert vor und nach Eintrag" UBYTE FORMULA_0003 0 0.0 0.0 255.0 READ_WRITE ECU_ADDRESS 0x3F9E40 /end MEASUREMENT
/begin MEASUREMENT ed_fil_index_214_inj.zyklus_filter_nv "Vorwaertsfilter zur Fehlerzustandsbestaetigung" UBYTE FORMULA_0003 0 0.0 0.0 255.0 READ_WRITE ECU_ADDRESS 0x3F9E41 /end MEASUREMENT
/begin MEASUREMENT ed_fil_index_215_inj.art_aktuell_nv "Fehlerart und Statusbits" UWORD FORMULA_0052 0 0.0 0.0 65535.0 READ_WRITE BIT_MASK 0xB4F ECU_ADDRESS 0x3F9E48 /end MEASUREMENT
/begin MEASUREMENT ed_fil_index_215_inj.fehler_aufrufe_nv "Gesamtzahl der Fehleraufrufe" UBYTE FORMULA_0003 0 0.0 0.0 255.0 READ_WRITE ECU_ADDRESS 0x3F9E4B /end MEASUREMENT
/begin MEASUREMENT ed_fil_index_215_inj.filter_max_nv "Maximaler Fehlerfilterwert" UBYTE FORMULA_0003 0 0.0 0.0 255.0 READ_WRITE ECU_ADDRESS 0x3F9E4A /end MEASUREMENT
/begin MEASUREMENT ed_fil_index_215_inj.filter_nv "Filterwert vor und nach Eintrag" UBYTE FORMULA_0003 0 0.0 0.0 255.0 READ_WRITE ECU_ADDRESS 0x3F9E46 /end MEASUREMENT
/begin MEASUREMENT ed_fil_index_215_inj.zyklus_filter_nv "Vorwaertsfilter zur Fehlerzustandsbestaetigung" UBYTE FORMULA_0003 0 0.0 0.0 255.0 READ_WRITE ECU_ADDRESS 0x3F9E47 /end MEASUREMENT
/begin MEASUREMENT ed_fil_index_216_inj.art_aktuell_nv "Fehlerart und Statusbits" UWORD FORMULA_0052 0 0.0 0.0 65535.0 READ_WRITE BIT_MASK 0xB4F ECU_ADDRESS 0x3F9E4E /end MEASUREMENT
/begin MEASUREMENT ed_fil_index_216_inj.fehler_aufrufe_nv "Gesamtzahl der Fehleraufrufe" UBYTE FORMULA_0003 0 0.0 0.0 255.0 READ_WRITE ECU_ADDRESS 0x3F9E51 /end MEASUREMENT
/begin MEASUREMENT ed_fil_index_216_inj.filter_max_nv "Maximaler Fehlerfilterwert" UBYTE FORMULA_0003 0 0.0 0.0 255.0 READ_WRITE ECU_ADDRESS 0x3F9E50 /end MEASUREMENT
/begin MEASUREMENT ed_fil_index_216_inj.filter_nv "Filterwert vor und nach Eintrag" UBYTE FORMULA_0003 0 0.0 0.0 255.0 READ_WRITE ECU_ADDRESS 0x3F9E4C /end MEASUREMENT
/begin MEASUREMENT ed_fil_index_216_inj.zyklus_filter_nv "Vorwaertsfilter zur Fehlerzustandsbestaetigung" UBYTE FORMULA_0003 0 0.0 0.0 255.0 READ_WRITE ECU_ADDRESS 0x3F9E4D /end MEASUREMENT
/begin MEASUREMENT ed_fil_index_217_inj.art_aktuell_nv "Fehlerart und Statusbits" UWORD FORMULA_0052 0 0.0 0.0 65535.0 READ_WRITE BIT_MASK 0xB4F ECU_ADDRESS 0x3F9E54 /end MEASUREMENT
/begin MEASUREMENT ed_fil_index_217_inj.fehler_aufrufe_nv "Gesamtzahl der Fehleraufrufe" UBYTE FORMULA_0003 0 0.0 0.0 255.0 READ_WRITE ECU_ADDRESS 0x3F9E57 /end MEASUREMENT
/begin MEASUREMENT ed_fil_index_217_inj.filter_max_nv "Maximaler Fehlerfilterwert" UBYTE FORMULA_0003 0 0.0 0.0 255.0 READ_WRITE ECU_ADDRESS 0x3F9E56 /end MEASUREMENT
/begin MEASUREMENT ed_fil_index_217_inj.filter_nv "Filterwert vor und nach Eintrag" UBYTE FORMULA_0003 0 0.0 0.0 255.0 READ_WRITE ECU_ADDRESS 0x3F9E52 /end MEASUREMENT
/begin MEASUREMENT ed_fil_index_217_inj.zyklus_filter_nv "Vorwaertsfilter zur Fehlerzustandsbestaetigung" UBYTE FORMULA_0003 0 0.0 0.0 255.0 READ_WRITE ECU_ADDRESS 0x3F9E53 /end MEASUREMENT
/begin MEASUREMENT ed_fil_index_218_inj.art_aktuell_nv "Fehlerart und Statusbits" UWORD FORMULA_0052 0 0.0 0.0 65535.0 READ_WRITE BIT_MASK 0xB4F ECU_ADDRESS 0x3F9E5A /end MEASUREMENT
/begin MEASUREMENT ed_fil_index_218_inj.fehler_aufrufe_nv "Gesamtzahl der Fehleraufrufe" UBYTE FORMULA_0003 0 0.0 0.0 255.0 READ_WRITE ECU_ADDRESS 0x3F9E5D /end MEASUREMENT
/begin MEASUREMENT ed_fil_index_218_inj.filter_max_nv "Maximaler Fehlerfilterwert" UBYTE FORMULA_0003 0 0.0 0.0 255.0 READ_WRITE ECU_ADDRESS 0x3F9E5C /end MEASUREMENT
/begin MEASUREMENT ed_fil_index_218_inj.filter_nv "Filterwert vor und nach Eintrag" UBYTE FORMULA_0003 0 0.0 0.0 255.0 READ_WRITE ECU_ADDRESS 0x3F9E58 /end MEASUREMENT
/begin MEASUREMENT ed_fil_index_218_inj.zyklus_filter_nv "Vorwaertsfilter zur Fehlerzustandsbestaetigung" UBYTE FORMULA_0003 0 0.0 0.0 255.0 READ_WRITE ECU_ADDRESS 0x3F9E59 /end MEASUREMENT
/begin MEASUREMENT ed_fil_index_219_inj.art_aktuell_nv "Fehlerart und Statusbits" UWORD FORMULA_0052 0 0.0 0.0 65535.0 READ_WRITE BIT_MASK 0xB4F ECU_ADDRESS 0x3F9E60 /end MEASUREMENT
/begin MEASUREMENT ed_fil_index_219_inj.fehler_aufrufe_nv "Gesamtzahl der Fehleraufrufe" UBYTE FORMULA_0003 0 0.0 0.0 255.0 READ_WRITE ECU_ADDRESS 0x3F9E63 /end MEASUREMENT
/begin MEASUREMENT ed_fil_index_219_inj.filter_max_nv "Maximaler Fehlerfilterwert" UBYTE FORMULA_0003 0 0.0 0.0 255.0 READ_WRITE ECU_ADDRESS 0x3F9E62 /end MEASUREMENT
/begin MEASUREMENT ed_fil_index_219_inj.filter_nv "Filterwert vor und nach Eintrag" UBYTE FORMULA_0003 0 0.0 0.0 255.0 READ_WRITE ECU_ADDRESS 0x3F9E5E /end MEASUREMENT
/begin MEASUREMENT ed_fil_index_219_inj.zyklus_filter_nv "Vorwaertsfilter zur Fehlerzustandsbestaetigung" UBYTE FORMULA_0003 0 0.0 0.0 255.0 READ_WRITE ECU_ADDRESS 0x3F9E5F /end MEASUREMENT
/begin MEASUREMENT ed_fil_index_220_inj.art_aktuell_nv "Fehlerart und Statusbits" UWORD FORMULA_0052 0 0.0 0.0 65535.0 READ_WRITE BIT_MASK 0xB4F ECU_ADDRESS 0x3F9E66 /end MEASUREMENT
/begin MEASUREMENT ed_fil_index_220_inj.fehler_aufrufe_nv "Gesamtzahl der Fehleraufrufe" UBYTE FORMULA_0003 0 0.0 0.0 255.0 READ_WRITE ECU_ADDRESS 0x3F9E69 /end MEASUREMENT
/begin MEASUREMENT ed_fil_index_220_inj.filter_max_nv "Maximaler Fehlerfilterwert" UBYTE FORMULA_0003 0 0.0 0.0 255.0 READ_WRITE ECU_ADDRESS 0x3F9E68 /end MEASUREMENT
/begin MEASUREMENT ed_fil_index_220_inj.filter_nv "Filterwert vor und nach Eintrag" UBYTE FORMULA_0003 0 0.0 0.0 255.0 READ_WRITE ECU_ADDRESS 0x3F9E64 /end MEASUREMENT
/begin MEASUREMENT ed_fil_index_220_inj.zyklus_filter_nv "Vorwaertsfilter zur Fehlerzustandsbestaetigung" UBYTE FORMULA_0003 0 0.0 0.0 255.0 READ_WRITE ECU_ADDRESS 0x3F9E65 /end MEASUREMENT
/begin MEASUREMENT ed_fil_index_221_inj.art_aktuell_nv "Fehlerart und Statusbits" UWORD FORMULA_0052 0 0.0 0.0 65535.0 READ_WRITE BIT_MASK 0xB4F ECU_ADDRESS 0x3F9E6C /end MEASUREMENT
/begin MEASUREMENT ed_fil_index_221_inj.fehler_aufrufe_nv "Gesamtzahl der Fehleraufrufe" UBYTE FORMULA_0003 0 0.0 0.0 255.0 READ_WRITE ECU_ADDRESS 0x3F9E6F /end MEASUREMENT
/begin MEASUREMENT ed_fil_index_221_inj.filter_max_nv "Maximaler Fehlerfilterwert" UBYTE FORMULA_0003 0 0.0 0.0 255.0 READ_WRITE ECU_ADDRESS 0x3F9E6E /end MEASUREMENT
/begin MEASUREMENT ed_fil_index_221_inj.filter_nv "Filterwert vor und nach Eintrag" UBYTE FORMULA_0003 0 0.0 0.0 255.0 READ_WRITE ECU_ADDRESS 0x3F9E6A /end MEASUREMENT
/begin MEASUREMENT ed_fil_index_221_inj.zyklus_filter_nv "Vorwaertsfilter zur Fehlerzustandsbestaetigung" UBYTE FORMULA_0003 0 0.0 0.0 255.0 READ_WRITE ECU_ADDRESS 0x3F9E6B /end MEASUREMENT
/begin MEASUREMENT ed_fil_index_222_inj.art_aktuell_nv "Fehlerart und Statusbits" UWORD FORMULA_0052 0 0.0 0.0 65535.0 READ_WRITE BIT_MASK 0xB4F ECU_ADDRESS 0x3F9E72 /end MEASUREMENT
/begin MEASUREMENT ed_fil_index_222_inj.fehler_aufrufe_nv "Gesamtzahl der Fehleraufrufe" UBYTE FORMULA_0003 0 0.0 0.0 255.0 READ_WRITE ECU_ADDRESS 0x3F9E75 /end MEASUREMENT
/begin MEASUREMENT ed_fil_index_222_inj.filter_max_nv "Maximaler Fehlerfilterwert" UBYTE FORMULA_0003 0 0.0 0.0 255.0 READ_WRITE ECU_ADDRESS 0x3F9E74 /end MEASUREMENT
/begin MEASUREMENT ed_fil_index_222_inj.filter_nv "Filterwert vor und nach Eintrag" UBYTE FORMULA_0003 0 0.0 0.0 255.0 READ_WRITE ECU_ADDRESS 0x3F9E70 /end MEASUREMENT
/begin MEASUREMENT ed_fil_index_222_inj.zyklus_filter_nv "Vorwaertsfilter zur Fehlerzustandsbestaetigung" UBYTE FORMULA_0003 0 0.0 0.0 255.0 READ_WRITE ECU_ADDRESS 0x3F9E71 /end MEASUREMENT
/begin MEASUREMENT ed_fil_index_223_inj.art_aktuell_nv "Fehlerart und Statusbits" UWORD FORMULA_0052 0 0.0 0.0 65535.0 READ_WRITE BIT_MASK 0xB4F ECU_ADDRESS 0x3F9E78 /end MEASUREMENT
/begin MEASUREMENT ed_fil_index_223_inj.fehler_aufrufe_nv "Gesamtzahl der Fehleraufrufe" UBYTE FORMULA_0003 0 0.0 0.0 255.0 READ_WRITE ECU_ADDRESS 0x3F9E7B /end MEASUREMENT
/begin MEASUREMENT ed_fil_index_223_inj.filter_max_nv "Maximaler Fehlerfilterwert" UBYTE FORMULA_0003 0 0.0 0.0 255.0 READ_WRITE ECU_ADDRESS 0x3F9E7A /end MEASUREMENT
/begin MEASUREMENT ed_fil_index_223_inj.filter_nv "Filterwert vor und nach Eintrag" UBYTE FORMULA_0003 0 0.0 0.0 255.0 READ_WRITE ECU_ADDRESS 0x3F9E76 /end MEASUREMENT
/begin MEASUREMENT ed_fil_index_223_inj.zyklus_filter_nv "Vorwaertsfilter zur Fehlerzustandsbestaetigung" UBYTE FORMULA_0003 0 0.0 0.0 255.0 READ_WRITE ECU_ADDRESS 0x3F9E77 /end MEASUREMENT
/begin MEASUREMENT ed_fil_kat_obd1.art_aktuell_nv "Fehlerart und Statusbits" UWORD FORMULA_0052 0 0.0 0.0 65535.0 READ_WRITE BIT_MASK 0xB4F ECU_ADDRESS 0x3F9C14 /end MEASUREMENT
/begin MEASUREMENT ed_fil_kat_obd1.fehler_aufrufe_nv "Gesamtzahl der Fehleraufrufe" UBYTE FORMULA_0003 0 0.0 0.0 255.0 READ_WRITE ECU_ADDRESS 0x3F9C17 /end MEASUREMENT
/begin MEASUREMENT ed_fil_kat_obd1.filter_max_nv "Maximaler Fehlerfilterwert" UBYTE FORMULA_0003 0 0.0 0.0 255.0 READ_WRITE ECU_ADDRESS 0x3F9C16 /end MEASUREMENT
/begin MEASUREMENT ed_fil_kat_obd1.filter_nv "Filterwert vor und nach Eintrag" UBYTE FORMULA_0003 0 0.0 0.0 255.0 READ_WRITE ECU_ADDRESS 0x3F9C12 /end MEASUREMENT
/begin MEASUREMENT ed_fil_kat_obd1.zyklus_filter_nv "Vorwaertsfilter zur Fehlerzustandsbestaetigung" UBYTE FORMULA_0003 0 0.0 0.0 255.0 READ_WRITE ECU_ADDRESS 0x3F9C13 /end MEASUREMENT
/begin MEASUREMENT ed_fil_kat_obd2.art_aktuell_nv "Fehlerart und Statusbits" UWORD FORMULA_0052 0 0.0 0.0 65535.0 READ_WRITE BIT_MASK 0xB4F ECU_ADDRESS 0x3F9C1A /end MEASUREMENT
/begin MEASUREMENT ed_fil_kat_obd2.fehler_aufrufe_nv "Gesamtzahl der Fehleraufrufe" UBYTE FORMULA_0003 0 0.0 0.0 255.0 READ_WRITE ECU_ADDRESS 0x3F9C1D /end MEASUREMENT
/begin MEASUREMENT ed_fil_kat_obd2.filter_max_nv "Maximaler Fehlerfilterwert" UBYTE FORMULA_0003 0 0.0 0.0 255.0 READ_WRITE ECU_ADDRESS 0x3F9C1C /end MEASUREMENT
/begin MEASUREMENT ed_fil_kat_obd2.filter_nv "Filterwert vor und nach Eintrag" UBYTE FORMULA_0003 0 0.0 0.0 255.0 READ_WRITE ECU_ADDRESS 0x3F9C18 /end MEASUREMENT
/begin MEASUREMENT ed_fil_kat_obd2.zyklus_filter_nv "Vorwaertsfilter zur Fehlerzustandsbestaetigung" UBYTE FORMULA_0003 0 0.0 0.0 255.0 READ_WRITE ECU_ADDRESS 0x3F9C19 /end MEASUREMENT
/begin MEASUREMENT ed_fil_kats_b1.art_aktuell_nv "Fehlerart und Statusbits" UWORD FORMULA_0052 0 0.0 0.0 65535.0 READ_WRITE BIT_MASK 0xB4F ECU_ADDRESS 0x3F9D46 /end MEASUREMENT
/begin MEASUREMENT ed_fil_kats_b1.fehler_aufrufe_nv "Gesamtzahl der Fehleraufrufe" UBYTE FORMULA_0003 0 0.0 0.0 255.0 READ_WRITE ECU_ADDRESS 0x3F9D49 /end MEASUREMENT
/begin MEASUREMENT ed_fil_kats_b1.filter_max_nv "Maximaler Fehlerfilterwert" UBYTE FORMULA_0003 0 0.0 0.0 255.0 READ_WRITE ECU_ADDRESS 0x3F9D48 /end MEASUREMENT
/begin MEASUREMENT ed_fil_kats_b1.filter_nv "Filterwert vor und nach Eintrag" UBYTE FORMULA_0003 0 0.0 0.0 255.0 READ_WRITE ECU_ADDRESS 0x3F9D44 /end MEASUREMENT
/begin MEASUREMENT ed_fil_kats_b1.zyklus_filter_nv "Vorwaertsfilter zur Fehlerzustandsbestaetigung" UBYTE FORMULA_0003 0 0.0 0.0 255.0 READ_WRITE ECU_ADDRESS 0x3F9D45 /end MEASUREMENT
/begin MEASUREMENT ed_fil_kats_b2.art_aktuell_nv "Fehlerart und Statusbits" UWORD FORMULA_0052 0 0.0 0.0 65535.0 READ_WRITE BIT_MASK 0xB4F ECU_ADDRESS 0x3F9D4C /end MEASUREMENT
/begin MEASUREMENT ed_fil_kats_b2.fehler_aufrufe_nv "Gesamtzahl der Fehleraufrufe" UBYTE FORMULA_0003 0 0.0 0.0 255.0 READ_WRITE ECU_ADDRESS 0x3F9D4F /end MEASUREMENT
/begin MEASUREMENT ed_fil_kats_b2.filter_max_nv "Maximaler Fehlerfilterwert" UBYTE FORMULA_0003 0 0.0 0.0 255.0 READ_WRITE ECU_ADDRESS 0x3F9D4E /end MEASUREMENT
/begin MEASUREMENT ed_fil_kats_b2.filter_nv "Filterwert vor und nach Eintrag" UBYTE FORMULA_0003 0 0.0 0.0 255.0 READ_WRITE ECU_ADDRESS 0x3F9D4A /end MEASUREMENT
/begin MEASUREMENT ed_fil_kats_b2.zyklus_filter_nv "Vorwaertsfilter zur Fehlerzustandsbestaetigung" UBYTE FORMULA_0003 0 0.0 0.0 255.0 READ_WRITE ECU_ADDRESS 0x3F9D4B /end MEASUREMENT
/begin MEASUREMENT ed_fil_kge1.art_aktuell_nv "Fehlerart und Statusbits" UWORD FORMULA_0052 0 0.0 0.0 65535.0 READ_WRITE BIT_MASK 0xB4F ECU_ADDRESS 0x3F9CE6 /end MEASUREMENT
/begin MEASUREMENT ed_fil_kge1.fehler_aufrufe_nv "Gesamtzahl der Fehleraufrufe" UBYTE FORMULA_0003 0 0.0 0.0 255.0 READ_WRITE ECU_ADDRESS 0x3F9CE9 /end MEASUREMENT
/begin MEASUREMENT ed_fil_kge1.filter_max_nv "Maximaler Fehlerfilterwert" UBYTE FORMULA_0003 0 0.0 0.0 255.0 READ_WRITE ECU_ADDRESS 0x3F9CE8 /end MEASUREMENT
/begin MEASUREMENT ed_fil_kge1.filter_nv "Filterwert vor und nach Eintrag" UBYTE FORMULA_0003 0 0.0 0.0 255.0 READ_WRITE ECU_ADDRESS 0x3F9CE4 /end MEASUREMENT
/begin MEASUREMENT ed_fil_kge1.zyklus_filter_nv "Vorwaertsfilter zur Fehlerzustandsbestaetigung" UBYTE FORMULA_0003 0 0.0 0.0 255.0 READ_WRITE ECU_ADDRESS 0x3F9CE5 /end MEASUREMENT
/begin MEASUREMENT ed_fil_kge2.art_aktuell_nv "Fehlerart und Statusbits" UWORD FORMULA_0052 0 0.0 0.0 65535.0 READ_WRITE BIT_MASK 0xB4F ECU_ADDRESS 0x3F9CEC /end MEASUREMENT
/begin MEASUREMENT ed_fil_kge2.fehler_aufrufe_nv "Gesamtzahl der Fehleraufrufe" UBYTE FORMULA_0003 0 0.0 0.0 255.0 READ_WRITE ECU_ADDRESS 0x3F9CEF /end MEASUREMENT
/begin MEASUREMENT ed_fil_kge2.filter_max_nv "Maximaler Fehlerfilterwert" UBYTE FORMULA_0003 0 0.0 0.0 255.0 READ_WRITE ECU_ADDRESS 0x3F9CEE /end MEASUREMENT
/begin MEASUREMENT ed_fil_kge2.filter_nv "Filterwert vor und nach Eintrag" UBYTE FORMULA_0003 0 0.0 0.0 255.0 READ_WRITE ECU_ADDRESS 0x3F9CEA /end MEASUREMENT
/begin MEASUREMENT ed_fil_kge2.zyklus_filter_nv "Vorwaertsfilter zur Fehlerzustandsbestaetigung" UBYTE FORMULA_0003 0 0.0 0.0 255.0 READ_WRITE ECU_ADDRESS 0x3F9CEB /end MEASUREMENT
/begin MEASUREMENT ed_fil_ksd1.art_aktuell_nv "Fehlerart und Statusbits" UWORD FORMULA_0052 0 0.0 0.0 65535.0 READ_WRITE BIT_MASK 0xB4F ECU_ADDRESS 0x3F9D3A /end MEASUREMENT
/begin MEASUREMENT ed_fil_ksd1.fehler_aufrufe_nv "Gesamtzahl der Fehleraufrufe" UBYTE FORMULA_0003 0 0.0 0.0 255.0 READ_WRITE ECU_ADDRESS 0x3F9D3D /end MEASUREMENT
/begin MEASUREMENT ed_fil_ksd1.filter_max_nv "Maximaler Fehlerfilterwert" UBYTE FORMULA_0003 0 0.0 0.0 255.0 READ_WRITE ECU_ADDRESS 0x3F9D3C /end MEASUREMENT
/begin MEASUREMENT ed_fil_ksd1.filter_nv "Filterwert vor und nach Eintrag" UBYTE FORMULA_0003 0 0.0 0.0 255.0 READ_WRITE ECU_ADDRESS 0x3F9D38 /end MEASUREMENT
/begin MEASUREMENT ed_fil_ksd1.zyklus_filter_nv "Vorwaertsfilter zur Fehlerzustandsbestaetigung" UBYTE FORMULA_0003 0 0.0 0.0 255.0 READ_WRITE ECU_ADDRESS 0x3F9D39 /end MEASUREMENT
/begin MEASUREMENT ed_fil_ksd2.art_aktuell_nv "Fehlerart und Statusbits" UWORD FORMULA_0052 0 0.0 0.0 65535.0 READ_WRITE BIT_MASK 0xB4F ECU_ADDRESS 0x3F9D40 /end MEASUREMENT
/begin MEASUREMENT ed_fil_ksd2.fehler_aufrufe_nv "Gesamtzahl der Fehleraufrufe" UBYTE FORMULA_0003 0 0.0 0.0 255.0 READ_WRITE ECU_ADDRESS 0x3F9D43 /end MEASUREMENT
/begin MEASUREMENT ed_fil_ksd2.filter_max_nv "Maximaler Fehlerfilterwert" UBYTE FORMULA_0003 0 0.0 0.0 255.0 READ_WRITE ECU_ADDRESS 0x3F9D42 /end MEASUREMENT
/begin MEASUREMENT ed_fil_ksd2.filter_nv "Filterwert vor und nach Eintrag" UBYTE FORMULA_0003 0 0.0 0.0 255.0 READ_WRITE ECU_ADDRESS 0x3F9D3E /end MEASUREMENT
/begin MEASUREMENT ed_fil_ksd2.zyklus_filter_nv "Vorwaertsfilter zur Fehlerzustandsbestaetigung" UBYTE FORMULA_0003 0 0.0 0.0 255.0 READ_WRITE ECU_ADDRESS 0x3F9D3F /end MEASUREMENT
/begin MEASUREMENT ed_fil_kw.art_aktuell_nv "Fehlerart und Statusbits" UWORD FORMULA_0052 0 0.0 0.0 65535.0 READ_WRITE BIT_MASK 0xB4F ECU_ADDRESS 0x3F9CD4 /end MEASUREMENT
/begin MEASUREMENT ed_fil_kw.fehler_aufrufe_nv "Gesamtzahl der Fehleraufrufe" UBYTE FORMULA_0003 0 0.0 0.0 255.0 READ_WRITE ECU_ADDRESS 0x3F9CD7 /end MEASUREMENT
/begin MEASUREMENT ed_fil_kw.filter_max_nv "Maximaler Fehlerfilterwert" UBYTE FORMULA_0003 0 0.0 0.0 255.0 READ_WRITE ECU_ADDRESS 0x3F9CD6 /end MEASUREMENT
/begin MEASUREMENT ed_fil_kw.filter_nv "Filterwert vor und nach Eintrag" UBYTE FORMULA_0003 0 0.0 0.0 255.0 READ_WRITE ECU_ADDRESS 0x3F9CD2 /end MEASUREMENT
/begin MEASUREMENT ed_fil_kw.zyklus_filter_nv "Vorwaertsfilter zur Fehlerzustandsbestaetigung" UBYTE FORMULA_0003 0 0.0 0.0 255.0 READ_WRITE ECU_ADDRESS 0x3F9CD3 /end MEASUREMENT
/begin MEASUREMENT ed_fil_la1_adapt.art_aktuell_nv "Fehlerart und Statusbits" UWORD FORMULA_0052 0 0.0 0.0 65535.0 READ_WRITE BIT_MASK 0xB4F ECU_ADDRESS 0x3F9CDA /end MEASUREMENT
/begin MEASUREMENT ed_fil_la1_adapt.fehler_aufrufe_nv "Gesamtzahl der Fehleraufrufe" UBYTE FORMULA_0003 0 0.0 0.0 255.0 READ_WRITE ECU_ADDRESS 0x3F9CDD /end MEASUREMENT
/begin MEASUREMENT ed_fil_la1_adapt.filter_max_nv "Maximaler Fehlerfilterwert" UBYTE FORMULA_0003 0 0.0 0.0 255.0 READ_WRITE ECU_ADDRESS 0x3F9CDC /end MEASUREMENT
/begin MEASUREMENT ed_fil_la1_adapt.filter_nv "Filterwert vor und nach Eintrag" UBYTE FORMULA_0003 0 0.0 0.0 255.0 READ_WRITE ECU_ADDRESS 0x3F9CD8 /end MEASUREMENT
/begin MEASUREMENT ed_fil_la1_adapt.zyklus_filter_nv "Vorwaertsfilter zur Fehlerzustandsbestaetigung" UBYTE FORMULA_0003 0 0.0 0.0 255.0 READ_WRITE ECU_ADDRESS 0x3F9CD9 /end MEASUREMENT
/begin MEASUREMENT ed_fil_la1_trim_ad.art_aktuell_nv "Fehlerart und Statusbits" UWORD FORMULA_0052 0 0.0 0.0 65535.0 READ_WRITE BIT_MASK 0xB4F ECU_ADDRESS 0x3F9D82 /end MEASUREMENT
/begin MEASUREMENT ed_fil_la1_trim_ad.fehler_aufrufe_nv "Gesamtzahl der Fehleraufrufe" UBYTE FORMULA_0003 0 0.0 0.0 255.0 READ_WRITE ECU_ADDRESS 0x3F9D85 /end MEASUREMENT
/begin MEASUREMENT ed_fil_la1_trim_ad.filter_max_nv "Maximaler Fehlerfilterwert" UBYTE FORMULA_0003 0 0.0 0.0 255.0 READ_WRITE ECU_ADDRESS 0x3F9D84 /end MEASUREMENT
/begin MEASUREMENT ed_fil_la1_trim_ad.filter_nv "Filterwert vor und nach Eintrag" UBYTE FORMULA_0003 0 0.0 0.0 255.0 READ_WRITE ECU_ADDRESS 0x3F9D80 /end MEASUREMENT
/begin MEASUREMENT ed_fil_la1_trim_ad.zyklus_filter_nv "Vorwaertsfilter zur Fehlerzustandsbestaetigung" UBYTE FORMULA_0003 0 0.0 0.0 255.0 READ_WRITE ECU_ADDRESS 0x3F9D81 /end MEASUREMENT
/begin MEASUREMENT ed_fil_la2_adapt.art_aktuell_nv "Fehlerart und Statusbits" UWORD FORMULA_0052 0 0.0 0.0 65535.0 READ_WRITE BIT_MASK 0xB4F ECU_ADDRESS 0x3F9CE0 /end MEASUREMENT
/begin MEASUREMENT ed_fil_la2_adapt.fehler_aufrufe_nv "Gesamtzahl der Fehleraufrufe" UBYTE FORMULA_0003 0 0.0 0.0 255.0 READ_WRITE ECU_ADDRESS 0x3F9CE3 /end MEASUREMENT
/begin MEASUREMENT ed_fil_la2_adapt.filter_max_nv "Maximaler Fehlerfilterwert" UBYTE FORMULA_0003 0 0.0 0.0 255.0 READ_WRITE ECU_ADDRESS 0x3F9CE2 /end MEASUREMENT
/begin MEASUREMENT ed_fil_la2_adapt.filter_nv "Filterwert vor und nach Eintrag" UBYTE FORMULA_0003 0 0.0 0.0 255.0 READ_WRITE ECU_ADDRESS 0x3F9CDE /end MEASUREMENT
/begin MEASUREMENT ed_fil_la2_adapt.zyklus_filter_nv "Vorwaertsfilter zur Fehlerzustandsbestaetigung" UBYTE FORMULA_0003 0 0.0 0.0 255.0 READ_WRITE ECU_ADDRESS 0x3F9CDF /end MEASUREMENT
/begin MEASUREMENT ed_fil_la2_trim_ad.art_aktuell_nv "Fehlerart und Statusbits" UWORD FORMULA_0052 0 0.0 0.0 65535.0 READ_WRITE BIT_MASK 0xB4F ECU_ADDRESS 0x3F9D88 /end MEASUREMENT
/begin MEASUREMENT ed_fil_la2_trim_ad.fehler_aufrufe_nv "Gesamtzahl der Fehleraufrufe" UBYTE FORMULA_0003 0 0.0 0.0 255.0 READ_WRITE ECU_ADDRESS 0x3F9D8B /end MEASUREMENT
/begin MEASUREMENT ed_fil_la2_trim_ad.filter_max_nv "Maximaler Fehlerfilterwert" UBYTE FORMULA_0003 0 0.0 0.0 255.0 READ_WRITE ECU_ADDRESS 0x3F9D8A /end MEASUREMENT
/begin MEASUREMENT ed_fil_la2_trim_ad.filter_nv "Filterwert vor und nach Eintrag" UBYTE FORMULA_0003 0 0.0 0.0 255.0 READ_WRITE ECU_ADDRESS 0x3F9D86 /end MEASUREMENT
/begin MEASUREMENT ed_fil_la2_trim_ad.zyklus_filter_nv "Vorwaertsfilter zur Fehlerzustandsbestaetigung" UBYTE FORMULA_0003 0 0.0 0.0 255.0 READ_WRITE ECU_ADDRESS 0x3F9D87 /end MEASUREMENT
/begin MEASUREMENT ed_fil_lam1_reg.art_aktuell_nv "Fehlerart und Statusbits" UWORD FORMULA_0052 0 0.0 0.0 65535.0 READ_WRITE BIT_MASK 0xB4F ECU_ADDRESS 0x3F9B0C /end MEASUREMENT
/begin MEASUREMENT ed_fil_lam1_reg.fehler_aufrufe_nv "Gesamtzahl der Fehleraufrufe" UBYTE FORMULA_0003 0 0.0 0.0 255.0 READ_WRITE ECU_ADDRESS 0x3F9B0F /end MEASUREMENT
/begin MEASUREMENT ed_fil_lam1_reg.filter_max_nv "Maximaler Fehlerfilterwert" UBYTE FORMULA_0003 0 0.0 0.0 255.0 READ_WRITE ECU_ADDRESS 0x3F9B0E /end MEASUREMENT
/begin MEASUREMENT ed_fil_lam1_reg.filter_nv "Filterwert vor und nach Eintrag" UBYTE FORMULA_0003 0 0.0 0.0 255.0 READ_WRITE ECU_ADDRESS 0x3F9B0A /end MEASUREMENT
/begin MEASUREMENT ed_fil_lam1_reg.zyklus_filter_nv "Vorwaertsfilter zur Fehlerzustandsbestaetigung" UBYTE FORMULA_0003 0 0.0 0.0 255.0 READ_WRITE ECU_ADDRESS 0x3F9B0B /end MEASUREMENT
/begin MEASUREMENT ed_fil_lam2_reg.art_aktuell_nv "Fehlerart und Statusbits" UWORD FORMULA_0052 0 0.0 0.0 65535.0 READ_WRITE BIT_MASK 0xB4F ECU_ADDRESS 0x3F9B12 /end MEASUREMENT
/begin MEASUREMENT ed_fil_lam2_reg.fehler_aufrufe_nv "Gesamtzahl der Fehleraufrufe" UBYTE FORMULA_0003 0 0.0 0.0 255.0 READ_WRITE ECU_ADDRESS 0x3F9B15 /end MEASUREMENT
/begin MEASUREMENT ed_fil_lam2_reg.filter_max_nv "Maximaler Fehlerfilterwert" UBYTE FORMULA_0003 0 0.0 0.0 255.0 READ_WRITE ECU_ADDRESS 0x3F9B14 /end MEASUREMENT
/begin MEASUREMENT ed_fil_lam2_reg.filter_nv "Filterwert vor und nach Eintrag" UBYTE FORMULA_0003 0 0.0 0.0 255.0 READ_WRITE ECU_ADDRESS 0x3F9B10 /end MEASUREMENT
/begin MEASUREMENT ed_fil_lam2_reg.zyklus_filter_nv "Vorwaertsfilter zur Fehlerzustandsbestaetigung" UBYTE FORMULA_0003 0 0.0 0.0 255.0 READ_WRITE ECU_ADDRESS 0x3F9B11 /end MEASUREMENT
/begin MEASUREMENT ed_fil_lank1.art_aktuell_nv "Fehlerart und Statusbits" UWORD FORMULA_0052 0 0.0 0.0 65535.0 READ_WRITE BIT_MASK 0xB4F ECU_ADDRESS 0x3F99DA /end MEASUREMENT
/begin MEASUREMENT ed_fil_lank1.fehler_aufrufe_nv "Gesamtzahl der Fehleraufrufe" UBYTE FORMULA_0003 0 0.0 0.0 255.0 READ_WRITE ECU_ADDRESS 0x3F99DD /end MEASUREMENT
/begin MEASUREMENT ed_fil_lank1.filter_max_nv "Maximaler Fehlerfilterwert" UBYTE FORMULA_0003 0 0.0 0.0 255.0 READ_WRITE ECU_ADDRESS 0x3F99DC /end MEASUREMENT
/begin MEASUREMENT ed_fil_lank1.filter_nv "Filterwert vor und nach Eintrag" UBYTE FORMULA_0003 0 0.0 0.0 255.0 READ_WRITE ECU_ADDRESS 0x3F99D8 /end MEASUREMENT
/begin MEASUREMENT ed_fil_lank1.zyklus_filter_nv "Vorwaertsfilter zur Fehlerzustandsbestaetigung" UBYTE FORMULA_0003 0 0.0 0.0 255.0 READ_WRITE ECU_ADDRESS 0x3F99D9 /end MEASUREMENT
/begin MEASUREMENT ed_fil_lank1_obd_s.art_aktuell_nv "Fehlerart und Statusbits" UWORD FORMULA_0052 0 0.0 0.0 65535.0 READ_WRITE BIT_MASK 0xB4F ECU_ADDRESS 0x3F9A3A /end MEASUREMENT
/begin MEASUREMENT ed_fil_lank1_obd_s.fehler_aufrufe_nv "Gesamtzahl der Fehleraufrufe" UBYTE FORMULA_0003 0 0.0 0.0 255.0 READ_WRITE ECU_ADDRESS 0x3F9A3D /end MEASUREMENT
/begin MEASUREMENT ed_fil_lank1_obd_s.filter_max_nv "Maximaler Fehlerfilterwert" UBYTE FORMULA_0003 0 0.0 0.0 255.0 READ_WRITE ECU_ADDRESS 0x3F9A3C /end MEASUREMENT
/begin MEASUREMENT ed_fil_lank1_obd_s.filter_nv "Filterwert vor und nach Eintrag" UBYTE FORMULA_0003 0 0.0 0.0 255.0 READ_WRITE ECU_ADDRESS 0x3F9A38 /end MEASUREMENT
/begin MEASUREMENT ed_fil_lank1_obd_s.zyklus_filter_nv "Vorwaertsfilter zur Fehlerzustandsbestaetigung" UBYTE FORMULA_0003 0 0.0 0.0 255.0 READ_WRITE ECU_ADDRESS 0x3F9A39 /end MEASUREMENT
/begin MEASUREMENT ed_fil_lank1_obd_we.art_aktuell_nv "Fehlerart und Statusbits" UWORD FORMULA_0052 0 0.0 0.0 65535.0 READ_WRITE BIT_MASK 0xB4F ECU_ADDRESS 0x3F9D9A /end MEASUREMENT
/begin MEASUREMENT ed_fil_lank1_obd_we.fehler_aufrufe_nv "Gesamtzahl der Fehleraufrufe" UBYTE FORMULA_0003 0 0.0 0.0 255.0 READ_WRITE ECU_ADDRESS 0x3F9D9D /end MEASUREMENT
/begin MEASUREMENT ed_fil_lank1_obd_we.filter_max_nv "Maximaler Fehlerfilterwert" UBYTE FORMULA_0003 0 0.0 0.0 255.0 READ_WRITE ECU_ADDRESS 0x3F9D9C /end MEASUREMENT
/begin MEASUREMENT ed_fil_lank1_obd_we.filter_nv "Filterwert vor und nach Eintrag" UBYTE FORMULA_0003 0 0.0 0.0 255.0 READ_WRITE ECU_ADDRESS 0x3F9D98 /end MEASUREMENT
/begin MEASUREMENT ed_fil_lank1_obd_we.zyklus_filter_nv "Vorwaertsfilter zur Fehlerzustandsbestaetigung" UBYTE FORMULA_0003 0 0.0 0.0 255.0 READ_WRITE ECU_ADDRESS 0x3F9D99 /end MEASUREMENT
/begin MEASUREMENT ed_fil_lank1_openload.art_aktuell_nv "Fehlerart und Statusbits" UWORD FORMULA_0052 0 0.0 0.0 65535.0 READ_WRITE BIT_MASK 0xB4F ECU_ADDRESS 0x3F9D8E /end MEASUREMENT
/begin MEASUREMENT ed_fil_lank1_openload.fehler_aufrufe_nv "Gesamtzahl der Fehleraufrufe" UBYTE FORMULA_0003 0 0.0 0.0 255.0 READ_WRITE ECU_ADDRESS 0x3F9D91 /end MEASUREMENT
/begin MEASUREMENT ed_fil_lank1_openload.filter_max_nv "Maximaler Fehlerfilterwert" UBYTE FORMULA_0003 0 0.0 0.0 255.0 READ_WRITE ECU_ADDRESS 0x3F9D90 /end MEASUREMENT
/begin MEASUREMENT ed_fil_lank1_openload.filter_nv "Filterwert vor und nach Eintrag" UBYTE FORMULA_0003 0 0.0 0.0 255.0 READ_WRITE ECU_ADDRESS 0x3F9D8C /end MEASUREMENT
/begin MEASUREMENT ed_fil_lank1_openload.zyklus_filter_nv "Vorwaertsfilter zur Fehlerzustandsbestaetigung" UBYTE FORMULA_0003 0 0.0 0.0 255.0 READ_WRITE ECU_ADDRESS 0x3F9D8D /end MEASUREMENT
/begin MEASUREMENT ed_fil_lank2.art_aktuell_nv "Fehlerart und Statusbits" UWORD FORMULA_0052 0 0.0 0.0 65535.0 READ_WRITE BIT_MASK 0xB4F ECU_ADDRESS 0x3F99E0 /end MEASUREMENT
/begin MEASUREMENT ed_fil_lank2.fehler_aufrufe_nv "Gesamtzahl der Fehleraufrufe" UBYTE FORMULA_0003 0 0.0 0.0 255.0 READ_WRITE ECU_ADDRESS 0x3F99E3 /end MEASUREMENT
/begin MEASUREMENT ed_fil_lank2.filter_max_nv "Maximaler Fehlerfilterwert" UBYTE FORMULA_0003 0 0.0 0.0 255.0 READ_WRITE ECU_ADDRESS 0x3F99E2 /end MEASUREMENT
/begin MEASUREMENT ed_fil_lank2.filter_nv "Filterwert vor und nach Eintrag" UBYTE FORMULA_0003 0 0.0 0.0 255.0 READ_WRITE ECU_ADDRESS 0x3F99DE /end MEASUREMENT
/begin MEASUREMENT ed_fil_lank2.zyklus_filter_nv "Vorwaertsfilter zur Fehlerzustandsbestaetigung" UBYTE FORMULA_0003 0 0.0 0.0 255.0 READ_WRITE ECU_ADDRESS 0x3F99DF /end MEASUREMENT
/begin MEASUREMENT ed_fil_lank2_obd_s.art_aktuell_nv "Fehlerart und Statusbits" UWORD FORMULA_0052 0 0.0 0.0 65535.0 READ_WRITE BIT_MASK 0xB4F ECU_ADDRESS 0x3F9A40 /end MEASUREMENT
/begin MEASUREMENT ed_fil_lank2_obd_s.fehler_aufrufe_nv "Gesamtzahl der Fehleraufrufe" UBYTE FORMULA_0003 0 0.0 0.0 255.0 READ_WRITE ECU_ADDRESS 0x3F9A43 /end MEASUREMENT
/begin MEASUREMENT ed_fil_lank2_obd_s.filter_max_nv "Maximaler Fehlerfilterwert" UBYTE FORMULA_0003 0 0.0 0.0 255.0 READ_WRITE ECU_ADDRESS 0x3F9A42 /end MEASUREMENT
/begin MEASUREMENT ed_fil_lank2_obd_s.filter_nv "Filterwert vor und nach Eintrag" UBYTE FORMULA_0003 0 0.0 0.0 255.0 READ_WRITE ECU_ADDRESS 0x3F9A3E /end MEASUREMENT
/begin MEASUREMENT ed_fil_lank2_obd_s.zyklus_filter_nv "Vorwaertsfilter zur Fehlerzustandsbestaetigung" UBYTE FORMULA_0003 0 0.0 0.0 255.0 READ_WRITE ECU_ADDRESS 0x3F9A3F /end MEASUREMENT
/begin MEASUREMENT ed_fil_lank2_obd_we.art_aktuell_nv "Fehlerart und Statusbits" UWORD FORMULA_0052 0 0.0 0.0 65535.0 READ_WRITE BIT_MASK 0xB4F ECU_ADDRESS 0x3F9DA0 /end MEASUREMENT
/begin MEASUREMENT ed_fil_lank2_obd_we.fehler_aufrufe_nv "Gesamtzahl der Fehleraufrufe" UBYTE FORMULA_0003 0 0.0 0.0 255.0 READ_WRITE ECU_ADDRESS 0x3F9DA3 /end MEASUREMENT
/begin MEASUREMENT ed_fil_lank2_obd_we.filter_max_nv "Maximaler Fehlerfilterwert" UBYTE FORMULA_0003 0 0.0 0.0 255.0 READ_WRITE ECU_ADDRESS 0x3F9DA2 /end MEASUREMENT
/begin MEASUREMENT ed_fil_lank2_obd_we.filter_nv "Filterwert vor und nach Eintrag" UBYTE FORMULA_0003 0 0.0 0.0 255.0 READ_WRITE ECU_ADDRESS 0x3F9D9E /end MEASUREMENT
/begin MEASUREMENT ed_fil_lank2_obd_we.zyklus_filter_nv "Vorwaertsfilter zur Fehlerzustandsbestaetigung" UBYTE FORMULA_0003 0 0.0 0.0 255.0 READ_WRITE ECU_ADDRESS 0x3F9D9F /end MEASUREMENT
/begin MEASUREMENT ed_fil_lank2_openload.art_aktuell_nv "Fehlerart und Statusbits" UWORD FORMULA_0052 0 0.0 0.0 65535.0 READ_WRITE BIT_MASK 0xB4F ECU_ADDRESS 0x3F9D94 /end MEASUREMENT
/begin MEASUREMENT ed_fil_lank2_openload.fehler_aufrufe_nv "Gesamtzahl der Fehleraufrufe" UBYTE FORMULA_0003 0 0.0 0.0 255.0 READ_WRITE ECU_ADDRESS 0x3F9D97 /end MEASUREMENT
/begin MEASUREMENT ed_fil_lank2_openload.filter_max_nv "Maximaler Fehlerfilterwert" UBYTE FORMULA_0003 0 0.0 0.0 255.0 READ_WRITE ECU_ADDRESS 0x3F9D96 /end MEASUREMENT
/begin MEASUREMENT ed_fil_lank2_openload.filter_nv "Filterwert vor und nach Eintrag" UBYTE FORMULA_0003 0 0.0 0.0 255.0 READ_WRITE ECU_ADDRESS 0x3F9D92 /end MEASUREMENT
/begin MEASUREMENT ed_fil_lank2_openload.zyklus_filter_nv "Vorwaertsfilter zur Fehlerzustandsbestaetigung" UBYTE FORMULA_0003 0 0.0 0.0 255.0 READ_WRITE ECU_ADDRESS 0x3F9D93 /end MEASUREMENT
/begin MEASUREMENT ed_fil_lavk_atic42.art_aktuell_nv "Fehlerart und Statusbits" UWORD FORMULA_0052 0 0.0 0.0 65535.0 READ_WRITE BIT_MASK 0xB4F ECU_ADDRESS 0x3F9DCA /end MEASUREMENT
/begin MEASUREMENT ed_fil_lavk_atic42.fehler_aufrufe_nv "Gesamtzahl der Fehleraufrufe" UBYTE FORMULA_0003 0 0.0 0.0 255.0 READ_WRITE ECU_ADDRESS 0x3F9DCD /end MEASUREMENT
/begin MEASUREMENT ed_fil_lavk_atic42.filter_max_nv "Maximaler Fehlerfilterwert" UBYTE FORMULA_0003 0 0.0 0.0 255.0 READ_WRITE ECU_ADDRESS 0x3F9DCC /end MEASUREMENT
/begin MEASUREMENT ed_fil_lavk_atic42.filter_nv "Filterwert vor und nach Eintrag" UBYTE FORMULA_0003 0 0.0 0.0 255.0 READ_WRITE ECU_ADDRESS 0x3F9DC8 /end MEASUREMENT
/begin MEASUREMENT ed_fil_lavk_atic42.zyklus_filter_nv "Vorwaertsfilter zur Fehlerzustandsbestaetigung" UBYTE FORMULA_0003 0 0.0 0.0 255.0 READ_WRITE ECU_ADDRESS 0x3F9DC9 /end MEASUREMENT
/begin MEASUREMENT ed_fil_lavk1.art_aktuell_nv "Fehlerart und Statusbits" UWORD FORMULA_0052 0 0.0 0.0 65535.0 READ_WRITE BIT_MASK 0xB4F ECU_ADDRESS 0x3F99B6 /end MEASUREMENT
/begin MEASUREMENT ed_fil_lavk1.fehler_aufrufe_nv "Gesamtzahl der Fehleraufrufe" UBYTE FORMULA_0003 0 0.0 0.0 255.0 READ_WRITE ECU_ADDRESS 0x3F99B9 /end MEASUREMENT
/begin MEASUREMENT ed_fil_lavk1.filter_max_nv "Maximaler Fehlerfilterwert" UBYTE FORMULA_0003 0 0.0 0.0 255.0 READ_WRITE ECU_ADDRESS 0x3F99B8 /end MEASUREMENT
/begin MEASUREMENT ed_fil_lavk1.filter_nv "Filterwert vor und nach Eintrag" UBYTE FORMULA_0003 0 0.0 0.0 255.0 READ_WRITE ECU_ADDRESS 0x3F99B4 /end MEASUREMENT
/begin MEASUREMENT ed_fil_lavk1.zyklus_filter_nv "Vorwaertsfilter zur Fehlerzustandsbestaetigung" UBYTE FORMULA_0003 0 0.0 0.0 255.0 READ_WRITE ECU_ADDRESS 0x3F99B5 /end MEASUREMENT
/begin MEASUREMENT ed_fil_lavk1_diag.art_aktuell_nv "Fehlerart und Statusbits" UWORD FORMULA_0052 0 0.0 0.0 65535.0 READ_WRITE BIT_MASK 0xB4F ECU_ADDRESS 0x3F9A8E /end MEASUREMENT
/begin MEASUREMENT ed_fil_lavk1_diag.fehler_aufrufe_nv "Gesamtzahl der Fehleraufrufe" UBYTE FORMULA_0003 0 0.0 0.0 255.0 READ_WRITE ECU_ADDRESS 0x3F9A91 /end MEASUREMENT
/begin MEASUREMENT ed_fil_lavk1_diag.filter_max_nv "Maximaler Fehlerfilterwert" UBYTE FORMULA_0003 0 0.0 0.0 255.0 READ_WRITE ECU_ADDRESS 0x3F9A90 /end MEASUREMENT
/begin MEASUREMENT ed_fil_lavk1_diag.filter_nv "Filterwert vor und nach Eintrag" UBYTE FORMULA_0003 0 0.0 0.0 255.0 READ_WRITE ECU_ADDRESS 0x3F9A8C /end MEASUREMENT
/begin MEASUREMENT ed_fil_lavk1_diag.zyklus_filter_nv "Vorwaertsfilter zur Fehlerzustandsbestaetigung" UBYTE FORMULA_0003 0 0.0 0.0 255.0 READ_WRITE ECU_ADDRESS 0x3F9A8D /end MEASUREMENT
/begin MEASUREMENT ed_fil_lavk1_ia_openload.art_aktuell_nv "Fehlerart und Statusbits" UWORD FORMULA_0052 0 0.0 0.0 65535.0 READ_WRITE BIT_MASK 0xB4F ECU_ADDRESS 0x3F9A9A /end MEASUREMENT
/begin MEASUREMENT ed_fil_lavk1_ia_openload.fehler_aufrufe_nv "Gesamtzahl der Fehleraufrufe" UBYTE FORMULA_0003 0 0.0 0.0 255.0 READ_WRITE ECU_ADDRESS 0x3F9A9D /end MEASUREMENT
/begin MEASUREMENT ed_fil_lavk1_ia_openload.filter_max_nv "Maximaler Fehlerfilterwert" UBYTE FORMULA_0003 0 0.0 0.0 255.0 READ_WRITE ECU_ADDRESS 0x3F9A9C /end MEASUREMENT
/begin MEASUREMENT ed_fil_lavk1_ia_openload.filter_nv "Filterwert vor und nach Eintrag" UBYTE FORMULA_0003 0 0.0 0.0 255.0 READ_WRITE ECU_ADDRESS 0x3F9A98 /end MEASUREMENT
/begin MEASUREMENT ed_fil_lavk1_ia_openload.zyklus_filter_nv "Vorwaertsfilter zur Fehlerzustandsbestaetigung" UBYTE FORMULA_0003 0 0.0 0.0 255.0 READ_WRITE ECU_ADDRESS 0x3F9A99 /end MEASUREMENT
/begin MEASUREMENT ed_fil_lavk1_ip_openload.art_aktuell_nv "Fehlerart und Statusbits" UWORD FORMULA_0052 0 0.0 0.0 65535.0 READ_WRITE BIT_MASK 0xB4F ECU_ADDRESS 0x3F9ABE /end MEASUREMENT
/begin MEASUREMENT ed_fil_lavk1_ip_openload.fehler_aufrufe_nv "Gesamtzahl der Fehleraufrufe" UBYTE FORMULA_0003 0 0.0 0.0 255.0 READ_WRITE ECU_ADDRESS 0x3F9AC1 /end MEASUREMENT
/begin MEASUREMENT ed_fil_lavk1_ip_openload.filter_max_nv "Maximaler Fehlerfilterwert" UBYTE FORMULA_0003 0 0.0 0.0 255.0 READ_WRITE ECU_ADDRESS 0x3F9AC0 /end MEASUREMENT
/begin MEASUREMENT ed_fil_lavk1_ip_openload.filter_nv "Filterwert vor und nach Eintrag" UBYTE FORMULA_0003 0 0.0 0.0 255.0 READ_WRITE ECU_ADDRESS 0x3F9ABC /end MEASUREMENT
/begin MEASUREMENT ed_fil_lavk1_ip_openload.zyklus_filter_nv "Vorwaertsfilter zur Fehlerzustandsbestaetigung" UBYTE FORMULA_0003 0 0.0 0.0 255.0 READ_WRITE ECU_ADDRESS 0x3F9ABD /end MEASUREMENT
/begin MEASUREMENT ed_fil_lavk1_obd_dyn.art_aktuell_nv "Fehlerart und Statusbits" UWORD FORMULA_0052 0 0.0 0.0 65535.0 READ_WRITE BIT_MASK 0xB4F ECU_ADDRESS 0x3F9B84 /end MEASUREMENT
/begin MEASUREMENT ed_fil_lavk1_obd_dyn.fehler_aufrufe_nv "Gesamtzahl der Fehleraufrufe" UBYTE FORMULA_0003 0 0.0 0.0 255.0 READ_WRITE ECU_ADDRESS 0x3F9B87 /end MEASUREMENT
/begin MEASUREMENT ed_fil_lavk1_obd_dyn.filter_max_nv "Maximaler Fehlerfilterwert" UBYTE FORMULA_0003 0 0.0 0.0 255.0 READ_WRITE ECU_ADDRESS 0x3F9B86 /end MEASUREMENT
/begin MEASUREMENT ed_fil_lavk1_obd_dyn.filter_nv "Filterwert vor und nach Eintrag" UBYTE FORMULA_0003 0 0.0 0.0 255.0 READ_WRITE ECU_ADDRESS 0x3F9B82 /end MEASUREMENT
/begin MEASUREMENT ed_fil_lavk1_obd_dyn.zyklus_filter_nv "Vorwaertsfilter zur Fehlerzustandsbestaetigung" UBYTE FORMULA_0003 0 0.0 0.0 255.0 READ_WRITE ECU_ADDRESS 0x3F9B83 /end MEASUREMENT
/begin MEASUREMENT ed_fil_lavk1_obd_plau.art_aktuell_nv "Fehlerart und Statusbits" UWORD FORMULA_0052 0 0.0 0.0 65535.0 READ_WRITE BIT_MASK 0xB4F ECU_ADDRESS 0x3F99C2 /end MEASUREMENT
/begin MEASUREMENT ed_fil_lavk1_obd_plau.fehler_aufrufe_nv "Gesamtzahl der Fehleraufrufe" UBYTE FORMULA_0003 0 0.0 0.0 255.0 READ_WRITE ECU_ADDRESS 0x3F99C5 /end MEASUREMENT
/begin MEASUREMENT ed_fil_lavk1_obd_plau.filter_max_nv "Maximaler Fehlerfilterwert" UBYTE FORMULA_0003 0 0.0 0.0 255.0 READ_WRITE ECU_ADDRESS 0x3F99C4 /end MEASUREMENT
/begin MEASUREMENT ed_fil_lavk1_obd_plau.filter_nv "Filterwert vor und nach Eintrag" UBYTE FORMULA_0003 0 0.0 0.0 255.0 READ_WRITE ECU_ADDRESS 0x3F99C0 /end MEASUREMENT
/begin MEASUREMENT ed_fil_lavk1_obd_plau.zyklus_filter_nv "Vorwaertsfilter zur Fehlerzustandsbestaetigung" UBYTE FORMULA_0003 0 0.0 0.0 255.0 READ_WRITE ECU_ADDRESS 0x3F99C1 /end MEASUREMENT
/begin MEASUREMENT ed_fil_lavk1_obd_sa.art_aktuell_nv "Fehlerart und Statusbits" UWORD FORMULA_0052 0 0.0 0.0 65535.0 READ_WRITE BIT_MASK 0xB4F ECU_ADDRESS 0x3F99CE /end MEASUREMENT
/begin MEASUREMENT ed_fil_lavk1_obd_sa.fehler_aufrufe_nv "Gesamtzahl der Fehleraufrufe" UBYTE FORMULA_0003 0 0.0 0.0 255.0 READ_WRITE ECU_ADDRESS 0x3F99D1 /end MEASUREMENT
/begin MEASUREMENT ed_fil_lavk1_obd_sa.filter_max_nv "Maximaler Fehlerfilterwert" UBYTE FORMULA_0003 0 0.0 0.0 255.0 READ_WRITE ECU_ADDRESS 0x3F99D0 /end MEASUREMENT
/begin MEASUREMENT ed_fil_lavk1_obd_sa.filter_nv "Filterwert vor und nach Eintrag" UBYTE FORMULA_0003 0 0.0 0.0 255.0 READ_WRITE ECU_ADDRESS 0x3F99CC /end MEASUREMENT
/begin MEASUREMENT ed_fil_lavk1_obd_sa.zyklus_filter_nv "Vorwaertsfilter zur Fehlerzustandsbestaetigung" UBYTE FORMULA_0003 0 0.0 0.0 255.0 READ_WRITE ECU_ADDRESS 0x3F99CD /end MEASUREMENT
/begin MEASUREMENT ed_fil_lavk1_obd_tl.art_aktuell_nv "Fehlerart und Statusbits" UWORD FORMULA_0052 0 0.0 0.0 65535.0 READ_WRITE BIT_MASK 0xB4F ECU_ADDRESS 0x3F9A46 /end MEASUREMENT
/begin MEASUREMENT ed_fil_lavk1_obd_tl.fehler_aufrufe_nv "Gesamtzahl der Fehleraufrufe" UBYTE FORMULA_0003 0 0.0 0.0 255.0 READ_WRITE ECU_ADDRESS 0x3F9A49 /end MEASUREMENT
/begin MEASUREMENT ed_fil_lavk1_obd_tl.filter_max_nv "Maximaler Fehlerfilterwert" UBYTE FORMULA_0003 0 0.0 0.0 255.0 READ_WRITE ECU_ADDRESS 0x3F9A48 /end MEASUREMENT
/begin MEASUREMENT ed_fil_lavk1_obd_tl.filter_nv "Filterwert vor und nach Eintrag" UBYTE FORMULA_0003 0 0.0 0.0 255.0 READ_WRITE ECU_ADDRESS 0x3F9A44 /end MEASUREMENT
/begin MEASUREMENT ed_fil_lavk1_obd_tl.zyklus_filter_nv "Vorwaertsfilter zur Fehlerzustandsbestaetigung" UBYTE FORMULA_0003 0 0.0 0.0 255.0 READ_WRITE ECU_ADDRESS 0x3F9A45 /end MEASUREMENT
/begin MEASUREMENT ed_fil_lavk1_trim.art_aktuell_nv "Fehlerart und Statusbits" UWORD FORMULA_0052 0 0.0 0.0 65535.0 READ_WRITE BIT_MASK 0xB4F ECU_ADDRESS 0x3F9BC6 /end MEASUREMENT
/begin MEASUREMENT ed_fil_lavk1_trim.fehler_aufrufe_nv "Gesamtzahl der Fehleraufrufe" UBYTE FORMULA_0003 0 0.0 0.0 255.0 READ_WRITE ECU_ADDRESS 0x3F9BC9 /end MEASUREMENT
/begin MEASUREMENT ed_fil_lavk1_trim.filter_max_nv "Maximaler Fehlerfilterwert" UBYTE FORMULA_0003 0 0.0 0.0 255.0 READ_WRITE ECU_ADDRESS 0x3F9BC8 /end MEASUREMENT
/begin MEASUREMENT ed_fil_lavk1_trim.filter_nv "Filterwert vor und nach Eintrag" UBYTE FORMULA_0003 0 0.0 0.0 255.0 READ_WRITE ECU_ADDRESS 0x3F9BC4 /end MEASUREMENT
/begin MEASUREMENT ed_fil_lavk1_trim.zyklus_filter_nv "Vorwaertsfilter zur Fehlerzustandsbestaetigung" UBYTE FORMULA_0003 0 0.0 0.0 255.0 READ_WRITE ECU_ADDRESS 0x3F9BC5 /end MEASUREMENT
/begin MEASUREMENT ed_fil_lavk1_un_openload.art_aktuell_nv "Fehlerart und Statusbits" UWORD FORMULA_0052 0 0.0 0.0 65535.0 READ_WRITE BIT_MASK 0xB4F ECU_ADDRESS 0x3F9AB2 /end MEASUREMENT
/begin MEASUREMENT ed_fil_lavk1_un_openload.fehler_aufrufe_nv "Gesamtzahl der Fehleraufrufe" UBYTE FORMULA_0003 0 0.0 0.0 255.0 READ_WRITE ECU_ADDRESS 0x3F9AB5 /end MEASUREMENT
/begin MEASUREMENT ed_fil_lavk1_un_openload.filter_max_nv "Maximaler Fehlerfilterwert" UBYTE FORMULA_0003 0 0.0 0.0 255.0 READ_WRITE ECU_ADDRESS 0x3F9AB4 /end MEASUREMENT
/begin MEASUREMENT ed_fil_lavk1_un_openload.filter_nv "Filterwert vor und nach Eintrag" UBYTE FORMULA_0003 0 0.0 0.0 255.0 READ_WRITE ECU_ADDRESS 0x3F9AB0 /end MEASUREMENT
/begin MEASUREMENT ed_fil_lavk1_un_openload.zyklus_filter_nv "Vorwaertsfilter zur Fehlerzustandsbestaetigung" UBYTE FORMULA_0003 0 0.0 0.0 255.0 READ_WRITE ECU_ADDRESS 0x3F9AB1 /end MEASUREMENT
/begin MEASUREMENT ed_fil_lavk2.art_aktuell_nv "Fehlerart und Statusbits" UWORD FORMULA_0052 0 0.0 0.0 65535.0 READ_WRITE BIT_MASK 0xB4F ECU_ADDRESS 0x3F99BC /end MEASUREMENT
/begin MEASUREMENT ed_fil_lavk2.fehler_aufrufe_nv "Gesamtzahl der Fehleraufrufe" UBYTE FORMULA_0003 0 0.0 0.0 255.0 READ_WRITE ECU_ADDRESS 0x3F99BF /end MEASUREMENT
/begin MEASUREMENT ed_fil_lavk2.filter_max_nv "Maximaler Fehlerfilterwert" UBYTE FORMULA_0003 0 0.0 0.0 255.0 READ_WRITE ECU_ADDRESS 0x3F99BE /end MEASUREMENT
/begin MEASUREMENT ed_fil_lavk2.filter_nv "Filterwert vor und nach Eintrag" UBYTE FORMULA_0003 0 0.0 0.0 255.0 READ_WRITE ECU_ADDRESS 0x3F99BA /end MEASUREMENT
/begin MEASUREMENT ed_fil_lavk2.zyklus_filter_nv "Vorwaertsfilter zur Fehlerzustandsbestaetigung" UBYTE FORMULA_0003 0 0.0 0.0 255.0 READ_WRITE ECU_ADDRESS 0x3F99BB /end MEASUREMENT
/begin MEASUREMENT ed_fil_lavk2_diag.art_aktuell_nv "Fehlerart und Statusbits" UWORD FORMULA_0052 0 0.0 0.0 65535.0 READ_WRITE BIT_MASK 0xB4F ECU_ADDRESS 0x3F9A94 /end MEASUREMENT
/begin MEASUREMENT ed_fil_lavk2_diag.fehler_aufrufe_nv "Gesamtzahl der Fehleraufrufe" UBYTE FORMULA_0003 0 0.0 0.0 255.0 READ_WRITE ECU_ADDRESS 0x3F9A97 /end MEASUREMENT
/begin MEASUREMENT ed_fil_lavk2_diag.filter_max_nv "Maximaler Fehlerfilterwert" UBYTE FORMULA_0003 0 0.0 0.0 255.0 READ_WRITE ECU_ADDRESS 0x3F9A96 /end MEASUREMENT
/begin MEASUREMENT ed_fil_lavk2_diag.filter_nv "Filterwert vor und nach Eintrag" UBYTE FORMULA_0003 0 0.0 0.0 255.0 READ_WRITE ECU_ADDRESS 0x3F9A92 /end MEASUREMENT
/begin MEASUREMENT ed_fil_lavk2_diag.zyklus_filter_nv "Vorwaertsfilter zur Fehlerzustandsbestaetigung" UBYTE FORMULA_0003 0 0.0 0.0 255.0 READ_WRITE ECU_ADDRESS 0x3F9A93 /end MEASUREMENT
/begin MEASUREMENT ed_fil_lavk2_ia_openload.art_aktuell_nv "Fehlerart und Statusbits" UWORD FORMULA_0052 0 0.0 0.0 65535.0 READ_WRITE BIT_MASK 0xB4F ECU_ADDRESS 0x3F9AA0 /end MEASUREMENT
/begin MEASUREMENT ed_fil_lavk2_ia_openload.fehler_aufrufe_nv "Gesamtzahl der Fehleraufrufe" UBYTE FORMULA_0003 0 0.0 0.0 255.0 READ_WRITE ECU_ADDRESS 0x3F9AA3 /end MEASUREMENT
/begin MEASUREMENT ed_fil_lavk2_ia_openload.filter_max_nv "Maximaler Fehlerfilterwert" UBYTE FORMULA_0003 0 0.0 0.0 255.0 READ_WRITE ECU_ADDRESS 0x3F9AA2 /end MEASUREMENT
/begin MEASUREMENT ed_fil_lavk2_ia_openload.filter_nv "Filterwert vor und nach Eintrag" UBYTE FORMULA_0003 0 0.0 0.0 255.0 READ_WRITE ECU_ADDRESS 0x3F9A9E /end MEASUREMENT
/begin MEASUREMENT ed_fil_lavk2_ia_openload.zyklus_filter_nv "Vorwaertsfilter zur Fehlerzustandsbestaetigung" UBYTE FORMULA_0003 0 0.0 0.0 255.0 READ_WRITE ECU_ADDRESS 0x3F9A9F /end MEASUREMENT
/begin MEASUREMENT ed_fil_lavk2_ip_openload.art_aktuell_nv "Fehlerart und Statusbits" UWORD FORMULA_0052 0 0.0 0.0 65535.0 READ_WRITE BIT_MASK 0xB4F ECU_ADDRESS 0x3F9AC4 /end MEASUREMENT
/begin MEASUREMENT ed_fil_lavk2_ip_openload.fehler_aufrufe_nv "Gesamtzahl der Fehleraufrufe" UBYTE FORMULA_0003 0 0.0 0.0 255.0 READ_WRITE ECU_ADDRESS 0x3F9AC7 /end MEASUREMENT
/begin MEASUREMENT ed_fil_lavk2_ip_openload.filter_max_nv "Maximaler Fehlerfilterwert" UBYTE FORMULA_0003 0 0.0 0.0 255.0 READ_WRITE ECU_ADDRESS 0x3F9AC6 /end MEASUREMENT
/begin MEASUREMENT ed_fil_lavk2_ip_openload.filter_nv "Filterwert vor und nach Eintrag" UBYTE FORMULA_0003 0 0.0 0.0 255.0 READ_WRITE ECU_ADDRESS 0x3F9AC2 /end MEASUREMENT
/begin MEASUREMENT ed_fil_lavk2_ip_openload.zyklus_filter_nv "Vorwaertsfilter zur Fehlerzustandsbestaetigung" UBYTE FORMULA_0003 0 0.0 0.0 255.0 READ_WRITE ECU_ADDRESS 0x3F9AC3 /end MEASUREMENT
/begin MEASUREMENT ed_fil_lavk2_obd_dyn.art_aktuell_nv "Fehlerart und Statusbits" UWORD FORMULA_0052 0 0.0 0.0 65535.0 READ_WRITE BIT_MASK 0xB4F ECU_ADDRESS 0x3F9B8A /end MEASUREMENT
/begin MEASUREMENT ed_fil_lavk2_obd_dyn.fehler_aufrufe_nv "Gesamtzahl der Fehleraufrufe" UBYTE FORMULA_0003 0 0.0 0.0 255.0 READ_WRITE ECU_ADDRESS 0x3F9B8D /end MEASUREMENT
/begin MEASUREMENT ed_fil_lavk2_obd_dyn.filter_max_nv "Maximaler Fehlerfilterwert" UBYTE FORMULA_0003 0 0.0 0.0 255.0 READ_WRITE ECU_ADDRESS 0x3F9B8C /end MEASUREMENT
/begin MEASUREMENT ed_fil_lavk2_obd_dyn.filter_nv "Filterwert vor und nach Eintrag" UBYTE FORMULA_0003 0 0.0 0.0 255.0 READ_WRITE ECU_ADDRESS 0x3F9B88 /end MEASUREMENT
/begin MEASUREMENT ed_fil_lavk2_obd_dyn.zyklus_filter_nv "Vorwaertsfilter zur Fehlerzustandsbestaetigung" UBYTE FORMULA_0003 0 0.0 0.0 255.0 READ_WRITE ECU_ADDRESS 0x3F9B89 /end MEASUREMENT
/begin MEASUREMENT ed_fil_lavk2_obd_plau.art_aktuell_nv "Fehlerart und Statusbits" UWORD FORMULA_0052 0 0.0 0.0 65535.0 READ_WRITE BIT_MASK 0xB4F ECU_ADDRESS 0x3F99C8 /end MEASUREMENT
/begin MEASUREMENT ed_fil_lavk2_obd_plau.fehler_aufrufe_nv "Gesamtzahl der Fehleraufrufe" UBYTE FORMULA_0003 0 0.0 0.0 255.0 READ_WRITE ECU_ADDRESS 0x3F99CB /end MEASUREMENT
/begin MEASUREMENT ed_fil_lavk2_obd_plau.filter_max_nv "Maximaler Fehlerfilterwert" UBYTE FORMULA_0003 0 0.0 0.0 255.0 READ_WRITE ECU_ADDRESS 0x3F99CA /end MEASUREMENT
/begin MEASUREMENT ed_fil_lavk2_obd_plau.filter_nv "Filterwert vor und nach Eintrag" UBYTE FORMULA_0003 0 0.0 0.0 255.0 READ_WRITE ECU_ADDRESS 0x3F99C6 /end MEASUREMENT
/begin MEASUREMENT ed_fil_lavk2_obd_plau.zyklus_filter_nv "Vorwaertsfilter zur Fehlerzustandsbestaetigung" UBYTE FORMULA_0003 0 0.0 0.0 255.0 READ_WRITE ECU_ADDRESS 0x3F99C7 /end MEASUREMENT
/begin MEASUREMENT ed_fil_lavk2_obd_sa.art_aktuell_nv "Fehlerart und Statusbits" UWORD FORMULA_0052 0 0.0 0.0 65535.0 READ_WRITE BIT_MASK 0xB4F ECU_ADDRESS 0x3F99D4 /end MEASUREMENT
/begin MEASUREMENT ed_fil_lavk2_obd_sa.fehler_aufrufe_nv "Gesamtzahl der Fehleraufrufe" UBYTE FORMULA_0003 0 0.0 0.0 255.0 READ_WRITE ECU_ADDRESS 0x3F99D7 /end MEASUREMENT
/begin MEASUREMENT ed_fil_lavk2_obd_sa.filter_max_nv "Maximaler Fehlerfilterwert" UBYTE FORMULA_0003 0 0.0 0.0 255.0 READ_WRITE ECU_ADDRESS 0x3F99D6 /end MEASUREMENT
/begin MEASUREMENT ed_fil_lavk2_obd_sa.filter_nv "Filterwert vor und nach Eintrag" UBYTE FORMULA_0003 0 0.0 0.0 255.0 READ_WRITE ECU_ADDRESS 0x3F99D2 /end MEASUREMENT
/begin MEASUREMENT ed_fil_lavk2_obd_sa.zyklus_filter_nv "Vorwaertsfilter zur Fehlerzustandsbestaetigung" UBYTE FORMULA_0003 0 0.0 0.0 255.0 READ_WRITE ECU_ADDRESS 0x3F99D3 /end MEASUREMENT
/begin MEASUREMENT ed_fil_lavk2_obd_tl.art_aktuell_nv "Fehlerart und Statusbits" UWORD FORMULA_0052 0 0.0 0.0 65535.0 READ_WRITE BIT_MASK 0xB4F ECU_ADDRESS 0x3F9A4C /end MEASUREMENT
/begin MEASUREMENT ed_fil_lavk2_obd_tl.fehler_aufrufe_nv "Gesamtzahl der Fehleraufrufe" UBYTE FORMULA_0003 0 0.0 0.0 255.0 READ_WRITE ECU_ADDRESS 0x3F9A4F /end MEASUREMENT
/begin MEASUREMENT ed_fil_lavk2_obd_tl.filter_max_nv "Maximaler Fehlerfilterwert" UBYTE FORMULA_0003 0 0.0 0.0 255.0 READ_WRITE ECU_ADDRESS 0x3F9A4E /end MEASUREMENT
/begin MEASUREMENT ed_fil_lavk2_obd_tl.filter_nv "Filterwert vor und nach Eintrag" UBYTE FORMULA_0003 0 0.0 0.0 255.0 READ_WRITE ECU_ADDRESS 0x3F9A4A /end MEASUREMENT
/begin MEASUREMENT ed_fil_lavk2_obd_tl.zyklus_filter_nv "Vorwaertsfilter zur Fehlerzustandsbestaetigung" UBYTE FORMULA_0003 0 0.0 0.0 255.0 READ_WRITE ECU_ADDRESS 0x3F9A4B /end MEASUREMENT
/begin MEASUREMENT ed_fil_lavk2_trim.art_aktuell_nv "Fehlerart und Statusbits" UWORD FORMULA_0052 0 0.0 0.0 65535.0 READ_WRITE BIT_MASK 0xB4F ECU_ADDRESS 0x3F9BCC /end MEASUREMENT
/begin MEASUREMENT ed_fil_lavk2_trim.fehler_aufrufe_nv "Gesamtzahl der Fehleraufrufe" UBYTE FORMULA_0003 0 0.0 0.0 255.0 READ_WRITE ECU_ADDRESS 0x3F9BCF /end MEASUREMENT
/begin MEASUREMENT ed_fil_lavk2_trim.filter_max_nv "Maximaler Fehlerfilterwert" UBYTE FORMULA_0003 0 0.0 0.0 255.0 READ_WRITE ECU_ADDRESS 0x3F9BCE /end MEASUREMENT
/begin MEASUREMENT ed_fil_lavk2_trim.filter_nv "Filterwert vor und nach Eintrag" UBYTE FORMULA_0003 0 0.0 0.0 255.0 READ_WRITE ECU_ADDRESS 0x3F9BCA /end MEASUREMENT
/begin MEASUREMENT ed_fil_lavk2_trim.zyklus_filter_nv "Vorwaertsfilter zur Fehlerzustandsbestaetigung" UBYTE FORMULA_0003 0 0.0 0.0 255.0 READ_WRITE ECU_ADDRESS 0x3F9BCB /end MEASUREMENT
/begin MEASUREMENT ed_fil_lavk2_un_openload.art_aktuell_nv "Fehlerart und Statusbits" UWORD FORMULA_0052 0 0.0 0.0 65535.0 READ_WRITE BIT_MASK 0xB4F ECU_ADDRESS 0x3F9AB8 /end MEASUREMENT
/begin MEASUREMENT ed_fil_lavk2_un_openload.fehler_aufrufe_nv "Gesamtzahl der Fehleraufrufe" UBYTE FORMULA_0003 0 0.0 0.0 255.0 READ_WRITE ECU_ADDRESS 0x3F9ABB /end MEASUREMENT
/begin MEASUREMENT ed_fil_lavk2_un_openload.filter_max_nv "Maximaler Fehlerfilterwert" UBYTE FORMULA_0003 0 0.0 0.0 255.0 READ_WRITE ECU_ADDRESS 0x3F9ABA /end MEASUREMENT
/begin MEASUREMENT ed_fil_lavk2_un_openload.filter_nv "Filterwert vor und nach Eintrag" UBYTE FORMULA_0003 0 0.0 0.0 255.0 READ_WRITE ECU_ADDRESS 0x3F9AB6 /end MEASUREMENT
/begin MEASUREMENT ed_fil_lavk2_un_openload.zyklus_filter_nv "Vorwaertsfilter zur Fehlerzustandsbestaetigung" UBYTE FORMULA_0003 0 0.0 0.0 255.0 READ_WRITE ECU_ADDRESS 0x3F9AB7 /end MEASUREMENT
/begin MEASUREMENT ed_fil_lshnk1.art_aktuell_nv "Fehlerart und Statusbits" UWORD FORMULA_0052 0 0.0 0.0 65535.0 READ_WRITE BIT_MASK 0xB4F ECU_ADDRESS 0x3F99E6 /end MEASUREMENT
/begin MEASUREMENT ed_fil_lshnk1.fehler_aufrufe_nv "Gesamtzahl der Fehleraufrufe" UBYTE FORMULA_0003 0 0.0 0.0 255.0 READ_WRITE ECU_ADDRESS 0x3F99E9 /end MEASUREMENT
/begin MEASUREMENT ed_fil_lshnk1.filter_max_nv "Maximaler Fehlerfilterwert" UBYTE FORMULA_0003 0 0.0 0.0 255.0 READ_WRITE ECU_ADDRESS 0x3F99E8 /end MEASUREMENT
/begin MEASUREMENT ed_fil_lshnk1.filter_nv "Filterwert vor und nach Eintrag" UBYTE FORMULA_0003 0 0.0 0.0 255.0 READ_WRITE ECU_ADDRESS 0x3F99E4 /end MEASUREMENT
/begin MEASUREMENT ed_fil_lshnk1.zyklus_filter_nv "Vorwaertsfilter zur Fehlerzustandsbestaetigung" UBYTE FORMULA_0003 0 0.0 0.0 255.0 READ_WRITE ECU_ADDRESS 0x3F99E5 /end MEASUREMENT
/begin MEASUREMENT ed_fil_lshnk1_r.art_aktuell_nv "Fehlerart und Statusbits" UWORD FORMULA_0052 0 0.0 0.0 65535.0 READ_WRITE BIT_MASK 0xB4F ECU_ADDRESS 0x3F9DA6 /end MEASUREMENT
/begin MEASUREMENT ed_fil_lshnk1_r.fehler_aufrufe_nv "Gesamtzahl der Fehleraufrufe" UBYTE FORMULA_0003 0 0.0 0.0 255.0 READ_WRITE ECU_ADDRESS 0x3F9DA9 /end MEASUREMENT
/begin MEASUREMENT ed_fil_lshnk1_r.filter_max_nv "Maximaler Fehlerfilterwert" UBYTE FORMULA_0003 0 0.0 0.0 255.0 READ_WRITE ECU_ADDRESS 0x3F9DA8 /end MEASUREMENT
/begin MEASUREMENT ed_fil_lshnk1_r.filter_nv "Filterwert vor und nach Eintrag" UBYTE FORMULA_0003 0 0.0 0.0 255.0 READ_WRITE ECU_ADDRESS 0x3F9DA4 /end MEASUREMENT
/begin MEASUREMENT ed_fil_lshnk1_r.zyklus_filter_nv "Vorwaertsfilter zur Fehlerzustandsbestaetigung" UBYTE FORMULA_0003 0 0.0 0.0 255.0 READ_WRITE ECU_ADDRESS 0x3F9DA5 /end MEASUREMENT
/begin MEASUREMENT ed_fil_lshnk2.art_aktuell_nv "Fehlerart und Statusbits" UWORD FORMULA_0052 0 0.0 0.0 65535.0 READ_WRITE BIT_MASK 0xB4F ECU_ADDRESS 0x3F99EC /end MEASUREMENT
/begin MEASUREMENT ed_fil_lshnk2.fehler_aufrufe_nv "Gesamtzahl der Fehleraufrufe" UBYTE FORMULA_0003 0 0.0 0.0 255.0 READ_WRITE ECU_ADDRESS 0x3F99EF /end MEASUREMENT
/begin MEASUREMENT ed_fil_lshnk2.filter_max_nv "Maximaler Fehlerfilterwert" UBYTE FORMULA_0003 0 0.0 0.0 255.0 READ_WRITE ECU_ADDRESS 0x3F99EE /end MEASUREMENT
/begin MEASUREMENT ed_fil_lshnk2.filter_nv "Filterwert vor und nach Eintrag" UBYTE FORMULA_0003 0 0.0 0.0 255.0 READ_WRITE ECU_ADDRESS 0x3F99EA /end MEASUREMENT
/begin MEASUREMENT ed_fil_lshnk2.zyklus_filter_nv "Vorwaertsfilter zur Fehlerzustandsbestaetigung" UBYTE FORMULA_0003 0 0.0 0.0 255.0 READ_WRITE ECU_ADDRESS 0x3F99EB /end MEASUREMENT
/begin MEASUREMENT ed_fil_lshnk2_r.art_aktuell_nv "Fehlerart und Statusbits" UWORD FORMULA_0052 0 0.0 0.0 65535.0 READ_WRITE BIT_MASK 0xB4F ECU_ADDRESS 0x3F9DAC /end MEASUREMENT
/begin MEASUREMENT ed_fil_lshnk2_r.fehler_aufrufe_nv "Gesamtzahl der Fehleraufrufe" UBYTE FORMULA_0003 0 0.0 0.0 255.0 READ_WRITE ECU_ADDRESS 0x3F9DAF /end MEASUREMENT
/begin MEASUREMENT ed_fil_lshnk2_r.filter_max_nv "Maximaler Fehlerfilterwert" UBYTE FORMULA_0003 0 0.0 0.0 255.0 READ_WRITE ECU_ADDRESS 0x3F9DAE /end MEASUREMENT
/begin MEASUREMENT ed_fil_lshnk2_r.filter_nv "Filterwert vor und nach Eintrag" UBYTE FORMULA_0003 0 0.0 0.0 255.0 READ_WRITE ECU_ADDRESS 0x3F9DAA /end MEASUREMENT
/begin MEASUREMENT ed_fil_lshnk2_r.zyklus_filter_nv "Vorwaertsfilter zur Fehlerzustandsbestaetigung" UBYTE FORMULA_0003 0 0.0 0.0 255.0 READ_WRITE ECU_ADDRESS 0x3F9DAB /end MEASUREMENT
/begin MEASUREMENT ed_fil_lshvk1.art_aktuell_nv "Fehlerart und Statusbits" UWORD FORMULA_0052 0 0.0 0.0 65535.0 READ_WRITE BIT_MASK 0xB4F ECU_ADDRESS 0x3F9A52 /end MEASUREMENT
/begin MEASUREMENT ed_fil_lshvk1.fehler_aufrufe_nv "Gesamtzahl der Fehleraufrufe" UBYTE FORMULA_0003 0 0.0 0.0 255.0 READ_WRITE ECU_ADDRESS 0x3F9A55 /end MEASUREMENT
/begin MEASUREMENT ed_fil_lshvk1.filter_max_nv "Maximaler Fehlerfilterwert" UBYTE FORMULA_0003 0 0.0 0.0 255.0 READ_WRITE ECU_ADDRESS 0x3F9A54 /end MEASUREMENT
/begin MEASUREMENT ed_fil_lshvk1.filter_nv "Filterwert vor und nach Eintrag" UBYTE FORMULA_0003 0 0.0 0.0 255.0 READ_WRITE ECU_ADDRESS 0x3F9A50 /end MEASUREMENT
/begin MEASUREMENT ed_fil_lshvk1.zyklus_filter_nv "Vorwaertsfilter zur Fehlerzustandsbestaetigung" UBYTE FORMULA_0003 0 0.0 0.0 255.0 READ_WRITE ECU_ADDRESS 0x3F9A51 /end MEASUREMENT
/begin MEASUREMENT ed_fil_lshvk1_r.art_aktuell_nv "Fehlerart und Statusbits" UWORD FORMULA_0052 0 0.0 0.0 65535.0 READ_WRITE BIT_MASK 0xB4F ECU_ADDRESS 0x3F9A6A /end MEASUREMENT
/begin MEASUREMENT ed_fil_lshvk1_r.fehler_aufrufe_nv "Gesamtzahl der Fehleraufrufe" UBYTE FORMULA_0003 0 0.0 0.0 255.0 READ_WRITE ECU_ADDRESS 0x3F9A6D /end MEASUREMENT
/begin MEASUREMENT ed_fil_lshvk1_r.filter_max_nv "Maximaler Fehlerfilterwert" UBYTE FORMULA_0003 0 0.0 0.0 255.0 READ_WRITE ECU_ADDRESS 0x3F9A6C /end MEASUREMENT
/begin MEASUREMENT ed_fil_lshvk1_r.filter_nv "Filterwert vor und nach Eintrag" UBYTE FORMULA_0003 0 0.0 0.0 255.0 READ_WRITE ECU_ADDRESS 0x3F9A68 /end MEASUREMENT
/begin MEASUREMENT ed_fil_lshvk1_r.zyklus_filter_nv "Vorwaertsfilter zur Fehlerzustandsbestaetigung" UBYTE FORMULA_0003 0 0.0 0.0 255.0 READ_WRITE ECU_ADDRESS 0x3F9A69 /end MEASUREMENT
/begin MEASUREMENT ed_fil_lshvk2.art_aktuell_nv "Fehlerart und Statusbits" UWORD FORMULA_0052 0 0.0 0.0 65535.0 READ_WRITE BIT_MASK 0xB4F ECU_ADDRESS 0x3F9A58 /end MEASUREMENT
/begin MEASUREMENT ed_fil_lshvk2.fehler_aufrufe_nv "Gesamtzahl der Fehleraufrufe" UBYTE FORMULA_0003 0 0.0 0.0 255.0 READ_WRITE ECU_ADDRESS 0x3F9A5B /end MEASUREMENT
/begin MEASUREMENT ed_fil_lshvk2.filter_max_nv "Maximaler Fehlerfilterwert" UBYTE FORMULA_0003 0 0.0 0.0 255.0 READ_WRITE ECU_ADDRESS 0x3F9A5A /end MEASUREMENT
/begin MEASUREMENT ed_fil_lshvk2.filter_nv "Filterwert vor und nach Eintrag" UBYTE FORMULA_0003 0 0.0 0.0 255.0 READ_WRITE ECU_ADDRESS 0x3F9A56 /end MEASUREMENT
/begin MEASUREMENT ed_fil_lshvk2.zyklus_filter_nv "Vorwaertsfilter zur Fehlerzustandsbestaetigung" UBYTE FORMULA_0003 0 0.0 0.0 255.0 READ_WRITE ECU_ADDRESS 0x3F9A57 /end MEASUREMENT
/begin MEASUREMENT ed_fil_lshvk2_r.art_aktuell_nv "Fehlerart und Statusbits" UWORD FORMULA_0052 0 0.0 0.0 65535.0 READ_WRITE BIT_MASK 0xB4F ECU_ADDRESS 0x3F9A70 /end MEASUREMENT
/begin MEASUREMENT ed_fil_lshvk2_r.fehler_aufrufe_nv "Gesamtzahl der Fehleraufrufe" UBYTE FORMULA_0003 0 0.0 0.0 255.0 READ_WRITE ECU_ADDRESS 0x3F9A73 /end MEASUREMENT
/begin MEASUREMENT ed_fil_lshvk2_r.filter_max_nv "Maximaler Fehlerfilterwert" UBYTE FORMULA_0003 0 0.0 0.0 255.0 READ_WRITE ECU_ADDRESS 0x3F9A72 /end MEASUREMENT
/begin MEASUREMENT ed_fil_lshvk2_r.filter_nv "Filterwert vor und nach Eintrag" UBYTE FORMULA_0003 0 0.0 0.0 255.0 READ_WRITE ECU_ADDRESS 0x3F9A6E /end MEASUREMENT
/begin MEASUREMENT ed_fil_lshvk2_r.zyklus_filter_nv "Vorwaertsfilter zur Fehlerzustandsbestaetigung" UBYTE FORMULA_0003 0 0.0 0.0 255.0 READ_WRITE ECU_ADDRESS 0x3F9A6F /end MEASUREMENT
/begin MEASUREMENT ed_fil_lsrvk1_obd_ref.art_aktuell_nv "Fehlerart und Statusbits" UWORD FORMULA_0052 0 0.0 0.0 65535.0 READ_WRITE BIT_MASK 0xB4F ECU_ADDRESS 0x3F9A82 /end MEASUREMENT
/begin MEASUREMENT ed_fil_lsrvk1_obd_ref.fehler_aufrufe_nv "Gesamtzahl der Fehleraufrufe" UBYTE FORMULA_0003 0 0.0 0.0 255.0 READ_WRITE ECU_ADDRESS 0x3F9A85 /end MEASUREMENT
/begin MEASUREMENT ed_fil_lsrvk1_obd_ref.filter_max_nv "Maximaler Fehlerfilterwert" UBYTE FORMULA_0003 0 0.0 0.0 255.0 READ_WRITE ECU_ADDRESS 0x3F9A84 /end MEASUREMENT
/begin MEASUREMENT ed_fil_lsrvk1_obd_ref.filter_nv "Filterwert vor und nach Eintrag" UBYTE FORMULA_0003 0 0.0 0.0 255.0 READ_WRITE ECU_ADDRESS 0x3F9A80 /end MEASUREMENT
/begin MEASUREMENT ed_fil_lsrvk1_obd_ref.zyklus_filter_nv "Vorwaertsfilter zur Fehlerzustandsbestaetigung" UBYTE FORMULA_0003 0 0.0 0.0 255.0 READ_WRITE ECU_ADDRESS 0x3F9A81 /end MEASUREMENT
/begin MEASUREMENT ed_fil_lsrvk1_obd_reg.art_aktuell_nv "Fehlerart und Statusbits" UWORD FORMULA_0052 0 0.0 0.0 65535.0 READ_WRITE BIT_MASK 0xB4F ECU_ADDRESS 0x3F9A5E /end MEASUREMENT
/begin MEASUREMENT ed_fil_lsrvk1_obd_reg.fehler_aufrufe_nv "Gesamtzahl der Fehleraufrufe" UBYTE FORMULA_0003 0 0.0 0.0 255.0 READ_WRITE ECU_ADDRESS 0x3F9A61 /end MEASUREMENT
/begin MEASUREMENT ed_fil_lsrvk1_obd_reg.filter_max_nv "Maximaler Fehlerfilterwert" UBYTE FORMULA_0003 0 0.0 0.0 255.0 READ_WRITE ECU_ADDRESS 0x3F9A60 /end MEASUREMENT
/begin MEASUREMENT ed_fil_lsrvk1_obd_reg.filter_nv "Filterwert vor und nach Eintrag" UBYTE FORMULA_0003 0 0.0 0.0 255.0 READ_WRITE ECU_ADDRESS 0x3F9A5C /end MEASUREMENT
/begin MEASUREMENT ed_fil_lsrvk1_obd_reg.zyklus_filter_nv "Vorwaertsfilter zur Fehlerzustandsbestaetigung" UBYTE FORMULA_0003 0 0.0 0.0 255.0 READ_WRITE ECU_ADDRESS 0x3F9A5D /end MEASUREMENT
/begin MEASUREMENT ed_fil_lsrvk1_obd_start.art_aktuell_nv "Fehlerart und Statusbits" UWORD FORMULA_0052 0 0.0 0.0 65535.0 READ_WRITE BIT_MASK 0xB4F ECU_ADDRESS 0x3F9A76 /end MEASUREMENT
/begin MEASUREMENT ed_fil_lsrvk1_obd_start.fehler_aufrufe_nv "Gesamtzahl der Fehleraufrufe" UBYTE FORMULA_0003 0 0.0 0.0 255.0 READ_WRITE ECU_ADDRESS 0x3F9A79 /end MEASUREMENT
/begin MEASUREMENT ed_fil_lsrvk1_obd_start.filter_max_nv "Maximaler Fehlerfilterwert" UBYTE FORMULA_0003 0 0.0 0.0 255.0 READ_WRITE ECU_ADDRESS 0x3F9A78 /end MEASUREMENT
/begin MEASUREMENT ed_fil_lsrvk1_obd_start.filter_nv "Filterwert vor und nach Eintrag" UBYTE FORMULA_0003 0 0.0 0.0 255.0 READ_WRITE ECU_ADDRESS 0x3F9A74 /end MEASUREMENT
/begin MEASUREMENT ed_fil_lsrvk1_obd_start.zyklus_filter_nv "Vorwaertsfilter zur Fehlerzustandsbestaetigung" UBYTE FORMULA_0003 0 0.0 0.0 255.0 READ_WRITE ECU_ADDRESS 0x3F9A75 /end MEASUREMENT
/begin MEASUREMENT ed_fil_lsrvk2_obd_ref.art_aktuell_nv "Fehlerart und Statusbits" UWORD FORMULA_0052 0 0.0 0.0 65535.0 READ_WRITE BIT_MASK 0xB4F ECU_ADDRESS 0x3F9A88 /end MEASUREMENT
/begin MEASUREMENT ed_fil_lsrvk2_obd_ref.fehler_aufrufe_nv "Gesamtzahl der Fehleraufrufe" UBYTE FORMULA_0003 0 0.0 0.0 255.0 READ_WRITE ECU_ADDRESS 0x3F9A8B /end MEASUREMENT
/begin MEASUREMENT ed_fil_lsrvk2_obd_ref.filter_max_nv "Maximaler Fehlerfilterwert" UBYTE FORMULA_0003 0 0.0 0.0 255.0 READ_WRITE ECU_ADDRESS 0x3F9A8A /end MEASUREMENT
/begin MEASUREMENT ed_fil_lsrvk2_obd_ref.filter_nv "Filterwert vor und nach Eintrag" UBYTE FORMULA_0003 0 0.0 0.0 255.0 READ_WRITE ECU_ADDRESS 0x3F9A86 /end MEASUREMENT
/begin MEASUREMENT ed_fil_lsrvk2_obd_ref.zyklus_filter_nv "Vorwaertsfilter zur Fehlerzustandsbestaetigung" UBYTE FORMULA_0003 0 0.0 0.0 255.0 READ_WRITE ECU_ADDRESS 0x3F9A87 /end MEASUREMENT
/begin MEASUREMENT ed_fil_lsrvk2_obd_reg.art_aktuell_nv "Fehlerart und Statusbits" UWORD FORMULA_0052 0 0.0 0.0 65535.0 READ_WRITE BIT_MASK 0xB4F ECU_ADDRESS 0x3F9A64 /end MEASUREMENT
/begin MEASUREMENT ed_fil_lsrvk2_obd_reg.fehler_aufrufe_nv "Gesamtzahl der Fehleraufrufe" UBYTE FORMULA_0003 0 0.0 0.0 255.0 READ_WRITE ECU_ADDRESS 0x3F9A67 /end MEASUREMENT
/begin MEASUREMENT ed_fil_lsrvk2_obd_reg.filter_max_nv "Maximaler Fehlerfilterwert" UBYTE FORMULA_0003 0 0.0 0.0 255.0 READ_WRITE ECU_ADDRESS 0x3F9A66 /end MEASUREMENT
/begin MEASUREMENT ed_fil_lsrvk2_obd_reg.filter_nv "Filterwert vor und nach Eintrag" UBYTE FORMULA_0003 0 0.0 0.0 255.0 READ_WRITE ECU_ADDRESS 0x3F9A62 /end MEASUREMENT
/begin MEASUREMENT ed_fil_lsrvk2_obd_reg.zyklus_filter_nv "Vorwaertsfilter zur Fehlerzustandsbestaetigung" UBYTE FORMULA_0003 0 0.0 0.0 255.0 READ_WRITE ECU_ADDRESS 0x3F9A63 /end MEASUREMENT
/begin MEASUREMENT ed_fil_lsrvk2_obd_start.art_aktuell_nv "Fehlerart und Statusbits" UWORD FORMULA_0052 0 0.0 0.0 65535.0 READ_WRITE BIT_MASK 0xB4F ECU_ADDRESS 0x3F9A7C /end MEASUREMENT
/begin MEASUREMENT ed_fil_lsrvk2_obd_start.fehler_aufrufe_nv "Gesamtzahl der Fehleraufrufe" UBYTE FORMULA_0003 0 0.0 0.0 255.0 READ_WRITE ECU_ADDRESS 0x3F9A7F /end MEASUREMENT
/begin MEASUREMENT ed_fil_lsrvk2_obd_start.filter_max_nv "Maximaler Fehlerfilterwert" UBYTE FORMULA_0003 0 0.0 0.0 255.0 READ_WRITE ECU_ADDRESS 0x3F9A7E /end MEASUREMENT
/begin MEASUREMENT ed_fil_lsrvk2_obd_start.filter_nv "Filterwert vor und nach Eintrag" UBYTE FORMULA_0003 0 0.0 0.0 255.0 READ_WRITE ECU_ADDRESS 0x3F9A7A /end MEASUREMENT
/begin MEASUREMENT ed_fil_lsrvk2_obd_start.zyklus_filter_nv "Vorwaertsfilter zur Fehlerzustandsbestaetigung" UBYTE FORMULA_0003 0 0.0 0.0 255.0 READ_WRITE ECU_ADDRESS 0x3F9A7B /end MEASUREMENT
/begin MEASUREMENT ed_fil_mvac_drucksensor.art_aktuell_nv "Fehlerart und Statusbits" UWORD FORMULA_0052 0 0.0 0.0 65535.0 READ_WRITE BIT_MASK 0xB4F ECU_ADDRESS 0x3F9C56 /end MEASUREMENT
/begin MEASUREMENT ed_fil_mvac_drucksensor.fehler_aufrufe_nv "Gesamtzahl der Fehleraufrufe" UBYTE FORMULA_0003 0 0.0 0.0 255.0 READ_WRITE ECU_ADDRESS 0x3F9C59 /end MEASUREMENT
/begin MEASUREMENT ed_fil_mvac_drucksensor.filter_max_nv "Maximaler Fehlerfilterwert" UBYTE FORMULA_0003 0 0.0 0.0 255.0 READ_WRITE ECU_ADDRESS 0x3F9C58 /end MEASUREMENT
/begin MEASUREMENT ed_fil_mvac_drucksensor.filter_nv "Filterwert vor und nach Eintrag" UBYTE FORMULA_0003 0 0.0 0.0 255.0 READ_WRITE ECU_ADDRESS 0x3F9C54 /end MEASUREMENT
/begin MEASUREMENT ed_fil_mvac_drucksensor.zyklus_filter_nv "Vorwaertsfilter zur Fehlerzustandsbestaetigung" UBYTE FORMULA_0003 0 0.0 0.0 255.0 READ_WRITE ECU_ADDRESS 0x3F9C55 /end MEASUREMENT
/begin MEASUREMENT ed_fil_nw_sync.art_aktuell_nv "Fehlerart und Statusbits" UWORD FORMULA_0052 0 0.0 0.0 65535.0 READ_WRITE BIT_MASK 0xB4F ECU_ADDRESS 0x3F9992 /end MEASUREMENT
/begin MEASUREMENT ed_fil_nw_sync.fehler_aufrufe_nv "Gesamtzahl der Fehleraufrufe" UBYTE FORMULA_0003 0 0.0 0.0 255.0 READ_WRITE ECU_ADDRESS 0x3F9995 /end MEASUREMENT
/begin MEASUREMENT ed_fil_nw_sync.filter_max_nv "Maximaler Fehlerfilterwert" UBYTE FORMULA_0003 0 0.0 0.0 255.0 READ_WRITE ECU_ADDRESS 0x3F9994 /end MEASUREMENT
/begin MEASUREMENT ed_fil_nw_sync.filter_nv "Filterwert vor und nach Eintrag" UBYTE FORMULA_0003 0 0.0 0.0 255.0 READ_WRITE ECU_ADDRESS 0x3F9990 /end MEASUREMENT
/begin MEASUREMENT ed_fil_nw_sync.zyklus_filter_nv "Vorwaertsfilter zur Fehlerzustandsbestaetigung" UBYTE FORMULA_0003 0 0.0 0.0 255.0 READ_WRITE ECU_ADDRESS 0x3F9991 /end MEASUREMENT
/begin MEASUREMENT ed_fil_pctrl_inj.art_aktuell_nv "Fehlerart und Statusbits" UWORD FORMULA_0052 0 0.0 0.0 65535.0 READ_WRITE BIT_MASK 0xB4F ECU_ADDRESS 0x3F999E /end MEASUREMENT
/begin MEASUREMENT ed_fil_pctrl_inj.fehler_aufrufe_nv "Gesamtzahl der Fehleraufrufe" UBYTE FORMULA_0003 0 0.0 0.0 255.0 READ_WRITE ECU_ADDRESS 0x3F99A1 /end MEASUREMENT
/begin MEASUREMENT ed_fil_pctrl_inj.filter_max_nv "Maximaler Fehlerfilterwert" UBYTE FORMULA_0003 0 0.0 0.0 255.0 READ_WRITE ECU_ADDRESS 0x3F99A0 /end MEASUREMENT
/begin MEASUREMENT ed_fil_pctrl_inj.filter_nv "Filterwert vor und nach Eintrag" UBYTE FORMULA_0003 0 0.0 0.0 255.0 READ_WRITE ECU_ADDRESS 0x3F999C /end MEASUREMENT
/begin MEASUREMENT ed_fil_pctrl_inj.zyklus_filter_nv "Vorwaertsfilter zur Fehlerzustandsbestaetigung" UBYTE FORMULA_0003 0 0.0 0.0 255.0 READ_WRITE ECU_ADDRESS 0x3F999D /end MEASUREMENT
/begin MEASUREMENT ed_fil_pks.art_aktuell_nv "Fehlerart und Statusbits" UWORD FORMULA_0052 0 0.0 0.0 65535.0 READ_WRITE BIT_MASK 0xB4F ECU_ADDRESS 0x3F99AA /end MEASUREMENT
/begin MEASUREMENT ed_fil_pks.fehler_aufrufe_nv "Gesamtzahl der Fehleraufrufe" UBYTE FORMULA_0003 0 0.0 0.0 255.0 READ_WRITE ECU_ADDRESS 0x3F99AD /end MEASUREMENT
/begin MEASUREMENT ed_fil_pks.filter_max_nv "Maximaler Fehlerfilterwert" UBYTE FORMULA_0003 0 0.0 0.0 255.0 READ_WRITE ECU_ADDRESS 0x3F99AC /end MEASUREMENT
/begin MEASUREMENT ed_fil_pks.filter_nv "Filterwert vor und nach Eintrag" UBYTE FORMULA_0003 0 0.0 0.0 255.0 READ_WRITE ECU_ADDRESS 0x3F99A8 /end MEASUREMENT
/begin MEASUREMENT ed_fil_pks.zyklus_filter_nv "Vorwaertsfilter zur Fehlerzustandsbestaetigung" UBYTE FORMULA_0003 0 0.0 0.0 255.0 READ_WRITE ECU_ADDRESS 0x3F99A9 /end MEASUREMENT
/begin MEASUREMENT ed_fil_pks_adapt_anschl.art_aktuell_nv "Fehlerart und Statusbits" UWORD FORMULA_0052 0 0.0 0.0 65535.0 READ_WRITE BIT_MASK 0xB4F ECU_ADDRESS 0x3F9DBE /end MEASUREMENT
/begin MEASUREMENT ed_fil_pks_adapt_anschl.fehler_aufrufe_nv "Gesamtzahl der Fehleraufrufe" UBYTE FORMULA_0003 0 0.0 0.0 255.0 READ_WRITE ECU_ADDRESS 0x3F9DC1 /end MEASUREMENT
/begin MEASUREMENT ed_fil_pks_adapt_anschl.filter_max_nv "Maximaler Fehlerfilterwert" UBYTE FORMULA_0003 0 0.0 0.0 255.0 READ_WRITE ECU_ADDRESS 0x3F9DC0 /end MEASUREMENT
/begin MEASUREMENT ed_fil_pks_adapt_anschl.filter_nv "Filterwert vor und nach Eintrag" UBYTE FORMULA_0003 0 0.0 0.0 255.0 READ_WRITE ECU_ADDRESS 0x3F9DBC /end MEASUREMENT
/begin MEASUREMENT ed_fil_pks_adapt_anschl.zyklus_filter_nv "Vorwaertsfilter zur Fehlerzustandsbestaetigung" UBYTE FORMULA_0003 0 0.0 0.0 255.0 READ_WRITE ECU_ADDRESS 0x3F9DBD /end MEASUREMENT
/begin MEASUREMENT ed_fil_pks_ll.art_aktuell_nv "Fehlerart und Statusbits" UWORD FORMULA_0052 0 0.0 0.0 65535.0 READ_WRITE BIT_MASK 0xB4F ECU_ADDRESS 0x3F9C02 /end MEASUREMENT
/begin MEASUREMENT ed_fil_pks_ll.fehler_aufrufe_nv "Gesamtzahl der Fehleraufrufe" UBYTE FORMULA_0003 0 0.0 0.0 255.0 READ_WRITE ECU_ADDRESS 0x3F9C05 /end MEASUREMENT
/begin MEASUREMENT eeprom_seite_lesen "Wo wurde der letzte Datensatz gefunden" UBYTE FORMULA_0077 0 0.0 0.0 255.0 READ_WRITE ECU_ADDRESS 0x3FBEB4 /end MEASUREMENT
/begin MEASUREMENT eeprom_seite_lesen_hdw "Wo wurde der letzte HDW-Datensatz gefunden" UBYTE FORMULA_0077 0 0.0 0.0 255.0 READ_WRITE ECU_ADDRESS 0x3FBEB5 /end MEASUREMENT
/begin MEASUREMENT eeprom_seite_schreiben "Wo hin soll der naechste Datensatz geschrieben werden" UBYTE FORMULA_0078 0 0.0 0.0 255.0 READ_WRITE ECU_ADDRESS 0x3FBEB6 /end MEASUREMENT
/begin MEASUREMENT eeprom_st "Status der EEPROM-Emulation" UBYTE FORMULA_0079 0 0.0 0.0 255.0 READ_WRITE ECU_ADDRESS 0x3FBEB7 /end MEASUREMENT
/begin MEASUREMENT fst_can_fehler "Dauer CAN-Fehlerkennzeichnung" UWORD FORMULA_0593 0 0.0 0.0 65535.0 READ_WRITE ECU_ADDRESS 0x3FBF58 /end MEASUREMENT
/begin MEASUREMENT fst_kva_old "letzter Stand Kraftstoffverbrauch" UBYTE FORMULA_0710 0 0.0 0.0 65.27999877929688 READ_WRITE ECU_ADDRESS 0x3FBF5A /end MEASUREMENT
/begin MEASUREMENT fst_links "gefilterter Geberwert links" UBYTE FORMULA_0559 0 0.0 0.0 127.5 READ_WRITE ECU_ADDRESS 0x3FBF5B /end MEASUREMENT
/begin MEASUREMENT fst_links.rest "Filter Rest Geberwert links" UBYTE FORMULA_0560 0 0.0 0.0 0.4979999959468842 READ_WRITE ECU_ADDRESS 0x3FBF5C /end MEASUREMENT
/begin MEASUREMENT fst_st "Status Tankfuellstand" UBYTE FORMULA_0714 0 0.0 0.0 255.0 READ_WRITE BIT_MASK 0xF ECU_ADDRESS 0x3FBF5D /end MEASUREMENT
/begin MEASUREMENT fst_tank_leer_st_ign "Fehlerstatus Tank leer Fehler" ULONG FORMULA_0044 0 0.0 0.0 4294967295.0 READ_WRITE ECU_ADDRESS 0x3FBF64 /end MEASUREMENT
/begin MEASUREMENT fst_tank_leer_st_inj "Fehlerstatus Tank leer Fehler" ULONG FORMULA_0044 0 0.0 0.0 4294967295.0 READ_WRITE ECU_ADDRESS 0x3FBF60 /end MEASUREMENT
/begin MEASUREMENT n_begr_fetrawe "Drehzahlbegrenzung bei FeTraWe" SWORD FORMULA_0006 0 0.0 0.0 10000.0 READ_WRITE ECU_ADDRESS 0x3FC8AA /end MEASUREMENT
/begin MEASUREMENT n_begr_fzg_steht "Drehzahlbegrenzung bei stehendem Fzg" SWORD FORMULA_0006 0 0.0 0.0 10000.0 READ_WRITE ECU_ADDRESS 0x3FC8AE /end MEASUREMENT
/begin MEASUREMENT n_begr_sk "SK-Drehzahlbegrenzung" SWORD FORMULA_0006 0 0.0 0.0 10000.0 READ_WRITE ECU_ADDRESS 0x3FC89C /end MEASUREMENT
/begin MEASUREMENT n_begr_status "Gewinner der MIN-Auswahl" UWORD FORMULA_0996 0 0.0 0.0 65535.0 READ_WRITE ECU_ADDRESS 0x3FC8B2 /end MEASUREMENT
/begin MEASUREMENT n_begr_tgetr_heiss "aenderungsbegr. Drehzahlbegrenzung bei heissem Tgetr" SWORD FORMULA_0006 0 0.0 0.0 10000.0 READ_WRITE ECU_ADDRESS 0x3FC8A6 /end MEASUREMENT
/begin MEASUREMENT n_begr_tgetr_heiss_cnt "Zaehler, um Aenderungsbegrenzung auf 100ms umzustellen" UBYTE FORMULA_0003 0 0.0 0.0 255.0 READ_WRITE ECU_ADDRESS 0x3FC8A8 /end MEASUREMENT
/begin MEASUREMENT n_begr_tgetr_heiss_neu "Drehzahlbegrenzung bei heissem Tgetr" SWORD FORMULA_0006 0 0.0 0.0 10000.0 READ_WRITE ECU_ADDRESS 0x3FC8A4 /end MEASUREMENT
/begin MEASUREMENT n_begr_ti "Drehzahlbegrenzung ueber Einspritzausblendung" SWORD FORMULA_0006 0 0.0 0.0 10000.0 READ_WRITE ECU_ADDRESS 0x3FC89A /end MEASUREMENT
/begin MEASUREMENT n_begr_time "Verweildauer ueber n_begr_egas" ULONG FORMULA_0147 0 0.0 0.0 36000.0 READ_WRITE ECU_ADDRESS 0x3FC8B4 /end MEASUREMENT
/begin MEASUREMENT n_begr_tmot_heiss "Drehzahlbegrenzung bei heissem Tmot" SWORD FORMULA_0006 0 0.0 0.0 10000.0 READ_WRITE ECU_ADDRESS 0x3FC8A2 /end MEASUREMENT
/begin MEASUREMENT n_begr_toel_heiss "Drehzahlbegrenzung bei heissem Oel" SWORD FORMULA_0006 0 0.0 0.0 10000.0 READ_WRITE ECU_ADDRESS 0x3FC8A0 /end MEASUREMENT
/begin MEASUREMENT n_begr_toel_kalt "Drehzahlbegrenzung bei kaltem Oel" SWORD FORMULA_0006 0 0.0 0.0 10000.0 READ_WRITE ECU_ADDRESS 0x3FC89E /end MEASUREMENT
/begin MEASUREMENT n_begr_tz_err "Drehzahlbegrenzung fuer Zuendspulenschutz" SWORD FORMULA_0006 0 0.0 0.0 10000.0 READ_WRITE ECU_ADDRESS 0x3FC8B0 /end MEASUREMENT
/begin MEASUREMENT n_begr_v_fehler "Drehzahlbegrenzung bei v-Fehler" SWORD FORMULA_0006 0 0.0 0.0 10000.0 READ_WRITE ECU_ADDRESS 0x3FC8AC /end MEASUREMENT
/begin MEASUREMENT n_dyn_filter "gefilterte Drehzahl fuer Dynamikerkennung" SWORD FORMULA_0006 0 0.0 0.0 10000.0 READ_WRITE ECU_ADDRESS 0x3FC872 /end MEASUREMENT
/begin MEASUREMENT n_dyn_timer "Aktuelle Sperrzeit fuer Ruecknahme N-Dynamik" UWORD FORMULA_0021 0 0.0 0.0 655.0 READ_WRITE ECU_ADDRESS 0x3FC870 /end MEASUREMENT
/begin MEASUREMENT n_grad_buf_0 "History Drehzahlgradient." SWORD FORMULA_0006 0 0.0 0.0 10000.0 READ_WRITE ECU_ADDRESS 0x3FC874 /end MEASUREMENT
/begin MEASUREMENT n_grad_buf_1 "History Drehzahlgradient." SWORD FORMULA_0006 0 0.0 0.0 10000.0 READ_WRITE ECU_ADDRESS 0x3FC876 /end MEASUREMENT
/begin MEASUREMENT n_grad_buf_2 "History Drehzahlgradient." SWORD FORMULA_0006 0 0.0 0.0 10000.0 READ_WRITE ECU_ADDRESS 0x3FC878 /end MEASUREMENT
/begin MEASUREMENT n_grad_buf_3 "History Drehzahlgradient." SWORD FORMULA_0006 0 0.0 0.0 10000.0 READ_WRITE ECU_ADDRESS 0x3FC87A /end MEASUREMENT
/begin MEASUREMENT n_grad_buf_4 "History Drehzahlgradient." SWORD FORMULA_0006 0 0.0 0.0 10000.0 READ_WRITE ECU_ADDRESS 0x3FC87C /end MEASUREMENT
/begin MEASUREMENT n_grad_buf_5 "History Drehzahlgradient." SWORD FORMULA_0006 0 0.0 0.0 10000.0 READ_WRITE ECU_ADDRESS 0x3FC87E /end MEASUREMENT
/begin MEASUREMENT n_grad_buf_6 "History Drehzahlgradient." SWORD FORMULA_0006 0 0.0 0.0 10000.0 READ_WRITE ECU_ADDRESS 0x3FC880 /end MEASUREMENT
/begin MEASUREMENT n_grad_buf_7 "History Drehzahlgradient." SWORD FORMULA_0006 0 0.0 0.0 10000.0 READ_WRITE ECU_ADDRESS 0x3FC882 /end MEASUREMENT
/begin MEASUREMENT n_grad_buf_8 "History Drehzahlgradient." SWORD FORMULA_0006 0 0.0 0.0 10000.0 READ_WRITE ECU_ADDRESS 0x3FC884 /end MEASUREMENT
/begin MEASUREMENT n_grad_buf_9 "History Drehzahlgradient." SWORD FORMULA_0006 0 0.0 0.0 10000.0 READ_WRITE ECU_ADDRESS 0x3FC886 /end MEASUREMENT
/begin MEASUREMENT n_max_err_e2 "nmax-Fehlerzaehler Ebene 2" UBYTE FORMULA_0003 0 0.0 0.0 255.0 READ_WRITE ECU_ADDRESS 0x3FD5DE /end MEASUREMENT
/begin MEASUREMENT n_max_ff_flag "Steuerflag fuer nmax Freeze Frame" UBYTE FORMULA_0997 0 0.0 0.0 255.0 READ_WRITE ECU_ADDRESS 0x3FC8B8 /end MEASUREMENT
/begin MEASUREMENT n_proz "Ersatzdrehzahl des jeweiligen Prozessors." SWORD FORMULA_0006 0 0.0 0.0 10000.0 READ_WRITE ECU_ADDRESS 0x3FC858 /end MEASUREMENT
/begin MEASUREMENT n_segm_a "Drehzahl aus Segmentabstand." SWORD FORMULA_0006 0 0.0 0.0 10000.0 READ_WRITE ECU_ADDRESS 0x3FC85E /end MEASUREMENT
/begin MEASUREMENT n_segm_b "Drehzahl aus Segmentabstand." SWORD FORMULA_0006 0 0.0 0.0 10000.0 READ_WRITE ECU_ADDRESS 0x3FC860 /end MEASUREMENT
/begin MEASUREMENT n_st_a "Status Drehzahlerfassung" UBYTE FORMULA_0353 0 0.0 0.0 255.0 READ_WRITE ECU_ADDRESS 0x3FC854 /end MEASUREMENT
/begin MEASUREMENT n_st_b "Status Drehzahlerfassung" UBYTE FORMULA_0353 0 0.0 0.0 255.0 READ_WRITE ECU_ADDRESS 0x3FC855 /end MEASUREMENT
/begin MEASUREMENT n_t_segm_a "Segmentzeit." UWORD FORMULA_0354 0 0.0 0.0 104.8560028076172 READ_WRITE ECU_ADDRESS 0x3FC862 /end MEASUREMENT
/begin MEASUREMENT n_t_segm_b "Segmentzeit." UWORD FORMULA_0354 0 0.0 0.0 104.8560028076172 READ_WRITE ECU_ADDRESS 0x3FC864 /end MEASUREMENT
/begin MEASUREMENT n_t_segm_start_a "Segmentstartzeit." ULONG FORMULA_0017 0 0.0 0.0 2396.745 READ_WRITE ECU_ADDRESS 0x3FC868 /end MEASUREMENT
/begin MEASUREMENT n_t_segm_start_b "Segmentstartzeit." ULONG FORMULA_0017 0 0.0 0.0 2396.745 READ_WRITE ECU_ADDRESS 0x3FC86C /end MEASUREMENT
/begin MEASUREMENT n_timer_stoerung_a "Zeitzaehler fuer Freeze Drehzahlerfassung" SBYTE FORMULA_0306 0 0.0 -1.279999971389771 1.269999980926514 READ_WRITE ECU_ADDRESS 0x3FC856 /end MEASUREMENT
/begin MEASUREMENT n_timer_stoerung_b "Zeitzaehler fuer Freeze Drehzahlerfassung" SBYTE FORMULA_0306 0 0.0 -1.279999971389771 1.269999980926514 READ_WRITE ECU_ADDRESS 0x3FC857 /end MEASUREMENT
/begin MEASUREMENT n_zahn_a "Drehzahl aus Zahnabstand" SWORD FORMULA_0006 0 0.0 0.0 10000.0 READ_WRITE ECU_ADDRESS 0x3FC85A /end MEASUREMENT
/begin MEASUREMENT n_zahn_b "Drehzahl aus Zahnabstand" SWORD FORMULA_0006 0 0.0 0.0 10000.0 READ_WRITE ECU_ADDRESS 0x3FC85C /end MEASUREMENT
/begin COMPU_METHOD FORMULA_0003 "FORMULA_0003" RAT_FUNC "%3.0" "-" COEFFS 0 1 0 0 0 1 /end COMPU_METHOD
/begin COMPU_METHOD FORMULA_0006 "FORMULA_0006" RAT_FUNC "%5.0" "Upm" COEFFS 0 1 0 0 0 1 /end COMPU_METHOD
/begin COMPU_METHOD FORMULA_0008 "FORMULA_0008" RAT_FUNC "%6.1" "V" COEFFS 0 10.0 0.0 0 0.0 1.0 /end COMPU_METHOD
/begin COMPU_METHOD FORMULA_0010 "FORMULA_0010" RAT_FUNC "%5.0" "-" COEFFS 0 1 0 0 0 1 /end COMPU_METHOD
/begin COMPU_METHOD FORMULA_0017 "FORMULA_0017" RAT_FUNC "%9.2" "ms" COEFFS 0 7000.0 0.0 0 0.0 1.0 /end COMPU_METHOD
/begin COMPU_METHOD FORMULA_0021 "FORMULA_0021" RAT_FUNC "%7.2" "s" COEFFS 0 100.0 0.0 0 0.0 1.0 /end COMPU_METHOD
/begin COMPU_METHOD FORMULA_0023 "FORMULA_0023" RAT_FUNC "%6.1" "°C" COEFFS 0 10.0 2732.0 0 0.0 1.0 /end COMPU_METHOD
/begin COMPU_METHOD FORMULA_0037 "FORMULA_0037" RAT_FUNC "%5.2" "-" COEFFS 0 1 0 0 0 1 /end COMPU_METHOD
/begin COMPU_METHOD FORMULA_0044 "FORMULA_0044" RAT_FUNC "%9.2" "-" COEFFS 0 1 0 0 0 1 /end COMPU_METHOD
/begin COMPU_METHOD FORMULA_0052 "FORMULA_0052" TAB_VERB "%7.2" "-" COMPU_TAB_REF FORMULA_0052_VTAB /end COMPU_METHOD
/begin COMPU_METHOD FORMULA_0071 "FORMULA_0071" RAT_FUNC "%6.1" "s" COEFFS 0 10.0 0.0 0 0.0 1.0 /end COMPU_METHOD
/begin COMPU_METHOD FORMULA_0072 "FORMULA_0072" RAT_FUNC "%7.0" "us" COEFFS 0 1 0 0 0 1 /end COMPU_METHOD
/begin COMPU_METHOD FORMULA_0074 "FORMULA_0074" RAT_FUNC "%6.1" "Kelvin" COEFFS 0 10.0 0.0 0 0.0 1.0 /end COMPU_METHOD
/begin COMPU_METHOD FORMULA_0076 "FORMULA_0076" RAT_FUNC "%6.1" "km/h" COEFFS 0 16.0 0.0 0 0.0 1.0 /end COMPU_METHOD
/begin COMPU_METHOD FORMULA_0077 "FORMULA_0077" TAB_VERB "%3.0" "Seite" COMPU_TAB_REF FORMULA_0077_VTAB /end COMPU_METHOD
/begin COMPU_METHOD FORMULA_0078 "FORMULA_0078" TAB_VERB "%3.0" "Seite" COMPU_TAB_REF FORMULA_0078_VTAB /end COMPU_METHOD
/begin COMPU_METHOD FORMULA_0079 "FORMULA_0079" TAB_VERB "%3.0" "-" COMPU_TAB_REF FORMULA_0079_VTAB /end COMPU_METHOD
/begin COMPU_METHOD FORMULA_0105 "FORMULA_0105" RAT_FUNC "%5.0" "Upm/s" COEFFS 0 1 0 0 0 1 /end COMPU_METHOD
/begin COMPU_METHOD FORMULA_0109 "FORMULA_0109" RAT_FUNC "%7.2" "s" COEFFS 0 200.0 0.0 0 0.0 1.0 /end COMPU_METHOD
/begin COMPU_METHOD FORMULA_0123 "FORMULA_0123" RAT_FUNC "%7.2" "m/(s*s)" COEFFS 0 40.0 0.0 0 0.0 1.0 /end COMPU_METHOD
/begin COMPU_METHOD FORMULA_0147 "FORMULA_0147" RAT_FUNC "%9.2" "s" COEFFS 0 100.0 0.0 0 0.0 1.0 /end COMPU_METHOD
/begin COMPU_METHOD FORMULA_0166 "FORMULA_0166" RAT_FUNC "%3.0" "Upm" COEFFS 0 2.e-002 0.0 0 0.0 1.0 /end COMPU_METHOD
/begin COMPU_METHOD FORMULA_0204 "FORMULA_0204" TAB_VERB "%5.2" "-" COMPU_TAB_REF FORMULA_0204_VTAB /end COMPU_METHOD
/begin COMPU_METHOD FORMULA_0206 "FORMULA_0206" TAB_VERB "%5.2" "-" COMPU_TAB_REF FORMULA_0206_VTAB /end COMPU_METHOD
/begin COMPU_METHOD FORMULA_0207 "FORMULA_0207" TAB_VERB "%5.2" "-" COMPU_TAB_REF FORMULA_0207_VTAB /end COMPU_METHOD
/begin COMPU_METHOD FORMULA_0209 "FORMULA_0209" TAB_VERB "%5.2" "-" COMPU_TAB_REF FORMULA_0209_VTAB /end COMPU_METHOD
/begin COMPU_METHOD FORMULA_0306 "FORMULA_0306" RAT_FUNC "%5.2" "s" COEFFS 0 100.0 0.0 0 0.0 1.0 /end COMPU_METHOD
/begin COMPU_METHOD FORMULA_0353 "FORMULA_0353" TAB_VERB "%3.0" "-" COMPU_TAB_REF FORMULA_0353_VTAB /end COMPU_METHOD
/begin COMPU_METHOD FORMULA_0354 "FORMULA_0354" RAT_FUNC "%7.2" "ms" COEFFS 0 625.0 0.0 0 0.0 1.0 /end COMPU_METHOD
/begin COMPU_METHOD FORMULA_0461 "FORMULA_0461" RAT_FUNC "%4.1" "s" COEFFS 0 10.0 0.0 0 0.0 1.0 /end COMPU_METHOD
/begin COMPU_METHOD FORMULA_0559 "FORMULA_0559" RAT_FUNC "%4.1" "l" COEFFS 0 2.0 0.0 0 0.0 1.0 /end COMPU_METHOD
/begin COMPU_METHOD FORMULA_0560 "FORMULA_0560" RAT_FUNC "%6.3" "l" COEFFS 0 512.0 0.0 0 0.0 1.0 /end COMPU_METHOD
/begin COMPU_METHOD FORMULA_0593 "FORMULA_0593" RAT_FUNC "%5.0" "s" COEFFS 0 1 0 0 0 1 /end COMPU_METHOD
/begin COMPU_METHOD FORMULA_0613 "FORMULA_0613" RAT_FUNC "%5.0" "km" COEFFS 0 1 0 0 0 1 /end COMPU_METHOD
/begin COMPU_METHOD FORMULA_0629 "FORMULA_0629" TAB_VERB "%5.2" "-" COMPU_TAB_REF FORMULA_0629_VTAB /end COMPU_METHOD
/begin COMPU_METHOD FORMULA_0653 "FORMULA_0653" TAB_VERB "%3.0" "-" COMPU_TAB_REF FORMULA_0653_VTAB /end COMPU_METHOD
/begin COMPU_METHOD FORMULA_0654 "FORMULA_0654" TAB_VERB "%3.0" "-" COMPU_TAB_REF FORMULA_0654_VTAB /end COMPU_METHOD
/begin COMPU_METHOD FORMULA_0655 "FORMULA_0655" TAB_VERB "%3.0" "-" COMPU_TAB_REF FORMULA_0655_VTAB /end COMPU_METHOD
/begin COMPU_METHOD FORMULA_0656 "FORMULA_0656" RAT_FUNC "%3.0" "Segmente" COEFFS 0 1 0 0 0 1 /end COMPU_METHOD
/begin COMPU_METHOD FORMULA_0657 "FORMULA_0657" RAT_FUNC "%5.2" "Upm" COEFFS 0 2.e-002 0.0 0 0.0 1.0 /end COMPU_METHOD
/begin COMPU_METHOD FORMULA_0658 "FORMULA_0658" RAT_FUNC "%5.2" "s" COEFFS 0 0 2.56 0 1 0 /end COMPU_METHOD
/begin COMPU_METHOD FORMULA_0659 "FORMULA_0659" RAT_FUNC "%6.3" "-" COEFFS 0 256.0 0.0 0 0.0 1.0 /end COMPU_METHOD
/begin COMPU_METHOD FORMULA_0660 "FORMULA_0660" RAT_FUNC "%5.0" ".Gang" COEFFS 0 1 0 0 0 1 /end COMPU_METHOD
/begin COMPU_METHOD FORMULA_0661 "FORMULA_0661" TAB_VERB "%3.0" "-" COMPU_TAB_REF FORMULA_0661_VTAB /end COMPU_METHOD
/begin COMPU_METHOD FORMULA_0663 "FORMULA_0663" TAB_VERB "%5.2" "-" COMPU_TAB_REF FORMULA_0663_VTAB /end COMPU_METHOD
/begin COMPU_METHOD FORMULA_0710 "FORMULA_0710" RAT_FUNC "%4.1" "ml" COEFFS 0 3.90625 0.0 0 0.0 1.0 /end COMPU_METHOD
/begin COMPU_METHOD FORMULA_0711 "FORMULA_0711" TAB_VERB "%5.2" "-" COMPU_TAB_REF FORMULA_0711_VTAB /end COMPU_METHOD
/begin COMPU_METHOD FORMULA_0712 "FORMULA_0712" TAB_VERB "%5.2" "-" COMPU_TAB_REF FORMULA_0712_VTAB /end COMPU_METHOD
/begin COMPU_METHOD FORMULA_0713 "FORMULA_0713" TAB_VERB "%5.2" "-" COMPU_TAB_REF FORMULA_0713_VTAB /end COMPU_METHOD
/begin COMPU_METHOD FORMULA_0714 "FORMULA_0714" TAB_VERB "%5.2" "-" COMPU_TAB_REF FORMULA_0714_VTAB /end COMPU_METHOD
/begin COMPU_METHOD FORMULA_0715 "FORMULA_0715" RAT_FUNC "%5.2" "s" COEFFS 0 0 256 0 1 0 /end COMPU_METHOD
/begin COMPU_METHOD FORMULA_0996 "FORMULA_0996" TAB_VERB "%7.2" "-" COMPU_TAB_REF FORMULA_0996_VTAB /end COMPU_METHOD
/begin COMPU_METHOD FORMULA_0997 "FORMULA_0997" TAB_VERB "%5.2" "-" COMPU_TAB_REF FORMULA_0997_VTAB /end COMPU_METHOD
/begin COMPU_METHOD FORMULA_0998 "FORMULA_0998" TAB_VERB "%3.0" "-" COMPU_TAB_REF FORMULA_0998_VTAB /end COMPU_METHOD
/begin COMPU_METHOD FORMULA_0999 "FORMULA_0999" RAT_FUNC "%3.0" "Upm/s" COEFFS 0 1.e-002 0.0 0 0.0 1.0 /end COMPU_METHOD
/begin COMPU_METHOD FORMULA_1000 "FORMULA_1000" RAT_FUNC "%7.2" "Upm/s" COEFFS 0 0.1 0.0 0 0.0 1.0 /end COMPU_METHOD
/begin COMPU_VTAB FORMULA_0052_VTAB "FORMULA_0052_VTAB" TAB_VERB 44 0 "O.K." 1 "SH_TO_UB" 2 "SH_TO_GND" 4 "OPENLOAD" 8 "UNPLAUSI" 256 "O.K./ZYKLUS" 512 "FILTER" 513 "FIL/SH_TO_UB" 514 "FIL/SH_TO_GND" 516 "FIL/OPENLOAD" 520 "FIL/UNPLAUSI" 576 "VORHANDEN" 577 "VORH/SH_TO_UB" 578 "VORH/SH_TO_GND" 580 "VORH/OPENLOAD" 584 "VORH/UNPLAUSI" 768 "FILTER/ZYKLUS" 769 "FIL/ZYK/SH_TO_UB" 770 "FIL/ZYK/SH_TO_GND" 772 "FIL/ZYK/OPENLOAD" 776 "FIL/ZYK/UNPLAUSI" 832 "VORHANDEN/ZYKLUS" 833 "VORH/ZYK/SH_TO_UB" 834 "VORH/ZYK/SH_TO_GND" 836 "VORH/ZYK/OPENLOAD" 840 "VORH/ZYK/UNPLAUSI" 2048 "O.K./SCDN" 2304 "O.K./S/ZYKLUS" 2561 "FIL/S/SH_TO_UB" 2562 "FIL/S/SH_TO_GND" 2564 "FIL/S/OPENLOAD" 2568 "FIL/S/UNPLAUSI" 2625 "VORH/S/SH_TO_UB" 2626 "VORH/S/SH_TO_GND" 2628 "VORH/S/OPENLOAD" 2632 "VORH/S/UNPLAUSI" 2817 "FIL/ZYK/S/SH_TO_UB" 2818 "FIL/ZYK/S/SH_TO_GND" 2820 "FIL/ZYK/S/OPENLOAD" 2824 "FIL/ZYK/S/UNPLAUSI" 2881 "VORH/ZYK/S/SH_TO_UB" 2882 "VORH/ZYK/S/SH_TO_GND" 2884 "VORH/ZYK/S/OPENLOAD" 2888 "VORH/ZYK/S/UNPLAUSI" /end COMPU_VTAB
/begin COMPU_VTAB FORMULA_0077_VTAB "FORMULA_0077_VTAB" TAB_VERB 1 128 "Keine Daten)" /end COMPU_VTAB
/begin COMPU_VTAB FORMULA_0078_VTAB "FORMULA_0078_VTAB" TAB_VERB 2 64 "Sektoren voll->A" 72 "Sektoren voll->B" /end COMPU_VTAB
/begin COMPU_VTAB FORMULA_0079_VTAB "FORMULA_0079_VTAB" TAB_VERB 9 0 "Daten o.k." 1 "CRC Stand falsch" 2 "Andere Erstellung" 4 "Andere Version" 8 "Wichtig groesser" 16 "Wichtig kleiner" 32 "Wichtig CRC falsch" 64 "Wichtig Laenge nio" 128 "keine Daten" /end COMPU_VTAB
/begin COMPU_VTAB FORMULA_0204_VTAB "FORMULA_0204_VTAB" TAB_VERB 2 0 "nein" 1 "ja" /end COMPU_VTAB
/begin COMPU_VTAB FORMULA_0206_VTAB "FORMULA_0206_VTAB" TAB_VERB 2 0 "nein" 1 "ja" /end COMPU_VTAB
/begin COMPU_VTAB FORMULA_0207_VTAB "FORMULA_0207_VTAB" TAB_VERB 2 0 "nein" 1 "ja" /end COMPU_VTAB
/begin COMPU_VTAB FORMULA_0209_VTAB "FORMULA_0209_VTAB" TAB_VERB 16 0 "O.K." 1 "SH_TO_UB" 2 "SH_TO_GND" 3 "UB+GND" 4 "OPENLOAD" 5 "UB+OL" 6 "GND+OL" 7 "UB+GND+OL" 8 "UNPLAUSI" 9 "UB+UP" 10 "GND+UP" 11 "UB+GND+UP" 12 "OL+UP" 13 "UB+OL+UP" 14 "GND+OL+UP" 15 "UB+GND+OL+UP" /end COMPU_VTAB
/begin COMPU_VTAB FORMULA_0353_VTAB "FORMULA_0353_VTAB" TAB_VERB 6 0 "Initialisierung" 1 "Zahndrehzahl" 3 "noch Zahndrehzahl" 7 "Segmentdrehzahl" 16 "Stoerung" 17 "Stoerung" DEFAULT_VALUE "Eingefroren" /end COMPU_VTAB
/begin COMPU_VTAB FORMULA_0629_VTAB "FORMULA_0629_VTAB" TAB_VERB 4 0 "Aus" 1 "readDummy" 2 "An" 4 "Stop" DEFAULT_VALUE "undef" /end COMPU_VTAB
/begin COMPU_VTAB FORMULA_0653_VTAB "FORMULA_0653_VTAB" TAB_VERB 1 0 "Aus" DEFAULT_VALUE "Ein" /end COMPU_VTAB
/begin COMPU_VTAB FORMULA_0654_VTAB "FORMULA_0654_VTAB" TAB_VERB 1 0 "Aus" DEFAULT_VALUE "Ein" /end COMPU_VTAB
/begin COMPU_VTAB FORMULA_0655_VTAB "FORMULA_0655_VTAB" TAB_VERB 1 0 "Aus" DEFAULT_VALUE "Blinken" /end COMPU_VTAB
/begin COMPU_VTAB FORMULA_0661_VTAB "FORMULA_0661_VTAB" TAB_VERB 3 0 "aus" 1 "an" 2 "Sperre SH_TO_UB" /end COMPU_VTAB
/begin COMPU_VTAB FORMULA_0663_VTAB "FORMULA_0663_VTAB" TAB_VERB 3 0 "Aus" 1 "Ein" 2 "ohne Abriss" /end COMPU_VTAB
/begin COMPU_VTAB FORMULA_0711_VTAB "FORMULA_0711_VTAB" TAB_VERB 2 0 "nein" 1 "ja" /end COMPU_VTAB
/begin COMPU_VTAB FORMULA_0712_VTAB "FORMULA_0712_VTAB" TAB_VERB 2 0 "nein" 1 "ja" /end COMPU_VTAB
/begin COMPU_VTAB FORMULA_0713_VTAB "FORMULA_0713_VTAB" TAB_VERB 2 0 "nein" 1 "ja" /end COMPU_VTAB
/begin COMPU_VTAB FORMULA_0714_VTAB "FORMULA_0714_VTAB" TAB_VERB 2 0 "FST O.K." 8 "FST unplausibel" DEFAULT_VALUE "CAN Fehler." /end COMPU_VTAB
/begin COMPU_VTAB FORMULA_0996_VTAB "FORMULA_0996_VTAB" TAB_VERB 11 1 "Standard" 2 "SK" 4 "Toel kalt" 8 "Toel heiss" 16 "Tmot kalt" 32 "FeTraWe" 64 "Fzg steht" 128 "v-Fehler" 256 "TZ-Schutz" 512 "Extern" 1024 "Tgetr heiss" /end COMPU_VTAB
/begin COMPU_VTAB FORMULA_0997_VTAB "FORMULA_0997_VTAB" TAB_VERB 4 0 "inaktiv" 1 "ueber nbegr" 2 "neuer FF" 3 "ueber nbegr und FF" /end COMPU_VTAB
/begin COMPU_VTAB FORMULA_0998_VTAB "FORMULA_0998_VTAB" TAB_VERB 2 0 "Speichern" 1 "Reset" DEFAULT_VALUE "undef" /end COMPU_VTAB
/begin FUNCTION diag_tr "" /begin DEF_CHARACTERISTIC K_DIAG_TR_MAX_ERR K_TD_DIAG_CFG /end DEF_CHARACTERISTIC
 /begin OUT_MEASUREMENT diag_st_atic35_AKL diag_st_atic35_EKP diag_st_atic35_EVAP2 diag_st_atic35_KLIMA diag_st_atic35_nn diag_st_atic35_NWA1 diag_st_atic35_NWA2 diag_st_atic35_NWE1 diag_st_atic35_NWE2 diag_st_atic35_SERVO_EVAP1 diag_st_atic35_SPORTLED diag_st_atic35_TD diag_st_atic35_VANOSDSV diag_st_atic39_DK1_ENABLE diag_st_atic39_DK2_ENABLE diag_st_atic39_DMTLH diag_st_atic39_DMTLP diag_st_atic39_DMTLV diag_st_atic39_EBOXL diag_st_atic39_ELUE diag_st_atic39_ELUP1 diag_st_atic39_ELUP2 diag_st_atic39_ELUP3 diag_st_atic39_EV1 diag_st_atic39_EV10 diag_st_atic39_EV2 diag_st_atic39_EV3 diag_st_atic39_EV4 diag_st_atic39_EV5 diag_st_atic39_EV6 diag_st_atic39_EV7 diag_st_atic39_EV8 diag_st_atic39_EV9 diag_st_atic39_IGC1 diag_st_atic39_IGC10 diag_st_atic39_IGC11 diag_st_atic39_IGC2 diag_st_atic39_IGC3 diag_st_atic39_IGC4 diag_st_atic39_IGC5 diag_st_atic39_IGC6 diag_st_atic39_IGC7 diag_st_atic39_IGC8 diag_st_atic39_IGC9 diag_st_atic39_LHN1 diag_st_atic39_LHN2 diag_st_atic39_LHV1 diag_st_atic39_LHV1_ diag_st_atic39_LHV2 diag_st_atic39_LHV2_ diag_st_atic39_LLFSO diag_st_atic39_LLFSS diag_st_atic39_nn diag_st_atic39_RLSLP diag_st_atic39_RLSTART diag_st_atic39_RLU87 diag_st_atic39_SERVO1 diag_st_atic39_SERVO2 diag_st_atic39_SLV diag_st_atic39_SLV_ diag_st_atic39_TEV1 diag_st_atic39_TEV2 diag_tr_atic35_error diag_tr_atic35_st diag_tr_atic35_tx_cnt diag_tr_atic39_error diag_tr_atic39_st diag_tr_atic39_tx_cnt /end OUT_MEASUREMENT
/end FUNCTION
/begin FUNCTION Diag_tr "" /begin DEF_CHARACTERISTIC K_DIAG_TR_UB_MIN /end DEF_CHARACTERISTIC /end FUNCTION
/begin FUNCTION DMTL ""
 /begin DEF_CHARACTERISTIC K_FST_ABWEICHUNG K_FST_CAN_FEHLER K_FST_FILT K_FST_NACHTANK K_FST_TANK_LEER_RECHTS K_FST_TANK_LEER_SUM K_FST_V_BETANK_END K_FST_VERBRAUCH K_FST_VERBRAUCH_VOLL K_FST_VOLL /end DEF_CHARACTERISTIC
 /begin OUT_MEASUREMENT B_FST_CAN_FEHLERKENNUNG B_FST_CAN_INIT B_FST_KEIN_CAN B_FST_NACHTANK B_FST_NACHTANK_LA B_FST_UNPLAUSIBEL fst_can_fehler fst_kva_old fst_links fst_links.rest fst_st fst_tank_leer_st_ign fst_tank_leer_st_inj /end OUT_MEASUREMENT
/end FUNCTION
/begin FUNCTION Drehtzahlwarnfeld ""
 /begin DEF_CHARACTERISTIC K_DWF_CFG K_DWF_ORANGE_OFF K_DWF_SHLI_AX_AKTIV K_DWF_SHLI_T_AKTIV K_DWF_SHLI_T_BL K_DWF_SHLI_T_FLS K_DWF_SHLI_T_INAKTIV K_DWF_SHLI_T_TOT K_DWF_SHLI_TAB_FAK K_DWF_SHLI_TAU_DN K_DWF_SHLI_TAU_N KL_DWF_SHLI_SEG KL_DWF_SHLI_V_DIFF /end DEF_CHARACTERISTIC
 /begin OUT_MEASUREMENT dwf_n_max dwf_n_rot dwf_repeat dwf_shli_dn dwf_shli_n dwf_shli_seg dwf_shli_st dwf_shli_st_bl dwf_shli_st_fls dwf_shli_st_on dwf_shli_tbegr dwf_shli_tseg /end OUT_MEASUREMENT
/end FUNCTION
/begin FUNCTION Drehzahlerfassung ""
 /begin DEF_CHARACTERISTIC K_N_BEGR_CFG K_N_BEGR_EGAS_HYS K_N_BEGR_ERR_E2 K_N_BEGR_FERTIGUNG K_N_BEGR_FETRAWE_WEG K_N_BEGR_FZG_STEHT K_N_BEGR_OFF_E2 K_N_BEGR_SK_RAMPE K_N_BEGR_TGETR_AEBGR_DOWN K_N_BEGR_TGETR_AEBGR_UP K_N_BEGR_TI_HYS K_N_BEGR_TI_MAX_E2 K_N_BEGR_TI_OFF_RSS K_N_BEGR_TRANSPORT K_N_BEGR_V_FEHLER K_N_BEGR_WERKSTATT K_N_MAX_FF_RESET K_N_MIN_FREEZE K_N_OBD_DYN_DELTA K_N_OBD_DYN_T K_N_OBD_DYN_TAU K_N_OBERGRENZE K_N_ZEIT_STOERUNG KL_N_BEGR_GANG KL_N_BEGR_SK KL_N_BEGR_TGETR_HEISS KL_N_BEGR_TI_OFFSET KL_N_BEGR_TMOT_HEISS KL_N_BEGR_TOEL_HEISS KL_N_BEGR_TOEL_KALT /end DEF_CHARACTERISTIC
 /begin OUT_MEASUREMENT n_begr_fetrawe n_begr_fzg_steht n_begr_sk n_begr_status n_begr_tgetr_heiss n_begr_tgetr_heiss_cnt n_begr_tgetr_heiss_neu n_begr_ti n_begr_time n_begr_tmot_heiss n_begr_toel_heiss n_begr_toel_kalt n_begr_tz_err n_begr_v_fehler n_dyn_filter n_dyn_timer n_grad_buf_0 n_grad_buf_1 n_grad_buf_2 n_grad_buf_3 n_grad_buf_4 n_grad_buf_5 n_grad_buf_6 n_grad_buf_7 n_grad_buf_8 n_grad_buf_9 n_max_err_e2 n_max_ff_flag n_proz n_segm_a n_segm_b n_st_a n_st_b n_t_segm_a n_t_segm_b n_t_segm_start_a n_t_segm_start_b n_timer_stoerung_a n_timer_stoerung_b n_zahn_a n_zahn_b /end OUT_MEASUREMENT
/end FUNCTION
/begin FUNCTION E-Boxluefter "" /begin DEF_CHARACTERISTIC K_EBOX_ELU_EIN K_EBOX_ELU_HYS K_EBOX_ELU_LOSBRECHEN /end DEF_CHARACTERISTIC /begin OUT_MEASUREMENT ebox_elu_exd_timeout ebox_elu_st /end OUT_MEASUREMENT /end FUNCTION
/begin FUNCTION EEPROM ""
 /begin OUT_MEASUREMENT eeprom_seite_lesen eeprom_seite_lesen_hdw eeprom_seite_schreiben eeprom_st /end OUT_MEASUREMENT
/end FUNCTION
/begin FUNCTION Egas "" /begin DEF_CHARACTERISTIC K_EGAS_CFG_DIAG /end DEF_CHARACTERISTIC /end FUNCTION
/begin FUNCTION Eigendiagnose ""
 /begin OUT_MEASUREMENT ed_css_time ed_debug_laufzeit ed_fil_appl_data_inj.art_aktuell_nv ed_fil_appl_data_inj.fehler_aufrufe_nv ed_fil_appl_data_inj.filter_max_nv ed_fil_appl_data_inj.filter_nv ed_fil_appl_data_inj.zyklus_filter_nv ed_fil_codierung.art_aktuell_nv ed_fil_codierung.fehler_aufrufe_nv ed_fil_codierung.filter_max_nv ed_fil_codierung.filter_nv ed_fil_codierung.zyklus_filter_nv ed_fil_dk1_enltg.art_aktuell_nv ed_fil_dk1_enltg.fehler_aufrufe_nv ed_fil_dk1_enltg.filter_max_nv ed_fil_dk1_enltg.filter_nv ed_fil_dk1_enltg.zyklus_filter_nv ed_fil_dk2_enltg.art_aktuell_nv ed_fil_dk2_enltg.fehler_aufrufe_nv ed_fil_dk2_enltg.filter_max_nv ed_fil_dk2_enltg.filter_nv ed_fil_dk2_enltg.zyklus_filter_nv ed_fil_dmtl_deckel.art_aktuell_nv ed_fil_dmtl_deckel.fehler_aufrufe_nv ed_fil_dmtl_deckel.filter_max_nv ed_fil_dmtl_deckel.filter_nv ed_fil_dmtl_deckel.zyklus_filter_nv ed_fil_dmtl_feinleck.art_aktuell_nv ed_fil_dmtl_feinleck.fehler_aufrufe_nv ed_fil_dmtl_feinleck.filter_max_nv ed_fil_dmtl_feinleck.filter_nv ed_fil_dmtl_feinleck.zyklus_filter_nv ed_fil_dmtl_feucht.art_aktuell_nv ed_fil_dmtl_feucht.fehler_aufrufe_nv ed_fil_dmtl_feucht.filter_max_nv ed_fil_dmtl_feucht.filter_nv ed_fil_dmtl_feucht.zyklus_filter_nv ed_fil_dmtl_grobleck.art_aktuell_nv ed_fil_dmtl_grobleck.fehler_aufrufe_nv ed_fil_dmtl_grobleck.filter_max_nv ed_fil_dmtl_grobleck.filter_nv ed_fil_dmtl_grobleck.zyklus_filter_nv ed_fil_dmtl_h.art_aktuell_nv ed_fil_dmtl_h.fehler_aufrufe_nv ed_fil_dmtl_h.filter_max_nv ed_fil_dmtl_h.filter_nv ed_fil_dmtl_h.zyklus_filter_nv ed_fil_dmtl_p.art_aktuell_nv ed_fil_dmtl_p.fehler_aufrufe_nv ed_fil_dmtl_p.filter_max_nv ed_fil_dmtl_p.filter_nv ed_fil_dmtl_p.zyklus_filter_nv ed_fil_dmtl_v.art_aktuell_nv ed_fil_dmtl_v.fehler_aufrufe_nv ed_fil_dmtl_v.filter_max_nv ed_fil_dmtl_v.filter_nv ed_fil_dmtl_v.zyklus_filter_nv ed_fil_e2_inj.art_aktuell_nv ed_fil_e2_inj.fehler_aufrufe_nv ed_fil_e2_inj.filter_max_nv ed_fil_e2_inj.filter_nv ed_fil_e2_inj.zyklus_filter_nv ed_fil_ebox_elu.art_aktuell_nv ed_fil_ebox_elu.fehler_aufrufe_nv ed_fil_ebox_elu.filter_max_nv ed_fil_ebox_elu.filter_nv ed_fil_ebox_elu.zyklus_filter_nv ed_fil_ekp_pwm.art_aktuell_nv ed_fil_ekp_pwm.fehler_aufrufe_nv ed_fil_ekp_pwm.filter_max_nv ed_fil_ekp_pwm.filter_nv ed_fil_ekp_pwm.zyklus_filter_nv ed_fil_elu.art_aktuell_nv ed_fil_elu.fehler_aufrufe_nv ed_fil_elu.filter_max_nv ed_fil_elu.filter_nv ed_fil_elu.zyklus_filter_nv ed_fil_elup.art_aktuell_nv ed_fil_elup.fehler_aufrufe_nv ed_fil_elup.filter_max_nv ed_fil_elup.filter_nv ed_fil_elup.zyklus_filter_nv ed_fil_ev1.art_aktuell_nv ed_fil_ev1.fehler_aufrufe_nv ed_fil_ev1.filter_max_nv ed_fil_ev1.filter_nv ed_fil_ev1.zyklus_filter_nv ed_fil_ev10.art_aktuell_nv ed_fil_ev10.fehler_aufrufe_nv ed_fil_ev10.filter_max_nv ed_fil_ev10.filter_nv ed_fil_ev10.zyklus_filter_nv ed_fil_ev2.art_aktuell_nv ed_fil_ev2.fehler_aufrufe_nv ed_fil_ev2.filter_max_nv ed_fil_ev2.filter_nv ed_fil_ev2.zyklus_filter_nv ed_fil_ev3.art_aktuell_nv ed_fil_ev3.fehler_aufrufe_nv ed_fil_ev3.filter_max_nv ed_fil_ev3.filter_nv ed_fil_ev3.zyklus_filter_nv ed_fil_ev4.art_aktuell_nv ed_fil_ev4.fehler_aufrufe_nv ed_fil_ev4.filter_max_nv ed_fil_ev4.filter_nv ed_fil_ev4.zyklus_filter_nv ed_fil_ev5.art_aktuell_nv ed_fil_ev5.fehler_aufrufe_nv ed_fil_ev5.filter_max_nv ed_fil_ev5.filter_nv ed_fil_ev5.zyklus_filter_nv ed_fil_ev6.art_aktuell_nv ed_fil_ev6.fehler_aufrufe_nv ed_fil_ev6.filter_max_nv ed_fil_ev6.filter_nv ed_fil_ev6.zyklus_filter_nv ed_fil_ev7.art_aktuell_nv ed_fil_ev7.fehler_aufrufe_nv ed_fil_ev7.filter_max_nv ed_fil_ev7.filter_nv ed_fil_ev7.zyklus_filter_nv ed_fil_ev8.art_aktuell_nv ed_fil_ev8.fehler_aufrufe_nv ed_fil_ev8.filter_max_nv ed_fil_ev8.filter_nv ed_fil_ev8.zyklus_filter_nv ed_fil_ev9.art_aktuell_nv ed_fil_ev9.fehler_aufrufe_nv ed_fil_ev9.filter_max_nv ed_fil_ev9.filter_nv ed_fil_ev9.zyklus_filter_nv ed_fil_ews_man.art_aktuell_nv ed_fil_ews_man.fehler_aufrufe_nv ed_fil_ews_man.filter_max_nv ed_fil_ews_man.filter_nv ed_fil_ews_man.zyklus_filter_nv ed_fil_ews_sci.art_aktuell_nv ed_fil_ews_sci.fehler_aufrufe_nv ed_fil_ews_sci.filter_max_nv ed_fil_ews_sci.filter_nv ed_fil_ews_sci.zyklus_filter_nv ed_fil_fetrawe.art_aktuell_nv ed_fil_fetrawe.fehler_aufrufe_nv ed_fil_fetrawe.filter_max_nv ed_fil_fetrawe.filter_nv ed_fil_fetrawe.zyklus_filter_nv ed_fil_fi_bsd.art_aktuell_nv ed_fil_fi_bsd.fehler_aufrufe_nv ed_fil_fi_bsd.filter_max_nv ed_fil_fi_bsd.filter_nv ed_fil_fi_bsd.zyklus_filter_nv ed_fil_fi_bsd_0.art_aktuell_nv ed_fil_fi_bsd_0.fehler_aufrufe_nv ed_fil_fi_bsd_0.filter_max_nv ed_fil_fi_bsd_0.filter_nv ed_fil_fi_bsd_0.zyklus_filter_nv ed_fil_fi_bsd_6.art_aktuell_nv ed_fil_fi_bsd_6.fehler_aufrufe_nv ed_fil_fi_bsd_6.filter_max_nv ed_fil_fi_bsd_6.filter_nv ed_fil_fi_bsd_6.zyklus_filter_nv ed_fil_fi_bsdglob.art_aktuell_nv ed_fil_fi_bsdglob.fehler_aufrufe_nv ed_fil_fi_bsdglob.filter_max_nv ed_fil_fi_bsdglob.filter_nv ed_fil_fi_bsdglob.zyklus_filter_nv ed_fil_fi_gen.art_aktuell_nv ed_fil_fi_gen.fehler_aufrufe_nv ed_fil_fi_gen.filter_max_nv ed_fil_fi_gen.filter_nv ed_fil_fi_gen.zyklus_filter_nv ed_fil_fi_ibs1.art_aktuell_nv ed_fil_fi_ibs1.fehler_aufrufe_nv ed_fil_fi_ibs1.filter_max_nv ed_fil_fi_ibs1.filter_nv ed_fil_fi_ibs1.zyklus_filter_nv ed_fil_fi_ibs2.art_aktuell_nv ed_fil_fi_ibs2.fehler_aufrufe_nv ed_fil_fi_ibs2.filter_max_nv ed_fil_fi_ibs2.filter_nv ed_fil_fi_ibs2.zyklus_filter_nv ed_fil_fi_ibs3.art_aktuell_nv ed_fil_fi_ibs3.fehler_aufrufe_nv ed_fil_fi_ibs3.filter_max_nv ed_fil_fi_ibs3.filter_nv ed_fil_fi_ibs3.zyklus_filter_nv ed_fil_fi_pmbatt.art_aktuell_nv ed_fil_fi_pmbatt.fehler_aufrufe_nv ed_fil_fi_pmbatt.filter_max_nv ed_fil_fi_pmbatt.filter_nv ed_fil_fi_pmbatt.zyklus_filter_nv ed_fil_fi_pmbn.art_aktuell_nv ed_fil_fi_pmbn.fehler_aufrufe_nv ed_fil_fi_pmbn.filter_max_nv ed_fil_fi_pmbn.filter_nv ed_fil_fi_pmbn.zyklus_filter_nv ed_fil_fi_pmruhverl.art_aktuell_nv ed_fil_fi_pmruhverl.fehler_aufrufe_nv ed_fil_fi_pmruhverl.filter_max_nv ed_fil_fi_pmruhverl.filter_nv ed_fil_fi_pmruhverl.zyklus_filter_nv ed_fil_fi_qlt.art_aktuell_nv ed_fil_fi_qlt.fehler_aufrufe_nv ed_fil_fi_qlt.filter_max_nv ed_fil_fi_qlt.filter_nv ed_fil_fi_qlt.zyklus_filter_nv ed_fil_fi_toens.art_aktuell_nv ed_fil_fi_toens.fehler_aufrufe_nv ed_fil_fi_toens.filter_max_nv ed_fil_fi_toens.filter_nv ed_fil_fi_toens.zyklus_filter_nv ed_fil_fplau1.art_aktuell_nv ed_fil_fplau1.fehler_aufrufe_nv ed_fil_fplau1.filter_max_nv ed_fil_fplau1.filter_nv ed_fil_fplau1.zyklus_filter_nv ed_fil_fplau2.art_aktuell_nv ed_fil_fplau2.fehler_aufrufe_nv ed_fil_fplau2.filter_max_nv ed_fil_fplau2.filter_nv ed_fil_fplau2.zyklus_filter_nv ed_fil_fst.art_aktuell_nv ed_fil_fst.fehler_aufrufe_nv ed_fil_fst.filter_max_nv ed_fil_fst.filter_nv ed_fil_fst.zyklus_filter_nv ed_fil_fst_geber.art_aktuell_nv ed_fil_fst_geber.fehler_aufrufe_nv ed_fil_fst_geber.filter_max_nv ed_fil_fst_geber.filter_nv ed_fil_fst_geber.zyklus_filter_nv ed_fil_hfm1.art_aktuell_nv ed_fil_hfm1.fehler_aufrufe_nv ed_fil_hfm1.filter_max_nv ed_fil_hfm1.filter_nv ed_fil_hfm1.zyklus_filter_nv ed_fil_hfm2.art_aktuell_nv ed_fil_hfm2.fehler_aufrufe_nv ed_fil_hfm2.filter_max_nv ed_fil_hfm2.filter_nv ed_fil_hfm2.zyklus_filter_nv ed_fil_index_135_inj.art_aktuell_nv ed_fil_index_135_inj.fehler_aufrufe_nv ed_fil_index_135_inj.filter_max_nv ed_fil_index_135_inj.filter_nv ed_fil_index_135_inj.zyklus_filter_nv ed_fil_index_15_inj.art_aktuell_nv ed_fil_index_15_inj.fehler_aufrufe_nv ed_fil_index_15_inj.filter_max_nv ed_fil_index_15_inj.filter_nv ed_fil_index_15_inj.zyklus_filter_nv ed_fil_index_196_inj.art_aktuell_nv ed_fil_index_196_inj.fehler_aufrufe_nv ed_fil_index_196_inj.filter_max_nv ed_fil_index_196_inj.filter_nv ed_fil_index_196_inj.zyklus_filter_nv ed_fil_index_197_inj.art_aktuell_nv ed_fil_index_197_inj.fehler_aufrufe_nv ed_fil_index_197_inj.filter_max_nv ed_fil_index_197_inj.filter_nv ed_fil_index_197_inj.zyklus_filter_nv ed_fil_index_198_inj.art_aktuell_nv ed_fil_index_198_inj.fehler_aufrufe_nv ed_fil_index_198_inj.filter_max_nv ed_fil_index_198_inj.filter_nv ed_fil_index_198_inj.zyklus_filter_nv ed_fil_index_199_inj.art_aktuell_nv ed_fil_index_199_inj.fehler_aufrufe_nv ed_fil_index_199_inj.filter_max_nv ed_fil_index_199_inj.filter_nv ed_fil_index_199_inj.zyklus_filter_nv ed_fil_index_200_inj.art_aktuell_nv ed_fil_index_200_inj.fehler_aufrufe_nv ed_fil_index_200_inj.filter_max_nv ed_fil_index_200_inj.filter_nv ed_fil_index_200_inj.zyklus_filter_nv ed_fil_index_201_inj.art_aktuell_nv ed_fil_index_201_inj.fehler_aufrufe_nv ed_fil_index_201_inj.filter_max_nv ed_fil_index_201_inj.filter_nv ed_fil_index_201_inj.zyklus_filter_nv ed_fil_index_202_inj.art_aktuell_nv ed_fil_index_202_inj.fehler_aufrufe_nv ed_fil_index_202_inj.filter_max_nv ed_fil_index_202_inj.filter_nv ed_fil_index_202_inj.zyklus_filter_nv ed_fil_index_203_inj.art_aktuell_nv ed_fil_index_203_inj.fehler_aufrufe_nv ed_fil_index_203_inj.filter_max_nv ed_fil_index_203_inj.filter_nv ed_fil_index_203_inj.zyklus_filter_nv ed_fil_index_204_inj.art_aktuell_nv ed_fil_index_204_inj.fehler_aufrufe_nv ed_fil_index_204_inj.filter_max_nv ed_fil_index_204_inj.filter_nv ed_fil_index_204_inj.zyklus_filter_nv ed_fil_index_205_inj.art_aktuell_nv ed_fil_index_205_inj.fehler_aufrufe_nv ed_fil_index_205_inj.filter_max_nv ed_fil_index_205_inj.filter_nv ed_fil_index_205_inj.zyklus_filter_nv ed_fil_index_206_inj.art_aktuell_nv ed_fil_index_206_inj.fehler_aufrufe_nv ed_fil_index_206_inj.filter_max_nv ed_fil_index_206_inj.filter_nv ed_fil_index_206_inj.zyklus_filter_nv ed_fil_index_207_inj.art_aktuell_nv ed_fil_index_207_inj.fehler_aufrufe_nv ed_fil_index_207_inj.filter_max_nv ed_fil_index_207_inj.filter_nv ed_fil_index_207_inj.zyklus_filter_nv ed_fil_index_208_inj.art_aktuell_nv ed_fil_index_208_inj.fehler_aufrufe_nv ed_fil_index_208_inj.filter_max_nv ed_fil_index_208_inj.filter_nv ed_fil_index_208_inj.zyklus_filter_nv ed_fil_index_209_inj.art_aktuell_nv ed_fil_index_209_inj.fehler_aufrufe_nv ed_fil_index_209_inj.filter_max_nv ed_fil_index_209_inj.filter_nv ed_fil_index_209_inj.zyklus_filter_nv ed_fil_index_210_inj.art_aktuell_nv ed_fil_index_210_inj.fehler_aufrufe_nv ed_fil_index_210_inj.filter_max_nv ed_fil_index_210_inj.filter_nv ed_fil_index_210_inj.zyklus_filter_nv ed_fil_index_211_inj.art_aktuell_nv ed_fil_index_211_inj.fehler_aufrufe_nv ed_fil_index_211_inj.filter_max_nv ed_fil_index_211_inj.filter_nv ed_fil_index_211_inj.zyklus_filter_nv ed_fil_index_212_inj.art_aktuell_nv ed_fil_index_212_inj.fehler_aufrufe_nv ed_fil_index_212_inj.filter_max_nv ed_fil_index_212_inj.filter_nv ed_fil_index_212_inj.zyklus_filter_nv ed_fil_index_213_inj.art_aktuell_nv ed_fil_index_213_inj.fehler_aufrufe_nv ed_fil_index_213_inj.filter_max_nv ed_fil_index_213_inj.filter_nv ed_fil_index_213_inj.zyklus_filter_nv ed_fil_index_214_inj.art_aktuell_nv ed_fil_index_214_inj.fehler_aufrufe_nv ed_fil_index_214_inj.filter_max_nv ed_fil_index_214_inj.filter_nv ed_fil_index_214_inj.zyklus_filter_nv ed_fil_index_215_inj.art_aktuell_nv ed_fil_index_215_inj.fehler_aufrufe_nv ed_fil_index_215_inj.filter_max_nv ed_fil_index_215_inj.filter_nv ed_fil_index_215_inj.zyklus_filter_nv ed_fil_index_216_inj.art_aktuell_nv ed_fil_index_216_inj.fehler_aufrufe_nv ed_fil_index_216_inj.filter_max_nv ed_fil_index_216_inj.filter_nv ed_fil_index_216_inj.zyklus_filter_nv ed_fil_index_217_inj.art_aktuell_nv ed_fil_index_217_inj.fehler_aufrufe_nv ed_fil_index_217_inj.filter_max_nv ed_fil_index_217_inj.filter_nv ed_fil_index_217_inj.zyklus_filter_nv ed_fil_index_218_inj.art_aktuell_nv ed_fil_index_218_inj.fehler_aufrufe_nv ed_fil_index_218_inj.filter_max_nv ed_fil_index_218_inj.filter_nv ed_fil_index_218_inj.zyklus_filter_nv ed_fil_index_219_inj.art_aktuell_nv ed_fil_index_219_inj.fehler_aufrufe_nv ed_fil_index_219_inj.filter_max_nv ed_fil_index_219_inj.filter_nv ed_fil_index_219_inj.zyklus_filter_nv ed_fil_index_220_inj.art_aktuell_nv ed_fil_index_220_inj.fehler_aufrufe_nv ed_fil_index_220_inj.filter_max_nv ed_fil_index_220_inj.filter_nv ed_fil_index_220_inj.zyklus_filter_nv ed_fil_index_221_inj.art_aktuell_nv ed_fil_index_221_inj.fehler_aufrufe_nv ed_fil_index_221_inj.filter_max_nv ed_fil_index_221_inj.filter_nv ed_fil_index_221_inj.zyklus_filter_nv ed_fil_index_222_inj.art_aktuell_nv ed_fil_index_222_inj.fehler_aufrufe_nv ed_fil_index_222_inj.filter_max_nv ed_fil_index_222_inj.filter_nv ed_fil_index_222_inj.zyklus_filter_nv ed_fil_index_223_inj.art_aktuell_nv ed_fil_index_223_inj.fehler_aufrufe_nv ed_fil_index_223_inj.filter_max_nv ed_fil_index_223_inj.filter_nv ed_fil_index_223_inj.zyklus_filter_nv ed_fil_kat_obd1.art_aktuell_nv ed_fil_kat_obd1.fehler_aufrufe_nv ed_fil_kat_obd1.filter_max_nv ed_fil_kat_obd1.filter_nv ed_fil_kat_obd1.zyklus_filter_nv ed_fil_kat_obd2.art_aktuell_nv ed_fil_kat_obd2.fehler_aufrufe_nv ed_fil_kat_obd2.filter_max_nv ed_fil_kat_obd2.filter_nv ed_fil_kat_obd2.zyklus_filter_nv ed_fil_kats_b1.art_aktuell_nv ed_fil_kats_b1.fehler_aufrufe_nv ed_fil_kats_b1.filter_max_nv ed_fil_kats_b1.filter_nv ed_fil_kats_b1.zyklus_filter_nv ed_fil_kats_b2.art_aktuell_nv ed_fil_kats_b2.fehler_aufrufe_nv ed_fil_kats_b2.filter_max_nv ed_fil_kats_b2.filter_nv ed_fil_kats_b2.zyklus_filter_nv ed_fil_kge1.art_aktuell_nv ed_fil_kge1.fehler_aufrufe_nv ed_fil_kge1.filter_max_nv ed_fil_kge1.filter_nv ed_fil_kge1.zyklus_filter_nv ed_fil_kge2.art_aktuell_nv ed_fil_kge2.fehler_aufrufe_nv ed_fil_kge2.filter_max_nv ed_fil_kge2.filter_nv ed_fil_kge2.zyklus_filter_nv ed_fil_ksd1.art_aktuell_nv ed_fil_ksd1.fehler_aufrufe_nv ed_fil_ksd1.filter_max_nv ed_fil_ksd1.filter_nv ed_fil_ksd1.zyklus_filter_nv ed_fil_ksd2.art_aktuell_nv ed_fil_ksd2.fehler_aufrufe_nv ed_fil_ksd2.filter_max_nv ed_fil_ksd2.filter_nv ed_fil_ksd2.zyklus_filter_nv ed_fil_kw.art_aktuell_nv ed_fil_kw.fehler_aufrufe_nv ed_fil_kw.filter_max_nv ed_fil_kw.filter_nv ed_fil_kw.zyklus_filter_nv ed_fil_la1_adapt.art_aktuell_nv ed_fil_la1_adapt.fehler_aufrufe_nv ed_fil_la1_adapt.filter_max_nv ed_fil_la1_adapt.filter_nv ed_fil_la1_adapt.zyklus_filter_nv ed_fil_la1_trim_ad.art_aktuell_nv ed_fil_la1_trim_ad.fehler_aufrufe_nv ed_fil_la1_trim_ad.filter_max_nv ed_fil_la1_trim_ad.filter_nv ed_fil_la1_trim_ad.zyklus_filter_nv ed_fil_la2_adapt.art_aktuell_nv ed_fil_la2_adapt.fehler_aufrufe_nv ed_fil_la2_adapt.filter_max_nv ed_fil_la2_adapt.filter_nv ed_fil_la2_adapt.zyklus_filter_nv ed_fil_la2_trim_ad.art_aktuell_nv ed_fil_la2_trim_ad.fehler_aufrufe_nv ed_fil_la2_trim_ad.filter_max_nv ed_fil_la2_trim_ad.filter_nv ed_fil_la2_trim_ad.zyklus_filter_nv ed_fil_lam1_reg.art_aktuell_nv ed_fil_lam1_reg.fehler_aufrufe_nv ed_fil_lam1_reg.filter_max_nv ed_fil_lam1_reg.filter_nv ed_fil_lam1_reg.zyklus_filter_nv ed_fil_lam2_reg.art_aktuell_nv ed_fil_lam2_reg.fehler_aufrufe_nv ed_fil_lam2_reg.filter_max_nv ed_fil_lam2_reg.filter_nv ed_fil_lam2_reg.zyklus_filter_nv ed_fil_lank1.art_aktuell_nv ed_fil_lank1.fehler_aufrufe_nv ed_fil_lank1.filter_max_nv ed_fil_lank1.filter_nv ed_fil_lank1.zyklus_filter_nv ed_fil_lank1_obd_s.art_aktuell_nv ed_fil_lank1_obd_s.fehler_aufrufe_nv ed_fil_lank1_obd_s.filter_max_nv ed_fil_lank1_obd_s.filter_nv ed_fil_lank1_obd_s.zyklus_filter_nv ed_fil_lank1_obd_we.art_aktuell_nv ed_fil_lank1_obd_we.fehler_aufrufe_nv ed_fil_lank1_obd_we.filter_max_nv ed_fil_lank1_obd_we.filter_nv ed_fil_lank1_obd_we.zyklus_filter_nv ed_fil_lank1_openload.art_aktuell_nv ed_fil_lank1_openload.fehler_aufrufe_nv ed_fil_lank1_openload.filter_max_nv ed_fil_lank1_openload.filter_nv ed_fil_lank1_openload.zyklus_filter_nv ed_fil_lank2.art_aktuell_nv ed_fil_lank2.fehler_aufrufe_nv ed_fil_lank2.filter_max_nv ed_fil_lank2.filter_nv ed_fil_lank2.zyklus_filter_nv ed_fil_lank2_obd_s.art_aktuell_nv ed_fil_lank2_obd_s.fehler_aufrufe_nv ed_fil_lank2_obd_s.filter_max_nv ed_fil_lank2_obd_s.filter_nv ed_fil_lank2_obd_s.zyklus_filter_nv ed_fil_lank2_obd_we.art_aktuell_nv ed_fil_lank2_obd_we.fehler_aufrufe_nv ed_fil_lank2_obd_we.filter_max_nv ed_fil_lank2_obd_we.filter_nv ed_fil_lank2_obd_we.zyklus_filter_nv ed_fil_lank2_openload.art_aktuell_nv ed_fil_lank2_openload.fehler_aufrufe_nv ed_fil_lank2_openload.filter_max_nv ed_fil_lank2_openload.filter_nv ed_fil_lank2_openload.zyklus_filter_nv ed_fil_lavk_atic42.art_aktuell_nv ed_fil_lavk_atic42.fehler_aufrufe_nv ed_fil_lavk_atic42.filter_max_nv ed_fil_lavk_atic42.filter_nv ed_fil_lavk_atic42.zyklus_filter_nv ed_fil_lavk1.art_aktuell_nv ed_fil_lavk1.fehler_aufrufe_nv ed_fil_lavk1.filter_max_nv ed_fil_lavk1.filter_nv ed_fil_lavk1.zyklus_filter_nv ed_fil_lavk1_diag.art_aktuell_nv ed_fil_lavk1_diag.fehler_aufrufe_nv ed_fil_lavk1_diag.filter_max_nv ed_fil_lavk1_diag.filter_nv ed_fil_lavk1_diag.zyklus_filter_nv ed_fil_lavk1_ia_openload.art_aktuell_nv ed_fil_lavk1_ia_openload.fehler_aufrufe_nv ed_fil_lavk1_ia_openload.filter_max_nv ed_fil_lavk1_ia_openload.filter_nv ed_fil_lavk1_ia_openload.zyklus_filter_nv ed_fil_lavk1_ip_openload.art_aktuell_nv ed_fil_lavk1_ip_openload.fehler_aufrufe_nv ed_fil_lavk1_ip_openload.filter_max_nv ed_fil_lavk1_ip_openload.filter_nv ed_fil_lavk1_ip_openload.zyklus_filter_nv ed_fil_lavk1_obd_dyn.art_aktuell_nv ed_fil_lavk1_obd_dyn.fehler_aufrufe_nv ed_fil_lavk1_obd_dyn.filter_max_nv ed_fil_lavk1_obd_dyn.filter_nv ed_fil_lavk1_obd_dyn.zyklus_filter_nv ed_fil_lavk1_obd_plau.art_aktuell_nv ed_fil_lavk1_obd_plau.fehler_aufrufe_nv ed_fil_lavk1_obd_plau.filter_max_nv ed_fil_lavk1_obd_plau.filter_nv ed_fil_lavk1_obd_plau.zyklus_filter_nv ed_fil_lavk1_obd_sa.art_aktuell_nv ed_fil_lavk1_obd_sa.fehler_aufrufe_nv ed_fil_lavk1_obd_sa.filter_max_nv ed_fil_lavk1_obd_sa.filter_nv ed_fil_lavk1_obd_sa.zyklus_filter_nv ed_fil_lavk1_obd_tl.art_aktuell_nv ed_fil_lavk1_obd_tl.fehler_aufrufe_nv ed_fil_lavk1_obd_tl.filter_max_nv ed_fil_lavk1_obd_tl.filter_nv ed_fil_lavk1_obd_tl.zyklus_filter_nv ed_fil_lavk1_trim.art_aktuell_nv ed_fil_lavk1_trim.fehler_aufrufe_nv ed_fil_lavk1_trim.filter_max_nv ed_fil_lavk1_trim.filter_nv ed_fil_lavk1_trim.zyklus_filter_nv ed_fil_lavk1_un_openload.art_aktuell_nv ed_fil_lavk1_un_openload.fehler_aufrufe_nv ed_fil_lavk1_un_openload.filter_max_nv ed_fil_lavk1_un_openload.filter_nv ed_fil_lavk1_un_openload.zyklus_filter_nv ed_fil_lavk2.art_aktuell_nv ed_fil_lavk2.fehler_aufrufe_nv ed_fil_lavk2.filter_max_nv ed_fil_lavk2.filter_nv ed_fil_lavk2.zyklus_filter_nv ed_fil_lavk2_diag.art_aktuell_nv ed_fil_lavk2_diag.fehler_aufrufe_nv ed_fil_lavk2_diag.filter_max_nv ed_fil_lavk2_diag.filter_nv ed_fil_lavk2_diag.zyklus_filter_nv ed_fil_lavk2_ia_openload.art_aktuell_nv ed_fil_lavk2_ia_openload.fehler_aufrufe_nv ed_fil_lavk2_ia_openload.filter_max_nv ed_fil_lavk2_ia_openload.filter_nv ed_fil_lavk2_ia_openload.zyklus_filter_nv ed_fil_lavk2_ip_openload.art_aktuell_nv ed_fil_lavk2_ip_openload.fehler_aufrufe_nv ed_fil_lavk2_ip_openload.filter_max_nv ed_fil_lavk2_ip_openload.filter_nv ed_fil_lavk2_ip_openload.zyklus_filter_nv ed_fil_lavk2_obd_dyn.art_aktuell_nv ed_fil_lavk2_obd_dyn.fehler_aufrufe_nv ed_fil_lavk2_obd_dyn.filter_max_nv ed_fil_lavk2_obd_dyn.filter_nv ed_fil_lavk2_obd_dyn.zyklus_filter_nv ed_fil_lavk2_obd_plau.art_aktuell_nv ed_fil_lavk2_obd_plau.fehler_aufrufe_nv ed_fil_lavk2_obd_plau.filter_max_nv ed_fil_lavk2_obd_plau.filter_nv ed_fil_lavk2_obd_plau.zyklus_filter_nv ed_fil_lavk2_obd_sa.art_aktuell_nv ed_fil_lavk2_obd_sa.fehler_aufrufe_nv ed_fil_lavk2_obd_sa.filter_max_nv ed_fil_lavk2_obd_sa.filter_nv ed_fil_lavk2_obd_sa.zyklus_filter_nv ed_fil_lavk2_obd_tl.art_aktuell_nv ed_fil_lavk2_obd_tl.fehler_aufrufe_nv ed_fil_lavk2_obd_tl.filter_max_nv ed_fil_lavk2_obd_tl.filter_nv ed_fil_lavk2_obd_tl.zyklus_filter_nv ed_fil_lavk2_trim.art_aktuell_nv ed_fil_lavk2_trim.fehler_aufrufe_nv ed_fil_lavk2_trim.filter_max_nv ed_fil_lavk2_trim.filter_nv ed_fil_lavk2_trim.zyklus_filter_nv ed_fil_lavk2_un_openload.art_aktuell_nv ed_fil_lavk2_un_openload.fehler_aufrufe_nv ed_fil_lavk2_un_openload.filter_max_nv ed_fil_lavk2_un_openload.filter_nv ed_fil_lavk2_un_openload.zyklus_filter_nv ed_fil_lshnk1.art_aktuell_nv ed_fil_lshnk1.fehler_aufrufe_nv ed_fil_lshnk1.filter_max_nv ed_fil_lshnk1.filter_nv ed_fil_lshnk1.zyklus_filter_nv ed_fil_lshnk1_r.art_aktuell_nv ed_fil_lshnk1_r.fehler_aufrufe_nv ed_fil_lshnk1_r.filter_max_nv ed_fil_lshnk1_r.filter_nv ed_fil_lshnk1_r.zyklus_filter_nv ed_fil_lshnk2.art_aktuell_nv ed_fil_lshnk2.fehler_aufrufe_nv ed_fil_lshnk2.filter_max_nv ed_fil_lshnk2.filter_nv ed_fil_lshnk2.zyklus_filter_nv ed_fil_lshnk2_r.art_aktuell_nv ed_fil_lshnk2_r.fehler_aufrufe_nv ed_fil_lshnk2_r.filter_max_nv ed_fil_lshnk2_r.filter_nv ed_fil_lshnk2_r.zyklus_filter_nv ed_fil_lshvk1.art_aktuell_nv ed_fil_lshvk1.fehler_aufrufe_nv ed_fil_lshvk1.filter_max_nv ed_fil_lshvk1.filter_nv ed_fil_lshvk1.zyklus_filter_nv ed_fil_lshvk1_r.art_aktuell_nv ed_fil_lshvk1_r.fehler_aufrufe_nv ed_fil_lshvk1_r.filter_max_nv ed_fil_lshvk1_r.filter_nv ed_fil_lshvk1_r.zyklus_filter_nv ed_fil_lshvk2.art_aktuell_nv ed_fil_lshvk2.fehler_aufrufe_nv ed_fil_lshvk2.filter_max_nv ed_fil_lshvk2.filter_nv ed_fil_lshvk2.zyklus_filter_nv ed_fil_lshvk2_r.art_aktuell_nv ed_fil_lshvk2_r.fehler_aufrufe_nv ed_fil_lshvk2_r.filter_max_nv ed_fil_lshvk2_r.filter_nv ed_fil_lshvk2_r.zyklus_filter_nv ed_fil_lsrvk1_obd_ref.art_aktuell_nv ed_fil_lsrvk1_obd_ref.fehler_aufrufe_nv ed_fil_lsrvk1_obd_ref.filter_max_nv ed_fil_lsrvk1_obd_ref.filter_nv ed_fil_lsrvk1_obd_ref.zyklus_filter_nv ed_fil_lsrvk1_obd_reg.art_aktuell_nv ed_fil_lsrvk1_obd_reg.fehler_aufrufe_nv ed_fil_lsrvk1_obd_reg.filter_max_nv ed_fil_lsrvk1_obd_reg.filter_nv ed_fil_lsrvk1_obd_reg.zyklus_filter_nv ed_fil_lsrvk1_obd_start.art_aktuell_nv ed_fil_lsrvk1_obd_start.fehler_aufrufe_nv ed_fil_lsrvk1_obd_start.filter_max_nv ed_fil_lsrvk1_obd_start.filter_nv ed_fil_lsrvk1_obd_start.zyklus_filter_nv ed_fil_lsrvk2_obd_ref.art_aktuell_nv ed_fil_lsrvk2_obd_ref.fehler_aufrufe_nv ed_fil_lsrvk2_obd_ref.filter_max_nv ed_fil_lsrvk2_obd_ref.filter_nv ed_fil_lsrvk2_obd_ref.zyklus_filter_nv ed_fil_lsrvk2_obd_reg.art_aktuell_nv ed_fil_lsrvk2_obd_reg.fehler_aufrufe_nv ed_fil_lsrvk2_obd_reg.filter_max_nv ed_fil_lsrvk2_obd_reg.filter_nv ed_fil_lsrvk2_obd_reg.zyklus_filter_nv ed_fil_lsrvk2_obd_start.art_aktuell_nv ed_fil_lsrvk2_obd_start.fehler_aufrufe_nv ed_fil_lsrvk2_obd_start.filter_max_nv ed_fil_lsrvk2_obd_start.filter_nv ed_fil_lsrvk2_obd_start.zyklus_filter_nv ed_fil_mvac_drucksensor.art_aktuell_nv ed_fil_mvac_drucksensor.fehler_aufrufe_nv ed_fil_mvac_drucksensor.filter_max_nv ed_fil_mvac_drucksensor.filter_nv ed_fil_mvac_drucksensor.zyklus_filter_nv ed_fil_nw_sync.art_aktuell_nv ed_fil_nw_sync.fehler_aufrufe_nv ed_fil_nw_sync.filter_max_nv ed_fil_nw_sync.filter_nv ed_fil_nw_sync.zyklus_filter_nv ed_fil_pctrl_inj.art_aktuell_nv ed_fil_pctrl_inj.fehler_aufrufe_nv ed_fil_pctrl_inj.filter_max_nv ed_fil_pctrl_inj.filter_nv ed_fil_pctrl_inj.zyklus_filter_nv ed_fil_pks.art_aktuell_nv ed_fil_pks.fehler_aufrufe_nv ed_fil_pks.filter_max_nv ed_fil_pks.filter_nv ed_fil_pks.zyklus_filter_nv ed_fil_pks_adapt_anschl.art_aktuell_nv ed_fil_pks_adapt_anschl.fehler_aufrufe_nv ed_fil_pks_adapt_anschl.filter_max_nv ed_fil_pks_adapt_anschl.filter_nv ed_fil_pks_adapt_anschl.zyklus_filter_nv ed_fil_pks_ll.art_aktuell_nv ed_fil_pks_ll.fehler_aufrufe_nv /end OUT_MEASUREMENT
/end FUNCTION
/begin RECORD_LAYOUT TKL_SW_VV_SW FNC_VALUES 4 SWORD COLUMN_DIR DIRECT AXIS_PTS_X 3 SWORD INDEX_INCR DIRECT NO_AXIS_PTS_X 1 UBYTE RESERVED 2 BYTE /end RECORD_LAYOUT
/begin RECORD_LAYOUT TKL_SW_VV_UB FNC_VALUES 4 UBYTE COLUMN_DIR DIRECT AXIS_PTS_X 3 SWORD INDEX_INCR DIRECT NO_AXIS_PTS_X 1 UBYTE RESERVED 2 BYTE /end RECORD_LAYOUT
/begin RECORD_LAYOUT TKL_UB_VV_SW FNC_VALUES 4 SWORD COLUMN_DIR DIRECT AXIS_PTS_X 3 UBYTE INDEX_INCR DIRECT NO_AXIS_PTS_X 1 UBYTE RESERVED 2 BYTE /end RECORD_LAYOUT
/begin RECORD_LAYOUT TKW_VV_VV_SB FNC_VALUES 1 SBYTE COLUMN_DIR DIRECT /end RECORD_LAYOUT
/begin RECORD_LAYOUT TKW_VV_VV_SW FNC_VALUES 1 SWORD COLUMN_DIR DIRECT /end RECORD_LAYOUT
/begin RECORD_LAYOUT TKW_VV_VV_UB FNC_VALUES 1 UBYTE COLUMN_DIR DIRECT /end RECORD_LAYOUT
/begin RECORD_LAYOUT TKW_VV_VV_UW FNC_VALUES 1 UWORD COLUMN_DIR DIRECT /end RECORD_LAYOUT
/end MODULE
/end PROJECT
