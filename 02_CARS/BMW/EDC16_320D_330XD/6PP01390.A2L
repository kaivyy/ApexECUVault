ASAP2_VERSION 1 3
/begin PROJECT P390 "BMW DDE6.2 6-Zylinder VP0.1 11.11.2003 CAN12H"
/begin HEADER "" VERSION "VP01_6Z_CAN12H" PROJECT_NO P390 /end HEADER
/begin MODULE DIM ""
/begin MOD_COMMON "" BYTE_ORDER MSB_FIRST ALIGNMENT_BYTE 1 ALIGNMENT_WORD 2 ALIGNMENT_LONG 4 ALIGNMENT_FLOAT32_IEEE 4 /end MOD_COMMON
/begin CHARACTERISTIC Dmd_gen_C "" VALUE 0xE3074 Kw_Ws16 65535.00 OneToOne -32768.00 32767.00 FORMAT "%8.2" /end CHARACTERISTIC
/begin CHARACTERISTIC InjVlv_facPiI2WvCor_C "Gewichtungsfaktor der Druckwellenkorrekturmenge der MI1 abhängig von PiI2" VALUE 0xE2542 Kw_Ws16 1.000000 Fact 0.00 1.000000 FORMAT "%8.6" EXTENDED_LIMITS -4.000000 3.999878 /end CHARACTERISTIC
/begin CHARACTERISTIC InjVlv_facWvCor1_MAP "KF 1 für Gewichtungsfaktor der Druckwellenkorrektur" MAP 0xE2544 Kf_Xs16_Ys16_Ws16 10.00000 Fact1 0.00 10.00000 FORMAT "%8.5" EXTENDED_LIMITS -256.0000 255.9922
 /begin AXIS_DESCR STD_AXIS InjCrv_qMI1Des InjMassInj 8 0.00 327.6700 FORMAT "%8.4" EXTENDED_LIMITS -327.6800 327.6700 DEPOSIT ABSOLUTE /end AXIS_DESCR
 /begin AXIS_DESCR STD_AXIS RailCD_pAct_mp Pres_Rail 16 0.00 2000.000 FORMAT "%5.3" EXTENDED_LIMITS -3276.800 3276.700 DEPOSIT ABSOLUTE /end AXIS_DESCR
/end CHARACTERISTIC
/begin CHARACTERISTIC InjVlv_facWvCor2_MAP "KF 2 für Gewichtungsfaktor der Druckwellenkorrektur" MAP 0xE2678 Kf_Xs16_Ys16_Ws16 10.00000 Fact1 0.00 10.00000 FORMAT "%8.5" EXTENDED_LIMITS -256.0000 255.9922
 /begin AXIS_DESCR STD_AXIS InjCrv_qPoI2Des_mp InjMassInj 8 0.00 327.6700 FORMAT "%8.4" EXTENDED_LIMITS -327.6800 327.6700 DEPOSIT ABSOLUTE /end AXIS_DESCR
 /begin AXIS_DESCR STD_AXIS RailCD_pAct_mp Pres_Rail 16 0.00 2000.000 FORMAT "%5.3" EXTENDED_LIMITS -3276.800 3276.700 DEPOSIT ABSOLUTE /end AXIS_DESCR
/end CHARACTERISTIC
/begin CHARACTERISTIC InjVlv_qWvCor1_MAP "Grundwerte-KF 1 der Druckwellenkorrekturmenge" MAP 0xE27AC Kf_Xs16_Ys16_Ws16 655.3400 InjMassInj -327.6700 327.6700 FORMAT "%8.4" EXTENDED_LIMITS -327.6800 327.6700
 /begin AXIS_DESCR STD_AXIS InjVlv_tiPiI1MI1Cor_mp InjTime_us 32 0.00 13000.00 FORMAT "%8.2" EXTENDED_LIMITS -32768.00 32767.00 DEPOSIT ABSOLUTE /end AXIS_DESCR
 /begin AXIS_DESCR STD_AXIS InjCrv_qPiI1Des InjMassInj 16 0.00 327.6700 FORMAT "%8.4" EXTENDED_LIMITS -327.6800 327.6700 DEPOSIT ABSOLUTE /end AXIS_DESCR
/end CHARACTERISTIC
/begin CHARACTERISTIC InjVlv_qWvCor2_MAP "Grundwerte-KF 2 der Druckwellenkorrekturmenge" MAP 0xE2C10 Kf_Xs16_Ys16_Ws16 655.3400 InjMassInj -327.6700 327.6700 FORMAT "%8.4" EXTENDED_LIMITS -327.6800 327.6700
 /begin AXIS_DESCR STD_AXIS InjVlv_tiMI1PoI2HydCor_mp InjTime_us 16 0.00 13000.00 FORMAT "%8.2" EXTENDED_LIMITS 0.00 65535.00 DEPOSIT ABSOLUTE /end AXIS_DESCR
 /begin AXIS_DESCR STD_AXIS InjVlv_rMI1WvCorNorm_mp QntR 16 0.0009765625 24.00000 FORMAT "%8.5" EXTENDED_LIMITS -32.00000 31.99902 DEPOSIT ABSOLUTE /end AXIS_DESCR
/end CHARACTERISTIC
/begin CHARACTERISTIC InjVlv_qWvCorMax_C "#SSD maximale Begrenzungsmenge der Druckwellenkorrektur" VALUE 0xE2E54 Kw_Ws16 20.00000 InjMassInj -10.00000 10.00000 FORMAT "%8.5" EXTENDED_LIMITS -327.6800 327.6700 /end CHARACTERISTIC
/begin CHARACTERISTIC InjVlv_qWvCorMin_C "#SSD minimale Begrenzungsmenge der Druckwellenkorrektur" VALUE 0xE2E56 Kw_Ws16 20.00000 InjMassInj -10.00000 10.00000 FORMAT "%8.5" EXTENDED_LIMITS -327.6800 327.6700 /end CHARACTERISTIC
/begin CHARACTERISTIC IVCtl_ChrgUpIKi_C "#SSD Kleinsignalverstärkung für I-Glied (Laden)" VALUE 0xE2E58 Kw_Wu32 9999999.99767 Ki_us2mA 0.00 9999999.99767 FORMAT "%13.5" /end CHARACTERISTIC
/begin CHARACTERISTIC IVCtl_ChrgUpIKiPos_C "#SSD Positive Großsignalverstärkung für I-Glied (Laden)" VALUE 0xE2E5C Kw_Wu32 9999999.99767 Ki_us2mA 0.00 9999999.99767 FORMAT "%13.5" /end CHARACTERISTIC
/begin CHARACTERISTIC IVCtl_ChrgUpIKiNeg_C "#SSD Negative Großsignalverstärkung für I-Glied (Laden)" VALUE 0xE2E60 Kw_Wu32 9999999.99767 Ki_us2mA 0.00 9999999.99767 FORMAT "%13.5" /end CHARACTERISTIC
/begin CHARACTERISTIC IVCtl_tiChrgUpIWinPos_C "#SSD Positives Kleinsignalfenster für I-Glied (Laden)" VALUE 0xE2E64 Kw_Ws16 200.0000 Time_Busy -100.0000 100.0000 FORMAT "%8.4" EXTENDED_LIMITS -3276.800 3276.700 /end CHARACTERISTIC
/begin CHARACTERISTIC IVCtl_tiChrgUpIWinNeg_C "#SSD Negatives Kleinsignalfenster für I-Glied (Laden)" VALUE 0xE2E66 Kw_Ws16 200.0000 Time_Busy -100.0000 100.0000 FORMAT "%8.4" EXTENDED_LIMITS -3276.800 3276.700 /end CHARACTERISTIC
/begin CHARACTERISTIC IVCtl_ChrgUpPKp_C "#SSD Kleinsignalverstärkung für P-Glied (Laden)" VALUE 0xE2E68 Kw_Wu32 655359.999847 Kp_us2mA 0.00 655359.999847 FORMAT "%13.6" /end CHARACTERISTIC
/begin CHARACTERISTIC IVCtl_ChrgUpPKpPos_C "#SSD Positive Großsignalverstärkung für P-Glied (Laden)" VALUE 0xE2E6C Kw_Wu32 655359.999847 Kp_us2mA 0.00 655359.999847 FORMAT "%13.6" /end CHARACTERISTIC
/begin CHARACTERISTIC IVCtl_ChrgUpPKpNeg_C "#SSD Negative Großsignalverstärkung für P-Glied (Laden)" VALUE 0xE2E70 Kw_Wu32 655359.999847 Kp_us2mA 0.00 655359.999847 FORMAT "%13.6" /end CHARACTERISTIC
/begin CHARACTERISTIC IVCtl_tiChrgUpPWinPos_C "#SSD Positives Kleinsignalfenster für P-Glied (Laden)" VALUE 0xE2E74 Kw_Ws16 200.0000 Time_Busy -100.0000 100.0000 FORMAT "%8.4" EXTENDED_LIMITS -3276.800 3276.700 /end CHARACTERISTIC
/begin CHARACTERISTIC IVCtl_tiChrgUpPWinNeg_C "#SSD Negatives Kleinsignalfenster für P-Glied (Laden)" VALUE 0xE2E76 Kw_Ws16 200.0000 Time_Busy -100.0000 100.0000 FORMAT "%8.4" EXTENDED_LIMITS -3276.800 3276.700 /end CHARACTERISTIC
/begin CHARACTERISTIC IVCtl_DisChDwnIKi_C "#SSD Kleinsignalverstärkung für I-Glied (Entladen)" VALUE 0xE2E78 Kw_Wu32 9999999.99767 Ki_us2mA 0.00 9999999.99767 FORMAT "%13.5" /end CHARACTERISTIC
/begin CHARACTERISTIC IVCtl_DisChDwnIKiPos_C "#SSD Positive Großsignalverstärkung für I-Glied (Entladen)" VALUE 0xE2E7C Kw_Wu32 9999999.99767 Ki_us2mA 0.00 9999999.99767 FORMAT "%13.5" /end CHARACTERISTIC
/begin CHARACTERISTIC IVCtl_DisChDwnIKiNeg_C "#SSD Negative Großsignalverstärkung für I-Glied (Entladen)" VALUE 0xE2E80 Kw_Wu32 9999999.99767 Ki_us2mA 0.00 9999999.99767 FORMAT "%13.5" /end CHARACTERISTIC
/begin CHARACTERISTIC IVCtl_tiDisChDwnIWinPos_C "#SSD Positives Kleinsignalfenster für I-Glied (Entladen)" VALUE 0xE2E84 Kw_Ws16 200.0000 Time_Busy -100.0000 100.0000 FORMAT "%8.4" EXTENDED_LIMITS -3276.800 3276.700 /end CHARACTERISTIC
/begin CHARACTERISTIC IVCtl_tiDisChDwnIWinNeg_C "#SSD Negatives Kleinsignalfenster für I-Glied (Entladen)" VALUE 0xE2E86 Kw_Ws16 200.0000 Time_Busy -100.0000 100.0000 FORMAT "%8.4" EXTENDED_LIMITS -3276.800 3276.700 /end CHARACTERISTIC
/begin CHARACTERISTIC IVCtl_DisChDwnPKp_C "#SSD Kleinsignalverstärkung für P-Glied (Entladen)" VALUE 0xE2E88 Kw_Wu32 655359.999847 Kp_us2mA 0.00 655359.999847 FORMAT "%13.6" /end CHARACTERISTIC
/begin CHARACTERISTIC IVCtl_DisChDwnPKpPos_C "#SSD Positive Großsignalverstärkung für P-Glied (Entladen)" VALUE 0xE2E8C Kw_Wu32 655359.999847 Kp_us2mA 0.00 655359.999847 FORMAT "%13.6" /end CHARACTERISTIC
/begin CHARACTERISTIC IVCtl_DisChDwnPKpNeg_C "#SSD Negative Großsignalverstärkung für P-Glied (Entladen)" VALUE 0xE2E90 Kw_Wu32 655359.999847 Kp_us2mA 0.00 655359.999847 FORMAT "%13.6" /end CHARACTERISTIC
/begin CHARACTERISTIC IVCtl_tiDisChDwnPWinPos_C "#SSD Positives Kleinsignalfenster für P-Glied (Entladen)" VALUE 0xE2E94 Kw_Ws16 200.0000 Time_Busy -100.0000 100.0000 FORMAT "%8.4" EXTENDED_LIMITS -3276.800 3276.700 /end CHARACTERISTIC
/begin CHARACTERISTIC IVCtl_tiDisChDwnPWinNeg_C "#SSD Negatives Kleinsignalfenster für P-Glied (Entladen)" VALUE 0xE2E96 Kw_Ws16 200.0000 Time_Busy -100.0000 100.0000 FORMAT "%8.4" EXTENDED_LIMITS -3276.800 3276.700 /end CHARACTERISTIC
/begin CHARACTERISTIC IVCtl_iChrgUpCls_C "#SSD Vorgabewert für obere Stromgrenze (Klassifizierung)" VALUE 0xE2E98 Kw_Ws16 30000.00 Curr 0.00 30000.00 FORMAT "%8.2" EXTENDED_LIMITS -32768.00 32767.00 /end CHARACTERISTIC
/begin CHARACTERISTIC IVCtl_iChrgUpGovMax_C "#SSD Maximaler Strom für Ausgang Ladezeitregler" VALUE 0xE2E9A Kw_Ws16 6000.000 Curr -3000.000 3000.000 FORMAT "%8.3" EXTENDED_LIMITS -32768.00 32767.00 /end CHARACTERISTIC
/begin CHARACTERISTIC IVCtl_iChrgUpGovMin_C "#SSD Minimaler Strom für Ausgang Ladezeitregler" VALUE 0xE2E9C Kw_Ws16 6000.000 Curr -3000.000 3000.000 FORMAT "%8.3" EXTENDED_LIMITS -32768.00 32767.00 /end CHARACTERISTIC
/begin CHARACTERISTIC IVCtl_iChrgUpInitI_C "#SSD Initialisierungswert für Ladezeitregler" VALUE 0xE2E9E Kw_Ws16 6000.000 Curr -3000.000 3000.000 FORMAT "%8.3" EXTENDED_LIMITS -32768.00 32767.00 /end CHARACTERISTIC
/begin CHARACTERISTIC IVCtl_iChrgUpMax_C "#SSD Maximaler Ladestrom für Aktor" VALUE 0xE2EA0 Kw_Ws16 30000.00 Curr 0.00 30000.00 FORMAT "%8.2" EXTENDED_LIMITS -32768.00 32767.00 /end CHARACTERISTIC
/begin CHARACTERISTIC IVCtl_iChrgUpMin_C "#SSD Minimaler Ladestrom für Aktor" VALUE 0xE2EA2 Kw_Ws16 30000.00 Curr 0.00 30000.00 FORMAT "%8.2" EXTENDED_LIMITS -32768.00 32767.00 /end CHARACTERISTIC
/begin CHARACTERISTIC IVCtl_iChrgUp_MAP "Kennfeld zur spannungs- und raildruckabhängigen Sollwertvorgabe der Ladezeit" MAP 0xE2EA4 Kf_Xs16_Ys16_Ws16 30000.00 Curr 0.00 30000.00 FORMAT "%8.2" EXTENDED_LIMITS -32768.00 32767.00
 /begin AXIS_DESCR STD_AXIS IVCtl_uSetUpAvrg_mp Volt_PA 25 0.00 250.0000 FORMAT "%8.4" EXTENDED_LIMITS -327.6800 327.6700 DEPOSIT ABSOLUTE /end AXIS_DESCR
 /begin AXIS_DESCR STD_AXIS RailCD_pPeak Pres_Rail 2 -3276.800 3276.700 FORMAT "%5.3" DEPOSIT ABSOLUTE /end AXIS_DESCR
/end CHARACTERISTIC
/begin CHARACTERISTIC IVCtl_iDisChDwnCls_C "#SSD Vorgabewert für untere Stromgrenze (Klassifizierung)" VALUE 0xE2F42 Kw_Ws16 30000.00 Curr -30000.00 0.00 FORMAT "%8.2" EXTENDED_LIMITS -32768.00 32767.00 /end CHARACTERISTIC
/begin CHARACTERISTIC IVCtl_iDisChDwnGovMax_C "#SSD Maximaler Strom für Ausgang Entladezeitregler" VALUE 0xE2F44 Kw_Ws16 6000.000 Curr -3000.000 3000.000 FORMAT "%8.3" EXTENDED_LIMITS -32768.00 32767.00 /end CHARACTERISTIC
/begin CHARACTERISTIC IVCtl_iDisChDwnGovMin_C "#SSD Minimaler Strom für Ausgang Entladezeitregler" VALUE 0xE2F46 Kw_Ws16 6000.000 Curr -3000.000 3000.000 FORMAT "%8.3" EXTENDED_LIMITS -32768.00 32767.00 /end CHARACTERISTIC
/begin CHARACTERISTIC IVCtl_iDisChDwnInitI_C "#SSD Initialisierungswert für Entladezeitregler" VALUE 0xE2F48 Kw_Ws16 6000.000 Curr -3000.000 3000.000 FORMAT "%8.3" EXTENDED_LIMITS -32768.00 32767.00 /end CHARACTERISTIC
/begin CHARACTERISTIC IVCtl_iDisChDwnMax_C "#SSD Maximaler Entladestrom" VALUE 0xE2F4A Kw_Ws16 30000.00 Curr -30000.00 0.00 FORMAT "%8.2" EXTENDED_LIMITS -32768.00 32767.00 /end CHARACTERISTIC
/begin CHARACTERISTIC IVCtl_iDisChDwnMin_C "#SSD Minimaler Entladestrom" VALUE 0xE2F4C Kw_Ws16 30000.00 Curr -30000.00 0.00 FORMAT "%8.2" EXTENDED_LIMITS -32768.00 32767.00 /end CHARACTERISTIC
/begin CHARACTERISTIC IVCtl_iDisChDwn_CUR "#SSD KL für Entladestromgrenze" CURVE 0xE2F4E Kl_Xs16_Ws16 30000.00 Curr -30000.00 0.00 FORMAT "%8.2" EXTENDED_LIMITS -32768.00 32767.00
 /begin AXIS_DESCR STD_AXIS IVCtl_uSetUpAvrg_mp Volt_PA 25 0.00 250.0000 FORMAT "%8.4" EXTENDED_LIMITS -327.6800 327.6700 DEPOSIT ABSOLUTE /end AXIS_DESCR
/end CHARACTERISTIC
/begin CHARACTERISTIC IVCtl_IKi_C "#SSD Integrationsbeiwert Ki für Kleinsignale" VALUE 0xE2FF0 Kw_Wu32 999999.999767 Ki 0.00 999999.999767 FORMAT "%13.6" /end CHARACTERISTIC
/begin CHARACTERISTIC IVCtl_IKiPos_C "#SSD Integrationsbeiwert für positive Großsignale" VALUE 0xE2FF4 Kw_Wu32 999999.999767 Ki 0.00 999999.999767 FORMAT "%13.6" /end CHARACTERISTIC
/begin CHARACTERISTIC IVCtl_IKiNeg_C "#SSD Integrationsbeiwert für negative Großsignale" VALUE 0xE2FF8 Kw_Wu32 999999.999767 Ki 0.00 999999.999767 FORMAT "%13.6" /end CHARACTERISTIC
/begin CHARACTERISTIC IVCtl_uIWinPos_C "#SSD Obere Grenze Kleinsignal zu Großsignal I-Regler" VALUE 0xE2FFC Kw_Ws16 655.3500 Volt_PA -327.6800 327.6700 FORMAT "%8.4" /end CHARACTERISTIC
/begin CHARACTERISTIC IVCtl_uIWinNeg_C "#SSD Untere Grenze Kleinsignal zu Großsignal I-Regler" VALUE 0xE2FFE Kw_Ws16 655.3500 Volt_PA -327.6800 327.6700 FORMAT "%8.4" /end CHARACTERISTIC
/begin CHARACTERISTIC IVCtl_PKp_C "#SSD Verstärkung Kleinsignal" VALUE 0xE3000 Kw_Wu32 65535.9999847 Kp 0.00 65535.9999847 FORMAT "%13.7" /end CHARACTERISTIC
/begin CHARACTERISTIC IVCtl_PKpPos_C "#SSD Verstärkung positives Großsignal" VALUE 0xE3004 Kw_Wu32 65535.9999847 Kp 0.00 65535.9999847 FORMAT "%13.7" /end CHARACTERISTIC
/begin CHARACTERISTIC IVCtl_PKpNeg_C "#SSD Verstärkung negatives Großsignal" VALUE 0xE3008 Kw_Wu32 65535.9999847 Kp 0.00 65535.9999847 FORMAT "%13.7" /end CHARACTERISTIC
/begin CHARACTERISTIC IVCtl_uPWinPos_C "#SSD Obere Grenze Kleinsignal zu Großsignal P-Regler" VALUE 0xE300C Kw_Ws16 655.3500 Volt_PA -327.6800 327.6700 FORMAT "%8.4" /end CHARACTERISTIC
/begin CHARACTERISTIC IVCtl_uPWinNeg_C "#SSD Untere Grenze Kleinsignal zu Großsignal P-Regler" VALUE 0xE300E Kw_Ws16 655.3500 Volt_PA -327.6800 327.6700 FORMAT "%8.4" /end CHARACTERISTIC
/begin CHARACTERISTIC IVCtl_swtAvrgEnaTiWarnVolt_C "zylinderspezifischer Schalter, um die Message InjVCD_stAvrgEnaTiWarn für dien Voltregler als Freigabekriterium zu aktivieren" VALUE 0xE3010 Kw_Wu8 255.0 OneToOne 0.00 255.0 FORMAT "%5.1" /end CHARACTERISTIC
/begin CHARACTERISTIC IVCtl_swtTiChrgMinMaxActr_C "Schalter zur Aktivierung der Berechnung der Min.-/Max.-Regelabweichung der Lade-/Entladezeit (aktorspezifisch)" VALUE 0xE2FB4 Kw_Wu8 1.000 OneToOne 0.00 1.000 FORMAT "%5.3" EXTENDED_LIMITS 0.00 255.0 /end CHARACTERISTIC
/begin CHARACTERISTIC IVCtl_swtTiChrgMinMaxRst_C "Schalter zum Rücksetzen der Berechnung Min.-/Max.-Regelabweichung von Lade-/Entladezeit" VALUE 0xE2FB5 Kw_Wu8 1.000 OneToOne 0.00 1.000 FORMAT "%5.3" EXTENDED_LIMITS 0.00 255.0 /end CHARACTERISTIC
/begin CHARACTERISTIC IVCtl_swtTiChrgMinMax_C "Schalter zur Aktivierung der Berechnung der Min.-/Max.-Regelabweichung der Lade-/Entladezeit (gemittelt)" VALUE 0xE2FB6 Kw_Wu8 1.000 OneToOne 0.00 1.000 FORMAT "%5.3" EXTENDED_LIMITS 0.00 255.0 /end CHARACTERISTIC
/begin CHARACTERISTIC IVCtl_swtUUpMinMaxActr_C "Schalter zur Aktivierung der Berechnung von Min.-/Max.-Regelabweichung der Spannung  (aktorspezifisch)" VALUE 0xE3011 Kw_Wu8 1.000 OneToOne 0.00 1.000 FORMAT "%5.3" EXTENDED_LIMITS 0.00 255.0 /end CHARACTERISTIC
/begin CHARACTERISTIC IVCtl_swtUUpMinMaxRst_C "Schalter zum Rücksetzen der Berechnung Min.-/Max.-Regelabweichung der Spannung" VALUE 0xE3012 Kw_Wu8 1.000 OneToOne 0.00 1.000 FORMAT "%5.3" EXTENDED_LIMITS 0.00 255.0 /end CHARACTERISTIC
/begin CHARACTERISTIC IVCtl_swtUUpMinMax_C "Schalter zur Aktivierung der Berechnung von Min.-/Max.-Regelabweichung der Spannung  (gemittelt)" VALUE 0xE3013 Kw_Wu8 1.000 OneToOne 0.00 1.000 FORMAT "%5.3" EXTENDED_LIMITS 0.00 255.0 /end CHARACTERISTIC
/begin CHARACTERISTIC IVCtl_tiChrgSetUp_MAP "Kennfeld zur spannungs- und raildruckabhängigen Sollwertvorgabe des Aktor-Ladestroms" MAP 0xE2FB8 Kf_Xs16_Ys16_Ws16 400.0000 Time_Busy 0.00 400.0000 FORMAT "%8.4" EXTENDED_LIMITS -3276.800 3276.700
 /begin AXIS_DESCR STD_AXIS IVCtl_uSetUpAvrg_mp Volt_PA 4 0.00 250.0000 FORMAT "%8.4" EXTENDED_LIMITS -327.6800 327.6700 DEPOSIT ABSOLUTE /end AXIS_DESCR
 /begin AXIS_DESCR STD_AXIS RailCD_pPeak Pres_Rail 2 -3276.800 3276.700 FORMAT "%5.3" DEPOSIT ABSOLUTE /end AXIS_DESCR
/end CHARACTERISTIC
/begin CHARACTERISTIC IVCtl_tiChrgUpPse_C "#SSD Vorgabewert der Pausezeit für Ladezeitregelung" VALUE 0xE2FD8 Kw_Ws16 400.0000 Time_Busy 0.00 400.0000 FORMAT "%8.4" EXTENDED_LIMITS -3276.800 3276.700 /end CHARACTERISTIC
/begin CHARACTERISTIC IVCtl_tiDisChDwnPse_C "#SSD Vorgabewert der Pausezeit für Entladezeitregelung" VALUE 0xE2FDA Kw_Ws16 400.0000 Time_Busy 0.00 400.0000 FORMAT "%8.4" EXTENDED_LIMITS -3276.800 3276.700 /end CHARACTERISTIC
/begin CHARACTERISTIC IVCtl_tiDisChSetDwn_CUR "#SSD Kennlinie zur spannungsabhängigen Sollwertvorgabe der Entladezeit" CURVE 0xE2FDC Kl_Xs16_Ws16 400.0000 Time_Busy 0.00 400.0000 FORMAT "%8.4" EXTENDED_LIMITS -3276.800 3276.700
 /begin AXIS_DESCR STD_AXIS IVCtl_uSetUpAvrg_mp Volt_PA 4 -250.0000 250.0000 FORMAT "%8.4" EXTENDED_LIMITS -327.6800 327.6700 DEPOSIT ABSOLUTE /end AXIS_DESCR
/end CHARACTERISTIC
/begin CHARACTERISTIC IVCtl_uClsActrUp_C "#SSD Sollspannung für den Piezoaktor während der Klassifizierung im Steuergerätenachlauf" VALUE 0xE3014 Kw_Ws16 500.0000 Volt_PA -250.0000 250.0000 FORMAT "%8.4" EXTENDED_LIMITS -327.6800 327.6700 /end CHARACTERISTIC
/begin CHARACTERISTIC IVCtl_uMaxSetUp_C "#SSD Obere Begrenzung  des korrigierten Spannungssollwertes (up-level)" VALUE 0xE3016 Kw_Ws16 250.0000 Volt_PA 0.00 250.0000 FORMAT "%8.4" EXTENDED_LIMITS -327.6800 327.6700 /end CHARACTERISTIC
/begin CHARACTERISTIC IVCtl_uMinSetUp_C "#SSD Untere Begrenzung  des korrigierten Spannungssollwertes (up-level)" VALUE 0xE3018 Kw_Ws16 250.0000 Volt_PA 0.00 250.0000 FORMAT "%8.4" EXTENDED_LIMITS -327.6800 327.6700 /end CHARACTERISTIC
/begin CHARACTERISTIC IVCtl_uPIMax_C "#SSD Maximaler Reglerausgang Spannungssollwert" VALUE 0xE301A Kw_Ws16 500.0000 Volt_PA -250.0000 250.0000 FORMAT "%8.4" EXTENDED_LIMITS -327.6800 327.6700 /end CHARACTERISTIC
/begin CHARACTERISTIC IVCtl_uPIMin_C "#SSD Minimaler Reglerausgang Spannungssollwert" VALUE 0xE301C Kw_Ws16 500.0000 Volt_PA -250.0000 250.0000 FORMAT "%8.4" EXTENDED_LIMITS -327.6800 327.6700 /end CHARACTERISTIC
/begin CHARACTERISTIC IVCtl_uSetUpPreCtl_CUR "#SSD Vorsteuerkennlinie für Spannungssollwertberechnung" CURVE 0xE301E Kl_Xs16_Ws16 250.0000 Volt_PA 0.00 250.0000 FORMAT "%8.4" EXTENDED_LIMITS -327.6800 327.6700
 /begin AXIS_DESCR STD_AXIS InjVlv_pCalcVolt Pres_Rail 20 -3276.800 3276.700 FORMAT "%5.3" DEPOSIT ABSOLUTE /end AXIS_DESCR
/end CHARACTERISTIC
/begin CHARACTERISTIC IVCtl_uUpInitI_C "#SSD Initialisierungswert für PI-Regler (up-Niveau)" VALUE 0xE3070 Kw_Ws16 500.0000 Volt_PA -250.0000 250.0000 FORMAT "%8.4" EXTENDED_LIMITS -327.6800 327.6700 /end CHARACTERISTIC
/begin CHARACTERISTIC K2RDLI_dDataSetVer_C "Array für Datensatzversion" ASCII 0xC04C4 Kwb_Wu8 255.0 defaultAscii 0.00 255.0 NUMBER 10 /end CHARACTERISTIC
/begin CHARACTERISTIC Layer_APPVARBN_C "" VALUE 0xE3076 Kw_Wu8 255.0 OneToOne 0.00 255.0 FORMAT "%5.1" /end CHARACTERISTIC
/begin CHARACTERISTIC Layer_APPVARVEH_C "" VALUE 0xE3077 Kw_Wu8 255.0 OneToOne 0.00 255.0 FORMAT "%5.1" /end CHARACTERISTIC
/begin CHARACTERISTIC Layer_ctDebBSDStep_C "" VALUE 0xE30A4 Kw_Wu8 255.0 OneToOne 0.00 255.0 FORMAT "%5.1" /end CHARACTERISTIC
/begin CHARACTERISTIC Layer_ctDebGENStep_C "" VALUE 0xE30A5 Kw_Wu8 255.0 OneToOne 0.00 255.0 FORMAT "%5.1" /end CHARACTERISTIC
/begin CHARACTERISTIC Layer_ctDebIBS1Step_C "" VALUE 0xE30A6 Kw_Wu8 255.0 OneToOne 0.00 255.0 FORMAT "%5.1" /end CHARACTERISTIC
/begin CHARACTERISTIC Layer_ctDebIBS2Step_C "" VALUE 0xE30A7 Kw_Wu8 255.0 OneToOne 0.00 255.0 FORMAT "%5.1" /end CHARACTERISTIC
/begin CHARACTERISTIC Layer_ctDebIBS3Step_C "" VALUE 0xE30A8 Kw_Wu8 255.0 OneToOne 0.00 255.0 FORMAT "%5.1" /end CHARACTERISTIC
/begin CHARACTERISTIC Layer_ctDebMANHYDRStep_C "" VALUE 0xE30A9 Kw_Wu8 255.0 OneToOne 0.00 255.0 FORMAT "%5.1" /end CHARACTERISTIC
/begin CHARACTERISTIC Layer_ctDebMANLUFTStep_C "" VALUE 0xE30AA Kw_Wu8 255.0 OneToOne 0.00 255.0 FORMAT "%5.1" /end CHARACTERISTIC
/begin CHARACTERISTIC Layer_ctDebPMBATTStep_C "" VALUE 0xE30AB Kw_Wu8 255.0 OneToOne 0.00 255.0 FORMAT "%5.1" /end CHARACTERISTIC
/begin CHARACTERISTIC Layer_ctDebPMBNStep_C "" VALUE 0xE30AC Kw_Wu8 255.0 OneToOne 0.00 255.0 FORMAT "%5.1" /end CHARACTERISTIC
/begin CHARACTERISTIC Layer_ctDebPMRUHVERLStep_C "" VALUE 0xE30AD Kw_Wu8 255.0 OneToOne 0.00 255.0 FORMAT "%5.1" /end CHARACTERISTIC
/begin CHARACTERISTIC Layer_ctDebQLTStep_C "" VALUE 0xE30AE Kw_Wu8 255.0 OneToOne 0.00 255.0 FORMAT "%5.1" /end CHARACTERISTIC
/begin CHARACTERISTIC Layer_ctDebTANSStep_C "" VALUE 0xE30AF Kw_Wu8 255.0 OneToOne 0.00 255.0 FORMAT "%5.1" /end CHARACTERISTIC
/begin CHARACTERISTIC Layer_ctDebTOENSStep_C "" VALUE 0xE30B0 Kw_Wu8 255.0 OneToOne 0.00 255.0 FORMAT "%5.1" /end CHARACTERISTIC
/begin CHARACTERISTIC Layer_ctDebTUMGStep_C "" VALUE 0xE30B1 Kw_Wu8 255.0 OneToOne 0.00 255.0 FORMAT "%5.1" /end CHARACTERISTIC
/begin CHARACTERISTIC Layer_ctDebBSDDef_C "" VALUE 0xE30B2 Kw_Wu16 65535.00 OneToOne 0.00 65535.00 FORMAT "%8.2" /end CHARACTERISTIC
/begin CHARACTERISTIC Layer_ctDebBSDOk_C "" VALUE 0xE30B4 Kw_Wu16 65535.00 OneToOne 0.00 65535.00 FORMAT "%8.2" /end CHARACTERISTIC
/begin CHARACTERISTIC Layer_ctDebGENDef_C "" VALUE 0xE30B6 Kw_Wu16 65535.00 OneToOne 0.00 65535.00 FORMAT "%8.2" /end CHARACTERISTIC
/begin CHARACTERISTIC Layer_ctDebGENOk_C "" VALUE 0xE30B8 Kw_Wu16 65535.00 OneToOne 0.00 65535.00 FORMAT "%8.2" /end CHARACTERISTIC
/begin CHARACTERISTIC Layer_ctDebIBS1Def_C "" VALUE 0xE30BA Kw_Wu16 65535.00 OneToOne 0.00 65535.00 FORMAT "%8.2" /end CHARACTERISTIC
/begin CHARACTERISTIC Layer_ctDebIBS1Ok_C "" VALUE 0xE30BC Kw_Wu16 65535.00 OneToOne 0.00 65535.00 FORMAT "%8.2" /end CHARACTERISTIC
/begin CHARACTERISTIC Layer_ctDebIBS2Def_C "" VALUE 0xE30BE Kw_Wu16 65535.00 OneToOne 0.00 65535.00 FORMAT "%8.2" /end CHARACTERISTIC
/begin CHARACTERISTIC Layer_ctDebIBS2Ok_C "" VALUE 0xE30C0 Kw_Wu16 65535.00 OneToOne 0.00 65535.00 FORMAT "%8.2" /end CHARACTERISTIC
/begin CHARACTERISTIC Layer_ctDebIBS3Def_C "" VALUE 0xE30C2 Kw_Wu16 65535.00 OneToOne 0.00 65535.00 FORMAT "%8.2" /end CHARACTERISTIC
/begin CHARACTERISTIC Layer_ctDebIBS3Ok_C "" VALUE 0xE30C4 Kw_Wu16 65535.00 OneToOne 0.00 65535.00 FORMAT "%8.2" /end CHARACTERISTIC
/begin CHARACTERISTIC Layer_ctDebMANHYDRDef_C "" VALUE 0xE30C6 Kw_Wu16 65535.00 OneToOne 0.00 65535.00 FORMAT "%8.2" /end CHARACTERISTIC
/begin CHARACTERISTIC Layer_ctDebMANHYDROk_C "" VALUE 0xE30C8 Kw_Wu16 65535.00 OneToOne 0.00 65535.00 FORMAT "%8.2" /end CHARACTERISTIC
/begin CHARACTERISTIC Layer_ctDebMANLUFTDef_C "" VALUE 0xE30CA Kw_Wu16 65535.00 OneToOne 0.00 65535.00 FORMAT "%8.2" /end CHARACTERISTIC
/begin CHARACTERISTIC Layer_ctDebMANLUFTOk_C "" VALUE 0xE30CC Kw_Wu16 65535.00 OneToOne 0.00 65535.00 FORMAT "%8.2" /end CHARACTERISTIC
/begin CHARACTERISTIC Layer_ctDebPMBATTDef_C "" VALUE 0xE30CE Kw_Wu16 65535.00 OneToOne 0.00 65535.00 FORMAT "%8.2" /end CHARACTERISTIC
/begin CHARACTERISTIC Layer_ctDebPMBATTOk_C "" VALUE 0xE30D0 Kw_Wu16 65535.00 OneToOne 0.00 65535.00 FORMAT "%8.2" /end CHARACTERISTIC
/begin CHARACTERISTIC Layer_ctDebPMBNDef_C "" VALUE 0xE30D2 Kw_Wu16 65535.00 OneToOne 0.00 65535.00 FORMAT "%8.2" /end CHARACTERISTIC
/begin CHARACTERISTIC Layer_ctDebPMBNOk_C "" VALUE 0xE30D4 Kw_Wu16 65535.00 OneToOne 0.00 65535.00 FORMAT "%8.2" /end CHARACTERISTIC
/begin CHARACTERISTIC Layer_ctDebPMRUHVERLDef_C "" VALUE 0xE30D6 Kw_Wu16 65535.00 OneToOne 0.00 65535.00 FORMAT "%8.2" /end CHARACTERISTIC
/begin CHARACTERISTIC Layer_ctDebPMRUHVERLOk_C "" VALUE 0xE30D8 Kw_Wu16 65535.00 OneToOne 0.00 65535.00 FORMAT "%8.2" /end CHARACTERISTIC
/begin CHARACTERISTIC Layer_ctDebQLTDef_C "" VALUE 0xE30DA Kw_Wu16 65535.00 OneToOne 0.00 65535.00 FORMAT "%8.2" /end CHARACTERISTIC
/begin CHARACTERISTIC Layer_ctDebQLTOk_C "" VALUE 0xE30DC Kw_Wu16 65535.00 OneToOne 0.00 65535.00 FORMAT "%8.2" /end CHARACTERISTIC
/begin CHARACTERISTIC Layer_ctDebTANSDef_C "" VALUE 0xE30DE Kw_Wu16 65535.00 OneToOne 0.00 65535.00 FORMAT "%8.2" /end CHARACTERISTIC
/begin CHARACTERISTIC Layer_ctDebTANSOk_C "" VALUE 0xE30E0 Kw_Wu16 65535.00 OneToOne 0.00 65535.00 FORMAT "%8.2" /end CHARACTERISTIC
/begin CHARACTERISTIC Layer_ctDebTOENSDef_C "" VALUE 0xE30E2 Kw_Wu16 65535.00 OneToOne 0.00 65535.00 FORMAT "%8.2" /end CHARACTERISTIC
/begin CHARACTERISTIC Layer_ctDebTOENSOk_C "" VALUE 0xE30E4 Kw_Wu16 65535.00 OneToOne 0.00 65535.00 FORMAT "%8.2" /end CHARACTERISTIC
/begin CHARACTERISTIC Layer_ctDebTUMGDef_C "" VALUE 0xE30E6 Kw_Wu16 65535.00 OneToOne 0.00 65535.00 FORMAT "%8.2" /end CHARACTERISTIC
/begin CHARACTERISTIC Layer_ctDebTUMGOk_C "" VALUE 0xE30E8 Kw_Wu16 65535.00 OneToOne 0.00 65535.00 FORMAT "%8.2" /end CHARACTERISTIC
/begin CHARACTERISTIC Layer_swtB_bsdprot "" VALUE 0xE3078 Kw_Wu8 255.0 OneToOne 0.00 255.0 FORMAT "%5.1" /end CHARACTERISTIC
/begin CHARACTERISTIC Layer_swtTunProt_C "" VALUE 0xE3079 Kw_Wu8 1.000 OneToOne 0.00 1.000 FORMAT "%5.3" EXTENDED_LIMITS 0.00 255.0 /end CHARACTERISTIC
/begin CHARACTERISTIC LIGov_tiCldCltchDT1_C "Koeffizient D-Glied (T)" VALUE 0xE3430 Kw_Wu32 4294.9673 TimeDelay_s 0.0000010000000 4294.9673 FORMAT "%9.4" /end CHARACTERISTIC
/begin CHARACTERISTIC LIGov_CldCltchDKd_C "Koeffizient D-Glied (K)" VALUE 0xE3434 Kw_Ws32 6553.59999847 Kd_rpm2Nm -3276.80000000 3276.79999847 FORMAT "%13.8" /end CHARACTERISTIC
/begin CHARACTERISTIC LIGov_CldCltchFlt1T1_C "T1 Komponente für erstes PDT1-Glied wenn ausgekuppelt und Motor kalt" VALUE 0xE30EC Kw_Wu32 4294.9673 TimeDelay_s 0.0000010000000 4294.9673 FORMAT "%9.4" /end CHARACTERISTIC
/begin CHARACTERISTIC LIGov_CldCltchFlt2T1_C "T1 Komponente für zweites PDT1-Glied wenn ausgekuppelt und Motor kalt" VALUE 0xE30F0 Kw_Wu32 4294.9673 TimeDelay_s 0.0000010000000 4294.9673 FORMAT "%9.4" /end CHARACTERISTIC
/begin CHARACTERISTIC LIGov_CldCltchIKi_C "Kleinsignalverstärkung" VALUE 0xE30F4 Kw_Wu32 799999.999814 Ki_rpm2Nm 0.00 799999.999814 FORMAT "%13.6" /end CHARACTERISTIC
/begin CHARACTERISTIC LIGov_CldCltchIKiPos_C "Verstärkung für positive Großsignale" VALUE 0xE30F8 Kw_Wu32 799999.999814 Ki_rpm2Nm 0.00 799999.999814 FORMAT "%13.6" /end CHARACTERISTIC
/begin CHARACTERISTIC LIGov_CldCltchIKiNeg_C "Verstärkung für negative Großsignale" VALUE 0xE30FC Kw_Wu32 799999.999814 Ki_rpm2Nm 0.00 799999.999814 FORMAT "%13.6" /end CHARACTERISTIC
/begin CHARACTERISTIC LIGov_CldCltchIWinPos_C "Kleinsignalfenster positiv" VALUE 0xE3100 Kw_Ws16 8191.875 EngN_HiRes -4096.000 4095.875 FORMAT "%8.3" /end CHARACTERISTIC
/begin CHARACTERISTIC LIGov_CldCltchIWinNeg_C "Kleinsignalfenster negativ" VALUE 0xE3102 Kw_Ws16 8191.875 EngN_HiRes -4096.000 4095.875 FORMAT "%8.3" /end CHARACTERISTIC
/begin CHARACTERISTIC LIGov_CldCltchPredef_C "Einschrittmoment Vorsteuerung" VALUE 0xE3104 Kw_Ws16 6553.500 Trq -3276.800 3276.700 FORMAT "%8.3" /end CHARACTERISTIC
/begin CHARACTERISTIC LIGov_CldCltchPKp_C "Kleinsignalverstärkung" VALUE 0xE3108 Kw_Wu32 52428.7999878 Kp_rpm2Nm 0.00 52428.7999878 FORMAT "%13.7" /end CHARACTERISTIC
/begin CHARACTERISTIC LIGov_CldCltchPKpPos_C "Verstärkung für positive Großsignale" VALUE 0xE310C Kw_Wu32 52428.7999878 Kp_rpm2Nm 0.00 52428.7999878 FORMAT "%13.7" /end CHARACTERISTIC
/begin CHARACTERISTIC LIGov_CldCltchPKpNeg_C "Verstärkung für negative Großsignale" VALUE 0xE3110 Kw_Wu32 52428.7999878 Kp_rpm2Nm 0.00 52428.7999878 FORMAT "%13.7" /end CHARACTERISTIC
/begin CHARACTERISTIC LIGov_CldCltchPWinPos_C "Kleinsignalfenster positiv" VALUE 0xE3114 Kw_Ws16 8191.875 EngN_HiRes -4096.000 4095.875 FORMAT "%8.3" /end CHARACTERISTIC
/begin CHARACTERISTIC LIGov_CldCltchPWinNeg_C "Kleinsignalfenster negativ" VALUE 0xE3116 Kw_Ws16 8191.875 EngN_HiRes -4096.000 4095.875 FORMAT "%8.3" /end CHARACTERISTIC
/begin CHARACTERISTIC LIGov_tiCldGearDT1_C "Koeffizient D-Glied (T)" VALUE 0xE3118 Kw_Wu32 4294.9673 TimeDelay_s 0.0000010000000 4294.9673 FORMAT "%9.4" /end CHARACTERISTIC
/begin CHARACTERISTIC LIGov_CldGearDKd_C "Koeffizient D-Glied (K)" VALUE 0xE311C Kw_Ws32 6553.59999847 Kd_rpm2Nm -3276.80000000 3276.79999847 FORMAT "%13.8" /end CHARACTERISTIC
/begin CHARACTERISTIC LIGov_CldGearIKi_C "Kleinsignalverstärkung" VALUE 0xE3120 Kw_Wu32 799999.999814 Ki_rpm2Nm 0.00 799999.999814 FORMAT "%13.6" /end CHARACTERISTIC
/begin CHARACTERISTIC LIGov_CldGearIKiPos_C "Verstärkung für positive Großsignale" VALUE 0xE3124 Kw_Wu32 799999.999814 Ki_rpm2Nm 0.00 799999.999814 FORMAT "%13.6" /end CHARACTERISTIC
/begin CHARACTERISTIC LIGov_CldGearIKiNeg_C "Verstärkung für negative Großsignale" VALUE 0xE3128 Kw_Wu32 799999.999814 Ki_rpm2Nm 0.00 799999.999814 FORMAT "%13.6" /end CHARACTERISTIC
/begin CHARACTERISTIC LIGov_CldGearIWinPos_C "Kleinsignalfenster positiv" VALUE 0xE312C Kw_Ws16 8191.875 EngN_HiRes -4096.000 4095.875 FORMAT "%8.3" /end CHARACTERISTIC
/begin CHARACTERISTIC LIGov_CldGearIWinNeg_C "Kleinsignalfenster negativ" VALUE 0xE312E Kw_Ws16 8191.875 EngN_HiRes -4096.000 4095.875 FORMAT "%8.3" /end CHARACTERISTIC
/begin CHARACTERISTIC LIGov_CldGearPredef_C "Einschrittmoment Vorsteuerung" VALUE 0xE3130 Kw_Ws16 6553.500 Trq -3276.800 3276.700 FORMAT "%8.3" /end CHARACTERISTIC
/begin CHARACTERISTIC LIGov_CldGearPKp_C "Kleinsignalverstärkung" VALUE 0xE3134 Kw_Wu32 52428.7999878 Kp_rpm2Nm 0.00 52428.7999878 FORMAT "%13.7" /end CHARACTERISTIC
/begin CHARACTERISTIC LIGov_CldGearPKpPos_C "Verstärkung für positive Großsignale" VALUE 0xE3138 Kw_Wu32 52428.7999878 Kp_rpm2Nm 0.00 52428.7999878 FORMAT "%13.7" /end CHARACTERISTIC
/begin CHARACTERISTIC LIGov_CldGearPKpNeg_C "Verstärkung für negative Großsignale" VALUE 0xE313C Kw_Wu32 52428.7999878 Kp_rpm2Nm 0.00 52428.7999878 FORMAT "%13.7" /end CHARACTERISTIC
/begin CHARACTERISTIC LIGov_CldGearPWinPos_C "Kleinsignalfenster positiv" VALUE 0xE3140 Kw_Ws16 8191.875 EngN_HiRes -4096.000 4095.875 FORMAT "%8.3" /end CHARACTERISTIC
/begin CHARACTERISTIC LIGov_CldGearPWinNeg_C "Kleinsignalfenster negativ" VALUE 0xE3142 Kw_Ws16 8191.875 EngN_HiRes -4096.000 4095.875 FORMAT "%8.3" /end CHARACTERISTIC
/begin CHARACTERISTIC LIGov_dnLimHighTrm_C "obere dn-Grenze für Abgleich" VALUE 0xE3328 Kw_Ws16 65535.00 EngN -32768.00 32767.00 FORMAT "%8.2" /end CHARACTERISTIC
/begin CHARACTERISTIC LIGov_dnLimLowTrm_C "untere dn-Grenze für Abgleich" VALUE 0xE332A Kw_Ws16 65535.00 EngN -32768.00 32767.00 FORMAT "%8.2" /end CHARACTERISTIC
/begin CHARACTERISTIC LIGov_tiGear1DT1_C "Koeffizient D-Glied (T)" VALUE 0xE3144 Kw_Wu32 4294.9673 TimeDelay_s 0.0000010000000 4294.9673 FORMAT "%9.4" /end CHARACTERISTIC
/begin CHARACTERISTIC LIGov_Gear1DKd_C "Koeffizient D-Glied (K)" VALUE 0xE3148 Kw_Ws32 6553.59999847 Kd_rpm2Nm -3276.80000000 3276.79999847 FORMAT "%13.8" /end CHARACTERISTIC
/begin CHARACTERISTIC LIGov_Gear1Flt1T1_C "T1 Komponente für erstes PDT1-Glied bei Verwendung des ersten Ganges" VALUE 0xE314C Kw_Wu32 4294.9673 TimeDelay_s 0.0000010000000 4294.9673 FORMAT "%9.4" /end CHARACTERISTIC
/begin CHARACTERISTIC LIGov_Gear1Flt2T1_C "T1 Komponente für zweites PDT1-Glied bei Verwendung des ersten Ganges" VALUE 0xE3150 Kw_Wu32 4294.9673 TimeDelay_s 0.0000010000000 4294.9673 FORMAT "%9.4" /end CHARACTERISTIC
/begin CHARACTERISTIC LIGov_Gear1IKi_C "Kleinsignalverstärkung" VALUE 0xE3154 Kw_Wu32 799999.999814 Ki_rpm2Nm 0.00 799999.999814 FORMAT "%13.6" /end CHARACTERISTIC
/begin CHARACTERISTIC LIGov_Gear1IKiPos_C "Verstärkung für positive Großsignale" VALUE 0xE3158 Kw_Wu32 799999.999814 Ki_rpm2Nm 0.00 799999.999814 FORMAT "%13.6" /end CHARACTERISTIC
/begin CHARACTERISTIC LIGov_Gear1IKiNeg_C "Verstärkung für negative Großsignale" VALUE 0xE315C Kw_Wu32 799999.999814 Ki_rpm2Nm 0.00 799999.999814 FORMAT "%13.6" /end CHARACTERISTIC
/begin CHARACTERISTIC LIGov_Gear1IWinPos_C "Kleinsignalfenster positiv" VALUE 0xE3160 Kw_Ws16 8191.875 EngN_HiRes -4096.000 4095.875 FORMAT "%8.3" /end CHARACTERISTIC
/begin CHARACTERISTIC LIGov_Gear1IWinNeg_C "Kleinsignalfenster negativ" VALUE 0xE3162 Kw_Ws16 8191.875 EngN_HiRes -4096.000 4095.875 FORMAT "%8.3" /end CHARACTERISTIC
/begin CHARACTERISTIC LIGov_Gear1Predef_C "Einschrittmoment Vorsteuerung" VALUE 0xE3164 Kw_Ws16 6553.500 Trq -3276.800 3276.700 FORMAT "%8.3" /end CHARACTERISTIC
/begin CHARACTERISTIC LIGov_Gear1PKp_C "Kleinsignalverstärkung" VALUE 0xE3168 Kw_Wu32 52428.7999878 Kp_rpm2Nm 0.00 52428.7999878 FORMAT "%13.7" /end CHARACTERISTIC
/begin CHARACTERISTIC LIGov_Gear1PKpPos_C "Verstärkung für positive Großsignale" VALUE 0xE316C Kw_Wu32 52428.7999878 Kp_rpm2Nm 0.00 52428.7999878 FORMAT "%13.7" /end CHARACTERISTIC
/begin CHARACTERISTIC LIGov_Gear1PKpNeg_C "Verstärkung für negative Großsignale" VALUE 0xE3170 Kw_Wu32 52428.7999878 Kp_rpm2Nm 0.00 52428.7999878 FORMAT "%13.7" /end CHARACTERISTIC
/begin CHARACTERISTIC LIGov_Gear1PWinPos_C "Kleinsignalfenster positiv" VALUE 0xE3174 Kw_Ws16 8191.875 EngN_HiRes -4096.000 4095.875 FORMAT "%8.3" /end CHARACTERISTIC
/begin CHARACTERISTIC LIGov_Gear1PWinNeg_C "Kleinsignalfenster negativ" VALUE 0xE3176 Kw_Ws16 8191.875 EngN_HiRes -4096.000 4095.875 FORMAT "%8.3" /end CHARACTERISTIC
/begin CHARACTERISTIC LIGov_tiGear2DT1_C "Koeffizient D-Glied (T)" VALUE 0xE3178 Kw_Wu32 4294.9673 TimeDelay_s 0.0000010000000 4294.9673 FORMAT "%9.4" /end CHARACTERISTIC
/begin CHARACTERISTIC LIGov_Gear2DKd_C "Koeffizient D-Glied (K)" VALUE 0xE317C Kw_Ws32 6553.59999847 Kd_rpm2Nm -3276.80000000 3276.79999847 FORMAT "%13.8" /end CHARACTERISTIC
/begin CHARACTERISTIC LIGov_Gear2Flt1T1_C "T1 Komponente für erstes PDT1-Glied bei Verwendung des zweiten Ganges" VALUE 0xE3180 Kw_Wu32 4294.9673 TimeDelay_s 0.0000010000000 4294.9673 FORMAT "%9.4" /end CHARACTERISTIC
/begin CHARACTERISTIC LIGov_Gear2Flt2T1_C "T1 Komponente für zweites PDT1-Glied bei Verwendung des zweiten Ganges" VALUE 0xE3184 Kw_Wu32 4294.9673 TimeDelay_s 0.0000010000000 4294.9673 FORMAT "%9.4" /end CHARACTERISTIC
/begin CHARACTERISTIC LIGov_Gear2IKi_C "Kleinsignalverstärkung" VALUE 0xE3188 Kw_Wu32 799999.999814 Ki_rpm2Nm 0.00 799999.999814 FORMAT "%13.6" /end CHARACTERISTIC
/begin CHARACTERISTIC LIGov_Gear2IKiPos_C "Verstärkung für positive Großsignale" VALUE 0xE318C Kw_Wu32 799999.999814 Ki_rpm2Nm 0.00 799999.999814 FORMAT "%13.6" /end CHARACTERISTIC
/begin CHARACTERISTIC LIGov_Gear2IKiNeg_C "Verstärkung für negative Großsignale" VALUE 0xE3190 Kw_Wu32 799999.999814 Ki_rpm2Nm 0.00 799999.999814 FORMAT "%13.6" /end CHARACTERISTIC
/begin CHARACTERISTIC LIGov_Gear2IWinPos_C "Kleinsignalfenster positiv" VALUE 0xE3194 Kw_Ws16 8191.875 EngN_HiRes -4096.000 4095.875 FORMAT "%8.3" /end CHARACTERISTIC
/begin CHARACTERISTIC LIGov_Gear2IWinNeg_C "Kleinsignalfenster negativ" VALUE 0xE3196 Kw_Ws16 8191.875 EngN_HiRes -4096.000 4095.875 FORMAT "%8.3" /end CHARACTERISTIC
/begin CHARACTERISTIC LIGov_Gear2Predef_C "Einschrittmoment Vorsteuerung" VALUE 0xE3198 Kw_Ws16 6553.500 Trq -3276.800 3276.700 FORMAT "%8.3" /end CHARACTERISTIC
/begin CHARACTERISTIC LIGov_Gear2PKp_C "Kleinsignalverstärkung" VALUE 0xE319C Kw_Wu32 52428.7999878 Kp_rpm2Nm 0.00 52428.7999878 FORMAT "%13.7" /end CHARACTERISTIC
/begin CHARACTERISTIC LIGov_Gear2PKpPos_C "Verstärkung für positive Großsignale" VALUE 0xE31A0 Kw_Wu32 52428.7999878 Kp_rpm2Nm 0.00 52428.7999878 FORMAT "%13.7" /end CHARACTERISTIC
/begin CHARACTERISTIC LIGov_Gear2PKpNeg_C "Verstärkung für negative Großsignale" VALUE 0xE31A4 Kw_Wu32 52428.7999878 Kp_rpm2Nm 0.00 52428.7999878 FORMAT "%13.7" /end CHARACTERISTIC
/begin CHARACTERISTIC LIGov_Gear2PWinPos_C "Kleinsignalfenster positiv" VALUE 0xE31A8 Kw_Ws16 8191.875 EngN_HiRes -4096.000 4095.875 FORMAT "%8.3" /end CHARACTERISTIC
/begin CHARACTERISTIC LIGov_Gear2PWinNeg_C "Kleinsignalfenster negativ" VALUE 0xE31AA Kw_Ws16 8191.875 EngN_HiRes -4096.000 4095.875 FORMAT "%8.3" /end CHARACTERISTIC
/begin CHARACTERISTIC LIGov_tiGear3DT1_C "Koeffizient D-Glied (T)" VALUE 0xE31AC Kw_Wu32 4294.9673 TimeDelay_s 0.0000010000000 4294.9673 FORMAT "%9.4" /end CHARACTERISTIC
/begin CHARACTERISTIC LIGov_Gear3DKd_C "Koeffizient D-Glied (K)" VALUE 0xE31B0 Kw_Ws32 6553.59999847 Kd_rpm2Nm -3276.80000000 3276.79999847 FORMAT "%13.8" /end CHARACTERISTIC
/begin CHARACTERISTIC LIGov_Gear3Flt1T1_C "T1 Komponente für erstes PDT1-Glied bei Verwendung des dritten Ganges" VALUE 0xE31B4 Kw_Wu32 4294.9673 TimeDelay_s 0.0000010000000 4294.9673 FORMAT "%9.4" /end CHARACTERISTIC
/begin CHARACTERISTIC LIGov_Gear3Flt2T1_C "T1 Komponente für zweites PDT1-Glied bei Verwendung des dritten Ganges" VALUE 0xE31B8 Kw_Wu32 4294.9673 TimeDelay_s 0.0000010000000 4294.9673 FORMAT "%9.4" /end CHARACTERISTIC
/begin CHARACTERISTIC LIGov_Gear3IKi_C "Kleinsignalverstärkung" VALUE 0xE31BC Kw_Wu32 799999.999814 Ki_rpm2Nm 0.00 799999.999814 FORMAT "%13.6" /end CHARACTERISTIC
/begin CHARACTERISTIC LIGov_Gear3IKiPos_C "Verstärkung für positive Großsignale" VALUE 0xE31C0 Kw_Wu32 799999.999814 Ki_rpm2Nm 0.00 799999.999814 FORMAT "%13.6" /end CHARACTERISTIC
/begin CHARACTERISTIC LIGov_Gear3IKiNeg_C "Verstärkung für negative Großsignale" VALUE 0xE31C4 Kw_Wu32 799999.999814 Ki_rpm2Nm 0.00 799999.999814 FORMAT "%13.6" /end CHARACTERISTIC
/begin CHARACTERISTIC LIGov_Gear3IWinPos_C "Kleinsignalfenster positiv" VALUE 0xE31C8 Kw_Ws16 8191.875 EngN_HiRes -4096.000 4095.875 FORMAT "%8.3" /end CHARACTERISTIC
/begin CHARACTERISTIC LIGov_Gear3IWinNeg_C "Kleinsignalfenster negativ" VALUE 0xE31CA Kw_Ws16 8191.875 EngN_HiRes -4096.000 4095.875 FORMAT "%8.3" /end CHARACTERISTIC
/begin CHARACTERISTIC LIGov_Gear3Predef_C "Einschrittmoment Vorsteuerung" VALUE 0xE31CC Kw_Ws16 6553.500 Trq -3276.800 3276.700 FORMAT "%8.3" /end CHARACTERISTIC
/begin CHARACTERISTIC LIGov_Gear3PKp_C "Kleinsignalverstärkung" VALUE 0xE31D0 Kw_Wu32 52428.7999878 Kp_rpm2Nm 0.00 52428.7999878 FORMAT "%13.7" /end CHARACTERISTIC
/begin CHARACTERISTIC LIGov_Gear3PKpPos_C "Verstärkung für positive Großsignale" VALUE 0xE31D4 Kw_Wu32 52428.7999878 Kp_rpm2Nm 0.00 52428.7999878 FORMAT "%13.7" /end CHARACTERISTIC
/begin CHARACTERISTIC LIGov_Gear3PKpNeg_C "Verstärkung für negative Großsignale" VALUE 0xE31D8 Kw_Wu32 52428.7999878 Kp_rpm2Nm 0.00 52428.7999878 FORMAT "%13.7" /end CHARACTERISTIC
/begin CHARACTERISTIC LIGov_Gear3PWinPos_C "Kleinsignalfenster positiv" VALUE 0xE31DC Kw_Ws16 8191.875 EngN_HiRes -4096.000 4095.875 FORMAT "%8.3" /end CHARACTERISTIC
/begin CHARACTERISTIC LIGov_Gear3PWinNeg_C "Kleinsignalfenster negativ" VALUE 0xE31DE Kw_Ws16 8191.875 EngN_HiRes -4096.000 4095.875 FORMAT "%8.3" /end CHARACTERISTIC
/begin CHARACTERISTIC LIGov_tiGear4DT1_C "Koeffizient D-Glied (T)" VALUE 0xE31E0 Kw_Wu32 4294.9673 TimeDelay_s 0.0000010000000 4294.9673 FORMAT "%9.4" /end CHARACTERISTIC
/begin CHARACTERISTIC LIGov_Gear4DKd_C "Koeffizient D-Glied (K)" VALUE 0xE31E4 Kw_Ws32 6553.59999847 Kd_rpm2Nm -3276.80000000 3276.79999847 FORMAT "%13.8" /end CHARACTERISTIC
/begin CHARACTERISTIC LIGov_Gear4Flt1T1_C "T1 Komponente für erstes PDT1-Glied bei Verwendung des vierte Ganges" VALUE 0xE31E8 Kw_Wu32 4294.9673 TimeDelay_s 0.0000010000000 4294.9673 FORMAT "%9.4" /end CHARACTERISTIC
/begin CHARACTERISTIC LIGov_Gear4Flt2T1_C "T1 Komponente für zweites PDT1-Glied bei Verwendung des vierte Ganges" VALUE 0xE31EC Kw_Wu32 4294.9673 TimeDelay_s 0.0000010000000 4294.9673 FORMAT "%9.4" /end CHARACTERISTIC
/begin CHARACTERISTIC LIGov_Gear4IKi_C "Kleinsignalverstärkung" VALUE 0xE31F0 Kw_Wu32 799999.999814 Ki_rpm2Nm 0.00 799999.999814 FORMAT "%13.6" /end CHARACTERISTIC
/begin CHARACTERISTIC LIGov_Gear4IKiPos_C "Verstärkung für positive Großsignale" VALUE 0xE31F4 Kw_Wu32 799999.999814 Ki_rpm2Nm 0.00 799999.999814 FORMAT "%13.6" /end CHARACTERISTIC
/begin CHARACTERISTIC LIGov_Gear4IKiNeg_C "Verstärkung für negative Großsignale" VALUE 0xE31F8 Kw_Wu32 799999.999814 Ki_rpm2Nm 0.00 799999.999814 FORMAT "%13.6" /end CHARACTERISTIC
/begin CHARACTERISTIC LIGov_Gear4IWinPos_C "Kleinsignalfenster positiv" VALUE 0xE31FC Kw_Ws16 8191.875 EngN_HiRes -4096.000 4095.875 FORMAT "%8.3" /end CHARACTERISTIC
/begin CHARACTERISTIC LIGov_Gear4IWinNeg_C "Kleinsignalfenster negativ" VALUE 0xE31FE Kw_Ws16 8191.875 EngN_HiRes -4096.000 4095.875 FORMAT "%8.3" /end CHARACTERISTIC
/begin CHARACTERISTIC LIGov_Gear4Predef_C "Einschrittmoment Vorsteuerung" VALUE 0xE3200 Kw_Ws16 6553.500 Trq -3276.800 3276.700 FORMAT "%8.3" /end CHARACTERISTIC
/begin CHARACTERISTIC LIGov_Gear4PKp_C "Kleinsignalverstärkung" VALUE 0xE3204 Kw_Wu32 52428.7999878 Kp_rpm2Nm 0.00 52428.7999878 FORMAT "%13.7" /end CHARACTERISTIC
/begin CHARACTERISTIC LIGov_Gear4PKpPos_C "Verstärkung für positive Großsignale" VALUE 0xE3208 Kw_Wu32 52428.7999878 Kp_rpm2Nm 0.00 52428.7999878 FORMAT "%13.7" /end CHARACTERISTIC
/begin CHARACTERISTIC LIGov_Gear4PKpNeg_C "Verstärkung für negative Großsignale" VALUE 0xE320C Kw_Wu32 52428.7999878 Kp_rpm2Nm 0.00 52428.7999878 FORMAT "%13.7" /end CHARACTERISTIC
/begin CHARACTERISTIC LIGov_Gear4PWinPos_C "Kleinsignalfenster positiv" VALUE 0xE3210 Kw_Ws16 8191.875 EngN_HiRes -4096.000 4095.875 FORMAT "%8.3" /end CHARACTERISTIC
/begin CHARACTERISTIC LIGov_Gear4PWinNeg_C "Kleinsignalfenster negativ" VALUE 0xE3212 Kw_Ws16 8191.875 EngN_HiRes -4096.000 4095.875 FORMAT "%8.3" /end CHARACTERISTIC
/begin CHARACTERISTIC LIGov_tiGear5DT1_C "Koeffizient D-Glied (T)" VALUE 0xE3214 Kw_Wu32 4294.9673 TimeDelay_s 0.0000010000000 4294.9673 FORMAT "%9.4" /end CHARACTERISTIC
/begin CHARACTERISTIC LIGov_Gear5DKd_C "Koeffizient D-Glied (K)" VALUE 0xE3218 Kw_Ws32 6553.59999847 Kd_rpm2Nm -3276.80000000 3276.79999847 FORMAT "%13.8" /end CHARACTERISTIC
/begin CHARACTERISTIC LIGov_Gear5Flt1T1_C "T1 Komponente für erstes PDT1-Glied bei Verwendung des fünften Ganges" VALUE 0xE321C Kw_Wu32 4294.9673 TimeDelay_s 0.0000010000000 4294.9673 FORMAT "%9.4" /end CHARACTERISTIC
/begin CHARACTERISTIC LIGov_Gear5Flt2T1_C "T1 Komponente für zweites PDT1-Glied bei Verwendung des fünften Ganges" VALUE 0xE3220 Kw_Wu32 4294.9673 TimeDelay_s 0.0000010000000 4294.9673 FORMAT "%9.4" /end CHARACTERISTIC
/begin CHARACTERISTIC LIGov_Gear5IKi_C "Kleinsignalverstärkung" VALUE 0xE3224 Kw_Wu32 799999.999814 Ki_rpm2Nm 0.00 799999.999814 FORMAT "%13.6" /end CHARACTERISTIC
/begin CHARACTERISTIC LIGov_Gear5IKiPos_C "Verstärkung für positive Großsignale" VALUE 0xE3228 Kw_Wu32 799999.999814 Ki_rpm2Nm 0.00 799999.999814 FORMAT "%13.6" /end CHARACTERISTIC
/begin CHARACTERISTIC LIGov_Gear5IKiNeg_C "Verstärkung für negative Großsignale" VALUE 0xE322C Kw_Wu32 799999.999814 Ki_rpm2Nm 0.00 799999.999814 FORMAT "%13.6" /end CHARACTERISTIC
/begin CHARACTERISTIC LIGov_Gear5IWinPos_C "Kleinsignalfenster positiv" VALUE 0xE3230 Kw_Ws16 8191.875 EngN_HiRes -4096.000 4095.875 FORMAT "%8.3" /end CHARACTERISTIC
/begin CHARACTERISTIC LIGov_Gear5IWinNeg_C "Kleinsignalfenster negativ" VALUE 0xE3232 Kw_Ws16 8191.875 EngN_HiRes -4096.000 4095.875 FORMAT "%8.3" /end CHARACTERISTIC
/begin CHARACTERISTIC LIGov_Gear5Predef_C "Einschrittmoment Vorsteuerung" VALUE 0xE3234 Kw_Ws16 6553.500 Trq -3276.800 3276.700 FORMAT "%8.3" /end CHARACTERISTIC
/begin CHARACTERISTIC LIGov_Gear5PKp_C "Kleinsignalverstärkung" VALUE 0xE3238 Kw_Wu32 52428.7999878 Kp_rpm2Nm 0.00 52428.7999878 FORMAT "%13.7" /end CHARACTERISTIC
/begin CHARACTERISTIC LIGov_Gear5PKpPos_C "Verstärkung für positive Großsignale" VALUE 0xE323C Kw_Wu32 52428.7999878 Kp_rpm2Nm 0.00 52428.7999878 FORMAT "%13.7" /end CHARACTERISTIC
/begin CHARACTERISTIC LIGov_Gear5PKpNeg_C "Verstärkung für negative Großsignale" VALUE 0xE3240 Kw_Wu32 52428.7999878 Kp_rpm2Nm 0.00 52428.7999878 FORMAT "%13.7" /end CHARACTERISTIC
/begin CHARACTERISTIC LIGov_Gear5PWinPos_C "Kleinsignalfenster positiv" VALUE 0xE3244 Kw_Ws16 8191.875 EngN_HiRes -4096.000 4095.875 FORMAT "%8.3" /end CHARACTERISTIC
/begin CHARACTERISTIC LIGov_Gear5PWinNeg_C "Kleinsignalfenster negativ" VALUE 0xE3246 Kw_Ws16 8191.875 EngN_HiRes -4096.000 4095.875 FORMAT "%8.3" /end CHARACTERISTIC
/begin CHARACTERISTIC LIGov_tiGear6DT1_C "Koeffizient D-Glied (T)" VALUE 0xE3248 Kw_Wu32 4294.9673 TimeDelay_s 0.0000010000000 4294.9673 FORMAT "%9.4" /end CHARACTERISTIC
/begin CHARACTERISTIC LIGov_Gear6DKd_C "Koeffizient D-Glied (K)" VALUE 0xE324C Kw_Ws32 6553.59999847 Kd_rpm2Nm -3276.80000000 3276.79999847 FORMAT "%13.8" /end CHARACTERISTIC
/begin CHARACTERISTIC LIGov_Gear6Flt1T1_C "T1 Komponente für erstes PDT1-Glied bei Verwendung des sechsten Ganges" VALUE 0xE3250 Kw_Wu32 4294.9673 TimeDelay_s 0.0000010000000 4294.9673 FORMAT "%9.4" /end CHARACTERISTIC
/begin CHARACTERISTIC LIGov_Gear6Flt2T1_C "T1 Komponente für zweites PDT1-Glied bei Verwendung des sechsten Ganges" VALUE 0xE3254 Kw_Wu32 4294.9673 TimeDelay_s 0.0000010000000 4294.9673 FORMAT "%9.4" /end CHARACTERISTIC
/begin CHARACTERISTIC LIGov_Gear6IKi_C "Kleinsignalverstärkung" VALUE 0xE3258 Kw_Wu32 799999.999814 Ki_rpm2Nm 0.00 799999.999814 FORMAT "%13.6" /end CHARACTERISTIC
/begin CHARACTERISTIC LIGov_Gear6IKiPos_C "Verstärkung für positie Großsingnale" VALUE 0xE325C Kw_Wu32 799999.999814 Ki_rpm2Nm 0.00 799999.999814 FORMAT "%13.6" /end CHARACTERISTIC
/begin CHARACTERISTIC LIGov_Gear6IKiNeg_C "Verstärkung für negative Großsignale" VALUE 0xE3260 Kw_Wu32 799999.999814 Ki_rpm2Nm 0.00 799999.999814 FORMAT "%13.6" /end CHARACTERISTIC
/begin CHARACTERISTIC LIGov_Gear6IWinPos_C "Kleinsignalfenster positiv" VALUE 0xE3264 Kw_Ws16 8191.875 EngN_HiRes -4096.000 4095.875 FORMAT "%8.3" /end CHARACTERISTIC
/begin CHARACTERISTIC LIGov_Gear6IWinNeg_C "Kleinsignalfenster negativ" VALUE 0xE3266 Kw_Ws16 8191.875 EngN_HiRes -4096.000 4095.875 FORMAT "%8.3" /end CHARACTERISTIC
/begin CHARACTERISTIC LIGov_Gear6Predef_C "Einschrittmoment Vorsteuerung" VALUE 0xE3268 Kw_Ws16 6553.500 Trq -3276.800 3276.700 FORMAT "%8.3" /end CHARACTERISTIC
/begin CHARACTERISTIC LIGov_Gear6PKp_C "Kleinsignalverstärkung" VALUE 0xE326C Kw_Wu32 52428.7999878 Kp_rpm2Nm 0.00 52428.7999878 FORMAT "%13.7" /end CHARACTERISTIC
/begin CHARACTERISTIC LIGov_Gear6PKpPos_C "Verstärkung für positive Großsignale" VALUE 0xE3270 Kw_Wu32 52428.7999878 Kp_rpm2Nm 0.00 52428.7999878 FORMAT "%13.7" /end CHARACTERISTIC
/begin CHARACTERISTIC LIGov_Gear6PKpNeg_C "Verstärkung für negative Großsignale" VALUE 0xE3274 Kw_Wu32 52428.7999878 Kp_rpm2Nm 0.00 52428.7999878 FORMAT "%13.7" /end CHARACTERISTIC
/begin CHARACTERISTIC LIGov_Gear6PWinPos_C "Kleinsignalfenster positiv" VALUE 0xE3278 Kw_Ws16 8191.875 EngN_HiRes -4096.000 4095.875 FORMAT "%8.3" /end CHARACTERISTIC
/begin CHARACTERISTIC LIGov_Gear6PWinNeg_C "Kleinsignalfenster negativ" VALUE 0xE327A Kw_Ws16 8191.875 EngN_HiRes -4096.000 4095.875 FORMAT "%8.3" /end CHARACTERISTIC
/begin CHARACTERISTIC LIGov_nDeltaSec_C "#SSD Delta allgemein zu Drehzahlschwelle Sicherheitsrampe" VALUE 0xE332C Kw_Ws16 32767.00 EngN 0.00 32767.00 FORMAT "%8.2" EXTENDED_LIMITS -32768.00 32767.00 /end CHARACTERISTIC
/begin CHARACTERISTIC LIGov_nDflTrmVal_C "Datensatz-Abgleichwert" VALUE 0xE327C Kw_Ws16 65535.00 EngN -32768.00 32767.00 FORMAT "%8.2" /end CHARACTERISTIC
/begin CHARACTERISTIC LIGov_nDHypDenom_C "Nennerparameter für Hyperbel zur Aufschaltung LLR D-Anteil" VALUE 0xE327E Kw_Ws16 32766.00 EngN 1.000000 32767.00 FORMAT "%8.2" EXTENDED_LIMITS -32768.00 32767.00 /end CHARACTERISTIC
/begin CHARACTERISTIC LIGov_nDHypNum_C "Zählerparameter für Hyperbel zur Aufschaltung LLR D-Anteil" VALUE 0xE3280 Kw_Ws16 65535.00 EngN -32768.00 32767.00 FORMAT "%8.2" /end CHARACTERISTIC
/begin CHARACTERISTIC LIGov_nDiffDelta_C "#SSD Delta zur Drehzahlschwelle Sicherheitsrampe" VALUE 0xE332E Kw_Ws16 32767.00 EngN 0.00 32767.00 FORMAT "%8.2" EXTENDED_LIMITS -32768.00 32767.00 /end CHARACTERISTIC
/begin CHARACTERISTIC LIGov_nHDC_C "Applizierbare LL-Solldrehzahl aufgrund HDC" VALUE 0xE3330 Kw_Ws16 32767.00 EngN 0.00 32767.00 FORMAT "%8.2" EXTENDED_LIMITS -32768.00 32767.00 /end CHARACTERISTIC
/begin CHARACTERISTIC LIGov_nLimHighOfs_C "Offset from the high engine speed limit for low-idle governor" VALUE 0xE3332 Kw_Ws16 32767.00 EngN 0.00 32767.00 FORMAT "%8.2" EXTENDED_LIMITS -32768.00 32767.00 /end CHARACTERISTIC
/begin CHARACTERISTIC LIGov_nLimHighTrmAct_C "" VALUE 0xE3334 Kw_Ws16 65535.00 EngN -32768.00 32767.00 FORMAT "%8.2" /end CHARACTERISTIC
/begin CHARACTERISTIC LIGov_nLimHigh_C "#SSD obere Drehzahlgrenze für LLR" VALUE 0xE3282 Kw_Ws16 65535.00 EngN -32768.00 32767.00 FORMAT "%8.2" /end CHARACTERISTIC
/begin CHARACTERISTIC LIGov_nLimLow_C "untere Drehzahlgrenze für LLR" VALUE 0xE3284 Kw_Ws16 65535.00 EngN -32768.00 32767.00 FORMAT "%8.2" /end CHARACTERISTIC
/begin CHARACTERISTIC LIGov_nMSDiffMax_C "#SSD Max zulässige Differenz zwischen Master Solldrehzahl und der vom Slave berechneten Solldrehzahl" VALUE 0xE3286 Kw_Ws16 5960.000 EngN 40.00000 6000.000 FORMAT "%8.3" EXTENDED_LIMITS -32768.00 32767.00 /end CHARACTERISTIC
/begin CHARACTERISTIC LIGov_nOffsetPreCtrltrqDem_C "Vorsteuerung aktiv n-Offset auf Basisdrehzahl und Momentenwunsch" VALUE 0xE3288 Kw_Ws16 65535.00 EngN -32768.00 32767.00 FORMAT "%8.2" /end CHARACTERISTIC
/begin CHARACTERISTIC LIGov_nOffsetPreCtrl_C "Vorsteuerung aktiv n-Offset auf Basisdrehzahl" VALUE 0xE328A Kw_Ws16 65535.00 EngN -32768.00 32767.00 FORMAT "%8.2" /end CHARACTERISTIC
/begin CHARACTERISTIC LIGov_nOffsetPredef_C "Einschrittmoment aktiv n-Offset auf Basisdrehzahl" VALUE 0xE328C Kw_Ws16 65535.00 EngN -32768.00 32767.00 FORMAT "%8.2" /end CHARACTERISTIC
/begin CHARACTERISTIC LIGov_nOffsetUbr_C "Drehzahlschwelle für Erkennung für Leerlaufregler-Zustand Unterbremsen" VALUE 0xE328E Kw_Ws16 65535.00 EngN -32768.00 32767.00 FORMAT "%8.2" /end CHARACTERISTIC
/begin CHARACTERISTIC LIGov_nRmpBaseDwn_C "#SSD Schrittweite der Rampe bei Absenkung LL-Solldrehzahl aus LL-Grundfunktion" VALUE 0xE3336 Kw_Ws16 32767.00 dn_dZfine 0.00 32767.00 FORMAT "%8.2" EXTENDED_LIMITS -32768.00 32767.00 /end CHARACTERISTIC
/begin CHARACTERISTIC LIGov_nRmpBaseUp_C "Schrittweite der Rampe bei Erhöhung LL-Solldrehzahl aus LL-Grundfunktion" VALUE 0xE3338 Kw_Ws16 32767.00 dn_dZfine 0.00 32767.00 FORMAT "%8.2" EXTENDED_LIMITS -32768.00 32767.00 /end CHARACTERISTIC
/begin CHARACTERISTIC LIGov_nRmpCoEngDwn_C "#SSD Schrittweite der Rampe bei Absenkung LL-Solldrehzahl aus CoEng_nMin" VALUE 0xE333A Kw_Ws16 32767.00 dn_dZfine 0.00 32767.00 FORMAT "%8.2" EXTENDED_LIMITS -32768.00 32767.00 /end CHARACTERISTIC
/begin CHARACTERISTIC LIGov_nRmpCoEngUp_C "Schrittweite der Rampe bei Erhöhung LL-Solldrehzahl aus CoEng_nMin" VALUE 0xE333C Kw_Ws16 32767.00 dn_dZfine 0.00 32767.00 FORMAT "%8.2" EXTENDED_LIMITS -32768.00 32767.00 /end CHARACTERISTIC
/begin CHARACTERISTIC LIGov_nRmpCutOutUp_C "Ramp by raising setpoint" VALUE 0xE3340 Kw_Wu32 65535999.9847 RmpEngN 0.00 65535999.9847 FORMAT "%13.4" /end CHARACTERISTIC
/begin CHARACTERISTIC LIGov_nRmpCutOutDwn_C "Ramp by lowing setpoint" VALUE 0xE3344 Kw_Wu32 65535999.9847 RmpEngN 0.00 65535999.9847 FORMAT "%13.4" /end CHARACTERISTIC
/begin CHARACTERISTIC LIGov_nRmpGearbxDwn_C "#SSD Schrittweite der Rampe bei Absenkung LL-Solldrehzahl aus Getriebe" VALUE 0xE3348 Kw_Ws16 32767.00 dn_dZfine 0.00 32767.00 FORMAT "%8.2" EXTENDED_LIMITS -32768.00 32767.00 /end CHARACTERISTIC
/begin CHARACTERISTIC LIGov_nRmpGearbxUp_C "Schrittweite der Rampe bei Absenkung LL-Solldrehzahl aus Getriebe" VALUE 0xE334A Kw_Ws16 32767.00 dn_dZfine 0.00 32767.00 FORMAT "%8.2" EXTENDED_LIMITS -32768.00 32767.00 /end CHARACTERISTIC
/begin CHARACTERISTIC LIGov_nRmpHDCDwn_C "#SSD Drehzahl Rampenschritt für HDC Eingriff - fallende Drehzahl" VALUE 0xE334C Kw_Ws16 32767.00 dn_dZfine 0.00 32767.00 FORMAT "%8.2" EXTENDED_LIMITS -32768.00 32767.00 /end CHARACTERISTIC
/begin CHARACTERISTIC LIGov_nRmpHDCUp_C "#SSD Drehzahl Rampenschrittweite des HDC-Eingriffes - steigende Drehzahl" VALUE 0xE334E Kw_Ws16 32767.00 dn_dZfine 0.00 32767.00 FORMAT "%8.2" EXTENDED_LIMITS -32768.00 32767.00 /end CHARACTERISTIC
/begin CHARACTERISTIC LIGov_nRmpPwrMngDwn_C "#SSD Schrittweite der Rampe bei Absenkung LL-Solldrehzahl aus Getriebe" VALUE 0xE3350 Kw_Ws16 32767.00 dn_dZfine 0.00 32767.00 FORMAT "%8.2" EXTENDED_LIMITS -32768.00 32767.00 /end CHARACTERISTIC
/begin CHARACTERISTIC LIGov_nRmpPwrMngUp_C "Schrittweite der Rampe bei Absenkung LL-Solldrehzahl aus PwrMng" VALUE 0xE3352 Kw_Ws16 32767.00 dn_dZfine 0.00 32767.00 FORMAT "%8.2" EXTENDED_LIMITS -32768.00 32767.00 /end CHARACTERISTIC
/begin CHARACTERISTIC LIGov_nRmpSecDelta_C "#SSD Schrittweite der SicherheitsRampe bei Erhöhung LL-Solldrehzahl" VALUE 0xE3354 Kw_Ws16 32767.00 dn_dZfine 0.00 32767.00 FORMAT "%8.2" EXTENDED_LIMITS -32768.00 32767.00 /end CHARACTERISTIC
/begin CHARACTERISTIC LIGov_nRmpSurgeDwn_C "#SSD Schrittweite der Rampe bei Absenkung LL-Solldrehzahl aus AntiSurge" VALUE 0xE3356 Kw_Ws16 32767.00 dn_dZfine 0.00 32767.00 FORMAT "%8.2" EXTENDED_LIMITS -32768.00 32767.00 /end CHARACTERISTIC
/begin CHARACTERISTIC LIGov_nRmpSurgeUp_C "Schrittweite der Rampe bei Erhöhung LL-Solldrehzahl aus AntiSurge" VALUE 0xE3358 Kw_Ws16 32767.00 dn_dZfine 0.00 32767.00 FORMAT "%8.2" EXTENDED_LIMITS -32768.00 32767.00 /end CHARACTERISTIC
/begin CHARACTERISTIC LIGov_nSetpointDia_C "Sollwert des LLR über Diagnoseschnittstelle" VALUE 0xE335A Kw_Ws16 32767.00 EngN 0.00 32767.00 FORMAT "%8.2" EXTENDED_LIMITS -32768.00 32767.00 /end CHARACTERISTIC
/begin CHARACTERISTIC LIGov_nSetpointDriveAway_C "LL-Solldrehzahl Fahrzeug fährt (V > 0)" VALUE 0xE335C Kw_Ws16 65535.00 EngN -32768.00 32767.00 FORMAT "%8.2" /end CHARACTERISTIC
/begin CHARACTERISTIC LIGov_nSetpointInit_MAP "Initialisierungskennfeld zur Berechnung der Leerlaufsolldrehzahl" MAP 0xE335E Kf_Xs16_Ys16_Ws16 6000.000 EngN 0.00 6000.000 FORMAT "%8.3" EXTENDED_LIMITS -32768.00 32767.00
 /begin AXIS_DESCR STD_AXIS CTSCD_tClnt Temp_Cels 8 -50.1400 199.8600 FORMAT "%8.4" EXTENDED_LIMITS -3549.940 3003.560 DEPOSIT ABSOLUTE /end AXIS_DESCR
 /begin AXIS_DESCR STD_AXIS APSCD_pVal Pres_hPa 8 0.00 3500.0000 FORMAT "%8.4" EXTENDED_LIMITS -32768.00 32767.00 DEPOSIT ABSOLUTE /end AXIS_DESCR
/end CHARACTERISTIC
/begin CHARACTERISTIC LIGov_nSetpointTrmLim_C "#SSD Schwelle für LL-Drehzahlanhebungserkennung" VALUE 0xE3402 Kw_Ws16 65535.00 EngN -32768.00 32767.00 FORMAT "%8.2" /end CHARACTERISTIC
/begin CHARACTERISTIC LIGov_nSetpointTrm_C "#SSD Ersatzwert für LL-Drehzahlanhebung" VALUE 0xE3404 Kw_Ws16 65535.00 EngN -32768.00 32767.00 FORMAT "%8.2" /end CHARACTERISTIC
/begin CHARACTERISTIC LIGov_nSetPointWarm_C "LL-Solldrehzahl Fahrzeug steht / warmer Motor" VALUE 0xE3406 Kw_Ws16 65535.00 EngN -32768.00 32767.00 FORMAT "%8.2" /end CHARACTERISTIC
/begin CHARACTERISTIC LIGov_nSetpoint_Vector "#SSD Bypass label, nicht editieren" VALUE 0xC2DF6 Kw_Wu8 255.0 OneToOne 0.00 255.0 FORMAT "%5.1" /end CHARACTERISTIC
/begin CHARACTERISTIC LIGov_nSetpoint_Channel "#SSD Bypass Label, nicht editieren!" VALUE 0xC2DF7 Kw_Wu8 255.0 OneToOne 0.00 255.0 FORMAT "%5.1" /end CHARACTERISTIC
/begin CHARACTERISTIC LIGov_rAPPThresFreezeI_C "Schwelle für PWG-Wert zum Rücksetzen des LLR Status ""freezeI""" VALUE 0xE3290 Kw_Ws16 100.0000 Prc 0.00 100.0000 FORMAT "%8.4" EXTENDED_LIMITS -400.0000 399.9878 /end CHARACTERISTIC
/begin CHARACTERISTIC LIGov_rAPPThresTrqDem_C "Schwelle für PWG-Wert zum Rücksetzen des LLR Status ""torque demand""" VALUE 0xE3292 Kw_Ws16 100.0000 Prc 0.00 100.0000 FORMAT "%8.4" EXTENDED_LIMITS -400.0000 399.9878 /end CHARACTERISTIC
/begin CHARACTERISTIC LIGov_stActiveHDC_C "Applizierbarer Zustand für aktivierte LL-Solldrehzahl aufgrund HDC" VALUE 0xE3408 Kw_Wu8 3.000 OneToOne 0.00 3.000 FORMAT "%5.3" EXTENDED_LIMITS 0.00 255.0 /end CHARACTERISTIC
/begin CHARACTERISTIC LIGov_stPsRev_C "Wählt Paramtersatz für Rückwärtsgang (1 entspricht PS 1.Gang, 2 entspricht PS 2.Gang)" VALUE 0xE3294 Kw_Ws8 1.000 OneToOne 1.000 2.000 FORMAT "%5.3" EXTENDED_LIMITS -128.0 127.0 /end CHARACTERISTIC
/begin CHARACTERISTIC LIGov_stReleaseHDC_C "Bitweises Freischalten der LL-Solldrehzahl aufgrund HDC über CAN" VALUE 0xE3409 Kw_Wu8 127.0 OneToOne 0.00 127.0 FORMAT "%5.1" EXTENDED_LIMITS 0.00 255.0 /end CHARACTERISTIC
/begin CHARACTERISTIC LIGov_swtAPPFreezeI_C "Schalter für die Auswahl gefilterter (0) oder ungefilterter (1) PWG-Wert für die Entscheidung des LLR-Status ""freezeI""" VALUE 0xE3295 Kw_Wu8 1.000 OneToOne 0.00 1.000 FORMAT "%5.3" EXTENDED_LIMITS 0.00 255.0 /end CHARACTERISTIC
/begin CHARACTERISTIC LIGov_swtAPPTrqDem_C "Schalter für die Auswahl gefilterter (0) oder ungefilterter (1) PWG-Wert für die Entscheidung des LLR-Status ""torque demanded""" VALUE 0xE3296 Kw_Wu8 1.000 OneToOne 0.00 1.000 FORMAT "%5.3" EXTENDED_LIMITS 0.00 255.0 /end CHARACTERISTIC
/begin CHARACTERISTIC LIGov_swtInitPreCtrlNotLck_C "Startzustand des LLR Zustands ""Vorsteuerung nicht gesperrt""" VALUE 0xE3297 Kw_Wu8 1.000 OneToOne 0.00 1.000 FORMAT "%5.3" EXTENDED_LIMITS 0.00 255.0 /end CHARACTERISTIC
/begin CHARACTERISTIC LIGov_tClntXLow_C "Schwelle 1 für Wassertemperaturhysterese" VALUE 0xE3298 Kw_Ws16 250.0000 Temp_Cels -50.14000 199.8600 FORMAT "%8.4" EXTENDED_LIMITS -3549.940 3003.560 /end CHARACTERISTIC
/begin CHARACTERISTIC LIGov_tClntXHigh_C "Schwelle 2 für Wassertemperaturhysterese" VALUE 0xE329A Kw_Ws16 250.0000 Temp_Cels -50.14000 199.8600 FORMAT "%8.4" EXTENDED_LIMITS -3549.940 3003.560 /end CHARACTERISTIC
/begin CHARACTERISTIC LIGov_stCold_C "Konstante für LiGov Status kalt" VALUE 0xE329C Kw_Ws16 65535.00 OneToOne -32768.00 32767.00 FORMAT "%8.2" READ_ONLY /end CHARACTERISTIC
/begin CHARACTERISTIC LIGov_stWarm_C "Konstante für LIGov Status warm" VALUE 0xE329E Kw_Ws16 65535.00 OneToOne -32768.00 32767.00 FORMAT "%8.2" READ_ONLY /end CHARACTERISTIC
/begin CHARACTERISTIC LIGov_tiDelCutOut_C "delay time after CoEng_stEng moves from status COENG_STSTART to COENG_STNORMAL" VALUE 0xE32A0 Kw_Wu16 2000.000 Time_ms 0.00 2000.000 FORMAT "%8.3" EXTENDED_LIMITS 0.00 655350.0 /end CHARACTERISTIC
/begin CHARACTERISTIC LIGov_tiPT1_CUR "Kennlinie der Zeitkonstanten für die PT1 Flterung über der Drehzahl" CURVE 0xE32A2 Kl_Xs16_Ws16 5.000000 TimeDelay_s_Lin_16 0.00 5.000000 FORMAT "%8.6" EXTENDED_LIMITS -5.000153 5.000000
 /begin AXIS_DESCR STD_AXIS LIGov_nDiff_mp EngN 8 -5000.000 1000.000 FORMAT "%8.3" EXTENDED_LIMITS -32768.00 32767.00 DEPOSIT ABSOLUTE /end AXIS_DESCR
/end CHARACTERISTIC
/begin CHARACTERISTIC LIGov_tiTW_C "Zeit nach Start für T_W-abh. LL-Solldrehzahl" VALUE 0xE340A Kw_Wu16 655.3500 Time_s 0.00 655.3500 FORMAT "%8.4" /end CHARACTERISTIC
/begin CHARACTERISTIC LIGov_trqInitI_CUR "Kennlinie zur Initialisierung des Integrators" CURVE 0xE340C Kl_Xs16_Ws16 400.0000 Trq 0.00 400.0000 FORMAT "%8.4" EXTENDED_LIMITS -3276.800 3276.700
 /begin AXIS_DESCR STD_AXIS CTSCD_tClnt Temp_Cels 8 -50.1400 199.8600 FORMAT "%8.4" EXTENDED_LIMITS -3549.940 3003.560 DEPOSIT ABSOLUTE /end AXIS_DESCR
/end CHARACTERISTIC
/begin CHARACTERISTIC LIGov_trqMax_CUR "Wassertemperaturabhängiges Begrenzungsmoment für den LLR" CURVE 0xE32C4 Kl_Xs16_Ws16 400.0000 Trq 0.00 400.0000 FORMAT "%8.4" EXTENDED_LIMITS -3276.800 3276.700
 /begin AXIS_DESCR STD_AXIS Eng_nAvrg EngN 8 -32768.00 32767.00 FORMAT "%8.2" DEPOSIT ABSOLUTE /end AXIS_DESCR
/end CHARACTERISTIC
/begin CHARACTERISTIC LIGov_trqThresDefrostI_C "Mengenschwelle Integrator einfrieren/auftauen" VALUE 0xE32E6 Kw_Ws16 6553.500 Trq -3276.800 3276.700 FORMAT "%8.3" /end CHARACTERISTIC
/begin CHARACTERISTIC LIGov_trq_Vector "#SSD Bypasslabel, nicht editieren!" VALUE 0xC2DF8 Kw_Wu8 255.0 OneToOne 0.00 255.0 FORMAT "%5.1" /end CHARACTERISTIC
/begin CHARACTERISTIC LIGov_trq_Channel "#SSD Bypasslabel, nicht editieren!" VALUE 0xC2DF9 Kw_Wu8 255.0 OneToOne 0.00 255.0 FORMAT "%5.1" /end CHARACTERISTIC
/begin CHARACTERISTIC LIGov_UbrPKp_C "Kleinsignalverstärkung" VALUE 0xE32E8 Kw_Wu32 52428.7999878 Kp_rpm2Nm 0.00 52428.7999878 FORMAT "%13.7" /end CHARACTERISTIC
/begin CHARACTERISTIC LIGov_UbrPKpPos_C "Verstärkung für positive Großsignale" VALUE 0xE32EC Kw_Wu32 52428.7999878 Kp_rpm2Nm 0.00 52428.7999878 FORMAT "%13.7" /end CHARACTERISTIC
/begin CHARACTERISTIC LIGov_UbrPKpNeg_C "Verstärkung für negative Großsignale" VALUE 0xE32F0 Kw_Wu32 52428.7999878 Kp_rpm2Nm 0.00 52428.7999878 FORMAT "%13.7" /end CHARACTERISTIC
/begin CHARACTERISTIC LIGov_UbrPWinPos_C "Kleinsignalfenster positiv" VALUE 0xE32F4 Kw_Ws16 8191.875 EngN_HiRes -4096.000 4095.875 FORMAT "%8.3" /end CHARACTERISTIC
/begin CHARACTERISTIC LIGov_UbrPWinNeg_C "Kleinsignalfenster negativ" VALUE 0xE32F6 Kw_Ws16 8191.875 EngN_HiRes -4096.000 4095.875 FORMAT "%8.3" /end CHARACTERISTIC
/begin CHARACTERISTIC LIGov_vThresUbr_C "Schwellgeschwindigkeit bei Unterbremsen" VALUE 0xE32F8 Kw_Ws16 655.3500 Vel -327.6800 327.6700 FORMAT "%8.4" /end CHARACTERISTIC
/begin CHARACTERISTIC LIGov_tiWrmCltchDT1_C "Koeffizient D-Glied (T)" VALUE 0xE3438 Kw_Wu32 4294.9673 TimeDelay_s 0.0000010000000 4294.9673 FORMAT "%9.4" /end CHARACTERISTIC
/begin CHARACTERISTIC LIGov_WrmCltchDKd_C "Koeffizient D-Glied (K)" VALUE 0xE343C Kw_Ws32 6553.59999847 Kd_rpm2Nm -3276.80000000 3276.79999847 FORMAT "%13.8" /end CHARACTERISTIC
/begin CHARACTERISTIC LIGov_WrmCltchFlt1T1_C "T1 Komponente für erstes PDT1-Glied wenn ausgekuppelt und Motor warm" VALUE 0xE32FC Kw_Wu32 4294.9673 TimeDelay_s 0.0000010000000 4294.9673 FORMAT "%9.4" /end CHARACTERISTIC
/begin CHARACTERISTIC LIGov_WrmCltchFlt2T1_C "T1 Komponente für zweites PDT1-Glied wenn ausgekuppelt und Motor warm" VALUE 0xE3300 Kw_Wu32 4294.9673 TimeDelay_s 0.0000010000000 4294.9673 FORMAT "%9.4" /end CHARACTERISTIC
/begin CHARACTERISTIC LIGov_WrmCltchIKi_C "Kleinsignalverstärkung" VALUE 0xE3304 Kw_Wu32 799999.999814 Ki_rpm2Nm 0.00 799999.999814 FORMAT "%13.6" /end CHARACTERISTIC
/begin CHARACTERISTIC LIGov_WrmCltchIKiPos_C "Verstärkung für positive Großsignale" VALUE 0xE3308 Kw_Wu32 799999.999814 Ki_rpm2Nm 0.00 799999.999814 FORMAT "%13.6" /end CHARACTERISTIC
/begin CHARACTERISTIC LIGov_WrmCltchIKiNeg_C "Verstärkung für negative Großsignale" VALUE 0xE330C Kw_Wu32 799999.999814 Ki_rpm2Nm 0.00 799999.999814 FORMAT "%13.6" /end CHARACTERISTIC
/begin CHARACTERISTIC LIGov_WrmCltchIWinPos_C "Kleinsignalfenster positiv" VALUE 0xE3310 Kw_Ws16 8191.875 EngN_HiRes -4096.000 4095.875 FORMAT "%8.3" /end CHARACTERISTIC
/begin CHARACTERISTIC LIGov_WrmCltchIWinNeg_C "Kleinsignalfenster negativ" VALUE 0xE3312 Kw_Ws16 8191.875 EngN_HiRes -4096.000 4095.875 FORMAT "%8.3" /end CHARACTERISTIC
/begin CHARACTERISTIC LIGov_WrmCltchPredef_C "Einschrittmoment Vorsteuerung" VALUE 0xE3314 Kw_Ws16 6553.500 Trq -3276.800 3276.700 FORMAT "%8.3" /end CHARACTERISTIC
/begin CHARACTERISTIC LIGov_WrmCltchPKp_C "Kleinsignalverstärkung" VALUE 0xE3318 Kw_Wu32 52428.7999878 Kp_rpm2Nm 0.00 52428.7999878 FORMAT "%13.7" /end CHARACTERISTIC
/begin CHARACTERISTIC LIGov_WrmCltchPKpPos_C "Verstärkung für positive Großsignale" VALUE 0xE331C Kw_Wu32 52428.7999878 Kp_rpm2Nm 0.00 52428.7999878 FORMAT "%13.7" /end CHARACTERISTIC
/begin CHARACTERISTIC LIGov_WrmCltchPKpNeg_C "Verstärkung für negative Großsignale" VALUE 0xE3320 Kw_Wu32 52428.7999878 Kp_rpm2Nm 0.00 52428.7999878 FORMAT "%13.7" /end CHARACTERISTIC
/begin CHARACTERISTIC LIGov_WrmCltchPWinPos_C "Kleinsignalfenster positiv" VALUE 0xE3324 Kw_Ws16 8191.875 EngN_HiRes -4096.000 4095.875 FORMAT "%8.3" /end CHARACTERISTIC
/begin CHARACTERISTIC LIGov_WrmCltchPWinNeg_C "Kleinsignalfenster negativ" VALUE 0xE3326 Kw_Ws16 8191.875 EngN_HiRes -4096.000 4095.875 FORMAT "%8.3" /end CHARACTERISTIC
/begin CHARACTERISTIC LPACD_DebExcTempDef_C "Fehlerentprellzeit fuer Uebertemperatur" VALUE 0xE3440 Kw_Wu16 655350.0 Time_ms 0.00 655350.0 FORMAT "%8.1" /end CHARACTERISTIC
/begin CHARACTERISTIC LPACD_DebExcTempOk_C "Heilungsentprellzeit fuer Uebertemperatur" VALUE 0xE3442 Kw_Wu16 655350.0 Time_ms 0.00 655350.0 FORMAT "%8.1" /end CHARACTERISTIC
/begin CHARACTERISTIC LPACD_DebNoLoadDef_C "Fehlerentprellzeit fuer Lastabfall" VALUE 0xE3444 Kw_Wu16 655350.0 Time_ms 0.00 655350.0 FORMAT "%8.1" /end CHARACTERISTIC
/begin CHARACTERISTIC LPACD_DebNoLoadOk_C "Heilungsentprellzeit fuer Lastabfall" VALUE 0xE3446 Kw_Wu16 655350.0 Time_ms 0.00 655350.0 FORMAT "%8.1" /end CHARACTERISTIC
/begin CHARACTERISTIC LPACD_DebShortCircBatDef_C "Fehlerentprellzeit fuer Kurzschluss nach Batteriespannung" VALUE 0xE3448 Kw_Wu16 655350.0 Time_ms 0.00 655350.0 FORMAT "%8.1" /end CHARACTERISTIC
/begin CHARACTERISTIC LPACD_DebShortCircBatOk_C "Heilungsentprellzeit fuer Kurzschluss nach Batteriespannung" VALUE 0xE344A Kw_Wu16 655350.0 Time_ms 0.00 655350.0 FORMAT "%8.1" /end CHARACTERISTIC
/begin CHARACTERISTIC LPACD_DebShortCircGndDef_C "Fehlerentprellzeit fuer Kurzschluss nach Masse" VALUE 0xE344C Kw_Wu16 655350.0 Time_ms 0.00 655350.0 FORMAT "%8.1" /end CHARACTERISTIC
/begin CHARACTERISTIC LPACD_DebShortCircGndOk_C "Heilungsentprellzeit fuer Kurzschluss nach Masse" VALUE 0xE344E Kw_Wu16 655350.0 Time_ms 0.00 655350.0 FORMAT "%8.1" /end CHARACTERISTIC
/begin CHARACTERISTIC LPACD_numDia_C "Parameter fuer Hardware Diagnose-Pin Auswahl" VALUE 0xE3450 Kw_Wu8 34.0000000000 NumPinDia 0.00 34.0000000000 FORMAT "%13.10" /end CHARACTERISTIC
/begin CHARACTERISTIC LPACD_numPwmOut_C "Parameter fuer Hardware Endstufen-Pin Auswahl" VALUE 0xE3451 Kw_Wu8 12.0000000000 NumPinPwmOut 0.00 12.0000000000 FORMAT "%13.10" /end CHARACTERISTIC
/begin CHARACTERISTIC LPACD_stInvOut_C "Invertierungsparameter fuer das Signal der Ladedruckstellerendstufe" VALUE 0xE3452 Kw_Wu8 1.000 OneToOne 0.00 1.000 FORMAT "%5.3" EXTENDED_LIMITS 0.00 255.0 /end CHARACTERISTIC
/begin CHARACTERISTIC LPACD_tiPer_C "Periodendauer des Ladedruckstellers" VALUE 0xE3454 Kw_Ws16 6553.500 Period -3276.800 3276.700 FORMAT "%8.3" /end CHARACTERISTIC
/begin CHARACTERISTIC LPACD_rCnv_CUR "Kennlinie zur Konvertierung von Oeffnungsgrad in Tastverhaeltnis" CURVE 0xE3456 Kl_Xs16_Ws16 100.0000 DtyCyc 0.00 100.0000 FORMAT "%8.4" EXTENDED_LIMITS -327.6800 327.6700
 /begin AXIS_DESCR STD_AXIS BPA_rLPACD Prc 25 -100.0000 200.0000 FORMAT "%8.4" EXTENDED_LIMITS -400.0000 399.9878 DEPOSIT ABSOLUTE /end AXIS_DESCR
/end CHARACTERISTIC
/begin CHARACTERISTIC LPACD_rOutMax_C "Maximal auszugebendes Tastverhaeltnis" VALUE 0xE34BC Kw_Ws16 655.3500 DtyCyc -327.6800 327.6700 FORMAT "%8.4" /end CHARACTERISTIC
/begin CHARACTERISTIC LPACD_rOutMin_C "Minimal auszugebendes Tastverhaeltnis" VALUE 0xE34BE Kw_Ws16 655.3500 DtyCyc -327.6800 327.6700 FORMAT "%8.4" /end CHARACTERISTIC
/begin CHARACTERISTIC LPACD_rTst_C "Tastverhaeltnis, dass im Fehlerfall zyklisch ausgegeben wird" VALUE 0xE34C0 Kw_Ws16 100.0000 DtyCyc 0.00 100.0000 FORMAT "%8.4" EXTENDED_LIMITS -327.6800 327.6700 /end CHARACTERISTIC
/begin CHARACTERISTIC LPACD_stPwrStgActv_C "Aktivierung der Abschaltbedingungen der Endstufe" VALUE 0xE34C2 Kw_Wu8 255.0 OneToOne 0.00 255.0 FORMAT "%5.1" /end CHARACTERISTIC
/begin CHARACTERISTIC LPACD_stPwrStgDia_C "Aktivierung der Abschaltbedingungen der Endstufendiagnose" VALUE 0xE34C3 Kw_Wu8 255.0 OneToOne 0.00 255.0 FORMAT "%5.1" /end CHARACTERISTIC
/begin CHARACTERISTIC LPACD_swt_C "Schalter fuer Batteriespannungskorrektur (0 = AUS, 1 = EIN)" VALUE 0xE34C4 Kw_Wu8 255.0 OneToOne 0.00 255.0 FORMAT "%5.1" /end CHARACTERISTIC
/begin CHARACTERISTIC LPACD_tiBtwTst_C "Zeitabstand, in dem im Fehlerfall die Endstufe getestet wird" VALUE 0xE34C6 Kw_Wu16 29980.00 Time_ms 20.00000 30000.00 FORMAT "%8.2" EXTENDED_LIMITS 0.00 655350.0 /end CHARACTERISTIC
/begin CHARACTERISTIC LSUCD_tiAdptFltInit_C "Zeitkonstante Adaptionsfilter für nicht adaptierten Zustand" VALUE 0xE35A0 Kw_Wu32 4294.9673 TimeDelay_s 0.0000010000000 4294.9673 FORMAT "%9.4" /end CHARACTERISTIC
/begin CHARACTERISTIC LSUCD_tiAdptFlt_C "Zeitkonstante Adaptionsfilter für adaptierten Zustand" VALUE 0xE35A4 Kw_Wu32 4294.9673 TimeDelay_s 0.0000010000000 4294.9673 FORMAT "%9.4" /end CHARACTERISTIC
/begin CHARACTERISTIC LSUCD_d2rInit_C "Initialisierungswert Bewertungsfilter" VALUE 0xE35A8 Kw_Ws16 0.6553500 O2 -0.3276800 0.3276700 FORMAT "%9.7" /end CHARACTERISTIC
/begin CHARACTERISTIC LSUCD_dcycMinGrad_C "Minimale Änderung des Tastverhältnisses zur Freigabe der Diagnose der Heizungskopplung" VALUE 0xE3724 Kw_Ws16 655.3500 DtyCyc -327.6800 327.6700 FORMAT "%8.4" /end CHARACTERISTIC
/begin CHARACTERISTIC LSUCD_DebHtCoupDef_C "Fehlerentprellzeit für Heizungskopplung" VALUE 0xE3726 Kw_Wu16 65535.00 OneToOne 0.00 65535.00 FORMAT "%8.2" /end CHARACTERISTIC
/begin CHARACTERISTIC LSUCD_DebHtCoupOk_C "Fehlerheilungszeit für Heizungskopplung" VALUE 0xE3728 Kw_Wu16 65535.00 OneToOne 0.00 65535.00 FORMAT "%8.2" /end CHARACTERISTIC
/begin CHARACTERISTIC LSUCD_DebO2ClbDef_C "Defektentprellzähler für O2-Kalibrierungsfehler" VALUE 0xE35F4 Kw_Wu16 65535.00 OneToOne 0.00 65535.00 FORMAT "%8.2" /end CHARACTERISTIC
/begin CHARACTERISTIC LSUCD_DebO2ClbOk_C "Heilungsentprellzähler für O2-Kalibrierungsfehler" VALUE 0xE35F6 Kw_Wu16 65535.00 OneToOne 0.00 65535.00 FORMAT "%8.2" /end CHARACTERISTIC
/begin CHARACTERISTIC LSUCD_DebRiClbDef_C "Defektentprellzähler des Ri-Kalibrierungsfehlers" VALUE 0xE36B8 Kw_Wu16 65535.00 OneToOne 0.00 65535.00 FORMAT "%8.2" /end CHARACTERISTIC
/begin CHARACTERISTIC LSUCD_DebRiClbOk_C "Heilungsentprellzähler des Ri-Kalibrierungsfehlers" VALUE 0xE36BA Kw_Wu16 65535.00 OneToOne 0.00 65535.00 FORMAT "%8.2" /end CHARACTERISTIC
/begin CHARACTERISTIC LSUCD_DebWireIpDef_C "Defektentprellzähler der Nebenschlusserkennung" VALUE 0xE372A Kw_Wu16 65535.00 OneToOne 0.00 65535.00 FORMAT "%8.2" /end CHARACTERISTIC
/begin CHARACTERISTIC LSUCD_DebWireIpOk_C "Heilungsentprellzähler der Nebenschlusserkennung" VALUE 0xE372C Kw_Wu16 65535.00 OneToOne 0.00 65535.00 FORMAT "%8.2" /end CHARACTERISTIC
/begin CHARACTERISTIC LSUCD_dmAirIKi_C "Verstärkung I-Regler bei Kleinsignalen" VALUE 0xE35AC Kw_Wu32 5.00003807247 Ki 0.00 5.00003807247 FORMAT "%13.11" EXTENDED_LIMITS 0.00 999999.999767 READ_ONLY /end CHARACTERISTIC
/begin CHARACTERISTIC LSUCD_dmAirIKiPos_C "Verstärkung I-Regler bei positiven Großsignalen" VALUE 0xE35B0 Kw_Wu32 5.00003807247 Ki 0.00 5.00003807247 FORMAT "%13.11" EXTENDED_LIMITS 0.00 999999.999767 READ_ONLY /end CHARACTERISTIC
/begin CHARACTERISTIC LSUCD_dmAirIKiNeg_C "Verstärkung I-Regler bei negativen Großsignalen" VALUE 0xE35B4 Kw_Wu32 5.00003807247 Ki 0.00 5.00003807247 FORMAT "%13.11" EXTENDED_LIMITS 0.00 999999.999767 READ_ONLY /end CHARACTERISTIC
/begin CHARACTERISTIC LSUCD_dmAirIWinPos_C "Obere Kleinsignalgrenze für  den I-Regler" VALUE 0xE35B8 Kw_Ws16 250.0000 AirMassPerTime 223.0000 473.0000 FORMAT "%8.4" EXTENDED_LIMITS -3276.800 3276.700 READ_ONLY /end CHARACTERISTIC
/begin CHARACTERISTIC LSUCD_dmAirIWinNeg_C "Untere Kleinsignalgrenze für den I-Regler" VALUE 0xE35BA Kw_Ws16 250.0000 AirMassPerTime 223.0000 473.0000 FORMAT "%8.4" EXTENDED_LIMITS -3276.800 3276.700 READ_ONLY /end CHARACTERISTIC
/begin CHARACTERISTIC LSUCD_dNumHtCoup_C "Anzahl der für ein signifikantes Resultat notwendigen Aktivierungen der Heizungskoplungsprüfung" VALUE 0xE372E Kw_Wu16 65535.00 OneToOne 0.00 65535.00 FORMAT "%8.2" /end CHARACTERISTIC
/begin CHARACTERISTIC LSUCD_EvalMaxVal_C "Oberer Grenzwert für Lernfortschrittsbewertung" VALUE 0xE35BC Kw_Ws16 0.6553500 O2 -0.3276800 0.3276700 FORMAT "%9.7" /end CHARACTERISTIC
/begin CHARACTERISTIC LSUCD_EvalMinVal_C "Unterer Grenzwert für Lernfortschrittsbewertung" VALUE 0xE35BE Kw_Ws16 0.6553500 O2 -0.3276800 0.3276700 FORMAT "%9.7" /end CHARACTERISTIC
/begin CHARACTERISTIC LSUCD_tiEvalFltInit_C "Zeitkonstante Bewertungsfilter für nicht adaptierten Zustand" VALUE 0xE35C0 Kw_Wu32 4294.9673 TimeDelay_s 0.0000010000000 4294.9673 FORMAT "%9.4" /end CHARACTERISTIC
/begin CHARACTERISTIC LSUCD_tiEvalFlt_C "Zeitkonstante Bewertungsfilter für adaptierten Zustand" VALUE 0xE35C4 Kw_Wu32 4294.9673 TimeDelay_s 0.0000010000000 4294.9673 FORMAT "%9.4" /end CHARACTERISTIC
/begin CHARACTERISTIC LSUCD_facPresCompLean_CUR "#SSD Kennlinie für Druckkorrekturfaktor bei magerem Luft-Kraftstoff-Gemisch" CURVE 0xE3660 Kl_Xs16_Ws16 7.999878 Fact -4.000000 3.999878 FORMAT "%8.6"
 /begin AXIS_DESCR STD_AXIS LSUCD_pExhGasLstVal_mp Pres_hPa 10 -32768.00 32767.00 FORMAT "%8.2" DEPOSIT ABSOLUTE /end AXIS_DESCR
/end CHARACTERISTIC
/begin CHARACTERISTIC LSUCD_facPresCompRich_CUR "#SSD Kennlinie für Druckkorrekturfaktor bei fettem Luft-Kraftstoff-Gemisch" CURVE 0xE368A Kl_Xs16_Ws16 7.999878 Fact -4.000000 3.999878 FORMAT "%8.6"
 /begin AXIS_DESCR STD_AXIS LSUCD_pExhGasLstVal_mp Pres_hPa 10 -32768.00 32767.00 FORMAT "%8.2" DEPOSIT ABSOLUTE /end AXIS_DESCR
/end CHARACTERISTIC
/begin CHARACTERISTIC LSUCD_mAirAdptActv_C "Minimalwert für Integral über Luftmassenstrom seit Schubbeginn für Aktivierung der Adaption" VAL_BLK 0xE35C8 Kwb_Ws16 6553.500 AirMass_2 -3276.800 3276.700 FORMAT "%8.3" NUMBER 1 /end CHARACTERISTIC
/begin CHARACTERISTIC LSUCD_stHtInvOut_C "Lambdas Sensor Heizerendstufe Invertierungsstatus" VALUE 0xE35D0 Kw_Wu8 1.000 OneToOne 0.00 1.000 FORMAT "%5.3" EXTENDED_LIMITS 0.00 255.0 /end CHARACTERISTIC
/begin CHARACTERISTIC LSUCD_tiHtPer_C "#SSD Periodendauer PWM Signal Heizwiderstand Ansteuerung" VALUE 0xE35D2 Kw_Ws16 6553.500 Period -3276.800 3276.700 FORMAT "%8.3" /end CHARACTERISTIC
/begin CHARACTERISTIC LSUCD_resRiMaxGrad_C "Maximale Änderung des Innenwiderstands zur Freigabe der Diagnose der Heizungskopplung" VALUE 0xE3730 Kw_Ws16 6553.500 Resist -3276.800 3276.700 FORMAT "%8.3" /end CHARACTERISTIC
/begin CHARACTERISTIC LSUCD_rO2IsolChkMax_C "Maximal zulässige Sauerstoffanzeige für kalte Sonde" VALUE 0xE3732 Kw_Ws16 0.6553500 O2 -0.3276800 0.3276700 FORMAT "%9.7" /end CHARACTERISTIC
/begin CHARACTERISTIC LSUCD_rO2IsolChkMin_C "Minimal zulässige Sauerstoffanzeige für kalte Sonde" VALUE 0xE3734 Kw_Ws16 0.6553500 O2 -0.3276800 0.3276700 FORMAT "%9.7" /end CHARACTERISTIC
/begin CHARACTERISTIC LSUCD_rO2SwtPresComp_C "Sauerstoffkonzentrationsgrenzwert für Umschaltung zwischen Druckkompensation für mageres und fettes Luft-Ktraftstoff-Gemisch" VALUE 0xE36B4 Kw_Ws16 0.6553500 O2 -0.3276800 0.3276700 FORMAT "%9.7" /end CHARACTERISTIC
/begin CHARACTERISTIC LSUCD_rO2_CUR "#SSD Kennlinie zur Umrechnung von Spannung in Sauerstoffkonzentration" CURVE 0xE35F8 Kl_Xs16_Ws16 0.6000000 O2 -0.3000000 0.3000000 FORMAT "%9.7" EXTENDED_LIMITS -0.3276800 0.3276700
 /begin AXIS_DESCR STD_AXIS LSUCD_uO2OfsCor_mp Volt 15 -1598.240 3998.045 FORMAT "%8.3" EXTENDED_LIMITS -160156.4 160151.5 DEPOSIT ABSOLUTE /end AXIS_DESCR
/end CHARACTERISTIC
/begin CHARACTERISTIC LSUCD_stCJ125CS_C "CJ125 chip select letzter Eintrag 0xC: LSU Funktionalität, 0xF: keine LSU Funktionalität" VAL_BLK 0xE371C Kwb_Wu8 15.00 OneToOne 0.00 15.00 FORMAT "%5.2" EXTENDED_LIMITS 0.00 255.0 NUMBER 5 /end CHARACTERISTIC
/begin CHARACTERISTIC LSUCD_stPumpCtlDis_C "#SSD Maske zur Auswahl der Betriebsart abhängigen Abschaltbedingungen für den Pumpstromregler" VALUE 0xE36B6 Kw_Wu8 255.0 OneToOne 0.00 255.0 FORMAT "%5.1" /end CHARACTERISTIC
/begin CHARACTERISTIC LSUCD_stRefCurHigh_C "Applikationskonstante zur Konfiguration des hohen Referenzpumpstroms von 0 bis 150uA" VALUE 0xE3721 Kw_Wu8 15.0000000000 CurRefPump 0.00 15.0000000000 FORMAT "%13.10" /end CHARACTERISTIC
/begin CHARACTERISTIC LSUCD_stRefCurNormal_C "Applikationskonstante zur Konfiguration des normalen Referenzpumpstroms von 0 bis 150uA" VALUE 0xE3722 Kw_Wu8 15.0000000000 CurRefPump 0.00 15.0000000000 FORMAT "%13.10" /end CHARACTERISTIC
/begin CHARACTERISTIC LSUCD_stWireDiaActv_C "Ansteuerungsflags für Diagnoseroutinen" VALUE 0xE3736 Kw_Wu16 65535.00 OneToOne 0.00 65535.00 FORMAT "%8.2" /end CHARACTERISTIC
/begin CHARACTERISTIC LSUCD_swtAdptVal_C "Schalterwert für Adaption der Lambda-Sonde (0= keine Adaption/ 1=Adaption)" VALUE 0xE35CA Kw_Wu8 1.000 OneToOne 0.00 1.000 FORMAT "%5.3" EXTENDED_LIMITS 0.00 255.0 /end CHARACTERISTIC
/begin CHARACTERISTIC LSUCD_swtAdptType_C "SW-Schaltertyp für Adaption der Lambda-Sonde (0=Datensatzwert, nicht applizierbar/1=EEPROM-Wert/2=Datensatzwert)" VALUE 0xE35CB Kw_Wu8 0.00 OneToOne 2.000 2.000 FORMAT "%5.3" EXTENDED_LIMITS 0.00 255.0 /end CHARACTERISTIC
/begin CHARACTERISTIC LSUCD_tAirAdptActv_C "Maximale Lufttemperatur für Aktivierung der Adaption" VALUE 0xE35CC Kw_Ws16 950.000 Temp_Cels -50.140 899.860 FORMAT "%8.3" EXTENDED_LIMITS -3549.940 3003.560 /end CHARACTERISTIC
/begin CHARACTERISTIC LSUCD_tiHtCoupChk_C "Zeitdauer der Heizungsabschaltung für Diagnose der Heizungskopplung" VALUE 0xE3738 Kw_Wu16 655.3500 Time_s 0.00 655.3500 FORMAT "%8.4" /end CHARACTERISTIC
/begin CHARACTERISTIC LSUCD_tiHtCoupPer_C "Zeitspanne zur Ansteuerung der Diagnose der Heizungskopplung" VALUE 0xE373A Kw_Wu16 655.3500 Time_s 0.00 655.3500 FORMAT "%8.4" /end CHARACTERISTIC
/begin CHARACTERISTIC LSUCD_tiIsolChkErr_C "Maximale Abkühlzeit LSU" VALUE 0xE373C Kw_Wu16 655.3500 Time_s 0.00 655.3500 FORMAT "%8.4" /end CHARACTERISTIC
/begin CHARACTERISTIC LSUCD_tiIsolChkPer_C "Periodendauer zur Einschaltung des Pumpstroms zur Nebenschlusserkennung" VALUE 0xE373E Kw_Wu16 655.3500 Time_s 0.00 655.3500 FORMAT "%8.4" /end CHARACTERISTIC
/begin CHARACTERISTIC LSUCD_tiIsolChkPump_C "Einschaltdauer für Pumpstrom bei Nebenschlusserkennung" VALUE 0xE3740 Kw_Wu16 655.3500 Time_s 0.00 655.3500 FORMAT "%8.4" /end CHARACTERISTIC
/begin CHARACTERISTIC LSUCD_tiO2ClbPT1_C "Filterzeitkonstante für Lernen Abgleichwert" VALUE 0xE3638 Kw_Wu32 4294.9673 TimeDelay_s 0.0000010000000 4294.9673 FORMAT "%9.4" /end CHARACTERISTIC
/begin CHARACTERISTIC LSUCD_tiO2PT1_C "Filterzeitkonstante für O2 Rohwertfilterung" VALUE 0xE363C Kw_Wu32 4294.9673 TimeDelay_s 0.0000010000000 4294.9673 FORMAT "%9.4" /end CHARACTERISTIC
/begin CHARACTERISTIC LSUCD_tiOpnLdTstActv_C "Zeitdauer der Kabelunterbrechungsdiagnose am Anschluss Nernst-Zelle(UN) und virtuelle Masse(VM)" VALUE 0xE374C Kw_Wu16 655.3500 Time_s 0.00 655.3500 FORMAT "%8.4" /end CHARACTERISTIC
/begin CHARACTERISTIC LSUCD_tiRiClbPT1_C "Zeitkonstante Ri Abgleichfilter" VALUE 0xE36BC Kw_Wu32 4294.9673 TimeDelay_s 0.0000010000000 4294.9673 FORMAT "%9.4" /end CHARACTERISTIC
/begin CHARACTERISTIC LSUCD_tiRiMeasDisa_C "Zeitdauer der Abschaltung der Ri-Messfrequenz" VALUE 0xE374E Kw_Wu16 655.3500 Time_s 0.00 655.3500 FORMAT "%8.4" /end CHARACTERISTIC
/begin CHARACTERISTIC LSUCD_tiRiPT1_C "Zeitkonstante Ri Filter" VALUE 0xE36C0 Kw_Wu32 4294.9673 TimeDelay_s 0.0000010000000 4294.9673 FORMAT "%9.4" /end CHARACTERISTIC
/begin CHARACTERISTIC LSUCD_tRi_CUR "#SSD Kennlinie zur Umrechnung des Innenwiderstands auf Äquivalenztemperatur" CURVE 0xE36C4 Kl_Xs16_Ws16 950.000 Temp_Cels -50.140 899.860 FORMAT "%8.3" EXTENDED_LIMITS -3549.940 3003.560
 /begin AXIS_DESCR STD_AXIS LSUCD_resRi_mp Resist 16 0.00 3000.000 FORMAT "%8.3" EXTENDED_LIMITS -3276.800 3276.700 DEPOSIT ABSOLUTE /end AXIS_DESCR
/end CHARACTERISTIC
/begin CHARACTERISTIC LSUCD_tiHtCoupFlt_C "Zeitkonstante Glättungsfilter in Diagnose der Heizungskopplung" VALUE 0xE3744 Kw_Wu32 4294.9673 TimeDelay_s 0.0000010000000 4294.9673 FORMAT "%9.4" /end CHARACTERISTIC
/begin CHARACTERISTIC LSUCD_uO2MaxGrad_C "Maximale Änderung des Sauerstoff-Spannungssignals zur Freigabe der Diagnose der Heizungskopplung" VALUE 0xE3748 Kw_Ws16 320307.9 Volt -160156.4 160151.5 FORMAT "%8.1" /end CHARACTERISTIC
/begin CHARACTERISTIC LSUCD_uO2MaxRippel_C "Maximal zulässige Änderung des Sauerstoff-Spannungssignals zur Abschaltung der Heizung" VALUE 0xE374A Kw_Ws16 320307.9 Volt -160156.4 160151.5 FORMAT "%8.1" /end CHARACTERISTIC
/begin CHARACTERISTIC LSUCD_uO2OpnLdNernstMax_C "Maximalspannung der Kabelunterbrechungsdiagnose am Anschluss Nerns-Zelle (UN)" VALUE 0xE3750 Kw_Ws16 5000.000 Volt 0.00 5000.000 FORMAT "%8.3" EXTENDED_LIMITS -160156.4 160151.5 /end CHARACTERISTIC
/begin CHARACTERISTIC LSUCD_uO2OpnLdNernstMin_C "Minimalspannung der Kabelunterbrechungsdiagnose am Anschluss Nerns-Zelle (UN)" VALUE 0xE3752 Kw_Ws16 6999.022 Volt -1999.022 5000.000 FORMAT "%8.3" EXTENDED_LIMITS -160156.4 160151.5 /end CHARACTERISTIC
/begin CHARACTERISTIC LSUCD_uO2OpnLdVirtGndMax_C "SRC-Maximalwert der Kabelunterbrechungsdiagnose am Anschluss virtuelle Masse (VM)" VALUE 0xE3754 Kw_Ws16 5097.752 Volt -97.75171 5000.000 FORMAT "%8.3" EXTENDED_LIMITS -160156.4 160151.5 /end CHARACTERISTIC
/begin CHARACTERISTIC LSUCD_uO2OpnLdVirtGndMin_C "SRC-Minimalwert der Kabelunterbrechungsdiagnose am Anschluss virtuelle Masse (VM)" VALUE 0xE3756 Kw_Ws16 5498.534 Volt -498.5337 5000.000 FORMAT "%8.3" EXTENDED_LIMITS -160156.4 160151.5 /end CHARACTERISTIC
/begin CHARACTERISTIC LSUCD_uRiOpnLdTstMax_C "Maximalwert der Ri-Spannung für Kabelunterbrechungsdiagnose am Anschluss Nernst-Zelle und virtuelle Masse" VALUE 0xE3758 Kw_Ws16 5200.391 Volt 0.00 5200.391 FORMAT "%8.3" EXTENDED_LIMITS -160156.4 160151.5 /end CHARACTERISTIC
/begin CHARACTERISTIC LSUCD_tiDebNoLdErrIPDef_C "Defekterkennungszeit der Kabelunterbrechungsdiagnose am Anschluss Pumpzelle (IP)" VALUE 0xE375A Kw_Wu16 655350.0 Time_ms 0.00 655350.0 FORMAT "%8.1" /end CHARACTERISTIC
/begin CHARACTERISTIC LSUCD_tiDebNoLdErrIPOk_C "Heilungsdauer der Kabelunterbrechungsdiagnose am Anschluss Pumpzelle (IP)" VALUE 0xE375C Kw_Wu16 655350.0 Time_ms 0.00 655350.0 FORMAT "%8.1" /end CHARACTERISTIC
/begin CHARACTERISTIC LSUCD_DebOpnLdVirtGndDef_C "Defektentprellzeit der Kabelabfallerkennung am Pin Virtuelle Masse" VALUE 0xE375E Kw_Wu16 655350.0 Time_ms 0.00 655350.0 FORMAT "%8.1" /end CHARACTERISTIC
/begin CHARACTERISTIC LSUCD_DebOpnLdVirtGndOk_C "Heilungsentprellzeit der Kabelabfallerkennung am Pin Virtuelle Masse" VALUE 0xE3760 Kw_Wu16 655350.0 Time_ms 0.00 655350.0 FORMAT "%8.1" /end CHARACTERISTIC
/begin CHARACTERISTIC LSUCD_DebOpnLdNernstDef_C "Defektentprellzeit der Kabelabfallerkennung am Pin UN" VALUE 0xE3762 Kw_Wu16 655350.0 Time_ms 0.00 655350.0 FORMAT "%8.1" /end CHARACTERISTIC
/begin CHARACTERISTIC LSUCD_DebOpnLdNernstOk_C "Heilungsentprellzeit der Kabelabfallerkennung am Pin UN" VALUE 0xE3764 Kw_Wu16 655350.0 Time_ms 0.00 655350.0 FORMAT "%8.1" /end CHARACTERISTIC
/begin CHARACTERISTIC LSUCD_tiDebHeaterDef_C "Defektentprellung Lambdasonden Heizerendstufe" VALUE 0xE35D4 Kw_Wu16 655350.0 Time_ms 0.00 655350.0 FORMAT "%8.1" /end CHARACTERISTIC
/begin CHARACTERISTIC LSUCD_tiDebHeaterOk_C "Heilungsentprellung der Heizerendstufe Lambdasensor" VALUE 0xE35D6 Kw_Wu16 655350.0 Time_ms 0.00 655350.0 FORMAT "%8.1" /end CHARACTERISTIC
/begin CHARACTERISTIC LSUCD_uBattNominal_C "#SSD Nominale Batteriespannung für Heizleistungskorrektur (= Spannung die 100 % entspricht)" VALUE 0xE35D8 Kw_Wu16 15992.18 Volt_Batt 0.00 15992.18 FORMAT "%8.2" EXTENDED_LIMITS 0.00 1281232. /end CHARACTERISTIC
/begin CHARACTERISTIC LSUCD_uBattMaxHigh_C "#SSD Schwelle für Abschaltung Heizeransteuern aufgrund zu hoher Batteriespannung" VALUE 0xE35DA Kw_Ws16 665630.5 Volt_Batt -640625.6 25004.89 FORMAT "%8.1" EXTENDED_LIMITS -640625.6 640606.1 /end CHARACTERISTIC
/begin CHARACTERISTIC LSUCD_uBattMaxLow_C "#SSD Schwelle für Rücknahme Abschaltung Heizeransteuern aufgrund zu hoher Batteriespannung" VALUE 0xE35DC Kw_Ws16 665630.5 Volt_Batt -640625.6 25004.89 FORMAT "%8.1" EXTENDED_LIMITS -640625.6 640606.1 /end CHARACTERISTIC
/begin CHARACTERISTIC LSUCD_stPwrStgDia_C "#SSD Verriegelungsmaske für Heizer Endstufen Diagnose" VALUE 0xE35DE Kw_Wu8 255.0 OneToOne 0.00 255.0 FORMAT "%5.1" /end CHARACTERISTIC
/begin CHARACTERISTIC LSUCD_dcycTstPowerStage_C "Tastverhältnis Endstufen Testimpuls" VALUE 0xE35E0 Kw_Ws16 50.00000 DtyCyc 0.00 50.00000 FORMAT "%8.5" EXTENDED_LIMITS -327.6800 327.6700 /end CHARACTERISTIC
/begin CHARACTERISTIC LSUCD_tiDebReset_C "Zeitverzögerung für zurücksetzen PWM Fehlerentprellung bei nicht aktiver Ansteuerung" VALUE 0xE35E2 Kw_Wu16 655350.0 Time_ms 0.00 655350.0 FORMAT "%8.1" /end CHARACTERISTIC
/begin CHARACTERISTIC LSUCD_stHtDis_C "#SSD Maske zur Auswahl der Betriebsmode abhängigen Abschaltbedingungen der Heizer Endstufe" VALUE 0xE35E4 Kw_Wu8 255.0 OneToOne 0.00 255.0 FORMAT "%5.1" /end CHARACTERISTIC
/begin CHARACTERISTIC LSUCD_stHeaterPwrStgSel_C "Applikationsparameter für die Heizerendstufe (1 für TLE6232)" VALUE 0xE35E5 Kw_Wu8 255.0 OneToOne 0.00 255.0 FORMAT "%5.1" /end CHARACTERISTIC
/begin CHARACTERISTIC LSUCD_tiHeaterBattDefDelay_C "Zeitverzögerung der Heizerdiagnose nachdem der Heizungsregeler aktiv ist" VALUE 0xE35E6 Kw_Wu16 655350.0 Time_ms 0.00 655350.0 FORMAT "%8.1" /end CHARACTERISTIC
/begin CHARACTERISTIC LSUCD_stRefPumpDis_C "#SSD Maske zur Auswahl der Betriebsart abhängigen Abschaltbedingungen für den Referenzpumpstrom" VALUE 0xE35E8 Kw_Wu8 255.0 OneToOne 0.00 255.0 FORMAT "%5.1" /end CHARACTERISTIC
/begin CHARACTERISTIC LSUCD_tiRefPumpHigh_C "Zeit für Regeneration Referenzzelle mit erhöhtem Pumpstrom" VALUE 0xE35EA Kw_Wu16 655350.0 Time_ms 0.00 655350.0 FORMAT "%8.1" /end CHARACTERISTIC
/begin CHARACTERISTIC LSUCD_tiRefTransLow_C "Verzögerungszeit bis zum Setzen des Bits in LSUCD_stRefPmp nach Übergang von hohem zu niedrigem Referenzpumpstrom" VALUE 0xE35EC Kw_Wu16 655350.0 Time_ms 0.00 655350.0 FORMAT "%8.1" /end CHARACTERISTIC
/begin CHARACTERISTIC LSUCD_tiRgnEna_C "Zeit-Periode für Regeneration" VALUE 0xE35EE Kw_Wu16 655350.0 Time_ms 0.00 655350.0 FORMAT "%8.1" /end CHARACTERISTIC
/begin CHARACTERISTIC LSUCD_tiRgnIpSettle_C "Zeitdauer zum Ausregeln des Pumpstroms nach Regeneration (nur für CJ125)" VALUE 0xE35F0 Kw_Wu16 655350.0 Time_ms 0.00 655350.0 FORMAT "%8.1" /end CHARACTERISTIC
/begin CHARACTERISTIC LSUCD_swtRgnChngCirct_C "Schalter der geänderten Hardware für die Pumpstromumkehr" VALUE 0xE35F2 Kw_Wu8 255.0 OneToOne 0.00 255.0 FORMAT "%5.1" /end CHARACTERISTIC
/begin CHARACTERISTIC LSUCD_tiDebLowBattErrDef_C "Defekterkennungszeit für Fehler niedrige Batteriespannung" VALUE 0xE3766 Kw_Wu16 655350.0 Time_ms 0.00 655350.0 FORMAT "%8.1" /end CHARACTERISTIC
/begin CHARACTERISTIC LSUCD_tiDebLowBattErrOk_C "Heilungszeit für Fehler niedrige Batteriespannung" VALUE 0xE3768 Kw_Wu16 655350.0 Time_ms 0.00 655350.0 FORMAT "%8.1" /end CHARACTERISTIC
/begin CHARACTERISTIC LSUCD_tiDebO2MaxTstDef_C "Defekt Entprellung der oberen Grenze  Sauerstoffsignal mit reduzierter Verstärkung" VALUE 0xE3640 Kw_Wu16 655350.0 Time_ms 0.00 655350.0 FORMAT "%8.1" /end CHARACTERISTIC
/begin CHARACTERISTIC LSUCD_tiDebO2MaxTstOk_C "Heilungs Entprellung der oberen Grenze  Sauerstoffsignal mit reduzierter Verstärkung" VALUE 0xE3642 Kw_Wu16 655350.0 Time_ms 0.00 655350.0 FORMAT "%8.1" /end CHARACTERISTIC
/begin CHARACTERISTIC LSUCD_tiDebO2MinDef_C "Defekt Entprellung der unteren Genze Sauerstoffsignal" VALUE 0xE3644 Kw_Wu16 655350.0 Time_ms 0.00 655350.0 FORMAT "%8.1" /end CHARACTERISTIC
/begin CHARACTERISTIC LSUCD_tiDebO2MinOk_C "Heilungsentprellung untere Grenze Sauerstoffsignal" VALUE 0xE3646 Kw_Wu16 655350.0 Time_ms 0.00 655350.0 FORMAT "%8.1" /end CHARACTERISTIC
/begin CHARACTERISTIC LSUCD_tiDebCircNernstDef_C "Defekt Entprellung des Nernst Anschlusses der Lambdasonde" VALUE 0xE376A Kw_Wu16 655350.0 Time_ms 0.00 655350.0 FORMAT "%8.1" /end CHARACTERISTIC
/begin CHARACTERISTIC LSUCD_tiDebCircNernstOk_C "Heilungsentprellung des Nernst Anschlusses Lambdasensor" VALUE 0xE376C Kw_Wu16 655350.0 Time_ms 0.00 655350.0 FORMAT "%8.1" /end CHARACTERISTIC
/begin CHARACTERISTIC LSUCD_tiDelO2Clb_C "Wartezeit auf Einschwingen O2 Abgleichwert" VALUE 0xE3648 Kw_Wu16 100.0000 Time_ms 0.00 100.0000 FORMAT "%8.4" EXTENDED_LIMITS 0.00 655350.0 /end CHARACTERISTIC
/begin CHARACTERISTIC LSUCD_tiO2Clb_C "Lernzeit O2 Abgleichwert" VALUE 0xE364A Kw_Wu16 100.0000 Time_ms 0.00 100.0000 FORMAT "%8.4" EXTENDED_LIMITS 0.00 655350.0 /end CHARACTERISTIC
/begin CHARACTERISTIC LSUCD_tiDelO2Val_C "Wartezeit auf Einschwingen O2 Meßwert nach Abgleich" VALUE 0xE364C Kw_Wu16 100.0000 Time_ms 0.00 100.0000 FORMAT "%8.4" EXTENDED_LIMITS 0.00 655350.0 /end CHARACTERISTIC
/begin CHARACTERISTIC LSUCD_uO2Ref_C "#SSD Sollspannung Auswerteschaltung bei Lambda = 1" VALUE 0xE364E Kw_Ws16 5000.000 Volt 0.00 5000.000 FORMAT "%8.3" EXTENDED_LIMITS -160156.4 160151.5 /end CHARACTERISTIC
/begin CHARACTERISTIC LSUCD_uO2ClbMax_C "Maximal zulässiger O2 Spannungskorrekturwert" VALUE 0xE3650 Kw_Ws16 320307.9 Volt -160156.4 160151.5 FORMAT "%8.1" /end CHARACTERISTIC
/begin CHARACTERISTIC LSUCD_uO2ClbMin_C "Minimal zulässiger O2 Spannungskorrekturwert" VALUE 0xE3652 Kw_Ws16 320307.9 Volt -160156.4 160151.5 FORMAT "%8.1" /end CHARACTERISTIC
/begin CHARACTERISTIC LSUCD_swtO2Filter_C "Schalter zur aktivierung der O2 Rohspannungs Filterung (0= Filter aus, 1 = Filter an)" VALUE 0xE3654 Kw_Wu8 1.000 OneToOne 0.00 1.000 FORMAT "%5.3" EXTENDED_LIMITS 0.00 255.0 /end CHARACTERISTIC
/begin CHARACTERISTIC LSUCD_uO2MaxNorm_C "Zulässige obere Spannungsgrenze für Normalkennlinie" VALUE 0xE3656 Kw_Ws16 5000.000 Volt 0.00 5000.000 FORMAT "%8.3" EXTENDED_LIMITS -160156.4 160151.5 /end CHARACTERISTIC
/begin CHARACTERISTIC LSUCD_uO2MaxTst_C "Zulässige obere Spannungsgrenze für Fettkennlinie (Nur für Test verwendet)" VALUE 0xE3658 Kw_Ws16 5000.000 Volt 0.00 5000.000 FORMAT "%8.3" EXTENDED_LIMITS -160156.4 160151.5 /end CHARACTERISTIC
/begin CHARACTERISTIC LSUCD_uO2Min_C "Unter Grenze Signalbereich" VALUE 0xE365A Kw_Ws16 5000.000 Volt 0.00 5000.000 FORMAT "%8.3" EXTENDED_LIMITS -160156.4 160151.5 /end CHARACTERISTIC
/begin CHARACTERISTIC LSUCD_swtSensDrftComp_C "Schalter zur Driftkompensation bei Auswahl eines Sensors hoher Empfindlichkeit[-]" VALUE 0xE365C Kw_Wu8 1.000 OneToOne 0.00 1.000 FORMAT "%5.3" EXTENDED_LIMITS 0.00 255.0 /end CHARACTERISTIC
/begin CHARACTERISTIC LSUCD_tiDebCircPumpDef_C "Defekt Entrpellung des Pumpstromanschlusses der Lambdasonde" VALUE 0xE376E Kw_Wu16 655350.0 Time_ms 0.00 655350.0 FORMAT "%8.1" /end CHARACTERISTIC
/begin CHARACTERISTIC LSUCD_tiDebCircPumpOk_C "Heilungsentprellung des Pumpstromanschlusses Lambdasensor" VALUE 0xE3770 Kw_Wu16 655350.0 Time_ms 0.00 655350.0 FORMAT "%8.1" /end CHARACTERISTIC
/begin CHARACTERISTIC LSUCD_tiDelRiClb_C "Wartezeit auf Einschwingen Ri Abgleichwert" VALUE 0xE3706 Kw_Wu16 100.0000 Time_ms 0.00 100.0000 FORMAT "%8.4" EXTENDED_LIMITS 0.00 655350.0 /end CHARACTERISTIC
/begin CHARACTERISTIC LSUCD_tiRiClb_C "Lernzeit Ri Abgleichwert" VALUE 0xE3708 Kw_Wu16 150.0000 Time_ms 0.00 150.0000 FORMAT "%8.4" EXTENDED_LIMITS 0.00 655350.0 /end CHARACTERISTIC
/begin CHARACTERISTIC LSUCD_tiDelRiVal_C "Wartezeit auf Einschwingen Ri Meßwert nach Abgleich" VALUE 0xE370A Kw_Wu16 100.0000 Time_ms 0.00 100.0000 FORMAT "%8.4" EXTENDED_LIMITS 0.00 655350.0 /end CHARACTERISTIC
/begin CHARACTERISTIC LSUCD_tiRiFltSettle_C "Maximale Zeitdauer zur Deaktivierung der Störungsunterdrückung" VALUE 0xE370C Kw_Wu16 3000.000 Time_ms 0.00 3000.000 FORMAT "%8.3" EXTENDED_LIMITS 0.00 655350.0 /end CHARACTERISTIC
/begin CHARACTERISTIC LSUCD_resRiMaxJmp_C "Maximal zulässige Ri-Änderung zwischen gemessenem und zuletzt gefiltertem Wert" VALUE 0xE370E Kw_Wu16 6553.500 Resist 0.00 6553.500 FORMAT "%8.3" /end CHARACTERISTIC
/begin CHARACTERISTIC LSUCD_uRiOfs_C "#SSD Sollspannung während Ri Offsetabgleich" VALUE 0xE3710 Kw_Ws16 5000.000 Volt 0.00 5000.000 FORMAT "%8.3" EXTENDED_LIMITS -160156.4 160151.5 /end CHARACTERISTIC
/begin CHARACTERISTIC LSUCD_facUToRi_C "#SSD Umrechnungsfaktor Meßspannung in Ri" VALUE 0xE3712 Kw_Ws16 1.289275 VoltToRes -0.6446474 0.6446277 FORMAT "%9.7" /end CHARACTERISTIC
/begin CHARACTERISTIC LSUCD_resRiClbRef_C "Wert Ri Referenzwiderstand" VALUE 0xE3714 Kw_Ws16 6553.500 Resist -3276.800 3276.700 FORMAT "%8.3" /end CHARACTERISTIC
/begin CHARACTERISTIC LSUCD_resRiClbMax_C "Maximal zulässiger Ri Korrekturwert" VALUE 0xE3716 Kw_Ws16 6553.500 Resist -3276.800 3276.700 FORMAT "%8.3" /end CHARACTERISTIC
/begin CHARACTERISTIC LSUCD_resRiClbMin_C "Minimal zulässiger Ri Korrekturwert" VALUE 0xE3718 Kw_Ws16 6553.500 Resist -3276.800 3276.700 FORMAT "%8.3" /end CHARACTERISTIC
/begin CHARACTERISTIC LSUCD_numRiDistSupp_C "Anzahl der aufeinanderfolgenden Zyklen zur Störungsunterdrückung" VALUE 0xE371A Kw_Wu8 255.0 OneToOne 0.00 255.0 FORMAT "%5.1" /end CHARACTERISTIC
/begin CHARACTERISTIC LSUCD_tiDebCircVirtGndDef_C "Defekt Entprellung der virtuellen Masse Lambdasensor" VALUE 0xE3772 Kw_Wu16 655350.0 Time_ms 0.00 655350.0 FORMAT "%8.1" /end CHARACTERISTIC
/begin CHARACTERISTIC LSUCD_tiDebCircVirtGndOk_C "Heilungsentprellung der virtuellen Masse Lambdasensor" VALUE 0xE3774 Kw_Wu16 655350.0 Time_ms 0.00 655350.0 FORMAT "%8.1" /end CHARACTERISTIC
/begin CHARACTERISTIC PwrMng_B_ulcp_C "Applikationslabel fuer Powermanagement" VALUE 0xE307A Kw_Wu8 255.0 OneToOne 0.00 255.0 FORMAT "%5.1" /end CHARACTERISTIC
/begin CHARACTERISTIC PwrMng_dmAirPerTimeCor_C "correction factor for air mass per time" VALUE 0xE307C Kw_Ws16 1500.000 SlopeRes10000 0.00 1500.000 FORMAT "%8.3" EXTENDED_LIMITS -3.276800 3.276700 /end CHARACTERISTIC
/begin CHARACTERISTIC PwrMng_dmAirPerTimeIMax_C "Maximum integrated air mass" VALUE 0xE307E Kw_Wu8 1500. AirMassPerTime 0.00 1500. FORMAT "%5.0" EXTENDED_LIMITS 0.00 25.50 /end CHARACTERISTIC
/begin CHARACTERISTIC PwrMng_dmAirPerTimeIMin_C "Integrated air mass minimum value" VALUE 0xE307F Kw_Wu8 1500. AirMassPerTime 0.00 1500. FORMAT "%5.0" EXTENDED_LIMITS 0.00 25.50 /end CHARACTERISTIC
/begin CHARACTERISTIC PwrMng_dmAirPerTimeIKi_C "I-governor gain, deviation is within small signal bounds" VALUE 0xE3080 Kw_Wu32 5.00003807247 Ki 0.00 5.00003807247 FORMAT "%13.11" EXTENDED_LIMITS 0.00 999999.999767 /end CHARACTERISTIC
/begin CHARACTERISTIC PwrMng_dmAirPerTimeIKiPos_C "I-governor gain, deviation is greater than small signal bound" VALUE 0xE3084 Kw_Wu32 5.00003807247 Ki 0.00 5.00003807247 FORMAT "%13.11" EXTENDED_LIMITS 0.00 999999.999767 /end CHARACTERISTIC
/begin CHARACTERISTIC PwrMng_dmAirPerTimeIKiNeg_C "I-governor gain, deviation is less than small signal bound" VALUE 0xE3088 Kw_Wu32 5.00003807247 Ki 0.00 5.00003807247 FORMAT "%13.11" EXTENDED_LIMITS 0.00 999999.999767 /end CHARACTERISTIC
/begin CHARACTERISTIC PwrMng_dmAirPerTimeIWinPos_C "I-governor positive window border" VALUE 0xE308C Kw_Ws16 1500.000 AirMassPerTime 0.00 1500.000 FORMAT "%8.3" EXTENDED_LIMITS -3276.800 3276.700 /end CHARACTERISTIC
/begin CHARACTERISTIC PwrMng_dmAirPerTimeIWinNeg_C "I-governor negative window border" VALUE 0xE308E Kw_Ws16 1500.000 AirMassPerTime 0.00 1500.000 FORMAT "%8.3" EXTENDED_LIMITS -3276.800 3276.700 /end CHARACTERISTIC
/begin CHARACTERISTIC PwrMng_nB_kwdreht_C "" VALUE 0xE3090 Kw_Ws16 6000.000 EngN 0.00 6000.000 FORMAT "%8.3" EXTENDED_LIMITS -32768.00 32767.00 /end CHARACTERISTIC
/begin CHARACTERISTIC PwrMng_nB_llHigh_C "High threshold for condition low idle" VALUE 0xE3092 Kw_Ws16 6000.000 EngN 0.00 6000.000 FORMAT "%8.3" EXTENDED_LIMITS -32768.00 32767.00 /end CHARACTERISTIC
/begin CHARACTERISTIC PwrMng_nB_llLow_C "Low threshold for condition low idle" VALUE 0xE3094 Kw_Ws16 6000.000 EngN 0.00 6000.000 FORMAT "%8.3" EXTENDED_LIMITS -32768.00 32767.00 /end CHARACTERISTIC
/begin CHARACTERISTIC PwrMng_rLoadMax_C "Threshold for condition maximum load" VALUE 0xE3096 Kw_Ws16 100.0000 Prc 0.00 100.0000 FORMAT "%8.4" EXTENDED_LIMITS -400.0000 399.9878 /end CHARACTERISTIC
/begin CHARACTERISTIC PwrMng_stIdlingDefVal_C "defect value for n_idlms" VALUE 0xE3098 Kw_Wu8 255.0 OneToOne 0.00 255.0 FORMAT "%5.1" /end CHARACTERISTIC
/begin CHARACTERISTIC PwrMng_swtnmot_w_C "switch for nmot_w (Eng_nAvrg/CrSCD_nCurr)" VALUE 0xE3099 Kw_Wu8 1.000 OneToOne 0.00 1.000 FORMAT "%5.3" EXTENDED_LIMITS 0.00 255.0 /end CHARACTERISTIC
/begin CHARACTERISTIC PwrMng_swtPmsvActiv_C "Applikationslabel fuer Powermanagement" VALUE 0xE309A Kw_Wu8 1.000 OneToOne 0.00 1.000 FORMAT "%5.3" EXTENDED_LIMITS 0.00 255.0 /end CHARACTERISTIC
/begin CHARACTERISTIC PwrMng_swttumg_C "switch for tumg (IATSCD_tAir/EATSCD_tAir)" VALUE 0xE309B Kw_Wu8 1.000 OneToOne 0.00 1.000 FORMAT "%5.3" EXTENDED_LIMITS 0.00 255.0 /end CHARACTERISTIC
/begin CHARACTERISTIC PwrMng_tiChgBatt_C "Applikationslabel fuer Powermanagement" VALUE 0xE309C Kw_Wu16 10000.00 Time_ms 0.00 10000.00 FORMAT "%8.2" EXTENDED_LIMITS 0.00 655350.0 /end CHARACTERISTIC
/begin CHARACTERISTIC PwrMng_tiHisRst_C "Applikationslabel fuer Powermanagement" VALUE 0xE309E Kw_Wu16 10000.00 Time_ms 0.00 10000.00 FORMAT "%8.2" EXTENDED_LIMITS 0.00 655350.0 /end CHARACTERISTIC
/begin CHARACTERISTIC PwrMng_Tkat_mod_C "" VALUE 0xE30A0 Kw_Ws16 327675.0 temp_ub_q5_o50 -163890.0 163785.0 FORMAT "%8.1" /end CHARACTERISTIC
/begin CHARACTERISTIC PwrMng_uAltTargetDefVal_C "defect value for ctrgnms" VALUE 0xE30A2 Kw_Ws16 65535.00 OneToOne -32768.00 32767.00 FORMAT "%8.2" /end CHARACTERISTIC
/begin MEASUREMENT BD_BSD "" UBYTE OneToOne 1 100 0.00 255.0 FORMAT "%5.1" ECU_ADDRESS 0x8FF7C0 /end MEASUREMENT
/begin MEASUREMENT BD_GEN "" UBYTE OneToOne 1 100 0.00 255.0 FORMAT "%5.1" ECU_ADDRESS 0x8FF7C1 /end MEASUREMENT
/begin MEASUREMENT BD_IBS1 "" UBYTE OneToOne 1 100 0.00 255.0 FORMAT "%5.1" ECU_ADDRESS 0x8FF7C2 /end MEASUREMENT
/begin MEASUREMENT BD_IBS2 "" UBYTE OneToOne 1 100 0.00 255.0 FORMAT "%5.1" ECU_ADDRESS 0x8FF7C3 /end MEASUREMENT
/begin MEASUREMENT BD_IBS3 "" UBYTE OneToOne 1 100 0.00 255.0 FORMAT "%5.1" ECU_ADDRESS 0x8FF7C4 /end MEASUREMENT
/begin MEASUREMENT BD_MANHYDR "" UBYTE OneToOne 1 100 0.00 255.0 FORMAT "%5.1" ECU_ADDRESS 0x8FF7C5 /end MEASUREMENT
/begin MEASUREMENT BD_MANLUFT "" UBYTE OneToOne 1 100 0.00 255.0 FORMAT "%5.1" ECU_ADDRESS 0x8FF7C6 /end MEASUREMENT
/begin MEASUREMENT BD_PMBATT "" UBYTE OneToOne 1 100 0.00 255.0 FORMAT "%5.1" ECU_ADDRESS 0x8FF7C7 /end MEASUREMENT
/begin MEASUREMENT BD_PMBN "" UBYTE OneToOne 1 100 0.00 255.0 FORMAT "%5.1" ECU_ADDRESS 0x8FF7C8 /end MEASUREMENT
/begin MEASUREMENT BD_PMRUHVERL "" UBYTE OneToOne 1 100 0.00 255.0 FORMAT "%5.1" ECU_ADDRESS 0x8FF7C9 /end MEASUREMENT
/begin MEASUREMENT BD_QLT "" UBYTE OneToOne 1 100 0.00 255.0 FORMAT "%5.1" ECU_ADDRESS 0x8FF7CA /end MEASUREMENT
/begin MEASUREMENT BD_TANS "" UBYTE OneToOne 1 100 0.00 255.0 FORMAT "%5.1" ECU_ADDRESS 0x8FF7CB /end MEASUREMENT
/begin MEASUREMENT BD_TOENS "" UBYTE OneToOne 1 100 0.00 255.0 FORMAT "%5.1" ECU_ADDRESS 0x8FF7CC /end MEASUREMENT
/begin MEASUREMENT BD_TUMG "" UBYTE OneToOne 1 100 0.00 255.0 FORMAT "%5.1" ECU_ADDRESS 0x8FF7CD /end MEASUREMENT
/begin MEASUREMENT Counter_Layer_fp1000_mp "" UBYTE OneToOne 1 100 0.00 255.0 FORMAT "%5.1" ECU_ADDRESS 0x8FF7F8 /end MEASUREMENT
/begin MEASUREMENT Counter_Layer_fp100_mp "" UBYTE OneToOne 1 100 0.00 255.0 FORMAT "%5.1" ECU_ADDRESS 0x8FF7F9 /end MEASUREMENT
/begin MEASUREMENT Counter_Layer_fp10_mp "" UBYTE OneToOne 1 100 0.00 255.0 FORMAT "%5.1" ECU_ADDRESS 0x8FF7FA /end MEASUREMENT
/begin MEASUREMENT Counter_Layer_fp200_mp "" UBYTE OneToOne 1 100 0.00 255.0 FORMAT "%5.1" ECU_ADDRESS 0x8FF7FB /end MEASUREMENT
/begin MEASUREMENT Counter_Layer_ini_mp "" UBYTE OneToOne 1 100 0.00 255.0 FORMAT "%5.1" ECU_ADDRESS 0x8FF7FC /end MEASUREMENT
/begin MEASUREMENT Counter_Layer_nl1000_mp "" UBYTE OneToOne 1 100 0.00 255.0 FORMAT "%5.1" ECU_ADDRESS 0x8FF7FD /end MEASUREMENT
/begin MEASUREMENT Counter_Layer_nl100_mp "" UBYTE OneToOne 1 100 0.00 255.0 FORMAT "%5.1" ECU_ADDRESS 0x8FF7FE /end MEASUREMENT
/begin MEASUREMENT Counter_Layer_nl10_mp "" UBYTE OneToOne 1 100 0.00 255.0 FORMAT "%5.1" ECU_ADDRESS 0x8FF7FF /end MEASUREMENT
/begin MEASUREMENT Counter_Layer_nl200_mp "" UBYTE OneToOne 1 100 0.00 255.0 FORMAT "%5.1" ECU_ADDRESS 0x8FF800 /end MEASUREMENT
/begin MEASUREMENT Counter_Layer_wakeup1000_mp "" UBYTE OneToOne 1 100 0.00 255.0 FORMAT "%5.1" ECU_ADDRESS 0x8FF801 /end MEASUREMENT
/begin MEASUREMENT Counter_Layer_wakeup100_mp "" UBYTE OneToOne 1 100 0.00 255.0 FORMAT "%5.1" ECU_ADDRESS 0x8FF802 /end MEASUREMENT
/begin MEASUREMENT Counter_Layer_wakeup10_mp "" UBYTE OneToOne 1 100 0.00 255.0 FORMAT "%5.1" ECU_ADDRESS 0x8FF803 /end MEASUREMENT
/begin MEASUREMENT Counter_Layer_wakeup200_mp "" UBYTE OneToOne 1 100 0.00 255.0 FORMAT "%5.1" ECU_ADDRESS 0x8FF804 /end MEASUREMENT
/begin MEASUREMENT E_BSD "" UBYTE OneToOne 1 100 0.00 255.0 FORMAT "%5.1" ECU_ADDRESS 0x8FF7CE /end MEASUREMENT
/begin MEASUREMENT E_GEN "" UBYTE OneToOne 1 100 0.00 255.0 FORMAT "%5.1" ECU_ADDRESS 0x8FF7CF /end MEASUREMENT
/begin MEASUREMENT E_IBS1 "" UBYTE OneToOne 1 100 0.00 255.0 FORMAT "%5.1" ECU_ADDRESS 0x8FF7D0 /end MEASUREMENT
/begin MEASUREMENT E_IBS2 "" UBYTE OneToOne 1 100 0.00 255.0 FORMAT "%5.1" ECU_ADDRESS 0x8FF7D1 /end MEASUREMENT
/begin MEASUREMENT E_IBS3 "" UBYTE OneToOne 1 100 0.00 255.0 FORMAT "%5.1" ECU_ADDRESS 0x8FF7D2 /end MEASUREMENT
/begin MEASUREMENT E_MANHYDR "" UBYTE OneToOne 1 100 0.00 255.0 FORMAT "%5.1" ECU_ADDRESS 0x8FF7D3 /end MEASUREMENT
/begin MEASUREMENT E_MANLUFT "" UBYTE OneToOne 1 100 0.00 255.0 FORMAT "%5.1" ECU_ADDRESS 0x8FF7D4 /end MEASUREMENT
/begin MEASUREMENT E_PMBATT "" UBYTE OneToOne 1 100 0.00 255.0 FORMAT "%5.1" ECU_ADDRESS 0x8FF7D5 /end MEASUREMENT
/begin MEASUREMENT E_PMBN "" UBYTE OneToOne 1 100 0.00 255.0 FORMAT "%5.1" ECU_ADDRESS 0x8FF7D6 /end MEASUREMENT
/begin MEASUREMENT E_PMRUHVERL "" UBYTE OneToOne 1 100 0.00 255.0 FORMAT "%5.1" ECU_ADDRESS 0x8FF7D7 /end MEASUREMENT
/begin MEASUREMENT E_QLT "" UBYTE OneToOne 1 100 0.00 255.0 FORMAT "%5.1" ECU_ADDRESS 0x8FF7D8 /end MEASUREMENT
/begin MEASUREMENT E_TANS "" UBYTE OneToOne 1 100 0.00 255.0 FORMAT "%5.1" ECU_ADDRESS 0x8FF7D9 /end MEASUREMENT
/begin MEASUREMENT E_TOENS "" UBYTE OneToOne 1 100 0.00 255.0 FORMAT "%5.1" ECU_ADDRESS 0x8FF7DA /end MEASUREMENT
/begin MEASUREMENT E_TUMG "" UBYTE OneToOne 1 100 0.00 255.0 FORMAT "%5.1" ECU_ADDRESS 0x8FF7DB /end MEASUREMENT
/begin MEASUREMENT InjVlv_facFTSWvCor "Faktor der Druckwellenkorrektur abhängig von der Kraftstofftemperatur" SWORD Fact 1 100 -4.000000 3.999878 FORMAT "%8.6" ECU_ADDRESS 0x7F8EA2 /end MEASUREMENT
/begin MEASUREMENT InjVlv_facMI1PoI2WvCor_mp "Druckwellenkorrekturfaktor für PoI2" SWORD Fact1 1 100 -256.0000 255.9922 FORMAT "%8.4" ECU_ADDRESS 0x8FF6E8 /end MEASUREMENT
/begin MEASUREMENT InjVlv_facPiI2PiI1WvCor_mp "Druckwellenkorrekturfaktor der PiI1" SWORD Fact1 1 100 -256.0000 255.9922 FORMAT "%8.4" ECU_ADDRESS 0x8FF6EA /end MEASUREMENT
/begin MEASUREMENT InjVlv_facPiIMI1WvCor_mp "Druckwellenkorrekturfaktor der MI1" SWORD Fact1 1 100 -256.0000 255.9922 FORMAT "%8.4" ECU_ADDRESS 0x8FF6EC /end MEASUREMENT
/begin MEASUREMENT InjVlv_pAct_mp "aktueller Raildruck ermittelt in InjVlv" SWORD Pres_Rail 1 100 -3276.800 3276.700 FORMAT "%5.3" ECU_ADDRESS 0x8FF6E6 /end MEASUREMENT
/begin MEASUREMENT InjVlv_qMI1PoI2WvCor_mp "Grundwert der Druckwellenkorrekturmenge der PoI2" SWORD InjMassInj 1 100 -327.6800 327.6700 FORMAT "%8.4" ECU_ADDRESS 0x8FF6EE /end MEASUREMENT
/begin MEASUREMENT InjVlv_qMI1WvCor_mp "Druckwellenkorrekturmenge der MI1" SWORD InjMassInj 1 100 -327.6800 327.6700 FORMAT "%8.4" ECU_ADDRESS 0x8FF6F0 /end MEASUREMENT
/begin MEASUREMENT InjVlv_qPiI1MI1WvCor_mp "Grundwert der Druckwellenkorrekturmenge der MI1 abhängig von PiI1" SWORD InjMassInj 1 100 -327.6800 327.6700 FORMAT "%8.4" ECU_ADDRESS 0x8FF6F2 /end MEASUREMENT
/begin MEASUREMENT InjVlv_qPiI1WvCor_mp "Druckwellenkorrekturmenge der PiI1" SWORD InjMassInj 1 100 -327.6800 327.6700 FORMAT "%8.4" ECU_ADDRESS 0x8FF6F4 /end MEASUREMENT
/begin MEASUREMENT InjVlv_qPiI2MI1WvCor_mp "Grundwert der Druckwellenkorrekturmenge der MI1 abhängig von PiI2" SWORD InjMassInj 1 100 -327.6800 327.6700 FORMAT "%8.4" ECU_ADDRESS 0x8FF6F6 /end MEASUREMENT
/begin MEASUREMENT InjVlv_qPiI2PiI1WvCor_mp "Grundwert der Druckwellenkorrekturmenge der PiI1" SWORD InjMassInj 1 100 -327.6800 327.6700 FORMAT "%8.4" ECU_ADDRESS 0x8FF6F8 /end MEASUREMENT
/begin MEASUREMENT InjVlv_qPoI2WvCor_mp "Druckwellenkorrekturmenge der PoI2" SWORD InjMassInj 1 100 -327.6800 327.6700 FORMAT "%8.4" ECU_ADDRESS 0x8FF6FA /end MEASUREMENT
/begin MEASUREMENT InjVlv_qWvCorNorm "Einspritznormierungsmenge" SWORD InjMassInj 1 100 -327.6800 327.6700 FORMAT "%8.4" ECU_ADDRESS 0x7F8EA8 /end MEASUREMENT
/begin MEASUREMENT InjVlv_rMI1WvCorNorm_mp "Raildruckabhängiges normiertes MI1 Einspritzverhältnis für Druckwellenkorrektur" SWORD QntR 1 100 -32.00000 31.99902 FORMAT "%8.5" ECU_ADDRESS 0x8FF6FC /end MEASUREMENT
/begin MEASUREMENT InjVlv_stWvCor "Status der Druckwellenkorrektur" UBYTE OneToOne 1 100 0.00 255.0 FORMAT "%5.1" ECU_ADDRESS 0x7F88E6 /end MEASUREMENT
/begin MEASUREMENT InjVlv_tiMI1PoI2Cor_mp "korrigierter Zeitabstand Ende MI1 bis Beginn PoI2" SWORD InjTime_us 1 100 -32768.00 32767.00 FORMAT "%8.2" ECU_ADDRESS 0x8FF6FE /end MEASUREMENT
/begin MEASUREMENT InjVlv_tiMI1PoI2HydCor_mp "hyd. korrigierter Zeitabstand Ende MI1 bis Beginn PoI2" UWORD InjTime_us 1 100 0.00 65535.00 FORMAT "%8.2" ECU_ADDRESS 0x8FF700 /end MEASUREMENT
/begin MEASUREMENT InjVlv_tiMI1PoI2_mp "Zeitabstand ende MI1 bis Beginn PoI2" UWORD InjTime_us 1 100 0.00 65535.00 FORMAT "%8.2" ECU_ADDRESS 0x8FF702 /end MEASUREMENT
/begin MEASUREMENT InjVlv_tiPiI1MI1Cor_mp "korrigierter Zeitabstand Ende PiI1 bis Beginn MI1" SWORD InjTime_us 1 100 -32768.00 32767.00 FORMAT "%8.2" ECU_ADDRESS 0x8FF704 /end MEASUREMENT
/begin MEASUREMENT InjVlv_tiPiI1MI1_mp "korrigierter Zeitabstand Ende PiI1 bis Beginn MI1" UWORD InjTime_us 1 100 0.00 65535.00 FORMAT "%8.2" ECU_ADDRESS 0x8FF706 /end MEASUREMENT
/begin MEASUREMENT InjVlv_tiPiI2MI1Cor_mp "korrigierter Zeitabstand Ende PiI2 bis Beginn MI1" SWORD InjTime_us 1 100 -32768.00 32767.00 FORMAT "%8.2" ECU_ADDRESS 0x8FF708 /end MEASUREMENT
/begin MEASUREMENT InjVlv_tiPiI2MI1_mp "Zeitabstand Ende PiI2 bis Beginn MI1" UWORD InjTime_us 1 100 0.00 65535.00 FORMAT "%8.2" ECU_ADDRESS 0x8FF70A /end MEASUREMENT
/begin MEASUREMENT InjVlv_tiPiI2PiI1Cor_mp "korrigierter Zeitabstand Ende PiI2 bis Beginn PiI1" SWORD InjTime_us 1 100 -32768.00 32767.00 FORMAT "%8.2" ECU_ADDRESS 0x8FF70C /end MEASUREMENT
/begin MEASUREMENT InjVlv_tiPiI2PiI1_mp "Zeitabstand Ende PiI2 bis Beginn PiI1" UWORD InjTime_us 1 100 0.00 65535.00 FORMAT "%8.2" ECU_ADDRESS 0x8FF70E /end MEASUREMENT
/begin MEASUREMENT InjVlv_tWvCor_mp "Eingangstemperatur fuer die Druckwellenkorrektur" SWORD Temp_Cels 1 100 -50.140 899.860 FORMAT "%8.3" ECU_ADDRESS 0x8FF6E4 /end MEASUREMENT
/begin MEASUREMENT IVCtl_iChrgUp2_mp "zweite Stromgrenze für Piezoaktor Laden" SWORD Curr 1 100 -32768.00 32767.00 FORMAT "%8.2" ECU_ADDRESS 0x8FF710 /end MEASUREMENT
/begin MEASUREMENT IVCtl_iChrgUpPI_mp "Reglerausgang Ladezeitregler" SWORD Curr 1 100 -32768.00 32767.00 FORMAT "%8.2" ECU_ADDRESS 0x8FF712 /end MEASUREMENT
/begin MEASUREMENT IVCtl_iChrgUp_mp "Ladestrom für Aktor" SWORD Curr 1 100 -32768.00 32767.00 FORMAT "%8.2" ECU_ADDRESS 0x8FF714 /end MEASUREMENT
/begin MEASUREMENT IVCtl_iDisChDwn "Entladestrom für Piezoaktor" SWORD Curr 1 100 -32768.00 32767.00 FORMAT "%8.2" ECU_ADDRESS 0x7F8D52 /end MEASUREMENT
/begin MEASUREMENT IVCtl_iDisChDwn2 "zweite Stromgrenze für Piezoaktor entladen" SWORD Curr 1 100 -32768.00 32767.00 FORMAT "%8.2" ECU_ADDRESS 0x7F8D54 /end MEASUREMENT
/begin MEASUREMENT IVCtl_iDisChDwnPI_mp "Ausgang Entladezeitregler" SWORD Curr 1 100 -32768.00 32767.00 FORMAT "%8.2" ECU_ADDRESS 0x8FF716 /end MEASUREMENT
/begin MEASUREMENT IVCtl_stAvrgEnaTiWarnVolt_mp "zylinderspezifische Statusanzeige: Voltregler wird durch die Message InjVCD_stAvrgEnaTiWarn freigegeben" UBYTE OneToOne 1 100 0.00 255.0 FORMAT "%5.1" ECU_ADDRESS 0x8FF778 /end MEASUREMENT
/begin MEASUREMENT IVCtl_stTiChrgPI "Status der Ladezeitregler (geregelt = FALSE, eingefroren = 1)" UBYTE OneToOne 1 100 0.00 255.0 FORMAT "%5.1" ECU_ADDRESS 0x7F88B0 /end MEASUREMENT
/begin MEASUREMENT IVCtl_stVoltPI "Status des PI-Reglers (bit 0-2:obere Grenze, bit 3-5:untere Grenze - 0:top, 1:up, 2:dwn, 3:top, 4:up, 5:dwn)" UBYTE OneToOne 1 100 0.00 255.0 FORMAT "%5.1" ECU_ADDRESS 0x7F88B1 /end MEASUREMENT
/begin MEASUREMENT IVCtl_tiChrgSetUp_mp "Ausgang von IVCtl_tiChrgSetUp_CUR" SWORD Time_Busy 1 100 -3276.800 3276.700 FORMAT "%8.3" ECU_ADDRESS 0x8FF718 /end MEASUREMENT
/begin MEASUREMENT IVCtl_tiChrgUpAvrg_mp "Mittelwert der gemessenen Ladezeiten" SWORD Time_Busy 1 100 -3276.800 3276.700 FORMAT "%8.3" ECU_ADDRESS 0x8FF71A /end MEASUREMENT
/begin MEASUREMENT IVCtl_tiChrgUpInPI "Eingangsgröße für den Ladezeitregler" SWORD Time_Busy 1 100 -3276.800 3276.700 FORMAT "%8.3" ECU_ADDRESS 0x7F8D56 /end MEASUREMENT
/begin MEASUREMENT IVCtl_tiChrgUpInPIActr_mp "Regelabweichung der Ladezeit (aktorspezifisch)" SWORD Time_Busy 1 100 -3276.800 3276.700 FORMAT "%8.3" ARRAY_SIZE 6 ECU_ADDRESS 0x8FF71C /end MEASUREMENT
/begin MEASUREMENT IVCtl_tiChrgUpMaxActr_mp "Maximale Regelabweichung der Ladezeit (aktorspezifisch)" SWORD Time_Busy 1 100 -3276.800 3276.700 FORMAT "%8.3" ARRAY_SIZE 6 ECU_ADDRESS 0x8FF728 /end MEASUREMENT
/begin MEASUREMENT IVCtl_tiChrgUpMax_mp "Maximale Regelabweichung der Ladezeit (gemittelt)" SWORD Time_Busy 1 100 -3276.800 3276.700 FORMAT "%8.3" ECU_ADDRESS 0x8FF734 /end MEASUREMENT
/begin MEASUREMENT IVCtl_tiChrgUpMinActr_mp "Minimale Regelabweichung der Ladezeit (aktorspezifisch)" SWORD Time_Busy 1 100 -3276.800 3276.700 FORMAT "%8.3" ARRAY_SIZE 6 ECU_ADDRESS 0x8FF736 /end MEASUREMENT
/begin MEASUREMENT IVCtl_tiChrgUpMin_mp "Minimale Regelabweichung der Ladezeit (gemittelt)" SWORD Time_Busy 1 100 -3276.800 3276.700 FORMAT "%8.3" ECU_ADDRESS 0x8FF742 /end MEASUREMENT
/begin MEASUREMENT IVCtl_tiChrgUpPse_mp "Pausezeit für Ladezeitregler" SWORD Time_Busy 1 100 -3276.800 3276.700 FORMAT "%8.3" ECU_ADDRESS 0x8FF744 /end MEASUREMENT
/begin MEASUREMENT IVCtl_tiDisChBottAvrg_mp "Mittelwert der gemessenen Entladezeiten" SWORD Time_Busy 1 100 -3276.800 3276.700 FORMAT "%8.3" ECU_ADDRESS 0x8FF746 /end MEASUREMENT
/begin MEASUREMENT IVCtl_tiDisChDwnInPI "Eingangsgröße des Entladezeitreglers" SWORD Time_Busy 1 100 -3276.800 3276.700 FORMAT "%8.3" ECU_ADDRESS 0x7F8D58 /end MEASUREMENT
/begin MEASUREMENT IVCtl_tiDisChDwnInPIActr_mp "Regelabweichung der Entladezeit (zylinderspezifisch)" SWORD Time_Busy 1 100 -3276.800 3276.700 FORMAT "%8.3" ARRAY_SIZE 6 ECU_ADDRESS 0x8FF748 /end MEASUREMENT
/begin MEASUREMENT IVCtl_tiDisChDwnMaxActr_mp "Maximale Regelabweichung der Entladezeit (aktorspezifisch)" SWORD Time_Busy 1 100 -3276.800 3276.700 FORMAT "%8.3" ARRAY_SIZE 6 ECU_ADDRESS 0x8FF754 /end MEASUREMENT
/begin MEASUREMENT IVCtl_tiDisChDwnMax_mp "Maximale Regelabweichung der Entladezeit (gemittelt)" SWORD Time_Busy 1 100 -3276.800 3276.700 FORMAT "%8.3" ECU_ADDRESS 0x8FF760 /end MEASUREMENT
/begin MEASUREMENT IVCtl_tiDisChDwnMinActr_mp "Minimale Regelabweichung der Entladezeit (aktorspezifisch)" SWORD Time_Busy 1 100 -3276.800 3276.700 FORMAT "%8.3" ARRAY_SIZE 6 ECU_ADDRESS 0x8FF762 /end MEASUREMENT
/begin MEASUREMENT IVCtl_tiDisChDwnMin_mp "Minimale Regelabweichung der Entlladezeit (gemittelt)" SWORD Time_Busy 1 100 -3276.800 3276.700 FORMAT "%8.3" ECU_ADDRESS 0x8FF76E /end MEASUREMENT
/begin MEASUREMENT IVCtl_tiDisChDwnPse_mp "Pausezeit für Entladezeitregler" SWORD Time_Busy 1 100 -3276.800 3276.700 FORMAT "%8.3" ECU_ADDRESS 0x8FF770 /end MEASUREMENT
/begin MEASUREMENT IVCtl_tiDisChSetDwn_mp "Ausgang von IVCtl_tiDisChSetDwn_CUR" SWORD Time_Busy 1 100 -3276.800 3276.700 FORMAT "%8.3" ECU_ADDRESS 0x8FF772 /end MEASUREMENT
/begin MEASUREMENT IVCtl_uClsActrUp "Spannungssollwert für Aktorklassifizierung" SWORD Volt_PA 1 100 -327.6800 327.6700 FORMAT "%8.4" ECU_ADDRESS 0x7F8D5A /end MEASUREMENT
/begin MEASUREMENT IVCtl_uCorrUp "Reglerausgang zur Korrektur der Aktorspannung" SWORD Volt_PA 1 100 -327.6800 327.6700 FORMAT "%8.4" ECU_ADDRESS 0x7F8D5C /end MEASUREMENT
/begin MEASUREMENT IVCtl_uSetBott "Spannungssollwert für Bottom-Level" SWORD Volt_PA 1 100 -327.6800 327.6700 FORMAT "%8.4" ECU_ADDRESS 0x7F8D5E /end MEASUREMENT
/begin MEASUREMENT IVCtl_uSetOfsActr "Spannungssollwert fuer Spannungsoffsetberechnung" SWORD Volt_PA 1 100 -327.6800 327.6700 FORMAT "%8.4" ARRAY_SIZE 6 ECU_ADDRESS 0x7F9254 /end MEASUREMENT
/begin MEASUREMENT IVCtl_uSetUp2Avrg_mp "Piezoaktorspannung gemittelt (Differenz Bottom zu Up Niveau minus Offset)" SWORD Volt_PA 1 100 -327.6800 327.6700 FORMAT "%8.4" ECU_ADDRESS 0x8FF774 /end MEASUREMENT
/begin MEASUREMENT IVCtl_uSetUpActr "Mittlerer aktorspezifischer Spannungssollwert für Piezo-Aktor (up-level)" SWORD Volt_PA 1 100 -327.6800 327.6700 FORMAT "%8.4" ARRAY_SIZE 6 ECU_ADDRESS 0x7F9260 /end MEASUREMENT
/begin MEASUREMENT IVCtl_uSetUpActrUnCorr_mp "unkorrigierter Spannungssollwert (Up-Niveau)" SWORD Volt_PA 1 100 -327.6800 327.6700 FORMAT "%8.4" ARRAY_SIZE 6 ECU_ADDRESS 0x8FF77A /end MEASUREMENT
/begin MEASUREMENT IVCtl_uSetUpActrUnLim_mp "Nicht begrenzter, korrigierter, mittlerer, aktorspezifischer Spannungssollwert für Piezo-Aktor (up-level)" SWORD Volt_PA 1 100 -327.6800 327.6700 FORMAT "%8.4" ARRAY_SIZE 6 ECU_ADDRESS 0x8FF786 /end MEASUREMENT
/begin MEASUREMENT IVCtl_uSetUpAvrg_mp "Gemittelter Spannungswert" SWORD Volt_PA 1 100 -327.6800 327.6700 FORMAT "%8.4" ECU_ADDRESS 0x8FF776 /end MEASUREMENT
/begin MEASUREMENT IVCtl_uSetUpPreCtl_mp "Vorsteuerwert für Spannungssollwertberechnung" SWORD Volt_PA 1 100 -327.6800 327.6700 FORMAT "%8.4" ECU_ADDRESS 0x8FF792 /end MEASUREMENT
/begin MEASUREMENT IVCtl_uSetUpTmp_mp "Temporärer gemittelter und gefilterter Spannungssollwert des Piezo-Aktors (up-level)" SWORD Volt_PA 1 100 -327.6800 327.6700 FORMAT "%8.4" ECU_ADDRESS 0x8FF794 /end MEASUREMENT
/begin MEASUREMENT IVCtl_uUpInPI "Eingangsgröße der Spannungsreglers" SWORD Volt_PA 1 100 -327.6800 327.6700 FORMAT "%8.4" ECU_ADDRESS 0x7F8D60 /end MEASUREMENT
/begin MEASUREMENT IVCtl_uUpInPIActr_mp "Regelabweichung des Spannungsreglers (aktorspezifisch)" SWORD Volt_PA 1 100 -327.6800 327.6700 FORMAT "%8.4" ARRAY_SIZE 6 ECU_ADDRESS 0x8FF796 /end MEASUREMENT
/begin MEASUREMENT IVCtl_uUpInPIMaxActr_mp "Maximale Regelabweichung des Spannungsreglers (aktorspezifisch)" SWORD Volt_PA 1 100 -327.6800 327.6700 FORMAT "%8.4" ARRAY_SIZE 6 ECU_ADDRESS 0x8FF7A2 /end MEASUREMENT
/begin MEASUREMENT IVCtl_uUpInPIMax_mp "Maximale Regelabweichung des Spannungsreglers (gemittelt)" SWORD Volt_PA 1 100 -327.6800 327.6700 FORMAT "%8.4" ECU_ADDRESS 0x8FF7AE /end MEASUREMENT
/begin MEASUREMENT IVCtl_uUpInPIMinActr_mp "Minimale Regelabweichung des Spannungsreglers (aktorspezifisch)" SWORD Volt_PA 1 100 -327.6800 327.6700 FORMAT "%8.4" ARRAY_SIZE 6 ECU_ADDRESS 0x8FF7B0 /end MEASUREMENT
/begin MEASUREMENT IVCtl_uUpInPIMin_mp "Minimale Regelabweichung des Spannungsreglers (gemittelt)" SWORD Volt_PA 1 100 -327.6800 327.6700 FORMAT "%8.4" ECU_ADDRESS 0x8FF7BC /end MEASUREMENT
/begin MEASUREMENT IVCtl_uUpTmp_mp "Gemittelte Spannungsistwerte des Piezoaktors (Up-Niveau)" SWORD Volt_PA 1 100 -327.6800 327.6700 FORMAT "%8.4" ECU_ADDRESS 0x8FF7BE /end MEASUREMENT
/begin MEASUREMENT Layer_bos01_w "" SWORD km_sw_q10 1 100 -327680.0 327670.0 FORMAT "%8.1" ECU_ADDRESS 0x7F8F20 /end MEASUREMENT
/begin MEASUREMENT Layer_bosbtvfbk "" UBYTE rel_ub_q1 1 100 0.00 255.0 FORMAT "%5.1" ECU_ADDRESS 0x7F8914 /end MEASUREMENT
/begin MEASUREMENT Layer_bosstate "" UBYTE DEZ 1 100 0.00 255.0 FORMAT "%5.1" ECU_ADDRESS 0x7F8915 /end MEASUREMENT
/begin MEASUREMENT Layer_bosvalue_DIAG "" UBYTE OneToOne 1 100 0.00 255.0 FORMAT "%5.1" ARRAY_SIZE 6 ECU_ADDRESS 0x7F921E /end MEASUREMENT
/begin MEASUREMENT Layer_FRC_INTM_T_BOS2 "" UBYTE DEZ 1 100 0.00 255.0 FORMAT "%5.1" ECU_ADDRESS 0x7F890F /end MEASUREMENT
/begin MEASUREMENT Layer_FRC_INTM_WAY_BOS2 "" UBYTE DEZ 1 100 0.00 255.0 FORMAT "%5.1" ECU_ADDRESS 0x7F8910 /end MEASUREMENT
/begin MEASUREMENT Layer_ID2_BOS2 "" UBYTE DEZ 1 100 0.00 255.0 FORMAT "%5.1" ECU_ADDRESS 0x7F8911 /end MEASUREMENT
/begin MEASUREMENT Layer_idbosmsg "" UBYTE DEZ 1 100 0.00 255.0 FORMAT "%5.1" ECU_ADDRESS 0x7F8916 /end MEASUREMENT
/begin MEASUREMENT Layer_idfbosmg_w "" UWORD DEZ 1 100 0.00 65535.00 FORMAT "%8.2" ECU_ADDRESS 0x7F8F22 /end MEASUREMENT
/begin MEASUREMENT Layer_ID_FN_BOS2 "" SWORD DEZ 1 100 -32768.00 32767.00 FORMAT "%8.2" ECU_ADDRESS 0x7F8F1E /end MEASUREMENT
/begin MEASUREMENT Layer_stLayer "" UWORD OneToOne 1 100 0.00 65535.00 FORMAT "%8.2" ECU_ADDRESS 0x7F8F24 /end MEASUREMENT
/begin MEASUREMENT Layer_stOelTog "" UBYTE DEZ 1 100 0.00 255.0 FORMAT "%5.1" ECU_ADDRESS 0x7F8917 /end MEASUREMENT
/begin MEASUREMENT Layer_stOelVerb "" UBYTE DEZ 1 100 0.00 255.0 FORMAT "%5.1" ECU_ADDRESS 0x7F8918 /end MEASUREMENT
/begin MEASUREMENT Layer_stOelVerl "" UBYTE DEZ 1 100 0.00 255.0 FORMAT "%5.1" ECU_ADDRESS 0x7F8919 /end MEASUREMENT
/begin MEASUREMENT Layer_TARD_MON_BOS2 "" UBYTE DEZ 1 100 0.00 255.0 FORMAT "%5.1" ECU_ADDRESS 0x7F8912 /end MEASUREMENT
/begin MEASUREMENT Layer_TARD_YR_BOS2 "" UBYTE DEZ 1 100 0.00 255.0 FORMAT "%5.1" ECU_ADDRESS 0x7F8913 /end MEASUREMENT
/begin MEASUREMENT Layer_volOil "" UBYTE DEZ 1 100 0.00 255.0 FORMAT "%5.1" ECU_ADDRESS 0x7F891B /end MEASUREMENT
/begin MEASUREMENT Layer_volOilRefill "" UBYTE DEZ 1 100 0.00 255.0 FORMAT "%5.1" ECU_ADDRESS 0x7F891C /end MEASUREMENT
/begin MEASUREMENT Layer_zrbosmld "" UBYTE DEZ 1 100 0.00 255.0 FORMAT "%5.1" ECU_ADDRESS 0x7F891D /end MEASUREMENT
/begin MEASUREMENT LIGov_CurrDKd_mp "Aktueller Parametersatzwert kp für den D-Anteil" SLONG Kd_rpm2Nm 1 100 -3276.80000000 3276.79999847 FORMAT "%13.8" ECU_ADDRESS 0x8FF83C /end MEASUREMENT
/begin MEASUREMENT LIGov_CurrDT1_mp "Aktueller Parametersatzwert T1 für den D-Anteil" ULONG TimeDelay_s 1 100 0.0000010000000 4294.9673 FORMAT "%9.4" ECU_ADDRESS 0x8FF840 /end MEASUREMENT
/begin MEASUREMENT LIGov_CurrFlt1T1_mp "Aktueller Parametersatzwert T1 für erstes PT1-Filter (n-Filterung)" ULONG TimeDelay_s 1 100 0.0000010000000 4294.9673 FORMAT "%9.4" ECU_ADDRESS 0x8FF844 /end MEASUREMENT
/begin MEASUREMENT LIGov_CurrFlt2T1_mp "Aktueller Parametersatzwert T1 für zweites PT1-Filter (n-Filterung)" ULONG TimeDelay_s 1 100 0.0000010000000 4294.9673 FORMAT "%9.4" ECU_ADDRESS 0x8FF848 /end MEASUREMENT
/begin MEASUREMENT LIGov_CurrIKiNeg_mp "Aktueller Parametersatzwert ki (negatives Großsignal) für den I-Anteil" SLONG Ki_rpm2Nm 1 100 -400000.000000 399999.999814 FORMAT "%13.6" ECU_ADDRESS 0x8FF84C /end MEASUREMENT
/begin MEASUREMENT LIGov_CurrIKiPos_mp "Aktueller Parametersatzwert ki (positives Großsignal) für den I-Anteil" SLONG Ki_rpm2Nm 1 100 -400000.000000 399999.999814 FORMAT "%13.6" ECU_ADDRESS 0x8FF850 /end MEASUREMENT
/begin MEASUREMENT LIGov_CurrIKi_mp "Aktueller Parametersatzwert ki (Kleinsignal) für den I-Anteil" SLONG Ki_rpm2Nm 1 100 -400000.000000 399999.999814 FORMAT "%13.6" ECU_ADDRESS 0x8FF854 /end MEASUREMENT
/begin MEASUREMENT LIGov_CurrIWinNeg_mp "Aktueller Parametersatzwert Fensterbreite (negatives Großsignal) für den I-Anteil" SWORD EngN_HiRes 1 100 -4096.000 4095.875 FORMAT "%8.3" ECU_ADDRESS 0x8FF858 /end MEASUREMENT
/begin MEASUREMENT LIGov_CurrIWinPos_mp "Aktueller Parametersatzwert Fensterbreite (positives Großsignal) für den I-Anteil" SWORD EngN_HiRes 1 100 -4096.000 4095.875 FORMAT "%8.3" ECU_ADDRESS 0x8FF85A /end MEASUREMENT
/begin MEASUREMENT LIGov_CurrPKpNeg_mp "Aktueller Parametersatzwert kp (negatives Großsignal) für den P-Anteil" SLONG Kp_rpm2Nm 1 100 -26214.4000000 26214.3999878 FORMAT "%13.7" ECU_ADDRESS 0x8FF85C /end MEASUREMENT
/begin MEASUREMENT LIGov_CurrPKpPos_mp "Aktueller Parametersatzwert kp (positives Großsignal) für den P-Anteil" SLONG Kp_rpm2Nm 1 100 -26214.4000000 26214.3999878 FORMAT "%13.7" ECU_ADDRESS 0x8FF860 /end MEASUREMENT
/begin MEASUREMENT LIGov_CurrPKp_mp "Aktueller Parametersatzwert kp (Kleinsignal) für P-Anteil" SLONG Kp_rpm2Nm 1 100 -26214.4000000 26214.3999878 FORMAT "%13.7" ECU_ADDRESS 0x8FF864 /end MEASUREMENT
/begin MEASUREMENT LIGov_CurrPWinNeg_mp "Aktueller Parametersatzwert Fensterbreite (negatives Großsignal) für den P-Anteil" SWORD EngN_HiRes 1 100 -4096.000 4095.875 FORMAT "%8.3" ECU_ADDRESS 0x8FF868 /end MEASUREMENT
/begin MEASUREMENT LIGov_CurrPWinPos_mp "Aktueller Parametersatzwert Fensterbreite (positives Großsignal) für den P-Anteil" SWORD EngN_HiRes 1 100 -4096.000 4095.875 FORMAT "%8.3" ECU_ADDRESS 0x8FF86A /end MEASUREMENT
/begin MEASUREMENT LIGov_nAvrg_mp "OLDA-Größe für Eng_nAvrg" SWORD EngN 1 100 -32768.00 32767.00 FORMAT "%8.2" ECU_ADDRESS 0x8FF86C /end MEASUREMENT
/begin MEASUREMENT LIGov_nDiffDelta_mp "Delta zur Drehzahlschwelle Sicherheitsrampe" SWORD EngN 1 100 -32768.00 32767.00 FORMAT "%8.2" ECU_ADDRESS 0x8FF810 /end MEASUREMENT
/begin MEASUREMENT LIGov_nDiffFlt1_mp "Regelabweichung hinter dem ersten PT1-Filter" SWORD EngN_HiRes 1 100 -4096.000 4095.875 FORMAT "%8.3" ECU_ADDRESS 0x8FF86E /end MEASUREMENT
/begin MEASUREMENT LIGov_nDiffFlt2_mp "Regelabweichung hinter zweitem PT1-Filter" SWORD EngN_HiRes 1 100 -4096.000 4095.875 FORMAT "%8.3" ECU_ADDRESS 0x8FF870 /end MEASUREMENT
/begin MEASUREMENT LIGov_nDiff_mp "n Regelabweichung" SWORD EngN 1 100 -32768.00 32767.00 FORMAT "%8.2" ECU_ADDRESS 0x8FF872 /end MEASUREMENT
/begin MEASUREMENT LIGov_nHDC_mp "LL-Solldrehzahl aufgrund HDC" SWORD EngN 1 100 -32768.00 32767.00 FORMAT "%8.2" ECU_ADDRESS 0x8FF812 /end MEASUREMENT
/begin MEASUREMENT LIGov_nLimHigh "" SWORD EngN 1 100 -32768.00 32767.00 FORMAT "%8.2" ECU_ADDRESS 0x7F8EAC /end MEASUREMENT
/begin MEASUREMENT LIGov_nMaxTrq "Drehzahldifferenz zur Vermeidung von Momentensprüngen aufgrund sprungförmiger LL-Solldrehzahl" SWORD EngN 1 100 -32768.00 32767.00 FORMAT "%8.2" ECU_ADDRESS 0x7F8EAE /end MEASUREMENT
/begin MEASUREMENT LIGov_nSetCoEngOld_mp "Vorhergehende LL-Solldrehzahl aus CoEng_nMin (nach Rampe)" SWORD EngN 1 100 -32768.00 32767.00 FORMAT "%8.2" ECU_ADDRESS 0x8FF814 /end MEASUREMENT
/begin MEASUREMENT LIGov_nSetCoEng_mp "LL-Solldrehzahl aus CoEng_nMin (nach Rampe)" SWORD EngN 1 100 -32768.00 32767.00 FORMAT "%8.2" ECU_ADDRESS 0x8FF816 /end MEASUREMENT
/begin MEASUREMENT LIGov_nSetGearbxOld_mp "Vorhergehende LL-Solldrehzahl aus Gearbx_nMin (nach Rampe)" SWORD EngN 1 100 -32768.00 32767.00 FORMAT "%8.2" ECU_ADDRESS 0x8FF818 /end MEASUREMENT
/begin MEASUREMENT LIGov_nSetGearbx_mp "LL-Solldrehzahl aus Gearbx_nMin (nach Rampe)" SWORD EngN 1 100 -32768.00 32767.00 FORMAT "%8.2" ECU_ADDRESS 0x8FF81A /end MEASUREMENT
/begin MEASUREMENT LIGov_nSetHDCOld_mp "Vorhergehende LL-Solldrehzahl aufgrund HDC (nach Rampe)" SWORD EngN 1 100 -32768.00 32767.00 FORMAT "%8.2" ECU_ADDRESS 0x8FF81C /end MEASUREMENT
/begin MEASUREMENT LIGov_nSetHDC_mp "LL-Solldrehzahl aufgrund HDC (nach Rampe)" SWORD EngN 1 100 -32768.00 32767.00 FORMAT "%8.2" ECU_ADDRESS 0x8FF81E /end MEASUREMENT
/begin MEASUREMENT LIGov_nSetLocal0_mp "LIGov set point before adding trimming setpoint" SWORD EngN 1 100 -32768.00 32767.00 FORMAT "%8.2" ECU_ADDRESS 0x8FF820 /end MEASUREMENT
/begin MEASUREMENT LIGov_nSetLocal2 "LL-Solldrehzahl aus ""langsamen' Anforderem"" (Startabwurf, temp.abhängig, Diagnoseabgleich)" SWORD EngN 1 100 -32768.00 32767.00 FORMAT "%8.2" ECU_ADDRESS 0x7F8EB0 /end MEASUREMENT
/begin MEASUREMENT LIGov_nSetLocalRampOld_mp "Vorhergegangene LL-Solldrehzahl aus ""langsamen Anforderern"" (nach Rampe)" SWORD EngN 1 100 -32768.00 32767.00 FORMAT "%8.2" ECU_ADDRESS 0x8FF822 /end MEASUREMENT
/begin MEASUREMENT LIGov_nSetLocalRamp_mp "LL-Solldrehzahl aus ""langsamen' Anforderem"" (nach Rampe)" SWORD EngN 1 100 -32768.00 32767.00 FORMAT "%8.2" ECU_ADDRESS 0x8FF824 /end MEASUREMENT
/begin MEASUREMENT LIGov_nSetpoint "Leerlaufsolldrehzahl" SWORD EngN 1 100 -32768.00 32767.00 FORMAT "%8.2" ECU_ADDRESS 0x7F8EB2 /end MEASUREMENT
/begin MEASUREMENT LIGov_nSetpointOld_mp "Vorhergegangene LL-Solldrehzahl" SWORD EngN 1 100 -32768.00 32767.00 FORMAT "%8.2" ECU_ADDRESS 0x8FF826 /end MEASUREMENT
/begin MEASUREMENT LIGov_nSetpointTemp_mp "Sollwert Leerlaufregler temperaturabhängig" SWORD EngN 1 100 -32768.00 32767.00 FORMAT "%8.2" ECU_ADDRESS 0x8FF828 /end MEASUREMENT
/begin MEASUREMENT LIGov_nSetpointTrm "Abgleich LLR-Solldrehzahl" SWORD EngN 1 100 -32768.00 32767.00 FORMAT "%8.2" ECU_ADDRESS 0x7F8EB4 /end MEASUREMENT
/begin MEASUREMENT LIGov_nSetpointTrm_mp "Meßpunkt zeigt den Leerlaufsollwert nach der Korrektur mit dem Abgleichwert" SWORD EngN 1 100 -32768.00 32767.00 FORMAT "%8.2" ECU_ADDRESS 0x8FF82A /end MEASUREMENT
/begin MEASUREMENT LIGov_nSetPwrMngOld_mp "Vorhergegangene LL-Solldrehzahl aus PwrMng_nMin (nach Rampe)" SWORD EngN 1 100 -32768.00 32767.00 FORMAT "%8.2" ECU_ADDRESS 0x8FF82C /end MEASUREMENT
/begin MEASUREMENT LIGov_nSetPwrMng_mp "LL-Solldrehzahl aus PwrMng_nMin (nach Rampe)" SWORD EngN 1 100 -32768.00 32767.00 FORMAT "%8.2" ECU_ADDRESS 0x8FF82E /end MEASUREMENT
/begin MEASUREMENT LIGov_nSetSec1_mp "Erster Sicherheitswert zur Begrenzung der LL-Solldrehzahl" SWORD EngN 1 100 -32768.00 32767.00 FORMAT "%8.2" ECU_ADDRESS 0x8FF830 /end MEASUREMENT
/begin MEASUREMENT LIGov_nSetSec2_mp "Zweiter Sicherheitswert zur Begrenzung der LL-Solldrehzahl" SWORD EngN 1 100 -32768.00 32767.00 FORMAT "%8.2" ECU_ADDRESS 0x8FF832 /end MEASUREMENT
/begin MEASUREMENT LIGov_nSetSec4_mp "Viertter Sicherheitswert zur Begrenzung der LL-Solldrehzahl" SWORD EngN 1 100 -32768.00 32767.00 FORMAT "%8.2" ECU_ADDRESS 0x8FF834 /end MEASUREMENT
/begin MEASUREMENT LIGov_nSetSurgeOld_mp "Vorhergegangene LL-Solldrehzahl aus PCR_nSetPointSurge (nach Rampe)" SWORD EngN 1 100 -32768.00 32767.00 FORMAT "%8.2" ECU_ADDRESS 0x8FF836 /end MEASUREMENT
/begin MEASUREMENT LIGov_nSetSurge_mp "LL-Solldrehzahl aus PCR_nSetPointSurge (nach Rampe)" SWORD EngN 1 100 -32768.00 32767.00 FORMAT "%8.2" ECU_ADDRESS 0x8FF838 /end MEASUREMENT
/begin MEASUREMENT LIGov_rIpoConvPS_mp "Verhältnis für die Interpolation zwischen Kalt- und Warmparametersatz" SWORD Fact 1 100 -4.000000 3.999878 FORMAT "%8.6" ECU_ADDRESS 0x8FF874 /end MEASUREMENT
/begin MEASUREMENT LIGov_st "Zustand des Leerlaufreglers" UWORD OneToOne 1 100 0.00 65535.00 FORMAT "%8.2" ECU_ADDRESS 0x7F8EB6 /end MEASUREMENT
/begin MEASUREMENT LIGov_stActiveHDC "Zustand für aktivierte LL-Solldrehzahl aufgrund HDC" UBYTE OneToOne 1 100 0.00 255.0 FORMAT "%5.1" ECU_ADDRESS 0x7F88E7 /end MEASUREMENT
/begin MEASUREMENT LIGov_stSetPoint "Status Leerlauf-Solldrehzahl-Anforderung" UWORD OneToOne 1 100 0.00 65535.00 FORMAT "%8.2" ECU_ADDRESS 0x7F8EB8 /end MEASUREMENT
/begin MEASUREMENT LIGov_stSetpointTrmActive "" UBYTE OneToOne 1 100 0.00 255.0 FORMAT "%5.1" ECU_ADDRESS 0x7F88E8 /end MEASUREMENT
/begin MEASUREMENT LIGov_stSetpointTrmAlw_mp "" UBYTE OneToOne 1 100 0.00 255.0 FORMAT "%5.1" ECU_ADDRESS 0x8FF83A /end MEASUREMENT
/begin MEASUREMENT LIGov_tiPT1_mp "aktuelle PT1 Zeitkonstante für PT1 filtern des LLR Ausgangs" SWORD TimeDelay_s_Lin_16 1 100 -5.000153 5.000000 FORMAT "%8.6" ECU_ADDRESS 0x8FF876 /end MEASUREMENT
/begin MEASUREMENT LIGov_trq "Leerlaufreglermoment" SWORD Trq 1 100 -3276.800 3276.700 FORMAT "%8.3" ECU_ADDRESS 0x7F8EBA /end MEASUREMENT
/begin MEASUREMENT LIGov_trqCurrPredef "aktuell verwendetes Einsschrittmoment" SWORD Trq 1 100 -3276.800 3276.700 FORMAT "%8.3" ECU_ADDRESS 0x7F8EBC /end MEASUREMENT
/begin MEASUREMENT LIGov_trqDRaw_mp "LLR D-Anteil Rohwert (ohne Gewichtsfaktor)" SWORD Trq 1 100 -3276.800 3276.700 FORMAT "%8.3" ECU_ADDRESS 0x8FF878 /end MEASUREMENT
/begin MEASUREMENT LIGov_trqD_mp "Messpunkt für den Wert des D-Anteils des LLR" SWORD Trq 1 100 -3276.800 3276.700 FORMAT "%8.3" ECU_ADDRESS 0x8FF87A /end MEASUREMENT
/begin MEASUREMENT LIGov_trqFlt "Leerlaufreglermoment PT1 gefiltert" SWORD Trq 1 100 -3276.800 3276.700 FORMAT "%8.3" ECU_ADDRESS 0x7F8EBE /end MEASUREMENT
/begin MEASUREMENT LIGov_trqI "Wert des I-Anteils des LLR" SWORD Trq 1 100 -3276.800 3276.700 FORMAT "%8.3" ECU_ADDRESS 0x7F8EC0 /end MEASUREMENT
/begin MEASUREMENT LIGov_trqInitI "Initialisierungsmoment für I-Anteil nach Start" SWORD Trq 1 100 -3276.800 3276.700 FORMAT "%8.3" ECU_ADDRESS 0x7F8EC2 /end MEASUREMENT
/begin MEASUREMENT LIGov_trqMax_mp "aktueller LLR Begrenzungswert" SWORD Trq 1 100 -3276.800 3276.700 FORMAT "%8.3" ECU_ADDRESS 0x8FF87C /end MEASUREMENT
/begin MEASUREMENT LIGov_trqP "Wert des P-Anteils des LLR" SWORD Trq 1 100 -3276.800 3276.700 FORMAT "%8.3" ECU_ADDRESS 0x7F8EC4 /end MEASUREMENT
/begin MEASUREMENT LIGov_trqPreInitI_mp "Initialisierungswert für Integrator als Ergebnis der Integrator-Rückrechnung" SLONG Trq32 1 100 -3276.80000000 3276.79999847 FORMAT "%13.8" ECU_ADDRESS 0x8FF880 /end MEASUREMENT
/begin MEASUREMENT LPACD_rCnv_mp "TV on steller" SWORD DtyCyc 1 100 -327.6800 327.6700 FORMAT "%8.4" ECU_ADDRESS 0x8FF884 /end MEASUREMENT
/begin MEASUREMENT LPACD_rOut "Ausgabewert on PWM-EST nach batteriespannung korrectur" SWORD DtyCyc 1 100 -327.6800 327.6700 FORMAT "%8.4" ECU_ADDRESS 0x7F8EC6 /end MEASUREMENT
/begin MEASUREMENT LSUCD_ctHtCoup "Zähler für LSU Diagnose Heizerkopplung" UWORD OneToOne 1 100 0.00 65535.00 FORMAT "%8.2" ARRAY_SIZE 1 ECU_ADDRESS 0x7F8EC8 /end MEASUREMENT
/begin MEASUREMENT LSUCD_d2rO2Eval_mp "Bewertungsgröße für Lernfortschritt" SWORD O2 1 100 -0.3276800 0.3276700 FORMAT "%9.7" ARRAY_SIZE 1 ECU_ADDRESS 0x8FF8A6 /end MEASUREMENT
/begin MEASUREMENT LSUCD_d2rO2_mp "Eingangsgröße des Bewertungsfilters" SWORD O2 1 100 -0.3276800 0.3276700 FORMAT "%9.7" ARRAY_SIZE 1 ECU_ADDRESS 0x8FF8A8 /end MEASUREMENT
/begin MEASUREMENT LSUCD_dcycHtCor "Tastverhältnis Heizer Endstufe nach Batteriespannungs Korrektur" SWORD DtyCyc 1 100 -327.6800 327.6700 FORMAT "%8.4" ARRAY_SIZE 1 ECU_ADDRESS 0x7F8ECA /end MEASUREMENT
/begin MEASUREMENT LSUCD_dcycHtCoupStep1 "Heizungs-Aufgabe fährt im ersten Signalerwerbungs-Zyklus rad" SWORD DtyCyc 1 100 -327.6800 327.6700 FORMAT "%8.4" ARRAY_SIZE 1 ECU_ADDRESS 0x7F8ECC /end MEASUREMENT
/begin MEASUREMENT LSUCD_dcycHtCoupStep2 "Heizungs-Aufgabe fährt im zweiten Signalerwerbungs-Zyklus rad" SWORD DtyCyc 1 100 -327.6800 327.6700 FORMAT "%8.4" ARRAY_SIZE 1 ECU_ADDRESS 0x7F8ECE /end MEASUREMENT
/begin MEASUREMENT LSUCD_dcycHtCoupStep3 "Heizungs-Aufgabe fährt im dritten Signalerwerbungs-Zyklus rad" SWORD DtyCyc 1 100 -327.6800 327.6700 FORMAT "%8.4" ARRAY_SIZE 1 ECU_ADDRESS 0x7F8ED0 /end MEASUREMENT
/begin MEASUREMENT LSUCD_dcycLimActHt "Aktuelle Tastverhältnisgrenze Heizeransteuerung für nominales Tastverhältnis (vor Korrektur)" SWORD DtyCyc 1 100 -327.6800 327.6700 FORMAT "%8.4" ECU_ADDRESS 0x7F8ED2 /end MEASUREMENT
/begin MEASUREMENT LSUCD_dcycRippel_mp "Änderung des Heizungs-Tastverhältnisses bei Diagnose der Heizungskopplung" SWORD DtyCyc 1 100 -327.6800 327.6700 FORMAT "%8.4" ARRAY_SIZE 1 ECU_ADDRESS 0x8FF8CC /end MEASUREMENT
/begin MEASUREMENT LSUCD_dHtCoupStep "Schieberegister für die Aufzeichnung der Werte" UBYTE OneToOne 1 100 0.00 255.0 FORMAT "%5.1" ECU_ADDRESS 0x7F88E9 /end MEASUREMENT
/begin MEASUREMENT LSUCD_dHtCoupStepLast "Letzter Wert des Schieberegisters" UBYTE OneToOne 1 100 0.00 255.0 FORMAT "%5.1" ECU_ADDRESS 0x7F88EA /end MEASUREMENT
/begin MEASUREMENT LSUCD_drO2Adpt "Eingelernter absoluter Messfehler der Sauerstoffkonzentration" SWORD O2 1 100 -0.3276800 0.3276700 FORMAT "%9.7" ARRAY_SIZE 1 ECU_ADDRESS 0x7F8ED4 /end MEASUREMENT
/begin MEASUREMENT LSUCD_drO2Flt_mp "Ausgangsgröße des Adaptionsfilters" SWORD O2 1 100 -0.3276800 0.3276700 FORMAT "%9.7" ARRAY_SIZE 1 ECU_ADDRESS 0x8FF8AA /end MEASUREMENT
/begin MEASUREMENT LSUCD_facO2Corr_mp "Aktueller Korrekturfaktor der Adaption" SWORD Fact 1 100 -4.000000 3.999878 FORMAT "%8.6" ARRAY_SIZE 1 ECU_ADDRESS 0x8FF8AC /end MEASUREMENT
/begin MEASUREMENT LSUCD_facPresComp_mp "Druckkorrekturfaktor" SWORD Fact 1 100 -4.000000 3.999878 FORMAT "%8.6" ARRAY_SIZE 1 ECU_ADDRESS 0x8FF8C0 /end MEASUREMENT
/begin MEASUREMENT LSUCD_facUCor_mp "Korrektur Faktor für Heizeranforderung" SWORD Fact 1 100 -4.000000 3.999878 FORMAT "%8.6" ECU_ADDRESS 0x8FF8B4 /end MEASUREMENT
/begin MEASUREMENT LSUCD_mAirAftOvrRun_mp "Integral über Luftmassenstrom seit Beginn der Schubphase" SWORD AirMass_2 1 100 -3276.800 3276.700 FORMAT "%8.3" ECU_ADDRESS 0x8FF8AE /end MEASUREMENT
/begin MEASUREMENT LSUCD_pExhGasLstVal_mp "Abgas-Wert des letzten geschätzten Sensors" SWORD Pres_hPa 1 100 -32768.00 32767.00 FORMAT "%8.2" ECU_ADDRESS 0x8FF8C2 /end MEASUREMENT
/begin MEASUREMENT LSUCD_resRi "Ri Meßwert (gefiltert und korrigiert)" SWORD Resist 1 100 -3276.800 3276.700 FORMAT "%8.3" ARRAY_SIZE 1 ECU_ADDRESS 0x7F8EDE /end MEASUREMENT
/begin MEASUREMENT LSUCD_resRiChange_mp "Betrag der Ri-Änderung mit dem letzten gefilterten Wert" SWORD Resist 1 100 -3276.800 3276.700 FORMAT "%8.3" ARRAY_SIZE 1 ECU_ADDRESS 0x8FF8C4 /end MEASUREMENT
/begin MEASUREMENT LSUCD_resRiClb "Korrekturwert Ri Offset" SWORD Resist 1 100 -3276.800 3276.700 FORMAT "%8.3" ARRAY_SIZE 1 ECU_ADDRESS 0x7F8EE0 /end MEASUREMENT
/begin MEASUREMENT LSUCD_resRiClbRaw_mp "Rohwert Ri Korrektur ohne Filterung" SWORD Resist 1 100 -3276.800 3276.700 FORMAT "%8.3" ARRAY_SIZE 1 ECU_ADDRESS 0x8FF8C6 /end MEASUREMENT
/begin MEASUREMENT LSUCD_resRiHtCoupStep1 "Innerer Wiederstand im ersten Datenakquisitionszyklus" SWORD Resist 1 100 -3276.800 3276.700 FORMAT "%8.3" ARRAY_SIZE 1 ECU_ADDRESS 0x7F8EE2 /end MEASUREMENT
/begin MEASUREMENT LSUCD_resRiHtCoupStep2 "Innerer Wiederstand im zweiten Datenakquisitionszyklus" SWORD Resist 1 100 -3276.800 3276.700 FORMAT "%8.3" ARRAY_SIZE 1 ECU_ADDRESS 0x7F8EE4 /end MEASUREMENT
/begin MEASUREMENT LSUCD_resRiHtCoupStep3 "Innerer Wiederstand im dritten Datenakquisitionszyklus" SWORD Resist 1 100 -3276.800 3276.700 FORMAT "%8.3" ARRAY_SIZE 1 ECU_ADDRESS 0x7F8EE6 /end MEASUREMENT
/begin MEASUREMENT LSUCD_resRiRaw "Ri Meßwert ohne Korrektur" SWORD Resist 1 100 -3276.800 3276.700 FORMAT "%8.3" ARRAY_SIZE 1 ECU_ADDRESS 0x7F8EE8 /end MEASUREMENT
/begin MEASUREMENT LSUCD_resRiRippel_mp "Änderung des Innenwiderstands bei Freigabe der Heizung" SWORD Resist 1 100 -3276.800 3276.700 FORMAT "%8.3" ARRAY_SIZE 1 ECU_ADDRESS 0x8FF8CE /end MEASUREMENT
/begin MEASUREMENT LSUCD_resRi_mp "Ri-Messwert gefiltert und korrigiert" SWORD Resist 1 100 -3276.800 3276.700 FORMAT "%8.3" ECU_ADDRESS 0x8FF8C8 /end MEASUREMENT
/begin MEASUREMENT LSUCD_rO2Act "Aktueller O2 Meßwert ohne Ausblendung Abgleichvorgang" SWORD O2 1 100 -0.3276800 0.3276700 FORMAT "%9.7" ARRAY_SIZE 1 ECU_ADDRESS 0x7F8ED6 /end MEASUREMENT
/begin MEASUREMENT LSUCD_rO2Adpt "Adaptierte Sauerstoffkonzentration" SWORD O2 1 100 -0.3276800 0.3276700 FORMAT "%9.7" ARRAY_SIZE 1 ECU_ADDRESS 0x7F8ED8 /end MEASUREMENT
/begin MEASUREMENT LSUCD_rO2PresComp "Druckkompensierte Sauerstoffkonzentration" SWORD O2 1 100 -0.3276800 0.3276700 FORMAT "%9.7" ARRAY_SIZE 1 ECU_ADDRESS 0x7F8EDA /end MEASUREMENT
/begin MEASUREMENT LSUCD_rO2Raw "O2 Wert ohne Druck- und Empfindlichkeitskorrektur" SWORD O2 1 100 -0.3276800 0.3276700 FORMAT "%9.7" ARRAY_SIZE 1 ECU_ADDRESS 0x7F8EDC /end MEASUREMENT
/begin MEASUREMENT LSUCD_rOutHWE_mp "Tastverhältnis Heizerendstufe nach Stellertest Anforderung und Endstufen Diagnose." SWORD DtyCyc 1 100 -327.6800 327.6700 FORMAT "%8.4" ARRAY_SIZE 1 ECU_ADDRESS 0x8FF8B6 /end MEASUREMENT
/begin MEASUREMENT LSUCD_stAdpt "Zustandsgröße der Adaption (adaptiert / nicht adaptiert)" UBYTE OneToOne 1 100 0.00 255.0 FORMAT "%5.1" ARRAY_SIZE 1 ECU_ADDRESS 0x7F88EB /end MEASUREMENT
/begin MEASUREMENT LSUCD_stAdptActv_mp "Zustand der Lernphase (aktiv / nicht aktiv)" UBYTE OneToOne 1 100 0.00 255.0 FORMAT "%5.1" ARRAY_SIZE 1 ECU_ADDRESS 0x8FF8B0 /end MEASUREMENT
/begin MEASUREMENT LSUCD_stChange_mp "Neues Lernergebnis im aktuellen Fahrzyklus" UBYTE OneToOne 1 100 0.00 255.0 FORMAT "%5.1" ARRAY_SIZE 1 ECU_ADDRESS 0x8FF8B1 /end MEASUREMENT
/begin MEASUREMENT LSUCD_stCircModeNew "Aktueller Wert des Auswerteschaltungs Modes (CJ 120 Konfiguration)" UWORD OneToOne 1 100 0.00 65535.00 FORMAT "%8.2" ARRAY_SIZE 1 ECU_ADDRESS 0x7F8EEA /end MEASUREMENT
/begin MEASUREMENT LSUCD_stDiaIAEna "Message um die Erkennung von IA oder IP Kurzschluss nach Masse freizugeben" UBYTE OneToOne 1 100 0.00 255.0 FORMAT "%5.1" ARRAY_SIZE 1 ECU_ADDRESS 0x7F88EC /end MEASUREMENT
/begin MEASUREMENT LSUCD_stHold_mp "Zustandsgröße der Adaption (gestört / nicht gestört)" UBYTE OneToOne 1 100 0.00 255.0 FORMAT "%5.1" ARRAY_SIZE 1 ECU_ADDRESS 0x8FF8B2 /end MEASUREMENT
/begin MEASUREMENT LSUCD_stHtCoupActv "Statusbotschaft für Heizungskopplung aktiv" UBYTE OneToOne 1 100 0.00 255.0 FORMAT "%5.1" ECU_ADDRESS 0x7F88ED /end MEASUREMENT
/begin MEASUREMENT LSUCD_stHtDis "Zustand Heizerabschaltung wegen Batteriespannung oder Betriebsmodus" UBYTE OneToOne 1 100 0.00 255.0 FORMAT "%5.1" ECU_ADDRESS 0x7F88EE /end MEASUREMENT
/begin MEASUREMENT LSUCD_stInitClb "Erste CJ120-Kalibrierung wurde angefordert" UBYTE OneToOne 1 100 0.00 255.0 FORMAT "%5.1" ECU_ADDRESS 0x7F88EF /end MEASUREMENT
/begin MEASUREMENT LSUCD_stIpHighCurEna "Status-Message für hohen (0 bis 150ua) Referenzpumpstrom für CJ125" UBYTE OneToOne 1 100 0.00 255.0 FORMAT "%5.1" ARRAY_SIZE 1 ECU_ADDRESS 0x7F88F0 /end MEASUREMENT
/begin MEASUREMENT LSUCD_stIpNormCurEna "Status-Message für normalen (0 bis 150ua) Referenzpumpstrom für CJ125" UBYTE OneToOne 1 100 0.00 255.0 FORMAT "%5.1" ARRAY_SIZE 1 ECU_ADDRESS 0x7F88F1 /end MEASUREMENT
/begin MEASUREMENT LSUCD_stIsolChkActv "Nebenschlußerkennung ist momentan aktiv" UBYTE OneToOne 1 100 0.00 255.0 FORMAT "%5.1" ARRAY_SIZE 1 ECU_ADDRESS 0x7F88F2 /end MEASUREMENT
/begin MEASUREMENT LSUCD_stIsolChkO2Last "Status ob die O2 Konzentration im letzten Zyklus innerhalb des vorgegebenen Fensters war" UBYTE OneToOne 1 100 0.00 255.0 FORMAT "%5.1" ARRAY_SIZE 1 ECU_ADDRESS 0x7F88F3 /end MEASUREMENT
/begin MEASUREMENT LSUCD_stIsolChkStrt "Statusmessage zum Starten der Nebenschlusserkennung" UBYTE OneToOne 1 100 0.00 255.0 FORMAT "%5.1" ARRAY_SIZE 1 ECU_ADDRESS 0x7F88F4 /end MEASUREMENT
/begin MEASUREMENT LSUCD_stO2Act "Gültigkeitsstatus des aktuellen O2 Signals (0 = ungültig, 1 = gültig)" UBYTE OneToOne 1 100 0.00 255.0 FORMAT "%5.1" ARRAY_SIZE 1 ECU_ADDRESS 0x7F88F5 /end MEASUREMENT
/begin MEASUREMENT LSUCD_stO2ClbEna "Auslösesignal für O2 Offsetspannung Kalibriersequenz" UBYTE OneToOne 1 100 0.00 255.0 FORMAT "%5.1" ECU_ADDRESS 0x7F88F6 /end MEASUREMENT
/begin MEASUREMENT LSUCD_stO2Clb_mp "Zusatands Bits der O2 Offset Abgleich Sequenz" UBYTE OneToOne 1 100 0.00 255.0 FORMAT "%5.1" ECU_ADDRESS 0x8FF8BA /end MEASUREMENT
/begin MEASUREMENT LSUCD_stO2IntValid "Status des internen O2-Rohsignals (gültig/ungültig)" UBYTE OneToOne 1 100 0.00 255.0 FORMAT "%5.1" ARRAY_SIZE 1 ECU_ADDRESS 0x7F88F7 /end MEASUREMENT
/begin MEASUREMENT LSUCD_stO2SPICalDem "SPI Status-Message um die Schaltung in den Kalibriermodus zu versetzen" UBYTE OneToOne 1 100 0.00 255.0 FORMAT "%5.1" ECU_ADDRESS 0x7F88F8 /end MEASUREMENT
/begin MEASUREMENT LSUCD_stO2SPISens "Modus-Bits zum Setzen der Empfindlichkeit der O2-Auswertung" UWORD OneToOne 1 100 0.00 65535.00 FORMAT "%8.2" ARRAY_SIZE 1 ECU_ADDRESS 0x7F8EEC /end MEASUREMENT
/begin MEASUREMENT LSUCD_stO2Valid "Zustand O2 Signal (0 = ungültig, 1 = gültig)" UBYTE OneToOne 1 100 0.00 255.0 FORMAT "%5.1" ARRAY_SIZE 1 ECU_ADDRESS 0x7F88F9 /end MEASUREMENT
/begin MEASUREMENT LSUCD_stOpnErrIP "Status Leerlauf-Fehler Pumpstrom Pin (IP)" UBYTE OneToOne 1 100 0.00 255.0 FORMAT "%5.1" ARRAY_SIZE 1 ECU_ADDRESS 0x7F88FA /end MEASUREMENT
/begin MEASUREMENT LSUCD_stOpnLdTstActv "Message von LSU_WireDiagnosis, die anzeigt, ob die Kabelunterbrechungsdiagnose für Nernst-Zelle und virtuelle Masse aktiv ist" UBYTE OneToOne 1 100 0.00 255.0 FORMAT "%5.1" ARRAY_SIZE 1 ECU_ADDRESS 0x7F88FB /end MEASUREMENT
/begin MEASUREMENT LSUCD_stPumpCtl "Status der Pumpensteuerung (ein/aus)" UBYTE OneToOne 1 100 0.00 255.0 FORMAT "%5.1" ARRAY_SIZE 1 ECU_ADDRESS 0x7F88FC /end MEASUREMENT
/begin MEASUREMENT LSUCD_stPumpDemRef "externe Anforderung Referenzpumpströme" UBYTE OneToOne 1 100 0.00 255.0 FORMAT "%5.1" ARRAY_SIZE 1 ECU_ADDRESS 0x7F88FD /end MEASUREMENT
/begin MEASUREMENT LSUCD_stPumpEna "Zustand der CJ 120 Pumpstromregelung (0 = abgeschaltet, 1 = aktiv = Strom angeschaltet)" UBYTE OneToOne 1 100 0.00 255.0 FORMAT "%5.1" ARRAY_SIZE 1 ECU_ADDRESS 0x7F88FE /end MEASUREMENT
/begin MEASUREMENT LSUCD_stRecValEval_mp "Messpunkt für den Status der Auswertung erfasster Werte in der Heizungskopplung" UBYTE OneToOne 1 100 0.00 255.0 FORMAT "%5.1" ARRAY_SIZE 1 ECU_ADDRESS 0x8FF8D0 /end MEASUREMENT
/begin MEASUREMENT LSUCD_stRefCurTrans_mp "Status des Übergangs von hohem zu niedrigem Strom" UBYTE OneToOne 1 100 0.00 255.0 FORMAT "%5.1" ARRAY_SIZE 1 ECU_ADDRESS 0x8FF8B8 /end MEASUREMENT
/begin MEASUREMENT LSUCD_stRefPump "Status der Referenz Pumpströme (0 = off, 1 = 20 uA, 2 = 40 uA, 3 = 60 uA)" UBYTE OneToOne 1 100 0.00 255.0 FORMAT "%5.1" ARRAY_SIZE 1 ECU_ADDRESS 0x7F88FF /end MEASUREMENT
/begin MEASUREMENT LSUCD_stRgnEna "Nachricht, um Regeneration zu befähigen" UBYTE OneToOne 1 100 0.00 255.0 FORMAT "%5.1" ECU_ADDRESS 0x7F8900 /end MEASUREMENT
/begin MEASUREMENT LSUCD_stRgnIpSettle "Status des Pumpe-Stromes, der nach Regeneration setzt" UBYTE OneToOne 1 100 0.00 255.0 FORMAT "%5.1" ECU_ADDRESS 0x7F8901 /end MEASUREMENT
/begin MEASUREMENT LSUCD_stRiClb "Status der Ri-Kalibrierungssequenz" UBYTE OneToOne 1 100 0.00 255.0 FORMAT "%5.1" ECU_ADDRESS 0x7F8902 /end MEASUREMENT
/begin MEASUREMENT LSUCD_stRiClbEna "Auslöser für Ri Abgleichsequenz" UBYTE OneToOne 1 100 0.00 255.0 FORMAT "%5.1" ECU_ADDRESS 0x7F8903 /end MEASUREMENT
/begin MEASUREMENT LSUCD_stRiFltAct_mp "Messpunkt für den Status der Filteraktivierung" UBYTE OneToOne 1 100 0.00 255.0 FORMAT "%5.1" ARRAY_SIZE 1 ECU_ADDRESS 0x8FF8CA /end MEASUREMENT
/begin MEASUREMENT LSUCD_stRiLimSlp_mp "Zustand der Ri Störungsunterdrückung" UBYTE OneToOne 1 100 0.00 255.0 FORMAT "%5.1" ARRAY_SIZE 1 ECU_ADDRESS 0x8FF8CB /end MEASUREMENT
/begin MEASUREMENT LSUCD_stRiSPICalDem "Anforderung der Ri-Regelung Einschaltung des Lern- oder Messmodus" UBYTE OneToOne 1 100 0.00 255.0 FORMAT "%5.1" ECU_ADDRESS 0x7F8904 /end MEASUREMENT
/begin MEASUREMENT LSUCD_stRiValid "Zustand Ri Signals (0 = ungültig, 1 = gültig)" UBYTE OneToOne 1 100 0.00 255.0 FORMAT "%5.1" ARRAY_SIZE 1 ECU_ADDRESS 0x7F8905 /end MEASUREMENT
/begin MEASUREMENT LSUCD_stSPIDiaInfo "Status der SPI Chip Diagnose" UWORD OneToOne 1 100 0.00 65535.00 FORMAT "%8.2" ARRAY_SIZE 1 ECU_ADDRESS 0x7F8EEE /end MEASUREMENT
/begin MEASUREMENT LSUCD_stSPIInitVal "Wert des CJ12x Initialisierungsregisters" UWORD OneToOne 1 100 0.00 65535.00 FORMAT "%8.2" ARRAY_SIZE 1 ECU_ADDRESS 0x7F8EF0 /end MEASUREMENT
/begin MEASUREMENT LSUCD_stSRCState_mp "Status der SRC Überwachung des O2 Rohsignales" UBYTE OneToOne 1 100 0.00 255.0 FORMAT "%5.1" ARRAY_SIZE 1 ECU_ADDRESS 0x8FF8BB /end MEASUREMENT
/begin MEASUREMENT LSUCD_stTstTrigger_mp "Messpunkt für den Status zur Auslösung des Tests der Nebenschlusserkennung" UBYTE OneToOne 1 100 0.00 255.0 FORMAT "%5.1" ARRAY_SIZE 1 ECU_ADDRESS 0x8FF8D1 /end MEASUREMENT
/begin MEASUREMENT LSUCD_stWireDiaChk_mp "Bitfeld: Unterdiagnosen ausgeführt" UBYTE OneToOne 1 100 0.00 255.0 FORMAT "%5.1" ARRAY_SIZE 1 ECU_ADDRESS 0x8FF8D2 /end MEASUREMENT
/begin MEASUREMENT LSUCD_stWireDiaErr_mp "Status des Fehlers Nebenschlusserkennung" UBYTE OneToOne 1 100 0.00 255.0 FORMAT "%5.1" ARRAY_SIZE 1 ECU_ADDRESS 0x8FF8D3 /end MEASUREMENT
/begin MEASUREMENT LSUCD_swtAdpt "Schalter für Adaption der Lambda-Sonde" UBYTE OneToOne 1 100 0.00 255.0 FORMAT "%5.1" ECU_ADDRESS 0x7F8906 /end MEASUREMENT
/begin MEASUREMENT LSUCD_tRi "Äquivalenztemperatur des gemessenen Ri-Werts" SWORD Temp_Cels 1 100 -50.140 899.860 FORMAT "%8.3" ARRAY_SIZE 1 ECU_ADDRESS 0x7F8EF2 /end MEASUREMENT
/begin MEASUREMENT LSUCD_uO2Clb "Offsetspannungs Korrekturwert für Lambda Spannungswert" SWORD Volt 1 100 -160156.4 160151.5 FORMAT "%8.1" ARRAY_SIZE 1 ECU_ADDRESS 0x7F8EF4 /end MEASUREMENT
/begin MEASUREMENT LSUCD_uO2FltRippel_mp "Gefilterte, überlagerte Sauerstoff-Wechselspannung bei Diagnose der Heizungskopplung" SWORD Volt 1 100 -160156.4 160151.5 FORMAT "%8.1" ARRAY_SIZE 1 ECU_ADDRESS 0x8FF8D4 /end MEASUREMENT
/begin MEASUREMENT LSUCD_uO2Grad_mp "Gradient der Sauerstoff-Spannung bei Diagnose der Heizungskopplung" SWORD Volt 1 100 -160156.4 160151.5 FORMAT "%8.1" ARRAY_SIZE 1 ECU_ADDRESS 0x8FF8D6 /end MEASUREMENT
/begin MEASUREMENT LSUCD_uO2HtCoupStep1 "O2 Konzentration im ersten Datenakquisitionszyklus" SWORD Volt 1 100 -160156.4 160151.5 FORMAT "%8.1" ARRAY_SIZE 1 ECU_ADDRESS 0x7F8EF6 /end MEASUREMENT
/begin MEASUREMENT LSUCD_uO2HtCoupStep2 "O2 Konzentration im zweiten Datenakquisitionszyklus" SWORD Volt 1 100 -160156.4 160151.5 FORMAT "%8.1" ARRAY_SIZE 1 ECU_ADDRESS 0x7F8EF8 /end MEASUREMENT
/begin MEASUREMENT LSUCD_uO2HtCoupStep3 "O2 Konzentration im dritten Datenakquisitionszyklus" SWORD Volt 1 100 -160156.4 160151.5 FORMAT "%8.1" ARRAY_SIZE 1 ECU_ADDRESS 0x7F8EFA /end MEASUREMENT
/begin MEASUREMENT LSUCD_uO2OfsCor_mp "O2 Spannungswert nach Offset Kompensation" SWORD Volt 1 100 -160156.4 160151.5 FORMAT "%8.1" ECU_ADDRESS 0x8FF8BC /end MEASUREMENT
/begin MEASUREMENT LSUCD_uO2Raw "Spannungsrohwert Lambdasignal nach Mittelung und Subtraktion Referenzwert" SWORD Volt 1 100 -160156.4 160151.5 FORMAT "%8.1" ARRAY_SIZE 1 ECU_ADDRESS 0x7F8EFC /end MEASUREMENT
/begin MEASUREMENT LSUCD_uO2Raw_mp "O2 Spannung nach Mittelwertbildung" SWORD Volt 1 100 -160156.4 160151.5 FORMAT "%8.1" ARRAY_SIZE 1 ECU_ADDRESS 0x8FF8BE /end MEASUREMENT
/begin MEASUREMENT LSUCD_uO2Rippel_mp "Sauerstoff-Wechselspannung bei Diagnose der Heizungskopplung" SWORD Volt 1 100 -160156.4 160151.5 FORMAT "%8.1" ARRAY_SIZE 1 ECU_ADDRESS 0x8FF8D8 /end MEASUREMENT
/begin MEASUREMENT LSUCD_uRiRaw "Spannungsrohwert Ri nach Mittelung" SWORD Volt 1 100 -160156.4 160151.5 FORMAT "%8.1" ARRAY_SIZE 1 ECU_ADDRESS 0x7F8EFE /end MEASUREMENT
/begin MEASUREMENT LSU_swtEna "Status-Message zu Freigabe oder Sperren der gesamten LSU-Funktionen" UBYTE OneToOne 1 100 0.00 255.0 FORMAT "%5.1" ECU_ADDRESS 0x7F890E /end MEASUREMENT
/begin MEASUREMENT PwrMng_absch_korr "correction value shut off" UWORD OneToOne 1 100 0.00 65535.00 FORMAT "%8.2" ECU_ADDRESS 0x7F8FE2 /end MEASUREMENT
/begin MEASUREMENT PwrMng_dmAirPerTimeI_mp "integrated air mass" SWORD AirMassPerTime 1 100 -3276.800 3276.700 FORMAT "%8.3" ECU_ADDRESS 0x8FF806 /end MEASUREMENT
/begin MEASUREMENT PwrMng_d_soc "battery load state" UWORD OneToOne 1 100 0.00 65535.00 FORMAT "%8.2" ECU_ADDRESS 0x7F8FE4 /end MEASUREMENT
/begin MEASUREMENT PwrMng_iEngine "engine current" SWORD igen_ub_q1 1 100 -32768.00 32767.00 FORMAT "%8.2" ECU_ADDRESS 0x7F8FE6 /end MEASUREMENT
/begin MEASUREMENT PwrMng_iGen "Alternator current" UBYTE igen_ub_q1 1 100 0.00 255.0 FORMAT "%5.1" ECU_ADDRESS 0x7F895D /end MEASUREMENT
/begin MEASUREMENT PwrMng_Nkw_mp "" UWORD nmot_uw_q0p25 1 100 0.00 16383.75 FORMAT "%8.2" ECU_ADDRESS 0x8FF808 /end MEASUREMENT
/begin MEASUREMENT PwrMng_nMin "low idle demand from PwrMng" SWORD EngN 1 100 -32768.00 32767.00 FORMAT "%8.2" ECU_ADDRESS 0x7F8FE8 /end MEASUREMENT
/begin MEASUREMENT PwrMng_nnnstart "start rpm engine" SWORD OneToOne 1 100 -32768.00 32767.00 FORMAT "%8.2" ECU_ADDRESS 0x7F8FEA /end MEASUREMENT
/begin MEASUREMENT PwrMng_pwrDes "alternator power" SWORD Pwr 1 100 -308831.1 308821.7 FORMAT "%8.1" ECU_ADDRESS 0x7F8FEC /end MEASUREMENT
/begin MEASUREMENT PwrMng_pwrPTC "dummy power management message" SWORD DtyCyc 1 100 -327.6800 327.6700 FORMAT "%8.4" ECU_ADDRESS 0x7F8FEE /end MEASUREMENT
/begin MEASUREMENT PwrMng_rCtrPwrSpCos "controlling power extra-consumers" UBYTE fak_q0p5 1 100 0.00 127.5 FORMAT "%5.1" ECU_ADDRESS 0x7F895E /end MEASUREMENT
/begin MEASUREMENT PwrMng_rdffgen "DF-signal in GS-resolution for CAN" UBYTE PCENT 1 100 0.00 99.61 FORMAT "%5.2" ECU_ADDRESS 0x7F895F /end MEASUREMENT
/begin MEASUREMENT PwrMng_stB_ccbtnach "Powermanagement value" UBYTE OneToOne 1 100 0.00 255.0 FORMAT "%5.1" ECU_ADDRESS 0x7F8960 /end MEASUREMENT
/begin MEASUREMENT PwrMng_stB_ccbttdfk "Powermanagement value" UBYTE OneToOne 1 100 0.00 255.0 FORMAT "%5.1" ECU_ADDRESS 0x7F8961 /end MEASUREMENT
/begin MEASUREMENT PwrMng_stB_ccbttknt "Powermanagement value" UBYTE OneToOne 1 100 0.00 255.0 FORMAT "%5.1" ECU_ADDRESS 0x7F8962 /end MEASUREMENT
/begin MEASUREMENT PwrMng_stB_ccpmerr "Powermanagement value" UBYTE OneToOne 1 100 0.00 255.0 FORMAT "%5.1" ECU_ADDRESS 0x7F8963 /end MEASUREMENT
/begin MEASUREMENT PwrMng_stB_ccprio "Powermanagement value" UBYTE OneToOne 1 100 0.00 255.0 FORMAT "%5.1" ECU_ADDRESS 0x7F8964 /end MEASUREMENT
/begin MEASUREMENT PwrMng_stB_ccruhver "Powermanagement value" UBYTE OneToOne 1 100 0.00 255.0 FORMAT "%5.1" ECU_ADDRESS 0x7F8965 /end MEASUREMENT
/begin MEASUREMENT PwrMng_stB_codierpm "Powermanagement value" UBYTE OneToOne 1 100 0.00 255.0 FORMAT "%5.1" ECU_ADDRESS 0x7F8966 /end MEASUREMENT
/begin MEASUREMENT PwrMng_stCtrCbr "controlling current branch" UBYTE DEZ 1 100 0.00 255.0 FORMAT "%5.1" ECU_ADDRESS 0x7F8967 /end MEASUREMENT
/begin MEASUREMENT PwrMng_stCtrPCos "controlling stand-consumers" UBYTE DEZ 1 100 0.00 255.0 FORMAT "%5.1" ECU_ADDRESS 0x7F8968 /end MEASUREMENT
/begin MEASUREMENT PwrMng_stCtrPrio "controlling priority peak decreasing" UBYTE DEZ 1 100 0.00 255.0 FORMAT "%5.1" ECU_ADDRESS 0x7F8969 /end MEASUREMENT
/begin MEASUREMENT PwrMng_stCtrPrioCf "controlling priority peak decreasing" UBYTE DEZ 1 100 0.00 255.0 FORMAT "%5.1" ECU_ADDRESS 0x7F896A /end MEASUREMENT
/begin MEASUREMENT PwrMng_stCtrPwrCos "controlling power consumers bit-coded" UWORD DEZ 1 100 0.00 65535.00 FORMAT "%8.2" ECU_ADDRESS 0x7F8FF0 /end MEASUREMENT
/begin MEASUREMENT PwrMng_stGen "State alternator" UBYTE OneToOne 1 100 0.00 255.0 FORMAT "%5.1" ECU_ADDRESS 0x7F896B /end MEASUREMENT
/begin MEASUREMENT PwrMng_stLdstGen "alternator load state" UBYTE OneToOne 1 100 0.00 255.0 FORMAT "%5.1" ECU_ADDRESS 0x7F896D /end MEASUREMENT
/begin MEASUREMENT PwrMng_stLIGov "State of low idle governor" UWORD OneToOne 1 100 0.00 65535.00 FORMAT "%8.2" ECU_ADDRESS 0x7F896C /end MEASUREMENT
/begin MEASUREMENT PwrMng_stPCos "state stand-consumers" UBYTE DEZ 1 100 0.00 255.0 FORMAT "%5.1" ECU_ADDRESS 0x7F896E /end MEASUREMENT
/begin MEASUREMENT PwrMng_stRqPCos "Demand stand-consumers" UBYTE DEZ 1 100 0.00 255.0 FORMAT "%5.1" ECU_ADDRESS 0x7F896F /end MEASUREMENT
/begin MEASUREMENT PwrMng_stSelSpCos "status extra-consumers detection" UBYTE DEZ 1 100 0.00 255.0 FORMAT "%5.1" ECU_ADDRESS 0x7F8970 /end MEASUREMENT
/begin MEASUREMENT PwrMng_stTerminal61 "Status Klemme 61" UBYTE OneToOne 1 100 0.00 255.0 FORMAT "%5.1" ECU_ADDRESS 0x7F8971 /end MEASUREMENT
/begin MEASUREMENT PwrMng_stULev "voltage level" UBYTE DEZ 1 100 0.00 255.0 FORMAT "%5.1" ECU_ADDRESS 0x7F8972 /end MEASUREMENT
/begin MEASUREMENT PwrMng_tiLRGen "Load-Response Zeit" UWORD Time_s 1 100 0.00 655.3500 FORMAT "%8.4" ECU_ADDRESS 0x7F8FF2 /end MEASUREMENT
/begin MEASUREMENT PwrMng_trqmd_gennm_mp "Alternator torque" SWORD Trq 1 100 -3276.800 3276.700 FORMAT "%8.3" ECU_ADDRESS 0x8FF80A /end MEASUREMENT
/begin MEASUREMENT PwrMng_tumgcan_mp "temperature from CAN" SWORD temp_q1 1 100 -32768.00 32767.00 FORMAT "%8.2" ECU_ADDRESS 0x8FF80C /end MEASUREMENT
/begin MEASUREMENT PwrMng_ubt "Battery voltage" UWORD spg_uw_q0p015 1 100 0.00 983.02500 ECU_ADDRESS 0x7F8FF8 /end MEASUREMENT
/begin MEASUREMENT PwrMng_uGen "Sollwert Generatorspannung" UWORD Volt_Batt 1 100 0.00 1281232. FORMAT "%8.0" ECU_ADDRESS 0x7F8FF4 /end MEASUREMENT
/begin MEASUREMENT PwrMng_uGen2 "" UWORD Volt_Batt 1 100 0.00 1281232. FORMAT "%8.0" ECU_ADDRESS 0x7F8FF6 /end MEASUREMENT
/begin MEASUREMENT PwrMng_V_mp "" UWORD vfzg_ub_q1p25 1 100 0.00 81918.75 FORMAT "%8.2" ECU_ADDRESS 0x8FF80E /end MEASUREMENT
/begin MEASUREMENT RF_BSD "" UBYTE OneToOne 1 100 0.00 255.0 FORMAT "%5.1" ECU_ADDRESS 0x8FF7DC /end MEASUREMENT
/begin MEASUREMENT RF_GEN "" UBYTE OneToOne 1 100 0.00 255.0 FORMAT "%5.1" ECU_ADDRESS 0x8FF7DD /end MEASUREMENT
/begin MEASUREMENT RF_IBS1 "" UBYTE OneToOne 1 100 0.00 255.0 FORMAT "%5.1" ECU_ADDRESS 0x8FF7DE /end MEASUREMENT
/begin MEASUREMENT RF_IBS2 "" UBYTE OneToOne 1 100 0.00 255.0 FORMAT "%5.1" ECU_ADDRESS 0x8FF7DF /end MEASUREMENT
/begin MEASUREMENT RF_IBS3 "" UBYTE OneToOne 1 100 0.00 255.0 FORMAT "%5.1" ECU_ADDRESS 0x8FF7E0 /end MEASUREMENT
/begin MEASUREMENT RF_MANHYDR "" UBYTE OneToOne 1 100 0.00 255.0 FORMAT "%5.1" ECU_ADDRESS 0x8FF7E1 /end MEASUREMENT
/begin MEASUREMENT RF_MANLUFT "" UBYTE OneToOne 1 100 0.00 255.0 FORMAT "%5.1" ECU_ADDRESS 0x8FF7E2 /end MEASUREMENT
/begin MEASUREMENT RF_PMBATT "" UBYTE OneToOne 1 100 0.00 255.0 FORMAT "%5.1" ECU_ADDRESS 0x8FF7E3 /end MEASUREMENT
/begin MEASUREMENT RF_PMBN "" UBYTE OneToOne 1 100 0.00 255.0 FORMAT "%5.1" ECU_ADDRESS 0x8FF7E4 /end MEASUREMENT
/begin MEASUREMENT RF_PMRUHVERL "" UBYTE OneToOne 1 100 0.00 255.0 FORMAT "%5.1" ECU_ADDRESS 0x8FF7E5 /end MEASUREMENT
/begin MEASUREMENT RF_QLT "" UBYTE OneToOne 1 100 0.00 255.0 FORMAT "%5.1" ECU_ADDRESS 0x8FF7E6 /end MEASUREMENT
/begin MEASUREMENT RF_TANS "" UBYTE OneToOne 1 100 0.00 255.0 FORMAT "%5.1" ECU_ADDRESS 0x8FF7E7 /end MEASUREMENT
/begin MEASUREMENT RF_TOENS "" UBYTE OneToOne 1 100 0.00 255.0 FORMAT "%5.1" ECU_ADDRESS 0x8FF7E8 /end MEASUREMENT
/begin MEASUREMENT RF_TUMG "" UBYTE OneToOne 1 100 0.00 255.0 FORMAT "%5.1" ECU_ADDRESS 0x8FF7E9 /end MEASUREMENT
/begin MEASUREMENT ZF_BSD "" UBYTE OneToOne 1 100 0.00 255.0 FORMAT "%5.1" ECU_ADDRESS 0x8FF7EA /end MEASUREMENT
/begin MEASUREMENT ZF_GEN "" UBYTE OneToOne 1 100 0.00 255.0 FORMAT "%5.1" ECU_ADDRESS 0x8FF7EB /end MEASUREMENT
/begin MEASUREMENT ZF_IBS1 "" UBYTE OneToOne 1 100 0.00 255.0 FORMAT "%5.1" ECU_ADDRESS 0x8FF7EC /end MEASUREMENT
/begin MEASUREMENT ZF_IBS2 "" UBYTE OneToOne 1 100 0.00 255.0 FORMAT "%5.1" ECU_ADDRESS 0x8FF7ED /end MEASUREMENT
/begin MEASUREMENT ZF_IBS3 "" UBYTE OneToOne 1 100 0.00 255.0 FORMAT "%5.1" ECU_ADDRESS 0x8FF7EE /end MEASUREMENT
/begin MEASUREMENT ZF_MANHYDR "" UBYTE OneToOne 1 100 0.00 255.0 FORMAT "%5.1" ECU_ADDRESS 0x8FF7EF /end MEASUREMENT
/begin MEASUREMENT ZF_MANLUFT "" UBYTE OneToOne 1 100 0.00 255.0 FORMAT "%5.1" ECU_ADDRESS 0x8FF7F0 /end MEASUREMENT
/begin MEASUREMENT ZF_PMBATT "" UBYTE OneToOne 1 100 0.00 255.0 FORMAT "%5.1" ECU_ADDRESS 0x8FF7F1 /end MEASUREMENT
/begin MEASUREMENT ZF_PMBN "" UBYTE OneToOne 1 100 0.00 255.0 FORMAT "%5.1" ECU_ADDRESS 0x8FF7F2 /end MEASUREMENT
/begin MEASUREMENT ZF_PMRUHVERL "" UBYTE OneToOne 1 100 0.00 255.0 FORMAT "%5.1" ECU_ADDRESS 0x8FF7F3 /end MEASUREMENT
/begin MEASUREMENT ZF_QLT "" UBYTE OneToOne 1 100 0.00 255.0 FORMAT "%5.1" ECU_ADDRESS 0x8FF7F4 /end MEASUREMENT
/begin MEASUREMENT ZF_TANS "" UBYTE OneToOne 1 100 0.00 255.0 FORMAT "%5.1" ECU_ADDRESS 0x8FF7F5 /end MEASUREMENT
/begin MEASUREMENT ZF_TOENS "" UBYTE OneToOne 1 100 0.00 255.0 FORMAT "%5.1" ECU_ADDRESS 0x8FF7F6 /end MEASUREMENT
/begin MEASUREMENT ZF_TUMG "" UBYTE OneToOne 1 100 0.00 255.0 FORMAT "%5.1" ECU_ADDRESS 0x8FF7F7 /end MEASUREMENT
/begin FUNCTION injvlv_wvcorlib "Druckwellenkorrektur Funktionsbibliothek"
 /begin DEF_CHARACTERISTIC InjVlv_facPiI2WvCor_C InjVlv_facWvCor1_MAP InjVlv_facWvCor2_MAP InjVlv_qWvCor1_MAP InjVlv_qWvCor2_MAP InjVlv_qWvCorMax_C InjVlv_qWvCorMin_C /end DEF_CHARACTERISTIC
 /begin IN_MEASUREMENT InjCrv_qMI1Des InjCrv_qPiI1Des InjCrv_qPoI2Des_mp InjVlv_rMI1WvCorNorm_mp InjVlv_tiMI1PoI2HydCor_mp InjVlv_tiPiI1MI1Cor_mp RailCD_pAct_mp /end IN_MEASUREMENT
 /begin OUT_MEASUREMENT InjVlv_pAct_mp /end OUT_MEASUREMENT
/end FUNCTION
/begin FUNCTION injvlv_wvcorlib_uic ""
 /begin OUT_MEASUREMENT InjVlv_facMI1PoI2WvCor_mp InjVlv_facPiI2PiI1WvCor_mp InjVlv_facPiIMI1WvCor_mp InjVlv_qMI1PoI2WvCor_mp InjVlv_qMI1WvCor_mp InjVlv_qPiI1MI1WvCor_mp InjVlv_qPiI1WvCor_mp InjVlv_qPiI2MI1WvCor_mp InjVlv_qPiI2PiI1WvCor_mp InjVlv_qPoI2WvCor_mp InjVlv_rMI1WvCorNorm_mp InjVlv_tiMI1PoI2Cor_mp InjVlv_tiMI1PoI2HydCor_mp InjVlv_tiMI1PoI2_mp InjVlv_tiPiI1MI1Cor_mp InjVlv_tiPiI1MI1_mp InjVlv_tiPiI2MI1Cor_mp InjVlv_tiPiI2MI1_mp InjVlv_tiPiI2PiI1Cor_mp InjVlv_tiPiI2PiI1_mp /end OUT_MEASUREMENT
/end FUNCTION
/begin FUNCTION injvlv_wvcor_msg "" /begin OUT_MEASUREMENT InjVlv_facFTSWvCor InjVlv_qWvCorNorm InjVlv_stWvCor /end OUT_MEASUREMENT /end FUNCTION
/begin FUNCTION injvlv_wvcor_uic "" /begin OUT_MEASUREMENT InjVlv_tWvCor_mp /end OUT_MEASUREMENT /end FUNCTION
/begin FUNCTION ivctl_tichrg "Ladezeitregelung des Piezoaktors"
 /begin DEF_CHARACTERISTIC IVCtl_ChrgUpIKi_C IVCtl_ChrgUpIKiPos_C IVCtl_ChrgUpIKiNeg_C IVCtl_tiChrgUpIWinPos_C IVCtl_tiChrgUpIWinNeg_C IVCtl_ChrgUpPKp_C IVCtl_ChrgUpPKpPos_C IVCtl_ChrgUpPKpNeg_C IVCtl_tiChrgUpPWinPos_C IVCtl_tiChrgUpPWinNeg_C IVCtl_DisChDwnIKi_C IVCtl_DisChDwnIKiPos_C IVCtl_DisChDwnIKiNeg_C IVCtl_tiDisChDwnIWinPos_C IVCtl_tiDisChDwnIWinNeg_C IVCtl_DisChDwnPKp_C IVCtl_DisChDwnPKpPos_C IVCtl_DisChDwnPKpNeg_C IVCtl_tiDisChDwnPWinPos_C IVCtl_tiDisChDwnPWinNeg_C IVCtl_iChrgUpCls_C IVCtl_iChrgUpGovMax_C IVCtl_iChrgUpGovMin_C IVCtl_iChrgUpInitI_C IVCtl_iChrgUpMax_C IVCtl_iChrgUpMin_C IVCtl_iChrgUp_MAP IVCtl_iDisChDwnCls_C IVCtl_iDisChDwnGovMax_C IVCtl_iDisChDwnGovMin_C IVCtl_iDisChDwnInitI_C IVCtl_iDisChDwnMax_C IVCtl_iDisChDwnMin_C IVCtl_iDisChDwn_CUR IVCtl_swtTiChrgMinMaxActr_C IVCtl_swtTiChrgMinMaxRst_C IVCtl_swtTiChrgMinMax_C IVCtl_tiChrgSetUp_MAP IVCtl_tiChrgUpPse_C IVCtl_tiDisChDwnPse_C IVCtl_tiDisChSetDwn_CUR /end DEF_CHARACTERISTIC
 /begin IN_MEASUREMENT RailCD_pPeak /end IN_MEASUREMENT
 /begin OUT_MEASUREMENT IVCtl_iChrgUp2_mp IVCtl_iChrgUpPI_mp IVCtl_iChrgUp_mp IVCtl_iDisChDwnPI_mp IVCtl_tiChrgSetUp_mp IVCtl_tiChrgUpAvrg_mp IVCtl_tiChrgUpInPIActr_mp IVCtl_tiChrgUpMaxActr_mp IVCtl_tiChrgUpMax_mp IVCtl_tiChrgUpMinActr_mp IVCtl_tiChrgUpMin_mp IVCtl_tiChrgUpPse_mp IVCtl_tiDisChBottAvrg_mp IVCtl_tiDisChDwnInPIActr_mp IVCtl_tiDisChDwnMaxActr_mp IVCtl_tiDisChDwnMax_mp IVCtl_tiDisChDwnMinActr_mp IVCtl_tiDisChDwnMin_mp IVCtl_tiDisChDwnPse_mp IVCtl_tiDisChSetDwn_mp IVCtl_uSetUp2Avrg_mp IVCtl_uSetUpAvrg_mp /end OUT_MEASUREMENT
/end FUNCTION
/begin FUNCTION ivctl_tichrg_msg ""
 /begin OUT_MEASUREMENT IVCtl_iDisChDwn IVCtl_iDisChDwn2 IVCtl_stTiChrgPI IVCtl_tiChrgUpInPI IVCtl_tiDisChDwnInPI /end OUT_MEASUREMENT
/end FUNCTION
/begin FUNCTION ivctl_volt "Spannungsregelung"
 /begin DEF_CHARACTERISTIC IVCtl_IKi_C IVCtl_IKiPos_C IVCtl_IKiNeg_C IVCtl_uIWinPos_C IVCtl_uIWinNeg_C IVCtl_PKp_C IVCtl_PKpPos_C IVCtl_PKpNeg_C IVCtl_uPWinPos_C IVCtl_uPWinNeg_C IVCtl_swtAvrgEnaTiWarnVolt_C IVCtl_swtUUpMinMaxActr_C IVCtl_swtUUpMinMaxRst_C IVCtl_swtUUpMinMax_C IVCtl_uClsActrUp_C IVCtl_uMaxSetUp_C IVCtl_uMinSetUp_C IVCtl_uPIMax_C IVCtl_uPIMin_C IVCtl_uSetUpPreCtl_CUR IVCtl_uUpInitI_C /end DEF_CHARACTERISTIC
 /begin IN_MEASUREMENT InjVlv_pCalcVolt /end IN_MEASUREMENT
 /begin OUT_MEASUREMENT IVCtl_stAvrgEnaTiWarnVolt_mp IVCtl_uSetUpActrUnCorr_mp IVCtl_uSetUpActrUnLim_mp IVCtl_uSetUpPreCtl_mp IVCtl_uSetUpTmp_mp IVCtl_uUpInPIActr_mp IVCtl_uUpInPIMaxActr_mp IVCtl_uUpInPIMax_mp IVCtl_uUpInPIMinActr_mp IVCtl_uUpInPIMin_mp IVCtl_uUpTmp_mp /end OUT_MEASUREMENT
/end FUNCTION
/begin FUNCTION ivctl_volt_msg ""
 /begin OUT_MEASUREMENT IVCtl_stVoltPI IVCtl_uClsActrUp IVCtl_uCorrUp IVCtl_uSetBott IVCtl_uSetOfsActr IVCtl_uSetUpActr IVCtl_uUpInPI /end OUT_MEASUREMENT
/end FUNCTION
/begin FUNCTION ivctl_volt_uic "" /end FUNCTION
/begin FUNCTION k2rdli "" /begin DEF_CHARACTERISTIC K2RDLI_dDataSetVer_C /end DEF_CHARACTERISTIC /end FUNCTION
/begin FUNCTION layer ""
 /begin DEF_CHARACTERISTIC Dmd_gen_C Layer_APPVARBN_C Layer_APPVARVEH_C Layer_swtB_bsdprot Layer_swtTunProt_C PwrMng_B_ulcp_C PwrMng_dmAirPerTimeCor_C PwrMng_dmAirPerTimeIMax_C PwrMng_dmAirPerTimeIMin_C PwrMng_dmAirPerTimeIKi_C PwrMng_dmAirPerTimeIKiPos_C PwrMng_dmAirPerTimeIKiNeg_C PwrMng_dmAirPerTimeIWinPos_C PwrMng_dmAirPerTimeIWinNeg_C PwrMng_nB_kwdreht_C PwrMng_nB_llHigh_C PwrMng_nB_llLow_C PwrMng_rLoadMax_C PwrMng_stIdlingDefVal_C PwrMng_swtnmot_w_C PwrMng_swtPmsvActiv_C PwrMng_swttumg_C PwrMng_tiChgBatt_C PwrMng_tiHisRst_C PwrMng_Tkat_mod_C PwrMng_uAltTargetDefVal_C /end DEF_CHARACTERISTIC
/end FUNCTION
/begin FUNCTION layer_fltmng ""
 /begin DEF_CHARACTERISTIC Layer_ctDebBSDStep_C Layer_ctDebGENStep_C Layer_ctDebIBS1Step_C Layer_ctDebIBS2Step_C Layer_ctDebIBS3Step_C Layer_ctDebMANHYDRStep_C Layer_ctDebMANLUFTStep_C Layer_ctDebPMBATTStep_C Layer_ctDebPMBNStep_C Layer_ctDebPMRUHVERLStep_C Layer_ctDebQLTStep_C Layer_ctDebTANSStep_C Layer_ctDebTOENSStep_C Layer_ctDebTUMGStep_C Layer_ctDebBSDDef_C Layer_ctDebBSDOk_C Layer_ctDebGENDef_C Layer_ctDebGENOk_C Layer_ctDebIBS1Def_C Layer_ctDebIBS1Ok_C Layer_ctDebIBS2Def_C Layer_ctDebIBS2Ok_C Layer_ctDebIBS3Def_C Layer_ctDebIBS3Ok_C Layer_ctDebMANHYDRDef_C Layer_ctDebMANHYDROk_C Layer_ctDebMANLUFTDef_C Layer_ctDebMANLUFTOk_C Layer_ctDebPMBATTDef_C Layer_ctDebPMBATTOk_C Layer_ctDebPMBNDef_C Layer_ctDebPMBNOk_C Layer_ctDebPMRUHVERLDef_C Layer_ctDebPMRUHVERLOk_C Layer_ctDebQLTDef_C Layer_ctDebQLTOk_C Layer_ctDebTANSDef_C Layer_ctDebTANSOk_C Layer_ctDebTOENSDef_C Layer_ctDebTOENSOk_C Layer_ctDebTUMGDef_C Layer_ctDebTUMGOk_C /end DEF_CHARACTERISTIC
/end FUNCTION
/begin FUNCTION layer_fltmng_uic ""
 /begin OUT_MEASUREMENT BD_BSD BD_GEN BD_IBS1 BD_IBS2 BD_IBS3 BD_MANHYDR BD_MANLUFT BD_PMBATT BD_PMBN BD_PMRUHVERL BD_QLT BD_TANS BD_TOENS BD_TUMG E_BSD E_GEN E_IBS1 E_IBS2 E_IBS3 E_MANHYDR E_MANLUFT E_PMBATT E_PMBN E_PMRUHVERL E_QLT E_TANS E_TOENS E_TUMG RF_BSD RF_GEN RF_IBS1 RF_IBS2 RF_IBS3 RF_MANHYDR RF_MANLUFT RF_PMBATT RF_PMBN RF_PMRUHVERL RF_QLT RF_TANS RF_TOENS RF_TUMG ZF_BSD ZF_GEN ZF_IBS1 ZF_IBS2 ZF_IBS3 ZF_MANHYDR ZF_MANLUFT ZF_PMBATT ZF_PMBN ZF_PMRUHVERL ZF_QLT ZF_TANS ZF_TOENS ZF_TUMG /end OUT_MEASUREMENT
/end FUNCTION
/begin FUNCTION layer_msg ""
 /begin OUT_MEASUREMENT Layer_bos01_w Layer_bosbtvfbk Layer_bosstate Layer_bosvalue_DIAG Layer_FRC_INTM_T_BOS2 Layer_FRC_INTM_WAY_BOS2 Layer_ID2_BOS2 Layer_idbosmsg Layer_idfbosmg_w Layer_ID_FN_BOS2 Layer_stLayer Layer_stOelTog Layer_stOelVerb Layer_stOelVerl Layer_TARD_MON_BOS2 Layer_TARD_YR_BOS2 Layer_volOil Layer_volOilRefill Layer_zrbosmld PwrMng_absch_korr PwrMng_d_soc PwrMng_iEngine PwrMng_iGen PwrMng_nMin PwrMng_nnnstart PwrMng_pwrDes PwrMng_pwrPTC PwrMng_rCtrPwrSpCos PwrMng_rdffgen PwrMng_stB_ccbtnach PwrMng_stB_ccbttdfk PwrMng_stB_ccbttknt PwrMng_stB_ccpmerr PwrMng_stB_ccprio PwrMng_stB_ccruhver PwrMng_stB_codierpm PwrMng_stCtrCbr PwrMng_stCtrPCos PwrMng_stCtrPrio PwrMng_stCtrPrioCf PwrMng_stCtrPwrCos PwrMng_stGen PwrMng_stLdstGen PwrMng_stLIGov PwrMng_stPCos PwrMng_stRqPCos PwrMng_stSelSpCos PwrMng_stTerminal61 PwrMng_stULev PwrMng_tiLRGen PwrMng_ubt PwrMng_uGen PwrMng_uGen2 /end OUT_MEASUREMENT
/end FUNCTION
/begin FUNCTION layer_uic ""
 /begin OUT_MEASUREMENT Counter_Layer_fp1000_mp Counter_Layer_fp100_mp Counter_Layer_fp10_mp Counter_Layer_fp200_mp Counter_Layer_ini_mp Counter_Layer_nl1000_mp Counter_Layer_nl100_mp Counter_Layer_nl10_mp Counter_Layer_nl200_mp Counter_Layer_wakeup1000_mp Counter_Layer_wakeup100_mp Counter_Layer_wakeup10_mp Counter_Layer_wakeup200_mp PwrMng_dmAirPerTimeI_mp PwrMng_Nkw_mp PwrMng_trqmd_gennm_mp PwrMng_tumgcan_mp PwrMng_V_mp /end OUT_MEASUREMENT
/end FUNCTION
/begin FUNCTION ligov "Leerlaufregler"
 /begin DEF_CHARACTERISTIC LIGov_CldCltchFlt1T1_C LIGov_CldCltchFlt2T1_C LIGov_CldCltchIKi_C LIGov_CldCltchIKiPos_C LIGov_CldCltchIKiNeg_C LIGov_CldCltchIWinPos_C LIGov_CldCltchIWinNeg_C LIGov_CldCltchPredef_C LIGov_CldCltchPKp_C LIGov_CldCltchPKpPos_C LIGov_CldCltchPKpNeg_C LIGov_CldCltchPWinPos_C LIGov_CldCltchPWinNeg_C LIGov_tiCldGearDT1_C LIGov_CldGearDKd_C LIGov_CldGearIKi_C LIGov_CldGearIKiPos_C LIGov_CldGearIKiNeg_C LIGov_CldGearIWinPos_C LIGov_CldGearIWinNeg_C LIGov_CldGearPredef_C LIGov_CldGearPKp_C LIGov_CldGearPKpPos_C LIGov_CldGearPKpNeg_C LIGov_CldGearPWinPos_C LIGov_CldGearPWinNeg_C LIGov_tiGear1DT1_C LIGov_Gear1DKd_C LIGov_Gear1Flt1T1_C LIGov_Gear1Flt2T1_C LIGov_Gear1IKi_C LIGov_Gear1IKiPos_C LIGov_Gear1IKiNeg_C LIGov_Gear1IWinPos_C LIGov_Gear1IWinNeg_C LIGov_Gear1Predef_C LIGov_Gear1PKp_C LIGov_Gear1PKpPos_C LIGov_Gear1PKpNeg_C LIGov_Gear1PWinPos_C LIGov_Gear1PWinNeg_C LIGov_tiGear2DT1_C LIGov_Gear2DKd_C LIGov_Gear2Flt1T1_C LIGov_Gear2Flt2T1_C LIGov_Gear2IKi_C LIGov_Gear2IKiPos_C LIGov_Gear2IKiNeg_C LIGov_Gear2IWinPos_C LIGov_Gear2IWinNeg_C LIGov_Gear2Predef_C LIGov_Gear2PKp_C LIGov_Gear2PKpPos_C LIGov_Gear2PKpNeg_C LIGov_Gear2PWinPos_C LIGov_Gear2PWinNeg_C LIGov_tiGear3DT1_C LIGov_Gear3DKd_C LIGov_Gear3Flt1T1_C LIGov_Gear3Flt2T1_C LIGov_Gear3IKi_C LIGov_Gear3IKiPos_C LIGov_Gear3IKiNeg_C LIGov_Gear3IWinPos_C LIGov_Gear3IWinNeg_C LIGov_Gear3Predef_C LIGov_Gear3PKp_C LIGov_Gear3PKpPos_C LIGov_Gear3PKpNeg_C LIGov_Gear3PWinPos_C LIGov_Gear3PWinNeg_C LIGov_tiGear4DT1_C LIGov_Gear4DKd_C LIGov_Gear4Flt1T1_C LIGov_Gear4Flt2T1_C LIGov_Gear4IKi_C LIGov_Gear4IKiPos_C LIGov_Gear4IKiNeg_C LIGov_Gear4IWinPos_C LIGov_Gear4IWinNeg_C LIGov_Gear4Predef_C LIGov_Gear4PKp_C LIGov_Gear4PKpPos_C LIGov_Gear4PKpNeg_C LIGov_Gear4PWinPos_C LIGov_Gear4PWinNeg_C LIGov_tiGear5DT1_C LIGov_Gear5DKd_C LIGov_Gear5Flt1T1_C LIGov_Gear5Flt2T1_C LIGov_Gear5IKi_C LIGov_Gear5IKiPos_C LIGov_Gear5IKiNeg_C LIGov_Gear5IWinPos_C LIGov_Gear5IWinNeg_C LIGov_Gear5Predef_C LIGov_Gear5PKp_C LIGov_Gear5PKpPos_C LIGov_Gear5PKpNeg_C LIGov_Gear5PWinPos_C LIGov_Gear5PWinNeg_C LIGov_tiGear6DT1_C LIGov_Gear6DKd_C LIGov_Gear6Flt1T1_C LIGov_Gear6Flt2T1_C LIGov_Gear6IKi_C LIGov_Gear6IKiPos_C LIGov_Gear6IKiNeg_C LIGov_Gear6IWinPos_C LIGov_Gear6IWinNeg_C LIGov_Gear6Predef_C LIGov_Gear6PKp_C LIGov_Gear6PKpPos_C LIGov_Gear6PKpNeg_C LIGov_Gear6PWinPos_C LIGov_Gear6PWinNeg_C LIGov_nDflTrmVal_C LIGov_nDHypDenom_C LIGov_nDHypNum_C LIGov_nLimHigh_C LIGov_nLimLow_C LIGov_nMSDiffMax_C LIGov_nOffsetPreCtrltrqDem_C LIGov_nOffsetPreCtrl_C LIGov_nOffsetPredef_C LIGov_nOffsetUbr_C LIGov_rAPPThresFreezeI_C LIGov_rAPPThresTrqDem_C LIGov_stPsRev_C LIGov_swtAPPFreezeI_C LIGov_swtAPPTrqDem_C LIGov_swtInitPreCtrlNotLck_C LIGov_tClntXLow_C LIGov_tClntXHigh_C LIGov_stCold_C LIGov_stWarm_C LIGov_tiDelCutOut_C LIGov_tiPT1_CUR LIGov_trqMax_CUR LIGov_trqThresDefrostI_C LIGov_UbrPKp_C LIGov_UbrPKpPos_C LIGov_UbrPKpNeg_C LIGov_UbrPWinPos_C LIGov_UbrPWinNeg_C LIGov_vThresUbr_C LIGov_WrmCltchFlt1T1_C LIGov_WrmCltchFlt2T1_C LIGov_WrmCltchIKi_C LIGov_WrmCltchIKiPos_C LIGov_WrmCltchIKiNeg_C LIGov_WrmCltchIWinPos_C LIGov_WrmCltchIWinNeg_C LIGov_WrmCltchPredef_C LIGov_WrmCltchPKp_C LIGov_WrmCltchPKpPos_C LIGov_WrmCltchPKpNeg_C LIGov_WrmCltchPWinPos_C LIGov_WrmCltchPWinNeg_C /end DEF_CHARACTERISTIC
 /begin IN_MEASUREMENT Eng_nAvrg LIGov_nDiff_mp /end IN_MEASUREMENT
/end FUNCTION
/begin FUNCTION ligov_msg ""
 /begin OUT_MEASUREMENT LIGov_st LIGov_trq LIGov_trqCurrPredef LIGov_trqFlt LIGov_trqI LIGov_trqP /end OUT_MEASUREMENT
/end FUNCTION
/begin FUNCTION ligov_ms_msg "" /end FUNCTION
/begin FUNCTION ligov_setpoint ""
 /begin DEF_CHARACTERISTIC LIGov_dnLimHighTrm_C LIGov_dnLimLowTrm_C LIGov_nDeltaSec_C LIGov_nDiffDelta_C LIGov_nHDC_C LIGov_nLimHighOfs_C LIGov_nLimHighTrmAct_C LIGov_nRmpBaseDwn_C LIGov_nRmpBaseUp_C LIGov_nRmpCoEngDwn_C LIGov_nRmpCoEngUp_C LIGov_nRmpCutOutUp_C LIGov_nRmpCutOutDwn_C LIGov_nRmpGearbxDwn_C LIGov_nRmpGearbxUp_C LIGov_nRmpHDCDwn_C LIGov_nRmpHDCUp_C LIGov_nRmpPwrMngDwn_C LIGov_nRmpPwrMngUp_C LIGov_nRmpSecDelta_C LIGov_nRmpSurgeDwn_C LIGov_nRmpSurgeUp_C LIGov_nSetpointDia_C LIGov_nSetpointDriveAway_C LIGov_nSetpointInit_MAP LIGov_nSetpointTrmLim_C LIGov_nSetpointTrm_C LIGov_nSetPointWarm_C LIGov_stActiveHDC_C LIGov_stReleaseHDC_C LIGov_tiTW_C LIGov_trqInitI_CUR /end DEF_CHARACTERISTIC
 /begin IN_MEASUREMENT APSCD_pVal CTSCD_tClnt /end IN_MEASUREMENT
/end FUNCTION
/begin FUNCTION ligov_setpoint_msg ""
 /begin OUT_MEASUREMENT LIGov_nLimHigh LIGov_nMaxTrq LIGov_nSetLocal2 LIGov_nSetpoint LIGov_nSetpointTrm LIGov_stActiveHDC LIGov_stSetPoint LIGov_stSetpointTrmActive LIGov_trqInitI /end OUT_MEASUREMENT
/end FUNCTION
/begin FUNCTION ligov_setpoint_uic "" /begin DEF_CHARACTERISTIC LIGov_nSetpoint_Vector LIGov_nSetpoint_Channel /end DEF_CHARACTERISTIC
 /begin OUT_MEASUREMENT LIGov_nDiffDelta_mp LIGov_nHDC_mp LIGov_nSetCoEngOld_mp LIGov_nSetCoEng_mp LIGov_nSetGearbxOld_mp LIGov_nSetGearbx_mp LIGov_nSetHDCOld_mp LIGov_nSetHDC_mp LIGov_nSetLocal0_mp LIGov_nSetLocalRampOld_mp LIGov_nSetLocalRamp_mp LIGov_nSetpointOld_mp LIGov_nSetpointTemp_mp LIGov_nSetpointTrm_mp LIGov_nSetPwrMngOld_mp LIGov_nSetPwrMng_mp LIGov_nSetSec1_mp LIGov_nSetSec2_mp LIGov_nSetSec4_mp LIGov_nSetSurgeOld_mp LIGov_nSetSurge_mp LIGov_stSetpointTrmAlw_mp /end OUT_MEASUREMENT
/end FUNCTION
/begin FUNCTION ligov_tsync_ps_conv ""
 /begin DEF_CHARACTERISTIC LIGov_tiCldCltchDT1_C LIGov_CldCltchDKd_C LIGov_tiWrmCltchDT1_C LIGov_WrmCltchDKd_C /end DEF_CHARACTERISTIC
/end FUNCTION
/begin FUNCTION ligov_uic "" /begin DEF_CHARACTERISTIC LIGov_trq_Vector LIGov_trq_Channel /end DEF_CHARACTERISTIC
 /begin OUT_MEASUREMENT LIGov_CurrDKd_mp LIGov_CurrDT1_mp LIGov_CurrFlt1T1_mp LIGov_CurrFlt2T1_mp LIGov_CurrIKiNeg_mp LIGov_CurrIKiPos_mp LIGov_CurrIKi_mp LIGov_CurrIWinNeg_mp LIGov_CurrIWinPos_mp LIGov_CurrPKpNeg_mp LIGov_CurrPKpPos_mp LIGov_CurrPKp_mp LIGov_CurrPWinNeg_mp LIGov_CurrPWinPos_mp LIGov_nAvrg_mp LIGov_nDiffFlt1_mp LIGov_nDiffFlt2_mp LIGov_nDiff_mp LIGov_rIpoConvPS_mp LIGov_tiPT1_mp LIGov_trqDRaw_mp LIGov_trqD_mp LIGov_trqMax_mp LIGov_trqPreInitI_mp /end OUT_MEASUREMENT
/end FUNCTION
/begin FUNCTION lpacd ""
 /begin DEF_CHARACTERISTIC LPACD_DebExcTempDef_C LPACD_DebExcTempOk_C LPACD_DebNoLoadDef_C LPACD_DebNoLoadOk_C LPACD_DebShortCircBatDef_C LPACD_DebShortCircBatOk_C LPACD_DebShortCircGndDef_C LPACD_DebShortCircGndOk_C LPACD_numDia_C LPACD_numPwmOut_C LPACD_stInvOut_C LPACD_tiPer_C LPACD_rCnv_CUR LPACD_rOutMax_C LPACD_rOutMin_C LPACD_rTst_C LPACD_stPwrStgActv_C LPACD_stPwrStgDia_C LPACD_swt_C LPACD_tiBtwTst_C /end DEF_CHARACTERISTIC
 /begin IN_MEASUREMENT BPA_rLPACD /end IN_MEASUREMENT
/end FUNCTION
/begin FUNCTION lpacd_msg "" /begin OUT_MEASUREMENT LPACD_rOut /end OUT_MEASUREMENT /end FUNCTION
/begin FUNCTION lpacd_uic "" /begin OUT_MEASUREMENT LPACD_rCnv_mp /end OUT_MEASUREMENT /end FUNCTION
/begin FUNCTION lsucd_adaption "Adaption des Lambdasondensignals"
 /begin DEF_CHARACTERISTIC LSUCD_tiAdptFltInit_C LSUCD_tiAdptFlt_C LSUCD_d2rInit_C LSUCD_dmAirIKi_C LSUCD_dmAirIKiPos_C LSUCD_dmAirIKiNeg_C LSUCD_dmAirIWinPos_C LSUCD_dmAirIWinNeg_C LSUCD_EvalMaxVal_C LSUCD_EvalMinVal_C LSUCD_tiEvalFltInit_C LSUCD_tiEvalFlt_C LSUCD_mAirAdptActv_C LSUCD_swtAdptVal_C LSUCD_swtAdptType_C LSUCD_tAirAdptActv_C /end DEF_CHARACTERISTIC
 /begin OUT_MEASUREMENT LSUCD_d2rO2Eval_mp LSUCD_d2rO2_mp LSUCD_drO2Flt_mp LSUCD_facO2Corr_mp LSUCD_mAirAftOvrRun_mp LSUCD_stAdptActv_mp LSUCD_stChange_mp LSUCD_stHold_mp /end OUT_MEASUREMENT
/end FUNCTION
/begin FUNCTION lsucd_adaption_msg "" /begin OUT_MEASUREMENT LSUCD_drO2Adpt LSUCD_rO2Adpt LSUCD_stAdpt LSUCD_swtAdpt /end OUT_MEASUREMENT /end FUNCTION
/begin FUNCTION lsucd_adaption_uic "" /end FUNCTION
/begin FUNCTION lsucd_heater "Heizung der Lambdasonde"
 /begin DEF_CHARACTERISTIC LSUCD_stHtInvOut_C LSUCD_tiHtPer_C LSUCD_tiDebHeaterDef_C LSUCD_tiDebHeaterOk_C LSUCD_uBattNominal_C LSUCD_uBattMaxHigh_C LSUCD_uBattMaxLow_C LSUCD_stPwrStgDia_C LSUCD_dcycTstPowerStage_C LSUCD_tiDebReset_C LSUCD_stHtDis_C LSUCD_stHeaterPwrStgSel_C LSUCD_tiHeaterBattDefDelay_C /end DEF_CHARACTERISTIC
 /begin OUT_MEASUREMENT LSUCD_facUCor_mp LSUCD_rOutHWE_mp /end OUT_MEASUREMENT
/end FUNCTION
/begin FUNCTION lsucd_heater_msg "" /begin OUT_MEASUREMENT LSUCD_dcycHtCor LSUCD_dcycLimActHt LSUCD_stHtDis /end OUT_MEASUREMENT /end FUNCTION
/begin FUNCTION lsucd_iprefctl "Controlling of the reference pump current"
 /begin DEF_CHARACTERISTIC LSUCD_stRefPumpDis_C LSUCD_tiRefPumpHigh_C LSUCD_tiRefTransLow_C LSUCD_tiRgnEna_C LSUCD_tiRgnIpSettle_C LSUCD_swtRgnChngCirct_C /end DEF_CHARACTERISTIC
 /begin OUT_MEASUREMENT LSUCD_stRefCurTrans_mp /end OUT_MEASUREMENT
/end FUNCTION
/begin FUNCTION lsucd_iprefctl_msg ""
 /begin OUT_MEASUREMENT LSUCD_stIpHighCurEna LSUCD_stIpNormCurEna LSUCD_stPumpDemRef LSUCD_stRefPump LSUCD_stRgnEna LSUCD_stRgnIpSettle /end OUT_MEASUREMENT
/end FUNCTION
/begin FUNCTION lsucd_iprefctl_uic "" /end FUNCTION
/begin FUNCTION lsucd_o2raw "Sauerstoffrohwert der Lambdasonde"
 /begin DEF_CHARACTERISTIC LSUCD_DebO2ClbDef_C LSUCD_DebO2ClbOk_C LSUCD_rO2_CUR LSUCD_tiO2ClbPT1_C LSUCD_tiO2PT1_C LSUCD_tiDebO2MaxTstDef_C LSUCD_tiDebO2MaxTstOk_C LSUCD_tiDebO2MinDef_C LSUCD_tiDebO2MinOk_C LSUCD_tiDelO2Clb_C LSUCD_tiO2Clb_C LSUCD_tiDelO2Val_C LSUCD_uO2Ref_C LSUCD_uO2ClbMax_C LSUCD_uO2ClbMin_C LSUCD_swtO2Filter_C LSUCD_uO2MaxNorm_C LSUCD_uO2MaxTst_C LSUCD_uO2Min_C LSUCD_swtSensDrftComp_C /end DEF_CHARACTERISTIC
 /begin OUT_MEASUREMENT LSUCD_stO2Clb_mp LSUCD_stSRCState_mp LSUCD_uO2OfsCor_mp LSUCD_uO2Raw_mp /end OUT_MEASUREMENT
/end FUNCTION
/begin FUNCTION lsucd_o2raw_msg ""
 /begin OUT_MEASUREMENT LSUCD_rO2Act LSUCD_rO2Raw LSUCD_stO2Act LSUCD_stO2ClbEna LSUCD_stO2IntValid LSUCD_stO2SPICalDem LSUCD_stO2SPISens LSUCD_uO2Clb LSUCD_uO2Raw LSU_swtEna /end OUT_MEASUREMENT
/end FUNCTION
/begin FUNCTION lsucd_o2raw_msg_var "" /begin OUT_MEASUREMENT LSUCD_stO2Valid /end OUT_MEASUREMENT /end FUNCTION
/begin FUNCTION lsucd_prescomp "Druckkompensation der mit Lambdasonde gemessenen Sauerstoffkonzentration"
 /begin DEF_CHARACTERISTIC LSUCD_facPresCompLean_CUR LSUCD_facPresCompRich_CUR LSUCD_rO2SwtPresComp_C /end DEF_CHARACTERISTIC
 /begin OUT_MEASUREMENT LSUCD_facPresComp_mp LSUCD_pExhGasLstVal_mp /end OUT_MEASUREMENT
/end FUNCTION
/begin FUNCTION lsucd_prescomp_msg "" /begin OUT_MEASUREMENT LSUCD_rO2PresComp /end OUT_MEASUREMENT /end FUNCTION
/begin FUNCTION lsucd_prescomp_uic "" /end FUNCTION
/begin FUNCTION lsucd_pumpctl "Pump current control" /begin DEF_CHARACTERISTIC LSUCD_stPumpCtlDis_C /end DEF_CHARACTERISTIC /end FUNCTION
/begin FUNCTION lsucd_pumpctl_msg "" /begin OUT_MEASUREMENT LSUCD_stPumpCtl /end OUT_MEASUREMENT /end FUNCTION
/begin FUNCTION lsucd_pumpctl_uic "" /end FUNCTION
/begin FUNCTION lsucd_ri "Ri der Lambdasonde"
 /begin DEF_CHARACTERISTIC LSUCD_DebRiClbDef_C LSUCD_DebRiClbOk_C LSUCD_tiRiClbPT1_C LSUCD_tiRiPT1_C LSUCD_tRi_CUR LSUCD_tiDelRiClb_C LSUCD_tiRiClb_C LSUCD_tiDelRiVal_C LSUCD_tiRiFltSettle_C LSUCD_resRiMaxJmp_C LSUCD_uRiOfs_C LSUCD_facUToRi_C LSUCD_resRiClbRef_C LSUCD_resRiClbMax_C LSUCD_resRiClbMin_C LSUCD_numRiDistSupp_C /end DEF_CHARACTERISTIC
 /begin OUT_MEASUREMENT LSUCD_resRiChange_mp LSUCD_resRiClbRaw_mp LSUCD_resRi_mp LSUCD_stRiFltAct_mp LSUCD_stRiLimSlp_mp /end OUT_MEASUREMENT
/end FUNCTION
/begin FUNCTION lsucd_ri_msg ""
 /begin OUT_MEASUREMENT LSUCD_resRi LSUCD_resRiClb LSUCD_resRiRaw LSUCD_stRiClb LSUCD_stRiClbEna LSUCD_stRiSPICalDem LSUCD_stRiValid LSUCD_tRi LSUCD_uRiRaw /end OUT_MEASUREMENT
/end FUNCTION
/begin FUNCTION lsucd_spictl "SPI Chip control"
 /begin DEF_CHARACTERISTIC LSUCD_stCJ125CS_C LSUCD_stRefCurHigh_C LSUCD_stRefCurNormal_C /end DEF_CHARACTERISTIC
/end FUNCTION
/begin FUNCTION lsucd_spictl_msg "" /begin OUT_MEASUREMENT LSUCD_stCircModeNew LSUCD_stSPIDiaInfo LSUCD_stSPIInitVal /end OUT_MEASUREMENT /end FUNCTION
/begin FUNCTION lsucd_spictl_uic "" /end FUNCTION
/begin FUNCTION lsucd_wiredia "Überwachung und Fehlererkennung von Kabel"
 /begin DEF_CHARACTERISTIC LSUCD_dcycMinGrad_C LSUCD_DebHtCoupDef_C LSUCD_DebHtCoupOk_C LSUCD_DebWireIpDef_C LSUCD_DebWireIpOk_C LSUCD_dNumHtCoup_C LSUCD_resRiMaxGrad_C LSUCD_rO2IsolChkMax_C LSUCD_rO2IsolChkMin_C LSUCD_stWireDiaActv_C LSUCD_tiHtCoupChk_C LSUCD_tiHtCoupPer_C LSUCD_tiIsolChkErr_C LSUCD_tiIsolChkPer_C LSUCD_tiIsolChkPump_C LSUCD_tiHtCoupFlt_C LSUCD_uO2MaxGrad_C LSUCD_uO2MaxRippel_C /end DEF_CHARACTERISTIC
 /begin OUT_MEASUREMENT LSUCD_dcycRippel_mp LSUCD_resRiRippel_mp LSUCD_stRecValEval_mp LSUCD_stTstTrigger_mp LSUCD_stWireDiaChk_mp LSUCD_stWireDiaErr_mp LSUCD_uO2FltRippel_mp LSUCD_uO2Grad_mp LSUCD_uO2Rippel_mp /end OUT_MEASUREMENT
/end FUNCTION
/begin FUNCTION lsucd_wiredia_100ms ""
 /begin DEF_CHARACTERISTIC LSUCD_tiOpnLdTstActv_C LSUCD_tiRiMeasDisa_C LSUCD_uO2OpnLdNernstMax_C LSUCD_uO2OpnLdNernstMin_C LSUCD_uO2OpnLdVirtGndMax_C LSUCD_uO2OpnLdVirtGndMin_C LSUCD_uRiOpnLdTstMax_C LSUCD_tiDebNoLdErrIPDef_C LSUCD_tiDebNoLdErrIPOk_C LSUCD_DebOpnLdVirtGndDef_C LSUCD_DebOpnLdVirtGndOk_C LSUCD_DebOpnLdNernstDef_C LSUCD_DebOpnLdNernstOk_C LSUCD_tiDebLowBattErrDef_C LSUCD_tiDebLowBattErrOk_C LSUCD_tiDebCircNernstDef_C LSUCD_tiDebCircNernstOk_C LSUCD_tiDebCircPumpDef_C LSUCD_tiDebCircPumpOk_C LSUCD_tiDebCircVirtGndDef_C LSUCD_tiDebCircVirtGndOk_C /end DEF_CHARACTERISTIC
/end FUNCTION
/begin FUNCTION lsucd_wiredia_100ms_msg "" /begin OUT_MEASUREMENT LSUCD_stOpnErrIP LSUCD_stOpnLdTstActv /end OUT_MEASUREMENT /end FUNCTION
/begin FUNCTION lsucd_wiredia_msg ""
 /begin OUT_MEASUREMENT LSUCD_ctHtCoup LSUCD_dcycHtCoupStep1 LSUCD_dcycHtCoupStep2 LSUCD_dcycHtCoupStep3 LSUCD_dHtCoupStep LSUCD_dHtCoupStepLast LSUCD_resRiHtCoupStep1 LSUCD_resRiHtCoupStep2 LSUCD_resRiHtCoupStep3 LSUCD_stDiaIAEna LSUCD_stHtCoupActv LSUCD_stInitClb LSUCD_stIsolChkActv LSUCD_stIsolChkO2Last LSUCD_stIsolChkStrt LSUCD_stPumpEna LSUCD_uO2HtCoupStep1 LSUCD_uO2HtCoupStep2 LSUCD_uO2HtCoupStep3 /end OUT_MEASUREMENT
/end FUNCTION
/begin FUNCTION lsucd_wiredia_uic "" /end FUNCTION
/begin COMPU_METHOD AirMassPerTime "Luftmasse pro Zeit" RAT_FUNC "%6.3" "Kg/h" COEFFS 0 10 0 0 0 1 /end COMPU_METHOD
/begin COMPU_METHOD AirMass_2 "Luftmasse (geringere Auflösung)" RAT_FUNC "%6.3" "g" COEFFS 0 10 0 0 0 1 /end COMPU_METHOD
/begin COMPU_METHOD Curr "Strom" RAT_FUNC "%6.2" "mA" COEFFS 0 1 0 0 0 1 /end COMPU_METHOD
/begin COMPU_METHOD CurRefPump "Applizierbarer Pumpreferenzstrom" TAB_VERB "%6.3" "-" COMPU_TAB_REF CurRefPump /end COMPU_METHOD
/begin COMPU_VTAB CurRefPump "Applizierbarer Pumpreferenzstrom" TAB_VERB 16 0 "0 uA" 1 "10 uA" 2 "20 uA" 3 "30 uA" 4 "40 uA" 5 "50 uA" 6 "60 uA" 7 "70 uA" 8 "80 uA" 9 "90 uA" 10 "100 uA" 11 "110 uA" 12 "120 uA" 13 "130 uA" 14 "140 uA" 15 "150 uA" /end COMPU_VTAB
/begin COMPU_METHOD DEZ "K3 Umwandlungen" RAT_FUNC "%6.2" "-" COEFFS 0 1 0 0 0 1 /end COMPU_METHOD
/begin COMPU_METHOD dn_dZfine "Engine acceleration per time (dn/dt) fine resolution" RAT_FUNC "%6.2" "rpm/s" COEFFS 0 1 0 0 0 1 /end COMPU_METHOD
/begin COMPU_METHOD DtyCyc "Tastverhaeltnis" RAT_FUNC "%6.4" "%" COEFFS 0 100 0 0 0 1 /end COMPU_METHOD
/begin COMPU_METHOD EngN "Motordrehzahl" RAT_FUNC "%6.2" "rpm" COEFFS 0 1 0 0 0 1 /end COMPU_METHOD
/begin COMPU_METHOD EngN_HiRes "Motordrehzahl, höhere Auflösung als EngM" RAT_FUNC "%6.3" "rpm" COEFFS 0 8 0 0 0 1 /end COMPU_METHOD
/begin COMPU_METHOD Fact "Faktor mit Auflösung 1 / 8192, hauptsächlich für einen Faktorenbereich 0...1 verwendet" RAT_FUNC "%6.5" "-" COEFFS 0 8192 0 0 0 1 /end COMPU_METHOD
/begin COMPU_METHOD Fact1 "Faktor mit Auflösung 0,01 (100 mal höherer Bereich als Fact)" RAT_FUNC "%6.4" "-" COEFFS 0 128 0 0 0 1 /end COMPU_METHOD
/begin COMPU_METHOD fak_q0p5 "K3 Umwandlungen" RAT_FUNC "%6.3" "-" COEFFS 0 1 0 0 0 0.5 /end COMPU_METHOD
/begin COMPU_METHOD igen_ub_q1 "K3 Umwandlungen" RAT_FUNC "%6.2" "-" COEFFS 0 1 0 0 0 1 /end COMPU_METHOD
/begin COMPU_METHOD InjMassInj "Einspritzmenge pro Einspritzung (mg/Einspritzung)" RAT_FUNC "%6.4" "mg/inj" COEFFS 0 100 0 0 0 1 /end COMPU_METHOD
/begin COMPU_METHOD InjTime_us "Zeit in Microsekunden für das Einspritztiming" RAT_FUNC "%6.2" "us" COEFFS 0 1 0 0 0 1 /end COMPU_METHOD
/begin COMPU_METHOD Kd_rpm2Nm "Differentialverstärkung Kd (Motordrehzahl EngN zu Motormoment Trq)" RAT_FUNC "%8.7" "Nm/rpm" COEFFS 0 655360 0 0 0 1 /end COMPU_METHOD
/begin COMPU_METHOD Ki "Integrale Verstärkung Ki (gleiche Einheit/Umrechnungsregel an Ein- und Ausgang)" RAT_FUNC "%6.5" "1/s" COEFFS 0 4294.967296 0 0 0 1 /end COMPU_METHOD
/begin COMPU_METHOD Ki_rpm2Nm "Integralverstärkung Ki (Motordrehzahl EngN zu Motormoment Trq)" RAT_FUNC "%6.5" "Nm/(rpm*s)" COEFFS 0 5368.70912 0 0 0 1 /end COMPU_METHOD
/begin COMPU_METHOD Ki_us2mA "Umrechnung für PI-(Ent)ladezeitregler" RAT_FUNC "%6.4" "mA/(us*s)" COEFFS 0 429.4967296 0 0 0 1 /end COMPU_METHOD
/begin COMPU_METHOD km_sw_q10 "K3 Umwandlungen" RAT_FUNC "%6.1" "-" COEFFS 0 0.1 0 0 0 1 /end COMPU_METHOD
/begin COMPU_METHOD Kp "proportionale Verstärkung Kp (gleiche Einheit/Umrechnungsregel an Ein- und Ausgang)" RAT_FUNC "%7.6" "1/1" COEFFS 0 65536 0 0 0 1 /end COMPU_METHOD
/begin COMPU_METHOD Kp_rpm2Nm "Proportionale Verstärkung Kp (Motordrehzahl EngN zu Moment Trq)" RAT_FUNC "%7.6" "Nm/rpm" COEFFS 0 81920 0 0 0 1 /end COMPU_METHOD
/begin COMPU_METHOD Kp_us2mA "Umrechnung für PI-(Ent)ladezeitregler" RAT_FUNC "%6.5" "mA/us" COEFFS 0 6553.6 0 0 0 1 /end COMPU_METHOD
/begin COMPU_METHOD nmot_uw_q0p25 "K3 Umwandlungen" RAT_FUNC "%6.3" "1/min" COEFFS 0 1 0 0 0 0.25 /end COMPU_METHOD
/begin COMPU_METHOD NumPinDia "Verbale Umrechnung für Diagnose Signale" TAB_VERB "%6.3" "-" COMPU_TAB_REF NumPinDia /end COMPU_METHOD
/begin COMPU_VTAB NumPinDia "Verbale Umrechnung für Diagnose Signale" TAB_VERB 35 0 "CJ945_Diagnostic_Signal" 1 "AC_Compressor_DiaSig" 2 "Fuel_Pump_DiaSig" 3 "Starter_234" 4 "Oil_Pressure_Lamp_Switch_245" 5 "Engine_Bay_Air_Flaps_123" 6 "Glow_Relay_Diagnostic_Signal1" 7 "reserved Glow_Relay_Diagnostic_Signal2" 8 "Ebox_Fan_Actuator_Diagnostic_Signal_219" 9 "Shuttr_Actuator_Diagnostic_Signal_231" 10 "Twostage_TurboLoading_SW_DiaSig" 11 "DIO_OUT_DIAGNOSTIC_DUMMY_NOT_USED" 12 "1st_Pressure_Control_Valve_Diagnostic_Signal_172" 13 "2nd_Pressure_Control_Valve_Diagnostic_Signal_172" 14 "1st_Metering_Unit_Diagnostic_Signal_171" 15 "2nd_Metering_Unit_Diagnostic_Signal_171" 16 "Boost_Pressure_Actuator_Diagnostic_Signal_193" 17 "Boost_Pressure_Actuator_Diagnostic_Signal_193_2" 18 "EGR_Actuator_Diagnostic_Signal_194" 19 "EGR_Actuator_Diagnostic_Signal2" 20 "Variable_Swirl_Actuator_Diagnostic_Signal_195" 21 "Throttle_Valve_Diagnostic_Signal_196" 22 "Throttle_Valve2_Diagnostic_Signal_196" 23 "FAN_240" 24 "Add_On_Heater_244" 25 "EngM_Bearing_Actuator_Diagnostic_Signal_124" 26 "EngM_Bearing_Actuator_Diagnostic_Signal_121" 27 "Low pressure stage BPA_Diagnostic_Signal_117" 28 "PWM_DIAGNOSTIC_DUMMY_NOT_USED" 29 "1st_Sensor_Supply_Voltage_DiaSig" 30 "2nd_Sensor_Supply_Voltage_DiaSig" 31 "3rd_Sensor_Supply_Voltage_DiaSig" 32 "4th_Sensor_Supply_Voltage_DiaSig" 33 "5th_Sensor_Supply_Voltage_DiaSig" 34 "6th_Sensor_Supply_Voltage_DiaSig" /end COMPU_VTAB
/begin COMPU_METHOD NumPinPwmOut "Verbale Umrechnung für PWM-Ausgang Signale" TAB_VERB "%6.3" "-" COMPU_TAB_REF NumPinPwmOut /end COMPU_METHOD
/begin COMPU_VTAB NumPinPwmOut "Verbale Umrechnung für PWM-Ausgang Signale" TAB_VERB 13 0 "Boost_Pressure_Actuator_193" 1 "EGR_Actuator_194" 2 "PCV_Actuator_172" 3 "MeUn_Actuator_171" 4 "Variable_Swirl_Actuator_195" 5 "Fan_Actuator_240" 6 "Add_On_Heater_244" 7 "EngM_Bearing_Actuator_124" 8 "EngM_Bearing_Actuator_121" 9 "Throttle Valve" 10 "LSU_Heater_PWMOutput" 11 "Low pressure stage BPA_117" 12 "PWM_DUMMY_NOT_USED" /end COMPU_VTAB
/begin COMPU_METHOD O2 "Sauerstoffkonzentration" RAT_FUNC "%8.7" "-" COEFFS 0 100000 0 0 0 1 /end COMPU_METHOD
/begin COMPU_METHOD OneToOne "eins zu eins (physikalischer Wert ist gleich dem internen Wert)" RAT_FUNC "%6.2" "-" COEFFS 0 1 0 0 0 1 /end COMPU_METHOD
/begin COMPU_METHOD PCENT "K3 Umwandlungen" RAT_FUNC "%6.3" "%" COEFFS 0 256 0 0 0 100 /end COMPU_METHOD
/begin COMPU_METHOD Period "Periodendauer" RAT_FUNC "%6.3" "ms" COEFFS 0 10 0 0 0 1 /end COMPU_METHOD
/begin COMPU_METHOD Prc "Prozent, gleiche interne Auflösung wie Fact, aber Darstellung in Prozent (0...100%)" RAT_FUNC "%6.4" "%" COEFFS 0 81.92 0 0 0 1 /end COMPU_METHOD
/begin COMPU_METHOD Pres_hPa "Druck (angezeigt in [hPa])" RAT_FUNC "%6.2" "hPa" COEFFS 0 1 0 0 0 1 /end COMPU_METHOD
/begin COMPU_METHOD Pres_Rail "Raildruck in hPa" RAT_FUNC "%4.3" "bar" COEFFS 0 10.000000 0 0 0 1 /end COMPU_METHOD
/begin COMPU_METHOD Pwr "Leistung" RAT_FUNC "%6.2" "W" COEFFS 0 0.10610329539459 0 0 0 1 /end COMPU_METHOD
/begin COMPU_METHOD Pwr_kW "Leistung in kW" RAT_FUNC "%6.4" "kW" COEFFS 0 100 0 0 0 1 /end COMPU_METHOD
/begin COMPU_METHOD QntR "Normierungsverhältnis Einspritzmenge / Normierungsmenge" RAT_FUNC "%6.5" "-" COEFFS 0 1024 0 0 0 1 /end COMPU_METHOD
/begin COMPU_METHOD rel_ub_q1 "K3 Umwandlungen" RAT_FUNC "%6.2" "%" COEFFS 0 1 0 0 0 1 /end COMPU_METHOD
/begin COMPU_METHOD Resist "Widerstand" RAT_FUNC "%6.3" "Ohm" COEFFS 0 10 0 0 0 1 /end COMPU_METHOD
/begin COMPU_METHOD Res_kOhm "Auflösung für Widerstände im Kilo-Ohm Bereich" RAT_FUNC "%6.3" "kOhm" COEFFS 0 10 0 0 0 1 /end COMPU_METHOD
/begin COMPU_METHOD RmpEngN "Rampengradient für Motordrehzahl" RAT_FUNC "%6.4" "rpm/s" COEFFS 0 65.536 0 0 0 1 /end COMPU_METHOD
/begin COMPU_METHOD SlopeRes10000 "Umrechnung für Slope: Slopewert mit Verhältnis 0,0001" RAT_FUNC "%7.6" "-" COEFFS 0 10000 0 0 0 1 /end COMPU_METHOD
/begin COMPU_METHOD spg_uw_q0p015 "K3 Umwandlungen" RAT_FUNC "%9.5" "V" COEFFS 0 1 0 0 0 0.015 /end COMPU_METHOD
/begin COMPU_METHOD Temp_Cels "Temperatur dargestellt in °C (gleiche interne Darstellung wie Temp_Kelv)" RAT_FUNC "%6.1" "deg C" COEFFS 0 10 2731.4 0 0 1 /end COMPU_METHOD
/begin COMPU_METHOD temp_q1 "K3 Umwandlungen" RAT_FUNC "%6.2" "Grad C" COEFFS 0 1 0 0 0 1 /end COMPU_METHOD
/begin COMPU_METHOD temp_ub_q5_o50 "K3 Umwandlungen" RAT_FUNC "%6.2" "Grad C" COEFFS 0 1 50 0 0 5 /end COMPU_METHOD
/begin COMPU_METHOD TimeDelay_s "Zeitkonstante T1 (in s) für PT1, DT1, etc." RAT_FUNC "%9.3" "s" COEFFS 0 0 1 0 0.00023283064365387 0 /end COMPU_METHOD
/begin COMPU_METHOD TimeDelay_s_Lin_16 "Zeitkonstante T1 (in s) für PT1, DT1, etc. für SINT16, kein Kehrwert" RAT_FUNC "%6.5" "s" COEFFS 0 6553.4 0 0 0 1 /end COMPU_METHOD
/begin COMPU_METHOD Time_Busy "Lade-/Entladezeit der Piezosteller (us)" RAT_FUNC "%6.3" "us" COEFFS 0 10 0 0 0 1 /end COMPU_METHOD
/begin COMPU_METHOD Time_ms "Zeit in ms für Fehlerentprellung (DSM) und SW-Timer" RAT_FUNC "%6.1" "ms" COEFFS 0 0.1 0 0 0 1 /end COMPU_METHOD
/begin COMPU_METHOD Time_s "Zeit in s für Fehlerentprellung (DSM) und SW-Timer" RAT_FUNC "%6.4" "s" COEFFS 0 100 0 0 0 1 /end COMPU_METHOD
/begin COMPU_METHOD Trq "Motormoment" RAT_FUNC "%6.3" "Nm" COEFFS 0 10 0 0 0 1 /end COMPU_METHOD
/begin COMPU_METHOD Trq32 "Umrechungsformel für inneres Moment in 32bit Zahlendarstellung" RAT_FUNC "%8.7" "Nm" COEFFS 0 655360 0 0 0 1 /end COMPU_METHOD
/begin COMPU_METHOD Vel "Fahrzeuggeschwindigkeit, gleiche interne Auflösung wie Vel_SI" RAT_FUNC "%6.4" "km/h" COEFFS 0 100 0 0 0 1 /end COMPU_METHOD
/begin COMPU_METHOD vfzg_ub_q1p25 "K3 Umwandlungen" RAT_FUNC "%6.2" "km/h" COEFFS 0 1 0 0 0 1.25 /end COMPU_METHOD
/begin COMPU_METHOD Volt "Spannung in V (von ADC)" RAT_FUNC "%6.2" "mV" COEFFS 0 0.2046 0 0 0 1 /end COMPU_METHOD
/begin COMPU_METHOD VoltToRes "Umrechnung für Faktor Spannung zu Widerstand" RAT_FUNC "%7.6" "Ohm/mV" COEFFS 0 50830.889540567 0 0 0 1 /end COMPU_METHOD
/begin COMPU_METHOD Volt_Batt "Batteriespannung" RAT_FUNC "%6.1" "mV" COEFFS 0 0.05115 0 0 0 1 /end COMPU_METHOD
/begin COMPU_METHOD Volt_PA "Spannung des Piezo-Aktors" RAT_FUNC "%6.4" "V" COEFFS 0 100 0 0 0 1 /end COMPU_METHOD
/begin COMPU_METHOD defaultAscii "" RAT_FUNC "%6.2" "-" COEFFS 0 1 0 0 0 1 /end COMPU_METHOD
/begin RECORD_LAYOUT Kf_Xs16_Ys16_Ws16 NO_AXIS_PTS_X 1 SWORD NO_AXIS_PTS_Y 2 SWORD AXIS_PTS_X 3 SWORD INDEX_INCR DIRECT AXIS_PTS_Y 4 SWORD INDEX_INCR DIRECT FNC_VALUES 5 SWORD COLUMN_DIR DIRECT /end RECORD_LAYOUT
/begin RECORD_LAYOUT Kl_Xs16_Ws16 NO_AXIS_PTS_X 1 SWORD AXIS_PTS_X 2 SWORD INDEX_INCR DIRECT FNC_VALUES 3 SWORD COLUMN_DIR DIRECT /end RECORD_LAYOUT
/begin RECORD_LAYOUT Kwb_Ws16 FNC_VALUES 1 SWORD COLUMN_DIR DIRECT /end RECORD_LAYOUT
/begin RECORD_LAYOUT Kwb_Wu8 FNC_VALUES 1 UBYTE COLUMN_DIR DIRECT /end RECORD_LAYOUT
/begin RECORD_LAYOUT Kw_Ws16 FNC_VALUES 1 SWORD COLUMN_DIR DIRECT /end RECORD_LAYOUT
/begin RECORD_LAYOUT Kw_Ws32 FNC_VALUES 1 SLONG COLUMN_DIR DIRECT /end RECORD_LAYOUT
/begin RECORD_LAYOUT Kw_Ws8 FNC_VALUES 1 SBYTE COLUMN_DIR DIRECT /end RECORD_LAYOUT
/begin RECORD_LAYOUT Kw_Wu16 FNC_VALUES 1 UWORD COLUMN_DIR DIRECT /end RECORD_LAYOUT
/begin RECORD_LAYOUT Kw_Wu32 FNC_VALUES 1 ULONG COLUMN_DIR DIRECT /end RECORD_LAYOUT
/begin RECORD_LAYOUT Kw_Wu8 FNC_VALUES 1 UBYTE COLUMN_DIR DIRECT /end RECORD_LAYOUT
/end MODULE
/end PROJECT
