ASAP2_VERSION 1 41
/begin PROJECT MSD85 "Spray Guided DI-System with Piezo Injectors for 8-Cylinder"
/begin HEADER "_default_HeaderComment" PROJECT_NO _91 /end HEADER
/begin MODULE _default_ModuleName "_default_ModuleLongIdentifier"
/begin MOD_COMMON "_default_ModCommonComment" DEPOSIT ABSOLUTE BYTE_ORDER MSB_LAST ALIGNMENT_BYTE 1 ALIGNMENT_WORD 2 ALIGNMENT_LONG 2 ALIGNMENT_FLOAT32_IEEE 2 ALIGNMENT_FLOAT64_IEEE 4 /end MOD_COMMON
/begin MEASUREMENT lv_at_mon "automatic transmission recognized" UBYTE _CNV_S_2_RANGE__0___1_CM 1 100. 0. 1. DISPLAY_IDENTIFIER LV_AT_MON ECU_ADDRESS 0xd0007414 /end MEASUREMENT
/begin MEASUREMENT lv_var_amt_mon "SSG-transmission recognized" UBYTE _CNV_S_2_RANGE__0___1_CM 1 100. 0. 1. DISPLAY_IDENTIFIER LV_VAR_AMT_MON ECU_ADDRESS 0xd000745e /end MEASUREMENT
/begin MEASUREMENT envd_0_conv_mon "Environmental data 0 for general monitoring error" UBYTE _CNV_A_R_LINEAR_____0_CM 1 100. 0. 255. DISPLAY_IDENTIFIER ENVD_0_CONV_MON ECU_ADDRESS 0xd00073d2 FORMAT "%3.0" /end MEASUREMENT
/begin MEASUREMENT envd_1_conv_mon "Environmental data 0 for general monitoring error" UBYTE _CNV_A_R_LINEAR_____0_CM 1 100. 0. 255. DISPLAY_IDENTIFIER ENVD_1_CONV_MON ECU_ADDRESS 0xd00073db FORMAT "%3.0" /end MEASUREMENT
/begin MEASUREMENT envd_2_conv_mon "Environmental data 0 for general monitoring error" UBYTE _CNV_A_R_LINEAR_____0_CM 1 100. 0. 255. DISPLAY_IDENTIFIER ENVD_2_CONV_MON ECU_ADDRESS 0xd00073e4 FORMAT "%3.0" /end MEASUREMENT
/begin MEASUREMENT envd_3_conv_mon "Environmental data 0 for general monitoring error" UBYTE _CNV_A_R_LINEAR_____0_CM 1 100. 0. 255. DISPLAY_IDENTIFIER ENVD_3_CONV_MON ECU_ADDRESS 0xd00073ed FORMAT "%3.0" /end MEASUREMENT
/begin MEASUREMENT envd_0_n_32_mon "Environmental data 0 for general monitoring error" UBYTE _CNV_A_R_LINEAR_____0_CM 1 100. 0. 255. DISPLAY_IDENTIFIER ENVD_0_N_32_MON ECU_ADDRESS 0xd00073d5 FORMAT "%3.0" /end MEASUREMENT
/begin MEASUREMENT envd_1_n_32_mon "Environmental data 0 for general monitoring error" UBYTE _CNV_A_R_LINEAR_____0_CM 1 100. 0. 255. DISPLAY_IDENTIFIER ENVD_1_N_32_MON ECU_ADDRESS 0xd00073de FORMAT "%3.0" /end MEASUREMENT
/begin MEASUREMENT envd_2_n_32_mon "Environmental data 0 for general monitoring error" UBYTE _CNV_A_R_LINEAR_____0_CM 1 100. 0. 255. DISPLAY_IDENTIFIER ENVD_2_N_32_MON ECU_ADDRESS 0xd00073e7 FORMAT "%3.0" /end MEASUREMENT
/begin MEASUREMENT envd_3_n_32_mon "Environmental data 0 for general monitoring error" UBYTE _CNV_A_R_LINEAR_____0_CM 1 100. 0. 255. DISPLAY_IDENTIFIER ENVD_3_N_32_MON ECU_ADDRESS 0xd00073f0 FORMAT "%3.0" /end MEASUREMENT
/begin MEASUREMENT envd_3_pvs_mon "Environmental data 0 for general monitoring error" UBYTE _CNV_A_R_LINEAR_____0_CM 1 100. 0. 255. DISPLAY_IDENTIFIER ENVD_3_PVS_MON ECU_ADDRESS 0xd00073f1 FORMAT "%3.0" /end MEASUREMENT
/begin MEASUREMENT envd_2_pvs_mon "Environmental data 0 for general monitoring error" UBYTE _CNV_A_R_LINEAR_____0_CM 1 100. 0. 255. DISPLAY_IDENTIFIER ENVD_2_PVS_MON ECU_ADDRESS 0xd00073e8 FORMAT "%3.0" /end MEASUREMENT
/begin MEASUREMENT envd_1_pvs_mon "Environmental data 0 for general monitoring error" UBYTE _CNV_A_R_LINEAR_____0_CM 1 100. 0. 255. DISPLAY_IDENTIFIER ENVD_1_PVS_MON ECU_ADDRESS 0xd00073df FORMAT "%3.0" /end MEASUREMENT
/begin MEASUREMENT envd_0_pvs_mon "Environmental data 0 for general monitoring error" UBYTE _CNV_A_R_LINEAR_____0_CM 1 100. 0. 255. DISPLAY_IDENTIFIER ENVD_0_PVS_MON ECU_ADDRESS 0xd00073d6 FORMAT "%3.0" /end MEASUREMENT
/begin MEASUREMENT envd_0_cru_inh_mon "Environmental data 0 for general monitoring error" UBYTE _CNV_A_R_LINEAR_____0_CM 1 100. 0. 255. DISPLAY_IDENTIFIER ENVD_0_CRU_INH_MON ECU_ADDRESS 0xd00073d3 FORMAT "%3.0" /end MEASUREMENT
/begin MEASUREMENT envd_1_cru_inh_mon "Environmental data 0 for general monitoring error" UBYTE _CNV_A_R_LINEAR_____0_CM 1 100. 0. 255. DISPLAY_IDENTIFIER ENVD_1_CRU_INH_MON ECU_ADDRESS 0xd00073dc FORMAT "%3.0" /end MEASUREMENT
/begin MEASUREMENT envd_2_cru_inh_mon "Environmental data 0 for general monitoring error" UBYTE _CNV_A_R_LINEAR_____0_CM 1 100. 0. 255. DISPLAY_IDENTIFIER ENVD_2_CRU_INH_MON ECU_ADDRESS 0xd00073e5 FORMAT "%3.0" /end MEASUREMENT
/begin MEASUREMENT envd_3_cru_inh_mon "Environmental data 0 for general monitoring error" UBYTE _CNV_A_R_LINEAR_____0_CM 1 100. 0. 255. DISPLAY_IDENTIFIER ENVD_3_CRU_INH_MON ECU_ADDRESS 0xd00073ee FORMAT "%3.0" /end MEASUREMENT
/begin MEASUREMENT envd_3_tqi_av_mon "Environmental data 0 for general monitoring error" UBYTE _CNV_A_R_LINEAR_____0_CM 1 100. 0. 255. DISPLAY_IDENTIFIER ENVD_3_TQI_AV_MON ECU_ADDRESS 0xd00073f5 FORMAT "%3.0" /end MEASUREMENT
/begin MEASUREMENT envd_2_tqi_av_mon "Environmental data 0 for general monitoring error" UBYTE _CNV_A_R_LINEAR_____0_CM 1 100. 0. 255. DISPLAY_IDENTIFIER ENVD_2_TQI_AV_MON ECU_ADDRESS 0xd00073ec FORMAT "%3.0" /end MEASUREMENT
/begin MEASUREMENT envd_1_tqi_av_mon "Environmental data 0 for general monitoring error" UBYTE _CNV_A_R_LINEAR_____0_CM 1 100. 0. 255. DISPLAY_IDENTIFIER ENVD_1_TQI_AV_MON ECU_ADDRESS 0xd00073e3 FORMAT "%3.0" /end MEASUREMENT
/begin MEASUREMENT envd_0_tqi_av_mon "Environmental data 0 for general monitoring error" UBYTE _CNV_A_R_LINEAR_____0_CM 1 100. 0. 255. DISPLAY_IDENTIFIER ENVD_0_TQI_AV_MON ECU_ADDRESS 0xd00073da FORMAT "%3.0" /end MEASUREMENT
/begin MEASUREMENT envd_0_mff_mon "Environmental data 0 for general monitoring error" UBYTE _CNV_A_R_LINEAR_____0_CM 1 100. 0. 255. DISPLAY_IDENTIFIER ENVD_0_MFF_MON ECU_ADDRESS 0xd00073d4 FORMAT "%3.0" /end MEASUREMENT
/begin MEASUREMENT envd_1_mff_mon "Environmental data 0 for general monitoring error" UBYTE _CNV_A_R_LINEAR_____0_CM 1 100. 0. 255. DISPLAY_IDENTIFIER ENVD_1_MFF_MON ECU_ADDRESS 0xd00073dd FORMAT "%3.0" /end MEASUREMENT
/begin MEASUREMENT envd_2_mff_mon "Environmental data 0 for general monitoring error" UBYTE _CNV_A_R_LINEAR_____0_CM 1 100. 0. 255. DISPLAY_IDENTIFIER ENVD_2_MFF_MON ECU_ADDRESS 0xd00073e6 FORMAT "%3.0" /end MEASUREMENT
/begin MEASUREMENT envd_3_mff_mon "Environmental data 0 for general monitoring error" UBYTE _CNV_A_R_LINEAR_____0_CM 1 100. 0. 255. DISPLAY_IDENTIFIER ENVD_3_MFF_MON ECU_ADDRESS 0xd00073ef FORMAT "%3.0" /end MEASUREMENT
/begin MEASUREMENT envd_3_tq_dif_isc_mon "Environmental data 0 for general monitoring error" UBYTE _CNV_A_R_LINEAR_____0_CM 1 100. 0. 255. DISPLAY_IDENTIFIER ENVD_3_TQ_DIF_ISC_MON ECU_ADDRESS 0xd00073f2 FORMAT "%3.0" /end MEASUREMENT
/begin MEASUREMENT envd_2_tq_dif_isc_mon "Environmental data 0 for general monitoring error" UBYTE _CNV_A_R_LINEAR_____0_CM 1 100. 0. 255. DISPLAY_IDENTIFIER ENVD_2_TQ_DIF_ISC_MON ECU_ADDRESS 0xd00073e9 FORMAT "%3.0" /end MEASUREMENT
/begin MEASUREMENT envd_1_tq_dif_isc_mon "Environmental data 0 for general monitoring error" UBYTE _CNV_A_R_LINEAR_____0_CM 1 100. 0. 255. DISPLAY_IDENTIFIER ENVD_1_TQ_DIF_ISC_MON ECU_ADDRESS 0xd00073e0 FORMAT "%3.0" /end MEASUREMENT
/begin MEASUREMENT envd_0_tq_dif_isc_mon "Environmental data 0 for general monitoring error" UBYTE _CNV_A_R_LINEAR_____0_CM 1 100. 0. 255. DISPLAY_IDENTIFIER ENVD_0_TQ_DIF_ISC_MON ECU_ADDRESS 0xd00073d7 FORMAT "%3.0" /end MEASUREMENT
/begin MEASUREMENT envd_0_tq_req_mon "Environmental data 0 for general monitoring error" UBYTE _CNV_A_R_LINEAR_____0_CM 1 100. 0. 255. DISPLAY_IDENTIFIER ENVD_0_TQ_REQ_MON ECU_ADDRESS 0xd00073d9 FORMAT "%3.0" /end MEASUREMENT
/begin MEASUREMENT envd_1_tq_req_mon "Environmental data 0 for general monitoring error" UBYTE _CNV_A_R_LINEAR_____0_CM 1 100. 0. 255. DISPLAY_IDENTIFIER ENVD_1_TQ_REQ_MON ECU_ADDRESS 0xd00073e2 FORMAT "%3.0" /end MEASUREMENT
/begin MEASUREMENT envd_2_tq_req_mon "Environmental data 0 for general monitoring error" UBYTE _CNV_A_R_LINEAR_____0_CM 1 100. 0. 255. DISPLAY_IDENTIFIER ENVD_2_TQ_REQ_MON ECU_ADDRESS 0xd00073eb FORMAT "%3.0" /end MEASUREMENT
/begin MEASUREMENT envd_3_tq_req_mon "Environmental data 0 for general monitoring error" UBYTE _CNV_A_R_LINEAR_____0_CM 1 100. 0. 255. DISPLAY_IDENTIFIER ENVD_3_TQ_REQ_MON ECU_ADDRESS 0xd00073f4 FORMAT "%3.0" /end MEASUREMENT
/begin MEASUREMENT envd_3_tq_ext_mon "Environmental data 0 for general monitoring error" UBYTE _CNV_A_R_LINEAR_____0_CM 1 100. 0. 255. DISPLAY_IDENTIFIER ENVD_3_TQ_EXT_MON ECU_ADDRESS 0xd00073f3 FORMAT "%3.0" /end MEASUREMENT
/begin MEASUREMENT envd_2_tq_ext_mon "Environmental data 0 for general monitoring error" UBYTE _CNV_A_R_LINEAR_____0_CM 1 100. 0. 255. DISPLAY_IDENTIFIER ENVD_2_TQ_EXT_MON ECU_ADDRESS 0xd00073ea FORMAT "%3.0" /end MEASUREMENT
/begin MEASUREMENT envd_0_tq_ext_mon "Environmental data 0 for general monitoring error" UBYTE _CNV_A_R_LINEAR_____0_CM 1 100. 0. 255. DISPLAY_IDENTIFIER ENVD_0_TQ_EXT_MON ECU_ADDRESS 0xd00073d8 FORMAT "%3.0" /end MEASUREMENT
/begin MEASUREMENT envd_1_tq_ext_mon "Environmental data 0 for general monitoring error" UBYTE _CNV_A_R_LINEAR_____0_CM 1 100. 0. 255. DISPLAY_IDENTIFIER ENVD_1_TQ_EXT_MON ECU_ADDRESS 0xd00073e1 FORMAT "%3.0" /end MEASUREMENT
/begin MEASUREMENT envd_0_tqi_n_max_mon "Environmental data 0 for N_LIM monitoring error (stored in reset resistant memory area)" UBYTE _CNV_A_R_LINEAR_____0_CM 1 100. 0. 255. DISPLAY_IDENTIFIER ENVD_0_TQI_N_MAX_MON ECU_ADDRESS 0xd0005485 FORMAT "%3.0" /end MEASUREMENT
/begin MEASUREMENT envd_2_tqi_n_max_mon "Environmental data 0 for N_LIM monitoring error (stored in reset resistant memory area)" UBYTE _CNV_A_R_LINEAR_____0_CM 1 100. 0. 255. DISPLAY_IDENTIFIER ENVD_2_TQI_N_MAX_MON ECU_ADDRESS 0xd0005487 FORMAT "%3.0" /end MEASUREMENT
/begin MEASUREMENT envd_3_tqi_n_max_mon "Environmental data 0 for N_LIM monitoring error (stored in reset resistant memory area)" UBYTE _CNV_A_R_LINEAR_____0_CM 1 100. 0. 255. DISPLAY_IDENTIFIER ENVD_3_TQI_N_MAX_MON ECU_ADDRESS 0xd0005488 FORMAT "%3.0" /end MEASUREMENT
/begin MEASUREMENT envd_1_tqi_n_max_mon "Environmental data 0 for N_LIM monitoring error (stored in reset resistant memory area)" UBYTE _CNV_A_R_LINEAR_____0_CM 1 100. 0. 255. DISPLAY_IDENTIFIER ENVD_1_TQI_N_MAX_MON ECU_ADDRESS 0xd0005486 FORMAT "%3.0" /end MEASUREMENT
/begin MEASUREMENT lv_err_mff_mon "Logical variable for error in mass fuel flow signal" UBYTE _CNV_S_2_RANGE__0___1_CM 1 100. 0. 1. DISPLAY_IDENTIFIER LV_ERR_MFF_MON ECU_ADDRESS 0xd0007425 BIT_MASK 0x1 /end MEASUREMENT
/begin MEASUREMENT lv_err_plaus_lamb_dif_mon "Present failure for LAMB_DIF plausibility diagnosis" UBYTE _CNV_S_2_RANGE__0___1_CM 1 100. 0. 1. DISPLAY_IDENTIFIER LV_ERR_PLAUS_LAMB_DIF_MON ECU_ADDRESS 0xd0001e41 BIT_MASK 0x1 /end MEASUREMENT
/begin MEASUREMENT lv_swi_afs_mff_mon "Flag for switching to AFS mode" UBYTE _CNV_S_2_RANGE__0___1_CM 1 100. 0. 1. DISPLAY_IDENTIFIER LV_SWI_AFS_MFF_MON ECU_ADDRESS 0xd0007457 BIT_MASK 0x1 /end MEASUREMENT
/begin MEASUREMENT abc_swi_afs_mff_mon "Anti bounce counter for request to AFS" UBYTE _CNV_A_R_LINEAR_____0_CM 1 100. 0. 255. DISPLAY_IDENTIFIER ABC_SWI_AFS_MFF_MON ECU_ADDRESS 0xd0001de0 FORMAT "%3.0" /end MEASUREMENT
/begin MEASUREMENT abc_mff_not_afs_mon "Anti bounce for fault in MFF signal (not AFS mode)" UBYTE _CNV_A_R_LINEAR_____0_CM 1 100. 0. 255. DISPLAY_IDENTIFIER ABC_MFF_NOT_AFS_MON ECU_ADDRESS 0xd0001ddb FORMAT "%3.0" /end MEASUREMENT
/begin CHARACTERISTIC c_abc_inc_mff_not_afs_mon "Anti bounce counter increment in case of MFF error (not AFS-mode)" VALUE 0xa080cc47 _REC_VAL_20_u1 255. _CNV_A_R_LINEAR_____0_CM 0. 255. DISPLAY_IDENTIFIER C_ABC_INC_MFF_NOT_AFS_MON FORMAT "%3.0" /end CHARACTERISTIC
/begin CHARACTERISTIC c_abc_max_mff_not_afs_mon "Value at which MFF error is recognised. when reached (not AFS-mode)" VALUE 0xa080cc62 _REC_VAL_20_u1 254. _CNV_A_R_LINEAR_____0_CM 1. 255. DISPLAY_IDENTIFIER C_ABC_MAX_MFF_NOT_AFS_MON FORMAT "%3.0" /end CHARACTERISTIC
/begin CHARACTERISTIC c_abc_inc_swi_afs_mff_mon "Anti bounce counter increment for request to AFS (MFF error)" VALUE 0xa080cc4d _REC_VAL_20_u1 255. _CNV_A_R_LINEAR_____0_CM 0. 255. DISPLAY_IDENTIFIER C_ABC_INC_SWI_AFS_MFF_MON FORMAT "%3.0" /end CHARACTERISTIC
/begin CHARACTERISTIC c_abc_max_swi_afs_mff_mon "Value at which OPM will be switched to AFS at MFF error" VALUE 0xa080cc68 _REC_VAL_20_u1 254. _CNV_A_R_LINEAR_____0_CM 1. 255. DISPLAY_IDENTIFIER C_ABC_MAX_SWI_AFS_MFF_MON FORMAT "%3.0" /end CHARACTERISTIC
/begin AXIS_PTS ldp_n_32_mon_ip_lamb_dif_mon "" 0xa080c7a0 n_32_mon _REC_AXS_20_u1 8160. _CNV_A_R_LINEAR_____10_CM 4 0. 8160. FORMAT "%4.0" /end AXIS_PTS
/begin AXIS_PTS ldp_tqi_sp_mon_ip_lamb_dif_mon "" 0xa080c89a tqi_sp_mon _REC_AXS_20_u1 510. _CNV_A_R_LINEAR_____262_CM 4 0. 510. FORMAT "%3.0" /end AXIS_PTS
/begin CHARACTERISTIC ip_lamb_dif_thd_mon "map for allowed LAMB_DIF threshold" MAP 0xa080cb08 _REC_MAP_20_u2_u1_u1 31.9990234375 _CNV_A_R_LINEAR_____129_CM 0. 31.9990234375 DISPLAY_IDENTIFIER IP_LAMB_DIF_THD_MON FORMAT "%7.4"
 /begin AXIS_DESCR COM_AXIS n_32_mon _CNV_A_R_LINEAR_____10_CM 4 0. 8160. FORMAT "%4.0" AXIS_PTS_REF ldp_n_32_mon_ip_lamb_dif_mon /end AXIS_DESCR
 /begin AXIS_DESCR COM_AXIS tqi_sp_mon _CNV_A_R_LINEAR_____262_CM 4 0. 510. FORMAT "%3.0" AXIS_PTS_REF ldp_tqi_sp_mon_ip_lamb_dif_mon /end AXIS_DESCR
/end CHARACTERISTIC
/begin MEASUREMENT lv_err_tps_mon "Logical variable for different TPS diagnosis between L1 and L2" UBYTE _CNV_S_2_RANGE__0___1_CM 1 100. 0. 1. DISPLAY_IDENTIFIER LV_ERR_TPS_MON ECU_ADDRESS 0xd000742f BIT_MASK 0x1 /end MEASUREMENT
/begin MEASUREMENT abc_lamb_dif_mon "Anti bounce counter for fault in LAMB_DIF signal" UBYTE _CNV_A_R_LINEAR_____0_CM 1 100. 0. 255. DISPLAY_IDENTIFIER ABC_LAMB_DIF_MON ECU_ADDRESS 0xd0001dd9 FORMAT "%3.0" /end MEASUREMENT
/begin MEASUREMENT abc_tps_ratio_mon "Anti bounce counter TPS ratio diagnosis error" UBYTE _CNV_A_R_LINEAR_____0_CM 1 100. 0. 255. DISPLAY_IDENTIFIER ABC_TPS_RATIO_MON ECU_ADDRESS 0xd0001de3 FORMAT "%3.0" /end MEASUREMENT
/begin MEASUREMENT v_tps_ad_2_mon[0] "Adapted TPS signal channel 2" UBYTE _CNV_A_R_LINEAR_____207_CM 1 100. 0. 4.98046875 DISPLAY_IDENTIFIER V_TPS_AD_2_MON[1] ECU_ADDRESS 0xd0001dca FORMAT "%4.2" /end MEASUREMENT
/begin MEASUREMENT v_tps_ad_2_mon[1] "Adapted TPS signal channel 2" UBYTE _CNV_A_R_LINEAR_____207_CM 1 100. 0. 4.98046875 DISPLAY_IDENTIFIER V_TPS_AD_2_MON[2] ECU_ADDRESS 0xd0001dcb FORMAT "%4.2" /end MEASUREMENT
/begin MEASUREMENT v_tps_ad_1_mon[0] "Adapted TPS signal channel 1" UBYTE _CNV_A_R_LINEAR_____207_CM 1 100. 0. 4.98046875 DISPLAY_IDENTIFIER V_TPS_AD_1_MON[1] ECU_ADDRESS 0xd0001dc8 FORMAT "%4.2" /end MEASUREMENT
/begin MEASUREMENT v_tps_ad_1_mon[1] "Adapted TPS signal channel 1" UBYTE _CNV_A_R_LINEAR_____207_CM 1 100. 0. 4.98046875 DISPLAY_IDENTIFIER V_TPS_AD_1_MON[2] ECU_ADDRESS 0xd0001dc9 FORMAT "%4.2" /end MEASUREMENT
/begin CHARACTERISTIC c_abc_dec_lamb_dif_mon "Anti bounce counter decrement in case of MFF error" VALUE 0xa080cc3c _REC_VAL_20_u1 255. _CNV_A_R_LINEAR_____0_CM 0. 255. DISPLAY_IDENTIFIER C_ABC_DEC_LAMB_DIF_MON FORMAT "%3.0" /end CHARACTERISTIC
/begin CHARACTERISTIC c_abc_inc_lamb_dif_mon "Anti bounce counter increment in case of MFF error" VALUE 0xa080cc44 _REC_VAL_20_u1 255. _CNV_A_R_LINEAR_____0_CM 0. 255. DISPLAY_IDENTIFIER C_ABC_INC_LAMB_DIF_MON FORMAT "%3.0" /end CHARACTERISTIC
/begin CHARACTERISTIC c_abc_inc_tps_ratio_mon "Anti bounce counter increment (additive value in case of ratio diagnosis error)" VALUE 0xa080cc4f _REC_VAL_20_u1 255. _CNV_A_R_LINEAR_____0_CM 0. 255. DISPLAY_IDENTIFIER C_ABC_INC_TPS_RATIO_MON FORMAT "%3.0" /end CHARACTERISTIC
/begin CHARACTERISTIC c_abc_max_lamb_dif_mon "Value at which MFF error is recognised. when reached" VALUE 0xa080cc5f _REC_VAL_20_u1 254. _CNV_A_R_LINEAR_____0_CM 1. 255. DISPLAY_IDENTIFIER C_ABC_MAX_LAMB_DIF_MON FORMAT "%3.0" /end CHARACTERISTIC
/begin CHARACTERISTIC c_abc_max_tps_ratio_mon "Value at which ratio diagnosis error is recognized. when reached" VALUE 0xa080cc6a _REC_VAL_20_u1 254. _CNV_A_R_LINEAR_____0_CM 1. 255. DISPLAY_IDENTIFIER C_ABC_MAX_TPS_RATIO_MON FORMAT "%3.0" /end CHARACTERISTIC
/begin CHARACTERISTIC c_v_tps_ratio_hys_mon "Maximum TPS ratio error allowed" VALUE 0xa080cd0c _REC_VAL_20_u1 4.98046875 _CNV_A_R_LINEAR_____207_CM 0. 4.98046875 DISPLAY_IDENTIFIER C_V_TPS_RATIO_HYS_MON FORMAT "%4.2" /end CHARACTERISTIC
/begin CHARACTERISTIC c_n_min_tps_diag_mon "Minimum engine speed for diagnosis of TPS ratio error" VALUE 0xa080cca4 _REC_VAL_20_u1 8160. _CNV_A_R_LINEAR_____10_CM 0. 8160. DISPLAY_IDENTIFIER C_N_MIN_TPS_DIAG_MON FORMAT "%4.0" /end CHARACTERISTIC
/begin MEASUREMENT union_instance_kwp_ddli.obd_lam_cor[0] "" UBYTE _CNV_A_R_LINEAR_____851_CM 1 100. -100. 99.21875 DISPLAY_IDENTIFIER OBD_LAM_COR[1] ECU_ADDRESS 0xd0003778 FORMAT "%10.5" /end MEASUREMENT
/begin MEASUREMENT union_instance_kwp_ddli.obd_lam_cor[1] "" UBYTE _CNV_A_R_LINEAR_____851_CM 1 100. -100. 99.21875 DISPLAY_IDENTIFIER OBD_LAM_COR[2] ECU_ADDRESS 0xd0003779 FORMAT "%10.5" /end MEASUREMENT
/begin MEASUREMENT union_instance_kwp_ddli.obd_lam_ad[0] "" UBYTE _CNV_A_R_LINEAR_____851_CM 1 100. -100. 99.21875 DISPLAY_IDENTIFIER OBD_LAM_AD[1] ECU_ADDRESS 0xd0003778 FORMAT "%10.5" /end MEASUREMENT
/begin MEASUREMENT union_instance_kwp_ddli.obd_lam_ad[1] "" UBYTE _CNV_A_R_LINEAR_____851_CM 1 100. -100. 99.21875 DISPLAY_IDENTIFIER OBD_LAM_AD[2] ECU_ADDRESS 0xd0003779 FORMAT "%10.5" /end MEASUREMENT
/begin MEASUREMENT union_instance_kwp_ddli.obd_fup "" UBYTE _CNV_A_R_LINEAR_____852_CM 1 100. 0. 765. DISPLAY_IDENTIFIER OBD_FUP ECU_ADDRESS 0xd0003778 FORMAT "%4.0" /end MEASUREMENT
/begin MEASUREMENT union_instance_kwp_ddli.obd_map "" UBYTE _CNV_A_R_LINEAR_____853_CM 1 100. 0. 255. DISPLAY_IDENTIFIER OBD_MAP ECU_ADDRESS 0xd0003778 FORMAT "%3.0" /end MEASUREMENT
/begin MEASUREMENT union_instance_kwp_ddli.obd_n "" UWORD _CNV_A_R_LINEAR_____170_CM 1 100. 0. 8160. DISPLAY_IDENTIFIER OBD_N ECU_ADDRESS 0xd0003778 FORMAT "%6.1" /end MEASUREMENT
/begin MEASUREMENT union_instance_kwp_ddli.obd_iga_igc "" UBYTE _CNV_A_R_LINEAR_____854_CM 1 100. -64. 63.5 DISPLAY_IDENTIFIER OBD_IGA_IGC ECU_ADDRESS 0xd0003778 FORMAT "%4.0" /end MEASUREMENT
/begin MEASUREMENT union_instance_kwp_ddli.obd_tia "" UBYTE _CNV_A_R_LINEAR_____26_CM 1 100. -40. 215. DISPLAY_IDENTIFIER OBD_TIA ECU_ADDRESS 0xd0003778 FORMAT "%3.0" /end MEASUREMENT
/begin MEASUREMENT union_instance_kwp_ddli.obd_maf "" UWORD _CNV_A_R_LINEAR_____855_CM 1 100. 0. 655.35 DISPLAY_IDENTIFIER OBD_MAF ECU_ADDRESS 0xd0003778 FORMAT "%10.3" /end MEASUREMENT
/begin MEASUREMENT union_instance_kwp_ddli.lamb_delta_i_lam_adj_kwp[0] "" SBYTE _CNV_A_R_LINEAR_____129_CM 1 100. -0.125 0.1240234375 DISPLAY_IDENTIFIER LAMB_DELTA_I_LAM_ADJ_KWP[1] ECU_ADDRESS 0xd0003778 FORMAT "%7.4" /end MEASUREMENT
/begin MEASUREMENT union_instance_kwp_ddli.lamb_delta_i_lam_adj_kwp[1] "" SBYTE _CNV_A_R_LINEAR_____129_CM 1 100. -0.125 0.1240234375 DISPLAY_IDENTIFIER LAMB_DELTA_I_LAM_ADJ_KWP[2] ECU_ADDRESS 0xd0003779 FORMAT "%7.4" /end MEASUREMENT
/begin MEASUREMENT union_instance_kwp_ddli.lamb_kwp[0] "" UBYTE _CNV_A_R_LINEAR_____856_CM 1 100. 0. 0.24902344 DISPLAY_IDENTIFIER LAMB_KWP[1] ECU_ADDRESS 0xd0003778 FORMAT "%10.6" /end MEASUREMENT
/begin MEASUREMENT union_instance_kwp_ddli.lamb_kwp[1] "" UBYTE _CNV_A_R_LINEAR_____856_CM 1 100. 0. 0.24902344 DISPLAY_IDENTIFIER LAMB_KWP[2] ECU_ADDRESS 0xd0003779 FORMAT "%10.6" /end MEASUREMENT
/begin MEASUREMENT union_instance_kwp_ddli.n_max_scdn_mis_32_kwp "" UBYTE _CNV_A_R_LINEAR_____10_CM 1 100. 0. 8160. DISPLAY_IDENTIFIER N_MAX_SCDN_MIS_32_KWP ECU_ADDRESS 0xd0003778 FORMAT "%4.0" /end MEASUREMENT
/begin MEASUREMENT union_instance_kwp_ddli.n_min_scdn_mis_32_kwp "" UBYTE _CNV_A_R_LINEAR_____10_CM 1 100. 0. 8160. DISPLAY_IDENTIFIER N_MIN_SCDN_MIS_32_KWP ECU_ADDRESS 0xd0003778 FORMAT "%4.0" /end MEASUREMENT
/begin MEASUREMENT union_instance_kwp_ddli.r_it_ls_down_kwp_h[0] "" UBYTE _CNV_A_R_LINEAR_____857_CM 1 100. 0. 65280. DISPLAY_IDENTIFIER R_IT_LS_DOWN_KWP_H[1] ECU_ADDRESS 0xd0003778 FORMAT "%9.2" /end MEASUREMENT
/begin MEASUREMENT union_instance_kwp_ddli.r_it_ls_down_kwp_h[1] "" UBYTE _CNV_A_R_LINEAR_____857_CM 1 100. 0. 65280. DISPLAY_IDENTIFIER R_IT_LS_DOWN_KWP_H[2] ECU_ADDRESS 0xd0003779 FORMAT "%9.2" /end MEASUREMENT
/begin MEASUREMENT union_instance_kwp_ddli.r_it_ls_down_kwp_l[0] "" UBYTE _CNV_A_R_LINEAR_____858_CM 1 100. 0. 255. DISPLAY_IDENTIFIER R_IT_LS_DOWN_KWP_L[1] ECU_ADDRESS 0xd0003778 FORMAT "%9.2" /end MEASUREMENT
/begin MEASUREMENT union_instance_kwp_ddli.r_it_ls_down_kwp_l[1] "" UBYTE _CNV_A_R_LINEAR_____858_CM 1 100. 0. 255. DISPLAY_IDENTIFIER R_IT_LS_DOWN_KWP_L[2] ECU_ADDRESS 0xd0003779 FORMAT "%9.2" /end MEASUREMENT
/begin MEASUREMENT union_instance_kwp_ddli.r_it_ls_up_kwp_h[0] "" UBYTE _CNV_A_R_LINEAR_____859_CM 1 100. 0. 16320. DISPLAY_IDENTIFIER R_IT_LS_UP_KWP_H[1] ECU_ADDRESS 0xd0003778 FORMAT "%9.2" /end MEASUREMENT
/begin MEASUREMENT union_instance_kwp_ddli.r_it_ls_up_kwp_h[1] "" UBYTE _CNV_A_R_LINEAR_____859_CM 1 100. 0. 16320. DISPLAY_IDENTIFIER R_IT_LS_UP_KWP_H[2] ECU_ADDRESS 0xd0003779 FORMAT "%9.2" /end MEASUREMENT
/begin MEASUREMENT union_instance_kwp_ddli.r_it_ls_up_kwp_l[0] "" UBYTE _CNV_A_R_LINEAR_____860_CM 1 100. 0. 63.75 DISPLAY_IDENTIFIER R_IT_LS_UP_KWP_L[1] ECU_ADDRESS 0xd0003778 FORMAT "%9.2" /end MEASUREMENT
/begin MEASUREMENT union_instance_kwp_ddli.r_it_ls_up_kwp_l[1] "" UBYTE _CNV_A_R_LINEAR_____860_CM 1 100. 0. 63.75 DISPLAY_IDENTIFIER R_IT_LS_UP_KWP_L[2] ECU_ADDRESS 0xd0003779 FORMAT "%9.2" /end MEASUREMENT
/begin MEASUREMENT union_instance_kwp_ddli.t_es_kwp "" UBYTE _CNV_A_R_LINEAR_____861_CM 1 100. 0. 1020. DISPLAY_IDENTIFIER T_ES_KWP ECU_ADDRESS 0xd0003778 FORMAT "%5.0" /end MEASUREMENT
/begin MEASUREMENT union_instance_kwp_ddli.tps_ad_step_kwp "" UBYTE _CNV_A_R_LINEAR_____0_CM 1 100. 0. 255. DISPLAY_IDENTIFIER TPS_AD_STEP_KWP ECU_ADDRESS 0xd0003778 FORMAT "%3.0" /end MEASUREMENT
/begin MEASUREMENT union_instance_kwp_ddli.v_amp_kwp "" UBYTE _CNV_A_R_LINEAR_____207_CM 1 100. 0. 4.98046875 DISPLAY_IDENTIFIER V_AMP_KWP ECU_ADDRESS 0xd0003778 FORMAT "%4.2" /end MEASUREMENT
/begin MEASUREMENT union_instance_kwp_ddli.v_dmtl_kwp "" UBYTE _CNV_A_R_LINEAR_____207_CM 1 100. 0. 4.98046875 DISPLAY_IDENTIFIER V_DMTL_KWP ECU_ADDRESS 0xd0003778 FORMAT "%4.2" /end MEASUREMENT
/begin MEASUREMENT union_instance_kwp_ddli.vls_down_kwp[0] "" UBYTE _CNV_A_R_LINEAR_____207_CM 1 100. 0. 4.98046875 DISPLAY_IDENTIFIER VLS_DOWN_KWP[1] ECU_ADDRESS 0xd0003778 FORMAT "%4.2" /end MEASUREMENT
/begin MEASUREMENT union_instance_kwp_ddli.vls_down_kwp[1] "" UBYTE _CNV_A_R_LINEAR_____207_CM 1 100. 0. 4.98046875 DISPLAY_IDENTIFIER VLS_DOWN_KWP[2] ECU_ADDRESS 0xd0003779 FORMAT "%4.2" /end MEASUREMENT
/begin MEASUREMENT union_instance_kwp_ddli.vls_up_kwp[0] "" UBYTE _CNV_A_R_LINEAR_____207_CM 1 100. 0. 4.98046875 DISPLAY_IDENTIFIER VLS_UP_KWP[1] ECU_ADDRESS 0xd0003778 FORMAT "%4.2" /end MEASUREMENT
/begin MEASUREMENT union_instance_kwp_ddli.vls_up_kwp[1] "" UBYTE _CNV_A_R_LINEAR_____207_CM 1 100. 0. 4.98046875 DISPLAY_IDENTIFIER VLS_UP_KWP[2] ECU_ADDRESS 0xd0003779 FORMAT "%4.2" /end MEASUREMENT
/begin MEASUREMENT union_instance_kwp_ddli.v_pvs_1_kwp "" UBYTE _CNV_A_R_LINEAR_____207_CM 1 100. 0. 4.98046875 DISPLAY_IDENTIFIER V_PVS_1_KWP ECU_ADDRESS 0xd0003778 FORMAT "%4.2" /end MEASUREMENT
/begin MEASUREMENT union_instance_kwp_ddli.v_pvs_2_kwp "" UBYTE _CNV_A_R_LINEAR_____207_CM 1 100. 0. 4.98046875 DISPLAY_IDENTIFIER V_PVS_2_KWP ECU_ADDRESS 0xd0003778 FORMAT "%4.2" /end MEASUREMENT
/begin MEASUREMENT union_instance_kwp_ddli.v_sof_swi_kwp "" UBYTE _CNV_A_R_LINEAR_____207_CM 1 100. 0. 4.98046875 DISPLAY_IDENTIFIER V_SOF_SWI_KWP ECU_ADDRESS 0xd0003778 FORMAT "%4.2" /end MEASUREMENT
/begin MEASUREMENT union_instance_kwp_ddli.v_tco_2_kwp "" UBYTE _CNV_A_R_LINEAR_____207_CM 1 100. 0. 4.98046875 DISPLAY_IDENTIFIER V_TCO_2_KWP ECU_ADDRESS 0xd0003778 FORMAT "%4.2" /end MEASUREMENT
/begin MEASUREMENT union_instance_kwp_ddli.v_tco_kwp "" UBYTE _CNV_A_R_LINEAR_____207_CM 1 100. 0. 4.98046875 DISPLAY_IDENTIFIER V_TCO_KWP ECU_ADDRESS 0xd0003778 FORMAT "%4.2" /end MEASUREMENT
/begin MEASUREMENT union_instance_kwp_ddli.v_tecu_kwp "" UBYTE _CNV_A_R_LINEAR_____207_CM 1 100. 0. 4.98046875 DISPLAY_IDENTIFIER V_TECU_KWP ECU_ADDRESS 0xd0003778 FORMAT "%4.2" /end MEASUREMENT
/begin MEASUREMENT union_instance_kwp_ddli.v_tps_1_kwp "" UBYTE _CNV_A_R_LINEAR_____207_CM 1 100. 0. 4.98046875 DISPLAY_IDENTIFIER V_TPS_1_KWP ECU_ADDRESS 0xd0003778 FORMAT "%4.2" /end MEASUREMENT
/begin MEASUREMENT union_instance_kwp_ddli.v_tps_2_kwp "" UBYTE _CNV_A_R_LINEAR_____207_CM 1 100. 0. 4.98046875 DISPLAY_IDENTIFIER V_TPS_2_KWP ECU_ADDRESS 0xd0003778 FORMAT "%4.2" /end MEASUREMENT
/begin MEASUREMENT union_instance_kwp_ddli.vb_bas_kwp "" UBYTE _CNV_A_R_LINEAR_____207_CM 1 100. 0. 4.98046875 DISPLAY_IDENTIFIER VB_BAS_KWP ECU_ADDRESS 0xd0003778 FORMAT "%4.2" /end MEASUREMENT
/begin MEASUREMENT union_instance_kwp_ddli.vcc_pvs_1_kwp "" UBYTE _CNV_A_R_LINEAR_____862_CM 1 100. 0. 9.960938000000001 DISPLAY_IDENTIFIER VCC_PVS_1_KWP ECU_ADDRESS 0xd0003778 /end MEASUREMENT
/begin MEASUREMENT union_instance_kwp_ddli.vcc_pvs_2_kwp "" UBYTE _CNV_A_R_LINEAR_____862_CM 1 100. 0. 9.960938000000001 DISPLAY_IDENTIFIER VCC_PVS_2_KWP ECU_ADDRESS 0xd0003778 /end MEASUREMENT
/begin MEASUREMENT union_instance_kwp_ddli.vls_dif_lam_adj_kwp[0] "" SBYTE _CNV_A_R_LINEAR_____863_CM 1 100. -0.625 0.6201100000000001 DISPLAY_IDENTIFIER VLS_DIF_LAM_ADJ_KWP[1] ECU_ADDRESS 0xd0003778 FORMAT "%7.6" /end MEASUREMENT
/begin MEASUREMENT union_instance_kwp_ddli.vls_dif_lam_adj_kwp[1] "" SBYTE _CNV_A_R_LINEAR_____863_CM 1 100. -0.625 0.6201100000000001 DISPLAY_IDENTIFIER VLS_DIF_LAM_ADJ_KWP[2] ECU_ADDRESS 0xd0003779 FORMAT "%7.6" /end MEASUREMENT
/begin MEASUREMENT union_instance_kwp_ddli.vls_ofs_lsl_kwp[0] "" SBYTE _CNV_A_R_LINEAR_____863_CM 1 100. -0.625 0.6201100000000001 DISPLAY_IDENTIFIER VLS_OFS_LSL_KWP[1] ECU_ADDRESS 0xd0003778 FORMAT "%7.6" /end MEASUREMENT
/begin MEASUREMENT union_instance_kwp_ddli.vls_ofs_lsl_kwp[1] "" SBYTE _CNV_A_R_LINEAR_____863_CM 1 100. -0.625 0.6201100000000001 DISPLAY_IDENTIFIER VLS_OFS_LSL_KWP[2] ECU_ADDRESS 0xd0003779 FORMAT "%7.6" /end MEASUREMENT
/begin MEASUREMENT union_instance_kwp_ddli.cur_dmtl_ref_leak_kwp "" UBYTE _CNV_A_R_LINEAR_____864_CM 1 100. 0. 49.80468 DISPLAY_IDENTIFIER CUR_DMTL_REF_LEAK_KWP ECU_ADDRESS 0xd0003778 FORMAT "%7.6" /end MEASUREMENT
/begin MEASUREMENT union_instance_kwp_ddli.cur_dmtl_rough_leak_min_kwp "" UBYTE _CNV_A_R_LINEAR_____864_CM 1 100. 0. 49.80468 DISPLAY_IDENTIFIER CUR_DMTL_ROUGH_LEAK_MIN_KWP ECU_ADDRESS 0xd0003778 FORMAT "%7.6" /end MEASUREMENT
/begin MEASUREMENT union_instance_kwp_ddli.cur_dmtl_cor_fil_kwp "" UBYTE _CNV_A_R_LINEAR_____864_CM 1 100. 0. 49.80468 DISPLAY_IDENTIFIER CUR_DMTL_COR_FIL_KWP ECU_ADDRESS 0xd0003778 FORMAT "%7.6" /end MEASUREMENT
/begin MEASUREMENT union_instance_kwp_ddli.v_igk_bas_kwp "" UBYTE _CNV_A_R_LINEAR_____207_CM 1 100. 0. 4.98046875 DISPLAY_IDENTIFIER V_IGK_BAS_KWP ECU_ADDRESS 0xd0003778 FORMAT "%4.2" /end MEASUREMENT
/begin MEASUREMENT union_instance_kwp_ddli.obd_t_ast "Time since engine start SAE J1979" UWORD _CNV_A_R_LINEAR_____36_CM 1 100. 0. 65535. DISPLAY_IDENTIFIER OBD_T_AST ECU_ADDRESS 0xd0003778 FORMAT "%5.0" /end MEASUREMENT
/begin MEASUREMENT union_instance_kwp_ddli.obd_amp "Barometric pressure SAE J1979" UBYTE _CNV_A_R_LINEAR_____853_CM 1 100. 0. 255. DISPLAY_IDENTIFIER OBD_AMP ECU_ADDRESS 0xd0003778 FORMAT "%3.0" /end MEASUREMENT
/begin MEASUREMENT union_instance_kwp_ddli.obd_vb "Control module voltage SAE J1979" UWORD _CNV_A_R_LINEAR_____865_CM 1 100. 0. 65.535 DISPLAY_IDENTIFIER OBD_VB ECU_ADDRESS 0xd0003778 /end MEASUREMENT
/begin MEASUREMENT union_instance_kwp_ddli.obd_lamb_sp "Commanded equivalence ratio SAE J1979" UWORD _CNV_A_R_LINEAR_____9_CM 1 100. 0. 1.99996948242188 DISPLAY_IDENTIFIER OBD_LAMB_SP ECU_ADDRESS 0xd0003778 FORMAT "%7.5" /end MEASUREMENT
/begin MEASUREMENT union_instance_kwp_ddli.obd_tam "Ambient air temperature SAE J1979" UBYTE _CNV_A_R_LINEAR_____26_CM 1 100. -40. 215. DISPLAY_IDENTIFIER OBD_TAM ECU_ADDRESS 0xd0003778 FORMAT "%3.0" /end MEASUREMENT
/begin MEASUREMENT union_instance_kwp_ddli.n_sae_byte_kwp "Ambient air temperature SAE J1979" UBYTE _CNV_A_R_LINEAR_____866_CM 1 100. 0. 16320. DISPLAY_IDENTIFIER N_SAE_BYTE_KWP ECU_ADDRESS 0xd0003778 FORMAT "%8.2" /end MEASUREMENT
/begin MEASUREMENT union_instance_kwp_ddli.v_alter_sp_kwp "setpoint alternator 1 voltage converted for KWP" UBYTE _CNV_A_R_LINEAR_____425_CM 1 100. 0. 25.5 DISPLAY_IDENTIFIER V_ALTER_SP_KWP ECU_ADDRESS 0xd0003778 FORMAT "%4.1" /end MEASUREMENT
/begin MEASUREMENT union_instance_kwp_ddli.fac_mv_diag_dyn_lsl_up_kwp "Mean value of normalised single sensor signal amplitude converted for KWP" UBYTE _CNV_A_R_LINEAR_____867_CM 1 100. 0. 1.02 DISPLAY_IDENTIFIER FAC_MV_DIAG_DYN_LSL_UP_KWP ECU_ADDRESS 0xd0003778 FORMAT "%4.2" /end MEASUREMENT
/begin MEASUREMENT union_instance_kwp_ddli.vp_tia_kwp "" UBYTE _CNV_A_R_LINEAR_____199_CM 1 100. 0. 4.998 DISPLAY_IDENTIFIER VP_TIA_KWP ECU_ADDRESS 0xd0003778 FORMAT "%6.4" /end MEASUREMENT
/begin MEASUREMENT union_instance_kwp_ddli.cur_cur_efc_max_dr_vvl_kwp "" UBYTE _CNV_A_R_LINEAR_____868_CM 1 100. 0. 2040. DISPLAY_IDENTIFIER CUR_CUR_EFC_MAX_DR_VVL_KWP ECU_ADDRESS 0xd0003778 FORMAT "%4.0" /end MEASUREMENT
/begin MEASUREMENT union_instance_kwp_ddli.fup_kwp "" UBYTE _CNV_A_R_LINEAR_____869_CM 1 100. 0. 346422. DISPLAY_IDENTIFIER FUP_KWP ECU_ADDRESS 0xd0003778 FORMAT "%6.0" /end MEASUREMENT
/begin MEASUREMENT union_instance_kwp_ddli.fup_efp_kwp "" UBYTE _CNV_A_R_LINEAR_____870_CM 1 100. 0. 173211. DISPLAY_IDENTIFIER FUP_EFP_KWP ECU_ADDRESS 0xd0003778 FORMAT "%6.0" /end MEASUREMENT
/begin MEASUREMENT union_instance_kwp_ddli.load_mis_kwp "" UBYTE _CNV_A_R_LINEAR_____5_CM 1 100. 0. 99.609375 DISPLAY_IDENTIFIER LOAD_MIS_KWP ECU_ADDRESS 0xd0003778 FORMAT "%9.6" /end MEASUREMENT
/begin MEASUREMENT union_instance_kwp_ddli.load_min_mis_kwp "" UBYTE _CNV_A_R_LINEAR_____5_CM 1 100. 0. 99.609375 DISPLAY_IDENTIFIER LOAD_MIN_MIS_KWP ECU_ADDRESS 0xd0003778 FORMAT "%9.6" /end MEASUREMENT
/begin MEASUREMENT union_instance_kwp_ddli.opg_acr_kwp "" UBYTE _CNV_A_R_LINEAR_____5_CM 1 100. 0. 99.609375 DISPLAY_IDENTIFIER OPG_ACR_KWP ECU_ADDRESS 0xd0003778 FORMAT "%9.6" /end MEASUREMENT
/begin MEASUREMENT union_instance_kwp_ddli.opg_sp_acr_kwp "" UBYTE _CNV_A_R_LINEAR_____5_CM 1 100. 0. 99.609375 DISPLAY_IDENTIFIER OPG_SP_ACR_KWP ECU_ADDRESS 0xd0003778 FORMAT "%9.6" /end MEASUREMENT
/begin MEASUREMENT union_instance_kwp_ddli.p_oel_ist_kwp "" UBYTE _CNV_A_R_LINEAR_____424_CM 1 100. 0. 8160. DISPLAY_IDENTIFIER P_OEL_IST_KWP ECU_ADDRESS 0xd0003778 FORMAT "%4.0" /end MEASUREMENT
/begin MEASUREMENT union_instance_kwp_ddli.put_kwp "" UBYTE _CNV_A_R_LINEAR_____853_CM 1 100. 0. 255. DISPLAY_IDENTIFIER PUT_KWP ECU_ADDRESS 0xd0003778 FORMAT "%3.0" /end MEASUREMENT
/begin MEASUREMENT union_instance_kwp_ddli.pwm_acr_kwp "" UBYTE _CNV_A_R_LINEAR_____5_CM 1 100. 0. 99.609375 DISPLAY_IDENTIFIER PWM_ACR_KWP ECU_ADDRESS 0xd0003778 FORMAT "%9.6" /end MEASUREMENT
/begin MEASUREMENT union_instance_kwp_ddli.pwm_neut_psn_gb_kwp "" UBYTE _CNV_A_R_LINEAR_____5_CM 1 100. 0. 99.609375 DISPLAY_IDENTIFIER PWM_NEUT_PSN_GB_KWP ECU_ADDRESS 0xd0003778 FORMAT "%9.6" /end MEASUREMENT
/begin MEASUREMENT union_instance_kwp_ddli.pwm_vcv_kwp "" UBYTE _CNV_A_R_LINEAR_____5_CM 1 100. 0. 99.609375 DISPLAY_IDENTIFIER PWM_VCV_KWP ECU_ADDRESS 0xd0003778 FORMAT "%9.6" /end MEASUREMENT
/begin MEASUREMENT union_instance_kwp_ddli.lamb_sp_kwp[0] "" UBYTE _CNV_A_R_LINEAR_____103_CM 1 100. 0. 1.9921875 DISPLAY_IDENTIFIER LAMB_SP_KWP[1] ECU_ADDRESS 0xd0003778 FORMAT "%8.6" /end MEASUREMENT
/begin MEASUREMENT union_instance_kwp_ddli.lamb_sp_kwp[1] "" UBYTE _CNV_A_R_LINEAR_____103_CM 1 100. 0. 1.9921875 DISPLAY_IDENTIFIER LAMB_SP_KWP[2] ECU_ADDRESS 0xd0003779 FORMAT "%8.6" /end MEASUREMENT
/begin MEASUREMENT union_instance_kwp_ddli.state_n_max_mon_high_kwp "" UBYTE _CNV_A_R_LINEAR_____0_CM 1 100. 0. 255. DISPLAY_IDENTIFIER STATE_N_MAX_MON_HIGH_KWP ECU_ADDRESS 0xd0003778 FORMAT "%3.0" /end MEASUREMENT
/begin MEASUREMENT union_instance_kwp_ddli.state_n_max_mon_low_kwp "" UBYTE _CNV_A_R_LINEAR_____0_CM 1 100. 0. 255. DISPLAY_IDENTIFIER STATE_N_MAX_MON_LOW_KWP ECU_ADDRESS 0xd0003778 FORMAT "%3.0" /end MEASUREMENT
/begin MEASUREMENT union_instance_kwp_ddli.t_es_cus_kwp "" UBYTE _CNV_A_R_LINEAR_____861_CM 1 100. 0. 1020. DISPLAY_IDENTIFIER T_ES_CUS_KWP ECU_ADDRESS 0xd0003778 FORMAT "%5.0" /end MEASUREMENT
/begin MEASUREMENT union_instance_kwp_ddli.tia_tcha_kwp "" UBYTE _CNV_A_R_ENSD_LINEA_399_CM 1 100. -50. 205. DISPLAY_IDENTIFIER TIA_TCHA_KWP ECU_ADDRESS 0xd0003778 FORMAT "%5.0" /end MEASUREMENT
/begin MEASUREMENT union_instance_kwp_ddli.t_per_maf_kwp "" UBYTE _CNV_A_R_LINEAR_____456_CM 1 100. 0. 1.02 DISPLAY_IDENTIFIER T_PER_MAF_KWP ECU_ADDRESS 0xd0003778 FORMAT "%5.3" /end MEASUREMENT
/begin MEASUREMENT union_instance_kwp_ddli.t_per_maf_frq_kwp "" UBYTE _CNV_A_R_LINEAR_____871_CM 1 100. 0. 65280. DISPLAY_IDENTIFIER T_PER_MAF_FRQ_KWP ECU_ADDRESS 0xd0003778 FORMAT "%6.0" /end MEASUREMENT
/begin MEASUREMENT union_instance_kwp_ddli.temp_dif_eac_kwp "" UBYTE _CNV_A_R_LINEAR_____872_CM 1 100. -12.75 12.75 DISPLAY_IDENTIFIER TEMP_DIF_EAC_KWP ECU_ADDRESS 0xd0003778 FORMAT "%4.2" /end MEASUREMENT
/begin MEASUREMENT union_instance_kwp_ddli.temp_eac_kwp "" UBYTE _CNV_A_R_LINEAR_____873_CM 1 100. 10. 138. DISPLAY_IDENTIFIER TEMP_EAC_KWP ECU_ADDRESS 0xd0003778 FORMAT "%4.2" /end MEASUREMENT
/begin MEASUREMENT union_instance_kwp_ddli.tps_dif_diag_cor_1_kwp "" UBYTE _CNV_A_R_LINEAR_____874_CM 1 100. 0. 119.040468778612 DISPLAY_IDENTIFIER TPS_DIF_DIAG_COR_1_KWP ECU_ADDRESS 0xd0003778 FORMAT "%9.5" /end MEASUREMENT
/begin MEASUREMENT union_instance_kwp_ddli.tps_dif_diag_cor_2_kwp "" UBYTE _CNV_A_R_LINEAR_____874_CM 1 100. 0. 119.040468778612 DISPLAY_IDENTIFIER TPS_DIF_DIAG_COR_2_KWP ECU_ADDRESS 0xd0003778 FORMAT "%9.5" /end MEASUREMENT
/begin MEASUREMENT union_instance_kwp_ddli.v_fup_efp_kwp "" UBYTE _CNV_A_R_LINEAR_____875_CM 1 100. 0. 4.98046 DISPLAY_IDENTIFIER V_FUP_EFP_KWP ECU_ADDRESS 0xd0003778 FORMAT "%7.5" /end MEASUREMENT
/begin MEASUREMENT union_instance_kwp_ddli.v_fup_mv_kwp "" UBYTE _CNV_A_R_LINEAR_____875_CM 1 100. 0. 4.98046 DISPLAY_IDENTIFIER V_FUP_MV_KWP ECU_ADDRESS 0xd0003778 FORMAT "%7.5" /end MEASUREMENT
/begin MEASUREMENT union_instance_kwp_ddli.vp_tia_tcha_kwp "" UBYTE _CNV_A_R_LINEAR_____876_CM 1 100. 0. 3.3 DISPLAY_IDENTIFIER VP_TIA_TCHA_KWP ECU_ADDRESS 0xd0003778 FORMAT "%3.1" /end MEASUREMENT
/begin MEASUREMENT union_instance_kwp_ddli.vp_teg_pcat_down_kwp "" UBYTE _CNV_A_R_LINEAR_____876_CM 1 100. 0. 3.3 DISPLAY_IDENTIFIER VP_TEG_PCAT_DOWN_KWP ECU_ADDRESS 0xd0003778 FORMAT "%3.1" /end MEASUREMENT
/begin MEASUREMENT union_instance_kwp_ddli.ang_exc_vvl_kwp "" UBYTE _CNV_A_R_LINEAR_____877_CM 1 100. 0. 199.21875 DISPLAY_IDENTIFIER ANG_EXC_VVL_KWP ECU_ADDRESS 0xd0003778 FORMAT "%9.5" /end MEASUREMENT
/begin MEASUREMENT union_instance_kwp_ddli.ang_sp_ctl_vvl_kwp "" UBYTE _CNV_A_R_LINEAR_____5_CM 1 100. 0. 99.609375 DISPLAY_IDENTIFIER ANG_SP_CTL_VVL_KWP ECU_ADDRESS 0xd0003778 FORMAT "%9.6" /end MEASUREMENT
/begin MEASUREMENT union_instance_kwp_ddli.pwm_dr_out_set_vvl_kwp "" UBYTE _CNV_A_R_LINEAR_____5_CM 1 100. 0. 99.609375 DISPLAY_IDENTIFIER PWM_DR_OUT_SET_VVL_KWP ECU_ADDRESS 0xd0003778 FORMAT "%9.6" /end MEASUREMENT
/begin MEASUREMENT union_instance_kwp_ddli.cur_mot_vvl_3_kwp "" SBYTE _CNV_A_R_LINEAR_____446_CM 1 100. -128. 127. DISPLAY_IDENTIFIER CUR_MOT_VVL_3_KWP ECU_ADDRESS 0xd0003778 FORMAT "%5.0" /end MEASUREMENT
/begin MEASUREMENT union_instance_kwp_ddli.temp_mot_vvl_kwp "" SBYTE _CNV_A_R_LINEAR_____522_CM 1 100. -48. 254. DISPLAY_IDENTIFIER TEMP_MOT_VVL_KWP ECU_ADDRESS 0xd0003778 FORMAT "%5.0" /end MEASUREMENT
/begin MEASUREMENT union_instance_kwp_ddli.vcc_dr_vvl_kwp "" UBYTE _CNV_A_R_LINEAR_____425_CM 1 100. 0. 25.5 DISPLAY_IDENTIFIER VCC_DR_VVL_KWP ECU_ADDRESS 0xd0003778 FORMAT "%4.1" /end MEASUREMENT
/begin MEASUREMENT union_instance_kwp_ddli.v_vcc_sens_vvl_kwp "" UBYTE _CNV_A_R_LINEAR_____425_CM 1 100. 0. 25.5 DISPLAY_IDENTIFIER V_VCC_SENS_VVL_KWP ECU_ADDRESS 0xd0003778 FORMAT "%4.1" /end MEASUREMENT
/begin MEASUREMENT union_instance_kwp_ddli.ang_de_absv_plaus_chk_vvl_kwp "" UBYTE _CNV_A_R_LINEAR_____878_CM 1 100. 0. 179.29687 DISPLAY_IDENTIFIER ANG_DE_ABSV_PLAUS_CHK_VVL_KWP ECU_ADDRESS 0xd0003778 FORMAT "%9.5" /end MEASUREMENT
/begin MEASUREMENT union_instance_kwp_ddli.temp_swi_mes_max_vvl_kwp "" SBYTE _CNV_A_R_LINEAR_____522_CM 1 100. -256. 254. DISPLAY_IDENTIFIER TEMP_SWI_MES_MAX_VVL_KWP ECU_ADDRESS 0xd0003778 FORMAT "%4.0" /end MEASUREMENT
/begin MEASUREMENT union_instance_kwp_ddli.state_byte_swi_kwp "" UBYTE _CNV_A_R_LINEAR_____0_CM 1 100. 0. 255. DISPLAY_IDENTIFIER STATE_BYTE_SWI_KWP ECU_ADDRESS 0xd0003778 FORMAT "%3.0" /end MEASUREMENT
/begin MEASUREMENT union_instance_kwp_ddli.cam_in_kwp "" UBYTE _CNV_A_R_LINEAR_____545_CM 1 100. 60. 155.625 DISPLAY_IDENTIFIER CAM_IN_KWP ECU_ADDRESS 0xd0003778 FORMAT "%7.3" /end MEASUREMENT
/begin MEASUREMENT union_instance_kwp_ddli.cam_sp_ivvt_in_kwp "" UBYTE _CNV_A_R_LINEAR_____879_CM 1 100. 50. 152. DISPLAY_IDENTIFIER CAM_SP_IVVT_IN_KWP ECU_ADDRESS 0xd0003778 FORMAT "%4.0" /end MEASUREMENT
/begin MEASUREMENT union_instance_kwp_ddli.v_pbsu_kwp "" UBYTE _CNV_A_R_LINEAR_____875_CM 1 100. 0. 4.98046 DISPLAY_IDENTIFIER V_PBSU_KWP ECU_ADDRESS 0xd0003778 FORMAT "%7.5" /end MEASUREMENT
/begin MEASUREMENT union_instance_kwp_ddli.v_put_kwp "" UBYTE _CNV_A_R_LINEAR_____875_CM 1 100. 0. 4.98046 DISPLAY_IDENTIFIER V_PUT_KWP ECU_ADDRESS 0xd0003778 FORMAT "%7.5" /end MEASUREMENT
/begin MEASUREMENT lv_mc_com_err "" UBYTE _CNV_S_2_RANGE__0___1_CM 1 100. 0. 1. DISPLAY_IDENTIFIER LV_MC_COM_ERR ECU_ADDRESS 0xd0008ab0 /end MEASUREMENT
/begin MEASUREMENT lv_mc_com_err_cpl "" UBYTE _CNV_S_2_RANGE__0___1_CM 1 100. 0. 1. DISPLAY_IDENTIFIER LV_MC_COM_ERR_CPL ECU_ADDRESS 0xd0008ab1 /end MEASUREMENT
/begin MEASUREMENT lf_ctr_rst_err_mem_act "" UBYTE _CNV_A_R_LINEAR_____0_CM 1 100. 0. 255. DISPLAY_IDENTIFIER LF_CTR_RST_ERR_MEM_ACT ECU_ADDRESS 0xd0005498 FORMAT "%3.0" /end MEASUREMENT
/begin MEASUREMENT lf_ctr_rst_err_mem_act_cpl "" UBYTE _CNV_A_R_LINEAR_____0_CM 1 100. 0. 255. DISPLAY_IDENTIFIER LF_CTR_RST_ERR_MEM_ACT_CPL ECU_ADDRESS 0xd0005499 FORMAT "%3.0" /end MEASUREMENT
/begin MEASUREMENT lf_ctr_rst_err_mem_old "" UBYTE _CNV_A_R_LINEAR_____0_CM 1 100. 0. 255. DISPLAY_IDENTIFIER LF_CTR_RST_ERR_MEM_OLD ECU_ADDRESS 0xd000549a FORMAT "%3.0" /end MEASUREMENT
/begin MEASUREMENT lf_ctr_rst_err_mem_old_cpl "" UBYTE _CNV_A_R_LINEAR_____0_CM 1 100. 0. 255. DISPLAY_IDENTIFIER LF_CTR_RST_ERR_MEM_OLD_CPL ECU_ADDRESS 0xd000549b FORMAT "%3.0" /end MEASUREMENT
/begin MEASUREMENT lf_err_cod_err_mem_act "" UBYTE _CNV_A_R_LINEAR_____0_CM 1 100. 0. 255. DISPLAY_IDENTIFIER LF_ERR_COD_ERR_MEM_ACT ECU_ADDRESS 0xd000549c FORMAT "%3.0" /end MEASUREMENT
/begin MEASUREMENT lf_err_cod_err_mem_act.err_cod_err_mem_act "" UBYTE _CNV_S_31_ECM3_ERR_C_881_CM 1 100. 0. 30. DISPLAY_IDENTIFIER ERR_COD_ERR_MEM_ACT ECU_ADDRESS 0xd000549c BIT_MASK 0x1F /end MEASUREMENT
/begin MEASUREMENT lf_err_cod_err_mem_act.state_err_idc_err_mem_act "" UBYTE _CNV_S_4_ECM3_STATE_882_CM 1 100. 0. 3. DISPLAY_IDENTIFIER STATE_ERR_IDC_ERR_MEM_ACT ECU_ADDRESS 0xd000549c BIT_MASK 0x60 /end MEASUREMENT
/begin MEASUREMENT lf_err_cod_err_mem_act.lv_mc_cpt_err_mem_act "" UBYTE _CNV_S_2_ECM3_LV_MC_883_CM 1 100. 0. 1. DISPLAY_IDENTIFIER LV_MC_CPT_ERR_MEM_ACT ECU_ADDRESS 0xd000549c BIT_MASK 0x80 /end MEASUREMENT
/begin MEASUREMENT lf_err_cod_err_mem_act_cpl "" UBYTE _CNV_A_R_LINEAR_____0_CM 1 100. 0. 255. DISPLAY_IDENTIFIER LF_ERR_COD_ERR_MEM_ACT_CPL ECU_ADDRESS 0xd000549d FORMAT "%3.0" /end MEASUREMENT
/begin MEASUREMENT lf_err_cod_err_mem_old "" UBYTE _CNV_A_R_LINEAR_____0_CM 1 100. 0. 255. DISPLAY_IDENTIFIER LF_ERR_COD_ERR_MEM_OLD ECU_ADDRESS 0xd000549e FORMAT "%3.0" /end MEASUREMENT
/begin MEASUREMENT lf_err_cod_err_mem_old.err_cod_err_mem_old "" UBYTE _CNV_S_31_ECM3_ERR_C_881_CM 1 100. 0. 30. DISPLAY_IDENTIFIER ERR_COD_ERR_MEM_OLD ECU_ADDRESS 0xd000549e BIT_MASK 0x1F /end MEASUREMENT
/begin MEASUREMENT lf_err_cod_err_mem_old.state_err_idc_err_mem_old "" UBYTE _CNV_S_4_ECM3_STATE_882_CM 1 100. 0. 3. DISPLAY_IDENTIFIER STATE_ERR_IDC_ERR_MEM_OLD ECU_ADDRESS 0xd000549e BIT_MASK 0x60 /end MEASUREMENT
/begin MEASUREMENT lf_err_cod_err_mem_old.lv_mc_cpt_err_mem_old "" UBYTE _CNV_S_2_ECM3_LV_MC_883_CM 1 100. 0. 1. DISPLAY_IDENTIFIER LV_MC_CPT_ERR_MEM_OLD ECU_ADDRESS 0xd000549e BIT_MASK 0x80 /end MEASUREMENT
/begin MEASUREMENT lf_err_cod_err_mem_old_cpl "" UBYTE _CNV_A_R_LINEAR_____0_CM 1 100. 0. 255. DISPLAY_IDENTIFIER LF_ERR_COD_ERR_MEM_OLD_CPL ECU_ADDRESS 0xd000549f FORMAT "%3.0" /end MEASUREMENT
/begin MEASUREMENT lv_mc_upd_err_mem_mc "" UBYTE _CNV_S_2_RANGE__0___1_CM 1 100. 0. 1. DISPLAY_IDENTIFIER LV_MC_UPD_ERR_MEM_MC ECU_ADDRESS 0xd0008acc /end MEASUREMENT
/begin MEASUREMENT lv_mc_upd_err_mem_mu "" UBYTE _CNV_S_2_RANGE__0___1_CM 1 100. 0. 1. DISPLAY_IDENTIFIER LV_MC_UPD_ERR_MEM_MU ECU_ADDRESS 0xd0008acd /end MEASUREMENT
/begin MEASUREMENT ctr_rst_mc "" UBYTE _CNV_A_R_LINEAR_____0_CM 1 100. 0. 255. DISPLAY_IDENTIFIER CTR_RST_MC ECU_ADDRESS 0xd0005494 FORMAT "%3.0" /end MEASUREMENT
/begin MEASUREMENT ctr_rst_mc_cpl "" UBYTE _CNV_A_R_LINEAR_____0_CM 1 100. 0. 255. DISPLAY_IDENTIFIER CTR_RST_MC_CPL ECU_ADDRESS 0xd0005495 FORMAT "%3.0" /end MEASUREMENT
/begin MEASUREMENT lf_err_cod_mc "" UBYTE _CNV_A_R_LINEAR_____0_CM 1 100. 0. 255. DISPLAY_IDENTIFIER LF_ERR_COD_MC ECU_ADDRESS 0xd0005496 FORMAT "%3.0" /end MEASUREMENT
/begin MEASUREMENT lf_err_cod_mc.err_cod_mc "" UBYTE _CNV_S_29_ECM3_ERR_C_884_CM 1 100. 0. 30. DISPLAY_IDENTIFIER ERR_COD_MC ECU_ADDRESS 0xd0005496 BIT_MASK 0x1F /end MEASUREMENT
/begin MEASUREMENT lf_err_cod_mc.state_err_idc_mc "" UBYTE _CNV_S_4_ECM3_STATE_882_CM 1 100. 0. 3. DISPLAY_IDENTIFIER STATE_ERR_IDC_MC ECU_ADDRESS 0xd0005496 BIT_MASK 0x60 /end MEASUREMENT
/begin MEASUREMENT lf_err_cod_mc_cpl "" UBYTE _CNV_A_R_LINEAR_____0_CM 1 100. 0. 255. DISPLAY_IDENTIFIER LF_ERR_COD_MC_CPL ECU_ADDRESS 0xd0005497 FORMAT "%3.0" /end MEASUREMENT
/begin MEASUREMENT lf_err_cod_mc_cpl.err_cod_mc_cpl "" UBYTE _CNV_A_R_LINEAR_____0_CM 1 100. 0. 255. DISPLAY_IDENTIFIER ERR_COD_MC_CPL ECU_ADDRESS 0xd0005497 FORMAT "%3.0" BIT_MASK 0x1F /end MEASUREMENT
/begin MEASUREMENT lf_err_cod_mc_cpl.state_err_idc_mc_cpl "" UBYTE _CNV_A_R_LINEAR_____0_CM 1 100. 0. 255. DISPLAY_IDENTIFIER STATE_ERR_IDC_MC_CPL ECU_ADDRESS 0xd0005497 FORMAT "%3.0" BIT_MASK 0x60 /end MEASUREMENT
/begin MEASUREMENT abc_mc_cks "" UBYTE _CNV_A_R_LINEAR_____0_CM 1 100. 0. 255. DISPLAY_IDENTIFIER ABC_MC_CKS ECU_ADDRESS 0xd0008a8c FORMAT "%3.0" /end MEASUREMENT
/begin MEASUREMENT abc_mc_hd "" UBYTE _CNV_A_R_LINEAR_____0_CM 1 100. 0. 255. DISPLAY_IDENTIFIER ABC_MC_HD ECU_ADDRESS 0xd0008a8d FORMAT "%3.0" /end MEASUREMENT
/begin MEASUREMENT abc_mc_conf_dif "" UBYTE _CNV_A_R_LINEAR_____0_CM 1 100. 0. 255. DISPLAY_IDENTIFIER ABC_MC_CONF_DIF ECU_ADDRESS 0xd0008a8e FORMAT "%3.0" /end MEASUREMENT
/begin MEASUREMENT abc_mc_wrg_idx "" UBYTE _CNV_A_R_LINEAR_____0_CM 1 100. 0. 255. DISPLAY_IDENTIFIER ABC_MC_WRG_IDX ECU_ADDRESS 0xd0008a8f FORMAT "%3.0" /end MEASUREMENT
/begin MEASUREMENT abc_mc_wrg_resp "" UBYTE _CNV_A_R_LINEAR_____0_CM 1 100. 0. 255. DISPLAY_IDENTIFIER ABC_MC_WRG_RESP ECU_ADDRESS 0xd0008a90 FORMAT "%3.0" /end MEASUREMENT
/begin MEASUREMENT abc_mc_not_dec "" UBYTE _CNV_A_R_LINEAR_____0_CM 1 100. 0. 255. DISPLAY_IDENTIFIER ABC_MC_NOT_DEC ECU_ADDRESS 0xd0008a91 FORMAT "%3.0" /end MEASUREMENT
/begin MEASUREMENT abc_mc_pfm_0_tog "" UBYTE _CNV_A_R_LINEAR_____0_CM 1 100. 0. 255. DISPLAY_IDENTIFIER ABC_MC_PFM_0_TOG ECU_ADDRESS 0xd0008a92 FORMAT "%3.0" /end MEASUREMENT
/begin MEASUREMENT abc_mc_pfm_1_tog "" UBYTE _CNV_A_R_LINEAR_____0_CM 1 100. 0. 255. DISPLAY_IDENTIFIER ABC_MC_PFM_1_TOG ECU_ADDRESS 0xd0008a93 FORMAT "%3.0" /end MEASUREMENT
/begin MEASUREMENT abc_mc_pfm_2_tog "" UBYTE _CNV_A_R_LINEAR_____0_CM 1 100. 0. 255. DISPLAY_IDENTIFIER ABC_MC_PFM_2_TOG ECU_ADDRESS 0xd0008a94 FORMAT "%3.0" /end MEASUREMENT
/begin MEASUREMENT abc_mc_pfm_3_tog "" UBYTE _CNV_A_R_LINEAR_____0_CM 1 100. 0. 255. DISPLAY_IDENTIFIER ABC_MC_PFM_3_TOG ECU_ADDRESS 0xd0008a95 FORMAT "%3.0" /end MEASUREMENT
/begin MEASUREMENT abc_mc_pfm_4_tog "" UBYTE _CNV_A_R_LINEAR_____0_CM 1 100. 0. 255. DISPLAY_IDENTIFIER ABC_MC_PFM_4_TOG ECU_ADDRESS 0xd0008a96 FORMAT "%3.0" /end MEASUREMENT
/begin MEASUREMENT abc_mc_pfm_5_tog "" UBYTE _CNV_A_R_LINEAR_____0_CM 1 100. 0. 255. DISPLAY_IDENTIFIER ABC_MC_PFM_5_TOG ECU_ADDRESS 0xd0008a97 FORMAT "%3.0" /end MEASUREMENT
/begin MEASUREMENT abc_mc_pfm_6_tog "" UBYTE _CNV_A_R_LINEAR_____0_CM 1 100. 0. 255. DISPLAY_IDENTIFIER ABC_MC_PFM_6_TOG ECU_ADDRESS 0xd0008a98 FORMAT "%3.0" /end MEASUREMENT
/begin MEASUREMENT abc_mc_pfm_0_resp "" UBYTE _CNV_A_R_LINEAR_____0_CM 1 100. 0. 255. DISPLAY_IDENTIFIER ABC_MC_PFM_0_RESP ECU_ADDRESS 0xd0008a99 FORMAT "%3.0" /end MEASUREMENT
/begin MEASUREMENT abc_mc_pfm_1_resp "" UBYTE _CNV_A_R_LINEAR_____0_CM 1 100. 0. 255. DISPLAY_IDENTIFIER ABC_MC_PFM_1_RESP ECU_ADDRESS 0xd0008a9a FORMAT "%3.0" /end MEASUREMENT
/begin MEASUREMENT abc_mc_pfm_2_resp "" UBYTE _CNV_A_R_LINEAR_____0_CM 1 100. 0. 255. DISPLAY_IDENTIFIER ABC_MC_PFM_2_RESP ECU_ADDRESS 0xd0008a9b FORMAT "%3.0" /end MEASUREMENT
/begin MEASUREMENT abc_mc_pfm_3_resp "" UBYTE _CNV_A_R_LINEAR_____0_CM 1 100. 0. 255. DISPLAY_IDENTIFIER ABC_MC_PFM_3_RESP ECU_ADDRESS 0xd0008a9c FORMAT "%3.0" /end MEASUREMENT
/begin MEASUREMENT abc_mc_pfm_4_resp "" UBYTE _CNV_A_R_LINEAR_____0_CM 1 100. 0. 255. DISPLAY_IDENTIFIER ABC_MC_PFM_4_RESP ECU_ADDRESS 0xd0008a9d FORMAT "%3.0" /end MEASUREMENT
/begin MEASUREMENT abc_mc_pfm_5_resp "" UBYTE _CNV_A_R_LINEAR_____0_CM 1 100. 0. 255. DISPLAY_IDENTIFIER ABC_MC_PFM_5_RESP ECU_ADDRESS 0xd0008a9e FORMAT "%3.0" /end MEASUREMENT
/begin MEASUREMENT abc_mc_pfm_6_resp "" UBYTE _CNV_A_R_LINEAR_____0_CM 1 100. 0. 255. DISPLAY_IDENTIFIER ABC_MC_PFM_6_RESP ECU_ADDRESS 0xd0008a9f FORMAT "%3.0" /end MEASUREMENT
/begin MEASUREMENT ctr_rst_mu "" UBYTE _CNV_A_R_LINEAR_____0_CM 1 100. 0. 255. DISPLAY_IDENTIFIER CTR_RST_MU ECU_ADDRESS 0xd0008aa0 FORMAT "%3.0" /end MEASUREMENT
/begin MEASUREMENT lf_err_cod_mu "" UBYTE _CNV_A_R_LINEAR_____0_CM 1 100. 0. 255. DISPLAY_IDENTIFIER LF_ERR_COD_MU ECU_ADDRESS 0xd0008aa1 FORMAT "%3.0" /end MEASUREMENT
/begin MEASUREMENT lf_err_cod_mu.err_cod_mu "" UBYTE _CNV_S_24_ECM3_ERR_C_885_CM 1 100. 0. 23. DISPLAY_IDENTIFIER ERR_COD_MU ECU_ADDRESS 0xd0008aa1 BIT_MASK 0x1F /end MEASUREMENT
/begin MEASUREMENT lf_err_cod_mu.state_err_idc_mu "" UBYTE _CNV_S_4_ECM3_STATE_882_CM 1 100. 0. 3. DISPLAY_IDENTIFIER STATE_ERR_IDC_MU ECU_ADDRESS 0xd0008aa1 BIT_MASK 0x60 /end MEASUREMENT
/begin MEASUREMENT mu_di_state "state of MU disable request" UBYTE _CNV_S_4_ECM3_MU_DI_886_CM 1 100. 0. 3. DISPLAY_IDENTIFIER MU_DI_STATE ECU_ADDRESS 0xd0008aa2 /end MEASUREMENT
/begin MEASUREMENT lv_mc_dr_off "" UBYTE _CNV_S_2_RANGE__0___1_CM 1 100. 0. 1. DISPLAY_IDENTIFIER LV_MC_DR_OFF ECU_ADDRESS 0xd0008aa3 /end MEASUREMENT
/begin MEASUREMENT lv_mc_dr_off_cpl "" UBYTE _CNV_S_2_RANGE__0___1_CM 1 100. 0. 1. DISPLAY_IDENTIFIER LV_MC_DR_OFF_CPL ECU_ADDRESS 0xd0008aa4 /end MEASUREMENT
/begin MEASUREMENT lv_err_mu_mc "" UBYTE _CNV_S_2_RANGE__0___1_CM 1 100. 0. 1. DISPLAY_IDENTIFIER LV_ERR_MU_MC ECU_ADDRESS 0xd0008aa5 /end MEASUREMENT
/begin MEASUREMENT lv_err_mu_mc_cpl "" UBYTE _CNV_S_2_RANGE__0___1_CM 1 100. 0. 1. DISPLAY_IDENTIFIER LV_ERR_MU_MC_CPL ECU_ADDRESS 0xd0008aa6 /end MEASUREMENT
/begin MEASUREMENT lv_err_tmp_mu_mc "" UBYTE _CNV_S_2_RANGE__0___1_CM 1 100. 0. 1. DISPLAY_IDENTIFIER LV_ERR_TMP_MU_MC ECU_ADDRESS 0xd0008aa7 /end MEASUREMENT
/begin MEASUREMENT lv_err_tmp_mu_mc_cpl "" UBYTE _CNV_S_2_RANGE__0___1_CM 1 100. 0. 1. DISPLAY_IDENTIFIER LV_ERR_TMP_MU_MC_CPL ECU_ADDRESS 0xd0008aa8 /end MEASUREMENT
/begin MEASUREMENT lv_mu_di_out_0 "" UBYTE _CNV_S_2_RANGE__0___1_CM 1 100. 0. 1. DISPLAY_IDENTIFIER LV_MU_DI_OUT_0 ECU_ADDRESS 0xd0008aa9 /end MEASUREMENT
/begin MEASUREMENT lv_mu_di_out_1 "" UBYTE _CNV_S_2_RANGE__0___1_CM 1 100. 0. 1. DISPLAY_IDENTIFIER LV_MU_DI_OUT_1 ECU_ADDRESS 0xd0008aaa /end MEASUREMENT
/begin MEASUREMENT lv_v_l_det_mu "" UBYTE _CNV_S_2_RANGE__0___1_CM 1 100. 0. 1. DISPLAY_IDENTIFIER LV_V_L_DET_MU ECU_ADDRESS 0xd0008aab /end MEASUREMENT
/begin MEASUREMENT lv_v_h_det_mu "" UBYTE _CNV_S_2_RANGE__0___1_CM 1 100. 0. 1. DISPLAY_IDENTIFIER LV_V_H_DET_MU ECU_ADDRESS 0xd0008aac /end MEASUREMENT
/begin MEASUREMENT lv_mc_inh_sopc "" UBYTE _CNV_S_2_RANGE__0___1_CM 1 100. 0. 1. DISPLAY_IDENTIFIER LV_MC_INH_SOPC ECU_ADDRESS 0xd0008aad /end MEASUREMENT
/begin MEASUREMENT ctr_com_cyc_mc_dec_rst "" UWORD _CNV_A_R_LINEAR_____0_CM 1 100. 0. 65535. DISPLAY_IDENTIFIER CTR_COM_CYC_MC_DEC_RST ECU_ADDRESS 0xd0001f74 FORMAT "%5.0" /end MEASUREMENT
/begin MEASUREMENT ctr_mu_di "" UBYTE _CNV_A_R_LINEAR_____0_CM 1 100. 0. 255. DISPLAY_IDENTIFIER CTR_MU_DI ECU_ADDRESS 0xd0001f78 FORMAT "%3.0" /end MEASUREMENT
/begin MEASUREMENT ctr_com_cyc_mc_dr_di_tmp "" UBYTE _CNV_A_R_LINEAR_____0_CM 1 100. 0. 255. DISPLAY_IDENTIFIER CTR_COM_CYC_MC_DR_DI_TMP ECU_ADDRESS 0xd0001f79 FORMAT "%3.0" /end MEASUREMENT
/begin MEASUREMENT lv_mu_di_act "" UBYTE _CNV_S_2_RANGE__0___1_CM 1 100. 0. 1. DISPLAY_IDENTIFIER LV_MU_DI_ACT ECU_ADDRESS 0xd0001f7a /end MEASUREMENT
/begin MEASUREMENT test_rec_idx_mon2 "" UBYTE _CNV_A_R_LINEAR_____0_CM 1 100. 0. 255. DISPLAY_IDENTIFIER TEST_REC_IDX_MON2 ECU_ADDRESS 0xd0008ac8 FORMAT "%3.0" /end MEASUREMENT
/begin MEASUREMENT lv_mc_fct_spc_ist_act "" UBYTE _CNV_S_2_RANGE__0___1_CM 1 100. 0. 1. DISPLAY_IDENTIFIER LV_MC_FCT_SPC_IST_ACT ECU_ADDRESS 0xd0008ac9 /end MEASUREMENT
/begin MEASUREMENT tcc_mc_fct_spc_ist_wrg_resp "" UBYTE _CNV_A_R_LINEAR_____0_CM 1 100. 0. 255. DISPLAY_IDENTIFIER TCC_MC_FCT_SPC_IST_WRG_RESP ECU_ADDRESS 0xd0001f7c FORMAT "%3.0" /end MEASUREMENT
/begin MEASUREMENT abc_lid_mc_fct_spc_ist_old "" UBYTE _CNV_A_R_LINEAR_____0_CM 1 100. 0. 255. DISPLAY_IDENTIFIER ABC_LID_MC_FCT_SPC_IST_OLD ECU_ADDRESS 0xd0001f7d FORMAT "%3.0" /end MEASUREMENT
/begin MEASUREMENT idx_nr_lid_mc_fct_spc_ist_old "" UBYTE _CNV_A_R_LINEAR_____0_CM 1 100. 0. 255. DISPLAY_IDENTIFIER IDX_NR_LID_MC_FCT_SPC_IST_OLD ECU_ADDRESS 0xd0001f7e FORMAT "%3.0" /end MEASUREMENT
/begin MEASUREMENT lv_mc_fct_spc_ist_wrg_resp_act "" UBYTE _CNV_S_2_RANGE__0___1_CM 1 100. 0. 1. DISPLAY_IDENTIFIER LV_MC_FCT_SPC_IST_WRG_RESP_ACT ECU_ADDRESS 0xd0001f7f /end MEASUREMENT
/begin MEASUREMENT lf_mc_syn_pfm "" UBYTE _CNV_A_R_LINEAR_____0_CM 1 100. 0. 255. DISPLAY_IDENTIFIER LF_MC_SYN_PFM ECU_ADDRESS 0xd0008abc FORMAT "%3.0" /end MEASUREMENT
/begin MEASUREMENT lf_mc_resp_pfm "" UBYTE _CNV_A_R_LINEAR_____0_CM 1 100. 0. 255. DISPLAY_IDENTIFIER LF_MC_RESP_PFM ECU_ADDRESS 0xd0008abd FORMAT "%3.0" /end MEASUREMENT
/begin MEASUREMENT state_mc_pfm_ctl_byte[0] "" UBYTE _CNV_A_R_LINEAR_____0_CM 1 100. 0. 255. DISPLAY_IDENTIFIER STATE_MC_PFM_CTL_BYTE[0] ECU_ADDRESS 0xd0008abe FORMAT "%3.0" /end MEASUREMENT
/begin MEASUREMENT state_mc_pfm_ctl_byte[1] "" UBYTE _CNV_A_R_LINEAR_____0_CM 1 100. 0. 255. DISPLAY_IDENTIFIER STATE_MC_PFM_CTL_BYTE[1] ECU_ADDRESS 0xd0008abf FORMAT "%3.0" /end MEASUREMENT
/begin MEASUREMENT state_mc_pfm_ctl_byte[2] "" UBYTE _CNV_A_R_LINEAR_____0_CM 1 100. 0. 255. DISPLAY_IDENTIFIER STATE_MC_PFM_CTL_BYTE[2] ECU_ADDRESS 0xd0008ac0 FORMAT "%3.0" /end MEASUREMENT
/begin MEASUREMENT state_mc_pfm_ctl_byte[3] "" UBYTE _CNV_A_R_LINEAR_____0_CM 1 100. 0. 255. DISPLAY_IDENTIFIER STATE_MC_PFM_CTL_BYTE[3] ECU_ADDRESS 0xd0008ac1 FORMAT "%3.0" /end MEASUREMENT
/begin MEASUREMENT state_mc_pfm_ctl_byte[4] "" UBYTE _CNV_A_R_LINEAR_____0_CM 1 100. 0. 255. DISPLAY_IDENTIFIER STATE_MC_PFM_CTL_BYTE[4] ECU_ADDRESS 0xd0008ac2 FORMAT "%3.0" /end MEASUREMENT
/begin MEASUREMENT state_mc_pfm_ctl_byte[5] "" UBYTE _CNV_A_R_LINEAR_____0_CM 1 100. 0. 255. DISPLAY_IDENTIFIER STATE_MC_PFM_CTL_BYTE[5] ECU_ADDRESS 0xd0008ac3 FORMAT "%3.0" /end MEASUREMENT
/begin MEASUREMENT state_mc_pfm_ctl_byte[6] "" UBYTE _CNV_A_R_LINEAR_____0_CM 1 100. 0. 255. DISPLAY_IDENTIFIER STATE_MC_PFM_CTL_BYTE[6] ECU_ADDRESS 0xd0008ac4 FORMAT "%3.0" /end MEASUREMENT
/begin MEASUREMENT lv_mc_pfm_wrg_resp_act_6 "" UBYTE _CNV_S_2_RANGE__0___1_CM 1 100. 0. 1. DISPLAY_IDENTIFIER LV_MC_PFM_WRG_RESP_ACT_6 ECU_ADDRESS 0xd0008ac5 /end MEASUREMENT
/begin MEASUREMENT tcc_mc_pfm_tog_6 "" UWORD _CNV_A_R_LINEAR_____0_CM 1 100. 0. 65535. DISPLAY_IDENTIFIER TCC_MC_PFM_TOG_6 ECU_ADDRESS 0xd0001f80 FORMAT "%5.0" /end MEASUREMENT
/begin MEASUREMENT lf_mc_pfm_syn_byte "" UBYTE _CNV_A_R_LINEAR_____0_CM 1 100. 0. 255. DISPLAY_IDENTIFIER LF_MC_PFM_SYN_BYTE ECU_ADDRESS 0xd0001f84 FORMAT "%3.0" /end MEASUREMENT
/begin MEASUREMENT lf_state_abc_pfm_mu "" UBYTE _CNV_A_R_LINEAR_____0_CM 1 100. 0. 255. DISPLAY_IDENTIFIER LF_STATE_ABC_PFM_MU ECU_ADDRESS 0xd0001f85 FORMAT "%3.0" /end MEASUREMENT
/begin MEASUREMENT lf_mc_pfm_syn_byte_chg "" UBYTE _CNV_A_R_LINEAR_____0_CM 1 100. 0. 255. DISPLAY_IDENTIFIER LF_MC_PFM_SYN_BYTE_CHG ECU_ADDRESS 0xd0001f86 FORMAT "%3.0" /end MEASUREMENT
/begin MEASUREMENT lf_mc_pfm_syn_byte_chg_old "" UBYTE _CNV_A_R_LINEAR_____0_CM 1 100. 0. 255. DISPLAY_IDENTIFIER LF_MC_PFM_SYN_BYTE_CHG_OLD ECU_ADDRESS 0xd0001f87 FORMAT "%3.0" /end MEASUREMENT
/begin MEASUREMENT tcc_mc_pfm_tog[0] "" UBYTE _CNV_A_R_LINEAR_____0_CM 1 100. 0. 255. DISPLAY_IDENTIFIER TCC_MC_PFM_TOG[0] ECU_ADDRESS 0xd0001f88 FORMAT "%3.0" /end MEASUREMENT
/begin MEASUREMENT tcc_mc_pfm_tog[1] "" UBYTE _CNV_A_R_LINEAR_____0_CM 1 100. 0. 255. DISPLAY_IDENTIFIER TCC_MC_PFM_TOG[1] ECU_ADDRESS 0xd0001f89 FORMAT "%3.0" /end MEASUREMENT
/begin MEASUREMENT tcc_mc_pfm_tog[2] "" UBYTE _CNV_A_R_LINEAR_____0_CM 1 100. 0. 255. DISPLAY_IDENTIFIER TCC_MC_PFM_TOG[2] ECU_ADDRESS 0xd0001f8a FORMAT "%3.0" /end MEASUREMENT
/begin MEASUREMENT tcc_mc_pfm_tog[3] "" UBYTE _CNV_A_R_LINEAR_____0_CM 1 100. 0. 255. DISPLAY_IDENTIFIER TCC_MC_PFM_TOG[3] ECU_ADDRESS 0xd0001f8b FORMAT "%3.0" /end MEASUREMENT
/begin MEASUREMENT tcc_mc_pfm_tog[4] "" UBYTE _CNV_A_R_LINEAR_____0_CM 1 100. 0. 255. DISPLAY_IDENTIFIER TCC_MC_PFM_TOG[4] ECU_ADDRESS 0xd0001f8c FORMAT "%3.0" /end MEASUREMENT
/begin MEASUREMENT tcc_mc_pfm_tog[5] "" UBYTE _CNV_A_R_LINEAR_____0_CM 1 100. 0. 255. DISPLAY_IDENTIFIER TCC_MC_PFM_TOG[5] ECU_ADDRESS 0xd0001f8d FORMAT "%3.0" /end MEASUREMENT
/begin MEASUREMENT lf_mc_wrg_resp_pfm_act "" UBYTE _CNV_A_R_LINEAR_____0_CM 1 100. 0. 255. DISPLAY_IDENTIFIER LF_MC_WRG_RESP_PFM_ACT ECU_ADDRESS 0xd0001f8e FORMAT "%3.0" /end MEASUREMENT
/begin MEASUREMENT lv_mc_rom_chk_ready "" UBYTE _CNV_S_2_RANGE__0___1_CM 1 100. 0. 1. DISPLAY_IDENTIFIER LV_MC_ROM_CHK_READY ECU_ADDRESS 0xd0005490 /end MEASUREMENT
/begin MEASUREMENT lv_mc_rom_chk_ready_cpl "" UBYTE _CNV_S_2_RANGE__0___1_CM 1 100. 0. 1. DISPLAY_IDENTIFIER LV_MC_ROM_CHK_READY_CPL ECU_ADDRESS 0xd0005491 /end MEASUREMENT
/begin MEASUREMENT lv_mc_rom_chk_ok "" UBYTE _CNV_S_2_RANGE__0___1_CM 1 100. 0. 1. DISPLAY_IDENTIFIER LV_MC_ROM_CHK_OK ECU_ADDRESS 0xd0005492 /end MEASUREMENT
/begin MEASUREMENT lv_mc_rom_chk_ok_cpl "" UBYTE _CNV_S_2_RANGE__0___1_CM 1 100. 0. 1. DISPLAY_IDENTIFIER LV_MC_ROM_CHK_OK_CPL ECU_ADDRESS 0xd0005493 /end MEASUREMENT
/begin MEASUREMENT vp_mc_an_dig_mon "" UWORD _CNV_A_R_LINEAR_____0_CM 1 100. 0. 65535. DISPLAY_IDENTIFIER VP_MC_AN_DIG_MON ECU_ADDRESS 0xd000a69c FORMAT "%5.0" /end MEASUREMENT
/begin MEASUREMENT vp_mc_an_dig_mon_cpl "" UWORD _CNV_A_R_LINEAR_____0_CM 1 100. 0. 65535. DISPLAY_IDENTIFIER VP_MC_AN_DIG_MON_CPL ECU_ADDRESS 0xd000a69e FORMAT "%5.0" /end MEASUREMENT
/begin MEASUREMENT vp_mu_an_dig_mon "" UWORD _CNV_A_R_LINEAR_____0_CM 1 100. 0. 65535. DISPLAY_IDENTIFIER VP_MU_AN_DIG_MON ECU_ADDRESS 0xd000a6a0 FORMAT "%5.0" /end MEASUREMENT
/begin MEASUREMENT vp_mu_an_dig_mon_cpl "" UWORD _CNV_A_R_LINEAR_____0_CM 1 100. 0. 65535. DISPLAY_IDENTIFIER VP_MU_AN_DIG_MON_CPL ECU_ADDRESS 0xd000a6a2 FORMAT "%5.0" /end MEASUREMENT
/begin MEASUREMENT state_mc "" UBYTE _CNV_A_R_LINEAR_____0_CM 1 100. 0. 255. DISPLAY_IDENTIFIER STATE_MC ECU_ADDRESS 0xd0008a84 FORMAT "%3.0" /end MEASUREMENT
/begin MEASUREMENT lf_mu_conf_byte "" UBYTE _CNV_A_R_LINEAR_____0_CM 1 100. 0. 255. DISPLAY_IDENTIFIER LF_MU_CONF_BYTE ECU_ADDRESS 0xd0008a85 FORMAT "%3.0" /end MEASUREMENT
/begin MEASUREMENT nr_mu_comp "" UBYTE _CNV_A_R_LINEAR_____0_CM 1 100. 0. 255. DISPLAY_IDENTIFIER NR_MU_COMP ECU_ADDRESS 0xd0008a86 FORMAT "%3.0" /end MEASUREMENT
/begin MEASUREMENT nr_mu_hw_vers "" UBYTE _CNV_A_R_LINEAR_____0_CM 1 100. 0. 255. DISPLAY_IDENTIFIER NR_MU_HW_VERS ECU_ADDRESS 0xd0008a87 FORMAT "%3.0" /end MEASUREMENT
/begin MEASUREMENT lv_mu_ign_key "" UBYTE _CNV_S_2_RANGE__0___1_CM 1 100. 0. 1. DISPLAY_IDENTIFIER LV_MU_IGN_KEY ECU_ADDRESS 0xd0008a88 /end MEASUREMENT
/begin MEASUREMENT rom_cks_cal_clc_l "" ULONG _CNV_A_R_LINEAR_____0_CM 1 100. 0. 4294967295. DISPLAY_IDENTIFIER ROM_CKS_CAL_CLC_L ECU_ADDRESS 0xd0001f98 FORMAT "%10.0" /end MEASUREMENT
/begin MEASUREMENT rom_cks_cal_clc_h "" ULONG _CNV_A_R_LINEAR_____0_CM 1 100. 0. 4294967295. DISPLAY_IDENTIFIER ROM_CKS_CAL_CLC_H ECU_ADDRESS 0xd0001f9c FORMAT "%10.0" /end MEASUREMENT
/begin MEASUREMENT ecu_cks_ptr "" ULONG _CNV_A_R_LINEAR_____0_CM 1 100. 0. 4294967295. DISPLAY_IDENTIFIER ECU_CKS_PTR ECU_ADDRESS 0xd0001fb0 FORMAT "%10.0" /end MEASUREMENT
/begin MEASUREMENT cal_cks_ptr "" ULONG _CNV_A_R_LINEAR_____0_CM 1 100. 0. 4294967295. DISPLAY_IDENTIFIER CAL_CKS_PTR ECU_ADDRESS 0xd0001fb4 FORMAT "%10.0" /end MEASUREMENT
/begin MEASUREMENT ecu_blk_size "" UWORD _CNV_A_R_LINEAR_____0_CM 1 100. 0. 65535. DISPLAY_IDENTIFIER ECU_BLK_SIZE ECU_ADDRESS 0xd0001f90 FORMAT "%5.0" /end MEASUREMENT
/begin MEASUREMENT cal_blk_size "" UWORD _CNV_A_R_LINEAR_____0_CM 1 100. 0. 65535. DISPLAY_IDENTIFIER CAL_BLK_SIZE ECU_ADDRESS 0xd0001f92 FORMAT "%5.0" /end MEASUREMENT
/begin MEASUREMENT tout_rom_cks_mon_ecu "" UBYTE _CNV_A_R_LINEAR_____0_CM 1 100. 0. 255. DISPLAY_IDENTIFIER TOUT_ROM_CKS_MON_ECU ECU_ADDRESS 0xd0001fb9 FORMAT "%3.0" /end MEASUREMENT
/begin MEASUREMENT tout_rom_cks_mon_cal "" UBYTE _CNV_A_R_LINEAR_____0_CM 1 100. 0. 255. DISPLAY_IDENTIFIER TOUT_ROM_CKS_MON_CAL ECU_ADDRESS 0xd0001fba FORMAT "%3.0" /end MEASUREMENT
/begin MEASUREMENT vp_mc_an_dig_mon_tmp "" UWORD _CNV_A_R_LINEAR_____0_CM 1 100. 0. 65535. DISPLAY_IDENTIFIER VP_MC_AN_DIG_MON_TMP ECU_ADDRESS 0xd0001f94 FORMAT "%5.0" /end MEASUREMENT
/begin MEASUREMENT vp_mc_an_dig_mon_tmp_cpl "" UWORD _CNV_A_R_LINEAR_____0_CM 1 100. 0. 65535. DISPLAY_IDENTIFIER VP_MC_AN_DIG_MON_TMP_CPL ECU_ADDRESS 0xd0001f96 FORMAT "%5.0" /end MEASUREMENT
/begin CHARACTERISTIC c_rom_cks_cal_l "" VALUE 0xa08084d8 _REC_VAL_20_u4 4294967295. _CNV_A_R_LINEAR_____0_CM 0. 4294967295. DISPLAY_IDENTIFIER C_ROM_CKS_CAL_L FORMAT "%10.0" /end CHARACTERISTIC
/begin CHARACTERISTIC c_rom_cks_cal_h "" VALUE 0xa08084d4 _REC_VAL_20_u4 4294967295. _CNV_A_R_LINEAR_____0_CM 0. 4294967295. DISPLAY_IDENTIFIER C_ROM_CKS_CAL_H FORMAT "%10.0" /end CHARACTERISTIC
/begin CHARACTERISTIC c_err_swi_mc_level_2_cal "" VALUE 0xa08084dc _REC_VAL_20_u1 255. _CNV_A_R_LINEAR_____0_CM 0. 255. DISPLAY_IDENTIFIER C_ERR_SWI_MC_LEVEL_2_CAL FORMAT "%3.0" /end CHARACTERISTIC
/begin MEASUREMENT state_mc_resp_sopc "" UBYTE _CNV_A_R_LINEAR_____0_CM 1 100. 0. 255. DISPLAY_IDENTIFIER STATE_MC_RESP_SOPC ECU_ADDRESS 0xd0008ab4 FORMAT "%3.0" /end MEASUREMENT
/begin MEASUREMENT state_mc_resp_sopc_cpl "" UBYTE _CNV_A_R_LINEAR_____0_CM 1 100. 0. 255. DISPLAY_IDENTIFIER STATE_MC_RESP_SOPC_CPL ECU_ADDRESS 0xd0008ab5 FORMAT "%3.0" /end MEASUREMENT
/begin MEASUREMENT lf_sdr_sopc "" UBYTE _CNV_A_R_LINEAR_____0_CM 1 100. 0. 255. DISPLAY_IDENTIFIER LF_SDR_SOPC ECU_ADDRESS 0xd0008ab6 FORMAT "%3.0" /end MEASUREMENT
/begin MEASUREMENT lf_sdr_sopc.lf_mc_sopc "" UBYTE _CNV_A_R_LINEAR_____0_CM 1 100. 0. 255. DISPLAY_IDENTIFIER LF_MC_SOPC ECU_ADDRESS 0xd0008ab6 FORMAT "%3.0" BIT_MASK 0xC /end MEASUREMENT
/begin MEASUREMENT lf_sdr_sopc.lf_mu_sopc "" UBYTE _CNV_A_R_LINEAR_____0_CM 1 100. 0. 255. DISPLAY_IDENTIFIER LF_MU_SOPC ECU_ADDRESS 0xd0008ab6 FORMAT "%3.0" BIT_MASK 0x3 /end MEASUREMENT
/begin MEASUREMENT lf_sdr_sopc_cpl "" UBYTE _CNV_A_R_LINEAR_____0_CM 1 100. 0. 255. DISPLAY_IDENTIFIER LF_SDR_SOPC_CPL ECU_ADDRESS 0xd0008ab7 FORMAT "%3.0" /end MEASUREMENT
/begin MEASUREMENT lv_mc_sopc_inh_di "" UBYTE _CNV_S_2_RANGE__0___1_CM 1 100. 0. 1. DISPLAY_IDENTIFIER LV_MC_SOPC_INH_DI ECU_ADDRESS 0xd0008ab8 /end MEASUREMENT
/begin MEASUREMENT lv_mc_sopc_inh_di_cpl "" UBYTE _CNV_S_2_RANGE__0___1_CM 1 100. 0. 1. DISPLAY_IDENTIFIER LV_MC_SOPC_INH_DI_CPL ECU_ADDRESS 0xd0008ab9 /end MEASUREMENT
/begin MEASUREMENT lv_mc_sopc_act "" UBYTE _CNV_S_2_RANGE__0___1_CM 1 100. 0. 1. DISPLAY_IDENTIFIER LV_MC_SOPC_ACT ECU_ADDRESS 0xd0008aba /end MEASUREMENT
/begin MEASUREMENT state_sopc "" UBYTE _CNV_A_R_LINEAR_____0_CM 1 100. 0. 255. DISPLAY_IDENTIFIER STATE_SOPC ECU_ADDRESS 0xd0001fbc FORMAT "%3.0" /end MEASUREMENT
/begin MEASUREMENT ctr_tout_sopc_mc "" UBYTE _CNV_A_R_LINEAR_____0_CM 1 100. 0. 255. DISPLAY_IDENTIFIER CTR_TOUT_SOPC_MC ECU_ADDRESS 0xd0001fbd FORMAT "%3.0" /end MEASUREMENT
/begin MEASUREMENT ctr_wait_mon_3_ena "" UBYTE _CNV_A_R_LINEAR_____0_CM 1 100. 0. 255. DISPLAY_IDENTIFIER CTR_WAIT_MON_3_ENA ECU_ADDRESS 0xd0008ad0 FORMAT "%3.0" /end MEASUREMENT
/begin MEASUREMENT envd_0_mon_3 "" UBYTE _CNV_A_R_LINEAR_____0_CM 1 100. 0. 255. DISPLAY_IDENTIFIER ENVD_0_MON_3 ECU_ADDRESS 0xd0008ad1 FORMAT "%3.0" /end MEASUREMENT
/begin MEASUREMENT envd_1_mon_3 "" UBYTE _CNV_A_R_LINEAR_____0_CM 1 100. 0. 255. DISPLAY_IDENTIFIER ENVD_1_MON_3 ECU_ADDRESS 0xd0008ad2 FORMAT "%3.0" /end MEASUREMENT
/begin MEASUREMENT envd_2_mon_3 "" UBYTE _CNV_A_R_LINEAR_____0_CM 1 100. 0. 255. DISPLAY_IDENTIFIER ENVD_2_MON_3 ECU_ADDRESS 0xd0008ad3 FORMAT "%3.0" /end MEASUREMENT
/begin MEASUREMENT envd_3_mon_3 "" UBYTE _CNV_A_R_LINEAR_____0_CM 1 100. 0. 255. DISPLAY_IDENTIFIER ENVD_3_MON_3 ECU_ADDRESS 0xd0008ad4 FORMAT "%3.0" /end MEASUREMENT
/begin MEASUREMENT lv_err_tmp_mu_mc_old "" UBYTE _CNV_S_2_RANGE__0___1_CM 1 100. 0. 1. DISPLAY_IDENTIFIER LV_ERR_TMP_MU_MC_OLD ECU_ADDRESS 0xd0001f70 /end MEASUREMENT
/begin MEASUREMENT err_cod_mc_save "" UBYTE _CNV_A_R_LINEAR_____0_CM 1 100. 0. 255. DISPLAY_IDENTIFIER ERR_COD_MC_SAVE ECU_ADDRESS 0xd0008ad5 FORMAT "%3.0" /end MEASUREMENT
/begin MEASUREMENT err_cod_mu_save "" UBYTE _CNV_A_R_LINEAR_____0_CM 1 100. 0. 255. DISPLAY_IDENTIFIER ERR_COD_MU_SAVE ECU_ADDRESS 0xd0008ad6 FORMAT "%3.0" /end MEASUREMENT
/begin MEASUREMENT rst_ctr_mc_save "" UBYTE _CNV_A_R_LINEAR_____0_CM 1 100. 0. 255. DISPLAY_IDENTIFIER RST_CTR_MC_SAVE ECU_ADDRESS 0xd0008ad7 FORMAT "%3.0" /end MEASUREMENT
/begin MEASUREMENT rst_ctr_mu_save "" UBYTE _CNV_A_R_LINEAR_____0_CM 1 100. 0. 255. DISPLAY_IDENTIFIER RST_CTR_MU_SAVE ECU_ADDRESS 0xd0008ad8 FORMAT "%3.0" /end MEASUREMENT
/begin MEASUREMENT lv_err_ram_mon_3 "" UBYTE _CNV_S_2_RANGE__0___1_CM 1 100. 0. 1. DISPLAY_IDENTIFIER LV_ERR_RAM_MON_3 ECU_ADDRESS 0xd0008ad9 /end MEASUREMENT
/begin MEASUREMENT lv_err_mon_3 "" UBYTE _CNV_S_2_RANGE__0___1_CM 1 100. 0. 1. DISPLAY_IDENTIFIER LV_ERR_MON_3 ECU_ADDRESS 0xd000804c /end MEASUREMENT
/begin MEASUREMENT pow_up_act "" UBYTE _CNV_A_R_LINEAR_____0_CM 1 100. 0. 255. DISPLAY_IDENTIFIER POW_UP_ACT ECU_ADDRESS 0xd00055dc FORMAT "%3.0" /end MEASUREMENT
/begin MEASUREMENT trm_buf_mc[0] "" UBYTE _CNV_A_R_LINEAR_____0_CM 1 100. 0. 255. DISPLAY_IDENTIFIER TRM_BUF_MC[0] ECU_ADDRESS 0xd00090c0 FORMAT "%3.0" /end MEASUREMENT
/begin MEASUREMENT trm_buf_mc[1] "" UBYTE _CNV_A_R_LINEAR_____0_CM 1 100. 0. 255. DISPLAY_IDENTIFIER TRM_BUF_MC[1] ECU_ADDRESS 0xd00090c1 FORMAT "%3.0" /end MEASUREMENT
/begin MEASUREMENT trm_buf_mc[2] "" UBYTE _CNV_A_R_LINEAR_____0_CM 1 100. 0. 255. DISPLAY_IDENTIFIER TRM_BUF_MC[2] ECU_ADDRESS 0xd00090c2 FORMAT "%3.0" /end MEASUREMENT
/begin MEASUREMENT trm_buf_mc[3] "" UBYTE _CNV_A_R_LINEAR_____0_CM 1 100. 0. 255. DISPLAY_IDENTIFIER TRM_BUF_MC[3] ECU_ADDRESS 0xd00090c3 FORMAT "%3.0" /end MEASUREMENT
/begin MEASUREMENT trm_buf_mc[4] "" UBYTE _CNV_A_R_LINEAR_____0_CM 1 100. 0. 255. DISPLAY_IDENTIFIER TRM_BUF_MC[4] ECU_ADDRESS 0xd00090c4 FORMAT "%3.0" /end MEASUREMENT
/begin MEASUREMENT rcv_buf_mc[0] "" UBYTE _CNV_A_R_LINEAR_____0_CM 1 100. 0. 255. DISPLAY_IDENTIFIER RCV_BUF_MC[0] ECU_ADDRESS 0xd00090c5 FORMAT "%3.0" /end MEASUREMENT
/begin MEASUREMENT rcv_buf_mc[1] "" UBYTE _CNV_A_R_LINEAR_____0_CM 1 100. 0. 255. DISPLAY_IDENTIFIER RCV_BUF_MC[1] ECU_ADDRESS 0xd00090c6 FORMAT "%3.0" /end MEASUREMENT
/begin MEASUREMENT rcv_buf_mc[2] "" UBYTE _CNV_A_R_LINEAR_____0_CM 1 100. 0. 255. DISPLAY_IDENTIFIER RCV_BUF_MC[2] ECU_ADDRESS 0xd00090c7 FORMAT "%3.0" /end MEASUREMENT
/begin MEASUREMENT rcv_buf_mc[3] "" UBYTE _CNV_A_R_LINEAR_____0_CM 1 100. 0. 255. DISPLAY_IDENTIFIER RCV_BUF_MC[3] ECU_ADDRESS 0xd00090c8 FORMAT "%3.0" /end MEASUREMENT
/begin MEASUREMENT rcv_buf_mc[4] "" UBYTE _CNV_A_R_LINEAR_____0_CM 1 100. 0. 255. DISPLAY_IDENTIFIER RCV_BUF_MC[4] ECU_ADDRESS 0xd00090c9 FORMAT "%3.0" /end MEASUREMENT
/begin MEASUREMENT rcv_buf_mc[5] "" UBYTE _CNV_A_R_LINEAR_____0_CM 1 100. 0. 255. DISPLAY_IDENTIFIER RCV_BUF_MC[5] ECU_ADDRESS 0xd00090ca FORMAT "%3.0" /end MEASUREMENT
/begin MEASUREMENT vp_mc_an_dig_mon_new "" UWORD _CNV_A_R_LINEAR_____0_CM 1 100. 0. 65535. DISPLAY_IDENTIFIER VP_MC_AN_DIG_MON_NEW ECU_ADDRESS 0xd000ac98 FORMAT "%5.0" /end MEASUREMENT
/begin MEASUREMENT vp_mc_an_dig_mon_new_cpl "" UWORD _CNV_A_R_LINEAR_____0_CM 1 100. 0. 65535. DISPLAY_IDENTIFIER VP_MC_AN_DIG_MON_NEW_CPL ECU_ADDRESS 0xd000ac9a FORMAT "%5.0" /end MEASUREMENT
/begin MEASUREMENT ctr_st_chk_lih_err[0] "Start check, limp home check 1 not passed" UWORD _CNV_A_R_LINEAR_____0_CM 1 100. 0. 65535. DISPLAY_IDENTIFIER CTR_ST_CHK_LIH_ERR[1] ECU_ADDRESS 0xd0007214 FORMAT "%5.0" /end MEASUREMENT
/begin MEASUREMENT ctr_st_chk_lih_err[1] "Start check, limp home check 1 not passed" UWORD _CNV_A_R_LINEAR_____0_CM 1 100. 0. 65535. DISPLAY_IDENTIFIER CTR_ST_CHK_LIH_ERR[2] ECU_ADDRESS 0xd0007216 FORMAT "%5.0" /end MEASUREMENT
/begin MEASUREMENT ctr_st_chk_lih_ok[0] "Start check, limp home check 1 passed" UWORD _CNV_A_R_LINEAR_____0_CM 1 100. 0. 65535. DISPLAY_IDENTIFIER CTR_ST_CHK_LIH_OK[1] ECU_ADDRESS 0xd0007218 FORMAT "%5.0" /end MEASUREMENT
/begin MEASUREMENT ctr_st_chk_lih_ok[1] "Start check, limp home check 1 passed" UWORD _CNV_A_R_LINEAR_____0_CM 1 100. 0. 65535. DISPLAY_IDENTIFIER CTR_ST_CHK_LIH_OK[2] ECU_ADDRESS 0xd000721a FORMAT "%5.0" /end MEASUREMENT
/begin CHARACTERISTIC c_t_max_tps_ad "Maximum time for Adaptation of the LIH and BOL position" VALUE 0xa08080c0 _REC_VAL_20_u1 1.275 _CNV_A_R_THRO_LINEA_889_CM 0. 1.275 DISPLAY_IDENTIFIER C_T_MAX_TPS_AD FORMAT "%5.3" /end CHARACTERISTIC
/begin CHARACTERISTIC c_t_max_tps_sp_rst_chk "Maximum time to reach the position C_TPS_SP_RST_CHK_BAS" VALUE 0xa08080c2 _REC_VAL_20_u1 1.275 _CNV_A_R_THRO_LINEA_889_CM 0. 1.275 DISPLAY_IDENTIFIER C_T_MAX_TPS_SP_RST_CHK FORMAT "%5.3" /end CHARACTERISTIC
/begin CHARACTERISTIC c_t_tps_ad_hys "Time period for hysteresis band to Adaptation" VALUE 0xa08080c3 _REC_VAL_20_u1 1.275 _CNV_A_R_THRO_LINEA_889_CM 0. 1.275 DISPLAY_IDENTIFIER C_T_TPS_AD_HYS FORMAT "%5.3" /end CHARACTERISTIC
/begin CHARACTERISTIC c_tps_sp_bol_lgrd "Change limitation for stopping the lower position" VALUE 0xa08080dc _REC_VAL_20_u1 1.85271317958707 _CNV_A_R_THRO_LINEA_890_CM 7.29414507874016e-003 1.86000732466581 DISPLAY_IDENTIFIER C_TPS_SP_BOL_LGRD FORMAT "%5.3" /end CHARACTERISTIC
/begin CHARACTERISTIC c_tps_sp_rst_chk_bas "TPS_SP for testing the retracting spring" VALUE 0xa08080ec _REC_VAL_20_u2 119.5 _CNV_A_R_LINEAR_____227_CM 0. 119.5 DISPLAY_IDENTIFIER C_TPS_SP_RST_CHK_BAS FORMAT "%7.3" /end CHARACTERISTIC
/begin CHARACTERISTIC c_tps_sp_rst_chk_hys "Hysteresis of C_TPS_SP_RST_CHK_BAS" VALUE 0xa08080ee _REC_VAL_20_u1 1.85271317958707 _CNV_A_R_THRO_LINEA_891_CM 7.29414507874016e-003 1.86000732466581 DISPLAY_IDENTIFIER C_TPS_SP_RST_CHK_HYS FORMAT "%5.3" /end CHARACTERISTIC
/begin CHARACTERISTIC c_tps_sp_rst_chk_lgrd "Change limitation for stopping the position C_TPS_SP_RST_CHK_BAS" VALUE 0xa08080ef _REC_VAL_20_u1 1.85271317958707 _CNV_A_R_THRO_LINEA_890_CM 7.29414507874016e-003 1.86000732466581 DISPLAY_IDENTIFIER C_TPS_SP_RST_CHK_LGRD FORMAT "%5.3" /end CHARACTERISTIC
/begin MEASUREMENT tps_lih_1[0] "Limp home position of the throttle valve of TPS 1" UWORD _CNV_A_R_LINEAR_____227_CM 1 100. 0. 119.5 DISPLAY_IDENTIFIER TPS_LIH_1[1] ECU_ADDRESS 0xd000723e FORMAT "%7.3" /end MEASUREMENT
/begin MEASUREMENT tps_lih_1[1] "Limp home position of the throttle valve of TPS 1" UWORD _CNV_A_R_LINEAR_____227_CM 1 100. 0. 119.5 DISPLAY_IDENTIFIER TPS_LIH_1[2] ECU_ADDRESS 0xd0007240 FORMAT "%7.3" /end MEASUREMENT
/begin MEASUREMENT tps_lih_2[0] "Limp home position  of the throttle valve of TPS 2" UWORD _CNV_A_R_LINEAR_____227_CM 1 100. 0. 119.5 DISPLAY_IDENTIFIER TPS_LIH_2[1] ECU_ADDRESS 0xd0007242 FORMAT "%7.3" /end MEASUREMENT
/begin MEASUREMENT tps_lih_2[1] "Limp home position  of the throttle valve of TPS 2" UWORD _CNV_A_R_LINEAR_____227_CM 1 100. 0. 119.5 DISPLAY_IDENTIFIER TPS_LIH_2[2] ECU_ADDRESS 0xd0007244 FORMAT "%7.3" /end MEASUREMENT
/begin CHARACTERISTIC c_tps_sp_spr_chk_up "TPS_SP for GO_LIH position" VALUE 0xa08080f0 _REC_VAL_20_u2 119.5 _CNV_A_R_LINEAR_____227_CM 0. 119.5 DISPLAY_IDENTIFIER C_TPS_SP_SPR_CHK_UP FORMAT "%7.3" /end CHARACTERISTIC
/begin MEASUREMENT tps_lih_ini[0] "Limp home position of the throttle valve - initialisation value" UWORD _CNV_A_R_LINEAR_____227_CM 1 100. 0. 119.5 DISPLAY_IDENTIFIER TPS_LIH_INI[1] ECU_ADDRESS 0xd0007246 FORMAT "%7.3" /end MEASUREMENT
/begin MEASUREMENT tps_lih_ini[1] "Limp home position of the throttle valve - initialisation value" UWORD _CNV_A_R_LINEAR_____227_CM 1 100. 0. 119.5 DISPLAY_IDENTIFIER TPS_LIH_INI[2] ECU_ADDRESS 0xd0007248 FORMAT "%7.3" /end MEASUREMENT
/begin CHARACTERISTIC c_t_dyw_tps_lih_chk "Time period for Dynamic window around Limp Home" VALUE 0xa08080bf _REC_VAL_20_u1 1.275 _CNV_A_R_THRO_LINEA_889_CM 0. 1.275 DISPLAY_IDENTIFIER C_T_DYW_TPS_LIH_CHK FORMAT "%5.3" /end CHARACTERISTIC
/begin MEASUREMENT lv_tps_ad_req_st_chk[0] "TPS start check adaptation request" UBYTE _CNV_S_2_RANGE__0___1_CM 1 100. 0. 1. DISPLAY_IDENTIFIER LV_TPS_AD_REQ_ST_CHK[1] ECU_ADDRESS 0xd000778e BIT_MASK 0x1 /end MEASUREMENT
/begin MEASUREMENT lv_tps_ad_req_st_chk[1] "TPS start check adaptation request" UBYTE _CNV_S_2_RANGE__0___1_CM 1 100. 0. 1. DISPLAY_IDENTIFIER LV_TPS_AD_REQ_ST_CHK[2] ECU_ADDRESS 0xd000778f BIT_MASK 0x1 /end MEASUREMENT
/begin MEASUREMENT tps_slop "Signal slope of throttle position sensor 1 and 2" UWORD _CNV_A_R_THRO_LINEA_892_CM 1 100. 0. 47.99926758 DISPLAY_IDENTIFIER TPS_SLOP ECU_ADDRESS 0xd000724e FORMAT "%7.4" /end MEASUREMENT
/begin CHARACTERISTIC c_t_max_tps_lih_chk "Maximum time for Limp Home recognition" VALUE 0xa08080c1 _REC_VAL_20_u1 1.275 _CNV_A_R_THRO_LINEA_889_CM 0. 1.275 DISPLAY_IDENTIFIER C_T_MAX_TPS_LIH_CHK FORMAT "%5.3" /end CHARACTERISTIC
/begin CHARACTERISTIC c_t_dly_tps_ad "Delay time after control unit is switched on" VALUE 0xa08080be _REC_VAL_20_u1 1.275 _CNV_A_R_THRO_LINEA_889_CM 0. 1.275 DISPLAY_IDENTIFIER C_T_DLY_TPS_AD FORMAT "%5.3" /end CHARACTERISTIC
/begin MEASUREMENT t_tps_bol_ofs_inc[0] "Waiting period before offset increase, continuously BOL adaptation" UWORD _CNV_A_R_LINEAR_____261_CM 1 100. 0. 2621.4 DISPLAY_IDENTIFIER T_TPS_BOL_OFS_INC[1] ECU_ADDRESS 0xd000394a FORMAT "%7.2" /end MEASUREMENT
/begin MEASUREMENT t_tps_bol_ofs_inc[1] "Waiting period before offset increase, continuously BOL adaptation" UWORD _CNV_A_R_LINEAR_____261_CM 1 100. 0. 2621.4 DISPLAY_IDENTIFIER T_TPS_BOL_OFS_INC[2] ECU_ADDRESS 0xd000394c FORMAT "%7.2" /end MEASUREMENT
/begin MEASUREMENT t_tps_bol_ofs_dec[0] "Waiting period before offset decrease, continuously BOL adaptation" UWORD _CNV_A_R_LINEAR_____261_CM 1 100. 0. 2621.4 DISPLAY_IDENTIFIER T_TPS_BOL_OFS_DEC[1] ECU_ADDRESS 0xd0003946 FORMAT "%7.2" /end MEASUREMENT
/begin MEASUREMENT t_tps_bol_ofs_dec[1] "Waiting period before offset decrease, continuously BOL adaptation" UWORD _CNV_A_R_LINEAR_____261_CM 1 100. 0. 2621.4 DISPLAY_IDENTIFIER T_TPS_BOL_OFS_DEC[2] ECU_ADDRESS 0xd0003948 FORMAT "%7.2" /end MEASUREMENT
/begin MEASUREMENT tps_ad_step[0] "Steps of throttle of the TPS adaptation or start check" UBYTE _CNV_S_13_THRO_RANGE_893_CM 1 100. 0. 12. DISPLAY_IDENTIFIER TPS_AD_STEP[1] ECU_ADDRESS 0xd0007760 /end MEASUREMENT
/begin MEASUREMENT tps_ad_step[1] "Steps of throttle of the TPS adaptation or start check" UBYTE _CNV_S_13_THRO_RANGE_893_CM 1 100. 0. 12. DISPLAY_IDENTIFIER TPS_AD_STEP[2] ECU_ADDRESS 0xd0007761 /end MEASUREMENT
/begin MEASUREMENT state_tps_bol_ad[0] "State vaiable indicates the state of the continuously BOL adaptation" UBYTE _CNV_S_4_THRO_RANGE_894_CM 1 100. 0. 3. DISPLAY_IDENTIFIER STATE_TPS_BOL_AD[1] ECU_ADDRESS 0xd0003988 /end MEASUREMENT
/begin MEASUREMENT state_tps_bol_ad[1] "State vaiable indicates the state of the continuously BOL adaptation" UBYTE _CNV_S_4_THRO_RANGE_894_CM 1 100. 0. 3. DISPLAY_IDENTIFIER STATE_TPS_BOL_AD[2] ECU_ADDRESS 0xd0003989 /end MEASUREMENT
/begin CHARACTERISTIC c_pwm_tps_bol "PWM threshold for the selection between offset increasing and decreasing" VALUE 0xa08080bc _REC_VAL_20_s2 199.9969482421875 _CNV_A_R_LINEAR_____212_CM -100. 99.9969482421875 DISPLAY_IDENTIFIER C_PWM_TPS_BOL FORMAT "%8.3" /end CHARACTERISTIC
/begin CHARACTERISTIC c_tco_min_tps_bol "Minimum temperature threshold of the continuously BOL adaptation" VALUE 0xa08080cb _REC_VAL_20_u1 190.5 _CNV_A_R_LINEAR_____17_CM -48. 142.5 DISPLAY_IDENTIFIER C_TCO_MIN_TPS_BOL FORMAT "%6.2" /end CHARACTERISTIC
/begin CHARACTERISTIC c_t_tps_bol_ofs_inc "Waiting period before offset increase, continuously BOL adaptation" VALUE 0xa08080c6 _REC_VAL_20_u2 2621.4 _CNV_A_R_LINEAR_____261_CM 0. 2621.4 DISPLAY_IDENTIFIER C_T_TPS_BOL_OFS_INC FORMAT "%7.2" /end CHARACTERISTIC
/begin CHARACTERISTIC c_t_tps_bol_ofs_dec "Waiting period before offset decrease, continuously BOL adaptation" VALUE 0xa08080c4 _REC_VAL_20_u2 2621.4 _CNV_A_R_LINEAR_____261_CM 0. 2621.4 DISPLAY_IDENTIFIER C_T_TPS_BOL_OFS_DEC FORMAT "%7.2" /end CHARACTERISTIC
/begin CHARACTERISTIC c_tps_sp_tps_bol "Throttle position setpoint threshold of the continuously BOL adaptation" VALUE 0xa08080f2 _REC_VAL_20_u2 119.5 _CNV_A_R_LINEAR_____227_CM 0. 119.5 DISPLAY_IDENTIFIER C_TPS_SP_TPS_BOL FORMAT "%7.3" /end CHARACTERISTIC
/begin MEASUREMENT lv_tps_ad_etc_off[0] "Logical variable to switch off the ETC controller during TPS adaptation" UBYTE _CNV_S_2_RANGE__0___1_CM 1 100. 0. 1. DISPLAY_IDENTIFIER LV_TPS_AD_ETC_OFF[1] ECU_ADDRESS 0xd000778a BIT_MASK 0x1 /end MEASUREMENT
/begin MEASUREMENT lv_tps_ad_etc_off[1] "Logical variable to switch off the ETC controller during TPS adaptation" UBYTE _CNV_S_2_RANGE__0___1_CM 1 100. 0. 1. DISPLAY_IDENTIFIER LV_TPS_AD_ETC_OFF[2] ECU_ADDRESS 0xd000778b BIT_MASK 0x1 /end MEASUREMENT
/begin MEASUREMENT lv_inh_iv_tps_ad[0] "Logical variable to inhibit injection and ignition during TPS adaptation" UBYTE _CNV_S_2_RANGE__0___1_CM 1 100. 0. 1. DISPLAY_IDENTIFIER LV_INH_IV_TPS_AD[1] ECU_ADDRESS 0xd000777a BIT_MASK 0x1 /end MEASUREMENT
/begin MEASUREMENT lv_inh_iv_tps_ad[1] "Logical variable to inhibit injection and ignition during TPS adaptation" UBYTE _CNV_S_2_RANGE__0___1_CM 1 100. 0. 1. DISPLAY_IDENTIFIER LV_INH_IV_TPS_AD[2] ECU_ADDRESS 0xd000777b BIT_MASK 0x1 /end MEASUREMENT
/begin CHARACTERISTIC lc_tps_ad_lih_ena "Switch on of the continuously LIH adaptation " VALUE 0xa080811a _REC_VAL_20_u1 1. _CNV_A_R_LINEAR_____0_CM 0. 1. DISPLAY_IDENTIFIER LC_TPS_AD_LIH_ENA FORMAT "%1.0" /end CHARACTERISTIC
/begin MEASUREMENT tps_sp_ad[0] "Throttle position setpoint during Adaptation" UWORD _CNV_A_R_LINEAR_____227_CM 1 100. 0. 119.5 DISPLAY_IDENTIFIER TPS_SP_AD[1] ECU_ADDRESS 0xd0007254 FORMAT "%7.3" /end MEASUREMENT
/begin MEASUREMENT tps_sp_ad[1] "Throttle position setpoint during Adaptation" UWORD _CNV_A_R_LINEAR_____227_CM 1 100. 0. 119.5 DISPLAY_IDENTIFIER TPS_SP_AD[2] ECU_ADDRESS 0xd0007256 FORMAT "%7.3" /end MEASUREMENT
/begin CHARACTERISTIC c_tps_slop "Signal slope of the throttle position senor 1 and 2" VALUE 0xa08080d8 _REC_VAL_20_u2 47.99926758000001 _CNV_A_R_THRO_LINEA_892_CM 0. 47.99926758 DISPLAY_IDENTIFIER C_TPS_SLOP FORMAT "%7.4" /end CHARACTERISTIC
/begin CHARACTERISTIC c_crlc_tps_ad "Correlation constant for the determination of the adaptation values" VALUE 0xa08080a0 _REC_VAL_20_u1 0.99609375 _CNV_A_R_LINEAR_____185_CM 0. 0.99609375 DISPLAY_IDENTIFIER C_CRLC_TPS_AD FORMAT "%5.3" /end CHARACTERISTIC
/begin CHARACTERISTIC c_tps_lih_ini "Initialisation value of the limp-home position in case of adaptation errors" VALUE 0xa08080d0 _REC_VAL_20_u2 119.5 _CNV_A_R_LINEAR_____227_CM 0. 119.5 DISPLAY_IDENTIFIER C_TPS_LIH_INI FORMAT "%7.3" /end CHARACTERISTIC
/begin MEASUREMENT v_tps_ad_el_bol_1[0] "Temporary adaptation value for the lower stop, TPS-channel 1" UWORD _CNV_A_R_LINEAR_____2_CM 1 100. 0. 4.9951171875 DISPLAY_IDENTIFIER V_TPS_AD_EL_BOL_1[1] ECU_ADDRESS 0xd0007276 FORMAT "%5.3" /end MEASUREMENT
/begin MEASUREMENT v_tps_ad_el_bol_1[1] "Temporary adaptation value for the lower stop, TPS-channel 1" UWORD _CNV_A_R_LINEAR_____2_CM 1 100. 0. 4.9951171875 DISPLAY_IDENTIFIER V_TPS_AD_EL_BOL_1[2] ECU_ADDRESS 0xd0007278 FORMAT "%5.3" /end MEASUREMENT
/begin MEASUREMENT vp_tps_ad_el_bol_1[0] "Temporary adaptation value for the lower stop, TPS-channel 1" SWORD _CNV_A_R_THRO_LINEA_895_CM 1 100. -5. 4.99984741210938 DISPLAY_IDENTIFIER VP_TPS_AD_EL_BOL_1[1] ECU_ADDRESS 0xd000728e FORMAT "%7.4" /end MEASUREMENT
/begin MEASUREMENT vp_tps_ad_el_bol_1[1] "Temporary adaptation value for the lower stop, TPS-channel 1" SWORD _CNV_A_R_THRO_LINEA_895_CM 1 100. -5. 4.99984741210938 DISPLAY_IDENTIFIER VP_TPS_AD_EL_BOL_1[2] ECU_ADDRESS 0xd0007290 FORMAT "%7.4" /end MEASUREMENT
/begin MEASUREMENT v_tps_ad_el_bol_2[0] "Temporary adaptation value for the lower stop, TPS-channel 2" UWORD _CNV_A_R_LINEAR_____2_CM 1 100. 0. 4.9951171875 DISPLAY_IDENTIFIER V_TPS_AD_EL_BOL_2[1] ECU_ADDRESS 0xd000727a FORMAT "%5.3" /end MEASUREMENT
/begin MEASUREMENT v_tps_ad_el_bol_2[1] "Temporary adaptation value for the lower stop, TPS-channel 2" UWORD _CNV_A_R_LINEAR_____2_CM 1 100. 0. 4.9951171875 DISPLAY_IDENTIFIER V_TPS_AD_EL_BOL_2[2] ECU_ADDRESS 0xd000727c FORMAT "%5.3" /end MEASUREMENT
/begin MEASUREMENT vp_tps_ad_el_bol_2[0] "Temporary adaptation value for the lower stop, TPS-channel 2" SWORD _CNV_A_R_THRO_LINEA_895_CM 1 100. -5. 4.99984741210938 DISPLAY_IDENTIFIER VP_TPS_AD_EL_BOL_2[1] ECU_ADDRESS 0xd0007292 FORMAT "%7.4" /end MEASUREMENT
/begin MEASUREMENT vp_tps_ad_el_bol_2[1] "Temporary adaptation value for the lower stop, TPS-channel 2" SWORD _CNV_A_R_THRO_LINEA_895_CM 1 100. -5. 4.99984741210938 DISPLAY_IDENTIFIER VP_TPS_AD_EL_BOL_2[2] ECU_ADDRESS 0xd0007294 FORMAT "%7.4" /end MEASUREMENT
/begin MEASUREMENT vp_tps_bol_ofs[0] "Temporary offset of the continuously BOL adaptation" SWORD _CNV_A_R_THRO_LINEA_895_CM 1 100. -5. 4.99984741210938 DISPLAY_IDENTIFIER VP_TPS_BOL_OFS[1] ECU_ADDRESS 0xd0003980 FORMAT "%7.4" /end MEASUREMENT
/begin MEASUREMENT vp_tps_bol_ofs[1] "Temporary offset of the continuously BOL adaptation" SWORD _CNV_A_R_THRO_LINEA_895_CM 1 100. -5. 4.99984741210938 DISPLAY_IDENTIFIER VP_TPS_BOL_OFS[2] ECU_ADDRESS 0xd0003982 FORMAT "%7.4" /end MEASUREMENT
/begin MEASUREMENT vp_tps_ad_lih_1[0] "Adaptation value for the limp home position, TPS-channel 1" SWORD _CNV_A_R_THRO_LINEA_895_CM 1 100. -5. 4.99984741210938 DISPLAY_IDENTIFIER VP_TPS_AD_LIH_1[1] ECU_ADDRESS 0xd0007296 FORMAT "%7.4" /end MEASUREMENT
/begin MEASUREMENT vp_tps_ad_lih_1[1] "Adaptation value for the limp home position, TPS-channel 1" SWORD _CNV_A_R_THRO_LINEA_895_CM 1 100. -5. 4.99984741210938 DISPLAY_IDENTIFIER VP_TPS_AD_LIH_1[2] ECU_ADDRESS 0xd0007298 FORMAT "%7.4" /end MEASUREMENT
/begin MEASUREMENT vp_tps_ad_lih_2[0] "Adaptation value for the limp home position, TPS-channel 2" SWORD _CNV_A_R_THRO_LINEA_895_CM 1 100. -5. 4.99984741210938 DISPLAY_IDENTIFIER VP_TPS_AD_LIH_2[1] ECU_ADDRESS 0xd000729a FORMAT "%7.4" /end MEASUREMENT
/begin MEASUREMENT vp_tps_ad_lih_2[1] "Adaptation value for the limp home position, TPS-channel 2" SWORD _CNV_A_R_THRO_LINEA_895_CM 1 100. -5. 4.99984741210938 DISPLAY_IDENTIFIER VP_TPS_AD_LIH_2[2] ECU_ADDRESS 0xd000729c FORMAT "%7.4" /end MEASUREMENT
/begin MEASUREMENT vp_tps_ad_bol_1[0] "Adaptation value for the lower stop, TPS-channel 1" SWORD _CNV_A_R_THRO_LINEA_895_CM 1 100. -5. 4.99984741210938 DISPLAY_IDENTIFIER VP_TPS_AD_BOL_1[1] ECU_ADDRESS 0xd0003978 FORMAT "%7.4" /end MEASUREMENT
/begin MEASUREMENT vp_tps_ad_bol_1[1] "Adaptation value for the lower stop, TPS-channel 1" SWORD _CNV_A_R_THRO_LINEA_895_CM 1 100. -5. 4.99984741210938 DISPLAY_IDENTIFIER VP_TPS_AD_BOL_1[2] ECU_ADDRESS 0xd000397a FORMAT "%7.4" /end MEASUREMENT
/begin MEASUREMENT vp_tps_ad_bol_2[0] "Adaptation value for the lower stop, TPS-channel 2" SWORD _CNV_A_R_THRO_LINEA_895_CM 1 100. -5. 4.99984741210938 DISPLAY_IDENTIFIER VP_TPS_AD_BOL_2[1] ECU_ADDRESS 0xd000397c FORMAT "%7.4" /end MEASUREMENT
/begin MEASUREMENT vp_tps_ad_bol_2[1] "Adaptation value for the lower stop, TPS-channel 2" SWORD _CNV_A_R_THRO_LINEA_895_CM 1 100. -5. 4.99984741210938 DISPLAY_IDENTIFIER VP_TPS_AD_BOL_2[2] ECU_ADDRESS 0xd000397e FORMAT "%7.4" /end MEASUREMENT
/begin CHARACTERISTIC c_vp_tps_ad_bol_ini_1 "Start adaptation value for the lower mechanical stop (TPS1)" VALUE 0xa08080f8 _REC_VAL_20_s2 9.99984741210938 _CNV_A_R_THRO_LINEA_895_CM -5. 4.99984741210938 DISPLAY_IDENTIFIER C_VP_TPS_AD_BOL_INI_1 FORMAT "%7.4" /end CHARACTERISTIC
/begin CHARACTERISTIC c_vp_tps_ad_bol_ini_2 "Start adaptation value for the lower mechanical stop (TPS2)" VALUE 0xa08080fa _REC_VAL_20_s2 9.99984741210938 _CNV_A_R_THRO_LINEA_895_CM -5. 4.99984741210938 DISPLAY_IDENTIFIER C_VP_TPS_AD_BOL_INI_2 FORMAT "%7.4" /end CHARACTERISTIC
/begin CHARACTERISTIC c_vp_tps_ad_hys "Hysteresis band for Adaptation value determination" VALUE 0xa08080fc _REC_VAL_20_s2 9.99984741210938 _CNV_A_R_THRO_LINEA_895_CM -5. 4.99984741210938 DISPLAY_IDENTIFIER C_VP_TPS_AD_HYS FORMAT "%7.4" /end CHARACTERISTIC
/begin CHARACTERISTIC c_vp_tps_ad_win_bol "Adaptation window size (+/-) for Adaptation of lower stop" VALUE 0xa08080fe _REC_VAL_20_s2 9.99984741210938 _CNV_A_R_THRO_LINEA_895_CM -5. 4.99984741210938 DISPLAY_IDENTIFIER C_VP_TPS_AD_WIN_BOL FORMAT "%7.4" /end CHARACTERISTIC
/begin CHARACTERISTIC c_vp_tps_ad_win_lih "Adaptation window size (+/-) for Adaptation of the Limp Home position" VALUE 0xa0808100 _REC_VAL_20_s2 9.99984741210938 _CNV_A_R_THRO_LINEA_895_CM -5. 4.99984741210938 DISPLAY_IDENTIFIER C_VP_TPS_AD_WIN_LIH FORMAT "%7.4" /end CHARACTERISTIC
/begin CHARACTERISTIC c_vp_tps_bol_ofs_cor "Offset incement of one correction step in the continuously BOL adaptation" VALUE 0xa0808102 _REC_VAL_20_s2 9.99984741210938 _CNV_A_R_THRO_LINEA_895_CM -5. 4.99984741210938 DISPLAY_IDENTIFIER C_VP_TPS_BOL_OFS_COR FORMAT "%7.4" /end CHARACTERISTIC
/begin CHARACTERISTIC c_vp_tps_bol_ofs_max "Maximum adaptation offset of the continuously BOL adaptation" VALUE 0xa0808104 _REC_VAL_20_s2 9.99984741210938 _CNV_A_R_THRO_LINEA_895_CM -5. 4.99984741210938 DISPLAY_IDENTIFIER C_VP_TPS_BOL_OFS_MAX FORMAT "%7.4" /end CHARACTERISTIC
/begin CHARACTERISTIC c_vp_tps_lih_chk_hys "Admissible tolerance on checking the limp home position" VALUE 0xa0808108 _REC_VAL_20_s2 9.99984741210938 _CNV_A_R_THRO_LINEA_895_CM -5. 4.99984741210938 DISPLAY_IDENTIFIER C_VP_TPS_LIH_CHK_HYS FORMAT "%7.4" /end CHARACTERISTIC
/begin CHARACTERISTIC c_vp_tps_sp_bol_1 "Lower limit for plausibility check of the adaptation value lower stop TPS1" VALUE 0xa0808112 _REC_VAL_20_s2 9.99984741210938 _CNV_A_R_THRO_LINEA_895_CM -5. 4.99984741210938 DISPLAY_IDENTIFIER C_VP_TPS_SP_BOL_1 FORMAT "%7.4" /end CHARACTERISTIC
/begin CHARACTERISTIC c_vp_tps_sp_bol_2 "Lower limit for plausibility check of the adaptation value lower stop TPS2" VALUE 0xa0808114 _REC_VAL_20_s2 9.99984741210938 _CNV_A_R_THRO_LINEA_895_CM -5. 4.99984741210938 DISPLAY_IDENTIFIER C_VP_TPS_SP_BOL_2 FORMAT "%7.4" /end CHARACTERISTIC
/begin CHARACTERISTIC c_vp_tps_sp_lih_1 "Setpoint of the limp Home position, voltage value TPS1" VALUE 0xa0808116 _REC_VAL_20_s2 9.99984741210938 _CNV_A_R_THRO_LINEA_895_CM -5. 4.99984741210938 DISPLAY_IDENTIFIER C_VP_TPS_SP_LIH_1 FORMAT "%7.4" /end CHARACTERISTIC
/begin CHARACTERISTIC c_vp_tps_sp_lih_2 "Setpoint of the limp Home position, voltage value TPS2" VALUE 0xa0808118 _REC_VAL_20_s2 9.99984741210938 _CNV_A_R_THRO_LINEA_895_CM -5. 4.99984741210938 DISPLAY_IDENTIFIER C_VP_TPS_SP_LIH_2 FORMAT "%7.4" /end CHARACTERISTIC
/begin MEASUREMENT lv_err_tps_ad_1 "Logical variable is set, if an adaptation error occurs" UBYTE _CNV_S_2_RANGE__0___1_CM 1 100. 0. 1. DISPLAY_IDENTIFIER LV_ERR_TPS_AD[1] ECU_ADDRESS 0xd000805d BIT_MASK 0x1 /end MEASUREMENT
/begin MEASUREMENT lv_err_tps_ad_2 "Logical variable is set, if an adaptation error occurs" UBYTE _CNV_S_2_RANGE__0___1_CM 1 100. 0. 1. DISPLAY_IDENTIFIER LV_ERR_TPS_AD[2] ECU_ADDRESS 0xd000805e BIT_MASK 0x1 /end MEASUREMENT
/begin MEASUREMENT lv_err_tps_ad_spr_1 "Logical variable is set, if a spring check error occurs during the adaptation" UBYTE _CNV_S_2_RANGE__0___1_CM 1 100. 0. 1. DISPLAY_IDENTIFIER LV_ERR_TPS_AD_SPR[1] ECU_ADDRESS 0xd0008063 BIT_MASK 0x1 /end MEASUREMENT
/begin MEASUREMENT lv_err_tps_ad_spr_2 "Logical variable is set, if a spring check error occurs during the adaptation" UBYTE _CNV_S_2_RANGE__0___1_CM 1 100. 0. 1. DISPLAY_IDENTIFIER LV_ERR_TPS_AD_SPR[2] ECU_ADDRESS 0xd0008064 BIT_MASK 0x1 /end MEASUREMENT
/begin MEASUREMENT lv_err_tps_st_chk_1 "Logical variable is set, if an error occurs in the TPS start check" UBYTE _CNV_S_2_RANGE__0___1_CM 1 100. 0. 1. DISPLAY_IDENTIFIER LV_ERR_TPS_ST_CHK[1] ECU_ADDRESS 0xd0008067 BIT_MASK 0x1 /end MEASUREMENT
/begin MEASUREMENT lv_err_tps_st_chk_2 "Logical variable is set, if an error occurs in the TPS start check" UBYTE _CNV_S_2_RANGE__0___1_CM 1 100. 0. 1. DISPLAY_IDENTIFIER LV_ERR_TPS_ST_CHK[2] ECU_ADDRESS 0xd0008068 BIT_MASK 0x1 /end MEASUREMENT
/begin CHARACTERISTIC c_tco_min_tps_ad "minimum TCO threshold for TPS adaptation" VALUE 0xa08080ca _REC_VAL_20_u1 190.5 _CNV_A_R_LINEAR_____17_CM -48. 142.5 DISPLAY_IDENTIFIER C_TCO_MIN_TPS_AD FORMAT "%6.2" /end CHARACTERISTIC
/begin CHARACTERISTIC c_tia_min_tps_ad "TIA threshold for TPS adaptation" VALUE 0xa08080cc _REC_VAL_20_u1 190.5 _CNV_A_R_LINEAR_____17_CM -48. 142.5 DISPLAY_IDENTIFIER C_TIA_MIN_TPS_AD FORMAT "%6.2" /end CHARACTERISTIC
/begin CHARACTERISTIC c_vb_min_tps_ad "VB threshold for ETC adaptation" VALUE 0xa08080f6 _REC_VAL_20_u1 25.8984375 _CNV_A_R_LINEAR_____272_CM 0. 25.8984375 DISPLAY_IDENTIFIER C_VB_MIN_TPS_AD FORMAT "%9.6" /end CHARACTERISTIC
/begin MEASUREMENT lv_tps_ad_act[0] "Logical variable to indicate an active or passive TPS adaptation" UBYTE _CNV_S_2_RANGE__0___1_CM 1 100. 0. 1. DISPLAY_IDENTIFIER LV_TPS_AD_ACT[1] ECU_ADDRESS 0xd0007788 BIT_MASK 0x1 /end MEASUREMENT
/begin MEASUREMENT lv_tps_ad_act[1] "Logical variable to indicate an active or passive TPS adaptation" UBYTE _CNV_S_2_RANGE__0___1_CM 1 100. 0. 1. DISPLAY_IDENTIFIER LV_TPS_AD_ACT[2] ECU_ADDRESS 0xd0007789 BIT_MASK 0x1 /end MEASUREMENT
/begin MEASUREMENT lv_tps_ad_req[0] "Logical variable to request a TPS adaptation" UBYTE _CNV_S_2_RANGE__0___1_CM 1 100. 0. 1. DISPLAY_IDENTIFIER LV_TPS_AD_REQ[1] ECU_ADDRESS 0xd000778c BIT_MASK 0x1 /end MEASUREMENT
/begin MEASUREMENT lv_tps_ad_req[1] "Logical variable to request a TPS adaptation" UBYTE _CNV_S_2_RANGE__0___1_CM 1 100. 0. 1. DISPLAY_IDENTIFIER LV_TPS_AD_REQ[2] ECU_ADDRESS 0xd000778d BIT_MASK 0x1 /end MEASUREMENT
/begin CHARACTERISTIC c_tco_max_tps_ad "maximum TCO threshold for TPS adaptation" VALUE 0xa08080c9 _REC_VAL_20_u1 190.5 _CNV_A_R_LINEAR_____17_CM -48. 142.5 DISPLAY_IDENTIFIER C_TCO_MAX_TPS_AD FORMAT "%6.2" /end CHARACTERISTIC
/begin CHARACTERISTIC c_n_max_tps_ad "Maximum engine speed for adaptation" VALUE 0xa08080b6 _REC_VAL_20_u1 8160. _CNV_A_R_LINEAR_____10_CM 0. 8160. DISPLAY_IDENTIFIER C_N_MAX_TPS_AD FORMAT "%4.0" /end CHARACTERISTIC
/begin CHARACTERISTIC lc_tps_ad_req "Logical variable to set a new adaptation request" VALUE 0xa080811b _REC_VAL_20_u1 1. _CNV_A_R_LINEAR_____0_CM 0. 1. DISPLAY_IDENTIFIER LC_TPS_AD_REQ FORMAT "%1.0" /end CHARACTERISTIC
/begin MEASUREMENT lv_inh_tps_ad[0] "Logical variable to inhibit the TPS adaptation" UBYTE _CNV_S_2_RANGE__0___1_CM 1 100. 0. 1. DISPLAY_IDENTIFIER LV_INH_TPS_AD[1] ECU_ADDRESS 0xd000777c BIT_MASK 0x1 /end MEASUREMENT
/begin MEASUREMENT lv_inh_tps_ad[1] "Logical variable to inhibit the TPS adaptation" UBYTE _CNV_S_2_RANGE__0___1_CM 1 100. 0. 1. DISPLAY_IDENTIFIER LV_INH_TPS_AD[2] ECU_ADDRESS 0xd000777d BIT_MASK 0x1 /end MEASUREMENT
/begin MEASUREMENT lv_err_cur_etc_dr[0] "Logical variable to indicate the error between actual and requested ETC current" UBYTE _CNV_S_2_RANGE__0___1_CM 1 100. 0. 1. DISPLAY_IDENTIFIER LV_ERR_CUR_ETC_DR[1] ECU_ADDRESS 0xd000398c BIT_MASK 0x1 /end MEASUREMENT
/begin MEASUREMENT lv_err_cur_etc_dr[1] "Logical variable to indicate the error between actual and requested ETC current" UBYTE _CNV_S_2_RANGE__0___1_CM 1 100. 0. 1. DISPLAY_IDENTIFIER LV_ERR_CUR_ETC_DR[2] ECU_ADDRESS 0xd000398d BIT_MASK 0x1 /end MEASUREMENT
/begin CHARACTERISTIC c_cur_etc_dr_tps_ad "Coded information about the ETC power stage state during the steps of the adaptation" VALUE 0xa08080a6 _REC_VAL_20_u2 65535. _CNV_A_R_LINEAR_____0_CM 0. 65535. DISPLAY_IDENTIFIER C_CUR_ETC_DR_TPS_AD FORMAT "%5.0" /end CHARACTERISTIC
/begin CHARACTERISTIC c_ctr_err_cur_etc_dr "Debounce counter for the error between actual and requested ETC current" VALUE 0xa08080a4 _REC_VAL_20_u1 255. _CNV_A_R_LINEAR_____0_CM 0. 255. DISPLAY_IDENTIFIER C_CTR_ERR_CUR_ETC_DR FORMAT "%3.0" /end CHARACTERISTIC
/begin CHARACTERISTIC c_tps_sp_min_tps_ad_req "Lower limit of the throttle position setpoint without throttle Adaptation" VALUE 0xa08080e6 _REC_VAL_20_u2 119.5 _CNV_A_R_LINEAR_____227_CM 0. 119.5 DISPLAY_IDENTIFIER C_TPS_SP_MIN_TPS_AD_REQ FORMAT "%7.3" /end CHARACTERISTIC
/begin CHARACTERISTIC c_tps_sp_max_tps_ad_req "Upper limit of the throttle position setpoint without throttle Adaptation" VALUE 0xa08080e2 _REC_VAL_20_u2 119.5 _CNV_A_R_LINEAR_____227_CM 0. 119.5 DISPLAY_IDENTIFIER C_TPS_SP_MAX_TPS_AD_REQ FORMAT "%7.3" /end CHARACTERISTIC
/begin CHARACTERISTIC c_tps_sp_max "Upper limit of the throttle position setpoint" VALUE 0xa08080e0 _REC_VAL_20_u2 119.5 _CNV_A_R_LINEAR_____227_CM 0. 119.5 DISPLAY_IDENTIFIER C_TPS_SP_MAX FORMAT "%7.3" /end CHARACTERISTIC
/begin CHARACTERISTIC ip_tps_sp_lgrd_st "Admissible gradient of throttle position setpoint for transient phase after start" MAP 0xa08136c4 _REC_MAP_20_u2_u2_u1 119.4927058536288 _CNV_A_R_LINEAR_____896_CM 7.29414637123848e-003 119.5 DISPLAY_IDENTIFIER IP_TPS_SP_LGRD_ST FORMAT "%7.3"
 /begin AXIS_DESCR COM_AXIS n _CNV_A_R_LINEAR_____14_CM 8 0. 8160. FORMAT "%4.0" AXIS_PTS_REF ldp_n_ip_tps_sp_lgrd_st /end AXIS_DESCR
 /begin AXIS_DESCR COM_AXIS tco _CNV_A_R_LINEAR_____17_CM 8 -48. 142.5 FORMAT "%6.2" AXIS_PTS_REF ldp_tco_ip_tps_sp_lgrd_st /end AXIS_DESCR
/end CHARACTERISTIC
/begin AXIS_PTS ldp_n_ip_tps_sp_lgrd_st "" 0xa0808020 n _REC_AXS_20_u2 8160. _CNV_A_R_LINEAR_____14_CM 8 0. 8160. FORMAT "%4.0" /end AXIS_PTS
/begin AXIS_PTS ldp_tco_ip_tps_sp_lgrd_st "" 0xa0808044 tco _REC_AXS_20_u1 190.5 _CNV_A_R_LINEAR_____17_CM 8 -48. 142.5 FORMAT "%6.2" /end AXIS_PTS
/begin MEASUREMENT tps_sp[0] "Throttle position setpoint for electronic throttle control" UWORD _CNV_A_R_LINEAR_____227_CM 1 100. 0. 119.5 DISPLAY_IDENTIFIER TPS_SP[1] ECU_ADDRESS 0xd0007250 FORMAT "%7.3" /end MEASUREMENT
/begin MEASUREMENT tps_sp[1] "Throttle position setpoint for electronic throttle control" UWORD _CNV_A_R_LINEAR_____227_CM 1 100. 0. 119.5 DISPLAY_IDENTIFIER TPS_SP[2] ECU_ADDRESS 0xd0007252 FORMAT "%7.3" /end MEASUREMENT
/begin MEASUREMENT state_tps_sp_tra_dir[0] "The state variable indicates the direction of the transient phase" UBYTE _CNV_S_3_THRO_RANGE_897_CM 1 100. 0. 2. DISPLAY_IDENTIFIER STATE_TPS_SP_TRA_DIR[1] ECU_ADDRESS 0xd000398a /end MEASUREMENT
/begin MEASUREMENT state_tps_sp_tra_dir[1] "The state variable indicates the direction of the transient phase" UBYTE _CNV_S_3_THRO_RANGE_897_CM 1 100. 0. 2. DISPLAY_IDENTIFIER STATE_TPS_SP_TRA_DIR[2] ECU_ADDRESS 0xd000398b /end MEASUREMENT
/begin MEASUREMENT tps_sp_sel[0] "Unlimited throttle position setpoint after selection" UWORD _CNV_A_R_LINEAR_____227_CM 1 100. 0. 119.5 DISPLAY_IDENTIFIER TPS_SP_SEL[1] ECU_ADDRESS 0xd000726c FORMAT "%7.3" /end MEASUREMENT
/begin MEASUREMENT tps_sp_sel[1] "Unlimited throttle position setpoint after selection" UWORD _CNV_A_R_LINEAR_____227_CM 1 100. 0. 119.5 DISPLAY_IDENTIFIER TPS_SP_SEL[2] ECU_ADDRESS 0xd000726e FORMAT "%7.3" /end MEASUREMENT
/begin MEASUREMENT tps_sp_req[0] "Throttle position setpoint request before final limitation" UWORD _CNV_A_R_LINEAR_____227_CM 1 100. 0. 119.5 DISPLAY_IDENTIFIER TPS_SP_REQ[1] ECU_ADDRESS 0xd0003974 FORMAT "%7.3" /end MEASUREMENT
/begin MEASUREMENT tps_sp_req[1] "Throttle position setpoint request before final limitation" UWORD _CNV_A_R_LINEAR_____227_CM 1 100. 0. 119.5 DISPLAY_IDENTIFIER TPS_SP_REQ[2] ECU_ADDRESS 0xd0003976 FORMAT "%7.3" /end MEASUREMENT
/begin MEASUREMENT tps_sp_max[0] "Upper threshold for throttle position setpoint limitation after ETC jam request" UWORD _CNV_A_R_LINEAR_____227_CM 1 100. 0. 119.5 DISPLAY_IDENTIFIER TPS_SP_MAX[1] ECU_ADDRESS 0xd0003970 FORMAT "%7.3" /end MEASUREMENT
/begin MEASUREMENT tps_sp_max[1] "Upper threshold for throttle position setpoint limitation after ETC jam request" UWORD _CNV_A_R_LINEAR_____227_CM 1 100. 0. 119.5 DISPLAY_IDENTIFIER TPS_SP_MAX[2] ECU_ADDRESS 0xd0003972 FORMAT "%7.3" /end MEASUREMENT
/begin MEASUREMENT lv_tps_sp_tra_st_mdl[0] "Logical variable indicates the transient phase of throttle position setpoint after start" UBYTE _CNV_S_2_RANGE__0___1_CM 1 100. 0. 1. DISPLAY_IDENTIFIER LV_TPS_SP_TRA_ST_MDL[1] ECU_ADDRESS 0xd0003990 BIT_MASK 0x1 /end MEASUREMENT
/begin MEASUREMENT lv_tps_sp_tra_st_mdl[1] "Logical variable indicates the transient phase of throttle position setpoint after start" UBYTE _CNV_S_2_RANGE__0___1_CM 1 100. 0. 1. DISPLAY_IDENTIFIER LV_TPS_SP_TRA_ST_MDL[2] ECU_ADDRESS 0xd0003991 BIT_MASK 0x1 /end MEASUREMENT
/begin MEASUREMENT lv_tps_sp_tra_jam_sel[0] "Logical variable indicates the transient phase of the throttle position setpoint after ETC jam request" UBYTE _CNV_S_2_RANGE__0___1_CM 1 100. 0. 1. DISPLAY_IDENTIFIER LV_TPS_SP_TRA_JAM_SEL[1] ECU_ADDRESS 0xd000398e BIT_MASK 0x1 /end MEASUREMENT
/begin MEASUREMENT lv_tps_sp_tra_jam_sel[1] "Logical variable indicates the transient phase of the throttle position setpoint after ETC jam request" UBYTE _CNV_S_2_RANGE__0___1_CM 1 100. 0. 1. DISPLAY_IDENTIFIER LV_TPS_SP_TRA_JAM_SEL[2] ECU_ADDRESS 0xd000398f BIT_MASK 0x1 /end MEASUREMENT
/begin CHARACTERISTIC c_tps_sp_min "Lower limit of the throttle position setpoint" VALUE 0xa08080e4 _REC_VAL_20_u2 119.5 _CNV_A_R_LINEAR_____227_CM 0. 119.5 DISPLAY_IDENTIFIER C_TPS_SP_MIN FORMAT "%7.3" /end CHARACTERISTIC
/begin CHARACTERISTIC c_tps_sp_jam_lgrd "Change limitation for setpoint limitation after ETC jam detection setpoint request" VALUE 0xa08080de _REC_VAL_20_u2 119.5 _CNV_A_R_LINEAR_____227_CM 0. 119.5 DISPLAY_IDENTIFIER C_TPS_SP_JAM_LGRD FORMAT "%7.3" /end CHARACTERISTIC
/begin CHARACTERISTIC c_tps_sp_as_man "Manual setpoint request by external device" VALUE 0xa08080da _REC_VAL_20_u2 119.5 _CNV_A_R_LINEAR_____227_CM 0. 119.5 DISPLAY_IDENTIFIER C_TPS_SP_AS_MAN FORMAT "%7.3" /end CHARACTERISTIC
/begin CHARACTERISTIC c_tps_sp_ext_adj_ena "Constant for the activation of the external setpoint adjustment" VALUE 0xa08080dd _REC_VAL_20_u1 4. _CNV_A_R_LINEAR_____0_CM 0. 4. DISPLAY_IDENTIFIER C_TPS_SP_EXT_ADJ_ENA FORMAT "%3.0" /end CHARACTERISTIC
/begin CHARACTERISTIC ip_tps_sp_ext_adj "Manual setpoint request dependent on PV by external device" CURVE 0xa080807c _REC_CUR_20_u2_u2 119.5 _CNV_A_R_LINEAR_____227_CM 0. 119.5 DISPLAY_IDENTIFIER IP_TPS_SP_EXT_ADJ FORMAT "%7.3"
 /begin AXIS_DESCR COM_AXIS pv _CNV_A_R_CPULOAD__0_448_CM 6 0. 99.90234375 FORMAT "%5.2" AXIS_PTS_REF ldp_pv_ip_tps_sp_ext /end AXIS_DESCR
/end CHARACTERISTIC
/begin MEASUREMENT tps_sp_es[0] "Throttle position setpoint during engine stop" UWORD _CNV_A_R_LINEAR_____227_CM 1 100. 0. 119.5 DISPLAY_IDENTIFIER TPS_SP_ES[1] ECU_ADDRESS 0xd0007258 FORMAT "%7.3" /end MEASUREMENT
/begin MEASUREMENT tps_sp_es[1] "Throttle position setpoint during engine stop" UWORD _CNV_A_R_LINEAR_____227_CM 1 100. 0. 119.5 DISPLAY_IDENTIFIER TPS_SP_ES[2] ECU_ADDRESS 0xd000725a FORMAT "%7.3" /end MEASUREMENT
/begin MEASUREMENT tps_sp_ext_adj[0] "ETC setpoint request by external device" UWORD _CNV_A_R_LINEAR_____227_CM 1 100. 0. 119.5 DISPLAY_IDENTIFIER TPS_SP_EXT_ADJ[1] ECU_ADDRESS 0xd000725c FORMAT "%7.3" /end MEASUREMENT
/begin MEASUREMENT tps_sp_ext_adj[1] "ETC setpoint request by external device" UWORD _CNV_A_R_LINEAR_____227_CM 1 100. 0. 119.5 DISPLAY_IDENTIFIER TPS_SP_EXT_ADJ[2] ECU_ADDRESS 0xd000725e FORMAT "%7.3" /end MEASUREMENT
/begin MEASUREMENT lv_tps_sp_ext_adj[0] "Logical variable indicates an ETC setpoint request by external device" UBYTE _CNV_S_2_RANGE__0___1_CM 1 100. 0. 1. DISPLAY_IDENTIFIER LV_TPS_SP_EXT_ADJ[1] ECU_ADDRESS 0xd000779a BIT_MASK 0x1 /end MEASUREMENT
/begin MEASUREMENT lv_tps_sp_ext_adj[1] "Logical variable indicates an ETC setpoint request by external device" UBYTE _CNV_S_2_RANGE__0___1_CM 1 100. 0. 1. DISPLAY_IDENTIFIER LV_TPS_SP_EXT_ADJ[2] ECU_ADDRESS 0xd000779b BIT_MASK 0x1 /end MEASUREMENT
/begin MEASUREMENT lv_tps_sp_lih[0] "Logical variable indicates an ETC limp-home setpoint request" UBYTE _CNV_S_2_RANGE__0___1_CM 1 100. 0. 1. DISPLAY_IDENTIFIER LV_TPS_SP_LIH[1] ECU_ADDRESS 0xd000779e BIT_MASK 0x1 /end MEASUREMENT
/begin MEASUREMENT lv_tps_sp_lih[1] "Logical variable indicates an ETC limp-home setpoint request" UBYTE _CNV_S_2_RANGE__0___1_CM 1 100. 0. 1. DISPLAY_IDENTIFIER LV_TPS_SP_LIH[2] ECU_ADDRESS 0xd000779f BIT_MASK 0x1 /end MEASUREMENT
/begin MEASUREMENT lv_tps_sp_etc_off[0] "ETC power stage deactivation request from setpoint selection" UBYTE _CNV_S_2_RANGE__0___1_CM 1 100. 0. 1. DISPLAY_IDENTIFIER LV_TPS_SP_ETC_OFF[1] ECU_ADDRESS 0xd0007798 BIT_MASK 0x1 /end MEASUREMENT
/begin MEASUREMENT lv_tps_sp_etc_off[1] "ETC power stage deactivation request from setpoint selection" UBYTE _CNV_S_2_RANGE__0___1_CM 1 100. 0. 1. DISPLAY_IDENTIFIER LV_TPS_SP_ETC_OFF[2] ECU_ADDRESS 0xd0007799 BIT_MASK 0x1 /end MEASUREMENT
/begin MEASUREMENT lv_tps_sp_es[0] "Logical variable indicates ETC setpoint request during engine stop" UBYTE _CNV_S_2_RANGE__0___1_CM 1 100. 0. 1. DISPLAY_IDENTIFIER LV_TPS_SP_ES[1] ECU_ADDRESS 0xd0007796 BIT_MASK 0x1 /end MEASUREMENT
/begin MEASUREMENT lv_tps_sp_es[1] "Logical variable indicates ETC setpoint request during engine stop" UBYTE _CNV_S_2_RANGE__0___1_CM 1 100. 0. 1. DISPLAY_IDENTIFIER LV_TPS_SP_ES[2] ECU_ADDRESS 0xd0007797 BIT_MASK 0x1 /end MEASUREMENT
/begin MEASUREMENT tps_sp_lih[0] "Throttle position setpoint for limp-home request" UWORD _CNV_A_R_LINEAR_____227_CM 1 100. 0. 119.5 DISPLAY_IDENTIFIER TPS_SP_LIH[1] ECU_ADDRESS 0xd0007264 FORMAT "%7.3" /end MEASUREMENT
/begin MEASUREMENT tps_sp_lih[1] "Throttle position setpoint for limp-home request" UWORD _CNV_A_R_LINEAR_____227_CM 1 100. 0. 119.5 DISPLAY_IDENTIFIER TPS_SP_LIH[2] ECU_ADDRESS 0xd0007266 FORMAT "%7.3" /end MEASUREMENT
/begin MEASUREMENT lv_tps_sp_pop[0] "Logical variable indicates ETC setpoint request during post operating phase" UBYTE _CNV_S_2_RANGE__0___1_CM 1 100. 0. 1. DISPLAY_IDENTIFIER LV_TPS_SP_POP[1] ECU_ADDRESS 0xd00077a2 BIT_MASK 0x1 /end MEASUREMENT
/begin MEASUREMENT lv_tps_sp_pop[1] "Logical variable indicates ETC setpoint request during post operating phase" UBYTE _CNV_S_2_RANGE__0___1_CM 1 100. 0. 1. DISPLAY_IDENTIFIER LV_TPS_SP_POP[2] ECU_ADDRESS 0xd00077a3 BIT_MASK 0x1 /end MEASUREMENT
/begin MEASUREMENT tps_sp_pop[0] "ETC setpoint during post operating phase" UWORD _CNV_A_R_LINEAR_____227_CM 1 100. 0. 119.5 DISPLAY_IDENTIFIER TPS_SP_POP[1] ECU_ADDRESS 0xd0007268 FORMAT "%7.3" /end MEASUREMENT
/begin MEASUREMENT tps_sp_pop[1] "ETC setpoint during post operating phase" UWORD _CNV_A_R_LINEAR_____227_CM 1 100. 0. 119.5 DISPLAY_IDENTIFIER TPS_SP_POP[2] ECU_ADDRESS 0xd000726a FORMAT "%7.3" /end MEASUREMENT
/begin AXIS_PTS ldp_pv_ip_tps_sp_ext "" 0xa0808034 pv _REC_AXS_20_u2 99.90234375 _CNV_A_R_CPULOAD__0_448_CM 6 0. 99.90234375 FORMAT "%5.2" /end AXIS_PTS
/begin CHARACTERISTIC c_pv_min_ext_adj "Smallest PV threshold for the activation of external setpoint adjustment dependent on PV" VALUE 0xa08080b8 _REC_VAL_20_u2 99.90234375 _CNV_A_R_CPULOAD__0_448_CM 0. 99.90234375 DISPLAY_IDENTIFIER C_PV_MIN_EXT_ADJ FORMAT "%5.2" /end CHARACTERISTIC
/begin CHARACTERISTIC c_t_tps_sp_pop "Tuneable time period for the throttle position setpoint during post operating phase" VALUE 0xa08080c8 _REC_VAL_20_u1 255. _CNV_A_R_LINEAR_____36_CM 0. 255. DISPLAY_IDENTIFIER C_T_TPS_SP_POP FORMAT "%3.0" /end CHARACTERISTIC
/begin CHARACTERISTIC ip_tps_sp_pop "Throttle position setpoint during post operating phase" CURVE 0xa0808088 _REC_CUR_20_u2_u1 119.5 _CNV_A_R_LINEAR_____227_CM 0. 119.5 DISPLAY_IDENTIFIER IP_TPS_SP_POP FORMAT "%7.3"
 /begin AXIS_DESCR COM_AXIS n_32 _CNV_A_R_LINEAR_____10_CM 4 0. 8160. FORMAT "%4.0" AXIS_PTS_REF ldp_n_32_ip_tps_sp_pop /end AXIS_DESCR
/end CHARACTERISTIC
/begin AXIS_PTS ldp_n_32_ip_tps_sp_pop "" 0xa080801a n_32 _REC_AXS_20_u1 816. _CNV_A_R_LINEAR_____10_CM 4 0. 8160. FORMAT "%4.0" /end AXIS_PTS
/begin CHARACTERISTIC c_tps_sp_pop_up "Throttle position during post operating phase before the ETC power stage is switched-off" VALUE 0xa08080ea _REC_VAL_20_u2 119.5 _CNV_A_R_LINEAR_____227_CM 0. 119.5 DISPLAY_IDENTIFIER C_TPS_SP_POP_UP FORMAT "%7.3" /end CHARACTERISTIC
/begin CHARACTERISTIC c_tps_sp_pop_lgrd "Gradient limitation for the ETC setpoint during the post operating phase " VALUE 0xa08080e8 _REC_VAL_20_u2 119.5 _CNV_A_R_LINEAR_____896_CM 0. 119.5 DISPLAY_IDENTIFIER C_TPS_SP_POP_LGRD FORMAT "%7.3" /end CHARACTERISTIC
/begin MEASUREMENT lv_tps_sp_jam[0] "Logical variable indicates a throttle position setpoint request for ETC jam detection " UBYTE _CNV_S_2_RANGE__0___1_CM 1 100. 0. 1. DISPLAY_IDENTIFIER LV_TPS_SP_JAM[1] ECU_ADDRESS 0xd000779c BIT_MASK 0x1 /end MEASUREMENT
/begin MEASUREMENT lv_tps_sp_jam[1] "Logical variable indicates a throttle position setpoint request for ETC jam detection " UBYTE _CNV_S_2_RANGE__0___1_CM 1 100. 0. 1. DISPLAY_IDENTIFIER LV_TPS_SP_JAM[2] ECU_ADDRESS 0xd000779d BIT_MASK 0x1 /end MEASUREMENT
/begin MEASUREMENT lv_tps_jam_open_dir[0] "Logical variable indicates a disturbance of the throttle flap in opening direction" UBYTE _CNV_S_2_RANGE__0___1_CM 1 100. 0. 1. DISPLAY_IDENTIFIER LV_TPS_JAM_OPEN_DIR[1] ECU_ADDRESS 0xd0007792 BIT_MASK 0x1 /end MEASUREMENT
/begin MEASUREMENT lv_tps_jam_open_dir[1] "Logical variable indicates a disturbance of the throttle flap in opening direction" UBYTE _CNV_S_2_RANGE__0___1_CM 1 100. 0. 1. DISPLAY_IDENTIFIER LV_TPS_JAM_OPEN_DIR[2] ECU_ADDRESS 0xd0007793 BIT_MASK 0x1 /end MEASUREMENT
/begin MEASUREMENT tps_sp_jam[0] "Throttle position setpoint request in case of a jammed ETC actuator" UWORD _CNV_A_R_LINEAR_____227_CM 1 100. 0. 119.5 DISPLAY_IDENTIFIER TPS_SP_JAM[1] ECU_ADDRESS 0xd0007260 FORMAT "%7.3" /end MEASUREMENT
/begin MEASUREMENT tps_sp_jam[1] "Throttle position setpoint request in case of a jammed ETC actuator" UWORD _CNV_A_R_LINEAR_____227_CM 1 100. 0. 119.5 DISPLAY_IDENTIFIER TPS_SP_JAM[2] ECU_ADDRESS 0xd0007262 FORMAT "%7.3" /end MEASUREMENT
/begin MEASUREMENT tps_sp_st[0] "TPS setpoint at start" UWORD _CNV_A_R_LINEAR_____227_CM 1 100. 0. 119.5 DISPLAY_IDENTIFIER TPS_SP_ST[1] ECU_ADDRESS 0xd0007270 FORMAT "%7.3" /end MEASUREMENT
/begin MEASUREMENT tps_sp_st[1] "TPS setpoint at start" UWORD _CNV_A_R_LINEAR_____227_CM 1 100. 0. 119.5 DISPLAY_IDENTIFIER TPS_SP_ST[2] ECU_ADDRESS 0xd0007272 FORMAT "%7.3" /end MEASUREMENT
/begin CHARACTERISTIC c_tps_ratio_hys "Admissible deviation of throttle valve angle between TPS 1 and 2" VALUE 0xa08080d6 _REC_VAL_20_u2 119.5 _CNV_A_R_LINEAR_____227_CM 0. 119.5 DISPLAY_IDENTIFIER C_TPS_RATIO_HYS FORMAT "%7.3" /end CHARACTERISTIC
/begin MEASUREMENT state_tps_diag[0] "State variable for the TPS diagnosis indicates the error state of the measurement system" UBYTE _CNV_S_5_THRO_RANGE_898_CM 1 100. 0. 8. DISPLAY_IDENTIFIER STATE_TPS_DIAG[1] ECU_ADDRESS 0xd000775c /end MEASUREMENT
/begin MEASUREMENT state_tps_diag[1] "State variable for the TPS diagnosis indicates the error state of the measurement system" UBYTE _CNV_S_5_THRO_RANGE_898_CM 1 100. 0. 8. DISPLAY_IDENTIFIER STATE_TPS_DIAG[2] ECU_ADDRESS 0xd000775d /end MEASUREMENT
/begin MEASUREMENT lv_tps_ratio_err_det[0] "Logical variable to indicate a TPS ratio error without denouncing" UBYTE _CNV_S_2_RANGE__0___1_CM 1 100. 0. 1. DISPLAY_IDENTIFIER LV_TPS_RATIO_ERR_DET[1] ECU_ADDRESS 0xd0007794 BIT_MASK 0x1 /end MEASUREMENT
/begin MEASUREMENT lv_tps_ratio_err_det[1] "Logical variable to indicate a TPS ratio error without denouncing" UBYTE _CNV_S_2_RANGE__0___1_CM 1 100. 0. 1. DISPLAY_IDENTIFIER LV_TPS_RATIO_ERR_DET[2] ECU_ADDRESS 0xd0007795 BIT_MASK 0x1 /end MEASUREMENT
/begin CHARACTERISTIC c_abc_inc_tps_ratio "Anti-bounce increment value TPS ratio diagnosis" VALUE 0xa0808097 _REC_VAL_20_u1 255. _CNV_A_R_LINEAR_____0_CM 0. 255. DISPLAY_IDENTIFIER C_ABC_INC_TPS_RATIO FORMAT "%3.0" /end CHARACTERISTIC
/begin CHARACTERISTIC c_abc_max_tps_ratio "Anti-bounce maximum value TPS ratio diagnosis" VALUE 0xa080809e _REC_VAL_20_u1 254. _CNV_A_R_LINEAR_____0_CM 1. 255. DISPLAY_IDENTIFIER C_ABC_MAX_TPS_RATIO FORMAT "%3.0" /end CHARACTERISTIC
/begin MEASUREMENT lv_err_tps_maf_1_1 "Present failure of the plausibility check between TPS 1 and MAF value" UBYTE _CNV_S_2_RANGE__0___1_CM 1 100. 0. 1. DISPLAY_IDENTIFIER LV_ERR_TPS_MAF_1[1] ECU_ADDRESS 0xd0008057 BIT_MASK 0x1 /end MEASUREMENT
/begin MEASUREMENT lv_err_tps_maf_1_2 "Present failure of the plausibility check between TPS 1 and MAF value" UBYTE _CNV_S_2_RANGE__0___1_CM 1 100. 0. 1. DISPLAY_IDENTIFIER LV_ERR_TPS_MAF_1[2] ECU_ADDRESS 0xd0008058 BIT_MASK 0x1 /end MEASUREMENT
/begin MEASUREMENT lv_err_tps_maf_2_1 "Present failure of the plausibility check between TPS 2 and MAF value" UBYTE _CNV_S_2_RANGE__0___1_CM 1 100. 0. 1. DISPLAY_IDENTIFIER LV_ERR_TPS_MAF_2[1] ECU_ADDRESS 0xd0008059 BIT_MASK 0x1 /end MEASUREMENT
/begin MEASUREMENT lv_err_tps_maf_2_2 "Present failure of the plausibility check between TPS 2 and MAF value" UBYTE _CNV_S_2_RANGE__0___1_CM 1 100. 0. 1. DISPLAY_IDENTIFIER LV_ERR_TPS_MAF_2[2] ECU_ADDRESS 0xd000805a BIT_MASK 0x1 /end MEASUREMENT
/begin MEASUREMENT lv_err_tps_ratio_1 "Present failure after filtering of diagnostic TPS ratio error" UBYTE _CNV_S_2_RANGE__0___1_CM 1 100. 0. 1. DISPLAY_IDENTIFIER LV_ERR_TPS_RATIO[1] ECU_ADDRESS 0xd000805b BIT_MASK 0x1 /end MEASUREMENT
/begin MEASUREMENT lv_err_tps_ratio_2 "Present failure after filtering of diagnostic TPS ratio error" UBYTE _CNV_S_2_RANGE__0___1_CM 1 100. 0. 1. DISPLAY_IDENTIFIER LV_ERR_TPS_RATIO[2] ECU_ADDRESS 0xd000805c BIT_MASK 0x1 /end MEASUREMENT
/begin MEASUREMENT lv_inh_diag_tps_ratio[0] "Inhibition condition for the TPS ratio check" UBYTE _CNV_S_2_RANGE__0___1_CM 1 100. 0. 1. DISPLAY_IDENTIFIER LV_INH_DIAG_TPS_RATIO[1] ECU_ADDRESS 0xd0007778 BIT_MASK 0x1 /end MEASUREMENT
/begin MEASUREMENT lv_inh_diag_tps_ratio[1] "Inhibition condition for the TPS ratio check" UBYTE _CNV_S_2_RANGE__0___1_CM 1 100. 0. 1. DISPLAY_IDENTIFIER LV_INH_DIAG_TPS_RATIO[2] ECU_ADDRESS 0xd0007779 BIT_MASK 0x1 /end MEASUREMENT
/begin MEASUREMENT lv_tps_1_maf_err_plaus[0] "Detected plausibility error between TPS 1 and MAF/MAP sensor" UBYTE _CNV_S_2_RANGE__0___1_CM 1 100. 0. 1. DISPLAY_IDENTIFIER LV_TPS_1_MAF_ERR_PLAUS[1] ECU_ADDRESS 0xd0007784 BIT_MASK 0x1 /end MEASUREMENT
/begin MEASUREMENT lv_tps_1_maf_err_plaus[1] "Detected plausibility error between TPS 1 and MAF/MAP sensor" UBYTE _CNV_S_2_RANGE__0___1_CM 1 100. 0. 1. DISPLAY_IDENTIFIER LV_TPS_1_MAF_ERR_PLAUS[2] ECU_ADDRESS 0xd0007785 BIT_MASK 0x1 /end MEASUREMENT
/begin MEASUREMENT lv_tps_2_maf_err_plaus[0] "Detected plausibility error between TPS 2 and MAF/MAP sensor" UBYTE _CNV_S_2_RANGE__0___1_CM 1 100. 0. 1. DISPLAY_IDENTIFIER LV_TPS_2_MAF_ERR_PLAUS[1] ECU_ADDRESS 0xd0007786 BIT_MASK 0x1 /end MEASUREMENT
/begin MEASUREMENT lv_tps_2_maf_err_plaus[1] "Detected plausibility error between TPS 2 and MAF/MAP sensor" UBYTE _CNV_S_2_RANGE__0___1_CM 1 100. 0. 1. DISPLAY_IDENTIFIER LV_TPS_2_MAF_ERR_PLAUS[2] ECU_ADDRESS 0xd0007787 BIT_MASK 0x1 /end MEASUREMENT
/begin CHARACTERISTIC lc_tps_maf_plaus_test "Logical variable to simulate TPS - MAF plausibility errors" VALUE 0xa080811c _REC_VAL_20_u1 1. _CNV_A_R_LINEAR_____0_CM 0. 1. DISPLAY_IDENTIFIER LC_TPS_MAF_PLAUS_TEST FORMAT "%1.0" /end CHARACTERISTIC
/begin MEASUREMENT tps_dif[0] "Position controller deviation" SWORD _CNV_A_R_THRO_LINEA_899_CM 1 100. -119.507294146371 119.5 DISPLAY_IDENTIFIER TPS_DIF[1] ECU_ADDRESS 0xd0007232 FORMAT "%8.3" /end MEASUREMENT
/begin MEASUREMENT tps_dif[1] "Position controller deviation" SWORD _CNV_A_R_THRO_LINEA_899_CM 1 100. -119.507294146371 119.5 DISPLAY_IDENTIFIER TPS_DIF[2] ECU_ADDRESS 0xd0007234 FORMAT "%8.3" /end MEASUREMENT
/begin MEASUREMENT tps_ofs_ctl[0] "Offset for the compensation of the control deviation" SWORD _CNV_A_R_THRO_LINEA_899_CM 1 100. -119.507294146371 119.5 DISPLAY_IDENTIFIER TPS_OFS_CTL[1] ECU_ADDRESS 0xd000395c FORMAT "%8.3" /end MEASUREMENT
/begin MEASUREMENT tps_ofs_ctl[1] "Offset for the compensation of the control deviation" SWORD _CNV_A_R_THRO_LINEA_899_CM 1 100. -119.507294146371 119.5 DISPLAY_IDENTIFIER TPS_OFS_CTL[2] ECU_ADDRESS 0xd000395e FORMAT "%8.3" /end MEASUREMENT
/begin CHARACTERISTIC c_tps_dif_max "Activation range for the static integrator" VALUE 0xa08080cd _REC_VAL_20_u1 1.86000732466581 _CNV_A_R_THRO_LINEA_891_CM 0. 1.86000732466581 DISPLAY_IDENTIFIER C_TPS_DIF_MAX FORMAT "%5.3" /end CHARACTERISTIC
/begin CHARACTERISTIC c_tps_lih_hys "Hysteresis area around limp-home position" VALUE 0xa08080cf _REC_VAL_20_u1 1.838124885552095 _CNV_A_R_THRO_LINEA_900_CM 2.18824391137154e-002 1.86000732466581 DISPLAY_IDENTIFIER C_TPS_LIH_HYS FORMAT "%5.3" /end CHARACTERISTIC
/begin CHARACTERISTIC c_tps_int_ini "Initialization value for the static integrator" VALUE 0xa08080ce _REC_VAL_20_u1 0.9992980528596701 _CNV_A_R_THRO_LINEA_891_CM 0. 0.99929805285967 DISPLAY_IDENTIFIER C_TPS_INT_INI FORMAT "%5.3" /end CHARACTERISTIC
/begin MEASUREMENT pwm_etc[0] "Duty cycle for ETC actuator control" SWORD _CNV_A_R_LINEAR_____212_CM 1 100. -100. 99.9969482421875 DISPLAY_IDENTIFIER PWM_ETC[1] ECU_ADDRESS 0xd0007222 FORMAT "%8.3" /end MEASUREMENT
/begin MEASUREMENT pwm_etc[1] "Duty cycle for ETC actuator control" SWORD _CNV_A_R_LINEAR_____212_CM 1 100. -100. 99.9969482421875 DISPLAY_IDENTIFIER PWM_ETC[2] ECU_ADDRESS 0xd0007224 FORMAT "%8.3" /end MEASUREMENT
/begin MEASUREMENT tps_dif_etc[0] "TPS value before PDT1 transfer function" SWORD _CNV_A_R_THRO_LINEA_899_CM 1 100. -119.507294146371 119.5 DISPLAY_IDENTIFIER TPS_DIF_ETC[1] ECU_ADDRESS 0xd0003952 FORMAT "%8.3" /end MEASUREMENT
/begin MEASUREMENT tps_dif_etc[1] "TPS value before PDT1 transfer function" SWORD _CNV_A_R_THRO_LINEA_899_CM 1 100. -119.507294146371 119.5 DISPLAY_IDENTIFIER TPS_DIF_ETC[2] ECU_ADDRESS 0xd0003954 FORMAT "%8.3" /end MEASUREMENT
/begin MEASUREMENT tps_fil_etc[0] "TPS value after PDT1 transfer function" SWORD _CNV_A_R_THRO_LINEA_899_CM 1 100. -119.507294146371 119.5 DISPLAY_IDENTIFIER TPS_FIL_ETC[1] ECU_ADDRESS 0xd0003956 FORMAT "%8.3" /end MEASUREMENT
/begin MEASUREMENT tps_fil_etc[1] "TPS value after PDT1 transfer function" SWORD _CNV_A_R_THRO_LINEA_899_CM 1 100. -119.507294146371 119.5 DISPLAY_IDENTIFIER TPS_FIL_ETC[2] ECU_ADDRESS 0xd0003958 FORMAT "%8.3" /end MEASUREMENT
/begin MEASUREMENT kp_cor_etc "Controller amplification, battery voltage corrected" UWORD _CNV_A_R_LINEAR_____901_CM 1 100. 0. 4095.9375 DISPLAY_IDENTIFIER KP_COR_ETC ECU_ADDRESS 0xd0003944 FORMAT "%8.3" /end MEASUREMENT
/begin MEASUREMENT fac_vb_etc "Factor battery voltage correction" UWORD _CNV_A_R_LINEAR_____129_CM 1 100. 0. 31.9990234375 DISPLAY_IDENTIFIER FAC_VB_ETC ECU_ADDRESS 0xd000721c FORMAT "%7.4" /end MEASUREMENT
/begin MEASUREMENT tps_max_etc "Limitation value of input value, PT1  transfer function " UWORD _CNV_A_R_LINEAR_____227_CM 1 100. 0. 119.5 DISPLAY_IDENTIFIER TPS_MAX_ETC ECU_ADDRESS 0xd000395a FORMAT "%7.3" /end MEASUREMENT
/begin CHARACTERISTIC c_kp_etc "Static position controller amplification " VALUE 0xa08080b4 _REC_VAL_20_u2 1023.9375 _CNV_A_R_LINEAR_____901_CM 6.25e-002 1024. DISPLAY_IDENTIFIER C_KP_ETC FORMAT "%8.3" /end CHARACTERISTIC
/begin CHARACTERISTIC c_ki_etc "Static integrator amplification" VALUE 0xa08080b2 _REC_VAL_20_u2 1. _CNV_A_R_LINEAR_____129_CM 0. 1. DISPLAY_IDENTIFIER C_KI_ETC FORMAT "%7.4" /end CHARACTERISTIC
/begin CHARACTERISTIC c_fac_0_fil_etc "Transfer function PDT1 parameter b0" VALUE 0xa08080a8 _REC_VAL_20_u2 1. _CNV_A_R_LINEAR_____129_CM 0. 1. DISPLAY_IDENTIFIER C_FAC_0_FIL_ETC FORMAT "%7.4" /end CHARACTERISTIC
/begin CHARACTERISTIC c_fac_1_fil_etc "Transfer function PDT1 parameter a1" VALUE 0xa08080aa _REC_VAL_20_u2 1. _CNV_A_R_LINEAR_____129_CM 0. 1. DISPLAY_IDENTIFIER C_FAC_1_FIL_ETC FORMAT "%7.4" /end CHARACTERISTIC
/begin CHARACTERISTIC ip_fac_vb_etc "Battery voltage correction" CURVE 0xa080806c _REC_CUR_20_u2_u1 3.5 _CNV_A_R_LINEAR_____129_CM 0.5 4. DISPLAY_IDENTIFIER IP_FAC_VB_ETC FORMAT "%7.4"
 /begin AXIS_DESCR COM_AXIS vb _CNV_A_R_LINEAR_____272_CM 2 0. 25.8984375 FORMAT "%9.6" AXIS_PTS_REF ldp_vb_mmv_ip_fac_vb_etc /end AXIS_DESCR
/end CHARACTERISTIC
/begin AXIS_PTS ldp_vb_mmv_ip_fac_vb_etc "Battery Voltage" 0xa080805e vb _REC_AXS_20_u1 25.8984375 _CNV_A_R_LINEAR_____272_CM 2 0. 25.8984375 FORMAT "%9.6" /end AXIS_PTS
/begin MEASUREMENT tps_sp_ctl[0] "Throttle position setpoint for ETC position controller" SWORD _CNV_A_R_THRO_LINEA_899_CM 1 100. -119.507294146371 119.5 DISPLAY_IDENTIFIER TPS_SP_CTL[1] ECU_ADDRESS 0xd0003960 FORMAT "%8.3" /end MEASUREMENT
/begin MEASUREMENT tps_sp_ctl[1] "Throttle position setpoint for ETC position controller" SWORD _CNV_A_R_THRO_LINEA_899_CM 1 100. -119.507294146371 119.5 DISPLAY_IDENTIFIER TPS_SP_CTL[2] ECU_ADDRESS 0xd0003962 FORMAT "%8.3" /end MEASUREMENT
/begin MEASUREMENT tps_sp_int[0] "Throttle position setpoint delivered from the static integrator" SWORD _CNV_A_R_THRO_LINEA_899_CM 1 100. -119.507294146371 119.5 DISPLAY_IDENTIFIER TPS_SP_INT[1] ECU_ADDRESS 0xd000396c FORMAT "%8.3" /end MEASUREMENT
/begin MEASUREMENT tps_sp_int[1] "Throttle position setpoint delivered from the static integrator" SWORD _CNV_A_R_THRO_LINEA_899_CM 1 100. -119.507294146371 119.5 DISPLAY_IDENTIFIER TPS_SP_INT[2] ECU_ADDRESS 0xd000396e FORMAT "%8.3" /end MEASUREMENT
/begin CHARACTERISTIC c_kdf_etc "Controller difference amplification" VALUE 0xa08080ae _REC_VAL_20_u2 64. _CNV_A_R_EVAC_LINEA_298_CM 0. 64. DISPLAY_IDENTIFIER C_KDF_ETC FORMAT "%7.4" /end CHARACTERISTIC
/begin CHARACTERISTIC c_kdf_pre_fil_etc "Difference amplification factor of the pre-filter function " VALUE 0xa08080b0 _REC_VAL_20_u2 64. _CNV_A_R_EVAC_LINEA_298_CM 0. 64. DISPLAY_IDENTIFIER C_KDF_PRE_FIL_ETC FORMAT "%7.4" /end CHARACTERISTIC
/begin CHARACTERISTIC c_tps_max_pre_fil_etc "Limitation threshold of the pre-filter function " VALUE 0xa08080d4 _REC_VAL_20_u1 0.9992980528596701 _CNV_A_R_THRO_LINEA_891_CM 0. 0.99929805285967 DISPLAY_IDENTIFIER C_TPS_MAX_PRE_FIL_ETC FORMAT "%5.3" /end CHARACTERISTIC
/begin CHARACTERISTIC c_tps_ofs_ctl_max "Maximum value of the static integrator" VALUE 0xa08080d5 _REC_VAL_20_u1 0.9992980528596701 _CNV_A_R_THRO_LINEA_891_CM 0. 0.99929805285967 DISPLAY_IDENTIFIER C_TPS_OFS_CTL_MAX FORMAT "%5.3" /end CHARACTERISTIC
/begin CHARACTERISTIC c_frq_pwm_etc "Frequency of the PWM signal for electronic throttle control" VALUE 0xa08080ac _REC_VAL_20_u2 2048. _CNV_A_R_LINEAR_____288_CM 0. 2048. DISPLAY_IDENTIFIER C_FRQ_PWM_ETC FORMAT "%4.0" /end CHARACTERISTIC
/begin MEASUREMENT lv_mtc_cur_off "The logical variable indicate the state of the ETC power stage" UBYTE _CNV_S_2_RANGE__0___1_CM 1 100. 0. 1. DISPLAY_IDENTIFIER LV_MTC_CUR_OFF ECU_ADDRESS 0xd000777e BIT_MASK 0x1 /end MEASUREMENT
/begin MEASUREMENT lv_pwm_etc_off[0] "The logical variable indicate the state of the ETC position control" UBYTE _CNV_S_2_RANGE__0___1_CM 1 100. 0. 1. DISPLAY_IDENTIFIER LV_PWM_ETC_OFF[1] ECU_ADDRESS 0xd0007782 BIT_MASK 0x1 /end MEASUREMENT
/begin MEASUREMENT lv_pwm_etc_off[1] "The logical variable indicate the state of the ETC position control" UBYTE _CNV_S_2_RANGE__0___1_CM 1 100. 0. 1. DISPLAY_IDENTIFIER LV_PWM_ETC_OFF[2] ECU_ADDRESS 0xd0007783 BIT_MASK 0x1 /end MEASUREMENT
/begin MEASUREMENT state_n_lim_etc_req "State variable indicates the kind of engine speed limitation request" UBYTE _CNV_S_3_THRO_RANGE_902_CM 1 100. 0. 2. DISPLAY_IDENTIFIER STATE_N_LIM_ETC_REQ ECU_ADDRESS 0xd000775a /end MEASUREMENT
/begin MEASUREMENT lv_err_tps "Global error bit, is set, if a ETC fault occurs" UBYTE _CNV_S_2_RANGE__0___1_CM 1 100. 0. 1. DISPLAY_IDENTIFIER LV_ERR_TPS ECU_ADDRESS 0xd0007766 BIT_MASK 0x1 /end MEASUREMENT
/begin MEASUREMENT lv_n_lim_etc_lih "Engine speed limitation request" UBYTE _CNV_S_2_RANGE__0___1_CM 1 100. 0. 1. DISPLAY_IDENTIFIER LV_N_LIM_ETC_LIH ECU_ADDRESS 0xd000777f BIT_MASK 0x1 /end MEASUREMENT
/begin MEASUREMENT lv_tps_sp_lih_req[0] "ETC limp-home position setpoint request" UBYTE _CNV_S_2_RANGE__0___1_CM 1 100. 0. 1. DISPLAY_IDENTIFIER LV_TPS_SP_LIH_REQ[1] ECU_ADDRESS 0xd00077a0 BIT_MASK 0x1 /end MEASUREMENT
/begin MEASUREMENT lv_tps_sp_lih_req[1] "ETC limp-home position setpoint request" UBYTE _CNV_S_2_RANGE__0___1_CM 1 100. 0. 1. DISPLAY_IDENTIFIER LV_TPS_SP_LIH_REQ[2] ECU_ADDRESS 0xd00077a1 BIT_MASK 0x1 /end MEASUREMENT
/begin MEASUREMENT tqi_max_etc "Engine torque limitation requests by the TPS state manager" SWORD _CNV_A_R_LINEAR_____31_CM 1 100. -1024. 1023.96875 DISPLAY_IDENTIFIER TQI_MAX_ETC ECU_ADDRESS 0xd0007274 FORMAT "%11.5" /end MEASUREMENT
/begin CHARACTERISTIC ip_fac_tps_tq_red "Factor engine torque limitiation" CURVE 0xa0808064 _REC_CUR_20_u1_u1 1.275 _CNV_A_R_THRO_LINEA_903_CM 0. 1.275 DISPLAY_IDENTIFIER IP_FAC_TPS_TQ_RED FORMAT "%5.3"
 /begin AXIS_DESCR COM_AXIS n_32 _CNV_A_R_LINEAR_____10_CM 8 0. 8160. FORMAT "%4.0" AXIS_PTS_REF ldp_n_32_ip_fac_tps_tq_red /end AXIS_DESCR
/end CHARACTERISTIC
/begin AXIS_PTS ldp_n_32_ip_fac_tps_tq_red "" 0xa0808010 n_32 _REC_AXS_20_u1 8160. _CNV_A_R_LINEAR_____10_CM 8 0. 8160. FORMAT "%4.0" /end AXIS_PTS
/begin MEASUREMENT lv_n_lim_etc_lih_req[0] "Engine speed limitation request separated for ETC system 1 and 2" UBYTE _CNV_S_2_RANGE__0___1_CM 1 100. 0. 1. DISPLAY_IDENTIFIER LV_N_LIM_ETC_LIH_REQ[1] ECU_ADDRESS 0xd0007780 BIT_MASK 0x1 /end MEASUREMENT
/begin MEASUREMENT lv_n_lim_etc_lih_req[1] "Engine speed limitation request separated for ETC system 1 and 2" UBYTE _CNV_S_2_RANGE__0___1_CM 1 100. 0. 1. DISPLAY_IDENTIFIER LV_N_LIM_ETC_LIH_REQ[2] ECU_ADDRESS 0xd0007781 BIT_MASK 0x1 /end MEASUREMENT
/begin MEASUREMENT lv_etc_dr_off_req[0] "ETC power stage deactivation request" UBYTE _CNV_S_2_RANGE__0___1_CM 1 100. 0. 1. DISPLAY_IDENTIFIER LV_ETC_DR_OFF_REQ[1] ECU_ADDRESS 0xd000776a BIT_MASK 0x1 /end MEASUREMENT
/begin MEASUREMENT lv_etc_dr_off_req[1] "ETC power stage deactivation request" UBYTE _CNV_S_2_RANGE__0___1_CM 1 100. 0. 1. DISPLAY_IDENTIFIER LV_ETC_DR_OFF_REQ[2] ECU_ADDRESS 0xd000776b BIT_MASK 0x1 /end MEASUREMENT
/begin MEASUREMENT lv_err_etc[0] "Global error information indicates an ETC error" UBYTE _CNV_S_2_RANGE__0___1_CM 1 100. 0. 1. DISPLAY_IDENTIFIER LV_ERR_ETC[1] ECU_ADDRESS 0xd0007764 BIT_MASK 0x1 /end MEASUREMENT
/begin MEASUREMENT lv_err_etc[1] "Global error information indicates an ETC error" UBYTE _CNV_S_2_RANGE__0___1_CM 1 100. 0. 1. DISPLAY_IDENTIFIER LV_ERR_ETC[2] ECU_ADDRESS 0xd0007765 BIT_MASK 0x1 /end MEASUREMENT
/begin MEASUREMENT tps_av_2[0] "Throttle flap opening angle of position sensor 2" SWORD _CNV_A_R_THRO_LINEA_899_CM 1 100. -119.507294146371 119.5 DISPLAY_IDENTIFIER TPS_AV_2[1] ECU_ADDRESS 0xd000722e FORMAT "%8.3" /end MEASUREMENT
/begin MEASUREMENT tps_av_2[1] "Throttle flap opening angle of position sensor 2" SWORD _CNV_A_R_THRO_LINEA_899_CM 1 100. -119.507294146371 119.5 DISPLAY_IDENTIFIER TPS_AV_2[2] ECU_ADDRESS 0xd0007230 FORMAT "%8.3" /end MEASUREMENT
/begin MEASUREMENT tps_grd[0] "Gradient of the throttle flap position, absolute value" UBYTE _CNV_A_R_LINEAR_____888_CM 1 100. 0. 2988.28125 DISPLAY_IDENTIFIER TPS_GRD[1] ECU_ADDRESS 0xd0007762 FORMAT "%6.1" /end MEASUREMENT
/begin MEASUREMENT tps_grd[1] "Gradient of the throttle flap position, absolute value" UBYTE _CNV_A_R_LINEAR_____888_CM 1 100. 0. 2988.28125 DISPLAY_IDENTIFIER TPS_GRD[2] ECU_ADDRESS 0xd0007763 FORMAT "%6.1" /end MEASUREMENT
/begin MEASUREMENT tps_lih[0] "Limp home position of the throttle flap" UWORD _CNV_A_R_LINEAR_____227_CM 1 100. 0. 119.5 DISPLAY_IDENTIFIER TPS_LIH[1] ECU_ADDRESS 0xd000723a FORMAT "%7.3" /end MEASUREMENT
/begin MEASUREMENT tps_lih[1] "Limp home position of the throttle flap" UWORD _CNV_A_R_LINEAR_____227_CM 1 100. 0. 119.5 DISPLAY_IDENTIFIER TPS_LIH[2] ECU_ADDRESS 0xd000723c FORMAT "%7.3" /end MEASUREMENT
/begin MEASUREMENT tps_seg[0] "Throttle flap position measured segment synchronous " UWORD _CNV_A_R_LINEAR_____227_CM 1 100. 0. 119.5 DISPLAY_IDENTIFIER TPS_SEG[1] ECU_ADDRESS 0xd000724a FORMAT "%7.3" /end MEASUREMENT
/begin MEASUREMENT tps_seg[1] "Throttle flap position measured segment synchronous " UWORD _CNV_A_R_LINEAR_____227_CM 1 100. 0. 119.5 DISPLAY_IDENTIFIER TPS_SEG[2] ECU_ADDRESS 0xd000724c FORMAT "%7.3" /end MEASUREMENT
/begin MEASUREMENT tps_etc[0] "Throttle flap opening angle for electronic throttle control" SWORD _CNV_A_R_THRO_LINEA_899_CM 1 100. -119.507294146371 119.5 DISPLAY_IDENTIFIER TPS_ETC[1] ECU_ADDRESS 0xd0007236 FORMAT "%8.3" /end MEASUREMENT
/begin MEASUREMENT tps_etc[1] "Throttle flap opening angle for electronic throttle control" SWORD _CNV_A_R_THRO_LINEA_899_CM 1 100. -119.507294146371 119.5 DISPLAY_IDENTIFIER TPS_ETC[2] ECU_ADDRESS 0xd0007238 FORMAT "%8.3" /end MEASUREMENT
/begin MEASUREMENT lv_tps_grd_up[0] "Logical variable for throttle position gradient direction" UBYTE _CNV_S_2_RANGE__0___1_CM 1 100. 0. 1. DISPLAY_IDENTIFIER LV_TPS_GRD_UP[1] ECU_ADDRESS 0xd0007790 BIT_MASK 0x1 /end MEASUREMENT
/begin MEASUREMENT lv_tps_grd_up[1] "Logical variable for throttle position gradient direction" UBYTE _CNV_S_2_RANGE__0___1_CM 1 100. 0. 1. DISPLAY_IDENTIFIER LV_TPS_GRD_UP[2] ECU_ADDRESS 0xd0007791 BIT_MASK 0x1 /end MEASUREMENT
/begin CHARACTERISTIC c_tps_max "Maximum mechanical opening angle of the throttle valve in degree" VALUE 0xa08080d2 _REC_VAL_20_u2 119.5 _CNV_A_R_LINEAR_____227_CM 0. 119.5 DISPLAY_IDENTIFIER C_TPS_MAX FORMAT "%7.3" /end CHARACTERISTIC
/begin MEASUREMENT tps[0] "Throttle flap opening angle with low resolution" UBYTE _CNV_A_R_LINEAR_____874_CM 1 100. 0. 119.040468778612 DISPLAY_IDENTIFIER TPS[1] ECU_ADDRESS 0xd000775e FORMAT "%4.1" /end MEASUREMENT
/begin MEASUREMENT tps[1] "Throttle flap opening angle with low resolution" UBYTE _CNV_A_R_LINEAR_____874_CM 1 100. 0. 119.040468778612 DISPLAY_IDENTIFIER TPS[2] ECU_ADDRESS 0xd000775f FORMAT "%4.1" /end MEASUREMENT
/begin MEASUREMENT tps_av[0] "Throttle flap opening angle with high resolution" UWORD _CNV_A_R_LINEAR_____227_CM 1 100. 0. 119.5 DISPLAY_IDENTIFIER TPS_AV[1] ECU_ADDRESS 0xd0007226 FORMAT "%7.3" /end MEASUREMENT
/begin MEASUREMENT tps_av[1] "Throttle flap opening angle with high resolution" UWORD _CNV_A_R_LINEAR_____227_CM 1 100. 0. 119.5 DISPLAY_IDENTIFIER TPS_AV[2] ECU_ADDRESS 0xd0007228 FORMAT "%7.3" /end MEASUREMENT
/begin MEASUREMENT opg_av_isa[0] "Actual idle speed actuator opening" UWORD _CNV_A_R_LINEAR_____8_CM 1 100. 0. 99.99847412109381 DISPLAY_IDENTIFIER OPG_AV_ISA[1] ECU_ADDRESS 0xd000721e /end MEASUREMENT
/begin MEASUREMENT opg_av_isa[1] "Actual idle speed actuator opening" UWORD _CNV_A_R_LINEAR_____8_CM 1 100. 0. 99.99847412109381 DISPLAY_IDENTIFIER OPG_AV_ISA[2] ECU_ADDRESS 0xd0007220 /end MEASUREMENT
/begin MEASUREMENT tps_av_1[0] "Throttle flap opening angle of position sensor 1" SWORD _CNV_A_R_THRO_LINEA_899_CM 1 100. -119.507294146371 119.5 DISPLAY_IDENTIFIER TPS_AV_1[1] ECU_ADDRESS 0xd000722a FORMAT "%8.3" /end MEASUREMENT
/begin MEASUREMENT tps_av_1[1] "Throttle flap opening angle of position sensor 1" SWORD _CNV_A_R_THRO_LINEA_899_CM 1 100. -119.507294146371 119.5 DISPLAY_IDENTIFIER TPS_AV_1[2] ECU_ADDRESS 0xd000722c FORMAT "%8.3" /end MEASUREMENT
/begin MEASUREMENT vp_tps_1[0] "Signal voltage throttle position sensor 1" SWORD _CNV_A_R_THRO_LINEA_895_CM 1 100. -5. 4.99984741210938 DISPLAY_IDENTIFIER VP_TPS_1[1] ECU_ADDRESS 0xd000727e FORMAT "%7.4" /end MEASUREMENT
/begin MEASUREMENT vp_tps_1[1] "Signal voltage throttle position sensor 1" SWORD _CNV_A_R_THRO_LINEA_895_CM 1 100. -5. 4.99984741210938 DISPLAY_IDENTIFIER VP_TPS_1[2] ECU_ADDRESS 0xd0007280 FORMAT "%7.4" /end MEASUREMENT
/begin MEASUREMENT vp_tps_2[0] "Signal voltage throttle position sensor 2" SWORD _CNV_A_R_THRO_LINEA_895_CM 1 100. -5. 4.99984741210938 DISPLAY_IDENTIFIER VP_TPS_2[1] ECU_ADDRESS 0xd0007286 FORMAT "%7.4" /end MEASUREMENT
/begin MEASUREMENT vp_tps_2[1] "Signal voltage throttle position sensor 2" SWORD _CNV_A_R_THRO_LINEA_895_CM 1 100. -5. 4.99984741210938 DISPLAY_IDENTIFIER VP_TPS_2[2] ECU_ADDRESS 0xd0007288 FORMAT "%7.4" /end MEASUREMENT
/begin CHARACTERISTIC c_vp_tps_grd "Lowest possible voltage gradient of the measured throttle position signals " VALUE 0xa0808106 _REC_VAL_20_s2 9.99984741210938 _CNV_A_R_THRO_LINEA_895_CM -5. 4.99984741210938 DISPLAY_IDENTIFIER C_VP_TPS_GRD FORMAT "%7.4" /end CHARACTERISTIC
/begin CHARACTERISTIC c_pwm_etc_max_diag "Maximum permitted PWM output of the ETC position controller" VALUE 0xa08080ba _REC_VAL_20_u2 99.9969482421875 _CNV_A_R_LINEAR_____212_CM 0. 99.9969482421875 DISPLAY_IDENTIFIER C_PWM_ETC_MAX_DIAG FORMAT "%7.3" /end CHARACTERISTIC
/begin MEASUREMENT ctr_diag_etc_ctl[0] "Anti-bounce counter of the ETC actuator diagnosis function " UBYTE _CNV_A_R_LINEAR_____0_CM 1 100. 0. 255. DISPLAY_IDENTIFIER CTR_DIAG_ETC_CTL[1] ECU_ADDRESS 0xd0007758 FORMAT "%3.0" /end MEASUREMENT
/begin MEASUREMENT ctr_diag_etc_ctl[1] "Anti-bounce counter of the ETC actuator diagnosis function " UBYTE _CNV_A_R_LINEAR_____0_CM 1 100. 0. 255. DISPLAY_IDENTIFIER CTR_DIAG_ETC_CTL[2] ECU_ADDRESS 0xd0007759 FORMAT "%3.0" /end MEASUREMENT
/begin MEASUREMENT ctr_diag_end_etc_ctl[0] "End of diagnosis counter of the ETC actuator diagnosis function " UBYTE _CNV_A_R_LINEAR_____0_CM 1 100. 0. 255. DISPLAY_IDENTIFIER CTR_DIAG_END_ETC_CTL[1] ECU_ADDRESS 0xd0003984 FORMAT "%3.0" /end MEASUREMENT
/begin MEASUREMENT ctr_diag_end_etc_ctl[1] "End of diagnosis counter of the ETC actuator diagnosis function " UBYTE _CNV_A_R_LINEAR_____0_CM 1 100. 0. 255. DISPLAY_IDENTIFIER CTR_DIAG_END_ETC_CTL[2] ECU_ADDRESS 0xd0003985 FORMAT "%3.0" /end MEASUREMENT
/begin MEASUREMENT tps_sp_grd[0] "Gradient of the throttle position setpoint, determined by low pass first order" SWORD _CNV_A_R_THRO_LINEA_899_CM 1 100. -119.507294146371 119.5 DISPLAY_IDENTIFIER TPS_SP_GRD[1] ECU_ADDRESS 0xd0003968 FORMAT "%8.3" /end MEASUREMENT
/begin MEASUREMENT tps_sp_grd[1] "Gradient of the throttle position setpoint, determined by low pass first order" SWORD _CNV_A_R_THRO_LINEA_899_CM 1 100. -119.507294146371 119.5 DISPLAY_IDENTIFIER TPS_SP_GRD[2] ECU_ADDRESS 0xd000396a FORMAT "%8.3" /end MEASUREMENT
/begin MEASUREMENT tps_sp_fil[0] "Throttle position setpoint after filtering by low pass first order" UWORD _CNV_A_R_LINEAR_____227_CM 1 100. 0. 119.5 DISPLAY_IDENTIFIER TPS_SP_FIL[1] ECU_ADDRESS 0xd0003964 FORMAT "%7.3" /end MEASUREMENT
/begin MEASUREMENT tps_sp_fil[1] "Throttle position setpoint after filtering by low pass first order" UWORD _CNV_A_R_LINEAR_____227_CM 1 100. 0. 119.5 DISPLAY_IDENTIFIER TPS_SP_FIL[2] ECU_ADDRESS 0xd0003966 FORMAT "%7.3" /end MEASUREMENT
/begin MEASUREMENT tps_dif_err_max[0] "Maximum admissible control deviation of the closed-loop position control system" UWORD _CNV_A_R_LINEAR_____227_CM 1 100. 0. 119.5 DISPLAY_IDENTIFIER TPS_DIF_ERR_MAX[1] ECU_ADDRESS 0xd000394e FORMAT "%7.3" /end MEASUREMENT
/begin MEASUREMENT tps_dif_err_max[1] "Maximum admissible control deviation of the closed-loop position control system" UWORD _CNV_A_R_LINEAR_____227_CM 1 100. 0. 119.5 DISPLAY_IDENTIFIER TPS_DIF_ERR_MAX[2] ECU_ADDRESS 0xd0003950 FORMAT "%7.3" /end MEASUREMENT
/begin CHARACTERISTIC c_crlc_tps_sp "Correlation constant for filtering of TPS_SP" VALUE 0xa08080a2 _REC_VAL_20_u2 0.9999847412109381 _CNV_A_R_LINEAR_____89_CM 0. 0.9999847412109381 DISPLAY_IDENTIFIER C_CRLC_TPS_SP FORMAT "%7.5" /end CHARACTERISTIC
/begin CHARACTERISTIC c_abc_dec_etc_ctl "Anti-bounce decrement value ETC actuator diagnosis" VALUE 0xa0808090 _REC_VAL_20_u1 255. _CNV_A_R_LINEAR_____0_CM 0. 255. DISPLAY_IDENTIFIER C_ABC_DEC_ETC_CTL FORMAT "%3.0" /end CHARACTERISTIC
/begin CHARACTERISTIC ip_tps_dif_err_max "Maximum admissible control deviation dependent on the TPS setpoint gradient" CURVE 0xa0808070 _REC_CUR_20_u2_u2 119.5 _CNV_A_R_LINEAR_____227_CM 0. 119.5 DISPLAY_IDENTIFIER IP_TPS_DIF_ERR_MAX FORMAT "%7.3"
 /begin AXIS_DESCR COM_AXIS online_dummy _CNV_A_R_LINEAR_____227_CM 6 0. 119.5 FORMAT "%7.3" AXIS_PTS_REF ldp_tps_sp_grd_ip_tps_dif_err /end AXIS_DESCR
/end CHARACTERISTIC
/begin AXIS_PTS ldp_tps_sp_grd_ip_tps_dif_err "" 0xa0808050 online_dummy _REC_AXS_20_u2 119.5 _CNV_A_R_LINEAR_____227_CM 6 0. 119.5 FORMAT "%7.3" /end AXIS_PTS
/begin MEASUREMENT ctr_diag_etc_pwm[0] "anti-bounce counter of the pwm_etc monitoring" UWORD _CNV_A_R_LINEAR_____0_CM 1 100. 0. 65535. DISPLAY_IDENTIFIER CTR_DIAG_ETC_PWM[1] ECU_ADDRESS 0xd0007210 FORMAT "%5.0" /end MEASUREMENT
/begin MEASUREMENT ctr_diag_etc_pwm[1] "anti-bounce counter of the pwm_etc monitoring" UWORD _CNV_A_R_LINEAR_____0_CM 1 100. 0. 65535. DISPLAY_IDENTIFIER CTR_DIAG_ETC_PWM[2] ECU_ADDRESS 0xd0007212 FORMAT "%5.0" /end MEASUREMENT
/begin MEASUREMENT ctr_diag_end_etc_pwm[0] "End of diagnosis counter of the PWM_ETC monitoring" UBYTE _CNV_A_R_LINEAR_____0_CM 1 100. 0. 255. DISPLAY_IDENTIFIER CTR_DIAG_END_ETC_PWM[1] ECU_ADDRESS 0xd0003986 FORMAT "%3.0" /end MEASUREMENT
/begin MEASUREMENT ctr_diag_end_etc_pwm[1] "End of diagnosis counter of the PWM_ETC monitoring" UBYTE _CNV_A_R_LINEAR_____0_CM 1 100. 0. 255. DISPLAY_IDENTIFIER CTR_DIAG_END_ETC_PWM[2] ECU_ADDRESS 0xd0003987 FORMAT "%3.0" /end MEASUREMENT
/begin CHARACTERISTIC c_abc_inc_etc_pwm "Anti-bounce increment value ETC actuator diagnosis" VALUE 0xa0808094 _REC_VAL_20_u1 255. _CNV_A_R_LINEAR_____0_CM 0. 255. DISPLAY_IDENTIFIER C_ABC_INC_ETC_PWM FORMAT "%3.0" /end CHARACTERISTIC
/begin CHARACTERISTIC c_abc_dec_etc_pwm "Anti-bounce decrement value ETC actuator diagnosis" VALUE 0xa0808091 _REC_VAL_20_u1 255. _CNV_A_R_LINEAR_____0_CM 0. 255. DISPLAY_IDENTIFIER C_ABC_DEC_ETC_PWM FORMAT "%3.0" /end CHARACTERISTIC
/begin CHARACTERISTIC c_abc_max_etc_pwm "Anti-bounce maximum value ETC actuator diagnosis" VALUE 0xa080809a _REC_VAL_20_u2 65534. _CNV_A_R_LINEAR_____0_CM 1. 65535. DISPLAY_IDENTIFIER C_ABC_MAX_ETC_PWM FORMAT "%5.0" /end CHARACTERISTIC
/begin CHARACTERISTIC c_abc_min_etc_pwm "Anti-bounce minimum value ETC actuator diagnosis" VALUE 0xa080809f _REC_VAL_20_u1 254. _CNV_A_R_LINEAR_____0_CM 1. 255. DISPLAY_IDENTIFIER C_ABC_MIN_ETC_PWM FORMAT "%3.0" /end CHARACTERISTIC
/begin CHARACTERISTIC c_abc_inc_etc_ctl "Anti-bounce increment value ETC actuator diagnosis" VALUE 0xa0808092 _REC_VAL_20_u1 255. _CNV_A_R_LINEAR_____0_CM 0. 255. DISPLAY_IDENTIFIER C_ABC_INC_ETC_CTL FORMAT "%3.0" /end CHARACTERISTIC
/begin CHARACTERISTIC c_abc_max_etc_ctl "Anti-bounce imaximum value ETC actuator diagnosis" VALUE 0xa0808098 _REC_VAL_20_u1 254. _CNV_A_R_LINEAR_____0_CM 1. 255. DISPLAY_IDENTIFIER C_ABC_MAX_ETC_CTL FORMAT "%3.0" /end CHARACTERISTIC
/begin MEASUREMENT lv_err_etc_ctl_1 "Logical variable is set, if a ETC actuator error is present" UBYTE _CNV_S_2_RANGE__0___1_CM 1 100. 0. 1. DISPLAY_IDENTIFIER LV_ERR_ETC_CTL[1] ECU_ADDRESS 0xd0008061 BIT_MASK 0x1 /end MEASUREMENT
/begin MEASUREMENT lv_err_etc_ctl_2 "Logical variable is set, if a ETC actuator error is present" UBYTE _CNV_S_2_RANGE__0___1_CM 1 100. 0. 1. DISPLAY_IDENTIFIER LV_ERR_ETC_CTL[2] ECU_ADDRESS 0xd0008062 BIT_MASK 0x1 /end MEASUREMENT
/begin MEASUREMENT lv_err_etc_pwm_1 "Logical variable is set, if PWM_ETC monitoring error is present" UBYTE _CNV_S_2_RANGE__0___1_CM 1 100. 0. 1. DISPLAY_IDENTIFIER LV_ERR_ETC_PWM[1] ECU_ADDRESS 0xd000805f BIT_MASK 0x1 /end MEASUREMENT
/begin MEASUREMENT lv_err_etc_pwm_2 "Logical variable is set, if PWM_ETC monitoring error is present" UBYTE _CNV_S_2_RANGE__0___1_CM 1 100. 0. 1. DISPLAY_IDENTIFIER LV_ERR_ETC_PWM[2] ECU_ADDRESS 0xd0008060 BIT_MASK 0x1 /end MEASUREMENT
/begin MEASUREMENT lv_inh_diag_etc_ctl[0] "Inhibition condition for the ETC control deviation diagnosis" UBYTE _CNV_S_2_RANGE__0___1_CM 1 100. 0. 1. DISPLAY_IDENTIFIER LV_INH_DIAG_ETC_CTL[1] ECU_ADDRESS 0xd000776e BIT_MASK 0x1 /end MEASUREMENT
/begin MEASUREMENT lv_inh_diag_etc_ctl[1] "Inhibition condition for the ETC control deviation diagnosis" UBYTE _CNV_S_2_RANGE__0___1_CM 1 100. 0. 1. DISPLAY_IDENTIFIER LV_INH_DIAG_ETC_CTL[2] ECU_ADDRESS 0xd000776f BIT_MASK 0x1 /end MEASUREMENT
/begin MEASUREMENT lv_inh_diag_etc_pwm[0] "Inhibition condition for the ETC position controller output monitoring" UBYTE _CNV_S_2_RANGE__0___1_CM 1 100. 0. 1. DISPLAY_IDENTIFIER LV_INH_DIAG_ETC_PWM[1] ECU_ADDRESS 0xd0007772 BIT_MASK 0x1 /end MEASUREMENT
/begin MEASUREMENT lv_inh_diag_etc_pwm[1] "Inhibition condition for the ETC position controller output monitoring" UBYTE _CNV_S_2_RANGE__0___1_CM 1 100. 0. 1. DISPLAY_IDENTIFIER LV_INH_DIAG_ETC_PWM[2] ECU_ADDRESS 0xd0007773 BIT_MASK 0x1 /end MEASUREMENT
/begin CHARACTERISTIC c_vb_min_pwm_etc_diag "Threshold depend on battery voltage for the activation of the PWM_ETC monitoring " VALUE 0xa08080f5 _REC_VAL_20_u1 25.8984375 _CNV_A_R_LINEAR_____272_CM 0. 25.8984375 DISPLAY_IDENTIFIER C_VB_MIN_PWM_ETC_DIAG FORMAT "%9.6" /end CHARACTERISTIC
/begin CHARACTERISTIC c_abc_inc_etc_dr "Antibounce counter increment" VALUE 0xa0808093 _REC_VAL_20_u1 255. _CNV_A_R_LINEAR_____0_CM 0. 255. DISPLAY_IDENTIFIER C_ABC_INC_ETC_DR FORMAT "%3.0" /end CHARACTERISTIC
/begin CHARACTERISTIC c_abc_max_etc_dr "Maximum value for antibounce counter" VALUE 0xa0808099 _REC_VAL_20_u1 254. _CNV_A_R_LINEAR_____0_CM 1. 255. DISPLAY_IDENTIFIER C_ABC_MAX_ETC_DR FORMAT "%3.0" /end CHARACTERISTIC
/begin MEASUREMENT lv_err_etc_dr_1 "Present failure after filtering of ETC power stage diagnostic " UBYTE _CNV_S_2_RANGE__0___1_CM 1 100. 0. 1. DISPLAY_IDENTIFIER LV_ERR_ETC_DR[1] ECU_ADDRESS 0xd0008065 BIT_MASK 0x1 /end MEASUREMENT
/begin MEASUREMENT lv_err_etc_dr_2 "Present failure after filtering of ETC power stage diagnostic " UBYTE _CNV_S_2_RANGE__0___1_CM 1 100. 0. 1. DISPLAY_IDENTIFIER LV_ERR_ETC_DR[2] ECU_ADDRESS 0xd0008066 BIT_MASK 0x1 /end MEASUREMENT
/begin MEASUREMENT lv_inh_diag_etc_dr[0] "Inhibition condition for the power stage diagnosis based on SF" UBYTE _CNV_S_2_RANGE__0___1_CM 1 100. 0. 1. DISPLAY_IDENTIFIER LV_INH_DIAG_ETC_DR[1] ECU_ADDRESS 0xd0007770 BIT_MASK 0x1 /end MEASUREMENT
/begin MEASUREMENT lv_inh_diag_etc_dr[1] "Inhibition condition for the power stage diagnosis based on SF" UBYTE _CNV_S_2_RANGE__0___1_CM 1 100. 0. 1. DISPLAY_IDENTIFIER LV_INH_DIAG_ETC_DR[2] ECU_ADDRESS 0xd0007771 BIT_MASK 0x1 /end MEASUREMENT
/begin CHARACTERISTIC c_vb_min_etc_dr_diag "Battery voltage threshold to inhibit the ETC power stage diagnosis " VALUE 0xa08080f4 _REC_VAL_20_u1 25.8984375 _CNV_A_R_LINEAR_____272_CM 0. 25.8984375 DISPLAY_IDENTIFIER C_VB_MIN_ETC_DR_DIAG FORMAT "%9.6" /end CHARACTERISTIC
/begin CHARACTERISTIC c_abc_inc_tps_1 "Anti-bounce increment value TPS 1 diagnosis" VALUE 0xa0808095 _REC_VAL_20_u1 255. _CNV_A_R_LINEAR_____0_CM 0. 255. DISPLAY_IDENTIFIER C_ABC_INC_TPS_1 FORMAT "%3.0" /end CHARACTERISTIC
/begin CHARACTERISTIC c_abc_inc_tps_2 "Anti-bounce increment value TPS 2 diagnosis" VALUE 0xa0808096 _REC_VAL_20_u1 255. _CNV_A_R_LINEAR_____0_CM 0. 255. DISPLAY_IDENTIFIER C_ABC_INC_TPS_2 FORMAT "%3.0" /end CHARACTERISTIC
/begin CHARACTERISTIC c_abc_max_tps_1 "Anti-bounce maximum value TPS 1 diagnosis" VALUE 0xa080809c _REC_VAL_20_u1 254. _CNV_A_R_LINEAR_____0_CM 1. 255. DISPLAY_IDENTIFIER C_ABC_MAX_TPS_1 FORMAT "%3.0" /end CHARACTERISTIC
/begin CHARACTERISTIC c_abc_max_tps_2 "Anti-bounce maximum value TPS 2 diagnosis" VALUE 0xa080809d _REC_VAL_20_u1 254. _CNV_A_R_LINEAR_____0_CM 1. 255. DISPLAY_IDENTIFIER C_ABC_MAX_TPS_2 FORMAT "%3.0" /end CHARACTERISTIC
/begin CHARACTERISTIC c_vp_tps_max_diag_1 "Upper diagnostic voltage TPS 1" VALUE 0xa080810a _REC_VAL_20_s2 9.99984741210938 _CNV_A_R_THRO_LINEA_895_CM -5. 4.99984741210938 DISPLAY_IDENTIFIER C_VP_TPS_MAX_DIAG_1 FORMAT "%7.4" /end CHARACTERISTIC
/begin CHARACTERISTIC c_vp_tps_max_diag_2 "Upper diagnostic voltage TPS 2" VALUE 0xa080810c _REC_VAL_20_s2 9.99984741210938 _CNV_A_R_THRO_LINEA_895_CM -5. 4.99984741210938 DISPLAY_IDENTIFIER C_VP_TPS_MAX_DIAG_2 FORMAT "%7.4" /end CHARACTERISTIC
/begin CHARACTERISTIC c_vp_tps_min_diag_1 "Lower diagnostic voltage TPS 1" VALUE 0xa080810e _REC_VAL_20_s2 9.99984741210938 _CNV_A_R_THRO_LINEA_895_CM -5. 4.99984741210938 DISPLAY_IDENTIFIER C_VP_TPS_MIN_DIAG_1 FORMAT "%7.4" /end CHARACTERISTIC
/begin CHARACTERISTIC c_vp_tps_min_diag_2 "Lower diagnostic voltage TPS 2" VALUE 0xa0808110 _REC_VAL_20_s2 9.99984741210938 _CNV_A_R_THRO_LINEA_895_CM -5. 4.99984741210938 DISPLAY_IDENTIFIER C_VP_TPS_MIN_DIAG_2 FORMAT "%7.4" /end CHARACTERISTIC
/begin MEASUREMENT lv_err_tps_1_1 "Present failure after filtering of diagnostic TPS 1" UBYTE _CNV_S_2_RANGE__0___1_CM 1 100. 0. 1. DISPLAY_IDENTIFIER LV_ERR_TPS_1[1] ECU_ADDRESS 0xd0008053 BIT_MASK 0x1 /end MEASUREMENT
/begin MEASUREMENT lv_err_tps_1_2 "Present failure after filtering of diagnostic TPS 1" UBYTE _CNV_S_2_RANGE__0___1_CM 1 100. 0. 1. DISPLAY_IDENTIFIER LV_ERR_TPS_1[2] ECU_ADDRESS 0xd0008054 BIT_MASK 0x1 /end MEASUREMENT
/begin MEASUREMENT lv_err_tps_2_1 "Present failure after filtering of diagnostic TPS 2" UBYTE _CNV_S_2_RANGE__0___1_CM 1 100. 0. 1. DISPLAY_IDENTIFIER LV_ERR_TPS_2[1] ECU_ADDRESS 0xd0008055 BIT_MASK 0x1 /end MEASUREMENT
/begin MEASUREMENT lv_err_tps_2_2 "Present failure after filtering of diagnostic TPS 2" UBYTE _CNV_S_2_RANGE__0___1_CM 1 100. 0. 1. DISPLAY_IDENTIFIER LV_ERR_TPS_2[2] ECU_ADDRESS 0xd0008056 BIT_MASK 0x1 /end MEASUREMENT
/begin MEASUREMENT lv_inh_diag_tps_2[0] "Inhibition condition for the TPS 2 diagnosis" UBYTE _CNV_S_2_RANGE__0___1_CM 1 100. 0. 1. DISPLAY_IDENTIFIER LV_INH_DIAG_TPS_2[1] ECU_ADDRESS 0xd0007776 BIT_MASK 0x1 /end MEASUREMENT
/begin MEASUREMENT lv_inh_diag_tps_2[1] "Inhibition condition for the TPS 2 diagnosis" UBYTE _CNV_S_2_RANGE__0___1_CM 1 100. 0. 1. DISPLAY_IDENTIFIER LV_INH_DIAG_TPS_2[2] ECU_ADDRESS 0xd0007777 BIT_MASK 0x1 /end MEASUREMENT
/begin MEASUREMENT lv_err_tps_vcc[0] "Throttle position sensor supply voltage error, isn't supported by the error management" UBYTE _CNV_S_2_RANGE__0___1_CM 1 100. 0. 1. DISPLAY_IDENTIFIER LV_ERR_TPS_VCC[1] ECU_ADDRESS 0xd0007768 BIT_MASK 0x1 /end MEASUREMENT
/begin MEASUREMENT lv_err_tps_vcc[1] "Throttle position sensor supply voltage error, isn't supported by the error management" UBYTE _CNV_S_2_RANGE__0___1_CM 1 100. 0. 1. DISPLAY_IDENTIFIER LV_ERR_TPS_VCC[2] ECU_ADDRESS 0xd0007769 BIT_MASK 0x1 /end MEASUREMENT
/begin MEASUREMENT lv_inh_diag_tps_1[0] "Inhibition condition for the TPS 1 diagnosis" UBYTE _CNV_S_2_RANGE__0___1_CM 1 100. 0. 1. DISPLAY_IDENTIFIER LV_INH_DIAG_TPS_1[1] ECU_ADDRESS 0xd0007774 BIT_MASK 0x1 /end MEASUREMENT
/begin MEASUREMENT lv_inh_diag_tps_1[1] "Inhibition condition for the TPS 1 diagnosis" UBYTE _CNV_S_2_RANGE__0___1_CM 1 100. 0. 1. DISPLAY_IDENTIFIER LV_INH_DIAG_TPS_1[2] ECU_ADDRESS 0xd0007775 BIT_MASK 0x1 /end MEASUREMENT
/begin COMPU_METHOD _CNV_A_R_LINEAR_____0_CM "" RAT_FUNC "%6.3" "-" COEFFS 0 1. 0. 0 0 1 /end COMPU_METHOD
/begin COMPU_METHOD _CNV_S_2_RANGE__0___1_CM "" TAB_VERB "%6.3" "-" COMPU_TAB_REF _CNV_S_2_RANGE__0___1 /end COMPU_METHOD
/begin COMPU_VTAB _CNV_S_2_RANGE__0___1 "" TAB_VERB 2 0 "0" 1 "1" /end COMPU_VTAB
/begin COMPU_METHOD _CNV_A_R_LINEAR_____2_CM "" RAT_FUNC "%6.3" "V" COEFFS 0 204.8 0. 0 0 1 /end COMPU_METHOD
/begin COMPU_METHOD _CNV_A_R_LINEAR_____5_CM "" RAT_FUNC "%6.3" "%" COEFFS 0 2.56 0. 0 0 1 /end COMPU_METHOD
/begin COMPU_METHOD _CNV_A_R_LINEAR_____8_CM "" RAT_FUNC "%6.3" "%" COEFFS 0 655.3599999999997 0. 0 0 1 /end COMPU_METHOD
/begin COMPU_METHOD _CNV_A_R_LINEAR_____9_CM "" RAT_FUNC "%6.3" "-" COEFFS 0 32767.99999999992 0. 0 0 1 /end COMPU_METHOD
/begin COMPU_METHOD _CNV_A_R_LINEAR_____10_CM "" RAT_FUNC "%6.3" "rpm" COEFFS 0 3.125e-002 0. 0 0 1 /end COMPU_METHOD
/begin COMPU_METHOD _CNV_A_R_LINEAR_____14_CM "" RAT_FUNC "%6.3" "rpm" COEFFS 0 1. 0. 0 0 1 /end COMPU_METHOD
/begin COMPU_METHOD _CNV_A_R_LINEAR_____17_CM "" RAT_FUNC "%6.3" "°C" COEFFS 0 1.333333333333333 64. 0 0 1 /end COMPU_METHOD
/begin COMPU_METHOD _CNV_A_R_LINEAR_____26_CM "" RAT_FUNC "%6.3" "°C" COEFFS 0 1. 40. 0 0 1 /end COMPU_METHOD
/begin COMPU_METHOD _CNV_A_R_LINEAR_____31_CM "" RAT_FUNC "%6.3" "Nm" COEFFS 0 32. 0. 0 0 1 /end COMPU_METHOD
/begin COMPU_METHOD _CNV_A_R_LINEAR_____36_CM "" RAT_FUNC "%6.3" "s" COEFFS 0 1. 0. 0 0 1 /end COMPU_METHOD
/begin COMPU_METHOD _CNV_A_R_LINEAR_____89_CM "" RAT_FUNC "%6.3" "-" COEFFS 0 65535.99999999996 0. 0 0 1 /end COMPU_METHOD
/begin COMPU_METHOD _CNV_A_R_LINEAR_____103_CM "" RAT_FUNC "%6.3" "-" COEFFS 0 128. 0. 0 0 1 /end COMPU_METHOD
/begin COMPU_METHOD _CNV_A_R_LINEAR_____129_CM "" RAT_FUNC "%6.3" "-" COEFFS 0 1024. 0. 0 0 1 /end COMPU_METHOD
/begin COMPU_METHOD _CNV_A_R_LINEAR_____170_CM "" RAT_FUNC "%6.3" "rpm" COEFFS 0 4. 0. 0 0 1 /end COMPU_METHOD
/begin COMPU_METHOD _CNV_A_R_LINEAR_____185_CM "" RAT_FUNC "%6.3" "" COEFFS 0 256. 0. 0 0 1 /end COMPU_METHOD
/begin COMPU_METHOD _CNV_A_R_LINEAR_____199_CM "" RAT_FUNC "%6.3" "V" COEFFS 0 51.0204081632653 0. 0 0 1 /end COMPU_METHOD
/begin COMPU_METHOD _CNV_A_R_LINEAR_____207_CM "" RAT_FUNC "%6.3" "V" COEFFS 0 51.2 0. 0 0 1 /end COMPU_METHOD
/begin COMPU_METHOD _CNV_A_R_LINEAR_____212_CM "" RAT_FUNC "%6.3" "%" COEFFS 0 327.68 0. 0 0 1 /end COMPU_METHOD
/begin COMPU_METHOD _CNV_A_R_LINEAR_____227_CM "" RAT_FUNC "%6.3" "°TPS" COEFFS 0 137.0962343096234 0. 0 0 1 /end COMPU_METHOD
/begin COMPU_METHOD _CNV_A_R_LINEAR_____261_CM "" RAT_FUNC "%6.3" "s" COEFFS 0 25. 0. 0 0 1 /end COMPU_METHOD
/begin COMPU_METHOD _CNV_A_R_LINEAR_____262_CM "" RAT_FUNC "%6.3" "Nm" COEFFS 0 0.5 0. 0 0 1 /end COMPU_METHOD
/begin COMPU_METHOD _CNV_A_R_LINEAR_____272_CM "Battery voltage" RAT_FUNC "%6.3" "V" COEFFS 0 9.846153846153847 0. 0 0 1 /end COMPU_METHOD
/begin COMPU_METHOD _CNV_A_R_LINEAR_____288_CM "" RAT_FUNC "%6.3" "Hz" COEFFS 0 1. 0. 0 0 1 /end COMPU_METHOD
/begin COMPU_METHOD _CNV_A_R_EVAC_LINEA_298_CM "" RAT_FUNC "%6.3" "-" COEFFS 0 16. 0. 0 0 1 /end COMPU_METHOD
/begin COMPU_METHOD _CNV_A_R_ENSD_LINEA_399_CM "" RAT_FUNC "%6.3" "°C" COEFFS 0 1. 50. 0 0 1 /end COMPU_METHOD
/begin COMPU_METHOD _CNV_A_R_LINEAR_____424_CM "" RAT_FUNC "%6.3" "hPa" COEFFS 0 3.125e-002 0. 0 0 1 /end COMPU_METHOD
/begin COMPU_METHOD _CNV_A_R_LINEAR_____425_CM "" RAT_FUNC "%6.3" "V" COEFFS 0 10. 0. 0 0 1 /end COMPU_METHOD
/begin COMPU_METHOD _CNV_A_R_LINEAR_____446_CM "" RAT_FUNC "%6.3" "A" COEFFS 0 1. 0. 0 0 1 /end COMPU_METHOD
/begin COMPU_METHOD _CNV_A_R_CPULOAD__0_448_CM "" RAT_FUNC "%6.3" "%" COEFFS 0 10.24 0. 0 0 1 /end COMPU_METHOD
/begin COMPU_METHOD _CNV_A_R_LINEAR_____456_CM "" RAT_FUNC "%6.3" "ms" COEFFS 0 250. 0. 0 0 1 /end COMPU_METHOD
/begin COMPU_METHOD _CNV_A_R_LINEAR_____522_CM "" RAT_FUNC "%6.3" "°C" COEFFS 0 0.5 0. 0 0 1 /end COMPU_METHOD
/begin COMPU_METHOD _CNV_A_R_LINEAR_____545_CM "" RAT_FUNC "%6.3" "°CRK" COEFFS 0 2.666666666666667 -160. 0 0 1 /end COMPU_METHOD
/begin COMPU_METHOD _CNV_A_R_LINEAR_____851_CM "" RAT_FUNC "%6.3" "%" COEFFS 0 1.28 128. 0 0 1 /end COMPU_METHOD
/begin COMPU_METHOD _CNV_A_R_LINEAR_____852_CM "" RAT_FUNC "%6.3" "kPa" COEFFS 0 0.3333333333333333 0. 0 0 1 /end COMPU_METHOD
/begin COMPU_METHOD _CNV_A_R_LINEAR_____853_CM "" RAT_FUNC "%6.3" "kPa" COEFFS 0 1. 0. 0 0 1 /end COMPU_METHOD
/begin COMPU_METHOD _CNV_A_R_LINEAR_____854_CM "" RAT_FUNC "%6.3" "°CRK" COEFFS 0 2. 128. 0 0 1 /end COMPU_METHOD
/begin COMPU_METHOD _CNV_A_R_LINEAR_____855_CM "" RAT_FUNC "%6.3" "g/s" COEFFS 0 100. 0. 0 0 1 /end COMPU_METHOD
/begin COMPU_METHOD _CNV_A_R_LINEAR_____856_CM "" RAT_FUNC "%6.3" "-" COEFFS 0 1023.999989719843 0. 0 0 1 /end COMPU_METHOD
/begin COMPU_METHOD _CNV_A_R_LINEAR_____857_CM "" RAT_FUNC "%6.3" "ohm" COEFFS 0 3.90625e-003 0. 0 0 1 /end COMPU_METHOD
/begin COMPU_METHOD _CNV_A_R_LINEAR_____858_CM "" RAT_FUNC "%6.3" "ohm" COEFFS 0 1. 0. 0 0 1 /end COMPU_METHOD
/begin COMPU_METHOD _CNV_A_R_LINEAR_____859_CM "" RAT_FUNC "%6.3" "ohm" COEFFS 0 1.5625e-002 0. 0 0 1 /end COMPU_METHOD
/begin COMPU_METHOD _CNV_A_R_LINEAR_____860_CM "" RAT_FUNC "%6.3" "ohm" COEFFS 0 4. 0. 0 0 1 /end COMPU_METHOD
/begin COMPU_METHOD _CNV_A_R_LINEAR_____861_CM "" RAT_FUNC "%6.3" "min" COEFFS 0 0.25 0. 0 0 1 /end COMPU_METHOD
/begin COMPU_METHOD _CNV_A_R_LINEAR_____862_CM "" RAT_FUNC "%6.3" "V" COEFFS 0 25.59999871498046 0. 0 0 1 /end COMPU_METHOD
/begin COMPU_METHOD _CNV_A_R_LINEAR_____863_CM "" RAT_FUNC "%6.3" "V" COEFFS 0 204.8011822248637 7.388905397931467e-004 0 0 1 /end COMPU_METHOD
/begin COMPU_METHOD _CNV_A_R_LINEAR_____864_CM "" RAT_FUNC "%6.3" "mA" COEFFS 0 5.120000771011881 0. 0 0 1 /end COMPU_METHOD
/begin COMPU_METHOD _CNV_A_R_LINEAR_____865_CM "" RAT_FUNC "%6.3" "V" COEFFS 0 1000. 0. 0 0 1 /end COMPU_METHOD
/begin COMPU_METHOD _CNV_A_R_LINEAR_____866_CM "" RAT_FUNC "%6.3" "rpm" COEFFS 0 1.5625e-002 0. 0 0 1 /end COMPU_METHOD
/begin COMPU_METHOD _CNV_A_R_LINEAR_____867_CM "" RAT_FUNC "%6.3" "-" COEFFS 0 250. 0. 0 0 1 /end COMPU_METHOD
/begin COMPU_METHOD _CNV_A_R_LINEAR_____868_CM "" RAT_FUNC "%6.3" "A^2" COEFFS 0 0.125 0. 0 0 1 /end COMPU_METHOD
/begin COMPU_METHOD _CNV_A_R_LINEAR_____869_CM "" RAT_FUNC "%6.3" "hPa" COEFFS 0 7.360964372932435e-004 0. 0 0 1 /end COMPU_METHOD
/begin COMPU_METHOD _CNV_A_R_LINEAR_____870_CM "" RAT_FUNC "%6.3" "hPa" COEFFS 0 1.472192874586487e-003 0. 0 0 1 /end COMPU_METHOD
/begin COMPU_METHOD _CNV_A_R_LINEAR_____871_CM "" RAT_FUNC "%6.3" "us" COEFFS 0 3.90625e-003 0. 0 0 1 /end COMPU_METHOD
/begin COMPU_METHOD _CNV_A_R_LINEAR_____872_CM "" RAT_FUNC "%6.3" "°C" COEFFS 0 10. 127.5 0 0 1 /end COMPU_METHOD
/begin COMPU_METHOD _CNV_A_R_LINEAR_____873_CM "" RAT_FUNC "%6.3" "°C" COEFFS 0 1.9921875 -19.921875 0 0 1 /end COMPU_METHOD
/begin COMPU_METHOD _CNV_A_R_LINEAR_____874_CM "" RAT_FUNC "%6.3" "°TPS" COEFFS 0 2.142128661087866 0. 0 0 1 /end COMPU_METHOD
/begin COMPU_METHOD _CNV_A_R_LINEAR_____875_CM "" RAT_FUNC "%6.3" "V" COEFFS 0 51.20008995153059 0. 0 0 1 /end COMPU_METHOD
/begin COMPU_METHOD _CNV_A_R_LINEAR_____876_CM "" RAT_FUNC "%6.3" "V" COEFFS 0 77.27272727272728 0. 0 0 1 /end COMPU_METHOD
/begin COMPU_METHOD _CNV_A_R_LINEAR_____877_CM "" RAT_FUNC "%6.3" "°" COEFFS 0 1.28 0. 0 0 1 /end COMPU_METHOD
/begin COMPU_METHOD _CNV_A_R_LINEAR_____878_CM "" RAT_FUNC "%6.3" "°" COEFFS 0 1.422222261883322 0. 0 0 1 /end COMPU_METHOD
/begin COMPU_METHOD _CNV_A_R_LINEAR_____879_CM "" RAT_FUNC "%6.3" "°CRK" COEFFS 0 2.5 -125. 0 0 1 /end COMPU_METHOD
/begin COMPU_METHOD _CNV_S_31_ECM3_ERR_C_881_CM "" TAB_VERB "%6.3" "-" COMPU_TAB_REF _CNV_S_31_ECM3_ERR_C_881 /end COMPU_METHOD
/begin COMPU_VTAB _CNV_S_31_ECM3_ERR_C_881 "" TAB_VERB 31 0 "NOT_ERR" 1 "COM_HD" 2 "COM_CKS" 3 "COM_PAR" 4 "CONF_DIF" 5 "SOPC(MC) or CONF_CPL(MU)" 6 "COMP_NR" 7 "ROM_LEVEL_1(MC) or TOUT_MAX(MU)" 8 "RAM_LEVEL_1(MC) or TOUT_MIN(MU)" 9 "ROM_LEVEL_2(MC) or IGK_MON(MU)" 10 "RAM_LEVEL_2(MC) or EOLT(MU)" 11 "WRG_IDX(MC) or FCT_SPC_IST(MU)" 12 "WRG_RESP(MC) or DR_OFF(MU)" 13 "NOT_DEC(MC) or V_L(MU)" 14 "V_H(MU)" 15 "V_L_H(MU)" 16 "PFM_0_TOG(MC) or PFM_0(MU)" 17 "PFM_1_TOG(MC) or PFM_1(MU)" 18 "PFM_2_TOG(MC) or PFM_2(MU)" 19 "PFM_3_TOG(MC) or PFM_3(MU)" 20 "PFM_4_TOG(MC) or PFM_4(MU)" 21 "PFM_5_TOG(MC) or PFM_5(MU)" 22 "PFM_6_TOG(MC) or PFM_6(MU)" 23 "NOT_VLD_TRAN" 24 "PFM_0_RESP(MC)" 25 "PFM_1_RESP(MC)" 26 "PFM_2_RESP(MC)" 27 "PFM_3_RESP(MC)" 28 "PFM_4_RESP(MC)" 29 "PFM_5_RESP(MC)" 30 "PFM_6_RESP(MC)" /end COMPU_VTAB
/begin COMPU_METHOD _CNV_S_4_ECM3_STATE_882_CM "" TAB_VERB "%6.3" "-" COMPU_TAB_REF _CNV_S_4_ECM3_STATE_882 /end COMPU_METHOD
/begin COMPU_VTAB _CNV_S_4_ECM3_STATE_882 "" TAB_VERB 4 0 "NOT_PRES" 1 "REST_REQ" 2 "DI_REQ" 3 "PREV_REST" /end COMPU_VTAB
/begin COMPU_METHOD _CNV_S_2_ECM3_LV_MC_883_CM "" TAB_VERB "%6.3" "-" COMPU_TAB_REF _CNV_S_2_ECM3_LV_MC_883 /end COMPU_METHOD
/begin COMPU_VTAB _CNV_S_2_ECM3_LV_MC_883 "" TAB_VERB 2 0 "MU" 1 "MC" /end COMPU_VTAB
/begin COMPU_METHOD _CNV_S_29_ECM3_ERR_C_884_CM "" TAB_VERB "%6.3" "-" COMPU_TAB_REF _CNV_S_29_ECM3_ERR_C_884 /end COMPU_METHOD
/begin COMPU_VTAB _CNV_S_29_ECM3_ERR_C_884 "" TAB_VERB 29 0 "NOT_ERR" 1 "COM_HD" 2 "COM_CKS" 3 "COM_PAR" 4 "CONF_DIF" 5 "SOPC" 6 "COMP_NR" 7 "ROM_LEVEL_1" 8 "RAM_LEVEL_1" 9 "ROM_LEVEL_2" 10 "RAM_LEVEL_2" 11 "WRG_IDX" 12 "WRG_RESP" 13 "NOT_DEC" 16 "PFM_0_TOG" 17 "PFM_1_TOG" 18 "PFM_2_TOG" 19 "PFM_3_TOG" 20 "PFM_4_TOG" 21 "PFM_5_TOG" 22 "PFM_6_TOG" 23 "NOT_VLD_TRAN" 24 "PFM_0_RESP" 25 "PFM_1_RESP" 26 "PFM_2_RESP" 27 "PFM_3_RESP" 28 "PFM_4_RESP" 29 "PFM_5_RESP" 30 "PFM_6_RESP" /end COMPU_VTAB
/begin COMPU_METHOD _CNV_S_24_ECM3_ERR_C_885_CM "" TAB_VERB "%6.3" "-" COMPU_TAB_REF _CNV_S_24_ECM3_ERR_C_885 /end COMPU_METHOD
/begin COMPU_VTAB _CNV_S_24_ECM3_ERR_C_885 "" TAB_VERB 24 0 "NOT_ERR" 1 "COM_HD" 2 "COM_CKS" 3 "COM_PAR" 4 "CONF_DIF" 5 "CONF_CPL" 6 "COMP_NR" 7 "TOUT_MAX" 8 "TOUT_MIN" 9 "IGK_MON" 10 "EOLT" 11 "FCT_SPC_IST" 12 "DR_OFF" 13 "V_L" 14 "V_H" 15 "V_L_H" 16 "PFM_0" 17 "PFM_1" 18 "PFM_2" 19 "PFM_3" 20 "PFM_4" 21 "PFM_5" 22 "PFM_6" 23 "NOT_VLD_TRAN" /end COMPU_VTAB
/begin COMPU_METHOD _CNV_S_4_ECM3_MU_DI_886_CM "" TAB_VERB "%6.3" "" COMPU_TAB_REF _CNV_S_4_ECM3_MU_DI_886 /end COMPU_METHOD
/begin COMPU_VTAB _CNV_S_4_ECM3_MU_DI_886 "" TAB_VERB 4 0 "MU_DI_NOT_REQ" 1 "MU_DI_BUSY" 2 "MU_DI_ERR" 3 "MU_DI_OK" /end COMPU_VTAB
/begin COMPU_METHOD _CNV_A_R_LINEAR_____888_CM "" RAT_FUNC "%6.3" "°TPS/s" COEFFS 0 8.533333333333333e-002 0. 0 0 1 /end COMPU_METHOD
/begin COMPU_METHOD _CNV_A_R_THRO_LINEA_889_CM "" RAT_FUNC "%6.3" "s" COEFFS 0 200. 0. 0 0 1 /end COMPU_METHOD
/begin COMPU_METHOD _CNV_A_R_THRO_LINEA_890_CM "" RAT_FUNC "%6.3" "°TPS/5ms" COEFFS 0 137.0962343096236 0. 0 0 1 /end COMPU_METHOD
/begin COMPU_METHOD _CNV_A_R_THRO_LINEA_891_CM "" RAT_FUNC "%6.3" "°TPS" COEFFS 0 137.0962343096236 0. 0 0 1 /end COMPU_METHOD
/begin COMPU_METHOD _CNV_A_R_THRO_LINEA_892_CM "" RAT_FUNC "%6.3" "°TPS/V" COEFFS 0 1365.333333279999 0. 0 0 1 /end COMPU_METHOD
/begin COMPU_METHOD _CNV_S_13_THRO_RANGE_893_CM "" TAB_VERB "%6.3" "-" COMPU_TAB_REF _CNV_S_13_THRO_RANGE_893 /end COMPU_METHOD
/begin COMPU_VTAB _CNV_S_13_THRO_RANGE_893 "" TAB_VERB 13 0 "ST_CHK_LIH" 1 "ST_GO_TOL" 2 "ST_SPR_CHK" 3 "ST_CHK_END" 4 "AD_INIT" 5 "AD_LIH_POS" 6 "AD_GO_BOL" 7 "AD_BOL_POS" 8 "AD_GO_LIH" 9 "AD_SPR_CHK_1" 10 "AD_GO_TOL" 11 "AD_SPR_CHK_2" 12 "AD_END" /end COMPU_VTAB
/begin COMPU_METHOD _CNV_S_4_THRO_RANGE_894_CM "" TAB_VERB "%6.3" "-" COMPU_TAB_REF _CNV_S_4_THRO_RANGE_894 /end COMPU_METHOD
/begin COMPU_VTAB _CNV_S_4_THRO_RANGE_894 "" TAB_VERB 4 0 "BOL_RESET" 1 "BOL_WAIT" 2 "BOL_INC" 3 "BOL_DEC" /end COMPU_VTAB
/begin COMPU_METHOD _CNV_A_R_THRO_LINEA_895_CM "" RAT_FUNC "%6.3" "V" COEFFS 0 6553.599999999997 -1.455191522836685e-011 0 0 1 /end COMPU_METHOD
/begin COMPU_METHOD _CNV_A_R_LINEAR_____896_CM "" RAT_FUNC "%6.3" "°TPS/10ms" COEFFS 0 137.0962343096234 0. 0 0 1 /end COMPU_METHOD
/begin COMPU_METHOD _CNV_S_3_THRO_RANGE_897_CM "" TAB_VERB "%6.3" "-" COMPU_TAB_REF _CNV_S_3_THRO_RANGE_897 /end COMPU_METHOD
/begin COMPU_VTAB _CNV_S_3_THRO_RANGE_897 "" TAB_VERB 3 0 "INIT" 1 "UP" 2 "DOWN" /end COMPU_VTAB
/begin COMPU_METHOD _CNV_S_5_THRO_RANGE_898_CM "" TAB_VERB "%6.3" "-" COMPU_TAB_REF _CNV_S_5_THRO_RANGE_898 /end COMPU_METHOD
/begin COMPU_VTAB _CNV_S_5_THRO_RANGE_898 "" TAB_VERB 5 0 "TPS_NO_ERROR" 1 "TPS_1_ERROR" 2 "TPS_2_ERROR" 4 "TPS_RATIO_ERR" 8 "TPS_DBL_ERROR" /end COMPU_VTAB
/begin COMPU_METHOD _CNV_A_R_THRO_LINEA_899_CM "" RAT_FUNC "%6.3" "°TPS" COEFFS 0 137.0962343096236 -1.818989403545857e-011 0 0 1 /end COMPU_METHOD
/begin COMPU_METHOD _CNV_A_R_THRO_LINEA_900_CM "" RAT_FUNC "%6.3" "°TPS" COEFFS 0 137.0962343096236 2.220446049250313e-016 0 0 1 /end COMPU_METHOD
/begin COMPU_METHOD _CNV_A_R_LINEAR_____901_CM "" RAT_FUNC "%6.3" "%/°TPS" COEFFS 0 16. 0. 0 0 1 /end COMPU_METHOD
/begin COMPU_METHOD _CNV_S_3_THRO_RANGE_902_CM "" TAB_VERB "%6.3" "-" COMPU_TAB_REF _CNV_S_3_THRO_RANGE_902 /end COMPU_METHOD
/begin COMPU_VTAB _CNV_S_3_THRO_RANGE_902 "" TAB_VERB 3 0 "N_NOT_LIM" 1 "N_LIM_CON" 2 "N_LIM_PVS" /end COMPU_VTAB
/begin COMPU_METHOD _CNV_A_R_THRO_LINEA_903_CM "" RAT_FUNC "%6.3" "-" COEFFS 0 200. 0. 0 0 1 /end COMPU_METHOD
/begin RECORD_LAYOUT _REC_VAL_20_u1 FNC_VALUES 1 UBYTE COLUMN_DIR DIRECT /end RECORD_LAYOUT
/begin RECORD_LAYOUT _REC_VAL_20_u2 FNC_VALUES 1 UWORD COLUMN_DIR DIRECT /end RECORD_LAYOUT
/begin RECORD_LAYOUT _REC_AXS_20_u1 NO_AXIS_PTS_X 1 UBYTE AXIS_PTS_X 2 UBYTE INDEX_INCR DIRECT /end RECORD_LAYOUT
/begin RECORD_LAYOUT _REC_MAP_20_u2_u1_u1 FNC_VALUES 1 UWORD COLUMN_DIR DIRECT /end RECORD_LAYOUT
/begin RECORD_LAYOUT _REC_CUR_20_u1_u1 FNC_VALUES 1 UBYTE COLUMN_DIR DIRECT /end RECORD_LAYOUT
/begin RECORD_LAYOUT _REC_VAL_20_s2 FNC_VALUES 1 SWORD COLUMN_DIR DIRECT /end RECORD_LAYOUT
/begin RECORD_LAYOUT _REC_MAP_20_u2_u2_u1 FNC_VALUES 1 UWORD COLUMN_DIR DIRECT /end RECORD_LAYOUT
/begin RECORD_LAYOUT _REC_AXS_20_u2 NO_AXIS_PTS_X 1 UWORD AXIS_PTS_X 2 UWORD INDEX_INCR DIRECT /end RECORD_LAYOUT
/begin RECORD_LAYOUT _REC_CUR_20_u2_u1 FNC_VALUES 1 UWORD COLUMN_DIR DIRECT /end RECORD_LAYOUT
/begin RECORD_LAYOUT _REC_CUR_20_u2_u2 FNC_VALUES 1 UWORD COLUMN_DIR DIRECT /end RECORD_LAYOUT
/begin RECORD_LAYOUT _REC_VAL_20_u4 FNC_VALUES 1 ULONG COLUMN_DIR DIRECT /end RECORD_LAYOUT
/begin FUNCTION ECM2_Mon_of_mass_fuel_flow "Mon_of_mass_fuel_flow"
 /begin DEF_CHARACTERISTIC c_abc_inc_mff_not_afs_mon c_abc_max_mff_not_afs_mon c_abc_inc_swi_afs_mff_mon c_abc_max_swi_afs_mff_mon ldp_n_32_mon_ip_lamb_dif_mon ldp_tqi_sp_mon_ip_lamb_dif_mon ip_lamb_dif_thd_mon c_abc_dec_lamb_dif_mon c_abc_inc_lamb_dif_mon c_abc_inc_tps_ratio_mon c_abc_max_lamb_dif_mon c_abc_max_tps_ratio_mon c_v_tps_ratio_hys_mon c_n_min_tps_diag_mon /end DEF_CHARACTERISTIC
 /begin OUT_MEASUREMENT lv_err_mff_mon lv_err_plaus_lamb_dif_mon lv_swi_afs_mff_mon abc_swi_afs_mff_mon abc_mff_not_afs_mon lv_err_tps_mon abc_lamb_dif_mon abc_tps_ratio_mon v_tps_ad_2_mon[0] v_tps_ad_2_mon[1] v_tps_ad_1_mon[0] v_tps_ad_1_mon[1] /end OUT_MEASUREMENT
/end FUNCTION
/begin FUNCTION ECM2_Err_mem_mng_process_mon_AI "Err_mem_mng_process_mon_AI"
 /begin OUT_MEASUREMENT lv_at_mon lv_var_amt_mon envd_0_conv_mon envd_1_conv_mon envd_2_conv_mon envd_3_conv_mon envd_0_n_32_mon envd_1_n_32_mon envd_2_n_32_mon envd_3_n_32_mon envd_3_pvs_mon envd_2_pvs_mon envd_1_pvs_mon envd_0_pvs_mon envd_0_cru_inh_mon envd_1_cru_inh_mon envd_2_cru_inh_mon envd_3_cru_inh_mon envd_3_tqi_av_mon envd_2_tqi_av_mon envd_1_tqi_av_mon envd_0_tqi_av_mon envd_0_mff_mon envd_1_mff_mon envd_2_mff_mon envd_3_mff_mon envd_3_tq_dif_isc_mon envd_2_tq_dif_isc_mon envd_1_tq_dif_isc_mon envd_0_tq_dif_isc_mon envd_0_tq_req_mon envd_1_tq_req_mon envd_2_tq_req_mon envd_3_tq_req_mon envd_3_tq_ext_mon envd_2_tq_ext_mon envd_0_tq_ext_mon envd_1_tq_ext_mon envd_0_tqi_n_max_mon envd_2_tqi_n_max_mon envd_3_tqi_n_max_mon envd_1_tqi_n_max_mon /end OUT_MEASUREMENT
/end FUNCTION
/begin FUNCTION KWP_DDLI ""
 /begin OUT_MEASUREMENT union_instance_kwp_ddli.obd_lam_cor[0] union_instance_kwp_ddli.obd_lam_cor[1] union_instance_kwp_ddli.obd_lam_ad[0] union_instance_kwp_ddli.obd_lam_ad[1] union_instance_kwp_ddli.obd_fup union_instance_kwp_ddli.obd_map union_instance_kwp_ddli.obd_n union_instance_kwp_ddli.obd_iga_igc union_instance_kwp_ddli.obd_tia union_instance_kwp_ddli.obd_maf union_instance_kwp_ddli.lamb_delta_i_lam_adj_kwp[0] union_instance_kwp_ddli.lamb_delta_i_lam_adj_kwp[1] union_instance_kwp_ddli.lamb_kwp[0] union_instance_kwp_ddli.lamb_kwp[1] union_instance_kwp_ddli.n_max_scdn_mis_32_kwp union_instance_kwp_ddli.n_min_scdn_mis_32_kwp union_instance_kwp_ddli.r_it_ls_down_kwp_h[0] union_instance_kwp_ddli.r_it_ls_down_kwp_h[1] union_instance_kwp_ddli.r_it_ls_down_kwp_l[0] union_instance_kwp_ddli.r_it_ls_down_kwp_l[1] union_instance_kwp_ddli.r_it_ls_up_kwp_h[0] union_instance_kwp_ddli.r_it_ls_up_kwp_h[1] union_instance_kwp_ddli.r_it_ls_up_kwp_l[0] union_instance_kwp_ddli.r_it_ls_up_kwp_l[1] union_instance_kwp_ddli.t_es_kwp union_instance_kwp_ddli.tps_ad_step_kwp union_instance_kwp_ddli.v_amp_kwp union_instance_kwp_ddli.v_dmtl_kwp union_instance_kwp_ddli.vls_down_kwp[0] union_instance_kwp_ddli.vls_down_kwp[1] union_instance_kwp_ddli.vls_up_kwp[0] union_instance_kwp_ddli.vls_up_kwp[1] union_instance_kwp_ddli.v_pvs_1_kwp union_instance_kwp_ddli.v_pvs_2_kwp union_instance_kwp_ddli.v_sof_swi_kwp union_instance_kwp_ddli.v_tco_2_kwp union_instance_kwp_ddli.v_tco_kwp union_instance_kwp_ddli.v_tecu_kwp union_instance_kwp_ddli.v_tps_1_kwp union_instance_kwp_ddli.v_tps_2_kwp union_instance_kwp_ddli.vb_bas_kwp union_instance_kwp_ddli.vcc_pvs_1_kwp union_instance_kwp_ddli.vcc_pvs_2_kwp union_instance_kwp_ddli.vls_dif_lam_adj_kwp[0] union_instance_kwp_ddli.vls_dif_lam_adj_kwp[1] union_instance_kwp_ddli.vls_ofs_lsl_kwp[0] union_instance_kwp_ddli.vls_ofs_lsl_kwp[1] union_instance_kwp_ddli.cur_dmtl_ref_leak_kwp union_instance_kwp_ddli.cur_dmtl_rough_leak_min_kwp union_instance_kwp_ddli.cur_dmtl_cor_fil_kwp union_instance_kwp_ddli.v_igk_bas_kwp union_instance_kwp_ddli.obd_t_ast union_instance_kwp_ddli.obd_amp union_instance_kwp_ddli.obd_vb union_instance_kwp_ddli.obd_lamb_sp union_instance_kwp_ddli.obd_tam union_instance_kwp_ddli.n_sae_byte_kwp union_instance_kwp_ddli.v_alter_sp_kwp union_instance_kwp_ddli.fac_mv_diag_dyn_lsl_up_kwp union_instance_kwp_ddli.vp_tia_kwp union_instance_kwp_ddli.cur_cur_efc_max_dr_vvl_kwp union_instance_kwp_ddli.fup_kwp union_instance_kwp_ddli.fup_efp_kwp union_instance_kwp_ddli.load_mis_kwp union_instance_kwp_ddli.load_min_mis_kwp union_instance_kwp_ddli.opg_acr_kwp union_instance_kwp_ddli.opg_sp_acr_kwp union_instance_kwp_ddli.p_oel_ist_kwp union_instance_kwp_ddli.put_kwp union_instance_kwp_ddli.pwm_acr_kwp union_instance_kwp_ddli.pwm_neut_psn_gb_kwp union_instance_kwp_ddli.pwm_vcv_kwp union_instance_kwp_ddli.lamb_sp_kwp[0] union_instance_kwp_ddli.lamb_sp_kwp[1] union_instance_kwp_ddli.state_n_max_mon_high_kwp union_instance_kwp_ddli.state_n_max_mon_low_kwp union_instance_kwp_ddli.t_es_cus_kwp union_instance_kwp_ddli.tia_tcha_kwp union_instance_kwp_ddli.t_per_maf_kwp union_instance_kwp_ddli.t_per_maf_frq_kwp union_instance_kwp_ddli.temp_dif_eac_kwp union_instance_kwp_ddli.temp_eac_kwp union_instance_kwp_ddli.tps_dif_diag_cor_1_kwp union_instance_kwp_ddli.tps_dif_diag_cor_2_kwp union_instance_kwp_ddli.v_fup_efp_kwp union_instance_kwp_ddli.v_fup_mv_kwp union_instance_kwp_ddli.vp_tia_tcha_kwp union_instance_kwp_ddli.vp_teg_pcat_down_kwp union_instance_kwp_ddli.ang_exc_vvl_kwp union_instance_kwp_ddli.ang_sp_ctl_vvl_kwp union_instance_kwp_ddli.pwm_dr_out_set_vvl_kwp union_instance_kwp_ddli.cur_mot_vvl_3_kwp union_instance_kwp_ddli.temp_mot_vvl_kwp union_instance_kwp_ddli.vcc_dr_vvl_kwp union_instance_kwp_ddli.v_vcc_sens_vvl_kwp union_instance_kwp_ddli.ang_de_absv_plaus_chk_vvl_kwp union_instance_kwp_ddli.temp_swi_mes_max_vvl_kwp union_instance_kwp_ddli.state_byte_swi_kwp union_instance_kwp_ddli.cam_in_kwp union_instance_kwp_ddli.cam_sp_ivvt_in_kwp union_instance_kwp_ddli.v_pbsu_kwp union_instance_kwp_ddli.v_put_kwp /end OUT_MEASUREMENT
/end FUNCTION
/begin FUNCTION C_E_ECM3 ""
 /begin SUB_FUNCTION ecm3_dtsyscom ecm3_dtsyserrm ecm3_dtsysfarea ecm3_dtsysfsist ecm3_dtsyspfm ecm3_dtsysprmon ecm3_dtsyssopc ecm3_manag /end SUB_FUNCTION
/end FUNCTION
/begin FUNCTION ecm3_dtsyscom "MC communication monitoring between MC and MU" /begin OUT_MEASUREMENT lv_mc_com_err lv_mc_com_err_cpl /end OUT_MEASUREMENT /end FUNCTION
/begin FUNCTION ecm3_dtsyserrm "Error memory management of processor monitoring"
 /begin OUT_MEASUREMENT lf_ctr_rst_err_mem_act lf_ctr_rst_err_mem_act_cpl lf_ctr_rst_err_mem_old lf_ctr_rst_err_mem_old_cpl lf_err_cod_err_mem_act lf_err_cod_err_mem_act.err_cod_err_mem_act lf_err_cod_err_mem_act.state_err_idc_err_mem_act lf_err_cod_err_mem_act.lv_mc_cpt_err_mem_act lf_err_cod_err_mem_act_cpl lf_err_cod_err_mem_old lf_err_cod_err_mem_old.err_cod_err_mem_old lf_err_cod_err_mem_old.state_err_idc_err_mem_old lf_err_cod_err_mem_old.lv_mc_cpt_err_mem_old lf_err_cod_err_mem_old_cpl lv_mc_upd_err_mem_mc lv_mc_upd_err_mem_mu /end OUT_MEASUREMENT
/end FUNCTION
/begin FUNCTION ecm3_dtsysfarea "MC Fault Reaction"
 /begin OUT_MEASUREMENT ctr_rst_mc ctr_rst_mc_cpl lf_err_cod_mc lf_err_cod_mc.err_cod_mc lf_err_cod_mc.state_err_idc_mc lf_err_cod_mc_cpl lf_err_cod_mc_cpl.err_cod_mc_cpl lf_err_cod_mc_cpl.state_err_idc_mc_cpl abc_mc_cks abc_mc_hd abc_mc_conf_dif abc_mc_wrg_idx abc_mc_wrg_resp abc_mc_not_dec abc_mc_pfm_0_tog abc_mc_pfm_1_tog abc_mc_pfm_2_tog abc_mc_pfm_3_tog abc_mc_pfm_4_tog abc_mc_pfm_5_tog abc_mc_pfm_6_tog abc_mc_pfm_0_resp abc_mc_pfm_1_resp abc_mc_pfm_2_resp abc_mc_pfm_3_resp abc_mc_pfm_4_resp abc_mc_pfm_5_resp abc_mc_pfm_6_resp ctr_rst_mu lf_err_cod_mu lf_err_cod_mu.err_cod_mu lf_err_cod_mu.state_err_idc_mu mu_di_state lv_mc_dr_off lv_mc_dr_off_cpl lv_err_mu_mc lv_err_mu_mc_cpl lv_err_tmp_mu_mc lv_err_tmp_mu_mc_cpl lv_mu_di_out_0 lv_mu_di_out_1 lv_v_l_det_mu lv_v_h_det_mu lv_mc_inh_sopc ctr_com_cyc_mc_dec_rst ctr_mu_di ctr_com_cyc_mc_dr_di_tmp lv_mu_di_act /end OUT_MEASUREMENT
/end FUNCTION
/begin FUNCTION ecm3_dtsysfsist "MC Function-specific Instruction Set Test (FS-IST)"
 /begin OUT_MEASUREMENT test_rec_idx_mon2 lv_mc_fct_spc_ist_act tcc_mc_fct_spc_ist_wrg_resp abc_lid_mc_fct_spc_ist_old idx_nr_lid_mc_fct_spc_ist_old lv_mc_fct_spc_ist_wrg_resp_act /end OUT_MEASUREMENT
/end FUNCTION
/begin FUNCTION ecm3_dtsyspfm "MC Program Flow Monitoring"
 /begin OUT_MEASUREMENT lf_mc_syn_pfm lf_mc_resp_pfm state_mc_pfm_ctl_byte[0] state_mc_pfm_ctl_byte[1] state_mc_pfm_ctl_byte[2] state_mc_pfm_ctl_byte[3] state_mc_pfm_ctl_byte[4] state_mc_pfm_ctl_byte[5] state_mc_pfm_ctl_byte[6] lv_mc_pfm_wrg_resp_act_6 tcc_mc_pfm_tog_6 lf_mc_pfm_syn_byte lf_state_abc_pfm_mu lf_mc_pfm_syn_byte_chg lf_mc_pfm_syn_byte_chg_old tcc_mc_pfm_tog[0] tcc_mc_pfm_tog[1] tcc_mc_pfm_tog[2] tcc_mc_pfm_tog[3] tcc_mc_pfm_tog[4] tcc_mc_pfm_tog[5] lf_mc_wrg_resp_pfm_act /end OUT_MEASUREMENT
/end FUNCTION
/begin FUNCTION ecm3_dtsysprmon "MC Processor Monitoring" /begin DEF_CHARACTERISTIC c_rom_cks_cal_l c_rom_cks_cal_h c_err_swi_mc_level_2_cal /end DEF_CHARACTERISTIC
 /begin OUT_MEASUREMENT lv_mc_rom_chk_ready lv_mc_rom_chk_ready_cpl lv_mc_rom_chk_ok lv_mc_rom_chk_ok_cpl vp_mc_an_dig_mon vp_mc_an_dig_mon_cpl vp_mu_an_dig_mon vp_mu_an_dig_mon_cpl state_mc lf_mu_conf_byte nr_mu_comp nr_mu_hw_vers lv_mu_ign_key rom_cks_cal_clc_l rom_cks_cal_clc_h ecu_cks_ptr cal_cks_ptr ecu_blk_size cal_blk_size tout_rom_cks_mon_ecu tout_rom_cks_mon_cal vp_mc_an_dig_mon_tmp vp_mc_an_dig_mon_tmp_cpl /end OUT_MEASUREMENT
/end FUNCTION
/begin FUNCTION ecm3_dtsyssopc "MC Switch-Off Path Check (SOPC)"
 /begin OUT_MEASUREMENT state_mc_resp_sopc state_mc_resp_sopc_cpl lf_sdr_sopc lf_sdr_sopc.lf_mc_sopc lf_sdr_sopc.lf_mu_sopc lf_sdr_sopc_cpl lv_mc_sopc_inh_di lv_mc_sopc_inh_di_cpl lv_mc_sopc_act state_sopc ctr_tout_sopc_mc /end OUT_MEASUREMENT
/end FUNCTION
/begin FUNCTION ecm3_manag "ECM3 Manager" /end FUNCTION
/begin FUNCTION C_E_ECM3_CNF "" /begin SUB_FUNCTION ecm3_dtsysapinc /end SUB_FUNCTION /end FUNCTION
/begin FUNCTION ecm3_dtsysapinc "MC Processor Monitoring (Application Incidences for 32bit EMS)"
 /begin OUT_MEASUREMENT ctr_wait_mon_3_ena envd_0_mon_3 envd_1_mon_3 envd_2_mon_3 envd_3_mon_3 lv_err_tmp_mu_mc_old err_cod_mc_save err_cod_mu_save rst_ctr_mc_save rst_ctr_mu_save lv_err_ram_mon_3 lv_err_mon_3 /end OUT_MEASUREMENT
/end FUNCTION
/begin FUNCTION C_E_ECM3_INFR "" /begin SUB_FUNCTION ecm3_infr /end SUB_FUNCTION /end FUNCTION
/begin FUNCTION ecm3_infr "INFR of ECM3" /begin OUT_MEASUREMENT pow_up_act /end OUT_MEASUREMENT /end FUNCTION
/begin FUNCTION C_2_ATIC81 "" /begin SUB_FUNCTION atic81 /end SUB_FUNCTION /end FUNCTION
/begin FUNCTION atic81 "ATIC81 communication driver"
 /begin OUT_MEASUREMENT trm_buf_mc[0] trm_buf_mc[1] trm_buf_mc[2] trm_buf_mc[3] trm_buf_mc[4] rcv_buf_mc[0] rcv_buf_mc[1] rcv_buf_mc[2] rcv_buf_mc[3] rcv_buf_mc[4] rcv_buf_mc[5] vp_mc_an_dig_mon_new vp_mc_an_dig_mon_new_cpl /end OUT_MEASUREMENT
/end FUNCTION
/begin FUNCTION C_4_THRO "C_4_THRO" /begin SUB_FUNCTION THRO_ETC_throttle_angle_var /end SUB_FUNCTION /end FUNCTION
/begin FUNCTION THRO_ETC_throttle_angle_var "ETC_throttle_angle_var" /begin DEF_CHARACTERISTIC c_tps_max c_vp_tps_grd /end DEF_CHARACTERISTIC
 /begin OUT_MEASUREMENT tps_av_2[0] tps_av_2[1] tps_grd[0] tps_grd[1] tps_lih[0] tps_lih[1] tps_seg[0] tps_seg[1] tps_etc[0] tps_etc[1] lv_tps_grd_up[0] lv_tps_grd_up[1] tps[0] tps[1] tps_av[0] tps_av[1] opg_av_isa[0] opg_av_isa[1] tps_av_1[0] tps_av_1[1] vp_tps_1[0] vp_tps_1[1] vp_tps_2[0] vp_tps_2[1] /end OUT_MEASUREMENT
/end FUNCTION
/begin FUNCTION C_C_THRO "C_C_THRO"
 /begin SUB_FUNCTION THRO_ETC_Jam_detection THRO_ETC_position_controller THRO_ETC_position_controller_AI THRO_ETC_setpoint_selection_AI THRO_ETC_setpoint_selection THRO_ETC_setpoint_calc_start THRO_ETC_Jam_detection_AI /end SUB_FUNCTION
/end FUNCTION
/begin FUNCTION THRO_ETC_Jam_detection "ETC_Jam_detection"
 /begin OUT_MEASUREMENT lv_tps_sp_jam[0] lv_tps_sp_jam[1] lv_tps_jam_open_dir[0] lv_tps_jam_open_dir[1] tps_sp_jam[0] tps_sp_jam[1] /end OUT_MEASUREMENT
/end FUNCTION
/begin FUNCTION THRO_ETC_position_controller "ETC_position_controller"
 /begin DEF_CHARACTERISTIC c_tps_dif_max c_tps_lih_hys c_tps_int_ini c_kp_etc c_ki_etc c_fac_0_fil_etc c_fac_1_fil_etc ip_fac_vb_etc ldp_vb_mmv_ip_fac_vb_etc c_kdf_etc c_kdf_pre_fil_etc c_tps_max_pre_fil_etc c_tps_ofs_ctl_max c_frq_pwm_etc /end DEF_CHARACTERISTIC
 /begin OUT_MEASUREMENT tps_dif[0] tps_dif[1] tps_ofs_ctl[0] tps_ofs_ctl[1] pwm_etc[0] pwm_etc[1] tps_dif_etc[0] tps_dif_etc[1] tps_fil_etc[0] tps_fil_etc[1] kp_cor_etc fac_vb_etc tps_max_etc tps_sp_ctl[0] tps_sp_ctl[1] tps_sp_int[0] tps_sp_int[1] /end OUT_MEASUREMENT
/end FUNCTION
/begin FUNCTION THRO_ETC_position_controller_AI "ETC_position_controller_AI" /begin OUT_MEASUREMENT lv_mtc_cur_off lv_pwm_etc_off[0] lv_pwm_etc_off[1] /end OUT_MEASUREMENT /end FUNCTION
/begin FUNCTION THRO_ETC_setpoint_selection_AI "ETC_setpoint_selection_AI"
 /begin DEF_CHARACTERISTIC c_tps_sp_as_man c_tps_sp_ext_adj_ena ip_tps_sp_ext_adj ldp_pv_ip_tps_sp_ext c_pv_min_ext_adj c_t_tps_sp_pop ip_tps_sp_pop ldp_n_32_ip_tps_sp_pop c_tps_sp_pop_up c_tps_sp_pop_lgrd /end DEF_CHARACTERISTIC
 /begin OUT_MEASUREMENT tps_sp_es[0] tps_sp_es[1] tps_sp_ext_adj[0] tps_sp_ext_adj[1] lv_tps_sp_ext_adj[0] lv_tps_sp_ext_adj[1] lv_tps_sp_lih[0] lv_tps_sp_lih[1] lv_tps_sp_etc_off[0] lv_tps_sp_etc_off[1] lv_tps_sp_es[0] lv_tps_sp_es[1] tps_sp_lih[0] tps_sp_lih[1] lv_tps_sp_pop[0] lv_tps_sp_pop[1] tps_sp_pop[0] tps_sp_pop[1] /end OUT_MEASUREMENT
/end FUNCTION
/begin FUNCTION THRO_ETC_setpoint_selection "ETC_setpoint_selection"
 /begin DEF_CHARACTERISTIC c_tps_sp_min_tps_ad_req c_tps_sp_max_tps_ad_req c_tps_sp_max ip_tps_sp_lgrd_st ldp_n_ip_tps_sp_lgrd_st ldp_tco_ip_tps_sp_lgrd_st c_tps_sp_min c_tps_sp_jam_lgrd /end DEF_CHARACTERISTIC
 /begin OUT_MEASUREMENT tps_sp[0] tps_sp[1] state_tps_sp_tra_dir[0] state_tps_sp_tra_dir[1] tps_sp_sel[0] tps_sp_sel[1] tps_sp_req[0] tps_sp_req[1] tps_sp_max[0] tps_sp_max[1] lv_tps_sp_tra_st_mdl[0] lv_tps_sp_tra_st_mdl[1] lv_tps_sp_tra_jam_sel[0] lv_tps_sp_tra_jam_sel[1] /end OUT_MEASUREMENT
/end FUNCTION
/begin FUNCTION THRO_ETC_setpoint_calc_start "ETC_setpoint_calc_start" /begin OUT_MEASUREMENT tps_sp_st[0] tps_sp_st[1] /end OUT_MEASUREMENT /end FUNCTION
/begin FUNCTION THRO_ETC_Jam_detection_AI "ETC_Jam_detection_AI" /end FUNCTION
/begin FUNCTION C_A_THRO "C_A_THRO"
 /begin SUB_FUNCTION THRO_ETC_limp_home_management THRO_ETC_actuator_diag THRO_ETC_actuator_diag_AI THRO_ETC_power_stage_diag THRO_ETC_power_stage_diag_AI THRO_ETC_position_sensor_diag THRO_ETC_position_sens_diag_AI THRO_ETC_actuator_adapt_diag THRO_ETC_actuator_adapt_diag_AI THRO_ETC_sensor_plaus_chk THRO_ETC_sensor_plaus_chk_AI /end SUB_FUNCTION
/end FUNCTION
/begin FUNCTION THRO_ETC_limp_home_management "ETC_limp_home_management" /begin DEF_CHARACTERISTIC ip_fac_tps_tq_red ldp_n_32_ip_fac_tps_tq_red /end DEF_CHARACTERISTIC
 /begin OUT_MEASUREMENT state_n_lim_etc_req lv_err_tps lv_n_lim_etc_lih lv_tps_sp_lih_req[0] lv_tps_sp_lih_req[1] tqi_max_etc lv_n_lim_etc_lih_req[0] lv_n_lim_etc_lih_req[1] lv_etc_dr_off_req[0] lv_etc_dr_off_req[1] lv_err_etc[0] lv_err_etc[1] /end OUT_MEASUREMENT
/end FUNCTION
/begin FUNCTION THRO_ETC_actuator_diag "ETC_actuator_diag"
 /begin DEF_CHARACTERISTIC c_pwm_etc_max_diag c_crlc_tps_sp c_abc_dec_etc_ctl ip_tps_dif_err_max ldp_tps_sp_grd_ip_tps_dif_err c_abc_inc_etc_pwm c_abc_dec_etc_pwm c_abc_max_etc_pwm c_abc_min_etc_pwm c_abc_inc_etc_ctl c_abc_max_etc_ctl /end DEF_CHARACTERISTIC
 /begin OUT_MEASUREMENT ctr_diag_etc_ctl[0] ctr_diag_etc_ctl[1] ctr_diag_end_etc_ctl[0] ctr_diag_end_etc_ctl[1] tps_sp_grd[0] tps_sp_grd[1] tps_sp_fil[0] tps_sp_fil[1] tps_dif_err_max[0] tps_dif_err_max[1] ctr_diag_etc_pwm[0] ctr_diag_etc_pwm[1] ctr_diag_end_etc_pwm[0] ctr_diag_end_etc_pwm[1] lv_err_etc_ctl_1 lv_err_etc_ctl_2 lv_err_etc_pwm_1 lv_err_etc_pwm_2 /end OUT_MEASUREMENT
/end FUNCTION
/begin FUNCTION THRO_ETC_actuator_diag_AI "ETC_actuator_diag_AI" /begin DEF_CHARACTERISTIC c_vb_min_pwm_etc_diag /end DEF_CHARACTERISTIC
 /begin OUT_MEASUREMENT lv_inh_diag_etc_ctl[0] lv_inh_diag_etc_ctl[1] lv_inh_diag_etc_pwm[0] lv_inh_diag_etc_pwm[1] /end OUT_MEASUREMENT
/end FUNCTION
/begin FUNCTION THRO_ETC_power_stage_diag "ETC_power_stage_diag" /begin DEF_CHARACTERISTIC c_abc_inc_etc_dr c_abc_max_etc_dr /end DEF_CHARACTERISTIC /begin OUT_MEASUREMENT lv_err_etc_dr_1 lv_err_etc_dr_2 /end OUT_MEASUREMENT /end FUNCTION
/begin FUNCTION THRO_ETC_power_stage_diag_AI "ETC_power_stage_diag_AI" /begin DEF_CHARACTERISTIC c_vb_min_etc_dr_diag /end DEF_CHARACTERISTIC /begin OUT_MEASUREMENT lv_inh_diag_etc_dr[0] lv_inh_diag_etc_dr[1] /end OUT_MEASUREMENT /end FUNCTION
/begin FUNCTION THRO_ETC_position_sensor_diag "ETC_position_sensor_diag"
 /begin DEF_CHARACTERISTIC c_abc_inc_tps_1 c_abc_inc_tps_2 c_abc_max_tps_1 c_abc_max_tps_2 c_vp_tps_max_diag_1 c_vp_tps_max_diag_2 c_vp_tps_min_diag_1 c_vp_tps_min_diag_2 /end DEF_CHARACTERISTIC
 /begin OUT_MEASUREMENT lv_err_tps_1_1 lv_err_tps_1_2 lv_err_tps_2_1 lv_err_tps_2_2 /end OUT_MEASUREMENT
/end FUNCTION
/begin FUNCTION THRO_ETC_position_sens_diag_AI "ETC_position_sens_diag_AI"
 /begin OUT_MEASUREMENT lv_inh_diag_tps_2[0] lv_inh_diag_tps_2[1] lv_err_tps_vcc[0] lv_err_tps_vcc[1] lv_inh_diag_tps_1[0] lv_inh_diag_tps_1[1] /end OUT_MEASUREMENT
/end FUNCTION
/begin FUNCTION THRO_ETC_actuator_adapt_diag "ETC_actuator_adapt_diag"
 /begin DEF_CHARACTERISTIC c_t_max_tps_ad c_t_max_tps_sp_rst_chk c_t_tps_ad_hys c_tps_sp_bol_lgrd c_tps_sp_rst_chk_bas c_tps_sp_rst_chk_hys c_tps_sp_rst_chk_lgrd c_tps_sp_spr_chk_up c_t_dyw_tps_lih_chk c_t_max_tps_lih_chk c_t_dly_tps_ad c_pwm_tps_bol c_tco_min_tps_bol c_t_tps_bol_ofs_inc c_t_tps_bol_ofs_dec c_tps_sp_tps_bol lc_tps_ad_lih_ena c_tps_slop c_crlc_tps_ad c_tps_lih_ini c_vp_tps_ad_bol_ini_1 c_vp_tps_ad_bol_ini_2 c_vp_tps_ad_hys c_vp_tps_ad_win_bol c_vp_tps_ad_win_lih c_vp_tps_bol_ofs_cor c_vp_tps_bol_ofs_max c_vp_tps_lih_chk_hys c_vp_tps_sp_bol_1 c_vp_tps_sp_bol_2 c_vp_tps_sp_lih_1 c_vp_tps_sp_lih_2 /end DEF_CHARACTERISTIC
 /begin OUT_MEASUREMENT ctr_st_chk_lih_err[0] ctr_st_chk_lih_err[1] ctr_st_chk_lih_ok[0] ctr_st_chk_lih_ok[1] tps_lih_1[0] tps_lih_1[1] tps_lih_2[0] tps_lih_2[1] tps_lih_ini[0] tps_lih_ini[1] lv_tps_ad_req_st_chk[0] lv_tps_ad_req_st_chk[1] tps_slop t_tps_bol_ofs_inc[0] t_tps_bol_ofs_inc[1] t_tps_bol_ofs_dec[0] t_tps_bol_ofs_dec[1] tps_ad_step[0] tps_ad_step[1] state_tps_bol_ad[0] state_tps_bol_ad[1] lv_tps_ad_etc_off[0] lv_tps_ad_etc_off[1] lv_inh_iv_tps_ad[0] lv_inh_iv_tps_ad[1] tps_sp_ad[0] tps_sp_ad[1] v_tps_ad_el_bol_1[0] v_tps_ad_el_bol_1[1] vp_tps_ad_el_bol_1[0] vp_tps_ad_el_bol_1[1] v_tps_ad_el_bol_2[0] v_tps_ad_el_bol_2[1] vp_tps_ad_el_bol_2[0] vp_tps_ad_el_bol_2[1] vp_tps_bol_ofs[0] vp_tps_bol_ofs[1] vp_tps_ad_lih_1[0] vp_tps_ad_lih_1[1] vp_tps_ad_lih_2[0] vp_tps_ad_lih_2[1] vp_tps_ad_bol_1[0] vp_tps_ad_bol_1[1] vp_tps_ad_bol_2[0] vp_tps_ad_bol_2[1] lv_err_tps_ad_1 lv_err_tps_ad_2 lv_err_tps_ad_spr_1 lv_err_tps_ad_spr_2 lv_err_tps_st_chk_1 lv_err_tps_st_chk_2 /end OUT_MEASUREMENT
/end FUNCTION
/begin FUNCTION THRO_ETC_actuator_adapt_diag_AI "ETC_actuator_adapt_diag_AI"
 /begin DEF_CHARACTERISTIC c_tco_min_tps_ad c_tia_min_tps_ad c_vb_min_tps_ad c_tco_max_tps_ad c_n_max_tps_ad lc_tps_ad_req c_cur_etc_dr_tps_ad c_ctr_err_cur_etc_dr /end DEF_CHARACTERISTIC
 /begin OUT_MEASUREMENT lv_tps_ad_act[0] lv_tps_ad_act[1] lv_tps_ad_req[0] lv_tps_ad_req[1] lv_inh_tps_ad[0] lv_inh_tps_ad[1] lv_err_cur_etc_dr[0] lv_err_cur_etc_dr[1] /end OUT_MEASUREMENT
/end FUNCTION
/begin FUNCTION THRO_ETC_sensor_plaus_chk "ETC_sensor_plaus_chk" /begin DEF_CHARACTERISTIC c_tps_ratio_hys c_abc_inc_tps_ratio c_abc_max_tps_ratio /end DEF_CHARACTERISTIC
 /begin OUT_MEASUREMENT state_tps_diag[0] state_tps_diag[1] lv_tps_ratio_err_det[0] lv_tps_ratio_err_det[1] lv_err_tps_maf_1_1 lv_err_tps_maf_1_2 lv_err_tps_maf_2_1 lv_err_tps_maf_2_2 lv_err_tps_ratio_1 lv_err_tps_ratio_2 /end OUT_MEASUREMENT
/end FUNCTION
/begin FUNCTION THRO_ETC_sensor_plaus_chk_AI "ETC_sensor_plaus_chk_AI" /begin DEF_CHARACTERISTIC lc_tps_maf_plaus_test /end DEF_CHARACTERISTIC
 /begin OUT_MEASUREMENT lv_inh_diag_tps_ratio[0] lv_inh_diag_tps_ratio[1] lv_tps_1_maf_err_plaus[0] lv_tps_1_maf_err_plaus[1] lv_tps_2_maf_err_plaus[0] lv_tps_2_maf_err_plaus[1] /end OUT_MEASUREMENT
/end FUNCTION
/begin FUNCTION C_9_AFUP "" /begin SUB_FUNCTION High_Pressure_Pump_Control /end SUB_FUNCTION /end FUNCTION
/end MODULE
/end PROJECT
