ASAP2_VERSION 1 41
/begin PROJECT MSD85 "Spray Guided DI-System with Piezo Injectors for 8-Cylinder"
/begin HEADER "_default_HeaderComment" PROJECT_NO _91 /end HEADER
/begin MODULE _default_ModuleName "_default_ModuleLongIdentifier"
/begin MOD_COMMON "_default_ModCommonComment" DEPOSIT ABSOLUTE BYTE_ORDER MSB_LAST ALIGNMENT_BYTE 1 ALIGNMENT_WORD 2 ALIGNMENT_LONG 2 ALIGNMENT_FLOAT32_IEEE 2 ALIGNMENT_FLOAT64_IEEE 4 /end MOD_COMMON
/begin MEASUREMENT lv_asr_plaus "Logical variable plausibility ASR" UBYTE _CNV_S_2_RANGE__0___1_CM 1 100. 0. 1. DISPLAY_IDENTIFIER LV_ASR_PLAUS ECU_ADDRESS 0xd0008b8f BIT_MASK 0x1 /end MEASUREMENT
/begin MEASUREMENT lam_bank_1.lam_up.bf.lv_lscl "activation flag of lambda control" ULONG _CNV_S_2_RANGE______76_CM 1 100. 0. 1. DISPLAY_IDENTIFIER LV_LSCL_1 ECU_ADDRESS 0xd000b860 BIT_MASK 0x1 /end MEASUREMENT
/begin MEASUREMENT lam_bank_1.lam_up.bf.lv_lam_cor_lim_intr "the sum output signal is limited under non-stationary operating conditions (threshold exceeded)						" ULONG _CNV_S_2_RANGE______76_CM 1 100. 0. 1. DISPLAY_IDENTIFIER LV_LAM_COR_LIM_INTR_1 ECU_ADDRESS 0xd000b860 BIT_MASK 0x2 /end MEASUREMENT
/begin MEASUREMENT lam_bank_1.lam_up.ti_lam_cor "controller output signal in consideration of the canister purge function and lambda adaptation" SWORD _CNV_A_R_LINEAR_____113_CM 1 100. -50. 49.9984741210938 DISPLAY_IDENTIFIER TI_LAM_COR_1 ECU_ADDRESS 0xd000b866 FORMAT "%6.2" /end MEASUREMENT
/begin MEASUREMENT lam_bank_1.lam_up.ti_lam_fac "limited lambda controller oiutput plus pre control correction" SWORD _CNV_A_R_LINEAR_____113_CM 1 100. -50. 49.9984741210938 DISPLAY_IDENTIFIER TI_LAM_FAC_1 ECU_ADDRESS 0xd000b86a FORMAT "%6.2" /end MEASUREMENT
/begin MEASUREMENT lam_bank_1.lam_up.lamb_dif "controller difference" SWORD _CNV_A_R_LINEAR_____211_CM 1 100. -1. 0.99996948 DISPLAY_IDENTIFIER LAMB_DIF_1 ECU_ADDRESS 0xd000b862 FORMAT "%8.5" /end MEASUREMENT
/begin MEASUREMENT lam_bank_1.lam_up.lamb "Lambda signal value of the WRAF sensor of exhast bank" UWORD _CNV_A_R_LINEAR_____129_CM 1 100. 0. 31.9990234375 DISPLAY_IDENTIFIER LAMB_1 ECU_ADDRESS 0xd000b864 FORMAT "%7.4" /end MEASUREMENT
/begin MEASUREMENT lam_bank_1.lam_ad.mff_ad_add_mmv_rel_quo "Relative lambda adaptation offset quotient" SWORD _CNV_A_R_LINEAR_____212_CM 1 100. -100. 99.9969482421875 DISPLAY_IDENTIFIER MFF_AD_ADD_MMV_REL_QUO_1 ECU_ADDRESS 0xd000b84a FORMAT "%8.3" /end MEASUREMENT
/begin MEASUREMENT lam_bank_1.lam_dly.lam_mv "sum of the controller output from the I-and I2-share" SWORD _CNV_A_R_LINEAR_____113_CM 1 100. -50. 49.9984741210938 DISPLAY_IDENTIFIER LAM_MV_1 ECU_ADDRESS 0xd000b858 FORMAT "%6.2" /end MEASUREMENT
/begin MEASUREMENT lam_bank_1.lam_dly.lam_mv_lpf_cp "mean value of the controller output, used by canister purge" SWORD _CNV_A_R_LINEAR_____113_CM 1 100. -50. 49.9984741210938 DISPLAY_IDENTIFIER LAM_MV_LPF_CP_1 ECU_ADDRESS 0xd000b85a FORMAT "%6.2" /end MEASUREMENT
/begin MEASUREMENT lam_bank_1.lam_dly.lamb_sp_fil "output signal of the lambda-sensor model" UWORD _CNV_A_R_LINEAR_____129_CM 1 100. 0. 31.9990234375 DISPLAY_IDENTIFIER LAMB_SP_FIL_1 ECU_ADDRESS 0xd000b85c FORMAT "%7.4" /end MEASUREMENT
/begin MEASUREMENT lam_bank_1.lam_dly.lamb_sp_fil_s_cp "output signal of the lambda-sensor model in stratified mode, used by canister purge" UWORD _CNV_A_R_LINEAR_____129_CM 1 100. 0. 31.9990234375 DISPLAY_IDENTIFIER LAMB_SP_FIL_S_CP_1 ECU_ADDRESS 0xd000b85e FORMAT "%7.4" /end MEASUREMENT
/begin MEASUREMENT lam_bank_1.lam_dly.delta_lamb_i_ad_h_res "adaptation value of trim control (i share moving mean value of lambda shift)" SWORD _CNV_A_R_LINEAR_____213_CM 1 100. -0.125 0.124996 DISPLAY_IDENTIFIER DELTA_LAMB_I_AD_H_RES_1 ECU_ADDRESS 0xd000b854 FORMAT "%8.6" /end MEASUREMENT
/begin MEASUREMENT lam_bank_1.lam_dly.delta_lamb_i_h_res "i share from trim control" SWORD _CNV_A_R_LINEAR_____213_CM 1 100. -0.125 0.124996 DISPLAY_IDENTIFIER DELTA_LAMB_I_H_RES_1 ECU_ADDRESS 0xd000b852 FORMAT "%8.6" /end MEASUREMENT
/begin MEASUREMENT lam_bank_1.lam_dly.bf.lv_delta_lamb "" ULONG _CNV_S_2_RANGE______76_CM 1 100. 0. 1. DISPLAY_IDENTIFIER LV_DELTA_LAMB_1 ECU_ADDRESS 0xd000b850 BIT_MASK 0x1 /end MEASUREMENT
/begin MEASUREMENT lam_bank_1.lam_dly.vls_dif_dly "sum of the controller output from the I-and I2-share" SWORD _CNV_A_R_LINEAR_____113_CM 1 100. -50. 49.9984741210938 DISPLAY_IDENTIFIER VLS_DIF_DLY_1 ECU_ADDRESS 0xd000b856 FORMAT "%6.2" /end MEASUREMENT
/begin MEASUREMENT lam_bank_1.ls_act_chk_pl.bf.lv_req_lamb_sp_ls_act_test "Lambda coordination request to change set point for active plausibility test" ULONG _CNV_S_2_RANGE______76_CM 1 100. 0. 1. DISPLAY_IDENTIFIER LV_REQ_LAMB_SP_LS_ACT_TEST_1 ECU_ADDRESS 0xd000b88c BIT_MASK 0x1 /end MEASUREMENT
/begin MEASUREMENT lam_bank_1.ls_act_chk_pl.bf.lv_temp_dew_ls_up "flag indicating that dew point is passed at lambda sensor up catalyst" ULONG _CNV_S_2_RANGE______76_CM 1 100. 0. 1. DISPLAY_IDENTIFIER LV_TEMP_DEW_LS_UP[1] ECU_ADDRESS 0xd000b88c BIT_MASK 0x2 /end MEASUREMENT
/begin MEASUREMENT lam_bank_1.ls_act_chk_pl.bf.lv_temp_dew_ls_down "flag indicating that dew point is passed at lambda sensor down catalyst" ULONG _CNV_S_2_RANGE______76_CM 1 100. 0. 1. DISPLAY_IDENTIFIER LV_TEMP_DEW_LS_DOWN[1] ECU_ADDRESS 0xd000b88c BIT_MASK 0x4 /end MEASUREMENT
/begin MEASUREMENT lam_bank_1.ls_act_chk_pl.bf.lv_inh_win_det_delta_i_lam "Flag to inhibit window calculation" ULONG _CNV_S_2_RANGE______76_CM 1 100. 0. 1. DISPLAY_IDENTIFIER LV_INH_WIN_DET_DELTA_I_LAM[1] ECU_ADDRESS 0xd000b88c BIT_MASK 0x8 /end MEASUREMENT
/begin MEASUREMENT lam_bank_1.ls_act_chk_pl.lamb_sp_beg_ls_act_test "Inicial value of lambda set point" UWORD _CNV_A_R_LINEAR_____129_CM 1 100. 0. 31.9990234375 DISPLAY_IDENTIFIER LAMB_SP_BEG_LS_ACT_TEST_1 ECU_ADDRESS 0xd000b894 /end MEASUREMENT
/begin MEASUREMENT lam_bank_1.ls_act_chk_pl.lamb_sp_ls_act_test "Lambda set point for active plausibility test" UWORD _CNV_A_R_LINEAR_____129_CM 1 100. 0. 31.9990234375 DISPLAY_IDENTIFIER LAMB_SP_LS_ACT_TEST_1 ECU_ADDRESS 0xd000b88e /end MEASUREMENT
/begin MEASUREMENT lam_bank_1.ls_act_chk_pl.teg_dyn_ls_up "Exhaust gas temperature at the lambda sensor upstream catalyst" UWORD _CNV_A_R_LINEAR_____214_CM 1 100. -273.15 1774.7875 DISPLAY_IDENTIFIER TEG_DYN_LS_UP[1] ECU_ADDRESS 0xd000b898 FORMAT "%9.4" /end MEASUREMENT
/begin MEASUREMENT lam_bank_1.ls_act_chk_pl.teg_dyn_ls_down "Exhaust gas temperature at the lambda sensor downstream catalyst" UWORD _CNV_A_R_LINEAR_____214_CM 1 100. -273.15 1774.7875 DISPLAY_IDENTIFIER TEG_DYN_LS_DOWN[1] ECU_ADDRESS 0xd000b89a FORMAT "%9.4" /end MEASUREMENT
/begin MEASUREMENT lam_bank_1.ls_ready.bf.lv_up_ls "Logical variable for operative readiness of upstream oxygen sensor" ULONG _CNV_S_2_RANGE______76_CM 1 100. 0. 1. DISPLAY_IDENTIFIER LV_UP_LS_1 ECU_ADDRESS 0xd000b875 BIT_MASK 0x1 /end MEASUREMENT
/begin MEASUREMENT lam_bank_1.lam_sti_afl.ctr_vls_afl_cyc "counter indicating the number of air fuel cycles since last activation of forced lambda stimulation" UWORD _CNV_A_R_LINEAR_____0_CM 1 100. 0. 65535. DISPLAY_IDENTIFIER CTR_VLS_AFL_CYC_1 ECU_ADDRESS 0xd000b8aa FORMAT "%5.0" /end MEASUREMENT
/begin MEASUREMENT lam_bank_1.ls_down.vls_down "Downstream sensor voltage measured" UWORD _CNV_A_R_LINEAR_____2_CM 1 100. 0. 4.9951171875 DISPLAY_IDENTIFIER VLS_DOWN_1 ECU_ADDRESS 0xd000b872 FORMAT "%5.3" /end MEASUREMENT
/begin MEASUREMENT lam_bank_1.ls_down_rdy.bf.lv_down_ls "Logical variable for operative readiness of downstream oxygen sensor(s)" ULONG _CNV_S_2_RANGE______76_CM 1 100. 0. 1. DISPLAY_IDENTIFIER LV_DOWN_LS_1 ECU_ADDRESS 0xd000b874 BIT_MASK 0x1 /end MEASUREMENT
/begin MEASUREMENT lam_bank_2.lam_up.bf.lv_lscl "activation flag of lambda control" ULONG _CNV_S_2_RANGE______76_CM 1 100. 0. 1. DISPLAY_IDENTIFIER LV_LSCL_2 ECU_ADDRESS 0xd000b8dc BIT_MASK 0x1 /end MEASUREMENT
/begin MEASUREMENT lam_bank_2.lam_up.bf.lv_lam_cor_lim_intr "the sum output signal is limited under non-stationary operating conditions (threshold exceeded)						" ULONG _CNV_S_2_RANGE______76_CM 1 100. 0. 1. DISPLAY_IDENTIFIER LV_LAM_COR_LIM_INTR_2 ECU_ADDRESS 0xd000b8dc BIT_MASK 0x2 /end MEASUREMENT
/begin MEASUREMENT lam_bank_2.lam_up.ti_lam_cor "controller output signal in consideration of the canister purge function and lambda adaptation" SWORD _CNV_A_R_LINEAR_____113_CM 1 100. -50. 49.9984741210938 DISPLAY_IDENTIFIER TI_LAM_COR_2 ECU_ADDRESS 0xd000b8e2 FORMAT "%6.2" /end MEASUREMENT
/begin MEASUREMENT lam_bank_2.lam_up.ti_lam_fac "limited lambda controller oiutput plus pre control correction" SWORD _CNV_A_R_LINEAR_____113_CM 1 100. -50. 49.9984741210938 DISPLAY_IDENTIFIER TI_LAM_FAC_2 ECU_ADDRESS 0xd000b8e6 FORMAT "%6.2" /end MEASUREMENT
/begin MEASUREMENT lam_bank_2.lam_up.lamb_dif "controller difference" SWORD _CNV_A_R_LINEAR_____211_CM 1 100. -1. 0.99996948 DISPLAY_IDENTIFIER LAMB_DIF_2 ECU_ADDRESS 0xd000b8de FORMAT "%8.5" /end MEASUREMENT
/begin MEASUREMENT lam_bank_2.lam_up.lamb "Lambda signal value of the WRAF sensor of exhast bank" UWORD _CNV_A_R_LINEAR_____129_CM 1 100. 0. 31.9990234375 DISPLAY_IDENTIFIER LAMB_2 ECU_ADDRESS 0xd000b8e0 FORMAT "%7.4" /end MEASUREMENT
/begin MEASUREMENT lam_bank_2.lam_ad.mff_ad_add_mmv_rel_quo "Relative lambda adaptation offset quotient" SWORD _CNV_A_R_LINEAR_____212_CM 1 100. -100. 99.9969482421875 DISPLAY_IDENTIFIER MFF_AD_ADD_MMV_REL_QUO_2 ECU_ADDRESS 0xd000b8c6 FORMAT "%8.3" /end MEASUREMENT
/begin MEASUREMENT lam_bank_2.lam_dly.lam_mv "sum of the controller output from the I-and I2-share" SWORD _CNV_A_R_LINEAR_____113_CM 1 100. -50. 49.9984741210938 DISPLAY_IDENTIFIER LAM_MV_2 ECU_ADDRESS 0xd000b8d4 FORMAT "%6.2" /end MEASUREMENT
/begin MEASUREMENT lam_bank_2.lam_dly.lam_mv_lpf_cp "mean value of the controller output, used by canister purge" SWORD _CNV_A_R_LINEAR_____113_CM 1 100. -50. 49.9984741210938 DISPLAY_IDENTIFIER LAM_MV_LPF_CP_2 ECU_ADDRESS 0xd000b8d6 FORMAT "%6.2" /end MEASUREMENT
/begin MEASUREMENT lam_bank_2.lam_dly.lamb_sp_fil "output signal of the lambda-sensor model" UWORD _CNV_A_R_LINEAR_____129_CM 1 100. 0. 31.9990234375 DISPLAY_IDENTIFIER LAMB_SP_FIL_2 ECU_ADDRESS 0xd000b8d8 FORMAT "%7.4" /end MEASUREMENT
/begin MEASUREMENT lam_bank_2.lam_dly.lamb_sp_fil_s_cp "output signal of the lambda-sensor model in stratified mode, used by canister purge" UWORD _CNV_A_R_LINEAR_____129_CM 1 100. 0. 31.9990234375 DISPLAY_IDENTIFIER LAMB_SP_FIL_S_CP_2 ECU_ADDRESS 0xd000b8da FORMAT "%7.4" /end MEASUREMENT
/begin MEASUREMENT lam_bank_2.lam_dly.delta_lamb_i_ad_h_res "adaptation value of trim control (i share moving mean value of lambda shift)" SWORD _CNV_A_R_LINEAR_____213_CM 1 100. -0.125 0.124996 DISPLAY_IDENTIFIER DELTA_LAMB_I_AD_H_RES_2 ECU_ADDRESS 0xd000b8d0 FORMAT "%8.6" /end MEASUREMENT
/begin MEASUREMENT lam_bank_2.lam_dly.delta_lamb_i_h_res "i share from trim control" SWORD _CNV_A_R_LINEAR_____213_CM 1 100. -0.125 0.124996 DISPLAY_IDENTIFIER DELTA_LAMB_I_H_RES_2 ECU_ADDRESS 0xd000b8ce FORMAT "%8.6" /end MEASUREMENT
/begin MEASUREMENT lam_bank_2.lam_dly.bf.lv_delta_lamb "" ULONG _CNV_S_2_RANGE______76_CM 1 100. 0. 1. DISPLAY_IDENTIFIER LV_DELTA_LAMB_2 ECU_ADDRESS 0xd000b8cc BIT_MASK 0x1 /end MEASUREMENT
/begin MEASUREMENT lam_bank_2.lam_dly.vls_dif_dly "sum of the controller output from the I-and I2-share" SWORD _CNV_A_R_LINEAR_____113_CM 1 100. -50. 49.9984741210938 DISPLAY_IDENTIFIER VLS_DIF_DLY_2 ECU_ADDRESS 0xd000b8d2 FORMAT "%6.2" /end MEASUREMENT
/begin MEASUREMENT lam_bank_2.ls_act_chk_pl.bf.lv_req_lamb_sp_ls_act_test "Lambda coordination request to change set point for active plausibility test" ULONG _CNV_S_2_RANGE______76_CM 1 100. 0. 1. DISPLAY_IDENTIFIER LV_REQ_LAMB_SP_LS_ACT_TEST_2 ECU_ADDRESS 0xd000b908 BIT_MASK 0x1 /end MEASUREMENT
/begin MEASUREMENT lam_bank_2.ls_act_chk_pl.bf.lv_temp_dew_ls_up "flag indicating that dew point is passed at lambda sensor up catalyst" ULONG _CNV_S_2_RANGE______76_CM 1 100. 0. 1. DISPLAY_IDENTIFIER LV_TEMP_DEW_LS_UP[2] ECU_ADDRESS 0xd000b908 BIT_MASK 0x2 /end MEASUREMENT
/begin MEASUREMENT lam_bank_2.ls_act_chk_pl.bf.lv_temp_dew_ls_down "flag indicating that dew point is passed at lambda sensor down catalyst" ULONG _CNV_S_2_RANGE______76_CM 1 100. 0. 1. DISPLAY_IDENTIFIER LV_TEMP_DEW_LS_DOWN[2] ECU_ADDRESS 0xd000b908 BIT_MASK 0x4 /end MEASUREMENT
/begin MEASUREMENT lam_bank_2.ls_act_chk_pl.bf.lv_inh_win_det_delta_i_lam "Flag to inhibit window calculation" ULONG _CNV_S_2_RANGE______76_CM 1 100. 0. 1. DISPLAY_IDENTIFIER LV_INH_WIN_DET_DELTA_I_LAM[2] ECU_ADDRESS 0xd000b908 BIT_MASK 0x8 /end MEASUREMENT
/begin MEASUREMENT lam_bank_2.ls_act_chk_pl.lamb_sp_beg_ls_act_test "Inicial value of lambda set point" UWORD _CNV_A_R_LINEAR_____129_CM 1 100. 0. 31.9990234375 DISPLAY_IDENTIFIER LAMB_SP_BEG_LS_ACT_TEST_2 ECU_ADDRESS 0xd000b910 /end MEASUREMENT
/begin MEASUREMENT lam_bank_2.ls_act_chk_pl.lamb_sp_ls_act_test "Lambda set point for active plausibility test" UWORD _CNV_A_R_LINEAR_____129_CM 1 100. 0. 31.9990234375 DISPLAY_IDENTIFIER LAMB_SP_LS_ACT_TEST_2 ECU_ADDRESS 0xd000b90a /end MEASUREMENT
/begin MEASUREMENT lam_bank_2.ls_act_chk_pl.teg_dyn_ls_up "Exhaust gas temperature at the lambda sensor upstream catalyst" UWORD _CNV_A_R_LINEAR_____214_CM 1 100. -273.15 1774.7875 DISPLAY_IDENTIFIER TEG_DYN_LS_UP[2] ECU_ADDRESS 0xd000b914 FORMAT "%9.4" /end MEASUREMENT
/begin MEASUREMENT lam_bank_2.ls_act_chk_pl.teg_dyn_ls_down "Exhaust gas temperature at the lambda sensor downstream catalyst" UWORD _CNV_A_R_LINEAR_____214_CM 1 100. -273.15 1774.7875 DISPLAY_IDENTIFIER TEG_DYN_LS_DOWN[2] ECU_ADDRESS 0xd000b916 FORMAT "%9.4" /end MEASUREMENT
/begin MEASUREMENT lam_bank_2.ls_ready.bf.lv_up_ls "Logical variable for operative readiness of upstream oxygen sensor" ULONG _CNV_S_2_RANGE______76_CM 1 100. 0. 1. DISPLAY_IDENTIFIER LV_UP_LS_2 ECU_ADDRESS 0xd000b8f1 BIT_MASK 0x1 /end MEASUREMENT
/begin MEASUREMENT lam_bank_2.lam_sti_afl.ctr_vls_afl_cyc "counter indicating the number of air fuel cycles since last activation of forced lambda stimulation" UWORD _CNV_A_R_LINEAR_____0_CM 1 100. 0. 65535. DISPLAY_IDENTIFIER CTR_VLS_AFL_CYC_2 ECU_ADDRESS 0xd000b926 FORMAT "%5.0" /end MEASUREMENT
/begin MEASUREMENT lam_bank_2.ls_down.vls_down "Downstream sensor voltage measured" UWORD _CNV_A_R_LINEAR_____2_CM 1 100. 0. 4.9951171875 DISPLAY_IDENTIFIER VLS_DOWN_2 ECU_ADDRESS 0xd000b8ee FORMAT "%5.3" /end MEASUREMENT
/begin MEASUREMENT lam_bank_2.ls_down_rdy.bf.lv_down_ls "Logical variable for operative readiness of downstream oxygen sensor(s)" ULONG _CNV_S_2_RANGE______76_CM 1 100. 0. 1. DISPLAY_IDENTIFIER LV_DOWN_LS_2 ECU_ADDRESS 0xd000b8f0 BIT_MASK 0x1 /end MEASUREMENT
/begin MEASUREMENT lv_msr_plaus "Logical variable plausibility MSR" UBYTE _CNV_S_2_RANGE__0___1_CM 1 100. 0. 1. DISPLAY_IDENTIFIER LV_MSR_PLAUS ECU_ADDRESS 0xd0008b90 BIT_MASK 0x1 /end MEASUREMENT
/begin CHARACTERISTIC ip_fac_tq_loss_acc_on "TQ_LOSS_ACC weighting factor at ACC activation" MAP 0xa080a98c _REC_MAP_20_u1_u1_u1 1.99220002 _CNV_A_R_LINEAR_____100_CM 0. 1.99220002 DISPLAY_IDENTIFIER IP_FAC_TQ_LOSS_ACC_ON FORMAT "%5.3"
 /begin AXIS_DESCR COM_AXIS t_acc _CNV_A_R_LINEAR_____3_CM 8 0. 2.55 FORMAT "%4.2" AXIS_PTS_REF ldp_t_acc_ip_fac_tq_loss_acc_on /end AXIS_DESCR
 /begin AXIS_DESCR COM_AXIS n_32 _CNV_A_R_LINEAR_____10_CM 8 0. 8160. FORMAT "%4.0" AXIS_PTS_REF ldp_n_32_ip_fac_tq_loss_acc_on /end AXIS_DESCR
/end CHARACTERISTIC
/begin CHARACTERISTIC ip_fac_tq_loss_acc_off "TQ_LOSS_ACC weighting factor at ACC deactivation" CURVE 0xa080a984 _REC_CUR_20_u1_u1 1.99220002 _CNV_A_R_LINEAR_____100_CM 0. 1.99220002 DISPLAY_IDENTIFIER IP_FAC_TQ_LOSS_ACC_OFF FORMAT "%5.3"
 /begin AXIS_DESCR COM_AXIS t_acc _CNV_A_R_LINEAR_____3_CM 8 0. 2.55 FORMAT "%4.2" AXIS_PTS_REF ldp_t_acc_fac_tq_loss_acc /end AXIS_DESCR
/end CHARACTERISTIC
/begin MEASUREMENT tq_add_acc "Torque reserve for switching on air conditioning compressor" SWORD _CNV_A_R_LINEAR_____31_CM 1 100. -1024. 1023.96875 DISPLAY_IDENTIFIER TQ_ADD_ACC ECU_ADDRESS 0xd000aaee FORMAT "%7.1" /end MEASUREMENT
/begin MEASUREMENT tq_loss_acc "Engine torque losses air conditioning compressor" SWORD _CNV_A_R_LINEAR_____31_CM 1 100. -1024. 1023.96875 DISPLAY_IDENTIFIER TQ_LOSS_ACC ECU_ADDRESS 0xd000aaec FORMAT "%8.2" /end MEASUREMENT
/begin MEASUREMENT tq_add_heat_acc "Torque reserve for switching on additional heating by ACC" SWORD _CNV_A_R_LINEAR_____31_CM 1 100. -1024. 1023.96875 DISPLAY_IDENTIFIER TQ_ADD_HEAT_ACC ECU_ADDRESS 0xd000aaf0 FORMAT "%8.2" /end MEASUREMENT
/begin MEASUREMENT lv_tout_acc "logical variable to start deactivation of torque reserve and condition for switch off TQ_LOSS_ACC calculation" UBYTE _CNV_S_2_RANGE__0___1_CM 1 100. 0. 1. DISPLAY_IDENTIFIER LV_TOUT_ACC ECU_ADDRESS 0xd0008cfc BIT_MASK 0x1 /end MEASUREMENT
/begin MEASUREMENT lv_req_heat_acc_ena "LV indicating that the conditions for additional heating are fulfilled" UBYTE _CNV_S_2_RANGE__0___1_CM 1 100. 0. 1. DISPLAY_IDENTIFIER LV_REQ_HEAT_ACC_ENA ECU_ADDRESS 0xd0008e94 BIT_MASK 0x1 /end MEASUREMENT
/begin MEASUREMENT lv_tout_req_heat_acc "logical variable to start deactivation of torque reserve TQ_ADD_HEAT_ACC" UBYTE _CNV_S_2_RANGE__0___1_CM 1 100. 0. 1. DISPLAY_IDENTIFIER LV_TOUT_REQ_HEAT_ACC ECU_ADDRESS 0xd0008e95 BIT_MASK 0x1 /end MEASUREMENT
/begin MEASUREMENT t_req_heat_acc "timer for duration of torque reserve TQ_ADD_HEAT_ACC calculation" ULONG _CNV_A_R_LINEAR_____3_CM 1 100. 0. 42949672.95 DISPLAY_IDENTIFIER T_REQ_HEAT_ACC ECU_ADDRESS 0xd000ba74 FORMAT "%11.2" /end MEASUREMENT
/begin CHARACTERISTIC ip_tq_add_acc "Torque reserve for switching on air conditioning compressor" MAP 0xa0816084 _REC_MAP_20_u2_u1_u2 2047.96875 _CNV_A_R_LINEAR_____87_CM -1024. 1023.96875 DISPLAY_IDENTIFIER IP_TQ_ADD_ACC FORMAT "%6.2"
 /begin AXIS_DESCR COM_AXIS n_32 _CNV_A_R_LINEAR_____10_CM 6 0. 8160. FORMAT "%4.0" AXIS_PTS_REF ldp_n_32__tq_add_acc /end AXIS_DESCR
 /begin AXIS_DESCR COM_AXIS tq_loss_acc_inp _CNV_A_R_LINEAR_____87_CM 6 -1024. 1023.96875 FORMAT "%6.2" AXIS_PTS_REF ldp_tq_loss_acc_inp__tq_add_acc /end AXIS_DESCR
/end CHARACTERISTIC
/begin CHARACTERISTIC ip_tq_add_heat_acc "Torque reserve for switching on additional heating" CURVE 0xa080b6fc _REC_CUR_20_u2_u1 2047.96875 _CNV_A_R_LINEAR_____87_CM -1024. 1023.96875 DISPLAY_IDENTIFIER IP_TQ_ADD_HEAT_ACC FORMAT "%6.2"
 /begin AXIS_DESCR COM_AXIS n_32 _CNV_A_R_LINEAR_____10_CM 6 0. 8160. FORMAT "%4.0" AXIS_PTS_REF ldp_n_32__tq_add_heat_acc /end AXIS_DESCR
/end CHARACTERISTIC
/begin CHARACTERISTIC c_tq_add_acc_lgrd "Limitation gradiant for TQ_ADD_ACC decrease after deactivation" VALUE 0xa080c358 _REC_VAL_20_u2 1023.96875 _CNV_A_R_LINEAR_____31_CM 0. 1023.96875 DISPLAY_IDENTIFIER C_TQ_ADD_ACC_LGRD FORMAT "%7.2" /end CHARACTERISTIC
/begin CHARACTERISTIC c_tq_add_heat_acc_lgrd "Limitation gradient for TQ_ADD_HEAT_ACC decrease after deactivation" VALUE 0xa080c360 _REC_VAL_20_u2 1023.96875 _CNV_A_R_LINEAR_____31_CM 0. 1023.96875 DISPLAY_IDENTIFIER C_TQ_ADD_HEAT_ACC_LGRD FORMAT "%7.2" /end CHARACTERISTIC
/begin CHARACTERISTIC c_tco_min_req_heat_acc "TCO threshold for enabling additional heat request" VALUE 0xa080c2db _REC_VAL_20_u1 190.5 _CNV_A_R_LINEAR_____17_CM -48. 142.5 DISPLAY_IDENTIFIER C_TCO_MIN_REQ_HEAT_ACC FORMAT "%5.1" /end CHARACTERISTIC
/begin CHARACTERISTIC c_tam_min_req_heat_acc "TAM threshold for enabling additional heat request" VALUE 0xa080c2b6 _REC_VAL_20_u1 190.5 _CNV_A_R_LINEAR_____17_CM -48. 142.5 DISPLAY_IDENTIFIER C_TAM_MIN_REQ_HEAT_ACC FORMAT "%5.1" /end CHARACTERISTIC
/begin CHARACTERISTIC c_tq_loss_max_acc "Maximum TQ_LOSS_ACC" VALUE 0xa080c386 _REC_VAL_20_s2 2047.96875 _CNV_A_R_LINEAR_____31_CM -1024. 1023.96875 DISPLAY_IDENTIFIER C_TQ_LOSS_MAX_ACC FORMAT "%8.2" /end CHARACTERISTIC
/begin AXIS_PTS ldp_t_acc_ip_fac_tq_loss_acc_on "" 0xa0808cc0 t_acc _REC_AXS_20_u1 2.55 _CNV_A_R_LINEAR_____3_CM 8 0. 2.55 FORMAT "%4.2" /end AXIS_PTS
/begin AXIS_PTS ldp_n_32_ip_fac_tq_loss_acc_on "" 0xa0808a04 n_32 _REC_AXS_20_u1 8160. _CNV_A_R_LINEAR_____10_CM 8 0. 8160. FORMAT "%4.0" /end AXIS_PTS
/begin AXIS_PTS ldp_n_32__tq_add_acc "" 0xa08089ae n_32 _REC_AXS_20_u1 8160. _CNV_A_R_LINEAR_____10_CM 6 0. 8160. FORMAT "%4.0" /end AXIS_PTS
/begin AXIS_PTS ldp_t_acc_fac_tq_loss_acc "" 0xa0808cb4 t_acc _REC_AXS_20_u1 2.55 _CNV_A_R_LINEAR_____3_CM 8 0. 2.55 FORMAT "%4.2" /end AXIS_PTS
/begin AXIS_PTS ldp_n_32__tq_add_heat_acc "" 0xa08089b6 n_32 _REC_AXS_20_u1 8160. _CNV_A_R_LINEAR_____10_CM 6 0. 8160. FORMAT "%4.0" /end AXIS_PTS
/begin MEASUREMENT tq_loss_acc_inp "ACC-torque for torque function" SWORD _CNV_A_R_LINEAR_____31_CM 1 100. -1024. 1023.96875 DISPLAY_IDENTIFIER TQ_LOSS_ACC_INP ECU_ADDRESS 0xd0001748 FORMAT "%8.2" /end MEASUREMENT
/begin CHARACTERISTIC c_crlc_tq_loss_acc_inp "Correlation factor for TQ_ACCIN_CAN calculation" VALUE 0xa080bb14 _REC_VAL_20_u1 0.99609375 _CNV_A_R_LINEAR_____28_CM 0. 0.99609375 DISPLAY_IDENTIFIER C_CRLC_TQ_LOSS_ACC_INP FORMAT "%5.3" /end CHARACTERISTIC
/begin AXIS_PTS ldp_tq_loss_acc_inp__tq_add_acc "" 0xa0808f98 tq_loss_acc_inp _REC_AXS_20_u2 2047.96875 _CNV_A_R_LINEAR_____87_CM 6 -1024. 1023.96875 FORMAT "%6.2" /end AXIS_PTS
/begin CHARACTERISTIC c_tq_add_acc_lgrd_on "Limitation gradiant for TQ_ADD_ACC increase at activation" VALUE 0xa080c35a _REC_VAL_20_u2 1023.96875 _CNV_A_R_LINEAR_____31_CM 0. 1023.96875 DISPLAY_IDENTIFIER C_TQ_ADD_ACC_LGRD_ON FORMAT "%7.2" /end CHARACTERISTIC
/begin CHARACTERISTIC c_t_req_heat_acc "time for duration of torque reserve TQ_ADD_HEAT_ACC calculation" VALUE 0xa080c26a _REC_VAL_20_u4 42949672.95 _CNV_A_R_LINEAR_____3_CM 0. 42949672.95 DISPLAY_IDENTIFIER C_T_REQ_HEAT_ACC FORMAT "%11.2" /end CHARACTERISTIC
/begin MEASUREMENT lv_amt_disable "logical variable for disabling AMT intervention due to EMS error" UBYTE _CNV_S_2_RANGE__0___1_CM 1 100. 0. 1. DISPLAY_IDENTIFIER LV_AMT_DISABLE ECU_ADDRESS 0xd0008ec5 BIT_MASK 0x1 /end MEASUREMENT
/begin MEASUREMENT lv_amt_disable_can "logical variable for disabling GS intervention due to CAN error" UBYTE _CNV_S_2_RANGE__0___1_CM 1 100. 0. 1. DISPLAY_IDENTIFIER LV_AMT_DISABLE_CAN ECU_ADDRESS 0xd0008ec6 BIT_MASK 0x1 /end MEASUREMENT
/begin MEASUREMENT lv_amt_ena_dec "logical variable for decreased torque intervention due to gear shift" UBYTE _CNV_S_2_RANGE__0___1_CM 1 100. 0. 1. DISPLAY_IDENTIFIER LV_AMT_ENA_DEC ECU_ADDRESS 0xd0008ec7 BIT_MASK 0x1 /end MEASUREMENT
/begin MEASUREMENT lv_amt_ena_inc "logical variable for increased torque intervention due to gear shift" UBYTE _CNV_S_2_RANGE__0___1_CM 1 100. 0. 1. DISPLAY_IDENTIFIER LV_AMT_ENA_INC ECU_ADDRESS 0xd0008ec8 BIT_MASK 0x1 /end MEASUREMENT
/begin MEASUREMENT lv_amt_ena "logical variable for gear shift intervention enabling" UBYTE _CNV_S_2_RANGE__0___1_CM 1 100. 0. 1. DISPLAY_IDENTIFIER LV_AMT_ENA ECU_ADDRESS 0xd0001752 BIT_MASK 0x1 /end MEASUREMENT
/begin MEASUREMENT tqi_amt_fast_dec_req "torque decrement for fast torque intervention during gear shift" SWORD _CNV_A_R_LINEAR_____31_CM 1 100. -1024. 1023.96875 DISPLAY_IDENTIFIER TQI_AMT_FAST_DEC_REQ ECU_ADDRESS 0xd000ab3c FORMAT "%8.2" /end MEASUREMENT
/begin MEASUREMENT tqi_amt_fast_dec_req_1 "Torque decrement for fast torque intervention during gear shift" SWORD _CNV_A_R_LINEAR_____31_CM 1 100. -1024. 1023.96875 DISPLAY_IDENTIFIER TQI_AMT_FAST_DEC_REQ_1 ECU_ADDRESS 0xd000ab44 FORMAT "%8.2" /end MEASUREMENT
/begin MEASUREMENT tqi_amt_slow_dec_req "torque decrement for slow torque intervention during gear shift" SWORD _CNV_A_R_LINEAR_____31_CM 1 100. -1024. 1023.96875 DISPLAY_IDENTIFIER TQI_AMT_SLOW_DEC_REQ ECU_ADDRESS 0xd000ab3e FORMAT "%8.2" /end MEASUREMENT
/begin MEASUREMENT tqi_amt_slow_dec_req_1 "torque decrement for slow torque intervention during gear shift" SWORD _CNV_A_R_LINEAR_____31_CM 1 100. -1024. 1023.96875 DISPLAY_IDENTIFIER TQI_AMT_SLOW_DEC_REQ_1 ECU_ADDRESS 0xd000ab46 FORMAT "%8.2" /end MEASUREMENT
/begin MEASUREMENT tqi_amt_fast_inc_req "torque increase for fast torque intervention during gear shift" SWORD _CNV_A_R_LINEAR_____31_CM 1 100. -1024. 1023.96875 DISPLAY_IDENTIFIER TQI_AMT_FAST_INC_REQ ECU_ADDRESS 0xd000ab40 FORMAT "%8.2" /end MEASUREMENT
/begin MEASUREMENT tqi_amt_fast_inc_req_1 "Torque increase for fast torque intervention during gear shift" SWORD _CNV_A_R_LINEAR_____31_CM 1 100. -1024. 1023.96875 DISPLAY_IDENTIFIER TQI_AMT_FAST_INC_REQ_1 ECU_ADDRESS 0xd000ab48 FORMAT "%8.2" /end MEASUREMENT
/begin MEASUREMENT tqi_amt_slow_inc_req "torque increase for slow torque intervention during gear shift" SWORD _CNV_A_R_LINEAR_____31_CM 1 100. -1024. 1023.96875 DISPLAY_IDENTIFIER TQI_AMT_SLOW_INC_REQ ECU_ADDRESS 0xd000ab42 FORMAT "%8.2" /end MEASUREMENT
/begin MEASUREMENT tqi_amt_slow_inc_req_1 "Torque increase for slow torque intervention during gear shift" SWORD _CNV_A_R_LINEAR_____31_CM 1 100. -1024. 1023.96875 DISPLAY_IDENTIFIER TQI_AMT_SLOW_INC_REQ_1 ECU_ADDRESS 0xd000ab4a FORMAT "%8.2" /end MEASUREMENT
/begin MEASUREMENT tqi_amt_fast_dec "torque decrement for fast torque intervention during gear shift" SWORD _CNV_A_R_LINEAR_____31_CM 1 100. -1024. 1023.96875 DISPLAY_IDENTIFIER TQI_AMT_FAST_DEC ECU_ADDRESS 0xd000ab4c FORMAT "%8.2" /end MEASUREMENT
/begin MEASUREMENT tqi_amt_slow_dec "torque decrement for slow torque intervention during gear shift" SWORD _CNV_A_R_LINEAR_____31_CM 1 100. -1024. 1023.96875 DISPLAY_IDENTIFIER TQI_AMT_SLOW_DEC ECU_ADDRESS 0xd000ab4e FORMAT "%8.2" /end MEASUREMENT
/begin MEASUREMENT lv_amt_dec_act "logical variable for torque intervention due to gear shift" UBYTE _CNV_S_2_RANGE__0___1_CM 1 100. 0. 1. DISPLAY_IDENTIFIER LV_AMT_DEC_ACT ECU_ADDRESS 0xd0008ec9 BIT_MASK 0x1 /end MEASUREMENT
/begin MEASUREMENT tqi_amt_fast_inc "torque increase for fast torque intervention during gear shift" SWORD _CNV_A_R_LINEAR_____31_CM 1 100. -1024. 1023.96875 DISPLAY_IDENTIFIER TQI_AMT_FAST_INC ECU_ADDRESS 0xd000ab50 FORMAT "%8.2" /end MEASUREMENT
/begin MEASUREMENT tqi_amt_slow_inc "torque increase for slow torque intervention during gear shift" SWORD _CNV_A_R_LINEAR_____31_CM 1 100. -1024. 1023.96875 DISPLAY_IDENTIFIER TQI_AMT_SLOW_INC ECU_ADDRESS 0xd000ab52 FORMAT "%8.2" /end MEASUREMENT
/begin MEASUREMENT lv_amt_dec_lih "logical variable for torque intervention LIH due to gear shift" UBYTE _CNV_S_2_RANGE__0___1_CM 1 100. 0. 1. DISPLAY_IDENTIFIER LV_AMT_DEC_LIH ECU_ADDRESS 0xd0001753 BIT_MASK 0x1 /end MEASUREMENT
/begin MEASUREMENT lv_amt_inc_act "logical variable for torque intervention due to gear shift" UBYTE _CNV_S_2_RANGE__0___1_CM 1 100. 0. 1. DISPLAY_IDENTIFIER LV_AMT_INC_ACT ECU_ADDRESS 0xd0008eca BIT_MASK 0x1 /end MEASUREMENT
/begin MEASUREMENT lv_amt_inc_lih "logical variable for torque intervention LIH due to gear shift" UBYTE _CNV_S_2_RANGE__0___1_CM 1 100. 0. 1. DISPLAY_IDENTIFIER LV_AMT_INC_LIH ECU_ADDRESS 0xd0008ecb BIT_MASK 0x1 /end MEASUREMENT
/begin CHARACTERISTIC c_lgrd_lih_amt_dec "limiting gradient for AMT emergency ramp function (default  0.6 Nm/10ms)" VALUE 0xa080be06 _REC_VAL_20_u2 1023.96875 _CNV_A_R_LINEAR_____187_CM 0. 1023.96875 DISPLAY_IDENTIFIER C_LGRD_LIH_AMT_DEC FORMAT "%7.2" /end CHARACTERISTIC
/begin CHARACTERISTIC c_lgrd_lih_amt_inc "limiting gradient for AMT emergency ramp function (default  0.6 Nm/10ms)" VALUE 0xa080be08 _REC_VAL_20_u2 1023.96875 _CNV_A_R_LINEAR_____187_CM 0. 1023.96875 DISPLAY_IDENTIFIER C_LGRD_LIH_AMT_INC FORMAT "%7.2" /end CHARACTERISTIC
/begin CHARACTERISTIC c_t_dly_lih_amt_dec "delay time for activation of AMT emergency ramp function (default 0s)" VALUE 0xa080c178 _REC_VAL_20_u1 2.55 _CNV_A_R_LINEAR_____3_CM 0. 2.55 DISPLAY_IDENTIFIER C_T_DLY_LIH_AMT_DEC FORMAT "%4.2" /end CHARACTERISTIC
/begin CHARACTERISTIC c_t_dly_lih_amt_inc "delay time for activation of AMT emergency ramp function (default 0s)" VALUE 0xa080c179 _REC_VAL_20_u1 2.55 _CNV_A_R_LINEAR_____3_CM 0. 2.55 DISPLAY_IDENTIFIER C_T_DLY_LIH_AMT_INC FORMAT "%4.2" /end CHARACTERISTIC
/begin CHARACTERISTIC c_amt_ena_inc_dec "Enable switch AMT intervention" VALUE 0xa080ba90 _REC_VAL_20_u1 3. _CNV_S_4_STATE_AMT__186_CM 0. 3. DISPLAY_IDENTIFIER C_AMT_ENA_INC_DEC /end CHARACTERISTIC
/begin MEASUREMENT state_tq_amt_plaus "Bitwise coded State for AMT intervention state" UBYTE _CNV_A_R_LINEAR_____0_CM 1 100. 0. 255. DISPLAY_IDENTIFIER STATE_TQ_AMT_PLAUS ECU_ADDRESS 0xd0008ec4 FORMAT "%3.0" /end MEASUREMENT
/begin MEASUREMENT t_amt_inc_lih_ctr "Delay time" UBYTE _CNV_A_R_LINEAR_____3_CM 1 100. 0. 2.55 DISPLAY_IDENTIFIER T_AMT_INC_LIH_CTR ECU_ADDRESS 0xd0001751 FORMAT "%4.2" /end MEASUREMENT
/begin MEASUREMENT t_amt_dec_lih_ctr "Delay time" UBYTE _CNV_A_R_LINEAR_____3_CM 1 100. 0. 2.55 DISPLAY_IDENTIFIER T_AMT_DEC_LIH_CTR ECU_ADDRESS 0xd0001750 FORMAT "%4.2" /end MEASUREMENT
/begin CHARACTERISTIC c_tq_amt_fast_inh_fcut "threshold for inhibiting FCUT during AMT intervention" VALUE 0xa080c368 _REC_VAL_20_s2 2047.96875 _CNV_A_R_LINEAR_____31_CM -1024. 1023.96875 DISPLAY_IDENTIFIER C_TQ_AMT_FAST_INH_FCUT FORMAT "%8.2" /end CHARACTERISTIC
/begin CHARACTERISTIC c_tq_amt_slow_inh_fcut "threshold for inhibiting FCUT during AMT intervention" VALUE 0xa080c36a _REC_VAL_20_s2 2047.96875 _CNV_A_R_LINEAR_____31_CM -1024. 1023.96875 DISPLAY_IDENTIFIER C_TQ_AMT_SLOW_INH_FCUT FORMAT "%8.2" /end CHARACTERISTIC
/begin MEASUREMENT lv_inh_fcut_amt "Logical variable inhibiting FCUT during AMT-intervention" UBYTE _CNV_S_2_RANGE__0___1_CM 1 100. 0. 1. DISPLAY_IDENTIFIER LV_INH_FCUT_AMT ECU_ADDRESS 0xd0008ecc BIT_MASK 0x1 /end MEASUREMENT
/begin MEASUREMENT lv_ars_disable "logical variable for disabling ARS intervention due to EMS error" UBYTE _CNV_S_2_RANGE__0___1_CM 1 100. 0. 1. DISPLAY_IDENTIFIER LV_ARS_DISABLE ECU_ADDRESS 0xd0008ebd BIT_MASK 0x1 /end MEASUREMENT
/begin MEASUREMENT lv_ars_disable_can "logical variable for disabling ARS intervention due to CAN error" UBYTE _CNV_S_2_RANGE__0___1_CM 1 100. 0. 1. DISPLAY_IDENTIFIER LV_ARS_DISABLE_CAN ECU_ADDRESS 0xd0008ebe BIT_MASK 0x1 /end MEASUREMENT
/begin MEASUREMENT lv_ars_ena "logical variable for ASR intervention enabling" UBYTE _CNV_S_2_RANGE__0___1_CM 1 100. 0. 1. DISPLAY_IDENTIFIER LV_ARS_ENA ECU_ADDRESS 0xd0008ebf BIT_MASK 0x1 /end MEASUREMENT
/begin MEASUREMENT lv_tq_max_ars "logical variable indicating maximum torque request - ARS" UBYTE _CNV_S_2_RANGE__0___1_CM 1 100. 0. 1. DISPLAY_IDENTIFIER LV_TQ_MAX_ARS ECU_ADDRESS 0xd0008ec0 BIT_MASK 0x1 /end MEASUREMENT
/begin MEASUREMENT tq_loss_ars_sp_max "ARS target torque loss - maximum (considering offset)" SWORD _CNV_A_R_LINEAR_____31_CM 1 100. -1024. 1023.96875 DISPLAY_IDENTIFIER TQ_LOSS_ARS_SP_MAX ECU_ADDRESS 0xd000ab2c FORMAT "%8.2" /end MEASUREMENT
/begin MEASUREMENT tq_loss_ars_sp_max_1 "ARS target torque loss - maximum" SWORD _CNV_A_R_LINEAR_____31_CM 1 100. -1024. 1023.96875 DISPLAY_IDENTIFIER TQ_LOSS_ARS_SP_MAX_1 ECU_ADDRESS 0xd000ab2a FORMAT "%8.2" /end MEASUREMENT
/begin MEASUREMENT tq_loss_ars_av_max_1 "ARS actual value of torque loss - maximum" SWORD _CNV_A_R_LINEAR_____31_CM 1 100. -1024. 1023.96875 DISPLAY_IDENTIFIER TQ_LOSS_ARS_AV_MAX_1 ECU_ADDRESS 0xd000ab2e FORMAT "%8.2" /end MEASUREMENT
/begin MEASUREMENT t_dly_tq_max_ars "Delay time for activation of LV_TQ_MAX_ARS" UWORD _CNV_A_R_LINEAR_____3_CM 1 100. 0. 655.35 DISPLAY_IDENTIFIER T_DLY_TQ_MAX_ARS ECU_ADDRESS 0xd000ab28 FORMAT "%6.2" /end MEASUREMENT
/begin MEASUREMENT tq_loss_ars "torque loss ARS for torque loss calculation" SWORD _CNV_A_R_LINEAR_____31_CM 1 100. -1024. 1023.96875 DISPLAY_IDENTIFIER TQ_LOSS_ARS ECU_ADDRESS 0xd000ab32 FORMAT "%8.2" /end MEASUREMENT
/begin MEASUREMENT tq_loss_ars_av_max "ARS actual value of torque loss - maximum (considering offset)" SWORD _CNV_A_R_LINEAR_____31_CM 1 100. -1024. 1023.96875 DISPLAY_IDENTIFIER TQ_LOSS_ARS_AV_MAX ECU_ADDRESS 0xd000ab30 FORMAT "%8.2" /end MEASUREMENT
/begin MEASUREMENT tq_loss_ars_grd "Torque loss gradient - ARS" SWORD _CNV_A_R_LINEAR_____31_CM 1 100. -1024. 1023.96875 DISPLAY_IDENTIFIER TQ_LOSS_ARS_GRD ECU_ADDRESS 0xd000ab36 FORMAT "%8.2" /end MEASUREMENT
/begin MEASUREMENT tq_loss_ars_dif "Difference torque loss TQ_LOSS_ARS_SP_CAN - TQ_LOSS_ARS_AV_CAN" SWORD _CNV_A_R_LINEAR_____31_CM 1 100. -1024. 1023.96875 DISPLAY_IDENTIFIER TQ_LOSS_ARS_DIF ECU_ADDRESS 0xd000ab38 FORMAT "%8.2" /end MEASUREMENT
/begin CHARACTERISTIC ip_tq_loss_ars_sp_max "ARS target torque loss - maximum" MAP 0xa0816b04 _REC_MAP_20_u2_u2_u2 2047.96875 _CNV_A_R_LINEAR_____87_CM -1024. 1023.96875 DISPLAY_IDENTIFIER IP_TQ_LOSS_ARS_SP_MAX FORMAT "%6.2"
 /begin AXIS_DESCR COM_AXIS ac_veh_trv_tcs _CNV_A_R_LINEAR_____256_CM 8 -51.175 51.175 FORMAT "%7.4" AXIS_PTS_REF ldpm_ac_veh_trv_tcs /end AXIS_DESCR
 /begin AXIS_DESCR COM_AXIS vs_fil _CNV_A_R_LINEAR_____86_CM 8 0. 511.99218 FORMAT "%7.3" AXIS_PTS_REF ldpm_vs_fil /end AXIS_DESCR
/end CHARACTERISTIC
/begin CHARACTERISTIC ip_tq_loss_ars_av_max "ARS Actual value of torque loss - maximum" MAP 0xa0816a04 _REC_MAP_20_u2_u2_u2 2047.96875 _CNV_A_R_LINEAR_____87_CM -1024. 1023.96875 DISPLAY_IDENTIFIER IP_TQ_LOSS_ARS_AV_MAX FORMAT "%6.2"
 /begin AXIS_DESCR COM_AXIS ac_veh_trv_tcs _CNV_A_R_LINEAR_____256_CM 8 -51.175 51.175 FORMAT "%7.4" AXIS_PTS_REF ldpm_ac_veh_trv_tcs /end AXIS_DESCR
 /begin AXIS_DESCR COM_AXIS vs_fil _CNV_A_R_LINEAR_____86_CM 8 0. 511.99218 FORMAT "%7.3" AXIS_PTS_REF ldpm_vs_fil /end AXIS_DESCR
/end CHARACTERISTIC
/begin CHARACTERISTIC ip_tq_loss_ars_sp_can_max "ARS torque loss depending on torque loss (SP) via CAN and engine speed" MAP 0xa0816a84 _REC_MAP_20_u2_u2_u1 2047.96875 _CNV_A_R_LINEAR_____87_CM -1024. 1023.96875 DISPLAY_IDENTIFIER IP_TQ_LOSS_ARS_SP_CAN_MAX FORMAT "%6.2"
 /begin AXIS_DESCR COM_AXIS tq_loss_ars_sp_can _CNV_A_R_LINEAR_____87_CM 8 -1024. 1023.96875 FORMAT "%6.2" AXIS_PTS_REF ldp_tq_loss_ars_sp_can_max /end AXIS_DESCR
 /begin AXIS_DESCR COM_AXIS n_32 _CNV_A_R_LINEAR_____10_CM 8 0. 8160. FORMAT "%4.0" AXIS_PTS_REF ldpm_n_32__tq_loss_ars /end AXIS_DESCR
/end CHARACTERISTIC
/begin CHARACTERISTIC ip_tq_loss_ars_av_can_max "ARS torque loss depending on torque loss (AV) via CAN and engine speed" MAP 0xa0816984 _REC_MAP_20_u2_u2_u1 2047.96875 _CNV_A_R_LINEAR_____87_CM -1024. 1023.96875 DISPLAY_IDENTIFIER IP_TQ_LOSS_ARS_AV_CAN_MAX FORMAT "%6.2"
 /begin AXIS_DESCR COM_AXIS tq_loss_ars_av_can _CNV_A_R_LINEAR_____87_CM 8 -1024. 1023.96875 FORMAT "%6.2" AXIS_PTS_REF ldp_tq_loss_ars_av_can_max /end AXIS_DESCR
 /begin AXIS_DESCR COM_AXIS n_32 _CNV_A_R_LINEAR_____10_CM 8 0. 8160. FORMAT "%4.0" AXIS_PTS_REF ldpm_n_32__tq_loss_ars /end AXIS_DESCR
/end CHARACTERISTIC
/begin CHARACTERISTIC c_fac_tq_loss_ars_grd "ARS torque loss gradient - correction factor" VALUE 0xa080bd0e _REC_VAL_20_u2 0.9999847412109381 _CNV_A_R_LINEAR_____89_CM 0. 0.9999847412109381 DISPLAY_IDENTIFIER C_FAC_TQ_LOSS_ARS_GRD FORMAT "%7.6" /end CHARACTERISTIC
/begin CHARACTERISTIC c_fac_tq_loss_ars_dif "ARS torque loss actual value - correction factor" VALUE 0xa080bd0c _REC_VAL_20_u2 0.9999847412109381 _CNV_A_R_LINEAR_____89_CM 0. 0.9999847412109381 DISPLAY_IDENTIFIER C_FAC_TQ_LOSS_ARS_DIF FORMAT "%7.6" /end CHARACTERISTIC
/begin CHARACTERISTIC c_t_dly_tq_max_ars "Time delay for activating LV_TQ_MAX_ARS" VALUE 0xa080c190 _REC_VAL_20_u2 655.35 _CNV_A_R_LINEAR_____3_CM 0. 655.35 DISPLAY_IDENTIFIER C_T_DLY_TQ_MAX_ARS FORMAT "%6.2" /end CHARACTERISTIC
/begin CHARACTERISTIC c_tq_loss_ars_sp_ofs "Offset for TQ_LOSS_ARS_SP" VALUE 0xa080c384 _REC_VAL_20_s2 2047.96875 _CNV_A_R_LINEAR_____31_CM -1024. 1023.96875 DISPLAY_IDENTIFIER C_TQ_LOSS_ARS_SP_OFS FORMAT "%8.2" /end CHARACTERISTIC
/begin CHARACTERISTIC c_tq_loss_ars_av_ofs "Offset for TQ_LOSS_ARS_AV" VALUE 0xa080c382 _REC_VAL_20_s2 2047.96875 _CNV_A_R_LINEAR_____31_CM -1024. 1023.96875 DISPLAY_IDENTIFIER C_TQ_LOSS_ARS_AV_OFS FORMAT "%8.2" /end CHARACTERISTIC
/begin CHARACTERISTIC c_v_max_ars_diag "filtered vehicle speed threshold for diagnosis" VALUE 0xa080c3da _REC_VAL_20_u2 511.99218 _CNV_A_R_LINEAR_____86_CM 0. 511.99218 DISPLAY_IDENTIFIER C_V_MAX_ARS_DIAG FORMAT "%7.3" /end CHARACTERISTIC
/begin CHARACTERISTIC c_n_max_ars_diag "engine speed threshold for diagnosis" VALUE 0xa080bf5e _REC_VAL_20_u1 8160. _CNV_A_R_LINEAR_____10_CM 0. 8160. DISPLAY_IDENTIFIER C_N_MAX_ARS_DIAG FORMAT "%4.0" /end CHARACTERISTIC
/begin AXIS_PTS ldpm_ac_veh_trv_tcs "" 0xa0809324 ac_veh_trv_tcs _REC_AXS_20_u2 102.35 _CNV_A_R_LINEAR_____256_CM 8 -51.175 51.175 FORMAT "%7.4" /end AXIS_PTS
/begin AXIS_PTS ldpm_vs_fil "" 0xa08098c8 vs_fil _REC_AXS_20_u2 511.99218 _CNV_A_R_LINEAR_____86_CM 8 0. 511.99218 FORMAT "%7.3" /end AXIS_PTS
/begin AXIS_PTS ldpm_n_32__tq_loss_ars "" 0xa0809610 n_32 _REC_AXS_20_u1 8160. _CNV_A_R_LINEAR_____10_CM 8 0. 8160. FORMAT "%4.0" /end AXIS_PTS
/begin AXIS_PTS ldp_tq_loss_ars_sp_can_max "" 0xa0808fdc tq_loss_ars_sp_can _REC_AXS_20_u2 2047.96875 _CNV_A_R_LINEAR_____87_CM 8 -1024. 1023.96875 FORMAT "%6.2" /end AXIS_PTS
/begin AXIS_PTS ldp_tq_loss_ars_av_can_max "" 0xa0808fb8 tq_loss_ars_av_can _REC_AXS_20_u2 2047.96875 _CNV_A_R_LINEAR_____87_CM 8 -1024. 1023.96875 FORMAT "%6.2" /end AXIS_PTS
/begin MEASUREMENT state_tq_ars_plaus "Bitwise coded State for ARS intervention state" UBYTE _CNV_A_R_LINEAR_____0_CM 1 100. 0. 255. DISPLAY_IDENTIFIER STATE_TQ_ARS_PLAUS ECU_ADDRESS 0xd0008ebc FORMAT "%3.0" /end MEASUREMENT
/begin MEASUREMENT lv_tq_loss_ars_is_ad_inh "flag for inhibition of IS-control adaptations due to torque losses ARS" UBYTE _CNV_S_2_RANGE__0___1_CM 1 100. 0. 1. DISPLAY_IDENTIFIER LV_TQ_LOSS_ARS_IS_AD_INH ECU_ADDRESS 0xd0008ec1 BIT_MASK 0x1 /end MEASUREMENT
/begin CHARACTERISTIC c_tq_loss_ars_ad "threshold torque losses PSTE for inhibition of IS-control adaptations" VALUE 0xa080c380 _REC_VAL_20_s2 2047.96875 _CNV_A_R_LINEAR_____31_CM -1024. 1023.96875 DISPLAY_IDENTIFIER C_TQ_LOSS_ARS_AD FORMAT "%8.2" /end CHARACTERISTIC
/begin CHARACTERISTIC c_t_ars_dly_ad "threshold torque losses PSTE for inhibition of IS-control adaptations" VALUE 0xa080c11c _REC_VAL_20_u1 2.55 _CNV_A_R_LINEAR_____3_CM 0. 2.55 DISPLAY_IDENTIFIER C_T_ARS_DLY_AD FORMAT "%4.2" /end CHARACTERISTIC
/begin MEASUREMENT tq_conv_can_1 "converter torque of CAN" SWORD _CNV_A_R_LINEAR_____31_CM 1 100. -1024. 1023.96875 DISPLAY_IDENTIFIER TQ_CONV_CAN_1 ECU_ADDRESS 0xd000aaf6 FORMAT "%6.2" /end MEASUREMENT
/begin MEASUREMENT tq_add_conv "Torque reserve for switching converter Torque" SWORD _CNV_A_R_LINEAR_____31_CM 1 100. -1024. 1023.96875 DISPLAY_IDENTIFIER TQ_ADD_CONV ECU_ADDRESS 0xd000aaf8 FORMAT "%6.2" /end MEASUREMENT
/begin MEASUREMENT lv_tout_conv "logical variable to start deactivation of torque reserve and condition for switch off TQ_CONV calculation" UBYTE _CNV_S_2_RANGE__0___1_CM 1 100. 0. 1. DISPLAY_IDENTIFIER LV_TOUT_CONV ECU_ADDRESS 0xd0001769 BIT_MASK 0x1 /end MEASUREMENT
/begin MEASUREMENT t_conv "timer for duration of transient TQ_LOSS_CONV correction" UWORD _CNV_A_R_LINEAR_____3_CM 1 100. 0. 5.1 DISPLAY_IDENTIFIER T_CONV ECU_ADDRESS 0xd0001758 FORMAT "%4.2" /end MEASUREMENT
/begin MEASUREMENT tq_clu_amt "converter torque" SWORD _CNV_A_R_LINEAR_____31_CM 1 100. -1024. 1023.96875 DISPLAY_IDENTIFIER TQ_CLU_AMT ECU_ADDRESS 0xd000aafe FORMAT "%8.2" /end MEASUREMENT
/begin MEASUREMENT lv_amt_crawl_on "Active AMT clutch torque" UBYTE _CNV_S_2_RANGE__0___1_CM 1 100. 0. 1. DISPLAY_IDENTIFIER LV_AMT_CRAWL_ON ECU_ADDRESS 0xd0008e99 BIT_MASK 0x1 /end MEASUREMENT
/begin CHARACTERISTIC ip_tq_amt "AMT torque offset" CURVE 0xa080b718 _REC_CUR_20_u2_u1 2047.96875 _CNV_A_R_LINEAR_____87_CM -1024. 1023.96875 DISPLAY_IDENTIFIER IP_TQ_AMT FORMAT "%6.2"
 /begin AXIS_DESCR COM_AXIS tco _CNV_A_R_LINEAR_____17_CM 6 -48. 142.5 FORMAT "%5.1" AXIS_PTS_REF ldp_tco__tq_clu_amt /end AXIS_DESCR
/end CHARACTERISTIC
/begin CHARACTERISTIC ip_tq_vs_fil_amt "AMT torque offset by VS and N_DIF" MAP 0xa0816f84 _REC_MAP_20_u2_u2_u2 2047.96875 _CNV_A_R_LINEAR_____87_CM -1024. 1023.96875 DISPLAY_IDENTIFIER IP_TQ_VS_FIL_AMT FORMAT "%6.2"
 /begin AXIS_DESCR COM_AXIS vs_fil _CNV_A_R_LINEAR_____86_CM 6 0. 511.99218 FORMAT "%7.3" AXIS_PTS_REF ldp_vs_fil__tq_clu_amt /end AXIS_DESCR
 /begin AXIS_DESCR COM_AXIS n_dif _CNV_A_R_LINEAR_____193_CM 6 -32768. 32767. FORMAT "%6.0" AXIS_PTS_REF ldp_n_dif__tq_clu_amt /end AXIS_DESCR
/end CHARACTERISTIC
/begin CHARACTERISTIC c_tq_add_conv_lgrd "Limitation gradient for TQ_ADD_CONV decrease after deactivation" VALUE 0xa080c35e _REC_VAL_20_u2 1023.96875 _CNV_A_R_LINEAR_____31_CM 0. 1023.96875 DISPLAY_IDENTIFIER C_TQ_ADD_CONV_LGRD FORMAT "%7.2" /end CHARACTERISTIC
/begin MEASUREMENT tq_add_trans "Torque reserve for Transmission" SWORD _CNV_A_R_LINEAR_____31_CM 1 100. -1024. 1023.96875 DISPLAY_IDENTIFIER TQ_ADD_TRANS ECU_ADDRESS 0xd000aafa FORMAT "%8.2" /end MEASUREMENT
/begin MEASUREMENT tq_add_amt "Torque reserve for switching AMT Torque" SWORD _CNV_A_R_LINEAR_____31_CM 1 100. -1024. 1023.96875 DISPLAY_IDENTIFIER TQ_ADD_AMT ECU_ADDRESS 0xd000ab00 FORMAT "%8.2" /end MEASUREMENT
/begin MEASUREMENT lv_tout_amt "logical variable to start deactivation of torque reserve and condition for switch off AMT calculation" UBYTE _CNV_S_2_RANGE__0___1_CM 1 100. 0. 1. DISPLAY_IDENTIFIER LV_TOUT_AMT ECU_ADDRESS 0xd0008e9a BIT_MASK 0x1 /end MEASUREMENT
/begin MEASUREMENT t_amt "timer for duration of transient TQ_LOSS_AMT correction" UWORD _CNV_A_R_LINEAR_____3_CM 1 100. 0. 5.1 DISPLAY_IDENTIFIER T_AMT ECU_ADDRESS 0xd000175a FORMAT "%4.2" /end MEASUREMENT
/begin CHARACTERISTIC ip_tq_add_conv "Torque reserve for switch GS" MAP 0xa08160cc _REC_MAP_20_u2_u1_u1 2047.96875 _CNV_A_R_LINEAR_____87_CM -1024. 1023.96875 DISPLAY_IDENTIFIER IP_TQ_ADD_CONV FORMAT "%6.2"
 /begin AXIS_DESCR COM_AXIS n_32 _CNV_A_R_LINEAR_____10_CM 6 0. 8160. FORMAT "%4.0" AXIS_PTS_REF ldp_n_32_ip_tq_add_conv /end AXIS_DESCR
 /begin AXIS_DESCR COM_AXIS toil _CNV_A_R_LINEAR_____26_CM 6 -40. 160. FORMAT "%3.0" AXIS_PTS_REF ldpm_toil_tq_add_conv /end AXIS_DESCR
/end CHARACTERISTIC
/begin CHARACTERISTIC ip_tq_add_amt "Torque reserve for switching on AMT" CURVE 0xa080b6f0 _REC_CUR_20_u2_u1 2047.96875 _CNV_A_R_LINEAR_____87_CM -1024. 1023.96875 DISPLAY_IDENTIFIER IP_TQ_ADD_AMT FORMAT "%6.2"
 /begin AXIS_DESCR COM_AXIS n_32 _CNV_A_R_LINEAR_____10_CM 6 0. 8160. FORMAT "%4.0" AXIS_PTS_REF ldp_n_32_ip_tq_add_amt /end AXIS_DESCR
/end CHARACTERISTIC
/begin MEASUREMENT lv_dly_n_sp_is "Flag for idle speed setpoint change" UBYTE _CNV_S_2_RANGE__0___1_CM 1 100. 0. 1. DISPLAY_IDENTIFIER LV_DLY_N_SP_IS ECU_ADDRESS 0xd0008e98 BIT_MASK 0x1 /end MEASUREMENT
/begin MEASUREMENT tq_conv_stn "Stationary Converter Torque" SWORD _CNV_A_R_LINEAR_____31_CM 1 100. -1024. 1023.96875 DISPLAY_IDENTIFIER TQ_CONV_STN ECU_ADDRESS 0xd0001760 FORMAT "%6.2" /end MEASUREMENT
/begin CHARACTERISTIC lc_tq_conv_dri_inh "logical constant converter torque calculation at LV_DRI = 0 inhibit" VALUE 0xa080c607 _REC_VAL_20_u1 1. _CNV_A_R_LINEAR_____0_CM 0. 1. DISPLAY_IDENTIFIER LC_TQ_CONV_DRI_INH FORMAT "%2.0" /end CHARACTERISTIC
/begin CHARACTERISTIC lc_tq_conv_can_inh "logical constant converter torque by CAN-interface inhibit" VALUE 0xa080c606 _REC_VAL_20_u1 1. _CNV_A_R_LINEAR_____0_CM 0. 1. DISPLAY_IDENTIFIER LC_TQ_CONV_CAN_INH FORMAT "%2.0" /end CHARACTERISTIC
/begin CHARACTERISTIC ip_fac_conv__toil "Converter characteristic" CURVE 0xa080a2ac _REC_CUR_20_u2_u1 4.88e-004 _CNV_A_R_LINEAR_____257_CM 0. 4.88e-004 DISPLAY_IDENTIFIER IP_FAC_CONV__TOIL FORMAT "%8.7"
 /begin AXIS_DESCR COM_AXIS toil _CNV_A_R_LINEAR_____26_CM 8 -40. 160. FORMAT "%3.0" AXIS_PTS_REF ldp_toil_fac_conv /end AXIS_DESCR
/end CHARACTERISTIC
/begin CHARACTERISTIC ip_fac_conv_dri__toil "Converter characteristic" CURVE 0xa080a2bc _REC_CUR_20_u2_u1 4.88e-004 _CNV_A_R_LINEAR_____257_CM 0. 4.88e-004 DISPLAY_IDENTIFIER IP_FAC_CONV_DRI__TOIL FORMAT "%8.7"
 /begin AXIS_DESCR COM_AXIS toil _CNV_A_R_LINEAR_____26_CM 8 -40. 160. FORMAT "%3.0" AXIS_PTS_REF ldp_toil_fac_conv /end AXIS_DESCR
/end CHARACTERISTIC
/begin CHARACTERISTIC ip_t_dly_conv__toil "Time delay for TQ_CONV activation" CURVE 0xa080b408 _REC_CUR_20_u1_u1 2550. _CNV_A_R_LINEAR_____20_CM 0. 2550. DISPLAY_IDENTIFIER IP_T_DLY_CONV__TOIL FORMAT "%4.0"
 /begin AXIS_DESCR COM_AXIS toil _CNV_A_R_LINEAR_____26_CM 8 -40. 160. FORMAT "%3.0" AXIS_PTS_REF ldp_toil_t_dly_conv /end AXIS_DESCR
/end CHARACTERISTIC
/begin CHARACTERISTIC ip_t_dly_n_sp_is__toil "Time delay for change of idle speed setpoint " CURVE 0xa080b418 _REC_CUR_20_u1_u1 2550. _CNV_A_R_LINEAR_____20_CM 0. 2550. DISPLAY_IDENTIFIER IP_T_DLY_N_SP_IS__TOIL FORMAT "%4.0"
 /begin AXIS_DESCR COM_AXIS toil _CNV_A_R_LINEAR_____26_CM 8 -40. 160. FORMAT "%3.0" AXIS_PTS_REF ldp_toil_t_dly_n_sp_is /end AXIS_DESCR
/end CHARACTERISTIC
/begin CHARACTERISTIC ip_fac_tq_conv__n_ratio_conv "Torque request factor" CURVE 0xa080a95c _REC_CUR_20_u2_u1 1.99996948242188 _CNV_A_R_LINEAR_____9_CM 0. 1.99996948242188 DISPLAY_IDENTIFIER IP_FAC_TQ_CONV__N_RATIO_CONV FORMAT "%7.5"
 /begin AXIS_DESCR COM_AXIS n_ratio_conv _CNV_A_R_LINEAR_____28_CM 8 0. 0.99609375 FORMAT "%5.3" AXIS_PTS_REF ldp_n_ratio_conv_fac_tq_conv /end AXIS_DESCR
/end CHARACTERISTIC
/begin CHARACTERISTIC c_tq_thd_amt_isc "Threshold look  ISC" VALUE 0xa080c39a _REC_VAL_20_u2 1023.96875 _CNV_A_R_LINEAR_____31_CM 0. 1023.96875 DISPLAY_IDENTIFIER C_TQ_THD_AMT_ISC FORMAT "%7.2" /end CHARACTERISTIC
/begin CHARACTERISTIC c_tq_add_amt_lgrd "Limitation gradient for TQ_ADD_AMT decrease after deactivation" VALUE 0xa080c35c _REC_VAL_20_u2 1023.96875 _CNV_A_R_LINEAR_____31_CM 0. 1023.96875 DISPLAY_IDENTIFIER C_TQ_ADD_AMT_LGRD FORMAT "%7.2" /end CHARACTERISTIC
/begin CHARACTERISTIC c_tq_lgrd_crawl_inc "????" VALUE 0xa080c378 _REC_VAL_20_u2 1023.96875 _CNV_A_R_LINEAR_____31_CM 0. 1023.96875 DISPLAY_IDENTIFIER C_TQ_LGRD_CRAWL_INC FORMAT "%7.2" /end CHARACTERISTIC
/begin CHARACTERISTIC c_tq_lgrd_crawl_dec "????" VALUE 0xa080c376 _REC_VAL_20_u2 1023.96875 _CNV_A_R_LINEAR_____31_CM 0. 1023.96875 DISPLAY_IDENTIFIER C_TQ_LGRD_CRAWL_DEC FORMAT "%7.2" /end CHARACTERISTIC
/begin MEASUREMENT tq_conv "Converter Torque" SWORD _CNV_A_R_LINEAR_____31_CM 1 100. -1024. 1023.96875 DISPLAY_IDENTIFIER TQ_CONV ECU_ADDRESS 0xd000aaf4 FORMAT "%6.2" /end MEASUREMENT
/begin CHARACTERISTIC ip_n_tur__gr_at__vs "Turbine speed" MAP 0xa080b1b0 _REC_MAP_20_u2_u1_u1 65535. _CNV_A_R_LINEAR_____14_CM 0. 65535. DISPLAY_IDENTIFIER IP_N_TUR__GR_AT__VS FORMAT "%5.0"
 /begin AXIS_DESCR COM_AXIS gr_at _CNV_A_R_LINEAR_____0_CM 13 0. 8. FORMAT "%1.0" AXIS_PTS_REF ldp_gr_at_n_tur /end AXIS_DESCR
 /begin AXIS_DESCR COM_AXIS vs _CNV_A_R_LINEAR_____6_CM 2 0. 255. FORMAT "%3.0" AXIS_PTS_REF ldp_vs_n_tur /end AXIS_DESCR
/end CHARACTERISTIC
/begin CHARACTERISTIC ip_tq_conv_can "Corrected Converter tourque via N_32" MAP 0xa081654c _REC_MAP_20_u2_u1_u2 2047.96875 _CNV_A_R_LINEAR_____87_CM -1024. 1023.96875 DISPLAY_IDENTIFIER IP_TQ_CONV_CAN FORMAT "%6.2"
 /begin AXIS_DESCR COM_AXIS n_32 _CNV_A_R_LINEAR_____10_CM 8 0. 8160. FORMAT "%4.0" AXIS_PTS_REF ldp_n_32__tq_conv /end AXIS_DESCR
 /begin AXIS_DESCR COM_AXIS tq_conv_can _CNV_A_R_LINEAR_____87_CM 8 -1024. 1023.96875 FORMAT "%6.2" AXIS_PTS_REF ldp_tq_conv_can__tq_conv /end AXIS_DESCR
/end CHARACTERISTIC
/begin AXIS_PTS ldp_tco__tq_clu_amt "" 0xa0808df8 tco _REC_AXS_20_u1 190.5 _CNV_A_R_LINEAR_____17_CM 6 -48. 142.5 FORMAT "%5.1" /end AXIS_PTS
/begin AXIS_PTS ldp_n_dif__tq_clu_amt "" 0xa0808ae8 n_dif _REC_AXS_20_u2 65535. _CNV_A_R_LINEAR_____193_CM 6 -32768. 32767. FORMAT "%6.0" /end AXIS_PTS
/begin AXIS_PTS ldp_n_32_ip_tq_add_conv "" 0xa0808a56 n_32 _REC_AXS_20_u1 8160. _CNV_A_R_LINEAR_____10_CM 6 0. 8160. FORMAT "%4.0" /end AXIS_PTS
/begin AXIS_PTS ldp_n_32_ip_tq_add_amt "" 0xa0808a4e n_32 _REC_AXS_20_u1 8160. _CNV_A_R_LINEAR_____10_CM 6 0. 8160. FORMAT "%4.0" /end AXIS_PTS
/begin AXIS_PTS ldp_vs_fil__tq_clu_amt "" 0xa08092c4 vs_fil _REC_AXS_20_u2 511.99218 _CNV_A_R_LINEAR_____86_CM 6 0. 511.99218 FORMAT "%7.3" /end AXIS_PTS
/begin AXIS_PTS ldp_n_ratio_conv_fac_tq_conv "" 0xa0808b9c n_ratio_conv _REC_AXS_20_u1 0.99609375 _CNV_A_R_LINEAR_____28_CM 8 0. 0.99609375 FORMAT "%5.3" /end AXIS_PTS
/begin AXIS_PTS ldp_toil_t_dly_n_sp_is "" 0xa0808f24 toil _REC_AXS_20_u1 200. _CNV_A_R_LINEAR_____26_CM 8 -40. 160. FORMAT "%3.0" /end AXIS_PTS
/begin AXIS_PTS ldp_toil_t_dly_conv "" 0xa0808f18 toil _REC_AXS_20_u1 200. _CNV_A_R_LINEAR_____26_CM 8 -40. 160. FORMAT "%3.0" /end AXIS_PTS
/begin AXIS_PTS ldp_toil_fac_conv "" 0xa0808ef8 toil _REC_AXS_20_u1 200. _CNV_A_R_LINEAR_____26_CM 8 -40. 160. FORMAT "%3.0" /end AXIS_PTS
/begin AXIS_PTS ldp_gr_at_n_tur "" 0xa0808778 gr_at _REC_AXS_20_u1 8. _CNV_A_R_LINEAR_____0_CM 13 0. 8. FORMAT "%1.0" /end AXIS_PTS
/begin AXIS_PTS ldp_n_32__tq_conv "" 0xa08089c0 n_32 _REC_AXS_20_u1 8160. _CNV_A_R_LINEAR_____10_CM 8 0. 8160. FORMAT "%4.0" /end AXIS_PTS
/begin AXIS_PTS ldp_vs_n_tur "" 0xa080930e vs _REC_AXS_20_u1 255. _CNV_A_R_LINEAR_____6_CM 2 0. 255. FORMAT "%3.0" /end AXIS_PTS
/begin AXIS_PTS ldp_tq_conv_can__tq_conv "" 0xa0808f64 tq_conv_can _REC_AXS_20_u2 2047.96875 _CNV_A_R_LINEAR_____87_CM 8 -1024. 1023.96875 FORMAT "%6.2" /end AXIS_PTS
/begin CHARACTERISTIC ip_t_ramp_conv_neg__toil "Ramp after shift disengaging" CURVE 0xa080b490 _REC_CUR_20_u1_u1 2550. _CNV_A_R_LINEAR_____20_CM 0. 2550. DISPLAY_IDENTIFIER IP_T_RAMP_CONV_NEG__TOIL FORMAT "%4.0"
 /begin AXIS_DESCR COM_AXIS toil _CNV_A_R_LINEAR_____26_CM 8 -40. 160. FORMAT "%3.0" AXIS_PTS_REF ldp_toil_t_ramp_conv_neg /end AXIS_DESCR
/end CHARACTERISTIC
/begin CHARACTERISTIC ip_t_ramp_conv_pos__toil "Ramp after shift engaging" CURVE 0xa080b498 _REC_CUR_20_u1_u1 2550. _CNV_A_R_LINEAR_____20_CM 0. 2550. DISPLAY_IDENTIFIER IP_T_RAMP_CONV_POS__TOIL FORMAT "%4.0"
 /begin AXIS_DESCR COM_AXIS toil _CNV_A_R_LINEAR_____26_CM 8 -40. 160. FORMAT "%3.0" AXIS_PTS_REF ldp_toil_t_ramp_conv_pos /end AXIS_DESCR
/end CHARACTERISTIC
/begin AXIS_PTS ldp_toil_t_ramp_conv_pos "" 0xa0808f3c toil _REC_AXS_20_u1 200. _CNV_A_R_LINEAR_____26_CM 8 -40. 160. FORMAT "%3.0" /end AXIS_PTS
/begin AXIS_PTS ldp_toil_t_ramp_conv_neg "" 0xa0808f30 toil _REC_AXS_20_u1 200. _CNV_A_R_LINEAR_____26_CM 8 -40. 160. FORMAT "%3.0" /end AXIS_PTS
/begin AXIS_PTS ldpm_toil_tq_add_conv "" 0xa0809880 toil _REC_AXS_20_u1 200. _CNV_A_R_LINEAR_____26_CM 6 -40. 160. FORMAT "%3.0" /end AXIS_PTS
/begin AXIS_PTS ldpm_vs_tq_add_conv "" 0xa0809910 vs _REC_AXS_20_u1 255. _CNV_A_R_LINEAR_____6_CM 6 0. 255. FORMAT "%3.0" /end AXIS_PTS
/begin AXIS_PTS ldp_n_grd_tq_add_conv "" 0xa0808b28 n_grd _REC_AXS_20_u1 8160. _CNV_A_R_LINEAR_____29_CM 6 -4096. 4064. FORMAT "%5.0" /end AXIS_PTS
/begin AXIS_PTS ldp_ac_cru_tq_add_conv "" 0xa08084e0 ac_cru _REC_AXS_20_u2 31.43952 _CNV_A_R_LINEAR_____258_CM 6 -15.72 15.71952 FORMAT "%8.4" /end AXIS_PTS
/begin CHARACTERISTIC ip_tq_add_conv_ac "Torque reserve for switch GS by AC_CRU" MAP 0xa0816114 _REC_MAP_20_u2_u2_u1 2047.96875 _CNV_A_R_LINEAR_____87_CM -1024. 1023.96875 DISPLAY_IDENTIFIER IP_TQ_ADD_CONV_AC FORMAT "%6.2"
 /begin AXIS_DESCR COM_AXIS ac_cru _CNV_A_R_LINEAR_____258_CM 6 -15.72 15.71952 FORMAT "%8.4" AXIS_PTS_REF ldp_ac_cru_tq_add_conv /end AXIS_DESCR
 /begin AXIS_DESCR COM_AXIS vs _CNV_A_R_LINEAR_____6_CM 6 0. 255. FORMAT "%3.0" AXIS_PTS_REF ldpm_vs_tq_add_conv /end AXIS_DESCR
/end CHARACTERISTIC
/begin CHARACTERISTIC ip_tq_add_conv_n_grd "Torque reserve for switch GS by N_GRD" MAP 0xa081615c _REC_MAP_20_u2_u1_u1 2047.96875 _CNV_A_R_LINEAR_____87_CM -1024. 1023.96875 DISPLAY_IDENTIFIER IP_TQ_ADD_CONV_N_GRD FORMAT "%6.2"
 /begin AXIS_DESCR COM_AXIS n_grd _CNV_A_R_LINEAR_____29_CM 6 -4096. 4064. FORMAT "%5.0" AXIS_PTS_REF ldp_n_grd_tq_add_conv /end AXIS_DESCR
 /begin AXIS_DESCR COM_AXIS vs _CNV_A_R_LINEAR_____6_CM 6 0. 255. FORMAT "%3.0" AXIS_PTS_REF ldpm_vs_tq_add_conv /end AXIS_DESCR
/end CHARACTERISTIC
/begin CHARACTERISTIC ip_fac_tq_add_conv_toil "Torque reserve for switch GS" CURVE 0xa080a81c _REC_CUR_20_u2_u1 1. _CNV_A_R_LINEAR_____229_CM 0. 1. DISPLAY_IDENTIFIER IP_FAC_TQ_ADD_CONV_TOIL FORMAT "%6.4"
 /begin AXIS_DESCR COM_AXIS toil _CNV_A_R_LINEAR_____26_CM 6 -40. 160. FORMAT "%3.0" AXIS_PTS_REF ldpm_toil_tq_add_conv /end AXIS_DESCR
/end CHARACTERISTIC
/begin MEASUREMENT tq_add_conv_2 "Torque reserve for switching converter Torque" SWORD _CNV_A_R_LINEAR_____31_CM 1 100. -1024. 1023.96875 DISPLAY_IDENTIFIER TQ_ADD_CONV_2 ECU_ADDRESS 0xd000aafc FORMAT "%6.2" /end MEASUREMENT
/begin MEASUREMENT lv_dcc_disable_can "logical variable for disabling DCC intervention due to CAN error" UBYTE _CNV_S_2_RANGE__0___1_CM 1 100. 0. 1. DISPLAY_IDENTIFIER LV_DCC_DISABLE_CAN ECU_ADDRESS 0xd0008ead BIT_MASK 0x1 /end MEASUREMENT
/begin MEASUREMENT tqi_dcc_fast_inc_req "torque increase for fast torque intervention during DCC" SWORD _CNV_A_R_LINEAR_____31_CM 1 100. -1024. 1023.96875 DISPLAY_IDENTIFIER TQI_DCC_FAST_INC_REQ ECU_ADDRESS 0xd000176c FORMAT "%8.2" /end MEASUREMENT
/begin MEASUREMENT tqi_dcc_slow_inc_req "torque increase for slow torque intervention during DCC" SWORD _CNV_A_R_LINEAR_____31_CM 1 100. -1024. 1023.96875 DISPLAY_IDENTIFIER TQI_DCC_SLOW_INC_REQ ECU_ADDRESS 0xd000176e FORMAT "%8.2" /end MEASUREMENT
/begin MEASUREMENT tqi_dcc_fast_inc "torque increase for fast torque intervention during DCC" SWORD _CNV_A_R_LINEAR_____31_CM 1 100. -1024. 1023.96875 DISPLAY_IDENTIFIER TQI_DCC_FAST_INC ECU_ADDRESS 0xd000ab20 FORMAT "%8.2" /end MEASUREMENT
/begin MEASUREMENT lv_dcc_ena_inc "logical variable for increased torque intervention due to DCC" UBYTE _CNV_S_2_RANGE__0___1_CM 1 100. 0. 1. DISPLAY_IDENTIFIER LV_DCC_ENA_INC ECU_ADDRESS 0xd0008eae BIT_MASK 0x1 /end MEASUREMENT
/begin MEASUREMENT lv_dcc_inc_act "logical variable for torque intervention due to DCC or LDM" UBYTE _CNV_S_2_RANGE__0___1_CM 1 100. 0. 1. DISPLAY_IDENTIFIER LV_DCC_INC_ACT ECU_ADDRESS 0xd0008eaf BIT_MASK 0x1 /end MEASUREMENT
/begin CHARACTERISTIC c_lgrd_lih_dcc_inc "limiting gradient for DCC emergency ramp function (default  0.6 Nm/10ms)" VALUE 0xa080be0c _REC_VAL_20_u2 1023.96875 _CNV_A_R_LINEAR_____187_CM 0. 1023.96875 DISPLAY_IDENTIFIER C_LGRD_LIH_DCC_INC FORMAT "%7.2" /end CHARACTERISTIC
/begin MEASUREMENT tqi_dcc_slow_inc "torque increase for slow torque intervention during DCC" SWORD _CNV_A_R_LINEAR_____31_CM 1 100. -1024. 1023.96875 DISPLAY_IDENTIFIER TQI_DCC_SLOW_INC ECU_ADDRESS 0xd000ab22 FORMAT "%8.2" /end MEASUREMENT
/begin MEASUREMENT lv_dcc_inc_lih "logical variable for torque intervention LIH due to DCC" UBYTE _CNV_S_2_RANGE__0___1_CM 1 100. 0. 1. DISPLAY_IDENTIFIER LV_DCC_INC_LIH ECU_ADDRESS 0xd0008eb0 BIT_MASK 0x1 /end MEASUREMENT
/begin MEASUREMENT t_dcc_lih_ctr "time counter delay time" UBYTE _CNV_A_R_LINEAR_____3_CM 1 100. 0. 2.55 DISPLAY_IDENTIFIER T_DCC_LIH_CTR ECU_ADDRESS 0xd0001774 FORMAT "%4.2" /end MEASUREMENT
/begin MEASUREMENT lv_err_bn_tq_dcc "Present error BN2000" UBYTE _CNV_S_2_RANGE__0___1_CM 1 100. 0. 1. DISPLAY_IDENTIFIER LV_ERR_BN_TQ_DCC ECU_ADDRESS 0xd0007f95 BIT_MASK 0x1 /end MEASUREMENT
/begin MEASUREMENT state_tq_dcc_plaus "Bitwise coded State for DCC intervention state" UBYTE _CNV_A_R_LINEAR_____0_CM 1 100. 0. 255. DISPLAY_IDENTIFIER STATE_TQ_DCC_PLAUS ECU_ADDRESS 0xd0008eac FORMAT "%3.0" /end MEASUREMENT
/begin CHARACTERISTIC c_t_dly_lih_dcc_inc "delay time for activation of DCC emergency ramp function (default 0s)" VALUE 0xa080c17b _REC_VAL_20_u1 2.55 _CNV_A_R_LINEAR_____3_CM 0. 2.55 DISPLAY_IDENTIFIER C_T_DLY_LIH_DCC_INC FORMAT "%4.2" /end CHARACTERISTIC
/begin MEASUREMENT eff_scc_av "Actual efficiency fuel cut-off" UWORD _CNV_A_R_LINEAR_____9_CM 1 100. 0. 1.99996948242188 DISPLAY_IDENTIFIER EFF_SCC_AV ECU_ADDRESS 0xd000ab06 FORMAT "%7.5" /end MEASUREMENT
/begin MEASUREMENT eff_scc_av_can "Actual efficiency fuel cut-off for CAN" UWORD _CNV_A_R_LINEAR_____9_CM 1 100. 0. 1.99996948242188 DISPLAY_IDENTIFIER EFF_SCC_AV_CAN ECU_ADDRESS 0xd000ab08 FORMAT "%7.5" /end MEASUREMENT
/begin MEASUREMENT eff_scc_sp_hys "Setpoint efficiency fuel cut-off pattern with hysteresis" UWORD _CNV_A_R_LINEAR_____9_CM 1 100. 0. 1.99996948242188 DISPLAY_IDENTIFIER EFF_SCC_SP_HYS ECU_ADDRESS 0xd000178a FORMAT "%7.5" /end MEASUREMENT
/begin MEASUREMENT eff_scc_bas "Basic efficiency fuel  cut-off" UWORD _CNV_A_R_LINEAR_____9_CM 1 100. 0. 1.99996948242188 DISPLAY_IDENTIFIER EFF_SCC_BAS ECU_ADDRESS 0xd000ab04 FORMAT "%7.5" /end MEASUREMENT
/begin MEASUREMENT fac_iga_min_teg_iga_bas "scaling factor for efficiency calculation with EFF_IGA_MIN_TEG and EFF_IGA_BAS_COR" UWORD _CNV_A_R_LINEAR_____9_CM 1 100. 0. 1.99996948242188 DISPLAY_IDENTIFIER FAC_IGA_MIN_TEG_IGA_BAS ECU_ADDRESS 0xd000178c FORMAT "%7.5" /end MEASUREMENT
/begin MEASUREMENT lv_auth_tq_pat "Logical variable for authorizing fuel cut-off pattern" UBYTE _CNV_S_2_RANGE__0___1_CM 1 100. 0. 1. DISPLAY_IDENTIFIER LV_AUTH_TQ_PAT ECU_ADDRESS 0xd0001799 BIT_MASK 0x1 /end MEASUREMENT
/begin MEASUREMENT nr_pat_scc "Selected index of fuel cut-off pattern" UBYTE _CNV_A_R_LINEAR_____0_CM 1 100. 0. 255. DISPLAY_IDENTIFIER NR_PAT_SCC ECU_ADDRESS 0xd0008e9c FORMAT "%3.0" /end MEASUREMENT
/begin CHARACTERISTIC lc_eff_scc_sp_man "flag for setting EFF_SCC_SP by application system" VALUE 0xa080c551 _REC_VAL_20_u1 1. _CNV_A_R_LINEAR_____0_CM 0. 1. DISPLAY_IDENTIFIER LC_EFF_SCC_SP_MAN FORMAT "%2.0" /end CHARACTERISTIC
/begin CHARACTERISTIC lc_eff_scc_bas_swi_clc "logical variable for deactivation of basic efficiency fuel cut_off calculation through missfire pattern" VALUE 0xa080c550 _REC_VAL_20_u1 1. _CNV_A_R_LINEAR_____0_CM 0. 1. DISPLAY_IDENTIFIER LC_EFF_SCC_BAS_SWI_CLC FORMAT "%2.0" /end CHARACTERISTIC
/begin CHARACTERISTIC lc_inh_fcut_fast "inhibition flag for fuel cut-off due fast fuel cut-off" VALUE 0xa080c585 _REC_VAL_20_u1 1. _CNV_A_R_LINEAR_____0_CM 0. 1. DISPLAY_IDENTIFIER LC_INH_FCUT_FAST FORMAT "%2.0" /end CHARACTERISTIC
/begin CHARACTERISTIC lc_ena_eff_scc_bas_man "logical variable for manually adjusting basic efficiency fuel cut-off" VALUE 0xa080c55b _REC_VAL_20_u1 1. _CNV_A_R_LINEAR_____0_CM 0. 1. DISPLAY_IDENTIFIER LC_ENA_EFF_SCC_BAS_MAN FORMAT "%2.0" /end CHARACTERISTIC
/begin CHARACTERISTIC c_eff_scc_sp_hys "Hysteresis applied on EFF_SCC_SP for NR_PAT_SCC calculation" VALUE 0xa080bc5e _REC_VAL_20_u2 1.99996948242188 _CNV_A_R_LINEAR_____9_CM 0. 1.99996948242188 DISPLAY_IDENTIFIER C_EFF_SCC_SP_HYS FORMAT "%7.5" /end CHARACTERISTIC
/begin CHARACTERISTIC c_eff_scc_bas_man "manually adjusted basic efficiency fuel cut-off" VALUE 0xa080bc5c _REC_VAL_20_u2 1.99996948242188 _CNV_A_R_LINEAR_____9_CM 0. 1.99996948242188 DISPLAY_IDENTIFIER C_EFF_SCC_BAS_MAN FORMAT "%7.5" /end CHARACTERISTIC
/begin CHARACTERISTIC lc_ena_fcut_tot_gs "logical variable for setting scaling factor due to gear shift intervention" VALUE 0xa080c562 _REC_VAL_20_u1 1. _CNV_A_R_LINEAR_____0_CM 0. 1. DISPLAY_IDENTIFIER LC_ENA_FCUT_TOT_GS FORMAT "%2.0" /end CHARACTERISTIC
/begin CHARACTERISTIC lc_inh_fcut_gs_iga "inhibition flag for fuel cut-off due to gear shift intervention with spark retarding" VALUE 0xa080c587 _REC_VAL_20_u1 1. _CNV_A_R_LINEAR_____0_CM 0. 1. DISPLAY_IDENTIFIER LC_INH_FCUT_GS_IGA FORMAT "%2.0" /end CHARACTERISTIC
/begin CHARACTERISTIC lc_inh_fcut_asr "inhibition flag for fuel cut-off due to ASR" VALUE 0xa080c583 _REC_VAL_20_u1 1. _CNV_A_R_LINEAR_____0_CM 0. 1. DISPLAY_IDENTIFIER LC_INH_FCUT_ASR FORMAT "%2.0" /end CHARACTERISTIC
/begin CHARACTERISTIC lc_ena_fcut_tot_asr "logical variable for setting scaling factor due to ASR" VALUE 0xa080c55f _REC_VAL_20_u1 1. _CNV_A_R_LINEAR_____0_CM 0. 1. DISPLAY_IDENTIFIER LC_ENA_FCUT_TOT_ASR FORMAT "%2.0" /end CHARACTERISTIC
/begin CHARACTERISTIC lc_inh_fcut_n_max "inhibition flag for fuel cut-off due to speed limitation" VALUE 0xa080c589 _REC_VAL_20_u1 1. _CNV_A_R_LINEAR_____0_CM 0. 1. DISPLAY_IDENTIFIER LC_INH_FCUT_N_MAX FORMAT "%2.0" /end CHARACTERISTIC
/begin CHARACTERISTIC lc_tq_scc_inh_man "inhibition flag for fuel cut-off due to torque management" VALUE 0xa080c60f _REC_VAL_20_u1 1. _CNV_A_R_LINEAR_____0_CM 0. 1. DISPLAY_IDENTIFIER LC_TQ_SCC_INH_MAN FORMAT "%2.0" /end CHARACTERISTIC
/begin CHARACTERISTIC lc_ena_fcut_tot_fast "logical variable for setting scaling factor due to fast fuel cut-off" VALUE 0xa080c561 _REC_VAL_20_u1 1. _CNV_A_R_LINEAR_____0_CM 0. 1. DISPLAY_IDENTIFIER LC_ENA_FCUT_TOT_FAST FORMAT "%2.0" /end CHARACTERISTIC
/begin CHARACTERISTIC lc_tq_scc_ena_man "flag for enabling SCC by application system" VALUE 0xa080c60e _REC_VAL_20_u1 1. _CNV_A_R_LINEAR_____0_CM 0. 1. DISPLAY_IDENTIFIER LC_TQ_SCC_ENA_MAN FORMAT "%2.0" /end CHARACTERISTIC
/begin CHARACTERISTIC c_eff_scc_sp_man "setpoint for efficiency of fuel cut-off set by application intervention" VALUE 0xa080bc60 _REC_VAL_20_u2 1.99996948242188 _CNV_A_R_LINEAR_____9_CM 0. 1.99996948242188 DISPLAY_IDENTIFIER C_EFF_SCC_SP_MAN FORMAT "%7.5" /end CHARACTERISTIC
/begin CHARACTERISTIC c_fac_iga_min_teg_iga_bas "manually adjusted scaling factor for efficiency calculation with EFF_IGA_MIN_TEG and EFF_IGA_BAS_COR" VALUE 0xa080bccc _REC_VAL_20_u2 1. _CNV_A_R_LINEAR_____259_CM 0. 1. DISPLAY_IDENTIFIER C_FAC_IGA_MIN_TEG_IGA_BAS FORMAT "%6.4" /end CHARACTERISTIC
/begin CHARACTERISTIC c_hys_eff_iga_min_teg "hysteresis in falling direction for IGA_MIN_TEG correction" VALUE 0xa080bdaa _REC_VAL_20_u2 1.99996948242188 _CNV_A_R_LINEAR_____9_CM 0. 1.99996948242188 DISPLAY_IDENTIFIER C_HYS_EFF_IGA_MIN_TEG FORMAT "%7.5" /end CHARACTERISTIC
/begin CHARACTERISTIC c_min_dec_eff_iga_min_teg_1 "minimum decrement for first decrease phase " VALUE 0xa080bec2 _REC_VAL_20_u2 1.99996948242188 _CNV_A_R_LINEAR_____9_CM 0. 1.99996948242188 DISPLAY_IDENTIFIER C_MIN_DEC_EFF_IGA_MIN_TEG_1 FORMAT "%7.5" /end CHARACTERISTIC
/begin CHARACTERISTIC c_min_dec_eff_iga_min_teg_2 "minimum decrement for second decrease phase " VALUE 0xa080bec4 _REC_VAL_20_u2 1.99996948242188 _CNV_A_R_LINEAR_____9_CM 0. 1.99996948242188 DISPLAY_IDENTIFIER C_MIN_DEC_EFF_IGA_MIN_TEG_2 FORMAT "%7.5" /end CHARACTERISTIC
/begin CHARACTERISTIC id_nr_pat_scc "SCC pattern depending on SCC efficiency" CURVE 0xa0809d84 _REC_CUR_20_u1_u2 255. _CNV_A_R_LINEAR_____0_CM 0. 255. DISPLAY_IDENTIFIER ID_NR_PAT_SCC FORMAT "%3.0"
 /begin AXIS_DESCR COM_AXIS eff_scc_sp _CNV_A_R_LINEAR_____9_CM 13 0. 1.99996948242188 FORMAT "%7.5" AXIS_PTS_REF ldp_eff_scc_sp__nr_pat_scc /end AXIS_DESCR
/end CHARACTERISTIC
/begin CHARACTERISTIC lc_inh_fcut_gs "inhibition flag for fuel cut-off due to gear shift intervention" VALUE 0xa080c586 _REC_VAL_20_u1 1. _CNV_A_R_LINEAR_____0_CM 0. 1. DISPLAY_IDENTIFIER LC_INH_FCUT_GS FORMAT "%2.0" /end CHARACTERISTIC
/begin CHARACTERISTIC lc_inh_fcut_amt "inhibition flag for fuel cut-off due to AMT intervention" VALUE 0xa080c582 _REC_VAL_20_u1 1. _CNV_A_R_LINEAR_____0_CM 0. 1. DISPLAY_IDENTIFIER LC_INH_FCUT_AMT FORMAT "%2.0" /end CHARACTERISTIC
/begin CHARACTERISTIC lc_inh_fcut_dcc "inhibition flag for fuel cut-off due to DCC intervention" VALUE 0xa080c584 _REC_VAL_20_u1 1. _CNV_A_R_LINEAR_____0_CM 0. 1. DISPLAY_IDENTIFIER LC_INH_FCUT_DCC FORMAT "%2.0" /end CHARACTERISTIC
/begin CHARACTERISTIC lc_ena_fcut_tot_n_max "logical variable for setting scaling factor due to engine speed limitation" VALUE 0xa080c564 _REC_VAL_20_u1 1. _CNV_A_R_LINEAR_____0_CM 0. 1. DISPLAY_IDENTIFIER LC_ENA_FCUT_TOT_N_MAX FORMAT "%2.0" /end CHARACTERISTIC
/begin CHARACTERISTIC lc_ena_fcut_tot_amt "logical variable for setting scaling factor due AMT" VALUE 0xa080c55e _REC_VAL_20_u1 1. _CNV_A_R_LINEAR_____0_CM 0. 1. DISPLAY_IDENTIFIER LC_ENA_FCUT_TOT_AMT FORMAT "%2.0" /end CHARACTERISTIC
/begin CHARACTERISTIC lc_ena_fcut_tot_dcc "logical variable for setting scaling factor due to DCC" VALUE 0xa080c560 _REC_VAL_20_u1 1. _CNV_A_R_LINEAR_____0_CM 0. 1. DISPLAY_IDENTIFIER LC_ENA_FCUT_TOT_DCC FORMAT "%2.0" /end CHARACTERISTIC
/begin AXIS_PTS ldp_eff_scc_sp__nr_pat_scc "" 0xa08085ac eff_scc_sp _REC_AXS_20_u2 1.99996948242188 _CNV_A_R_LINEAR_____9_CM 13 0. 1.99996948242188 FORMAT "%7.5" /end AXIS_PTS
/begin CHARACTERISTIC lc_inh_fcut_ldm "inhibition flag for fuel cut-off due to LDM intervention" VALUE 0xa080c588 _REC_VAL_20_u1 1. _CNV_A_R_LINEAR_____0_CM 0. 1. DISPLAY_IDENTIFIER LC_INH_FCUT_LDM FORMAT "%2.0" /end CHARACTERISTIC
/begin CHARACTERISTIC lc_ena_fcut_tot_ldm "logical variable for setting scaling factor due to LDM" VALUE 0xa080c563 _REC_VAL_20_u1 1. _CNV_A_R_LINEAR_____0_CM 0. 1. DISPLAY_IDENTIFIER LC_ENA_FCUT_TOT_LDM FORMAT "%2.0" /end CHARACTERISTIC
/begin MEASUREMENT eff_scc_sp "Setpoint efficiency fuel cut-off pattern" UWORD _CNV_A_R_LINEAR_____9_CM 1 100. 0. 1.99996948242188 DISPLAY_IDENTIFIER EFF_SCC_SP ECU_ADDRESS 0xd000ab0a FORMAT "%7.5" /end MEASUREMENT
/begin MEASUREMENT sum_inh_iv_tot "Sum of cylinders which are shut off either by means of static or dynamic fuel cut-off pattern" UBYTE _CNV_A_R_LINEAR_____0_CM 1 100. 0. 8. DISPLAY_IDENTIFIER SUM_INH_IV_TOT ECU_ADDRESS 0xd0001798 FORMAT "%1.0" /end MEASUREMENT
/begin MEASUREMENT sum_inh_iv_bas "Sum of cylinders which are shut off due to malfunctions" UBYTE _CNV_A_R_LINEAR_____0_CM 1 100. 0. 8. DISPLAY_IDENTIFIER SUM_INH_IV_BAS ECU_ADDRESS 0xd0008e9d FORMAT "%1.0" /end MEASUREMENT
/begin MEASUREMENT inh_iv_tot "Overall shut off pattern (static and dynamic)" UWORD _CNV_A_R_LINEAR_____0_CM 1 100. 0. 65535. DISPLAY_IDENTIFIER INH_IV_TOT ECU_ADDRESS 0xd0001790 FORMAT "%5.0" /end MEASUREMENT
/begin MEASUREMENT t_max_fcut_fast "time counter for clutch switch observation fast fuel cut off" UBYTE _CNV_A_R_LINEAR_____3_CM 1 100. 0. 2.55 DISPLAY_IDENTIFIER T_MAX_FCUT_FAST ECU_ADDRESS 0xd000179c FORMAT "%4.2" /end MEASUREMENT
/begin CHARACTERISTIC c_maf_dif_min_fcut_fast "min. load decrease fast fuel cut-off" VALUE 0xa080be22 _REC_VAL_20_u2 1389. _CNV_A_R_LINEAR_____111_CM 0. 1389. DISPLAY_IDENTIFIER C_MAF_DIF_MIN_FCUT_FAST FORMAT "%7.2" /end CHARACTERISTIC
/begin CHARACTERISTIC c_tco_min_fcut_fast "min. coolant temperature fast fuel cut-off" VALUE 0xa080c2d4 _REC_VAL_20_u1 190.5 _CNV_A_R_LINEAR_____17_CM -48. 142.5 DISPLAY_IDENTIFIER C_TCO_MIN_FCUT_FAST FORMAT "%5.1" /end CHARACTERISTIC
/begin MEASUREMENT lv_cs_chg "Logical variable" UBYTE _CNV_S_2_RANGE__0___1_CM 1 100. 0. 1. DISPLAY_IDENTIFIER LV_CS_CHG ECU_ADDRESS 0xd00017a1 BIT_MASK 0x1 /end MEASUREMENT
/begin MEASUREMENT lv_fcut_fast "Logical variable for authorizing fuel cut off pattern" UBYTE _CNV_S_2_RANGE__0___1_CM 1 100. 0. 1. DISPLAY_IDENTIFIER LV_FCUT_FAST ECU_ADDRESS 0xd0008ea0 BIT_MASK 0x1 /end MEASUREMENT
/begin MEASUREMENT lv_ct_chg "Logical variable" UBYTE _CNV_S_2_RANGE__0___1_CM 1 100. 0. 1. DISPLAY_IDENTIFIER LV_CT_CHG ECU_ADDRESS 0xd00017a0 BIT_MASK 0x1 /end MEASUREMENT
/begin CHARACTERISTIC c_t_max_fcut_fast "max. time cllutch switch observation fast fuel cut-off" VALUE 0xa080c1ed _REC_VAL_20_u1 2.55 _CNV_A_R_LINEAR_____3_CM 0. 2.55 DISPLAY_IDENTIFIER C_T_MAX_FCUT_FAST FORMAT "%4.2" /end CHARACTERISTIC
/begin CHARACTERISTIC c_vs_min_fcut_fast "min veh. speed  fuel cut-off" VALUE 0xa080c4db _REC_VAL_20_u1 255. _CNV_A_R_LINEAR_____6_CM 0. 255. DISPLAY_IDENTIFIER C_VS_MIN_FCUT_FAST FORMAT "%3.0" /end CHARACTERISTIC
/begin CHARACTERISTIC id_maf_n_min_fcut_fast "engine speed -load threshold for  fast fuel cut-off" MAP 0xa0809bec _REC_MAP_20_u1_u2_u2 1. _CNV_S_2_RANGE______76_CM 0. 1. DISPLAY_IDENTIFIER ID_MAF_N_MIN_FCUT_FAST
 /begin AXIS_DESCR COM_AXIS maf _CNV_A_R_LINEAR_____111_CM 4 0. 1389. FORMAT "%7.2" AXIS_PTS_REF ldp_maf__min_fcut_fast /end AXIS_DESCR
 /begin AXIS_DESCR COM_AXIS n _CNV_A_R_LINEAR_____14_CM 4 0. 8160. FORMAT "%4.0" AXIS_PTS_REF ldp_n__min_fcut_fast /end AXIS_DESCR
/end CHARACTERISTIC
/begin AXIS_PTS ldp_maf__min_fcut_fast "" 0xa0808820 maf _REC_AXS_20_u2 1389. _CNV_A_R_LINEAR_____111_CM 4 0. 1389. FORMAT "%7.2" /end AXIS_PTS
/begin AXIS_PTS ldp_n__min_fcut_fast "" 0xa0808aa0 n _REC_AXS_20_u2 8160. _CNV_A_R_LINEAR_____14_CM 4 0. 8160. FORMAT "%4.0" /end AXIS_PTS
/begin CHARACTERISTIC c_vs_min_fcut_fast_tcha "min veh. speed fuel cut off turbo charger" VALUE 0xa080c4dc _REC_VAL_20_u1 255. _CNV_A_R_LINEAR_____6_CM 0. 255. DISPLAY_IDENTIFIER C_VS_MIN_FCUT_FAST_TCHA FORMAT "%3.0" /end CHARACTERISTIC
/begin MEASUREMENT t_max_fcut_fast_tcha "Time counter for gear shift observation fast fuel cut off turbo charger" UBYTE _CNV_A_R_LINEAR_____3_CM 1 100. 0. 2.55 DISPLAY_IDENTIFIER T_MAX_FCUT_FAST_TCHA ECU_ADDRESS 0xd000179d FORMAT "%4.2" /end MEASUREMENT
/begin CHARACTERISTIC c_t_max_fcut_fast_tcha "max. time gear shift observation fast fuel cut off turbo charger" VALUE 0xa080c1ee _REC_VAL_20_u1 2.55 _CNV_A_R_LINEAR_____3_CM 0. 2.55 DISPLAY_IDENTIFIER C_T_MAX_FCUT_FAST_TCHA FORMAT "%4.2" /end CHARACTERISTIC
/begin MEASUREMENT lv_asr_ena "Logical variable for ASR intervention enabling" UBYTE _CNV_S_2_RANGE__0___1_CM 1 100. 0. 1. DISPLAY_IDENTIFIER LV_ASR_ENA ECU_ADDRESS 0xd00017b8 BIT_MASK 0x1 /end MEASUREMENT
/begin MEASUREMENT lv_msr_ena "Logical variable for MSR intervention enabling" UBYTE _CNV_S_2_RANGE__0___1_CM 1 100. 0. 1. DISPLAY_IDENTIFIER LV_MSR_ENA ECU_ADDRESS 0xd00017b9 BIT_MASK 0x1 /end MEASUREMENT
/begin MEASUREMENT tqi_msr_fast_req "fast torque intervention due to MSR previous limp home check" SWORD _CNV_A_R_LINEAR_____31_CM 1 100. -1024. 1023.96875 DISPLAY_IDENTIFIER TQI_MSR_FAST_REQ ECU_ADDRESS 0xd00017b0 FORMAT "%8.2" /end MEASUREMENT
/begin MEASUREMENT tqi_msr_slow_req "slow torque intervention due to MSR previous limp home check" SWORD _CNV_A_R_LINEAR_____31_CM 1 100. -1024. 1023.96875 DISPLAY_IDENTIFIER TQI_MSR_SLOW_REQ ECU_ADDRESS 0xd00017b2 FORMAT "%8.2" /end MEASUREMENT
/begin MEASUREMENT sf_tqd "Status flag driving toque at clutch" UBYTE _CNV_A_R_LINEAR_____0_CM 1 100. 0. 3. DISPLAY_IDENTIFIER SF_TQD ECU_ADDRESS 0xd0008ea4 FORMAT "%2.0" /end MEASUREMENT
/begin MEASUREMENT lv_tcs_disable "Logical variable for disabling TCS intervention due to EMS error" UBYTE _CNV_S_2_RANGE__0___1_CM 1 100. 0. 1. DISPLAY_IDENTIFIER LV_TCS_DISABLE ECU_ADDRESS 0xd0008ea9 BIT_MASK 0x1 /end MEASUREMENT
/begin MEASUREMENT tqi_asr_slow "torque decrement for slow torque intervention during TCS" SWORD _CNV_A_R_LINEAR_____31_CM 1 100. -1024. 1023.96875 DISPLAY_IDENTIFIER TQI_ASR_SLOW ECU_ADDRESS 0xd000ab1a FORMAT "%8.2" /end MEASUREMENT
/begin CHARACTERISTIC c_lgrd_lih_asr "Limiting gradient for ASR emergency ramp function (default 0.6 Nm/10ms)" VALUE 0xa080be0a _REC_VAL_20_u2 1023.96875 _CNV_A_R_LINEAR_____187_CM 0. 1023.96875 DISPLAY_IDENTIFIER C_LGRD_LIH_ASR FORMAT "%7.2" /end CHARACTERISTIC
/begin CHARACTERISTIC c_t_dly_lih_asr "Delay time for activation of ASR emergency ramp function (default 0 s)" VALUE 0xa080c17a _REC_VAL_20_u1 2.55 _CNV_A_R_LINEAR_____3_CM 0. 2.55 DISPLAY_IDENTIFIER C_T_DLY_LIH_ASR FORMAT "%4.2" /end CHARACTERISTIC
/begin MEASUREMENT tqi_asr_fast_req "fast torque intervention due to ASR" SWORD _CNV_A_R_LINEAR_____31_CM 1 100. -1024. 1023.96875 DISPLAY_IDENTIFIER TQI_ASR_FAST_REQ ECU_ADDRESS 0xd00017ac FORMAT "%8.2" /end MEASUREMENT
/begin MEASUREMENT tqi_asr_fast_req_1 "Torque decrement for fast torque intervention during TCS" SWORD _CNV_A_R_LINEAR_____31_CM 1 100. -1024. 1023.96875 DISPLAY_IDENTIFIER TQI_ASR_FAST_REQ_1 ECU_ADDRESS 0xd000ab10 FORMAT "%8.2" /end MEASUREMENT
/begin MEASUREMENT tqi_asr_slow_req "slow torque intervention due to ASR" SWORD _CNV_A_R_LINEAR_____31_CM 1 100. -1024. 1023.96875 DISPLAY_IDENTIFIER TQI_ASR_SLOW_REQ ECU_ADDRESS 0xd00017ae FORMAT "%8.2" /end MEASUREMENT
/begin MEASUREMENT tqi_msr_fast_req_1 "Torque increase for fast torque intervention during TCS" SWORD _CNV_A_R_LINEAR_____31_CM 1 100. -1024. 1023.96875 DISPLAY_IDENTIFIER TQI_MSR_FAST_REQ_1 ECU_ADDRESS 0xd000ab14 FORMAT "%8.2" /end MEASUREMENT
/begin MEASUREMENT tqi_asr_slow_req_1 "torque decrement for slow torque intervention during TCS" SWORD _CNV_A_R_LINEAR_____31_CM 1 100. -1024. 1023.96875 DISPLAY_IDENTIFIER TQI_ASR_SLOW_REQ_1 ECU_ADDRESS 0xd000ab12 FORMAT "%8.2" /end MEASUREMENT
/begin MEASUREMENT tqi_msr_slow_req_1 "Torque increase for slow torque intervention during gear shift" SWORD _CNV_A_R_LINEAR_____31_CM 1 100. -1024. 1023.96875 DISPLAY_IDENTIFIER TQI_MSR_SLOW_REQ_1 ECU_ADDRESS 0xd000ab16 FORMAT "%8.2" /end MEASUREMENT
/begin MEASUREMENT tqi_asr_fast "torque decrement for fast torque intervention during TCS" SWORD _CNV_A_R_LINEAR_____31_CM 1 100. -1024. 1023.96875 DISPLAY_IDENTIFIER TQI_ASR_FAST ECU_ADDRESS 0xd000ab18 FORMAT "%8.2" /end MEASUREMENT
/begin MEASUREMENT tqi_msr_fast "fast torque intervention due to MSR" SWORD _CNV_A_R_LINEAR_____31_CM 1 100. -1024. 1023.96875 DISPLAY_IDENTIFIER TQI_MSR_FAST ECU_ADDRESS 0xd000ab1c FORMAT "%8.2" /end MEASUREMENT
/begin MEASUREMENT tqi_msr_slow "slow torque intervention due to MSR" SWORD _CNV_A_R_LINEAR_____31_CM 1 100. -1024. 1023.96875 DISPLAY_IDENTIFIER TQI_MSR_SLOW ECU_ADDRESS 0xd000ab1e FORMAT "%8.2" /end MEASUREMENT
/begin MEASUREMENT lv_msr_lih "Logical variable fortorque intervention limp home due toMSR" UBYTE _CNV_S_2_RANGE__0___1_CM 1 100. 0. 1. DISPLAY_IDENTIFIER LV_MSR_LIH ECU_ADDRESS 0xd0008ea8 BIT_MASK 0x1 /end MEASUREMENT
/begin MEASUREMENT lv_msr_act "Logical variable fortorque intervention due to MSR" UBYTE _CNV_S_2_RANGE__0___1_CM 1 100. 0. 1. DISPLAY_IDENTIFIER LV_MSR_ACT ECU_ADDRESS 0xd0008ea7 BIT_MASK 0x1 /end MEASUREMENT
/begin CHARACTERISTIC c_t_dly_lih_msr "Delay time for activation of MSR emergency ramp function (default 0 s)" VALUE 0xa080c17f _REC_VAL_20_u1 2.55 _CNV_A_R_LINEAR_____3_CM 0. 2.55 DISPLAY_IDENTIFIER C_T_DLY_LIH_MSR FORMAT "%4.2" /end CHARACTERISTIC
/begin MEASUREMENT lv_asr_act "Logical variable fortorque intervention due to ASR" UBYTE _CNV_S_2_RANGE__0___1_CM 1 100. 0. 1. DISPLAY_IDENTIFIER LV_ASR_ACT ECU_ADDRESS 0xd0008ea6 BIT_MASK 0x1 /end MEASUREMENT
/begin CHARACTERISTIC lc_msr_disable "logical constant to disable MSR interventions" VALUE 0xa080c5b4 _REC_VAL_20_u1 1. _CNV_S_2_RANGE______76_CM 0. 1. DISPLAY_IDENTIFIER LC_MSR_DISABLE /end CHARACTERISTIC
/begin MEASUREMENT lv_tcs_ena "Logical variable for basically TCS intervention enabling" UBYTE _CNV_S_2_RANGE__0___1_CM 1 100. 0. 1. DISPLAY_IDENTIFIER LV_TCS_ENA ECU_ADDRESS 0xd00017b6 BIT_MASK 0x1 /end MEASUREMENT
/begin MEASUREMENT lv_tcs_disable_can "logical variable for disabling TCS intervention due to EMS CAN error" UBYTE _CNV_S_2_RANGE__0___1_CM 1 100. 0. 1. DISPLAY_IDENTIFIER LV_TCS_DISABLE_CAN ECU_ADDRESS 0xd0008eaa BIT_MASK 0x1 /end MEASUREMENT
/begin MEASUREMENT lv_asr_lih "logical variable for torque intervention LIH due to TCS" UBYTE _CNV_S_2_RANGE__0___1_CM 1 100. 0. 1. DISPLAY_IDENTIFIER LV_ASR_LIH ECU_ADDRESS 0xd00017b7 BIT_MASK 0x1 /end MEASUREMENT
/begin MEASUREMENT t_asr_lih_ctr "Delay time" UBYTE _CNV_A_R_LINEAR_____3_CM 1 100. 0. 2.55 DISPLAY_IDENTIFIER T_ASR_LIH_CTR ECU_ADDRESS 0xd00017b4 FORMAT "%4.2" /end MEASUREMENT
/begin MEASUREMENT t_msr_lih_ctr "Delay time" UBYTE _CNV_A_R_LINEAR_____3_CM 1 100. 0. 2.55 DISPLAY_IDENTIFIER T_MSR_LIH_CTR ECU_ADDRESS 0xd00017b5 FORMAT "%4.2" /end MEASUREMENT
/begin CHARACTERISTIC c_lgrd_lih_msr "Limiting gradient for MSR emergency ramp function (default 0.6 Nm/10ms)" VALUE 0xa080be14 _REC_VAL_20_u2 1023.96875 _CNV_A_R_LINEAR_____187_CM 0. 1023.96875 DISPLAY_IDENTIFIER C_LGRD_LIH_MSR FORMAT "%7.2" /end CHARACTERISTIC
/begin CHARACTERISTIC c_tq_max_msr "limiting torque for MSR" VALUE 0xa080c396 _REC_VAL_20_u2 2047.96875 _CNV_A_R_LINEAR_____87_CM -1024. 1023.96875 DISPLAY_IDENTIFIER C_TQ_MAX_MSR FORMAT "%6.2" /end CHARACTERISTIC
/begin CHARACTERISTIC lc_asr_disable "logical constant to disable ASR interventions" VALUE 0xa080c539 _REC_VAL_20_u1 1. _CNV_S_2_RANGE______76_CM 0. 1. DISPLAY_IDENTIFIER LC_ASR_DISABLE /end CHARACTERISTIC
/begin MEASUREMENT state_tq_tcs_plaus "Bitwise coded State for TCS intervention state" UBYTE _CNV_A_R_LINEAR_____0_CM 1 100. 0. 255. DISPLAY_IDENTIFIER STATE_TQ_TCS_PLAUS ECU_ADDRESS 0xd0008ea5 FORMAT "%3.0" /end MEASUREMENT
/begin MEASUREMENT fac_tq_req_cru "Torque factor request for cruise control" UWORD _CNV_A_R_LINEAR_____9_CM 1 100. 0. 1.99996948242188 DISPLAY_IDENTIFIER FAC_TQ_REQ_CRU ECU_ADDRESS 0xd000ab54 FORMAT "%7.5" /end MEASUREMENT
/begin MEASUREMENT fac_tq_req_dcc "Scaling factor of inverse  DCC model" UWORD _CNV_A_R_LINEAR_____9_CM 1 100. 0. 1.99996948242188 DISPLAY_IDENTIFIER FAC_TQ_REQ_DCC ECU_ADDRESS 0xd000ab56 FORMAT "%7.5" /end MEASUREMENT
/begin MEASUREMENT state_tq_dcc "State of DCC torque intervention" UBYTE _CNV_S_6_STATE_TQ_D_260_CM 1 100. 0. 11. DISPLAY_IDENTIFIER STATE_TQ_DCC ECU_ADDRESS 0xd0008ed0 /end MEASUREMENT
/begin MEASUREMENT lv_tq_dcc_act "Torque structure leaded by DCC intervention" UBYTE _CNV_S_2_RANGE__0___1_CM 1 100. 0. 1. DISPLAY_IDENTIFIER LV_TQ_DCC_ACT ECU_ADDRESS 0xd00017c0 BIT_MASK 0x1 /end MEASUREMENT
/begin MEASUREMENT tq_delta_max_clu "Difference between TQ_MAX_CLU and TQ_MIN_CLU" SWORD _CNV_A_R_LINEAR_____31_CM 1 100. -1024. 1023.96875 DISPLAY_IDENTIFIER TQ_DELTA_MAX_CLU ECU_ADDRESS 0xd00017bc FORMAT "%8.2" /end MEASUREMENT
/begin CHARACTERISTIC c_lgrd_tq_cru_inc_1 "Change limitation for cruise control request out of lower vehicle speed" VALUE 0xa080be16 _REC_VAL_20_u2 1.99996948242188 _CNV_A_R_LINEAR_____9_CM 0. 1.99996948242188 DISPLAY_IDENTIFIER C_LGRD_TQ_CRU_INC_1 FORMAT "%7.5" /end CHARACTERISTIC
/begin CHARACTERISTIC c_lgrd_tq_cru_inc_2 "Change limitation for cruise control request out of higher vehicle speed" VALUE 0xa080be18 _REC_VAL_20_u2 1.99996948242188 _CNV_A_R_LINEAR_____9_CM 0. 1.99996948242188 DISPLAY_IDENTIFIER C_LGRD_TQ_CRU_INC_2 FORMAT "%7.5" /end CHARACTERISTIC
/begin CHARACTERISTIC c_fac_dcc_fl "Full load detection of DCC" VALUE 0xa080bcc8 _REC_VAL_20_u2 1. _CNV_A_R_LINEAR_____259_CM 0. 1. DISPLAY_IDENTIFIER C_FAC_DCC_FL FORMAT "%6.4" /end CHARACTERISTIC
/begin MEASUREMENT state_tq_ldm "State of DCC torque intervention" UBYTE _CNV_S_6_STATE_TQ_D_260_CM 1 100. 0. 11. DISPLAY_IDENTIFIER STATE_TQ_LDM ECU_ADDRESS 0xd0008ed1 /end MEASUREMENT
/begin CHARACTERISTIC c_tq_ad_add_s_swi "Adaptive engine torque Adaptation value for switch between hom and strat" VALUE 0xa080c356 _REC_VAL_20_s2 2047.96875 _CNV_A_R_LINEAR_____31_CM -1024. 1023.96875 DISPLAY_IDENTIFIER C_TQ_AD_ADD_S_SWI FORMAT "%7.1" /end CHARACTERISTIC
/begin CHARACTERISTIC lc_tq_lim_inh "logical constant inhibition torque intervetion for safety in general" VALUE 0xa080c609 _REC_VAL_20_u1 1. _CNV_A_R_LINEAR_____0_CM 0. 1. DISPLAY_IDENTIFIER LC_TQ_LIM_INH FORMAT "%2.0" /end CHARACTERISTIC
/begin CHARACTERISTIC lc_tq_lim_inh_fast "logical constant inhibition torque intervetion for safety for fast path" VALUE 0xa080c60a _REC_VAL_20_u1 1. _CNV_A_R_LINEAR_____0_CM 0. 1. DISPLAY_IDENTIFIER LC_TQ_LIM_INH_FAST FORMAT "%2.0" /end CHARACTERISTIC
/begin CHARACTERISTIC lc_tq_lim_inh_slow "logical constant inhibition torque intervetion for safety for slow path" VALUE 0xa080c60b _REC_VAL_20_u1 1. _CNV_A_R_LINEAR_____0_CM 0. 1. DISPLAY_IDENTIFIER LC_TQ_LIM_INH_SLOW FORMAT "%2.0" /end CHARACTERISTIC
/begin CHARACTERISTIC c_tqi_req_lim_pas "Maximum positive gradient of the requested torque TQI_REQ_LIM" VALUE 0xa080c3ae _REC_VAL_20_u2 1023.96875 _CNV_A_R_LINEAR_____31_CM 0. 1023.96875 DISPLAY_IDENTIFIER C_TQI_REQ_LIM_PAS FORMAT "%7.2" /end CHARACTERISTIC
/begin CHARACTERISTIC c_tq_lim_inc "Maximum positive gradient of the requested torque TQI_REQ_LIM" VALUE 0xa080c37e _REC_VAL_20_u2 1023.96875 _CNV_A_R_LINEAR_____31_CM 0. 1023.96875 DISPLAY_IDENTIFIER C_TQ_LIM_INC FORMAT "%7.2" /end CHARACTERISTIC
/begin CHARACTERISTIC c_tq_lim_dec "Maximum negative gradient of the requested torque TQI_REQ_LIM" VALUE 0xa080c37c _REC_VAL_20_u2 1023.96875 _CNV_A_R_LINEAR_____31_CM 0. 1023.96875 DISPLAY_IDENTIFIER C_TQ_LIM_DEC FORMAT "%7.2" /end CHARACTERISTIC
/begin CHARACTERISTIC c_t_tq_lim_intv "Time after active torque intervention to reset LV_TQ_LIM_INTV" VALUE 0xa080c28e _REC_VAL_20_u2 2621.4 _CNV_A_R_LINEAR_____261_CM 0. 2621.4 DISPLAY_IDENTIFIER C_T_TQ_LIM_INTV FORMAT "%7.2" /end CHARACTERISTIC
/begin CHARACTERISTIC ip_tqi_dif_lim "Torque after torque interventionj to reset LV_TQ_LIM_INTV" MAP 0xa080b860 _REC_MAP_20_u2_u1_u1 2047.96875 _CNV_A_R_LINEAR_____87_CM -1024. 1023.96875 DISPLAY_IDENTIFIER IP_TQI_DIF_LIM FORMAT "%6.2"
 /begin AXIS_DESCR COM_AXIS n_32 _CNV_A_R_LINEAR_____10_CM 4 0. 8160. FORMAT "%4.0" AXIS_PTS_REF ldp_n_32__tqi_dif_lim /end AXIS_DESCR
 /begin AXIS_DESCR COM_AXIS tqi_sp_mon _CNV_A_R_LINEAR_____262_CM 4 0. 510. FORMAT "%3.0" AXIS_PTS_REF ldp_tqi_sp_mon__tqi_dif_lim /end AXIS_DESCR
/end CHARACTERISTIC
/begin AXIS_PTS ldp_n_32__tqi_dif_lim "" 0xa08089d2 n_32 _REC_AXS_20_u1 8160. _CNV_A_R_LINEAR_____10_CM 4 0. 8160. FORMAT "%4.0" /end AXIS_PTS
/begin AXIS_PTS ldp_tqi_sp_mon__tqi_dif_lim "" 0xa0809076 tqi_sp_mon _REC_AXS_20_u1 510. _CNV_A_R_LINEAR_____262_CM 4 0. 510. FORMAT "%3.0" /end AXIS_PTS
/begin MEASUREMENT t_tq_lim_intv "Time counter after transition LV_TQ_INTV_ACT 1-->0 to set LV_TQ_LIM_INTV = 0" UWORD _CNV_A_R_LINEAR_____261_CM 1 100. 0. 2621.4 DISPLAY_IDENTIFIER T_TQ_LIM_INTV ECU_ADDRESS 0xd00017c4 FORMAT "%7.2" /end MEASUREMENT
/begin MEASUREMENT sum_tqi_req_lim "Event counter of active torque limitations" UWORD _CNV_A_R_LINEAR_____0_CM 1 100. 0. 65535. DISPLAY_IDENTIFIER SUM_TQI_REQ_LIM ECU_ADDRESS 0xd000ab74 FORMAT "%5.0" /end MEASUREMENT
/begin MEASUREMENT tqi_req_lim_4 "Intermediate value 4 for requested torque for safety" SWORD _CNV_A_R_LINEAR_____31_CM 1 100. -1024. 1023.96875 DISPLAY_IDENTIFIER TQI_REQ_LIM_4 ECU_ADDRESS 0xd00017ce FORMAT "%6.2" /end MEASUREMENT
/begin MEASUREMENT tqi_req_lim_slow "???" SWORD _CNV_A_R_LINEAR_____31_CM 1 100. -1024. 1023.96875 DISPLAY_IDENTIFIER TQI_REQ_LIM_SLOW ECU_ADDRESS 0xd000ab7e FORMAT "%8.2" /end MEASUREMENT
/begin MEASUREMENT tqi_req_lim_3 "Intermediate value 3 for requested torque for safety" SWORD _CNV_A_R_LINEAR_____31_CM 1 100. -1024. 1023.96875 DISPLAY_IDENTIFIER TQI_REQ_LIM_3 ECU_ADDRESS 0xd00017cc FORMAT "%6.2" /end MEASUREMENT
/begin MEASUREMENT lv_tq_lim_intv "Bit for torque intervention for safety active" UBYTE _CNV_S_2_RANGE__0___1_CM 1 100. 0. 1. DISPLAY_IDENTIFIER LV_TQ_LIM_INTV ECU_ADDRESS 0xd0008ee0 BIT_MASK 0x1 /end MEASUREMENT
/begin MEASUREMENT tqi_req_lim_1 "Intermediate value 1 for requested torque for safety" SWORD _CNV_A_R_LINEAR_____31_CM 1 100. -1024. 1023.96875 DISPLAY_IDENTIFIER TQI_REQ_LIM_1 ECU_ADDRESS 0xd00017c8 FORMAT "%6.2" /end MEASUREMENT
/begin MEASUREMENT tqi_req_lim_2 "Intermediate value 2 for requested torque for safety" SWORD _CNV_A_R_LINEAR_____31_CM 1 100. -1024. 1023.96875 DISPLAY_IDENTIFIER TQI_REQ_LIM_2 ECU_ADDRESS 0xd00017ca FORMAT "%6.2" /end MEASUREMENT
/begin MEASUREMENT tqi_dif_lim "Torque offset for regnition torque intervention active" SWORD _CNV_A_R_LINEAR_____31_CM 1 100. -1024. 1023.96875 DISPLAY_IDENTIFIER TQI_DIF_LIM ECU_ADDRESS 0xd000ab7a FORMAT "%6.2" /end MEASUREMENT
/begin MEASUREMENT t_tqi_req_lim "incremented time counter after transition LV_TQ_LIM_INTV_\" 0 -> 1 to set LV_TQ_LIM_INTV = 0" UWORD _CNV_A_R_LINEAR_____261_CM 1 100. 0. 2621.4 DISPLAY_IDENTIFIER T_TQI_REQ_LIM ECU_ADDRESS 0xd00017c6 FORMAT "%7.2" /end MEASUREMENT
/begin MEASUREMENT t_tqi_req_lim_max "max time counter after transition LV_TQ_LIM_INTV_\" 0 -> 1 to set LV_TQ_LIM_INTV = 0" UWORD _CNV_A_R_LINEAR_____261_CM 1 100. 0. 2621.4 DISPLAY_IDENTIFIER T_TQI_REQ_LIM_MAX ECU_ADDRESS 0xd000ab76 FORMAT "%7.2" /end MEASUREMENT
/begin MEASUREMENT tqi_req_lim_fast "???" SWORD _CNV_A_R_LINEAR_____31_CM 1 100. -1024. 1023.96875 DISPLAY_IDENTIFIER TQI_REQ_LIM_FAST ECU_ADDRESS 0xd000ab7c FORMAT "%8.2" /end MEASUREMENT
/begin MEASUREMENT tqi_req_lim_dif "difference of torque request for safety" SWORD _CNV_A_R_LINEAR_____31_CM 1 100. -1024. 1023.96875 DISPLAY_IDENTIFIER TQI_REQ_LIM_DIF ECU_ADDRESS 0xd00017d0 FORMAT "%8.2" /end MEASUREMENT
/begin MEASUREMENT tqi_req_lim_dif_max "max. difference of torque request for safety" SWORD _CNV_A_R_LINEAR_____31_CM 1 100. -1024. 1023.96875 DISPLAY_IDENTIFIER TQI_REQ_LIM_DIF_MAX ECU_ADDRESS 0xd000ab78 FORMAT "%8.2" /end MEASUREMENT
/begin MEASUREMENT lv_tq_lim_intv_1 "Result for TQI_AV > TQI_SP_MON" UBYTE _CNV_S_2_RANGE__0___1_CM 1 100. 0. 1. DISPLAY_IDENTIFIER LV_TQ_LIM_INTV_1 ECU_ADDRESS 0xd00017d6 BIT_MASK 0x1 /end MEASUREMENT
/begin MEASUREMENT lv_tq_lim_intv_2 "ON-Delayed (40 ms) result for TQI_AV > TQI_SP_MON" UBYTE _CNV_S_2_RANGE__0___1_CM 1 100. 0. 1. DISPLAY_IDENTIFIER LV_TQ_LIM_INTV_2 ECU_ADDRESS 0xd00017d7 BIT_MASK 0x1 /end MEASUREMENT
/begin MEASUREMENT tqi_req_lim_dif_ofs "Permitted deviation offset" UWORD _CNV_A_R_LINEAR_____31_CM 1 100. 0. 255. DISPLAY_IDENTIFIER TQI_REQ_LIM_DIF_OFS ECU_ADDRESS 0xd00017d2 FORMAT "%7.3" /end MEASUREMENT
/begin CHARACTERISTIC c_tqi_dif_lim_max_ofs "Offset after start condition" VALUE 0xa080c3a2 _REC_VAL_20_u2 255. _CNV_A_R_LINEAR_____31_CM 0. 255. DISPLAY_IDENTIFIER C_TQI_DIF_LIM_MAX_OFS FORMAT "%7.3" /end CHARACTERISTIC
/begin CHARACTERISTIC c_dec_tqi_lim_dif_max "Decrement after start condition" VALUE 0xa080bc3a _REC_VAL_20_u2 254. _CNV_A_R_LINEAR_____31_CM 1. 255. DISPLAY_IDENTIFIER C_DEC_TQI_LIM_DIF_MAX FORMAT "%7.3" /end CHARACTERISTIC
/begin CHARACTERISTIC ip_tq_lim_amt "Maximum allowed torque at clutch due to torque limitation depending on gear ratio by AMT" CURVE 0xa080b748 _REC_CUR_20_u2_u2 1023.96875 _CNV_A_R_LINEAR_____31_CM 0. 1023.96875 DISPLAY_IDENTIFIER IP_TQ_LIM_AMT FORMAT "%7.2"
 /begin AXIS_DESCR COM_AXIS vs_fil _CNV_A_R_LINEAR_____86_CM 6 0. 511.99218 FORMAT "%7.3" AXIS_PTS_REF ldpm_vs_fil__tq_p_max /end AXIS_DESCR
/end CHARACTERISTIC
/begin CHARACTERISTIC ip_tq_lim_at "Maximum allowed torque at clutch due to torque limitation depending on gear ratio by AT" CURVE 0xa080b754 _REC_CUR_20_u2_u2 1023.96875 _CNV_A_R_LINEAR_____31_CM 0. 1023.96875 DISPLAY_IDENTIFIER IP_TQ_LIM_AT FORMAT "%7.2"
 /begin AXIS_DESCR COM_AXIS vs_fil _CNV_A_R_LINEAR_____86_CM 6 0. 511.99218 FORMAT "%7.3" AXIS_PTS_REF ldpm_vs_fil__tq_p_max /end AXIS_DESCR
/end CHARACTERISTIC
/begin CHARACTERISTIC c_t_tq_lim "Time delay vehicle speed activation" VALUE 0xa080c28c _REC_VAL_20_u2 20.47 _CNV_A_R_LINEAR_____3_CM 0. 20.47 DISPLAY_IDENTIFIER C_T_TQ_LIM FORMAT "%5.3" /end CHARACTERISTIC
/begin CHARACTERISTIC lc_tqi_p_max_inh_as "Logical constant for torque limitation ON/OFF (0=ON)" VALUE 0xa080c611 _REC_VAL_20_u1 1. _CNV_A_R_LINEAR_____0_CM 0. 1. DISPLAY_IDENTIFIER LC_TQI_P_MAX_INH_AS FORMAT "%1.0" /end CHARACTERISTIC
/begin CHARACTERISTIC id_tq_p_max_mt "Maximum allowed torque at clutch due to torque limitation depending on gear ratio" CURVE 0xa0809f18 _REC_CUR_20_u2_u1 1023.96875 _CNV_A_R_LINEAR_____31_CM 0. 1023.96875 DISPLAY_IDENTIFIER ID_TQ_P_MAX_MT FORMAT "%7.2"
 /begin AXIS_DESCR COM_AXIS gear _CNV_A_R_LINEAR_____50_CM 13 0. 12. FORMAT "%3.0" AXIS_PTS_REF ldpm_gear__tq_p_max /end AXIS_DESCR
/end CHARACTERISTIC
/begin CHARACTERISTIC id_tq_p_max_at "Minimum allowed torque at clutch due to torque limitation depending on gear ratio" CURVE 0xa0809efc _REC_CUR_20_u2_u1 1023.96875 _CNV_A_R_LINEAR_____31_CM 0. 1023.96875 DISPLAY_IDENTIFIER ID_TQ_P_MAX_AT FORMAT "%7.2"
 /begin AXIS_DESCR COM_AXIS gear _CNV_A_R_LINEAR_____50_CM 13 0. 12. FORMAT "%3.0" AXIS_PTS_REF ldpm_gear__tq_p_max /end AXIS_DESCR
/end CHARACTERISTIC
/begin AXIS_PTS ldpm_gear__tq_p_max "" 0xa0809434 gear _REC_AXS_20_u1 12. _CNV_A_R_LINEAR_____50_CM 13 0. 12. FORMAT "%3.0" /end AXIS_PTS
/begin AXIS_PTS ldpm_vs_fil__tq_p_max "" 0xa08098dc vs_fil _REC_AXS_20_u2 511.99218 _CNV_A_R_LINEAR_____86_CM 6 0. 511.99218 FORMAT "%7.3" /end AXIS_PTS
/begin CHARACTERISTIC c_tq_lim_at_lgrd "Limitating gradient at end of AT torque limitation" VALUE 0xa080c37a _REC_VAL_20_u2 1023.96875 _CNV_A_R_LINEAR_____31_CM 0. 1023.96875 DISPLAY_IDENTIFIER C_TQ_LIM_AT_LGRD FORMAT "%7.2" /end CHARACTERISTIC
/begin CHARACTERISTIC c_tqi_pbr_max "maximum allowed TQI_ PBR_MAX" VALUE 0xa080c3ac _REC_VAL_20_u2 1023.96875 _CNV_A_R_LINEAR_____31_CM 0. 1023.96875 DISPLAY_IDENTIFIER C_TQI_PBR_MAX FORMAT "%7.2" /end CHARACTERISTIC
/begin CHARACTERISTIC c_vs_max_tq_lim_pbr "Threshold of vehicle speed limitation for PBR" VALUE 0xa080c4d3 _REC_VAL_20_u1 255. _CNV_A_R_LINEAR_____6_CM 0. 255. DISPLAY_IDENTIFIER C_VS_MAX_TQ_LIM_PBR FORMAT "%3.0" /end CHARACTERISTIC
/begin MEASUREMENT tq_loss_pste "Summary Engine Torque losses power steering" SWORD _CNV_A_R_LINEAR_____31_CM 1 100. -1024. 1023.96875 DISPLAY_IDENTIFIER TQ_LOSS_PSTE ECU_ADDRESS 0xd000aadc FORMAT "%8.2" /end MEASUREMENT
/begin MEASUREMENT lv_pste_disable "LV for disabling PSTE intervention due to EMS error" UBYTE _CNV_S_2_RANGE__0___1_CM 1 100. 0. 1. DISPLAY_IDENTIFIER LV_PSTE_DISABLE ECU_ADDRESS 0xd0008e89 BIT_MASK 0x1 /end MEASUREMENT
/begin MEASUREMENT lv_pste_disable_can "LV for disabling PSTE intervention due to CAN error" UBYTE _CNV_S_2_RANGE__0___1_CM 1 100. 0. 1. DISPLAY_IDENTIFIER LV_PSTE_DISABLE_CAN ECU_ADDRESS 0xd0008e88 BIT_MASK 0x1 /end MEASUREMENT
/begin MEASUREMENT lv_pste_ena "LV for enabling PSTE intervention" UBYTE _CNV_S_2_RANGE__0___1_CM 1 100. 0. 1. DISPLAY_IDENTIFIER LV_PSTE_ENA ECU_ADDRESS 0xd0008e8a BIT_MASK 0x1 /end MEASUREMENT
/begin CHARACTERISTIC lc_pste_ena "Logical constant for enabling of power steering" VALUE 0xa080c5d5 _REC_VAL_20_u1 1. _CNV_A_R_LINEAR_____0_CM 0. 1. DISPLAY_IDENTIFIER LC_PSTE_ENA FORMAT "%1.0" /end CHARACTERISTIC
/begin CHARACTERISTIC ip_tq_add_pste "Power steering torque reserve depending on engine-speed" CURVE 0xa080b708 _REC_CUR_20_u2_u2 1023.96875 _CNV_A_R_LINEAR_____31_CM 0. 1023.96875 DISPLAY_IDENTIFIER IP_TQ_ADD_PSTE FORMAT "%7.2"
 /begin AXIS_DESCR COM_AXIS ang_pste_stnd _CNV_A_R_LINEAR_____263_CM 8 -100. 99.99694824 FORMAT "%8.3" AXIS_PTS_REF ldpm_ang_pste_stnd_tqlo_1 /end AXIS_DESCR
/end CHARACTERISTIC
/begin MEASUREMENT tq_loss_pste_1 "Engine Torque losses power steering" SWORD _CNV_A_R_LINEAR_____31_CM 1 100. -1024. 1023.96875 DISPLAY_IDENTIFIER TQ_LOSS_PSTE_1 ECU_ADDRESS 0xd000aae0 FORMAT "%8.2" /end MEASUREMENT
/begin MEASUREMENT lv_pste_2_disable "LV for disabling PSTE_2 intervention due to EMS error" UBYTE _CNV_S_2_RANGE__0___1_CM 1 100. 0. 1. DISPLAY_IDENTIFIER LV_PSTE_2_DISABLE ECU_ADDRESS 0xd0008e8c BIT_MASK 0x1 /end MEASUREMENT
/begin MEASUREMENT lv_pste_3_disable "LV for disabling PSTE intervention due to EMS error" UBYTE _CNV_S_2_RANGE__0___1_CM 1 100. 0. 1. DISPLAY_IDENTIFIER LV_PSTE_3_DISABLE ECU_ADDRESS 0xd0008e91 BIT_MASK 0x1 /end MEASUREMENT
/begin MEASUREMENT lv_pste_2_disable_can "LV for disabling PSTE_2 intervention due to CAN error" UBYTE _CNV_S_2_RANGE__0___1_CM 1 100. 0. 1. DISPLAY_IDENTIFIER LV_PSTE_2_DISABLE_CAN ECU_ADDRESS 0xd0008e8b BIT_MASK 0x1 /end MEASUREMENT
/begin MEASUREMENT lv_pste_3_disable_can "LV for disabling PSTE 3 intervention due to CAN error" UBYTE _CNV_S_2_RANGE__0___1_CM 1 100. 0. 1. DISPLAY_IDENTIFIER LV_PSTE_3_DISABLE_CAN ECU_ADDRESS 0xd0008e90 BIT_MASK 0x1 /end MEASUREMENT
/begin MEASUREMENT lv_pste_2_ena "LV for enabling PSTE_2 intervention" UBYTE _CNV_S_2_RANGE__0___1_CM 1 100. 0. 1. DISPLAY_IDENTIFIER LV_PSTE_2_ENA ECU_ADDRESS 0xd0008e8d BIT_MASK 0x1 /end MEASUREMENT
/begin MEASUREMENT lv_pste_3_ena "LV for enabling PSTE intervention" UBYTE _CNV_S_2_RANGE__0___1_CM 1 100. 0. 1. DISPLAY_IDENTIFIER LV_PSTE_3_ENA ECU_ADDRESS 0xd0008e92 BIT_MASK 0x1 /end MEASUREMENT
/begin MEASUREMENT tq_loss_pste_2_av "Engine Torque losses active front steering active value" SWORD _CNV_A_R_LINEAR_____31_CM 1 100. -1024. 1023.96875 DISPLAY_IDENTIFIER TQ_LOSS_PSTE_2_AV ECU_ADDRESS 0xd00017e8 FORMAT "%8.2" /end MEASUREMENT
/begin MEASUREMENT tq_loss_pste_2_sp "Engine Torque losses active front steering set point" SWORD _CNV_A_R_LINEAR_____31_CM 1 100. -1024. 1023.96875 DISPLAY_IDENTIFIER TQ_LOSS_PSTE_2_SP ECU_ADDRESS 0xd00017e6 FORMAT "%8.2" /end MEASUREMENT
/begin MEASUREMENT tq_loss_pste_2_dif "Engine Torque losses active front steering difference" SWORD _CNV_A_R_LINEAR_____31_CM 1 100. -1024. 1023.96875 DISPLAY_IDENTIFIER TQ_LOSS_PSTE_2_DIF ECU_ADDRESS 0xd00017ea FORMAT "%8.2" /end MEASUREMENT
/begin MEASUREMENT tq_loss_pste_2_grd "Engine Torque losses active front steering gradient" SWORD _CNV_A_R_LINEAR_____187_CM 1 100. -1024. 1023.96875 DISPLAY_IDENTIFIER TQ_LOSS_PSTE_2_GRD ECU_ADDRESS 0xd00017ec FORMAT "%8.2" /end MEASUREMENT
/begin MEASUREMENT t_pste_2 "SP AV Timer PSTE_2" UBYTE _CNV_A_R_LINEAR_____3_CM 1 100. 0. 2.55 DISPLAY_IDENTIFIER T_PSTE_2 ECU_ADDRESS 0xd0008e84 FORMAT "%4.2" /end MEASUREMENT
/begin MEASUREMENT t_pste_3 "SP AV Timer PSTE_3" UBYTE _CNV_A_R_LINEAR_____3_CM 1 100. 0. 2.55 DISPLAY_IDENTIFIER T_PSTE_3 ECU_ADDRESS 0xd0008e86 FORMAT "%4.2" /end MEASUREMENT
/begin CHARACTERISTIC lc_pste_2_ena "Logical constant for inhibitation of active power steering" VALUE 0xa080c5d2 _REC_VAL_20_u1 1. _CNV_A_R_LINEAR_____0_CM 0. 1. DISPLAY_IDENTIFIER LC_PSTE_2_ENA FORMAT "%1.0" /end CHARACTERISTIC
/begin CHARACTERISTIC lc_pste_3_ena "Logical variable for inhibitation of eletric power steering EHB 3" VALUE 0xa080c5d4 _REC_VAL_20_u1 1. _CNV_A_R_LINEAR_____0_CM 0. 1. DISPLAY_IDENTIFIER LC_PSTE_3_ENA FORMAT "%1.0" /end CHARACTERISTIC
/begin AXIS_PTS ldpm_n_32__pste_2 "" 0xa08095e0 n_32 _REC_AXS_20_u1 8160. _CNV_A_R_LINEAR_____10_CM 8 0. 8160. FORMAT "%4.0" /end AXIS_PTS
/begin AXIS_PTS ldpm_t_pste_2__pste_2 "" 0xa080976c t_pste_2 _REC_AXS_20_u1 2.55 _CNV_A_R_LINEAR_____3_CM 4 0. 2.55 FORMAT "%4.2" /end AXIS_PTS
/begin AXIS_PTS ldpm_t_pste_3__pste_3 "" 0xa0809772 t_pste_3 _REC_AXS_20_u1 2.55 _CNV_A_R_LINEAR_____3_CM 4 0. 2.55 FORMAT "%4.2" /end AXIS_PTS
/begin CHARACTERISTIC ip_fac_tq_loss_pste_2_sp "Active power steering torque loss correction SP" MAP 0xa080aa54 _REC_MAP_20_u1_u1_u1 3.984375 _CNV_A_R_LINEAR_____264_CM -2. 1.984375 DISPLAY_IDENTIFIER IP_FAC_TQ_LOSS_PSTE_2_SP FORMAT "%5.2"
 /begin AXIS_DESCR COM_AXIS n_32 _CNV_A_R_LINEAR_____10_CM 4 0. 8160. FORMAT "%4.0" AXIS_PTS_REF ldpm_n_32__pste_2_1 /end AXIS_DESCR
 /begin AXIS_DESCR COM_AXIS t_pste_2 _CNV_A_R_LINEAR_____3_CM 4 0. 2.55 FORMAT "%4.2" AXIS_PTS_REF ldpm_t_pste_2__pste_2 /end AXIS_DESCR
/end CHARACTERISTIC
/begin CHARACTERISTIC ip_fac_tq_loss_pste_3_sp "Electric power steering torque loss correction SP" MAP 0xa080abc4 _REC_MAP_20_u1_u1_u1 3.984375 _CNV_A_R_LINEAR_____264_CM -2. 1.984375 DISPLAY_IDENTIFIER IP_FAC_TQ_LOSS_PSTE_3_SP FORMAT "%5.2"
 /begin AXIS_DESCR COM_AXIS n_32 _CNV_A_R_LINEAR_____10_CM 4 0. 8160. FORMAT "%4.0" AXIS_PTS_REF ldpm_n_32__pste_3_1 /end AXIS_DESCR
 /begin AXIS_DESCR COM_AXIS t_pste_3 _CNV_A_R_LINEAR_____3_CM 4 0. 2.55 FORMAT "%4.2" AXIS_PTS_REF ldpm_t_pste_3__pste_3 /end AXIS_DESCR
/end CHARACTERISTIC
/begin CHARACTERISTIC ip_fac_tq_loss_pste_2_av "Active power steering torque loss correction AV" MAP 0xa080aa44 _REC_MAP_20_u1_u1_u1 3.984375 _CNV_A_R_LINEAR_____264_CM -2. 1.984375 DISPLAY_IDENTIFIER IP_FAC_TQ_LOSS_PSTE_2_AV FORMAT "%5.2"
 /begin AXIS_DESCR COM_AXIS n_32 _CNV_A_R_LINEAR_____10_CM 4 0. 8160. FORMAT "%4.0" AXIS_PTS_REF ldpm_n_32__pste_2_1 /end AXIS_DESCR
 /begin AXIS_DESCR COM_AXIS t_pste_2 _CNV_A_R_LINEAR_____3_CM 4 0. 2.55 FORMAT "%4.2" AXIS_PTS_REF ldpm_t_pste_2__pste_2 /end AXIS_DESCR
/end CHARACTERISTIC
/begin CHARACTERISTIC ip_fac_tq_loss_pste_3_av "Electric power steering torque loss correction AV" MAP 0xa080aa94 _REC_MAP_20_u1_u1_u1 3.984375 _CNV_A_R_LINEAR_____264_CM -2. 1.984375 DISPLAY_IDENTIFIER IP_FAC_TQ_LOSS_PSTE_3_AV FORMAT "%5.2"
 /begin AXIS_DESCR COM_AXIS n_32 _CNV_A_R_LINEAR_____10_CM 4 0. 8160. FORMAT "%4.0" AXIS_PTS_REF ldpm_n_32__pste_3_1 /end AXIS_DESCR
 /begin AXIS_DESCR COM_AXIS t_pste_3 _CNV_A_R_LINEAR_____3_CM 4 0. 2.55 FORMAT "%4.2" AXIS_PTS_REF ldpm_t_pste_3__pste_3 /end AXIS_DESCR
/end CHARACTERISTIC
/begin CHARACTERISTIC c_fac_tq_loss_pste_2_grd "Correction value gradient" VALUE 0xa080bd11 _REC_VAL_20_u1 0.159375 _CNV_A_R_LINEAR_____264_CM -2. 1.984375 DISPLAY_IDENTIFIER C_FAC_TQ_LOSS_PSTE_2_GRD FORMAT "%5.2" /end CHARACTERISTIC
/begin CHARACTERISTIC c_fac_tq_loss_pste_3_grd "Correction value gradient" VALUE 0xa080bd13 _REC_VAL_20_u1 0.159375 _CNV_A_R_LINEAR_____264_CM -2. 1.984375 DISPLAY_IDENTIFIER C_FAC_TQ_LOSS_PSTE_3_GRD FORMAT "%5.2" /end CHARACTERISTIC
/begin CHARACTERISTIC c_fac_tq_loss_pste_2_dif "Correction value differences" VALUE 0xa080bd10 _REC_VAL_20_u1 0.159375 _CNV_A_R_LINEAR_____264_CM -2. 1.984375 DISPLAY_IDENTIFIER C_FAC_TQ_LOSS_PSTE_2_DIF FORMAT "%5.2" /end CHARACTERISTIC
/begin CHARACTERISTIC c_fac_tq_loss_pste_3_dif "Correction value differences" VALUE 0xa080bd12 _REC_VAL_20_u1 0.159375 _CNV_A_R_LINEAR_____264_CM -2. 1.984375 DISPLAY_IDENTIFIER C_FAC_TQ_LOSS_PSTE_3_DIF FORMAT "%5.2" /end CHARACTERISTIC
/begin MEASUREMENT tq_add_pste "Engine torque reserve for power steering" SWORD _CNV_A_R_LINEAR_____31_CM 1 100. -1024. 1023.96875 DISPLAY_IDENTIFIER TQ_ADD_PSTE ECU_ADDRESS 0xd000aade FORMAT "%8.2" /end MEASUREMENT
/begin MEASUREMENT tq_add_pste_1 "Engine torque reserve for power steering" SWORD _CNV_A_R_LINEAR_____31_CM 1 100. -1024. 1023.96875 DISPLAY_IDENTIFIER TQ_ADD_PSTE_1 ECU_ADDRESS 0xd00017e4 FORMAT "%8.2" /end MEASUREMENT
/begin MEASUREMENT tq_add_pste_2 "Engine torque reserve active front  steering" SWORD _CNV_A_R_LINEAR_____31_CM 1 100. -1024. 1023.96875 DISPLAY_IDENTIFIER TQ_ADD_PSTE_2 ECU_ADDRESS 0xd000aae4 FORMAT "%8.2" /end MEASUREMENT
/begin MEASUREMENT tq_add_pste_3 "Engine torque reserve active front  steering" SWORD _CNV_A_R_LINEAR_____31_CM 1 100. -1024. 1023.96875 DISPLAY_IDENTIFIER TQ_ADD_PSTE_3 ECU_ADDRESS 0xd000aae8 FORMAT "%8.2" /end MEASUREMENT
/begin MEASUREMENT tq_loss_pste_2 "Engine Torque losses active front steering" SWORD _CNV_A_R_LINEAR_____31_CM 1 100. -1024. 1023.96875 DISPLAY_IDENTIFIER TQ_LOSS_PSTE_2 ECU_ADDRESS 0xd000aae2 FORMAT "%8.2" /end MEASUREMENT
/begin MEASUREMENT tq_loss_pste_3 "Engine Torque losses active front steering" SWORD _CNV_A_R_LINEAR_____31_CM 1 100. -1024. 1023.96875 DISPLAY_IDENTIFIER TQ_LOSS_PSTE_3 ECU_ADDRESS 0xd000aae6 FORMAT "%8.2" /end MEASUREMENT
/begin MEASUREMENT tq_loss_pste_3_sp "Engine torque losses electric power steering setpoint" SWORD _CNV_A_R_LINEAR_____31_CM 1 100. -1024. 1023.96875 DISPLAY_IDENTIFIER TQ_LOSS_PSTE_3_SP ECU_ADDRESS 0xd00017f0 FORMAT "%8.2" /end MEASUREMENT
/begin MEASUREMENT tq_loss_pste_3_av "Engine torque losses actual value for electric power steering (EHB3)" SWORD _CNV_A_R_LINEAR_____31_CM 1 100. -1024. 1023.96875 DISPLAY_IDENTIFIER TQ_LOSS_PSTE_3_AV ECU_ADDRESS 0xd00017f2 FORMAT "%8.2" /end MEASUREMENT
/begin MEASUREMENT tq_loss_pste_3_dif "Engine torque losses difference for electric power steering (EHB3)" SWORD _CNV_A_R_LINEAR_____31_CM 1 100. -1024. 1023.96875 DISPLAY_IDENTIFIER TQ_LOSS_PSTE_3_DIF ECU_ADDRESS 0xd00017f4 FORMAT "%8.2" /end MEASUREMENT
/begin MEASUREMENT tq_loss_pste_3_grd "Engine torque losses gradient for electric power steering (EHB3)" SWORD _CNV_A_R_LINEAR_____31_CM 1 100. -1024. 1023.96875 DISPLAY_IDENTIFIER TQ_LOSS_PSTE_3_GRD ECU_ADDRESS 0xd00017f6 FORMAT "%8.2" /end MEASUREMENT
/begin MEASUREMENT tq_loss_pste_3_raw "Engine torque losses for electric power steering (EHB3)" SWORD _CNV_A_R_LINEAR_____31_CM 1 100. -1024. 1023.96875 DISPLAY_IDENTIFIER TQ_LOSS_PSTE_3_RAW ECU_ADDRESS 0xd00017f8 FORMAT "%8.2" /end MEASUREMENT
/begin MEASUREMENT tq_loss_pste_2_raw "Engine Torque losses active front steering" SWORD _CNV_A_R_LINEAR_____31_CM 1 100. -1024. 1023.96875 DISPLAY_IDENTIFIER TQ_LOSS_PSTE_2_RAW ECU_ADDRESS 0xd00017ee FORMAT "%8.2" /end MEASUREMENT
/begin CHARACTERISTIC c_tq_add_pste_1_lih "limp home value torque reserve" VALUE 0xa080c364 _REC_VAL_20_u2 40.95875 _CNV_A_R_LINEAR_____31_CM 0. 1023.96875 DISPLAY_IDENTIFIER C_TQ_ADD_PSTE_1_LIH FORMAT "%7.2" /end CHARACTERISTIC
/begin AXIS_PTS ldpm_ang_pste_stnd_tqlo_1 "" 0xa080934c ang_pste_stnd _REC_AXS_20_u2 199.99694824 _CNV_A_R_LINEAR_____263_CM 8 -100. 99.99694824 FORMAT "%8.3" /end AXIS_PTS
/begin AXIS_PTS ldpm_ang_pste_stnd_tqlo "" 0xa0809338 ang_pste_stnd _REC_AXS_20_u2 199.99694824 _CNV_A_R_LINEAR_____263_CM 8 -100. 99.99694824 FORMAT "%8.3" /end AXIS_PTS
/begin AXIS_PTS ldp_tq_loss_pste_2_sp_can "" 0xa0809010 tq_loss_pste_2_sp_can _REC_AXS_20_u2 2047.96875 _CNV_A_R_LINEAR_____87_CM 8 -1024. 1023.96875 FORMAT "%6.2" /end AXIS_PTS
/begin AXIS_PTS ldpm_tq_loss_pste_3_sp_can "" 0xa0809888 tq_loss_pste_3_sp_can _REC_AXS_20_u2 2047.96875 _CNV_A_R_LINEAR_____87_CM 8 -1024. 1023.96875 FORMAT "%6.2" /end AXIS_PTS
/begin CHARACTERISTIC ip_fac_tq_loss_pste "Factor weighting the torque request" CURVE 0xa080a9cc _REC_CUR_20_u1_u2 3.984375 _CNV_A_R_LINEAR_____243_CM 0. 3.984375 DISPLAY_IDENTIFIER IP_FAC_TQ_LOSS_PSTE FORMAT "%4.2"
 /begin AXIS_DESCR COM_AXIS n _CNV_A_R_LINEAR_____14_CM 8 0. 8160. FORMAT "%4.0" AXIS_PTS_REF ldp_n__fac_tq_add_pste /end AXIS_DESCR
/end CHARACTERISTIC
/begin AXIS_PTS ldp_n__fac_tq_add_pste "" 0xa0808a8c n _REC_AXS_20_u2 8160. _CNV_A_R_LINEAR_____14_CM 8 0. 8160. FORMAT "%4.0" /end AXIS_PTS
/begin AXIS_PTS ldpm_vs_tq_loss_pste_2 "" 0xa0809918 vs _REC_AXS_20_u1 255. _CNV_A_R_LINEAR_____6_CM 6 0. 255. FORMAT "%3.0" /end AXIS_PTS
/begin AXIS_PTS ldpm_vs_tq_loss_pste_3 "" 0xa0809920 vs _REC_AXS_20_u1 255. _CNV_A_R_LINEAR_____6_CM 6 0. 255. FORMAT "%3.0" /end AXIS_PTS
/begin CHARACTERISTIC ip_tq_add_pste_2 "Active power steering torque reserve" MAP 0xa081630c _REC_MAP_20_u2_u2_u2 2047.96875 _CNV_A_R_LINEAR_____87_CM -1024. 1023.96875 DISPLAY_IDENTIFIER IP_TQ_ADD_PSTE_2 FORMAT "%6.2"
 /begin AXIS_DESCR COM_AXIS ang_pste_stnd _CNV_A_R_LINEAR_____263_CM 8 -100. 99.99694824 FORMAT "%8.3" AXIS_PTS_REF ldpm_ang_pste_stnd_tqlo /end AXIS_DESCR
 /begin AXIS_DESCR COM_AXIS tq_loss_pste_2_sp_can _CNV_A_R_LINEAR_____87_CM 8 -1024. 1023.96875 FORMAT "%6.2" AXIS_PTS_REF ldp_tq_loss_pste_2_sp_can /end AXIS_DESCR
/end CHARACTERISTIC
/begin CHARACTERISTIC ip_tq_add_pste_3_pste "Electric power steering torque reserve" MAP 0xa081644c _REC_MAP_20_u2_u2_u2 2047.96875 _CNV_A_R_LINEAR_____87_CM -1024. 1023.96875 DISPLAY_IDENTIFIER IP_TQ_ADD_PSTE_3_PSTE FORMAT "%6.2"
 /begin AXIS_DESCR COM_AXIS ang_pste_stnd _CNV_A_R_LINEAR_____263_CM 8 -100. 99.99694824 FORMAT "%8.3" AXIS_PTS_REF ldpm_ang_pste_stnd_tqlo /end AXIS_DESCR
 /begin AXIS_DESCR COM_AXIS tq_loss_pste_3_sp_can _CNV_A_R_LINEAR_____87_CM 8 -1024. 1023.96875 FORMAT "%6.2" AXIS_PTS_REF ldpm_tq_loss_pste_3_sp_can /end AXIS_DESCR
/end CHARACTERISTIC
/begin CHARACTERISTIC ip_tq_add_pste_3_pste_2 "Electric power steering torque reserve" MAP 0xa08164cc _REC_MAP_20_u2_u2_u2 2047.96875 _CNV_A_R_LINEAR_____87_CM -1024. 1023.96875 DISPLAY_IDENTIFIER IP_TQ_ADD_PSTE_3_PSTE_2 FORMAT "%6.2"
 /begin AXIS_DESCR COM_AXIS ang_pste_stnd _CNV_A_R_LINEAR_____263_CM 8 -100. 99.99694824 FORMAT "%8.3" AXIS_PTS_REF ldpm_ang_pste_stnd_tqlo /end AXIS_DESCR
 /begin AXIS_DESCR COM_AXIS tq_loss_pste_3_sp_can _CNV_A_R_LINEAR_____87_CM 8 -1024. 1023.96875 FORMAT "%6.2" AXIS_PTS_REF ldpm_tq_loss_pste_3_sp_can /end AXIS_DESCR
/end CHARACTERISTIC
/begin CHARACTERISTIC ip_tq_add_pste_2_lih "factor active power steering torque loss correction vs" MAP 0xa081638c _REC_MAP_20_u2_u1_u2 2047.96875 _CNV_A_R_LINEAR_____87_CM -1024. 1023.96875 DISPLAY_IDENTIFIER IP_TQ_ADD_PSTE_2_LIH FORMAT "%6.2"
 /begin AXIS_DESCR COM_AXIS vs _CNV_A_R_LINEAR_____6_CM 6 0. 255. FORMAT "%3.0" AXIS_PTS_REF ldpm_vs_tq_loss_pste_2 /end AXIS_DESCR
 /begin AXIS_DESCR COM_AXIS ang_pste_stnd _CNV_A_R_LINEAR_____263_CM 8 -100. 99.99694824 FORMAT "%8.3" AXIS_PTS_REF ldpm_ang_pste_stnd_tqlo /end AXIS_DESCR
/end CHARACTERISTIC
/begin CHARACTERISTIC ip_tq_add_pste_3_lih "factor active power steering torque loss correction vs" MAP 0xa08163ec _REC_MAP_20_u2_u1_u2 2047.96875 _CNV_A_R_LINEAR_____87_CM -1024. 1023.96875 DISPLAY_IDENTIFIER IP_TQ_ADD_PSTE_3_LIH FORMAT "%6.2"
 /begin AXIS_DESCR COM_AXIS vs _CNV_A_R_LINEAR_____6_CM 6 0. 255. FORMAT "%3.0" AXIS_PTS_REF ldpm_vs_tq_loss_pste_3 /end AXIS_DESCR
 /begin AXIS_DESCR COM_AXIS ang_pste_stnd _CNV_A_R_LINEAR_____263_CM 8 -100. 99.99694824 FORMAT "%8.3" AXIS_PTS_REF ldpm_ang_pste_stnd_tqlo /end AXIS_DESCR
/end CHARACTERISTIC
/begin CHARACTERISTIC ip_tq_loss_pste "Power steering torque loss versus engine-speed" MAP 0xa0816b84 _REC_MAP_20_u2_u2_u2 2047.96875 _CNV_A_R_LINEAR_____87_CM -1024. 1023.96875 DISPLAY_IDENTIFIER IP_TQ_LOSS_PSTE FORMAT "%6.2"
 /begin AXIS_DESCR COM_AXIS ang_pste_stnd _CNV_A_R_LINEAR_____263_CM 8 -100. 99.99694824 FORMAT "%8.3" AXIS_PTS_REF ldpm_ang_pste_stnd_tqlo_1 /end AXIS_DESCR
 /begin AXIS_DESCR COM_AXIS vel_ang_pste_cor _CNV_A_R_LINEAR_____265_CM 8 -1439.98976 1439.945815 FORMAT "%8.2" AXIS_PTS_REF ldp_vel_ang_pste_tqlo_1 /end AXIS_DESCR
/end CHARACTERISTIC
/begin AXIS_PTS ldp_vel_ang_pste_tqlo_1 "" 0xa0809110 vel_ang_pste_cor _REC_AXS_20_u2 2879.935575 _CNV_A_R_LINEAR_____265_CM 8 -1439.98976 1439.945815 FORMAT "%8.2" /end AXIS_PTS
/begin AXIS_PTS ldpm_vel_ang_pste_tqlo "" 0xa08098b0 vel_ang_pste_cor _REC_AXS_20_u2 2879.935575 _CNV_A_R_LINEAR_____265_CM 8 -1439.98976 1439.945815 FORMAT "%8.2" /end AXIS_PTS
/begin CHARACTERISTIC ip_fac_tq_add_pste_2_vs "Active power steering torque loss correction" CURVE 0xa080a948 _REC_CUR_20_u1_u1 3.984375 _CNV_A_R_LINEAR_____266_CM 0. 3.984375 DISPLAY_IDENTIFIER IP_FAC_TQ_ADD_PSTE_2_VS FORMAT "%4.2"
 /begin AXIS_DESCR COM_AXIS vs _CNV_A_R_LINEAR_____6_CM 6 0. 255. FORMAT "%3.0" AXIS_PTS_REF ldpm_vs_tq_loss_pste_2 /end AXIS_DESCR
/end CHARACTERISTIC
/begin CHARACTERISTIC ip_fac_tq_add_pste_3_vs_pste_2 "Electric power steering torque loss correction" CURVE 0xa080a954 _REC_CUR_20_u1_u1 3.984375 _CNV_A_R_LINEAR_____266_CM 0. 3.984375 DISPLAY_IDENTIFIER IP_FAC_TQ_ADD_PSTE_3_VS_PSTE_2 FORMAT "%4.2"
 /begin AXIS_DESCR COM_AXIS vs _CNV_A_R_LINEAR_____6_CM 6 0. 255. FORMAT "%3.0" AXIS_PTS_REF ldpm_vs_tq_loss_pste_3 /end AXIS_DESCR
/end CHARACTERISTIC
/begin CHARACTERISTIC ip_fac_tq_add_pste_3_vs_pste "Electric power steering torque loss correction" CURVE 0xa080a94e _REC_CUR_20_u1_u1 3.984375 _CNV_A_R_LINEAR_____266_CM 0. 3.984375 DISPLAY_IDENTIFIER IP_FAC_TQ_ADD_PSTE_3_VS_PSTE FORMAT "%4.2"
 /begin AXIS_DESCR COM_AXIS vs _CNV_A_R_LINEAR_____6_CM 6 0. 255. FORMAT "%3.0" AXIS_PTS_REF ldpm_vs_tq_loss_pste_3 /end AXIS_DESCR
/end CHARACTERISTIC
/begin CHARACTERISTIC ip_fac_tq_loss_pste_2 "factor active power steering torque loss correction vs" MAP 0xa080a9d4 _REC_MAP_20_u1_u1_u1 3.984375 _CNV_A_R_LINEAR_____266_CM 0. 3.984375 DISPLAY_IDENTIFIER IP_FAC_TQ_LOSS_PSTE_2 FORMAT "%4.2"
 /begin AXIS_DESCR COM_AXIS vs _CNV_A_R_LINEAR_____6_CM 6 0. 255. FORMAT "%3.0" AXIS_PTS_REF ldpm_vs_tq_loss_pste_2 /end AXIS_DESCR
 /begin AXIS_DESCR COM_AXIS n_32 _CNV_A_R_LINEAR_____10_CM 8 0. 8160. FORMAT "%4.0" AXIS_PTS_REF ldpm_n_32__pste_2 /end AXIS_DESCR
/end CHARACTERISTIC
/begin CHARACTERISTIC ip_fac_tq_loss_pste_2_vs "factor active power steering torque loss correction vs" MAP 0xa080aa64 _REC_MAP_20_u1_u1_u1 3.984375 _CNV_A_R_LINEAR_____266_CM 0. 3.984375 DISPLAY_IDENTIFIER IP_FAC_TQ_LOSS_PSTE_2_VS FORMAT "%4.2"
 /begin AXIS_DESCR COM_AXIS vs _CNV_A_R_LINEAR_____6_CM 6 0. 255. FORMAT "%3.0" AXIS_PTS_REF ldpm_vs_tq_loss_pste_2 /end AXIS_DESCR
 /begin AXIS_DESCR COM_AXIS n_32 _CNV_A_R_LINEAR_____10_CM 8 0. 8160. FORMAT "%4.0" AXIS_PTS_REF ldpm_n_32__pste_2 /end AXIS_DESCR
/end CHARACTERISTIC
/begin CHARACTERISTIC ip_tq_loss_pste_2 "Active power steering torque loss correction" MAP 0xa0816c04 _REC_MAP_20_u2_u2_u2 2047.96875 _CNV_A_R_LINEAR_____87_CM -1024. 1023.96875 DISPLAY_IDENTIFIER IP_TQ_LOSS_PSTE_2 FORMAT "%6.2"
 /begin AXIS_DESCR COM_AXIS ang_pste_stnd _CNV_A_R_LINEAR_____263_CM 8 -100. 99.99694824 FORMAT "%8.3" AXIS_PTS_REF ldpm_ang_pste_stnd_tqlo /end AXIS_DESCR
 /begin AXIS_DESCR COM_AXIS vel_ang_pste_cor _CNV_A_R_LINEAR_____265_CM 8 -1439.98976 1439.945815 FORMAT "%8.2" AXIS_PTS_REF ldpm_vel_ang_pste_tqlo /end AXIS_DESCR
/end CHARACTERISTIC
/begin CHARACTERISTIC ip_fac_tq_loss_pste_2_ang "factor active power steering torque loss correction °STW" MAP 0xa080aa04 _REC_MAP_20_u1_u2_u2 3.984375 _CNV_A_R_LINEAR_____266_CM 0. 3.984375 DISPLAY_IDENTIFIER IP_FAC_TQ_LOSS_PSTE_2_ANG FORMAT "%4.2"
 /begin AXIS_DESCR COM_AXIS ang_pste_stnd _CNV_A_R_LINEAR_____263_CM 8 -100. 99.99694824 FORMAT "%8.3" AXIS_PTS_REF ldpm_ang_pste_stnd_tqlo /end AXIS_DESCR
 /begin AXIS_DESCR COM_AXIS vel_ang_pste_cor _CNV_A_R_LINEAR_____265_CM 8 -1439.98976 1439.945815 FORMAT "%8.2" AXIS_PTS_REF ldpm_vel_ang_pste_tqlo /end AXIS_DESCR
/end CHARACTERISTIC
/begin CHARACTERISTIC c_tq_loss_pste_2_sp_min "Min torque threshold for timer reset" VALUE 0xa080c38c _REC_VAL_20_s2 81.91875 _CNV_A_R_LINEAR_____31_CM -1024. 1023.96875 DISPLAY_IDENTIFIER C_TQ_LOSS_PSTE_2_SP_MIN FORMAT "%8.2" /end CHARACTERISTIC
/begin CHARACTERISTIC c_tq_loss_pste_3_sp_min "Min torque threshold for timer reset" VALUE 0xa080c390 _REC_VAL_20_s2 81.91875 _CNV_A_R_LINEAR_____31_CM -1024. 1023.96875 DISPLAY_IDENTIFIER C_TQ_LOSS_PSTE_3_SP_MIN FORMAT "%8.2" /end CHARACTERISTIC
/begin CHARACTERISTIC lc_tq_loss_pste_2_swi "configuration AFS switch" VALUE 0xa080c60c _REC_VAL_20_u1 4.e-002 _CNV_A_R_LINEAR_____0_CM 0. 1. DISPLAY_IDENTIFIER LC_TQ_LOSS_PSTE_2_SWI FORMAT "%2.0" /end CHARACTERISTIC
/begin CHARACTERISTIC lc_tq_loss_pste_3_swi "configuration EHB3 switch" VALUE 0xa080c60d _REC_VAL_20_u1 4.e-002 _CNV_A_R_LINEAR_____0_CM 0. 1. DISPLAY_IDENTIFIER LC_TQ_LOSS_PSTE_3_SWI FORMAT "%2.0" /end CHARACTERISTIC
/begin CHARACTERISTIC c_tq_loss_pste_1_lih "limp home value torque losses" VALUE 0xa080c388 _REC_VAL_20_s2 81.91875 _CNV_A_R_LINEAR_____31_CM -1024. 1023.96875 DISPLAY_IDENTIFIER C_TQ_LOSS_PSTE_1_LIH FORMAT "%8.2" /end CHARACTERISTIC
/begin CHARACTERISTIC c_tq_loss_pste_2_lih "limp home value torque losses" VALUE 0xa080c38a _REC_VAL_20_s2 81.91875 _CNV_A_R_LINEAR_____31_CM -1024. 1023.96875 DISPLAY_IDENTIFIER C_TQ_LOSS_PSTE_2_LIH FORMAT "%8.2" /end CHARACTERISTIC
/begin CHARACTERISTIC c_tq_loss_pste_3_lih "limp home value torque losses" VALUE 0xa080c38e _REC_VAL_20_s2 81.91875 _CNV_A_R_LINEAR_____31_CM -1024. 1023.96875 DISPLAY_IDENTIFIER C_TQ_LOSS_PSTE_3_LIH FORMAT "%8.2" /end CHARACTERISTIC
/begin MEASUREMENT state_tq_pste_2_plaus "Bitwise coded State for PSTE_2 intervention state" UBYTE _CNV_A_R_LINEAR_____0_CM 1 100. 0. 255. DISPLAY_IDENTIFIER STATE_TQ_PSTE_2_PLAUS ECU_ADDRESS 0xd0008e85 FORMAT "%3.0" /end MEASUREMENT
/begin MEASUREMENT state_tq_pste_3_plaus "Bitwise coded State for PSTE_3 intervention state" UBYTE _CNV_A_R_LINEAR_____0_CM 1 100. 0. 255. DISPLAY_IDENTIFIER STATE_TQ_PSTE_3_PLAUS ECU_ADDRESS 0xd0008e87 FORMAT "%3.0" /end MEASUREMENT
/begin CHARACTERISTIC c_tq_add_pste_ad "threshold torque reserve PSTE for inhibition of IS-control adaptations" VALUE 0xa080c366 _REC_VAL_20_u2 40.95875 _CNV_A_R_LINEAR_____31_CM 0. 1023.96875 DISPLAY_IDENTIFIER C_TQ_ADD_PSTE_AD FORMAT "%7.2" /end CHARACTERISTIC
/begin CHARACTERISTIC c_tq_loss_pste_ad "threshold torque reserve PSTE for inhibition of IS-control adaptations" VALUE 0xa080c392 _REC_VAL_20_s2 81.91875 _CNV_A_R_LINEAR_____31_CM -1024. 1023.96875 DISPLAY_IDENTIFIER C_TQ_LOSS_PSTE_AD FORMAT "%8.2" /end CHARACTERISTIC
/begin CHARACTERISTIC c_t_pste_dly_ad "threshold torque reserve PSTE for inhibition of IS-control adaptations" VALUE 0xa080c25a _REC_VAL_20_u1 0.102 _CNV_A_R_LINEAR_____3_CM 0. 2.55 DISPLAY_IDENTIFIER C_T_PSTE_DLY_AD FORMAT "%4.2" /end CHARACTERISTIC
/begin MEASUREMENT lv_tq_loss_pste_is_ad_inh "flag for inhibition of IS-control adaptations due to torque losses PSTE" UBYTE _CNV_S_2_RANGE__0___1_CM 1 100. 0. 1. DISPLAY_IDENTIFIER LV_TQ_LOSS_PSTE_IS_AD_INH ECU_ADDRESS 0xd0008e8e BIT_MASK 0x1 /end MEASUREMENT
/begin MEASUREMENT lv_tq_add_pste_is_ad_inh "flag for inhibition of IS-control adaptations due to torque reserve PSTE" UBYTE _CNV_S_2_RANGE__0___1_CM 1 100. 0. 1. DISPLAY_IDENTIFIER LV_TQ_ADD_PSTE_IS_AD_INH ECU_ADDRESS 0xd0008e8f BIT_MASK 0x1 /end MEASUREMENT
/begin CHARACTERISTIC lc_pste_2_man_act "logical variable for manual activation of PSTE_2 conditions independent of PSTE_2 messages" VALUE 0xa080c5d3 _REC_VAL_20_u1 1. _CNV_A_R_LINEAR_____0_CM 0. 1. DISPLAY_IDENTIFIER LC_PSTE_2_MAN_ACT FORMAT "%1.0" /end CHARACTERISTIC
/begin AXIS_PTS ldpm_n_32__pste_2_1 "" 0xa08095ea n_32 _REC_AXS_20_u1 8160. _CNV_A_R_LINEAR_____10_CM 4 0. 8160. FORMAT "%4.0" /end AXIS_PTS
/begin AXIS_PTS ldpm_n_32__pste_3_1 "" 0xa08095fa n_32 _REC_AXS_20_u1 8160. _CNV_A_R_LINEAR_____10_CM 4 0. 8160. FORMAT "%4.0" /end AXIS_PTS
/begin MEASUREMENT fac_iga_opm_sel "Ignition interpolation factor for operation switch manager" UBYTE _CNV_A_R_LINEAR_____28_CM 1 100. 0. 0.99609375 DISPLAY_IDENTIFIER FAC_IGA_OPM_SEL ECU_ADDRESS 0xd000874c FORMAT "%5.3" /end MEASUREMENT
/begin MEASUREMENT lv_iga_st_opm_sel "condition for IGA_ST operation mode, 1 =  OPM_1 , 0 = OPM_2" UBYTE _CNV_S_2_RANGE__0___1_CM 1 100. 0. 1. DISPLAY_IDENTIFIER LV_IGA_ST_OPM_SEL ECU_ADDRESS 0xd0008771 BIT_MASK 0x1 /end MEASUREMENT
/begin MEASUREMENT iga_add_cmb_ctl[0] "corrected basic ignition angle due to combustion function" SBYTE _CNV_A_R_LINEAR_____200_CM 1 100. -48. 47.625 DISPLAY_IDENTIFIER IGA_ADD_CMB_CTL[0] ECU_ADDRESS 0xd0008750 FORMAT "%5.1" /end MEASUREMENT
/begin MEASUREMENT iga_add_cmb_ctl[1] "corrected basic ignition angle due to combustion function" SBYTE _CNV_A_R_LINEAR_____200_CM 1 100. -48. 47.625 DISPLAY_IDENTIFIER IGA_ADD_CMB_CTL[1] ECU_ADDRESS 0xd0008751 FORMAT "%5.1" /end MEASUREMENT
/begin MEASUREMENT iga_add_cmb_ctl[2] "corrected basic ignition angle due to combustion function" SBYTE _CNV_A_R_LINEAR_____200_CM 1 100. -48. 47.625 DISPLAY_IDENTIFIER IGA_ADD_CMB_CTL[2] ECU_ADDRESS 0xd0008752 FORMAT "%5.1" /end MEASUREMENT
/begin MEASUREMENT iga_add_cmb_ctl[3] "corrected basic ignition angle due to combustion function" SBYTE _CNV_A_R_LINEAR_____200_CM 1 100. -48. 47.625 DISPLAY_IDENTIFIER IGA_ADD_CMB_CTL[3] ECU_ADDRESS 0xd0008753 FORMAT "%5.1" /end MEASUREMENT
/begin MEASUREMENT iga_add_cmb_ctl[4] "corrected basic ignition angle due to combustion function" SBYTE _CNV_A_R_LINEAR_____200_CM 1 100. -48. 47.625 DISPLAY_IDENTIFIER IGA_ADD_CMB_CTL[4] ECU_ADDRESS 0xd0008754 FORMAT "%5.1" /end MEASUREMENT
/begin MEASUREMENT iga_add_cmb_ctl[5] "corrected basic ignition angle due to combustion function" SBYTE _CNV_A_R_LINEAR_____200_CM 1 100. -48. 47.625 DISPLAY_IDENTIFIER IGA_ADD_CMB_CTL[5] ECU_ADDRESS 0xd0008755 FORMAT "%5.1" /end MEASUREMENT
/begin MEASUREMENT iga_add_cmb_ctl[6] "corrected basic ignition angle due to combustion function" SBYTE _CNV_A_R_LINEAR_____200_CM 1 100. -48. 47.625 DISPLAY_IDENTIFIER IGA_ADD_CMB_CTL[6] ECU_ADDRESS 0xd0008756 FORMAT "%5.1" /end MEASUREMENT
/begin MEASUREMENT iga_add_cmb_ctl[7] "corrected basic ignition angle due to combustion function" SBYTE _CNV_A_R_LINEAR_____200_CM 1 100. -48. 47.625 DISPLAY_IDENTIFIER IGA_ADD_CMB_CTL[7] ECU_ADDRESS 0xd0008757 FORMAT "%5.1" /end MEASUREMENT
/begin MEASUREMENT iga_av_h_rng_s_1[0] "Ignition angle applied on cylinder CYL in stratified cumbustion" SWORD _CNV_A_R_LINEAR_____188_CM 1 100. -90. 90. DISPLAY_IDENTIFIER IGA_AV_H_RNG_S_1[0] ECU_ADDRESS 0xd000a2d8 FORMAT "%8.4" /end MEASUREMENT
/begin MEASUREMENT iga_av_h_rng_s_1[1] "Ignition angle applied on cylinder CYL in stratified cumbustion" SWORD _CNV_A_R_LINEAR_____188_CM 1 100. -90. 90. DISPLAY_IDENTIFIER IGA_AV_H_RNG_S_1[1] ECU_ADDRESS 0xd000a2da FORMAT "%8.4" /end MEASUREMENT
/begin MEASUREMENT iga_av_h_rng_s_1[2] "Ignition angle applied on cylinder CYL in stratified cumbustion" SWORD _CNV_A_R_LINEAR_____188_CM 1 100. -90. 90. DISPLAY_IDENTIFIER IGA_AV_H_RNG_S_1[2] ECU_ADDRESS 0xd000a2dc FORMAT "%8.4" /end MEASUREMENT
/begin MEASUREMENT iga_av_h_rng_s_1[3] "Ignition angle applied on cylinder CYL in stratified cumbustion" SWORD _CNV_A_R_LINEAR_____188_CM 1 100. -90. 90. DISPLAY_IDENTIFIER IGA_AV_H_RNG_S_1[3] ECU_ADDRESS 0xd000a2de FORMAT "%8.4" /end MEASUREMENT
/begin MEASUREMENT iga_av_h_rng_s_1[4] "Ignition angle applied on cylinder CYL in stratified cumbustion" SWORD _CNV_A_R_LINEAR_____188_CM 1 100. -90. 90. DISPLAY_IDENTIFIER IGA_AV_H_RNG_S_1[4] ECU_ADDRESS 0xd000a2e0 FORMAT "%8.4" /end MEASUREMENT
/begin MEASUREMENT iga_av_h_rng_s_1[5] "Ignition angle applied on cylinder CYL in stratified cumbustion" SWORD _CNV_A_R_LINEAR_____188_CM 1 100. -90. 90. DISPLAY_IDENTIFIER IGA_AV_H_RNG_S_1[5] ECU_ADDRESS 0xd000a2e2 FORMAT "%8.4" /end MEASUREMENT
/begin MEASUREMENT iga_av_h_rng_s_1[6] "Ignition angle applied on cylinder CYL in stratified cumbustion" SWORD _CNV_A_R_LINEAR_____188_CM 1 100. -90. 90. DISPLAY_IDENTIFIER IGA_AV_H_RNG_S_1[6] ECU_ADDRESS 0xd000a2e4 FORMAT "%8.4" /end MEASUREMENT
/begin MEASUREMENT iga_av_h_rng_s_1[7] "Ignition angle applied on cylinder CYL in stratified cumbustion" SWORD _CNV_A_R_LINEAR_____188_CM 1 100. -90. 90. DISPLAY_IDENTIFIER IGA_AV_H_RNG_S_1[7] ECU_ADDRESS 0xd000a2e6 FORMAT "%8.4" /end MEASUREMENT
/begin MEASUREMENT iga_ref_lamb_cor "Additive lambda correction of IGA_REF" SBYTE _CNV_A_R_LINEAR_____200_CM 1 100. -48. 47.625 DISPLAY_IDENTIFIER IGA_REF_LAMB_COR ECU_ADDRESS 0xd000875c FORMAT "%5.1" /end MEASUREMENT
/begin MEASUREMENT iga_ref_temp_cor "Additive temperature correction of IGA_REF" SBYTE _CNV_A_R_LINEAR_____200_CM 1 100. -48. 47.625 DISPLAY_IDENTIFIER IGA_REF_TEMP_COR ECU_ADDRESS 0xd0008770 FORMAT "%5.1" /end MEASUREMENT
/begin MEASUREMENT iga_av_h_rng_homs[0] "Ignition angle applied on cylinder CYL in stratified cumbustion" SWORD _CNV_A_R_LINEAR_____188_CM 1 100. -90. 90. DISPLAY_IDENTIFIER IGA_AV_H_RNG_HOMS[0] ECU_ADDRESS 0xd000a2e8 FORMAT "%8.4" /end MEASUREMENT
/begin MEASUREMENT iga_av_h_rng_homs[1] "Ignition angle applied on cylinder CYL in stratified cumbustion" SWORD _CNV_A_R_LINEAR_____188_CM 1 100. -90. 90. DISPLAY_IDENTIFIER IGA_AV_H_RNG_HOMS[1] ECU_ADDRESS 0xd000a2ea FORMAT "%8.4" /end MEASUREMENT
/begin MEASUREMENT iga_av_h_rng_homs[2] "Ignition angle applied on cylinder CYL in stratified cumbustion" SWORD _CNV_A_R_LINEAR_____188_CM 1 100. -90. 90. DISPLAY_IDENTIFIER IGA_AV_H_RNG_HOMS[2] ECU_ADDRESS 0xd000a2ec FORMAT "%8.4" /end MEASUREMENT
/begin MEASUREMENT iga_av_h_rng_homs[3] "Ignition angle applied on cylinder CYL in stratified cumbustion" SWORD _CNV_A_R_LINEAR_____188_CM 1 100. -90. 90. DISPLAY_IDENTIFIER IGA_AV_H_RNG_HOMS[3] ECU_ADDRESS 0xd000a2ee FORMAT "%8.4" /end MEASUREMENT
/begin MEASUREMENT iga_av_h_rng_homs[4] "Ignition angle applied on cylinder CYL in stratified cumbustion" SWORD _CNV_A_R_LINEAR_____188_CM 1 100. -90. 90. DISPLAY_IDENTIFIER IGA_AV_H_RNG_HOMS[4] ECU_ADDRESS 0xd000a2f0 FORMAT "%8.4" /end MEASUREMENT
/begin MEASUREMENT iga_av_h_rng_homs[5] "Ignition angle applied on cylinder CYL in stratified cumbustion" SWORD _CNV_A_R_LINEAR_____188_CM 1 100. -90. 90. DISPLAY_IDENTIFIER IGA_AV_H_RNG_HOMS[5] ECU_ADDRESS 0xd000a2f2 FORMAT "%8.4" /end MEASUREMENT
/begin MEASUREMENT iga_av_h_rng_homs[6] "Ignition angle applied on cylinder CYL in stratified cumbustion" SWORD _CNV_A_R_LINEAR_____188_CM 1 100. -90. 90. DISPLAY_IDENTIFIER IGA_AV_H_RNG_HOMS[6] ECU_ADDRESS 0xd000a2f4 FORMAT "%8.4" /end MEASUREMENT
/begin MEASUREMENT iga_av_h_rng_homs[7] "Ignition angle applied on cylinder CYL in stratified cumbustion" SWORD _CNV_A_R_LINEAR_____188_CM 1 100. -90. 90. DISPLAY_IDENTIFIER IGA_AV_H_RNG_HOMS[7] ECU_ADDRESS 0xd000a2f6 FORMAT "%8.4" /end MEASUREMENT
/begin MEASUREMENT iga_bas_cor "corrected basic ignition angle" UBYTE _CNV_A_R_LINEAR_____190_CM 1 100. -35.625 60. DISPLAY_IDENTIFIER IGA_BAS_COR ECU_ADDRESS 0xd000874d FORMAT "%5.1" /end MEASUREMENT
/begin MEASUREMENT iga_ref_cor "Corrected reference ignition angle" UBYTE _CNV_A_R_LINEAR_____190_CM 1 100. -35.625 60. DISPLAY_IDENTIFIER IGA_REF_COR ECU_ADDRESS 0xd0008758 FORMAT "%5.1" /end MEASUREMENT
/begin MEASUREMENT iga_bas_cor_cbk[0] "corrected basic ignition angle,bank 1" UBYTE _CNV_A_R_LINEAR_____190_CM 1 100. -35.625 60. DISPLAY_IDENTIFIER IGA_BAS_COR_CBK[1] ECU_ADDRESS 0xd000874e FORMAT "%5.1" /end MEASUREMENT
/begin MEASUREMENT iga_bas_cor_cbk[1] "corrected basic ignition angle,bank 1" UBYTE _CNV_A_R_LINEAR_____190_CM 1 100. -35.625 60. DISPLAY_IDENTIFIER IGA_BAS_COR_CBK[2] ECU_ADDRESS 0xd000874f FORMAT "%5.1" /end MEASUREMENT
/begin MEASUREMENT iga_ref_cor_cbk[0] "Corrected reference ignition angle,bank 1" UBYTE _CNV_A_R_LINEAR_____190_CM 1 100. -35.625 60. DISPLAY_IDENTIFIER IGA_REF_COR_CBK[1] ECU_ADDRESS 0xd000875a FORMAT "%5.1" /end MEASUREMENT
/begin MEASUREMENT iga_ref_cor_cbk[1] "Corrected reference ignition angle,bank 1" UBYTE _CNV_A_R_LINEAR_____190_CM 1 100. -35.625 60. DISPLAY_IDENTIFIER IGA_REF_COR_CBK[2] ECU_ADDRESS 0xd000875b FORMAT "%5.1" /end MEASUREMENT
/begin MEASUREMENT iga_min_h_rng "minimum ignition angle in wide range" SWORD _CNV_A_R_LINEAR_____188_CM 1 100. -90. 90. DISPLAY_IDENTIFIER IGA_MIN_H_RNG ECU_ADDRESS 0xd000a2f8 FORMAT "%8.4" /end MEASUREMENT
/begin MEASUREMENT iga_wout_knk[0] "actual ignition angle (incl. application corrections without knock interception)" UBYTE _CNV_A_R_LINEAR_____190_CM 1 100. -35.625 60. DISPLAY_IDENTIFIER IGA_WOUT_KNK[0] ECU_ADDRESS 0xd0008768 FORMAT "%5.1" /end MEASUREMENT
/begin MEASUREMENT iga_wout_knk[1] "actual ignition angle (incl. application corrections without knock interception)" UBYTE _CNV_A_R_LINEAR_____190_CM 1 100. -35.625 60. DISPLAY_IDENTIFIER IGA_WOUT_KNK[1] ECU_ADDRESS 0xd0008769 FORMAT "%5.1" /end MEASUREMENT
/begin MEASUREMENT iga_wout_knk[2] "actual ignition angle (incl. application corrections without knock interception)" UBYTE _CNV_A_R_LINEAR_____190_CM 1 100. -35.625 60. DISPLAY_IDENTIFIER IGA_WOUT_KNK[2] ECU_ADDRESS 0xd000876a FORMAT "%5.1" /end MEASUREMENT
/begin MEASUREMENT iga_wout_knk[3] "actual ignition angle (incl. application corrections without knock interception)" UBYTE _CNV_A_R_LINEAR_____190_CM 1 100. -35.625 60. DISPLAY_IDENTIFIER IGA_WOUT_KNK[3] ECU_ADDRESS 0xd000876b FORMAT "%5.1" /end MEASUREMENT
/begin MEASUREMENT iga_wout_knk[4] "actual ignition angle (incl. application corrections without knock interception)" UBYTE _CNV_A_R_LINEAR_____190_CM 1 100. -35.625 60. DISPLAY_IDENTIFIER IGA_WOUT_KNK[4] ECU_ADDRESS 0xd000876c FORMAT "%5.1" /end MEASUREMENT
/begin MEASUREMENT iga_wout_knk[5] "actual ignition angle (incl. application corrections without knock interception)" UBYTE _CNV_A_R_LINEAR_____190_CM 1 100. -35.625 60. DISPLAY_IDENTIFIER IGA_WOUT_KNK[5] ECU_ADDRESS 0xd000876d FORMAT "%5.1" /end MEASUREMENT
/begin MEASUREMENT iga_wout_knk[6] "actual ignition angle (incl. application corrections without knock interception)" UBYTE _CNV_A_R_LINEAR_____190_CM 1 100. -35.625 60. DISPLAY_IDENTIFIER IGA_WOUT_KNK[6] ECU_ADDRESS 0xd000876e FORMAT "%5.1" /end MEASUREMENT
/begin MEASUREMENT iga_wout_knk[7] "actual ignition angle (incl. application corrections without knock interception)" UBYTE _CNV_A_R_LINEAR_____190_CM 1 100. -35.625 60. DISPLAY_IDENTIFIER IGA_WOUT_KNK[7] ECU_ADDRESS 0xd000876f FORMAT "%5.1" /end MEASUREMENT
/begin MEASUREMENT iga_av_h_rng[0] "homogeneus ignition angle in wide range applied on cylinder x" SWORD _CNV_A_R_LINEAR_____188_CM 1 100. -90. 90. DISPLAY_IDENTIFIER IGA_AV_H_RNG[0] ECU_ADDRESS 0xd000a2fc FORMAT "%8.4" /end MEASUREMENT
/begin MEASUREMENT iga_av_h_rng[1] "homogeneus ignition angle in wide range applied on cylinder x" SWORD _CNV_A_R_LINEAR_____188_CM 1 100. -90. 90. DISPLAY_IDENTIFIER IGA_AV_H_RNG[1] ECU_ADDRESS 0xd000a2fe FORMAT "%8.4" /end MEASUREMENT
/begin MEASUREMENT iga_av_h_rng[2] "homogeneus ignition angle in wide range applied on cylinder x" SWORD _CNV_A_R_LINEAR_____188_CM 1 100. -90. 90. DISPLAY_IDENTIFIER IGA_AV_H_RNG[2] ECU_ADDRESS 0xd000a300 FORMAT "%8.4" /end MEASUREMENT
/begin MEASUREMENT iga_av_h_rng[3] "homogeneus ignition angle in wide range applied on cylinder x" SWORD _CNV_A_R_LINEAR_____188_CM 1 100. -90. 90. DISPLAY_IDENTIFIER IGA_AV_H_RNG[3] ECU_ADDRESS 0xd000a302 FORMAT "%8.4" /end MEASUREMENT
/begin MEASUREMENT iga_av_h_rng[4] "homogeneus ignition angle in wide range applied on cylinder x" SWORD _CNV_A_R_LINEAR_____188_CM 1 100. -90. 90. DISPLAY_IDENTIFIER IGA_AV_H_RNG[4] ECU_ADDRESS 0xd000a304 FORMAT "%8.4" /end MEASUREMENT
/begin MEASUREMENT iga_av_h_rng[5] "homogeneus ignition angle in wide range applied on cylinder x" SWORD _CNV_A_R_LINEAR_____188_CM 1 100. -90. 90. DISPLAY_IDENTIFIER IGA_AV_H_RNG[5] ECU_ADDRESS 0xd000a306 FORMAT "%8.4" /end MEASUREMENT
/begin MEASUREMENT iga_av_h_rng[6] "homogeneus ignition angle in wide range applied on cylinder x" SWORD _CNV_A_R_LINEAR_____188_CM 1 100. -90. 90. DISPLAY_IDENTIFIER IGA_AV_H_RNG[6] ECU_ADDRESS 0xd000a308 FORMAT "%8.4" /end MEASUREMENT
/begin MEASUREMENT iga_av_h_rng[7] "homogeneus ignition angle in wide range applied on cylinder x" SWORD _CNV_A_R_LINEAR_____188_CM 1 100. -90. 90. DISPLAY_IDENTIFIER IGA_AV_H_RNG[7] ECU_ADDRESS 0xd000a30a FORMAT "%8.4" /end MEASUREMENT
/begin MEASUREMENT iga_av_mv_h_rng "mean value of actual ignition angle bank selective in wide range" SWORD _CNV_A_R_LINEAR_____188_CM 1 100. -90. 90. DISPLAY_IDENTIFIER IGA_AV_MV_H_RNG ECU_ADDRESS 0xd000a30c FORMAT "%8.4" /end MEASUREMENT
/begin MEASUREMENT iga_av_mv_can_h_rng "mean value of actual ignition angle in wide range" SWORD _CNV_A_R_LINEAR_____188_CM 1 100. -90. 90. DISPLAY_IDENTIFIER IGA_AV_MV_CAN_H_RNG ECU_ADDRESS 0xd000a30e FORMAT "%8.4" /end MEASUREMENT
/begin MEASUREMENT iga_av_mv_cbk_h_rng[0] "mean value of actual ignition angle bank selective in wide range" SWORD _CNV_A_R_LINEAR_____188_CM 1 100. -90. 90. DISPLAY_IDENTIFIER IGA_AV_MV_CBK_H_RNG[0] ECU_ADDRESS 0xd000a310 FORMAT "%8.4" /end MEASUREMENT
/begin MEASUREMENT iga_av_mv_cbk_h_rng[1] "mean value of actual ignition angle bank selective in wide range" SWORD _CNV_A_R_LINEAR_____188_CM 1 100. -90. 90. DISPLAY_IDENTIFIER IGA_AV_MV_CBK_H_RNG[1] ECU_ADDRESS 0xd000a312 FORMAT "%8.4" /end MEASUREMENT
/begin MEASUREMENT iga_av_h_rng_s[0] "homogeneus ignition angle in high range applied on cylinder x " SWORD _CNV_A_R_LINEAR_____188_CM 1 100. -90. 90. DISPLAY_IDENTIFIER IGA_AV_H_RNG_S[0] ECU_ADDRESS 0xd000a314 FORMAT "%8.4" /end MEASUREMENT
/begin MEASUREMENT iga_av_h_rng_s[1] "homogeneus ignition angle in high range applied on cylinder x " SWORD _CNV_A_R_LINEAR_____188_CM 1 100. -90. 90. DISPLAY_IDENTIFIER IGA_AV_H_RNG_S[1] ECU_ADDRESS 0xd000a316 FORMAT "%8.4" /end MEASUREMENT
/begin MEASUREMENT iga_av_h_rng_s[2] "homogeneus ignition angle in high range applied on cylinder x " SWORD _CNV_A_R_LINEAR_____188_CM 1 100. -90. 90. DISPLAY_IDENTIFIER IGA_AV_H_RNG_S[2] ECU_ADDRESS 0xd000a318 FORMAT "%8.4" /end MEASUREMENT
/begin MEASUREMENT iga_av_h_rng_s[3] "homogeneus ignition angle in high range applied on cylinder x " SWORD _CNV_A_R_LINEAR_____188_CM 1 100. -90. 90. DISPLAY_IDENTIFIER IGA_AV_H_RNG_S[3] ECU_ADDRESS 0xd000a31a FORMAT "%8.4" /end MEASUREMENT
/begin MEASUREMENT iga_av_h_rng_s[4] "homogeneus ignition angle in high range applied on cylinder x " SWORD _CNV_A_R_LINEAR_____188_CM 1 100. -90. 90. DISPLAY_IDENTIFIER IGA_AV_H_RNG_S[4] ECU_ADDRESS 0xd000a31c FORMAT "%8.4" /end MEASUREMENT
/begin MEASUREMENT iga_av_h_rng_s[5] "homogeneus ignition angle in high range applied on cylinder x " SWORD _CNV_A_R_LINEAR_____188_CM 1 100. -90. 90. DISPLAY_IDENTIFIER IGA_AV_H_RNG_S[5] ECU_ADDRESS 0xd000a31e FORMAT "%8.4" /end MEASUREMENT
/begin MEASUREMENT iga_av_h_rng_s[6] "homogeneus ignition angle in high range applied on cylinder x " SWORD _CNV_A_R_LINEAR_____188_CM 1 100. -90. 90. DISPLAY_IDENTIFIER IGA_AV_H_RNG_S[6] ECU_ADDRESS 0xd000a320 FORMAT "%8.4" /end MEASUREMENT
/begin MEASUREMENT iga_av_h_rng_s[7] "homogeneus ignition angle in high range applied on cylinder x " SWORD _CNV_A_R_LINEAR_____188_CM 1 100. -90. 90. DISPLAY_IDENTIFIER IGA_AV_H_RNG_S[7] ECU_ADDRESS 0xd000a322 FORMAT "%8.4" /end MEASUREMENT
/begin MEASUREMENT iga[0] "Basic ignition angle application correction and knock control included" UBYTE _CNV_A_R_LINEAR_____190_CM 1 100. -35.625 60. DISPLAY_IDENTIFIER IGA[0] ECU_ADDRESS 0xd0008760 FORMAT "%5.1" /end MEASUREMENT
/begin MEASUREMENT iga[1] "Basic ignition angle application correction and knock control included" UBYTE _CNV_A_R_LINEAR_____190_CM 1 100. -35.625 60. DISPLAY_IDENTIFIER IGA[1] ECU_ADDRESS 0xd0008761 FORMAT "%5.1" /end MEASUREMENT
/begin MEASUREMENT iga[2] "Basic ignition angle application correction and knock control included" UBYTE _CNV_A_R_LINEAR_____190_CM 1 100. -35.625 60. DISPLAY_IDENTIFIER IGA[2] ECU_ADDRESS 0xd0008762 FORMAT "%5.1" /end MEASUREMENT
/begin MEASUREMENT iga[3] "Basic ignition angle application correction and knock control included" UBYTE _CNV_A_R_LINEAR_____190_CM 1 100. -35.625 60. DISPLAY_IDENTIFIER IGA[3] ECU_ADDRESS 0xd0008763 FORMAT "%5.1" /end MEASUREMENT
/begin MEASUREMENT iga[4] "Basic ignition angle application correction and knock control included" UBYTE _CNV_A_R_LINEAR_____190_CM 1 100. -35.625 60. DISPLAY_IDENTIFIER IGA[4] ECU_ADDRESS 0xd0008764 FORMAT "%5.1" /end MEASUREMENT
/begin MEASUREMENT iga[5] "Basic ignition angle application correction and knock control included" UBYTE _CNV_A_R_LINEAR_____190_CM 1 100. -35.625 60. DISPLAY_IDENTIFIER IGA[5] ECU_ADDRESS 0xd0008765 FORMAT "%5.1" /end MEASUREMENT
/begin MEASUREMENT iga[6] "Basic ignition angle application correction and knock control included" UBYTE _CNV_A_R_LINEAR_____190_CM 1 100. -35.625 60. DISPLAY_IDENTIFIER IGA[6] ECU_ADDRESS 0xd0008766 FORMAT "%5.1" /end MEASUREMENT
/begin MEASUREMENT iga[7] "Basic ignition angle application correction and knock control included" UBYTE _CNV_A_R_LINEAR_____190_CM 1 100. -35.625 60. DISPLAY_IDENTIFIER IGA[7] ECU_ADDRESS 0xd0008767 FORMAT "%5.1" /end MEASUREMENT
/begin MEASUREMENT lv_iga_grd_act "FLag for ignition angle gradient limitation out of start active" UBYTE _CNV_S_2_RANGE__0___1_CM 1 100. 0. 1. DISPLAY_IDENTIFIER LV_IGA_GRD_ACT ECU_ADDRESS 0xd0008772 BIT_MASK 0x1 /end MEASUREMENT
/begin MEASUREMENT iga_dif_min_h_rng "Difference of minimum ignition angle to reference ignition angle in wide range" UWORD _CNV_A_R_LINEAR_____188_CM 1 100. 0. 180. DISPLAY_IDENTIFIER IGA_DIF_MIN_H_RNG ECU_ADDRESS 0xd000a2fa FORMAT "%8.4" /end MEASUREMENT
/begin MEASUREMENT load_thd_fl "load threshold for full load recognition" UWORD _CNV_A_R_LINEAR_____24_CM 1 100. 0. 3.99993896484375 DISPLAY_IDENTIFIER LOAD_THD_FL ECU_ADDRESS 0xd00072a6 FORMAT "%7.5" /end MEASUREMENT
/begin MEASUREMENT maf_sp_tqi "MAF setpoint for torque interventions" UWORD _CNV_A_R_LINEAR_____111_CM 1 100. 0. 1389. DISPLAY_IDENTIFIER MAF_SP_TQI ECU_ADDRESS 0xd00072ae FORMAT "%6.2" /end MEASUREMENT
/begin MEASUREMENT tq_req_clu "requested torque at clutch" SWORD _CNV_A_R_LINEAR_____31_CM 1 100. -1024. 1023.96875 DISPLAY_IDENTIFIER TQ_REQ_CLU ECU_ADDRESS 0xd00072a8 FORMAT "%11.5" /end MEASUREMENT
/begin MEASUREMENT tqi_sp "Torque setpoint fast path" SWORD _CNV_A_R_LINEAR_____31_CM 1 100. -1024. 1023.96875 DISPLAY_IDENTIFIER TQI_SP ECU_ADDRESS 0xd00072aa FORMAT "%11.5" /end MEASUREMENT
/begin MEASUREMENT tqi_ems "Torque " SWORD _CNV_A_R_LINEAR_____31_CM 1 100. -1024. 1023.96875 DISPLAY_IDENTIFIER TQI_EMS ECU_ADDRESS 0xd00072b0 FORMAT "%6.2" /end MEASUREMENT
/begin MEASUREMENT tq_add_max "maximum torque reserve at clutch" SWORD _CNV_A_R_LINEAR_____31_CM 1 100. -1024. 1023.96875 DISPLAY_IDENTIFIER TQ_ADD_MAX ECU_ADDRESS 0xd00072b2 FORMAT "%6.2" /end MEASUREMENT
/begin MEASUREMENT tqi_add_max "maximum indicated torque reserve" SWORD _CNV_A_R_LINEAR_____31_CM 1 100. -1024. 1023.96875 DISPLAY_IDENTIFIER TQI_ADD_MAX ECU_ADDRESS 0xd00072b4 FORMAT "%6.2" /end MEASUREMENT
/begin MEASUREMENT tqi_add_max_tol "maximum indicated torque reserve top level" SWORD _CNV_A_R_LINEAR_____31_CM 1 100. -1024. 1023.96875 DISPLAY_IDENTIFIER TQI_ADD_MAX_TOL ECU_ADDRESS 0xd00072b6 FORMAT "%6.2" /end MEASUREMENT
/begin MEASUREMENT maf_add_max "Maximum possible engine load for catalyst heating - mg/Stk" UWORD _CNV_A_R_LINEAR_____111_CM 1 100. 0. 1389. DISPLAY_IDENTIFIER MAF_ADD_MAX ECU_ADDRESS 0xd00072a4 FORMAT "%7.2" /end MEASUREMENT
/begin MEASUREMENT eff_iga_min_add_max "Minimum possible ignition efficiency for catalyst heating" UWORD _CNV_A_R_LINEAR_____9_CM 1 100. 0. 1.99996948242188 DISPLAY_IDENTIFIER EFF_IGA_MIN_ADD_MAX ECU_ADDRESS 0xd00072a0 FORMAT "%7.5" /end MEASUREMENT
/begin MEASUREMENT tqi_fast "Indicated engine torque fast request" SWORD _CNV_A_R_LINEAR_____31_CM 1 100. -1024. 1023.96875 DISPLAY_IDENTIFIER TQI_FAST ECU_ADDRESS 0xd00072b8 FORMAT "%6.2" /end MEASUREMENT
/begin MEASUREMENT tqi_req_fast "limited torque request for fast path" SWORD _CNV_A_R_LINEAR_____31_CM 1 100. -1024. 1023.96875 DISPLAY_IDENTIFIER TQI_REQ_FAST ECU_ADDRESS 0xd00072ba FORMAT "%6.2" /end MEASUREMENT
/begin MEASUREMENT tqi_req_fast_dtm "Indicated torque request fast" SWORD _CNV_A_R_LINEAR_____31_CM 1 100. -1024. 1023.96875 DISPLAY_IDENTIFIER TQI_REQ_FAST_DTM ECU_ADDRESS 0xd00072bc FORMAT "%8.2" /end MEASUREMENT
/begin MEASUREMENT tqi_req_fast_dtm_can "Indicated torque request fast for torque calculation CAN" SWORD _CNV_A_R_LINEAR_____31_CM 1 100. -1024. 1023.96875 DISPLAY_IDENTIFIER TQI_REQ_FAST_DTM_CAN ECU_ADDRESS 0xd00072be FORMAT "%8.2" /end MEASUREMENT
/begin MEASUREMENT tqi_req_fast_sel "Fast indicated engine torque request selected" SWORD _CNV_A_R_LINEAR_____31_CM 1 100. -1024. 1023.96875 DISPLAY_IDENTIFIER TQI_REQ_FAST_SEL ECU_ADDRESS 0xd00072c0 FORMAT "%6.2" /end MEASUREMENT
/begin MEASUREMENT tqi_req_slow_dtm "Indicated torque request slow" SWORD _CNV_A_R_LINEAR_____31_CM 1 100. -1024. 1023.96875 DISPLAY_IDENTIFIER TQI_REQ_SLOW_DTM ECU_ADDRESS 0xd00072c2 FORMAT "%8.2" /end MEASUREMENT
/begin MEASUREMENT tqi_req_slow_sel "Slow indicated engine torque request selected" SWORD _CNV_A_R_LINEAR_____31_CM 1 100. -1024. 1023.96875 DISPLAY_IDENTIFIER TQI_REQ_SLOW_SEL ECU_ADDRESS 0xd00072c4 FORMAT "%6.2" /end MEASUREMENT
/begin MEASUREMENT tqi_req_tra_fast "Requested indicated torque for fast path" SWORD _CNV_A_R_LINEAR_____31_CM 1 100. -1024. 1023.96875 DISPLAY_IDENTIFIER TQI_REQ_TRA_FAST ECU_ADDRESS 0xd00072c6 FORMAT "%8.2" /end MEASUREMENT
/begin MEASUREMENT tqi_sp_can "Setpoint indicated engine torque for CAN calculations" SWORD _CNV_A_R_LINEAR_____31_CM 1 100. -1024. 1023.96875 DISPLAY_IDENTIFIER TQI_SP_CAN ECU_ADDRESS 0xd00072c8 FORMAT "%6.2" /end MEASUREMENT
/begin MEASUREMENT state_tq_intv_fast "Fast external torque intervention" UBYTE _CNV_S_8_RANGE_STAT_450_CM 1 100. 0. 7. DISPLAY_IDENTIFIER STATE_TQ_INTV_FAST ECU_ADDRESS 0xd00077d8 /end MEASUREMENT
/begin MEASUREMENT state_tq_intv_slow "Air path external torque intervention" UBYTE _CNV_S_8_RANGE_STAT_450_CM 1 100. 0. 7. DISPLAY_IDENTIFIER STATE_TQ_INTV_SLOW ECU_ADDRESS 0xd00077d9 /end MEASUREMENT
/begin MEASUREMENT tq_req_ipm "Torque request for IPM" SWORD _CNV_A_R_LINEAR_____451_CM 1 100. -3276.8 3276.7 DISPLAY_IDENTIFIER TQ_REQ_IPM ECU_ADDRESS 0xd00072cc FORMAT "%6.0" /end MEASUREMENT
/begin MEASUREMENT tqi_req_slow "limited torque request for slow path" SWORD _CNV_A_R_LINEAR_____31_CM 1 100. -1024. 1023.96875 DISPLAY_IDENTIFIER TQI_REQ_SLOW ECU_ADDRESS 0xd00072ca FORMAT "%6.2" /end MEASUREMENT
/begin MEASUREMENT tqi_maf_sp_cus "limited torque request for slow path" SWORD _CNV_A_R_LINEAR_____31_CM 1 100. -1024. 1023.96875 DISPLAY_IDENTIFIER TQI_MAF_SP_CUS ECU_ADDRESS 0xd00072ce FORMAT "%8.2" /end MEASUREMENT
/begin MEASUREMENT tqi_ref "Reference indicated engine torque" SWORD _CNV_A_R_LINEAR_____31_CM 1 100. -1024. 1023.96875 DISPLAY_IDENTIFIER TQI_REF ECU_ADDRESS 0xd000a340 FORMAT "%8.2" /end MEASUREMENT
/begin MEASUREMENT tqi_ref_max "Maximum indicated torque from IP_TQI_REF" SWORD _CNV_A_R_LINEAR_____31_CM 1 100. -1024. 1023.96875 DISPLAY_IDENTIFIER TQI_REF_MAX ECU_ADDRESS 0xd000a352 FORMAT "%6.2" /end MEASUREMENT
/begin MEASUREMENT lv_tq_iga_ena "torque intervention for ignition released" UBYTE _CNV_S_2_RANGE__0___1_CM 1 100. 0. 1. DISPLAY_IDENTIFIER LV_TQ_IGA_ENA ECU_ADDRESS 0xd000879f BIT_MASK 0x1 /end MEASUREMENT
/begin MEASUREMENT tqi_av_hom "Actual indicated engine torque for homogeneous mode" SWORD _CNV_A_R_LINEAR_____31_CM 1 100. -1024. 1023.96875 DISPLAY_IDENTIFIER TQI_AV_HOM ECU_ADDRESS 0xd000a350 FORMAT "%6.2" /end MEASUREMENT
/begin MEASUREMENT eff_lamb_bas_cor "Basic lambda efficiency" UWORD _CNV_A_R_LINEAR_____9_CM 1 100. 0. 1.99996948242188 DISPLAY_IDENTIFIER EFF_LAMB_BAS_COR ECU_ADDRESS 0xd000a348 FORMAT "%7.5" /end MEASUREMENT
/begin MEASUREMENT tqi_av_s "Actual indicated engine torque for stratified mode" SWORD _CNV_A_R_LINEAR_____31_CM 1 100. -1024. 1023.96875 DISPLAY_IDENTIFIER TQI_AV_S ECU_ADDRESS 0xd000a34a FORMAT "%6.2" /end MEASUREMENT
/begin MEASUREMENT tqi_ref_s "Indicated  reference engine torque for stratified mode" SWORD _CNV_A_R_LINEAR_____31_CM 1 100. -1024. 1023.96875 DISPLAY_IDENTIFIER TQI_REF_S ECU_ADDRESS 0xd000a34c FORMAT "%8.2" /end MEASUREMENT
/begin MEASUREMENT eff_lamb_sp_bas "Basic lambda setpoint efficiency" UWORD _CNV_A_R_LINEAR_____9_CM 1 100. 0. 1.99996948242188 DISPLAY_IDENTIFIER EFF_LAMB_SP_BAS ECU_ADDRESS 0xd000a34e FORMAT "%7.5" /end MEASUREMENT
/begin MEASUREMENT tq_max_clu "Max. torque at clutch" SWORD _CNV_A_R_LINEAR_____31_CM 1 100. -1024. 1023.96875 DISPLAY_IDENTIFIER TQ_MAX_CLU ECU_ADDRESS 0xd000a354 FORMAT "%8.2" /end MEASUREMENT
/begin MEASUREMENT fac_cam_ch "Factor for weighting FAC_EFF_IGA at Catalyst heating" UBYTE _CNV_A_R_LINEAR_____185_CM 1 100. 0. 0.99609375 DISPLAY_IDENTIFIER FAC_CAM_CH ECU_ADDRESS 0xd000879c FORMAT "%5.3" /end MEASUREMENT
/begin MEASUREMENT fac_eff_iga_ch "Überblendfaktor  (warm/kalt) für Spreizung und Zündhaken während Katheizen" UBYTE _CNV_A_R_LINEAR_____185_CM 1 100. 0. 0.99609375 DISPLAY_IDENTIFIER FAC_EFF_IGA_CH ECU_ADDRESS 0xd000879d FORMAT "%5.3" /end MEASUREMENT
/begin MEASUREMENT tqi_sp_maf "Torque setpoint at air path" SWORD _CNV_A_R_LINEAR_____31_CM 1 100. -1024. 1023.96875 DISPLAY_IDENTIFIER TQI_SP_MAF ECU_ADDRESS 0xd000a356 FORMAT "%8.2" /end MEASUREMENT
/begin MEASUREMENT tqi_min_s "Min Reference indicated engine torque for stratified mode" SWORD _CNV_A_R_LINEAR_____31_CM 1 100. -1024. 1023.96875 DISPLAY_IDENTIFIER TQI_MIN_S ECU_ADDRESS 0xd000a358 FORMAT "%8.2" /end MEASUREMENT
/begin MEASUREMENT eff_lamb_av "Actual lambda efficiency" UWORD _CNV_A_R_LINEAR_____9_CM 1 100. 0. 1.99996948242188 DISPLAY_IDENTIFIER EFF_LAMB_AV ECU_ADDRESS 0xd000a342 FORMAT "%7.5" /end MEASUREMENT
/begin MEASUREMENT eff_lamb_av_cbk[0] "Actual lambda efficiency bank specific" UWORD _CNV_A_R_LINEAR_____9_CM 1 100. 0. 1.99996948242188 DISPLAY_IDENTIFIER EFF_LAMB_AV_CBK[1] ECU_ADDRESS 0xd000a344 FORMAT "%7.5" /end MEASUREMENT
/begin MEASUREMENT eff_lamb_av_cbk[1] "Actual lambda efficiency bank specific" UWORD _CNV_A_R_LINEAR_____9_CM 1 100. 0. 1.99996948242188 DISPLAY_IDENTIFIER EFF_LAMB_AV_CBK[2] ECU_ADDRESS 0xd000a346 FORMAT "%7.5" /end MEASUREMENT
/begin MEASUREMENT tqi_ref_iga_min_lamb "Indicated engine torque corrected by EFF_IGA_MIN and EFF_LAMB_BAS" SWORD _CNV_A_R_LINEAR_____31_CM 1 100. -1024. 1023.96875 DISPLAY_IDENTIFIER TQI_REF_IGA_MIN_LAMB ECU_ADDRESS 0xd000a364 FORMAT "%6.2" /end MEASUREMENT
/begin MEASUREMENT tq_av "Actual engine torque static at clutch" SWORD _CNV_A_R_LINEAR_____31_CM 1 100. -1024. 1023.96875 DISPLAY_IDENTIFIER TQ_AV ECU_ADDRESS 0xd000a366 FORMAT "%6.2" /end MEASUREMENT
/begin MEASUREMENT lv_tqi_bol_set "Logical variable it is set if  TQI_SP  falls below TQI_BOL" UBYTE _CNV_S_2_RANGE__0___1_CM 1 100. 0. 1. DISPLAY_IDENTIFIER LV_TQI_BOL_SET ECU_ADDRESS 0xd00087a0 BIT_MASK 0x1 /end MEASUREMENT
/begin MEASUREMENT fac_eff_iga_secu "Factor for fading ignition angle efficiency in case of cold/warm engine" UBYTE _CNV_A_R_LINEAR_____185_CM 1 100. 0. 0.99609375 DISPLAY_IDENTIFIER FAC_EFF_IGA_SECU ECU_ADDRESS 0xd000879e FORMAT "%5.3" /end MEASUREMENT
/begin MEASUREMENT lv_gs_act_fl "Logical bit which indicates gear shift at full load condition." UBYTE _CNV_S_2_RANGE__0___1_CM 1 100. 0. 1. DISPLAY_IDENTIFIER LV_GS_ACT_FL ECU_ADDRESS 0xd00087a1 BIT_MASK 0x1 /end MEASUREMENT
/begin MEASUREMENT tqi_min_homs "Min Reference indicated engine torque for HOMS" SWORD _CNV_A_R_LINEAR_____31_CM 1 100. -1024. 1023.96875 DISPLAY_IDENTIFIER TQI_MIN_HOMS ECU_ADDRESS 0xd000a370 FORMAT "%8.2" /end MEASUREMENT
/begin MEASUREMENT lv_tq_min_clu "Logical variable for coordination engine start torque and minimum torque and clutch" UBYTE _CNV_S_2_RANGE__0___1_CM 1 100. 0. 1. DISPLAY_IDENTIFIER LV_TQ_MIN_CLU ECU_ADDRESS 0xd00087a2 BIT_MASK 0x1 /end MEASUREMENT
/begin MEASUREMENT tq_min_clu "Minimum  torque at clutch " SWORD _CNV_A_R_LINEAR_____31_CM 1 100. -1024. 1023.96875 DISPLAY_IDENTIFIER TQ_MIN_CLU ECU_ADDRESS 0xd000a372 FORMAT "%6.2" /end MEASUREMENT
/begin CHARACTERISTIC c_mff_ref "reference MFF for conversion mg /stk to %" VALUE 0xa080be94 _REC_VAL_20_u2 694.5 _CNV_A_R_LINEAR_____225_CM 0. 694.5 DISPLAY_IDENTIFIER C_MFF_REF FORMAT "%6.2" /end CHARACTERISTIC
/begin MEASUREMENT lv_inh_lscl_cus[0] "inhibit signal for the controller deactivation" UBYTE _CNV_S_2_RANGE__0___1_CM 1 100. 0. 1. DISPLAY_IDENTIFIER LV_INH_LSCL_CUS[1] ECU_ADDRESS 0xd00086c4 BIT_MASK 0x1 /end MEASUREMENT
/begin MEASUREMENT lv_inh_lscl_cus[1] "inhibit signal for the controller deactivation" UBYTE _CNV_S_2_RANGE__0___1_CM 1 100. 0. 1. DISPLAY_IDENTIFIER LV_INH_LSCL_CUS[2] ECU_ADDRESS 0xd00086c5 BIT_MASK 0x1 /end MEASUREMENT
/begin MEASUREMENT lamb_sp_ofs_ext[0] "lambda setpoint offset defined by customer" SWORD _CNV_A_R_LINEAR_____24_CM 1 100. -2. 1.99993896484375 DISPLAY_IDENTIFIER LAMB_SP_OFS_EXT[1] ECU_ADDRESS 0xd000a240 FORMAT "%8.5" /end MEASUREMENT
/begin MEASUREMENT lamb_sp_ofs_ext[1] "lambda setpoint offset defined by customer" SWORD _CNV_A_R_LINEAR_____24_CM 1 100. -2. 1.99993896484375 DISPLAY_IDENTIFIER LAMB_SP_OFS_EXT[2] ECU_ADDRESS 0xd000a242 FORMAT "%8.5" /end MEASUREMENT
/begin MEASUREMENT fac_lam_ad_cus[0] "lambda adaption carried out by customer(multiplicative share)" SWORD _CNV_A_R_LINEAR_____113_CM 1 100. -50. 49.9984741210938 DISPLAY_IDENTIFIER FAC_LAM_AD_CUS[1] ECU_ADDRESS 0xd000a244 FORMAT "%5.4" /end MEASUREMENT
/begin MEASUREMENT fac_lam_ad_cus[1] "lambda adaption carried out by customer(multiplicative share)" SWORD _CNV_A_R_LINEAR_____113_CM 1 100. -50. 49.9984741210938 DISPLAY_IDENTIFIER FAC_LAM_AD_CUS[2] ECU_ADDRESS 0xd000a246 FORMAT "%5.4" /end MEASUREMENT
/begin MEASUREMENT lamb_sp_hom_cus[0] "Lambda setpoint with high resolution delivered by customer" UWORD _CNV_A_R_LINEAR_____24_CM 1 100. 0. 1.99993896484375 DISPLAY_IDENTIFIER LAMB_SP_HOM_CUS[1] ECU_ADDRESS 0xd000a248 FORMAT "%7.5" /end MEASUREMENT
/begin MEASUREMENT lamb_sp_hom_cus[1] "Lambda setpoint with high resolution delivered by customer" UWORD _CNV_A_R_LINEAR_____24_CM 1 100. 0. 1.99993896484375 DISPLAY_IDENTIFIER LAMB_SP_HOM_CUS[2] ECU_ADDRESS 0xd000a24a FORMAT "%7.5" /end MEASUREMENT
/begin MEASUREMENT fac_lam_adj_lam_ad_cus[0] "Long term customer Lambda Adaption (multiplicative share)" SWORD _CNV_A_R_LINEAR_____113_CM 1 100. -50. 49.9984741210938 DISPLAY_IDENTIFIER FAC_LAM_ADJ_LAM_AD_CUS[1] ECU_ADDRESS 0xd00034e0 FORMAT "%5.4" /end MEASUREMENT
/begin MEASUREMENT fac_lam_adj_lam_ad_cus[1] "Long term customer Lambda Adaption (multiplicative share)" SWORD _CNV_A_R_LINEAR_____113_CM 1 100. -50. 49.9984741210938 DISPLAY_IDENTIFIER FAC_LAM_ADJ_LAM_AD_CUS[2] ECU_ADDRESS 0xd00034e2 FORMAT "%5.4" /end MEASUREMENT
/begin MEASUREMENT fac_lam_adj_tmp_lam_ad_cus[0] "Temporary value of the Long term customer Lambda Adaption (multiplicative share)" SWORD _CNV_A_R_LINEAR_____113_CM 1 100. -50. 49.9984741210938 DISPLAY_IDENTIFIER FAC_LAM_ADJ_TMP_LAM_AD_CUS[1] ECU_ADDRESS 0xd00034e4 FORMAT "%5.4" /end MEASUREMENT
/begin MEASUREMENT fac_lam_adj_tmp_lam_ad_cus[1] "Temporary value of the Long term customer Lambda Adaption (multiplicative share)" SWORD _CNV_A_R_LINEAR_____113_CM 1 100. -50. 49.9984741210938 DISPLAY_IDENTIFIER FAC_LAM_ADJ_TMP_LAM_AD_CUS[2] ECU_ADDRESS 0xd00034e6 FORMAT "%5.4" /end MEASUREMENT
/begin MEASUREMENT fac_lam_adj_cor_lam_ad_cus[0] "Corrected value of the Long term customer Lambda Adaption (multiplicative share)" SWORD _CNV_A_R_LINEAR_____113_CM 1 100. -50. 49.9984741210938 DISPLAY_IDENTIFIER FAC_LAM_ADJ_COR_LAM_AD_CUS[1] ECU_ADDRESS 0xd000a24c FORMAT "%5.4" /end MEASUREMENT
/begin MEASUREMENT fac_lam_adj_cor_lam_ad_cus[1] "Corrected value of the Long term customer Lambda Adaption (multiplicative share)" SWORD _CNV_A_R_LINEAR_____113_CM 1 100. -50. 49.9984741210938 DISPLAY_IDENTIFIER FAC_LAM_ADJ_COR_LAM_AD_CUS[2] ECU_ADDRESS 0xd000a24e FORMAT "%5.4" /end MEASUREMENT
/begin MEASUREMENT lv_fac_lim_max_lam_ad_cus[0] "Flag indicating that the customer lambda adaptation is over the max threshold" UBYTE _CNV_S_2_RANGE__0___1_CM 1 100. 0. 1. DISPLAY_IDENTIFIER LV_FAC_LIM_MAX_LAM_AD_CUS[1] ECU_ADDRESS 0xd00086c6 BIT_MASK 0x1 /end MEASUREMENT
/begin MEASUREMENT lv_fac_lim_max_lam_ad_cus[1] "Flag indicating that the customer lambda adaptation is over the max threshold" UBYTE _CNV_S_2_RANGE__0___1_CM 1 100. 0. 1. DISPLAY_IDENTIFIER LV_FAC_LIM_MAX_LAM_AD_CUS[2] ECU_ADDRESS 0xd00086c7 BIT_MASK 0x1 /end MEASUREMENT
/begin MEASUREMENT lv_fac_lim_min_lam_ad_cus[0] "Flga indicating that the customer lambda adaptation is under the min threshold" UBYTE _CNV_S_2_RANGE__0___1_CM 1 100. 0. 1. DISPLAY_IDENTIFIER LV_FAC_LIM_MIN_LAM_AD_CUS[1] ECU_ADDRESS 0xd00086c8 BIT_MASK 0x1 /end MEASUREMENT
/begin MEASUREMENT lv_fac_lim_min_lam_ad_cus[1] "Flga indicating that the customer lambda adaptation is under the min threshold" UBYTE _CNV_S_2_RANGE__0___1_CM 1 100. 0. 1. DISPLAY_IDENTIFIER LV_FAC_LIM_MIN_LAM_AD_CUS[2] ECU_ADDRESS 0xd00086c9 BIT_MASK 0x1 /end MEASUREMENT
/begin MEASUREMENT ctr_km_lam_adj_lam_ad_cus[0] "Vehicle kilometer at the last long term customer lambda adaptation stored in NVMY" UWORD _CNV_A_R_LINEAR_____58_CM 1 100. 0. 655350. DISPLAY_IDENTIFIER CTR_KM_LAM_ADJ_LAM_AD_CUS[1] ECU_ADDRESS 0xd00034e8 FORMAT "%7.0" /end MEASUREMENT
/begin MEASUREMENT ctr_km_lam_adj_lam_ad_cus[1] "Vehicle kilometer at the last long term customer lambda adaptation stored in NVMY" UWORD _CNV_A_R_LINEAR_____58_CM 1 100. 0. 655350. DISPLAY_IDENTIFIER CTR_KM_LAM_ADJ_LAM_AD_CUS[2] ECU_ADDRESS 0xd00034ea FORMAT "%7.0" /end MEASUREMENT
/begin MEASUREMENT ctr_km_lam_adj_tmp_lam_ad_cus[0] "Vehicle kilometer counter for the next long term customer lambda adaptation" UWORD _CNV_A_R_LINEAR_____58_CM 1 100. 0. 655350. DISPLAY_IDENTIFIER CTR_KM_LAM_ADJ_TMP_LAM_AD_CUS[1] ECU_ADDRESS 0xd00034ec FORMAT "%7.0" /end MEASUREMENT
/begin MEASUREMENT ctr_km_lam_adj_tmp_lam_ad_cus[1] "Vehicle kilometer counter for the next long term customer lambda adaptation" UWORD _CNV_A_R_LINEAR_____58_CM 1 100. 0. 655350. DISPLAY_IDENTIFIER CTR_KM_LAM_ADJ_TMP_LAM_AD_CUS[2] ECU_ADDRESS 0xd00034ee FORMAT "%7.0" /end MEASUREMENT
/begin CHARACTERISTIC c_ctr_km_thd_lam_ad_cus "Distance to carry out next long term customer lambda adaptation" VALUE 0xa080bb9e _REC_VAL_20_u2 655350. _CNV_A_R_LINEAR_____58_CM 0. 655350. DISPLAY_IDENTIFIER C_CTR_KM_THD_LAM_AD_CUS FORMAT "%7.0" /end CHARACTERISTIC
/begin CHARACTERISTIC c_fac_lam_adj_min_lam_ad_cus "Minimun limit of the long term customer lambda adaptation" VALUE 0xa080bcd4 _REC_VAL_20_s2 99.99847412109381 _CNV_A_R_LINEAR_____113_CM -50. 49.9984741210938 DISPLAY_IDENTIFIER C_FAC_LAM_ADJ_MIN_LAM_AD_CUS FORMAT "%5.4" /end CHARACTERISTIC
/begin CHARACTERISTIC c_fac_lam_adj_max_lam_ad_cus "Maximun limit of the long term customer lambda adaptation" VALUE 0xa080bcd2 _REC_VAL_20_s2 99.99847412109381 _CNV_A_R_LINEAR_____113_CM -50. 49.9984741210938 DISPLAY_IDENTIFIER C_FAC_LAM_ADJ_MAX_LAM_AD_CUS FORMAT "%5.4" /end CHARACTERISTIC
/begin CHARACTERISTIC c_crlc_lam_adj_lam_ad_cus "Correlation constant for the long term adaptation" VALUE 0xa080baee _REC_VAL_20_u1 1. _CNV_A_R_ENRD_LINEA_389_CM 0. 1. DISPLAY_IDENTIFIER C_CRLC_LAM_ADJ_LAM_AD_CUS FORMAT "%5.3" /end CHARACTERISTIC
/begin CHARACTERISTIC c_n_lam_ad_cus "Calibreatable engine speed to check the current lambda adaptation value delivered by customer" VALUE 0xa080bf4f _REC_VAL_20_u1 8160. _CNV_A_R_LINEAR_____10_CM 0. 8160. DISPLAY_IDENTIFIER C_N_LAM_AD_CUS FORMAT "%4.0" /end CHARACTERISTIC
/begin CHARACTERISTIC c_mff_lam_ad_cus "Calibreatable relative MFF to check the current lambda adaptation value delivered by customer" VALUE 0xa080be7c _REC_VAL_20_u2 31.99951171875 _CNV_A_R_LINEAR_____241_CM 0. 31.99951171875 DISPLAY_IDENTIFIER C_MFF_LAM_AD_CUS FORMAT "%9.6" /end CHARACTERISTIC
/begin CHARACTERISTIC c_tco_lam_ad_cus "Calibreatable cooling water temp. to check the current lambda adaptation value delivered by customer" VALUE 0xa080c2c2 _REC_VAL_20_u1 190.5 _CNV_A_R_LINEAR_____17_CM -48. 142.5 DISPLAY_IDENTIFIER C_TCO_LAM_AD_CUS FORMAT "%6.2" /end CHARACTERISTIC
/begin MEASUREMENT lv_di_ad_ref_cam_ivvt[0] "Adaptation of inlet camschaft reference position: 0 = enabled, 1 = disabled" UBYTE _CNV_S_2_RANGE__0___1_CM 1 100. 0. 1. DISPLAY_IDENTIFIER LV_DI_AD_REF_CAM_IVVT_IN ECU_ADDRESS 0xd00087a8 BIT_MASK 0x1 /end MEASUREMENT
/begin MEASUREMENT lv_di_ad_ref_cam_ivvt[1] "Adaptation of inlet camschaft reference position: 0 = enabled, 1 = disabled" UBYTE _CNV_S_2_RANGE__0___1_CM 1 100. 0. 1. DISPLAY_IDENTIFIER LV_DI_AD_REF_CAM_IVVT_EX ECU_ADDRESS 0xd00087a9 BIT_MASK 0x1 /end MEASUREMENT
/begin MEASUREMENT cam_ex[0] "Actual position exhaust CAM VVTI" UBYTE _CNV_A_R_LINEAR_____544_CM 1 100. -40. -135.625 DISPLAY_IDENTIFIER CAM_EX[1] ECU_ADDRESS 0xd00087ae FORMAT "%8.3" /end MEASUREMENT
/begin MEASUREMENT cam_ex[1] "Actual position exhaust CAM VVTI" UBYTE _CNV_A_R_LINEAR_____544_CM 1 100. -40. -135.625 DISPLAY_IDENTIFIER CAM_EX[2] ECU_ADDRESS 0xd00087af FORMAT "%8.3" /end MEASUREMENT
/begin MEASUREMENT lv_cam_lock_ivvt_in[0] "VVT on intake camshaft in locked position at engine start" UBYTE _CNV_S_2_RANGE__0___1_CM 1 100. 0. 1. DISPLAY_IDENTIFIER LV_CAM_LOCK_IVVT_IN[1] ECU_ADDRESS 0xd00087aa BIT_MASK 0x1 /end MEASUREMENT
/begin MEASUREMENT lv_cam_lock_ivvt_in[1] "VVT on intake camshaft in locked position at engine start" UBYTE _CNV_S_2_RANGE__0___1_CM 1 100. 0. 1. DISPLAY_IDENTIFIER LV_CAM_LOCK_IVVT_IN[2] ECU_ADDRESS 0xd00087ab BIT_MASK 0x1 /end MEASUREMENT
/begin MEASUREMENT lv_cam_lock_ivvt_ex[0] "VVT on exhaust camshaft in locked position at engine start" UBYTE _CNV_S_2_RANGE__0___1_CM 1 100. 0. 1. DISPLAY_IDENTIFIER LV_CAM_LOCK_IVVT_EX[1] ECU_ADDRESS 0xd00087ac BIT_MASK 0x1 /end MEASUREMENT
/begin MEASUREMENT lv_cam_lock_ivvt_ex[1] "VVT on exhaust camshaft in locked position at engine start" UBYTE _CNV_S_2_RANGE__0___1_CM 1 100. 0. 1. DISPLAY_IDENTIFIER LV_CAM_LOCK_IVVT_EX[2] ECU_ADDRESS 0xd00087ad BIT_MASK 0x1 /end MEASUREMENT
/begin CHARACTERISTIC lc_not_adj_cam_ivvt_ex[0] "Exhaust camshaft: 0 = with adjustement; 1 = without adjustement" VALUE 0xa080c5ba _REC_VAL_20_u1 1. _CNV_A_R_LINEAR_____0_CM 0. 1. DISPLAY_IDENTIFIER LC_NOT_ADJ_CAM_IVVT_EX[0] FORMAT "%2.0" /end CHARACTERISTIC
/begin CHARACTERISTIC lc_not_adj_cam_ivvt_ex[1] "Exhaust camshaft: 0 = with adjustement; 1 = without adjustement" VALUE 0xa080c5bb _REC_VAL_20_u1 1. _CNV_A_R_LINEAR_____0_CM 0. 1. DISPLAY_IDENTIFIER LC_NOT_ADJ_CAM_IVVT_EX[1] FORMAT "%2.0" /end CHARACTERISTIC
/begin CHARACTERISTIC lc_not_adj_cam_ivvt_in[0] "Inlet camshaft: 0 = with adjustement; 1 = without adjustement" VALUE 0xa080c5bc _REC_VAL_20_u1 1. _CNV_A_R_LINEAR_____0_CM 0. 1. DISPLAY_IDENTIFIER LC_NOT_ADJ_CAM_IVVT_IN[0] FORMAT "%2.0" /end CHARACTERISTIC
/begin CHARACTERISTIC lc_not_adj_cam_ivvt_in[1] "Inlet camshaft: 0 = with adjustement; 1 = without adjustement" VALUE 0xa080c5bd _REC_VAL_20_u1 1. _CNV_A_R_LINEAR_____0_CM 0. 1. DISPLAY_IDENTIFIER LC_NOT_ADJ_CAM_IVVT_IN[1] FORMAT "%2.0" /end CHARACTERISTIC
/begin CHARACTERISTIC c_cam_ini_in "valve spread angle inlet camshafts with IVVT passive" VALUE 0xa080ba9e _REC_VAL_20_u1 95.625 _CNV_A_R_LINEAR_____545_CM 60. 155.625 DISPLAY_IDENTIFIER C_CAM_INI_IN FORMAT "%5.1" /end CHARACTERISTIC
/begin CHARACTERISTIC c_cam_ini_ex "valve spread angle exhaust camshaft  with IVVT passive" VALUE 0xa080ba9d _REC_VAL_20_u1 -95.625 _CNV_A_R_LINEAR_____544_CM -40. -135.625 DISPLAY_IDENTIFIER C_CAM_INI_EX FORMAT "%5.1" /end CHARACTERISTIC
/begin MEASUREMENT cam_sp_ivvt_in "Inlet CAM setpoint for VVTI" SWORD _CNV_A_R_LINEAR_____546_CM 1 100. -3276.8 3276.7 DISPLAY_IDENTIFIER CAM_SP_IVVT_IN ECU_ADDRESS 0xd000a380 FORMAT "%7.2" /end MEASUREMENT
/begin MEASUREMENT cam_sp_ivvt_ex "Exhaust CAM setpoint for VVTI" SWORD _CNV_A_R_LINEAR_____546_CM 1 100. -3276.8 3276.7 DISPLAY_IDENTIFIER CAM_SP_IVVT_EX ECU_ADDRESS 0xd000a382 FORMAT "%7.2" /end MEASUREMENT
/begin MEASUREMENT cam_sp_ref_in "Inlet camshaft target spread at reference conditions (warm engine)" SWORD _CNV_A_R_LINEAR_____546_CM 1 100. -3276.8 3276.7 DISPLAY_IDENTIFIER CAM_SP_REF_IN ECU_ADDRESS 0xd000a378 FORMAT "%7.2" /end MEASUREMENT
/begin MEASUREMENT cam_sp_ref_ex "Exhaust camshaft target spread at reference conditions (warm engine)" SWORD _CNV_A_R_LINEAR_____546_CM 1 100. -3276.8 3276.7 DISPLAY_IDENTIFIER CAM_SP_REF_EX ECU_ADDRESS 0xd000a37a FORMAT "%7.2" /end MEASUREMENT
/begin MEASUREMENT cam_in_h[0] "Actual position inlet CAM VVTI" SWORD _CNV_A_R_LINEAR_____546_CM 1 100. -3276.8 3276.7 DISPLAY_IDENTIFIER CAM_IN_H[1] ECU_ADDRESS 0xd000a37c FORMAT "%7.2" /end MEASUREMENT
/begin MEASUREMENT cam_in_h[1] "Actual position inlet CAM VVTI" SWORD _CNV_A_R_LINEAR_____546_CM 1 100. -3276.8 3276.7 DISPLAY_IDENTIFIER CAM_IN_H[2] ECU_ADDRESS 0xd000a37e FORMAT "%7.2" /end MEASUREMENT
/begin MEASUREMENT lv_vb_cdn_obd_1 "Boolean for battery voltage conditionf fulfilled for OBD-I diagnosis" UBYTE _CNV_S_2_RANGE__0___1_CM 1 100. 0. 1. DISPLAY_IDENTIFIER LV_VB_CDN_OBD_1 ECU_ADDRESS 0xd0008794 /end MEASUREMENT
/begin MEASUREMENT lv_vb_cdn_obd_2 "Boolean for battery voltage conditionf fulfilled for OBD-II diagnosis" UBYTE _CNV_S_2_RANGE__0___1_CM 1 100. 0. 1. DISPLAY_IDENTIFIER LV_VB_CDN_OBD_2 ECU_ADDRESS 0xd0008795 /end MEASUREMENT
/begin MEASUREMENT lamb_min "minimum value lambda in multiple-branched exhaust gas lines" UWORD _CNV_A_R_LINEAR_____129_CM 1 100. 0. 31.9990234375 DISPLAY_IDENTIFIER LAMB_MIN ECU_ADDRESS 0xd000a274 FORMAT "%7.4" /end MEASUREMENT
/begin MEASUREMENT lv_lamb_puls_dyn_diag "Request forced stimulation parameters specific for the WRAF sensor dynmaic" UBYTE _CNV_S_2_RANGE__0___1_CM 1 100. 0. 1. DISPLAY_IDENTIFIER LV_LAMB_PULS_DYN_DIAG ECU_ADDRESS 0xd00086f8 /end MEASUREMENT
/begin MEASUREMENT lv_err_ls_up_dyn_vld_1 "Boolean flag indicating the validation of correspondent symptom" UBYTE _CNV_S_2_RANGE__0___1_CM 1 100. 0. 1. DISPLAY_IDENTIFIER LV_ERR_LS_UP_DYN_VLD_1 ECU_ADDRESS 0xd00086f9 BIT_MASK 0x1 /end MEASUREMENT
/begin MEASUREMENT lv_err_ls_up_dyn_vld_2 "Boolean flag indicating the validation of correspondent symptom" UBYTE _CNV_S_2_RANGE__0___1_CM 1 100. 0. 1. DISPLAY_IDENTIFIER LV_ERR_LS_UP_DYN_VLD_2 ECU_ADDRESS 0xd00086fb BIT_MASK 0x1 /end MEASUREMENT
/begin MEASUREMENT lamb_mv "mean value lambda in multiple-branched exhaust gas lines" UWORD _CNV_A_R_LINEAR_____129_CM 1 100. 0. 31.9990234375 DISPLAY_IDENTIFIER LAMB_MV ECU_ADDRESS 0xd000a276 FORMAT "%7.4" /end MEASUREMENT
/begin MEASUREMENT lv_lsl_ofs_puls_1 "Request" UBYTE _CNV_S_2_RANGE__0___1_CM 1 100. 0. 1. DISPLAY_IDENTIFIER LV_LSL_OFS_PULS_1 ECU_ADDRESS 0xd00086fa BIT_MASK 0x1 /end MEASUREMENT
/begin MEASUREMENT lv_lsl_ofs_puls_2 "Request" UBYTE _CNV_S_2_RANGE__0___1_CM 1 100. 0. 1. DISPLAY_IDENTIFIER LV_LSL_OFS_PULS_2 ECU_ADDRESS 0xd00086fc BIT_MASK 0x1 /end MEASUREMENT
/begin MEASUREMENT vls_down_min_dc[0] "Min Voltage Value in a DC" UWORD _CNV_A_R_LINEAR_____224_CM 1 100. 0. 4.995 DISPLAY_IDENTIFIER VLS_DOWN_MIN_DC[1] ECU_ADDRESS 0xd000a278 FORMAT "%5.3" /end MEASUREMENT
/begin MEASUREMENT vls_down_min_dc[1] "Min Voltage Value in a DC" UWORD _CNV_A_R_LINEAR_____224_CM 1 100. 0. 4.995 DISPLAY_IDENTIFIER VLS_DOWN_MIN_DC[2] ECU_ADDRESS 0xd000a27a FORMAT "%5.3" /end MEASUREMENT
/begin MEASUREMENT vls_down_max_dc[0] "Max Voltage Value in a DC" UWORD _CNV_A_R_LINEAR_____224_CM 1 100. 0. 4.995 DISPLAY_IDENTIFIER VLS_DOWN_MAX_DC[1] ECU_ADDRESS 0xd000a27c FORMAT "%5.3" /end MEASUREMENT
/begin MEASUREMENT vls_down_max_dc[1] "Max Voltage Value in a DC" UWORD _CNV_A_R_LINEAR_____224_CM 1 100. 0. 4.995 DISPLAY_IDENTIFIER VLS_DOWN_MAX_DC[2] ECU_ADDRESS 0xd000a27e FORMAT "%5.3" /end MEASUREMENT
/begin MEASUREMENT lv_mff_ad_end "logical value indicating temporary end of lambda adaptation" UBYTE _CNV_S_2_RANGE__0___1_CM 1 100. 0. 1. DISPLAY_IDENTIFIER LV_MFF_AD_END ECU_ADDRESS 0xd00086cc BIT_MASK 0x1 /end MEASUREMENT
/begin MEASUREMENT lv_mff_ad_cdn "flag for time scheduler indicating good conditions for lambda adaptation" UBYTE _CNV_S_2_RANGE__0___1_CM 1 100. 0. 1. DISPLAY_IDENTIFIER LV_MFF_AD_CDN ECU_ADDRESS 0xd00086cd BIT_MASK 0x1 /end MEASUREMENT
/begin MEASUREMENT vls_cyl[0] "upstream oxygen sensor acquisition (cylinder individual)" UWORD _CNV_A_R_LINEAR_____2_CM 1 100. 0. 4.9951171875 DISPLAY_IDENTIFIER VLS_CYL_0 ECU_ADDRESS 0xd000a254 FORMAT "%5.3" /end MEASUREMENT
/begin MEASUREMENT vls_cyl[1] "upstream oxygen sensor acquisition (cylinder individual)" UWORD _CNV_A_R_LINEAR_____2_CM 1 100. 0. 4.9951171875 DISPLAY_IDENTIFIER VLS_CYL_1 ECU_ADDRESS 0xd000a256 FORMAT "%5.3" /end MEASUREMENT
/begin MEASUREMENT vls_cyl[2] "upstream oxygen sensor acquisition (cylinder individual)" UWORD _CNV_A_R_LINEAR_____2_CM 1 100. 0. 4.9951171875 DISPLAY_IDENTIFIER VLS_CYL_2 ECU_ADDRESS 0xd000a258 FORMAT "%5.3" /end MEASUREMENT
/begin MEASUREMENT vls_cyl[3] "upstream oxygen sensor acquisition (cylinder individual)" UWORD _CNV_A_R_LINEAR_____2_CM 1 100. 0. 4.9951171875 DISPLAY_IDENTIFIER VLS_CYL_3 ECU_ADDRESS 0xd000a25a FORMAT "%5.3" /end MEASUREMENT
/begin MEASUREMENT vls_cyl[4] "upstream oxygen sensor acquisition (cylinder individual)" UWORD _CNV_A_R_LINEAR_____2_CM 1 100. 0. 4.9951171875 DISPLAY_IDENTIFIER VLS_CYL_4 ECU_ADDRESS 0xd000a25c FORMAT "%5.3" /end MEASUREMENT
/begin MEASUREMENT vls_cyl[5] "upstream oxygen sensor acquisition (cylinder individual)" UWORD _CNV_A_R_LINEAR_____2_CM 1 100. 0. 4.9951171875 DISPLAY_IDENTIFIER VLS_CYL_5 ECU_ADDRESS 0xd000a25e FORMAT "%5.3" /end MEASUREMENT
/begin MEASUREMENT vls_cyl[6] "upstream oxygen sensor acquisition (cylinder individual)" UWORD _CNV_A_R_LINEAR_____2_CM 1 100. 0. 4.9951171875 DISPLAY_IDENTIFIER VLS_CYL[6] ECU_ADDRESS 0xd000a260 FORMAT "%5.3" /end MEASUREMENT
/begin MEASUREMENT vls_cyl[7] "upstream oxygen sensor acquisition (cylinder individual)" UWORD _CNV_A_R_LINEAR_____2_CM 1 100. 0. 4.9951171875 DISPLAY_IDENTIFIER VLS_CYL[7] ECU_ADDRESS 0xd000a262 FORMAT "%5.3" /end MEASUREMENT
/begin MEASUREMENT vls_cyl_trig[0] "cylinder selective update counter for trigger event" UBYTE _CNV_A_R_LINEAR_____0_CM 1 100. 0. 255. DISPLAY_IDENTIFIER VLS_CYL_TRIG_0 ECU_ADDRESS 0xd00086d8 FORMAT "%3.0" /end MEASUREMENT
/begin MEASUREMENT vls_cyl_trig[1] "cylinder selective update counter for trigger event" UBYTE _CNV_A_R_LINEAR_____0_CM 1 100. 0. 255. DISPLAY_IDENTIFIER VLS_CYL_TRIG_1 ECU_ADDRESS 0xd00086d9 FORMAT "%3.0" /end MEASUREMENT
/begin MEASUREMENT vls_cyl_trig[2] "cylinder selective update counter for trigger event" UBYTE _CNV_A_R_LINEAR_____0_CM 1 100. 0. 255. DISPLAY_IDENTIFIER VLS_CYL_TRIG_2 ECU_ADDRESS 0xd00086da FORMAT "%3.0" /end MEASUREMENT
/begin MEASUREMENT vls_cyl_trig[3] "cylinder selective update counter for trigger event" UBYTE _CNV_A_R_LINEAR_____0_CM 1 100. 0. 255. DISPLAY_IDENTIFIER VLS_CYL_TRIG_3 ECU_ADDRESS 0xd00086db FORMAT "%3.0" /end MEASUREMENT
/begin MEASUREMENT vls_cyl_trig[4] "cylinder selective update counter for trigger event" UBYTE _CNV_A_R_LINEAR_____0_CM 1 100. 0. 255. DISPLAY_IDENTIFIER VLS_CYL_TRIG_4 ECU_ADDRESS 0xd00086dc FORMAT "%3.0" /end MEASUREMENT
/begin MEASUREMENT vls_cyl_trig[5] "cylinder selective update counter for trigger event" UBYTE _CNV_A_R_LINEAR_____0_CM 1 100. 0. 255. DISPLAY_IDENTIFIER VLS_CYL_TRIG_5 ECU_ADDRESS 0xd00086dd FORMAT "%3.0" /end MEASUREMENT
/begin MEASUREMENT vls_cyl_trig[6] "cylinder selective update counter for trigger event" UBYTE _CNV_A_R_LINEAR_____0_CM 1 100. 0. 255. DISPLAY_IDENTIFIER VLS_CYL_TRIG[6] ECU_ADDRESS 0xd00086de FORMAT "%3.0" /end MEASUREMENT
/begin MEASUREMENT vls_cyl_trig[7] "cylinder selective update counter for trigger event" UBYTE _CNV_A_R_LINEAR_____0_CM 1 100. 0. 255. DISPLAY_IDENTIFIER VLS_CYL_TRIG[7] ECU_ADDRESS 0xd00086df FORMAT "%3.0" /end MEASUREMENT
/begin CHARACTERISTIC lc_fac_lam_ad_out_bal_man "Manual adjustment off full mass set point factor for cylinder balancing" VALUE 0xa080c56b _REC_VAL_20_u1 1. _CNV_A_R_LINEAR_____0_CM 0. 1. DISPLAY_IDENTIFIER LC_FAC_LAM_AD_OUT_BAL_MAN FORMAT "%1.0" /end CHARACTERISTIC
/begin MEASUREMENT fac_lam_mv "mean value of lambda controller output bank 1 and bank 2" SWORD _CNV_A_R_LINEAR_____113_CM 1 100. -50. 49.9984741210938 DISPLAY_IDENTIFIER FAC_LAM_MV ECU_ADDRESS 0xd000a264 FORMAT "%7.3" /end MEASUREMENT
/begin MEASUREMENT fac_lam_pctl_cus[0] "pre control path correction" SWORD _CNV_A_R_LINEAR_____113_CM 1 100. -50. 49.9984741210938 DISPLAY_IDENTIFIER FAC_LAM_PCTL_CUS[1] ECU_ADDRESS 0xd000a266 FORMAT "%7.3" /end MEASUREMENT
/begin MEASUREMENT fac_lam_pctl_cus[1] "pre control path correction" SWORD _CNV_A_R_LINEAR_____113_CM 1 100. -50. 49.9984741210938 DISPLAY_IDENTIFIER FAC_LAM_PCTL_CUS[2] ECU_ADDRESS 0xd000a268 FORMAT "%7.3" /end MEASUREMENT
/begin MEASUREMENT fac_lam_ad_bal[0] "Lambda adaption output to be used in the MFF correction" SWORD _CNV_A_R_LINEAR_____113_CM 1 100. -50. 49.9984741210938 DISPLAY_IDENTIFIER FAC_LAM_AD_BAL[1] ECU_ADDRESS 0xd000a26a FORMAT "%7.3" /end MEASUREMENT
/begin MEASUREMENT fac_lam_ad_bal[1] "Lambda adaption output to be used in the MFF correction" SWORD _CNV_A_R_LINEAR_____113_CM 1 100. -50. 49.9984741210938 DISPLAY_IDENTIFIER FAC_LAM_AD_BAL[2] ECU_ADDRESS 0xd000a26c FORMAT "%7.3" /end MEASUREMENT
/begin MEASUREMENT lv_lam_ad_ext "Logical variable indicating that Lambda Adaptation is carried out outside from LACO" UBYTE _CNV_S_2_RANGE__0___1_CM 1 100. 0. 1. DISPLAY_IDENTIFIER LV_LAM_AD_EXT ECU_ADDRESS 0xd00086d0 BIT_MASK 0x1 /end MEASUREMENT
/begin CHARACTERISTIC lc_lam_ad_ext "Logical switch between LACO internal (=0) and external (=1) Lambda Adaptation source" VALUE 0xa080c59c _REC_VAL_20_u1 1. _CNV_A_R_LINEAR_____0_CM 0. 1. DISPLAY_IDENTIFIER LC_LAM_AD_EXT FORMAT "%1.0" /end CHARACTERISTIC
/begin MEASUREMENT lv_fac_l_rng_lim_min_ext_lam_ad[0] "Flag indicating Lambda Adaptation external to LACO is under its min. limit threshold" UBYTE _CNV_S_2_RANGE__0___1_CM 1 100. 0. 1. DISPLAY_IDENTIFIER LV_FAC_L_RNG_LIM_MIN_EXT_LAM_AD[1] ECU_ADDRESS 0xd00086d2 BIT_MASK 0x1 /end MEASUREMENT
/begin MEASUREMENT lv_fac_l_rng_lim_min_ext_lam_ad[1] "Flag indicating Lambda Adaptation external to LACO is under its min. limit threshold" UBYTE _CNV_S_2_RANGE__0___1_CM 1 100. 0. 1. DISPLAY_IDENTIFIER LV_FAC_L_RNG_LIM_MIN_EXT_LAM_AD[2] ECU_ADDRESS 0xd00086d3 BIT_MASK 0x1 /end MEASUREMENT
/begin MEASUREMENT lv_fac_l_rng_lim_max_ext_lam_ad[0] "Flag indicating Lambda Adaptation external to LACO is under its min. limit threshold" UBYTE _CNV_S_2_RANGE__0___1_CM 1 100. 0. 1. DISPLAY_IDENTIFIER LV_FAC_L_RNG_LIM_MAX_EXT_LAM_AD[1] ECU_ADDRESS 0xd00086d4 BIT_MASK 0x1 /end MEASUREMENT
/begin MEASUREMENT lv_fac_l_rng_lim_max_ext_lam_ad[1] "Flag indicating Lambda Adaptation external to LACO is under its min. limit threshold" UBYTE _CNV_S_2_RANGE__0___1_CM 1 100. 0. 1. DISPLAY_IDENTIFIER LV_FAC_L_RNG_LIM_MAX_EXT_LAM_AD[2] ECU_ADDRESS 0xd00086d5 BIT_MASK 0x1 /end MEASUREMENT
/begin CHARACTERISTIC lc_fac_lam_lim_fil_ena "Logical switch to enable filtering of the lambda controller output" VALUE 0xa080c56e _REC_VAL_20_u1 1. _CNV_A_R_LINEAR_____0_CM 0. 1. DISPLAY_IDENTIFIER LC_FAC_LAM_LIM_FIL_ENA FORMAT "%1.0" /end CHARACTERISTIC
/begin AXIS_PTS ldp_n_ip_crlc_fac_lam_lim_fil "" 0xa0808b30 n _REC_AXS_20_u2 8160. _CNV_A_R_LINEAR_____14_CM 8 0. 8160. FORMAT "%4.0" /end AXIS_PTS
/begin AXIS_PTS ldp_maf_ip_crlc_fac_lam_lim_fil "" 0xa0808830 maf _REC_AXS_20_u2 1389. _CNV_A_R_LINEAR_____111_CM 8 0. 1389. FORMAT "%7.2" /end AXIS_PTS
/begin CHARACTERISTIC ip_crlc_fac_lam_lim_fil "Correlation constant for liltering the lambda controller output" MAP 0xa080a05c _REC_MAP_20_u1_u2_u2 0.99609375 _CNV_A_R_LINEAR_____28_CM 0. 0.99609375 DISPLAY_IDENTIFIER IP_CRLC_FAC_LAM_LIM_FIL FORMAT "%5.3"
 /begin AXIS_DESCR COM_AXIS n _CNV_A_R_LINEAR_____14_CM 8 0. 8160. FORMAT "%4.0" AXIS_PTS_REF ldp_n_ip_crlc_fac_lam_lim_fil /end AXIS_DESCR
 /begin AXIS_DESCR COM_AXIS maf _CNV_A_R_LINEAR_____111_CM 8 0. 1389. FORMAT "%7.2" AXIS_PTS_REF ldp_maf_ip_crlc_fac_lam_lim_fil /end AXIS_DESCR
/end CHARACTERISTIC
/begin MEASUREMENT lv_map_puc_lim_act_lsl_gain_ad "Logical variable is set if MAP limitation is activated" UBYTE _CNV_S_2_RANGE__0___1_CM 1 100. 0. 1. DISPLAY_IDENTIFIER LV_MAP_PUC_LIM_ACT_LSL_GAIN_AD ECU_ADDRESS 0xd00087a4 BIT_MASK 0x1 /end MEASUREMENT
/begin MEASUREMENT tqi_av "Actual indicated engine torque" SWORD _CNV_A_R_LINEAR_____31_CM 1 100. -1024. 1023.96875 DISPLAY_IDENTIFIER TQI_AV ECU_ADDRESS 0xd000a374 FORMAT "%6.2" /end MEASUREMENT
/begin MEASUREMENT fac_tq_req_driv "scaling factor for requested torque at clutch from driver" UWORD _CNV_A_R_LINEAR_____9_CM 1 100. 0. 1.99996948242188 DISPLAY_IDENTIFIER FAC_TQ_REQ_DRIV ECU_ADDRESS 0xd000a140 FORMAT "%7.5" /end MEASUREMENT
/begin MEASUREMENT fac_tq_req "Torque factor from pedal value interpretation and cruise control" UWORD _CNV_A_R_LINEAR_____9_CM 1 100. 0. 1.99996948242188 DISPLAY_IDENTIFIER FAC_TQ_REQ ECU_ADDRESS 0xd000a142 FORMAT "%7.5" /end MEASUREMENT
/begin MEASUREMENT fac_tq_req_clu "Torque scaling factor for calculation requested torque at clutch" UWORD _CNV_A_R_LINEAR_____9_CM 1 100. 0. 1.99996948242188 DISPLAY_IDENTIFIER FAC_TQ_REQ_CLU ECU_ADDRESS 0xd000a144 FORMAT "%7.5" /end MEASUREMENT
/begin MEASUREMENT fac_tq_req_clu_ldm "Torque scaling factor for calculation requested torque at clutch for LDM" UWORD _CNV_A_R_LINEAR_____9_CM 1 100. 0. 1.99996948242188 DISPLAY_IDENTIFIER FAC_TQ_REQ_CLU_LDM ECU_ADDRESS 0xd000a146 FORMAT "%7.5" /end MEASUREMENT
/begin MEASUREMENT lv_rng_l_req "Activation condition for low-range-mode" UBYTE _CNV_S_2_RANGE__0___1_CM 1 100. 0. 1. DISPLAY_IDENTIFIER LV_RNG_L_REQ ECU_ADDRESS 0xd0008688 BIT_MASK 0x1 /end MEASUREMENT
/begin MEASUREMENT lv_ldm_disable_can "Logical variable for disabling LDM intervention due to CAN error" UBYTE _CNV_S_2_RANGE__0___1_CM 1 100. 0. 1. DISPLAY_IDENTIFIER LV_LDM_DISABLE_CAN ECU_ADDRESS 0xd0008eb6 BIT_MASK 0x1 /end MEASUREMENT
/begin MEASUREMENT state_tq_ldm_plaus "Bitwise coded state for LDM intervention state" UBYTE _CNV_A_R_LINEAR_____0_CM 1 100. 0. 255. DISPLAY_IDENTIFIER STATE_TQ_LDM_PLAUS ECU_ADDRESS 0xd0008eb4 FORMAT "%3.0" /end MEASUREMENT
/begin MEASUREMENT tq_wheel_ldm_req "Torque increase for torque intervention during LDM" SWORD _CNV_A_R_LINEAR_____64_CM 1 100. -32768. 32767. DISPLAY_IDENTIFIER TQ_WHEEL_LDM_REQ ECU_ADDRESS 0xd0001778 FORMAT "%6.0" /end MEASUREMENT
/begin MEASUREMENT tq_sp_wheel "Torque increase for fast torque intervention during LDM" SWORD _CNV_A_R_LINEAR_____64_CM 1 100. -32768. 32767. DISPLAY_IDENTIFIER TQ_SP_WHEEL ECU_ADDRESS 0xd000ab24 FORMAT "%6.0" /end MEASUREMENT
/begin MEASUREMENT lv_ldm_ena "Logical variable for increased torque intervention due to LDM" UBYTE _CNV_S_2_RANGE__0___1_CM 1 100. 0. 1. DISPLAY_IDENTIFIER LV_LDM_ENA ECU_ADDRESS 0xd0008eb7 BIT_MASK 0x1 /end MEASUREMENT
/begin MEASUREMENT lv_ldm_act "Logical variable for torque intervention due to LDM" UBYTE _CNV_S_2_RANGE__0___1_CM 1 100. 0. 1. DISPLAY_IDENTIFIER LV_LDM_ACT ECU_ADDRESS 0xd0008eb5 BIT_MASK 0x1 /end MEASUREMENT
/begin MEASUREMENT lv_ldm_lih "Logical variable for torque intervention LIH due to LDM" UBYTE _CNV_S_2_RANGE__0___1_CM 1 100. 0. 1. DISPLAY_IDENTIFIER LV_LDM_LIH ECU_ADDRESS 0xd0008eb9 BIT_MASK 0x1 /end MEASUREMENT
/begin MEASUREMENT t_ldm_lih_ctr "Time counter delay time" UBYTE _CNV_A_R_LINEAR_____3_CM 1 100. 0. 2.55 DISPLAY_IDENTIFIER T_LDM_LIH_CTR ECU_ADDRESS 0xd0001780 FORMAT "%4.2" /end MEASUREMENT
/begin CHARACTERISTIC c_lgrd_lih_ldm "Limiting gradient for LDM emergency ramp function" VALUE 0xa080be12 _REC_VAL_20_u2 1023.96875 _CNV_A_R_LINEAR_____187_CM 0. 1023.96875 DISPLAY_IDENTIFIER C_LGRD_LIH_LDM FORMAT "%7.2" /end CHARACTERISTIC
/begin CHARACTERISTIC c_t_dly_lih_ldm "Delay time for activation of LDM emergency ramp function" VALUE 0xa080c17e _REC_VAL_20_u1 2.55 _CNV_A_R_LINEAR_____3_CM 0. 2.55 DISPLAY_IDENTIFIER C_T_DLY_LIH_LDM FORMAT "%4.2" /end CHARACTERISTIC
/begin MEASUREMENT lv_ldm_puc_inh "Logical variable for PUC-inhibit due to LDM" UBYTE _CNV_S_2_RANGE__0___1_CM 1 100. 0. 1. DISPLAY_IDENTIFIER LV_LDM_PUC_INH ECU_ADDRESS 0xd0008eb8 BIT_MASK 0x1 /end MEASUREMENT
/begin CHARACTERISTIC c_state_di_puc_act "State disable IS/PU/PUC engine states" VALUE 0xa080c0e0 _REC_VAL_20_u1 3. _CNV_A_R_LINEAR_____0_CM 0. 3. DISPLAY_IDENTIFIER C_STATE_DI_PUC_ACT FORMAT "%1.0" /end CHARACTERISTIC
/begin CHARACTERISTIC lc_ldm_off_clu "Switch for using LDM clutch info to deactivate LDM torque intervention" VALUE 0xa080c5a6 _REC_VAL_20_u1 1. _CNV_S_2_RANGE__0___1_CM 0. 1. DISPLAY_IDENTIFIER LC_LDM_OFF_CLU /end CHARACTERISTIC
/begin MEASUREMENT lv_tqi_req_can_inh "general flag for inhibition of external torque requests" UBYTE _CNV_S_2_RANGE__0___1_CM 1 100. 0. 1. DISPLAY_IDENTIFIER LV_TQI_REQ_CAN_INH ECU_ADDRESS 0xd0008ee4 BIT_MASK 0x1 /end MEASUREMENT
/begin AXIS_PTS ldp_ang_pste_stnd__tq_loss_mon "" 0xa080c66c ang_pste_stnd _REC_AXS_20_u2 199.99694824 _CNV_A_R_LINEAR_____263_CM 6 -100. 99.99694824 FORMAT "%8.3" /end AXIS_PTS
/begin AXIS_PTS ldp_vs_mon__tq_loss_mon "" 0xa080c8b8 vs_mon _REC_AXS_20_u2 511.99218 _CNV_A_R_LINEAR_____86_CM 6 0. 511.99218 FORMAT "%7.3" /end AXIS_PTS
/begin CHARACTERISTIC ip_tq_loss_pste_2_min_mon "Power steering torque loss versus engine-speed" MAP 0xa080cfa4 _REC_MAP_20_u2_u2_u2 1024. _CNV_A_R_LINEAR_____87_CM -1024. 0. DISPLAY_IDENTIFIER IP_TQ_LOSS_PSTE_2_MIN_MON FORMAT "%6.2"
 /begin AXIS_DESCR COM_AXIS vs_mon _CNV_A_R_LINEAR_____86_CM 6 0. 511.99218 FORMAT "%7.3" AXIS_PTS_REF ldp_vs_mon__tq_loss_mon /end AXIS_DESCR
 /begin AXIS_DESCR COM_AXIS ang_pste_stnd _CNV_A_R_LINEAR_____263_CM 6 -100. 99.99694824 FORMAT "%8.3" AXIS_PTS_REF ldp_ang_pste_stnd__tq_loss_mon /end AXIS_DESCR
/end CHARACTERISTIC
/begin MEASUREMENT opm_req_cus "Actual engine operation mode ( 16bit )" UWORD _CNV_A_R_LINEAR_____0_CM 1 100. 0. 65535. DISPLAY_IDENTIFIER OPM_REQ_CUS ECU_ADDRESS 0xd000a14c FORMAT "%5.0" /end MEASUREMENT
/begin MEASUREMENT lv_nt_so2p_ext_adj_act "NOx trap desulfation started by external adjustment is active" UBYTE _CNV_S_2_RANGE__0___1_CM 1 100. 0. 1. DISPLAY_IDENTIFIER LV_NT_SO2P_EXT_ADJ_ACT ECU_ADDRESS 0xd00074ac /end MEASUREMENT
/begin COMPU_METHOD _CNV_A_R_LINEAR_____0_CM "" RAT_FUNC "%6.3" "-" COEFFS 0 1. 0. 0 0 1 /end COMPU_METHOD
/begin COMPU_METHOD _CNV_S_2_RANGE__0___1_CM "" TAB_VERB "%6.3" "-" COMPU_TAB_REF _CNV_S_2_RANGE__0___1 /end COMPU_METHOD
/begin COMPU_VTAB _CNV_S_2_RANGE__0___1 "" TAB_VERB 2 0 "0" 1 "1" /end COMPU_VTAB
/begin COMPU_METHOD _CNV_A_R_LINEAR_____2_CM "" RAT_FUNC "%6.3" "V" COEFFS 0 204.8 0. 0 0 1 /end COMPU_METHOD
/begin COMPU_METHOD _CNV_A_R_LINEAR_____3_CM "" RAT_FUNC "%6.3" "s" COEFFS 0 100. 0. 0 0 1 /end COMPU_METHOD
/begin COMPU_METHOD _CNV_A_R_LINEAR_____6_CM "" RAT_FUNC "%6.3" "km/h" COEFFS 0 1. 0. 0 0 1 /end COMPU_METHOD
/begin COMPU_METHOD _CNV_A_R_LINEAR_____9_CM "" RAT_FUNC "%6.3" "-" COEFFS 0 32767.99999999992 0. 0 0 1 /end COMPU_METHOD
/begin COMPU_METHOD _CNV_A_R_LINEAR_____10_CM "" RAT_FUNC "%6.3" "rpm" COEFFS 0 3.125e-002 0. 0 0 1 /end COMPU_METHOD
/begin COMPU_METHOD _CNV_A_R_LINEAR_____14_CM "" RAT_FUNC "%6.3" "rpm" COEFFS 0 1. 0. 0 0 1 /end COMPU_METHOD
/begin COMPU_METHOD _CNV_A_R_LINEAR_____17_CM "" RAT_FUNC "%6.3" "°C" COEFFS 0 1.333333333333333 64. 0 0 1 /end COMPU_METHOD
/begin COMPU_METHOD _CNV_A_R_LINEAR_____20_CM "" RAT_FUNC "%6.3" "ms" COEFFS 0 0.1 0. 0 0 1 /end COMPU_METHOD
/begin COMPU_METHOD _CNV_A_R_LINEAR_____24_CM "" RAT_FUNC "%6.3" "-" COEFFS 0 16384. 0. 0 0 1 /end COMPU_METHOD
/begin COMPU_METHOD _CNV_A_R_LINEAR_____26_CM "" RAT_FUNC "%6.3" "°C" COEFFS 0 1. 40. 0 0 1 /end COMPU_METHOD
/begin COMPU_METHOD _CNV_A_R_LINEAR_____28_CM "" RAT_FUNC "%6.3" "-" COEFFS 0 256. 0. 0 0 1 /end COMPU_METHOD
/begin COMPU_METHOD _CNV_A_R_LINEAR_____29_CM "" RAT_FUNC "%6.3" "rpm/s" COEFFS 0 3.125e-002 128. 0 0 1 /end COMPU_METHOD
/begin COMPU_METHOD _CNV_A_R_LINEAR_____31_CM "" RAT_FUNC "%6.3" "Nm" COEFFS 0 32. 0. 0 0 1 /end COMPU_METHOD
/begin COMPU_METHOD _CNV_A_R_LINEAR_____50_CM "" RAT_FUNC "%6.3" "" COEFFS 0 1. 0. 0 0 1 /end COMPU_METHOD
/begin COMPU_METHOD _CNV_A_R_LINEAR_____58_CM "" RAT_FUNC "%6.3" "km" COEFFS 0 0.1 0. 0 0 1 /end COMPU_METHOD
/begin COMPU_METHOD _CNV_A_R_LINEAR_____64_CM "" RAT_FUNC "%6.3" "Nm" COEFFS 0 1. 0. 0 0 1 /end COMPU_METHOD
/begin COMPU_METHOD _CNV_S_2_RANGE______76_CM "" TAB_VERB "%6.3" "" COMPU_TAB_REF _CNV_S_2_RANGE______76 /end COMPU_METHOD
/begin COMPU_VTAB _CNV_S_2_RANGE______76 "" TAB_VERB 2 0 "0" 1 "1" /end COMPU_VTAB
/begin COMPU_METHOD _CNV_A_R_LINEAR_____86_CM "" RAT_FUNC "%6.3" "km/h" COEFFS 0 128.0000018750286 0. 0 0 1 /end COMPU_METHOD
/begin COMPU_METHOD _CNV_A_R_LINEAR_____87_CM "" RAT_FUNC "%6.3" "Nm" COEFFS 0 32. 32768. 0 0 1 /end COMPU_METHOD
/begin COMPU_METHOD _CNV_A_R_LINEAR_____89_CM "" RAT_FUNC "%6.3" "-" COEFFS 0 65535.99999999996 0. 0 0 1 /end COMPU_METHOD
/begin COMPU_METHOD _CNV_A_R_LINEAR_____100_CM "" RAT_FUNC "%6.3" "-" COEFFS 0 127.9991955827809 0. 0 0 1 /end COMPU_METHOD
/begin COMPU_METHOD _CNV_A_R_LINEAR_____111_CM "" RAT_FUNC "%6.3" "mg/stk" COEFFS 0 47.18142548596112 0. 0 0 1 /end COMPU_METHOD
/begin COMPU_METHOD _CNV_A_R_LINEAR_____113_CM "" RAT_FUNC "%6.3" "%" COEFFS 0 655.3599999999997 -1.455191522836685e-011 0 0 1 /end COMPU_METHOD
/begin COMPU_METHOD _CNV_A_R_LINEAR_____129_CM "" RAT_FUNC "%6.3" "-" COEFFS 0 1024. 0. 0 0 1 /end COMPU_METHOD
/begin COMPU_METHOD _CNV_A_R_LINEAR_____185_CM "" RAT_FUNC "%6.3" "" COEFFS 0 256. 0. 0 0 1 /end COMPU_METHOD
/begin COMPU_METHOD _CNV_S_4_STATE_AMT__186_CM "" TAB_VERB "%6.3" "" COMPU_TAB_REF _CNV_S_4_STATE_AMT__186 /end COMPU_METHOD
/begin COMPU_VTAB _CNV_S_4_STATE_AMT__186 "" TAB_VERB 4 0 "NO" 1 "DEC" 2 "INC" 3 "DEC_INC" /end COMPU_VTAB
/begin COMPU_METHOD _CNV_A_R_LINEAR_____187_CM "" RAT_FUNC "%6.3" "Nm/10ms" COEFFS 0 32. 0. 0 0 1 /end COMPU_METHOD
/begin COMPU_METHOD _CNV_A_R_LINEAR_____188_CM "" RAT_FUNC "%6.3" "°CRK" COEFFS 0 16. 0. 0 0 1 /end COMPU_METHOD
/begin COMPU_METHOD _CNV_A_R_LINEAR_____190_CM "" RAT_FUNC "%6.3" "°CRK" COEFFS 0 2.666666666666667 95. 0 0 1 /end COMPU_METHOD
/begin COMPU_METHOD _CNV_A_R_LINEAR_____193_CM "" RAT_FUNC "%6.3" "rpm" COEFFS 0 1. 32768. 0 0 1 /end COMPU_METHOD
/begin COMPU_METHOD _CNV_A_R_LINEAR_____200_CM "" RAT_FUNC "%6.3" "°CRK" COEFFS 0 2.666666666666667 0. 0 0 1 /end COMPU_METHOD
/begin COMPU_METHOD _CNV_A_R_LINEAR_____211_CM "" RAT_FUNC "%6.3" "-" COEFFS 0 32768.00003968061 3.96806062781252e-005 0 0 1 /end COMPU_METHOD
/begin COMPU_METHOD _CNV_A_R_LINEAR_____212_CM "" RAT_FUNC "%6.3" "%" COEFFS 0 327.68 0. 0 0 1 /end COMPU_METHOD
/begin COMPU_METHOD _CNV_A_R_LINEAR_____213_CM "" RAT_FUNC "%6.3" "-" COEFFS 0 262144.1943071089 2.428838861669647e-002 0 0 1 /end COMPU_METHOD
/begin COMPU_METHOD _CNV_A_R_LINEAR_____214_CM "" RAT_FUNC "%6.3" "°C" COEFFS 0 16. 4370.4 0 0 1 /end COMPU_METHOD
/begin COMPU_METHOD _CNV_A_R_LINEAR_____224_CM "" RAT_FUNC "%6.3" "V" COEFFS 0 204.8048048048048 0. 0 0 1 /end COMPU_METHOD
/begin COMPU_METHOD _CNV_A_R_LINEAR_____225_CM "" RAT_FUNC "%6.3" "mg/stk" COEFFS 0 47.18070554355651 0. 0 0 1 /end COMPU_METHOD
/begin COMPU_METHOD _CNV_A_R_LINEAR_____229_CM "" RAT_FUNC "%6.3" "" COEFFS 0 65535. 0. 0 0 1 /end COMPU_METHOD
/begin COMPU_METHOD _CNV_A_R_LINEAR_____241_CM "" RAT_FUNC "%6.3" "-" COEFFS 0 2048. 0. 0 0 1 /end COMPU_METHOD
/begin COMPU_METHOD _CNV_A_R_LINEAR_____243_CM "" RAT_FUNC "%6.3" "" COEFFS 0 64. 0. 0 0 1 /end COMPU_METHOD
/begin COMPU_METHOD _CNV_A_R_LINEAR_____256_CM "" RAT_FUNC "%6.3" "m/s²" COEFFS 0 640. 32768. 0 0 1 /end COMPU_METHOD
/begin COMPU_METHOD _CNV_A_R_LINEAR_____257_CM "" RAT_FUNC "%6.3" "Nm/rpm*rpm" COEFFS 0 134293032.7868853 0. 0 0 1 /end COMPU_METHOD
/begin COMPU_METHOD _CNV_A_R_LINEAR_____258_CM "" RAT_FUNC "%6.3" "m/s²" COEFFS 0 2084.478388983038 32768.00027481336 0 0 1 /end COMPU_METHOD
/begin COMPU_METHOD _CNV_A_R_LINEAR_____259_CM "" RAT_FUNC "%6.3" "-" COEFFS 0 32768. 0. 0 0 1 /end COMPU_METHOD
/begin COMPU_METHOD _CNV_S_6_STATE_TQ_D_260_CM "" TAB_VERB "%6.3" "" COMPU_TAB_REF _CNV_S_6_STATE_TQ_D_260 /end COMPU_METHOD
/begin COMPU_VTAB _CNV_S_6_STATE_TQ_D_260 "" TAB_VERB 6 0 "0" 1 "1" 8 "2" 9 "3" 10 "4" 11 "5" /end COMPU_VTAB
/begin COMPU_METHOD _CNV_A_R_LINEAR_____261_CM "" RAT_FUNC "%6.3" "s" COEFFS 0 25. 0. 0 0 1 /end COMPU_METHOD
/begin COMPU_METHOD _CNV_A_R_LINEAR_____262_CM "" RAT_FUNC "%6.3" "Nm" COEFFS 0 0.5 0. 0 0 1 /end COMPU_METHOD
/begin COMPU_METHOD _CNV_A_R_LINEAR_____263_CM "" RAT_FUNC "%6.3" "%" COEFFS 0 327.680000003584 32768.00000035841 0 0 1 /end COMPU_METHOD
/begin COMPU_METHOD _CNV_A_R_LINEAR_____264_CM "" RAT_FUNC "%6.3" "-" COEFFS 0 64. 128. 0 0 1 /end COMPU_METHOD
/begin COMPU_METHOD _CNV_A_R_LINEAR_____265_CM "" RAT_FUNC "%6.3" "°STW/s" COEFFS 0 22.75571737399022 32768. 0 0 1 /end COMPU_METHOD
/begin COMPU_METHOD _CNV_A_R_LINEAR_____266_CM "" RAT_FUNC "%6.3" "-" COEFFS 0 64. 0. 0 0 1 /end COMPU_METHOD
/begin COMPU_METHOD _CNV_A_R_ENRD_LINEA_389_CM "" RAT_FUNC "%6.3" "-" COEFFS 0 255. 0. 0 0 1 /end COMPU_METHOD
/begin COMPU_METHOD _CNV_S_8_RANGE_STAT_450_CM "" TAB_VERB "%6.3" "-" COMPU_TAB_REF _CNV_S_8_RANGE_STAT_450 /end COMPU_METHOD
/begin COMPU_VTAB _CNV_S_8_RANGE_STAT_450 "" TAB_VERB 8 0 "no" 1 "ASR" 2 "MSR" 3 "GS_DEC" 4 "GS_INC" 5 "AMT_DEC" 6 "AMT_INC" 7 "DCC" /end COMPU_VTAB
/begin COMPU_METHOD _CNV_A_R_LINEAR_____451_CM "" RAT_FUNC "%6.3" "Nm" COEFFS 0 10. 0. 0 0 1 /end COMPU_METHOD
/begin COMPU_METHOD _CNV_A_R_LINEAR_____544_CM "" RAT_FUNC "%6.3" "°CRK" COEFFS 0 -2.666666666666667 -106.6666666666667 0 0 1 /end COMPU_METHOD
/begin COMPU_METHOD _CNV_A_R_LINEAR_____545_CM "" RAT_FUNC "%6.3" "°CRK" COEFFS 0 2.666666666666667 -160. 0 0 1 /end COMPU_METHOD
/begin COMPU_METHOD _CNV_A_R_LINEAR_____546_CM "" RAT_FUNC "%6.3" "°CRK" COEFFS 0 10. 0. 0 0 1 /end COMPU_METHOD
/begin RECORD_LAYOUT _REC_VAL_20_u1 FNC_VALUES 1 UBYTE COLUMN_DIR DIRECT /end RECORD_LAYOUT
/begin RECORD_LAYOUT _REC_VAL_20_u2 FNC_VALUES 1 UWORD COLUMN_DIR DIRECT /end RECORD_LAYOUT
/begin RECORD_LAYOUT _REC_AXS_20_u1 NO_AXIS_PTS_X 1 UBYTE AXIS_PTS_X 2 UBYTE INDEX_INCR DIRECT /end RECORD_LAYOUT
/begin RECORD_LAYOUT _REC_MAP_20_u2_u1_u1 FNC_VALUES 1 UWORD COLUMN_DIR DIRECT /end RECORD_LAYOUT
/begin RECORD_LAYOUT _REC_CUR_20_u1_u1 FNC_VALUES 1 UBYTE COLUMN_DIR DIRECT /end RECORD_LAYOUT
/begin RECORD_LAYOUT _REC_VAL_20_s2 FNC_VALUES 1 SWORD COLUMN_DIR DIRECT /end RECORD_LAYOUT
/begin RECORD_LAYOUT _REC_MAP_20_u2_u2_u1 FNC_VALUES 1 UWORD COLUMN_DIR DIRECT /end RECORD_LAYOUT
/begin RECORD_LAYOUT _REC_AXS_20_u2 NO_AXIS_PTS_X 1 UWORD AXIS_PTS_X 2 UWORD INDEX_INCR DIRECT /end RECORD_LAYOUT
/begin RECORD_LAYOUT _REC_CUR_20_u2_u1 FNC_VALUES 1 UWORD COLUMN_DIR DIRECT /end RECORD_LAYOUT
/begin RECORD_LAYOUT _REC_CUR_20_u2_u2 FNC_VALUES 1 UWORD COLUMN_DIR DIRECT /end RECORD_LAYOUT
/begin RECORD_LAYOUT _REC_CUR_20_u1_u2 FNC_VALUES 1 UBYTE COLUMN_DIR DIRECT /end RECORD_LAYOUT
/begin RECORD_LAYOUT _REC_MAP_20_u2_u2_u2 FNC_VALUES 1 UWORD COLUMN_DIR DIRECT /end RECORD_LAYOUT
/begin RECORD_LAYOUT _REC_MAP_20_u2_u1_u2 FNC_VALUES 1 UWORD COLUMN_DIR DIRECT /end RECORD_LAYOUT
/begin RECORD_LAYOUT _REC_MAP_20_u1_u2_u2 FNC_VALUES 1 UBYTE COLUMN_DIR DIRECT /end RECORD_LAYOUT
/begin RECORD_LAYOUT _REC_VAL_20_u4 FNC_VALUES 1 ULONG COLUMN_DIR DIRECT /end RECORD_LAYOUT
/begin RECORD_LAYOUT _REC_MAP_20_u1_u1_u1 FNC_VALUES 1 UBYTE COLUMN_DIR DIRECT /end RECORD_LAYOUT
/begin FUNCTION TQM_Reference_and_basic_torque "_Reference and basic torque"
 /begin OUT_MEASUREMENT tqi_ref lv_tq_iga_ena fac_cam_ch fac_eff_iga_ch tqi_ref_iga_min_lamb fac_eff_iga_secu lv_gs_act_fl lv_map_puc_lim_act_lsl_gain_ad /end OUT_MEASUREMENT
/end FUNCTION
/begin FUNCTION TQM_Torque_loss_and_reserve_for_ACC "_Torque loss and reserve for ACC"
 /begin DEF_CHARACTERISTIC ip_fac_tq_loss_acc_on ip_fac_tq_loss_acc_off ip_tq_add_acc ip_tq_add_heat_acc c_tq_add_acc_lgrd c_tq_add_heat_acc_lgrd c_tco_min_req_heat_acc c_tam_min_req_heat_acc c_tq_loss_max_acc c_crlc_tq_loss_acc_inp c_tq_add_acc_lgrd_on c_t_req_heat_acc /end DEF_CHARACTERISTIC
 /begin OUT_MEASUREMENT tq_add_acc tq_loss_acc tq_add_heat_acc lv_tout_acc lv_req_heat_acc_ena lv_tout_req_heat_acc t_req_heat_acc tq_loss_acc_inp /end OUT_MEASUREMENT
/end FUNCTION
/begin FUNCTION TQM_Torque_based_pattern_calculation "_Torque based pattern calculation"
 /begin DEF_CHARACTERISTIC lc_eff_scc_sp_man lc_eff_scc_bas_swi_clc lc_inh_fcut_fast lc_ena_eff_scc_bas_man c_eff_scc_sp_hys c_eff_scc_bas_man lc_ena_fcut_tot_gs lc_inh_fcut_gs_iga lc_inh_fcut_asr lc_ena_fcut_tot_asr lc_inh_fcut_n_max lc_tq_scc_inh_man lc_ena_fcut_tot_fast lc_tq_scc_ena_man c_eff_scc_sp_man c_fac_iga_min_teg_iga_bas c_hys_eff_iga_min_teg c_min_dec_eff_iga_min_teg_1 c_min_dec_eff_iga_min_teg_2 id_nr_pat_scc lc_inh_fcut_gs lc_inh_fcut_amt lc_inh_fcut_dcc lc_ena_fcut_tot_n_max lc_ena_fcut_tot_amt lc_ena_fcut_tot_dcc lc_inh_fcut_ldm lc_ena_fcut_tot_ldm /end DEF_CHARACTERISTIC
 /begin OUT_MEASUREMENT eff_scc_av eff_scc_av_can eff_scc_sp_hys eff_scc_bas fac_iga_min_teg_iga_bas lv_auth_tq_pat nr_pat_scc eff_scc_sp sum_inh_iv_tot sum_inh_iv_bas inh_iv_tot t_max_fcut_fast t_max_fcut_fast_tcha /end OUT_MEASUREMENT
/end FUNCTION
/begin FUNCTION TQM_Minimum_torque_at_clutch "_Minimum torque at clutch" /begin OUT_MEASUREMENT lv_tq_min_clu tq_min_clu /end OUT_MEASUREMENT /end FUNCTION
/begin FUNCTION TQM_Converter_torque "_Converter torque"
 /begin DEF_CHARACTERISTIC c_tq_add_conv_lgrd ip_tq_add_conv lc_tq_conv_dri_inh lc_tq_conv_can_inh ip_fac_conv__toil ip_fac_conv_dri__toil ip_t_dly_conv__toil ip_t_dly_n_sp_is__toil ip_fac_tq_conv__n_ratio_conv ip_n_tur__gr_at__vs ip_tq_conv_can ip_t_ramp_conv_neg__toil ip_t_ramp_conv_pos__toil ip_tq_add_conv_ac ip_tq_add_conv_n_grd ip_fac_tq_add_conv_toil /end DEF_CHARACTERISTIC
 /begin OUT_MEASUREMENT tq_conv_can_1 tq_add_conv lv_tout_conv t_conv tq_add_trans lv_dly_n_sp_is tq_conv_stn tq_conv tq_add_conv_2 /end OUT_MEASUREMENT
/end FUNCTION
/begin FUNCTION TQM_Pedal_value_interpretation "_Pedal value interpretation" /begin OUT_MEASUREMENT fac_tq_req_driv lv_rng_l_req /end OUT_MEASUREMENT /end FUNCTION
/begin FUNCTION TQM_Maximum_torque_at_clutch "_Maximum torque at clutch" /begin OUT_MEASUREMENT tqi_ref_max tq_max_clu /end OUT_MEASUREMENT /end FUNCTION
/begin FUNCTION TQM_Torque_Request_at_Clutch_General "_Torque Request at Clutch General" /begin OUT_MEASUREMENT fac_tq_req fac_tq_req_clu fac_tq_req_clu_ldm /end OUT_MEASUREMENT /end FUNCTION
/begin FUNCTION TQM_Actual_Engine_Torque "_Actual Engine Torque"
 /begin OUT_MEASUREMENT tqi_av_hom eff_lamb_bas_cor tqi_av_s tqi_ref_s eff_lamb_sp_bas tqi_sp_maf tqi_min_s eff_lamb_av eff_lamb_av_cbk[0] eff_lamb_av_cbk[1] tq_av tqi_min_homs tqi_av /end OUT_MEASUREMENT
/end FUNCTION
/begin FUNCTION TQM_Engine_torque_limitation "_Engine torque limitation"
 /begin DEF_CHARACTERISTIC ip_tq_lim_amt ip_tq_lim_at c_t_tq_lim lc_tqi_p_max_inh_as id_tq_p_max_mt id_tq_p_max_at c_tq_lim_at_lgrd c_tqi_pbr_max c_vs_max_tq_lim_pbr /end DEF_CHARACTERISTIC
/end FUNCTION
/begin FUNCTION TQM_Torque_Request_for_Cruise_Control "_Torque Request for Cruise Control" /begin DEF_CHARACTERISTIC c_lgrd_tq_cru_inc_1 c_lgrd_tq_cru_inc_2 c_fac_dcc_fl /end DEF_CHARACTERISTIC
 /begin OUT_MEASUREMENT fac_tq_req_cru fac_tq_req_dcc state_tq_dcc lv_tq_dcc_act tq_delta_max_clu state_tq_ldm /end OUT_MEASUREMENT
/end FUNCTION
/begin FUNCTION TQM_Torque_Request_for_safety "_Torque Request for safety"
 /begin DEF_CHARACTERISTIC lc_tq_lim_inh lc_tq_lim_inh_fast lc_tq_lim_inh_slow c_tqi_req_lim_pas c_tq_lim_inc c_tq_lim_dec c_t_tq_lim_intv ip_tqi_dif_lim c_tqi_dif_lim_max_ofs c_dec_tqi_lim_dif_max /end DEF_CHARACTERISTIC
 /begin OUT_MEASUREMENT t_tq_lim_intv sum_tqi_req_lim tqi_req_lim_4 tqi_req_lim_slow tqi_req_lim_3 lv_tq_lim_intv tqi_req_lim_1 tqi_req_lim_2 tqi_dif_lim t_tqi_req_lim t_tqi_req_lim_max tqi_req_lim_fast tqi_req_lim_dif tqi_req_lim_dif_max lv_tq_lim_intv_1 lv_tq_lim_intv_2 tqi_req_lim_dif_ofs /end OUT_MEASUREMENT
/end FUNCTION
/begin FUNCTION TQM_Torque_loss_for_power_steering "_Torque loss for power steering"
 /begin DEF_CHARACTERISTIC lc_pste_ena ip_tq_add_pste lc_pste_2_ena lc_pste_3_ena ldpm_n_32__pste_2 ldpm_t_pste_2__pste_2 ldpm_t_pste_3__pste_3 ip_fac_tq_loss_pste_2_sp ip_fac_tq_loss_pste_3_sp ip_fac_tq_loss_pste_2_av ip_fac_tq_loss_pste_3_av c_fac_tq_loss_pste_2_grd c_fac_tq_loss_pste_3_grd c_fac_tq_loss_pste_2_dif c_fac_tq_loss_pste_3_dif c_tq_add_pste_1_lih ip_fac_tq_loss_pste ip_tq_add_pste_2 ip_tq_add_pste_3_pste ip_tq_add_pste_3_pste_2 ip_tq_add_pste_2_lih ip_tq_add_pste_3_lih ip_tq_loss_pste ip_fac_tq_add_pste_2_vs ip_fac_tq_add_pste_3_vs_pste_2 ip_fac_tq_add_pste_3_vs_pste ip_fac_tq_loss_pste_2 ip_fac_tq_loss_pste_2_vs ip_tq_loss_pste_2 ip_fac_tq_loss_pste_2_ang c_tq_loss_pste_2_sp_min c_tq_loss_pste_3_sp_min lc_tq_loss_pste_2_swi lc_tq_loss_pste_3_swi c_tq_loss_pste_1_lih c_tq_loss_pste_2_lih c_tq_loss_pste_3_lih c_tq_add_pste_ad c_tq_loss_pste_ad c_t_pste_dly_ad lc_pste_2_man_act ldpm_n_32__pste_2_1 ldpm_n_32__pste_3_1 ip_tq_loss_pste_2_min_mon /end DEF_CHARACTERISTIC
 /begin OUT_MEASUREMENT tq_loss_pste lv_pste_disable lv_pste_disable_can lv_pste_ena tq_loss_pste_1 lv_pste_2_disable lv_pste_3_disable lv_pste_2_disable_can lv_pste_3_disable_can lv_pste_2_ena lv_pste_3_ena tq_loss_pste_2_av tq_loss_pste_2_sp tq_loss_pste_2_dif tq_loss_pste_2_grd t_pste_2 t_pste_3 tq_add_pste tq_add_pste_1 tq_add_pste_2 tq_add_pste_3 tq_loss_pste_2 tq_loss_pste_3 tq_loss_pste_3_sp tq_loss_pste_3_av tq_loss_pste_3_dif tq_loss_pste_3_grd tq_loss_pste_3_raw tq_loss_pste_2_raw state_tq_pste_2_plaus state_tq_pste_3_plaus lv_tq_loss_pste_is_ad_inh lv_tq_add_pste_is_ad_inh /end OUT_MEASUREMENT
/end FUNCTION
/begin FUNCTION TQM_Torque_Monitoring_Limitation_and_Coordination "_Torque Monitoring Limitation and Coordination" /begin DEF_CHARACTERISTIC c_tq_ad_add_s_swi /end DEF_CHARACTERISTIC /end FUNCTION
/begin FUNCTION TQM_Application_incidences_for_torque_based_pattern_calculation "_Application incidences for torque based pattern calculation"
 /begin DEF_CHARACTERISTIC c_maf_dif_min_fcut_fast c_tco_min_fcut_fast c_t_max_fcut_fast c_vs_min_fcut_fast id_maf_n_min_fcut_fast c_vs_min_fcut_fast_tcha c_t_max_fcut_fast_tcha /end DEF_CHARACTERISTIC
 /begin OUT_MEASUREMENT lv_cs_chg lv_fcut_fast lv_ct_chg /end OUT_MEASUREMENT
/end FUNCTION
/begin FUNCTION TQM_Torque_Transient "_Torque Transient" /end FUNCTION
/begin FUNCTION TQM_Torque_request_for_distance_cruise_control "_Torque request for distance cruise control" /begin DEF_CHARACTERISTIC c_lgrd_lih_dcc_inc c_t_dly_lih_dcc_inc /end DEF_CHARACTERISTIC
 /begin OUT_MEASUREMENT lv_dcc_disable_can tqi_dcc_fast_inc_req tqi_dcc_slow_inc_req tqi_dcc_fast_inc lv_dcc_ena_inc lv_dcc_inc_act tqi_dcc_slow_inc lv_dcc_inc_lih t_dcc_lih_ctr lv_err_bn_tq_dcc state_tq_dcc_plaus /end OUT_MEASUREMENT
/end FUNCTION
/begin FUNCTION TQM_AMT_Clutch_torque "_AMT Clutch torque"
 /begin DEF_CHARACTERISTIC ip_tq_amt ip_tq_vs_fil_amt ip_tq_add_amt c_tq_thd_amt_isc c_tq_add_amt_lgrd c_tq_lgrd_crawl_inc c_tq_lgrd_crawl_dec /end DEF_CHARACTERISTIC
 /begin OUT_MEASUREMENT tq_clu_amt lv_amt_crawl_on tq_add_amt lv_tout_amt t_amt /end OUT_MEASUREMENT
/end FUNCTION
/begin FUNCTION TQM_Torque_request_for_AMT_intervention "_Torque request for AMT intervention"
 /begin DEF_CHARACTERISTIC c_lgrd_lih_amt_dec c_lgrd_lih_amt_inc c_t_dly_lih_amt_dec c_t_dly_lih_amt_inc c_amt_ena_inc_dec c_tq_amt_fast_inh_fcut c_tq_amt_slow_inh_fcut /end DEF_CHARACTERISTIC
 /begin OUT_MEASUREMENT lv_amt_disable lv_amt_disable_can lv_amt_ena_dec lv_amt_ena_inc lv_amt_ena tqi_amt_fast_dec_req tqi_amt_fast_dec_req_1 tqi_amt_slow_dec_req tqi_amt_slow_dec_req_1 tqi_amt_fast_inc_req tqi_amt_fast_inc_req_1 tqi_amt_slow_inc_req tqi_amt_slow_inc_req_1 tqi_amt_fast_dec tqi_amt_slow_dec lv_amt_dec_act tqi_amt_fast_inc tqi_amt_slow_inc lv_amt_dec_lih lv_amt_inc_act lv_amt_inc_lih state_tq_amt_plaus t_amt_inc_lih_ctr t_amt_dec_lih_ctr lv_inh_fcut_amt /end OUT_MEASUREMENT
/end FUNCTION
/begin FUNCTION TQM_Minimum_indicated_engine_torque_at_trailing_throttle "_Minimum indicated engine torque at trailing throttle" /begin OUT_MEASUREMENT lv_tqi_bol_set /end OUT_MEASUREMENT /end FUNCTION
/begin FUNCTION TQM_Torque_Request_for_Traction_Control_TCS "_Torque Request for Traction Control TCS"
 /begin DEF_CHARACTERISTIC c_lgrd_lih_asr c_t_dly_lih_asr c_t_dly_lih_msr lc_msr_disable c_lgrd_lih_msr c_tq_max_msr lc_asr_disable /end DEF_CHARACTERISTIC
 /begin OUT_MEASUREMENT lv_asr_plaus lv_msr_plaus lv_asr_ena lv_msr_ena tqi_msr_fast_req tqi_msr_slow_req sf_tqd lv_tcs_disable tqi_asr_slow tqi_asr_fast_req tqi_asr_fast_req_1 tqi_asr_slow_req tqi_msr_fast_req_1 tqi_asr_slow_req_1 tqi_msr_slow_req_1 tqi_asr_fast tqi_msr_fast tqi_msr_slow lv_msr_lih lv_msr_act lv_asr_act lv_tcs_ena lv_tcs_disable_can lv_asr_lih t_asr_lih_ctr t_msr_lih_ctr state_tq_tcs_plaus /end OUT_MEASUREMENT
/end FUNCTION
/begin FUNCTION TQM_Torque_Loss___Anti_Roll_Stabilisation "_Torque Loss - Anti-Roll-Stabilisation"
 /begin DEF_CHARACTERISTIC ip_tq_loss_ars_sp_max ip_tq_loss_ars_av_max ip_tq_loss_ars_sp_can_max ip_tq_loss_ars_av_can_max c_fac_tq_loss_ars_grd c_fac_tq_loss_ars_dif c_t_dly_tq_max_ars c_tq_loss_ars_sp_ofs c_tq_loss_ars_av_ofs c_v_max_ars_diag c_n_max_ars_diag c_tq_loss_ars_ad c_t_ars_dly_ad /end DEF_CHARACTERISTIC
 /begin OUT_MEASUREMENT lv_ars_disable lv_ars_disable_can lv_ars_ena lv_tq_max_ars tq_loss_ars_sp_max tq_loss_ars_sp_max_1 tq_loss_ars_av_max_1 t_dly_tq_max_ars tq_loss_ars tq_loss_ars_av_max tq_loss_ars_grd tq_loss_ars_dif state_tq_ars_plaus lv_tq_loss_ars_is_ad_inh /end OUT_MEASUREMENT
/end FUNCTION
/begin FUNCTION TQM_TQ_Based_CH_For_Desulf "_TQ_Based_CH_For_Desulf" /end FUNCTION
/begin FUNCTION TQM_Torque_Request_for_LDM "_Torque Request for LDM"
 /begin DEF_CHARACTERISTIC c_lgrd_lih_ldm c_t_dly_lih_ldm c_state_di_puc_act lc_ldm_off_clu /end DEF_CHARACTERISTIC
 /begin OUT_MEASUREMENT lv_ldm_disable_can state_tq_ldm_plaus tq_wheel_ldm_req tq_sp_wheel lv_ldm_ena lv_ldm_act lv_ldm_lih t_ldm_lih_ctr lv_ldm_puc_inh /end OUT_MEASUREMENT
/end FUNCTION
/begin FUNCTION TQM_General_Flag_for_inhibition_of_external_torque_request "_General Flag for inhibition of external torque request" /begin OUT_MEASUREMENT lv_tqi_req_can_inh /end OUT_MEASUREMENT /end FUNCTION
/begin FUNCTION AGGR_TQSP_adaption ""
 /begin OUT_MEASUREMENT load_thd_fl maf_sp_tqi tq_req_clu tqi_sp tqi_ems tq_add_max tqi_add_max tqi_add_max_tol maf_add_max eff_iga_min_add_max tqi_fast tqi_req_fast tqi_req_fast_dtm tqi_req_fast_dtm_can tqi_req_fast_sel tqi_req_slow_dtm tqi_req_slow_sel tqi_req_tra_fast tqi_sp_can state_tq_intv_fast state_tq_intv_slow tq_req_ipm tqi_req_slow tqi_maf_sp_cus /end OUT_MEASUREMENT
/end FUNCTION
/begin FUNCTION AGGR_IGSP_adaption ""
 /begin OUT_MEASUREMENT fac_iga_opm_sel lv_iga_st_opm_sel iga_add_cmb_ctl[0] iga_add_cmb_ctl[1] iga_add_cmb_ctl[2] iga_add_cmb_ctl[3] iga_add_cmb_ctl[4] iga_add_cmb_ctl[5] iga_add_cmb_ctl[6] iga_add_cmb_ctl[7] iga_av_h_rng_s_1[0] iga_av_h_rng_s_1[1] iga_av_h_rng_s_1[2] iga_av_h_rng_s_1[3] iga_av_h_rng_s_1[4] iga_av_h_rng_s_1[5] iga_av_h_rng_s_1[6] iga_av_h_rng_s_1[7] iga_ref_lamb_cor iga_ref_temp_cor iga_av_h_rng_homs[0] iga_av_h_rng_homs[1] iga_av_h_rng_homs[2] iga_av_h_rng_homs[3] iga_av_h_rng_homs[4] iga_av_h_rng_homs[5] iga_av_h_rng_homs[6] iga_av_h_rng_homs[7] iga_bas_cor iga_ref_cor iga_bas_cor_cbk[0] iga_bas_cor_cbk[1] iga_ref_cor_cbk[0] iga_ref_cor_cbk[1] iga_min_h_rng iga_wout_knk[0] iga_wout_knk[1] iga_wout_knk[2] iga_wout_knk[3] iga_wout_knk[4] iga_wout_knk[5] iga_wout_knk[6] iga_wout_knk[7] iga_av_h_rng[0] iga_av_h_rng[1] iga_av_h_rng[2] iga_av_h_rng[3] iga_av_h_rng[4] iga_av_h_rng[5] iga_av_h_rng[6] iga_av_h_rng[7] iga_av_mv_h_rng iga_av_mv_can_h_rng iga_av_mv_cbk_h_rng[0] iga_av_mv_cbk_h_rng[1] iga_av_h_rng_s[0] iga_av_h_rng_s[1] iga_av_h_rng_s[2] iga_av_h_rng_s[3] iga_av_h_rng_s[4] iga_av_h_rng_s[5] iga_av_h_rng_s[6] iga_av_h_rng_s[7] iga[0] iga[1] iga[2] iga[3] iga[4] iga[5] iga[6] iga[7] lv_iga_grd_act iga_dif_min_h_rng /end OUT_MEASUREMENT
/end FUNCTION
/begin FUNCTION AGGR_PWSL_adaption "" /begin OUT_MEASUREMENT lv_vb_cdn_obd_1 lv_vb_cdn_obd_2 lv_nt_so2p_ext_adj_act /end OUT_MEASUREMENT /end FUNCTION
/begin FUNCTION AGGR_VVTI_adaption ""
 /begin DEF_CHARACTERISTIC lc_not_adj_cam_ivvt_ex[0] lc_not_adj_cam_ivvt_ex[1] lc_not_adj_cam_ivvt_in[0] lc_not_adj_cam_ivvt_in[1] c_cam_ini_in c_cam_ini_ex /end DEF_CHARACTERISTIC
 /begin OUT_MEASUREMENT lv_di_ad_ref_cam_ivvt[0] lv_di_ad_ref_cam_ivvt[1] cam_ex[0] cam_ex[1] lv_cam_lock_ivvt_in[0] lv_cam_lock_ivvt_in[1] lv_cam_lock_ivvt_ex[0] lv_cam_lock_ivvt_ex[1] cam_sp_ivvt_in cam_sp_ivvt_ex cam_sp_ref_in cam_sp_ref_ex cam_in_h[0] cam_in_h[1] /end OUT_MEASUREMENT
/end FUNCTION
/begin FUNCTION AGGR_LACO_adaption ""
 /begin DEF_CHARACTERISTIC c_mff_ref c_ctr_km_thd_lam_ad_cus c_fac_lam_adj_min_lam_ad_cus c_fac_lam_adj_max_lam_ad_cus c_crlc_lam_adj_lam_ad_cus c_n_lam_ad_cus c_mff_lam_ad_cus c_tco_lam_ad_cus lc_fac_lam_ad_out_bal_man lc_lam_ad_ext lc_fac_lam_lim_fil_ena ldp_n_ip_crlc_fac_lam_lim_fil ldp_maf_ip_crlc_fac_lam_lim_fil ip_crlc_fac_lam_lim_fil /end DEF_CHARACTERISTIC
 /begin OUT_MEASUREMENT lam_bank_1.lam_up.bf.lv_lscl lam_bank_1.lam_up.bf.lv_lam_cor_lim_intr lam_bank_1.lam_up.ti_lam_cor lam_bank_1.lam_up.ti_lam_fac lam_bank_1.lam_up.lamb_dif lam_bank_1.lam_ad.mff_ad_add_mmv_rel_quo lam_bank_1.lam_dly.lam_mv lam_bank_1.lam_dly.lam_mv_lpf_cp lam_bank_1.lam_dly.lamb_sp_fil lam_bank_1.lam_dly.lamb_sp_fil_s_cp lam_bank_1.lam_dly.delta_lamb_i_ad_h_res lam_bank_1.lam_dly.delta_lamb_i_h_res lam_bank_1.lam_dly.bf.lv_delta_lamb lam_bank_1.lam_dly.vls_dif_dly lam_bank_2.lam_up.bf.lv_lscl lam_bank_2.lam_up.bf.lv_lam_cor_lim_intr lam_bank_2.lam_up.ti_lam_cor lam_bank_2.lam_up.ti_lam_fac lam_bank_2.lam_up.lamb_dif lam_bank_2.lam_ad.mff_ad_add_mmv_rel_quo lam_bank_2.lam_dly.lam_mv lam_bank_2.lam_dly.lam_mv_lpf_cp lam_bank_2.lam_dly.lamb_sp_fil lam_bank_2.lam_dly.lamb_sp_fil_s_cp lam_bank_2.lam_dly.delta_lamb_i_ad_h_res lam_bank_2.lam_dly.delta_lamb_i_h_res lam_bank_2.lam_dly.bf.lv_delta_lamb lam_bank_2.lam_dly.vls_dif_dly lv_inh_lscl_cus[0] lv_inh_lscl_cus[1] lamb_sp_ofs_ext[0] lamb_sp_ofs_ext[1] fac_lam_ad_cus[0] fac_lam_ad_cus[1] lamb_sp_hom_cus[0] lamb_sp_hom_cus[1] fac_lam_adj_lam_ad_cus[0] fac_lam_adj_lam_ad_cus[1] fac_lam_adj_tmp_lam_ad_cus[0] fac_lam_adj_tmp_lam_ad_cus[1] fac_lam_adj_cor_lam_ad_cus[0] fac_lam_adj_cor_lam_ad_cus[1] lv_fac_lim_max_lam_ad_cus[0] lv_fac_lim_max_lam_ad_cus[1] lv_fac_lim_min_lam_ad_cus[0] lv_fac_lim_min_lam_ad_cus[1] ctr_km_lam_adj_lam_ad_cus[0] ctr_km_lam_adj_lam_ad_cus[1] ctr_km_lam_adj_tmp_lam_ad_cus[0] ctr_km_lam_adj_tmp_lam_ad_cus[1] lv_mff_ad_end lv_mff_ad_cdn vls_cyl[0] vls_cyl[1] vls_cyl[2] vls_cyl[3] vls_cyl[4] vls_cyl[5] vls_cyl[6] vls_cyl[7] vls_cyl_trig[0] vls_cyl_trig[1] vls_cyl_trig[2] vls_cyl_trig[3] vls_cyl_trig[4] vls_cyl_trig[5] vls_cyl_trig[6] vls_cyl_trig[7] fac_lam_mv fac_lam_pctl_cus[0] fac_lam_pctl_cus[1] fac_lam_ad_bal[0] fac_lam_ad_bal[1] lv_lam_ad_ext lv_fac_l_rng_lim_min_ext_lam_ad[0] lv_fac_l_rng_lim_min_ext_lam_ad[1] lv_fac_l_rng_lim_max_ext_lam_ad[0] lv_fac_l_rng_lim_max_ext_lam_ad[1] /end OUT_MEASUREMENT
/end FUNCTION
/begin FUNCTION AGGR_EGCP_adaption ""
 /begin OUT_MEASUREMENT lam_bank_1.lam_up.lamb lam_bank_1.ls_act_chk_pl.bf.lv_req_lamb_sp_ls_act_test lam_bank_1.ls_act_chk_pl.bf.lv_temp_dew_ls_up lam_bank_1.ls_act_chk_pl.bf.lv_temp_dew_ls_down lam_bank_1.ls_act_chk_pl.bf.lv_inh_win_det_delta_i_lam lam_bank_1.ls_act_chk_pl.lamb_sp_beg_ls_act_test lam_bank_1.ls_act_chk_pl.lamb_sp_ls_act_test lam_bank_1.ls_act_chk_pl.teg_dyn_ls_up lam_bank_1.ls_act_chk_pl.teg_dyn_ls_down lam_bank_1.ls_ready.bf.lv_up_ls lam_bank_1.lam_sti_afl.ctr_vls_afl_cyc lam_bank_1.ls_down.vls_down lam_bank_1.ls_down_rdy.bf.lv_down_ls lam_bank_2.lam_up.lamb lam_bank_2.ls_act_chk_pl.bf.lv_req_lamb_sp_ls_act_test lam_bank_2.ls_act_chk_pl.bf.lv_temp_dew_ls_up lam_bank_2.ls_act_chk_pl.bf.lv_temp_dew_ls_down lam_bank_2.ls_act_chk_pl.bf.lv_inh_win_det_delta_i_lam lam_bank_2.ls_act_chk_pl.lamb_sp_beg_ls_act_test lam_bank_2.ls_act_chk_pl.lamb_sp_ls_act_test lam_bank_2.ls_act_chk_pl.teg_dyn_ls_up lam_bank_2.ls_act_chk_pl.teg_dyn_ls_down lam_bank_2.ls_ready.bf.lv_up_ls lam_bank_2.lam_sti_afl.ctr_vls_afl_cyc lam_bank_2.ls_down.vls_down lam_bank_2.ls_down_rdy.bf.lv_down_ls lamb_min lv_lamb_puls_dyn_diag lv_err_ls_up_dyn_vld_1 lv_err_ls_up_dyn_vld_2 lamb_mv lv_lsl_ofs_puls_1 lv_lsl_ofs_puls_2 vls_down_min_dc[0] vls_down_min_dc[1] vls_down_max_dc[0] vls_down_max_dc[1] opm_req_cus /end OUT_MEASUREMENT
/end FUNCTION
/begin FUNCTION AGGR_AFMO_adaption "" /end FUNCTION
/end MODULE
/end PROJECT
