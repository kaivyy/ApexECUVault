ASAP2_VERSION 1 30
/begin PROJECT MSS65-inj "Generiert am 14.10.05 um 11:34:36"
/begin HEADER "" VERSION "R341" /end HEADER
/begin MODULE _MSS65-inj "Generiert am 14.10.05 um 11:34:36"
/begin MOD_COMMON "" BYTE_ORDER MSB_FIRST ALIGNMENT_BYTE 1 ALIGNMENT_WORD 2 ALIGNMENT_LONG 4 ALIGNMENT_FLOAT32_IEEE 4 ALIGNMENT_FLOAT64_IEEE 8 /end MOD_COMMON
/begin CHARACTERISTIC K_ED_APPL_DATA_INJ.DEC_NACH_EINTRAG "Filterverringerung nach Fehlerspeichereintrag" VALUE 0x70F93 TKW_VV_VV_UB 100.0 FORMULA_0003 0.0 255.0 /end CHARACTERISTIC
/begin CHARACTERISTIC K_ED_APPL_DATA_INJ.DEC_VOR_EINTRAG "Filterverringerung vorm Fehlerspeichereintrag" VALUE 0x70F91 TKW_VV_VV_UB 100.0 FORMULA_0003 0.0 255.0 /end CHARACTERISTIC
/begin CHARACTERISTIC K_ED_APPL_DATA_INJ.FEHLERSCHWELLE "Filterschwelle fuer Fehlereintrag" VALUE 0x70F8E TKW_VV_VV_UB 100.0 FORMULA_0003 0.0 255.0 /end CHARACTERISTIC
/begin CHARACTERISTIC K_ED_APPL_DATA_INJ.INC_NACH_EINTRAG "Filtererhoehung nach Fehlerspeichereintrag" VALUE 0x70F92 TKW_VV_VV_UB 100.0 FORMULA_0003 0.0 255.0 /end CHARACTERISTIC
/begin CHARACTERISTIC K_ED_APPL_DATA_INJ.INC_VOR_EINTRAG "Filtererhoehung vorm Fehlerspeichereintrag" VALUE 0x70F90 TKW_VV_VV_UB 100.0 FORMULA_0003 0.0 255.0 /end CHARACTERISTIC
/begin CHARACTERISTIC K_ED_APPL_DATA_INJ.KLASSENINDEX "Auswahl der Fehlerklasse" VALUE 0x70F94 TKW_VV_VV_UB 100.0 FORMULA_0003 0.0 8.0 /end CHARACTERISTIC
/begin CHARACTERISTIC K_ED_APPL_DATA_INJ.OK_SCHWELLE "Filterschwelle fuer Fehleraustrag" VALUE 0x70F8F TKW_VV_VV_UB 100.0 FORMULA_0003 0.0 255.0 /end CHARACTERISTIC
/begin CHARACTERISTIC K_ED_APPL_DATA_INJ.P_CODE_OPENLOAD "P-Code fuer die Art OPENLOAD" VALUE 0x70F8A TKW_VV_VV_UW 100.0 FORMULA_0010 0.0 65535.0 /end CHARACTERISTIC
/begin CHARACTERISTIC K_ED_APPL_DATA_INJ.P_CODE_SH_TO_GND "P-Code fuer die Art SH_TO_GND" VALUE 0x70F88 TKW_VV_VV_UW 100.0 FORMULA_0010 0.0 65535.0 /end CHARACTERISTIC
/begin CHARACTERISTIC K_ED_APPL_DATA_INJ.P_CODE_SH_TO_UB "P-Code fuer die Art SH_TO_UB" VALUE 0x70F86 TKW_VV_VV_UW 100.0 FORMULA_0010 0.0 65535.0 /end CHARACTERISTIC
/begin CHARACTERISTIC K_ED_APPL_DATA_INJ.P_CODE_UNPLAUSIBEL "P-Code fuer die Art UNPLAUSIBEL" VALUE 0x70F8C TKW_VV_VV_UW 100.0 FORMULA_0010 0.0 65535.0 /end CHARACTERISTIC
/begin CHARACTERISTIC K_ED_CODIERUNG.DEC_NACH_EINTRAG "Filterverringerung nach Fehlerspeichereintrag" VALUE 0x7143F TKW_VV_VV_UB 100.0 FORMULA_0003 0.0 255.0 /end CHARACTERISTIC
/begin CHARACTERISTIC K_ED_CODIERUNG.DEC_VOR_EINTRAG "Filterverringerung vorm Fehlerspeichereintrag" VALUE 0x7143D TKW_VV_VV_UB 100.0 FORMULA_0003 0.0 255.0 /end CHARACTERISTIC
/begin CHARACTERISTIC K_ED_CODIERUNG.FEHLERSCHWELLE "Filterschwelle fuer Fehlereintrag" VALUE 0x7143A TKW_VV_VV_UB 100.0 FORMULA_0003 0.0 255.0 /end CHARACTERISTIC
/begin CHARACTERISTIC K_ED_CODIERUNG.INC_NACH_EINTRAG "Filtererhoehung nach Fehlerspeichereintrag" VALUE 0x7143E TKW_VV_VV_UB 100.0 FORMULA_0003 0.0 255.0 /end CHARACTERISTIC
/begin CHARACTERISTIC K_ED_CODIERUNG.INC_VOR_EINTRAG "Filtererhoehung vorm Fehlerspeichereintrag" VALUE 0x7143C TKW_VV_VV_UB 100.0 FORMULA_0003 0.0 255.0 /end CHARACTERISTIC
/begin CHARACTERISTIC K_ED_CODIERUNG.KLASSENINDEX "Auswahl der Fehlerklasse" VALUE 0x71440 TKW_VV_VV_UB 100.0 FORMULA_0003 0.0 8.0 /end CHARACTERISTIC
/begin CHARACTERISTIC K_ED_CODIERUNG.OK_SCHWELLE "Filterschwelle fuer Fehleraustrag" VALUE 0x7143B TKW_VV_VV_UB 100.0 FORMULA_0003 0.0 255.0 /end CHARACTERISTIC
/begin CHARACTERISTIC K_ED_CODIERUNG.P_CODE_OPENLOAD "P-Code fuer die Art OPENLOAD" VALUE 0x71436 TKW_VV_VV_UW 100.0 FORMULA_0010 0.0 65535.0 /end CHARACTERISTIC
/begin CHARACTERISTIC K_ED_CODIERUNG.P_CODE_SH_TO_GND "P-Code fuer die Art SH_TO_GND" VALUE 0x71434 TKW_VV_VV_UW 100.0 FORMULA_0010 0.0 65535.0 /end CHARACTERISTIC
/begin CHARACTERISTIC K_ED_CODIERUNG.P_CODE_SH_TO_UB "P-Code fuer die Art SH_TO_UB" VALUE 0x71432 TKW_VV_VV_UW 100.0 FORMULA_0010 0.0 65535.0 /end CHARACTERISTIC
/begin CHARACTERISTIC K_ED_CODIERUNG.P_CODE_UNPLAUSIBEL "P-Code fuer die Art UNPLAUSIBEL" VALUE 0x71438 TKW_VV_VV_UW 100.0 FORMULA_0010 0.0 65535.0 /end CHARACTERISTIC
/begin CHARACTERISTIC K_ED_CSS_TIME "Zeit fuer CSS-Denominator" VALUE 0x71F94 TKW_VV_VV_UW 100.0 FORMULA_0071 0.0 6553.5 FORMAT "%4.1" /end CHARACTERISTIC
/begin CHARACTERISTIC K_ED_DK1_ENLTG.DEC_NACH_EINTRAG "Filterverringerung nach Fehlerspeichereintrag" VALUE 0x71799 TKW_VV_VV_UB 100.0 FORMULA_0003 0.0 255.0 /end CHARACTERISTIC
/begin CHARACTERISTIC K_ED_DK1_ENLTG.DEC_VOR_EINTRAG "Filterverringerung vorm Fehlerspeichereintrag" VALUE 0x71797 TKW_VV_VV_UB 100.0 FORMULA_0003 0.0 255.0 /end CHARACTERISTIC
/begin CHARACTERISTIC K_ED_DK1_ENLTG.FEHLERSCHWELLE "Filterschwelle fuer Fehlereintrag" VALUE 0x71794 TKW_VV_VV_UB 100.0 FORMULA_0003 0.0 255.0 /end CHARACTERISTIC
/begin CHARACTERISTIC K_ED_DK1_ENLTG.INC_NACH_EINTRAG "Filtererhoehung nach Fehlerspeichereintrag" VALUE 0x71798 TKW_VV_VV_UB 100.0 FORMULA_0003 0.0 255.0 /end CHARACTERISTIC
/begin CHARACTERISTIC K_ED_DK1_ENLTG.INC_VOR_EINTRAG "Filtererhoehung vorm Fehlerspeichereintrag" VALUE 0x71796 TKW_VV_VV_UB 100.0 FORMULA_0003 0.0 255.0 /end CHARACTERISTIC
/begin CHARACTERISTIC K_ED_DK1_ENLTG.KLASSENINDEX "Auswahl der Fehlerklasse" VALUE 0x7179A TKW_VV_VV_UB 100.0 FORMULA_0003 0.0 8.0 /end CHARACTERISTIC
/begin CHARACTERISTIC K_ED_DK1_ENLTG.OK_SCHWELLE "Filterschwelle fuer Fehleraustrag" VALUE 0x71795 TKW_VV_VV_UB 100.0 FORMULA_0003 0.0 255.0 /end CHARACTERISTIC
/begin CHARACTERISTIC K_ED_DK1_ENLTG.P_CODE_OPENLOAD "P-Code fuer die Art OPENLOAD" VALUE 0x71790 TKW_VV_VV_UW 100.0 FORMULA_0010 0.0 65535.0 /end CHARACTERISTIC
/begin CHARACTERISTIC K_ED_DK1_ENLTG.P_CODE_SH_TO_GND "P-Code fuer die Art SH_TO_GND" VALUE 0x7178E TKW_VV_VV_UW 100.0 FORMULA_0010 0.0 65535.0 /end CHARACTERISTIC
/begin CHARACTERISTIC K_ED_DK1_ENLTG.P_CODE_SH_TO_UB "P-Code fuer die Art SH_TO_UB" VALUE 0x7178C TKW_VV_VV_UW 100.0 FORMULA_0010 0.0 65535.0 /end CHARACTERISTIC
/begin CHARACTERISTIC K_ED_DK1_ENLTG.P_CODE_UNPLAUSIBEL "P-Code fuer die Art UNPLAUSIBEL" VALUE 0x71792 TKW_VV_VV_UW 100.0 FORMULA_0010 0.0 65535.0 /end CHARACTERISTIC
/begin CHARACTERISTIC K_ED_DK2_ENLTG.DEC_NACH_EINTRAG "Filterverringerung nach Fehlerspeichereintrag" VALUE 0x717B3 TKW_VV_VV_UB 100.0 FORMULA_0003 0.0 255.0 /end CHARACTERISTIC
/begin CHARACTERISTIC K_ED_DK2_ENLTG.DEC_VOR_EINTRAG "Filterverringerung vorm Fehlerspeichereintrag" VALUE 0x717B1 TKW_VV_VV_UB 100.0 FORMULA_0003 0.0 255.0 /end CHARACTERISTIC
/begin CHARACTERISTIC K_ED_DK2_ENLTG.FEHLERSCHWELLE "Filterschwelle fuer Fehlereintrag" VALUE 0x717AE TKW_VV_VV_UB 100.0 FORMULA_0003 0.0 255.0 /end CHARACTERISTIC
/begin CHARACTERISTIC K_ED_DK2_ENLTG.INC_NACH_EINTRAG "Filtererhoehung nach Fehlerspeichereintrag" VALUE 0x717B2 TKW_VV_VV_UB 100.0 FORMULA_0003 0.0 255.0 /end CHARACTERISTIC
/begin CHARACTERISTIC K_ED_DK2_ENLTG.INC_VOR_EINTRAG "Filtererhoehung vorm Fehlerspeichereintrag" VALUE 0x717B0 TKW_VV_VV_UB 100.0 FORMULA_0003 0.0 255.0 /end CHARACTERISTIC
/begin CHARACTERISTIC K_ED_DK2_ENLTG.KLASSENINDEX "Auswahl der Fehlerklasse" VALUE 0x717B4 TKW_VV_VV_UB 100.0 FORMULA_0003 0.0 8.0 /end CHARACTERISTIC
/begin CHARACTERISTIC K_ED_DK2_ENLTG.OK_SCHWELLE "Filterschwelle fuer Fehleraustrag" VALUE 0x717AF TKW_VV_VV_UB 100.0 FORMULA_0003 0.0 255.0 /end CHARACTERISTIC
/begin CHARACTERISTIC K_ED_DK2_ENLTG.P_CODE_OPENLOAD "P-Code fuer die Art OPENLOAD" VALUE 0x717AA TKW_VV_VV_UW 100.0 FORMULA_0010 0.0 65535.0 /end CHARACTERISTIC
/begin CHARACTERISTIC K_ED_DK2_ENLTG.P_CODE_SH_TO_GND "P-Code fuer die Art SH_TO_GND" VALUE 0x717A8 TKW_VV_VV_UW 100.0 FORMULA_0010 0.0 65535.0 /end CHARACTERISTIC
/begin CHARACTERISTIC K_ED_DK2_ENLTG.P_CODE_SH_TO_UB "P-Code fuer die Art SH_TO_UB" VALUE 0x717A6 TKW_VV_VV_UW 100.0 FORMULA_0010 0.0 65535.0 /end CHARACTERISTIC
/begin CHARACTERISTIC K_ED_DK2_ENLTG.P_CODE_UNPLAUSIBEL "P-Code fuer die Art UNPLAUSIBEL" VALUE 0x717AC TKW_VV_VV_UW 100.0 FORMULA_0010 0.0 65535.0 /end CHARACTERISTIC
/begin CHARACTERISTIC K_ED_DMTL_DECKEL.DEC_NACH_EINTRAG "Filterverringerung nach Fehlerspeichereintrag" VALUE 0x713BD TKW_VV_VV_UB 100.0 FORMULA_0003 0.0 255.0 /end CHARACTERISTIC
/begin CHARACTERISTIC K_ED_DMTL_DECKEL.DEC_VOR_EINTRAG "Filterverringerung vorm Fehlerspeichereintrag" VALUE 0x713BB TKW_VV_VV_UB 100.0 FORMULA_0003 0.0 255.0 /end CHARACTERISTIC
/begin CHARACTERISTIC K_ED_DMTL_DECKEL.FEHLERSCHWELLE "Filterschwelle fuer Fehlereintrag" VALUE 0x713B8 TKW_VV_VV_UB 100.0 FORMULA_0003 0.0 255.0 /end CHARACTERISTIC
/begin CHARACTERISTIC K_ED_DMTL_DECKEL.INC_NACH_EINTRAG "Filtererhoehung nach Fehlerspeichereintrag" VALUE 0x713BC TKW_VV_VV_UB 100.0 FORMULA_0003 0.0 255.0 /end CHARACTERISTIC
/begin CHARACTERISTIC K_ED_DMTL_DECKEL.INC_VOR_EINTRAG "Filtererhoehung vorm Fehlerspeichereintrag" VALUE 0x713BA TKW_VV_VV_UB 100.0 FORMULA_0003 0.0 255.0 /end CHARACTERISTIC
/begin CHARACTERISTIC K_ED_DMTL_DECKEL.KLASSENINDEX "Auswahl der Fehlerklasse" VALUE 0x713BE TKW_VV_VV_UB 100.0 FORMULA_0003 0.0 8.0 /end CHARACTERISTIC
/begin CHARACTERISTIC K_ED_DMTL_DECKEL.OK_SCHWELLE "Filterschwelle fuer Fehleraustrag" VALUE 0x713B9 TKW_VV_VV_UB 100.0 FORMULA_0003 0.0 255.0 /end CHARACTERISTIC
/begin CHARACTERISTIC K_ED_DMTL_DECKEL.P_CODE_OPENLOAD "P-Code fuer die Art OPENLOAD" VALUE 0x713B4 TKW_VV_VV_UW 100.0 FORMULA_0010 0.0 65535.0 /end CHARACTERISTIC
/begin CHARACTERISTIC K_ED_DMTL_DECKEL.P_CODE_SH_TO_GND "P-Code fuer die Art SH_TO_GND" VALUE 0x713B2 TKW_VV_VV_UW 100.0 FORMULA_0010 0.0 65535.0 /end CHARACTERISTIC
/begin CHARACTERISTIC K_ED_DMTL_DECKEL.P_CODE_SH_TO_UB "P-Code fuer die Art SH_TO_UB" VALUE 0x713B0 TKW_VV_VV_UW 100.0 FORMULA_0010 0.0 65535.0 /end CHARACTERISTIC
/begin CHARACTERISTIC K_ED_DMTL_DECKEL.P_CODE_UNPLAUSIBEL "P-Code fuer die Art UNPLAUSIBEL" VALUE 0x713B6 TKW_VV_VV_UW 100.0 FORMULA_0010 0.0 65535.0 /end CHARACTERISTIC
/begin CHARACTERISTIC K_ED_DMTL_FEINLECK.DEC_NACH_EINTRAG "Filterverringerung nach Fehlerspeichereintrag" VALUE 0x71B0D TKW_VV_VV_UB 100.0 FORMULA_0003 0.0 255.0 /end CHARACTERISTIC
/begin CHARACTERISTIC K_ED_DMTL_FEINLECK.DEC_VOR_EINTRAG "Filterverringerung vorm Fehlerspeichereintrag" VALUE 0x71B0B TKW_VV_VV_UB 100.0 FORMULA_0003 0.0 255.0 /end CHARACTERISTIC
/begin CHARACTERISTIC K_ED_DMTL_FEINLECK.FEHLERSCHWELLE "Filterschwelle fuer Fehlereintrag" VALUE 0x71B08 TKW_VV_VV_UB 100.0 FORMULA_0003 0.0 255.0 /end CHARACTERISTIC
/begin CHARACTERISTIC K_ED_DMTL_FEINLECK.INC_NACH_EINTRAG "Filtererhoehung nach Fehlerspeichereintrag" VALUE 0x71B0C TKW_VV_VV_UB 100.0 FORMULA_0003 0.0 255.0 /end CHARACTERISTIC
/begin CHARACTERISTIC K_ED_DMTL_FEINLECK.INC_VOR_EINTRAG "Filtererhoehung vorm Fehlerspeichereintrag" VALUE 0x71B0A TKW_VV_VV_UB 100.0 FORMULA_0003 0.0 255.0 /end CHARACTERISTIC
/begin CHARACTERISTIC K_ED_DMTL_FEINLECK.KLASSENINDEX "Auswahl der Fehlerklasse" VALUE 0x71B0E TKW_VV_VV_UB 100.0 FORMULA_0003 0.0 8.0 /end CHARACTERISTIC
/begin CHARACTERISTIC K_ED_DMTL_FEINLECK.OK_SCHWELLE "Filterschwelle fuer Fehleraustrag" VALUE 0x71B09 TKW_VV_VV_UB 100.0 FORMULA_0003 0.0 255.0 /end CHARACTERISTIC
/begin CHARACTERISTIC K_ED_DMTL_FEINLECK.P_CODE_OPENLOAD "P-Code fuer die Art OPENLOAD" VALUE 0x71B04 TKW_VV_VV_UW 100.0 FORMULA_0010 0.0 65535.0 /end CHARACTERISTIC
/begin CHARACTERISTIC K_ED_DMTL_FEINLECK.P_CODE_SH_TO_GND "P-Code fuer die Art SH_TO_GND" VALUE 0x71B02 TKW_VV_VV_UW 100.0 FORMULA_0010 0.0 65535.0 /end CHARACTERISTIC
/begin CHARACTERISTIC K_ED_DMTL_FEINLECK.P_CODE_SH_TO_UB "P-Code fuer die Art SH_TO_UB" VALUE 0x71B00 TKW_VV_VV_UW 100.0 FORMULA_0010 0.0 65535.0 /end CHARACTERISTIC
/begin CHARACTERISTIC K_ED_DMTL_FEINLECK.P_CODE_UNPLAUSIBEL "P-Code fuer die Art UNPLAUSIBEL" VALUE 0x71B06 TKW_VV_VV_UW 100.0 FORMULA_0010 0.0 65535.0 /end CHARACTERISTIC
/begin CHARACTERISTIC K_ED_DMTL_FEUCHT.DEC_NACH_EINTRAG "Filterverringerung nach Fehlerspeichereintrag" VALUE 0x713A3 TKW_VV_VV_UB 100.0 FORMULA_0003 0.0 255.0 /end CHARACTERISTIC
/begin CHARACTERISTIC K_ED_DMTL_FEUCHT.DEC_VOR_EINTRAG "Filterverringerung vorm Fehlerspeichereintrag" VALUE 0x713A1 TKW_VV_VV_UB 100.0 FORMULA_0003 0.0 255.0 /end CHARACTERISTIC
/begin CHARACTERISTIC K_ED_DMTL_FEUCHT.FEHLERSCHWELLE "Filterschwelle fuer Fehlereintrag" VALUE 0x7139E TKW_VV_VV_UB 100.0 FORMULA_0003 0.0 255.0 /end CHARACTERISTIC
/begin CHARACTERISTIC K_ED_DMTL_FEUCHT.INC_NACH_EINTRAG "Filtererhoehung nach Fehlerspeichereintrag" VALUE 0x713A2 TKW_VV_VV_UB 100.0 FORMULA_0003 0.0 255.0 /end CHARACTERISTIC
/begin CHARACTERISTIC K_ED_DMTL_FEUCHT.INC_VOR_EINTRAG "Filtererhoehung vorm Fehlerspeichereintrag" VALUE 0x713A0 TKW_VV_VV_UB 100.0 FORMULA_0003 0.0 255.0 /end CHARACTERISTIC
/begin CHARACTERISTIC K_ED_DMTL_FEUCHT.KLASSENINDEX "Auswahl der Fehlerklasse" VALUE 0x713A4 TKW_VV_VV_UB 100.0 FORMULA_0003 0.0 8.0 /end CHARACTERISTIC
/begin CHARACTERISTIC K_ED_DMTL_FEUCHT.OK_SCHWELLE "Filterschwelle fuer Fehleraustrag" VALUE 0x7139F TKW_VV_VV_UB 100.0 FORMULA_0003 0.0 255.0 /end CHARACTERISTIC
/begin CHARACTERISTIC K_ED_DMTL_FEUCHT.P_CODE_OPENLOAD "P-Code fuer die Art OPENLOAD" VALUE 0x7139A TKW_VV_VV_UW 100.0 FORMULA_0010 0.0 65535.0 /end CHARACTERISTIC
/begin CHARACTERISTIC K_ED_DMTL_FEUCHT.P_CODE_SH_TO_GND "P-Code fuer die Art SH_TO_GND" VALUE 0x71398 TKW_VV_VV_UW 100.0 FORMULA_0010 0.0 65535.0 /end CHARACTERISTIC
/begin CHARACTERISTIC K_ED_DMTL_FEUCHT.P_CODE_SH_TO_UB "P-Code fuer die Art SH_TO_UB" VALUE 0x71396 TKW_VV_VV_UW 100.0 FORMULA_0010 0.0 65535.0 /end CHARACTERISTIC
/begin CHARACTERISTIC K_ED_DMTL_FEUCHT.P_CODE_UNPLAUSIBEL "P-Code fuer die Art UNPLAUSIBEL" VALUE 0x7139C TKW_VV_VV_UW 100.0 FORMULA_0010 0.0 65535.0 /end CHARACTERISTIC
/begin CHARACTERISTIC K_ED_DMTL_GROBLECK.DEC_NACH_EINTRAG "Filterverringerung nach Fehlerspeichereintrag" VALUE 0x71389 TKW_VV_VV_UB 100.0 FORMULA_0003 0.0 255.0 /end CHARACTERISTIC
/begin CHARACTERISTIC K_ED_DMTL_GROBLECK.DEC_VOR_EINTRAG "Filterverringerung vorm Fehlerspeichereintrag" VALUE 0x71387 TKW_VV_VV_UB 100.0 FORMULA_0003 0.0 255.0 /end CHARACTERISTIC
/begin CHARACTERISTIC K_ED_DMTL_GROBLECK.FEHLERSCHWELLE "Filterschwelle fuer Fehlereintrag" VALUE 0x71384 TKW_VV_VV_UB 100.0 FORMULA_0003 0.0 255.0 /end CHARACTERISTIC
/begin MEASUREMENT ed_fsp_20of20_.ff_lam_reg_f_b2_nv "Lambdaregelfaktor des Freeze Frame" UBYTE FORMULA_0058 0 0.0 0.0 1.99210000038147 READ_WRITE ECU_ADDRESS 0x3FA719 /end MEASUREMENT
/begin MEASUREMENT ed_fsp_20of20_.ff_ml_ges_nv "Luftmasse des Freeze Frame" UWORD FORMULA_0056 0 0.0 0.0 655.3499755859375 READ_WRITE ECU_ADDRESS 0x3FA714 /end MEASUREMENT
/begin MEASUREMENT ed_fsp_20of20_.ff_n_nv "Drehzahl des Freeze Frame" UWORD FORMULA_0055 0 0.0 0.0 16383.75 READ_WRITE ECU_ADDRESS 0x3FA712 /end MEASUREMENT
/begin MEASUREMENT ed_fsp_20of20_.ff_p_code_nv "P-Code des Freeze Frame" UWORD FORMULA_0010 0 0.0 0.0 65535.0 READ_WRITE ECU_ADDRESS 0x3FA710 /end MEASUREMENT
/begin MEASUREMENT ed_fsp_20of20_.ff_pks_ist_nv "Kraftstoffdruck des Freeze Frame" UBYTE FORMULA_0061 0 0.0 0.0 765.0 READ_WRITE ECU_ADDRESS 0x3FA71E /end MEASUREMENT
/begin MEASUREMENT ed_fsp_20of20_.ff_rf_m_nv "Last des Freeze Frame" UBYTE FORMULA_0059 0 0.0 0.0 100.0 READ_WRITE ECU_ADDRESS 0x3FA71C /end MEASUREMENT
/begin MEASUREMENT ed_fsp_20of20_.ff_sl_st_nv "Sekundaerluftstatus des Freeze Frame" UBYTE FORMULA_0064 0 0.0 0.0 255.0 READ_WRITE ECU_ADDRESS 0x3FA723 /end MEASUREMENT
/begin MEASUREMENT ed_fsp_20of20_.ff_tan_m_nv "Ansauglufttemperatur des Freeze Frame" UBYTE FORMULA_0060 0 0.0 -40.0 215.0 READ_WRITE ECU_ADDRESS 0x3FA721 /end MEASUREMENT
/begin MEASUREMENT ed_fsp_20of20_.ff_tmot_nv "Kuehlwassertemperatur des Freeze Frame" UBYTE FORMULA_0060 0 0.0 -40.0 215.0 READ_WRITE ECU_ADDRESS 0x3FA71D /end MEASUREMENT
/begin MEASUREMENT ed_fsp_20of20_.ff_tz1_nv "Zuendwinkel 1 des Freeze Frame" UBYTE FORMULA_0063 0 0.0 -64.0 63.5 READ_WRITE ECU_ADDRESS 0x3FA720 /end MEASUREMENT
/begin MEASUREMENT ed_fsp_20of20_.ff_v_vorne_nv "Geschwindigkeit des Freeze Frame" UBYTE FORMULA_0062 0 0.0 0.0 255.0 READ_WRITE ECU_ADDRESS 0x3FA71F /end MEASUREMENT
/begin MEASUREMENT ed_fsp_20of20_.haeufigkeitszaehler_nv "Uebergangszaehler von i.O. -> n.i.O" UBYTE FORMULA_0003 0 0.0 0.0 255.0 READ_WRITE ECU_ADDRESS 0x3FA6E6 /end MEASUREMENT
/begin MEASUREMENT ed_fsp_20of20_.inj_fehlerzaehler_nv "INJ-Fehlerzaehler" UWORD FORMULA_0010 0 0.0 0.0 65535.0 READ_WRITE ECU_ADDRESS 0x3FA706 /end MEASUREMENT
/begin MEASUREMENT ed_fsp_20of20_.logistikzaehler_nv "Warm-Up-Cycling-Zaehler" UBYTE FORMULA_0003 0 0.0 0.0 255.0 READ_WRITE ECU_ADDRESS 0x3FA6E7 /end MEASUREMENT
/begin MEASUREMENT ed_fsp_20of20_.mil_filter_nv "Filterwert der Milansteuerung" UBYTE FORMULA_0003 0 0.0 0.0 255.0 READ_WRITE ECU_ADDRESS 0x3FA70A /end MEASUREMENT
/begin MEASUREMENT ed_fsp_20of20_.mil_filter_scdn_nv "Similar Conditions Eintragsfilterwert der Milansteuerung" UBYTE FORMULA_0003 0 0.0 0.0 255.0 READ_WRITE ECU_ADDRESS 0x3FA70B /end MEASUREMENT
/begin MEASUREMENT ed_fsp_20of20_.scdn_nenner_nv "Gesamte Anzahl" UWORD FORMULA_0010 0 0.0 0.0 65535.0 READ_WRITE ECU_ADDRESS 0x3FA70E /end MEASUREMENT
/begin MEASUREMENT ed_fsp_20of20_.scdn_zaehler_nv "Im similar Fenster" UWORD FORMULA_0010 0 0.0 0.0 65535.0 READ_WRITE ECU_ADDRESS 0x3FA70C /end MEASUREMENT
/begin MEASUREMENT ed_fsp_20of20_.uw_satz_1of3_.uw_km_stand_nv "Kilometerstand beim Fehlereintrag" UWORD FORMULA_0054 0 0.0 0.0 524280.0 READ_WRITE ECU_ADDRESS 0x3FA6E8 /end MEASUREMENT
/begin MEASUREMENT ed_fsp_20of20_.uw_satz_1of3_.uw_wert_nv_1of4_ "Umweltbedingung beim Fehlereintrag" UWORD FORMULA_0010 0 0.0 0.0 65535.0 READ_WRITE ECU_ADDRESS 0x3FA6EA /end MEASUREMENT
/begin MEASUREMENT ed_fsp_20of20_.uw_satz_1of3_.uw_wert_nv_2of4_ "Umweltbedingung beim Fehlereintrag" UWORD FORMULA_0010 0 0.0 0.0 65535.0 READ_WRITE ECU_ADDRESS 0x3FA6EC /end MEASUREMENT
/begin MEASUREMENT ed_fsp_20of20_.uw_satz_1of3_.uw_wert_nv_3of4_ "Umweltbedingung beim Fehlereintrag" UWORD FORMULA_0010 0 0.0 0.0 65535.0 READ_WRITE ECU_ADDRESS 0x3FA6EE /end MEASUREMENT
/begin MEASUREMENT ed_fsp_20of20_.uw_satz_1of3_.uw_wert_nv_4of4_ "Umweltbedingung beim Fehlereintrag" UWORD FORMULA_0010 0 0.0 0.0 65535.0 READ_WRITE ECU_ADDRESS 0x3FA6F0 /end MEASUREMENT
/begin MEASUREMENT ed_fsp_20of20_.uw_satz_2of3_.uw_km_stand_nv "Kilometerstand beim Fehlereintrag" UWORD FORMULA_0054 0 0.0 0.0 524280.0 READ_WRITE ECU_ADDRESS 0x3FA6F2 /end MEASUREMENT
/begin MEASUREMENT ed_fsp_20of20_.uw_satz_2of3_.uw_wert_nv_1of4_ "Umweltbedingung beim Fehlereintrag" UWORD FORMULA_0010 0 0.0 0.0 65535.0 READ_WRITE ECU_ADDRESS 0x3FA6F4 /end MEASUREMENT
/begin MEASUREMENT ed_fsp_20of20_.uw_satz_2of3_.uw_wert_nv_2of4_ "Umweltbedingung beim Fehlereintrag" UWORD FORMULA_0010 0 0.0 0.0 65535.0 READ_WRITE ECU_ADDRESS 0x3FA6F6 /end MEASUREMENT
/begin MEASUREMENT ed_fsp_20of20_.uw_satz_2of3_.uw_wert_nv_3of4_ "Umweltbedingung beim Fehlereintrag" UWORD FORMULA_0010 0 0.0 0.0 65535.0 READ_WRITE ECU_ADDRESS 0x3FA6F8 /end MEASUREMENT
/begin MEASUREMENT ed_fsp_20of20_.uw_satz_2of3_.uw_wert_nv_4of4_ "Umweltbedingung beim Fehlereintrag" UWORD FORMULA_0010 0 0.0 0.0 65535.0 READ_WRITE ECU_ADDRESS 0x3FA6FA /end MEASUREMENT
/begin MEASUREMENT ed_fsp_20of20_.uw_satz_3of3_.uw_km_stand_nv "Kilometerstand beim Fehlereintrag" UWORD FORMULA_0054 0 0.0 0.0 524280.0 READ_WRITE ECU_ADDRESS 0x3FA6FC /end MEASUREMENT
/begin MEASUREMENT ed_fsp_20of20_.uw_satz_3of3_.uw_wert_nv_1of4_ "Umweltbedingung beim Fehlereintrag" UWORD FORMULA_0010 0 0.0 0.0 65535.0 READ_WRITE ECU_ADDRESS 0x3FA6FE /end MEASUREMENT
/begin MEASUREMENT ed_fsp_20of20_.uw_satz_3of3_.uw_wert_nv_2of4_ "Umweltbedingung beim Fehlereintrag" UWORD FORMULA_0010 0 0.0 0.0 65535.0 READ_WRITE ECU_ADDRESS 0x3FA700 /end MEASUREMENT
/begin MEASUREMENT ed_fsp_20of20_.uw_satz_3of3_.uw_wert_nv_3of4_ "Umweltbedingung beim Fehlereintrag" UWORD FORMULA_0010 0 0.0 0.0 65535.0 READ_WRITE ECU_ADDRESS 0x3FA702 /end MEASUREMENT
/begin MEASUREMENT ed_fsp_20of20_.uw_satz_3of3_.uw_wert_nv_4of4_ "Umweltbedingung beim Fehlereintrag" UWORD FORMULA_0010 0 0.0 0.0 65535.0 READ_WRITE ECU_ADDRESS 0x3FA704 /end MEASUREMENT
/begin MEASUREMENT ed_fsp_2of20_.ed_fil_index_nv "Verweis auf Fehlerfilter" UWORD FORMULA_0010 0 0.0 0.0 65535.0 READ_WRITE ECU_ADDRESS 0x3FA264 /end MEASUREMENT
/begin MEASUREMENT ed_fsp_2of20_.fehlerart_nv "Fehlerart und Statusbits" UWORD FORMULA_0010 0 0.0 0.0 65535.0 READ_WRITE ECU_ADDRESS 0x3FA240 /end MEASUREMENT
/begin MEASUREMENT ed_fsp_2of20_.fehlercode_nv "Externer Fehlerort" UWORD FORMULA_0053 0 0.0 0.0 65535.0 READ_WRITE ECU_ADDRESS 0x3FA23E /end MEASUREMENT
/begin MEASUREMENT ed_fsp_2of20_.ff_egas_ist_dk_b1_nv "Drosselklappenposition des Freeze Frame" UBYTE FORMULA_0059 0 0.0 0.0 100.0 READ_WRITE ECU_ADDRESS 0x3FA27E /end MEASUREMENT
/begin MEASUREMENT ed_fsp_2of20_.ff_laa_f_ber_b1_nv "Lambdaadaptionsfaktor ohne TE des Freeze Frame" UBYTE FORMULA_0058 0 0.0 0.0 1.99210000038147 READ_WRITE ECU_ADDRESS 0x3FA276 /end MEASUREMENT
/begin MEASUREMENT ed_fsp_2of20_.ff_laa_f_ber_b2_nv "Lambdaadaptionsfaktor ohne TE des Freeze Frame" UBYTE FORMULA_0058 0 0.0 0.0 1.99210000038147 READ_WRITE ECU_ADDRESS 0x3FA277 /end MEASUREMENT
/begin MEASUREMENT ed_fsp_2of20_.ff_lam_reg_b1_nv "Einspritzsystem des Freeze Frame" UBYTE FORMULA_0057 0 0.0 0.0 255.0 READ_WRITE ECU_ADDRESS 0x3FA272 /end MEASUREMENT
/begin MEASUREMENT ed_fsp_2of20_.ff_lam_reg_b2_nv "Einspritzsystem des Freeze Frame" UBYTE FORMULA_0057 0 0.0 0.0 255.0 READ_WRITE ECU_ADDRESS 0x3FA273 /end MEASUREMENT
/begin MEASUREMENT ed_fsp_2of20_.ff_lam_reg_f_b1_nv "Lambdaregelfaktor des Freeze Frame" UBYTE FORMULA_0058 0 0.0 0.0 1.99210000038147 READ_WRITE ECU_ADDRESS 0x3FA274 /end MEASUREMENT
/begin MEASUREMENT ed_fsp_2of20_.ff_lam_reg_f_b2_nv "Lambdaregelfaktor des Freeze Frame" UBYTE FORMULA_0058 0 0.0 0.0 1.99210000038147 READ_WRITE ECU_ADDRESS 0x3FA275 /end MEASUREMENT
/begin MEASUREMENT ed_fsp_2of20_.ff_ml_ges_nv "Luftmasse des Freeze Frame" UWORD FORMULA_0056 0 0.0 0.0 655.3499755859375 READ_WRITE ECU_ADDRESS 0x3FA270 /end MEASUREMENT
/begin MEASUREMENT ed_fsp_2of20_.ff_n_nv "Drehzahl des Freeze Frame" UWORD FORMULA_0055 0 0.0 0.0 16383.75 READ_WRITE ECU_ADDRESS 0x3FA26E /end MEASUREMENT
/begin MEASUREMENT ed_fsp_2of20_.ff_p_code_nv "P-Code des Freeze Frame" UWORD FORMULA_0010 0 0.0 0.0 65535.0 READ_WRITE ECU_ADDRESS 0x3FA26C /end MEASUREMENT
/begin MEASUREMENT ed_fsp_2of20_.ff_pks_ist_nv "Kraftstoffdruck des Freeze Frame" UBYTE FORMULA_0061 0 0.0 0.0 765.0 READ_WRITE ECU_ADDRESS 0x3FA27A /end MEASUREMENT
/begin MEASUREMENT ed_fsp_2of20_.ff_rf_m_nv "Last des Freeze Frame" UBYTE FORMULA_0059 0 0.0 0.0 100.0 READ_WRITE ECU_ADDRESS 0x3FA278 /end MEASUREMENT
/begin MEASUREMENT ed_fsp_2of20_.ff_sl_st_nv "Sekundaerluftstatus des Freeze Frame" UBYTE FORMULA_0064 0 0.0 0.0 255.0 READ_WRITE ECU_ADDRESS 0x3FA27F /end MEASUREMENT
/begin MEASUREMENT ed_fsp_2of20_.ff_tan_m_nv "Ansauglufttemperatur des Freeze Frame" UBYTE FORMULA_0060 0 0.0 -40.0 215.0 READ_WRITE ECU_ADDRESS 0x3FA27D /end MEASUREMENT
/begin MEASUREMENT ed_fsp_2of20_.ff_tmot_nv "Kuehlwassertemperatur des Freeze Frame" UBYTE FORMULA_0060 0 0.0 -40.0 215.0 READ_WRITE ECU_ADDRESS 0x3FA279 /end MEASUREMENT
/begin MEASUREMENT ed_fsp_2of20_.ff_tz1_nv "Zuendwinkel 1 des Freeze Frame" UBYTE FORMULA_0063 0 0.0 -64.0 63.5 READ_WRITE ECU_ADDRESS 0x3FA27C /end MEASUREMENT
/begin MEASUREMENT ed_fsp_2of20_.ff_v_vorne_nv "Geschwindigkeit des Freeze Frame" UBYTE FORMULA_0062 0 0.0 0.0 255.0 READ_WRITE ECU_ADDRESS 0x3FA27B /end MEASUREMENT
/begin MEASUREMENT ed_fsp_2of20_.haeufigkeitszaehler_nv "Uebergangszaehler von i.O. -> n.i.O" UBYTE FORMULA_0003 0 0.0 0.0 255.0 READ_WRITE ECU_ADDRESS 0x3FA242 /end MEASUREMENT
/begin MEASUREMENT ed_fsp_2of20_.inj_fehlerzaehler_nv "INJ-Fehlerzaehler" UWORD FORMULA_0010 0 0.0 0.0 65535.0 READ_WRITE ECU_ADDRESS 0x3FA262 /end MEASUREMENT
/begin MEASUREMENT ed_fsp_2of20_.logistikzaehler_nv "Warm-Up-Cycling-Zaehler" UBYTE FORMULA_0003 0 0.0 0.0 255.0 READ_WRITE ECU_ADDRESS 0x3FA243 /end MEASUREMENT
/begin MEASUREMENT ed_fsp_2of20_.mil_filter_nv "Filterwert der Milansteuerung" UBYTE FORMULA_0003 0 0.0 0.0 255.0 READ_WRITE ECU_ADDRESS 0x3FA266 /end MEASUREMENT
/begin MEASUREMENT ed_fsp_2of20_.mil_filter_scdn_nv "Similar Conditions Eintragsfilterwert der Milansteuerung" UBYTE FORMULA_0003 0 0.0 0.0 255.0 READ_WRITE ECU_ADDRESS 0x3FA267 /end MEASUREMENT
/begin MEASUREMENT ed_fsp_2of20_.scdn_nenner_nv "Gesamte Anzahl" UWORD FORMULA_0010 0 0.0 0.0 65535.0 READ_WRITE ECU_ADDRESS 0x3FA26A /end MEASUREMENT
/begin MEASUREMENT ed_fsp_2of20_.scdn_zaehler_nv "Im similar Fenster" UWORD FORMULA_0010 0 0.0 0.0 65535.0 READ_WRITE ECU_ADDRESS 0x3FA268 /end MEASUREMENT
/begin MEASUREMENT ed_fsp_2of20_.uw_satz_1of3_.uw_km_stand_nv "Kilometerstand beim Fehlereintrag" UWORD FORMULA_0054 0 0.0 0.0 524280.0 READ_WRITE ECU_ADDRESS 0x3FA244 /end MEASUREMENT
/begin MEASUREMENT ed_fsp_2of20_.uw_satz_1of3_.uw_wert_nv_1of4_ "Umweltbedingung beim Fehlereintrag" UWORD FORMULA_0010 0 0.0 0.0 65535.0 READ_WRITE ECU_ADDRESS 0x3FA246 /end MEASUREMENT
/begin MEASUREMENT ed_fsp_2of20_.uw_satz_1of3_.uw_wert_nv_2of4_ "Umweltbedingung beim Fehlereintrag" UWORD FORMULA_0010 0 0.0 0.0 65535.0 READ_WRITE ECU_ADDRESS 0x3FA248 /end MEASUREMENT
/begin MEASUREMENT ed_fsp_2of20_.uw_satz_1of3_.uw_wert_nv_3of4_ "Umweltbedingung beim Fehlereintrag" UWORD FORMULA_0010 0 0.0 0.0 65535.0 READ_WRITE ECU_ADDRESS 0x3FA24A /end MEASUREMENT
/begin MEASUREMENT ed_fsp_2of20_.uw_satz_1of3_.uw_wert_nv_4of4_ "Umweltbedingung beim Fehlereintrag" UWORD FORMULA_0010 0 0.0 0.0 65535.0 READ_WRITE ECU_ADDRESS 0x3FA24C /end MEASUREMENT
/begin MEASUREMENT ed_fsp_2of20_.uw_satz_2of3_.uw_km_stand_nv "Kilometerstand beim Fehlereintrag" UWORD FORMULA_0054 0 0.0 0.0 524280.0 READ_WRITE ECU_ADDRESS 0x3FA24E /end MEASUREMENT
/begin MEASUREMENT ed_fsp_2of20_.uw_satz_2of3_.uw_wert_nv_1of4_ "Umweltbedingung beim Fehlereintrag" UWORD FORMULA_0010 0 0.0 0.0 65535.0 READ_WRITE ECU_ADDRESS 0x3FA250 /end MEASUREMENT
/begin MEASUREMENT ed_fsp_2of20_.uw_satz_2of3_.uw_wert_nv_2of4_ "Umweltbedingung beim Fehlereintrag" UWORD FORMULA_0010 0 0.0 0.0 65535.0 READ_WRITE ECU_ADDRESS 0x3FA252 /end MEASUREMENT
/begin MEASUREMENT ed_fsp_2of20_.uw_satz_2of3_.uw_wert_nv_3of4_ "Umweltbedingung beim Fehlereintrag" UWORD FORMULA_0010 0 0.0 0.0 65535.0 READ_WRITE ECU_ADDRESS 0x3FA254 /end MEASUREMENT
/begin MEASUREMENT ed_fsp_2of20_.uw_satz_2of3_.uw_wert_nv_4of4_ "Umweltbedingung beim Fehlereintrag" UWORD FORMULA_0010 0 0.0 0.0 65535.0 READ_WRITE ECU_ADDRESS 0x3FA256 /end MEASUREMENT
/begin MEASUREMENT ed_fsp_2of20_.uw_satz_3of3_.uw_km_stand_nv "Kilometerstand beim Fehlereintrag" UWORD FORMULA_0054 0 0.0 0.0 524280.0 READ_WRITE ECU_ADDRESS 0x3FA258 /end MEASUREMENT
/begin MEASUREMENT ed_fsp_2of20_.uw_satz_3of3_.uw_wert_nv_1of4_ "Umweltbedingung beim Fehlereintrag" UWORD FORMULA_0010 0 0.0 0.0 65535.0 READ_WRITE ECU_ADDRESS 0x3FA25A /end MEASUREMENT
/begin MEASUREMENT ed_fsp_2of20_.uw_satz_3of3_.uw_wert_nv_2of4_ "Umweltbedingung beim Fehlereintrag" UWORD FORMULA_0010 0 0.0 0.0 65535.0 READ_WRITE ECU_ADDRESS 0x3FA25C /end MEASUREMENT
/begin MEASUREMENT ed_fsp_2of20_.uw_satz_3of3_.uw_wert_nv_3of4_ "Umweltbedingung beim Fehlereintrag" UWORD FORMULA_0010 0 0.0 0.0 65535.0 READ_WRITE ECU_ADDRESS 0x3FA25E /end MEASUREMENT
/begin MEASUREMENT ed_fsp_2of20_.uw_satz_3of3_.uw_wert_nv_4of4_ "Umweltbedingung beim Fehlereintrag" UWORD FORMULA_0010 0 0.0 0.0 65535.0 READ_WRITE ECU_ADDRESS 0x3FA260 /end MEASUREMENT
/begin MEASUREMENT ed_fsp_3of20_.ed_fil_index_nv "Verweis auf Fehlerfilter" UWORD FORMULA_0010 0 0.0 0.0 65535.0 READ_WRITE ECU_ADDRESS 0x3FA2A6 /end MEASUREMENT
/begin MEASUREMENT ed_fsp_3of20_.fehlerart_nv "Fehlerart und Statusbits" UWORD FORMULA_0010 0 0.0 0.0 65535.0 READ_WRITE ECU_ADDRESS 0x3FA282 /end MEASUREMENT
/begin MEASUREMENT ed_fsp_3of20_.fehlercode_nv "Externer Fehlerort" UWORD FORMULA_0053 0 0.0 0.0 65535.0 READ_WRITE ECU_ADDRESS 0x3FA280 /end MEASUREMENT
/begin MEASUREMENT ed_fsp_3of20_.ff_egas_ist_dk_b1_nv "Drosselklappenposition des Freeze Frame" UBYTE FORMULA_0059 0 0.0 0.0 100.0 READ_WRITE ECU_ADDRESS 0x3FA2C0 /end MEASUREMENT
/begin MEASUREMENT ed_fsp_3of20_.ff_laa_f_ber_b1_nv "Lambdaadaptionsfaktor ohne TE des Freeze Frame" UBYTE FORMULA_0058 0 0.0 0.0 1.99210000038147 READ_WRITE ECU_ADDRESS 0x3FA2B8 /end MEASUREMENT
/begin MEASUREMENT ed_fsp_3of20_.ff_laa_f_ber_b2_nv "Lambdaadaptionsfaktor ohne TE des Freeze Frame" UBYTE FORMULA_0058 0 0.0 0.0 1.99210000038147 READ_WRITE ECU_ADDRESS 0x3FA2B9 /end MEASUREMENT
/begin MEASUREMENT ed_fsp_3of20_.ff_lam_reg_b1_nv "Einspritzsystem des Freeze Frame" UBYTE FORMULA_0057 0 0.0 0.0 255.0 READ_WRITE ECU_ADDRESS 0x3FA2B4 /end MEASUREMENT
/begin MEASUREMENT ed_fsp_3of20_.ff_lam_reg_b2_nv "Einspritzsystem des Freeze Frame" UBYTE FORMULA_0057 0 0.0 0.0 255.0 READ_WRITE ECU_ADDRESS 0x3FA2B5 /end MEASUREMENT
/begin MEASUREMENT ed_fsp_3of20_.ff_lam_reg_f_b1_nv "Lambdaregelfaktor des Freeze Frame" UBYTE FORMULA_0058 0 0.0 0.0 1.99210000038147 READ_WRITE ECU_ADDRESS 0x3FA2B6 /end MEASUREMENT
/begin MEASUREMENT ed_fsp_3of20_.ff_lam_reg_f_b2_nv "Lambdaregelfaktor des Freeze Frame" UBYTE FORMULA_0058 0 0.0 0.0 1.99210000038147 READ_WRITE ECU_ADDRESS 0x3FA2B7 /end MEASUREMENT
/begin MEASUREMENT ed_fsp_3of20_.ff_ml_ges_nv "Luftmasse des Freeze Frame" UWORD FORMULA_0056 0 0.0 0.0 655.3499755859375 READ_WRITE ECU_ADDRESS 0x3FA2B2 /end MEASUREMENT
/begin MEASUREMENT ed_fsp_3of20_.ff_n_nv "Drehzahl des Freeze Frame" UWORD FORMULA_0055 0 0.0 0.0 16383.75 READ_WRITE ECU_ADDRESS 0x3FA2B0 /end MEASUREMENT
/begin MEASUREMENT ed_fsp_3of20_.ff_p_code_nv "P-Code des Freeze Frame" UWORD FORMULA_0010 0 0.0 0.0 65535.0 READ_WRITE ECU_ADDRESS 0x3FA2AE /end MEASUREMENT
/begin MEASUREMENT ed_fsp_3of20_.ff_pks_ist_nv "Kraftstoffdruck des Freeze Frame" UBYTE FORMULA_0061 0 0.0 0.0 765.0 READ_WRITE ECU_ADDRESS 0x3FA2BC /end MEASUREMENT
/begin MEASUREMENT ed_fsp_3of20_.ff_rf_m_nv "Last des Freeze Frame" UBYTE FORMULA_0059 0 0.0 0.0 100.0 READ_WRITE ECU_ADDRESS 0x3FA2BA /end MEASUREMENT
/begin MEASUREMENT ed_fsp_3of20_.ff_sl_st_nv "Sekundaerluftstatus des Freeze Frame" UBYTE FORMULA_0064 0 0.0 0.0 255.0 READ_WRITE ECU_ADDRESS 0x3FA2C1 /end MEASUREMENT
/begin MEASUREMENT ed_fsp_3of20_.ff_tan_m_nv "Ansauglufttemperatur des Freeze Frame" UBYTE FORMULA_0060 0 0.0 -40.0 215.0 READ_WRITE ECU_ADDRESS 0x3FA2BF /end MEASUREMENT
/begin MEASUREMENT ed_fsp_3of20_.ff_tmot_nv "Kuehlwassertemperatur des Freeze Frame" UBYTE FORMULA_0060 0 0.0 -40.0 215.0 READ_WRITE ECU_ADDRESS 0x3FA2BB /end MEASUREMENT
/begin MEASUREMENT ed_fsp_3of20_.ff_tz1_nv "Zuendwinkel 1 des Freeze Frame" UBYTE FORMULA_0063 0 0.0 -64.0 63.5 READ_WRITE ECU_ADDRESS 0x3FA2BE /end MEASUREMENT
/begin MEASUREMENT ed_fsp_3of20_.ff_v_vorne_nv "Geschwindigkeit des Freeze Frame" UBYTE FORMULA_0062 0 0.0 0.0 255.0 READ_WRITE ECU_ADDRESS 0x3FA2BD /end MEASUREMENT
/begin MEASUREMENT ed_fsp_3of20_.haeufigkeitszaehler_nv "Uebergangszaehler von i.O. -> n.i.O" UBYTE FORMULA_0003 0 0.0 0.0 255.0 READ_WRITE ECU_ADDRESS 0x3FA284 /end MEASUREMENT
/begin MEASUREMENT ed_fsp_3of20_.inj_fehlerzaehler_nv "INJ-Fehlerzaehler" UWORD FORMULA_0010 0 0.0 0.0 65535.0 READ_WRITE ECU_ADDRESS 0x3FA2A4 /end MEASUREMENT
/begin MEASUREMENT ed_fsp_3of20_.logistikzaehler_nv "Warm-Up-Cycling-Zaehler" UBYTE FORMULA_0003 0 0.0 0.0 255.0 READ_WRITE ECU_ADDRESS 0x3FA285 /end MEASUREMENT
/begin MEASUREMENT ed_fsp_3of20_.mil_filter_nv "Filterwert der Milansteuerung" UBYTE FORMULA_0003 0 0.0 0.0 255.0 READ_WRITE ECU_ADDRESS 0x3FA2A8 /end MEASUREMENT
/begin MEASUREMENT ed_fsp_3of20_.mil_filter_scdn_nv "Similar Conditions Eintragsfilterwert der Milansteuerung" UBYTE FORMULA_0003 0 0.0 0.0 255.0 READ_WRITE ECU_ADDRESS 0x3FA2A9 /end MEASUREMENT
/begin MEASUREMENT ed_fsp_3of20_.scdn_nenner_nv "Gesamte Anzahl" UWORD FORMULA_0010 0 0.0 0.0 65535.0 READ_WRITE ECU_ADDRESS 0x3FA2AC /end MEASUREMENT
/begin MEASUREMENT ed_fsp_3of20_.scdn_zaehler_nv "Im similar Fenster" UWORD FORMULA_0010 0 0.0 0.0 65535.0 READ_WRITE ECU_ADDRESS 0x3FA2AA /end MEASUREMENT
/begin MEASUREMENT ed_fsp_3of20_.uw_satz_1of3_.uw_km_stand_nv "Kilometerstand beim Fehlereintrag" UWORD FORMULA_0054 0 0.0 0.0 524280.0 READ_WRITE ECU_ADDRESS 0x3FA286 /end MEASUREMENT
/begin MEASUREMENT ed_fsp_3of20_.uw_satz_1of3_.uw_wert_nv_1of4_ "Umweltbedingung beim Fehlereintrag" UWORD FORMULA_0010 0 0.0 0.0 65535.0 READ_WRITE ECU_ADDRESS 0x3FA288 /end MEASUREMENT
/begin MEASUREMENT ed_fsp_3of20_.uw_satz_1of3_.uw_wert_nv_2of4_ "Umweltbedingung beim Fehlereintrag" UWORD FORMULA_0010 0 0.0 0.0 65535.0 READ_WRITE ECU_ADDRESS 0x3FA28A /end MEASUREMENT
/begin MEASUREMENT ed_fsp_3of20_.uw_satz_1of3_.uw_wert_nv_3of4_ "Umweltbedingung beim Fehlereintrag" UWORD FORMULA_0010 0 0.0 0.0 65535.0 READ_WRITE ECU_ADDRESS 0x3FA28C /end MEASUREMENT
/begin MEASUREMENT ed_fsp_3of20_.uw_satz_1of3_.uw_wert_nv_4of4_ "Umweltbedingung beim Fehlereintrag" UWORD FORMULA_0010 0 0.0 0.0 65535.0 READ_WRITE ECU_ADDRESS 0x3FA28E /end MEASUREMENT
/begin MEASUREMENT ed_fsp_3of20_.uw_satz_2of3_.uw_km_stand_nv "Kilometerstand beim Fehlereintrag" UWORD FORMULA_0054 0 0.0 0.0 524280.0 READ_WRITE ECU_ADDRESS 0x3FA290 /end MEASUREMENT
/begin MEASUREMENT ed_fsp_3of20_.uw_satz_2of3_.uw_wert_nv_1of4_ "Umweltbedingung beim Fehlereintrag" UWORD FORMULA_0010 0 0.0 0.0 65535.0 READ_WRITE ECU_ADDRESS 0x3FA292 /end MEASUREMENT
/begin MEASUREMENT ed_fsp_3of20_.uw_satz_2of3_.uw_wert_nv_2of4_ "Umweltbedingung beim Fehlereintrag" UWORD FORMULA_0010 0 0.0 0.0 65535.0 READ_WRITE ECU_ADDRESS 0x3FA294 /end MEASUREMENT
/begin MEASUREMENT ed_fsp_3of20_.uw_satz_2of3_.uw_wert_nv_3of4_ "Umweltbedingung beim Fehlereintrag" UWORD FORMULA_0010 0 0.0 0.0 65535.0 READ_WRITE ECU_ADDRESS 0x3FA296 /end MEASUREMENT
/begin MEASUREMENT ed_fsp_3of20_.uw_satz_2of3_.uw_wert_nv_4of4_ "Umweltbedingung beim Fehlereintrag" UWORD FORMULA_0010 0 0.0 0.0 65535.0 READ_WRITE ECU_ADDRESS 0x3FA298 /end MEASUREMENT
/begin MEASUREMENT ed_fsp_3of20_.uw_satz_3of3_.uw_km_stand_nv "Kilometerstand beim Fehlereintrag" UWORD FORMULA_0054 0 0.0 0.0 524280.0 READ_WRITE ECU_ADDRESS 0x3FA29A /end MEASUREMENT
/begin MEASUREMENT ed_fsp_3of20_.uw_satz_3of3_.uw_wert_nv_1of4_ "Umweltbedingung beim Fehlereintrag" UWORD FORMULA_0010 0 0.0 0.0 65535.0 READ_WRITE ECU_ADDRESS 0x3FA29C /end MEASUREMENT
/begin MEASUREMENT ed_fsp_3of20_.uw_satz_3of3_.uw_wert_nv_2of4_ "Umweltbedingung beim Fehlereintrag" UWORD FORMULA_0010 0 0.0 0.0 65535.0 READ_WRITE ECU_ADDRESS 0x3FA29E /end MEASUREMENT
/begin MEASUREMENT ed_fsp_3of20_.uw_satz_3of3_.uw_wert_nv_3of4_ "Umweltbedingung beim Fehlereintrag" UWORD FORMULA_0010 0 0.0 0.0 65535.0 READ_WRITE ECU_ADDRESS 0x3FA2A0 /end MEASUREMENT
/begin MEASUREMENT ed_fsp_3of20_.uw_satz_3of3_.uw_wert_nv_4of4_ "Umweltbedingung beim Fehlereintrag" UWORD FORMULA_0010 0 0.0 0.0 65535.0 READ_WRITE ECU_ADDRESS 0x3FA2A2 /end MEASUREMENT
/begin MEASUREMENT ed_fsp_4of20_.ed_fil_index_nv "Verweis auf Fehlerfilter" UWORD FORMULA_0010 0 0.0 0.0 65535.0 READ_WRITE ECU_ADDRESS 0x3FA2E8 /end MEASUREMENT
/begin MEASUREMENT ed_fsp_4of20_.fehlerart_nv "Fehlerart und Statusbits" UWORD FORMULA_0010 0 0.0 0.0 65535.0 READ_WRITE ECU_ADDRESS 0x3FA2C4 /end MEASUREMENT
/begin MEASUREMENT ed_fsp_4of20_.fehlercode_nv "Externer Fehlerort" UWORD FORMULA_0053 0 0.0 0.0 65535.0 READ_WRITE ECU_ADDRESS 0x3FA2C2 /end MEASUREMENT
/begin MEASUREMENT ed_fsp_4of20_.ff_egas_ist_dk_b1_nv "Drosselklappenposition des Freeze Frame" UBYTE FORMULA_0059 0 0.0 0.0 100.0 READ_WRITE ECU_ADDRESS 0x3FA302 /end MEASUREMENT
/begin MEASUREMENT ed_fsp_4of20_.ff_laa_f_ber_b1_nv "Lambdaadaptionsfaktor ohne TE des Freeze Frame" UBYTE FORMULA_0058 0 0.0 0.0 1.99210000038147 READ_WRITE ECU_ADDRESS 0x3FA2FA /end MEASUREMENT
/begin MEASUREMENT ed_fsp_4of20_.ff_laa_f_ber_b2_nv "Lambdaadaptionsfaktor ohne TE des Freeze Frame" UBYTE FORMULA_0058 0 0.0 0.0 1.99210000038147 READ_WRITE ECU_ADDRESS 0x3FA2FB /end MEASUREMENT
/begin MEASUREMENT ed_fsp_4of20_.ff_lam_reg_b1_nv "Einspritzsystem des Freeze Frame" UBYTE FORMULA_0057 0 0.0 0.0 255.0 READ_WRITE ECU_ADDRESS 0x3FA2F6 /end MEASUREMENT
/begin MEASUREMENT ed_fsp_4of20_.ff_lam_reg_b2_nv "Einspritzsystem des Freeze Frame" UBYTE FORMULA_0057 0 0.0 0.0 255.0 READ_WRITE ECU_ADDRESS 0x3FA2F7 /end MEASUREMENT
/begin MEASUREMENT ed_fsp_4of20_.ff_lam_reg_f_b1_nv "Lambdaregelfaktor des Freeze Frame" UBYTE FORMULA_0058 0 0.0 0.0 1.99210000038147 READ_WRITE ECU_ADDRESS 0x3FA2F8 /end MEASUREMENT
/begin MEASUREMENT ed_fsp_4of20_.ff_lam_reg_f_b2_nv "Lambdaregelfaktor des Freeze Frame" UBYTE FORMULA_0058 0 0.0 0.0 1.99210000038147 READ_WRITE ECU_ADDRESS 0x3FA2F9 /end MEASUREMENT
/begin MEASUREMENT ed_fsp_4of20_.ff_ml_ges_nv "Luftmasse des Freeze Frame" UWORD FORMULA_0056 0 0.0 0.0 655.3499755859375 READ_WRITE ECU_ADDRESS 0x3FA2F4 /end MEASUREMENT
/begin MEASUREMENT ed_fsp_4of20_.ff_n_nv "Drehzahl des Freeze Frame" UWORD FORMULA_0055 0 0.0 0.0 16383.75 READ_WRITE ECU_ADDRESS 0x3FA2F2 /end MEASUREMENT
/begin MEASUREMENT ed_fsp_4of20_.ff_p_code_nv "P-Code des Freeze Frame" UWORD FORMULA_0010 0 0.0 0.0 65535.0 READ_WRITE ECU_ADDRESS 0x3FA2F0 /end MEASUREMENT
/begin MEASUREMENT ed_fsp_4of20_.ff_pks_ist_nv "Kraftstoffdruck des Freeze Frame" UBYTE FORMULA_0061 0 0.0 0.0 765.0 READ_WRITE ECU_ADDRESS 0x3FA2FE /end MEASUREMENT
/begin MEASUREMENT ed_fsp_4of20_.ff_rf_m_nv "Last des Freeze Frame" UBYTE FORMULA_0059 0 0.0 0.0 100.0 READ_WRITE ECU_ADDRESS 0x3FA2FC /end MEASUREMENT
/begin MEASUREMENT ed_fsp_4of20_.ff_sl_st_nv "Sekundaerluftstatus des Freeze Frame" UBYTE FORMULA_0064 0 0.0 0.0 255.0 READ_WRITE ECU_ADDRESS 0x3FA303 /end MEASUREMENT
/begin MEASUREMENT ed_fsp_4of20_.ff_tan_m_nv "Ansauglufttemperatur des Freeze Frame" UBYTE FORMULA_0060 0 0.0 -40.0 215.0 READ_WRITE ECU_ADDRESS 0x3FA301 /end MEASUREMENT
/begin MEASUREMENT ed_fsp_4of20_.ff_tmot_nv "Kuehlwassertemperatur des Freeze Frame" UBYTE FORMULA_0060 0 0.0 -40.0 215.0 READ_WRITE ECU_ADDRESS 0x3FA2FD /end MEASUREMENT
/begin MEASUREMENT ed_fsp_4of20_.ff_tz1_nv "Zuendwinkel 1 des Freeze Frame" UBYTE FORMULA_0063 0 0.0 -64.0 63.5 READ_WRITE ECU_ADDRESS 0x3FA300 /end MEASUREMENT
/begin MEASUREMENT ed_fsp_4of20_.ff_v_vorne_nv "Geschwindigkeit des Freeze Frame" UBYTE FORMULA_0062 0 0.0 0.0 255.0 READ_WRITE ECU_ADDRESS 0x3FA2FF /end MEASUREMENT
/begin MEASUREMENT ed_fsp_4of20_.haeufigkeitszaehler_nv "Uebergangszaehler von i.O. -> n.i.O" UBYTE FORMULA_0003 0 0.0 0.0 255.0 READ_WRITE ECU_ADDRESS 0x3FA2C6 /end MEASUREMENT
/begin MEASUREMENT ed_fsp_4of20_.inj_fehlerzaehler_nv "INJ-Fehlerzaehler" UWORD FORMULA_0010 0 0.0 0.0 65535.0 READ_WRITE ECU_ADDRESS 0x3FA2E6 /end MEASUREMENT
/begin MEASUREMENT ed_fsp_4of20_.logistikzaehler_nv "Warm-Up-Cycling-Zaehler" UBYTE FORMULA_0003 0 0.0 0.0 255.0 READ_WRITE ECU_ADDRESS 0x3FA2C7 /end MEASUREMENT
/begin MEASUREMENT ed_fsp_4of20_.mil_filter_nv "Filterwert der Milansteuerung" UBYTE FORMULA_0003 0 0.0 0.0 255.0 READ_WRITE ECU_ADDRESS 0x3FA2EA /end MEASUREMENT
/begin MEASUREMENT ed_fsp_4of20_.mil_filter_scdn_nv "Similar Conditions Eintragsfilterwert der Milansteuerung" UBYTE FORMULA_0003 0 0.0 0.0 255.0 READ_WRITE ECU_ADDRESS 0x3FA2EB /end MEASUREMENT
/begin MEASUREMENT ed_fsp_4of20_.scdn_nenner_nv "Gesamte Anzahl" UWORD FORMULA_0010 0 0.0 0.0 65535.0 READ_WRITE ECU_ADDRESS 0x3FA2EE /end MEASUREMENT
/begin MEASUREMENT ed_fsp_4of20_.scdn_zaehler_nv "Im similar Fenster" UWORD FORMULA_0010 0 0.0 0.0 65535.0 READ_WRITE ECU_ADDRESS 0x3FA2EC /end MEASUREMENT
/begin MEASUREMENT ed_fsp_4of20_.uw_satz_1of3_.uw_km_stand_nv "Kilometerstand beim Fehlereintrag" UWORD FORMULA_0054 0 0.0 0.0 524280.0 READ_WRITE ECU_ADDRESS 0x3FA2C8 /end MEASUREMENT
/begin MEASUREMENT ed_fsp_4of20_.uw_satz_1of3_.uw_wert_nv_1of4_ "Umweltbedingung beim Fehlereintrag" UWORD FORMULA_0010 0 0.0 0.0 65535.0 READ_WRITE ECU_ADDRESS 0x3FA2CA /end MEASUREMENT
/begin MEASUREMENT ed_fsp_4of20_.uw_satz_1of3_.uw_wert_nv_2of4_ "Umweltbedingung beim Fehlereintrag" UWORD FORMULA_0010 0 0.0 0.0 65535.0 READ_WRITE ECU_ADDRESS 0x3FA2CC /end MEASUREMENT
/begin MEASUREMENT ed_fsp_4of20_.uw_satz_1of3_.uw_wert_nv_3of4_ "Umweltbedingung beim Fehlereintrag" UWORD FORMULA_0010 0 0.0 0.0 65535.0 READ_WRITE ECU_ADDRESS 0x3FA2CE /end MEASUREMENT
/begin MEASUREMENT ed_fsp_4of20_.uw_satz_1of3_.uw_wert_nv_4of4_ "Umweltbedingung beim Fehlereintrag" UWORD FORMULA_0010 0 0.0 0.0 65535.0 READ_WRITE ECU_ADDRESS 0x3FA2D0 /end MEASUREMENT
/begin MEASUREMENT ed_fsp_4of20_.uw_satz_2of3_.uw_km_stand_nv "Kilometerstand beim Fehlereintrag" UWORD FORMULA_0054 0 0.0 0.0 524280.0 READ_WRITE ECU_ADDRESS 0x3FA2D2 /end MEASUREMENT
/begin MEASUREMENT ed_fsp_4of20_.uw_satz_2of3_.uw_wert_nv_1of4_ "Umweltbedingung beim Fehlereintrag" UWORD FORMULA_0010 0 0.0 0.0 65535.0 READ_WRITE ECU_ADDRESS 0x3FA2D4 /end MEASUREMENT
/begin MEASUREMENT ed_fsp_4of20_.uw_satz_2of3_.uw_wert_nv_2of4_ "Umweltbedingung beim Fehlereintrag" UWORD FORMULA_0010 0 0.0 0.0 65535.0 READ_WRITE ECU_ADDRESS 0x3FA2D6 /end MEASUREMENT
/begin MEASUREMENT ed_fsp_4of20_.uw_satz_2of3_.uw_wert_nv_3of4_ "Umweltbedingung beim Fehlereintrag" UWORD FORMULA_0010 0 0.0 0.0 65535.0 READ_WRITE ECU_ADDRESS 0x3FA2D8 /end MEASUREMENT
/begin MEASUREMENT ed_fsp_4of20_.uw_satz_2of3_.uw_wert_nv_4of4_ "Umweltbedingung beim Fehlereintrag" UWORD FORMULA_0010 0 0.0 0.0 65535.0 READ_WRITE ECU_ADDRESS 0x3FA2DA /end MEASUREMENT
/begin MEASUREMENT ed_fsp_4of20_.uw_satz_3of3_.uw_km_stand_nv "Kilometerstand beim Fehlereintrag" UWORD FORMULA_0054 0 0.0 0.0 524280.0 READ_WRITE ECU_ADDRESS 0x3FA2DC /end MEASUREMENT
/begin MEASUREMENT ed_fsp_4of20_.uw_satz_3of3_.uw_wert_nv_1of4_ "Umweltbedingung beim Fehlereintrag" UWORD FORMULA_0010 0 0.0 0.0 65535.0 READ_WRITE ECU_ADDRESS 0x3FA2DE /end MEASUREMENT
/begin MEASUREMENT ed_fsp_4of20_.uw_satz_3of3_.uw_wert_nv_2of4_ "Umweltbedingung beim Fehlereintrag" UWORD FORMULA_0010 0 0.0 0.0 65535.0 READ_WRITE ECU_ADDRESS 0x3FA2E0 /end MEASUREMENT
/begin MEASUREMENT ed_fsp_4of20_.uw_satz_3of3_.uw_wert_nv_3of4_ "Umweltbedingung beim Fehlereintrag" UWORD FORMULA_0010 0 0.0 0.0 65535.0 READ_WRITE ECU_ADDRESS 0x3FA2E2 /end MEASUREMENT
/begin MEASUREMENT ed_fsp_4of20_.uw_satz_3of3_.uw_wert_nv_4of4_ "Umweltbedingung beim Fehlereintrag" UWORD FORMULA_0010 0 0.0 0.0 65535.0 READ_WRITE ECU_ADDRESS 0x3FA2E4 /end MEASUREMENT
/begin MEASUREMENT ed_fsp_5of20_.ed_fil_index_nv "Verweis auf Fehlerfilter" UWORD FORMULA_0010 0 0.0 0.0 65535.0 READ_WRITE ECU_ADDRESS 0x3FA32A /end MEASUREMENT
/begin MEASUREMENT ed_fsp_5of20_.fehlerart_nv "Fehlerart und Statusbits" UWORD FORMULA_0010 0 0.0 0.0 65535.0 READ_WRITE ECU_ADDRESS 0x3FA306 /end MEASUREMENT
/begin MEASUREMENT ed_fsp_5of20_.fehlercode_nv "Externer Fehlerort" UWORD FORMULA_0053 0 0.0 0.0 65535.0 READ_WRITE ECU_ADDRESS 0x3FA304 /end MEASUREMENT
/begin MEASUREMENT ed_fsp_5of20_.ff_egas_ist_dk_b1_nv "Drosselklappenposition des Freeze Frame" UBYTE FORMULA_0059 0 0.0 0.0 100.0 READ_WRITE ECU_ADDRESS 0x3FA344 /end MEASUREMENT
/begin MEASUREMENT ed_fsp_5of20_.ff_laa_f_ber_b1_nv "Lambdaadaptionsfaktor ohne TE des Freeze Frame" UBYTE FORMULA_0058 0 0.0 0.0 1.99210000038147 READ_WRITE ECU_ADDRESS 0x3FA33C /end MEASUREMENT
/begin MEASUREMENT ed_fsp_5of20_.ff_laa_f_ber_b2_nv "Lambdaadaptionsfaktor ohne TE des Freeze Frame" UBYTE FORMULA_0058 0 0.0 0.0 1.99210000038147 READ_WRITE ECU_ADDRESS 0x3FA33D /end MEASUREMENT
/begin MEASUREMENT ed_fsp_5of20_.ff_lam_reg_b1_nv "Einspritzsystem des Freeze Frame" UBYTE FORMULA_0057 0 0.0 0.0 255.0 READ_WRITE ECU_ADDRESS 0x3FA338 /end MEASUREMENT
/begin MEASUREMENT ed_fsp_5of20_.ff_lam_reg_b2_nv "Einspritzsystem des Freeze Frame" UBYTE FORMULA_0057 0 0.0 0.0 255.0 READ_WRITE ECU_ADDRESS 0x3FA339 /end MEASUREMENT
/begin MEASUREMENT ed_fsp_5of20_.ff_lam_reg_f_b1_nv "Lambdaregelfaktor des Freeze Frame" UBYTE FORMULA_0058 0 0.0 0.0 1.99210000038147 READ_WRITE ECU_ADDRESS 0x3FA33A /end MEASUREMENT
/begin MEASUREMENT ed_fsp_5of20_.ff_lam_reg_f_b2_nv "Lambdaregelfaktor des Freeze Frame" UBYTE FORMULA_0058 0 0.0 0.0 1.99210000038147 READ_WRITE ECU_ADDRESS 0x3FA33B /end MEASUREMENT
/begin MEASUREMENT ed_fsp_5of20_.ff_ml_ges_nv "Luftmasse des Freeze Frame" UWORD FORMULA_0056 0 0.0 0.0 655.3499755859375 READ_WRITE ECU_ADDRESS 0x3FA336 /end MEASUREMENT
/begin MEASUREMENT ed_fsp_5of20_.ff_n_nv "Drehzahl des Freeze Frame" UWORD FORMULA_0055 0 0.0 0.0 16383.75 READ_WRITE ECU_ADDRESS 0x3FA334 /end MEASUREMENT
/begin MEASUREMENT ed_fsp_5of20_.ff_p_code_nv "P-Code des Freeze Frame" UWORD FORMULA_0010 0 0.0 0.0 65535.0 READ_WRITE ECU_ADDRESS 0x3FA332 /end MEASUREMENT
/begin MEASUREMENT ed_fsp_5of20_.ff_pks_ist_nv "Kraftstoffdruck des Freeze Frame" UBYTE FORMULA_0061 0 0.0 0.0 765.0 READ_WRITE ECU_ADDRESS 0x3FA340 /end MEASUREMENT
/begin MEASUREMENT ed_fsp_5of20_.ff_rf_m_nv "Last des Freeze Frame" UBYTE FORMULA_0059 0 0.0 0.0 100.0 READ_WRITE ECU_ADDRESS 0x3FA33E /end MEASUREMENT
/begin MEASUREMENT ed_fsp_5of20_.ff_sl_st_nv "Sekundaerluftstatus des Freeze Frame" UBYTE FORMULA_0064 0 0.0 0.0 255.0 READ_WRITE ECU_ADDRESS 0x3FA345 /end MEASUREMENT
/begin MEASUREMENT ed_fsp_5of20_.ff_tan_m_nv "Ansauglufttemperatur des Freeze Frame" UBYTE FORMULA_0060 0 0.0 -40.0 215.0 READ_WRITE ECU_ADDRESS 0x3FA343 /end MEASUREMENT
/begin MEASUREMENT ed_fsp_5of20_.ff_tmot_nv "Kuehlwassertemperatur des Freeze Frame" UBYTE FORMULA_0060 0 0.0 -40.0 215.0 READ_WRITE ECU_ADDRESS 0x3FA33F /end MEASUREMENT
/begin MEASUREMENT ed_fsp_5of20_.ff_tz1_nv "Zuendwinkel 1 des Freeze Frame" UBYTE FORMULA_0063 0 0.0 -64.0 63.5 READ_WRITE ECU_ADDRESS 0x3FA342 /end MEASUREMENT
/begin MEASUREMENT ed_fsp_5of20_.ff_v_vorne_nv "Geschwindigkeit des Freeze Frame" UBYTE FORMULA_0062 0 0.0 0.0 255.0 READ_WRITE ECU_ADDRESS 0x3FA341 /end MEASUREMENT
/begin MEASUREMENT ed_fsp_5of20_.haeufigkeitszaehler_nv "Uebergangszaehler von i.O. -> n.i.O" UBYTE FORMULA_0003 0 0.0 0.0 255.0 READ_WRITE ECU_ADDRESS 0x3FA308 /end MEASUREMENT
/begin MEASUREMENT ed_fsp_5of20_.inj_fehlerzaehler_nv "INJ-Fehlerzaehler" UWORD FORMULA_0010 0 0.0 0.0 65535.0 READ_WRITE ECU_ADDRESS 0x3FA328 /end MEASUREMENT
/begin MEASUREMENT ed_fsp_5of20_.logistikzaehler_nv "Warm-Up-Cycling-Zaehler" UBYTE FORMULA_0003 0 0.0 0.0 255.0 READ_WRITE ECU_ADDRESS 0x3FA309 /end MEASUREMENT
/begin MEASUREMENT ed_fsp_5of20_.mil_filter_nv "Filterwert der Milansteuerung" UBYTE FORMULA_0003 0 0.0 0.0 255.0 READ_WRITE ECU_ADDRESS 0x3FA32C /end MEASUREMENT
/begin MEASUREMENT ed_fsp_5of20_.mil_filter_scdn_nv "Similar Conditions Eintragsfilterwert der Milansteuerung" UBYTE FORMULA_0003 0 0.0 0.0 255.0 READ_WRITE ECU_ADDRESS 0x3FA32D /end MEASUREMENT
/begin MEASUREMENT ed_fsp_5of20_.scdn_nenner_nv "Gesamte Anzahl" UWORD FORMULA_0010 0 0.0 0.0 65535.0 READ_WRITE ECU_ADDRESS 0x3FA330 /end MEASUREMENT
/begin MEASUREMENT ed_fsp_5of20_.scdn_zaehler_nv "Im similar Fenster" UWORD FORMULA_0010 0 0.0 0.0 65535.0 READ_WRITE ECU_ADDRESS 0x3FA32E /end MEASUREMENT
/begin MEASUREMENT ed_fsp_5of20_.uw_satz_1of3_.uw_km_stand_nv "Kilometerstand beim Fehlereintrag" UWORD FORMULA_0054 0 0.0 0.0 524280.0 READ_WRITE ECU_ADDRESS 0x3FA30A /end MEASUREMENT
/begin MEASUREMENT ed_fsp_5of20_.uw_satz_1of3_.uw_wert_nv_1of4_ "Umweltbedingung beim Fehlereintrag" UWORD FORMULA_0010 0 0.0 0.0 65535.0 READ_WRITE ECU_ADDRESS 0x3FA30C /end MEASUREMENT
/begin MEASUREMENT ed_fsp_5of20_.uw_satz_1of3_.uw_wert_nv_2of4_ "Umweltbedingung beim Fehlereintrag" UWORD FORMULA_0010 0 0.0 0.0 65535.0 READ_WRITE ECU_ADDRESS 0x3FA30E /end MEASUREMENT
/begin MEASUREMENT ed_fsp_5of20_.uw_satz_1of3_.uw_wert_nv_3of4_ "Umweltbedingung beim Fehlereintrag" UWORD FORMULA_0010 0 0.0 0.0 65535.0 READ_WRITE ECU_ADDRESS 0x3FA310 /end MEASUREMENT
/begin MEASUREMENT ed_fsp_5of20_.uw_satz_1of3_.uw_wert_nv_4of4_ "Umweltbedingung beim Fehlereintrag" UWORD FORMULA_0010 0 0.0 0.0 65535.0 READ_WRITE ECU_ADDRESS 0x3FA312 /end MEASUREMENT
/begin MEASUREMENT ed_fsp_5of20_.uw_satz_2of3_.uw_km_stand_nv "Kilometerstand beim Fehlereintrag" UWORD FORMULA_0054 0 0.0 0.0 524280.0 READ_WRITE ECU_ADDRESS 0x3FA314 /end MEASUREMENT
/begin MEASUREMENT ed_fsp_5of20_.uw_satz_2of3_.uw_wert_nv_1of4_ "Umweltbedingung beim Fehlereintrag" UWORD FORMULA_0010 0 0.0 0.0 65535.0 READ_WRITE ECU_ADDRESS 0x3FA316 /end MEASUREMENT
/begin MEASUREMENT ed_fsp_5of20_.uw_satz_2of3_.uw_wert_nv_2of4_ "Umweltbedingung beim Fehlereintrag" UWORD FORMULA_0010 0 0.0 0.0 65535.0 READ_WRITE ECU_ADDRESS 0x3FA318 /end MEASUREMENT
/begin MEASUREMENT ed_fsp_5of20_.uw_satz_2of3_.uw_wert_nv_3of4_ "Umweltbedingung beim Fehlereintrag" UWORD FORMULA_0010 0 0.0 0.0 65535.0 READ_WRITE ECU_ADDRESS 0x3FA31A /end MEASUREMENT
/begin MEASUREMENT ed_fsp_5of20_.uw_satz_2of3_.uw_wert_nv_4of4_ "Umweltbedingung beim Fehlereintrag" UWORD FORMULA_0010 0 0.0 0.0 65535.0 READ_WRITE ECU_ADDRESS 0x3FA31C /end MEASUREMENT
/begin MEASUREMENT ed_fsp_5of20_.uw_satz_3of3_.uw_km_stand_nv "Kilometerstand beim Fehlereintrag" UWORD FORMULA_0054 0 0.0 0.0 524280.0 READ_WRITE ECU_ADDRESS 0x3FA31E /end MEASUREMENT
/begin MEASUREMENT ed_fsp_5of20_.uw_satz_3of3_.uw_wert_nv_1of4_ "Umweltbedingung beim Fehlereintrag" UWORD FORMULA_0010 0 0.0 0.0 65535.0 READ_WRITE ECU_ADDRESS 0x3FA320 /end MEASUREMENT
/begin MEASUREMENT ed_fsp_5of20_.uw_satz_3of3_.uw_wert_nv_2of4_ "Umweltbedingung beim Fehlereintrag" UWORD FORMULA_0010 0 0.0 0.0 65535.0 READ_WRITE ECU_ADDRESS 0x3FA322 /end MEASUREMENT
/begin MEASUREMENT ed_fsp_5of20_.uw_satz_3of3_.uw_wert_nv_3of4_ "Umweltbedingung beim Fehlereintrag" UWORD FORMULA_0010 0 0.0 0.0 65535.0 READ_WRITE ECU_ADDRESS 0x3FA324 /end MEASUREMENT
/begin MEASUREMENT ed_fsp_5of20_.uw_satz_3of3_.uw_wert_nv_4of4_ "Umweltbedingung beim Fehlereintrag" UWORD FORMULA_0010 0 0.0 0.0 65535.0 READ_WRITE ECU_ADDRESS 0x3FA326 /end MEASUREMENT
/begin MEASUREMENT ed_fsp_6of20_.ed_fil_index_nv "Verweis auf Fehlerfilter" UWORD FORMULA_0010 0 0.0 0.0 65535.0 READ_WRITE ECU_ADDRESS 0x3FA36C /end MEASUREMENT
/begin MEASUREMENT ed_fsp_6of20_.fehlerart_nv "Fehlerart und Statusbits" UWORD FORMULA_0010 0 0.0 0.0 65535.0 READ_WRITE ECU_ADDRESS 0x3FA348 /end MEASUREMENT
/begin MEASUREMENT ed_fsp_6of20_.fehlercode_nv "Externer Fehlerort" UWORD FORMULA_0053 0 0.0 0.0 65535.0 READ_WRITE ECU_ADDRESS 0x3FA346 /end MEASUREMENT
/begin MEASUREMENT ed_fsp_6of20_.ff_egas_ist_dk_b1_nv "Drosselklappenposition des Freeze Frame" UBYTE FORMULA_0059 0 0.0 0.0 100.0 READ_WRITE ECU_ADDRESS 0x3FA386 /end MEASUREMENT
/begin MEASUREMENT ed_fsp_6of20_.ff_laa_f_ber_b1_nv "Lambdaadaptionsfaktor ohne TE des Freeze Frame" UBYTE FORMULA_0058 0 0.0 0.0 1.99210000038147 READ_WRITE ECU_ADDRESS 0x3FA37E /end MEASUREMENT
/begin MEASUREMENT ed_fsp_6of20_.ff_laa_f_ber_b2_nv "Lambdaadaptionsfaktor ohne TE des Freeze Frame" UBYTE FORMULA_0058 0 0.0 0.0 1.99210000038147 READ_WRITE ECU_ADDRESS 0x3FA37F /end MEASUREMENT
/begin MEASUREMENT ed_fsp_6of20_.ff_lam_reg_b1_nv "Einspritzsystem des Freeze Frame" UBYTE FORMULA_0057 0 0.0 0.0 255.0 READ_WRITE ECU_ADDRESS 0x3FA37A /end MEASUREMENT
/begin MEASUREMENT ed_fsp_6of20_.ff_lam_reg_b2_nv "Einspritzsystem des Freeze Frame" UBYTE FORMULA_0057 0 0.0 0.0 255.0 READ_WRITE ECU_ADDRESS 0x3FA37B /end MEASUREMENT
/begin MEASUREMENT ed_fsp_6of20_.ff_lam_reg_f_b1_nv "Lambdaregelfaktor des Freeze Frame" UBYTE FORMULA_0058 0 0.0 0.0 1.99210000038147 READ_WRITE ECU_ADDRESS 0x3FA37C /end MEASUREMENT
/begin MEASUREMENT ed_fsp_6of20_.ff_lam_reg_f_b2_nv "Lambdaregelfaktor des Freeze Frame" UBYTE FORMULA_0058 0 0.0 0.0 1.99210000038147 READ_WRITE ECU_ADDRESS 0x3FA37D /end MEASUREMENT
/begin MEASUREMENT ed_fsp_6of20_.ff_ml_ges_nv "Luftmasse des Freeze Frame" UWORD FORMULA_0056 0 0.0 0.0 655.3499755859375 READ_WRITE ECU_ADDRESS 0x3FA378 /end MEASUREMENT
/begin MEASUREMENT ed_fsp_6of20_.ff_n_nv "Drehzahl des Freeze Frame" UWORD FORMULA_0055 0 0.0 0.0 16383.75 READ_WRITE ECU_ADDRESS 0x3FA376 /end MEASUREMENT
/begin MEASUREMENT ed_fsp_6of20_.ff_p_code_nv "P-Code des Freeze Frame" UWORD FORMULA_0010 0 0.0 0.0 65535.0 READ_WRITE ECU_ADDRESS 0x3FA374 /end MEASUREMENT
/begin MEASUREMENT ed_fsp_6of20_.ff_pks_ist_nv "Kraftstoffdruck des Freeze Frame" UBYTE FORMULA_0061 0 0.0 0.0 765.0 READ_WRITE ECU_ADDRESS 0x3FA382 /end MEASUREMENT
/begin MEASUREMENT ed_fsp_6of20_.ff_rf_m_nv "Last des Freeze Frame" UBYTE FORMULA_0059 0 0.0 0.0 100.0 READ_WRITE ECU_ADDRESS 0x3FA380 /end MEASUREMENT
/begin MEASUREMENT ed_fsp_6of20_.ff_sl_st_nv "Sekundaerluftstatus des Freeze Frame" UBYTE FORMULA_0064 0 0.0 0.0 255.0 READ_WRITE ECU_ADDRESS 0x3FA387 /end MEASUREMENT
/begin MEASUREMENT ed_fsp_6of20_.ff_tan_m_nv "Ansauglufttemperatur des Freeze Frame" UBYTE FORMULA_0060 0 0.0 -40.0 215.0 READ_WRITE ECU_ADDRESS 0x3FA385 /end MEASUREMENT
/begin MEASUREMENT ed_fsp_6of20_.ff_tmot_nv "Kuehlwassertemperatur des Freeze Frame" UBYTE FORMULA_0060 0 0.0 -40.0 215.0 READ_WRITE ECU_ADDRESS 0x3FA381 /end MEASUREMENT
/begin MEASUREMENT ed_fsp_6of20_.ff_tz1_nv "Zuendwinkel 1 des Freeze Frame" UBYTE FORMULA_0063 0 0.0 -64.0 63.5 READ_WRITE ECU_ADDRESS 0x3FA384 /end MEASUREMENT
/begin MEASUREMENT ed_fsp_6of20_.ff_v_vorne_nv "Geschwindigkeit des Freeze Frame" UBYTE FORMULA_0062 0 0.0 0.0 255.0 READ_WRITE ECU_ADDRESS 0x3FA383 /end MEASUREMENT
/begin MEASUREMENT ed_fsp_6of20_.haeufigkeitszaehler_nv "Uebergangszaehler von i.O. -> n.i.O" UBYTE FORMULA_0003 0 0.0 0.0 255.0 READ_WRITE ECU_ADDRESS 0x3FA34A /end MEASUREMENT
/begin MEASUREMENT ed_fsp_6of20_.inj_fehlerzaehler_nv "INJ-Fehlerzaehler" UWORD FORMULA_0010 0 0.0 0.0 65535.0 READ_WRITE ECU_ADDRESS 0x3FA36A /end MEASUREMENT
/begin MEASUREMENT ed_fsp_6of20_.logistikzaehler_nv "Warm-Up-Cycling-Zaehler" UBYTE FORMULA_0003 0 0.0 0.0 255.0 READ_WRITE ECU_ADDRESS 0x3FA34B /end MEASUREMENT
/begin MEASUREMENT ed_fsp_6of20_.mil_filter_nv "Filterwert der Milansteuerung" UBYTE FORMULA_0003 0 0.0 0.0 255.0 READ_WRITE ECU_ADDRESS 0x3FA36E /end MEASUREMENT
/begin MEASUREMENT ed_fsp_6of20_.mil_filter_scdn_nv "Similar Conditions Eintragsfilterwert der Milansteuerung" UBYTE FORMULA_0003 0 0.0 0.0 255.0 READ_WRITE ECU_ADDRESS 0x3FA36F /end MEASUREMENT
/begin MEASUREMENT ed_fsp_6of20_.scdn_nenner_nv "Gesamte Anzahl" UWORD FORMULA_0010 0 0.0 0.0 65535.0 READ_WRITE ECU_ADDRESS 0x3FA372 /end MEASUREMENT
/begin MEASUREMENT ed_fsp_6of20_.scdn_zaehler_nv "Im similar Fenster" UWORD FORMULA_0010 0 0.0 0.0 65535.0 READ_WRITE ECU_ADDRESS 0x3FA370 /end MEASUREMENT
/begin MEASUREMENT ed_fsp_6of20_.uw_satz_1of3_.uw_km_stand_nv "Kilometerstand beim Fehlereintrag" UWORD FORMULA_0054 0 0.0 0.0 524280.0 READ_WRITE ECU_ADDRESS 0x3FA34C /end MEASUREMENT
/begin MEASUREMENT ed_fsp_6of20_.uw_satz_1of3_.uw_wert_nv_1of4_ "Umweltbedingung beim Fehlereintrag" UWORD FORMULA_0010 0 0.0 0.0 65535.0 READ_WRITE ECU_ADDRESS 0x3FA34E /end MEASUREMENT
/begin MEASUREMENT ed_fsp_6of20_.uw_satz_1of3_.uw_wert_nv_2of4_ "Umweltbedingung beim Fehlereintrag" UWORD FORMULA_0010 0 0.0 0.0 65535.0 READ_WRITE ECU_ADDRESS 0x3FA350 /end MEASUREMENT
/begin MEASUREMENT ed_fsp_6of20_.uw_satz_1of3_.uw_wert_nv_3of4_ "Umweltbedingung beim Fehlereintrag" UWORD FORMULA_0010 0 0.0 0.0 65535.0 READ_WRITE ECU_ADDRESS 0x3FA352 /end MEASUREMENT
/begin MEASUREMENT ed_fsp_6of20_.uw_satz_1of3_.uw_wert_nv_4of4_ "Umweltbedingung beim Fehlereintrag" UWORD FORMULA_0010 0 0.0 0.0 65535.0 READ_WRITE ECU_ADDRESS 0x3FA354 /end MEASUREMENT
/begin MEASUREMENT ed_fsp_6of20_.uw_satz_2of3_.uw_km_stand_nv "Kilometerstand beim Fehlereintrag" UWORD FORMULA_0054 0 0.0 0.0 524280.0 READ_WRITE ECU_ADDRESS 0x3FA356 /end MEASUREMENT
/begin MEASUREMENT ed_fsp_6of20_.uw_satz_2of3_.uw_wert_nv_1of4_ "Umweltbedingung beim Fehlereintrag" UWORD FORMULA_0010 0 0.0 0.0 65535.0 READ_WRITE ECU_ADDRESS 0x3FA358 /end MEASUREMENT
/begin MEASUREMENT ed_fsp_6of20_.uw_satz_2of3_.uw_wert_nv_2of4_ "Umweltbedingung beim Fehlereintrag" UWORD FORMULA_0010 0 0.0 0.0 65535.0 READ_WRITE ECU_ADDRESS 0x3FA35A /end MEASUREMENT
/begin MEASUREMENT ed_fsp_6of20_.uw_satz_2of3_.uw_wert_nv_3of4_ "Umweltbedingung beim Fehlereintrag" UWORD FORMULA_0010 0 0.0 0.0 65535.0 READ_WRITE ECU_ADDRESS 0x3FA35C /end MEASUREMENT
/begin MEASUREMENT ed_fsp_6of20_.uw_satz_2of3_.uw_wert_nv_4of4_ "Umweltbedingung beim Fehlereintrag" UWORD FORMULA_0010 0 0.0 0.0 65535.0 READ_WRITE ECU_ADDRESS 0x3FA35E /end MEASUREMENT
/begin MEASUREMENT ed_fsp_6of20_.uw_satz_3of3_.uw_km_stand_nv "Kilometerstand beim Fehlereintrag" UWORD FORMULA_0054 0 0.0 0.0 524280.0 READ_WRITE ECU_ADDRESS 0x3FA360 /end MEASUREMENT
/begin MEASUREMENT ed_fsp_6of20_.uw_satz_3of3_.uw_wert_nv_1of4_ "Umweltbedingung beim Fehlereintrag" UWORD FORMULA_0010 0 0.0 0.0 65535.0 READ_WRITE ECU_ADDRESS 0x3FA362 /end MEASUREMENT
/begin MEASUREMENT ed_fsp_6of20_.uw_satz_3of3_.uw_wert_nv_2of4_ "Umweltbedingung beim Fehlereintrag" UWORD FORMULA_0010 0 0.0 0.0 65535.0 READ_WRITE ECU_ADDRESS 0x3FA364 /end MEASUREMENT
/begin MEASUREMENT ed_fsp_6of20_.uw_satz_3of3_.uw_wert_nv_3of4_ "Umweltbedingung beim Fehlereintrag" UWORD FORMULA_0010 0 0.0 0.0 65535.0 READ_WRITE ECU_ADDRESS 0x3FA366 /end MEASUREMENT
/begin MEASUREMENT ed_fsp_6of20_.uw_satz_3of3_.uw_wert_nv_4of4_ "Umweltbedingung beim Fehlereintrag" UWORD FORMULA_0010 0 0.0 0.0 65535.0 READ_WRITE ECU_ADDRESS 0x3FA368 /end MEASUREMENT
/begin MEASUREMENT ed_fsp_7of20_.ed_fil_index_nv "Verweis auf Fehlerfilter" UWORD FORMULA_0010 0 0.0 0.0 65535.0 READ_WRITE ECU_ADDRESS 0x3FA3AE /end MEASUREMENT
/begin MEASUREMENT ed_fsp_7of20_.fehlerart_nv "Fehlerart und Statusbits" UWORD FORMULA_0010 0 0.0 0.0 65535.0 READ_WRITE ECU_ADDRESS 0x3FA38A /end MEASUREMENT
/begin MEASUREMENT ed_fsp_7of20_.fehlercode_nv "Externer Fehlerort" UWORD FORMULA_0053 0 0.0 0.0 65535.0 READ_WRITE ECU_ADDRESS 0x3FA388 /end MEASUREMENT
/begin MEASUREMENT ed_fsp_7of20_.ff_egas_ist_dk_b1_nv "Drosselklappenposition des Freeze Frame" UBYTE FORMULA_0059 0 0.0 0.0 100.0 READ_WRITE ECU_ADDRESS 0x3FA3C8 /end MEASUREMENT
/begin MEASUREMENT ed_fsp_7of20_.ff_laa_f_ber_b1_nv "Lambdaadaptionsfaktor ohne TE des Freeze Frame" UBYTE FORMULA_0058 0 0.0 0.0 1.99210000038147 READ_WRITE ECU_ADDRESS 0x3FA3C0 /end MEASUREMENT
/begin MEASUREMENT ed_fsp_7of20_.ff_laa_f_ber_b2_nv "Lambdaadaptionsfaktor ohne TE des Freeze Frame" UBYTE FORMULA_0058 0 0.0 0.0 1.99210000038147 READ_WRITE ECU_ADDRESS 0x3FA3C1 /end MEASUREMENT
/begin MEASUREMENT ed_fsp_7of20_.ff_lam_reg_b1_nv "Einspritzsystem des Freeze Frame" UBYTE FORMULA_0057 0 0.0 0.0 255.0 READ_WRITE ECU_ADDRESS 0x3FA3BC /end MEASUREMENT
/begin MEASUREMENT ed_fsp_7of20_.ff_lam_reg_b2_nv "Einspritzsystem des Freeze Frame" UBYTE FORMULA_0057 0 0.0 0.0 255.0 READ_WRITE ECU_ADDRESS 0x3FA3BD /end MEASUREMENT
/begin MEASUREMENT ed_fsp_7of20_.ff_lam_reg_f_b1_nv "Lambdaregelfaktor des Freeze Frame" UBYTE FORMULA_0058 0 0.0 0.0 1.99210000038147 READ_WRITE ECU_ADDRESS 0x3FA3BE /end MEASUREMENT
/begin MEASUREMENT ed_fsp_7of20_.ff_lam_reg_f_b2_nv "Lambdaregelfaktor des Freeze Frame" UBYTE FORMULA_0058 0 0.0 0.0 1.99210000038147 READ_WRITE ECU_ADDRESS 0x3FA3BF /end MEASUREMENT
/begin MEASUREMENT ed_fsp_7of20_.ff_ml_ges_nv "Luftmasse des Freeze Frame" UWORD FORMULA_0056 0 0.0 0.0 655.3499755859375 READ_WRITE ECU_ADDRESS 0x3FA3BA /end MEASUREMENT
/begin MEASUREMENT ed_fsp_7of20_.ff_n_nv "Drehzahl des Freeze Frame" UWORD FORMULA_0055 0 0.0 0.0 16383.75 READ_WRITE ECU_ADDRESS 0x3FA3B8 /end MEASUREMENT
/begin MEASUREMENT ed_fsp_7of20_.ff_p_code_nv "P-Code des Freeze Frame" UWORD FORMULA_0010 0 0.0 0.0 65535.0 READ_WRITE ECU_ADDRESS 0x3FA3B6 /end MEASUREMENT
/begin MEASUREMENT ed_fsp_7of20_.ff_pks_ist_nv "Kraftstoffdruck des Freeze Frame" UBYTE FORMULA_0061 0 0.0 0.0 765.0 READ_WRITE ECU_ADDRESS 0x3FA3C4 /end MEASUREMENT
/begin MEASUREMENT ed_fsp_7of20_.ff_rf_m_nv "Last des Freeze Frame" UBYTE FORMULA_0059 0 0.0 0.0 100.0 READ_WRITE ECU_ADDRESS 0x3FA3C2 /end MEASUREMENT
/begin MEASUREMENT ed_fsp_7of20_.ff_sl_st_nv "Sekundaerluftstatus des Freeze Frame" UBYTE FORMULA_0064 0 0.0 0.0 255.0 READ_WRITE ECU_ADDRESS 0x3FA3C9 /end MEASUREMENT
/begin MEASUREMENT ed_fsp_7of20_.ff_tan_m_nv "Ansauglufttemperatur des Freeze Frame" UBYTE FORMULA_0060 0 0.0 -40.0 215.0 READ_WRITE ECU_ADDRESS 0x3FA3C7 /end MEASUREMENT
/begin MEASUREMENT ed_fsp_7of20_.ff_tmot_nv "Kuehlwassertemperatur des Freeze Frame" UBYTE FORMULA_0060 0 0.0 -40.0 215.0 READ_WRITE ECU_ADDRESS 0x3FA3C3 /end MEASUREMENT
/begin MEASUREMENT ed_fsp_7of20_.ff_tz1_nv "Zuendwinkel 1 des Freeze Frame" UBYTE FORMULA_0063 0 0.0 -64.0 63.5 READ_WRITE ECU_ADDRESS 0x3FA3C6 /end MEASUREMENT
/begin MEASUREMENT ed_fsp_7of20_.ff_v_vorne_nv "Geschwindigkeit des Freeze Frame" UBYTE FORMULA_0062 0 0.0 0.0 255.0 READ_WRITE ECU_ADDRESS 0x3FA3C5 /end MEASUREMENT
/begin MEASUREMENT ed_fsp_7of20_.haeufigkeitszaehler_nv "Uebergangszaehler von i.O. -> n.i.O" UBYTE FORMULA_0003 0 0.0 0.0 255.0 READ_WRITE ECU_ADDRESS 0x3FA38C /end MEASUREMENT
/begin MEASUREMENT ed_fsp_7of20_.inj_fehlerzaehler_nv "INJ-Fehlerzaehler" UWORD FORMULA_0010 0 0.0 0.0 65535.0 READ_WRITE ECU_ADDRESS 0x3FA3AC /end MEASUREMENT
/begin MEASUREMENT ed_fsp_7of20_.logistikzaehler_nv "Warm-Up-Cycling-Zaehler" UBYTE FORMULA_0003 0 0.0 0.0 255.0 READ_WRITE ECU_ADDRESS 0x3FA38D /end MEASUREMENT
/begin MEASUREMENT ed_fsp_7of20_.mil_filter_nv "Filterwert der Milansteuerung" UBYTE FORMULA_0003 0 0.0 0.0 255.0 READ_WRITE ECU_ADDRESS 0x3FA3B0 /end MEASUREMENT
/begin MEASUREMENT ed_fsp_7of20_.mil_filter_scdn_nv "Similar Conditions Eintragsfilterwert der Milansteuerung" UBYTE FORMULA_0003 0 0.0 0.0 255.0 READ_WRITE ECU_ADDRESS 0x3FA3B1 /end MEASUREMENT
/begin MEASUREMENT ed_fsp_7of20_.scdn_nenner_nv "Gesamte Anzahl" UWORD FORMULA_0010 0 0.0 0.0 65535.0 READ_WRITE ECU_ADDRESS 0x3FA3B4 /end MEASUREMENT
/begin MEASUREMENT ed_fsp_7of20_.scdn_zaehler_nv "Im similar Fenster" UWORD FORMULA_0010 0 0.0 0.0 65535.0 READ_WRITE ECU_ADDRESS 0x3FA3B2 /end MEASUREMENT
/begin MEASUREMENT ed_fsp_7of20_.uw_satz_1of3_.uw_km_stand_nv "Kilometerstand beim Fehlereintrag" UWORD FORMULA_0054 0 0.0 0.0 524280.0 READ_WRITE ECU_ADDRESS 0x3FA38E /end MEASUREMENT
/begin MEASUREMENT ed_fsp_7of20_.uw_satz_1of3_.uw_wert_nv_1of4_ "Umweltbedingung beim Fehlereintrag" UWORD FORMULA_0010 0 0.0 0.0 65535.0 READ_WRITE ECU_ADDRESS 0x3FA390 /end MEASUREMENT
/begin MEASUREMENT ed_fsp_7of20_.uw_satz_1of3_.uw_wert_nv_2of4_ "Umweltbedingung beim Fehlereintrag" UWORD FORMULA_0010 0 0.0 0.0 65535.0 READ_WRITE ECU_ADDRESS 0x3FA392 /end MEASUREMENT
/begin MEASUREMENT ed_fsp_7of20_.uw_satz_1of3_.uw_wert_nv_3of4_ "Umweltbedingung beim Fehlereintrag" UWORD FORMULA_0010 0 0.0 0.0 65535.0 READ_WRITE ECU_ADDRESS 0x3FA394 /end MEASUREMENT
/begin MEASUREMENT ed_fsp_7of20_.uw_satz_1of3_.uw_wert_nv_4of4_ "Umweltbedingung beim Fehlereintrag" UWORD FORMULA_0010 0 0.0 0.0 65535.0 READ_WRITE ECU_ADDRESS 0x3FA396 /end MEASUREMENT
/begin MEASUREMENT ed_fsp_7of20_.uw_satz_2of3_.uw_km_stand_nv "Kilometerstand beim Fehlereintrag" UWORD FORMULA_0054 0 0.0 0.0 524280.0 READ_WRITE ECU_ADDRESS 0x3FA398 /end MEASUREMENT
/begin MEASUREMENT ed_fsp_7of20_.uw_satz_2of3_.uw_wert_nv_1of4_ "Umweltbedingung beim Fehlereintrag" UWORD FORMULA_0010 0 0.0 0.0 65535.0 READ_WRITE ECU_ADDRESS 0x3FA39A /end MEASUREMENT
/begin MEASUREMENT ed_fsp_7of20_.uw_satz_2of3_.uw_wert_nv_2of4_ "Umweltbedingung beim Fehlereintrag" UWORD FORMULA_0010 0 0.0 0.0 65535.0 READ_WRITE ECU_ADDRESS 0x3FA39C /end MEASUREMENT
/begin MEASUREMENT ed_fsp_7of20_.uw_satz_2of3_.uw_wert_nv_3of4_ "Umweltbedingung beim Fehlereintrag" UWORD FORMULA_0010 0 0.0 0.0 65535.0 READ_WRITE ECU_ADDRESS 0x3FA39E /end MEASUREMENT
/begin MEASUREMENT ed_fsp_7of20_.uw_satz_2of3_.uw_wert_nv_4of4_ "Umweltbedingung beim Fehlereintrag" UWORD FORMULA_0010 0 0.0 0.0 65535.0 READ_WRITE ECU_ADDRESS 0x3FA3A0 /end MEASUREMENT
/begin MEASUREMENT ed_fsp_7of20_.uw_satz_3of3_.uw_km_stand_nv "Kilometerstand beim Fehlereintrag" UWORD FORMULA_0054 0 0.0 0.0 524280.0 READ_WRITE ECU_ADDRESS 0x3FA3A2 /end MEASUREMENT
/begin MEASUREMENT ed_fsp_7of20_.uw_satz_3of3_.uw_wert_nv_1of4_ "Umweltbedingung beim Fehlereintrag" UWORD FORMULA_0010 0 0.0 0.0 65535.0 READ_WRITE ECU_ADDRESS 0x3FA3A4 /end MEASUREMENT
/begin MEASUREMENT ed_fsp_7of20_.uw_satz_3of3_.uw_wert_nv_2of4_ "Umweltbedingung beim Fehlereintrag" UWORD FORMULA_0010 0 0.0 0.0 65535.0 READ_WRITE ECU_ADDRESS 0x3FA3A6 /end MEASUREMENT
/begin MEASUREMENT ed_fsp_7of20_.uw_satz_3of3_.uw_wert_nv_3of4_ "Umweltbedingung beim Fehlereintrag" UWORD FORMULA_0010 0 0.0 0.0 65535.0 READ_WRITE ECU_ADDRESS 0x3FA3A8 /end MEASUREMENT
/begin MEASUREMENT ed_fsp_7of20_.uw_satz_3of3_.uw_wert_nv_4of4_ "Umweltbedingung beim Fehlereintrag" UWORD FORMULA_0010 0 0.0 0.0 65535.0 READ_WRITE ECU_ADDRESS 0x3FA3AA /end MEASUREMENT
/begin MEASUREMENT ed_fsp_8of20_.ed_fil_index_nv "Verweis auf Fehlerfilter" UWORD FORMULA_0010 0 0.0 0.0 65535.0 READ_WRITE ECU_ADDRESS 0x3FA3F0 /end MEASUREMENT
/begin MEASUREMENT ed_fsp_8of20_.fehlerart_nv "Fehlerart und Statusbits" UWORD FORMULA_0010 0 0.0 0.0 65535.0 READ_WRITE ECU_ADDRESS 0x3FA3CC /end MEASUREMENT
/begin MEASUREMENT ed_fsp_8of20_.fehlercode_nv "Externer Fehlerort" UWORD FORMULA_0053 0 0.0 0.0 65535.0 READ_WRITE ECU_ADDRESS 0x3FA3CA /end MEASUREMENT
/begin MEASUREMENT ed_fsp_8of20_.ff_egas_ist_dk_b1_nv "Drosselklappenposition des Freeze Frame" UBYTE FORMULA_0059 0 0.0 0.0 100.0 READ_WRITE ECU_ADDRESS 0x3FA40A /end MEASUREMENT
/begin MEASUREMENT ed_fsp_8of20_.ff_laa_f_ber_b1_nv "Lambdaadaptionsfaktor ohne TE des Freeze Frame" UBYTE FORMULA_0058 0 0.0 0.0 1.99210000038147 READ_WRITE ECU_ADDRESS 0x3FA402 /end MEASUREMENT
/begin MEASUREMENT ed_fsp_8of20_.ff_laa_f_ber_b2_nv "Lambdaadaptionsfaktor ohne TE des Freeze Frame" UBYTE FORMULA_0058 0 0.0 0.0 1.99210000038147 READ_WRITE ECU_ADDRESS 0x3FA403 /end MEASUREMENT
/begin MEASUREMENT ed_fsp_8of20_.ff_lam_reg_b1_nv "Einspritzsystem des Freeze Frame" UBYTE FORMULA_0057 0 0.0 0.0 255.0 READ_WRITE ECU_ADDRESS 0x3FA3FE /end MEASUREMENT
/begin MEASUREMENT ed_fsp_8of20_.ff_lam_reg_b2_nv "Einspritzsystem des Freeze Frame" UBYTE FORMULA_0057 0 0.0 0.0 255.0 READ_WRITE ECU_ADDRESS 0x3FA3FF /end MEASUREMENT
/begin MEASUREMENT ed_fsp_8of20_.ff_lam_reg_f_b1_nv "Lambdaregelfaktor des Freeze Frame" UBYTE FORMULA_0058 0 0.0 0.0 1.99210000038147 READ_WRITE ECU_ADDRESS 0x3FA400 /end MEASUREMENT
/begin MEASUREMENT ed_fsp_8of20_.ff_lam_reg_f_b2_nv "Lambdaregelfaktor des Freeze Frame" UBYTE FORMULA_0058 0 0.0 0.0 1.99210000038147 READ_WRITE ECU_ADDRESS 0x3FA401 /end MEASUREMENT
/begin MEASUREMENT ed_fsp_8of20_.ff_ml_ges_nv "Luftmasse des Freeze Frame" UWORD FORMULA_0056 0 0.0 0.0 655.3499755859375 READ_WRITE ECU_ADDRESS 0x3FA3FC /end MEASUREMENT
/begin MEASUREMENT ed_fsp_8of20_.ff_n_nv "Drehzahl des Freeze Frame" UWORD FORMULA_0055 0 0.0 0.0 16383.75 READ_WRITE ECU_ADDRESS 0x3FA3FA /end MEASUREMENT
/begin MEASUREMENT ed_fsp_8of20_.ff_p_code_nv "P-Code des Freeze Frame" UWORD FORMULA_0010 0 0.0 0.0 65535.0 READ_WRITE ECU_ADDRESS 0x3FA3F8 /end MEASUREMENT
/begin MEASUREMENT ed_fsp_8of20_.ff_pks_ist_nv "Kraftstoffdruck des Freeze Frame" UBYTE FORMULA_0061 0 0.0 0.0 765.0 READ_WRITE ECU_ADDRESS 0x3FA406 /end MEASUREMENT
/begin MEASUREMENT ed_fsp_8of20_.ff_rf_m_nv "Last des Freeze Frame" UBYTE FORMULA_0059 0 0.0 0.0 100.0 READ_WRITE ECU_ADDRESS 0x3FA404 /end MEASUREMENT
/begin MEASUREMENT ed_fsp_8of20_.ff_sl_st_nv "Sekundaerluftstatus des Freeze Frame" UBYTE FORMULA_0064 0 0.0 0.0 255.0 READ_WRITE ECU_ADDRESS 0x3FA40B /end MEASUREMENT
/begin MEASUREMENT ed_fsp_8of20_.ff_tan_m_nv "Ansauglufttemperatur des Freeze Frame" UBYTE FORMULA_0060 0 0.0 -40.0 215.0 READ_WRITE ECU_ADDRESS 0x3FA409 /end MEASUREMENT
/begin MEASUREMENT ed_fsp_8of20_.ff_tmot_nv "Kuehlwassertemperatur des Freeze Frame" UBYTE FORMULA_0060 0 0.0 -40.0 215.0 READ_WRITE ECU_ADDRESS 0x3FA405 /end MEASUREMENT
/begin MEASUREMENT ed_fsp_8of20_.ff_tz1_nv "Zuendwinkel 1 des Freeze Frame" UBYTE FORMULA_0063 0 0.0 -64.0 63.5 READ_WRITE ECU_ADDRESS 0x3FA408 /end MEASUREMENT
/begin MEASUREMENT ed_fsp_8of20_.ff_v_vorne_nv "Geschwindigkeit des Freeze Frame" UBYTE FORMULA_0062 0 0.0 0.0 255.0 READ_WRITE ECU_ADDRESS 0x3FA407 /end MEASUREMENT
/begin MEASUREMENT ed_fsp_8of20_.haeufigkeitszaehler_nv "Uebergangszaehler von i.O. -> n.i.O" UBYTE FORMULA_0003 0 0.0 0.0 255.0 READ_WRITE ECU_ADDRESS 0x3FA3CE /end MEASUREMENT
/begin MEASUREMENT ed_fsp_8of20_.inj_fehlerzaehler_nv "INJ-Fehlerzaehler" UWORD FORMULA_0010 0 0.0 0.0 65535.0 READ_WRITE ECU_ADDRESS 0x3FA3EE /end MEASUREMENT
/begin MEASUREMENT ed_fsp_8of20_.logistikzaehler_nv "Warm-Up-Cycling-Zaehler" UBYTE FORMULA_0003 0 0.0 0.0 255.0 READ_WRITE ECU_ADDRESS 0x3FA3CF /end MEASUREMENT
/begin MEASUREMENT ed_fsp_8of20_.mil_filter_nv "Filterwert der Milansteuerung" UBYTE FORMULA_0003 0 0.0 0.0 255.0 READ_WRITE ECU_ADDRESS 0x3FA3F2 /end MEASUREMENT
/begin MEASUREMENT ed_fsp_8of20_.mil_filter_scdn_nv "Similar Conditions Eintragsfilterwert der Milansteuerung" UBYTE FORMULA_0003 0 0.0 0.0 255.0 READ_WRITE ECU_ADDRESS 0x3FA3F3 /end MEASUREMENT
/begin MEASUREMENT ed_fsp_8of20_.scdn_nenner_nv "Gesamte Anzahl" UWORD FORMULA_0010 0 0.0 0.0 65535.0 READ_WRITE ECU_ADDRESS 0x3FA3F6 /end MEASUREMENT
/begin MEASUREMENT ed_fsp_8of20_.scdn_zaehler_nv "Im similar Fenster" UWORD FORMULA_0010 0 0.0 0.0 65535.0 READ_WRITE ECU_ADDRESS 0x3FA3F4 /end MEASUREMENT
/begin MEASUREMENT ed_fsp_8of20_.uw_satz_1of3_.uw_km_stand_nv "Kilometerstand beim Fehlereintrag" UWORD FORMULA_0054 0 0.0 0.0 524280.0 READ_WRITE ECU_ADDRESS 0x3FA3D0 /end MEASUREMENT
/begin MEASUREMENT ed_fsp_8of20_.uw_satz_1of3_.uw_wert_nv_1of4_ "Umweltbedingung beim Fehlereintrag" UWORD FORMULA_0010 0 0.0 0.0 65535.0 READ_WRITE ECU_ADDRESS 0x3FA3D2 /end MEASUREMENT
/begin MEASUREMENT ed_fsp_8of20_.uw_satz_1of3_.uw_wert_nv_2of4_ "Umweltbedingung beim Fehlereintrag" UWORD FORMULA_0010 0 0.0 0.0 65535.0 READ_WRITE ECU_ADDRESS 0x3FA3D4 /end MEASUREMENT
/begin MEASUREMENT ed_fsp_8of20_.uw_satz_1of3_.uw_wert_nv_3of4_ "Umweltbedingung beim Fehlereintrag" UWORD FORMULA_0010 0 0.0 0.0 65535.0 READ_WRITE ECU_ADDRESS 0x3FA3D6 /end MEASUREMENT
/begin MEASUREMENT ed_fsp_8of20_.uw_satz_1of3_.uw_wert_nv_4of4_ "Umweltbedingung beim Fehlereintrag" UWORD FORMULA_0010 0 0.0 0.0 65535.0 READ_WRITE ECU_ADDRESS 0x3FA3D8 /end MEASUREMENT
/begin MEASUREMENT ed_fsp_8of20_.uw_satz_2of3_.uw_km_stand_nv "Kilometerstand beim Fehlereintrag" UWORD FORMULA_0054 0 0.0 0.0 524280.0 READ_WRITE ECU_ADDRESS 0x3FA3DA /end MEASUREMENT
/begin MEASUREMENT ed_fsp_8of20_.uw_satz_2of3_.uw_wert_nv_1of4_ "Umweltbedingung beim Fehlereintrag" UWORD FORMULA_0010 0 0.0 0.0 65535.0 READ_WRITE ECU_ADDRESS 0x3FA3DC /end MEASUREMENT
/begin MEASUREMENT ed_fsp_8of20_.uw_satz_2of3_.uw_wert_nv_2of4_ "Umweltbedingung beim Fehlereintrag" UWORD FORMULA_0010 0 0.0 0.0 65535.0 READ_WRITE ECU_ADDRESS 0x3FA3DE /end MEASUREMENT
/begin MEASUREMENT ed_fsp_8of20_.uw_satz_2of3_.uw_wert_nv_3of4_ "Umweltbedingung beim Fehlereintrag" UWORD FORMULA_0010 0 0.0 0.0 65535.0 READ_WRITE ECU_ADDRESS 0x3FA3E0 /end MEASUREMENT
/begin MEASUREMENT ed_fsp_8of20_.uw_satz_2of3_.uw_wert_nv_4of4_ "Umweltbedingung beim Fehlereintrag" UWORD FORMULA_0010 0 0.0 0.0 65535.0 READ_WRITE ECU_ADDRESS 0x3FA3E2 /end MEASUREMENT
/begin MEASUREMENT ed_fsp_8of20_.uw_satz_3of3_.uw_km_stand_nv "Kilometerstand beim Fehlereintrag" UWORD FORMULA_0054 0 0.0 0.0 524280.0 READ_WRITE ECU_ADDRESS 0x3FA3E4 /end MEASUREMENT
/begin MEASUREMENT ed_fsp_8of20_.uw_satz_3of3_.uw_wert_nv_1of4_ "Umweltbedingung beim Fehlereintrag" UWORD FORMULA_0010 0 0.0 0.0 65535.0 READ_WRITE ECU_ADDRESS 0x3FA3E6 /end MEASUREMENT
/begin MEASUREMENT ed_fsp_8of20_.uw_satz_3of3_.uw_wert_nv_2of4_ "Umweltbedingung beim Fehlereintrag" UWORD FORMULA_0010 0 0.0 0.0 65535.0 READ_WRITE ECU_ADDRESS 0x3FA3E8 /end MEASUREMENT
/begin MEASUREMENT ed_fsp_8of20_.uw_satz_3of3_.uw_wert_nv_3of4_ "Umweltbedingung beim Fehlereintrag" UWORD FORMULA_0010 0 0.0 0.0 65535.0 READ_WRITE ECU_ADDRESS 0x3FA3EA /end MEASUREMENT
/begin MEASUREMENT ed_fsp_8of20_.uw_satz_3of3_.uw_wert_nv_4of4_ "Umweltbedingung beim Fehlereintrag" UWORD FORMULA_0010 0 0.0 0.0 65535.0 READ_WRITE ECU_ADDRESS 0x3FA3EC /end MEASUREMENT
/begin MEASUREMENT ed_fsp_9of20_.ed_fil_index_nv "Verweis auf Fehlerfilter" UWORD FORMULA_0010 0 0.0 0.0 65535.0 READ_WRITE ECU_ADDRESS 0x3FA432 /end MEASUREMENT
/begin MEASUREMENT ed_fsp_9of20_.fehlerart_nv "Fehlerart und Statusbits" UWORD FORMULA_0010 0 0.0 0.0 65535.0 READ_WRITE ECU_ADDRESS 0x3FA40E /end MEASUREMENT
/begin MEASUREMENT ed_fsp_9of20_.fehlercode_nv "Externer Fehlerort" UWORD FORMULA_0053 0 0.0 0.0 65535.0 READ_WRITE ECU_ADDRESS 0x3FA40C /end MEASUREMENT
/begin MEASUREMENT ed_fsp_9of20_.ff_egas_ist_dk_b1_nv "Drosselklappenposition des Freeze Frame" UBYTE FORMULA_0059 0 0.0 0.0 100.0 READ_WRITE ECU_ADDRESS 0x3FA44C /end MEASUREMENT
/begin MEASUREMENT ed_fsp_9of20_.ff_laa_f_ber_b1_nv "Lambdaadaptionsfaktor ohne TE des Freeze Frame" UBYTE FORMULA_0058 0 0.0 0.0 1.99210000038147 READ_WRITE ECU_ADDRESS 0x3FA444 /end MEASUREMENT
/begin MEASUREMENT ed_fsp_9of20_.ff_laa_f_ber_b2_nv "Lambdaadaptionsfaktor ohne TE des Freeze Frame" UBYTE FORMULA_0058 0 0.0 0.0 1.99210000038147 READ_WRITE ECU_ADDRESS 0x3FA445 /end MEASUREMENT
/begin MEASUREMENT ed_fsp_9of20_.ff_lam_reg_b1_nv "Einspritzsystem des Freeze Frame" UBYTE FORMULA_0057 0 0.0 0.0 255.0 READ_WRITE ECU_ADDRESS 0x3FA440 /end MEASUREMENT
/begin MEASUREMENT ed_fsp_9of20_.ff_lam_reg_b2_nv "Einspritzsystem des Freeze Frame" UBYTE FORMULA_0057 0 0.0 0.0 255.0 READ_WRITE ECU_ADDRESS 0x3FA441 /end MEASUREMENT
/begin MEASUREMENT ed_fsp_9of20_.ff_lam_reg_f_b1_nv "Lambdaregelfaktor des Freeze Frame" UBYTE FORMULA_0058 0 0.0 0.0 1.99210000038147 READ_WRITE ECU_ADDRESS 0x3FA442 /end MEASUREMENT
/begin MEASUREMENT ed_fsp_9of20_.ff_lam_reg_f_b2_nv "Lambdaregelfaktor des Freeze Frame" UBYTE FORMULA_0058 0 0.0 0.0 1.99210000038147 READ_WRITE ECU_ADDRESS 0x3FA443 /end MEASUREMENT
/begin MEASUREMENT ed_fsp_9of20_.ff_ml_ges_nv "Luftmasse des Freeze Frame" UWORD FORMULA_0056 0 0.0 0.0 655.3499755859375 READ_WRITE ECU_ADDRESS 0x3FA43E /end MEASUREMENT
/begin MEASUREMENT ed_fsp_9of20_.ff_n_nv "Drehzahl des Freeze Frame" UWORD FORMULA_0055 0 0.0 0.0 16383.75 READ_WRITE ECU_ADDRESS 0x3FA43C /end MEASUREMENT
/begin MEASUREMENT ed_fsp_9of20_.ff_p_code_nv "P-Code des Freeze Frame" UWORD FORMULA_0010 0 0.0 0.0 65535.0 READ_WRITE ECU_ADDRESS 0x3FA43A /end MEASUREMENT
/begin MEASUREMENT ed_fsp_9of20_.ff_pks_ist_nv "Kraftstoffdruck des Freeze Frame" UBYTE FORMULA_0061 0 0.0 0.0 765.0 READ_WRITE ECU_ADDRESS 0x3FA448 /end MEASUREMENT
/begin MEASUREMENT ed_fsp_9of20_.ff_rf_m_nv "Last des Freeze Frame" UBYTE FORMULA_0059 0 0.0 0.0 100.0 READ_WRITE ECU_ADDRESS 0x3FA446 /end MEASUREMENT
/begin MEASUREMENT ed_fsp_9of20_.ff_sl_st_nv "Sekundaerluftstatus des Freeze Frame" UBYTE FORMULA_0064 0 0.0 0.0 255.0 READ_WRITE ECU_ADDRESS 0x3FA44D /end MEASUREMENT
/begin MEASUREMENT ed_fsp_9of20_.ff_tan_m_nv "Ansauglufttemperatur des Freeze Frame" UBYTE FORMULA_0060 0 0.0 -40.0 215.0 READ_WRITE ECU_ADDRESS 0x3FA44B /end MEASUREMENT
/begin MEASUREMENT ed_fsp_9of20_.ff_tmot_nv "Kuehlwassertemperatur des Freeze Frame" UBYTE FORMULA_0060 0 0.0 -40.0 215.0 READ_WRITE ECU_ADDRESS 0x3FA447 /end MEASUREMENT
/begin MEASUREMENT ed_fsp_9of20_.ff_tz1_nv "Zuendwinkel 1 des Freeze Frame" UBYTE FORMULA_0063 0 0.0 -64.0 63.5 READ_WRITE ECU_ADDRESS 0x3FA44A /end MEASUREMENT
/begin MEASUREMENT ed_fsp_9of20_.ff_v_vorne_nv "Geschwindigkeit des Freeze Frame" UBYTE FORMULA_0062 0 0.0 0.0 255.0 READ_WRITE ECU_ADDRESS 0x3FA449 /end MEASUREMENT
/begin MEASUREMENT ed_fsp_9of20_.haeufigkeitszaehler_nv "Uebergangszaehler von i.O. -> n.i.O" UBYTE FORMULA_0003 0 0.0 0.0 255.0 READ_WRITE ECU_ADDRESS 0x3FA410 /end MEASUREMENT
/begin MEASUREMENT ed_fsp_9of20_.inj_fehlerzaehler_nv "INJ-Fehlerzaehler" UWORD FORMULA_0010 0 0.0 0.0 65535.0 READ_WRITE ECU_ADDRESS 0x3FA430 /end MEASUREMENT
/begin MEASUREMENT ed_fsp_9of20_.logistikzaehler_nv "Warm-Up-Cycling-Zaehler" UBYTE FORMULA_0003 0 0.0 0.0 255.0 READ_WRITE ECU_ADDRESS 0x3FA411 /end MEASUREMENT
/begin MEASUREMENT ed_fsp_9of20_.mil_filter_nv "Filterwert der Milansteuerung" UBYTE FORMULA_0003 0 0.0 0.0 255.0 READ_WRITE ECU_ADDRESS 0x3FA434 /end MEASUREMENT
/begin MEASUREMENT ed_fsp_9of20_.mil_filter_scdn_nv "Similar Conditions Eintragsfilterwert der Milansteuerung" UBYTE FORMULA_0003 0 0.0 0.0 255.0 READ_WRITE ECU_ADDRESS 0x3FA435 /end MEASUREMENT
/begin MEASUREMENT ed_fsp_9of20_.scdn_nenner_nv "Gesamte Anzahl" UWORD FORMULA_0010 0 0.0 0.0 65535.0 READ_WRITE ECU_ADDRESS 0x3FA438 /end MEASUREMENT
/begin MEASUREMENT ed_fsp_9of20_.scdn_zaehler_nv "Im similar Fenster" UWORD FORMULA_0010 0 0.0 0.0 65535.0 READ_WRITE ECU_ADDRESS 0x3FA436 /end MEASUREMENT
/begin MEASUREMENT ed_fsp_9of20_.uw_satz_1of3_.uw_km_stand_nv "Kilometerstand beim Fehlereintrag" UWORD FORMULA_0054 0 0.0 0.0 524280.0 READ_WRITE ECU_ADDRESS 0x3FA412 /end MEASUREMENT
/begin MEASUREMENT ed_fsp_9of20_.uw_satz_1of3_.uw_wert_nv_1of4_ "Umweltbedingung beim Fehlereintrag" UWORD FORMULA_0010 0 0.0 0.0 65535.0 READ_WRITE ECU_ADDRESS 0x3FA414 /end MEASUREMENT
/begin MEASUREMENT ed_fsp_9of20_.uw_satz_1of3_.uw_wert_nv_2of4_ "Umweltbedingung beim Fehlereintrag" UWORD FORMULA_0010 0 0.0 0.0 65535.0 READ_WRITE ECU_ADDRESS 0x3FA416 /end MEASUREMENT
/begin MEASUREMENT ed_fsp_9of20_.uw_satz_1of3_.uw_wert_nv_3of4_ "Umweltbedingung beim Fehlereintrag" UWORD FORMULA_0010 0 0.0 0.0 65535.0 READ_WRITE ECU_ADDRESS 0x3FA418 /end MEASUREMENT
/begin MEASUREMENT ed_fsp_9of20_.uw_satz_1of3_.uw_wert_nv_4of4_ "Umweltbedingung beim Fehlereintrag" UWORD FORMULA_0010 0 0.0 0.0 65535.0 READ_WRITE ECU_ADDRESS 0x3FA41A /end MEASUREMENT
/begin MEASUREMENT ed_fsp_9of20_.uw_satz_2of3_.uw_km_stand_nv "Kilometerstand beim Fehlereintrag" UWORD FORMULA_0054 0 0.0 0.0 524280.0 READ_WRITE ECU_ADDRESS 0x3FA41C /end MEASUREMENT
/begin MEASUREMENT ed_fsp_9of20_.uw_satz_2of3_.uw_wert_nv_1of4_ "Umweltbedingung beim Fehlereintrag" UWORD FORMULA_0010 0 0.0 0.0 65535.0 READ_WRITE ECU_ADDRESS 0x3FA41E /end MEASUREMENT
/begin MEASUREMENT ed_fsp_9of20_.uw_satz_2of3_.uw_wert_nv_2of4_ "Umweltbedingung beim Fehlereintrag" UWORD FORMULA_0010 0 0.0 0.0 65535.0 READ_WRITE ECU_ADDRESS 0x3FA420 /end MEASUREMENT
/begin MEASUREMENT ed_fsp_9of20_.uw_satz_2of3_.uw_wert_nv_3of4_ "Umweltbedingung beim Fehlereintrag" UWORD FORMULA_0010 0 0.0 0.0 65535.0 READ_WRITE ECU_ADDRESS 0x3FA422 /end MEASUREMENT
/begin MEASUREMENT ed_fsp_9of20_.uw_satz_2of3_.uw_wert_nv_4of4_ "Umweltbedingung beim Fehlereintrag" UWORD FORMULA_0010 0 0.0 0.0 65535.0 READ_WRITE ECU_ADDRESS 0x3FA424 /end MEASUREMENT
/begin MEASUREMENT ed_fsp_9of20_.uw_satz_3of3_.uw_km_stand_nv "Kilometerstand beim Fehlereintrag" UWORD FORMULA_0054 0 0.0 0.0 524280.0 READ_WRITE ECU_ADDRESS 0x3FA426 /end MEASUREMENT
/begin MEASUREMENT ed_fsp_9of20_.uw_satz_3of3_.uw_wert_nv_1of4_ "Umweltbedingung beim Fehlereintrag" UWORD FORMULA_0010 0 0.0 0.0 65535.0 READ_WRITE ECU_ADDRESS 0x3FA428 /end MEASUREMENT
/begin MEASUREMENT ed_fsp_9of20_.uw_satz_3of3_.uw_wert_nv_2of4_ "Umweltbedingung beim Fehlereintrag" UWORD FORMULA_0010 0 0.0 0.0 65535.0 READ_WRITE ECU_ADDRESS 0x3FA42A /end MEASUREMENT
/begin MEASUREMENT ed_fsp_9of20_.uw_satz_3of3_.uw_wert_nv_3of4_ "Umweltbedingung beim Fehlereintrag" UWORD FORMULA_0010 0 0.0 0.0 65535.0 READ_WRITE ECU_ADDRESS 0x3FA42C /end MEASUREMENT
/begin MEASUREMENT ed_fsp_9of20_.uw_satz_3of3_.uw_wert_nv_4of4_ "Umweltbedingung beim Fehlereintrag" UWORD FORMULA_0010 0 0.0 0.0 65535.0 READ_WRITE ECU_ADDRESS 0x3FA42E /end MEASUREMENT
/begin MEASUREMENT ed_loeschen "Uebergangsloesung zum Loeschen" UBYTE FORMULA_0070 0 0.0 0.0 255.0 READ_WRITE ECU_ADDRESS 0x3FBEA8 /end MEASUREMENT
/begin MEASUREMENT ed_mil_bmw_ign "Mil-Status IGN" UBYTE FORMULA_0065 0 0 0.0 255.0 READ_WRITE BIT_MASK 0x1 ECU_ADDRESS 0x3F8578 /end MEASUREMENT
/begin MEASUREMENT ed_mil_bmw_inj "Mil-Status INJ" UBYTE FORMULA_0065 0 0 0.0 255.0 READ_WRITE BIT_MASK 0x1 ECU_ADDRESS 0x3F8870 /end MEASUREMENT
/begin MEASUREMENT ed_mil_dme_ign "Mil-Status IGN" UBYTE FORMULA_0067 0 0 0.0 255.0 READ_WRITE BIT_MASK 0x80 ECU_ADDRESS 0x3F8578 /end MEASUREMENT
/begin MEASUREMENT ed_mil_dme_inj "Mil-Status INJ" UBYTE FORMULA_0067 0 0 0.0 255.0 READ_WRITE BIT_MASK 0x80 ECU_ADDRESS 0x3F8870 /end MEASUREMENT
/begin MEASUREMENT ed_mil_on_km_stand_nv "Kilometerstand MIL on" ULONG FORMULA_0027 0 0.0 0.0 16777214.0 READ_WRITE ECU_ADDRESS 0x3F9934 /end MEASUREMENT
/begin MEASUREMENT ed_mil_predrive_ign "Mil-Status IGN" UBYTE FORMULA_0066 0 0 0.0 255.0 READ_WRITE BIT_MASK 0x2 ECU_ADDRESS 0x3F8578 /end MEASUREMENT
/begin MEASUREMENT ed_mil_predrive_inj "Mil-Status INJ" UBYTE FORMULA_0066 0 0 0.0 255.0 READ_WRITE BIT_MASK 0x2 ECU_ADDRESS 0x3F8870 /end MEASUREMENT
/begin MEASUREMENT ed_mil_smg_ign "Mil-Status IGN" UBYTE FORMULA_0069 0 0 0.0 255.0 READ_WRITE BIT_MASK 0x8 ECU_ADDRESS 0x3F8578 /end MEASUREMENT
/begin MEASUREMENT ed_mil_st_ign "Mil-Status IGN" UBYTE FORMULA_0037 0 0.0 0.0 255.0 READ_WRITE ECU_ADDRESS 0x3F8578 /end MEASUREMENT
/begin MEASUREMENT ed_mil_st_inj "Mil-Status INJ" UBYTE FORMULA_0037 0 0.0 0.0 255.0 READ_WRITE ECU_ADDRESS 0x3F8870 /end MEASUREMENT
/begin MEASUREMENT ed_mil_zyl_off_ign "Mil-Status IGN" UBYTE FORMULA_0068 0 0 0.0 255.0 READ_WRITE BIT_MASK 0x4 ECU_ADDRESS 0x3F8578 /end MEASUREMENT
/begin MEASUREMENT ed_rbm_appl_data_inj.denominator_nv "Fahrzyklen" UWORD FORMULA_0010 0 0.0 0.0 65535.0 READ_WRITE ECU_ADDRESS 0x3F9F86 /end MEASUREMENT
/begin MEASUREMENT ed_rbm_appl_data_inj.numerator_nv "Diagnosezyklen" UWORD FORMULA_0010 0 0.0 0.0 65535.0 READ_WRITE ECU_ADDRESS 0x3F9F84 /end MEASUREMENT
/begin MEASUREMENT ed_rbm_codierung.denominator_nv "Fahrzyklen" UWORD FORMULA_0010 0 0.0 0.0 65535.0 READ_WRITE ECU_ADDRESS 0x3FA03E /end MEASUREMENT
/begin MEASUREMENT ed_rbm_codierung.numerator_nv "Diagnosezyklen" UWORD FORMULA_0010 0 0.0 0.0 65535.0 READ_WRITE ECU_ADDRESS 0x3FA03C /end MEASUREMENT
/begin MEASUREMENT ed_rbm_denominator_nv "Status der Denominatorerhoehung" UBYTE FORMULA_0003 0 0.0 0.0 255.0 READ_WRITE ECU_ADDRESS 0x3F9931 /end MEASUREMENT
/begin MEASUREMENT ed_rbm_dk1_enltg.denominator_nv "Fahrzyklen" UWORD FORMULA_0010 0 0.0 0.0 65535.0 READ_WRITE ECU_ADDRESS 0x3FA0C2 /end MEASUREMENT
/begin MEASUREMENT ed_rbm_dk1_enltg.numerator_nv "Diagnosezyklen" UWORD FORMULA_0010 0 0.0 0.0 65535.0 READ_WRITE ECU_ADDRESS 0x3FA0C0 /end MEASUREMENT
/begin MEASUREMENT ed_rbm_dk2_enltg.denominator_nv "Fahrzyklen" UWORD FORMULA_0010 0 0.0 0.0 65535.0 READ_WRITE ECU_ADDRESS 0x3FA0C6 /end MEASUREMENT
/begin MEASUREMENT ed_rbm_dk2_enltg.numerator_nv "Diagnosezyklen" UWORD FORMULA_0010 0 0.0 0.0 65535.0 READ_WRITE ECU_ADDRESS 0x3FA0C4 /end MEASUREMENT
/begin MEASUREMENT ed_rbm_dmtl_deckel.denominator_nv "Fahrzyklen" UWORD FORMULA_0010 0 0.0 0.0 65535.0 READ_WRITE ECU_ADDRESS 0x3FA02A /end MEASUREMENT
/begin MEASUREMENT ed_rbm_dmtl_deckel.numerator_nv "Diagnosezyklen" UWORD FORMULA_0010 0 0.0 0.0 65535.0 READ_WRITE ECU_ADDRESS 0x3FA028 /end MEASUREMENT
/begin MEASUREMENT ed_rbm_dmtl_feinleck.denominator_nv "Fahrzyklen" UWORD FORMULA_0010 0 0.0 0.0 65535.0 READ_WRITE ECU_ADDRESS 0x3FA14A /end MEASUREMENT
/begin MEASUREMENT ed_rbm_dmtl_feinleck.numerator_nv "Diagnosezyklen" UWORD FORMULA_0010 0 0.0 0.0 65535.0 READ_WRITE ECU_ADDRESS 0x3FA148 /end MEASUREMENT
/begin MEASUREMENT ed_rbm_dmtl_feucht.denominator_nv "Fahrzyklen" UWORD FORMULA_0010 0 0.0 0.0 65535.0 READ_WRITE ECU_ADDRESS 0x3FA026 /end MEASUREMENT
/begin MEASUREMENT ed_rbm_dmtl_feucht.numerator_nv "Diagnosezyklen" UWORD FORMULA_0010 0 0.0 0.0 65535.0 READ_WRITE ECU_ADDRESS 0x3FA024 /end MEASUREMENT
/begin MEASUREMENT ed_rbm_dmtl_grobleck.denominator_nv "Fahrzyklen" UWORD FORMULA_0010 0 0.0 0.0 65535.0 READ_WRITE ECU_ADDRESS 0x3FA022 /end MEASUREMENT
/begin MEASUREMENT ed_rbm_dmtl_grobleck.numerator_nv "Diagnosezyklen" UWORD FORMULA_0010 0 0.0 0.0 65535.0 READ_WRITE ECU_ADDRESS 0x3FA020 /end MEASUREMENT
/begin MEASUREMENT ed_rbm_dmtl_h.denominator_nv "Fahrzyklen" UWORD FORMULA_0010 0 0.0 0.0 65535.0 READ_WRITE ECU_ADDRESS 0x3FA01E /end MEASUREMENT
/begin MEASUREMENT ed_rbm_dmtl_h.numerator_nv "Diagnosezyklen" UWORD FORMULA_0010 0 0.0 0.0 65535.0 READ_WRITE ECU_ADDRESS 0x3FA01C /end MEASUREMENT
/begin MEASUREMENT ed_rbm_dmtl_p.denominator_nv "Fahrzyklen" UWORD FORMULA_0010 0 0.0 0.0 65535.0 READ_WRITE ECU_ADDRESS 0x3FA016 /end MEASUREMENT
/begin MEASUREMENT ed_rbm_dmtl_p.numerator_nv "Diagnosezyklen" UWORD FORMULA_0010 0 0.0 0.0 65535.0 READ_WRITE ECU_ADDRESS 0x3FA014 /end MEASUREMENT
/begin MEASUREMENT ed_rbm_dmtl_v.denominator_nv "Fahrzyklen" UWORD FORMULA_0010 0 0.0 0.0 65535.0 READ_WRITE ECU_ADDRESS 0x3FA01A /end MEASUREMENT
/begin MEASUREMENT ed_rbm_dmtl_v.numerator_nv "Diagnosezyklen" UWORD FORMULA_0010 0 0.0 0.0 65535.0 READ_WRITE ECU_ADDRESS 0x3FA018 /end MEASUREMENT
/begin MEASUREMENT ed_rbm_e2_inj.denominator_nv "Fahrzyklen" UWORD FORMULA_0010 0 0.0 0.0 65535.0 READ_WRITE ECU_ADDRESS 0x3FA0DE /end MEASUREMENT
/begin MEASUREMENT ed_rbm_e2_inj.numerator_nv "Diagnosezyklen" UWORD FORMULA_0010 0 0.0 0.0 65535.0 READ_WRITE ECU_ADDRESS 0x3FA0DC /end MEASUREMENT
/begin MEASUREMENT ed_rbm_ebox_elu.denominator_nv "Fahrzyklen" UWORD FORMULA_0010 0 0.0 0.0 65535.0 READ_WRITE ECU_ADDRESS 0x3FA0BA /end MEASUREMENT
/begin MEASUREMENT ed_rbm_ebox_elu.numerator_nv "Diagnosezyklen" UWORD FORMULA_0010 0 0.0 0.0 65535.0 READ_WRITE ECU_ADDRESS 0x3FA0B8 /end MEASUREMENT
/begin MEASUREMENT ed_rbm_ekp_pwm.denominator_nv "Fahrzyklen" UWORD FORMULA_0010 0 0.0 0.0 65535.0 READ_WRITE ECU_ADDRESS 0x3FA03A /end MEASUREMENT
/begin MEASUREMENT ed_rbm_ekp_pwm.numerator_nv "Diagnosezyklen" UWORD FORMULA_0010 0 0.0 0.0 65535.0 READ_WRITE ECU_ADDRESS 0x3FA038 /end MEASUREMENT
/begin MEASUREMENT ed_rbm_elu.denominator_nv "Fahrzyklen" UWORD FORMULA_0010 0 0.0 0.0 65535.0 READ_WRITE ECU_ADDRESS 0x3FA11E /end MEASUREMENT
/begin MEASUREMENT ed_rbm_elu.numerator_nv "Diagnosezyklen" UWORD FORMULA_0010 0 0.0 0.0 65535.0 READ_WRITE ECU_ADDRESS 0x3FA11C /end MEASUREMENT
/begin MEASUREMENT ed_rbm_elup.denominator_nv "Fahrzyklen" UWORD FORMULA_0010 0 0.0 0.0 65535.0 READ_WRITE ECU_ADDRESS 0x3FA11A /end MEASUREMENT
/begin MEASUREMENT ed_rbm_elup.numerator_nv "Diagnosezyklen" UWORD FORMULA_0010 0 0.0 0.0 65535.0 READ_WRITE ECU_ADDRESS 0x3FA118 /end MEASUREMENT
/begin MEASUREMENT ed_rbm_ev1.denominator_nv "Fahrzyklen" UWORD FORMULA_0010 0 0.0 0.0 65535.0 READ_WRITE ECU_ADDRESS 0x3F9FDA /end MEASUREMENT
/begin MEASUREMENT ed_rbm_ev1.numerator_nv "Diagnosezyklen" UWORD FORMULA_0010 0 0.0 0.0 65535.0 READ_WRITE ECU_ADDRESS 0x3F9FD8 /end MEASUREMENT
/begin MEASUREMENT ed_rbm_ev10.denominator_nv "Fahrzyklen" UWORD FORMULA_0010 0 0.0 0.0 65535.0 READ_WRITE ECU_ADDRESS 0x3F9FFE /end MEASUREMENT
/begin MEASUREMENT ed_rbm_ev10.numerator_nv "Diagnosezyklen" UWORD FORMULA_0010 0 0.0 0.0 65535.0 READ_WRITE ECU_ADDRESS 0x3F9FFC /end MEASUREMENT
/begin MEASUREMENT ed_rbm_ev2.denominator_nv "Fahrzyklen" UWORD FORMULA_0010 0 0.0 0.0 65535.0 READ_WRITE ECU_ADDRESS 0x3F9FDE /end MEASUREMENT
/begin MEASUREMENT ed_rbm_ev2.numerator_nv "Diagnosezyklen" UWORD FORMULA_0010 0 0.0 0.0 65535.0 READ_WRITE ECU_ADDRESS 0x3F9FDC /end MEASUREMENT
/begin MEASUREMENT ed_rbm_ev3.denominator_nv "Fahrzyklen" UWORD FORMULA_0010 0 0.0 0.0 65535.0 READ_WRITE ECU_ADDRESS 0x3F9FE2 /end MEASUREMENT
/begin MEASUREMENT ed_rbm_ev3.numerator_nv "Diagnosezyklen" UWORD FORMULA_0010 0 0.0 0.0 65535.0 READ_WRITE ECU_ADDRESS 0x3F9FE0 /end MEASUREMENT
/begin MEASUREMENT ed_rbm_ev4.denominator_nv "Fahrzyklen" UWORD FORMULA_0010 0 0.0 0.0 65535.0 READ_WRITE ECU_ADDRESS 0x3F9FE6 /end MEASUREMENT
/begin MEASUREMENT ed_rbm_ev4.numerator_nv "Diagnosezyklen" UWORD FORMULA_0010 0 0.0 0.0 65535.0 READ_WRITE ECU_ADDRESS 0x3F9FE4 /end MEASUREMENT
/begin MEASUREMENT ed_rbm_ev5.denominator_nv "Fahrzyklen" UWORD FORMULA_0010 0 0.0 0.0 65535.0 READ_WRITE ECU_ADDRESS 0x3F9FEA /end MEASUREMENT
/begin MEASUREMENT ed_rbm_ev5.numerator_nv "Diagnosezyklen" UWORD FORMULA_0010 0 0.0 0.0 65535.0 READ_WRITE ECU_ADDRESS 0x3F9FE8 /end MEASUREMENT
/begin MEASUREMENT ed_rbm_ev6.denominator_nv "Fahrzyklen" UWORD FORMULA_0010 0 0.0 0.0 65535.0 READ_WRITE ECU_ADDRESS 0x3F9FEE /end MEASUREMENT
/begin MEASUREMENT ed_rbm_ev6.numerator_nv "Diagnosezyklen" UWORD FORMULA_0010 0 0.0 0.0 65535.0 READ_WRITE ECU_ADDRESS 0x3F9FEC /end MEASUREMENT
/begin MEASUREMENT ed_rbm_ev7.denominator_nv "Fahrzyklen" UWORD FORMULA_0010 0 0.0 0.0 65535.0 READ_WRITE ECU_ADDRESS 0x3F9FF2 /end MEASUREMENT
/begin MEASUREMENT ed_rbm_ev7.numerator_nv "Diagnosezyklen" UWORD FORMULA_0010 0 0.0 0.0 65535.0 READ_WRITE ECU_ADDRESS 0x3F9FF0 /end MEASUREMENT
/begin MEASUREMENT ed_rbm_ev8.denominator_nv "Fahrzyklen" UWORD FORMULA_0010 0 0.0 0.0 65535.0 READ_WRITE ECU_ADDRESS 0x3F9FF6 /end MEASUREMENT
/begin MEASUREMENT ed_rbm_ev8.numerator_nv "Diagnosezyklen" UWORD FORMULA_0010 0 0.0 0.0 65535.0 READ_WRITE ECU_ADDRESS 0x3F9FF4 /end MEASUREMENT
/begin MEASUREMENT ed_rbm_ev9.denominator_nv "Fahrzyklen" UWORD FORMULA_0010 0 0.0 0.0 65535.0 READ_WRITE ECU_ADDRESS 0x3F9FFA /end MEASUREMENT
/begin MEASUREMENT ed_rbm_ev9.numerator_nv "Diagnosezyklen" UWORD FORMULA_0010 0 0.0 0.0 65535.0 READ_WRITE ECU_ADDRESS 0x3F9FF8 /end MEASUREMENT
/begin MEASUREMENT ed_rbm_ews_man.denominator_nv "Fahrzyklen" UWORD FORMULA_0010 0 0.0 0.0 65535.0 READ_WRITE ECU_ADDRESS 0x3FA0A2 /end MEASUREMENT
/begin MEASUREMENT ed_rbm_ews_man.numerator_nv "Diagnosezyklen" UWORD FORMULA_0010 0 0.0 0.0 65535.0 READ_WRITE ECU_ADDRESS 0x3FA0A0 /end MEASUREMENT
/begin MEASUREMENT ed_rbm_ews_sci.denominator_nv "Fahrzyklen" UWORD FORMULA_0010 0 0.0 0.0 65535.0 READ_WRITE ECU_ADDRESS 0x3FA09E /end MEASUREMENT
/begin MEASUREMENT ed_rbm_ews_sci.numerator_nv "Diagnosezyklen" UWORD FORMULA_0010 0 0.0 0.0 65535.0 READ_WRITE ECU_ADDRESS 0x3FA09C /end MEASUREMENT
/begin MEASUREMENT ed_rbm_fetrawe.denominator_nv "Fahrzyklen" UWORD FORMULA_0010 0 0.0 0.0 65535.0 READ_WRITE ECU_ADDRESS 0x3FA10A /end MEASUREMENT
/begin MEASUREMENT ed_rbm_fetrawe.numerator_nv "Diagnosezyklen" UWORD FORMULA_0010 0 0.0 0.0 65535.0 READ_WRITE ECU_ADDRESS 0x3FA108 /end MEASUREMENT
/begin MEASUREMENT ed_rbm_fi_bsd.denominator_nv "Fahrzyklen" UWORD FORMULA_0010 0 0.0 0.0 65535.0 READ_WRITE ECU_ADDRESS 0x3FA072 /end MEASUREMENT
/begin MEASUREMENT ed_rbm_fi_bsd.numerator_nv "Diagnosezyklen" UWORD FORMULA_0010 0 0.0 0.0 65535.0 READ_WRITE ECU_ADDRESS 0x3FA070 /end MEASUREMENT
/begin MEASUREMENT ed_rbm_fi_bsd_0.denominator_nv "Fahrzyklen" UWORD FORMULA_0010 0 0.0 0.0 65535.0 READ_WRITE ECU_ADDRESS 0x3FA0A6 /end MEASUREMENT
/begin MEASUREMENT ed_rbm_fi_bsd_0.numerator_nv "Diagnosezyklen" UWORD FORMULA_0010 0 0.0 0.0 65535.0 READ_WRITE ECU_ADDRESS 0x3FA0A4 /end MEASUREMENT
/begin MEASUREMENT ed_rbm_fi_bsd_6.denominator_nv "Fahrzyklen" UWORD FORMULA_0010 0 0.0 0.0 65535.0 READ_WRITE ECU_ADDRESS 0x3FA0AA /end MEASUREMENT
/begin MEASUREMENT ed_rbm_fi_bsd_6.numerator_nv "Diagnosezyklen" UWORD FORMULA_0010 0 0.0 0.0 65535.0 READ_WRITE ECU_ADDRESS 0x3FA0A8 /end MEASUREMENT
/begin MEASUREMENT ed_rbm_fi_bsdglob.denominator_nv "Fahrzyklen" UWORD FORMULA_0010 0 0.0 0.0 65535.0 READ_WRITE ECU_ADDRESS 0x3FA0AE /end MEASUREMENT
/begin MEASUREMENT ed_rbm_fi_bsdglob.numerator_nv "Diagnosezyklen" UWORD FORMULA_0010 0 0.0 0.0 65535.0 READ_WRITE ECU_ADDRESS 0x3FA0AC /end MEASUREMENT
/begin MEASUREMENT ed_rbm_fi_gen.denominator_nv "Fahrzyklen" UWORD FORMULA_0010 0 0.0 0.0 65535.0 READ_WRITE ECU_ADDRESS 0x3FA06E /end MEASUREMENT
/begin MEASUREMENT ed_rbm_fi_gen.numerator_nv "Diagnosezyklen" UWORD FORMULA_0010 0 0.0 0.0 65535.0 READ_WRITE ECU_ADDRESS 0x3FA06C /end MEASUREMENT
/begin MEASUREMENT ed_rbm_fi_ibs1.denominator_nv "Fahrzyklen" UWORD FORMULA_0010 0 0.0 0.0 65535.0 READ_WRITE ECU_ADDRESS 0x3FA07A /end MEASUREMENT
/begin MEASUREMENT ed_rbm_fi_ibs1.numerator_nv "Diagnosezyklen" UWORD FORMULA_0010 0 0.0 0.0 65535.0 READ_WRITE ECU_ADDRESS 0x3FA078 /end MEASUREMENT
/begin MEASUREMENT ed_rbm_fi_ibs2.denominator_nv "Fahrzyklen" UWORD FORMULA_0010 0 0.0 0.0 65535.0 READ_WRITE ECU_ADDRESS 0x3FA07E /end MEASUREMENT
/begin MEASUREMENT ed_rbm_fi_ibs2.numerator_nv "Diagnosezyklen" UWORD FORMULA_0010 0 0.0 0.0 65535.0 READ_WRITE ECU_ADDRESS 0x3FA07C /end MEASUREMENT
/begin MEASUREMENT ed_rbm_fi_ibs3.denominator_nv "Fahrzyklen" UWORD FORMULA_0010 0 0.0 0.0 65535.0 READ_WRITE ECU_ADDRESS 0x3FA082 /end MEASUREMENT
/begin MEASUREMENT ed_rbm_fi_ibs3.numerator_nv "Diagnosezyklen" UWORD FORMULA_0010 0 0.0 0.0 65535.0 READ_WRITE ECU_ADDRESS 0x3FA080 /end MEASUREMENT
/begin MEASUREMENT ed_rbm_fi_pmbatt.denominator_nv "Fahrzyklen" UWORD FORMULA_0010 0 0.0 0.0 65535.0 READ_WRITE ECU_ADDRESS 0x3FA08A /end MEASUREMENT
/begin MEASUREMENT ed_rbm_fi_pmbatt.numerator_nv "Diagnosezyklen" UWORD FORMULA_0010 0 0.0 0.0 65535.0 READ_WRITE ECU_ADDRESS 0x3FA088 /end MEASUREMENT
/begin MEASUREMENT ed_rbm_fi_pmbn.denominator_nv "Fahrzyklen" UWORD FORMULA_0010 0 0.0 0.0 65535.0 READ_WRITE ECU_ADDRESS 0x3FA086 /end MEASUREMENT
/begin MEASUREMENT ed_rbm_fi_pmbn.numerator_nv "Diagnosezyklen" UWORD FORMULA_0010 0 0.0 0.0 65535.0 READ_WRITE ECU_ADDRESS 0x3FA084 /end MEASUREMENT
/begin MEASUREMENT ed_rbm_fi_pmruhverl.denominator_nv "Fahrzyklen" UWORD FORMULA_0010 0 0.0 0.0 65535.0 READ_WRITE ECU_ADDRESS 0x3FA0B2 /end MEASUREMENT
/begin MEASUREMENT ed_rbm_fi_pmruhverl.numerator_nv "Diagnosezyklen" UWORD FORMULA_0010 0 0.0 0.0 65535.0 READ_WRITE ECU_ADDRESS 0x3FA0B0 /end MEASUREMENT
/begin MEASUREMENT ed_rbm_fi_qlt.denominator_nv "Fahrzyklen" UWORD FORMULA_0010 0 0.0 0.0 65535.0 READ_WRITE ECU_ADDRESS 0x3FA076 /end MEASUREMENT
/begin MEASUREMENT ed_rbm_fi_qlt.numerator_nv "Diagnosezyklen" UWORD FORMULA_0010 0 0.0 0.0 65535.0 READ_WRITE ECU_ADDRESS 0x3FA074 /end MEASUREMENT
/begin MEASUREMENT ed_rbm_fi_toens.denominator_nv "Fahrzyklen" UWORD FORMULA_0010 0 0.0 0.0 65535.0 READ_WRITE ECU_ADDRESS 0x3FA0B6 /end MEASUREMENT
/begin MEASUREMENT ed_rbm_fi_toens.numerator_nv "Diagnosezyklen" UWORD FORMULA_0010 0 0.0 0.0 65535.0 READ_WRITE ECU_ADDRESS 0x3FA0B4 /end MEASUREMENT
/begin MEASUREMENT ed_rbm_fplau1.denominator_nv "Fahrzyklen" UWORD FORMULA_0010 0 0.0 0.0 65535.0 READ_WRITE ECU_ADDRESS 0x3F9F1A /end MEASUREMENT
/begin MEASUREMENT ed_rbm_fplau1.numerator_nv "Diagnosezyklen" UWORD FORMULA_0010 0 0.0 0.0 65535.0 READ_WRITE ECU_ADDRESS 0x3F9F18 /end MEASUREMENT
/begin MEASUREMENT ed_rbm_fplau2.denominator_nv "Fahrzyklen" UWORD FORMULA_0010 0 0.0 0.0 65535.0 READ_WRITE ECU_ADDRESS 0x3F9F1E /end MEASUREMENT
/begin MEASUREMENT ed_rbm_fplau2.numerator_nv "Diagnosezyklen" UWORD FORMULA_0010 0 0.0 0.0 65535.0 READ_WRITE ECU_ADDRESS 0x3F9F1C /end MEASUREMENT
/begin MEASUREMENT ed_rbm_fst.denominator_nv "Fahrzyklen" UWORD FORMULA_0010 0 0.0 0.0 65535.0 READ_WRITE ECU_ADDRESS 0x3FA0F6 /end MEASUREMENT
/begin MEASUREMENT ed_rbm_fst.numerator_nv "Diagnosezyklen" UWORD FORMULA_0010 0 0.0 0.0 65535.0 READ_WRITE ECU_ADDRESS 0x3FA0F4 /end MEASUREMENT
/begin MEASUREMENT ed_rbm_fst_geber.denominator_nv "Fahrzyklen" UWORD FORMULA_0010 0 0.0 0.0 65535.0 READ_WRITE ECU_ADDRESS 0x3FA13E /end MEASUREMENT
/begin MEASUREMENT ed_rbm_fst_geber.numerator_nv "Diagnosezyklen" UWORD FORMULA_0010 0 0.0 0.0 65535.0 READ_WRITE ECU_ADDRESS 0x3FA13C /end MEASUREMENT
/begin MEASUREMENT ed_rbm_hfm1.denominator_nv "Fahrzyklen" UWORD FORMULA_0010 0 0.0 0.0 65535.0 READ_WRITE ECU_ADDRESS 0x3F9E86 /end MEASUREMENT
/begin MEASUREMENT ed_rbm_hfm1.numerator_nv "Diagnosezyklen" UWORD FORMULA_0010 0 0.0 0.0 65535.0 READ_WRITE ECU_ADDRESS 0x3F9E84 /end MEASUREMENT
/begin MEASUREMENT ed_rbm_hfm2.denominator_nv "Fahrzyklen" UWORD FORMULA_0010 0 0.0 0.0 65535.0 READ_WRITE ECU_ADDRESS 0x3F9E8A /end MEASUREMENT
/begin MEASUREMENT ed_rbm_hfm2.numerator_nv "Diagnosezyklen" UWORD FORMULA_0010 0 0.0 0.0 65535.0 READ_WRITE ECU_ADDRESS 0x3F9E88 /end MEASUREMENT
/begin MEASUREMENT ed_rbm_index_135_inj.denominator_nv "Fahrzyklen" UWORD FORMULA_0010 0 0.0 0.0 65535.0 READ_WRITE ECU_ADDRESS 0x3FA09A /end MEASUREMENT
/begin MEASUREMENT ed_rbm_index_135_inj.numerator_nv "Diagnosezyklen" UWORD FORMULA_0010 0 0.0 0.0 65535.0 READ_WRITE ECU_ADDRESS 0x3FA098 /end MEASUREMENT
/begin MEASUREMENT ed_rbm_index_15_inj.denominator_nv "Fahrzyklen" UWORD FORMULA_0010 0 0.0 0.0 65535.0 READ_WRITE ECU_ADDRESS 0x3F9EBA /end MEASUREMENT
/begin MEASUREMENT ed_rbm_index_15_inj.numerator_nv "Diagnosezyklen" UWORD FORMULA_0010 0 0.0 0.0 65535.0 READ_WRITE ECU_ADDRESS 0x3F9EB8 /end MEASUREMENT
/begin MEASUREMENT ed_rbm_index_196_inj.denominator_nv "Fahrzyklen" UWORD FORMULA_0010 0 0.0 0.0 65535.0 READ_WRITE ECU_ADDRESS 0x3FA18E /end MEASUREMENT
/begin MEASUREMENT ed_rbm_index_196_inj.numerator_nv "Diagnosezyklen" UWORD FORMULA_0010 0 0.0 0.0 65535.0 READ_WRITE ECU_ADDRESS 0x3FA18C /end MEASUREMENT
/begin MEASUREMENT ed_rbm_index_197_inj.denominator_nv "Fahrzyklen" UWORD FORMULA_0010 0 0.0 0.0 65535.0 READ_WRITE ECU_ADDRESS 0x3FA192 /end MEASUREMENT
/begin MEASUREMENT ed_rbm_index_197_inj.numerator_nv "Diagnosezyklen" UWORD FORMULA_0010 0 0.0 0.0 65535.0 READ_WRITE ECU_ADDRESS 0x3FA190 /end MEASUREMENT
/begin MEASUREMENT ed_rbm_index_198_inj.denominator_nv "Fahrzyklen" UWORD FORMULA_0010 0 0.0 0.0 65535.0 READ_WRITE ECU_ADDRESS 0x3FA196 /end MEASUREMENT
/begin MEASUREMENT ed_rbm_index_198_inj.numerator_nv "Diagnosezyklen" UWORD FORMULA_0010 0 0.0 0.0 65535.0 READ_WRITE ECU_ADDRESS 0x3FA194 /end MEASUREMENT
/begin MEASUREMENT ed_rbm_index_199_inj.denominator_nv "Fahrzyklen" UWORD FORMULA_0010 0 0.0 0.0 65535.0 READ_WRITE ECU_ADDRESS 0x3FA19A /end MEASUREMENT
/begin MEASUREMENT ed_rbm_index_199_inj.numerator_nv "Diagnosezyklen" UWORD FORMULA_0010 0 0.0 0.0 65535.0 READ_WRITE ECU_ADDRESS 0x3FA198 /end MEASUREMENT
/begin MEASUREMENT ed_rbm_index_200_inj.denominator_nv "Fahrzyklen" UWORD FORMULA_0010 0 0.0 0.0 65535.0 READ_WRITE ECU_ADDRESS 0x3FA19E /end MEASUREMENT
/begin MEASUREMENT ed_rbm_index_200_inj.numerator_nv "Diagnosezyklen" UWORD FORMULA_0010 0 0.0 0.0 65535.0 READ_WRITE ECU_ADDRESS 0x3FA19C /end MEASUREMENT
/begin MEASUREMENT ed_rbm_index_201_inj.denominator_nv "Fahrzyklen" UWORD FORMULA_0010 0 0.0 0.0 65535.0 READ_WRITE ECU_ADDRESS 0x3FA1A2 /end MEASUREMENT
/begin MEASUREMENT ed_rbm_index_201_inj.numerator_nv "Diagnosezyklen" UWORD FORMULA_0010 0 0.0 0.0 65535.0 READ_WRITE ECU_ADDRESS 0x3FA1A0 /end MEASUREMENT
/begin MEASUREMENT ed_rbm_index_202_inj.denominator_nv "Fahrzyklen" UWORD FORMULA_0010 0 0.0 0.0 65535.0 READ_WRITE ECU_ADDRESS 0x3FA1A6 /end MEASUREMENT
/begin MEASUREMENT ed_rbm_index_202_inj.numerator_nv "Diagnosezyklen" UWORD FORMULA_0010 0 0.0 0.0 65535.0 READ_WRITE ECU_ADDRESS 0x3FA1A4 /end MEASUREMENT
/begin MEASUREMENT ed_rbm_index_203_inj.denominator_nv "Fahrzyklen" UWORD FORMULA_0010 0 0.0 0.0 65535.0 READ_WRITE ECU_ADDRESS 0x3FA1AA /end MEASUREMENT
/begin MEASUREMENT ed_rbm_index_203_inj.numerator_nv "Diagnosezyklen" UWORD FORMULA_0010 0 0.0 0.0 65535.0 READ_WRITE ECU_ADDRESS 0x3FA1A8 /end MEASUREMENT
/begin MEASUREMENT ed_rbm_index_204_inj.denominator_nv "Fahrzyklen" UWORD FORMULA_0010 0 0.0 0.0 65535.0 READ_WRITE ECU_ADDRESS 0x3FA1AE /end MEASUREMENT
/begin MEASUREMENT ed_rbm_index_204_inj.numerator_nv "Diagnosezyklen" UWORD FORMULA_0010 0 0.0 0.0 65535.0 READ_WRITE ECU_ADDRESS 0x3FA1AC /end MEASUREMENT
/begin MEASUREMENT ed_rbm_index_205_inj.denominator_nv "Fahrzyklen" UWORD FORMULA_0010 0 0.0 0.0 65535.0 READ_WRITE ECU_ADDRESS 0x3FA1B2 /end MEASUREMENT
/begin MEASUREMENT ed_rbm_index_205_inj.numerator_nv "Diagnosezyklen" UWORD FORMULA_0010 0 0.0 0.0 65535.0 READ_WRITE ECU_ADDRESS 0x3FA1B0 /end MEASUREMENT
/begin MEASUREMENT ed_rbm_index_206_inj.denominator_nv "Fahrzyklen" UWORD FORMULA_0010 0 0.0 0.0 65535.0 READ_WRITE ECU_ADDRESS 0x3FA1B6 /end MEASUREMENT
/begin MEASUREMENT ed_rbm_index_206_inj.numerator_nv "Diagnosezyklen" UWORD FORMULA_0010 0 0.0 0.0 65535.0 READ_WRITE ECU_ADDRESS 0x3FA1B4 /end MEASUREMENT
/begin MEASUREMENT ed_rbm_index_207_inj.denominator_nv "Fahrzyklen" UWORD FORMULA_0010 0 0.0 0.0 65535.0 READ_WRITE ECU_ADDRESS 0x3FA1BA /end MEASUREMENT
/begin MEASUREMENT ed_rbm_index_207_inj.numerator_nv "Diagnosezyklen" UWORD FORMULA_0010 0 0.0 0.0 65535.0 READ_WRITE ECU_ADDRESS 0x3FA1B8 /end MEASUREMENT
/begin MEASUREMENT ed_rbm_index_208_inj.denominator_nv "Fahrzyklen" UWORD FORMULA_0010 0 0.0 0.0 65535.0 READ_WRITE ECU_ADDRESS 0x3FA1BE /end MEASUREMENT
/begin MEASUREMENT ed_rbm_index_208_inj.numerator_nv "Diagnosezyklen" UWORD FORMULA_0010 0 0.0 0.0 65535.0 READ_WRITE ECU_ADDRESS 0x3FA1BC /end MEASUREMENT
/begin MEASUREMENT ed_rbm_index_209_inj.denominator_nv "Fahrzyklen" UWORD FORMULA_0010 0 0.0 0.0 65535.0 READ_WRITE ECU_ADDRESS 0x3FA1C2 /end MEASUREMENT
/begin MEASUREMENT ed_rbm_index_209_inj.numerator_nv "Diagnosezyklen" UWORD FORMULA_0010 0 0.0 0.0 65535.0 READ_WRITE ECU_ADDRESS 0x3FA1C0 /end MEASUREMENT
/begin MEASUREMENT ed_rbm_index_210_inj.denominator_nv "Fahrzyklen" UWORD FORMULA_0010 0 0.0 0.0 65535.0 READ_WRITE ECU_ADDRESS 0x3FA1C6 /end MEASUREMENT
/begin MEASUREMENT ed_rbm_index_210_inj.numerator_nv "Diagnosezyklen" UWORD FORMULA_0010 0 0.0 0.0 65535.0 READ_WRITE ECU_ADDRESS 0x3FA1C4 /end MEASUREMENT
/begin MEASUREMENT ed_rbm_index_211_inj.denominator_nv "Fahrzyklen" UWORD FORMULA_0010 0 0.0 0.0 65535.0 READ_WRITE ECU_ADDRESS 0x3FA1CA /end MEASUREMENT
/begin MEASUREMENT ed_rbm_index_211_inj.numerator_nv "Diagnosezyklen" UWORD FORMULA_0010 0 0.0 0.0 65535.0 READ_WRITE ECU_ADDRESS 0x3FA1C8 /end MEASUREMENT
/begin MEASUREMENT ed_rbm_index_212_inj.denominator_nv "Fahrzyklen" UWORD FORMULA_0010 0 0.0 0.0 65535.0 READ_WRITE ECU_ADDRESS 0x3FA1CE /end MEASUREMENT
/begin MEASUREMENT ed_rbm_index_212_inj.numerator_nv "Diagnosezyklen" UWORD FORMULA_0010 0 0.0 0.0 65535.0 READ_WRITE ECU_ADDRESS 0x3FA1CC /end MEASUREMENT
/begin MEASUREMENT ed_rbm_index_213_inj.denominator_nv "Fahrzyklen" UWORD FORMULA_0010 0 0.0 0.0 65535.0 READ_WRITE ECU_ADDRESS 0x3FA1D2 /end MEASUREMENT
/begin MEASUREMENT ed_rbm_index_213_inj.numerator_nv "Diagnosezyklen" UWORD FORMULA_0010 0 0.0 0.0 65535.0 READ_WRITE ECU_ADDRESS 0x3FA1D0 /end MEASUREMENT
/begin MEASUREMENT ed_rbm_index_214_inj.denominator_nv "Fahrzyklen" UWORD FORMULA_0010 0 0.0 0.0 65535.0 READ_WRITE ECU_ADDRESS 0x3FA1D6 /end MEASUREMENT
/begin MEASUREMENT ed_rbm_index_214_inj.numerator_nv "Diagnosezyklen" UWORD FORMULA_0010 0 0.0 0.0 65535.0 READ_WRITE ECU_ADDRESS 0x3FA1D4 /end MEASUREMENT
/begin MEASUREMENT ed_rbm_index_215_inj.denominator_nv "Fahrzyklen" UWORD FORMULA_0010 0 0.0 0.0 65535.0 READ_WRITE ECU_ADDRESS 0x3FA1DA /end MEASUREMENT
/begin MEASUREMENT ed_rbm_index_215_inj.numerator_nv "Diagnosezyklen" UWORD FORMULA_0010 0 0.0 0.0 65535.0 READ_WRITE ECU_ADDRESS 0x3FA1D8 /end MEASUREMENT
/begin MEASUREMENT ed_rbm_index_216_inj.denominator_nv "Fahrzyklen" UWORD FORMULA_0010 0 0.0 0.0 65535.0 READ_WRITE ECU_ADDRESS 0x3FA1DE /end MEASUREMENT
/begin MEASUREMENT ed_rbm_index_216_inj.numerator_nv "Diagnosezyklen" UWORD FORMULA_0010 0 0.0 0.0 65535.0 READ_WRITE ECU_ADDRESS 0x3FA1DC /end MEASUREMENT
/begin MEASUREMENT ed_rbm_index_217_inj.denominator_nv "Fahrzyklen" UWORD FORMULA_0010 0 0.0 0.0 65535.0 READ_WRITE ECU_ADDRESS 0x3FA1E2 /end MEASUREMENT
/begin MEASUREMENT ed_rbm_index_217_inj.numerator_nv "Diagnosezyklen" UWORD FORMULA_0010 0 0.0 0.0 65535.0 READ_WRITE ECU_ADDRESS 0x3FA1E0 /end MEASUREMENT
/begin MEASUREMENT ed_rbm_index_218_inj.denominator_nv "Fahrzyklen" UWORD FORMULA_0010 0 0.0 0.0 65535.0 READ_WRITE ECU_ADDRESS 0x3FA1E6 /end MEASUREMENT
/begin MEASUREMENT ed_rbm_index_218_inj.numerator_nv "Diagnosezyklen" UWORD FORMULA_0010 0 0.0 0.0 65535.0 READ_WRITE ECU_ADDRESS 0x3FA1E4 /end MEASUREMENT
/begin MEASUREMENT ed_rbm_index_219_inj.denominator_nv "Fahrzyklen" UWORD FORMULA_0010 0 0.0 0.0 65535.0 READ_WRITE ECU_ADDRESS 0x3FA1EA /end MEASUREMENT
/begin MEASUREMENT ed_rbm_index_219_inj.numerator_nv "Diagnosezyklen" UWORD FORMULA_0010 0 0.0 0.0 65535.0 READ_WRITE ECU_ADDRESS 0x3FA1E8 /end MEASUREMENT
/begin MEASUREMENT ed_rbm_index_220_inj.denominator_nv "Fahrzyklen" UWORD FORMULA_0010 0 0.0 0.0 65535.0 READ_WRITE ECU_ADDRESS 0x3FA1EE /end MEASUREMENT
/begin MEASUREMENT ed_rbm_index_220_inj.numerator_nv "Diagnosezyklen" UWORD FORMULA_0010 0 0.0 0.0 65535.0 READ_WRITE ECU_ADDRESS 0x3FA1EC /end MEASUREMENT
/begin MEASUREMENT ed_rbm_index_221_inj.denominator_nv "Fahrzyklen" UWORD FORMULA_0010 0 0.0 0.0 65535.0 READ_WRITE ECU_ADDRESS 0x3FA1F2 /end MEASUREMENT
/begin MEASUREMENT ed_rbm_index_221_inj.numerator_nv "Diagnosezyklen" UWORD FORMULA_0010 0 0.0 0.0 65535.0 READ_WRITE ECU_ADDRESS 0x3FA1F0 /end MEASUREMENT
/begin MEASUREMENT ed_rbm_index_222_inj.denominator_nv "Fahrzyklen" UWORD FORMULA_0010 0 0.0 0.0 65535.0 READ_WRITE ECU_ADDRESS 0x3FA1F6 /end MEASUREMENT
/begin MEASUREMENT ed_rbm_index_222_inj.numerator_nv "Diagnosezyklen" UWORD FORMULA_0010 0 0.0 0.0 65535.0 READ_WRITE ECU_ADDRESS 0x3FA1F4 /end MEASUREMENT
/begin MEASUREMENT ed_rbm_index_223_inj.denominator_nv "Fahrzyklen" UWORD FORMULA_0010 0 0.0 0.0 65535.0 READ_WRITE ECU_ADDRESS 0x3FA1FA /end MEASUREMENT
/begin MEASUREMENT ed_rbm_index_223_inj.numerator_nv "Diagnosezyklen" UWORD FORMULA_0010 0 0.0 0.0 65535.0 READ_WRITE ECU_ADDRESS 0x3FA1F8 /end MEASUREMENT
/begin MEASUREMENT ed_rbm_kat_obd1.denominator_nv "Fahrzyklen" UWORD FORMULA_0010 0 0.0 0.0 65535.0 READ_WRITE ECU_ADDRESS 0x3FA062 /end MEASUREMENT
/begin MEASUREMENT ed_rbm_kat_obd1.numerator_nv "Diagnosezyklen" UWORD FORMULA_0010 0 0.0 0.0 65535.0 READ_WRITE ECU_ADDRESS 0x3FA060 /end MEASUREMENT
/begin MEASUREMENT ed_rbm_kat_obd2.denominator_nv "Fahrzyklen" UWORD FORMULA_0010 0 0.0 0.0 65535.0 READ_WRITE ECU_ADDRESS 0x3FA066 /end MEASUREMENT
/begin MEASUREMENT ed_rbm_kat_obd2.numerator_nv "Diagnosezyklen" UWORD FORMULA_0010 0 0.0 0.0 65535.0 READ_WRITE ECU_ADDRESS 0x3FA064 /end MEASUREMENT
/begin MEASUREMENT ed_rbm_kats_b1.denominator_nv "Fahrzyklen" UWORD FORMULA_0010 0 0.0 0.0 65535.0 READ_WRITE ECU_ADDRESS 0x3FA12E /end MEASUREMENT
/begin MEASUREMENT ed_rbm_kats_b1.numerator_nv "Diagnosezyklen" UWORD FORMULA_0010 0 0.0 0.0 65535.0 READ_WRITE ECU_ADDRESS 0x3FA12C /end MEASUREMENT
/begin MEASUREMENT ed_rbm_kats_b2.denominator_nv "Fahrzyklen" UWORD FORMULA_0010 0 0.0 0.0 65535.0 READ_WRITE ECU_ADDRESS 0x3FA132 /end MEASUREMENT
/begin MEASUREMENT ed_rbm_kats_b2.numerator_nv "Diagnosezyklen" UWORD FORMULA_0010 0 0.0 0.0 65535.0 READ_WRITE ECU_ADDRESS 0x3FA130 /end MEASUREMENT
/begin MEASUREMENT ed_rbm_kge1.denominator_nv "Fahrzyklen" UWORD FORMULA_0010 0 0.0 0.0 65535.0 READ_WRITE ECU_ADDRESS 0x3FA0EE /end MEASUREMENT
/begin MEASUREMENT ed_rbm_kge1.numerator_nv "Diagnosezyklen" UWORD FORMULA_0010 0 0.0 0.0 65535.0 READ_WRITE ECU_ADDRESS 0x3FA0EC /end MEASUREMENT
/begin MEASUREMENT ed_rbm_kge2.denominator_nv "Fahrzyklen" UWORD FORMULA_0010 0 0.0 0.0 65535.0 READ_WRITE ECU_ADDRESS 0x3FA0F2 /end MEASUREMENT
/begin MEASUREMENT ed_rbm_kge2.numerator_nv "Diagnosezyklen" UWORD FORMULA_0010 0 0.0 0.0 65535.0 READ_WRITE ECU_ADDRESS 0x3FA0F0 /end MEASUREMENT
/begin MEASUREMENT ed_rbm_ksd1.denominator_nv "Fahrzyklen" UWORD FORMULA_0010 0 0.0 0.0 65535.0 READ_WRITE ECU_ADDRESS 0x3FA126 /end MEASUREMENT
/begin MEASUREMENT ed_rbm_ksd1.numerator_nv "Diagnosezyklen" UWORD FORMULA_0010 0 0.0 0.0 65535.0 READ_WRITE ECU_ADDRESS 0x3FA124 /end MEASUREMENT
/begin MEASUREMENT ed_rbm_ksd2.denominator_nv "Fahrzyklen" UWORD FORMULA_0010 0 0.0 0.0 65535.0 READ_WRITE ECU_ADDRESS 0x3FA12A /end MEASUREMENT
/begin MEASUREMENT ed_rbm_ksd2.numerator_nv "Diagnosezyklen" UWORD FORMULA_0010 0 0.0 0.0 65535.0 READ_WRITE ECU_ADDRESS 0x3FA128 /end MEASUREMENT
/begin MEASUREMENT ed_rbm_kw.denominator_nv "Fahrzyklen" UWORD FORMULA_0010 0 0.0 0.0 65535.0 READ_WRITE ECU_ADDRESS 0x3FA0E2 /end MEASUREMENT
/begin MEASUREMENT ed_rbm_kw.numerator_nv "Diagnosezyklen" UWORD FORMULA_0010 0 0.0 0.0 65535.0 READ_WRITE ECU_ADDRESS 0x3FA0E0 /end MEASUREMENT
/begin MEASUREMENT ed_rbm_la1_adapt.denominator_nv "Fahrzyklen" UWORD FORMULA_0010 0 0.0 0.0 65535.0 READ_WRITE ECU_ADDRESS 0x3FA0E6 /end MEASUREMENT
/begin MEASUREMENT ed_rbm_la1_adapt.numerator_nv "Diagnosezyklen" UWORD FORMULA_0010 0 0.0 0.0 65535.0 READ_WRITE ECU_ADDRESS 0x3FA0E4 /end MEASUREMENT
/begin MEASUREMENT ed_rbm_la1_trim_ad.denominator_nv "Fahrzyklen" UWORD FORMULA_0010 0 0.0 0.0 65535.0 READ_WRITE ECU_ADDRESS 0x3FA156 /end MEASUREMENT
/begin MEASUREMENT ed_rbm_la1_trim_ad.numerator_nv "Diagnosezyklen" UWORD FORMULA_0010 0 0.0 0.0 65535.0 READ_WRITE ECU_ADDRESS 0x3FA154 /end MEASUREMENT
/begin MEASUREMENT ed_rbm_la2_adapt.denominator_nv "Fahrzyklen" UWORD FORMULA_0010 0 0.0 0.0 65535.0 READ_WRITE ECU_ADDRESS 0x3FA0EA /end MEASUREMENT
/begin MEASUREMENT ed_rbm_la2_adapt.numerator_nv "Diagnosezyklen" UWORD FORMULA_0010 0 0.0 0.0 65535.0 READ_WRITE ECU_ADDRESS 0x3FA0E8 /end MEASUREMENT
/begin MEASUREMENT ed_rbm_la2_trim_ad.denominator_nv "Fahrzyklen" UWORD FORMULA_0010 0 0.0 0.0 65535.0 READ_WRITE ECU_ADDRESS 0x3FA15A /end MEASUREMENT
/begin MEASUREMENT ed_rbm_la2_trim_ad.numerator_nv "Diagnosezyklen" UWORD FORMULA_0010 0 0.0 0.0 65535.0 READ_WRITE ECU_ADDRESS 0x3FA158 /end MEASUREMENT
/begin MEASUREMENT ed_rbm_lam1_reg.denominator_nv "Fahrzyklen" UWORD FORMULA_0010 0 0.0 0.0 65535.0 READ_WRITE ECU_ADDRESS 0x3F9FB2 /end MEASUREMENT
/begin MEASUREMENT ed_rbm_lam1_reg.numerator_nv "Diagnosezyklen" UWORD FORMULA_0010 0 0.0 0.0 65535.0 READ_WRITE ECU_ADDRESS 0x3F9FB0 /end MEASUREMENT
/begin MEASUREMENT ed_rbm_lam2_reg.denominator_nv "Fahrzyklen" UWORD FORMULA_0010 0 0.0 0.0 65535.0 READ_WRITE ECU_ADDRESS 0x3F9FB6 /end MEASUREMENT
/begin MEASUREMENT ed_rbm_lam2_reg.numerator_nv "Diagnosezyklen" UWORD FORMULA_0010 0 0.0 0.0 65535.0 READ_WRITE ECU_ADDRESS 0x3F9FB4 /end MEASUREMENT
/begin MEASUREMENT ed_rbm_lank1.denominator_nv "Fahrzyklen" UWORD FORMULA_0010 0 0.0 0.0 65535.0 READ_WRITE ECU_ADDRESS 0x3F9EE6 /end MEASUREMENT
/begin MEASUREMENT ed_rbm_lank1.numerator_nv "Diagnosezyklen" UWORD FORMULA_0010 0 0.0 0.0 65535.0 READ_WRITE ECU_ADDRESS 0x3F9EE4 /end MEASUREMENT
/begin MEASUREMENT ed_rbm_lank1_obd_s.denominator_nv "Fahrzyklen" UWORD FORMULA_0010 0 0.0 0.0 65535.0 READ_WRITE ECU_ADDRESS 0x3F9F26 /end MEASUREMENT
/begin MEASUREMENT ed_rbm_lank1_obd_s.numerator_nv "Diagnosezyklen" UWORD FORMULA_0010 0 0.0 0.0 65535.0 READ_WRITE ECU_ADDRESS 0x3F9F24 /end MEASUREMENT
/begin MEASUREMENT ed_rbm_lank1_obd_we.denominator_nv "Fahrzyklen" UWORD FORMULA_0010 0 0.0 0.0 65535.0 READ_WRITE ECU_ADDRESS 0x3FA166 /end MEASUREMENT
/begin MEASUREMENT ed_rbm_lank1_obd_we.numerator_nv "Diagnosezyklen" UWORD FORMULA_0010 0 0.0 0.0 65535.0 READ_WRITE ECU_ADDRESS 0x3FA164 /end MEASUREMENT
/begin MEASUREMENT ed_rbm_lank1_openload.denominator_nv "Fahrzyklen" UWORD FORMULA_0010 0 0.0 0.0 65535.0 READ_WRITE ECU_ADDRESS 0x3FA15E /end MEASUREMENT
/begin MEASUREMENT ed_rbm_lank1_openload.numerator_nv "Diagnosezyklen" UWORD FORMULA_0010 0 0.0 0.0 65535.0 READ_WRITE ECU_ADDRESS 0x3FA15C /end MEASUREMENT
/begin MEASUREMENT ed_rbm_lank2.denominator_nv "Fahrzyklen" UWORD FORMULA_0010 0 0.0 0.0 65535.0 READ_WRITE ECU_ADDRESS 0x3F9EEA /end MEASUREMENT
/begin MEASUREMENT ed_rbm_lank2.numerator_nv "Diagnosezyklen" UWORD FORMULA_0010 0 0.0 0.0 65535.0 READ_WRITE ECU_ADDRESS 0x3F9EE8 /end MEASUREMENT
/begin MEASUREMENT ed_rbm_lank2_obd_s.denominator_nv "Fahrzyklen" UWORD FORMULA_0010 0 0.0 0.0 65535.0 READ_WRITE ECU_ADDRESS 0x3F9F2A /end MEASUREMENT
/begin MEASUREMENT ed_rbm_lank2_obd_s.numerator_nv "Diagnosezyklen" UWORD FORMULA_0010 0 0.0 0.0 65535.0 READ_WRITE ECU_ADDRESS 0x3F9F28 /end MEASUREMENT
/begin MEASUREMENT ed_rbm_lank2_obd_we.denominator_nv "Fahrzyklen" UWORD FORMULA_0010 0 0.0 0.0 65535.0 READ_WRITE ECU_ADDRESS 0x3FA16A /end MEASUREMENT
/begin MEASUREMENT ed_rbm_lank2_obd_we.numerator_nv "Diagnosezyklen" UWORD FORMULA_0010 0 0.0 0.0 65535.0 READ_WRITE ECU_ADDRESS 0x3FA168 /end MEASUREMENT
/begin MEASUREMENT ed_rbm_lank2_openload.denominator_nv "Fahrzyklen" UWORD FORMULA_0010 0 0.0 0.0 65535.0 READ_WRITE ECU_ADDRESS 0x3FA162 /end MEASUREMENT
/begin MEASUREMENT ed_rbm_lank2_openload.numerator_nv "Diagnosezyklen" UWORD FORMULA_0010 0 0.0 0.0 65535.0 READ_WRITE ECU_ADDRESS 0x3FA160 /end MEASUREMENT
/begin MEASUREMENT ed_rbm_lavk_atic42.denominator_nv "Fahrzyklen" UWORD FORMULA_0010 0 0.0 0.0 65535.0 READ_WRITE ECU_ADDRESS 0x3FA186 /end MEASUREMENT
/begin MEASUREMENT ed_rbm_lavk_atic42.numerator_nv "Diagnosezyklen" UWORD FORMULA_0010 0 0.0 0.0 65535.0 READ_WRITE ECU_ADDRESS 0x3FA184 /end MEASUREMENT
/begin MEASUREMENT ed_rbm_lavk1.denominator_nv "Fahrzyklen" UWORD FORMULA_0010 0 0.0 0.0 65535.0 READ_WRITE ECU_ADDRESS 0x3F9ECE /end MEASUREMENT
/begin MEASUREMENT ed_rbm_lavk1.numerator_nv "Diagnosezyklen" UWORD FORMULA_0010 0 0.0 0.0 65535.0 READ_WRITE ECU_ADDRESS 0x3F9ECC /end MEASUREMENT
/begin MEASUREMENT ed_rbm_lavk1_diag.denominator_nv "Fahrzyklen" UWORD FORMULA_0010 0 0.0 0.0 65535.0 READ_WRITE ECU_ADDRESS 0x3F9F5E /end MEASUREMENT
/begin MEASUREMENT ed_rbm_lavk1_diag.numerator_nv "Diagnosezyklen" UWORD FORMULA_0010 0 0.0 0.0 65535.0 READ_WRITE ECU_ADDRESS 0x3F9F5C /end MEASUREMENT
/begin MEASUREMENT ed_rbm_lavk1_ia_openload.denominator_nv "Fahrzyklen" UWORD FORMULA_0010 0 0.0 0.0 65535.0 READ_WRITE ECU_ADDRESS 0x3F9F66 /end MEASUREMENT
/begin MEASUREMENT ed_rbm_lavk1_ia_openload.numerator_nv "Diagnosezyklen" UWORD FORMULA_0010 0 0.0 0.0 65535.0 READ_WRITE ECU_ADDRESS 0x3F9F64 /end MEASUREMENT
/begin MEASUREMENT ed_rbm_lavk1_ip_openload.denominator_nv "Fahrzyklen" UWORD FORMULA_0010 0 0.0 0.0 65535.0 READ_WRITE ECU_ADDRESS 0x3F9F7E /end MEASUREMENT
/begin MEASUREMENT ed_rbm_lavk1_ip_openload.numerator_nv "Diagnosezyklen" UWORD FORMULA_0010 0 0.0 0.0 65535.0 READ_WRITE ECU_ADDRESS 0x3F9F7C /end MEASUREMENT
/begin MEASUREMENT ed_rbm_lavk1_obd_dyn.denominator_nv "Fahrzyklen" UWORD FORMULA_0010 0 0.0 0.0 65535.0 READ_WRITE ECU_ADDRESS 0x3FA002 /end MEASUREMENT
/begin MEASUREMENT ed_rbm_lavk1_obd_dyn.numerator_nv "Diagnosezyklen" UWORD FORMULA_0010 0 0.0 0.0 65535.0 READ_WRITE ECU_ADDRESS 0x3FA000 /end MEASUREMENT
/begin MEASUREMENT ed_rbm_lavk1_obd_plau.denominator_nv "Fahrzyklen" UWORD FORMULA_0010 0 0.0 0.0 65535.0 READ_WRITE ECU_ADDRESS 0x3F9ED6 /end MEASUREMENT
/begin MEASUREMENT ed_rbm_lavk1_obd_plau.numerator_nv "Diagnosezyklen" UWORD FORMULA_0010 0 0.0 0.0 65535.0 READ_WRITE ECU_ADDRESS 0x3F9ED4 /end MEASUREMENT
/begin MEASUREMENT ed_rbm_lavk1_obd_sa.denominator_nv "Fahrzyklen" UWORD FORMULA_0010 0 0.0 0.0 65535.0 READ_WRITE ECU_ADDRESS 0x3F9EDE /end MEASUREMENT
/begin MEASUREMENT ed_rbm_lavk1_obd_sa.numerator_nv "Diagnosezyklen" UWORD FORMULA_0010 0 0.0 0.0 65535.0 READ_WRITE ECU_ADDRESS 0x3F9EDC /end MEASUREMENT
/begin MEASUREMENT ed_rbm_lavk1_obd_tl.denominator_nv "Fahrzyklen" UWORD FORMULA_0010 0 0.0 0.0 65535.0 READ_WRITE ECU_ADDRESS 0x3F9F2E /end MEASUREMENT
/begin MEASUREMENT ed_rbm_lavk1_obd_tl.numerator_nv "Diagnosezyklen" UWORD FORMULA_0010 0 0.0 0.0 65535.0 READ_WRITE ECU_ADDRESS 0x3F9F2C /end MEASUREMENT
/begin MEASUREMENT ed_rbm_lavk1_trim.denominator_nv "Fahrzyklen" UWORD FORMULA_0010 0 0.0 0.0 65535.0 READ_WRITE ECU_ADDRESS 0x3FA02E /end MEASUREMENT
/begin MEASUREMENT ed_rbm_lavk1_trim.numerator_nv "Diagnosezyklen" UWORD FORMULA_0010 0 0.0 0.0 65535.0 READ_WRITE ECU_ADDRESS 0x3FA02C /end MEASUREMENT
/begin MEASUREMENT ed_rbm_lavk1_un_openload.denominator_nv "Fahrzyklen" UWORD FORMULA_0010 0 0.0 0.0 65535.0 READ_WRITE ECU_ADDRESS 0x3F9F76 /end MEASUREMENT
/begin MEASUREMENT ed_rbm_lavk1_un_openload.numerator_nv "Diagnosezyklen" UWORD FORMULA_0010 0 0.0 0.0 65535.0 READ_WRITE ECU_ADDRESS 0x3F9F74 /end MEASUREMENT
/begin MEASUREMENT ed_rbm_lavk2.denominator_nv "Fahrzyklen" UWORD FORMULA_0010 0 0.0 0.0 65535.0 READ_WRITE ECU_ADDRESS 0x3F9ED2 /end MEASUREMENT
/begin MEASUREMENT ed_rbm_lavk2.numerator_nv "Diagnosezyklen" UWORD FORMULA_0010 0 0.0 0.0 65535.0 READ_WRITE ECU_ADDRESS 0x3F9ED0 /end MEASUREMENT
/begin MEASUREMENT ed_rbm_lavk2_diag.denominator_nv "Fahrzyklen" UWORD FORMULA_0010 0 0.0 0.0 65535.0 READ_WRITE ECU_ADDRESS 0x3F9F62 /end MEASUREMENT
/begin MEASUREMENT ed_rbm_lavk2_diag.numerator_nv "Diagnosezyklen" UWORD FORMULA_0010 0 0.0 0.0 65535.0 READ_WRITE ECU_ADDRESS 0x3F9F60 /end MEASUREMENT
/begin MEASUREMENT ed_rbm_lavk2_ia_openload.denominator_nv "Fahrzyklen" UWORD FORMULA_0010 0 0.0 0.0 65535.0 READ_WRITE ECU_ADDRESS 0x3F9F6A /end MEASUREMENT
/begin MEASUREMENT ed_rbm_lavk2_ia_openload.numerator_nv "Diagnosezyklen" UWORD FORMULA_0010 0 0.0 0.0 65535.0 READ_WRITE ECU_ADDRESS 0x3F9F68 /end MEASUREMENT
/begin MEASUREMENT ed_rbm_lavk2_ip_openload.denominator_nv "Fahrzyklen" UWORD FORMULA_0010 0 0.0 0.0 65535.0 READ_WRITE ECU_ADDRESS 0x3F9F82 /end MEASUREMENT
/begin MEASUREMENT ed_rbm_lavk2_ip_openload.numerator_nv "Diagnosezyklen" UWORD FORMULA_0010 0 0.0 0.0 65535.0 READ_WRITE ECU_ADDRESS 0x3F9F80 /end MEASUREMENT
/begin MEASUREMENT ed_rbm_lavk2_obd_dyn.denominator_nv "Fahrzyklen" UWORD FORMULA_0010 0 0.0 0.0 65535.0 READ_WRITE ECU_ADDRESS 0x3FA006 /end MEASUREMENT
/begin MEASUREMENT ed_rbm_lavk2_obd_dyn.numerator_nv "Diagnosezyklen" UWORD FORMULA_0010 0 0.0 0.0 65535.0 READ_WRITE ECU_ADDRESS 0x3FA004 /end MEASUREMENT
/begin MEASUREMENT ed_rbm_lavk2_obd_plau.denominator_nv "Fahrzyklen" UWORD FORMULA_0010 0 0.0 0.0 65535.0 READ_WRITE ECU_ADDRESS 0x3F9EDA /end MEASUREMENT
/begin MEASUREMENT ed_rbm_lavk2_obd_plau.numerator_nv "Diagnosezyklen" UWORD FORMULA_0010 0 0.0 0.0 65535.0 READ_WRITE ECU_ADDRESS 0x3F9ED8 /end MEASUREMENT
/begin MEASUREMENT ed_rbm_lavk2_obd_sa.denominator_nv "Fahrzyklen" UWORD FORMULA_0010 0 0.0 0.0 65535.0 READ_WRITE ECU_ADDRESS 0x3F9EE2 /end MEASUREMENT
/begin MEASUREMENT ed_rbm_lavk2_obd_sa.numerator_nv "Diagnosezyklen" UWORD FORMULA_0010 0 0.0 0.0 65535.0 READ_WRITE ECU_ADDRESS 0x3F9EE0 /end MEASUREMENT
/begin MEASUREMENT ed_rbm_lavk2_obd_tl.denominator_nv "Fahrzyklen" UWORD FORMULA_0010 0 0.0 0.0 65535.0 READ_WRITE ECU_ADDRESS 0x3F9F32 /end MEASUREMENT
/begin MEASUREMENT ed_rbm_lavk2_obd_tl.numerator_nv "Diagnosezyklen" UWORD FORMULA_0010 0 0.0 0.0 65535.0 READ_WRITE ECU_ADDRESS 0x3F9F30 /end MEASUREMENT
/begin MEASUREMENT ed_rbm_lavk2_trim.denominator_nv "Fahrzyklen" UWORD FORMULA_0010 0 0.0 0.0 65535.0 READ_WRITE ECU_ADDRESS 0x3FA032 /end MEASUREMENT
/begin MEASUREMENT ed_rbm_lavk2_trim.numerator_nv "Diagnosezyklen" UWORD FORMULA_0010 0 0.0 0.0 65535.0 READ_WRITE ECU_ADDRESS 0x3FA030 /end MEASUREMENT
/begin MEASUREMENT ed_rbm_lavk2_un_openload.denominator_nv "Fahrzyklen" UWORD FORMULA_0010 0 0.0 0.0 65535.0 READ_WRITE ECU_ADDRESS 0x3F9F7A /end MEASUREMENT
/begin MEASUREMENT ed_rbm_lavk2_un_openload.numerator_nv "Diagnosezyklen" UWORD FORMULA_0010 0 0.0 0.0 65535.0 READ_WRITE ECU_ADDRESS 0x3F9F78 /end MEASUREMENT
/begin MEASUREMENT ed_rbm_lshnk1.denominator_nv "Fahrzyklen" UWORD FORMULA_0010 0 0.0 0.0 65535.0 READ_WRITE ECU_ADDRESS 0x3F9EEE /end MEASUREMENT
/begin MEASUREMENT ed_rbm_lshnk1.numerator_nv "Diagnosezyklen" UWORD FORMULA_0010 0 0.0 0.0 65535.0 READ_WRITE ECU_ADDRESS 0x3F9EEC /end MEASUREMENT
/begin MEASUREMENT ed_rbm_lshnk1_r.denominator_nv "Fahrzyklen" UWORD FORMULA_0010 0 0.0 0.0 65535.0 READ_WRITE ECU_ADDRESS 0x3FA16E /end MEASUREMENT
/begin MEASUREMENT ed_rbm_lshnk1_r.numerator_nv "Diagnosezyklen" UWORD FORMULA_0010 0 0.0 0.0 65535.0 READ_WRITE ECU_ADDRESS 0x3FA16C /end MEASUREMENT
/begin MEASUREMENT ed_rbm_lshnk2.denominator_nv "Fahrzyklen" UWORD FORMULA_0010 0 0.0 0.0 65535.0 READ_WRITE ECU_ADDRESS 0x3F9EF2 /end MEASUREMENT
/begin MEASUREMENT ed_rbm_lshnk2.numerator_nv "Diagnosezyklen" UWORD FORMULA_0010 0 0.0 0.0 65535.0 READ_WRITE ECU_ADDRESS 0x3F9EF0 /end MEASUREMENT
/begin MEASUREMENT ed_rbm_lshnk2_r.denominator_nv "Fahrzyklen" UWORD FORMULA_0010 0 0.0 0.0 65535.0 READ_WRITE ECU_ADDRESS 0x3FA172 /end MEASUREMENT
/begin MEASUREMENT ed_rbm_lshnk2_r.numerator_nv "Diagnosezyklen" UWORD FORMULA_0010 0 0.0 0.0 65535.0 READ_WRITE ECU_ADDRESS 0x3FA170 /end MEASUREMENT
/begin MEASUREMENT ed_rbm_lshvk1.denominator_nv "Fahrzyklen" UWORD FORMULA_0010 0 0.0 0.0 65535.0 READ_WRITE ECU_ADDRESS 0x3F9F36 /end MEASUREMENT
/begin MEASUREMENT ed_rbm_lshvk1.numerator_nv "Diagnosezyklen" UWORD FORMULA_0010 0 0.0 0.0 65535.0 READ_WRITE ECU_ADDRESS 0x3F9F34 /end MEASUREMENT
/begin MEASUREMENT ed_rbm_lshvk1_r.denominator_nv "Fahrzyklen" UWORD FORMULA_0010 0 0.0 0.0 65535.0 READ_WRITE ECU_ADDRESS 0x3F9F46 /end MEASUREMENT
/begin MEASUREMENT ed_rbm_lshvk1_r.numerator_nv "Diagnosezyklen" UWORD FORMULA_0010 0 0.0 0.0 65535.0 READ_WRITE ECU_ADDRESS 0x3F9F44 /end MEASUREMENT
/begin MEASUREMENT ed_rbm_lshvk2.denominator_nv "Fahrzyklen" UWORD FORMULA_0010 0 0.0 0.0 65535.0 READ_WRITE ECU_ADDRESS 0x3F9F3A /end MEASUREMENT
/begin MEASUREMENT ed_rbm_lshvk2.numerator_nv "Diagnosezyklen" UWORD FORMULA_0010 0 0.0 0.0 65535.0 READ_WRITE ECU_ADDRESS 0x3F9F38 /end MEASUREMENT
/begin MEASUREMENT ed_rbm_lshvk2_r.denominator_nv "Fahrzyklen" UWORD FORMULA_0010 0 0.0 0.0 65535.0 READ_WRITE ECU_ADDRESS 0x3F9F4A /end MEASUREMENT
/begin MEASUREMENT ed_rbm_lshvk2_r.numerator_nv "Diagnosezyklen" UWORD FORMULA_0010 0 0.0 0.0 65535.0 READ_WRITE ECU_ADDRESS 0x3F9F48 /end MEASUREMENT
/begin MEASUREMENT ed_rbm_lsrvk1_obd_ref.denominator_nv "Fahrzyklen" UWORD FORMULA_0010 0 0.0 0.0 65535.0 READ_WRITE ECU_ADDRESS 0x3F9F56 /end MEASUREMENT
/begin MEASUREMENT ed_rbm_lsrvk1_obd_ref.numerator_nv "Diagnosezyklen" UWORD FORMULA_0010 0 0.0 0.0 65535.0 READ_WRITE ECU_ADDRESS 0x3F9F54 /end MEASUREMENT
/begin MEASUREMENT ed_rbm_lsrvk1_obd_reg.denominator_nv "Fahrzyklen" UWORD FORMULA_0010 0 0.0 0.0 65535.0 READ_WRITE ECU_ADDRESS 0x3F9F3E /end MEASUREMENT
/begin MEASUREMENT ed_rbm_lsrvk1_obd_reg.numerator_nv "Diagnosezyklen" UWORD FORMULA_0010 0 0.0 0.0 65535.0 READ_WRITE ECU_ADDRESS 0x3F9F3C /end MEASUREMENT
/begin MEASUREMENT ed_rbm_lsrvk1_obd_start.denominator_nv "Fahrzyklen" UWORD FORMULA_0010 0 0.0 0.0 65535.0 READ_WRITE ECU_ADDRESS 0x3F9F4E /end MEASUREMENT
/begin MEASUREMENT ed_rbm_lsrvk1_obd_start.numerator_nv "Diagnosezyklen" UWORD FORMULA_0010 0 0.0 0.0 65535.0 READ_WRITE ECU_ADDRESS 0x3F9F4C /end MEASUREMENT
/begin MEASUREMENT ed_rbm_lsrvk2_obd_ref.denominator_nv "Fahrzyklen" UWORD FORMULA_0010 0 0.0 0.0 65535.0 READ_WRITE ECU_ADDRESS 0x3F9F5A /end MEASUREMENT
/begin MEASUREMENT ed_rbm_lsrvk2_obd_ref.numerator_nv "Diagnosezyklen" UWORD FORMULA_0010 0 0.0 0.0 65535.0 READ_WRITE ECU_ADDRESS 0x3F9F58 /end MEASUREMENT
/begin MEASUREMENT ed_rbm_lsrvk2_obd_reg.denominator_nv "Fahrzyklen" UWORD FORMULA_0010 0 0.0 0.0 65535.0 READ_WRITE ECU_ADDRESS 0x3F9F42 /end MEASUREMENT
/begin MEASUREMENT ed_rbm_lsrvk2_obd_reg.numerator_nv "Diagnosezyklen" UWORD FORMULA_0010 0 0.0 0.0 65535.0 READ_WRITE ECU_ADDRESS 0x3F9F40 /end MEASUREMENT
/begin MEASUREMENT ed_rbm_lsrvk2_obd_start.denominator_nv "Fahrzyklen" UWORD FORMULA_0010 0 0.0 0.0 65535.0 READ_WRITE ECU_ADDRESS 0x3F9F52 /end MEASUREMENT
/begin MEASUREMENT ed_rbm_lsrvk2_obd_start.numerator_nv "Diagnosezyklen" UWORD FORMULA_0010 0 0.0 0.0 65535.0 READ_WRITE ECU_ADDRESS 0x3F9F50 /end MEASUREMENT
/begin MEASUREMENT ed_rbm_mvac_drucksensor.denominator_nv "Fahrzyklen" UWORD FORMULA_0010 0 0.0 0.0 65535.0 READ_WRITE ECU_ADDRESS 0x3FA08E /end MEASUREMENT
/begin MEASUREMENT ed_rbm_mvac_drucksensor.numerator_nv "Diagnosezyklen" UWORD FORMULA_0010 0 0.0 0.0 65535.0 READ_WRITE ECU_ADDRESS 0x3FA08C /end MEASUREMENT
/begin MEASUREMENT ed_rbm_nw_sync.denominator_nv "Fahrzyklen" UWORD FORMULA_0010 0 0.0 0.0 65535.0 READ_WRITE ECU_ADDRESS 0x3F9EB6 /end MEASUREMENT
/begin MEASUREMENT ed_rbm_nw_sync.numerator_nv "Diagnosezyklen" UWORD FORMULA_0010 0 0.0 0.0 65535.0 READ_WRITE ECU_ADDRESS 0x3F9EB4 /end MEASUREMENT
/begin MEASUREMENT ed_rbm_pctrl_inj.denominator_nv "Fahrzyklen" UWORD FORMULA_0010 0 0.0 0.0 65535.0 READ_WRITE ECU_ADDRESS 0x3F9EBE /end MEASUREMENT
/begin MEASUREMENT ed_rbm_pctrl_inj.numerator_nv "Diagnosezyklen" UWORD FORMULA_0010 0 0.0 0.0 65535.0 READ_WRITE ECU_ADDRESS 0x3F9EBC /end MEASUREMENT
/begin MEASUREMENT ed_rbm_pks.denominator_nv "Fahrzyklen" UWORD FORMULA_0010 0 0.0 0.0 65535.0 READ_WRITE ECU_ADDRESS 0x3F9EC6 /end MEASUREMENT
/begin MEASUREMENT ed_rbm_pks.numerator_nv "Diagnosezyklen" UWORD FORMULA_0010 0 0.0 0.0 65535.0 READ_WRITE ECU_ADDRESS 0x3F9EC4 /end MEASUREMENT
/begin MEASUREMENT ed_rbm_pks_adapt_anschl.denominator_nv "Fahrzyklen" UWORD FORMULA_0010 0 0.0 0.0 65535.0 READ_WRITE ECU_ADDRESS 0x3FA17E /end MEASUREMENT
/begin MEASUREMENT ed_rbm_pks_adapt_anschl.numerator_nv "Diagnosezyklen" UWORD FORMULA_0010 0 0.0 0.0 65535.0 READ_WRITE ECU_ADDRESS 0x3FA17C /end MEASUREMENT
/begin MEASUREMENT ed_rbm_pks_ll.denominator_nv "Fahrzyklen" UWORD FORMULA_0010 0 0.0 0.0 65535.0 READ_WRITE ECU_ADDRESS 0x3FA056 /end MEASUREMENT
/begin MEASUREMENT ed_rbm_pks_ll.numerator_nv "Diagnosezyklen" UWORD FORMULA_0010 0 0.0 0.0 65535.0 READ_WRITE ECU_ADDRESS 0x3FA054 /end MEASUREMENT
/begin MEASUREMENT ed_rbm_pks_modell.denominator_nv "Fahrzyklen" UWORD FORMULA_0010 0 0.0 0.0 65535.0 READ_WRITE ECU_ADDRESS 0x3FA176 /end MEASUREMENT
/begin MEASUREMENT ed_rbm_pks_modell.numerator_nv "Diagnosezyklen" UWORD FORMULA_0010 0 0.0 0.0 65535.0 READ_WRITE ECU_ADDRESS 0x3FA174 /end MEASUREMENT
/begin MEASUREMENT ed_rbm_pks_paufbau.denominator_nv "Fahrzyklen" UWORD FORMULA_0010 0 0.0 0.0 65535.0 READ_WRITE ECU_ADDRESS 0x3FA17A /end MEASUREMENT
/begin MEASUREMENT ed_rbm_pks_paufbau.numerator_nv "Diagnosezyklen" UWORD FORMULA_0010 0 0.0 0.0 65535.0 READ_WRITE ECU_ADDRESS 0x3FA178 /end MEASUREMENT
/begin MEASUREMENT ed_rbm_pks_q.denominator_nv "Fahrzyklen" UWORD FORMULA_0010 0 0.0 0.0 65535.0 READ_WRITE ECU_ADDRESS 0x3FA05E /end MEASUREMENT
/begin MEASUREMENT ed_rbm_pks_q.numerator_nv "Diagnosezyklen" UWORD FORMULA_0010 0 0.0 0.0 65535.0 READ_WRITE ECU_ADDRESS 0x3FA05C /end MEASUREMENT
/begin MEASUREMENT ed_rbm_pks_tl.denominator_nv "Fahrzyklen" UWORD FORMULA_0010 0 0.0 0.0 65535.0 READ_WRITE ECU_ADDRESS 0x3FA05A /end MEASUREMENT
/begin MEASUREMENT ed_rbm_pks_tl.numerator_nv "Diagnosezyklen" UWORD FORMULA_0010 0 0.0 0.0 65535.0 READ_WRITE ECU_ADDRESS 0x3FA058 /end MEASUREMENT
/begin MEASUREMENT ed_rbm_psau1.denominator_nv "Fahrzyklen" UWORD FORMULA_0010 0 0.0 0.0 65535.0 READ_WRITE ECU_ADDRESS 0x3F9E8E /end MEASUREMENT
/begin MEASUREMENT ed_rbm_psau1.numerator_nv "Diagnosezyklen" UWORD FORMULA_0010 0 0.0 0.0 65535.0 READ_WRITE ECU_ADDRESS 0x3F9E8C /end MEASUREMENT
/begin MEASUREMENT ed_rbm_psau2.denominator_nv "Fahrzyklen" UWORD FORMULA_0010 0 0.0 0.0 65535.0 READ_WRITE ECU_ADDRESS 0x3F9E92 /end MEASUREMENT
/begin MEASUREMENT ed_rbm_psau2.numerator_nv "Diagnosezyklen" UWORD FORMULA_0010 0 0.0 0.0 65535.0 READ_WRITE ECU_ADDRESS 0x3F9E90 /end MEASUREMENT
/begin MEASUREMENT ed_rbm_pt_anfradmom.denominator_nv "Fahrzyklen" UWORD FORMULA_0010 0 0.0 0.0 65535.0 READ_WRITE ECU_ADDRESS 0x3FA13A /end MEASUREMENT
/begin MEASUREMENT ed_rbm_pt_anfradmom.numerator_nv "Diagnosezyklen" UWORD FORMULA_0010 0 0.0 0.0 65535.0 READ_WRITE ECU_ADDRESS 0x3FA138 /end MEASUREMENT
/begin MEASUREMENT ed_rbm_pt_atemp.denominator_nv "Fahrzyklen" UWORD FORMULA_0010 0 0.0 0.0 65535.0 READ_WRITE ECU_ADDRESS 0x3F9F0A /end MEASUREMENT
/begin MEASUREMENT ed_rbm_pt_atemp.numerator_nv "Diagnosezyklen" UWORD FORMULA_0010 0 0.0 0.0 65535.0 READ_WRITE ECU_ADDRESS 0x3F9F08 /end MEASUREMENT
/begin MEASUREMENT ed_rbm_pt_ax.denominator_nv "Fahrzyklen" UWORD FORMULA_0010 0 0.0 0.0 65535.0 READ_WRITE ECU_ADDRESS 0x3FA18A /end MEASUREMENT
/begin MEASUREMENT ed_rbm_pt_ax.numerator_nv "Diagnosezyklen" UWORD FORMULA_0010 0 0.0 0.0 65535.0 READ_WRITE ECU_ADDRESS 0x3FA188 /end MEASUREMENT
/begin MEASUREMENT ed_rbm_pt_bedat.denominator_nv "Fahrzyklen" UWORD FORMULA_0010 0 0.0 0.0 65535.0 READ_WRITE ECU_ADDRESS 0x3FA092 /end MEASUREMENT
/begin MEASUREMENT ed_rbm_pt_bedat.numerator_nv "Diagnosezyklen" UWORD FORMULA_0010 0 0.0 0.0 65535.0 READ_WRITE ECU_ADDRESS 0x3FA090 /end MEASUREMENT
/begin MEASUREMENT ed_rbm_pt_bedfgr.denominator_nv "Fahrzyklen" UWORD FORMULA_0010 0 0.0 0.0 65535.0 READ_WRITE ECU_ADDRESS 0x3FA012 /end MEASUREMENT
/begin MEASUREMENT ed_rbm_pt_bedfgr.numerator_nv "Diagnosezyklen" UWORD FORMULA_0010 0 0.0 0.0 65535.0 READ_WRITE ECU_ADDRESS 0x3FA010 /end MEASUREMENT
/begin MEASUREMENT ed_rbm_pt_busoff.denominator_nv "Fahrzyklen" UWORD FORMULA_0010 0 0.0 0.0 65535.0 READ_WRITE ECU_ADDRESS 0x3F9EF6 /end MEASUREMENT
/begin MEASUREMENT ed_rbm_pt_busoff.numerator_nv "Diagnosezyklen" UWORD FORMULA_0010 0 0.0 0.0 65535.0 READ_WRITE ECU_ADDRESS 0x3F9EF4 /end MEASUREMENT
/begin MEASUREMENT ed_rbm_pt_crash.denominator_nv "Fahrzyklen" UWORD FORMULA_0010 0 0.0 0.0 65535.0 READ_WRITE ECU_ADDRESS 0x3FA00A /end MEASUREMENT
/begin MEASUREMENT ed_rbm_pt_crash.numerator_nv "Diagnosezyklen" UWORD FORMULA_0010 0 0.0 0.0 65535.0 READ_WRITE ECU_ADDRESS 0x3FA008 /end MEASUREMENT
/begin MEASUREMENT ed_rbm_pt_grb.denominator_nv "Fahrzyklen" UWORD FORMULA_0010 0 0.0 0.0 65535.0 READ_WRITE ECU_ADDRESS 0x3F9F6E /end MEASUREMENT
/begin MEASUREMENT ed_rbm_pt_grb.numerator_nv "Diagnosezyklen" UWORD FORMULA_0010 0 0.0 0.0 65535.0 READ_WRITE ECU_ADDRESS 0x3F9F6C /end MEASUREMENT
/begin MEASUREMENT ed_rbm_pt_grb2.denominator_nv "Fahrzyklen" UWORD FORMULA_0010 0 0.0 0.0 65535.0 READ_WRITE ECU_ADDRESS 0x3F9F72 /end MEASUREMENT
/begin MEASUREMENT ed_rbm_pt_grb2.numerator_nv "Diagnosezyklen" UWORD FORMULA_0010 0 0.0 0.0 65535.0 READ_WRITE ECU_ADDRESS 0x3F9F70 /end MEASUREMENT
/begin MEASUREMENT ed_rbm_pt_grb3.denominator_nv "Fahrzyklen" UWORD FORMULA_0010 0 0.0 0.0 65535.0 READ_WRITE ECU_ADDRESS 0x3FA136 /end MEASUREMENT
/begin MEASUREMENT ed_rbm_pt_grb3.numerator_nv "Diagnosezyklen" UWORD FORMULA_0010 0 0.0 0.0 65535.0 READ_WRITE ECU_ADDRESS 0x3FA134 /end MEASUREMENT
/begin MEASUREMENT ed_rbm_pt_kkos.denominator_nv "Fahrzyklen" UWORD FORMULA_0010 0 0.0 0.0 65535.0 READ_WRITE ECU_ADDRESS 0x3F9F12 /end MEASUREMENT
/begin MEASUREMENT ed_rbm_pt_kkos.numerator_nv "Diagnosezyklen" UWORD FORMULA_0010 0 0.0 0.0 65535.0 READ_WRITE ECU_ADDRESS 0x3F9F10 /end MEASUREMENT
/begin MEASUREMENT ed_rbm_pt_klst.denominator_nv "Fahrzyklen" UWORD FORMULA_0010 0 0.0 0.0 65535.0 READ_WRITE ECU_ADDRESS 0x3F9F0E /end MEASUREMENT
/begin MEASUREMENT ed_rbm_pt_klst.numerator_nv "Diagnosezyklen" UWORD FORMULA_0010 0 0.0 0.0 65535.0 READ_WRITE ECU_ADDRESS 0x3F9F0C /end MEASUREMENT
/begin MEASUREMENT ed_rbm_pt_km.denominator_nv "Fahrzyklen" UWORD FORMULA_0010 0 0.0 0.0 65535.0 READ_WRITE ECU_ADDRESS 0x3FA04E /end MEASUREMENT
/begin MEASUREMENT ed_rbm_pt_km.numerator_nv "Diagnosezyklen" UWORD FORMULA_0010 0 0.0 0.0 65535.0 READ_WRITE ECU_ADDRESS 0x3FA04C /end MEASUREMENT
/begin MEASUREMENT ed_rbm_pt_kombi.denominator_nv "Fahrzyklen" UWORD FORMULA_0010 0 0.0 0.0 65535.0 READ_WRITE ECU_ADDRESS 0x3FA052 /end MEASUREMENT
/begin MEASUREMENT ed_rbm_pt_kombi.numerator_nv "Diagnosezyklen" UWORD FORMULA_0010 0 0.0 0.0 65535.0 READ_WRITE ECU_ADDRESS 0x3FA050 /end MEASUREMENT
/begin MEASUREMENT ed_rbm_pt_lrw.denominator_nv "Fahrzyklen" UWORD FORMULA_0010 0 0.0 0.0 65535.0 READ_WRITE ECU_ADDRESS 0x3F9F16 /end MEASUREMENT
/begin MEASUREMENT ed_rbm_pt_lrw.numerator_nv "Diagnosezyklen" UWORD FORMULA_0010 0 0.0 0.0 65535.0 READ_WRITE ECU_ADDRESS 0x3F9F14 /end MEASUREMENT
/begin MEASUREMENT ed_rbm_pt_statanh.denominator_nv "Fahrzyklen" UWORD FORMULA_0010 0 0.0 0.0 65535.0 READ_WRITE ECU_ADDRESS 0x3FA122 /end MEASUREMENT
/begin MEASUREMENT ed_rbm_pt_statanh.numerator_nv "Diagnosezyklen" UWORD FORMULA_0010 0 0.0 0.0 65535.0 READ_WRITE ECU_ADDRESS 0x3FA120 /end MEASUREMENT
/begin MEASUREMENT ed_rbm_pt_statdkg.denominator_nv "Fahrzyklen" UWORD FORMULA_0010 0 0.0 0.0 65535.0 READ_WRITE ECU_ADDRESS 0x3F9EC2 /end MEASUREMENT
/begin MEASUREMENT ed_rbm_pt_statdkg.numerator_nv "Diagnosezyklen" UWORD FORMULA_0010 0 0.0 0.0 65535.0 READ_WRITE ECU_ADDRESS 0x3F9EC0 /end MEASUREMENT
/begin MEASUREMENT ed_rbm_pt_statr.denominator_nv "Fahrzyklen" UWORD FORMULA_0010 0 0.0 0.0 65535.0 READ_WRITE ECU_ADDRESS 0x3F9ECA /end MEASUREMENT
/begin MEASUREMENT ed_rbm_pt_statr.numerator_nv "Diagnosezyklen" UWORD FORMULA_0010 0 0.0 0.0 65535.0 READ_WRITE ECU_ADDRESS 0x3F9EC8 /end MEASUREMENT
/begin MEASUREMENT ed_rbm_pt_stdsc.denominator_nv "Fahrzyklen" UWORD FORMULA_0010 0 0.0 0.0 65535.0 READ_WRITE ECU_ADDRESS 0x3F9EFE /end MEASUREMENT
/begin MEASUREMENT ed_rbm_pt_stdsc.numerator_nv "Diagnosezyklen" UWORD FORMULA_0010 0 0.0 0.0 65535.0 READ_WRITE ECU_ADDRESS 0x3F9EFC /end MEASUREMENT
/begin MEASUREMENT ed_rbm_pt_toma.denominator_nv "Fahrzyklen" UWORD FORMULA_0010 0 0.0 0.0 65535.0 READ_WRITE ECU_ADDRESS 0x3FA146 /end MEASUREMENT
/begin MEASUREMENT ed_rbm_pt_toma.numerator_nv "Diagnosezyklen" UWORD FORMULA_0010 0 0.0 0.0 65535.0 READ_WRITE ECU_ADDRESS 0x3FA144 /end MEASUREMENT
/begin MEASUREMENT ed_rbm_pt_torqdsc.denominator_nv "Fahrzyklen" UWORD FORMULA_0010 0 0.0 0.0 65535.0 READ_WRITE ECU_ADDRESS 0x3F9EFA /end MEASUREMENT
/begin MEASUREMENT ed_rbm_pt_torqdsc.numerator_nv "Diagnosezyklen" UWORD FORMULA_0010 0 0.0 0.0 65535.0 READ_WRITE ECU_ADDRESS 0x3F9EF8 /end MEASUREMENT
/begin MEASUREMENT ed_rbm_pt_vehmod.denominator_nv "Fahrzyklen" UWORD FORMULA_0010 0 0.0 0.0 65535.0 READ_WRITE ECU_ADDRESS 0x3FA00E /end MEASUREMENT
/begin MEASUREMENT ed_rbm_pt_vehmod.numerator_nv "Diagnosezyklen" UWORD FORMULA_0010 0 0.0 0.0 65535.0 READ_WRITE ECU_ADDRESS 0x3FA00C /end MEASUREMENT
/begin MEASUREMENT ed_rbm_pt_vfzg.denominator_nv "Fahrzyklen" UWORD FORMULA_0010 0 0.0 0.0 65535.0 READ_WRITE ECU_ADDRESS 0x3F9F06 /end MEASUREMENT
/begin MEASUREMENT ed_rbm_pt_vfzg.numerator_nv "Diagnosezyklen" UWORD FORMULA_0010 0 0.0 0.0 65535.0 READ_WRITE ECU_ADDRESS 0x3F9F04 /end MEASUREMENT
/begin MEASUREMENT ed_rbm_pt_vrad.denominator_nv "Fahrzyklen" UWORD FORMULA_0010 0 0.0 0.0 65535.0 READ_WRITE ECU_ADDRESS 0x3F9F02 /end MEASUREMENT
/begin MEASUREMENT ed_rbm_pt_vrad.numerator_nv "Diagnosezyklen" UWORD FORMULA_0010 0 0.0 0.0 65535.0 READ_WRITE ECU_ADDRESS 0x3F9F00 /end MEASUREMENT
/begin MEASUREMENT ed_rbm_pumg.denominator_nv "Fahrzyklen" UWORD FORMULA_0010 0 0.0 0.0 65535.0 READ_WRITE ECU_ADDRESS 0x3F9E82 /end MEASUREMENT
/begin MEASUREMENT ed_rbm_pumg.numerator_nv "Diagnosezyklen" UWORD FORMULA_0010 0 0.0 0.0 65535.0 READ_WRITE ECU_ADDRESS 0x3F9E80 /end MEASUREMENT
/begin MEASUREMENT ed_rbm_pumg_obd.denominator_nv "Fahrzyklen" UWORD FORMULA_0010 0 0.0 0.0 65535.0 READ_WRITE ECU_ADDRESS 0x3FA14E /end MEASUREMENT
/begin MEASUREMENT ed_rbm_pumg_obd.numerator_nv "Diagnosezyklen" UWORD FORMULA_0010 0 0.0 0.0 65535.0 READ_WRITE ECU_ADDRESS 0x3FA14C /end MEASUREMENT
/begin MEASUREMENT ed_rbm_rlslp.denominator_nv "Fahrzyklen" UWORD FORMULA_0010 0 0.0 0.0 65535.0 READ_WRITE ECU_ADDRESS 0x3FA046 /end MEASUREMENT
/begin MEASUREMENT ed_rbm_rlslp.numerator_nv "Diagnosezyklen" UWORD FORMULA_0010 0 0.0 0.0 65535.0 READ_WRITE ECU_ADDRESS 0x3FA044 /end MEASUREMENT
/begin MEASUREMENT ed_rbm_rlu87.denominator_nv "Fahrzyklen" UWORD FORMULA_0010 0 0.0 0.0 65535.0 READ_WRITE ECU_ADDRESS 0x3FA036 /end MEASUREMENT
/begin MEASUREMENT ed_rbm_rlu87.numerator_nv "Diagnosezyklen" UWORD FORMULA_0010 0 0.0 0.0 65535.0 READ_WRITE ECU_ADDRESS 0x3FA034 /end MEASUREMENT
/begin MEASUREMENT ed_rbm_s_getr_hs.denominator_nv "Fahrzyklen" UWORD FORMULA_0010 0 0.0 0.0 65535.0 READ_WRITE ECU_ADDRESS 0x3FA10E /end MEASUREMENT
/begin MEASUREMENT ed_rbm_s_getr_hs.numerator_nv "Diagnosezyklen" UWORD FORMULA_0010 0 0.0 0.0 65535.0 READ_WRITE ECU_ADDRESS 0x3FA10C /end MEASUREMENT
/begin MEASUREMENT ed_rbm_s_kupp_hs.denominator_nv "Fahrzyklen" UWORD FORMULA_0010 0 0.0 0.0 65535.0 READ_WRITE ECU_ADDRESS 0x3FA112 /end MEASUREMENT
/begin MEASUREMENT ed_rbm_s_kupp_hs.numerator_nv "Diagnosezyklen" UWORD FORMULA_0010 0 0.0 0.0 65535.0 READ_WRITE ECU_ADDRESS 0x3FA110 /end MEASUREMENT
/begin MEASUREMENT ed_rbm_s_poel_diag.denominator_nv "Fahrzyklen" UWORD FORMULA_0010 0 0.0 0.0 65535.0 READ_WRITE ECU_ADDRESS 0x3FA0CA /end MEASUREMENT
/begin MEASUREMENT ed_rbm_s_poel_diag.numerator_nv "Diagnosezyklen" UWORD FORMULA_0010 0 0.0 0.0 65535.0 READ_WRITE ECU_ADDRESS 0x3FA0C8 /end MEASUREMENT
/begin MEASUREMENT ed_rbm_sg_inj.denominator_nv "Fahrzyklen" UWORD FORMULA_0010 0 0.0 0.0 65535.0 READ_WRITE ECU_ADDRESS 0x3FA0BE /end MEASUREMENT
/begin MEASUREMENT ed_rbm_sg_inj.numerator_nv "Diagnosezyklen" UWORD FORMULA_0010 0 0.0 0.0 65535.0 READ_WRITE ECU_ADDRESS 0x3FA0BC /end MEASUREMENT
/begin MEASUREMENT ed_rbm_sk_manager_inj.denominator_nv "Fahrzyklen" UWORD FORMULA_0010 0 0.0 0.0 65535.0 READ_WRITE ECU_ADDRESS 0x3FA096 /end MEASUREMENT
/begin MEASUREMENT ed_rbm_sk_manager_inj.numerator_nv "Diagnosezyklen" UWORD FORMULA_0010 0 0.0 0.0 65535.0 READ_WRITE ECU_ADDRESS 0x3FA094 /end MEASUREMENT
/begin MEASUREMENT ed_rbm_sk_tr_inj.denominator_nv "Fahrzyklen" UWORD FORMULA_0010 0 0.0 0.0 65535.0 READ_WRITE ECU_ADDRESS 0x3F9E7E /end MEASUREMENT
/begin MEASUREMENT ed_rbm_sk_tr_inj.numerator_nv "Diagnosezyklen" UWORD FORMULA_0010 0 0.0 0.0 65535.0 READ_WRITE ECU_ADDRESS 0x3F9E7C /end MEASUREMENT
/begin MEASUREMENT ed_rbm_sl_durchs_b1.denominator_nv "Fahrzyklen" UWORD FORMULA_0010 0 0.0 0.0 65535.0 READ_WRITE ECU_ADDRESS 0x3FA0FE /end MEASUREMENT
/begin MEASUREMENT ed_rbm_sl_durchs_b1.numerator_nv "Diagnosezyklen" UWORD FORMULA_0010 0 0.0 0.0 65535.0 READ_WRITE ECU_ADDRESS 0x3FA0FC /end MEASUREMENT
/begin MEASUREMENT ed_rbm_sl_durchs_b2.denominator_nv "Fahrzyklen" UWORD FORMULA_0010 0 0.0 0.0 65535.0 READ_WRITE ECU_ADDRESS 0x3FA102 /end MEASUREMENT
/begin MEASUREMENT ed_rbm_sl_durchs_b2.numerator_nv "Diagnosezyklen" UWORD FORMULA_0010 0 0.0 0.0 65535.0 READ_WRITE ECU_ADDRESS 0x3FA100 /end MEASUREMENT
/begin MEASUREMENT ed_rbm_sl_durchs_hstrang.denominator_nv "Fahrzyklen" UWORD FORMULA_0010 0 0.0 0.0 65535.0 READ_WRITE ECU_ADDRESS 0x3FA106 /end MEASUREMENT
/begin MEASUREMENT ed_rbm_sl_durchs_hstrang.numerator_nv "Diagnosezyklen" UWORD FORMULA_0010 0 0.0 0.0 65535.0 READ_WRITE ECU_ADDRESS 0x3FA104 /end MEASUREMENT
/begin MEASUREMENT ed_rbm_sl_ml_hfm.denominator_nv "Fahrzyklen" UWORD FORMULA_0010 0 0.0 0.0 65535.0 READ_WRITE ECU_ADDRESS 0x3F9F22 /end MEASUREMENT
/begin MEASUREMENT ed_rbm_sl_ml_hfm.numerator_nv "Diagnosezyklen" UWORD FORMULA_0010 0 0.0 0.0 65535.0 READ_WRITE ECU_ADDRESS 0x3F9F20 /end MEASUREMENT
/begin MEASUREMENT ed_rbm_sl_ml_hfm_obd.denominator_nv "Fahrzyklen" UWORD FORMULA_0010 0 0.0 0.0 65535.0 READ_WRITE ECU_ADDRESS 0x3FA152 /end MEASUREMENT
/begin MEASUREMENT ed_rbm_sl_ml_hfm_obd.numerator_nv "Diagnosezyklen" UWORD FORMULA_0010 0 0.0 0.0 65535.0 READ_WRITE ECU_ADDRESS 0x3FA150 /end MEASUREMENT
/begin MEASUREMENT ed_rbm_slp.denominator_nv "Fahrzyklen" UWORD FORMULA_0010 0 0.0 0.0 65535.0 READ_WRITE ECU_ADDRESS 0x3FA0FA /end MEASUREMENT
/begin MEASUREMENT ed_rbm_slp.numerator_nv "Diagnosezyklen" UWORD FORMULA_0010 0 0.0 0.0 65535.0 READ_WRITE ECU_ADDRESS 0x3FA0F8 /end MEASUREMENT
/begin MEASUREMENT ed_rbm_slv.denominator_nv "Fahrzyklen" UWORD FORMULA_0010 0 0.0 0.0 65535.0 READ_WRITE ECU_ADDRESS 0x3FA04A /end MEASUREMENT
/begin MEASUREMENT ed_rbm_slv.numerator_nv "Diagnosezyklen" UWORD FORMULA_0010 0 0.0 0.0 65535.0 READ_WRITE ECU_ADDRESS 0x3FA048 /end MEASUREMENT
/begin MEASUREMENT ed_rbm_tank_leer.denominator_nv "Fahrzyklen" UWORD FORMULA_0010 0 0.0 0.0 65535.0 READ_WRITE ECU_ADDRESS 0x3FA142 /end MEASUREMENT
/begin MEASUREMENT ed_rbm_tank_leer.numerator_nv "Diagnosezyklen" UWORD FORMULA_0010 0 0.0 0.0 65535.0 READ_WRITE ECU_ADDRESS 0x3FA140 /end MEASUREMENT
/begin MEASUREMENT ed_rbm_td.denominator_nv "Fahrzyklen" UWORD FORMULA_0010 0 0.0 0.0 65535.0 READ_WRITE ECU_ADDRESS 0x3FA042 /end MEASUREMENT
/begin MEASUREMENT ed_rbm_td.numerator_nv "Diagnosezyklen" UWORD FORMULA_0010 0 0.0 0.0 65535.0 READ_WRITE ECU_ADDRESS 0x3FA040 /end MEASUREMENT
/begin MEASUREMENT ed_rbm_te_obd_1.denominator_nv "Fahrzyklen" UWORD FORMULA_0010 0 0.0 0.0 65535.0 READ_WRITE ECU_ADDRESS 0x3FA0CE /end MEASUREMENT
/begin MEASUREMENT ed_rbm_te_obd_1.numerator_nv "Diagnosezyklen" UWORD FORMULA_0010 0 0.0 0.0 65535.0 READ_WRITE ECU_ADDRESS 0x3FA0CC /end MEASUREMENT
/begin MEASUREMENT ed_rbm_te_obd_2.denominator_nv "Fahrzyklen" UWORD FORMULA_0010 0 0.0 0.0 65535.0 READ_WRITE ECU_ADDRESS 0x3FA0D2 /end MEASUREMENT
/begin MEASUREMENT ed_rbm_te_obd_2.numerator_nv "Diagnosezyklen" UWORD FORMULA_0010 0 0.0 0.0 65535.0 READ_WRITE ECU_ADDRESS 0x3FA0D0 /end MEASUREMENT
/begin MEASUREMENT ed_rbm_tev1.denominator_nv "Fahrzyklen" UWORD FORMULA_0010 0 0.0 0.0 65535.0 READ_WRITE ECU_ADDRESS 0x3FA0D6 /end MEASUREMENT
/begin MEASUREMENT ed_rbm_tev1.numerator_nv "Diagnosezyklen" UWORD FORMULA_0010 0 0.0 0.0 65535.0 READ_WRITE ECU_ADDRESS 0x3FA0D4 /end MEASUREMENT
/begin MEASUREMENT ed_rbm_tev2.denominator_nv "Fahrzyklen" UWORD FORMULA_0010 0 0.0 0.0 65535.0 READ_WRITE ECU_ADDRESS 0x3FA0DA /end MEASUREMENT
/begin MEASUREMENT ed_rbm_tev2.numerator_nv "Diagnosezyklen" UWORD FORMULA_0010 0 0.0 0.0 65535.0 READ_WRITE ECU_ADDRESS 0x3FA0D8 /end MEASUREMENT
/begin MEASUREMENT ed_rbm_tgetr_hs.denominator_nv "Fahrzyklen" UWORD FORMULA_0010 0 0.0 0.0 65535.0 READ_WRITE ECU_ADDRESS 0x3FA182 /end MEASUREMENT
/begin MEASUREMENT ed_rbm_tgetr_hs.numerator_nv "Diagnosezyklen" UWORD FORMULA_0010 0 0.0 0.0 65535.0 READ_WRITE ECU_ADDRESS 0x3FA180 /end MEASUREMENT
/begin MEASUREMENT ed_rbm_time "Motor laeuft fuer Rate Based" UWORD FORMULA_0071 0 0.0 0.0 6553.5 READ_WRITE ECU_ADDRESS 0x3FBEAA /end MEASUREMENT
/begin MEASUREMENT ed_rbm_time_ll "Zeit im Leerlauf" UWORD FORMULA_0071 0 0.0 0.0 6553.5 READ_WRITE ECU_ADDRESS 0x3FBEAC /end MEASUREMENT
/begin MEASUREMENT ed_rbm_time_slp "Zeit mit Sekundaerlufteinblassung" UWORD FORMULA_0071 0 0.0 0.0 6553.5 READ_WRITE ECU_ADDRESS 0x3FBEA4 /end MEASUREMENT
/begin MEASUREMENT ed_rbm_time_v "Zeit mit Mindestgeschwindigkeit" UWORD FORMULA_0071 0 0.0 0.0 6553.5 READ_WRITE ECU_ADDRESS 0x3FBEAE /end MEASUREMENT
/begin MEASUREMENT ed_rbm_tz1.denominator_nv "Fahrzyklen" UWORD FORMULA_0010 0 0.0 0.0 65535.0 READ_WRITE ECU_ADDRESS 0x3F9F8A /end MEASUREMENT
/begin MEASUREMENT ed_rbm_tz1.numerator_nv "Diagnosezyklen" UWORD FORMULA_0010 0 0.0 0.0 65535.0 READ_WRITE ECU_ADDRESS 0x3F9F88 /end MEASUREMENT
/begin MEASUREMENT ed_rbm_tz10.denominator_nv "Fahrzyklen" UWORD FORMULA_0010 0 0.0 0.0 65535.0 READ_WRITE ECU_ADDRESS 0x3F9FAE /end MEASUREMENT
/begin MEASUREMENT ed_rbm_tz10.numerator_nv "Diagnosezyklen" UWORD FORMULA_0010 0 0.0 0.0 65535.0 READ_WRITE ECU_ADDRESS 0x3F9FAC /end MEASUREMENT
/begin MEASUREMENT ed_rbm_tz2.denominator_nv "Fahrzyklen" UWORD FORMULA_0010 0 0.0 0.0 65535.0 READ_WRITE ECU_ADDRESS 0x3F9F8E /end MEASUREMENT
/begin MEASUREMENT ed_rbm_tz2.numerator_nv "Diagnosezyklen" UWORD FORMULA_0010 0 0.0 0.0 65535.0 READ_WRITE ECU_ADDRESS 0x3F9F8C /end MEASUREMENT
/begin MEASUREMENT ed_rbm_tz3.denominator_nv "Fahrzyklen" UWORD FORMULA_0010 0 0.0 0.0 65535.0 READ_WRITE ECU_ADDRESS 0x3F9F92 /end MEASUREMENT
/begin MEASUREMENT ed_rbm_tz3.numerator_nv "Diagnosezyklen" UWORD FORMULA_0010 0 0.0 0.0 65535.0 READ_WRITE ECU_ADDRESS 0x3F9F90 /end MEASUREMENT
/begin MEASUREMENT ed_rbm_tz4.denominator_nv "Fahrzyklen" UWORD FORMULA_0010 0 0.0 0.0 65535.0 READ_WRITE ECU_ADDRESS 0x3F9F96 /end MEASUREMENT
/begin MEASUREMENT ed_rbm_tz4.numerator_nv "Diagnosezyklen" UWORD FORMULA_0010 0 0.0 0.0 65535.0 READ_WRITE ECU_ADDRESS 0x3F9F94 /end MEASUREMENT
/begin MEASUREMENT ed_rbm_tz5.denominator_nv "Fahrzyklen" UWORD FORMULA_0010 0 0.0 0.0 65535.0 READ_WRITE ECU_ADDRESS 0x3F9F9A /end MEASUREMENT
/begin MEASUREMENT ed_rbm_tz5.numerator_nv "Diagnosezyklen" UWORD FORMULA_0010 0 0.0 0.0 65535.0 READ_WRITE ECU_ADDRESS 0x3F9F98 /end MEASUREMENT
/begin MEASUREMENT ed_rbm_tz6.denominator_nv "Fahrzyklen" UWORD FORMULA_0010 0 0.0 0.0 65535.0 READ_WRITE ECU_ADDRESS 0x3F9F9E /end MEASUREMENT
/begin MEASUREMENT ed_rbm_tz6.numerator_nv "Diagnosezyklen" UWORD FORMULA_0010 0 0.0 0.0 65535.0 READ_WRITE ECU_ADDRESS 0x3F9F9C /end MEASUREMENT
/begin MEASUREMENT ed_rbm_tz7.denominator_nv "Fahrzyklen" UWORD FORMULA_0010 0 0.0 0.0 65535.0 READ_WRITE ECU_ADDRESS 0x3F9FA2 /end MEASUREMENT
/begin MEASUREMENT ed_rbm_tz7.numerator_nv "Diagnosezyklen" UWORD FORMULA_0010 0 0.0 0.0 65535.0 READ_WRITE ECU_ADDRESS 0x3F9FA0 /end MEASUREMENT
/begin MEASUREMENT ed_rbm_tz8.denominator_nv "Fahrzyklen" UWORD FORMULA_0010 0 0.0 0.0 65535.0 READ_WRITE ECU_ADDRESS 0x3F9FA6 /end MEASUREMENT
/begin MEASUREMENT ed_rbm_tz8.numerator_nv "Diagnosezyklen" UWORD FORMULA_0010 0 0.0 0.0 65535.0 READ_WRITE ECU_ADDRESS 0x3F9FA4 /end MEASUREMENT
/begin MEASUREMENT ed_rbm_tz9.denominator_nv "Fahrzyklen" UWORD FORMULA_0010 0 0.0 0.0 65535.0 READ_WRITE ECU_ADDRESS 0x3F9FAA /end MEASUREMENT
/begin MEASUREMENT ed_rbm_tz9.numerator_nv "Diagnosezyklen" UWORD FORMULA_0010 0 0.0 0.0 65535.0 READ_WRITE ECU_ADDRESS 0x3F9FA8 /end MEASUREMENT
/begin MEASUREMENT ed_rbm_van_anschl_a1.denominator_nv "Fahrzyklen" UWORD FORMULA_0010 0 0.0 0.0 65535.0 READ_WRITE ECU_ADDRESS 0x3F9FBE /end MEASUREMENT
/begin MEASUREMENT ed_rbm_van_anschl_a1.numerator_nv "Diagnosezyklen" UWORD FORMULA_0010 0 0.0 0.0 65535.0 READ_WRITE ECU_ADDRESS 0x3F9FBC /end MEASUREMENT
/begin MEASUREMENT ed_rbm_van_anschl_a2.denominator_nv "Fahrzyklen" UWORD FORMULA_0010 0 0.0 0.0 65535.0 READ_WRITE ECU_ADDRESS 0x3F9FC6 /end MEASUREMENT
/begin MEASUREMENT ed_rbm_van_anschl_a2.numerator_nv "Diagnosezyklen" UWORD FORMULA_0010 0 0.0 0.0 65535.0 READ_WRITE ECU_ADDRESS 0x3F9FC4 /end MEASUREMENT
/begin MEASUREMENT ed_rbm_van_anschl_e1.denominator_nv "Fahrzyklen" UWORD FORMULA_0010 0 0.0 0.0 65535.0 READ_WRITE ECU_ADDRESS 0x3F9FBA /end MEASUREMENT
/begin MEASUREMENT ed_rbm_van_anschl_e1.numerator_nv "Diagnosezyklen" UWORD FORMULA_0010 0 0.0 0.0 65535.0 READ_WRITE ECU_ADDRESS 0x3F9FB8 /end MEASUREMENT
/begin MEASUREMENT ed_rbm_van_anschl_e2.denominator_nv "Fahrzyklen" UWORD FORMULA_0010 0 0.0 0.0 65535.0 READ_WRITE ECU_ADDRESS 0x3F9FC2 /end MEASUREMENT
/begin MEASUREMENT ed_rbm_van_anschl_e2.numerator_nv "Diagnosezyklen" UWORD FORMULA_0010 0 0.0 0.0 65535.0 READ_WRITE ECU_ADDRESS 0x3F9FC0 /end MEASUREMENT
/begin MEASUREMENT ed_rbm_van_druck.denominator_nv "Fahrzyklen" UWORD FORMULA_0010 0 0.0 0.0 65535.0 READ_WRITE ECU_ADDRESS 0x3FA116 /end MEASUREMENT
/begin MEASUREMENT ed_rbm_van_druck.numerator_nv "Diagnosezyklen" UWORD FORMULA_0010 0 0.0 0.0 65535.0 READ_WRITE ECU_ADDRESS 0x3FA114 /end MEASUREMENT
/begin MEASUREMENT ed_rbm_van_dsv.denominator_nv "Fahrzyklen" UWORD FORMULA_0010 0 0.0 0.0 65535.0 READ_WRITE ECU_ADDRESS 0x3FA06A /end MEASUREMENT
/begin MEASUREMENT ed_rbm_van_dsv.numerator_nv "Diagnosezyklen" UWORD FORMULA_0010 0 0.0 0.0 65535.0 READ_WRITE ECU_ADDRESS 0x3FA068 /end MEASUREMENT
/begin MEASUREMENT ed_rbm_van_hall_a1.denominator_nv "Fahrzyklen" UWORD FORMULA_0010 0 0.0 0.0 65535.0 READ_WRITE ECU_ADDRESS 0x3F9E9A /end MEASUREMENT
/begin MEASUREMENT ed_rbm_van_hall_a1.numerator_nv "Diagnosezyklen" UWORD FORMULA_0010 0 0.0 0.0 65535.0 READ_WRITE ECU_ADDRESS 0x3F9E98 /end MEASUREMENT
/begin MEASUREMENT ed_rbm_van_hall_a2.denominator_nv "Fahrzyklen" UWORD FORMULA_0010 0 0.0 0.0 65535.0 READ_WRITE ECU_ADDRESS 0x3F9EA2 /end MEASUREMENT
/begin MEASUREMENT ed_rbm_van_hall_a2.numerator_nv "Diagnosezyklen" UWORD FORMULA_0010 0 0.0 0.0 65535.0 READ_WRITE ECU_ADDRESS 0x3F9EA0 /end MEASUREMENT
/begin MEASUREMENT ed_rbm_van_hall_e1.denominator_nv "Fahrzyklen" UWORD FORMULA_0010 0 0.0 0.0 65535.0 READ_WRITE ECU_ADDRESS 0x3F9E96 /end MEASUREMENT
/begin MEASUREMENT ed_rbm_van_hall_e1.numerator_nv "Diagnosezyklen" UWORD FORMULA_0010 0 0.0 0.0 65535.0 READ_WRITE ECU_ADDRESS 0x3F9E94 /end MEASUREMENT
/begin MEASUREMENT ed_rbm_van_hall_e2.denominator_nv "Fahrzyklen" UWORD FORMULA_0010 0 0.0 0.0 65535.0 READ_WRITE ECU_ADDRESS 0x3F9E9E /end MEASUREMENT
/begin MEASUREMENT ed_rbm_van_hall_e2.numerator_nv "Diagnosezyklen" UWORD FORMULA_0010 0 0.0 0.0 65535.0 READ_WRITE ECU_ADDRESS 0x3F9E9C /end MEASUREMENT
/begin MEASUREMENT ed_rbm_van_regl_a1.denominator_nv "Fahrzyklen" UWORD FORMULA_0010 0 0.0 0.0 65535.0 READ_WRITE ECU_ADDRESS 0x3F9EAA /end MEASUREMENT
/begin MEASUREMENT ed_rbm_van_regl_a1.numerator_nv "Diagnosezyklen" UWORD FORMULA_0010 0 0.0 0.0 65535.0 READ_WRITE ECU_ADDRESS 0x3F9EA8 /end MEASUREMENT
/begin MEASUREMENT ed_rbm_van_regl_a2.denominator_nv "Fahrzyklen" UWORD FORMULA_0010 0 0.0 0.0 65535.0 READ_WRITE ECU_ADDRESS 0x3F9EB2 /end MEASUREMENT
/begin MEASUREMENT ed_rbm_van_regl_a2.numerator_nv "Diagnosezyklen" UWORD FORMULA_0010 0 0.0 0.0 65535.0 READ_WRITE ECU_ADDRESS 0x3F9EB0 /end MEASUREMENT
/begin MEASUREMENT ed_rbm_van_regl_e1.denominator_nv "Fahrzyklen" UWORD FORMULA_0010 0 0.0 0.0 65535.0 READ_WRITE ECU_ADDRESS 0x3F9EA6 /end MEASUREMENT
/begin MEASUREMENT ed_rbm_van_regl_e1.numerator_nv "Diagnosezyklen" UWORD FORMULA_0010 0 0.0 0.0 65535.0 READ_WRITE ECU_ADDRESS 0x3F9EA4 /end MEASUREMENT
/begin MEASUREMENT ed_rbm_van_regl_e2.denominator_nv "Fahrzyklen" UWORD FORMULA_0010 0 0.0 0.0 65535.0 READ_WRITE ECU_ADDRESS 0x3F9EAE /end MEASUREMENT
/begin MEASUREMENT ed_rbm_van_regl_e2.numerator_nv "Diagnosezyklen" UWORD FORMULA_0010 0 0.0 0.0 65535.0 READ_WRITE ECU_ADDRESS 0x3F9EAC /end MEASUREMENT
/begin MEASUREMENT ed_rbm_van_vent_a1.denominator_nv "Fahrzyklen" UWORD FORMULA_0010 0 0.0 0.0 65535.0 READ_WRITE ECU_ADDRESS 0x3F9FCE /end MEASUREMENT
/begin MEASUREMENT ed_rbm_van_vent_a1.numerator_nv "Diagnosezyklen" UWORD FORMULA_0010 0 0.0 0.0 65535.0 READ_WRITE ECU_ADDRESS 0x3F9FCC /end MEASUREMENT
/begin MEASUREMENT ed_rbm_van_vent_a2.denominator_nv "Fahrzyklen" UWORD FORMULA_0010 0 0.0 0.0 65535.0 READ_WRITE ECU_ADDRESS 0x3F9FD6 /end MEASUREMENT
/begin MEASUREMENT ed_rbm_van_vent_a2.numerator_nv "Diagnosezyklen" UWORD FORMULA_0010 0 0.0 0.0 65535.0 READ_WRITE ECU_ADDRESS 0x3F9FD4 /end MEASUREMENT
/begin MEASUREMENT ed_rbm_van_vent_e1.denominator_nv "Fahrzyklen" UWORD FORMULA_0010 0 0.0 0.0 65535.0 READ_WRITE ECU_ADDRESS 0x3F9FCA /end MEASUREMENT
/begin MEASUREMENT ed_rbm_van_vent_e1.numerator_nv "Diagnosezyklen" UWORD FORMULA_0010 0 0.0 0.0 65535.0 READ_WRITE ECU_ADDRESS 0x3F9FC8 /end MEASUREMENT
/begin MEASUREMENT ed_rbm_van_vent_e2.denominator_nv "Fahrzyklen" UWORD FORMULA_0010 0 0.0 0.0 65535.0 READ_WRITE ECU_ADDRESS 0x3F9FD2 /end MEASUREMENT
/begin MEASUREMENT ed_rbm_van_vent_e2.numerator_nv "Diagnosezyklen" UWORD FORMULA_0010 0 0.0 0.0 65535.0 READ_WRITE ECU_ADDRESS 0x3F9FD0 /end MEASUREMENT
/begin MEASUREMENT ed_scdn_st_nv "Welche Fehler muessen mit similar Conditions behandelt werden" ULONG FORMULA_0000 0 0.0 0.0 4294967295.0 READ_WRITE ECU_ADDRESS 0x3F9938 /end MEASUREMENT
/begin MEASUREMENT ed_st_fehler_ign "ED-Gesamtstatus IGN-Fehler" ULONG FORMULA_0000 0 0.0 0.0 4294967295.0 READ_WRITE ARRAY_SIZE 4 ECU_ADDRESS 0x3F8558 MATRIX_DIM 4 1 1 /end MEASUREMENT
/begin MEASUREMENT ed_st_fehler_inj "ED-Gesamtstatus INJ-Fehler" ULONG FORMULA_0000 0 0.0 0.0 4294967295.0 READ_WRITE ARRAY_SIZE 7 ECU_ADDRESS 0x3F8838 MATRIX_DIM 7 1 1 /end MEASUREMENT
/begin MEASUREMENT ed_st_filter_ign "ED-Gesamtstatus IGN-Filter" ULONG FORMULA_0000 0 0.0 0.0 4294967295.0 READ_WRITE ARRAY_SIZE 4 ECU_ADDRESS 0x3F8568 MATRIX_DIM 4 1 1 /end MEASUREMENT
/begin MEASUREMENT ed_st_filter_inj "ED-Gesamtstatus INJ-Filter" ULONG FORMULA_0000 0 0.0 0.0 4294967295.0 READ_WRITE ARRAY_SIZE 7 ECU_ADDRESS 0x3F8854 MATRIX_DIM 7 1 1 /end MEASUREMENT
/begin MEASUREMENT ed_st_nv "Status-Eigendiagnose" UBYTE FORMULA_0037 0 0.0 0.0 255.0 READ_WRITE ECU_ADDRESS 0x3F9930 /end MEASUREMENT
/begin MEASUREMENT ed_st_nv_css_den "CSS-Denominator" UBYTE FORMULA_0050 0 0 0.0 255.0 READ_WRITE BIT_MASK 0x20 ECU_ADDRESS 0x3F9930 /end MEASUREMENT
/begin MEASUREMENT ed_st_nv_css_num "CSS-Numerator" UBYTE FORMULA_0051 0 0 0.0 255.0 READ_WRITE BIT_MASK 0x40 ECU_ADDRESS 0x3F9930 /end MEASUREMENT
/begin MEASUREMENT ed_st_nv_rbm_abbruch "Abbruch des RBM" UBYTE FORMULA_0049 0 0 0.0 255.0 READ_WRITE BIT_MASK 0x10 ECU_ADDRESS 0x3F9930 /end MEASUREMENT
/begin MEASUREMENT ed_st_nv_rbm_dcy "Rate-Based-DCY" UBYTE FORMULA_0046 0 0 0.0 255.0 READ_WRITE BIT_MASK 0x2 ECU_ADDRESS 0x3F9930 /end MEASUREMENT
/begin MEASUREMENT ed_st_nv_rbm_evap "RBM-EVAP-Bedingung" UBYTE FORMULA_0047 0 0 0.0 255.0 READ_WRITE BIT_MASK 0x4 ECU_ADDRESS 0x3F9930 /end MEASUREMENT
/begin MEASUREMENT ed_st_nv_rbm_slp "RBM-SLP-Bedingung" UBYTE FORMULA_0048 0 0 0.0 255.0 READ_WRITE BIT_MASK 0x8 ECU_ADDRESS 0x3F9930 /end MEASUREMENT
/begin MEASUREMENT ed_st_nv_wuc "Warmupcycleerkennung" UBYTE FORMULA_0045 0 0 0.0 255.0 READ_WRITE BIT_MASK 0x1 ECU_ADDRESS 0x3F9930 /end MEASUREMENT
/begin COMPU_METHOD FORMULA_0000 "FORMULA_0000" RAT_FUNC "%7.0" "-" COEFFS 0 1 0 0 0 1 /end COMPU_METHOD
/begin COMPU_METHOD FORMULA_0003 "FORMULA_0003" RAT_FUNC "%3.0" "-" COEFFS 0 1 0 0 0 1 /end COMPU_METHOD
/begin COMPU_METHOD FORMULA_0010 "FORMULA_0010" RAT_FUNC "%5.0" "-" COEFFS 0 1 0 0 0 1 /end COMPU_METHOD
/begin COMPU_METHOD FORMULA_0027 "FORMULA_0027" RAT_FUNC "%7.0" "km" COEFFS 0 1 0 0 0 1 /end COMPU_METHOD
/begin COMPU_METHOD FORMULA_0037 "FORMULA_0037" RAT_FUNC "%5.2" "-" COEFFS 0 1 0 0 0 1 /end COMPU_METHOD
/begin COMPU_METHOD FORMULA_0045 "FORMULA_0045" TAB_VERB "%5.2" "-" COMPU_TAB_REF FORMULA_0045_VTAB /end COMPU_METHOD
/begin COMPU_METHOD FORMULA_0046 "FORMULA_0046" TAB_VERB "%5.2" "-" COMPU_TAB_REF FORMULA_0046_VTAB /end COMPU_METHOD
/begin COMPU_METHOD FORMULA_0047 "FORMULA_0047" TAB_VERB "%5.2" "-" COMPU_TAB_REF FORMULA_0047_VTAB /end COMPU_METHOD
/begin COMPU_METHOD FORMULA_0048 "FORMULA_0048" TAB_VERB "%5.2" "-" COMPU_TAB_REF FORMULA_0048_VTAB /end COMPU_METHOD
/begin COMPU_METHOD FORMULA_0049 "FORMULA_0049" TAB_VERB "%5.2" "-" COMPU_TAB_REF FORMULA_0049_VTAB /end COMPU_METHOD
/begin COMPU_METHOD FORMULA_0050 "FORMULA_0050" TAB_VERB "%5.2" "-" COMPU_TAB_REF FORMULA_0050_VTAB /end COMPU_METHOD
/begin COMPU_METHOD FORMULA_0051 "FORMULA_0051" TAB_VERB "%5.2" "-" COMPU_TAB_REF FORMULA_0051_VTAB /end COMPU_METHOD
/begin COMPU_METHOD FORMULA_0053 "FORMULA_0053" TAB_VERB "%5.0" "-" COMPU_TAB_REF FORMULA_0053_VTAB /end COMPU_METHOD
/begin COMPU_METHOD FORMULA_0054 "FORMULA_0054" RAT_FUNC "%5.0" "km" COEFFS 0 0.125 0.0 0 0.0 1.0 /end COMPU_METHOD
/begin COMPU_METHOD FORMULA_0055 "FORMULA_0055" RAT_FUNC "%5.0" "-" COEFFS 0 4.0 0.0 0 0.0 1.0 /end COMPU_METHOD
/begin COMPU_METHOD FORMULA_0056 "FORMULA_0056" RAT_FUNC "%7.2" "g/s" COEFFS 0 100.0 0.0 0 0.0 1.0 /end COMPU_METHOD
/begin COMPU_METHOD FORMULA_0057 "FORMULA_0057" TAB_VERB "%3.0" "-" COMPU_TAB_REF FORMULA_0057_VTAB /end COMPU_METHOD
/begin COMPU_METHOD FORMULA_0058 "FORMULA_0058" RAT_FUNC "%7.4" "-" COEFFS 0 128.0 0.0 0 0.0 1.0 /end COMPU_METHOD
/begin COMPU_METHOD FORMULA_0059 "FORMULA_0059" RAT_FUNC "%7.4" "%" COEFFS 0 2.55 0.0 0 0.0 1.0 /end COMPU_METHOD
/begin COMPU_METHOD FORMULA_0060 "FORMULA_0060" RAT_FUNC "%3.0" "°C" COEFFS 0 1.0 40.0 0 0.0 1.0 /end COMPU_METHOD
/begin COMPU_METHOD FORMULA_0061 "FORMULA_0061" RAT_FUNC "%3.0" "kPa" COEFFS 0 0.3333333333333333 0.0 0 0.0 1.0 /end COMPU_METHOD
/begin COMPU_METHOD FORMULA_0062 "FORMULA_0062" RAT_FUNC "%3.0" "km/h" COEFFS 0 1 0 0 0 1 /end COMPU_METHOD
/begin COMPU_METHOD FORMULA_0063 "FORMULA_0063" RAT_FUNC "%4.1" "°KW" COEFFS 0 2.0 128.0 0 0.0 1.0 /end COMPU_METHOD
/begin COMPU_METHOD FORMULA_0064 "FORMULA_0064" TAB_VERB "%3.0" "-" COMPU_TAB_REF FORMULA_0064_VTAB /end COMPU_METHOD
/begin COMPU_METHOD FORMULA_0065 "FORMULA_0065" TAB_VERB "%5.2" "-" COMPU_TAB_REF FORMULA_0065_VTAB /end COMPU_METHOD
/begin COMPU_METHOD FORMULA_0066 "FORMULA_0066" TAB_VERB "%5.2" "-" COMPU_TAB_REF FORMULA_0066_VTAB /end COMPU_METHOD
/begin COMPU_METHOD FORMULA_0067 "FORMULA_0067" TAB_VERB "%5.2" "-" COMPU_TAB_REF FORMULA_0067_VTAB /end COMPU_METHOD
/begin COMPU_METHOD FORMULA_0068 "FORMULA_0068" TAB_VERB "%5.2" "-" COMPU_TAB_REF FORMULA_0068_VTAB /end COMPU_METHOD
/begin COMPU_METHOD FORMULA_0069 "FORMULA_0069" TAB_VERB "%5.2" "-" COMPU_TAB_REF FORMULA_0069_VTAB /end COMPU_METHOD
/begin COMPU_METHOD FORMULA_0070 "FORMULA_0070" TAB_VERB "%3.0" "-" COMPU_TAB_REF FORMULA_0070_VTAB /end COMPU_METHOD
/begin COMPU_METHOD FORMULA_0071 "FORMULA_0071" RAT_FUNC "%6.1" "s" COEFFS 0 10.0 0.0 0 0.0 1.0 /end COMPU_METHOD
/begin COMPU_VTAB FORMULA_0045_VTAB "FORMULA_0045_VTAB" TAB_VERB 1 0 "kein WUC" DEFAULT_VALUE "Warmcycle" /end COMPU_VTAB
/begin COMPU_VTAB FORMULA_0046_VTAB "FORMULA_0046_VTAB" TAB_VERB 1 0 "Kein Cycle" DEFAULT_VALUE "Rate-Based-DCY" /end COMPU_VTAB
/begin COMPU_VTAB FORMULA_0047_VTAB "FORMULA_0047_VTAB" TAB_VERB 1 0 "Kein RBM-EVAP" DEFAULT_VALUE "RBM-EVAP" /end COMPU_VTAB
/begin COMPU_VTAB FORMULA_0048_VTAB "FORMULA_0048_VTAB" TAB_VERB 1 0 "Kein RBM-SLP" DEFAULT_VALUE "RBM-SLP" /end COMPU_VTAB
/begin COMPU_VTAB FORMULA_0049_VTAB "FORMULA_0049_VTAB" TAB_VERB 1 0 "Kein Abbruch" DEFAULT_VALUE "Abbruch" /end COMPU_VTAB
/begin COMPU_VTAB FORMULA_0050_VTAB "FORMULA_0050_VTAB" TAB_VERB 1 0 "Kein CSS-DEN" DEFAULT_VALUE "CSS-DEN" /end COMPU_VTAB
/begin COMPU_VTAB FORMULA_0051_VTAB "FORMULA_0051_VTAB" TAB_VERB 1 0 "Kein CSS-NUM" DEFAULT_VALUE "CSS-NUM" /end COMPU_VTAB
/begin COMPU_VTAB FORMULA_0053_VTAB "FORMULA_0053_VTAB" TAB_VERB 352 10000 "SK_TESTFEHLER" 10001 "PUMG_FEHLER" 10002 "HFM1_FEHLER" 10003 "HFM2_FEHLER" 10004 "PSAU1_FEHLER" 10005 "PSAU2_FEHLER" 10006 "VAN_HALL_E1_FEHLER" 10007 "VAN_HALL_A1_FEHLER" 10008 "VAN_HALL_E2_FEHLER" 10009 "VAN_HALL_A2_FEHLER" 10010 "VAN_REGL_E1_FEHLER" 10011 "VAN_REGL_A1_FEHLER" 10012 "VAN_REGL_E2_FEHLER" 10013 "VAN_REGL_A2_FEHLER" 10014 "NW_SYNC_FEHLER" 10015 "INDEX_15_INJ" 10016 "PCTRL_IGN_FEHLER" 10017 "PT_TORQDKG_FEHLER" 10018 "PKS_FEHLER" 10019 "PT_STATUSR_FEHLER" 10020 "LAVK1_FEHLER" 10021 "LAVK2_FEHLER" 10022 "LAVK1_OBD_PLAU_FEHLER" 10023 "LAVK2_OBD_PLAU_FEHLER" 10024 "LAVK1_OBD_SA_FEHLER" 10025 "LAVK2_OBD_SA_FEHLER" 10026 "LANK1_FEHLER" 10027 "LANK2_FEHLER" 10028 "LSHNK1_FEHLER" 10029 "LSHNK2_FEHLER" 52615 "PT_BUSOFF" 52632 "PT_TORQDSC_FEHLER" 52645 "PT_STDSC_FEHLER" 52667 "PT_VRAD_FEHLER" 52636 "PT_VFZG_FEHLER" 52628 "PT_ATEMP_FEHLER" 52640 "PT_KLST_FEHLER" 52649 "PT_KKOS_FEHLER" 52641 "PT_LRW_FEHLER" 10039 "FPLAU1_FEHLER" 10040 "FPLAU2_FEHLER" 10041 "SL_ML_HFM_FEHLER" 10042 "LANK1_OBD_S_FEHLER" 10043 "LANK2_OBD_S_FEHLER" 10044 "LAVK1_OBD_TL_FEHLER" 10045 "LAVK2_OBD_TL_FEHLER" 10046 "LSHVK1_FEHLER" 10047 "LSHVK2_FEHLER" 10048 "LSRVK1_OBD_REG_FEHLER" 10049 "LSRVK2_OBD_REG_FEHLER" 10050 "LSHVK1_R_FEHLER" 10051 "LSHVK2_R_FEHLER" 10052 "LSRVK1_OBD_START_FEHLER" 10053 "LSRVK2_OBD_START_FEHLER" 10054 "LSRVK1_OBD_REF_FEHLER" 10055 "LSRVK2_OBD_REF_FEHLER" 10056 "LAVK1_DIAG_FEHLER" 10057 "LAVK2_DIAG_FEHLER" 10058 "LAVK1_IA_OPENLOAD_FEHLER" 10059 "LAVK2_IA_OPENLOAD_FEHLER" 10060 "PT_GRB_FEHLER" 10061 "PT_GRB2_FEHLER" 10062 "LAVK1_UN_OPENLOAD_FEHLER" 10063 "LAVK2_UN_OPENLOAD_FEHLER" 10064 "LAVK1_IP_OPENLOAD_FEHLER" 10065 "LAVK2_IP_OPENLOAD_FEHLER" 10066 "APPL_DATA_INJ" 10067 "TZ1_FEHLER" 10068 "TZ2_FEHLER" 10069 "TZ3_FEHLER" 10070 "TZ4_FEHLER" 10071 "TZ5_FEHLER" 10072 "TZ6_FEHLER" 10073 "TZ7_FEHLER" 10074 "TZ8_FEHLER" 10075 "TZ9_FEHLER" 10076 "TZ10_FEHLER" 10077 "LAM1_REG_FEHLER" 10078 "LAM2_REG_FEHLER" 10079 "VAN_ANSCHL_E1_FEHLER" 10080 "VAN_ANSCHL_A1_FEHLER" 10081 "VAN_ANSCHL_E2_FEHLER" 10082 "VAN_ANSCHL_A2_FEHLER" 10083 "VAN_VENT_E1_FEHLER" 10084 "VAN_VENT_A1_FEHLER" 10085 "VAN_VENT_E2_FEHLER" 10086 "VAN_VENT_A2_FEHLER" 10087 "EV1_FEHLER" 10088 "EV2_FEHLER" 10089 "EV3_FEHLER" 10090 "EV4_FEHLER" 10091 "EV5_FEHLER" 10092 "EV6_FEHLER" 10093 "EV7_FEHLER" 10094 "EV8_FEHLER" 10095 "EV9_FEHLER" 10096 "EV10_FEHLER" 10097 "LAVK1_OBD_DYN_FEHLER" 10098 "LAVK2_OBD_DYN_FEHLER" 52650 "PT_CRASH_FEHLER" 52635 "PT_VEHMOD_FEHLER" 52629 "PT_BEDFGR_FEHLER" 10102 "DMTL_P_FEHLER" 10103 "DMTL_V_FEHLER" 10104 "DMTL_H_FEHLER" 10105 "DMTL_GROBLECK_FEHLER" 10106 "DMTL_FEUCHT_FEHLER" 10107 "DMTL_DECKEL_MELDUNG" 10108 "LA1_TRIM_FEHLER" 10109 "LA2_TRIM_FEHLER" 10110 "RLU87_FEHLER" 10111 "EKP_PWM_FEHLER" 10112 "CODIER_FEHLER" 10113 "TD_FEHLER" 10114 "RLSLP_FEHLER" 10115 "SLV_FEHLER" 52639 "PT_KMST_FEHLER" 52648 "PT_STATKOM_FEHLER" 10118 "PKS_LL_FEHLER" 10119 "PKS_TL_FEHLER" 10120 "PKS_Q_FEHLER" 10121 "KAT_OBD1_FEHLER" 10122 "KAT_OBD2_FEHLER" 10123 "VAN_DSV_FEHLER" 10124 "FI_GEN" 10125 "FI_BSD" 10126 "FI_QLT" 10127 "FI_IBS1" 10128 "FI_IBS2" 10129 "FI_IBS3" 10130 "FI_PMBN" 10131 "FI_PMBATT" 10132 "MVAC_DRUCKSENSOR" 52668 "PT_BEDAT_FEHLER" 10134 "SK_MANAGER_INJ" 10135 "INDEX_135_INJ" 10136 "EWS_SCI_FEHLER" 10137 "EWS_MAN_FEHLER" 10138 "FI_BSD_0" 10139 "FI_BSD_6" 10140 "FI_BSDGLOB" 10141 "FI_PMRUHVERL" 10142 "FI_TOENS" 10143 "EBOX_ELU_FEHLER" 10144 "SG_INJ_FEHLER" 10145 "EGAS_ENLTG1_DIAG" 10146 "EGAS_ENLTG2_DIAG" 10147 "S_POEL_FEHLER" 10148 "TEV1_OBD_FEHLER" 10149 "TEV2_OBD_FEHLER" 10150 "TEV1_FEHLER" 10151 "TEV2_FEHLER" 10152 "EBENE2_INJ_FEHLER" 10153 "KW_FEHLER" 10154 "LA1_ADAPT_FEHLER" 10155 "LA2_ADAPT_FEHLER" 10156 "KGE1_FEHLER" 10157 "KGE2_FEHLER" 10158 "FST_FEHLER" 10159 "SLP_FEHLER" 10160 "SL_DURCHS_B1" 10161 "SL_DURCHS_B2" 10162 "SL_DURCHS_HSTRANG" 10163 "FETRAWE_FEHLER" 10164 "S_GETR_HS_FEHLER" 10165 "S_KUPP_HS_FEHLER" 10166 "VAN_DRUCK_FEHLER" 10167 "ELUP_FEHLER" 10168 "ELU_FEHLER" 52655 "PT_STATANH_FEHLER" 10170 "KSD1_FEHLER" 10171 "KSD2_FEHLER" 10172 "KATS1_FEHLER" 10173 "KATS2_FEHLER" 10174 "PT_GRB3_FEHLER" 10175 "PT_ANFRADMOM_FEHLER" 10176 "FST_GEBER_FEHLER" 10177 "TANK_LEER_INFO" 10178 "PT_TOMA_FEHLER" 10179 "DMTL_FEINLECK_FEHLER" 10180 "PUMG_OBD_FEHLER" 10181 "SL_ML_HFM_OBD_FEHLER" 10182 "LA1_TRIM_AD_FEHLER" 10183 "LA2_TRIM_AD_FEHLER" 10184 "LANK1_OPENLOAD_FEHLER" 10185 "LANK2_OPENLOAD_FEHLER" 10186 "LANK1_OBD_WE_FEHLER" 10187 "LANK2_OBD_WE_FEHLER" 10188 "LSHNK1_R_FEHLER" 10189 "LSHNK2_R_FEHLER" 10190 "PKS_MODELL_FEHLER" 10191 "PKS_PAUFBAU_FEHLER" 10192 "PKSR_ADAPT_ANSCHL_FEHLER" 10193 "TGETR_FEHLER" 10194 "LAVK_ATIC42_FEHLER" 10195 "PT_ALAENGS_FEHLER" 10196 "INDEX_196_INJ" 10197 "INDEX_197_INJ" 10198 "INDEX_198_INJ" 10199 "INDEX_199_INJ" 10200 "INDEX_200_INJ" 10201 "INDEX_201_INJ" 10202 "INDEX_202_INJ" 10203 "INDEX_203_INJ" 10204 "INDEX_204_INJ" 10205 "INDEX_205_INJ" 10206 "INDEX_206_INJ" 10207 "INDEX_207_INJ" 10208 "INDEX_208_INJ" 10209 "INDEX_209_INJ" 10210 "INDEX_210_INJ" 10211 "INDEX_211_INJ" 10212 "INDEX_212_INJ" 10213 "INDEX_213_INJ" 10214 "INDEX_214_INJ" 10215 "INDEX_215_INJ" 10216 "INDEX_216_INJ" 10217 "INDEX_217_INJ" 10218 "INDEX_218_INJ" 10219 "INDEX_219_INJ" 10220 "INDEX_220_INJ" 10221 "INDEX_221_INJ" 10222 "INDEX_222_INJ" 10223 "INDEX_223_INJ" 11000 "SK_TESTFEHLER" 11001 "TMOT_FEHLER" 11002 "TMOT_OBD_FEHLER" 11003 "TAN1_FEHLER" 11004 "TAN2_FEHLER" 11005 "TIME_REL_OBD_FEHLER" 11006 "UB_FEHLER" 11007 "TKA_FEHLER" 11008 "TDME_FEHLER" 11009 "UEXT_111_219_514_FEHLER" 11010 "UEXT_124_512_FEHLER" 11011 "APPL_DATA_IGN" 11012 "TKA_OBD_FEHLER" 11013 "PWG1_FEHLER" 11014 "PWG2_FEHLER" 11015 "PWG_VGL_FEHLER" 11016 "PCTRL_INJ_FEHLER" 52669 "EC_LLS1_FEHLER" 52670 "EC_LLS2_FEHLER" 52671 "EC_DK1_FEHLER" 52672 "EC_DK2_FEHLER" 11021 "LLS1_SK_FEHLER" 11022 "LLS2_SK_FEHLER" 11023 "SMG_SCHALTABLAUF" 11024 "SMG_SK_FEHLER" 11025 "SMG_SK_N_UEBERWACHUNG" 11026 "TUMG_OBD_FEHLER" 11027 "V_FEHLER" 11028 "DK_INIT_FEHLER" 11029 "DK1_REG_FEHLER" 11030 "DK2_REG_FEHLER" 11031 "DK1_ADAPT_FEHLER" 11032 "DK2_ADAPT_FEHLER" 11033 "INDEX_33_IGN" 11034 "INDEX_34_IGN" 11035 "INDEX_35_IGN" 11036 "INDEX_36_IGN" 11037 "TABG1_FEHLER" 11038 "TABG2_FEHLER" 11039 "DK1_WDK_FEHLER" 11040 "DK2_WDK_FEHLER" 11041 "DK1_PDR_FEHLER" 11042 "DK2_PDR_FEHLER" 11043 "LLS1_REG_FEHLER" 11044 "LLS2_REG_FEHLER" 11045 "DK1_SK_FEHLER" 11046 "DK2_SK_FEHLER" 11047 "DK1_FT_FEHLER" 11048 "DK2_FT_FEHLER" 11049 "MD_SK_ERR" 11050 "LLS_INIT_FEHLER" 11051 "DSC_EINGR_FEHLER" 11052 "DK1_CMD_FEHLER" 11053 "DK2_CMD_FEHLER" 11054 "LLS1_CMD_FEHLER" 11055 "LLS2_CMD_FEHLER" 52673 "SC_SMG1_FEHLER" 52674 "SC_SMG2_FEHLER" 52675 "SC_SMG3_FEHLER" 52619 "SC_BUSOFF_FEHLER" 52627 "EC_BUSOFF_FEHLER" 11061 "AUSS_KAT_Z1_FEHLER" 11062 "AUSS_KAT_Z2_FEHLER" 11063 "AUSS_KAT_Z3_FEHLER" 11064 "AUSS_KAT_Z4_FEHLER" 11065 "AUSS_KAT_Z5_FEHLER" 11066 "AUSS_KAT_Z6_FEHLER" 11067 "AUSS_KAT_Z7_FEHLER" 11068 "AUSS_KAT_Z8_FEHLER" 11069 "AUSS_KAT_Z9_FEHLER" 11070 "AUSS_KAT_Z10_FEHLER" 11071 "INDEX_71_IGN" 11072 "INDEX_72_IGN" 11073 "AUSS_KAT_MULT_FEHLER" 11074 "AUSS_ABG_Z1_FEHLER" 11075 "AUSS_ABG_Z2_FEHLER" 11076 "AUSS_ABG_Z3_FEHLER" 11077 "AUSS_ABG_Z4_FEHLER" 11078 "AUSS_ABG_Z5_FEHLER" 11079 "AUSS_ABG_Z6_FEHLER" 11080 "AUSS_ABG_Z7_FEHLER" 11081 "AUSS_ABG_Z8_FEHLER" 11082 "AUSS_ABG_Z9_FEHLER" 11083 "AUSS_ABG_Z10_FEHLER" 11084 "INDEX_84_IGN" 11085 "INDEX_85_IGN" 11086 "AUSS_ABG_MULT_FEHLER" 11087 "TAN_OBD_B1_FEHLER" 11088 "DKG_EINGR_FEHLER" 11089 "SC_PKS_FEHLER" 11090 "ZOELP1_FEHLER" 11091 "ZOELP2_FEHLER" 11092 "SG_IGN_FEHLER" 11093 "EBENE2_IGN_FEHLER" 11094 "BLS_PLAU_FEHLER" 11095 "SK_MANAGER_IGN" 11096 "LLR_DIAGNOSE" 11097 "THERMOSTAT_FEHLER" 11098 "TAN_OBD_B2_FEHLER" 11099 "DK1_ZUSTAND" 11100 "DK2_ZUSTAND" 11101 "FGR_ABWURF" 11102 "PWG_BLS_FEHLER" 11103 "START_RL_FEHLER" 11104 "AFZ_FEHLER" 11105 "N_GETR_EIN_HS_FEHLER" 11106 "SERVO_I_FEHLER" 11107 "SERVO_V_FEHLER" 11108 "TUMG_FEHLER" 11109 "LLR_DIAGNOSE_CSS" 11110 "TMOT_HIGH_FEHLER" 11111 "M_SPULE_ZYL_1" 11112 "M_SPULE_ZYL_2" 11113 "M_SPULE_ZYL_3" 11114 "M_SPULE_ZYL_4" 11115 "M_SPULE_ZYL_5" 11116 "M_SPULE_ZYL_6" 11117 "M_SPULE_ZYL_7" 11118 "M_SPULE_ZYL_8" 11119 "M_SPULE_ZYL_9" 11120 "M_SPULE_ZYL_10" 11121 "INDEX_121_IGN" 11122 "INDEX_122_IGN" 11123 "INDEX_123_IGN" 11124 "INDEX_124_IGN" 11125 "INDEX_125_IGN" 11126 "INDEX_126_IGN" 11127 "INDEX_127_IGN" /end COMPU_VTAB
/begin COMPU_VTAB FORMULA_0057_VTAB "FORMULA_0057_VTAB" TAB_VERB 4 1 "Regler noch aus" 2 "Regler aktiv" 4 "Schubabschalten" 8 "Sonde defekt" /end COMPU_VTAB
/begin COMPU_VTAB FORMULA_0064_VTAB "FORMULA_0064_VTAB" TAB_VERB 2 1 "Einblasung" 4 "Keine Einblasung" /end COMPU_VTAB
/begin COMPU_VTAB FORMULA_0065_VTAB "FORMULA_0065_VTAB" TAB_VERB 1 0 "BMW-MIL aus" DEFAULT_VALUE "BMW-MIL an" /end COMPU_VTAB
/begin COMPU_VTAB FORMULA_0066_VTAB "FORMULA_0066_VTAB" TAB_VERB 1 0 "PRE-MIL aus" DEFAULT_VALUE "PRE-MIL an" /end COMPU_VTAB
/begin COMPU_VTAB FORMULA_0067_VTAB "FORMULA_0067_VTAB" TAB_VERB 1 0 "DME-MIL aus" DEFAULT_VALUE "DME-MIL an" /end COMPU_VTAB
/begin COMPU_VTAB FORMULA_0068_VTAB "FORMULA_0068_VTAB" TAB_VERB 1 0 "ZYL_OFF-MIL aus" DEFAULT_VALUE "ZYL_OFF-MIL an" /end COMPU_VTAB
/begin COMPU_VTAB FORMULA_0069_VTAB "FORMULA_0069_VTAB" TAB_VERB 1 0 "SMG-MIL aus" DEFAULT_VALUE "SMG-MIL an" /end COMPU_VTAB
/begin COMPU_VTAB FORMULA_0070_VTAB "FORMULA_0070_VTAB" TAB_VERB 1 165 "fsp_loeschen" DEFAULT_VALUE "fsp_sichern" /end COMPU_VTAB
/begin FUNCTION Eigendiagnose ""
 /begin DEF_CHARACTERISTIC K_ED_APPL_DATA_INJ.DEC_NACH_EINTRAG K_ED_APPL_DATA_INJ.DEC_VOR_EINTRAG K_ED_APPL_DATA_INJ.FEHLERSCHWELLE K_ED_APPL_DATA_INJ.INC_NACH_EINTRAG K_ED_APPL_DATA_INJ.INC_VOR_EINTRAG K_ED_APPL_DATA_INJ.KLASSENINDEX K_ED_APPL_DATA_INJ.OK_SCHWELLE K_ED_APPL_DATA_INJ.P_CODE_OPENLOAD K_ED_APPL_DATA_INJ.P_CODE_SH_TO_GND K_ED_APPL_DATA_INJ.P_CODE_SH_TO_UB K_ED_APPL_DATA_INJ.P_CODE_UNPLAUSIBEL K_ED_CODIERUNG.DEC_NACH_EINTRAG K_ED_CODIERUNG.DEC_VOR_EINTRAG K_ED_CODIERUNG.FEHLERSCHWELLE K_ED_CODIERUNG.INC_NACH_EINTRAG K_ED_CODIERUNG.INC_VOR_EINTRAG K_ED_CODIERUNG.KLASSENINDEX K_ED_CODIERUNG.OK_SCHWELLE K_ED_CODIERUNG.P_CODE_OPENLOAD K_ED_CODIERUNG.P_CODE_SH_TO_GND K_ED_CODIERUNG.P_CODE_SH_TO_UB K_ED_CODIERUNG.P_CODE_UNPLAUSIBEL K_ED_CSS_TIME K_ED_DK1_ENLTG.DEC_NACH_EINTRAG K_ED_DK1_ENLTG.DEC_VOR_EINTRAG K_ED_DK1_ENLTG.FEHLERSCHWELLE K_ED_DK1_ENLTG.INC_NACH_EINTRAG K_ED_DK1_ENLTG.INC_VOR_EINTRAG K_ED_DK1_ENLTG.KLASSENINDEX K_ED_DK1_ENLTG.OK_SCHWELLE K_ED_DK1_ENLTG.P_CODE_OPENLOAD K_ED_DK1_ENLTG.P_CODE_SH_TO_GND K_ED_DK1_ENLTG.P_CODE_SH_TO_UB K_ED_DK1_ENLTG.P_CODE_UNPLAUSIBEL K_ED_DK2_ENLTG.DEC_NACH_EINTRAG K_ED_DK2_ENLTG.DEC_VOR_EINTRAG K_ED_DK2_ENLTG.FEHLERSCHWELLE K_ED_DK2_ENLTG.INC_NACH_EINTRAG K_ED_DK2_ENLTG.INC_VOR_EINTRAG K_ED_DK2_ENLTG.KLASSENINDEX K_ED_DK2_ENLTG.OK_SCHWELLE K_ED_DK2_ENLTG.P_CODE_OPENLOAD K_ED_DK2_ENLTG.P_CODE_SH_TO_GND K_ED_DK2_ENLTG.P_CODE_SH_TO_UB K_ED_DK2_ENLTG.P_CODE_UNPLAUSIBEL K_ED_DMTL_DECKEL.DEC_NACH_EINTRAG K_ED_DMTL_DECKEL.DEC_VOR_EINTRAG K_ED_DMTL_DECKEL.FEHLERSCHWELLE K_ED_DMTL_DECKEL.INC_NACH_EINTRAG K_ED_DMTL_DECKEL.INC_VOR_EINTRAG K_ED_DMTL_DECKEL.KLASSENINDEX K_ED_DMTL_DECKEL.OK_SCHWELLE K_ED_DMTL_DECKEL.P_CODE_OPENLOAD K_ED_DMTL_DECKEL.P_CODE_SH_TO_GND K_ED_DMTL_DECKEL.P_CODE_SH_TO_UB K_ED_DMTL_DECKEL.P_CODE_UNPLAUSIBEL K_ED_DMTL_FEINLECK.DEC_NACH_EINTRAG K_ED_DMTL_FEINLECK.DEC_VOR_EINTRAG K_ED_DMTL_FEINLECK.FEHLERSCHWELLE K_ED_DMTL_FEINLECK.INC_NACH_EINTRAG K_ED_DMTL_FEINLECK.INC_VOR_EINTRAG K_ED_DMTL_FEINLECK.KLASSENINDEX K_ED_DMTL_FEINLECK.OK_SCHWELLE K_ED_DMTL_FEINLECK.P_CODE_OPENLOAD K_ED_DMTL_FEINLECK.P_CODE_SH_TO_GND K_ED_DMTL_FEINLECK.P_CODE_SH_TO_UB K_ED_DMTL_FEINLECK.P_CODE_UNPLAUSIBEL K_ED_DMTL_FEUCHT.DEC_NACH_EINTRAG K_ED_DMTL_FEUCHT.DEC_VOR_EINTRAG K_ED_DMTL_FEUCHT.FEHLERSCHWELLE K_ED_DMTL_FEUCHT.INC_NACH_EINTRAG K_ED_DMTL_FEUCHT.INC_VOR_EINTRAG K_ED_DMTL_FEUCHT.KLASSENINDEX K_ED_DMTL_FEUCHT.OK_SCHWELLE K_ED_DMTL_FEUCHT.P_CODE_OPENLOAD K_ED_DMTL_FEUCHT.P_CODE_SH_TO_GND K_ED_DMTL_FEUCHT.P_CODE_SH_TO_UB K_ED_DMTL_FEUCHT.P_CODE_UNPLAUSIBEL K_ED_DMTL_GROBLECK.DEC_NACH_EINTRAG K_ED_DMTL_GROBLECK.DEC_VOR_EINTRAG K_ED_DMTL_GROBLECK.FEHLERSCHWELLE /end DEF_CHARACTERISTIC
 /begin OUT_MEASUREMENT ed_fsp_20of20_.ff_lam_reg_f_b2_nv ed_fsp_20of20_.ff_ml_ges_nv ed_fsp_20of20_.ff_n_nv ed_fsp_20of20_.ff_p_code_nv ed_fsp_20of20_.ff_pks_ist_nv ed_fsp_20of20_.ff_rf_m_nv ed_fsp_20of20_.ff_sl_st_nv ed_fsp_20of20_.ff_tan_m_nv ed_fsp_20of20_.ff_tmot_nv ed_fsp_20of20_.ff_tz1_nv ed_fsp_20of20_.ff_v_vorne_nv ed_fsp_20of20_.haeufigkeitszaehler_nv ed_fsp_20of20_.inj_fehlerzaehler_nv ed_fsp_20of20_.logistikzaehler_nv ed_fsp_20of20_.mil_filter_nv ed_fsp_20of20_.mil_filter_scdn_nv ed_fsp_20of20_.scdn_nenner_nv ed_fsp_20of20_.scdn_zaehler_nv ed_fsp_20of20_.uw_satz_1of3_.uw_km_stand_nv ed_fsp_20of20_.uw_satz_1of3_.uw_wert_nv_1of4_ ed_fsp_20of20_.uw_satz_1of3_.uw_wert_nv_2of4_ ed_fsp_20of20_.uw_satz_1of3_.uw_wert_nv_3of4_ ed_fsp_20of20_.uw_satz_1of3_.uw_wert_nv_4of4_ ed_fsp_20of20_.uw_satz_2of3_.uw_km_stand_nv ed_fsp_20of20_.uw_satz_2of3_.uw_wert_nv_1of4_ ed_fsp_20of20_.uw_satz_2of3_.uw_wert_nv_2of4_ ed_fsp_20of20_.uw_satz_2of3_.uw_wert_nv_3of4_ ed_fsp_20of20_.uw_satz_2of3_.uw_wert_nv_4of4_ ed_fsp_20of20_.uw_satz_3of3_.uw_km_stand_nv ed_fsp_20of20_.uw_satz_3of3_.uw_wert_nv_1of4_ ed_fsp_20of20_.uw_satz_3of3_.uw_wert_nv_2of4_ ed_fsp_20of20_.uw_satz_3of3_.uw_wert_nv_3of4_ ed_fsp_20of20_.uw_satz_3of3_.uw_wert_nv_4of4_ ed_fsp_2of20_.ed_fil_index_nv ed_fsp_2of20_.fehlerart_nv ed_fsp_2of20_.fehlercode_nv ed_fsp_2of20_.ff_egas_ist_dk_b1_nv ed_fsp_2of20_.ff_laa_f_ber_b1_nv ed_fsp_2of20_.ff_laa_f_ber_b2_nv ed_fsp_2of20_.ff_lam_reg_b1_nv ed_fsp_2of20_.ff_lam_reg_b2_nv ed_fsp_2of20_.ff_lam_reg_f_b1_nv ed_fsp_2of20_.ff_lam_reg_f_b2_nv ed_fsp_2of20_.ff_ml_ges_nv ed_fsp_2of20_.ff_n_nv ed_fsp_2of20_.ff_p_code_nv ed_fsp_2of20_.ff_pks_ist_nv ed_fsp_2of20_.ff_rf_m_nv ed_fsp_2of20_.ff_sl_st_nv ed_fsp_2of20_.ff_tan_m_nv ed_fsp_2of20_.ff_tmot_nv ed_fsp_2of20_.ff_tz1_nv ed_fsp_2of20_.ff_v_vorne_nv ed_fsp_2of20_.haeufigkeitszaehler_nv ed_fsp_2of20_.inj_fehlerzaehler_nv ed_fsp_2of20_.logistikzaehler_nv ed_fsp_2of20_.mil_filter_nv ed_fsp_2of20_.mil_filter_scdn_nv ed_fsp_2of20_.scdn_nenner_nv ed_fsp_2of20_.scdn_zaehler_nv ed_fsp_2of20_.uw_satz_1of3_.uw_km_stand_nv ed_fsp_2of20_.uw_satz_1of3_.uw_wert_nv_1of4_ ed_fsp_2of20_.uw_satz_1of3_.uw_wert_nv_2of4_ ed_fsp_2of20_.uw_satz_1of3_.uw_wert_nv_3of4_ ed_fsp_2of20_.uw_satz_1of3_.uw_wert_nv_4of4_ ed_fsp_2of20_.uw_satz_2of3_.uw_km_stand_nv ed_fsp_2of20_.uw_satz_2of3_.uw_wert_nv_1of4_ ed_fsp_2of20_.uw_satz_2of3_.uw_wert_nv_2of4_ ed_fsp_2of20_.uw_satz_2of3_.uw_wert_nv_3of4_ ed_fsp_2of20_.uw_satz_2of3_.uw_wert_nv_4of4_ ed_fsp_2of20_.uw_satz_3of3_.uw_km_stand_nv ed_fsp_2of20_.uw_satz_3of3_.uw_wert_nv_1of4_ ed_fsp_2of20_.uw_satz_3of3_.uw_wert_nv_2of4_ ed_fsp_2of20_.uw_satz_3of3_.uw_wert_nv_3of4_ ed_fsp_2of20_.uw_satz_3of3_.uw_wert_nv_4of4_ ed_fsp_3of20_.ed_fil_index_nv ed_fsp_3of20_.fehlerart_nv ed_fsp_3of20_.fehlercode_nv ed_fsp_3of20_.ff_egas_ist_dk_b1_nv ed_fsp_3of20_.ff_laa_f_ber_b1_nv ed_fsp_3of20_.ff_laa_f_ber_b2_nv ed_fsp_3of20_.ff_lam_reg_b1_nv ed_fsp_3of20_.ff_lam_reg_b2_nv ed_fsp_3of20_.ff_lam_reg_f_b1_nv ed_fsp_3of20_.ff_lam_reg_f_b2_nv ed_fsp_3of20_.ff_ml_ges_nv ed_fsp_3of20_.ff_n_nv ed_fsp_3of20_.ff_p_code_nv ed_fsp_3of20_.ff_pks_ist_nv ed_fsp_3of20_.ff_rf_m_nv ed_fsp_3of20_.ff_sl_st_nv ed_fsp_3of20_.ff_tan_m_nv ed_fsp_3of20_.ff_tmot_nv ed_fsp_3of20_.ff_tz1_nv ed_fsp_3of20_.ff_v_vorne_nv ed_fsp_3of20_.haeufigkeitszaehler_nv ed_fsp_3of20_.inj_fehlerzaehler_nv ed_fsp_3of20_.logistikzaehler_nv ed_fsp_3of20_.mil_filter_nv ed_fsp_3of20_.mil_filter_scdn_nv ed_fsp_3of20_.scdn_nenner_nv ed_fsp_3of20_.scdn_zaehler_nv ed_fsp_3of20_.uw_satz_1of3_.uw_km_stand_nv ed_fsp_3of20_.uw_satz_1of3_.uw_wert_nv_1of4_ ed_fsp_3of20_.uw_satz_1of3_.uw_wert_nv_2of4_ ed_fsp_3of20_.uw_satz_1of3_.uw_wert_nv_3of4_ ed_fsp_3of20_.uw_satz_1of3_.uw_wert_nv_4of4_ ed_fsp_3of20_.uw_satz_2of3_.uw_km_stand_nv ed_fsp_3of20_.uw_satz_2of3_.uw_wert_nv_1of4_ ed_fsp_3of20_.uw_satz_2of3_.uw_wert_nv_2of4_ ed_fsp_3of20_.uw_satz_2of3_.uw_wert_nv_3of4_ ed_fsp_3of20_.uw_satz_2of3_.uw_wert_nv_4of4_ ed_fsp_3of20_.uw_satz_3of3_.uw_km_stand_nv ed_fsp_3of20_.uw_satz_3of3_.uw_wert_nv_1of4_ ed_fsp_3of20_.uw_satz_3of3_.uw_wert_nv_2of4_ ed_fsp_3of20_.uw_satz_3of3_.uw_wert_nv_3of4_ ed_fsp_3of20_.uw_satz_3of3_.uw_wert_nv_4of4_ ed_fsp_4of20_.ed_fil_index_nv ed_fsp_4of20_.fehlerart_nv ed_fsp_4of20_.fehlercode_nv ed_fsp_4of20_.ff_egas_ist_dk_b1_nv ed_fsp_4of20_.ff_laa_f_ber_b1_nv ed_fsp_4of20_.ff_laa_f_ber_b2_nv ed_fsp_4of20_.ff_lam_reg_b1_nv ed_fsp_4of20_.ff_lam_reg_b2_nv ed_fsp_4of20_.ff_lam_reg_f_b1_nv ed_fsp_4of20_.ff_lam_reg_f_b2_nv ed_fsp_4of20_.ff_ml_ges_nv ed_fsp_4of20_.ff_n_nv ed_fsp_4of20_.ff_p_code_nv ed_fsp_4of20_.ff_pks_ist_nv ed_fsp_4of20_.ff_rf_m_nv ed_fsp_4of20_.ff_sl_st_nv ed_fsp_4of20_.ff_tan_m_nv ed_fsp_4of20_.ff_tmot_nv ed_fsp_4of20_.ff_tz1_nv ed_fsp_4of20_.ff_v_vorne_nv ed_fsp_4of20_.haeufigkeitszaehler_nv ed_fsp_4of20_.inj_fehlerzaehler_nv ed_fsp_4of20_.logistikzaehler_nv ed_fsp_4of20_.mil_filter_nv ed_fsp_4of20_.mil_filter_scdn_nv ed_fsp_4of20_.scdn_nenner_nv ed_fsp_4of20_.scdn_zaehler_nv ed_fsp_4of20_.uw_satz_1of3_.uw_km_stand_nv ed_fsp_4of20_.uw_satz_1of3_.uw_wert_nv_1of4_ ed_fsp_4of20_.uw_satz_1of3_.uw_wert_nv_2of4_ ed_fsp_4of20_.uw_satz_1of3_.uw_wert_nv_3of4_ ed_fsp_4of20_.uw_satz_1of3_.uw_wert_nv_4of4_ ed_fsp_4of20_.uw_satz_2of3_.uw_km_stand_nv ed_fsp_4of20_.uw_satz_2of3_.uw_wert_nv_1of4_ ed_fsp_4of20_.uw_satz_2of3_.uw_wert_nv_2of4_ ed_fsp_4of20_.uw_satz_2of3_.uw_wert_nv_3of4_ ed_fsp_4of20_.uw_satz_2of3_.uw_wert_nv_4of4_ ed_fsp_4of20_.uw_satz_3of3_.uw_km_stand_nv ed_fsp_4of20_.uw_satz_3of3_.uw_wert_nv_1of4_ ed_fsp_4of20_.uw_satz_3of3_.uw_wert_nv_2of4_ ed_fsp_4of20_.uw_satz_3of3_.uw_wert_nv_3of4_ ed_fsp_4of20_.uw_satz_3of3_.uw_wert_nv_4of4_ ed_fsp_5of20_.ed_fil_index_nv ed_fsp_5of20_.fehlerart_nv ed_fsp_5of20_.fehlercode_nv ed_fsp_5of20_.ff_egas_ist_dk_b1_nv ed_fsp_5of20_.ff_laa_f_ber_b1_nv ed_fsp_5of20_.ff_laa_f_ber_b2_nv ed_fsp_5of20_.ff_lam_reg_b1_nv ed_fsp_5of20_.ff_lam_reg_b2_nv ed_fsp_5of20_.ff_lam_reg_f_b1_nv ed_fsp_5of20_.ff_lam_reg_f_b2_nv ed_fsp_5of20_.ff_ml_ges_nv ed_fsp_5of20_.ff_n_nv ed_fsp_5of20_.ff_p_code_nv ed_fsp_5of20_.ff_pks_ist_nv ed_fsp_5of20_.ff_rf_m_nv ed_fsp_5of20_.ff_sl_st_nv ed_fsp_5of20_.ff_tan_m_nv ed_fsp_5of20_.ff_tmot_nv ed_fsp_5of20_.ff_tz1_nv ed_fsp_5of20_.ff_v_vorne_nv ed_fsp_5of20_.haeufigkeitszaehler_nv ed_fsp_5of20_.inj_fehlerzaehler_nv ed_fsp_5of20_.logistikzaehler_nv ed_fsp_5of20_.mil_filter_nv ed_fsp_5of20_.mil_filter_scdn_nv ed_fsp_5of20_.scdn_nenner_nv ed_fsp_5of20_.scdn_zaehler_nv ed_fsp_5of20_.uw_satz_1of3_.uw_km_stand_nv ed_fsp_5of20_.uw_satz_1of3_.uw_wert_nv_1of4_ ed_fsp_5of20_.uw_satz_1of3_.uw_wert_nv_2of4_ ed_fsp_5of20_.uw_satz_1of3_.uw_wert_nv_3of4_ ed_fsp_5of20_.uw_satz_1of3_.uw_wert_nv_4of4_ ed_fsp_5of20_.uw_satz_2of3_.uw_km_stand_nv ed_fsp_5of20_.uw_satz_2of3_.uw_wert_nv_1of4_ ed_fsp_5of20_.uw_satz_2of3_.uw_wert_nv_2of4_ ed_fsp_5of20_.uw_satz_2of3_.uw_wert_nv_3of4_ ed_fsp_5of20_.uw_satz_2of3_.uw_wert_nv_4of4_ ed_fsp_5of20_.uw_satz_3of3_.uw_km_stand_nv ed_fsp_5of20_.uw_satz_3of3_.uw_wert_nv_1of4_ ed_fsp_5of20_.uw_satz_3of3_.uw_wert_nv_2of4_ ed_fsp_5of20_.uw_satz_3of3_.uw_wert_nv_3of4_ ed_fsp_5of20_.uw_satz_3of3_.uw_wert_nv_4of4_ ed_fsp_6of20_.ed_fil_index_nv ed_fsp_6of20_.fehlerart_nv ed_fsp_6of20_.fehlercode_nv ed_fsp_6of20_.ff_egas_ist_dk_b1_nv ed_fsp_6of20_.ff_laa_f_ber_b1_nv ed_fsp_6of20_.ff_laa_f_ber_b2_nv ed_fsp_6of20_.ff_lam_reg_b1_nv ed_fsp_6of20_.ff_lam_reg_b2_nv ed_fsp_6of20_.ff_lam_reg_f_b1_nv ed_fsp_6of20_.ff_lam_reg_f_b2_nv ed_fsp_6of20_.ff_ml_ges_nv ed_fsp_6of20_.ff_n_nv ed_fsp_6of20_.ff_p_code_nv ed_fsp_6of20_.ff_pks_ist_nv ed_fsp_6of20_.ff_rf_m_nv ed_fsp_6of20_.ff_sl_st_nv ed_fsp_6of20_.ff_tan_m_nv ed_fsp_6of20_.ff_tmot_nv ed_fsp_6of20_.ff_tz1_nv ed_fsp_6of20_.ff_v_vorne_nv ed_fsp_6of20_.haeufigkeitszaehler_nv ed_fsp_6of20_.inj_fehlerzaehler_nv ed_fsp_6of20_.logistikzaehler_nv ed_fsp_6of20_.mil_filter_nv ed_fsp_6of20_.mil_filter_scdn_nv ed_fsp_6of20_.scdn_nenner_nv ed_fsp_6of20_.scdn_zaehler_nv ed_fsp_6of20_.uw_satz_1of3_.uw_km_stand_nv ed_fsp_6of20_.uw_satz_1of3_.uw_wert_nv_1of4_ ed_fsp_6of20_.uw_satz_1of3_.uw_wert_nv_2of4_ ed_fsp_6of20_.uw_satz_1of3_.uw_wert_nv_3of4_ ed_fsp_6of20_.uw_satz_1of3_.uw_wert_nv_4of4_ ed_fsp_6of20_.uw_satz_2of3_.uw_km_stand_nv ed_fsp_6of20_.uw_satz_2of3_.uw_wert_nv_1of4_ ed_fsp_6of20_.uw_satz_2of3_.uw_wert_nv_2of4_ ed_fsp_6of20_.uw_satz_2of3_.uw_wert_nv_3of4_ ed_fsp_6of20_.uw_satz_2of3_.uw_wert_nv_4of4_ ed_fsp_6of20_.uw_satz_3of3_.uw_km_stand_nv ed_fsp_6of20_.uw_satz_3of3_.uw_wert_nv_1of4_ ed_fsp_6of20_.uw_satz_3of3_.uw_wert_nv_2of4_ ed_fsp_6of20_.uw_satz_3of3_.uw_wert_nv_3of4_ ed_fsp_6of20_.uw_satz_3of3_.uw_wert_nv_4of4_ ed_fsp_7of20_.ed_fil_index_nv ed_fsp_7of20_.fehlerart_nv ed_fsp_7of20_.fehlercode_nv ed_fsp_7of20_.ff_egas_ist_dk_b1_nv ed_fsp_7of20_.ff_laa_f_ber_b1_nv ed_fsp_7of20_.ff_laa_f_ber_b2_nv ed_fsp_7of20_.ff_lam_reg_b1_nv ed_fsp_7of20_.ff_lam_reg_b2_nv ed_fsp_7of20_.ff_lam_reg_f_b1_nv ed_fsp_7of20_.ff_lam_reg_f_b2_nv ed_fsp_7of20_.ff_ml_ges_nv ed_fsp_7of20_.ff_n_nv ed_fsp_7of20_.ff_p_code_nv ed_fsp_7of20_.ff_pks_ist_nv ed_fsp_7of20_.ff_rf_m_nv ed_fsp_7of20_.ff_sl_st_nv ed_fsp_7of20_.ff_tan_m_nv ed_fsp_7of20_.ff_tmot_nv ed_fsp_7of20_.ff_tz1_nv ed_fsp_7of20_.ff_v_vorne_nv ed_fsp_7of20_.haeufigkeitszaehler_nv ed_fsp_7of20_.inj_fehlerzaehler_nv ed_fsp_7of20_.logistikzaehler_nv ed_fsp_7of20_.mil_filter_nv ed_fsp_7of20_.mil_filter_scdn_nv ed_fsp_7of20_.scdn_nenner_nv ed_fsp_7of20_.scdn_zaehler_nv ed_fsp_7of20_.uw_satz_1of3_.uw_km_stand_nv ed_fsp_7of20_.uw_satz_1of3_.uw_wert_nv_1of4_ ed_fsp_7of20_.uw_satz_1of3_.uw_wert_nv_2of4_ ed_fsp_7of20_.uw_satz_1of3_.uw_wert_nv_3of4_ ed_fsp_7of20_.uw_satz_1of3_.uw_wert_nv_4of4_ ed_fsp_7of20_.uw_satz_2of3_.uw_km_stand_nv ed_fsp_7of20_.uw_satz_2of3_.uw_wert_nv_1of4_ ed_fsp_7of20_.uw_satz_2of3_.uw_wert_nv_2of4_ ed_fsp_7of20_.uw_satz_2of3_.uw_wert_nv_3of4_ ed_fsp_7of20_.uw_satz_2of3_.uw_wert_nv_4of4_ ed_fsp_7of20_.uw_satz_3of3_.uw_km_stand_nv ed_fsp_7of20_.uw_satz_3of3_.uw_wert_nv_1of4_ ed_fsp_7of20_.uw_satz_3of3_.uw_wert_nv_2of4_ ed_fsp_7of20_.uw_satz_3of3_.uw_wert_nv_3of4_ ed_fsp_7of20_.uw_satz_3of3_.uw_wert_nv_4of4_ ed_fsp_8of20_.ed_fil_index_nv ed_fsp_8of20_.fehlerart_nv ed_fsp_8of20_.fehlercode_nv ed_fsp_8of20_.ff_egas_ist_dk_b1_nv ed_fsp_8of20_.ff_laa_f_ber_b1_nv ed_fsp_8of20_.ff_laa_f_ber_b2_nv ed_fsp_8of20_.ff_lam_reg_b1_nv ed_fsp_8of20_.ff_lam_reg_b2_nv ed_fsp_8of20_.ff_lam_reg_f_b1_nv ed_fsp_8of20_.ff_lam_reg_f_b2_nv ed_fsp_8of20_.ff_ml_ges_nv ed_fsp_8of20_.ff_n_nv ed_fsp_8of20_.ff_p_code_nv ed_fsp_8of20_.ff_pks_ist_nv ed_fsp_8of20_.ff_rf_m_nv ed_fsp_8of20_.ff_sl_st_nv ed_fsp_8of20_.ff_tan_m_nv ed_fsp_8of20_.ff_tmot_nv ed_fsp_8of20_.ff_tz1_nv ed_fsp_8of20_.ff_v_vorne_nv ed_fsp_8of20_.haeufigkeitszaehler_nv ed_fsp_8of20_.inj_fehlerzaehler_nv ed_fsp_8of20_.logistikzaehler_nv ed_fsp_8of20_.mil_filter_nv ed_fsp_8of20_.mil_filter_scdn_nv ed_fsp_8of20_.scdn_nenner_nv ed_fsp_8of20_.scdn_zaehler_nv ed_fsp_8of20_.uw_satz_1of3_.uw_km_stand_nv ed_fsp_8of20_.uw_satz_1of3_.uw_wert_nv_1of4_ ed_fsp_8of20_.uw_satz_1of3_.uw_wert_nv_2of4_ ed_fsp_8of20_.uw_satz_1of3_.uw_wert_nv_3of4_ ed_fsp_8of20_.uw_satz_1of3_.uw_wert_nv_4of4_ ed_fsp_8of20_.uw_satz_2of3_.uw_km_stand_nv ed_fsp_8of20_.uw_satz_2of3_.uw_wert_nv_1of4_ ed_fsp_8of20_.uw_satz_2of3_.uw_wert_nv_2of4_ ed_fsp_8of20_.uw_satz_2of3_.uw_wert_nv_3of4_ ed_fsp_8of20_.uw_satz_2of3_.uw_wert_nv_4of4_ ed_fsp_8of20_.uw_satz_3of3_.uw_km_stand_nv ed_fsp_8of20_.uw_satz_3of3_.uw_wert_nv_1of4_ ed_fsp_8of20_.uw_satz_3of3_.uw_wert_nv_2of4_ ed_fsp_8of20_.uw_satz_3of3_.uw_wert_nv_3of4_ ed_fsp_8of20_.uw_satz_3of3_.uw_wert_nv_4of4_ ed_fsp_9of20_.ed_fil_index_nv ed_fsp_9of20_.fehlerart_nv ed_fsp_9of20_.fehlercode_nv ed_fsp_9of20_.ff_egas_ist_dk_b1_nv ed_fsp_9of20_.ff_laa_f_ber_b1_nv ed_fsp_9of20_.ff_laa_f_ber_b2_nv ed_fsp_9of20_.ff_lam_reg_b1_nv ed_fsp_9of20_.ff_lam_reg_b2_nv ed_fsp_9of20_.ff_lam_reg_f_b1_nv ed_fsp_9of20_.ff_lam_reg_f_b2_nv ed_fsp_9of20_.ff_ml_ges_nv ed_fsp_9of20_.ff_n_nv ed_fsp_9of20_.ff_p_code_nv ed_fsp_9of20_.ff_pks_ist_nv ed_fsp_9of20_.ff_rf_m_nv ed_fsp_9of20_.ff_sl_st_nv ed_fsp_9of20_.ff_tan_m_nv ed_fsp_9of20_.ff_tmot_nv ed_fsp_9of20_.ff_tz1_nv ed_fsp_9of20_.ff_v_vorne_nv ed_fsp_9of20_.haeufigkeitszaehler_nv ed_fsp_9of20_.inj_fehlerzaehler_nv ed_fsp_9of20_.logistikzaehler_nv ed_fsp_9of20_.mil_filter_nv ed_fsp_9of20_.mil_filter_scdn_nv ed_fsp_9of20_.scdn_nenner_nv ed_fsp_9of20_.scdn_zaehler_nv ed_fsp_9of20_.uw_satz_1of3_.uw_km_stand_nv ed_fsp_9of20_.uw_satz_1of3_.uw_wert_nv_1of4_ ed_fsp_9of20_.uw_satz_1of3_.uw_wert_nv_2of4_ ed_fsp_9of20_.uw_satz_1of3_.uw_wert_nv_3of4_ ed_fsp_9of20_.uw_satz_1of3_.uw_wert_nv_4of4_ ed_fsp_9of20_.uw_satz_2of3_.uw_km_stand_nv ed_fsp_9of20_.uw_satz_2of3_.uw_wert_nv_1of4_ ed_fsp_9of20_.uw_satz_2of3_.uw_wert_nv_2of4_ ed_fsp_9of20_.uw_satz_2of3_.uw_wert_nv_3of4_ ed_fsp_9of20_.uw_satz_2of3_.uw_wert_nv_4of4_ ed_fsp_9of20_.uw_satz_3of3_.uw_km_stand_nv ed_fsp_9of20_.uw_satz_3of3_.uw_wert_nv_1of4_ ed_fsp_9of20_.uw_satz_3of3_.uw_wert_nv_2of4_ ed_fsp_9of20_.uw_satz_3of3_.uw_wert_nv_3of4_ ed_fsp_9of20_.uw_satz_3of3_.uw_wert_nv_4of4_ ed_loeschen ed_mil_bmw_ign ed_mil_bmw_inj ed_mil_dme_ign ed_mil_dme_inj ed_mil_on_km_stand_nv ed_mil_predrive_ign ed_mil_predrive_inj ed_mil_smg_ign ed_mil_st_ign ed_mil_st_inj ed_mil_zyl_off_ign ed_rbm_appl_data_inj.denominator_nv ed_rbm_appl_data_inj.numerator_nv ed_rbm_codierung.denominator_nv ed_rbm_codierung.numerator_nv ed_rbm_denominator_nv ed_rbm_dk1_enltg.denominator_nv ed_rbm_dk1_enltg.numerator_nv ed_rbm_dk2_enltg.denominator_nv ed_rbm_dk2_enltg.numerator_nv ed_rbm_dmtl_deckel.denominator_nv ed_rbm_dmtl_deckel.numerator_nv ed_rbm_dmtl_feinleck.denominator_nv ed_rbm_dmtl_feinleck.numerator_nv ed_rbm_dmtl_feucht.denominator_nv ed_rbm_dmtl_feucht.numerator_nv ed_rbm_dmtl_grobleck.denominator_nv ed_rbm_dmtl_grobleck.numerator_nv ed_rbm_dmtl_h.denominator_nv ed_rbm_dmtl_h.numerator_nv ed_rbm_dmtl_p.denominator_nv ed_rbm_dmtl_p.numerator_nv ed_rbm_dmtl_v.denominator_nv ed_rbm_dmtl_v.numerator_nv ed_rbm_e2_inj.denominator_nv ed_rbm_e2_inj.numerator_nv ed_rbm_ebox_elu.denominator_nv ed_rbm_ebox_elu.numerator_nv ed_rbm_ekp_pwm.denominator_nv ed_rbm_ekp_pwm.numerator_nv ed_rbm_elu.denominator_nv ed_rbm_elu.numerator_nv ed_rbm_elup.denominator_nv ed_rbm_elup.numerator_nv ed_rbm_ev1.denominator_nv ed_rbm_ev1.numerator_nv ed_rbm_ev10.denominator_nv ed_rbm_ev10.numerator_nv ed_rbm_ev2.denominator_nv ed_rbm_ev2.numerator_nv ed_rbm_ev3.denominator_nv ed_rbm_ev3.numerator_nv ed_rbm_ev4.denominator_nv ed_rbm_ev4.numerator_nv ed_rbm_ev5.denominator_nv ed_rbm_ev5.numerator_nv ed_rbm_ev6.denominator_nv ed_rbm_ev6.numerator_nv ed_rbm_ev7.denominator_nv ed_rbm_ev7.numerator_nv ed_rbm_ev8.denominator_nv ed_rbm_ev8.numerator_nv ed_rbm_ev9.denominator_nv ed_rbm_ev9.numerator_nv ed_rbm_ews_man.denominator_nv ed_rbm_ews_man.numerator_nv ed_rbm_ews_sci.denominator_nv ed_rbm_ews_sci.numerator_nv ed_rbm_fetrawe.denominator_nv ed_rbm_fetrawe.numerator_nv ed_rbm_fi_bsd.denominator_nv ed_rbm_fi_bsd.numerator_nv ed_rbm_fi_bsd_0.denominator_nv ed_rbm_fi_bsd_0.numerator_nv ed_rbm_fi_bsd_6.denominator_nv ed_rbm_fi_bsd_6.numerator_nv ed_rbm_fi_bsdglob.denominator_nv ed_rbm_fi_bsdglob.numerator_nv ed_rbm_fi_gen.denominator_nv ed_rbm_fi_gen.numerator_nv ed_rbm_fi_ibs1.denominator_nv ed_rbm_fi_ibs1.numerator_nv ed_rbm_fi_ibs2.denominator_nv ed_rbm_fi_ibs2.numerator_nv ed_rbm_fi_ibs3.denominator_nv ed_rbm_fi_ibs3.numerator_nv ed_rbm_fi_pmbatt.denominator_nv ed_rbm_fi_pmbatt.numerator_nv ed_rbm_fi_pmbn.denominator_nv ed_rbm_fi_pmbn.numerator_nv ed_rbm_fi_pmruhverl.denominator_nv ed_rbm_fi_pmruhverl.numerator_nv ed_rbm_fi_qlt.denominator_nv ed_rbm_fi_qlt.numerator_nv ed_rbm_fi_toens.denominator_nv ed_rbm_fi_toens.numerator_nv ed_rbm_fplau1.denominator_nv ed_rbm_fplau1.numerator_nv ed_rbm_fplau2.denominator_nv ed_rbm_fplau2.numerator_nv ed_rbm_fst.denominator_nv ed_rbm_fst.numerator_nv ed_rbm_fst_geber.denominator_nv ed_rbm_fst_geber.numerator_nv ed_rbm_hfm1.denominator_nv ed_rbm_hfm1.numerator_nv ed_rbm_hfm2.denominator_nv ed_rbm_hfm2.numerator_nv ed_rbm_index_135_inj.denominator_nv ed_rbm_index_135_inj.numerator_nv ed_rbm_index_15_inj.denominator_nv ed_rbm_index_15_inj.numerator_nv ed_rbm_index_196_inj.denominator_nv ed_rbm_index_196_inj.numerator_nv ed_rbm_index_197_inj.denominator_nv ed_rbm_index_197_inj.numerator_nv ed_rbm_index_198_inj.denominator_nv ed_rbm_index_198_inj.numerator_nv ed_rbm_index_199_inj.denominator_nv ed_rbm_index_199_inj.numerator_nv ed_rbm_index_200_inj.denominator_nv ed_rbm_index_200_inj.numerator_nv ed_rbm_index_201_inj.denominator_nv ed_rbm_index_201_inj.numerator_nv ed_rbm_index_202_inj.denominator_nv ed_rbm_index_202_inj.numerator_nv ed_rbm_index_203_inj.denominator_nv ed_rbm_index_203_inj.numerator_nv ed_rbm_index_204_inj.denominator_nv ed_rbm_index_204_inj.numerator_nv ed_rbm_index_205_inj.denominator_nv ed_rbm_index_205_inj.numerator_nv ed_rbm_index_206_inj.denominator_nv ed_rbm_index_206_inj.numerator_nv ed_rbm_index_207_inj.denominator_nv ed_rbm_index_207_inj.numerator_nv ed_rbm_index_208_inj.denominator_nv ed_rbm_index_208_inj.numerator_nv ed_rbm_index_209_inj.denominator_nv ed_rbm_index_209_inj.numerator_nv ed_rbm_index_210_inj.denominator_nv ed_rbm_index_210_inj.numerator_nv ed_rbm_index_211_inj.denominator_nv ed_rbm_index_211_inj.numerator_nv ed_rbm_index_212_inj.denominator_nv ed_rbm_index_212_inj.numerator_nv ed_rbm_index_213_inj.denominator_nv ed_rbm_index_213_inj.numerator_nv ed_rbm_index_214_inj.denominator_nv ed_rbm_index_214_inj.numerator_nv ed_rbm_index_215_inj.denominator_nv ed_rbm_index_215_inj.numerator_nv ed_rbm_index_216_inj.denominator_nv ed_rbm_index_216_inj.numerator_nv ed_rbm_index_217_inj.denominator_nv ed_rbm_index_217_inj.numerator_nv ed_rbm_index_218_inj.denominator_nv ed_rbm_index_218_inj.numerator_nv ed_rbm_index_219_inj.denominator_nv ed_rbm_index_219_inj.numerator_nv ed_rbm_index_220_inj.denominator_nv ed_rbm_index_220_inj.numerator_nv ed_rbm_index_221_inj.denominator_nv ed_rbm_index_221_inj.numerator_nv ed_rbm_index_222_inj.denominator_nv ed_rbm_index_222_inj.numerator_nv ed_rbm_index_223_inj.denominator_nv ed_rbm_index_223_inj.numerator_nv ed_rbm_kat_obd1.denominator_nv ed_rbm_kat_obd1.numerator_nv ed_rbm_kat_obd2.denominator_nv ed_rbm_kat_obd2.numerator_nv ed_rbm_kats_b1.denominator_nv ed_rbm_kats_b1.numerator_nv ed_rbm_kats_b2.denominator_nv ed_rbm_kats_b2.numerator_nv ed_rbm_kge1.denominator_nv ed_rbm_kge1.numerator_nv ed_rbm_kge2.denominator_nv ed_rbm_kge2.numerator_nv ed_rbm_ksd1.denominator_nv ed_rbm_ksd1.numerator_nv ed_rbm_ksd2.denominator_nv ed_rbm_ksd2.numerator_nv ed_rbm_kw.denominator_nv ed_rbm_kw.numerator_nv ed_rbm_la1_adapt.denominator_nv ed_rbm_la1_adapt.numerator_nv ed_rbm_la1_trim_ad.denominator_nv ed_rbm_la1_trim_ad.numerator_nv ed_rbm_la2_adapt.denominator_nv ed_rbm_la2_adapt.numerator_nv ed_rbm_la2_trim_ad.denominator_nv ed_rbm_la2_trim_ad.numerator_nv ed_rbm_lam1_reg.denominator_nv ed_rbm_lam1_reg.numerator_nv ed_rbm_lam2_reg.denominator_nv ed_rbm_lam2_reg.numerator_nv ed_rbm_lank1.denominator_nv ed_rbm_lank1.numerator_nv ed_rbm_lank1_obd_s.denominator_nv ed_rbm_lank1_obd_s.numerator_nv ed_rbm_lank1_obd_we.denominator_nv ed_rbm_lank1_obd_we.numerator_nv ed_rbm_lank1_openload.denominator_nv ed_rbm_lank1_openload.numerator_nv ed_rbm_lank2.denominator_nv ed_rbm_lank2.numerator_nv ed_rbm_lank2_obd_s.denominator_nv ed_rbm_lank2_obd_s.numerator_nv ed_rbm_lank2_obd_we.denominator_nv ed_rbm_lank2_obd_we.numerator_nv ed_rbm_lank2_openload.denominator_nv ed_rbm_lank2_openload.numerator_nv ed_rbm_lavk_atic42.denominator_nv ed_rbm_lavk_atic42.numerator_nv ed_rbm_lavk1.denominator_nv ed_rbm_lavk1.numerator_nv ed_rbm_lavk1_diag.denominator_nv ed_rbm_lavk1_diag.numerator_nv ed_rbm_lavk1_ia_openload.denominator_nv ed_rbm_lavk1_ia_openload.numerator_nv ed_rbm_lavk1_ip_openload.denominator_nv ed_rbm_lavk1_ip_openload.numerator_nv ed_rbm_lavk1_obd_dyn.denominator_nv ed_rbm_lavk1_obd_dyn.numerator_nv ed_rbm_lavk1_obd_plau.denominator_nv ed_rbm_lavk1_obd_plau.numerator_nv ed_rbm_lavk1_obd_sa.denominator_nv ed_rbm_lavk1_obd_sa.numerator_nv ed_rbm_lavk1_obd_tl.denominator_nv ed_rbm_lavk1_obd_tl.numerator_nv ed_rbm_lavk1_trim.denominator_nv ed_rbm_lavk1_trim.numerator_nv ed_rbm_lavk1_un_openload.denominator_nv ed_rbm_lavk1_un_openload.numerator_nv ed_rbm_lavk2.denominator_nv ed_rbm_lavk2.numerator_nv ed_rbm_lavk2_diag.denominator_nv ed_rbm_lavk2_diag.numerator_nv ed_rbm_lavk2_ia_openload.denominator_nv ed_rbm_lavk2_ia_openload.numerator_nv ed_rbm_lavk2_ip_openload.denominator_nv ed_rbm_lavk2_ip_openload.numerator_nv ed_rbm_lavk2_obd_dyn.denominator_nv ed_rbm_lavk2_obd_dyn.numerator_nv ed_rbm_lavk2_obd_plau.denominator_nv ed_rbm_lavk2_obd_plau.numerator_nv ed_rbm_lavk2_obd_sa.denominator_nv ed_rbm_lavk2_obd_sa.numerator_nv ed_rbm_lavk2_obd_tl.denominator_nv ed_rbm_lavk2_obd_tl.numerator_nv ed_rbm_lavk2_trim.denominator_nv ed_rbm_lavk2_trim.numerator_nv ed_rbm_lavk2_un_openload.denominator_nv ed_rbm_lavk2_un_openload.numerator_nv ed_rbm_lshnk1.denominator_nv ed_rbm_lshnk1.numerator_nv ed_rbm_lshnk1_r.denominator_nv ed_rbm_lshnk1_r.numerator_nv ed_rbm_lshnk2.denominator_nv ed_rbm_lshnk2.numerator_nv ed_rbm_lshnk2_r.denominator_nv ed_rbm_lshnk2_r.numerator_nv ed_rbm_lshvk1.denominator_nv ed_rbm_lshvk1.numerator_nv ed_rbm_lshvk1_r.denominator_nv ed_rbm_lshvk1_r.numerator_nv ed_rbm_lshvk2.denominator_nv ed_rbm_lshvk2.numerator_nv ed_rbm_lshvk2_r.denominator_nv ed_rbm_lshvk2_r.numerator_nv ed_rbm_lsrvk1_obd_ref.denominator_nv ed_rbm_lsrvk1_obd_ref.numerator_nv ed_rbm_lsrvk1_obd_reg.denominator_nv ed_rbm_lsrvk1_obd_reg.numerator_nv ed_rbm_lsrvk1_obd_start.denominator_nv ed_rbm_lsrvk1_obd_start.numerator_nv ed_rbm_lsrvk2_obd_ref.denominator_nv ed_rbm_lsrvk2_obd_ref.numerator_nv ed_rbm_lsrvk2_obd_reg.denominator_nv ed_rbm_lsrvk2_obd_reg.numerator_nv ed_rbm_lsrvk2_obd_start.denominator_nv ed_rbm_lsrvk2_obd_start.numerator_nv ed_rbm_mvac_drucksensor.denominator_nv ed_rbm_mvac_drucksensor.numerator_nv ed_rbm_nw_sync.denominator_nv ed_rbm_nw_sync.numerator_nv ed_rbm_pctrl_inj.denominator_nv ed_rbm_pctrl_inj.numerator_nv ed_rbm_pks.denominator_nv ed_rbm_pks.numerator_nv ed_rbm_pks_adapt_anschl.denominator_nv ed_rbm_pks_adapt_anschl.numerator_nv ed_rbm_pks_ll.denominator_nv ed_rbm_pks_ll.numerator_nv ed_rbm_pks_modell.denominator_nv ed_rbm_pks_modell.numerator_nv ed_rbm_pks_paufbau.denominator_nv ed_rbm_pks_paufbau.numerator_nv ed_rbm_pks_q.denominator_nv ed_rbm_pks_q.numerator_nv ed_rbm_pks_tl.denominator_nv ed_rbm_pks_tl.numerator_nv ed_rbm_psau1.denominator_nv ed_rbm_psau1.numerator_nv ed_rbm_psau2.denominator_nv ed_rbm_psau2.numerator_nv ed_rbm_pt_anfradmom.denominator_nv ed_rbm_pt_anfradmom.numerator_nv ed_rbm_pt_atemp.denominator_nv ed_rbm_pt_atemp.numerator_nv ed_rbm_pt_ax.denominator_nv ed_rbm_pt_ax.numerator_nv ed_rbm_pt_bedat.denominator_nv ed_rbm_pt_bedat.numerator_nv ed_rbm_pt_bedfgr.denominator_nv ed_rbm_pt_bedfgr.numerator_nv ed_rbm_pt_busoff.denominator_nv ed_rbm_pt_busoff.numerator_nv ed_rbm_pt_crash.denominator_nv ed_rbm_pt_crash.numerator_nv ed_rbm_pt_grb.denominator_nv ed_rbm_pt_grb.numerator_nv ed_rbm_pt_grb2.denominator_nv ed_rbm_pt_grb2.numerator_nv ed_rbm_pt_grb3.denominator_nv ed_rbm_pt_grb3.numerator_nv ed_rbm_pt_kkos.denominator_nv ed_rbm_pt_kkos.numerator_nv ed_rbm_pt_klst.denominator_nv ed_rbm_pt_klst.numerator_nv ed_rbm_pt_km.denominator_nv ed_rbm_pt_km.numerator_nv ed_rbm_pt_kombi.denominator_nv ed_rbm_pt_kombi.numerator_nv ed_rbm_pt_lrw.denominator_nv ed_rbm_pt_lrw.numerator_nv ed_rbm_pt_statanh.denominator_nv ed_rbm_pt_statanh.numerator_nv ed_rbm_pt_statdkg.denominator_nv ed_rbm_pt_statdkg.numerator_nv ed_rbm_pt_statr.denominator_nv ed_rbm_pt_statr.numerator_nv ed_rbm_pt_stdsc.denominator_nv ed_rbm_pt_stdsc.numerator_nv ed_rbm_pt_toma.denominator_nv ed_rbm_pt_toma.numerator_nv ed_rbm_pt_torqdsc.denominator_nv ed_rbm_pt_torqdsc.numerator_nv ed_rbm_pt_vehmod.denominator_nv ed_rbm_pt_vehmod.numerator_nv ed_rbm_pt_vfzg.denominator_nv ed_rbm_pt_vfzg.numerator_nv ed_rbm_pt_vrad.denominator_nv ed_rbm_pt_vrad.numerator_nv ed_rbm_pumg.denominator_nv ed_rbm_pumg.numerator_nv ed_rbm_pumg_obd.denominator_nv ed_rbm_pumg_obd.numerator_nv ed_rbm_rlslp.denominator_nv ed_rbm_rlslp.numerator_nv ed_rbm_rlu87.denominator_nv ed_rbm_rlu87.numerator_nv ed_rbm_s_getr_hs.denominator_nv ed_rbm_s_getr_hs.numerator_nv ed_rbm_s_kupp_hs.denominator_nv ed_rbm_s_kupp_hs.numerator_nv ed_rbm_s_poel_diag.denominator_nv ed_rbm_s_poel_diag.numerator_nv ed_rbm_sg_inj.denominator_nv ed_rbm_sg_inj.numerator_nv ed_rbm_sk_manager_inj.denominator_nv ed_rbm_sk_manager_inj.numerator_nv ed_rbm_sk_tr_inj.denominator_nv ed_rbm_sk_tr_inj.numerator_nv ed_rbm_sl_durchs_b1.denominator_nv ed_rbm_sl_durchs_b1.numerator_nv ed_rbm_sl_durchs_b2.denominator_nv ed_rbm_sl_durchs_b2.numerator_nv ed_rbm_sl_durchs_hstrang.denominator_nv ed_rbm_sl_durchs_hstrang.numerator_nv ed_rbm_sl_ml_hfm.denominator_nv ed_rbm_sl_ml_hfm.numerator_nv ed_rbm_sl_ml_hfm_obd.denominator_nv ed_rbm_sl_ml_hfm_obd.numerator_nv ed_rbm_slp.denominator_nv ed_rbm_slp.numerator_nv ed_rbm_slv.denominator_nv ed_rbm_slv.numerator_nv ed_rbm_tank_leer.denominator_nv ed_rbm_tank_leer.numerator_nv ed_rbm_td.denominator_nv ed_rbm_td.numerator_nv ed_rbm_te_obd_1.denominator_nv ed_rbm_te_obd_1.numerator_nv ed_rbm_te_obd_2.denominator_nv ed_rbm_te_obd_2.numerator_nv ed_rbm_tev1.denominator_nv ed_rbm_tev1.numerator_nv ed_rbm_tev2.denominator_nv ed_rbm_tev2.numerator_nv ed_rbm_tgetr_hs.denominator_nv ed_rbm_tgetr_hs.numerator_nv ed_rbm_time ed_rbm_time_ll ed_rbm_time_slp ed_rbm_time_v ed_rbm_tz1.denominator_nv ed_rbm_tz1.numerator_nv ed_rbm_tz10.denominator_nv ed_rbm_tz10.numerator_nv ed_rbm_tz2.denominator_nv ed_rbm_tz2.numerator_nv ed_rbm_tz3.denominator_nv ed_rbm_tz3.numerator_nv ed_rbm_tz4.denominator_nv ed_rbm_tz4.numerator_nv ed_rbm_tz5.denominator_nv ed_rbm_tz5.numerator_nv ed_rbm_tz6.denominator_nv ed_rbm_tz6.numerator_nv ed_rbm_tz7.denominator_nv ed_rbm_tz7.numerator_nv ed_rbm_tz8.denominator_nv ed_rbm_tz8.numerator_nv ed_rbm_tz9.denominator_nv ed_rbm_tz9.numerator_nv ed_rbm_van_anschl_a1.denominator_nv ed_rbm_van_anschl_a1.numerator_nv ed_rbm_van_anschl_a2.denominator_nv ed_rbm_van_anschl_a2.numerator_nv ed_rbm_van_anschl_e1.denominator_nv ed_rbm_van_anschl_e1.numerator_nv ed_rbm_van_anschl_e2.denominator_nv ed_rbm_van_anschl_e2.numerator_nv ed_rbm_van_druck.denominator_nv ed_rbm_van_druck.numerator_nv ed_rbm_van_dsv.denominator_nv ed_rbm_van_dsv.numerator_nv ed_rbm_van_hall_a1.denominator_nv ed_rbm_van_hall_a1.numerator_nv ed_rbm_van_hall_a2.denominator_nv ed_rbm_van_hall_a2.numerator_nv ed_rbm_van_hall_e1.denominator_nv ed_rbm_van_hall_e1.numerator_nv ed_rbm_van_hall_e2.denominator_nv ed_rbm_van_hall_e2.numerator_nv ed_rbm_van_regl_a1.denominator_nv ed_rbm_van_regl_a1.numerator_nv ed_rbm_van_regl_a2.denominator_nv ed_rbm_van_regl_a2.numerator_nv ed_rbm_van_regl_e1.denominator_nv ed_rbm_van_regl_e1.numerator_nv ed_rbm_van_regl_e2.denominator_nv ed_rbm_van_regl_e2.numerator_nv ed_rbm_van_vent_a1.denominator_nv ed_rbm_van_vent_a1.numerator_nv ed_rbm_van_vent_a2.denominator_nv ed_rbm_van_vent_a2.numerator_nv ed_rbm_van_vent_e1.denominator_nv ed_rbm_van_vent_e1.numerator_nv ed_rbm_van_vent_e2.denominator_nv ed_rbm_van_vent_e2.numerator_nv ed_scdn_st_nv ed_st_fehler_ign ed_st_fehler_inj ed_st_filter_ign ed_st_filter_inj ed_st_nv ed_st_nv_css_den ed_st_nv_css_num ed_st_nv_rbm_abbruch ed_st_nv_rbm_dcy ed_st_nv_rbm_evap ed_st_nv_rbm_slp ed_st_nv_wuc /end OUT_MEASUREMENT
/end FUNCTION
/begin RECORD_LAYOUT TKW_VV_VV_UB FNC_VALUES 1 UBYTE COLUMN_DIR DIRECT /end RECORD_LAYOUT
/begin RECORD_LAYOUT TKW_VV_VV_UW FNC_VALUES 1 UWORD COLUMN_DIR DIRECT /end RECORD_LAYOUT
/end MODULE
/end PROJECT
