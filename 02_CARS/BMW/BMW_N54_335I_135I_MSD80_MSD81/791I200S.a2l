ASAP2_VERSION 1 41
/begin PROJECT MSD85 "Spray Guided DI-System with Piezo Injectors for 8-Cylinder"
/begin HEADER "_default_HeaderComment" PROJECT_NO _91 /end HEADER
/begin MODULE _default_ModuleName "_default_ModuleLongIdentifier"
/begin MOD_COMMON "_default_ModCommonComment" DEPOSIT ABSOLUTE BYTE_ORDER MSB_LAST ALIGNMENT_BYTE 1 ALIGNMENT_WORD 2 ALIGNMENT_LONG 2 ALIGNMENT_FLOAT32_IEEE 2 ALIGNMENT_FLOAT64_IEEE 4 /end MOD_COMMON
/begin MEASUREMENT fmy_stat_slv_ivvt_in_1.ctr_abc "anti bounce counter for diagnosis instance SLV_IVVT_IN_1" UBYTE _CNV_A_R_LINEAR_____0_CM 1 100. 0. 255. DISPLAY_IDENTIFIER CTR_ABC_SLV_IVVT_IN_1 ECU_ADDRESS 0xd00099a4 FORMAT "%3.0" /end MEASUREMENT
/begin MEASUREMENT fmy_stat_slv_ivvt_in_1.ctr_end_diag "counter for end of diagnosis for diagnosis instance SLV_IVVT_IN_1" UBYTE _CNV_A_R_LINEAR_____0_CM 1 100. 0. 255. DISPLAY_IDENTIFIER CTR_ABC_END_DIAG_SLV_IVVT_IN_1 ECU_ADDRESS 0xd00099a5 FORMAT "%3.0" /end MEASUREMENT
/begin MEASUREMENT fmy_stat_slv_ivvt_in_1.err_info_stat.lv_err_mem "storage in dynamic failure memory of the diagnosis instance SLV_IVVT_IN_1" UWORD _CNV_S_2_RANGE__0___1_CM 1 100. 0. 1. DISPLAY_IDENTIFIER LV_ERR_MEM_SLV_IVVT_IN_1 ECU_ADDRESS 0xd00099a6 BIT_MASK 0x8 /end MEASUREMENT
/begin MEASUREMENT fmy_stat_slv_ivvt_in_1.err_info_stat.lv_ready "readiness status of the diagnosis instance SLV_IVVT_IN_1" UWORD _CNV_S_2_RANGE__0___1_CM 1 100. 0. 1. DISPLAY_IDENTIFIER LV_READY_SLV_IVVT_IN_1 ECU_ADDRESS 0xd00099a6 BIT_MASK 0x10 /end MEASUREMENT
/begin MEASUREMENT fmy_stat_slv_ivvt_in_1.err_info_stat.lv_end_diag "end of diagnosis of the diagnosis instance SLV_IVVT_IN_1" UWORD _CNV_S_2_RANGE__0___1_CM 1 100. 0. 1. DISPLAY_IDENTIFIER LV_END_DIAG_SLV_IVVT_IN_1 ECU_ADDRESS 0xd00099a6 BIT_MASK 0x20 /end MEASUREMENT
/begin MEASUREMENT fmy_stat_slv_ivvt_in_1.err_info_stat.lv_cdn_diag "diagnosis condition of the diagnosis instance SLV_IVVT_IN_1" UWORD _CNV_S_2_RANGE__0___1_CM 1 100. 0. 1. DISPLAY_IDENTIFIER LV_CDN_DIAG_SLV_IVVT_IN_1 ECU_ADDRESS 0xd00099a6 BIT_MASK 0x40 /end MEASUREMENT
/begin MEASUREMENT fmy_stat_slv_ivvt_in_1.err_info_stat.err_sym "symptoms of the diagnosis instance SLV_IVVT_IN_1" UWORD _CNV_S_16_RANGE_ERR__349_CM 1 100. 0. 15. DISPLAY_IDENTIFIER ERR_SYM_SLV_IVVT_IN_1 ECU_ADDRESS 0xd00099a6 BIT_MASK 0x780 /end MEASUREMENT
/begin MEASUREMENT fmy_stat_slv_ivvt_in_2.ctr_abc "anti bounce counter for diagnosis instance SLV_IVVT_IN_2" UBYTE _CNV_A_R_LINEAR_____0_CM 1 100. 0. 255. DISPLAY_IDENTIFIER CTR_ABC_SLV_IVVT_IN_2 ECU_ADDRESS 0xd00099a8 FORMAT "%3.0" /end MEASUREMENT
/begin MEASUREMENT fmy_stat_slv_ivvt_in_2.ctr_end_diag "counter for end of diagnosis for diagnosis instance SLV_IVVT_IN_2" UBYTE _CNV_A_R_LINEAR_____0_CM 1 100. 0. 255. DISPLAY_IDENTIFIER CTR_ABC_END_DIAG_SLV_IVVT_IN_2 ECU_ADDRESS 0xd00099a9 FORMAT "%3.0" /end MEASUREMENT
/begin MEASUREMENT fmy_stat_slv_ivvt_in_2.err_info_stat.lv_err_mem "storage in dynamic failure memory of the diagnosis instance SLV_IVVT_IN_2" UWORD _CNV_S_2_RANGE__0___1_CM 1 100. 0. 1. DISPLAY_IDENTIFIER LV_ERR_MEM_SLV_IVVT_IN_2 ECU_ADDRESS 0xd00099aa BIT_MASK 0x8 /end MEASUREMENT
/begin MEASUREMENT fmy_stat_slv_ivvt_in_2.err_info_stat.lv_ready "readiness status of the diagnosis instance SLV_IVVT_IN_2" UWORD _CNV_S_2_RANGE__0___1_CM 1 100. 0. 1. DISPLAY_IDENTIFIER LV_READY_SLV_IVVT_IN_2 ECU_ADDRESS 0xd00099aa BIT_MASK 0x10 /end MEASUREMENT
/begin MEASUREMENT fmy_stat_slv_ivvt_in_2.err_info_stat.lv_end_diag "end of diagnosis of the diagnosis instance SLV_IVVT_IN_2" UWORD _CNV_S_2_RANGE__0___1_CM 1 100. 0. 1. DISPLAY_IDENTIFIER LV_END_DIAG_SLV_IVVT_IN_2 ECU_ADDRESS 0xd00099aa BIT_MASK 0x20 /end MEASUREMENT
/begin MEASUREMENT fmy_stat_slv_ivvt_in_2.err_info_stat.lv_cdn_diag "diagnosis condition of the diagnosis instance SLV_IVVT_IN_2" UWORD _CNV_S_2_RANGE__0___1_CM 1 100. 0. 1. DISPLAY_IDENTIFIER LV_CDN_DIAG_SLV_IVVT_IN_2 ECU_ADDRESS 0xd00099aa BIT_MASK 0x40 /end MEASUREMENT
/begin MEASUREMENT fmy_stat_slv_ivvt_in_2.err_info_stat.err_sym "symptoms of the diagnosis instance SLV_IVVT_IN_2" UWORD _CNV_S_16_RANGE_ERR__349_CM 1 100. 0. 15. DISPLAY_IDENTIFIER ERR_SYM_SLV_IVVT_IN_2 ECU_ADDRESS 0xd00099aa BIT_MASK 0x780 /end MEASUREMENT
/begin MEASUREMENT fmy_stat_slv_ivvt_ex_1.ctr_abc "anti bounce counter for diagnosis instance SLV_IVVT_EX_1" UBYTE _CNV_A_R_LINEAR_____0_CM 1 100. 0. 255. DISPLAY_IDENTIFIER CTR_ABC_SLV_IVVT_EX_1 ECU_ADDRESS 0xd0009998 FORMAT "%3.0" /end MEASUREMENT
/begin MEASUREMENT fmy_stat_slv_ivvt_ex_1.ctr_end_diag "counter for end of diagnosis for diagnosis instance SLV_IVVT_EX_1" UBYTE _CNV_A_R_LINEAR_____0_CM 1 100. 0. 255. DISPLAY_IDENTIFIER CTR_ABC_END_DIAG_SLV_IVVT_EX_1 ECU_ADDRESS 0xd0009999 FORMAT "%3.0" /end MEASUREMENT
/begin MEASUREMENT fmy_stat_slv_ivvt_ex_1.err_info_stat.lv_err_mem "storage in dynamic failure memory of the diagnosis instance SLV_IVVT_EX_1" UWORD _CNV_S_2_RANGE__0___1_CM 1 100. 0. 1. DISPLAY_IDENTIFIER LV_ERR_MEM_SLV_IVVT_EX_1 ECU_ADDRESS 0xd000999a BIT_MASK 0x8 /end MEASUREMENT
/begin MEASUREMENT fmy_stat_slv_ivvt_ex_1.err_info_stat.lv_ready "readiness status of the diagnosis instance SLV_IVVT_EX_1" UWORD _CNV_S_2_RANGE__0___1_CM 1 100. 0. 1. DISPLAY_IDENTIFIER LV_READY_SLV_IVVT_EX_1 ECU_ADDRESS 0xd000999a BIT_MASK 0x10 /end MEASUREMENT
/begin MEASUREMENT fmy_stat_slv_ivvt_ex_1.err_info_stat.lv_end_diag "end of diagnosis of the diagnosis instance SLV_IVVT_EX_1" UWORD _CNV_S_2_RANGE__0___1_CM 1 100. 0. 1. DISPLAY_IDENTIFIER LV_END_DIAG_SLV_IVVT_EX_1 ECU_ADDRESS 0xd000999a BIT_MASK 0x20 /end MEASUREMENT
/begin MEASUREMENT fmy_stat_slv_ivvt_ex_1.err_info_stat.lv_cdn_diag "diagnosis condition of the diagnosis instance SLV_IVVT_EX_1" UWORD _CNV_S_2_RANGE__0___1_CM 1 100. 0. 1. DISPLAY_IDENTIFIER LV_CDN_DIAG_SLV_IVVT_EX_1 ECU_ADDRESS 0xd000999a BIT_MASK 0x40 /end MEASUREMENT
/begin MEASUREMENT fmy_stat_slv_ivvt_ex_1.err_info_stat.err_sym "symptoms of the diagnosis instance SLV_IVVT_EX_1" UWORD _CNV_S_16_RANGE_ERR__349_CM 1 100. 0. 15. DISPLAY_IDENTIFIER ERR_SYM_SLV_IVVT_EX_1 ECU_ADDRESS 0xd000999a BIT_MASK 0x780 /end MEASUREMENT
/begin MEASUREMENT fmy_stat_slv_ivvt_ex_2.ctr_abc "anti bounce counter for diagnosis instance SLV_IVVT_EX_2" UBYTE _CNV_A_R_LINEAR_____0_CM 1 100. 0. 255. DISPLAY_IDENTIFIER CTR_ABC_SLV_IVVT_EX_2 ECU_ADDRESS 0xd000999c FORMAT "%3.0" /end MEASUREMENT
/begin MEASUREMENT fmy_stat_slv_ivvt_ex_2.ctr_end_diag "counter for end of diagnosis for diagnosis instance SLV_IVVT_EX_2" UBYTE _CNV_A_R_LINEAR_____0_CM 1 100. 0. 255. DISPLAY_IDENTIFIER CTR_ABC_END_DIAG_SLV_IVVT_EX_2 ECU_ADDRESS 0xd000999d FORMAT "%3.0" /end MEASUREMENT
/begin MEASUREMENT fmy_stat_slv_ivvt_ex_2.err_info_stat.lv_err_mem "storage in dynamic failure memory of the diagnosis instance SLV_IVVT_EX_2" UWORD _CNV_S_2_RANGE__0___1_CM 1 100. 0. 1. DISPLAY_IDENTIFIER LV_ERR_MEM_SLV_IVVT_EX_2 ECU_ADDRESS 0xd000999e BIT_MASK 0x8 /end MEASUREMENT
/begin MEASUREMENT fmy_stat_slv_ivvt_ex_2.err_info_stat.lv_ready "readiness status of the diagnosis instance SLV_IVVT_EX_2" UWORD _CNV_S_2_RANGE__0___1_CM 1 100. 0. 1. DISPLAY_IDENTIFIER LV_READY_SLV_IVVT_EX_2 ECU_ADDRESS 0xd000999e BIT_MASK 0x10 /end MEASUREMENT
/begin MEASUREMENT fmy_stat_slv_ivvt_ex_2.err_info_stat.lv_end_diag "end of diagnosis of the diagnosis instance SLV_IVVT_EX_2" UWORD _CNV_S_2_RANGE__0___1_CM 1 100. 0. 1. DISPLAY_IDENTIFIER LV_END_DIAG_SLV_IVVT_EX_2 ECU_ADDRESS 0xd000999e BIT_MASK 0x20 /end MEASUREMENT
/begin MEASUREMENT fmy_stat_slv_ivvt_ex_2.err_info_stat.lv_cdn_diag "diagnosis condition of the diagnosis instance SLV_IVVT_EX_2" UWORD _CNV_S_2_RANGE__0___1_CM 1 100. 0. 1. DISPLAY_IDENTIFIER LV_CDN_DIAG_SLV_IVVT_EX_2 ECU_ADDRESS 0xd000999e BIT_MASK 0x40 /end MEASUREMENT
/begin MEASUREMENT fmy_stat_slv_ivvt_ex_2.err_info_stat.err_sym "symptoms of the diagnosis instance SLV_IVVT_EX_2" UWORD _CNV_S_16_RANGE_ERR__349_CM 1 100. 0. 15. DISPLAY_IDENTIFIER ERR_SYM_SLV_IVVT_EX_2 ECU_ADDRESS 0xd000999e BIT_MASK 0x780 /end MEASUREMENT
/begin MEASUREMENT fmy_stat_ecu_cks.ctr_abc "anti bounce counter for diagnosis instance ECU_CKS" UBYTE _CNV_A_R_LINEAR_____0_CM 1 100. 0. 255. DISPLAY_IDENTIFIER CTR_ABC_ECU_CKS ECU_ADDRESS 0xd0009640 FORMAT "%3.0" /end MEASUREMENT
/begin MEASUREMENT fmy_stat_ecu_cks.ctr_end_diag "counter for end of diagnosis for diagnosis instance ECU_CKS" UBYTE _CNV_A_R_LINEAR_____0_CM 1 100. 0. 255. DISPLAY_IDENTIFIER CTR_ABC_END_DIAG_ECU_CKS ECU_ADDRESS 0xd0009641 FORMAT "%3.0" /end MEASUREMENT
/begin MEASUREMENT fmy_stat_ecu_cks.err_info_stat.lv_err_mem "storage in dynamic failure memory of the diagnosis instance ECU_CKS" UWORD _CNV_S_2_RANGE__0___1_CM 1 100. 0. 1. DISPLAY_IDENTIFIER LV_ERR_MEM_ECU_CKS ECU_ADDRESS 0xd0009642 BIT_MASK 0x8 /end MEASUREMENT
/begin MEASUREMENT fmy_stat_ecu_cks.err_info_stat.lv_ready "readiness status of the diagnosis instance ECU_CKS" UWORD _CNV_S_2_RANGE__0___1_CM 1 100. 0. 1. DISPLAY_IDENTIFIER LV_READY_ECU_CKS ECU_ADDRESS 0xd0009642 BIT_MASK 0x10 /end MEASUREMENT
/begin MEASUREMENT fmy_stat_ecu_cks.err_info_stat.lv_end_diag "end of diagnosis of the diagnosis instance ECU_CKS" UWORD _CNV_S_2_RANGE__0___1_CM 1 100. 0. 1. DISPLAY_IDENTIFIER LV_END_DIAG_ECU_CKS ECU_ADDRESS 0xd0009642 BIT_MASK 0x20 /end MEASUREMENT
/begin MEASUREMENT fmy_stat_ecu_cks.err_info_stat.lv_cdn_diag "diagnosis condition of the diagnosis instance ECU_CKS" UWORD _CNV_S_2_RANGE__0___1_CM 1 100. 0. 1. DISPLAY_IDENTIFIER LV_CDN_DIAG_ECU_CKS ECU_ADDRESS 0xd0009642 BIT_MASK 0x40 /end MEASUREMENT
/begin MEASUREMENT fmy_stat_ecu_cks.err_info_stat.err_sym "symptoms of the diagnosis instance ECU_CKS" UWORD _CNV_S_16_RANGE_ERR__349_CM 1 100. 0. 15. DISPLAY_IDENTIFIER ERR_SYM_ECU_CKS ECU_ADDRESS 0xd0009642 BIT_MASK 0x780 /end MEASUREMENT
/begin MEASUREMENT fmy_stat_vs.ctr_abc "anti bounce counter for diagnosis instance VS" UBYTE _CNV_A_R_LINEAR_____0_CM 1 100. 0. 255. DISPLAY_IDENTIFIER CTR_ABC_VS ECU_ADDRESS 0xd0009afc FORMAT "%3.0" /end MEASUREMENT
/begin MEASUREMENT fmy_stat_vs.ctr_end_diag "counter for end of diagnosis for diagnosis instance VS" UBYTE _CNV_A_R_LINEAR_____0_CM 1 100. 0. 255. DISPLAY_IDENTIFIER CTR_ABC_END_DIAG_VS ECU_ADDRESS 0xd0009afd FORMAT "%3.0" /end MEASUREMENT
/begin MEASUREMENT fmy_stat_vs.err_info_stat.lv_err_mem "storage in dynamic failure memory of the diagnosis instance VS" UWORD _CNV_S_2_RANGE__0___1_CM 1 100. 0. 1. DISPLAY_IDENTIFIER LV_ERR_MEM_VS ECU_ADDRESS 0xd0009afe BIT_MASK 0x8 /end MEASUREMENT
/begin MEASUREMENT fmy_stat_vs.err_info_stat.lv_ready "readiness status of the diagnosis instance VS" UWORD _CNV_S_2_RANGE__0___1_CM 1 100. 0. 1. DISPLAY_IDENTIFIER LV_READY_VS ECU_ADDRESS 0xd0009afe BIT_MASK 0x10 /end MEASUREMENT
/begin MEASUREMENT fmy_stat_vs.err_info_stat.lv_end_diag "end of diagnosis of the diagnosis instance VS" UWORD _CNV_S_2_RANGE__0___1_CM 1 100. 0. 1. DISPLAY_IDENTIFIER LV_END_DIAG_VS ECU_ADDRESS 0xd0009afe BIT_MASK 0x20 /end MEASUREMENT
/begin MEASUREMENT fmy_stat_vs.err_info_stat.lv_cdn_diag "diagnosis condition of the diagnosis instance VS" UWORD _CNV_S_2_RANGE__0___1_CM 1 100. 0. 1. DISPLAY_IDENTIFIER LV_CDN_DIAG_VS ECU_ADDRESS 0xd0009afe BIT_MASK 0x40 /end MEASUREMENT
/begin MEASUREMENT fmy_stat_vs.err_info_stat.err_sym "symptoms of the diagnosis instance VS" UWORD _CNV_S_16_RANGE_ERR__349_CM 1 100. 0. 15. DISPLAY_IDENTIFIER ERR_SYM_VS ECU_ADDRESS 0xd0009afe BIT_MASK 0x780 /end MEASUREMENT
/begin MEASUREMENT fmy_stat_knks_1.ctr_abc "anti bounce counter for diagnosis instance KNKS_1" UBYTE _CNV_A_R_LINEAR_____0_CM 1 100. 0. 255. DISPLAY_IDENTIFIER CTR_ABC_KNKS_1 ECU_ADDRESS 0xd00097ac FORMAT "%3.0" /end MEASUREMENT
/begin MEASUREMENT fmy_stat_knks_1.ctr_end_diag "counter for end of diagnosis for diagnosis instance KNKS_1" UBYTE _CNV_A_R_LINEAR_____0_CM 1 100. 0. 255. DISPLAY_IDENTIFIER CTR_ABC_END_DIAG_KNKS_1 ECU_ADDRESS 0xd00097ad FORMAT "%3.0" /end MEASUREMENT
/begin MEASUREMENT fmy_stat_knks_1.err_info_stat.lv_err_mem "storage in dynamic failure memory of the diagnosis instance KNKS_1" UWORD _CNV_S_2_RANGE__0___1_CM 1 100. 0. 1. DISPLAY_IDENTIFIER LV_ERR_MEM_KNKS_1 ECU_ADDRESS 0xd00097ae BIT_MASK 0x8 /end MEASUREMENT
/begin MEASUREMENT fmy_stat_knks_1.err_info_stat.lv_ready "readiness status of the diagnosis instance KNKS_1" UWORD _CNV_S_2_RANGE__0___1_CM 1 100. 0. 1. DISPLAY_IDENTIFIER LV_READY_KNKS_1 ECU_ADDRESS 0xd00097ae BIT_MASK 0x10 /end MEASUREMENT
/begin MEASUREMENT fmy_stat_knks_1.err_info_stat.lv_end_diag "end of diagnosis of the diagnosis instance KNKS_1" UWORD _CNV_S_2_RANGE__0___1_CM 1 100. 0. 1. DISPLAY_IDENTIFIER LV_END_DIAG_KNKS_1 ECU_ADDRESS 0xd00097ae BIT_MASK 0x20 /end MEASUREMENT
/begin MEASUREMENT fmy_stat_knks_1.err_info_stat.lv_cdn_diag "diagnosis condition of the diagnosis instance KNKS_1" UWORD _CNV_S_2_RANGE__0___1_CM 1 100. 0. 1. DISPLAY_IDENTIFIER LV_CDN_DIAG_KNKS_1 ECU_ADDRESS 0xd00097ae BIT_MASK 0x40 /end MEASUREMENT
/begin MEASUREMENT fmy_stat_knks_1.err_info_stat.err_sym "symptoms of the diagnosis instance KNKS_1" UWORD _CNV_S_16_RANGE_ERR__349_CM 1 100. 0. 15. DISPLAY_IDENTIFIER ERR_SYM_KNKS_1 ECU_ADDRESS 0xd00097ae BIT_MASK 0x780 /end MEASUREMENT
/begin MEASUREMENT fmy_stat_knks_2.ctr_abc "anti bounce counter for diagnosis instance KNKS_2" UBYTE _CNV_A_R_LINEAR_____0_CM 1 100. 0. 255. DISPLAY_IDENTIFIER CTR_ABC_KNKS_2 ECU_ADDRESS 0xd00097b0 FORMAT "%3.0" /end MEASUREMENT
/begin MEASUREMENT fmy_stat_knks_2.ctr_end_diag "counter for end of diagnosis for diagnosis instance KNKS_2" UBYTE _CNV_A_R_LINEAR_____0_CM 1 100. 0. 255. DISPLAY_IDENTIFIER CTR_ABC_END_DIAG_KNKS_2 ECU_ADDRESS 0xd00097b1 FORMAT "%3.0" /end MEASUREMENT
/begin MEASUREMENT fmy_stat_knks_2.err_info_stat.lv_err_mem "storage in dynamic failure memory of the diagnosis instance KNKS_2" UWORD _CNV_S_2_RANGE__0___1_CM 1 100. 0. 1. DISPLAY_IDENTIFIER LV_ERR_MEM_KNKS_2 ECU_ADDRESS 0xd00097b2 BIT_MASK 0x8 /end MEASUREMENT
/begin MEASUREMENT fmy_stat_knks_2.err_info_stat.lv_ready "readiness status of the diagnosis instance KNKS_2" UWORD _CNV_S_2_RANGE__0___1_CM 1 100. 0. 1. DISPLAY_IDENTIFIER LV_READY_KNKS_2 ECU_ADDRESS 0xd00097b2 BIT_MASK 0x10 /end MEASUREMENT
/begin MEASUREMENT fmy_stat_knks_2.err_info_stat.lv_end_diag "end of diagnosis of the diagnosis instance KNKS_2" UWORD _CNV_S_2_RANGE__0___1_CM 1 100. 0. 1. DISPLAY_IDENTIFIER LV_END_DIAG_KNKS_2 ECU_ADDRESS 0xd00097b2 BIT_MASK 0x20 /end MEASUREMENT
/begin MEASUREMENT fmy_stat_knks_2.err_info_stat.lv_cdn_diag "diagnosis condition of the diagnosis instance KNKS_2" UWORD _CNV_S_2_RANGE__0___1_CM 1 100. 0. 1. DISPLAY_IDENTIFIER LV_CDN_DIAG_KNKS_2 ECU_ADDRESS 0xd00097b2 BIT_MASK 0x40 /end MEASUREMENT
/begin MEASUREMENT fmy_stat_knks_2.err_info_stat.err_sym "symptoms of the diagnosis instance KNKS_2" UWORD _CNV_S_16_RANGE_ERR__349_CM 1 100. 0. 15. DISPLAY_IDENTIFIER ERR_SYM_KNKS_2 ECU_ADDRESS 0xd00097b2 BIT_MASK 0x780 /end MEASUREMENT
/begin MEASUREMENT fmy_stat_knks_3.ctr_abc "anti bounce counter for diagnosis instance KNKS_3" UBYTE _CNV_A_R_LINEAR_____0_CM 1 100. 0. 255. DISPLAY_IDENTIFIER CTR_ABC_KNKS_3 ECU_ADDRESS 0xd00097b4 FORMAT "%3.0" /end MEASUREMENT
/begin MEASUREMENT fmy_stat_knks_3.ctr_end_diag "counter for end of diagnosis for diagnosis instance KNKS_3" UBYTE _CNV_A_R_LINEAR_____0_CM 1 100. 0. 255. DISPLAY_IDENTIFIER CTR_ABC_END_DIAG_KNKS_3 ECU_ADDRESS 0xd00097b5 FORMAT "%3.0" /end MEASUREMENT
/begin MEASUREMENT fmy_stat_knks_3.err_info_stat.lv_err_mem "storage in dynamic failure memory of the diagnosis instance KNKS_3" UWORD _CNV_S_2_RANGE__0___1_CM 1 100. 0. 1. DISPLAY_IDENTIFIER LV_ERR_MEM_KNKS_3 ECU_ADDRESS 0xd00097b6 BIT_MASK 0x8 /end MEASUREMENT
/begin MEASUREMENT fmy_stat_knks_3.err_info_stat.lv_ready "readiness status of the diagnosis instance KNKS_3" UWORD _CNV_S_2_RANGE__0___1_CM 1 100. 0. 1. DISPLAY_IDENTIFIER LV_READY_KNKS_3 ECU_ADDRESS 0xd00097b6 BIT_MASK 0x10 /end MEASUREMENT
/begin MEASUREMENT fmy_stat_knks_3.err_info_stat.lv_end_diag "end of diagnosis of the diagnosis instance KNKS_3" UWORD _CNV_S_2_RANGE__0___1_CM 1 100. 0. 1. DISPLAY_IDENTIFIER LV_END_DIAG_KNKS_3 ECU_ADDRESS 0xd00097b6 BIT_MASK 0x20 /end MEASUREMENT
/begin MEASUREMENT fmy_stat_knks_3.err_info_stat.lv_cdn_diag "diagnosis condition of the diagnosis instance KNKS_3" UWORD _CNV_S_2_RANGE__0___1_CM 1 100. 0. 1. DISPLAY_IDENTIFIER LV_CDN_DIAG_KNKS_3 ECU_ADDRESS 0xd00097b6 BIT_MASK 0x40 /end MEASUREMENT
/begin MEASUREMENT fmy_stat_knks_3.err_info_stat.err_sym "symptoms of the diagnosis instance KNKS_3" UWORD _CNV_S_16_RANGE_ERR__349_CM 1 100. 0. 15. DISPLAY_IDENTIFIER ERR_SYM_KNKS_3 ECU_ADDRESS 0xd00097b6 BIT_MASK 0x780 /end MEASUREMENT
/begin MEASUREMENT fmy_stat_knks_4.ctr_abc "anti bounce counter for diagnosis instance KNKS_4" UBYTE _CNV_A_R_LINEAR_____0_CM 1 100. 0. 255. DISPLAY_IDENTIFIER CTR_ABC_KNKS_4 ECU_ADDRESS 0xd00097b8 FORMAT "%3.0" /end MEASUREMENT
/begin MEASUREMENT fmy_stat_knks_4.ctr_end_diag "counter for end of diagnosis for diagnosis instance KNKS_4" UBYTE _CNV_A_R_LINEAR_____0_CM 1 100. 0. 255. DISPLAY_IDENTIFIER CTR_ABC_END_DIAG_KNKS_4 ECU_ADDRESS 0xd00097b9 FORMAT "%3.0" /end MEASUREMENT
/begin MEASUREMENT fmy_stat_knks_4.err_info_stat.lv_err_mem "storage in dynamic failure memory of the diagnosis instance KNKS_4" UWORD _CNV_S_2_RANGE__0___1_CM 1 100. 0. 1. DISPLAY_IDENTIFIER LV_ERR_MEM_KNKS_4 ECU_ADDRESS 0xd00097ba BIT_MASK 0x8 /end MEASUREMENT
/begin MEASUREMENT fmy_stat_knks_4.err_info_stat.lv_ready "readiness status of the diagnosis instance KNKS_4" UWORD _CNV_S_2_RANGE__0___1_CM 1 100. 0. 1. DISPLAY_IDENTIFIER LV_READY_KNKS_4 ECU_ADDRESS 0xd00097ba BIT_MASK 0x10 /end MEASUREMENT
/begin MEASUREMENT fmy_stat_knks_4.err_info_stat.lv_end_diag "end of diagnosis of the diagnosis instance KNKS_4" UWORD _CNV_S_2_RANGE__0___1_CM 1 100. 0. 1. DISPLAY_IDENTIFIER LV_END_DIAG_KNKS_4 ECU_ADDRESS 0xd00097ba BIT_MASK 0x20 /end MEASUREMENT
/begin MEASUREMENT fmy_stat_knks_4.err_info_stat.lv_cdn_diag "diagnosis condition of the diagnosis instance KNKS_4" UWORD _CNV_S_2_RANGE__0___1_CM 1 100. 0. 1. DISPLAY_IDENTIFIER LV_CDN_DIAG_KNKS_4 ECU_ADDRESS 0xd00097ba BIT_MASK 0x40 /end MEASUREMENT
/begin MEASUREMENT fmy_stat_knks_4.err_info_stat.err_sym "symptoms of the diagnosis instance KNKS_4" UWORD _CNV_S_16_RANGE_ERR__349_CM 1 100. 0. 15. DISPLAY_IDENTIFIER ERR_SYM_KNKS_4 ECU_ADDRESS 0xd00097ba BIT_MASK 0x780 /end MEASUREMENT
/begin MEASUREMENT fmy_stat_rfp_dr_1.ctr_abc "anti bounce counter for diagnosis instance RFP_DR_1" UBYTE _CNV_A_R_LINEAR_____0_CM 1 100. 0. 255. DISPLAY_IDENTIFIER CTR_ABC_RFP_DR_1 ECU_ADDRESS 0xd0009940 FORMAT "%3.0" /end MEASUREMENT
/begin MEASUREMENT fmy_stat_rfp_dr_1.ctr_end_diag "counter for end of diagnosis for diagnosis instance RFP_DR_1" UBYTE _CNV_A_R_LINEAR_____0_CM 1 100. 0. 255. DISPLAY_IDENTIFIER CTR_ABC_END_DIAG_RFP_DR_1 ECU_ADDRESS 0xd0009941 FORMAT "%3.0" /end MEASUREMENT
/begin MEASUREMENT fmy_stat_rfp_dr_1.err_info_stat.lv_err_mem "storage in dynamic failure memory of the diagnosis instance RFP_DR_1" UWORD _CNV_S_2_RANGE__0___1_CM 1 100. 0. 1. DISPLAY_IDENTIFIER LV_ERR_MEM_RFP_DR_1 ECU_ADDRESS 0xd0009942 BIT_MASK 0x8 /end MEASUREMENT
/begin MEASUREMENT fmy_stat_rfp_dr_1.err_info_stat.lv_ready "readiness status of the diagnosis instance RFP_DR_1" UWORD _CNV_S_2_RANGE__0___1_CM 1 100. 0. 1. DISPLAY_IDENTIFIER LV_READY_RFP_DR_1 ECU_ADDRESS 0xd0009942 BIT_MASK 0x10 /end MEASUREMENT
/begin MEASUREMENT fmy_stat_rfp_dr_1.err_info_stat.lv_end_diag "end of diagnosis of the diagnosis instance RFP_DR_1" UWORD _CNV_S_2_RANGE__0___1_CM 1 100. 0. 1. DISPLAY_IDENTIFIER LV_END_DIAG_RFP_DR_1 ECU_ADDRESS 0xd0009942 BIT_MASK 0x20 /end MEASUREMENT
/begin MEASUREMENT fmy_stat_rfp_dr_1.err_info_stat.lv_cdn_diag "diagnosis condition of the diagnosis instance RFP_DR_1" UWORD _CNV_S_2_RANGE__0___1_CM 1 100. 0. 1. DISPLAY_IDENTIFIER LV_CDN_DIAG_RFP_DR_1 ECU_ADDRESS 0xd0009942 BIT_MASK 0x40 /end MEASUREMENT
/begin MEASUREMENT fmy_stat_rfp_dr_1.err_info_stat.err_sym "symptoms of the diagnosis instance RFP_DR_1" UWORD _CNV_S_16_RANGE_ERR__349_CM 1 100. 0. 15. DISPLAY_IDENTIFIER ERR_SYM_RFP_DR_1 ECU_ADDRESS 0xd0009942 BIT_MASK 0x780 /end MEASUREMENT
/begin MEASUREMENT fmy_stat_rfp_dr_2.ctr_abc "anti bounce counter for diagnosis instance RFP_DR_2" UBYTE _CNV_A_R_LINEAR_____0_CM 1 100. 0. 255. DISPLAY_IDENTIFIER CTR_ABC_RFP_DR_2 ECU_ADDRESS 0xd0009944 FORMAT "%3.0" /end MEASUREMENT
/begin MEASUREMENT fmy_stat_rfp_dr_2.ctr_end_diag "counter for end of diagnosis for diagnosis instance RFP_DR_2" UBYTE _CNV_A_R_LINEAR_____0_CM 1 100. 0. 255. DISPLAY_IDENTIFIER CTR_ABC_END_DIAG_RFP_DR_2 ECU_ADDRESS 0xd0009945 FORMAT "%3.0" /end MEASUREMENT
/begin MEASUREMENT fmy_stat_rfp_dr_2.err_info_stat.lv_err_mem "storage in dynamic failure memory of the diagnosis instance RFP_DR_2" UWORD _CNV_S_2_RANGE__0___1_CM 1 100. 0. 1. DISPLAY_IDENTIFIER LV_ERR_MEM_RFP_DR_2 ECU_ADDRESS 0xd0009946 BIT_MASK 0x8 /end MEASUREMENT
/begin MEASUREMENT fmy_stat_rfp_dr_2.err_info_stat.lv_ready "readiness status of the diagnosis instance RFP_DR_2" UWORD _CNV_S_2_RANGE__0___1_CM 1 100. 0. 1. DISPLAY_IDENTIFIER LV_READY_RFP_DR_2 ECU_ADDRESS 0xd0009946 BIT_MASK 0x10 /end MEASUREMENT
/begin MEASUREMENT fmy_stat_rfp_dr_2.err_info_stat.lv_end_diag "end of diagnosis of the diagnosis instance RFP_DR_2" UWORD _CNV_S_2_RANGE__0___1_CM 1 100. 0. 1. DISPLAY_IDENTIFIER LV_END_DIAG_RFP_DR_2 ECU_ADDRESS 0xd0009946 BIT_MASK 0x20 /end MEASUREMENT
/begin MEASUREMENT fmy_stat_rfp_dr_2.err_info_stat.lv_cdn_diag "diagnosis condition of the diagnosis instance RFP_DR_2" UWORD _CNV_S_2_RANGE__0___1_CM 1 100. 0. 1. DISPLAY_IDENTIFIER LV_CDN_DIAG_RFP_DR_2 ECU_ADDRESS 0xd0009946 BIT_MASK 0x40 /end MEASUREMENT
/begin MEASUREMENT fmy_stat_rfp_dr_2.err_info_stat.err_sym "symptoms of the diagnosis instance RFP_DR_2" UWORD _CNV_S_16_RANGE_ERR__349_CM 1 100. 0. 15. DISPLAY_IDENTIFIER ERR_SYM_RFP_DR_2 ECU_ADDRESS 0xd0009946 BIT_MASK 0x780 /end MEASUREMENT
/begin MEASUREMENT fmy_stat_wg_1_dr.ctr_abc "anti bounce counter for diagnosis instance WG_1_DR" UBYTE _CNV_A_R_LINEAR_____0_CM 1 100. 0. 255. DISPLAY_IDENTIFIER CTR_ABC_WG_1_DR ECU_ADDRESS 0xd0009b0c FORMAT "%3.0" /end MEASUREMENT
/begin MEASUREMENT fmy_stat_wg_1_dr.ctr_end_diag "counter for end of diagnosis for diagnosis instance WG_1_DR" UBYTE _CNV_A_R_LINEAR_____0_CM 1 100. 0. 255. DISPLAY_IDENTIFIER CTR_ABC_END_DIAG_WG_1_DR ECU_ADDRESS 0xd0009b0d FORMAT "%3.0" /end MEASUREMENT
/begin MEASUREMENT fmy_stat_wg_1_dr.err_info_stat.lv_err_mem "storage in dynamic failure memory of the diagnosis instance WG_1_DR" UWORD _CNV_S_2_RANGE__0___1_CM 1 100. 0. 1. DISPLAY_IDENTIFIER LV_ERR_MEM_WG_1_DR ECU_ADDRESS 0xd0009b0e BIT_MASK 0x8 /end MEASUREMENT
/begin MEASUREMENT fmy_stat_wg_1_dr.err_info_stat.lv_ready "readiness status of the diagnosis instance WG_1_DR" UWORD _CNV_S_2_RANGE__0___1_CM 1 100. 0. 1. DISPLAY_IDENTIFIER LV_READY_WG_1_DR ECU_ADDRESS 0xd0009b0e BIT_MASK 0x10 /end MEASUREMENT
/begin MEASUREMENT fmy_stat_wg_1_dr.err_info_stat.lv_end_diag "end of diagnosis of the diagnosis instance WG_1_DR" UWORD _CNV_S_2_RANGE__0___1_CM 1 100. 0. 1. DISPLAY_IDENTIFIER LV_END_DIAG_WG_1_DR ECU_ADDRESS 0xd0009b0e BIT_MASK 0x20 /end MEASUREMENT
/begin MEASUREMENT fmy_stat_wg_1_dr.err_info_stat.lv_cdn_diag "diagnosis condition of the diagnosis instance WG_1_DR" UWORD _CNV_S_2_RANGE__0___1_CM 1 100. 0. 1. DISPLAY_IDENTIFIER LV_CDN_DIAG_WG_1_DR ECU_ADDRESS 0xd0009b0e BIT_MASK 0x40 /end MEASUREMENT
/begin MEASUREMENT fmy_stat_wg_1_dr.err_info_stat.err_sym "symptoms of the diagnosis instance WG_1_DR" UWORD _CNV_S_16_RANGE_ERR__349_CM 1 100. 0. 15. DISPLAY_IDENTIFIER ERR_SYM_WG_1_DR ECU_ADDRESS 0xd0009b0e BIT_MASK 0x780 /end MEASUREMENT
/begin MEASUREMENT fmy_stat_wg_2_dr.ctr_abc "anti bounce counter for diagnosis instance WG_2_DR" UBYTE _CNV_A_R_LINEAR_____0_CM 1 100. 0. 255. DISPLAY_IDENTIFIER CTR_ABC_WG_2_DR ECU_ADDRESS 0xd0009b10 FORMAT "%3.0" /end MEASUREMENT
/begin MEASUREMENT fmy_stat_wg_2_dr.ctr_end_diag "counter for end of diagnosis for diagnosis instance WG_2_DR" UBYTE _CNV_A_R_LINEAR_____0_CM 1 100. 0. 255. DISPLAY_IDENTIFIER CTR_ABC_END_DIAG_WG_2_DR ECU_ADDRESS 0xd0009b11 FORMAT "%3.0" /end MEASUREMENT
/begin MEASUREMENT fmy_stat_wg_2_dr.err_info_stat.lv_err_mem "storage in dynamic failure memory of the diagnosis instance WG_2_DR" UWORD _CNV_S_2_RANGE__0___1_CM 1 100. 0. 1. DISPLAY_IDENTIFIER LV_ERR_MEM_WG_2_DR ECU_ADDRESS 0xd0009b12 BIT_MASK 0x8 /end MEASUREMENT
/begin MEASUREMENT fmy_stat_wg_2_dr.err_info_stat.lv_ready "readiness status of the diagnosis instance WG_2_DR" UWORD _CNV_S_2_RANGE__0___1_CM 1 100. 0. 1. DISPLAY_IDENTIFIER LV_READY_WG_2_DR ECU_ADDRESS 0xd0009b12 BIT_MASK 0x10 /end MEASUREMENT
/begin MEASUREMENT fmy_stat_wg_2_dr.err_info_stat.lv_end_diag "end of diagnosis of the diagnosis instance WG_2_DR" UWORD _CNV_S_2_RANGE__0___1_CM 1 100. 0. 1. DISPLAY_IDENTIFIER LV_END_DIAG_WG_2_DR ECU_ADDRESS 0xd0009b12 BIT_MASK 0x20 /end MEASUREMENT
/begin MEASUREMENT fmy_stat_wg_2_dr.err_info_stat.lv_cdn_diag "diagnosis condition of the diagnosis instance WG_2_DR" UWORD _CNV_S_2_RANGE__0___1_CM 1 100. 0. 1. DISPLAY_IDENTIFIER LV_CDN_DIAG_WG_2_DR ECU_ADDRESS 0xd0009b12 BIT_MASK 0x40 /end MEASUREMENT
/begin MEASUREMENT fmy_stat_wg_2_dr.err_info_stat.err_sym "symptoms of the diagnosis instance WG_2_DR" UWORD _CNV_S_16_RANGE_ERR__349_CM 1 100. 0. 15. DISPLAY_IDENTIFIER ERR_SYM_WG_2_DR ECU_ADDRESS 0xd0009b12 BIT_MASK 0x780 /end MEASUREMENT
/begin MEASUREMENT fmy_stat_put_el_1.ctr_abc "anti bounce counter for diagnosis instance PUT_EL_1" UBYTE _CNV_A_R_LINEAR_____0_CM 1 100. 0. 255. DISPLAY_IDENTIFIER CTR_ABC_PUT_EL_1 ECU_ADDRESS 0xd0009904 FORMAT "%3.0" /end MEASUREMENT
/begin MEASUREMENT fmy_stat_put_el_1.ctr_end_diag "counter for end of diagnosis for diagnosis instance PUT_EL_1" UBYTE _CNV_A_R_LINEAR_____0_CM 1 100. 0. 255. DISPLAY_IDENTIFIER CTR_ABC_END_DIAG_PUT_EL_1 ECU_ADDRESS 0xd0009905 FORMAT "%3.0" /end MEASUREMENT
/begin MEASUREMENT fmy_stat_put_el_1.err_info_stat.lv_err_mem "storage in dynamic failure memory of the diagnosis instance PUT_EL_1" UWORD _CNV_S_2_RANGE__0___1_CM 1 100. 0. 1. DISPLAY_IDENTIFIER LV_ERR_MEM_PUT_EL_1 ECU_ADDRESS 0xd0009906 BIT_MASK 0x8 /end MEASUREMENT
/begin MEASUREMENT fmy_stat_put_el_1.err_info_stat.lv_ready "readiness status of the diagnosis instance PUT_EL_1" UWORD _CNV_S_2_RANGE__0___1_CM 1 100. 0. 1. DISPLAY_IDENTIFIER LV_READY_PUT_EL_1 ECU_ADDRESS 0xd0009906 BIT_MASK 0x10 /end MEASUREMENT
/begin MEASUREMENT fmy_stat_put_el_1.err_info_stat.lv_end_diag "end of diagnosis of the diagnosis instance PUT_EL_1" UWORD _CNV_S_2_RANGE__0___1_CM 1 100. 0. 1. DISPLAY_IDENTIFIER LV_END_DIAG_PUT_EL_1 ECU_ADDRESS 0xd0009906 BIT_MASK 0x20 /end MEASUREMENT
/begin MEASUREMENT fmy_stat_put_el_1.err_info_stat.lv_cdn_diag "diagnosis condition of the diagnosis instance PUT_EL_1" UWORD _CNV_S_2_RANGE__0___1_CM 1 100. 0. 1. DISPLAY_IDENTIFIER LV_CDN_DIAG_PUT_EL_1 ECU_ADDRESS 0xd0009906 BIT_MASK 0x40 /end MEASUREMENT
/begin MEASUREMENT fmy_stat_put_el_1.err_info_stat.err_sym "symptoms of the diagnosis instance PUT_EL_1" UWORD _CNV_S_16_RANGE_ERR__349_CM 1 100. 0. 15. DISPLAY_IDENTIFIER ERR_SYM_PUT_EL_1 ECU_ADDRESS 0xd0009906 BIT_MASK 0x780 /end MEASUREMENT
/begin MEASUREMENT fmy_stat_put_el_2.ctr_abc "anti bounce counter for diagnosis instance PUT_EL_2" UBYTE _CNV_A_R_LINEAR_____0_CM 1 100. 0. 255. DISPLAY_IDENTIFIER CTR_ABC_PUT_EL_2 ECU_ADDRESS 0xd0009908 FORMAT "%3.0" /end MEASUREMENT
/begin MEASUREMENT fmy_stat_put_el_2.ctr_end_diag "counter for end of diagnosis for diagnosis instance PUT_EL_2" UBYTE _CNV_A_R_LINEAR_____0_CM 1 100. 0. 255. DISPLAY_IDENTIFIER CTR_ABC_END_DIAG_PUT_EL_2 ECU_ADDRESS 0xd0009909 FORMAT "%3.0" /end MEASUREMENT
/begin MEASUREMENT fmy_stat_put_el_2.err_info_stat.lv_err_mem "storage in dynamic failure memory of the diagnosis instance PUT_EL_2" UWORD _CNV_S_2_RANGE__0___1_CM 1 100. 0. 1. DISPLAY_IDENTIFIER LV_ERR_MEM_PUT_EL_2 ECU_ADDRESS 0xd000990a BIT_MASK 0x8 /end MEASUREMENT
/begin MEASUREMENT fmy_stat_put_el_2.err_info_stat.lv_ready "readiness status of the diagnosis instance PUT_EL_2" UWORD _CNV_S_2_RANGE__0___1_CM 1 100. 0. 1. DISPLAY_IDENTIFIER LV_READY_PUT_EL_2 ECU_ADDRESS 0xd000990a BIT_MASK 0x10 /end MEASUREMENT
/begin MEASUREMENT fmy_stat_put_el_2.err_info_stat.lv_end_diag "end of diagnosis of the diagnosis instance PUT_EL_2" UWORD _CNV_S_2_RANGE__0___1_CM 1 100. 0. 1. DISPLAY_IDENTIFIER LV_END_DIAG_PUT_EL_2 ECU_ADDRESS 0xd000990a BIT_MASK 0x20 /end MEASUREMENT
/begin MEASUREMENT fmy_stat_put_el_2.err_info_stat.lv_cdn_diag "diagnosis condition of the diagnosis instance PUT_EL_2" UWORD _CNV_S_2_RANGE__0___1_CM 1 100. 0. 1. DISPLAY_IDENTIFIER LV_CDN_DIAG_PUT_EL_2 ECU_ADDRESS 0xd000990a BIT_MASK 0x40 /end MEASUREMENT
/begin MEASUREMENT fmy_stat_put_el_2.err_info_stat.err_sym "symptoms of the diagnosis instance PUT_EL_2" UWORD _CNV_S_16_RANGE_ERR__349_CM 1 100. 0. 15. DISPLAY_IDENTIFIER ERR_SYM_PUT_EL_2 ECU_ADDRESS 0xd000990a BIT_MASK 0x780 /end MEASUREMENT
/begin MEASUREMENT fmy_stat_igc_scp_0.ctr_abc "anti bounce counter for diagnosis instance IGC_SCP_0" UBYTE _CNV_A_R_LINEAR_____0_CM 1 100. 0. 255. DISPLAY_IDENTIFIER CTR_ABC_IGC_SCP_0 ECU_ADDRESS 0xd000972c FORMAT "%3.0" /end MEASUREMENT
/begin MEASUREMENT fmy_stat_igc_scp_0.ctr_end_diag "counter for end of diagnosis for diagnosis instance IGC_SCP_0" UBYTE _CNV_A_R_LINEAR_____0_CM 1 100. 0. 255. DISPLAY_IDENTIFIER CTR_ABC_END_DIAG_IGC_SCP_0 ECU_ADDRESS 0xd000972d FORMAT "%3.0" /end MEASUREMENT
/begin MEASUREMENT fmy_stat_igc_scp_0.err_info_stat.lv_err_mem "storage in dynamic failure memory of the diagnosis instance IGC_SCP_0" UWORD _CNV_S_2_RANGE__0___1_CM 1 100. 0. 1. DISPLAY_IDENTIFIER LV_ERR_MEM_IGC_SCP_0 ECU_ADDRESS 0xd000972e BIT_MASK 0x8 /end MEASUREMENT
/begin MEASUREMENT fmy_stat_igc_scp_0.err_info_stat.lv_ready "readiness status of the diagnosis instance IGC_SCP_0" UWORD _CNV_S_2_RANGE__0___1_CM 1 100. 0. 1. DISPLAY_IDENTIFIER LV_READY_IGC_SCP_0 ECU_ADDRESS 0xd000972e BIT_MASK 0x10 /end MEASUREMENT
/begin MEASUREMENT fmy_stat_igc_scp_0.err_info_stat.lv_end_diag "end of diagnosis of the diagnosis instance IGC_SCP_0" UWORD _CNV_S_2_RANGE__0___1_CM 1 100. 0. 1. DISPLAY_IDENTIFIER LV_END_DIAG_IGC_SCP_0 ECU_ADDRESS 0xd000972e BIT_MASK 0x20 /end MEASUREMENT
/begin MEASUREMENT fmy_stat_igc_scp_0.err_info_stat.lv_cdn_diag "diagnosis condition of the diagnosis instance IGC_SCP_0" UWORD _CNV_S_2_RANGE__0___1_CM 1 100. 0. 1. DISPLAY_IDENTIFIER LV_CDN_DIAG_IGC_SCP_0 ECU_ADDRESS 0xd000972e BIT_MASK 0x40 /end MEASUREMENT
/begin MEASUREMENT fmy_stat_igc_scp_0.err_info_stat.err_sym "symptoms of the diagnosis instance IGC_SCP_0" UWORD _CNV_S_16_RANGE_ERR__349_CM 1 100. 0. 15. DISPLAY_IDENTIFIER ERR_SYM_IGC_SCP_0 ECU_ADDRESS 0xd000972e BIT_MASK 0x780 /end MEASUREMENT
/begin MEASUREMENT fmy_stat_igc_scp_1.ctr_abc "anti bounce counter for diagnosis instance IGC_SCP_1" UBYTE _CNV_A_R_LINEAR_____0_CM 1 100. 0. 255. DISPLAY_IDENTIFIER CTR_ABC_IGC_SCP_1 ECU_ADDRESS 0xd0009730 FORMAT "%3.0" /end MEASUREMENT
/begin MEASUREMENT fmy_stat_igc_scp_1.ctr_end_diag "counter for end of diagnosis for diagnosis instance IGC_SCP_1" UBYTE _CNV_A_R_LINEAR_____0_CM 1 100. 0. 255. DISPLAY_IDENTIFIER CTR_ABC_END_DIAG_IGC_SCP_1 ECU_ADDRESS 0xd0009731 FORMAT "%3.0" /end MEASUREMENT
/begin MEASUREMENT fmy_stat_igc_scp_1.err_info_stat.lv_err_mem "storage in dynamic failure memory of the diagnosis instance IGC_SCP_1" UWORD _CNV_S_2_RANGE__0___1_CM 1 100. 0. 1. DISPLAY_IDENTIFIER LV_ERR_MEM_IGC_SCP_1 ECU_ADDRESS 0xd0009732 BIT_MASK 0x8 /end MEASUREMENT
/begin MEASUREMENT fmy_stat_igc_scp_1.err_info_stat.lv_ready "readiness status of the diagnosis instance IGC_SCP_1" UWORD _CNV_S_2_RANGE__0___1_CM 1 100. 0. 1. DISPLAY_IDENTIFIER LV_READY_IGC_SCP_1 ECU_ADDRESS 0xd0009732 BIT_MASK 0x10 /end MEASUREMENT
/begin MEASUREMENT fmy_stat_igc_scp_1.err_info_stat.lv_end_diag "end of diagnosis of the diagnosis instance IGC_SCP_1" UWORD _CNV_S_2_RANGE__0___1_CM 1 100. 0. 1. DISPLAY_IDENTIFIER LV_END_DIAG_IGC_SCP_1 ECU_ADDRESS 0xd0009732 BIT_MASK 0x20 /end MEASUREMENT
/begin MEASUREMENT fmy_stat_igc_scp_1.err_info_stat.lv_cdn_diag "diagnosis condition of the diagnosis instance IGC_SCP_1" UWORD _CNV_S_2_RANGE__0___1_CM 1 100. 0. 1. DISPLAY_IDENTIFIER LV_CDN_DIAG_IGC_SCP_1 ECU_ADDRESS 0xd0009732 BIT_MASK 0x40 /end MEASUREMENT
/begin MEASUREMENT fmy_stat_igc_scp_1.err_info_stat.err_sym "symptoms of the diagnosis instance IGC_SCP_1" UWORD _CNV_S_16_RANGE_ERR__349_CM 1 100. 0. 15. DISPLAY_IDENTIFIER ERR_SYM_IGC_SCP_1 ECU_ADDRESS 0xd0009732 BIT_MASK 0x780 /end MEASUREMENT
/begin MEASUREMENT fmy_stat_igc_scp_2.ctr_abc "anti bounce counter for diagnosis instance IGC_SCP_2" UBYTE _CNV_A_R_LINEAR_____0_CM 1 100. 0. 255. DISPLAY_IDENTIFIER CTR_ABC_IGC_SCP_2 ECU_ADDRESS 0xd0009734 FORMAT "%3.0" /end MEASUREMENT
/begin MEASUREMENT fmy_stat_igc_scp_2.ctr_end_diag "counter for end of diagnosis for diagnosis instance IGC_SCP_2" UBYTE _CNV_A_R_LINEAR_____0_CM 1 100. 0. 255. DISPLAY_IDENTIFIER CTR_ABC_END_DIAG_IGC_SCP_2 ECU_ADDRESS 0xd0009735 FORMAT "%3.0" /end MEASUREMENT
/begin MEASUREMENT fmy_stat_igc_scp_2.err_info_stat.lv_err_mem "storage in dynamic failure memory of the diagnosis instance IGC_SCP_2" UWORD _CNV_S_2_RANGE__0___1_CM 1 100. 0. 1. DISPLAY_IDENTIFIER LV_ERR_MEM_IGC_SCP_2 ECU_ADDRESS 0xd0009736 BIT_MASK 0x8 /end MEASUREMENT
/begin MEASUREMENT fmy_stat_igc_scp_2.err_info_stat.lv_ready "readiness status of the diagnosis instance IGC_SCP_2" UWORD _CNV_S_2_RANGE__0___1_CM 1 100. 0. 1. DISPLAY_IDENTIFIER LV_READY_IGC_SCP_2 ECU_ADDRESS 0xd0009736 BIT_MASK 0x10 /end MEASUREMENT
/begin MEASUREMENT fmy_stat_igc_scp_2.err_info_stat.lv_end_diag "end of diagnosis of the diagnosis instance IGC_SCP_2" UWORD _CNV_S_2_RANGE__0___1_CM 1 100. 0. 1. DISPLAY_IDENTIFIER LV_END_DIAG_IGC_SCP_2 ECU_ADDRESS 0xd0009736 BIT_MASK 0x20 /end MEASUREMENT
/begin MEASUREMENT fmy_stat_igc_scp_2.err_info_stat.lv_cdn_diag "diagnosis condition of the diagnosis instance IGC_SCP_2" UWORD _CNV_S_2_RANGE__0___1_CM 1 100. 0. 1. DISPLAY_IDENTIFIER LV_CDN_DIAG_IGC_SCP_2 ECU_ADDRESS 0xd0009736 BIT_MASK 0x40 /end MEASUREMENT
/begin MEASUREMENT fmy_stat_igc_scp_2.err_info_stat.err_sym "symptoms of the diagnosis instance IGC_SCP_2" UWORD _CNV_S_16_RANGE_ERR__349_CM 1 100. 0. 15. DISPLAY_IDENTIFIER ERR_SYM_IGC_SCP_2 ECU_ADDRESS 0xd0009736 BIT_MASK 0x780 /end MEASUREMENT
/begin MEASUREMENT fmy_stat_igc_scp_3.ctr_abc "anti bounce counter for diagnosis instance IGC_SCP_3" UBYTE _CNV_A_R_LINEAR_____0_CM 1 100. 0. 255. DISPLAY_IDENTIFIER CTR_ABC_IGC_SCP_3 ECU_ADDRESS 0xd0009738 FORMAT "%3.0" /end MEASUREMENT
/begin MEASUREMENT fmy_stat_igc_scp_3.ctr_end_diag "counter for end of diagnosis for diagnosis instance IGC_SCP_3" UBYTE _CNV_A_R_LINEAR_____0_CM 1 100. 0. 255. DISPLAY_IDENTIFIER CTR_ABC_END_DIAG_IGC_SCP_3 ECU_ADDRESS 0xd0009739 FORMAT "%3.0" /end MEASUREMENT
/begin MEASUREMENT fmy_stat_igc_scp_3.err_info_stat.lv_err_mem "storage in dynamic failure memory of the diagnosis instance IGC_SCP_3" UWORD _CNV_S_2_RANGE__0___1_CM 1 100. 0. 1. DISPLAY_IDENTIFIER LV_ERR_MEM_IGC_SCP_3 ECU_ADDRESS 0xd000973a BIT_MASK 0x8 /end MEASUREMENT
/begin MEASUREMENT fmy_stat_igc_scp_3.err_info_stat.lv_ready "readiness status of the diagnosis instance IGC_SCP_3" UWORD _CNV_S_2_RANGE__0___1_CM 1 100. 0. 1. DISPLAY_IDENTIFIER LV_READY_IGC_SCP_3 ECU_ADDRESS 0xd000973a BIT_MASK 0x10 /end MEASUREMENT
/begin MEASUREMENT fmy_stat_igc_scp_3.err_info_stat.lv_end_diag "end of diagnosis of the diagnosis instance IGC_SCP_3" UWORD _CNV_S_2_RANGE__0___1_CM 1 100. 0. 1. DISPLAY_IDENTIFIER LV_END_DIAG_IGC_SCP_3 ECU_ADDRESS 0xd000973a BIT_MASK 0x20 /end MEASUREMENT
/begin MEASUREMENT fmy_stat_igc_scp_3.err_info_stat.lv_cdn_diag "diagnosis condition of the diagnosis instance IGC_SCP_3" UWORD _CNV_S_2_RANGE__0___1_CM 1 100. 0. 1. DISPLAY_IDENTIFIER LV_CDN_DIAG_IGC_SCP_3 ECU_ADDRESS 0xd000973a BIT_MASK 0x40 /end MEASUREMENT
/begin MEASUREMENT fmy_stat_igc_scp_3.err_info_stat.err_sym "symptoms of the diagnosis instance IGC_SCP_3" UWORD _CNV_S_16_RANGE_ERR__349_CM 1 100. 0. 15. DISPLAY_IDENTIFIER ERR_SYM_IGC_SCP_3 ECU_ADDRESS 0xd000973a BIT_MASK 0x780 /end MEASUREMENT
/begin MEASUREMENT fmy_stat_igc_scp_4.ctr_abc "anti bounce counter for diagnosis instance IGC_SCP_4" UBYTE _CNV_A_R_LINEAR_____0_CM 1 100. 0. 255. DISPLAY_IDENTIFIER CTR_ABC_IGC_SCP_4 ECU_ADDRESS 0xd000973c FORMAT "%3.0" /end MEASUREMENT
/begin MEASUREMENT fmy_stat_igc_scp_4.ctr_end_diag "counter for end of diagnosis for diagnosis instance IGC_SCP_4" UBYTE _CNV_A_R_LINEAR_____0_CM 1 100. 0. 255. DISPLAY_IDENTIFIER CTR_ABC_END_DIAG_IGC_SCP_4 ECU_ADDRESS 0xd000973d FORMAT "%3.0" /end MEASUREMENT
/begin MEASUREMENT fmy_stat_igc_scp_4.err_info_stat.lv_err_mem "storage in dynamic failure memory of the diagnosis instance IGC_SCP_4" UWORD _CNV_S_2_RANGE__0___1_CM 1 100. 0. 1. DISPLAY_IDENTIFIER LV_ERR_MEM_IGC_SCP_4 ECU_ADDRESS 0xd000973e BIT_MASK 0x8 /end MEASUREMENT
/begin MEASUREMENT fmy_stat_igc_scp_4.err_info_stat.lv_ready "readiness status of the diagnosis instance IGC_SCP_4" UWORD _CNV_S_2_RANGE__0___1_CM 1 100. 0. 1. DISPLAY_IDENTIFIER LV_READY_IGC_SCP_4 ECU_ADDRESS 0xd000973e BIT_MASK 0x10 /end MEASUREMENT
/begin MEASUREMENT fmy_stat_igc_scp_4.err_info_stat.lv_end_diag "end of diagnosis of the diagnosis instance IGC_SCP_4" UWORD _CNV_S_2_RANGE__0___1_CM 1 100. 0. 1. DISPLAY_IDENTIFIER LV_END_DIAG_IGC_SCP_4 ECU_ADDRESS 0xd000973e BIT_MASK 0x20 /end MEASUREMENT
/begin MEASUREMENT fmy_stat_igc_scp_4.err_info_stat.lv_cdn_diag "diagnosis condition of the diagnosis instance IGC_SCP_4" UWORD _CNV_S_2_RANGE__0___1_CM 1 100. 0. 1. DISPLAY_IDENTIFIER LV_CDN_DIAG_IGC_SCP_4 ECU_ADDRESS 0xd000973e BIT_MASK 0x40 /end MEASUREMENT
/begin MEASUREMENT fmy_stat_igc_scp_4.err_info_stat.err_sym "symptoms of the diagnosis instance IGC_SCP_4" UWORD _CNV_S_16_RANGE_ERR__349_CM 1 100. 0. 15. DISPLAY_IDENTIFIER ERR_SYM_IGC_SCP_4 ECU_ADDRESS 0xd000973e BIT_MASK 0x780 /end MEASUREMENT
/begin MEASUREMENT fmy_stat_igc_scp_5.ctr_abc "anti bounce counter for diagnosis instance IGC_SCP_5" UBYTE _CNV_A_R_LINEAR_____0_CM 1 100. 0. 255. DISPLAY_IDENTIFIER CTR_ABC_IGC_SCP_5 ECU_ADDRESS 0xd0009740 FORMAT "%3.0" /end MEASUREMENT
/begin MEASUREMENT fmy_stat_igc_scp_5.ctr_end_diag "counter for end of diagnosis for diagnosis instance IGC_SCP_5" UBYTE _CNV_A_R_LINEAR_____0_CM 1 100. 0. 255. DISPLAY_IDENTIFIER CTR_ABC_END_DIAG_IGC_SCP_5 ECU_ADDRESS 0xd0009741 FORMAT "%3.0" /end MEASUREMENT
/begin MEASUREMENT fmy_stat_igc_scp_5.err_info_stat.lv_err_mem "storage in dynamic failure memory of the diagnosis instance IGC_SCP_5" UWORD _CNV_S_2_RANGE__0___1_CM 1 100. 0. 1. DISPLAY_IDENTIFIER LV_ERR_MEM_IGC_SCP_5 ECU_ADDRESS 0xd0009742 BIT_MASK 0x8 /end MEASUREMENT
/begin MEASUREMENT fmy_stat_igc_scp_5.err_info_stat.lv_ready "readiness status of the diagnosis instance IGC_SCP_5" UWORD _CNV_S_2_RANGE__0___1_CM 1 100. 0. 1. DISPLAY_IDENTIFIER LV_READY_IGC_SCP_5 ECU_ADDRESS 0xd0009742 BIT_MASK 0x10 /end MEASUREMENT
/begin MEASUREMENT fmy_stat_igc_scp_5.err_info_stat.lv_end_diag "end of diagnosis of the diagnosis instance IGC_SCP_5" UWORD _CNV_S_2_RANGE__0___1_CM 1 100. 0. 1. DISPLAY_IDENTIFIER LV_END_DIAG_IGC_SCP_5 ECU_ADDRESS 0xd0009742 BIT_MASK 0x20 /end MEASUREMENT
/begin MEASUREMENT fmy_stat_igc_scp_5.err_info_stat.lv_cdn_diag "diagnosis condition of the diagnosis instance IGC_SCP_5" UWORD _CNV_S_2_RANGE__0___1_CM 1 100. 0. 1. DISPLAY_IDENTIFIER LV_CDN_DIAG_IGC_SCP_5 ECU_ADDRESS 0xd0009742 BIT_MASK 0x40 /end MEASUREMENT
/begin MEASUREMENT fmy_stat_igc_scp_5.err_info_stat.err_sym "symptoms of the diagnosis instance IGC_SCP_5" UWORD _CNV_S_16_RANGE_ERR__349_CM 1 100. 0. 15. DISPLAY_IDENTIFIER ERR_SYM_IGC_SCP_5 ECU_ADDRESS 0xd0009742 BIT_MASK 0x780 /end MEASUREMENT
/begin MEASUREMENT fmy_stat_igc_scp_6.ctr_abc "anti bounce counter for diagnosis instance IGC_SCP_6" UBYTE _CNV_A_R_LINEAR_____0_CM 1 100. 0. 255. DISPLAY_IDENTIFIER CTR_ABC_IGC_SCP_6 ECU_ADDRESS 0xd0009744 FORMAT "%3.0" /end MEASUREMENT
/begin MEASUREMENT fmy_stat_igc_scp_6.ctr_end_diag "counter for end of diagnosis for diagnosis instance IGC_SCP_6" UBYTE _CNV_A_R_LINEAR_____0_CM 1 100. 0. 255. DISPLAY_IDENTIFIER CTR_ABC_END_DIAG_IGC_SCP_6 ECU_ADDRESS 0xd0009745 FORMAT "%3.0" /end MEASUREMENT
/begin MEASUREMENT fmy_stat_igc_scp_6.err_info_stat.lv_err_mem "storage in dynamic failure memory of the diagnosis instance IGC_SCP_6" UWORD _CNV_S_2_RANGE__0___1_CM 1 100. 0. 1. DISPLAY_IDENTIFIER LV_ERR_MEM_IGC_SCP_6 ECU_ADDRESS 0xd0009746 BIT_MASK 0x8 /end MEASUREMENT
/begin MEASUREMENT fmy_stat_igc_scp_6.err_info_stat.lv_ready "readiness status of the diagnosis instance IGC_SCP_6" UWORD _CNV_S_2_RANGE__0___1_CM 1 100. 0. 1. DISPLAY_IDENTIFIER LV_READY_IGC_SCP_6 ECU_ADDRESS 0xd0009746 BIT_MASK 0x10 /end MEASUREMENT
/begin MEASUREMENT fmy_stat_igc_scp_6.err_info_stat.lv_end_diag "end of diagnosis of the diagnosis instance IGC_SCP_6" UWORD _CNV_S_2_RANGE__0___1_CM 1 100. 0. 1. DISPLAY_IDENTIFIER LV_END_DIAG_IGC_SCP_6 ECU_ADDRESS 0xd0009746 BIT_MASK 0x20 /end MEASUREMENT
/begin MEASUREMENT fmy_stat_igc_scp_6.err_info_stat.lv_cdn_diag "diagnosis condition of the diagnosis instance IGC_SCP_6" UWORD _CNV_S_2_RANGE__0___1_CM 1 100. 0. 1. DISPLAY_IDENTIFIER LV_CDN_DIAG_IGC_SCP_6 ECU_ADDRESS 0xd0009746 BIT_MASK 0x40 /end MEASUREMENT
/begin MEASUREMENT fmy_stat_igc_scp_6.err_info_stat.err_sym "symptoms of the diagnosis instance IGC_SCP_6" UWORD _CNV_S_16_RANGE_ERR__349_CM 1 100. 0. 15. DISPLAY_IDENTIFIER ERR_SYM_IGC_SCP_6 ECU_ADDRESS 0xd0009746 BIT_MASK 0x780 /end MEASUREMENT
/begin MEASUREMENT fmy_stat_igc_scp_7.ctr_abc "anti bounce counter for diagnosis instance IGC_SCP_7" UBYTE _CNV_A_R_LINEAR_____0_CM 1 100. 0. 255. DISPLAY_IDENTIFIER CTR_ABC_IGC_SCP_7 ECU_ADDRESS 0xd0009748 FORMAT "%3.0" /end MEASUREMENT
/begin MEASUREMENT fmy_stat_igc_scp_7.ctr_end_diag "counter for end of diagnosis for diagnosis instance IGC_SCP_7" UBYTE _CNV_A_R_LINEAR_____0_CM 1 100. 0. 255. DISPLAY_IDENTIFIER CTR_ABC_END_DIAG_IGC_SCP_7 ECU_ADDRESS 0xd0009749 FORMAT "%3.0" /end MEASUREMENT
/begin MEASUREMENT fmy_stat_igc_scp_7.err_info_stat.lv_err_mem "storage in dynamic failure memory of the diagnosis instance IGC_SCP_7" UWORD _CNV_S_2_RANGE__0___1_CM 1 100. 0. 1. DISPLAY_IDENTIFIER LV_ERR_MEM_IGC_SCP_7 ECU_ADDRESS 0xd000974a BIT_MASK 0x8 /end MEASUREMENT
/begin MEASUREMENT fmy_stat_igc_scp_7.err_info_stat.lv_ready "readiness status of the diagnosis instance IGC_SCP_7" UWORD _CNV_S_2_RANGE__0___1_CM 1 100. 0. 1. DISPLAY_IDENTIFIER LV_READY_IGC_SCP_7 ECU_ADDRESS 0xd000974a BIT_MASK 0x10 /end MEASUREMENT
/begin MEASUREMENT fmy_stat_igc_scp_7.err_info_stat.lv_end_diag "end of diagnosis of the diagnosis instance IGC_SCP_7" UWORD _CNV_S_2_RANGE__0___1_CM 1 100. 0. 1. DISPLAY_IDENTIFIER LV_END_DIAG_IGC_SCP_7 ECU_ADDRESS 0xd000974a BIT_MASK 0x20 /end MEASUREMENT
/begin MEASUREMENT fmy_stat_igc_scp_7.err_info_stat.lv_cdn_diag "diagnosis condition of the diagnosis instance IGC_SCP_7" UWORD _CNV_S_2_RANGE__0___1_CM 1 100. 0. 1. DISPLAY_IDENTIFIER LV_CDN_DIAG_IGC_SCP_7 ECU_ADDRESS 0xd000974a BIT_MASK 0x40 /end MEASUREMENT
/begin MEASUREMENT fmy_stat_igc_scp_7.err_info_stat.err_sym "symptoms of the diagnosis instance IGC_SCP_7" UWORD _CNV_S_16_RANGE_ERR__349_CM 1 100. 0. 15. DISPLAY_IDENTIFIER ERR_SYM_IGC_SCP_7 ECU_ADDRESS 0xd000974a BIT_MASK 0x780 /end MEASUREMENT
/begin MEASUREMENT fmy_stat_igc_scg_0.ctr_abc "anti bounce counter for diagnosis instance IGC_SCG_0" UBYTE _CNV_A_R_LINEAR_____0_CM 1 100. 0. 255. DISPLAY_IDENTIFIER CTR_ABC_IGC_SCG_0 ECU_ADDRESS 0xd000970c FORMAT "%3.0" /end MEASUREMENT
/begin MEASUREMENT fmy_stat_igc_scg_0.ctr_end_diag "counter for end of diagnosis for diagnosis instance IGC_SCG_0" UBYTE _CNV_A_R_LINEAR_____0_CM 1 100. 0. 255. DISPLAY_IDENTIFIER CTR_ABC_END_DIAG_IGC_SCG_0 ECU_ADDRESS 0xd000970d FORMAT "%3.0" /end MEASUREMENT
/begin MEASUREMENT fmy_stat_igc_scg_0.err_info_stat.lv_err_mem "storage in dynamic failure memory of the diagnosis instance IGC_SCG_0" UWORD _CNV_S_2_RANGE__0___1_CM 1 100. 0. 1. DISPLAY_IDENTIFIER LV_ERR_MEM_IGC_SCG_0 ECU_ADDRESS 0xd000970e BIT_MASK 0x8 /end MEASUREMENT
/begin MEASUREMENT fmy_stat_igc_scg_0.err_info_stat.lv_ready "readiness status of the diagnosis instance IGC_SCG_0" UWORD _CNV_S_2_RANGE__0___1_CM 1 100. 0. 1. DISPLAY_IDENTIFIER LV_READY_IGC_SCG_0 ECU_ADDRESS 0xd000970e BIT_MASK 0x10 /end MEASUREMENT
/begin MEASUREMENT fmy_stat_igc_scg_0.err_info_stat.lv_end_diag "end of diagnosis of the diagnosis instance IGC_SCG_0" UWORD _CNV_S_2_RANGE__0___1_CM 1 100. 0. 1. DISPLAY_IDENTIFIER LV_END_DIAG_IGC_SCG_0 ECU_ADDRESS 0xd000970e BIT_MASK 0x20 /end MEASUREMENT
/begin MEASUREMENT fmy_stat_igc_scg_0.err_info_stat.lv_cdn_diag "diagnosis condition of the diagnosis instance IGC_SCG_0" UWORD _CNV_S_2_RANGE__0___1_CM 1 100. 0. 1. DISPLAY_IDENTIFIER LV_CDN_DIAG_IGC_SCG_0 ECU_ADDRESS 0xd000970e BIT_MASK 0x40 /end MEASUREMENT
/begin MEASUREMENT fmy_stat_igc_scg_0.err_info_stat.err_sym "symptoms of the diagnosis instance IGC_SCG_0" UWORD _CNV_S_16_RANGE_ERR__349_CM 1 100. 0. 15. DISPLAY_IDENTIFIER ERR_SYM_IGC_SCG_0 ECU_ADDRESS 0xd000970e BIT_MASK 0x780 /end MEASUREMENT
/begin MEASUREMENT fmy_stat_igc_scg_1.ctr_abc "anti bounce counter for diagnosis instance IGC_SCG_1" UBYTE _CNV_A_R_LINEAR_____0_CM 1 100. 0. 255. DISPLAY_IDENTIFIER CTR_ABC_IGC_SCG_1 ECU_ADDRESS 0xd0009710 FORMAT "%3.0" /end MEASUREMENT
/begin MEASUREMENT fmy_stat_igc_scg_1.ctr_end_diag "counter for end of diagnosis for diagnosis instance IGC_SCG_1" UBYTE _CNV_A_R_LINEAR_____0_CM 1 100. 0. 255. DISPLAY_IDENTIFIER CTR_ABC_END_DIAG_IGC_SCG_1 ECU_ADDRESS 0xd0009711 FORMAT "%3.0" /end MEASUREMENT
/begin MEASUREMENT fmy_stat_igc_scg_1.err_info_stat.lv_err_mem "storage in dynamic failure memory of the diagnosis instance IGC_SCG_1" UWORD _CNV_S_2_RANGE__0___1_CM 1 100. 0. 1. DISPLAY_IDENTIFIER LV_ERR_MEM_IGC_SCG_1 ECU_ADDRESS 0xd0009712 BIT_MASK 0x8 /end MEASUREMENT
/begin MEASUREMENT fmy_stat_igc_scg_1.err_info_stat.lv_ready "readiness status of the diagnosis instance IGC_SCG_1" UWORD _CNV_S_2_RANGE__0___1_CM 1 100. 0. 1. DISPLAY_IDENTIFIER LV_READY_IGC_SCG_1 ECU_ADDRESS 0xd0009712 BIT_MASK 0x10 /end MEASUREMENT
/begin MEASUREMENT fmy_stat_igc_scg_1.err_info_stat.lv_end_diag "end of diagnosis of the diagnosis instance IGC_SCG_1" UWORD _CNV_S_2_RANGE__0___1_CM 1 100. 0. 1. DISPLAY_IDENTIFIER LV_END_DIAG_IGC_SCG_1 ECU_ADDRESS 0xd0009712 BIT_MASK 0x20 /end MEASUREMENT
/begin MEASUREMENT fmy_stat_igc_scg_1.err_info_stat.lv_cdn_diag "diagnosis condition of the diagnosis instance IGC_SCG_1" UWORD _CNV_S_2_RANGE__0___1_CM 1 100. 0. 1. DISPLAY_IDENTIFIER LV_CDN_DIAG_IGC_SCG_1 ECU_ADDRESS 0xd0009712 BIT_MASK 0x40 /end MEASUREMENT
/begin MEASUREMENT fmy_stat_igc_scg_1.err_info_stat.err_sym "symptoms of the diagnosis instance IGC_SCG_1" UWORD _CNV_S_16_RANGE_ERR__349_CM 1 100. 0. 15. DISPLAY_IDENTIFIER ERR_SYM_IGC_SCG_1 ECU_ADDRESS 0xd0009712 BIT_MASK 0x780 /end MEASUREMENT
/begin MEASUREMENT fmy_stat_igc_scg_2.ctr_abc "anti bounce counter for diagnosis instance IGC_SCG_2" UBYTE _CNV_A_R_LINEAR_____0_CM 1 100. 0. 255. DISPLAY_IDENTIFIER CTR_ABC_IGC_SCG_2 ECU_ADDRESS 0xd0009714 FORMAT "%3.0" /end MEASUREMENT
/begin MEASUREMENT fmy_stat_igc_scg_2.ctr_end_diag "counter for end of diagnosis for diagnosis instance IGC_SCG_2" UBYTE _CNV_A_R_LINEAR_____0_CM 1 100. 0. 255. DISPLAY_IDENTIFIER CTR_ABC_END_DIAG_IGC_SCG_2 ECU_ADDRESS 0xd0009715 FORMAT "%3.0" /end MEASUREMENT
/begin MEASUREMENT fmy_stat_igc_scg_2.err_info_stat.lv_err_mem "storage in dynamic failure memory of the diagnosis instance IGC_SCG_2" UWORD _CNV_S_2_RANGE__0___1_CM 1 100. 0. 1. DISPLAY_IDENTIFIER LV_ERR_MEM_IGC_SCG_2 ECU_ADDRESS 0xd0009716 BIT_MASK 0x8 /end MEASUREMENT
/begin MEASUREMENT fmy_stat_igc_scg_2.err_info_stat.lv_ready "readiness status of the diagnosis instance IGC_SCG_2" UWORD _CNV_S_2_RANGE__0___1_CM 1 100. 0. 1. DISPLAY_IDENTIFIER LV_READY_IGC_SCG_2 ECU_ADDRESS 0xd0009716 BIT_MASK 0x10 /end MEASUREMENT
/begin MEASUREMENT fmy_stat_igc_scg_2.err_info_stat.lv_end_diag "end of diagnosis of the diagnosis instance IGC_SCG_2" UWORD _CNV_S_2_RANGE__0___1_CM 1 100. 0. 1. DISPLAY_IDENTIFIER LV_END_DIAG_IGC_SCG_2 ECU_ADDRESS 0xd0009716 BIT_MASK 0x20 /end MEASUREMENT
/begin MEASUREMENT fmy_stat_igc_scg_2.err_info_stat.lv_cdn_diag "diagnosis condition of the diagnosis instance IGC_SCG_2" UWORD _CNV_S_2_RANGE__0___1_CM 1 100. 0. 1. DISPLAY_IDENTIFIER LV_CDN_DIAG_IGC_SCG_2 ECU_ADDRESS 0xd0009716 BIT_MASK 0x40 /end MEASUREMENT
/begin MEASUREMENT fmy_stat_igc_scg_2.err_info_stat.err_sym "symptoms of the diagnosis instance IGC_SCG_2" UWORD _CNV_S_16_RANGE_ERR__349_CM 1 100. 0. 15. DISPLAY_IDENTIFIER ERR_SYM_IGC_SCG_2 ECU_ADDRESS 0xd0009716 BIT_MASK 0x780 /end MEASUREMENT
/begin MEASUREMENT fmy_stat_igc_scg_3.ctr_abc "anti bounce counter for diagnosis instance IGC_SCG_3" UBYTE _CNV_A_R_LINEAR_____0_CM 1 100. 0. 255. DISPLAY_IDENTIFIER CTR_ABC_IGC_SCG_3 ECU_ADDRESS 0xd0009718 FORMAT "%3.0" /end MEASUREMENT
/begin MEASUREMENT fmy_stat_igc_scg_3.ctr_end_diag "counter for end of diagnosis for diagnosis instance IGC_SCG_3" UBYTE _CNV_A_R_LINEAR_____0_CM 1 100. 0. 255. DISPLAY_IDENTIFIER CTR_ABC_END_DIAG_IGC_SCG_3 ECU_ADDRESS 0xd0009719 FORMAT "%3.0" /end MEASUREMENT
/begin MEASUREMENT fmy_stat_igc_scg_3.err_info_stat.lv_err_mem "storage in dynamic failure memory of the diagnosis instance IGC_SCG_3" UWORD _CNV_S_2_RANGE__0___1_CM 1 100. 0. 1. DISPLAY_IDENTIFIER LV_ERR_MEM_IGC_SCG_3 ECU_ADDRESS 0xd000971a BIT_MASK 0x8 /end MEASUREMENT
/begin MEASUREMENT fmy_stat_igc_scg_3.err_info_stat.lv_ready "readiness status of the diagnosis instance IGC_SCG_3" UWORD _CNV_S_2_RANGE__0___1_CM 1 100. 0. 1. DISPLAY_IDENTIFIER LV_READY_IGC_SCG_3 ECU_ADDRESS 0xd000971a BIT_MASK 0x10 /end MEASUREMENT
/begin MEASUREMENT fmy_stat_igc_scg_3.err_info_stat.lv_end_diag "end of diagnosis of the diagnosis instance IGC_SCG_3" UWORD _CNV_S_2_RANGE__0___1_CM 1 100. 0. 1. DISPLAY_IDENTIFIER LV_END_DIAG_IGC_SCG_3 ECU_ADDRESS 0xd000971a BIT_MASK 0x20 /end MEASUREMENT
/begin MEASUREMENT fmy_stat_igc_scg_3.err_info_stat.lv_cdn_diag "diagnosis condition of the diagnosis instance IGC_SCG_3" UWORD _CNV_S_2_RANGE__0___1_CM 1 100. 0. 1. DISPLAY_IDENTIFIER LV_CDN_DIAG_IGC_SCG_3 ECU_ADDRESS 0xd000971a BIT_MASK 0x40 /end MEASUREMENT
/begin MEASUREMENT fmy_stat_igc_scg_3.err_info_stat.err_sym "symptoms of the diagnosis instance IGC_SCG_3" UWORD _CNV_S_16_RANGE_ERR__349_CM 1 100. 0. 15. DISPLAY_IDENTIFIER ERR_SYM_IGC_SCG_3 ECU_ADDRESS 0xd000971a BIT_MASK 0x780 /end MEASUREMENT
/begin MEASUREMENT fmy_stat_igc_scg_4.ctr_abc "anti bounce counter for diagnosis instance IGC_SCG_4" UBYTE _CNV_A_R_LINEAR_____0_CM 1 100. 0. 255. DISPLAY_IDENTIFIER CTR_ABC_IGC_SCG_4 ECU_ADDRESS 0xd000971c FORMAT "%3.0" /end MEASUREMENT
/begin MEASUREMENT fmy_stat_igc_scg_4.ctr_end_diag "counter for end of diagnosis for diagnosis instance IGC_SCG_4" UBYTE _CNV_A_R_LINEAR_____0_CM 1 100. 0. 255. DISPLAY_IDENTIFIER CTR_ABC_END_DIAG_IGC_SCG_4 ECU_ADDRESS 0xd000971d FORMAT "%3.0" /end MEASUREMENT
/begin MEASUREMENT fmy_stat_igc_scg_4.err_info_stat.lv_err_mem "storage in dynamic failure memory of the diagnosis instance IGC_SCG_4" UWORD _CNV_S_2_RANGE__0___1_CM 1 100. 0. 1. DISPLAY_IDENTIFIER LV_ERR_MEM_IGC_SCG_4 ECU_ADDRESS 0xd000971e BIT_MASK 0x8 /end MEASUREMENT
/begin MEASUREMENT fmy_stat_igc_scg_4.err_info_stat.lv_ready "readiness status of the diagnosis instance IGC_SCG_4" UWORD _CNV_S_2_RANGE__0___1_CM 1 100. 0. 1. DISPLAY_IDENTIFIER LV_READY_IGC_SCG_4 ECU_ADDRESS 0xd000971e BIT_MASK 0x10 /end MEASUREMENT
/begin MEASUREMENT fmy_stat_igc_scg_4.err_info_stat.lv_end_diag "end of diagnosis of the diagnosis instance IGC_SCG_4" UWORD _CNV_S_2_RANGE__0___1_CM 1 100. 0. 1. DISPLAY_IDENTIFIER LV_END_DIAG_IGC_SCG_4 ECU_ADDRESS 0xd000971e BIT_MASK 0x20 /end MEASUREMENT
/begin MEASUREMENT fmy_stat_igc_scg_4.err_info_stat.lv_cdn_diag "diagnosis condition of the diagnosis instance IGC_SCG_4" UWORD _CNV_S_2_RANGE__0___1_CM 1 100. 0. 1. DISPLAY_IDENTIFIER LV_CDN_DIAG_IGC_SCG_4 ECU_ADDRESS 0xd000971e BIT_MASK 0x40 /end MEASUREMENT
/begin MEASUREMENT fmy_stat_igc_scg_4.err_info_stat.err_sym "symptoms of the diagnosis instance IGC_SCG_4" UWORD _CNV_S_16_RANGE_ERR__349_CM 1 100. 0. 15. DISPLAY_IDENTIFIER ERR_SYM_IGC_SCG_4 ECU_ADDRESS 0xd000971e BIT_MASK 0x780 /end MEASUREMENT
/begin MEASUREMENT fmy_stat_igc_scg_5.ctr_abc "anti bounce counter for diagnosis instance IGC_SCG_5" UBYTE _CNV_A_R_LINEAR_____0_CM 1 100. 0. 255. DISPLAY_IDENTIFIER CTR_ABC_IGC_SCG_5 ECU_ADDRESS 0xd0009720 FORMAT "%3.0" /end MEASUREMENT
/begin MEASUREMENT fmy_stat_igc_scg_5.ctr_end_diag "counter for end of diagnosis for diagnosis instance IGC_SCG_5" UBYTE _CNV_A_R_LINEAR_____0_CM 1 100. 0. 255. DISPLAY_IDENTIFIER CTR_ABC_END_DIAG_IGC_SCG_5 ECU_ADDRESS 0xd0009721 FORMAT "%3.0" /end MEASUREMENT
/begin MEASUREMENT fmy_stat_igc_scg_5.err_info_stat.lv_err_mem "storage in dynamic failure memory of the diagnosis instance IGC_SCG_5" UWORD _CNV_S_2_RANGE__0___1_CM 1 100. 0. 1. DISPLAY_IDENTIFIER LV_ERR_MEM_IGC_SCG_5 ECU_ADDRESS 0xd0009722 BIT_MASK 0x8 /end MEASUREMENT
/begin MEASUREMENT fmy_stat_igc_scg_5.err_info_stat.lv_ready "readiness status of the diagnosis instance IGC_SCG_5" UWORD _CNV_S_2_RANGE__0___1_CM 1 100. 0. 1. DISPLAY_IDENTIFIER LV_READY_IGC_SCG_5 ECU_ADDRESS 0xd0009722 BIT_MASK 0x10 /end MEASUREMENT
/begin MEASUREMENT fmy_stat_igc_scg_5.err_info_stat.lv_end_diag "end of diagnosis of the diagnosis instance IGC_SCG_5" UWORD _CNV_S_2_RANGE__0___1_CM 1 100. 0. 1. DISPLAY_IDENTIFIER LV_END_DIAG_IGC_SCG_5 ECU_ADDRESS 0xd0009722 BIT_MASK 0x20 /end MEASUREMENT
/begin MEASUREMENT fmy_stat_igc_scg_5.err_info_stat.lv_cdn_diag "diagnosis condition of the diagnosis instance IGC_SCG_5" UWORD _CNV_S_2_RANGE__0___1_CM 1 100. 0. 1. DISPLAY_IDENTIFIER LV_CDN_DIAG_IGC_SCG_5 ECU_ADDRESS 0xd0009722 BIT_MASK 0x40 /end MEASUREMENT
/begin MEASUREMENT fmy_stat_igc_scg_5.err_info_stat.err_sym "symptoms of the diagnosis instance IGC_SCG_5" UWORD _CNV_S_16_RANGE_ERR__349_CM 1 100. 0. 15. DISPLAY_IDENTIFIER ERR_SYM_IGC_SCG_5 ECU_ADDRESS 0xd0009722 BIT_MASK 0x780 /end MEASUREMENT
/begin MEASUREMENT fmy_stat_igc_scg_6.ctr_abc "anti bounce counter for diagnosis instance IGC_SCG_6" UBYTE _CNV_A_R_LINEAR_____0_CM 1 100. 0. 255. DISPLAY_IDENTIFIER CTR_ABC_IGC_SCG_6 ECU_ADDRESS 0xd0009724 FORMAT "%3.0" /end MEASUREMENT
/begin MEASUREMENT fmy_stat_igc_scg_6.ctr_end_diag "counter for end of diagnosis for diagnosis instance IGC_SCG_6" UBYTE _CNV_A_R_LINEAR_____0_CM 1 100. 0. 255. DISPLAY_IDENTIFIER CTR_ABC_END_DIAG_IGC_SCG_6 ECU_ADDRESS 0xd0009725 FORMAT "%3.0" /end MEASUREMENT
/begin MEASUREMENT fmy_stat_igc_scg_6.err_info_stat.lv_err_mem "storage in dynamic failure memory of the diagnosis instance IGC_SCG_6" UWORD _CNV_S_2_RANGE__0___1_CM 1 100. 0. 1. DISPLAY_IDENTIFIER LV_ERR_MEM_IGC_SCG_6 ECU_ADDRESS 0xd0009726 BIT_MASK 0x8 /end MEASUREMENT
/begin MEASUREMENT fmy_stat_igc_scg_6.err_info_stat.lv_ready "readiness status of the diagnosis instance IGC_SCG_6" UWORD _CNV_S_2_RANGE__0___1_CM 1 100. 0. 1. DISPLAY_IDENTIFIER LV_READY_IGC_SCG_6 ECU_ADDRESS 0xd0009726 BIT_MASK 0x10 /end MEASUREMENT
/begin MEASUREMENT fmy_stat_igc_scg_6.err_info_stat.lv_end_diag "end of diagnosis of the diagnosis instance IGC_SCG_6" UWORD _CNV_S_2_RANGE__0___1_CM 1 100. 0. 1. DISPLAY_IDENTIFIER LV_END_DIAG_IGC_SCG_6 ECU_ADDRESS 0xd0009726 BIT_MASK 0x20 /end MEASUREMENT
/begin MEASUREMENT fmy_stat_igc_scg_6.err_info_stat.lv_cdn_diag "diagnosis condition of the diagnosis instance IGC_SCG_6" UWORD _CNV_S_2_RANGE__0___1_CM 1 100. 0. 1. DISPLAY_IDENTIFIER LV_CDN_DIAG_IGC_SCG_6 ECU_ADDRESS 0xd0009726 BIT_MASK 0x40 /end MEASUREMENT
/begin MEASUREMENT fmy_stat_igc_scg_6.err_info_stat.err_sym "symptoms of the diagnosis instance IGC_SCG_6" UWORD _CNV_S_16_RANGE_ERR__349_CM 1 100. 0. 15. DISPLAY_IDENTIFIER ERR_SYM_IGC_SCG_6 ECU_ADDRESS 0xd0009726 BIT_MASK 0x780 /end MEASUREMENT
/begin MEASUREMENT fmy_stat_igc_scg_7.ctr_abc "anti bounce counter for diagnosis instance IGC_SCG_7" UBYTE _CNV_A_R_LINEAR_____0_CM 1 100. 0. 255. DISPLAY_IDENTIFIER CTR_ABC_IGC_SCG_7 ECU_ADDRESS 0xd0009728 FORMAT "%3.0" /end MEASUREMENT
/begin MEASUREMENT fmy_stat_igc_scg_7.ctr_end_diag "counter for end of diagnosis for diagnosis instance IGC_SCG_7" UBYTE _CNV_A_R_LINEAR_____0_CM 1 100. 0. 255. DISPLAY_IDENTIFIER CTR_ABC_END_DIAG_IGC_SCG_7 ECU_ADDRESS 0xd0009729 FORMAT "%3.0" /end MEASUREMENT
/begin MEASUREMENT fmy_stat_igc_scg_7.err_info_stat.lv_err_mem "storage in dynamic failure memory of the diagnosis instance IGC_SCG_7" UWORD _CNV_S_2_RANGE__0___1_CM 1 100. 0. 1. DISPLAY_IDENTIFIER LV_ERR_MEM_IGC_SCG_7 ECU_ADDRESS 0xd000972a BIT_MASK 0x8 /end MEASUREMENT
/begin MEASUREMENT fmy_stat_igc_scg_7.err_info_stat.lv_ready "readiness status of the diagnosis instance IGC_SCG_7" UWORD _CNV_S_2_RANGE__0___1_CM 1 100. 0. 1. DISPLAY_IDENTIFIER LV_READY_IGC_SCG_7 ECU_ADDRESS 0xd000972a BIT_MASK 0x10 /end MEASUREMENT
/begin MEASUREMENT fmy_stat_igc_scg_7.err_info_stat.lv_end_diag "end of diagnosis of the diagnosis instance IGC_SCG_7" UWORD _CNV_S_2_RANGE__0___1_CM 1 100. 0. 1. DISPLAY_IDENTIFIER LV_END_DIAG_IGC_SCG_7 ECU_ADDRESS 0xd000972a BIT_MASK 0x20 /end MEASUREMENT
/begin MEASUREMENT fmy_stat_igc_scg_7.err_info_stat.lv_cdn_diag "diagnosis condition of the diagnosis instance IGC_SCG_7" UWORD _CNV_S_2_RANGE__0___1_CM 1 100. 0. 1. DISPLAY_IDENTIFIER LV_CDN_DIAG_IGC_SCG_7 ECU_ADDRESS 0xd000972a BIT_MASK 0x40 /end MEASUREMENT
/begin MEASUREMENT fmy_stat_igc_scg_7.err_info_stat.err_sym "symptoms of the diagnosis instance IGC_SCG_7" UWORD _CNV_S_16_RANGE_ERR__349_CM 1 100. 0. 15. DISPLAY_IDENTIFIER ERR_SYM_IGC_SCG_7 ECU_ADDRESS 0xd000972a BIT_MASK 0x780 /end MEASUREMENT
/begin MEASUREMENT fmy_stat_igc_ol_0.ctr_abc "anti bounce counter for diagnosis instance IGC_OL_0" UBYTE _CNV_A_R_LINEAR_____0_CM 1 100. 0. 255. DISPLAY_IDENTIFIER CTR_ABC_IGC_OL_0 ECU_ADDRESS 0xd00096ec FORMAT "%3.0" /end MEASUREMENT
/begin MEASUREMENT fmy_stat_igc_ol_0.ctr_end_diag "counter for end of diagnosis for diagnosis instance IGC_OL_0" UBYTE _CNV_A_R_LINEAR_____0_CM 1 100. 0. 255. DISPLAY_IDENTIFIER CTR_ABC_END_DIAG_IGC_OL_0 ECU_ADDRESS 0xd00096ed FORMAT "%3.0" /end MEASUREMENT
/begin MEASUREMENT fmy_stat_igc_ol_0.err_info_stat.lv_err_mem "storage in dynamic failure memory of the diagnosis instance IGC_OL_0" UWORD _CNV_S_2_RANGE__0___1_CM 1 100. 0. 1. DISPLAY_IDENTIFIER LV_ERR_MEM_IGC_OL_0 ECU_ADDRESS 0xd00096ee BIT_MASK 0x8 /end MEASUREMENT
/begin MEASUREMENT fmy_stat_igc_ol_0.err_info_stat.lv_ready "readiness status of the diagnosis instance IGC_OL_0" UWORD _CNV_S_2_RANGE__0___1_CM 1 100. 0. 1. DISPLAY_IDENTIFIER LV_READY_IGC_OL_0 ECU_ADDRESS 0xd00096ee BIT_MASK 0x10 /end MEASUREMENT
/begin MEASUREMENT fmy_stat_igc_ol_0.err_info_stat.lv_end_diag "end of diagnosis of the diagnosis instance IGC_OL_0" UWORD _CNV_S_2_RANGE__0___1_CM 1 100. 0. 1. DISPLAY_IDENTIFIER LV_END_DIAG_IGC_OL_0 ECU_ADDRESS 0xd00096ee BIT_MASK 0x20 /end MEASUREMENT
/begin MEASUREMENT fmy_stat_igc_ol_0.err_info_stat.lv_cdn_diag "diagnosis condition of the diagnosis instance IGC_OL_0" UWORD _CNV_S_2_RANGE__0___1_CM 1 100. 0. 1. DISPLAY_IDENTIFIER LV_CDN_DIAG_IGC_OL_0 ECU_ADDRESS 0xd00096ee BIT_MASK 0x40 /end MEASUREMENT
/begin MEASUREMENT fmy_stat_igc_ol_0.err_info_stat.err_sym "symptoms of the diagnosis instance IGC_OL_0" UWORD _CNV_S_16_RANGE_ERR__349_CM 1 100. 0. 15. DISPLAY_IDENTIFIER ERR_SYM_IGC_OL_0 ECU_ADDRESS 0xd00096ee BIT_MASK 0x780 /end MEASUREMENT
/begin MEASUREMENT fmy_stat_igc_ol_1.ctr_abc "anti bounce counter for diagnosis instance IGC_OL_1" UBYTE _CNV_A_R_LINEAR_____0_CM 1 100. 0. 255. DISPLAY_IDENTIFIER CTR_ABC_IGC_OL_1 ECU_ADDRESS 0xd00096f0 FORMAT "%3.0" /end MEASUREMENT
/begin MEASUREMENT fmy_stat_igc_ol_1.ctr_end_diag "counter for end of diagnosis for diagnosis instance IGC_OL_1" UBYTE _CNV_A_R_LINEAR_____0_CM 1 100. 0. 255. DISPLAY_IDENTIFIER CTR_ABC_END_DIAG_IGC_OL_1 ECU_ADDRESS 0xd00096f1 FORMAT "%3.0" /end MEASUREMENT
/begin MEASUREMENT fmy_stat_igc_ol_1.err_info_stat.lv_err_mem "storage in dynamic failure memory of the diagnosis instance IGC_OL_1" UWORD _CNV_S_2_RANGE__0___1_CM 1 100. 0. 1. DISPLAY_IDENTIFIER LV_ERR_MEM_IGC_OL_1 ECU_ADDRESS 0xd00096f2 BIT_MASK 0x8 /end MEASUREMENT
/begin MEASUREMENT fmy_stat_igc_ol_1.err_info_stat.lv_ready "readiness status of the diagnosis instance IGC_OL_1" UWORD _CNV_S_2_RANGE__0___1_CM 1 100. 0. 1. DISPLAY_IDENTIFIER LV_READY_IGC_OL_1 ECU_ADDRESS 0xd00096f2 BIT_MASK 0x10 /end MEASUREMENT
/begin MEASUREMENT fmy_stat_igc_ol_1.err_info_stat.lv_end_diag "end of diagnosis of the diagnosis instance IGC_OL_1" UWORD _CNV_S_2_RANGE__0___1_CM 1 100. 0. 1. DISPLAY_IDENTIFIER LV_END_DIAG_IGC_OL_1 ECU_ADDRESS 0xd00096f2 BIT_MASK 0x20 /end MEASUREMENT
/begin MEASUREMENT fmy_stat_igc_ol_1.err_info_stat.lv_cdn_diag "diagnosis condition of the diagnosis instance IGC_OL_1" UWORD _CNV_S_2_RANGE__0___1_CM 1 100. 0. 1. DISPLAY_IDENTIFIER LV_CDN_DIAG_IGC_OL_1 ECU_ADDRESS 0xd00096f2 BIT_MASK 0x40 /end MEASUREMENT
/begin MEASUREMENT fmy_stat_igc_ol_1.err_info_stat.err_sym "symptoms of the diagnosis instance IGC_OL_1" UWORD _CNV_S_16_RANGE_ERR__349_CM 1 100. 0. 15. DISPLAY_IDENTIFIER ERR_SYM_IGC_OL_1 ECU_ADDRESS 0xd00096f2 BIT_MASK 0x780 /end MEASUREMENT
/begin MEASUREMENT fmy_stat_igc_ol_2.ctr_abc "anti bounce counter for diagnosis instance IGC_OL_2" UBYTE _CNV_A_R_LINEAR_____0_CM 1 100. 0. 255. DISPLAY_IDENTIFIER CTR_ABC_IGC_OL_2 ECU_ADDRESS 0xd00096f4 FORMAT "%3.0" /end MEASUREMENT
/begin MEASUREMENT fmy_stat_igc_ol_2.ctr_end_diag "counter for end of diagnosis for diagnosis instance IGC_OL_2" UBYTE _CNV_A_R_LINEAR_____0_CM 1 100. 0. 255. DISPLAY_IDENTIFIER CTR_ABC_END_DIAG_IGC_OL_2 ECU_ADDRESS 0xd00096f5 FORMAT "%3.0" /end MEASUREMENT
/begin MEASUREMENT fmy_stat_igc_ol_2.err_info_stat.lv_err_mem "storage in dynamic failure memory of the diagnosis instance IGC_OL_2" UWORD _CNV_S_2_RANGE__0___1_CM 1 100. 0. 1. DISPLAY_IDENTIFIER LV_ERR_MEM_IGC_OL_2 ECU_ADDRESS 0xd00096f6 BIT_MASK 0x8 /end MEASUREMENT
/begin MEASUREMENT fmy_stat_igc_ol_2.err_info_stat.lv_ready "readiness status of the diagnosis instance IGC_OL_2" UWORD _CNV_S_2_RANGE__0___1_CM 1 100. 0. 1. DISPLAY_IDENTIFIER LV_READY_IGC_OL_2 ECU_ADDRESS 0xd00096f6 BIT_MASK 0x10 /end MEASUREMENT
/begin MEASUREMENT fmy_stat_igc_ol_2.err_info_stat.lv_end_diag "end of diagnosis of the diagnosis instance IGC_OL_2" UWORD _CNV_S_2_RANGE__0___1_CM 1 100. 0. 1. DISPLAY_IDENTIFIER LV_END_DIAG_IGC_OL_2 ECU_ADDRESS 0xd00096f6 BIT_MASK 0x20 /end MEASUREMENT
/begin MEASUREMENT fmy_stat_igc_ol_2.err_info_stat.lv_cdn_diag "diagnosis condition of the diagnosis instance IGC_OL_2" UWORD _CNV_S_2_RANGE__0___1_CM 1 100. 0. 1. DISPLAY_IDENTIFIER LV_CDN_DIAG_IGC_OL_2 ECU_ADDRESS 0xd00096f6 BIT_MASK 0x40 /end MEASUREMENT
/begin MEASUREMENT fmy_stat_igc_ol_2.err_info_stat.err_sym "symptoms of the diagnosis instance IGC_OL_2" UWORD _CNV_S_16_RANGE_ERR__349_CM 1 100. 0. 15. DISPLAY_IDENTIFIER ERR_SYM_IGC_OL_2 ECU_ADDRESS 0xd00096f6 BIT_MASK 0x780 /end MEASUREMENT
/begin MEASUREMENT fmy_stat_igc_ol_3.ctr_abc "anti bounce counter for diagnosis instance IGC_OL_3" UBYTE _CNV_A_R_LINEAR_____0_CM 1 100. 0. 255. DISPLAY_IDENTIFIER CTR_ABC_IGC_OL_3 ECU_ADDRESS 0xd00096f8 FORMAT "%3.0" /end MEASUREMENT
/begin MEASUREMENT fmy_stat_igc_ol_3.ctr_end_diag "counter for end of diagnosis for diagnosis instance IGC_OL_3" UBYTE _CNV_A_R_LINEAR_____0_CM 1 100. 0. 255. DISPLAY_IDENTIFIER CTR_ABC_END_DIAG_IGC_OL_3 ECU_ADDRESS 0xd00096f9 FORMAT "%3.0" /end MEASUREMENT
/begin MEASUREMENT fmy_stat_igc_ol_3.err_info_stat.lv_err_mem "storage in dynamic failure memory of the diagnosis instance IGC_OL_3" UWORD _CNV_S_2_RANGE__0___1_CM 1 100. 0. 1. DISPLAY_IDENTIFIER LV_ERR_MEM_IGC_OL_3 ECU_ADDRESS 0xd00096fa BIT_MASK 0x8 /end MEASUREMENT
/begin MEASUREMENT fmy_stat_igc_ol_3.err_info_stat.lv_ready "readiness status of the diagnosis instance IGC_OL_3" UWORD _CNV_S_2_RANGE__0___1_CM 1 100. 0. 1. DISPLAY_IDENTIFIER LV_READY_IGC_OL_3 ECU_ADDRESS 0xd00096fa BIT_MASK 0x10 /end MEASUREMENT
/begin MEASUREMENT fmy_stat_igc_ol_3.err_info_stat.lv_end_diag "end of diagnosis of the diagnosis instance IGC_OL_3" UWORD _CNV_S_2_RANGE__0___1_CM 1 100. 0. 1. DISPLAY_IDENTIFIER LV_END_DIAG_IGC_OL_3 ECU_ADDRESS 0xd00096fa BIT_MASK 0x20 /end MEASUREMENT
/begin MEASUREMENT fmy_stat_igc_ol_3.err_info_stat.lv_cdn_diag "diagnosis condition of the diagnosis instance IGC_OL_3" UWORD _CNV_S_2_RANGE__0___1_CM 1 100. 0. 1. DISPLAY_IDENTIFIER LV_CDN_DIAG_IGC_OL_3 ECU_ADDRESS 0xd00096fa BIT_MASK 0x40 /end MEASUREMENT
/begin MEASUREMENT fmy_stat_igc_ol_3.err_info_stat.err_sym "symptoms of the diagnosis instance IGC_OL_3" UWORD _CNV_S_16_RANGE_ERR__349_CM 1 100. 0. 15. DISPLAY_IDENTIFIER ERR_SYM_IGC_OL_3 ECU_ADDRESS 0xd00096fa BIT_MASK 0x780 /end MEASUREMENT
/begin MEASUREMENT fmy_stat_igc_ol_4.ctr_abc "anti bounce counter for diagnosis instance IGC_OL_4" UBYTE _CNV_A_R_LINEAR_____0_CM 1 100. 0. 255. DISPLAY_IDENTIFIER CTR_ABC_IGC_OL_4 ECU_ADDRESS 0xd00096fc FORMAT "%3.0" /end MEASUREMENT
/begin MEASUREMENT fmy_stat_igc_ol_4.ctr_end_diag "counter for end of diagnosis for diagnosis instance IGC_OL_4" UBYTE _CNV_A_R_LINEAR_____0_CM 1 100. 0. 255. DISPLAY_IDENTIFIER CTR_ABC_END_DIAG_IGC_OL_4 ECU_ADDRESS 0xd00096fd FORMAT "%3.0" /end MEASUREMENT
/begin MEASUREMENT fmy_stat_igc_ol_4.err_info_stat.lv_err_mem "storage in dynamic failure memory of the diagnosis instance IGC_OL_4" UWORD _CNV_S_2_RANGE__0___1_CM 1 100. 0. 1. DISPLAY_IDENTIFIER LV_ERR_MEM_IGC_OL_4 ECU_ADDRESS 0xd00096fe BIT_MASK 0x8 /end MEASUREMENT
/begin MEASUREMENT fmy_stat_igc_ol_4.err_info_stat.lv_ready "readiness status of the diagnosis instance IGC_OL_4" UWORD _CNV_S_2_RANGE__0___1_CM 1 100. 0. 1. DISPLAY_IDENTIFIER LV_READY_IGC_OL_4 ECU_ADDRESS 0xd00096fe BIT_MASK 0x10 /end MEASUREMENT
/begin MEASUREMENT fmy_stat_igc_ol_4.err_info_stat.lv_end_diag "end of diagnosis of the diagnosis instance IGC_OL_4" UWORD _CNV_S_2_RANGE__0___1_CM 1 100. 0. 1. DISPLAY_IDENTIFIER LV_END_DIAG_IGC_OL_4 ECU_ADDRESS 0xd00096fe BIT_MASK 0x20 /end MEASUREMENT
/begin MEASUREMENT fmy_stat_igc_ol_4.err_info_stat.lv_cdn_diag "diagnosis condition of the diagnosis instance IGC_OL_4" UWORD _CNV_S_2_RANGE__0___1_CM 1 100. 0. 1. DISPLAY_IDENTIFIER LV_CDN_DIAG_IGC_OL_4 ECU_ADDRESS 0xd00096fe BIT_MASK 0x40 /end MEASUREMENT
/begin MEASUREMENT fmy_stat_igc_ol_4.err_info_stat.err_sym "symptoms of the diagnosis instance IGC_OL_4" UWORD _CNV_S_16_RANGE_ERR__349_CM 1 100. 0. 15. DISPLAY_IDENTIFIER ERR_SYM_IGC_OL_4 ECU_ADDRESS 0xd00096fe BIT_MASK 0x780 /end MEASUREMENT
/begin MEASUREMENT fmy_stat_igc_ol_5.ctr_abc "anti bounce counter for diagnosis instance IGC_OL_5" UBYTE _CNV_A_R_LINEAR_____0_CM 1 100. 0. 255. DISPLAY_IDENTIFIER CTR_ABC_IGC_OL_5 ECU_ADDRESS 0xd0009700 FORMAT "%3.0" /end MEASUREMENT
/begin MEASUREMENT fmy_stat_igc_ol_5.ctr_end_diag "counter for end of diagnosis for diagnosis instance IGC_OL_5" UBYTE _CNV_A_R_LINEAR_____0_CM 1 100. 0. 255. DISPLAY_IDENTIFIER CTR_ABC_END_DIAG_IGC_OL_5 ECU_ADDRESS 0xd0009701 FORMAT "%3.0" /end MEASUREMENT
/begin MEASUREMENT fmy_stat_igc_ol_5.err_info_stat.lv_err_mem "storage in dynamic failure memory of the diagnosis instance IGC_OL_5" UWORD _CNV_S_2_RANGE__0___1_CM 1 100. 0. 1. DISPLAY_IDENTIFIER LV_ERR_MEM_IGC_OL_5 ECU_ADDRESS 0xd0009702 BIT_MASK 0x8 /end MEASUREMENT
/begin MEASUREMENT fmy_stat_igc_ol_5.err_info_stat.lv_ready "readiness status of the diagnosis instance IGC_OL_5" UWORD _CNV_S_2_RANGE__0___1_CM 1 100. 0. 1. DISPLAY_IDENTIFIER LV_READY_IGC_OL_5 ECU_ADDRESS 0xd0009702 BIT_MASK 0x10 /end MEASUREMENT
/begin MEASUREMENT fmy_stat_igc_ol_5.err_info_stat.lv_end_diag "end of diagnosis of the diagnosis instance IGC_OL_5" UWORD _CNV_S_2_RANGE__0___1_CM 1 100. 0. 1. DISPLAY_IDENTIFIER LV_END_DIAG_IGC_OL_5 ECU_ADDRESS 0xd0009702 BIT_MASK 0x20 /end MEASUREMENT
/begin MEASUREMENT fmy_stat_igc_ol_5.err_info_stat.lv_cdn_diag "diagnosis condition of the diagnosis instance IGC_OL_5" UWORD _CNV_S_2_RANGE__0___1_CM 1 100. 0. 1. DISPLAY_IDENTIFIER LV_CDN_DIAG_IGC_OL_5 ECU_ADDRESS 0xd0009702 BIT_MASK 0x40 /end MEASUREMENT
/begin MEASUREMENT fmy_stat_igc_ol_5.err_info_stat.err_sym "symptoms of the diagnosis instance IGC_OL_5" UWORD _CNV_S_16_RANGE_ERR__349_CM 1 100. 0. 15. DISPLAY_IDENTIFIER ERR_SYM_IGC_OL_5 ECU_ADDRESS 0xd0009702 BIT_MASK 0x780 /end MEASUREMENT
/begin MEASUREMENT fmy_stat_igc_ol_6.ctr_abc "anti bounce counter for diagnosis instance IGC_OL_6" UBYTE _CNV_A_R_LINEAR_____0_CM 1 100. 0. 255. DISPLAY_IDENTIFIER CTR_ABC_IGC_OL_6 ECU_ADDRESS 0xd0009704 FORMAT "%3.0" /end MEASUREMENT
/begin MEASUREMENT fmy_stat_igc_ol_6.ctr_end_diag "counter for end of diagnosis for diagnosis instance IGC_OL_6" UBYTE _CNV_A_R_LINEAR_____0_CM 1 100. 0. 255. DISPLAY_IDENTIFIER CTR_ABC_END_DIAG_IGC_OL_6 ECU_ADDRESS 0xd0009705 FORMAT "%3.0" /end MEASUREMENT
/begin MEASUREMENT fmy_stat_igc_ol_6.err_info_stat.lv_err_mem "storage in dynamic failure memory of the diagnosis instance IGC_OL_6" UWORD _CNV_S_2_RANGE__0___1_CM 1 100. 0. 1. DISPLAY_IDENTIFIER LV_ERR_MEM_IGC_OL_6 ECU_ADDRESS 0xd0009706 BIT_MASK 0x8 /end MEASUREMENT
/begin MEASUREMENT fmy_stat_igc_ol_6.err_info_stat.lv_ready "readiness status of the diagnosis instance IGC_OL_6" UWORD _CNV_S_2_RANGE__0___1_CM 1 100. 0. 1. DISPLAY_IDENTIFIER LV_READY_IGC_OL_6 ECU_ADDRESS 0xd0009706 BIT_MASK 0x10 /end MEASUREMENT
/begin MEASUREMENT fmy_stat_igc_ol_6.err_info_stat.lv_end_diag "end of diagnosis of the diagnosis instance IGC_OL_6" UWORD _CNV_S_2_RANGE__0___1_CM 1 100. 0. 1. DISPLAY_IDENTIFIER LV_END_DIAG_IGC_OL_6 ECU_ADDRESS 0xd0009706 BIT_MASK 0x20 /end MEASUREMENT
/begin MEASUREMENT fmy_stat_igc_ol_6.err_info_stat.lv_cdn_diag "diagnosis condition of the diagnosis instance IGC_OL_6" UWORD _CNV_S_2_RANGE__0___1_CM 1 100. 0. 1. DISPLAY_IDENTIFIER LV_CDN_DIAG_IGC_OL_6 ECU_ADDRESS 0xd0009706 BIT_MASK 0x40 /end MEASUREMENT
/begin MEASUREMENT fmy_stat_igc_ol_6.err_info_stat.err_sym "symptoms of the diagnosis instance IGC_OL_6" UWORD _CNV_S_16_RANGE_ERR__349_CM 1 100. 0. 15. DISPLAY_IDENTIFIER ERR_SYM_IGC_OL_6 ECU_ADDRESS 0xd0009706 BIT_MASK 0x780 /end MEASUREMENT
/begin MEASUREMENT fmy_stat_igc_ol_7.ctr_abc "anti bounce counter for diagnosis instance IGC_OL_7" UBYTE _CNV_A_R_LINEAR_____0_CM 1 100. 0. 255. DISPLAY_IDENTIFIER CTR_ABC_IGC_OL_7 ECU_ADDRESS 0xd0009708 FORMAT "%3.0" /end MEASUREMENT
/begin MEASUREMENT fmy_stat_igc_ol_7.ctr_end_diag "counter for end of diagnosis for diagnosis instance IGC_OL_7" UBYTE _CNV_A_R_LINEAR_____0_CM 1 100. 0. 255. DISPLAY_IDENTIFIER CTR_ABC_END_DIAG_IGC_OL_7 ECU_ADDRESS 0xd0009709 FORMAT "%3.0" /end MEASUREMENT
/begin MEASUREMENT fmy_stat_igc_ol_7.err_info_stat.lv_err_mem "storage in dynamic failure memory of the diagnosis instance IGC_OL_7" UWORD _CNV_S_2_RANGE__0___1_CM 1 100. 0. 1. DISPLAY_IDENTIFIER LV_ERR_MEM_IGC_OL_7 ECU_ADDRESS 0xd000970a BIT_MASK 0x8 /end MEASUREMENT
/begin MEASUREMENT fmy_stat_igc_ol_7.err_info_stat.lv_ready "readiness status of the diagnosis instance IGC_OL_7" UWORD _CNV_S_2_RANGE__0___1_CM 1 100. 0. 1. DISPLAY_IDENTIFIER LV_READY_IGC_OL_7 ECU_ADDRESS 0xd000970a BIT_MASK 0x10 /end MEASUREMENT
/begin MEASUREMENT fmy_stat_igc_ol_7.err_info_stat.lv_end_diag "end of diagnosis of the diagnosis instance IGC_OL_7" UWORD _CNV_S_2_RANGE__0___1_CM 1 100. 0. 1. DISPLAY_IDENTIFIER LV_END_DIAG_IGC_OL_7 ECU_ADDRESS 0xd000970a BIT_MASK 0x20 /end MEASUREMENT
/begin MEASUREMENT fmy_stat_igc_ol_7.err_info_stat.lv_cdn_diag "diagnosis condition of the diagnosis instance IGC_OL_7" UWORD _CNV_S_2_RANGE__0___1_CM 1 100. 0. 1. DISPLAY_IDENTIFIER LV_CDN_DIAG_IGC_OL_7 ECU_ADDRESS 0xd000970a BIT_MASK 0x40 /end MEASUREMENT
/begin MEASUREMENT fmy_stat_igc_ol_7.err_info_stat.err_sym "symptoms of the diagnosis instance IGC_OL_7" UWORD _CNV_S_16_RANGE_ERR__349_CM 1 100. 0. 15. DISPLAY_IDENTIFIER ERR_SYM_IGC_OL_7 ECU_ADDRESS 0xd000970a BIT_MASK 0x780 /end MEASUREMENT
/begin MEASUREMENT fmy_stat_dur_igc_mpl.ctr_abc "anti bounce counter for diagnosis instance DUR_IGC_MPL" UBYTE _CNV_A_R_LINEAR_____0_CM 1 100. 0. 255. DISPLAY_IDENTIFIER CTR_ABC_DUR_IGC_MPL ECU_ADDRESS 0xd000960c FORMAT "%3.0" /end MEASUREMENT
/begin MEASUREMENT fmy_stat_dur_igc_mpl.ctr_end_diag "counter for end of diagnosis for diagnosis instance DUR_IGC_MPL" UBYTE _CNV_A_R_LINEAR_____0_CM 1 100. 0. 255. DISPLAY_IDENTIFIER CTR_ABC_END_DIAG_DUR_IGC_MPL ECU_ADDRESS 0xd000960d FORMAT "%3.0" /end MEASUREMENT
/begin MEASUREMENT fmy_stat_dur_igc_mpl.err_info_stat.lv_err_mem "storage in dynamic failure memory of the diagnosis instance DUR_IGC_MPL" UWORD _CNV_S_2_RANGE__0___1_CM 1 100. 0. 1. DISPLAY_IDENTIFIER LV_ERR_MEM_DUR_IGC_MPL ECU_ADDRESS 0xd000960e BIT_MASK 0x8 /end MEASUREMENT
/begin MEASUREMENT fmy_stat_dur_igc_mpl.err_info_stat.lv_ready "readiness status of the diagnosis instance DUR_IGC_MPL" UWORD _CNV_S_2_RANGE__0___1_CM 1 100. 0. 1. DISPLAY_IDENTIFIER LV_READY_DUR_IGC_MPL ECU_ADDRESS 0xd000960e BIT_MASK 0x10 /end MEASUREMENT
/begin MEASUREMENT fmy_stat_dur_igc_mpl.err_info_stat.lv_end_diag "end of diagnosis of the diagnosis instance DUR_IGC_MPL" UWORD _CNV_S_2_RANGE__0___1_CM 1 100. 0. 1. DISPLAY_IDENTIFIER LV_END_DIAG_DUR_IGC_MPL ECU_ADDRESS 0xd000960e BIT_MASK 0x20 /end MEASUREMENT
/begin MEASUREMENT fmy_stat_dur_igc_mpl.err_info_stat.lv_cdn_diag "diagnosis condition of the diagnosis instance DUR_IGC_MPL" UWORD _CNV_S_2_RANGE__0___1_CM 1 100. 0. 1. DISPLAY_IDENTIFIER LV_CDN_DIAG_DUR_IGC_MPL ECU_ADDRESS 0xd000960e BIT_MASK 0x40 /end MEASUREMENT
/begin MEASUREMENT fmy_stat_dur_igc_mpl.err_info_stat.err_sym "symptoms of the diagnosis instance DUR_IGC_MPL" UWORD _CNV_S_16_RANGE_ERR__349_CM 1 100. 0. 15. DISPLAY_IDENTIFIER ERR_SYM_DUR_IGC_MPL ECU_ADDRESS 0xd000960e BIT_MASK 0x780 /end MEASUREMENT
/begin MEASUREMENT fmy_stat_v_ref_1.ctr_abc "anti bounce counter for diagnosis instance V_REF_1" UBYTE _CNV_A_R_LINEAR_____0_CM 1 100. 0. 255. DISPLAY_IDENTIFIER CTR_ABC_V_REF_1 ECU_ADDRESS 0xd0009adc FORMAT "%3.0" /end MEASUREMENT
/begin MEASUREMENT fmy_stat_v_ref_1.ctr_end_diag "counter for end of diagnosis for diagnosis instance V_REF_1" UBYTE _CNV_A_R_LINEAR_____0_CM 1 100. 0. 255. DISPLAY_IDENTIFIER CTR_ABC_END_DIAG_V_REF_1 ECU_ADDRESS 0xd0009add FORMAT "%3.0" /end MEASUREMENT
/begin MEASUREMENT fmy_stat_v_ref_1.err_info_stat.lv_err_mem "storage in dynamic failure memory of the diagnosis instance V_REF_1" UWORD _CNV_S_2_RANGE__0___1_CM 1 100. 0. 1. DISPLAY_IDENTIFIER LV_ERR_MEM_V_REF_1 ECU_ADDRESS 0xd0009ade BIT_MASK 0x8 /end MEASUREMENT
/begin MEASUREMENT fmy_stat_v_ref_1.err_info_stat.lv_ready "readiness status of the diagnosis instance V_REF_1" UWORD _CNV_S_2_RANGE__0___1_CM 1 100. 0. 1. DISPLAY_IDENTIFIER LV_READY_V_REF_1 ECU_ADDRESS 0xd0009ade BIT_MASK 0x10 /end MEASUREMENT
/begin MEASUREMENT fmy_stat_v_ref_1.err_info_stat.lv_end_diag "end of diagnosis of the diagnosis instance V_REF_1" UWORD _CNV_S_2_RANGE__0___1_CM 1 100. 0. 1. DISPLAY_IDENTIFIER LV_END_DIAG_V_REF_1 ECU_ADDRESS 0xd0009ade BIT_MASK 0x20 /end MEASUREMENT
/begin MEASUREMENT fmy_stat_v_ref_1.err_info_stat.lv_cdn_diag "diagnosis condition of the diagnosis instance V_REF_1" UWORD _CNV_S_2_RANGE__0___1_CM 1 100. 0. 1. DISPLAY_IDENTIFIER LV_CDN_DIAG_V_REF_1 ECU_ADDRESS 0xd0009ade BIT_MASK 0x40 /end MEASUREMENT
/begin MEASUREMENT fmy_stat_v_ref_1.err_info_stat.err_sym "symptoms of the diagnosis instance V_REF_1" UWORD _CNV_S_16_RANGE_ERR__349_CM 1 100. 0. 15. DISPLAY_IDENTIFIER ERR_SYM_V_REF_1 ECU_ADDRESS 0xd0009ade BIT_MASK 0x780 /end MEASUREMENT
/begin MEASUREMENT fmy_stat_v_ref_2.ctr_abc "anti bounce counter for diagnosis instance V_REF_2" UBYTE _CNV_A_R_LINEAR_____0_CM 1 100. 0. 255. DISPLAY_IDENTIFIER CTR_ABC_V_REF_2 ECU_ADDRESS 0xd0009ae0 FORMAT "%3.0" /end MEASUREMENT
/begin MEASUREMENT fmy_stat_v_ref_2.ctr_end_diag "counter for end of diagnosis for diagnosis instance V_REF_2" UBYTE _CNV_A_R_LINEAR_____0_CM 1 100. 0. 255. DISPLAY_IDENTIFIER CTR_ABC_END_DIAG_V_REF_2 ECU_ADDRESS 0xd0009ae1 FORMAT "%3.0" /end MEASUREMENT
/begin MEASUREMENT fmy_stat_v_ref_2.err_info_stat.lv_err_mem "storage in dynamic failure memory of the diagnosis instance V_REF_2" UWORD _CNV_S_2_RANGE__0___1_CM 1 100. 0. 1. DISPLAY_IDENTIFIER LV_ERR_MEM_V_REF_2 ECU_ADDRESS 0xd0009ae2 BIT_MASK 0x8 /end MEASUREMENT
/begin MEASUREMENT fmy_stat_v_ref_2.err_info_stat.lv_ready "readiness status of the diagnosis instance V_REF_2" UWORD _CNV_S_2_RANGE__0___1_CM 1 100. 0. 1. DISPLAY_IDENTIFIER LV_READY_V_REF_2 ECU_ADDRESS 0xd0009ae2 BIT_MASK 0x10 /end MEASUREMENT
/begin MEASUREMENT fmy_stat_v_ref_2.err_info_stat.lv_end_diag "end of diagnosis of the diagnosis instance V_REF_2" UWORD _CNV_S_2_RANGE__0___1_CM 1 100. 0. 1. DISPLAY_IDENTIFIER LV_END_DIAG_V_REF_2 ECU_ADDRESS 0xd0009ae2 BIT_MASK 0x20 /end MEASUREMENT
/begin MEASUREMENT fmy_stat_v_ref_2.err_info_stat.lv_cdn_diag "diagnosis condition of the diagnosis instance V_REF_2" UWORD _CNV_S_2_RANGE__0___1_CM 1 100. 0. 1. DISPLAY_IDENTIFIER LV_CDN_DIAG_V_REF_2 ECU_ADDRESS 0xd0009ae2 BIT_MASK 0x40 /end MEASUREMENT
/begin MEASUREMENT fmy_stat_v_ref_2.err_info_stat.err_sym "symptoms of the diagnosis instance V_REF_2" UWORD _CNV_S_16_RANGE_ERR__349_CM 1 100. 0. 15. DISPLAY_IDENTIFIER ERR_SYM_V_REF_2 ECU_ADDRESS 0xd0009ae2 BIT_MASK 0x780 /end MEASUREMENT
/begin MEASUREMENT fmy_stat_pvs_1.ctr_abc "anti bounce counter for diagnosis instance PVS_1" UBYTE _CNV_A_R_LINEAR_____0_CM 1 100. 0. 255. DISPLAY_IDENTIFIER CTR_ABC_PVS_1 ECU_ADDRESS 0xd0009910 FORMAT "%3.0" /end MEASUREMENT
/begin MEASUREMENT fmy_stat_pvs_1.ctr_end_diag "counter for end of diagnosis for diagnosis instance PVS_1" UBYTE _CNV_A_R_LINEAR_____0_CM 1 100. 0. 255. DISPLAY_IDENTIFIER CTR_ABC_END_DIAG_PVS_1 ECU_ADDRESS 0xd0009911 FORMAT "%3.0" /end MEASUREMENT
/begin MEASUREMENT fmy_stat_pvs_1.err_info_stat.lv_err_mem "storage in dynamic failure memory of the diagnosis instance PVS_1" UWORD _CNV_S_2_RANGE__0___1_CM 1 100. 0. 1. DISPLAY_IDENTIFIER LV_ERR_MEM_PVS_1 ECU_ADDRESS 0xd0009912 BIT_MASK 0x8 /end MEASUREMENT
/begin MEASUREMENT fmy_stat_pvs_1.err_info_stat.lv_ready "readiness status of the diagnosis instance PVS_1" UWORD _CNV_S_2_RANGE__0___1_CM 1 100. 0. 1. DISPLAY_IDENTIFIER LV_READY_PVS_1 ECU_ADDRESS 0xd0009912 BIT_MASK 0x10 /end MEASUREMENT
/begin MEASUREMENT fmy_stat_pvs_1.err_info_stat.lv_end_diag "end of diagnosis of the diagnosis instance PVS_1" UWORD _CNV_S_2_RANGE__0___1_CM 1 100. 0. 1. DISPLAY_IDENTIFIER LV_END_DIAG_PVS_1 ECU_ADDRESS 0xd0009912 BIT_MASK 0x20 /end MEASUREMENT
/begin MEASUREMENT fmy_stat_pvs_1.err_info_stat.lv_cdn_diag "diagnosis condition of the diagnosis instance PVS_1" UWORD _CNV_S_2_RANGE__0___1_CM 1 100. 0. 1. DISPLAY_IDENTIFIER LV_CDN_DIAG_PVS_1 ECU_ADDRESS 0xd0009912 BIT_MASK 0x40 /end MEASUREMENT
/begin MEASUREMENT fmy_stat_pvs_1.err_info_stat.err_sym "symptoms of the diagnosis instance PVS_1" UWORD _CNV_S_16_RANGE_ERR__349_CM 1 100. 0. 15. DISPLAY_IDENTIFIER ERR_SYM_PVS_1 ECU_ADDRESS 0xd0009912 BIT_MASK 0x780 /end MEASUREMENT
/begin MEASUREMENT fmy_stat_pvs_2.ctr_abc "anti bounce counter for diagnosis instance PVS_2" UBYTE _CNV_A_R_LINEAR_____0_CM 1 100. 0. 255. DISPLAY_IDENTIFIER CTR_ABC_PVS_2 ECU_ADDRESS 0xd0009914 FORMAT "%3.0" /end MEASUREMENT
/begin MEASUREMENT fmy_stat_pvs_2.ctr_end_diag "counter for end of diagnosis for diagnosis instance PVS_2" UBYTE _CNV_A_R_LINEAR_____0_CM 1 100. 0. 255. DISPLAY_IDENTIFIER CTR_ABC_END_DIAG_PVS_2 ECU_ADDRESS 0xd0009915 FORMAT "%3.0" /end MEASUREMENT
/begin MEASUREMENT fmy_stat_pvs_2.err_info_stat.lv_err_mem "storage in dynamic failure memory of the diagnosis instance PVS_2" UWORD _CNV_S_2_RANGE__0___1_CM 1 100. 0. 1. DISPLAY_IDENTIFIER LV_ERR_MEM_PVS_2 ECU_ADDRESS 0xd0009916 BIT_MASK 0x8 /end MEASUREMENT
/begin MEASUREMENT fmy_stat_pvs_2.err_info_stat.lv_ready "readiness status of the diagnosis instance PVS_2" UWORD _CNV_S_2_RANGE__0___1_CM 1 100. 0. 1. DISPLAY_IDENTIFIER LV_READY_PVS_2 ECU_ADDRESS 0xd0009916 BIT_MASK 0x10 /end MEASUREMENT
/begin MEASUREMENT fmy_stat_pvs_2.err_info_stat.lv_end_diag "end of diagnosis of the diagnosis instance PVS_2" UWORD _CNV_S_2_RANGE__0___1_CM 1 100. 0. 1. DISPLAY_IDENTIFIER LV_END_DIAG_PVS_2 ECU_ADDRESS 0xd0009916 BIT_MASK 0x20 /end MEASUREMENT
/begin MEASUREMENT fmy_stat_pvs_2.err_info_stat.lv_cdn_diag "diagnosis condition of the diagnosis instance PVS_2" UWORD _CNV_S_2_RANGE__0___1_CM 1 100. 0. 1. DISPLAY_IDENTIFIER LV_CDN_DIAG_PVS_2 ECU_ADDRESS 0xd0009916 BIT_MASK 0x40 /end MEASUREMENT
/begin MEASUREMENT fmy_stat_pvs_2.err_info_stat.err_sym "symptoms of the diagnosis instance PVS_2" UWORD _CNV_S_16_RANGE_ERR__349_CM 1 100. 0. 15. DISPLAY_IDENTIFIER ERR_SYM_PVS_2 ECU_ADDRESS 0xd0009916 BIT_MASK 0x780 /end MEASUREMENT
/begin MEASUREMENT fmy_stat_pvs_ratio.ctr_abc "anti bounce counter for diagnosis instance PVS_RATIO" UBYTE _CNV_A_R_LINEAR_____0_CM 1 100. 0. 255. DISPLAY_IDENTIFIER CTR_ABC_PVS_RATIO ECU_ADDRESS 0xd0009924 FORMAT "%3.0" /end MEASUREMENT
/begin MEASUREMENT fmy_stat_pvs_ratio.ctr_end_diag "counter for end of diagnosis for diagnosis instance PVS_RATIO" UBYTE _CNV_A_R_LINEAR_____0_CM 1 100. 0. 255. DISPLAY_IDENTIFIER CTR_ABC_END_DIAG_PVS_RATIO ECU_ADDRESS 0xd0009925 FORMAT "%3.0" /end MEASUREMENT
/begin MEASUREMENT fmy_stat_pvs_ratio.err_info_stat.lv_err_mem "storage in dynamic failure memory of the diagnosis instance PVS_RATIO" UWORD _CNV_S_2_RANGE__0___1_CM 1 100. 0. 1. DISPLAY_IDENTIFIER LV_ERR_MEM_PVS_RATIO ECU_ADDRESS 0xd0009926 BIT_MASK 0x8 /end MEASUREMENT
/begin MEASUREMENT fmy_stat_pvs_ratio.err_info_stat.lv_ready "readiness status of the diagnosis instance PVS_RATIO" UWORD _CNV_S_2_RANGE__0___1_CM 1 100. 0. 1. DISPLAY_IDENTIFIER LV_READY_PVS_RATIO ECU_ADDRESS 0xd0009926 BIT_MASK 0x10 /end MEASUREMENT
/begin MEASUREMENT fmy_stat_pvs_ratio.err_info_stat.lv_end_diag "end of diagnosis of the diagnosis instance PVS_RATIO" UWORD _CNV_S_2_RANGE__0___1_CM 1 100. 0. 1. DISPLAY_IDENTIFIER LV_END_DIAG_PVS_RATIO ECU_ADDRESS 0xd0009926 BIT_MASK 0x20 /end MEASUREMENT
/begin MEASUREMENT fmy_stat_pvs_ratio.err_info_stat.lv_cdn_diag "diagnosis condition of the diagnosis instance PVS_RATIO" UWORD _CNV_S_2_RANGE__0___1_CM 1 100. 0. 1. DISPLAY_IDENTIFIER LV_CDN_DIAG_PVS_RATIO ECU_ADDRESS 0xd0009926 BIT_MASK 0x40 /end MEASUREMENT
/begin MEASUREMENT fmy_stat_pvs_ratio.err_info_stat.err_sym "symptoms of the diagnosis instance PVS_RATIO" UWORD _CNV_S_16_RANGE_ERR__349_CM 1 100. 0. 15. DISPLAY_IDENTIFIER ERR_SYM_PVS_RATIO ECU_ADDRESS 0xd0009926 BIT_MASK 0x780 /end MEASUREMENT
/begin MEASUREMENT fmy_stat_pvs_double.ctr_abc "anti bounce counter for diagnosis instance PVS_DOUBLE" UBYTE _CNV_A_R_LINEAR_____0_CM 1 100. 0. 255. DISPLAY_IDENTIFIER CTR_ABC_PVS_DOUBLE ECU_ADDRESS 0xd000991c FORMAT "%3.0" /end MEASUREMENT
/begin MEASUREMENT fmy_stat_pvs_double.ctr_end_diag "counter for end of diagnosis for diagnosis instance PVS_DOUBLE" UBYTE _CNV_A_R_LINEAR_____0_CM 1 100. 0. 255. DISPLAY_IDENTIFIER CTR_ABC_END_DIAG_PVS_DOUBLE ECU_ADDRESS 0xd000991d FORMAT "%3.0" /end MEASUREMENT
/begin MEASUREMENT fmy_stat_pvs_double.err_info_stat.lv_err_mem "storage in dynamic failure memory of the diagnosis instance PVS_DOUBLE" UWORD _CNV_S_2_RANGE__0___1_CM 1 100. 0. 1. DISPLAY_IDENTIFIER LV_ERR_MEM_PVS_DOUBLE ECU_ADDRESS 0xd000991e BIT_MASK 0x8 /end MEASUREMENT
/begin MEASUREMENT fmy_stat_pvs_double.err_info_stat.lv_ready "readiness status of the diagnosis instance PVS_DOUBLE" UWORD _CNV_S_2_RANGE__0___1_CM 1 100. 0. 1. DISPLAY_IDENTIFIER LV_READY_PVS_DOUBLE ECU_ADDRESS 0xd000991e BIT_MASK 0x10 /end MEASUREMENT
/begin MEASUREMENT fmy_stat_pvs_double.err_info_stat.lv_end_diag "end of diagnosis of the diagnosis instance PVS_DOUBLE" UWORD _CNV_S_2_RANGE__0___1_CM 1 100. 0. 1. DISPLAY_IDENTIFIER LV_END_DIAG_PVS_DOUBLE ECU_ADDRESS 0xd000991e BIT_MASK 0x20 /end MEASUREMENT
/begin MEASUREMENT fmy_stat_pvs_double.err_info_stat.lv_cdn_diag "diagnosis condition of the diagnosis instance PVS_DOUBLE" UWORD _CNV_S_2_RANGE__0___1_CM 1 100. 0. 1. DISPLAY_IDENTIFIER LV_CDN_DIAG_PVS_DOUBLE ECU_ADDRESS 0xd000991e BIT_MASK 0x40 /end MEASUREMENT
/begin MEASUREMENT fmy_stat_pvs_double.err_info_stat.err_sym "symptoms of the diagnosis instance PVS_DOUBLE" UWORD _CNV_S_16_RANGE_ERR__349_CM 1 100. 0. 15. DISPLAY_IDENTIFIER ERR_SYM_PVS_DOUBLE ECU_ADDRESS 0xd000991e BIT_MASK 0x780 /end MEASUREMENT
/begin MEASUREMENT fmy_stat_pvs_bls_not_plaus.ctr_abc "anti bounce counter for diagnosis instance PVS_BLS_NOT_PLAUS" UBYTE _CNV_A_R_LINEAR_____0_CM 1 100. 0. 255. DISPLAY_IDENTIFIER CTR_ABC_PVS_BLS_NOT_PLAUS ECU_ADDRESS 0xd0009918 FORMAT "%3.0" /end MEASUREMENT
/begin MEASUREMENT fmy_stat_pvs_bls_not_plaus.ctr_end_diag "counter for end of diagnosis for diagnosis instance PVS_BLS_NOT_PLAUS" UBYTE _CNV_A_R_LINEAR_____0_CM 1 100. 0. 255. DISPLAY_IDENTIFIER CTR_ABC_END_DIAG_PVS_BLS_NOT_PLAUS ECU_ADDRESS 0xd0009919 FORMAT "%3.0" /end MEASUREMENT
/begin MEASUREMENT fmy_stat_pvs_bls_not_plaus.err_info_stat.lv_err_mem "storage in dynamic failure memory of the diagnosis instance PVS_BLS_NOT_PLAUS" UWORD _CNV_S_2_RANGE__0___1_CM 1 100. 0. 1. DISPLAY_IDENTIFIER LV_ERR_MEM_PVS_BLS_NOT_PLAUS ECU_ADDRESS 0xd000991a BIT_MASK 0x8 /end MEASUREMENT
/begin MEASUREMENT fmy_stat_pvs_bls_not_plaus.err_info_stat.lv_ready "readiness status of the diagnosis instance PVS_BLS_NOT_PLAUS" UWORD _CNV_S_2_RANGE__0___1_CM 1 100. 0. 1. DISPLAY_IDENTIFIER LV_READY_PVS_BLS_NOT_PLAUS ECU_ADDRESS 0xd000991a BIT_MASK 0x10 /end MEASUREMENT
/begin MEASUREMENT fmy_stat_pvs_bls_not_plaus.err_info_stat.lv_end_diag "end of diagnosis of the diagnosis instance PVS_BLS_NOT_PLAUS" UWORD _CNV_S_2_RANGE__0___1_CM 1 100. 0. 1. DISPLAY_IDENTIFIER LV_END_DIAG_PVS_BLS_NOT_PLAUS ECU_ADDRESS 0xd000991a BIT_MASK 0x20 /end MEASUREMENT
/begin MEASUREMENT fmy_stat_pvs_bls_not_plaus.err_info_stat.lv_cdn_diag "diagnosis condition of the diagnosis instance PVS_BLS_NOT_PLAUS" UWORD _CNV_S_2_RANGE__0___1_CM 1 100. 0. 1. DISPLAY_IDENTIFIER LV_CDN_DIAG_PVS_BLS_NOT_PLAUS ECU_ADDRESS 0xd000991a BIT_MASK 0x40 /end MEASUREMENT
/begin MEASUREMENT fmy_stat_pvs_bls_not_plaus.err_info_stat.err_sym "symptoms of the diagnosis instance PVS_BLS_NOT_PLAUS" UWORD _CNV_S_16_RANGE_ERR__349_CM 1 100. 0. 15. DISPLAY_IDENTIFIER ERR_SYM_PVS_BLS_NOT_PLAUS ECU_ADDRESS 0xd000991a BIT_MASK 0x780 /end MEASUREMENT
/begin MEASUREMENT fmy_stat_mtc_ctl_1.ctr_abc "anti bounce counter for diagnosis instance MTC_CTL_1" UBYTE _CNV_A_R_LINEAR_____0_CM 1 100. 0. 255. DISPLAY_IDENTIFIER CTR_ABC_MTC_CTL_1 ECU_ADDRESS 0xd0009868 FORMAT "%3.0" /end MEASUREMENT
/begin MEASUREMENT fmy_stat_mtc_ctl_1.ctr_end_diag "counter for end of diagnosis for diagnosis instance MTC_CTL_1" UBYTE _CNV_A_R_LINEAR_____0_CM 1 100. 0. 255. DISPLAY_IDENTIFIER CTR_ABC_END_DIAG_MTC_CTL_1 ECU_ADDRESS 0xd0009869 FORMAT "%3.0" /end MEASUREMENT
/begin MEASUREMENT fmy_stat_mtc_ctl_1.err_info_stat.lv_err_mem "storage in dynamic failure memory of the diagnosis instance MTC_CTL_1" UWORD _CNV_S_2_RANGE__0___1_CM 1 100. 0. 1. DISPLAY_IDENTIFIER LV_ERR_MEM_MTC_CTL_1 ECU_ADDRESS 0xd000986a BIT_MASK 0x8 /end MEASUREMENT
/begin MEASUREMENT fmy_stat_mtc_ctl_1.err_info_stat.lv_ready "readiness status of the diagnosis instance MTC_CTL_1" UWORD _CNV_S_2_RANGE__0___1_CM 1 100. 0. 1. DISPLAY_IDENTIFIER LV_READY_MTC_CTL_1 ECU_ADDRESS 0xd000986a BIT_MASK 0x10 /end MEASUREMENT
/begin MEASUREMENT fmy_stat_mtc_ctl_1.err_info_stat.lv_end_diag "end of diagnosis of the diagnosis instance MTC_CTL_1" UWORD _CNV_S_2_RANGE__0___1_CM 1 100. 0. 1. DISPLAY_IDENTIFIER LV_END_DIAG_MTC_CTL_1 ECU_ADDRESS 0xd000986a BIT_MASK 0x20 /end MEASUREMENT
/begin MEASUREMENT fmy_stat_mtc_ctl_1.err_info_stat.lv_cdn_diag "diagnosis condition of the diagnosis instance MTC_CTL_1" UWORD _CNV_S_2_RANGE__0___1_CM 1 100. 0. 1. DISPLAY_IDENTIFIER LV_CDN_DIAG_MTC_CTL_1 ECU_ADDRESS 0xd000986a BIT_MASK 0x40 /end MEASUREMENT
/begin MEASUREMENT fmy_stat_mtc_ctl_1.err_info_stat.err_sym "symptoms of the diagnosis instance MTC_CTL_1" UWORD _CNV_S_16_RANGE_ERR__349_CM 1 100. 0. 15. DISPLAY_IDENTIFIER ERR_SYM_MTC_CTL_1 ECU_ADDRESS 0xd000986a BIT_MASK 0x780 /end MEASUREMENT
/begin MEASUREMENT fmy_stat_gen.ctr_abc "anti bounce counter for diagnosis instance GEN" UBYTE _CNV_A_R_LINEAR_____0_CM 1 100. 0. 255. DISPLAY_IDENTIFIER CTR_ABC_GEN ECU_ADDRESS 0xd00096bc FORMAT "%3.0" /end MEASUREMENT
/begin MEASUREMENT fmy_stat_gen.ctr_end_diag "counter for end of diagnosis for diagnosis instance GEN" UBYTE _CNV_A_R_LINEAR_____0_CM 1 100. 0. 255. DISPLAY_IDENTIFIER CTR_ABC_END_DIAG_GEN ECU_ADDRESS 0xd00096bd FORMAT "%3.0" /end MEASUREMENT
/begin MEASUREMENT fmy_stat_gen.err_info_stat.lv_err_mem "storage in dynamic failure memory of the diagnosis instance GEN" UWORD _CNV_S_2_RANGE__0___1_CM 1 100. 0. 1. DISPLAY_IDENTIFIER LV_ERR_MEM_GEN ECU_ADDRESS 0xd00096be BIT_MASK 0x8 /end MEASUREMENT
/begin MEASUREMENT fmy_stat_gen.err_info_stat.lv_ready "readiness status of the diagnosis instance GEN" UWORD _CNV_S_2_RANGE__0___1_CM 1 100. 0. 1. DISPLAY_IDENTIFIER LV_READY_GEN ECU_ADDRESS 0xd00096be BIT_MASK 0x10 /end MEASUREMENT
/begin MEASUREMENT fmy_stat_gen.err_info_stat.lv_end_diag "end of diagnosis of the diagnosis instance GEN" UWORD _CNV_S_2_RANGE__0___1_CM 1 100. 0. 1. DISPLAY_IDENTIFIER LV_END_DIAG_GEN ECU_ADDRESS 0xd00096be BIT_MASK 0x20 /end MEASUREMENT
/begin MEASUREMENT fmy_stat_gen.err_info_stat.lv_cdn_diag "diagnosis condition of the diagnosis instance GEN" UWORD _CNV_S_2_RANGE__0___1_CM 1 100. 0. 1. DISPLAY_IDENTIFIER LV_CDN_DIAG_GEN ECU_ADDRESS 0xd00096be BIT_MASK 0x40 /end MEASUREMENT
/begin MEASUREMENT fmy_stat_gen.err_info_stat.err_sym "symptoms of the diagnosis instance GEN" UWORD _CNV_S_16_RANGE_ERR__349_CM 1 100. 0. 15. DISPLAY_IDENTIFIER ERR_SYM_GEN ECU_ADDRESS 0xd00096be BIT_MASK 0x780 /end MEASUREMENT
/begin MEASUREMENT fmy_stat_gen_diag.ctr_abc "anti bounce counter for diagnosis instance GEN_DIAG" UBYTE _CNV_A_R_LINEAR_____0_CM 1 100. 0. 255. DISPLAY_IDENTIFIER CTR_ABC_GEN_DIAG ECU_ADDRESS 0xd00096c8 FORMAT "%3.0" /end MEASUREMENT
/begin MEASUREMENT fmy_stat_gen_diag.ctr_end_diag "counter for end of diagnosis for diagnosis instance GEN_DIAG" UBYTE _CNV_A_R_LINEAR_____0_CM 1 100. 0. 255. DISPLAY_IDENTIFIER CTR_ABC_END_DIAG_GEN_DIAG ECU_ADDRESS 0xd00096c9 FORMAT "%3.0" /end MEASUREMENT
/begin MEASUREMENT fmy_stat_gen_diag.err_info_stat.lv_err_mem "storage in dynamic failure memory of the diagnosis instance GEN_DIAG" UWORD _CNV_S_2_RANGE__0___1_CM 1 100. 0. 1. DISPLAY_IDENTIFIER LV_ERR_MEM_GEN_DIAG ECU_ADDRESS 0xd00096ca BIT_MASK 0x8 /end MEASUREMENT
/begin MEASUREMENT fmy_stat_gen_diag.err_info_stat.lv_ready "readiness status of the diagnosis instance GEN_DIAG" UWORD _CNV_S_2_RANGE__0___1_CM 1 100. 0. 1. DISPLAY_IDENTIFIER LV_READY_GEN_DIAG ECU_ADDRESS 0xd00096ca BIT_MASK 0x10 /end MEASUREMENT
/begin MEASUREMENT fmy_stat_gen_diag.err_info_stat.lv_end_diag "end of diagnosis of the diagnosis instance GEN_DIAG" UWORD _CNV_S_2_RANGE__0___1_CM 1 100. 0. 1. DISPLAY_IDENTIFIER LV_END_DIAG_GEN_DIAG ECU_ADDRESS 0xd00096ca BIT_MASK 0x20 /end MEASUREMENT
/begin MEASUREMENT fmy_stat_gen_diag.err_info_stat.lv_cdn_diag "diagnosis condition of the diagnosis instance GEN_DIAG" UWORD _CNV_S_2_RANGE__0___1_CM 1 100. 0. 1. DISPLAY_IDENTIFIER LV_CDN_DIAG_GEN_DIAG ECU_ADDRESS 0xd00096ca BIT_MASK 0x40 /end MEASUREMENT
/begin MEASUREMENT fmy_stat_gen_diag.err_info_stat.err_sym "symptoms of the diagnosis instance GEN_DIAG" UWORD _CNV_S_16_RANGE_ERR__349_CM 1 100. 0. 15. DISPLAY_IDENTIFIER ERR_SYM_GEN_DIAG ECU_ADDRESS 0xd00096ca BIT_MASK 0x780 /end MEASUREMENT
/begin MEASUREMENT fmy_stat_alter_bn.ctr_abc "anti bounce counter for diagnosis instance ALTER_BN" UBYTE _CNV_A_R_LINEAR_____0_CM 1 100. 0. 255. DISPLAY_IDENTIFIER CTR_ABC_ALTER_BN ECU_ADDRESS 0xd00093cc FORMAT "%3.0" /end MEASUREMENT
/begin MEASUREMENT fmy_stat_alter_bn.ctr_end_diag "counter for end of diagnosis for diagnosis instance ALTER_BN" UBYTE _CNV_A_R_LINEAR_____0_CM 1 100. 0. 255. DISPLAY_IDENTIFIER CTR_ABC_END_DIAG_ALTER_BN ECU_ADDRESS 0xd00093cd FORMAT "%3.0" /end MEASUREMENT
/begin MEASUREMENT fmy_stat_alter_bn.err_info_stat.lv_err_mem "storage in dynamic failure memory of the diagnosis instance ALTER_BN" UWORD _CNV_S_2_RANGE__0___1_CM 1 100. 0. 1. DISPLAY_IDENTIFIER LV_ERR_MEM_ALTER_BN ECU_ADDRESS 0xd00093ce BIT_MASK 0x8 /end MEASUREMENT
/begin MEASUREMENT fmy_stat_alter_bn.err_info_stat.lv_ready "readiness status of the diagnosis instance ALTER_BN" UWORD _CNV_S_2_RANGE__0___1_CM 1 100. 0. 1. DISPLAY_IDENTIFIER LV_READY_ALTER_BN ECU_ADDRESS 0xd00093ce BIT_MASK 0x10 /end MEASUREMENT
/begin MEASUREMENT fmy_stat_alter_bn.err_info_stat.lv_end_diag "end of diagnosis of the diagnosis instance ALTER_BN" UWORD _CNV_S_2_RANGE__0___1_CM 1 100. 0. 1. DISPLAY_IDENTIFIER LV_END_DIAG_ALTER_BN ECU_ADDRESS 0xd00093ce BIT_MASK 0x20 /end MEASUREMENT
/begin MEASUREMENT fmy_stat_alter_bn.err_info_stat.lv_cdn_diag "diagnosis condition of the diagnosis instance ALTER_BN" UWORD _CNV_S_2_RANGE__0___1_CM 1 100. 0. 1. DISPLAY_IDENTIFIER LV_CDN_DIAG_ALTER_BN ECU_ADDRESS 0xd00093ce BIT_MASK 0x40 /end MEASUREMENT
/begin MEASUREMENT fmy_stat_alter_bn.err_info_stat.err_sym "symptoms of the diagnosis instance ALTER_BN" UWORD _CNV_S_16_RANGE_ERR__349_CM 1 100. 0. 15. DISPLAY_IDENTIFIER ERR_SYM_ALTER_BN ECU_ADDRESS 0xd00093ce BIT_MASK 0x780 /end MEASUREMENT
/begin MEASUREMENT fmy_stat_alter_bn_bat.ctr_abc "anti bounce counter for diagnosis instance ALTER_BN_BAT" UBYTE _CNV_A_R_LINEAR_____0_CM 1 100. 0. 255. DISPLAY_IDENTIFIER CTR_ABC_ALTER_BN_BAT ECU_ADDRESS 0xd00093d0 FORMAT "%3.0" /end MEASUREMENT
/begin MEASUREMENT fmy_stat_alter_bn_bat.ctr_end_diag "counter for end of diagnosis for diagnosis instance ALTER_BN_BAT" UBYTE _CNV_A_R_LINEAR_____0_CM 1 100. 0. 255. DISPLAY_IDENTIFIER CTR_ABC_END_DIAG_ALTER_BN_BAT ECU_ADDRESS 0xd00093d1 FORMAT "%3.0" /end MEASUREMENT
/begin MEASUREMENT fmy_stat_alter_bn_bat.err_info_stat.lv_err_mem "storage in dynamic failure memory of the diagnosis instance ALTER_BN_BAT" UWORD _CNV_S_2_RANGE__0___1_CM 1 100. 0. 1. DISPLAY_IDENTIFIER LV_ERR_MEM_ALTER_BN_BAT ECU_ADDRESS 0xd00093d2 BIT_MASK 0x8 /end MEASUREMENT
/begin MEASUREMENT fmy_stat_alter_bn_bat.err_info_stat.lv_ready "readiness status of the diagnosis instance ALTER_BN_BAT" UWORD _CNV_S_2_RANGE__0___1_CM 1 100. 0. 1. DISPLAY_IDENTIFIER LV_READY_ALTER_BN_BAT ECU_ADDRESS 0xd00093d2 BIT_MASK 0x10 /end MEASUREMENT
/begin MEASUREMENT fmy_stat_alter_bn_bat.err_info_stat.lv_end_diag "end of diagnosis of the diagnosis instance ALTER_BN_BAT" UWORD _CNV_S_2_RANGE__0___1_CM 1 100. 0. 1. DISPLAY_IDENTIFIER LV_END_DIAG_ALTER_BN_BAT ECU_ADDRESS 0xd00093d2 BIT_MASK 0x20 /end MEASUREMENT
/begin MEASUREMENT fmy_stat_alter_bn_bat.err_info_stat.lv_cdn_diag "diagnosis condition of the diagnosis instance ALTER_BN_BAT" UWORD _CNV_S_2_RANGE__0___1_CM 1 100. 0. 1. DISPLAY_IDENTIFIER LV_CDN_DIAG_ALTER_BN_BAT ECU_ADDRESS 0xd00093d2 BIT_MASK 0x40 /end MEASUREMENT
/begin MEASUREMENT fmy_stat_alter_bn_bat.err_info_stat.err_sym "symptoms of the diagnosis instance ALTER_BN_BAT" UWORD _CNV_S_16_RANGE_ERR__349_CM 1 100. 0. 15. DISPLAY_IDENTIFIER ERR_SYM_ALTER_BN_BAT ECU_ADDRESS 0xd00093d2 BIT_MASK 0x780 /end MEASUREMENT
/begin MEASUREMENT fmy_stat_t_es.ctr_abc "anti bounce counter for diagnosis instance T_ES" UBYTE _CNV_A_R_LINEAR_____0_CM 1 100. 0. 255. DISPLAY_IDENTIFIER CTR_ABC_T_ES ECU_ADDRESS 0xd00099ec FORMAT "%3.0" /end MEASUREMENT
/begin MEASUREMENT fmy_stat_t_es.ctr_end_diag "counter for end of diagnosis for diagnosis instance T_ES" UBYTE _CNV_A_R_LINEAR_____0_CM 1 100. 0. 255. DISPLAY_IDENTIFIER CTR_ABC_END_DIAG_T_ES ECU_ADDRESS 0xd00099ed FORMAT "%3.0" /end MEASUREMENT
/begin MEASUREMENT fmy_stat_t_es.err_info_stat.lv_err_mem "storage in dynamic failure memory of the diagnosis instance T_ES" UWORD _CNV_S_2_RANGE__0___1_CM 1 100. 0. 1. DISPLAY_IDENTIFIER LV_ERR_MEM_T_ES ECU_ADDRESS 0xd00099ee BIT_MASK 0x8 /end MEASUREMENT
/begin MEASUREMENT fmy_stat_t_es.err_info_stat.lv_ready "readiness status of the diagnosis instance T_ES" UWORD _CNV_S_2_RANGE__0___1_CM 1 100. 0. 1. DISPLAY_IDENTIFIER LV_READY_T_ES ECU_ADDRESS 0xd00099ee BIT_MASK 0x10 /end MEASUREMENT
/begin MEASUREMENT fmy_stat_t_es.err_info_stat.lv_end_diag "end of diagnosis of the diagnosis instance T_ES" UWORD _CNV_S_2_RANGE__0___1_CM 1 100. 0. 1. DISPLAY_IDENTIFIER LV_END_DIAG_T_ES ECU_ADDRESS 0xd00099ee BIT_MASK 0x20 /end MEASUREMENT
/begin MEASUREMENT fmy_stat_t_es.err_info_stat.lv_cdn_diag "diagnosis condition of the diagnosis instance T_ES" UWORD _CNV_S_2_RANGE__0___1_CM 1 100. 0. 1. DISPLAY_IDENTIFIER LV_CDN_DIAG_T_ES ECU_ADDRESS 0xd00099ee BIT_MASK 0x40 /end MEASUREMENT
/begin MEASUREMENT fmy_stat_t_es.err_info_stat.err_sym "symptoms of the diagnosis instance T_ES" UWORD _CNV_S_16_RANGE_ERR__349_CM 1 100. 0. 15. DISPLAY_IDENTIFIER ERR_SYM_T_ES ECU_ADDRESS 0xd00099ee BIT_MASK 0x780 /end MEASUREMENT
/begin MEASUREMENT fmy_stat_map_dip_plaus.ctr_abc "anti bounce counter for diagnosis instance MAP_DIP_PLAUS" UBYTE _CNV_A_R_LINEAR_____0_CM 1 100. 0. 255. DISPLAY_IDENTIFIER CTR_ABC_MAP_DIP_PLAUS ECU_ADDRESS 0xd0009808 FORMAT "%3.0" /end MEASUREMENT
/begin MEASUREMENT fmy_stat_map_dip_plaus.ctr_end_diag "counter for end of diagnosis for diagnosis instance MAP_DIP_PLAUS" UBYTE _CNV_A_R_LINEAR_____0_CM 1 100. 0. 255. DISPLAY_IDENTIFIER CTR_ABC_END_DIAG_MAP_DIP_PLAUS ECU_ADDRESS 0xd0009809 FORMAT "%3.0" /end MEASUREMENT
/begin MEASUREMENT fmy_stat_map_dip_plaus.err_info_stat.lv_err_mem "storage in dynamic failure memory of the diagnosis instance MAP_DIP_PLAUS" UWORD _CNV_S_2_RANGE__0___1_CM 1 100. 0. 1. DISPLAY_IDENTIFIER LV_ERR_MEM_MAP_DIP_PLAUS ECU_ADDRESS 0xd000980a BIT_MASK 0x8 /end MEASUREMENT
/begin MEASUREMENT fmy_stat_map_dip_plaus.err_info_stat.lv_ready "readiness status of the diagnosis instance MAP_DIP_PLAUS" UWORD _CNV_S_2_RANGE__0___1_CM 1 100. 0. 1. DISPLAY_IDENTIFIER LV_READY_MAP_DIP_PLAUS ECU_ADDRESS 0xd000980a BIT_MASK 0x10 /end MEASUREMENT
/begin MEASUREMENT fmy_stat_map_dip_plaus.err_info_stat.lv_end_diag "end of diagnosis of the diagnosis instance MAP_DIP_PLAUS" UWORD _CNV_S_2_RANGE__0___1_CM 1 100. 0. 1. DISPLAY_IDENTIFIER LV_END_DIAG_MAP_DIP_PLAUS ECU_ADDRESS 0xd000980a BIT_MASK 0x20 /end MEASUREMENT
/begin MEASUREMENT fmy_stat_map_dip_plaus.err_info_stat.lv_cdn_diag "diagnosis condition of the diagnosis instance MAP_DIP_PLAUS" UWORD _CNV_S_2_RANGE__0___1_CM 1 100. 0. 1. DISPLAY_IDENTIFIER LV_CDN_DIAG_MAP_DIP_PLAUS ECU_ADDRESS 0xd000980a BIT_MASK 0x40 /end MEASUREMENT
/begin MEASUREMENT fmy_stat_map_dip_plaus.err_info_stat.err_sym "symptoms of the diagnosis instance MAP_DIP_PLAUS" UWORD _CNV_S_16_RANGE_ERR__349_CM 1 100. 0. 15. DISPLAY_IDENTIFIER ERR_SYM_MAP_DIP_PLAUS ECU_ADDRESS 0xd000980a BIT_MASK 0x780 /end MEASUREMENT
/begin MEASUREMENT fmy_stat_toil_level.ctr_abc "anti bounce counter for diagnosis instance TOIL_LEVEL" UBYTE _CNV_A_R_LINEAR_____0_CM 1 100. 0. 255. DISPLAY_IDENTIFIER CTR_ABC_TOIL_LEVEL ECU_ADDRESS 0xd0009a54 FORMAT "%3.0" /end MEASUREMENT
/begin MEASUREMENT fmy_stat_toil_level.ctr_end_diag "counter for end of diagnosis for diagnosis instance TOIL_LEVEL" UBYTE _CNV_A_R_LINEAR_____0_CM 1 100. 0. 255. DISPLAY_IDENTIFIER CTR_ABC_END_DIAG_TOIL_LEVEL ECU_ADDRESS 0xd0009a55 FORMAT "%3.0" /end MEASUREMENT
/begin MEASUREMENT fmy_stat_toil_level.err_info_stat.lv_err_mem "storage in dynamic failure memory of the diagnosis instance TOIL_LEVEL" UWORD _CNV_S_2_RANGE__0___1_CM 1 100. 0. 1. DISPLAY_IDENTIFIER LV_ERR_MEM_TOIL_LEVEL ECU_ADDRESS 0xd0009a56 BIT_MASK 0x8 /end MEASUREMENT
/begin MEASUREMENT fmy_stat_toil_level.err_info_stat.lv_ready "readiness status of the diagnosis instance TOIL_LEVEL" UWORD _CNV_S_2_RANGE__0___1_CM 1 100. 0. 1. DISPLAY_IDENTIFIER LV_READY_TOIL_LEVEL ECU_ADDRESS 0xd0009a56 BIT_MASK 0x10 /end MEASUREMENT
/begin MEASUREMENT fmy_stat_toil_level.err_info_stat.lv_end_diag "end of diagnosis of the diagnosis instance TOIL_LEVEL" UWORD _CNV_S_2_RANGE__0___1_CM 1 100. 0. 1. DISPLAY_IDENTIFIER LV_END_DIAG_TOIL_LEVEL ECU_ADDRESS 0xd0009a56 BIT_MASK 0x20 /end MEASUREMENT
/begin MEASUREMENT fmy_stat_toil_level.err_info_stat.lv_cdn_diag "diagnosis condition of the diagnosis instance TOIL_LEVEL" UWORD _CNV_S_2_RANGE__0___1_CM 1 100. 0. 1. DISPLAY_IDENTIFIER LV_CDN_DIAG_TOIL_LEVEL ECU_ADDRESS 0xd0009a56 BIT_MASK 0x40 /end MEASUREMENT
/begin MEASUREMENT fmy_stat_toil_level.err_info_stat.err_sym "symptoms of the diagnosis instance TOIL_LEVEL" UWORD _CNV_S_16_RANGE_ERR__349_CM 1 100. 0. 15. DISPLAY_IDENTIFIER ERR_SYM_TOIL_LEVEL ECU_ADDRESS 0xd0009a56 BIT_MASK 0x780 /end MEASUREMENT
/begin MEASUREMENT fmy_stat_alter_bn_rgn.ctr_abc "anti bounce counter for diagnosis instance ALTER_BN_RGN" UBYTE _CNV_A_R_LINEAR_____0_CM 1 100. 0. 255. DISPLAY_IDENTIFIER CTR_ABC_ALTER_BN_RGN ECU_ADDRESS 0xd00093d4 FORMAT "%3.0" /end MEASUREMENT
/begin MEASUREMENT fmy_stat_alter_bn_rgn.ctr_end_diag "counter for end of diagnosis for diagnosis instance ALTER_BN_RGN" UBYTE _CNV_A_R_LINEAR_____0_CM 1 100. 0. 255. DISPLAY_IDENTIFIER CTR_ABC_END_DIAG_ALTER_BN_RGN ECU_ADDRESS 0xd00093d5 FORMAT "%3.0" /end MEASUREMENT
/begin MEASUREMENT fmy_stat_alter_bn_rgn.err_info_stat.lv_err_mem "storage in dynamic failure memory of the diagnosis instance ALTER_BN_RGN" UWORD _CNV_S_2_RANGE__0___1_CM 1 100. 0. 1. DISPLAY_IDENTIFIER LV_ERR_MEM_ALTER_BN_RGN ECU_ADDRESS 0xd00093d6 BIT_MASK 0x8 /end MEASUREMENT
/begin MEASUREMENT fmy_stat_alter_bn_rgn.err_info_stat.lv_ready "readiness status of the diagnosis instance ALTER_BN_RGN" UWORD _CNV_S_2_RANGE__0___1_CM 1 100. 0. 1. DISPLAY_IDENTIFIER LV_READY_ALTER_BN_RGN ECU_ADDRESS 0xd00093d6 BIT_MASK 0x10 /end MEASUREMENT
/begin MEASUREMENT fmy_stat_alter_bn_rgn.err_info_stat.lv_end_diag "end of diagnosis of the diagnosis instance ALTER_BN_RGN" UWORD _CNV_S_2_RANGE__0___1_CM 1 100. 0. 1. DISPLAY_IDENTIFIER LV_END_DIAG_ALTER_BN_RGN ECU_ADDRESS 0xd00093d6 BIT_MASK 0x20 /end MEASUREMENT
/begin MEASUREMENT fmy_stat_alter_bn_rgn.err_info_stat.lv_cdn_diag "diagnosis condition of the diagnosis instance ALTER_BN_RGN" UWORD _CNV_S_2_RANGE__0___1_CM 1 100. 0. 1. DISPLAY_IDENTIFIER LV_CDN_DIAG_ALTER_BN_RGN ECU_ADDRESS 0xd00093d6 BIT_MASK 0x40 /end MEASUREMENT
/begin MEASUREMENT fmy_stat_alter_bn_rgn.err_info_stat.err_sym "symptoms of the diagnosis instance ALTER_BN_RGN" UWORD _CNV_S_16_RANGE_ERR__349_CM 1 100. 0. 15. DISPLAY_IDENTIFIER ERR_SYM_ALTER_BN_RGN ECU_ADDRESS 0xd00093d6 BIT_MASK 0x780 /end MEASUREMENT
/begin MEASUREMENT fmy_stat_per_cam_in_1.ctr_abc "anti bounce counter for diagnosis instance PER_CAM_IN_1" UBYTE _CNV_A_R_LINEAR_____0_CM 1 100. 0. 255. DISPLAY_IDENTIFIER CTR_ABC_PER_CAM_IN_1 ECU_ADDRESS 0xd00098c8 FORMAT "%3.0" /end MEASUREMENT
/begin MEASUREMENT fmy_stat_per_cam_in_1.ctr_end_diag "counter for end of diagnosis for diagnosis instance PER_CAM_IN_1" UBYTE _CNV_A_R_LINEAR_____0_CM 1 100. 0. 255. DISPLAY_IDENTIFIER CTR_ABC_END_DIAG_PER_CAM_IN_1 ECU_ADDRESS 0xd00098c9 FORMAT "%3.0" /end MEASUREMENT
/begin MEASUREMENT fmy_stat_per_cam_in_1.err_info_stat.lv_err_mem "storage in dynamic failure memory of the diagnosis instance PER_CAM_IN_1" UWORD _CNV_S_2_RANGE__0___1_CM 1 100. 0. 1. DISPLAY_IDENTIFIER LV_ERR_MEM_PER_CAM_IN_1 ECU_ADDRESS 0xd00098ca BIT_MASK 0x8 /end MEASUREMENT
/begin MEASUREMENT fmy_stat_per_cam_in_1.err_info_stat.lv_ready "readiness status of the diagnosis instance PER_CAM_IN_1" UWORD _CNV_S_2_RANGE__0___1_CM 1 100. 0. 1. DISPLAY_IDENTIFIER LV_READY_PER_CAM_IN_1 ECU_ADDRESS 0xd00098ca BIT_MASK 0x10 /end MEASUREMENT
/begin MEASUREMENT fmy_stat_per_cam_in_1.err_info_stat.lv_end_diag "end of diagnosis of the diagnosis instance PER_CAM_IN_1" UWORD _CNV_S_2_RANGE__0___1_CM 1 100. 0. 1. DISPLAY_IDENTIFIER LV_END_DIAG_PER_CAM_IN_1 ECU_ADDRESS 0xd00098ca BIT_MASK 0x20 /end MEASUREMENT
/begin MEASUREMENT fmy_stat_per_cam_in_1.err_info_stat.lv_cdn_diag "diagnosis condition of the diagnosis instance PER_CAM_IN_1" UWORD _CNV_S_2_RANGE__0___1_CM 1 100. 0. 1. DISPLAY_IDENTIFIER LV_CDN_DIAG_PER_CAM_IN_1 ECU_ADDRESS 0xd00098ca BIT_MASK 0x40 /end MEASUREMENT
/begin MEASUREMENT fmy_stat_per_cam_in_1.err_info_stat.err_sym "symptoms of the diagnosis instance PER_CAM_IN_1" UWORD _CNV_S_16_RANGE_ERR__349_CM 1 100. 0. 15. DISPLAY_IDENTIFIER ERR_SYM_PER_CAM_IN_1 ECU_ADDRESS 0xd00098ca BIT_MASK 0x780 /end MEASUREMENT
/begin MEASUREMENT fmy_stat_per_cam_ex_1.ctr_abc "anti bounce counter for diagnosis instance PER_CAM_EX_1" UBYTE _CNV_A_R_LINEAR_____0_CM 1 100. 0. 255. DISPLAY_IDENTIFIER CTR_ABC_PER_CAM_EX_1 ECU_ADDRESS 0xd00098c0 FORMAT "%3.0" /end MEASUREMENT
/begin MEASUREMENT fmy_stat_per_cam_ex_1.ctr_end_diag "counter for end of diagnosis for diagnosis instance PER_CAM_EX_1" UBYTE _CNV_A_R_LINEAR_____0_CM 1 100. 0. 255. DISPLAY_IDENTIFIER CTR_ABC_END_DIAG_PER_CAM_EX_1 ECU_ADDRESS 0xd00098c1 FORMAT "%3.0" /end MEASUREMENT
/begin MEASUREMENT fmy_stat_per_cam_ex_1.err_info_stat.lv_err_mem "storage in dynamic failure memory of the diagnosis instance PER_CAM_EX_1" UWORD _CNV_S_2_RANGE__0___1_CM 1 100. 0. 1. DISPLAY_IDENTIFIER LV_ERR_MEM_PER_CAM_EX_1 ECU_ADDRESS 0xd00098c2 BIT_MASK 0x8 /end MEASUREMENT
/begin MEASUREMENT fmy_stat_per_cam_ex_1.err_info_stat.lv_ready "readiness status of the diagnosis instance PER_CAM_EX_1" UWORD _CNV_S_2_RANGE__0___1_CM 1 100. 0. 1. DISPLAY_IDENTIFIER LV_READY_PER_CAM_EX_1 ECU_ADDRESS 0xd00098c2 BIT_MASK 0x10 /end MEASUREMENT
/begin MEASUREMENT fmy_stat_per_cam_ex_1.err_info_stat.lv_end_diag "end of diagnosis of the diagnosis instance PER_CAM_EX_1" UWORD _CNV_S_2_RANGE__0___1_CM 1 100. 0. 1. DISPLAY_IDENTIFIER LV_END_DIAG_PER_CAM_EX_1 ECU_ADDRESS 0xd00098c2 BIT_MASK 0x20 /end MEASUREMENT
/begin MEASUREMENT fmy_stat_per_cam_ex_1.err_info_stat.lv_cdn_diag "diagnosis condition of the diagnosis instance PER_CAM_EX_1" UWORD _CNV_S_2_RANGE__0___1_CM 1 100. 0. 1. DISPLAY_IDENTIFIER LV_CDN_DIAG_PER_CAM_EX_1 ECU_ADDRESS 0xd00098c2 BIT_MASK 0x40 /end MEASUREMENT
/begin MEASUREMENT fmy_stat_per_cam_ex_1.err_info_stat.err_sym "symptoms of the diagnosis instance PER_CAM_EX_1" UWORD _CNV_S_16_RANGE_ERR__349_CM 1 100. 0. 15. DISPLAY_IDENTIFIER ERR_SYM_PER_CAM_EX_1 ECU_ADDRESS 0xd00098c2 BIT_MASK 0x780 /end MEASUREMENT
/begin MEASUREMENT fmy_stat_syn_cam_in_1.ctr_abc "anti bounce counter for diagnosis instance SYN_CAM_IN_1" UBYTE _CNV_A_R_LINEAR_____0_CM 1 100. 0. 255. DISPLAY_IDENTIFIER CTR_ABC_SYN_CAM_IN_1 ECU_ADDRESS 0xd00099d4 FORMAT "%3.0" /end MEASUREMENT
/begin MEASUREMENT fmy_stat_syn_cam_in_1.ctr_end_diag "counter for end of diagnosis for diagnosis instance SYN_CAM_IN_1" UBYTE _CNV_A_R_LINEAR_____0_CM 1 100. 0. 255. DISPLAY_IDENTIFIER CTR_ABC_END_DIAG_SYN_CAM_IN_1 ECU_ADDRESS 0xd00099d5 FORMAT "%3.0" /end MEASUREMENT
/begin MEASUREMENT fmy_stat_syn_cam_in_1.err_info_stat.lv_err_mem "storage in dynamic failure memory of the diagnosis instance SYN_CAM_IN_1" UWORD _CNV_S_2_RANGE__0___1_CM 1 100. 0. 1. DISPLAY_IDENTIFIER LV_ERR_MEM_SYN_CAM_IN_1 ECU_ADDRESS 0xd00099d6 BIT_MASK 0x8 /end MEASUREMENT
/begin MEASUREMENT fmy_stat_syn_cam_in_1.err_info_stat.lv_ready "readiness status of the diagnosis instance SYN_CAM_IN_1" UWORD _CNV_S_2_RANGE__0___1_CM 1 100. 0. 1. DISPLAY_IDENTIFIER LV_READY_SYN_CAM_IN_1 ECU_ADDRESS 0xd00099d6 BIT_MASK 0x10 /end MEASUREMENT
/begin MEASUREMENT fmy_stat_syn_cam_in_1.err_info_stat.lv_end_diag "end of diagnosis of the diagnosis instance SYN_CAM_IN_1" UWORD _CNV_S_2_RANGE__0___1_CM 1 100. 0. 1. DISPLAY_IDENTIFIER LV_END_DIAG_SYN_CAM_IN_1 ECU_ADDRESS 0xd00099d6 BIT_MASK 0x20 /end MEASUREMENT
/begin MEASUREMENT fmy_stat_syn_cam_in_1.err_info_stat.lv_cdn_diag "diagnosis condition of the diagnosis instance SYN_CAM_IN_1" UWORD _CNV_S_2_RANGE__0___1_CM 1 100. 0. 1. DISPLAY_IDENTIFIER LV_CDN_DIAG_SYN_CAM_IN_1 ECU_ADDRESS 0xd00099d6 BIT_MASK 0x40 /end MEASUREMENT
/begin MEASUREMENT fmy_stat_syn_cam_in_1.err_info_stat.err_sym "symptoms of the diagnosis instance SYN_CAM_IN_1" UWORD _CNV_S_16_RANGE_ERR__349_CM 1 100. 0. 15. DISPLAY_IDENTIFIER ERR_SYM_SYN_CAM_IN_1 ECU_ADDRESS 0xd00099d6 BIT_MASK 0x780 /end MEASUREMENT
/begin MEASUREMENT fmy_stat_syn_cam_ex_1.ctr_abc "anti bounce counter for diagnosis instance SYN_CAM_EX_1" UBYTE _CNV_A_R_LINEAR_____0_CM 1 100. 0. 255. DISPLAY_IDENTIFIER CTR_ABC_SYN_CAM_EX_1 ECU_ADDRESS 0xd00099cc FORMAT "%3.0" /end MEASUREMENT
/begin MEASUREMENT fmy_stat_syn_cam_ex_1.ctr_end_diag "counter for end of diagnosis for diagnosis instance SYN_CAM_EX_1" UBYTE _CNV_A_R_LINEAR_____0_CM 1 100. 0. 255. DISPLAY_IDENTIFIER CTR_ABC_END_DIAG_SYN_CAM_EX_1 ECU_ADDRESS 0xd00099cd FORMAT "%3.0" /end MEASUREMENT
/begin MEASUREMENT fmy_stat_syn_cam_ex_1.err_info_stat.lv_err_mem "storage in dynamic failure memory of the diagnosis instance SYN_CAM_EX_1" UWORD _CNV_S_2_RANGE__0___1_CM 1 100. 0. 1. DISPLAY_IDENTIFIER LV_ERR_MEM_SYN_CAM_EX_1 ECU_ADDRESS 0xd00099ce BIT_MASK 0x8 /end MEASUREMENT
/begin MEASUREMENT fmy_stat_syn_cam_ex_1.err_info_stat.lv_ready "readiness status of the diagnosis instance SYN_CAM_EX_1" UWORD _CNV_S_2_RANGE__0___1_CM 1 100. 0. 1. DISPLAY_IDENTIFIER LV_READY_SYN_CAM_EX_1 ECU_ADDRESS 0xd00099ce BIT_MASK 0x10 /end MEASUREMENT
/begin MEASUREMENT fmy_stat_syn_cam_ex_1.err_info_stat.lv_end_diag "end of diagnosis of the diagnosis instance SYN_CAM_EX_1" UWORD _CNV_S_2_RANGE__0___1_CM 1 100. 0. 1. DISPLAY_IDENTIFIER LV_END_DIAG_SYN_CAM_EX_1 ECU_ADDRESS 0xd00099ce BIT_MASK 0x20 /end MEASUREMENT
/begin MEASUREMENT fmy_stat_syn_cam_ex_1.err_info_stat.lv_cdn_diag "diagnosis condition of the diagnosis instance SYN_CAM_EX_1" UWORD _CNV_S_2_RANGE__0___1_CM 1 100. 0. 1. DISPLAY_IDENTIFIER LV_CDN_DIAG_SYN_CAM_EX_1 ECU_ADDRESS 0xd00099ce BIT_MASK 0x40 /end MEASUREMENT
/begin MEASUREMENT fmy_stat_syn_cam_ex_1.err_info_stat.err_sym "symptoms of the diagnosis instance SYN_CAM_EX_1" UWORD _CNV_S_16_RANGE_ERR__349_CM 1 100. 0. 15. DISPLAY_IDENTIFIER ERR_SYM_SYN_CAM_EX_1 ECU_ADDRESS 0xd00099ce BIT_MASK 0x780 /end MEASUREMENT
/begin MEASUREMENT fmy_stat_ref_crk_cam_in_1.ctr_abc "anti bounce counter for diagnosis instance REF_CRK_CAM_IN_1" UBYTE _CNV_A_R_LINEAR_____0_CM 1 100. 0. 255. DISPLAY_IDENTIFIER CTR_ABC_REF_CRK_CAM_IN_1 ECU_ADDRESS 0xd0009938 FORMAT "%3.0" /end MEASUREMENT
/begin MEASUREMENT fmy_stat_ref_crk_cam_in_1.ctr_end_diag "counter for end of diagnosis for diagnosis instance REF_CRK_CAM_IN_1" UBYTE _CNV_A_R_LINEAR_____0_CM 1 100. 0. 255. DISPLAY_IDENTIFIER CTR_ABC_END_DIAG_REF_CRK_CAM_IN_1 ECU_ADDRESS 0xd0009939 FORMAT "%3.0" /end MEASUREMENT
/begin MEASUREMENT fmy_stat_ref_crk_cam_in_1.err_info_stat.lv_err_mem "storage in dynamic failure memory of the diagnosis instance REF_CRK_CAM_IN_1" UWORD _CNV_S_2_RANGE__0___1_CM 1 100. 0. 1. DISPLAY_IDENTIFIER LV_ERR_MEM_REF_CRK_CAM_IN_1 ECU_ADDRESS 0xd000993a BIT_MASK 0x8 /end MEASUREMENT
/begin MEASUREMENT fmy_stat_ref_crk_cam_in_1.err_info_stat.lv_ready "readiness status of the diagnosis instance REF_CRK_CAM_IN_1" UWORD _CNV_S_2_RANGE__0___1_CM 1 100. 0. 1. DISPLAY_IDENTIFIER LV_READY_REF_CRK_CAM_IN_1 ECU_ADDRESS 0xd000993a BIT_MASK 0x10 /end MEASUREMENT
/begin MEASUREMENT fmy_stat_ref_crk_cam_in_1.err_info_stat.lv_end_diag "end of diagnosis of the diagnosis instance REF_CRK_CAM_IN_1" UWORD _CNV_S_2_RANGE__0___1_CM 1 100. 0. 1. DISPLAY_IDENTIFIER LV_END_DIAG_REF_CRK_CAM_IN_1 ECU_ADDRESS 0xd000993a BIT_MASK 0x20 /end MEASUREMENT
/begin MEASUREMENT fmy_stat_ref_crk_cam_in_1.err_info_stat.lv_cdn_diag "diagnosis condition of the diagnosis instance REF_CRK_CAM_IN_1" UWORD _CNV_S_2_RANGE__0___1_CM 1 100. 0. 1. DISPLAY_IDENTIFIER LV_CDN_DIAG_REF_CRK_CAM_IN_1 ECU_ADDRESS 0xd000993a BIT_MASK 0x40 /end MEASUREMENT
/begin MEASUREMENT fmy_stat_ref_crk_cam_in_1.err_info_stat.err_sym "symptoms of the diagnosis instance REF_CRK_CAM_IN_1" UWORD _CNV_S_16_RANGE_ERR__349_CM 1 100. 0. 15. DISPLAY_IDENTIFIER ERR_SYM_REF_CRK_CAM_IN_1 ECU_ADDRESS 0xd000993a BIT_MASK 0x780 /end MEASUREMENT
/begin MEASUREMENT fmy_stat_ref_crk_cam_ex_1.ctr_abc "anti bounce counter for diagnosis instance REF_CRK_CAM_EX_1" UBYTE _CNV_A_R_LINEAR_____0_CM 1 100. 0. 255. DISPLAY_IDENTIFIER CTR_ABC_REF_CRK_CAM_EX_1 ECU_ADDRESS 0xd0009930 FORMAT "%3.0" /end MEASUREMENT
/begin MEASUREMENT fmy_stat_ref_crk_cam_ex_1.ctr_end_diag "counter for end of diagnosis for diagnosis instance REF_CRK_CAM_EX_1" UBYTE _CNV_A_R_LINEAR_____0_CM 1 100. 0. 255. DISPLAY_IDENTIFIER CTR_ABC_END_DIAG_REF_CRK_CAM_EX_1 ECU_ADDRESS 0xd0009931 FORMAT "%3.0" /end MEASUREMENT
/begin MEASUREMENT fmy_stat_ref_crk_cam_ex_1.err_info_stat.lv_err_mem "storage in dynamic failure memory of the diagnosis instance REF_CRK_CAM_EX_1" UWORD _CNV_S_2_RANGE__0___1_CM 1 100. 0. 1. DISPLAY_IDENTIFIER LV_ERR_MEM_REF_CRK_CAM_EX_1 ECU_ADDRESS 0xd0009932 BIT_MASK 0x8 /end MEASUREMENT
/begin MEASUREMENT fmy_stat_ref_crk_cam_ex_1.err_info_stat.lv_ready "readiness status of the diagnosis instance REF_CRK_CAM_EX_1" UWORD _CNV_S_2_RANGE__0___1_CM 1 100. 0. 1. DISPLAY_IDENTIFIER LV_READY_REF_CRK_CAM_EX_1 ECU_ADDRESS 0xd0009932 BIT_MASK 0x10 /end MEASUREMENT
/begin MEASUREMENT fmy_stat_ref_crk_cam_ex_1.err_info_stat.lv_end_diag "end of diagnosis of the diagnosis instance REF_CRK_CAM_EX_1" UWORD _CNV_S_2_RANGE__0___1_CM 1 100. 0. 1. DISPLAY_IDENTIFIER LV_END_DIAG_REF_CRK_CAM_EX_1 ECU_ADDRESS 0xd0009932 BIT_MASK 0x20 /end MEASUREMENT
/begin MEASUREMENT fmy_stat_ref_crk_cam_ex_1.err_info_stat.lv_cdn_diag "diagnosis condition of the diagnosis instance REF_CRK_CAM_EX_1" UWORD _CNV_S_2_RANGE__0___1_CM 1 100. 0. 1. DISPLAY_IDENTIFIER LV_CDN_DIAG_REF_CRK_CAM_EX_1 ECU_ADDRESS 0xd0009932 BIT_MASK 0x40 /end MEASUREMENT
/begin MEASUREMENT fmy_stat_ref_crk_cam_ex_1.err_info_stat.err_sym "symptoms of the diagnosis instance REF_CRK_CAM_EX_1" UWORD _CNV_S_16_RANGE_ERR__349_CM 1 100. 0. 15. DISPLAY_IDENTIFIER ERR_SYM_REF_CRK_CAM_EX_1 ECU_ADDRESS 0xd0009932 BIT_MASK 0x780 /end MEASUREMENT
/begin MEASUREMENT fmy_stat_per_cam_in_2.ctr_abc "anti bounce counter for diagnosis instance PER_CAM_IN_2" UBYTE _CNV_A_R_LINEAR_____0_CM 1 100. 0. 255. DISPLAY_IDENTIFIER CTR_ABC_PER_CAM_IN_2 ECU_ADDRESS 0xd00098cc FORMAT "%3.0" /end MEASUREMENT
/begin MEASUREMENT fmy_stat_per_cam_in_2.ctr_end_diag "counter for end of diagnosis for diagnosis instance PER_CAM_IN_2" UBYTE _CNV_A_R_LINEAR_____0_CM 1 100. 0. 255. DISPLAY_IDENTIFIER CTR_ABC_END_DIAG_PER_CAM_IN_2 ECU_ADDRESS 0xd00098cd FORMAT "%3.0" /end MEASUREMENT
/begin MEASUREMENT fmy_stat_per_cam_in_2.err_info_stat.lv_err_mem "storage in dynamic failure memory of the diagnosis instance PER_CAM_IN_2" UWORD _CNV_S_2_RANGE__0___1_CM 1 100. 0. 1. DISPLAY_IDENTIFIER LV_ERR_MEM_PER_CAM_IN_2 ECU_ADDRESS 0xd00098ce BIT_MASK 0x8 /end MEASUREMENT
/begin MEASUREMENT fmy_stat_per_cam_in_2.err_info_stat.lv_ready "readiness status of the diagnosis instance PER_CAM_IN_2" UWORD _CNV_S_2_RANGE__0___1_CM 1 100. 0. 1. DISPLAY_IDENTIFIER LV_READY_PER_CAM_IN_2 ECU_ADDRESS 0xd00098ce BIT_MASK 0x10 /end MEASUREMENT
/begin MEASUREMENT fmy_stat_per_cam_in_2.err_info_stat.lv_end_diag "end of diagnosis of the diagnosis instance PER_CAM_IN_2" UWORD _CNV_S_2_RANGE__0___1_CM 1 100. 0. 1. DISPLAY_IDENTIFIER LV_END_DIAG_PER_CAM_IN_2 ECU_ADDRESS 0xd00098ce BIT_MASK 0x20 /end MEASUREMENT
/begin MEASUREMENT fmy_stat_per_cam_in_2.err_info_stat.lv_cdn_diag "diagnosis condition of the diagnosis instance PER_CAM_IN_2" UWORD _CNV_S_2_RANGE__0___1_CM 1 100. 0. 1. DISPLAY_IDENTIFIER LV_CDN_DIAG_PER_CAM_IN_2 ECU_ADDRESS 0xd00098ce BIT_MASK 0x40 /end MEASUREMENT
/begin MEASUREMENT fmy_stat_per_cam_in_2.err_info_stat.err_sym "symptoms of the diagnosis instance PER_CAM_IN_2" UWORD _CNV_S_16_RANGE_ERR__349_CM 1 100. 0. 15. DISPLAY_IDENTIFIER ERR_SYM_PER_CAM_IN_2 ECU_ADDRESS 0xd00098ce BIT_MASK 0x780 /end MEASUREMENT
/begin MEASUREMENT fmy_stat_per_cam_ex_2.ctr_abc "anti bounce counter for diagnosis instance PER_CAM_EX_2" UBYTE _CNV_A_R_LINEAR_____0_CM 1 100. 0. 255. DISPLAY_IDENTIFIER CTR_ABC_PER_CAM_EX_2 ECU_ADDRESS 0xd00098c4 FORMAT "%3.0" /end MEASUREMENT
/begin MEASUREMENT fmy_stat_per_cam_ex_2.ctr_end_diag "counter for end of diagnosis for diagnosis instance PER_CAM_EX_2" UBYTE _CNV_A_R_LINEAR_____0_CM 1 100. 0. 255. DISPLAY_IDENTIFIER CTR_ABC_END_DIAG_PER_CAM_EX_2 ECU_ADDRESS 0xd00098c5 FORMAT "%3.0" /end MEASUREMENT
/begin MEASUREMENT fmy_stat_per_cam_ex_2.err_info_stat.lv_err_mem "storage in dynamic failure memory of the diagnosis instance PER_CAM_EX_2" UWORD _CNV_S_2_RANGE__0___1_CM 1 100. 0. 1. DISPLAY_IDENTIFIER LV_ERR_MEM_PER_CAM_EX_2 ECU_ADDRESS 0xd00098c6 BIT_MASK 0x8 /end MEASUREMENT
/begin MEASUREMENT fmy_stat_per_cam_ex_2.err_info_stat.lv_ready "readiness status of the diagnosis instance PER_CAM_EX_2" UWORD _CNV_S_2_RANGE__0___1_CM 1 100. 0. 1. DISPLAY_IDENTIFIER LV_READY_PER_CAM_EX_2 ECU_ADDRESS 0xd00098c6 BIT_MASK 0x10 /end MEASUREMENT
/begin MEASUREMENT fmy_stat_per_cam_ex_2.err_info_stat.lv_end_diag "end of diagnosis of the diagnosis instance PER_CAM_EX_2" UWORD _CNV_S_2_RANGE__0___1_CM 1 100. 0. 1. DISPLAY_IDENTIFIER LV_END_DIAG_PER_CAM_EX_2 ECU_ADDRESS 0xd00098c6 BIT_MASK 0x20 /end MEASUREMENT
/begin MEASUREMENT fmy_stat_per_cam_ex_2.err_info_stat.lv_cdn_diag "diagnosis condition of the diagnosis instance PER_CAM_EX_2" UWORD _CNV_S_2_RANGE__0___1_CM 1 100. 0. 1. DISPLAY_IDENTIFIER LV_CDN_DIAG_PER_CAM_EX_2 ECU_ADDRESS 0xd00098c6 BIT_MASK 0x40 /end MEASUREMENT
/begin MEASUREMENT fmy_stat_per_cam_ex_2.err_info_stat.err_sym "symptoms of the diagnosis instance PER_CAM_EX_2" UWORD _CNV_S_16_RANGE_ERR__349_CM 1 100. 0. 15. DISPLAY_IDENTIFIER ERR_SYM_PER_CAM_EX_2 ECU_ADDRESS 0xd00098c6 BIT_MASK 0x780 /end MEASUREMENT
/begin MEASUREMENT fmy_stat_syn_cam_in_2.ctr_abc "anti bounce counter for diagnosis instance SYN_CAM_IN_2" UBYTE _CNV_A_R_LINEAR_____0_CM 1 100. 0. 255. DISPLAY_IDENTIFIER CTR_ABC_SYN_CAM_IN_2 ECU_ADDRESS 0xd00099d8 FORMAT "%3.0" /end MEASUREMENT
/begin MEASUREMENT fmy_stat_syn_cam_in_2.ctr_end_diag "counter for end of diagnosis for diagnosis instance SYN_CAM_IN_2" UBYTE _CNV_A_R_LINEAR_____0_CM 1 100. 0. 255. DISPLAY_IDENTIFIER CTR_ABC_END_DIAG_SYN_CAM_IN_2 ECU_ADDRESS 0xd00099d9 FORMAT "%3.0" /end MEASUREMENT
/begin MEASUREMENT fmy_stat_syn_cam_in_2.err_info_stat.lv_err_mem "storage in dynamic failure memory of the diagnosis instance SYN_CAM_IN_2" UWORD _CNV_S_2_RANGE__0___1_CM 1 100. 0. 1. DISPLAY_IDENTIFIER LV_ERR_MEM_SYN_CAM_IN_2 ECU_ADDRESS 0xd00099da BIT_MASK 0x8 /end MEASUREMENT
/begin MEASUREMENT fmy_stat_syn_cam_in_2.err_info_stat.lv_ready "readiness status of the diagnosis instance SYN_CAM_IN_2" UWORD _CNV_S_2_RANGE__0___1_CM 1 100. 0. 1. DISPLAY_IDENTIFIER LV_READY_SYN_CAM_IN_2 ECU_ADDRESS 0xd00099da BIT_MASK 0x10 /end MEASUREMENT
/begin MEASUREMENT fmy_stat_syn_cam_in_2.err_info_stat.lv_end_diag "end of diagnosis of the diagnosis instance SYN_CAM_IN_2" UWORD _CNV_S_2_RANGE__0___1_CM 1 100. 0. 1. DISPLAY_IDENTIFIER LV_END_DIAG_SYN_CAM_IN_2 ECU_ADDRESS 0xd00099da BIT_MASK 0x20 /end MEASUREMENT
/begin MEASUREMENT fmy_stat_syn_cam_in_2.err_info_stat.lv_cdn_diag "diagnosis condition of the diagnosis instance SYN_CAM_IN_2" UWORD _CNV_S_2_RANGE__0___1_CM 1 100. 0. 1. DISPLAY_IDENTIFIER LV_CDN_DIAG_SYN_CAM_IN_2 ECU_ADDRESS 0xd00099da BIT_MASK 0x40 /end MEASUREMENT
/begin MEASUREMENT fmy_stat_syn_cam_in_2.err_info_stat.err_sym "symptoms of the diagnosis instance SYN_CAM_IN_2" UWORD _CNV_S_16_RANGE_ERR__349_CM 1 100. 0. 15. DISPLAY_IDENTIFIER ERR_SYM_SYN_CAM_IN_2 ECU_ADDRESS 0xd00099da BIT_MASK 0x780 /end MEASUREMENT
/begin MEASUREMENT fmy_stat_syn_cam_ex_2.ctr_abc "anti bounce counter for diagnosis instance SYN_CAM_EX_2" UBYTE _CNV_A_R_LINEAR_____0_CM 1 100. 0. 255. DISPLAY_IDENTIFIER CTR_ABC_SYN_CAM_EX_2 ECU_ADDRESS 0xd00099d0 FORMAT "%3.0" /end MEASUREMENT
/begin MEASUREMENT fmy_stat_syn_cam_ex_2.ctr_end_diag "counter for end of diagnosis for diagnosis instance SYN_CAM_EX_2" UBYTE _CNV_A_R_LINEAR_____0_CM 1 100. 0. 255. DISPLAY_IDENTIFIER CTR_ABC_END_DIAG_SYN_CAM_EX_2 ECU_ADDRESS 0xd00099d1 FORMAT "%3.0" /end MEASUREMENT
/begin MEASUREMENT fmy_stat_syn_cam_ex_2.err_info_stat.lv_err_mem "storage in dynamic failure memory of the diagnosis instance SYN_CAM_EX_2" UWORD _CNV_S_2_RANGE__0___1_CM 1 100. 0. 1. DISPLAY_IDENTIFIER LV_ERR_MEM_SYN_CAM_EX_2 ECU_ADDRESS 0xd00099d2 BIT_MASK 0x8 /end MEASUREMENT
/begin MEASUREMENT fmy_stat_syn_cam_ex_2.err_info_stat.lv_ready "readiness status of the diagnosis instance SYN_CAM_EX_2" UWORD _CNV_S_2_RANGE__0___1_CM 1 100. 0. 1. DISPLAY_IDENTIFIER LV_READY_SYN_CAM_EX_2 ECU_ADDRESS 0xd00099d2 BIT_MASK 0x10 /end MEASUREMENT
/begin MEASUREMENT fmy_stat_syn_cam_ex_2.err_info_stat.lv_end_diag "end of diagnosis of the diagnosis instance SYN_CAM_EX_2" UWORD _CNV_S_2_RANGE__0___1_CM 1 100. 0. 1. DISPLAY_IDENTIFIER LV_END_DIAG_SYN_CAM_EX_2 ECU_ADDRESS 0xd00099d2 BIT_MASK 0x20 /end MEASUREMENT
/begin MEASUREMENT fmy_stat_syn_cam_ex_2.err_info_stat.lv_cdn_diag "diagnosis condition of the diagnosis instance SYN_CAM_EX_2" UWORD _CNV_S_2_RANGE__0___1_CM 1 100. 0. 1. DISPLAY_IDENTIFIER LV_CDN_DIAG_SYN_CAM_EX_2 ECU_ADDRESS 0xd00099d2 BIT_MASK 0x40 /end MEASUREMENT
/begin MEASUREMENT fmy_stat_syn_cam_ex_2.err_info_stat.err_sym "symptoms of the diagnosis instance SYN_CAM_EX_2" UWORD _CNV_S_16_RANGE_ERR__349_CM 1 100. 0. 15. DISPLAY_IDENTIFIER ERR_SYM_SYN_CAM_EX_2 ECU_ADDRESS 0xd00099d2 BIT_MASK 0x780 /end MEASUREMENT
/begin MEASUREMENT fmy_stat_ref_crk_cam_in_2.ctr_abc "anti bounce counter for diagnosis instance REF_CRK_CAM_IN_2" UBYTE _CNV_A_R_LINEAR_____0_CM 1 100. 0. 255. DISPLAY_IDENTIFIER CTR_ABC_REF_CRK_CAM_IN_2 ECU_ADDRESS 0xd000993c FORMAT "%3.0" /end MEASUREMENT
/begin MEASUREMENT fmy_stat_ref_crk_cam_in_2.ctr_end_diag "counter for end of diagnosis for diagnosis instance REF_CRK_CAM_IN_2" UBYTE _CNV_A_R_LINEAR_____0_CM 1 100. 0. 255. DISPLAY_IDENTIFIER CTR_ABC_END_DIAG_REF_CRK_CAM_IN_2 ECU_ADDRESS 0xd000993d FORMAT "%3.0" /end MEASUREMENT
/begin MEASUREMENT fmy_stat_ref_crk_cam_in_2.err_info_stat.lv_err_mem "storage in dynamic failure memory of the diagnosis instance REF_CRK_CAM_IN_2" UWORD _CNV_S_2_RANGE__0___1_CM 1 100. 0. 1. DISPLAY_IDENTIFIER LV_ERR_MEM_REF_CRK_CAM_IN_2 ECU_ADDRESS 0xd000993e BIT_MASK 0x8 /end MEASUREMENT
/begin MEASUREMENT fmy_stat_ref_crk_cam_in_2.err_info_stat.lv_ready "readiness status of the diagnosis instance REF_CRK_CAM_IN_2" UWORD _CNV_S_2_RANGE__0___1_CM 1 100. 0. 1. DISPLAY_IDENTIFIER LV_READY_REF_CRK_CAM_IN_2 ECU_ADDRESS 0xd000993e BIT_MASK 0x10 /end MEASUREMENT
/begin MEASUREMENT fmy_stat_ref_crk_cam_in_2.err_info_stat.lv_end_diag "end of diagnosis of the diagnosis instance REF_CRK_CAM_IN_2" UWORD _CNV_S_2_RANGE__0___1_CM 1 100. 0. 1. DISPLAY_IDENTIFIER LV_END_DIAG_REF_CRK_CAM_IN_2 ECU_ADDRESS 0xd000993e BIT_MASK 0x20 /end MEASUREMENT
/begin MEASUREMENT fmy_stat_ref_crk_cam_in_2.err_info_stat.lv_cdn_diag "diagnosis condition of the diagnosis instance REF_CRK_CAM_IN_2" UWORD _CNV_S_2_RANGE__0___1_CM 1 100. 0. 1. DISPLAY_IDENTIFIER LV_CDN_DIAG_REF_CRK_CAM_IN_2 ECU_ADDRESS 0xd000993e BIT_MASK 0x40 /end MEASUREMENT
/begin MEASUREMENT fmy_stat_ref_crk_cam_in_2.err_info_stat.err_sym "symptoms of the diagnosis instance REF_CRK_CAM_IN_2" UWORD _CNV_S_16_RANGE_ERR__349_CM 1 100. 0. 15. DISPLAY_IDENTIFIER ERR_SYM_REF_CRK_CAM_IN_2 ECU_ADDRESS 0xd000993e BIT_MASK 0x780 /end MEASUREMENT
/begin MEASUREMENT fmy_stat_ref_crk_cam_ex_2.ctr_abc "anti bounce counter for diagnosis instance REF_CRK_CAM_EX_2" UBYTE _CNV_A_R_LINEAR_____0_CM 1 100. 0. 255. DISPLAY_IDENTIFIER CTR_ABC_REF_CRK_CAM_EX_2 ECU_ADDRESS 0xd0009934 FORMAT "%3.0" /end MEASUREMENT
/begin MEASUREMENT fmy_stat_ref_crk_cam_ex_2.ctr_end_diag "counter for end of diagnosis for diagnosis instance REF_CRK_CAM_EX_2" UBYTE _CNV_A_R_LINEAR_____0_CM 1 100. 0. 255. DISPLAY_IDENTIFIER CTR_ABC_END_DIAG_REF_CRK_CAM_EX_2 ECU_ADDRESS 0xd0009935 FORMAT "%3.0" /end MEASUREMENT
/begin MEASUREMENT fmy_stat_ref_crk_cam_ex_2.err_info_stat.lv_err_mem "storage in dynamic failure memory of the diagnosis instance REF_CRK_CAM_EX_2" UWORD _CNV_S_2_RANGE__0___1_CM 1 100. 0. 1. DISPLAY_IDENTIFIER LV_ERR_MEM_REF_CRK_CAM_EX_2 ECU_ADDRESS 0xd0009936 BIT_MASK 0x8 /end MEASUREMENT
/begin MEASUREMENT fmy_stat_ref_crk_cam_ex_2.err_info_stat.lv_ready "readiness status of the diagnosis instance REF_CRK_CAM_EX_2" UWORD _CNV_S_2_RANGE__0___1_CM 1 100. 0. 1. DISPLAY_IDENTIFIER LV_READY_REF_CRK_CAM_EX_2 ECU_ADDRESS 0xd0009936 BIT_MASK 0x10 /end MEASUREMENT
/begin MEASUREMENT fmy_stat_ref_crk_cam_ex_2.err_info_stat.lv_end_diag "end of diagnosis of the diagnosis instance REF_CRK_CAM_EX_2" UWORD _CNV_S_2_RANGE__0___1_CM 1 100. 0. 1. DISPLAY_IDENTIFIER LV_END_DIAG_REF_CRK_CAM_EX_2 ECU_ADDRESS 0xd0009936 BIT_MASK 0x20 /end MEASUREMENT
/begin MEASUREMENT fmy_stat_ref_crk_cam_ex_2.err_info_stat.lv_cdn_diag "diagnosis condition of the diagnosis instance REF_CRK_CAM_EX_2" UWORD _CNV_S_2_RANGE__0___1_CM 1 100. 0. 1. DISPLAY_IDENTIFIER LV_CDN_DIAG_REF_CRK_CAM_EX_2 ECU_ADDRESS 0xd0009936 BIT_MASK 0x40 /end MEASUREMENT
/begin MEASUREMENT fmy_stat_ref_crk_cam_ex_2.err_info_stat.err_sym "symptoms of the diagnosis instance REF_CRK_CAM_EX_2" UWORD _CNV_S_16_RANGE_ERR__349_CM 1 100. 0. 15. DISPLAY_IDENTIFIER ERR_SYM_REF_CRK_CAM_EX_2 ECU_ADDRESS 0xd0009936 BIT_MASK 0x780 /end MEASUREMENT
/begin MEASUREMENT fmy_stat_crk_tooth.ctr_abc "anti bounce counter for diagnosis instance CRK_TOOTH" UBYTE _CNV_A_R_LINEAR_____0_CM 1 100. 0. 255. DISPLAY_IDENTIFIER CTR_ABC_CRK_TOOTH ECU_ADDRESS 0xd0009574 FORMAT "%3.0" /end MEASUREMENT
/begin MEASUREMENT fmy_stat_crk_tooth.ctr_end_diag "counter for end of diagnosis for diagnosis instance CRK_TOOTH" UBYTE _CNV_A_R_LINEAR_____0_CM 1 100. 0. 255. DISPLAY_IDENTIFIER CTR_ABC_END_DIAG_CRK_TOOTH ECU_ADDRESS 0xd0009575 FORMAT "%3.0" /end MEASUREMENT
/begin MEASUREMENT fmy_stat_crk_tooth.err_info_stat.lv_err_mem "storage in dynamic failure memory of the diagnosis instance CRK_TOOTH" UWORD _CNV_S_2_RANGE__0___1_CM 1 100. 0. 1. DISPLAY_IDENTIFIER LV_ERR_MEM_CRK_TOOTH ECU_ADDRESS 0xd0009576 BIT_MASK 0x8 /end MEASUREMENT
/begin MEASUREMENT fmy_stat_crk_tooth.err_info_stat.lv_ready "readiness status of the diagnosis instance CRK_TOOTH" UWORD _CNV_S_2_RANGE__0___1_CM 1 100. 0. 1. DISPLAY_IDENTIFIER LV_READY_CRK_TOOTH ECU_ADDRESS 0xd0009576 BIT_MASK 0x10 /end MEASUREMENT
/begin MEASUREMENT fmy_stat_crk_tooth.err_info_stat.lv_end_diag "end of diagnosis of the diagnosis instance CRK_TOOTH" UWORD _CNV_S_2_RANGE__0___1_CM 1 100. 0. 1. DISPLAY_IDENTIFIER LV_END_DIAG_CRK_TOOTH ECU_ADDRESS 0xd0009576 BIT_MASK 0x20 /end MEASUREMENT
/begin MEASUREMENT fmy_stat_crk_tooth.err_info_stat.lv_cdn_diag "diagnosis condition of the diagnosis instance CRK_TOOTH" UWORD _CNV_S_2_RANGE__0___1_CM 1 100. 0. 1. DISPLAY_IDENTIFIER LV_CDN_DIAG_CRK_TOOTH ECU_ADDRESS 0xd0009576 BIT_MASK 0x40 /end MEASUREMENT
/begin MEASUREMENT fmy_stat_crk_tooth.err_info_stat.err_sym "symptoms of the diagnosis instance CRK_TOOTH" UWORD _CNV_S_16_RANGE_ERR__349_CM 1 100. 0. 15. DISPLAY_IDENTIFIER ERR_SYM_CRK_TOOTH ECU_ADDRESS 0xd0009576 BIT_MASK 0x780 /end MEASUREMENT
/begin MEASUREMENT fmy_stat_crk_tooth_per.ctr_abc "anti bounce counter for diagnosis instance CRK_TOOTH_PER" UBYTE _CNV_A_R_LINEAR_____0_CM 1 100. 0. 255. DISPLAY_IDENTIFIER CTR_ABC_CRK_TOOTH_PER ECU_ADDRESS 0xd0009578 FORMAT "%3.0" /end MEASUREMENT
/begin MEASUREMENT fmy_stat_crk_tooth_per.ctr_end_diag "counter for end of diagnosis for diagnosis instance CRK_TOOTH_PER" UBYTE _CNV_A_R_LINEAR_____0_CM 1 100. 0. 255. DISPLAY_IDENTIFIER CTR_ABC_END_DIAG_CRK_TOOTH_PER ECU_ADDRESS 0xd0009579 FORMAT "%3.0" /end MEASUREMENT
/begin MEASUREMENT fmy_stat_crk_tooth_per.err_info_stat.lv_err_mem "storage in dynamic failure memory of the diagnosis instance CRK_TOOTH_PER" UWORD _CNV_S_2_RANGE__0___1_CM 1 100. 0. 1. DISPLAY_IDENTIFIER LV_ERR_MEM_CRK_TOOTH_PER ECU_ADDRESS 0xd000957a BIT_MASK 0x8 /end MEASUREMENT
/begin MEASUREMENT fmy_stat_crk_tooth_per.err_info_stat.lv_ready "readiness status of the diagnosis instance CRK_TOOTH_PER" UWORD _CNV_S_2_RANGE__0___1_CM 1 100. 0. 1. DISPLAY_IDENTIFIER LV_READY_CRK_TOOTH_PER ECU_ADDRESS 0xd000957a BIT_MASK 0x10 /end MEASUREMENT
/begin MEASUREMENT fmy_stat_crk_tooth_per.err_info_stat.lv_end_diag "end of diagnosis of the diagnosis instance CRK_TOOTH_PER" UWORD _CNV_S_2_RANGE__0___1_CM 1 100. 0. 1. DISPLAY_IDENTIFIER LV_END_DIAG_CRK_TOOTH_PER ECU_ADDRESS 0xd000957a BIT_MASK 0x20 /end MEASUREMENT
/begin MEASUREMENT fmy_stat_crk_tooth_per.err_info_stat.lv_cdn_diag "diagnosis condition of the diagnosis instance CRK_TOOTH_PER" UWORD _CNV_S_2_RANGE__0___1_CM 1 100. 0. 1. DISPLAY_IDENTIFIER LV_CDN_DIAG_CRK_TOOTH_PER ECU_ADDRESS 0xd000957a BIT_MASK 0x40 /end MEASUREMENT
/begin MEASUREMENT fmy_stat_crk_tooth_per.err_info_stat.err_sym "symptoms of the diagnosis instance CRK_TOOTH_PER" UWORD _CNV_S_16_RANGE_ERR__349_CM 1 100. 0. 15. DISPLAY_IDENTIFIER ERR_SYM_CRK_TOOTH_PER ECU_ADDRESS 0xd000957a BIT_MASK 0x780 /end MEASUREMENT
/begin MEASUREMENT fmy_stat_crk_syn.ctr_abc "anti bounce counter for diagnosis instance CRK_SYN" UBYTE _CNV_A_R_LINEAR_____0_CM 1 100. 0. 255. DISPLAY_IDENTIFIER CTR_ABC_CRK_SYN ECU_ADDRESS 0xd0009570 FORMAT "%3.0" /end MEASUREMENT
/begin MEASUREMENT fmy_stat_crk_syn.ctr_end_diag "counter for end of diagnosis for diagnosis instance CRK_SYN" UBYTE _CNV_A_R_LINEAR_____0_CM 1 100. 0. 255. DISPLAY_IDENTIFIER CTR_ABC_END_DIAG_CRK_SYN ECU_ADDRESS 0xd0009571 FORMAT "%3.0" /end MEASUREMENT
/begin MEASUREMENT fmy_stat_crk_syn.err_info_stat.lv_err_mem "storage in dynamic failure memory of the diagnosis instance CRK_SYN" UWORD _CNV_S_2_RANGE__0___1_CM 1 100. 0. 1. DISPLAY_IDENTIFIER LV_ERR_MEM_CRK_SYN ECU_ADDRESS 0xd0009572 BIT_MASK 0x8 /end MEASUREMENT
/begin MEASUREMENT fmy_stat_crk_syn.err_info_stat.lv_ready "readiness status of the diagnosis instance CRK_SYN" UWORD _CNV_S_2_RANGE__0___1_CM 1 100. 0. 1. DISPLAY_IDENTIFIER LV_READY_CRK_SYN ECU_ADDRESS 0xd0009572 BIT_MASK 0x10 /end MEASUREMENT
/begin MEASUREMENT fmy_stat_crk_syn.err_info_stat.lv_end_diag "end of diagnosis of the diagnosis instance CRK_SYN" UWORD _CNV_S_2_RANGE__0___1_CM 1 100. 0. 1. DISPLAY_IDENTIFIER LV_END_DIAG_CRK_SYN ECU_ADDRESS 0xd0009572 BIT_MASK 0x20 /end MEASUREMENT
/begin MEASUREMENT fmy_stat_crk_syn.err_info_stat.lv_cdn_diag "diagnosis condition of the diagnosis instance CRK_SYN" UWORD _CNV_S_2_RANGE__0___1_CM 1 100. 0. 1. DISPLAY_IDENTIFIER LV_CDN_DIAG_CRK_SYN ECU_ADDRESS 0xd0009572 BIT_MASK 0x40 /end MEASUREMENT
/begin MEASUREMENT fmy_stat_crk_syn.err_info_stat.err_sym "symptoms of the diagnosis instance CRK_SYN" UWORD _CNV_S_16_RANGE_ERR__349_CM 1 100. 0. 15. DISPLAY_IDENTIFIER ERR_SYM_CRK_SYN ECU_ADDRESS 0xd0009572 BIT_MASK 0x780 /end MEASUREMENT
/begin MEASUREMENT fmy_stat_crk_plaus.ctr_abc "anti bounce counter for diagnosis instance CRK_PLAUS" UBYTE _CNV_A_R_LINEAR_____0_CM 1 100. 0. 255. DISPLAY_IDENTIFIER CTR_ABC_CRK_PLAUS ECU_ADDRESS 0xd000956c FORMAT "%3.0" /end MEASUREMENT
/begin MEASUREMENT fmy_stat_crk_plaus.ctr_end_diag "counter for end of diagnosis for diagnosis instance CRK_PLAUS" UBYTE _CNV_A_R_LINEAR_____0_CM 1 100. 0. 255. DISPLAY_IDENTIFIER CTR_ABC_END_DIAG_CRK_PLAUS ECU_ADDRESS 0xd000956d FORMAT "%3.0" /end MEASUREMENT
/begin MEASUREMENT fmy_stat_crk_plaus.err_info_stat.lv_err_mem "storage in dynamic failure memory of the diagnosis instance CRK_PLAUS" UWORD _CNV_S_2_RANGE__0___1_CM 1 100. 0. 1. DISPLAY_IDENTIFIER LV_ERR_MEM_CRK_PLAUS ECU_ADDRESS 0xd000956e BIT_MASK 0x8 /end MEASUREMENT
/begin MEASUREMENT fmy_stat_crk_plaus.err_info_stat.lv_ready "readiness status of the diagnosis instance CRK_PLAUS" UWORD _CNV_S_2_RANGE__0___1_CM 1 100. 0. 1. DISPLAY_IDENTIFIER LV_READY_CRK_PLAUS ECU_ADDRESS 0xd000956e BIT_MASK 0x10 /end MEASUREMENT
/begin MEASUREMENT fmy_stat_crk_plaus.err_info_stat.lv_end_diag "end of diagnosis of the diagnosis instance CRK_PLAUS" UWORD _CNV_S_2_RANGE__0___1_CM 1 100. 0. 1. DISPLAY_IDENTIFIER LV_END_DIAG_CRK_PLAUS ECU_ADDRESS 0xd000956e BIT_MASK 0x20 /end MEASUREMENT
/begin MEASUREMENT fmy_stat_crk_plaus.err_info_stat.lv_cdn_diag "diagnosis condition of the diagnosis instance CRK_PLAUS" UWORD _CNV_S_2_RANGE__0___1_CM 1 100. 0. 1. DISPLAY_IDENTIFIER LV_CDN_DIAG_CRK_PLAUS ECU_ADDRESS 0xd000956e BIT_MASK 0x40 /end MEASUREMENT
/begin MEASUREMENT fmy_stat_crk_plaus.err_info_stat.err_sym "symptoms of the diagnosis instance CRK_PLAUS" UWORD _CNV_S_16_RANGE_ERR__349_CM 1 100. 0. 15. DISPLAY_IDENTIFIER ERR_SYM_CRK_PLAUS ECU_ADDRESS 0xd000956e BIT_MASK 0x780 /end MEASUREMENT
/begin MEASUREMENT fmy_stat_plaus_cam_in_1.ctr_abc "anti bounce counter for diagnosis instance PLAUS_CAM_IN_1" UBYTE _CNV_A_R_LINEAR_____0_CM 1 100. 0. 255. DISPLAY_IDENTIFIER CTR_ABC_PLAUS_CAM_IN_1 ECU_ADDRESS 0xd00098d8 FORMAT "%3.0" /end MEASUREMENT
/begin MEASUREMENT fmy_stat_plaus_cam_in_1.ctr_end_diag "counter for end of diagnosis for diagnosis instance PLAUS_CAM_IN_1" UBYTE _CNV_A_R_LINEAR_____0_CM 1 100. 0. 255. DISPLAY_IDENTIFIER CTR_ABC_END_DIAG_PLAUS_CAM_IN_1 ECU_ADDRESS 0xd00098d9 FORMAT "%3.0" /end MEASUREMENT
/begin MEASUREMENT fmy_stat_plaus_cam_in_1.err_info_stat.lv_err_mem "storage in dynamic failure memory of the diagnosis instance PLAUS_CAM_IN_1" UWORD _CNV_S_2_RANGE__0___1_CM 1 100. 0. 1. DISPLAY_IDENTIFIER LV_ERR_MEM_PLAUS_CAM_IN_1 ECU_ADDRESS 0xd00098da BIT_MASK 0x8 /end MEASUREMENT
/begin MEASUREMENT fmy_stat_plaus_cam_in_1.err_info_stat.lv_ready "readiness status of the diagnosis instance PLAUS_CAM_IN_1" UWORD _CNV_S_2_RANGE__0___1_CM 1 100. 0. 1. DISPLAY_IDENTIFIER LV_READY_PLAUS_CAM_IN_1 ECU_ADDRESS 0xd00098da BIT_MASK 0x10 /end MEASUREMENT
/begin MEASUREMENT fmy_stat_plaus_cam_in_1.err_info_stat.lv_end_diag "end of diagnosis of the diagnosis instance PLAUS_CAM_IN_1" UWORD _CNV_S_2_RANGE__0___1_CM 1 100. 0. 1. DISPLAY_IDENTIFIER LV_END_DIAG_PLAUS_CAM_IN_1 ECU_ADDRESS 0xd00098da BIT_MASK 0x20 /end MEASUREMENT
/begin MEASUREMENT fmy_stat_plaus_cam_in_1.err_info_stat.lv_cdn_diag "diagnosis condition of the diagnosis instance PLAUS_CAM_IN_1" UWORD _CNV_S_2_RANGE__0___1_CM 1 100. 0. 1. DISPLAY_IDENTIFIER LV_CDN_DIAG_PLAUS_CAM_IN_1 ECU_ADDRESS 0xd00098da BIT_MASK 0x40 /end MEASUREMENT
/begin MEASUREMENT fmy_stat_plaus_cam_in_1.err_info_stat.err_sym "symptoms of the diagnosis instance PLAUS_CAM_IN_1" UWORD _CNV_S_16_RANGE_ERR__349_CM 1 100. 0. 15. DISPLAY_IDENTIFIER ERR_SYM_PLAUS_CAM_IN_1 ECU_ADDRESS 0xd00098da BIT_MASK 0x780 /end MEASUREMENT
/begin MEASUREMENT fmy_stat_plaus_cam_ex_1.ctr_abc "anti bounce counter for diagnosis instance PLAUS_CAM_EX_1" UBYTE _CNV_A_R_LINEAR_____0_CM 1 100. 0. 255. DISPLAY_IDENTIFIER CTR_ABC_PLAUS_CAM_EX_1 ECU_ADDRESS 0xd00098d0 FORMAT "%3.0" /end MEASUREMENT
/begin MEASUREMENT fmy_stat_plaus_cam_ex_1.ctr_end_diag "counter for end of diagnosis for diagnosis instance PLAUS_CAM_EX_1" UBYTE _CNV_A_R_LINEAR_____0_CM 1 100. 0. 255. DISPLAY_IDENTIFIER CTR_ABC_END_DIAG_PLAUS_CAM_EX_1 ECU_ADDRESS 0xd00098d1 FORMAT "%3.0" /end MEASUREMENT
/begin MEASUREMENT fmy_stat_plaus_cam_ex_1.err_info_stat.lv_err_mem "storage in dynamic failure memory of the diagnosis instance PLAUS_CAM_EX_1" UWORD _CNV_S_2_RANGE__0___1_CM 1 100. 0. 1. DISPLAY_IDENTIFIER LV_ERR_MEM_PLAUS_CAM_EX_1 ECU_ADDRESS 0xd00098d2 BIT_MASK 0x8 /end MEASUREMENT
/begin MEASUREMENT fmy_stat_plaus_cam_ex_1.err_info_stat.lv_ready "readiness status of the diagnosis instance PLAUS_CAM_EX_1" UWORD _CNV_S_2_RANGE__0___1_CM 1 100. 0. 1. DISPLAY_IDENTIFIER LV_READY_PLAUS_CAM_EX_1 ECU_ADDRESS 0xd00098d2 BIT_MASK 0x10 /end MEASUREMENT
/begin MEASUREMENT fmy_stat_plaus_cam_ex_1.err_info_stat.lv_end_diag "end of diagnosis of the diagnosis instance PLAUS_CAM_EX_1" UWORD _CNV_S_2_RANGE__0___1_CM 1 100. 0. 1. DISPLAY_IDENTIFIER LV_END_DIAG_PLAUS_CAM_EX_1 ECU_ADDRESS 0xd00098d2 BIT_MASK 0x20 /end MEASUREMENT
/begin MEASUREMENT fmy_stat_plaus_cam_ex_1.err_info_stat.lv_cdn_diag "diagnosis condition of the diagnosis instance PLAUS_CAM_EX_1" UWORD _CNV_S_2_RANGE__0___1_CM 1 100. 0. 1. DISPLAY_IDENTIFIER LV_CDN_DIAG_PLAUS_CAM_EX_1 ECU_ADDRESS 0xd00098d2 BIT_MASK 0x40 /end MEASUREMENT
/begin MEASUREMENT fmy_stat_plaus_cam_ex_1.err_info_stat.err_sym "symptoms of the diagnosis instance PLAUS_CAM_EX_1" UWORD _CNV_S_16_RANGE_ERR__349_CM 1 100. 0. 15. DISPLAY_IDENTIFIER ERR_SYM_PLAUS_CAM_EX_1 ECU_ADDRESS 0xd00098d2 BIT_MASK 0x780 /end MEASUREMENT
/begin MEASUREMENT fmy_stat_syn_crk_cam_in_1.ctr_abc "anti bounce counter for diagnosis instance SYN_CRK_CAM_IN_1" UBYTE _CNV_A_R_LINEAR_____0_CM 1 100. 0. 255. DISPLAY_IDENTIFIER CTR_ABC_SYN_CRK_CAM_IN_1 ECU_ADDRESS 0xd00099e4 FORMAT "%3.0" /end MEASUREMENT
/begin MEASUREMENT fmy_stat_syn_crk_cam_in_1.ctr_end_diag "counter for end of diagnosis for diagnosis instance SYN_CRK_CAM_IN_1" UBYTE _CNV_A_R_LINEAR_____0_CM 1 100. 0. 255. DISPLAY_IDENTIFIER CTR_ABC_END_DIAG_SYN_CRK_CAM_IN_1 ECU_ADDRESS 0xd00099e5 FORMAT "%3.0" /end MEASUREMENT
/begin MEASUREMENT fmy_stat_syn_crk_cam_in_1.err_info_stat.lv_err_mem "storage in dynamic failure memory of the diagnosis instance SYN_CRK_CAM_IN_1" UWORD _CNV_S_2_RANGE__0___1_CM 1 100. 0. 1. DISPLAY_IDENTIFIER LV_ERR_MEM_SYN_CRK_CAM_IN_1 ECU_ADDRESS 0xd00099e6 BIT_MASK 0x8 /end MEASUREMENT
/begin MEASUREMENT fmy_stat_syn_crk_cam_in_1.err_info_stat.lv_ready "readiness status of the diagnosis instance SYN_CRK_CAM_IN_1" UWORD _CNV_S_2_RANGE__0___1_CM 1 100. 0. 1. DISPLAY_IDENTIFIER LV_READY_SYN_CRK_CAM_IN_1 ECU_ADDRESS 0xd00099e6 BIT_MASK 0x10 /end MEASUREMENT
/begin MEASUREMENT fmy_stat_syn_crk_cam_in_1.err_info_stat.lv_end_diag "end of diagnosis of the diagnosis instance SYN_CRK_CAM_IN_1" UWORD _CNV_S_2_RANGE__0___1_CM 1 100. 0. 1. DISPLAY_IDENTIFIER LV_END_DIAG_SYN_CRK_CAM_IN_1 ECU_ADDRESS 0xd00099e6 BIT_MASK 0x20 /end MEASUREMENT
/begin MEASUREMENT fmy_stat_syn_crk_cam_in_1.err_info_stat.lv_cdn_diag "diagnosis condition of the diagnosis instance SYN_CRK_CAM_IN_1" UWORD _CNV_S_2_RANGE__0___1_CM 1 100. 0. 1. DISPLAY_IDENTIFIER LV_CDN_DIAG_SYN_CRK_CAM_IN_1 ECU_ADDRESS 0xd00099e6 BIT_MASK 0x40 /end MEASUREMENT
/begin MEASUREMENT fmy_stat_syn_crk_cam_in_1.err_info_stat.err_sym "symptoms of the diagnosis instance SYN_CRK_CAM_IN_1" UWORD _CNV_S_16_RANGE_ERR__349_CM 1 100. 0. 15. DISPLAY_IDENTIFIER ERR_SYM_SYN_CRK_CAM_IN_1 ECU_ADDRESS 0xd00099e6 BIT_MASK 0x780 /end MEASUREMENT
/begin MEASUREMENT fmy_stat_syn_crk_cam_ex_1.ctr_abc "anti bounce counter for diagnosis instance SYN_CRK_CAM_EX_1" UBYTE _CNV_A_R_LINEAR_____0_CM 1 100. 0. 255. DISPLAY_IDENTIFIER CTR_ABC_SYN_CRK_CAM_EX_1 ECU_ADDRESS 0xd00099dc FORMAT "%3.0" /end MEASUREMENT
/begin MEASUREMENT fmy_stat_syn_crk_cam_ex_1.ctr_end_diag "counter for end of diagnosis for diagnosis instance SYN_CRK_CAM_EX_1" UBYTE _CNV_A_R_LINEAR_____0_CM 1 100. 0. 255. DISPLAY_IDENTIFIER CTR_ABC_END_DIAG_SYN_CRK_CAM_EX_1 ECU_ADDRESS 0xd00099dd FORMAT "%3.0" /end MEASUREMENT
/begin MEASUREMENT fmy_stat_syn_crk_cam_ex_1.err_info_stat.lv_err_mem "storage in dynamic failure memory of the diagnosis instance SYN_CRK_CAM_EX_1" UWORD _CNV_S_2_RANGE__0___1_CM 1 100. 0. 1. DISPLAY_IDENTIFIER LV_ERR_MEM_SYN_CRK_CAM_EX_1 ECU_ADDRESS 0xd00099de BIT_MASK 0x8 /end MEASUREMENT
/begin MEASUREMENT fmy_stat_syn_crk_cam_ex_1.err_info_stat.lv_ready "readiness status of the diagnosis instance SYN_CRK_CAM_EX_1" UWORD _CNV_S_2_RANGE__0___1_CM 1 100. 0. 1. DISPLAY_IDENTIFIER LV_READY_SYN_CRK_CAM_EX_1 ECU_ADDRESS 0xd00099de BIT_MASK 0x10 /end MEASUREMENT
/begin MEASUREMENT fmy_stat_syn_crk_cam_ex_1.err_info_stat.lv_end_diag "end of diagnosis of the diagnosis instance SYN_CRK_CAM_EX_1" UWORD _CNV_S_2_RANGE__0___1_CM 1 100. 0. 1. DISPLAY_IDENTIFIER LV_END_DIAG_SYN_CRK_CAM_EX_1 ECU_ADDRESS 0xd00099de BIT_MASK 0x20 /end MEASUREMENT
/begin MEASUREMENT fmy_stat_syn_crk_cam_ex_1.err_info_stat.lv_cdn_diag "diagnosis condition of the diagnosis instance SYN_CRK_CAM_EX_1" UWORD _CNV_S_2_RANGE__0___1_CM 1 100. 0. 1. DISPLAY_IDENTIFIER LV_CDN_DIAG_SYN_CRK_CAM_EX_1 ECU_ADDRESS 0xd00099de BIT_MASK 0x40 /end MEASUREMENT
/begin MEASUREMENT fmy_stat_syn_crk_cam_ex_1.err_info_stat.err_sym "symptoms of the diagnosis instance SYN_CRK_CAM_EX_1" UWORD _CNV_S_16_RANGE_ERR__349_CM 1 100. 0. 15. DISPLAY_IDENTIFIER ERR_SYM_SYN_CRK_CAM_EX_1 ECU_ADDRESS 0xd00099de BIT_MASK 0x780 /end MEASUREMENT
/begin MEASUREMENT fmy_stat_tooth_off_in_1.ctr_abc "anti bounce counter for diagnosis instance TOOTH_OFF_IN_1" UBYTE _CNV_A_R_LINEAR_____0_CM 1 100. 0. 255. DISPLAY_IDENTIFIER CTR_ABC_TOOTH_OFF_IN_1 ECU_ADDRESS 0xd0009a60 FORMAT "%3.0" /end MEASUREMENT
/begin MEASUREMENT fmy_stat_tooth_off_in_1.ctr_end_diag "counter for end of diagnosis for diagnosis instance TOOTH_OFF_IN_1" UBYTE _CNV_A_R_LINEAR_____0_CM 1 100. 0. 255. DISPLAY_IDENTIFIER CTR_ABC_END_DIAG_TOOTH_OFF_IN_1 ECU_ADDRESS 0xd0009a61 FORMAT "%3.0" /end MEASUREMENT
/begin MEASUREMENT fmy_stat_tooth_off_in_1.err_info_stat.lv_err_mem "storage in dynamic failure memory of the diagnosis instance TOOTH_OFF_IN_1" UWORD _CNV_S_2_RANGE__0___1_CM 1 100. 0. 1. DISPLAY_IDENTIFIER LV_ERR_MEM_TOOTH_OFF_IN_1 ECU_ADDRESS 0xd0009a62 BIT_MASK 0x8 /end MEASUREMENT
/begin MEASUREMENT fmy_stat_tooth_off_in_1.err_info_stat.lv_ready "readiness status of the diagnosis instance TOOTH_OFF_IN_1" UWORD _CNV_S_2_RANGE__0___1_CM 1 100. 0. 1. DISPLAY_IDENTIFIER LV_READY_TOOTH_OFF_IN_1 ECU_ADDRESS 0xd0009a62 BIT_MASK 0x10 /end MEASUREMENT
/begin MEASUREMENT fmy_stat_tooth_off_in_1.err_info_stat.lv_end_diag "end of diagnosis of the diagnosis instance TOOTH_OFF_IN_1" UWORD _CNV_S_2_RANGE__0___1_CM 1 100. 0. 1. DISPLAY_IDENTIFIER LV_END_DIAG_TOOTH_OFF_IN_1 ECU_ADDRESS 0xd0009a62 BIT_MASK 0x20 /end MEASUREMENT
/begin MEASUREMENT fmy_stat_tooth_off_in_1.err_info_stat.lv_cdn_diag "diagnosis condition of the diagnosis instance TOOTH_OFF_IN_1" UWORD _CNV_S_2_RANGE__0___1_CM 1 100. 0. 1. DISPLAY_IDENTIFIER LV_CDN_DIAG_TOOTH_OFF_IN_1 ECU_ADDRESS 0xd0009a62 BIT_MASK 0x40 /end MEASUREMENT
/begin MEASUREMENT fmy_stat_tooth_off_in_1.err_info_stat.err_sym "symptoms of the diagnosis instance TOOTH_OFF_IN_1" UWORD _CNV_S_16_RANGE_ERR__349_CM 1 100. 0. 15. DISPLAY_IDENTIFIER ERR_SYM_TOOTH_OFF_IN_1 ECU_ADDRESS 0xd0009a62 BIT_MASK 0x780 /end MEASUREMENT
/begin MEASUREMENT fmy_stat_tooth_off_ex_1.ctr_abc "anti bounce counter for diagnosis instance TOOTH_OFF_EX_1" UBYTE _CNV_A_R_LINEAR_____0_CM 1 100. 0. 255. DISPLAY_IDENTIFIER CTR_ABC_TOOTH_OFF_EX_1 ECU_ADDRESS 0xd0009a58 FORMAT "%3.0" /end MEASUREMENT
/begin MEASUREMENT fmy_stat_tooth_off_ex_1.ctr_end_diag "counter for end of diagnosis for diagnosis instance TOOTH_OFF_EX_1" UBYTE _CNV_A_R_LINEAR_____0_CM 1 100. 0. 255. DISPLAY_IDENTIFIER CTR_ABC_END_DIAG_TOOTH_OFF_EX_1 ECU_ADDRESS 0xd0009a59 FORMAT "%3.0" /end MEASUREMENT
/begin MEASUREMENT fmy_stat_tooth_off_ex_1.err_info_stat.lv_err_mem "storage in dynamic failure memory of the diagnosis instance TOOTH_OFF_EX_1" UWORD _CNV_S_2_RANGE__0___1_CM 1 100. 0. 1. DISPLAY_IDENTIFIER LV_ERR_MEM_TOOTH_OFF_EX_1 ECU_ADDRESS 0xd0009a5a BIT_MASK 0x8 /end MEASUREMENT
/begin MEASUREMENT fmy_stat_tooth_off_ex_1.err_info_stat.lv_ready "readiness status of the diagnosis instance TOOTH_OFF_EX_1" UWORD _CNV_S_2_RANGE__0___1_CM 1 100. 0. 1. DISPLAY_IDENTIFIER LV_READY_TOOTH_OFF_EX_1 ECU_ADDRESS 0xd0009a5a BIT_MASK 0x10 /end MEASUREMENT
/begin MEASUREMENT fmy_stat_tooth_off_ex_1.err_info_stat.lv_end_diag "end of diagnosis of the diagnosis instance TOOTH_OFF_EX_1" UWORD _CNV_S_2_RANGE__0___1_CM 1 100. 0. 1. DISPLAY_IDENTIFIER LV_END_DIAG_TOOTH_OFF_EX_1 ECU_ADDRESS 0xd0009a5a BIT_MASK 0x20 /end MEASUREMENT
/begin MEASUREMENT fmy_stat_tooth_off_ex_1.err_info_stat.lv_cdn_diag "diagnosis condition of the diagnosis instance TOOTH_OFF_EX_1" UWORD _CNV_S_2_RANGE__0___1_CM 1 100. 0. 1. DISPLAY_IDENTIFIER LV_CDN_DIAG_TOOTH_OFF_EX_1 ECU_ADDRESS 0xd0009a5a BIT_MASK 0x40 /end MEASUREMENT
/begin MEASUREMENT fmy_stat_tooth_off_ex_1.err_info_stat.err_sym "symptoms of the diagnosis instance TOOTH_OFF_EX_1" UWORD _CNV_S_16_RANGE_ERR__349_CM 1 100. 0. 15. DISPLAY_IDENTIFIER ERR_SYM_TOOTH_OFF_EX_1 ECU_ADDRESS 0xd0009a5a BIT_MASK 0x780 /end MEASUREMENT
/begin MEASUREMENT fmy_stat_plaus_cam_in_2.ctr_abc "anti bounce counter for diagnosis instance PLAUS_CAM_IN_2" UBYTE _CNV_A_R_LINEAR_____0_CM 1 100. 0. 255. DISPLAY_IDENTIFIER CTR_ABC_PLAUS_CAM_IN_2 ECU_ADDRESS 0xd00098dc FORMAT "%3.0" /end MEASUREMENT
/begin MEASUREMENT fmy_stat_plaus_cam_in_2.ctr_end_diag "counter for end of diagnosis for diagnosis instance PLAUS_CAM_IN_2" UBYTE _CNV_A_R_LINEAR_____0_CM 1 100. 0. 255. DISPLAY_IDENTIFIER CTR_ABC_END_DIAG_PLAUS_CAM_IN_2 ECU_ADDRESS 0xd00098dd FORMAT "%3.0" /end MEASUREMENT
/begin MEASUREMENT fmy_stat_plaus_cam_in_2.err_info_stat.lv_err_mem "storage in dynamic failure memory of the diagnosis instance PLAUS_CAM_IN_2" UWORD _CNV_S_2_RANGE__0___1_CM 1 100. 0. 1. DISPLAY_IDENTIFIER LV_ERR_MEM_PLAUS_CAM_IN_2 ECU_ADDRESS 0xd00098de BIT_MASK 0x8 /end MEASUREMENT
/begin MEASUREMENT fmy_stat_plaus_cam_in_2.err_info_stat.lv_ready "readiness status of the diagnosis instance PLAUS_CAM_IN_2" UWORD _CNV_S_2_RANGE__0___1_CM 1 100. 0. 1. DISPLAY_IDENTIFIER LV_READY_PLAUS_CAM_IN_2 ECU_ADDRESS 0xd00098de BIT_MASK 0x10 /end MEASUREMENT
/begin MEASUREMENT fmy_stat_plaus_cam_in_2.err_info_stat.lv_end_diag "end of diagnosis of the diagnosis instance PLAUS_CAM_IN_2" UWORD _CNV_S_2_RANGE__0___1_CM 1 100. 0. 1. DISPLAY_IDENTIFIER LV_END_DIAG_PLAUS_CAM_IN_2 ECU_ADDRESS 0xd00098de BIT_MASK 0x20 /end MEASUREMENT
/begin MEASUREMENT fmy_stat_plaus_cam_in_2.err_info_stat.lv_cdn_diag "diagnosis condition of the diagnosis instance PLAUS_CAM_IN_2" UWORD _CNV_S_2_RANGE__0___1_CM 1 100. 0. 1. DISPLAY_IDENTIFIER LV_CDN_DIAG_PLAUS_CAM_IN_2 ECU_ADDRESS 0xd00098de BIT_MASK 0x40 /end MEASUREMENT
/begin MEASUREMENT fmy_stat_plaus_cam_in_2.err_info_stat.err_sym "symptoms of the diagnosis instance PLAUS_CAM_IN_2" UWORD _CNV_S_16_RANGE_ERR__349_CM 1 100. 0. 15. DISPLAY_IDENTIFIER ERR_SYM_PLAUS_CAM_IN_2 ECU_ADDRESS 0xd00098de BIT_MASK 0x780 /end MEASUREMENT
/begin MEASUREMENT fmy_stat_plaus_cam_ex_2.ctr_abc "anti bounce counter for diagnosis instance PLAUS_CAM_EX_2" UBYTE _CNV_A_R_LINEAR_____0_CM 1 100. 0. 255. DISPLAY_IDENTIFIER CTR_ABC_PLAUS_CAM_EX_2 ECU_ADDRESS 0xd00098d4 FORMAT "%3.0" /end MEASUREMENT
/begin MEASUREMENT fmy_stat_plaus_cam_ex_2.ctr_end_diag "counter for end of diagnosis for diagnosis instance PLAUS_CAM_EX_2" UBYTE _CNV_A_R_LINEAR_____0_CM 1 100. 0. 255. DISPLAY_IDENTIFIER CTR_ABC_END_DIAG_PLAUS_CAM_EX_2 ECU_ADDRESS 0xd00098d5 FORMAT "%3.0" /end MEASUREMENT
/begin MEASUREMENT fmy_stat_plaus_cam_ex_2.err_info_stat.lv_err_mem "storage in dynamic failure memory of the diagnosis instance PLAUS_CAM_EX_2" UWORD _CNV_S_2_RANGE__0___1_CM 1 100. 0. 1. DISPLAY_IDENTIFIER LV_ERR_MEM_PLAUS_CAM_EX_2 ECU_ADDRESS 0xd00098d6 BIT_MASK 0x8 /end MEASUREMENT
/begin MEASUREMENT fmy_stat_plaus_cam_ex_2.err_info_stat.lv_ready "readiness status of the diagnosis instance PLAUS_CAM_EX_2" UWORD _CNV_S_2_RANGE__0___1_CM 1 100. 0. 1. DISPLAY_IDENTIFIER LV_READY_PLAUS_CAM_EX_2 ECU_ADDRESS 0xd00098d6 BIT_MASK 0x10 /end MEASUREMENT
/begin MEASUREMENT fmy_stat_plaus_cam_ex_2.err_info_stat.lv_end_diag "end of diagnosis of the diagnosis instance PLAUS_CAM_EX_2" UWORD _CNV_S_2_RANGE__0___1_CM 1 100. 0. 1. DISPLAY_IDENTIFIER LV_END_DIAG_PLAUS_CAM_EX_2 ECU_ADDRESS 0xd00098d6 BIT_MASK 0x20 /end MEASUREMENT
/begin MEASUREMENT fmy_stat_plaus_cam_ex_2.err_info_stat.lv_cdn_diag "diagnosis condition of the diagnosis instance PLAUS_CAM_EX_2" UWORD _CNV_S_2_RANGE__0___1_CM 1 100. 0. 1. DISPLAY_IDENTIFIER LV_CDN_DIAG_PLAUS_CAM_EX_2 ECU_ADDRESS 0xd00098d6 BIT_MASK 0x40 /end MEASUREMENT
/begin MEASUREMENT fmy_stat_plaus_cam_ex_2.err_info_stat.err_sym "symptoms of the diagnosis instance PLAUS_CAM_EX_2" UWORD _CNV_S_16_RANGE_ERR__349_CM 1 100. 0. 15. DISPLAY_IDENTIFIER ERR_SYM_PLAUS_CAM_EX_2 ECU_ADDRESS 0xd00098d6 BIT_MASK 0x780 /end MEASUREMENT
/begin MEASUREMENT fmy_stat_syn_crk_cam_in_2.ctr_abc "anti bounce counter for diagnosis instance SYN_CRK_CAM_IN_2" UBYTE _CNV_A_R_LINEAR_____0_CM 1 100. 0. 255. DISPLAY_IDENTIFIER CTR_ABC_SYN_CRK_CAM_IN_2 ECU_ADDRESS 0xd00099e8 FORMAT "%3.0" /end MEASUREMENT
/begin MEASUREMENT fmy_stat_syn_crk_cam_in_2.ctr_end_diag "counter for end of diagnosis for diagnosis instance SYN_CRK_CAM_IN_2" UBYTE _CNV_A_R_LINEAR_____0_CM 1 100. 0. 255. DISPLAY_IDENTIFIER CTR_ABC_END_DIAG_SYN_CRK_CAM_IN_2 ECU_ADDRESS 0xd00099e9 FORMAT "%3.0" /end MEASUREMENT
/begin MEASUREMENT fmy_stat_syn_crk_cam_in_2.err_info_stat.lv_err_mem "storage in dynamic failure memory of the diagnosis instance SYN_CRK_CAM_IN_2" UWORD _CNV_S_2_RANGE__0___1_CM 1 100. 0. 1. DISPLAY_IDENTIFIER LV_ERR_MEM_SYN_CRK_CAM_IN_2 ECU_ADDRESS 0xd00099ea BIT_MASK 0x8 /end MEASUREMENT
/begin MEASUREMENT fmy_stat_syn_crk_cam_in_2.err_info_stat.lv_ready "readiness status of the diagnosis instance SYN_CRK_CAM_IN_2" UWORD _CNV_S_2_RANGE__0___1_CM 1 100. 0. 1. DISPLAY_IDENTIFIER LV_READY_SYN_CRK_CAM_IN_2 ECU_ADDRESS 0xd00099ea BIT_MASK 0x10 /end MEASUREMENT
/begin MEASUREMENT fmy_stat_syn_crk_cam_in_2.err_info_stat.lv_end_diag "end of diagnosis of the diagnosis instance SYN_CRK_CAM_IN_2" UWORD _CNV_S_2_RANGE__0___1_CM 1 100. 0. 1. DISPLAY_IDENTIFIER LV_END_DIAG_SYN_CRK_CAM_IN_2 ECU_ADDRESS 0xd00099ea BIT_MASK 0x20 /end MEASUREMENT
/begin MEASUREMENT fmy_stat_syn_crk_cam_in_2.err_info_stat.lv_cdn_diag "diagnosis condition of the diagnosis instance SYN_CRK_CAM_IN_2" UWORD _CNV_S_2_RANGE__0___1_CM 1 100. 0. 1. DISPLAY_IDENTIFIER LV_CDN_DIAG_SYN_CRK_CAM_IN_2 ECU_ADDRESS 0xd00099ea BIT_MASK 0x40 /end MEASUREMENT
/begin MEASUREMENT fmy_stat_syn_crk_cam_in_2.err_info_stat.err_sym "symptoms of the diagnosis instance SYN_CRK_CAM_IN_2" UWORD _CNV_S_16_RANGE_ERR__349_CM 1 100. 0. 15. DISPLAY_IDENTIFIER ERR_SYM_SYN_CRK_CAM_IN_2 ECU_ADDRESS 0xd00099ea BIT_MASK 0x780 /end MEASUREMENT
/begin MEASUREMENT fmy_stat_syn_crk_cam_ex_2.ctr_abc "anti bounce counter for diagnosis instance SYN_CRK_CAM_EX_2" UBYTE _CNV_A_R_LINEAR_____0_CM 1 100. 0. 255. DISPLAY_IDENTIFIER CTR_ABC_SYN_CRK_CAM_EX_2 ECU_ADDRESS 0xd00099e0 FORMAT "%3.0" /end MEASUREMENT
/begin MEASUREMENT fmy_stat_syn_crk_cam_ex_2.ctr_end_diag "counter for end of diagnosis for diagnosis instance SYN_CRK_CAM_EX_2" UBYTE _CNV_A_R_LINEAR_____0_CM 1 100. 0. 255. DISPLAY_IDENTIFIER CTR_ABC_END_DIAG_SYN_CRK_CAM_EX_2 ECU_ADDRESS 0xd00099e1 FORMAT "%3.0" /end MEASUREMENT
/begin MEASUREMENT fmy_stat_syn_crk_cam_ex_2.err_info_stat.lv_err_mem "storage in dynamic failure memory of the diagnosis instance SYN_CRK_CAM_EX_2" UWORD _CNV_S_2_RANGE__0___1_CM 1 100. 0. 1. DISPLAY_IDENTIFIER LV_ERR_MEM_SYN_CRK_CAM_EX_2 ECU_ADDRESS 0xd00099e2 BIT_MASK 0x8 /end MEASUREMENT
/begin MEASUREMENT fmy_stat_syn_crk_cam_ex_2.err_info_stat.lv_ready "readiness status of the diagnosis instance SYN_CRK_CAM_EX_2" UWORD _CNV_S_2_RANGE__0___1_CM 1 100. 0. 1. DISPLAY_IDENTIFIER LV_READY_SYN_CRK_CAM_EX_2 ECU_ADDRESS 0xd00099e2 BIT_MASK 0x10 /end MEASUREMENT
/begin MEASUREMENT fmy_stat_syn_crk_cam_ex_2.err_info_stat.lv_end_diag "end of diagnosis of the diagnosis instance SYN_CRK_CAM_EX_2" UWORD _CNV_S_2_RANGE__0___1_CM 1 100. 0. 1. DISPLAY_IDENTIFIER LV_END_DIAG_SYN_CRK_CAM_EX_2 ECU_ADDRESS 0xd00099e2 BIT_MASK 0x20 /end MEASUREMENT
/begin MEASUREMENT fmy_stat_syn_crk_cam_ex_2.err_info_stat.lv_cdn_diag "diagnosis condition of the diagnosis instance SYN_CRK_CAM_EX_2" UWORD _CNV_S_2_RANGE__0___1_CM 1 100. 0. 1. DISPLAY_IDENTIFIER LV_CDN_DIAG_SYN_CRK_CAM_EX_2 ECU_ADDRESS 0xd00099e2 BIT_MASK 0x40 /end MEASUREMENT
/begin MEASUREMENT fmy_stat_syn_crk_cam_ex_2.err_info_stat.err_sym "symptoms of the diagnosis instance SYN_CRK_CAM_EX_2" UWORD _CNV_S_16_RANGE_ERR__349_CM 1 100. 0. 15. DISPLAY_IDENTIFIER ERR_SYM_SYN_CRK_CAM_EX_2 ECU_ADDRESS 0xd00099e2 BIT_MASK 0x780 /end MEASUREMENT
/begin MEASUREMENT fmy_stat_tooth_off_in_2.ctr_abc "anti bounce counter for diagnosis instance TOOTH_OFF_IN_2" UBYTE _CNV_A_R_LINEAR_____0_CM 1 100. 0. 255. DISPLAY_IDENTIFIER CTR_ABC_TOOTH_OFF_IN_2 ECU_ADDRESS 0xd0009a64 FORMAT "%3.0" /end MEASUREMENT
/begin MEASUREMENT fmy_stat_tooth_off_in_2.ctr_end_diag "counter for end of diagnosis for diagnosis instance TOOTH_OFF_IN_2" UBYTE _CNV_A_R_LINEAR_____0_CM 1 100. 0. 255. DISPLAY_IDENTIFIER CTR_ABC_END_DIAG_TOOTH_OFF_IN_2 ECU_ADDRESS 0xd0009a65 FORMAT "%3.0" /end MEASUREMENT
/begin MEASUREMENT fmy_stat_tooth_off_in_2.err_info_stat.lv_err_mem "storage in dynamic failure memory of the diagnosis instance TOOTH_OFF_IN_2" UWORD _CNV_S_2_RANGE__0___1_CM 1 100. 0. 1. DISPLAY_IDENTIFIER LV_ERR_MEM_TOOTH_OFF_IN_2 ECU_ADDRESS 0xd0009a66 BIT_MASK 0x8 /end MEASUREMENT
/begin MEASUREMENT fmy_stat_tooth_off_in_2.err_info_stat.lv_ready "readiness status of the diagnosis instance TOOTH_OFF_IN_2" UWORD _CNV_S_2_RANGE__0___1_CM 1 100. 0. 1. DISPLAY_IDENTIFIER LV_READY_TOOTH_OFF_IN_2 ECU_ADDRESS 0xd0009a66 BIT_MASK 0x10 /end MEASUREMENT
/begin MEASUREMENT fmy_stat_tooth_off_in_2.err_info_stat.lv_end_diag "end of diagnosis of the diagnosis instance TOOTH_OFF_IN_2" UWORD _CNV_S_2_RANGE__0___1_CM 1 100. 0. 1. DISPLAY_IDENTIFIER LV_END_DIAG_TOOTH_OFF_IN_2 ECU_ADDRESS 0xd0009a66 BIT_MASK 0x20 /end MEASUREMENT
/begin MEASUREMENT fmy_stat_tooth_off_in_2.err_info_stat.lv_cdn_diag "diagnosis condition of the diagnosis instance TOOTH_OFF_IN_2" UWORD _CNV_S_2_RANGE__0___1_CM 1 100. 0. 1. DISPLAY_IDENTIFIER LV_CDN_DIAG_TOOTH_OFF_IN_2 ECU_ADDRESS 0xd0009a66 BIT_MASK 0x40 /end MEASUREMENT
/begin MEASUREMENT fmy_stat_tooth_off_in_2.err_info_stat.err_sym "symptoms of the diagnosis instance TOOTH_OFF_IN_2" UWORD _CNV_S_16_RANGE_ERR__349_CM 1 100. 0. 15. DISPLAY_IDENTIFIER ERR_SYM_TOOTH_OFF_IN_2 ECU_ADDRESS 0xd0009a66 BIT_MASK 0x780 /end MEASUREMENT
/begin MEASUREMENT fmy_stat_tooth_off_ex_2.ctr_abc "anti bounce counter for diagnosis instance TOOTH_OFF_EX_2" UBYTE _CNV_A_R_LINEAR_____0_CM 1 100. 0. 255. DISPLAY_IDENTIFIER CTR_ABC_TOOTH_OFF_EX_2 ECU_ADDRESS 0xd0009a5c FORMAT "%3.0" /end MEASUREMENT
/begin MEASUREMENT fmy_stat_tooth_off_ex_2.ctr_end_diag "counter for end of diagnosis for diagnosis instance TOOTH_OFF_EX_2" UBYTE _CNV_A_R_LINEAR_____0_CM 1 100. 0. 255. DISPLAY_IDENTIFIER CTR_ABC_END_DIAG_TOOTH_OFF_EX_2 ECU_ADDRESS 0xd0009a5d FORMAT "%3.0" /end MEASUREMENT
/begin MEASUREMENT fmy_stat_tooth_off_ex_2.err_info_stat.lv_err_mem "storage in dynamic failure memory of the diagnosis instance TOOTH_OFF_EX_2" UWORD _CNV_S_2_RANGE__0___1_CM 1 100. 0. 1. DISPLAY_IDENTIFIER LV_ERR_MEM_TOOTH_OFF_EX_2 ECU_ADDRESS 0xd0009a5e BIT_MASK 0x8 /end MEASUREMENT
/begin MEASUREMENT fmy_stat_tooth_off_ex_2.err_info_stat.lv_ready "readiness status of the diagnosis instance TOOTH_OFF_EX_2" UWORD _CNV_S_2_RANGE__0___1_CM 1 100. 0. 1. DISPLAY_IDENTIFIER LV_READY_TOOTH_OFF_EX_2 ECU_ADDRESS 0xd0009a5e BIT_MASK 0x10 /end MEASUREMENT
/begin MEASUREMENT fmy_stat_tooth_off_ex_2.err_info_stat.lv_end_diag "end of diagnosis of the diagnosis instance TOOTH_OFF_EX_2" UWORD _CNV_S_2_RANGE__0___1_CM 1 100. 0. 1. DISPLAY_IDENTIFIER LV_END_DIAG_TOOTH_OFF_EX_2 ECU_ADDRESS 0xd0009a5e BIT_MASK 0x20 /end MEASUREMENT
/begin MEASUREMENT fmy_stat_tooth_off_ex_2.err_info_stat.lv_cdn_diag "diagnosis condition of the diagnosis instance TOOTH_OFF_EX_2" UWORD _CNV_S_2_RANGE__0___1_CM 1 100. 0. 1. DISPLAY_IDENTIFIER LV_CDN_DIAG_TOOTH_OFF_EX_2 ECU_ADDRESS 0xd0009a5e BIT_MASK 0x40 /end MEASUREMENT
/begin MEASUREMENT fmy_stat_tooth_off_ex_2.err_info_stat.err_sym "symptoms of the diagnosis instance TOOTH_OFF_EX_2" UWORD _CNV_S_16_RANGE_ERR__349_CM 1 100. 0. 15. DISPLAY_IDENTIFIER ERR_SYM_TOOTH_OFF_EX_2 ECU_ADDRESS 0xd0009a5e BIT_MASK 0x780 /end MEASUREMENT
/begin MEASUREMENT fmy_stat_can_boff.ctr_abc "anti bounce counter for diagnosis instance CAN_BOFF" UBYTE _CNV_A_R_LINEAR_____0_CM 1 100. 0. 255. DISPLAY_IDENTIFIER CTR_ABC_CAN_BOFF ECU_ADDRESS 0xd0009480 FORMAT "%3.0" /end MEASUREMENT
/begin MEASUREMENT fmy_stat_can_boff.ctr_end_diag "counter for end of diagnosis for diagnosis instance CAN_BOFF" UBYTE _CNV_A_R_LINEAR_____0_CM 1 100. 0. 255. DISPLAY_IDENTIFIER CTR_ABC_END_DIAG_CAN_BOFF ECU_ADDRESS 0xd0009481 FORMAT "%3.0" /end MEASUREMENT
/begin MEASUREMENT fmy_stat_can_boff.err_info_stat.lv_err_mem "storage in dynamic failure memory of the diagnosis instance CAN_BOFF" UWORD _CNV_S_2_RANGE__0___1_CM 1 100. 0. 1. DISPLAY_IDENTIFIER LV_ERR_MEM_CAN_BOFF ECU_ADDRESS 0xd0009482 BIT_MASK 0x8 /end MEASUREMENT
/begin MEASUREMENT fmy_stat_can_boff.err_info_stat.lv_ready "readiness status of the diagnosis instance CAN_BOFF" UWORD _CNV_S_2_RANGE__0___1_CM 1 100. 0. 1. DISPLAY_IDENTIFIER LV_READY_CAN_BOFF ECU_ADDRESS 0xd0009482 BIT_MASK 0x10 /end MEASUREMENT
/begin MEASUREMENT fmy_stat_can_boff.err_info_stat.lv_end_diag "end of diagnosis of the diagnosis instance CAN_BOFF" UWORD _CNV_S_2_RANGE__0___1_CM 1 100. 0. 1. DISPLAY_IDENTIFIER LV_END_DIAG_CAN_BOFF ECU_ADDRESS 0xd0009482 BIT_MASK 0x20 /end MEASUREMENT
/begin MEASUREMENT fmy_stat_can_boff.err_info_stat.lv_cdn_diag "diagnosis condition of the diagnosis instance CAN_BOFF" UWORD _CNV_S_2_RANGE__0___1_CM 1 100. 0. 1. DISPLAY_IDENTIFIER LV_CDN_DIAG_CAN_BOFF ECU_ADDRESS 0xd0009482 BIT_MASK 0x40 /end MEASUREMENT
/begin MEASUREMENT fmy_stat_can_boff.err_info_stat.err_sym "symptoms of the diagnosis instance CAN_BOFF" UWORD _CNV_S_16_RANGE_ERR__349_CM 1 100. 0. 15. DISPLAY_IDENTIFIER ERR_SYM_CAN_BOFF ECU_ADDRESS 0xd0009482 BIT_MASK 0x780 /end MEASUREMENT
/begin MEASUREMENT fmy_stat_rly_main.ctr_abc "anti bounce counter for diagnosis instance RLY_MAIN" UBYTE _CNV_A_R_LINEAR_____0_CM 1 100. 0. 255. DISPLAY_IDENTIFIER CTR_ABC_RLY_MAIN ECU_ADDRESS 0xd0009950 FORMAT "%3.0" /end MEASUREMENT
/begin MEASUREMENT fmy_stat_rly_main.ctr_end_diag "counter for end of diagnosis for diagnosis instance RLY_MAIN" UBYTE _CNV_A_R_LINEAR_____0_CM 1 100. 0. 255. DISPLAY_IDENTIFIER CTR_ABC_END_DIAG_RLY_MAIN ECU_ADDRESS 0xd0009951 FORMAT "%3.0" /end MEASUREMENT
/begin MEASUREMENT fmy_stat_rly_main.err_info_stat.lv_err_mem "storage in dynamic failure memory of the diagnosis instance RLY_MAIN" UWORD _CNV_S_2_RANGE__0___1_CM 1 100. 0. 1. DISPLAY_IDENTIFIER LV_ERR_MEM_RLY_MAIN ECU_ADDRESS 0xd0009952 BIT_MASK 0x8 /end MEASUREMENT
/begin MEASUREMENT fmy_stat_rly_main.err_info_stat.lv_ready "readiness status of the diagnosis instance RLY_MAIN" UWORD _CNV_S_2_RANGE__0___1_CM 1 100. 0. 1. DISPLAY_IDENTIFIER LV_READY_RLY_MAIN ECU_ADDRESS 0xd0009952 BIT_MASK 0x10 /end MEASUREMENT
/begin MEASUREMENT fmy_stat_rly_main.err_info_stat.lv_end_diag "end of diagnosis of the diagnosis instance RLY_MAIN" UWORD _CNV_S_2_RANGE__0___1_CM 1 100. 0. 1. DISPLAY_IDENTIFIER LV_END_DIAG_RLY_MAIN ECU_ADDRESS 0xd0009952 BIT_MASK 0x20 /end MEASUREMENT
/begin MEASUREMENT fmy_stat_rly_main.err_info_stat.lv_cdn_diag "diagnosis condition of the diagnosis instance RLY_MAIN" UWORD _CNV_S_2_RANGE__0___1_CM 1 100. 0. 1. DISPLAY_IDENTIFIER LV_CDN_DIAG_RLY_MAIN ECU_ADDRESS 0xd0009952 BIT_MASK 0x40 /end MEASUREMENT
/begin MEASUREMENT fmy_stat_rly_main.err_info_stat.err_sym "symptoms of the diagnosis instance RLY_MAIN" UWORD _CNV_S_16_RANGE_ERR__349_CM 1 100. 0. 15. DISPLAY_IDENTIFIER ERR_SYM_RLY_MAIN ECU_ADDRESS 0xd0009952 BIT_MASK 0x780 /end MEASUREMENT
/begin MEASUREMENT fmy_stat_rly_main_dly.ctr_abc "anti bounce counter for diagnosis instance RLY_MAIN_DLY" UBYTE _CNV_A_R_LINEAR_____0_CM 1 100. 0. 255. DISPLAY_IDENTIFIER CTR_ABC_RLY_MAIN_DLY ECU_ADDRESS 0xd0009954 FORMAT "%3.0" /end MEASUREMENT
/begin MEASUREMENT fmy_stat_rly_main_dly.ctr_end_diag "counter for end of diagnosis for diagnosis instance RLY_MAIN_DLY" UBYTE _CNV_A_R_LINEAR_____0_CM 1 100. 0. 255. DISPLAY_IDENTIFIER CTR_ABC_END_DIAG_RLY_MAIN_DLY ECU_ADDRESS 0xd0009955 FORMAT "%3.0" /end MEASUREMENT
/begin MEASUREMENT fmy_stat_rly_main_dly.err_info_stat.lv_err_mem "storage in dynamic failure memory of the diagnosis instance RLY_MAIN_DLY" UWORD _CNV_S_2_RANGE__0___1_CM 1 100. 0. 1. DISPLAY_IDENTIFIER LV_ERR_MEM_RLY_MAIN_DLY ECU_ADDRESS 0xd0009956 BIT_MASK 0x8 /end MEASUREMENT
/begin MEASUREMENT fmy_stat_rly_main_dly.err_info_stat.lv_ready "readiness status of the diagnosis instance RLY_MAIN_DLY" UWORD _CNV_S_2_RANGE__0___1_CM 1 100. 0. 1. DISPLAY_IDENTIFIER LV_READY_RLY_MAIN_DLY ECU_ADDRESS 0xd0009956 BIT_MASK 0x10 /end MEASUREMENT
/begin MEASUREMENT fmy_stat_rly_main_dly.err_info_stat.lv_end_diag "end of diagnosis of the diagnosis instance RLY_MAIN_DLY" UWORD _CNV_S_2_RANGE__0___1_CM 1 100. 0. 1. DISPLAY_IDENTIFIER LV_END_DIAG_RLY_MAIN_DLY ECU_ADDRESS 0xd0009956 BIT_MASK 0x20 /end MEASUREMENT
/begin MEASUREMENT fmy_stat_rly_main_dly.err_info_stat.lv_cdn_diag "diagnosis condition of the diagnosis instance RLY_MAIN_DLY" UWORD _CNV_S_2_RANGE__0___1_CM 1 100. 0. 1. DISPLAY_IDENTIFIER LV_CDN_DIAG_RLY_MAIN_DLY ECU_ADDRESS 0xd0009956 BIT_MASK 0x40 /end MEASUREMENT
/begin MEASUREMENT fmy_stat_rly_main_dly.err_info_stat.err_sym "symptoms of the diagnosis instance RLY_MAIN_DLY" UWORD _CNV_S_16_RANGE_ERR__349_CM 1 100. 0. 15. DISPLAY_IDENTIFIER ERR_SYM_RLY_MAIN_DLY ECU_ADDRESS 0xd0009956 BIT_MASK 0x780 /end MEASUREMENT
/begin MEASUREMENT fmy_stat_rly_accout.ctr_abc "anti bounce counter for diagnosis instance RLY_ACCOUT" UBYTE _CNV_A_R_LINEAR_____0_CM 1 100. 0. 255. DISPLAY_IDENTIFIER CTR_ABC_RLY_ACCOUT ECU_ADDRESS 0xd0009948 FORMAT "%3.0" /end MEASUREMENT
/begin MEASUREMENT fmy_stat_rly_accout.ctr_end_diag "counter for end of diagnosis for diagnosis instance RLY_ACCOUT" UBYTE _CNV_A_R_LINEAR_____0_CM 1 100. 0. 255. DISPLAY_IDENTIFIER CTR_ABC_END_DIAG_RLY_ACCOUT ECU_ADDRESS 0xd0009949 FORMAT "%3.0" /end MEASUREMENT
/begin MEASUREMENT fmy_stat_rly_accout.err_info_stat.lv_err_mem "storage in dynamic failure memory of the diagnosis instance RLY_ACCOUT" UWORD _CNV_S_2_RANGE__0___1_CM 1 100. 0. 1. DISPLAY_IDENTIFIER LV_ERR_MEM_RLY_ACCOUT ECU_ADDRESS 0xd000994a BIT_MASK 0x8 /end MEASUREMENT
/begin MEASUREMENT fmy_stat_rly_accout.err_info_stat.lv_ready "readiness status of the diagnosis instance RLY_ACCOUT" UWORD _CNV_S_2_RANGE__0___1_CM 1 100. 0. 1. DISPLAY_IDENTIFIER LV_READY_RLY_ACCOUT ECU_ADDRESS 0xd000994a BIT_MASK 0x10 /end MEASUREMENT
/begin MEASUREMENT fmy_stat_rly_accout.err_info_stat.lv_end_diag "end of diagnosis of the diagnosis instance RLY_ACCOUT" UWORD _CNV_S_2_RANGE__0___1_CM 1 100. 0. 1. DISPLAY_IDENTIFIER LV_END_DIAG_RLY_ACCOUT ECU_ADDRESS 0xd000994a BIT_MASK 0x20 /end MEASUREMENT
/begin MEASUREMENT fmy_stat_rly_accout.err_info_stat.lv_cdn_diag "diagnosis condition of the diagnosis instance RLY_ACCOUT" UWORD _CNV_S_2_RANGE__0___1_CM 1 100. 0. 1. DISPLAY_IDENTIFIER LV_CDN_DIAG_RLY_ACCOUT ECU_ADDRESS 0xd000994a BIT_MASK 0x40 /end MEASUREMENT
/begin MEASUREMENT fmy_stat_rly_accout.err_info_stat.err_sym "symptoms of the diagnosis instance RLY_ACCOUT" UWORD _CNV_S_16_RANGE_ERR__349_CM 1 100. 0. 15. DISPLAY_IDENTIFIER ERR_SYM_RLY_ACCOUT ECU_ADDRESS 0xd000994a BIT_MASK 0x780 /end MEASUREMENT
/begin MEASUREMENT fmy_stat_isc.ctr_abc "anti bounce counter for diagnosis instance ISC" UBYTE _CNV_A_R_LINEAR_____0_CM 1 100. 0. 255. DISPLAY_IDENTIFIER CTR_ABC_ISC ECU_ADDRESS 0xd0009764 FORMAT "%3.0" /end MEASUREMENT
/begin MEASUREMENT fmy_stat_isc.ctr_end_diag "counter for end of diagnosis for diagnosis instance ISC" UBYTE _CNV_A_R_LINEAR_____0_CM 1 100. 0. 255. DISPLAY_IDENTIFIER CTR_ABC_END_DIAG_ISC ECU_ADDRESS 0xd0009765 FORMAT "%3.0" /end MEASUREMENT
/begin MEASUREMENT fmy_stat_isc.err_info_stat.lv_err_mem "storage in dynamic failure memory of the diagnosis instance ISC" UWORD _CNV_S_2_RANGE__0___1_CM 1 100. 0. 1. DISPLAY_IDENTIFIER LV_ERR_MEM_ISC ECU_ADDRESS 0xd0009766 BIT_MASK 0x8 /end MEASUREMENT
/begin MEASUREMENT fmy_stat_isc.err_info_stat.lv_ready "readiness status of the diagnosis instance ISC" UWORD _CNV_S_2_RANGE__0___1_CM 1 100. 0. 1. DISPLAY_IDENTIFIER LV_READY_ISC ECU_ADDRESS 0xd0009766 BIT_MASK 0x10 /end MEASUREMENT
/begin MEASUREMENT fmy_stat_isc.err_info_stat.lv_end_diag "end of diagnosis of the diagnosis instance ISC" UWORD _CNV_S_2_RANGE__0___1_CM 1 100. 0. 1. DISPLAY_IDENTIFIER LV_END_DIAG_ISC ECU_ADDRESS 0xd0009766 BIT_MASK 0x20 /end MEASUREMENT
/begin MEASUREMENT fmy_stat_isc.err_info_stat.lv_cdn_diag "diagnosis condition of the diagnosis instance ISC" UWORD _CNV_S_2_RANGE__0___1_CM 1 100. 0. 1. DISPLAY_IDENTIFIER LV_CDN_DIAG_ISC ECU_ADDRESS 0xd0009766 BIT_MASK 0x40 /end MEASUREMENT
/begin MEASUREMENT fmy_stat_isc.err_info_stat.err_sym "symptoms of the diagnosis instance ISC" UWORD _CNV_S_16_RANGE_ERR__349_CM 1 100. 0. 15. DISPLAY_IDENTIFIER ERR_SYM_ISC ECU_ADDRESS 0xd0009766 BIT_MASK 0x780 /end MEASUREMENT
/begin MEASUREMENT fmy_stat_isc_cst.ctr_abc "anti bounce counter for diagnosis instance ISC_CST" UBYTE _CNV_A_R_LINEAR_____0_CM 1 100. 0. 255. DISPLAY_IDENTIFIER CTR_ABC_ISC_CST ECU_ADDRESS 0xd0009768 FORMAT "%3.0" /end MEASUREMENT
/begin MEASUREMENT fmy_stat_isc_cst.ctr_end_diag "counter for end of diagnosis for diagnosis instance ISC_CST" UBYTE _CNV_A_R_LINEAR_____0_CM 1 100. 0. 255. DISPLAY_IDENTIFIER CTR_ABC_END_DIAG_ISC_CST ECU_ADDRESS 0xd0009769 FORMAT "%3.0" /end MEASUREMENT
/begin MEASUREMENT fmy_stat_isc_cst.err_info_stat.lv_err_mem "storage in dynamic failure memory of the diagnosis instance ISC_CST" UWORD _CNV_S_2_RANGE__0___1_CM 1 100. 0. 1. DISPLAY_IDENTIFIER LV_ERR_MEM_ISC_CST ECU_ADDRESS 0xd000976a BIT_MASK 0x8 /end MEASUREMENT
/begin MEASUREMENT fmy_stat_isc_cst.err_info_stat.lv_ready "readiness status of the diagnosis instance ISC_CST" UWORD _CNV_S_2_RANGE__0___1_CM 1 100. 0. 1. DISPLAY_IDENTIFIER LV_READY_ISC_CST ECU_ADDRESS 0xd000976a BIT_MASK 0x10 /end MEASUREMENT
/begin MEASUREMENT fmy_stat_isc_cst.err_info_stat.lv_end_diag "end of diagnosis of the diagnosis instance ISC_CST" UWORD _CNV_S_2_RANGE__0___1_CM 1 100. 0. 1. DISPLAY_IDENTIFIER LV_END_DIAG_ISC_CST ECU_ADDRESS 0xd000976a BIT_MASK 0x20 /end MEASUREMENT
/begin MEASUREMENT fmy_stat_isc_cst.err_info_stat.lv_cdn_diag "diagnosis condition of the diagnosis instance ISC_CST" UWORD _CNV_S_2_RANGE__0___1_CM 1 100. 0. 1. DISPLAY_IDENTIFIER LV_CDN_DIAG_ISC_CST ECU_ADDRESS 0xd000976a BIT_MASK 0x40 /end MEASUREMENT
/begin MEASUREMENT fmy_stat_isc_cst.err_info_stat.err_sym "symptoms of the diagnosis instance ISC_CST" UWORD _CNV_S_16_RANGE_ERR__349_CM 1 100. 0. 15. DISPLAY_IDENTIFIER ERR_SYM_ISC_CST ECU_ADDRESS 0xd000976a BIT_MASK 0x780 /end MEASUREMENT
/begin MEASUREMENT fmy_stat_im_bls_plaus.ctr_abc "anti bounce counter for diagnosis instance IM_BLS_PLAUS" UBYTE _CNV_A_R_LINEAR_____0_CM 1 100. 0. 255. DISPLAY_IDENTIFIER CTR_ABC_IM_BLS_PLAUS ECU_ADDRESS 0xd000974c FORMAT "%3.0" /end MEASUREMENT
/begin MEASUREMENT fmy_stat_im_bls_plaus.ctr_end_diag "counter for end of diagnosis for diagnosis instance IM_BLS_PLAUS" UBYTE _CNV_A_R_LINEAR_____0_CM 1 100. 0. 255. DISPLAY_IDENTIFIER CTR_ABC_END_DIAG_IM_BLS_PLAUS ECU_ADDRESS 0xd000974d FORMAT "%3.0" /end MEASUREMENT
/begin MEASUREMENT fmy_stat_im_bls_plaus.err_info_stat.lv_err_mem "storage in dynamic failure memory of the diagnosis instance IM_BLS_PLAUS" UWORD _CNV_S_2_RANGE__0___1_CM 1 100. 0. 1. DISPLAY_IDENTIFIER LV_ERR_MEM_IM_BLS_PLAUS ECU_ADDRESS 0xd000974e BIT_MASK 0x8 /end MEASUREMENT
/begin MEASUREMENT fmy_stat_im_bls_plaus.err_info_stat.lv_ready "readiness status of the diagnosis instance IM_BLS_PLAUS" UWORD _CNV_S_2_RANGE__0___1_CM 1 100. 0. 1. DISPLAY_IDENTIFIER LV_READY_IM_BLS_PLAUS ECU_ADDRESS 0xd000974e BIT_MASK 0x10 /end MEASUREMENT
/begin MEASUREMENT fmy_stat_im_bls_plaus.err_info_stat.lv_end_diag "end of diagnosis of the diagnosis instance IM_BLS_PLAUS" UWORD _CNV_S_2_RANGE__0___1_CM 1 100. 0. 1. DISPLAY_IDENTIFIER LV_END_DIAG_IM_BLS_PLAUS ECU_ADDRESS 0xd000974e BIT_MASK 0x20 /end MEASUREMENT
/begin MEASUREMENT fmy_stat_im_bls_plaus.err_info_stat.lv_cdn_diag "diagnosis condition of the diagnosis instance IM_BLS_PLAUS" UWORD _CNV_S_2_RANGE__0___1_CM 1 100. 0. 1. DISPLAY_IDENTIFIER LV_CDN_DIAG_IM_BLS_PLAUS ECU_ADDRESS 0xd000974e BIT_MASK 0x40 /end MEASUREMENT
/begin MEASUREMENT fmy_stat_im_bls_plaus.err_info_stat.err_sym "symptoms of the diagnosis instance IM_BLS_PLAUS" UWORD _CNV_S_16_RANGE_ERR__349_CM 1 100. 0. 15. DISPLAY_IDENTIFIER ERR_SYM_IM_BLS_PLAUS ECU_ADDRESS 0xd000974e BIT_MASK 0x780 /end MEASUREMENT
/begin MEASUREMENT fmy_stat_im_bts_plaus.ctr_abc "anti bounce counter for diagnosis instance IM_BTS_PLAUS" UBYTE _CNV_A_R_LINEAR_____0_CM 1 100. 0. 255. DISPLAY_IDENTIFIER CTR_ABC_IM_BTS_PLAUS ECU_ADDRESS 0xd0009750 FORMAT "%3.0" /end MEASUREMENT
/begin MEASUREMENT fmy_stat_im_bts_plaus.ctr_end_diag "counter for end of diagnosis for diagnosis instance IM_BTS_PLAUS" UBYTE _CNV_A_R_LINEAR_____0_CM 1 100. 0. 255. DISPLAY_IDENTIFIER CTR_ABC_END_DIAG_IM_BTS_PLAUS ECU_ADDRESS 0xd0009751 FORMAT "%3.0" /end MEASUREMENT
/begin MEASUREMENT fmy_stat_im_bts_plaus.err_info_stat.lv_err_mem "storage in dynamic failure memory of the diagnosis instance IM_BTS_PLAUS" UWORD _CNV_S_2_RANGE__0___1_CM 1 100. 0. 1. DISPLAY_IDENTIFIER LV_ERR_MEM_IM_BTS_PLAUS ECU_ADDRESS 0xd0009752 BIT_MASK 0x8 /end MEASUREMENT
/begin MEASUREMENT fmy_stat_im_bts_plaus.err_info_stat.lv_ready "readiness status of the diagnosis instance IM_BTS_PLAUS" UWORD _CNV_S_2_RANGE__0___1_CM 1 100. 0. 1. DISPLAY_IDENTIFIER LV_READY_IM_BTS_PLAUS ECU_ADDRESS 0xd0009752 BIT_MASK 0x10 /end MEASUREMENT
/begin MEASUREMENT fmy_stat_im_bts_plaus.err_info_stat.lv_end_diag "end of diagnosis of the diagnosis instance IM_BTS_PLAUS" UWORD _CNV_S_2_RANGE__0___1_CM 1 100. 0. 1. DISPLAY_IDENTIFIER LV_END_DIAG_IM_BTS_PLAUS ECU_ADDRESS 0xd0009752 BIT_MASK 0x20 /end MEASUREMENT
/begin MEASUREMENT fmy_stat_im_bts_plaus.err_info_stat.lv_cdn_diag "diagnosis condition of the diagnosis instance IM_BTS_PLAUS" UWORD _CNV_S_2_RANGE__0___1_CM 1 100. 0. 1. DISPLAY_IDENTIFIER LV_CDN_DIAG_IM_BTS_PLAUS ECU_ADDRESS 0xd0009752 BIT_MASK 0x40 /end MEASUREMENT
/begin MEASUREMENT fmy_stat_im_bts_plaus.err_info_stat.err_sym "symptoms of the diagnosis instance IM_BTS_PLAUS" UWORD _CNV_S_16_RANGE_ERR__349_CM 1 100. 0. 15. DISPLAY_IDENTIFIER ERR_SYM_IM_BTS_PLAUS ECU_ADDRESS 0xd0009752 BIT_MASK 0x780 /end MEASUREMENT
/begin MEASUREMENT fmy_stat_msw_tog.ctr_abc "anti bounce counter for diagnosis instance MSW_TOG" UBYTE _CNV_A_R_LINEAR_____0_CM 1 100. 0. 255. DISPLAY_IDENTIFIER CTR_ABC_MSW_TOG ECU_ADDRESS 0xd0009864 FORMAT "%3.0" /end MEASUREMENT
/begin MEASUREMENT fmy_stat_msw_tog.ctr_end_diag "counter for end of diagnosis for diagnosis instance MSW_TOG" UBYTE _CNV_A_R_LINEAR_____0_CM 1 100. 0. 255. DISPLAY_IDENTIFIER CTR_ABC_END_DIAG_MSW_TOG ECU_ADDRESS 0xd0009865 FORMAT "%3.0" /end MEASUREMENT
/begin MEASUREMENT fmy_stat_msw_tog.err_info_stat.lv_err_mem "storage in dynamic failure memory of the diagnosis instance MSW_TOG" UWORD _CNV_S_2_RANGE__0___1_CM 1 100. 0. 1. DISPLAY_IDENTIFIER LV_ERR_MEM_MSW_TOG ECU_ADDRESS 0xd0009866 BIT_MASK 0x8 /end MEASUREMENT
/begin COMPU_METHOD _CNV_A_R_LINEAR_____0_CM "" RAT_FUNC "%6.3" "-" COEFFS 0 1. 0. 0 0 1 /end COMPU_METHOD
/begin COMPU_METHOD _CNV_S_2_RANGE__0___1_CM "" TAB_VERB "%6.3" "-" COMPU_TAB_REF _CNV_S_2_RANGE__0___1 /end COMPU_METHOD
/begin COMPU_VTAB _CNV_S_2_RANGE__0___1 "" TAB_VERB 2 0 "0" 1 "1" /end COMPU_VTAB
/begin COMPU_METHOD _CNV_S_16_RANGE_ERR__349_CM "" TAB_VERB "%6.3" "-" COMPU_TAB_REF _CNV_S_16_RANGE_ERR__349 /end COMPU_METHOD
/begin COMPU_VTAB _CNV_S_16_RANGE_ERR__349 "" TAB_VERB 16 0 "NO_SYM" 1 "SYM_0" 2 "SYM_1" 3 "SYM_0, SYM_1" 4 "SYM_2" 5 "SYM_0, SYM_2" 6 "SYM_1, SYM_2" 7 "SYM_0, SYM_1, SYM_2" 8 "SYM_3" 9 "SYM_0, SYM_3" 10 "SYM_1, SYM_3" 11 "SYM_0, SYM_1,SYM_3" 12 "SYM_2, SYM_3" 13 "SYM_0, SYM_2, SYM_3" 14 "SYM_1, SYM_2, SYM_3" 15 "SYM_0, SYM_1, SYM_2, SYM_3" /end COMPU_VTAB
/begin FUNCTION ERRM_Table_of_Failures "Table_of_Failures"
 /begin OUT_MEASUREMENT fmy_stat_slv_ivvt_in_1.ctr_abc fmy_stat_slv_ivvt_in_1.ctr_end_diag fmy_stat_slv_ivvt_in_1.err_info_stat.lv_err_mem fmy_stat_slv_ivvt_in_1.err_info_stat.lv_ready fmy_stat_slv_ivvt_in_1.err_info_stat.lv_end_diag fmy_stat_slv_ivvt_in_1.err_info_stat.lv_cdn_diag fmy_stat_slv_ivvt_in_1.err_info_stat.err_sym fmy_stat_slv_ivvt_in_2.ctr_abc fmy_stat_slv_ivvt_in_2.ctr_end_diag fmy_stat_slv_ivvt_in_2.err_info_stat.lv_err_mem fmy_stat_slv_ivvt_in_2.err_info_stat.lv_ready fmy_stat_slv_ivvt_in_2.err_info_stat.lv_end_diag fmy_stat_slv_ivvt_in_2.err_info_stat.lv_cdn_diag fmy_stat_slv_ivvt_in_2.err_info_stat.err_sym fmy_stat_slv_ivvt_ex_1.ctr_abc fmy_stat_slv_ivvt_ex_1.ctr_end_diag fmy_stat_slv_ivvt_ex_1.err_info_stat.lv_err_mem fmy_stat_slv_ivvt_ex_1.err_info_stat.lv_ready fmy_stat_slv_ivvt_ex_1.err_info_stat.lv_end_diag fmy_stat_slv_ivvt_ex_1.err_info_stat.lv_cdn_diag fmy_stat_slv_ivvt_ex_1.err_info_stat.err_sym fmy_stat_slv_ivvt_ex_2.ctr_abc fmy_stat_slv_ivvt_ex_2.ctr_end_diag fmy_stat_slv_ivvt_ex_2.err_info_stat.lv_err_mem fmy_stat_slv_ivvt_ex_2.err_info_stat.lv_ready fmy_stat_slv_ivvt_ex_2.err_info_stat.lv_end_diag fmy_stat_slv_ivvt_ex_2.err_info_stat.lv_cdn_diag fmy_stat_slv_ivvt_ex_2.err_info_stat.err_sym fmy_stat_ecu_cks.ctr_abc fmy_stat_ecu_cks.ctr_end_diag fmy_stat_ecu_cks.err_info_stat.lv_err_mem fmy_stat_ecu_cks.err_info_stat.lv_ready fmy_stat_ecu_cks.err_info_stat.lv_end_diag fmy_stat_ecu_cks.err_info_stat.lv_cdn_diag fmy_stat_ecu_cks.err_info_stat.err_sym fmy_stat_vs.ctr_abc fmy_stat_vs.ctr_end_diag fmy_stat_vs.err_info_stat.lv_err_mem fmy_stat_vs.err_info_stat.lv_ready fmy_stat_vs.err_info_stat.lv_end_diag fmy_stat_vs.err_info_stat.lv_cdn_diag fmy_stat_vs.err_info_stat.err_sym fmy_stat_knks_1.ctr_abc fmy_stat_knks_1.ctr_end_diag fmy_stat_knks_1.err_info_stat.lv_err_mem fmy_stat_knks_1.err_info_stat.lv_ready fmy_stat_knks_1.err_info_stat.lv_end_diag fmy_stat_knks_1.err_info_stat.lv_cdn_diag fmy_stat_knks_1.err_info_stat.err_sym fmy_stat_knks_2.ctr_abc fmy_stat_knks_2.ctr_end_diag fmy_stat_knks_2.err_info_stat.lv_err_mem fmy_stat_knks_2.err_info_stat.lv_ready fmy_stat_knks_2.err_info_stat.lv_end_diag fmy_stat_knks_2.err_info_stat.lv_cdn_diag fmy_stat_knks_2.err_info_stat.err_sym fmy_stat_knks_3.ctr_abc fmy_stat_knks_3.ctr_end_diag fmy_stat_knks_3.err_info_stat.lv_err_mem fmy_stat_knks_3.err_info_stat.lv_ready fmy_stat_knks_3.err_info_stat.lv_end_diag fmy_stat_knks_3.err_info_stat.lv_cdn_diag fmy_stat_knks_3.err_info_stat.err_sym fmy_stat_knks_4.ctr_abc fmy_stat_knks_4.ctr_end_diag fmy_stat_knks_4.err_info_stat.lv_err_mem fmy_stat_knks_4.err_info_stat.lv_ready fmy_stat_knks_4.err_info_stat.lv_end_diag fmy_stat_knks_4.err_info_stat.lv_cdn_diag fmy_stat_knks_4.err_info_stat.err_sym fmy_stat_rfp_dr_1.ctr_abc fmy_stat_rfp_dr_1.ctr_end_diag fmy_stat_rfp_dr_1.err_info_stat.lv_err_mem fmy_stat_rfp_dr_1.err_info_stat.lv_ready fmy_stat_rfp_dr_1.err_info_stat.lv_end_diag fmy_stat_rfp_dr_1.err_info_stat.lv_cdn_diag fmy_stat_rfp_dr_1.err_info_stat.err_sym fmy_stat_rfp_dr_2.ctr_abc fmy_stat_rfp_dr_2.ctr_end_diag fmy_stat_rfp_dr_2.err_info_stat.lv_err_mem fmy_stat_rfp_dr_2.err_info_stat.lv_ready fmy_stat_rfp_dr_2.err_info_stat.lv_end_diag fmy_stat_rfp_dr_2.err_info_stat.lv_cdn_diag fmy_stat_rfp_dr_2.err_info_stat.err_sym fmy_stat_wg_1_dr.ctr_abc fmy_stat_wg_1_dr.ctr_end_diag fmy_stat_wg_1_dr.err_info_stat.lv_err_mem fmy_stat_wg_1_dr.err_info_stat.lv_ready fmy_stat_wg_1_dr.err_info_stat.lv_end_diag fmy_stat_wg_1_dr.err_info_stat.lv_cdn_diag fmy_stat_wg_1_dr.err_info_stat.err_sym fmy_stat_wg_2_dr.ctr_abc fmy_stat_wg_2_dr.ctr_end_diag fmy_stat_wg_2_dr.err_info_stat.lv_err_mem fmy_stat_wg_2_dr.err_info_stat.lv_ready fmy_stat_wg_2_dr.err_info_stat.lv_end_diag fmy_stat_wg_2_dr.err_info_stat.lv_cdn_diag fmy_stat_wg_2_dr.err_info_stat.err_sym fmy_stat_put_el_1.ctr_abc fmy_stat_put_el_1.ctr_end_diag fmy_stat_put_el_1.err_info_stat.lv_err_mem fmy_stat_put_el_1.err_info_stat.lv_ready fmy_stat_put_el_1.err_info_stat.lv_end_diag fmy_stat_put_el_1.err_info_stat.lv_cdn_diag fmy_stat_put_el_1.err_info_stat.err_sym fmy_stat_put_el_2.ctr_abc fmy_stat_put_el_2.ctr_end_diag fmy_stat_put_el_2.err_info_stat.lv_err_mem fmy_stat_put_el_2.err_info_stat.lv_ready fmy_stat_put_el_2.err_info_stat.lv_end_diag fmy_stat_put_el_2.err_info_stat.lv_cdn_diag fmy_stat_put_el_2.err_info_stat.err_sym fmy_stat_igc_scp_0.ctr_abc fmy_stat_igc_scp_0.ctr_end_diag fmy_stat_igc_scp_0.err_info_stat.lv_err_mem fmy_stat_igc_scp_0.err_info_stat.lv_ready fmy_stat_igc_scp_0.err_info_stat.lv_end_diag fmy_stat_igc_scp_0.err_info_stat.lv_cdn_diag fmy_stat_igc_scp_0.err_info_stat.err_sym fmy_stat_igc_scp_1.ctr_abc fmy_stat_igc_scp_1.ctr_end_diag fmy_stat_igc_scp_1.err_info_stat.lv_err_mem fmy_stat_igc_scp_1.err_info_stat.lv_ready fmy_stat_igc_scp_1.err_info_stat.lv_end_diag fmy_stat_igc_scp_1.err_info_stat.lv_cdn_diag fmy_stat_igc_scp_1.err_info_stat.err_sym fmy_stat_igc_scp_2.ctr_abc fmy_stat_igc_scp_2.ctr_end_diag fmy_stat_igc_scp_2.err_info_stat.lv_err_mem fmy_stat_igc_scp_2.err_info_stat.lv_ready fmy_stat_igc_scp_2.err_info_stat.lv_end_diag fmy_stat_igc_scp_2.err_info_stat.lv_cdn_diag fmy_stat_igc_scp_2.err_info_stat.err_sym fmy_stat_igc_scp_3.ctr_abc fmy_stat_igc_scp_3.ctr_end_diag fmy_stat_igc_scp_3.err_info_stat.lv_err_mem fmy_stat_igc_scp_3.err_info_stat.lv_ready fmy_stat_igc_scp_3.err_info_stat.lv_end_diag fmy_stat_igc_scp_3.err_info_stat.lv_cdn_diag fmy_stat_igc_scp_3.err_info_stat.err_sym fmy_stat_igc_scp_4.ctr_abc fmy_stat_igc_scp_4.ctr_end_diag fmy_stat_igc_scp_4.err_info_stat.lv_err_mem fmy_stat_igc_scp_4.err_info_stat.lv_ready fmy_stat_igc_scp_4.err_info_stat.lv_end_diag fmy_stat_igc_scp_4.err_info_stat.lv_cdn_diag fmy_stat_igc_scp_4.err_info_stat.err_sym fmy_stat_igc_scp_5.ctr_abc fmy_stat_igc_scp_5.ctr_end_diag fmy_stat_igc_scp_5.err_info_stat.lv_err_mem fmy_stat_igc_scp_5.err_info_stat.lv_ready fmy_stat_igc_scp_5.err_info_stat.lv_end_diag fmy_stat_igc_scp_5.err_info_stat.lv_cdn_diag fmy_stat_igc_scp_5.err_info_stat.err_sym fmy_stat_igc_scp_6.ctr_abc fmy_stat_igc_scp_6.ctr_end_diag fmy_stat_igc_scp_6.err_info_stat.lv_err_mem fmy_stat_igc_scp_6.err_info_stat.lv_ready fmy_stat_igc_scp_6.err_info_stat.lv_end_diag fmy_stat_igc_scp_6.err_info_stat.lv_cdn_diag fmy_stat_igc_scp_6.err_info_stat.err_sym fmy_stat_igc_scp_7.ctr_abc fmy_stat_igc_scp_7.ctr_end_diag fmy_stat_igc_scp_7.err_info_stat.lv_err_mem fmy_stat_igc_scp_7.err_info_stat.lv_ready fmy_stat_igc_scp_7.err_info_stat.lv_end_diag fmy_stat_igc_scp_7.err_info_stat.lv_cdn_diag fmy_stat_igc_scp_7.err_info_stat.err_sym fmy_stat_igc_scg_0.ctr_abc fmy_stat_igc_scg_0.ctr_end_diag fmy_stat_igc_scg_0.err_info_stat.lv_err_mem fmy_stat_igc_scg_0.err_info_stat.lv_ready fmy_stat_igc_scg_0.err_info_stat.lv_end_diag fmy_stat_igc_scg_0.err_info_stat.lv_cdn_diag fmy_stat_igc_scg_0.err_info_stat.err_sym fmy_stat_igc_scg_1.ctr_abc fmy_stat_igc_scg_1.ctr_end_diag fmy_stat_igc_scg_1.err_info_stat.lv_err_mem fmy_stat_igc_scg_1.err_info_stat.lv_ready fmy_stat_igc_scg_1.err_info_stat.lv_end_diag fmy_stat_igc_scg_1.err_info_stat.lv_cdn_diag fmy_stat_igc_scg_1.err_info_stat.err_sym fmy_stat_igc_scg_2.ctr_abc fmy_stat_igc_scg_2.ctr_end_diag fmy_stat_igc_scg_2.err_info_stat.lv_err_mem fmy_stat_igc_scg_2.err_info_stat.lv_ready fmy_stat_igc_scg_2.err_info_stat.lv_end_diag fmy_stat_igc_scg_2.err_info_stat.lv_cdn_diag fmy_stat_igc_scg_2.err_info_stat.err_sym fmy_stat_igc_scg_3.ctr_abc fmy_stat_igc_scg_3.ctr_end_diag fmy_stat_igc_scg_3.err_info_stat.lv_err_mem fmy_stat_igc_scg_3.err_info_stat.lv_ready fmy_stat_igc_scg_3.err_info_stat.lv_end_diag fmy_stat_igc_scg_3.err_info_stat.lv_cdn_diag fmy_stat_igc_scg_3.err_info_stat.err_sym fmy_stat_igc_scg_4.ctr_abc fmy_stat_igc_scg_4.ctr_end_diag fmy_stat_igc_scg_4.err_info_stat.lv_err_mem fmy_stat_igc_scg_4.err_info_stat.lv_ready fmy_stat_igc_scg_4.err_info_stat.lv_end_diag fmy_stat_igc_scg_4.err_info_stat.lv_cdn_diag fmy_stat_igc_scg_4.err_info_stat.err_sym fmy_stat_igc_scg_5.ctr_abc fmy_stat_igc_scg_5.ctr_end_diag fmy_stat_igc_scg_5.err_info_stat.lv_err_mem fmy_stat_igc_scg_5.err_info_stat.lv_ready fmy_stat_igc_scg_5.err_info_stat.lv_end_diag fmy_stat_igc_scg_5.err_info_stat.lv_cdn_diag fmy_stat_igc_scg_5.err_info_stat.err_sym fmy_stat_igc_scg_6.ctr_abc fmy_stat_igc_scg_6.ctr_end_diag fmy_stat_igc_scg_6.err_info_stat.lv_err_mem fmy_stat_igc_scg_6.err_info_stat.lv_ready fmy_stat_igc_scg_6.err_info_stat.lv_end_diag fmy_stat_igc_scg_6.err_info_stat.lv_cdn_diag fmy_stat_igc_scg_6.err_info_stat.err_sym fmy_stat_igc_scg_7.ctr_abc fmy_stat_igc_scg_7.ctr_end_diag fmy_stat_igc_scg_7.err_info_stat.lv_err_mem fmy_stat_igc_scg_7.err_info_stat.lv_ready fmy_stat_igc_scg_7.err_info_stat.lv_end_diag fmy_stat_igc_scg_7.err_info_stat.lv_cdn_diag fmy_stat_igc_scg_7.err_info_stat.err_sym fmy_stat_igc_ol_0.ctr_abc fmy_stat_igc_ol_0.ctr_end_diag fmy_stat_igc_ol_0.err_info_stat.lv_err_mem fmy_stat_igc_ol_0.err_info_stat.lv_ready fmy_stat_igc_ol_0.err_info_stat.lv_end_diag fmy_stat_igc_ol_0.err_info_stat.lv_cdn_diag fmy_stat_igc_ol_0.err_info_stat.err_sym fmy_stat_igc_ol_1.ctr_abc fmy_stat_igc_ol_1.ctr_end_diag fmy_stat_igc_ol_1.err_info_stat.lv_err_mem fmy_stat_igc_ol_1.err_info_stat.lv_ready fmy_stat_igc_ol_1.err_info_stat.lv_end_diag fmy_stat_igc_ol_1.err_info_stat.lv_cdn_diag fmy_stat_igc_ol_1.err_info_stat.err_sym fmy_stat_igc_ol_2.ctr_abc fmy_stat_igc_ol_2.ctr_end_diag fmy_stat_igc_ol_2.err_info_stat.lv_err_mem fmy_stat_igc_ol_2.err_info_stat.lv_ready fmy_stat_igc_ol_2.err_info_stat.lv_end_diag fmy_stat_igc_ol_2.err_info_stat.lv_cdn_diag fmy_stat_igc_ol_2.err_info_stat.err_sym fmy_stat_igc_ol_3.ctr_abc fmy_stat_igc_ol_3.ctr_end_diag fmy_stat_igc_ol_3.err_info_stat.lv_err_mem fmy_stat_igc_ol_3.err_info_stat.lv_ready fmy_stat_igc_ol_3.err_info_stat.lv_end_diag fmy_stat_igc_ol_3.err_info_stat.lv_cdn_diag fmy_stat_igc_ol_3.err_info_stat.err_sym fmy_stat_igc_ol_4.ctr_abc fmy_stat_igc_ol_4.ctr_end_diag fmy_stat_igc_ol_4.err_info_stat.lv_err_mem fmy_stat_igc_ol_4.err_info_stat.lv_ready fmy_stat_igc_ol_4.err_info_stat.lv_end_diag fmy_stat_igc_ol_4.err_info_stat.lv_cdn_diag fmy_stat_igc_ol_4.err_info_stat.err_sym fmy_stat_igc_ol_5.ctr_abc fmy_stat_igc_ol_5.ctr_end_diag fmy_stat_igc_ol_5.err_info_stat.lv_err_mem fmy_stat_igc_ol_5.err_info_stat.lv_ready fmy_stat_igc_ol_5.err_info_stat.lv_end_diag fmy_stat_igc_ol_5.err_info_stat.lv_cdn_diag fmy_stat_igc_ol_5.err_info_stat.err_sym fmy_stat_igc_ol_6.ctr_abc fmy_stat_igc_ol_6.ctr_end_diag fmy_stat_igc_ol_6.err_info_stat.lv_err_mem fmy_stat_igc_ol_6.err_info_stat.lv_ready fmy_stat_igc_ol_6.err_info_stat.lv_end_diag fmy_stat_igc_ol_6.err_info_stat.lv_cdn_diag fmy_stat_igc_ol_6.err_info_stat.err_sym fmy_stat_igc_ol_7.ctr_abc fmy_stat_igc_ol_7.ctr_end_diag fmy_stat_igc_ol_7.err_info_stat.lv_err_mem fmy_stat_igc_ol_7.err_info_stat.lv_ready fmy_stat_igc_ol_7.err_info_stat.lv_end_diag fmy_stat_igc_ol_7.err_info_stat.lv_cdn_diag fmy_stat_igc_ol_7.err_info_stat.err_sym fmy_stat_dur_igc_mpl.ctr_abc fmy_stat_dur_igc_mpl.ctr_end_diag fmy_stat_dur_igc_mpl.err_info_stat.lv_err_mem fmy_stat_dur_igc_mpl.err_info_stat.lv_ready fmy_stat_dur_igc_mpl.err_info_stat.lv_end_diag fmy_stat_dur_igc_mpl.err_info_stat.lv_cdn_diag fmy_stat_dur_igc_mpl.err_info_stat.err_sym fmy_stat_v_ref_1.ctr_abc fmy_stat_v_ref_1.ctr_end_diag fmy_stat_v_ref_1.err_info_stat.lv_err_mem fmy_stat_v_ref_1.err_info_stat.lv_ready fmy_stat_v_ref_1.err_info_stat.lv_end_diag fmy_stat_v_ref_1.err_info_stat.lv_cdn_diag fmy_stat_v_ref_1.err_info_stat.err_sym fmy_stat_v_ref_2.ctr_abc fmy_stat_v_ref_2.ctr_end_diag fmy_stat_v_ref_2.err_info_stat.lv_err_mem fmy_stat_v_ref_2.err_info_stat.lv_ready fmy_stat_v_ref_2.err_info_stat.lv_end_diag fmy_stat_v_ref_2.err_info_stat.lv_cdn_diag fmy_stat_v_ref_2.err_info_stat.err_sym fmy_stat_pvs_1.ctr_abc fmy_stat_pvs_1.ctr_end_diag fmy_stat_pvs_1.err_info_stat.lv_err_mem fmy_stat_pvs_1.err_info_stat.lv_ready fmy_stat_pvs_1.err_info_stat.lv_end_diag fmy_stat_pvs_1.err_info_stat.lv_cdn_diag fmy_stat_pvs_1.err_info_stat.err_sym fmy_stat_pvs_2.ctr_abc fmy_stat_pvs_2.ctr_end_diag fmy_stat_pvs_2.err_info_stat.lv_err_mem fmy_stat_pvs_2.err_info_stat.lv_ready fmy_stat_pvs_2.err_info_stat.lv_end_diag fmy_stat_pvs_2.err_info_stat.lv_cdn_diag fmy_stat_pvs_2.err_info_stat.err_sym fmy_stat_pvs_ratio.ctr_abc fmy_stat_pvs_ratio.ctr_end_diag fmy_stat_pvs_ratio.err_info_stat.lv_err_mem fmy_stat_pvs_ratio.err_info_stat.lv_ready fmy_stat_pvs_ratio.err_info_stat.lv_end_diag fmy_stat_pvs_ratio.err_info_stat.lv_cdn_diag fmy_stat_pvs_ratio.err_info_stat.err_sym fmy_stat_pvs_double.ctr_abc fmy_stat_pvs_double.ctr_end_diag fmy_stat_pvs_double.err_info_stat.lv_err_mem fmy_stat_pvs_double.err_info_stat.lv_ready fmy_stat_pvs_double.err_info_stat.lv_end_diag fmy_stat_pvs_double.err_info_stat.lv_cdn_diag fmy_stat_pvs_double.err_info_stat.err_sym fmy_stat_pvs_bls_not_plaus.ctr_abc fmy_stat_pvs_bls_not_plaus.ctr_end_diag fmy_stat_pvs_bls_not_plaus.err_info_stat.lv_err_mem fmy_stat_pvs_bls_not_plaus.err_info_stat.lv_ready fmy_stat_pvs_bls_not_plaus.err_info_stat.lv_end_diag fmy_stat_pvs_bls_not_plaus.err_info_stat.lv_cdn_diag fmy_stat_pvs_bls_not_plaus.err_info_stat.err_sym fmy_stat_mtc_ctl_1.ctr_abc fmy_stat_mtc_ctl_1.ctr_end_diag fmy_stat_mtc_ctl_1.err_info_stat.lv_err_mem fmy_stat_mtc_ctl_1.err_info_stat.lv_ready fmy_stat_mtc_ctl_1.err_info_stat.lv_end_diag fmy_stat_mtc_ctl_1.err_info_stat.lv_cdn_diag fmy_stat_mtc_ctl_1.err_info_stat.err_sym fmy_stat_gen.ctr_abc fmy_stat_gen.ctr_end_diag fmy_stat_gen.err_info_stat.lv_err_mem fmy_stat_gen.err_info_stat.lv_ready fmy_stat_gen.err_info_stat.lv_end_diag fmy_stat_gen.err_info_stat.lv_cdn_diag fmy_stat_gen.err_info_stat.err_sym fmy_stat_gen_diag.ctr_abc fmy_stat_gen_diag.ctr_end_diag fmy_stat_gen_diag.err_info_stat.lv_err_mem fmy_stat_gen_diag.err_info_stat.lv_ready fmy_stat_gen_diag.err_info_stat.lv_end_diag fmy_stat_gen_diag.err_info_stat.lv_cdn_diag fmy_stat_gen_diag.err_info_stat.err_sym fmy_stat_alter_bn.ctr_abc fmy_stat_alter_bn.ctr_end_diag fmy_stat_alter_bn.err_info_stat.lv_err_mem fmy_stat_alter_bn.err_info_stat.lv_ready fmy_stat_alter_bn.err_info_stat.lv_end_diag fmy_stat_alter_bn.err_info_stat.lv_cdn_diag fmy_stat_alter_bn.err_info_stat.err_sym fmy_stat_alter_bn_bat.ctr_abc fmy_stat_alter_bn_bat.ctr_end_diag fmy_stat_alter_bn_bat.err_info_stat.lv_err_mem fmy_stat_alter_bn_bat.err_info_stat.lv_ready fmy_stat_alter_bn_bat.err_info_stat.lv_end_diag fmy_stat_alter_bn_bat.err_info_stat.lv_cdn_diag fmy_stat_alter_bn_bat.err_info_stat.err_sym fmy_stat_t_es.ctr_abc fmy_stat_t_es.ctr_end_diag fmy_stat_t_es.err_info_stat.lv_err_mem fmy_stat_t_es.err_info_stat.lv_ready fmy_stat_t_es.err_info_stat.lv_end_diag fmy_stat_t_es.err_info_stat.lv_cdn_diag fmy_stat_t_es.err_info_stat.err_sym fmy_stat_map_dip_plaus.ctr_abc fmy_stat_map_dip_plaus.ctr_end_diag fmy_stat_map_dip_plaus.err_info_stat.lv_err_mem fmy_stat_map_dip_plaus.err_info_stat.lv_ready fmy_stat_map_dip_plaus.err_info_stat.lv_end_diag fmy_stat_map_dip_plaus.err_info_stat.lv_cdn_diag fmy_stat_map_dip_plaus.err_info_stat.err_sym fmy_stat_toil_level.ctr_abc fmy_stat_toil_level.ctr_end_diag fmy_stat_toil_level.err_info_stat.lv_err_mem fmy_stat_toil_level.err_info_stat.lv_ready fmy_stat_toil_level.err_info_stat.lv_end_diag fmy_stat_toil_level.err_info_stat.lv_cdn_diag fmy_stat_toil_level.err_info_stat.err_sym fmy_stat_alter_bn_rgn.ctr_abc fmy_stat_alter_bn_rgn.ctr_end_diag fmy_stat_alter_bn_rgn.err_info_stat.lv_err_mem fmy_stat_alter_bn_rgn.err_info_stat.lv_ready fmy_stat_alter_bn_rgn.err_info_stat.lv_end_diag fmy_stat_alter_bn_rgn.err_info_stat.lv_cdn_diag fmy_stat_alter_bn_rgn.err_info_stat.err_sym fmy_stat_per_cam_in_1.ctr_abc fmy_stat_per_cam_in_1.ctr_end_diag fmy_stat_per_cam_in_1.err_info_stat.lv_err_mem fmy_stat_per_cam_in_1.err_info_stat.lv_ready fmy_stat_per_cam_in_1.err_info_stat.lv_end_diag fmy_stat_per_cam_in_1.err_info_stat.lv_cdn_diag fmy_stat_per_cam_in_1.err_info_stat.err_sym fmy_stat_per_cam_ex_1.ctr_abc fmy_stat_per_cam_ex_1.ctr_end_diag fmy_stat_per_cam_ex_1.err_info_stat.lv_err_mem fmy_stat_per_cam_ex_1.err_info_stat.lv_ready fmy_stat_per_cam_ex_1.err_info_stat.lv_end_diag fmy_stat_per_cam_ex_1.err_info_stat.lv_cdn_diag fmy_stat_per_cam_ex_1.err_info_stat.err_sym fmy_stat_syn_cam_in_1.ctr_abc fmy_stat_syn_cam_in_1.ctr_end_diag fmy_stat_syn_cam_in_1.err_info_stat.lv_err_mem fmy_stat_syn_cam_in_1.err_info_stat.lv_ready fmy_stat_syn_cam_in_1.err_info_stat.lv_end_diag fmy_stat_syn_cam_in_1.err_info_stat.lv_cdn_diag fmy_stat_syn_cam_in_1.err_info_stat.err_sym fmy_stat_syn_cam_ex_1.ctr_abc fmy_stat_syn_cam_ex_1.ctr_end_diag fmy_stat_syn_cam_ex_1.err_info_stat.lv_err_mem fmy_stat_syn_cam_ex_1.err_info_stat.lv_ready fmy_stat_syn_cam_ex_1.err_info_stat.lv_end_diag fmy_stat_syn_cam_ex_1.err_info_stat.lv_cdn_diag fmy_stat_syn_cam_ex_1.err_info_stat.err_sym fmy_stat_ref_crk_cam_in_1.ctr_abc fmy_stat_ref_crk_cam_in_1.ctr_end_diag fmy_stat_ref_crk_cam_in_1.err_info_stat.lv_err_mem fmy_stat_ref_crk_cam_in_1.err_info_stat.lv_ready fmy_stat_ref_crk_cam_in_1.err_info_stat.lv_end_diag fmy_stat_ref_crk_cam_in_1.err_info_stat.lv_cdn_diag fmy_stat_ref_crk_cam_in_1.err_info_stat.err_sym fmy_stat_ref_crk_cam_ex_1.ctr_abc fmy_stat_ref_crk_cam_ex_1.ctr_end_diag fmy_stat_ref_crk_cam_ex_1.err_info_stat.lv_err_mem fmy_stat_ref_crk_cam_ex_1.err_info_stat.lv_ready fmy_stat_ref_crk_cam_ex_1.err_info_stat.lv_end_diag fmy_stat_ref_crk_cam_ex_1.err_info_stat.lv_cdn_diag fmy_stat_ref_crk_cam_ex_1.err_info_stat.err_sym fmy_stat_per_cam_in_2.ctr_abc fmy_stat_per_cam_in_2.ctr_end_diag fmy_stat_per_cam_in_2.err_info_stat.lv_err_mem fmy_stat_per_cam_in_2.err_info_stat.lv_ready fmy_stat_per_cam_in_2.err_info_stat.lv_end_diag fmy_stat_per_cam_in_2.err_info_stat.lv_cdn_diag fmy_stat_per_cam_in_2.err_info_stat.err_sym fmy_stat_per_cam_ex_2.ctr_abc fmy_stat_per_cam_ex_2.ctr_end_diag fmy_stat_per_cam_ex_2.err_info_stat.lv_err_mem fmy_stat_per_cam_ex_2.err_info_stat.lv_ready fmy_stat_per_cam_ex_2.err_info_stat.lv_end_diag fmy_stat_per_cam_ex_2.err_info_stat.lv_cdn_diag fmy_stat_per_cam_ex_2.err_info_stat.err_sym fmy_stat_syn_cam_in_2.ctr_abc fmy_stat_syn_cam_in_2.ctr_end_diag fmy_stat_syn_cam_in_2.err_info_stat.lv_err_mem fmy_stat_syn_cam_in_2.err_info_stat.lv_ready fmy_stat_syn_cam_in_2.err_info_stat.lv_end_diag fmy_stat_syn_cam_in_2.err_info_stat.lv_cdn_diag fmy_stat_syn_cam_in_2.err_info_stat.err_sym fmy_stat_syn_cam_ex_2.ctr_abc fmy_stat_syn_cam_ex_2.ctr_end_diag fmy_stat_syn_cam_ex_2.err_info_stat.lv_err_mem fmy_stat_syn_cam_ex_2.err_info_stat.lv_ready fmy_stat_syn_cam_ex_2.err_info_stat.lv_end_diag fmy_stat_syn_cam_ex_2.err_info_stat.lv_cdn_diag fmy_stat_syn_cam_ex_2.err_info_stat.err_sym fmy_stat_ref_crk_cam_in_2.ctr_abc fmy_stat_ref_crk_cam_in_2.ctr_end_diag fmy_stat_ref_crk_cam_in_2.err_info_stat.lv_err_mem fmy_stat_ref_crk_cam_in_2.err_info_stat.lv_ready fmy_stat_ref_crk_cam_in_2.err_info_stat.lv_end_diag fmy_stat_ref_crk_cam_in_2.err_info_stat.lv_cdn_diag fmy_stat_ref_crk_cam_in_2.err_info_stat.err_sym fmy_stat_ref_crk_cam_ex_2.ctr_abc fmy_stat_ref_crk_cam_ex_2.ctr_end_diag fmy_stat_ref_crk_cam_ex_2.err_info_stat.lv_err_mem fmy_stat_ref_crk_cam_ex_2.err_info_stat.lv_ready fmy_stat_ref_crk_cam_ex_2.err_info_stat.lv_end_diag fmy_stat_ref_crk_cam_ex_2.err_info_stat.lv_cdn_diag fmy_stat_ref_crk_cam_ex_2.err_info_stat.err_sym fmy_stat_crk_tooth.ctr_abc fmy_stat_crk_tooth.ctr_end_diag fmy_stat_crk_tooth.err_info_stat.lv_err_mem fmy_stat_crk_tooth.err_info_stat.lv_ready fmy_stat_crk_tooth.err_info_stat.lv_end_diag fmy_stat_crk_tooth.err_info_stat.lv_cdn_diag fmy_stat_crk_tooth.err_info_stat.err_sym fmy_stat_crk_tooth_per.ctr_abc fmy_stat_crk_tooth_per.ctr_end_diag fmy_stat_crk_tooth_per.err_info_stat.lv_err_mem fmy_stat_crk_tooth_per.err_info_stat.lv_ready fmy_stat_crk_tooth_per.err_info_stat.lv_end_diag fmy_stat_crk_tooth_per.err_info_stat.lv_cdn_diag fmy_stat_crk_tooth_per.err_info_stat.err_sym fmy_stat_crk_syn.ctr_abc fmy_stat_crk_syn.ctr_end_diag fmy_stat_crk_syn.err_info_stat.lv_err_mem fmy_stat_crk_syn.err_info_stat.lv_ready fmy_stat_crk_syn.err_info_stat.lv_end_diag fmy_stat_crk_syn.err_info_stat.lv_cdn_diag fmy_stat_crk_syn.err_info_stat.err_sym fmy_stat_crk_plaus.ctr_abc fmy_stat_crk_plaus.ctr_end_diag fmy_stat_crk_plaus.err_info_stat.lv_err_mem fmy_stat_crk_plaus.err_info_stat.lv_ready fmy_stat_crk_plaus.err_info_stat.lv_end_diag fmy_stat_crk_plaus.err_info_stat.lv_cdn_diag fmy_stat_crk_plaus.err_info_stat.err_sym fmy_stat_plaus_cam_in_1.ctr_abc fmy_stat_plaus_cam_in_1.ctr_end_diag fmy_stat_plaus_cam_in_1.err_info_stat.lv_err_mem fmy_stat_plaus_cam_in_1.err_info_stat.lv_ready fmy_stat_plaus_cam_in_1.err_info_stat.lv_end_diag fmy_stat_plaus_cam_in_1.err_info_stat.lv_cdn_diag fmy_stat_plaus_cam_in_1.err_info_stat.err_sym fmy_stat_plaus_cam_ex_1.ctr_abc fmy_stat_plaus_cam_ex_1.ctr_end_diag fmy_stat_plaus_cam_ex_1.err_info_stat.lv_err_mem fmy_stat_plaus_cam_ex_1.err_info_stat.lv_ready fmy_stat_plaus_cam_ex_1.err_info_stat.lv_end_diag fmy_stat_plaus_cam_ex_1.err_info_stat.lv_cdn_diag fmy_stat_plaus_cam_ex_1.err_info_stat.err_sym fmy_stat_syn_crk_cam_in_1.ctr_abc fmy_stat_syn_crk_cam_in_1.ctr_end_diag fmy_stat_syn_crk_cam_in_1.err_info_stat.lv_err_mem fmy_stat_syn_crk_cam_in_1.err_info_stat.lv_ready fmy_stat_syn_crk_cam_in_1.err_info_stat.lv_end_diag fmy_stat_syn_crk_cam_in_1.err_info_stat.lv_cdn_diag fmy_stat_syn_crk_cam_in_1.err_info_stat.err_sym fmy_stat_syn_crk_cam_ex_1.ctr_abc fmy_stat_syn_crk_cam_ex_1.ctr_end_diag fmy_stat_syn_crk_cam_ex_1.err_info_stat.lv_err_mem fmy_stat_syn_crk_cam_ex_1.err_info_stat.lv_ready fmy_stat_syn_crk_cam_ex_1.err_info_stat.lv_end_diag fmy_stat_syn_crk_cam_ex_1.err_info_stat.lv_cdn_diag fmy_stat_syn_crk_cam_ex_1.err_info_stat.err_sym fmy_stat_tooth_off_in_1.ctr_abc fmy_stat_tooth_off_in_1.ctr_end_diag fmy_stat_tooth_off_in_1.err_info_stat.lv_err_mem fmy_stat_tooth_off_in_1.err_info_stat.lv_ready fmy_stat_tooth_off_in_1.err_info_stat.lv_end_diag fmy_stat_tooth_off_in_1.err_info_stat.lv_cdn_diag fmy_stat_tooth_off_in_1.err_info_stat.err_sym fmy_stat_tooth_off_ex_1.ctr_abc fmy_stat_tooth_off_ex_1.ctr_end_diag fmy_stat_tooth_off_ex_1.err_info_stat.lv_err_mem fmy_stat_tooth_off_ex_1.err_info_stat.lv_ready fmy_stat_tooth_off_ex_1.err_info_stat.lv_end_diag fmy_stat_tooth_off_ex_1.err_info_stat.lv_cdn_diag fmy_stat_tooth_off_ex_1.err_info_stat.err_sym fmy_stat_plaus_cam_in_2.ctr_abc fmy_stat_plaus_cam_in_2.ctr_end_diag fmy_stat_plaus_cam_in_2.err_info_stat.lv_err_mem fmy_stat_plaus_cam_in_2.err_info_stat.lv_ready fmy_stat_plaus_cam_in_2.err_info_stat.lv_end_diag fmy_stat_plaus_cam_in_2.err_info_stat.lv_cdn_diag fmy_stat_plaus_cam_in_2.err_info_stat.err_sym fmy_stat_plaus_cam_ex_2.ctr_abc fmy_stat_plaus_cam_ex_2.ctr_end_diag fmy_stat_plaus_cam_ex_2.err_info_stat.lv_err_mem fmy_stat_plaus_cam_ex_2.err_info_stat.lv_ready fmy_stat_plaus_cam_ex_2.err_info_stat.lv_end_diag fmy_stat_plaus_cam_ex_2.err_info_stat.lv_cdn_diag fmy_stat_plaus_cam_ex_2.err_info_stat.err_sym fmy_stat_syn_crk_cam_in_2.ctr_abc fmy_stat_syn_crk_cam_in_2.ctr_end_diag fmy_stat_syn_crk_cam_in_2.err_info_stat.lv_err_mem fmy_stat_syn_crk_cam_in_2.err_info_stat.lv_ready fmy_stat_syn_crk_cam_in_2.err_info_stat.lv_end_diag fmy_stat_syn_crk_cam_in_2.err_info_stat.lv_cdn_diag fmy_stat_syn_crk_cam_in_2.err_info_stat.err_sym fmy_stat_syn_crk_cam_ex_2.ctr_abc fmy_stat_syn_crk_cam_ex_2.ctr_end_diag fmy_stat_syn_crk_cam_ex_2.err_info_stat.lv_err_mem fmy_stat_syn_crk_cam_ex_2.err_info_stat.lv_ready fmy_stat_syn_crk_cam_ex_2.err_info_stat.lv_end_diag fmy_stat_syn_crk_cam_ex_2.err_info_stat.lv_cdn_diag fmy_stat_syn_crk_cam_ex_2.err_info_stat.err_sym fmy_stat_tooth_off_in_2.ctr_abc fmy_stat_tooth_off_in_2.ctr_end_diag fmy_stat_tooth_off_in_2.err_info_stat.lv_err_mem fmy_stat_tooth_off_in_2.err_info_stat.lv_ready fmy_stat_tooth_off_in_2.err_info_stat.lv_end_diag fmy_stat_tooth_off_in_2.err_info_stat.lv_cdn_diag fmy_stat_tooth_off_in_2.err_info_stat.err_sym fmy_stat_tooth_off_ex_2.ctr_abc fmy_stat_tooth_off_ex_2.ctr_end_diag fmy_stat_tooth_off_ex_2.err_info_stat.lv_err_mem fmy_stat_tooth_off_ex_2.err_info_stat.lv_ready fmy_stat_tooth_off_ex_2.err_info_stat.lv_end_diag fmy_stat_tooth_off_ex_2.err_info_stat.lv_cdn_diag fmy_stat_tooth_off_ex_2.err_info_stat.err_sym fmy_stat_can_boff.ctr_abc fmy_stat_can_boff.ctr_end_diag fmy_stat_can_boff.err_info_stat.lv_err_mem fmy_stat_can_boff.err_info_stat.lv_ready fmy_stat_can_boff.err_info_stat.lv_end_diag fmy_stat_can_boff.err_info_stat.lv_cdn_diag fmy_stat_can_boff.err_info_stat.err_sym fmy_stat_rly_main.ctr_abc fmy_stat_rly_main.ctr_end_diag fmy_stat_rly_main.err_info_stat.lv_err_mem fmy_stat_rly_main.err_info_stat.lv_ready fmy_stat_rly_main.err_info_stat.lv_end_diag fmy_stat_rly_main.err_info_stat.lv_cdn_diag fmy_stat_rly_main.err_info_stat.err_sym fmy_stat_rly_main_dly.ctr_abc fmy_stat_rly_main_dly.ctr_end_diag fmy_stat_rly_main_dly.err_info_stat.lv_err_mem fmy_stat_rly_main_dly.err_info_stat.lv_ready fmy_stat_rly_main_dly.err_info_stat.lv_end_diag fmy_stat_rly_main_dly.err_info_stat.lv_cdn_diag fmy_stat_rly_main_dly.err_info_stat.err_sym fmy_stat_rly_accout.ctr_abc fmy_stat_rly_accout.ctr_end_diag fmy_stat_rly_accout.err_info_stat.lv_err_mem fmy_stat_rly_accout.err_info_stat.lv_ready fmy_stat_rly_accout.err_info_stat.lv_end_diag fmy_stat_rly_accout.err_info_stat.lv_cdn_diag fmy_stat_rly_accout.err_info_stat.err_sym fmy_stat_isc.ctr_abc fmy_stat_isc.ctr_end_diag fmy_stat_isc.err_info_stat.lv_err_mem fmy_stat_isc.err_info_stat.lv_ready fmy_stat_isc.err_info_stat.lv_end_diag fmy_stat_isc.err_info_stat.lv_cdn_diag fmy_stat_isc.err_info_stat.err_sym fmy_stat_isc_cst.ctr_abc fmy_stat_isc_cst.ctr_end_diag fmy_stat_isc_cst.err_info_stat.lv_err_mem fmy_stat_isc_cst.err_info_stat.lv_ready fmy_stat_isc_cst.err_info_stat.lv_end_diag fmy_stat_isc_cst.err_info_stat.lv_cdn_diag fmy_stat_isc_cst.err_info_stat.err_sym fmy_stat_im_bls_plaus.ctr_abc fmy_stat_im_bls_plaus.ctr_end_diag fmy_stat_im_bls_plaus.err_info_stat.lv_err_mem fmy_stat_im_bls_plaus.err_info_stat.lv_ready fmy_stat_im_bls_plaus.err_info_stat.lv_end_diag fmy_stat_im_bls_plaus.err_info_stat.lv_cdn_diag fmy_stat_im_bls_plaus.err_info_stat.err_sym fmy_stat_im_bts_plaus.ctr_abc fmy_stat_im_bts_plaus.ctr_end_diag fmy_stat_im_bts_plaus.err_info_stat.lv_err_mem fmy_stat_im_bts_plaus.err_info_stat.lv_ready fmy_stat_im_bts_plaus.err_info_stat.lv_end_diag fmy_stat_im_bts_plaus.err_info_stat.lv_cdn_diag fmy_stat_im_bts_plaus.err_info_stat.err_sym fmy_stat_msw_tog.ctr_abc fmy_stat_msw_tog.ctr_end_diag fmy_stat_msw_tog.err_info_stat.lv_err_mem /end OUT_MEASUREMENT
/end FUNCTION
/end MODULE
/end PROJECT
