ASAP2_VERSION 1 30
/begin PROJECT MSS65-ign "Generiert am 14.10.05 um 09:57:47"
/begin HEADER "" VERSION "R341" /end HEADER
/begin MODULE _MSS65-ign "Generiert am 14.10.05 um 09:57:47"
/begin MOD_COMMON "" BYTE_ORDER MSB_FIRST ALIGNMENT_BYTE 1 ALIGNMENT_WORD 2 ALIGNMENT_LONG 4 ALIGNMENT_FLOAT32_IEEE 4 ALIGNMENT_FLOAT64_IEEE 8 /end MOD_COMMON
/begin MEASUREMENT ed_fil_auss_kat_z3.filter_nv "Filterwert vor und nach Eintrag" UBYTE FORMULA_0003 0 0.0 0.0 255.0 READ_WRITE ECU_ADDRESS 0x3F9482 /end MEASUREMENT
/begin MEASUREMENT ed_fil_auss_kat_z3.zyklus_filter_nv "Vorwaertsfilter zur Fehlerzustandsbestaetigung" UBYTE FORMULA_0003 0 0.0 0.0 255.0 READ_WRITE ECU_ADDRESS 0x3F9483 /end MEASUREMENT
/begin MEASUREMENT ed_fil_auss_kat_z4.art_aktuell_nv "Fehlerart und Statusbits" UWORD FORMULA_0052 0 0.0 0.0 65535.0 READ_WRITE BIT_MASK 0xB4F ECU_ADDRESS 0x3F948A /end MEASUREMENT
/begin MEASUREMENT ed_fil_auss_kat_z4.fehler_aufrufe_nv "Gesamtzahl der Fehleraufrufe" UBYTE FORMULA_0003 0 0.0 0.0 255.0 READ_WRITE ECU_ADDRESS 0x3F948D /end MEASUREMENT
/begin MEASUREMENT ed_fil_auss_kat_z4.filter_max_nv "Maximaler Fehlerfilterwert" UBYTE FORMULA_0003 0 0.0 0.0 255.0 READ_WRITE ECU_ADDRESS 0x3F948C /end MEASUREMENT
/begin MEASUREMENT ed_fil_auss_kat_z4.filter_nv "Filterwert vor und nach Eintrag" UBYTE FORMULA_0003 0 0.0 0.0 255.0 READ_WRITE ECU_ADDRESS 0x3F9488 /end MEASUREMENT
/begin MEASUREMENT ed_fil_auss_kat_z4.zyklus_filter_nv "Vorwaertsfilter zur Fehlerzustandsbestaetigung" UBYTE FORMULA_0003 0 0.0 0.0 255.0 READ_WRITE ECU_ADDRESS 0x3F9489 /end MEASUREMENT
/begin MEASUREMENT ed_fil_auss_kat_z5.art_aktuell_nv "Fehlerart und Statusbits" UWORD FORMULA_0052 0 0.0 0.0 65535.0 READ_WRITE BIT_MASK 0xB4F ECU_ADDRESS 0x3F9490 /end MEASUREMENT
/begin MEASUREMENT ed_fil_auss_kat_z5.fehler_aufrufe_nv "Gesamtzahl der Fehleraufrufe" UBYTE FORMULA_0003 0 0.0 0.0 255.0 READ_WRITE ECU_ADDRESS 0x3F9493 /end MEASUREMENT
/begin MEASUREMENT ed_fil_auss_kat_z5.filter_max_nv "Maximaler Fehlerfilterwert" UBYTE FORMULA_0003 0 0.0 0.0 255.0 READ_WRITE ECU_ADDRESS 0x3F9492 /end MEASUREMENT
/begin MEASUREMENT ed_fil_auss_kat_z5.filter_nv "Filterwert vor und nach Eintrag" UBYTE FORMULA_0003 0 0.0 0.0 255.0 READ_WRITE ECU_ADDRESS 0x3F948E /end MEASUREMENT
/begin MEASUREMENT ed_fil_auss_kat_z5.zyklus_filter_nv "Vorwaertsfilter zur Fehlerzustandsbestaetigung" UBYTE FORMULA_0003 0 0.0 0.0 255.0 READ_WRITE ECU_ADDRESS 0x3F948F /end MEASUREMENT
/begin MEASUREMENT ed_fil_auss_kat_z6.art_aktuell_nv "Fehlerart und Statusbits" UWORD FORMULA_0052 0 0.0 0.0 65535.0 READ_WRITE BIT_MASK 0xB4F ECU_ADDRESS 0x3F9496 /end MEASUREMENT
/begin MEASUREMENT ed_fil_auss_kat_z6.fehler_aufrufe_nv "Gesamtzahl der Fehleraufrufe" UBYTE FORMULA_0003 0 0.0 0.0 255.0 READ_WRITE ECU_ADDRESS 0x3F9499 /end MEASUREMENT
/begin MEASUREMENT ed_fil_auss_kat_z6.filter_max_nv "Maximaler Fehlerfilterwert" UBYTE FORMULA_0003 0 0.0 0.0 255.0 READ_WRITE ECU_ADDRESS 0x3F9498 /end MEASUREMENT
/begin MEASUREMENT ed_fil_auss_kat_z6.filter_nv "Filterwert vor und nach Eintrag" UBYTE FORMULA_0003 0 0.0 0.0 255.0 READ_WRITE ECU_ADDRESS 0x3F9494 /end MEASUREMENT
/begin MEASUREMENT ed_fil_auss_kat_z6.zyklus_filter_nv "Vorwaertsfilter zur Fehlerzustandsbestaetigung" UBYTE FORMULA_0003 0 0.0 0.0 255.0 READ_WRITE ECU_ADDRESS 0x3F9495 /end MEASUREMENT
/begin MEASUREMENT ed_fil_auss_kat_z7.art_aktuell_nv "Fehlerart und Statusbits" UWORD FORMULA_0052 0 0.0 0.0 65535.0 READ_WRITE BIT_MASK 0xB4F ECU_ADDRESS 0x3F949C /end MEASUREMENT
/begin MEASUREMENT ed_fil_auss_kat_z7.fehler_aufrufe_nv "Gesamtzahl der Fehleraufrufe" UBYTE FORMULA_0003 0 0.0 0.0 255.0 READ_WRITE ECU_ADDRESS 0x3F949F /end MEASUREMENT
/begin MEASUREMENT ed_fil_auss_kat_z7.filter_max_nv "Maximaler Fehlerfilterwert" UBYTE FORMULA_0003 0 0.0 0.0 255.0 READ_WRITE ECU_ADDRESS 0x3F949E /end MEASUREMENT
/begin MEASUREMENT ed_fil_auss_kat_z7.filter_nv "Filterwert vor und nach Eintrag" UBYTE FORMULA_0003 0 0.0 0.0 255.0 READ_WRITE ECU_ADDRESS 0x3F949A /end MEASUREMENT
/begin MEASUREMENT ed_fil_auss_kat_z7.zyklus_filter_nv "Vorwaertsfilter zur Fehlerzustandsbestaetigung" UBYTE FORMULA_0003 0 0.0 0.0 255.0 READ_WRITE ECU_ADDRESS 0x3F949B /end MEASUREMENT
/begin MEASUREMENT ed_fil_auss_kat_z8.art_aktuell_nv "Fehlerart und Statusbits" UWORD FORMULA_0052 0 0.0 0.0 65535.0 READ_WRITE BIT_MASK 0xB4F ECU_ADDRESS 0x3F94A2 /end MEASUREMENT
/begin MEASUREMENT ed_fil_auss_kat_z8.fehler_aufrufe_nv "Gesamtzahl der Fehleraufrufe" UBYTE FORMULA_0003 0 0.0 0.0 255.0 READ_WRITE ECU_ADDRESS 0x3F94A5 /end MEASUREMENT
/begin MEASUREMENT ed_fil_auss_kat_z8.filter_max_nv "Maximaler Fehlerfilterwert" UBYTE FORMULA_0003 0 0.0 0.0 255.0 READ_WRITE ECU_ADDRESS 0x3F94A4 /end MEASUREMENT
/begin MEASUREMENT ed_fil_auss_kat_z8.filter_nv "Filterwert vor und nach Eintrag" UBYTE FORMULA_0003 0 0.0 0.0 255.0 READ_WRITE ECU_ADDRESS 0x3F94A0 /end MEASUREMENT
/begin MEASUREMENT ed_fil_auss_kat_z8.zyklus_filter_nv "Vorwaertsfilter zur Fehlerzustandsbestaetigung" UBYTE FORMULA_0003 0 0.0 0.0 255.0 READ_WRITE ECU_ADDRESS 0x3F94A1 /end MEASUREMENT
/begin MEASUREMENT ed_fil_auss_kat_z9.art_aktuell_nv "Fehlerart und Statusbits" UWORD FORMULA_0052 0 0.0 0.0 65535.0 READ_WRITE BIT_MASK 0xB4F ECU_ADDRESS 0x3F94A8 /end MEASUREMENT
/begin MEASUREMENT ed_fil_auss_kat_z9.fehler_aufrufe_nv "Gesamtzahl der Fehleraufrufe" UBYTE FORMULA_0003 0 0.0 0.0 255.0 READ_WRITE ECU_ADDRESS 0x3F94AB /end MEASUREMENT
/begin MEASUREMENT ed_fil_auss_kat_z9.filter_max_nv "Maximaler Fehlerfilterwert" UBYTE FORMULA_0003 0 0.0 0.0 255.0 READ_WRITE ECU_ADDRESS 0x3F94AA /end MEASUREMENT
/begin MEASUREMENT ed_fil_auss_kat_z9.filter_nv "Filterwert vor und nach Eintrag" UBYTE FORMULA_0003 0 0.0 0.0 255.0 READ_WRITE ECU_ADDRESS 0x3F94A6 /end MEASUREMENT
/begin MEASUREMENT ed_fil_auss_kat_z9.zyklus_filter_nv "Vorwaertsfilter zur Fehlerzustandsbestaetigung" UBYTE FORMULA_0003 0 0.0 0.0 255.0 READ_WRITE ECU_ADDRESS 0x3F94A7 /end MEASUREMENT
/begin MEASUREMENT ed_fil_bls_plau.art_aktuell_nv "Fehlerart und Statusbits" UWORD FORMULA_0052 0 0.0 0.0 65535.0 READ_WRITE BIT_MASK 0xB4F ECU_ADDRESS 0x3F953E /end MEASUREMENT
/begin MEASUREMENT ed_fil_bls_plau.fehler_aufrufe_nv "Gesamtzahl der Fehleraufrufe" UBYTE FORMULA_0003 0 0.0 0.0 255.0 READ_WRITE ECU_ADDRESS 0x3F9541 /end MEASUREMENT
/begin MEASUREMENT ed_fil_bls_plau.filter_max_nv "Maximaler Fehlerfilterwert" UBYTE FORMULA_0003 0 0.0 0.0 255.0 READ_WRITE ECU_ADDRESS 0x3F9540 /end MEASUREMENT
/begin MEASUREMENT ed_fil_bls_plau.filter_nv "Filterwert vor und nach Eintrag" UBYTE FORMULA_0003 0 0.0 0.0 255.0 READ_WRITE ECU_ADDRESS 0x3F953C /end MEASUREMENT
/begin MEASUREMENT ed_fil_bls_plau.zyklus_filter_nv "Vorwaertsfilter zur Fehlerzustandsbestaetigung" UBYTE FORMULA_0003 0 0.0 0.0 255.0 READ_WRITE ECU_ADDRESS 0x3F953D /end MEASUREMENT
/begin MEASUREMENT ed_fil_dk_init.art_aktuell_nv "Fehlerart und Statusbits" UWORD FORMULA_0052 0 0.0 0.0 65535.0 READ_WRITE BIT_MASK 0xB4F ECU_ADDRESS 0x3F93B2 /end MEASUREMENT
/begin MEASUREMENT ed_fil_dk_init.fehler_aufrufe_nv "Gesamtzahl der Fehleraufrufe" UBYTE FORMULA_0003 0 0.0 0.0 255.0 READ_WRITE ECU_ADDRESS 0x3F93B5 /end MEASUREMENT
/begin MEASUREMENT ed_fil_dk_init.filter_max_nv "Maximaler Fehlerfilterwert" UBYTE FORMULA_0003 0 0.0 0.0 255.0 READ_WRITE ECU_ADDRESS 0x3F93B4 /end MEASUREMENT
/begin MEASUREMENT ed_fil_dk_init.filter_nv "Filterwert vor und nach Eintrag" UBYTE FORMULA_0003 0 0.0 0.0 255.0 READ_WRITE ECU_ADDRESS 0x3F93B0 /end MEASUREMENT
/begin MEASUREMENT ed_fil_dk_init.zyklus_filter_nv "Vorwaertsfilter zur Fehlerzustandsbestaetigung" UBYTE FORMULA_0003 0 0.0 0.0 255.0 READ_WRITE ECU_ADDRESS 0x3F93B1 /end MEASUREMENT
/begin MEASUREMENT ed_fil_dk1_adapt.art_aktuell_nv "Fehlerart und Statusbits" UWORD FORMULA_0052 0 0.0 0.0 65535.0 READ_WRITE BIT_MASK 0xB4F ECU_ADDRESS 0x3F93C4 /end MEASUREMENT
/begin MEASUREMENT ed_fil_dk1_adapt.fehler_aufrufe_nv "Gesamtzahl der Fehleraufrufe" UBYTE FORMULA_0003 0 0.0 0.0 255.0 READ_WRITE ECU_ADDRESS 0x3F93C7 /end MEASUREMENT
/begin MEASUREMENT ed_fil_dk1_adapt.filter_max_nv "Maximaler Fehlerfilterwert" UBYTE FORMULA_0003 0 0.0 0.0 255.0 READ_WRITE ECU_ADDRESS 0x3F93C6 /end MEASUREMENT
/begin MEASUREMENT ed_fil_dk1_adapt.filter_nv "Filterwert vor und nach Eintrag" UBYTE FORMULA_0003 0 0.0 0.0 255.0 READ_WRITE ECU_ADDRESS 0x3F93C2 /end MEASUREMENT
/begin MEASUREMENT ed_fil_dk1_adapt.zyklus_filter_nv "Vorwaertsfilter zur Fehlerzustandsbestaetigung" UBYTE FORMULA_0003 0 0.0 0.0 255.0 READ_WRITE ECU_ADDRESS 0x3F93C3 /end MEASUREMENT
/begin MEASUREMENT ed_fil_dk1_can.art_aktuell_nv "Fehlerart und Statusbits" UWORD FORMULA_0052 0 0.0 0.0 65535.0 READ_WRITE BIT_MASK 0xB4F ECU_ADDRESS 0x3F937C /end MEASUREMENT
/begin MEASUREMENT ed_fil_dk1_can.fehler_aufrufe_nv "Gesamtzahl der Fehleraufrufe" UBYTE FORMULA_0003 0 0.0 0.0 255.0 READ_WRITE ECU_ADDRESS 0x3F937F /end MEASUREMENT
/begin MEASUREMENT ed_fil_dk1_can.filter_max_nv "Maximaler Fehlerfilterwert" UBYTE FORMULA_0003 0 0.0 0.0 255.0 READ_WRITE ECU_ADDRESS 0x3F937E /end MEASUREMENT
/begin MEASUREMENT ed_fil_dk1_can.filter_nv "Filterwert vor und nach Eintrag" UBYTE FORMULA_0003 0 0.0 0.0 255.0 READ_WRITE ECU_ADDRESS 0x3F937A /end MEASUREMENT
/begin MEASUREMENT ed_fil_dk1_can.zyklus_filter_nv "Vorwaertsfilter zur Fehlerzustandsbestaetigung" UBYTE FORMULA_0003 0 0.0 0.0 255.0 READ_WRITE ECU_ADDRESS 0x3F937B /end MEASUREMENT
/begin MEASUREMENT ed_fil_dk1_cmd.art_aktuell_nv "Fehlerart und Statusbits" UWORD FORMULA_0052 0 0.0 0.0 65535.0 READ_WRITE BIT_MASK 0xB4F ECU_ADDRESS 0x3F9442 /end MEASUREMENT
/begin MEASUREMENT ed_fil_dk1_cmd.fehler_aufrufe_nv "Gesamtzahl der Fehleraufrufe" UBYTE FORMULA_0003 0 0.0 0.0 255.0 READ_WRITE ECU_ADDRESS 0x3F9445 /end MEASUREMENT
/begin MEASUREMENT ed_fil_dk1_cmd.filter_max_nv "Maximaler Fehlerfilterwert" UBYTE FORMULA_0003 0 0.0 0.0 255.0 READ_WRITE ECU_ADDRESS 0x3F9444 /end MEASUREMENT
/begin MEASUREMENT ed_fil_dk1_cmd.filter_nv "Filterwert vor und nach Eintrag" UBYTE FORMULA_0003 0 0.0 0.0 255.0 READ_WRITE ECU_ADDRESS 0x3F9440 /end MEASUREMENT
/begin MEASUREMENT ed_fil_dk1_cmd.zyklus_filter_nv "Vorwaertsfilter zur Fehlerzustandsbestaetigung" UBYTE FORMULA_0003 0 0.0 0.0 255.0 READ_WRITE ECU_ADDRESS 0x3F9441 /end MEASUREMENT
/begin MEASUREMENT ed_fil_dk1_federn.art_aktuell_nv "Fehlerart und Statusbits" UWORD FORMULA_0052 0 0.0 0.0 65535.0 READ_WRITE BIT_MASK 0xB4F ECU_ADDRESS 0x3F9424 /end MEASUREMENT
/begin MEASUREMENT ed_fil_dk1_federn.fehler_aufrufe_nv "Gesamtzahl der Fehleraufrufe" UBYTE FORMULA_0003 0 0.0 0.0 255.0 READ_WRITE ECU_ADDRESS 0x3F9427 /end MEASUREMENT
/begin MEASUREMENT ed_fil_dk1_federn.filter_max_nv "Maximaler Fehlerfilterwert" UBYTE FORMULA_0003 0 0.0 0.0 255.0 READ_WRITE ECU_ADDRESS 0x3F9426 /end MEASUREMENT
/begin MEASUREMENT ed_fil_dk1_federn.filter_nv "Filterwert vor und nach Eintrag" UBYTE FORMULA_0003 0 0.0 0.0 255.0 READ_WRITE ECU_ADDRESS 0x3F9422 /end MEASUREMENT
/begin MEASUREMENT ed_fil_dk1_federn.zyklus_filter_nv "Vorwaertsfilter zur Fehlerzustandsbestaetigung" UBYTE FORMULA_0003 0 0.0 0.0 255.0 READ_WRITE ECU_ADDRESS 0x3F9423 /end MEASUREMENT
/begin MEASUREMENT ed_fil_dk1_pdr.art_aktuell_nv "Fehlerart und Statusbits" UWORD FORMULA_0052 0 0.0 0.0 65535.0 READ_WRITE BIT_MASK 0xB4F ECU_ADDRESS 0x3F9400 /end MEASUREMENT
/begin MEASUREMENT ed_fil_dk1_pdr.fehler_aufrufe_nv "Gesamtzahl der Fehleraufrufe" UBYTE FORMULA_0003 0 0.0 0.0 255.0 READ_WRITE ECU_ADDRESS 0x3F9403 /end MEASUREMENT
/begin MEASUREMENT ed_fil_dk1_pdr.filter_max_nv "Maximaler Fehlerfilterwert" UBYTE FORMULA_0003 0 0.0 0.0 255.0 READ_WRITE ECU_ADDRESS 0x3F9402 /end MEASUREMENT
/begin MEASUREMENT ed_fil_dk1_pdr.filter_nv "Filterwert vor und nach Eintrag" UBYTE FORMULA_0003 0 0.0 0.0 255.0 READ_WRITE ECU_ADDRESS 0x3F93FE /end MEASUREMENT
/begin MEASUREMENT ed_fil_dk1_pdr.zyklus_filter_nv "Vorwaertsfilter zur Fehlerzustandsbestaetigung" UBYTE FORMULA_0003 0 0.0 0.0 255.0 READ_WRITE ECU_ADDRESS 0x3F93FF /end MEASUREMENT
/begin MEASUREMENT ed_fil_dk1_regler.art_aktuell_nv "Fehlerart und Statusbits" UWORD FORMULA_0052 0 0.0 0.0 65535.0 READ_WRITE BIT_MASK 0xB4F ECU_ADDRESS 0x3F93B8 /end MEASUREMENT
/begin MEASUREMENT ed_fil_dk1_regler.fehler_aufrufe_nv "Gesamtzahl der Fehleraufrufe" UBYTE FORMULA_0003 0 0.0 0.0 255.0 READ_WRITE ECU_ADDRESS 0x3F93BB /end MEASUREMENT
/begin MEASUREMENT ed_fil_dk1_regler.filter_max_nv "Maximaler Fehlerfilterwert" UBYTE FORMULA_0003 0 0.0 0.0 255.0 READ_WRITE ECU_ADDRESS 0x3F93BA /end MEASUREMENT
/begin MEASUREMENT ed_fil_dk1_regler.filter_nv "Filterwert vor und nach Eintrag" UBYTE FORMULA_0003 0 0.0 0.0 255.0 READ_WRITE ECU_ADDRESS 0x3F93B6 /end MEASUREMENT
/begin MEASUREMENT ed_fil_dk1_regler.zyklus_filter_nv "Vorwaertsfilter zur Fehlerzustandsbestaetigung" UBYTE FORMULA_0003 0 0.0 0.0 255.0 READ_WRITE ECU_ADDRESS 0x3F93B7 /end MEASUREMENT
/begin MEASUREMENT ed_fil_dk1_sk_err.art_aktuell_nv "Fehlerart und Statusbits" UWORD FORMULA_0052 0 0.0 0.0 65535.0 READ_WRITE BIT_MASK 0xB4F ECU_ADDRESS 0x3F9418 /end MEASUREMENT
/begin MEASUREMENT ed_fil_dk1_sk_err.fehler_aufrufe_nv "Gesamtzahl der Fehleraufrufe" UBYTE FORMULA_0003 0 0.0 0.0 255.0 READ_WRITE ECU_ADDRESS 0x3F941B /end MEASUREMENT
/begin MEASUREMENT ed_fil_dk1_sk_err.filter_max_nv "Maximaler Fehlerfilterwert" UBYTE FORMULA_0003 0 0.0 0.0 255.0 READ_WRITE ECU_ADDRESS 0x3F941A /end MEASUREMENT
/begin MEASUREMENT ed_fil_dk1_sk_err.filter_nv "Filterwert vor und nach Eintrag" UBYTE FORMULA_0003 0 0.0 0.0 255.0 READ_WRITE ECU_ADDRESS 0x3F9416 /end MEASUREMENT
/begin MEASUREMENT ed_fil_dk1_sk_err.zyklus_filter_nv "Vorwaertsfilter zur Fehlerzustandsbestaetigung" UBYTE FORMULA_0003 0 0.0 0.0 255.0 READ_WRITE ECU_ADDRESS 0x3F9417 /end MEASUREMENT
/begin MEASUREMENT ed_fil_dk1_wdk.art_aktuell_nv "Fehlerart und Statusbits" UWORD FORMULA_0052 0 0.0 0.0 65535.0 READ_WRITE BIT_MASK 0xB4F ECU_ADDRESS 0x3F93F4 /end MEASUREMENT
/begin MEASUREMENT ed_fil_dk1_wdk.fehler_aufrufe_nv "Gesamtzahl der Fehleraufrufe" UBYTE FORMULA_0003 0 0.0 0.0 255.0 READ_WRITE ECU_ADDRESS 0x3F93F7 /end MEASUREMENT
/begin MEASUREMENT ed_fil_dk1_wdk.filter_max_nv "Maximaler Fehlerfilterwert" UBYTE FORMULA_0003 0 0.0 0.0 255.0 READ_WRITE ECU_ADDRESS 0x3F93F6 /end MEASUREMENT
/begin MEASUREMENT ed_fil_dk1_wdk.filter_nv "Filterwert vor und nach Eintrag" UBYTE FORMULA_0003 0 0.0 0.0 255.0 READ_WRITE ECU_ADDRESS 0x3F93F2 /end MEASUREMENT
/begin MEASUREMENT ed_fil_dk1_wdk.zyklus_filter_nv "Vorwaertsfilter zur Fehlerzustandsbestaetigung" UBYTE FORMULA_0003 0 0.0 0.0 255.0 READ_WRITE ECU_ADDRESS 0x3F93F3 /end MEASUREMENT
/begin MEASUREMENT ed_fil_dk1_zust.art_aktuell_nv "Fehlerart und Statusbits" UWORD FORMULA_0052 0 0.0 0.0 65535.0 READ_WRITE BIT_MASK 0xB4F ECU_ADDRESS 0x3F955C /end MEASUREMENT
/begin MEASUREMENT ed_fil_dk1_zust.fehler_aufrufe_nv "Gesamtzahl der Fehleraufrufe" UBYTE FORMULA_0003 0 0.0 0.0 255.0 READ_WRITE ECU_ADDRESS 0x3F955F /end MEASUREMENT
/begin MEASUREMENT ed_fil_dk1_zust.filter_max_nv "Maximaler Fehlerfilterwert" UBYTE FORMULA_0003 0 0.0 0.0 255.0 READ_WRITE ECU_ADDRESS 0x3F955E /end MEASUREMENT
/begin MEASUREMENT ed_fil_dk1_zust.filter_nv "Filterwert vor und nach Eintrag" UBYTE FORMULA_0003 0 0.0 0.0 255.0 READ_WRITE ECU_ADDRESS 0x3F955A /end MEASUREMENT
/begin MEASUREMENT ed_fil_dk1_zust.zyklus_filter_nv "Vorwaertsfilter zur Fehlerzustandsbestaetigung" UBYTE FORMULA_0003 0 0.0 0.0 255.0 READ_WRITE ECU_ADDRESS 0x3F955B /end MEASUREMENT
/begin MEASUREMENT ed_fil_dk2_adapt.art_aktuell_nv "Fehlerart und Statusbits" UWORD FORMULA_0052 0 0.0 0.0 65535.0 READ_WRITE BIT_MASK 0xB4F ECU_ADDRESS 0x3F93CA /end MEASUREMENT
/begin MEASUREMENT ed_fil_dk2_adapt.fehler_aufrufe_nv "Gesamtzahl der Fehleraufrufe" UBYTE FORMULA_0003 0 0.0 0.0 255.0 READ_WRITE ECU_ADDRESS 0x3F93CD /end MEASUREMENT
/begin MEASUREMENT ed_fil_dk2_adapt.filter_max_nv "Maximaler Fehlerfilterwert" UBYTE FORMULA_0003 0 0.0 0.0 255.0 READ_WRITE ECU_ADDRESS 0x3F93CC /end MEASUREMENT
/begin MEASUREMENT ed_fil_dk2_adapt.filter_nv "Filterwert vor und nach Eintrag" UBYTE FORMULA_0003 0 0.0 0.0 255.0 READ_WRITE ECU_ADDRESS 0x3F93C8 /end MEASUREMENT
/begin MEASUREMENT ed_fil_dk2_adapt.zyklus_filter_nv "Vorwaertsfilter zur Fehlerzustandsbestaetigung" UBYTE FORMULA_0003 0 0.0 0.0 255.0 READ_WRITE ECU_ADDRESS 0x3F93C9 /end MEASUREMENT
/begin MEASUREMENT ed_fil_dk2_can.art_aktuell_nv "Fehlerart und Statusbits" UWORD FORMULA_0052 0 0.0 0.0 65535.0 READ_WRITE BIT_MASK 0xB4F ECU_ADDRESS 0x3F9382 /end MEASUREMENT
/begin MEASUREMENT ed_fil_dk2_can.fehler_aufrufe_nv "Gesamtzahl der Fehleraufrufe" UBYTE FORMULA_0003 0 0.0 0.0 255.0 READ_WRITE ECU_ADDRESS 0x3F9385 /end MEASUREMENT
/begin MEASUREMENT ed_fil_dk2_can.filter_max_nv "Maximaler Fehlerfilterwert" UBYTE FORMULA_0003 0 0.0 0.0 255.0 READ_WRITE ECU_ADDRESS 0x3F9384 /end MEASUREMENT
/begin MEASUREMENT ed_fil_dk2_can.filter_nv "Filterwert vor und nach Eintrag" UBYTE FORMULA_0003 0 0.0 0.0 255.0 READ_WRITE ECU_ADDRESS 0x3F9380 /end MEASUREMENT
/begin MEASUREMENT ed_fil_dk2_can.zyklus_filter_nv "Vorwaertsfilter zur Fehlerzustandsbestaetigung" UBYTE FORMULA_0003 0 0.0 0.0 255.0 READ_WRITE ECU_ADDRESS 0x3F9381 /end MEASUREMENT
/begin MEASUREMENT ed_fil_dk2_cmd.art_aktuell_nv "Fehlerart und Statusbits" UWORD FORMULA_0052 0 0.0 0.0 65535.0 READ_WRITE BIT_MASK 0xB4F ECU_ADDRESS 0x3F9448 /end MEASUREMENT
/begin MEASUREMENT ed_fil_dk2_cmd.fehler_aufrufe_nv "Gesamtzahl der Fehleraufrufe" UBYTE FORMULA_0003 0 0.0 0.0 255.0 READ_WRITE ECU_ADDRESS 0x3F944B /end MEASUREMENT
/begin MEASUREMENT ed_fil_dk2_cmd.filter_max_nv "Maximaler Fehlerfilterwert" UBYTE FORMULA_0003 0 0.0 0.0 255.0 READ_WRITE ECU_ADDRESS 0x3F944A /end MEASUREMENT
/begin MEASUREMENT ed_fil_dk2_cmd.filter_nv "Filterwert vor und nach Eintrag" UBYTE FORMULA_0003 0 0.0 0.0 255.0 READ_WRITE ECU_ADDRESS 0x3F9446 /end MEASUREMENT
/begin MEASUREMENT ed_fil_dk2_cmd.zyklus_filter_nv "Vorwaertsfilter zur Fehlerzustandsbestaetigung" UBYTE FORMULA_0003 0 0.0 0.0 255.0 READ_WRITE ECU_ADDRESS 0x3F9447 /end MEASUREMENT
/begin MEASUREMENT ed_fil_dk2_federn.art_aktuell_nv "Fehlerart und Statusbits" UWORD FORMULA_0052 0 0.0 0.0 65535.0 READ_WRITE BIT_MASK 0xB4F ECU_ADDRESS 0x3F942A /end MEASUREMENT
/begin MEASUREMENT ed_fil_dk2_federn.fehler_aufrufe_nv "Gesamtzahl der Fehleraufrufe" UBYTE FORMULA_0003 0 0.0 0.0 255.0 READ_WRITE ECU_ADDRESS 0x3F942D /end MEASUREMENT
/begin MEASUREMENT ed_fil_dk2_federn.filter_max_nv "Maximaler Fehlerfilterwert" UBYTE FORMULA_0003 0 0.0 0.0 255.0 READ_WRITE ECU_ADDRESS 0x3F942C /end MEASUREMENT
/begin MEASUREMENT ed_fil_dk2_federn.filter_nv "Filterwert vor und nach Eintrag" UBYTE FORMULA_0003 0 0.0 0.0 255.0 READ_WRITE ECU_ADDRESS 0x3F9428 /end MEASUREMENT
/begin MEASUREMENT ed_fil_dk2_federn.zyklus_filter_nv "Vorwaertsfilter zur Fehlerzustandsbestaetigung" UBYTE FORMULA_0003 0 0.0 0.0 255.0 READ_WRITE ECU_ADDRESS 0x3F9429 /end MEASUREMENT
/begin MEASUREMENT ed_fil_dk2_pdr.art_aktuell_nv "Fehlerart und Statusbits" UWORD FORMULA_0052 0 0.0 0.0 65535.0 READ_WRITE BIT_MASK 0xB4F ECU_ADDRESS 0x3F9406 /end MEASUREMENT
/begin MEASUREMENT ed_fil_dk2_pdr.fehler_aufrufe_nv "Gesamtzahl der Fehleraufrufe" UBYTE FORMULA_0003 0 0.0 0.0 255.0 READ_WRITE ECU_ADDRESS 0x3F9409 /end MEASUREMENT
/begin MEASUREMENT ed_fil_dk2_pdr.filter_max_nv "Maximaler Fehlerfilterwert" UBYTE FORMULA_0003 0 0.0 0.0 255.0 READ_WRITE ECU_ADDRESS 0x3F9408 /end MEASUREMENT
/begin MEASUREMENT ed_fil_dk2_pdr.filter_nv "Filterwert vor und nach Eintrag" UBYTE FORMULA_0003 0 0.0 0.0 255.0 READ_WRITE ECU_ADDRESS 0x3F9404 /end MEASUREMENT
/begin MEASUREMENT ed_fil_dk2_pdr.zyklus_filter_nv "Vorwaertsfilter zur Fehlerzustandsbestaetigung" UBYTE FORMULA_0003 0 0.0 0.0 255.0 READ_WRITE ECU_ADDRESS 0x3F9405 /end MEASUREMENT
/begin MEASUREMENT ed_fil_dk2_regler.art_aktuell_nv "Fehlerart und Statusbits" UWORD FORMULA_0052 0 0.0 0.0 65535.0 READ_WRITE BIT_MASK 0xB4F ECU_ADDRESS 0x3F93BE /end MEASUREMENT
/begin MEASUREMENT ed_fil_dk2_regler.fehler_aufrufe_nv "Gesamtzahl der Fehleraufrufe" UBYTE FORMULA_0003 0 0.0 0.0 255.0 READ_WRITE ECU_ADDRESS 0x3F93C1 /end MEASUREMENT
/begin MEASUREMENT ed_fil_dk2_regler.filter_max_nv "Maximaler Fehlerfilterwert" UBYTE FORMULA_0003 0 0.0 0.0 255.0 READ_WRITE ECU_ADDRESS 0x3F93C0 /end MEASUREMENT
/begin MEASUREMENT ed_fil_dk2_regler.filter_nv "Filterwert vor und nach Eintrag" UBYTE FORMULA_0003 0 0.0 0.0 255.0 READ_WRITE ECU_ADDRESS 0x3F93BC /end MEASUREMENT
/begin MEASUREMENT ed_fil_dk2_regler.zyklus_filter_nv "Vorwaertsfilter zur Fehlerzustandsbestaetigung" UBYTE FORMULA_0003 0 0.0 0.0 255.0 READ_WRITE ECU_ADDRESS 0x3F93BD /end MEASUREMENT
/begin MEASUREMENT ed_fil_dk2_sk_err.art_aktuell_nv "Fehlerart und Statusbits" UWORD FORMULA_0052 0 0.0 0.0 65535.0 READ_WRITE BIT_MASK 0xB4F ECU_ADDRESS 0x3F941E /end MEASUREMENT
/begin MEASUREMENT ed_fil_dk2_sk_err.fehler_aufrufe_nv "Gesamtzahl der Fehleraufrufe" UBYTE FORMULA_0003 0 0.0 0.0 255.0 READ_WRITE ECU_ADDRESS 0x3F9421 /end MEASUREMENT
/begin MEASUREMENT ed_fil_dk2_sk_err.filter_max_nv "Maximaler Fehlerfilterwert" UBYTE FORMULA_0003 0 0.0 0.0 255.0 READ_WRITE ECU_ADDRESS 0x3F9420 /end MEASUREMENT
/begin MEASUREMENT ed_fil_dk2_sk_err.filter_nv "Filterwert vor und nach Eintrag" UBYTE FORMULA_0003 0 0.0 0.0 255.0 READ_WRITE ECU_ADDRESS 0x3F941C /end MEASUREMENT
/begin MEASUREMENT ed_fil_dk2_sk_err.zyklus_filter_nv "Vorwaertsfilter zur Fehlerzustandsbestaetigung" UBYTE FORMULA_0003 0 0.0 0.0 255.0 READ_WRITE ECU_ADDRESS 0x3F941D /end MEASUREMENT
/begin MEASUREMENT ed_fil_dk2_wdk.art_aktuell_nv "Fehlerart und Statusbits" UWORD FORMULA_0052 0 0.0 0.0 65535.0 READ_WRITE BIT_MASK 0xB4F ECU_ADDRESS 0x3F93FA /end MEASUREMENT
/begin MEASUREMENT ed_fil_dk2_wdk.fehler_aufrufe_nv "Gesamtzahl der Fehleraufrufe" UBYTE FORMULA_0003 0 0.0 0.0 255.0 READ_WRITE ECU_ADDRESS 0x3F93FD /end MEASUREMENT
/begin MEASUREMENT ed_fil_dk2_wdk.filter_max_nv "Maximaler Fehlerfilterwert" UBYTE FORMULA_0003 0 0.0 0.0 255.0 READ_WRITE ECU_ADDRESS 0x3F93FC /end MEASUREMENT
/begin MEASUREMENT ed_fil_dk2_wdk.filter_nv "Filterwert vor und nach Eintrag" UBYTE FORMULA_0003 0 0.0 0.0 255.0 READ_WRITE ECU_ADDRESS 0x3F93F8 /end MEASUREMENT
/begin MEASUREMENT ed_fil_dk2_wdk.zyklus_filter_nv "Vorwaertsfilter zur Fehlerzustandsbestaetigung" UBYTE FORMULA_0003 0 0.0 0.0 255.0 READ_WRITE ECU_ADDRESS 0x3F93F9 /end MEASUREMENT
/begin MEASUREMENT ed_fil_dk2_zust.art_aktuell_nv "Fehlerart und Statusbits" UWORD FORMULA_0052 0 0.0 0.0 65535.0 READ_WRITE BIT_MASK 0xB4F ECU_ADDRESS 0x3F9562 /end MEASUREMENT
/begin MEASUREMENT ed_fil_dk2_zust.fehler_aufrufe_nv "Gesamtzahl der Fehleraufrufe" UBYTE FORMULA_0003 0 0.0 0.0 255.0 READ_WRITE ECU_ADDRESS 0x3F9565 /end MEASUREMENT
/begin MEASUREMENT ed_fil_dk2_zust.filter_max_nv "Maximaler Fehlerfilterwert" UBYTE FORMULA_0003 0 0.0 0.0 255.0 READ_WRITE ECU_ADDRESS 0x3F9564 /end MEASUREMENT
/begin MEASUREMENT ed_fil_dk2_zust.filter_nv "Filterwert vor und nach Eintrag" UBYTE FORMULA_0003 0 0.0 0.0 255.0 READ_WRITE ECU_ADDRESS 0x3F9560 /end MEASUREMENT
/begin MEASUREMENT ed_fil_dk2_zust.zyklus_filter_nv "Vorwaertsfilter zur Fehlerzustandsbestaetigung" UBYTE FORMULA_0003 0 0.0 0.0 255.0 READ_WRITE ECU_ADDRESS 0x3F9561 /end MEASUREMENT
/begin MEASUREMENT ed_fil_dkg_eingr.art_aktuell_nv "Fehlerart und Statusbits" UWORD FORMULA_0052 0 0.0 0.0 65535.0 READ_WRITE BIT_MASK 0xB4F ECU_ADDRESS 0x3F951A /end MEASUREMENT
/begin MEASUREMENT ed_fil_dkg_eingr.fehler_aufrufe_nv "Gesamtzahl der Fehleraufrufe" UBYTE FORMULA_0003 0 0.0 0.0 255.0 READ_WRITE ECU_ADDRESS 0x3F951D /end MEASUREMENT
/begin MEASUREMENT ed_fil_dkg_eingr.filter_max_nv "Maximaler Fehlerfilterwert" UBYTE FORMULA_0003 0 0.0 0.0 255.0 READ_WRITE ECU_ADDRESS 0x3F951C /end MEASUREMENT
/begin MEASUREMENT ed_fil_dkg_eingr.filter_nv "Filterwert vor und nach Eintrag" UBYTE FORMULA_0003 0 0.0 0.0 255.0 READ_WRITE ECU_ADDRESS 0x3F9518 /end MEASUREMENT
/begin MEASUREMENT ed_fil_dkg_eingr.zyklus_filter_nv "Vorwaertsfilter zur Fehlerzustandsbestaetigung" UBYTE FORMULA_0003 0 0.0 0.0 255.0 READ_WRITE ECU_ADDRESS 0x3F9519 /end MEASUREMENT
/begin MEASUREMENT ed_fil_dsc_eingr.art_aktuell_nv "Fehlerart und Statusbits" UWORD FORMULA_0052 0 0.0 0.0 65535.0 READ_WRITE BIT_MASK 0xB4F ECU_ADDRESS 0x3F943C /end MEASUREMENT
/begin MEASUREMENT ed_fil_dsc_eingr.fehler_aufrufe_nv "Gesamtzahl der Fehleraufrufe" UBYTE FORMULA_0003 0 0.0 0.0 255.0 READ_WRITE ECU_ADDRESS 0x3F943F /end MEASUREMENT
/begin MEASUREMENT ed_fil_dsc_eingr.filter_max_nv "Maximaler Fehlerfilterwert" UBYTE FORMULA_0003 0 0.0 0.0 255.0 READ_WRITE ECU_ADDRESS 0x3F943E /end MEASUREMENT
/begin MEASUREMENT ed_fil_dsc_eingr.filter_nv "Filterwert vor und nach Eintrag" UBYTE FORMULA_0003 0 0.0 0.0 255.0 READ_WRITE ECU_ADDRESS 0x3F943A /end MEASUREMENT
/begin MEASUREMENT ed_fil_dsc_eingr.zyklus_filter_nv "Vorwaertsfilter zur Fehlerzustandsbestaetigung" UBYTE FORMULA_0003 0 0.0 0.0 255.0 READ_WRITE ECU_ADDRESS 0x3F943B /end MEASUREMENT
/begin MEASUREMENT ed_fil_e2_ign.art_aktuell_nv "Fehlerart und Statusbits" UWORD FORMULA_0052 0 0.0 0.0 65535.0 READ_WRITE BIT_MASK 0xB4F ECU_ADDRESS 0x3F9538 /end MEASUREMENT
/begin MEASUREMENT ed_fil_e2_ign.fehler_aufrufe_nv "Gesamtzahl der Fehleraufrufe" UBYTE FORMULA_0003 0 0.0 0.0 255.0 READ_WRITE ECU_ADDRESS 0x3F953B /end MEASUREMENT
/begin MEASUREMENT ed_fil_e2_ign.filter_max_nv "Maximaler Fehlerfilterwert" UBYTE FORMULA_0003 0 0.0 0.0 255.0 READ_WRITE ECU_ADDRESS 0x3F953A /end MEASUREMENT
/begin MEASUREMENT ed_fil_e2_ign.filter_nv "Filterwert vor und nach Eintrag" UBYTE FORMULA_0003 0 0.0 0.0 255.0 READ_WRITE ECU_ADDRESS 0x3F9536 /end MEASUREMENT
/begin MEASUREMENT ed_fil_e2_ign.zyklus_filter_nv "Vorwaertsfilter zur Fehlerzustandsbestaetigung" UBYTE FORMULA_0003 0 0.0 0.0 255.0 READ_WRITE ECU_ADDRESS 0x3F9537 /end MEASUREMENT
/begin MEASUREMENT ed_fil_ec_busoff.art_aktuell_nv "Fehlerart und Statusbits" UWORD FORMULA_0052 0 0.0 0.0 65535.0 READ_WRITE BIT_MASK 0xB4F ECU_ADDRESS 0x3F9472 /end MEASUREMENT
/begin MEASUREMENT ed_fil_ec_busoff.fehler_aufrufe_nv "Gesamtzahl der Fehleraufrufe" UBYTE FORMULA_0003 0 0.0 0.0 255.0 READ_WRITE ECU_ADDRESS 0x3F9475 /end MEASUREMENT
/begin MEASUREMENT ed_fil_ec_busoff.filter_max_nv "Maximaler Fehlerfilterwert" UBYTE FORMULA_0003 0 0.0 0.0 255.0 READ_WRITE ECU_ADDRESS 0x3F9474 /end MEASUREMENT
/begin MEASUREMENT ed_fil_ec_busoff.filter_nv "Filterwert vor und nach Eintrag" UBYTE FORMULA_0003 0 0.0 0.0 255.0 READ_WRITE ECU_ADDRESS 0x3F9470 /end MEASUREMENT
/begin MEASUREMENT ed_fil_ec_busoff.zyklus_filter_nv "Vorwaertsfilter zur Fehlerzustandsbestaetigung" UBYTE FORMULA_0003 0 0.0 0.0 255.0 READ_WRITE ECU_ADDRESS 0x3F9471 /end MEASUREMENT
/begin MEASUREMENT ed_fil_fgr_abwurf.art_aktuell_nv "Fehlerart und Statusbits" UWORD FORMULA_0052 0 0.0 0.0 65535.0 READ_WRITE BIT_MASK 0xB4F ECU_ADDRESS 0x3F9568 /end MEASUREMENT
/begin MEASUREMENT ed_fil_fgr_abwurf.fehler_aufrufe_nv "Gesamtzahl der Fehleraufrufe" UBYTE FORMULA_0003 0 0.0 0.0 255.0 READ_WRITE ECU_ADDRESS 0x3F956B /end MEASUREMENT
/begin MEASUREMENT ed_fil_fgr_abwurf.filter_max_nv "Maximaler Fehlerfilterwert" UBYTE FORMULA_0003 0 0.0 0.0 255.0 READ_WRITE ECU_ADDRESS 0x3F956A /end MEASUREMENT
/begin MEASUREMENT ed_fil_fgr_abwurf.filter_nv "Filterwert vor und nach Eintrag" UBYTE FORMULA_0003 0 0.0 0.0 255.0 READ_WRITE ECU_ADDRESS 0x3F9566 /end MEASUREMENT
/begin MEASUREMENT ed_fil_fgr_abwurf.zyklus_filter_nv "Vorwaertsfilter zur Fehlerzustandsbestaetigung" UBYTE FORMULA_0003 0 0.0 0.0 255.0 READ_WRITE ECU_ADDRESS 0x3F9567 /end MEASUREMENT
/begin MEASUREMENT ed_fil_index_121_ign.art_aktuell_nv "Fehlerart und Statusbits" UWORD FORMULA_0052 0 0.0 0.0 65535.0 READ_WRITE BIT_MASK 0xB4F ECU_ADDRESS 0x3F95E0 /end MEASUREMENT
/begin MEASUREMENT ed_fil_index_121_ign.fehler_aufrufe_nv "Gesamtzahl der Fehleraufrufe" UBYTE FORMULA_0003 0 0.0 0.0 255.0 READ_WRITE ECU_ADDRESS 0x3F95E3 /end MEASUREMENT
/begin MEASUREMENT ed_fil_index_121_ign.filter_max_nv "Maximaler Fehlerfilterwert" UBYTE FORMULA_0003 0 0.0 0.0 255.0 READ_WRITE ECU_ADDRESS 0x3F95E2 /end MEASUREMENT
/begin MEASUREMENT ed_fil_index_121_ign.filter_nv "Filterwert vor und nach Eintrag" UBYTE FORMULA_0003 0 0.0 0.0 255.0 READ_WRITE ECU_ADDRESS 0x3F95DE /end MEASUREMENT
/begin MEASUREMENT ed_fil_index_121_ign.zyklus_filter_nv "Vorwaertsfilter zur Fehlerzustandsbestaetigung" UBYTE FORMULA_0003 0 0.0 0.0 255.0 READ_WRITE ECU_ADDRESS 0x3F95DF /end MEASUREMENT
/begin MEASUREMENT ed_fil_index_122_ign.art_aktuell_nv "Fehlerart und Statusbits" UWORD FORMULA_0052 0 0.0 0.0 65535.0 READ_WRITE BIT_MASK 0xB4F ECU_ADDRESS 0x3F95E6 /end MEASUREMENT
/begin MEASUREMENT ed_fil_index_122_ign.fehler_aufrufe_nv "Gesamtzahl der Fehleraufrufe" UBYTE FORMULA_0003 0 0.0 0.0 255.0 READ_WRITE ECU_ADDRESS 0x3F95E9 /end MEASUREMENT
/begin MEASUREMENT ed_fil_index_122_ign.filter_max_nv "Maximaler Fehlerfilterwert" UBYTE FORMULA_0003 0 0.0 0.0 255.0 READ_WRITE ECU_ADDRESS 0x3F95E8 /end MEASUREMENT
/begin MEASUREMENT ed_fil_index_122_ign.filter_nv "Filterwert vor und nach Eintrag" UBYTE FORMULA_0003 0 0.0 0.0 255.0 READ_WRITE ECU_ADDRESS 0x3F95E4 /end MEASUREMENT
/begin MEASUREMENT ed_fil_index_122_ign.zyklus_filter_nv "Vorwaertsfilter zur Fehlerzustandsbestaetigung" UBYTE FORMULA_0003 0 0.0 0.0 255.0 READ_WRITE ECU_ADDRESS 0x3F95E5 /end MEASUREMENT
/begin MEASUREMENT ed_fil_index_123_ign.art_aktuell_nv "Fehlerart und Statusbits" UWORD FORMULA_0052 0 0.0 0.0 65535.0 READ_WRITE BIT_MASK 0xB4F ECU_ADDRESS 0x3F95EC /end MEASUREMENT
/begin MEASUREMENT ed_fil_index_123_ign.fehler_aufrufe_nv "Gesamtzahl der Fehleraufrufe" UBYTE FORMULA_0003 0 0.0 0.0 255.0 READ_WRITE ECU_ADDRESS 0x3F95EF /end MEASUREMENT
/begin MEASUREMENT ed_fil_index_123_ign.filter_max_nv "Maximaler Fehlerfilterwert" UBYTE FORMULA_0003 0 0.0 0.0 255.0 READ_WRITE ECU_ADDRESS 0x3F95EE /end MEASUREMENT
/begin MEASUREMENT ed_fil_index_123_ign.filter_nv "Filterwert vor und nach Eintrag" UBYTE FORMULA_0003 0 0.0 0.0 255.0 READ_WRITE ECU_ADDRESS 0x3F95EA /end MEASUREMENT
/begin MEASUREMENT ed_fil_index_123_ign.zyklus_filter_nv "Vorwaertsfilter zur Fehlerzustandsbestaetigung" UBYTE FORMULA_0003 0 0.0 0.0 255.0 READ_WRITE ECU_ADDRESS 0x3F95EB /end MEASUREMENT
/begin MEASUREMENT ed_fil_index_124_ign.art_aktuell_nv "Fehlerart und Statusbits" UWORD FORMULA_0052 0 0.0 0.0 65535.0 READ_WRITE BIT_MASK 0xB4F ECU_ADDRESS 0x3F95F2 /end MEASUREMENT
/begin MEASUREMENT ed_fil_index_124_ign.fehler_aufrufe_nv "Gesamtzahl der Fehleraufrufe" UBYTE FORMULA_0003 0 0.0 0.0 255.0 READ_WRITE ECU_ADDRESS 0x3F95F5 /end MEASUREMENT
/begin MEASUREMENT ed_fil_index_124_ign.filter_max_nv "Maximaler Fehlerfilterwert" UBYTE FORMULA_0003 0 0.0 0.0 255.0 READ_WRITE ECU_ADDRESS 0x3F95F4 /end MEASUREMENT
/begin MEASUREMENT ed_fil_index_124_ign.filter_nv "Filterwert vor und nach Eintrag" UBYTE FORMULA_0003 0 0.0 0.0 255.0 READ_WRITE ECU_ADDRESS 0x3F95F0 /end MEASUREMENT
/begin MEASUREMENT ed_fil_index_124_ign.zyklus_filter_nv "Vorwaertsfilter zur Fehlerzustandsbestaetigung" UBYTE FORMULA_0003 0 0.0 0.0 255.0 READ_WRITE ECU_ADDRESS 0x3F95F1 /end MEASUREMENT
/begin MEASUREMENT ed_fil_index_125_ign.art_aktuell_nv "Fehlerart und Statusbits" UWORD FORMULA_0052 0 0.0 0.0 65535.0 READ_WRITE BIT_MASK 0xB4F ECU_ADDRESS 0x3F95F8 /end MEASUREMENT
/begin MEASUREMENT ed_fil_index_125_ign.fehler_aufrufe_nv "Gesamtzahl der Fehleraufrufe" UBYTE FORMULA_0003 0 0.0 0.0 255.0 READ_WRITE ECU_ADDRESS 0x3F95FB /end MEASUREMENT
/begin MEASUREMENT ed_fil_index_125_ign.filter_max_nv "Maximaler Fehlerfilterwert" UBYTE FORMULA_0003 0 0.0 0.0 255.0 READ_WRITE ECU_ADDRESS 0x3F95FA /end MEASUREMENT
/begin MEASUREMENT ed_fil_index_125_ign.filter_nv "Filterwert vor und nach Eintrag" UBYTE FORMULA_0003 0 0.0 0.0 255.0 READ_WRITE ECU_ADDRESS 0x3F95F6 /end MEASUREMENT
/begin MEASUREMENT ed_fil_index_125_ign.zyklus_filter_nv "Vorwaertsfilter zur Fehlerzustandsbestaetigung" UBYTE FORMULA_0003 0 0.0 0.0 255.0 READ_WRITE ECU_ADDRESS 0x3F95F7 /end MEASUREMENT
/begin MEASUREMENT ed_fil_index_126_ign.art_aktuell_nv "Fehlerart und Statusbits" UWORD FORMULA_0052 0 0.0 0.0 65535.0 READ_WRITE BIT_MASK 0xB4F ECU_ADDRESS 0x3F95FE /end MEASUREMENT
/begin MEASUREMENT ed_fil_index_126_ign.fehler_aufrufe_nv "Gesamtzahl der Fehleraufrufe" UBYTE FORMULA_0003 0 0.0 0.0 255.0 READ_WRITE ECU_ADDRESS 0x3F9601 /end MEASUREMENT
/begin MEASUREMENT ed_fil_index_126_ign.filter_max_nv "Maximaler Fehlerfilterwert" UBYTE FORMULA_0003 0 0.0 0.0 255.0 READ_WRITE ECU_ADDRESS 0x3F9600 /end MEASUREMENT
/begin MEASUREMENT ed_fil_index_126_ign.filter_nv "Filterwert vor und nach Eintrag" UBYTE FORMULA_0003 0 0.0 0.0 255.0 READ_WRITE ECU_ADDRESS 0x3F95FC /end MEASUREMENT
/begin MEASUREMENT ed_fil_index_126_ign.zyklus_filter_nv "Vorwaertsfilter zur Fehlerzustandsbestaetigung" UBYTE FORMULA_0003 0 0.0 0.0 255.0 READ_WRITE ECU_ADDRESS 0x3F95FD /end MEASUREMENT
/begin MEASUREMENT ed_fil_index_127_ign.art_aktuell_nv "Fehlerart und Statusbits" UWORD FORMULA_0052 0 0.0 0.0 65535.0 READ_WRITE BIT_MASK 0xB4F ECU_ADDRESS 0x3F9604 /end MEASUREMENT
/begin MEASUREMENT ed_fil_index_127_ign.fehler_aufrufe_nv "Gesamtzahl der Fehleraufrufe" UBYTE FORMULA_0003 0 0.0 0.0 255.0 READ_WRITE ECU_ADDRESS 0x3F9607 /end MEASUREMENT
/begin MEASUREMENT ed_fil_index_127_ign.filter_max_nv "Maximaler Fehlerfilterwert" UBYTE FORMULA_0003 0 0.0 0.0 255.0 READ_WRITE ECU_ADDRESS 0x3F9606 /end MEASUREMENT
/begin MEASUREMENT ed_fil_index_127_ign.filter_nv "Filterwert vor und nach Eintrag" UBYTE FORMULA_0003 0 0.0 0.0 255.0 READ_WRITE ECU_ADDRESS 0x3F9602 /end MEASUREMENT
/begin MEASUREMENT ed_fil_index_127_ign.zyklus_filter_nv "Vorwaertsfilter zur Fehlerzustandsbestaetigung" UBYTE FORMULA_0003 0 0.0 0.0 255.0 READ_WRITE ECU_ADDRESS 0x3F9603 /end MEASUREMENT
/begin MEASUREMENT ed_fil_index_33_ign.art_aktuell_nv "Fehlerart und Statusbits" UWORD FORMULA_0052 0 0.0 0.0 65535.0 READ_WRITE BIT_MASK 0xB4F ECU_ADDRESS 0x3F93D0 /end MEASUREMENT
/begin MEASUREMENT ed_fil_index_33_ign.fehler_aufrufe_nv "Gesamtzahl der Fehleraufrufe" UBYTE FORMULA_0003 0 0.0 0.0 255.0 READ_WRITE ECU_ADDRESS 0x3F93D3 /end MEASUREMENT
/begin MEASUREMENT ed_fil_index_33_ign.filter_max_nv "Maximaler Fehlerfilterwert" UBYTE FORMULA_0003 0 0.0 0.0 255.0 READ_WRITE ECU_ADDRESS 0x3F93D2 /end MEASUREMENT
/begin MEASUREMENT ed_fil_index_33_ign.filter_nv "Filterwert vor und nach Eintrag" UBYTE FORMULA_0003 0 0.0 0.0 255.0 READ_WRITE ECU_ADDRESS 0x3F93CE /end MEASUREMENT
/begin MEASUREMENT ed_fil_index_33_ign.zyklus_filter_nv "Vorwaertsfilter zur Fehlerzustandsbestaetigung" UBYTE FORMULA_0003 0 0.0 0.0 255.0 READ_WRITE ECU_ADDRESS 0x3F93CF /end MEASUREMENT
/begin MEASUREMENT ed_fil_index_34_ign.art_aktuell_nv "Fehlerart und Statusbits" UWORD FORMULA_0052 0 0.0 0.0 65535.0 READ_WRITE BIT_MASK 0xB4F ECU_ADDRESS 0x3F93D6 /end MEASUREMENT
/begin MEASUREMENT ed_fil_index_34_ign.fehler_aufrufe_nv "Gesamtzahl der Fehleraufrufe" UBYTE FORMULA_0003 0 0.0 0.0 255.0 READ_WRITE ECU_ADDRESS 0x3F93D9 /end MEASUREMENT
/begin MEASUREMENT ed_fil_index_34_ign.filter_max_nv "Maximaler Fehlerfilterwert" UBYTE FORMULA_0003 0 0.0 0.0 255.0 READ_WRITE ECU_ADDRESS 0x3F93D8 /end MEASUREMENT
/begin MEASUREMENT ed_fil_index_34_ign.filter_nv "Filterwert vor und nach Eintrag" UBYTE FORMULA_0003 0 0.0 0.0 255.0 READ_WRITE ECU_ADDRESS 0x3F93D4 /end MEASUREMENT
/begin MEASUREMENT ed_fil_index_34_ign.zyklus_filter_nv "Vorwaertsfilter zur Fehlerzustandsbestaetigung" UBYTE FORMULA_0003 0 0.0 0.0 255.0 READ_WRITE ECU_ADDRESS 0x3F93D5 /end MEASUREMENT
/begin MEASUREMENT ed_fil_index_35_ign.art_aktuell_nv "Fehlerart und Statusbits" UWORD FORMULA_0052 0 0.0 0.0 65535.0 READ_WRITE BIT_MASK 0xB4F ECU_ADDRESS 0x3F93DC /end MEASUREMENT
/begin MEASUREMENT ed_fil_index_35_ign.fehler_aufrufe_nv "Gesamtzahl der Fehleraufrufe" UBYTE FORMULA_0003 0 0.0 0.0 255.0 READ_WRITE ECU_ADDRESS 0x3F93DF /end MEASUREMENT
/begin MEASUREMENT ed_fil_index_35_ign.filter_max_nv "Maximaler Fehlerfilterwert" UBYTE FORMULA_0003 0 0.0 0.0 255.0 READ_WRITE ECU_ADDRESS 0x3F93DE /end MEASUREMENT
/begin MEASUREMENT ed_fil_index_35_ign.filter_nv "Filterwert vor und nach Eintrag" UBYTE FORMULA_0003 0 0.0 0.0 255.0 READ_WRITE ECU_ADDRESS 0x3F93DA /end MEASUREMENT
/begin MEASUREMENT ed_fil_index_35_ign.zyklus_filter_nv "Vorwaertsfilter zur Fehlerzustandsbestaetigung" UBYTE FORMULA_0003 0 0.0 0.0 255.0 READ_WRITE ECU_ADDRESS 0x3F93DB /end MEASUREMENT
/begin MEASUREMENT ed_fil_index_36_ign.art_aktuell_nv "Fehlerart und Statusbits" UWORD FORMULA_0052 0 0.0 0.0 65535.0 READ_WRITE BIT_MASK 0xB4F ECU_ADDRESS 0x3F93E2 /end MEASUREMENT
/begin MEASUREMENT ed_fil_index_36_ign.fehler_aufrufe_nv "Gesamtzahl der Fehleraufrufe" UBYTE FORMULA_0003 0 0.0 0.0 255.0 READ_WRITE ECU_ADDRESS 0x3F93E5 /end MEASUREMENT
/begin MEASUREMENT ed_fil_index_36_ign.filter_max_nv "Maximaler Fehlerfilterwert" UBYTE FORMULA_0003 0 0.0 0.0 255.0 READ_WRITE ECU_ADDRESS 0x3F93E4 /end MEASUREMENT
/begin MEASUREMENT ed_fil_index_36_ign.filter_nv "Filterwert vor und nach Eintrag" UBYTE FORMULA_0003 0 0.0 0.0 255.0 READ_WRITE ECU_ADDRESS 0x3F93E0 /end MEASUREMENT
/begin MEASUREMENT ed_fil_index_36_ign.zyklus_filter_nv "Vorwaertsfilter zur Fehlerzustandsbestaetigung" UBYTE FORMULA_0003 0 0.0 0.0 255.0 READ_WRITE ECU_ADDRESS 0x3F93E1 /end MEASUREMENT
/begin MEASUREMENT ed_fil_index_71_ign.art_aktuell_nv "Fehlerart und Statusbits" UWORD FORMULA_0052 0 0.0 0.0 65535.0 READ_WRITE BIT_MASK 0xB4F ECU_ADDRESS 0x3F94B4 /end MEASUREMENT
/begin MEASUREMENT ed_fil_index_71_ign.fehler_aufrufe_nv "Gesamtzahl der Fehleraufrufe" UBYTE FORMULA_0003 0 0.0 0.0 255.0 READ_WRITE ECU_ADDRESS 0x3F94B7 /end MEASUREMENT
/begin MEASUREMENT ed_fil_index_71_ign.filter_max_nv "Maximaler Fehlerfilterwert" UBYTE FORMULA_0003 0 0.0 0.0 255.0 READ_WRITE ECU_ADDRESS 0x3F94B6 /end MEASUREMENT
/begin MEASUREMENT ed_fil_index_71_ign.filter_nv "Filterwert vor und nach Eintrag" UBYTE FORMULA_0003 0 0.0 0.0 255.0 READ_WRITE ECU_ADDRESS 0x3F94B2 /end MEASUREMENT
/begin MEASUREMENT ed_fil_index_71_ign.zyklus_filter_nv "Vorwaertsfilter zur Fehlerzustandsbestaetigung" UBYTE FORMULA_0003 0 0.0 0.0 255.0 READ_WRITE ECU_ADDRESS 0x3F94B3 /end MEASUREMENT
/begin MEASUREMENT ed_fil_index_72_ign.art_aktuell_nv "Fehlerart und Statusbits" UWORD FORMULA_0052 0 0.0 0.0 65535.0 READ_WRITE BIT_MASK 0xB4F ECU_ADDRESS 0x3F94BA /end MEASUREMENT
/begin MEASUREMENT ed_fil_index_72_ign.fehler_aufrufe_nv "Gesamtzahl der Fehleraufrufe" UBYTE FORMULA_0003 0 0.0 0.0 255.0 READ_WRITE ECU_ADDRESS 0x3F94BD /end MEASUREMENT
/begin MEASUREMENT ed_fil_index_72_ign.filter_max_nv "Maximaler Fehlerfilterwert" UBYTE FORMULA_0003 0 0.0 0.0 255.0 READ_WRITE ECU_ADDRESS 0x3F94BC /end MEASUREMENT
/begin MEASUREMENT ed_fil_index_72_ign.filter_nv "Filterwert vor und nach Eintrag" UBYTE FORMULA_0003 0 0.0 0.0 255.0 READ_WRITE ECU_ADDRESS 0x3F94B8 /end MEASUREMENT
/begin MEASUREMENT ed_fil_index_72_ign.zyklus_filter_nv "Vorwaertsfilter zur Fehlerzustandsbestaetigung" UBYTE FORMULA_0003 0 0.0 0.0 255.0 READ_WRITE ECU_ADDRESS 0x3F94B9 /end MEASUREMENT
/begin MEASUREMENT ed_fil_index_84_ign.art_aktuell_nv "Fehlerart und Statusbits" UWORD FORMULA_0052 0 0.0 0.0 65535.0 READ_WRITE BIT_MASK 0xB4F ECU_ADDRESS 0x3F9502 /end MEASUREMENT
/begin MEASUREMENT ed_fil_index_84_ign.fehler_aufrufe_nv "Gesamtzahl der Fehleraufrufe" UBYTE FORMULA_0003 0 0.0 0.0 255.0 READ_WRITE ECU_ADDRESS 0x3F9505 /end MEASUREMENT
/begin MEASUREMENT ed_fil_index_84_ign.filter_max_nv "Maximaler Fehlerfilterwert" UBYTE FORMULA_0003 0 0.0 0.0 255.0 READ_WRITE ECU_ADDRESS 0x3F9504 /end MEASUREMENT
/begin MEASUREMENT ed_fil_index_84_ign.filter_nv "Filterwert vor und nach Eintrag" UBYTE FORMULA_0003 0 0.0 0.0 255.0 READ_WRITE ECU_ADDRESS 0x3F9500 /end MEASUREMENT
/begin MEASUREMENT ed_fil_index_84_ign.zyklus_filter_nv "Vorwaertsfilter zur Fehlerzustandsbestaetigung" UBYTE FORMULA_0003 0 0.0 0.0 255.0 READ_WRITE ECU_ADDRESS 0x3F9501 /end MEASUREMENT
/begin MEASUREMENT ed_fil_index_85_ign.art_aktuell_nv "Fehlerart und Statusbits" UWORD FORMULA_0052 0 0.0 0.0 65535.0 READ_WRITE BIT_MASK 0xB4F ECU_ADDRESS 0x3F9508 /end MEASUREMENT
/begin MEASUREMENT ed_fil_index_85_ign.fehler_aufrufe_nv "Gesamtzahl der Fehleraufrufe" UBYTE FORMULA_0003 0 0.0 0.0 255.0 READ_WRITE ECU_ADDRESS 0x3F950B /end MEASUREMENT
/begin MEASUREMENT ed_fil_index_85_ign.filter_max_nv "Maximaler Fehlerfilterwert" UBYTE FORMULA_0003 0 0.0 0.0 255.0 READ_WRITE ECU_ADDRESS 0x3F950A /end MEASUREMENT
/begin MEASUREMENT ed_fil_index_85_ign.filter_nv "Filterwert vor und nach Eintrag" UBYTE FORMULA_0003 0 0.0 0.0 255.0 READ_WRITE ECU_ADDRESS 0x3F9506 /end MEASUREMENT
/begin MEASUREMENT ed_fil_index_85_ign.zyklus_filter_nv "Vorwaertsfilter zur Fehlerzustandsbestaetigung" UBYTE FORMULA_0003 0 0.0 0.0 255.0 READ_WRITE ECU_ADDRESS 0x3F9507 /end MEASUREMENT
/begin MEASUREMENT ed_fil_llr_diag.art_aktuell_nv "Fehlerart und Statusbits" UWORD FORMULA_0052 0 0.0 0.0 65535.0 READ_WRITE BIT_MASK 0xB4F ECU_ADDRESS 0x3F954A /end MEASUREMENT
/begin MEASUREMENT ed_fil_llr_diag.fehler_aufrufe_nv "Gesamtzahl der Fehleraufrufe" UBYTE FORMULA_0003 0 0.0 0.0 255.0 READ_WRITE ECU_ADDRESS 0x3F954D /end MEASUREMENT
/begin MEASUREMENT ed_fil_llr_diag.filter_max_nv "Maximaler Fehlerfilterwert" UBYTE FORMULA_0003 0 0.0 0.0 255.0 READ_WRITE ECU_ADDRESS 0x3F954C /end MEASUREMENT
/begin MEASUREMENT ed_fil_llr_diag.filter_nv "Filterwert vor und nach Eintrag" UBYTE FORMULA_0003 0 0.0 0.0 255.0 READ_WRITE ECU_ADDRESS 0x3F9548 /end MEASUREMENT
/begin MEASUREMENT ed_fil_llr_diag.zyklus_filter_nv "Vorwaertsfilter zur Fehlerzustandsbestaetigung" UBYTE FORMULA_0003 0 0.0 0.0 255.0 READ_WRITE ECU_ADDRESS 0x3F9549 /end MEASUREMENT
/begin MEASUREMENT ed_fil_llr_diag_css.art_aktuell_nv "Fehlerart und Statusbits" UWORD FORMULA_0052 0 0.0 0.0 65535.0 READ_WRITE BIT_MASK 0xB4F ECU_ADDRESS 0x3F9598 /end MEASUREMENT
/begin MEASUREMENT ed_fil_llr_diag_css.fehler_aufrufe_nv "Gesamtzahl der Fehleraufrufe" UBYTE FORMULA_0003 0 0.0 0.0 255.0 READ_WRITE ECU_ADDRESS 0x3F959B /end MEASUREMENT
/begin MEASUREMENT ed_fil_llr_diag_css.filter_max_nv "Maximaler Fehlerfilterwert" UBYTE FORMULA_0003 0 0.0 0.0 255.0 READ_WRITE ECU_ADDRESS 0x3F959A /end MEASUREMENT
/begin MEASUREMENT ed_fil_llr_diag_css.filter_nv "Filterwert vor und nach Eintrag" UBYTE FORMULA_0003 0 0.0 0.0 255.0 READ_WRITE ECU_ADDRESS 0x3F9596 /end MEASUREMENT
/begin MEASUREMENT ed_fil_llr_diag_css.zyklus_filter_nv "Vorwaertsfilter zur Fehlerzustandsbestaetigung" UBYTE FORMULA_0003 0 0.0 0.0 255.0 READ_WRITE ECU_ADDRESS 0x3F9597 /end MEASUREMENT
/begin MEASUREMENT ed_fil_lls_init.art_aktuell_nv "Fehlerart und Statusbits" UWORD FORMULA_0052 0 0.0 0.0 65535.0 READ_WRITE BIT_MASK 0xB4F ECU_ADDRESS 0x3F9436 /end MEASUREMENT
/begin MEASUREMENT ed_fil_lls_init.fehler_aufrufe_nv "Gesamtzahl der Fehleraufrufe" UBYTE FORMULA_0003 0 0.0 0.0 255.0 READ_WRITE ECU_ADDRESS 0x3F9439 /end MEASUREMENT
/begin MEASUREMENT ed_fil_lls_init.filter_max_nv "Maximaler Fehlerfilterwert" UBYTE FORMULA_0003 0 0.0 0.0 255.0 READ_WRITE ECU_ADDRESS 0x3F9438 /end MEASUREMENT
/begin MEASUREMENT ed_fil_lls_init.filter_nv "Filterwert vor und nach Eintrag" UBYTE FORMULA_0003 0 0.0 0.0 255.0 READ_WRITE ECU_ADDRESS 0x3F9434 /end MEASUREMENT
/begin MEASUREMENT ed_fil_lls_init.zyklus_filter_nv "Vorwaertsfilter zur Fehlerzustandsbestaetigung" UBYTE FORMULA_0003 0 0.0 0.0 255.0 READ_WRITE ECU_ADDRESS 0x3F9435 /end MEASUREMENT
/begin MEASUREMENT ed_fil_lls1_can.art_aktuell_nv "Fehlerart und Statusbits" UWORD FORMULA_0052 0 0.0 0.0 65535.0 READ_WRITE BIT_MASK 0xB4F ECU_ADDRESS 0x3F9370 /end MEASUREMENT
/begin MEASUREMENT ed_fil_lls1_can.fehler_aufrufe_nv "Gesamtzahl der Fehleraufrufe" UBYTE FORMULA_0003 0 0.0 0.0 255.0 READ_WRITE ECU_ADDRESS 0x3F9373 /end MEASUREMENT
/begin MEASUREMENT ed_fil_lls1_can.filter_max_nv "Maximaler Fehlerfilterwert" UBYTE FORMULA_0003 0 0.0 0.0 255.0 READ_WRITE ECU_ADDRESS 0x3F9372 /end MEASUREMENT
/begin MEASUREMENT ed_fil_lls1_can.filter_nv "Filterwert vor und nach Eintrag" UBYTE FORMULA_0003 0 0.0 0.0 255.0 READ_WRITE ECU_ADDRESS 0x3F936E /end MEASUREMENT
/begin MEASUREMENT ed_fil_lls1_can.zyklus_filter_nv "Vorwaertsfilter zur Fehlerzustandsbestaetigung" UBYTE FORMULA_0003 0 0.0 0.0 255.0 READ_WRITE ECU_ADDRESS 0x3F936F /end MEASUREMENT
/begin MEASUREMENT ed_fil_lls1_cmd.art_aktuell_nv "Fehlerart und Statusbits" UWORD FORMULA_0052 0 0.0 0.0 65535.0 READ_WRITE BIT_MASK 0xB4F ECU_ADDRESS 0x3F944E /end MEASUREMENT
/begin MEASUREMENT ed_fil_lls1_cmd.fehler_aufrufe_nv "Gesamtzahl der Fehleraufrufe" UBYTE FORMULA_0003 0 0.0 0.0 255.0 READ_WRITE ECU_ADDRESS 0x3F9451 /end MEASUREMENT
/begin MEASUREMENT ed_fil_lls1_cmd.filter_max_nv "Maximaler Fehlerfilterwert" UBYTE FORMULA_0003 0 0.0 0.0 255.0 READ_WRITE ECU_ADDRESS 0x3F9450 /end MEASUREMENT
/begin MEASUREMENT ed_fil_lls1_cmd.filter_nv "Filterwert vor und nach Eintrag" UBYTE FORMULA_0003 0 0.0 0.0 255.0 READ_WRITE ECU_ADDRESS 0x3F944C /end MEASUREMENT
/begin MEASUREMENT ed_fil_lls1_cmd.zyklus_filter_nv "Vorwaertsfilter zur Fehlerzustandsbestaetigung" UBYTE FORMULA_0003 0 0.0 0.0 255.0 READ_WRITE ECU_ADDRESS 0x3F944D /end MEASUREMENT
/begin MEASUREMENT ed_fil_lls1_regler.art_aktuell_nv "Fehlerart und Statusbits" UWORD FORMULA_0052 0 0.0 0.0 65535.0 READ_WRITE BIT_MASK 0xB4F ECU_ADDRESS 0x3F940C /end MEASUREMENT
/begin MEASUREMENT ed_fil_lls1_regler.fehler_aufrufe_nv "Gesamtzahl der Fehleraufrufe" UBYTE FORMULA_0003 0 0.0 0.0 255.0 READ_WRITE ECU_ADDRESS 0x3F940F /end MEASUREMENT
/begin MEASUREMENT ed_fil_lls1_regler.filter_max_nv "Maximaler Fehlerfilterwert" UBYTE FORMULA_0003 0 0.0 0.0 255.0 READ_WRITE ECU_ADDRESS 0x3F940E /end MEASUREMENT
/begin MEASUREMENT ed_fil_lls1_regler.filter_nv "Filterwert vor und nach Eintrag" UBYTE FORMULA_0003 0 0.0 0.0 255.0 READ_WRITE ECU_ADDRESS 0x3F940A /end MEASUREMENT
/begin MEASUREMENT ed_fil_lls1_regler.zyklus_filter_nv "Vorwaertsfilter zur Fehlerzustandsbestaetigung" UBYTE FORMULA_0003 0 0.0 0.0 255.0 READ_WRITE ECU_ADDRESS 0x3F940B /end MEASUREMENT
/begin MEASUREMENT ed_fil_lls1_sk.art_aktuell_nv "Fehlerart und Statusbits" UWORD FORMULA_0052 0 0.0 0.0 65535.0 READ_WRITE BIT_MASK 0xB4F ECU_ADDRESS 0x3F9388 /end MEASUREMENT
/begin MEASUREMENT ed_fil_lls1_sk.fehler_aufrufe_nv "Gesamtzahl der Fehleraufrufe" UBYTE FORMULA_0003 0 0.0 0.0 255.0 READ_WRITE ECU_ADDRESS 0x3F938B /end MEASUREMENT
/begin MEASUREMENT ed_fil_lls1_sk.filter_max_nv "Maximaler Fehlerfilterwert" UBYTE FORMULA_0003 0 0.0 0.0 255.0 READ_WRITE ECU_ADDRESS 0x3F938A /end MEASUREMENT
/begin MEASUREMENT ed_fil_lls1_sk.filter_nv "Filterwert vor und nach Eintrag" UBYTE FORMULA_0003 0 0.0 0.0 255.0 READ_WRITE ECU_ADDRESS 0x3F9386 /end MEASUREMENT
/begin MEASUREMENT ed_fil_lls1_sk.zyklus_filter_nv "Vorwaertsfilter zur Fehlerzustandsbestaetigung" UBYTE FORMULA_0003 0 0.0 0.0 255.0 READ_WRITE ECU_ADDRESS 0x3F9387 /end MEASUREMENT
/begin MEASUREMENT ed_fil_lls2_can.art_aktuell_nv "Fehlerart und Statusbits" UWORD FORMULA_0052 0 0.0 0.0 65535.0 READ_WRITE BIT_MASK 0xB4F ECU_ADDRESS 0x3F9376 /end MEASUREMENT
/begin MEASUREMENT ed_fil_lls2_can.fehler_aufrufe_nv "Gesamtzahl der Fehleraufrufe" UBYTE FORMULA_0003 0 0.0 0.0 255.0 READ_WRITE ECU_ADDRESS 0x3F9379 /end MEASUREMENT
/begin MEASUREMENT ed_fil_lls2_can.filter_max_nv "Maximaler Fehlerfilterwert" UBYTE FORMULA_0003 0 0.0 0.0 255.0 READ_WRITE ECU_ADDRESS 0x3F9378 /end MEASUREMENT
/begin MEASUREMENT ed_fil_lls2_can.filter_nv "Filterwert vor und nach Eintrag" UBYTE FORMULA_0003 0 0.0 0.0 255.0 READ_WRITE ECU_ADDRESS 0x3F9374 /end MEASUREMENT
/begin MEASUREMENT ed_fil_lls2_can.zyklus_filter_nv "Vorwaertsfilter zur Fehlerzustandsbestaetigung" UBYTE FORMULA_0003 0 0.0 0.0 255.0 READ_WRITE ECU_ADDRESS 0x3F9375 /end MEASUREMENT
/begin MEASUREMENT ed_fil_lls2_cmd.art_aktuell_nv "Fehlerart und Statusbits" UWORD FORMULA_0052 0 0.0 0.0 65535.0 READ_WRITE BIT_MASK 0xB4F ECU_ADDRESS 0x3F9454 /end MEASUREMENT
/begin MEASUREMENT ed_fil_lls2_cmd.fehler_aufrufe_nv "Gesamtzahl der Fehleraufrufe" UBYTE FORMULA_0003 0 0.0 0.0 255.0 READ_WRITE ECU_ADDRESS 0x3F9457 /end MEASUREMENT
/begin MEASUREMENT ed_fil_lls2_cmd.filter_max_nv "Maximaler Fehlerfilterwert" UBYTE FORMULA_0003 0 0.0 0.0 255.0 READ_WRITE ECU_ADDRESS 0x3F9456 /end MEASUREMENT
/begin MEASUREMENT ed_fil_lls2_cmd.filter_nv "Filterwert vor und nach Eintrag" UBYTE FORMULA_0003 0 0.0 0.0 255.0 READ_WRITE ECU_ADDRESS 0x3F9452 /end MEASUREMENT
/begin MEASUREMENT ed_fil_lls2_cmd.zyklus_filter_nv "Vorwaertsfilter zur Fehlerzustandsbestaetigung" UBYTE FORMULA_0003 0 0.0 0.0 255.0 READ_WRITE ECU_ADDRESS 0x3F9453 /end MEASUREMENT
/begin MEASUREMENT ed_fil_lls2_regler.art_aktuell_nv "Fehlerart und Statusbits" UWORD FORMULA_0052 0 0.0 0.0 65535.0 READ_WRITE BIT_MASK 0xB4F ECU_ADDRESS 0x3F9412 /end MEASUREMENT
/begin MEASUREMENT ed_fil_lls2_regler.fehler_aufrufe_nv "Gesamtzahl der Fehleraufrufe" UBYTE FORMULA_0003 0 0.0 0.0 255.0 READ_WRITE ECU_ADDRESS 0x3F9415 /end MEASUREMENT
/begin MEASUREMENT ed_fil_lls2_regler.filter_max_nv "Maximaler Fehlerfilterwert" UBYTE FORMULA_0003 0 0.0 0.0 255.0 READ_WRITE ECU_ADDRESS 0x3F9414 /end MEASUREMENT
/begin MEASUREMENT ed_fil_lls2_regler.filter_nv "Filterwert vor und nach Eintrag" UBYTE FORMULA_0003 0 0.0 0.0 255.0 READ_WRITE ECU_ADDRESS 0x3F9410 /end MEASUREMENT
/begin MEASUREMENT ed_fil_lls2_regler.zyklus_filter_nv "Vorwaertsfilter zur Fehlerzustandsbestaetigung" UBYTE FORMULA_0003 0 0.0 0.0 255.0 READ_WRITE ECU_ADDRESS 0x3F9411 /end MEASUREMENT
/begin MEASUREMENT ed_fil_lls2_sk.art_aktuell_nv "Fehlerart und Statusbits" UWORD FORMULA_0052 0 0.0 0.0 65535.0 READ_WRITE BIT_MASK 0xB4F ECU_ADDRESS 0x3F938E /end MEASUREMENT
/begin MEASUREMENT ed_fil_lls2_sk.fehler_aufrufe_nv "Gesamtzahl der Fehleraufrufe" UBYTE FORMULA_0003 0 0.0 0.0 255.0 READ_WRITE ECU_ADDRESS 0x3F9391 /end MEASUREMENT
/begin MEASUREMENT ed_fil_lls2_sk.filter_max_nv "Maximaler Fehlerfilterwert" UBYTE FORMULA_0003 0 0.0 0.0 255.0 READ_WRITE ECU_ADDRESS 0x3F9390 /end MEASUREMENT
/begin MEASUREMENT ed_fil_lls2_sk.filter_nv "Filterwert vor und nach Eintrag" UBYTE FORMULA_0003 0 0.0 0.0 255.0 READ_WRITE ECU_ADDRESS 0x3F938C /end MEASUREMENT
/begin MEASUREMENT ed_fil_lls2_sk.zyklus_filter_nv "Vorwaertsfilter zur Fehlerzustandsbestaetigung" UBYTE FORMULA_0003 0 0.0 0.0 255.0 READ_WRITE ECU_ADDRESS 0x3F938D /end MEASUREMENT
/begin MEASUREMENT ed_fil_m_spule_z1.art_aktuell_nv "Fehlerart und Statusbits" UWORD FORMULA_0052 0 0.0 0.0 65535.0 READ_WRITE BIT_MASK 0xB4F ECU_ADDRESS 0x3F95A4 /end MEASUREMENT
/begin MEASUREMENT ed_fil_m_spule_z1.fehler_aufrufe_nv "Gesamtzahl der Fehleraufrufe" UBYTE FORMULA_0003 0 0.0 0.0 255.0 READ_WRITE ECU_ADDRESS 0x3F95A7 /end MEASUREMENT
/begin MEASUREMENT ed_fil_m_spule_z1.filter_max_nv "Maximaler Fehlerfilterwert" UBYTE FORMULA_0003 0 0.0 0.0 255.0 READ_WRITE ECU_ADDRESS 0x3F95A6 /end MEASUREMENT
/begin MEASUREMENT ed_fil_m_spule_z1.filter_nv "Filterwert vor und nach Eintrag" UBYTE FORMULA_0003 0 0.0 0.0 255.0 READ_WRITE ECU_ADDRESS 0x3F95A2 /end MEASUREMENT
/begin MEASUREMENT ed_fil_m_spule_z1.zyklus_filter_nv "Vorwaertsfilter zur Fehlerzustandsbestaetigung" UBYTE FORMULA_0003 0 0.0 0.0 255.0 READ_WRITE ECU_ADDRESS 0x3F95A3 /end MEASUREMENT
/begin MEASUREMENT ed_fil_m_spule_z10.art_aktuell_nv "Fehlerart und Statusbits" UWORD FORMULA_0052 0 0.0 0.0 65535.0 READ_WRITE BIT_MASK 0xB4F ECU_ADDRESS 0x3F95DA /end MEASUREMENT
/begin MEASUREMENT ed_fil_m_spule_z10.fehler_aufrufe_nv "Gesamtzahl der Fehleraufrufe" UBYTE FORMULA_0003 0 0.0 0.0 255.0 READ_WRITE ECU_ADDRESS 0x3F95DD /end MEASUREMENT
/begin MEASUREMENT ed_fil_m_spule_z10.filter_max_nv "Maximaler Fehlerfilterwert" UBYTE FORMULA_0003 0 0.0 0.0 255.0 READ_WRITE ECU_ADDRESS 0x3F95DC /end MEASUREMENT
/begin MEASUREMENT ed_fil_m_spule_z10.filter_nv "Filterwert vor und nach Eintrag" UBYTE FORMULA_0003 0 0.0 0.0 255.0 READ_WRITE ECU_ADDRESS 0x3F95D8 /end MEASUREMENT
/begin MEASUREMENT ed_fil_m_spule_z10.zyklus_filter_nv "Vorwaertsfilter zur Fehlerzustandsbestaetigung" UBYTE FORMULA_0003 0 0.0 0.0 255.0 READ_WRITE ECU_ADDRESS 0x3F95D9 /end MEASUREMENT
/begin MEASUREMENT ed_fil_m_spule_z2.art_aktuell_nv "Fehlerart und Statusbits" UWORD FORMULA_0052 0 0.0 0.0 65535.0 READ_WRITE BIT_MASK 0xB4F ECU_ADDRESS 0x3F95AA /end MEASUREMENT
/begin MEASUREMENT ed_fil_m_spule_z2.fehler_aufrufe_nv "Gesamtzahl der Fehleraufrufe" UBYTE FORMULA_0003 0 0.0 0.0 255.0 READ_WRITE ECU_ADDRESS 0x3F95AD /end MEASUREMENT
/begin MEASUREMENT ed_fil_m_spule_z2.filter_max_nv "Maximaler Fehlerfilterwert" UBYTE FORMULA_0003 0 0.0 0.0 255.0 READ_WRITE ECU_ADDRESS 0x3F95AC /end MEASUREMENT
/begin MEASUREMENT ed_fil_m_spule_z2.filter_nv "Filterwert vor und nach Eintrag" UBYTE FORMULA_0003 0 0.0 0.0 255.0 READ_WRITE ECU_ADDRESS 0x3F95A8 /end MEASUREMENT
/begin MEASUREMENT ed_fil_m_spule_z2.zyklus_filter_nv "Vorwaertsfilter zur Fehlerzustandsbestaetigung" UBYTE FORMULA_0003 0 0.0 0.0 255.0 READ_WRITE ECU_ADDRESS 0x3F95A9 /end MEASUREMENT
/begin MEASUREMENT ed_fil_m_spule_z3.art_aktuell_nv "Fehlerart und Statusbits" UWORD FORMULA_0052 0 0.0 0.0 65535.0 READ_WRITE BIT_MASK 0xB4F ECU_ADDRESS 0x3F95B0 /end MEASUREMENT
/begin MEASUREMENT ed_fil_m_spule_z3.fehler_aufrufe_nv "Gesamtzahl der Fehleraufrufe" UBYTE FORMULA_0003 0 0.0 0.0 255.0 READ_WRITE ECU_ADDRESS 0x3F95B3 /end MEASUREMENT
/begin MEASUREMENT ed_fil_m_spule_z3.filter_max_nv "Maximaler Fehlerfilterwert" UBYTE FORMULA_0003 0 0.0 0.0 255.0 READ_WRITE ECU_ADDRESS 0x3F95B2 /end MEASUREMENT
/begin MEASUREMENT ed_fil_m_spule_z3.filter_nv "Filterwert vor und nach Eintrag" UBYTE FORMULA_0003 0 0.0 0.0 255.0 READ_WRITE ECU_ADDRESS 0x3F95AE /end MEASUREMENT
/begin MEASUREMENT ed_fil_m_spule_z3.zyklus_filter_nv "Vorwaertsfilter zur Fehlerzustandsbestaetigung" UBYTE FORMULA_0003 0 0.0 0.0 255.0 READ_WRITE ECU_ADDRESS 0x3F95AF /end MEASUREMENT
/begin MEASUREMENT ed_fil_m_spule_z4.art_aktuell_nv "Fehlerart und Statusbits" UWORD FORMULA_0052 0 0.0 0.0 65535.0 READ_WRITE BIT_MASK 0xB4F ECU_ADDRESS 0x3F95B6 /end MEASUREMENT
/begin MEASUREMENT ed_fil_m_spule_z4.fehler_aufrufe_nv "Gesamtzahl der Fehleraufrufe" UBYTE FORMULA_0003 0 0.0 0.0 255.0 READ_WRITE ECU_ADDRESS 0x3F95B9 /end MEASUREMENT
/begin MEASUREMENT ed_fil_m_spule_z4.filter_max_nv "Maximaler Fehlerfilterwert" UBYTE FORMULA_0003 0 0.0 0.0 255.0 READ_WRITE ECU_ADDRESS 0x3F95B8 /end MEASUREMENT
/begin MEASUREMENT ed_fil_m_spule_z4.filter_nv "Filterwert vor und nach Eintrag" UBYTE FORMULA_0003 0 0.0 0.0 255.0 READ_WRITE ECU_ADDRESS 0x3F95B4 /end MEASUREMENT
/begin MEASUREMENT ed_fil_m_spule_z4.zyklus_filter_nv "Vorwaertsfilter zur Fehlerzustandsbestaetigung" UBYTE FORMULA_0003 0 0.0 0.0 255.0 READ_WRITE ECU_ADDRESS 0x3F95B5 /end MEASUREMENT
/begin MEASUREMENT ed_fil_m_spule_z5.art_aktuell_nv "Fehlerart und Statusbits" UWORD FORMULA_0052 0 0.0 0.0 65535.0 READ_WRITE BIT_MASK 0xB4F ECU_ADDRESS 0x3F95BC /end MEASUREMENT
/begin MEASUREMENT ed_fil_m_spule_z5.fehler_aufrufe_nv "Gesamtzahl der Fehleraufrufe" UBYTE FORMULA_0003 0 0.0 0.0 255.0 READ_WRITE ECU_ADDRESS 0x3F95BF /end MEASUREMENT
/begin MEASUREMENT ed_fil_m_spule_z5.filter_max_nv "Maximaler Fehlerfilterwert" UBYTE FORMULA_0003 0 0.0 0.0 255.0 READ_WRITE ECU_ADDRESS 0x3F95BE /end MEASUREMENT
/begin MEASUREMENT ed_fil_m_spule_z5.filter_nv "Filterwert vor und nach Eintrag" UBYTE FORMULA_0003 0 0.0 0.0 255.0 READ_WRITE ECU_ADDRESS 0x3F95BA /end MEASUREMENT
/begin MEASUREMENT ed_fil_m_spule_z5.zyklus_filter_nv "Vorwaertsfilter zur Fehlerzustandsbestaetigung" UBYTE FORMULA_0003 0 0.0 0.0 255.0 READ_WRITE ECU_ADDRESS 0x3F95BB /end MEASUREMENT
/begin MEASUREMENT ed_fil_m_spule_z6.art_aktuell_nv "Fehlerart und Statusbits" UWORD FORMULA_0052 0 0.0 0.0 65535.0 READ_WRITE BIT_MASK 0xB4F ECU_ADDRESS 0x3F95C2 /end MEASUREMENT
/begin MEASUREMENT ed_fil_m_spule_z6.fehler_aufrufe_nv "Gesamtzahl der Fehleraufrufe" UBYTE FORMULA_0003 0 0.0 0.0 255.0 READ_WRITE ECU_ADDRESS 0x3F95C5 /end MEASUREMENT
/begin MEASUREMENT ed_fil_m_spule_z6.filter_max_nv "Maximaler Fehlerfilterwert" UBYTE FORMULA_0003 0 0.0 0.0 255.0 READ_WRITE ECU_ADDRESS 0x3F95C4 /end MEASUREMENT
/begin MEASUREMENT ed_fil_m_spule_z6.filter_nv "Filterwert vor und nach Eintrag" UBYTE FORMULA_0003 0 0.0 0.0 255.0 READ_WRITE ECU_ADDRESS 0x3F95C0 /end MEASUREMENT
/begin MEASUREMENT ed_fil_m_spule_z6.zyklus_filter_nv "Vorwaertsfilter zur Fehlerzustandsbestaetigung" UBYTE FORMULA_0003 0 0.0 0.0 255.0 READ_WRITE ECU_ADDRESS 0x3F95C1 /end MEASUREMENT
/begin MEASUREMENT ed_fil_m_spule_z7.art_aktuell_nv "Fehlerart und Statusbits" UWORD FORMULA_0052 0 0.0 0.0 65535.0 READ_WRITE BIT_MASK 0xB4F ECU_ADDRESS 0x3F95C8 /end MEASUREMENT
/begin MEASUREMENT ed_fil_m_spule_z7.fehler_aufrufe_nv "Gesamtzahl der Fehleraufrufe" UBYTE FORMULA_0003 0 0.0 0.0 255.0 READ_WRITE ECU_ADDRESS 0x3F95CB /end MEASUREMENT
/begin MEASUREMENT ed_fil_m_spule_z7.filter_max_nv "Maximaler Fehlerfilterwert" UBYTE FORMULA_0003 0 0.0 0.0 255.0 READ_WRITE ECU_ADDRESS 0x3F95CA /end MEASUREMENT
/begin MEASUREMENT ed_fil_m_spule_z7.filter_nv "Filterwert vor und nach Eintrag" UBYTE FORMULA_0003 0 0.0 0.0 255.0 READ_WRITE ECU_ADDRESS 0x3F95C6 /end MEASUREMENT
/begin MEASUREMENT ed_fil_m_spule_z7.zyklus_filter_nv "Vorwaertsfilter zur Fehlerzustandsbestaetigung" UBYTE FORMULA_0003 0 0.0 0.0 255.0 READ_WRITE ECU_ADDRESS 0x3F95C7 /end MEASUREMENT
/begin MEASUREMENT ed_fil_m_spule_z8.art_aktuell_nv "Fehlerart und Statusbits" UWORD FORMULA_0052 0 0.0 0.0 65535.0 READ_WRITE BIT_MASK 0xB4F ECU_ADDRESS 0x3F95CE /end MEASUREMENT
/begin MEASUREMENT ed_fil_m_spule_z8.fehler_aufrufe_nv "Gesamtzahl der Fehleraufrufe" UBYTE FORMULA_0003 0 0.0 0.0 255.0 READ_WRITE ECU_ADDRESS 0x3F95D1 /end MEASUREMENT
/begin MEASUREMENT ed_fil_m_spule_z8.filter_max_nv "Maximaler Fehlerfilterwert" UBYTE FORMULA_0003 0 0.0 0.0 255.0 READ_WRITE ECU_ADDRESS 0x3F95D0 /end MEASUREMENT
/begin MEASUREMENT ed_fil_m_spule_z8.filter_nv "Filterwert vor und nach Eintrag" UBYTE FORMULA_0003 0 0.0 0.0 255.0 READ_WRITE ECU_ADDRESS 0x3F95CC /end MEASUREMENT
/begin MEASUREMENT ed_fil_m_spule_z8.zyklus_filter_nv "Vorwaertsfilter zur Fehlerzustandsbestaetigung" UBYTE FORMULA_0003 0 0.0 0.0 255.0 READ_WRITE ECU_ADDRESS 0x3F95CD /end MEASUREMENT
/begin MEASUREMENT ed_fil_m_spule_z9.art_aktuell_nv "Fehlerart und Statusbits" UWORD FORMULA_0052 0 0.0 0.0 65535.0 READ_WRITE BIT_MASK 0xB4F ECU_ADDRESS 0x3F95D4 /end MEASUREMENT
/begin MEASUREMENT ed_fil_m_spule_z9.fehler_aufrufe_nv "Gesamtzahl der Fehleraufrufe" UBYTE FORMULA_0003 0 0.0 0.0 255.0 READ_WRITE ECU_ADDRESS 0x3F95D7 /end MEASUREMENT
/begin MEASUREMENT ed_fil_m_spule_z9.filter_max_nv "Maximaler Fehlerfilterwert" UBYTE FORMULA_0003 0 0.0 0.0 255.0 READ_WRITE ECU_ADDRESS 0x3F95D6 /end MEASUREMENT
/begin MEASUREMENT ed_fil_m_spule_z9.filter_nv "Filterwert vor und nach Eintrag" UBYTE FORMULA_0003 0 0.0 0.0 255.0 READ_WRITE ECU_ADDRESS 0x3F95D2 /end MEASUREMENT
/begin MEASUREMENT ed_fil_m_spule_z9.zyklus_filter_nv "Vorwaertsfilter zur Fehlerzustandsbestaetigung" UBYTE FORMULA_0003 0 0.0 0.0 255.0 READ_WRITE ECU_ADDRESS 0x3F95D3 /end MEASUREMENT
/begin MEASUREMENT ed_fil_md_sk_err.art_aktuell_nv "Fehlerart und Statusbits" UWORD FORMULA_0052 0 0.0 0.0 65535.0 READ_WRITE BIT_MASK 0xB4F ECU_ADDRESS 0x3F9430 /end MEASUREMENT
/begin MEASUREMENT ed_fil_md_sk_err.fehler_aufrufe_nv "Gesamtzahl der Fehleraufrufe" UBYTE FORMULA_0003 0 0.0 0.0 255.0 READ_WRITE ECU_ADDRESS 0x3F9433 /end MEASUREMENT
/begin MEASUREMENT ed_fil_md_sk_err.filter_max_nv "Maximaler Fehlerfilterwert" UBYTE FORMULA_0003 0 0.0 0.0 255.0 READ_WRITE ECU_ADDRESS 0x3F9432 /end MEASUREMENT
/begin MEASUREMENT ed_fil_md_sk_err.filter_nv "Filterwert vor und nach Eintrag" UBYTE FORMULA_0003 0 0.0 0.0 255.0 READ_WRITE ECU_ADDRESS 0x3F942E /end MEASUREMENT
/begin MEASUREMENT ed_fil_md_sk_err.zyklus_filter_nv "Vorwaertsfilter zur Fehlerzustandsbestaetigung" UBYTE FORMULA_0003 0 0.0 0.0 255.0 READ_WRITE ECU_ADDRESS 0x3F942F /end MEASUREMENT
/begin MEASUREMENT ed_fil_n_getr_ein_hs.art_aktuell_nv "Fehlerart und Statusbits" UWORD FORMULA_0052 0 0.0 0.0 65535.0 READ_WRITE BIT_MASK 0xB4F ECU_ADDRESS 0x3F9580 /end MEASUREMENT
/begin MEASUREMENT ed_fil_n_getr_ein_hs.fehler_aufrufe_nv "Gesamtzahl der Fehleraufrufe" UBYTE FORMULA_0003 0 0.0 0.0 255.0 READ_WRITE ECU_ADDRESS 0x3F9583 /end MEASUREMENT
/begin MEASUREMENT ed_fil_n_getr_ein_hs.filter_max_nv "Maximaler Fehlerfilterwert" UBYTE FORMULA_0003 0 0.0 0.0 255.0 READ_WRITE ECU_ADDRESS 0x3F9582 /end MEASUREMENT
/begin MEASUREMENT ed_fil_n_getr_ein_hs.filter_nv "Filterwert vor und nach Eintrag" UBYTE FORMULA_0003 0 0.0 0.0 255.0 READ_WRITE ECU_ADDRESS 0x3F957E /end MEASUREMENT
/begin MEASUREMENT ed_fil_n_getr_ein_hs.zyklus_filter_nv "Vorwaertsfilter zur Fehlerzustandsbestaetigung" UBYTE FORMULA_0003 0 0.0 0.0 255.0 READ_WRITE ECU_ADDRESS 0x3F957F /end MEASUREMENT
/begin MEASUREMENT ed_fil_pctrl_ign.art_aktuell_nv "Fehlerart und Statusbits" UWORD FORMULA_0052 0 0.0 0.0 65535.0 READ_WRITE BIT_MASK 0xB4F ECU_ADDRESS 0x3F936A /end MEASUREMENT
/begin MEASUREMENT ed_fil_pctrl_ign.fehler_aufrufe_nv "Gesamtzahl der Fehleraufrufe" UBYTE FORMULA_0003 0 0.0 0.0 255.0 READ_WRITE ECU_ADDRESS 0x3F936D /end MEASUREMENT
/begin MEASUREMENT ed_fil_pctrl_ign.filter_max_nv "Maximaler Fehlerfilterwert" UBYTE FORMULA_0003 0 0.0 0.0 255.0 READ_WRITE ECU_ADDRESS 0x3F936C /end MEASUREMENT
/begin MEASUREMENT ed_fil_pctrl_ign.filter_nv "Filterwert vor und nach Eintrag" UBYTE FORMULA_0003 0 0.0 0.0 255.0 READ_WRITE ECU_ADDRESS 0x3F9368 /end MEASUREMENT
/begin MEASUREMENT ed_fil_pctrl_ign.zyklus_filter_nv "Vorwaertsfilter zur Fehlerzustandsbestaetigung" UBYTE FORMULA_0003 0 0.0 0.0 255.0 READ_WRITE ECU_ADDRESS 0x3F9369 /end MEASUREMENT
/begin MEASUREMENT ed_fil_pwg_bls.art_aktuell_nv "Fehlerart und Statusbits" UWORD FORMULA_0052 0 0.0 0.0 65535.0 READ_WRITE BIT_MASK 0xB4F ECU_ADDRESS 0x3F956E /end MEASUREMENT
/begin MEASUREMENT ed_fil_pwg_bls.fehler_aufrufe_nv "Gesamtzahl der Fehleraufrufe" UBYTE FORMULA_0003 0 0.0 0.0 255.0 READ_WRITE ECU_ADDRESS 0x3F9571 /end MEASUREMENT
/begin MEASUREMENT ed_fil_pwg_bls.filter_max_nv "Maximaler Fehlerfilterwert" UBYTE FORMULA_0003 0 0.0 0.0 255.0 READ_WRITE ECU_ADDRESS 0x3F9570 /end MEASUREMENT
/begin MEASUREMENT ed_fil_pwg_bls.filter_nv "Filterwert vor und nach Eintrag" UBYTE FORMULA_0003 0 0.0 0.0 255.0 READ_WRITE ECU_ADDRESS 0x3F956C /end MEASUREMENT
/begin MEASUREMENT ed_fil_pwg_bls.zyklus_filter_nv "Vorwaertsfilter zur Fehlerzustandsbestaetigung" UBYTE FORMULA_0003 0 0.0 0.0 255.0 READ_WRITE ECU_ADDRESS 0x3F956D /end MEASUREMENT
/begin MEASUREMENT ed_fil_pwg_vgl.art_aktuell_nv "Fehlerart und Statusbits" UWORD FORMULA_0052 0 0.0 0.0 65535.0 READ_WRITE BIT_MASK 0xB4F ECU_ADDRESS 0x3F9364 /end MEASUREMENT
/begin MEASUREMENT ed_fil_pwg_vgl.fehler_aufrufe_nv "Gesamtzahl der Fehleraufrufe" UBYTE FORMULA_0003 0 0.0 0.0 255.0 READ_WRITE ECU_ADDRESS 0x3F9367 /end MEASUREMENT
/begin MEASUREMENT ed_fil_pwg_vgl.filter_max_nv "Maximaler Fehlerfilterwert" UBYTE FORMULA_0003 0 0.0 0.0 255.0 READ_WRITE ECU_ADDRESS 0x3F9366 /end MEASUREMENT
/begin MEASUREMENT ed_fil_pwg_vgl.filter_nv "Filterwert vor und nach Eintrag" UBYTE FORMULA_0003 0 0.0 0.0 255.0 READ_WRITE ECU_ADDRESS 0x3F9362 /end MEASUREMENT
/begin MEASUREMENT ed_fil_pwg_vgl.zyklus_filter_nv "Vorwaertsfilter zur Fehlerzustandsbestaetigung" UBYTE FORMULA_0003 0 0.0 0.0 255.0 READ_WRITE ECU_ADDRESS 0x3F9363 /end MEASUREMENT
/begin MEASUREMENT ed_fil_pwg1.art_aktuell_nv "Fehlerart und Statusbits" UWORD FORMULA_0052 0 0.0 0.0 65535.0 READ_WRITE BIT_MASK 0xB4F ECU_ADDRESS 0x3F9358 /end MEASUREMENT
/begin MEASUREMENT ed_fil_pwg1.fehler_aufrufe_nv "Gesamtzahl der Fehleraufrufe" UBYTE FORMULA_0003 0 0.0 0.0 255.0 READ_WRITE ECU_ADDRESS 0x3F935B /end MEASUREMENT
/begin MEASUREMENT ed_fil_pwg1.filter_max_nv "Maximaler Fehlerfilterwert" UBYTE FORMULA_0003 0 0.0 0.0 255.0 READ_WRITE ECU_ADDRESS 0x3F935A /end MEASUREMENT
/begin MEASUREMENT ed_fil_pwg1.filter_nv "Filterwert vor und nach Eintrag" UBYTE FORMULA_0003 0 0.0 0.0 255.0 READ_WRITE ECU_ADDRESS 0x3F9356 /end MEASUREMENT
/begin MEASUREMENT ed_fil_pwg1.zyklus_filter_nv "Vorwaertsfilter zur Fehlerzustandsbestaetigung" UBYTE FORMULA_0003 0 0.0 0.0 255.0 READ_WRITE ECU_ADDRESS 0x3F9357 /end MEASUREMENT
/begin MEASUREMENT ed_fil_pwg2.art_aktuell_nv "Fehlerart und Statusbits" UWORD FORMULA_0052 0 0.0 0.0 65535.0 READ_WRITE BIT_MASK 0xB4F ECU_ADDRESS 0x3F935E /end MEASUREMENT
/begin MEASUREMENT ed_fil_pwg2.fehler_aufrufe_nv "Gesamtzahl der Fehleraufrufe" UBYTE FORMULA_0003 0 0.0 0.0 255.0 READ_WRITE ECU_ADDRESS 0x3F9361 /end MEASUREMENT
/begin MEASUREMENT ed_fil_pwg2.filter_max_nv "Maximaler Fehlerfilterwert" UBYTE FORMULA_0003 0 0.0 0.0 255.0 READ_WRITE ECU_ADDRESS 0x3F9360 /end MEASUREMENT
/begin MEASUREMENT ed_fil_pwg2.filter_nv "Filterwert vor und nach Eintrag" UBYTE FORMULA_0003 0 0.0 0.0 255.0 READ_WRITE ECU_ADDRESS 0x3F935C /end MEASUREMENT
/begin MEASUREMENT ed_fil_pwg2.zyklus_filter_nv "Vorwaertsfilter zur Fehlerzustandsbestaetigung" UBYTE FORMULA_0003 0 0.0 0.0 255.0 READ_WRITE ECU_ADDRESS 0x3F935D /end MEASUREMENT
/begin MEASUREMENT ed_fil_sc_busoff.art_aktuell_nv "Fehlerart und Statusbits" UWORD FORMULA_0052 0 0.0 0.0 65535.0 READ_WRITE BIT_MASK 0xB4F ECU_ADDRESS 0x3F946C /end MEASUREMENT
/begin MEASUREMENT ed_fil_sc_busoff.fehler_aufrufe_nv "Gesamtzahl der Fehleraufrufe" UBYTE FORMULA_0003 0 0.0 0.0 255.0 READ_WRITE ECU_ADDRESS 0x3F946F /end MEASUREMENT
/begin MEASUREMENT ed_fil_sc_busoff.filter_max_nv "Maximaler Fehlerfilterwert" UBYTE FORMULA_0003 0 0.0 0.0 255.0 READ_WRITE ECU_ADDRESS 0x3F946E /end MEASUREMENT
/begin MEASUREMENT ed_fil_sc_busoff.filter_nv "Filterwert vor und nach Eintrag" UBYTE FORMULA_0003 0 0.0 0.0 255.0 READ_WRITE ECU_ADDRESS 0x3F946A /end MEASUREMENT
/begin MEASUREMENT ed_fil_sc_busoff.zyklus_filter_nv "Vorwaertsfilter zur Fehlerzustandsbestaetigung" UBYTE FORMULA_0003 0 0.0 0.0 255.0 READ_WRITE ECU_ADDRESS 0x3F946B /end MEASUREMENT
/begin MEASUREMENT ed_fil_sc_pks.art_aktuell_nv "Fehlerart und Statusbits" UWORD FORMULA_0052 0 0.0 0.0 65535.0 READ_WRITE BIT_MASK 0xB4F ECU_ADDRESS 0x3F9520 /end MEASUREMENT
/begin MEASUREMENT ed_fil_sc_pks.fehler_aufrufe_nv "Gesamtzahl der Fehleraufrufe" UBYTE FORMULA_0003 0 0.0 0.0 255.0 READ_WRITE ECU_ADDRESS 0x3F9523 /end MEASUREMENT
/begin MEASUREMENT ed_fil_sc_pks.filter_max_nv "Maximaler Fehlerfilterwert" UBYTE FORMULA_0003 0 0.0 0.0 255.0 READ_WRITE ECU_ADDRESS 0x3F9522 /end MEASUREMENT
/begin MEASUREMENT ed_fil_sc_pks.filter_nv "Filterwert vor und nach Eintrag" UBYTE FORMULA_0003 0 0.0 0.0 255.0 READ_WRITE ECU_ADDRESS 0x3F951E /end MEASUREMENT
/begin MEASUREMENT ed_fil_sc_pks.zyklus_filter_nv "Vorwaertsfilter zur Fehlerzustandsbestaetigung" UBYTE FORMULA_0003 0 0.0 0.0 255.0 READ_WRITE ECU_ADDRESS 0x3F951F /end MEASUREMENT
/begin MEASUREMENT ed_fil_sc_smg1.art_aktuell_nv "Fehlerart und Statusbits" UWORD FORMULA_0052 0 0.0 0.0 65535.0 READ_WRITE BIT_MASK 0xB4F ECU_ADDRESS 0x3F945A /end MEASUREMENT
/begin MEASUREMENT ed_fil_sc_smg1.fehler_aufrufe_nv "Gesamtzahl der Fehleraufrufe" UBYTE FORMULA_0003 0 0.0 0.0 255.0 READ_WRITE ECU_ADDRESS 0x3F945D /end MEASUREMENT
/begin MEASUREMENT ed_fil_sc_smg1.filter_max_nv "Maximaler Fehlerfilterwert" UBYTE FORMULA_0003 0 0.0 0.0 255.0 READ_WRITE ECU_ADDRESS 0x3F945C /end MEASUREMENT
/begin MEASUREMENT ed_fil_sc_smg1.filter_nv "Filterwert vor und nach Eintrag" UBYTE FORMULA_0003 0 0.0 0.0 255.0 READ_WRITE ECU_ADDRESS 0x3F9458 /end MEASUREMENT
/begin MEASUREMENT ed_fil_sc_smg1.zyklus_filter_nv "Vorwaertsfilter zur Fehlerzustandsbestaetigung" UBYTE FORMULA_0003 0 0.0 0.0 255.0 READ_WRITE ECU_ADDRESS 0x3F9459 /end MEASUREMENT
/begin MEASUREMENT ed_fil_sc_smg2.art_aktuell_nv "Fehlerart und Statusbits" UWORD FORMULA_0052 0 0.0 0.0 65535.0 READ_WRITE BIT_MASK 0xB4F ECU_ADDRESS 0x3F9460 /end MEASUREMENT
/begin MEASUREMENT ed_fil_sc_smg2.fehler_aufrufe_nv "Gesamtzahl der Fehleraufrufe" UBYTE FORMULA_0003 0 0.0 0.0 255.0 READ_WRITE ECU_ADDRESS 0x3F9463 /end MEASUREMENT
/begin MEASUREMENT ed_fil_sc_smg2.filter_max_nv "Maximaler Fehlerfilterwert" UBYTE FORMULA_0003 0 0.0 0.0 255.0 READ_WRITE ECU_ADDRESS 0x3F9462 /end MEASUREMENT
/begin MEASUREMENT ed_fil_sc_smg2.filter_nv "Filterwert vor und nach Eintrag" UBYTE FORMULA_0003 0 0.0 0.0 255.0 READ_WRITE ECU_ADDRESS 0x3F945E /end MEASUREMENT
/begin MEASUREMENT ed_fil_sc_smg2.zyklus_filter_nv "Vorwaertsfilter zur Fehlerzustandsbestaetigung" UBYTE FORMULA_0003 0 0.0 0.0 255.0 READ_WRITE ECU_ADDRESS 0x3F945F /end MEASUREMENT
/begin MEASUREMENT ed_fil_sc_smg3.art_aktuell_nv "Fehlerart und Statusbits" UWORD FORMULA_0052 0 0.0 0.0 65535.0 READ_WRITE BIT_MASK 0xB4F ECU_ADDRESS 0x3F9466 /end MEASUREMENT
/begin MEASUREMENT ed_fil_sc_smg3.fehler_aufrufe_nv "Gesamtzahl der Fehleraufrufe" UBYTE FORMULA_0003 0 0.0 0.0 255.0 READ_WRITE ECU_ADDRESS 0x3F9469 /end MEASUREMENT
/begin MEASUREMENT ed_fil_sc_smg3.filter_max_nv "Maximaler Fehlerfilterwert" UBYTE FORMULA_0003 0 0.0 0.0 255.0 READ_WRITE ECU_ADDRESS 0x3F9468 /end MEASUREMENT
/begin MEASUREMENT ed_fil_sc_smg3.filter_nv "Filterwert vor und nach Eintrag" UBYTE FORMULA_0003 0 0.0 0.0 255.0 READ_WRITE ECU_ADDRESS 0x3F9464 /end MEASUREMENT
/begin MEASUREMENT ed_fil_sc_smg3.zyklus_filter_nv "Vorwaertsfilter zur Fehlerzustandsbestaetigung" UBYTE FORMULA_0003 0 0.0 0.0 255.0 READ_WRITE ECU_ADDRESS 0x3F9465 /end MEASUREMENT
/begin MEASUREMENT ed_fil_servo_i.art_aktuell_nv "Fehlerart und Statusbits" UWORD FORMULA_0052 0 0.0 0.0 65535.0 READ_WRITE BIT_MASK 0xB4F ECU_ADDRESS 0x3F9586 /end MEASUREMENT
/begin MEASUREMENT ed_fil_servo_i.fehler_aufrufe_nv "Gesamtzahl der Fehleraufrufe" UBYTE FORMULA_0003 0 0.0 0.0 255.0 READ_WRITE ECU_ADDRESS 0x3F9589 /end MEASUREMENT
/begin MEASUREMENT ed_fil_servo_i.filter_max_nv "Maximaler Fehlerfilterwert" UBYTE FORMULA_0003 0 0.0 0.0 255.0 READ_WRITE ECU_ADDRESS 0x3F9588 /end MEASUREMENT
/begin MEASUREMENT ed_fil_servo_i.filter_nv "Filterwert vor und nach Eintrag" UBYTE FORMULA_0003 0 0.0 0.0 255.0 READ_WRITE ECU_ADDRESS 0x3F9584 /end MEASUREMENT
/begin MEASUREMENT ed_fil_servo_i.zyklus_filter_nv "Vorwaertsfilter zur Fehlerzustandsbestaetigung" UBYTE FORMULA_0003 0 0.0 0.0 255.0 READ_WRITE ECU_ADDRESS 0x3F9585 /end MEASUREMENT
/begin MEASUREMENT ed_fil_servo_v.art_aktuell_nv "Fehlerart und Statusbits" UWORD FORMULA_0052 0 0.0 0.0 65535.0 READ_WRITE BIT_MASK 0xB4F ECU_ADDRESS 0x3F958C /end MEASUREMENT
/begin MEASUREMENT ed_fil_servo_v.fehler_aufrufe_nv "Gesamtzahl der Fehleraufrufe" UBYTE FORMULA_0003 0 0.0 0.0 255.0 READ_WRITE ECU_ADDRESS 0x3F958F /end MEASUREMENT
/begin MEASUREMENT ed_fil_servo_v.filter_max_nv "Maximaler Fehlerfilterwert" UBYTE FORMULA_0003 0 0.0 0.0 255.0 READ_WRITE ECU_ADDRESS 0x3F958E /end MEASUREMENT
/begin MEASUREMENT ed_fil_servo_v.filter_nv "Filterwert vor und nach Eintrag" UBYTE FORMULA_0003 0 0.0 0.0 255.0 READ_WRITE ECU_ADDRESS 0x3F958A /end MEASUREMENT
/begin MEASUREMENT ed_fil_servo_v.zyklus_filter_nv "Vorwaertsfilter zur Fehlerzustandsbestaetigung" UBYTE FORMULA_0003 0 0.0 0.0 255.0 READ_WRITE ECU_ADDRESS 0x3F958B /end MEASUREMENT
/begin MEASUREMENT ed_fil_sg_ign.art_aktuell_nv "Fehlerart und Statusbits" UWORD FORMULA_0052 0 0.0 0.0 65535.0 READ_WRITE BIT_MASK 0xB4F ECU_ADDRESS 0x3F9532 /end MEASUREMENT
/begin MEASUREMENT ed_fil_sg_ign.fehler_aufrufe_nv "Gesamtzahl der Fehleraufrufe" UBYTE FORMULA_0003 0 0.0 0.0 255.0 READ_WRITE ECU_ADDRESS 0x3F9535 /end MEASUREMENT
/begin MEASUREMENT ed_fil_sg_ign.filter_max_nv "Maximaler Fehlerfilterwert" UBYTE FORMULA_0003 0 0.0 0.0 255.0 READ_WRITE ECU_ADDRESS 0x3F9534 /end MEASUREMENT
/begin MEASUREMENT ed_fil_sg_ign.filter_nv "Filterwert vor und nach Eintrag" UBYTE FORMULA_0003 0 0.0 0.0 255.0 READ_WRITE ECU_ADDRESS 0x3F9530 /end MEASUREMENT
/begin MEASUREMENT ed_fil_sg_ign.zyklus_filter_nv "Vorwaertsfilter zur Fehlerzustandsbestaetigung" UBYTE FORMULA_0003 0 0.0 0.0 255.0 READ_WRITE ECU_ADDRESS 0x3F9531 /end MEASUREMENT
/begin MEASUREMENT ed_fil_sk_manager_ign.art_aktuell_nv "Fehlerart und Statusbits" UWORD FORMULA_0052 0 0.0 0.0 65535.0 READ_WRITE BIT_MASK 0xB4F ECU_ADDRESS 0x3F9544 /end MEASUREMENT
/begin MEASUREMENT ed_fil_sk_manager_ign.fehler_aufrufe_nv "Gesamtzahl der Fehleraufrufe" UBYTE FORMULA_0003 0 0.0 0.0 255.0 READ_WRITE ECU_ADDRESS 0x3F9547 /end MEASUREMENT
/begin MEASUREMENT ed_fil_sk_manager_ign.filter_max_nv "Maximaler Fehlerfilterwert" UBYTE FORMULA_0003 0 0.0 0.0 255.0 READ_WRITE ECU_ADDRESS 0x3F9546 /end MEASUREMENT
/begin MEASUREMENT ed_fil_sk_manager_ign.filter_nv "Filterwert vor und nach Eintrag" UBYTE FORMULA_0003 0 0.0 0.0 255.0 READ_WRITE ECU_ADDRESS 0x3F9542 /end MEASUREMENT
/begin MEASUREMENT ed_fil_sk_manager_ign.zyklus_filter_nv "Vorwaertsfilter zur Fehlerzustandsbestaetigung" UBYTE FORMULA_0003 0 0.0 0.0 255.0 READ_WRITE ECU_ADDRESS 0x3F9543 /end MEASUREMENT
/begin MEASUREMENT ed_fil_sk_tr_ign.art_aktuell_nv "Fehlerart und Statusbits" UWORD FORMULA_0052 0 0.0 0.0 65535.0 READ_WRITE BIT_MASK 0xB4F ECU_ADDRESS 0x3F930A /end MEASUREMENT
/begin MEASUREMENT ed_fil_sk_tr_ign.fehler_aufrufe_nv "Gesamtzahl der Fehleraufrufe" UBYTE FORMULA_0003 0 0.0 0.0 255.0 READ_WRITE ECU_ADDRESS 0x3F930D /end MEASUREMENT
/begin MEASUREMENT ed_fil_sk_tr_ign.filter_max_nv "Maximaler Fehlerfilterwert" UBYTE FORMULA_0003 0 0.0 0.0 255.0 READ_WRITE ECU_ADDRESS 0x3F930C /end MEASUREMENT
/begin MEASUREMENT ed_fil_sk_tr_ign.filter_nv "Filterwert vor und nach Eintrag" UBYTE FORMULA_0003 0 0.0 0.0 255.0 READ_WRITE ECU_ADDRESS 0x3F9308 /end MEASUREMENT
/begin MEASUREMENT ed_fil_sk_tr_ign.zyklus_filter_nv "Vorwaertsfilter zur Fehlerzustandsbestaetigung" UBYTE FORMULA_0003 0 0.0 0.0 255.0 READ_WRITE ECU_ADDRESS 0x3F9309 /end MEASUREMENT
/begin MEASUREMENT ed_fil_smg_schaltab.art_aktuell_nv "Fehlerart und Statusbits" UWORD FORMULA_0052 0 0.0 0.0 65535.0 READ_WRITE BIT_MASK 0xB4F ECU_ADDRESS 0x3F9394 /end MEASUREMENT
/begin MEASUREMENT ed_fil_smg_schaltab.fehler_aufrufe_nv "Gesamtzahl der Fehleraufrufe" UBYTE FORMULA_0003 0 0.0 0.0 255.0 READ_WRITE ECU_ADDRESS 0x3F9397 /end MEASUREMENT
/begin MEASUREMENT ed_fil_smg_schaltab.filter_max_nv "Maximaler Fehlerfilterwert" UBYTE FORMULA_0003 0 0.0 0.0 255.0 READ_WRITE ECU_ADDRESS 0x3F9396 /end MEASUREMENT
/begin MEASUREMENT ed_fil_smg_schaltab.filter_nv "Filterwert vor und nach Eintrag" UBYTE FORMULA_0003 0 0.0 0.0 255.0 READ_WRITE ECU_ADDRESS 0x3F9392 /end MEASUREMENT
/begin MEASUREMENT ed_fil_smg_schaltab.zyklus_filter_nv "Vorwaertsfilter zur Fehlerzustandsbestaetigung" UBYTE FORMULA_0003 0 0.0 0.0 255.0 READ_WRITE ECU_ADDRESS 0x3F9393 /end MEASUREMENT
/begin MEASUREMENT ed_fil_smg_sk.art_aktuell_nv "Fehlerart und Statusbits" UWORD FORMULA_0052 0 0.0 0.0 65535.0 READ_WRITE BIT_MASK 0xB4F ECU_ADDRESS 0x3F939A /end MEASUREMENT
/begin MEASUREMENT ed_fil_smg_sk.fehler_aufrufe_nv "Gesamtzahl der Fehleraufrufe" UBYTE FORMULA_0003 0 0.0 0.0 255.0 READ_WRITE ECU_ADDRESS 0x3F939D /end MEASUREMENT
/begin MEASUREMENT ed_fil_smg_sk.filter_max_nv "Maximaler Fehlerfilterwert" UBYTE FORMULA_0003 0 0.0 0.0 255.0 READ_WRITE ECU_ADDRESS 0x3F939C /end MEASUREMENT
/begin MEASUREMENT ed_fil_smg_sk.filter_nv "Filterwert vor und nach Eintrag" UBYTE FORMULA_0003 0 0.0 0.0 255.0 READ_WRITE ECU_ADDRESS 0x3F9398 /end MEASUREMENT
/begin MEASUREMENT ed_fil_smg_sk.zyklus_filter_nv "Vorwaertsfilter zur Fehlerzustandsbestaetigung" UBYTE FORMULA_0003 0 0.0 0.0 255.0 READ_WRITE ECU_ADDRESS 0x3F9399 /end MEASUREMENT
/begin MEASUREMENT ed_fil_smg_sk_n.art_aktuell_nv "Fehlerart und Statusbits" UWORD FORMULA_0052 0 0.0 0.0 65535.0 READ_WRITE BIT_MASK 0xB4F ECU_ADDRESS 0x3F93A0 /end MEASUREMENT
/begin MEASUREMENT ed_fil_smg_sk_n.fehler_aufrufe_nv "Gesamtzahl der Fehleraufrufe" UBYTE FORMULA_0003 0 0.0 0.0 255.0 READ_WRITE ECU_ADDRESS 0x3F93A3 /end MEASUREMENT
/begin MEASUREMENT ed_fil_smg_sk_n.filter_max_nv "Maximaler Fehlerfilterwert" UBYTE FORMULA_0003 0 0.0 0.0 255.0 READ_WRITE ECU_ADDRESS 0x3F93A2 /end MEASUREMENT
/begin MEASUREMENT ed_fil_smg_sk_n.filter_nv "Filterwert vor und nach Eintrag" UBYTE FORMULA_0003 0 0.0 0.0 255.0 READ_WRITE ECU_ADDRESS 0x3F939E /end MEASUREMENT
/begin MEASUREMENT ed_fil_smg_sk_n.zyklus_filter_nv "Vorwaertsfilter zur Fehlerzustandsbestaetigung" UBYTE FORMULA_0003 0 0.0 0.0 255.0 READ_WRITE ECU_ADDRESS 0x3F939F /end MEASUREMENT
/begin MEASUREMENT ed_fil_start_rl.art_aktuell_nv "Fehlerart und Statusbits" UWORD FORMULA_0052 0 0.0 0.0 65535.0 READ_WRITE BIT_MASK 0xB4F ECU_ADDRESS 0x3F9574 /end MEASUREMENT
/begin MEASUREMENT ed_fil_start_rl.fehler_aufrufe_nv "Gesamtzahl der Fehleraufrufe" UBYTE FORMULA_0003 0 0.0 0.0 255.0 READ_WRITE ECU_ADDRESS 0x3F9577 /end MEASUREMENT
/begin MEASUREMENT ed_fil_start_rl.filter_max_nv "Maximaler Fehlerfilterwert" UBYTE FORMULA_0003 0 0.0 0.0 255.0 READ_WRITE ECU_ADDRESS 0x3F9576 /end MEASUREMENT
/begin MEASUREMENT ed_fil_start_rl.filter_nv "Filterwert vor und nach Eintrag" UBYTE FORMULA_0003 0 0.0 0.0 255.0 READ_WRITE ECU_ADDRESS 0x3F9572 /end MEASUREMENT
/begin MEASUREMENT ed_fil_start_rl.zyklus_filter_nv "Vorwaertsfilter zur Fehlerzustandsbestaetigung" UBYTE FORMULA_0003 0 0.0 0.0 255.0 READ_WRITE ECU_ADDRESS 0x3F9573 /end MEASUREMENT
/begin MEASUREMENT ed_fil_tabg1.art_aktuell_nv "Fehlerart und Statusbits" UWORD FORMULA_0052 0 0.0 0.0 65535.0 READ_WRITE BIT_MASK 0xB4F ECU_ADDRESS 0x3F93E8 /end MEASUREMENT
/begin MEASUREMENT ed_fil_tabg1.fehler_aufrufe_nv "Gesamtzahl der Fehleraufrufe" UBYTE FORMULA_0003 0 0.0 0.0 255.0 READ_WRITE ECU_ADDRESS 0x3F93EB /end MEASUREMENT
/begin MEASUREMENT ed_fil_tabg1.filter_max_nv "Maximaler Fehlerfilterwert" UBYTE FORMULA_0003 0 0.0 0.0 255.0 READ_WRITE ECU_ADDRESS 0x3F93EA /end MEASUREMENT
/begin MEASUREMENT ed_fil_tabg1.filter_nv "Filterwert vor und nach Eintrag" UBYTE FORMULA_0003 0 0.0 0.0 255.0 READ_WRITE ECU_ADDRESS 0x3F93E6 /end MEASUREMENT
/begin MEASUREMENT ed_fil_tabg1.zyklus_filter_nv "Vorwaertsfilter zur Fehlerzustandsbestaetigung" UBYTE FORMULA_0003 0 0.0 0.0 255.0 READ_WRITE ECU_ADDRESS 0x3F93E7 /end MEASUREMENT
/begin MEASUREMENT ed_fil_tabg2.art_aktuell_nv "Fehlerart und Statusbits" UWORD FORMULA_0052 0 0.0 0.0 65535.0 READ_WRITE BIT_MASK 0xB4F ECU_ADDRESS 0x3F93EE /end MEASUREMENT
/begin MEASUREMENT ed_fil_tabg2.fehler_aufrufe_nv "Gesamtzahl der Fehleraufrufe" UBYTE FORMULA_0003 0 0.0 0.0 255.0 READ_WRITE ECU_ADDRESS 0x3F93F1 /end MEASUREMENT
/begin MEASUREMENT ed_fil_tabg2.filter_max_nv "Maximaler Fehlerfilterwert" UBYTE FORMULA_0003 0 0.0 0.0 255.0 READ_WRITE ECU_ADDRESS 0x3F93F0 /end MEASUREMENT
/begin MEASUREMENT ed_fil_tabg2.filter_nv "Filterwert vor und nach Eintrag" UBYTE FORMULA_0003 0 0.0 0.0 255.0 READ_WRITE ECU_ADDRESS 0x3F93EC /end MEASUREMENT
/begin MEASUREMENT ed_fil_tabg2.zyklus_filter_nv "Vorwaertsfilter zur Fehlerzustandsbestaetigung" UBYTE FORMULA_0003 0 0.0 0.0 255.0 READ_WRITE ECU_ADDRESS 0x3F93ED /end MEASUREMENT
/begin MEASUREMENT ed_fil_tan_obd_b1.art_aktuell_nv "Fehlerart und Statusbits" UWORD FORMULA_0052 0 0.0 0.0 65535.0 READ_WRITE BIT_MASK 0xB4F ECU_ADDRESS 0x3F9514 /end MEASUREMENT
/begin MEASUREMENT ed_fil_tan_obd_b1.fehler_aufrufe_nv "Gesamtzahl der Fehleraufrufe" UBYTE FORMULA_0003 0 0.0 0.0 255.0 READ_WRITE ECU_ADDRESS 0x3F9517 /end MEASUREMENT
/begin MEASUREMENT ed_fil_tan_obd_b1.filter_max_nv "Maximaler Fehlerfilterwert" UBYTE FORMULA_0003 0 0.0 0.0 255.0 READ_WRITE ECU_ADDRESS 0x3F9516 /end MEASUREMENT
/begin MEASUREMENT ed_fil_tan_obd_b1.filter_nv "Filterwert vor und nach Eintrag" UBYTE FORMULA_0003 0 0.0 0.0 255.0 READ_WRITE ECU_ADDRESS 0x3F9512 /end MEASUREMENT
/begin MEASUREMENT ed_fil_tan_obd_b1.zyklus_filter_nv "Vorwaertsfilter zur Fehlerzustandsbestaetigung" UBYTE FORMULA_0003 0 0.0 0.0 255.0 READ_WRITE ECU_ADDRESS 0x3F9513 /end MEASUREMENT
/begin MEASUREMENT ed_fil_tan_obd_b2.art_aktuell_nv "Fehlerart und Statusbits" UWORD FORMULA_0052 0 0.0 0.0 65535.0 READ_WRITE BIT_MASK 0xB4F ECU_ADDRESS 0x3F9556 /end MEASUREMENT
/begin MEASUREMENT ed_fil_tan_obd_b2.fehler_aufrufe_nv "Gesamtzahl der Fehleraufrufe" UBYTE FORMULA_0003 0 0.0 0.0 255.0 READ_WRITE ECU_ADDRESS 0x3F9559 /end MEASUREMENT
/begin MEASUREMENT ed_fil_tan_obd_b2.filter_max_nv "Maximaler Fehlerfilterwert" UBYTE FORMULA_0003 0 0.0 0.0 255.0 READ_WRITE ECU_ADDRESS 0x3F9558 /end MEASUREMENT
/begin MEASUREMENT ed_fil_tan_obd_b2.filter_nv "Filterwert vor und nach Eintrag" UBYTE FORMULA_0003 0 0.0 0.0 255.0 READ_WRITE ECU_ADDRESS 0x3F9554 /end MEASUREMENT
/begin MEASUREMENT ed_fil_tan_obd_b2.zyklus_filter_nv "Vorwaertsfilter zur Fehlerzustandsbestaetigung" UBYTE FORMULA_0003 0 0.0 0.0 255.0 READ_WRITE ECU_ADDRESS 0x3F9555 /end MEASUREMENT
/begin MEASUREMENT ed_fil_tan1.art_aktuell_nv "Fehlerart und Statusbits" UWORD FORMULA_0052 0 0.0 0.0 65535.0 READ_WRITE BIT_MASK 0xB4F ECU_ADDRESS 0x3F931C /end MEASUREMENT
/begin MEASUREMENT ed_fil_tan1.fehler_aufrufe_nv "Gesamtzahl der Fehleraufrufe" UBYTE FORMULA_0003 0 0.0 0.0 255.0 READ_WRITE ECU_ADDRESS 0x3F931F /end MEASUREMENT
/begin MEASUREMENT ed_fil_tan1.filter_max_nv "Maximaler Fehlerfilterwert" UBYTE FORMULA_0003 0 0.0 0.0 255.0 READ_WRITE ECU_ADDRESS 0x3F931E /end MEASUREMENT
/begin MEASUREMENT ed_fil_tan1.filter_nv "Filterwert vor und nach Eintrag" UBYTE FORMULA_0003 0 0.0 0.0 255.0 READ_WRITE ECU_ADDRESS 0x3F931A /end MEASUREMENT
/begin MEASUREMENT ed_fil_tan1.zyklus_filter_nv "Vorwaertsfilter zur Fehlerzustandsbestaetigung" UBYTE FORMULA_0003 0 0.0 0.0 255.0 READ_WRITE ECU_ADDRESS 0x3F931B /end MEASUREMENT
/begin MEASUREMENT ed_fil_tan2.art_aktuell_nv "Fehlerart und Statusbits" UWORD FORMULA_0052 0 0.0 0.0 65535.0 READ_WRITE BIT_MASK 0xB4F ECU_ADDRESS 0x3F9322 /end MEASUREMENT
/begin MEASUREMENT ed_fil_tan2.fehler_aufrufe_nv "Gesamtzahl der Fehleraufrufe" UBYTE FORMULA_0003 0 0.0 0.0 255.0 READ_WRITE ECU_ADDRESS 0x3F9325 /end MEASUREMENT
/begin MEASUREMENT ed_fil_tan2.filter_max_nv "Maximaler Fehlerfilterwert" UBYTE FORMULA_0003 0 0.0 0.0 255.0 READ_WRITE ECU_ADDRESS 0x3F9324 /end MEASUREMENT
/begin MEASUREMENT ed_fil_tan2.filter_nv "Filterwert vor und nach Eintrag" UBYTE FORMULA_0003 0 0.0 0.0 255.0 READ_WRITE ECU_ADDRESS 0x3F9320 /end MEASUREMENT
/begin MEASUREMENT ed_fil_tan2.zyklus_filter_nv "Vorwaertsfilter zur Fehlerzustandsbestaetigung" UBYTE FORMULA_0003 0 0.0 0.0 255.0 READ_WRITE ECU_ADDRESS 0x3F9321 /end MEASUREMENT
/begin MEASUREMENT ed_fil_tdme.art_aktuell_nv "Fehlerart und Statusbits" UWORD FORMULA_0052 0 0.0 0.0 65535.0 READ_WRITE BIT_MASK 0xB4F ECU_ADDRESS 0x3F933A /end MEASUREMENT
/begin MEASUREMENT ed_fil_tdme.fehler_aufrufe_nv "Gesamtzahl der Fehleraufrufe" UBYTE FORMULA_0003 0 0.0 0.0 255.0 READ_WRITE ECU_ADDRESS 0x3F933D /end MEASUREMENT
/begin MEASUREMENT ed_fil_tdme.filter_max_nv "Maximaler Fehlerfilterwert" UBYTE FORMULA_0003 0 0.0 0.0 255.0 READ_WRITE ECU_ADDRESS 0x3F933C /end MEASUREMENT
/begin MEASUREMENT ed_fil_tdme.filter_nv "Filterwert vor und nach Eintrag" UBYTE FORMULA_0003 0 0.0 0.0 255.0 READ_WRITE ECU_ADDRESS 0x3F9338 /end MEASUREMENT
/begin MEASUREMENT ed_fil_tdme.zyklus_filter_nv "Vorwaertsfilter zur Fehlerzustandsbestaetigung" UBYTE FORMULA_0003 0 0.0 0.0 255.0 READ_WRITE ECU_ADDRESS 0x3F9339 /end MEASUREMENT
/begin MEASUREMENT ed_fil_thermostat.art_aktuell_nv "Fehlerart und Statusbits" UWORD FORMULA_0052 0 0.0 0.0 65535.0 READ_WRITE BIT_MASK 0xB4F ECU_ADDRESS 0x3F9550 /end MEASUREMENT
/begin MEASUREMENT ed_fil_thermostat.fehler_aufrufe_nv "Gesamtzahl der Fehleraufrufe" UBYTE FORMULA_0003 0 0.0 0.0 255.0 READ_WRITE ECU_ADDRESS 0x3F9553 /end MEASUREMENT
/begin MEASUREMENT ed_fil_thermostat.filter_max_nv "Maximaler Fehlerfilterwert" UBYTE FORMULA_0003 0 0.0 0.0 255.0 READ_WRITE ECU_ADDRESS 0x3F9552 /end MEASUREMENT
/begin MEASUREMENT ed_fil_thermostat.filter_nv "Filterwert vor und nach Eintrag" UBYTE FORMULA_0003 0 0.0 0.0 255.0 READ_WRITE ECU_ADDRESS 0x3F954E /end MEASUREMENT
/begin MEASUREMENT ed_fil_thermostat.zyklus_filter_nv "Vorwaertsfilter zur Fehlerzustandsbestaetigung" UBYTE FORMULA_0003 0 0.0 0.0 255.0 READ_WRITE ECU_ADDRESS 0x3F954F /end MEASUREMENT
/begin MEASUREMENT ed_fil_time_rel_obd.art_aktuell_nv "Fehlerart und Statusbits" UWORD FORMULA_0052 0 0.0 0.0 65535.0 READ_WRITE BIT_MASK 0xB4F ECU_ADDRESS 0x3F9328 /end MEASUREMENT
/begin MEASUREMENT ed_fil_time_rel_obd.fehler_aufrufe_nv "Gesamtzahl der Fehleraufrufe" UBYTE FORMULA_0003 0 0.0 0.0 255.0 READ_WRITE ECU_ADDRESS 0x3F932B /end MEASUREMENT
/begin MEASUREMENT ed_fil_time_rel_obd.filter_max_nv "Maximaler Fehlerfilterwert" UBYTE FORMULA_0003 0 0.0 0.0 255.0 READ_WRITE ECU_ADDRESS 0x3F932A /end MEASUREMENT
/begin MEASUREMENT ed_fil_time_rel_obd.filter_nv "Filterwert vor und nach Eintrag" UBYTE FORMULA_0003 0 0.0 0.0 255.0 READ_WRITE ECU_ADDRESS 0x3F9326 /end MEASUREMENT
/begin MEASUREMENT ed_fil_time_rel_obd.zyklus_filter_nv "Vorwaertsfilter zur Fehlerzustandsbestaetigung" UBYTE FORMULA_0003 0 0.0 0.0 255.0 READ_WRITE ECU_ADDRESS 0x3F9327 /end MEASUREMENT
/begin MEASUREMENT ed_fil_tka.art_aktuell_nv "Fehlerart und Statusbits" UWORD FORMULA_0052 0 0.0 0.0 65535.0 READ_WRITE BIT_MASK 0xB4F ECU_ADDRESS 0x3F9334 /end MEASUREMENT
/begin MEASUREMENT ed_fil_tka.fehler_aufrufe_nv "Gesamtzahl der Fehleraufrufe" UBYTE FORMULA_0003 0 0.0 0.0 255.0 READ_WRITE ECU_ADDRESS 0x3F9337 /end MEASUREMENT
/begin MEASUREMENT ed_fil_tka.filter_max_nv "Maximaler Fehlerfilterwert" UBYTE FORMULA_0003 0 0.0 0.0 255.0 READ_WRITE ECU_ADDRESS 0x3F9336 /end MEASUREMENT
/begin MEASUREMENT ed_fil_tka.filter_nv "Filterwert vor und nach Eintrag" UBYTE FORMULA_0003 0 0.0 0.0 255.0 READ_WRITE ECU_ADDRESS 0x3F9332 /end MEASUREMENT
/begin MEASUREMENT ed_fil_tka.zyklus_filter_nv "Vorwaertsfilter zur Fehlerzustandsbestaetigung" UBYTE FORMULA_0003 0 0.0 0.0 255.0 READ_WRITE ECU_ADDRESS 0x3F9333 /end MEASUREMENT
/begin MEASUREMENT ed_fil_tka_obd.art_aktuell_nv "Fehlerart und Statusbits" UWORD FORMULA_0052 0 0.0 0.0 65535.0 READ_WRITE BIT_MASK 0xB4F ECU_ADDRESS 0x3F9352 /end MEASUREMENT
/begin MEASUREMENT ed_fil_tka_obd.fehler_aufrufe_nv "Gesamtzahl der Fehleraufrufe" UBYTE FORMULA_0003 0 0.0 0.0 255.0 READ_WRITE ECU_ADDRESS 0x3F9355 /end MEASUREMENT
/begin MEASUREMENT ed_fil_tka_obd.filter_max_nv "Maximaler Fehlerfilterwert" UBYTE FORMULA_0003 0 0.0 0.0 255.0 READ_WRITE ECU_ADDRESS 0x3F9354 /end MEASUREMENT
/begin MEASUREMENT ed_fil_tka_obd.filter_nv "Filterwert vor und nach Eintrag" UBYTE FORMULA_0003 0 0.0 0.0 255.0 READ_WRITE ECU_ADDRESS 0x3F9350 /end MEASUREMENT
/begin MEASUREMENT ed_fil_tka_obd.zyklus_filter_nv "Vorwaertsfilter zur Fehlerzustandsbestaetigung" UBYTE FORMULA_0003 0 0.0 0.0 255.0 READ_WRITE ECU_ADDRESS 0x3F9351 /end MEASUREMENT
/begin MEASUREMENT ed_fil_tmot.art_aktuell_nv "Fehlerart und Statusbits" UWORD FORMULA_0052 0 0.0 0.0 65535.0 READ_WRITE BIT_MASK 0xB4F ECU_ADDRESS 0x3F9310 /end MEASUREMENT
/begin MEASUREMENT ed_fil_tmot.fehler_aufrufe_nv "Gesamtzahl der Fehleraufrufe" UBYTE FORMULA_0003 0 0.0 0.0 255.0 READ_WRITE ECU_ADDRESS 0x3F9313 /end MEASUREMENT
/begin MEASUREMENT ed_fil_tmot.filter_max_nv "Maximaler Fehlerfilterwert" UBYTE FORMULA_0003 0 0.0 0.0 255.0 READ_WRITE ECU_ADDRESS 0x3F9312 /end MEASUREMENT
/begin MEASUREMENT ed_fil_tmot.filter_nv "Filterwert vor und nach Eintrag" UBYTE FORMULA_0003 0 0.0 0.0 255.0 READ_WRITE ECU_ADDRESS 0x3F930E /end MEASUREMENT
/begin MEASUREMENT ed_fil_tmot.zyklus_filter_nv "Vorwaertsfilter zur Fehlerzustandsbestaetigung" UBYTE FORMULA_0003 0 0.0 0.0 255.0 READ_WRITE ECU_ADDRESS 0x3F930F /end MEASUREMENT
/begin MEASUREMENT ed_fil_tmot_obd.art_aktuell_nv "Fehlerart und Statusbits" UWORD FORMULA_0052 0 0.0 0.0 65535.0 READ_WRITE BIT_MASK 0xB4F ECU_ADDRESS 0x3F9316 /end MEASUREMENT
/begin MEASUREMENT ed_fil_tmot_obd.fehler_aufrufe_nv "Gesamtzahl der Fehleraufrufe" UBYTE FORMULA_0003 0 0.0 0.0 255.0 READ_WRITE ECU_ADDRESS 0x3F9319 /end MEASUREMENT
/begin MEASUREMENT ed_fil_tmot_obd.filter_max_nv "Maximaler Fehlerfilterwert" UBYTE FORMULA_0003 0 0.0 0.0 255.0 READ_WRITE ECU_ADDRESS 0x3F9318 /end MEASUREMENT
/begin MEASUREMENT ed_fil_tmot_obd.filter_nv "Filterwert vor und nach Eintrag" UBYTE FORMULA_0003 0 0.0 0.0 255.0 READ_WRITE ECU_ADDRESS 0x3F9314 /end MEASUREMENT
/begin MEASUREMENT ed_fil_tmot_obd.zyklus_filter_nv "Vorwaertsfilter zur Fehlerzustandsbestaetigung" UBYTE FORMULA_0003 0 0.0 0.0 255.0 READ_WRITE ECU_ADDRESS 0x3F9315 /end MEASUREMENT
/begin MEASUREMENT ed_fil_tmot_obd_high.art_aktuell_nv "Fehlerart und Statusbits" UWORD FORMULA_0052 0 0.0 0.0 65535.0 READ_WRITE BIT_MASK 0xB4F ECU_ADDRESS 0x3F959E /end MEASUREMENT
/begin MEASUREMENT ed_fil_tmot_obd_high.fehler_aufrufe_nv "Gesamtzahl der Fehleraufrufe" UBYTE FORMULA_0003 0 0.0 0.0 255.0 READ_WRITE ECU_ADDRESS 0x3F95A1 /end MEASUREMENT
/begin MEASUREMENT ed_fil_tmot_obd_high.filter_max_nv "Maximaler Fehlerfilterwert" UBYTE FORMULA_0003 0 0.0 0.0 255.0 READ_WRITE ECU_ADDRESS 0x3F95A0 /end MEASUREMENT
/begin MEASUREMENT ed_fil_tmot_obd_high.filter_nv "Filterwert vor und nach Eintrag" UBYTE FORMULA_0003 0 0.0 0.0 255.0 READ_WRITE ECU_ADDRESS 0x3F959C /end MEASUREMENT
/begin MEASUREMENT ed_fil_tmot_obd_high.zyklus_filter_nv "Vorwaertsfilter zur Fehlerzustandsbestaetigung" UBYTE FORMULA_0003 0 0.0 0.0 255.0 READ_WRITE ECU_ADDRESS 0x3F959D /end MEASUREMENT
/begin MEASUREMENT ed_fil_tumg.art_aktuell_nv "Fehlerart und Statusbits" UWORD FORMULA_0052 0 0.0 0.0 65535.0 READ_WRITE BIT_MASK 0xB4F ECU_ADDRESS 0x3F9592 /end MEASUREMENT
/begin MEASUREMENT ed_fil_tumg.fehler_aufrufe_nv "Gesamtzahl der Fehleraufrufe" UBYTE FORMULA_0003 0 0.0 0.0 255.0 READ_WRITE ECU_ADDRESS 0x3F9595 /end MEASUREMENT
/begin MEASUREMENT ed_fil_tumg.filter_max_nv "Maximaler Fehlerfilterwert" UBYTE FORMULA_0003 0 0.0 0.0 255.0 READ_WRITE ECU_ADDRESS 0x3F9594 /end MEASUREMENT
/begin MEASUREMENT ed_fil_tumg.filter_nv "Filterwert vor und nach Eintrag" UBYTE FORMULA_0003 0 0.0 0.0 255.0 READ_WRITE ECU_ADDRESS 0x3F9590 /end MEASUREMENT
/begin MEASUREMENT ed_fil_tumg.zyklus_filter_nv "Vorwaertsfilter zur Fehlerzustandsbestaetigung" UBYTE FORMULA_0003 0 0.0 0.0 255.0 READ_WRITE ECU_ADDRESS 0x3F9591 /end MEASUREMENT
/begin MEASUREMENT ed_fil_tumg_obd.art_aktuell_nv "Fehlerart und Statusbits" UWORD FORMULA_0052 0 0.0 0.0 65535.0 READ_WRITE BIT_MASK 0xB4F ECU_ADDRESS 0x3F93A6 /end MEASUREMENT
/begin MEASUREMENT ed_fil_tumg_obd.fehler_aufrufe_nv "Gesamtzahl der Fehleraufrufe" UBYTE FORMULA_0003 0 0.0 0.0 255.0 READ_WRITE ECU_ADDRESS 0x3F93A9 /end MEASUREMENT
/begin MEASUREMENT ed_fil_tumg_obd.filter_max_nv "Maximaler Fehlerfilterwert" UBYTE FORMULA_0003 0 0.0 0.0 255.0 READ_WRITE ECU_ADDRESS 0x3F93A8 /end MEASUREMENT
/begin MEASUREMENT ed_fil_tumg_obd.filter_nv "Filterwert vor und nach Eintrag" UBYTE FORMULA_0003 0 0.0 0.0 255.0 READ_WRITE ECU_ADDRESS 0x3F93A4 /end MEASUREMENT
/begin MEASUREMENT ed_fil_tumg_obd.zyklus_filter_nv "Vorwaertsfilter zur Fehlerzustandsbestaetigung" UBYTE FORMULA_0003 0 0.0 0.0 255.0 READ_WRITE ECU_ADDRESS 0x3F93A5 /end MEASUREMENT
/begin MEASUREMENT ed_fil_ub.art_aktuell_nv "Fehlerart und Statusbits" UWORD FORMULA_0052 0 0.0 0.0 65535.0 READ_WRITE BIT_MASK 0xB4F ECU_ADDRESS 0x3F932E /end MEASUREMENT
/begin MEASUREMENT ed_fil_ub.fehler_aufrufe_nv "Gesamtzahl der Fehleraufrufe" UBYTE FORMULA_0003 0 0.0 0.0 255.0 READ_WRITE ECU_ADDRESS 0x3F9331 /end MEASUREMENT
/begin MEASUREMENT ed_fil_ub.filter_max_nv "Maximaler Fehlerfilterwert" UBYTE FORMULA_0003 0 0.0 0.0 255.0 READ_WRITE ECU_ADDRESS 0x3F9330 /end MEASUREMENT
/begin MEASUREMENT ed_fil_ub.filter_nv "Filterwert vor und nach Eintrag" UBYTE FORMULA_0003 0 0.0 0.0 255.0 READ_WRITE ECU_ADDRESS 0x3F932C /end MEASUREMENT
/begin MEASUREMENT ed_fil_ub.zyklus_filter_nv "Vorwaertsfilter zur Fehlerzustandsbestaetigung" UBYTE FORMULA_0003 0 0.0 0.0 255.0 READ_WRITE ECU_ADDRESS 0x3F932D /end MEASUREMENT
/begin MEASUREMENT ed_fil_uext_111219514.art_aktuell_nv "Fehlerart und Statusbits" UWORD FORMULA_0052 0 0.0 0.0 65535.0 READ_WRITE BIT_MASK 0xB4F ECU_ADDRESS 0x3F9340 /end MEASUREMENT
/begin MEASUREMENT ed_fil_uext_111219514.fehler_aufrufe_nv "Gesamtzahl der Fehleraufrufe" UBYTE FORMULA_0003 0 0.0 0.0 255.0 READ_WRITE ECU_ADDRESS 0x3F9343 /end MEASUREMENT
/begin MEASUREMENT ed_fil_uext_111219514.filter_max_nv "Maximaler Fehlerfilterwert" UBYTE FORMULA_0003 0 0.0 0.0 255.0 READ_WRITE ECU_ADDRESS 0x3F9342 /end MEASUREMENT
/begin MEASUREMENT ed_fil_uext_111219514.filter_nv "Filterwert vor und nach Eintrag" UBYTE FORMULA_0003 0 0.0 0.0 255.0 READ_WRITE ECU_ADDRESS 0x3F933E /end MEASUREMENT
/begin MEASUREMENT ed_fil_uext_111219514.zyklus_filter_nv "Vorwaertsfilter zur Fehlerzustandsbestaetigung" UBYTE FORMULA_0003 0 0.0 0.0 255.0 READ_WRITE ECU_ADDRESS 0x3F933F /end MEASUREMENT
/begin MEASUREMENT ed_fil_uext_124_512.art_aktuell_nv "Fehlerart und Statusbits" UWORD FORMULA_0052 0 0.0 0.0 65535.0 READ_WRITE BIT_MASK 0xB4F ECU_ADDRESS 0x3F9346 /end MEASUREMENT
/begin MEASUREMENT ed_fil_uext_124_512.fehler_aufrufe_nv "Gesamtzahl der Fehleraufrufe" UBYTE FORMULA_0003 0 0.0 0.0 255.0 READ_WRITE ECU_ADDRESS 0x3F9349 /end MEASUREMENT
/begin MEASUREMENT ed_fil_uext_124_512.filter_max_nv "Maximaler Fehlerfilterwert" UBYTE FORMULA_0003 0 0.0 0.0 255.0 READ_WRITE ECU_ADDRESS 0x3F9348 /end MEASUREMENT
/begin MEASUREMENT ed_fil_uext_124_512.filter_nv "Filterwert vor und nach Eintrag" UBYTE FORMULA_0003 0 0.0 0.0 255.0 READ_WRITE ECU_ADDRESS 0x3F9344 /end MEASUREMENT
/begin MEASUREMENT ed_fil_uext_124_512.zyklus_filter_nv "Vorwaertsfilter zur Fehlerzustandsbestaetigung" UBYTE FORMULA_0003 0 0.0 0.0 255.0 READ_WRITE ECU_ADDRESS 0x3F9345 /end MEASUREMENT
/begin MEASUREMENT ed_fil_v_direkt.art_aktuell_nv "Fehlerart und Statusbits" UWORD FORMULA_0052 0 0.0 0.0 65535.0 READ_WRITE BIT_MASK 0xB4F ECU_ADDRESS 0x3F93AC /end MEASUREMENT
/begin MEASUREMENT ed_fil_v_direkt.fehler_aufrufe_nv "Gesamtzahl der Fehleraufrufe" UBYTE FORMULA_0003 0 0.0 0.0 255.0 READ_WRITE ECU_ADDRESS 0x3F93AF /end MEASUREMENT
/begin MEASUREMENT ed_fil_v_direkt.filter_max_nv "Maximaler Fehlerfilterwert" UBYTE FORMULA_0003 0 0.0 0.0 255.0 READ_WRITE ECU_ADDRESS 0x3F93AE /end MEASUREMENT
/begin MEASUREMENT ed_fil_v_direkt.filter_nv "Filterwert vor und nach Eintrag" UBYTE FORMULA_0003 0 0.0 0.0 255.0 READ_WRITE ECU_ADDRESS 0x3F93AA /end MEASUREMENT
/begin MEASUREMENT ed_fil_v_direkt.zyklus_filter_nv "Vorwaertsfilter zur Fehlerzustandsbestaetigung" UBYTE FORMULA_0003 0 0.0 0.0 255.0 READ_WRITE ECU_ADDRESS 0x3F93AB /end MEASUREMENT
/begin MEASUREMENT ed_fil_zoelp1.art_aktuell_nv "Fehlerart und Statusbits" UWORD FORMULA_0052 0 0.0 0.0 65535.0 READ_WRITE BIT_MASK 0xB4F ECU_ADDRESS 0x3F9526 /end MEASUREMENT
/begin MEASUREMENT ed_fil_zoelp1.fehler_aufrufe_nv "Gesamtzahl der Fehleraufrufe" UBYTE FORMULA_0003 0 0.0 0.0 255.0 READ_WRITE ECU_ADDRESS 0x3F9529 /end MEASUREMENT
/begin MEASUREMENT ed_fil_zoelp1.filter_max_nv "Maximaler Fehlerfilterwert" UBYTE FORMULA_0003 0 0.0 0.0 255.0 READ_WRITE ECU_ADDRESS 0x3F9528 /end MEASUREMENT
/begin MEASUREMENT ed_fil_zoelp1.filter_nv "Filterwert vor und nach Eintrag" UBYTE FORMULA_0003 0 0.0 0.0 255.0 READ_WRITE ECU_ADDRESS 0x3F9524 /end MEASUREMENT
/begin MEASUREMENT ed_fil_zoelp1.zyklus_filter_nv "Vorwaertsfilter zur Fehlerzustandsbestaetigung" UBYTE FORMULA_0003 0 0.0 0.0 255.0 READ_WRITE ECU_ADDRESS 0x3F9525 /end MEASUREMENT
/begin MEASUREMENT ed_fil_zoelp2.art_aktuell_nv "Fehlerart und Statusbits" UWORD FORMULA_0052 0 0.0 0.0 65535.0 READ_WRITE BIT_MASK 0xB4F ECU_ADDRESS 0x3F952C /end MEASUREMENT
/begin MEASUREMENT ed_fil_zoelp2.fehler_aufrufe_nv "Gesamtzahl der Fehleraufrufe" UBYTE FORMULA_0003 0 0.0 0.0 255.0 READ_WRITE ECU_ADDRESS 0x3F952F /end MEASUREMENT
/begin MEASUREMENT ed_fil_zoelp2.filter_max_nv "Maximaler Fehlerfilterwert" UBYTE FORMULA_0003 0 0.0 0.0 255.0 READ_WRITE ECU_ADDRESS 0x3F952E /end MEASUREMENT
/begin MEASUREMENT ed_fil_zoelp2.filter_nv "Filterwert vor und nach Eintrag" UBYTE FORMULA_0003 0 0.0 0.0 255.0 READ_WRITE ECU_ADDRESS 0x3F952A /end MEASUREMENT
/begin MEASUREMENT ed_fil_zoelp2.zyklus_filter_nv "Vorwaertsfilter zur Fehlerzustandsbestaetigung" UBYTE FORMULA_0003 0 0.0 0.0 255.0 READ_WRITE ECU_ADDRESS 0x3F952B /end MEASUREMENT
/begin MEASUREMENT ed_fsp_10of20_.ed_fil_index_nv "Verweis auf Fehlerfilter" UWORD FORMULA_0010 0 0.0 0.0 65535.0 READ_WRITE ECU_ADDRESS 0x3F9A80 /end MEASUREMENT
/begin MEASUREMENT ed_fsp_10of20_.fehlerart_nv "Fehlerart und Statusbits" UWORD FORMULA_0010 0 0.0 0.0 65535.0 READ_WRITE ECU_ADDRESS 0x3F9A5C /end MEASUREMENT
/begin MEASUREMENT ed_fsp_10of20_.fehlercode_nv "Externer Fehlerort" UWORD FORMULA_0053 0 0.0 0.0 65535.0 READ_WRITE ECU_ADDRESS 0x3F9A5A /end MEASUREMENT
/begin MEASUREMENT ed_fsp_10of20_.ff_egas_ist_dk_b1_nv "Drosselklappenposition des Freeze Frame" UBYTE FORMULA_0059 0 0.0 0.0 100.0 READ_WRITE ECU_ADDRESS 0x3F9A9A /end MEASUREMENT
/begin MEASUREMENT ed_fsp_10of20_.ff_laa_f_ber_b1_nv "Lambdaadaptionsfaktor ohne TE des Freeze Frame" UBYTE FORMULA_0058 0 0.0 0.0 1.99210000038147 READ_WRITE ECU_ADDRESS 0x3F9A92 /end MEASUREMENT
/begin MEASUREMENT ed_fsp_10of20_.ff_laa_f_ber_b2_nv "Lambdaadaptionsfaktor ohne TE des Freeze Frame" UBYTE FORMULA_0058 0 0.0 0.0 1.99210000038147 READ_WRITE ECU_ADDRESS 0x3F9A93 /end MEASUREMENT
/begin MEASUREMENT ed_fsp_10of20_.ff_lam_reg_b1_nv "Einspritzsystem des Freeze Frame" UBYTE FORMULA_0057 0 0.0 0.0 255.0 READ_WRITE ECU_ADDRESS 0x3F9A8E /end MEASUREMENT
/begin MEASUREMENT ed_fsp_10of20_.ff_lam_reg_b2_nv "Einspritzsystem des Freeze Frame" UBYTE FORMULA_0057 0 0.0 0.0 255.0 READ_WRITE ECU_ADDRESS 0x3F9A8F /end MEASUREMENT
/begin MEASUREMENT ed_fsp_10of20_.ff_lam_reg_f_b1_nv "Lambdaregelfaktor des Freeze Frame" UBYTE FORMULA_0058 0 0.0 0.0 1.99210000038147 READ_WRITE ECU_ADDRESS 0x3F9A90 /end MEASUREMENT
/begin MEASUREMENT ed_fsp_10of20_.ff_lam_reg_f_b2_nv "Lambdaregelfaktor des Freeze Frame" UBYTE FORMULA_0058 0 0.0 0.0 1.99210000038147 READ_WRITE ECU_ADDRESS 0x3F9A91 /end MEASUREMENT
/begin MEASUREMENT ed_fsp_10of20_.ff_ml_ges_nv "Luftmasse des Freeze Frame" UWORD FORMULA_0056 0 0.0 0.0 655.3499755859375 READ_WRITE ECU_ADDRESS 0x3F9A8C /end MEASUREMENT
/begin MEASUREMENT ed_fsp_10of20_.ff_n_nv "Drehzahl des Freeze Frame" UWORD FORMULA_0055 0 0.0 0.0 16383.75 READ_WRITE ECU_ADDRESS 0x3F9A8A /end MEASUREMENT
/begin MEASUREMENT ed_fsp_10of20_.ff_p_code_nv "P-Code des Freeze Frame" UWORD FORMULA_0010 0 0.0 0.0 65535.0 READ_WRITE ECU_ADDRESS 0x3F9A88 /end MEASUREMENT
/begin MEASUREMENT ed_fsp_10of20_.ff_pks_ist_nv "Kraftstoffdruck des Freeze Frame" UBYTE FORMULA_0061 0 0.0 0.0 765.0 READ_WRITE ECU_ADDRESS 0x3F9A96 /end MEASUREMENT
/begin MEASUREMENT ed_fsp_10of20_.ff_rf_m_nv "Last des Freeze Frame" UBYTE FORMULA_0059 0 0.0 0.0 100.0 READ_WRITE ECU_ADDRESS 0x3F9A94 /end MEASUREMENT
/begin MEASUREMENT ed_fsp_10of20_.ff_sl_st_nv "Sekundaerluftstatus des Freeze Frame" UBYTE FORMULA_0064 0 0.0 0.0 255.0 READ_WRITE ECU_ADDRESS 0x3F9A9B /end MEASUREMENT
/begin MEASUREMENT ed_fsp_10of20_.ff_tan_m_nv "Ansauglufttemperatur des Freeze Frame" UBYTE FORMULA_0060 0 0.0 -40.0 215.0 READ_WRITE ECU_ADDRESS 0x3F9A99 /end MEASUREMENT
/begin MEASUREMENT ed_fsp_10of20_.ff_tmot_nv "Kuehlwassertemperatur des Freeze Frame" UBYTE FORMULA_0060 0 0.0 -40.0 215.0 READ_WRITE ECU_ADDRESS 0x3F9A95 /end MEASUREMENT
/begin MEASUREMENT ed_fsp_10of20_.ff_tz1_nv "Zuendwinkel 1 des Freeze Frame" UBYTE FORMULA_0063 0 0.0 -64.0 63.5 READ_WRITE ECU_ADDRESS 0x3F9A98 /end MEASUREMENT
/begin MEASUREMENT ed_fsp_10of20_.ff_v_vorne_nv "Geschwindigkeit des Freeze Frame" UBYTE FORMULA_0062 0 0.0 0.0 255.0 READ_WRITE ECU_ADDRESS 0x3F9A97 /end MEASUREMENT
/begin MEASUREMENT ed_fsp_10of20_.haeufigkeitszaehler_nv "Uebergangszaehler von i.O. -> n.i.O" UBYTE FORMULA_0003 0 0.0 0.0 255.0 READ_WRITE ECU_ADDRESS 0x3F9A5E /end MEASUREMENT
/begin MEASUREMENT ed_fsp_10of20_.inj_fehlerzaehler_nv "INJ-Fehlerzaehler" UWORD FORMULA_0010 0 0.0 0.0 65535.0 READ_WRITE ECU_ADDRESS 0x3F9A7E /end MEASUREMENT
/begin MEASUREMENT ed_fsp_10of20_.logistikzaehler_nv "Warm-Up-Cycling-Zaehler" UBYTE FORMULA_0003 0 0.0 0.0 255.0 READ_WRITE ECU_ADDRESS 0x3F9A5F /end MEASUREMENT
/begin MEASUREMENT ed_fsp_10of20_.mil_filter_nv "Filterwert der Milansteuerung" UBYTE FORMULA_0003 0 0.0 0.0 255.0 READ_WRITE ECU_ADDRESS 0x3F9A82 /end MEASUREMENT
/begin MEASUREMENT ed_fsp_10of20_.mil_filter_scdn_nv "Similar Conditions Eintragsfilterwert der Milansteuerung" UBYTE FORMULA_0003 0 0.0 0.0 255.0 READ_WRITE ECU_ADDRESS 0x3F9A83 /end MEASUREMENT
/begin MEASUREMENT ed_fsp_10of20_.scdn_nenner_nv "Gesamte Anzahl" UWORD FORMULA_0010 0 0.0 0.0 65535.0 READ_WRITE ECU_ADDRESS 0x3F9A86 /end MEASUREMENT
/begin MEASUREMENT ed_fsp_10of20_.scdn_zaehler_nv "Im similar Fenster" UWORD FORMULA_0010 0 0.0 0.0 65535.0 READ_WRITE ECU_ADDRESS 0x3F9A84 /end MEASUREMENT
/begin MEASUREMENT ed_fsp_10of20_.uw_satz_1of3_.uw_km_stand_nv "Kilometerstand beim Fehlereintrag" UWORD FORMULA_0054 0 0.0 0.0 524280.0 READ_WRITE ECU_ADDRESS 0x3F9A60 /end MEASUREMENT
/begin MEASUREMENT ed_fsp_10of20_.uw_satz_1of3_.uw_wert_nv_1of4_ "Umweltbedingung beim Fehlereintrag" UWORD FORMULA_0010 0 0.0 0.0 65535.0 READ_WRITE ECU_ADDRESS 0x3F9A62 /end MEASUREMENT
/begin MEASUREMENT ed_fsp_10of20_.uw_satz_1of3_.uw_wert_nv_2of4_ "Umweltbedingung beim Fehlereintrag" UWORD FORMULA_0010 0 0.0 0.0 65535.0 READ_WRITE ECU_ADDRESS 0x3F9A64 /end MEASUREMENT
/begin MEASUREMENT ed_fsp_10of20_.uw_satz_1of3_.uw_wert_nv_3of4_ "Umweltbedingung beim Fehlereintrag" UWORD FORMULA_0010 0 0.0 0.0 65535.0 READ_WRITE ECU_ADDRESS 0x3F9A66 /end MEASUREMENT
/begin MEASUREMENT ed_fsp_10of20_.uw_satz_1of3_.uw_wert_nv_4of4_ "Umweltbedingung beim Fehlereintrag" UWORD FORMULA_0010 0 0.0 0.0 65535.0 READ_WRITE ECU_ADDRESS 0x3F9A68 /end MEASUREMENT
/begin MEASUREMENT ed_fsp_10of20_.uw_satz_2of3_.uw_km_stand_nv "Kilometerstand beim Fehlereintrag" UWORD FORMULA_0054 0 0.0 0.0 524280.0 READ_WRITE ECU_ADDRESS 0x3F9A6A /end MEASUREMENT
/begin MEASUREMENT ed_fsp_10of20_.uw_satz_2of3_.uw_wert_nv_1of4_ "Umweltbedingung beim Fehlereintrag" UWORD FORMULA_0010 0 0.0 0.0 65535.0 READ_WRITE ECU_ADDRESS 0x3F9A6C /end MEASUREMENT
/begin MEASUREMENT ed_fsp_10of20_.uw_satz_2of3_.uw_wert_nv_2of4_ "Umweltbedingung beim Fehlereintrag" UWORD FORMULA_0010 0 0.0 0.0 65535.0 READ_WRITE ECU_ADDRESS 0x3F9A6E /end MEASUREMENT
/begin MEASUREMENT ed_fsp_10of20_.uw_satz_2of3_.uw_wert_nv_3of4_ "Umweltbedingung beim Fehlereintrag" UWORD FORMULA_0010 0 0.0 0.0 65535.0 READ_WRITE ECU_ADDRESS 0x3F9A70 /end MEASUREMENT
/begin MEASUREMENT ed_fsp_10of20_.uw_satz_2of3_.uw_wert_nv_4of4_ "Umweltbedingung beim Fehlereintrag" UWORD FORMULA_0010 0 0.0 0.0 65535.0 READ_WRITE ECU_ADDRESS 0x3F9A72 /end MEASUREMENT
/begin MEASUREMENT ed_fsp_10of20_.uw_satz_3of3_.uw_km_stand_nv "Kilometerstand beim Fehlereintrag" UWORD FORMULA_0054 0 0.0 0.0 524280.0 READ_WRITE ECU_ADDRESS 0x3F9A74 /end MEASUREMENT
/begin MEASUREMENT ed_fsp_10of20_.uw_satz_3of3_.uw_wert_nv_1of4_ "Umweltbedingung beim Fehlereintrag" UWORD FORMULA_0010 0 0.0 0.0 65535.0 READ_WRITE ECU_ADDRESS 0x3F9A76 /end MEASUREMENT
/begin MEASUREMENT ed_fsp_10of20_.uw_satz_3of3_.uw_wert_nv_2of4_ "Umweltbedingung beim Fehlereintrag" UWORD FORMULA_0010 0 0.0 0.0 65535.0 READ_WRITE ECU_ADDRESS 0x3F9A78 /end MEASUREMENT
/begin MEASUREMENT ed_fsp_10of20_.uw_satz_3of3_.uw_wert_nv_3of4_ "Umweltbedingung beim Fehlereintrag" UWORD FORMULA_0010 0 0.0 0.0 65535.0 READ_WRITE ECU_ADDRESS 0x3F9A7A /end MEASUREMENT
/begin MEASUREMENT ed_fsp_10of20_.uw_satz_3of3_.uw_wert_nv_4of4_ "Umweltbedingung beim Fehlereintrag" UWORD FORMULA_0010 0 0.0 0.0 65535.0 READ_WRITE ECU_ADDRESS 0x3F9A7C /end MEASUREMENT
/begin MEASUREMENT ed_fsp_11of20_.ed_fil_index_nv "Verweis auf Fehlerfilter" UWORD FORMULA_0010 0 0.0 0.0 65535.0 READ_WRITE ECU_ADDRESS 0x3F9AC2 /end MEASUREMENT
/begin MEASUREMENT ed_fsp_11of20_.fehlerart_nv "Fehlerart und Statusbits" UWORD FORMULA_0010 0 0.0 0.0 65535.0 READ_WRITE ECU_ADDRESS 0x3F9A9E /end MEASUREMENT
/begin MEASUREMENT ed_fsp_11of20_.fehlercode_nv "Externer Fehlerort" UWORD FORMULA_0053 0 0.0 0.0 65535.0 READ_WRITE ECU_ADDRESS 0x3F9A9C /end MEASUREMENT
/begin MEASUREMENT ed_fsp_11of20_.ff_egas_ist_dk_b1_nv "Drosselklappenposition des Freeze Frame" UBYTE FORMULA_0059 0 0.0 0.0 100.0 READ_WRITE ECU_ADDRESS 0x3F9ADC /end MEASUREMENT
/begin MEASUREMENT ed_fsp_11of20_.ff_laa_f_ber_b1_nv "Lambdaadaptionsfaktor ohne TE des Freeze Frame" UBYTE FORMULA_0058 0 0.0 0.0 1.99210000038147 READ_WRITE ECU_ADDRESS 0x3F9AD4 /end MEASUREMENT
/begin MEASUREMENT ed_fsp_11of20_.ff_laa_f_ber_b2_nv "Lambdaadaptionsfaktor ohne TE des Freeze Frame" UBYTE FORMULA_0058 0 0.0 0.0 1.99210000038147 READ_WRITE ECU_ADDRESS 0x3F9AD5 /end MEASUREMENT
/begin MEASUREMENT ed_fsp_11of20_.ff_lam_reg_b1_nv "Einspritzsystem des Freeze Frame" UBYTE FORMULA_0057 0 0.0 0.0 255.0 READ_WRITE ECU_ADDRESS 0x3F9AD0 /end MEASUREMENT
/begin MEASUREMENT ed_fsp_11of20_.ff_lam_reg_b2_nv "Einspritzsystem des Freeze Frame" UBYTE FORMULA_0057 0 0.0 0.0 255.0 READ_WRITE ECU_ADDRESS 0x3F9AD1 /end MEASUREMENT
/begin MEASUREMENT ed_fsp_11of20_.ff_lam_reg_f_b1_nv "Lambdaregelfaktor des Freeze Frame" UBYTE FORMULA_0058 0 0.0 0.0 1.99210000038147 READ_WRITE ECU_ADDRESS 0x3F9AD2 /end MEASUREMENT
/begin MEASUREMENT ed_fsp_11of20_.ff_lam_reg_f_b2_nv "Lambdaregelfaktor des Freeze Frame" UBYTE FORMULA_0058 0 0.0 0.0 1.99210000038147 READ_WRITE ECU_ADDRESS 0x3F9AD3 /end MEASUREMENT
/begin MEASUREMENT ed_fsp_11of20_.ff_ml_ges_nv "Luftmasse des Freeze Frame" UWORD FORMULA_0056 0 0.0 0.0 655.3499755859375 READ_WRITE ECU_ADDRESS 0x3F9ACE /end MEASUREMENT
/begin MEASUREMENT ed_fsp_11of20_.ff_n_nv "Drehzahl des Freeze Frame" UWORD FORMULA_0055 0 0.0 0.0 16383.75 READ_WRITE ECU_ADDRESS 0x3F9ACC /end MEASUREMENT
/begin MEASUREMENT ed_fsp_11of20_.ff_p_code_nv "P-Code des Freeze Frame" UWORD FORMULA_0010 0 0.0 0.0 65535.0 READ_WRITE ECU_ADDRESS 0x3F9ACA /end MEASUREMENT
/begin MEASUREMENT ed_fsp_11of20_.ff_pks_ist_nv "Kraftstoffdruck des Freeze Frame" UBYTE FORMULA_0061 0 0.0 0.0 765.0 READ_WRITE ECU_ADDRESS 0x3F9AD8 /end MEASUREMENT
/begin MEASUREMENT ed_fsp_11of20_.ff_rf_m_nv "Last des Freeze Frame" UBYTE FORMULA_0059 0 0.0 0.0 100.0 READ_WRITE ECU_ADDRESS 0x3F9AD6 /end MEASUREMENT
/begin MEASUREMENT ed_fsp_11of20_.ff_sl_st_nv "Sekundaerluftstatus des Freeze Frame" UBYTE FORMULA_0064 0 0.0 0.0 255.0 READ_WRITE ECU_ADDRESS 0x3F9ADD /end MEASUREMENT
/begin MEASUREMENT ed_fsp_11of20_.ff_tan_m_nv "Ansauglufttemperatur des Freeze Frame" UBYTE FORMULA_0060 0 0.0 -40.0 215.0 READ_WRITE ECU_ADDRESS 0x3F9ADB /end MEASUREMENT
/begin MEASUREMENT ed_fsp_11of20_.ff_tmot_nv "Kuehlwassertemperatur des Freeze Frame" UBYTE FORMULA_0060 0 0.0 -40.0 215.0 READ_WRITE ECU_ADDRESS 0x3F9AD7 /end MEASUREMENT
/begin MEASUREMENT ed_fsp_11of20_.ff_tz1_nv "Zuendwinkel 1 des Freeze Frame" UBYTE FORMULA_0063 0 0.0 -64.0 63.5 READ_WRITE ECU_ADDRESS 0x3F9ADA /end MEASUREMENT
/begin MEASUREMENT ed_fsp_11of20_.ff_v_vorne_nv "Geschwindigkeit des Freeze Frame" UBYTE FORMULA_0062 0 0.0 0.0 255.0 READ_WRITE ECU_ADDRESS 0x3F9AD9 /end MEASUREMENT
/begin MEASUREMENT ed_fsp_11of20_.haeufigkeitszaehler_nv "Uebergangszaehler von i.O. -> n.i.O" UBYTE FORMULA_0003 0 0.0 0.0 255.0 READ_WRITE ECU_ADDRESS 0x3F9AA0 /end MEASUREMENT
/begin MEASUREMENT ed_fsp_11of20_.inj_fehlerzaehler_nv "INJ-Fehlerzaehler" UWORD FORMULA_0010 0 0.0 0.0 65535.0 READ_WRITE ECU_ADDRESS 0x3F9AC0 /end MEASUREMENT
/begin MEASUREMENT ed_fsp_11of20_.logistikzaehler_nv "Warm-Up-Cycling-Zaehler" UBYTE FORMULA_0003 0 0.0 0.0 255.0 READ_WRITE ECU_ADDRESS 0x3F9AA1 /end MEASUREMENT
/begin MEASUREMENT ed_fsp_11of20_.mil_filter_nv "Filterwert der Milansteuerung" UBYTE FORMULA_0003 0 0.0 0.0 255.0 READ_WRITE ECU_ADDRESS 0x3F9AC4 /end MEASUREMENT
/begin MEASUREMENT ed_fsp_11of20_.mil_filter_scdn_nv "Similar Conditions Eintragsfilterwert der Milansteuerung" UBYTE FORMULA_0003 0 0.0 0.0 255.0 READ_WRITE ECU_ADDRESS 0x3F9AC5 /end MEASUREMENT
/begin MEASUREMENT ed_fsp_11of20_.scdn_nenner_nv "Gesamte Anzahl" UWORD FORMULA_0010 0 0.0 0.0 65535.0 READ_WRITE ECU_ADDRESS 0x3F9AC8 /end MEASUREMENT
/begin MEASUREMENT ed_fsp_11of20_.scdn_zaehler_nv "Im similar Fenster" UWORD FORMULA_0010 0 0.0 0.0 65535.0 READ_WRITE ECU_ADDRESS 0x3F9AC6 /end MEASUREMENT
/begin MEASUREMENT ed_fsp_11of20_.uw_satz_1of3_.uw_km_stand_nv "Kilometerstand beim Fehlereintrag" UWORD FORMULA_0054 0 0.0 0.0 524280.0 READ_WRITE ECU_ADDRESS 0x3F9AA2 /end MEASUREMENT
/begin MEASUREMENT ed_fsp_11of20_.uw_satz_1of3_.uw_wert_nv_1of4_ "Umweltbedingung beim Fehlereintrag" UWORD FORMULA_0010 0 0.0 0.0 65535.0 READ_WRITE ECU_ADDRESS 0x3F9AA4 /end MEASUREMENT
/begin MEASUREMENT ed_fsp_11of20_.uw_satz_1of3_.uw_wert_nv_2of4_ "Umweltbedingung beim Fehlereintrag" UWORD FORMULA_0010 0 0.0 0.0 65535.0 READ_WRITE ECU_ADDRESS 0x3F9AA6 /end MEASUREMENT
/begin MEASUREMENT ed_fsp_11of20_.uw_satz_1of3_.uw_wert_nv_3of4_ "Umweltbedingung beim Fehlereintrag" UWORD FORMULA_0010 0 0.0 0.0 65535.0 READ_WRITE ECU_ADDRESS 0x3F9AA8 /end MEASUREMENT
/begin MEASUREMENT ed_fsp_11of20_.uw_satz_1of3_.uw_wert_nv_4of4_ "Umweltbedingung beim Fehlereintrag" UWORD FORMULA_0010 0 0.0 0.0 65535.0 READ_WRITE ECU_ADDRESS 0x3F9AAA /end MEASUREMENT
/begin MEASUREMENT ed_fsp_11of20_.uw_satz_2of3_.uw_km_stand_nv "Kilometerstand beim Fehlereintrag" UWORD FORMULA_0054 0 0.0 0.0 524280.0 READ_WRITE ECU_ADDRESS 0x3F9AAC /end MEASUREMENT
/begin MEASUREMENT ed_fsp_11of20_.uw_satz_2of3_.uw_wert_nv_1of4_ "Umweltbedingung beim Fehlereintrag" UWORD FORMULA_0010 0 0.0 0.0 65535.0 READ_WRITE ECU_ADDRESS 0x3F9AAE /end MEASUREMENT
/begin MEASUREMENT ed_fsp_11of20_.uw_satz_2of3_.uw_wert_nv_2of4_ "Umweltbedingung beim Fehlereintrag" UWORD FORMULA_0010 0 0.0 0.0 65535.0 READ_WRITE ECU_ADDRESS 0x3F9AB0 /end MEASUREMENT
/begin MEASUREMENT ed_fsp_11of20_.uw_satz_2of3_.uw_wert_nv_3of4_ "Umweltbedingung beim Fehlereintrag" UWORD FORMULA_0010 0 0.0 0.0 65535.0 READ_WRITE ECU_ADDRESS 0x3F9AB2 /end MEASUREMENT
/begin MEASUREMENT ed_fsp_11of20_.uw_satz_2of3_.uw_wert_nv_4of4_ "Umweltbedingung beim Fehlereintrag" UWORD FORMULA_0010 0 0.0 0.0 65535.0 READ_WRITE ECU_ADDRESS 0x3F9AB4 /end MEASUREMENT
/begin MEASUREMENT ed_fsp_11of20_.uw_satz_3of3_.uw_km_stand_nv "Kilometerstand beim Fehlereintrag" UWORD FORMULA_0054 0 0.0 0.0 524280.0 READ_WRITE ECU_ADDRESS 0x3F9AB6 /end MEASUREMENT
/begin MEASUREMENT ed_fsp_11of20_.uw_satz_3of3_.uw_wert_nv_1of4_ "Umweltbedingung beim Fehlereintrag" UWORD FORMULA_0010 0 0.0 0.0 65535.0 READ_WRITE ECU_ADDRESS 0x3F9AB8 /end MEASUREMENT
/begin MEASUREMENT ed_fsp_11of20_.uw_satz_3of3_.uw_wert_nv_2of4_ "Umweltbedingung beim Fehlereintrag" UWORD FORMULA_0010 0 0.0 0.0 65535.0 READ_WRITE ECU_ADDRESS 0x3F9ABA /end MEASUREMENT
/begin MEASUREMENT ed_fsp_11of20_.uw_satz_3of3_.uw_wert_nv_3of4_ "Umweltbedingung beim Fehlereintrag" UWORD FORMULA_0010 0 0.0 0.0 65535.0 READ_WRITE ECU_ADDRESS 0x3F9ABC /end MEASUREMENT
/begin MEASUREMENT ed_fsp_11of20_.uw_satz_3of3_.uw_wert_nv_4of4_ "Umweltbedingung beim Fehlereintrag" UWORD FORMULA_0010 0 0.0 0.0 65535.0 READ_WRITE ECU_ADDRESS 0x3F9ABE /end MEASUREMENT
/begin MEASUREMENT ed_fsp_12of20_.ed_fil_index_nv "Verweis auf Fehlerfilter" UWORD FORMULA_0010 0 0.0 0.0 65535.0 READ_WRITE ECU_ADDRESS 0x3F9B04 /end MEASUREMENT
/begin MEASUREMENT ed_fsp_12of20_.fehlerart_nv "Fehlerart und Statusbits" UWORD FORMULA_0010 0 0.0 0.0 65535.0 READ_WRITE ECU_ADDRESS 0x3F9AE0 /end MEASUREMENT
/begin MEASUREMENT ed_fsp_12of20_.fehlercode_nv "Externer Fehlerort" UWORD FORMULA_0053 0 0.0 0.0 65535.0 READ_WRITE ECU_ADDRESS 0x3F9ADE /end MEASUREMENT
/begin MEASUREMENT ed_fsp_12of20_.ff_egas_ist_dk_b1_nv "Drosselklappenposition des Freeze Frame" UBYTE FORMULA_0059 0 0.0 0.0 100.0 READ_WRITE ECU_ADDRESS 0x3F9B1E /end MEASUREMENT
/begin MEASUREMENT ed_fsp_12of20_.ff_laa_f_ber_b1_nv "Lambdaadaptionsfaktor ohne TE des Freeze Frame" UBYTE FORMULA_0058 0 0.0 0.0 1.99210000038147 READ_WRITE ECU_ADDRESS 0x3F9B16 /end MEASUREMENT
/begin MEASUREMENT ed_fsp_12of20_.ff_laa_f_ber_b2_nv "Lambdaadaptionsfaktor ohne TE des Freeze Frame" UBYTE FORMULA_0058 0 0.0 0.0 1.99210000038147 READ_WRITE ECU_ADDRESS 0x3F9B17 /end MEASUREMENT
/begin MEASUREMENT ed_fsp_12of20_.ff_lam_reg_b1_nv "Einspritzsystem des Freeze Frame" UBYTE FORMULA_0057 0 0.0 0.0 255.0 READ_WRITE ECU_ADDRESS 0x3F9B12 /end MEASUREMENT
/begin MEASUREMENT ed_fsp_12of20_.ff_lam_reg_b2_nv "Einspritzsystem des Freeze Frame" UBYTE FORMULA_0057 0 0.0 0.0 255.0 READ_WRITE ECU_ADDRESS 0x3F9B13 /end MEASUREMENT
/begin MEASUREMENT ed_fsp_12of20_.ff_lam_reg_f_b1_nv "Lambdaregelfaktor des Freeze Frame" UBYTE FORMULA_0058 0 0.0 0.0 1.99210000038147 READ_WRITE ECU_ADDRESS 0x3F9B14 /end MEASUREMENT
/begin MEASUREMENT ed_fsp_12of20_.ff_lam_reg_f_b2_nv "Lambdaregelfaktor des Freeze Frame" UBYTE FORMULA_0058 0 0.0 0.0 1.99210000038147 READ_WRITE ECU_ADDRESS 0x3F9B15 /end MEASUREMENT
/begin MEASUREMENT ed_fsp_12of20_.ff_ml_ges_nv "Luftmasse des Freeze Frame" UWORD FORMULA_0056 0 0.0 0.0 655.3499755859375 READ_WRITE ECU_ADDRESS 0x3F9B10 /end MEASUREMENT
/begin MEASUREMENT ed_fsp_12of20_.ff_n_nv "Drehzahl des Freeze Frame" UWORD FORMULA_0055 0 0.0 0.0 16383.75 READ_WRITE ECU_ADDRESS 0x3F9B0E /end MEASUREMENT
/begin MEASUREMENT ed_fsp_12of20_.ff_p_code_nv "P-Code des Freeze Frame" UWORD FORMULA_0010 0 0.0 0.0 65535.0 READ_WRITE ECU_ADDRESS 0x3F9B0C /end MEASUREMENT
/begin MEASUREMENT ed_fsp_12of20_.ff_pks_ist_nv "Kraftstoffdruck des Freeze Frame" UBYTE FORMULA_0061 0 0.0 0.0 765.0 READ_WRITE ECU_ADDRESS 0x3F9B1A /end MEASUREMENT
/begin MEASUREMENT ed_fsp_12of20_.ff_rf_m_nv "Last des Freeze Frame" UBYTE FORMULA_0059 0 0.0 0.0 100.0 READ_WRITE ECU_ADDRESS 0x3F9B18 /end MEASUREMENT
/begin MEASUREMENT ed_fsp_12of20_.ff_sl_st_nv "Sekundaerluftstatus des Freeze Frame" UBYTE FORMULA_0064 0 0.0 0.0 255.0 READ_WRITE ECU_ADDRESS 0x3F9B1F /end MEASUREMENT
/begin MEASUREMENT ed_fsp_12of20_.ff_tan_m_nv "Ansauglufttemperatur des Freeze Frame" UBYTE FORMULA_0060 0 0.0 -40.0 215.0 READ_WRITE ECU_ADDRESS 0x3F9B1D /end MEASUREMENT
/begin MEASUREMENT ed_fsp_12of20_.ff_tmot_nv "Kuehlwassertemperatur des Freeze Frame" UBYTE FORMULA_0060 0 0.0 -40.0 215.0 READ_WRITE ECU_ADDRESS 0x3F9B19 /end MEASUREMENT
/begin MEASUREMENT ed_fsp_12of20_.ff_tz1_nv "Zuendwinkel 1 des Freeze Frame" UBYTE FORMULA_0063 0 0.0 -64.0 63.5 READ_WRITE ECU_ADDRESS 0x3F9B1C /end MEASUREMENT
/begin MEASUREMENT ed_fsp_12of20_.ff_v_vorne_nv "Geschwindigkeit des Freeze Frame" UBYTE FORMULA_0062 0 0.0 0.0 255.0 READ_WRITE ECU_ADDRESS 0x3F9B1B /end MEASUREMENT
/begin MEASUREMENT ed_fsp_12of20_.haeufigkeitszaehler_nv "Uebergangszaehler von i.O. -> n.i.O" UBYTE FORMULA_0003 0 0.0 0.0 255.0 READ_WRITE ECU_ADDRESS 0x3F9AE2 /end MEASUREMENT
/begin MEASUREMENT ed_fsp_12of20_.inj_fehlerzaehler_nv "INJ-Fehlerzaehler" UWORD FORMULA_0010 0 0.0 0.0 65535.0 READ_WRITE ECU_ADDRESS 0x3F9B02 /end MEASUREMENT
/begin MEASUREMENT ed_fsp_12of20_.logistikzaehler_nv "Warm-Up-Cycling-Zaehler" UBYTE FORMULA_0003 0 0.0 0.0 255.0 READ_WRITE ECU_ADDRESS 0x3F9AE3 /end MEASUREMENT
/begin MEASUREMENT ed_fsp_12of20_.mil_filter_nv "Filterwert der Milansteuerung" UBYTE FORMULA_0003 0 0.0 0.0 255.0 READ_WRITE ECU_ADDRESS 0x3F9B06 /end MEASUREMENT
/begin MEASUREMENT ed_fsp_12of20_.mil_filter_scdn_nv "Similar Conditions Eintragsfilterwert der Milansteuerung" UBYTE FORMULA_0003 0 0.0 0.0 255.0 READ_WRITE ECU_ADDRESS 0x3F9B07 /end MEASUREMENT
/begin MEASUREMENT ed_fsp_12of20_.scdn_nenner_nv "Gesamte Anzahl" UWORD FORMULA_0010 0 0.0 0.0 65535.0 READ_WRITE ECU_ADDRESS 0x3F9B0A /end MEASUREMENT
/begin MEASUREMENT ed_fsp_12of20_.scdn_zaehler_nv "Im similar Fenster" UWORD FORMULA_0010 0 0.0 0.0 65535.0 READ_WRITE ECU_ADDRESS 0x3F9B08 /end MEASUREMENT
/begin MEASUREMENT ed_fsp_12of20_.uw_satz_1of3_.uw_km_stand_nv "Kilometerstand beim Fehlereintrag" UWORD FORMULA_0054 0 0.0 0.0 524280.0 READ_WRITE ECU_ADDRESS 0x3F9AE4 /end MEASUREMENT
/begin MEASUREMENT ed_fsp_12of20_.uw_satz_1of3_.uw_wert_nv_1of4_ "Umweltbedingung beim Fehlereintrag" UWORD FORMULA_0010 0 0.0 0.0 65535.0 READ_WRITE ECU_ADDRESS 0x3F9AE6 /end MEASUREMENT
/begin MEASUREMENT ed_fsp_12of20_.uw_satz_1of3_.uw_wert_nv_2of4_ "Umweltbedingung beim Fehlereintrag" UWORD FORMULA_0010 0 0.0 0.0 65535.0 READ_WRITE ECU_ADDRESS 0x3F9AE8 /end MEASUREMENT
/begin MEASUREMENT ed_fsp_12of20_.uw_satz_1of3_.uw_wert_nv_3of4_ "Umweltbedingung beim Fehlereintrag" UWORD FORMULA_0010 0 0.0 0.0 65535.0 READ_WRITE ECU_ADDRESS 0x3F9AEA /end MEASUREMENT
/begin MEASUREMENT ed_fsp_12of20_.uw_satz_1of3_.uw_wert_nv_4of4_ "Umweltbedingung beim Fehlereintrag" UWORD FORMULA_0010 0 0.0 0.0 65535.0 READ_WRITE ECU_ADDRESS 0x3F9AEC /end MEASUREMENT
/begin MEASUREMENT ed_fsp_12of20_.uw_satz_2of3_.uw_km_stand_nv "Kilometerstand beim Fehlereintrag" UWORD FORMULA_0054 0 0.0 0.0 524280.0 READ_WRITE ECU_ADDRESS 0x3F9AEE /end MEASUREMENT
/begin MEASUREMENT ed_fsp_12of20_.uw_satz_2of3_.uw_wert_nv_1of4_ "Umweltbedingung beim Fehlereintrag" UWORD FORMULA_0010 0 0.0 0.0 65535.0 READ_WRITE ECU_ADDRESS 0x3F9AF0 /end MEASUREMENT
/begin MEASUREMENT ed_fsp_12of20_.uw_satz_2of3_.uw_wert_nv_2of4_ "Umweltbedingung beim Fehlereintrag" UWORD FORMULA_0010 0 0.0 0.0 65535.0 READ_WRITE ECU_ADDRESS 0x3F9AF2 /end MEASUREMENT
/begin MEASUREMENT ed_fsp_12of20_.uw_satz_2of3_.uw_wert_nv_3of4_ "Umweltbedingung beim Fehlereintrag" UWORD FORMULA_0010 0 0.0 0.0 65535.0 READ_WRITE ECU_ADDRESS 0x3F9AF4 /end MEASUREMENT
/begin MEASUREMENT ed_fsp_12of20_.uw_satz_2of3_.uw_wert_nv_4of4_ "Umweltbedingung beim Fehlereintrag" UWORD FORMULA_0010 0 0.0 0.0 65535.0 READ_WRITE ECU_ADDRESS 0x3F9AF6 /end MEASUREMENT
/begin MEASUREMENT ed_fsp_12of20_.uw_satz_3of3_.uw_km_stand_nv "Kilometerstand beim Fehlereintrag" UWORD FORMULA_0054 0 0.0 0.0 524280.0 READ_WRITE ECU_ADDRESS 0x3F9AF8 /end MEASUREMENT
/begin MEASUREMENT ed_fsp_12of20_.uw_satz_3of3_.uw_wert_nv_1of4_ "Umweltbedingung beim Fehlereintrag" UWORD FORMULA_0010 0 0.0 0.0 65535.0 READ_WRITE ECU_ADDRESS 0x3F9AFA /end MEASUREMENT
/begin MEASUREMENT ed_fsp_12of20_.uw_satz_3of3_.uw_wert_nv_2of4_ "Umweltbedingung beim Fehlereintrag" UWORD FORMULA_0010 0 0.0 0.0 65535.0 READ_WRITE ECU_ADDRESS 0x3F9AFC /end MEASUREMENT
/begin MEASUREMENT ed_fsp_12of20_.uw_satz_3of3_.uw_wert_nv_3of4_ "Umweltbedingung beim Fehlereintrag" UWORD FORMULA_0010 0 0.0 0.0 65535.0 READ_WRITE ECU_ADDRESS 0x3F9AFE /end MEASUREMENT
/begin MEASUREMENT ed_fsp_12of20_.uw_satz_3of3_.uw_wert_nv_4of4_ "Umweltbedingung beim Fehlereintrag" UWORD FORMULA_0010 0 0.0 0.0 65535.0 READ_WRITE ECU_ADDRESS 0x3F9B00 /end MEASUREMENT
/begin MEASUREMENT ed_fsp_13of20_.ed_fil_index_nv "Verweis auf Fehlerfilter" UWORD FORMULA_0010 0 0.0 0.0 65535.0 READ_WRITE ECU_ADDRESS 0x3F9B46 /end MEASUREMENT
/begin MEASUREMENT ed_fsp_13of20_.fehlerart_nv "Fehlerart und Statusbits" UWORD FORMULA_0010 0 0.0 0.0 65535.0 READ_WRITE ECU_ADDRESS 0x3F9B22 /end MEASUREMENT
/begin MEASUREMENT ed_fsp_13of20_.fehlercode_nv "Externer Fehlerort" UWORD FORMULA_0053 0 0.0 0.0 65535.0 READ_WRITE ECU_ADDRESS 0x3F9B20 /end MEASUREMENT
/begin MEASUREMENT ed_fsp_13of20_.ff_egas_ist_dk_b1_nv "Drosselklappenposition des Freeze Frame" UBYTE FORMULA_0059 0 0.0 0.0 100.0 READ_WRITE ECU_ADDRESS 0x3F9B60 /end MEASUREMENT
/begin MEASUREMENT ed_fsp_13of20_.ff_laa_f_ber_b1_nv "Lambdaadaptionsfaktor ohne TE des Freeze Frame" UBYTE FORMULA_0058 0 0.0 0.0 1.99210000038147 READ_WRITE ECU_ADDRESS 0x3F9B58 /end MEASUREMENT
/begin MEASUREMENT ed_fsp_13of20_.ff_laa_f_ber_b2_nv "Lambdaadaptionsfaktor ohne TE des Freeze Frame" UBYTE FORMULA_0058 0 0.0 0.0 1.99210000038147 READ_WRITE ECU_ADDRESS 0x3F9B59 /end MEASUREMENT
/begin MEASUREMENT ed_fsp_13of20_.ff_lam_reg_b1_nv "Einspritzsystem des Freeze Frame" UBYTE FORMULA_0057 0 0.0 0.0 255.0 READ_WRITE ECU_ADDRESS 0x3F9B54 /end MEASUREMENT
/begin MEASUREMENT ed_fsp_13of20_.ff_lam_reg_b2_nv "Einspritzsystem des Freeze Frame" UBYTE FORMULA_0057 0 0.0 0.0 255.0 READ_WRITE ECU_ADDRESS 0x3F9B55 /end MEASUREMENT
/begin MEASUREMENT ed_fsp_13of20_.ff_lam_reg_f_b1_nv "Lambdaregelfaktor des Freeze Frame" UBYTE FORMULA_0058 0 0.0 0.0 1.99210000038147 READ_WRITE ECU_ADDRESS 0x3F9B56 /end MEASUREMENT
/begin MEASUREMENT ed_fsp_13of20_.ff_lam_reg_f_b2_nv "Lambdaregelfaktor des Freeze Frame" UBYTE FORMULA_0058 0 0.0 0.0 1.99210000038147 READ_WRITE ECU_ADDRESS 0x3F9B57 /end MEASUREMENT
/begin MEASUREMENT ed_fsp_13of20_.ff_ml_ges_nv "Luftmasse des Freeze Frame" UWORD FORMULA_0056 0 0.0 0.0 655.3499755859375 READ_WRITE ECU_ADDRESS 0x3F9B52 /end MEASUREMENT
/begin MEASUREMENT ed_fsp_13of20_.ff_n_nv "Drehzahl des Freeze Frame" UWORD FORMULA_0055 0 0.0 0.0 16383.75 READ_WRITE ECU_ADDRESS 0x3F9B50 /end MEASUREMENT
/begin MEASUREMENT ed_fsp_13of20_.ff_p_code_nv "P-Code des Freeze Frame" UWORD FORMULA_0010 0 0.0 0.0 65535.0 READ_WRITE ECU_ADDRESS 0x3F9B4E /end MEASUREMENT
/begin MEASUREMENT ed_fsp_13of20_.ff_pks_ist_nv "Kraftstoffdruck des Freeze Frame" UBYTE FORMULA_0061 0 0.0 0.0 765.0 READ_WRITE ECU_ADDRESS 0x3F9B5C /end MEASUREMENT
/begin MEASUREMENT ed_fsp_13of20_.ff_rf_m_nv "Last des Freeze Frame" UBYTE FORMULA_0059 0 0.0 0.0 100.0 READ_WRITE ECU_ADDRESS 0x3F9B5A /end MEASUREMENT
/begin MEASUREMENT ed_fsp_13of20_.ff_sl_st_nv "Sekundaerluftstatus des Freeze Frame" UBYTE FORMULA_0064 0 0.0 0.0 255.0 READ_WRITE ECU_ADDRESS 0x3F9B61 /end MEASUREMENT
/begin MEASUREMENT ed_fsp_13of20_.ff_tan_m_nv "Ansauglufttemperatur des Freeze Frame" UBYTE FORMULA_0060 0 0.0 -40.0 215.0 READ_WRITE ECU_ADDRESS 0x3F9B5F /end MEASUREMENT
/begin MEASUREMENT ed_fsp_13of20_.ff_tmot_nv "Kuehlwassertemperatur des Freeze Frame" UBYTE FORMULA_0060 0 0.0 -40.0 215.0 READ_WRITE ECU_ADDRESS 0x3F9B5B /end MEASUREMENT
/begin MEASUREMENT ed_fsp_13of20_.ff_tz1_nv "Zuendwinkel 1 des Freeze Frame" UBYTE FORMULA_0063 0 0.0 -64.0 63.5 READ_WRITE ECU_ADDRESS 0x3F9B5E /end MEASUREMENT
/begin MEASUREMENT ed_fsp_13of20_.ff_v_vorne_nv "Geschwindigkeit des Freeze Frame" UBYTE FORMULA_0062 0 0.0 0.0 255.0 READ_WRITE ECU_ADDRESS 0x3F9B5D /end MEASUREMENT
/begin MEASUREMENT ed_fsp_13of20_.haeufigkeitszaehler_nv "Uebergangszaehler von i.O. -> n.i.O" UBYTE FORMULA_0003 0 0.0 0.0 255.0 READ_WRITE ECU_ADDRESS 0x3F9B24 /end MEASUREMENT
/begin MEASUREMENT ed_fsp_13of20_.inj_fehlerzaehler_nv "INJ-Fehlerzaehler" UWORD FORMULA_0010 0 0.0 0.0 65535.0 READ_WRITE ECU_ADDRESS 0x3F9B44 /end MEASUREMENT
/begin MEASUREMENT ed_fsp_13of20_.logistikzaehler_nv "Warm-Up-Cycling-Zaehler" UBYTE FORMULA_0003 0 0.0 0.0 255.0 READ_WRITE ECU_ADDRESS 0x3F9B25 /end MEASUREMENT
/begin MEASUREMENT ed_fsp_13of20_.mil_filter_nv "Filterwert der Milansteuerung" UBYTE FORMULA_0003 0 0.0 0.0 255.0 READ_WRITE ECU_ADDRESS 0x3F9B48 /end MEASUREMENT
/begin MEASUREMENT ed_fsp_13of20_.mil_filter_scdn_nv "Similar Conditions Eintragsfilterwert der Milansteuerung" UBYTE FORMULA_0003 0 0.0 0.0 255.0 READ_WRITE ECU_ADDRESS 0x3F9B49 /end MEASUREMENT
/begin MEASUREMENT ed_fsp_13of20_.scdn_nenner_nv "Gesamte Anzahl" UWORD FORMULA_0010 0 0.0 0.0 65535.0 READ_WRITE ECU_ADDRESS 0x3F9B4C /end MEASUREMENT
/begin MEASUREMENT ed_fsp_13of20_.scdn_zaehler_nv "Im similar Fenster" UWORD FORMULA_0010 0 0.0 0.0 65535.0 READ_WRITE ECU_ADDRESS 0x3F9B4A /end MEASUREMENT
/begin MEASUREMENT ed_fsp_13of20_.uw_satz_1of3_.uw_km_stand_nv "Kilometerstand beim Fehlereintrag" UWORD FORMULA_0054 0 0.0 0.0 524280.0 READ_WRITE ECU_ADDRESS 0x3F9B26 /end MEASUREMENT
/begin MEASUREMENT ed_fsp_13of20_.uw_satz_1of3_.uw_wert_nv_1of4_ "Umweltbedingung beim Fehlereintrag" UWORD FORMULA_0010 0 0.0 0.0 65535.0 READ_WRITE ECU_ADDRESS 0x3F9B28 /end MEASUREMENT
/begin MEASUREMENT ed_fsp_13of20_.uw_satz_1of3_.uw_wert_nv_2of4_ "Umweltbedingung beim Fehlereintrag" UWORD FORMULA_0010 0 0.0 0.0 65535.0 READ_WRITE ECU_ADDRESS 0x3F9B2A /end MEASUREMENT
/begin MEASUREMENT ed_fsp_13of20_.uw_satz_1of3_.uw_wert_nv_3of4_ "Umweltbedingung beim Fehlereintrag" UWORD FORMULA_0010 0 0.0 0.0 65535.0 READ_WRITE ECU_ADDRESS 0x3F9B2C /end MEASUREMENT
/begin MEASUREMENT ed_fsp_13of20_.uw_satz_1of3_.uw_wert_nv_4of4_ "Umweltbedingung beim Fehlereintrag" UWORD FORMULA_0010 0 0.0 0.0 65535.0 READ_WRITE ECU_ADDRESS 0x3F9B2E /end MEASUREMENT
/begin MEASUREMENT ed_fsp_13of20_.uw_satz_2of3_.uw_km_stand_nv "Kilometerstand beim Fehlereintrag" UWORD FORMULA_0054 0 0.0 0.0 524280.0 READ_WRITE ECU_ADDRESS 0x3F9B30 /end MEASUREMENT
/begin MEASUREMENT ed_fsp_13of20_.uw_satz_2of3_.uw_wert_nv_1of4_ "Umweltbedingung beim Fehlereintrag" UWORD FORMULA_0010 0 0.0 0.0 65535.0 READ_WRITE ECU_ADDRESS 0x3F9B32 /end MEASUREMENT
/begin MEASUREMENT ed_fsp_13of20_.uw_satz_2of3_.uw_wert_nv_2of4_ "Umweltbedingung beim Fehlereintrag" UWORD FORMULA_0010 0 0.0 0.0 65535.0 READ_WRITE ECU_ADDRESS 0x3F9B34 /end MEASUREMENT
/begin MEASUREMENT ed_fsp_13of20_.uw_satz_2of3_.uw_wert_nv_3of4_ "Umweltbedingung beim Fehlereintrag" UWORD FORMULA_0010 0 0.0 0.0 65535.0 READ_WRITE ECU_ADDRESS 0x3F9B36 /end MEASUREMENT
/begin MEASUREMENT ed_fsp_13of20_.uw_satz_2of3_.uw_wert_nv_4of4_ "Umweltbedingung beim Fehlereintrag" UWORD FORMULA_0010 0 0.0 0.0 65535.0 READ_WRITE ECU_ADDRESS 0x3F9B38 /end MEASUREMENT
/begin MEASUREMENT ed_fsp_13of20_.uw_satz_3of3_.uw_km_stand_nv "Kilometerstand beim Fehlereintrag" UWORD FORMULA_0054 0 0.0 0.0 524280.0 READ_WRITE ECU_ADDRESS 0x3F9B3A /end MEASUREMENT
/begin MEASUREMENT ed_fsp_13of20_.uw_satz_3of3_.uw_wert_nv_1of4_ "Umweltbedingung beim Fehlereintrag" UWORD FORMULA_0010 0 0.0 0.0 65535.0 READ_WRITE ECU_ADDRESS 0x3F9B3C /end MEASUREMENT
/begin MEASUREMENT ed_fsp_13of20_.uw_satz_3of3_.uw_wert_nv_2of4_ "Umweltbedingung beim Fehlereintrag" UWORD FORMULA_0010 0 0.0 0.0 65535.0 READ_WRITE ECU_ADDRESS 0x3F9B3E /end MEASUREMENT
/begin MEASUREMENT ed_fsp_13of20_.uw_satz_3of3_.uw_wert_nv_3of4_ "Umweltbedingung beim Fehlereintrag" UWORD FORMULA_0010 0 0.0 0.0 65535.0 READ_WRITE ECU_ADDRESS 0x3F9B40 /end MEASUREMENT
/begin MEASUREMENT ed_fsp_13of20_.uw_satz_3of3_.uw_wert_nv_4of4_ "Umweltbedingung beim Fehlereintrag" UWORD FORMULA_0010 0 0.0 0.0 65535.0 READ_WRITE ECU_ADDRESS 0x3F9B42 /end MEASUREMENT
/begin MEASUREMENT ed_fsp_14of20_.ed_fil_index_nv "Verweis auf Fehlerfilter" UWORD FORMULA_0010 0 0.0 0.0 65535.0 READ_WRITE ECU_ADDRESS 0x3F9B88 /end MEASUREMENT
/begin MEASUREMENT ed_fsp_14of20_.fehlerart_nv "Fehlerart und Statusbits" UWORD FORMULA_0010 0 0.0 0.0 65535.0 READ_WRITE ECU_ADDRESS 0x3F9B64 /end MEASUREMENT
/begin MEASUREMENT ed_fsp_14of20_.fehlercode_nv "Externer Fehlerort" UWORD FORMULA_0053 0 0.0 0.0 65535.0 READ_WRITE ECU_ADDRESS 0x3F9B62 /end MEASUREMENT
/begin MEASUREMENT ed_fsp_14of20_.ff_egas_ist_dk_b1_nv "Drosselklappenposition des Freeze Frame" UBYTE FORMULA_0059 0 0.0 0.0 100.0 READ_WRITE ECU_ADDRESS 0x3F9BA2 /end MEASUREMENT
/begin MEASUREMENT ed_fsp_14of20_.ff_laa_f_ber_b1_nv "Lambdaadaptionsfaktor ohne TE des Freeze Frame" UBYTE FORMULA_0058 0 0.0 0.0 1.99210000038147 READ_WRITE ECU_ADDRESS 0x3F9B9A /end MEASUREMENT
/begin MEASUREMENT ed_fsp_14of20_.ff_laa_f_ber_b2_nv "Lambdaadaptionsfaktor ohne TE des Freeze Frame" UBYTE FORMULA_0058 0 0.0 0.0 1.99210000038147 READ_WRITE ECU_ADDRESS 0x3F9B9B /end MEASUREMENT
/begin MEASUREMENT ed_fsp_14of20_.ff_lam_reg_b1_nv "Einspritzsystem des Freeze Frame" UBYTE FORMULA_0057 0 0.0 0.0 255.0 READ_WRITE ECU_ADDRESS 0x3F9B96 /end MEASUREMENT
/begin MEASUREMENT ed_fsp_14of20_.ff_lam_reg_b2_nv "Einspritzsystem des Freeze Frame" UBYTE FORMULA_0057 0 0.0 0.0 255.0 READ_WRITE ECU_ADDRESS 0x3F9B97 /end MEASUREMENT
/begin MEASUREMENT ed_fsp_14of20_.ff_lam_reg_f_b1_nv "Lambdaregelfaktor des Freeze Frame" UBYTE FORMULA_0058 0 0.0 0.0 1.99210000038147 READ_WRITE ECU_ADDRESS 0x3F9B98 /end MEASUREMENT
/begin MEASUREMENT ed_fsp_14of20_.ff_lam_reg_f_b2_nv "Lambdaregelfaktor des Freeze Frame" UBYTE FORMULA_0058 0 0.0 0.0 1.99210000038147 READ_WRITE ECU_ADDRESS 0x3F9B99 /end MEASUREMENT
/begin MEASUREMENT ed_fsp_14of20_.ff_ml_ges_nv "Luftmasse des Freeze Frame" UWORD FORMULA_0056 0 0.0 0.0 655.3499755859375 READ_WRITE ECU_ADDRESS 0x3F9B94 /end MEASUREMENT
/begin MEASUREMENT ed_fsp_14of20_.ff_n_nv "Drehzahl des Freeze Frame" UWORD FORMULA_0055 0 0.0 0.0 16383.75 READ_WRITE ECU_ADDRESS 0x3F9B92 /end MEASUREMENT
/begin MEASUREMENT ed_fsp_14of20_.ff_p_code_nv "P-Code des Freeze Frame" UWORD FORMULA_0010 0 0.0 0.0 65535.0 READ_WRITE ECU_ADDRESS 0x3F9B90 /end MEASUREMENT
/begin MEASUREMENT ed_fsp_14of20_.ff_pks_ist_nv "Kraftstoffdruck des Freeze Frame" UBYTE FORMULA_0061 0 0.0 0.0 765.0 READ_WRITE ECU_ADDRESS 0x3F9B9E /end MEASUREMENT
/begin MEASUREMENT ed_fsp_14of20_.ff_rf_m_nv "Last des Freeze Frame" UBYTE FORMULA_0059 0 0.0 0.0 100.0 READ_WRITE ECU_ADDRESS 0x3F9B9C /end MEASUREMENT
/begin MEASUREMENT ed_fsp_14of20_.ff_sl_st_nv "Sekundaerluftstatus des Freeze Frame" UBYTE FORMULA_0064 0 0.0 0.0 255.0 READ_WRITE ECU_ADDRESS 0x3F9BA3 /end MEASUREMENT
/begin MEASUREMENT ed_fsp_14of20_.ff_tan_m_nv "Ansauglufttemperatur des Freeze Frame" UBYTE FORMULA_0060 0 0.0 -40.0 215.0 READ_WRITE ECU_ADDRESS 0x3F9BA1 /end MEASUREMENT
/begin MEASUREMENT ed_fsp_14of20_.ff_tmot_nv "Kuehlwassertemperatur des Freeze Frame" UBYTE FORMULA_0060 0 0.0 -40.0 215.0 READ_WRITE ECU_ADDRESS 0x3F9B9D /end MEASUREMENT
/begin MEASUREMENT ed_fsp_14of20_.ff_tz1_nv "Zuendwinkel 1 des Freeze Frame" UBYTE FORMULA_0063 0 0.0 -64.0 63.5 READ_WRITE ECU_ADDRESS 0x3F9BA0 /end MEASUREMENT
/begin MEASUREMENT ed_fsp_14of20_.ff_v_vorne_nv "Geschwindigkeit des Freeze Frame" UBYTE FORMULA_0062 0 0.0 0.0 255.0 READ_WRITE ECU_ADDRESS 0x3F9B9F /end MEASUREMENT
/begin MEASUREMENT ed_fsp_14of20_.haeufigkeitszaehler_nv "Uebergangszaehler von i.O. -> n.i.O" UBYTE FORMULA_0003 0 0.0 0.0 255.0 READ_WRITE ECU_ADDRESS 0x3F9B66 /end MEASUREMENT
/begin MEASUREMENT ed_fsp_14of20_.inj_fehlerzaehler_nv "INJ-Fehlerzaehler" UWORD FORMULA_0010 0 0.0 0.0 65535.0 READ_WRITE ECU_ADDRESS 0x3F9B86 /end MEASUREMENT
/begin MEASUREMENT ed_fsp_14of20_.logistikzaehler_nv "Warm-Up-Cycling-Zaehler" UBYTE FORMULA_0003 0 0.0 0.0 255.0 READ_WRITE ECU_ADDRESS 0x3F9B67 /end MEASUREMENT
/begin MEASUREMENT ed_fsp_14of20_.mil_filter_nv "Filterwert der Milansteuerung" UBYTE FORMULA_0003 0 0.0 0.0 255.0 READ_WRITE ECU_ADDRESS 0x3F9B8A /end MEASUREMENT
/begin MEASUREMENT ed_fsp_14of20_.mil_filter_scdn_nv "Similar Conditions Eintragsfilterwert der Milansteuerung" UBYTE FORMULA_0003 0 0.0 0.0 255.0 READ_WRITE ECU_ADDRESS 0x3F9B8B /end MEASUREMENT
/begin MEASUREMENT ed_fsp_14of20_.scdn_nenner_nv "Gesamte Anzahl" UWORD FORMULA_0010 0 0.0 0.0 65535.0 READ_WRITE ECU_ADDRESS 0x3F9B8E /end MEASUREMENT
/begin MEASUREMENT ed_fsp_14of20_.scdn_zaehler_nv "Im similar Fenster" UWORD FORMULA_0010 0 0.0 0.0 65535.0 READ_WRITE ECU_ADDRESS 0x3F9B8C /end MEASUREMENT
/begin MEASUREMENT ed_fsp_14of20_.uw_satz_1of3_.uw_km_stand_nv "Kilometerstand beim Fehlereintrag" UWORD FORMULA_0054 0 0.0 0.0 524280.0 READ_WRITE ECU_ADDRESS 0x3F9B68 /end MEASUREMENT
/begin MEASUREMENT ed_fsp_14of20_.uw_satz_1of3_.uw_wert_nv_1of4_ "Umweltbedingung beim Fehlereintrag" UWORD FORMULA_0010 0 0.0 0.0 65535.0 READ_WRITE ECU_ADDRESS 0x3F9B6A /end MEASUREMENT
/begin MEASUREMENT ed_fsp_14of20_.uw_satz_1of3_.uw_wert_nv_2of4_ "Umweltbedingung beim Fehlereintrag" UWORD FORMULA_0010 0 0.0 0.0 65535.0 READ_WRITE ECU_ADDRESS 0x3F9B6C /end MEASUREMENT
/begin MEASUREMENT ed_fsp_14of20_.uw_satz_1of3_.uw_wert_nv_3of4_ "Umweltbedingung beim Fehlereintrag" UWORD FORMULA_0010 0 0.0 0.0 65535.0 READ_WRITE ECU_ADDRESS 0x3F9B6E /end MEASUREMENT
/begin MEASUREMENT ed_fsp_14of20_.uw_satz_1of3_.uw_wert_nv_4of4_ "Umweltbedingung beim Fehlereintrag" UWORD FORMULA_0010 0 0.0 0.0 65535.0 READ_WRITE ECU_ADDRESS 0x3F9B70 /end MEASUREMENT
/begin MEASUREMENT ed_fsp_14of20_.uw_satz_2of3_.uw_km_stand_nv "Kilometerstand beim Fehlereintrag" UWORD FORMULA_0054 0 0.0 0.0 524280.0 READ_WRITE ECU_ADDRESS 0x3F9B72 /end MEASUREMENT
/begin MEASUREMENT ed_fsp_14of20_.uw_satz_2of3_.uw_wert_nv_1of4_ "Umweltbedingung beim Fehlereintrag" UWORD FORMULA_0010 0 0.0 0.0 65535.0 READ_WRITE ECU_ADDRESS 0x3F9B74 /end MEASUREMENT
/begin MEASUREMENT ed_fsp_14of20_.uw_satz_2of3_.uw_wert_nv_2of4_ "Umweltbedingung beim Fehlereintrag" UWORD FORMULA_0010 0 0.0 0.0 65535.0 READ_WRITE ECU_ADDRESS 0x3F9B76 /end MEASUREMENT
/begin MEASUREMENT ed_fsp_14of20_.uw_satz_2of3_.uw_wert_nv_3of4_ "Umweltbedingung beim Fehlereintrag" UWORD FORMULA_0010 0 0.0 0.0 65535.0 READ_WRITE ECU_ADDRESS 0x3F9B78 /end MEASUREMENT
/begin MEASUREMENT ed_fsp_14of20_.uw_satz_2of3_.uw_wert_nv_4of4_ "Umweltbedingung beim Fehlereintrag" UWORD FORMULA_0010 0 0.0 0.0 65535.0 READ_WRITE ECU_ADDRESS 0x3F9B7A /end MEASUREMENT
/begin MEASUREMENT ed_fsp_14of20_.uw_satz_3of3_.uw_km_stand_nv "Kilometerstand beim Fehlereintrag" UWORD FORMULA_0054 0 0.0 0.0 524280.0 READ_WRITE ECU_ADDRESS 0x3F9B7C /end MEASUREMENT
/begin MEASUREMENT ed_fsp_14of20_.uw_satz_3of3_.uw_wert_nv_1of4_ "Umweltbedingung beim Fehlereintrag" UWORD FORMULA_0010 0 0.0 0.0 65535.0 READ_WRITE ECU_ADDRESS 0x3F9B7E /end MEASUREMENT
/begin MEASUREMENT ed_fsp_14of20_.uw_satz_3of3_.uw_wert_nv_2of4_ "Umweltbedingung beim Fehlereintrag" UWORD FORMULA_0010 0 0.0 0.0 65535.0 READ_WRITE ECU_ADDRESS 0x3F9B80 /end MEASUREMENT
/begin MEASUREMENT ed_fsp_14of20_.uw_satz_3of3_.uw_wert_nv_3of4_ "Umweltbedingung beim Fehlereintrag" UWORD FORMULA_0010 0 0.0 0.0 65535.0 READ_WRITE ECU_ADDRESS 0x3F9B82 /end MEASUREMENT
/begin MEASUREMENT ed_fsp_14of20_.uw_satz_3of3_.uw_wert_nv_4of4_ "Umweltbedingung beim Fehlereintrag" UWORD FORMULA_0010 0 0.0 0.0 65535.0 READ_WRITE ECU_ADDRESS 0x3F9B84 /end MEASUREMENT
/begin MEASUREMENT ed_fsp_15of20_.ed_fil_index_nv "Verweis auf Fehlerfilter" UWORD FORMULA_0010 0 0.0 0.0 65535.0 READ_WRITE ECU_ADDRESS 0x3F9BCA /end MEASUREMENT
/begin MEASUREMENT ed_fsp_15of20_.fehlerart_nv "Fehlerart und Statusbits" UWORD FORMULA_0010 0 0.0 0.0 65535.0 READ_WRITE ECU_ADDRESS 0x3F9BA6 /end MEASUREMENT
/begin MEASUREMENT ed_fsp_15of20_.fehlercode_nv "Externer Fehlerort" UWORD FORMULA_0053 0 0.0 0.0 65535.0 READ_WRITE ECU_ADDRESS 0x3F9BA4 /end MEASUREMENT
/begin MEASUREMENT ed_fsp_15of20_.ff_egas_ist_dk_b1_nv "Drosselklappenposition des Freeze Frame" UBYTE FORMULA_0059 0 0.0 0.0 100.0 READ_WRITE ECU_ADDRESS 0x3F9BE4 /end MEASUREMENT
/begin MEASUREMENT ed_fsp_15of20_.ff_laa_f_ber_b1_nv "Lambdaadaptionsfaktor ohne TE des Freeze Frame" UBYTE FORMULA_0058 0 0.0 0.0 1.99210000038147 READ_WRITE ECU_ADDRESS 0x3F9BDC /end MEASUREMENT
/begin MEASUREMENT ed_fsp_15of20_.ff_laa_f_ber_b2_nv "Lambdaadaptionsfaktor ohne TE des Freeze Frame" UBYTE FORMULA_0058 0 0.0 0.0 1.99210000038147 READ_WRITE ECU_ADDRESS 0x3F9BDD /end MEASUREMENT
/begin MEASUREMENT ed_fsp_15of20_.ff_lam_reg_b1_nv "Einspritzsystem des Freeze Frame" UBYTE FORMULA_0057 0 0.0 0.0 255.0 READ_WRITE ECU_ADDRESS 0x3F9BD8 /end MEASUREMENT
/begin MEASUREMENT ed_fsp_15of20_.ff_lam_reg_b2_nv "Einspritzsystem des Freeze Frame" UBYTE FORMULA_0057 0 0.0 0.0 255.0 READ_WRITE ECU_ADDRESS 0x3F9BD9 /end MEASUREMENT
/begin MEASUREMENT ed_fsp_15of20_.ff_lam_reg_f_b1_nv "Lambdaregelfaktor des Freeze Frame" UBYTE FORMULA_0058 0 0.0 0.0 1.99210000038147 READ_WRITE ECU_ADDRESS 0x3F9BDA /end MEASUREMENT
/begin MEASUREMENT ed_fsp_15of20_.ff_lam_reg_f_b2_nv "Lambdaregelfaktor des Freeze Frame" UBYTE FORMULA_0058 0 0.0 0.0 1.99210000038147 READ_WRITE ECU_ADDRESS 0x3F9BDB /end MEASUREMENT
/begin MEASUREMENT ed_fsp_15of20_.ff_ml_ges_nv "Luftmasse des Freeze Frame" UWORD FORMULA_0056 0 0.0 0.0 655.3499755859375 READ_WRITE ECU_ADDRESS 0x3F9BD6 /end MEASUREMENT
/begin MEASUREMENT ed_fsp_15of20_.ff_n_nv "Drehzahl des Freeze Frame" UWORD FORMULA_0055 0 0.0 0.0 16383.75 READ_WRITE ECU_ADDRESS 0x3F9BD4 /end MEASUREMENT
/begin MEASUREMENT ed_fsp_15of20_.ff_p_code_nv "P-Code des Freeze Frame" UWORD FORMULA_0010 0 0.0 0.0 65535.0 READ_WRITE ECU_ADDRESS 0x3F9BD2 /end MEASUREMENT
/begin MEASUREMENT ed_fsp_15of20_.ff_pks_ist_nv "Kraftstoffdruck des Freeze Frame" UBYTE FORMULA_0061 0 0.0 0.0 765.0 READ_WRITE ECU_ADDRESS 0x3F9BE0 /end MEASUREMENT
/begin MEASUREMENT ed_fsp_15of20_.ff_rf_m_nv "Last des Freeze Frame" UBYTE FORMULA_0059 0 0.0 0.0 100.0 READ_WRITE ECU_ADDRESS 0x3F9BDE /end MEASUREMENT
/begin MEASUREMENT ed_fsp_15of20_.ff_sl_st_nv "Sekundaerluftstatus des Freeze Frame" UBYTE FORMULA_0064 0 0.0 0.0 255.0 READ_WRITE ECU_ADDRESS 0x3F9BE5 /end MEASUREMENT
/begin MEASUREMENT ed_fsp_15of20_.ff_tan_m_nv "Ansauglufttemperatur des Freeze Frame" UBYTE FORMULA_0060 0 0.0 -40.0 215.0 READ_WRITE ECU_ADDRESS 0x3F9BE3 /end MEASUREMENT
/begin MEASUREMENT ed_fsp_15of20_.ff_tmot_nv "Kuehlwassertemperatur des Freeze Frame" UBYTE FORMULA_0060 0 0.0 -40.0 215.0 READ_WRITE ECU_ADDRESS 0x3F9BDF /end MEASUREMENT
/begin MEASUREMENT ed_fsp_15of20_.ff_tz1_nv "Zuendwinkel 1 des Freeze Frame" UBYTE FORMULA_0063 0 0.0 -64.0 63.5 READ_WRITE ECU_ADDRESS 0x3F9BE2 /end MEASUREMENT
/begin MEASUREMENT ed_fsp_15of20_.ff_v_vorne_nv "Geschwindigkeit des Freeze Frame" UBYTE FORMULA_0062 0 0.0 0.0 255.0 READ_WRITE ECU_ADDRESS 0x3F9BE1 /end MEASUREMENT
/begin MEASUREMENT ed_fsp_15of20_.haeufigkeitszaehler_nv "Uebergangszaehler von i.O. -> n.i.O" UBYTE FORMULA_0003 0 0.0 0.0 255.0 READ_WRITE ECU_ADDRESS 0x3F9BA8 /end MEASUREMENT
/begin MEASUREMENT ed_fsp_15of20_.inj_fehlerzaehler_nv "INJ-Fehlerzaehler" UWORD FORMULA_0010 0 0.0 0.0 65535.0 READ_WRITE ECU_ADDRESS 0x3F9BC8 /end MEASUREMENT
/begin MEASUREMENT ed_fsp_15of20_.logistikzaehler_nv "Warm-Up-Cycling-Zaehler" UBYTE FORMULA_0003 0 0.0 0.0 255.0 READ_WRITE ECU_ADDRESS 0x3F9BA9 /end MEASUREMENT
/begin MEASUREMENT ed_fsp_15of20_.mil_filter_nv "Filterwert der Milansteuerung" UBYTE FORMULA_0003 0 0.0 0.0 255.0 READ_WRITE ECU_ADDRESS 0x3F9BCC /end MEASUREMENT
/begin MEASUREMENT ed_fsp_15of20_.mil_filter_scdn_nv "Similar Conditions Eintragsfilterwert der Milansteuerung" UBYTE FORMULA_0003 0 0.0 0.0 255.0 READ_WRITE ECU_ADDRESS 0x3F9BCD /end MEASUREMENT
/begin MEASUREMENT ed_fsp_15of20_.scdn_nenner_nv "Gesamte Anzahl" UWORD FORMULA_0010 0 0.0 0.0 65535.0 READ_WRITE ECU_ADDRESS 0x3F9BD0 /end MEASUREMENT
/begin MEASUREMENT ed_fsp_15of20_.scdn_zaehler_nv "Im similar Fenster" UWORD FORMULA_0010 0 0.0 0.0 65535.0 READ_WRITE ECU_ADDRESS 0x3F9BCE /end MEASUREMENT
/begin MEASUREMENT ed_fsp_15of20_.uw_satz_1of3_.uw_km_stand_nv "Kilometerstand beim Fehlereintrag" UWORD FORMULA_0054 0 0.0 0.0 524280.0 READ_WRITE ECU_ADDRESS 0x3F9BAA /end MEASUREMENT
/begin MEASUREMENT ed_fsp_15of20_.uw_satz_1of3_.uw_wert_nv_1of4_ "Umweltbedingung beim Fehlereintrag" UWORD FORMULA_0010 0 0.0 0.0 65535.0 READ_WRITE ECU_ADDRESS 0x3F9BAC /end MEASUREMENT
/begin MEASUREMENT ed_fsp_15of20_.uw_satz_1of3_.uw_wert_nv_2of4_ "Umweltbedingung beim Fehlereintrag" UWORD FORMULA_0010 0 0.0 0.0 65535.0 READ_WRITE ECU_ADDRESS 0x3F9BAE /end MEASUREMENT
/begin MEASUREMENT ed_fsp_15of20_.uw_satz_1of3_.uw_wert_nv_3of4_ "Umweltbedingung beim Fehlereintrag" UWORD FORMULA_0010 0 0.0 0.0 65535.0 READ_WRITE ECU_ADDRESS 0x3F9BB0 /end MEASUREMENT
/begin MEASUREMENT ed_fsp_15of20_.uw_satz_1of3_.uw_wert_nv_4of4_ "Umweltbedingung beim Fehlereintrag" UWORD FORMULA_0010 0 0.0 0.0 65535.0 READ_WRITE ECU_ADDRESS 0x3F9BB2 /end MEASUREMENT
/begin MEASUREMENT ed_fsp_15of20_.uw_satz_2of3_.uw_km_stand_nv "Kilometerstand beim Fehlereintrag" UWORD FORMULA_0054 0 0.0 0.0 524280.0 READ_WRITE ECU_ADDRESS 0x3F9BB4 /end MEASUREMENT
/begin MEASUREMENT ed_fsp_15of20_.uw_satz_2of3_.uw_wert_nv_1of4_ "Umweltbedingung beim Fehlereintrag" UWORD FORMULA_0010 0 0.0 0.0 65535.0 READ_WRITE ECU_ADDRESS 0x3F9BB6 /end MEASUREMENT
/begin MEASUREMENT ed_fsp_15of20_.uw_satz_2of3_.uw_wert_nv_2of4_ "Umweltbedingung beim Fehlereintrag" UWORD FORMULA_0010 0 0.0 0.0 65535.0 READ_WRITE ECU_ADDRESS 0x3F9BB8 /end MEASUREMENT
/begin MEASUREMENT ed_fsp_15of20_.uw_satz_2of3_.uw_wert_nv_3of4_ "Umweltbedingung beim Fehlereintrag" UWORD FORMULA_0010 0 0.0 0.0 65535.0 READ_WRITE ECU_ADDRESS 0x3F9BBA /end MEASUREMENT
/begin MEASUREMENT ed_fsp_15of20_.uw_satz_2of3_.uw_wert_nv_4of4_ "Umweltbedingung beim Fehlereintrag" UWORD FORMULA_0010 0 0.0 0.0 65535.0 READ_WRITE ECU_ADDRESS 0x3F9BBC /end MEASUREMENT
/begin MEASUREMENT ed_fsp_15of20_.uw_satz_3of3_.uw_km_stand_nv "Kilometerstand beim Fehlereintrag" UWORD FORMULA_0054 0 0.0 0.0 524280.0 READ_WRITE ECU_ADDRESS 0x3F9BBE /end MEASUREMENT
/begin MEASUREMENT ed_fsp_15of20_.uw_satz_3of3_.uw_wert_nv_1of4_ "Umweltbedingung beim Fehlereintrag" UWORD FORMULA_0010 0 0.0 0.0 65535.0 READ_WRITE ECU_ADDRESS 0x3F9BC0 /end MEASUREMENT
/begin MEASUREMENT ed_fsp_15of20_.uw_satz_3of3_.uw_wert_nv_2of4_ "Umweltbedingung beim Fehlereintrag" UWORD FORMULA_0010 0 0.0 0.0 65535.0 READ_WRITE ECU_ADDRESS 0x3F9BC2 /end MEASUREMENT
/begin MEASUREMENT ed_fsp_15of20_.uw_satz_3of3_.uw_wert_nv_3of4_ "Umweltbedingung beim Fehlereintrag" UWORD FORMULA_0010 0 0.0 0.0 65535.0 READ_WRITE ECU_ADDRESS 0x3F9BC4 /end MEASUREMENT
/begin MEASUREMENT ed_fsp_15of20_.uw_satz_3of3_.uw_wert_nv_4of4_ "Umweltbedingung beim Fehlereintrag" UWORD FORMULA_0010 0 0.0 0.0 65535.0 READ_WRITE ECU_ADDRESS 0x3F9BC6 /end MEASUREMENT
/begin MEASUREMENT ed_fsp_16of20_.ed_fil_index_nv "Verweis auf Fehlerfilter" UWORD FORMULA_0010 0 0.0 0.0 65535.0 READ_WRITE ECU_ADDRESS 0x3F9C0C /end MEASUREMENT
/begin MEASUREMENT ed_fsp_16of20_.fehlerart_nv "Fehlerart und Statusbits" UWORD FORMULA_0010 0 0.0 0.0 65535.0 READ_WRITE ECU_ADDRESS 0x3F9BE8 /end MEASUREMENT
/begin MEASUREMENT ed_fsp_16of20_.fehlercode_nv "Externer Fehlerort" UWORD FORMULA_0053 0 0.0 0.0 65535.0 READ_WRITE ECU_ADDRESS 0x3F9BE6 /end MEASUREMENT
/begin MEASUREMENT ed_fsp_16of20_.ff_egas_ist_dk_b1_nv "Drosselklappenposition des Freeze Frame" UBYTE FORMULA_0059 0 0.0 0.0 100.0 READ_WRITE ECU_ADDRESS 0x3F9C26 /end MEASUREMENT
/begin MEASUREMENT ed_fsp_16of20_.ff_laa_f_ber_b1_nv "Lambdaadaptionsfaktor ohne TE des Freeze Frame" UBYTE FORMULA_0058 0 0.0 0.0 1.99210000038147 READ_WRITE ECU_ADDRESS 0x3F9C1E /end MEASUREMENT
/begin MEASUREMENT ed_fsp_16of20_.ff_laa_f_ber_b2_nv "Lambdaadaptionsfaktor ohne TE des Freeze Frame" UBYTE FORMULA_0058 0 0.0 0.0 1.99210000038147 READ_WRITE ECU_ADDRESS 0x3F9C1F /end MEASUREMENT
/begin MEASUREMENT ed_fsp_16of20_.ff_lam_reg_b1_nv "Einspritzsystem des Freeze Frame" UBYTE FORMULA_0057 0 0.0 0.0 255.0 READ_WRITE ECU_ADDRESS 0x3F9C1A /end MEASUREMENT
/begin MEASUREMENT ed_fsp_16of20_.ff_lam_reg_b2_nv "Einspritzsystem des Freeze Frame" UBYTE FORMULA_0057 0 0.0 0.0 255.0 READ_WRITE ECU_ADDRESS 0x3F9C1B /end MEASUREMENT
/begin MEASUREMENT ed_fsp_16of20_.ff_lam_reg_f_b1_nv "Lambdaregelfaktor des Freeze Frame" UBYTE FORMULA_0058 0 0.0 0.0 1.99210000038147 READ_WRITE ECU_ADDRESS 0x3F9C1C /end MEASUREMENT
/begin MEASUREMENT ed_fsp_16of20_.ff_lam_reg_f_b2_nv "Lambdaregelfaktor des Freeze Frame" UBYTE FORMULA_0058 0 0.0 0.0 1.99210000038147 READ_WRITE ECU_ADDRESS 0x3F9C1D /end MEASUREMENT
/begin MEASUREMENT ed_fsp_16of20_.ff_ml_ges_nv "Luftmasse des Freeze Frame" UWORD FORMULA_0056 0 0.0 0.0 655.3499755859375 READ_WRITE ECU_ADDRESS 0x3F9C18 /end MEASUREMENT
/begin MEASUREMENT ed_fsp_16of20_.ff_n_nv "Drehzahl des Freeze Frame" UWORD FORMULA_0055 0 0.0 0.0 16383.75 READ_WRITE ECU_ADDRESS 0x3F9C16 /end MEASUREMENT
/begin MEASUREMENT ed_fsp_16of20_.ff_p_code_nv "P-Code des Freeze Frame" UWORD FORMULA_0010 0 0.0 0.0 65535.0 READ_WRITE ECU_ADDRESS 0x3F9C14 /end MEASUREMENT
/begin MEASUREMENT ed_fsp_16of20_.ff_pks_ist_nv "Kraftstoffdruck des Freeze Frame" UBYTE FORMULA_0061 0 0.0 0.0 765.0 READ_WRITE ECU_ADDRESS 0x3F9C22 /end MEASUREMENT
/begin MEASUREMENT ed_fsp_16of20_.ff_rf_m_nv "Last des Freeze Frame" UBYTE FORMULA_0059 0 0.0 0.0 100.0 READ_WRITE ECU_ADDRESS 0x3F9C20 /end MEASUREMENT
/begin MEASUREMENT ed_fsp_16of20_.ff_sl_st_nv "Sekundaerluftstatus des Freeze Frame" UBYTE FORMULA_0064 0 0.0 0.0 255.0 READ_WRITE ECU_ADDRESS 0x3F9C27 /end MEASUREMENT
/begin MEASUREMENT ed_fsp_16of20_.ff_tan_m_nv "Ansauglufttemperatur des Freeze Frame" UBYTE FORMULA_0060 0 0.0 -40.0 215.0 READ_WRITE ECU_ADDRESS 0x3F9C25 /end MEASUREMENT
/begin MEASUREMENT ed_fsp_16of20_.ff_tmot_nv "Kuehlwassertemperatur des Freeze Frame" UBYTE FORMULA_0060 0 0.0 -40.0 215.0 READ_WRITE ECU_ADDRESS 0x3F9C21 /end MEASUREMENT
/begin MEASUREMENT ed_fsp_16of20_.ff_tz1_nv "Zuendwinkel 1 des Freeze Frame" UBYTE FORMULA_0063 0 0.0 -64.0 63.5 READ_WRITE ECU_ADDRESS 0x3F9C24 /end MEASUREMENT
/begin MEASUREMENT ed_fsp_16of20_.ff_v_vorne_nv "Geschwindigkeit des Freeze Frame" UBYTE FORMULA_0062 0 0.0 0.0 255.0 READ_WRITE ECU_ADDRESS 0x3F9C23 /end MEASUREMENT
/begin MEASUREMENT ed_fsp_16of20_.haeufigkeitszaehler_nv "Uebergangszaehler von i.O. -> n.i.O" UBYTE FORMULA_0003 0 0.0 0.0 255.0 READ_WRITE ECU_ADDRESS 0x3F9BEA /end MEASUREMENT
/begin MEASUREMENT ed_fsp_16of20_.inj_fehlerzaehler_nv "INJ-Fehlerzaehler" UWORD FORMULA_0010 0 0.0 0.0 65535.0 READ_WRITE ECU_ADDRESS 0x3F9C0A /end MEASUREMENT
/begin MEASUREMENT ed_fsp_16of20_.logistikzaehler_nv "Warm-Up-Cycling-Zaehler" UBYTE FORMULA_0003 0 0.0 0.0 255.0 READ_WRITE ECU_ADDRESS 0x3F9BEB /end MEASUREMENT
/begin MEASUREMENT ed_fsp_16of20_.mil_filter_nv "Filterwert der Milansteuerung" UBYTE FORMULA_0003 0 0.0 0.0 255.0 READ_WRITE ECU_ADDRESS 0x3F9C0E /end MEASUREMENT
/begin MEASUREMENT ed_fsp_16of20_.mil_filter_scdn_nv "Similar Conditions Eintragsfilterwert der Milansteuerung" UBYTE FORMULA_0003 0 0.0 0.0 255.0 READ_WRITE ECU_ADDRESS 0x3F9C0F /end MEASUREMENT
/begin MEASUREMENT ed_fsp_16of20_.scdn_nenner_nv "Gesamte Anzahl" UWORD FORMULA_0010 0 0.0 0.0 65535.0 READ_WRITE ECU_ADDRESS 0x3F9C12 /end MEASUREMENT
/begin MEASUREMENT ed_fsp_16of20_.scdn_zaehler_nv "Im similar Fenster" UWORD FORMULA_0010 0 0.0 0.0 65535.0 READ_WRITE ECU_ADDRESS 0x3F9C10 /end MEASUREMENT
/begin MEASUREMENT ed_fsp_16of20_.uw_satz_1of3_.uw_km_stand_nv "Kilometerstand beim Fehlereintrag" UWORD FORMULA_0054 0 0.0 0.0 524280.0 READ_WRITE ECU_ADDRESS 0x3F9BEC /end MEASUREMENT
/begin MEASUREMENT ed_fsp_16of20_.uw_satz_1of3_.uw_wert_nv_1of4_ "Umweltbedingung beim Fehlereintrag" UWORD FORMULA_0010 0 0.0 0.0 65535.0 READ_WRITE ECU_ADDRESS 0x3F9BEE /end MEASUREMENT
/begin MEASUREMENT ed_fsp_16of20_.uw_satz_1of3_.uw_wert_nv_2of4_ "Umweltbedingung beim Fehlereintrag" UWORD FORMULA_0010 0 0.0 0.0 65535.0 READ_WRITE ECU_ADDRESS 0x3F9BF0 /end MEASUREMENT
/begin MEASUREMENT ed_fsp_16of20_.uw_satz_1of3_.uw_wert_nv_3of4_ "Umweltbedingung beim Fehlereintrag" UWORD FORMULA_0010 0 0.0 0.0 65535.0 READ_WRITE ECU_ADDRESS 0x3F9BF2 /end MEASUREMENT
/begin MEASUREMENT ed_fsp_16of20_.uw_satz_1of3_.uw_wert_nv_4of4_ "Umweltbedingung beim Fehlereintrag" UWORD FORMULA_0010 0 0.0 0.0 65535.0 READ_WRITE ECU_ADDRESS 0x3F9BF4 /end MEASUREMENT
/begin MEASUREMENT ed_fsp_16of20_.uw_satz_2of3_.uw_km_stand_nv "Kilometerstand beim Fehlereintrag" UWORD FORMULA_0054 0 0.0 0.0 524280.0 READ_WRITE ECU_ADDRESS 0x3F9BF6 /end MEASUREMENT
/begin MEASUREMENT ed_fsp_16of20_.uw_satz_2of3_.uw_wert_nv_1of4_ "Umweltbedingung beim Fehlereintrag" UWORD FORMULA_0010 0 0.0 0.0 65535.0 READ_WRITE ECU_ADDRESS 0x3F9BF8 /end MEASUREMENT
/begin MEASUREMENT ed_fsp_16of20_.uw_satz_2of3_.uw_wert_nv_2of4_ "Umweltbedingung beim Fehlereintrag" UWORD FORMULA_0010 0 0.0 0.0 65535.0 READ_WRITE ECU_ADDRESS 0x3F9BFA /end MEASUREMENT
/begin MEASUREMENT ed_fsp_16of20_.uw_satz_2of3_.uw_wert_nv_3of4_ "Umweltbedingung beim Fehlereintrag" UWORD FORMULA_0010 0 0.0 0.0 65535.0 READ_WRITE ECU_ADDRESS 0x3F9BFC /end MEASUREMENT
/begin MEASUREMENT ed_fsp_16of20_.uw_satz_2of3_.uw_wert_nv_4of4_ "Umweltbedingung beim Fehlereintrag" UWORD FORMULA_0010 0 0.0 0.0 65535.0 READ_WRITE ECU_ADDRESS 0x3F9BFE /end MEASUREMENT
/begin MEASUREMENT ed_fsp_16of20_.uw_satz_3of3_.uw_km_stand_nv "Kilometerstand beim Fehlereintrag" UWORD FORMULA_0054 0 0.0 0.0 524280.0 READ_WRITE ECU_ADDRESS 0x3F9C00 /end MEASUREMENT
/begin MEASUREMENT ed_fsp_16of20_.uw_satz_3of3_.uw_wert_nv_1of4_ "Umweltbedingung beim Fehlereintrag" UWORD FORMULA_0010 0 0.0 0.0 65535.0 READ_WRITE ECU_ADDRESS 0x3F9C02 /end MEASUREMENT
/begin MEASUREMENT ed_fsp_16of20_.uw_satz_3of3_.uw_wert_nv_2of4_ "Umweltbedingung beim Fehlereintrag" UWORD FORMULA_0010 0 0.0 0.0 65535.0 READ_WRITE ECU_ADDRESS 0x3F9C04 /end MEASUREMENT
/begin MEASUREMENT ed_fsp_16of20_.uw_satz_3of3_.uw_wert_nv_3of4_ "Umweltbedingung beim Fehlereintrag" UWORD FORMULA_0010 0 0.0 0.0 65535.0 READ_WRITE ECU_ADDRESS 0x3F9C06 /end MEASUREMENT
/begin MEASUREMENT ed_fsp_16of20_.uw_satz_3of3_.uw_wert_nv_4of4_ "Umweltbedingung beim Fehlereintrag" UWORD FORMULA_0010 0 0.0 0.0 65535.0 READ_WRITE ECU_ADDRESS 0x3F9C08 /end MEASUREMENT
/begin COMPU_METHOD FORMULA_0003 "FORMULA_0003" RAT_FUNC "%3.0" "-" COEFFS 0 1 0 0 0 1 /end COMPU_METHOD
/begin COMPU_METHOD FORMULA_0010 "FORMULA_0010" RAT_FUNC "%5.0" "-" COEFFS 0 1 0 0 0 1 /end COMPU_METHOD
/begin COMPU_METHOD FORMULA_0052 "FORMULA_0052" TAB_VERB "%7.2" "-" COMPU_TAB_REF FORMULA_0052_VTAB /end COMPU_METHOD
/begin COMPU_METHOD FORMULA_0053 "FORMULA_0053" TAB_VERB "%5.0" "-" COMPU_TAB_REF FORMULA_0053_VTAB /end COMPU_METHOD
/begin COMPU_METHOD FORMULA_0054 "FORMULA_0054" RAT_FUNC "%5.0" "km" COEFFS 0 0.125 0.0 0 0.0 1.0 /end COMPU_METHOD
/begin COMPU_METHOD FORMULA_0055 "FORMULA_0055" RAT_FUNC "%5.0" "-" COEFFS 0 4.0 0.0 0 0.0 1.0 /end COMPU_METHOD
/begin COMPU_METHOD FORMULA_0056 "FORMULA_0056" RAT_FUNC "%7.2" "g/s" COEFFS 0 100.0 0.0 0 0.0 1.0 /end COMPU_METHOD
/begin COMPU_METHOD FORMULA_0057 "FORMULA_0057" TAB_VERB "%3.0" "-" COMPU_TAB_REF FORMULA_0057_VTAB /end COMPU_METHOD
/begin COMPU_METHOD FORMULA_0058 "FORMULA_0058" RAT_FUNC "%7.4" "-" COEFFS 0 128.0 0.0 0 0.0 1.0 /end COMPU_METHOD
/begin COMPU_METHOD FORMULA_0059 "FORMULA_0059" RAT_FUNC "%7.4" "%" COEFFS 0 2.55 0.0 0 0.0 1.0 /end COMPU_METHOD
/begin COMPU_METHOD FORMULA_0060 "FORMULA_0060" RAT_FUNC "%3.0" "°C" COEFFS 0 1.0 40.0 0 0.0 1.0 /end COMPU_METHOD
/begin COMPU_METHOD FORMULA_0061 "FORMULA_0061" RAT_FUNC "%3.0" "kPa" COEFFS 0 0.3333333333333333 0.0 0 0.0 1.0 /end COMPU_METHOD
/begin COMPU_METHOD FORMULA_0062 "FORMULA_0062" RAT_FUNC "%3.0" "km/h" COEFFS 0 1 0 0 0 1 /end COMPU_METHOD
/begin COMPU_METHOD FORMULA_0063 "FORMULA_0063" RAT_FUNC "%4.1" "°KW" COEFFS 0 2.0 128.0 0 0.0 1.0 /end COMPU_METHOD
/begin COMPU_METHOD FORMULA_0064 "FORMULA_0064" TAB_VERB "%3.0" "-" COMPU_TAB_REF FORMULA_0064_VTAB /end COMPU_METHOD
/begin COMPU_VTAB FORMULA_0052_VTAB "FORMULA_0052_VTAB" TAB_VERB 44 0 "O.K." 1 "SH_TO_UB" 2 "SH_TO_GND" 4 "OPENLOAD" 8 "UNPLAUSI" 256 "O.K./ZYKLUS" 512 "FILTER" 513 "FIL/SH_TO_UB" 514 "FIL/SH_TO_GND" 516 "FIL/OPENLOAD" 520 "FIL/UNPLAUSI" 576 "VORHANDEN" 577 "VORH/SH_TO_UB" 578 "VORH/SH_TO_GND" 580 "VORH/OPENLOAD" 584 "VORH/UNPLAUSI" 768 "FILTER/ZYKLUS" 769 "FIL/ZYK/SH_TO_UB" 770 "FIL/ZYK/SH_TO_GND" 772 "FIL/ZYK/OPENLOAD" 776 "FIL/ZYK/UNPLAUSI" 832 "VORHANDEN/ZYKLUS" 833 "VORH/ZYK/SH_TO_UB" 834 "VORH/ZYK/SH_TO_GND" 836 "VORH/ZYK/OPENLOAD" 840 "VORH/ZYK/UNPLAUSI" 2048 "O.K./SCDN" 2304 "O.K./S/ZYKLUS" 2561 "FIL/S/SH_TO_UB" 2562 "FIL/S/SH_TO_GND" 2564 "FIL/S/OPENLOAD" 2568 "FIL/S/UNPLAUSI" 2625 "VORH/S/SH_TO_UB" 2626 "VORH/S/SH_TO_GND" 2628 "VORH/S/OPENLOAD" 2632 "VORH/S/UNPLAUSI" 2817 "FIL/ZYK/S/SH_TO_UB" 2818 "FIL/ZYK/S/SH_TO_GND" 2820 "FIL/ZYK/S/OPENLOAD" 2824 "FIL/ZYK/S/UNPLAUSI" 2881 "VORH/ZYK/S/SH_TO_UB" 2882 "VORH/ZYK/S/SH_TO_GND" 2884 "VORH/ZYK/S/OPENLOAD" 2888 "VORH/ZYK/S/UNPLAUSI" /end COMPU_VTAB
/begin COMPU_VTAB FORMULA_0053_VTAB "FORMULA_0053_VTAB" TAB_VERB 352 10000 "SK_TESTFEHLER" 10001 "PUMG_FEHLER" 10002 "HFM1_FEHLER" 10003 "HFM2_FEHLER" 10004 "PSAU1_FEHLER" 10005 "PSAU2_FEHLER" 10006 "VAN_HALL_E1_FEHLER" 10007 "VAN_HALL_A1_FEHLER" 10008 "VAN_HALL_E2_FEHLER" 10009 "VAN_HALL_A2_FEHLER" 10010 "VAN_REGL_E1_FEHLER" 10011 "VAN_REGL_A1_FEHLER" 10012 "VAN_REGL_E2_FEHLER" 10013 "VAN_REGL_A2_FEHLER" 10014 "NW_SYNC_FEHLER" 10015 "INDEX_15_INJ" 10016 "PCTRL_IGN_FEHLER" 10017 "PT_TORQDKG_FEHLER" 10018 "PKS_FEHLER" 10019 "PT_STATUSR_FEHLER" 10020 "LAVK1_FEHLER" 10021 "LAVK2_FEHLER" 10022 "LAVK1_OBD_PLAU_FEHLER" 10023 "LAVK2_OBD_PLAU_FEHLER" 10024 "LAVK1_OBD_SA_FEHLER" 10025 "LAVK2_OBD_SA_FEHLER" 10026 "LANK1_FEHLER" 10027 "LANK2_FEHLER" 10028 "LSHNK1_FEHLER" 10029 "LSHNK2_FEHLER" 52615 "PT_BUSOFF" 52632 "PT_TORQDSC_FEHLER" 52645 "PT_STDSC_FEHLER" 52667 "PT_VRAD_FEHLER" 52636 "PT_VFZG_FEHLER" 52628 "PT_ATEMP_FEHLER" 52640 "PT_KLST_FEHLER" 52649 "PT_KKOS_FEHLER" 52641 "PT_LRW_FEHLER" 10039 "FPLAU1_FEHLER" 10040 "FPLAU2_FEHLER" 10041 "SL_ML_HFM_FEHLER" 10042 "LANK1_OBD_S_FEHLER" 10043 "LANK2_OBD_S_FEHLER" 10044 "LAVK1_OBD_TL_FEHLER" 10045 "LAVK2_OBD_TL_FEHLER" 10046 "LSHVK1_FEHLER" 10047 "LSHVK2_FEHLER" 10048 "LSRVK1_OBD_REG_FEHLER" 10049 "LSRVK2_OBD_REG_FEHLER" 10050 "LSHVK1_R_FEHLER" 10051 "LSHVK2_R_FEHLER" 10052 "LSRVK1_OBD_START_FEHLER" 10053 "LSRVK2_OBD_START_FEHLER" 10054 "LSRVK1_OBD_REF_FEHLER" 10055 "LSRVK2_OBD_REF_FEHLER" 10056 "LAVK1_DIAG_FEHLER" 10057 "LAVK2_DIAG_FEHLER" 10058 "LAVK1_IA_OPENLOAD_FEHLER" 10059 "LAVK2_IA_OPENLOAD_FEHLER" 10060 "PT_GRB_FEHLER" 10061 "PT_GRB2_FEHLER" 10062 "LAVK1_UN_OPENLOAD_FEHLER" 10063 "LAVK2_UN_OPENLOAD_FEHLER" 10064 "LAVK1_IP_OPENLOAD_FEHLER" 10065 "LAVK2_IP_OPENLOAD_FEHLER" 10066 "APPL_DATA_INJ" 10067 "TZ1_FEHLER" 10068 "TZ2_FEHLER" 10069 "TZ3_FEHLER" 10070 "TZ4_FEHLER" 10071 "TZ5_FEHLER" 10072 "TZ6_FEHLER" 10073 "TZ7_FEHLER" 10074 "TZ8_FEHLER" 10075 "TZ9_FEHLER" 10076 "TZ10_FEHLER" 10077 "LAM1_REG_FEHLER" 10078 "LAM2_REG_FEHLER" 10079 "VAN_ANSCHL_E1_FEHLER" 10080 "VAN_ANSCHL_A1_FEHLER" 10081 "VAN_ANSCHL_E2_FEHLER" 10082 "VAN_ANSCHL_A2_FEHLER" 10083 "VAN_VENT_E1_FEHLER" 10084 "VAN_VENT_A1_FEHLER" 10085 "VAN_VENT_E2_FEHLER" 10086 "VAN_VENT_A2_FEHLER" 10087 "EV1_FEHLER" 10088 "EV2_FEHLER" 10089 "EV3_FEHLER" 10090 "EV4_FEHLER" 10091 "EV5_FEHLER" 10092 "EV6_FEHLER" 10093 "EV7_FEHLER" 10094 "EV8_FEHLER" 10095 "EV9_FEHLER" 10096 "EV10_FEHLER" 10097 "LAVK1_OBD_DYN_FEHLER" 10098 "LAVK2_OBD_DYN_FEHLER" 52650 "PT_CRASH_FEHLER" 52635 "PT_VEHMOD_FEHLER" 52629 "PT_BEDFGR_FEHLER" 10102 "DMTL_P_FEHLER" 10103 "DMTL_V_FEHLER" 10104 "DMTL_H_FEHLER" 10105 "DMTL_GROBLECK_FEHLER" 10106 "DMTL_FEUCHT_FEHLER" 10107 "DMTL_DECKEL_MELDUNG" 10108 "LA1_TRIM_FEHLER" 10109 "LA2_TRIM_FEHLER" 10110 "RLU87_FEHLER" 10111 "EKP_PWM_FEHLER" 10112 "CODIER_FEHLER" 10113 "TD_FEHLER" 10114 "RLSLP_FEHLER" 10115 "SLV_FEHLER" 52639 "PT_KMST_FEHLER" 52648 "PT_STATKOM_FEHLER" 10118 "PKS_LL_FEHLER" 10119 "PKS_TL_FEHLER" 10120 "PKS_Q_FEHLER" 10121 "KAT_OBD1_FEHLER" 10122 "KAT_OBD2_FEHLER" 10123 "VAN_DSV_FEHLER" 10124 "FI_GEN" 10125 "FI_BSD" 10126 "FI_QLT" 10127 "FI_IBS1" 10128 "FI_IBS2" 10129 "FI_IBS3" 10130 "FI_PMBN" 10131 "FI_PMBATT" 10132 "MVAC_DRUCKSENSOR" 52668 "PT_BEDAT_FEHLER" 10134 "SK_MANAGER_INJ" 10135 "INDEX_135_INJ" 10136 "EWS_SCI_FEHLER" 10137 "EWS_MAN_FEHLER" 10138 "FI_BSD_0" 10139 "FI_BSD_6" 10140 "FI_BSDGLOB" 10141 "FI_PMRUHVERL" 10142 "FI_TOENS" 10143 "EBOX_ELU_FEHLER" 10144 "SG_INJ_FEHLER" 10145 "EGAS_ENLTG1_DIAG" 10146 "EGAS_ENLTG2_DIAG" 10147 "S_POEL_FEHLER" 10148 "TEV1_OBD_FEHLER" 10149 "TEV2_OBD_FEHLER" 10150 "TEV1_FEHLER" 10151 "TEV2_FEHLER" 10152 "EBENE2_INJ_FEHLER" 10153 "KW_FEHLER" 10154 "LA1_ADAPT_FEHLER" 10155 "LA2_ADAPT_FEHLER" 10156 "KGE1_FEHLER" 10157 "KGE2_FEHLER" 10158 "FST_FEHLER" 10159 "SLP_FEHLER" 10160 "SL_DURCHS_B1" 10161 "SL_DURCHS_B2" 10162 "SL_DURCHS_HSTRANG" 10163 "FETRAWE_FEHLER" 10164 "S_GETR_HS_FEHLER" 10165 "S_KUPP_HS_FEHLER" 10166 "VAN_DRUCK_FEHLER" 10167 "ELUP_FEHLER" 10168 "ELU_FEHLER" 52655 "PT_STATANH_FEHLER" 10170 "KSD1_FEHLER" 10171 "KSD2_FEHLER" 10172 "KATS1_FEHLER" 10173 "KATS2_FEHLER" 10174 "PT_GRB3_FEHLER" 10175 "PT_ANFRADMOM_FEHLER" 10176 "FST_GEBER_FEHLER" 10177 "TANK_LEER_INFO" 10178 "PT_TOMA_FEHLER" 10179 "DMTL_FEINLECK_FEHLER" 10180 "PUMG_OBD_FEHLER" 10181 "SL_ML_HFM_OBD_FEHLER" 10182 "LA1_TRIM_AD_FEHLER" 10183 "LA2_TRIM_AD_FEHLER" 10184 "LANK1_OPENLOAD_FEHLER" 10185 "LANK2_OPENLOAD_FEHLER" 10186 "LANK1_OBD_WE_FEHLER" 10187 "LANK2_OBD_WE_FEHLER" 10188 "LSHNK1_R_FEHLER" 10189 "LSHNK2_R_FEHLER" 10190 "PKS_MODELL_FEHLER" 10191 "PKS_PAUFBAU_FEHLER" 10192 "PKSR_ADAPT_ANSCHL_FEHLER" 10193 "TGETR_FEHLER" 10194 "LAVK_ATIC42_FEHLER" 10195 "PT_ALAENGS_FEHLER" 10196 "INDEX_196_INJ" 10197 "INDEX_197_INJ" 10198 "INDEX_198_INJ" 10199 "INDEX_199_INJ" 10200 "INDEX_200_INJ" 10201 "INDEX_201_INJ" 10202 "INDEX_202_INJ" 10203 "INDEX_203_INJ" 10204 "INDEX_204_INJ" 10205 "INDEX_205_INJ" 10206 "INDEX_206_INJ" 10207 "INDEX_207_INJ" 10208 "INDEX_208_INJ" 10209 "INDEX_209_INJ" 10210 "INDEX_210_INJ" 10211 "INDEX_211_INJ" 10212 "INDEX_212_INJ" 10213 "INDEX_213_INJ" 10214 "INDEX_214_INJ" 10215 "INDEX_215_INJ" 10216 "INDEX_216_INJ" 10217 "INDEX_217_INJ" 10218 "INDEX_218_INJ" 10219 "INDEX_219_INJ" 10220 "INDEX_220_INJ" 10221 "INDEX_221_INJ" 10222 "INDEX_222_INJ" 10223 "INDEX_223_INJ" 11000 "SK_TESTFEHLER" 11001 "TMOT_FEHLER" 11002 "TMOT_OBD_FEHLER" 11003 "TAN1_FEHLER" 11004 "TAN2_FEHLER" 11005 "TIME_REL_OBD_FEHLER" 11006 "UB_FEHLER" 11007 "TKA_FEHLER" 11008 "TDME_FEHLER" 11009 "UEXT_111_219_514_FEHLER" 11010 "UEXT_124_512_FEHLER" 11011 "APPL_DATA_IGN" 11012 "TKA_OBD_FEHLER" 11013 "PWG1_FEHLER" 11014 "PWG2_FEHLER" 11015 "PWG_VGL_FEHLER" 11016 "PCTRL_INJ_FEHLER" 52669 "EC_LLS1_FEHLER" 52670 "EC_LLS2_FEHLER" 52671 "EC_DK1_FEHLER" 52672 "EC_DK2_FEHLER" 11021 "LLS1_SK_FEHLER" 11022 "LLS2_SK_FEHLER" 11023 "SMG_SCHALTABLAUF" 11024 "SMG_SK_FEHLER" 11025 "SMG_SK_N_UEBERWACHUNG" 11026 "TUMG_OBD_FEHLER" 11027 "V_FEHLER" 11028 "DK_INIT_FEHLER" 11029 "DK1_REG_FEHLER" 11030 "DK2_REG_FEHLER" 11031 "DK1_ADAPT_FEHLER" 11032 "DK2_ADAPT_FEHLER" 11033 "INDEX_33_IGN" 11034 "INDEX_34_IGN" 11035 "INDEX_35_IGN" 11036 "INDEX_36_IGN" 11037 "TABG1_FEHLER" 11038 "TABG2_FEHLER" 11039 "DK1_WDK_FEHLER" 11040 "DK2_WDK_FEHLER" 11041 "DK1_PDR_FEHLER" 11042 "DK2_PDR_FEHLER" 11043 "LLS1_REG_FEHLER" 11044 "LLS2_REG_FEHLER" 11045 "DK1_SK_FEHLER" 11046 "DK2_SK_FEHLER" 11047 "DK1_FT_FEHLER" 11048 "DK2_FT_FEHLER" 11049 "MD_SK_ERR" 11050 "LLS_INIT_FEHLER" 11051 "DSC_EINGR_FEHLER" 11052 "DK1_CMD_FEHLER" 11053 "DK2_CMD_FEHLER" 11054 "LLS1_CMD_FEHLER" 11055 "LLS2_CMD_FEHLER" 52673 "SC_SMG1_FEHLER" 52674 "SC_SMG2_FEHLER" 52675 "SC_SMG3_FEHLER" 52619 "SC_BUSOFF_FEHLER" 52627 "EC_BUSOFF_FEHLER" 11061 "AUSS_KAT_Z1_FEHLER" 11062 "AUSS_KAT_Z2_FEHLER" 11063 "AUSS_KAT_Z3_FEHLER" 11064 "AUSS_KAT_Z4_FEHLER" 11065 "AUSS_KAT_Z5_FEHLER" 11066 "AUSS_KAT_Z6_FEHLER" 11067 "AUSS_KAT_Z7_FEHLER" 11068 "AUSS_KAT_Z8_FEHLER" 11069 "AUSS_KAT_Z9_FEHLER" 11070 "AUSS_KAT_Z10_FEHLER" 11071 "INDEX_71_IGN" 11072 "INDEX_72_IGN" 11073 "AUSS_KAT_MULT_FEHLER" 11074 "AUSS_ABG_Z1_FEHLER" 11075 "AUSS_ABG_Z2_FEHLER" 11076 "AUSS_ABG_Z3_FEHLER" 11077 "AUSS_ABG_Z4_FEHLER" 11078 "AUSS_ABG_Z5_FEHLER" 11079 "AUSS_ABG_Z6_FEHLER" 11080 "AUSS_ABG_Z7_FEHLER" 11081 "AUSS_ABG_Z8_FEHLER" 11082 "AUSS_ABG_Z9_FEHLER" 11083 "AUSS_ABG_Z10_FEHLER" 11084 "INDEX_84_IGN" 11085 "INDEX_85_IGN" 11086 "AUSS_ABG_MULT_FEHLER" 11087 "TAN_OBD_B1_FEHLER" 11088 "DKG_EINGR_FEHLER" 11089 "SC_PKS_FEHLER" 11090 "ZOELP1_FEHLER" 11091 "ZOELP2_FEHLER" 11092 "SG_IGN_FEHLER" 11093 "EBENE2_IGN_FEHLER" 11094 "BLS_PLAU_FEHLER" 11095 "SK_MANAGER_IGN" 11096 "LLR_DIAGNOSE" 11097 "THERMOSTAT_FEHLER" 11098 "TAN_OBD_B2_FEHLER" 11099 "DK1_ZUSTAND" 11100 "DK2_ZUSTAND" 11101 "FGR_ABWURF" 11102 "PWG_BLS_FEHLER" 11103 "START_RL_FEHLER" 11104 "AFZ_FEHLER" 11105 "N_GETR_EIN_HS_FEHLER" 11106 "SERVO_I_FEHLER" 11107 "SERVO_V_FEHLER" 11108 "TUMG_FEHLER" 11109 "LLR_DIAGNOSE_CSS" 11110 "TMOT_HIGH_FEHLER" 11111 "M_SPULE_ZYL_1" 11112 "M_SPULE_ZYL_2" 11113 "M_SPULE_ZYL_3" 11114 "M_SPULE_ZYL_4" 11115 "M_SPULE_ZYL_5" 11116 "M_SPULE_ZYL_6" 11117 "M_SPULE_ZYL_7" 11118 "M_SPULE_ZYL_8" 11119 "M_SPULE_ZYL_9" 11120 "M_SPULE_ZYL_10" 11121 "INDEX_121_IGN" 11122 "INDEX_122_IGN" 11123 "INDEX_123_IGN" 11124 "INDEX_124_IGN" 11125 "INDEX_125_IGN" 11126 "INDEX_126_IGN" 11127 "INDEX_127_IGN" /end COMPU_VTAB
/begin COMPU_VTAB FORMULA_0057_VTAB "FORMULA_0057_VTAB" TAB_VERB 4 1 "Regler noch aus" 2 "Regler aktiv" 4 "Schubabschalten" 8 "Sonde defekt" /end COMPU_VTAB
/begin COMPU_VTAB FORMULA_0064_VTAB "FORMULA_0064_VTAB" TAB_VERB 2 1 "Einblasung" 4 "Keine Einblasung" /end COMPU_VTAB
/begin FUNCTION Eigendiagnose ""
 /begin OUT_MEASUREMENT ed_fil_auss_kat_z3.filter_nv ed_fil_auss_kat_z3.zyklus_filter_nv ed_fil_auss_kat_z4.art_aktuell_nv ed_fil_auss_kat_z4.fehler_aufrufe_nv ed_fil_auss_kat_z4.filter_max_nv ed_fil_auss_kat_z4.filter_nv ed_fil_auss_kat_z4.zyklus_filter_nv ed_fil_auss_kat_z5.art_aktuell_nv ed_fil_auss_kat_z5.fehler_aufrufe_nv ed_fil_auss_kat_z5.filter_max_nv ed_fil_auss_kat_z5.filter_nv ed_fil_auss_kat_z5.zyklus_filter_nv ed_fil_auss_kat_z6.art_aktuell_nv ed_fil_auss_kat_z6.fehler_aufrufe_nv ed_fil_auss_kat_z6.filter_max_nv ed_fil_auss_kat_z6.filter_nv ed_fil_auss_kat_z6.zyklus_filter_nv ed_fil_auss_kat_z7.art_aktuell_nv ed_fil_auss_kat_z7.fehler_aufrufe_nv ed_fil_auss_kat_z7.filter_max_nv ed_fil_auss_kat_z7.filter_nv ed_fil_auss_kat_z7.zyklus_filter_nv ed_fil_auss_kat_z8.art_aktuell_nv ed_fil_auss_kat_z8.fehler_aufrufe_nv ed_fil_auss_kat_z8.filter_max_nv ed_fil_auss_kat_z8.filter_nv ed_fil_auss_kat_z8.zyklus_filter_nv ed_fil_auss_kat_z9.art_aktuell_nv ed_fil_auss_kat_z9.fehler_aufrufe_nv ed_fil_auss_kat_z9.filter_max_nv ed_fil_auss_kat_z9.filter_nv ed_fil_auss_kat_z9.zyklus_filter_nv ed_fil_bls_plau.art_aktuell_nv ed_fil_bls_plau.fehler_aufrufe_nv ed_fil_bls_plau.filter_max_nv ed_fil_bls_plau.filter_nv ed_fil_bls_plau.zyklus_filter_nv ed_fil_dk_init.art_aktuell_nv ed_fil_dk_init.fehler_aufrufe_nv ed_fil_dk_init.filter_max_nv ed_fil_dk_init.filter_nv ed_fil_dk_init.zyklus_filter_nv ed_fil_dk1_adapt.art_aktuell_nv ed_fil_dk1_adapt.fehler_aufrufe_nv ed_fil_dk1_adapt.filter_max_nv ed_fil_dk1_adapt.filter_nv ed_fil_dk1_adapt.zyklus_filter_nv ed_fil_dk1_can.art_aktuell_nv ed_fil_dk1_can.fehler_aufrufe_nv ed_fil_dk1_can.filter_max_nv ed_fil_dk1_can.filter_nv ed_fil_dk1_can.zyklus_filter_nv ed_fil_dk1_cmd.art_aktuell_nv ed_fil_dk1_cmd.fehler_aufrufe_nv ed_fil_dk1_cmd.filter_max_nv ed_fil_dk1_cmd.filter_nv ed_fil_dk1_cmd.zyklus_filter_nv ed_fil_dk1_federn.art_aktuell_nv ed_fil_dk1_federn.fehler_aufrufe_nv ed_fil_dk1_federn.filter_max_nv ed_fil_dk1_federn.filter_nv ed_fil_dk1_federn.zyklus_filter_nv ed_fil_dk1_pdr.art_aktuell_nv ed_fil_dk1_pdr.fehler_aufrufe_nv ed_fil_dk1_pdr.filter_max_nv ed_fil_dk1_pdr.filter_nv ed_fil_dk1_pdr.zyklus_filter_nv ed_fil_dk1_regler.art_aktuell_nv ed_fil_dk1_regler.fehler_aufrufe_nv ed_fil_dk1_regler.filter_max_nv ed_fil_dk1_regler.filter_nv ed_fil_dk1_regler.zyklus_filter_nv ed_fil_dk1_sk_err.art_aktuell_nv ed_fil_dk1_sk_err.fehler_aufrufe_nv ed_fil_dk1_sk_err.filter_max_nv ed_fil_dk1_sk_err.filter_nv ed_fil_dk1_sk_err.zyklus_filter_nv ed_fil_dk1_wdk.art_aktuell_nv ed_fil_dk1_wdk.fehler_aufrufe_nv ed_fil_dk1_wdk.filter_max_nv ed_fil_dk1_wdk.filter_nv ed_fil_dk1_wdk.zyklus_filter_nv ed_fil_dk1_zust.art_aktuell_nv ed_fil_dk1_zust.fehler_aufrufe_nv ed_fil_dk1_zust.filter_max_nv ed_fil_dk1_zust.filter_nv ed_fil_dk1_zust.zyklus_filter_nv ed_fil_dk2_adapt.art_aktuell_nv ed_fil_dk2_adapt.fehler_aufrufe_nv ed_fil_dk2_adapt.filter_max_nv ed_fil_dk2_adapt.filter_nv ed_fil_dk2_adapt.zyklus_filter_nv ed_fil_dk2_can.art_aktuell_nv ed_fil_dk2_can.fehler_aufrufe_nv ed_fil_dk2_can.filter_max_nv ed_fil_dk2_can.filter_nv ed_fil_dk2_can.zyklus_filter_nv ed_fil_dk2_cmd.art_aktuell_nv ed_fil_dk2_cmd.fehler_aufrufe_nv ed_fil_dk2_cmd.filter_max_nv ed_fil_dk2_cmd.filter_nv ed_fil_dk2_cmd.zyklus_filter_nv ed_fil_dk2_federn.art_aktuell_nv ed_fil_dk2_federn.fehler_aufrufe_nv ed_fil_dk2_federn.filter_max_nv ed_fil_dk2_federn.filter_nv ed_fil_dk2_federn.zyklus_filter_nv ed_fil_dk2_pdr.art_aktuell_nv ed_fil_dk2_pdr.fehler_aufrufe_nv ed_fil_dk2_pdr.filter_max_nv ed_fil_dk2_pdr.filter_nv ed_fil_dk2_pdr.zyklus_filter_nv ed_fil_dk2_regler.art_aktuell_nv ed_fil_dk2_regler.fehler_aufrufe_nv ed_fil_dk2_regler.filter_max_nv ed_fil_dk2_regler.filter_nv ed_fil_dk2_regler.zyklus_filter_nv ed_fil_dk2_sk_err.art_aktuell_nv ed_fil_dk2_sk_err.fehler_aufrufe_nv ed_fil_dk2_sk_err.filter_max_nv ed_fil_dk2_sk_err.filter_nv ed_fil_dk2_sk_err.zyklus_filter_nv ed_fil_dk2_wdk.art_aktuell_nv ed_fil_dk2_wdk.fehler_aufrufe_nv ed_fil_dk2_wdk.filter_max_nv ed_fil_dk2_wdk.filter_nv ed_fil_dk2_wdk.zyklus_filter_nv ed_fil_dk2_zust.art_aktuell_nv ed_fil_dk2_zust.fehler_aufrufe_nv ed_fil_dk2_zust.filter_max_nv ed_fil_dk2_zust.filter_nv ed_fil_dk2_zust.zyklus_filter_nv ed_fil_dkg_eingr.art_aktuell_nv ed_fil_dkg_eingr.fehler_aufrufe_nv ed_fil_dkg_eingr.filter_max_nv ed_fil_dkg_eingr.filter_nv ed_fil_dkg_eingr.zyklus_filter_nv ed_fil_dsc_eingr.art_aktuell_nv ed_fil_dsc_eingr.fehler_aufrufe_nv ed_fil_dsc_eingr.filter_max_nv ed_fil_dsc_eingr.filter_nv ed_fil_dsc_eingr.zyklus_filter_nv ed_fil_e2_ign.art_aktuell_nv ed_fil_e2_ign.fehler_aufrufe_nv ed_fil_e2_ign.filter_max_nv ed_fil_e2_ign.filter_nv ed_fil_e2_ign.zyklus_filter_nv ed_fil_ec_busoff.art_aktuell_nv ed_fil_ec_busoff.fehler_aufrufe_nv ed_fil_ec_busoff.filter_max_nv ed_fil_ec_busoff.filter_nv ed_fil_ec_busoff.zyklus_filter_nv ed_fil_fgr_abwurf.art_aktuell_nv ed_fil_fgr_abwurf.fehler_aufrufe_nv ed_fil_fgr_abwurf.filter_max_nv ed_fil_fgr_abwurf.filter_nv ed_fil_fgr_abwurf.zyklus_filter_nv ed_fil_index_121_ign.art_aktuell_nv ed_fil_index_121_ign.fehler_aufrufe_nv ed_fil_index_121_ign.filter_max_nv ed_fil_index_121_ign.filter_nv ed_fil_index_121_ign.zyklus_filter_nv ed_fil_index_122_ign.art_aktuell_nv ed_fil_index_122_ign.fehler_aufrufe_nv ed_fil_index_122_ign.filter_max_nv ed_fil_index_122_ign.filter_nv ed_fil_index_122_ign.zyklus_filter_nv ed_fil_index_123_ign.art_aktuell_nv ed_fil_index_123_ign.fehler_aufrufe_nv ed_fil_index_123_ign.filter_max_nv ed_fil_index_123_ign.filter_nv ed_fil_index_123_ign.zyklus_filter_nv ed_fil_index_124_ign.art_aktuell_nv ed_fil_index_124_ign.fehler_aufrufe_nv ed_fil_index_124_ign.filter_max_nv ed_fil_index_124_ign.filter_nv ed_fil_index_124_ign.zyklus_filter_nv ed_fil_index_125_ign.art_aktuell_nv ed_fil_index_125_ign.fehler_aufrufe_nv ed_fil_index_125_ign.filter_max_nv ed_fil_index_125_ign.filter_nv ed_fil_index_125_ign.zyklus_filter_nv ed_fil_index_126_ign.art_aktuell_nv ed_fil_index_126_ign.fehler_aufrufe_nv ed_fil_index_126_ign.filter_max_nv ed_fil_index_126_ign.filter_nv ed_fil_index_126_ign.zyklus_filter_nv ed_fil_index_127_ign.art_aktuell_nv ed_fil_index_127_ign.fehler_aufrufe_nv ed_fil_index_127_ign.filter_max_nv ed_fil_index_127_ign.filter_nv ed_fil_index_127_ign.zyklus_filter_nv ed_fil_index_33_ign.art_aktuell_nv ed_fil_index_33_ign.fehler_aufrufe_nv ed_fil_index_33_ign.filter_max_nv ed_fil_index_33_ign.filter_nv ed_fil_index_33_ign.zyklus_filter_nv ed_fil_index_34_ign.art_aktuell_nv ed_fil_index_34_ign.fehler_aufrufe_nv ed_fil_index_34_ign.filter_max_nv ed_fil_index_34_ign.filter_nv ed_fil_index_34_ign.zyklus_filter_nv ed_fil_index_35_ign.art_aktuell_nv ed_fil_index_35_ign.fehler_aufrufe_nv ed_fil_index_35_ign.filter_max_nv ed_fil_index_35_ign.filter_nv ed_fil_index_35_ign.zyklus_filter_nv ed_fil_index_36_ign.art_aktuell_nv ed_fil_index_36_ign.fehler_aufrufe_nv ed_fil_index_36_ign.filter_max_nv ed_fil_index_36_ign.filter_nv ed_fil_index_36_ign.zyklus_filter_nv ed_fil_index_71_ign.art_aktuell_nv ed_fil_index_71_ign.fehler_aufrufe_nv ed_fil_index_71_ign.filter_max_nv ed_fil_index_71_ign.filter_nv ed_fil_index_71_ign.zyklus_filter_nv ed_fil_index_72_ign.art_aktuell_nv ed_fil_index_72_ign.fehler_aufrufe_nv ed_fil_index_72_ign.filter_max_nv ed_fil_index_72_ign.filter_nv ed_fil_index_72_ign.zyklus_filter_nv ed_fil_index_84_ign.art_aktuell_nv ed_fil_index_84_ign.fehler_aufrufe_nv ed_fil_index_84_ign.filter_max_nv ed_fil_index_84_ign.filter_nv ed_fil_index_84_ign.zyklus_filter_nv ed_fil_index_85_ign.art_aktuell_nv ed_fil_index_85_ign.fehler_aufrufe_nv ed_fil_index_85_ign.filter_max_nv ed_fil_index_85_ign.filter_nv ed_fil_index_85_ign.zyklus_filter_nv ed_fil_llr_diag.art_aktuell_nv ed_fil_llr_diag.fehler_aufrufe_nv ed_fil_llr_diag.filter_max_nv ed_fil_llr_diag.filter_nv ed_fil_llr_diag.zyklus_filter_nv ed_fil_llr_diag_css.art_aktuell_nv ed_fil_llr_diag_css.fehler_aufrufe_nv ed_fil_llr_diag_css.filter_max_nv ed_fil_llr_diag_css.filter_nv ed_fil_llr_diag_css.zyklus_filter_nv ed_fil_lls_init.art_aktuell_nv ed_fil_lls_init.fehler_aufrufe_nv ed_fil_lls_init.filter_max_nv ed_fil_lls_init.filter_nv ed_fil_lls_init.zyklus_filter_nv ed_fil_lls1_can.art_aktuell_nv ed_fil_lls1_can.fehler_aufrufe_nv ed_fil_lls1_can.filter_max_nv ed_fil_lls1_can.filter_nv ed_fil_lls1_can.zyklus_filter_nv ed_fil_lls1_cmd.art_aktuell_nv ed_fil_lls1_cmd.fehler_aufrufe_nv ed_fil_lls1_cmd.filter_max_nv ed_fil_lls1_cmd.filter_nv ed_fil_lls1_cmd.zyklus_filter_nv ed_fil_lls1_regler.art_aktuell_nv ed_fil_lls1_regler.fehler_aufrufe_nv ed_fil_lls1_regler.filter_max_nv ed_fil_lls1_regler.filter_nv ed_fil_lls1_regler.zyklus_filter_nv ed_fil_lls1_sk.art_aktuell_nv ed_fil_lls1_sk.fehler_aufrufe_nv ed_fil_lls1_sk.filter_max_nv ed_fil_lls1_sk.filter_nv ed_fil_lls1_sk.zyklus_filter_nv ed_fil_lls2_can.art_aktuell_nv ed_fil_lls2_can.fehler_aufrufe_nv ed_fil_lls2_can.filter_max_nv ed_fil_lls2_can.filter_nv ed_fil_lls2_can.zyklus_filter_nv ed_fil_lls2_cmd.art_aktuell_nv ed_fil_lls2_cmd.fehler_aufrufe_nv ed_fil_lls2_cmd.filter_max_nv ed_fil_lls2_cmd.filter_nv ed_fil_lls2_cmd.zyklus_filter_nv ed_fil_lls2_regler.art_aktuell_nv ed_fil_lls2_regler.fehler_aufrufe_nv ed_fil_lls2_regler.filter_max_nv ed_fil_lls2_regler.filter_nv ed_fil_lls2_regler.zyklus_filter_nv ed_fil_lls2_sk.art_aktuell_nv ed_fil_lls2_sk.fehler_aufrufe_nv ed_fil_lls2_sk.filter_max_nv ed_fil_lls2_sk.filter_nv ed_fil_lls2_sk.zyklus_filter_nv ed_fil_m_spule_z1.art_aktuell_nv ed_fil_m_spule_z1.fehler_aufrufe_nv ed_fil_m_spule_z1.filter_max_nv ed_fil_m_spule_z1.filter_nv ed_fil_m_spule_z1.zyklus_filter_nv ed_fil_m_spule_z10.art_aktuell_nv ed_fil_m_spule_z10.fehler_aufrufe_nv ed_fil_m_spule_z10.filter_max_nv ed_fil_m_spule_z10.filter_nv ed_fil_m_spule_z10.zyklus_filter_nv ed_fil_m_spule_z2.art_aktuell_nv ed_fil_m_spule_z2.fehler_aufrufe_nv ed_fil_m_spule_z2.filter_max_nv ed_fil_m_spule_z2.filter_nv ed_fil_m_spule_z2.zyklus_filter_nv ed_fil_m_spule_z3.art_aktuell_nv ed_fil_m_spule_z3.fehler_aufrufe_nv ed_fil_m_spule_z3.filter_max_nv ed_fil_m_spule_z3.filter_nv ed_fil_m_spule_z3.zyklus_filter_nv ed_fil_m_spule_z4.art_aktuell_nv ed_fil_m_spule_z4.fehler_aufrufe_nv ed_fil_m_spule_z4.filter_max_nv ed_fil_m_spule_z4.filter_nv ed_fil_m_spule_z4.zyklus_filter_nv ed_fil_m_spule_z5.art_aktuell_nv ed_fil_m_spule_z5.fehler_aufrufe_nv ed_fil_m_spule_z5.filter_max_nv ed_fil_m_spule_z5.filter_nv ed_fil_m_spule_z5.zyklus_filter_nv ed_fil_m_spule_z6.art_aktuell_nv ed_fil_m_spule_z6.fehler_aufrufe_nv ed_fil_m_spule_z6.filter_max_nv ed_fil_m_spule_z6.filter_nv ed_fil_m_spule_z6.zyklus_filter_nv ed_fil_m_spule_z7.art_aktuell_nv ed_fil_m_spule_z7.fehler_aufrufe_nv ed_fil_m_spule_z7.filter_max_nv ed_fil_m_spule_z7.filter_nv ed_fil_m_spule_z7.zyklus_filter_nv ed_fil_m_spule_z8.art_aktuell_nv ed_fil_m_spule_z8.fehler_aufrufe_nv ed_fil_m_spule_z8.filter_max_nv ed_fil_m_spule_z8.filter_nv ed_fil_m_spule_z8.zyklus_filter_nv ed_fil_m_spule_z9.art_aktuell_nv ed_fil_m_spule_z9.fehler_aufrufe_nv ed_fil_m_spule_z9.filter_max_nv ed_fil_m_spule_z9.filter_nv ed_fil_m_spule_z9.zyklus_filter_nv ed_fil_md_sk_err.art_aktuell_nv ed_fil_md_sk_err.fehler_aufrufe_nv ed_fil_md_sk_err.filter_max_nv ed_fil_md_sk_err.filter_nv ed_fil_md_sk_err.zyklus_filter_nv ed_fil_n_getr_ein_hs.art_aktuell_nv ed_fil_n_getr_ein_hs.fehler_aufrufe_nv ed_fil_n_getr_ein_hs.filter_max_nv ed_fil_n_getr_ein_hs.filter_nv ed_fil_n_getr_ein_hs.zyklus_filter_nv ed_fil_pctrl_ign.art_aktuell_nv ed_fil_pctrl_ign.fehler_aufrufe_nv ed_fil_pctrl_ign.filter_max_nv ed_fil_pctrl_ign.filter_nv ed_fil_pctrl_ign.zyklus_filter_nv ed_fil_pwg_bls.art_aktuell_nv ed_fil_pwg_bls.fehler_aufrufe_nv ed_fil_pwg_bls.filter_max_nv ed_fil_pwg_bls.filter_nv ed_fil_pwg_bls.zyklus_filter_nv ed_fil_pwg_vgl.art_aktuell_nv ed_fil_pwg_vgl.fehler_aufrufe_nv ed_fil_pwg_vgl.filter_max_nv ed_fil_pwg_vgl.filter_nv ed_fil_pwg_vgl.zyklus_filter_nv ed_fil_pwg1.art_aktuell_nv ed_fil_pwg1.fehler_aufrufe_nv ed_fil_pwg1.filter_max_nv ed_fil_pwg1.filter_nv ed_fil_pwg1.zyklus_filter_nv ed_fil_pwg2.art_aktuell_nv ed_fil_pwg2.fehler_aufrufe_nv ed_fil_pwg2.filter_max_nv ed_fil_pwg2.filter_nv ed_fil_pwg2.zyklus_filter_nv ed_fil_sc_busoff.art_aktuell_nv ed_fil_sc_busoff.fehler_aufrufe_nv ed_fil_sc_busoff.filter_max_nv ed_fil_sc_busoff.filter_nv ed_fil_sc_busoff.zyklus_filter_nv ed_fil_sc_pks.art_aktuell_nv ed_fil_sc_pks.fehler_aufrufe_nv ed_fil_sc_pks.filter_max_nv ed_fil_sc_pks.filter_nv ed_fil_sc_pks.zyklus_filter_nv ed_fil_sc_smg1.art_aktuell_nv ed_fil_sc_smg1.fehler_aufrufe_nv ed_fil_sc_smg1.filter_max_nv ed_fil_sc_smg1.filter_nv ed_fil_sc_smg1.zyklus_filter_nv ed_fil_sc_smg2.art_aktuell_nv ed_fil_sc_smg2.fehler_aufrufe_nv ed_fil_sc_smg2.filter_max_nv ed_fil_sc_smg2.filter_nv ed_fil_sc_smg2.zyklus_filter_nv ed_fil_sc_smg3.art_aktuell_nv ed_fil_sc_smg3.fehler_aufrufe_nv ed_fil_sc_smg3.filter_max_nv ed_fil_sc_smg3.filter_nv ed_fil_sc_smg3.zyklus_filter_nv ed_fil_servo_i.art_aktuell_nv ed_fil_servo_i.fehler_aufrufe_nv ed_fil_servo_i.filter_max_nv ed_fil_servo_i.filter_nv ed_fil_servo_i.zyklus_filter_nv ed_fil_servo_v.art_aktuell_nv ed_fil_servo_v.fehler_aufrufe_nv ed_fil_servo_v.filter_max_nv ed_fil_servo_v.filter_nv ed_fil_servo_v.zyklus_filter_nv ed_fil_sg_ign.art_aktuell_nv ed_fil_sg_ign.fehler_aufrufe_nv ed_fil_sg_ign.filter_max_nv ed_fil_sg_ign.filter_nv ed_fil_sg_ign.zyklus_filter_nv ed_fil_sk_manager_ign.art_aktuell_nv ed_fil_sk_manager_ign.fehler_aufrufe_nv ed_fil_sk_manager_ign.filter_max_nv ed_fil_sk_manager_ign.filter_nv ed_fil_sk_manager_ign.zyklus_filter_nv ed_fil_sk_tr_ign.art_aktuell_nv ed_fil_sk_tr_ign.fehler_aufrufe_nv ed_fil_sk_tr_ign.filter_max_nv ed_fil_sk_tr_ign.filter_nv ed_fil_sk_tr_ign.zyklus_filter_nv ed_fil_smg_schaltab.art_aktuell_nv ed_fil_smg_schaltab.fehler_aufrufe_nv ed_fil_smg_schaltab.filter_max_nv ed_fil_smg_schaltab.filter_nv ed_fil_smg_schaltab.zyklus_filter_nv ed_fil_smg_sk.art_aktuell_nv ed_fil_smg_sk.fehler_aufrufe_nv ed_fil_smg_sk.filter_max_nv ed_fil_smg_sk.filter_nv ed_fil_smg_sk.zyklus_filter_nv ed_fil_smg_sk_n.art_aktuell_nv ed_fil_smg_sk_n.fehler_aufrufe_nv ed_fil_smg_sk_n.filter_max_nv ed_fil_smg_sk_n.filter_nv ed_fil_smg_sk_n.zyklus_filter_nv ed_fil_start_rl.art_aktuell_nv ed_fil_start_rl.fehler_aufrufe_nv ed_fil_start_rl.filter_max_nv ed_fil_start_rl.filter_nv ed_fil_start_rl.zyklus_filter_nv ed_fil_tabg1.art_aktuell_nv ed_fil_tabg1.fehler_aufrufe_nv ed_fil_tabg1.filter_max_nv ed_fil_tabg1.filter_nv ed_fil_tabg1.zyklus_filter_nv ed_fil_tabg2.art_aktuell_nv ed_fil_tabg2.fehler_aufrufe_nv ed_fil_tabg2.filter_max_nv ed_fil_tabg2.filter_nv ed_fil_tabg2.zyklus_filter_nv ed_fil_tan_obd_b1.art_aktuell_nv ed_fil_tan_obd_b1.fehler_aufrufe_nv ed_fil_tan_obd_b1.filter_max_nv ed_fil_tan_obd_b1.filter_nv ed_fil_tan_obd_b1.zyklus_filter_nv ed_fil_tan_obd_b2.art_aktuell_nv ed_fil_tan_obd_b2.fehler_aufrufe_nv ed_fil_tan_obd_b2.filter_max_nv ed_fil_tan_obd_b2.filter_nv ed_fil_tan_obd_b2.zyklus_filter_nv ed_fil_tan1.art_aktuell_nv ed_fil_tan1.fehler_aufrufe_nv ed_fil_tan1.filter_max_nv ed_fil_tan1.filter_nv ed_fil_tan1.zyklus_filter_nv ed_fil_tan2.art_aktuell_nv ed_fil_tan2.fehler_aufrufe_nv ed_fil_tan2.filter_max_nv ed_fil_tan2.filter_nv ed_fil_tan2.zyklus_filter_nv ed_fil_tdme.art_aktuell_nv ed_fil_tdme.fehler_aufrufe_nv ed_fil_tdme.filter_max_nv ed_fil_tdme.filter_nv ed_fil_tdme.zyklus_filter_nv ed_fil_thermostat.art_aktuell_nv ed_fil_thermostat.fehler_aufrufe_nv ed_fil_thermostat.filter_max_nv ed_fil_thermostat.filter_nv ed_fil_thermostat.zyklus_filter_nv ed_fil_time_rel_obd.art_aktuell_nv ed_fil_time_rel_obd.fehler_aufrufe_nv ed_fil_time_rel_obd.filter_max_nv ed_fil_time_rel_obd.filter_nv ed_fil_time_rel_obd.zyklus_filter_nv ed_fil_tka.art_aktuell_nv ed_fil_tka.fehler_aufrufe_nv ed_fil_tka.filter_max_nv ed_fil_tka.filter_nv ed_fil_tka.zyklus_filter_nv ed_fil_tka_obd.art_aktuell_nv ed_fil_tka_obd.fehler_aufrufe_nv ed_fil_tka_obd.filter_max_nv ed_fil_tka_obd.filter_nv ed_fil_tka_obd.zyklus_filter_nv ed_fil_tmot.art_aktuell_nv ed_fil_tmot.fehler_aufrufe_nv ed_fil_tmot.filter_max_nv ed_fil_tmot.filter_nv ed_fil_tmot.zyklus_filter_nv ed_fil_tmot_obd.art_aktuell_nv ed_fil_tmot_obd.fehler_aufrufe_nv ed_fil_tmot_obd.filter_max_nv ed_fil_tmot_obd.filter_nv ed_fil_tmot_obd.zyklus_filter_nv ed_fil_tmot_obd_high.art_aktuell_nv ed_fil_tmot_obd_high.fehler_aufrufe_nv ed_fil_tmot_obd_high.filter_max_nv ed_fil_tmot_obd_high.filter_nv ed_fil_tmot_obd_high.zyklus_filter_nv ed_fil_tumg.art_aktuell_nv ed_fil_tumg.fehler_aufrufe_nv ed_fil_tumg.filter_max_nv ed_fil_tumg.filter_nv ed_fil_tumg.zyklus_filter_nv ed_fil_tumg_obd.art_aktuell_nv ed_fil_tumg_obd.fehler_aufrufe_nv ed_fil_tumg_obd.filter_max_nv ed_fil_tumg_obd.filter_nv ed_fil_tumg_obd.zyklus_filter_nv ed_fil_ub.art_aktuell_nv ed_fil_ub.fehler_aufrufe_nv ed_fil_ub.filter_max_nv ed_fil_ub.filter_nv ed_fil_ub.zyklus_filter_nv ed_fil_uext_111219514.art_aktuell_nv ed_fil_uext_111219514.fehler_aufrufe_nv ed_fil_uext_111219514.filter_max_nv ed_fil_uext_111219514.filter_nv ed_fil_uext_111219514.zyklus_filter_nv ed_fil_uext_124_512.art_aktuell_nv ed_fil_uext_124_512.fehler_aufrufe_nv ed_fil_uext_124_512.filter_max_nv ed_fil_uext_124_512.filter_nv ed_fil_uext_124_512.zyklus_filter_nv ed_fil_v_direkt.art_aktuell_nv ed_fil_v_direkt.fehler_aufrufe_nv ed_fil_v_direkt.filter_max_nv ed_fil_v_direkt.filter_nv ed_fil_v_direkt.zyklus_filter_nv ed_fil_zoelp1.art_aktuell_nv ed_fil_zoelp1.fehler_aufrufe_nv ed_fil_zoelp1.filter_max_nv ed_fil_zoelp1.filter_nv ed_fil_zoelp1.zyklus_filter_nv ed_fil_zoelp2.art_aktuell_nv ed_fil_zoelp2.fehler_aufrufe_nv ed_fil_zoelp2.filter_max_nv ed_fil_zoelp2.filter_nv ed_fil_zoelp2.zyklus_filter_nv ed_fsp_10of20_.ed_fil_index_nv ed_fsp_10of20_.fehlerart_nv ed_fsp_10of20_.fehlercode_nv ed_fsp_10of20_.ff_egas_ist_dk_b1_nv ed_fsp_10of20_.ff_laa_f_ber_b1_nv ed_fsp_10of20_.ff_laa_f_ber_b2_nv ed_fsp_10of20_.ff_lam_reg_b1_nv ed_fsp_10of20_.ff_lam_reg_b2_nv ed_fsp_10of20_.ff_lam_reg_f_b1_nv ed_fsp_10of20_.ff_lam_reg_f_b2_nv ed_fsp_10of20_.ff_ml_ges_nv ed_fsp_10of20_.ff_n_nv ed_fsp_10of20_.ff_p_code_nv ed_fsp_10of20_.ff_pks_ist_nv ed_fsp_10of20_.ff_rf_m_nv ed_fsp_10of20_.ff_sl_st_nv ed_fsp_10of20_.ff_tan_m_nv ed_fsp_10of20_.ff_tmot_nv ed_fsp_10of20_.ff_tz1_nv ed_fsp_10of20_.ff_v_vorne_nv ed_fsp_10of20_.haeufigkeitszaehler_nv ed_fsp_10of20_.inj_fehlerzaehler_nv ed_fsp_10of20_.logistikzaehler_nv ed_fsp_10of20_.mil_filter_nv ed_fsp_10of20_.mil_filter_scdn_nv ed_fsp_10of20_.scdn_nenner_nv ed_fsp_10of20_.scdn_zaehler_nv ed_fsp_10of20_.uw_satz_1of3_.uw_km_stand_nv ed_fsp_10of20_.uw_satz_1of3_.uw_wert_nv_1of4_ ed_fsp_10of20_.uw_satz_1of3_.uw_wert_nv_2of4_ ed_fsp_10of20_.uw_satz_1of3_.uw_wert_nv_3of4_ ed_fsp_10of20_.uw_satz_1of3_.uw_wert_nv_4of4_ ed_fsp_10of20_.uw_satz_2of3_.uw_km_stand_nv ed_fsp_10of20_.uw_satz_2of3_.uw_wert_nv_1of4_ ed_fsp_10of20_.uw_satz_2of3_.uw_wert_nv_2of4_ ed_fsp_10of20_.uw_satz_2of3_.uw_wert_nv_3of4_ ed_fsp_10of20_.uw_satz_2of3_.uw_wert_nv_4of4_ ed_fsp_10of20_.uw_satz_3of3_.uw_km_stand_nv ed_fsp_10of20_.uw_satz_3of3_.uw_wert_nv_1of4_ ed_fsp_10of20_.uw_satz_3of3_.uw_wert_nv_2of4_ ed_fsp_10of20_.uw_satz_3of3_.uw_wert_nv_3of4_ ed_fsp_10of20_.uw_satz_3of3_.uw_wert_nv_4of4_ ed_fsp_11of20_.ed_fil_index_nv ed_fsp_11of20_.fehlerart_nv ed_fsp_11of20_.fehlercode_nv ed_fsp_11of20_.ff_egas_ist_dk_b1_nv ed_fsp_11of20_.ff_laa_f_ber_b1_nv ed_fsp_11of20_.ff_laa_f_ber_b2_nv ed_fsp_11of20_.ff_lam_reg_b1_nv ed_fsp_11of20_.ff_lam_reg_b2_nv ed_fsp_11of20_.ff_lam_reg_f_b1_nv ed_fsp_11of20_.ff_lam_reg_f_b2_nv ed_fsp_11of20_.ff_ml_ges_nv ed_fsp_11of20_.ff_n_nv ed_fsp_11of20_.ff_p_code_nv ed_fsp_11of20_.ff_pks_ist_nv ed_fsp_11of20_.ff_rf_m_nv ed_fsp_11of20_.ff_sl_st_nv ed_fsp_11of20_.ff_tan_m_nv ed_fsp_11of20_.ff_tmot_nv ed_fsp_11of20_.ff_tz1_nv ed_fsp_11of20_.ff_v_vorne_nv ed_fsp_11of20_.haeufigkeitszaehler_nv ed_fsp_11of20_.inj_fehlerzaehler_nv ed_fsp_11of20_.logistikzaehler_nv ed_fsp_11of20_.mil_filter_nv ed_fsp_11of20_.mil_filter_scdn_nv ed_fsp_11of20_.scdn_nenner_nv ed_fsp_11of20_.scdn_zaehler_nv ed_fsp_11of20_.uw_satz_1of3_.uw_km_stand_nv ed_fsp_11of20_.uw_satz_1of3_.uw_wert_nv_1of4_ ed_fsp_11of20_.uw_satz_1of3_.uw_wert_nv_2of4_ ed_fsp_11of20_.uw_satz_1of3_.uw_wert_nv_3of4_ ed_fsp_11of20_.uw_satz_1of3_.uw_wert_nv_4of4_ ed_fsp_11of20_.uw_satz_2of3_.uw_km_stand_nv ed_fsp_11of20_.uw_satz_2of3_.uw_wert_nv_1of4_ ed_fsp_11of20_.uw_satz_2of3_.uw_wert_nv_2of4_ ed_fsp_11of20_.uw_satz_2of3_.uw_wert_nv_3of4_ ed_fsp_11of20_.uw_satz_2of3_.uw_wert_nv_4of4_ ed_fsp_11of20_.uw_satz_3of3_.uw_km_stand_nv ed_fsp_11of20_.uw_satz_3of3_.uw_wert_nv_1of4_ ed_fsp_11of20_.uw_satz_3of3_.uw_wert_nv_2of4_ ed_fsp_11of20_.uw_satz_3of3_.uw_wert_nv_3of4_ ed_fsp_11of20_.uw_satz_3of3_.uw_wert_nv_4of4_ ed_fsp_12of20_.ed_fil_index_nv ed_fsp_12of20_.fehlerart_nv ed_fsp_12of20_.fehlercode_nv ed_fsp_12of20_.ff_egas_ist_dk_b1_nv ed_fsp_12of20_.ff_laa_f_ber_b1_nv ed_fsp_12of20_.ff_laa_f_ber_b2_nv ed_fsp_12of20_.ff_lam_reg_b1_nv ed_fsp_12of20_.ff_lam_reg_b2_nv ed_fsp_12of20_.ff_lam_reg_f_b1_nv ed_fsp_12of20_.ff_lam_reg_f_b2_nv ed_fsp_12of20_.ff_ml_ges_nv ed_fsp_12of20_.ff_n_nv ed_fsp_12of20_.ff_p_code_nv ed_fsp_12of20_.ff_pks_ist_nv ed_fsp_12of20_.ff_rf_m_nv ed_fsp_12of20_.ff_sl_st_nv ed_fsp_12of20_.ff_tan_m_nv ed_fsp_12of20_.ff_tmot_nv ed_fsp_12of20_.ff_tz1_nv ed_fsp_12of20_.ff_v_vorne_nv ed_fsp_12of20_.haeufigkeitszaehler_nv ed_fsp_12of20_.inj_fehlerzaehler_nv ed_fsp_12of20_.logistikzaehler_nv ed_fsp_12of20_.mil_filter_nv ed_fsp_12of20_.mil_filter_scdn_nv ed_fsp_12of20_.scdn_nenner_nv ed_fsp_12of20_.scdn_zaehler_nv ed_fsp_12of20_.uw_satz_1of3_.uw_km_stand_nv ed_fsp_12of20_.uw_satz_1of3_.uw_wert_nv_1of4_ ed_fsp_12of20_.uw_satz_1of3_.uw_wert_nv_2of4_ ed_fsp_12of20_.uw_satz_1of3_.uw_wert_nv_3of4_ ed_fsp_12of20_.uw_satz_1of3_.uw_wert_nv_4of4_ ed_fsp_12of20_.uw_satz_2of3_.uw_km_stand_nv ed_fsp_12of20_.uw_satz_2of3_.uw_wert_nv_1of4_ ed_fsp_12of20_.uw_satz_2of3_.uw_wert_nv_2of4_ ed_fsp_12of20_.uw_satz_2of3_.uw_wert_nv_3of4_ ed_fsp_12of20_.uw_satz_2of3_.uw_wert_nv_4of4_ ed_fsp_12of20_.uw_satz_3of3_.uw_km_stand_nv ed_fsp_12of20_.uw_satz_3of3_.uw_wert_nv_1of4_ ed_fsp_12of20_.uw_satz_3of3_.uw_wert_nv_2of4_ ed_fsp_12of20_.uw_satz_3of3_.uw_wert_nv_3of4_ ed_fsp_12of20_.uw_satz_3of3_.uw_wert_nv_4of4_ ed_fsp_13of20_.ed_fil_index_nv ed_fsp_13of20_.fehlerart_nv ed_fsp_13of20_.fehlercode_nv ed_fsp_13of20_.ff_egas_ist_dk_b1_nv ed_fsp_13of20_.ff_laa_f_ber_b1_nv ed_fsp_13of20_.ff_laa_f_ber_b2_nv ed_fsp_13of20_.ff_lam_reg_b1_nv ed_fsp_13of20_.ff_lam_reg_b2_nv ed_fsp_13of20_.ff_lam_reg_f_b1_nv ed_fsp_13of20_.ff_lam_reg_f_b2_nv ed_fsp_13of20_.ff_ml_ges_nv ed_fsp_13of20_.ff_n_nv ed_fsp_13of20_.ff_p_code_nv ed_fsp_13of20_.ff_pks_ist_nv ed_fsp_13of20_.ff_rf_m_nv ed_fsp_13of20_.ff_sl_st_nv ed_fsp_13of20_.ff_tan_m_nv ed_fsp_13of20_.ff_tmot_nv ed_fsp_13of20_.ff_tz1_nv ed_fsp_13of20_.ff_v_vorne_nv ed_fsp_13of20_.haeufigkeitszaehler_nv ed_fsp_13of20_.inj_fehlerzaehler_nv ed_fsp_13of20_.logistikzaehler_nv ed_fsp_13of20_.mil_filter_nv ed_fsp_13of20_.mil_filter_scdn_nv ed_fsp_13of20_.scdn_nenner_nv ed_fsp_13of20_.scdn_zaehler_nv ed_fsp_13of20_.uw_satz_1of3_.uw_km_stand_nv ed_fsp_13of20_.uw_satz_1of3_.uw_wert_nv_1of4_ ed_fsp_13of20_.uw_satz_1of3_.uw_wert_nv_2of4_ ed_fsp_13of20_.uw_satz_1of3_.uw_wert_nv_3of4_ ed_fsp_13of20_.uw_satz_1of3_.uw_wert_nv_4of4_ ed_fsp_13of20_.uw_satz_2of3_.uw_km_stand_nv ed_fsp_13of20_.uw_satz_2of3_.uw_wert_nv_1of4_ ed_fsp_13of20_.uw_satz_2of3_.uw_wert_nv_2of4_ ed_fsp_13of20_.uw_satz_2of3_.uw_wert_nv_3of4_ ed_fsp_13of20_.uw_satz_2of3_.uw_wert_nv_4of4_ ed_fsp_13of20_.uw_satz_3of3_.uw_km_stand_nv ed_fsp_13of20_.uw_satz_3of3_.uw_wert_nv_1of4_ ed_fsp_13of20_.uw_satz_3of3_.uw_wert_nv_2of4_ ed_fsp_13of20_.uw_satz_3of3_.uw_wert_nv_3of4_ ed_fsp_13of20_.uw_satz_3of3_.uw_wert_nv_4of4_ ed_fsp_14of20_.ed_fil_index_nv ed_fsp_14of20_.fehlerart_nv ed_fsp_14of20_.fehlercode_nv ed_fsp_14of20_.ff_egas_ist_dk_b1_nv ed_fsp_14of20_.ff_laa_f_ber_b1_nv ed_fsp_14of20_.ff_laa_f_ber_b2_nv ed_fsp_14of20_.ff_lam_reg_b1_nv ed_fsp_14of20_.ff_lam_reg_b2_nv ed_fsp_14of20_.ff_lam_reg_f_b1_nv ed_fsp_14of20_.ff_lam_reg_f_b2_nv ed_fsp_14of20_.ff_ml_ges_nv ed_fsp_14of20_.ff_n_nv ed_fsp_14of20_.ff_p_code_nv ed_fsp_14of20_.ff_pks_ist_nv ed_fsp_14of20_.ff_rf_m_nv ed_fsp_14of20_.ff_sl_st_nv ed_fsp_14of20_.ff_tan_m_nv ed_fsp_14of20_.ff_tmot_nv ed_fsp_14of20_.ff_tz1_nv ed_fsp_14of20_.ff_v_vorne_nv ed_fsp_14of20_.haeufigkeitszaehler_nv ed_fsp_14of20_.inj_fehlerzaehler_nv ed_fsp_14of20_.logistikzaehler_nv ed_fsp_14of20_.mil_filter_nv ed_fsp_14of20_.mil_filter_scdn_nv ed_fsp_14of20_.scdn_nenner_nv ed_fsp_14of20_.scdn_zaehler_nv ed_fsp_14of20_.uw_satz_1of3_.uw_km_stand_nv ed_fsp_14of20_.uw_satz_1of3_.uw_wert_nv_1of4_ ed_fsp_14of20_.uw_satz_1of3_.uw_wert_nv_2of4_ ed_fsp_14of20_.uw_satz_1of3_.uw_wert_nv_3of4_ ed_fsp_14of20_.uw_satz_1of3_.uw_wert_nv_4of4_ ed_fsp_14of20_.uw_satz_2of3_.uw_km_stand_nv ed_fsp_14of20_.uw_satz_2of3_.uw_wert_nv_1of4_ ed_fsp_14of20_.uw_satz_2of3_.uw_wert_nv_2of4_ ed_fsp_14of20_.uw_satz_2of3_.uw_wert_nv_3of4_ ed_fsp_14of20_.uw_satz_2of3_.uw_wert_nv_4of4_ ed_fsp_14of20_.uw_satz_3of3_.uw_km_stand_nv ed_fsp_14of20_.uw_satz_3of3_.uw_wert_nv_1of4_ ed_fsp_14of20_.uw_satz_3of3_.uw_wert_nv_2of4_ ed_fsp_14of20_.uw_satz_3of3_.uw_wert_nv_3of4_ ed_fsp_14of20_.uw_satz_3of3_.uw_wert_nv_4of4_ ed_fsp_15of20_.ed_fil_index_nv ed_fsp_15of20_.fehlerart_nv ed_fsp_15of20_.fehlercode_nv ed_fsp_15of20_.ff_egas_ist_dk_b1_nv ed_fsp_15of20_.ff_laa_f_ber_b1_nv ed_fsp_15of20_.ff_laa_f_ber_b2_nv ed_fsp_15of20_.ff_lam_reg_b1_nv ed_fsp_15of20_.ff_lam_reg_b2_nv ed_fsp_15of20_.ff_lam_reg_f_b1_nv ed_fsp_15of20_.ff_lam_reg_f_b2_nv ed_fsp_15of20_.ff_ml_ges_nv ed_fsp_15of20_.ff_n_nv ed_fsp_15of20_.ff_p_code_nv ed_fsp_15of20_.ff_pks_ist_nv ed_fsp_15of20_.ff_rf_m_nv ed_fsp_15of20_.ff_sl_st_nv ed_fsp_15of20_.ff_tan_m_nv ed_fsp_15of20_.ff_tmot_nv ed_fsp_15of20_.ff_tz1_nv ed_fsp_15of20_.ff_v_vorne_nv ed_fsp_15of20_.haeufigkeitszaehler_nv ed_fsp_15of20_.inj_fehlerzaehler_nv ed_fsp_15of20_.logistikzaehler_nv ed_fsp_15of20_.mil_filter_nv ed_fsp_15of20_.mil_filter_scdn_nv ed_fsp_15of20_.scdn_nenner_nv ed_fsp_15of20_.scdn_zaehler_nv ed_fsp_15of20_.uw_satz_1of3_.uw_km_stand_nv ed_fsp_15of20_.uw_satz_1of3_.uw_wert_nv_1of4_ ed_fsp_15of20_.uw_satz_1of3_.uw_wert_nv_2of4_ ed_fsp_15of20_.uw_satz_1of3_.uw_wert_nv_3of4_ ed_fsp_15of20_.uw_satz_1of3_.uw_wert_nv_4of4_ ed_fsp_15of20_.uw_satz_2of3_.uw_km_stand_nv ed_fsp_15of20_.uw_satz_2of3_.uw_wert_nv_1of4_ ed_fsp_15of20_.uw_satz_2of3_.uw_wert_nv_2of4_ ed_fsp_15of20_.uw_satz_2of3_.uw_wert_nv_3of4_ ed_fsp_15of20_.uw_satz_2of3_.uw_wert_nv_4of4_ ed_fsp_15of20_.uw_satz_3of3_.uw_km_stand_nv ed_fsp_15of20_.uw_satz_3of3_.uw_wert_nv_1of4_ ed_fsp_15of20_.uw_satz_3of3_.uw_wert_nv_2of4_ ed_fsp_15of20_.uw_satz_3of3_.uw_wert_nv_3of4_ ed_fsp_15of20_.uw_satz_3of3_.uw_wert_nv_4of4_ ed_fsp_16of20_.ed_fil_index_nv ed_fsp_16of20_.fehlerart_nv ed_fsp_16of20_.fehlercode_nv ed_fsp_16of20_.ff_egas_ist_dk_b1_nv ed_fsp_16of20_.ff_laa_f_ber_b1_nv ed_fsp_16of20_.ff_laa_f_ber_b2_nv ed_fsp_16of20_.ff_lam_reg_b1_nv ed_fsp_16of20_.ff_lam_reg_b2_nv ed_fsp_16of20_.ff_lam_reg_f_b1_nv ed_fsp_16of20_.ff_lam_reg_f_b2_nv ed_fsp_16of20_.ff_ml_ges_nv ed_fsp_16of20_.ff_n_nv ed_fsp_16of20_.ff_p_code_nv ed_fsp_16of20_.ff_pks_ist_nv ed_fsp_16of20_.ff_rf_m_nv ed_fsp_16of20_.ff_sl_st_nv ed_fsp_16of20_.ff_tan_m_nv ed_fsp_16of20_.ff_tmot_nv ed_fsp_16of20_.ff_tz1_nv ed_fsp_16of20_.ff_v_vorne_nv ed_fsp_16of20_.haeufigkeitszaehler_nv ed_fsp_16of20_.inj_fehlerzaehler_nv ed_fsp_16of20_.logistikzaehler_nv ed_fsp_16of20_.mil_filter_nv ed_fsp_16of20_.mil_filter_scdn_nv ed_fsp_16of20_.scdn_nenner_nv ed_fsp_16of20_.scdn_zaehler_nv ed_fsp_16of20_.uw_satz_1of3_.uw_km_stand_nv ed_fsp_16of20_.uw_satz_1of3_.uw_wert_nv_1of4_ ed_fsp_16of20_.uw_satz_1of3_.uw_wert_nv_2of4_ ed_fsp_16of20_.uw_satz_1of3_.uw_wert_nv_3of4_ ed_fsp_16of20_.uw_satz_1of3_.uw_wert_nv_4of4_ ed_fsp_16of20_.uw_satz_2of3_.uw_km_stand_nv ed_fsp_16of20_.uw_satz_2of3_.uw_wert_nv_1of4_ ed_fsp_16of20_.uw_satz_2of3_.uw_wert_nv_2of4_ ed_fsp_16of20_.uw_satz_2of3_.uw_wert_nv_3of4_ ed_fsp_16of20_.uw_satz_2of3_.uw_wert_nv_4of4_ ed_fsp_16of20_.uw_satz_3of3_.uw_km_stand_nv ed_fsp_16of20_.uw_satz_3of3_.uw_wert_nv_1of4_ ed_fsp_16of20_.uw_satz_3of3_.uw_wert_nv_2of4_ ed_fsp_16of20_.uw_satz_3of3_.uw_wert_nv_3of4_ ed_fsp_16of20_.uw_satz_3of3_.uw_wert_nv_4of4_ /end OUT_MEASUREMENT
/end FUNCTION
/end MODULE
/end PROJECT
