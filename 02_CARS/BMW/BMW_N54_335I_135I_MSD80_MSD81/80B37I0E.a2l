ASAP2_VERSION 1 41
/begin PROJECT MSD70 "Spray Guided DI-System with Piezo Injectors for 6-Cylinder"
/begin HEADER "_default_HeaderComment" PROJECT_NO _0B /end HEADER
/begin MODULE _default_ModuleName "_default_ModuleLongIdentifier"
/begin MOD_COMMON "_default_ModCommonComment" DEPOSIT ABSOLUTE BYTE_ORDER MSB_LAST ALIGNMENT_BYTE 1 ALIGNMENT_WORD 2 ALIGNMENT_LONG 2 ALIGNMENT_FLOAT32_IEEE 2 ALIGNMENT_FLOAT64_IEEE 4 /end MOD_COMMON
/begin AXIS_PTS ldpm_temp_ini_ls_up_1_egcp "" 0xa1001b3c online_dummy _REC_AXS_20_u2 4095.9375 _CNV_A_R_EGCP_LINEA_315_CM 6 -2048. 2047.9375 FORMAT "%10.4" /end AXIS_PTS
/begin AXIS_PTS ldpm_maf_kgh_3_egcp "" 0xa1001ab4 maf_kgh _REC_AXS_20_u2 2047.96875 _CNV_A_R_LINEAR_____207_CM 6 0. 2047.96875 FORMAT "%10.5" /end AXIS_PTS
/begin CHARACTERISTIC c_lshpwm_min_lsh_down "Minimum permitted heater effective voltage PWM for downstream LSH OBDII diagnosis " VALUE 0xa1002111 _REC_VAL_20_u1 99.609375 _CNV_A_R_LINEAR_____5_CM 0. 99.609375 DISPLAY_IDENTIFIER C_LSHPWM_MIN_LSH_DOWN FORMAT "%9.6" /end CHARACTERISTIC
/begin CHARACTERISTIC c_lshpwm_max_lsh_down "Maximum permitted heater effective voltage PWM for downstream LSH OBDII diagnosis " VALUE 0xa100210d _REC_VAL_20_u1 99.609375 _CNV_A_R_LINEAR_____5_CM 0. 99.609375 DISPLAY_IDENTIFIER C_LSHPWM_MAX_LSH_DOWN FORMAT "%9.6" /end CHARACTERISTIC
/begin CHARACTERISTIC c_temp_sp_obd_lsh_down "Set temperature for downstream LSH operation used to generate power integral" VALUE 0xa100223a _REC_VAL_20_u2 2047.9375 _CNV_A_R_LINEAR_____204_CM -273.15 1774.7875 DISPLAY_IDENTIFIER C_TEMP_SP_OBD_LSH_DOWN FORMAT "%9.4" /end CHARACTERISTIC
/begin AXIS_PTS ldp_r_it_ls_down_new_lsh_down "" 0xa100198c online_dummy _REC_AXS_20_u2 65535. _CNV_A_R_LINEAR_____332_CM 4 0. 65535. FORMAT "%5.0" /end AXIS_PTS
/begin CHARACTERISTIC c_t_dly_obd_lsh_down "Minimum delay prior to checking status of OBDI heater / signal faults" VALUE 0xa10021b8 _REC_VAL_20_u1 255. _CNV_A_R_LINEAR_____35_CM 0. 255. DISPLAY_IDENTIFIER C_T_DLY_OBD_LSH_DOWN FORMAT "%3.0" /end CHARACTERISTIC
/begin CHARACTERISTIC ip_fac_maf_obd_lsh_down "Factor reflecting forced convection influence of cooling area, gas velocity and heat transfer coefficient" CURVE 0xa1001c60 _REC_CUR_20_u1_u2 15.9375 _CNV_A_R_EGCP_LINEA_333_CM 0. 15.9375 DISPLAY_IDENTIFIER IP_FAC_MAF_OBD_LSH_DOWN
 /begin AXIS_DESCR COM_AXIS maf_kgh _CNV_A_R_LINEAR_____207_CM 6 0. 2047.96875 FORMAT "%10.5" AXIS_PTS_REF ldpm_maf_kgh_3_egcp /end AXIS_DESCR
/end CHARACTERISTIC
/begin CHARACTERISTIC c_tcc_thd_err_obd_lsh_down "Fault detection threshold, when exceeded, heater is determined to be defective during driving cycle" VALUE 0xa100220e _REC_VAL_20_u2 1023. _CNV_A_R_LINEAR_____0_CM 0. 1023. DISPLAY_IDENTIFIER C_TCC_THD_ERR_OBD_LSH_DOWN FORMAT "%4.0" /end CHARACTERISTIC
/begin CHARACTERISTIC c_tcc_thd_obd_lsh_down "Number of valid downstream LSH OBDII diagnosis cycles over which statistic evaluation to be carried out" VALUE 0xa1002212 _REC_VAL_20_u2 1023. _CNV_A_R_LINEAR_____0_CM 0. 1023. DISPLAY_IDENTIFIER C_TCC_THD_OBD_LSH_DOWN FORMAT "%4.0" /end CHARACTERISTIC
/begin CHARACTERISTIC c_pow_int_min_obd_lsh_down "Measure of minimum required cooling energy required at downstream sensor prior to checking Ri threshold" VALUE 0xa100216c _REC_VAL_20_u2 65535. _CNV_A_R_LINEAR_____334_CM 0. 65535. DISPLAY_IDENTIFIER C_POW_INT_MIN_OBD_LSH_DOWN FORMAT "%5.0" /end CHARACTERISTIC
/begin CHARACTERISTIC ip_r_it_thd_obd_lsh_down "Internal resistance threshold, when exceeded, heater is determined to be defective for current diagnosis cycle" CURVE 0xa1001ed8 _REC_CUR_20_u2_u2 65535. _CNV_A_R_LINEAR_____332_CM 0. 65535. DISPLAY_IDENTIFIER IP_R_IT_THD_OBD_LSH_DOWN FORMAT "%5.0"
 /begin AXIS_DESCR COM_AXIS online_dummy _CNV_A_R_LINEAR_____332_CM 4 0. 65535. FORMAT "%5.0" AXIS_PTS_REF ldp_r_it_ls_down_new_lsh_down /end AXIS_DESCR
/end CHARACTERISTIC
/begin MEASUREMENT lv_err_obd_lsh_down_2 "Boolean flag indicating that diagnosis has been completed" UBYTE _CNV_S_2_RANGE__0___1_CM 1 100. 0. 1. DISPLAY_IDENTIFIER LV_ERR_OBD_LSH_DOWN[2] ECU_ADDRESS 0xd00034b9 BIT_MASK 0x1 /end MEASUREMENT
/begin MEASUREMENT lv_err_obd_lsh_down_1 "Boolean flag indicating that diagnosis has been completed" UBYTE _CNV_S_2_RANGE__0___1_CM 1 100. 0. 1. DISPLAY_IDENTIFIER LV_ERR_OBD_LSH_DOWN[1] ECU_ADDRESS 0xd00034a0 BIT_MASK 0x1 /end MEASUREMENT
/begin CHARACTERISTIC c_teg_dyn_max_obd_lsh_down "Temperature threshold under which downstream LSH OBDII diagnosis activated" VALUE 0xa1002220 _REC_VAL_20_u2 2047.9375 _CNV_A_R_LINEAR_____204_CM -273.15 1774.7875 DISPLAY_IDENTIFIER C_TEG_DYN_MAX_OBD_LSH_DOWN FORMAT "%9.4" /end CHARACTERISTIC
/begin CHARACTERISTIC c_lshpwm_min_lsh_up "Minimum permitted heater effective voltage PWM for upstream LSH OBD2 diagnosis" VALUE 0xa1002112 _REC_VAL_20_u1 99.609375 _CNV_A_R_LINEAR_____5_CM 0. 99.609375 DISPLAY_IDENTIFIER C_LSHPWM_MIN_LSH_UP FORMAT "%9.6" /end CHARACTERISTIC
/begin CHARACTERISTIC c_ttip_min_obd_lsh_up "Lower diagnosis threshold for oxygen sensor ceramic temperature" VALUE 0xa1002246 _REC_VAL_20_s2 4095.9375 _CNV_A_R_LINEAR_____123_CM -2048. 2047.9375 DISPLAY_IDENTIFIER C_TTIP_MIN_OBD_LSH_UP FORMAT "%10.4" /end CHARACTERISTIC
/begin CHARACTERISTIC c_ttip_max_obd_lsh_up "Upper diagnosis threshold for oxygen sensor ceramic temperature" VALUE 0xa1002240 _REC_VAL_20_s2 4095.9375 _CNV_A_R_LINEAR_____123_CM -2048. 2047.9375 DISPLAY_IDENTIFIER C_TTIP_MAX_OBD_LSH_UP FORMAT "%10.4" /end CHARACTERISTIC
/begin CHARACTERISTIC c_tcc_thd_obd_lsh_up "Number of valid LSH OBD2 diagnosis cycles over which statistic evaluation to be carried out" VALUE 0xa1002214 _REC_VAL_20_u2 65535. _CNV_A_R_LINEAR_____0_CM 0. 65535. DISPLAY_IDENTIFIER C_TCC_THD_OBD_LSH_UP FORMAT "%5.0" /end CHARACTERISTIC
/begin CHARACTERISTIC c_tcc_thd_err_obd_lsh_up "Fault detection threshold, when exceeded, heater is determined to be defective during driving cycle" VALUE 0xa1002210 _REC_VAL_20_u2 65535. _CNV_A_R_LINEAR_____0_CM 0. 65535. DISPLAY_IDENTIFIER C_TCC_THD_ERR_OBD_LSH_UP FORMAT "%5.0" /end CHARACTERISTIC
/begin CHARACTERISTIC lc_obd_rep_lsh_up "Logical constant permitting dignosis to be repeated within onde driving cycle" VALUE 0xa1002310 _REC_VAL_20_u1 1. _CNV_A_R_LINEAR_____0_CM 0. 1. DISPLAY_IDENTIFIER LC_OBD_REP_LSH_UP FORMAT "%1.0" /end CHARACTERISTIC
/begin CHARACTERISTIC ip_t_dly_ls_up_ready_raw_lsh_up "Time after heater management start to exaggerated forced stimulation, if no raw readiness observed" CURVE 0xa1001eec _REC_CUR_20_u2_u2 6553.5 _CNV_A_R_LINEAR_____4_CM 0. 6553.5 DISPLAY_IDENTIFIER IP_T_DLY_LS_UP_READY_RAW_LSH_UP FORMAT "%6.1"
 /begin AXIS_DESCR COM_AXIS online_dummy _CNV_A_R_EGCP_LINEA_315_CM 6 -2048. 2047.9375 FORMAT "%10.4" AXIS_PTS_REF ldpm_temp_ini_ls_up_1_egcp /end AXIS_DESCR
/end CHARACTERISTIC
/begin CHARACTERISTIC ip_t_dly_ls_up_ready_obd_lsh_up "Time threshold after heater management start where fault detected, if no full operative readiness observed" CURVE 0xa1001ee0 _REC_CUR_20_u2_u2 6553.5 _CNV_A_R_LINEAR_____4_CM 0. 6553.5 DISPLAY_IDENTIFIER IP_T_DLY_LS_UP_READY_OBD_LSH_UP FORMAT "%6.1"
 /begin AXIS_DESCR COM_AXIS online_dummy _CNV_A_R_EGCP_LINEA_315_CM 6 -2048. 2047.9375 FORMAT "%10.4" AXIS_PTS_REF ldpm_temp_ini_ls_up_1_egcp /end AXIS_DESCR
/end CHARACTERISTIC
/begin CHARACTERISTIC lc_obd_lsh_up "Logical constant permitting dignosis to be carried out" VALUE 0xa100230f _REC_VAL_20_u1 1. _CNV_A_R_LINEAR_____0_CM 0. 1. DISPLAY_IDENTIFIER LC_OBD_LSH_UP FORMAT "%1.0" /end CHARACTERISTIC
/begin CHARACTERISTIC c_t_dly_pow_ctl_obd_lsh_up "Minimum delay prior to checking status of OBD1 heater /signal faults" VALUE 0xa10021bb _REC_VAL_20_u1 255. _CNV_A_R_LINEAR_____35_CM 0. 255. DISPLAY_IDENTIFIER C_T_DLY_POW_CTL_OBD_LSH_UP FORMAT "%3.0" /end CHARACTERISTIC
/begin CHARACTERISTIC c_t_dly_ttip_mes_obd_lsh_up "Time delay after TTIP_ERR_MES symptom valid to set error flag" VALUE 0xa10021bf _REC_VAL_20_u1 255. _CNV_A_R_LINEAR_____35_CM 0. 255. DISPLAY_IDENTIFIER C_T_DLY_TTIP_MES_OBD_LSH_UP FORMAT "%3.0" /end CHARACTERISTIC
/begin CHARACTERISTIC c_t_dly_ttip_res_obd_lsh_up "Time delay to reset TTIP_ERR_MES timer" VALUE 0xa10021c0 _REC_VAL_20_u1 255. _CNV_A_R_LINEAR_____35_CM 0. 255. DISPLAY_IDENTIFIER C_T_DLY_TTIP_RES_OBD_LSH_UP FORMAT "%3.0" /end CHARACTERISTIC
/begin CHARACTERISTIC c_teg_dyn_min_obd_lsh_up "Minimum exhaust temperature to activate oxygen sensor ceramic temperature diagnosis" VALUE 0xa100222a _REC_VAL_20_u2 2047.9375 _CNV_A_R_LINEAR_____204_CM -273.15 1774.7875 DISPLAY_IDENTIFIER C_TEG_DYN_MIN_OBD_LSH_UP FORMAT "%9.4" /end CHARACTERISTIC
/begin MEASUREMENT egcp[0].egcp_struct_outdglshi0.lv_inh_diag_lsh_up "Inhibit flag for upstream oxygen sensor heater OBDI diagnosis" UBYTE _CNV_S_2_RANGE__0___1_CM 1 100. 0. 1. DISPLAY_IDENTIFIER LV_INH_DIAG_LSH_UP[1] ECU_ADDRESS 0xd00019cc BIT_MASK 0x1 /end MEASUREMENT
/begin MEASUREMENT egcp[0].egcp_struct_outdglshdi0.lv_inh_diag_lsh_down "Inhibit flag for downstream oxygen sensor heater OBDI diagnosis" UBYTE _CNV_S_2_RANGE__0___1_CM 1 100. 0. 1. DISPLAY_IDENTIFIER LV_INH_DIAG_LSH_DOWN[1] ECU_ADDRESS 0xd00019d0 BIT_MASK 0x1 /end MEASUREMENT
/begin MEASUREMENT egcp[0].egcp_struct_pladgspi0.ctr_err_save_diag_lsl_up_if "Number of communication errors during the WRAF sensor controller initialization " UBYTE _CNV_A_R_LINEAR_____0_CM 1 100. 0. 255. DISPLAY_IDENTIFIER CTR_ERR_SAVE_DIAG_LSL_UP_IF[1] ECU_ADDRESS 0xd00019d8 FORMAT "%3.0" /end MEASUREMENT
/begin MEASUREMENT egcp[0].egcp_struct_pladgspi0.ctr_delta_lsl_up_if "Increment of error counter since initialization respectively since last increment of error counter" UBYTE _CNV_A_R_LINEAR_____0_CM 1 100. 0. 255. DISPLAY_IDENTIFIER CTR_DELTA_LSL_UP_IF[1] ECU_ADDRESS 0xd00019d9 FORMAT "%3.0" /end MEASUREMENT
/begin MEASUREMENT egcp[0].egcp_struct_pladgspii0.lv_inh_diag_lsl_up_if "Inhibit diagnosis" UBYTE _CNV_S_2_RANGE__0___1_CM 1 100. 0. 1. DISPLAY_IDENTIFIER LV_INH_DIAG_LSL_UP_IF[1] ECU_ADDRESS 0xd00019da BIT_MASK 0x1 /end MEASUREMENT
/begin MEASUREMENT egcp[0].egcp_struct_sigdglsdi1.lv_inh_diag_oc_ls_down "Boolean flag indicating project specific application conditions for downstream open line diagnosis not met" UBYTE _CNV_S_2_RANGE__0___1_CM 1 100. 0. 1. DISPLAY_IDENTIFIER LV_INH_DIAG_OC_LS_DOWN[1] ECU_ADDRESS 0xd0001a78 BIT_MASK 0x1 /end MEASUREMENT
/begin MEASUREMENT egcp[0].egcp_struct_sigdglsdi1.lv_inh_diag_puc_ls_down "Boolean flag indicating project specific application conditions for downstream PUC diagnosis not met" UBYTE _CNV_S_2_RANGE__0___1_CM 1 100. 0. 1. DISPLAY_IDENTIFIER LV_INH_DIAG_PUC_LS_DOWN[1] ECU_ADDRESS 0xd0001a79 BIT_MASK 0x1 /end MEASUREMENT
/begin MEASUREMENT egcp[0].egcp_struct_sigdglsdi1.lv_inh_diag_fl_ls_down "Boolean flag indicating project specific application conditions for downstream FL diagnosis not met" UBYTE _CNV_S_2_RANGE__0___1_CM 1 100. 0. 1. DISPLAY_IDENTIFIER LV_INH_DIAG_FL_LS_DOWN[1] ECU_ADDRESS 0xd0001a7a BIT_MASK 0x1 /end MEASUREMENT
/begin MEASUREMENT egcp[0].egcp_struct_sigdglsdi1.lv_inh_diag_scg_ls_down "Boolean flag indicating project specific application conditions for downstream SCG diagnosis not met" UBYTE _CNV_S_2_RANGE__0___1_CM 1 100. 0. 1. DISPLAY_IDENTIFIER LV_INH_DIAG_SCG_LS_DOWN[1] ECU_ADDRESS 0xd0001a7b BIT_MASK 0x1 /end MEASUREMENT
/begin MEASUREMENT egcp[0].egcp_struct_sigdglsdi1.lv_inh_diag_scp_ls_down "Boolean flag indicating project specific application conditions for downstream short to plus diagnosis not met" UBYTE _CNV_S_2_RANGE__0___1_CM 1 100. 0. 1. DISPLAY_IDENTIFIER LV_INH_DIAG_SCP_LS_DOWN[1] ECU_ADDRESS 0xd0001a7c BIT_MASK 0x1 /end MEASUREMENT
/begin MEASUREMENT egcp[0].egcp_struct_sigdglsla0.t_dly_diag_el_lsl_up "Delay timer to start the electrical failure diagnosis " UWORD _CNV_A_R_LINEAR_____3_CM 1 100. 0. 655.35 DISPLAY_IDENTIFIER T_DLY_DIAG_EL_LSL_UP[1] ECU_ADDRESS 0xd0001a80 FORMAT "%6.2" /end MEASUREMENT
/begin MEASUREMENT egcp[0].egcp_struct_sigdglsla0.ctr_iplsl_sym_diag_lsl_up "Error debounce counter" UWORD _CNV_A_R_LINEAR_____0_CM 1 100. 0. 65535. DISPLAY_IDENTIFIER CTR_IPLSL_SYM_DIAG_LSL_UP[1] ECU_ADDRESS 0xd0001a82 FORMAT "%5.0" /end MEASUREMENT
/begin MEASUREMENT egcp[0].egcp_struct_sigdglsla0.t_diag_oc_lsl_up "Open Circuit Diagnosis Timer" UWORD _CNV_A_R_LINEAR_____4_CM 1 100. 0. 6553.5 DISPLAY_IDENTIFIER T_DIAG_OC_LSL_UP[1] ECU_ADDRESS 0xd0001a84 FORMAT "%6.1" /end MEASUREMENT
/begin MEASUREMENT egcp[0].egcp_struct_sigdglsla0.t_vls_up_min_diag_oc_lsl_up "Timer for LSL signal under voltage" UWORD _CNV_A_R_LINEAR_____4_CM 1 100. 0. 6553.5 DISPLAY_IDENTIFIER T_VLS_UP_MIN_DIAG_OC_LSL_UP[1] ECU_ADDRESS 0xd0001a86 FORMAT "%6.1" /end MEASUREMENT
/begin MEASUREMENT egcp[0].egcp_struct_sigdglsla0.t_diag_oc_lsl_up_lsh_err "Timer to finish OC diagnosis in case of OBD2 upstream heater error symptom active and LAMB plausible" UWORD _CNV_A_R_LINEAR_____4_CM 1 100. 0. 6553.5 DISPLAY_IDENTIFIER T_DIAG_OC_LSL_UP_LSH_ERR[1] ECU_ADDRESS 0xd0001a88 FORMAT "%6.1" /end MEASUREMENT
/begin MEASUREMENT egcp[0].egcp_struct_sigdglsla0.t_diag_oc_rst_osc_di "Time to reactivate oscillator for upstream tip temperature measurement" UWORD _CNV_A_R_LINEAR_____4_CM 1 100. 0. 6553.5 DISPLAY_IDENTIFIER T_DIAG_OC_RST_OSC_DI[1] ECU_ADDRESS 0xd0001a8a FORMAT "%6.1" /end MEASUREMENT
/begin MEASUREMENT egcp[0].egcp_struct_sigdglsla0.t_wait_sym_obd_2_lsh_up "Waiting time to check if OBD2 upstream heater error is present (to distinguish OC on Vip from Vg)" UWORD _CNV_A_R_LINEAR_____4_CM 1 100. 0. 6553.5 DISPLAY_IDENTIFIER T_WAIT_SYM_OBD_2_LSH_UP[1] ECU_ADDRESS 0xd0001a8c FORMAT "%6.1" /end MEASUREMENT
/begin MEASUREMENT egcp[0].egcp_struct_sigdglsla0.iplsl_sym_diag_lsl_up "Symptoms of the WRAF sensor Pump Current Controller Diagnosis" UBYTE _CNV_S_5_EGCP_RANGE_353_CM 1 100. 0. 8. DISPLAY_IDENTIFIER IPLSL_SYM_DIAG_LSL_UP[1] ECU_ADDRESS 0xd0001a8e /end MEASUREMENT
/begin MEASUREMENT egcp[0].egcp_struct_sigdglsla0.state_err_el_lsl_up "State to get visible the separate OBD-I failures" UBYTE _CNV_S_11_EGCP_RANGE_354_CM 1 100. 0. 10. DISPLAY_IDENTIFIER STATE_ERR_EL_LSL_UP[1] ECU_ADDRESS 0xd0001a8f /end MEASUREMENT
/begin MEASUREMENT egcp[0].egcp_struct_sigdglsla0.state_diag_oc_lsl_up "Status of the LSL Open Circuit Diagnosis" UBYTE _CNV_S_3_EGCP_RANGE_355_CM 1 100. 0. 2. DISPLAY_IDENTIFIER STATE_DIAG_OC_LSL_UP[1] ECU_ADDRESS 0xd0001a90 /end MEASUREMENT
/begin MEASUREMENT egcp[0].egcp_struct_sigdglsla0.lv_lsl_up_spi_com_inh "Inhibit bit for the SPI-communication" UBYTE _CNV_S_2_RANGE__0___1_CM 1 100. 0. 1. DISPLAY_IDENTIFIER LV_LSL_UP_SPI_COM_INH[1] ECU_ADDRESS 0xd0001a91 BIT_MASK 0x1 /end MEASUREMENT
/begin MEASUREMENT egcp[0].egcp_struct_sigdglsla0.lv_diag_iplsl_sym_lsl_up "Pump Current Controller in Limitation for too long time" UBYTE _CNV_S_2_RANGE__0___1_CM 1 100. 0. 1. DISPLAY_IDENTIFIER LV_DIAG_IPLSL_SYM_LSL_UP[1] ECU_ADDRESS 0xd0001a92 BIT_MASK 0x1 /end MEASUREMENT
/begin MEASUREMENT egcp[0].egcp_struct_sigdglsla0.lv_diag_iplsl_cdn_lsl_up "Conditions to run the WRAF sensor Pump Current Controller Diagnosis" UBYTE _CNV_S_2_RANGE__0___1_CM 1 100. 0. 1. DISPLAY_IDENTIFIER LV_DIAG_IPLSL_CDN_LSL_UP[1] ECU_ADDRESS 0xd0001a93 BIT_MASK 0x1 /end MEASUREMENT
/begin MEASUREMENT egcp[0].egcp_struct_sigdglsla0.lv_diag_oc_if_osc_di_lsl_up "Request stop oscillator used to determine sensor internal resistance" UBYTE _CNV_S_2_RANGE__0___1_CM 1 100. 0. 1. DISPLAY_IDENTIFIER LV_DIAG_OC_IF_OSC_DI_LSL_UP[1] ECU_ADDRESS 0xd0001a94 BIT_MASK 0x1 /end MEASUREMENT
/begin MEASUREMENT egcp[0].egcp_struct_sigdglsla0.lv_vls_up_min_diag_oc_lsl_up "Bit indicating LSL undervoltage " UBYTE _CNV_S_2_RANGE__0___1_CM 1 100. 0. 1. DISPLAY_IDENTIFIER LV_VLS_UP_MIN_DIAG_OC_LSL_UP[1] ECU_ADDRESS 0xd0001a95 BIT_MASK 0x1 /end MEASUREMENT
/begin MEASUREMENT egcp[0].egcp_struct_sigdglsla0.lv_diag_act_el_lsl_up "Logical Value for diagnosis active (=1) or not (=0)" UBYTE _CNV_S_2_RANGE__0___1_CM 1 100. 0. 1. DISPLAY_IDENTIFIER LV_DIAG_ACT_EL_LSL_UP[1] ECU_ADDRESS 0xd0001a96 BIT_MASK 0x1 /end MEASUREMENT
/begin MEASUREMENT egcp[0].egcp_struct_sigdglslai0.lv_inh_diag_el_lsl_up "Deactivation of \"HW-Based Diagnosis\"" UBYTE _CNV_S_2_RANGE__0___1_CM 1 100. 0. 1. DISPLAY_IDENTIFIER LV_INH_DIAG_EL_LSL_UP[1] ECU_ADDRESS 0xd0001a98 BIT_MASK 0x1 /end MEASUREMENT
/begin MEASUREMENT egcp[0].egcp_struct_sigdglslai0.lv_inh_diag_oc_lsl_up "Deactivation of \"Open Circuit Diagnosis\"" UBYTE _CNV_S_2_RANGE__0___1_CM 1 100. 0. 1. DISPLAY_IDENTIFIER LV_INH_DIAG_OC_LSL_UP[1] ECU_ADDRESS 0xd0001a99 BIT_MASK 0x1 /end MEASUREMENT
/begin MEASUREMENT egcp[0].egcp_struct_sigdglslai0.lv_iplsl_diag_inh_lsl_up "Deactivation of \"HW-Based Diagnosis with the CJ120\"" UBYTE _CNV_S_2_RANGE__0___1_CM 1 100. 0. 1. DISPLAY_IDENTIFIER LV_IPLSL_DIAG_INH_LSL_UP[1] ECU_ADDRESS 0xd0001a9a BIT_MASK 0x1 /end MEASUREMENT
/begin MEASUREMENT egcp[0].egcp_struct_pladgft0.lam_mmv_vls_dif_dly_ldc "Floating mean value for limited lambda deviation" SWORD _CNV_A_R_LINEAR_____110_CM 1 100. -50. 49.9984741210938 DISPLAY_IDENTIFIER LAM_MMV_VLS_DIF_DLY_LDC[1] ECU_ADDRESS 0xd0001a9c FORMAT "%7.3" /end MEASUREMENT
/begin MEASUREMENT egcp[0].egcp_struct_pladgft0.maf_int_vls_dif_dly_min "MAF integral for lower VLS_DIF_DLY deviation" UWORD _CNV_A_R_LINEAR_____356_CM 1 100. 0. 1820.42 DISPLAY_IDENTIFIER MAF_INT_VLS_DIF_DLY_MIN[1] ECU_ADDRESS 0xd0001a9e FORMAT "%7.2" /end MEASUREMENT
/begin MEASUREMENT egcp[0].egcp_struct_pladgft0.maf_int_vls_dif_dly_max "MAF integral for upper VLS_DIF_DLY deviation" UWORD _CNV_A_R_LINEAR_____356_CM 1 100. 0. 1820.42 DISPLAY_IDENTIFIER MAF_INT_VLS_DIF_DLY_MAX[1] ECU_ADDRESS 0xd0001aa0 FORMAT "%7.2" /end MEASUREMENT
/begin MEASUREMENT egcp[0].egcp_struct_pladgft0.maf_int_vls_dif_dly_ldc "Integral of mass air flow since limited dynamic conditions fulfilled" UWORD _CNV_A_R_LINEAR_____357_CM 1 100. 0. 1389. DISPLAY_IDENTIFIER MAF_INT_VLS_DIF_DLY_LDC[1] ECU_ADDRESS 0xd0001aa2 FORMAT "%7.2" /end MEASUREMENT
/begin MEASUREMENT egcp[0].egcp_struct_pladgft0.maf_int_rst_vls_down_dif_diag "Integral to start a new diagnostic cycle and to set the end flag" UWORD _CNV_A_R_LINEAR_____356_CM 1 100. 0. 1820.42 DISPLAY_IDENTIFIER MAF_INT_RST_VLS_DOWN_DIF_DIAG[1] ECU_ADDRESS 0xd0001aa4 FORMAT "%7.2" /end MEASUREMENT
/begin MEASUREMENT egcp[0].egcp_struct_pladgft0.t_sum_max_delta_i_lam "Total duration over C_LAMB_DELTA_I_MAX_DIAG" UWORD _CNV_A_R_LINEAR_____35_CM 1 100. 0. 65535. DISPLAY_IDENTIFIER T_SUM_MAX_DELTA_I_LAM[1] ECU_ADDRESS 0xd0001aa6 FORMAT "%5.0" /end MEASUREMENT
/begin MEASUREMENT egcp[0].egcp_struct_pladgft0.t_sum_min_delta_i_lam "Total duration over C_LAMB_DELTA_I_MIN_DIAG" UWORD _CNV_A_R_LINEAR_____35_CM 1 100. 0. 65535. DISPLAY_IDENTIFIER T_SUM_MIN_DELTA_I_LAM[1] ECU_ADDRESS 0xd0001aa8 FORMAT "%5.0" /end MEASUREMENT
/begin MEASUREMENT egcp[0].egcp_struct_pladgft0.t_sum_end_diag_win_delta_i_lam "Time counter to set LV_END_DIAG_WIN_DELTA_I_LAM[i] for similar conditions window" UWORD _CNV_A_R_LINEAR_____35_CM 1 100. 0. 65535. DISPLAY_IDENTIFIER T_SUM_END_DIAG_WIN_DELTA_I_LAM[1] ECU_ADDRESS 0xd0001aaa FORMAT "%5.0" /end MEASUREMENT
/begin MEASUREMENT egcp[0].egcp_struct_pladgft0.t_sum_end_ready_delta_i_lam "Second time counter to set LV_END_DIAG_DELTA_I_LAM[i]" UWORD _CNV_A_R_LINEAR_____35_CM 1 100. 0. 65535. DISPLAY_IDENTIFIER T_SUM_END_READY_DELTA_I_LAM[1] ECU_ADDRESS 0xd0001aac FORMAT "%5.0" /end MEASUREMENT
/begin MEASUREMENT egcp[0].egcp_struct_pladgft0.t_sum_rst_delta_i_lam "Time counter to reset T_SUM_MAX_DELTA_I_LAM[i] and T_SUM_MIN_DELTA_I_LAM[i]." UWORD _CNV_A_R_LINEAR_____35_CM 1 100. 0. 65535. DISPLAY_IDENTIFIER T_SUM_RST_DELTA_I_LAM[1] ECU_ADDRESS 0xd0001aae FORMAT "%5.0" /end MEASUREMENT
/begin MEASUREMENT egcp[0].egcp_struct_pladgft0.lamb_delta_i_save_diag "I-share from trim controller  - to be transmitted to the Scan Tool mode06" SWORD _CNV_A_R_LINEAR_____23_CM 1 100. -0.125 0.125 DISPLAY_IDENTIFIER LAMB_DELTA_I_SAVE_DIAG[1] ECU_ADDRESS 0xd0001ab0 FORMAT "%8.5" /end MEASUREMENT
/begin MEASUREMENT egcp[0].egcp_struct_pladgft0.err_sym_lam_adj "Symptoms of the lambda trim control errors" UBYTE _CNV_S_5_EGCP_RANGE_353_CM 1 100. 0. 8. DISPLAY_IDENTIFIER ERR_SYM_LAM_ADJ[1] ECU_ADDRESS 0xd0001ab2 /end MEASUREMENT
/begin MEASUREMENT egcp[0].egcp_struct_pladgft0.lv_vls_dif_dly_ldc "Status limited dynamic for the function \"Monitoring Trim Controller Deviation\"" UBYTE _CNV_S_2_RANGE__0___1_CM 1 100. 0. 1. DISPLAY_IDENTIFIER LV_VLS_DIF_DLY_LDC[1] ECU_ADDRESS 0xd0001ab3 BIT_MASK 0x1 /end MEASUREMENT
/begin MEASUREMENT egcp[0].egcp_struct_pladgft0.lv_vls_dif_dly_ldc_lam_mv "Status limited dynamic FAC_LAM_MV[i]" UBYTE _CNV_S_2_RANGE__0___1_CM 1 100. 0. 1. DISPLAY_IDENTIFIER LV_VLS_DIF_DLY_LDC_LAM_MV[1] ECU_ADDRESS 0xd0001ab4 BIT_MASK 0x1 /end MEASUREMENT
/begin MEASUREMENT egcp[0].egcp_struct_pladgft0.lv_end_diag_lam_adj "Diagnostic cycle for lambda trim control complete" UBYTE _CNV_S_2_RANGE__0___1_CM 1 100. 0. 1. DISPLAY_IDENTIFIER LV_END_DIAG_LAM_ADJ[1] ECU_ADDRESS 0xd0001ab5 BIT_MASK 0x1 /end MEASUREMENT
/begin MEASUREMENT egcp[0].egcp_struct_pladgft0.lv_err_lam_adj "Status diagnostic result of lambda trim control" UBYTE _CNV_S_2_RANGE__0___1_CM 1 100. 0. 1. DISPLAY_IDENTIFIER LV_ERR_LAM_ADJ[1] ECU_ADDRESS 0xd0001ab6 BIT_MASK 0x1 /end MEASUREMENT
/begin MEASUREMENT egcp[0].egcp_struct_pladgft0.lv_end_diag_win_delta_i_lam "End of diagnosis cycle for similar conditions window" UBYTE _CNV_S_2_RANGE__0___1_CM 1 100. 0. 1. DISPLAY_IDENTIFIER LV_END_DIAG_WIN_DELTA_I_LAM[1] ECU_ADDRESS 0xd0001ab7 BIT_MASK 0x1 /end MEASUREMENT
/begin MEASUREMENT egcp[0].egcp_struct_pladgft0.lv_det_sym_eve_delta_i_lam "Bit for second time counter DELTA_I_LAM (T_SUM_END_READY_DELTA_I_LAM[i])" UBYTE _CNV_S_2_RANGE__0___1_CM 1 100. 0. 1. DISPLAY_IDENTIFIER LV_DET_SYM_EVE_DELTA_I_LAM[1] ECU_ADDRESS 0xd0001ab8 BIT_MASK 0x1 /end MEASUREMENT
/begin MEASUREMENT egcp[0].egcp_struct_pladgfti0.lv_inh_diag_dly_lam "Inhibition condition for the dynamic fuel trim diagnosis" UBYTE _CNV_S_2_RANGE__0___1_CM 1 100. 0. 1. DISPLAY_IDENTIFIER LV_INH_DIAG_DLY_LAM[1] ECU_ADDRESS 0xd0001aba BIT_MASK 0x1 /end MEASUREMENT
/begin MEASUREMENT egcp[0].egcp_struct_pladgfti0.lv_inh_diag_rbm_dly_lam "Inhibition of the dynamic fuel trim diagnosis due to failures" UBYTE _CNV_S_2_RANGE__0___1_CM 1 100. 0. 1. DISPLAY_IDENTIFIER LV_INH_DIAG_RBM_DLY_LAM[1] ECU_ADDRESS 0xd0001abb BIT_MASK 0x1 /end MEASUREMENT
/begin MEASUREMENT egcp[0].egcp_struct_pladgfti0.state_rbm_lam_adj "Interface of LAM_ADJ[NC_CBK_EX_NR] monitor with the Rate-Based-Monitoring statistics" UBYTE _CNV_A_R_LINEAR_____0_CM 1 100. 0. 255. DISPLAY_IDENTIFIER STATE_RBM_LAM_ADJ[1] ECU_ADDRESS 0xd0001abc FORMAT "%3.0" /end MEASUREMENT
/begin MEASUREMENT egcp[0].egcp_struct_fctdglslh0.ttip_mes_ls_up_obd_lsh_up "Most current oxygen sensor temperature (Mode 6 information)" SWORD _CNV_A_R_LINEAR_____123_CM 1 100. -2048. 2047.9375 DISPLAY_IDENTIFIER TTIP_MES_LS_UP_OBD_LSH_UP[1] ECU_ADDRESS 0xd0001ac0 FORMAT "%10.4" /end MEASUREMENT
/begin MEASUREMENT egcp[0].egcp_struct_fctdglslh0.tcc_vld_obd_lsh_up "Number of completed diagnosis cycles" UWORD _CNV_A_R_LINEAR_____0_CM 1 100. 0. 65535. DISPLAY_IDENTIFIER TCC_VLD_OBD_LSH_UP[1] ECU_ADDRESS 0xd0001ac2 FORMAT "%5.0" /end MEASUREMENT
/begin MEASUREMENT egcp[0].egcp_struct_fctdglslh0.tcc_err_obd_lsh_up "Number of diagnosis cycles in which temperature deviation exceeding limits present" UWORD _CNV_A_R_LINEAR_____0_CM 1 100. 0. 65535. DISPLAY_IDENTIFIER TCC_ERR_OBD_LSH_UP[1] ECU_ADDRESS 0xd0001ac4 FORMAT "%5.0" /end MEASUREMENT
/begin MEASUREMENT egcp[0].egcp_struct_fctdglslh0.state_sym_obd_lsl_lsh_up "Variable indicating status of each symptom, updated each recurrence & at diagnosis completion" UBYTE _CNV_S_4_EGCP_RANGE_358_CM 1 100. 0. 4. DISPLAY_IDENTIFIER STATE_SYM_OBD_LSL_LSH_UP[1] ECU_ADDRESS 0xd0001ac6 /end MEASUREMENT
/begin MEASUREMENT egcp[0].egcp_struct_fctdglslh0.lv_lamb_pls_req_diag_lsh_up "Boolean flag requesting exaggerated forced stimulation" UBYTE _CNV_S_2_RANGE__0___1_CM 1 100. 0. 1. DISPLAY_IDENTIFIER LV_LAMB_PLS_REQ_DIAG_LSH_UP[1] ECU_ADDRESS 0xd0001ac7 BIT_MASK 0x1 /end MEASUREMENT
/begin MEASUREMENT egcp[0].egcp_struct_fctdglslh0.lv_diag_obd_cdn_lsh_up "Boolean flag indicating that conditions for diagnosis met" UBYTE _CNV_S_2_RANGE__0___1_CM 1 100. 0. 1. DISPLAY_IDENTIFIER LV_DIAG_OBD_CDN_LSH_UP[1] ECU_ADDRESS 0xd0001ac8 BIT_MASK 0x1 /end MEASUREMENT
/begin MEASUREMENT egcp[0].egcp_struct_fctdglslh0.lv_diag_obd_sym_lsh_up "Boolean flag indicating that fault is present and has been debounced" UBYTE _CNV_S_2_RANGE__0___1_CM 1 100. 0. 1. DISPLAY_IDENTIFIER LV_DIAG_OBD_SYM_LSH_UP[1] ECU_ADDRESS 0xd0001ac9 BIT_MASK 0x1 /end MEASUREMENT
/begin MEASUREMENT egcp[0].egcp_struct_fctdglslh0.lv_diag_obd_end_lsh_up "Boolean flag indicating that diagnosis has been completed" UBYTE _CNV_S_2_RANGE__0___1_CM 1 100. 0. 1. DISPLAY_IDENTIFIER LV_DIAG_OBD_END_LSH_UP[1] ECU_ADDRESS 0xd0001aca BIT_MASK 0x1 /end MEASUREMENT
/begin MEASUREMENT egcp[0].egcp_struct_fctdglshd1.r_it_thd_obd_lsh_down "Threshold for most current downstream oxygen sensor internal resistance used for diagnosis cycle, Mode 6 information" UWORD _CNV_A_R_LINEAR_____0_CM 1 100. 0. 65535. DISPLAY_IDENTIFIER R_IT_THD_OBD_LSH_DOWN[1] ECU_ADDRESS 0xd0001acc FORMAT "%5.0" /end MEASUREMENT
/begin MEASUREMENT egcp[0].egcp_struct_fctdglshd1.r_it_obd_lsh_down "Most current downstream oxygen sensor internal resistance used for diagnosis cycle, Mode 6 information" UWORD _CNV_A_R_LINEAR_____0_CM 1 100. 0. 65535. DISPLAY_IDENTIFIER R_IT_OBD_LSH_DOWN[1] ECU_ADDRESS 0xd0001ace FORMAT "%5.0" /end MEASUREMENT
/begin MEASUREMENT egcp[0].egcp_struct_fctdglshd1.temp_dif_obd_lsh_down "Indicates difference in temperature between set operating temperature & exhaust gas at sensor location" UWORD _CNV_A_R_EGCP_LINEA_359_CM 1 100. 0. 2047. DISPLAY_IDENTIFIER TEMP_DIF_OBD_LSH_DOWN[1] ECU_ADDRESS 0xd0001ad0 FORMAT "%4.0" /end MEASUREMENT
/begin MEASUREMENT egcp[0].egcp_struct_fctdglshd1.pow_int_obd_lsh_down "Integral indicates measure of cooling energy of exhaust gas at sensor location" UWORD _CNV_A_R_LINEAR_____334_CM 1 100. 0. 65535. DISPLAY_IDENTIFIER POW_INT_OBD_LSH_DOWN[1] ECU_ADDRESS 0xd0001ad2 FORMAT "%5.0" /end MEASUREMENT
/begin MEASUREMENT egcp[0].egcp_struct_fctdglshd1.tcc_vld_obd_lsh_down "Number of completed valid diagnosis cycles" UWORD _CNV_A_R_LINEAR_____0_CM 1 100. 0. 1023. DISPLAY_IDENTIFIER TCC_VLD_OBD_LSH_DOWN[1] ECU_ADDRESS 0xd0001ad4 FORMAT "%4.0" /end MEASUREMENT
/begin MEASUREMENT egcp[0].egcp_struct_fctdglshd1.tcc_err_obd_lsh_down "Number of faults detected during valid diagnosis cycles" UWORD _CNV_A_R_LINEAR_____0_CM 1 100. 0. 1023. DISPLAY_IDENTIFIER TCC_ERR_OBD_LSH_DOWN[1] ECU_ADDRESS 0xd0001ad6 FORMAT "%4.0" /end MEASUREMENT
/begin MEASUREMENT egcp[0].egcp_struct_fctdglshd1.ctr_cycnr_r_it_obd_ls_down "Value of handshake counter for last valid resistance value used for diagnosis" UWORD _CNV_A_R_LINEAR_____0_CM 1 100. 0. 65535. DISPLAY_IDENTIFIER CTR_CYCNR_R_IT_OBD_LS_DOWN[1] ECU_ADDRESS 0xd0001ad8 FORMAT "%5.0" /end MEASUREMENT
/begin MEASUREMENT egcp[0].egcp_struct_fctdglshd1.state_obd_lsh_down "Indicates current phase of oxygen sensor heater OBDII diagnosis" UBYTE _CNV_S_9_EGCP_RANGE_360_CM 1 100. 0. 8. DISPLAY_IDENTIFIER STATE_OBD_LSH_DOWN[1] ECU_ADDRESS 0xd0001ada /end MEASUREMENT
/begin MEASUREMENT egcp[0].egcp_struct_fctdglshdi1.lv_inh_diag_obd_lsh_down "Boolean inhibit flag for O2 sensor heater OBDII monitoring" UBYTE _CNV_S_2_RANGE__0___1_CM 1 100. 0. 1. DISPLAY_IDENTIFIER LV_INH_DIAG_OBD_LSH_DOWN[1] ECU_ADDRESS 0xd0001adc BIT_MASK 0x1 /end MEASUREMENT
/begin MEASUREMENT egcp[0].egcp_struct_fctdglshdi1.lv_inh_diag_rbm_obd_lsh_down "Flag to inhibit rate based monitoring for oxygen sensor heater OBDII diagnosis" UBYTE _CNV_S_2_RANGE__0___1_CM 1 100. 0. 1. DISPLAY_IDENTIFIER LV_INH_DIAG_RBM_OBD_LSH_DOWN[1] ECU_ADDRESS 0xd0001add BIT_MASK 0x1 /end MEASUREMENT
/begin MEASUREMENT egcp[0].egcp_struct_fctdglshdi1.state_rbm_obd_lsh_down "Interface of OBD_LSH_DOWN monitor with the Rate-Based Monitoring statistics" UBYTE _CNV_A_R_LINEAR_____0_CM 1 100. 0. 7. DISPLAY_IDENTIFIER STATE_RBM_OBD_LSH_DOWN[1] ECU_ADDRESS 0xd0001ade FORMAT "%1.0" /end MEASUREMENT
/begin MEASUREMENT egcp[0].egcp_struct_sigdglsl1.t_dly_diag_shift_down "Delay timer for the end flag of the shift down diagnosis in the no failure case (RBM purpose)" UWORD _CNV_A_R_LINEAR_____4_CM 1 100. 0. 6553.5 DISPLAY_IDENTIFIER T_DLY_DIAG_SHIFT_DOWN[1] ECU_ADDRESS 0xd0001ae0 FORMAT "%6.1" /end MEASUREMENT
/begin MEASUREMENT egcp[0].egcp_struct_sigdglsl1.lv_t_dly_diag_shift_down "Delay timer for the end flag of the shift down diagnosis in the no failure case (RBM purpose)" UBYTE _CNV_S_2_RANGE__0___1_CM 1 100. 0. 1. DISPLAY_IDENTIFIER LV_T_DLY_DIAG_SHIFT_DOWN[1] ECU_ADDRESS 0xd0001ae2 BIT_MASK 0x1 /end MEASUREMENT
/begin MEASUREMENT egcp[0].egcp_struct_sigdglsl1.lv_err_ls_down "Final diagnostic of the downstream oxygen sensor" UBYTE _CNV_S_2_RANGE__0___1_CM 1 100. 0. 1. DISPLAY_IDENTIFIER LV_ERR_LS_DOWN[1] ECU_ADDRESS 0xd0001ae3 BIT_MASK 0x1 /end MEASUREMENT
/begin MEASUREMENT egcp[0].egcp_struct_sigdglsl1.lv_err_ls_up "Final diagnostic of the upstream oxygen sensor" UBYTE _CNV_S_2_RANGE__0___1_CM 1 100. 0. 1. DISPLAY_IDENTIFIER LV_ERR_LS_UP[1] ECU_ADDRESS 0xd0001ae4 BIT_MASK 0x1 /end MEASUREMENT
/begin MEASUREMENT egcp[0].egcp_struct_sigdglsl1.lv_ls_up_diag_end "Sum end bit of upstream oxygen sensor diagnosis functions" UBYTE _CNV_S_2_RANGE__0___1_CM 1 100. 0. 1. DISPLAY_IDENTIFIER LV_LS_UP_DIAG_END[1] ECU_ADDRESS 0xd0001ae5 BIT_MASK 0x1 /end MEASUREMENT
/begin MEASUREMENT egcp[0].egcp_struct_sigdglsl1.lv_ls_up_obd_1_man_deac "Logical variable indicating manual deactivation of all OBD1 diagnosis for upstream oxygen sensor" UBYTE _CNV_S_2_RANGE__0___1_CM 1 100. 0. 1. DISPLAY_IDENTIFIER LV_LS_UP_OBD_1_MAN_DEAC[1] ECU_ADDRESS 0xd0001ae6 BIT_MASK 0x1 /end MEASUREMENT
/begin MEASUREMENT egcp[0].egcp_struct_sigdglsl1.lv_ls_up_obd_2_man_deac "Logical variable indicating manual deactivation of all OBD2 diagnosis for upstream oxygen sensor" UBYTE _CNV_S_2_RANGE__0___1_CM 1 100. 0. 1. DISPLAY_IDENTIFIER LV_LS_UP_OBD_2_MAN_DEAC[1] ECU_ADDRESS 0xd0001ae7 BIT_MASK 0x1 /end MEASUREMENT
/begin MEASUREMENT egcp[0].egcp_struct_sigdglsl1.lv_ls_down_diag_end "Collecting end flag for the diagnosis functions of the downstream oxygen sensor" UBYTE _CNV_S_2_RANGE__0___1_CM 1 100. 0. 1. DISPLAY_IDENTIFIER LV_LS_DOWN_DIAG_END[1] ECU_ADDRESS 0xd0001ae8 BIT_MASK 0x1 /end MEASUREMENT
/begin MEASUREMENT egcp[0].egcp_struct_sigdglsl1.lv_ls_down_obd_1_man_deac "Logical variable indicating manual deactivation of all OBD1 diagnosis for downstream oxygen sensor" UBYTE _CNV_S_2_RANGE__0___1_CM 1 100. 0. 1. DISPLAY_IDENTIFIER LV_LS_DOWN_OBD_1_MAN_DEAC[1] ECU_ADDRESS 0xd0001ae9 BIT_MASK 0x1 /end MEASUREMENT
/begin MEASUREMENT egcp[0].egcp_struct_sigdglsl1.lv_ls_down_obd_2_man_deac "Logical variable indicating manual deactivation of all OBD2 diagnosis for downstream oxygen sensor" UBYTE _CNV_S_2_RANGE__0___1_CM 1 100. 0. 1. DISPLAY_IDENTIFIER LV_LS_DOWN_OBD_2_MAN_DEAC[1] ECU_ADDRESS 0xd0001aea BIT_MASK 0x1 /end MEASUREMENT
/begin MEASUREMENT egcp[0].egcp_struct_pladglsl1.lamb_sp_delta_ls_up_down "Increment of lambda setpoint" SWORD _CNV_A_R_EGCP_LINEA_361_CM 1 100. -32. 31.999023 DISPLAY_IDENTIFIER LAMB_SP_DELTA_LS_UP_DOWN[1] ECU_ADDRESS 0xd0001aec FORMAT "%9.6" /end MEASUREMENT
/begin MEASUREMENT egcp[0].egcp_struct_pladglsl1.maf_int_diag_ls_up_down "Integral of air mass flow  while check is active" UWORD _CNV_A_R_LINEAR_____356_CM 1 100. 0. 1820.42 DISPLAY_IDENTIFIER MAF_INT_DIAG_LS_UP_DOWN[1] ECU_ADDRESS 0xd0001aee FORMAT "%7.2" /end MEASUREMENT
/begin MEASUREMENT egcp[0].egcp_struct_pladglsl1.lamb_sp_beg_diag_ls_up_down "Inicial value of lambda set point " UWORD _CNV_A_R_LINEAR_____122_CM 1 100. 0. 31.9990234375 DISPLAY_IDENTIFIER LAMB_SP_BEG_DIAG_LS_UP_DOWN[1] ECU_ADDRESS 0xd0001af0 FORMAT "%7.4" /end MEASUREMENT
/begin MEASUREMENT egcp[0].egcp_struct_pladglsl1.t_diag_act_afr_ls_up_down "Timer for plauisibility test under rich AF conditions" UWORD _CNV_A_R_LINEAR_____4_CM 1 100. 0. 6553.5 DISPLAY_IDENTIFIER T_DIAG_ACT_AFR_LS_UP_DOWN[1] ECU_ADDRESS 0xd0001af2 FORMAT "%6.1" /end MEASUREMENT
/begin MEASUREMENT egcp[0].egcp_struct_pladglsl1.t_diag_act_afl_ls_up_down "Timer for plauisibility test under lean AF conditions" UWORD _CNV_A_R_LINEAR_____4_CM 1 100. 0. 6553.5 DISPLAY_IDENTIFIER T_DIAG_ACT_AFL_LS_UP_DOWN[1] ECU_ADDRESS 0xd0001af4 FORMAT "%6.1" /end MEASUREMENT
/begin MEASUREMENT egcp[0].egcp_struct_pladglsl1.lamb_sp_diag_ls_up_down "Lambda set point for active plausibility test" UWORD _CNV_A_R_LINEAR_____122_CM 1 100. 0. 31.9990234375 DISPLAY_IDENTIFIER LAMB_SP_DIAG_LS_UP_DOWN[1] ECU_ADDRESS 0xd0001af6 FORMAT "%7.4" /end MEASUREMENT
/begin MEASUREMENT egcp[0].egcp_struct_pladglsl1.ctr_sum_rst_afr_chk_lsl_up "Reset counter for the rich active test" UWORD _CNV_A_R_LINEAR_____0_CM 1 100. 0. 65535. DISPLAY_IDENTIFIER CTR_SUM_RST_AFR_CHK_LSL_UP[1] ECU_ADDRESS 0xd0001af8 FORMAT "%5.0" /end MEASUREMENT
/begin MEASUREMENT egcp[0].egcp_struct_pladglsl1.ctr_sum_rst_afl_chk_lsl_up "Reset counter for the rich active test" UWORD _CNV_A_R_LINEAR_____0_CM 1 100. 0. 65535. DISPLAY_IDENTIFIER CTR_SUM_RST_AFL_CHK_LSL_UP[1] ECU_ADDRESS 0xd0001afa FORMAT "%5.0" /end MEASUREMENT
/begin MEASUREMENT egcp[0].egcp_struct_pladglsl1.ctr_afr_chk_lsl_up "Debounce counter for the rich test" UWORD _CNV_A_R_LINEAR_____0_CM 1 100. 0. 65535. DISPLAY_IDENTIFIER CTR_AFR_CHK_LSL_UP[1] ECU_ADDRESS 0xd0001afc FORMAT "%5.0" /end MEASUREMENT
/begin MEASUREMENT egcp[0].egcp_struct_pladglsl1.ctr_afl_chk_lsl_up "Debounce counter for the lean test" UWORD _CNV_A_R_LINEAR_____0_CM 1 100. 0. 65535. DISPLAY_IDENTIFIER CTR_AFL_CHK_LSL_UP[1] ECU_ADDRESS 0xd0001afe FORMAT "%5.0" /end MEASUREMENT
/begin MEASUREMENT egcp[0].egcp_struct_pladglsl1.t_end_diag_act_ls_down "Timer for the end of the downstream sensor active test in the no failure case" UWORD _CNV_A_R_LINEAR_____4_CM 1 100. 0. 6553.5 DISPLAY_IDENTIFIER T_END_DIAG_ACT_LS_DOWN[1] ECU_ADDRESS 0xd0001b00 FORMAT "%6.1" /end MEASUREMENT
/begin MEASUREMENT egcp[0].egcp_struct_pladglsl1.t_afr_chk_ls_down "Debounce counter for the rich test" UWORD _CNV_A_R_LINEAR_____4_CM 1 100. 0. 6553.5 DISPLAY_IDENTIFIER T_AFR_CHK_LS_DOWN[1] ECU_ADDRESS 0xd0001b02 FORMAT "%6.1" /end MEASUREMENT
/begin MEASUREMENT egcp[0].egcp_struct_pladglsl1.t_afl_chk_ls_down "Debounce counter for the lean test" UWORD _CNV_A_R_LINEAR_____4_CM 1 100. 0. 6553.5 DISPLAY_IDENTIFIER T_AFL_CHK_LS_DOWN[1] ECU_ADDRESS 0xd0001b04 FORMAT "%6.1" /end MEASUREMENT
/begin MEASUREMENT egcp[0].egcp_struct_pladglsl1.state_diag_act_ls_up_down "State of check of downstream oxygen sensor signal for lambda sensor error manager" UBYTE _CNV_S_4_EGCP_RANGE_362_CM 1 100. 0. 3. DISPLAY_IDENTIFIER STATE_DIAG_ACT_LS_UP_DOWN[1] ECU_ADDRESS 0xd0001b06 /end MEASUREMENT
/begin MEASUREMENT egcp[0].egcp_struct_pladglsl1.lv_diag_afl_cdn_ls_up_down "Boolean flag, condition to execute AFL active check of the oxygen sensors" UBYTE _CNV_S_2_RANGE__0___1_CM 1 100. 0. 1. DISPLAY_IDENTIFIER LV_DIAG_AFL_CDN_LS_UP_DOWN[1] ECU_ADDRESS 0xd0001b07 BIT_MASK 0x1 /end MEASUREMENT
/begin MEASUREMENT egcp[0].egcp_struct_pladglsl1.lv_diag_afr_cdn_ls_up_down "Boolean flag, condition to execute AFR active check of the oxygen sensors" UBYTE _CNV_S_2_RANGE__0___1_CM 1 100. 0. 1. DISPLAY_IDENTIFIER LV_DIAG_AFR_CDN_LS_UP_DOWN[1] ECU_ADDRESS 0xd0001b08 BIT_MASK 0x1 /end MEASUREMENT
/begin MEASUREMENT egcp[0].egcp_struct_pladglsl1.lv_diag_act_end_ls_up_down "Boolean flag, end of active check of the oxygen sensors" UBYTE _CNV_S_2_RANGE__0___1_CM 1 100. 0. 1. DISPLAY_IDENTIFIER LV_DIAG_ACT_END_LS_UP_DOWN[1] ECU_ADDRESS 0xd0001b09 BIT_MASK 0x1 /end MEASUREMENT
/begin MEASUREMENT egcp[0].egcp_struct_pladglsl1.lv_lamb_sp_afr_req_diag_act "Trigger function to change lambda set point for AFR active plauisibility test" UBYTE _CNV_S_2_RANGE__0___1_CM 1 100. 0. 1. DISPLAY_IDENTIFIER LV_LAMB_SP_AFR_REQ_DIAG_ACT[1] ECU_ADDRESS 0xd0001b0a BIT_MASK 0x1 /end MEASUREMENT
/begin MEASUREMENT egcp[0].egcp_struct_pladglsl1.lv_lamb_sp_afl_req_diag_act "Trigger function to change lambda set point for AFL active plauisibility test" UBYTE _CNV_S_2_RANGE__0___1_CM 1 100. 0. 1. DISPLAY_IDENTIFIER LV_LAMB_SP_AFL_REQ_DIAG_ACT[1] ECU_ADDRESS 0xd0001b0b BIT_MASK 0x1 /end MEASUREMENT
/begin MEASUREMENT egcp[0].egcp_struct_pladglsl1.lv_lamb_sp_req_diag_act "Lambda coordination request to change set point for active plausibility test" UBYTE _CNV_S_2_RANGE__0___1_CM 1 100. 0. 1. DISPLAY_IDENTIFIER LV_LAMB_SP_REQ_DIAG_ACT[1] ECU_ADDRESS 0xd0001b0c BIT_MASK 0x1 /end MEASUREMENT
/begin MEASUREMENT egcp[0].egcp_struct_pladglsl1.lv_diag_cyc_end_ls_down "End of cycle of active test of downstream sensor" UBYTE _CNV_S_2_RANGE__0___1_CM 1 100. 0. 1. DISPLAY_IDENTIFIER LV_DIAG_CYC_END_LS_DOWN[1] ECU_ADDRESS 0xd0001b0d BIT_MASK 0x1 /end MEASUREMENT
/begin MEASUREMENT egcp[0].egcp_struct_pladglsl1.lv_lam_di_req "Request disable close loop operation of the lambda controller" UBYTE _CNV_S_2_RANGE__0___1_CM 1 100. 0. 1. DISPLAY_IDENTIFIER LV_LAM_DI_REQ[1] ECU_ADDRESS 0xd0001b0e BIT_MASK 0x1 /end MEASUREMENT
/begin MEASUREMENT egcp[0].egcp_struct_pladglsl1.lv_diag_afr_end_ls_up_down "Boolean flag indicating the end of RICH active check" UBYTE _CNV_S_2_RANGE__0___1_CM 1 100. 0. 1. DISPLAY_IDENTIFIER LV_DIAG_AFR_END_LS_UP_DOWN[1] ECU_ADDRESS 0xd0001b0f BIT_MASK 0x1 /end MEASUREMENT
/begin MEASUREMENT egcp[0].egcp_struct_pladglsl1.lv_diag_afl_end_ls_up_down "Boolean flag indicating the end of LEAN active check" UBYTE _CNV_S_2_RANGE__0___1_CM 1 100. 0. 1. DISPLAY_IDENTIFIER LV_DIAG_AFL_END_LS_UP_DOWN[1] ECU_ADDRESS 0xd0001b10 BIT_MASK 0x1 /end MEASUREMENT
/begin MEASUREMENT egcp[0].egcp_struct_pladglsl1.lv_diag_afr_chk_sym_lsl_up "Debounced failure in the upstream sensor during the RICH active check " UBYTE _CNV_S_2_RANGE__0___1_CM 1 100. 0. 1. DISPLAY_IDENTIFIER LV_DIAG_AFR_CHK_SYM_LSL_UP[1] ECU_ADDRESS 0xd0001b11 BIT_MASK 0x1 /end MEASUREMENT
/begin MEASUREMENT egcp[0].egcp_struct_pladglsl1.lv_diag_afl_chk_sym_lsl_up "Debounced failure in the upstream sensor during the LEAN active check" UBYTE _CNV_S_2_RANGE__0___1_CM 1 100. 0. 1. DISPLAY_IDENTIFIER LV_DIAG_AFL_CHK_SYM_LSL_UP[1] ECU_ADDRESS 0xd0001b12 BIT_MASK 0x1 /end MEASUREMENT
/begin MEASUREMENT egcp[0].egcp_struct_pladglsl1.lv_diag_act_chk_cdn_lsl_up "Conditions to run active test of upstream sensor fulfilled" UBYTE _CNV_S_2_RANGE__0___1_CM 1 100. 0. 1. DISPLAY_IDENTIFIER LV_DIAG_ACT_CHK_CDN_LSL_UP[1] ECU_ADDRESS 0xd0001b13 BIT_MASK 0x1 /end MEASUREMENT
/begin MEASUREMENT egcp[0].egcp_struct_pladglsl1.lv_diag_act_chk_end_lsl_up "End active test of upstream sensor" UBYTE _CNV_S_2_RANGE__0___1_CM 1 100. 0. 1. DISPLAY_IDENTIFIER LV_DIAG_ACT_CHK_END_LSL_UP[1] ECU_ADDRESS 0xd0001b14 BIT_MASK 0x1 /end MEASUREMENT
/begin MEASUREMENT egcp[0].egcp_struct_pladglsl1.lv_diag_eol_end_ls_up_down "Boolean flag, end of active check of the oxygen sensors (EOL test)" UBYTE _CNV_S_2_RANGE__0___1_CM 1 100. 0. 1. DISPLAY_IDENTIFIER LV_DIAG_EOL_END_LS_UP_DOWN[1] ECU_ADDRESS 0xd0001b15 BIT_MASK 0x1 /end MEASUREMENT
/begin MEASUREMENT egcp[0].egcp_struct_pladglsl1.lv_diag_eol_dc_ls_up_down "Flag indicating eol test was active in this driving cycle." UBYTE _CNV_S_2_RANGE__0___1_CM 1 100. 0. 1. DISPLAY_IDENTIFIER LV_DIAG_EOL_DC_LS_UP_DOWN[1] ECU_ADDRESS 0xd0001b16 BIT_MASK 0x1 /end MEASUREMENT
/begin MEASUREMENT egcp[0].egcp_struct_pladglsl1.lv_sym_afl_chk_ls_down "Symptom of oxygen sensor downstream too lean in case of 2 bank system during end of line test or sensor interchanged test" UBYTE _CNV_S_2_RANGE__0___1_CM 1 100. 0. 1. DISPLAY_IDENTIFIER LV_SYM_AFL_CHK_LS_DOWN[1] ECU_ADDRESS 0xd0001b17 BIT_MASK 0x1 /end MEASUREMENT
/begin MEASUREMENT egcp[0].egcp_struct_pladglsl1.lv_sym_afr_chk_ls_down "Symptom of oxygen sensor downstream too rich in case of 2 bank system during end of line test or sensor interchanged test" UBYTE _CNV_S_2_RANGE__0___1_CM 1 100. 0. 1. DISPLAY_IDENTIFIER LV_SYM_AFR_CHK_LS_DOWN[1] ECU_ADDRESS 0xd0001b18 BIT_MASK 0x1 /end MEASUREMENT
/begin MEASUREMENT egcp[0].egcp_struct_sigdglsdi2.lv_diag_mpl_inh_ls_down "OBD II function dowmstream sensor: application incidences for inhibition" UBYTE _CNV_S_2_RANGE__0___1_CM 1 100. 0. 1. DISPLAY_IDENTIFIER LV_DIAG_MPL_INH_LS_DOWN[1] ECU_ADDRESS 0xd0001b1a BIT_MASK 0x1 /end MEASUREMENT
/begin MEASUREMENT egcp[0].egcp_struct_sigdglsdi2.state_rbm_swt_ls_down "Interface of SWT_LS_DOWN monitor with the Rate Based Monitoring statistics" UBYTE _CNV_A_R_LINEAR_____0_CM 1 100. 0. 255. DISPLAY_IDENTIFIER STATE_RBM_SWT_LS_DOWN[1] ECU_ADDRESS 0xd0001b1b FORMAT "%3.0" /end MEASUREMENT
/begin MEASUREMENT egcp[0].egcp_struct_sigdglsdi2.state_rbm_pue_ls_down "Interface of PUE_LS_DOWN monitor with the Rate Based Monitoring statistics" UBYTE _CNV_A_R_LINEAR_____0_CM 1 100. 0. 255. DISPLAY_IDENTIFIER STATE_RBM_PUE_LS_DOWN[1] ECU_ADDRESS 0xd0001b1c FORMAT "%3.0" /end MEASUREMENT
/begin MEASUREMENT egcp[0].egcp_struct_fctdglslhi0.lv_inh_diag_obd_lsh_up "Boolean inhibit flag for O2 sensor heater OBDII monitoring" UBYTE _CNV_S_2_RANGE__0___1_CM 1 100. 0. 1. DISPLAY_IDENTIFIER LV_INH_DIAG_OBD_LSH_UP[1] ECU_ADDRESS 0xd0001b1e BIT_MASK 0x1 /end MEASUREMENT
/begin MEASUREMENT egcp[0].egcp_struct_pladgls2.lv_diag_sym_chg_ls_down "Debounced error: downstream sensor of banks 1and 2 interchanged" UBYTE _CNV_S_2_RANGE__0___1_CM 1 100. 0. 1. DISPLAY_IDENTIFIER LV_DIAG_SYM_CHG_LS_DOWN[1] ECU_ADDRESS 0xd0001ba0 BIT_MASK 0x1 /end MEASUREMENT
/begin MEASUREMENT egcp[0].egcp_struct_sigdglsli1.state_rbm_shift_afl_lsl_up "Interface of SHIFT_AFL_LSL_UP[NC_CBK_EX_NR] monitor with the Rate-Based Monitoring statistics" UBYTE _CNV_A_R_LINEAR_____0_CM 1 100. 0. 255. DISPLAY_IDENTIFIER STATE_RBM_SHIFT_AFL_LSL_UP[1] ECU_ADDRESS 0xd0001ba2 FORMAT "%3.0" /end MEASUREMENT
/begin MEASUREMENT egcp[0].egcp_struct_sigdglsli1.state_rbm_shift_afr_lsl_up "Interface of SHIFT_AFR_LSL_UP[NC_CBK_EX_NR] monitor with the Rate-Based Monitoring statistics" UBYTE _CNV_A_R_LINEAR_____0_CM 1 100. 0. 255. DISPLAY_IDENTIFIER STATE_RBM_SHIFT_AFR_LSL_UP[1] ECU_ADDRESS 0xd0001ba3 FORMAT "%3.0" /end MEASUREMENT
/begin MEASUREMENT egcp[0].egcp_struct_sigdglsli1.state_rbm_obd_vld_lsh_up "Interface of OBD_VLD_LSH_UP[NC_CBK_EX_NR] monitor with the Rate-Based Monitoring statistics" UBYTE _CNV_A_R_LINEAR_____0_CM 1 100. 0. 255. DISPLAY_IDENTIFIER STATE_RBM_OBD_VLD_LSH_UP[1] ECU_ADDRESS 0xd0001ba4 FORMAT "%3.0" /end MEASUREMENT
/begin MEASUREMENT egcp[0].egcp_struct_sigdglsd2.vls_down_tran_puc "Monitor sensor voltage on activating the trailing throttle fuel cut-off, Bank i" UWORD _CNV_A_R_LINEAR_____2_CM 1 100. 0. 4.9951171875 DISPLAY_IDENTIFIER VLS_DOWN_TRAN_PUC[1] ECU_ADDRESS 0xd0001bc0 FORMAT "%5.3" /end MEASUREMENT
/begin MEASUREMENT egcp[0].egcp_struct_sigdglsd2.vls_down_pue "Monitor sensor voltage at the time of leaving PUC, Bank i (i=1.2)" UWORD _CNV_A_R_LINEAR_____2_CM 1 100. 0. 4.9951171875 DISPLAY_IDENTIFIER VLS_DOWN_PUE[1] ECU_ADDRESS 0xd0001bc2 FORMAT "%5.3" /end MEASUREMENT
/begin MEASUREMENT egcp[0].egcp_struct_sigdglsd2.vls_dif_diag_pue_ls_down "difference of VLS_DOWN_i values from the beginning to the end of the MAF_INT_PUC_NOT_ACT calculation" UWORD _CNV_A_R_LINEAR_____2_CM 1 100. 0. 4.9951171875 DISPLAY_IDENTIFIER VLS_DIF_DIAG_PUE_LS_DOWN[1] ECU_ADDRESS 0xd0001bc4 FORMAT "%5.3" /end MEASUREMENT
/begin MEASUREMENT egcp[0].egcp_struct_sigdglsd2.vls_dif_save_diag_ls_down "Difference of VLS_DOWN_i values from the beginning to the end of the MAF_INT_PUC_NOT_ACT calculation for scantool" UWORD _CNV_A_R_LINEAR_____2_CM 1 100. 0. 4.9951171875 DISPLAY_IDENTIFIER VLS_DIF_SAVE_DIAG_LS_DOWN[1] ECU_ADDRESS 0xd0001bc6 FORMAT "%5.3" /end MEASUREMENT
/begin MEASUREMENT egcp[0].egcp_struct_sigdglsd2.vls_dif_min_diag_pue_ls_down "Minimum value of VLS_DIF_DIAG_PUE_LS_DOWN[i] until MAF threshold outside PUC is exceeded" UWORD _CNV_A_R_LINEAR_____2_CM 1 100. 0. 4.9951171875 DISPLAY_IDENTIFIER VLS_DIF_MIN_DIAG_PUE_LS_DOWN[1] ECU_ADDRESS 0xd0001bc8 FORMAT "%5.3" /end MEASUREMENT
/begin MEASUREMENT egcp[0].egcp_struct_sigdglsd2.vls_dif_max_diag_pue_ls_down "Maximum value of VLS_DIF_DIAG_PUE_LS_DOWN[i] until MAF threshold outside PUC is exceeded" UWORD _CNV_A_R_LINEAR_____2_CM 1 100. 0. 4.9951171875 DISPLAY_IDENTIFIER VLS_DIF_MAX_DIAG_PUE_LS_DOWN[1] ECU_ADDRESS 0xd0001bca FORMAT "%5.3" /end MEASUREMENT
/begin MEASUREMENT egcp[0].egcp_struct_sigdglsd2.ctr_end_diag_pue_ls_down "Counter to set LV_END_DIAG_VLS_DOWN_PUE_i" UWORD _CNV_A_R_LINEAR_____0_CM 1 100. 0. 65535. DISPLAY_IDENTIFIER CTR_END_DIAG_PUE_LS_DOWN[1] ECU_ADDRESS 0xd0001bcc FORMAT "%5.0" /end MEASUREMENT
/begin MEASUREMENT egcp[0].egcp_struct_sigdglsd2.ctr_quo_sum_swt_ls_down "Sum of weighted CTR_SWT_ACT_LS_DOWN[NC_CBK_EX_NR], Bank i" UWORD _CNV_A_R_LINEAR_____27_CM 1 100. 0. 255.99609375 DISPLAY_IDENTIFIER CTR_QUO_SUM_SWT_LS_DOWN[1] ECU_ADDRESS 0xd0001bce FORMAT "%10.6" /end MEASUREMENT
/begin MEASUREMENT egcp[0].egcp_struct_sigdglsd2.ctr_quo_swt_ls_down "Weighted value CTR_SWT_ACT_LS_DOWN[NC_CBK_EX_NR ]" UWORD _CNV_A_R_LINEAR_____27_CM 1 100. 0. 255.99609375 DISPLAY_IDENTIFIER CTR_QUO_SWT_LS_DOWN[1] ECU_ADDRESS 0xd0001bd0 FORMAT "%10.6" /end MEASUREMENT
/begin MEASUREMENT egcp[0].egcp_struct_sigdglsd2.ctr_quo_swt_rbm_ls_down "Weighted value of CTR_SWT_ACT_RBM_LS_DOWN[NC_CBK_EX_NR ] for RBM purpose" UWORD _CNV_A_R_LINEAR_____27_CM 1 100. 0. 255.99609375 DISPLAY_IDENTIFIER CTR_QUO_SWT_RBM_LS_DOWN[1] ECU_ADDRESS 0xd0001bd2 FORMAT "%10.6" /end MEASUREMENT
/begin MEASUREMENT egcp[0].egcp_struct_sigdglsd2.ctr_swt_act_ls_down "Cycle counter for switching time determination, Bank i" UBYTE _CNV_A_R_LINEAR_____22_CM 1 100. 0. 5100. DISPLAY_IDENTIFIER CTR_SWT_ACT_LS_DOWN[1] ECU_ADDRESS 0xd0001bd4 FORMAT "%4.0" /end MEASUREMENT
/begin MEASUREMENT egcp[0].egcp_struct_sigdglsd2.ctr_swt_act_rbm_ls_down "Cycle counter for RBM switching time determination, Bank i" UBYTE _CNV_A_R_LINEAR_____22_CM 1 100. 0. 5100. DISPLAY_IDENTIFIER CTR_SWT_ACT_RBM_LS_DOWN[1] ECU_ADDRESS 0xd0001bd5 FORMAT "%4.0" /end MEASUREMENT
/begin MEASUREMENT egcp[0].egcp_struct_sigdglsd2.ctr_swt_ls_down "Number of valid switching times from rich to lean" UBYTE _CNV_A_R_LINEAR_____0_CM 1 100. 0. 255. DISPLAY_IDENTIFIER CTR_SWT_LS_DOWN[1] ECU_ADDRESS 0xd0001bd6 FORMAT "%3.0" /end MEASUREMENT
/begin MEASUREMENT egcp[0].egcp_struct_sigdglsd2.ctr_cycnr_swt_ls_down "Sum of weighted CTR_SWT_ACT_LS_DOWN[NC_CBK_EX_NR], Bank i" UBYTE _CNV_A_R_LINEAR_____100_CM 1 100. 0. 1.9921875 DISPLAY_IDENTIFIER CTR_CYCNR_SWT_LS_DOWN[1] ECU_ADDRESS 0xd0001bd7 FORMAT "%8.6" /end MEASUREMENT
/begin MEASUREMENT egcp[0].egcp_struct_sigdglsd2.ctr_save_swt_ls_down "Mean value of the ratio between the monitor sensor switching time and the threshold value for scantool" UBYTE _CNV_A_R_LINEAR_____100_CM 1 100. 0. 1.9921875 DISPLAY_IDENTIFIER CTR_SAVE_SWT_LS_DOWN[1] ECU_ADDRESS 0xd0001bd8 FORMAT "%8.6" /end MEASUREMENT
/begin MEASUREMENT egcp[0].egcp_struct_sigdglsd2.ctr_sym_diag_pue_ls_down "Counter for anti-bounce of LS_DOWN_PUE diagnosis" UBYTE _CNV_A_R_LINEAR_____0_CM 1 100. 0. 255. DISPLAY_IDENTIFIER CTR_SYM_DIAG_PUE_LS_DOWN[1] ECU_ADDRESS 0xd0001bd9 FORMAT "%3.0" /end MEASUREMENT
/begin MEASUREMENT egcp[0].egcp_struct_sigdglsd2.lv_diag_pue_vld_ls_down "Debounced diagnosis result of pull end plausibility" UBYTE _CNV_S_2_RANGE__0___1_CM 1 100. 0. 1. DISPLAY_IDENTIFIER LV_DIAG_PUE_VLD_LS_DOWN[1] ECU_ADDRESS 0xd0001bda BIT_MASK 0x1 /end MEASUREMENT
/begin MEASUREMENT egcp[0].egcp_struct_sigdglsd2.lv_diag_mpl_cdn_ls_down "Status of permission for diagnosis" UBYTE _CNV_S_2_RANGE__0___1_CM 1 100. 0. 1. DISPLAY_IDENTIFIER LV_DIAG_MPL_CDN_LS_DOWN[1] ECU_ADDRESS 0xd0001bdb BIT_MASK 0x1 /end MEASUREMENT
/begin MEASUREMENT egcp[0].egcp_struct_sigdglsd2.lv_diag_mpl_end_ls_down "Bit to indicate end of complete monitor sensor diagnosis" UBYTE _CNV_S_2_RANGE__0___1_CM 1 100. 0. 1. DISPLAY_IDENTIFIER LV_DIAG_MPL_END_LS_DOWN[1] ECU_ADDRESS 0xd0001bdc BIT_MASK 0x1 /end MEASUREMENT
/begin MEASUREMENT egcp[0].egcp_struct_sigdglsd2.lv_swt_diag_vld_ls_down "Validity bit of the current switching time check" UBYTE _CNV_S_2_RANGE__0___1_CM 1 100. 0. 1. DISPLAY_IDENTIFIER LV_SWT_DIAG_VLD_LS_DOWN[1] ECU_ADDRESS 0xd0001bdd BIT_MASK 0x1 /end MEASUREMENT
/begin MEASUREMENT egcp[1].egcp_struct_outdglshi0.lv_inh_diag_lsh_up "Inhibit flag for upstream oxygen sensor heater OBDI diagnosis" UBYTE _CNV_S_2_RANGE__0___1_CM 1 100. 0. 1. DISPLAY_IDENTIFIER LV_INH_DIAG_LSH_UP[2] ECU_ADDRESS 0xd0001cbc BIT_MASK 0x1 /end MEASUREMENT
/begin MEASUREMENT egcp[1].egcp_struct_outdglshdi0.lv_inh_diag_lsh_down "Inhibit flag for downstream oxygen sensor heater OBDI diagnosis" UBYTE _CNV_S_2_RANGE__0___1_CM 1 100. 0. 1. DISPLAY_IDENTIFIER LV_INH_DIAG_LSH_DOWN[2] ECU_ADDRESS 0xd0001cc0 BIT_MASK 0x1 /end MEASUREMENT
/begin MEASUREMENT egcp[1].egcp_struct_pladgspi0.ctr_err_save_diag_lsl_up_if "Number of communication errors during the WRAF sensor controller initialization " UBYTE _CNV_A_R_LINEAR_____0_CM 1 100. 0. 255. DISPLAY_IDENTIFIER CTR_ERR_SAVE_DIAG_LSL_UP_IF[2] ECU_ADDRESS 0xd0001cc8 FORMAT "%3.0" /end MEASUREMENT
/begin MEASUREMENT egcp[1].egcp_struct_pladgspi0.ctr_delta_lsl_up_if "Increment of error counter since initialization respectively since last increment of error counter" UBYTE _CNV_A_R_LINEAR_____0_CM 1 100. 0. 255. DISPLAY_IDENTIFIER CTR_DELTA_LSL_UP_IF[2] ECU_ADDRESS 0xd0001cc9 FORMAT "%3.0" /end MEASUREMENT
/begin MEASUREMENT egcp[1].egcp_struct_pladgspii0.lv_inh_diag_lsl_up_if "Inhibit diagnosis" UBYTE _CNV_S_2_RANGE__0___1_CM 1 100. 0. 1. DISPLAY_IDENTIFIER LV_INH_DIAG_LSL_UP_IF[2] ECU_ADDRESS 0xd0001cca BIT_MASK 0x1 /end MEASUREMENT
/begin MEASUREMENT egcp[1].egcp_struct_sigdglsdi1.lv_inh_diag_oc_ls_down "Boolean flag indicating project specific application conditions for downstream open line diagnosis not met" UBYTE _CNV_S_2_RANGE__0___1_CM 1 100. 0. 1. DISPLAY_IDENTIFIER LV_INH_DIAG_OC_LS_DOWN[2] ECU_ADDRESS 0xd0001d68 BIT_MASK 0x1 /end MEASUREMENT
/begin MEASUREMENT egcp[1].egcp_struct_sigdglsdi1.lv_inh_diag_puc_ls_down "Boolean flag indicating project specific application conditions for downstream PUC diagnosis not met" UBYTE _CNV_S_2_RANGE__0___1_CM 1 100. 0. 1. DISPLAY_IDENTIFIER LV_INH_DIAG_PUC_LS_DOWN[2] ECU_ADDRESS 0xd0001d69 BIT_MASK 0x1 /end MEASUREMENT
/begin MEASUREMENT egcp[1].egcp_struct_sigdglsdi1.lv_inh_diag_fl_ls_down "Boolean flag indicating project specific application conditions for downstream FL diagnosis not met" UBYTE _CNV_S_2_RANGE__0___1_CM 1 100. 0. 1. DISPLAY_IDENTIFIER LV_INH_DIAG_FL_LS_DOWN[2] ECU_ADDRESS 0xd0001d6a BIT_MASK 0x1 /end MEASUREMENT
/begin MEASUREMENT egcp[1].egcp_struct_sigdglsdi1.lv_inh_diag_scg_ls_down "Boolean flag indicating project specific application conditions for downstream SCG diagnosis not met" UBYTE _CNV_S_2_RANGE__0___1_CM 1 100. 0. 1. DISPLAY_IDENTIFIER LV_INH_DIAG_SCG_LS_DOWN[2] ECU_ADDRESS 0xd0001d6b BIT_MASK 0x1 /end MEASUREMENT
/begin MEASUREMENT egcp[1].egcp_struct_sigdglsdi1.lv_inh_diag_scp_ls_down "Boolean flag indicating project specific application conditions for downstream short to plus diagnosis not met" UBYTE _CNV_S_2_RANGE__0___1_CM 1 100. 0. 1. DISPLAY_IDENTIFIER LV_INH_DIAG_SCP_LS_DOWN[2] ECU_ADDRESS 0xd0001d6c BIT_MASK 0x1 /end MEASUREMENT
/begin MEASUREMENT egcp[1].egcp_struct_sigdglsla0.t_dly_diag_el_lsl_up "Delay timer to start the electrical failure diagnosis " UWORD _CNV_A_R_LINEAR_____3_CM 1 100. 0. 655.35 DISPLAY_IDENTIFIER T_DLY_DIAG_EL_LSL_UP[2] ECU_ADDRESS 0xd0001d70 FORMAT "%6.2" /end MEASUREMENT
/begin MEASUREMENT egcp[1].egcp_struct_sigdglsla0.ctr_iplsl_sym_diag_lsl_up "Error debounce counter" UWORD _CNV_A_R_LINEAR_____0_CM 1 100. 0. 65535. DISPLAY_IDENTIFIER CTR_IPLSL_SYM_DIAG_LSL_UP[2] ECU_ADDRESS 0xd0001d72 FORMAT "%5.0" /end MEASUREMENT
/begin MEASUREMENT egcp[1].egcp_struct_sigdglsla0.t_diag_oc_lsl_up "Open Circuit Diagnosis Timer" UWORD _CNV_A_R_LINEAR_____4_CM 1 100. 0. 6553.5 DISPLAY_IDENTIFIER T_DIAG_OC_LSL_UP[2] ECU_ADDRESS 0xd0001d74 FORMAT "%6.1" /end MEASUREMENT
/begin MEASUREMENT egcp[1].egcp_struct_sigdglsla0.t_vls_up_min_diag_oc_lsl_up "Timer for LSL signal under voltage" UWORD _CNV_A_R_LINEAR_____4_CM 1 100. 0. 6553.5 DISPLAY_IDENTIFIER T_VLS_UP_MIN_DIAG_OC_LSL_UP[2] ECU_ADDRESS 0xd0001d76 FORMAT "%6.1" /end MEASUREMENT
/begin MEASUREMENT egcp[1].egcp_struct_sigdglsla0.t_diag_oc_lsl_up_lsh_err "Timer to finish OC diagnosis in case of OBD2 upstream heater error symptom active and LAMB plausible" UWORD _CNV_A_R_LINEAR_____4_CM 1 100. 0. 6553.5 DISPLAY_IDENTIFIER T_DIAG_OC_LSL_UP_LSH_ERR[2] ECU_ADDRESS 0xd0001d78 FORMAT "%6.1" /end MEASUREMENT
/begin MEASUREMENT egcp[1].egcp_struct_sigdglsla0.t_diag_oc_rst_osc_di "Time to reactivate oscillator for upstream tip temperature measurement" UWORD _CNV_A_R_LINEAR_____4_CM 1 100. 0. 6553.5 DISPLAY_IDENTIFIER T_DIAG_OC_RST_OSC_DI[2] ECU_ADDRESS 0xd0001d7a FORMAT "%6.1" /end MEASUREMENT
/begin MEASUREMENT egcp[1].egcp_struct_sigdglsla0.t_wait_sym_obd_2_lsh_up "Waiting time to check if OBD2 upstream heater error is present (to distinguish OC on Vip from Vg)" UWORD _CNV_A_R_LINEAR_____4_CM 1 100. 0. 6553.5 DISPLAY_IDENTIFIER T_WAIT_SYM_OBD_2_LSH_UP[2] ECU_ADDRESS 0xd0001d7c FORMAT "%6.1" /end MEASUREMENT
/begin MEASUREMENT egcp[1].egcp_struct_sigdglsla0.iplsl_sym_diag_lsl_up "Symptoms of the WRAF sensor Pump Current Controller Diagnosis" UBYTE _CNV_S_5_EGCP_RANGE_353_CM 1 100. 0. 8. DISPLAY_IDENTIFIER IPLSL_SYM_DIAG_LSL_UP[2] ECU_ADDRESS 0xd0001d7e /end MEASUREMENT
/begin MEASUREMENT egcp[1].egcp_struct_sigdglsla0.state_err_el_lsl_up "State to get visible the separate OBD-I failures" UBYTE _CNV_S_11_EGCP_RANGE_354_CM 1 100. 0. 10. DISPLAY_IDENTIFIER STATE_ERR_EL_LSL_UP[2] ECU_ADDRESS 0xd0001d7f /end MEASUREMENT
/begin MEASUREMENT egcp[1].egcp_struct_sigdglsla0.state_diag_oc_lsl_up "Status of the LSL Open Circuit Diagnosis" UBYTE _CNV_S_3_EGCP_RANGE_355_CM 1 100. 0. 2. DISPLAY_IDENTIFIER STATE_DIAG_OC_LSL_UP[2] ECU_ADDRESS 0xd0001d80 /end MEASUREMENT
/begin MEASUREMENT egcp[1].egcp_struct_sigdglsla0.lv_lsl_up_spi_com_inh "Inhibit bit for the SPI-communication" UBYTE _CNV_S_2_RANGE__0___1_CM 1 100. 0. 1. DISPLAY_IDENTIFIER LV_LSL_UP_SPI_COM_INH[2] ECU_ADDRESS 0xd0001d81 BIT_MASK 0x1 /end MEASUREMENT
/begin MEASUREMENT egcp[1].egcp_struct_sigdglsla0.lv_diag_iplsl_sym_lsl_up "Pump Current Controller in Limitation for too long time" UBYTE _CNV_S_2_RANGE__0___1_CM 1 100. 0. 1. DISPLAY_IDENTIFIER LV_DIAG_IPLSL_SYM_LSL_UP[2] ECU_ADDRESS 0xd0001d82 BIT_MASK 0x1 /end MEASUREMENT
/begin MEASUREMENT egcp[1].egcp_struct_sigdglsla0.lv_diag_iplsl_cdn_lsl_up "Conditions to run the WRAF sensor Pump Current Controller Diagnosis" UBYTE _CNV_S_2_RANGE__0___1_CM 1 100. 0. 1. DISPLAY_IDENTIFIER LV_DIAG_IPLSL_CDN_LSL_UP[2] ECU_ADDRESS 0xd0001d83 BIT_MASK 0x1 /end MEASUREMENT
/begin MEASUREMENT egcp[1].egcp_struct_sigdglsla0.lv_diag_oc_if_osc_di_lsl_up "Request stop oscillator used to determine sensor internal resistance" UBYTE _CNV_S_2_RANGE__0___1_CM 1 100. 0. 1. DISPLAY_IDENTIFIER LV_DIAG_OC_IF_OSC_DI_LSL_UP[2] ECU_ADDRESS 0xd0001d84 BIT_MASK 0x1 /end MEASUREMENT
/begin MEASUREMENT egcp[1].egcp_struct_sigdglsla0.lv_vls_up_min_diag_oc_lsl_up "Bit indicating LSL undervoltage " UBYTE _CNV_S_2_RANGE__0___1_CM 1 100. 0. 1. DISPLAY_IDENTIFIER LV_VLS_UP_MIN_DIAG_OC_LSL_UP[2] ECU_ADDRESS 0xd0001d85 BIT_MASK 0x1 /end MEASUREMENT
/begin MEASUREMENT egcp[1].egcp_struct_sigdglsla0.lv_diag_act_el_lsl_up "Logical Value for diagnosis active (=1) or not (=0)" UBYTE _CNV_S_2_RANGE__0___1_CM 1 100. 0. 1. DISPLAY_IDENTIFIER LV_DIAG_ACT_EL_LSL_UP[2] ECU_ADDRESS 0xd0001d86 BIT_MASK 0x1 /end MEASUREMENT
/begin MEASUREMENT egcp[1].egcp_struct_sigdglslai0.lv_inh_diag_el_lsl_up "Deactivation of \"HW-Based Diagnosis\"" UBYTE _CNV_S_2_RANGE__0___1_CM 1 100. 0. 1. DISPLAY_IDENTIFIER LV_INH_DIAG_EL_LSL_UP[2] ECU_ADDRESS 0xd0001d88 BIT_MASK 0x1 /end MEASUREMENT
/begin MEASUREMENT egcp[1].egcp_struct_sigdglslai0.lv_inh_diag_oc_lsl_up "Deactivation of \"Open Circuit Diagnosis\"" UBYTE _CNV_S_2_RANGE__0___1_CM 1 100. 0. 1. DISPLAY_IDENTIFIER LV_INH_DIAG_OC_LSL_UP[2] ECU_ADDRESS 0xd0001d89 BIT_MASK 0x1 /end MEASUREMENT
/begin MEASUREMENT egcp[1].egcp_struct_sigdglslai0.lv_iplsl_diag_inh_lsl_up "Deactivation of \"HW-Based Diagnosis with the CJ120\"" UBYTE _CNV_S_2_RANGE__0___1_CM 1 100. 0. 1. DISPLAY_IDENTIFIER LV_IPLSL_DIAG_INH_LSL_UP[2] ECU_ADDRESS 0xd0001d8a BIT_MASK 0x1 /end MEASUREMENT
/begin MEASUREMENT egcp[1].egcp_struct_pladgft0.lam_mmv_vls_dif_dly_ldc "Floating mean value for limited lambda deviation" SWORD _CNV_A_R_LINEAR_____110_CM 1 100. -50. 49.9984741210938 DISPLAY_IDENTIFIER LAM_MMV_VLS_DIF_DLY_LDC[2] ECU_ADDRESS 0xd0001d8c FORMAT "%7.3" /end MEASUREMENT
/begin MEASUREMENT egcp[1].egcp_struct_pladgft0.maf_int_vls_dif_dly_min "MAF integral for lower VLS_DIF_DLY deviation" UWORD _CNV_A_R_LINEAR_____356_CM 1 100. 0. 1820.42 DISPLAY_IDENTIFIER MAF_INT_VLS_DIF_DLY_MIN[2] ECU_ADDRESS 0xd0001d8e FORMAT "%7.2" /end MEASUREMENT
/begin MEASUREMENT egcp[1].egcp_struct_pladgft0.maf_int_vls_dif_dly_max "MAF integral for upper VLS_DIF_DLY deviation" UWORD _CNV_A_R_LINEAR_____356_CM 1 100. 0. 1820.42 DISPLAY_IDENTIFIER MAF_INT_VLS_DIF_DLY_MAX[2] ECU_ADDRESS 0xd0001d90 FORMAT "%7.2" /end MEASUREMENT
/begin MEASUREMENT egcp[1].egcp_struct_pladgft0.maf_int_vls_dif_dly_ldc "Integral of mass air flow since limited dynamic conditions fulfilled" UWORD _CNV_A_R_LINEAR_____357_CM 1 100. 0. 1389. DISPLAY_IDENTIFIER MAF_INT_VLS_DIF_DLY_LDC[2] ECU_ADDRESS 0xd0001d92 FORMAT "%7.2" /end MEASUREMENT
/begin MEASUREMENT egcp[1].egcp_struct_pladgft0.maf_int_rst_vls_down_dif_diag "Integral to start a new diagnostic cycle and to set the end flag" UWORD _CNV_A_R_LINEAR_____356_CM 1 100. 0. 1820.42 DISPLAY_IDENTIFIER MAF_INT_RST_VLS_DOWN_DIF_DIAG[2] ECU_ADDRESS 0xd0001d94 FORMAT "%7.2" /end MEASUREMENT
/begin MEASUREMENT egcp[1].egcp_struct_pladgft0.t_sum_max_delta_i_lam "Total duration over C_LAMB_DELTA_I_MAX_DIAG" UWORD _CNV_A_R_LINEAR_____35_CM 1 100. 0. 65535. DISPLAY_IDENTIFIER T_SUM_MAX_DELTA_I_LAM[2] ECU_ADDRESS 0xd0001d96 FORMAT "%5.0" /end MEASUREMENT
/begin MEASUREMENT egcp[1].egcp_struct_pladgft0.t_sum_min_delta_i_lam "Total duration over C_LAMB_DELTA_I_MIN_DIAG" UWORD _CNV_A_R_LINEAR_____35_CM 1 100. 0. 65535. DISPLAY_IDENTIFIER T_SUM_MIN_DELTA_I_LAM[2] ECU_ADDRESS 0xd0001d98 FORMAT "%5.0" /end MEASUREMENT
/begin MEASUREMENT egcp[1].egcp_struct_pladgft0.t_sum_end_diag_win_delta_i_lam "Time counter to set LV_END_DIAG_WIN_DELTA_I_LAM[i] for similar conditions window" UWORD _CNV_A_R_LINEAR_____35_CM 1 100. 0. 65535. DISPLAY_IDENTIFIER T_SUM_END_DIAG_WIN_DELTA_I_LAM[2] ECU_ADDRESS 0xd0001d9a FORMAT "%5.0" /end MEASUREMENT
/begin MEASUREMENT egcp[1].egcp_struct_pladgft0.t_sum_end_ready_delta_i_lam "Second time counter to set LV_END_DIAG_DELTA_I_LAM[i]" UWORD _CNV_A_R_LINEAR_____35_CM 1 100. 0. 65535. DISPLAY_IDENTIFIER T_SUM_END_READY_DELTA_I_LAM[2] ECU_ADDRESS 0xd0001d9c FORMAT "%5.0" /end MEASUREMENT
/begin MEASUREMENT egcp[1].egcp_struct_pladgft0.t_sum_rst_delta_i_lam "Time counter to reset T_SUM_MAX_DELTA_I_LAM[i] and T_SUM_MIN_DELTA_I_LAM[i]." UWORD _CNV_A_R_LINEAR_____35_CM 1 100. 0. 65535. DISPLAY_IDENTIFIER T_SUM_RST_DELTA_I_LAM[2] ECU_ADDRESS 0xd0001d9e FORMAT "%5.0" /end MEASUREMENT
/begin MEASUREMENT egcp[1].egcp_struct_pladgft0.lamb_delta_i_save_diag "I-share from trim controller  - to be transmitted to the Scan Tool mode06" SWORD _CNV_A_R_LINEAR_____23_CM 1 100. -0.125 0.125 DISPLAY_IDENTIFIER LAMB_DELTA_I_SAVE_DIAG[2] ECU_ADDRESS 0xd0001da0 FORMAT "%8.5" /end MEASUREMENT
/begin MEASUREMENT egcp[1].egcp_struct_pladgft0.err_sym_lam_adj "Symptoms of the lambda trim control errors" UBYTE _CNV_S_5_EGCP_RANGE_353_CM 1 100. 0. 8. DISPLAY_IDENTIFIER ERR_SYM_LAM_ADJ[2] ECU_ADDRESS 0xd0001da2 /end MEASUREMENT
/begin MEASUREMENT egcp[1].egcp_struct_pladgft0.lv_vls_dif_dly_ldc "Status limited dynamic for the function \"Monitoring Trim Controller Deviation\"" UBYTE _CNV_S_2_RANGE__0___1_CM 1 100. 0. 1. DISPLAY_IDENTIFIER LV_VLS_DIF_DLY_LDC[2] ECU_ADDRESS 0xd0001da3 BIT_MASK 0x1 /end MEASUREMENT
/begin MEASUREMENT egcp[1].egcp_struct_pladgft0.lv_vls_dif_dly_ldc_lam_mv "Status limited dynamic FAC_LAM_MV[i]" UBYTE _CNV_S_2_RANGE__0___1_CM 1 100. 0. 1. DISPLAY_IDENTIFIER LV_VLS_DIF_DLY_LDC_LAM_MV[2] ECU_ADDRESS 0xd0001da4 BIT_MASK 0x1 /end MEASUREMENT
/begin MEASUREMENT egcp[1].egcp_struct_pladgft0.lv_end_diag_lam_adj "Diagnostic cycle for lambda trim control complete" UBYTE _CNV_S_2_RANGE__0___1_CM 1 100. 0. 1. DISPLAY_IDENTIFIER LV_END_DIAG_LAM_ADJ[2] ECU_ADDRESS 0xd0001da5 BIT_MASK 0x1 /end MEASUREMENT
/begin MEASUREMENT egcp[1].egcp_struct_pladgft0.lv_err_lam_adj "Status diagnostic result of lambda trim control" UBYTE _CNV_S_2_RANGE__0___1_CM 1 100. 0. 1. DISPLAY_IDENTIFIER LV_ERR_LAM_ADJ[2] ECU_ADDRESS 0xd0001da6 BIT_MASK 0x1 /end MEASUREMENT
/begin MEASUREMENT egcp[1].egcp_struct_pladgft0.lv_end_diag_win_delta_i_lam "End of diagnosis cycle for similar conditions window" UBYTE _CNV_S_2_RANGE__0___1_CM 1 100. 0. 1. DISPLAY_IDENTIFIER LV_END_DIAG_WIN_DELTA_I_LAM[2] ECU_ADDRESS 0xd0001da7 BIT_MASK 0x1 /end MEASUREMENT
/begin MEASUREMENT egcp[1].egcp_struct_pladgft0.lv_det_sym_eve_delta_i_lam "Bit for second time counter DELTA_I_LAM (T_SUM_END_READY_DELTA_I_LAM[i])" UBYTE _CNV_S_2_RANGE__0___1_CM 1 100. 0. 1. DISPLAY_IDENTIFIER LV_DET_SYM_EVE_DELTA_I_LAM[2] ECU_ADDRESS 0xd0001da8 BIT_MASK 0x1 /end MEASUREMENT
/begin MEASUREMENT egcp[1].egcp_struct_pladgfti0.lv_inh_diag_dly_lam "Inhibition condition for the dynamic fuel trim diagnosis" UBYTE _CNV_S_2_RANGE__0___1_CM 1 100. 0. 1. DISPLAY_IDENTIFIER LV_INH_DIAG_DLY_LAM[2] ECU_ADDRESS 0xd0001daa BIT_MASK 0x1 /end MEASUREMENT
/begin MEASUREMENT egcp[1].egcp_struct_pladgfti0.lv_inh_diag_rbm_dly_lam "Inhibition of the dynamic fuel trim diagnosis due to failures" UBYTE _CNV_S_2_RANGE__0___1_CM 1 100. 0. 1. DISPLAY_IDENTIFIER LV_INH_DIAG_RBM_DLY_LAM[2] ECU_ADDRESS 0xd0001dab BIT_MASK 0x1 /end MEASUREMENT
/begin MEASUREMENT egcp[1].egcp_struct_pladgfti0.state_rbm_lam_adj "Interface of LAM_ADJ[NC_CBK_EX_NR] monitor with the Rate-Based-Monitoring statistics" UBYTE _CNV_A_R_LINEAR_____0_CM 1 100. 0. 255. DISPLAY_IDENTIFIER STATE_RBM_LAM_ADJ[2] ECU_ADDRESS 0xd0001dac FORMAT "%3.0" /end MEASUREMENT
/begin MEASUREMENT egcp[1].egcp_struct_fctdglslh0.ttip_mes_ls_up_obd_lsh_up "Most current oxygen sensor temperature (Mode 6 information)" SWORD _CNV_A_R_LINEAR_____123_CM 1 100. -2048. 2047.9375 DISPLAY_IDENTIFIER TTIP_MES_LS_UP_OBD_LSH_UP[2] ECU_ADDRESS 0xd0001db0 FORMAT "%10.4" /end MEASUREMENT
/begin MEASUREMENT egcp[1].egcp_struct_fctdglslh0.tcc_vld_obd_lsh_up "Number of completed diagnosis cycles" UWORD _CNV_A_R_LINEAR_____0_CM 1 100. 0. 65535. DISPLAY_IDENTIFIER TCC_VLD_OBD_LSH_UP[2] ECU_ADDRESS 0xd0001db2 FORMAT "%5.0" /end MEASUREMENT
/begin MEASUREMENT egcp[1].egcp_struct_fctdglslh0.tcc_err_obd_lsh_up "Number of diagnosis cycles in which temperature deviation exceeding limits present" UWORD _CNV_A_R_LINEAR_____0_CM 1 100. 0. 65535. DISPLAY_IDENTIFIER TCC_ERR_OBD_LSH_UP[2] ECU_ADDRESS 0xd0001db4 FORMAT "%5.0" /end MEASUREMENT
/begin MEASUREMENT egcp[1].egcp_struct_fctdglslh0.state_sym_obd_lsl_lsh_up "Variable indicating status of each symptom, updated each recurrence & at diagnosis completion" UBYTE _CNV_S_4_EGCP_RANGE_358_CM 1 100. 0. 4. DISPLAY_IDENTIFIER STATE_SYM_OBD_LSL_LSH_UP[2] ECU_ADDRESS 0xd0001db6 /end MEASUREMENT
/begin MEASUREMENT egcp[1].egcp_struct_fctdglslh0.lv_lamb_pls_req_diag_lsh_up "Boolean flag requesting exaggerated forced stimulation" UBYTE _CNV_S_2_RANGE__0___1_CM 1 100. 0. 1. DISPLAY_IDENTIFIER LV_LAMB_PLS_REQ_DIAG_LSH_UP[2] ECU_ADDRESS 0xd0001db7 BIT_MASK 0x1 /end MEASUREMENT
/begin MEASUREMENT egcp[1].egcp_struct_fctdglslh0.lv_diag_obd_cdn_lsh_up "Boolean flag indicating that conditions for diagnosis met" UBYTE _CNV_S_2_RANGE__0___1_CM 1 100. 0. 1. DISPLAY_IDENTIFIER LV_DIAG_OBD_CDN_LSH_UP[2] ECU_ADDRESS 0xd0001db8 BIT_MASK 0x1 /end MEASUREMENT
/begin MEASUREMENT egcp[1].egcp_struct_fctdglslh0.lv_diag_obd_sym_lsh_up "Boolean flag indicating that fault is present and has been debounced" UBYTE _CNV_S_2_RANGE__0___1_CM 1 100. 0. 1. DISPLAY_IDENTIFIER LV_DIAG_OBD_SYM_LSH_UP[2] ECU_ADDRESS 0xd0001db9 BIT_MASK 0x1 /end MEASUREMENT
/begin MEASUREMENT egcp[1].egcp_struct_fctdglslh0.lv_diag_obd_end_lsh_up "Boolean flag indicating that diagnosis has been completed" UBYTE _CNV_S_2_RANGE__0___1_CM 1 100. 0. 1. DISPLAY_IDENTIFIER LV_DIAG_OBD_END_LSH_UP[2] ECU_ADDRESS 0xd0001dba BIT_MASK 0x1 /end MEASUREMENT
/begin MEASUREMENT egcp[1].egcp_struct_fctdglshd1.r_it_thd_obd_lsh_down "Threshold for most current downstream oxygen sensor internal resistance used for diagnosis cycle, Mode 6 information" UWORD _CNV_A_R_LINEAR_____0_CM 1 100. 0. 65535. DISPLAY_IDENTIFIER R_IT_THD_OBD_LSH_DOWN[2] ECU_ADDRESS 0xd0001dbc FORMAT "%5.0" /end MEASUREMENT
/begin MEASUREMENT egcp[1].egcp_struct_fctdglshd1.r_it_obd_lsh_down "Most current downstream oxygen sensor internal resistance used for diagnosis cycle, Mode 6 information" UWORD _CNV_A_R_LINEAR_____0_CM 1 100. 0. 65535. DISPLAY_IDENTIFIER R_IT_OBD_LSH_DOWN[2] ECU_ADDRESS 0xd0001dbe FORMAT "%5.0" /end MEASUREMENT
/begin MEASUREMENT egcp[1].egcp_struct_fctdglshd1.temp_dif_obd_lsh_down "Indicates difference in temperature between set operating temperature & exhaust gas at sensor location" UWORD _CNV_A_R_EGCP_LINEA_359_CM 1 100. 0. 2047. DISPLAY_IDENTIFIER TEMP_DIF_OBD_LSH_DOWN[2] ECU_ADDRESS 0xd0001dc0 FORMAT "%4.0" /end MEASUREMENT
/begin MEASUREMENT egcp[1].egcp_struct_fctdglshd1.pow_int_obd_lsh_down "Integral indicates measure of cooling energy of exhaust gas at sensor location" UWORD _CNV_A_R_LINEAR_____334_CM 1 100. 0. 65535. DISPLAY_IDENTIFIER POW_INT_OBD_LSH_DOWN[2] ECU_ADDRESS 0xd0001dc2 FORMAT "%5.0" /end MEASUREMENT
/begin MEASUREMENT egcp[1].egcp_struct_fctdglshd1.tcc_vld_obd_lsh_down "Number of completed valid diagnosis cycles" UWORD _CNV_A_R_LINEAR_____0_CM 1 100. 0. 1023. DISPLAY_IDENTIFIER TCC_VLD_OBD_LSH_DOWN[2] ECU_ADDRESS 0xd0001dc4 FORMAT "%4.0" /end MEASUREMENT
/begin MEASUREMENT egcp[1].egcp_struct_fctdglshd1.tcc_err_obd_lsh_down "Number of faults detected during valid diagnosis cycles" UWORD _CNV_A_R_LINEAR_____0_CM 1 100. 0. 1023. DISPLAY_IDENTIFIER TCC_ERR_OBD_LSH_DOWN[2] ECU_ADDRESS 0xd0001dc6 FORMAT "%4.0" /end MEASUREMENT
/begin MEASUREMENT egcp[1].egcp_struct_fctdglshd1.ctr_cycnr_r_it_obd_ls_down "Value of handshake counter for last valid resistance value used for diagnosis" UWORD _CNV_A_R_LINEAR_____0_CM 1 100. 0. 65535. DISPLAY_IDENTIFIER CTR_CYCNR_R_IT_OBD_LS_DOWN[2] ECU_ADDRESS 0xd0001dc8 FORMAT "%5.0" /end MEASUREMENT
/begin MEASUREMENT egcp[1].egcp_struct_fctdglshd1.state_obd_lsh_down "Indicates current phase of oxygen sensor heater OBDII diagnosis" UBYTE _CNV_S_9_EGCP_RANGE_360_CM 1 100. 0. 8. DISPLAY_IDENTIFIER STATE_OBD_LSH_DOWN[2] ECU_ADDRESS 0xd0001dca /end MEASUREMENT
/begin MEASUREMENT egcp[1].egcp_struct_fctdglshdi1.lv_inh_diag_obd_lsh_down "Boolean inhibit flag for O2 sensor heater OBDII monitoring" UBYTE _CNV_S_2_RANGE__0___1_CM 1 100. 0. 1. DISPLAY_IDENTIFIER LV_INH_DIAG_OBD_LSH_DOWN[2] ECU_ADDRESS 0xd0001dcc BIT_MASK 0x1 /end MEASUREMENT
/begin MEASUREMENT egcp[1].egcp_struct_fctdglshdi1.lv_inh_diag_rbm_obd_lsh_down "Flag to inhibit rate based monitoring for oxygen sensor heater OBDII diagnosis" UBYTE _CNV_S_2_RANGE__0___1_CM 1 100. 0. 1. DISPLAY_IDENTIFIER LV_INH_DIAG_RBM_OBD_LSH_DOWN[2] ECU_ADDRESS 0xd0001dcd BIT_MASK 0x1 /end MEASUREMENT
/begin MEASUREMENT egcp[1].egcp_struct_fctdglshdi1.state_rbm_obd_lsh_down "Interface of OBD_LSH_DOWN monitor with the Rate-Based Monitoring statistics" UBYTE _CNV_A_R_LINEAR_____0_CM 1 100. 0. 7. DISPLAY_IDENTIFIER STATE_RBM_OBD_LSH_DOWN[2] ECU_ADDRESS 0xd0001dce FORMAT "%1.0" /end MEASUREMENT
/begin MEASUREMENT egcp[1].egcp_struct_sigdglsl1.t_dly_diag_shift_down "Delay timer for the end flag of the shift down diagnosis in the no failure case (RBM purpose)" UWORD _CNV_A_R_LINEAR_____4_CM 1 100. 0. 6553.5 DISPLAY_IDENTIFIER T_DLY_DIAG_SHIFT_DOWN[2] ECU_ADDRESS 0xd0001dd0 FORMAT "%6.1" /end MEASUREMENT
/begin MEASUREMENT egcp[1].egcp_struct_sigdglsl1.lv_t_dly_diag_shift_down "Delay timer for the end flag of the shift down diagnosis in the no failure case (RBM purpose)" UBYTE _CNV_S_2_RANGE__0___1_CM 1 100. 0. 1. DISPLAY_IDENTIFIER LV_T_DLY_DIAG_SHIFT_DOWN[2] ECU_ADDRESS 0xd0001dd2 BIT_MASK 0x1 /end MEASUREMENT
/begin MEASUREMENT egcp[1].egcp_struct_sigdglsl1.lv_err_ls_down "Final diagnostic of the downstream oxygen sensor" UBYTE _CNV_S_2_RANGE__0___1_CM 1 100. 0. 1. DISPLAY_IDENTIFIER LV_ERR_LS_DOWN[2] ECU_ADDRESS 0xd0001dd3 BIT_MASK 0x1 /end MEASUREMENT
/begin MEASUREMENT egcp[1].egcp_struct_sigdglsl1.lv_err_ls_up "Final diagnostic of the upstream oxygen sensor" UBYTE _CNV_S_2_RANGE__0___1_CM 1 100. 0. 1. DISPLAY_IDENTIFIER LV_ERR_LS_UP[2] ECU_ADDRESS 0xd0001dd4 BIT_MASK 0x1 /end MEASUREMENT
/begin MEASUREMENT egcp[1].egcp_struct_sigdglsl1.lv_ls_up_diag_end "Sum end bit of upstream oxygen sensor diagnosis functions" UBYTE _CNV_S_2_RANGE__0___1_CM 1 100. 0. 1. DISPLAY_IDENTIFIER LV_LS_UP_DIAG_END[2] ECU_ADDRESS 0xd0001dd5 BIT_MASK 0x1 /end MEASUREMENT
/begin MEASUREMENT egcp[1].egcp_struct_sigdglsl1.lv_ls_up_obd_1_man_deac "Logical variable indicating manual deactivation of all OBD1 diagnosis for upstream oxygen sensor" UBYTE _CNV_S_2_RANGE__0___1_CM 1 100. 0. 1. DISPLAY_IDENTIFIER LV_LS_UP_OBD_1_MAN_DEAC[2] ECU_ADDRESS 0xd0001dd6 BIT_MASK 0x1 /end MEASUREMENT
/begin MEASUREMENT egcp[1].egcp_struct_sigdglsl1.lv_ls_up_obd_2_man_deac "Logical variable indicating manual deactivation of all OBD2 diagnosis for upstream oxygen sensor" UBYTE _CNV_S_2_RANGE__0___1_CM 1 100. 0. 1. DISPLAY_IDENTIFIER LV_LS_UP_OBD_2_MAN_DEAC[2] ECU_ADDRESS 0xd0001dd7 BIT_MASK 0x1 /end MEASUREMENT
/begin MEASUREMENT egcp[1].egcp_struct_sigdglsl1.lv_ls_down_diag_end "Collecting end flag for the diagnosis functions of the downstream oxygen sensor" UBYTE _CNV_S_2_RANGE__0___1_CM 1 100. 0. 1. DISPLAY_IDENTIFIER LV_LS_DOWN_DIAG_END[2] ECU_ADDRESS 0xd0001dd8 BIT_MASK 0x1 /end MEASUREMENT
/begin MEASUREMENT egcp[1].egcp_struct_sigdglsl1.lv_ls_down_obd_1_man_deac "Logical variable indicating manual deactivation of all OBD1 diagnosis for downstream oxygen sensor" UBYTE _CNV_S_2_RANGE__0___1_CM 1 100. 0. 1. DISPLAY_IDENTIFIER LV_LS_DOWN_OBD_1_MAN_DEAC[2] ECU_ADDRESS 0xd0001dd9 BIT_MASK 0x1 /end MEASUREMENT
/begin MEASUREMENT egcp[1].egcp_struct_sigdglsl1.lv_ls_down_obd_2_man_deac "Logical variable indicating manual deactivation of all OBD2 diagnosis for downstream oxygen sensor" UBYTE _CNV_S_2_RANGE__0___1_CM 1 100. 0. 1. DISPLAY_IDENTIFIER LV_LS_DOWN_OBD_2_MAN_DEAC[2] ECU_ADDRESS 0xd0001dda BIT_MASK 0x1 /end MEASUREMENT
/begin MEASUREMENT egcp[1].egcp_struct_pladglsl1.lamb_sp_delta_ls_up_down "Increment of lambda setpoint" SWORD _CNV_A_R_EGCP_LINEA_361_CM 1 100. -32. 31.999023 DISPLAY_IDENTIFIER LAMB_SP_DELTA_LS_UP_DOWN[2] ECU_ADDRESS 0xd0001ddc FORMAT "%9.6" /end MEASUREMENT
/begin MEASUREMENT egcp[1].egcp_struct_pladglsl1.maf_int_diag_ls_up_down "Integral of air mass flow  while check is active" UWORD _CNV_A_R_LINEAR_____356_CM 1 100. 0. 1820.42 DISPLAY_IDENTIFIER MAF_INT_DIAG_LS_UP_DOWN[2] ECU_ADDRESS 0xd0001dde FORMAT "%7.2" /end MEASUREMENT
/begin MEASUREMENT egcp[1].egcp_struct_pladglsl1.lamb_sp_beg_diag_ls_up_down "Inicial value of lambda set point " UWORD _CNV_A_R_LINEAR_____122_CM 1 100. 0. 31.9990234375 DISPLAY_IDENTIFIER LAMB_SP_BEG_DIAG_LS_UP_DOWN[2] ECU_ADDRESS 0xd0001de0 FORMAT "%7.4" /end MEASUREMENT
/begin MEASUREMENT egcp[1].egcp_struct_pladglsl1.t_diag_act_afr_ls_up_down "Timer for plauisibility test under rich AF conditions" UWORD _CNV_A_R_LINEAR_____4_CM 1 100. 0. 6553.5 DISPLAY_IDENTIFIER T_DIAG_ACT_AFR_LS_UP_DOWN[2] ECU_ADDRESS 0xd0001de2 FORMAT "%6.1" /end MEASUREMENT
/begin MEASUREMENT egcp[1].egcp_struct_pladglsl1.t_diag_act_afl_ls_up_down "Timer for plauisibility test under lean AF conditions" UWORD _CNV_A_R_LINEAR_____4_CM 1 100. 0. 6553.5 DISPLAY_IDENTIFIER T_DIAG_ACT_AFL_LS_UP_DOWN[2] ECU_ADDRESS 0xd0001de4 FORMAT "%6.1" /end MEASUREMENT
/begin MEASUREMENT egcp[1].egcp_struct_pladglsl1.lamb_sp_diag_ls_up_down "Lambda set point for active plausibility test" UWORD _CNV_A_R_LINEAR_____122_CM 1 100. 0. 31.9990234375 DISPLAY_IDENTIFIER LAMB_SP_DIAG_LS_UP_DOWN[2] ECU_ADDRESS 0xd0001de6 FORMAT "%7.4" /end MEASUREMENT
/begin MEASUREMENT egcp[1].egcp_struct_pladglsl1.ctr_sum_rst_afr_chk_lsl_up "Reset counter for the rich active test" UWORD _CNV_A_R_LINEAR_____0_CM 1 100. 0. 65535. DISPLAY_IDENTIFIER CTR_SUM_RST_AFR_CHK_LSL_UP[2] ECU_ADDRESS 0xd0001de8 FORMAT "%5.0" /end MEASUREMENT
/begin MEASUREMENT egcp[1].egcp_struct_pladglsl1.ctr_sum_rst_afl_chk_lsl_up "Reset counter for the rich active test" UWORD _CNV_A_R_LINEAR_____0_CM 1 100. 0. 65535. DISPLAY_IDENTIFIER CTR_SUM_RST_AFL_CHK_LSL_UP[2] ECU_ADDRESS 0xd0001dea FORMAT "%5.0" /end MEASUREMENT
/begin MEASUREMENT egcp[1].egcp_struct_pladglsl1.ctr_afr_chk_lsl_up "Debounce counter for the rich test" UWORD _CNV_A_R_LINEAR_____0_CM 1 100. 0. 65535. DISPLAY_IDENTIFIER CTR_AFR_CHK_LSL_UP[2] ECU_ADDRESS 0xd0001dec FORMAT "%5.0" /end MEASUREMENT
/begin MEASUREMENT egcp[1].egcp_struct_pladglsl1.ctr_afl_chk_lsl_up "Debounce counter for the lean test" UWORD _CNV_A_R_LINEAR_____0_CM 1 100. 0. 65535. DISPLAY_IDENTIFIER CTR_AFL_CHK_LSL_UP[2] ECU_ADDRESS 0xd0001dee FORMAT "%5.0" /end MEASUREMENT
/begin MEASUREMENT egcp[1].egcp_struct_pladglsl1.t_end_diag_act_ls_down "Timer for the end of the downstream sensor active test in the no failure case" UWORD _CNV_A_R_LINEAR_____4_CM 1 100. 0. 6553.5 DISPLAY_IDENTIFIER T_END_DIAG_ACT_LS_DOWN[2] ECU_ADDRESS 0xd0001df0 FORMAT "%6.1" /end MEASUREMENT
/begin MEASUREMENT egcp[1].egcp_struct_pladglsl1.t_afr_chk_ls_down "Debounce counter for the rich test" UWORD _CNV_A_R_LINEAR_____4_CM 1 100. 0. 6553.5 DISPLAY_IDENTIFIER T_AFR_CHK_LS_DOWN[2] ECU_ADDRESS 0xd0001df2 FORMAT "%6.1" /end MEASUREMENT
/begin MEASUREMENT egcp[1].egcp_struct_pladglsl1.t_afl_chk_ls_down "Debounce counter for the lean test" UWORD _CNV_A_R_LINEAR_____4_CM 1 100. 0. 6553.5 DISPLAY_IDENTIFIER T_AFL_CHK_LS_DOWN[2] ECU_ADDRESS 0xd0001df4 FORMAT "%6.1" /end MEASUREMENT
/begin MEASUREMENT egcp[1].egcp_struct_pladglsl1.state_diag_act_ls_up_down "State of check of downstream oxygen sensor signal for lambda sensor error manager" UBYTE _CNV_S_4_EGCP_RANGE_362_CM 1 100. 0. 3. DISPLAY_IDENTIFIER STATE_DIAG_ACT_LS_UP_DOWN[2] ECU_ADDRESS 0xd0001df6 /end MEASUREMENT
/begin MEASUREMENT egcp[1].egcp_struct_pladglsl1.lv_diag_afl_cdn_ls_up_down "Boolean flag, condition to execute AFL active check of the oxygen sensors" UBYTE _CNV_S_2_RANGE__0___1_CM 1 100. 0. 1. DISPLAY_IDENTIFIER LV_DIAG_AFL_CDN_LS_UP_DOWN[2] ECU_ADDRESS 0xd0001df7 BIT_MASK 0x1 /end MEASUREMENT
/begin MEASUREMENT egcp[1].egcp_struct_pladglsl1.lv_diag_afr_cdn_ls_up_down "Boolean flag, condition to execute AFR active check of the oxygen sensors" UBYTE _CNV_S_2_RANGE__0___1_CM 1 100. 0. 1. DISPLAY_IDENTIFIER LV_DIAG_AFR_CDN_LS_UP_DOWN[2] ECU_ADDRESS 0xd0001df8 BIT_MASK 0x1 /end MEASUREMENT
/begin MEASUREMENT egcp[1].egcp_struct_pladglsl1.lv_diag_act_end_ls_up_down "Boolean flag, end of active check of the oxygen sensors" UBYTE _CNV_S_2_RANGE__0___1_CM 1 100. 0. 1. DISPLAY_IDENTIFIER LV_DIAG_ACT_END_LS_UP_DOWN[2] ECU_ADDRESS 0xd0001df9 BIT_MASK 0x1 /end MEASUREMENT
/begin MEASUREMENT egcp[1].egcp_struct_pladglsl1.lv_lamb_sp_afr_req_diag_act "Trigger function to change lambda set point for AFR active plauisibility test" UBYTE _CNV_S_2_RANGE__0___1_CM 1 100. 0. 1. DISPLAY_IDENTIFIER LV_LAMB_SP_AFR_REQ_DIAG_ACT[2] ECU_ADDRESS 0xd0001dfa BIT_MASK 0x1 /end MEASUREMENT
/begin MEASUREMENT egcp[1].egcp_struct_pladglsl1.lv_lamb_sp_afl_req_diag_act "Trigger function to change lambda set point for AFL active plauisibility test" UBYTE _CNV_S_2_RANGE__0___1_CM 1 100. 0. 1. DISPLAY_IDENTIFIER LV_LAMB_SP_AFL_REQ_DIAG_ACT[2] ECU_ADDRESS 0xd0001dfb BIT_MASK 0x1 /end MEASUREMENT
/begin MEASUREMENT egcp[1].egcp_struct_pladglsl1.lv_lamb_sp_req_diag_act "Lambda coordination request to change set point for active plausibility test" UBYTE _CNV_S_2_RANGE__0___1_CM 1 100. 0. 1. DISPLAY_IDENTIFIER LV_LAMB_SP_REQ_DIAG_ACT[2] ECU_ADDRESS 0xd0001dfc BIT_MASK 0x1 /end MEASUREMENT
/begin MEASUREMENT egcp[1].egcp_struct_pladglsl1.lv_diag_cyc_end_ls_down "End of cycle of active test of downstream sensor" UBYTE _CNV_S_2_RANGE__0___1_CM 1 100. 0. 1. DISPLAY_IDENTIFIER LV_DIAG_CYC_END_LS_DOWN[2] ECU_ADDRESS 0xd0001dfd BIT_MASK 0x1 /end MEASUREMENT
/begin MEASUREMENT egcp[1].egcp_struct_pladglsl1.lv_lam_di_req "Request disable close loop operation of the lambda controller" UBYTE _CNV_S_2_RANGE__0___1_CM 1 100. 0. 1. DISPLAY_IDENTIFIER LV_LAM_DI_REQ[2] ECU_ADDRESS 0xd0001dfe BIT_MASK 0x1 /end MEASUREMENT
/begin MEASUREMENT egcp[1].egcp_struct_pladglsl1.lv_diag_afr_end_ls_up_down "Boolean flag indicating the end of RICH active check" UBYTE _CNV_S_2_RANGE__0___1_CM 1 100. 0. 1. DISPLAY_IDENTIFIER LV_DIAG_AFR_END_LS_UP_DOWN[2] ECU_ADDRESS 0xd0001dff BIT_MASK 0x1 /end MEASUREMENT
/begin MEASUREMENT egcp[1].egcp_struct_pladglsl1.lv_diag_afl_end_ls_up_down "Boolean flag indicating the end of LEAN active check" UBYTE _CNV_S_2_RANGE__0___1_CM 1 100. 0. 1. DISPLAY_IDENTIFIER LV_DIAG_AFL_END_LS_UP_DOWN[2] ECU_ADDRESS 0xd0001e00 BIT_MASK 0x1 /end MEASUREMENT
/begin MEASUREMENT egcp[1].egcp_struct_pladglsl1.lv_diag_afr_chk_sym_lsl_up "Debounced failure in the upstream sensor during the RICH active check " UBYTE _CNV_S_2_RANGE__0___1_CM 1 100. 0. 1. DISPLAY_IDENTIFIER LV_DIAG_AFR_CHK_SYM_LSL_UP[2] ECU_ADDRESS 0xd0001e01 BIT_MASK 0x1 /end MEASUREMENT
/begin MEASUREMENT egcp[1].egcp_struct_pladglsl1.lv_diag_afl_chk_sym_lsl_up "Debounced failure in the upstream sensor during the LEAN active check" UBYTE _CNV_S_2_RANGE__0___1_CM 1 100. 0. 1. DISPLAY_IDENTIFIER LV_DIAG_AFL_CHK_SYM_LSL_UP[2] ECU_ADDRESS 0xd0001e02 BIT_MASK 0x1 /end MEASUREMENT
/begin MEASUREMENT egcp[1].egcp_struct_pladglsl1.lv_diag_act_chk_cdn_lsl_up "Conditions to run active test of upstream sensor fulfilled" UBYTE _CNV_S_2_RANGE__0___1_CM 1 100. 0. 1. DISPLAY_IDENTIFIER LV_DIAG_ACT_CHK_CDN_LSL_UP[2] ECU_ADDRESS 0xd0001e03 BIT_MASK 0x1 /end MEASUREMENT
/begin MEASUREMENT egcp[1].egcp_struct_pladglsl1.lv_diag_act_chk_end_lsl_up "End active test of upstream sensor" UBYTE _CNV_S_2_RANGE__0___1_CM 1 100. 0. 1. DISPLAY_IDENTIFIER LV_DIAG_ACT_CHK_END_LSL_UP[2] ECU_ADDRESS 0xd0001e04 BIT_MASK 0x1 /end MEASUREMENT
/begin MEASUREMENT egcp[1].egcp_struct_pladglsl1.lv_diag_eol_end_ls_up_down "Boolean flag, end of active check of the oxygen sensors (EOL test)" UBYTE _CNV_S_2_RANGE__0___1_CM 1 100. 0. 1. DISPLAY_IDENTIFIER LV_DIAG_EOL_END_LS_UP_DOWN[2] ECU_ADDRESS 0xd0001e05 BIT_MASK 0x1 /end MEASUREMENT
/begin MEASUREMENT egcp[1].egcp_struct_pladglsl1.lv_diag_eol_dc_ls_up_down "Flag indicating eol test was active in this driving cycle." UBYTE _CNV_S_2_RANGE__0___1_CM 1 100. 0. 1. DISPLAY_IDENTIFIER LV_DIAG_EOL_DC_LS_UP_DOWN[2] ECU_ADDRESS 0xd0001e06 BIT_MASK 0x1 /end MEASUREMENT
/begin MEASUREMENT egcp[1].egcp_struct_pladglsl1.lv_sym_afl_chk_ls_down "Symptom of oxygen sensor downstream too lean in case of 2 bank system during end of line test or sensor interchanged test" UBYTE _CNV_S_2_RANGE__0___1_CM 1 100. 0. 1. DISPLAY_IDENTIFIER LV_SYM_AFL_CHK_LS_DOWN[2] ECU_ADDRESS 0xd0001e07 BIT_MASK 0x1 /end MEASUREMENT
/begin MEASUREMENT egcp[1].egcp_struct_pladglsl1.lv_sym_afr_chk_ls_down "Symptom of oxygen sensor downstream too rich in case of 2 bank system during end of line test or sensor interchanged test" UBYTE _CNV_S_2_RANGE__0___1_CM 1 100. 0. 1. DISPLAY_IDENTIFIER LV_SYM_AFR_CHK_LS_DOWN[2] ECU_ADDRESS 0xd0001e08 BIT_MASK 0x1 /end MEASUREMENT
/begin MEASUREMENT egcp[1].egcp_struct_sigdglsdi2.lv_diag_mpl_inh_ls_down "OBD II function dowmstream sensor: application incidences for inhibition" UBYTE _CNV_S_2_RANGE__0___1_CM 1 100. 0. 1. DISPLAY_IDENTIFIER LV_DIAG_MPL_INH_LS_DOWN[2] ECU_ADDRESS 0xd0001e0a BIT_MASK 0x1 /end MEASUREMENT
/begin MEASUREMENT egcp[1].egcp_struct_sigdglsdi2.state_rbm_swt_ls_down "Interface of SWT_LS_DOWN monitor with the Rate Based Monitoring statistics" UBYTE _CNV_A_R_LINEAR_____0_CM 1 100. 0. 255. DISPLAY_IDENTIFIER STATE_RBM_SWT_LS_DOWN[2] ECU_ADDRESS 0xd0001e0b FORMAT "%3.0" /end MEASUREMENT
/begin MEASUREMENT egcp[1].egcp_struct_sigdglsdi2.state_rbm_pue_ls_down "Interface of PUE_LS_DOWN monitor with the Rate Based Monitoring statistics" UBYTE _CNV_A_R_LINEAR_____0_CM 1 100. 0. 255. DISPLAY_IDENTIFIER STATE_RBM_PUE_LS_DOWN[2] ECU_ADDRESS 0xd0001e0c FORMAT "%3.0" /end MEASUREMENT
/begin MEASUREMENT egcp[1].egcp_struct_fctdglslhi0.lv_inh_diag_obd_lsh_up "Boolean inhibit flag for O2 sensor heater OBDII monitoring" UBYTE _CNV_S_2_RANGE__0___1_CM 1 100. 0. 1. DISPLAY_IDENTIFIER LV_INH_DIAG_OBD_LSH_UP[2] ECU_ADDRESS 0xd0001e0e BIT_MASK 0x1 /end MEASUREMENT
/begin MEASUREMENT egcp[1].egcp_struct_pladgls2.lv_diag_sym_chg_ls_down "Debounced error: downstream sensor of banks 1and 2 interchanged" UBYTE _CNV_S_2_RANGE__0___1_CM 1 100. 0. 1. DISPLAY_IDENTIFIER LV_DIAG_SYM_CHG_LS_DOWN[2] ECU_ADDRESS 0xd0001e90 BIT_MASK 0x1 /end MEASUREMENT
/begin MEASUREMENT egcp[1].egcp_struct_sigdglsli1.state_rbm_shift_afl_lsl_up "Interface of SHIFT_AFL_LSL_UP[NC_CBK_EX_NR] monitor with the Rate-Based Monitoring statistics" UBYTE _CNV_A_R_LINEAR_____0_CM 1 100. 0. 255. DISPLAY_IDENTIFIER STATE_RBM_SHIFT_AFL_LSL_UP[2] ECU_ADDRESS 0xd0001e92 FORMAT "%3.0" /end MEASUREMENT
/begin MEASUREMENT egcp[1].egcp_struct_sigdglsli1.state_rbm_shift_afr_lsl_up "Interface of SHIFT_AFR_LSL_UP[NC_CBK_EX_NR] monitor with the Rate-Based Monitoring statistics" UBYTE _CNV_A_R_LINEAR_____0_CM 1 100. 0. 255. DISPLAY_IDENTIFIER STATE_RBM_SHIFT_AFR_LSL_UP[2] ECU_ADDRESS 0xd0001e93 FORMAT "%3.0" /end MEASUREMENT
/begin MEASUREMENT egcp[1].egcp_struct_sigdglsli1.state_rbm_obd_vld_lsh_up "Interface of OBD_VLD_LSH_UP[NC_CBK_EX_NR] monitor with the Rate-Based Monitoring statistics" UBYTE _CNV_A_R_LINEAR_____0_CM 1 100. 0. 255. DISPLAY_IDENTIFIER STATE_RBM_OBD_VLD_LSH_UP[2] ECU_ADDRESS 0xd0001e94 FORMAT "%3.0" /end MEASUREMENT
/begin MEASUREMENT egcp[1].egcp_struct_sigdglsd2.vls_down_tran_puc "Monitor sensor voltage on activating the trailing throttle fuel cut-off, Bank i" UWORD _CNV_A_R_LINEAR_____2_CM 1 100. 0. 4.9951171875 DISPLAY_IDENTIFIER VLS_DOWN_TRAN_PUC[2] ECU_ADDRESS 0xd0001eb0 FORMAT "%5.3" /end MEASUREMENT
/begin MEASUREMENT egcp[1].egcp_struct_sigdglsd2.vls_down_pue "Monitor sensor voltage at the time of leaving PUC, Bank i (i=1.2)" UWORD _CNV_A_R_LINEAR_____2_CM 1 100. 0. 4.9951171875 DISPLAY_IDENTIFIER VLS_DOWN_PUE[2] ECU_ADDRESS 0xd0001eb2 FORMAT "%5.3" /end MEASUREMENT
/begin MEASUREMENT egcp[1].egcp_struct_sigdglsd2.vls_dif_diag_pue_ls_down "difference of VLS_DOWN_i values from the beginning to the end of the MAF_INT_PUC_NOT_ACT calculation" UWORD _CNV_A_R_LINEAR_____2_CM 1 100. 0. 4.9951171875 DISPLAY_IDENTIFIER VLS_DIF_DIAG_PUE_LS_DOWN[2] ECU_ADDRESS 0xd0001eb4 FORMAT "%5.3" /end MEASUREMENT
/begin MEASUREMENT egcp[1].egcp_struct_sigdglsd2.vls_dif_save_diag_ls_down "Difference of VLS_DOWN_i values from the beginning to the end of the MAF_INT_PUC_NOT_ACT calculation for scantool" UWORD _CNV_A_R_LINEAR_____2_CM 1 100. 0. 4.9951171875 DISPLAY_IDENTIFIER VLS_DIF_SAVE_DIAG_LS_DOWN[2] ECU_ADDRESS 0xd0001eb6 FORMAT "%5.3" /end MEASUREMENT
/begin MEASUREMENT egcp[1].egcp_struct_sigdglsd2.vls_dif_min_diag_pue_ls_down "Minimum value of VLS_DIF_DIAG_PUE_LS_DOWN[i] until MAF threshold outside PUC is exceeded" UWORD _CNV_A_R_LINEAR_____2_CM 1 100. 0. 4.9951171875 DISPLAY_IDENTIFIER VLS_DIF_MIN_DIAG_PUE_LS_DOWN[2] ECU_ADDRESS 0xd0001eb8 FORMAT "%5.3" /end MEASUREMENT
/begin MEASUREMENT egcp[1].egcp_struct_sigdglsd2.vls_dif_max_diag_pue_ls_down "Maximum value of VLS_DIF_DIAG_PUE_LS_DOWN[i] until MAF threshold outside PUC is exceeded" UWORD _CNV_A_R_LINEAR_____2_CM 1 100. 0. 4.9951171875 DISPLAY_IDENTIFIER VLS_DIF_MAX_DIAG_PUE_LS_DOWN[2] ECU_ADDRESS 0xd0001eba FORMAT "%5.3" /end MEASUREMENT
/begin MEASUREMENT egcp[1].egcp_struct_sigdglsd2.ctr_end_diag_pue_ls_down "Counter to set LV_END_DIAG_VLS_DOWN_PUE_i" UWORD _CNV_A_R_LINEAR_____0_CM 1 100. 0. 65535. DISPLAY_IDENTIFIER CTR_END_DIAG_PUE_LS_DOWN[2] ECU_ADDRESS 0xd0001ebc FORMAT "%5.0" /end MEASUREMENT
/begin MEASUREMENT egcp[1].egcp_struct_sigdglsd2.ctr_quo_sum_swt_ls_down "Sum of weighted CTR_SWT_ACT_LS_DOWN[NC_CBK_EX_NR], Bank i" UWORD _CNV_A_R_LINEAR_____27_CM 1 100. 0. 255.99609375 DISPLAY_IDENTIFIER CTR_QUO_SUM_SWT_LS_DOWN[2] ECU_ADDRESS 0xd0001ebe FORMAT "%10.6" /end MEASUREMENT
/begin MEASUREMENT egcp[1].egcp_struct_sigdglsd2.ctr_quo_swt_ls_down "Weighted value CTR_SWT_ACT_LS_DOWN[NC_CBK_EX_NR ]" UWORD _CNV_A_R_LINEAR_____27_CM 1 100. 0. 255.99609375 DISPLAY_IDENTIFIER CTR_QUO_SWT_LS_DOWN[2] ECU_ADDRESS 0xd0001ec0 FORMAT "%10.6" /end MEASUREMENT
/begin MEASUREMENT egcp[1].egcp_struct_sigdglsd2.ctr_quo_swt_rbm_ls_down "Weighted value of CTR_SWT_ACT_RBM_LS_DOWN[NC_CBK_EX_NR ] for RBM purpose" UWORD _CNV_A_R_LINEAR_____27_CM 1 100. 0. 255.99609375 DISPLAY_IDENTIFIER CTR_QUO_SWT_RBM_LS_DOWN[2] ECU_ADDRESS 0xd0001ec2 FORMAT "%10.6" /end MEASUREMENT
/begin MEASUREMENT egcp[1].egcp_struct_sigdglsd2.ctr_swt_act_ls_down "Cycle counter for switching time determination, Bank i" UBYTE _CNV_A_R_LINEAR_____22_CM 1 100. 0. 5100. DISPLAY_IDENTIFIER CTR_SWT_ACT_LS_DOWN[2] ECU_ADDRESS 0xd0001ec4 FORMAT "%4.0" /end MEASUREMENT
/begin MEASUREMENT egcp[1].egcp_struct_sigdglsd2.ctr_swt_act_rbm_ls_down "Cycle counter for RBM switching time determination, Bank i" UBYTE _CNV_A_R_LINEAR_____22_CM 1 100. 0. 5100. DISPLAY_IDENTIFIER CTR_SWT_ACT_RBM_LS_DOWN[2] ECU_ADDRESS 0xd0001ec5 FORMAT "%4.0" /end MEASUREMENT
/begin MEASUREMENT egcp[1].egcp_struct_sigdglsd2.ctr_swt_ls_down "Number of valid switching times from rich to lean" UBYTE _CNV_A_R_LINEAR_____0_CM 1 100. 0. 255. DISPLAY_IDENTIFIER CTR_SWT_LS_DOWN[2] ECU_ADDRESS 0xd0001ec6 FORMAT "%3.0" /end MEASUREMENT
/begin MEASUREMENT egcp[1].egcp_struct_sigdglsd2.ctr_cycnr_swt_ls_down "Sum of weighted CTR_SWT_ACT_LS_DOWN[NC_CBK_EX_NR], Bank i" UBYTE _CNV_A_R_LINEAR_____100_CM 1 100. 0. 1.9921875 DISPLAY_IDENTIFIER CTR_CYCNR_SWT_LS_DOWN[2] ECU_ADDRESS 0xd0001ec7 FORMAT "%8.6" /end MEASUREMENT
/begin MEASUREMENT egcp[1].egcp_struct_sigdglsd2.ctr_save_swt_ls_down "Mean value of the ratio between the monitor sensor switching time and the threshold value for scantool" UBYTE _CNV_A_R_LINEAR_____100_CM 1 100. 0. 1.9921875 DISPLAY_IDENTIFIER CTR_SAVE_SWT_LS_DOWN[2] ECU_ADDRESS 0xd0001ec8 FORMAT "%8.6" /end MEASUREMENT
/begin MEASUREMENT egcp[1].egcp_struct_sigdglsd2.ctr_sym_diag_pue_ls_down "Counter for anti-bounce of LS_DOWN_PUE diagnosis" UBYTE _CNV_A_R_LINEAR_____0_CM 1 100. 0. 255. DISPLAY_IDENTIFIER CTR_SYM_DIAG_PUE_LS_DOWN[2] ECU_ADDRESS 0xd0001ec9 FORMAT "%3.0" /end MEASUREMENT
/begin MEASUREMENT egcp[1].egcp_struct_sigdglsd2.lv_diag_pue_vld_ls_down "Debounced diagnosis result of pull end plausibility" UBYTE _CNV_S_2_RANGE__0___1_CM 1 100. 0. 1. DISPLAY_IDENTIFIER LV_DIAG_PUE_VLD_LS_DOWN[2] ECU_ADDRESS 0xd0001eca BIT_MASK 0x1 /end MEASUREMENT
/begin MEASUREMENT egcp[1].egcp_struct_sigdglsd2.lv_diag_mpl_cdn_ls_down "Status of permission for diagnosis" UBYTE _CNV_S_2_RANGE__0___1_CM 1 100. 0. 1. DISPLAY_IDENTIFIER LV_DIAG_MPL_CDN_LS_DOWN[2] ECU_ADDRESS 0xd0001ecb BIT_MASK 0x1 /end MEASUREMENT
/begin MEASUREMENT egcp[1].egcp_struct_sigdglsd2.lv_diag_mpl_end_ls_down "Bit to indicate end of complete monitor sensor diagnosis" UBYTE _CNV_S_2_RANGE__0___1_CM 1 100. 0. 1. DISPLAY_IDENTIFIER LV_DIAG_MPL_END_LS_DOWN[2] ECU_ADDRESS 0xd0001ecc BIT_MASK 0x1 /end MEASUREMENT
/begin MEASUREMENT egcp[1].egcp_struct_sigdglsd2.lv_swt_diag_vld_ls_down "Validity bit of the current switching time check" UBYTE _CNV_S_2_RANGE__0___1_CM 1 100. 0. 1. DISPLAY_IDENTIFIER LV_SWT_DIAG_VLD_LS_DOWN[2] ECU_ADDRESS 0xd0001ecd BIT_MASK 0x1 /end MEASUREMENT
/begin CHARACTERISTIC c_lamb_delta_i_max_diag "Maximum limit of LAMB_DELTA_I_LAM_ADJ[i] + LAMB_DELTA_AD_LAM_ADJ[i]" VALUE 0xa10020d6 _REC_VAL_20_s2 0.25 _CNV_A_R_LINEAR_____23_CM -0.125 0.125 DISPLAY_IDENTIFIER C_LAMB_DELTA_I_MAX_DIAG FORMAT "%8.5" /end CHARACTERISTIC
/begin CHARACTERISTIC c_lamb_delta_i_min_diag "Minimum limit of LAMB_DELTA_I_LAM_ADJ[i] + LAMB_DELTA_AD_LAM_ADJ[i]" VALUE 0xa10020d8 _REC_VAL_20_s2 0.25 _CNV_A_R_LINEAR_____23_CM -0.125 0.125 DISPLAY_IDENTIFIER C_LAMB_DELTA_I_MIN_DIAG FORMAT "%8.5" /end CHARACTERISTIC
/begin CHARACTERISTIC c_vls_dif_max_diag "Maximum threshold for VLS_DIF_DLY deviation" VALUE 0xa100227c _REC_VAL_20_s2 9.99511718999929 _CNV_A_R_LINEAR_____369_CM -5.00000000000182 4.99511718999747 DISPLAY_IDENTIFIER C_VLS_DIF_MAX_DIAG /end CHARACTERISTIC
/begin CHARACTERISTIC c_vls_dif_min_diag "Minimum threshold for VLS_DIF_DLY deviation" VALUE 0xa100227e _REC_VAL_20_s2 9.99511718999929 _CNV_A_R_LINEAR_____369_CM -5.00000000000182 4.99511718999747 DISPLAY_IDENTIFIER C_VLS_DIF_MIN_DIAG /end CHARACTERISTIC
/begin CHARACTERISTIC c_maf_int_vls_dif_dly_min "Maximum MAF integral of VLS_DIF_DLY deviation (rich side)" VALUE 0xa100213c _REC_VAL_20_u2 1820.42 _CNV_A_R_LINEAR_____356_CM 0. 1820.42 DISPLAY_IDENTIFIER C_MAF_INT_VLS_DIF_DLY_MIN FORMAT "%7.2" /end CHARACTERISTIC
/begin CHARACTERISTIC c_maf_int_vls_dif_dly_max "Maximum MAF integral of VLS_DIF_DLY deviation (lean side)" VALUE 0xa100213a _REC_VAL_20_u2 1820.42 _CNV_A_R_LINEAR_____356_CM 0. 1820.42 DISPLAY_IDENTIFIER C_MAF_INT_VLS_DIF_DLY_MAX FORMAT "%7.2" /end CHARACTERISTIC
/begin MEASUREMENT lv_vls_dif_dly_ldc_n "Status limited dynamic N" UBYTE _CNV_S_2_RANGE__0___1_CM 1 100. 0. 1. DISPLAY_IDENTIFIER LV_VLS_DIF_DLY_LDC_N ECU_ADDRESS 0xc000196e BIT_MASK 0x1 /end MEASUREMENT
/begin MEASUREMENT lv_vls_dif_dly_ldc_maf "Status limited dynamic MAF" UBYTE _CNV_S_2_RANGE__0___1_CM 1 100. 0. 1. DISPLAY_IDENTIFIER LV_VLS_DIF_DLY_LDC_MAF ECU_ADDRESS 0xc000196d BIT_MASK 0x1 /end MEASUREMENT
/begin MEASUREMENT n_mmv_vls_dif_dly_ldc "Floating mean value for limited engine speed" UWORD _CNV_A_R_LINEAR_____13_CM 1 100. 0. 8160. DISPLAY_IDENTIFIER N_MMV_VLS_DIF_DLY_LDC ECU_ADDRESS 0xc000195e FORMAT "%4.0" /end MEASUREMENT
/begin MEASUREMENT maf_mmv_vls_dif_dly_ldc "Floating mean value for limited MAF" UWORD _CNV_A_R_LINEAR_____108_CM 1 100. 0. 1389. DISPLAY_IDENTIFIER MAF_MMV_VLS_DIF_DLY_LDC ECU_ADDRESS 0xc000195c FORMAT "%7.2" /end MEASUREMENT
/begin CHARACTERISTIC c_n_ldc_vls_dif_dly "Threshold limited dynamic engine speed" VALUE 0xa100215e _REC_VAL_20_u2 8160. _CNV_A_R_LINEAR_____13_CM 0. 8160. DISPLAY_IDENTIFIER C_N_LDC_VLS_DIF_DLY FORMAT "%4.0" /end CHARACTERISTIC
/begin CHARACTERISTIC c_maf_ldc_vls_dif_dly "Threshold limited dynamic engine MAF " VALUE 0xa100214a _REC_VAL_20_u2 1389. _CNV_A_R_LINEAR_____108_CM 0. 1389. DISPLAY_IDENTIFIER C_MAF_LDC_VLS_DIF_DLY FORMAT "%7.2" /end CHARACTERISTIC
/begin CHARACTERISTIC c_lam_mv_ldc_vls_dif_dly "Threshold limited dynamic lambda " VALUE 0xa10020be _REC_VAL_20_u2 99.99847412109381 _CNV_A_R_LINEAR_____7_CM 0. 99.99847412109381 DISPLAY_IDENTIFIER C_LAM_MV_LDC_VLS_DIF_DLY /end CHARACTERISTIC
/begin CHARACTERISTIC c_n_crlc_ldc_vls_dif_dly "Correlation constant floating mean value calculation engine speed" VALUE 0xa100215c _REC_VAL_20_u2 0.9999847412109381 _CNV_A_R_LINEAR_____68_CM 0. 0.9999847412109381 DISPLAY_IDENTIFIER C_N_CRLC_LDC_VLS_DIF_DLY FORMAT "%7.5" /end CHARACTERISTIC
/begin CHARACTERISTIC c_maf_crlc_ldc_vls_dif_dly "Correlation constant floating mean value calculation MAF" VALUE 0xa1002114 _REC_VAL_20_u2 0.9999847412109381 _CNV_A_R_LINEAR_____68_CM 0. 0.9999847412109381 DISPLAY_IDENTIFIER C_MAF_CRLC_LDC_VLS_DIF_DLY FORMAT "%7.5" /end CHARACTERISTIC
/begin CHARACTERISTIC c_lam_mv_crlc_ldc_vls_dif_dly "Correlation constant floating mean value calculation lambda" VALUE 0xa10020bc _REC_VAL_20_u2 0.9999847412109381 _CNV_A_R_LINEAR_____68_CM 0. 0.9999847412109381 DISPLAY_IDENTIFIER C_LAM_MV_CRLC_LDC_VLS_DIF_DLY FORMAT "%7.5" /end CHARACTERISTIC
/begin CHARACTERISTIC c_maf_int_min_vls_dif_dly_ldc "Maximum value of the mass air flow integral after limited dynamic conditions were fulfilled" VALUE 0xa100212a _REC_VAL_20_u2 1389. _CNV_A_R_LINEAR_____357_CM 0. 1389. DISPLAY_IDENTIFIER C_MAF_INT_MIN_VLS_DIF_DLY_LDC FORMAT "%7.2" /end CHARACTERISTIC
/begin CHARACTERISTIC c_maf_int_rst_vls_down_dif_diag "Threshold for integral to start a new diagnostic cycle and to set the end flag" VALUE 0xa1002138 _REC_VAL_20_u2 1820.42 _CNV_A_R_LINEAR_____356_CM 0. 1820.42 DISPLAY_IDENTIFIER C_MAF_INT_RST_VLS_DOWN_DIF_DIAG FORMAT "%7.2" /end CHARACTERISTIC
/begin CHARACTERISTIC c_t_sum_max_max_delta_i_lam "Duration of T_SUM_MAX_DELTA_I_LAM[i] to detect an error" VALUE 0xa10021fa _REC_VAL_20_u2 65535. _CNV_A_R_LINEAR_____35_CM 0. 65535. DISPLAY_IDENTIFIER C_T_SUM_MAX_MAX_DELTA_I_LAM FORMAT "%5.0" /end CHARACTERISTIC
/begin CHARACTERISTIC c_t_sum_min_max_delta_i_lam "Duration of T_SUM_MIN_DELTA_I_LAM[i] to detect an error" VALUE 0xa10021fc _REC_VAL_20_u2 65535. _CNV_A_R_LINEAR_____35_CM 0. 65535. DISPLAY_IDENTIFIER C_T_SUM_MIN_MAX_DELTA_I_LAM FORMAT "%5.0" /end CHARACTERISTIC
/begin CHARACTERISTIC c_t_sum_rst_max_delta_i_lam "Time counter to reset T_SUM_MIN/MAX_DELTA_I_LAM[i]" VALUE 0xa1002200 _REC_VAL_20_u2 65535. _CNV_A_R_LINEAR_____35_CM 0. 65535. DISPLAY_IDENTIFIER C_T_SUM_RST_MAX_DELTA_I_LAM FORMAT "%5.0" /end CHARACTERISTIC
/begin CHARACTERISTIC c_t_sum_max_err_delta_i_lam "Time counter for maximum time of trim control over limit to set LV_END_DIAG_DELTA_I_LAM[i]" VALUE 0xa10021f8 _REC_VAL_20_u2 65535. _CNV_A_R_LINEAR_____35_CM 0. 65535. DISPLAY_IDENTIFIER C_T_SUM_MAX_ERR_DELTA_I_LAM FORMAT "%5.0" /end CHARACTERISTIC
/begin CHARACTERISTIC c_t_sum_ready_delta_i_lam "Time counter for end of diagnosis" VALUE 0xa10021fe _REC_VAL_20_u2 65535. _CNV_A_R_LINEAR_____35_CM 0. 65535. DISPLAY_IDENTIFIER C_T_SUM_READY_DELTA_I_LAM FORMAT "%5.0" /end CHARACTERISTIC
/begin CHARACTERISTIC c_cat_diag_max_delta_i_lam "Maximum threshold for catalyst diagnosis result to perform the diagnosis" VALUE 0xa100202a _REC_VAL_20_u1 1.9921875 _CNV_A_R_LINEAR_____100_CM 0. 1.9921875 DISPLAY_IDENTIFIER C_CAT_DIAG_MAX_DELTA_I_LAM FORMAT "%8.6" /end CHARACTERISTIC
/begin MEASUREMENT lv_err_delta_i_lam_2 "Trim controller limit error" UBYTE _CNV_S_2_RANGE__0___1_CM 1 100. 0. 1. DISPLAY_IDENTIFIER LV_ERR_DELTA_I_LAM_2 ECU_ADDRESS 0xd00034c1 BIT_MASK 0x1 /end MEASUREMENT
/begin MEASUREMENT lv_err_delta_i_lam_1 "Trim controller limit error" UBYTE _CNV_S_2_RANGE__0___1_CM 1 100. 0. 1. DISPLAY_IDENTIFIER LV_ERR_DELTA_I_LAM_1 ECU_ADDRESS 0xd00034a8 BIT_MASK 0x1 /end MEASUREMENT
/begin MEASUREMENT lv_err_vls_down_dif_1 "Trim controller deviation error" UBYTE _CNV_S_2_RANGE__0___1_CM 1 100. 0. 1. DISPLAY_IDENTIFIER LV_ERR_VLS_DOWN_DIF_1 ECU_ADDRESS 0xd000349b BIT_MASK 0x1 /end MEASUREMENT
/begin MEASUREMENT lv_err_vls_down_dif_2 "Trim controller deviation error" UBYTE _CNV_S_2_RANGE__0___1_CM 1 100. 0. 1. DISPLAY_IDENTIFIER LV_ERR_VLS_DOWN_DIF_2 ECU_ADDRESS 0xd00034b4 BIT_MASK 0x1 /end MEASUREMENT
/begin MEASUREMENT state_rbm_vls_down_dif[0] "RBM - Interface of VLS_DOWN_DIF monitor" UBYTE _CNV_A_R_LINEAR_____0_CM 1 100. 0. 7. DISPLAY_IDENTIFIER STATE_RBM_VLS_DOWN_DIF[1] ECU_ADDRESS 0xd0002dbc FORMAT "%1.0" /end MEASUREMENT
/begin MEASUREMENT state_rbm_vls_down_dif[1] "RBM - Interface of VLS_DOWN_DIF monitor" UBYTE _CNV_A_R_LINEAR_____0_CM 1 100. 0. 7. DISPLAY_IDENTIFIER STATE_RBM_VLS_DOWN_DIF[2] ECU_ADDRESS 0xd0002dbd FORMAT "%1.0" /end MEASUREMENT
/begin MEASUREMENT maf_int_diag_chg_ls_up "MAF integral value when  ERR_SYM_... ¹  \"NO_SYM\"" UWORD _CNV_A_R_LINEAR_____356_CM 1 100. 0. 1820.42 DISPLAY_IDENTIFIER MAF_INT_DIAG_CHG_LS_UP ECU_ADDRESS 0xc0001956 FORMAT "%7.2" /end MEASUREMENT
/begin MEASUREMENT maf_int_diag_chg_ls_down "MAF integral value when  ERR_SYM_... ¹  \"NO_SYM\"" UWORD _CNV_A_R_LINEAR_____356_CM 1 100. 0. 1820.42 DISPLAY_IDENTIFIER MAF_INT_DIAG_CHG_LS_DOWN ECU_ADDRESS 0xc0001954 FORMAT "%7.2" /end MEASUREMENT
/begin MEASUREMENT t_end_diag_chg_ls_up "Timer to set LV_END_... = 1" UWORD _CNV_A_R_LINEAR_____4_CM 1 100. 0. 6553.5 DISPLAY_IDENTIFIER T_END_DIAG_CHG_LS_UP ECU_ADDRESS 0xc0001960 FORMAT "%6.1" /end MEASUREMENT
/begin CHARACTERISTIC c_t_end_diag_chg_ls_up "Max. time to set LV_END_... = 1" VALUE 0xa10021c8 _REC_VAL_20_u2 6553.5 _CNV_A_R_LINEAR_____4_CM 0. 6553.5 DISPLAY_IDENTIFIER C_T_END_DIAG_CHG_LS_UP FORMAT "%6.1" /end CHARACTERISTIC
/begin CHARACTERISTIC c_maf_int_diag_chg_ls_up "Max. MAF integral value when  ERR_SYM_... ¹  \"NO_SYM\" " VALUE 0xa1002118 _REC_VAL_20_u2 1820.42 _CNV_A_R_LINEAR_____356_CM 0. 1820.42 DISPLAY_IDENTIFIER C_MAF_INT_DIAG_CHG_LS_UP FORMAT "%7.2" /end CHARACTERISTIC
/begin CHARACTERISTIC c_maf_int_diag_chg_ls_down "Max. MAF integral value when  ERR_SYM_... ¹  \"NO_SYM\" " VALUE 0xa1002116 _REC_VAL_20_u2 1820.42 _CNV_A_R_LINEAR_____356_CM 0. 1820.42 DISPLAY_IDENTIFIER C_MAF_INT_DIAG_CHG_LS_DOWN FORMAT "%7.2" /end CHARACTERISTIC
/begin CHARACTERISTIC c_fac_lam_lim_max_chg_ls_up "Max. Threshold to detect a interchanged sensor" VALUE 0xa100208e _REC_VAL_20_s2 99.99847412109381 _CNV_A_R_LINEAR_____110_CM -50. 49.9984741210938 DISPLAY_IDENTIFIER C_FAC_LAM_LIM_MAX_CHG_LS_UP FORMAT "%7.3" /end CHARACTERISTIC
/begin CHARACTERISTIC c_fac_lam_lim_min_chg_ls_up "Min. Threshold to detect a interchanged sensor" VALUE 0xa1002090 _REC_VAL_20_s2 99.99847412109381 _CNV_A_R_LINEAR_____110_CM -50. 49.9984741210938 DISPLAY_IDENTIFIER C_FAC_LAM_LIM_MIN_CHG_LS_UP FORMAT "%7.3" /end CHARACTERISTIC
/begin CHARACTERISTIC c_fac_int_chg_ls_up "Gain factor for the MAF integral" VALUE 0xa100208b _REC_VAL_20_u1 1.9921875 _CNV_A_R_LINEAR_____100_CM 0. 1.9921875 DISPLAY_IDENTIFIER C_FAC_INT_CHG_LS_UP FORMAT "%8.6" /end CHARACTERISTIC
/begin CHARACTERISTIC c_vls_down_max_chg_ls_down "Max. Threshold to detect a interchanged sensor" VALUE 0xa1002292 _REC_VAL_20_u2 4.9951171875 _CNV_A_R_LINEAR_____2_CM 0. 4.9951171875 DISPLAY_IDENTIFIER C_VLS_DOWN_MAX_CHG_LS_DOWN FORMAT "%5.3" /end CHARACTERISTIC
/begin CHARACTERISTIC c_vls_down_min_chg_ls_down "Min. Threshold to detect a interchanged sensor" VALUE 0xa1002294 _REC_VAL_20_u2 4.9951171875 _CNV_A_R_LINEAR_____2_CM 0. 4.9951171875 DISPLAY_IDENTIFIER C_VLS_DOWN_MIN_CHG_LS_DOWN FORMAT "%5.3" /end CHARACTERISTIC
/begin CHARACTERISTIC c_fac_int_chg_ls_down "Gain factor for the MAF integral" VALUE 0xa100208a _REC_VAL_20_u1 1.9921875 _CNV_A_R_LINEAR_____100_CM 0. 1.9921875 DISPLAY_IDENTIFIER C_FAC_INT_CHG_LS_DOWN FORMAT "%8.6" /end CHARACTERISTIC
/begin MEASUREMENT lv_err_chg_ls_up "Debounced error: upstream sensor of banks 1and 2 interchanged" UBYTE _CNV_S_2_RANGE__0___1_CM 1 100. 0. 1. DISPLAY_IDENTIFIER LV_ERR_CHG_LS_UP ECU_ADDRESS 0xd00034c3 BIT_MASK 0x1 /end MEASUREMENT
/begin MEASUREMENT lv_ls_down_cdn_diag_chg "Condition to run the diagnosis are fullfiled" UBYTE _CNV_S_2_RANGE__0___1_CM 1 100. 0. 1. DISPLAY_IDENTIFIER LV_LS_DOWN_CDN_DIAG_CHG ECU_ADDRESS 0xc000196c BIT_MASK 0x1 /end MEASUREMENT
/begin MEASUREMENT lv_inh_diag_chg_ls_up "Inhibit diagnosis interchanged upstream sensors" UBYTE _CNV_S_2_RANGE__0___1_CM 1 100. 0. 1. DISPLAY_IDENTIFIER LV_INH_DIAG_CHG_LS_UP ECU_ADDRESS 0xd0002da1 BIT_MASK 0x1 /end MEASUREMENT
/begin MEASUREMENT lv_inh_diag_rbm_chg_ls_up "Inhibitation of interchanged upstreamsensors caused by other errors" UBYTE _CNV_S_2_RANGE__0___1_CM 1 100. 0. 1. DISPLAY_IDENTIFIER LV_INH_DIAG_RBM_CHG_LS_UP ECU_ADDRESS 0xd0002da3 BIT_MASK 0x1 /end MEASUREMENT
/begin MEASUREMENT lv_inh_diag_chg_ls_down "Inhibit diagnosis interchanged upstream sensors" UBYTE _CNV_S_2_RANGE__0___1_CM 1 100. 0. 1. DISPLAY_IDENTIFIER LV_INH_DIAG_CHG_LS_DOWN ECU_ADDRESS 0xd0002da0 BIT_MASK 0x1 /end MEASUREMENT
/begin MEASUREMENT state_rbm_chg_ls_up "Interface of CHG_LS_UP monitor with the Rate-Based Monitoring statistics" UBYTE _CNV_A_R_LINEAR_____0_CM 1 100. 0. 255. DISPLAY_IDENTIFIER STATE_RBM_CHG_LS_UP ECU_ADDRESS 0xd0002db8 FORMAT "%3.0" /end MEASUREMENT
/begin CHARACTERISTIC c_maf_int_diag_ls_up_down "Minimum threshold for MAF integral required to start active test" VALUE 0xa100211a _REC_VAL_20_u2 1820.42 _CNV_A_R_LINEAR_____356_CM 0. 1820.42 DISPLAY_IDENTIFIER C_MAF_INT_DIAG_LS_UP_DOWN FORMAT "%7.2" /end CHARACTERISTIC
/begin CHARACTERISTIC c_t_max_diag_afr_ls_up_down "Timer threshold for plausibility test under rich AF conditions" VALUE 0xa10021dc _REC_VAL_20_u2 6553.5 _CNV_A_R_LINEAR_____4_CM 0. 6553.5 DISPLAY_IDENTIFIER C_T_MAX_DIAG_AFR_LS_UP_DOWN FORMAT "%6.1" /end CHARACTERISTIC
/begin CHARACTERISTIC c_t_max_diag_afl_ls_up_down "Timer threshold for plausibility test under lean AF conditions" VALUE 0xa10021da _REC_VAL_20_u2 6553.5 _CNV_A_R_LINEAR_____4_CM 0. 6553.5 DISPLAY_IDENTIFIER C_T_MAX_DIAG_AFL_LS_UP_DOWN FORMAT "%6.1" /end CHARACTERISTIC
/begin CHARACTERISTIC c_t_diag_eol_ls_up_down "Initialization of timer in case EOL to reduce the required minimum activity test time" VALUE 0xa100218c _REC_VAL_20_u2 6553.5 _CNV_A_R_LINEAR_____4_CM 0. 6553.5 DISPLAY_IDENTIFIER C_T_DIAG_EOL_LS_UP_DOWN FORMAT "%6.1" /end CHARACTERISTIC
/begin CHARACTERISTIC c_maf_int_eol_diag_ls_up_down "Initialization of MAF integral to reduce required minimum MAF value to start active test" VALUE 0xa1002120 _REC_VAL_20_u2 1820.42 _CNV_A_R_LINEAR_____356_CM 0. 1820.42 DISPLAY_IDENTIFIER C_MAF_INT_EOL_DIAG_LS_UP_DOWN FORMAT "%7.2" /end CHARACTERISTIC
/begin CHARACTERISTIC c_lamb_afl_min_diag_ls_up_down "Min. lambda set point for lean fault detection " VALUE 0xa10020c2 _REC_VAL_20_u2 31.9990234375 _CNV_A_R_LINEAR_____122_CM 0. 31.9990234375 DISPLAY_IDENTIFIER C_LAMB_AFL_MIN_DIAG_LS_UP_DOWN FORMAT "%7.4" /end CHARACTERISTIC
/begin CHARACTERISTIC c_lamb_afl_max_diag_ls_up_down "Max. lambda set point for lean fault detection " VALUE 0xa10020c0 _REC_VAL_20_u2 31.9990234375 _CNV_A_R_LINEAR_____122_CM 0. 31.9990234375 DISPLAY_IDENTIFIER C_LAMB_AFL_MAX_DIAG_LS_UP_DOWN FORMAT "%7.4" /end CHARACTERISTIC
/begin CHARACTERISTIC c_lamb_afr_min_diag_ls_up_down "Min. lambda set point for rich fault detection " VALUE 0xa10020ca _REC_VAL_20_u2 31.9990234375 _CNV_A_R_LINEAR_____122_CM 0. 31.9990234375 DISPLAY_IDENTIFIER C_LAMB_AFR_MIN_DIAG_LS_UP_DOWN FORMAT "%7.4" /end CHARACTERISTIC
/begin CHARACTERISTIC c_lamb_afr_max_diag_ls_up_down "Max. lambda set point for rich fault detection " VALUE 0xa10020c8 _REC_VAL_20_u2 31.9990234375 _CNV_A_R_LINEAR_____122_CM 0. 31.9990234375 DISPLAY_IDENTIFIER C_LAMB_AFR_MAX_DIAG_LS_UP_DOWN FORMAT "%7.4" /end CHARACTERISTIC
/begin CHARACTERISTIC c_vls_afr_thd_diag_act_ls_down "VLS voltage threshold for rich fault detection (downstream sensor)" VALUE 0xa1002278 _REC_VAL_20_u2 4.9951171875 _CNV_A_R_LINEAR_____2_CM 0. 4.9951171875 DISPLAY_IDENTIFIER C_VLS_AFR_THD_DIAG_ACT_LS_DOWN FORMAT "%5.3" /end CHARACTERISTIC
/begin CHARACTERISTIC c_vls_afl_thd_diag_act_ls_down "VLS voltage threshold for lean fault detection (downstream sensor)" VALUE 0xa1002274 _REC_VAL_20_u2 4.9951171875 _CNV_A_R_LINEAR_____2_CM 0. 4.9951171875 DISPLAY_IDENTIFIER C_VLS_AFL_THD_DIAG_ACT_LS_DOWN FORMAT "%5.3" /end CHARACTERISTIC
/begin CHARACTERISTIC c_lamb_sp_afr_diag_ls_up_down "Lambda set point for rich fault detection " VALUE 0xa10020f4 _REC_VAL_20_u2 31.9990234375 _CNV_A_R_LINEAR_____122_CM 0. 31.9990234375 DISPLAY_IDENTIFIER C_LAMB_SP_AFR_DIAG_LS_UP_DOWN FORMAT "%7.4" /end CHARACTERISTIC
/begin CHARACTERISTIC c_lamb_sp_afl_diag_ls_up_down "Lambda set point for lean fault detection " VALUE 0xa10020f0 _REC_VAL_20_u2 31.9990234375 _CNV_A_R_LINEAR_____122_CM 0. 31.9990234375 DISPLAY_IDENTIFIER C_LAMB_SP_AFL_DIAG_LS_UP_DOWN FORMAT "%7.4" /end CHARACTERISTIC
/begin CHARACTERISTIC c_lamb_sp_step_diag_ls_up_down "Number of recurrences to achieve the desired lambda set point" VALUE 0xa1002100 _REC_VAL_20_u1 254. _CNV_A_R_LINEAR_____0_CM 1. 255. DISPLAY_IDENTIFIER C_LAMB_SP_STEP_DIAG_LS_UP_DOWN FORMAT "%3.0" /end CHARACTERISTIC
/begin MEASUREMENT lv_err_chk_ls_down_2 "Debounced failure in the downstream sensor " UBYTE _CNV_S_2_RANGE__0___1_CM 1 100. 0. 1. DISPLAY_IDENTIFIER LV_ERR_CHK_LS_DOWN[2] ECU_ADDRESS 0xd00034bd BIT_MASK 0x1 /end MEASUREMENT
/begin CHARACTERISTIC lc_diag_auth_chk_ls_up_down "Boolean switch allowing the active test" VALUE 0xa10022d7 _REC_VAL_20_u1 1. _CNV_A_R_LINEAR_____0_CM 0. 1. DISPLAY_IDENTIFIER LC_DIAG_AUTH_CHK_LS_UP_DOWN FORMAT "%1.0" /end CHARACTERISTIC
/begin CHARACTERISTIC c_abc_inc_chk_lsl_up "Increment for debounce algorithmus" VALUE 0xa1002014 _REC_VAL_20_u1 255. _CNV_A_R_LINEAR_____0_CM 0. 255. DISPLAY_IDENTIFIER C_ABC_INC_CHK_LSL_UP FORMAT "%3.0" /end CHARACTERISTIC
/begin CHARACTERISTIC c_lamb_afr_thd_diag_act_lsl_up "Lambda value threshold for rich fault detection (upstream sensor)" VALUE 0xa10020ce _REC_VAL_20_u2 31.9990234375 _CNV_A_R_LINEAR_____122_CM 0. 31.9990234375 DISPLAY_IDENTIFIER C_LAMB_AFR_THD_DIAG_ACT_LSL_UP FORMAT "%7.4" /end CHARACTERISTIC
/begin CHARACTERISTIC c_lamb_afl_thd_diag_act_lsl_up "Lambda value threshold for lean fault detection (upstream sensor)" VALUE 0xa10020c6 _REC_VAL_20_u2 31.9990234375 _CNV_A_R_LINEAR_____122_CM 0. 31.9990234375 DISPLAY_IDENTIFIER C_LAMB_AFL_THD_DIAG_ACT_LSL_UP FORMAT "%7.4" /end CHARACTERISTIC
/begin CHARACTERISTIC c_ctr_sum_rst_afr_chk_lsl_up "Reset debounce counter for Richt test" VALUE 0xa1002066 _REC_VAL_20_u2 65535. _CNV_A_R_LINEAR_____0_CM 0. 65535. DISPLAY_IDENTIFIER C_CTR_SUM_RST_AFR_CHK_LSL_UP FORMAT "%5.0" /end CHARACTERISTIC
/begin CHARACTERISTIC c_ctr_sum_rst_afl_chk_lsl_up "Reset debounce counter for Lean test" VALUE 0xa1002064 _REC_VAL_20_u2 65535. _CNV_A_R_LINEAR_____0_CM 0. 65535. DISPLAY_IDENTIFIER C_CTR_SUM_RST_AFL_CHK_LSL_UP FORMAT "%5.0" /end CHARACTERISTIC
/begin CHARACTERISTIC c_abc_max_chk_lsl_up "Maximum value for debounce algorithmus" VALUE 0xa100201e _REC_VAL_20_u2 65535. _CNV_A_R_LINEAR_____0_CM 0. 65535. DISPLAY_IDENTIFIER C_ABC_MAX_CHK_LSL_UP FORMAT "%5.0" /end CHARACTERISTIC
/begin MEASUREMENT lv_err_chk_ls_down_1 "Debounced failure in the downstream sensor " UBYTE _CNV_S_2_RANGE__0___1_CM 1 100. 0. 1. DISPLAY_IDENTIFIER LV_ERR_CHK_LS_DOWN[1] ECU_ADDRESS 0xd00034a4 BIT_MASK 0x1 /end MEASUREMENT
/begin MEASUREMENT lv_err_chg_ls_down "Debounced failure of downstream lambda sensors interchanged " UBYTE _CNV_S_2_RANGE__0___1_CM 1 100. 0. 1. DISPLAY_IDENTIFIER LV_ERR_CHG_LS_DOWN ECU_ADDRESS 0xd00034aa BIT_MASK 0x1 /end MEASUREMENT
/begin CHARACTERISTIC c_t_max_chk_ls_down "Time to debounce the error" VALUE 0xa10021d8 _REC_VAL_20_u2 6553.5 _CNV_A_R_LINEAR_____4_CM 0. 6553.5 DISPLAY_IDENTIFIER C_T_MAX_CHK_LS_DOWN FORMAT "%6.1" /end CHARACTERISTIC
/begin CHARACTERISTIC c_t_end_diag_act_ls_down "Timer threshold for the end of the downstream sensor active test in the no failure case" VALUE 0xa10021c4 _REC_VAL_20_u2 6553.5 _CNV_A_R_LINEAR_____4_CM 0. 6553.5 DISPLAY_IDENTIFIER C_T_END_DIAG_ACT_LS_DOWN FORMAT "%6.1" /end CHARACTERISTIC
/begin MEASUREMENT state_rbm_chk_ls_down[0] "RBM - Interface of CHK_LS_DOWN monitor" UBYTE _CNV_A_R_LINEAR_____0_CM 1 100. 0. 7. DISPLAY_IDENTIFIER STATE_RBM_CHK_LS_DOWN[1] ECU_ADDRESS 0xd0002dba FORMAT "%1.0" /end MEASUREMENT
/begin MEASUREMENT state_rbm_chk_ls_down[1] "RBM - Interface of CHK_LS_DOWN monitor" UBYTE _CNV_A_R_LINEAR_____0_CM 1 100. 0. 7. DISPLAY_IDENTIFIER STATE_RBM_CHK_LS_DOWN[2] ECU_ADDRESS 0xd0002dbb FORMAT "%1.0" /end MEASUREMENT
/begin MEASUREMENT lv_err_lsl_up_if_1 "Present error in the CJ120 WRAF sensor controller" UBYTE _CNV_S_2_RANGE__0___1_CM 1 100. 0. 1. DISPLAY_IDENTIFIER LV_ERR_LSL_UP_IF[1] ECU_ADDRESS 0xd0003497 BIT_MASK 0x1 /end MEASUREMENT
/begin CHARACTERISTIC c_ctr_max_spi_com_lsl_up[0] "Max. allowed number of SPI comunication errors" VALUE 0xa100205c _REC_VAL_20_u1 255. _CNV_A_R_LINEAR_____0_CM 0. 255. DISPLAY_IDENTIFIER C_CTR_MAX_SPI_COM_LSL_UP[1] FORMAT "%3.0" /end CHARACTERISTIC
/begin CHARACTERISTIC c_ctr_max_spi_com_lsl_up[1] "Max. allowed number of SPI comunication errors" VALUE 0xa100205d _REC_VAL_20_u1 255. _CNV_A_R_LINEAR_____0_CM 0. 255. DISPLAY_IDENTIFIER C_CTR_MAX_SPI_COM_LSL_UP[2] FORMAT "%3.0" /end CHARACTERISTIC
/begin CHARACTERISTIC c_t_rst_max_diag_lsl_up_if[0] "Max. waiting time for the initialization of the WRAF sensor controller" VALUE 0xa10021f2 _REC_VAL_20_u2 655.35 _CNV_A_R_LINEAR_____3_CM 0. 655.35 DISPLAY_IDENTIFIER C_T_RST_MAX_DIAG_LSL_UP_IF[1] FORMAT "%6.2" /end CHARACTERISTIC
/begin CHARACTERISTIC c_t_rst_max_diag_lsl_up_if[1] "Max. waiting time for the initialization of the WRAF sensor controller" VALUE 0xa10021f4 _REC_VAL_20_u2 655.35 _CNV_A_R_LINEAR_____3_CM 0. 655.35 DISPLAY_IDENTIFIER C_T_RST_MAX_DIAG_LSL_UP_IF[2] FORMAT "%6.2" /end CHARACTERISTIC
/begin CHARACTERISTIC c_t_end_diag_lsl_up_if[0] "Time to diagnostic availability" VALUE 0xa10021ca _REC_VAL_20_u2 655.35 _CNV_A_R_LINEAR_____3_CM 0. 655.35 DISPLAY_IDENTIFIER C_T_END_DIAG_LSL_UP_IF[1] FORMAT "%6.2" /end CHARACTERISTIC
/begin CHARACTERISTIC c_t_end_diag_lsl_up_if[1] "Time to diagnostic availability" VALUE 0xa10021cc _REC_VAL_20_u2 655.35 _CNV_A_R_LINEAR_____3_CM 0. 655.35 DISPLAY_IDENTIFIER C_T_END_DIAG_LSL_UP_IF[2] FORMAT "%6.2" /end CHARACTERISTIC
/begin MEASUREMENT lv_err_lsl_up_if_2 "Present error in the CJ120 WRAF sensor controller" UBYTE _CNV_S_2_RANGE__0___1_CM 1 100. 0. 1. DISPLAY_IDENTIFIER LV_ERR_LSL_UP_IF[2] ECU_ADDRESS 0xd00034b0 BIT_MASK 0x1 /end MEASUREMENT
/begin CHARACTERISTIC c_tco_min_diag_mpl_ls_down "Minimum coolant temperature for diagnosis of the monitor sensors" VALUE 0xa1002217 _REC_VAL_20_u1 190.5 _CNV_A_R_LINEAR_____16_CM -48. 142.5 DISPLAY_IDENTIFIER C_TCO_MIN_DIAG_MPL_LS_DOWN FORMAT "%6.2" /end CHARACTERISTIC
/begin CHARACTERISTIC c_vs_min_diag_mpl_ls_down "Minimum vehicle speed for diagnosis of the monitor sensors" VALUE 0xa10022d2 _REC_VAL_20_u1 255. _CNV_A_R_LINEAR_____6_CM 0. 255. DISPLAY_IDENTIFIER C_VS_MIN_DIAG_MPL_LS_DOWN FORMAT "%3.0" /end CHARACTERISTIC
/begin CHARACTERISTIC c_vs_max_diag_mpl_ls_down "Maximum vehicle speed for diagnosis of the monitor sensors" VALUE 0xa10022d1 _REC_VAL_20_u1 255. _CNV_A_R_LINEAR_____6_CM 0. 255. DISPLAY_IDENTIFIER C_VS_MAX_DIAG_MPL_LS_DOWN FORMAT "%3.0" /end CHARACTERISTIC
/begin CHARACTERISTIC c_temp_cat_min_diag_mpl_ls_down "Catalyst temperature threshold for diagnosis of the monitor sensors" VALUE 0xa1002236 _REC_VAL_20_u2 2047.9375 _CNV_A_R_LINEAR_____204_CM -273.15 1774.7875 DISPLAY_IDENTIFIER C_TEMP_CAT_MIN_DIAG_MPL_LS_DOWN FORMAT "%9.4" /end CHARACTERISTIC
/begin MEASUREMENT maf_kgh_min_puc "Minimum value of MAF_KGH while switching time calculation" UWORD _CNV_A_R_LINEAR_____207_CM 1 100. 0. 2047.96875 DISPLAY_IDENTIFIER MAF_KGH_MIN_PUC ECU_ADDRESS 0xc000195a FORMAT "%10.5" /end MEASUREMENT
/begin AXIS_PTS ldp_maf_kgh_ip_fac_ls_down "" 0xa1001950 maf_kgh _REC_AXS_20_u2 2047.96875 _CNV_A_R_LINEAR_____207_CM 8 0. 2047.96875 FORMAT "%10.5" /end AXIS_PTS
/begin CHARACTERISTIC ip_fac_cycnr_max_ls_down_act "Weighting factor for CTR_SWT_ACT_LS_DOWN[NC_CBK_EX_NR]" CURVE 0xa1001c58 _REC_CUR_20_u1_u2 5100. _CNV_A_R_LINEAR_____22_CM 0. 5100. DISPLAY_IDENTIFIER IP_FAC_CYCNR_MAX_LS_DOWN_ACT FORMAT "%4.0"
 /begin AXIS_DESCR COM_AXIS maf_kgh _CNV_A_R_LINEAR_____207_CM 8 0. 2047.96875 FORMAT "%10.5" AXIS_PTS_REF ldp_maf_kgh_ip_fac_ls_down /end AXIS_DESCR
/end CHARACTERISTIC
/begin CHARACTERISTIC c_maf_int_puc_diag_pue_ls_down "Threshold for activation of the diagnosis" VALUE 0xa100212c _REC_VAL_20_u2 2912.666666666671 _CNV_A_R_LINEAR_____329_CM 0. 2912.66666666667 DISPLAY_IDENTIFIER C_MAF_INT_PUC_DIAG_PUE_LS_DOWN FORMAT "%7.2" /end CHARACTERISTIC
/begin CHARACTERISTIC c_maf_int_diag_pue_ls_down "Threshold for start of the diagnosis" VALUE 0xa100211e _REC_VAL_20_u2 2912.666666666671 _CNV_A_R_LINEAR_____329_CM 0. 2912.66666666667 DISPLAY_IDENTIFIER C_MAF_INT_DIAG_PUE_LS_DOWN FORMAT "%7.2" /end CHARACTERISTIC
/begin CHARACTERISTIC c_ctr_swt_diag_ls_down "Condition for the start of the lambda sensor switching time check" VALUE 0xa1002068 _REC_VAL_20_u1 255. _CNV_A_R_LINEAR_____0_CM 0. 255. DISPLAY_IDENTIFIER C_CTR_SWT_DIAG_LS_DOWN FORMAT "%3.0" /end CHARACTERISTIC
/begin CHARACTERISTIC c_ctr_sym_inc_diag_pue_ls_down "Counter increment for PUE_VLS_DOWN diagnosis" VALUE 0xa100206d _REC_VAL_20_u1 255. _CNV_A_R_LINEAR_____0_CM 0. 255. DISPLAY_IDENTIFIER C_CTR_SYM_INC_DIAG_PUE_LS_DOWN FORMAT "%3.0" /end CHARACTERISTIC
/begin CHARACTERISTIC c_ctr_sym_max_diag_pue_ls_down "Maximum value of  counter for PUE_VLS_DOWN diagnosis" VALUE 0xa100206f _REC_VAL_20_u1 255. _CNV_A_R_LINEAR_____0_CM 0. 255. DISPLAY_IDENTIFIER C_CTR_SYM_MAX_DIAG_PUE_LS_DOWN FORMAT "%3.0" /end CHARACTERISTIC
/begin CHARACTERISTIC c_vls_dif_min_diag_pue_ls_down "Threshold for VLS_DIF_DIAG_PUE_LS_DOWN[NC_CBK_EX_NR]" VALUE 0xa1002280 _REC_VAL_20_u2 4.9951171875 _CNV_A_R_LINEAR_____2_CM 0. 4.9951171875 DISPLAY_IDENTIFIER C_VLS_DIF_MIN_DIAG_PUE_LS_DOWN FORMAT "%5.3" /end CHARACTERISTIC
/begin CHARACTERISTIC c_ctr_swt_ls_down "Diagnostic threshold for CTR_CYCNR_SWT_LS_DOWN[NC_CBK_EX_NR]" VALUE 0xa1002069 _REC_VAL_20_u1 1.9921875 _CNV_A_R_LINEAR_____100_CM 0. 1.9921875 DISPLAY_IDENTIFIER C_CTR_SWT_LS_DOWN FORMAT "%8.6" /end CHARACTERISTIC
/begin CHARACTERISTIC c_maf_puc_max_diag_swt_ls_down "Mass air flow threshold for diagnosis of the switching times" VALUE 0xa1002154 _REC_VAL_20_u2 2047.96875 _CNV_A_R_LINEAR_____207_CM 0. 2047.96875 DISPLAY_IDENTIFIER C_MAF_PUC_MAX_DIAG_SWT_LS_DOWN FORMAT "%10.5" /end CHARACTERISTIC
/begin CHARACTERISTIC c_maf_puc_min_diag_swt_ls_down "Mass air flow threshold for diagnosis of the switching times" VALUE 0xa1002156 _REC_VAL_20_u2 2047.96875 _CNV_A_R_LINEAR_____207_CM 0. 2047.96875 DISPLAY_IDENTIFIER C_MAF_PUC_MIN_DIAG_SWT_LS_DOWN FORMAT "%10.5" /end CHARACTERISTIC
/begin CHARACTERISTIC c_fac_vls_max_diag_swt_ls_down "Reduction factor for start of switching time determination" VALUE 0xa10020a4 _REC_VAL_20_u1 0.99609375 _CNV_A_R_LINEAR_____27_CM 0. 0.99609375 DISPLAY_IDENTIFIER C_FAC_VLS_MAX_DIAG_SWT_LS_DOWN FORMAT "%5.3" /end CHARACTERISTIC
/begin CHARACTERISTIC c_vls_hys_diag_swt_ls_down "Monitor sensor voltage hysteresis" VALUE 0xa10022a4 _REC_VAL_20_u2 4.9951171875 _CNV_A_R_LINEAR_____2_CM 0. 4.9951171875 DISPLAY_IDENTIFIER C_VLS_HYS_DIAG_SWT_LS_DOWN FORMAT "%5.3" /end CHARACTERISTIC
/begin CHARACTERISTIC c_vls_puc_min_diag_swt_ls_down "Voltage threshold for monitor sensor diagnosis" VALUE 0xa10022b8 _REC_VAL_20_u2 4.9951171875 _CNV_A_R_LINEAR_____2_CM 0. 4.9951171875 DISPLAY_IDENTIFIER C_VLS_PUC_MIN_DIAG_SWT_LS_DOWN FORMAT "%5.3" /end CHARACTERISTIC
/begin CHARACTERISTIC c_fac_vls_min_diag_swt_ls_down "Reduction factor for end of switching time determination" VALUE 0xa10020a5 _REC_VAL_20_u1 0.99609375 _CNV_A_R_LINEAR_____27_CM 0. 0.99609375 DISPLAY_IDENTIFIER C_FAC_VLS_MIN_DIAG_SWT_LS_DOWN FORMAT "%5.3" /end CHARACTERISTIC
/begin CHARACTERISTIC c_ctr_end_diag_pue_ls_down "Counter threshold for CTR_END_DIAG_PUE_LS_DOWN[NC_CBK_EX_NR]" VALUE 0xa100204a _REC_VAL_20_u2 65535. _CNV_A_R_LINEAR_____0_CM 0. 65535. DISPLAY_IDENTIFIER C_CTR_END_DIAG_PUE_LS_DOWN FORMAT "%5.0" /end CHARACTERISTIC
/begin MEASUREMENT lv_err_pue_ls_down_1 "Debounced diagnosis result of pull end plausibility" UBYTE _CNV_S_2_RANGE__0___1_CM 1 100. 0. 1. DISPLAY_IDENTIFIER LV_ERR_PUE_LS_DOWN[1] ECU_ADDRESS 0xd000349e BIT_MASK 0x1 /end MEASUREMENT
/begin MEASUREMENT lv_err_pue_ls_down_2 "Debounced diagnosis result of pull end plausibility" UBYTE _CNV_S_2_RANGE__0___1_CM 1 100. 0. 1. DISPLAY_IDENTIFIER LV_ERR_PUE_LS_DOWN[2] ECU_ADDRESS 0xd00034b7 BIT_MASK 0x1 /end MEASUREMENT
/begin MEASUREMENT lv_err_swt_ls_down_1 "Error bit of the switching time diagnosis" UBYTE _CNV_S_2_RANGE__0___1_CM 1 100. 0. 1. DISPLAY_IDENTIFIER LV_ERR_SWT_LS_DOWN[1] ECU_ADDRESS 0xd000349f BIT_MASK 0x1 /end MEASUREMENT
/begin MEASUREMENT lv_err_swt_ls_down_2 "Error bit of the switching time diagnosis" UBYTE _CNV_S_2_RANGE__0___1_CM 1 100. 0. 1. DISPLAY_IDENTIFIER LV_ERR_SWT_LS_DOWN[2] ECU_ADDRESS 0xd00034b8 BIT_MASK 0x1 /end MEASUREMENT
/begin CHARACTERISTIC c_abc_max_scg_ls_down "Debounce counter maximum for short to ground electrical check" VALUE 0xa1002026 _REC_VAL_20_u1 255. _CNV_A_R_LINEAR_____0_CM 0. 255. DISPLAY_IDENTIFIER C_ABC_MAX_SCG_LS_DOWN FORMAT "%3.0" /end CHARACTERISTIC
/begin CHARACTERISTIC c_abc_inc_scg_ls_down "Debounce counter increment for short to ground electrical check" VALUE 0xa100201b _REC_VAL_20_u1 255. _CNV_A_R_LINEAR_____0_CM 0. 255. DISPLAY_IDENTIFIER C_ABC_INC_SCG_LS_DOWN FORMAT "%3.0" /end CHARACTERISTIC
/begin CHARACTERISTIC c_abc_inc_oc_ls_down "Debounce counter increment for open line electrical check" VALUE 0xa1002019 _REC_VAL_20_u1 255. _CNV_A_R_LINEAR_____0_CM 0. 255. DISPLAY_IDENTIFIER C_ABC_INC_OC_LS_DOWN FORMAT "%3.0" /end CHARACTERISTIC
/begin CHARACTERISTIC c_abc_max_oc_ls_down "Debounce counter maximum for open line electrical check" VALUE 0xa1002024 _REC_VAL_20_u1 255. _CNV_A_R_LINEAR_____0_CM 0. 255. DISPLAY_IDENTIFIER C_ABC_MAX_OC_LS_DOWN FORMAT "%3.0" /end CHARACTERISTIC
/begin CHARACTERISTIC c_abc_max_scp_ls_down "Debounce counter maximum for short to plus electrical check" VALUE 0xa1002027 _REC_VAL_20_u1 255. _CNV_A_R_LINEAR_____0_CM 0. 255. DISPLAY_IDENTIFIER C_ABC_MAX_SCP_LS_DOWN FORMAT "%3.0" /end CHARACTERISTIC
/begin CHARACTERISTIC c_abc_inc_scp_ls_down "Debounce counter increment  for short to plus electrical check" VALUE 0xa100201c _REC_VAL_20_u1 255. _CNV_A_R_LINEAR_____0_CM 0. 255. DISPLAY_IDENTIFIER C_ABC_INC_SCP_LS_DOWN FORMAT "%3.0" /end CHARACTERISTIC
/begin CHARACTERISTIC c_abc_inc_puc_ls_down "Debounce counter increment for PUC plausibility" VALUE 0xa100201a _REC_VAL_20_u1 255. _CNV_A_R_LINEAR_____0_CM 0. 255. DISPLAY_IDENTIFIER C_ABC_INC_PUC_LS_DOWN FORMAT "%3.0" /end CHARACTERISTIC
/begin CHARACTERISTIC c_abc_inc_fl_ls_down "Debounce counter increment for FL plausibility" VALUE 0xa1002016 _REC_VAL_20_u1 255. _CNV_A_R_LINEAR_____0_CM 0. 255. DISPLAY_IDENTIFIER C_ABC_INC_FL_LS_DOWN FORMAT "%3.0" /end CHARACTERISTIC
/begin CHARACTERISTIC c_abc_max_puc_ls_down "Debounce counter maximum for PUC plausibility" VALUE 0xa1002025 _REC_VAL_20_u1 255. _CNV_A_R_LINEAR_____0_CM 0. 255. DISPLAY_IDENTIFIER C_ABC_MAX_PUC_LS_DOWN FORMAT "%3.0" /end CHARACTERISTIC
/begin CHARACTERISTIC c_abc_max_fl_ls_down "Debounce counter maximum for FL plausibility" VALUE 0xa1002021 _REC_VAL_20_u1 255. _CNV_A_R_LINEAR_____0_CM 0. 255. DISPLAY_IDENTIFIER C_ABC_MAX_FL_LS_DOWN FORMAT "%3.0" /end CHARACTERISTIC
/begin CHARACTERISTIC lc_inh_ls_down_man_deac "Manual deactivation of inhibit conditions (When = 1)" VALUE 0xa10022e2 _REC_VAL_20_u1 1. _CNV_S_2_RANGE__0___1_CM 0. 1. DISPLAY_IDENTIFIER LC_INH_LS_DOWN_MAN_DEAC /end CHARACTERISTIC
/begin MEASUREMENT lv_err_obd_vld_lsh_up_2 "Boolean flag indicating the validation of correspondent symptom (transmitted to the error management)" UBYTE _CNV_S_2_RANGE__0___1_CM 1 100. 0. 1. DISPLAY_IDENTIFIER LV_ERR_OBD_VLD_LSH_UP[2] ECU_ADDRESS 0xd00034bc BIT_MASK 0x1 /end MEASUREMENT
/begin MEASUREMENT lv_err_dyn_vld_ls_up_2 "Boolean flag indicating the validation of correspondent symptom (transmitted to the error management)" UBYTE _CNV_S_2_RANGE__0___1_CM 1 100. 0. 1. DISPLAY_IDENTIFIER LV_ERR_DYN_VLD_LS_UP[2] ECU_ADDRESS 0xd00034ba BIT_MASK 0x1 /end MEASUREMENT
/begin MEASUREMENT lv_err_obd_vld_lsh_up_1 "Boolean flag indicating the validation of correspondent symptom (transmitted to the error management)" UBYTE _CNV_S_2_RANGE__0___1_CM 1 100. 0. 1. DISPLAY_IDENTIFIER LV_ERR_OBD_VLD_LSH_UP[1] ECU_ADDRESS 0xd00034a3 BIT_MASK 0x1 /end MEASUREMENT
/begin CHARACTERISTIC lc_err_dyn_vld_ls_up "Allow Sensor Dynamic Fault to be considered as Sensor Failure (stops closed loop AF control)" VALUE 0xa10022dc _REC_VAL_20_u1 1. _CNV_A_R_LINEAR_____0_CM 0. 1. DISPLAY_IDENTIFIER LC_ERR_DYN_VLD_LS_UP FORMAT "%1.0" /end CHARACTERISTIC
/begin MEASUREMENT lv_err_dyn_vld_ls_up_1 "Boolean flag indicating the validation of correspondent symptom (transmitted to the error management)" UBYTE _CNV_S_2_RANGE__0___1_CM 1 100. 0. 1. DISPLAY_IDENTIFIER LV_ERR_DYN_VLD_LS_UP[1] ECU_ADDRESS 0xd00034a1 BIT_MASK 0x1 /end MEASUREMENT
/begin MEASUREMENT lv_err_shift_afl_lsl_up_1 "WRAF Sensor characteristic line shift to lean ERROR detected" UBYTE _CNV_S_2_RANGE__0___1_CM 1 100. 0. 1. DISPLAY_IDENTIFIER LV_ERR_SHIFT_AFL_LSL_UP[1] ECU_ADDRESS 0xd00034a5 BIT_MASK 0x1 /end MEASUREMENT
/begin MEASUREMENT lv_err_shift_afr_lsl_up_1 "WRAF Sensor characteristic line shift to rich ERROR detected" UBYTE _CNV_S_2_RANGE__0___1_CM 1 100. 0. 1. DISPLAY_IDENTIFIER LV_ERR_SHIFT_AFR_LSL_UP[1] ECU_ADDRESS 0xd00034a6 BIT_MASK 0x1 /end MEASUREMENT
/begin MEASUREMENT lv_err_shift_afl_lsl_up_2 "WRAF Sensor characteristic line shift to lean ERROR detected" UBYTE _CNV_S_2_RANGE__0___1_CM 1 100. 0. 1. DISPLAY_IDENTIFIER LV_ERR_SHIFT_AFL_LSL_UP[2] ECU_ADDRESS 0xd00034be BIT_MASK 0x1 /end MEASUREMENT
/begin MEASUREMENT lv_err_shift_afr_lsl_up_2 "WRAF Sensor characteristic line shift to rich ERROR detected" UBYTE _CNV_S_2_RANGE__0___1_CM 1 100. 0. 1. DISPLAY_IDENTIFIER LV_ERR_SHIFT_AFR_LSL_UP[2] ECU_ADDRESS 0xd00034bf BIT_MASK 0x1 /end MEASUREMENT
/begin CHARACTERISTIC lc_ls_up_obd_1_man_deac[0] "Logical calibration data for manual deactivation of all OBD1 diagnosis for upstream oxygen sensor" VALUE 0xa10022f6 _REC_VAL_20_u1 1. _CNV_A_R_LINEAR_____0_CM 0. 1. DISPLAY_IDENTIFIER LC_LS_UP_OBD_1_MAN_DEAC[1] FORMAT "%1.0" /end CHARACTERISTIC
/begin CHARACTERISTIC lc_ls_up_obd_1_man_deac[1] "Logical calibration data for manual deactivation of all OBD1 diagnosis for upstream oxygen sensor" VALUE 0xa10022f7 _REC_VAL_20_u1 1. _CNV_A_R_LINEAR_____0_CM 0. 1. DISPLAY_IDENTIFIER LC_LS_UP_OBD_1_MAN_DEAC[2] FORMAT "%1.0" /end CHARACTERISTIC
/begin CHARACTERISTIC lc_ls_up_obd_2_man_deac[0] "Logical calibration data for manual deactivation of all OBD2 diagnosis for upstream oxygen sensor" VALUE 0xa10022f8 _REC_VAL_20_u1 1. _CNV_A_R_LINEAR_____0_CM 0. 1. DISPLAY_IDENTIFIER LC_LS_UP_OBD_2_MAN_DEAC[1] FORMAT "%1.0" /end CHARACTERISTIC
/begin CHARACTERISTIC lc_ls_up_obd_2_man_deac[1] "Logical calibration data for manual deactivation of all OBD2 diagnosis for upstream oxygen sensor" VALUE 0xa10022f9 _REC_VAL_20_u1 1. _CNV_A_R_LINEAR_____0_CM 0. 1. DISPLAY_IDENTIFIER LC_LS_UP_OBD_2_MAN_DEAC[2] FORMAT "%1.0" /end CHARACTERISTIC
/begin CHARACTERISTIC lc_ls_up_err[0] "Opportunity for manual setting of LV_ERR_LS_UP[i] = 1" VALUE 0xa10022f4 _REC_VAL_20_u1 1. _CNV_A_R_LINEAR_____0_CM 0. 1. DISPLAY_IDENTIFIER LC_LS_UP_ERR[1] FORMAT "%1.0" /end CHARACTERISTIC
/begin CHARACTERISTIC lc_ls_up_err[1] "Opportunity for manual setting of LV_ERR_LS_UP[i] = 1" VALUE 0xa10022f5 _REC_VAL_20_u1 1. _CNV_A_R_LINEAR_____0_CM 0. 1. DISPLAY_IDENTIFIER LC_LS_UP_ERR[2] FORMAT "%1.0" /end CHARACTERISTIC
/begin CHARACTERISTIC c_nr_end_diag_lsl_up "Bit mask to select the consideration of a certain end flag for the final end flag" VALUE 0xa1002168 _REC_VAL_20_u2 65535. _CNV_A_R_LINEAR_____0_CM 0. 65535. DISPLAY_IDENTIFIER C_NR_END_DIAG_LSL_UP FORMAT "%5.0" /end CHARACTERISTIC
/begin CHARACTERISTIC c_nr_end_diag_ls_down "Bit mask to select the consideration of a certain end flag for the final end flag" VALUE 0xa1002166 _REC_VAL_20_u2 65535. _CNV_A_R_LINEAR_____0_CM 0. 65535. DISPLAY_IDENTIFIER C_NR_END_DIAG_LS_DOWN FORMAT "%5.0" /end CHARACTERISTIC
/begin CHARACTERISTIC lc_ls_up_diag_act[0] "Activation bit for upstream oxygen sensor final diagnosis" VALUE 0xa10022f2 _REC_VAL_20_u1 1. _CNV_A_R_LINEAR_____0_CM 0. 1. DISPLAY_IDENTIFIER LC_LS_UP_DIAG_ACT[1] FORMAT "%1.0" /end CHARACTERISTIC
/begin CHARACTERISTIC lc_ls_up_diag_act[1] "Activation bit for upstream oxygen sensor final diagnosis" VALUE 0xa10022f3 _REC_VAL_20_u1 1. _CNV_A_R_LINEAR_____0_CM 0. 1. DISPLAY_IDENTIFIER LC_LS_UP_DIAG_ACT[2] FORMAT "%1.0" /end CHARACTERISTIC
/begin CHARACTERISTIC lc_ls_down_diag_act[0] "Activation bit for downstream oxygen sensor final diagnosis" VALUE 0xa10022ea _REC_VAL_20_u1 1. _CNV_A_R_LINEAR_____0_CM 0. 1. DISPLAY_IDENTIFIER LC_LS_DOWN_DIAG_ACT[1] FORMAT "%1.0" /end CHARACTERISTIC
/begin CHARACTERISTIC lc_ls_down_diag_act[1] "Activation bit for downstream oxygen sensor final diagnosis" VALUE 0xa10022eb _REC_VAL_20_u1 1. _CNV_A_R_LINEAR_____0_CM 0. 1. DISPLAY_IDENTIFIER LC_LS_DOWN_DIAG_ACT[2] FORMAT "%1.0" /end CHARACTERISTIC
/begin CHARACTERISTIC lc_ls_down_obd_1_man_deac[0] "Logical calibration data for manual deactivation of all OBD1 diagnosis for downstream oxygen sensor" VALUE 0xa10022ee _REC_VAL_20_u1 1. _CNV_A_R_LINEAR_____0_CM 0. 1. DISPLAY_IDENTIFIER LC_LS_DOWN_OBD_1_MAN_DEAC[1] FORMAT "%1.0" /end CHARACTERISTIC
/begin CHARACTERISTIC lc_ls_down_obd_1_man_deac[1] "Logical calibration data for manual deactivation of all OBD1 diagnosis for downstream oxygen sensor" VALUE 0xa10022ef _REC_VAL_20_u1 1. _CNV_A_R_LINEAR_____0_CM 0. 1. DISPLAY_IDENTIFIER LC_LS_DOWN_OBD_1_MAN_DEAC[2] FORMAT "%1.0" /end CHARACTERISTIC
/begin CHARACTERISTIC lc_ls_down_obd_2_man_deac[0] "Logical calibration data for manual deactivation of all OBD2 diagnosis for downstream oxygen sensor" VALUE 0xa10022f0 _REC_VAL_20_u1 1. _CNV_A_R_LINEAR_____0_CM 0. 1. DISPLAY_IDENTIFIER LC_LS_DOWN_OBD_2_MAN_DEAC[1] FORMAT "%1.0" /end CHARACTERISTIC
/begin CHARACTERISTIC lc_ls_down_obd_2_man_deac[1] "Logical calibration data for manual deactivation of all OBD2 diagnosis for downstream oxygen sensor" VALUE 0xa10022f1 _REC_VAL_20_u1 1. _CNV_A_R_LINEAR_____0_CM 0. 1. DISPLAY_IDENTIFIER LC_LS_DOWN_OBD_2_MAN_DEAC[2] FORMAT "%1.0" /end CHARACTERISTIC
/begin CHARACTERISTIC lc_ls_down_err[0] "Opportunity for manual setting of LV_ERR_LS_DOWN[i] = 1" VALUE 0xa10022ec _REC_VAL_20_u1 1. _CNV_A_R_LINEAR_____0_CM 0. 1. DISPLAY_IDENTIFIER LC_LS_DOWN_ERR[1] FORMAT "%1.0" /end CHARACTERISTIC
/begin CHARACTERISTIC lc_ls_down_err[1] "Opportunity for manual setting of LV_ERR_LS_DOWN[i] = 1" VALUE 0xa10022ed _REC_VAL_20_u1 1. _CNV_A_R_LINEAR_____0_CM 0. 1. DISPLAY_IDENTIFIER LC_LS_DOWN_ERR[2] FORMAT "%1.0" /end CHARACTERISTIC
/begin CHARACTERISTIC lc_err_chg_ls_up "Allow Sensor Interchanged Fault to be considered as Sensor Failure (stops closed loop AF control)" VALUE 0xa10022db _REC_VAL_20_u1 1. _CNV_A_R_LINEAR_____0_CM 0. 1. DISPLAY_IDENTIFIER LC_ERR_CHG_LS_UP FORMAT "%1.0" /end CHARACTERISTIC
/begin CHARACTERISTIC lc_err_chg_ls_down "Allow Sensor Interchanged Fault to be considered as Sensor Failure (in case of 1)" VALUE 0xa10022da _REC_VAL_20_u1 1. _CNV_A_R_LINEAR_____0_CM 0. 1. DISPLAY_IDENTIFIER LC_ERR_CHG_LS_DOWN FORMAT "%1.0" /end CHARACTERISTIC
/begin CHARACTERISTIC c_t_dly_diag_shift_down "Threshold for the \"end flag\" delay timer in the no failure case" VALUE 0xa10021a8 _REC_VAL_20_u2 6553.5 _CNV_A_R_LINEAR_____4_CM 0. 6553.5 DISPLAY_IDENTIFIER C_T_DLY_DIAG_SHIFT_DOWN FORMAT "%6.1" /end CHARACTERISTIC
/begin MEASUREMENT lv_err_el_lsl_up_1 "Debounced diagnosis value caused by an OBD-I error at the WRAF-Sensor" UBYTE _CNV_S_2_RANGE__0___1_CM 1 100. 0. 1. DISPLAY_IDENTIFIER LV_ERR_EL_LSL_UP[1] ECU_ADDRESS 0xd0003498 BIT_MASK 0x1 /end MEASUREMENT
/begin MEASUREMENT lv_err_el_lsl_up_2 "Debounced diagnosis value caused by an OBD-I error at the WRAF-Sensor" UBYTE _CNV_S_2_RANGE__0___1_CM 1 100. 0. 1. DISPLAY_IDENTIFIER LV_ERR_EL_LSL_UP[2] ECU_ADDRESS 0xd00034b1 BIT_MASK 0x1 /end MEASUREMENT
/begin CHARACTERISTIC c_ctr_iplsl_sym_diag_lsl_up "Max. error debounce counter" VALUE 0xa1002058 _REC_VAL_20_u2 65535. _CNV_A_R_LINEAR_____0_CM 0. 65535. DISPLAY_IDENTIFIER C_CTR_IPLSL_SYM_DIAG_LSL_UP FORMAT "%5.0" /end CHARACTERISTIC
/begin CHARACTERISTIC c_lamb_sp_afr_iplsl_diag_lsl_up "Max. rich lambda set point to activate the IP diagnosis" VALUE 0xa10020f6 _REC_VAL_20_u2 31.9990234375 _CNV_A_R_LINEAR_____122_CM 0. 31.9990234375 DISPLAY_IDENTIFIER C_LAMB_SP_AFR_IPLSL_DIAG_LSL_UP FORMAT "%7.4" /end CHARACTERISTIC
/begin CHARACTERISTIC c_lamb_sp_afl_iplsl_diag_lsl_up "Min. lean lambda set point to activate the IP diagnosis" VALUE 0xa10020f2 _REC_VAL_20_u2 31.9990234375 _CNV_A_R_LINEAR_____122_CM 0. 31.9990234375 DISPLAY_IDENTIFIER C_LAMB_SP_AFL_IPLSL_DIAG_LSL_UP FORMAT "%7.4" /end CHARACTERISTIC
/begin MEASUREMENT lv_err_oc_lsl_up_2 "Debounced open circuit failure detected" UBYTE _CNV_S_2_RANGE__0___1_CM 1 100. 0. 1. DISPLAY_IDENTIFIER LV_ERR_OC_LSL_UP[2] ECU_ADDRESS 0xd00034c0 BIT_MASK 0x1 /end MEASUREMENT
/begin MEASUREMENT lv_err_oc_lsl_up_1 "Debounced open circuit failure detected" UBYTE _CNV_S_2_RANGE__0___1_CM 1 100. 0. 1. DISPLAY_IDENTIFIER LV_ERR_OC_LSL_UP[1] ECU_ADDRESS 0xd00034a7 BIT_MASK 0x1 /end MEASUREMENT
/begin CHARACTERISTIC c_t_vls_up_min_diag_oc_lsl_up "Max allowed time for LSL undervoltage" VALUE 0xa1002204 _REC_VAL_20_u2 6553.5 _CNV_A_R_LINEAR_____4_CM 0. 6553.5 DISPLAY_IDENTIFIER C_T_VLS_UP_MIN_DIAG_OC_LSL_UP FORMAT "%6.1" /end CHARACTERISTIC
/begin CHARACTERISTIC c_t_dly_diag_el_lsl_up "Time delay  to start the electrical failure diagnosis" VALUE 0xa100219e _REC_VAL_20_u2 655.35 _CNV_A_R_LINEAR_____3_CM 0. 655.35 DISPLAY_IDENTIFIER C_T_DLY_DIAG_EL_LSL_UP FORMAT "%6.2" /end CHARACTERISTIC
/begin CHARACTERISTIC lc_iplsl_sym_diag_lsl_up "Logical variable to force IPLSL symptom flag (only for test purpose)" VALUE 0xa10022e7 _REC_VAL_20_u1 1. _CNV_A_R_LINEAR_____0_CM 0. 1. DISPLAY_IDENTIFIER LC_IPLSL_SYM_DIAG_LSL_UP FORMAT "%1.0" /end CHARACTERISTIC
/begin CHARACTERISTIC lc_diag_puc_end_man_lsl_up "Boolean switch to bypass activation of LV_DIAG_PUC_END_LSL_UP[i]" VALUE 0xa10022d9 _REC_VAL_20_u1 1. _CNV_A_R_LINEAR_____0_CM 0. 1. DISPLAY_IDENTIFIER LC_DIAG_PUC_END_MAN_LSL_UP FORMAT "%1.0" /end CHARACTERISTIC
/begin CHARACTERISTIC c_t_diag_oc_lsl_up "Timer to finish OC diagnosis in case of OBD2 upstream heater error symptom active and conditions for plausiblity diagnosis fulfilled" VALUE 0xa100218e _REC_VAL_20_u2 6553.5 _CNV_A_R_LINEAR_____4_CM 0. 6553.5 DISPLAY_IDENTIFIER C_T_DIAG_OC_LSL_UP FORMAT "%6.1" /end CHARACTERISTIC
/begin CHARACTERISTIC c_t_diag_oc_lsl_up_lsh_err "Timer to finish OC diagnosis in case of OBD2 upstream heater error symptom active and LAMB plausible" VALUE 0xa1002190 _REC_VAL_20_u2 6553.5 _CNV_A_R_LINEAR_____4_CM 0. 6553.5 DISPLAY_IDENTIFIER C_T_DIAG_OC_LSL_UP_LSH_ERR FORMAT "%6.1" /end CHARACTERISTIC
/begin CHARACTERISTIC c_t_diag_oc_rst_osc_di "Time to reactivate oscillator for upstream tip temperature measurement" VALUE 0xa1002192 _REC_VAL_20_u2 6553.5 _CNV_A_R_LINEAR_____4_CM 0. 6553.5 DISPLAY_IDENTIFIER C_T_DIAG_OC_RST_OSC_DI FORMAT "%6.1" /end CHARACTERISTIC
/begin CHARACTERISTIC c_t_wait_sym_obd_2_lsh_up "Waiting time to check if OBD2 upstream heater error is present ( to distinguish OC on Vip from Vg)" VALUE 0xa100220a _REC_VAL_20_u2 6553.5 _CNV_A_R_LINEAR_____4_CM 0. 6553.5 DISPLAY_IDENTIFIER C_T_WAIT_SYM_OBD_2_LSH_UP FORMAT "%6.1" /end CHARACTERISTIC
/begin CHARACTERISTIC c_vls_up_diag_min_oc_lsl_up "LSL undervoltage threshold" VALUE 0xa10022c8 _REC_VAL_20_s2 319.9951171875 _CNV_A_R_LINEAR_____2_CM -160. 159.9951171875 DISPLAY_IDENTIFIER C_VLS_UP_DIAG_MIN_OC_LSL_UP FORMAT "%8.3" /end CHARACTERISTIC
/begin CHARACTERISTIC c_abc_inc_diag_el_lsl_up "Increment of OBD-I Diagnosis debouncer counter" VALUE 0xa1002015 _REC_VAL_20_u1 255. _CNV_A_R_LINEAR_____0_CM 0. 255. DISPLAY_IDENTIFIER C_ABC_INC_DIAG_EL_LSL_UP FORMAT "%3.0" /end CHARACTERISTIC
/begin CHARACTERISTIC c_abc_max_diag_el_lsl_up "Maximum threshold of OBD-I Diagnosis debouncer counter" VALUE 0xa1002020 _REC_VAL_20_u1 254. _CNV_A_R_LINEAR_____0_CM 1. 255. DISPLAY_IDENTIFIER C_ABC_MAX_DIAG_EL_LSL_UP FORMAT "%3.0" /end CHARACTERISTIC
/begin COMPU_METHOD _CNV_A_R_LINEAR_____0_CM "" RAT_FUNC "%6.3" "-" COEFFS 0 1. 0. 0 0 1 /end COMPU_METHOD
/begin COMPU_METHOD _CNV_S_2_RANGE__0___1_CM "" TAB_VERB "%6.3" "-" COMPU_TAB_REF _CNV_S_2_RANGE__0___1 /end COMPU_METHOD
/begin COMPU_VTAB _CNV_S_2_RANGE__0___1 "" TAB_VERB 2 0 "0" 1 "1" /end COMPU_VTAB
/begin COMPU_METHOD _CNV_A_R_LINEAR_____2_CM "" RAT_FUNC "%6.3" "V" COEFFS 0 204.8 0. 0 0 1 /end COMPU_METHOD
/begin COMPU_METHOD _CNV_A_R_LINEAR_____3_CM "" RAT_FUNC "%6.3" "s" COEFFS 0 100. 0. 0 0 1 /end COMPU_METHOD
/begin COMPU_METHOD _CNV_A_R_LINEAR_____4_CM "" RAT_FUNC "%6.3" "s" COEFFS 0 10. 0. 0 0 1 /end COMPU_METHOD
/begin COMPU_METHOD _CNV_A_R_LINEAR_____5_CM "" RAT_FUNC "%6.3" "%" COEFFS 0 2.56 0. 0 0 1 /end COMPU_METHOD
/begin COMPU_METHOD _CNV_A_R_LINEAR_____6_CM "" RAT_FUNC "%6.3" "km/h" COEFFS 0 1. 0. 0 0 1 /end COMPU_METHOD
/begin COMPU_METHOD _CNV_A_R_LINEAR_____7_CM "" RAT_FUNC "%6.3" "%" COEFFS 0 655.3599999999997 0. 0 0 1 /end COMPU_METHOD
/begin COMPU_METHOD _CNV_A_R_LINEAR_____13_CM "" RAT_FUNC "%6.3" "rpm" COEFFS 0 1. 0. 0 0 1 /end COMPU_METHOD
/begin COMPU_METHOD _CNV_A_R_LINEAR_____16_CM "" RAT_FUNC "%6.3" "°C" COEFFS 0 1.333333333333333 64. 0 0 1 /end COMPU_METHOD
/begin COMPU_METHOD _CNV_A_R_LINEAR_____22_CM "" RAT_FUNC "%6.3" "ms" COEFFS 0 5.e-002 0. 0 0 1 /end COMPU_METHOD
/begin COMPU_METHOD _CNV_A_R_LINEAR_____23_CM "" RAT_FUNC "%6.3" "-" COEFFS 0 16384. 0. 0 0 1 /end COMPU_METHOD
/begin COMPU_METHOD _CNV_A_R_LINEAR_____27_CM "" RAT_FUNC "%6.3" "-" COEFFS 0 256. 0. 0 0 1 /end COMPU_METHOD
/begin COMPU_METHOD _CNV_A_R_LINEAR_____35_CM "" RAT_FUNC "%6.3" "s" COEFFS 0 1. 0. 0 0 1 /end COMPU_METHOD
/begin COMPU_METHOD _CNV_A_R_LINEAR_____68_CM "" RAT_FUNC "%6.3" "-" COEFFS 0 65535.99999999996 0. 0 0 1 /end COMPU_METHOD
/begin COMPU_METHOD _CNV_A_R_LINEAR_____100_CM "" RAT_FUNC "%6.3" "-" COEFFS 0 128. 0. 0 0 1 /end COMPU_METHOD
/begin COMPU_METHOD _CNV_A_R_LINEAR_____108_CM "" RAT_FUNC "%6.3" "mg/stk" COEFFS 0 47.18142548596112 0. 0 0 1 /end COMPU_METHOD
/begin COMPU_METHOD _CNV_A_R_LINEAR_____110_CM "" RAT_FUNC "%6.3" "%" COEFFS 0 655.3599999999997 -1.455191522836685e-011 0 0 1 /end COMPU_METHOD
/begin COMPU_METHOD _CNV_A_R_LINEAR_____122_CM "" RAT_FUNC "%6.3" "-" COEFFS 0 1024. 0. 0 0 1 /end COMPU_METHOD
/begin COMPU_METHOD _CNV_A_R_LINEAR_____123_CM "" RAT_FUNC "%6.3" "°C" COEFFS 0 16. 0. 0 0 1 /end COMPU_METHOD
/begin COMPU_METHOD _CNV_A_R_LINEAR_____204_CM "" RAT_FUNC "%6.3" "°C" COEFFS 0 16. 4370.4 0 0 1 /end COMPU_METHOD
/begin COMPU_METHOD _CNV_A_R_LINEAR_____207_CM "" RAT_FUNC "%6.3" "kg/h" COEFFS 0 32. 0. 0 0 1 /end COMPU_METHOD
/begin COMPU_METHOD _CNV_A_R_EGCP_LINEA_315_CM "Battery voltage" RAT_FUNC "%6.3" "°C" COEFFS 0 16. 32768. 0 0 1 /end COMPU_METHOD
/begin COMPU_METHOD _CNV_A_R_LINEAR_____329_CM "" RAT_FUNC "%6.3" "g" COEFFS 0 22.49999999999997 0. 0 0 1 /end COMPU_METHOD
/begin COMPU_METHOD _CNV_A_R_LINEAR_____332_CM "" RAT_FUNC "%6.3" "Ohm" COEFFS 0 1. 0. 0 0 1 /end COMPU_METHOD
/begin COMPU_METHOD _CNV_A_R_EGCP_LINEA_333_CM "" RAT_FUNC "%6.3" "J/K" COEFFS 0 16. 0. 0 0 1 /end COMPU_METHOD
/begin COMPU_METHOD _CNV_A_R_LINEAR_____334_CM "" RAT_FUNC "%6.3" "J" COEFFS 0 1. 0. 0 0 1 /end COMPU_METHOD
/begin COMPU_METHOD _CNV_S_5_EGCP_RANGE_353_CM "" TAB_VERB "%6.3" "-" COMPU_TAB_REF _CNV_S_5_EGCP_RANGE_353 /end COMPU_METHOD
/begin COMPU_VTAB _CNV_S_5_EGCP_RANGE_353 "" TAB_VERB 5 0 "NO_SYM" 1 "SYM_0" 2 "SYM_1" 4 "SYM_2" 8 "SYM_3" /end COMPU_VTAB
/begin COMPU_METHOD _CNV_S_11_EGCP_RANGE_354_CM "" TAB_VERB "%6.3" "-" COMPU_TAB_REF _CNV_S_11_EGCP_RANGE_354 /end COMPU_METHOD
/begin COMPU_VTAB _CNV_S_11_EGCP_RANGE_354 "" TAB_VERB 11 0 "NO_FAULT" 1 "SCG_LINE_RCD" 2 "SCG_LINE_VIP" 3 "SCG_LINE_VG" 4 "SCG_LINE_VN" 5 "SCG" 6 "SCBAT_LINE_RCD" 7 "SCBAT_LINE_VIP" 8 "SCBAT_LINE_VG" 9 "SCBAT_LINE_VN" 10 "SCBAT" /end COMPU_VTAB
/begin COMPU_METHOD _CNV_S_3_EGCP_RANGE_355_CM "" TAB_VERB "%6.3" "-" COMPU_TAB_REF _CNV_S_3_EGCP_RANGE_355 /end COMPU_METHOD
/begin COMPU_VTAB _CNV_S_3_EGCP_RANGE_355 "" TAB_VERB 3 0 "PASSIVE" 1 "ACTIVE" 2 "END" /end COMPU_VTAB
/begin COMPU_METHOD _CNV_A_R_LINEAR_____356_CM "" RAT_FUNC "%6.3" "g" COEFFS 0 35.99993408114611 0. 0 0 1 /end COMPU_METHOD
/begin COMPU_METHOD _CNV_A_R_LINEAR_____357_CM "" RAT_FUNC "%6.3" "g" COEFFS 0 47.18142548596112 0. 0 0 1 /end COMPU_METHOD
/begin COMPU_METHOD _CNV_S_4_EGCP_RANGE_358_CM "" TAB_VERB "%6.3" "-" COMPU_TAB_REF _CNV_S_4_EGCP_RANGE_358 /end COMPU_METHOD
/begin COMPU_VTAB _CNV_S_4_EGCP_RANGE_358 "" TAB_VERB 4 0 "NO_SYM" 1 "TTIP_ERR" 2 "READY_ERR" 4 "TTIP_MES_ERR" /end COMPU_VTAB
/begin COMPU_METHOD _CNV_A_R_EGCP_LINEA_359_CM "" RAT_FUNC "%6.3" "K" COEFFS 0 1. 0. 0 0 1 /end COMPU_METHOD
/begin COMPU_METHOD _CNV_S_9_EGCP_RANGE_360_CM "" TAB_VERB "%6.3" "-" COMPU_TAB_REF _CNV_S_9_EGCP_RANGE_360 /end COMPU_METHOD
/begin COMPU_VTAB _CNV_S_9_EGCP_RANGE_360 "" TAB_VERB 9 0 "DIAG_OFF" 1 "DIAG_INIT" 2 "LS_READY" 3 "OBD1_DLY" 4 "OBD1_CHK" 5 "TEG_THD" 6 "POW_INT" 7 "DIAG_ACT" 8 "DIAG_END" /end COMPU_VTAB
/begin COMPU_METHOD _CNV_A_R_EGCP_LINEA_361_CM "" RAT_FUNC "%6.3" "-" COEFFS 0 1024.000007000107 2.240034154965542e-004 0 0 1 /end COMPU_METHOD
/begin COMPU_METHOD _CNV_S_4_EGCP_RANGE_362_CM "" TAB_VERB "%6.3" "-" COMPU_TAB_REF _CNV_S_4_EGCP_RANGE_362 /end COMPU_METHOD
/begin COMPU_VTAB _CNV_S_4_EGCP_RANGE_362 "" TAB_VERB 4 0 "PASSIVE" 1 "RICH CHECK" 2 "LEAN CHECK" 3 "CHECK FINISHED" /end COMPU_VTAB
/begin COMPU_METHOD _CNV_A_R_LINEAR_____369_CM "" RAT_FUNC "%6.3" "V" COEFFS 0 204.7999999487896 -2.556795379859977e-007 0 0 1 /end COMPU_METHOD
/begin RECORD_LAYOUT _REC_VAL_20_u1 FNC_VALUES 1 UBYTE COLUMN_DIR DIRECT /end RECORD_LAYOUT
/begin RECORD_LAYOUT _REC_VAL_20_u2 FNC_VALUES 1 UWORD COLUMN_DIR DIRECT /end RECORD_LAYOUT
/begin RECORD_LAYOUT _REC_VAL_20_s2 FNC_VALUES 1 SWORD COLUMN_DIR DIRECT /end RECORD_LAYOUT
/begin RECORD_LAYOUT _REC_AXS_20_u2 NO_AXIS_PTS_X 1 UWORD AXIS_PTS_X 2 UWORD INDEX_INCR DIRECT /end RECORD_LAYOUT
/begin RECORD_LAYOUT _REC_CUR_20_u2_u2 FNC_VALUES 1 UWORD COLUMN_DIR DIRECT /end RECORD_LAYOUT
/begin RECORD_LAYOUT _REC_CUR_20_u1_u2 FNC_VALUES 1 UBYTE COLUMN_DIR DIRECT /end RECORD_LAYOUT
/begin FUNCTION EGCP_HW_based_DIAG_ATIC42 "_HW_based_DIAG_ATIC42"
 /begin DEF_CHARACTERISTIC c_ctr_iplsl_sym_diag_lsl_up c_lamb_sp_afr_iplsl_diag_lsl_up c_lamb_sp_afl_iplsl_diag_lsl_up c_t_vls_up_min_diag_oc_lsl_up c_t_dly_diag_el_lsl_up lc_iplsl_sym_diag_lsl_up lc_diag_puc_end_man_lsl_up c_t_diag_oc_lsl_up c_t_diag_oc_lsl_up_lsh_err c_t_diag_oc_rst_osc_di c_t_wait_sym_obd_2_lsh_up c_vls_up_diag_min_oc_lsl_up /end DEF_CHARACTERISTIC
 /begin OUT_MEASUREMENT egcp[0].egcp_struct_sigdglsla0.t_dly_diag_el_lsl_up egcp[0].egcp_struct_sigdglsla0.ctr_iplsl_sym_diag_lsl_up egcp[0].egcp_struct_sigdglsla0.t_diag_oc_lsl_up egcp[0].egcp_struct_sigdglsla0.t_vls_up_min_diag_oc_lsl_up egcp[0].egcp_struct_sigdglsla0.t_diag_oc_lsl_up_lsh_err egcp[0].egcp_struct_sigdglsla0.t_diag_oc_rst_osc_di egcp[0].egcp_struct_sigdglsla0.t_wait_sym_obd_2_lsh_up egcp[0].egcp_struct_sigdglsla0.iplsl_sym_diag_lsl_up egcp[0].egcp_struct_sigdglsla0.state_err_el_lsl_up egcp[0].egcp_struct_sigdglsla0.state_diag_oc_lsl_up egcp[0].egcp_struct_sigdglsla0.lv_lsl_up_spi_com_inh egcp[0].egcp_struct_sigdglsla0.lv_diag_iplsl_sym_lsl_up egcp[0].egcp_struct_sigdglsla0.lv_diag_iplsl_cdn_lsl_up egcp[0].egcp_struct_sigdglsla0.lv_diag_oc_if_osc_di_lsl_up egcp[0].egcp_struct_sigdglsla0.lv_vls_up_min_diag_oc_lsl_up egcp[0].egcp_struct_sigdglsla0.lv_diag_act_el_lsl_up egcp[1].egcp_struct_sigdglsla0.t_dly_diag_el_lsl_up egcp[1].egcp_struct_sigdglsla0.ctr_iplsl_sym_diag_lsl_up egcp[1].egcp_struct_sigdglsla0.t_diag_oc_lsl_up egcp[1].egcp_struct_sigdglsla0.t_vls_up_min_diag_oc_lsl_up egcp[1].egcp_struct_sigdglsla0.t_diag_oc_lsl_up_lsh_err egcp[1].egcp_struct_sigdglsla0.t_diag_oc_rst_osc_di egcp[1].egcp_struct_sigdglsla0.t_wait_sym_obd_2_lsh_up egcp[1].egcp_struct_sigdglsla0.iplsl_sym_diag_lsl_up egcp[1].egcp_struct_sigdglsla0.state_err_el_lsl_up egcp[1].egcp_struct_sigdglsla0.state_diag_oc_lsl_up egcp[1].egcp_struct_sigdglsla0.lv_lsl_up_spi_com_inh egcp[1].egcp_struct_sigdglsla0.lv_diag_iplsl_sym_lsl_up egcp[1].egcp_struct_sigdglsla0.lv_diag_iplsl_cdn_lsl_up egcp[1].egcp_struct_sigdglsla0.lv_diag_oc_if_osc_di_lsl_up egcp[1].egcp_struct_sigdglsla0.lv_vls_up_min_diag_oc_lsl_up egcp[1].egcp_struct_sigdglsla0.lv_diag_act_el_lsl_up lv_err_el_lsl_up_1 lv_err_el_lsl_up_2 lv_err_oc_lsl_up_2 lv_err_oc_lsl_up_1 /end OUT_MEASUREMENT
/end FUNCTION
/begin FUNCTION EGCP_WRAF_sensor_ctl_DIAG "_WRAF_sensor_controller_DIAG"
 /begin DEF_CHARACTERISTIC c_ctr_max_spi_com_lsl_up[0] c_ctr_max_spi_com_lsl_up[1] c_t_rst_max_diag_lsl_up_if[0] c_t_rst_max_diag_lsl_up_if[1] c_t_end_diag_lsl_up_if[0] c_t_end_diag_lsl_up_if[1] /end DEF_CHARACTERISTIC
 /begin OUT_MEASUREMENT egcp[0].egcp_struct_pladgspi0.ctr_err_save_diag_lsl_up_if egcp[0].egcp_struct_pladgspi0.ctr_delta_lsl_up_if egcp[1].egcp_struct_pladgspi0.ctr_err_save_diag_lsl_up_if egcp[1].egcp_struct_pladgspi0.ctr_delta_lsl_up_if lv_err_lsl_up_if_1 lv_err_lsl_up_if_2 /end OUT_MEASUREMENT
/end FUNCTION
/begin FUNCTION EGCP_A_I_WRAF_sens_electric_DIAG "_A_I_WRAF_sens_electric_DIAG" /begin DEF_CHARACTERISTIC c_abc_inc_diag_el_lsl_up c_abc_max_diag_el_lsl_up /end DEF_CHARACTERISTIC
 /begin OUT_MEASUREMENT egcp[0].egcp_struct_sigdglslai0.lv_inh_diag_el_lsl_up egcp[0].egcp_struct_sigdglslai0.lv_inh_diag_oc_lsl_up egcp[0].egcp_struct_sigdglslai0.lv_iplsl_diag_inh_lsl_up egcp[1].egcp_struct_sigdglslai0.lv_inh_diag_el_lsl_up egcp[1].egcp_struct_sigdglslai0.lv_inh_diag_oc_lsl_up egcp[1].egcp_struct_sigdglslai0.lv_iplsl_diag_inh_lsl_up /end OUT_MEASUREMENT
/end FUNCTION
/begin FUNCTION EGCP_A_I_WRAF_sens_ctl_DIAG "_A_I_WRAF_sens_controller_DIAG"
 /begin OUT_MEASUREMENT egcp[0].egcp_struct_pladgspii0.lv_inh_diag_lsl_up_if egcp[1].egcp_struct_pladgspii0.lv_inh_diag_lsl_up_if /end OUT_MEASUREMENT
/end FUNCTION
/begin FUNCTION EGCP_A_I_upst_ls_heat_OBDI_DIAG "_A_I_upst_ls_heat_OBDI_DIAG"
 /begin OUT_MEASUREMENT egcp[0].egcp_struct_outdglshi0.lv_inh_diag_lsh_up egcp[1].egcp_struct_outdglshi0.lv_inh_diag_lsh_up /end OUT_MEASUREMENT
/end FUNCTION
/begin FUNCTION EGCP_downst_ls_heat_OBDI_DIAG_AI "_downst_ls_heat_OBDI_DIAG_AI"
 /begin OUT_MEASUREMENT egcp[0].egcp_struct_outdglshdi0.lv_inh_diag_lsh_down egcp[1].egcp_struct_outdglshdi0.lv_inh_diag_lsh_down /end OUT_MEASUREMENT
/end FUNCTION
/begin FUNCTION EGCP_A_I_downst_ls_probe_DIAG "_A_I_downst_ls_probe_DIAG"
 /begin DEF_CHARACTERISTIC c_abc_max_scg_ls_down c_abc_inc_scg_ls_down c_abc_inc_oc_ls_down c_abc_max_oc_ls_down c_abc_max_scp_ls_down c_abc_inc_scp_ls_down c_abc_inc_puc_ls_down c_abc_inc_fl_ls_down c_abc_max_puc_ls_down c_abc_max_fl_ls_down /end DEF_CHARACTERISTIC
 /begin OUT_MEASUREMENT egcp[0].egcp_struct_sigdglsdi1.lv_inh_diag_oc_ls_down egcp[0].egcp_struct_sigdglsdi1.lv_inh_diag_puc_ls_down egcp[0].egcp_struct_sigdglsdi1.lv_inh_diag_fl_ls_down egcp[0].egcp_struct_sigdglsdi1.lv_inh_diag_scg_ls_down egcp[0].egcp_struct_sigdglsdi1.lv_inh_diag_scp_ls_down egcp[1].egcp_struct_sigdglsdi1.lv_inh_diag_oc_ls_down egcp[1].egcp_struct_sigdglsdi1.lv_inh_diag_puc_ls_down egcp[1].egcp_struct_sigdglsdi1.lv_inh_diag_fl_ls_down egcp[1].egcp_struct_sigdglsdi1.lv_inh_diag_scg_ls_down egcp[1].egcp_struct_sigdglsdi1.lv_inh_diag_scp_ls_down /end OUT_MEASUREMENT
/end FUNCTION
/begin FUNCTION C_B_EGCP "C_B_EGCP"
 /begin SUB_FUNCTION EGCP_Dynamic_fuel_trim_diag EGCP_Dynamic_fuel_trim_diag_inci EGCP_O2_sensor_up_heater_diag EGCP_O2_sensor_down_heater_diag EGCP_O2_sensor_down_heat_diag_ai EGCP_O2_sensor_downstream_diag EGCP_O2_sensor_inter_signal_diag EGCP_O2_sensor_diag_management EGCP_O2_sensor_swap_sig_diag_ai EGCP_O2_sensor_swap_sig_diag EGCP_O2_sensor_probe_diag_plaus EGCP_O2_sensor_temperature EGCP_O2_sensor_down_diag_inci EGCP_O2_sensor_up_heater_diag_ai EGCP_Linear_O2_sensor_diag EGCP_Linear_O2_sensor_diag_inci EGCP_O2_sensor_temperature_inci EGCP_O2_sensor_diag_manag_inci EGCP_O2_sensor_probe_diag_inci EGCP_Down_O2_sensor_resist_inci EGCP_Linear_O2_sensor_hea_diag EGCP_Linear_O2_sens_hea_diag_AI EGCP_O2_down_diag_NOx_rgn EGCP_O2_down_diag_NOx_rgn_AI /end SUB_FUNCTION
/end FUNCTION
/begin FUNCTION EGCP_Dynamic_fuel_trim_diag "Dynamic_fuel_trim_diag"
 /begin DEF_CHARACTERISTIC c_lamb_delta_i_max_diag c_lamb_delta_i_min_diag c_vls_dif_max_diag c_vls_dif_min_diag c_maf_int_vls_dif_dly_min c_maf_int_vls_dif_dly_max c_n_ldc_vls_dif_dly c_maf_ldc_vls_dif_dly c_lam_mv_ldc_vls_dif_dly c_n_crlc_ldc_vls_dif_dly c_maf_crlc_ldc_vls_dif_dly c_lam_mv_crlc_ldc_vls_dif_dly c_maf_int_min_vls_dif_dly_ldc c_maf_int_rst_vls_down_dif_diag c_t_sum_max_max_delta_i_lam c_t_sum_min_max_delta_i_lam c_t_sum_rst_max_delta_i_lam c_t_sum_max_err_delta_i_lam c_t_sum_ready_delta_i_lam c_cat_diag_max_delta_i_lam /end DEF_CHARACTERISTIC
 /begin OUT_MEASUREMENT egcp[0].egcp_struct_pladgft0.lam_mmv_vls_dif_dly_ldc egcp[0].egcp_struct_pladgft0.maf_int_vls_dif_dly_min egcp[0].egcp_struct_pladgft0.maf_int_vls_dif_dly_max egcp[0].egcp_struct_pladgft0.maf_int_vls_dif_dly_ldc egcp[0].egcp_struct_pladgft0.maf_int_rst_vls_down_dif_diag egcp[0].egcp_struct_pladgft0.t_sum_max_delta_i_lam egcp[0].egcp_struct_pladgft0.t_sum_min_delta_i_lam egcp[0].egcp_struct_pladgft0.t_sum_end_diag_win_delta_i_lam egcp[0].egcp_struct_pladgft0.t_sum_end_ready_delta_i_lam egcp[0].egcp_struct_pladgft0.t_sum_rst_delta_i_lam egcp[0].egcp_struct_pladgft0.lamb_delta_i_save_diag egcp[0].egcp_struct_pladgft0.err_sym_lam_adj egcp[0].egcp_struct_pladgft0.lv_vls_dif_dly_ldc egcp[0].egcp_struct_pladgft0.lv_vls_dif_dly_ldc_lam_mv egcp[0].egcp_struct_pladgft0.lv_end_diag_lam_adj egcp[0].egcp_struct_pladgft0.lv_err_lam_adj egcp[0].egcp_struct_pladgft0.lv_end_diag_win_delta_i_lam egcp[0].egcp_struct_pladgft0.lv_det_sym_eve_delta_i_lam egcp[1].egcp_struct_pladgft0.lam_mmv_vls_dif_dly_ldc egcp[1].egcp_struct_pladgft0.maf_int_vls_dif_dly_min egcp[1].egcp_struct_pladgft0.maf_int_vls_dif_dly_max egcp[1].egcp_struct_pladgft0.maf_int_vls_dif_dly_ldc egcp[1].egcp_struct_pladgft0.maf_int_rst_vls_down_dif_diag egcp[1].egcp_struct_pladgft0.t_sum_max_delta_i_lam egcp[1].egcp_struct_pladgft0.t_sum_min_delta_i_lam egcp[1].egcp_struct_pladgft0.t_sum_end_diag_win_delta_i_lam egcp[1].egcp_struct_pladgft0.t_sum_end_ready_delta_i_lam egcp[1].egcp_struct_pladgft0.t_sum_rst_delta_i_lam egcp[1].egcp_struct_pladgft0.lamb_delta_i_save_diag egcp[1].egcp_struct_pladgft0.err_sym_lam_adj egcp[1].egcp_struct_pladgft0.lv_vls_dif_dly_ldc egcp[1].egcp_struct_pladgft0.lv_vls_dif_dly_ldc_lam_mv egcp[1].egcp_struct_pladgft0.lv_end_diag_lam_adj egcp[1].egcp_struct_pladgft0.lv_err_lam_adj egcp[1].egcp_struct_pladgft0.lv_end_diag_win_delta_i_lam egcp[1].egcp_struct_pladgft0.lv_det_sym_eve_delta_i_lam lv_vls_dif_dly_ldc_n lv_vls_dif_dly_ldc_maf n_mmv_vls_dif_dly_ldc maf_mmv_vls_dif_dly_ldc lv_err_delta_i_lam_2 lv_err_delta_i_lam_1 lv_err_vls_down_dif_1 lv_err_vls_down_dif_2 /end OUT_MEASUREMENT
/end FUNCTION
/begin FUNCTION EGCP_Dynamic_fuel_trim_diag_inci "Dynamic_fuel_trim_diag_inci"
 /begin OUT_MEASUREMENT egcp[0].egcp_struct_pladgfti0.lv_inh_diag_dly_lam egcp[0].egcp_struct_pladgfti0.lv_inh_diag_rbm_dly_lam egcp[0].egcp_struct_pladgfti0.state_rbm_lam_adj egcp[1].egcp_struct_pladgfti0.lv_inh_diag_dly_lam egcp[1].egcp_struct_pladgfti0.lv_inh_diag_rbm_dly_lam egcp[1].egcp_struct_pladgfti0.state_rbm_lam_adj state_rbm_vls_down_dif[0] state_rbm_vls_down_dif[1] state_rbm_chk_ls_down[0] state_rbm_chk_ls_down[1] /end OUT_MEASUREMENT
/end FUNCTION
/begin FUNCTION EGCP_O2_sensor_up_heater_diag "O2_sensor_up_heater_diag"
 /begin DEF_CHARACTERISTIC c_lshpwm_min_lsh_up c_ttip_min_obd_lsh_up c_ttip_max_obd_lsh_up c_tcc_thd_obd_lsh_up c_tcc_thd_err_obd_lsh_up lc_obd_rep_lsh_up ip_t_dly_ls_up_ready_raw_lsh_up ip_t_dly_ls_up_ready_obd_lsh_up lc_obd_lsh_up c_t_dly_pow_ctl_obd_lsh_up c_t_dly_ttip_mes_obd_lsh_up c_t_dly_ttip_res_obd_lsh_up c_teg_dyn_min_obd_lsh_up /end DEF_CHARACTERISTIC
 /begin OUT_MEASUREMENT egcp[0].egcp_struct_fctdglslh0.ttip_mes_ls_up_obd_lsh_up egcp[0].egcp_struct_fctdglslh0.tcc_vld_obd_lsh_up egcp[0].egcp_struct_fctdglslh0.tcc_err_obd_lsh_up egcp[0].egcp_struct_fctdglslh0.state_sym_obd_lsl_lsh_up egcp[0].egcp_struct_fctdglslh0.lv_lamb_pls_req_diag_lsh_up egcp[0].egcp_struct_fctdglslh0.lv_diag_obd_cdn_lsh_up egcp[0].egcp_struct_fctdglslh0.lv_diag_obd_sym_lsh_up egcp[0].egcp_struct_fctdglslh0.lv_diag_obd_end_lsh_up egcp[1].egcp_struct_fctdglslh0.ttip_mes_ls_up_obd_lsh_up egcp[1].egcp_struct_fctdglslh0.tcc_vld_obd_lsh_up egcp[1].egcp_struct_fctdglslh0.tcc_err_obd_lsh_up egcp[1].egcp_struct_fctdglslh0.state_sym_obd_lsl_lsh_up egcp[1].egcp_struct_fctdglslh0.lv_lamb_pls_req_diag_lsh_up egcp[1].egcp_struct_fctdglslh0.lv_diag_obd_cdn_lsh_up egcp[1].egcp_struct_fctdglslh0.lv_diag_obd_sym_lsh_up egcp[1].egcp_struct_fctdglslh0.lv_diag_obd_end_lsh_up /end OUT_MEASUREMENT
/end FUNCTION
/begin FUNCTION EGCP_O2_sensor_down_heater_diag "O2_sensor_down_heater_diag"
 /begin DEF_CHARACTERISTIC c_lshpwm_min_lsh_down c_lshpwm_max_lsh_down c_temp_sp_obd_lsh_down ldp_r_it_ls_down_new_lsh_down c_t_dly_obd_lsh_down ip_fac_maf_obd_lsh_down c_tcc_thd_err_obd_lsh_down c_tcc_thd_obd_lsh_down c_pow_int_min_obd_lsh_down ip_r_it_thd_obd_lsh_down c_teg_dyn_max_obd_lsh_down /end DEF_CHARACTERISTIC
 /begin OUT_MEASUREMENT lv_err_obd_lsh_down_2 lv_err_obd_lsh_down_1 egcp[0].egcp_struct_fctdglshd1.r_it_thd_obd_lsh_down egcp[0].egcp_struct_fctdglshd1.r_it_obd_lsh_down egcp[0].egcp_struct_fctdglshd1.temp_dif_obd_lsh_down egcp[0].egcp_struct_fctdglshd1.pow_int_obd_lsh_down egcp[0].egcp_struct_fctdglshd1.tcc_vld_obd_lsh_down egcp[0].egcp_struct_fctdglshd1.tcc_err_obd_lsh_down egcp[0].egcp_struct_fctdglshd1.ctr_cycnr_r_it_obd_ls_down egcp[0].egcp_struct_fctdglshd1.state_obd_lsh_down egcp[1].egcp_struct_fctdglshd1.r_it_thd_obd_lsh_down egcp[1].egcp_struct_fctdglshd1.r_it_obd_lsh_down egcp[1].egcp_struct_fctdglshd1.temp_dif_obd_lsh_down egcp[1].egcp_struct_fctdglshd1.pow_int_obd_lsh_down egcp[1].egcp_struct_fctdglshd1.tcc_vld_obd_lsh_down egcp[1].egcp_struct_fctdglshd1.tcc_err_obd_lsh_down egcp[1].egcp_struct_fctdglshd1.ctr_cycnr_r_it_obd_ls_down egcp[1].egcp_struct_fctdglshd1.state_obd_lsh_down /end OUT_MEASUREMENT
/end FUNCTION
/begin FUNCTION EGCP_O2_sensor_down_heat_diag_ai "O2_sensor_down_heater_diag"
 /begin OUT_MEASUREMENT egcp[0].egcp_struct_fctdglshdi1.lv_inh_diag_obd_lsh_down egcp[0].egcp_struct_fctdglshdi1.lv_inh_diag_rbm_obd_lsh_down egcp[0].egcp_struct_fctdglshdi1.state_rbm_obd_lsh_down egcp[1].egcp_struct_fctdglshdi1.lv_inh_diag_obd_lsh_down egcp[1].egcp_struct_fctdglshdi1.lv_inh_diag_rbm_obd_lsh_down egcp[1].egcp_struct_fctdglshdi1.state_rbm_obd_lsh_down /end OUT_MEASUREMENT
/end FUNCTION
/begin FUNCTION EGCP_O2_sensor_downstream_diag "O2_sensor_down_heater_diag"
 /begin DEF_CHARACTERISTIC c_tco_min_diag_mpl_ls_down c_vs_min_diag_mpl_ls_down c_vs_max_diag_mpl_ls_down c_temp_cat_min_diag_mpl_ls_down ldp_maf_kgh_ip_fac_ls_down ip_fac_cycnr_max_ls_down_act c_maf_int_puc_diag_pue_ls_down c_maf_int_diag_pue_ls_down c_ctr_swt_diag_ls_down c_ctr_sym_inc_diag_pue_ls_down c_ctr_sym_max_diag_pue_ls_down c_vls_dif_min_diag_pue_ls_down c_ctr_swt_ls_down c_maf_puc_max_diag_swt_ls_down c_maf_puc_min_diag_swt_ls_down c_fac_vls_max_diag_swt_ls_down c_vls_hys_diag_swt_ls_down c_vls_puc_min_diag_swt_ls_down c_fac_vls_min_diag_swt_ls_down c_ctr_end_diag_pue_ls_down /end DEF_CHARACTERISTIC
 /begin OUT_MEASUREMENT egcp[0].egcp_struct_sigdglsd2.vls_down_tran_puc egcp[0].egcp_struct_sigdglsd2.vls_down_pue egcp[0].egcp_struct_sigdglsd2.vls_dif_diag_pue_ls_down egcp[0].egcp_struct_sigdglsd2.vls_dif_save_diag_ls_down egcp[0].egcp_struct_sigdglsd2.vls_dif_min_diag_pue_ls_down egcp[0].egcp_struct_sigdglsd2.vls_dif_max_diag_pue_ls_down egcp[0].egcp_struct_sigdglsd2.ctr_end_diag_pue_ls_down egcp[0].egcp_struct_sigdglsd2.ctr_quo_sum_swt_ls_down egcp[0].egcp_struct_sigdglsd2.ctr_quo_swt_ls_down egcp[0].egcp_struct_sigdglsd2.ctr_quo_swt_rbm_ls_down egcp[0].egcp_struct_sigdglsd2.ctr_swt_act_ls_down egcp[0].egcp_struct_sigdglsd2.ctr_swt_act_rbm_ls_down egcp[0].egcp_struct_sigdglsd2.ctr_swt_ls_down egcp[0].egcp_struct_sigdglsd2.ctr_cycnr_swt_ls_down egcp[0].egcp_struct_sigdglsd2.ctr_save_swt_ls_down egcp[0].egcp_struct_sigdglsd2.ctr_sym_diag_pue_ls_down egcp[0].egcp_struct_sigdglsd2.lv_diag_pue_vld_ls_down egcp[0].egcp_struct_sigdglsd2.lv_diag_mpl_cdn_ls_down egcp[0].egcp_struct_sigdglsd2.lv_diag_mpl_end_ls_down egcp[0].egcp_struct_sigdglsd2.lv_swt_diag_vld_ls_down egcp[1].egcp_struct_sigdglsd2.vls_down_tran_puc egcp[1].egcp_struct_sigdglsd2.vls_down_pue egcp[1].egcp_struct_sigdglsd2.vls_dif_diag_pue_ls_down egcp[1].egcp_struct_sigdglsd2.vls_dif_save_diag_ls_down egcp[1].egcp_struct_sigdglsd2.vls_dif_min_diag_pue_ls_down egcp[1].egcp_struct_sigdglsd2.vls_dif_max_diag_pue_ls_down egcp[1].egcp_struct_sigdglsd2.ctr_end_diag_pue_ls_down egcp[1].egcp_struct_sigdglsd2.ctr_quo_sum_swt_ls_down egcp[1].egcp_struct_sigdglsd2.ctr_quo_swt_ls_down egcp[1].egcp_struct_sigdglsd2.ctr_quo_swt_rbm_ls_down egcp[1].egcp_struct_sigdglsd2.ctr_swt_act_ls_down egcp[1].egcp_struct_sigdglsd2.ctr_swt_act_rbm_ls_down egcp[1].egcp_struct_sigdglsd2.ctr_swt_ls_down egcp[1].egcp_struct_sigdglsd2.ctr_cycnr_swt_ls_down egcp[1].egcp_struct_sigdglsd2.ctr_save_swt_ls_down egcp[1].egcp_struct_sigdglsd2.ctr_sym_diag_pue_ls_down egcp[1].egcp_struct_sigdglsd2.lv_diag_pue_vld_ls_down egcp[1].egcp_struct_sigdglsd2.lv_diag_mpl_cdn_ls_down egcp[1].egcp_struct_sigdglsd2.lv_diag_mpl_end_ls_down egcp[1].egcp_struct_sigdglsd2.lv_swt_diag_vld_ls_down maf_kgh_min_puc lv_err_pue_ls_down_1 lv_err_pue_ls_down_2 lv_err_swt_ls_down_1 lv_err_swt_ls_down_2 /end OUT_MEASUREMENT
/end FUNCTION
/begin FUNCTION EGCP_O2_sensor_inter_signal_diag "O2_sensor_inter_signal_diag" /end FUNCTION
/begin FUNCTION EGCP_O2_sensor_diag_management "O2_sensor_diag_management"
 /begin DEF_CHARACTERISTIC lc_err_dyn_vld_ls_up lc_ls_up_obd_1_man_deac[0] lc_ls_up_obd_1_man_deac[1] lc_ls_up_obd_2_man_deac[0] lc_ls_up_obd_2_man_deac[1] lc_ls_up_err[0] lc_ls_up_err[1] c_nr_end_diag_lsl_up c_nr_end_diag_ls_down lc_ls_up_diag_act[0] lc_ls_up_diag_act[1] lc_ls_down_diag_act[0] lc_ls_down_diag_act[1] lc_ls_down_obd_1_man_deac[0] lc_ls_down_obd_1_man_deac[1] lc_ls_down_obd_2_man_deac[0] lc_ls_down_obd_2_man_deac[1] lc_ls_down_err[0] lc_ls_down_err[1] lc_err_chg_ls_up lc_err_chg_ls_down c_t_dly_diag_shift_down /end DEF_CHARACTERISTIC
 /begin OUT_MEASUREMENT egcp[0].egcp_struct_sigdglsl1.t_dly_diag_shift_down egcp[0].egcp_struct_sigdglsl1.lv_t_dly_diag_shift_down egcp[0].egcp_struct_sigdglsl1.lv_err_ls_down egcp[0].egcp_struct_sigdglsl1.lv_err_ls_up egcp[0].egcp_struct_sigdglsl1.lv_ls_up_diag_end egcp[0].egcp_struct_sigdglsl1.lv_ls_up_obd_1_man_deac egcp[0].egcp_struct_sigdglsl1.lv_ls_up_obd_2_man_deac egcp[0].egcp_struct_sigdglsl1.lv_ls_down_diag_end egcp[0].egcp_struct_sigdglsl1.lv_ls_down_obd_1_man_deac egcp[0].egcp_struct_sigdglsl1.lv_ls_down_obd_2_man_deac egcp[0].egcp_struct_sigdglsli1.state_rbm_shift_afl_lsl_up egcp[0].egcp_struct_sigdglsli1.state_rbm_shift_afr_lsl_up egcp[0].egcp_struct_sigdglsli1.state_rbm_obd_vld_lsh_up egcp[1].egcp_struct_sigdglsl1.t_dly_diag_shift_down egcp[1].egcp_struct_sigdglsl1.lv_t_dly_diag_shift_down egcp[1].egcp_struct_sigdglsl1.lv_err_ls_down egcp[1].egcp_struct_sigdglsl1.lv_err_ls_up egcp[1].egcp_struct_sigdglsl1.lv_ls_up_diag_end egcp[1].egcp_struct_sigdglsl1.lv_ls_up_obd_1_man_deac egcp[1].egcp_struct_sigdglsl1.lv_ls_up_obd_2_man_deac egcp[1].egcp_struct_sigdglsl1.lv_ls_down_diag_end egcp[1].egcp_struct_sigdglsl1.lv_ls_down_obd_1_man_deac egcp[1].egcp_struct_sigdglsl1.lv_ls_down_obd_2_man_deac egcp[1].egcp_struct_sigdglsli1.state_rbm_shift_afl_lsl_up egcp[1].egcp_struct_sigdglsli1.state_rbm_shift_afr_lsl_up egcp[1].egcp_struct_sigdglsli1.state_rbm_obd_vld_lsh_up lv_err_obd_vld_lsh_up_2 lv_err_dyn_vld_ls_up_2 lv_err_obd_vld_lsh_up_1 lv_err_dyn_vld_ls_up_1 lv_err_shift_afl_lsl_up_1 lv_err_shift_afr_lsl_up_1 lv_err_shift_afl_lsl_up_2 lv_err_shift_afr_lsl_up_2 /end OUT_MEASUREMENT
/end FUNCTION
/begin FUNCTION EGCP_O2_sensor_swap_sig_diag_ai "O2_sensor_swap_sig_diag_ai"
 /begin OUT_MEASUREMENT t_end_diag_chg_ls_up lv_inh_diag_chg_ls_up lv_inh_diag_rbm_chg_ls_up lv_inh_diag_chg_ls_down state_rbm_chg_ls_up /end OUT_MEASUREMENT
/end FUNCTION
/begin FUNCTION EGCP_O2_sensor_swap_sig_diag "O2_sensor_swap_sig_diag_ai"
 /begin DEF_CHARACTERISTIC c_t_end_diag_chg_ls_up c_maf_int_diag_chg_ls_up c_maf_int_diag_chg_ls_down c_fac_lam_lim_max_chg_ls_up c_fac_lam_lim_min_chg_ls_up c_fac_int_chg_ls_up c_vls_down_max_chg_ls_down c_vls_down_min_chg_ls_down c_fac_int_chg_ls_down /end DEF_CHARACTERISTIC
 /begin OUT_MEASUREMENT egcp[0].egcp_struct_pladgls2.lv_diag_sym_chg_ls_down egcp[1].egcp_struct_pladgls2.lv_diag_sym_chg_ls_down maf_int_diag_chg_ls_up maf_int_diag_chg_ls_down lv_err_chg_ls_up lv_ls_down_cdn_diag_chg /end OUT_MEASUREMENT
/end FUNCTION
/begin FUNCTION EGCP_O2_sensor_probe_diag_plaus "O2_sensor_probe_diag_plaus"
 /begin DEF_CHARACTERISTIC c_maf_int_diag_ls_up_down c_t_max_diag_afr_ls_up_down c_t_max_diag_afl_ls_up_down c_t_diag_eol_ls_up_down c_maf_int_eol_diag_ls_up_down c_lamb_afl_min_diag_ls_up_down c_lamb_afl_max_diag_ls_up_down c_lamb_afr_min_diag_ls_up_down c_lamb_afr_max_diag_ls_up_down c_vls_afr_thd_diag_act_ls_down c_vls_afl_thd_diag_act_ls_down c_lamb_sp_afr_diag_ls_up_down c_lamb_sp_afl_diag_ls_up_down c_lamb_sp_step_diag_ls_up_down lc_diag_auth_chk_ls_up_down c_abc_inc_chk_lsl_up c_lamb_afr_thd_diag_act_lsl_up c_lamb_afl_thd_diag_act_lsl_up c_ctr_sum_rst_afr_chk_lsl_up c_ctr_sum_rst_afl_chk_lsl_up c_abc_max_chk_lsl_up c_t_max_chk_ls_down c_t_end_diag_act_ls_down /end DEF_CHARACTERISTIC
 /begin OUT_MEASUREMENT egcp[0].egcp_struct_pladglsl1.lamb_sp_delta_ls_up_down egcp[0].egcp_struct_pladglsl1.maf_int_diag_ls_up_down egcp[0].egcp_struct_pladglsl1.lamb_sp_beg_diag_ls_up_down egcp[0].egcp_struct_pladglsl1.t_diag_act_afr_ls_up_down egcp[0].egcp_struct_pladglsl1.t_diag_act_afl_ls_up_down egcp[0].egcp_struct_pladglsl1.lamb_sp_diag_ls_up_down egcp[0].egcp_struct_pladglsl1.ctr_sum_rst_afr_chk_lsl_up egcp[0].egcp_struct_pladglsl1.ctr_sum_rst_afl_chk_lsl_up egcp[0].egcp_struct_pladglsl1.ctr_afr_chk_lsl_up egcp[0].egcp_struct_pladglsl1.ctr_afl_chk_lsl_up egcp[0].egcp_struct_pladglsl1.t_end_diag_act_ls_down egcp[0].egcp_struct_pladglsl1.t_afr_chk_ls_down egcp[0].egcp_struct_pladglsl1.t_afl_chk_ls_down egcp[0].egcp_struct_pladglsl1.state_diag_act_ls_up_down egcp[0].egcp_struct_pladglsl1.lv_diag_afl_cdn_ls_up_down egcp[0].egcp_struct_pladglsl1.lv_diag_afr_cdn_ls_up_down egcp[0].egcp_struct_pladglsl1.lv_diag_act_end_ls_up_down egcp[0].egcp_struct_pladglsl1.lv_lamb_sp_afr_req_diag_act egcp[0].egcp_struct_pladglsl1.lv_lamb_sp_afl_req_diag_act egcp[0].egcp_struct_pladglsl1.lv_lamb_sp_req_diag_act egcp[0].egcp_struct_pladglsl1.lv_diag_cyc_end_ls_down egcp[0].egcp_struct_pladglsl1.lv_lam_di_req egcp[0].egcp_struct_pladglsl1.lv_diag_afr_end_ls_up_down egcp[0].egcp_struct_pladglsl1.lv_diag_afl_end_ls_up_down egcp[0].egcp_struct_pladglsl1.lv_diag_afr_chk_sym_lsl_up egcp[0].egcp_struct_pladglsl1.lv_diag_afl_chk_sym_lsl_up egcp[0].egcp_struct_pladglsl1.lv_diag_act_chk_cdn_lsl_up egcp[0].egcp_struct_pladglsl1.lv_diag_act_chk_end_lsl_up egcp[0].egcp_struct_pladglsl1.lv_diag_eol_end_ls_up_down egcp[0].egcp_struct_pladglsl1.lv_diag_eol_dc_ls_up_down egcp[0].egcp_struct_pladglsl1.lv_sym_afl_chk_ls_down egcp[0].egcp_struct_pladglsl1.lv_sym_afr_chk_ls_down egcp[1].egcp_struct_pladglsl1.lamb_sp_delta_ls_up_down egcp[1].egcp_struct_pladglsl1.maf_int_diag_ls_up_down egcp[1].egcp_struct_pladglsl1.lamb_sp_beg_diag_ls_up_down egcp[1].egcp_struct_pladglsl1.t_diag_act_afr_ls_up_down egcp[1].egcp_struct_pladglsl1.t_diag_act_afl_ls_up_down egcp[1].egcp_struct_pladglsl1.lamb_sp_diag_ls_up_down egcp[1].egcp_struct_pladglsl1.ctr_sum_rst_afr_chk_lsl_up egcp[1].egcp_struct_pladglsl1.ctr_sum_rst_afl_chk_lsl_up egcp[1].egcp_struct_pladglsl1.ctr_afr_chk_lsl_up egcp[1].egcp_struct_pladglsl1.ctr_afl_chk_lsl_up egcp[1].egcp_struct_pladglsl1.t_end_diag_act_ls_down egcp[1].egcp_struct_pladglsl1.t_afr_chk_ls_down egcp[1].egcp_struct_pladglsl1.t_afl_chk_ls_down egcp[1].egcp_struct_pladglsl1.state_diag_act_ls_up_down egcp[1].egcp_struct_pladglsl1.lv_diag_afl_cdn_ls_up_down egcp[1].egcp_struct_pladglsl1.lv_diag_afr_cdn_ls_up_down egcp[1].egcp_struct_pladglsl1.lv_diag_act_end_ls_up_down egcp[1].egcp_struct_pladglsl1.lv_lamb_sp_afr_req_diag_act egcp[1].egcp_struct_pladglsl1.lv_lamb_sp_afl_req_diag_act egcp[1].egcp_struct_pladglsl1.lv_lamb_sp_req_diag_act egcp[1].egcp_struct_pladglsl1.lv_diag_cyc_end_ls_down egcp[1].egcp_struct_pladglsl1.lv_lam_di_req egcp[1].egcp_struct_pladglsl1.lv_diag_afr_end_ls_up_down egcp[1].egcp_struct_pladglsl1.lv_diag_afl_end_ls_up_down egcp[1].egcp_struct_pladglsl1.lv_diag_afr_chk_sym_lsl_up egcp[1].egcp_struct_pladglsl1.lv_diag_afl_chk_sym_lsl_up egcp[1].egcp_struct_pladglsl1.lv_diag_act_chk_cdn_lsl_up egcp[1].egcp_struct_pladglsl1.lv_diag_act_chk_end_lsl_up egcp[1].egcp_struct_pladglsl1.lv_diag_eol_end_ls_up_down egcp[1].egcp_struct_pladglsl1.lv_diag_eol_dc_ls_up_down egcp[1].egcp_struct_pladglsl1.lv_sym_afl_chk_ls_down egcp[1].egcp_struct_pladglsl1.lv_sym_afr_chk_ls_down lv_err_chk_ls_down_2 lv_err_chk_ls_down_1 lv_err_chg_ls_down /end OUT_MEASUREMENT
/end FUNCTION
/begin FUNCTION EGCP_O2_sensor_temperature "O2_sensor_temperature" /end FUNCTION
/begin FUNCTION EGCP_O2_sensor_down_diag_inci "O2_sensor_down_diag_inci" /begin DEF_CHARACTERISTIC lc_inh_ls_down_man_deac /end DEF_CHARACTERISTIC
 /begin OUT_MEASUREMENT egcp[0].egcp_struct_sigdglsdi2.lv_diag_mpl_inh_ls_down egcp[0].egcp_struct_sigdglsdi2.state_rbm_swt_ls_down egcp[0].egcp_struct_sigdglsdi2.state_rbm_pue_ls_down egcp[1].egcp_struct_sigdglsdi2.lv_diag_mpl_inh_ls_down egcp[1].egcp_struct_sigdglsdi2.state_rbm_swt_ls_down egcp[1].egcp_struct_sigdglsdi2.state_rbm_pue_ls_down /end OUT_MEASUREMENT
/end FUNCTION
/begin FUNCTION EGCP_O2_sensor_up_heater_diag_ai "O2_sensor_up_heater_diag_ai"
 /begin OUT_MEASUREMENT egcp[0].egcp_struct_fctdglslhi0.lv_inh_diag_obd_lsh_up egcp[1].egcp_struct_fctdglslhi0.lv_inh_diag_obd_lsh_up /end OUT_MEASUREMENT
/end FUNCTION
/end MODULE
/end PROJECT
