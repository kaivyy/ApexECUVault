ASAP2_VERSION 1 3
/begin PROJECT _725D601B "725D601B"
/begin HEADER "" VERSION "_725D601B" PROJECT_NO _725D601B /end HEADER
/begin MODULE DIM ""
/begin MOD_COMMON "" BYTE_ORDER MSB_FIRST ALIGNMENT_BYTE 1 ALIGNMENT_WORD 2 ALIGNMENT_LONG 2 ALIGNMENT_FLOAT32_IEEE 4 /end MOD_COMMON
/begin CHARACTERISTIC AFZBKLH "Anzahl Fahrzyklen mit Bed. K¸hlleistung hoch f¸r Stuck-Check TMOT" VALUE 0xFC7FAE KwWU8 255.0 dez 0.00 255.0 FORMAT "%5.1" /end CHARACTERISTIC
/begin CHARACTERISTIC AFZBKLN "Anzahl Fahrzyklen mit Bed. K¸hlleistung niedrig f¸r Stuck-Check TMOT" VALUE 0xFC7FAF KwWU8 255.0 dez 0.00 255.0 FORMAT "%5.1" /end CHARACTERISTIC
/begin CHARACTERISTIC AFZPTAFX "Anzahl Fahrzyklen f¸r Plausibilit‰ts-Check fixiertes TANS-Signal" VALUE 0xFD2322 KwUb 255.0 dez 0.00 255.0 FORMAT "%5.1" /end CHARACTERISTIC
/begin CHARACTERISTIC ALLPTAFX "Anzahl Leerlaufzyklen f¸r Plausibilit‰ts-Check fixiertes TANS-Signal" VALUE 0xFD2323 KwUb 255.0 dez 0.00 255.0 FORMAT "%5.1" /end CHARACTERISTIC
/begin CHARACTERISTIC CWBWEEN "Codewort zur Deaktivierung der Bewegungserkennung" VALUE 0xFC7E9E KwUb 255.0 dez 0.00 255.0 FORMAT "%5.1" /end CHARACTERISTIC
/begin CHARACTERISTIC CWGGLSU "Codewort f¸r GGLSU" VALUE 0xFC7E9C KwWU8 255.0 dez 0.00 255.0 FORMAT "%5.1" /end CHARACTERISTIC
/begin CHARACTERISTIC CWGLFETM "Codewort Fehlerpfad Motortemperatur" VALUE 0xFD54E2 KwWU8 255.0 DEZ 0.00 255.0 FORMAT "%5.1" /end CHARACTERISTIC
/begin CHARACTERISTIC CWHDMTL "Codewort HDMTL-Funktion" VALUE 0xFD48E8 KwUb 255.0 dez 0.00 255.0 FORMAT "%5.1" /end CHARACTERISTIC
/begin CHARACTERISTIC CWPG1 "Codewort f¸r Eigenschaften des Nockenwellensignals PG1" VALUE 0xFC80BE KwWU16 65535.00 dez 0.00 65535.00 FORMAT "%8.2" /end CHARACTERISTIC
/begin CHARACTERISTIC CWPG2 "Codewort f¸r Eigenschaften des Nockenwellensignals PG2" VALUE 0xFC80C0 KwWU16 65535.00 dez 0.00 65535.00 FORMAT "%8.2" /end CHARACTERISTIC
/begin CHARACTERISTIC CWPG3 "Codewort f¸r Eigenschaften des Nockenwellensignals PG3" VALUE 0xFC80C2 KwWU16 65535.00 dez 0.00 65535.00 FORMAT "%8.2" /end CHARACTERISTIC
/begin CHARACTERISTIC CWPG4 "Codewort f¸r Eigenschaften des Nockenwellensignals PG4" VALUE 0xFC80C4 KwWU16 65535.00 dez 0.00 65535.00 FORMAT "%8.2" /end CHARACTERISTIC
/begin CHARACTERISTIC CWPSL421 "Codewort Signalauswahl zur Ansteuerung der Enstufe 4.21 (ME9.2.1)" VALUE 0xFD27FA KwWU8 255.0 dez 0.00 255.0 FORMAT "%5.1" /end CHARACTERISTIC
/begin CHARACTERISTIC CWSTDH "Codeword zum Abschalten von B_stdhakt" VALUE 0xFC7FB0 KwWU8 255.0 dez 0.00 255.0 FORMAT "%5.1" /end CHARACTERISTIC
/begin CHARACTERISTIC CWTMREW "Codewort Refernztemperaturbildung" VALUE 0xFD236C KwUb 255.0 dez 0.00 255.0 FORMAT "%5.1" /end CHARACTERISTIC
/begin CHARACTERISTIC CWVERS "Code-Wort zur Aktivierung vfz-Ersatzwertberechnung bei E_vfz = false" VALUE 0xFC8094 KwWU8 255.0 dez 0.00 255.0 FORMAT "%5.1" /end CHARACTERISTIC
/begin CHARACTERISTIC DPHFLFR1 "Maximale Abweichung der Phasenflanke von PG1 nach fr¸h" VALUE 0xFC80B4 KwWU8 255.0 kw_q1 0.00 255.0 FORMAT "%5.1" /end CHARACTERISTIC
/begin CHARACTERISTIC DPHFLFR2 "Maximale Abweichung der Phasenflanke von PG2 nach fr¸h" VALUE 0xFC80B5 KwWU8 255.0 kw_q1 0.00 255.0 FORMAT "%5.1" /end CHARACTERISTIC
/begin CHARACTERISTIC DPHFLFR3 "Maximale Abweichung der Phasenflanke von PG3 nach fr¸h" VALUE 0xFC80B6 KwWU8 255.0 kw_q1 0.00 255.0 FORMAT "%5.1" /end CHARACTERISTIC
/begin CHARACTERISTIC DPHFLFR4 "Maximale Abweichung der Phasenflanke von PG4 nach fr¸h" VALUE 0xFC80B7 KwWU8 255.0 kw_q1 0.00 255.0 FORMAT "%5.1" /end CHARACTERISTIC
/begin CHARACTERISTIC DPHFLSP1 "Maximale Abweichung der Phasenflanke von PG1 nach sp‰t" VALUE 0xFC80B8 KwWU8 255.0 kw_q1 0.00 255.0 FORMAT "%5.1" /end CHARACTERISTIC
/begin CHARACTERISTIC DPHFLSP2 "Maximale Abweichung der Phasenflanke von PG2 nach sp‰t" VALUE 0xFC80B9 KwWU8 255.0 kw_q1 0.00 255.0 FORMAT "%5.1" /end CHARACTERISTIC
/begin CHARACTERISTIC DPHFLSP3 "Maximale Abweichung der Phasenflanke von PG3 nach sp‰t" VALUE 0xFC80BA KwWU8 255.0 kw_q1 0.00 255.0 FORMAT "%5.1" /end CHARACTERISTIC
/begin CHARACTERISTIC DPHFLSP4 "Maximale Abweichung der Phasenflanke von PG4 nach sp‰t" VALUE 0xFC80BB KwWU8 255.0 kw_q1 0.00 255.0 FORMAT "%5.1" /end CHARACTERISTIC
/begin CHARACTERISTIC DPRHLSU "Relative Heizleistungs‰nderung (delta) pro Zeit w‰hrend der Aufheizphase" VALUE 0xFD0454 KwWS16 99.99998 rel_q0p0061 0.00 99.99998 FORMAT "%8.4" /end CHARACTERISTIC
/begin CHARACTERISTIC DTAFIX "Delta TANS- Schwelle f¸r unplausibel fixiertes Signal" VALUE 0xFD2324 KwUb 191.3 temp_ub_b191p25 0.00 191.3 FORMAT "%5.1" /end CHARACTERISTIC
/begin CHARACTERISTIC DTAMLCONST "‹berblendwert L¸fteransteuerungs‰nderung" VALUE 0xFD236D KwSb 0.1868 temp_sb_b0p093 -0.09375 0.09302 FORMAT "%7.5" /end CHARACTERISTIC
/begin CHARACTERISTIC DTKATMMX "max. zul‰ssige Temperaturdifferenz zwischen TKA und TMOT f¸r Highsidedcheck" VALUE 0xFD25BC KwWU8 191.3 temp_ub_q0p75_o48 -48.00 143.3 FORMAT "%5.1" /end CHARACTERISTIC
/begin CHARACTERISTIC DTKLSUSTA "Max. zul‰ssige Temperaturabweichung vom Sollwert f¸r Heizerstatus A" VALUE 0xFD0456 KwWU16 1535.977 temp_q0p0234 0.00 1535.977 FORMAT "%8.3" /end CHARACTERISTIC
/begin CHARACTERISTIC DTKLSUSTB "Max. zul‰ssige Temperaturabweichung vom Sollwert f¸r Heizerstatus B" VALUE 0xFD0458 KwWU16 1535.977 temp_q0p0234 0.00 1535.977 FORMAT "%8.3" /end CHARACTERISTIC
/begin CHARACTERISTIC DTLRTML "Bewertungsfaktor Zeitdekrementierung f¸r Erreichen tmot-Einschaltschwelle LR" CURVE 0xFD236E KlAUbSstUbWUb 99.61 rel_ub_b99p6 0.00 99.61 FORMAT "%5.2"
 /begin AXIS_DESCR STD_AXIS mll1 m_ub_b1020 7 0.00 1020. FORMAT "%5.0" DEPOSIT ABSOLUTE /end AXIS_DESCR
/end CHARACTERISTIC
/begin CHARACTERISTIC DTMABSDTA "Schwelle Motortemperaturdiff. zw. Abstellen u. Start des Motors f¸r TANS-Diagn." VALUE 0xFD2325 KwUb 191.3 temp_ub_b191p25 0.00 191.3 FORMAT "%5.1" /end CHARACTERISTIC
/begin CHARACTERISTIC DTMDMA "Abstand Motortemperaturmodell zur Starttemperatur" VALUE 0xFD237D KwUb 191.3 temp_ub_b191p25 0.00 191.3 FORMAT "%5.1" /end CHARACTERISTIC
/begin CHARACTERISTIC DTMDNPO "Abstand Motortemperaturmodell zur oberen Unplausibilit‰tsschwelle" VALUE 0xFD237E KwUb 191.3 temp_ub_b191p25 0.00 191.3 FORMAT "%5.1" /end CHARACTERISTIC
/begin CHARACTERISTIC DTMFR "Delta TMOT-Schwelle f¸r R¸ckschaltfilter-Reset" VALUE 0xFD237F KwSb 191.3 temp_sb_q0p75 -96.00 95.25 FORMAT "%5.2" /end CHARACTERISTIC
/begin CHARACTERISTIC DTMPTA "Vergleichsschwelle Motortemperatur - Ansauglufttemperatur" VALUE 0xFD2326 KwUb 191.3 temp_ub_b191p25 0.00 191.3 FORMAT "%5.1" /end CHARACTERISTIC
/begin CHARACTERISTIC DTMSH "Delta-tmot-Schwelle Standheizungseinfluss ein" VALUE 0xFD2380 KwSb 191.3 temp_sb_q0p75 -96.00 95.25 FORMAT "%5.2" /end CHARACTERISTIC
/begin CHARACTERISTIC DTMSHA "Delta-tmot-Schwelle Standheizungseinfluss aus bei kleinem Delta-tmot" VALUE 0xFD2381 KwSb 191.3 temp_sb_q0p75 -96.00 95.25 FORMAT "%5.2" /end CHARACTERISTIC
/begin CHARACTERISTIC DTMSRT "Delta Motortemp.zu Starttemp. f.Retrigg. Modelle (Blockheater-Erkennung)" VALUE 0xFD2382 KwUb 191.3 temp_ub_b191p25 0.00 191.3 FORMAT "%5.1" /end CHARACTERISTIC
/begin CHARACTERISTIC DTTKAFX "Delta TKA- Schwelle f¸r unplausibel fixiertes Signal" VALUE 0xFD25BD KwWU8 191.3 temp_ub_q0p75_o48 -48.00 143.3 FORMAT "%5.1" /end CHARACTERISTIC
/begin CHARACTERISTIC DTUMABSTMX "Schwelle Abstell-zu Motorstarttemperatur" VALUE 0xFD253E KwWU8 255.0 temp_q1 0.00 255.0 FORMAT "%5.1" /end CHARACTERISTIC
/begin CHARACTERISTIC DTUMMSTMX "Schwelle Temperatur‰nderung  seit Motorstart" VALUE 0xFD253F KwWU8 255.0 temp_q1 0.00 255.0 FORMAT "%5.1" /end CHARACTERISTIC
/begin CHARACTERISTIC DTUMTA "Offset Ansauglufttemperatur -> Umgebungstemperatur" VALUE 0xFD2540 KwWS8 191.3 temp_sb_q0p75 -96.00 95.25 FORMAT "%5.2" /end CHARACTERISTIC
/begin CHARACTERISTIC DUPW12 "Zul‰ssige Spannungsabweichung zwischen PWG-Poti 1 und 2" VALUE 0xFC7E9F KwUb 4.980 spg_ub_b5 0.00 4.980 FORMAT "%5.3" /end CHARACTERISTIC
/begin CHARACTERISTIC DUPW12BE "notweniger Spannungsweg von Poti 2 zur Bewegungserkennung" VALUE 0xFC7EBC KwUw 4.995117 spg_uw_q0p00488 0.00 4.995117 FORMAT "%8.6" /end CHARACTERISTIC
/begin CHARACTERISTIC DUPW12TG "Zul‰ssige Spannungsabweichung zwischen PWG Poti 1 und  2 im Teilgasbereich" VALUE 0xFC7EA0 KwUb 4.980 spg_ub_b5 0.00 4.980 FORMAT "%5.3" /end CHARACTERISTIC
/begin CHARACTERISTIC DUPW12VG "Zul‰ssige Spannungsabweichung zwischen PWG-Poti 1 und 2 im Vollgasbereich" VALUE 0xFC7EA1 KwUb 4.980 spg_ub_b5 0.00 4.980 FORMAT "%5.3" /end CHARACTERISTIC
/begin CHARACTERISTIC DUPWGHY "Spannungshysterese bei Entjitterung der PWG-Spannung" VALUE 0xFC7EBE KwUw 4.995117 spg_uw_q0p00488 0.00 4.995117 FORMAT "%8.6" /end CHARACTERISTIC
/begin CHARACTERISTIC DURINLSU "maximal zul‰ssige Spannungs‰nderung f¸r Berechnung rinlsu_w" VALUE 0xFC7F54 KwWU16 319.9951 spg_q0p00488 0.00 319.9951 FORMAT "%8.4" /end CHARACTERISTIC
/begin CHARACTERISTIC DVERSBEG "Delta-Geschwindigkeit f¸r ƒnderungsbegrenzung Ersatzwert" VALUE 0xFC808E KwWU16 511.9922 vfzg_uw_b512 0.00 511.9922 FORMAT "%8.4" /end CHARACTERISTIC
/begin CHARACTERISTIC DVFZBEG "Delta-Geschwindigkeit f¸r ƒnderungsbegrenzung" VALUE 0xFC8098 KwWU16 511.9922 vfzg_uw_b512 0.00 511.9922 FORMAT "%8.4" /end CHARACTERISTIC
/begin CHARACTERISTIC DWPMXNB "Maximal zul‰ssige Pedalwerterhˆhung pro Rechenschritt nach Bremsbet‰tigung" VALUE 0xFC7EC0 KwUw 100.0000 relPED_uw_b100 0.00 100.0000 FORMAT "%8.4" /end CHARACTERISTIC
/begin CHARACTERISTIC DWPMXNOT "Maximal zul‰ssige Pedalwerterhˆhung pro Rechenschritt im PWG-Ersatzbetrieb" VALUE 0xFC7EC2 KwUw 100.0000 relPED_uw_b100 0.00 100.0000 FORMAT "%8.4" /end CHARACTERISTIC
/begin CHARACTERISTIC DWPOPBP "Pedalgradient zur Deaktivierung der PWG/Brems-Plaus." VALUE 0xFC7EC4 KwUw 100.0000 relPED_uw_b100 0.00 100.0000 FORMAT "%8.4" /end CHARACTERISTIC
/begin CHARACTERISTIC DWPPBP "Pedalwerterniedrigung pro Rechenschritt bei Plausibilit‰t Bremse/PWG" VALUE 0xFC7EC6 KwUw 100.0000 relPED_uw_b100 0.00 100.0000 FORMAT "%8.4" /end CHARACTERISTIC
/begin CHARACTERISTIC DZZST "Anzahl Z‰hne bei Zahnunterdr¸ckung im Start" VALUE 0xFC80CE KwWU8 249.0 dez 6.000 255.0 FORMAT "%5.1" /end CHARACTERISTIC
/begin CHARACTERISTIC FABSTT "Faktor Abstellzeit f¸r Modelltemparatur" CURVE 0xFD23CA KlAUwSstUwWUw 1.999969 fak_uw_b2 0.00 1.999969 FORMAT "%8.6"
 /begin AXIS_DESCR STD_AXIS tabst_w t1sxs_uw_q1 5 0.00 65535.00 FORMAT "%8.2" DEPOSIT ABSOLUTE /end AXIS_DESCR
/end CHARACTERISTIC
/begin CHARACTERISTIC FARIN "Umrechnungsfaktor f¸r Innenwiderstand Nernstzelle LSU" VALUE 0xFC7F56 KwWU16 1023.984 rpspg_q0p0156 0.00 1023.984 FORMAT "%8.3" /end CHARACTERISTIC
/begin CHARACTERISTIC FIPLSU "Faktor f¸r Umrechnung Spannung in Pumpstrom" VALUE 0xFC7E8A KwWU16 16383.75 ispg_q0p25 0.00 16383.75 FORMAT "%8.2" /end CHARACTERISTIC
/begin CHARACTERISTIC FIPREFLSU "Bewertungsfaktor f¸r den Pumpstrom" VALUE 0xFC7E9D KwWU8 31.88 i_q0p125_uA 0.00 31.88 FORMAT "%5.2" /end CHARACTERISTIC
/begin CHARACTERISTIC FLAMPFT "Druck-Korrekturfaktor f¸r Lambda fett" CURVE 0xFD22B8 KlAxU8SstxU16WU16 1.999969 fak_uw_b2 0.00 1.999969 FORMAT "%8.6"
 /begin AXIS_DESCR STD_AXIS palsu_w p_uw_q0p039 10 0.00 2559.961 FORMAT "%8.3" DEPOSIT ABSOLUTE /end AXIS_DESCR
/end CHARACTERISTIC
/begin CHARACTERISTIC FLAMPMR "Druck-Korrekturfaktor f¸r Lambda mager" CURVE 0xFD22E2 KlAxU8SstxU16WU16 1.999969 fak_uw_b2 0.00 1.999969 FORMAT "%8.6"
 /begin AXIS_DESCR STD_AXIS palsu_w p_uw_q0p039 10 0.00 2559.961 FORMAT "%8.3" DEPOSIT ABSOLUTE /end AXIS_DESCR
/end CHARACTERISTIC
/begin CHARACTERISTIC FLSUFTKL "Faktor zur Spannungsumrechung bei Verwendung der v=8-Kennlinie" VALUE 0xFC7E8C KwWU16 3.999939 fak_uw_b4 0.00 3.999939 FORMAT "%8.6" /end CHARACTERISTIC
/begin CHARACTERISTIC FSYNDEL "Prozentueller Segmentanteil f¸r erstes Zwangssynchro" VALUE 0xFC80CF KwWU8 50.00 rel_ub_b100 0.00 50.00 FORMAT "%5.2" /end CHARACTERISTIC
/begin CHARACTERISTIC GLFDTKAOFF "K¸hlmitteltemperaturschwelle GLF aus" VALUE 0xFD54E3 KwWU8 191.3 temp_ub_q0p75_o48 -48.00 143.3 FORMAT "%5.1" /end CHARACTERISTIC
/begin CHARACTERISTIC GLFDTKAON "K¸hlmitteltemperaturschwelle GLF ein" VALUE 0xFD54E4 KwWU8 191.3 temp_ub_q0p75_o48 -48.00 143.3 FORMAT "%5.1" /end CHARACTERISTIC
/begin CHARACTERISTIC GLFGEOFF "Getriebetemperaturschwelle GLF aus" VALUE 0xFD54E5 KwWU8 191.3 temp_ub_q0p75_o48 -48.00 143.3 FORMAT "%5.1" /end CHARACTERISTIC
/begin CHARACTERISTIC GLFGEON "Getriebetemperaturschwelle GLF ein" VALUE 0xFD54E6 KwWU8 191.3 temp_ub_q0p75_o48 -48.00 143.3 FORMAT "%5.1" /end CHARACTERISTIC
/begin CHARACTERISTIC GLFHOLD "Ausschaltverzˆgerungszeit GLF" VALUE 0xFD54E7 KwWU8 255.0 t1sxs_q1 0.00 255.0 FORMAT "%5.1" /end CHARACTERISTIC
/begin CHARACTERISTIC GLFLOFF "L¸fterstufe GLF aus" VALUE 0xFD54E8 KwWU8 255.0 DEZ 0.00 255.0 FORMAT "%5.1" /end CHARACTERISTIC
/begin CHARACTERISTIC GLFLON "L¸fterstufe GLF ein" VALUE 0xFD54E9 KwWU8 255.0 DEZ 0.00 255.0 FORMAT "%5.1" /end CHARACTERISTIC
/begin CHARACTERISTIC GLFNON "Drehzahlschwelle GLF ein" VALUE 0xFD54EA KwWU8 10200. nmot_ub_q40 0.00 10200. FORMAT "%5.0" /end CHARACTERISTIC
/begin CHARACTERISTIC GLFON "Einschaltverzˆgerungszeit GLF" VALUE 0xFD54EB KwWU8 255.0 t1sxs_q1 0.00 255.0 FORMAT "%5.1" /end CHARACTERISTIC
/begin CHARACTERISTIC GLFTKAOFF "K¸hlerausgangstemperaturschwelle GLF aus" VALUE 0xFD54EC KwWU8 191.3 temp_ub_q0p75_o48 -48.00 143.3 FORMAT "%5.1" /end CHARACTERISTIC
/begin CHARACTERISTIC GLFTKAON "K¸hlerausgangstemperaturschwelle GLF ein" VALUE 0xFD54ED KwWU8 191.3 temp_ub_q0p75_o48 -48.00 143.3 FORMAT "%5.1" /end CHARACTERISTIC
/begin CHARACTERISTIC GLFTOLOFF "÷ltemperaturschwelle GLF aus" VALUE 0xFD54EE KwWU8 191.3 temp_ub_q0p75_o48 -48.00 143.3 FORMAT "%5.1" /end CHARACTERISTIC
/begin CHARACTERISTIC GLFTOLON "÷ltemperaturschwelle GLF ein" VALUE 0xFD54EF KwWU8 191.3 temp_ub_q0p75_o48 -48.00 143.3 FORMAT "%5.1" /end CHARACTERISTIC
/begin CHARACTERISTIC GLFVOFF "Geschwindigkeitsschwelle GLF aus" VALUE 0xFD54F0 KwWU8 318.8 vfzg_ub_q1p25 0.00 318.8 FORMAT "%5.1" /end CHARACTERISTIC
/begin CHARACTERISTIC GLFVON "Geschwindigkeitsschwelle GLF ein" VALUE 0xFD54F1 KwWU8 318.8 vfzg_ub_q1p25 0.00 318.8 FORMAT "%5.1" /end CHARACTERISTIC
/begin CHARACTERISTIC IMTUMGTA "Schwelle integrierte Luftmasse f¸r Bestimmung Umgebungstemperatur" VALUE 0xFD2541 KwWU8 23.21 m_ub_b23p3 0.00 23.21 FORMAT "%5.2" /end CHARACTERISTIC
/begin CHARACTERISTIC KDHRLSU "D-Verst‰rkungsfaktor des PID-Reglers f¸r %HRLSU" VALUE 0xFD045A KwWU16 33.33282 reltemp_q5p086Em4 0.00 33.33282 FORMAT "%8.5" /end CHARACTERISTIC
/begin CHARACTERISTIC KFBS "Kennfeld f¸r banksel. Gemischfaktor" MAP 0xFC7498 KfAxUbAyUbSstxUbSstyUbWSb 0.4980 fak_sb_b0p25 -0.2500 0.2480
 /begin AXIS_DESCR STD_AXIS nmot nmot_ub_q40 6 0.00 10200. FORMAT "%5.0" DEPOSIT ABSOLUTE /end AXIS_DESCR
 /begin AXIS_DESCR STD_AXIS rl rel_ub_q0p75 6 0.00 191.3 FORMAT "%5.1" DEPOSIT ABSOLUTE /end AXIS_DESCR
/end CHARACTERISTIC
/begin CHARACTERISTIC KFDTMNK "Kennfeld f¸r Totzeit K¸hlwasserdurchlauf bei gergeltem Thermostat f¸r Referenzwe" MAP 0xFD23E0 KfAxUbAyUbSstxSwSstyUbWSw 6553.500 temp_sb_b0p093 -3276.800 3276.700 FORMAT "%8.3"
 /begin AXIS_DESCR STD_AXIS dtmrwp_w fak_q0p1 5 -3276.800 3276.700 FORMAT "%8.3" DEPOSIT ABSOLUTE /end AXIS_DESCR
 /begin AXIS_DESCR STD_AXIS tmrw temp_ub_q0p75_o48 5 -48.00 143.3 FORMAT "%5.1" DEPOSIT ABSOLUTE /end AXIS_DESCR
/end CHARACTERISTIC
/begin CHARACTERISTIC KFDTMRK "Kennfeld f¸r Totzeit K¸hlwasserdurchlauf bei gergeltem Thermostat f¸r Referenzwe" MAP 0xFD2424 KfAxUbAyUbSstxSwSstyUbWSw 199.9966 temp_sb_b0p093 -99.99976 99.99683 FORMAT "%8.4"
 /begin AXIS_DESCR STD_AXIS dtmrwt_w rel_sw_b100 5 -100.0000 99.99695 FORMAT "%8.4" DEPOSIT ABSOLUTE /end AXIS_DESCR
 /begin AXIS_DESCR STD_AXIS tmrw temp_ub_q0p75_o48 5 -48.00 143.3 FORMAT "%5.1" DEPOSIT ABSOLUTE /end AXIS_DESCR
/end CHARACTERISTIC
/begin CHARACTERISTIC KFDTMTE "Kennfeld Motortemperaturgradient f¸r Ersatztemperatur" MAP 0xFD2468 KfAxUbAyUbSstxUbSstyUbWSb 0.1868 temp_sb_b0p093 -0.09375 0.09302 FORMAT "%7.5"
 /begin AXIS_DESCR STD_AXIS mll1 m_ub_b1020 5 0.00 1020. FORMAT "%5.0" DEPOSIT ABSOLUTE /end AXIS_DESCR
 /begin AXIS_DESCR STD_AXIS tmew temp_ub_q0p75_o48 4 -48.00 143.3 FORMAT "%5.1" DEPOSIT ABSOLUTE /end AXIS_DESCR
/end CHARACTERISTIC
/begin CHARACTERISTIC KFDTMTR "Kennfeld Motortemperaturgradient f¸r Referenztemperatur" MAP 0xFD2487 KfAxUbAyUbSstxUbSstyUbWSb 0.1868 temp_sb_b0p093 -0.09375 0.09302 FORMAT "%7.5"
 /begin AXIS_DESCR STD_AXIS mll1 m_ub_b1020 5 0.00 1020. FORMAT "%5.0" DEPOSIT ABSOLUTE /end AXIS_DESCR
 /begin AXIS_DESCR STD_AXIS tmrw temp_ub_q0p75_o48 4 -48.00 143.3 FORMAT "%5.1" DEPOSIT ABSOLUTE /end AXIS_DESCR
/end CHARACTERISTIC
/begin CHARACTERISTIC KFDTMTU "Kennfeld Korrekturgradient Motortemperatur bei geringer Erw‰rmung" MAP 0xFD24A6 KfAxUbAyUbSstxUbSstyUbWSb 0.1868 temp_sb_b0p093 -0.09375 0.09302 FORMAT "%7.5"
 /begin AXIS_DESCR STD_AXIS mll1 m_ub_b1020 5 0.00 1020. FORMAT "%5.0" DEPOSIT ABSOLUTE /end AXIS_DESCR
 /begin AXIS_DESCR STD_AXIS tum temp_ub_q0p75_o48 4 -48.00 143.3 FORMAT "%5.1" DEPOSIT ABSOLUTE /end AXIS_DESCR
/end CHARACTERISTIC
/begin CHARACTERISTIC KFTDTMREOF "Abschaltschalttotzeit Motorabk¸hlung bei ausgeschaltetemThermostat" MAP 0xFD24C6 KfAxUbAyUbSstxUbSstyUwWUw 6553.500 t_q0p1 0.00 6553.500 FORMAT "%8.3"
 /begin AXIS_DESCR STD_AXIS nmot nmot_ub_q40 4 0.00 10000. FORMAT "%5.0" DEPOSIT ABSOLUTE /end AXIS_DESCR
 /begin AXIS_DESCR STD_AXIS tumg temp_ub_q0p75_o48 5 -48.00 143.3 FORMAT "%5.1" DEPOSIT ABSOLUTE /end AXIS_DESCR
/end CHARACTERISTIC
/begin CHARACTERISTIC KFTKAABKUE "Kennfeld TKA-Abk¸hlkurve" MAP 0xFD254C KfAxU8AyU8SstxU8SstyU16WU8 191.3 temp_ub_q0p75 0.00 191.3 FORMAT "%5.1"
 /begin AXIS_DESCR STD_AXIS dtkatumg temp_ub_q0p75 6 0.00 191.3 FORMAT "%5.1" DEPOSIT ABSOLUTE /end AXIS_DESCR
 /begin AXIS_DESCR STD_AXIS tabst_w t1sxs_uw_q1 6 0.00 65535.00 FORMAT "%8.2" DEPOSIT ABSOLUTE /end AXIS_DESCR
/end CHARACTERISTIC
/begin CHARACTERISTIC KIHRLSU "I-Verst‰rkungsfaktor des PID-Reglers f¸r %HRLSU" VALUE 0xFD045C KwWU16 16.66641 reltemp_q2p543Em4 0.00 16.66641 FORMAT "%8.5" /end CHARACTERISTIC
/begin CHARACTERISTIC KLDTMFXTM "Kennlinie Delta TMOT- Schwelle f¸r unplausibel fixiertes Signal" CURVE 0xFC7F70 KlAxU8SstxU8WU8 191.3 temp_ub_b191p25 0.00 191.3 FORMAT "%5.1"
 /begin AXIS_DESCR STD_AXIS tmotlin temp_ub_q0p75_o48 7 -48.00 143.3 FORMAT "%5.1" DEPOSIT ABSOLUTE /end AXIS_DESCR
/end CHARACTERISTIC
/begin CHARACTERISTIC KLDTMRS "Kennlinie Motortemperatur-Gradient im Schub f¸r Referenzmodell" CURVE 0xFD24FE KlAUbSstUbWSb 0.1868 temp_sb_b0p093 -0.09375 0.09302 FORMAT "%7.5"
 /begin AXIS_DESCR STD_AXIS tmrw temp_ub_q0p75_o48 5 -48.00 143.3 FORMAT "%5.1" DEPOSIT ABSOLUTE /end AXIS_DESCR
/end CHARACTERISTIC
/begin CHARACTERISTIC KLDTTKASC "max. zul‰ssige Temp-Differenz zwischen TKA und TUMG f¸r Freigabe des Stuckchecks" CURVE 0xFD2584 KlAxU8SstxU8WU8 191.3 temp_ub_q0p75 0.00 191.3 FORMAT "%5.1"
 /begin AXIS_DESCR STD_AXIS tumg temp_ub_q0p75_o48 6 -48.00 143.3 FORMAT "%5.1" DEPOSIT ABSOLUTE /end AXIS_DESCR
/end CHARACTERISTIC
/begin CHARACTERISTIC KLGLFAOFF "Kennlinie Ansauglufttemperaturschwelle GLF aus" CURVE 0xFD54B1 KlAxU8SstxU8WU8 191.3 temp_ub_q0p75_o48 -48.00 143.3 FORMAT "%5.1"
 /begin AXIS_DESCR STD_AXIS vfzg vfzg_ub_q1p25 8 0.00 318.8 FORMAT "%5.1" DEPOSIT ABSOLUTE /end AXIS_DESCR
/end CHARACTERISTIC
/begin CHARACTERISTIC KLGLFAON "Kennlinie Ansauglufttemperaturschwelle GLF ein" CURVE 0xFD54C2 KlAxU8SstxU8WU8 191.3 temp_ub_q0p75_o48 -48.00 143.3 FORMAT "%5.1"
 /begin AXIS_DESCR STD_AXIS vfzg vfzg_ub_q1p25 8 0.00 318.8 FORMAT "%5.1" DEPOSIT ABSOLUTE /end AXIS_DESCR
/end CHARACTERISTIC
/begin CHARACTERISTIC KLGLFLAST "Kennlinie Lastschwelle ¸ber nmot_w" CURVE 0xFD54D3 KlAxU8SstxU8WU8 191.3 rel_ub_q0p75 0.00 191.3 FORMAT "%5.1"
 /begin AXIS_DESCR STD_AXIS nmot nmot_ub_q40 7 0.00 10200. FORMAT "%5.0" DEPOSIT ABSOLUTE /end AXIS_DESCR
/end CHARACTERISTIC
/begin CHARACTERISTIC KLKTKVK "Kennlinie: Proportionalit‰tsfaktor zw. T-Abweichung der LSU und Korrekturfaktor" CURVE 0xFC7ECC KlAxU8SstxS16WU16 1.999969 fak_uw_b2 0.00 1.999969 FORMAT "%8.6"
 /begin AXIS_DESCR STD_AXIS rdtklsu_w temp_q0p0234 11 -768.0000 767.9766 FORMAT "%8.4" DEPOSIT ABSOLUTE /end AXIS_DESCR
/end CHARACTERISTIC
/begin CHARACTERISTIC KLPRHLSU "Initialisierungs-Kennlinie f¸r relative Heizleistung" CURVE 0xFD0442 KlAxU8SstxU16WS16 99.99998 rel_q0p0061 0.00 99.99998 FORMAT "%8.4"
 /begin AXIS_DESCR STD_AXIS tatuk_w temp_q0p0234_o273 4 -273.1500 1262.827 FORMAT "%8.3" DEPOSIT ABSOLUTE /end AXIS_DESCR
/end CHARACTERISTIC
/begin CHARACTERISTIC KLRTLSU "Kennlinie Transformation Innenwiderstand der Nernstzelle in Temperatur" CURVE 0xFC7EFA KlAxU8SstxU16WU16 1535.977 temp_q0p0234_o273 -273.1500 1262.827 FORMAT "%8.3"
 /begin AXIS_DESCR STD_AXIS rinlsu_w r_q0p0391 22 0.00 2559.961 FORMAT "%8.3" DEPOSIT ABSOLUTE /end AXIS_DESCR
/end CHARACTERISTIC
/begin CHARACTERISTIC KLTDTMREON "Einschaltschalttotzeit Motorabk¸hlung bei angesteuertem Thermostat" CURVE 0xFD2383 KlAUbSstUbWUb 25.50 t_q0p1 0.00 25.50 FORMAT "%5.2"
 /begin AXIS_DESCR STD_AXIS tumg temp_ub_q0p75_o48 4 -48.00 143.3 FORMAT "%5.1" DEPOSIT ABSOLUTE /end AXIS_DESCR
/end CHARACTERISTIC
/begin CHARACTERISTIC KNLSYN "Sicherheitsfaktor f¸r Notlauf-Synchronisationsbedingung" VALUE 0xFC80C6 KwWU16 655.3500 fak_uw_q0p01 0.00 655.3500 FORMAT "%8.4" /end CHARACTERISTIC
/begin CHARACTERISTIC KPHRLSU "P-Verst‰rkungsfaktor des PID-Reglers f¸r %HRLSU" VALUE 0xFD045E KwWU16 33.33282 reltemp_q5p086Em4 0.00 33.33282 FORMAT "%8.5" /end CHARACTERISTIC
/begin CHARACTERISTIC MIFAMXNOT "maximales relativ Moment im Pedal Fehler" CURVE 0xFD230C KlAUbSstUbWUb 99.61 rel_ub_b99p6 0.00 99.61 FORMAT "%5.2"
 /begin AXIS_DESCR STD_AXIS nmot nmot_ub_q40 8 0.00 10200. FORMAT "%5.0" DEPOSIT ABSOLUTE /end AXIS_DESCR
/end CHARACTERISTIC
/begin CHARACTERISTIC MLDTAMN "Min.-Schwelle Motorluftmassendurchsatz f¸r Plaus.-Check Ansauglufttemp. TANS" VALUE 0xFD2327 KwUb 1020. m_ub_b1020 0.00 1020. FORMAT "%5.0" /end CHARACTERISTIC
/begin CHARACTERISTIC MLDTAMX "Max.-Schwelle Motorluftmassendurchsatz f¸r Plaus.-Check Ansauglufttemp. TANS" VALUE 0xFD2328 KwUb 1020. m_ub_b1020 0.00 1020. FORMAT "%5.0" /end CHARACTERISTIC
/begin CHARACTERISTIC MLOBKLHV "Max. Luftmassendurchsatz f¸r Bedingung K¸hlleistung hoch" CURVE 0xFC7F7F KlAxU8SstxU8WU8 1020. m_ub_b1020 0.00 1020. FORMAT "%5.0"
 /begin AXIS_DESCR STD_AXIS vfzg vfzg_ub_q1p25 5 0.00 318.8 FORMAT "%5.1" DEPOSIT ABSOLUTE /end AXIS_DESCR
/end CHARACTERISTIC
/begin CHARACTERISTIC MLOBKLNV "Max. Luftmassendurchsatz f¸r Bedingung K¸hlleistung niedrig" CURVE 0xFC7F8A KlAxU8SstxU8WU8 1020. m_ub_b1020 0.00 1020. FORMAT "%5.0"
 /begin AXIS_DESCR STD_AXIS vfzg vfzg_ub_q1p25 5 0.00 318.8 FORMAT "%5.1" DEPOSIT ABSOLUTE /end AXIS_DESCR
/end CHARACTERISTIC
/begin CHARACTERISTIC MLPTAFXO "oberes Limit f¸r Motorluftmassendurchsatz bei Check Ansauglufttemp. TANS fixiert" VALUE 0xFD2329 KwUb 1020. m_ub_b1020 0.00 1020. FORMAT "%5.0" /end CHARACTERISTIC
/begin CHARACTERISTIC MLPTAFXU "unteres Limit f. Motorluftmassendurchsatz bei Check Ansauglufttemp. TANS fixiert" VALUE 0xFD232A KwUb 1020. m_ub_b1020 0.00 1020. FORMAT "%5.0" /end CHARACTERISTIC
/begin CHARACTERISTIC MLUBKLHV "Min. Luftmassendurchsatz f¸r Bedingung K¸hlleistung hoch" CURVE 0xFC7F95 KlAxU8SstxU8WU8 1020. m_ub_b1020 0.00 1020. FORMAT "%5.0"
 /begin AXIS_DESCR STD_AXIS vfzg vfzg_ub_q1p25 5 0.00 318.8 FORMAT "%5.1" DEPOSIT ABSOLUTE /end AXIS_DESCR
/end CHARACTERISTIC
/begin CHARACTERISTIC MLUBKLNV "Min. Luftmassendurchsatz f¸r Bedingung K¸hlleistung niedrig" CURVE 0xFC7FA0 KlAxU8SstxU8WU8 1020. m_ub_b1020 0.00 1020. FORMAT "%5.0"
 /begin AXIS_DESCR STD_AXIS vfzg vfzg_ub_q1p25 5 0.00 318.8 FORMAT "%5.1" DEPOSIT ABSOLUTE /end AXIS_DESCR
/end CHARACTERISTIC
/begin CHARACTERISTIC NMIN "Minimal Drehzahl" VALUE 0xFC80D0 KwWU8 235.0 nmot_q1 20.00 255.0 FORMAT "%5.1" /end CHARACTERISTIC
/begin CHARACTERISTIC NMOTFIL "Drehzahlschwelle f¸r die Umschaltung nach Zahnzeitmittelung" VALUE 0xFC80D1 KwWU8 10200. nmot_ub_q40 0.00 10200. FORMAT "%5.0" /end CHARACTERISTIC
/begin CHARACTERISTIC NMOTFILHS "Hysteresis Deltawert f¸r die Umschaltung nach Zahnzeitmittelung" VALUE 0xFC80D2 KwWU8 10200. nmot_ub_q40 0.00 10200. FORMAT "%5.0" /end CHARACTERISTIC
/begin CHARACTERISTIC NMOTQSYN "Motordrehzahlschwelle zur Freigabe des Schnellstarts ¸ber PG Schnellstart" VALUE 0xFC80C8 KwWU16 600.0000 nmot_q1 0.00 600.0000 FORMAT "%8.4" /end CHARACTERISTIC
/begin CHARACTERISTIC NMOTTKASC "Motordrehzahlschwelle f¸r TKA-Stuckcheck, damit Wasserpumpe hˆhere Durchs‰tze pu" VALUE 0xFD25BE KwWU8 10200. nmot_ub_q40 0.00 10200. FORMAT "%5.0" /end CHARACTERISTIC
/begin CHARACTERISTIC NMXPHPOS "Drehzahlschwelle f¸r des ‹berpr¸fung Geberradeinbaus" VALUE 0xFC80BC KwWU8 10200. nmot_ub_q40 0.00 10200. FORMAT "%5.0" /end CHARACTERISTIC
/begin CHARACTERISTIC NTUMGTA "Schwelle Drehzahl f¸r Bestimmung Umgebungstemperatur aus TANS" VALUE 0xFD2542 KwWU8 10200. nmot_ub_q40 0.00 10200. FORMAT "%5.0" /end CHARACTERISTIC
/begin CHARACTERISTIC NWOFFSET "Offset der ersten positiven Flanke des NW-Signals zu SW-BM Zyl. 1" VAL_BLK 0xFC809E KwbWU8 255.0 dez 0.00 255.0 FORMAT "%5.1" NUMBER 4 /end CHARACTERISTIC
/begin CHARACTERISTIC NWPMBBR "Mindestdrehzahl f¸r Pedalwertbegrenzung bei bet‰tigter Bremse" VALUE 0xFC7EA2 KwUb 10200. nmot_ub_q40 0.00 10200. FORMAT "%5.0" /end CHARACTERISTIC
/begin CHARACTERISTIC NWSIGNAL "Ablageschema der Nockenwelle" VAL_BLK 0xFC80A2 KwbWU8 255.0 dez 0.00 255.0 FORMAT "%5.1" NUMBER 9 /end CHARACTERISTIC
/begin CHARACTERISTIC NWSIGTOL "Toleranz der Nockenwellenflanken auf KW Zahnbasis" VALUE 0xFC80BD KwWU8 255.0 dez 0.00 255.0 FORMAT "%5.1" /end CHARACTERISTIC
/begin CHARACTERISTIC O2VK "Umrechnung  Spannung / O2, LSU-Sonde vor Katalysator" CURVE 0xFC7E48 KlAxU8SstxS16WS16 63.99902 relO2_q9p765Em4 -32.00000 31.99902 FORMAT "%8.5"
 /begin AXIS_DESCR STD_AXIS ipktk_w i_q1_uA 16 -32768.00 32767.00 FORMAT "%8.2" DEPOSIT ABSOLUTE /end AXIS_DESCR
/end CHARACTERISTIC
/begin CHARACTERISTIC OFQSYNADAP "Offset zwischen adaptierter Phasenflanke und Phasenflanke im Start" VALUE 0xFC80D3 KwWS8 255.0 kw_q1 -128.0 127.0 FORMAT "%5.1" /end CHARACTERISTIC
/begin CHARACTERISTIC PHLSNHMN "Heizleistung f¸r ausreichende Sondenheizung" VALUE 0xFD0404 KwUb 2.550 fak_ub_q0p01 0.00 2.550 FORMAT "%5.3" /end CHARACTERISTIC
/begin CHARACTERISTIC PRHLSUL "Kleine relative Heizleistung bis zum Erreichen der Bedingung Taupunktende" VALUE 0xFD0460 KwWU16 199.9969 rel_uw_b200 0.00 199.9969 FORMAT "%8.4" /end CHARACTERISTIC
/begin CHARACTERISTIC RINCAL "Kalibrierwiderstand f¸r Innenwiderstand Nernstzelle" VALUE 0xFC7F58 KwWU16 2559.961 r_q0p0391 0.00 2559.961 FORMAT "%8.3" /end CHARACTERISTIC
/begin CHARACTERISTIC RININI "Initialisierungswert von rinlsu_w ( Widerstandswert der Nernstzelle LSU)" VALUE 0xFC7F5A KwWU16 2559.961 r_q0p0391 0.00 2559.961 FORMAT "%8.3" /end CHARACTERISTIC
/begin CHARACTERISTIC STNSG1 "St¸tzstellenverteilung nmot-1 SG-Temperaturhistogramm" VALUE 0xFD25C6 KwUb 10200. nmot_ub_q40 0.00 10200. FORMAT "%5.0" /end CHARACTERISTIC
/begin CHARACTERISTIC STNSG2 "St¸tzstellenverteilung nmot-2 SG-Temperaturhistogramm" VALUE 0xFD25C7 KwUb 10200. nmot_ub_q40 0.00 10200. FORMAT "%5.0" /end CHARACTERISTIC
/begin CHARACTERISTIC STNSG3 "St¸tzstellenverteilung nmot-3 SG-Temperaturhistogramm" VALUE 0xFD25C8 KwUb 10200. nmot_ub_q40 0.00 10200. FORMAT "%5.0" /end CHARACTERISTIC
/begin CHARACTERISTIC STNSG4 "St¸tzstellenverteilung nmot-4 SG-Temperaturhistogramm" VALUE 0xFD25C9 KwUb 10200. nmot_ub_q40 0.00 10200. FORMAT "%5.0" /end CHARACTERISTIC
/begin CHARACTERISTIC STNSG5 "St¸tzstellenverteilung nmot-5 SG-Temperaturhistogramm" VALUE 0xFD25CA KwUb 10200. nmot_ub_q40 0.00 10200. FORMAT "%5.0" /end CHARACTERISTIC
/begin CHARACTERISTIC STTSG1 "St¸tzstellenverteilung 1 tsg  SG-Temperaturhistogramm" VALUE 0xFD25CB KwUb 191.3 temp_ub_q0p75_o48 -48.00 143.3 FORMAT "%5.1" /end CHARACTERISTIC
/begin CHARACTERISTIC STTSG2 "St¸tzstellenverteilung 2 tsg  SG-Temperaturhistogramm" VALUE 0xFD25CC KwUb 191.3 temp_ub_q0p75_o48 -48.00 143.3 FORMAT "%5.1" /end CHARACTERISTIC
/begin CHARACTERISTIC STTSG3 "St¸tzstellenverteilung 3 tsg  SG-Temperaturhistogramm" VALUE 0xFD25CD KwUb 191.3 temp_ub_q0p75_o48 -48.00 143.3 FORMAT "%5.1" /end CHARACTERISTIC
/begin CHARACTERISTIC STTSG4 "St¸tzstellenverteilung 4 tsg  SG-Temperaturhistogramm" VALUE 0xFD25CE KwUb 191.3 temp_ub_q0p75_o48 -48.00 143.3 FORMAT "%5.1" /end CHARACTERISTIC
/begin CHARACTERISTIC STTSG5 "St¸tzstellenverteilung 5 tsg  SG-Temperaturhistogramm" VALUE 0xFD25CF KwUb 191.3 temp_ub_q0p75_o48 -48.00 143.3 FORMAT "%5.1" /end CHARACTERISTIC
/begin CHARACTERISTIC TABGL "Zeit f¸r LSU-Abgleich" VALUE 0xFC7E8E KwWU16 655.3500 t10msxs_uw_b655p35 0.00 655.3500 FORMAT "%8.4" /end CHARACTERISTIC
/begin CHARACTERISTIC TABGS "Zeit nach Start f¸r LSU-Abgleich" VALUE 0xFC7E90 KwWU16 655.3500 t10msxs_uw_b655p35 0.00 655.3500 FORMAT "%8.4" /end CHARACTERISTIC
/begin CHARACTERISTIC TABSTDH "Einschaltschwelle aus Abstellzeit f¸r Standheizung" VALUE 0xFC7FAC KwWU16 65535.00 t1sxs_uw_q1 0.00 65535.00 FORMAT "%8.2" /end CHARACTERISTIC
/begin CHARACTERISTIC TABSTRILSU "Abstellzeit f¸r Freigabe ri-Berechnung" VALUE 0xFD0462 KwWU16 65535.00 t1sxs_uw_q1 0.00 65535.00 FORMAT "%8.2" /end CHARACTERISTIC
/begin CHARACTERISTIC TADE "Ersatzgrˆﬂe Lufttemperatur im Fehlerfall" VALUE 0xFD232B KwUb 191.3 temp_ub_q0p75_o48 -48.00 143.3 FORMAT "%5.1" /end CHARACTERISTIC
/begin CHARACTERISTIC TADMM "1. Stufenbreite (Zeit) f¸r Motortemperaturmodell" VALUE 0xFD250A KwUw 6553.500 t100msxs_uw_b6553p5 0.00 6553.500 FORMAT "%8.3" /end CHARACTERISTIC
/begin CHARACTERISTIC TADMN "Ansauglufttemperatur min." VALUE 0xFD232C KwUb 191.3 temp_ub_q0p75_o48 -48.00 143.3 FORMAT "%5.1" /end CHARACTERISTIC
/begin CHARACTERISTIC TADMX "Ansauglufttemperatur max." VALUE 0xFD232D KwUb 191.3 temp_ub_q0p75_o48 -48.00 143.3 FORMAT "%5.1" /end CHARACTERISTIC
/begin CHARACTERISTIC TADPLMX "oberes Limit f¸r plausibles Ansauglufttemp.-Signal TANS" VALUE 0xFD232E KwUb 191.3 temp_ub_q0p75_o48 -48.00 143.3 FORMAT "%5.1" /end CHARACTERISTIC
/begin CHARACTERISTIC TANHKMMN "Kat-Temperatur f¸r ausreichende Sondenheizung" VALUE 0xFD040C KwUw 1535.977 temp_q0p0234_o273 -273.1500 1262.827 FORMAT "%8.3" /end CHARACTERISTIC
/begin CHARACTERISTIC TANSELI "Temperatur Ansaugluft-Erfassung u. Linearisierung, Inverskennlinie" CURVE 0xFD232F KlAUbSstUbWUb 191.3 temp_ub_q0p75_o48 -48.00 143.3 FORMAT "%5.1"
 /begin AXIS_DESCR STD_AXIS wtans spg_ub_b5 20 0.00 4.980 FORMAT "%5.3" DEPOSIT ABSOLUTE /end AXIS_DESCR
/end CHARACTERISTIC
/begin CHARACTERISTIC TATAMLTMRW "Abtastung D-Glied" VALUE 0xFD238C KwUb 25.50 t100msxs_ub_b25p5 0.00 25.50 FORMAT "%5.2" /end CHARACTERISTIC
/begin CHARACTERISTIC TDBKLOFF "Abschaltzeit f¸r Bed. K¸hlleistung nach ununterbrochenem Verlassen des Bereichs" VALUE 0xFC7FB1 KwWU8 25.50 t_q0p1 0.00 25.50 FORMAT "%5.2" /end CHARACTERISTIC
/begin CHARACTERISTIC TDFZTAFX "Entprellzeit Fahrzyklus f¸r Plausibilit‰ts-Check fixiertes TANS-Signal" VALUE 0xFD2358 KwUb 255.0 t1sxs_ub_b255 0.00 255.0 FORMAT "%5.1" /end CHARACTERISTIC
/begin CHARACTERISTIC TDLLTAFX "Entprellzeit Leerlauf f¸r Plausibilit‰ts-Check fixiertes TANS-Signal" VALUE 0xFD2359 KwUb 255.0 t1sxs_ub_b255 0.00 255.0 FORMAT "%5.1" /end CHARACTERISTIC
/begin CHARACTERISTIC TDNSTA "Auspufferw‰rmzeit ab Start, f¸r TANS - Diagnose" VALUE 0xFD235A KwUb 255.0 t1sxs_ub_b255 0.00 255.0 FORMAT "%5.1" /end CHARACTERISTIC
/begin CHARACTERISTIC TDNSUB "Batterie - Erholzeit ab Start, f¸r UBATT - Diagnose" VALUE 0xFC7FBB KwUb 255.0 t100msxs_ub_b255 0.00 255.0 FORMAT "%5.1" /end CHARACTERISTIC
/begin CHARACTERISTIC TDPLTAO "Entprellzeit f¸r oberen Plausibilit‰tscheck des Ansauglufttemp.-Signals TANS" VALUE 0xFD235B KwUb 255.0 t1sxs_ub_b255 0.00 255.0 FORMAT "%5.1" /end CHARACTERISTIC
/begin CHARACTERISTIC TDTA "Entprellzeit Fehlererkennung TANS" VALUE 0xFD235C KwUb 25.50 t100msxs_ub_b25p5 0.00 25.50 FORMAT "%5.2" /end CHARACTERISTIC
/begin CHARACTERISTIC TDTAL "TANS Fehlererkennung / Zeitsperre ab B_LL = 1" VALUE 0xFD235D KwUb 255.0 t1sxs_ub_b255 0.00 255.0 FORMAT "%5.1" /end CHARACTERISTIC
/begin CHARACTERISTIC TDTAPL "Entprellzeit f¸r Plausibilit‰tscheck Ansauglufttemperatur TANS" VALUE 0xFD235E KwUb 255.0 t1sxs_ub_b255 0.00 255.0 FORMAT "%5.1" /end CHARACTERISTIC
/begin CHARACTERISTIC TDTKAUS "Entprellzeit Fehlererkennung Temperatur K¸hlerausgang" VALUE 0xFD25BF KwWU8 25.50 t_q0p1 0.00 25.50 FORMAT "%5.2" /end CHARACTERISTIC
/begin CHARACTERISTIC TDTM "Entprellzeit Fehlererkennung, Motortemperatursensor" VALUE 0xFD250C KwUw 6553.500 t100msxs_uw_b6553p5 0.00 6553.500 FORMAT "%8.3" /end CHARACTERISTIC
/begin CHARACTERISTIC TDTMMA "Verzˆgerungszeit Anfangswert Motortemperaturmodell" VALUE 0xFD250E KwUw 6553.500 t100msxs_uw_b6553p5 0.00 6553.500 FORMAT "%8.3" /end CHARACTERISTIC
/begin CHARACTERISTIC TDTUMHEAL "Entprellzeit Heilung" VALUE 0xFD2543 KwWU8 25.50 t100msxs_ub_b25p5 0.00 25.50 FORMAT "%5.2" /end CHARACTERISTIC
/begin CHARACTERISTIC TDTUMNPL "Entprellzeit NPL-Fehler" VALUE 0xFD2544 KwWU8 25.50 t100msxs_ub_b25p5 0.00 25.50 FORMAT "%5.2" /end CHARACTERISTIC
/begin CHARACTERISTIC TDTUMSIG "Entprellzeit SIG-Fehler" VALUE 0xFD2545 KwWU8 25.50 t100msxs_ub_b25p5 0.00 25.50 FORMAT "%5.2" /end CHARACTERISTIC
/begin CHARACTERISTIC TDUB "Wartezeit f¸r UBATT-Diagnose" VALUE 0xFC7FBC KwUb 25.50 t100msxs_ub_b25p5 0.00 25.50 FORMAT "%5.2" /end CHARACTERISTIC
/begin CHARACTERISTIC TDVTAPL "Wartezeit nach Fz-Geschwindigk.-Schwelle f.Plaus-Check Ansauglufttemperatur TANS" VALUE 0xFD235F KwUb 255.0 t1sxs_ub_b255 0.00 255.0 FORMAT "%5.1" /end CHARACTERISTIC
/begin CHARACTERISTIC TDWPOPBP "Entprellzeit zur Deaktivierung der PWG/Brems-Plaus. ¸ber Pedalgradient" VALUE 0xFC7EA3 KwUb 2.550 t10msxs_ub_b2p55 0.00 2.550 FORMAT "%5.3" /end CHARACTERISTIC
/begin CHARACTERISTIC TFGRVRAB "FGR: Zeit f¸r Geschwindigkeitsabschaltung ¸ber vroh =0" VALUE 0xFC8095 KwWU8 2.550 t_q0p01 0.00 2.550 FORMAT "%5.3" /end CHARACTERISTIC
/begin CHARACTERISTIC TFPWG2 "Filterzeit zur Filterung von Poti 2 bei der Bewegungserkennung" VALUE 0xFC7EC8 KwUw 655.34999985 zk10msxs_uw_b655 0.010000152590 655.36000000 FORMAT "%12.8" /end CHARACTERISTIC
/begin CHARACTERISTIC TGLFLASTOF "Zeit f¸r Lastschwelle GLF aus" VALUE 0xFD54F2 KwWU8 255.0 t_q1 0.00 255.0 FORMAT "%5.1" /end CHARACTERISTIC
/begin CHARACTERISTIC TGLFLASTON "Zeit f¸r Lastschwelle GLF ein" VALUE 0xFD54F3 KwWU8 255.0 t_q1 0.00 255.0 FORMAT "%5.1" /end CHARACTERISTIC
/begin CHARACTERISTIC THHA "Auszeit f¸r Reduzierung der Heizleistung Sonde hinter Kat bei 13V" VALUE 0xFD0405 KwUb 2.550 t10msxs_q0p01_o0p05 -0.05000 2.500 FORMAT "%5.3" /end CHARACTERISTIC
/begin CHARACTERISTIC THHA2 "Auszeit f¸r Reduzierung der Heizleistung Sonde2 hinter Kat bei 13V" VALUE 0xFD0406 KwUb 2.550 t10msxs_q0p01_o0p05 -0.05000 2.500 FORMAT "%5.3" /end CHARACTERISTIC
/begin CHARACTERISTIC THHAWU "Ausschaltzeit w‰hrend Leistungsreduzierung Sondenheizung hinter Kat" VALUE 0xFD0407 KwUb 2.550 t10msxs_ub_b2p55 0.00 2.550 FORMAT "%5.3" /end CHARACTERISTIC
/begin CHARACTERISTIC THLSUHR "Verzˆgerungszeit zum Setzen der Bedingung B_henrin nach Einschalten der Heizung" VALUE 0xFD0468 KwWU8 25.50 t100msxs_ub_b25p5 0.00 25.50 FORMAT "%5.2" /end CHARACTERISTIC
/begin CHARACTERISTIC THLSUHRST "Verzˆgerungszeit zum Setzen von B_henrin nach Einschalten der Heizung  im Start" VALUE 0xFD0469 KwWU8 25.50 t100msxs_ub_b25p5 0.00 25.50 FORMAT "%5.2" /end CHARACTERISTIC
/begin CHARACTERISTIC THSHA "Verzˆgerungszeit f¸r Sonde ausreichend beheizt" VALUE 0xFD0408 KwUb 25.50 t100msxs_ub_b25p5 0.00 25.50 FORMAT "%5.2" /end CHARACTERISTIC
/begin CHARACTERISTIC THSHKTK "Kennlinie f¸r die Ausschaltdauer der Sondenheizung abh. v.d. Abgastemp. h.Kat" CURVE 0xFD040E KlAUbSstUwWUb 2.550 t10msxs_q0p01_o0p05 -0.05000 2.500 FORMAT "%5.3"
 /begin AXIS_DESCR STD_AXIS tanhkm_w temp_q0p0234_o273 8 -273.1500 1262.827 FORMAT "%8.3" DEPOSIT ABSOLUTE /end AXIS_DESCR
/end CHARACTERISTIC
/begin CHARACTERISTIC THSHKTK2 "Kennlinie f¸r die Ausschaltdauer der Sondenheizung2 abh. v.d. Abgastemp. h.Kat" CURVE 0xFD0428 KlAUbSstUwWUb 2.550 t10msxs_q0p01_o0p05 -0.05000 2.500 FORMAT "%5.3"
 /begin AXIS_DESCR STD_AXIS tanhkm2_w temp_q0p0234_o273 8 -273.1500 1262.827 FORMAT "%8.3" DEPOSIT ABSOLUTE /end AXIS_DESCR
/end CHARACTERISTIC
/begin CHARACTERISTIC TKAELI "Temperatur K¸hlerausgang Erfassung und Linearisierung" CURVE 0xFD2591 KlAxU8SstxU8WU8 191.3 temp_ub_q0p75_o48 -48.00 143.3 FORMAT "%5.1"
 /begin AXIS_DESCR STD_AXIS wtka spg_ub_b5 20 0.00 4.980 FORMAT "%5.3" DEPOSIT ABSOLUTE /end AXIS_DESCR
/end CHARACTERISTIC
/begin CHARACTERISTIC TKAUSDE "Ersatzgrˆﬂe Temperatur K¸hlerausgang im Fehlerfall" VALUE 0xFD25C0 KwWU8 191.3 temp_ub_q0p75_o48 -48.00 143.3 FORMAT "%5.1" /end CHARACTERISTIC
/begin CHARACTERISTIC TKAUSDMN "Min. Temperatur K¸hlerausgang" VALUE 0xFD25C1 KwWU8 191.3 temp_ub_q0p75_o48 -48.00 143.3 FORMAT "%5.1" /end CHARACTERISTIC
/begin CHARACTERISTIC TKAUSDMX "Max. Temperatur K¸hlerausgang" VALUE 0xFD25C2 KwWU8 191.3 temp_ub_q0p75_o48 -48.00 143.3 FORMAT "%5.1" /end CHARACTERISTIC
/begin CHARACTERISTIC TKERENSCUN "Einschaltschwelle f¸r Diagnose an UN des Auswerte-ICs (auf Temperaturbasis)" VALUE 0xFC7F5C KwWU16 1535.977 temp_q0p0234_o273 -273.1500 1262.827 FORMAT "%8.3" /end CHARACTERISTIC
/begin CHARACTERISTIC TKERLSPSF "Einschaltschwelle f¸r Pumpstromregler des Auswerte-ICs (auf Temperaturbasis)" VALUE 0xFC7F5E KwWU16 1535.977 temp_q0p0234_o273 -273.1500 1262.827 FORMAT "%8.3" /end CHARACTERISTIC
/begin CHARACTERISTIC TKERLSUS "Keramiksolltemperatur f¸r LSU" VALUE 0xFD0464 KwWU16 1535.977 temp_q0p0234_o273 -273.1500 1262.827 FORMAT "%8.3" /end CHARACTERISTIC
/begin CHARACTERISTIC TKERLSUST "Keramiktemperaturgrenzwert zum Abbruch der Startsteuerung" VALUE 0xFD0466 KwWU16 1535.977 temp_q0p0234_o273 -273.1500 1262.827 FORMAT "%8.3" /end CHARACTERISTIC
/begin CHARACTERISTIC TMABDTAMN "Minimalschwelle der Motorabstelltemperatur f¸r Plausibit‰tscheck TANS" VALUE 0xFD2360 KwUb 191.3 temp_ub_q0p75_o48 -48.00 143.3 FORMAT "%5.1" /end CHARACTERISTIC
/begin CHARACTERISTIC TMBVH "Verzˆgerungszeit f¸r Aktivierung Miﬂbrauchsverhinderung" VALUE 0xFD2320 KwUw 6553.500 t100msxs_uw_b6553p5 0.00 6553.500 FORMAT "%8.3" /end CHARACTERISTIC
/begin CHARACTERISTIC TMDMMA "Anfangstemperatur f¸r Motortemperaturmodell" VALUE 0xFD238D KwUb 191.3 temp_ub_q0p75_o48 -48.00 143.3 FORMAT "%5.1" /end CHARACTERISTIC
/begin CHARACTERISTIC TMDMMAT "Ersatztemperatur abh. Abstellzeit w‰hrend TDTMMA" CURVE 0xFD2510 KlAUwSstUwWUw 191.2500 temp_uw_q0p75_o48 -48.00000 143.2500 FORMAT "%8.4"
 /begin AXIS_DESCR STD_AXIS tabst_w t1sxs_uw_q1 3 0.00 65535.00 FORMAT "%8.2" DEPOSIT ABSOLUTE /end AXIS_DESCR
/end CHARACTERISTIC
/begin CHARACTERISTIC TMDMMAU "Unterster Anfangswert aus tans f¸r Motortemperaturmodell" VALUE 0xFD238E KwUb 191.3 temp_ub_q0p75_o48 -48.00 143.3 FORMAT "%5.1" /end CHARACTERISTIC
/begin CHARACTERISTIC TMDMMEE "Endtemperatur f¸r Ersatzwert Motortemperatur" VALUE 0xFD238F KwUb 191.3 temp_ub_q0p75_o48 -48.00 143.3 FORMAT "%5.1" /end CHARACTERISTIC
/begin CHARACTERISTIC TMDMMER "Endtemperatur f¸r Referenzwert Motortemperatur" VALUE 0xFD2390 KwUb 191.3 temp_ub_q0p75_o48 -48.00 143.3 FORMAT "%5.1" /end CHARACTERISTIC
/begin CHARACTERISTIC TMDMN "Motortemperatur min." VALUE 0xFD2391 KwUb 191.3 temp_ub_q0p75_o48 -48.00 143.3 FORMAT "%5.1" /end CHARACTERISTIC
/begin CHARACTERISTIC TMDMX "Motortemperatur max." VALUE 0xFD2392 KwUb 191.3 temp_ub_q0p75_o48 -48.00 143.3 FORMAT "%5.1" /end CHARACTERISTIC
/begin CHARACTERISTIC TMESSCMN "Min.-Schwelle Ersatz-Motortemperatur f¸r Stuck-Signal Check" VALUE 0xFC7FB2 KwWU8 191.3 temp_ub_q0p75_o48 -48.00 143.3 FORMAT "%5.1" /end CHARACTERISTIC
/begin CHARACTERISTIC TMLRTMS "Motortemperaturschwelle f¸r LR ein abh. von Starttemperatur" CURVE 0xFD2393 KlAUbSstUbWUb 191.3 temp_ub_q0p75_o48 -48.00 143.3 FORMAT "%5.1"
 /begin AXIS_DESCR STD_AXIS tmst temp_ub_q0p75_o48 4 -48.00 143.3 FORMAT "%5.1" DEPOSIT ABSOLUTE /end AXIS_DESCR
/end CHARACTERISTIC
/begin CHARACTERISTIC TMMXRT "max. Motortemperatur f. Retrigg. Modelle (Blockheater-Erkennung)" VALUE 0xFD239C KwUb 191.3 temp_ub_q0p75_o48 -48.00 143.3 FORMAT "%5.1" /end CHARACTERISTIC
/begin CHARACTERISTIC TMOTELI "Temperatur Motor Erfassung u. Linearisierung, Inverskennlinie" CURVE 0xFD239D KlAUbSstUbWUb 191.3 temp_ub_q0p75_o48 -48.00 143.3 FORMAT "%5.1"
 /begin AXIS_DESCR STD_AXIS wtmot spg_ub_b5 20 0.00 4.980 FORMAT "%5.3" DEPOSIT ABSOLUTE /end AXIS_DESCR
/end CHARACTERISTIC
/begin CHARACTERISTIC TMOTSHE "tmot-Ersatzwert f¸r Standheizungseinfluss" VALUE 0xFD23C6 KwUb 191.3 temp_ub_q0p75_o48 -48.00 143.3 FORMAT "%5.1" /end CHARACTERISTIC
/begin CHARACTERISTIC TMOTTKASC "Motortemperaturschwelle ab der die TKA Stuckcheck-Freigabe erfolgt" VALUE 0xFD25C3 KwWU8 191.3 temp_ub_q0p75_o48 -48.00 143.3 FORMAT "%5.1" /end CHARACTERISTIC
/begin CHARACTERISTIC TMPTAFXU "untere Motortemperaturschwelle f¸r Plausibilit‰ts-Check fixiertes TANS Signal" VALUE 0xFD2361 KwUb 191.3 temp_ub_q0p75_o48 -48.00 143.3 FORMAT "%5.1" /end CHARACTERISTIC
/begin CHARACTERISTIC TMRWKFT "Minimumtemperaturschwelle f¸r Ersatzwertberechnung" VALUE 0xFD23C7 KwUb 191.3 temp_ub_q0p75_o48 -48.00 143.3 FORMAT "%5.1" /end CHARACTERISTIC
/begin CHARACTERISTIC TMRWTKWMX "Maximale Tastverh‰ltnis Thermostatansteuerung" VALUE 0xFD251E KwSw 6553.500 fak_q0p1 -3276.800 3276.700 FORMAT "%8.3" /end CHARACTERISTIC
/begin CHARACTERISTIC TMSDTAO "obere Motorstart-Temp.-Schwelle f¸r Plausibitit‰tscheck Ansauglufttemp. TANS" VALUE 0xFD2362 KwUb 191.3 temp_ub_q0p75_o48 -48.00 143.3 FORMAT "%5.1" /end CHARACTERISTIC
/begin CHARACTERISTIC TMSDTAU "untere Motorstart-Temp.-Schwelle f¸r Plausibitit‰tscheck Ansauglufttemp. TANS" VALUE 0xFD2363 KwUb 191.3 temp_ub_q0p75_o48 -48.00 143.3 FORMAT "%5.1" /end CHARACTERISTIC
/begin CHARACTERISTIC TMSPTAFX "Motorstarttemperaturschwelle f¸r Plausibilit‰ts-Check fixiertes TANS Signal" VALUE 0xFD2364 KwUb 191.3 temp_ub_q0p75_o48 -48.00 143.3 FORMAT "%5.1" /end CHARACTERISTIC
/begin CHARACTERISTIC TMSSSCO "obere Motorstart-Temp.-Schwelle f¸r Stuck-Signal Check" VALUE 0xFC7FB3 KwWU8 191.3 temp_ub_q0p75_o48 -48.00 143.3 FORMAT "%5.1" /end CHARACTERISTIC
/begin CHARACTERISTIC TMSSSCU "untere Motorstart-Temp.-Schwelle f¸r Stuck-Signal Check" VALUE 0xFC7FB4 KwWU8 191.3 temp_ub_q0p75_o48 -48.00 143.3 FORMAT "%5.1" /end CHARACTERISTIC
/begin CHARACTERISTIC TMSTTKASC "max. Motorstarttemperaturschwelle ab der der TKA Stuckcheck freigegeben wird" VALUE 0xFD25C4 KwWU8 191.3 temp_ub_q0p75_o48 -48.00 143.3 FORMAT "%5.1" /end CHARACTERISTIC
/begin CHARACTERISTIC TNLPHWAIT "Zeit f¸r Zahnaufweitung bei B_rphsp" VALUE 0xFC80CA KwWU16 65.53500 t_q0p001_ms 0.00 65.53500 FORMAT "%8.5" /end CHARACTERISTIC
/begin CHARACTERISTIC TNSRT "Max.-Zeit ab Start f¸r Retriggerung Berechnung Motortemperaturmodell" VALUE 0xFD23C8 KwUb 255.0 t1sxs_ub_b255 0.00 255.0 FORMAT "%5.1" /end CHARACTERISTIC
/begin CHARACTERISTIC TNTMTKASC "Entprellzeit nach der tka steigen m¸sste weil tmot grˆsser Stuckcheck-Schwelle" VALUE 0xFD25BA KwWU16 6553.500 t_q0p1 0.00 6553.500 FORMAT "%8.3" /end CHARACTERISTIC
/begin CHARACTERISTIC TPNSE1 "Pr¸fzeit nach Startende f¸r PWG-Diagnose" VALUE 0xFD231D KwUb 12.70 t50msxs_ub_b12p75 0.05000 12.75 FORMAT "%5.2" /end CHARACTERISTIC
/begin CHARACTERISTIC TPREL "Zahnentprellzeit in der Initialisierung" VALUE 0xFC80D4 KwWU8 255.0 t1msxms_q1 0.00 255.0 FORMAT "%5.1" /end CHARACTERISTIC
/begin CHARACTERISTIC TRESSH "Zeitschwelle Reset Standheizungseinfluss" VALUE 0xFD2520 KwUw 6553.500 t100msxs_uw_b6553p5 0.00 6553.500 FORMAT "%8.3" /end CHARACTERISTIC
/begin CHARACTERISTIC TRINSTART "Zeit f¸r kleine Zeitkonstante rinlsu_w" VALUE 0xFC7F6C KwWU8 2.550 t10msxs_uw_b655p35 0.00 2.550 FORMAT "%5.3" /end CHARACTERISTIC
/begin CHARACTERISTIC TSGELI "Temperatur Steuerger‰t- Erfassung und Linearisierung" CURVE 0xFD25D0 KlAUbSstUbWUb 191.3 temp_ub_q0p75_o48 -48.00 143.3 FORMAT "%5.1"
 /begin AXIS_DESCR STD_AXIS wtsg spg_ub_b5 18 0.00 4.980 FORMAT "%5.3" DEPOSIT ABSOLUTE /end AXIS_DESCR
/end CHARACTERISTIC
/begin CHARACTERISTIC TSTDHE "Sp‰testmˆgliche Ber¸cksichtigung des STDH-Einflusses nach Start" VALUE 0xFD2522 KwUw 6553.500 t100msxs_uw_b6553p5 0.00 6553.500 FORMAT "%8.3" /end CHARACTERISTIC
/begin CHARACTERISTIC TSTSG "Zeitintervall f¸r Erfassung SG-Temperatur-Histogramm" VALUE 0xFD25F5 KwUb 254.0 t1sxs_ub_b255 1.000 255.0 FORMAT "%5.1" /end CHARACTERISTIC
/begin CHARACTERISTIC TTANSFIX "Zeitschwelle, bis zu der tans ""eingefroren"" wird, wegen Standheizung" VALUE 0xFC7F6E KwWU16 65535.00 t1sxs_uw_b65535 0.00 65535.00 FORMAT "%8.2" /end CHARACTERISTIC
/begin CHARACTERISTIC TTAPLC "Frist f¸r Plausibilit‰tscheck der Ansauglufttemperatur" VALUE 0xFD2368 KwUw 6553.500 t100msxs_uw_b6553p5 0.00 6553.500 FORMAT "%8.3" /end CHARACTERISTIC
/begin CHARACTERISTIC TTUMABSTMX "Abstellzeit f¸r Temperaturplausibisierung" VALUE 0xFD2538 KwWU16 65535.00 t1sxs_uw_q1 0.00 65535.00 FORMAT "%8.2" /end CHARACTERISTIC
/begin CHARACTERISTIC TTUMTNSEMN "Zeitfenster f¸r Temperaturplausibisierung nach Motorstart" VALUE 0xFD253A KwWU16 6553.500 t100msxs_uw_b6553p5 0.00 6553.500 FORMAT "%8.3" /end CHARACTERISTIC
/begin CHARACTERISTIC TTUMTNSEMX "Zeitfenster f¸r Erkennung von Temp.‰nderung seit Motorstart" VALUE 0xFD253C KwWU16 6553.500 t100msxs_uw_b6553p5 0.00 6553.500 FORMAT "%8.3" /end CHARACTERISTIC
/begin CHARACTERISTIC TUMDETM "Umgebungslufttemperatur-Ersatzwert f¸r Motortemperatur-Modell" VALUE 0xFD23C9 KwUb 191.3 temp_ub_q0p75_o48 -48.00 143.3 FORMAT "%5.1" /end CHARACTERISTIC
/begin CHARACTERISTIC TUMGNPL "Schwelle Umgebungstemperatur zu Motortemperatur" VALUE 0xFD2546 KwWU8 255.0 temp_q1 0.00 255.0 FORMAT "%5.1" /end CHARACTERISTIC
/begin CHARACTERISTIC TUMGTAI "Initialisierungswert Umgebungstemperatur" VALUE 0xFD2547 KwWU8 191.3 temp_ub_q0p75_o48 -48.00 143.3 FORMAT "%5.1" /end CHARACTERISTIC
/begin CHARACTERISTIC TUMGTKASC "min. Umgebungstemperaturschwelle ab der der TKA Stuckcheck freigegeben wird" VALUE 0xFD25C5 KwWU8 191.3 temp_ub_q0p75_o48 -48.00 143.3 FORMAT "%5.1" /end CHARACTERISTIC
/begin CHARACTERISTIC TUMNPLMN "Plausbereich f¸r TUMG- Diagnose" VALUE 0xFD2548 KwWS8 255.0 temp_q1 -128.0 127.0 FORMAT "%5.1" /end CHARACTERISTIC
/begin CHARACTERISTIC TUMNPLMX "Plausbereich f¸r TUMG- Diagnose" VALUE 0xFD2549 KwWS8 255.0 temp_q1 -128.0 127.0 FORMAT "%5.1" /end CHARACTERISTIC
/begin CHARACTERISTIC TUMTMOTMN "Min. K¸hlwassertemp. f¸r TUMG- Plausdiagnose" VALUE 0xFD254A KwWU8 191.3 temp_ub_q0p75_o48 -48.00 143.3 FORMAT "%5.1" /end CHARACTERISTIC
/begin CHARACTERISTIC TUMTO "Totzeit f¸r Umschaltung CJ120" VALUE 0xFC7F60 KwWU16 655.2500 t10msxs_uw_b655p35 0.1000000 655.3500 FORMAT "%8.4" /end CHARACTERISTIC
/begin CHARACTERISTIC TUMTOE "Totzeit f¸r Umschaltung CJ120/CJ125 f¸r elektrischen Abgleich" VALUE 0xFC7E92 KwWU16 655.3500 t10msxs_uw_b655p35 0.00 655.3500 FORMAT "%8.4" /end CHARACTERISTIC
/begin CHARACTERISTIC TUPWBWV "Zeitverzˆgerung zum Einspeichern eines neuen Poti 2 Wertes" VALUE 0xFC7EA4 KwUb 2.550 t10msxs_ub_b2p55 0.00 2.550 FORMAT "%5.3" /end CHARACTERISTIC
/begin CHARACTERISTIC TUPWG12 "Fehlerzeit bei Vergleich von PWG-Poti 1 und 2" VALUE 0xFC7EA5 KwUb 2.550 t10msxs_ub_b2p55 0.00 2.550 FORMAT "%5.3" /end CHARACTERISTIC
/begin CHARACTERISTIC TUPWG1O "Fehlerzeit bei Bereichsverletzung von PWG-Poti 1 nach oben" VALUE 0xFC7EA6 KwUb 2.550 t10msxs_ub_b2p55 0.00 2.550 FORMAT "%5.3" /end CHARACTERISTIC
/begin CHARACTERISTIC TUPWG1U "Fehlerzeit bei Bereichsverletzung von PWG-Poti 1 nach unten" VALUE 0xFC7EA7 KwUb 2.550 t10msxs_ub_b2p55 0.00 2.550 FORMAT "%5.3" /end CHARACTERISTIC
/begin CHARACTERISTIC TUPWG2O "Fehlerzeit bei Bereichsverletzung von PWG-Poti 2 nach oben" VALUE 0xFC7EA8 KwUb 2.550 t10msxs_ub_b2p55 0.00 2.550 FORMAT "%5.3" /end CHARACTERISTIC
/begin CHARACTERISTIC TUPWG2U "Fehlerzeit bei Bereichsverletzung von PWG-Poti 2 nach unten" VALUE 0xFC7EA9 KwUb 2.550 t10msxs_ub_b2p55 0.00 2.550 FORMAT "%5.3" /end CHARACTERISTIC
/begin CHARACTERISTIC TUPWLLU "Entprellzeit zur Fehlererkennung ""unerwartete Leerlaufspannungen""" VALUE 0xFC7EAA KwUb 2.550 t10msxs_ub_b2p55 0.00 2.550 FORMAT "%5.3" /end CHARACTERISTIC
/begin CHARACTERISTIC TVABGL "Verzˆgerungszeit f¸r LSU-Abgleich" VALUE 0xFC7E94 KwWU16 655.3500 t10msxs_uw_b655p35 0.00 655.3500 FORMAT "%8.4" /end CHARACTERISTIC
/begin CHARACTERISTIC TVHSH "Einschaltverzˆgerung der Sondenheizung hinter Kat" VALUE 0xFD0409 KwUb 25.50 t100msxs_ub_b25p5 0.00 25.50 FORMAT "%5.2" /end CHARACTERISTIC
/begin CHARACTERISTIC TVSABGL "Verzˆgerungszeit f¸r LSU-Abgleich nach Start" VALUE 0xFC7F62 KwWU16 655.3500 t10msxs_uw_b655p35 0.00 655.3500 FORMAT "%8.4" /end CHARACTERISTIC
/begin CHARACTERISTIC TWBKLHON "Wartezeit innerhalb Bereichsgrenzen f¸r Bed. K¸hlleistung hoch" VALUE 0xFC7FB5 KwWU8 25.50 t_q0p1 0.00 25.50 FORMAT "%5.2" /end CHARACTERISTIC
/begin CHARACTERISTIC TWBKLNON "Wartezeit innerhalb Bereichsgrenzen f¸r Bed. K¸hlleistung niedrig" VALUE 0xFC7FB6 KwWU8 25.50 t_q0p1 0.00 25.50 FORMAT "%5.2" /end CHARACTERISTIC
/begin CHARACTERISTIC TWLRTMS "Wartezeit f¸r Diagnose TMOT-Einschaltbedingung lambda-Regelung" CURVE 0xFD2524 KlAUbSstUbWUw 6553.500 t100msxs_uw_b6553p5 0.00 6553.500 FORMAT "%8.3"
 /begin AXIS_DESCR STD_AXIS tmst temp_ub_q0p75_o48 4 -48.00 143.3 FORMAT "%5.1" DEPOSIT ABSOLUTE /end AXIS_DESCR
/end CHARACTERISTIC
/begin CHARACTERISTIC TWPLK "Entprellzeit f¸r R¸cknahme der LL-Vorgabe bei Lebendkennung" VALUE 0xFD231E KwUb 25.50 t100msxs_ub_b25p5 0.00 25.50 FORMAT "%5.2" /end CHARACTERISTIC
/begin CHARACTERISTIC TWPMBBR "Verzˆgerungszeit f¸r Pedalwertbegrenzung bei bet‰tigter Bremse" VALUE 0xFC7EAB KwUb 2.550 t10msxs_ub_b2p55 0.00 2.550 FORMAT "%5.3" /end CHARACTERISTIC
/begin CHARACTERISTIC UBDE "Ubatt - Ersatzwert bei defektem AD - Kanal" VALUE 0xFC7FBD KwUb 24.02 spg_ubatt 0.00 24.02 FORMAT "%5.2" /end CHARACTERISTIC
/begin CHARACTERISTIC UBDMN1 "Batteriespannung min. (Netz)" VALUE 0xFC7FBE KwUb 24.02 spg_ubatt 0.00 24.02 FORMAT "%5.2" /end CHARACTERISTIC
/begin CHARACTERISTIC UBDMN2 "Batteriespannung min. (ADC)" VALUE 0xFC7FBF KwUb 24.02 spg_ubatt 0.00 24.02 FORMAT "%5.2" /end CHARACTERISTIC
/begin CHARACTERISTIC UBDMX "Batteriespannung max." VALUE 0xFC7FC0 KwUb 24.02 spg_ubatt 0.00 24.02 FORMAT "%5.2" /end CHARACTERISTIC
/begin CHARACTERISTIC UBHS "Batteriespannungsschwelle f¸r Abschalten der Sondenheizung" VALUE 0xFD040A KwUb 24.02 spg_ubatt 0.00 24.02 FORMAT "%5.2" /end CHARACTERISTIC
/begin CHARACTERISTIC UECONS "Fahrzeuggesamt¸bersetzung bei Ersatzwertbildung ¸ber Motordrehzahl" VALUE 0xFC8096 KwWU8 25.50 fak_q0p1 0.00 25.50 FORMAT "%5.2" /end CHARACTERISTIC
/begin CHARACTERISTIC UHSN "Nennspannung f¸r die Sondenheizung" VALUE 0xFD040B KwUb 24.02 spg_ubatt 0.00 24.02 FORMAT "%5.2" /end CHARACTERISTIC
/begin CHARACTERISTIC UPW1BE "Spannung PWG-Poti 1 f¸r Durchf¸hrung der Bewegungserkennung" VALUE 0xFC7EAC KwUb 4.980 spg_ub_b5 0.00 4.980 FORMAT "%5.3" /end CHARACTERISTIC
/begin CHARACTERISTIC UPW1LLMX "Maximale Spannung von Poti 1 im Leergaspunkt" VALUE 0xFC7EAD KwUb 4.980 spg_ub_b5 0.00 4.980 FORMAT "%5.3" /end CHARACTERISTIC
/begin CHARACTERISTIC UPWG12U "Untere Begrenzung PWG-Poti-Spannung vor Vergleich Poti 1 und 2" VALUE 0xFC7EAE KwUb 4.980 spg_ub_b5 0.00 4.980 FORMAT "%5.3" /end CHARACTERISTIC
/begin CHARACTERISTIC UPWG1O "Obere Schranke f¸r PWG-Poti-1-Spannung" VALUE 0xFC7EAF KwUb 4.980 spg_ub_b5 0.00 4.980 FORMAT "%5.3" /end CHARACTERISTIC
/begin CHARACTERISTIC UPWG1U "Untere Schranke f¸r PWG-Poti-1-Spannung" VALUE 0xFC7EB0 KwUb 4.980 spg_ub_b5 0.00 4.980 FORMAT "%5.3" /end CHARACTERISTIC
/begin CHARACTERISTIC UPWG2O "Obere Schranke f¸r PWG-Poti-2-Spannung" VALUE 0xFC7EB1 KwUb 4.980 spg_ub_b5 0.00 4.980 FORMAT "%5.3" /end CHARACTERISTIC
/begin CHARACTERISTIC UPWG2U "Untere Schranke f¸r PWG-Poti-2-Spannung" VALUE 0xFC7EB2 KwUb 4.980 spg_ub_b5 0.00 4.980 FORMAT "%5.3" /end CHARACTERISTIC
/begin CHARACTERISTIC UPWGO "Oberer PWG-Spannungswert f¸r Umnormierung auf Pedalwert" VALUE 0xFC7EB3 KwUb 4.980 spg_ub_b5 0.00 4.980 FORMAT "%5.3" /end CHARACTERISTIC
/begin CHARACTERISTIC UPWGTG "PWG-Spannungsschwelle f¸r Teilgasbereich" VALUE 0xFC7EB4 KwUb 4.980 spg_ub_b5 0.00 4.980 FORMAT "%5.3" /end CHARACTERISTIC
/begin CHARACTERISTIC UPWGU "Unterer PWG-Spannungswert f¸r Umnormierung auf Pedalwert" VALUE 0xFC7EB5 KwUb 4.980 spg_ub_b5 0.00 4.980 FORMAT "%5.3" /end CHARACTERISTIC
/begin CHARACTERISTIC UPWGUBF "Unterer Spannungswert zur Umnormierung bei erkanntem Bewegungsfehler" VALUE 0xFC7EB6 KwUb 4.980 spg_ub_b5 0.00 4.980 FORMAT "%5.3" /end CHARACTERISTIC
/begin CHARACTERISTIC UPWGUR "Reduzierter unterer PWG-Spannungswert f¸r Umnormierung auf Pedalwert" VALUE 0xFC7EB7 KwUb 4.980 spg_ub_b5 0.00 4.980 FORMAT "%5.3" /end CHARACTERISTIC
/begin CHARACTERISTIC UPWGVG "PWG-Spannungsschwelle f¸r Vollgasbereich" VALUE 0xFC7EB8 KwUb 4.980 spg_ub_b5 0.00 4.980 FORMAT "%5.3" /end CHARACTERISTIC
/begin CHARACTERISTIC URINOFF "CJ120-Spannung bei LSU-Nernstwiderstand rinlsu_w = 0" VALUE 0xFC7F64 KwWU16 5.000000 spg_q0p00488 0.00 5.000000 FORMAT "%8.6" /end CHARACTERISTIC
/begin CHARACTERISTIC USABGL "LSU-Spannung bei Pumpstrom Null" VALUE 0xFC7E96 KwWU16 31.99951 spg_q4p88Em4 0.00 31.99951 FORMAT "%8.5" /end CHARACTERISTIC
/begin CHARACTERISTIC VBKLHO "obere Fz-Geschwindigkeitsschwelle f¸r Bedingung K¸hlleistung hoch" VALUE 0xFC7FB7 KwWU8 318.8 vfzg_ub_q1p25 0.00 318.8 FORMAT "%5.1" /end CHARACTERISTIC
/begin CHARACTERISTIC VBKLHU "untere Fz-Geschwindigkeitsschwelle f¸r Bedingung K¸hlleistung hoch" VALUE 0xFC7FB8 KwWU8 318.8 vfzg_ub_q1p25 0.00 318.8 FORMAT "%5.1" /end CHARACTERISTIC
/begin CHARACTERISTIC VBKLNO "obere Fz-Geschwindigkeitsschwelle f¸r Bedingung K¸hlleistung niedrig" VALUE 0xFC7FB9 KwWU8 318.8 vfzg_ub_q1p25 0.00 318.8 FORMAT "%5.1" /end CHARACTERISTIC
/begin CHARACTERISTIC VBKLNU "untere Fz-Geschwindigkeitsschwelle f¸r Bedingung K¸hlleistung niedrig" VALUE 0xFC7FBA KwWU8 318.8 vfzg_ub_q1p25 0.00 318.8 FORMAT "%5.1" /end CHARACTERISTIC
/begin CHARACTERISTIC VFZMN "Erkennen Fahren-Stehen" VALUE 0xFC809A KwWU16 511.9922 vfzg_uw_b512 0.00 511.9922 FORMAT "%8.4" /end CHARACTERISTIC
/begin CHARACTERISTIC VMDUB "Geschwindigkeitsschwelle min. f¸r Batteriespannungs-Diagnose" VALUE 0xFC7FC1 KwUb 318.8 vfzg_ub_q1p25 0.00 318.8 FORMAT "%5.1" /end CHARACTERISTIC
/begin CHARACTERISTIC VPTAFXO "0bere Fahrzgeschwindigk.-Schwelle f¸r Plausibilit‰ts-Check fixiertes TANS Signal" VALUE 0xFD2365 KwUb 318.8 vfzg_ub_q1p25 0.00 318.8 FORMAT "%5.1" /end CHARACTERISTIC
/begin CHARACTERISTIC VPTAFXU "untere Fahrzgeschwindigk.Schwelle f¸r Plausibilit‰ts-Check fixiertes TANS Signal" VALUE 0xFD2366 KwUb 318.8 vfzg_ub_q1p25 0.00 318.8 FORMAT "%5.1" /end CHARACTERISTIC
/begin CHARACTERISTIC VRFGRMN "Untere Schwelle vroh_w f¸r FGR-Abschaltung ¸ber vfzg_w = 0" VALUE 0xFC8090 KwWU16 511.9922 vfzg_uw_b512 0.00 511.9922 FORMAT "%8.4" /end CHARACTERISTIC
/begin CHARACTERISTIC VRFMNERS "Untere Schwelle vfzers  f¸r Abschaltung vfzg-Ersatzwert" VALUE 0xFC8092 KwWU16 511.9922 vfzg_uw_b512 0.00 511.9922 FORMAT "%8.4" /end CHARACTERISTIC
/begin CHARACTERISTIC VTAPLC "Geschwindigkeitsschwelle f¸r Plausibilit‰tscheck der Ansauglufttemperatur" VALUE 0xFD2367 KwUb 318.8 vfzg_ub_q1p25 0.00 318.8 FORMAT "%5.1" /end CHARACTERISTIC
/begin CHARACTERISTIC VTUMGTA "Schwelle Fahrzeuggeschwindigkeit f¸r TANS -> Umgebungstemperatur" VALUE 0xFD254B KwWU8 318.8 vfzg_ub_q1p25 0.00 318.8 FORMAT "%5.1" /end CHARACTERISTIC
/begin CHARACTERISTIC VWPMBBR "Mindestgeschwindigkeit f¸r Pedalwertbegrenzung bei bet‰tigter Bremse" VALUE 0xFC7EB9 KwUb 318.8 vfzg_ub_q1p25 0.00 318.8 FORMAT "%5.1" /end CHARACTERISTIC
/begin CHARACTERISTIC WKWALETEST "Testwert f¸r Start ¸ber Auslauferkennung" VALUE 0xFC80CC KwWU16 6553.500 kw_q0p1 0.00 6553.500 FORMAT "%8.3" /end CHARACTERISTIC
/begin CHARACTERISTIC WNWSPG1 "Sollwinkel der 1. negativen Nockenwellenflanke von PG1" VALUE 0xFC80AC KwWU16 6553.500 kw_q0p1 0.00 6553.500 FORMAT "%8.3" /end CHARACTERISTIC
/begin CHARACTERISTIC WNWSPG2 "Sollwinkel der 1. negativen Nockenwellenflanke von PG2" VALUE 0xFC80AE KwWU16 6553.500 kw_q0p1 0.00 6553.500 FORMAT "%8.3" /end CHARACTERISTIC
/begin CHARACTERISTIC WNWSPG3 "Sollwinkel der 1. negativen Nockenwellenflanke von PG3" VALUE 0xFC80B0 KwWU16 6553.500 kw_q0p1 0.00 6553.500 FORMAT "%8.3" /end CHARACTERISTIC
/begin CHARACTERISTIC WNWSPG4 "Sollwinkel der 1. negativen Nockenwellenflanke von PG4" VALUE 0xFC80B2 KwWU16 6553.500 kw_q0p1 0.00 6553.500 FORMAT "%8.3" /end CHARACTERISTIC
/begin CHARACTERISTIC WPMXBR "Maximal zul‰ssiger Pedalwert bei bet‰tigter Bremse (vor Erkennung wped = 0)" VALUE 0xFC7ECA KwUw 100.0000 relPED_uw_b100 0.00 100.0000 FORMAT "%8.4" /end CHARACTERISTIC
/begin CHARACTERISTIC WPMXNOT "Maximal zul‰ssiger Fahrpedalwert im PWG-Notfahren" VALUE 0xFC7EBA KwUb 100.0 relPED_ub_b100 0.00 100.0 FORMAT "%5.1" /end CHARACTERISTIC
/begin CHARACTERISTIC WPRMBVH "Pedalwertgrenze zur R¸cknahme der Miﬂbrauchsverhinderung" VALUE 0xFD231F KwUb 100.0 relPED_ub_b100 0.00 100.0 FORMAT "%5.1" /end CHARACTERISTIC
/begin CHARACTERISTIC ZBWF "Z‰hlerstand f¸r Fehlereintrag Bewegungserkennung" VALUE 0xFC7EBB KwUb 255.0 dez 0.00 255.0 FORMAT "%5.1" /end CHARACTERISTIC
/begin CHARACTERISTIC ZFDUSVK "Filterzeitkonstante f¸r LSU-Spannungsabgleich vor Kat" VALUE 0xFC7E98 KwWU16 655.34999985 zk10msxs_uw_b655 0.010000152590 655.36000000 FORMAT "%12.8" /end CHARACTERISTIC
/begin CHARACTERISTIC ZFRIN "Zeitkonstante f¸r Filter rinlsu_w" VALUE 0xFC7F66 KwWU16 655.34999985 zk10msxs_uw_b655 0.010000152590 655.36000000 FORMAT "%12.8" /end CHARACTERISTIC
/begin CHARACTERISTIC ZFRINCAL "Zeitkonstante f¸r Filter krivk_w" VALUE 0xFC7F68 KwWU16 655.34999985 zk10msxs_uw_b655 0.010000152590 655.36000000 FORMAT "%12.8" /end CHARACTERISTIC
/begin CHARACTERISTIC ZFRINSTART "Zeitkonstantre f¸r Filter rinlsu_w nach Start" VALUE 0xFC7F6A KwWU16 655.34999985 zk10msxs_uw_b655 0.010000152590 655.36000000 FORMAT "%12.8" /end CHARACTERISTIC
/begin CHARACTERISTIC ZFTANS "Zeitkonstante Tiefpaﬂfilter Ansauglufttemperatur" VALUE 0xFD236A KwUw 6553.4999985 zk100msxs_uw_b6553 0.10000152590 6553.6000000 FORMAT "%12.7" /end CHARACTERISTIC
/begin CHARACTERISTIC ZFTMOT "Zeitkonstante Tiefpaﬂfilter tmot" VALUE 0xFD2532 KwUw 6553.4999985 zk100msxs_uw_b6553 0.10000152590 6553.6000000 FORMAT "%12.7" /end CHARACTERISTIC
/begin CHARACTERISTIC ZFTMOTR "Zeitkonstante Wegschalten  Standheizungseinfluss zur¸ck auf tmot" VALUE 0xFD2534 KwUw 6553.4999985 zk100msxs_uw_b6553 0.10000152590 6553.6000000 FORMAT "%12.7" /end CHARACTERISTIC
/begin CHARACTERISTIC ZFUULSU "Filterzeitkonstante f¸r Lambda" VALUE 0xFC7E9A KwWU16 655.34999985 zk10msxs_uw_b655 0.010000152590 655.36000000 FORMAT "%12.8" /end CHARACTERISTIC
/begin CHARACTERISTIC ZFV "Zeitkonstante f¸r Filterung des Geschwindigkeitssignals" VALUE 0xFC809C KwWU16 655.34999985 zk10msxs_uw_b655 0.010000152590 655.36000000 FORMAT "%12.8" /end CHARACTERISTIC
/begin CHARACTERISTIC ZTMRWTAML "Zeitkonstante TAML Filterung" VALUE 0xFD2536 KwUw 6553.4999985 zk100msxs_uw_b6553 0.10000152590 6553.6000000 FORMAT "%12.7" /end CHARACTERISTIC
/begin CHARACTERISTIC ZTPREL "Anzahl Z‰hne w‰hrend der Starterkennung" VALUE 0xFC80D5 KwWU8 255.0 dez 0.00 255.0 FORMAT "%5.1" /end CHARACTERISTIC
/begin MEASUREMENT anzburst "Anzahl der Burst-Z‰hne" UWORD dez 1 100 0 65535 FORMAT "%8.2" ECU_ADDRESS 0x4046C6 /end MEASUREMENT
/begin MEASUREMENT anztmklh "Z‰hler Anzahl Fahrzyklen im Bereich K¸hlleistung hoch" UBYTE dez 1 100 0 255 FORMAT "%5.1" ECU_ADDRESS 0x402E72 /end MEASUREMENT
/begin MEASUREMENT anztmkln "Z‰hler Anzahl Fahrzyklen im Bereich K¸hlleistung niedrig" UBYTE dez 1 100 0 255 FORMAT "%5.1" ECU_ADDRESS 0x402E73 /end MEASUREMENT
/begin MEASUREMENT bfzgl_b "Fahrzeugl‰ngsbeschleunigung" SBYTE bfzg_sb_q0p217 1 100 -27.776 27.559 FORMAT "%5.2" ECU_ADDRESS 0x40392C /end MEASUREMENT
/begin MEASUREMENT B_aglf "Bedingung Ansteuerung gesteuerte Luftf¸hrung" UBYTE B_TRUE 1 100 0 1 BIT_MASK 0x1 FORMAT "%13.11" ECU_ADDRESS 0x3FC391 /end MEASUREMENT
/begin MEASUREMENT B_bm "Bedingung Bezugsmarke erkannt" UBYTE B_TRUE 1 100 0 1 BIT_MASK 0x1 FORMAT "%13.11" ECU_ADDRESS 0x402F52 /end MEASUREMENT
/begin MEASUREMENT B_bwf "Bedingung: Bewegungserkennung hat Fehler erkannt" UBYTE B_TRUE 1 100 0 1 BIT_MASK 0x1 FORMAT "%13.11" ECU_ADDRESS 0x403BE5 /end MEASUREMENT
/begin MEASUREMENT B_bwunpl "Bedingung Unplausibilit‰t bei Bewegungserkennung" UBYTE B_TRUE 1 100 0 1 BIT_MASK 0x2 FORMAT "%13.11" ECU_ADDRESS 0x403BE5 /end MEASUREMENT
/begin MEASUREMENT B_checkpg "Freigabe zur ‹berpr¸fung der Nockenwellenflankenposition von PG" UBYTE B_TRUE 1 100 0 1 BIT_MASK 0x1 FORMAT "%13.11" ECU_ADDRESS 0x3FC176 /end MEASUREMENT
/begin MEASUREMENT B_checkpg2 "Freigabe zur ‹berpr¸fung der Nockenwellenflankenposition von PG2" UBYTE B_TRUE 1 100 0 1 BIT_MASK 0x1 FORMAT "%13.11" ECU_ADDRESS 0x3FC177 /end MEASUREMENT
/begin MEASUREMENT B_checkpg3 "Freigabe zur ‹berpr¸fung der Nockenwellenflankenposition von PG3" UBYTE B_TRUE 1 100 0 1 BIT_MASK 0x1 FORMAT "%13.11" ECU_ADDRESS 0x3FC178 /end MEASUREMENT
/begin MEASUREMENT B_checkpg4 "Freigabe zur ‹berpr¸fung der Nockenwellenflankenposition von PG4" UBYTE B_TRUE 1 100 0 1 BIT_MASK 0x1 FORMAT "%13.11" ECU_ADDRESS 0x3FC179 /end MEASUREMENT
/begin MEASUREMENT B_ckrivk "Bedingung:  Berechnung von krivk" UBYTE B_TRUE 1 100 0 1 BIT_MASK 0x1 FORMAT "%13.11" ECU_ADDRESS 0x402E69 /end MEASUREMENT
/begin MEASUREMENT B_ckrivk2 "Bedingung:  Berechnung von krivk, Bank 2" UBYTE B_TRUE 1 100 0 1 BIT_MASK 0x2 FORMAT "%13.11" ECU_ADDRESS 0x402E69 /end MEASUREMENT
/begin MEASUREMENT B_ctunp "Bedingung Fehler in CAN-Signal Umgebungstemperatur" UBYTE B_TRUE 1 100 0 1 BIT_MASK 0x2 FORMAT "%13.11" ECU_ADDRESS 0x402E9A /end MEASUREMENT
/begin MEASUREMENT B_dupw12 "Bedingung zul‰ssige Abweichung zwischen PWG-Poti 1 und 2 ¸berschritten" UBYTE B_TRUE 1 100 0 1 BIT_MASK 0x4 FORMAT "%13.11" ECU_ADDRESS 0x403BE5 /end MEASUREMENT
/begin MEASUREMENT B_ehsctm "Bedingung: Fehler aus  High-Side-Check TMOT-Signal erkannt" UBYTE B_TRUE 1 100 0 1 BIT_MASK 0x1 FORMAT "%13.11" ECU_ADDRESS 0x403BEA /end MEASUREMENT
/begin MEASUREMENT B_end421 "Bedingung Ansteuerung Endstufe 4.21 (ME9.2.1)" UBYTE B_TRUE 1 100 0 1 BIT_MASK 0x1 FORMAT "%13.11" ECU_ADDRESS 0x3FC180 /end MEASUREMENT
/begin MEASUREMENT B_enhlshk "Bedingung Freigabe Heizung Lambdasonde hinter Katalysator" UBYTE B_TRUE 1 100 0 1 BIT_MASK 0x1 FORMAT "%13.11" ECU_ADDRESS 0x3FC01F /end MEASUREMENT
/begin MEASUREMENT B_enscun "Bedingung: Kurzschluﬂ nach Ubat-Erkennung an UN des CJ125 eingeschaltet" UBYTE B_TRUE 1 100 0 1 BIT_MASK 0x4 FORMAT "%13.11" ECU_ADDRESS 0x402E68 /end MEASUREMENT
/begin MEASUREMENT B_enscun2 "Bedingung: Kurzschluﬂ nach Ubat-Erkennung an UN des CJ125 eingeschaltet, Bank 2" UBYTE B_TRUE 1 100 0 1 BIT_MASK 0x8 FORMAT "%13.11" ECU_ADDRESS 0x402E68 /end MEASUREMENT
/begin MEASUREMENT B_eshlsu "Bedingung Ende Startsteuerung in %HRLSU" UBYTE B_TRUE 1 100 0 1 BIT_MASK 0x1 FORMAT "%13.11" ECU_ADDRESS 0x402B6C /end MEASUREMENT
/begin MEASUREMENT B_eshlsu2 "Bedingung Ende Startsteuerung in %HRLSU, Bank 2" UBYTE B_TRUE 1 100 0 1 BIT_MASK 0x1 FORMAT "%13.11" ECU_ADDRESS 0x402B6D /end MEASUREMENT
/begin MEASUREMENT B_etafix "Bedingung Unplausibilit‰t fixierter Meﬂwert f¸r tans diagnostiziert" UBYTE B_TRUE 1 100 0 1 BIT_MASK 0x1 FORMAT "%13.11" ECU_ADDRESS 0x3FC105 /end MEASUREMENT
/begin MEASUREMENT B_etum "Bedingung Fehler in Umgebungstemperatur" UBYTE B_TRUE 1 100 0 1 BIT_MASK 0x1 FORMAT "%13.11" ECU_ADDRESS 0x402E9A /end MEASUREMENT
/begin MEASUREMENT B_exttper "Umschaltung nach Zahnzeitmittelung" UBYTE B_TRUE 1 100 0 1 BIT_MASK 0x40 FORMAT "%13.11" ECU_ADDRESS 0x402F52 /end MEASUREMENT
/begin MEASUREMENT B_fgdtm "Bedingung Freigabe Diagnose Tmot" UBYTE B_TRUE 1 100 0 1 BIT_MASK 0x1 FORMAT "%13.11" ECU_ADDRESS 0x403BE9 /end MEASUREMENT
/begin MEASUREMENT B_fklanf "Bedingung Anforderung Verst‰rkungsumschaltung Fettkennlinie LSU/CJ120" UBYTE B_TRUE 1 100 0 1 BIT_MASK 0x1 FORMAT "%13.11" ECU_ADDRESS 0x40390A /end MEASUREMENT
/begin MEASUREMENT B_fklanf2 "Bedingung Anforderung Verst‰rkungsumschaltung Fettkennlinie LSU2/CJ120" UBYTE B_TRUE 1 100 0 1 BIT_MASK 0x1 FORMAT "%13.11" ECU_ADDRESS 0x40390B /end MEASUREMENT
/begin MEASUREMENT B_fklanfs "Bedingung Anforderung Verst‰rkungsumschaltung Fettkennlinie LSU/CJ120 nach Start" UBYTE B_TRUE 1 100 0 1 BIT_MASK 0x1 FORMAT "%13.11" ECU_ADDRESS 0x40390C /end MEASUREMENT
/begin MEASUREMENT B_fztafx "Bedingung Fahrzyklus f¸r Check Ansauglufttemperatursignal TANS fixiert" UBYTE B_TRUE 1 100 0 1 BIT_MASK 0x1 FORMAT "%13.11" ECU_ADDRESS 0x3FC106 /end MEASUREMENT
/begin MEASUREMENT B_glf "Bedingung Gleichlauf zwischen Poti 1 und Poti 2 verletzt" UBYTE B_TRUE 1 100 0 1 BIT_MASK 0x1 FORMAT "%13.11" ECU_ADDRESS 0x3FC0FA /end MEASUREMENT
/begin MEASUREMENT B_glferr "Bedingung Fehler in Eingangsgrˆsse GLF" UBYTE B_TRUE 1 100 0 1 BIT_MASK 0x1 FORMAT "%13.11" ECU_ADDRESS 0x40374C /end MEASUREMENT
/begin MEASUREMENT B_glfoff "Bedingiung GLF aus" UBYTE B_TRUE 1 100 0 1 BIT_MASK 0x2 FORMAT "%13.11" ECU_ADDRESS 0x40374C /end MEASUREMENT
/begin MEASUREMENT B_glfon "Bedingung GLF ein" UBYTE B_TRUE 1 100 0 1 BIT_MASK 0x4 FORMAT "%13.11" ECU_ADDRESS 0x40374C /end MEASUREMENT
/begin MEASUREMENT B_hdmtl "Bedingung Heizung DM-TL" UBYTE B_TRUE 1 100 0 1 BIT_MASK 0x1 FORMAT "%13.11" ECU_ADDRESS 0x403658 /end MEASUREMENT
/begin MEASUREMENT B_henrin "Bedingung Ri-Messung darf aus Sicht der Heizungsregelung eingeschaltet werden" UBYTE B_TRUE 1 100 0 1 BIT_MASK 0x2 FORMAT "%13.11" ECU_ADDRESS 0x402B6C /end MEASUREMENT
/begin MEASUREMENT B_henrin2 "Bedingung Ri-Messung darf aus Sicht der Heizungsregelung eingeschaltet werden,B2" UBYTE B_TRUE 1 100 0 1 BIT_MASK 0x2 FORMAT "%13.11" ECU_ADDRESS 0x402B6D /end MEASUREMENT
/begin MEASUREMENT B_hlsuaru "Bedingung I-Anteil der Temp.-Regelung ist angehalten" UBYTE B_TRUE 1 100 0 1 BIT_MASK 0x2 FORMAT "%13.11" ECU_ADDRESS 0x402B6E /end MEASUREMENT
/begin MEASUREMENT B_hlsuaru2 "Bedingung I-Anteil der Temp.-Regelung ist angehalten, Bank 2" UBYTE B_TRUE 1 100 0 1 BIT_MASK 0x2 FORMAT "%13.11" ECU_ADDRESS 0x402B6F /end MEASUREMENT
/begin MEASUREMENT B_hlsumx "Bedingung U_bat-korregierte Stellgrˆﬂe ist maximal (=100%)" UBYTE B_TRUE 1 100 0 1 BIT_MASK 0x20 FORMAT "%13.11" ECU_ADDRESS 0x402B6C /end MEASUREMENT
/begin MEASUREMENT B_hlsumx2 "Bedingung U_bat-korregierte Stellgrˆﬂe ist maximal (=100%), Bank 2" UBYTE B_TRUE 1 100 0 1 BIT_MASK 0x20 FORMAT "%13.11" ECU_ADDRESS 0x402B6D /end MEASUREMENT
/begin MEASUREMENT B_hsha "Bedingung Sonde hinter Kat ausreichend beheizt" UBYTE B_TRUE 1 100 0 1 BIT_MASK 0x1 FORMAT "%13.11" ECU_ADDRESS 0x3FC020 /end MEASUREMENT
/begin MEASUREMENT B_hsha2 "Bedingung Sonde 2 hinter Kat ausreichend beheizt" UBYTE B_TRUE 1 100 0 1 BIT_MASK 0x1 FORMAT "%13.11" ECU_ADDRESS 0x3FC021 /end MEASUREMENT
/begin MEASUREMENT B_hshe "Bedingung Endstufe Sondenheizung hinter Kat angesteuert" UBYTE B_TRUE 1 100 0 1 BIT_MASK 0x1 FORMAT "%13.11" ECU_ADDRESS 0x3FC022 /end MEASUREMENT
/begin MEASUREMENT B_hshe2 "Bedingung Endstufe Sondenheizung2 hinter Kat angesteuert" UBYTE B_TRUE 1 100 0 1 BIT_MASK 0x1 FORMAT "%13.11" ECU_ADDRESS 0x3FC023 /end MEASUREMENT
/begin MEASUREMENT B_hstkaerr "Bedingung Highsided TKA Fehler vorhanden" UBYTE B_TRUE 1 100 0 1 BIT_MASK 0x4 FORMAT "%13.11" ECU_ADDRESS 0x402EA2 /end MEASUREMENT
/begin MEASUREMENT B_hstlsua "Bedingung: Heizerstatus A liegt vor, Sonde ist ausreichend aufgeheizt" UBYTE B_TRUE 1 100 0 1 BIT_MASK 0x4 FORMAT "%13.11" ECU_ADDRESS 0x402B6C /end MEASUREMENT
/begin MEASUREMENT B_hstlsua2 "Bedingung: Heizerstatus A liegt vor, Sonde ist ausreichend aufgeheizt, Bank2" UBYTE B_TRUE 1 100 0 1 BIT_MASK 0x4 FORMAT "%13.11" ECU_ADDRESS 0x402B6D /end MEASUREMENT
/begin MEASUREMENT B_hstlsub "Bedingung: Heizerstatus B liegt vor, Schubabgleich darf durchgef¸hrt werden" UBYTE B_TRUE 1 100 0 1 BIT_MASK 0x8 FORMAT "%13.11" ECU_ADDRESS 0x402B6C /end MEASUREMENT
/begin MEASUREMENT B_hstlsub2 "Bedingung: Heizerstatus B liegt vor, Schubabgleich darf durchgef¸hrt werden,b2" UBYTE B_TRUE 1 100 0 1 BIT_MASK 0x8 FORMAT "%13.11" ECU_ADDRESS 0x402B6D /end MEASUREMENT
/begin MEASUREMENT B_hsv "Bedingung Heizung Sonde vor Kat einschaltbereit" UBYTE B_TRUE 1 100 0 1 BIT_MASK 0x10 FORMAT "%13.11" ECU_ADDRESS 0x402B6C /end MEASUREMENT
/begin MEASUREMENT B_hsv2 "Bedingung Heizung Sonde2 vor Kat einschaltbereit" UBYTE B_TRUE 1 100 0 1 BIT_MASK 0x10 FORMAT "%13.11" ECU_ADDRESS 0x402B6D /end MEASUREMENT
/begin MEASUREMENT B_iclsabg "Bedingung: Anforderung/Durchf¸hrung  des elektrischen Abgleiches der LSU" UBYTE B_TRUE 1 100 0 1 BIT_MASK 0x2 FORMAT "%13.11" ECU_ADDRESS 0x40390A /end MEASUREMENT
/begin MEASUREMENT B_iclsabg2 "Bedingung: Anforderung/Durchf¸hrung  des elektrischen Abgleiches der LSU, Bank 2" UBYTE B_TRUE 1 100 0 1 BIT_MASK 0x2 FORMAT "%13.11" ECU_ADDRESS 0x40390B /end MEASUREMENT
/begin MEASUREMENT B_kalter "Umschaltung Thermostatregelung" UBYTE B_TRUE 1 100 0 1 BIT_MASK 0x2 FORMAT "%13.11" ECU_ADDRESS 0x403BEA /end MEASUREMENT
/begin MEASUREMENT B_kaltumew "Umschaltung Ersatzwert durch K¸hlanforderung von geregeltem Kennfeldthermostat" UBYTE B_TRUE 1 100 0 1 BIT_MASK 0x4 FORMAT "%13.11" ECU_ADDRESS 0x403BEA /end MEASUREMENT
/begin MEASUREMENT B_kaltumof "Totzeit Einfluss bei Abschaltung Thermostateingriff auf Tmot" UBYTE B_TRUE 1 100 0 1 BIT_MASK 0x8 FORMAT "%13.11" ECU_ADDRESS 0x403BEA /end MEASUREMENT
/begin MEASUREMENT B_kaltumre "Umschaltung Referenz -und Ersatzwert durch K¸hlanforderung von geregeltem Kennfe" UBYTE B_TRUE 1 100 0 1 BIT_MASK 0x10 FORMAT "%13.11" ECU_ADDRESS 0x403BEA /end MEASUREMENT
/begin MEASUREMENT B_kaltumrw "Umschaltung Referenzwert durch K¸hlanforderung von geregeltem Kennfeldthermostat" UBYTE B_TRUE 1 100 0 1 BIT_MASK 0x20 FORMAT "%13.11" ECU_ADDRESS 0x403BEA /end MEASUREMENT
/begin MEASUREMENT B_kpl "Bedingung keine Unplausibilit‰t erkannt" UBYTE B_TRUE 1 100 0 1 BIT_MASK 0x1 FORMAT "%13.11" ECU_ADDRESS 0x3FC107 /end MEASUREMENT
/begin MEASUREMENT B_llhzta "Bedingung TANS-Sensor  wird im Leerlauf aufgeheizt" UBYTE B_TRUE 1 100 0 1 BIT_MASK 0x1 FORMAT "%13.11" ECU_ADDRESS 0x3FC108 /end MEASUREMENT
/begin MEASUREMENT B_lltafx "Bedingung Leerlaufzyklus f¸r Check Ansauglufttemperatursignal TANS fixiert" UBYTE B_TRUE 1 100 0 1 BIT_MASK 0x1 FORMAT "%13.11" ECU_ADDRESS 0x3FC109 /end MEASUREMENT
/begin MEASUREMENT B_mbvh "Bedingung Miﬂbrauchsverhinderung" UBYTE B_TRUE 1 100 0 1 BIT_MASK 0x1 FORMAT "%13.11" ECU_ADDRESS 0x3FC0FB /end MEASUREMENT
/begin MEASUREMENT B_mxmntm "Bedingung min-oder max-Fehler Motortemperaturf¸hler vorhanden" UBYTE B_TRUE 1 100 0 1 BIT_MASK 0x40 FORMAT "%13.11" ECU_ADDRESS 0x403BEA /end MEASUREMENT
/begin MEASUREMENT B_npotm "Bedingung: Motortemperatursignal im oberen Bereich nicht plausibel" UBYTE B_TRUE 1 100 0 1 BIT_MASK 0x80 FORMAT "%13.11" ECU_ADDRESS 0x403BEA /end MEASUREMENT
/begin MEASUREMENT B_pbpabr "Bedingung: Plausibilit‰tbegrenzung ""Bremse/PWG"" aktivieren ¸ber Bremse" UBYTE B_TRUE 1 100 0 1 BIT_MASK 0x1 FORMAT "%13.11" ECU_ADDRESS 0x3FC0FC /end MEASUREMENT
/begin MEASUREMENT B_pg1limsw "Bereichs¸berschreitung bei Grenzen f¸r Nockenwellenflanke von PG" UBYTE B_TRUE 1 100 0 1 BIT_MASK 0x1 FORMAT "%13.11" ECU_ADDRESS 0x3FC17A /end MEASUREMENT
/begin MEASUREMENT B_pg2limsw "Bereichs¸berschreitung bei Grenzen f¸r Nockenwellenflanke von PG2" UBYTE B_TRUE 1 100 0 1 BIT_MASK 0x1 FORMAT "%13.11" ECU_ADDRESS 0x3FC17B /end MEASUREMENT
/begin MEASUREMENT B_pg3limsw "Bereichs¸berschreitung bei Grenzen f¸r Nockenwellenflanke von PG3" UBYTE B_TRUE 1 100 0 1 BIT_MASK 0x1 FORMAT "%13.11" ECU_ADDRESS 0x3FC17C /end MEASUREMENT
/begin MEASUREMENT B_pg4limsw "Bereichs¸berschreitung bei Grenzen f¸r Nockenwellenflanke von PG4" UBYTE B_TRUE 1 100 0 1 BIT_MASK 0x1 FORMAT "%13.11" ECU_ADDRESS 0x3FC17D /end MEASUREMENT
/begin MEASUREMENT B_phaactiv "Bedingung aktive Flanke der Master-Nockenwelle" UBYTE B_TRUE 1 100 0 1 BIT_MASK 0x1 FORMAT "%13.11" ECU_ADDRESS 0x3FC17E /end MEASUREMENT
/begin MEASUREMENT B_plaus "Fehlertyp 'Wert unplausibel' erkannt" UBYTE B_TRUE 1 100 0 1 BIT_MASK 0x1 FORMAT "%13.11" ECU_ADDRESS 0x3FC10A /end MEASUREMENT
/begin MEASUREMENT B_pusab "Bedingung Abschaltung der Pumpspannung f¸r LSU" UBYTE B_TRUE 1 100 0 1 BIT_MASK 0x1 FORMAT "%13.11" ECU_ADDRESS 0x402E68 /end MEASUREMENT
/begin MEASUREMENT B_pusab2 "Bedingung Abschaltung der Pumpspannung f¸r LSU 2, Bank 2" UBYTE B_TRUE 1 100 0 1 BIT_MASK 0x10 FORMAT "%13.11" ECU_ADDRESS 0x402E68 /end MEASUREMENT
/begin MEASUREMENT B_pwgbwf "Bedingung PWG-Bewegungsfehler" UBYTE B_TRUE 1 100 0 1 BIT_MASK 0x80 FORMAT "%13.11" ECU_ADDRESS 0x403BE6 /end MEASUREMENT
/begin MEASUREMENT B_pwglk "Bedingung Lebenderkennung PWG" UBYTE B_TRUE 1 100 0 1 BIT_MASK 0x20 FORMAT "%13.11" ECU_ADDRESS 0x403BE5 /end MEASUREMENT
/begin MEASUREMENT B_pwgnotfr "FR-Fehlerreaktion PWG-Notfahren" UBYTE B_TRUE 1 100 0 1 BIT_MASK 0x1 FORMAT "%13.11" ECU_ADDRESS 0x3FC0FD /end MEASUREMENT
/begin MEASUREMENT B_rehs "Restart Sondenheizung" UBYTE B_TRUE 1 100 0 1 BIT_MASK 0x1 FORMAT "%13.11" ECU_ADDRESS 0x3FC024 /end MEASUREMENT
/begin MEASUREMENT B_resabg "Bedingung f¸r R¸cksetzen Abgleich CJ125" UBYTE B_TRUE 1 100 0 1 BIT_MASK 0x4 FORMAT "%13.11" ECU_ADDRESS 0x40390C /end MEASUREMENT
/begin MEASUREMENT B_resabg2 "Bedingung f¸r R¸cksetzen Abgleich CJ125 Bank 2" UBYTE B_TRUE 1 100 0 1 BIT_MASK 0x8 FORMAT "%13.11" ECU_ADDRESS 0x40390C /end MEASUREMENT
/begin MEASUREMENT B_rinabg "Bedingung Abgleich Innenwiderstand Nernstzelle von LSU" UBYTE B_TRUE 1 100 0 1 BIT_MASK 0x2 FORMAT "%13.11" ECU_ADDRESS 0x402E68 /end MEASUREMENT
/begin MEASUREMENT B_rinabg2 "Bedingung Abgleich Innenwiderstand Nernstzelle von LSU , Bank 2" UBYTE B_TRUE 1 100 0 1 BIT_MASK 0x20 FORMAT "%13.11" ECU_ADDRESS 0x402E68 /end MEASUREMENT
/begin MEASUREMENT B_scbkhoff "Bedingung Bereich K¸hlleistung hoch f¸r Stuckcheck verlassen" UBYTE B_TRUE 1 100 0 1 BIT_MASK 0x1 FORMAT "%13.11" ECU_ADDRESS 0x403BEB /end MEASUREMENT
/begin MEASUREMENT B_scbknoff "Bedingung Bereich K¸hlleistung niedrig f¸r Stuckcheck verlassen" UBYTE B_TRUE 1 100 0 1 BIT_MASK 0x2 FORMAT "%13.11" ECU_ADDRESS 0x403BEB /end MEASUREMENT
/begin MEASUREMENT B_sctkaen "Bedingung Stuckcheck TKA freigegeben" UBYTE B_TRUE 1 100 0 1 BIT_MASK 0x1 FORMAT "%13.11" ECU_ADDRESS 0x402EA2 /end MEASUREMENT
/begin MEASUREMENT B_sctkaerr "Bedingung Stuckcheck TKA Fehler vorhanden" UBYTE B_TRUE 1 100 0 1 BIT_MASK 0x2 FORMAT "%13.11" ECU_ADDRESS 0x402EA2 /end MEASUREMENT
/begin MEASUREMENT B_shakt "Bedingung Standheizungseinfluss" UBYTE B_TRUE 1 100 0 1 BIT_MASK 0x4 FORMAT "%13.11" ECU_ADDRESS 0x403BEB /end MEASUREMENT
/begin MEASUREMENT B_sp1s "Mitteilung an SR: SP1S ist F¸hrungsgrˆﬂe." UBYTE B_TRUE 1 100 0 1 BIT_MASK 0x1 FORMAT "%13.11" ECU_ADDRESS 0x3FC0FE /end MEASUREMENT
/begin MEASUREMENT B_sp2s "Mitteilung an SR:Poti2 SP2S F¸hrungsgrˆﬂe,Poti1 Ober-oder Untergrenze ¸berschr." UBYTE B_TRUE 1 100 0 1 BIT_MASK 0x1 FORMAT "%13.11" ECU_ADDRESS 0x3FC0FF /end MEASUREMENT
/begin MEASUREMENT B_sphrlsu "Bedingung: Stop Heizungsregelung wegen Fehler an der LSU" UBYTE B_TRUE 1 100 0 1 BIT_MASK 0x4 FORMAT "%13.11" ECU_ADDRESS 0x402B6E /end MEASUREMENT
/begin MEASUREMENT B_sphrlsu2 "Bedingung: Stop Heizungsregelung wegen Fehler an der LSU, Bank 2" UBYTE B_TRUE 1 100 0 1 BIT_MASK 0x4 FORMAT "%13.11" ECU_ADDRESS 0x402B6F /end MEASUREMENT
/begin MEASUREMENT B_spsmin "Mitteilung an SR: '1'= PWG-Notfahren mit SPSMIN" UBYTE B_TRUE 1 100 0 1 BIT_MASK 0x1 FORMAT "%13.11" ECU_ADDRESS 0x3FC100 /end MEASUREMENT
/begin MEASUREMENT B_stdhaktOld "" UBYTE B_TRUE 1 100 0 1 BIT_MASK 0x1 FORMAT "%13.11" ECU_ADDRESS 0x3FC10B /end MEASUREMENT
/begin MEASUREMENT B_stprel "Bedingung Entprellung von Drehzahlgebersignal gestartet" UBYTE B_TRUE 1 100 0 1 BIT_MASK 0x2 FORMAT "%13.11" ECU_ADDRESS 0x402F52 /end MEASUREMENT
/begin MEASUREMENT B_synnldg "Bedingung: Motorposition im Notlauf DG aus PG-Signal erkannt" UBYTE B_TRUE 1 100 0 1 BIT_MASK 0x20 FORMAT "%13.11" ECU_ADDRESS 0x402F52 /end MEASUREMENT
/begin MEASUREMENT B_tabgs "Bedingung Abgleich stetige Lambda-Sonde LSU nach Start" UBYTE B_TRUE 1 100 0 1 BIT_MASK 0x2 FORMAT "%13.11" ECU_ADDRESS 0x40390C /end MEASUREMENT
/begin MEASUREMENT B_tablsugr "Bed. Abstellzeit zu groﬂ, daﬂ Ri-Messung um Zeit THLSUHR verzˆgert wird" UBYTE B_TRUE 1 100 0 1 BIT_MASK 0x10 FORMAT "%13.11" ECU_ADDRESS 0x402B6E /end MEASUREMENT
/begin MEASUREMENT B_tamlent "Entprellung Thermostatansteuerung f¸r TMRW" UBYTE B_TRUE 1 100 0 1 BIT_MASK 0x8 FORMAT "%13.11" ECU_ADDRESS 0x403BEB /end MEASUREMENT
/begin MEASUREMENT B_tkatuvgl "Bedingung TKA-Solltemperatur nahe an Umgebungstemperatur" UBYTE B_TRUE 1 100 0 1 BIT_MASK 0x20 FORMAT "%13.11" ECU_ADDRESS 0x402EA2 /end MEASUREMENT
/begin MEASUREMENT B_tmdmme "Bedingung Endtemperatur von Motortemperaturmodell erreicht" UBYTE B_TRUE 1 100 0 1 BIT_MASK 0x2 FORMAT "%13.11" ECU_ADDRESS 0x403BE9 /end MEASUREMENT
/begin MEASUREMENT B_tmmn "Bedingung: Blockheater erkannt" UBYTE B_TRUE 1 100 0 1 BIT_MASK 0x10 FORMAT "%13.11" ECU_ADDRESS 0x403BEB /end MEASUREMENT
/begin MEASUREMENT B_tmpsener "Sammelfehler Temperatursensoren f¸r TUM-Plaus" UBYTE B_TRUE 1 100 0 1 BIT_MASK 0x8 FORMAT "%13.11" ECU_ADDRESS 0x402E9B /end MEASUREMENT
/begin MEASUREMENT B_tmrwmsee "Masterfehler f¸r Ersatzwertbestimmung" UBYTE B_TRUE 1 100 0 1 BIT_MASK 0x20 FORMAT "%13.11" ECU_ADDRESS 0x403BEB /end MEASUREMENT
/begin MEASUREMENT B_tmsrt "Bedingung Retriggerung Motortemperaturmodell nach Start" UBYTE B_TRUE 1 100 0 1 BIT_MASK 0x4 FORMAT "%13.11" ECU_ADDRESS 0x403BE9 /end MEASUREMENT
/begin MEASUREMENT B_tmtkascf "Bedingung tmot erreicht Schwellwert ab der das Thermostat ˆffnet" UBYTE B_TRUE 1 100 0 1 BIT_MASK 0x10 FORMAT "%13.11" ECU_ADDRESS 0x402EA2 /end MEASUREMENT
/begin MEASUREMENT B_tprel "Bedingung Zeitentprellung abgeschlossen" UBYTE B_TRUE 1 100 0 1 BIT_MASK 0x4 FORMAT "%13.11" ECU_ADDRESS 0x402F52 /end MEASUREMENT
/begin MEASUREMENT B_tumabstp "Umgebungstemperatur‰nderung seit letzter Fahrt" UBYTE B_TRUE 1 100 0 1 BIT_MASK 0x4 FORMAT "%13.11" ECU_ADDRESS 0x402E9B /end MEASUREMENT
/begin MEASUREMENT B_tumen "Berechnung TUM-Plaus g¸ltig" UBYTE B_TRUE 1 100 0 1 BIT_MASK 0x20 FORMAT "%13.11" ECU_ADDRESS 0x402E9B /end MEASUREMENT
/begin MEASUREMENT B_tumgnpl "Umgebungstemperatur nicht plausibel" UBYTE B_TRUE 1 100 0 1 BIT_MASK 0x2 FORMAT "%13.11" ECU_ADDRESS 0x402E9B /end MEASUREMENT
/begin MEASUREMENT B_tummstpl "Temperatur‰nderung seit Motorstart" UBYTE B_TRUE 1 100 0 1 BIT_MASK 0x40 FORMAT "%13.11" ECU_ADDRESS 0x402E9B /end MEASUREMENT
/begin MEASUREMENT B_tumnplen "Diagnose aktiv" UBYTE B_TRUE 1 100 0 1 BIT_MASK 0x1 FORMAT "%13.11" ECU_ADDRESS 0x402E9B /end MEASUREMENT
/begin MEASUREMENT B_tumrec "Erste Umgebungstemperatur vom CAN empfangen" UBYTE B_TRUE 1 100 0 1 BIT_MASK 0x10 FORMAT "%13.11" ECU_ADDRESS 0x402E9B /end MEASUREMENT
/begin MEASUREMENT B_tumres "NPL -Fehler Umgebungstemperatur verwerfen" UBYTE B_TRUE 1 100 0 1 BIT_MASK 0x80 FORMAT "%13.11" ECU_ADDRESS 0x402E9B /end MEASUREMENT
/begin MEASUREMENT B_up2bwf "Bewegungsfehler an Poti 2 bei Abschluﬂ der Bewegungserkennung" UBYTE B_TRUE 1 100 0 1 BIT_MASK 0x40 FORMAT "%13.11" ECU_ADDRESS 0x403BE5 /end MEASUREMENT
/begin MEASUREMENT B_upw12e "Bedingung: Fehler bei Vergleich der beiden normierten PWG-Poti-Spannungen" UBYTE B_TRUE 1 100 0 1 BIT_MASK 0x4 FORMAT "%13.11" ECU_ADDRESS 0x403BE6 /end MEASUREMENT
/begin MEASUREMENT B_upw1mn "Bedingung: Spannung PWG-Poti 1 unterhalb Minimalwert" UBYTE B_TRUE 1 100 0 1 BIT_MASK 0x8 FORMAT "%13.11" ECU_ADDRESS 0x403BE6 /end MEASUREMENT
/begin MEASUREMENT B_upw1mx "Bedingung: Spannung PWG-Poti 1 oberhalb Maximalwert" UBYTE B_TRUE 1 100 0 1 BIT_MASK 0x10 FORMAT "%13.11" ECU_ADDRESS 0x403BE6 /end MEASUREMENT
/begin MEASUREMENT B_upw2mn "Bedingung: Spannung PWG-Poti 2 unterhalb Minimalwert" UBYTE B_TRUE 1 100 0 1 BIT_MASK 0x20 FORMAT "%13.11" ECU_ADDRESS 0x403BE6 /end MEASUREMENT
/begin MEASUREMENT B_upw2mx "Bedingung: Spannung PWG-Poti 2 oberhalb Maximalwert" UBYTE B_TRUE 1 100 0 1 BIT_MASK 0x40 FORMAT "%13.11" ECU_ADDRESS 0x403BE6 /end MEASUREMENT
/begin MEASUREMENT B_upwbwf "Bewegungserkennung hat im aktuellen Fahrzyklus einen Fehler erkannt" UBYTE B_TRUE 1 100 0 1 BIT_MASK 0x1 FORMAT "%13.11" ECU_ADDRESS 0x3FC101 /end MEASUREMENT
/begin MEASUREMENT B_upwg1o "Bedingung Bereichsverletzung an PWG-Poti 1 nach oben" UBYTE B_TRUE 1 100 0 1 BIT_MASK 0x8 FORMAT "%13.11" ECU_ADDRESS 0x403BE5 /end MEASUREMENT
/begin MEASUREMENT B_upwg1u "Bedingung Bereichsverletzung an PWG-Poti 1 nach unten" UBYTE B_TRUE 1 100 0 1 BIT_MASK 0x10 FORMAT "%13.11" ECU_ADDRESS 0x403BE5 /end MEASUREMENT
/begin MEASUREMENT B_upwg2o "Bedingung Bereichsverletzung an PWG-Poti 2 nach oben" UBYTE B_TRUE 1 100 0 1 BIT_MASK 0x1 FORMAT "%13.11" ECU_ADDRESS 0x403BE6 /end MEASUREMENT
/begin MEASUREMENT B_upwg2u "Bedingung Bereichsverletzung an PWG-Poti 2 nach unten" UBYTE B_TRUE 1 100 0 1 BIT_MASK 0x2 FORMAT "%13.11" ECU_ADDRESS 0x403BE6 /end MEASUREMENT
/begin MEASUREMENT B_vnull "Bedingung Fahrzeug steht" UBYTE B_TRUE 1 100 0 1 BIT_MASK 0x1 FORMAT "%13.11" ECU_ADDRESS 0x3FC175 /end MEASUREMENT
/begin MEASUREMENT B_vpwgerr "Bedingung: Verdacht auf PWG-Fehler" UBYTE B_TRUE 1 100 0 1 BIT_MASK 0x1 FORMAT "%13.11" ECU_ADDRESS 0x3FC102 /end MEASUREMENT
/begin MEASUREMENT B_wpabnb "Bedingung ƒnderungsbegrenzung des Pedalwerts nach Bremsbet‰tigung" UBYTE B_TRUE 1 100 0 1 BIT_MASK 0x1 FORMAT "%13.11" ECU_ADDRESS 0x3FC103 /end MEASUREMENT
/begin MEASUREMENT B_wpmbbr "Bedingung Maximalbegrenzung des Pedalwerts bei Bremsbet‰tigung" UBYTE B_TRUE 1 100 0 1 BIT_MASK 0x1 FORMAT "%13.11" ECU_ADDRESS 0x3FC104 /end MEASUREMENT
/begin MEASUREMENT B_zhsctm "Bedingung: Zyklusflag-Freigabe vom High-Side-Check TMOT-Signal" UBYTE B_TRUE 1 100 0 1 BIT_MASK 0x40 FORMAT "%13.11" ECU_ADDRESS 0x403BEB /end MEASUREMENT
/begin MEASUREMENT B_zphflma "Phasenflankenz‰hler der Master-NW ist OK" UBYTE B_TRUE 1 100 0 1 BIT_MASK 0x1 FORMAT "%13.11" ECU_ADDRESS 0x3FC17F /end MEASUREMENT
/begin MEASUREMENT B_zprel "Bedingung Zahnentprellung erfolgt" UBYTE B_TRUE 1 100 0 1 BIT_MASK 0x8 FORMAT "%13.11" ECU_ADDRESS 0x402F52 /end MEASUREMENT
/begin MEASUREMENT B_zsctka "Bedingung: Zyklusflag-Freigabe vom Stuck-Signal-Check TKA-Signal" UBYTE B_TRUE 1 100 0 1 BIT_MASK 0x8 FORMAT "%13.11" ECU_ADDRESS 0x402EA2 /end MEASUREMENT
/begin MEASUREMENT B_zsynchro "Bedingung f¸r einmaliges Auslˆsen eines virtuellen Zwangssynchros im Start" UBYTE B_TRUE 1 100 0 1 BIT_MASK 0x10 FORMAT "%13.11" ECU_ADDRESS 0x402F52 /end MEASUREMENT
/begin MEASUREMENT B_ztafix "Bedingung Unplausibilit‰tspr¸fung f¸r fixiertes tans-Meﬂwert erf¸llt" UBYTE B_TRUE 1 100 0 1 BIT_MASK 0x1 FORMAT "%13.11" ECU_ADDRESS 0x3FC10C /end MEASUREMENT
/begin MEASUREMENT camstate "Array mit Status des Nockenwelle-Treibers f¸r jede NW" UBYTE dez 1 100 0 255 FORMAT "%5.1" ARRAY_SIZE 4 ECU_ADDRESS 0x40392E /end MEASUREMENT
/begin MEASUREMENT crankstate "Status des Kurbelwellentreibers" UBYTE dez 1 100 0 255 FORMAT "%5.1" ECU_ADDRESS 0x403937 /end MEASUREMENT
/begin MEASUREMENT ctrbwf "Fehlerz‰hler Bewegungserkennung" UBYTE dez 1 100 0 255 FORMAT "%5.1" ECU_ADDRESS 0x403BE3 /end MEASUREMENT
/begin MEASUREMENT dlrspids_w "DLR f¸r DV-E: Summe der PID-Anteile (mit Vorzeichen)" SWORD rel_q0p01 1 100 -327.68 327.67 FORMAT "%8.4" ECU_ADDRESS 0x3FC3F6 /end MEASUREMENT
/begin MEASUREMENT drinlsu2_w "Differenz zwischen Soll- und Istwert f¸r RICAL w‰hrend des Abgleiches, Bank 2" SWORD r_q0p0391 1 100 -1280 1279.96 FORMAT "%8.3" ECU_ADDRESS 0x402E4C /end MEASUREMENT
/begin MEASUREMENT drinlsu_w "Differenz zwischen Soll- und Istwert f¸r RICAL w‰hrend des Abgleiches" SWORD r_q0p0391 1 100 -1280 1279.96 FORMAT "%8.3" ECU_ADDRESS 0x402E4E /end MEASUREMENT
/begin MEASUREMENT dtkatumg "Temperaturdifferenz zwischen tkalin zu tmot" UBYTE temp_ub_q0p75 1 100 0 191.25 FORMAT "%5.1" ECU_ADDRESS 0x402EA0 /end MEASUREMENT
/begin MEASUREMENT dtkavglw "Temperaturdifferenz aus TKA-Abk¸hlung" UBYTE temp_ub_q0p75 1 100 0 191.25 FORMAT "%5.1" ECU_ADDRESS 0x402EA1 /end MEASUREMENT
/begin MEASUREMENT dtmabsta "Delta Motortemperatur zwischen letztem Abstellen und aktuellem Start" UBYTE temp_ub_b191p25 1 100 0 191.25 FORMAT "%5.1" ECU_ADDRESS 0x402E6A /end MEASUREMENT
/begin MEASUREMENT dtmrw "L¸fteransteuerungs‰nderung" SBYTE temp_sb_b0p093 1 100 -0.09375 0.0930176 FORMAT "%7.5" ECU_ADDRESS 0x402E74 /end MEASUREMENT
/begin MEASUREMENT dtmrwp_w "W‰rmestrom‰nderung f¸r Referenztemperatur TMOT" SWORD fak_q0p1 1 100 -3276.8 3276.7 FORMAT "%8.3" ECU_ADDRESS 0x402E8A /end MEASUREMENT
/begin MEASUREMENT dtmrwt_w "L¸fteransteuerungs‰nderung" SWORD rel_sw_b100 1 100 -100 99.9969 FORMAT "%8.4" ECU_ADDRESS 0x402E8C /end MEASUREMENT
/begin MEASUREMENT dua10g2_w "Verst‰rkung korrigierte Sondenspannung vor Kat einer Breitbandlambdasonde Bank 2" SWORD spg_q4p88Em4 1 100 -16 15.9995 FORMAT "%8.5" ECU_ADDRESS 0x402E16 /end MEASUREMENT
/begin MEASUREMENT dua10g_w "Verst‰rkung korrigierte Sondenspannung vor Kat einer Breitbandlambdasonde" SWORD spg_q4p88Em4 1 100 -16 15.9995 FORMAT "%8.5" ECU_ADDRESS 0x402E18 /end MEASUREMENT
/begin MEASUREMENT dwped "Gradient des normierten Fahrpedalwinkels" SBYTE rel_sb_q0p39 1 100 -49.9968 49.6062 FORMAT "%5.2" ECU_ADDRESS 0x403BE4 /end MEASUREMENT
/begin MEASUREMENT dwped_w "Gradient des normierten Fahrpedalwinkels" SWORD rel_sw_b50 1 100 -50 49.9985 FORMAT "%8.5" ECU_ADDRESS 0x404086 /end MEASUREMENT
/begin MEASUREMENT fktmsch "Korrekturfaktor f¸r Steigung Modelltemperatur bei Schichtbetrieb" UBYTE fak_ub_b2 1 100 0 1.99219 FORMAT "%5.3" ECU_ADDRESS 0x402E75 /end MEASUREMENT
/begin MEASUREMENT fvst_w "Faktor Vorsteuerung" UWORD fak_uw_b64 1 100 0 63.999 FORMAT "%8.5" ECU_ADDRESS 0x40404E /end MEASUREMENT
/begin MEASUREMENT ggo2lsuAusBits10ms "" UBYTE dez 1 100 0 255 FORMAT "%5.1" ECU_ADDRESS 0x40390A /end MEASUREMENT
/begin MEASUREMENT ggo2lsuAusBits10ms_2 "" UBYTE dez 1 100 0 255 FORMAT "%5.1" ECU_ADDRESS 0x40390B /end MEASUREMENT
/begin MEASUREMENT ggo2lsuLokBits10ms "" UBYTE dez 1 100 0 255 FORMAT "%5.1" ECU_ADDRESS 0x40390C /end MEASUREMENT
/begin MEASUREMENT GGPEDlokbits "" UBYTE dez 1 100 0 255 FORMAT "%5.1" ECU_ADDRESS 0x403BE5 /end MEASUREMENT
/begin MEASUREMENT GGPEDlokbits2 "" UBYTE dez 1 100 0 255 FORMAT "%5.1" ECU_ADDRESS 0x403BE6 /end MEASUREMENT
/begin MEASUREMENT ggrtlsuAusBits10ms "" UBYTE dez 1 100 0 255 FORMAT "%5.1" ECU_ADDRESS 0x402E68 /end MEASUREMENT
/begin MEASUREMENT ggrtlsuLokBits10ms "" UBYTE dez 1 100 0 255 FORMAT "%5.1" ECU_ADDRESS 0x402E69 /end MEASUREMENT
/begin MEASUREMENT ggtfumgAUSBit "" UBYTE dez 1 100 0 255 FORMAT "%5.1" ECU_ADDRESS 0x402E9A /end MEASUREMENT
/begin MEASUREMENT ggtfumgLocBit "" UBYTE dez 1 100 0 255 FORMAT "%5.1" ECU_ADDRESS 0x402E9B /end MEASUREMENT
/begin MEASUREMENT ggtkaLokBits "" UBYTE dez 1 100 0 255 FORMAT "%5.1" ECU_ADDRESS 0x402EA2 /end MEASUREMENT
/begin MEASUREMENT GLF100mslocbits "" UBYTE dez 1 100 0 255 FORMAT "%5.1" ECU_ADDRESS 0x40374C /end MEASUREMENT
/begin MEASUREMENT hrlsuAusBits "" UBYTE dez 1 100 0 255 FORMAT "%5.1" ECU_ADDRESS 0x402B6C /end MEASUREMENT
/begin MEASUREMENT hrlsuAusBits_2 "" UBYTE dez 1 100 0 255 FORMAT "%5.1" ECU_ADDRESS 0x402B6D /end MEASUREMENT
/begin MEASUREMENT hrlsuLokBits "" UBYTE dez 1 100 0 255 FORMAT "%5.1" ECU_ADDRESS 0x402B6E /end MEASUREMENT
/begin MEASUREMENT hrlsuLokBits_2 "" UBYTE dez 1 100 0 255 FORMAT "%5.1" ECU_ADDRESS 0x402B6F /end MEASUREMENT
/begin MEASUREMENT iintpid2_w "Initialisierungswert f¸r den Integrator INTPID2 des PID-Reglers, Bank 2" UWORD rel_uw_b200 1 100 0 99.9969 FORMAT "%8.5" ECU_ADDRESS 0x402B46 /end MEASUREMENT
/begin MEASUREMENT iintpid_w "Initialisierungswert f¸r den Integrator INTPID des PID-Reglers" UWORD rel_uw_b200 1 100 0 99.9969 FORMAT "%8.5" ECU_ADDRESS 0x402B48 /end MEASUREMENT
/begin MEASUREMENT ipiprk2_w "Pumpstrom IP LSU 2, korrigiert um Referenzpumpstrom" SWORD i_q1_uA 1 100 -32768 32767 FORMAT "%8.2" ECU_ADDRESS 0x402E1E /end MEASUREMENT
/begin MEASUREMENT ipiprk_w "Pumpstrom IP LSU, korrigiert um Referenzpumpstrom" SWORD i_q1_uA 1 100 -32768 32767 FORMAT "%8.2" ECU_ADDRESS 0x402E20 /end MEASUREMENT
/begin MEASUREMENT ipkorp2_w "Pumpstrom IP LSU 2, druckkorrigiert" SWORD i_q1_uA 1 100 -32768 32767 FORMAT "%8.2" ECU_ADDRESS 0x402E22 /end MEASUREMENT
/begin MEASUREMENT ipkorp_w "Pumpstrom IP LSU, druckkorrigiert" SWORD i_q1_uA 1 100 -32768 32767 FORMAT "%8.2" ECU_ADDRESS 0x402E24 /end MEASUREMENT
/begin MEASUREMENT ipktk2_w "Pumpstrom IP LSU 2, temperaturkorrigiert" SWORD i_q1_uA 1 100 -32768 32767 FORMAT "%8.2" ECU_ADDRESS 0x402E26 /end MEASUREMENT
/begin MEASUREMENT ipktk_w "Pumpstrom IP LSU, temperaturkorrigiert" SWORD i_q1_uA 1 100 -32768 32767 FORMAT "%8.2" ECU_ADDRESS 0x402E28 /end MEASUREMENT
/begin MEASUREMENT iplsuvj2_w "Pumpstrom IP LSU2" UWORD dez 1 100 0 65535 FORMAT "%8.2" ECU_ADDRESS 0x402E2A /end MEASUREMENT
/begin MEASUREMENT iplsuvj_w "Pumpstrom IP LSU" UWORD dez 1 100 0 65535 FORMAT "%8.2" ECU_ADDRESS 0x402E2C /end MEASUREMENT
/begin MEASUREMENT iproh2_w "Pumpstrom IP LSU 2, Rohwert" SWORD i_q1_uA 1 100 -32768 32767 FORMAT "%8.2" ECU_ADDRESS 0x402E2E /end MEASUREMENT
/begin MEASUREMENT iproh_w "Pumpstrom IP LSU, Rohwert" SWORD i_q1_uA 1 100 -32768 32767 FORMAT "%8.2" ECU_ADDRESS 0x402E30 /end MEASUREMENT
/begin MEASUREMENT krivk2_w "Korrekturwert f¸r den Innenwiderstand der Nernstzelle der LSU 2" SWORD r_q0p0391 1 100 -1280 1279.96 FORMAT "%8.3" ECU_ADDRESS 0x3FE18C /end MEASUREMENT
/begin MEASUREMENT krivk_w "Korrekturwert f¸r den Innenwiderstand der Nernstzelle der LSU" SWORD r_q0p0391 1 100 -1280 1279.96 FORMAT "%8.3" ECU_ADDRESS 0x3FE18E /end MEASUREMENT
/begin MEASUREMENT ktkvk2_w "Pumpstromkorrekturfaktor in Abh‰ngigkeit der Keramiktemperatur der LSU, Bank 2" UWORD fak_uw_b2 1 100 0 1.99997 FORMAT "%8.6" ECU_ADDRESS 0x402E54 /end MEASUREMENT
/begin MEASUREMENT ktkvk_w "Pumpstromkorrekturfaktor in Abh‰ngigkeit der Keramiktemperatur der LSU" UWORD fak_uw_b2 1 100 0 1.99997 FORMAT "%8.6" ECU_ADDRESS 0x402E56 /end MEASUREMENT
/begin MEASUREMENT kusvk2_w "Korrekturwert der LSU-Spannung vor Kat Bank2" SWORD spg_q4p88Em4 1 100 -16 15.9995 FORMAT "%8.5" ECU_ADDRESS 0x3FE182 /end MEASUREMENT
/begin MEASUREMENT kusvkft2_w "Korrekturwert der LSU-Spannung vor Kat f¸r Fettkennlinie, Bank 2" SWORD spg_q4p88Em4 1 100 -16 15.9995 FORMAT "%8.5" ECU_ADDRESS 0x3FE184 /end MEASUREMENT
/begin MEASUREMENT kusvkft_w "Korrekturwert der LSU-Spannung vor Kat f¸r Fettkennlinie" SWORD spg_q4p88Em4 1 100 -16 15.9995 FORMAT "%8.5" ECU_ADDRESS 0x3FE186 /end MEASUREMENT
/begin MEASUREMENT kusvk_w "Korrekturwert der LSU-Spannung vor Kat" SWORD spg_q4p88Em4 1 100 -16 15.9995 FORMAT "%8.5" ECU_ADDRESS 0x3FE188 /end MEASUREMENT
/begin MEASUREMENT lsukorp2_w "Faktor f¸r Druckkorrektur LSU 2" UWORD fak_uw_b2 1 100 0 1.99997 FORMAT "%8.6" ECU_ADDRESS 0x402E32 /end MEASUREMENT
/begin MEASUREMENT lsukorp_w "Faktor f¸r Druckkorrektur LSU" UWORD fak_uw_b2 1 100 0 1.99997 FORMAT "%8.6" ECU_ADDRESS 0x402E34 /end MEASUREMENT
/begin MEASUREMENT manftmew "Monitor Anfangswert TMEW-Bildung" UBYTE temp_ub_q0p75_o48 1 100 -48 143.25 FORMAT "%5.1" ECU_ADDRESS 0x402E76 /end MEASUREMENT
/begin MEASUREMENT mifamx_w "maximales indiziertes Motormoment Fahrerwunsch im PWG-Notfahren" UWORD rel_uw_b100 1 100 0 99.9985 FORMAT "%8.5" ECU_ADDRESS 0x402E4A /end MEASUREMENT
/begin MEASUREMENT mll1 "Luftmassenfluﬂ bezogen auf lambda=1" UBYTE m_ub_b1020 1 100 0 1020 FORMAT "%5.0" ECU_ADDRESS 0x3FC3B0 /end MEASUREMENT
/begin MEASUREMENT msttmew "Monitor Steigung TMEW-Bildung" SBYTE temp_sb_b0p093 1 100 -0.09375 0.0930176 FORMAT "%7.5" ECU_ADDRESS 0x402E77 /end MEASUREMENT
/begin MEASUREMENT msttmewk "Monitor Steigung TMEW bei K¸hlanforderung" SBYTE temp_sb_b0p093 1 100 -0.09375 0.0930176 FORMAT "%7.5" ECU_ADDRESS 0x402E78 /end MEASUREMENT
/begin MEASUREMENT msttmrw "Monitor Steigung TMRW-Bildung" SBYTE temp_sb_b0p093 1 100 -0.09375 0.0930176 FORMAT "%7.5" ECU_ADDRESS 0x402E79 /end MEASUREMENT
/begin MEASUREMENT msttmrwk "Monitor Steigung TMRW bei K¸hlanforderung" SBYTE temp_sb_b0p093 1 100 -0.09375 0.0930176 FORMAT "%7.5" ECU_ADDRESS 0x402E7A /end MEASUREMENT
/begin MEASUREMENT nlindex "Flankenindex des Nockenwellensignals bei DG-Notlauf" UBYTE dez 1 100 0 255 FORMAT "%5.1" ECU_ADDRESS 0x403938 /end MEASUREMENT
/begin MEASUREMENT nturbc_temp "" UWORD nmot_q0p125 1 100 0 8191.88 FORMAT "%8.3" ECU_ADDRESS 0x4046B8 /end MEASUREMENT
/begin MEASUREMENT nwacedmast "Aktive Flanke der Masternockenwelle" UBYTE dez 1 100 0 255 FORMAT "%5.1" ECU_ADDRESS 0x403932 /end MEASUREMENT
/begin MEASUREMENT nwsolpos_w "Sollposition der folgenden NW-Flanke f¸r den DG-Notlauf" UWORD dez 1 100 0 65535 FORMAT "%8.2" ECU_ADDRESS 0x4046C8 /end MEASUREMENT
/begin MEASUREMENT o2vk2_w "O2- ‹berschuss bzw. _O2- Mangel der LSU 2 im Abgas bezogen auf Lambda = 1" SWORD relO2_q9p765Em4 1 100 -32 31.999 FORMAT "%8.5" ECU_ADDRESS 0x402E36 /end MEASUREMENT
/begin MEASUREMENT o2vk_w "O2- ‹berschuss bzw. _O2- Mangel der LSU im Abgas bezogen auf Lambda = 1" SWORD relO2_q9p765Em4 1 100 -32 31.999 FORMAT "%8.5" ECU_ADDRESS 0x402E38 /end MEASUREMENT
/begin MEASUREMENT palsu2_w "Absolutdruck Abgassystem 2" UWORD p_uw_q0p039 1 100 0 2559.96 FORMAT "%8.3" ECU_ADDRESS 0x402E3A /end MEASUREMENT
/begin MEASUREMENT palsu_w "Absolutdruck Abgassystem" UWORD p_uw_q0p039 1 100 0 2559.96 FORMAT "%8.3" ECU_ADDRESS 0x402E3C /end MEASUREMENT
/begin MEASUREMENT pg1limfr_w "Maximale Fr¸hposition der Nockenwellenflanke 0 von PG" SWORD kw_q0p1 1 100 -3276.8 3276.7 FORMAT "%8.3" ECU_ADDRESS 0x4046CA /end MEASUREMENT
/begin MEASUREMENT pg1limsp_w "Maximale Sp‰tposition der Nockenwellenflanke 0 von PG" SWORD kw_q0p1 1 100 -3276.8 3276.7 FORMAT "%8.3" ECU_ADDRESS 0x4046CC /end MEASUREMENT
/begin MEASUREMENT pg2limfr_w "Maximale Fr¸hposition der Nockenwellenflanke 0 von PG2" SWORD kw_q0p1 1 100 -3276.8 3276.7 FORMAT "%8.3" ECU_ADDRESS 0x4046CE /end MEASUREMENT
/begin MEASUREMENT pg2limsp_w "Maximale Sp‰tposition der Nockenwellenflanke 0 von PG2" SWORD kw_q0p1 1 100 -3276.8 3276.7 FORMAT "%8.3" ECU_ADDRESS 0x4046D0 /end MEASUREMENT
/begin MEASUREMENT pg3limfr_w "Maximale Fr¸hposition der Nockenwellenflanke 0 von PG3" SWORD kw_q0p1 1 100 -3276.8 3276.7 FORMAT "%8.3" ECU_ADDRESS 0x4046D2 /end MEASUREMENT
/begin MEASUREMENT pg3limsp_w "Maximale Sp‰tposition der Nockenwellenflanke 0 von PG3" SWORD kw_q0p1 1 100 -3276.8 3276.7 FORMAT "%8.3" ECU_ADDRESS 0x4046D4 /end MEASUREMENT
/begin MEASUREMENT pg4limfr_w "Maximale Fr¸hposition der Nockenwellenflanke 0 von PG4" SWORD kw_q0p1 1 100 -3276.8 3276.7 FORMAT "%8.3" ECU_ADDRESS 0x4046D6 /end MEASUREMENT
/begin MEASUREMENT pg4limsp_w "Maximale Sp‰tposition der Nockenwellenflanke 0 von PG4" SWORD kw_q0p1 1 100 -3276.8 3276.7 FORMAT "%8.3" ECU_ADDRESS 0x4046D8 /end MEASUREMENT
/begin MEASUREMENT phlsnh "normierte Heizleistung der Lambdasonde hinter Kat" UBYTE fak_ub_q0p01 1 100 0 2.55 FORMAT "%5.3" ECU_ADDRESS 0x402B3C /end MEASUREMENT
/begin MEASUREMENT phlsnh2 "normierte Heizleistung der Lambdasonde 2 hinter Kat" UBYTE fak_ub_q0p01 1 100 0 2.55 FORMAT "%5.3" ECU_ADDRESS 0x402B3D /end MEASUREMENT
/begin MEASUREMENT phlsuri2_w "unbegrenzte Heizleistungsanforderung, Bank 2" UWORD rel_uw_b200 1 100 0 199.997 FORMAT "%8.4" ECU_ADDRESS 0x402B4A /end MEASUREMENT
/begin MEASUREMENT phlsuri_w "unbegrenzte Heizleistungsanforderung" UWORD rel_uw_b200 1 100 0 199.997 FORMAT "%8.4" ECU_ADDRESS 0x402B4C /end MEASUREMENT
/begin MEASUREMENT prhlsub2_w "Relative Leistung f¸r Lambdasondenheizung zu Beginn der Aufheizphase, Bank 2" UWORD rel_uw_b200 1 100 0 199.997 FORMAT "%8.4" ECU_ADDRESS 0x402B4E /end MEASUREMENT
/begin MEASUREMENT prhlsub_w "Relative Leistung f¸r Lambdasondenheizung zu Beginn der Aufheizphase" UWORD rel_uw_b200 1 100 0 199.997 FORMAT "%8.4" ECU_ADDRESS 0x402B50 /end MEASUREMENT
/begin MEASUREMENT prhlsud2_w "D-Anteil der Stellgrˆﬂe des PID-Reglers aus %HRLSU, Bank 2" SWORD rel_sw_b100 1 100 -100 99.9969 FORMAT "%8.4" ECU_ADDRESS 0x402B52 /end MEASUREMENT
/begin MEASUREMENT prhlsud_w "D-Anteil der Stellgrˆﬂe des PID-Reglers aus %HRLSU" SWORD rel_sw_b100 1 100 -100 99.9969 FORMAT "%8.4" ECU_ADDRESS 0x402B54 /end MEASUREMENT
/begin MEASUREMENT prhlsui2_w "I-Anteil der Stellgrˆﬂe des PID-Reglers aus %HRLSU, Bank 2" SWORD rel_sw_b100 1 100 -100 99.9969 FORMAT "%8.4" ECU_ADDRESS 0x402B56 /end MEASUREMENT
/begin MEASUREMENT prhlsuin_w "Relative Initialisierungsheizleistung f¸r Lambdasondenheizung" SWORD rel_q0p0061 1 100 0 100 FORMAT "%8.4" ECU_ADDRESS 0x402B58 /end MEASUREMENT
/begin MEASUREMENT prhlsui_w "I-Anteil der Stellgrˆﬂe des PID-Reglers aus %HRLSU" SWORD rel_sw_b100 1 100 -100 99.9969 FORMAT "%8.4" ECU_ADDRESS 0x402B5A /end MEASUREMENT
/begin MEASUREMENT prhlsup2_w "P-Anteil der Stellgrˆﬂe des PID-Reglers aus %HRLSU, Bank 2" SWORD rel_sw_b100 1 100 -100 99.9969 FORMAT "%8.4" ECU_ADDRESS 0x402B5C /end MEASUREMENT
/begin MEASUREMENT prhlsup_w "P-Anteil der Stellgrˆﬂe des PID-Reglers aus %HRLSU" SWORD rel_sw_b100 1 100 -100 99.9969 FORMAT "%8.4" ECU_ADDRESS 0x402B5E /end MEASUREMENT
/begin MEASUREMENT prhlsur2_w "Relative Heizleistung f¸r Lambdasondenheizung w‰hrend der Regelphase, Bank 2" UWORD rel_uw_b200 1 100 0 199.997 FORMAT "%8.4" ECU_ADDRESS 0x402B60 /end MEASUREMENT
/begin MEASUREMENT prhlsur_w "Relative Heizleistung f¸r Lambdasondenheizung w‰hrend der Regelphase" UWORD rel_uw_b200 1 100 0 199.997 FORMAT "%8.4" ECU_ADDRESS 0x402B62 /end MEASUREMENT
/begin MEASUREMENT prhrlsu2_w "Relative Heizleistungsanforderung f¸r Lambdasondenheizung, Bank 2" UWORD rel_uw_b200 1 100 0 199.997 FORMAT "%8.4" ECU_ADDRESS 0x402B64 /end MEASUREMENT
/begin MEASUREMENT prhrlsu_w "Relative Heizleistungsanforderung f¸r Lambdasondenheizung" UWORD rel_uw_b200 1 100 0 199.997 FORMAT "%8.4" ECU_ADDRESS 0x402B66 /end MEASUREMENT
/begin MEASUREMENT qstartinf "Infomartionsbyte f¸r aktivierte Schnellstartmethoden" UBYTE dez 1 100 0 255 FORMAT "%5.1" ECU_ADDRESS 0x403939 /end MEASUREMENT
/begin MEASUREMENT rdtklsu2_w "Regeldifferenz der Temperaturregelung f¸r die LSU, Bank 2" SWORD temp_q0p0234 1 100 -768 767.977 FORMAT "%8.4" ECU_ADDRESS 0x402B68 /end MEASUREMENT
/begin MEASUREMENT rdtklsu_w "Regeldifferenz der Temperaturregelung f¸r die LSU" SWORD temp_q0p0234 1 100 -768 767.977 FORMAT "%8.4" ECU_ADDRESS 0x402B6A /end MEASUREMENT
/begin MEASUREMENT rinlsu2_w "Innenwiderstand der Nernstzelle der LSU, Bank 2" UWORD r_q0p0391 1 100 0 2559.96 FORMAT "%8.3" ECU_ADDRESS 0x402E58 /end MEASUREMENT
/begin MEASUREMENT rinlsuk2_w "Innenwiderstand der Nernstzelle der LSU 2, nicht gefiltert" UWORD r_q0p0391 1 100 0 2559.96 FORMAT "%8.3" ECU_ADDRESS 0x402E5A /end MEASUREMENT
/begin MEASUREMENT rinlsuk_w "Innenwiderstand der Nernstzelle der LSU, nicht gefiltert" UWORD r_q0p0391 1 100 0 2559.96 FORMAT "%8.3" ECU_ADDRESS 0x402E5C /end MEASUREMENT
/begin MEASUREMENT rinlsu_w "Innenwiderstand der Nernstzelle der LSU" UWORD r_q0p0391 1 100 0 2559.96 FORMAT "%8.3" ECU_ADDRESS 0x402E5E /end MEASUREMENT
/begin MEASUREMENT rk2_w "relative Kraftstoffmasse Bank2" UWORD rel_uw_b3072 1 100 0 3071.95 FORMAT "%8.3" ECU_ADDRESS 0x404050 /end MEASUREMENT
/begin MEASUREMENT rkkva2_w "relative Kraftstoffmasse (f¸r Kraftstoff-Verbrauchs-Anzeige Bank 2)" UWORD rel_uw_b3072 1 100 0 3071.95 FORMAT "%8.3" ECU_ADDRESS 0x404052 /end MEASUREMENT
/begin MEASUREMENT rkkva_w "relative Kraftstoffmasse (f¸r Kraftstoff-Verbrauchs-Anzeige Bank 1)" UWORD rel_uw_b3072 1 100 0 3071.95 FORMAT "%8.3" ECU_ADDRESS 0x404054 /end MEASUREMENT
/begin MEASUREMENT rk_w "Relative Kraftstoffmasse" UWORD rel_uw_b3072 1 100 0 3071.95 FORMAT "%8.3" ECU_ADDRESS 0x404056 /end MEASUREMENT
/begin MEASUREMENT rrinlsu2_w "Innenwiderstand der Nernstzelle der LSU 2, nicht korrigiert" UWORD r_q0p0391 1 100 0 2559.96 FORMAT "%8.3" ECU_ADDRESS 0x402E60 /end MEASUREMENT
/begin MEASUREMENT rrinlsu_w "Innenwiderstand der Nernstzelle der LSU, nicht korrigiert" UWORD r_q0p0391 1 100 0 2559.96 FORMAT "%8.3" ECU_ADDRESS 0x402E62 /end MEASUREMENT
/begin MEASUREMENT sync_level "Meldung Synchronisations-Level des HWT" UBYTE dez 1 100 0 255 FORMAT "%5.1" ECU_ADDRESS 0x40393A /end MEASUREMENT
/begin MEASUREMENT synid "Synchronisationsindex des Nockenwellensignals bei DG-Notlauf" UBYTE dez 1 100 0 255 FORMAT "%5.1" ECU_ADDRESS 0x40393B /end MEASUREMENT
/begin MEASUREMENT SYN_st "" UBYTE dez 1 100 0 255 FORMAT "%5.1" ECU_ADDRESS 0x402F52 /end MEASUREMENT
/begin MEASUREMENT tamax "maximal aufgetretene Ansauglufttemperatur" UBYTE temp_ub_q0p75_o48 1 100 -48 143.25 FORMAT "%5.1" ECU_ADDRESS 0x402E6B /end MEASUREMENT
/begin MEASUREMENT tamin "minimal aufgetretene Ansauglauftemperatur" UBYTE temp_ub_q0p75_o48 1 100 -48 143.25 FORMAT "%5.1" ECU_ADDRESS 0x402E6C /end MEASUREMENT
/begin MEASUREMENT tamlfori_w "L¸fteransteuerung ungefiltert" UWORD rel_uw_b100 1 100 0 99.9985 FORMAT "%8.5" ECU_ADDRESS 0x402E8E /end MEASUREMENT
/begin MEASUREMENT tans "Ansaugluft - Temperatur" UBYTE temp_ub_q0p75_o48 1 100 -48 143.25 FORMAT "%5.1" ECU_ADDRESS 0x403BE8 /end MEASUREMENT
/begin MEASUREMENT tansab "Ansauglufttemperatur beim Abstellen" UBYTE temp_ub_q0p75_o48 1 100 -48 143.25 FORMAT "%5.1" ECU_ADDRESS 0x3FE190 /end MEASUREMENT
/begin MEASUREMENT tansabk_w "Ansauglufttemperatur beim Abstellen intern in Kelvin" UWORD temp_q0p0234_o273 1 100 -273.15 1262.83 FORMAT "%8.3" ECU_ADDRESS 0x3FE192 /end MEASUREMENT
/begin MEASUREMENT tansk_w "Ansaugluft - Temperatur in GrdC,  intern in Kelvin gerechnet" UWORD temp_q0p0234_o273 1 100 -273.15 1262.83 FORMAT "%8.3" ECU_ADDRESS 0x402E70 /end MEASUREMENT
/begin MEASUREMENT tanslin "Ansauglufttemperatur, linearisiert und umgerechnet" UBYTE temp_ub_q0p75_o48 1 100 -48 143.25 FORMAT "%5.1" ECU_ADDRESS 0x3FE198 /end MEASUREMENT
/begin MEASUREMENT tdlrtm_w "Diagnosezeit f¸r ‹berschreitung Motortemperaturschwelle f¸r Lambda-Regelung" UWORD t100msxs_uw_b6553p5 1 100 0 6553.5 FORMAT "%8.3" ECU_ADDRESS 0x402E90 /end MEASUREMENT
/begin MEASUREMENT thhaist "Auszeit f¸r Sondenheizung hinter Kat" UBYTE t10msxs_ub_b2p55 1 100 0 2.55 FORMAT "%5.3" ECU_ADDRESS 0x402B3E /end MEASUREMENT
/begin MEASUREMENT thhaist2 "Auszeit f¸r Sondenheizung2 hinter Kat" UBYTE t10msxs_ub_b2p55 1 100 0 2.55 FORMAT "%5.3" ECU_ADDRESS 0x402B3F /end MEASUREMENT
/begin MEASUREMENT thhat "unkorrigierte Ausschaltzeit der Sondenheizung hinter Kat" UBYTE t10msxs_q0p01_o0p05 1 100 -0.05 2.5 FORMAT "%5.3" ECU_ADDRESS 0x402B40 /end MEASUREMENT
/begin MEASUREMENT thhat2 "unkorrigierte Ausschaltzeit der Sondenheizung 2 hinter Kat" UBYTE t10msxs_q0p01_o0p05 1 100 -0.05 2.5 FORMAT "%5.3" ECU_ADDRESS 0x402B41 /end MEASUREMENT
/begin MEASUREMENT tka "Temperatur Motork¸hlerausgang (K¸hlmittel)" UBYTE temp_ub_q0p75_o48 1 100 -48 143.25 FORMAT "%5.1" ECU_ADDRESS 0x402EA3 /end MEASUREMENT
/begin MEASUREMENT tkaab "TKA-Abstell-Temperatur" UBYTE temp_ub_q0p75_o48 1 100 -48 143.25 FORMAT "%5.1" ECU_ADDRESS 0x3FE19D /end MEASUREMENT
/begin MEASUREMENT tkalin "Temperatur K¸hlerausgang linearisiert und umgerechnet" UBYTE temp_ub_q0p75_o48 1 100 -48 143.25 FORMAT "%5.1" ECU_ADDRESS 0x402EA4 /end MEASUREMENT
/begin MEASUREMENT tkalinmn "minimale Temperatur Motork¸hlerausgang (K¸hlmittel) im Fahrzyklus" UBYTE temp_ub_q0p75_o48 1 100 -48 143.25 FORMAT "%5.1" ECU_ADDRESS 0x402EA5 /end MEASUREMENT
/begin MEASUREMENT tkalinmx "maximale Temperatur Motork¸hlerausgang (K¸hlmittel) im Fahrzyklus" UBYTE temp_ub_q0p75_o48 1 100 -48 143.25 FORMAT "%5.1" ECU_ADDRESS 0x402EA6 /end MEASUREMENT
/begin MEASUREMENT tkerlsu2_w "Keramiktemperatur der LSU, Bank 2" UWORD temp_q0p0234_o273 1 100 -273.15 1262.83 FORMAT "%8.3" ECU_ADDRESS 0x402E64 /end MEASUREMENT
/begin MEASUREMENT tkerlsu_w "Keramiktemperatur der LSU" UWORD temp_q0p0234_o273 1 100 -273.15 1262.83 FORMAT "%8.3" ECU_ADDRESS 0x402E66 /end MEASUREMENT
/begin MEASUREMENT tmew "Motortemperatur-Ersatzwert aus Modell" UBYTE temp_ub_q0p75_o48 1 100 -48 143.25 FORMAT "%5.1" ECU_ADDRESS 0x402E7B /end MEASUREMENT
/begin MEASUREMENT tmewab "Motortemperatur-Ersatzwert aus Modell beim Abstellen" UBYTE temp_ub_q0p75_o48 1 100 -48 143.25 FORMAT "%5.1" ECU_ADDRESS 0x3FE199 /end MEASUREMENT
/begin MEASUREMENT tmot "Motor-Temperatur" UBYTE temp_ub_q0p75_o48 1 100 -48 143.25 FORMAT "%5.1" ECU_ADDRESS 0x403BED /end MEASUREMENT
/begin MEASUREMENT tmotab "Motortemperatur beim Abstellen" UBYTE temp_ub_q0p75_o48 1 100 -48 143.25 FORMAT "%5.1" ECU_ADDRESS 0x3FE19A /end MEASUREMENT
/begin MEASUREMENT tmotlin "Motortemperatur, linearisiert und umgerechnet" UBYTE temp_ub_q0p75_o48 1 100 -48 143.25 FORMAT "%5.1" ECU_ADDRESS 0x402E7C /end MEASUREMENT
/begin MEASUREMENT tmotlinmn "minimal aufgetretene Motortemperatur-Meﬂwert" UBYTE temp_ub_q0p75_o48 1 100 -48 143.25 FORMAT "%5.1" ECU_ADDRESS 0x402E7D /end MEASUREMENT
/begin MEASUREMENT tmotlinmx "maximal aufgetretene Motortemperatur-Meﬂwert" UBYTE temp_ub_q0p75_o48 1 100 -48 143.25 FORMAT "%5.1" ECU_ADDRESS 0x402E7E /end MEASUREMENT
/begin MEASUREMENT tmotlinst "gemessene Motortemperatur im Start, linearisiert und umgerechnet" UBYTE temp_ub_q0p75_o48 1 100 -48 143.25 FORMAT "%5.1" ECU_ADDRESS 0x402E7F /end MEASUREMENT
/begin MEASUREMENT tmotlin_w "Motortemperatur, linearisiert und umgerechnet, 16Bit-Wort" UWORD temp_uw_q0p0029_o48 1 100 -48 143.997 FORMAT "%8.4" ECU_ADDRESS 0x402E92 /end MEASUREMENT
/begin MEASUREMENT tmotnt "Motortemperatur nach Tiefpaﬂfilter" UBYTE temp_ub_q0p75_o48 1 100 -48 143.25 FORMAT "%5.1" ECU_ADDRESS 0x402E80 /end MEASUREMENT
/begin MEASUREMENT tmotstdh "Motortemperatur mit Standheizungseinfluss" UBYTE temp_ub_q0p75_o48 1 100 -48 143.25 FORMAT "%5.1" ECU_ADDRESS 0x402E81 /end MEASUREMENT
/begin MEASUREMENT tmotvt "Motortemperatur vor Tiefpaﬂfilter" UBYTE temp_ub_q0p75_o48 1 100 -48 143.25 FORMAT "%5.1" ECU_ADDRESS 0x402E82 /end MEASUREMENT
/begin MEASUREMENT tmrw "Motortemperatur-Referenzwert aus Modell" UBYTE temp_ub_q0p75_o48 1 100 -48 143.25 FORMAT "%5.1" ECU_ADDRESS 0x402E83 /end MEASUREMENT
/begin MEASUREMENT tmrwend "Endwert f¸r Referenzwert Motortemperatur-Modell" UBYTE temp_ub_q0p75_o48 1 100 -48 143.25 FORMAT "%5.1" ECU_ADDRESS 0x402E84 /end MEASUREMENT
/begin MEASUREMENT tmrwktof_w "Haltezeit beim Abschalten Thermostatregelung" UWORD t_q0p1 1 100 0 6553.5 FORMAT "%8.3" ECU_ADDRESS 0x402E94 /end MEASUREMENT
/begin MEASUREMENT tmrwkton "Totzeit K¸hlwasserdurchlauf bei gergeltem Thermostat f¸r Referenzwertberechnung" UBYTE t_q0p1 1 100 0 25.5 FORMAT "%5.2" ECU_ADDRESS 0x402E85 /end MEASUREMENT
/begin MEASUREMENT tmrwp_w "gefilterte Thermostatansteuerung" SWORD fak_q0p1 1 100 -3276.8 3276.7 FORMAT "%8.3" ECU_ADDRESS 0x402E96 /end MEASUREMENT
/begin MEASUREMENT tmrwt_w "L¸fteransteuerung gefiltert" UWORD rel_uw_b100 1 100 0 99.9985 FORMAT "%8.5" ECU_ADDRESS 0x402E98 /end MEASUREMENT
/begin MEASUREMENT tmst "Motorstarttemperatur" UBYTE temp_ub_q0p75_o48 1 100 -48 143.25 FORMAT "%5.1" ECU_ADDRESS 0x402E86 /end MEASUREMENT
/begin MEASUREMENT tnphslin_w "Zahnzeit f¸r Zahngenerierung im Notlauf mit linearer Extrapolation" UWORD t_q0p001_ms 1 100 0 65.535 FORMAT "%8.5" ECU_ADDRESS 0x4046DA /end MEASUREMENT
/begin MEASUREMENT tnwia2_l "Zeit eines Systemtimers bei Eintreffen einer genutzten Ph.-flanke (Auslaﬂ,Bank2)" ULONG t_q1p024_ms 1 100 0 4.39805e+009 FORMAT "%13.2" ECU_ADDRESS 0x404A94 /end MEASUREMENT
/begin MEASUREMENT tnwia_l "Zeit eines Systemtimers bei Eintreffen einer genutzten Ph.-flanke (Auslaﬂ)" ULONG t_q1p024_ms 1 100 0 4.39805e+009 FORMAT "%13.2" ECU_ADDRESS 0x404A98 /end MEASUREMENT
/begin MEASUREMENT tnwie2_l "Zeit eines Systemtimers bei Eintreffen einer genutzten Ph.-flanke (Einlaﬂ,Bank2)" ULONG t_q1p024_ms 1 100 0 4.39805e+009 FORMAT "%13.2" ECU_ADDRESS 0x404A9C /end MEASUREMENT
/begin MEASUREMENT tnwie_l "Zeit eines Systemtimers bei Eintreffen einer genutzten Phasenflanke" ULONG t_q1p024_ms 1 100 0 4.39805e+009 FORMAT "%13.2" ECU_ADDRESS 0x404AA0 /end MEASUREMENT
/begin MEASUREMENT trsecstdh_l "" ULONG t1sxs_q1 1 100 0 4.29497e+009 FORMAT "%13.2" ECU_ADDRESS 0x3FE194 /end MEASUREMENT
/begin MEASUREMENT tsegph_l "Periodendauer eines Phasensegments" ULONG t_q0p001_ms 1 100 0 4.29497e+006 FORMAT "%13.5" ECU_ADDRESS 0x404AB4 /end MEASUREMENT
/begin MEASUREMENT tseg_l "Winkel-Segmentzeit" ULONG t_q0p0001_ms 1 100 0 429497 FORMAT "%13.6" ECU_ADDRESS 0x404AB8 /end MEASUREMENT
/begin MEASUREMENT tsg "Steuerger‰tetemperatur" UBYTE temp_ub_q0p75_o48 1 100 -48 143.25 FORMAT "%5.1" ECU_ADDRESS 0x402EA7 /end MEASUREMENT
/begin MEASUREMENT ttmtkasc "Timer Motordrehzahl grˆsser Schwelle f¸r TKA-Stuckcheck" UWORD t_q0p1 1 100 0 6553.5 FORMAT "%8.3" ECU_ADDRESS 0x402E9E /end MEASUREMENT
/begin MEASUREMENT ttwbklhon "Aufsummierte Zeit im Bereich K¸hlleistung hoch" UBYTE t_q0p1 1 100 0 25.5 FORMAT "%5.2" ECU_ADDRESS 0x402E87 /end MEASUREMENT
/begin MEASUREMENT ttwbklnon "Aufsummierte Zeit im Bereich K¸hlleistung niedrig" UBYTE t_q0p1 1 100 0 25.5 FORMAT "%5.2" ECU_ADDRESS 0x402E88 /end MEASUREMENT
/begin MEASUREMENT tum "Umgebungstemperatur" UBYTE temp_ub_q0p75_o48 1 100 -48 143.25 FORMAT "%5.1" ECU_ADDRESS 0x402E89 /end MEASUREMENT
/begin MEASUREMENT tumg "Umgebungstemperatur" UBYTE temp_ub_q0p75_o48 1 100 -48 143.25 FORMAT "%5.1" ECU_ADDRESS 0x402E9C /end MEASUREMENT
/begin MEASUREMENT tumgabst "Umgebungstemperatur beim Abstellen" SBYTE temp_q1 1 100 -128 127 FORMAT "%5.1" ECU_ADDRESS 0x3FE19B /end MEASUREMENT
/begin MEASUREMENT tumgmst "Umgebungstemperatur beim Motorstart" SBYTE temp_q1 1 100 -128 127 FORMAT "%5.1" ECU_ADDRESS 0x402E9D /end MEASUREMENT
/begin MEASUREMENT tumgta "Umgebungstemperatur aus Ansauglufttemperatur" UBYTE temp_ub_q0p75_o48 1 100 -48 143.25 FORMAT "%5.1" ECU_ADDRESS 0x3FE19C /end MEASUREMENT
/begin MEASUREMENT ua10mo2_w "Offset korrigierte Sondenspannung vor Kat einer Breitbandlambdasonde Bank 2" UWORD spg_q4p88Em4 1 100 0 31.9995 FORMAT "%8.5" ECU_ADDRESS 0x402E3E /end MEASUREMENT
/begin MEASUREMENT ua10mo_w "Offset korrigierte Sondenspannung vor Kat einer Breitbandlambdasonde" UWORD spg_q4p88Em4 1 100 0 31.9995 FORMAT "%8.5" ECU_ADDRESS 0x402E40 /end MEASUREMENT
/begin MEASUREMENT ua10ms2_w "Sondenspannung vor Kat einer Breitbandlambdasonde Bank2 (Mittelwert ¸ber 10ms)" UWORD spg_q4p88Em4 1 100 0 31.9995 FORMAT "%8.5" ECU_ADDRESS 0x402E42 /end MEASUREMENT
/begin MEASUREMENT ua10msm2_w "Sondenspannung vor Kat einer Breitbandlambdasonde Bank2 (Mittelwert ¸ber 10ms)" UWORD spg_q4p88Em4 1 100 0 31.9995 FORMAT "%8.5" ECU_ADDRESS 0x404674 /end MEASUREMENT
/begin MEASUREMENT ua10msm_w "Sondenspannung vor Kat einer Breitbandlambdasonde (Mittelwert ¸ber 10ms)" UWORD spg_q4p88Em4 1 100 0 31.9995 FORMAT "%8.5" ECU_ADDRESS 0x404676 /end MEASUREMENT
/begin MEASUREMENT ua10ms_w "Sondenspannung vor Kat einer Breitbandlambdasonde (Mittelwert ¸ber 10ms)" UWORD spg_q4p88Em4 1 100 0 31.9995 FORMAT "%8.5" ECU_ADDRESS 0x402E44 /end MEASUREMENT
/begin MEASUREMENT ub "Batteriespannung" UBYTE spg_ubatt 1 100 0 24.021 FORMAT "%5.2" ECU_ADDRESS 0x403BEE /end MEASUREMENT
/begin MEASUREMENT ubsq "Bordnetzspannung, umgerechnet in Standard-Quantisierung" UBYTE spg_q0p1 1 100 0 25.5 FORMAT "%5.2" ECU_ADDRESS 0x403BEF /end MEASUREMENT
/begin MEASUREMENT ubsqf "Bordnetzspannung, umgerechnet in Standard-Quantisierung und gefiltert" UBYTE spg_q0p1 1 100 0 25.5 FORMAT "%5.2" ECU_ADDRESS 0x403BF0 /end MEASUREMENT
/begin MEASUREMENT ubsqf_w "Bordnetzspannung, umgerechnet in Standard-Quantisierung und gefiltert" UWORD spg_q0p00039 1 100 0 25.5996 FORMAT "%8.5" ECU_ADDRESS 0x404096 /end MEASUREMENT
/begin MEASUREMENT ubsq_w "Bordnetzspannung, umgerechnet in Standard-Quantisierung" UWORD spg_q0p00039 1 100 0 25.5996 FORMAT "%8.5" ECU_ADDRESS 0x404098 /end MEASUREMENT
/begin MEASUREMENT ub_w "Batteriespannung" UWORD spg_ubatt 1 100 0 6173.4 FORMAT "%8.3" ECU_ADDRESS 0x40409A /end MEASUREMENT
/begin MEASUREMENT upw2ll_w "Spannungswert von PWG-Poti 2 vor der Bewegung" UWORD spg_uw_q0p00488 1 100 0 319.995 FORMAT "%8.4" ECU_ADDRESS 0x3FE18A /end MEASUREMENT
/begin MEASUREMENT upwg2d_w "Verdoppelte PWG-Poti-2-Spannung (Word)" UWORD spg_uw_q0p00488 1 100 0 319.995 FORMAT "%8.4" ECU_ADDRESS 0x404088 /end MEASUREMENT
/begin MEASUREMENT upwg2fil_w "Gefilterte Poti 2 Spannung" UWORD spg_uw_q0p00488 1 100 0 319.995 FORMAT "%8.4" ECU_ADDRESS 0x40408A /end MEASUREMENT
/begin MEASUREMENT upwgej_w "Entjitterte PWG-Poti-Spannung" UWORD spg_uw_q0p00488 1 100 0 319.995 FORMAT "%8.4" ECU_ADDRESS 0x40408C /end MEASUREMENT
/begin MEASUREMENT upwg_w "Resultierende PWG-Poti-Spannung nach Plausibilit‰tspr¸fung" UWORD spg_uw_q0p00488 1 100 0 319.995 FORMAT "%8.4" ECU_ADDRESS 0x40408E /end MEASUREMENT
/begin MEASUREMENT usvkvj2_w "Sondenspannung vor Kat einer Breitbandlambdasonde Bank2 f¸r Scan Tool" UWORD spg_q1p22Em4 1 100 0 7.99988 FORMAT "%8.6" ECU_ADDRESS 0x402E46 /end MEASUREMENT
/begin MEASUREMENT usvkvj_w "Sondenspannung vor Kat einer Breitbandlambdasonde f¸r Scan Tool" UWORD spg_q1p22Em4 1 100 0 7.99988 FORMAT "%8.6" ECU_ADDRESS 0x402E48 /end MEASUREMENT
/begin MEASUREMENT vers_temp "" UWORD vfzg_uw_b512 1 100 0 511.992 FORMAT "%8.4" ECU_ADDRESS 0x4046BA /end MEASUREMENT
/begin MEASUREMENT vers_temp2 "" UWORD vfzg_uw_b512 1 100 0 511.992 FORMAT "%8.4" ECU_ADDRESS 0x4046BC /end MEASUREMENT
/begin MEASUREMENT vfil_w "gefilterte Geschwindigkeit (16-Bit)" UWORD vfzg_uw_b512 1 100 0 511.992 FORMAT "%8.4" ECU_ADDRESS 0x4046BE /end MEASUREMENT
/begin MEASUREMENT vfzg "Fahrzeuggeschwindigkeit" UBYTE vfzg_ub_q1p25 1 100 0 318.75 FORMAT "%5.1" ECU_ADDRESS 0x40392D /end MEASUREMENT
/begin MEASUREMENT vfzgers_w "Fahrzeuggeschwindigkeit Ersatzwert" UWORD vfzg_uw_b512 1 100 0 511.992 FORMAT "%8.4" ECU_ADDRESS 0x4046C0 /end MEASUREMENT
/begin MEASUREMENT vfzg_w "Fahrzeuggeschwindigkeit" UWORD vfzg_uw_b512 1 100 0 511.992 FORMAT "%8.4" ECU_ADDRESS 0x4046C2 /end MEASUREMENT
/begin MEASUREMENT vfzroh_w "Fahrzeuggeschwindigkeit Ausgabewert an SCAN-Tool" UWORD vfzg_uw_b512 1 100 0 511.992 FORMAT "%8.4" ECU_ADDRESS 0x4046C4 /end MEASUREMENT
/begin MEASUREMENT wkwalest_w "Startwinkel aus Motor-Abstellposition berechnet" UWORD kw_q0p1 1 100 0 6553.5 FORMAT "%8.3" ECU_ADDRESS 0x4046EC /end MEASUREMENT
/begin MEASUREMENT wkwas_w "Winkel Kurbelwelle im Arbeitsspiel" UWORD kw_q0p1 1 100 0 6553.5 FORMAT "%8.3" ECU_ADDRESS 0x4046EE /end MEASUREMENT
/begin MEASUREMENT wnwkwa2_w "Winkel der Auslaﬂ-NW-Flanken von Bank 2 relativ zur Kurbelwelle" UWORD kw_q0p1 1 100 0 6553.5 FORMAT "%8.3" ECU_ADDRESS 0x4046DC /end MEASUREMENT
/begin MEASUREMENT wnwkwa_w "Winkel der Auslaﬂ-NW-Flanken relativ zur Kurbelwelle" UWORD kw_q0p1 1 100 0 6553.5 FORMAT "%8.3" ECU_ADDRESS 0x4046DE /end MEASUREMENT
/begin MEASUREMENT wnwkwe2_w "Winkel der Einlaﬂ-NW-Flanken von Bank 2relativ zur Kurbelwelle" UWORD kw_q0p1 1 100 0 6553.5 FORMAT "%8.3" ECU_ADDRESS 0x4046E0 /end MEASUREMENT
/begin MEASUREMENT wnwkwe_w "Winkel der Einlaﬂ-NW-Flanken relativ zur Kurbelwelle" UWORD kw_q0p1 1 100 0 6553.5 FORMAT "%8.3" ECU_ADDRESS 0x4046E2 /end MEASUREMENT
/begin MEASUREMENT wped "Normierter Fahrpedalwinkel" UBYTE relPED_ub_b100 1 100 0 100 FORMAT "%5.1" ECU_ADDRESS 0x403BE7 /end MEASUREMENT
/begin MEASUREMENT wpedt_w "Pedalwert (tempor‰r) bei 2 ME-Steuerger‰ten" UWORD relPED_uw_b100 1 100 0 100 FORMAT "%8.4" ECU_ADDRESS 0x404090 /end MEASUREMENT
/begin MEASUREMENT wpedv_w "Normierter Fahrpedalwinkel vor Ber¸cksichtigung der Begrenzungen im Notfahren" UWORD relPED_uw_b100 1 100 0 100 FORMAT "%8.4" ECU_ADDRESS 0x404092 /end MEASUREMENT
/begin MEASUREMENT wped_w "normierter Fahrpedalwinkel" UWORD relPED_uw_b100 1 100 0 100 FORMAT "%8.4" ECU_ADDRESS 0x404094 /end MEASUREMENT
/begin MEASUREMENT zfzptafx "Z‰hlerstand Fahrzyklen f¸r Check Ansauglufttemperatursignal TANS fixiert" UBYTE dez 1 100 0 255 FORMAT "%5.1" ECU_ADDRESS 0x402E6D /end MEASUREMENT
/begin MEASUREMENT zllptafx "Z‰hlerstand Lerrlaufzyklen f¸r Check Ansauglufttemperatursignal TANS fixiert" UBYTE dez 1 100 0 255 FORMAT "%5.1" ECU_ADDRESS 0x402E6E /end MEASUREMENT
/begin MEASUREMENT zphfl "Z‰hler ‰quidistante Phasenflanken" SBYTE dez 1 100 -128 127 FORMAT "%5.1" ECU_ADDRESS 0x403933 /end MEASUREMENT
/begin MEASUREMENT zphfl2 "Z‰hler ‰quidistante Phasenflanken 2" SBYTE dez 1 100 -128 127 FORMAT "%5.1" ECU_ADDRESS 0x403934 /end MEASUREMENT
/begin MEASUREMENT zphfl2ct_w "Z‰hler f¸r Fehler bei zphfl2 Bestimmung" UWORD dez 1 100 0 65535 FORMAT "%8.2" ECU_ADDRESS 0x4046E4 /end MEASUREMENT
/begin MEASUREMENT zphfl3 "Z‰hler ‰quidistante Phasenflanken 3" SBYTE dez 1 100 -128 127 FORMAT "%5.1" ECU_ADDRESS 0x403935 /end MEASUREMENT
/begin MEASUREMENT zphfl3ct_w "Z‰hler f¸r Fehler bei zphfl3 Bestimmung" UWORD dez 1 100 0 65535 FORMAT "%8.2" ECU_ADDRESS 0x4046E6 /end MEASUREMENT
/begin MEASUREMENT zphfl4 "Z‰hler ‰quidistante Phasenflanken 4" SBYTE dez 1 100 -128 127 FORMAT "%5.1" ECU_ADDRESS 0x403936 /end MEASUREMENT
/begin MEASUREMENT zphfl4ct_w "Z‰hler f¸r Fehler bei zphfl4 Bestimmung" UWORD dez 1 100 0 65535 FORMAT "%8.2" ECU_ADDRESS 0x4046E8 /end MEASUREMENT
/begin MEASUREMENT zphflct_w "Z‰hler f¸r Fehler bei zphfl Bestimmung" UWORD dez 1 100 0 65535 FORMAT "%8.2" ECU_ADDRESS 0x4046EA /end MEASUREMENT
/begin MEASUREMENT zrph2_l "Z‰hler Raster Phasensignal 2" ULONG dez 1 100 0 4.29497e+009 FORMAT "%13.2" ECU_ADDRESS 0x404AA4 /end MEASUREMENT
/begin MEASUREMENT zrph3_l "Z‰hler Raster Phasensignal 3" ULONG dez 1 100 0 4.29497e+009 FORMAT "%13.2" ECU_ADDRESS 0x404AA8 /end MEASUREMENT
/begin MEASUREMENT zrph4_l "Z‰hler Raster Phasensignal 4" ULONG dez 1 100 0 4.29497e+009 FORMAT "%13.2" ECU_ADDRESS 0x404AAC /end MEASUREMENT
/begin MEASUREMENT zrph_l "Z‰hler Raster Phasensignal" ULONG dez 1 100 0 4.29497e+009 FORMAT "%13.2" ECU_ADDRESS 0x404AB0 /end MEASUREMENT
/begin MEASUREMENT zzkwas_w "Zahnz‰hler Kurbelwelle im Arbeitsspiel" UWORD dez 1 100 0 65535 FORMAT "%8.2" ECU_ADDRESS 0x4046F0 /end MEASUREMENT
/begin MEASUREMENT zzvirt "virtueller Zahnz‰hler im Start bis zur Synchronisation" UBYTE dez 1 100 0 255 FORMAT "%5.1" ECU_ADDRESS 0x40393C /end MEASUREMENT
/begin MEASUREMENT zzyl "SW-Zylinderz‰hler" UBYTE dez 1 100 0 255 FORMAT "%5.1" ECU_ADDRESS 0x40393D /end MEASUREMENT
/begin FUNCTION GGO2LSU "1.50      Gebergrˆﬂe Sauerstoffsignal LSU"
 /begin DEF_CHARACTERISTIC CWGGLSU FIPLSU FIPREFLSU FLAMPFT FLAMPMR FLSUFTKL O2VK TABGL TABGS TUMTOE TVABGL USABGL ZFDUSVK ZFUULSU /end DEF_CHARACTERISTIC
 /begin IN_MEASUREMENT B_eiclsu B_eiclsu2 B_elsuwi B_elsuwi2 B_fklsol B_fklsol2 B_llr B_st B_stend iprefanf iprefanf2 ktkvk2_w ktkvk_w pabnav2_w pabnav_w pabvvk2_w pabvvk_w tnst_w uulsuv2_w uulsuv_w /end IN_MEASUREMENT
 /begin OUT_MEASUREMENT B_fklanf B_fklanf2 B_iclsabg B_iclsabg2 dua10g2_w dua10g_w ggo2lsuAusBits10ms ggo2lsuAusBits10ms_2 iplsuvj2_w iplsuvj_w kusvk2_w kusvkft2_w kusvkft_w kusvk_w lsukorp2_w lsukorp_w o2vk2_w o2vk_w palsu2_w palsu_w ua10mo2_w ua10mo_w ua10ms2_w ua10ms_w usvkvj2_w usvkvj_w /end OUT_MEASUREMENT
 /begin LOC_MEASUREMENT B_fklanfs B_resabg B_resabg2 B_tabgs ggo2lsuLokBits10ms ipiprk2_w ipiprk_w ipkorp2_w ipkorp_w ipktk2_w ipktk_w iproh2_w iproh_w ua10msm2_w ua10msm_w /end LOC_MEASUREMENT
/end FUNCTION
/begin FUNCTION GGPED "12.40     Gebergrˆﬂe Fahrpedal"
 /begin DEF_CHARACTERISTIC CWBWEEN DUPW12 DUPW12BE DUPW12TG DUPW12VG DUPWGHY DWPMXNB DWPMXNOT DWPOPBP DWPPBP MIFAMXNOT NWPMBBR TDWPOPBP TFPWG2 TMBVH TPNSE1 TUPWBWV TUPWG12 TUPWG1O TUPWG1U TUPWG2O TUPWG2U TUPWLLU TWPLK TWPMBBR UPW1BE UPW1LLMX UPWG12U UPWG1O UPWG1U UPWG2O UPWG2U UPWGO UPWGTG UPWGU UPWGUBF UPWGUR UPWGVG VWPMBBR WPMXBR WPMXNOT WPRMBVH ZBWF /end DEF_CHARACTERISTIC
 /begin IN_MEASUREMENT B_bkva B_bkvv B_bl B_br B_br2k B_brems B_dknot B_dksbeg B_fabr B_nmax B_pwf B_pwgnotum B_stend B_ubpvg nmot upwg1_w upwg2_w vfzg /end IN_MEASUREMENT
 /begin OUT_MEASUREMENT B_pwgnotfr B_upwbwf dwped dwped_w mifamx_w wped wped_w /end OUT_MEASUREMENT
 /begin LOC_MEASUREMENT B_bwf B_bwunpl B_dupw12 B_glf B_mbvh B_pbpabr B_pwgbwf B_pwglk B_sp1s B_sp2s B_spsmin B_up2bwf B_upw12e B_upw1mn B_upw1mx B_upw2mn B_upw2mx B_upwg1o B_upwg1u B_upwg2o B_upwg2u B_vpwgerr B_wpabnb B_wpmbbr ctrbwf GGPEDlokbits GGPEDlokbits2 upw2ll_w upwg2d_w upwg2fil_w upwgej_w upwg_w wpedt_w wpedv_w /end LOC_MEASUREMENT
/end FUNCTION
/begin FUNCTION GGRTLSU "1.100     Gebergrˆﬂe Widerstand und Temperatur der LSU"
 /begin DEF_CHARACTERISTIC DURINLSU FARIN KLKTKVK KLRTLSU RINCAL RININI TKERENSCUN TKERLSPSF TRINSTART TUMTO TVSABGL URINOFF ZFRIN ZFRINCAL ZFRINSTART /end DEF_CHARACTERISTIC
 /begin REF_CHARACTERISTIC TVSERSL /end REF_CHARACTERISTIC
 /begin IN_MEASUREMENT B_ehsve B_ehsve2 B_eiclsu B_eiclsu2 B_elsuwi B_elsuwi2 B_henrin B_henrin2 B_iclsabg B_iclsabg2 B_lsuiamn B_lsuiamn2 B_lsuiamx B_lsuiamx2 B_lsuunmn B_lsuunmn2 B_lsuunmx B_lsuunmx2 B_lsuvmmn B_lsuvmmn2 B_lsuvmmx B_lsuvmmx2 B_nmot B_pwf B_spf3k B_spf3k2 B_stend rdtklsu2_w rdtklsu_w ubsq_w urinlsu2_w urinlsu_w /end IN_MEASUREMENT
 /begin OUT_MEASUREMENT B_enscun B_enscun2 B_pusab B_pusab2 B_rinabg B_rinabg2 ggrtlsuAusBits10ms krivk2_w krivk_w ktkvk2_w ktkvk_w rinlsu2_w rinlsu_w tkerlsu2_w tkerlsu_w /end OUT_MEASUREMENT
 /begin LOC_MEASUREMENT B_ckrivk B_ckrivk2 drinlsu2_w drinlsu_w ggrtlsuLokBits10ms rinlsuk2_w rinlsuk_w rrinlsu2_w rrinlsu_w /end LOC_MEASUREMENT
/end FUNCTION
/begin FUNCTION GGTFA "28.10     Gebergrˆﬂe TFA Temperaturf¸hler Ansaugluft"
 /begin DEF_CHARACTERISTIC AFZPTAFX ALLPTAFX DTAFIX DTMABSDTA DTMPTA MLDTAMN MLDTAMX MLPTAFXO MLPTAFXU TADE TADMN TADMX TADPLMX TANSELI TDFZTAFX TDLLTAFX TDNSTA TDPLTAO TDTA TDTAL TDTAPL TDVTAPL TMABDTAMN TMPTAFXU TMSDTAO TMSDTAU TMSPTAFX TTANSFIX TTAPLC VPTAFXO VPTAFXU VTAPLC ZFTANS /end DEF_CHARACTERISTIC
 /begin REF_CHARACTERISTIC TNSRT /end REF_CHARACTERISTIC
 /begin IN_MEASUREMENT B_ll B_nmot B_pwf B_sa B_stdhakt B_stend B_tmsrt ml ststdheiz tmot tmotab tmst tnse_w trmin_w trsec_l vfzg wtans /end IN_MEASUREMENT
 /begin OUT_MEASUREMENT tans tansab tansabk_w tansk_w tanslin /end OUT_MEASUREMENT
 /begin LOC_MEASUREMENT B_etafix B_fztafx B_kpl B_llhzta B_lltafx B_plaus B_stdhaktOld B_ztafix dtmabsta tamax tamin trsecstdh_l zfzptafx zllptafx /end LOC_MEASUREMENT
/end FUNCTION
/begin FUNCTION GGTFM "49.60     Gebergrˆﬂe TFM Temperaturf¸hler Motor (/-K¸hlmittel)"
 /begin DEF_CHARACTERISTIC AFZBKLH AFZBKLN CWSTDH CWTMREW DTAMLCONST DTLRTML DTMDMA DTMDNPO DTMFR DTMSH DTMSHA DTMSRT FABSTT KFDTMNK KFDTMRK KFDTMTE KFDTMTR KFDTMTU KFTDTMREOF KLDTMFXTM KLDTMRS KLTDTMREON MLOBKLHV MLOBKLNV MLUBKLHV MLUBKLNV TABSTDH TADMM TATAMLTMRW TDBKLOFF TDTM TDTMMA TMDMMA TMDMMAT TMDMMAU TMDMMEE TMDMMER TMDMN TMDMX TMESSCMN TMLRTMS TMMXRT TMOTELI TMOTSHE TMRWKFT TMRWTKWMX TMSSSCO TMSSSCU TNSRT TRESSH TSTDHE TUMDETM TWBKLHON TWBKLNON TWLRTMS VBKLHO VBKLHU VBKLNO VBKLNU ZFTMOT ZFTMOTR ZTMRWTAML /end DEF_CHARACTERISTIC
 /begin IN_MEASUREMENT B_etum B_kalt B_nmin B_nmot B_nokatfz B_oeltemp B_pwf B_sa B_st B_stdhakt B_stend ml nmot tabst_w taml tans tkwpwm tnse_w tol trmin_w tumg vfzg wtmot /end IN_MEASUREMENT
 /begin OUT_MEASUREMENT B_fgdtm B_tmdmme B_tmsrt manftmew mll1 msttmew msttmrw tdlrtm_w tmew tmewab tmot tmotab tmotlin tmotlin_w tmrw tmst /end OUT_MEASUREMENT
 /begin LOC_MEASUREMENT anztmklh anztmkln B_ehsctm B_kalter B_kaltumew B_kaltumof B_kaltumre B_kaltumrw B_mxmntm B_npotm B_scbkhoff B_scbknoff B_shakt B_tamlent B_tmmn B_tmrwmsee B_zhsctm dtmrw dtmrwp_w dtmrwt_w fktmsch msttmewk msttmrwk tamlfori_w tmotlinmn tmotlinmx tmotlinst tmotnt tmotstdh tmotvt tmrwend tmrwktof_w tmrwkton tmrwp_w tmrwt_w ttwbklhon ttwbklnon tum /end LOC_MEASUREMENT
/end FUNCTION
/begin FUNCTION GGTFUMG "8.30      Gebergrˆﬂe TFUMG Temperaturf¸hler Umgebung (/-sluft)"
 /begin DEF_CHARACTERISTIC DTUMABSTMX DTUMMSTMX DTUMTA IMTUMGTA NTUMGTA TDTUMHEAL TDTUMNPL TDTUMSIG TTUMABSTMX TTUMTNSEMN TTUMTNSEMX TUMGNPL TUMGTAI TUMNPLMN TUMNPLMX TUMTMOTMN VTUMGTA /end DEF_CHARACTERISTIC
 /begin IN_MEASUREMENT B_ins3cok B_kl15 B_pwf B_stend B_tabunpl B_tfu imlatm nmot tabst_w tans tka tmot tnse_w tumgcan vfzg /end IN_MEASUREMENT
 /begin OUT_MEASUREMENT B_ctunp B_etum ggtfumgAUSBit tumg tumgabst tumgmst /end OUT_MEASUREMENT
 /begin LOC_MEASUREMENT B_tmpsener B_tumabstp B_tumen B_tumgnpl B_tummstpl B_tumnplen B_tumrec B_tumres ggtfumgLocBit tumgta /end LOC_MEASUREMENT
 /begin SUB_FUNCTION DFPM_GGTFUMG /end SUB_FUNCTION
/end FUNCTION
/begin FUNCTION GGTKA "1.50      Gebergrˆﬂe TKA Temperatur K¸hlerausgang"
 /begin DEF_CHARACTERISTIC DTKATMMX DTTKAFX KFTKAABKUE KLDTTKASC NMOTTKASC TDTKAUS TKAELI TKAUSDE TKAUSDMN TKAUSDMX TMOTTKASC TMSTTKASC TNTMTKASC TUMGTKASC /end DEF_CHARACTERISTIC
 /begin IN_MEASUREMENT B_dcy B_pwf B_stend nmot tabst_w tmot tmst tumg wtka /end IN_MEASUREMENT
 /begin OUT_MEASUREMENT tka tkalin /end OUT_MEASUREMENT
 /begin LOC_MEASUREMENT B_hstkaerr B_sctkaen B_sctkaerr B_tkatuvgl B_tmtkascf B_zsctka dtkatumg dtkavglw ggtkaLokBits tkaab tkalinmn tkalinmx ttmtkasc /end LOC_MEASUREMENT
 /begin SUB_FUNCTION DFPM_GGTKA /end SUB_FUNCTION
/end FUNCTION
/begin FUNCTION GGTSG "1.10      Gebergrˆﬂe und Dokumentation Temperatur Steuerger‰t"
 /begin DEF_CHARACTERISTIC STNSG1 STNSG2 STNSG3 STNSG4 STNSG5 STTSG1 STTSG2 STTSG3 STTSG4 STTSG5 TSGELI TSTSG /end DEF_CHARACTERISTIC
 /begin IN_MEASUREMENT nmot wtsg /end IN_MEASUREMENT
 /begin OUT_MEASUREMENT tsg /end OUT_MEASUREMENT
/end FUNCTION
/begin FUNCTION GGUB "18.10     Gebergrˆﬂe Batteriespannung, inkl.Diagnose" /begin DEF_CHARACTERISTIC TDNSUB TDUB UBDE UBDMN1 UBDMN2 UBDMX VMDUB /end DEF_CHARACTERISTIC /begin IN_MEASUREMENT B_stend B_wakeup vfzg wub /end IN_MEASUREMENT /begin OUT_MEASUREMENT ub ubsq ubsqf ubsqf_w ubsq_w ub_w /end OUT_MEASUREMENT /end FUNCTION
/begin FUNCTION GGVFZG "10.60     Gebergrˆﬂe Fahrzeuggeschwindigkeit"
 /begin DEF_CHARACTERISTIC CWVERS DVERSBEG DVFZBEG TFGRVRAB UECONS VFZMN VRFGRMN VRFMNERS ZFV /end DEF_CHARACTERISTIC
 /begin REF_CHARACTERISTIC KWBAIMV /end REF_CHARACTERISTIC
 /begin IN_MEASUREMENT bfzgldsc_w B_dsc4cok B_egs1cok B_egs3cok B_evfzgv1 codcan codget gangauti nmot_w nturbc_w uevges vfzgv1_w vmaxidx vroh_w /end IN_MEASUREMENT
 /begin OUT_MEASUREMENT bfzgl_b B_vnull vfzg vfzg_w vfzroh_w /end OUT_MEASUREMENT
 /begin LOC_MEASUREMENT nturbc_temp vers_temp vers_temp2 vfil_w vfzgers_w /end LOC_MEASUREMENT
/end FUNCTION
/begin FUNCTION GK "14.40     Gemischkontrolle" /begin DEF_CHARACTERISTIC KFBS /end DEF_CHARACTERISTIC
 /begin IN_MEASUREMENT fgru fns fr2_w fra2_w fra_w fr_w fst_w fwe fwl lamnswl_w lamsbg2_w lamsbg_w nmot rka2_w rkaco_w rka_w rkte_w rkukg_w rl rlp_w /end IN_MEASUREMENT
 /begin OUT_MEASUREMENT rk2_w rkkva2_w rkkva_w rk_w /end OUT_MEASUREMENT
 /begin LOC_MEASUREMENT fvst_w /end LOC_MEASUREMENT
/end FUNCTION
/begin FUNCTION GLF "2.50      Gesteuerte Luftf¸hrung"
 /begin DEF_CHARACTERISTIC CWGLFETM GLFDTKAOFF GLFDTKAON GLFGEOFF GLFGEON GLFHOLD GLFLOFF GLFLON GLFNON GLFON GLFTKAOFF GLFTKAON GLFTOLOFF GLFTOLON GLFVOFF GLFVON KLGLFAOFF KLGLFAON KLGLFLAST TGLFLASTOF TGLFLASTON /end DEF_CHARACTERISTIC
 /begin IN_MEASUREMENT B_faglf B_glfet B_kalt B_kl15 B_stend nmot rl stmlac tans tget tka tkws tol vfzg /end IN_MEASUREMENT
 /begin OUT_MEASUREMENT B_aglf /end OUT_MEASUREMENT
 /begin LOC_MEASUREMENT B_glferr B_glfoff B_glfon GLF100mslocbits /end LOC_MEASUREMENT
/end FUNCTION
/begin FUNCTION HDMTL "1.50      Heizung DM-TL" /begin DEF_CHARACTERISTIC CWHDMTL /end DEF_CHARACTERISTIC /begin IN_MEASUREMENT B_cddmtl B_desee B_nmot B_stend /end IN_MEASUREMENT /begin OUT_MEASUREMENT B_hdmtl /end OUT_MEASUREMENT /end FUNCTION
/begin FUNCTION HLSHK "3.31      Sondenheizung hinter Kat"
 /begin DEF_CHARACTERISTIC PHLSNHMN TANHKMMN THHA THHA2 THHAWU THSHA THSHKTK THSHKTK2 TVHSH UBHS UHSN /end DEF_CHARACTERISTIC
 /begin IN_MEASUREMENT B_atmtpk B_atmtpk2 B_atmtpl B_atmtpl2 B_stend tanhkm2_w tanhkm_w ub /end IN_MEASUREMENT
 /begin OUT_MEASUREMENT B_hsha B_hsha2 B_hshe B_hshe2 phlsnh phlsnh2 /end OUT_MEASUREMENT
 /begin LOC_MEASUREMENT B_enhlshk B_rehs thhaist thhaist2 thhat thhat2 /end LOC_MEASUREMENT
/end FUNCTION
/begin FUNCTION HRLSU "4.110     Heizungsregelung stetige Lambdasonde LSU"
 /begin DEF_CHARACTERISTIC DPRHLSU DTKLSUSTA DTKLSUSTB KDHRLSU KIHRLSU KLPRHLSU KPHRLSU PRHLSUL TABSTRILSU THLSUHR THLSUHRST TKERLSUS TKERLSUST /end DEF_CHARACTERISTIC
 /begin IN_MEASUREMENT B_atmtpa B_atmtpa2 B_ehlsu B_ehlsu2 B_ehsve B_ehsve2 B_eiclsu B_eiclsu2 B_elsuwi B_elsuwi2 B_hrlsaus B_nmot B_rinabg B_rinabg2 B_spf3k B_spf3k2 B_stend tabst_w tatuk_w tkerlsu2_w tkerlsu_w /end IN_MEASUREMENT
 /begin OUT_MEASUREMENT B_eshlsu B_eshlsu2 B_henrin B_henrin2 B_hlsumx B_hlsumx2 B_hstlsua B_hstlsua2 B_hstlsub B_hstlsub2 B_hsv B_hsv2 hrlsuAusBits hrlsuAusBits_2 prhrlsu2_w prhrlsu_w rdtklsu2_w rdtklsu_w /end OUT_MEASUREMENT
 /begin LOC_MEASUREMENT B_hlsuaru B_hlsuaru2 B_sphrlsu B_sphrlsu2 B_tablsugr hrlsuLokBits hrlsuLokBits_2 iintpid2_w iintpid_w phlsuri2_w phlsuri_w prhlsub2_w prhlsub_w prhlsud2_w prhlsud_w prhlsui2_w prhlsuin_w prhlsui_w prhlsup2_w prhlsup_w prhlsur2_w prhlsur_w /end LOC_MEASUREMENT
/end FUNCTION
/begin FUNCTION HT2KTDVE "1.20" /begin IN_MEASUREMENT AS_dimdk B_dcdisfr B_dlrspid dlrspid_w /end IN_MEASUREMENT /begin OUT_MEASUREMENT dlrspids_w /end OUT_MEASUREMENT /end FUNCTION
/begin FUNCTION HT2KTPH "1.140     Umsetzungsschicht Hardewaretreiber zu Komponententreiber Nockenwelle"
 /begin DEF_CHARACTERISTIC DPHFLFR1 DPHFLFR2 DPHFLFR3 DPHFLFR4 DPHFLSP1 DPHFLSP2 DPHFLSP3 DPHFLSP4 NMXPHPOS NWOFFSET NWSIGNAL NWSIGTOL WNWSPG1 WNWSPG2 WNWSPG3 WNWSPG4 /end DEF_CHARACTERISTIC
 /begin IN_MEASUREMENT B_nachlauf B_nldg B_synnldg nlindex nmot pgmaster softres synstate tsegph_l /end IN_MEASUREMENT
 /begin OUT_MEASUREMENT anzburst B_checkpg B_checkpg2 B_checkpg3 B_checkpg4 B_phaactiv nwacedmast tnphslin_w tnwia2_l tnwia_l tnwie2_l tnwie_l wnwkwa2_w wnwkwa_w wnwkwe2_w wnwkwe_w zphfl zphfl2 zphfl2ct_w zphfl3 zphfl3ct_w zphfl4 zphfl4ct_w zphflct_w zrph2_l zrph3_l zrph4_l zrph_l /end OUT_MEASUREMENT
 /begin LOC_MEASUREMENT B_pg1limsw B_pg2limsw B_pg3limsw B_pg4limsw B_zphflma camstate nwsolpos_w pg1limfr_w pg1limsp_w pg2limfr_w pg2limsp_w pg3limfr_w pg3limsp_w pg4limfr_w pg4limsp_w /end LOC_MEASUREMENT
/end FUNCTION
/begin FUNCTION HT2KTWNE "1.130     Umsetzungsschicht Hardwaretreiber zu Komponententreiber Kurbelwelle"
 /begin DEF_CHARACTERISTIC CWPG1 CWPG2 CWPG3 CWPG4 DZZST FSYNDEL KNLSYN NMIN NMOTFIL NMOTFILHS NMOTQSYN OFQSYNADAP TNLPHWAIT TPREL WKWALETEST ZTPREL /end DEF_CHARACTERISTIC
 /begin REF_CHARACTERISTIC CWALE /end REF_CHARACTERISTIC
 /begin IN_MEASUREMENT B_ale B_nachlauf B_nldg B_nlph B_stend inisynmon nmot nwacedmast pgmaster synstate wkwstop_w /end IN_MEASUREMENT
 /begin OUT_MEASUREMENT B_bm B_exttper B_stprel B_synnldg B_tprel B_zprel B_zsynchro crankstate nlindex sync_level synid SYN_st tsegph_l tseg_l wkwas_w zzkwas_w zzvirt zzyl /end OUT_MEASUREMENT
 /begin LOC_MEASUREMENT qstartinf wkwalest_w /end LOC_MEASUREMENT
/end FUNCTION
/begin FUNCTION HWPSL421 "1.10" /begin DEF_CHARACTERISTIC CWPSL421 /end DEF_CHARACTERISTIC /begin IN_MEASUREMENT B_aglf B_oeldran /end IN_MEASUREMENT /begin OUT_MEASUREMENT B_end421 /end OUT_MEASUREMENT /end FUNCTION
/begin COMPU_METHOD bfzg_sb_q0p217 "" RAT_FUNC "%6.3" "m/s^2" COEFFS 0 1 0 0 0 0.217 /end COMPU_METHOD
/begin COMPU_METHOD B_TRUE "boolsche Zust‰nde, positive Logik" TAB_VERB "%6.3" "" COMPU_TAB_REF B_TRUE /end COMPU_METHOD
/begin COMPU_VTAB B_TRUE "boolsche Zust‰nde, positive Logik" TAB_VERB 2 0 "----" 1 "TRUE" /end COMPU_VTAB
/begin COMPU_METHOD DEZ "1 : 1 Umrechnug (dez/hex)" RAT_FUNC "%6.2" "" COEFFS 0 1 0 0 0 1 /end COMPU_METHOD
/begin COMPU_METHOD dez "1 : 1 Umrechnug (dez/hex)" RAT_FUNC "%6.2" "" COEFFS 0 1 0 0 0 1 /end COMPU_METHOD
/begin COMPU_METHOD fak_q0p1 "" RAT_FUNC "%6.3" "-" COEFFS 0 1 0 0 0 0.1 /end COMPU_METHOD
/begin COMPU_METHOD fak_sb_b0p25 "" RAT_FUNC "%6.4" "-" COEFFS 0 256 0 0 0 0.5 /end COMPU_METHOD
/begin COMPU_METHOD fak_ub_b2 "" RAT_FUNC "%6.4" "-" COEFFS 0 256 0 0 0 2 /end COMPU_METHOD
/begin COMPU_METHOD fak_ub_q0p01 "" RAT_FUNC "%6.4" "-" COEFFS 0 1 0 0 0 0.01 /end COMPU_METHOD
/begin COMPU_METHOD fak_uw_b2 "" RAT_FUNC "%7.6" "-" COEFFS 0 65536 0 0 0 2 /end COMPU_METHOD
/begin COMPU_METHOD fak_uw_b4 "" RAT_FUNC "%7.6" "-" COEFFS 0 65536 0 0 0 4 /end COMPU_METHOD
/begin COMPU_METHOD fak_uw_b64 "" RAT_FUNC "%6.5" "-" COEFFS 0 65536 0 0 0 64 /end COMPU_METHOD
/begin COMPU_METHOD fak_uw_q0p01 "" RAT_FUNC "%6.4" "-" COEFFS 0 1 0 0 0 0.01 /end COMPU_METHOD
/begin COMPU_METHOD ispg_q0p25 "" RAT_FUNC "%6.3" "uA/V" COEFFS 0 4 0 0 0 1 /end COMPU_METHOD
/begin COMPU_METHOD i_q0p125_uA "" RAT_FUNC "%6.3" "uA" COEFFS 0 8 0 0 0 1 /end COMPU_METHOD
/begin COMPU_METHOD i_q1_uA "" RAT_FUNC "%6.2" "uA" COEFFS 0 1 0 0 0 1 /end COMPU_METHOD
/begin COMPU_METHOD kw_q0p1 "" RAT_FUNC "%6.3" "Grad KW" COEFFS 0 10 0 0 0 1 /end COMPU_METHOD
/begin COMPU_METHOD kw_q1 "" RAT_FUNC "%6.2" "Grad KW" COEFFS 0 1 0 0 0 1 /end COMPU_METHOD
/begin COMPU_METHOD m_ub_b1020 "" RAT_FUNC "%6.2" "kg/h" COEFFS 0 1 0 0 0 4 /end COMPU_METHOD
/begin COMPU_METHOD m_ub_b23p3 "" RAT_FUNC "%6.3" "kg" COEFFS 0 2812.5 0 0 0 256 /end COMPU_METHOD
/begin COMPU_METHOD nmot_q0p125 "" RAT_FUNC "%6.3" "1/min" COEFFS 0 8 0 0 0 1 /end COMPU_METHOD
/begin COMPU_METHOD nmot_q1 "" RAT_FUNC "%6.2" "1/min" COEFFS 0 1 0 0 0 1 /end COMPU_METHOD
/begin COMPU_METHOD nmot_ub_q40 "" RAT_FUNC "%6.1" "1/min" COEFFS 0 1 0 0 0 40 /end COMPU_METHOD
/begin COMPU_METHOD p_uw_q0p039 "" RAT_FUNC "%6.4" "hPa" COEFFS 0 256 0 0 0 10 /end COMPU_METHOD
/begin COMPU_METHOD relO2_q9p765Em4 "" RAT_FUNC "%6.5" "% O2" COEFFS 0 1024 0 0 0 1 /end COMPU_METHOD
/begin COMPU_METHOD relPED_ub_b100 "" RAT_FUNC "%6.3" "%PED" COEFFS 0 255 0 0 0 100 /end COMPU_METHOD
/begin COMPU_METHOD relPED_uw_b100 "" RAT_FUNC "%6.4" "%PED" COEFFS 0 65535 0 0 0 100 /end COMPU_METHOD
/begin COMPU_METHOD reltemp_q2p543Em4 "" RAT_FUNC "%6.5" "%/K" COEFFS 0 98304 0 0 0 25 /end COMPU_METHOD
/begin COMPU_METHOD reltemp_q5p086Em4 "" RAT_FUNC "%6.5" "%/K" COEFFS 0 49152 0 0 0 25 /end COMPU_METHOD
/begin COMPU_METHOD rel_q0p0061 "" RAT_FUNC "%6.4" "" COEFFS 0 1 0 0 0 0.00609756 /end COMPU_METHOD
/begin COMPU_METHOD rel_q0p01 "" RAT_FUNC "%6.4" "%" COEFFS 0 100 0 0 0 1 /end COMPU_METHOD
/begin COMPU_METHOD rel_sb_q0p39 "" RAT_FUNC "%6.3" "%" COEFFS 0 1 0 0 0 0.3906 /end COMPU_METHOD
/begin COMPU_METHOD rel_sw_b100 "" RAT_FUNC "%6.4" "%" COEFFS 0 32768 0 0 0 100 /end COMPU_METHOD
/begin COMPU_METHOD rel_sw_b50 "" RAT_FUNC "%6.4" "%" COEFFS 0 65536 0 0 0 100 /end COMPU_METHOD
/begin COMPU_METHOD rel_ub_b100 "" RAT_FUNC "%6.3" "%" COEFFS 0 256 0 0 0 100 /end COMPU_METHOD
/begin COMPU_METHOD rel_ub_b99p6 "" RAT_FUNC "%6.3" "%" COEFFS 0 256 0 0 0 100 /end COMPU_METHOD
/begin COMPU_METHOD rel_ub_q0p75 "" RAT_FUNC "%6.3" "%" COEFFS 0 1 0 0 0 0.75 /end COMPU_METHOD
/begin COMPU_METHOD rel_uw_b100 "" RAT_FUNC "%6.4" "%" COEFFS 0 65536 0 0 0 100 /end COMPU_METHOD
/begin COMPU_METHOD rel_uw_b200 "" RAT_FUNC "%6.4" "%" COEFFS 0 65536 0 0 0 200 /end COMPU_METHOD
/begin COMPU_METHOD rel_uw_b3072 "" RAT_FUNC "%6.4" "%" COEFFS 0 65536 0 0 0 3072 /end COMPU_METHOD
/begin COMPU_METHOD rpspg_q0p0156 "" RAT_FUNC "%6.4" "Ohm/V" COEFFS 0 65536 0 0 0 1024 /end COMPU_METHOD
/begin COMPU_METHOD r_q0p0391 "" RAT_FUNC "%6.4" "Ohm" COEFFS 0 65536 0 0 0 2560 /end COMPU_METHOD
/begin COMPU_METHOD spg_q0p00039 "" RAT_FUNC "%6.5" "V" COEFFS 0 1 0 0 0 0.000390625 /end COMPU_METHOD
/begin COMPU_METHOD spg_q0p00488 "" RAT_FUNC "%6.4" "V" COEFFS 0 1024 0 0 0 5 /end COMPU_METHOD
/begin COMPU_METHOD spg_q0p1 "" RAT_FUNC "%6.3" "V" COEFFS 0 1 0 0 0 0.1 /end COMPU_METHOD
/begin COMPU_METHOD spg_q1p22Em4 "" RAT_FUNC "%6.5" "V" COEFFS 0 65536 0 0 0 8 /end COMPU_METHOD
/begin COMPU_METHOD spg_q4p88Em4 "" RAT_FUNC "%6.5" "V" COEFFS 0 2048 0 0 0 1 /end COMPU_METHOD
/begin COMPU_METHOD spg_ubatt "" RAT_FUNC "%6.3" "V" COEFFS 0 1 0 0 0 0.0942 /end COMPU_METHOD
/begin COMPU_METHOD spg_ub_b5 "" RAT_FUNC "%6.4" "V" COEFFS 0 256 0 0 0 5 /end COMPU_METHOD
/begin COMPU_METHOD spg_uw_q0p00488 "" RAT_FUNC "%6.4" "V" COEFFS 0 1024 0 0 0 5 /end COMPU_METHOD
/begin COMPU_METHOD t100msxs_ub_b255 "" RAT_FUNC "%6.2" "s" COEFFS 0 1 0 0 0 1 /end COMPU_METHOD
/begin COMPU_METHOD t100msxs_ub_b25p5 "" RAT_FUNC "%6.3" "s" COEFFS 0 1 0 0 0 0.1 /end COMPU_METHOD
/begin COMPU_METHOD t100msxs_uw_b6553p5 "" RAT_FUNC "%6.3" "s" COEFFS 0 1 0 0 0 0.1 /end COMPU_METHOD
/begin COMPU_METHOD t10msxs_q0p01_o0p05 "" RAT_FUNC "%6.4" "s" COEFFS 0 1 0.05 0 0 0.01 /end COMPU_METHOD
/begin COMPU_METHOD t10msxs_ub_b2p55 "" RAT_FUNC "%6.4" "s" COEFFS 0 1 0 0 0 0.01 /end COMPU_METHOD
/begin COMPU_METHOD t10msxs_uw_b655p35 "" RAT_FUNC "%6.4" "s" COEFFS 0 1 0 0 0 0.01 /end COMPU_METHOD
/begin COMPU_METHOD t1msxms_q1 "" RAT_FUNC "%6.2" "ms" COEFFS 0 1 0 0 0 1 /end COMPU_METHOD
/begin COMPU_METHOD t1sxs_q1 "" RAT_FUNC "%6.2" "s" COEFFS 0 1 0 0 0 1 /end COMPU_METHOD
/begin COMPU_METHOD t1sxs_ub_b255 "" RAT_FUNC "%6.2" "s" COEFFS 0 1 0 0 0 1 /end COMPU_METHOD
/begin COMPU_METHOD t1sxs_uw_b65535 "" RAT_FUNC "%6.2" "s" COEFFS 0 1 0 0 0 1 /end COMPU_METHOD
/begin COMPU_METHOD t1sxs_uw_q1 "" RAT_FUNC "%6.2" "s" COEFFS 0 1 0 0 0 1 /end COMPU_METHOD
/begin COMPU_METHOD t50msxs_ub_b12p75 "" RAT_FUNC "%6.4" "s" COEFFS 0 1 0 0 0 0.05 /end COMPU_METHOD
/begin COMPU_METHOD temp_q0p0234 "" RAT_FUNC "%6.4" "K" COEFFS 0 256 0 0 0 6 /end COMPU_METHOD
/begin COMPU_METHOD temp_q0p0234_o273 "" RAT_FUNC "%6.1" "Grad C" COEFFS 0 1 273.15 0 0 0.0234375 /end COMPU_METHOD
/begin COMPU_METHOD temp_q1 "" RAT_FUNC "%6.2" "Grad C" COEFFS 0 1 0 0 0 1 /end COMPU_METHOD
/begin COMPU_METHOD temp_sb_b0p093 "" RAT_FUNC "%6.5" "Grad C" COEFFS 0 512 0 0 0 0.375 /end COMPU_METHOD
/begin COMPU_METHOD temp_sb_q0p75 "" RAT_FUNC "%6.3" "Grad C" COEFFS 0 1 0 0 0 0.75 /end COMPU_METHOD
/begin COMPU_METHOD temp_ub_b191p25 "" RAT_FUNC "%6.3" "Grad C" COEFFS 0 1 0 0 0 0.75 /end COMPU_METHOD
/begin COMPU_METHOD temp_ub_q0p75 "" RAT_FUNC "%6.3" "Grad C" COEFFS 0 1 0 0 0 0.75 /end COMPU_METHOD
/begin COMPU_METHOD temp_ub_q0p75_o48 "" RAT_FUNC "%6.2" "Grad C" COEFFS 0 1 48 0 0 0.75 /end COMPU_METHOD
/begin COMPU_METHOD temp_uw_q0p0029_o48 "" RAT_FUNC "%6.2" "Grad C" COEFFS 0 256 12288 0 0 0.75 /end COMPU_METHOD
/begin COMPU_METHOD temp_uw_q0p75_o48 "" RAT_FUNC "%6.2" "Grad C" COEFFS 0 1 48 0 0 0.75 /end COMPU_METHOD
/begin COMPU_METHOD t_q0p0001_ms "" RAT_FUNC "%7.6" "ms" COEFFS 0 1 0 0 0 0.0001 /end COMPU_METHOD
/begin COMPU_METHOD t_q0p001_ms "" RAT_FUNC "%6.5" "ms" COEFFS 0 1 0 0 0 0.001 /end COMPU_METHOD
/begin COMPU_METHOD t_q0p01 "" RAT_FUNC "%6.4" "s" COEFFS 0 100 0 0 0 1 /end COMPU_METHOD
/begin COMPU_METHOD t_q0p1 "" RAT_FUNC "%6.3" "s" COEFFS 0 10 0 0 0 1 /end COMPU_METHOD
/begin COMPU_METHOD t_q1 "" RAT_FUNC "%6.2" "s" COEFFS 0 1 0 0 0 1 /end COMPU_METHOD
/begin COMPU_METHOD t_q1p024_ms "" RAT_FUNC "%6.2" "ms" COEFFS 0 1 0 0 0 1.024 /end COMPU_METHOD
/begin COMPU_METHOD vfzg_ub_q1p25 "" RAT_FUNC "%6.2" "km/h" COEFFS 0 1 0 0 0 1.25 /end COMPU_METHOD
/begin COMPU_METHOD vfzg_uw_b512 "" RAT_FUNC "%6.4" "km/h" COEFFS 0 65536 0 0 0 512 /end COMPU_METHOD
/begin COMPU_METHOD zk100msxs_uw_b6553 "" RAT_FUNC "%6.1" "s" COEFFS 0 0 65536 0 10 0 /end COMPU_METHOD
/begin COMPU_METHOD zk10msxs_uw_b655 "" RAT_FUNC "%6.2" "s" COEFFS 0 0 65536 0 100 0 /end COMPU_METHOD
/begin RECORD_LAYOUT KfAxU8AyU8SstxU8SstyU16WU8 NO_AXIS_PTS_X 1 UBYTE NO_AXIS_PTS_Y 2 UBYTE AXIS_PTS_X 3 UBYTE INDEX_INCR DIRECT AXIS_PTS_Y 4 UWORD INDEX_INCR DIRECT FNC_VALUES 5 UBYTE COLUMN_DIR DIRECT /end RECORD_LAYOUT
/begin RECORD_LAYOUT KfAxUbAyUbSstxSwSstyUbWSw NO_AXIS_PTS_X 1 UBYTE NO_AXIS_PTS_Y 2 UBYTE AXIS_PTS_X 3 SWORD INDEX_INCR DIRECT AXIS_PTS_Y 4 UBYTE INDEX_INCR DIRECT FNC_VALUES 5 SWORD COLUMN_DIR DIRECT /end RECORD_LAYOUT
/begin RECORD_LAYOUT KfAxUbAyUbSstxUbSstyUbWSb NO_AXIS_PTS_X 1 UBYTE NO_AXIS_PTS_Y 2 UBYTE AXIS_PTS_X 3 UBYTE INDEX_INCR DIRECT AXIS_PTS_Y 4 UBYTE INDEX_INCR DIRECT FNC_VALUES 5 SBYTE COLUMN_DIR DIRECT /end RECORD_LAYOUT
/begin RECORD_LAYOUT KfAxUbAyUbSstxUbSstyUwWUw NO_AXIS_PTS_X 1 UBYTE NO_AXIS_PTS_Y 2 UBYTE AXIS_PTS_X 3 UBYTE INDEX_INCR DIRECT AXIS_PTS_Y 4 UWORD INDEX_INCR DIRECT FNC_VALUES 5 UWORD COLUMN_DIR DIRECT /end RECORD_LAYOUT
/begin RECORD_LAYOUT KlAUbSstUbWSb NO_AXIS_PTS_X 1 UBYTE AXIS_PTS_X 2 UBYTE INDEX_INCR DIRECT FNC_VALUES 3 SBYTE COLUMN_DIR DIRECT /end RECORD_LAYOUT
/begin RECORD_LAYOUT KlAUbSstUbWUb NO_AXIS_PTS_X 1 UBYTE AXIS_PTS_X 2 UBYTE INDEX_INCR DIRECT FNC_VALUES 3 UBYTE COLUMN_DIR DIRECT /end RECORD_LAYOUT
/begin RECORD_LAYOUT KlAUbSstUbWUw NO_AXIS_PTS_X 1 UBYTE AXIS_PTS_X 2 UBYTE INDEX_INCR DIRECT FNC_VALUES 3 UWORD COLUMN_DIR DIRECT /end RECORD_LAYOUT
/begin RECORD_LAYOUT KlAUbSstUwWUb NO_AXIS_PTS_X 1 UBYTE AXIS_PTS_X 2 UWORD INDEX_INCR DIRECT FNC_VALUES 3 UBYTE COLUMN_DIR DIRECT /end RECORD_LAYOUT
/begin RECORD_LAYOUT KlAUwSstUwWUw NO_AXIS_PTS_X 1 UWORD AXIS_PTS_X 2 UWORD INDEX_INCR DIRECT FNC_VALUES 3 UWORD COLUMN_DIR DIRECT /end RECORD_LAYOUT
/begin RECORD_LAYOUT KlAxU8SstxS16WS16 NO_AXIS_PTS_X 1 SWORD AXIS_PTS_X 2 SWORD INDEX_INCR DIRECT FNC_VALUES 3 SWORD COLUMN_DIR DIRECT /end RECORD_LAYOUT
/begin RECORD_LAYOUT KlAxU8SstxS16WU16 NO_AXIS_PTS_X 1 UWORD AXIS_PTS_X 2 SWORD INDEX_INCR DIRECT FNC_VALUES 3 UWORD COLUMN_DIR DIRECT /end RECORD_LAYOUT
/begin RECORD_LAYOUT KlAxU8SstxU16WS16 NO_AXIS_PTS_X 1 UWORD AXIS_PTS_X 2 UWORD INDEX_INCR DIRECT FNC_VALUES 3 SWORD COLUMN_DIR DIRECT /end RECORD_LAYOUT
/begin RECORD_LAYOUT KlAxU8SstxU16WU16 NO_AXIS_PTS_X 1 UWORD AXIS_PTS_X 2 UWORD INDEX_INCR DIRECT FNC_VALUES 3 UWORD COLUMN_DIR DIRECT /end RECORD_LAYOUT
/begin RECORD_LAYOUT KlAxU8SstxU8WU8 NO_AXIS_PTS_X 1 UBYTE AXIS_PTS_X 2 UBYTE INDEX_INCR DIRECT FNC_VALUES 3 UBYTE COLUMN_DIR DIRECT /end RECORD_LAYOUT
/begin RECORD_LAYOUT KwbWU8 FNC_VALUES 1 UBYTE COLUMN_DIR DIRECT /end RECORD_LAYOUT
/begin RECORD_LAYOUT KwSb FNC_VALUES 1 SBYTE COLUMN_DIR DIRECT /end RECORD_LAYOUT
/begin RECORD_LAYOUT KwSw FNC_VALUES 1 SWORD COLUMN_DIR DIRECT /end RECORD_LAYOUT
/begin RECORD_LAYOUT KwUb FNC_VALUES 1 UBYTE COLUMN_DIR DIRECT /end RECORD_LAYOUT
/begin RECORD_LAYOUT KwUw FNC_VALUES 1 UWORD COLUMN_DIR DIRECT /end RECORD_LAYOUT
/begin RECORD_LAYOUT KwWS16 FNC_VALUES 1 SWORD COLUMN_DIR DIRECT /end RECORD_LAYOUT
/begin RECORD_LAYOUT KwWS8 FNC_VALUES 1 SBYTE COLUMN_DIR DIRECT /end RECORD_LAYOUT
/begin RECORD_LAYOUT KwWU16 FNC_VALUES 1 UWORD COLUMN_DIR DIRECT /end RECORD_LAYOUT
/begin RECORD_LAYOUT KwWU8 FNC_VALUES 1 UBYTE COLUMN_DIR DIRECT /end RECORD_LAYOUT
/end MODULE
/end PROJECT
