ASAP2_VERSION 1 41
/begin PROJECT MSD70 "Spray Guided DI-System with Piezo Injectors for 6-Cylinder"
/begin HEADER "_default_HeaderComment" PROJECT_NO _0B /end HEADER
/begin MODULE _default_ModuleName "_default_ModuleLongIdentifier"
/begin MOD_COMMON "_default_ModCommonComment" DEPOSIT ABSOLUTE BYTE_ORDER MSB_LAST ALIGNMENT_BYTE 1 ALIGNMENT_WORD 2 ALIGNMENT_LONG 2 ALIGNMENT_FLOAT32_IEEE 2 ALIGNMENT_FLOAT64_IEEE 4 /end MOD_COMMON
/begin MEASUREMENT tbl_frf[0].envd_obd[0] "Freeze frame FRF_OBD: environmental data (fixed by law)" UBYTE _CNV_A_R_LINEAR_____0_CM 1 100. 0. 255. DISPLAY_IDENTIFIER ENVD_OBD_1_0 ECU_ADDRESS 0xd00047a0 FORMAT "%3.0" /end MEASUREMENT
/begin MEASUREMENT tbl_frf[0].envd_obd[1] "Freeze frame FRF_OBD: environmental data (fixed by law)" UBYTE _CNV_A_R_LINEAR_____0_CM 1 100. 0. 255. DISPLAY_IDENTIFIER ENVD_OBD_2_0 ECU_ADDRESS 0xd00047a1 FORMAT "%3.0" /end MEASUREMENT
/begin MEASUREMENT tbl_frf[0].envd_obd[2] "Freeze frame FRF_OBD: environmental data (fixed by law)" UBYTE _CNV_A_R_LINEAR_____0_CM 1 100. 0. 255. DISPLAY_IDENTIFIER ENVD_OBD_3_0 ECU_ADDRESS 0xd00047a2 FORMAT "%3.0" /end MEASUREMENT
/begin MEASUREMENT tbl_frf[0].envd_obd[3] "Freeze frame FRF_OBD: environmental data (fixed by law)" UBYTE _CNV_A_R_LINEAR_____0_CM 1 100. 0. 255. DISPLAY_IDENTIFIER ENVD_OBD_4_0 ECU_ADDRESS 0xd00047a3 FORMAT "%3.0" /end MEASUREMENT
/begin MEASUREMENT tbl_frf[0].envd_obd[4] "Freeze frame FRF_OBD: environmental data (fixed by law)" UBYTE _CNV_A_R_LINEAR_____0_CM 1 100. 0. 255. DISPLAY_IDENTIFIER ENVD_OBD_5_0 ECU_ADDRESS 0xd00047a4 FORMAT "%3.0" /end MEASUREMENT
/begin MEASUREMENT tbl_frf[0].envd_obd[5] "Freeze frame FRF_OBD: environmental data (fixed by law)" UBYTE _CNV_A_R_LINEAR_____0_CM 1 100. 0. 255. DISPLAY_IDENTIFIER ENVD_OBD_6_0 ECU_ADDRESS 0xd00047a5 FORMAT "%3.0" /end MEASUREMENT
/begin MEASUREMENT tbl_frf[0].envd_obd[6] "Freeze frame FRF_OBD: environmental data (fixed by law)" UBYTE _CNV_A_R_LINEAR_____0_CM 1 100. 0. 255. DISPLAY_IDENTIFIER ENVD_OBD_7_0 ECU_ADDRESS 0xd00047a6 FORMAT "%3.0" /end MEASUREMENT
/begin MEASUREMENT tbl_frf[0].envd_obd[7] "Freeze frame FRF_OBD: environmental data (fixed by law)" UBYTE _CNV_A_R_LINEAR_____0_CM 1 100. 0. 255. DISPLAY_IDENTIFIER ENVD_OBD_8_0 ECU_ADDRESS 0xd00047a7 FORMAT "%3.0" /end MEASUREMENT
/begin MEASUREMENT tbl_frf[0].envd_obd[8] "Freeze frame FRF_OBD: environmental data (fixed by law)" UBYTE _CNV_A_R_LINEAR_____0_CM 1 100. 0. 255. DISPLAY_IDENTIFIER ENVD_OBD_9_0 ECU_ADDRESS 0xd00047a8 FORMAT "%3.0" /end MEASUREMENT
/begin MEASUREMENT tbl_frf[0].envd_obd[9] "Freeze frame FRF_OBD: environmental data (fixed by law)" UBYTE _CNV_A_R_LINEAR_____0_CM 1 100. 0. 255. DISPLAY_IDENTIFIER ENVD_OBD_10_0 ECU_ADDRESS 0xd00047a9 FORMAT "%3.0" /end MEASUREMENT
/begin MEASUREMENT tbl_frf[0].envd_obd[10] "Freeze frame FRF_OBD: environmental data (fixed by law)" UBYTE _CNV_A_R_LINEAR_____0_CM 1 100. 0. 255. DISPLAY_IDENTIFIER ENVD_OBD_11_0 ECU_ADDRESS 0xd00047aa FORMAT "%3.0" /end MEASUREMENT
/begin MEASUREMENT tbl_frf[0].envd_obd[11] "Freeze frame FRF_OBD: environmental data (fixed by law)" UBYTE _CNV_A_R_LINEAR_____0_CM 1 100. 0. 255. DISPLAY_IDENTIFIER ENVD_OBD_12_0 ECU_ADDRESS 0xd00047ab FORMAT "%3.0" /end MEASUREMENT
/begin MEASUREMENT tbl_frf[0].envd_obd[12] "Freeze frame FRF_OBD: environmental data (fixed by law)" UBYTE _CNV_A_R_LINEAR_____0_CM 1 100. 0. 255. DISPLAY_IDENTIFIER ENVD_OBD_13_0 ECU_ADDRESS 0xd00047ac FORMAT "%3.0" /end MEASUREMENT
/begin MEASUREMENT tbl_frf[0].envd_obd[13] "Freeze frame FRF_OBD: environmental data (fixed by law)" UBYTE _CNV_A_R_LINEAR_____0_CM 1 100. 0. 255. DISPLAY_IDENTIFIER ENVD_OBD_14_0 ECU_ADDRESS 0xd00047ad FORMAT "%3.0" /end MEASUREMENT
/begin MEASUREMENT tbl_frf[0].envd_obd[14] "Freeze frame FRF_OBD: environmental data (fixed by law)" UBYTE _CNV_A_R_LINEAR_____0_CM 1 100. 0. 255. DISPLAY_IDENTIFIER ENVD_OBD_15_0 ECU_ADDRESS 0xd00047ae FORMAT "%3.0" /end MEASUREMENT
/begin MEASUREMENT tbl_frf[0].envd_obd[15] "Freeze frame FRF_OBD: environmental data (fixed by law)" UBYTE _CNV_A_R_LINEAR_____0_CM 1 100. 0. 255. DISPLAY_IDENTIFIER ENVD_OBD_16_0 ECU_ADDRESS 0xd00047af FORMAT "%3.0" /end MEASUREMENT
/begin MEASUREMENT tbl_frf[0].envd_obd[16] "Freeze frame FRF_OBD: environmental data (fixed by law)" UBYTE _CNV_A_R_LINEAR_____0_CM 1 100. 0. 255. DISPLAY_IDENTIFIER ENVD_OBD_17_0 ECU_ADDRESS 0xd00047b0 FORMAT "%3.0" /end MEASUREMENT
/begin MEASUREMENT tbl_frf[0].envd_obd[17] "Freeze frame FRF_OBD: environmental data (fixed by law)" UBYTE _CNV_A_R_LINEAR_____0_CM 1 100. 0. 255. DISPLAY_IDENTIFIER ENVD_OBD_18_0 ECU_ADDRESS 0xd00047b1 FORMAT "%3.0" /end MEASUREMENT
/begin MEASUREMENT tbl_frf[0].envd_obd[18] "Freeze frame FRF_OBD: environmental data (fixed by law)" UBYTE _CNV_A_R_LINEAR_____0_CM 1 100. 0. 255. DISPLAY_IDENTIFIER ENVD_OBD_19_0 ECU_ADDRESS 0xd00047b2 FORMAT "%3.0" /end MEASUREMENT
/begin MEASUREMENT tbl_frf[0].envd_obd[19] "Freeze frame FRF_OBD: environmental data (fixed by law)" UBYTE _CNV_A_R_LINEAR_____0_CM 1 100. 0. 255. DISPLAY_IDENTIFIER ENVD_OBD_20_0 ECU_ADDRESS 0xd00047b3 FORMAT "%3.0" /end MEASUREMENT
/begin MEASUREMENT tbl_frf[0].envd_obd[20] "Freeze frame FRF_OBD: environmental data (fixed by law)" UBYTE _CNV_A_R_LINEAR_____0_CM 1 100. 0. 255. DISPLAY_IDENTIFIER ENVD_OBD_21_0 ECU_ADDRESS 0xd00047b4 FORMAT "%3.0" /end MEASUREMENT
/begin MEASUREMENT tbl_frf[0].envd_obd[21] "Freeze frame FRF_OBD: environmental data (fixed by law)" UBYTE _CNV_A_R_LINEAR_____0_CM 1 100. 0. 255. DISPLAY_IDENTIFIER ENVD_OBD_22_0 ECU_ADDRESS 0xd00047b5 FORMAT "%3.0" /end MEASUREMENT
/begin MEASUREMENT tbl_frf[0].envd_obd[22] "Freeze frame FRF_OBD: environmental data (fixed by law)" UBYTE _CNV_A_R_LINEAR_____0_CM 1 100. 0. 255. DISPLAY_IDENTIFIER ENVD_OBD_23_0 ECU_ADDRESS 0xd00047b6 FORMAT "%3.0" /end MEASUREMENT
/begin MEASUREMENT tbl_frf[0].envd_obd[23] "Freeze frame FRF_OBD: environmental data (fixed by law)" UBYTE _CNV_A_R_LINEAR_____0_CM 1 100. 0. 255. DISPLAY_IDENTIFIER ENVD_OBD_24_0 ECU_ADDRESS 0xd00047b7 FORMAT "%3.0" /end MEASUREMENT
/begin MEASUREMENT tbl_frf[0].envd_obd[24] "Freeze frame FRF_OBD: environmental data (fixed by law)" UBYTE _CNV_A_R_LINEAR_____0_CM 1 100. 0. 255. DISPLAY_IDENTIFIER ENVD_OBD_25_0 ECU_ADDRESS 0xd00047b8 FORMAT "%3.0" /end MEASUREMENT
/begin MEASUREMENT tbl_frf[0].envd_obd[25] "Freeze frame FRF_OBD: environmental data (fixed by law)" UBYTE _CNV_A_R_LINEAR_____0_CM 1 100. 0. 255. DISPLAY_IDENTIFIER ENVD_OBD_26_0 ECU_ADDRESS 0xd00047b9 FORMAT "%3.0" /end MEASUREMENT
/begin MEASUREMENT tbl_frf[0].envd_obd[26] "Freeze frame FRF_OBD: environmental data (fixed by law)" UBYTE _CNV_A_R_LINEAR_____0_CM 1 100. 0. 255. DISPLAY_IDENTIFIER ENVD_OBD_27_0 ECU_ADDRESS 0xd00047ba FORMAT "%3.0" /end MEASUREMENT
/begin MEASUREMENT tbl_frf[0].envd_obd[27] "Freeze frame FRF_OBD: environmental data (fixed by law)" UBYTE _CNV_A_R_LINEAR_____0_CM 1 100. 0. 255. DISPLAY_IDENTIFIER ENVD_OBD_28_0 ECU_ADDRESS 0xd00047bb FORMAT "%3.0" /end MEASUREMENT
/begin MEASUREMENT tbl_frf[0].envd_obd[28] "Freeze frame FRF_OBD: environmental data (fixed by law)" UBYTE _CNV_A_R_LINEAR_____0_CM 1 100. 0. 255. DISPLAY_IDENTIFIER ENVD_OBD_29_0 ECU_ADDRESS 0xd00047bc FORMAT "%3.0" /end MEASUREMENT
/begin MEASUREMENT tbl_frf[0].envd_obd[29] "Freeze frame FRF_OBD: environmental data (fixed by law)" UBYTE _CNV_A_R_LINEAR_____0_CM 1 100. 0. 255. DISPLAY_IDENTIFIER ENVD_OBD_30_0 ECU_ADDRESS 0xd00047bd FORMAT "%3.0" /end MEASUREMENT
/begin MEASUREMENT tbl_frf[0].envd_obd[30] "Freeze frame FRF_OBD: environmental data (fixed by law)" UBYTE _CNV_A_R_LINEAR_____0_CM 1 100. 0. 255. DISPLAY_IDENTIFIER ENVD_OBD_31_0 ECU_ADDRESS 0xd00047be FORMAT "%3.0" /end MEASUREMENT
/begin MEASUREMENT tbl_frf[0].envd_obd[31] "Freeze frame FRF_OBD: environmental data (fixed by law)" UBYTE _CNV_A_R_LINEAR_____0_CM 1 100. 0. 255. DISPLAY_IDENTIFIER ENVD_OBD_32_0 ECU_ADDRESS 0xd00047bf FORMAT "%3.0" /end MEASUREMENT
/begin MEASUREMENT tbl_frf[0].envd_obd[32] "Freeze frame FRF_OBD: environmental data (fixed by law)" UBYTE _CNV_A_R_LINEAR_____0_CM 1 100. 0. 255. DISPLAY_IDENTIFIER ENVD_OBD_33_0 ECU_ADDRESS 0xd00047c0 FORMAT "%3.0" /end MEASUREMENT
/begin MEASUREMENT tbl_frf[0].envd_obd[33] "Freeze frame FRF_OBD: environmental data (fixed by law)" UBYTE _CNV_A_R_LINEAR_____0_CM 1 100. 0. 255. DISPLAY_IDENTIFIER ENVD_OBD_34_0 ECU_ADDRESS 0xd00047c1 FORMAT "%3.0" /end MEASUREMENT
/begin MEASUREMENT tbl_frf[0].envd_obd[34] "Freeze frame FRF_OBD: environmental data (fixed by law)" UBYTE _CNV_A_R_LINEAR_____0_CM 1 100. 0. 255. DISPLAY_IDENTIFIER ENVD_OBD[34] ECU_ADDRESS 0xd00047c2 FORMAT "%3.0" /end MEASUREMENT
/begin MEASUREMENT tbl_frf[0].envd_cus_cmn[0] "Freeze frame FRF_CUS_CMN: environmental data common to all failure (not fixed by law)" UBYTE _CNV_A_R_LINEAR_____0_CM 1 100. 0. 255. DISPLAY_IDENTIFIER ENVD_CUS_CMN_1_0 ECU_ADDRESS 0xd00047c3 FORMAT "%3.0" /end MEASUREMENT
/begin MEASUREMENT tbl_frf[0].envd_cus_set_cmn[0][0] "Freeze frame FRF_CUS_SET_CMN: environmental data common to all failure (not fixed by law) stored in set" UBYTE _CNV_A_R_LINEAR_____0_CM 1 100. 0. 255. DISPLAY_IDENTIFIER ENVD_CUS_SET_CMN_1_1_0 ECU_ADDRESS 0xd00047c4 FORMAT "%3.0" /end MEASUREMENT
/begin MEASUREMENT tbl_frf[0].envd_cus_set_cmn[0][1] "Freeze frame FRF_CUS_SET_CMN: environmental data common to all failure (not fixed by law) stored in set" UBYTE _CNV_A_R_LINEAR_____0_CM 1 100. 0. 255. DISPLAY_IDENTIFIER ENVD_CUS_SET_CMN_2_1_0 ECU_ADDRESS 0xd00047c5 FORMAT "%3.0" /end MEASUREMENT
/begin MEASUREMENT tbl_frf[0].envd_cus_set_cmn[0][2] "Freeze frame FRF_CUS_SET_CMN: environmental data common to all failure (not fixed by law) stored in set" UBYTE _CNV_A_R_LINEAR_____0_CM 1 100. 0. 255. DISPLAY_IDENTIFIER ENVD_CUS_SET_CMN_3_1_0 ECU_ADDRESS 0xd00047c6 FORMAT "%3.0" /end MEASUREMENT
/begin MEASUREMENT tbl_frf[0].envd_cus_set_cmn[1][0] "Freeze frame FRF_CUS_SET_CMN: environmental data common to all failure (not fixed by law) stored in set" UBYTE _CNV_A_R_LINEAR_____0_CM 1 100. 0. 255. DISPLAY_IDENTIFIER ENVD_CUS_SET_CMN_1_2_0 ECU_ADDRESS 0xd00047c7 FORMAT "%3.0" /end MEASUREMENT
/begin MEASUREMENT tbl_frf[0].envd_cus_set_cmn[1][1] "Freeze frame FRF_CUS_SET_CMN: environmental data common to all failure (not fixed by law) stored in set" UBYTE _CNV_A_R_LINEAR_____0_CM 1 100. 0. 255. DISPLAY_IDENTIFIER ENVD_CUS_SET_CMN_2_2_0 ECU_ADDRESS 0xd00047c8 FORMAT "%3.0" /end MEASUREMENT
/begin MEASUREMENT tbl_frf[0].envd_cus_set_cmn[1][2] "Freeze frame FRF_CUS_SET_CMN: environmental data common to all failure (not fixed by law) stored in set" UBYTE _CNV_A_R_LINEAR_____0_CM 1 100. 0. 255. DISPLAY_IDENTIFIER ENVD_CUS_SET_CMN_3_2_0 ECU_ADDRESS 0xd00047c9 FORMAT "%3.0" /end MEASUREMENT
/begin MEASUREMENT tbl_frf[0].envd_cus_set_cmn[2][0] "Freeze frame FRF_CUS_SET_CMN: environmental data common to all failure (not fixed by law) stored in set" UBYTE _CNV_A_R_LINEAR_____0_CM 1 100. 0. 255. DISPLAY_IDENTIFIER ENVD_CUS_SET_CMN_1_3_0 ECU_ADDRESS 0xd00047ca FORMAT "%3.0" /end MEASUREMENT
/begin MEASUREMENT tbl_frf[0].envd_cus_set_cmn[2][1] "Freeze frame FRF_CUS_SET_CMN: environmental data common to all failure (not fixed by law) stored in set" UBYTE _CNV_A_R_LINEAR_____0_CM 1 100. 0. 255. DISPLAY_IDENTIFIER ENVD_CUS_SET_CMN_2_3_0 ECU_ADDRESS 0xd00047cb FORMAT "%3.0" /end MEASUREMENT
/begin MEASUREMENT tbl_frf[0].envd_cus_set_cmn[2][2] "Freeze frame FRF_CUS_SET_CMN: environmental data common to all failure (not fixed by law) stored in set" UBYTE _CNV_A_R_LINEAR_____0_CM 1 100. 0. 255. DISPLAY_IDENTIFIER ENVD_CUS_SET_CMN_3_3_0 ECU_ADDRESS 0xd00047cc FORMAT "%3.0" /end MEASUREMENT
/begin MEASUREMENT tbl_frf[0].envd_cus_set_spc[0][0] "Freeze frame FRF_CUS_SET_SPC: environmental data specific to each failure (not fixed by law) stored in set" UBYTE _CNV_A_R_LINEAR_____0_CM 1 100. 0. 255. DISPLAY_IDENTIFIER ENVD_CUS_SET_SPC_1_1_0 ECU_ADDRESS 0xd00047d0 FORMAT "%3.0" /end MEASUREMENT
/begin MEASUREMENT tbl_frf[0].envd_cus_set_spc[0][1] "Freeze frame FRF_CUS_SET_SPC: environmental data specific to each failure (not fixed by law) stored in set" UBYTE _CNV_A_R_LINEAR_____0_CM 1 100. 0. 255. DISPLAY_IDENTIFIER ENVD_CUS_SET_SPC_2_1_0 ECU_ADDRESS 0xd00047d1 FORMAT "%3.0" /end MEASUREMENT
/begin MEASUREMENT tbl_frf[0].envd_cus_set_spc[0][2] "Freeze frame FRF_CUS_SET_SPC: environmental data specific to each failure (not fixed by law) stored in set" UBYTE _CNV_A_R_LINEAR_____0_CM 1 100. 0. 255. DISPLAY_IDENTIFIER ENVD_CUS_SET_SPC_3_1_0 ECU_ADDRESS 0xd00047d2 FORMAT "%3.0" /end MEASUREMENT
/begin MEASUREMENT tbl_frf[0].envd_cus_set_spc[0][3] "Freeze frame FRF_CUS_SET_SPC: environmental data specific to each failure (not fixed by law) stored in set" UBYTE _CNV_A_R_LINEAR_____0_CM 1 100. 0. 255. DISPLAY_IDENTIFIER ENVD_CUS_SET_SPC_4_1_0 ECU_ADDRESS 0xd00047d3 FORMAT "%3.0" /end MEASUREMENT
/begin MEASUREMENT tbl_frf[0].envd_cus_set_spc[1][0] "Freeze frame FRF_CUS_SET_SPC: environmental data specific to each failure (not fixed by law) stored in set" UBYTE _CNV_A_R_LINEAR_____0_CM 1 100. 0. 255. DISPLAY_IDENTIFIER ENVD_CUS_SET_SPC_1_2_0 ECU_ADDRESS 0xd00047d4 FORMAT "%3.0" /end MEASUREMENT
/begin MEASUREMENT tbl_frf[0].envd_cus_set_spc[1][1] "Freeze frame FRF_CUS_SET_SPC: environmental data specific to each failure (not fixed by law) stored in set" UBYTE _CNV_A_R_LINEAR_____0_CM 1 100. 0. 255. DISPLAY_IDENTIFIER ENVD_CUS_SET_SPC_2_2_0 ECU_ADDRESS 0xd00047d5 FORMAT "%3.0" /end MEASUREMENT
/begin MEASUREMENT tbl_frf[0].envd_cus_set_spc[1][2] "Freeze frame FRF_CUS_SET_SPC: environmental data specific to each failure (not fixed by law) stored in set" UBYTE _CNV_A_R_LINEAR_____0_CM 1 100. 0. 255. DISPLAY_IDENTIFIER ENVD_CUS_SET_SPC_3_2_0 ECU_ADDRESS 0xd00047d6 FORMAT "%3.0" /end MEASUREMENT
/begin MEASUREMENT tbl_frf[0].envd_cus_set_spc[1][3] "Freeze frame FRF_CUS_SET_SPC: environmental data specific to each failure (not fixed by law) stored in set" UBYTE _CNV_A_R_LINEAR_____0_CM 1 100. 0. 255. DISPLAY_IDENTIFIER ENVD_CUS_SET_SPC_4_2_0 ECU_ADDRESS 0xd00047d7 FORMAT "%3.0" /end MEASUREMENT
/begin MEASUREMENT tbl_frf[0].envd_cus_set_spc[2][0] "Freeze frame FRF_CUS_SET_SPC: environmental data specific to each failure (not fixed by law) stored in set" UBYTE _CNV_A_R_LINEAR_____0_CM 1 100. 0. 255. DISPLAY_IDENTIFIER ENVD_CUS_SET_SPC_1_3_0 ECU_ADDRESS 0xd00047d8 FORMAT "%3.0" /end MEASUREMENT
/begin MEASUREMENT tbl_frf[0].envd_cus_set_spc[2][1] "Freeze frame FRF_CUS_SET_SPC: environmental data specific to each failure (not fixed by law) stored in set" UBYTE _CNV_A_R_LINEAR_____0_CM 1 100. 0. 255. DISPLAY_IDENTIFIER ENVD_CUS_SET_SPC_2_3_0 ECU_ADDRESS 0xd00047d9 FORMAT "%3.0" /end MEASUREMENT
/begin MEASUREMENT tbl_frf[0].envd_cus_set_spc[2][2] "Freeze frame FRF_CUS_SET_SPC: environmental data specific to each failure (not fixed by law) stored in set" UBYTE _CNV_A_R_LINEAR_____0_CM 1 100. 0. 255. DISPLAY_IDENTIFIER ENVD_CUS_SET_SPC_3_3_0 ECU_ADDRESS 0xd00047da FORMAT "%3.0" /end MEASUREMENT
/begin MEASUREMENT tbl_frf[0].envd_cus_set_spc[2][3] "Freeze frame FRF_CUS_SET_SPC: environmental data specific to each failure (not fixed by law) stored in set" UBYTE _CNV_A_R_LINEAR_____0_CM 1 100. 0. 255. DISPLAY_IDENTIFIER ENVD_CUS_SET_SPC_4_3_0 ECU_ADDRESS 0xd00047db FORMAT "%3.0" /end MEASUREMENT
/begin MEASUREMENT tbl_frf[1].envd_obd[0] "Freeze frame FRF_OBD: environmental data (fixed by law)" UBYTE _CNV_A_R_LINEAR_____0_CM 1 100. 0. 255. DISPLAY_IDENTIFIER ENVD_OBD_1_1 ECU_ADDRESS 0xd00047e0 FORMAT "%3.0" /end MEASUREMENT
/begin MEASUREMENT tbl_frf[1].envd_obd[1] "Freeze frame FRF_OBD: environmental data (fixed by law)" UBYTE _CNV_A_R_LINEAR_____0_CM 1 100. 0. 255. DISPLAY_IDENTIFIER ENVD_OBD_2_1 ECU_ADDRESS 0xd00047e1 FORMAT "%3.0" /end MEASUREMENT
/begin MEASUREMENT tbl_frf[1].envd_obd[2] "Freeze frame FRF_OBD: environmental data (fixed by law)" UBYTE _CNV_A_R_LINEAR_____0_CM 1 100. 0. 255. DISPLAY_IDENTIFIER ENVD_OBD_3_1 ECU_ADDRESS 0xd00047e2 FORMAT "%3.0" /end MEASUREMENT
/begin MEASUREMENT tbl_frf[1].envd_obd[3] "Freeze frame FRF_OBD: environmental data (fixed by law)" UBYTE _CNV_A_R_LINEAR_____0_CM 1 100. 0. 255. DISPLAY_IDENTIFIER ENVD_OBD_4_1 ECU_ADDRESS 0xd00047e3 FORMAT "%3.0" /end MEASUREMENT
/begin MEASUREMENT tbl_frf[1].envd_obd[4] "Freeze frame FRF_OBD: environmental data (fixed by law)" UBYTE _CNV_A_R_LINEAR_____0_CM 1 100. 0. 255. DISPLAY_IDENTIFIER ENVD_OBD_5_1 ECU_ADDRESS 0xd00047e4 FORMAT "%3.0" /end MEASUREMENT
/begin MEASUREMENT tbl_frf[1].envd_obd[5] "Freeze frame FRF_OBD: environmental data (fixed by law)" UBYTE _CNV_A_R_LINEAR_____0_CM 1 100. 0. 255. DISPLAY_IDENTIFIER ENVD_OBD_6_1 ECU_ADDRESS 0xd00047e5 FORMAT "%3.0" /end MEASUREMENT
/begin MEASUREMENT tbl_frf[1].envd_obd[6] "Freeze frame FRF_OBD: environmental data (fixed by law)" UBYTE _CNV_A_R_LINEAR_____0_CM 1 100. 0. 255. DISPLAY_IDENTIFIER ENVD_OBD_7_1 ECU_ADDRESS 0xd00047e6 FORMAT "%3.0" /end MEASUREMENT
/begin MEASUREMENT tbl_frf[1].envd_obd[7] "Freeze frame FRF_OBD: environmental data (fixed by law)" UBYTE _CNV_A_R_LINEAR_____0_CM 1 100. 0. 255. DISPLAY_IDENTIFIER ENVD_OBD_8_1 ECU_ADDRESS 0xd00047e7 FORMAT "%3.0" /end MEASUREMENT
/begin MEASUREMENT tbl_frf[1].envd_obd[8] "Freeze frame FRF_OBD: environmental data (fixed by law)" UBYTE _CNV_A_R_LINEAR_____0_CM 1 100. 0. 255. DISPLAY_IDENTIFIER ENVD_OBD_9_1 ECU_ADDRESS 0xd00047e8 FORMAT "%3.0" /end MEASUREMENT
/begin MEASUREMENT tbl_frf[1].envd_obd[9] "Freeze frame FRF_OBD: environmental data (fixed by law)" UBYTE _CNV_A_R_LINEAR_____0_CM 1 100. 0. 255. DISPLAY_IDENTIFIER ENVD_OBD_10_1 ECU_ADDRESS 0xd00047e9 FORMAT "%3.0" /end MEASUREMENT
/begin MEASUREMENT tbl_frf[1].envd_obd[10] "Freeze frame FRF_OBD: environmental data (fixed by law)" UBYTE _CNV_A_R_LINEAR_____0_CM 1 100. 0. 255. DISPLAY_IDENTIFIER ENVD_OBD_11_1 ECU_ADDRESS 0xd00047ea FORMAT "%3.0" /end MEASUREMENT
/begin MEASUREMENT tbl_frf[1].envd_obd[11] "Freeze frame FRF_OBD: environmental data (fixed by law)" UBYTE _CNV_A_R_LINEAR_____0_CM 1 100. 0. 255. DISPLAY_IDENTIFIER ENVD_OBD_12_1 ECU_ADDRESS 0xd00047eb FORMAT "%3.0" /end MEASUREMENT
/begin MEASUREMENT tbl_frf[1].envd_obd[12] "Freeze frame FRF_OBD: environmental data (fixed by law)" UBYTE _CNV_A_R_LINEAR_____0_CM 1 100. 0. 255. DISPLAY_IDENTIFIER ENVD_OBD_13_1 ECU_ADDRESS 0xd00047ec FORMAT "%3.0" /end MEASUREMENT
/begin MEASUREMENT tbl_frf[1].envd_obd[13] "Freeze frame FRF_OBD: environmental data (fixed by law)" UBYTE _CNV_A_R_LINEAR_____0_CM 1 100. 0. 255. DISPLAY_IDENTIFIER ENVD_OBD_14_1 ECU_ADDRESS 0xd00047ed FORMAT "%3.0" /end MEASUREMENT
/begin MEASUREMENT tbl_frf[1].envd_obd[14] "Freeze frame FRF_OBD: environmental data (fixed by law)" UBYTE _CNV_A_R_LINEAR_____0_CM 1 100. 0. 255. DISPLAY_IDENTIFIER ENVD_OBD_15_1 ECU_ADDRESS 0xd00047ee FORMAT "%3.0" /end MEASUREMENT
/begin MEASUREMENT tbl_frf[1].envd_obd[15] "Freeze frame FRF_OBD: environmental data (fixed by law)" UBYTE _CNV_A_R_LINEAR_____0_CM 1 100. 0. 255. DISPLAY_IDENTIFIER ENVD_OBD_16_1 ECU_ADDRESS 0xd00047ef FORMAT "%3.0" /end MEASUREMENT
/begin MEASUREMENT tbl_frf[1].envd_obd[16] "Freeze frame FRF_OBD: environmental data (fixed by law)" UBYTE _CNV_A_R_LINEAR_____0_CM 1 100. 0. 255. DISPLAY_IDENTIFIER ENVD_OBD_17_1 ECU_ADDRESS 0xd00047f0 FORMAT "%3.0" /end MEASUREMENT
/begin MEASUREMENT tbl_frf[1].envd_obd[17] "Freeze frame FRF_OBD: environmental data (fixed by law)" UBYTE _CNV_A_R_LINEAR_____0_CM 1 100. 0. 255. DISPLAY_IDENTIFIER ENVD_OBD_18_1 ECU_ADDRESS 0xd00047f1 FORMAT "%3.0" /end MEASUREMENT
/begin MEASUREMENT tbl_frf[1].envd_obd[18] "Freeze frame FRF_OBD: environmental data (fixed by law)" UBYTE _CNV_A_R_LINEAR_____0_CM 1 100. 0. 255. DISPLAY_IDENTIFIER ENVD_OBD_19_1 ECU_ADDRESS 0xd00047f2 FORMAT "%3.0" /end MEASUREMENT
/begin MEASUREMENT tbl_frf[1].envd_obd[19] "Freeze frame FRF_OBD: environmental data (fixed by law)" UBYTE _CNV_A_R_LINEAR_____0_CM 1 100. 0. 255. DISPLAY_IDENTIFIER ENVD_OBD_20_1 ECU_ADDRESS 0xd00047f3 FORMAT "%3.0" /end MEASUREMENT
/begin MEASUREMENT tbl_frf[1].envd_obd[20] "Freeze frame FRF_OBD: environmental data (fixed by law)" UBYTE _CNV_A_R_LINEAR_____0_CM 1 100. 0. 255. DISPLAY_IDENTIFIER ENVD_OBD_21_1 ECU_ADDRESS 0xd00047f4 FORMAT "%3.0" /end MEASUREMENT
/begin MEASUREMENT tbl_frf[1].envd_obd[21] "Freeze frame FRF_OBD: environmental data (fixed by law)" UBYTE _CNV_A_R_LINEAR_____0_CM 1 100. 0. 255. DISPLAY_IDENTIFIER ENVD_OBD_22_1 ECU_ADDRESS 0xd00047f5 FORMAT "%3.0" /end MEASUREMENT
/begin MEASUREMENT tbl_frf[1].envd_obd[22] "Freeze frame FRF_OBD: environmental data (fixed by law)" UBYTE _CNV_A_R_LINEAR_____0_CM 1 100. 0. 255. DISPLAY_IDENTIFIER ENVD_OBD_23_1 ECU_ADDRESS 0xd00047f6 FORMAT "%3.0" /end MEASUREMENT
/begin MEASUREMENT tbl_frf[1].envd_obd[23] "Freeze frame FRF_OBD: environmental data (fixed by law)" UBYTE _CNV_A_R_LINEAR_____0_CM 1 100. 0. 255. DISPLAY_IDENTIFIER ENVD_OBD_24_1 ECU_ADDRESS 0xd00047f7 FORMAT "%3.0" /end MEASUREMENT
/begin MEASUREMENT tbl_frf[1].envd_obd[24] "Freeze frame FRF_OBD: environmental data (fixed by law)" UBYTE _CNV_A_R_LINEAR_____0_CM 1 100. 0. 255. DISPLAY_IDENTIFIER ENVD_OBD_25_1 ECU_ADDRESS 0xd00047f8 FORMAT "%3.0" /end MEASUREMENT
/begin MEASUREMENT tbl_frf[1].envd_obd[25] "Freeze frame FRF_OBD: environmental data (fixed by law)" UBYTE _CNV_A_R_LINEAR_____0_CM 1 100. 0. 255. DISPLAY_IDENTIFIER ENVD_OBD_26_1 ECU_ADDRESS 0xd00047f9 FORMAT "%3.0" /end MEASUREMENT
/begin MEASUREMENT tbl_frf[1].envd_obd[26] "Freeze frame FRF_OBD: environmental data (fixed by law)" UBYTE _CNV_A_R_LINEAR_____0_CM 1 100. 0. 255. DISPLAY_IDENTIFIER ENVD_OBD_27_1 ECU_ADDRESS 0xd00047fa FORMAT "%3.0" /end MEASUREMENT
/begin MEASUREMENT tbl_frf[1].envd_obd[27] "Freeze frame FRF_OBD: environmental data (fixed by law)" UBYTE _CNV_A_R_LINEAR_____0_CM 1 100. 0. 255. DISPLAY_IDENTIFIER ENVD_OBD_28_1 ECU_ADDRESS 0xd00047fb FORMAT "%3.0" /end MEASUREMENT
/begin MEASUREMENT tbl_frf[1].envd_obd[28] "Freeze frame FRF_OBD: environmental data (fixed by law)" UBYTE _CNV_A_R_LINEAR_____0_CM 1 100. 0. 255. DISPLAY_IDENTIFIER ENVD_OBD_29_1 ECU_ADDRESS 0xd00047fc FORMAT "%3.0" /end MEASUREMENT
/begin MEASUREMENT tbl_frf[1].envd_obd[29] "Freeze frame FRF_OBD: environmental data (fixed by law)" UBYTE _CNV_A_R_LINEAR_____0_CM 1 100. 0. 255. DISPLAY_IDENTIFIER ENVD_OBD_30_1 ECU_ADDRESS 0xd00047fd FORMAT "%3.0" /end MEASUREMENT
/begin MEASUREMENT tbl_frf[1].envd_obd[30] "Freeze frame FRF_OBD: environmental data (fixed by law)" UBYTE _CNV_A_R_LINEAR_____0_CM 1 100. 0. 255. DISPLAY_IDENTIFIER ENVD_OBD_31_1 ECU_ADDRESS 0xd00047fe FORMAT "%3.0" /end MEASUREMENT
/begin MEASUREMENT tbl_frf[1].envd_obd[31] "Freeze frame FRF_OBD: environmental data (fixed by law)" UBYTE _CNV_A_R_LINEAR_____0_CM 1 100. 0. 255. DISPLAY_IDENTIFIER ENVD_OBD_32_1 ECU_ADDRESS 0xd00047ff FORMAT "%3.0" /end MEASUREMENT
/begin MEASUREMENT tbl_frf[1].envd_obd[32] "Freeze frame FRF_OBD: environmental data (fixed by law)" UBYTE _CNV_A_R_LINEAR_____0_CM 1 100. 0. 255. DISPLAY_IDENTIFIER ENVD_OBD_33_1 ECU_ADDRESS 0xd0004800 FORMAT "%3.0" /end MEASUREMENT
/begin MEASUREMENT tbl_frf[1].envd_obd[33] "Freeze frame FRF_OBD: environmental data (fixed by law)" UBYTE _CNV_A_R_LINEAR_____0_CM 1 100. 0. 255. DISPLAY_IDENTIFIER ENVD_OBD_34_1 ECU_ADDRESS 0xd0004801 FORMAT "%3.0" /end MEASUREMENT
/begin MEASUREMENT tbl_frf[1].envd_obd[34] "Freeze frame FRF_OBD: environmental data (fixed by law)" UBYTE _CNV_A_R_LINEAR_____0_CM 1 100. 0. 255. DISPLAY_IDENTIFIER ENVD_OBD[34] ECU_ADDRESS 0xd0004802 FORMAT "%3.0" /end MEASUREMENT
/begin MEASUREMENT tbl_frf[1].envd_cus_cmn[0] "Freeze frame FRF_CUS_CMN: environmental data common to all failure (not fixed by law)" UBYTE _CNV_A_R_LINEAR_____0_CM 1 100. 0. 255. DISPLAY_IDENTIFIER ENVD_CUS_CMN_1_1 ECU_ADDRESS 0xd0004803 FORMAT "%3.0" /end MEASUREMENT
/begin MEASUREMENT tbl_frf[1].envd_cus_set_cmn[0][0] "Freeze frame FRF_CUS_SET_CMN: environmental data common to all failure (not fixed by law) stored in set" UBYTE _CNV_A_R_LINEAR_____0_CM 1 100. 0. 255. DISPLAY_IDENTIFIER ENVD_CUS_SET_CMN_1_1_1 ECU_ADDRESS 0xd0004804 FORMAT "%3.0" /end MEASUREMENT
/begin MEASUREMENT tbl_frf[1].envd_cus_set_cmn[0][1] "Freeze frame FRF_CUS_SET_CMN: environmental data common to all failure (not fixed by law) stored in set" UBYTE _CNV_A_R_LINEAR_____0_CM 1 100. 0. 255. DISPLAY_IDENTIFIER ENVD_CUS_SET_CMN_2_1_1 ECU_ADDRESS 0xd0004805 FORMAT "%3.0" /end MEASUREMENT
/begin MEASUREMENT tbl_frf[1].envd_cus_set_cmn[0][2] "Freeze frame FRF_CUS_SET_CMN: environmental data common to all failure (not fixed by law) stored in set" UBYTE _CNV_A_R_LINEAR_____0_CM 1 100. 0. 255. DISPLAY_IDENTIFIER ENVD_CUS_SET_CMN_3_1_1 ECU_ADDRESS 0xd0004806 FORMAT "%3.0" /end MEASUREMENT
/begin MEASUREMENT tbl_frf[1].envd_cus_set_cmn[1][0] "Freeze frame FRF_CUS_SET_CMN: environmental data common to all failure (not fixed by law) stored in set" UBYTE _CNV_A_R_LINEAR_____0_CM 1 100. 0. 255. DISPLAY_IDENTIFIER ENVD_CUS_SET_CMN_1_0_ ECU_ADDRESS 0xd0004807 FORMAT "%3.0" /end MEASUREMENT
/begin MEASUREMENT tbl_frf[1].envd_cus_set_cmn[1][1] "Freeze frame FRF_CUS_SET_CMN: environmental data common to all failure (not fixed by law) stored in set" UBYTE _CNV_A_R_LINEAR_____0_CM 1 100. 0. 255. DISPLAY_IDENTIFIER ENVD_CUS_SET_CMN_1_1_ ECU_ADDRESS 0xd0004808 FORMAT "%3.0" /end MEASUREMENT
/begin MEASUREMENT tbl_frf[1].envd_cus_set_cmn[1][2] "Freeze frame FRF_CUS_SET_CMN: environmental data common to all failure (not fixed by law) stored in set" UBYTE _CNV_A_R_LINEAR_____0_CM 1 100. 0. 255. DISPLAY_IDENTIFIER ENVD_CUS_SET_CMN_1_2_ ECU_ADDRESS 0xd0004809 FORMAT "%3.0" /end MEASUREMENT
/begin MEASUREMENT tbl_frf[1].envd_cus_set_cmn[2][0] "Freeze frame FRF_CUS_SET_CMN: environmental data common to all failure (not fixed by law) stored in set" UBYTE _CNV_A_R_LINEAR_____0_CM 1 100. 0. 255. DISPLAY_IDENTIFIER ENVD_CUS_SET_CMN_2_0_ ECU_ADDRESS 0xd000480a FORMAT "%3.0" /end MEASUREMENT
/begin MEASUREMENT tbl_frf[1].envd_cus_set_cmn[2][1] "Freeze frame FRF_CUS_SET_CMN: environmental data common to all failure (not fixed by law) stored in set" UBYTE _CNV_A_R_LINEAR_____0_CM 1 100. 0. 255. DISPLAY_IDENTIFIER ENVD_CUS_SET_CMN_2_1_ ECU_ADDRESS 0xd000480b FORMAT "%3.0" /end MEASUREMENT
/begin MEASUREMENT tbl_frf[1].envd_cus_set_cmn[2][2] "Freeze frame FRF_CUS_SET_CMN: environmental data common to all failure (not fixed by law) stored in set" UBYTE _CNV_A_R_LINEAR_____0_CM 1 100. 0. 255. DISPLAY_IDENTIFIER ENVD_CUS_SET_CMN_2_2_ ECU_ADDRESS 0xd000480c FORMAT "%3.0" /end MEASUREMENT
/begin MEASUREMENT tbl_frf[1].envd_cus_set_spc[0][0] "Freeze frame FRF_CUS_SET_SPC: environmental data specific to each failure (not fixed by law) stored in set" UBYTE _CNV_A_R_LINEAR_____0_CM 1 100. 0. 255. DISPLAY_IDENTIFIER ENVD_CUS_SET_SPC_1_1_1 ECU_ADDRESS 0xd0004810 FORMAT "%3.0" /end MEASUREMENT
/begin MEASUREMENT tbl_frf[1].envd_cus_set_spc[0][1] "Freeze frame FRF_CUS_SET_SPC: environmental data specific to each failure (not fixed by law) stored in set" UBYTE _CNV_A_R_LINEAR_____0_CM 1 100. 0. 255. DISPLAY_IDENTIFIER ENVD_CUS_SET_SPC_2_1_1 ECU_ADDRESS 0xd0004811 FORMAT "%3.0" /end MEASUREMENT
/begin MEASUREMENT tbl_frf[1].envd_cus_set_spc[0][2] "Freeze frame FRF_CUS_SET_SPC: environmental data specific to each failure (not fixed by law) stored in set" UBYTE _CNV_A_R_LINEAR_____0_CM 1 100. 0. 255. DISPLAY_IDENTIFIER ENVD_CUS_SET_SPC_3_1_1 ECU_ADDRESS 0xd0004812 FORMAT "%3.0" /end MEASUREMENT
/begin MEASUREMENT tbl_frf[1].envd_cus_set_spc[0][3] "Freeze frame FRF_CUS_SET_SPC: environmental data specific to each failure (not fixed by law) stored in set" UBYTE _CNV_A_R_LINEAR_____0_CM 1 100. 0. 255. DISPLAY_IDENTIFIER ENVD_CUS_SET_SPC_4_1_1 ECU_ADDRESS 0xd0004813 FORMAT "%3.0" /end MEASUREMENT
/begin MEASUREMENT tbl_frf[1].envd_cus_set_spc[1][0] "Freeze frame FRF_CUS_SET_SPC: environmental data specific to each failure (not fixed by law) stored in set" UBYTE _CNV_A_R_LINEAR_____0_CM 1 100. 0. 255. DISPLAY_IDENTIFIER ENVD_CUS_SET_SPC_1_0_ ECU_ADDRESS 0xd0004814 FORMAT "%3.0" /end MEASUREMENT
/begin MEASUREMENT tbl_frf[1].envd_cus_set_spc[1][1] "Freeze frame FRF_CUS_SET_SPC: environmental data specific to each failure (not fixed by law) stored in set" UBYTE _CNV_A_R_LINEAR_____0_CM 1 100. 0. 255. DISPLAY_IDENTIFIER ENVD_CUS_SET_SPC_1_1_ ECU_ADDRESS 0xd0004815 FORMAT "%3.0" /end MEASUREMENT
/begin MEASUREMENT tbl_frf[1].envd_cus_set_spc[1][2] "Freeze frame FRF_CUS_SET_SPC: environmental data specific to each failure (not fixed by law) stored in set" UBYTE _CNV_A_R_LINEAR_____0_CM 1 100. 0. 255. DISPLAY_IDENTIFIER ENVD_CUS_SET_SPC_1_2_ ECU_ADDRESS 0xd0004816 FORMAT "%3.0" /end MEASUREMENT
/begin MEASUREMENT tbl_frf[1].envd_cus_set_spc[1][3] "Freeze frame FRF_CUS_SET_SPC: environmental data specific to each failure (not fixed by law) stored in set" UBYTE _CNV_A_R_LINEAR_____0_CM 1 100. 0. 255. DISPLAY_IDENTIFIER ENVD_CUS_SET_SPC_1_3_ ECU_ADDRESS 0xd0004817 FORMAT "%3.0" /end MEASUREMENT
/begin MEASUREMENT tbl_frf[1].envd_cus_set_spc[2][0] "Freeze frame FRF_CUS_SET_SPC: environmental data specific to each failure (not fixed by law) stored in set" UBYTE _CNV_A_R_LINEAR_____0_CM 1 100. 0. 255. DISPLAY_IDENTIFIER ENVD_CUS_SET_SPC_2_0_ ECU_ADDRESS 0xd0004818 FORMAT "%3.0" /end MEASUREMENT
/begin MEASUREMENT tbl_frf[1].envd_cus_set_spc[2][1] "Freeze frame FRF_CUS_SET_SPC: environmental data specific to each failure (not fixed by law) stored in set" UBYTE _CNV_A_R_LINEAR_____0_CM 1 100. 0. 255. DISPLAY_IDENTIFIER ENVD_CUS_SET_SPC_2_1_ ECU_ADDRESS 0xd0004819 FORMAT "%3.0" /end MEASUREMENT
/begin MEASUREMENT tbl_frf[1].envd_cus_set_spc[2][2] "Freeze frame FRF_CUS_SET_SPC: environmental data specific to each failure (not fixed by law) stored in set" UBYTE _CNV_A_R_LINEAR_____0_CM 1 100. 0. 255. DISPLAY_IDENTIFIER ENVD_CUS_SET_SPC_2_2_ ECU_ADDRESS 0xd000481a FORMAT "%3.0" /end MEASUREMENT
/begin MEASUREMENT tbl_frf[1].envd_cus_set_spc[2][3] "Freeze frame FRF_CUS_SET_SPC: environmental data specific to each failure (not fixed by law) stored in set" UBYTE _CNV_A_R_LINEAR_____0_CM 1 100. 0. 255. DISPLAY_IDENTIFIER ENVD_CUS_SET_SPC_2_3_ ECU_ADDRESS 0xd000481b FORMAT "%3.0" /end MEASUREMENT
/begin MEASUREMENT tbl_frf[2].envd_obd[0] "Freeze frame FRF_OBD: environmental data (fixed by law)" UBYTE _CNV_A_R_LINEAR_____0_CM 1 100. 0. 255. DISPLAY_IDENTIFIER ENVD_OBD_1_2 ECU_ADDRESS 0xd0004820 FORMAT "%3.0" /end MEASUREMENT
/begin MEASUREMENT tbl_frf[2].envd_obd[1] "Freeze frame FRF_OBD: environmental data (fixed by law)" UBYTE _CNV_A_R_LINEAR_____0_CM 1 100. 0. 255. DISPLAY_IDENTIFIER ENVD_OBD_2_2 ECU_ADDRESS 0xd0004821 FORMAT "%3.0" /end MEASUREMENT
/begin MEASUREMENT tbl_frf[2].envd_obd[2] "Freeze frame FRF_OBD: environmental data (fixed by law)" UBYTE _CNV_A_R_LINEAR_____0_CM 1 100. 0. 255. DISPLAY_IDENTIFIER ENVD_OBD_3_2 ECU_ADDRESS 0xd0004822 FORMAT "%3.0" /end MEASUREMENT
/begin MEASUREMENT tbl_frf[2].envd_obd[3] "Freeze frame FRF_OBD: environmental data (fixed by law)" UBYTE _CNV_A_R_LINEAR_____0_CM 1 100. 0. 255. DISPLAY_IDENTIFIER ENVD_OBD_4_2 ECU_ADDRESS 0xd0004823 FORMAT "%3.0" /end MEASUREMENT
/begin MEASUREMENT tbl_frf[2].envd_obd[4] "Freeze frame FRF_OBD: environmental data (fixed by law)" UBYTE _CNV_A_R_LINEAR_____0_CM 1 100. 0. 255. DISPLAY_IDENTIFIER ENVD_OBD_5_2 ECU_ADDRESS 0xd0004824 FORMAT "%3.0" /end MEASUREMENT
/begin MEASUREMENT tbl_frf[2].envd_obd[5] "Freeze frame FRF_OBD: environmental data (fixed by law)" UBYTE _CNV_A_R_LINEAR_____0_CM 1 100. 0. 255. DISPLAY_IDENTIFIER ENVD_OBD_6_2 ECU_ADDRESS 0xd0004825 FORMAT "%3.0" /end MEASUREMENT
/begin MEASUREMENT tbl_frf[2].envd_obd[6] "Freeze frame FRF_OBD: environmental data (fixed by law)" UBYTE _CNV_A_R_LINEAR_____0_CM 1 100. 0. 255. DISPLAY_IDENTIFIER ENVD_OBD_7_2 ECU_ADDRESS 0xd0004826 FORMAT "%3.0" /end MEASUREMENT
/begin MEASUREMENT tbl_frf[2].envd_obd[7] "Freeze frame FRF_OBD: environmental data (fixed by law)" UBYTE _CNV_A_R_LINEAR_____0_CM 1 100. 0. 255. DISPLAY_IDENTIFIER ENVD_OBD_8_2 ECU_ADDRESS 0xd0004827 FORMAT "%3.0" /end MEASUREMENT
/begin MEASUREMENT tbl_frf[2].envd_obd[8] "Freeze frame FRF_OBD: environmental data (fixed by law)" UBYTE _CNV_A_R_LINEAR_____0_CM 1 100. 0. 255. DISPLAY_IDENTIFIER ENVD_OBD_9_2 ECU_ADDRESS 0xd0004828 FORMAT "%3.0" /end MEASUREMENT
/begin MEASUREMENT tbl_frf[2].envd_obd[9] "Freeze frame FRF_OBD: environmental data (fixed by law)" UBYTE _CNV_A_R_LINEAR_____0_CM 1 100. 0. 255. DISPLAY_IDENTIFIER ENVD_OBD_10_2 ECU_ADDRESS 0xd0004829 FORMAT "%3.0" /end MEASUREMENT
/begin MEASUREMENT tbl_frf[2].envd_obd[10] "Freeze frame FRF_OBD: environmental data (fixed by law)" UBYTE _CNV_A_R_LINEAR_____0_CM 1 100. 0. 255. DISPLAY_IDENTIFIER ENVD_OBD_11_2 ECU_ADDRESS 0xd000482a FORMAT "%3.0" /end MEASUREMENT
/begin MEASUREMENT tbl_frf[2].envd_obd[11] "Freeze frame FRF_OBD: environmental data (fixed by law)" UBYTE _CNV_A_R_LINEAR_____0_CM 1 100. 0. 255. DISPLAY_IDENTIFIER ENVD_OBD_12_2 ECU_ADDRESS 0xd000482b FORMAT "%3.0" /end MEASUREMENT
/begin MEASUREMENT tbl_frf[2].envd_obd[12] "Freeze frame FRF_OBD: environmental data (fixed by law)" UBYTE _CNV_A_R_LINEAR_____0_CM 1 100. 0. 255. DISPLAY_IDENTIFIER ENVD_OBD_13_2 ECU_ADDRESS 0xd000482c FORMAT "%3.0" /end MEASUREMENT
/begin MEASUREMENT tbl_frf[2].envd_obd[13] "Freeze frame FRF_OBD: environmental data (fixed by law)" UBYTE _CNV_A_R_LINEAR_____0_CM 1 100. 0. 255. DISPLAY_IDENTIFIER ENVD_OBD_14_2 ECU_ADDRESS 0xd000482d FORMAT "%3.0" /end MEASUREMENT
/begin MEASUREMENT tbl_frf[2].envd_obd[14] "Freeze frame FRF_OBD: environmental data (fixed by law)" UBYTE _CNV_A_R_LINEAR_____0_CM 1 100. 0. 255. DISPLAY_IDENTIFIER ENVD_OBD_15_2 ECU_ADDRESS 0xd000482e FORMAT "%3.0" /end MEASUREMENT
/begin MEASUREMENT tbl_frf[2].envd_obd[15] "Freeze frame FRF_OBD: environmental data (fixed by law)" UBYTE _CNV_A_R_LINEAR_____0_CM 1 100. 0. 255. DISPLAY_IDENTIFIER ENVD_OBD_16_2 ECU_ADDRESS 0xd000482f FORMAT "%3.0" /end MEASUREMENT
/begin MEASUREMENT tbl_frf[2].envd_obd[16] "Freeze frame FRF_OBD: environmental data (fixed by law)" UBYTE _CNV_A_R_LINEAR_____0_CM 1 100. 0. 255. DISPLAY_IDENTIFIER ENVD_OBD_17_2 ECU_ADDRESS 0xd0004830 FORMAT "%3.0" /end MEASUREMENT
/begin MEASUREMENT tbl_frf[2].envd_obd[17] "Freeze frame FRF_OBD: environmental data (fixed by law)" UBYTE _CNV_A_R_LINEAR_____0_CM 1 100. 0. 255. DISPLAY_IDENTIFIER ENVD_OBD_18_2 ECU_ADDRESS 0xd0004831 FORMAT "%3.0" /end MEASUREMENT
/begin MEASUREMENT tbl_frf[2].envd_obd[18] "Freeze frame FRF_OBD: environmental data (fixed by law)" UBYTE _CNV_A_R_LINEAR_____0_CM 1 100. 0. 255. DISPLAY_IDENTIFIER ENVD_OBD_19_2 ECU_ADDRESS 0xd0004832 FORMAT "%3.0" /end MEASUREMENT
/begin MEASUREMENT tbl_frf[2].envd_obd[19] "Freeze frame FRF_OBD: environmental data (fixed by law)" UBYTE _CNV_A_R_LINEAR_____0_CM 1 100. 0. 255. DISPLAY_IDENTIFIER ENVD_OBD_20_2 ECU_ADDRESS 0xd0004833 FORMAT "%3.0" /end MEASUREMENT
/begin MEASUREMENT tbl_frf[2].envd_obd[20] "Freeze frame FRF_OBD: environmental data (fixed by law)" UBYTE _CNV_A_R_LINEAR_____0_CM 1 100. 0. 255. DISPLAY_IDENTIFIER ENVD_OBD_21_2 ECU_ADDRESS 0xd0004834 FORMAT "%3.0" /end MEASUREMENT
/begin MEASUREMENT tbl_frf[2].envd_obd[21] "Freeze frame FRF_OBD: environmental data (fixed by law)" UBYTE _CNV_A_R_LINEAR_____0_CM 1 100. 0. 255. DISPLAY_IDENTIFIER ENVD_OBD_22_2 ECU_ADDRESS 0xd0004835 FORMAT "%3.0" /end MEASUREMENT
/begin MEASUREMENT tbl_frf[2].envd_obd[22] "Freeze frame FRF_OBD: environmental data (fixed by law)" UBYTE _CNV_A_R_LINEAR_____0_CM 1 100. 0. 255. DISPLAY_IDENTIFIER ENVD_OBD_23_2 ECU_ADDRESS 0xd0004836 FORMAT "%3.0" /end MEASUREMENT
/begin MEASUREMENT tbl_frf[2].envd_obd[23] "Freeze frame FRF_OBD: environmental data (fixed by law)" UBYTE _CNV_A_R_LINEAR_____0_CM 1 100. 0. 255. DISPLAY_IDENTIFIER ENVD_OBD_24_2 ECU_ADDRESS 0xd0004837 FORMAT "%3.0" /end MEASUREMENT
/begin MEASUREMENT tbl_frf[2].envd_obd[24] "Freeze frame FRF_OBD: environmental data (fixed by law)" UBYTE _CNV_A_R_LINEAR_____0_CM 1 100. 0. 255. DISPLAY_IDENTIFIER ENVD_OBD_25_2 ECU_ADDRESS 0xd0004838 FORMAT "%3.0" /end MEASUREMENT
/begin MEASUREMENT tbl_frf[2].envd_obd[25] "Freeze frame FRF_OBD: environmental data (fixed by law)" UBYTE _CNV_A_R_LINEAR_____0_CM 1 100. 0. 255. DISPLAY_IDENTIFIER ENVD_OBD_26_2 ECU_ADDRESS 0xd0004839 FORMAT "%3.0" /end MEASUREMENT
/begin MEASUREMENT tbl_frf[2].envd_obd[26] "Freeze frame FRF_OBD: environmental data (fixed by law)" UBYTE _CNV_A_R_LINEAR_____0_CM 1 100. 0. 255. DISPLAY_IDENTIFIER ENVD_OBD_27_2 ECU_ADDRESS 0xd000483a FORMAT "%3.0" /end MEASUREMENT
/begin MEASUREMENT tbl_frf[2].envd_obd[27] "Freeze frame FRF_OBD: environmental data (fixed by law)" UBYTE _CNV_A_R_LINEAR_____0_CM 1 100. 0. 255. DISPLAY_IDENTIFIER ENVD_OBD_28_2 ECU_ADDRESS 0xd000483b FORMAT "%3.0" /end MEASUREMENT
/begin MEASUREMENT tbl_frf[2].envd_obd[28] "Freeze frame FRF_OBD: environmental data (fixed by law)" UBYTE _CNV_A_R_LINEAR_____0_CM 1 100. 0. 255. DISPLAY_IDENTIFIER ENVD_OBD_29_2 ECU_ADDRESS 0xd000483c FORMAT "%3.0" /end MEASUREMENT
/begin MEASUREMENT tbl_frf[2].envd_obd[29] "Freeze frame FRF_OBD: environmental data (fixed by law)" UBYTE _CNV_A_R_LINEAR_____0_CM 1 100. 0. 255. DISPLAY_IDENTIFIER ENVD_OBD_30_2 ECU_ADDRESS 0xd000483d FORMAT "%3.0" /end MEASUREMENT
/begin MEASUREMENT tbl_frf[2].envd_obd[30] "Freeze frame FRF_OBD: environmental data (fixed by law)" UBYTE _CNV_A_R_LINEAR_____0_CM 1 100. 0. 255. DISPLAY_IDENTIFIER ENVD_OBD_31_2 ECU_ADDRESS 0xd000483e FORMAT "%3.0" /end MEASUREMENT
/begin MEASUREMENT tbl_frf[2].envd_obd[31] "Freeze frame FRF_OBD: environmental data (fixed by law)" UBYTE _CNV_A_R_LINEAR_____0_CM 1 100. 0. 255. DISPLAY_IDENTIFIER ENVD_OBD_32_2 ECU_ADDRESS 0xd000483f FORMAT "%3.0" /end MEASUREMENT
/begin MEASUREMENT tbl_frf[2].envd_obd[32] "Freeze frame FRF_OBD: environmental data (fixed by law)" UBYTE _CNV_A_R_LINEAR_____0_CM 1 100. 0. 255. DISPLAY_IDENTIFIER ENVD_OBD_33_2 ECU_ADDRESS 0xd0004840 FORMAT "%3.0" /end MEASUREMENT
/begin MEASUREMENT tbl_frf[2].envd_obd[33] "Freeze frame FRF_OBD: environmental data (fixed by law)" UBYTE _CNV_A_R_LINEAR_____0_CM 1 100. 0. 255. DISPLAY_IDENTIFIER ENVD_OBD_34_2 ECU_ADDRESS 0xd0004841 FORMAT "%3.0" /end MEASUREMENT
/begin MEASUREMENT tbl_frf[2].envd_obd[34] "Freeze frame FRF_OBD: environmental data (fixed by law)" UBYTE _CNV_A_R_LINEAR_____0_CM 1 100. 0. 255. DISPLAY_IDENTIFIER ENVD_OBD[34] ECU_ADDRESS 0xd0004842 FORMAT "%3.0" /end MEASUREMENT
/begin MEASUREMENT tbl_frf[2].envd_cus_cmn[0] "Freeze frame FRF_CUS_CMN: environmental data common to all failure (not fixed by law)" UBYTE _CNV_A_R_LINEAR_____0_CM 1 100. 0. 255. DISPLAY_IDENTIFIER ENVD_CUS_CMN_1_2 ECU_ADDRESS 0xd0004843 FORMAT "%3.0" /end MEASUREMENT
/begin MEASUREMENT tbl_frf[2].envd_cus_set_cmn[0][0] "Freeze frame FRF_CUS_SET_CMN: environmental data common to all failure (not fixed by law) stored in set" UBYTE _CNV_A_R_LINEAR_____0_CM 1 100. 0. 255. DISPLAY_IDENTIFIER ENVD_CUS_SET_CMN_1_1_2 ECU_ADDRESS 0xd0004844 FORMAT "%3.0" /end MEASUREMENT
/begin MEASUREMENT tbl_frf[2].envd_cus_set_cmn[0][1] "Freeze frame FRF_CUS_SET_CMN: environmental data common to all failure (not fixed by law) stored in set" UBYTE _CNV_A_R_LINEAR_____0_CM 1 100. 0. 255. DISPLAY_IDENTIFIER ENVD_CUS_SET_CMN_2_1_2 ECU_ADDRESS 0xd0004845 FORMAT "%3.0" /end MEASUREMENT
/begin MEASUREMENT tbl_frf[2].envd_cus_set_cmn[0][2] "Freeze frame FRF_CUS_SET_CMN: environmental data common to all failure (not fixed by law) stored in set" UBYTE _CNV_A_R_LINEAR_____0_CM 1 100. 0. 255. DISPLAY_IDENTIFIER ENVD_CUS_SET_CMN_3_1_2 ECU_ADDRESS 0xd0004846 FORMAT "%3.0" /end MEASUREMENT
/begin MEASUREMENT tbl_frf[2].envd_cus_set_cmn[1][0] "Freeze frame FRF_CUS_SET_CMN: environmental data common to all failure (not fixed by law) stored in set" UBYTE _CNV_A_R_LINEAR_____0_CM 1 100. 0. 255. DISPLAY_IDENTIFIER ENVD_CUS_SET_CMN_1_2_2 ECU_ADDRESS 0xd0004847 FORMAT "%3.0" /end MEASUREMENT
/begin MEASUREMENT tbl_frf[2].envd_cus_set_cmn[1][1] "Freeze frame FRF_CUS_SET_CMN: environmental data common to all failure (not fixed by law) stored in set" UBYTE _CNV_A_R_LINEAR_____0_CM 1 100. 0. 255. DISPLAY_IDENTIFIER ENVD_CUS_SET_CMN_2_2_2 ECU_ADDRESS 0xd0004848 FORMAT "%3.0" /end MEASUREMENT
/begin MEASUREMENT tbl_frf[2].envd_cus_set_cmn[1][2] "Freeze frame FRF_CUS_SET_CMN: environmental data common to all failure (not fixed by law) stored in set" UBYTE _CNV_A_R_LINEAR_____0_CM 1 100. 0. 255. DISPLAY_IDENTIFIER ENVD_CUS_SET_CMN_3_2_2 ECU_ADDRESS 0xd0004849 FORMAT "%3.0" /end MEASUREMENT
/begin MEASUREMENT tbl_frf[2].envd_cus_set_cmn[2][0] "Freeze frame FRF_CUS_SET_CMN: environmental data common to all failure (not fixed by law) stored in set" UBYTE _CNV_A_R_LINEAR_____0_CM 1 100. 0. 255. DISPLAY_IDENTIFIER ENVD_CUS_SET_CMN_1_3_2 ECU_ADDRESS 0xd000484a FORMAT "%3.0" /end MEASUREMENT
/begin MEASUREMENT tbl_frf[2].envd_cus_set_cmn[2][1] "Freeze frame FRF_CUS_SET_CMN: environmental data common to all failure (not fixed by law) stored in set" UBYTE _CNV_A_R_LINEAR_____0_CM 1 100. 0. 255. DISPLAY_IDENTIFIER ENVD_CUS_SET_CMN_2_3_2 ECU_ADDRESS 0xd000484b FORMAT "%3.0" /end MEASUREMENT
/begin MEASUREMENT tbl_frf[2].envd_cus_set_cmn[2][2] "Freeze frame FRF_CUS_SET_CMN: environmental data common to all failure (not fixed by law) stored in set" UBYTE _CNV_A_R_LINEAR_____0_CM 1 100. 0. 255. DISPLAY_IDENTIFIER ENVD_CUS_SET_CMN_3_3_2 ECU_ADDRESS 0xd000484c FORMAT "%3.0" /end MEASUREMENT
/begin MEASUREMENT tbl_frf[2].envd_cus_set_spc[0][0] "Freeze frame FRF_CUS_SET_SPC: environmental data specific to each failure (not fixed by law) stored in set" UBYTE _CNV_A_R_LINEAR_____0_CM 1 100. 0. 255. DISPLAY_IDENTIFIER ENVD_CUS_SET_SPC_1_1_2 ECU_ADDRESS 0xd0004850 FORMAT "%3.0" /end MEASUREMENT
/begin MEASUREMENT tbl_frf[2].envd_cus_set_spc[0][1] "Freeze frame FRF_CUS_SET_SPC: environmental data specific to each failure (not fixed by law) stored in set" UBYTE _CNV_A_R_LINEAR_____0_CM 1 100. 0. 255. DISPLAY_IDENTIFIER ENVD_CUS_SET_SPC_2_1_2 ECU_ADDRESS 0xd0004851 FORMAT "%3.0" /end MEASUREMENT
/begin MEASUREMENT tbl_frf[2].envd_cus_set_spc[0][2] "Freeze frame FRF_CUS_SET_SPC: environmental data specific to each failure (not fixed by law) stored in set" UBYTE _CNV_A_R_LINEAR_____0_CM 1 100. 0. 255. DISPLAY_IDENTIFIER ENVD_CUS_SET_SPC_3_1_2 ECU_ADDRESS 0xd0004852 FORMAT "%3.0" /end MEASUREMENT
/begin MEASUREMENT tbl_frf[2].envd_cus_set_spc[0][3] "Freeze frame FRF_CUS_SET_SPC: environmental data specific to each failure (not fixed by law) stored in set" UBYTE _CNV_A_R_LINEAR_____0_CM 1 100. 0. 255. DISPLAY_IDENTIFIER ENVD_CUS_SET_SPC_4_1_2 ECU_ADDRESS 0xd0004853 FORMAT "%3.0" /end MEASUREMENT
/begin MEASUREMENT tbl_frf[2].envd_cus_set_spc[1][0] "Freeze frame FRF_CUS_SET_SPC: environmental data specific to each failure (not fixed by law) stored in set" UBYTE _CNV_A_R_LINEAR_____0_CM 1 100. 0. 255. DISPLAY_IDENTIFIER ENVD_CUS_SET_SPC_1_2_2 ECU_ADDRESS 0xd0004854 FORMAT "%3.0" /end MEASUREMENT
/begin MEASUREMENT tbl_frf[2].envd_cus_set_spc[1][1] "Freeze frame FRF_CUS_SET_SPC: environmental data specific to each failure (not fixed by law) stored in set" UBYTE _CNV_A_R_LINEAR_____0_CM 1 100. 0. 255. DISPLAY_IDENTIFIER ENVD_CUS_SET_SPC_2_2_2 ECU_ADDRESS 0xd0004855 FORMAT "%3.0" /end MEASUREMENT
/begin MEASUREMENT tbl_frf[2].envd_cus_set_spc[1][2] "Freeze frame FRF_CUS_SET_SPC: environmental data specific to each failure (not fixed by law) stored in set" UBYTE _CNV_A_R_LINEAR_____0_CM 1 100. 0. 255. DISPLAY_IDENTIFIER ENVD_CUS_SET_SPC_3_2_2 ECU_ADDRESS 0xd0004856 FORMAT "%3.0" /end MEASUREMENT
/begin MEASUREMENT tbl_frf[2].envd_cus_set_spc[1][3] "Freeze frame FRF_CUS_SET_SPC: environmental data specific to each failure (not fixed by law) stored in set" UBYTE _CNV_A_R_LINEAR_____0_CM 1 100. 0. 255. DISPLAY_IDENTIFIER ENVD_CUS_SET_SPC_4_2_2 ECU_ADDRESS 0xd0004857 FORMAT "%3.0" /end MEASUREMENT
/begin MEASUREMENT tbl_frf[2].envd_cus_set_spc[2][0] "Freeze frame FRF_CUS_SET_SPC: environmental data specific to each failure (not fixed by law) stored in set" UBYTE _CNV_A_R_LINEAR_____0_CM 1 100. 0. 255. DISPLAY_IDENTIFIER ENVD_CUS_SET_SPC_1_3_2 ECU_ADDRESS 0xd0004858 FORMAT "%3.0" /end MEASUREMENT
/begin MEASUREMENT tbl_frf[2].envd_cus_set_spc[2][1] "Freeze frame FRF_CUS_SET_SPC: environmental data specific to each failure (not fixed by law) stored in set" UBYTE _CNV_A_R_LINEAR_____0_CM 1 100. 0. 255. DISPLAY_IDENTIFIER ENVD_CUS_SET_SPC_2_3_2 ECU_ADDRESS 0xd0004859 FORMAT "%3.0" /end MEASUREMENT
/begin MEASUREMENT tbl_frf[2].envd_cus_set_spc[2][2] "Freeze frame FRF_CUS_SET_SPC: environmental data specific to each failure (not fixed by law) stored in set" UBYTE _CNV_A_R_LINEAR_____0_CM 1 100. 0. 255. DISPLAY_IDENTIFIER ENVD_CUS_SET_SPC_3_3_2 ECU_ADDRESS 0xd000485a FORMAT "%3.0" /end MEASUREMENT
/begin MEASUREMENT tbl_frf[2].envd_cus_set_spc[2][3] "Freeze frame FRF_CUS_SET_SPC: environmental data specific to each failure (not fixed by law) stored in set" UBYTE _CNV_A_R_LINEAR_____0_CM 1 100. 0. 255. DISPLAY_IDENTIFIER ENVD_CUS_SET_SPC_4_3_2 ECU_ADDRESS 0xd000485b FORMAT "%3.0" /end MEASUREMENT
/begin MEASUREMENT tbl_frf[3].envd_obd[0] "Freeze frame FRF_OBD: environmental data (fixed by law)" UBYTE _CNV_A_R_LINEAR_____0_CM 1 100. 0. 255. DISPLAY_IDENTIFIER ENVD_OBD_1_3 ECU_ADDRESS 0xd0004860 FORMAT "%3.0" /end MEASUREMENT
/begin MEASUREMENT tbl_frf[3].envd_obd[1] "Freeze frame FRF_OBD: environmental data (fixed by law)" UBYTE _CNV_A_R_LINEAR_____0_CM 1 100. 0. 255. DISPLAY_IDENTIFIER ENVD_OBD_2_3 ECU_ADDRESS 0xd0004861 FORMAT "%3.0" /end MEASUREMENT
/begin MEASUREMENT tbl_frf[3].envd_obd[2] "Freeze frame FRF_OBD: environmental data (fixed by law)" UBYTE _CNV_A_R_LINEAR_____0_CM 1 100. 0. 255. DISPLAY_IDENTIFIER ENVD_OBD_3_3 ECU_ADDRESS 0xd0004862 FORMAT "%3.0" /end MEASUREMENT
/begin MEASUREMENT tbl_frf[3].envd_obd[3] "Freeze frame FRF_OBD: environmental data (fixed by law)" UBYTE _CNV_A_R_LINEAR_____0_CM 1 100. 0. 255. DISPLAY_IDENTIFIER ENVD_OBD_4_3 ECU_ADDRESS 0xd0004863 FORMAT "%3.0" /end MEASUREMENT
/begin MEASUREMENT tbl_frf[3].envd_obd[4] "Freeze frame FRF_OBD: environmental data (fixed by law)" UBYTE _CNV_A_R_LINEAR_____0_CM 1 100. 0. 255. DISPLAY_IDENTIFIER ENVD_OBD_5_3 ECU_ADDRESS 0xd0004864 FORMAT "%3.0" /end MEASUREMENT
/begin MEASUREMENT tbl_frf[3].envd_obd[5] "Freeze frame FRF_OBD: environmental data (fixed by law)" UBYTE _CNV_A_R_LINEAR_____0_CM 1 100. 0. 255. DISPLAY_IDENTIFIER ENVD_OBD_6_3 ECU_ADDRESS 0xd0004865 FORMAT "%3.0" /end MEASUREMENT
/begin MEASUREMENT tbl_frf[3].envd_obd[6] "Freeze frame FRF_OBD: environmental data (fixed by law)" UBYTE _CNV_A_R_LINEAR_____0_CM 1 100. 0. 255. DISPLAY_IDENTIFIER ENVD_OBD_7_3 ECU_ADDRESS 0xd0004866 FORMAT "%3.0" /end MEASUREMENT
/begin MEASUREMENT tbl_frf[3].envd_obd[7] "Freeze frame FRF_OBD: environmental data (fixed by law)" UBYTE _CNV_A_R_LINEAR_____0_CM 1 100. 0. 255. DISPLAY_IDENTIFIER ENVD_OBD_8_3 ECU_ADDRESS 0xd0004867 FORMAT "%3.0" /end MEASUREMENT
/begin MEASUREMENT tbl_frf[3].envd_obd[8] "Freeze frame FRF_OBD: environmental data (fixed by law)" UBYTE _CNV_A_R_LINEAR_____0_CM 1 100. 0. 255. DISPLAY_IDENTIFIER ENVD_OBD_9_3 ECU_ADDRESS 0xd0004868 FORMAT "%3.0" /end MEASUREMENT
/begin MEASUREMENT tbl_frf[3].envd_obd[9] "Freeze frame FRF_OBD: environmental data (fixed by law)" UBYTE _CNV_A_R_LINEAR_____0_CM 1 100. 0. 255. DISPLAY_IDENTIFIER ENVD_OBD_10_3 ECU_ADDRESS 0xd0004869 FORMAT "%3.0" /end MEASUREMENT
/begin MEASUREMENT tbl_frf[3].envd_obd[10] "Freeze frame FRF_OBD: environmental data (fixed by law)" UBYTE _CNV_A_R_LINEAR_____0_CM 1 100. 0. 255. DISPLAY_IDENTIFIER ENVD_OBD_11_3 ECU_ADDRESS 0xd000486a FORMAT "%3.0" /end MEASUREMENT
/begin MEASUREMENT tbl_frf[3].envd_obd[11] "Freeze frame FRF_OBD: environmental data (fixed by law)" UBYTE _CNV_A_R_LINEAR_____0_CM 1 100. 0. 255. DISPLAY_IDENTIFIER ENVD_OBD_12_3 ECU_ADDRESS 0xd000486b FORMAT "%3.0" /end MEASUREMENT
/begin MEASUREMENT tbl_frf[3].envd_obd[12] "Freeze frame FRF_OBD: environmental data (fixed by law)" UBYTE _CNV_A_R_LINEAR_____0_CM 1 100. 0. 255. DISPLAY_IDENTIFIER ENVD_OBD_13_3 ECU_ADDRESS 0xd000486c FORMAT "%3.0" /end MEASUREMENT
/begin MEASUREMENT tbl_frf[3].envd_obd[13] "Freeze frame FRF_OBD: environmental data (fixed by law)" UBYTE _CNV_A_R_LINEAR_____0_CM 1 100. 0. 255. DISPLAY_IDENTIFIER ENVD_OBD_14_3 ECU_ADDRESS 0xd000486d FORMAT "%3.0" /end MEASUREMENT
/begin MEASUREMENT tbl_frf[3].envd_obd[14] "Freeze frame FRF_OBD: environmental data (fixed by law)" UBYTE _CNV_A_R_LINEAR_____0_CM 1 100. 0. 255. DISPLAY_IDENTIFIER ENVD_OBD_15_3 ECU_ADDRESS 0xd000486e FORMAT "%3.0" /end MEASUREMENT
/begin MEASUREMENT tbl_frf[3].envd_obd[15] "Freeze frame FRF_OBD: environmental data (fixed by law)" UBYTE _CNV_A_R_LINEAR_____0_CM 1 100. 0. 255. DISPLAY_IDENTIFIER ENVD_OBD_16_3 ECU_ADDRESS 0xd000486f FORMAT "%3.0" /end MEASUREMENT
/begin MEASUREMENT tbl_frf[3].envd_obd[16] "Freeze frame FRF_OBD: environmental data (fixed by law)" UBYTE _CNV_A_R_LINEAR_____0_CM 1 100. 0. 255. DISPLAY_IDENTIFIER ENVD_OBD_17_3 ECU_ADDRESS 0xd0004870 FORMAT "%3.0" /end MEASUREMENT
/begin MEASUREMENT tbl_frf[3].envd_obd[17] "Freeze frame FRF_OBD: environmental data (fixed by law)" UBYTE _CNV_A_R_LINEAR_____0_CM 1 100. 0. 255. DISPLAY_IDENTIFIER ENVD_OBD_18_3 ECU_ADDRESS 0xd0004871 FORMAT "%3.0" /end MEASUREMENT
/begin MEASUREMENT tbl_frf[3].envd_obd[18] "Freeze frame FRF_OBD: environmental data (fixed by law)" UBYTE _CNV_A_R_LINEAR_____0_CM 1 100. 0. 255. DISPLAY_IDENTIFIER ENVD_OBD_19_3 ECU_ADDRESS 0xd0004872 FORMAT "%3.0" /end MEASUREMENT
/begin MEASUREMENT tbl_frf[3].envd_obd[19] "Freeze frame FRF_OBD: environmental data (fixed by law)" UBYTE _CNV_A_R_LINEAR_____0_CM 1 100. 0. 255. DISPLAY_IDENTIFIER ENVD_OBD_20_3 ECU_ADDRESS 0xd0004873 FORMAT "%3.0" /end MEASUREMENT
/begin MEASUREMENT tbl_frf[3].envd_obd[20] "Freeze frame FRF_OBD: environmental data (fixed by law)" UBYTE _CNV_A_R_LINEAR_____0_CM 1 100. 0. 255. DISPLAY_IDENTIFIER ENVD_OBD_21_3 ECU_ADDRESS 0xd0004874 FORMAT "%3.0" /end MEASUREMENT
/begin MEASUREMENT tbl_frf[3].envd_obd[21] "Freeze frame FRF_OBD: environmental data (fixed by law)" UBYTE _CNV_A_R_LINEAR_____0_CM 1 100. 0. 255. DISPLAY_IDENTIFIER ENVD_OBD_22_3 ECU_ADDRESS 0xd0004875 FORMAT "%3.0" /end MEASUREMENT
/begin MEASUREMENT tbl_frf[3].envd_obd[22] "Freeze frame FRF_OBD: environmental data (fixed by law)" UBYTE _CNV_A_R_LINEAR_____0_CM 1 100. 0. 255. DISPLAY_IDENTIFIER ENVD_OBD_23_3 ECU_ADDRESS 0xd0004876 FORMAT "%3.0" /end MEASUREMENT
/begin MEASUREMENT tbl_frf[3].envd_obd[23] "Freeze frame FRF_OBD: environmental data (fixed by law)" UBYTE _CNV_A_R_LINEAR_____0_CM 1 100. 0. 255. DISPLAY_IDENTIFIER ENVD_OBD_24_3 ECU_ADDRESS 0xd0004877 FORMAT "%3.0" /end MEASUREMENT
/begin MEASUREMENT tbl_frf[3].envd_obd[24] "Freeze frame FRF_OBD: environmental data (fixed by law)" UBYTE _CNV_A_R_LINEAR_____0_CM 1 100. 0. 255. DISPLAY_IDENTIFIER ENVD_OBD_25_3 ECU_ADDRESS 0xd0004878 FORMAT "%3.0" /end MEASUREMENT
/begin MEASUREMENT tbl_frf[3].envd_obd[25] "Freeze frame FRF_OBD: environmental data (fixed by law)" UBYTE _CNV_A_R_LINEAR_____0_CM 1 100. 0. 255. DISPLAY_IDENTIFIER ENVD_OBD_26_3 ECU_ADDRESS 0xd0004879 FORMAT "%3.0" /end MEASUREMENT
/begin MEASUREMENT tbl_frf[3].envd_obd[26] "Freeze frame FRF_OBD: environmental data (fixed by law)" UBYTE _CNV_A_R_LINEAR_____0_CM 1 100. 0. 255. DISPLAY_IDENTIFIER ENVD_OBD_27_3 ECU_ADDRESS 0xd000487a FORMAT "%3.0" /end MEASUREMENT
/begin MEASUREMENT tbl_frf[3].envd_obd[27] "Freeze frame FRF_OBD: environmental data (fixed by law)" UBYTE _CNV_A_R_LINEAR_____0_CM 1 100. 0. 255. DISPLAY_IDENTIFIER ENVD_OBD_28_3 ECU_ADDRESS 0xd000487b FORMAT "%3.0" /end MEASUREMENT
/begin MEASUREMENT tbl_frf[3].envd_obd[28] "Freeze frame FRF_OBD: environmental data (fixed by law)" UBYTE _CNV_A_R_LINEAR_____0_CM 1 100. 0. 255. DISPLAY_IDENTIFIER ENVD_OBD_29_3 ECU_ADDRESS 0xd000487c FORMAT "%3.0" /end MEASUREMENT
/begin MEASUREMENT tbl_frf[3].envd_obd[29] "Freeze frame FRF_OBD: environmental data (fixed by law)" UBYTE _CNV_A_R_LINEAR_____0_CM 1 100. 0. 255. DISPLAY_IDENTIFIER ENVD_OBD_30_3 ECU_ADDRESS 0xd000487d FORMAT "%3.0" /end MEASUREMENT
/begin MEASUREMENT tbl_frf[3].envd_obd[30] "Freeze frame FRF_OBD: environmental data (fixed by law)" UBYTE _CNV_A_R_LINEAR_____0_CM 1 100. 0. 255. DISPLAY_IDENTIFIER ENVD_OBD_31_3 ECU_ADDRESS 0xd000487e FORMAT "%3.0" /end MEASUREMENT
/begin MEASUREMENT tbl_frf[3].envd_obd[31] "Freeze frame FRF_OBD: environmental data (fixed by law)" UBYTE _CNV_A_R_LINEAR_____0_CM 1 100. 0. 255. DISPLAY_IDENTIFIER ENVD_OBD_32_3 ECU_ADDRESS 0xd000487f FORMAT "%3.0" /end MEASUREMENT
/begin MEASUREMENT tbl_frf[3].envd_obd[32] "Freeze frame FRF_OBD: environmental data (fixed by law)" UBYTE _CNV_A_R_LINEAR_____0_CM 1 100. 0. 255. DISPLAY_IDENTIFIER ENVD_OBD_33_3 ECU_ADDRESS 0xd0004880 FORMAT "%3.0" /end MEASUREMENT
/begin MEASUREMENT tbl_frf[3].envd_obd[33] "Freeze frame FRF_OBD: environmental data (fixed by law)" UBYTE _CNV_A_R_LINEAR_____0_CM 1 100. 0. 255. DISPLAY_IDENTIFIER ENVD_OBD_34_3 ECU_ADDRESS 0xd0004881 FORMAT "%3.0" /end MEASUREMENT
/begin MEASUREMENT tbl_frf[3].envd_obd[34] "Freeze frame FRF_OBD: environmental data (fixed by law)" UBYTE _CNV_A_R_LINEAR_____0_CM 1 100. 0. 255. DISPLAY_IDENTIFIER ENVD_OBD[34] ECU_ADDRESS 0xd0004882 FORMAT "%3.0" /end MEASUREMENT
/begin MEASUREMENT tbl_frf[3].envd_cus_cmn[0] "Freeze frame FRF_CUS_CMN: environmental data common to all failure (not fixed by law)" UBYTE _CNV_A_R_LINEAR_____0_CM 1 100. 0. 255. DISPLAY_IDENTIFIER ENVD_CUS_CMN_1_3 ECU_ADDRESS 0xd0004883 FORMAT "%3.0" /end MEASUREMENT
/begin MEASUREMENT tbl_frf[3].envd_cus_set_cmn[0][0] "Freeze frame FRF_CUS_SET_CMN: environmental data common to all failure (not fixed by law) stored in set" UBYTE _CNV_A_R_LINEAR_____0_CM 1 100. 0. 255. DISPLAY_IDENTIFIER ENVD_CUS_SET_CMN_1_1_3 ECU_ADDRESS 0xd0004884 FORMAT "%3.0" /end MEASUREMENT
/begin MEASUREMENT tbl_frf[3].envd_cus_set_cmn[0][1] "Freeze frame FRF_CUS_SET_CMN: environmental data common to all failure (not fixed by law) stored in set" UBYTE _CNV_A_R_LINEAR_____0_CM 1 100. 0. 255. DISPLAY_IDENTIFIER ENVD_CUS_SET_CMN_2_1_3 ECU_ADDRESS 0xd0004885 FORMAT "%3.0" /end MEASUREMENT
/begin MEASUREMENT tbl_frf[3].envd_cus_set_cmn[0][2] "Freeze frame FRF_CUS_SET_CMN: environmental data common to all failure (not fixed by law) stored in set" UBYTE _CNV_A_R_LINEAR_____0_CM 1 100. 0. 255. DISPLAY_IDENTIFIER ENVD_CUS_SET_CMN_3_1_3 ECU_ADDRESS 0xd0004886 FORMAT "%3.0" /end MEASUREMENT
/begin MEASUREMENT tbl_frf[3].envd_cus_set_cmn[1][0] "Freeze frame FRF_CUS_SET_CMN: environmental data common to all failure (not fixed by law) stored in set" UBYTE _CNV_A_R_LINEAR_____0_CM 1 100. 0. 255. DISPLAY_IDENTIFIER ENVD_CUS_SET_CMN_1_2_3 ECU_ADDRESS 0xd0004887 FORMAT "%3.0" /end MEASUREMENT
/begin MEASUREMENT tbl_frf[3].envd_cus_set_cmn[1][1] "Freeze frame FRF_CUS_SET_CMN: environmental data common to all failure (not fixed by law) stored in set" UBYTE _CNV_A_R_LINEAR_____0_CM 1 100. 0. 255. DISPLAY_IDENTIFIER ENVD_CUS_SET_CMN_2_2_3 ECU_ADDRESS 0xd0004888 FORMAT "%3.0" /end MEASUREMENT
/begin MEASUREMENT tbl_frf[3].envd_cus_set_cmn[1][2] "Freeze frame FRF_CUS_SET_CMN: environmental data common to all failure (not fixed by law) stored in set" UBYTE _CNV_A_R_LINEAR_____0_CM 1 100. 0. 255. DISPLAY_IDENTIFIER ENVD_CUS_SET_CMN_3_2_3 ECU_ADDRESS 0xd0004889 FORMAT "%3.0" /end MEASUREMENT
/begin MEASUREMENT tbl_frf[3].envd_cus_set_cmn[2][0] "Freeze frame FRF_CUS_SET_CMN: environmental data common to all failure (not fixed by law) stored in set" UBYTE _CNV_A_R_LINEAR_____0_CM 1 100. 0. 255. DISPLAY_IDENTIFIER ENVD_CUS_SET_CMN_1_3_3 ECU_ADDRESS 0xd000488a FORMAT "%3.0" /end MEASUREMENT
/begin MEASUREMENT tbl_frf[3].envd_cus_set_cmn[2][1] "Freeze frame FRF_CUS_SET_CMN: environmental data common to all failure (not fixed by law) stored in set" UBYTE _CNV_A_R_LINEAR_____0_CM 1 100. 0. 255. DISPLAY_IDENTIFIER ENVD_CUS_SET_CMN_2_3_3 ECU_ADDRESS 0xd000488b FORMAT "%3.0" /end MEASUREMENT
/begin MEASUREMENT tbl_frf[3].envd_cus_set_cmn[2][2] "Freeze frame FRF_CUS_SET_CMN: environmental data common to all failure (not fixed by law) stored in set" UBYTE _CNV_A_R_LINEAR_____0_CM 1 100. 0. 255. DISPLAY_IDENTIFIER ENVD_CUS_SET_CMN_3_3_3 ECU_ADDRESS 0xd000488c FORMAT "%3.0" /end MEASUREMENT
/begin MEASUREMENT tbl_frf[3].envd_cus_set_spc[0][0] "Freeze frame FRF_CUS_SET_SPC: environmental data specific to each failure (not fixed by law) stored in set" UBYTE _CNV_A_R_LINEAR_____0_CM 1 100. 0. 255. DISPLAY_IDENTIFIER ENVD_CUS_SET_SPC_1_1_3 ECU_ADDRESS 0xd0004890 FORMAT "%3.0" /end MEASUREMENT
/begin MEASUREMENT tbl_frf[3].envd_cus_set_spc[0][1] "Freeze frame FRF_CUS_SET_SPC: environmental data specific to each failure (not fixed by law) stored in set" UBYTE _CNV_A_R_LINEAR_____0_CM 1 100. 0. 255. DISPLAY_IDENTIFIER ENVD_CUS_SET_SPC_2_1_3 ECU_ADDRESS 0xd0004891 FORMAT "%3.0" /end MEASUREMENT
/begin MEASUREMENT tbl_frf[3].envd_cus_set_spc[0][2] "Freeze frame FRF_CUS_SET_SPC: environmental data specific to each failure (not fixed by law) stored in set" UBYTE _CNV_A_R_LINEAR_____0_CM 1 100. 0. 255. DISPLAY_IDENTIFIER ENVD_CUS_SET_SPC_3_1_3 ECU_ADDRESS 0xd0004892 FORMAT "%3.0" /end MEASUREMENT
/begin MEASUREMENT tbl_frf[3].envd_cus_set_spc[0][3] "Freeze frame FRF_CUS_SET_SPC: environmental data specific to each failure (not fixed by law) stored in set" UBYTE _CNV_A_R_LINEAR_____0_CM 1 100. 0. 255. DISPLAY_IDENTIFIER ENVD_CUS_SET_SPC_4_1_3 ECU_ADDRESS 0xd0004893 FORMAT "%3.0" /end MEASUREMENT
/begin MEASUREMENT tbl_frf[3].envd_cus_set_spc[1][0] "Freeze frame FRF_CUS_SET_SPC: environmental data specific to each failure (not fixed by law) stored in set" UBYTE _CNV_A_R_LINEAR_____0_CM 1 100. 0. 255. DISPLAY_IDENTIFIER ENVD_CUS_SET_SPC_1_2_3 ECU_ADDRESS 0xd0004894 FORMAT "%3.0" /end MEASUREMENT
/begin MEASUREMENT tbl_frf[3].envd_cus_set_spc[1][1] "Freeze frame FRF_CUS_SET_SPC: environmental data specific to each failure (not fixed by law) stored in set" UBYTE _CNV_A_R_LINEAR_____0_CM 1 100. 0. 255. DISPLAY_IDENTIFIER ENVD_CUS_SET_SPC_2_2_3 ECU_ADDRESS 0xd0004895 FORMAT "%3.0" /end MEASUREMENT
/begin MEASUREMENT tbl_frf[3].envd_cus_set_spc[1][2] "Freeze frame FRF_CUS_SET_SPC: environmental data specific to each failure (not fixed by law) stored in set" UBYTE _CNV_A_R_LINEAR_____0_CM 1 100. 0. 255. DISPLAY_IDENTIFIER ENVD_CUS_SET_SPC_3_2_3 ECU_ADDRESS 0xd0004896 FORMAT "%3.0" /end MEASUREMENT
/begin MEASUREMENT tbl_frf[3].envd_cus_set_spc[1][3] "Freeze frame FRF_CUS_SET_SPC: environmental data specific to each failure (not fixed by law) stored in set" UBYTE _CNV_A_R_LINEAR_____0_CM 1 100. 0. 255. DISPLAY_IDENTIFIER ENVD_CUS_SET_SPC_4_2_3 ECU_ADDRESS 0xd0004897 FORMAT "%3.0" /end MEASUREMENT
/begin MEASUREMENT tbl_frf[3].envd_cus_set_spc[2][0] "Freeze frame FRF_CUS_SET_SPC: environmental data specific to each failure (not fixed by law) stored in set" UBYTE _CNV_A_R_LINEAR_____0_CM 1 100. 0. 255. DISPLAY_IDENTIFIER ENVD_CUS_SET_SPC_1_3_3 ECU_ADDRESS 0xd0004898 FORMAT "%3.0" /end MEASUREMENT
/begin MEASUREMENT tbl_frf[3].envd_cus_set_spc[2][1] "Freeze frame FRF_CUS_SET_SPC: environmental data specific to each failure (not fixed by law) stored in set" UBYTE _CNV_A_R_LINEAR_____0_CM 1 100. 0. 255. DISPLAY_IDENTIFIER ENVD_CUS_SET_SPC_2_3_3 ECU_ADDRESS 0xd0004899 FORMAT "%3.0" /end MEASUREMENT
/begin MEASUREMENT tbl_frf[3].envd_cus_set_spc[2][2] "Freeze frame FRF_CUS_SET_SPC: environmental data specific to each failure (not fixed by law) stored in set" UBYTE _CNV_A_R_LINEAR_____0_CM 1 100. 0. 255. DISPLAY_IDENTIFIER ENVD_CUS_SET_SPC_3_3_3 ECU_ADDRESS 0xd000489a FORMAT "%3.0" /end MEASUREMENT
/begin MEASUREMENT tbl_frf[3].envd_cus_set_spc[2][3] "Freeze frame FRF_CUS_SET_SPC: environmental data specific to each failure (not fixed by law) stored in set" UBYTE _CNV_A_R_LINEAR_____0_CM 1 100. 0. 255. DISPLAY_IDENTIFIER ENVD_CUS_SET_SPC_4_3_3 ECU_ADDRESS 0xd000489b FORMAT "%3.0" /end MEASUREMENT
/begin MEASUREMENT tbl_frf[4].envd_obd[0] "Freeze frame FRF_OBD: environmental data (fixed by law)" UBYTE _CNV_A_R_LINEAR_____0_CM 1 100. 0. 255. DISPLAY_IDENTIFIER ENVD_OBD_1_4 ECU_ADDRESS 0xd00048a0 FORMAT "%3.0" /end MEASUREMENT
/begin MEASUREMENT tbl_frf[4].envd_obd[1] "Freeze frame FRF_OBD: environmental data (fixed by law)" UBYTE _CNV_A_R_LINEAR_____0_CM 1 100. 0. 255. DISPLAY_IDENTIFIER ENVD_OBD_2_4 ECU_ADDRESS 0xd00048a1 FORMAT "%3.0" /end MEASUREMENT
/begin MEASUREMENT tbl_frf[4].envd_obd[2] "Freeze frame FRF_OBD: environmental data (fixed by law)" UBYTE _CNV_A_R_LINEAR_____0_CM 1 100. 0. 255. DISPLAY_IDENTIFIER ENVD_OBD_3_4 ECU_ADDRESS 0xd00048a2 FORMAT "%3.0" /end MEASUREMENT
/begin MEASUREMENT tbl_frf[4].envd_obd[3] "Freeze frame FRF_OBD: environmental data (fixed by law)" UBYTE _CNV_A_R_LINEAR_____0_CM 1 100. 0. 255. DISPLAY_IDENTIFIER ENVD_OBD_4_4 ECU_ADDRESS 0xd00048a3 FORMAT "%3.0" /end MEASUREMENT
/begin MEASUREMENT tbl_frf[4].envd_obd[4] "Freeze frame FRF_OBD: environmental data (fixed by law)" UBYTE _CNV_A_R_LINEAR_____0_CM 1 100. 0. 255. DISPLAY_IDENTIFIER ENVD_OBD_5_4 ECU_ADDRESS 0xd00048a4 FORMAT "%3.0" /end MEASUREMENT
/begin MEASUREMENT tbl_frf[4].envd_obd[5] "Freeze frame FRF_OBD: environmental data (fixed by law)" UBYTE _CNV_A_R_LINEAR_____0_CM 1 100. 0. 255. DISPLAY_IDENTIFIER ENVD_OBD_6_4 ECU_ADDRESS 0xd00048a5 FORMAT "%3.0" /end MEASUREMENT
/begin MEASUREMENT tbl_frf[4].envd_obd[6] "Freeze frame FRF_OBD: environmental data (fixed by law)" UBYTE _CNV_A_R_LINEAR_____0_CM 1 100. 0. 255. DISPLAY_IDENTIFIER ENVD_OBD_7_4 ECU_ADDRESS 0xd00048a6 FORMAT "%3.0" /end MEASUREMENT
/begin MEASUREMENT tbl_frf[4].envd_obd[7] "Freeze frame FRF_OBD: environmental data (fixed by law)" UBYTE _CNV_A_R_LINEAR_____0_CM 1 100. 0. 255. DISPLAY_IDENTIFIER ENVD_OBD_8_4 ECU_ADDRESS 0xd00048a7 FORMAT "%3.0" /end MEASUREMENT
/begin MEASUREMENT tbl_frf[4].envd_obd[8] "Freeze frame FRF_OBD: environmental data (fixed by law)" UBYTE _CNV_A_R_LINEAR_____0_CM 1 100. 0. 255. DISPLAY_IDENTIFIER ENVD_OBD_9_4 ECU_ADDRESS 0xd00048a8 FORMAT "%3.0" /end MEASUREMENT
/begin MEASUREMENT tbl_frf[4].envd_obd[9] "Freeze frame FRF_OBD: environmental data (fixed by law)" UBYTE _CNV_A_R_LINEAR_____0_CM 1 100. 0. 255. DISPLAY_IDENTIFIER ENVD_OBD_10_4 ECU_ADDRESS 0xd00048a9 FORMAT "%3.0" /end MEASUREMENT
/begin MEASUREMENT tbl_frf[4].envd_obd[10] "Freeze frame FRF_OBD: environmental data (fixed by law)" UBYTE _CNV_A_R_LINEAR_____0_CM 1 100. 0. 255. DISPLAY_IDENTIFIER ENVD_OBD_11_4 ECU_ADDRESS 0xd00048aa FORMAT "%3.0" /end MEASUREMENT
/begin MEASUREMENT tbl_frf[4].envd_obd[11] "Freeze frame FRF_OBD: environmental data (fixed by law)" UBYTE _CNV_A_R_LINEAR_____0_CM 1 100. 0. 255. DISPLAY_IDENTIFIER ENVD_OBD_12_4 ECU_ADDRESS 0xd00048ab FORMAT "%3.0" /end MEASUREMENT
/begin MEASUREMENT tbl_frf[4].envd_obd[12] "Freeze frame FRF_OBD: environmental data (fixed by law)" UBYTE _CNV_A_R_LINEAR_____0_CM 1 100. 0. 255. DISPLAY_IDENTIFIER ENVD_OBD_13_4 ECU_ADDRESS 0xd00048ac FORMAT "%3.0" /end MEASUREMENT
/begin MEASUREMENT tbl_frf[4].envd_obd[13] "Freeze frame FRF_OBD: environmental data (fixed by law)" UBYTE _CNV_A_R_LINEAR_____0_CM 1 100. 0. 255. DISPLAY_IDENTIFIER ENVD_OBD_14_4 ECU_ADDRESS 0xd00048ad FORMAT "%3.0" /end MEASUREMENT
/begin MEASUREMENT tbl_frf[4].envd_obd[14] "Freeze frame FRF_OBD: environmental data (fixed by law)" UBYTE _CNV_A_R_LINEAR_____0_CM 1 100. 0. 255. DISPLAY_IDENTIFIER ENVD_OBD_15_4 ECU_ADDRESS 0xd00048ae FORMAT "%3.0" /end MEASUREMENT
/begin MEASUREMENT tbl_frf[4].envd_obd[15] "Freeze frame FRF_OBD: environmental data (fixed by law)" UBYTE _CNV_A_R_LINEAR_____0_CM 1 100. 0. 255. DISPLAY_IDENTIFIER ENVD_OBD_16_4 ECU_ADDRESS 0xd00048af FORMAT "%3.0" /end MEASUREMENT
/begin MEASUREMENT tbl_frf[4].envd_obd[16] "Freeze frame FRF_OBD: environmental data (fixed by law)" UBYTE _CNV_A_R_LINEAR_____0_CM 1 100. 0. 255. DISPLAY_IDENTIFIER ENVD_OBD_17_4 ECU_ADDRESS 0xd00048b0 FORMAT "%3.0" /end MEASUREMENT
/begin MEASUREMENT tbl_frf[4].envd_obd[17] "Freeze frame FRF_OBD: environmental data (fixed by law)" UBYTE _CNV_A_R_LINEAR_____0_CM 1 100. 0. 255. DISPLAY_IDENTIFIER ENVD_OBD_18_4 ECU_ADDRESS 0xd00048b1 FORMAT "%3.0" /end MEASUREMENT
/begin MEASUREMENT tbl_frf[4].envd_obd[18] "Freeze frame FRF_OBD: environmental data (fixed by law)" UBYTE _CNV_A_R_LINEAR_____0_CM 1 100. 0. 255. DISPLAY_IDENTIFIER ENVD_OBD_19_4 ECU_ADDRESS 0xd00048b2 FORMAT "%3.0" /end MEASUREMENT
/begin MEASUREMENT tbl_frf[4].envd_obd[19] "Freeze frame FRF_OBD: environmental data (fixed by law)" UBYTE _CNV_A_R_LINEAR_____0_CM 1 100. 0. 255. DISPLAY_IDENTIFIER ENVD_OBD_20_4 ECU_ADDRESS 0xd00048b3 FORMAT "%3.0" /end MEASUREMENT
/begin MEASUREMENT tbl_frf[4].envd_obd[20] "Freeze frame FRF_OBD: environmental data (fixed by law)" UBYTE _CNV_A_R_LINEAR_____0_CM 1 100. 0. 255. DISPLAY_IDENTIFIER ENVD_OBD_21_4 ECU_ADDRESS 0xd00048b4 FORMAT "%3.0" /end MEASUREMENT
/begin MEASUREMENT tbl_frf[4].envd_obd[21] "Freeze frame FRF_OBD: environmental data (fixed by law)" UBYTE _CNV_A_R_LINEAR_____0_CM 1 100. 0. 255. DISPLAY_IDENTIFIER ENVD_OBD_22_4 ECU_ADDRESS 0xd00048b5 FORMAT "%3.0" /end MEASUREMENT
/begin MEASUREMENT tbl_frf[4].envd_obd[22] "Freeze frame FRF_OBD: environmental data (fixed by law)" UBYTE _CNV_A_R_LINEAR_____0_CM 1 100. 0. 255. DISPLAY_IDENTIFIER ENVD_OBD_23_4 ECU_ADDRESS 0xd00048b6 FORMAT "%3.0" /end MEASUREMENT
/begin MEASUREMENT tbl_frf[4].envd_obd[23] "Freeze frame FRF_OBD: environmental data (fixed by law)" UBYTE _CNV_A_R_LINEAR_____0_CM 1 100. 0. 255. DISPLAY_IDENTIFIER ENVD_OBD_24_4 ECU_ADDRESS 0xd00048b7 FORMAT "%3.0" /end MEASUREMENT
/begin MEASUREMENT tbl_frf[4].envd_obd[24] "Freeze frame FRF_OBD: environmental data (fixed by law)" UBYTE _CNV_A_R_LINEAR_____0_CM 1 100. 0. 255. DISPLAY_IDENTIFIER ENVD_OBD_25_4 ECU_ADDRESS 0xd00048b8 FORMAT "%3.0" /end MEASUREMENT
/begin MEASUREMENT tbl_frf[4].envd_obd[25] "Freeze frame FRF_OBD: environmental data (fixed by law)" UBYTE _CNV_A_R_LINEAR_____0_CM 1 100. 0. 255. DISPLAY_IDENTIFIER ENVD_OBD_26_4 ECU_ADDRESS 0xd00048b9 FORMAT "%3.0" /end MEASUREMENT
/begin MEASUREMENT tbl_frf[4].envd_obd[26] "Freeze frame FRF_OBD: environmental data (fixed by law)" UBYTE _CNV_A_R_LINEAR_____0_CM 1 100. 0. 255. DISPLAY_IDENTIFIER ENVD_OBD_27_4 ECU_ADDRESS 0xd00048ba FORMAT "%3.0" /end MEASUREMENT
/begin MEASUREMENT tbl_frf[4].envd_obd[27] "Freeze frame FRF_OBD: environmental data (fixed by law)" UBYTE _CNV_A_R_LINEAR_____0_CM 1 100. 0. 255. DISPLAY_IDENTIFIER ENVD_OBD_28_4 ECU_ADDRESS 0xd00048bb FORMAT "%3.0" /end MEASUREMENT
/begin MEASUREMENT tbl_frf[4].envd_obd[28] "Freeze frame FRF_OBD: environmental data (fixed by law)" UBYTE _CNV_A_R_LINEAR_____0_CM 1 100. 0. 255. DISPLAY_IDENTIFIER ENVD_OBD_29_4 ECU_ADDRESS 0xd00048bc FORMAT "%3.0" /end MEASUREMENT
/begin MEASUREMENT tbl_frf[4].envd_obd[29] "Freeze frame FRF_OBD: environmental data (fixed by law)" UBYTE _CNV_A_R_LINEAR_____0_CM 1 100. 0. 255. DISPLAY_IDENTIFIER ENVD_OBD_30_4 ECU_ADDRESS 0xd00048bd FORMAT "%3.0" /end MEASUREMENT
/begin MEASUREMENT tbl_frf[4].envd_obd[30] "Freeze frame FRF_OBD: environmental data (fixed by law)" UBYTE _CNV_A_R_LINEAR_____0_CM 1 100. 0. 255. DISPLAY_IDENTIFIER ENVD_OBD_31_4 ECU_ADDRESS 0xd00048be FORMAT "%3.0" /end MEASUREMENT
/begin MEASUREMENT tbl_frf[4].envd_obd[31] "Freeze frame FRF_OBD: environmental data (fixed by law)" UBYTE _CNV_A_R_LINEAR_____0_CM 1 100. 0. 255. DISPLAY_IDENTIFIER ENVD_OBD_32_4 ECU_ADDRESS 0xd00048bf FORMAT "%3.0" /end MEASUREMENT
/begin MEASUREMENT tbl_frf[4].envd_obd[32] "Freeze frame FRF_OBD: environmental data (fixed by law)" UBYTE _CNV_A_R_LINEAR_____0_CM 1 100. 0. 255. DISPLAY_IDENTIFIER ENVD_OBD_33_4 ECU_ADDRESS 0xd00048c0 FORMAT "%3.0" /end MEASUREMENT
/begin MEASUREMENT tbl_frf[4].envd_obd[33] "Freeze frame FRF_OBD: environmental data (fixed by law)" UBYTE _CNV_A_R_LINEAR_____0_CM 1 100. 0. 255. DISPLAY_IDENTIFIER ENVD_OBD_34_4 ECU_ADDRESS 0xd00048c1 FORMAT "%3.0" /end MEASUREMENT
/begin MEASUREMENT tbl_frf[4].envd_obd[34] "Freeze frame FRF_OBD: environmental data (fixed by law)" UBYTE _CNV_A_R_LINEAR_____0_CM 1 100. 0. 255. DISPLAY_IDENTIFIER ENVD_OBD[34] ECU_ADDRESS 0xd00048c2 FORMAT "%3.0" /end MEASUREMENT
/begin MEASUREMENT tbl_frf[4].envd_cus_cmn[0] "Freeze frame FRF_CUS_CMN: environmental data common to all failure (not fixed by law)" UBYTE _CNV_A_R_LINEAR_____0_CM 1 100. 0. 255. DISPLAY_IDENTIFIER ENVD_CUS_CMN_1_4 ECU_ADDRESS 0xd00048c3 FORMAT "%3.0" /end MEASUREMENT
/begin MEASUREMENT tbl_frf[4].envd_cus_set_cmn[0][0] "Freeze frame FRF_CUS_SET_CMN: environmental data common to all failure (not fixed by law) stored in set" UBYTE _CNV_A_R_LINEAR_____0_CM 1 100. 0. 255. DISPLAY_IDENTIFIER ENVD_CUS_SET_CMN_1_1_4 ECU_ADDRESS 0xd00048c4 FORMAT "%3.0" /end MEASUREMENT
/begin MEASUREMENT tbl_frf[4].envd_cus_set_cmn[0][1] "Freeze frame FRF_CUS_SET_CMN: environmental data common to all failure (not fixed by law) stored in set" UBYTE _CNV_A_R_LINEAR_____0_CM 1 100. 0. 255. DISPLAY_IDENTIFIER ENVD_CUS_SET_CMN_2_1_4 ECU_ADDRESS 0xd00048c5 FORMAT "%3.0" /end MEASUREMENT
/begin MEASUREMENT tbl_frf[4].envd_cus_set_cmn[0][2] "Freeze frame FRF_CUS_SET_CMN: environmental data common to all failure (not fixed by law) stored in set" UBYTE _CNV_A_R_LINEAR_____0_CM 1 100. 0. 255. DISPLAY_IDENTIFIER ENVD_CUS_SET_CMN_3_1_4 ECU_ADDRESS 0xd00048c6 FORMAT "%3.0" /end MEASUREMENT
/begin MEASUREMENT tbl_frf[4].envd_cus_set_cmn[1][0] "Freeze frame FRF_CUS_SET_CMN: environmental data common to all failure (not fixed by law) stored in set" UBYTE _CNV_A_R_LINEAR_____0_CM 1 100. 0. 255. DISPLAY_IDENTIFIER ENVD_CUS_SET_CMN_1_2_4 ECU_ADDRESS 0xd00048c7 FORMAT "%3.0" /end MEASUREMENT
/begin MEASUREMENT tbl_frf[4].envd_cus_set_cmn[1][1] "Freeze frame FRF_CUS_SET_CMN: environmental data common to all failure (not fixed by law) stored in set" UBYTE _CNV_A_R_LINEAR_____0_CM 1 100. 0. 255. DISPLAY_IDENTIFIER ENVD_CUS_SET_CMN_2_2_4 ECU_ADDRESS 0xd00048c8 FORMAT "%3.0" /end MEASUREMENT
/begin MEASUREMENT tbl_frf[4].envd_cus_set_cmn[1][2] "Freeze frame FRF_CUS_SET_CMN: environmental data common to all failure (not fixed by law) stored in set" UBYTE _CNV_A_R_LINEAR_____0_CM 1 100. 0. 255. DISPLAY_IDENTIFIER ENVD_CUS_SET_CMN_3_2_4 ECU_ADDRESS 0xd00048c9 FORMAT "%3.0" /end MEASUREMENT
/begin MEASUREMENT tbl_frf[4].envd_cus_set_cmn[2][0] "Freeze frame FRF_CUS_SET_CMN: environmental data common to all failure (not fixed by law) stored in set" UBYTE _CNV_A_R_LINEAR_____0_CM 1 100. 0. 255. DISPLAY_IDENTIFIER ENVD_CUS_SET_CMN_1_3_4 ECU_ADDRESS 0xd00048ca FORMAT "%3.0" /end MEASUREMENT
/begin MEASUREMENT tbl_frf[4].envd_cus_set_cmn[2][1] "Freeze frame FRF_CUS_SET_CMN: environmental data common to all failure (not fixed by law) stored in set" UBYTE _CNV_A_R_LINEAR_____0_CM 1 100. 0. 255. DISPLAY_IDENTIFIER ENVD_CUS_SET_CMN_2_3_4 ECU_ADDRESS 0xd00048cb FORMAT "%3.0" /end MEASUREMENT
/begin MEASUREMENT tbl_frf[4].envd_cus_set_cmn[2][2] "Freeze frame FRF_CUS_SET_CMN: environmental data common to all failure (not fixed by law) stored in set" UBYTE _CNV_A_R_LINEAR_____0_CM 1 100. 0. 255. DISPLAY_IDENTIFIER ENVD_CUS_SET_CMN_3_3_4 ECU_ADDRESS 0xd00048cc FORMAT "%3.0" /end MEASUREMENT
/begin MEASUREMENT tbl_frf[4].envd_cus_set_spc[0][0] "Freeze frame FRF_CUS_SET_SPC: environmental data specific to each failure (not fixed by law) stored in set" UBYTE _CNV_A_R_LINEAR_____0_CM 1 100. 0. 255. DISPLAY_IDENTIFIER ENVD_CUS_SET_SPC_1_1_4 ECU_ADDRESS 0xd00048d0 FORMAT "%3.0" /end MEASUREMENT
/begin MEASUREMENT tbl_frf[4].envd_cus_set_spc[0][1] "Freeze frame FRF_CUS_SET_SPC: environmental data specific to each failure (not fixed by law) stored in set" UBYTE _CNV_A_R_LINEAR_____0_CM 1 100. 0. 255. DISPLAY_IDENTIFIER ENVD_CUS_SET_SPC_2_1_4 ECU_ADDRESS 0xd00048d1 FORMAT "%3.0" /end MEASUREMENT
/begin MEASUREMENT tbl_frf[4].envd_cus_set_spc[0][2] "Freeze frame FRF_CUS_SET_SPC: environmental data specific to each failure (not fixed by law) stored in set" UBYTE _CNV_A_R_LINEAR_____0_CM 1 100. 0. 255. DISPLAY_IDENTIFIER ENVD_CUS_SET_SPC_3_1_4 ECU_ADDRESS 0xd00048d2 FORMAT "%3.0" /end MEASUREMENT
/begin MEASUREMENT tbl_frf[4].envd_cus_set_spc[0][3] "Freeze frame FRF_CUS_SET_SPC: environmental data specific to each failure (not fixed by law) stored in set" UBYTE _CNV_A_R_LINEAR_____0_CM 1 100. 0. 255. DISPLAY_IDENTIFIER ENVD_CUS_SET_SPC_4_1_4 ECU_ADDRESS 0xd00048d3 FORMAT "%3.0" /end MEASUREMENT
/begin MEASUREMENT tbl_frf[4].envd_cus_set_spc[1][0] "Freeze frame FRF_CUS_SET_SPC: environmental data specific to each failure (not fixed by law) stored in set" UBYTE _CNV_A_R_LINEAR_____0_CM 1 100. 0. 255. DISPLAY_IDENTIFIER ENVD_CUS_SET_SPC_1_2_4 ECU_ADDRESS 0xd00048d4 FORMAT "%3.0" /end MEASUREMENT
/begin MEASUREMENT tbl_frf[4].envd_cus_set_spc[1][1] "Freeze frame FRF_CUS_SET_SPC: environmental data specific to each failure (not fixed by law) stored in set" UBYTE _CNV_A_R_LINEAR_____0_CM 1 100. 0. 255. DISPLAY_IDENTIFIER ENVD_CUS_SET_SPC_2_2_4 ECU_ADDRESS 0xd00048d5 FORMAT "%3.0" /end MEASUREMENT
/begin MEASUREMENT tbl_frf[4].envd_cus_set_spc[1][2] "Freeze frame FRF_CUS_SET_SPC: environmental data specific to each failure (not fixed by law) stored in set" UBYTE _CNV_A_R_LINEAR_____0_CM 1 100. 0. 255. DISPLAY_IDENTIFIER ENVD_CUS_SET_SPC_3_2_4 ECU_ADDRESS 0xd00048d6 FORMAT "%3.0" /end MEASUREMENT
/begin MEASUREMENT tbl_frf[4].envd_cus_set_spc[1][3] "Freeze frame FRF_CUS_SET_SPC: environmental data specific to each failure (not fixed by law) stored in set" UBYTE _CNV_A_R_LINEAR_____0_CM 1 100. 0. 255. DISPLAY_IDENTIFIER ENVD_CUS_SET_SPC_4_2_4 ECU_ADDRESS 0xd00048d7 FORMAT "%3.0" /end MEASUREMENT
/begin MEASUREMENT tbl_frf[4].envd_cus_set_spc[2][0] "Freeze frame FRF_CUS_SET_SPC: environmental data specific to each failure (not fixed by law) stored in set" UBYTE _CNV_A_R_LINEAR_____0_CM 1 100. 0. 255. DISPLAY_IDENTIFIER ENVD_CUS_SET_SPC_1_3_4 ECU_ADDRESS 0xd00048d8 FORMAT "%3.0" /end MEASUREMENT
/begin MEASUREMENT tbl_frf[4].envd_cus_set_spc[2][1] "Freeze frame FRF_CUS_SET_SPC: environmental data specific to each failure (not fixed by law) stored in set" UBYTE _CNV_A_R_LINEAR_____0_CM 1 100. 0. 255. DISPLAY_IDENTIFIER ENVD_CUS_SET_SPC_2_3_4 ECU_ADDRESS 0xd00048d9 FORMAT "%3.0" /end MEASUREMENT
/begin MEASUREMENT tbl_frf[4].envd_cus_set_spc[2][2] "Freeze frame FRF_CUS_SET_SPC: environmental data specific to each failure (not fixed by law) stored in set" UBYTE _CNV_A_R_LINEAR_____0_CM 1 100. 0. 255. DISPLAY_IDENTIFIER ENVD_CUS_SET_SPC_3_3_4 ECU_ADDRESS 0xd00048da FORMAT "%3.0" /end MEASUREMENT
/begin MEASUREMENT tbl_frf[4].envd_cus_set_spc[2][3] "Freeze frame FRF_CUS_SET_SPC: environmental data specific to each failure (not fixed by law) stored in set" UBYTE _CNV_A_R_LINEAR_____0_CM 1 100. 0. 255. DISPLAY_IDENTIFIER ENVD_CUS_SET_SPC_4_3_4 ECU_ADDRESS 0xd00048db FORMAT "%3.0" /end MEASUREMENT
/begin MEASUREMENT tbl_frf[5].envd_obd[0] "Freeze frame FRF_OBD: environmental data (fixed by law)" UBYTE _CNV_A_R_LINEAR_____0_CM 1 100. 0. 255. DISPLAY_IDENTIFIER ENVD_OBD_1_5 ECU_ADDRESS 0xd00048e0 FORMAT "%3.0" /end MEASUREMENT
/begin MEASUREMENT tbl_frf[5].envd_obd[1] "Freeze frame FRF_OBD: environmental data (fixed by law)" UBYTE _CNV_A_R_LINEAR_____0_CM 1 100. 0. 255. DISPLAY_IDENTIFIER ENVD_OBD_2_5 ECU_ADDRESS 0xd00048e1 FORMAT "%3.0" /end MEASUREMENT
/begin MEASUREMENT tbl_frf[5].envd_obd[2] "Freeze frame FRF_OBD: environmental data (fixed by law)" UBYTE _CNV_A_R_LINEAR_____0_CM 1 100. 0. 255. DISPLAY_IDENTIFIER ENVD_OBD_3_5 ECU_ADDRESS 0xd00048e2 FORMAT "%3.0" /end MEASUREMENT
/begin MEASUREMENT tbl_frf[5].envd_obd[3] "Freeze frame FRF_OBD: environmental data (fixed by law)" UBYTE _CNV_A_R_LINEAR_____0_CM 1 100. 0. 255. DISPLAY_IDENTIFIER ENVD_OBD_4_5 ECU_ADDRESS 0xd00048e3 FORMAT "%3.0" /end MEASUREMENT
/begin MEASUREMENT tbl_frf[5].envd_obd[4] "Freeze frame FRF_OBD: environmental data (fixed by law)" UBYTE _CNV_A_R_LINEAR_____0_CM 1 100. 0. 255. DISPLAY_IDENTIFIER ENVD_OBD_5_5 ECU_ADDRESS 0xd00048e4 FORMAT "%3.0" /end MEASUREMENT
/begin MEASUREMENT tbl_frf[5].envd_obd[5] "Freeze frame FRF_OBD: environmental data (fixed by law)" UBYTE _CNV_A_R_LINEAR_____0_CM 1 100. 0. 255. DISPLAY_IDENTIFIER ENVD_OBD_6_5 ECU_ADDRESS 0xd00048e5 FORMAT "%3.0" /end MEASUREMENT
/begin MEASUREMENT tbl_frf[5].envd_obd[6] "Freeze frame FRF_OBD: environmental data (fixed by law)" UBYTE _CNV_A_R_LINEAR_____0_CM 1 100. 0. 255. DISPLAY_IDENTIFIER ENVD_OBD_7_5 ECU_ADDRESS 0xd00048e6 FORMAT "%3.0" /end MEASUREMENT
/begin MEASUREMENT tbl_frf[5].envd_obd[7] "Freeze frame FRF_OBD: environmental data (fixed by law)" UBYTE _CNV_A_R_LINEAR_____0_CM 1 100. 0. 255. DISPLAY_IDENTIFIER ENVD_OBD_8_5 ECU_ADDRESS 0xd00048e7 FORMAT "%3.0" /end MEASUREMENT
/begin MEASUREMENT tbl_frf[5].envd_obd[8] "Freeze frame FRF_OBD: environmental data (fixed by law)" UBYTE _CNV_A_R_LINEAR_____0_CM 1 100. 0. 255. DISPLAY_IDENTIFIER ENVD_OBD_9_5 ECU_ADDRESS 0xd00048e8 FORMAT "%3.0" /end MEASUREMENT
/begin MEASUREMENT tbl_frf[5].envd_obd[9] "Freeze frame FRF_OBD: environmental data (fixed by law)" UBYTE _CNV_A_R_LINEAR_____0_CM 1 100. 0. 255. DISPLAY_IDENTIFIER ENVD_OBD_10_5 ECU_ADDRESS 0xd00048e9 FORMAT "%3.0" /end MEASUREMENT
/begin MEASUREMENT tbl_frf[5].envd_obd[10] "Freeze frame FRF_OBD: environmental data (fixed by law)" UBYTE _CNV_A_R_LINEAR_____0_CM 1 100. 0. 255. DISPLAY_IDENTIFIER ENVD_OBD_11_5 ECU_ADDRESS 0xd00048ea FORMAT "%3.0" /end MEASUREMENT
/begin MEASUREMENT tbl_frf[5].envd_obd[11] "Freeze frame FRF_OBD: environmental data (fixed by law)" UBYTE _CNV_A_R_LINEAR_____0_CM 1 100. 0. 255. DISPLAY_IDENTIFIER ENVD_OBD_12_5 ECU_ADDRESS 0xd00048eb FORMAT "%3.0" /end MEASUREMENT
/begin MEASUREMENT tbl_frf[5].envd_obd[12] "Freeze frame FRF_OBD: environmental data (fixed by law)" UBYTE _CNV_A_R_LINEAR_____0_CM 1 100. 0. 255. DISPLAY_IDENTIFIER ENVD_OBD_13_5 ECU_ADDRESS 0xd00048ec FORMAT "%3.0" /end MEASUREMENT
/begin MEASUREMENT tbl_frf[5].envd_obd[13] "Freeze frame FRF_OBD: environmental data (fixed by law)" UBYTE _CNV_A_R_LINEAR_____0_CM 1 100. 0. 255. DISPLAY_IDENTIFIER ENVD_OBD_14_5 ECU_ADDRESS 0xd00048ed FORMAT "%3.0" /end MEASUREMENT
/begin MEASUREMENT tbl_frf[5].envd_obd[14] "Freeze frame FRF_OBD: environmental data (fixed by law)" UBYTE _CNV_A_R_LINEAR_____0_CM 1 100. 0. 255. DISPLAY_IDENTIFIER ENVD_OBD_15_5 ECU_ADDRESS 0xd00048ee FORMAT "%3.0" /end MEASUREMENT
/begin MEASUREMENT tbl_frf[5].envd_obd[15] "Freeze frame FRF_OBD: environmental data (fixed by law)" UBYTE _CNV_A_R_LINEAR_____0_CM 1 100. 0. 255. DISPLAY_IDENTIFIER ENVD_OBD_16_5 ECU_ADDRESS 0xd00048ef FORMAT "%3.0" /end MEASUREMENT
/begin MEASUREMENT tbl_frf[5].envd_obd[16] "Freeze frame FRF_OBD: environmental data (fixed by law)" UBYTE _CNV_A_R_LINEAR_____0_CM 1 100. 0. 255. DISPLAY_IDENTIFIER ENVD_OBD_17_5 ECU_ADDRESS 0xd00048f0 FORMAT "%3.0" /end MEASUREMENT
/begin MEASUREMENT tbl_frf[5].envd_obd[17] "Freeze frame FRF_OBD: environmental data (fixed by law)" UBYTE _CNV_A_R_LINEAR_____0_CM 1 100. 0. 255. DISPLAY_IDENTIFIER ENVD_OBD_18_5 ECU_ADDRESS 0xd00048f1 FORMAT "%3.0" /end MEASUREMENT
/begin MEASUREMENT tbl_frf[5].envd_obd[18] "Freeze frame FRF_OBD: environmental data (fixed by law)" UBYTE _CNV_A_R_LINEAR_____0_CM 1 100. 0. 255. DISPLAY_IDENTIFIER ENVD_OBD_19_5 ECU_ADDRESS 0xd00048f2 FORMAT "%3.0" /end MEASUREMENT
/begin MEASUREMENT tbl_frf[5].envd_obd[19] "Freeze frame FRF_OBD: environmental data (fixed by law)" UBYTE _CNV_A_R_LINEAR_____0_CM 1 100. 0. 255. DISPLAY_IDENTIFIER ENVD_OBD_20_5 ECU_ADDRESS 0xd00048f3 FORMAT "%3.0" /end MEASUREMENT
/begin MEASUREMENT tbl_frf[5].envd_obd[20] "Freeze frame FRF_OBD: environmental data (fixed by law)" UBYTE _CNV_A_R_LINEAR_____0_CM 1 100. 0. 255. DISPLAY_IDENTIFIER ENVD_OBD_21_5 ECU_ADDRESS 0xd00048f4 FORMAT "%3.0" /end MEASUREMENT
/begin MEASUREMENT tbl_frf[5].envd_obd[21] "Freeze frame FRF_OBD: environmental data (fixed by law)" UBYTE _CNV_A_R_LINEAR_____0_CM 1 100. 0. 255. DISPLAY_IDENTIFIER ENVD_OBD_22_5 ECU_ADDRESS 0xd00048f5 FORMAT "%3.0" /end MEASUREMENT
/begin MEASUREMENT tbl_frf[5].envd_obd[22] "Freeze frame FRF_OBD: environmental data (fixed by law)" UBYTE _CNV_A_R_LINEAR_____0_CM 1 100. 0. 255. DISPLAY_IDENTIFIER ENVD_OBD_23_5 ECU_ADDRESS 0xd00048f6 FORMAT "%3.0" /end MEASUREMENT
/begin MEASUREMENT tbl_frf[5].envd_obd[23] "Freeze frame FRF_OBD: environmental data (fixed by law)" UBYTE _CNV_A_R_LINEAR_____0_CM 1 100. 0. 255. DISPLAY_IDENTIFIER ENVD_OBD_24_5 ECU_ADDRESS 0xd00048f7 FORMAT "%3.0" /end MEASUREMENT
/begin MEASUREMENT tbl_frf[5].envd_obd[24] "Freeze frame FRF_OBD: environmental data (fixed by law)" UBYTE _CNV_A_R_LINEAR_____0_CM 1 100. 0. 255. DISPLAY_IDENTIFIER ENVD_OBD_25_5 ECU_ADDRESS 0xd00048f8 FORMAT "%3.0" /end MEASUREMENT
/begin MEASUREMENT tbl_frf[5].envd_obd[25] "Freeze frame FRF_OBD: environmental data (fixed by law)" UBYTE _CNV_A_R_LINEAR_____0_CM 1 100. 0. 255. DISPLAY_IDENTIFIER ENVD_OBD_26_5 ECU_ADDRESS 0xd00048f9 FORMAT "%3.0" /end MEASUREMENT
/begin MEASUREMENT tbl_frf[5].envd_obd[26] "Freeze frame FRF_OBD: environmental data (fixed by law)" UBYTE _CNV_A_R_LINEAR_____0_CM 1 100. 0. 255. DISPLAY_IDENTIFIER ENVD_OBD_27_5 ECU_ADDRESS 0xd00048fa FORMAT "%3.0" /end MEASUREMENT
/begin MEASUREMENT tbl_frf[5].envd_obd[27] "Freeze frame FRF_OBD: environmental data (fixed by law)" UBYTE _CNV_A_R_LINEAR_____0_CM 1 100. 0. 255. DISPLAY_IDENTIFIER ENVD_OBD_28_5 ECU_ADDRESS 0xd00048fb FORMAT "%3.0" /end MEASUREMENT
/begin MEASUREMENT tbl_frf[5].envd_obd[28] "Freeze frame FRF_OBD: environmental data (fixed by law)" UBYTE _CNV_A_R_LINEAR_____0_CM 1 100. 0. 255. DISPLAY_IDENTIFIER ENVD_OBD_29_5 ECU_ADDRESS 0xd00048fc FORMAT "%3.0" /end MEASUREMENT
/begin MEASUREMENT tbl_frf[5].envd_obd[29] "Freeze frame FRF_OBD: environmental data (fixed by law)" UBYTE _CNV_A_R_LINEAR_____0_CM 1 100. 0. 255. DISPLAY_IDENTIFIER ENVD_OBD_30_5 ECU_ADDRESS 0xd00048fd FORMAT "%3.0" /end MEASUREMENT
/begin MEASUREMENT tbl_frf[5].envd_obd[30] "Freeze frame FRF_OBD: environmental data (fixed by law)" UBYTE _CNV_A_R_LINEAR_____0_CM 1 100. 0. 255. DISPLAY_IDENTIFIER ENVD_OBD_31_5 ECU_ADDRESS 0xd00048fe FORMAT "%3.0" /end MEASUREMENT
/begin MEASUREMENT tbl_frf[5].envd_obd[31] "Freeze frame FRF_OBD: environmental data (fixed by law)" UBYTE _CNV_A_R_LINEAR_____0_CM 1 100. 0. 255. DISPLAY_IDENTIFIER ENVD_OBD_32_5 ECU_ADDRESS 0xd00048ff FORMAT "%3.0" /end MEASUREMENT
/begin MEASUREMENT tbl_frf[5].envd_obd[32] "Freeze frame FRF_OBD: environmental data (fixed by law)" UBYTE _CNV_A_R_LINEAR_____0_CM 1 100. 0. 255. DISPLAY_IDENTIFIER ENVD_OBD_33_5 ECU_ADDRESS 0xd0004900 FORMAT "%3.0" /end MEASUREMENT
/begin MEASUREMENT tbl_frf[5].envd_obd[33] "Freeze frame FRF_OBD: environmental data (fixed by law)" UBYTE _CNV_A_R_LINEAR_____0_CM 1 100. 0. 255. DISPLAY_IDENTIFIER ENVD_OBD_34_5 ECU_ADDRESS 0xd0004901 FORMAT "%3.0" /end MEASUREMENT
/begin MEASUREMENT tbl_frf[5].envd_obd[34] "Freeze frame FRF_OBD: environmental data (fixed by law)" UBYTE _CNV_A_R_LINEAR_____0_CM 1 100. 0. 255. DISPLAY_IDENTIFIER ENVD_OBD[34] ECU_ADDRESS 0xd0004902 FORMAT "%3.0" /end MEASUREMENT
/begin MEASUREMENT tbl_frf[5].envd_cus_cmn[0] "Freeze frame FRF_CUS_CMN: environmental data common to all failure (not fixed by law)" UBYTE _CNV_A_R_LINEAR_____0_CM 1 100. 0. 255. DISPLAY_IDENTIFIER ENVD_CUS_CMN_1_5 ECU_ADDRESS 0xd0004903 FORMAT "%3.0" /end MEASUREMENT
/begin MEASUREMENT tbl_frf[5].envd_cus_set_cmn[0][0] "Freeze frame FRF_CUS_SET_CMN: environmental data common to all failure (not fixed by law) stored in set" UBYTE _CNV_A_R_LINEAR_____0_CM 1 100. 0. 255. DISPLAY_IDENTIFIER ENVD_CUS_SET_CMN_1_1_5 ECU_ADDRESS 0xd0004904 FORMAT "%3.0" /end MEASUREMENT
/begin MEASUREMENT tbl_frf[5].envd_cus_set_cmn[0][1] "Freeze frame FRF_CUS_SET_CMN: environmental data common to all failure (not fixed by law) stored in set" UBYTE _CNV_A_R_LINEAR_____0_CM 1 100. 0. 255. DISPLAY_IDENTIFIER ENVD_CUS_SET_CMN_2_1_5 ECU_ADDRESS 0xd0004905 FORMAT "%3.0" /end MEASUREMENT
/begin MEASUREMENT tbl_frf[5].envd_cus_set_cmn[0][2] "Freeze frame FRF_CUS_SET_CMN: environmental data common to all failure (not fixed by law) stored in set" UBYTE _CNV_A_R_LINEAR_____0_CM 1 100. 0. 255. DISPLAY_IDENTIFIER ENVD_CUS_SET_CMN_3_1_5 ECU_ADDRESS 0xd0004906 FORMAT "%3.0" /end MEASUREMENT
/begin MEASUREMENT tbl_frf[5].envd_cus_set_cmn[1][0] "Freeze frame FRF_CUS_SET_CMN: environmental data common to all failure (not fixed by law) stored in set" UBYTE _CNV_A_R_LINEAR_____0_CM 1 100. 0. 255. DISPLAY_IDENTIFIER ENVD_CUS_SET_CMN_1_2_5 ECU_ADDRESS 0xd0004907 FORMAT "%3.0" /end MEASUREMENT
/begin MEASUREMENT tbl_frf[5].envd_cus_set_cmn[1][1] "Freeze frame FRF_CUS_SET_CMN: environmental data common to all failure (not fixed by law) stored in set" UBYTE _CNV_A_R_LINEAR_____0_CM 1 100. 0. 255. DISPLAY_IDENTIFIER ENVD_CUS_SET_CMN_2_2_5 ECU_ADDRESS 0xd0004908 FORMAT "%3.0" /end MEASUREMENT
/begin MEASUREMENT tbl_frf[5].envd_cus_set_cmn[1][2] "Freeze frame FRF_CUS_SET_CMN: environmental data common to all failure (not fixed by law) stored in set" UBYTE _CNV_A_R_LINEAR_____0_CM 1 100. 0. 255. DISPLAY_IDENTIFIER ENVD_CUS_SET_CMN_3_2_5 ECU_ADDRESS 0xd0004909 FORMAT "%3.0" /end MEASUREMENT
/begin MEASUREMENT tbl_frf[5].envd_cus_set_cmn[2][0] "Freeze frame FRF_CUS_SET_CMN: environmental data common to all failure (not fixed by law) stored in set" UBYTE _CNV_A_R_LINEAR_____0_CM 1 100. 0. 255. DISPLAY_IDENTIFIER ENVD_CUS_SET_CMN_1_3_5 ECU_ADDRESS 0xd000490a FORMAT "%3.0" /end MEASUREMENT
/begin MEASUREMENT tbl_frf[5].envd_cus_set_cmn[2][1] "Freeze frame FRF_CUS_SET_CMN: environmental data common to all failure (not fixed by law) stored in set" UBYTE _CNV_A_R_LINEAR_____0_CM 1 100. 0. 255. DISPLAY_IDENTIFIER ENVD_CUS_SET_CMN_2_3_5 ECU_ADDRESS 0xd000490b FORMAT "%3.0" /end MEASUREMENT
/begin MEASUREMENT tbl_frf[5].envd_cus_set_cmn[2][2] "Freeze frame FRF_CUS_SET_CMN: environmental data common to all failure (not fixed by law) stored in set" UBYTE _CNV_A_R_LINEAR_____0_CM 1 100. 0. 255. DISPLAY_IDENTIFIER ENVD_CUS_SET_CMN_3_3_5 ECU_ADDRESS 0xd000490c FORMAT "%3.0" /end MEASUREMENT
/begin MEASUREMENT tbl_frf[5].envd_cus_set_spc[0][0] "Freeze frame FRF_CUS_SET_SPC: environmental data specific to each failure (not fixed by law) stored in set" UBYTE _CNV_A_R_LINEAR_____0_CM 1 100. 0. 255. DISPLAY_IDENTIFIER ENVD_CUS_SET_SPC_1_1_5 ECU_ADDRESS 0xd0004910 FORMAT "%3.0" /end MEASUREMENT
/begin MEASUREMENT tbl_frf[5].envd_cus_set_spc[0][1] "Freeze frame FRF_CUS_SET_SPC: environmental data specific to each failure (not fixed by law) stored in set" UBYTE _CNV_A_R_LINEAR_____0_CM 1 100. 0. 255. DISPLAY_IDENTIFIER ENVD_CUS_SET_SPC_2_1_5 ECU_ADDRESS 0xd0004911 FORMAT "%3.0" /end MEASUREMENT
/begin MEASUREMENT tbl_frf[5].envd_cus_set_spc[0][2] "Freeze frame FRF_CUS_SET_SPC: environmental data specific to each failure (not fixed by law) stored in set" UBYTE _CNV_A_R_LINEAR_____0_CM 1 100. 0. 255. DISPLAY_IDENTIFIER ENVD_CUS_SET_SPC_3_1_5 ECU_ADDRESS 0xd0004912 FORMAT "%3.0" /end MEASUREMENT
/begin MEASUREMENT tbl_frf[5].envd_cus_set_spc[0][3] "Freeze frame FRF_CUS_SET_SPC: environmental data specific to each failure (not fixed by law) stored in set" UBYTE _CNV_A_R_LINEAR_____0_CM 1 100. 0. 255. DISPLAY_IDENTIFIER ENVD_CUS_SET_SPC_4_1_5 ECU_ADDRESS 0xd0004913 FORMAT "%3.0" /end MEASUREMENT
/begin MEASUREMENT tbl_frf[5].envd_cus_set_spc[1][0] "Freeze frame FRF_CUS_SET_SPC: environmental data specific to each failure (not fixed by law) stored in set" UBYTE _CNV_A_R_LINEAR_____0_CM 1 100. 0. 255. DISPLAY_IDENTIFIER ENVD_CUS_SET_SPC_1_2_5 ECU_ADDRESS 0xd0004914 FORMAT "%3.0" /end MEASUREMENT
/begin MEASUREMENT tbl_frf[5].envd_cus_set_spc[1][1] "Freeze frame FRF_CUS_SET_SPC: environmental data specific to each failure (not fixed by law) stored in set" UBYTE _CNV_A_R_LINEAR_____0_CM 1 100. 0. 255. DISPLAY_IDENTIFIER ENVD_CUS_SET_SPC_2_2_5 ECU_ADDRESS 0xd0004915 FORMAT "%3.0" /end MEASUREMENT
/begin MEASUREMENT tbl_frf[5].envd_cus_set_spc[1][2] "Freeze frame FRF_CUS_SET_SPC: environmental data specific to each failure (not fixed by law) stored in set" UBYTE _CNV_A_R_LINEAR_____0_CM 1 100. 0. 255. DISPLAY_IDENTIFIER ENVD_CUS_SET_SPC_3_2_5 ECU_ADDRESS 0xd0004916 FORMAT "%3.0" /end MEASUREMENT
/begin MEASUREMENT tbl_frf[5].envd_cus_set_spc[1][3] "Freeze frame FRF_CUS_SET_SPC: environmental data specific to each failure (not fixed by law) stored in set" UBYTE _CNV_A_R_LINEAR_____0_CM 1 100. 0. 255. DISPLAY_IDENTIFIER ENVD_CUS_SET_SPC_4_2_5 ECU_ADDRESS 0xd0004917 FORMAT "%3.0" /end MEASUREMENT
/begin MEASUREMENT tbl_frf[5].envd_cus_set_spc[2][0] "Freeze frame FRF_CUS_SET_SPC: environmental data specific to each failure (not fixed by law) stored in set" UBYTE _CNV_A_R_LINEAR_____0_CM 1 100. 0. 255. DISPLAY_IDENTIFIER ENVD_CUS_SET_SPC_1_3_5 ECU_ADDRESS 0xd0004918 FORMAT "%3.0" /end MEASUREMENT
/begin MEASUREMENT tbl_frf[5].envd_cus_set_spc[2][1] "Freeze frame FRF_CUS_SET_SPC: environmental data specific to each failure (not fixed by law) stored in set" UBYTE _CNV_A_R_LINEAR_____0_CM 1 100. 0. 255. DISPLAY_IDENTIFIER ENVD_CUS_SET_SPC_2_3_5 ECU_ADDRESS 0xd0004919 FORMAT "%3.0" /end MEASUREMENT
/begin MEASUREMENT tbl_frf[5].envd_cus_set_spc[2][2] "Freeze frame FRF_CUS_SET_SPC: environmental data specific to each failure (not fixed by law) stored in set" UBYTE _CNV_A_R_LINEAR_____0_CM 1 100. 0. 255. DISPLAY_IDENTIFIER ENVD_CUS_SET_SPC_3_3_5 ECU_ADDRESS 0xd000491a FORMAT "%3.0" /end MEASUREMENT
/begin MEASUREMENT tbl_frf[5].envd_cus_set_spc[2][3] "Freeze frame FRF_CUS_SET_SPC: environmental data specific to each failure (not fixed by law) stored in set" UBYTE _CNV_A_R_LINEAR_____0_CM 1 100. 0. 255. DISPLAY_IDENTIFIER ENVD_CUS_SET_SPC_4_3_5 ECU_ADDRESS 0xd000491b FORMAT "%3.0" /end MEASUREMENT
/begin MEASUREMENT tbl_frf[6].envd_obd[0] "Freeze frame FRF_OBD: environmental data (fixed by law)" UBYTE _CNV_A_R_LINEAR_____0_CM 1 100. 0. 255. DISPLAY_IDENTIFIER ENVD_OBD_1_6 ECU_ADDRESS 0xd0004920 FORMAT "%3.0" /end MEASUREMENT
/begin MEASUREMENT tbl_frf[6].envd_obd[1] "Freeze frame FRF_OBD: environmental data (fixed by law)" UBYTE _CNV_A_R_LINEAR_____0_CM 1 100. 0. 255. DISPLAY_IDENTIFIER ENVD_OBD_2_6 ECU_ADDRESS 0xd0004921 FORMAT "%3.0" /end MEASUREMENT
/begin MEASUREMENT tbl_frf[6].envd_obd[2] "Freeze frame FRF_OBD: environmental data (fixed by law)" UBYTE _CNV_A_R_LINEAR_____0_CM 1 100. 0. 255. DISPLAY_IDENTIFIER ENVD_OBD_3_6 ECU_ADDRESS 0xd0004922 FORMAT "%3.0" /end MEASUREMENT
/begin MEASUREMENT tbl_frf[6].envd_obd[3] "Freeze frame FRF_OBD: environmental data (fixed by law)" UBYTE _CNV_A_R_LINEAR_____0_CM 1 100. 0. 255. DISPLAY_IDENTIFIER ENVD_OBD_4_6 ECU_ADDRESS 0xd0004923 FORMAT "%3.0" /end MEASUREMENT
/begin MEASUREMENT tbl_frf[6].envd_obd[4] "Freeze frame FRF_OBD: environmental data (fixed by law)" UBYTE _CNV_A_R_LINEAR_____0_CM 1 100. 0. 255. DISPLAY_IDENTIFIER ENVD_OBD_5_6 ECU_ADDRESS 0xd0004924 FORMAT "%3.0" /end MEASUREMENT
/begin MEASUREMENT tbl_frf[6].envd_obd[5] "Freeze frame FRF_OBD: environmental data (fixed by law)" UBYTE _CNV_A_R_LINEAR_____0_CM 1 100. 0. 255. DISPLAY_IDENTIFIER ENVD_OBD_6_6 ECU_ADDRESS 0xd0004925 FORMAT "%3.0" /end MEASUREMENT
/begin MEASUREMENT tbl_frf[6].envd_obd[6] "Freeze frame FRF_OBD: environmental data (fixed by law)" UBYTE _CNV_A_R_LINEAR_____0_CM 1 100. 0. 255. DISPLAY_IDENTIFIER ENVD_OBD_7_6 ECU_ADDRESS 0xd0004926 FORMAT "%3.0" /end MEASUREMENT
/begin MEASUREMENT tbl_frf[6].envd_obd[7] "Freeze frame FRF_OBD: environmental data (fixed by law)" UBYTE _CNV_A_R_LINEAR_____0_CM 1 100. 0. 255. DISPLAY_IDENTIFIER ENVD_OBD_8_6 ECU_ADDRESS 0xd0004927 FORMAT "%3.0" /end MEASUREMENT
/begin MEASUREMENT tbl_frf[6].envd_obd[8] "Freeze frame FRF_OBD: environmental data (fixed by law)" UBYTE _CNV_A_R_LINEAR_____0_CM 1 100. 0. 255. DISPLAY_IDENTIFIER ENVD_OBD_9_6 ECU_ADDRESS 0xd0004928 FORMAT "%3.0" /end MEASUREMENT
/begin MEASUREMENT tbl_frf[6].envd_obd[9] "Freeze frame FRF_OBD: environmental data (fixed by law)" UBYTE _CNV_A_R_LINEAR_____0_CM 1 100. 0. 255. DISPLAY_IDENTIFIER ENVD_OBD_10_6 ECU_ADDRESS 0xd0004929 FORMAT "%3.0" /end MEASUREMENT
/begin MEASUREMENT tbl_frf[6].envd_obd[10] "Freeze frame FRF_OBD: environmental data (fixed by law)" UBYTE _CNV_A_R_LINEAR_____0_CM 1 100. 0. 255. DISPLAY_IDENTIFIER ENVD_OBD_11_6 ECU_ADDRESS 0xd000492a FORMAT "%3.0" /end MEASUREMENT
/begin MEASUREMENT tbl_frf[6].envd_obd[11] "Freeze frame FRF_OBD: environmental data (fixed by law)" UBYTE _CNV_A_R_LINEAR_____0_CM 1 100. 0. 255. DISPLAY_IDENTIFIER ENVD_OBD_12_6 ECU_ADDRESS 0xd000492b FORMAT "%3.0" /end MEASUREMENT
/begin MEASUREMENT tbl_frf[6].envd_obd[12] "Freeze frame FRF_OBD: environmental data (fixed by law)" UBYTE _CNV_A_R_LINEAR_____0_CM 1 100. 0. 255. DISPLAY_IDENTIFIER ENVD_OBD_13_6 ECU_ADDRESS 0xd000492c FORMAT "%3.0" /end MEASUREMENT
/begin MEASUREMENT tbl_frf[6].envd_obd[13] "Freeze frame FRF_OBD: environmental data (fixed by law)" UBYTE _CNV_A_R_LINEAR_____0_CM 1 100. 0. 255. DISPLAY_IDENTIFIER ENVD_OBD_14_6 ECU_ADDRESS 0xd000492d FORMAT "%3.0" /end MEASUREMENT
/begin MEASUREMENT tbl_frf[6].envd_obd[14] "Freeze frame FRF_OBD: environmental data (fixed by law)" UBYTE _CNV_A_R_LINEAR_____0_CM 1 100. 0. 255. DISPLAY_IDENTIFIER ENVD_OBD_15_6 ECU_ADDRESS 0xd000492e FORMAT "%3.0" /end MEASUREMENT
/begin MEASUREMENT tbl_frf[6].envd_obd[15] "Freeze frame FRF_OBD: environmental data (fixed by law)" UBYTE _CNV_A_R_LINEAR_____0_CM 1 100. 0. 255. DISPLAY_IDENTIFIER ENVD_OBD_16_6 ECU_ADDRESS 0xd000492f FORMAT "%3.0" /end MEASUREMENT
/begin MEASUREMENT tbl_frf[6].envd_obd[16] "Freeze frame FRF_OBD: environmental data (fixed by law)" UBYTE _CNV_A_R_LINEAR_____0_CM 1 100. 0. 255. DISPLAY_IDENTIFIER ENVD_OBD_17_6 ECU_ADDRESS 0xd0004930 FORMAT "%3.0" /end MEASUREMENT
/begin MEASUREMENT tbl_frf[6].envd_obd[17] "Freeze frame FRF_OBD: environmental data (fixed by law)" UBYTE _CNV_A_R_LINEAR_____0_CM 1 100. 0. 255. DISPLAY_IDENTIFIER ENVD_OBD_18_6 ECU_ADDRESS 0xd0004931 FORMAT "%3.0" /end MEASUREMENT
/begin MEASUREMENT tbl_frf[6].envd_obd[18] "Freeze frame FRF_OBD: environmental data (fixed by law)" UBYTE _CNV_A_R_LINEAR_____0_CM 1 100. 0. 255. DISPLAY_IDENTIFIER ENVD_OBD_19_6 ECU_ADDRESS 0xd0004932 FORMAT "%3.0" /end MEASUREMENT
/begin MEASUREMENT tbl_frf[6].envd_obd[19] "Freeze frame FRF_OBD: environmental data (fixed by law)" UBYTE _CNV_A_R_LINEAR_____0_CM 1 100. 0. 255. DISPLAY_IDENTIFIER ENVD_OBD_20_6 ECU_ADDRESS 0xd0004933 FORMAT "%3.0" /end MEASUREMENT
/begin MEASUREMENT tbl_frf[6].envd_obd[20] "Freeze frame FRF_OBD: environmental data (fixed by law)" UBYTE _CNV_A_R_LINEAR_____0_CM 1 100. 0. 255. DISPLAY_IDENTIFIER ENVD_OBD_21_6 ECU_ADDRESS 0xd0004934 FORMAT "%3.0" /end MEASUREMENT
/begin MEASUREMENT tbl_frf[6].envd_obd[21] "Freeze frame FRF_OBD: environmental data (fixed by law)" UBYTE _CNV_A_R_LINEAR_____0_CM 1 100. 0. 255. DISPLAY_IDENTIFIER ENVD_OBD_22_6 ECU_ADDRESS 0xd0004935 FORMAT "%3.0" /end MEASUREMENT
/begin MEASUREMENT tbl_frf[6].envd_obd[22] "Freeze frame FRF_OBD: environmental data (fixed by law)" UBYTE _CNV_A_R_LINEAR_____0_CM 1 100. 0. 255. DISPLAY_IDENTIFIER ENVD_OBD_23_6 ECU_ADDRESS 0xd0004936 FORMAT "%3.0" /end MEASUREMENT
/begin MEASUREMENT tbl_frf[6].envd_obd[23] "Freeze frame FRF_OBD: environmental data (fixed by law)" UBYTE _CNV_A_R_LINEAR_____0_CM 1 100. 0. 255. DISPLAY_IDENTIFIER ENVD_OBD_24_6 ECU_ADDRESS 0xd0004937 FORMAT "%3.0" /end MEASUREMENT
/begin MEASUREMENT tbl_frf[6].envd_obd[24] "Freeze frame FRF_OBD: environmental data (fixed by law)" UBYTE _CNV_A_R_LINEAR_____0_CM 1 100. 0. 255. DISPLAY_IDENTIFIER ENVD_OBD_25_6 ECU_ADDRESS 0xd0004938 FORMAT "%3.0" /end MEASUREMENT
/begin MEASUREMENT tbl_frf[6].envd_obd[25] "Freeze frame FRF_OBD: environmental data (fixed by law)" UBYTE _CNV_A_R_LINEAR_____0_CM 1 100. 0. 255. DISPLAY_IDENTIFIER ENVD_OBD_26_6 ECU_ADDRESS 0xd0004939 FORMAT "%3.0" /end MEASUREMENT
/begin MEASUREMENT tbl_frf[6].envd_obd[26] "Freeze frame FRF_OBD: environmental data (fixed by law)" UBYTE _CNV_A_R_LINEAR_____0_CM 1 100. 0. 255. DISPLAY_IDENTIFIER ENVD_OBD_27_6 ECU_ADDRESS 0xd000493a FORMAT "%3.0" /end MEASUREMENT
/begin MEASUREMENT tbl_frf[6].envd_obd[27] "Freeze frame FRF_OBD: environmental data (fixed by law)" UBYTE _CNV_A_R_LINEAR_____0_CM 1 100. 0. 255. DISPLAY_IDENTIFIER ENVD_OBD_28_6 ECU_ADDRESS 0xd000493b FORMAT "%3.0" /end MEASUREMENT
/begin MEASUREMENT tbl_frf[6].envd_obd[28] "Freeze frame FRF_OBD: environmental data (fixed by law)" UBYTE _CNV_A_R_LINEAR_____0_CM 1 100. 0. 255. DISPLAY_IDENTIFIER ENVD_OBD_29_6 ECU_ADDRESS 0xd000493c FORMAT "%3.0" /end MEASUREMENT
/begin MEASUREMENT tbl_frf[6].envd_obd[29] "Freeze frame FRF_OBD: environmental data (fixed by law)" UBYTE _CNV_A_R_LINEAR_____0_CM 1 100. 0. 255. DISPLAY_IDENTIFIER ENVD_OBD_30_6 ECU_ADDRESS 0xd000493d FORMAT "%3.0" /end MEASUREMENT
/begin MEASUREMENT tbl_frf[6].envd_obd[30] "Freeze frame FRF_OBD: environmental data (fixed by law)" UBYTE _CNV_A_R_LINEAR_____0_CM 1 100. 0. 255. DISPLAY_IDENTIFIER ENVD_OBD_31_6 ECU_ADDRESS 0xd000493e FORMAT "%3.0" /end MEASUREMENT
/begin MEASUREMENT tbl_frf[6].envd_obd[31] "Freeze frame FRF_OBD: environmental data (fixed by law)" UBYTE _CNV_A_R_LINEAR_____0_CM 1 100. 0. 255. DISPLAY_IDENTIFIER ENVD_OBD_32_6 ECU_ADDRESS 0xd000493f FORMAT "%3.0" /end MEASUREMENT
/begin MEASUREMENT tbl_frf[6].envd_obd[32] "Freeze frame FRF_OBD: environmental data (fixed by law)" UBYTE _CNV_A_R_LINEAR_____0_CM 1 100. 0. 255. DISPLAY_IDENTIFIER ENVD_OBD_33_6 ECU_ADDRESS 0xd0004940 FORMAT "%3.0" /end MEASUREMENT
/begin MEASUREMENT tbl_frf[6].envd_obd[33] "Freeze frame FRF_OBD: environmental data (fixed by law)" UBYTE _CNV_A_R_LINEAR_____0_CM 1 100. 0. 255. DISPLAY_IDENTIFIER ENVD_OBD_34_6 ECU_ADDRESS 0xd0004941 FORMAT "%3.0" /end MEASUREMENT
/begin MEASUREMENT tbl_frf[6].envd_obd[34] "Freeze frame FRF_OBD: environmental data (fixed by law)" UBYTE _CNV_A_R_LINEAR_____0_CM 1 100. 0. 255. DISPLAY_IDENTIFIER ENVD_OBD[34] ECU_ADDRESS 0xd0004942 FORMAT "%3.0" /end MEASUREMENT
/begin MEASUREMENT tbl_frf[6].envd_cus_cmn[0] "Freeze frame FRF_CUS_CMN: environmental data common to all failure (not fixed by law)" UBYTE _CNV_A_R_LINEAR_____0_CM 1 100. 0. 255. DISPLAY_IDENTIFIER ENVD_CUS_CMN_1_6 ECU_ADDRESS 0xd0004943 FORMAT "%3.0" /end MEASUREMENT
/begin MEASUREMENT tbl_frf[6].envd_cus_set_cmn[0][0] "Freeze frame FRF_CUS_SET_CMN: environmental data common to all failure (not fixed by law) stored in set" UBYTE _CNV_A_R_LINEAR_____0_CM 1 100. 0. 255. DISPLAY_IDENTIFIER ENVD_CUS_SET_CMN_1_1_6 ECU_ADDRESS 0xd0004944 FORMAT "%3.0" /end MEASUREMENT
/begin MEASUREMENT tbl_frf[6].envd_cus_set_cmn[0][1] "Freeze frame FRF_CUS_SET_CMN: environmental data common to all failure (not fixed by law) stored in set" UBYTE _CNV_A_R_LINEAR_____0_CM 1 100. 0. 255. DISPLAY_IDENTIFIER ENVD_CUS_SET_CMN_2_1_6 ECU_ADDRESS 0xd0004945 FORMAT "%3.0" /end MEASUREMENT
/begin MEASUREMENT tbl_frf[6].envd_cus_set_cmn[0][2] "Freeze frame FRF_CUS_SET_CMN: environmental data common to all failure (not fixed by law) stored in set" UBYTE _CNV_A_R_LINEAR_____0_CM 1 100. 0. 255. DISPLAY_IDENTIFIER ENVD_CUS_SET_CMN_3_1_6 ECU_ADDRESS 0xd0004946 FORMAT "%3.0" /end MEASUREMENT
/begin MEASUREMENT tbl_frf[6].envd_cus_set_cmn[1][0] "Freeze frame FRF_CUS_SET_CMN: environmental data common to all failure (not fixed by law) stored in set" UBYTE _CNV_A_R_LINEAR_____0_CM 1 100. 0. 255. DISPLAY_IDENTIFIER ENVD_CUS_SET_CMN_1_2_6 ECU_ADDRESS 0xd0004947 FORMAT "%3.0" /end MEASUREMENT
/begin MEASUREMENT tbl_frf[6].envd_cus_set_cmn[1][1] "Freeze frame FRF_CUS_SET_CMN: environmental data common to all failure (not fixed by law) stored in set" UBYTE _CNV_A_R_LINEAR_____0_CM 1 100. 0. 255. DISPLAY_IDENTIFIER ENVD_CUS_SET_CMN_2_2_6 ECU_ADDRESS 0xd0004948 FORMAT "%3.0" /end MEASUREMENT
/begin MEASUREMENT tbl_frf[6].envd_cus_set_cmn[1][2] "Freeze frame FRF_CUS_SET_CMN: environmental data common to all failure (not fixed by law) stored in set" UBYTE _CNV_A_R_LINEAR_____0_CM 1 100. 0. 255. DISPLAY_IDENTIFIER ENVD_CUS_SET_CMN_3_2_6 ECU_ADDRESS 0xd0004949 FORMAT "%3.0" /end MEASUREMENT
/begin MEASUREMENT tbl_frf[6].envd_cus_set_cmn[2][0] "Freeze frame FRF_CUS_SET_CMN: environmental data common to all failure (not fixed by law) stored in set" UBYTE _CNV_A_R_LINEAR_____0_CM 1 100. 0. 255. DISPLAY_IDENTIFIER ENVD_CUS_SET_CMN_1_3_6 ECU_ADDRESS 0xd000494a FORMAT "%3.0" /end MEASUREMENT
/begin MEASUREMENT tbl_frf[6].envd_cus_set_cmn[2][1] "Freeze frame FRF_CUS_SET_CMN: environmental data common to all failure (not fixed by law) stored in set" UBYTE _CNV_A_R_LINEAR_____0_CM 1 100. 0. 255. DISPLAY_IDENTIFIER ENVD_CUS_SET_CMN_2_3_6 ECU_ADDRESS 0xd000494b FORMAT "%3.0" /end MEASUREMENT
/begin MEASUREMENT tbl_frf[6].envd_cus_set_cmn[2][2] "Freeze frame FRF_CUS_SET_CMN: environmental data common to all failure (not fixed by law) stored in set" UBYTE _CNV_A_R_LINEAR_____0_CM 1 100. 0. 255. DISPLAY_IDENTIFIER ENVD_CUS_SET_CMN_3_3_6 ECU_ADDRESS 0xd000494c FORMAT "%3.0" /end MEASUREMENT
/begin MEASUREMENT tbl_frf[6].envd_cus_set_spc[0][0] "Freeze frame FRF_CUS_SET_SPC: environmental data specific to each failure (not fixed by law) stored in set" UBYTE _CNV_A_R_LINEAR_____0_CM 1 100. 0. 255. DISPLAY_IDENTIFIER ENVD_CUS_SET_SPC_1_1_6 ECU_ADDRESS 0xd0004950 FORMAT "%3.0" /end MEASUREMENT
/begin MEASUREMENT tbl_frf[6].envd_cus_set_spc[0][1] "Freeze frame FRF_CUS_SET_SPC: environmental data specific to each failure (not fixed by law) stored in set" UBYTE _CNV_A_R_LINEAR_____0_CM 1 100. 0. 255. DISPLAY_IDENTIFIER ENVD_CUS_SET_SPC_2_1_6 ECU_ADDRESS 0xd0004951 FORMAT "%3.0" /end MEASUREMENT
/begin MEASUREMENT tbl_frf[6].envd_cus_set_spc[0][2] "Freeze frame FRF_CUS_SET_SPC: environmental data specific to each failure (not fixed by law) stored in set" UBYTE _CNV_A_R_LINEAR_____0_CM 1 100. 0. 255. DISPLAY_IDENTIFIER ENVD_CUS_SET_SPC_3_1_6 ECU_ADDRESS 0xd0004952 FORMAT "%3.0" /end MEASUREMENT
/begin MEASUREMENT tbl_frf[6].envd_cus_set_spc[0][3] "Freeze frame FRF_CUS_SET_SPC: environmental data specific to each failure (not fixed by law) stored in set" UBYTE _CNV_A_R_LINEAR_____0_CM 1 100. 0. 255. DISPLAY_IDENTIFIER ENVD_CUS_SET_SPC_4_1_6 ECU_ADDRESS 0xd0004953 FORMAT "%3.0" /end MEASUREMENT
/begin MEASUREMENT tbl_frf[6].envd_cus_set_spc[1][0] "Freeze frame FRF_CUS_SET_SPC: environmental data specific to each failure (not fixed by law) stored in set" UBYTE _CNV_A_R_LINEAR_____0_CM 1 100. 0. 255. DISPLAY_IDENTIFIER ENVD_CUS_SET_SPC_1_2_6 ECU_ADDRESS 0xd0004954 FORMAT "%3.0" /end MEASUREMENT
/begin MEASUREMENT tbl_frf[6].envd_cus_set_spc[1][1] "Freeze frame FRF_CUS_SET_SPC: environmental data specific to each failure (not fixed by law) stored in set" UBYTE _CNV_A_R_LINEAR_____0_CM 1 100. 0. 255. DISPLAY_IDENTIFIER ENVD_CUS_SET_SPC_2_2_6 ECU_ADDRESS 0xd0004955 FORMAT "%3.0" /end MEASUREMENT
/begin MEASUREMENT tbl_frf[6].envd_cus_set_spc[1][2] "Freeze frame FRF_CUS_SET_SPC: environmental data specific to each failure (not fixed by law) stored in set" UBYTE _CNV_A_R_LINEAR_____0_CM 1 100. 0. 255. DISPLAY_IDENTIFIER ENVD_CUS_SET_SPC_3_2_6 ECU_ADDRESS 0xd0004956 FORMAT "%3.0" /end MEASUREMENT
/begin MEASUREMENT tbl_frf[6].envd_cus_set_spc[1][3] "Freeze frame FRF_CUS_SET_SPC: environmental data specific to each failure (not fixed by law) stored in set" UBYTE _CNV_A_R_LINEAR_____0_CM 1 100. 0. 255. DISPLAY_IDENTIFIER ENVD_CUS_SET_SPC_4_2_6 ECU_ADDRESS 0xd0004957 FORMAT "%3.0" /end MEASUREMENT
/begin MEASUREMENT tbl_frf[6].envd_cus_set_spc[2][0] "Freeze frame FRF_CUS_SET_SPC: environmental data specific to each failure (not fixed by law) stored in set" UBYTE _CNV_A_R_LINEAR_____0_CM 1 100. 0. 255. DISPLAY_IDENTIFIER ENVD_CUS_SET_SPC_1_3_6 ECU_ADDRESS 0xd0004958 FORMAT "%3.0" /end MEASUREMENT
/begin MEASUREMENT tbl_frf[6].envd_cus_set_spc[2][1] "Freeze frame FRF_CUS_SET_SPC: environmental data specific to each failure (not fixed by law) stored in set" UBYTE _CNV_A_R_LINEAR_____0_CM 1 100. 0. 255. DISPLAY_IDENTIFIER ENVD_CUS_SET_SPC_2_3_6 ECU_ADDRESS 0xd0004959 FORMAT "%3.0" /end MEASUREMENT
/begin MEASUREMENT tbl_frf[6].envd_cus_set_spc[2][2] "Freeze frame FRF_CUS_SET_SPC: environmental data specific to each failure (not fixed by law) stored in set" UBYTE _CNV_A_R_LINEAR_____0_CM 1 100. 0. 255. DISPLAY_IDENTIFIER ENVD_CUS_SET_SPC_3_3_6 ECU_ADDRESS 0xd000495a FORMAT "%3.0" /end MEASUREMENT
/begin MEASUREMENT tbl_frf[6].envd_cus_set_spc[2][3] "Freeze frame FRF_CUS_SET_SPC: environmental data specific to each failure (not fixed by law) stored in set" UBYTE _CNV_A_R_LINEAR_____0_CM 1 100. 0. 255. DISPLAY_IDENTIFIER ENVD_CUS_SET_SPC_4_3_6 ECU_ADDRESS 0xd000495b FORMAT "%3.0" /end MEASUREMENT
/begin MEASUREMENT tbl_frf[7].envd_obd[0] "Freeze frame FRF_OBD: environmental data (fixed by law)" UBYTE _CNV_A_R_LINEAR_____0_CM 1 100. 0. 255. DISPLAY_IDENTIFIER ENVD_OBD_1_7 ECU_ADDRESS 0xd0004960 FORMAT "%3.0" /end MEASUREMENT
/begin MEASUREMENT tbl_frf[7].envd_obd[1] "Freeze frame FRF_OBD: environmental data (fixed by law)" UBYTE _CNV_A_R_LINEAR_____0_CM 1 100. 0. 255. DISPLAY_IDENTIFIER ENVD_OBD_2_7 ECU_ADDRESS 0xd0004961 FORMAT "%3.0" /end MEASUREMENT
/begin MEASUREMENT tbl_frf[7].envd_obd[2] "Freeze frame FRF_OBD: environmental data (fixed by law)" UBYTE _CNV_A_R_LINEAR_____0_CM 1 100. 0. 255. DISPLAY_IDENTIFIER ENVD_OBD_3_7 ECU_ADDRESS 0xd0004962 FORMAT "%3.0" /end MEASUREMENT
/begin MEASUREMENT tbl_frf[7].envd_obd[3] "Freeze frame FRF_OBD: environmental data (fixed by law)" UBYTE _CNV_A_R_LINEAR_____0_CM 1 100. 0. 255. DISPLAY_IDENTIFIER ENVD_OBD_4_7 ECU_ADDRESS 0xd0004963 FORMAT "%3.0" /end MEASUREMENT
/begin MEASUREMENT tbl_frf[7].envd_obd[4] "Freeze frame FRF_OBD: environmental data (fixed by law)" UBYTE _CNV_A_R_LINEAR_____0_CM 1 100. 0. 255. DISPLAY_IDENTIFIER ENVD_OBD_5_7 ECU_ADDRESS 0xd0004964 FORMAT "%3.0" /end MEASUREMENT
/begin MEASUREMENT tbl_frf[7].envd_obd[5] "Freeze frame FRF_OBD: environmental data (fixed by law)" UBYTE _CNV_A_R_LINEAR_____0_CM 1 100. 0. 255. DISPLAY_IDENTIFIER ENVD_OBD_6_7 ECU_ADDRESS 0xd0004965 FORMAT "%3.0" /end MEASUREMENT
/begin MEASUREMENT tbl_frf[7].envd_obd[6] "Freeze frame FRF_OBD: environmental data (fixed by law)" UBYTE _CNV_A_R_LINEAR_____0_CM 1 100. 0. 255. DISPLAY_IDENTIFIER ENVD_OBD_7_7 ECU_ADDRESS 0xd0004966 FORMAT "%3.0" /end MEASUREMENT
/begin MEASUREMENT tbl_frf[7].envd_obd[7] "Freeze frame FRF_OBD: environmental data (fixed by law)" UBYTE _CNV_A_R_LINEAR_____0_CM 1 100. 0. 255. DISPLAY_IDENTIFIER ENVD_OBD_8_7 ECU_ADDRESS 0xd0004967 FORMAT "%3.0" /end MEASUREMENT
/begin MEASUREMENT tbl_frf[7].envd_obd[8] "Freeze frame FRF_OBD: environmental data (fixed by law)" UBYTE _CNV_A_R_LINEAR_____0_CM 1 100. 0. 255. DISPLAY_IDENTIFIER ENVD_OBD_9_7 ECU_ADDRESS 0xd0004968 FORMAT "%3.0" /end MEASUREMENT
/begin MEASUREMENT tbl_frf[7].envd_obd[9] "Freeze frame FRF_OBD: environmental data (fixed by law)" UBYTE _CNV_A_R_LINEAR_____0_CM 1 100. 0. 255. DISPLAY_IDENTIFIER ENVD_OBD_10_7 ECU_ADDRESS 0xd0004969 FORMAT "%3.0" /end MEASUREMENT
/begin MEASUREMENT tbl_frf[7].envd_obd[10] "Freeze frame FRF_OBD: environmental data (fixed by law)" UBYTE _CNV_A_R_LINEAR_____0_CM 1 100. 0. 255. DISPLAY_IDENTIFIER ENVD_OBD_11_7 ECU_ADDRESS 0xd000496a FORMAT "%3.0" /end MEASUREMENT
/begin MEASUREMENT tbl_frf[7].envd_obd[11] "Freeze frame FRF_OBD: environmental data (fixed by law)" UBYTE _CNV_A_R_LINEAR_____0_CM 1 100. 0. 255. DISPLAY_IDENTIFIER ENVD_OBD_12_7 ECU_ADDRESS 0xd000496b FORMAT "%3.0" /end MEASUREMENT
/begin MEASUREMENT tbl_frf[7].envd_obd[12] "Freeze frame FRF_OBD: environmental data (fixed by law)" UBYTE _CNV_A_R_LINEAR_____0_CM 1 100. 0. 255. DISPLAY_IDENTIFIER ENVD_OBD_13_7 ECU_ADDRESS 0xd000496c FORMAT "%3.0" /end MEASUREMENT
/begin MEASUREMENT tbl_frf[7].envd_obd[13] "Freeze frame FRF_OBD: environmental data (fixed by law)" UBYTE _CNV_A_R_LINEAR_____0_CM 1 100. 0. 255. DISPLAY_IDENTIFIER ENVD_OBD_14_7 ECU_ADDRESS 0xd000496d FORMAT "%3.0" /end MEASUREMENT
/begin MEASUREMENT tbl_frf[7].envd_obd[14] "Freeze frame FRF_OBD: environmental data (fixed by law)" UBYTE _CNV_A_R_LINEAR_____0_CM 1 100. 0. 255. DISPLAY_IDENTIFIER ENVD_OBD_15_7 ECU_ADDRESS 0xd000496e FORMAT "%3.0" /end MEASUREMENT
/begin MEASUREMENT tbl_frf[7].envd_obd[15] "Freeze frame FRF_OBD: environmental data (fixed by law)" UBYTE _CNV_A_R_LINEAR_____0_CM 1 100. 0. 255. DISPLAY_IDENTIFIER ENVD_OBD_16_7 ECU_ADDRESS 0xd000496f FORMAT "%3.0" /end MEASUREMENT
/begin MEASUREMENT tbl_frf[7].envd_obd[16] "Freeze frame FRF_OBD: environmental data (fixed by law)" UBYTE _CNV_A_R_LINEAR_____0_CM 1 100. 0. 255. DISPLAY_IDENTIFIER ENVD_OBD_17_7 ECU_ADDRESS 0xd0004970 FORMAT "%3.0" /end MEASUREMENT
/begin MEASUREMENT tbl_frf[7].envd_obd[17] "Freeze frame FRF_OBD: environmental data (fixed by law)" UBYTE _CNV_A_R_LINEAR_____0_CM 1 100. 0. 255. DISPLAY_IDENTIFIER ENVD_OBD_18_7 ECU_ADDRESS 0xd0004971 FORMAT "%3.0" /end MEASUREMENT
/begin MEASUREMENT tbl_frf[7].envd_obd[18] "Freeze frame FRF_OBD: environmental data (fixed by law)" UBYTE _CNV_A_R_LINEAR_____0_CM 1 100. 0. 255. DISPLAY_IDENTIFIER ENVD_OBD_19_7 ECU_ADDRESS 0xd0004972 FORMAT "%3.0" /end MEASUREMENT
/begin MEASUREMENT tbl_frf[7].envd_obd[19] "Freeze frame FRF_OBD: environmental data (fixed by law)" UBYTE _CNV_A_R_LINEAR_____0_CM 1 100. 0. 255. DISPLAY_IDENTIFIER ENVD_OBD_20_7 ECU_ADDRESS 0xd0004973 FORMAT "%3.0" /end MEASUREMENT
/begin MEASUREMENT tbl_frf[7].envd_obd[20] "Freeze frame FRF_OBD: environmental data (fixed by law)" UBYTE _CNV_A_R_LINEAR_____0_CM 1 100. 0. 255. DISPLAY_IDENTIFIER ENVD_OBD_21_7 ECU_ADDRESS 0xd0004974 FORMAT "%3.0" /end MEASUREMENT
/begin MEASUREMENT tbl_frf[7].envd_obd[21] "Freeze frame FRF_OBD: environmental data (fixed by law)" UBYTE _CNV_A_R_LINEAR_____0_CM 1 100. 0. 255. DISPLAY_IDENTIFIER ENVD_OBD_22_7 ECU_ADDRESS 0xd0004975 FORMAT "%3.0" /end MEASUREMENT
/begin MEASUREMENT tbl_frf[7].envd_obd[22] "Freeze frame FRF_OBD: environmental data (fixed by law)" UBYTE _CNV_A_R_LINEAR_____0_CM 1 100. 0. 255. DISPLAY_IDENTIFIER ENVD_OBD_23_7 ECU_ADDRESS 0xd0004976 FORMAT "%3.0" /end MEASUREMENT
/begin MEASUREMENT tbl_frf[7].envd_obd[23] "Freeze frame FRF_OBD: environmental data (fixed by law)" UBYTE _CNV_A_R_LINEAR_____0_CM 1 100. 0. 255. DISPLAY_IDENTIFIER ENVD_OBD_24_7 ECU_ADDRESS 0xd0004977 FORMAT "%3.0" /end MEASUREMENT
/begin MEASUREMENT tbl_frf[7].envd_obd[24] "Freeze frame FRF_OBD: environmental data (fixed by law)" UBYTE _CNV_A_R_LINEAR_____0_CM 1 100. 0. 255. DISPLAY_IDENTIFIER ENVD_OBD_25_7 ECU_ADDRESS 0xd0004978 FORMAT "%3.0" /end MEASUREMENT
/begin MEASUREMENT tbl_frf[7].envd_obd[25] "Freeze frame FRF_OBD: environmental data (fixed by law)" UBYTE _CNV_A_R_LINEAR_____0_CM 1 100. 0. 255. DISPLAY_IDENTIFIER ENVD_OBD_26_7 ECU_ADDRESS 0xd0004979 FORMAT "%3.0" /end MEASUREMENT
/begin MEASUREMENT tbl_frf[7].envd_obd[26] "Freeze frame FRF_OBD: environmental data (fixed by law)" UBYTE _CNV_A_R_LINEAR_____0_CM 1 100. 0. 255. DISPLAY_IDENTIFIER ENVD_OBD_27_7 ECU_ADDRESS 0xd000497a FORMAT "%3.0" /end MEASUREMENT
/begin MEASUREMENT tbl_frf[7].envd_obd[27] "Freeze frame FRF_OBD: environmental data (fixed by law)" UBYTE _CNV_A_R_LINEAR_____0_CM 1 100. 0. 255. DISPLAY_IDENTIFIER ENVD_OBD_28_7 ECU_ADDRESS 0xd000497b FORMAT "%3.0" /end MEASUREMENT
/begin MEASUREMENT tbl_frf[7].envd_obd[28] "Freeze frame FRF_OBD: environmental data (fixed by law)" UBYTE _CNV_A_R_LINEAR_____0_CM 1 100. 0. 255. DISPLAY_IDENTIFIER ENVD_OBD_29_7 ECU_ADDRESS 0xd000497c FORMAT "%3.0" /end MEASUREMENT
/begin MEASUREMENT tbl_frf[7].envd_obd[29] "Freeze frame FRF_OBD: environmental data (fixed by law)" UBYTE _CNV_A_R_LINEAR_____0_CM 1 100. 0. 255. DISPLAY_IDENTIFIER ENVD_OBD_30_7 ECU_ADDRESS 0xd000497d FORMAT "%3.0" /end MEASUREMENT
/begin MEASUREMENT tbl_frf[7].envd_obd[30] "Freeze frame FRF_OBD: environmental data (fixed by law)" UBYTE _CNV_A_R_LINEAR_____0_CM 1 100. 0. 255. DISPLAY_IDENTIFIER ENVD_OBD_31_7 ECU_ADDRESS 0xd000497e FORMAT "%3.0" /end MEASUREMENT
/begin MEASUREMENT tbl_frf[7].envd_obd[31] "Freeze frame FRF_OBD: environmental data (fixed by law)" UBYTE _CNV_A_R_LINEAR_____0_CM 1 100. 0. 255. DISPLAY_IDENTIFIER ENVD_OBD_32_7 ECU_ADDRESS 0xd000497f FORMAT "%3.0" /end MEASUREMENT
/begin MEASUREMENT tbl_frf[7].envd_obd[32] "Freeze frame FRF_OBD: environmental data (fixed by law)" UBYTE _CNV_A_R_LINEAR_____0_CM 1 100. 0. 255. DISPLAY_IDENTIFIER ENVD_OBD_33_7 ECU_ADDRESS 0xd0004980 FORMAT "%3.0" /end MEASUREMENT
/begin MEASUREMENT tbl_frf[7].envd_obd[33] "Freeze frame FRF_OBD: environmental data (fixed by law)" UBYTE _CNV_A_R_LINEAR_____0_CM 1 100. 0. 255. DISPLAY_IDENTIFIER ENVD_OBD_34_7 ECU_ADDRESS 0xd0004981 FORMAT "%3.0" /end MEASUREMENT
/begin MEASUREMENT tbl_frf[7].envd_obd[34] "Freeze frame FRF_OBD: environmental data (fixed by law)" UBYTE _CNV_A_R_LINEAR_____0_CM 1 100. 0. 255. DISPLAY_IDENTIFIER ENVD_OBD[34] ECU_ADDRESS 0xd0004982 FORMAT "%3.0" /end MEASUREMENT
/begin MEASUREMENT tbl_frf[7].envd_cus_cmn[0] "Freeze frame FRF_CUS_CMN: environmental data common to all failure (not fixed by law)" UBYTE _CNV_A_R_LINEAR_____0_CM 1 100. 0. 255. DISPLAY_IDENTIFIER ENVD_CUS_CMN_1_7 ECU_ADDRESS 0xd0004983 FORMAT "%3.0" /end MEASUREMENT
/begin MEASUREMENT tbl_frf[7].envd_cus_set_cmn[0][0] "Freeze frame FRF_CUS_SET_CMN: environmental data common to all failure (not fixed by law) stored in set" UBYTE _CNV_A_R_LINEAR_____0_CM 1 100. 0. 255. DISPLAY_IDENTIFIER ENVD_CUS_SET_CMN_1_1_7 ECU_ADDRESS 0xd0004984 FORMAT "%3.0" /end MEASUREMENT
/begin MEASUREMENT tbl_frf[7].envd_cus_set_cmn[0][1] "Freeze frame FRF_CUS_SET_CMN: environmental data common to all failure (not fixed by law) stored in set" UBYTE _CNV_A_R_LINEAR_____0_CM 1 100. 0. 255. DISPLAY_IDENTIFIER ENVD_CUS_SET_CMN_2_1_7 ECU_ADDRESS 0xd0004985 FORMAT "%3.0" /end MEASUREMENT
/begin MEASUREMENT tbl_frf[7].envd_cus_set_cmn[0][2] "Freeze frame FRF_CUS_SET_CMN: environmental data common to all failure (not fixed by law) stored in set" UBYTE _CNV_A_R_LINEAR_____0_CM 1 100. 0. 255. DISPLAY_IDENTIFIER ENVD_CUS_SET_CMN_3_1_7 ECU_ADDRESS 0xd0004986 FORMAT "%3.0" /end MEASUREMENT
/begin MEASUREMENT tbl_frf[7].envd_cus_set_cmn[1][0] "Freeze frame FRF_CUS_SET_CMN: environmental data common to all failure (not fixed by law) stored in set" UBYTE _CNV_A_R_LINEAR_____0_CM 1 100. 0. 255. DISPLAY_IDENTIFIER ENVD_CUS_SET_CMN_1_2_7 ECU_ADDRESS 0xd0004987 FORMAT "%3.0" /end MEASUREMENT
/begin MEASUREMENT tbl_frf[7].envd_cus_set_cmn[1][1] "Freeze frame FRF_CUS_SET_CMN: environmental data common to all failure (not fixed by law) stored in set" UBYTE _CNV_A_R_LINEAR_____0_CM 1 100. 0. 255. DISPLAY_IDENTIFIER ENVD_CUS_SET_CMN_2_2_7 ECU_ADDRESS 0xd0004988 FORMAT "%3.0" /end MEASUREMENT
/begin MEASUREMENT tbl_frf[7].envd_cus_set_cmn[1][2] "Freeze frame FRF_CUS_SET_CMN: environmental data common to all failure (not fixed by law) stored in set" UBYTE _CNV_A_R_LINEAR_____0_CM 1 100. 0. 255. DISPLAY_IDENTIFIER ENVD_CUS_SET_CMN_3_2_7 ECU_ADDRESS 0xd0004989 FORMAT "%3.0" /end MEASUREMENT
/begin MEASUREMENT tbl_frf[7].envd_cus_set_cmn[2][0] "Freeze frame FRF_CUS_SET_CMN: environmental data common to all failure (not fixed by law) stored in set" UBYTE _CNV_A_R_LINEAR_____0_CM 1 100. 0. 255. DISPLAY_IDENTIFIER ENVD_CUS_SET_CMN_1_3_7 ECU_ADDRESS 0xd000498a FORMAT "%3.0" /end MEASUREMENT
/begin MEASUREMENT tbl_frf[7].envd_cus_set_cmn[2][1] "Freeze frame FRF_CUS_SET_CMN: environmental data common to all failure (not fixed by law) stored in set" UBYTE _CNV_A_R_LINEAR_____0_CM 1 100. 0. 255. DISPLAY_IDENTIFIER ENVD_CUS_SET_CMN_2_3_7 ECU_ADDRESS 0xd000498b FORMAT "%3.0" /end MEASUREMENT
/begin MEASUREMENT tbl_frf[7].envd_cus_set_cmn[2][2] "Freeze frame FRF_CUS_SET_CMN: environmental data common to all failure (not fixed by law) stored in set" UBYTE _CNV_A_R_LINEAR_____0_CM 1 100. 0. 255. DISPLAY_IDENTIFIER ENVD_CUS_SET_CMN_3_3_7 ECU_ADDRESS 0xd000498c FORMAT "%3.0" /end MEASUREMENT
/begin MEASUREMENT tbl_frf[7].envd_cus_set_spc[0][0] "Freeze frame FRF_CUS_SET_SPC: environmental data specific to each failure (not fixed by law) stored in set" UBYTE _CNV_A_R_LINEAR_____0_CM 1 100. 0. 255. DISPLAY_IDENTIFIER ENVD_CUS_SET_SPC_1_1_7 ECU_ADDRESS 0xd0004990 FORMAT "%3.0" /end MEASUREMENT
/begin MEASUREMENT tbl_frf[7].envd_cus_set_spc[0][1] "Freeze frame FRF_CUS_SET_SPC: environmental data specific to each failure (not fixed by law) stored in set" UBYTE _CNV_A_R_LINEAR_____0_CM 1 100. 0. 255. DISPLAY_IDENTIFIER ENVD_CUS_SET_SPC_2_1_7 ECU_ADDRESS 0xd0004991 FORMAT "%3.0" /end MEASUREMENT
/begin MEASUREMENT tbl_frf[7].envd_cus_set_spc[0][2] "Freeze frame FRF_CUS_SET_SPC: environmental data specific to each failure (not fixed by law) stored in set" UBYTE _CNV_A_R_LINEAR_____0_CM 1 100. 0. 255. DISPLAY_IDENTIFIER ENVD_CUS_SET_SPC_3_1_7 ECU_ADDRESS 0xd0004992 FORMAT "%3.0" /end MEASUREMENT
/begin MEASUREMENT tbl_frf[7].envd_cus_set_spc[0][3] "Freeze frame FRF_CUS_SET_SPC: environmental data specific to each failure (not fixed by law) stored in set" UBYTE _CNV_A_R_LINEAR_____0_CM 1 100. 0. 255. DISPLAY_IDENTIFIER ENVD_CUS_SET_SPC_4_1_7 ECU_ADDRESS 0xd0004993 FORMAT "%3.0" /end MEASUREMENT
/begin MEASUREMENT tbl_frf[7].envd_cus_set_spc[1][0] "Freeze frame FRF_CUS_SET_SPC: environmental data specific to each failure (not fixed by law) stored in set" UBYTE _CNV_A_R_LINEAR_____0_CM 1 100. 0. 255. DISPLAY_IDENTIFIER ENVD_CUS_SET_SPC_1_2_7 ECU_ADDRESS 0xd0004994 FORMAT "%3.0" /end MEASUREMENT
/begin MEASUREMENT tbl_frf[7].envd_cus_set_spc[1][1] "Freeze frame FRF_CUS_SET_SPC: environmental data specific to each failure (not fixed by law) stored in set" UBYTE _CNV_A_R_LINEAR_____0_CM 1 100. 0. 255. DISPLAY_IDENTIFIER ENVD_CUS_SET_SPC_2_2_7 ECU_ADDRESS 0xd0004995 FORMAT "%3.0" /end MEASUREMENT
/begin MEASUREMENT tbl_frf[7].envd_cus_set_spc[1][2] "Freeze frame FRF_CUS_SET_SPC: environmental data specific to each failure (not fixed by law) stored in set" UBYTE _CNV_A_R_LINEAR_____0_CM 1 100. 0. 255. DISPLAY_IDENTIFIER ENVD_CUS_SET_SPC_3_2_7 ECU_ADDRESS 0xd0004996 FORMAT "%3.0" /end MEASUREMENT
/begin MEASUREMENT tbl_frf[7].envd_cus_set_spc[1][3] "Freeze frame FRF_CUS_SET_SPC: environmental data specific to each failure (not fixed by law) stored in set" UBYTE _CNV_A_R_LINEAR_____0_CM 1 100. 0. 255. DISPLAY_IDENTIFIER ENVD_CUS_SET_SPC_4_2_7 ECU_ADDRESS 0xd0004997 FORMAT "%3.0" /end MEASUREMENT
/begin MEASUREMENT tbl_frf[7].envd_cus_set_spc[2][0] "Freeze frame FRF_CUS_SET_SPC: environmental data specific to each failure (not fixed by law) stored in set" UBYTE _CNV_A_R_LINEAR_____0_CM 1 100. 0. 255. DISPLAY_IDENTIFIER ENVD_CUS_SET_SPC_1_3_7 ECU_ADDRESS 0xd0004998 FORMAT "%3.0" /end MEASUREMENT
/begin MEASUREMENT tbl_frf[7].envd_cus_set_spc[2][1] "Freeze frame FRF_CUS_SET_SPC: environmental data specific to each failure (not fixed by law) stored in set" UBYTE _CNV_A_R_LINEAR_____0_CM 1 100. 0. 255. DISPLAY_IDENTIFIER ENVD_CUS_SET_SPC_2_3_7 ECU_ADDRESS 0xd0004999 FORMAT "%3.0" /end MEASUREMENT
/begin MEASUREMENT tbl_frf[7].envd_cus_set_spc[2][2] "Freeze frame FRF_CUS_SET_SPC: environmental data specific to each failure (not fixed by law) stored in set" UBYTE _CNV_A_R_LINEAR_____0_CM 1 100. 0. 255. DISPLAY_IDENTIFIER ENVD_CUS_SET_SPC_3_3_7 ECU_ADDRESS 0xd000499a FORMAT "%3.0" /end MEASUREMENT
/begin MEASUREMENT tbl_frf[7].envd_cus_set_spc[2][3] "Freeze frame FRF_CUS_SET_SPC: environmental data specific to each failure (not fixed by law) stored in set" UBYTE _CNV_A_R_LINEAR_____0_CM 1 100. 0. 255. DISPLAY_IDENTIFIER ENVD_CUS_SET_SPC_4_3_7 ECU_ADDRESS 0xd000499b FORMAT "%3.0" /end MEASUREMENT
/begin MEASUREMENT tbl_frf[8].envd_obd[0] "Freeze frame FRF_OBD: environmental data (fixed by law)" UBYTE _CNV_A_R_LINEAR_____0_CM 1 100. 0. 255. DISPLAY_IDENTIFIER ENVD_OBD_1_8 ECU_ADDRESS 0xd00049a0 FORMAT "%3.0" /end MEASUREMENT
/begin MEASUREMENT tbl_frf[8].envd_obd[1] "Freeze frame FRF_OBD: environmental data (fixed by law)" UBYTE _CNV_A_R_LINEAR_____0_CM 1 100. 0. 255. DISPLAY_IDENTIFIER ENVD_OBD_2_8 ECU_ADDRESS 0xd00049a1 FORMAT "%3.0" /end MEASUREMENT
/begin MEASUREMENT tbl_frf[8].envd_obd[2] "Freeze frame FRF_OBD: environmental data (fixed by law)" UBYTE _CNV_A_R_LINEAR_____0_CM 1 100. 0. 255. DISPLAY_IDENTIFIER ENVD_OBD_3_8 ECU_ADDRESS 0xd00049a2 FORMAT "%3.0" /end MEASUREMENT
/begin MEASUREMENT tbl_frf[8].envd_obd[3] "Freeze frame FRF_OBD: environmental data (fixed by law)" UBYTE _CNV_A_R_LINEAR_____0_CM 1 100. 0. 255. DISPLAY_IDENTIFIER ENVD_OBD_4_8 ECU_ADDRESS 0xd00049a3 FORMAT "%3.0" /end MEASUREMENT
/begin MEASUREMENT tbl_frf[8].envd_obd[4] "Freeze frame FRF_OBD: environmental data (fixed by law)" UBYTE _CNV_A_R_LINEAR_____0_CM 1 100. 0. 255. DISPLAY_IDENTIFIER ENVD_OBD_5_8 ECU_ADDRESS 0xd00049a4 FORMAT "%3.0" /end MEASUREMENT
/begin MEASUREMENT tbl_frf[8].envd_obd[5] "Freeze frame FRF_OBD: environmental data (fixed by law)" UBYTE _CNV_A_R_LINEAR_____0_CM 1 100. 0. 255. DISPLAY_IDENTIFIER ENVD_OBD_6_8 ECU_ADDRESS 0xd00049a5 FORMAT "%3.0" /end MEASUREMENT
/begin MEASUREMENT tbl_frf[8].envd_obd[6] "Freeze frame FRF_OBD: environmental data (fixed by law)" UBYTE _CNV_A_R_LINEAR_____0_CM 1 100. 0. 255. DISPLAY_IDENTIFIER ENVD_OBD_7_8 ECU_ADDRESS 0xd00049a6 FORMAT "%3.0" /end MEASUREMENT
/begin MEASUREMENT tbl_frf[8].envd_obd[7] "Freeze frame FRF_OBD: environmental data (fixed by law)" UBYTE _CNV_A_R_LINEAR_____0_CM 1 100. 0. 255. DISPLAY_IDENTIFIER ENVD_OBD_8_8 ECU_ADDRESS 0xd00049a7 FORMAT "%3.0" /end MEASUREMENT
/begin MEASUREMENT tbl_frf[8].envd_obd[8] "Freeze frame FRF_OBD: environmental data (fixed by law)" UBYTE _CNV_A_R_LINEAR_____0_CM 1 100. 0. 255. DISPLAY_IDENTIFIER ENVD_OBD_9_8 ECU_ADDRESS 0xd00049a8 FORMAT "%3.0" /end MEASUREMENT
/begin MEASUREMENT tbl_frf[8].envd_obd[9] "Freeze frame FRF_OBD: environmental data (fixed by law)" UBYTE _CNV_A_R_LINEAR_____0_CM 1 100. 0. 255. DISPLAY_IDENTIFIER ENVD_OBD_10_8 ECU_ADDRESS 0xd00049a9 FORMAT "%3.0" /end MEASUREMENT
/begin MEASUREMENT tbl_frf[8].envd_obd[10] "Freeze frame FRF_OBD: environmental data (fixed by law)" UBYTE _CNV_A_R_LINEAR_____0_CM 1 100. 0. 255. DISPLAY_IDENTIFIER ENVD_OBD_11_8 ECU_ADDRESS 0xd00049aa FORMAT "%3.0" /end MEASUREMENT
/begin MEASUREMENT tbl_frf[8].envd_obd[11] "Freeze frame FRF_OBD: environmental data (fixed by law)" UBYTE _CNV_A_R_LINEAR_____0_CM 1 100. 0. 255. DISPLAY_IDENTIFIER ENVD_OBD_12_8 ECU_ADDRESS 0xd00049ab FORMAT "%3.0" /end MEASUREMENT
/begin MEASUREMENT tbl_frf[8].envd_obd[12] "Freeze frame FRF_OBD: environmental data (fixed by law)" UBYTE _CNV_A_R_LINEAR_____0_CM 1 100. 0. 255. DISPLAY_IDENTIFIER ENVD_OBD_13_8 ECU_ADDRESS 0xd00049ac FORMAT "%3.0" /end MEASUREMENT
/begin MEASUREMENT tbl_frf[8].envd_obd[13] "Freeze frame FRF_OBD: environmental data (fixed by law)" UBYTE _CNV_A_R_LINEAR_____0_CM 1 100. 0. 255. DISPLAY_IDENTIFIER ENVD_OBD_14_8 ECU_ADDRESS 0xd00049ad FORMAT "%3.0" /end MEASUREMENT
/begin MEASUREMENT tbl_frf[8].envd_obd[14] "Freeze frame FRF_OBD: environmental data (fixed by law)" UBYTE _CNV_A_R_LINEAR_____0_CM 1 100. 0. 255. DISPLAY_IDENTIFIER ENVD_OBD_15_8 ECU_ADDRESS 0xd00049ae FORMAT "%3.0" /end MEASUREMENT
/begin MEASUREMENT tbl_frf[8].envd_obd[15] "Freeze frame FRF_OBD: environmental data (fixed by law)" UBYTE _CNV_A_R_LINEAR_____0_CM 1 100. 0. 255. DISPLAY_IDENTIFIER ENVD_OBD_16_8 ECU_ADDRESS 0xd00049af FORMAT "%3.0" /end MEASUREMENT
/begin MEASUREMENT tbl_frf[8].envd_obd[16] "Freeze frame FRF_OBD: environmental data (fixed by law)" UBYTE _CNV_A_R_LINEAR_____0_CM 1 100. 0. 255. DISPLAY_IDENTIFIER ENVD_OBD_17_8 ECU_ADDRESS 0xd00049b0 FORMAT "%3.0" /end MEASUREMENT
/begin MEASUREMENT tbl_frf[8].envd_obd[17] "Freeze frame FRF_OBD: environmental data (fixed by law)" UBYTE _CNV_A_R_LINEAR_____0_CM 1 100. 0. 255. DISPLAY_IDENTIFIER ENVD_OBD_18_8 ECU_ADDRESS 0xd00049b1 FORMAT "%3.0" /end MEASUREMENT
/begin MEASUREMENT tbl_frf[8].envd_obd[18] "Freeze frame FRF_OBD: environmental data (fixed by law)" UBYTE _CNV_A_R_LINEAR_____0_CM 1 100. 0. 255. DISPLAY_IDENTIFIER ENVD_OBD_19_8 ECU_ADDRESS 0xd00049b2 FORMAT "%3.0" /end MEASUREMENT
/begin MEASUREMENT tbl_frf[8].envd_obd[19] "Freeze frame FRF_OBD: environmental data (fixed by law)" UBYTE _CNV_A_R_LINEAR_____0_CM 1 100. 0. 255. DISPLAY_IDENTIFIER ENVD_OBD_20_8 ECU_ADDRESS 0xd00049b3 FORMAT "%3.0" /end MEASUREMENT
/begin MEASUREMENT tbl_frf[8].envd_obd[20] "Freeze frame FRF_OBD: environmental data (fixed by law)" UBYTE _CNV_A_R_LINEAR_____0_CM 1 100. 0. 255. DISPLAY_IDENTIFIER ENVD_OBD_21_8 ECU_ADDRESS 0xd00049b4 FORMAT "%3.0" /end MEASUREMENT
/begin MEASUREMENT tbl_frf[8].envd_obd[21] "Freeze frame FRF_OBD: environmental data (fixed by law)" UBYTE _CNV_A_R_LINEAR_____0_CM 1 100. 0. 255. DISPLAY_IDENTIFIER ENVD_OBD_22_8 ECU_ADDRESS 0xd00049b5 FORMAT "%3.0" /end MEASUREMENT
/begin MEASUREMENT tbl_frf[8].envd_obd[22] "Freeze frame FRF_OBD: environmental data (fixed by law)" UBYTE _CNV_A_R_LINEAR_____0_CM 1 100. 0. 255. DISPLAY_IDENTIFIER ENVD_OBD_23_8 ECU_ADDRESS 0xd00049b6 FORMAT "%3.0" /end MEASUREMENT
/begin MEASUREMENT tbl_frf[8].envd_obd[23] "Freeze frame FRF_OBD: environmental data (fixed by law)" UBYTE _CNV_A_R_LINEAR_____0_CM 1 100. 0. 255. DISPLAY_IDENTIFIER ENVD_OBD_24_8 ECU_ADDRESS 0xd00049b7 FORMAT "%3.0" /end MEASUREMENT
/begin MEASUREMENT tbl_frf[8].envd_obd[24] "Freeze frame FRF_OBD: environmental data (fixed by law)" UBYTE _CNV_A_R_LINEAR_____0_CM 1 100. 0. 255. DISPLAY_IDENTIFIER ENVD_OBD_25_8 ECU_ADDRESS 0xd00049b8 FORMAT "%3.0" /end MEASUREMENT
/begin MEASUREMENT tbl_frf[8].envd_obd[25] "Freeze frame FRF_OBD: environmental data (fixed by law)" UBYTE _CNV_A_R_LINEAR_____0_CM 1 100. 0. 255. DISPLAY_IDENTIFIER ENVD_OBD_26_8 ECU_ADDRESS 0xd00049b9 FORMAT "%3.0" /end MEASUREMENT
/begin MEASUREMENT tbl_frf[8].envd_obd[26] "Freeze frame FRF_OBD: environmental data (fixed by law)" UBYTE _CNV_A_R_LINEAR_____0_CM 1 100. 0. 255. DISPLAY_IDENTIFIER ENVD_OBD_27_8 ECU_ADDRESS 0xd00049ba FORMAT "%3.0" /end MEASUREMENT
/begin MEASUREMENT tbl_frf[8].envd_obd[27] "Freeze frame FRF_OBD: environmental data (fixed by law)" UBYTE _CNV_A_R_LINEAR_____0_CM 1 100. 0. 255. DISPLAY_IDENTIFIER ENVD_OBD_28_8 ECU_ADDRESS 0xd00049bb FORMAT "%3.0" /end MEASUREMENT
/begin MEASUREMENT tbl_frf[8].envd_obd[28] "Freeze frame FRF_OBD: environmental data (fixed by law)" UBYTE _CNV_A_R_LINEAR_____0_CM 1 100. 0. 255. DISPLAY_IDENTIFIER ENVD_OBD_29_8 ECU_ADDRESS 0xd00049bc FORMAT "%3.0" /end MEASUREMENT
/begin MEASUREMENT tbl_frf[8].envd_obd[29] "Freeze frame FRF_OBD: environmental data (fixed by law)" UBYTE _CNV_A_R_LINEAR_____0_CM 1 100. 0. 255. DISPLAY_IDENTIFIER ENVD_OBD_30_8 ECU_ADDRESS 0xd00049bd FORMAT "%3.0" /end MEASUREMENT
/begin MEASUREMENT tbl_frf[8].envd_obd[30] "Freeze frame FRF_OBD: environmental data (fixed by law)" UBYTE _CNV_A_R_LINEAR_____0_CM 1 100. 0. 255. DISPLAY_IDENTIFIER ENVD_OBD_31_8 ECU_ADDRESS 0xd00049be FORMAT "%3.0" /end MEASUREMENT
/begin MEASUREMENT tbl_frf[8].envd_obd[31] "Freeze frame FRF_OBD: environmental data (fixed by law)" UBYTE _CNV_A_R_LINEAR_____0_CM 1 100. 0. 255. DISPLAY_IDENTIFIER ENVD_OBD_32_8 ECU_ADDRESS 0xd00049bf FORMAT "%3.0" /end MEASUREMENT
/begin MEASUREMENT tbl_frf[8].envd_obd[32] "Freeze frame FRF_OBD: environmental data (fixed by law)" UBYTE _CNV_A_R_LINEAR_____0_CM 1 100. 0. 255. DISPLAY_IDENTIFIER ENVD_OBD_33_8 ECU_ADDRESS 0xd00049c0 FORMAT "%3.0" /end MEASUREMENT
/begin MEASUREMENT tbl_frf[8].envd_obd[33] "Freeze frame FRF_OBD: environmental data (fixed by law)" UBYTE _CNV_A_R_LINEAR_____0_CM 1 100. 0. 255. DISPLAY_IDENTIFIER ENVD_OBD_34_8 ECU_ADDRESS 0xd00049c1 FORMAT "%3.0" /end MEASUREMENT
/begin MEASUREMENT tbl_frf[8].envd_obd[34] "Freeze frame FRF_OBD: environmental data (fixed by law)" UBYTE _CNV_A_R_LINEAR_____0_CM 1 100. 0. 255. DISPLAY_IDENTIFIER ENVD_OBD[34] ECU_ADDRESS 0xd00049c2 FORMAT "%3.0" /end MEASUREMENT
/begin MEASUREMENT tbl_frf[8].envd_cus_cmn[0] "Freeze frame FRF_CUS_CMN: environmental data common to all failure (not fixed by law)" UBYTE _CNV_A_R_LINEAR_____0_CM 1 100. 0. 255. DISPLAY_IDENTIFIER ENVD_CUS_CMN_1_8 ECU_ADDRESS 0xd00049c3 FORMAT "%3.0" /end MEASUREMENT
/begin MEASUREMENT tbl_frf[8].envd_cus_set_cmn[0][0] "Freeze frame FRF_CUS_SET_CMN: environmental data common to all failure (not fixed by law) stored in set" UBYTE _CNV_A_R_LINEAR_____0_CM 1 100. 0. 255. DISPLAY_IDENTIFIER ENVD_CUS_SET_CMN_1_1_8 ECU_ADDRESS 0xd00049c4 FORMAT "%3.0" /end MEASUREMENT
/begin MEASUREMENT tbl_frf[8].envd_cus_set_cmn[0][1] "Freeze frame FRF_CUS_SET_CMN: environmental data common to all failure (not fixed by law) stored in set" UBYTE _CNV_A_R_LINEAR_____0_CM 1 100. 0. 255. DISPLAY_IDENTIFIER ENVD_CUS_SET_CMN_2_1_8 ECU_ADDRESS 0xd00049c5 FORMAT "%3.0" /end MEASUREMENT
/begin MEASUREMENT tbl_frf[8].envd_cus_set_cmn[0][2] "Freeze frame FRF_CUS_SET_CMN: environmental data common to all failure (not fixed by law) stored in set" UBYTE _CNV_A_R_LINEAR_____0_CM 1 100. 0. 255. DISPLAY_IDENTIFIER ENVD_CUS_SET_CMN_3_1_8 ECU_ADDRESS 0xd00049c6 FORMAT "%3.0" /end MEASUREMENT
/begin MEASUREMENT tbl_frf[8].envd_cus_set_cmn[1][0] "Freeze frame FRF_CUS_SET_CMN: environmental data common to all failure (not fixed by law) stored in set" UBYTE _CNV_A_R_LINEAR_____0_CM 1 100. 0. 255. DISPLAY_IDENTIFIER ENVD_CUS_SET_CMN_1_2_8 ECU_ADDRESS 0xd00049c7 FORMAT "%3.0" /end MEASUREMENT
/begin MEASUREMENT tbl_frf[8].envd_cus_set_cmn[1][1] "Freeze frame FRF_CUS_SET_CMN: environmental data common to all failure (not fixed by law) stored in set" UBYTE _CNV_A_R_LINEAR_____0_CM 1 100. 0. 255. DISPLAY_IDENTIFIER ENVD_CUS_SET_CMN_2_2_8 ECU_ADDRESS 0xd00049c8 FORMAT "%3.0" /end MEASUREMENT
/begin MEASUREMENT tbl_frf[8].envd_cus_set_cmn[1][2] "Freeze frame FRF_CUS_SET_CMN: environmental data common to all failure (not fixed by law) stored in set" UBYTE _CNV_A_R_LINEAR_____0_CM 1 100. 0. 255. DISPLAY_IDENTIFIER ENVD_CUS_SET_CMN_3_2_8 ECU_ADDRESS 0xd00049c9 FORMAT "%3.0" /end MEASUREMENT
/begin MEASUREMENT tbl_frf[8].envd_cus_set_cmn[2][0] "Freeze frame FRF_CUS_SET_CMN: environmental data common to all failure (not fixed by law) stored in set" UBYTE _CNV_A_R_LINEAR_____0_CM 1 100. 0. 255. DISPLAY_IDENTIFIER ENVD_CUS_SET_CMN_1_3_8 ECU_ADDRESS 0xd00049ca FORMAT "%3.0" /end MEASUREMENT
/begin MEASUREMENT tbl_frf[8].envd_cus_set_cmn[2][1] "Freeze frame FRF_CUS_SET_CMN: environmental data common to all failure (not fixed by law) stored in set" UBYTE _CNV_A_R_LINEAR_____0_CM 1 100. 0. 255. DISPLAY_IDENTIFIER ENVD_CUS_SET_CMN_2_3_8 ECU_ADDRESS 0xd00049cb FORMAT "%3.0" /end MEASUREMENT
/begin MEASUREMENT tbl_frf[8].envd_cus_set_cmn[2][2] "Freeze frame FRF_CUS_SET_CMN: environmental data common to all failure (not fixed by law) stored in set" UBYTE _CNV_A_R_LINEAR_____0_CM 1 100. 0. 255. DISPLAY_IDENTIFIER ENVD_CUS_SET_CMN_3_3_8 ECU_ADDRESS 0xd00049cc FORMAT "%3.0" /end MEASUREMENT
/begin MEASUREMENT tbl_frf[8].envd_cus_set_spc[0][0] "Freeze frame FRF_CUS_SET_SPC: environmental data specific to each failure (not fixed by law) stored in set" UBYTE _CNV_A_R_LINEAR_____0_CM 1 100. 0. 255. DISPLAY_IDENTIFIER ENVD_CUS_SET_SPC_1_1_8 ECU_ADDRESS 0xd00049d0 FORMAT "%3.0" /end MEASUREMENT
/begin MEASUREMENT tbl_frf[8].envd_cus_set_spc[0][1] "Freeze frame FRF_CUS_SET_SPC: environmental data specific to each failure (not fixed by law) stored in set" UBYTE _CNV_A_R_LINEAR_____0_CM 1 100. 0. 255. DISPLAY_IDENTIFIER ENVD_CUS_SET_SPC_2_1_8 ECU_ADDRESS 0xd00049d1 FORMAT "%3.0" /end MEASUREMENT
/begin MEASUREMENT tbl_frf[8].envd_cus_set_spc[0][2] "Freeze frame FRF_CUS_SET_SPC: environmental data specific to each failure (not fixed by law) stored in set" UBYTE _CNV_A_R_LINEAR_____0_CM 1 100. 0. 255. DISPLAY_IDENTIFIER ENVD_CUS_SET_SPC_3_1_8 ECU_ADDRESS 0xd00049d2 FORMAT "%3.0" /end MEASUREMENT
/begin MEASUREMENT tbl_frf[8].envd_cus_set_spc[0][3] "Freeze frame FRF_CUS_SET_SPC: environmental data specific to each failure (not fixed by law) stored in set" UBYTE _CNV_A_R_LINEAR_____0_CM 1 100. 0. 255. DISPLAY_IDENTIFIER ENVD_CUS_SET_SPC_4_1_8 ECU_ADDRESS 0xd00049d3 FORMAT "%3.0" /end MEASUREMENT
/begin MEASUREMENT tbl_frf[8].envd_cus_set_spc[1][0] "Freeze frame FRF_CUS_SET_SPC: environmental data specific to each failure (not fixed by law) stored in set" UBYTE _CNV_A_R_LINEAR_____0_CM 1 100. 0. 255. DISPLAY_IDENTIFIER ENVD_CUS_SET_SPC_1_2_8 ECU_ADDRESS 0xd00049d4 FORMAT "%3.0" /end MEASUREMENT
/begin MEASUREMENT tbl_frf[8].envd_cus_set_spc[1][1] "Freeze frame FRF_CUS_SET_SPC: environmental data specific to each failure (not fixed by law) stored in set" UBYTE _CNV_A_R_LINEAR_____0_CM 1 100. 0. 255. DISPLAY_IDENTIFIER ENVD_CUS_SET_SPC_2_2_8 ECU_ADDRESS 0xd00049d5 FORMAT "%3.0" /end MEASUREMENT
/begin MEASUREMENT tbl_frf[8].envd_cus_set_spc[1][2] "Freeze frame FRF_CUS_SET_SPC: environmental data specific to each failure (not fixed by law) stored in set" UBYTE _CNV_A_R_LINEAR_____0_CM 1 100. 0. 255. DISPLAY_IDENTIFIER ENVD_CUS_SET_SPC_3_2_8 ECU_ADDRESS 0xd00049d6 FORMAT "%3.0" /end MEASUREMENT
/begin MEASUREMENT tbl_frf[8].envd_cus_set_spc[1][3] "Freeze frame FRF_CUS_SET_SPC: environmental data specific to each failure (not fixed by law) stored in set" UBYTE _CNV_A_R_LINEAR_____0_CM 1 100. 0. 255. DISPLAY_IDENTIFIER ENVD_CUS_SET_SPC_4_2_8 ECU_ADDRESS 0xd00049d7 FORMAT "%3.0" /end MEASUREMENT
/begin MEASUREMENT tbl_frf[8].envd_cus_set_spc[2][0] "Freeze frame FRF_CUS_SET_SPC: environmental data specific to each failure (not fixed by law) stored in set" UBYTE _CNV_A_R_LINEAR_____0_CM 1 100. 0. 255. DISPLAY_IDENTIFIER ENVD_CUS_SET_SPC_1_3_8 ECU_ADDRESS 0xd00049d8 FORMAT "%3.0" /end MEASUREMENT
/begin MEASUREMENT tbl_frf[8].envd_cus_set_spc[2][1] "Freeze frame FRF_CUS_SET_SPC: environmental data specific to each failure (not fixed by law) stored in set" UBYTE _CNV_A_R_LINEAR_____0_CM 1 100. 0. 255. DISPLAY_IDENTIFIER ENVD_CUS_SET_SPC_2_3_8 ECU_ADDRESS 0xd00049d9 FORMAT "%3.0" /end MEASUREMENT
/begin MEASUREMENT tbl_frf[8].envd_cus_set_spc[2][2] "Freeze frame FRF_CUS_SET_SPC: environmental data specific to each failure (not fixed by law) stored in set" UBYTE _CNV_A_R_LINEAR_____0_CM 1 100. 0. 255. DISPLAY_IDENTIFIER ENVD_CUS_SET_SPC_3_3_8 ECU_ADDRESS 0xd00049da FORMAT "%3.0" /end MEASUREMENT
/begin MEASUREMENT tbl_frf[8].envd_cus_set_spc[2][3] "Freeze frame FRF_CUS_SET_SPC: environmental data specific to each failure (not fixed by law) stored in set" UBYTE _CNV_A_R_LINEAR_____0_CM 1 100. 0. 255. DISPLAY_IDENTIFIER ENVD_CUS_SET_SPC_4_3_8 ECU_ADDRESS 0xd00049db FORMAT "%3.0" /end MEASUREMENT
/begin MEASUREMENT tbl_frf[9].envd_obd[0] "Freeze frame FRF_OBD: environmental data (fixed by law)" UBYTE _CNV_A_R_LINEAR_____0_CM 1 100. 0. 255. DISPLAY_IDENTIFIER ENVD_OBD_1_9 ECU_ADDRESS 0xd00049e0 FORMAT "%3.0" /end MEASUREMENT
/begin MEASUREMENT tbl_frf[9].envd_obd[1] "Freeze frame FRF_OBD: environmental data (fixed by law)" UBYTE _CNV_A_R_LINEAR_____0_CM 1 100. 0. 255. DISPLAY_IDENTIFIER ENVD_OBD_2_9 ECU_ADDRESS 0xd00049e1 FORMAT "%3.0" /end MEASUREMENT
/begin MEASUREMENT tbl_frf[9].envd_obd[2] "Freeze frame FRF_OBD: environmental data (fixed by law)" UBYTE _CNV_A_R_LINEAR_____0_CM 1 100. 0. 255. DISPLAY_IDENTIFIER ENVD_OBD_3_9 ECU_ADDRESS 0xd00049e2 FORMAT "%3.0" /end MEASUREMENT
/begin MEASUREMENT tbl_frf[9].envd_obd[3] "Freeze frame FRF_OBD: environmental data (fixed by law)" UBYTE _CNV_A_R_LINEAR_____0_CM 1 100. 0. 255. DISPLAY_IDENTIFIER ENVD_OBD_4_9 ECU_ADDRESS 0xd00049e3 FORMAT "%3.0" /end MEASUREMENT
/begin MEASUREMENT tbl_frf[9].envd_obd[4] "Freeze frame FRF_OBD: environmental data (fixed by law)" UBYTE _CNV_A_R_LINEAR_____0_CM 1 100. 0. 255. DISPLAY_IDENTIFIER ENVD_OBD_5_9 ECU_ADDRESS 0xd00049e4 FORMAT "%3.0" /end MEASUREMENT
/begin MEASUREMENT tbl_frf[9].envd_obd[5] "Freeze frame FRF_OBD: environmental data (fixed by law)" UBYTE _CNV_A_R_LINEAR_____0_CM 1 100. 0. 255. DISPLAY_IDENTIFIER ENVD_OBD_6_9 ECU_ADDRESS 0xd00049e5 FORMAT "%3.0" /end MEASUREMENT
/begin MEASUREMENT tbl_frf[9].envd_obd[6] "Freeze frame FRF_OBD: environmental data (fixed by law)" UBYTE _CNV_A_R_LINEAR_____0_CM 1 100. 0. 255. DISPLAY_IDENTIFIER ENVD_OBD_7_9 ECU_ADDRESS 0xd00049e6 FORMAT "%3.0" /end MEASUREMENT
/begin MEASUREMENT tbl_frf[9].envd_obd[7] "Freeze frame FRF_OBD: environmental data (fixed by law)" UBYTE _CNV_A_R_LINEAR_____0_CM 1 100. 0. 255. DISPLAY_IDENTIFIER ENVD_OBD_8_9 ECU_ADDRESS 0xd00049e7 FORMAT "%3.0" /end MEASUREMENT
/begin MEASUREMENT tbl_frf[9].envd_obd[8] "Freeze frame FRF_OBD: environmental data (fixed by law)" UBYTE _CNV_A_R_LINEAR_____0_CM 1 100. 0. 255. DISPLAY_IDENTIFIER ENVD_OBD_9_9 ECU_ADDRESS 0xd00049e8 FORMAT "%3.0" /end MEASUREMENT
/begin MEASUREMENT tbl_frf[9].envd_obd[9] "Freeze frame FRF_OBD: environmental data (fixed by law)" UBYTE _CNV_A_R_LINEAR_____0_CM 1 100. 0. 255. DISPLAY_IDENTIFIER ENVD_OBD_10_9 ECU_ADDRESS 0xd00049e9 FORMAT "%3.0" /end MEASUREMENT
/begin MEASUREMENT tbl_frf[9].envd_obd[10] "Freeze frame FRF_OBD: environmental data (fixed by law)" UBYTE _CNV_A_R_LINEAR_____0_CM 1 100. 0. 255. DISPLAY_IDENTIFIER ENVD_OBD_11_9 ECU_ADDRESS 0xd00049ea FORMAT "%3.0" /end MEASUREMENT
/begin MEASUREMENT tbl_frf[9].envd_obd[11] "Freeze frame FRF_OBD: environmental data (fixed by law)" UBYTE _CNV_A_R_LINEAR_____0_CM 1 100. 0. 255. DISPLAY_IDENTIFIER ENVD_OBD_12_9 ECU_ADDRESS 0xd00049eb FORMAT "%3.0" /end MEASUREMENT
/begin MEASUREMENT tbl_frf[9].envd_obd[12] "Freeze frame FRF_OBD: environmental data (fixed by law)" UBYTE _CNV_A_R_LINEAR_____0_CM 1 100. 0. 255. DISPLAY_IDENTIFIER ENVD_OBD_13_9 ECU_ADDRESS 0xd00049ec FORMAT "%3.0" /end MEASUREMENT
/begin MEASUREMENT tbl_frf[9].envd_obd[13] "Freeze frame FRF_OBD: environmental data (fixed by law)" UBYTE _CNV_A_R_LINEAR_____0_CM 1 100. 0. 255. DISPLAY_IDENTIFIER ENVD_OBD_14_9 ECU_ADDRESS 0xd00049ed FORMAT "%3.0" /end MEASUREMENT
/begin MEASUREMENT tbl_frf[9].envd_obd[14] "Freeze frame FRF_OBD: environmental data (fixed by law)" UBYTE _CNV_A_R_LINEAR_____0_CM 1 100. 0. 255. DISPLAY_IDENTIFIER ENVD_OBD_15_9 ECU_ADDRESS 0xd00049ee FORMAT "%3.0" /end MEASUREMENT
/begin MEASUREMENT tbl_frf[9].envd_obd[15] "Freeze frame FRF_OBD: environmental data (fixed by law)" UBYTE _CNV_A_R_LINEAR_____0_CM 1 100. 0. 255. DISPLAY_IDENTIFIER ENVD_OBD_16_9 ECU_ADDRESS 0xd00049ef FORMAT "%3.0" /end MEASUREMENT
/begin MEASUREMENT tbl_frf[9].envd_obd[16] "Freeze frame FRF_OBD: environmental data (fixed by law)" UBYTE _CNV_A_R_LINEAR_____0_CM 1 100. 0. 255. DISPLAY_IDENTIFIER ENVD_OBD_17_9 ECU_ADDRESS 0xd00049f0 FORMAT "%3.0" /end MEASUREMENT
/begin MEASUREMENT tbl_frf[9].envd_obd[17] "Freeze frame FRF_OBD: environmental data (fixed by law)" UBYTE _CNV_A_R_LINEAR_____0_CM 1 100. 0. 255. DISPLAY_IDENTIFIER ENVD_OBD_18_9 ECU_ADDRESS 0xd00049f1 FORMAT "%3.0" /end MEASUREMENT
/begin MEASUREMENT tbl_frf[9].envd_obd[18] "Freeze frame FRF_OBD: environmental data (fixed by law)" UBYTE _CNV_A_R_LINEAR_____0_CM 1 100. 0. 255. DISPLAY_IDENTIFIER ENVD_OBD_19_9 ECU_ADDRESS 0xd00049f2 FORMAT "%3.0" /end MEASUREMENT
/begin MEASUREMENT tbl_frf[9].envd_obd[19] "Freeze frame FRF_OBD: environmental data (fixed by law)" UBYTE _CNV_A_R_LINEAR_____0_CM 1 100. 0. 255. DISPLAY_IDENTIFIER ENVD_OBD_20_9 ECU_ADDRESS 0xd00049f3 FORMAT "%3.0" /end MEASUREMENT
/begin MEASUREMENT tbl_frf[9].envd_obd[20] "Freeze frame FRF_OBD: environmental data (fixed by law)" UBYTE _CNV_A_R_LINEAR_____0_CM 1 100. 0. 255. DISPLAY_IDENTIFIER ENVD_OBD_21_9 ECU_ADDRESS 0xd00049f4 FORMAT "%3.0" /end MEASUREMENT
/begin MEASUREMENT tbl_frf[9].envd_obd[21] "Freeze frame FRF_OBD: environmental data (fixed by law)" UBYTE _CNV_A_R_LINEAR_____0_CM 1 100. 0. 255. DISPLAY_IDENTIFIER ENVD_OBD_22_9 ECU_ADDRESS 0xd00049f5 FORMAT "%3.0" /end MEASUREMENT
/begin MEASUREMENT tbl_frf[9].envd_obd[22] "Freeze frame FRF_OBD: environmental data (fixed by law)" UBYTE _CNV_A_R_LINEAR_____0_CM 1 100. 0. 255. DISPLAY_IDENTIFIER ENVD_OBD_23_9 ECU_ADDRESS 0xd00049f6 FORMAT "%3.0" /end MEASUREMENT
/begin MEASUREMENT tbl_frf[9].envd_obd[23] "Freeze frame FRF_OBD: environmental data (fixed by law)" UBYTE _CNV_A_R_LINEAR_____0_CM 1 100. 0. 255. DISPLAY_IDENTIFIER ENVD_OBD_24_9 ECU_ADDRESS 0xd00049f7 FORMAT "%3.0" /end MEASUREMENT
/begin MEASUREMENT tbl_frf[9].envd_obd[24] "Freeze frame FRF_OBD: environmental data (fixed by law)" UBYTE _CNV_A_R_LINEAR_____0_CM 1 100. 0. 255. DISPLAY_IDENTIFIER ENVD_OBD_25_9 ECU_ADDRESS 0xd00049f8 FORMAT "%3.0" /end MEASUREMENT
/begin MEASUREMENT tbl_frf[9].envd_obd[25] "Freeze frame FRF_OBD: environmental data (fixed by law)" UBYTE _CNV_A_R_LINEAR_____0_CM 1 100. 0. 255. DISPLAY_IDENTIFIER ENVD_OBD_26_9 ECU_ADDRESS 0xd00049f9 FORMAT "%3.0" /end MEASUREMENT
/begin MEASUREMENT tbl_frf[9].envd_obd[26] "Freeze frame FRF_OBD: environmental data (fixed by law)" UBYTE _CNV_A_R_LINEAR_____0_CM 1 100. 0. 255. DISPLAY_IDENTIFIER ENVD_OBD_27_9 ECU_ADDRESS 0xd00049fa FORMAT "%3.0" /end MEASUREMENT
/begin MEASUREMENT tbl_frf[9].envd_obd[27] "Freeze frame FRF_OBD: environmental data (fixed by law)" UBYTE _CNV_A_R_LINEAR_____0_CM 1 100. 0. 255. DISPLAY_IDENTIFIER ENVD_OBD_28_9 ECU_ADDRESS 0xd00049fb FORMAT "%3.0" /end MEASUREMENT
/begin MEASUREMENT tbl_frf[9].envd_obd[28] "Freeze frame FRF_OBD: environmental data (fixed by law)" UBYTE _CNV_A_R_LINEAR_____0_CM 1 100. 0. 255. DISPLAY_IDENTIFIER ENVD_OBD_29_9 ECU_ADDRESS 0xd00049fc FORMAT "%3.0" /end MEASUREMENT
/begin MEASUREMENT tbl_frf[9].envd_obd[29] "Freeze frame FRF_OBD: environmental data (fixed by law)" UBYTE _CNV_A_R_LINEAR_____0_CM 1 100. 0. 255. DISPLAY_IDENTIFIER ENVD_OBD_30_9 ECU_ADDRESS 0xd00049fd FORMAT "%3.0" /end MEASUREMENT
/begin MEASUREMENT tbl_frf[9].envd_obd[30] "Freeze frame FRF_OBD: environmental data (fixed by law)" UBYTE _CNV_A_R_LINEAR_____0_CM 1 100. 0. 255. DISPLAY_IDENTIFIER ENVD_OBD_31_9 ECU_ADDRESS 0xd00049fe FORMAT "%3.0" /end MEASUREMENT
/begin MEASUREMENT tbl_frf[9].envd_obd[31] "Freeze frame FRF_OBD: environmental data (fixed by law)" UBYTE _CNV_A_R_LINEAR_____0_CM 1 100. 0. 255. DISPLAY_IDENTIFIER ENVD_OBD_32_9 ECU_ADDRESS 0xd00049ff FORMAT "%3.0" /end MEASUREMENT
/begin MEASUREMENT tbl_frf[9].envd_obd[32] "Freeze frame FRF_OBD: environmental data (fixed by law)" UBYTE _CNV_A_R_LINEAR_____0_CM 1 100. 0. 255. DISPLAY_IDENTIFIER ENVD_OBD_33_9 ECU_ADDRESS 0xd0004a00 FORMAT "%3.0" /end MEASUREMENT
/begin MEASUREMENT tbl_frf[9].envd_obd[33] "Freeze frame FRF_OBD: environmental data (fixed by law)" UBYTE _CNV_A_R_LINEAR_____0_CM 1 100. 0. 255. DISPLAY_IDENTIFIER ENVD_OBD_34_9 ECU_ADDRESS 0xd0004a01 FORMAT "%3.0" /end MEASUREMENT
/begin MEASUREMENT tbl_frf[9].envd_obd[34] "Freeze frame FRF_OBD: environmental data (fixed by law)" UBYTE _CNV_A_R_LINEAR_____0_CM 1 100. 0. 255. DISPLAY_IDENTIFIER ENVD_OBD[34] ECU_ADDRESS 0xd0004a02 FORMAT "%3.0" /end MEASUREMENT
/begin MEASUREMENT tbl_frf[9].envd_cus_cmn[0] "Freeze frame FRF_CUS_CMN: environmental data common to all failure (not fixed by law)" UBYTE _CNV_A_R_LINEAR_____0_CM 1 100. 0. 255. DISPLAY_IDENTIFIER ENVD_CUS_CMN_1_9 ECU_ADDRESS 0xd0004a03 FORMAT "%3.0" /end MEASUREMENT
/begin MEASUREMENT tbl_frf[9].envd_cus_set_cmn[0][0] "Freeze frame FRF_CUS_SET_CMN: environmental data common to all failure (not fixed by law) stored in set" UBYTE _CNV_A_R_LINEAR_____0_CM 1 100. 0. 255. DISPLAY_IDENTIFIER ENVD_CUS_SET_CMN_1_1_9 ECU_ADDRESS 0xd0004a04 FORMAT "%3.0" /end MEASUREMENT
/begin MEASUREMENT tbl_frf[9].envd_cus_set_cmn[0][1] "Freeze frame FRF_CUS_SET_CMN: environmental data common to all failure (not fixed by law) stored in set" UBYTE _CNV_A_R_LINEAR_____0_CM 1 100. 0. 255. DISPLAY_IDENTIFIER ENVD_CUS_SET_CMN_2_1_9 ECU_ADDRESS 0xd0004a05 FORMAT "%3.0" /end MEASUREMENT
/begin MEASUREMENT tbl_frf[9].envd_cus_set_cmn[0][2] "Freeze frame FRF_CUS_SET_CMN: environmental data common to all failure (not fixed by law) stored in set" UBYTE _CNV_A_R_LINEAR_____0_CM 1 100. 0. 255. DISPLAY_IDENTIFIER ENVD_CUS_SET_CMN_3_1_9 ECU_ADDRESS 0xd0004a06 FORMAT "%3.0" /end MEASUREMENT
/begin MEASUREMENT tbl_frf[9].envd_cus_set_cmn[1][0] "Freeze frame FRF_CUS_SET_CMN: environmental data common to all failure (not fixed by law) stored in set" UBYTE _CNV_A_R_LINEAR_____0_CM 1 100. 0. 255. DISPLAY_IDENTIFIER ENVD_CUS_SET_CMN_1_2_9 ECU_ADDRESS 0xd0004a07 FORMAT "%3.0" /end MEASUREMENT
/begin MEASUREMENT tbl_frf[9].envd_cus_set_cmn[1][1] "Freeze frame FRF_CUS_SET_CMN: environmental data common to all failure (not fixed by law) stored in set" UBYTE _CNV_A_R_LINEAR_____0_CM 1 100. 0. 255. DISPLAY_IDENTIFIER ENVD_CUS_SET_CMN_2_2_9 ECU_ADDRESS 0xd0004a08 FORMAT "%3.0" /end MEASUREMENT
/begin MEASUREMENT tbl_frf[9].envd_cus_set_cmn[1][2] "Freeze frame FRF_CUS_SET_CMN: environmental data common to all failure (not fixed by law) stored in set" UBYTE _CNV_A_R_LINEAR_____0_CM 1 100. 0. 255. DISPLAY_IDENTIFIER ENVD_CUS_SET_CMN_3_2_9 ECU_ADDRESS 0xd0004a09 FORMAT "%3.0" /end MEASUREMENT
/begin MEASUREMENT tbl_frf[9].envd_cus_set_cmn[2][0] "Freeze frame FRF_CUS_SET_CMN: environmental data common to all failure (not fixed by law) stored in set" UBYTE _CNV_A_R_LINEAR_____0_CM 1 100. 0. 255. DISPLAY_IDENTIFIER ENVD_CUS_SET_CMN_1_3_9 ECU_ADDRESS 0xd0004a0a FORMAT "%3.0" /end MEASUREMENT
/begin MEASUREMENT tbl_frf[9].envd_cus_set_cmn[2][1] "Freeze frame FRF_CUS_SET_CMN: environmental data common to all failure (not fixed by law) stored in set" UBYTE _CNV_A_R_LINEAR_____0_CM 1 100. 0. 255. DISPLAY_IDENTIFIER ENVD_CUS_SET_CMN_2_3_9 ECU_ADDRESS 0xd0004a0b FORMAT "%3.0" /end MEASUREMENT
/begin MEASUREMENT tbl_frf[9].envd_cus_set_cmn[2][2] "Freeze frame FRF_CUS_SET_CMN: environmental data common to all failure (not fixed by law) stored in set" UBYTE _CNV_A_R_LINEAR_____0_CM 1 100. 0. 255. DISPLAY_IDENTIFIER ENVD_CUS_SET_CMN_3_3_9 ECU_ADDRESS 0xd0004a0c FORMAT "%3.0" /end MEASUREMENT
/begin MEASUREMENT tbl_frf[9].envd_cus_set_spc[0][0] "Freeze frame FRF_CUS_SET_SPC: environmental data specific to each failure (not fixed by law) stored in set" UBYTE _CNV_A_R_LINEAR_____0_CM 1 100. 0. 255. DISPLAY_IDENTIFIER ENVD_CUS_SET_SPC_1_1_9 ECU_ADDRESS 0xd0004a10 FORMAT "%3.0" /end MEASUREMENT
/begin MEASUREMENT tbl_frf[9].envd_cus_set_spc[0][1] "Freeze frame FRF_CUS_SET_SPC: environmental data specific to each failure (not fixed by law) stored in set" UBYTE _CNV_A_R_LINEAR_____0_CM 1 100. 0. 255. DISPLAY_IDENTIFIER ENVD_CUS_SET_SPC_2_1_9 ECU_ADDRESS 0xd0004a11 FORMAT "%3.0" /end MEASUREMENT
/begin MEASUREMENT tbl_frf[9].envd_cus_set_spc[0][2] "Freeze frame FRF_CUS_SET_SPC: environmental data specific to each failure (not fixed by law) stored in set" UBYTE _CNV_A_R_LINEAR_____0_CM 1 100. 0. 255. DISPLAY_IDENTIFIER ENVD_CUS_SET_SPC_3_1_9 ECU_ADDRESS 0xd0004a12 FORMAT "%3.0" /end MEASUREMENT
/begin MEASUREMENT tbl_frf[9].envd_cus_set_spc[0][3] "Freeze frame FRF_CUS_SET_SPC: environmental data specific to each failure (not fixed by law) stored in set" UBYTE _CNV_A_R_LINEAR_____0_CM 1 100. 0. 255. DISPLAY_IDENTIFIER ENVD_CUS_SET_SPC_4_1_9 ECU_ADDRESS 0xd0004a13 FORMAT "%3.0" /end MEASUREMENT
/begin MEASUREMENT tbl_frf[9].envd_cus_set_spc[1][0] "Freeze frame FRF_CUS_SET_SPC: environmental data specific to each failure (not fixed by law) stored in set" UBYTE _CNV_A_R_LINEAR_____0_CM 1 100. 0. 255. DISPLAY_IDENTIFIER ENVD_CUS_SET_SPC_1_2_9 ECU_ADDRESS 0xd0004a14 FORMAT "%3.0" /end MEASUREMENT
/begin MEASUREMENT tbl_frf[9].envd_cus_set_spc[1][1] "Freeze frame FRF_CUS_SET_SPC: environmental data specific to each failure (not fixed by law) stored in set" UBYTE _CNV_A_R_LINEAR_____0_CM 1 100. 0. 255. DISPLAY_IDENTIFIER ENVD_CUS_SET_SPC_2_2_9 ECU_ADDRESS 0xd0004a15 FORMAT "%3.0" /end MEASUREMENT
/begin MEASUREMENT tbl_frf[9].envd_cus_set_spc[1][2] "Freeze frame FRF_CUS_SET_SPC: environmental data specific to each failure (not fixed by law) stored in set" UBYTE _CNV_A_R_LINEAR_____0_CM 1 100. 0. 255. DISPLAY_IDENTIFIER ENVD_CUS_SET_SPC_3_2_9 ECU_ADDRESS 0xd0004a16 FORMAT "%3.0" /end MEASUREMENT
/begin MEASUREMENT tbl_frf[9].envd_cus_set_spc[1][3] "Freeze frame FRF_CUS_SET_SPC: environmental data specific to each failure (not fixed by law) stored in set" UBYTE _CNV_A_R_LINEAR_____0_CM 1 100. 0. 255. DISPLAY_IDENTIFIER ENVD_CUS_SET_SPC_4_2_9 ECU_ADDRESS 0xd0004a17 FORMAT "%3.0" /end MEASUREMENT
/begin MEASUREMENT tbl_frf[9].envd_cus_set_spc[2][0] "Freeze frame FRF_CUS_SET_SPC: environmental data specific to each failure (not fixed by law) stored in set" UBYTE _CNV_A_R_LINEAR_____0_CM 1 100. 0. 255. DISPLAY_IDENTIFIER ENVD_CUS_SET_SPC_1_3_9 ECU_ADDRESS 0xd0004a18 FORMAT "%3.0" /end MEASUREMENT
/begin MEASUREMENT tbl_frf[9].envd_cus_set_spc[2][1] "Freeze frame FRF_CUS_SET_SPC: environmental data specific to each failure (not fixed by law) stored in set" UBYTE _CNV_A_R_LINEAR_____0_CM 1 100. 0. 255. DISPLAY_IDENTIFIER ENVD_CUS_SET_SPC_2_3_9 ECU_ADDRESS 0xd0004a19 FORMAT "%3.0" /end MEASUREMENT
/begin MEASUREMENT tbl_frf[9].envd_cus_set_spc[2][2] "Freeze frame FRF_CUS_SET_SPC: environmental data specific to each failure (not fixed by law) stored in set" UBYTE _CNV_A_R_LINEAR_____0_CM 1 100. 0. 255. DISPLAY_IDENTIFIER ENVD_CUS_SET_SPC_3_3_9 ECU_ADDRESS 0xd0004a1a FORMAT "%3.0" /end MEASUREMENT
/begin MEASUREMENT tbl_frf[9].envd_cus_set_spc[2][3] "Freeze frame FRF_CUS_SET_SPC: environmental data specific to each failure (not fixed by law) stored in set" UBYTE _CNV_A_R_LINEAR_____0_CM 1 100. 0. 255. DISPLAY_IDENTIFIER ENVD_CUS_SET_SPC_4_3_9 ECU_ADDRESS 0xd0004a1b FORMAT "%3.0" /end MEASUREMENT
/begin MEASUREMENT fmy_scdn_equ_mis_0.n_min "minimal engine speed of similar conditions window (2nd)" UWORD _CNV_A_R_LINEAR_____13_CM 1 100. 0. 8160. DISPLAY_IDENTIFIER N_MIN_SCDN_EQU_MIS_0 ECU_ADDRESS 0xd0002620 FORMAT "%4.0" /end MEASUREMENT
/begin MEASUREMENT fmy_scdn_equ_mis_0.n_max "maximal engine speed of similar conditions window (2nd)" UWORD _CNV_A_R_LINEAR_____13_CM 1 100. 0. 8160. DISPLAY_IDENTIFIER N_MAX_SCDN_EQU_MIS_0 ECU_ADDRESS 0xd0002622 FORMAT "%4.0" /end MEASUREMENT
/begin MEASUREMENT fmy_scdn_equ_mis_0.ctr_scdn_equ_dc "Counter of non-occurence of similar condition" UBYTE _CNV_A_R_LINEAR_____0_CM 1 100. 0. 255. DISPLAY_IDENTIFIER CTR_SCDN_EQU_DC_MIS_0 ECU_ADDRESS 0xd0002624 FORMAT "%3.0" /end MEASUREMENT
/begin MEASUREMENT fmy_scdn_equ_mis_0.scdn_info "see specification for description." UBYTE _CNV_A_R_LINEAR_____0_CM 1 100. 0. 31. DISPLAY_IDENTIFIER SCDN_INFO_MIS_0 ECU_ADDRESS 0xd0002625 FORMAT "%3.0" /end MEASUREMENT
/begin MEASUREMENT fmy_scdn_equ_mis_0.load_min "minimal load of similar conditions window (2nd)" UBYTE _CNV_A_R_LINEAR_____5_CM 1 100. 0. 99.609375 DISPLAY_IDENTIFIER LOAD_MIN_SCDN_EQU_MIS_0 ECU_ADDRESS 0xd0002626 FORMAT "%9.6" /end MEASUREMENT
/begin MEASUREMENT fmy_scdn_equ_mis_0.load_max "maximal load of similar conditions window (2nd)" UBYTE _CNV_A_R_LINEAR_____5_CM 1 100. 0. 99.609375 DISPLAY_IDENTIFIER LOAD_MAX_SCDN_EQU_MIS_0 ECU_ADDRESS 0xd0002627 FORMAT "%9.6" /end MEASUREMENT
/begin MEASUREMENT fmy_scdn_equ_mis_0.lv_wup_scdn_equ "Warm-up status for similar conditions for OBDII continuous error XX" UBYTE _CNV_S_2_RANGE__0___1_CM 1 100. 0. 1. DISPLAY_IDENTIFIER LV_WUP_SCDN_EQU_MIS_0 ECU_ADDRESS 0xd0002628 /end MEASUREMENT
/begin MEASUREMENT fmy_scdn_equ_mis_1.n_min "minimal engine speed of similar conditions window (2nd)" UWORD _CNV_A_R_LINEAR_____13_CM 1 100. 0. 8160. DISPLAY_IDENTIFIER N_MIN_SCDN_EQU_MIS_1 ECU_ADDRESS 0xd000262c FORMAT "%4.0" /end MEASUREMENT
/begin MEASUREMENT fmy_scdn_equ_mis_1.n_max "maximal engine speed of similar conditions window (2nd)" UWORD _CNV_A_R_LINEAR_____13_CM 1 100. 0. 8160. DISPLAY_IDENTIFIER N_MAX_SCDN_EQU_MIS_1 ECU_ADDRESS 0xd000262e FORMAT "%4.0" /end MEASUREMENT
/begin MEASUREMENT fmy_scdn_equ_mis_1.ctr_scdn_equ_dc "Counter of non-occurence of similar condition" UBYTE _CNV_A_R_LINEAR_____0_CM 1 100. 0. 255. DISPLAY_IDENTIFIER CTR_SCDN_EQU_DC_MIS_1 ECU_ADDRESS 0xd0002630 FORMAT "%3.0" /end MEASUREMENT
/begin MEASUREMENT fmy_scdn_equ_mis_1.scdn_info "see specification for description." UBYTE _CNV_A_R_LINEAR_____0_CM 1 100. 0. 31. DISPLAY_IDENTIFIER SCDN_INFO_MIS_1 ECU_ADDRESS 0xd0002631 FORMAT "%3.0" /end MEASUREMENT
/begin MEASUREMENT fmy_scdn_equ_mis_1.load_min "minimal load of similar conditions window (2nd)" UBYTE _CNV_A_R_LINEAR_____5_CM 1 100. 0. 99.609375 DISPLAY_IDENTIFIER LOAD_MIN_SCDN_EQU_MIS_1 ECU_ADDRESS 0xd0002632 FORMAT "%9.6" /end MEASUREMENT
/begin MEASUREMENT fmy_scdn_equ_mis_1.load_max "maximal load of similar conditions window (2nd)" UBYTE _CNV_A_R_LINEAR_____5_CM 1 100. 0. 99.609375 DISPLAY_IDENTIFIER LOAD_MAX_SCDN_EQU_MIS_1 ECU_ADDRESS 0xd0002633 FORMAT "%9.6" /end MEASUREMENT
/begin MEASUREMENT fmy_scdn_equ_mis_1.lv_wup_scdn_equ "Warm-up status for similar conditions for OBDII continuous error XX" UBYTE _CNV_S_2_RANGE__0___1_CM 1 100. 0. 1. DISPLAY_IDENTIFIER LV_WUP_SCDN_EQU_MIS_1 ECU_ADDRESS 0xd0002634 /end MEASUREMENT
/begin MEASUREMENT fmy_scdn_equ_mis_2.n_min "minimal engine speed of similar conditions window (2nd)" UWORD _CNV_A_R_LINEAR_____13_CM 1 100. 0. 8160. DISPLAY_IDENTIFIER N_MIN_SCDN_EQU_MIS_2 ECU_ADDRESS 0xd0002638 FORMAT "%4.0" /end MEASUREMENT
/begin MEASUREMENT fmy_scdn_equ_mis_2.n_max "maximal engine speed of similar conditions window (2nd)" UWORD _CNV_A_R_LINEAR_____13_CM 1 100. 0. 8160. DISPLAY_IDENTIFIER N_MAX_SCDN_EQU_MIS_2 ECU_ADDRESS 0xd000263a FORMAT "%4.0" /end MEASUREMENT
/begin MEASUREMENT fmy_scdn_equ_mis_2.ctr_scdn_equ_dc "Counter of non-occurence of similar condition" UBYTE _CNV_A_R_LINEAR_____0_CM 1 100. 0. 255. DISPLAY_IDENTIFIER CTR_SCDN_EQU_DC_MIS_2 ECU_ADDRESS 0xd000263c FORMAT "%3.0" /end MEASUREMENT
/begin MEASUREMENT fmy_scdn_equ_mis_2.scdn_info "see specification for description." UBYTE _CNV_A_R_LINEAR_____0_CM 1 100. 0. 31. DISPLAY_IDENTIFIER SCDN_INFO_MIS_2 ECU_ADDRESS 0xd000263d FORMAT "%3.0" /end MEASUREMENT
/begin MEASUREMENT fmy_scdn_equ_mis_2.load_min "minimal load of similar conditions window (2nd)" UBYTE _CNV_A_R_LINEAR_____5_CM 1 100. 0. 99.609375 DISPLAY_IDENTIFIER LOAD_MIN_SCDN_EQU_MIS_2 ECU_ADDRESS 0xd000263e FORMAT "%9.6" /end MEASUREMENT
/begin MEASUREMENT fmy_scdn_equ_mis_2.load_max "maximal load of similar conditions window (2nd)" UBYTE _CNV_A_R_LINEAR_____5_CM 1 100. 0. 99.609375 DISPLAY_IDENTIFIER LOAD_MAX_SCDN_EQU_MIS_2 ECU_ADDRESS 0xd000263f FORMAT "%9.6" /end MEASUREMENT
/begin MEASUREMENT fmy_scdn_equ_mis_2.lv_wup_scdn_equ "Warm-up status for similar conditions for OBDII continuous error XX" UBYTE _CNV_S_2_RANGE__0___1_CM 1 100. 0. 1. DISPLAY_IDENTIFIER LV_WUP_SCDN_EQU_MIS_2 ECU_ADDRESS 0xd0002640 /end MEASUREMENT
/begin MEASUREMENT fmy_scdn_equ_fsd_1.n_min "minimal engine speed of similar conditions window (2nd)" UWORD _CNV_A_R_LINEAR_____13_CM 1 100. 0. 8160. DISPLAY_IDENTIFIER N_MIN_SCDN_EQU_FSD_1 ECU_ADDRESS 0xd0002608 FORMAT "%4.0" /end MEASUREMENT
/begin MEASUREMENT fmy_scdn_equ_fsd_1.n_max "maximal engine speed of similar conditions window (2nd)" UWORD _CNV_A_R_LINEAR_____13_CM 1 100. 0. 8160. DISPLAY_IDENTIFIER N_MAX_SCDN_EQU_FSD_1 ECU_ADDRESS 0xd000260a FORMAT "%4.0" /end MEASUREMENT
/begin MEASUREMENT fmy_scdn_equ_fsd_1.ctr_scdn_equ_dc "Counter of non-occurence of similar condition" UBYTE _CNV_A_R_LINEAR_____0_CM 1 100. 0. 255. DISPLAY_IDENTIFIER CTR_SCDN_EQU_DC_FSD_1 ECU_ADDRESS 0xd000260c FORMAT "%3.0" /end MEASUREMENT
/begin MEASUREMENT fmy_scdn_equ_fsd_1.scdn_info "see specification for description." UBYTE _CNV_A_R_LINEAR_____0_CM 1 100. 0. 31. DISPLAY_IDENTIFIER SCDN_INFO_FSD_1 ECU_ADDRESS 0xd000260d FORMAT "%3.0" /end MEASUREMENT
/begin MEASUREMENT fmy_scdn_equ_fsd_1.load_min "minimal load of similar conditions window (2nd)" UBYTE _CNV_A_R_LINEAR_____5_CM 1 100. 0. 99.609375 DISPLAY_IDENTIFIER LOAD_MIN_SCDN_EQU_FSD_1 ECU_ADDRESS 0xd000260e FORMAT "%9.6" /end MEASUREMENT
/begin MEASUREMENT fmy_scdn_equ_fsd_1.load_max "maximal load of similar conditions window (2nd)" UBYTE _CNV_A_R_LINEAR_____5_CM 1 100. 0. 99.609375 DISPLAY_IDENTIFIER LOAD_MAX_SCDN_EQU_FSD_1 ECU_ADDRESS 0xd000260f FORMAT "%9.6" /end MEASUREMENT
/begin MEASUREMENT fmy_scdn_equ_fsd_1.lv_wup_scdn_equ "Warm-up status for similar conditions for OBDII continuous error XX" UBYTE _CNV_S_2_RANGE__0___1_CM 1 100. 0. 1. DISPLAY_IDENTIFIER LV_WUP_SCDN_EQU_FSD_1 ECU_ADDRESS 0xd0002610 /end MEASUREMENT
/begin MEASUREMENT fmy_scdn_equ_fsd_2.n_min "minimal engine speed of similar conditions window (2nd)" UWORD _CNV_A_R_LINEAR_____13_CM 1 100. 0. 8160. DISPLAY_IDENTIFIER N_MIN_SCDN_EQU_FSD_2 ECU_ADDRESS 0xd0002614 FORMAT "%4.0" /end MEASUREMENT
/begin MEASUREMENT fmy_scdn_equ_fsd_2.n_max "maximal engine speed of similar conditions window (2nd)" UWORD _CNV_A_R_LINEAR_____13_CM 1 100. 0. 8160. DISPLAY_IDENTIFIER N_MAX_SCDN_EQU_FSD_2 ECU_ADDRESS 0xd0002616 FORMAT "%4.0" /end MEASUREMENT
/begin MEASUREMENT fmy_scdn_equ_fsd_2.ctr_scdn_equ_dc "Counter of non-occurence of similar condition" UBYTE _CNV_A_R_LINEAR_____0_CM 1 100. 0. 255. DISPLAY_IDENTIFIER CTR_SCDN_EQU_DC_FSD_2 ECU_ADDRESS 0xd0002618 FORMAT "%3.0" /end MEASUREMENT
/begin MEASUREMENT fmy_scdn_equ_fsd_2.scdn_info "see specification for description." UBYTE _CNV_A_R_LINEAR_____0_CM 1 100. 0. 31. DISPLAY_IDENTIFIER SCDN_INFO_FSD_2 ECU_ADDRESS 0xd0002619 FORMAT "%3.0" /end MEASUREMENT
/begin MEASUREMENT fmy_scdn_equ_fsd_2.load_min "minimal load of similar conditions window (2nd)" UBYTE _CNV_A_R_LINEAR_____5_CM 1 100. 0. 99.609375 DISPLAY_IDENTIFIER LOAD_MIN_SCDN_EQU_FSD_2 ECU_ADDRESS 0xd000261a FORMAT "%9.6" /end MEASUREMENT
/begin MEASUREMENT fmy_scdn_equ_fsd_2.load_max "maximal load of similar conditions window (2nd)" UBYTE _CNV_A_R_LINEAR_____5_CM 1 100. 0. 99.609375 DISPLAY_IDENTIFIER LOAD_MAX_SCDN_EQU_FSD_2 ECU_ADDRESS 0xd000261b FORMAT "%9.6" /end MEASUREMENT
/begin MEASUREMENT fmy_scdn_equ_fsd_2.lv_wup_scdn_equ "Warm-up status for similar conditions for OBDII continuous error XX" UBYTE _CNV_S_2_RANGE__0___1_CM 1 100. 0. 1. DISPLAY_IDENTIFIER LV_WUP_SCDN_EQU_FSD_2 ECU_ADDRESS 0xd000261c /end MEASUREMENT
/begin MEASUREMENT fmy_scdn_equ_mis_3.n_min "minimal engine speed of similar conditions window (2nd)" UWORD _CNV_A_R_LINEAR_____13_CM 1 100. 0. 8160. DISPLAY_IDENTIFIER N_MIN_SCDN_EQU_MIS_3 ECU_ADDRESS 0xd0002644 FORMAT "%4.0" /end MEASUREMENT
/begin MEASUREMENT fmy_scdn_equ_mis_3.n_max "maximal engine speed of similar conditions window (2nd)" UWORD _CNV_A_R_LINEAR_____13_CM 1 100. 0. 8160. DISPLAY_IDENTIFIER N_MAX_SCDN_EQU_MIS_3 ECU_ADDRESS 0xd0002646 FORMAT "%4.0" /end MEASUREMENT
/begin MEASUREMENT fmy_scdn_equ_mis_3.ctr_scdn_equ_dc "Counter of non-occurence of similar condition" UBYTE _CNV_A_R_LINEAR_____0_CM 1 100. 0. 255. DISPLAY_IDENTIFIER CTR_SCDN_EQU_DC_MIS_3 ECU_ADDRESS 0xd0002648 FORMAT "%3.0" /end MEASUREMENT
/begin MEASUREMENT fmy_scdn_equ_mis_3.scdn_info "see specification for description." UBYTE _CNV_A_R_LINEAR_____0_CM 1 100. 0. 31. DISPLAY_IDENTIFIER SCDN_INFO_MIS_3 ECU_ADDRESS 0xd0002649 FORMAT "%3.0" /end MEASUREMENT
/begin MEASUREMENT fmy_scdn_equ_mis_3.load_min "minimal load of similar conditions window (2nd)" UBYTE _CNV_A_R_LINEAR_____5_CM 1 100. 0. 99.609375 DISPLAY_IDENTIFIER LOAD_MIN_SCDN_EQU_MIS_3 ECU_ADDRESS 0xd000264a FORMAT "%9.6" /end MEASUREMENT
/begin MEASUREMENT fmy_scdn_equ_mis_3.load_max "maximal load of similar conditions window (2nd)" UBYTE _CNV_A_R_LINEAR_____5_CM 1 100. 0. 99.609375 DISPLAY_IDENTIFIER LOAD_MAX_SCDN_EQU_MIS_3 ECU_ADDRESS 0xd000264b FORMAT "%9.6" /end MEASUREMENT
/begin MEASUREMENT fmy_scdn_equ_mis_3.lv_wup_scdn_equ "Warm-up status for similar conditions for OBDII continuous error XX" UBYTE _CNV_S_2_RANGE__0___1_CM 1 100. 0. 1. DISPLAY_IDENTIFIER LV_WUP_SCDN_EQU_MIS_3 ECU_ADDRESS 0xd000264c /end MEASUREMENT
/begin MEASUREMENT fmy_scdn_equ_mis_4.n_min "minimal engine speed of similar conditions window (2nd)" UWORD _CNV_A_R_LINEAR_____13_CM 1 100. 0. 8160. DISPLAY_IDENTIFIER N_MIN_SCDN_EQU_MIS_4 ECU_ADDRESS 0xd0002650 FORMAT "%4.0" /end MEASUREMENT
/begin MEASUREMENT fmy_scdn_equ_mis_4.n_max "maximal engine speed of similar conditions window (2nd)" UWORD _CNV_A_R_LINEAR_____13_CM 1 100. 0. 8160. DISPLAY_IDENTIFIER N_MAX_SCDN_EQU_MIS_4 ECU_ADDRESS 0xd0002652 FORMAT "%4.0" /end MEASUREMENT
/begin MEASUREMENT fmy_scdn_equ_mis_4.ctr_scdn_equ_dc "Counter of non-occurence of similar condition" UBYTE _CNV_A_R_LINEAR_____0_CM 1 100. 0. 255. DISPLAY_IDENTIFIER CTR_SCDN_EQU_DC_MIS_4 ECU_ADDRESS 0xd0002654 FORMAT "%3.0" /end MEASUREMENT
/begin MEASUREMENT fmy_scdn_equ_mis_4.scdn_info "see specification for description." UBYTE _CNV_A_R_LINEAR_____0_CM 1 100. 0. 31. DISPLAY_IDENTIFIER SCDN_INFO_MIS_4 ECU_ADDRESS 0xd0002655 FORMAT "%3.0" /end MEASUREMENT
/begin MEASUREMENT fmy_scdn_equ_mis_4.load_min "minimal load of similar conditions window (2nd)" UBYTE _CNV_A_R_LINEAR_____5_CM 1 100. 0. 99.609375 DISPLAY_IDENTIFIER LOAD_MIN_SCDN_EQU_MIS_4 ECU_ADDRESS 0xd0002656 FORMAT "%9.6" /end MEASUREMENT
/begin MEASUREMENT fmy_scdn_equ_mis_4.load_max "maximal load of similar conditions window (2nd)" UBYTE _CNV_A_R_LINEAR_____5_CM 1 100. 0. 99.609375 DISPLAY_IDENTIFIER LOAD_MAX_SCDN_EQU_MIS_4 ECU_ADDRESS 0xd0002657 FORMAT "%9.6" /end MEASUREMENT
/begin MEASUREMENT fmy_scdn_equ_mis_4.lv_wup_scdn_equ "Warm-up status for similar conditions for OBDII continuous error XX" UBYTE _CNV_S_2_RANGE__0___1_CM 1 100. 0. 1. DISPLAY_IDENTIFIER LV_WUP_SCDN_EQU_MIS_4 ECU_ADDRESS 0xd0002658 /end MEASUREMENT
/begin MEASUREMENT fmy_scdn_equ_mis_5.n_min "minimal engine speed of similar conditions window (2nd)" UWORD _CNV_A_R_LINEAR_____13_CM 1 100. 0. 8160. DISPLAY_IDENTIFIER N_MIN_SCDN_EQU_MIS_5 ECU_ADDRESS 0xd000265c FORMAT "%4.0" /end MEASUREMENT
/begin MEASUREMENT fmy_scdn_equ_mis_5.n_max "maximal engine speed of similar conditions window (2nd)" UWORD _CNV_A_R_LINEAR_____13_CM 1 100. 0. 8160. DISPLAY_IDENTIFIER N_MAX_SCDN_EQU_MIS_5 ECU_ADDRESS 0xd000265e FORMAT "%4.0" /end MEASUREMENT
/begin MEASUREMENT fmy_scdn_equ_mis_5.ctr_scdn_equ_dc "Counter of non-occurence of similar condition" UBYTE _CNV_A_R_LINEAR_____0_CM 1 100. 0. 255. DISPLAY_IDENTIFIER CTR_SCDN_EQU_DC_MIS_5 ECU_ADDRESS 0xd0002660 FORMAT "%3.0" /end MEASUREMENT
/begin MEASUREMENT fmy_scdn_equ_mis_5.scdn_info "see specification for description." UBYTE _CNV_A_R_LINEAR_____0_CM 1 100. 0. 31. DISPLAY_IDENTIFIER SCDN_INFO_MIS_5 ECU_ADDRESS 0xd0002661 FORMAT "%3.0" /end MEASUREMENT
/begin MEASUREMENT fmy_scdn_equ_mis_5.load_min "minimal load of similar conditions window (2nd)" UBYTE _CNV_A_R_LINEAR_____5_CM 1 100. 0. 99.609375 DISPLAY_IDENTIFIER LOAD_MIN_SCDN_EQU_MIS_5 ECU_ADDRESS 0xd0002662 FORMAT "%9.6" /end MEASUREMENT
/begin MEASUREMENT fmy_scdn_equ_mis_5.load_max "maximal load of similar conditions window (2nd)" UBYTE _CNV_A_R_LINEAR_____5_CM 1 100. 0. 99.609375 DISPLAY_IDENTIFIER LOAD_MAX_SCDN_EQU_MIS_5 ECU_ADDRESS 0xd0002663 FORMAT "%9.6" /end MEASUREMENT
/begin MEASUREMENT fmy_scdn_equ_mis_5.lv_wup_scdn_equ "Warm-up status for similar conditions for OBDII continuous error XX" UBYTE _CNV_S_2_RANGE__0___1_CM 1 100. 0. 1. DISPLAY_IDENTIFIER LV_WUP_SCDN_EQU_MIS_5 ECU_ADDRESS 0xd0002664 /end MEASUREMENT
/begin MEASUREMENT fmy_scdn_tmp[0].n_min_err "minimal engine speed of similar conditions window for detected failure (1st)" UWORD _CNV_A_R_LINEAR_____13_CM 1 100. 0. 8160. DISPLAY_IDENTIFIER N_MIN_SCDN_ERR_TMP[0] ECU_ADDRESS 0xd0002668 FORMAT "%4.0" /end MEASUREMENT
/begin MEASUREMENT fmy_scdn_tmp[0].n_max_err "maximal engine speed of similar conditions window for detected failure (1st)" UWORD _CNV_A_R_LINEAR_____13_CM 1 100. 0. 8160. DISPLAY_IDENTIFIER N_MAX_SCDN_ERR_TMP[0] ECU_ADDRESS 0xd000266a FORMAT "%4.0" /end MEASUREMENT
/begin MEASUREMENT fmy_scdn_tmp[0].load_min_err "minimal load of similar conditions window for detected failure (1st)" UBYTE _CNV_A_R_LINEAR_____5_CM 1 100. 0. 99.609375 DISPLAY_IDENTIFIER LOAD_MIN_SCDN_ERR_TMP[0] ECU_ADDRESS 0xd000266c FORMAT "%9.6" /end MEASUREMENT
/begin MEASUREMENT fmy_scdn_tmp[0].load_max_err "maximal load of similar conditions window for detected failure (1st)" UBYTE _CNV_A_R_LINEAR_____5_CM 1 100. 0. 99.609375 DISPLAY_IDENTIFIER LOAD_MAX_SCDN_ERR_TMP[0] ECU_ADDRESS 0xd000266d FORMAT "%9.6" /end MEASUREMENT
/begin MEASUREMENT fmy_scdn_tmp[0].n_min_not_err "minimal engine speed of similar conditions window for non detected failure (3rd)" UWORD _CNV_A_R_LINEAR_____13_CM 1 100. 0. 8160. DISPLAY_IDENTIFIER N_MIN_SCDN_NOT_ERR_TMP[0] ECU_ADDRESS 0xd000266e FORMAT "%4.0" /end MEASUREMENT
/begin MEASUREMENT fmy_scdn_tmp[0].n_max_not_err "maximal engine speed of similar conditions window for non detected failure (3rd)" UWORD _CNV_A_R_LINEAR_____13_CM 1 100. 0. 8160. DISPLAY_IDENTIFIER N_MAX_SCDN_NOT_ERR_TMP[0] ECU_ADDRESS 0xd0002670 FORMAT "%4.0" /end MEASUREMENT
/begin MEASUREMENT fmy_scdn_tmp[0].load_min_not_err "minimal load of similar conditions window for non detected failure (3rd)" UBYTE _CNV_A_R_LINEAR_____5_CM 1 100. 0. 99.609375 DISPLAY_IDENTIFIER LOAD_MIN_SCDN_NOT_ERR_TMP[0] ECU_ADDRESS 0xd0002672 FORMAT "%9.6" /end MEASUREMENT
/begin MEASUREMENT fmy_scdn_tmp[0].load_max_not_err "maximal load of similar conditions window for non detected failure (3rd)" UBYTE _CNV_A_R_LINEAR_____5_CM 1 100. 0. 99.609375 DISPLAY_IDENTIFIER LOAD_MAX_SCDN_NOT_ERR_TMP[0] ECU_ADDRESS 0xd0002673 FORMAT "%9.6" /end MEASUREMENT
/begin MEASUREMENT fmy_scdn_tmp[1].n_min_err "minimal engine speed of similar conditions window for detected failure (1st)" UWORD _CNV_A_R_LINEAR_____13_CM 1 100. 0. 8160. DISPLAY_IDENTIFIER N_MIN_SCDN_ERR_TMP[1] ECU_ADDRESS 0xd0002674 FORMAT "%4.0" /end MEASUREMENT
/begin MEASUREMENT fmy_scdn_tmp[1].n_max_err "maximal engine speed of similar conditions window for detected failure (1st)" UWORD _CNV_A_R_LINEAR_____13_CM 1 100. 0. 8160. DISPLAY_IDENTIFIER N_MAX_SCDN_ERR_TMP[1] ECU_ADDRESS 0xd0002676 FORMAT "%4.0" /end MEASUREMENT
/begin MEASUREMENT fmy_scdn_tmp[1].load_min_err "minimal load of similar conditions window for detected failure (1st)" UBYTE _CNV_A_R_LINEAR_____5_CM 1 100. 0. 99.609375 DISPLAY_IDENTIFIER LOAD_MIN_SCDN_ERR_TMP[1] ECU_ADDRESS 0xd0002678 FORMAT "%9.6" /end MEASUREMENT
/begin MEASUREMENT fmy_scdn_tmp[1].load_max_err "maximal load of similar conditions window for detected failure (1st)" UBYTE _CNV_A_R_LINEAR_____5_CM 1 100. 0. 99.609375 DISPLAY_IDENTIFIER LOAD_MAX_SCDN_ERR_TMP[1] ECU_ADDRESS 0xd0002679 FORMAT "%9.6" /end MEASUREMENT
/begin MEASUREMENT fmy_scdn_tmp[1].n_min_not_err "minimal engine speed of similar conditions window for non detected failure (3rd)" UWORD _CNV_A_R_LINEAR_____13_CM 1 100. 0. 8160. DISPLAY_IDENTIFIER N_MIN_SCDN_NOT_ERR_TMP[1] ECU_ADDRESS 0xd000267a FORMAT "%4.0" /end MEASUREMENT
/begin MEASUREMENT fmy_scdn_tmp[1].n_max_not_err "maximal engine speed of similar conditions window for non detected failure (3rd)" UWORD _CNV_A_R_LINEAR_____13_CM 1 100. 0. 8160. DISPLAY_IDENTIFIER N_MAX_SCDN_NOT_ERR_TMP[1] ECU_ADDRESS 0xd000267c FORMAT "%4.0" /end MEASUREMENT
/begin MEASUREMENT fmy_scdn_tmp[1].load_min_not_err "minimal load of similar conditions window for non detected failure (3rd)" UBYTE _CNV_A_R_LINEAR_____5_CM 1 100. 0. 99.609375 DISPLAY_IDENTIFIER LOAD_MIN_SCDN_NOT_ERR_TMP[1] ECU_ADDRESS 0xd000267e FORMAT "%9.6" /end MEASUREMENT
/begin MEASUREMENT fmy_scdn_tmp[1].load_max_not_err "maximal load of similar conditions window for non detected failure (3rd)" UBYTE _CNV_A_R_LINEAR_____5_CM 1 100. 0. 99.609375 DISPLAY_IDENTIFIER LOAD_MAX_SCDN_NOT_ERR_TMP[1] ECU_ADDRESS 0xd000267f FORMAT "%9.6" /end MEASUREMENT
/begin MEASUREMENT fmy_scdn_tmp[2].n_min_err "minimal engine speed of similar conditions window for detected failure (1st)" UWORD _CNV_A_R_LINEAR_____13_CM 1 100. 0. 8160. DISPLAY_IDENTIFIER N_MIN_SCDN_ERR_TMP[2] ECU_ADDRESS 0xd0002680 FORMAT "%4.0" /end MEASUREMENT
/begin MEASUREMENT fmy_scdn_tmp[2].n_max_err "maximal engine speed of similar conditions window for detected failure (1st)" UWORD _CNV_A_R_LINEAR_____13_CM 1 100. 0. 8160. DISPLAY_IDENTIFIER N_MAX_SCDN_ERR_TMP[2] ECU_ADDRESS 0xd0002682 FORMAT "%4.0" /end MEASUREMENT
/begin MEASUREMENT fmy_scdn_tmp[2].load_min_err "minimal load of similar conditions window for detected failure (1st)" UBYTE _CNV_A_R_LINEAR_____5_CM 1 100. 0. 99.609375 DISPLAY_IDENTIFIER LOAD_MIN_SCDN_ERR_TMP[2] ECU_ADDRESS 0xd0002684 FORMAT "%9.6" /end MEASUREMENT
/begin MEASUREMENT fmy_scdn_tmp[2].load_max_err "maximal load of similar conditions window for detected failure (1st)" UBYTE _CNV_A_R_LINEAR_____5_CM 1 100. 0. 99.609375 DISPLAY_IDENTIFIER LOAD_MAX_SCDN_ERR_TMP[2] ECU_ADDRESS 0xd0002685 FORMAT "%9.6" /end MEASUREMENT
/begin MEASUREMENT fmy_scdn_tmp[2].n_min_not_err "minimal engine speed of similar conditions window for non detected failure (3rd)" UWORD _CNV_A_R_LINEAR_____13_CM 1 100. 0. 8160. DISPLAY_IDENTIFIER N_MIN_SCDN_NOT_ERR_TMP[2] ECU_ADDRESS 0xd0002686 FORMAT "%4.0" /end MEASUREMENT
/begin MEASUREMENT fmy_scdn_tmp[2].n_max_not_err "maximal engine speed of similar conditions window for non detected failure (3rd)" UWORD _CNV_A_R_LINEAR_____13_CM 1 100. 0. 8160. DISPLAY_IDENTIFIER N_MAX_SCDN_NOT_ERR_TMP[2] ECU_ADDRESS 0xd0002688 FORMAT "%4.0" /end MEASUREMENT
/begin MEASUREMENT fmy_scdn_tmp[2].load_min_not_err "minimal load of similar conditions window for non detected failure (3rd)" UBYTE _CNV_A_R_LINEAR_____5_CM 1 100. 0. 99.609375 DISPLAY_IDENTIFIER LOAD_MIN_SCDN_NOT_ERR_TMP[2] ECU_ADDRESS 0xd000268a FORMAT "%9.6" /end MEASUREMENT
/begin MEASUREMENT fmy_scdn_tmp[2].load_max_not_err "maximal load of similar conditions window for non detected failure (3rd)" UBYTE _CNV_A_R_LINEAR_____5_CM 1 100. 0. 99.609375 DISPLAY_IDENTIFIER LOAD_MAX_SCDN_NOT_ERR_TMP[2] ECU_ADDRESS 0xd000268b FORMAT "%9.6" /end MEASUREMENT
/begin MEASUREMENT fmy_scdn_tmp[3].n_min_err "minimal engine speed of similar conditions window for detected failure (1st)" UWORD _CNV_A_R_LINEAR_____13_CM 1 100. 0. 8160. DISPLAY_IDENTIFIER N_MIN_SCDN_ERR_TMP[3] ECU_ADDRESS 0xd000268c FORMAT "%4.0" /end MEASUREMENT
/begin MEASUREMENT fmy_scdn_tmp[3].n_max_err "maximal engine speed of similar conditions window for detected failure (1st)" UWORD _CNV_A_R_LINEAR_____13_CM 1 100. 0. 8160. DISPLAY_IDENTIFIER N_MAX_SCDN_ERR_TMP[3] ECU_ADDRESS 0xd000268e FORMAT "%4.0" /end MEASUREMENT
/begin MEASUREMENT fmy_scdn_tmp[3].load_min_err "minimal load of similar conditions window for detected failure (1st)" UBYTE _CNV_A_R_LINEAR_____5_CM 1 100. 0. 99.609375 DISPLAY_IDENTIFIER LOAD_MIN_SCDN_ERR_TMP[3] ECU_ADDRESS 0xd0002690 FORMAT "%9.6" /end MEASUREMENT
/begin MEASUREMENT fmy_scdn_tmp[3].load_max_err "maximal load of similar conditions window for detected failure (1st)" UBYTE _CNV_A_R_LINEAR_____5_CM 1 100. 0. 99.609375 DISPLAY_IDENTIFIER LOAD_MAX_SCDN_ERR_TMP[3] ECU_ADDRESS 0xd0002691 FORMAT "%9.6" /end MEASUREMENT
/begin MEASUREMENT fmy_scdn_tmp[3].n_min_not_err "minimal engine speed of similar conditions window for non detected failure (3rd)" UWORD _CNV_A_R_LINEAR_____13_CM 1 100. 0. 8160. DISPLAY_IDENTIFIER N_MIN_SCDN_NOT_ERR_TMP[3] ECU_ADDRESS 0xd0002692 FORMAT "%4.0" /end MEASUREMENT
/begin MEASUREMENT fmy_scdn_tmp[3].n_max_not_err "maximal engine speed of similar conditions window for non detected failure (3rd)" UWORD _CNV_A_R_LINEAR_____13_CM 1 100. 0. 8160. DISPLAY_IDENTIFIER N_MAX_SCDN_NOT_ERR_TMP[3] ECU_ADDRESS 0xd0002694 FORMAT "%4.0" /end MEASUREMENT
/begin MEASUREMENT fmy_scdn_tmp[3].load_min_not_err "minimal load of similar conditions window for non detected failure (3rd)" UBYTE _CNV_A_R_LINEAR_____5_CM 1 100. 0. 99.609375 DISPLAY_IDENTIFIER LOAD_MIN_SCDN_NOT_ERR_TMP[3] ECU_ADDRESS 0xd0002696 FORMAT "%9.6" /end MEASUREMENT
/begin MEASUREMENT fmy_scdn_tmp[3].load_max_not_err "maximal load of similar conditions window for non detected failure (3rd)" UBYTE _CNV_A_R_LINEAR_____5_CM 1 100. 0. 99.609375 DISPLAY_IDENTIFIER LOAD_MAX_SCDN_NOT_ERR_TMP[3] ECU_ADDRESS 0xd0002697 FORMAT "%9.6" /end MEASUREMENT
/begin MEASUREMENT load_scdn "Calculated load" UBYTE _CNV_A_R_LINEAR_____5_CM 1 100. 0. 99.609375 DISPLAY_IDENTIFIER LOAD_SCDN ECU_ADDRESS 0xd0002e70 FORMAT "%9.6" /end MEASUREMENT
/begin COMPU_METHOD _CNV_A_R_LINEAR_____0_CM "" RAT_FUNC "%6.3" "-" COEFFS 0 1. 0. 0 0 1 /end COMPU_METHOD
/begin COMPU_METHOD _CNV_S_2_RANGE__0___1_CM "" TAB_VERB "%6.3" "-" COMPU_TAB_REF _CNV_S_2_RANGE__0___1 /end COMPU_METHOD
/begin COMPU_VTAB _CNV_S_2_RANGE__0___1 "" TAB_VERB 2 0 "0" 1 "1" /end COMPU_VTAB
/begin COMPU_METHOD _CNV_A_R_LINEAR_____5_CM "" RAT_FUNC "%6.3" "%" COEFFS 0 2.56 0. 0 0 1 /end COMPU_METHOD
/begin COMPU_METHOD _CNV_A_R_LINEAR_____13_CM "" RAT_FUNC "%6.3" "rpm" COEFFS 0 1. 0. 0 0 1 /end COMPU_METHOD
/begin FUNCTION ERRM_Similar_Conditions_Appl_Inc "Similar_Conditions_Appl_Inc"
 /begin OUT_MEASUREMENT fmy_scdn_equ_mis_0.n_min fmy_scdn_equ_mis_0.n_max fmy_scdn_equ_mis_0.ctr_scdn_equ_dc fmy_scdn_equ_mis_0.scdn_info fmy_scdn_equ_mis_0.load_min fmy_scdn_equ_mis_0.load_max fmy_scdn_equ_mis_0.lv_wup_scdn_equ fmy_scdn_equ_mis_1.n_min fmy_scdn_equ_mis_1.n_max fmy_scdn_equ_mis_1.ctr_scdn_equ_dc fmy_scdn_equ_mis_1.scdn_info fmy_scdn_equ_mis_1.load_min fmy_scdn_equ_mis_1.load_max fmy_scdn_equ_mis_1.lv_wup_scdn_equ fmy_scdn_equ_mis_2.n_min fmy_scdn_equ_mis_2.n_max fmy_scdn_equ_mis_2.ctr_scdn_equ_dc fmy_scdn_equ_mis_2.scdn_info fmy_scdn_equ_mis_2.load_min fmy_scdn_equ_mis_2.load_max fmy_scdn_equ_mis_2.lv_wup_scdn_equ fmy_scdn_equ_fsd_1.n_min fmy_scdn_equ_fsd_1.n_max fmy_scdn_equ_fsd_1.ctr_scdn_equ_dc fmy_scdn_equ_fsd_1.scdn_info fmy_scdn_equ_fsd_1.load_min fmy_scdn_equ_fsd_1.load_max fmy_scdn_equ_fsd_1.lv_wup_scdn_equ fmy_scdn_equ_fsd_2.n_min fmy_scdn_equ_fsd_2.n_max fmy_scdn_equ_fsd_2.ctr_scdn_equ_dc fmy_scdn_equ_fsd_2.scdn_info fmy_scdn_equ_fsd_2.load_min fmy_scdn_equ_fsd_2.load_max fmy_scdn_equ_fsd_2.lv_wup_scdn_equ fmy_scdn_equ_mis_3.n_min fmy_scdn_equ_mis_3.n_max fmy_scdn_equ_mis_3.ctr_scdn_equ_dc fmy_scdn_equ_mis_3.scdn_info fmy_scdn_equ_mis_3.load_min fmy_scdn_equ_mis_3.load_max fmy_scdn_equ_mis_3.lv_wup_scdn_equ fmy_scdn_equ_mis_4.n_min fmy_scdn_equ_mis_4.n_max fmy_scdn_equ_mis_4.ctr_scdn_equ_dc fmy_scdn_equ_mis_4.scdn_info fmy_scdn_equ_mis_4.load_min fmy_scdn_equ_mis_4.load_max fmy_scdn_equ_mis_4.lv_wup_scdn_equ fmy_scdn_equ_mis_5.n_min fmy_scdn_equ_mis_5.n_max fmy_scdn_equ_mis_5.ctr_scdn_equ_dc fmy_scdn_equ_mis_5.scdn_info fmy_scdn_equ_mis_5.load_min fmy_scdn_equ_mis_5.load_max fmy_scdn_equ_mis_5.lv_wup_scdn_equ fmy_scdn_tmp[0].n_min_err fmy_scdn_tmp[0].n_max_err fmy_scdn_tmp[0].load_min_err fmy_scdn_tmp[0].load_max_err fmy_scdn_tmp[0].n_min_not_err fmy_scdn_tmp[0].n_max_not_err fmy_scdn_tmp[0].load_min_not_err fmy_scdn_tmp[0].load_max_not_err fmy_scdn_tmp[1].n_min_err fmy_scdn_tmp[1].n_max_err fmy_scdn_tmp[1].load_min_err fmy_scdn_tmp[1].load_max_err fmy_scdn_tmp[1].n_min_not_err fmy_scdn_tmp[1].n_max_not_err fmy_scdn_tmp[1].load_min_not_err fmy_scdn_tmp[1].load_max_not_err fmy_scdn_tmp[2].n_min_err fmy_scdn_tmp[2].n_max_err fmy_scdn_tmp[2].load_min_err fmy_scdn_tmp[2].load_max_err fmy_scdn_tmp[2].n_min_not_err fmy_scdn_tmp[2].n_max_not_err fmy_scdn_tmp[2].load_min_not_err fmy_scdn_tmp[2].load_max_not_err fmy_scdn_tmp[3].n_min_err fmy_scdn_tmp[3].n_max_err fmy_scdn_tmp[3].load_min_err fmy_scdn_tmp[3].load_max_err fmy_scdn_tmp[3].n_min_not_err fmy_scdn_tmp[3].n_max_not_err fmy_scdn_tmp[3].load_min_not_err fmy_scdn_tmp[3].load_max_not_err load_scdn /end OUT_MEASUREMENT
/end FUNCTION
/begin FUNCTION ERRM_Environmental_data_Appl_Inc "Environmental_Data_Appl_Inc"
 /begin OUT_MEASUREMENT tbl_frf[0].envd_obd[0] tbl_frf[0].envd_obd[1] tbl_frf[0].envd_obd[2] tbl_frf[0].envd_obd[3] tbl_frf[0].envd_obd[4] tbl_frf[0].envd_obd[5] tbl_frf[0].envd_obd[6] tbl_frf[0].envd_obd[7] tbl_frf[0].envd_obd[8] tbl_frf[0].envd_obd[9] tbl_frf[0].envd_obd[10] tbl_frf[0].envd_obd[11] tbl_frf[0].envd_obd[12] tbl_frf[0].envd_obd[13] tbl_frf[0].envd_obd[14] tbl_frf[0].envd_obd[15] tbl_frf[0].envd_obd[16] tbl_frf[0].envd_obd[17] tbl_frf[0].envd_obd[18] tbl_frf[0].envd_obd[19] tbl_frf[0].envd_obd[20] tbl_frf[0].envd_obd[21] tbl_frf[0].envd_obd[22] tbl_frf[0].envd_obd[23] tbl_frf[0].envd_obd[24] tbl_frf[0].envd_obd[25] tbl_frf[0].envd_obd[26] tbl_frf[0].envd_obd[27] tbl_frf[0].envd_obd[28] tbl_frf[0].envd_obd[29] tbl_frf[0].envd_obd[30] tbl_frf[0].envd_obd[31] tbl_frf[0].envd_obd[32] tbl_frf[0].envd_obd[33] tbl_frf[0].envd_obd[34] tbl_frf[0].envd_cus_cmn[0] tbl_frf[0].envd_cus_set_cmn[0][0] tbl_frf[0].envd_cus_set_cmn[0][1] tbl_frf[0].envd_cus_set_cmn[0][2] tbl_frf[0].envd_cus_set_cmn[1][0] tbl_frf[0].envd_cus_set_cmn[1][1] tbl_frf[0].envd_cus_set_cmn[1][2] tbl_frf[0].envd_cus_set_cmn[2][0] tbl_frf[0].envd_cus_set_cmn[2][1] tbl_frf[0].envd_cus_set_cmn[2][2] tbl_frf[0].envd_cus_set_spc[0][0] tbl_frf[0].envd_cus_set_spc[0][1] tbl_frf[0].envd_cus_set_spc[0][2] tbl_frf[0].envd_cus_set_spc[0][3] tbl_frf[0].envd_cus_set_spc[1][0] tbl_frf[0].envd_cus_set_spc[1][1] tbl_frf[0].envd_cus_set_spc[1][2] tbl_frf[0].envd_cus_set_spc[1][3] tbl_frf[0].envd_cus_set_spc[2][0] tbl_frf[0].envd_cus_set_spc[2][1] tbl_frf[0].envd_cus_set_spc[2][2] tbl_frf[0].envd_cus_set_spc[2][3] tbl_frf[1].envd_obd[0] tbl_frf[1].envd_obd[1] tbl_frf[1].envd_obd[2] tbl_frf[1].envd_obd[3] tbl_frf[1].envd_obd[4] tbl_frf[1].envd_obd[5] tbl_frf[1].envd_obd[6] tbl_frf[1].envd_obd[7] tbl_frf[1].envd_obd[8] tbl_frf[1].envd_obd[9] tbl_frf[1].envd_obd[10] tbl_frf[1].envd_obd[11] tbl_frf[1].envd_obd[12] tbl_frf[1].envd_obd[13] tbl_frf[1].envd_obd[14] tbl_frf[1].envd_obd[15] tbl_frf[1].envd_obd[16] tbl_frf[1].envd_obd[17] tbl_frf[1].envd_obd[18] tbl_frf[1].envd_obd[19] tbl_frf[1].envd_obd[20] tbl_frf[1].envd_obd[21] tbl_frf[1].envd_obd[22] tbl_frf[1].envd_obd[23] tbl_frf[1].envd_obd[24] tbl_frf[1].envd_obd[25] tbl_frf[1].envd_obd[26] tbl_frf[1].envd_obd[27] tbl_frf[1].envd_obd[28] tbl_frf[1].envd_obd[29] tbl_frf[1].envd_obd[30] tbl_frf[1].envd_obd[31] tbl_frf[1].envd_obd[32] tbl_frf[1].envd_obd[33] tbl_frf[1].envd_obd[34] tbl_frf[1].envd_cus_cmn[0] tbl_frf[1].envd_cus_set_cmn[0][0] tbl_frf[1].envd_cus_set_cmn[0][1] tbl_frf[1].envd_cus_set_cmn[0][2] tbl_frf[1].envd_cus_set_cmn[1][0] tbl_frf[1].envd_cus_set_cmn[1][1] tbl_frf[1].envd_cus_set_cmn[1][2] tbl_frf[1].envd_cus_set_cmn[2][0] tbl_frf[1].envd_cus_set_cmn[2][1] tbl_frf[1].envd_cus_set_cmn[2][2] tbl_frf[1].envd_cus_set_spc[0][0] tbl_frf[1].envd_cus_set_spc[0][1] tbl_frf[1].envd_cus_set_spc[0][2] tbl_frf[1].envd_cus_set_spc[0][3] tbl_frf[1].envd_cus_set_spc[1][0] tbl_frf[1].envd_cus_set_spc[1][1] tbl_frf[1].envd_cus_set_spc[1][2] tbl_frf[1].envd_cus_set_spc[1][3] tbl_frf[1].envd_cus_set_spc[2][0] tbl_frf[1].envd_cus_set_spc[2][1] tbl_frf[1].envd_cus_set_spc[2][2] tbl_frf[1].envd_cus_set_spc[2][3] tbl_frf[2].envd_obd[0] tbl_frf[2].envd_obd[1] tbl_frf[2].envd_obd[2] tbl_frf[2].envd_obd[3] tbl_frf[2].envd_obd[4] tbl_frf[2].envd_obd[5] tbl_frf[2].envd_obd[6] tbl_frf[2].envd_obd[7] tbl_frf[2].envd_obd[8] tbl_frf[2].envd_obd[9] tbl_frf[2].envd_obd[10] tbl_frf[2].envd_obd[11] tbl_frf[2].envd_obd[12] tbl_frf[2].envd_obd[13] tbl_frf[2].envd_obd[14] tbl_frf[2].envd_obd[15] tbl_frf[2].envd_obd[16] tbl_frf[2].envd_obd[17] tbl_frf[2].envd_obd[18] tbl_frf[2].envd_obd[19] tbl_frf[2].envd_obd[20] tbl_frf[2].envd_obd[21] tbl_frf[2].envd_obd[22] tbl_frf[2].envd_obd[23] tbl_frf[2].envd_obd[24] tbl_frf[2].envd_obd[25] tbl_frf[2].envd_obd[26] tbl_frf[2].envd_obd[27] tbl_frf[2].envd_obd[28] tbl_frf[2].envd_obd[29] tbl_frf[2].envd_obd[30] tbl_frf[2].envd_obd[31] tbl_frf[2].envd_obd[32] tbl_frf[2].envd_obd[33] tbl_frf[2].envd_obd[34] tbl_frf[2].envd_cus_cmn[0] tbl_frf[2].envd_cus_set_cmn[0][0] tbl_frf[2].envd_cus_set_cmn[0][1] tbl_frf[2].envd_cus_set_cmn[0][2] tbl_frf[2].envd_cus_set_cmn[1][0] tbl_frf[2].envd_cus_set_cmn[1][1] tbl_frf[2].envd_cus_set_cmn[1][2] tbl_frf[2].envd_cus_set_cmn[2][0] tbl_frf[2].envd_cus_set_cmn[2][1] tbl_frf[2].envd_cus_set_cmn[2][2] tbl_frf[2].envd_cus_set_spc[0][0] tbl_frf[2].envd_cus_set_spc[0][1] tbl_frf[2].envd_cus_set_spc[0][2] tbl_frf[2].envd_cus_set_spc[0][3] tbl_frf[2].envd_cus_set_spc[1][0] tbl_frf[2].envd_cus_set_spc[1][1] tbl_frf[2].envd_cus_set_spc[1][2] tbl_frf[2].envd_cus_set_spc[1][3] tbl_frf[2].envd_cus_set_spc[2][0] tbl_frf[2].envd_cus_set_spc[2][1] tbl_frf[2].envd_cus_set_spc[2][2] tbl_frf[2].envd_cus_set_spc[2][3] tbl_frf[3].envd_obd[0] tbl_frf[3].envd_obd[1] tbl_frf[3].envd_obd[2] tbl_frf[3].envd_obd[3] tbl_frf[3].envd_obd[4] tbl_frf[3].envd_obd[5] tbl_frf[3].envd_obd[6] tbl_frf[3].envd_obd[7] tbl_frf[3].envd_obd[8] tbl_frf[3].envd_obd[9] tbl_frf[3].envd_obd[10] tbl_frf[3].envd_obd[11] tbl_frf[3].envd_obd[12] tbl_frf[3].envd_obd[13] tbl_frf[3].envd_obd[14] tbl_frf[3].envd_obd[15] tbl_frf[3].envd_obd[16] tbl_frf[3].envd_obd[17] tbl_frf[3].envd_obd[18] tbl_frf[3].envd_obd[19] tbl_frf[3].envd_obd[20] tbl_frf[3].envd_obd[21] tbl_frf[3].envd_obd[22] tbl_frf[3].envd_obd[23] tbl_frf[3].envd_obd[24] tbl_frf[3].envd_obd[25] tbl_frf[3].envd_obd[26] tbl_frf[3].envd_obd[27] tbl_frf[3].envd_obd[28] tbl_frf[3].envd_obd[29] tbl_frf[3].envd_obd[30] tbl_frf[3].envd_obd[31] tbl_frf[3].envd_obd[32] tbl_frf[3].envd_obd[33] tbl_frf[3].envd_obd[34] tbl_frf[3].envd_cus_cmn[0] tbl_frf[3].envd_cus_set_cmn[0][0] tbl_frf[3].envd_cus_set_cmn[0][1] tbl_frf[3].envd_cus_set_cmn[0][2] tbl_frf[3].envd_cus_set_cmn[1][0] tbl_frf[3].envd_cus_set_cmn[1][1] tbl_frf[3].envd_cus_set_cmn[1][2] tbl_frf[3].envd_cus_set_cmn[2][0] tbl_frf[3].envd_cus_set_cmn[2][1] tbl_frf[3].envd_cus_set_cmn[2][2] tbl_frf[3].envd_cus_set_spc[0][0] tbl_frf[3].envd_cus_set_spc[0][1] tbl_frf[3].envd_cus_set_spc[0][2] tbl_frf[3].envd_cus_set_spc[0][3] tbl_frf[3].envd_cus_set_spc[1][0] tbl_frf[3].envd_cus_set_spc[1][1] tbl_frf[3].envd_cus_set_spc[1][2] tbl_frf[3].envd_cus_set_spc[1][3] tbl_frf[3].envd_cus_set_spc[2][0] tbl_frf[3].envd_cus_set_spc[2][1] tbl_frf[3].envd_cus_set_spc[2][2] tbl_frf[3].envd_cus_set_spc[2][3] tbl_frf[4].envd_obd[0] tbl_frf[4].envd_obd[1] tbl_frf[4].envd_obd[2] tbl_frf[4].envd_obd[3] tbl_frf[4].envd_obd[4] tbl_frf[4].envd_obd[5] tbl_frf[4].envd_obd[6] tbl_frf[4].envd_obd[7] tbl_frf[4].envd_obd[8] tbl_frf[4].envd_obd[9] tbl_frf[4].envd_obd[10] tbl_frf[4].envd_obd[11] tbl_frf[4].envd_obd[12] tbl_frf[4].envd_obd[13] tbl_frf[4].envd_obd[14] tbl_frf[4].envd_obd[15] tbl_frf[4].envd_obd[16] tbl_frf[4].envd_obd[17] tbl_frf[4].envd_obd[18] tbl_frf[4].envd_obd[19] tbl_frf[4].envd_obd[20] tbl_frf[4].envd_obd[21] tbl_frf[4].envd_obd[22] tbl_frf[4].envd_obd[23] tbl_frf[4].envd_obd[24] tbl_frf[4].envd_obd[25] tbl_frf[4].envd_obd[26] tbl_frf[4].envd_obd[27] tbl_frf[4].envd_obd[28] tbl_frf[4].envd_obd[29] tbl_frf[4].envd_obd[30] tbl_frf[4].envd_obd[31] tbl_frf[4].envd_obd[32] tbl_frf[4].envd_obd[33] tbl_frf[4].envd_obd[34] tbl_frf[4].envd_cus_cmn[0] tbl_frf[4].envd_cus_set_cmn[0][0] tbl_frf[4].envd_cus_set_cmn[0][1] tbl_frf[4].envd_cus_set_cmn[0][2] tbl_frf[4].envd_cus_set_cmn[1][0] tbl_frf[4].envd_cus_set_cmn[1][1] tbl_frf[4].envd_cus_set_cmn[1][2] tbl_frf[4].envd_cus_set_cmn[2][0] tbl_frf[4].envd_cus_set_cmn[2][1] tbl_frf[4].envd_cus_set_cmn[2][2] tbl_frf[4].envd_cus_set_spc[0][0] tbl_frf[4].envd_cus_set_spc[0][1] tbl_frf[4].envd_cus_set_spc[0][2] tbl_frf[4].envd_cus_set_spc[0][3] tbl_frf[4].envd_cus_set_spc[1][0] tbl_frf[4].envd_cus_set_spc[1][1] tbl_frf[4].envd_cus_set_spc[1][2] tbl_frf[4].envd_cus_set_spc[1][3] tbl_frf[4].envd_cus_set_spc[2][0] tbl_frf[4].envd_cus_set_spc[2][1] tbl_frf[4].envd_cus_set_spc[2][2] tbl_frf[4].envd_cus_set_spc[2][3] tbl_frf[5].envd_obd[0] tbl_frf[5].envd_obd[1] tbl_frf[5].envd_obd[2] tbl_frf[5].envd_obd[3] tbl_frf[5].envd_obd[4] tbl_frf[5].envd_obd[5] tbl_frf[5].envd_obd[6] tbl_frf[5].envd_obd[7] tbl_frf[5].envd_obd[8] tbl_frf[5].envd_obd[9] tbl_frf[5].envd_obd[10] tbl_frf[5].envd_obd[11] tbl_frf[5].envd_obd[12] tbl_frf[5].envd_obd[13] tbl_frf[5].envd_obd[14] tbl_frf[5].envd_obd[15] tbl_frf[5].envd_obd[16] tbl_frf[5].envd_obd[17] tbl_frf[5].envd_obd[18] tbl_frf[5].envd_obd[19] tbl_frf[5].envd_obd[20] tbl_frf[5].envd_obd[21] tbl_frf[5].envd_obd[22] tbl_frf[5].envd_obd[23] tbl_frf[5].envd_obd[24] tbl_frf[5].envd_obd[25] tbl_frf[5].envd_obd[26] tbl_frf[5].envd_obd[27] tbl_frf[5].envd_obd[28] tbl_frf[5].envd_obd[29] tbl_frf[5].envd_obd[30] tbl_frf[5].envd_obd[31] tbl_frf[5].envd_obd[32] tbl_frf[5].envd_obd[33] tbl_frf[5].envd_obd[34] tbl_frf[5].envd_cus_cmn[0] tbl_frf[5].envd_cus_set_cmn[0][0] tbl_frf[5].envd_cus_set_cmn[0][1] tbl_frf[5].envd_cus_set_cmn[0][2] tbl_frf[5].envd_cus_set_cmn[1][0] tbl_frf[5].envd_cus_set_cmn[1][1] tbl_frf[5].envd_cus_set_cmn[1][2] tbl_frf[5].envd_cus_set_cmn[2][0] tbl_frf[5].envd_cus_set_cmn[2][1] tbl_frf[5].envd_cus_set_cmn[2][2] tbl_frf[5].envd_cus_set_spc[0][0] tbl_frf[5].envd_cus_set_spc[0][1] tbl_frf[5].envd_cus_set_spc[0][2] tbl_frf[5].envd_cus_set_spc[0][3] tbl_frf[5].envd_cus_set_spc[1][0] tbl_frf[5].envd_cus_set_spc[1][1] tbl_frf[5].envd_cus_set_spc[1][2] tbl_frf[5].envd_cus_set_spc[1][3] tbl_frf[5].envd_cus_set_spc[2][0] tbl_frf[5].envd_cus_set_spc[2][1] tbl_frf[5].envd_cus_set_spc[2][2] tbl_frf[5].envd_cus_set_spc[2][3] tbl_frf[6].envd_obd[0] tbl_frf[6].envd_obd[1] tbl_frf[6].envd_obd[2] tbl_frf[6].envd_obd[3] tbl_frf[6].envd_obd[4] tbl_frf[6].envd_obd[5] tbl_frf[6].envd_obd[6] tbl_frf[6].envd_obd[7] tbl_frf[6].envd_obd[8] tbl_frf[6].envd_obd[9] tbl_frf[6].envd_obd[10] tbl_frf[6].envd_obd[11] tbl_frf[6].envd_obd[12] tbl_frf[6].envd_obd[13] tbl_frf[6].envd_obd[14] tbl_frf[6].envd_obd[15] tbl_frf[6].envd_obd[16] tbl_frf[6].envd_obd[17] tbl_frf[6].envd_obd[18] tbl_frf[6].envd_obd[19] tbl_frf[6].envd_obd[20] tbl_frf[6].envd_obd[21] tbl_frf[6].envd_obd[22] tbl_frf[6].envd_obd[23] tbl_frf[6].envd_obd[24] tbl_frf[6].envd_obd[25] tbl_frf[6].envd_obd[26] tbl_frf[6].envd_obd[27] tbl_frf[6].envd_obd[28] tbl_frf[6].envd_obd[29] tbl_frf[6].envd_obd[30] tbl_frf[6].envd_obd[31] tbl_frf[6].envd_obd[32] tbl_frf[6].envd_obd[33] tbl_frf[6].envd_obd[34] tbl_frf[6].envd_cus_cmn[0] tbl_frf[6].envd_cus_set_cmn[0][0] tbl_frf[6].envd_cus_set_cmn[0][1] tbl_frf[6].envd_cus_set_cmn[0][2] tbl_frf[6].envd_cus_set_cmn[1][0] tbl_frf[6].envd_cus_set_cmn[1][1] tbl_frf[6].envd_cus_set_cmn[1][2] tbl_frf[6].envd_cus_set_cmn[2][0] tbl_frf[6].envd_cus_set_cmn[2][1] tbl_frf[6].envd_cus_set_cmn[2][2] tbl_frf[6].envd_cus_set_spc[0][0] tbl_frf[6].envd_cus_set_spc[0][1] tbl_frf[6].envd_cus_set_spc[0][2] tbl_frf[6].envd_cus_set_spc[0][3] tbl_frf[6].envd_cus_set_spc[1][0] tbl_frf[6].envd_cus_set_spc[1][1] tbl_frf[6].envd_cus_set_spc[1][2] tbl_frf[6].envd_cus_set_spc[1][3] tbl_frf[6].envd_cus_set_spc[2][0] tbl_frf[6].envd_cus_set_spc[2][1] tbl_frf[6].envd_cus_set_spc[2][2] tbl_frf[6].envd_cus_set_spc[2][3] tbl_frf[7].envd_obd[0] tbl_frf[7].envd_obd[1] tbl_frf[7].envd_obd[2] tbl_frf[7].envd_obd[3] tbl_frf[7].envd_obd[4] tbl_frf[7].envd_obd[5] tbl_frf[7].envd_obd[6] tbl_frf[7].envd_obd[7] tbl_frf[7].envd_obd[8] tbl_frf[7].envd_obd[9] tbl_frf[7].envd_obd[10] tbl_frf[7].envd_obd[11] tbl_frf[7].envd_obd[12] tbl_frf[7].envd_obd[13] tbl_frf[7].envd_obd[14] tbl_frf[7].envd_obd[15] tbl_frf[7].envd_obd[16] tbl_frf[7].envd_obd[17] tbl_frf[7].envd_obd[18] tbl_frf[7].envd_obd[19] tbl_frf[7].envd_obd[20] tbl_frf[7].envd_obd[21] tbl_frf[7].envd_obd[22] tbl_frf[7].envd_obd[23] tbl_frf[7].envd_obd[24] tbl_frf[7].envd_obd[25] tbl_frf[7].envd_obd[26] tbl_frf[7].envd_obd[27] tbl_frf[7].envd_obd[28] tbl_frf[7].envd_obd[29] tbl_frf[7].envd_obd[30] tbl_frf[7].envd_obd[31] tbl_frf[7].envd_obd[32] tbl_frf[7].envd_obd[33] tbl_frf[7].envd_obd[34] tbl_frf[7].envd_cus_cmn[0] tbl_frf[7].envd_cus_set_cmn[0][0] tbl_frf[7].envd_cus_set_cmn[0][1] tbl_frf[7].envd_cus_set_cmn[0][2] tbl_frf[7].envd_cus_set_cmn[1][0] tbl_frf[7].envd_cus_set_cmn[1][1] tbl_frf[7].envd_cus_set_cmn[1][2] tbl_frf[7].envd_cus_set_cmn[2][0] tbl_frf[7].envd_cus_set_cmn[2][1] tbl_frf[7].envd_cus_set_cmn[2][2] tbl_frf[7].envd_cus_set_spc[0][0] tbl_frf[7].envd_cus_set_spc[0][1] tbl_frf[7].envd_cus_set_spc[0][2] tbl_frf[7].envd_cus_set_spc[0][3] tbl_frf[7].envd_cus_set_spc[1][0] tbl_frf[7].envd_cus_set_spc[1][1] tbl_frf[7].envd_cus_set_spc[1][2] tbl_frf[7].envd_cus_set_spc[1][3] tbl_frf[7].envd_cus_set_spc[2][0] tbl_frf[7].envd_cus_set_spc[2][1] tbl_frf[7].envd_cus_set_spc[2][2] tbl_frf[7].envd_cus_set_spc[2][3] tbl_frf[8].envd_obd[0] tbl_frf[8].envd_obd[1] tbl_frf[8].envd_obd[2] tbl_frf[8].envd_obd[3] tbl_frf[8].envd_obd[4] tbl_frf[8].envd_obd[5] tbl_frf[8].envd_obd[6] tbl_frf[8].envd_obd[7] tbl_frf[8].envd_obd[8] tbl_frf[8].envd_obd[9] tbl_frf[8].envd_obd[10] tbl_frf[8].envd_obd[11] tbl_frf[8].envd_obd[12] tbl_frf[8].envd_obd[13] tbl_frf[8].envd_obd[14] tbl_frf[8].envd_obd[15] tbl_frf[8].envd_obd[16] tbl_frf[8].envd_obd[17] tbl_frf[8].envd_obd[18] tbl_frf[8].envd_obd[19] tbl_frf[8].envd_obd[20] tbl_frf[8].envd_obd[21] tbl_frf[8].envd_obd[22] tbl_frf[8].envd_obd[23] tbl_frf[8].envd_obd[24] tbl_frf[8].envd_obd[25] tbl_frf[8].envd_obd[26] tbl_frf[8].envd_obd[27] tbl_frf[8].envd_obd[28] tbl_frf[8].envd_obd[29] tbl_frf[8].envd_obd[30] tbl_frf[8].envd_obd[31] tbl_frf[8].envd_obd[32] tbl_frf[8].envd_obd[33] tbl_frf[8].envd_obd[34] tbl_frf[8].envd_cus_cmn[0] tbl_frf[8].envd_cus_set_cmn[0][0] tbl_frf[8].envd_cus_set_cmn[0][1] tbl_frf[8].envd_cus_set_cmn[0][2] tbl_frf[8].envd_cus_set_cmn[1][0] tbl_frf[8].envd_cus_set_cmn[1][1] tbl_frf[8].envd_cus_set_cmn[1][2] tbl_frf[8].envd_cus_set_cmn[2][0] tbl_frf[8].envd_cus_set_cmn[2][1] tbl_frf[8].envd_cus_set_cmn[2][2] tbl_frf[8].envd_cus_set_spc[0][0] tbl_frf[8].envd_cus_set_spc[0][1] tbl_frf[8].envd_cus_set_spc[0][2] tbl_frf[8].envd_cus_set_spc[0][3] tbl_frf[8].envd_cus_set_spc[1][0] tbl_frf[8].envd_cus_set_spc[1][1] tbl_frf[8].envd_cus_set_spc[1][2] tbl_frf[8].envd_cus_set_spc[1][3] tbl_frf[8].envd_cus_set_spc[2][0] tbl_frf[8].envd_cus_set_spc[2][1] tbl_frf[8].envd_cus_set_spc[2][2] tbl_frf[8].envd_cus_set_spc[2][3] tbl_frf[9].envd_obd[0] tbl_frf[9].envd_obd[1] tbl_frf[9].envd_obd[2] tbl_frf[9].envd_obd[3] tbl_frf[9].envd_obd[4] tbl_frf[9].envd_obd[5] tbl_frf[9].envd_obd[6] tbl_frf[9].envd_obd[7] tbl_frf[9].envd_obd[8] tbl_frf[9].envd_obd[9] tbl_frf[9].envd_obd[10] tbl_frf[9].envd_obd[11] tbl_frf[9].envd_obd[12] tbl_frf[9].envd_obd[13] tbl_frf[9].envd_obd[14] tbl_frf[9].envd_obd[15] tbl_frf[9].envd_obd[16] tbl_frf[9].envd_obd[17] tbl_frf[9].envd_obd[18] tbl_frf[9].envd_obd[19] tbl_frf[9].envd_obd[20] tbl_frf[9].envd_obd[21] tbl_frf[9].envd_obd[22] tbl_frf[9].envd_obd[23] tbl_frf[9].envd_obd[24] tbl_frf[9].envd_obd[25] tbl_frf[9].envd_obd[26] tbl_frf[9].envd_obd[27] tbl_frf[9].envd_obd[28] tbl_frf[9].envd_obd[29] tbl_frf[9].envd_obd[30] tbl_frf[9].envd_obd[31] tbl_frf[9].envd_obd[32] tbl_frf[9].envd_obd[33] tbl_frf[9].envd_obd[34] tbl_frf[9].envd_cus_cmn[0] tbl_frf[9].envd_cus_set_cmn[0][0] tbl_frf[9].envd_cus_set_cmn[0][1] tbl_frf[9].envd_cus_set_cmn[0][2] tbl_frf[9].envd_cus_set_cmn[1][0] tbl_frf[9].envd_cus_set_cmn[1][1] tbl_frf[9].envd_cus_set_cmn[1][2] tbl_frf[9].envd_cus_set_cmn[2][0] tbl_frf[9].envd_cus_set_cmn[2][1] tbl_frf[9].envd_cus_set_cmn[2][2] tbl_frf[9].envd_cus_set_spc[0][0] tbl_frf[9].envd_cus_set_spc[0][1] tbl_frf[9].envd_cus_set_spc[0][2] tbl_frf[9].envd_cus_set_spc[0][3] tbl_frf[9].envd_cus_set_spc[1][0] tbl_frf[9].envd_cus_set_spc[1][1] tbl_frf[9].envd_cus_set_spc[1][2] tbl_frf[9].envd_cus_set_spc[1][3] tbl_frf[9].envd_cus_set_spc[2][0] tbl_frf[9].envd_cus_set_spc[2][1] tbl_frf[9].envd_cus_set_spc[2][2] tbl_frf[9].envd_cus_set_spc[2][3] /end OUT_MEASUREMENT
/end FUNCTION
/end MODULE
/end PROJECT
