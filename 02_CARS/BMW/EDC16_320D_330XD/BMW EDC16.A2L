ASAP2_VERSION 1 3
/begin PROJECT P383 "BMW DDE6.3 8-Zylinder V9E.3 11.10.2004 CAN12H"
/begin HEADER "" VERSION "V9E.3_8Z_CAN12H" PROJECT_NO P383 /end HEADER
/begin MODULE DIM ""
/begin MOD_COMMON "" BYTE_ORDER MSB_FIRST ALIGNMENT_BYTE 1 ALIGNMENT_WORD 2 ALIGNMENT_LONG 4 ALIGNMENT_FLOAT32_IEEE 4 /end MOD_COMMON
/begin MEASUREMENT Dfp_ACCDSwtin_mp "Messpunkt fuer Fehlerpfad  Dfp_ACCDSwtin" UWORD OneToOne 1 100 0.00 65535.00 FORMAT "%8.2" ECU_ADDRESS 0x8FD680 /end MEASUREMENT
/begin MEASUREMENT Dfp_AccPedPlausBrk_mp "Fehlerpfad für Unplausibilität AccPed-Brk" UWORD OneToOne 1 100 0.00 65535.00 FORMAT "%8.2" ECU_ADDRESS 0x8FD682 /end MEASUREMENT
/begin MEASUREMENT Dfp_ACC_PlausTrqDes_mp "Bremse ist ACC_PlausTrqTmrDead_C [s] getreten & ACC fordert noch immer Moment." UWORD OneToOne 1 100 0.00 65535.00 FORMAT "%8.2" ECU_ADDRESS 0x8FD684 /end MEASUREMENT
/begin MEASUREMENT Dfp_ACC_trqInr_mp "Too much Torque ACC" UWORD OneToOne 1 100 0.00 65535.00 FORMAT "%8.2" ECU_ADDRESS 0x8FD686 /end MEASUREMENT
/begin MEASUREMENT Dfp_ACTrq_mp "Messpunkt fuer Fehlerpfad  Dfp_ACTrq" UWORD OneToOne 1 100 0.00 65535.00 FORMAT "%8.2" ECU_ADDRESS 0x8FD688 /end MEASUREMENT
/begin MEASUREMENT Dfp_ADCMon_mp "Messpunkt fuer Fehlerpfad  Dfp_ADCMon" UWORD OneToOne 1 100 0.00 65535.00 FORMAT "%8.2" ECU_ADDRESS 0x8FD68A /end MEASUREMENT
/begin MEASUREMENT Dfp_AddPCDTnkLvl_mp "Fehlerpfad des Additiv-Tankleerschalters" UWORD OneToOne 1 100 0.00 65535.00 FORMAT "%8.2" ECU_ADDRESS 0x8FD68C /end MEASUREMENT
/begin MEASUREMENT Dfp_AFSCDIdlAdjVal_mp "Messpunkt fuer Fehlerpfad  Dfp_AFSCDIdlAdjVal" UWORD OneToOne 1 100 0.00 65535.00 FORMAT "%8.2" ECU_ADDRESS 0x8FD68E /end MEASUREMENT
/begin MEASUREMENT Dfp_AFSCDLdAdjVal_mp "Messpunkt fuer Fehlerpfad  Dfp_AFSCDLdAdjVal" UWORD OneToOne 1 100 0.00 65535.00 FORMAT "%8.2" ECU_ADDRESS 0x8FD690 /end MEASUREMENT
/begin MEASUREMENT Dfp_AFSCDPlAirPerCylDif_mp "Messpunkt fuer Fehlerpfad  Dfp_AFSCDPlAirPerCylDif" UWORD OneToOne 1 100 0.00 65535.00 FORMAT "%8.2" ECU_ADDRESS 0x8FD692 /end MEASUREMENT
/begin MEASUREMENT Dfp_AFSCD_AirTempDcyc2_mp "Messpunkt fuer Fehlerpfad  Dfp_AFSCD_AirTempDcyc2" UWORD OneToOne 1 100 0.00 65535.00 FORMAT "%8.2" ECU_ADDRESS 0x8FD694 /end MEASUREMENT
/begin MEASUREMENT Dfp_AFSCD_AirTempDcyc_mp "Messpunkt fuer Fehlerpfad  Dfp_AFSCD_AirTempDcyc" UWORD OneToOne 1 100 0.00 65535.00 FORMAT "%8.2" ECU_ADDRESS 0x8FD696 /end MEASUREMENT
/begin MEASUREMENT Dfp_AFSCD_PlOffsDrft2_mp "Messpunkt fuer Fehlerpfad  Dfp_AFSCD_PlOffsDrft2" UWORD OneToOne 1 100 0.00 65535.00 FORMAT "%8.2" ECU_ADDRESS 0x8FD698 /end MEASUREMENT
/begin MEASUREMENT Dfp_AFSCD_PlOffsDrft_mp "Messpunkt fuer Fehlerpfad  Dfp_AFSCD_PlOffsDrft" UWORD OneToOne 1 100 0.00 65535.00 FORMAT "%8.2" ECU_ADDRESS 0x8FD69A /end MEASUREMENT
/begin MEASUREMENT Dfp_AFSCD_PlSetyDrft_mp "Messpunkt fuer Fehlerpfad  Dfp_AFSCD_PlSetyDrft" UWORD OneToOne 1 100 0.00 65535.00 FORMAT "%8.2" ECU_ADDRESS 0x8FD69C /end MEASUREMENT
/begin MEASUREMENT Dfp_AFSCD_SRCAirTemp2_mp "Messpunkt fuer Fehlerpfad  Dfp_AFSCD_SRCAirTemp2" UWORD OneToOne 1 100 0.00 65535.00 FORMAT "%8.2" ECU_ADDRESS 0x8FD69E /end MEASUREMENT
/begin MEASUREMENT Dfp_AFSCD_SRCAirTemp_mp "Fehlerpfad für Prüfung auf optimal Lufttemperatur" UWORD OneToOne 1 100 0.00 65535.00 FORMAT "%8.2" ECU_ADDRESS 0x8FD6A0 /end MEASUREMENT
/begin MEASUREMENT Dfp_AFSCD_SRCBatt2_mp "Messpunkt fuer Fehlerpfad  Dfp_AFSCD_SRCBatt2" UWORD OneToOne 1 100 0.00 65535.00 FORMAT "%8.2" ECU_ADDRESS 0x8FD6A2 /end MEASUREMENT
/begin MEASUREMENT Dfp_AFSCD_SRCBatt_mp "Fehlerpfad für Prüfung auf optimale Batteriespannung" UWORD OneToOne 1 100 0.00 65535.00 FORMAT "%8.2" ECU_ADDRESS 0x8FD6A4 /end MEASUREMENT
/begin MEASUREMENT Dfp_AFSCD_SRCCorrAirm2_mp "Messpunkt fuer Fehlerpfad  Dfp_AFSCD_SRCCorrAirm2" UWORD OneToOne 1 100 0.00 65535.00 FORMAT "%8.2" ECU_ADDRESS 0x8FD6A6 /end MEASUREMENT
/begin MEASUREMENT Dfp_AFSCD_SRCCorrAirm_mp "Fehlerpfad für SRC des korrigierten Sensorsignals (HFM6)" UWORD OneToOne 1 100 0.00 65535.00 FORMAT "%8.2" ECU_ADDRESS 0x8FD6A8 /end MEASUREMENT
/begin MEASUREMENT Dfp_AFSCD_SRCRawAirm2_mp "Messpunkt fuer Fehlerpfad  Dfp_AFSCD_SRCRawAirm2" UWORD OneToOne 1 100 0.00 65535.00 FORMAT "%8.2" ECU_ADDRESS 0x8FD6AA /end MEASUREMENT
/begin MEASUREMENT Dfp_AFSCD_SRCRawAirm_mp "Fehlerpfad für SRC des unkorrigierten Sensorsignals (HFM6)" UWORD OneToOne 1 100 0.00 65535.00 FORMAT "%8.2" ECU_ADDRESS 0x8FD6AC /end MEASUREMENT
/begin MEASUREMENT Dfp_AFSCD_SRCRefSigPer2_mp "Messpunkt fuer Fehlerpfad  Dfp_AFSCD_SRCRefSigPer2" UWORD OneToOne 1 100 0.00 65535.00 FORMAT "%8.2" ECU_ADDRESS 0x8FD6AE /end MEASUREMENT
/begin MEASUREMENT Dfp_AFSCD_SRCRefSigPer_mp "Fehlerpfad für SRC des Referenzsignals (Lufttemperatur-Periodendauer beim HFM6)" UWORD OneToOne 1 100 0.00 65535.00 FORMAT "%8.2" ECU_ADDRESS 0x8FD6B0 /end MEASUREMENT
/begin MEASUREMENT Dfp_AirCtlGvnrDvtRgnMax_mp "Regelabweichung in Regeneration zu groß" UWORD OneToOne 1 100 0.00 65535.00 FORMAT "%8.2" ECU_ADDRESS 0x8FD6B2 /end MEASUREMENT
/begin MEASUREMENT Dfp_AirCtlGvnrDvtRgnMin_mp "Regelabweichung in Regeneration zu klein" UWORD OneToOne 1 100 0.00 65535.00 FORMAT "%8.2" ECU_ADDRESS 0x8FD6B4 /end MEASUREMENT
/begin MEASUREMENT Dfp_AirCtlGvnrDvtRgnMn2_mp "" UWORD OneToOne 1 100 0.00 65535.00 FORMAT "%8.2" ECU_ADDRESS 0x8FD6B6 /end MEASUREMENT
/begin MEASUREMENT Dfp_AirCtlGvnrDvtRgnMx2_mp "" UWORD OneToOne 1 100 0.00 65535.00 FORMAT "%8.2" ECU_ADDRESS 0x8FD6B8 /end MEASUREMENT
/begin MEASUREMENT Dfp_AirCtlPlateBreak_mp "Dfp for plate break monitoring" UWORD OneToOne 1 100 0.00 65535.00 FORMAT "%8.2" ECU_ADDRESS 0x8FD6BA /end MEASUREMENT
/begin MEASUREMENT Dfp_AirCtlRmpTO_mp "Fehlerpfadmeßpunkt für Zeitüberschreitung der Übergangsphase von Regenerations- zum Normalbetrieb" UWORD OneToOne 1 100 0.00 65535.00 FORMAT "%8.2" ECU_ADDRESS 0x8FD6BC /end MEASUREMENT
/begin MEASUREMENT Dfp_AirCtl_GovNegDev2_mp "AirCtl permanent governor2 negative deviatio" UWORD OneToOne 1 100 0.00 65535.00 FORMAT "%8.2" ECU_ADDRESS 0x8FD6BE /end MEASUREMENT
/begin MEASUREMENT Dfp_AirCtl_GovNegDev_mp "Messpunkt fuer Fehlerpfad  Dfp_AirCtl_GovNegDev" UWORD OneToOne 1 100 0.00 65535.00 FORMAT "%8.2" ECU_ADDRESS 0x8FD6C0 /end MEASUREMENT
/begin MEASUREMENT Dfp_AirCtl_GovPosDev2_mp "AirCtl permanent governor2 positive deviation" UWORD OneToOne 1 100 0.00 65535.00 FORMAT "%8.2" ECU_ADDRESS 0x8FD6C2 /end MEASUREMENT
/begin MEASUREMENT Dfp_AirCtl_GovPosDev_mp "Messpunkt fuer Fehlerpfad  Dfp_AirCtl_GovPosDev" UWORD OneToOne 1 100 0.00 65535.00 FORMAT "%8.2" ECU_ADDRESS 0x8FD6C4 /end MEASUREMENT
/begin MEASUREMENT Dfp_AltCD_mp "Fehlerpfad des Generators (Kommunikationsfehler)" UWORD OneToOne 1 100 0.00 65535.00 FORMAT "%8.2" ECU_ADDRESS 0x8FD6C6 /end MEASUREMENT
/begin MEASUREMENT Dfp_AOHtCD_AOHtDia1_mp "Messpunkt fuer Fehlerpfad  Dfp_AOHtCD_AOHtDia1" UWORD OneToOne 1 100 0.00 65535.00 FORMAT "%8.2" ECU_ADDRESS 0x8FD6C8 /end MEASUREMENT
/begin MEASUREMENT Dfp_AOHtCD_AOHtDia2_mp "Messpunkt fuer Fehlerpfad  Dfp_AOHtCD_AOHtDia2" UWORD OneToOne 1 100 0.00 65535.00 FORMAT "%8.2" ECU_ADDRESS 0x8FD6CA /end MEASUREMENT
/begin MEASUREMENT Dfp_AOHtCD_AOHtDia3_mp "Messpunkt fuer Fehlerpfad  Dfp_AOHtCD_AOHtDia3" UWORD OneToOne 1 100 0.00 65535.00 FORMAT "%8.2" ECU_ADDRESS 0x8FD6CC /end MEASUREMENT
/begin MEASUREMENT Dfp_AOHtCD_mp "Messpunkt fuer Fehlerpfad bei PWM Endstufenfehler" UWORD OneToOne 1 100 0.00 65535.00 FORMAT "%8.2" ECU_ADDRESS 0x8FD6CE /end MEASUREMENT
/begin MEASUREMENT Dfp_APP1_mp "Messpunkt fuer Fehlerpfad  Dfp_APP1" UWORD OneToOne 1 100 0.00 65535.00 FORMAT "%8.2" ECU_ADDRESS 0x8FD6D0 /end MEASUREMENT
/begin MEASUREMENT Dfp_APP2_mp "Messpunkt fuer Fehlerpfad  Dfp_APP2" UWORD OneToOne 1 100 0.00 65535.00 FORMAT "%8.2" ECU_ADDRESS 0x8FD6D2 /end MEASUREMENT
/begin MEASUREMENT Dfp_APPCDCmpd_mp "Messpunkt für Dfp_APPCDCmpd" UWORD OneToOne 1 100 0.00 65535.00 FORMAT "%8.2" ECU_ADDRESS 0x8FD6D4 /end MEASUREMENT
/begin MEASUREMENT Dfp_APPSync_mp "Messpunkt für Fehlerpfad Dfp_APPSync" UWORD OneToOne 1 100 0.00 65535.00 FORMAT "%8.2" ECU_ADDRESS 0x8FD6D6 /end MEASUREMENT
/begin MEASUREMENT Dfp_APSCD_mp "Messpunkt fuer Fehlerpfad  Dfp_APSCD" UWORD OneToOne 1 100 0.00 65535.00 FORMAT "%8.2" ECU_ADDRESS 0x8FD6D8 /end MEASUREMENT
/begin MEASUREMENT Dfp_ARS_mp "Fault path for ARS" UWORD OneToOne 1 100 0.00 65535.00 FORMAT "%8.2" ECU_ADDRESS 0x8FD6DA /end MEASUREMENT
/begin MEASUREMENT Dfp_BattCD_mp "Messpunkt fuer Fehlerpfad  Dfp_BattCD" UWORD OneToOne 1 100 0.00 65535.00 FORMAT "%8.2" ECU_ADDRESS 0x8FD6DC /end MEASUREMENT
/begin MEASUREMENT Dfp_BPACD_BPADia1v2_mp "Messpunkt fuer Fehlerpfad  Dfp_BPACD_BPADia1v2" UWORD OneToOne 1 100 0.00 65535.00 FORMAT "%8.2" ECU_ADDRESS 0x8FD6DE /end MEASUREMENT
/begin MEASUREMENT Dfp_BPACD_BPADia1_mp "Messpunkt fuer Fehlerpfad  Dfp_BPACD_BPADia1" UWORD OneToOne 1 100 0.00 65535.00 FORMAT "%8.2" ECU_ADDRESS 0x8FD6E0 /end MEASUREMENT
/begin MEASUREMENT Dfp_BPACD_BPADia2v2_mp "Messpunkt fuer Fehlerpfad  Dfp_BPACD_BPADia2v2" UWORD OneToOne 1 100 0.00 65535.00 FORMAT "%8.2" ECU_ADDRESS 0x8FD6E2 /end MEASUREMENT
/begin MEASUREMENT Dfp_BPACD_BPADia2_mp "Messpunkt fuer Fehlerpfad  Dfp_BPACD_BPADia2" UWORD OneToOne 1 100 0.00 65535.00 FORMAT "%8.2" ECU_ADDRESS 0x8FD6E4 /end MEASUREMENT
/begin MEASUREMENT Dfp_BPACD_BPADia3v2_mp "Messpunkt fuer Fehlerpfad  Dfp_BPACD_BPADia3v2" UWORD OneToOne 1 100 0.00 65535.00 FORMAT "%8.2" ECU_ADDRESS 0x8FD6E6 /end MEASUREMENT
/begin MEASUREMENT Dfp_BPACD_BPADia3_mp "Messpunkt fuer Fehlerpfad  Dfp_BPACD_BPADia3" UWORD OneToOne 1 100 0.00 65535.00 FORMAT "%8.2" ECU_ADDRESS 0x8FD6E8 /end MEASUREMENT
/begin MEASUREMENT Dfp_BPACD_BPADia4v2_mp "Fehlerpfad 4 für Fensterdiagnose des Ladedruckstellers auf v2" UWORD OneToOne 1 100 0.00 65535.00 FORMAT "%8.2" ECU_ADDRESS 0x8FD6EA /end MEASUREMENT
/begin MEASUREMENT Dfp_BPACD_BPADia4_mp "Fehlerpfad 4 für Fensterdiagnose des Ladedruckstellers" UWORD OneToOne 1 100 0.00 65535.00 FORMAT "%8.2" ECU_ADDRESS 0x8FD6EC /end MEASUREMENT
/begin MEASUREMENT Dfp_BPACD_Max2_mp "Messpunkt fuer Fehlerpfad  Dfp_BPACD_Max2" UWORD OneToOne 1 100 0.00 65535.00 FORMAT "%8.2" ECU_ADDRESS 0x8FD6EE /end MEASUREMENT
/begin MEASUREMENT Dfp_BPACD_Max_mp "Fehlerpfad für Kurzschluss nach Batteriespannung des Ladedruckstrellers" UWORD OneToOne 1 100 0.00 65535.00 FORMAT "%8.2" ECU_ADDRESS 0x8FD6F0 /end MEASUREMENT
/begin MEASUREMENT Dfp_BPACD_Min2_mp "Messpunkt fuer Fehlerpfad  Dfp_BPACD_Min2" UWORD OneToOne 1 100 0.00 65535.00 FORMAT "%8.2" ECU_ADDRESS 0x8FD6F2 /end MEASUREMENT
/begin MEASUREMENT Dfp_BPACD_Min_mp "Fehlerpfad für Kurzschluss nach Masse des Ladedruckstellers" UWORD OneToOne 1 100 0.00 65535.00 FORMAT "%8.2" ECU_ADDRESS 0x8FD6F4 /end MEASUREMENT
/begin MEASUREMENT Dfp_BPACD_SigNpl2_mp "Messpunkt fuer Fehlerpfad  Dfp_BPACD_SigNpl2" UWORD OneToOne 1 100 0.00 65535.00 FORMAT "%8.2" ECU_ADDRESS 0x8FD6F6 /end MEASUREMENT
/begin MEASUREMENT Dfp_BPACD_SigNpl_mp "Fehlerpfad für Lastabfall und Übertemperatur des Ladedruckstellers" UWORD OneToOne 1 100 0.00 65535.00 FORMAT "%8.2" ECU_ADDRESS 0x8FD6F8 /end MEASUREMENT
/begin MEASUREMENT Dfp_BPSCD_mp "Messpunkt fuer Fehlerpfad  Dfp_BPSCD" UWORD OneToOne 1 100 0.00 65535.00 FORMAT "%8.2" ECU_ADDRESS 0x8FD6FA /end MEASUREMENT
/begin MEASUREMENT Dfp_BrkCD_mp "Messpunkt fuer Fehlerpfad  Dfp_BrkCD" UWORD OneToOne 1 100 0.00 65535.00 FORMAT "%8.2" ECU_ADDRESS 0x8FD6FC /end MEASUREMENT
/begin MEASUREMENT Dfp_Bss_mp "Messpunkt fuer Fehlerpfad  Dfp_Bss" UWORD OneToOne 1 100 0.00 65535.00 FORMAT "%8.2" ECU_ADDRESS 0x8FD6FE /end MEASUREMENT
/begin MEASUREMENT Dfp_CBACD_mp "Messpunkt fuer Fehlerpfad  Dfp_CBACD" UWORD OneToOne 1 100 0.00 65535.00 FORMAT "%8.2" ECU_ADDRESS 0x8FD700 /end MEASUREMENT
/begin MEASUREMENT Dfp_Clg_DynTst_mp "Messpunkt fuer Fehlerpfad  Dfp_Clg_DynTst" UWORD OneToOne 1 100 0.00 65535.00 FORMAT "%8.2" ECU_ADDRESS 0x8FD702 /end MEASUREMENT
/begin MEASUREMENT Dfp_CmbChbMisfire1_mp "Fehlerpfad Zündaussetzer in Zylinder 1" UWORD OneToOne 1 100 0.00 65535.00 FORMAT "%8.2" ECU_ADDRESS 0x8FD704 /end MEASUREMENT
/begin MEASUREMENT Dfp_CmbChbMisfire2_mp "Fehlerpfad Zündaussetzer in Zylinder 2" UWORD OneToOne 1 100 0.00 65535.00 FORMAT "%8.2" ECU_ADDRESS 0x8FD706 /end MEASUREMENT
/begin MEASUREMENT Dfp_CmbChbMisfire3_mp "Fehlerpfad Zündaussetzer in Zylinder 3" UWORD OneToOne 1 100 0.00 65535.00 FORMAT "%8.2" ECU_ADDRESS 0x8FD708 /end MEASUREMENT
/begin MEASUREMENT Dfp_CmbChbMisfire4_mp "Fehlerpfad Zündaussetzer in Zylinder 4" UWORD OneToOne 1 100 0.00 65535.00 FORMAT "%8.2" ECU_ADDRESS 0x8FD70A /end MEASUREMENT
/begin MEASUREMENT Dfp_CmbChbMisfire5_mp "Fehlerpfad Zündaussetzer in Zylinder 5" UWORD OneToOne 1 100 0.00 65535.00 FORMAT "%8.2" ECU_ADDRESS 0x8FD70C /end MEASUREMENT
/begin MEASUREMENT Dfp_CmbChbMisfire6_mp "Fehlerpfad Zündaussetzer in Zylinder 6" UWORD OneToOne 1 100 0.00 65535.00 FORMAT "%8.2" ECU_ADDRESS 0x8FD70E /end MEASUREMENT
/begin MEASUREMENT Dfp_CmbChbMisfire7_mp "Messpunkt fuer Fehlerpfad  Dfp_CmbChbMisfire7" UWORD OneToOne 1 100 0.00 65535.00 FORMAT "%8.2" ECU_ADDRESS 0x8FD710 /end MEASUREMENT
/begin MEASUREMENT Dfp_CmbChbMisfire8_mp "Messpunkt fuer Fehlerpfad  Dfp_CmbChbMisfire8" UWORD OneToOne 1 100 0.00 65535.00 FORMAT "%8.2" ECU_ADDRESS 0x8FD712 /end MEASUREMENT
/begin MEASUREMENT Dfp_CmbChbMisfireMul_mp "Fehlerpfad Zündaussetzer in mehreren Zylindern" UWORD OneToOne 1 100 0.00 65535.00 FORMAT "%8.2" ECU_ADDRESS 0x8FD714 /end MEASUREMENT
/begin MEASUREMENT Dfp_CoDT_TRQ_Des_mp "Messpunkt fuer Fehlerpfad  Dfp_CoDT_TRQ_Des" UWORD OneToOne 1 100 0.00 65535.00 FORMAT "%8.2" ECU_ADDRESS 0x8FD716 /end MEASUREMENT
/begin MEASUREMENT Dfp_CoDT_TRQ_Lead_mp "Messpunkt fuer Fehlerpfad  Dfp_CoDT_TRQ_Lead" UWORD OneToOne 1 100 0.00 65535.00 FORMAT "%8.2" ECU_ADDRESS 0x8FD718 /end MEASUREMENT
/begin MEASUREMENT Dfp_CoEng_GbxRpmRduc_mp "" UWORD OneToOne 1 100 0.00 65535.00 FORMAT "%8.2" ECU_ADDRESS 0x8FD71A /end MEASUREMENT
/begin MEASUREMENT Dfp_ConvCD_mp "Messpunkt fuer Fehlerpfad  Dfp_ConvCD" UWORD OneToOne 1 100 0.00 65535.00 FORMAT "%8.2" ECU_ADDRESS 0x8FD71C /end MEASUREMENT
/begin MEASUREMENT Dfp_CoVMDCSh_mp "Fehlerpfade physikalische Unplausibilität der  Motorschlupfregelung" UWORD OneToOne 1 100 0.00 65535.00 FORMAT "%8.2" ECU_ADDRESS 0x8FD71E /end MEASUREMENT
/begin MEASUREMENT Dfp_CrCCDMFL_mp "Messpunkt fuer Fehlerpfad  Dfp_CrCCDMFL" UWORD OneToOne 1 100 0.00 65535.00 FORMAT "%8.2" ECU_ADDRESS 0x8FD720 /end MEASUREMENT
/begin MEASUREMENT Dfp_CrCtl_vCrCtl_mp "Erkennung gefilterte Offset-Geschwindigkeit über Grenze beim Stufentempomat" UWORD OneToOne 1 100 0.00 65535.00 FORMAT "%8.2" ECU_ADDRESS 0x8FD722 /end MEASUREMENT
/begin MEASUREMENT Dfp_CTSCD_mp "Messpunkt fuer Fehlerpfad  Dfp_CTSCD" UWORD OneToOne 1 100 0.00 65535.00 FORMAT "%8.2" ECU_ADDRESS 0x8FD724 /end MEASUREMENT
/begin MEASUREMENT Dfp_EATSCD_mp "Messpunkt fuer Fehlerpfad  Dfp_EATSCD" UWORD OneToOne 1 100 0.00 65535.00 FORMAT "%8.2" ECU_ADDRESS 0x8FD726 /end MEASUREMENT
/begin MEASUREMENT Dfp_EBAFCD_mp "Messpunkt fuer Fehlerpfad  Dfp_EBAFCD" UWORD OneToOne 1 100 0.00 65535.00 FORMAT "%8.2" ECU_ADDRESS 0x8FD728 /end MEASUREMENT
/begin MEASUREMENT Dfp_EBFCD_mp "Messpunkt fuer Fehlerpfad  Dfp_EBFCD" UWORD OneToOne 1 100 0.00 65535.00 FORMAT "%8.2" ECU_ADDRESS 0x8FD72A /end MEASUREMENT
/begin MEASUREMENT Dfp_EBTSCD_mp "Messpunkt fuer Fehlerpfad  Dfp_EBTSCD" UWORD OneToOne 1 100 0.00 65535.00 FORMAT "%8.2" ECU_ADDRESS 0x8FD72C /end MEASUREMENT
/begin MEASUREMENT Dfp_EBTSCD_OvrTemp_mp "Messpunkt fuer Fehlerpfad  Dfp_EBTSCD_OvrTemp" UWORD OneToOne 1 100 0.00 65535.00 FORMAT "%8.2" ECU_ADDRESS 0x8FD72E /end MEASUREMENT
/begin MEASUREMENT Dfp_EEPCDVarMng_mp "Messpunkt fuer Fehlerpfad  Dfp_EEPCDVarMng" UWORD OneToOne 1 100 0.00 65535.00 FORMAT "%8.2" ECU_ADDRESS 0x8FD730 /end MEASUREMENT
/begin MEASUREMENT Dfp_EGPpCD_mp "Messpunkt fuer Fehlerpfad  Dfp_EGPpCD" UWORD OneToOne 1 100 0.00 65535.00 FORMAT "%8.2" ECU_ADDRESS 0x8FD732 /end MEASUREMENT
/begin MEASUREMENT Dfp_EGRCD_Max2_mp "Fehlerpfad für Kurzschluss nach Batteriespannung des 2ten Abgasrückführstellers" UWORD OneToOne 1 100 0.00 65535.00 FORMAT "%8.2" ECU_ADDRESS 0x8FD734 /end MEASUREMENT
/begin MEASUREMENT Dfp_EGRCD_Max_mp "Fehlerpfad für Kurzschluss nach Batteriespannung des Abgasrückführstellers" UWORD OneToOne 1 100 0.00 65535.00 FORMAT "%8.2" ECU_ADDRESS 0x8FD736 /end MEASUREMENT
/begin MEASUREMENT Dfp_EGRCD_Min2_mp "Fehlerpfad für Kurzschluss nach Masse des 2ten Abgasrückführstellers" UWORD OneToOne 1 100 0.00 65535.00 FORMAT "%8.2" ECU_ADDRESS 0x8FD738 /end MEASUREMENT
/begin MEASUREMENT Dfp_EGRCD_Min_mp "Fehlerpfad für Kurzschluss nach Masse des Abgasrückführstellers" UWORD OneToOne 1 100 0.00 65535.00 FORMAT "%8.2" ECU_ADDRESS 0x8FD73A /end MEASUREMENT
/begin MEASUREMENT Dfp_EGRCD_PWMInDia1_mp "" UWORD OneToOne 1 100 0.00 65535.00 FORMAT "%8.2" ECU_ADDRESS 0x8FD73C /end MEASUREMENT
/begin MEASUREMENT Dfp_EGRCD_PWMInDia21_mp "" UWORD OneToOne 1 100 0.00 65535.00 FORMAT "%8.2" ECU_ADDRESS 0x8FD73E /end MEASUREMENT
/begin MEASUREMENT Dfp_EGRCD_PWMInDia22_mp "" UWORD OneToOne 1 100 0.00 65535.00 FORMAT "%8.2" ECU_ADDRESS 0x8FD740 /end MEASUREMENT
/begin MEASUREMENT Dfp_EGRCD_PWMInDia23_mp "" UWORD OneToOne 1 100 0.00 65535.00 FORMAT "%8.2" ECU_ADDRESS 0x8FD742 /end MEASUREMENT
/begin MEASUREMENT Dfp_EGRCD_PWMInDia24_mp "" UWORD OneToOne 1 100 0.00 65535.00 FORMAT "%8.2" ECU_ADDRESS 0x8FD744 /end MEASUREMENT
/begin MEASUREMENT Dfp_EGRCD_PWMInDia2_mp "" UWORD OneToOne 1 100 0.00 65535.00 FORMAT "%8.2" ECU_ADDRESS 0x8FD746 /end MEASUREMENT
/begin MEASUREMENT Dfp_EGRCD_PWMInDia3_mp "" UWORD OneToOne 1 100 0.00 65535.00 FORMAT "%8.2" ECU_ADDRESS 0x8FD748 /end MEASUREMENT
/begin MEASUREMENT Dfp_EGRCD_PWMInDia4_mp "" UWORD OneToOne 1 100 0.00 65535.00 FORMAT "%8.2" ECU_ADDRESS 0x8FD74A /end MEASUREMENT
/begin MEASUREMENT Dfp_EGRCD_SigDia2_mp "" UWORD OneToOne 1 100 0.00 65535.00 FORMAT "%8.2" ECU_ADDRESS 0x8FD74C /end MEASUREMENT
/begin MEASUREMENT Dfp_EGRCD_SigDia_mp "" UWORD OneToOne 1 100 0.00 65535.00 FORMAT "%8.2" ECU_ADDRESS 0x8FD74E /end MEASUREMENT
/begin MEASUREMENT Dfp_EGRCD_SigNpl2_mp "Fehlerpfad für Lastabfall und Übertemperatur des 2ten Abgasrückführstellers" UWORD OneToOne 1 100 0.00 65535.00 FORMAT "%8.2" ECU_ADDRESS 0x8FD750 /end MEASUREMENT
/begin MEASUREMENT Dfp_EGRCD_SigNpl_mp "Fehlerpfad für Lastabfall und Übertemperatur des Abgasrückführstellers" UWORD OneToOne 1 100 0.00 65535.00 FORMAT "%8.2" ECU_ADDRESS 0x8FD752 /end MEASUREMENT
/begin MEASUREMENT Dfp_EGTOilLvlCrit_mp "Fehlerpfad für kritische Ölmasse" UWORD OneToOne 1 100 0.00 65535.00 FORMAT "%8.2" ECU_ADDRESS 0x8FD754 /end MEASUREMENT
/begin MEASUREMENT Dfp_EGTOilVscCrit_mp "Fehlerpfad für kritisch Ölviskosität" UWORD OneToOne 1 100 0.00 65535.00 FORMAT "%8.2" ECU_ADDRESS 0x8FD756 /end MEASUREMENT
/begin MEASUREMENT Dfp_EGTRgnOilDil_mp "Fehlerpfad maximale Zeit für Ölverdünnung überschritten" UWORD OneToOne 1 100 0.00 65535.00 FORMAT "%8.2" ECU_ADDRESS 0x8FD758 /end MEASUREMENT
/begin MEASUREMENT Dfp_EGTTempGvnrInrB1_mp "Messpunkt für Fehlerpfad Dfp_EGTTempGvnrInrB1 Bank1" UWORD OneToOne 1 100 0.00 65535.00 FORMAT "%8.2" ECU_ADDRESS 0x8FD75A /end MEASUREMENT
/begin MEASUREMENT Dfp_EGTTempGvnrInrB2_mp "Messpunkt für Fehlerpfad Dfp_EGTTempGvnrInrB2 Bank2" UWORD OneToOne 1 100 0.00 65535.00 FORMAT "%8.2" ECU_ADDRESS 0x8FD75C /end MEASUREMENT
/begin MEASUREMENT Dfp_EGTTempGvnrOutrB1_mp "Messpunkt für Fehlerpfad Dfp_EGTTempGvnrOutrB1 Bank1" UWORD OneToOne 1 100 0.00 65535.00 FORMAT "%8.2" ECU_ADDRESS 0x8FD75E /end MEASUREMENT
/begin MEASUREMENT Dfp_EGTTempGvnrOutrB2_mp "Messpunkt für Fehlerpfad Dfp_EGTTempGvnrOutrB2 Bank2" UWORD OneToOne 1 100 0.00 65535.00 FORMAT "%8.2" ECU_ADDRESS 0x8FD760 /end MEASUREMENT
/begin MEASUREMENT Dfp_EngMCaS1_mp "Meßpunkt für Fehlerpfad Dfp_EngMCaS1" UWORD OneToOne 1 100 0.00 65535.00 FORMAT "%8.2" ECU_ADDRESS 0x8FD762 /end MEASUREMENT
/begin MEASUREMENT Dfp_EngMCrS1_mp "Meßpunkt für Fehlerpfad Dfp_EngMCrS1" UWORD OneToOne 1 100 0.00 65535.00 FORMAT "%8.2" ECU_ADDRESS 0x8FD764 /end MEASUREMENT
/begin MEASUREMENT Dfp_EngMntCtlCD_mp "Messpunkt fuer Fehlerpfad  Dfp_EngMntCtlCD" UWORD OneToOne 1 100 0.00 65535.00 FORMAT "%8.2" ECU_ADDRESS 0x8FD766 /end MEASUREMENT
/begin MEASUREMENT Dfp_EngMOfsCaSCrS_mp "Meßpunkt fuer Fehlerpfad Dfp_EngMOfsCaSCrS" UWORD OneToOne 1 100 0.00 65535.00 FORMAT "%8.2" ECU_ADDRESS 0x8FD768 /end MEASUREMENT
/begin MEASUREMENT Dfp_ETClbETFltInj1_mp "Messpunkt fuer Fehlerpfad  Dfp_ETClbETFltInj1" UWORD OneToOne 1 100 0.00 65535.00 FORMAT "%8.2" ECU_ADDRESS 0x8FD76A /end MEASUREMENT
/begin MEASUREMENT Dfp_ETClbETFltInj2_mp "Messpunkt fuer Fehlerpfad  Dfp_ETClbETFltInj2" UWORD OneToOne 1 100 0.00 65535.00 FORMAT "%8.2" ECU_ADDRESS 0x8FD76C /end MEASUREMENT
/begin MEASUREMENT Dfp_ETClbETFltInj3_mp "Messpunkt fuer Fehlerpfad  Dfp_ETClbETFltInj3" UWORD OneToOne 1 100 0.00 65535.00 FORMAT "%8.2" ECU_ADDRESS 0x8FD76E /end MEASUREMENT
/begin MEASUREMENT Dfp_ETClbETFltInj4_mp "Messpunkt fuer Fehlerpfad  Dfp_ETClbETFltInj4" UWORD OneToOne 1 100 0.00 65535.00 FORMAT "%8.2" ECU_ADDRESS 0x8FD770 /end MEASUREMENT
/begin MEASUREMENT Dfp_ETClbETFltInj5_mp "Messpunkt fuer Fehlerpfad  Dfp_ETClbETFltInj5" UWORD OneToOne 1 100 0.00 65535.00 FORMAT "%8.2" ECU_ADDRESS 0x8FD772 /end MEASUREMENT
/begin MEASUREMENT Dfp_ETClbETFltInj6_mp "Messpunkt fuer Fehlerpfad  Dfp_ETClbETFltInj6" UWORD OneToOne 1 100 0.00 65535.00 FORMAT "%8.2" ECU_ADDRESS 0x8FD774 /end MEASUREMENT
/begin MEASUREMENT Dfp_ETClbETFltInj7_mp "Messpunkt fuer Fehlerpfad  Dfp_ETClbETFltInj7" UWORD OneToOne 1 100 0.00 65535.00 FORMAT "%8.2" ECU_ADDRESS 0x8FD776 /end MEASUREMENT
/begin MEASUREMENT Dfp_ETClbETFltInj8_mp "Messpunkt fuer Fehlerpfad  Dfp_ETClbETFltInj8" UWORD OneToOne 1 100 0.00 65535.00 FORMAT "%8.2" ECU_ADDRESS 0x8FD778 /end MEASUREMENT
/begin MEASUREMENT Dfp_ETClbInj1_mp "Messpunkt fuer Fehlerpfad  Dfp_ETClbInj1" UWORD OneToOne 1 100 0.00 65535.00 FORMAT "%8.2" ECU_ADDRESS 0x8FD77A /end MEASUREMENT
/begin MEASUREMENT Dfp_ETClbInj2_mp "Messpunkt fuer Fehlerpfad  Dfp_ETClbInj2" UWORD OneToOne 1 100 0.00 65535.00 FORMAT "%8.2" ECU_ADDRESS 0x8FD77C /end MEASUREMENT
/begin MEASUREMENT Dfp_ETClbInj3_mp "Messpunkt fuer Fehlerpfad  Dfp_ETClbInj3" UWORD OneToOne 1 100 0.00 65535.00 FORMAT "%8.2" ECU_ADDRESS 0x8FD77E /end MEASUREMENT
/begin MEASUREMENT Dfp_ETClbInj4_mp "Messpunkt fuer Fehlerpfad  Dfp_ETClbInj4" UWORD OneToOne 1 100 0.00 65535.00 FORMAT "%8.2" ECU_ADDRESS 0x8FD780 /end MEASUREMENT
/begin MEASUREMENT Dfp_ETClbInj5_mp "Messpunkt fuer Fehlerpfad  Dfp_ETClbInj5" UWORD OneToOne 1 100 0.00 65535.00 FORMAT "%8.2" ECU_ADDRESS 0x8FD782 /end MEASUREMENT
/begin MEASUREMENT Dfp_ETClbInj6_mp "Messpunkt fuer Fehlerpfad  Dfp_ETClbInj6" UWORD OneToOne 1 100 0.00 65535.00 FORMAT "%8.2" ECU_ADDRESS 0x8FD784 /end MEASUREMENT
/begin MEASUREMENT Dfp_ETClbInj7_mp "Messpunkt fuer Fehlerpfad  Dfp_ETClbInj7" UWORD OneToOne 1 100 0.00 65535.00 FORMAT "%8.2" ECU_ADDRESS 0x8FD786 /end MEASUREMENT
/begin MEASUREMENT Dfp_ETClbInj8_mp "Messpunkt fuer Fehlerpfad  Dfp_ETClbInj8" UWORD OneToOne 1 100 0.00 65535.00 FORMAT "%8.2" ECU_ADDRESS 0x8FD788 /end MEASUREMENT
/begin MEASUREMENT Dfp_FanCD_FanCtlr1_mp "Messpunkt fuer Fehlerpfad  Dfp_FanCD_FanCtlr1" UWORD OneToOne 1 100 0.00 65535.00 FORMAT "%8.2" ECU_ADDRESS 0x8FD78A /end MEASUREMENT
/begin MEASUREMENT Dfp_FanCD_FanCtlr2_mp "Messpunkt fuer Fehlerpfad  Dfp_FanCD_FanCtlr2" UWORD OneToOne 1 100 0.00 65535.00 FORMAT "%8.2" ECU_ADDRESS 0x8FD78C /end MEASUREMENT
/begin MEASUREMENT Dfp_FanCD_FanCtlr3_mp "Messpunkt fuer Fehlerpfad  Dfp_FanCD_FanCtlr3" UWORD OneToOne 1 100 0.00 65535.00 FORMAT "%8.2" ECU_ADDRESS 0x8FD78E /end MEASUREMENT
/begin MEASUREMENT Dfp_FanCD_mp "Fehlerpfad signalisiert Fehler in der Zuleitung zum Lüfter" UWORD OneToOne 1 100 0.00 65535.00 FORMAT "%8.2" ECU_ADDRESS 0x8FD790 /end MEASUREMENT
/begin MEASUREMENT Dfp_FBCqDvt_mp "Messpunkt fuer Fehlerpfad  Dfp_FBCqDvt" UWORD OneToOne 1 100 0.00 65535.00 FORMAT "%8.2" ECU_ADDRESS 0x8FD792 /end MEASUREMENT
/begin MEASUREMENT Dfp_FlFCD_mp "Messpunkt fuer Fehlerpfad  Dfp_FlFCD" UWORD OneToOne 1 100 0.00 65535.00 FORMAT "%8.2" ECU_ADDRESS 0x8FD794 /end MEASUREMENT
/begin MEASUREMENT Dfp_FlMngSmkDefect_mp "Messpunkt fuer Fehlerpfad  Dfp_FlMngSmkDefect" UWORD OneToOne 1 100 0.00 65535.00 FORMAT "%8.2" ECU_ADDRESS 0x8FD796 /end MEASUREMENT
/begin MEASUREMENT Dfp_FlSCDT1_mp "Messpunkt fuer Fehlerpfad  Dfp_FlSCDT1" UWORD OneToOne 1 100 0.00 65535.00 FORMAT "%8.2" ECU_ADDRESS 0x8FD798 /end MEASUREMENT
/begin MEASUREMENT Dfp_FMAErrMod_mp "Messpunkt fuer Fehlerpfad  Dfp_FMAErrMod" UWORD OneToOne 1 100 0.00 65535.00 FORMAT "%8.2" ECU_ADDRESS 0x8FD79A /end MEASUREMENT
/begin MEASUREMENT Dfp_FMTC_NonMonotonMap_mp "Prüfung Monotonie der Mengenstützpunkte über Moment in FMTC_trq2qBas_MAP" UWORD OneToOne 1 100 0.00 65535.00 FORMAT "%8.2" ECU_ADDRESS 0x8FD79C /end MEASUREMENT
/begin MEASUREMENT Dfp_FrmMngANFRADMOMPT_mp "Messpunkt fuer Fehlerpfad  Dfp_FrmMngANFRADMOMPT" UWORD OneToOne 1 100 0.00 65535.00 FORMAT "%8.2" ECU_ADDRESS 0x8FD79E /end MEASUREMENT
/begin MEASUREMENT Dfp_FrmMngASC1_mp "Messpunkt fuer Fehlerpfad  Dfp_FrmMngASC1" UWORD OneToOne 1 100 0.00 65535.00 FORMAT "%8.2" ECU_ADDRESS 0x8FD7A0 /end MEASUREMENT
/begin MEASUREMENT Dfp_FrmMngASC2_mp "Messpunkt fuer Fehlerpfad  Dfp_FrmMngASC2" UWORD OneToOne 1 100 0.00 65535.00 FORMAT "%8.2" ECU_ADDRESS 0x8FD7A2 /end MEASUREMENT
/begin MEASUREMENT Dfp_FrmMngASC3_mp "Messpunkt fuer Fehlerpfad  Dfp_FrmMngASC3" UWORD OneToOne 1 100 0.00 65535.00 FORMAT "%8.2" ECU_ADDRESS 0x8FD7A4 /end MEASUREMENT
/begin MEASUREMENT Dfp_FrmMngASC4_mp "Messpunkt fuer Fehlerpfad  Dfp_FrmMngASC4" UWORD OneToOne 1 100 0.00 65535.00 FORMAT "%8.2" ECU_ADDRESS 0x8FD7A6 /end MEASUREMENT
/begin MEASUREMENT Dfp_FrmMngBOS_RESET2_mp "" UWORD OneToOne 1 100 0.00 65535.00 FORMAT "%8.2" ECU_ADDRESS 0x8FD7A8 /end MEASUREMENT
/begin MEASUREMENT Dfp_FrmMngBOS_RESET_mp "BOS_RESET - CAN-message related errors" UWORD OneToOne 1 100 0.00 65535.00 FORMAT "%8.2" ECU_ADDRESS 0x8FD7AA /end MEASUREMENT
/begin MEASUREMENT Dfp_FrmMngDMANFAFS_mp "Messpunkt fuer Fehlerpfad  Dfp_FrmMngDMANFAFS" UWORD OneToOne 1 100 0.00 65535.00 FORMAT "%8.2" ECU_ADDRESS 0x8FD7AC /end MEASUREMENT
/begin MEASUREMENT Dfp_FrmMngDRMANFSSG_mp "Messpunkt fuer Fehlerpfad  Dfp_FrmMngDRMANFSSG" UWORD OneToOne 1 100 0.00 65535.00 FORMAT "%8.2" ECU_ADDRESS 0x8FD7AE /end MEASUREMENT
/begin MEASUREMENT Dfp_FrmMngEGS1_mp "Fehleerpfad für die EGS1 Botschaft" UWORD OneToOne 1 100 0.00 65535.00 FORMAT "%8.2" ECU_ADDRESS 0x8FD7B0 /end MEASUREMENT
/begin MEASUREMENT Dfp_FrmMngEGS2_mp "Messpunkt fuer Fehlerpfad  Dfp_FrmMngEGS2" UWORD OneToOne 1 100 0.00 65535.00 FORMAT "%8.2" ECU_ADDRESS 0x8FD7B2 /end MEASUREMENT
/begin MEASUREMENT Dfp_FrmMngGEARBX_DATA2_mp "Messpunkt fuer Fehlerpfad  Dfp_FrmMngGEARBX_DATA2" UWORD OneToOne 1 100 0.00 65535.00 FORMAT "%8.2" ECU_ADDRESS 0x8FD7B4 /end MEASUREMENT
/begin MEASUREMENT Dfp_FrmMngGEARBX_DATA_mp "GEARBX_DATA CAN12h-message related faults" UWORD OneToOne 1 100 0.00 65535.00 FORMAT "%8.2" ECU_ADDRESS 0x8FD7B6 /end MEASUREMENT
/begin MEASUREMENT Dfp_FrmMngHEAT_AC_mp "HEAT_AC CAN12h-message related faults" UWORD OneToOne 1 100 0.00 65535.00 FORMAT "%8.2" ECU_ADDRESS 0x8FD7B8 /end MEASUREMENT
/begin MEASUREMENT Dfp_FrmMngINSTR2_mp "Messpunkt fuer Fehlerpfad  Dfp_FrmMngINSTR2" UWORD OneToOne 1 100 0.00 65535.00 FORMAT "%8.2" ECU_ADDRESS 0x8FD7BA /end MEASUREMENT
/begin MEASUREMENT Dfp_FrmMngINSTR3_mp "Messpunkt fuer Fehlerpfad  Dfp_FrmMngINSTR3" UWORD OneToOne 1 100 0.00 65535.00 FORMAT "%8.2" ECU_ADDRESS 0x8FD7BC /end MEASUREMENT
/begin MEASUREMENT Dfp_FrmMngLENKRADWINKEL_mp "Messpunkt fuer Fehlerpfad  Dfp_FrmMngLENKRADWINKEL" UWORD OneToOne 1 100 0.00 65535.00 FORMAT "%8.2" ECU_ADDRESS 0x8FD7BE /end MEASUREMENT
/begin MEASUREMENT Dfp_FrmMngMILEAGE_RANGE_mp "Messpunkt fuer Fehlerpfad  Dfp_FrmMngMILEAGE_RANGE" UWORD OneToOne 1 100 0.00 65535.00 FORMAT "%8.2" ECU_ADDRESS 0x8FD7C0 /end MEASUREMENT
/begin MEASUREMENT Dfp_FrmMngMSPHISYNC_mp "" UWORD OneToOne 1 100 0.00 65535.00 FORMAT "%8.2" ECU_ADDRESS 0x8FD7C2 /end MEASUREMENT
/begin MEASUREMENT Dfp_FrmMngMST4_mp "" UWORD OneToOne 1 100 0.00 65535.00 FORMAT "%8.2" ECU_ADDRESS 0x8FD7C4 /end MEASUREMENT
/begin MEASUREMENT Dfp_FrmMngMST5_mp "" UWORD OneToOne 1 100 0.00 65535.00 FORMAT "%8.2" ECU_ADDRESS 0x8FD7C6 /end MEASUREMENT
/begin MEASUREMENT Dfp_FrmMngOPCRCTLACC_mp "Messpunkt fuer Fehlerpfad  Dfp_FrmMngOPCRCTLACC" UWORD OneToOne 1 100 0.00 65535.00 FORMAT "%8.2" ECU_ADDRESS 0x8FD7C8 /end MEASUREMENT
/begin MEASUREMENT Dfp_FrmMngParkConsumer_mp "Messpunkt fuer Fehlerpfad  Dfp_FrmMngParkConsumer" UWORD OneToOne 1 100 0.00 65535.00 FORMAT "%8.2" ECU_ADDRESS 0x8FD7CA /end MEASUREMENT
/begin MEASUREMENT Dfp_FrmMngPRGG_CCTR_mp "Messpunkt fuer Fehlerpfad  Dfp_FrmMngPRGG_CCTR" UWORD OneToOne 1 100 0.00 65535.00 FORMAT "%8.2" ECU_ADDRESS 0x8FD7CC /end MEASUREMENT
/begin MEASUREMENT Dfp_FrmMngPWRMNG_LOADV_mp "Messpunkt fuer Fehlerpfad  Dfp_FrmMngPWRMNG_LOADV" UWORD OneToOne 1 100 0.00 65535.00 FORMAT "%8.2" ECU_ADDRESS 0x8FD7CE /end MEASUREMENT
/begin MEASUREMENT Dfp_FrmMngRQSTGEFAN_mp "RQ_STG_EFAN - CAN-message related errors" UWORD OneToOne 1 100 0.00 65535.00 FORMAT "%8.2" ECU_ADDRESS 0x8FD7D0 /end MEASUREMENT
/begin MEASUREMENT Dfp_FrmMngSLV4_mp "" UWORD OneToOne 1 100 0.00 65535.00 FORMAT "%8.2" ECU_ADDRESS 0x8FD7D2 /end MEASUREMENT
/begin MEASUREMENT Dfp_FrmMngSLV5_mp "" UWORD OneToOne 1 100 0.00 65535.00 FORMAT "%8.2" ECU_ADDRESS 0x8FD7D4 /end MEASUREMENT
/begin MEASUREMENT Dfp_FrmMngSSGErr_mp "Messpunkt fuer Fehlerpfad  Dfp_FrmMngSSGErr" UWORD OneToOne 1 100 0.00 65535.00 FORMAT "%8.2" ECU_ADDRESS 0x8FD7D6 /end MEASUREMENT
/begin MEASUREMENT Dfp_FrmMngSSGShOff_mp "Messpunkt fuer Fehlerpfad  Dfp_FrmMngSSGShOff" UWORD OneToOne 1 100 0.00 65535.00 FORMAT "%8.2" ECU_ADDRESS 0x8FD7D8 /end MEASUREMENT
/begin MEASUREMENT Dfp_FrmMngSTAT_ANH_mp "Messpunkt fuer Fehlerpfad  Dfp_FrmMngSTAT_ANH" UWORD OneToOne 1 100 0.00 65535.00 FORMAT "%8.2" ECU_ADDRESS 0x8FD7DA /end MEASUREMENT
/begin MEASUREMENT Dfp_FrmMngSTAT_ARS_mp "STAT_ARS CAN12h-message related faults" UWORD OneToOne 1 100 0.00 65535.00 FORMAT "%8.2" ECU_ADDRESS 0x8FD7DC /end MEASUREMENT
/begin MEASUREMENT Dfp_FrmMngSTAT_DSC_mp "STAT_DSC CAN12h-message related faults" UWORD OneToOne 1 100 0.00 65535.00 FORMAT "%8.2" ECU_ADDRESS 0x8FD7DE /end MEASUREMENT
/begin MEASUREMENT Dfp_FrmMngSTAT_EKP_mp "Fehlerpfad für STAT_EKP" UWORD OneToOne 1 100 0.00 65535.00 FORMAT "%8.2" ECU_ADDRESS 0x8FD7E0 /end MEASUREMENT
/begin MEASUREMENT Dfp_FrmMngSTAT_KOMBI_mp "STAT_KOMBI - CAN-message related errors" UWORD OneToOne 1 100 0.00 65535.00 FORMAT "%8.2" ECU_ADDRESS 0x8FD7E2 /end MEASUREMENT
/begin MEASUREMENT Dfp_FrmMngSTAT_SITZ_mp "Defect fault path for STAT_SITZBELEGUNG_GURT - CAN-message related errors" UWORD OneToOne 1 100 0.00 65535.00 FORMAT "%8.2" ECU_ADDRESS 0x8FD7E4 /end MEASUREMENT
/begin MEASUREMENT Dfp_FrmMngstCurr_mp "Messpunkt für Dfp von FrmMng_stCurr Botschaft" UWORD OneToOne 1 100 0.00 65535.00 FORMAT "%8.2" ECU_ADDRESS 0x8FD7E6 /end MEASUREMENT
/begin MEASUREMENT Dfp_FrmMngStOBDGbxMilOf_mp "error path of Gear Box MIL OFF" UWORD OneToOne 1 100 0.00 65535.00 FORMAT "%8.2" ECU_ADDRESS 0x8FD7E8 /end MEASUREMENT
/begin MEASUREMENT Dfp_FrmMngStOBDGbxMilOn_mp "error path of Gear Box MIL ON" UWORD OneToOne 1 100 0.00 65535.00 FORMAT "%8.2" ECU_ADDRESS 0x8FD7EA /end MEASUREMENT
/begin MEASUREMENT Dfp_FrmMngswtPSPOff_mp "Messpunkt für Dfp von FrmMng_swtPSPOff Botschaft" UWORD OneToOne 1 100 0.00 65535.00 FORMAT "%8.2" ECU_ADDRESS 0x8FD7EC /end MEASUREMENT
/begin MEASUREMENT Dfp_FrmMngTEMPRELTIME_mp "A_TEMP_RELATIVZEIT - CAN-message related errors" UWORD OneToOne 1 100 0.00 65535.00 FORMAT "%8.2" ECU_ADDRESS 0x8FD7EE /end MEASUREMENT
/begin MEASUREMENT Dfp_FrmMngTERMINAL_mp "TERMINAL CAN12h-message related faults" UWORD OneToOne 1 100 0.00 65535.00 FORMAT "%8.2" ECU_ADDRESS 0x8FD7F0 /end MEASUREMENT
/begin MEASUREMENT Dfp_FrmMngTIME_DATE_mp "Messpunkt fuer Fehlerpfad  Dfp_FrmMngTIME_DATE" UWORD OneToOne 1 100 0.00 65535.00 FORMAT "%8.2" ECU_ADDRESS 0x8FD7F2 /end MEASUREMENT
/begin MEASUREMENT Dfp_FrmMngTORQUE_DSC_mp "TORQUE_DSC CAN12h-message related faults" UWORD OneToOne 1 100 0.00 65535.00 FORMAT "%8.2" ECU_ADDRESS 0x8FD7F4 /end MEASUREMENT
/begin MEASUREMENT Dfp_FrmMngTORQUE_GEARBX_mp "TORQUE_GEARBX CAN12h-message related faults" UWORD OneToOne 1 100 0.00 65535.00 FORMAT "%8.2" ECU_ADDRESS 0x8FD7F6 /end MEASUREMENT
/begin MEASUREMENT Dfp_FrmMngTrq_ReqACC_mp "Messpunkt fuer Fehlerpfad  Dfp_FrmMngTrq_ReqACC" UWORD OneToOne 1 100 0.00 65535.00 FORMAT "%8.2" ECU_ADDRESS 0x8FD7F8 /end MEASUREMENT
/begin MEASUREMENT Dfp_FrmMngVEH_MOD_mp "VEH_MOD - CAN-message related errors" UWORD OneToOne 1 100 0.00 65535.00 FORMAT "%8.2" ECU_ADDRESS 0x8FD7FA /end MEASUREMENT
/begin MEASUREMENT Dfp_FrmMngVELOCITY_mp "VELOCITY CAN12h-message related faults" UWORD OneToOne 1 100 0.00 65535.00 FORMAT "%8.2" ECU_ADDRESS 0x8FD7FC /end MEASUREMENT
/begin MEASUREMENT Dfp_FrmMngWHEEL_SPEED_mp "WHEEL_SPEED - CAN-message related errors" UWORD OneToOne 1 100 0.00 65535.00 FORMAT "%8.2" ECU_ADDRESS 0x8FD7FE /end MEASUREMENT
/begin MEASUREMENT Dfp_FTSCD_mp "Messpunkt fuer Fehlerpfad  Dfp_FTSCD" UWORD OneToOne 1 100 0.00 65535.00 FORMAT "%8.2" ECU_ADDRESS 0x8FD800 /end MEASUREMENT
/begin MEASUREMENT Dfp_GearbxIncMax_mp "Fehlerpfad  physikalische Unplausibilität des erhöhenden Getriebeeingriffs" UWORD OneToOne 1 100 0.00 65535.00 FORMAT "%8.2" ECU_ADDRESS 0x8FD802 /end MEASUREMENT
/begin MEASUREMENT Dfp_GlwCDGlwCirc1_mp "Messpunkt fuer Fehlerpfad  Dfp_GlwCDGlwCirc1" UWORD OneToOne 1 100 0.00 65535.00 FORMAT "%8.2" ECU_ADDRESS 0x8FD804 /end MEASUREMENT
/begin MEASUREMENT Dfp_GlwCDGlwCirc2_mp "Messpunkt fuer Fehlerpfad  Dfp_GlwCDGlwCirc2" UWORD OneToOne 1 100 0.00 65535.00 FORMAT "%8.2" ECU_ADDRESS 0x8FD806 /end MEASUREMENT
/begin MEASUREMENT Dfp_GlwCDGlwCirc3_mp "Messpunkt fuer Fehlerpfad  Dfp_GlwCDGlwCirc3" UWORD OneToOne 1 100 0.00 65535.00 FORMAT "%8.2" ECU_ADDRESS 0x8FD808 /end MEASUREMENT
/begin MEASUREMENT Dfp_GlwCDGlwCirc4_mp "Messpunkt fuer Fehlerpfad  Dfp_GlwCDGlwCirc4" UWORD OneToOne 1 100 0.00 65535.00 FORMAT "%8.2" ECU_ADDRESS 0x8FD80A /end MEASUREMENT
/begin MEASUREMENT Dfp_GlwCDGlwCirc5_mp "Messpunkt fuer Fehlerpfad  Dfp_GlwCDGlwCirc5" UWORD OneToOne 1 100 0.00 65535.00 FORMAT "%8.2" ECU_ADDRESS 0x8FD80C /end MEASUREMENT
/begin MEASUREMENT Dfp_GlwCDGlwCirc6_mp "Messpunkt fuer Fehlerpfad  Dfp_GlwCDGlwCirc6" UWORD OneToOne 1 100 0.00 65535.00 FORMAT "%8.2" ECU_ADDRESS 0x8FD80E /end MEASUREMENT
/begin MEASUREMENT Dfp_GlwCDGlwCirc7_mp "Messpunkt fuer Fehlerpfad  Dfp_GlwCDGlwCirc7" UWORD OneToOne 1 100 0.00 65535.00 FORMAT "%8.2" ECU_ADDRESS 0x8FD810 /end MEASUREMENT
/begin MEASUREMENT Dfp_GlwCDGlwCirc8_mp "Messpunkt fuer Fehlerpfad  Dfp_GlwCDGlwCirc8" UWORD OneToOne 1 100 0.00 65535.00 FORMAT "%8.2" ECU_ADDRESS 0x8FD812 /end MEASUREMENT
/begin MEASUREMENT Dfp_GlwCD_mp "Messpunkt fuer Fehlerpfad  Dfp_GlwCD" UWORD OneToOne 1 100 0.00 65535.00 FORMAT "%8.2" ECU_ADDRESS 0x8FD814 /end MEASUREMENT
/begin MEASUREMENT Dfp_GlwCtl_mp "Glüh-Steuerungs-Rückmeldungs-Fehler" UWORD OneToOne 1 100 0.00 65535.00 FORMAT "%8.2" ECU_ADDRESS 0x8FD816 /end MEASUREMENT
/begin MEASUREMENT Dfp_HWEMonCom_mp "Messpunkt fuer Fehlerpfad  Dfp_HWEMonCom" UWORD OneToOne 1 100 0.00 65535.00 FORMAT "%8.2" ECU_ADDRESS 0x8FD818 /end MEASUREMENT
/begin MEASUREMENT Dfp_HWEMonEEPROM_mp "Messpunkt fuer Fehlerpfad  Dfp_HWEMonEEPROM" UWORD OneToOne 1 100 0.00 65535.00 FORMAT "%8.2" ECU_ADDRESS 0x8FD81A /end MEASUREMENT
/begin MEASUREMENT Dfp_HWEMonRcyLocked_mp "Messpunkt fuer Fehlerpfad  Dfp_HWEMonRcyLocked" UWORD OneToOne 1 100 0.00 65535.00 FORMAT "%8.2" ECU_ADDRESS 0x8FD81C /end MEASUREMENT
/begin MEASUREMENT Dfp_HWEMonRcySuppressed_mp "Messpunkt fuer Fehlerpfad  Dfp_HWEMonRcySuppressed" UWORD OneToOne 1 100 0.00 65535.00 FORMAT "%8.2" ECU_ADDRESS 0x8FD81E /end MEASUREMENT
/begin MEASUREMENT Dfp_HWEMonRcyVisible_mp "Messpunkt fuer Fehlerpfad  Dfp_HWEMonRcyVisible" UWORD OneToOne 1 100 0.00 65535.00 FORMAT "%8.2" ECU_ADDRESS 0x8FD820 /end MEASUREMENT
/begin MEASUREMENT Dfp_HWEMonUMaxSupply_mp "Messpunkt fuer Fehlerpfad  Dfp_HWEMonUMaxSupply" UWORD OneToOne 1 100 0.00 65535.00 FORMAT "%8.2" ECU_ADDRESS 0x8FD822 /end MEASUREMENT
/begin MEASUREMENT Dfp_HWEMonUMinSupply_mp "Messpunkt fuer Fehlerpfad  Dfp_HWEMonUMinSupply" UWORD OneToOne 1 100 0.00 65535.00 FORMAT "%8.2" ECU_ADDRESS 0x8FD824 /end MEASUREMENT
/begin MEASUREMENT Dfp_IATSCD_CATSSec_mp "SRC Fehler zweiter Ansauglufttemperatursensor" UWORD OneToOne 1 100 0.00 65535.00 FORMAT "%8.2" ECU_ADDRESS 0x8FD826 /end MEASUREMENT
/begin MEASUREMENT Dfp_IATSCD_CATS_mp "Fehlerpfad Ladelufttemperaturwert nach Ladeluftkühler" UWORD OneToOne 1 100 0.00 65535.00 FORMAT "%8.2" ECU_ADDRESS 0x8FD828 /end MEASUREMENT
/begin MEASUREMENT Dfp_IATSCD_mp "Messpunkt fuer Fehlerpfad  Dfp_IATSCD" UWORD OneToOne 1 100 0.00 65535.00 FORMAT "%8.2" ECU_ADDRESS 0x8FD82A /end MEASUREMENT
/begin MEASUREMENT Dfp_ImmCtlImmCD_mp "Messpunkt fuer Fehlerpfad  Dfp_ImmCtlImmCD" UWORD OneToOne 1 100 0.00 65535.00 FORMAT "%8.2" ECU_ADDRESS 0x8FD82C /end MEASUREMENT
/begin MEASUREMENT Dfp_ImmCtlImmEep_mp "Messpunkt fuer Fehlerpfad  Dfp_ImmCtlImmEep" UWORD OneToOne 1 100 0.00 65535.00 FORMAT "%8.2" ECU_ADDRESS 0x8FD82E /end MEASUREMENT
/begin MEASUREMENT Dfp_ImmCtlMpl_mp "Messpunkt fuer Fehlerpfad  Dfp_ImmCtlMpl" UWORD OneToOne 1 100 0.00 65535.00 FORMAT "%8.2" ECU_ADDRESS 0x8FD830 /end MEASUREMENT
/begin MEASUREMENT Dfp_IndSys1_mp "IndSys1 defect path" UWORD OneToOne 1 100 0.00 65535.00 FORMAT "%8.2" ECU_ADDRESS 0x8FD832 /end MEASUREMENT
/begin MEASUREMENT Dfp_IndSys2_mp "IndSys2 defect path" UWORD OneToOne 1 100 0.00 65535.00 FORMAT "%8.2" ECU_ADDRESS 0x8FD834 /end MEASUREMENT
/begin MEASUREMENT Dfp_InjCrv_InjLim_mp "Messpunkt fuer Fehlerpfad Dfp_InjCrv_InjLim" UWORD OneToOne 1 100 0.00 65535.00 FORMAT "%8.2" ECU_ADDRESS 0x8FD836 /end MEASUREMENT
/begin MEASUREMENT Dfp_InjCtlAdjQnt_mp "Messpunkt fuer Fehlerpfad  Dfp_InjCtlAdjQnt" UWORD OneToOne 1 100 0.00 65535.00 FORMAT "%8.2" ECU_ADDRESS 0x8FD838 /end MEASUREMENT
/begin MEASUREMENT Dfp_InjCtlDrift_mp "Messpunkt fuer Fehlerpfad  Dfp_InjCtlDrift" UWORD OneToOne 1 100 0.00 65535.00 FORMAT "%8.2" ECU_ADDRESS 0x8FD83A /end MEASUREMENT
/begin MEASUREMENT Dfp_InjVCDActrChrg_mp "Messpunkt fuer Fehlerpfad  Dfp_InjVCDActrChrg" UWORD OneToOne 1 100 0.00 65535.00 FORMAT "%8.2" ECU_ADDRESS 0x8FD83C /end MEASUREMENT
/begin MEASUREMENT Dfp_InjVCDActrEnrg1_mp "Messpunkt fuer Fehlerpfad  Dfp_InjVCDActrEnrg1" UWORD OneToOne 1 100 0.00 65535.00 FORMAT "%8.2" ECU_ADDRESS 0x8FD83E /end MEASUREMENT
/begin MEASUREMENT Dfp_InjVCDActrEnrg2_mp "Messpunkt fuer Fehlerpfad  Dfp_InjVCDActrEnrg2" UWORD OneToOne 1 100 0.00 65535.00 FORMAT "%8.2" ECU_ADDRESS 0x8FD840 /end MEASUREMENT
/begin MEASUREMENT Dfp_InjVCDActrEnrg3_mp "Messpunkt fuer Fehlerpfad  Dfp_InjVCDActrEnrg3" UWORD OneToOne 1 100 0.00 65535.00 FORMAT "%8.2" ECU_ADDRESS 0x8FD842 /end MEASUREMENT
/begin MEASUREMENT Dfp_InjVCDActrEnrg4_mp "Messpunkt fuer Fehlerpfad  Dfp_InjVCDActrEnrg4" UWORD OneToOne 1 100 0.00 65535.00 FORMAT "%8.2" ECU_ADDRESS 0x8FD844 /end MEASUREMENT
/begin MEASUREMENT Dfp_InjVCDActrEnrg5_mp "Messpunkt fuer Fehlerpfad  Dfp_InjVCDActrEnrg5" UWORD OneToOne 1 100 0.00 65535.00 FORMAT "%8.2" ECU_ADDRESS 0x8FD846 /end MEASUREMENT
/begin MEASUREMENT Dfp_InjVCDActrEnrg6_mp "Messpunkt fuer Fehlerpfad  Dfp_InjVCDActrEnrg6" UWORD OneToOne 1 100 0.00 65535.00 FORMAT "%8.2" ECU_ADDRESS 0x8FD848 /end MEASUREMENT
/begin MEASUREMENT Dfp_InjVCDActrEnrg7_mp "Messpunkt fuer Fehlerpfad  Dfp_InjVCDActrEnrg7" UWORD OneToOne 1 100 0.00 65535.00 FORMAT "%8.2" ECU_ADDRESS 0x8FD84A /end MEASUREMENT
/begin MEASUREMENT Dfp_InjVCDActrEnrg8_mp "Messpunkt fuer Fehlerpfad  Dfp_InjVCDActrEnrg8" UWORD OneToOne 1 100 0.00 65535.00 FORMAT "%8.2" ECU_ADDRESS 0x8FD84C /end MEASUREMENT
/begin MEASUREMENT Dfp_InjVCDActrVolt_mp "Messpunkt fuer Fehlerpfad  Dfp_InjVCDActrVolt" UWORD OneToOne 1 100 0.00 65535.00 FORMAT "%8.2" ECU_ADDRESS 0x8FD84E /end MEASUREMENT
/begin MEASUREMENT Dfp_InjVCDClsBank1_mp "Messpunkt fuer Fehlerpfad  Dfp_InjVCDClsBank1" UWORD OneToOne 1 100 0.00 65535.00 FORMAT "%8.2" ECU_ADDRESS 0x8FD850 /end MEASUREMENT
/begin MEASUREMENT Dfp_InjVCDClsBank2_mp "Messpunkt fuer Fehlerpfad  Dfp_InjVCDClsBank2" UWORD OneToOne 1 100 0.00 65535.00 FORMAT "%8.2" ECU_ADDRESS 0x8FD852 /end MEASUREMENT
/begin MEASUREMENT Dfp_InjVCDMonCab_mp "Messpunkt fuer Fehlerpfad  Dfp_InjVCDMonCab" UWORD OneToOne 1 100 0.00 65535.00 FORMAT "%8.2" ECU_ADDRESS 0x8FD854 /end MEASUREMENT
/begin MEASUREMENT Dfp_InjVCDMonSwt_mp "Messpunkt fuer Fehlerpfad  Dfp_InjVCDMonSwt" UWORD OneToOne 1 100 0.00 65535.00 FORMAT "%8.2" ECU_ADDRESS 0x8FD856 /end MEASUREMENT
/begin MEASUREMENT Dfp_InjVCDShOffDCDC_mp "Fehlerpfad ""Ladeschalterkurzschluss""" UWORD OneToOne 1 100 0.00 65535.00 FORMAT "%8.2" ECU_ADDRESS 0x8FD858 /end MEASUREMENT
/begin MEASUREMENT Dfp_InjVCDUBuf1_mp "Messpunkt fuer Fehlerpfad  Dfp_InjVCDUBuf1" UWORD OneToOne 1 100 0.00 65535.00 FORMAT "%8.2" ECU_ADDRESS 0x8FD85A /end MEASUREMENT
/begin MEASUREMENT Dfp_InjVCDUBuf2_mp "Messpunkt fuer Fehlerpfad  Dfp_InjVCDUBuf2" UWORD OneToOne 1 100 0.00 65535.00 FORMAT "%8.2" ECU_ADDRESS 0x8FD85C /end MEASUREMENT
/begin MEASUREMENT Dfp_InjVCD_CY370Ampl_mp "Fehlerpfad für Verstärkerabgleich vom CY370" UWORD OneToOne 1 100 0.00 65535.00 FORMAT "%8.2" ECU_ADDRESS 0x8FD85E /end MEASUREMENT
/begin MEASUREMENT Dfp_InjVCD_DrvTimeRcy_mp "CY370 Drive Time Recovery aufgetreten" UWORD OneToOne 1 100 0.00 65535.00 FORMAT "%8.2" ECU_ADDRESS 0x8FD860 /end MEASUREMENT
/begin MEASUREMENT Dfp_InjVCD_DrvTime_mp "CY370 Drivetime Fehler aufgetreten" UWORD OneToOne 1 100 0.00 65535.00 FORMAT "%8.2" ECU_ADDRESS 0x8FD862 /end MEASUREMENT
/begin MEASUREMENT Dfp_InjVCD_TPUErr_mp "Fehlerpfad: TPU Fehler" UWORD OneToOne 1 100 0.00 65535.00 FORMAT "%8.2" ECU_ADDRESS 0x8FD864 /end MEASUREMENT
/begin MEASUREMENT Dfp_InjVlvBnk1A_mp "Magnetventilfehler an allen Magentventilen der Bank 1A" UWORD OneToOne 1 100 0.00 65535.00 FORMAT "%8.2" ECU_ADDRESS 0x8FD866 /end MEASUREMENT
/begin MEASUREMENT Dfp_InjVlvBnk1B_mp "B Fehlerpfad für Bank 1" UWORD OneToOne 1 100 0.00 65535.00 FORMAT "%8.2" ECU_ADDRESS 0x8FD868 /end MEASUREMENT
/begin MEASUREMENT Dfp_InjVlvBnk2A_mp "Magnetventilfehler an allen Magentventilen der Bank 2A" UWORD OneToOne 1 100 0.00 65535.00 FORMAT "%8.2" ECU_ADDRESS 0x8FD86A /end MEASUREMENT
/begin MEASUREMENT Dfp_InjVlvBnk2B_mp "B Fehlerpfad für Bank 2" UWORD OneToOne 1 100 0.00 65535.00 FORMAT "%8.2" ECU_ADDRESS 0x8FD86C /end MEASUREMENT
/begin MEASUREMENT Dfp_InjVlvChipA_mp "A Fehlerpfad  für Baustein" UWORD OneToOne 1 100 0.00 65535.00 FORMAT "%8.2" ECU_ADDRESS 0x8FD86E /end MEASUREMENT
/begin MEASUREMENT Dfp_InjVlvChipB_mp "B Fehlerpfad für Baustein" UWORD OneToOne 1 100 0.00 65535.00 FORMAT "%8.2" ECU_ADDRESS 0x8FD870 /end MEASUREMENT
/begin MEASUREMENT Dfp_InjVlvCyl1A_mp "Einspritzventilfehler A für Zylinder 1" UWORD OneToOne 1 100 0.00 65535.00 FORMAT "%8.2" ECU_ADDRESS 0x8FD872 /end MEASUREMENT
/begin MEASUREMENT Dfp_InjVlvCyl1B_mp "Einspritzventilfehler B für Zylinder 1" UWORD OneToOne 1 100 0.00 65535.00 FORMAT "%8.2" ECU_ADDRESS 0x8FD874 /end MEASUREMENT
/begin MEASUREMENT Dfp_InjVlvCyl1C_mp "Einspritzventilfehler C für Zylinder 1" UWORD OneToOne 1 100 0.00 65535.00 FORMAT "%8.2" ECU_ADDRESS 0x8FD876 /end MEASUREMENT
/begin MEASUREMENT Dfp_InjVlvCyl2A_mp "Einspritzventilfehler A für Zylinder 2" UWORD OneToOne 1 100 0.00 65535.00 FORMAT "%8.2" ECU_ADDRESS 0x8FD878 /end MEASUREMENT
/begin MEASUREMENT Dfp_InjVlvCyl2B_mp "Einspritzventilfehler B für Zylinder 2" UWORD OneToOne 1 100 0.00 65535.00 FORMAT "%8.2" ECU_ADDRESS 0x8FD87A /end MEASUREMENT
/begin MEASUREMENT Dfp_InjVlvCyl2C_mp "Einspritzventilfehler C für Zylinder 2" UWORD OneToOne 1 100 0.00 65535.00 FORMAT "%8.2" ECU_ADDRESS 0x8FD87C /end MEASUREMENT
/begin MEASUREMENT Dfp_InjVlvCyl3A_mp "Einspritzventilfehler A für Zylinder 3" UWORD OneToOne 1 100 0.00 65535.00 FORMAT "%8.2" ECU_ADDRESS 0x8FD87E /end MEASUREMENT
/begin MEASUREMENT Dfp_InjVlvCyl3B_mp "Einspritzventilfehler B für Zylinder 3" UWORD OneToOne 1 100 0.00 65535.00 FORMAT "%8.2" ECU_ADDRESS 0x8FD880 /end MEASUREMENT
/begin MEASUREMENT Dfp_InjVlvCyl3C_mp "Einspritzventilfehler C für Zylinder 3" UWORD OneToOne 1 100 0.00 65535.00 FORMAT "%8.2" ECU_ADDRESS 0x8FD882 /end MEASUREMENT
/begin MEASUREMENT Dfp_InjVlvCyl4A_mp "Einspritzventilfehler A für Zylinder 4" UWORD OneToOne 1 100 0.00 65535.00 FORMAT "%8.2" ECU_ADDRESS 0x8FD884 /end MEASUREMENT
/begin MEASUREMENT Dfp_InjVlvCyl4B_mp "Einspritzventilfehler B für Zylinder 4" UWORD OneToOne 1 100 0.00 65535.00 FORMAT "%8.2" ECU_ADDRESS 0x8FD886 /end MEASUREMENT
/begin MEASUREMENT Dfp_InjVlvCyl4C_mp "Einspritzventilfehler C für Zylinder 4" UWORD OneToOne 1 100 0.00 65535.00 FORMAT "%8.2" ECU_ADDRESS 0x8FD888 /end MEASUREMENT
/begin MEASUREMENT Dfp_InjVlvCyl5A_mp "Einspritzventilfehler A für Zylinder 5" UWORD OneToOne 1 100 0.00 65535.00 FORMAT "%8.2" ECU_ADDRESS 0x8FD88A /end MEASUREMENT
/begin MEASUREMENT Dfp_InjVlvCyl5B_mp "Einspritzventilfehler B für Zylinder 5" UWORD OneToOne 1 100 0.00 65535.00 FORMAT "%8.2" ECU_ADDRESS 0x8FD88C /end MEASUREMENT
/begin MEASUREMENT Dfp_InjVlvCyl5C_mp "Einspritzventilfehler C für Zylinder 5" UWORD OneToOne 1 100 0.00 65535.00 FORMAT "%8.2" ECU_ADDRESS 0x8FD88E /end MEASUREMENT
/begin MEASUREMENT Dfp_InjVlvCyl6A_mp "Einspritzventilfehler A für Zylinder 6" UWORD OneToOne 1 100 0.00 65535.00 FORMAT "%8.2" ECU_ADDRESS 0x8FD890 /end MEASUREMENT
/begin MEASUREMENT Dfp_InjVlvCyl6B_mp "Einspritzventilfehler B für Zylinder 6" UWORD OneToOne 1 100 0.00 65535.00 FORMAT "%8.2" ECU_ADDRESS 0x8FD892 /end MEASUREMENT
/begin MEASUREMENT Dfp_InjVlvCyl6C_mp "Einspritzventilfehler C für Zylinder 6" UWORD OneToOne 1 100 0.00 65535.00 FORMAT "%8.2" ECU_ADDRESS 0x8FD894 /end MEASUREMENT
/begin MEASUREMENT Dfp_InjVlvCyl7A_mp "Einspritzventilfehler A für Zylinder 7" UWORD OneToOne 1 100 0.00 65535.00 FORMAT "%8.2" ECU_ADDRESS 0x8FD896 /end MEASUREMENT
/begin MEASUREMENT Dfp_InjVlvCyl7B_mp "Einspritzventilfehler B für Zylinder 7" UWORD OneToOne 1 100 0.00 65535.00 FORMAT "%8.2" ECU_ADDRESS 0x8FD898 /end MEASUREMENT
/begin MEASUREMENT Dfp_InjVlvCyl7C_mp "Einspritzventilfehler C für Zylinder 7" UWORD OneToOne 1 100 0.00 65535.00 FORMAT "%8.2" ECU_ADDRESS 0x8FD89A /end MEASUREMENT
/begin MEASUREMENT Dfp_InjVlvCyl8A_mp "Einspritzventilfehler A für Zylinder 8" UWORD OneToOne 1 100 0.00 65535.00 FORMAT "%8.2" ECU_ADDRESS 0x8FD89C /end MEASUREMENT
/begin MEASUREMENT Dfp_InjVlvCyl8B_mp "Einspritzventilfehler B für Zylinder 8" UWORD OneToOne 1 100 0.00 65535.00 FORMAT "%8.2" ECU_ADDRESS 0x8FD89E /end MEASUREMENT
/begin MEASUREMENT Dfp_InjVlvCyl8C_mp "Einspritzventilfehler C für Zylinder 8" UWORD OneToOne 1 100 0.00 65535.00 FORMAT "%8.2" ECU_ADDRESS 0x8FD8A0 /end MEASUREMENT
/begin MEASUREMENT Dfp_InjVlvNVC1_mp "Messpunkt für Fehlerpfad Dfp_InjVlvNVC1" UWORD OneToOne 1 100 0.00 65535.00 FORMAT "%8.2" ECU_ADDRESS 0x8FD8A2 /end MEASUREMENT
/begin MEASUREMENT Dfp_InjVlvNVC2_mp "Messpunkt für Fehlerpfad Dfp_InjVlvNVC2" UWORD OneToOne 1 100 0.00 65535.00 FORMAT "%8.2" ECU_ADDRESS 0x8FD8A4 /end MEASUREMENT
/begin MEASUREMENT Dfp_InjVlvNVC3_mp "Messpunkt für Fehlerpfad Dfp_InjVlvNVC3" UWORD OneToOne 1 100 0.00 65535.00 FORMAT "%8.2" ECU_ADDRESS 0x8FD8A6 /end MEASUREMENT
/begin MEASUREMENT Dfp_InjVlvNVC4_mp "Messpunkt für Fehlerpfad Dfp_InjVlvNVC4" UWORD OneToOne 1 100 0.00 65535.00 FORMAT "%8.2" ECU_ADDRESS 0x8FD8A8 /end MEASUREMENT
/begin MEASUREMENT Dfp_InjVlvNVC5_mp "Messpunkt für Fehlerpfad Dfp_InjVlvNVC5" UWORD OneToOne 1 100 0.00 65535.00 FORMAT "%8.2" ECU_ADDRESS 0x8FD8AA /end MEASUREMENT
/begin MEASUREMENT Dfp_InjVlvNVC6_mp "Messpunkt für Fehlerpfad Dfp_InjVlvNVC6" UWORD OneToOne 1 100 0.00 65535.00 FORMAT "%8.2" ECU_ADDRESS 0x8FD8AC /end MEASUREMENT
/begin MEASUREMENT Dfp_InjVlvNVC7_mp "Messpunkt für Fehlerpfad Dfp_InjVlvNVC7" UWORD OneToOne 1 100 0.00 65535.00 FORMAT "%8.2" ECU_ADDRESS 0x8FD8AE /end MEASUREMENT
/begin MEASUREMENT Dfp_InjVlvNVC8_mp "Messpunkt für Fehlerpfad Dfp_InjVlvNVC8" UWORD OneToOne 1 100 0.00 65535.00 FORMAT "%8.2" ECU_ADDRESS 0x8FD8B0 /end MEASUREMENT
/begin MEASUREMENT Dfp_KeyCheck_mp "" UWORD OneToOne 1 100 0.00 65535.00 FORMAT "%8.2" ECU_ADDRESS 0x8FD8B2 /end MEASUREMENT
/begin MEASUREMENT Dfp_Layer_BSD_mp "Messpunkt fuer Fehlerpfad  Dfp_Layer_BSD" UWORD OneToOne 1 100 0.00 65535.00 FORMAT "%8.2" ECU_ADDRESS 0x8FD8B4 /end MEASUREMENT
/begin MEASUREMENT Dfp_Layer_GEN_mp "Messpunkt fuer Fehlerpfad  Dfp_Layer_GEN" UWORD OneToOne 1 100 0.00 65535.00 FORMAT "%8.2" ECU_ADDRESS 0x8FD8B6 /end MEASUREMENT
/begin MEASUREMENT Dfp_Layer_IBS1_mp "Messpunkt fuer Fehlerpfad  Dfp_Layer_IBS1" UWORD OneToOne 1 100 0.00 65535.00 FORMAT "%8.2" ECU_ADDRESS 0x8FD8B8 /end MEASUREMENT
/begin MEASUREMENT Dfp_Layer_IBS2_mp "Messpunkt fuer Fehlerpfad  Dfp_Layer_IBS2" UWORD OneToOne 1 100 0.00 65535.00 FORMAT "%8.2" ECU_ADDRESS 0x8FD8BA /end MEASUREMENT
/begin MEASUREMENT Dfp_Layer_IBS3_mp "Messpunkt fuer Fehlerpfad  Dfp_Layer_IBS3" UWORD OneToOne 1 100 0.00 65535.00 FORMAT "%8.2" ECU_ADDRESS 0x8FD8BC /end MEASUREMENT
/begin MEASUREMENT Dfp_Layer_MANHYDR_mp "Messpunkt fuer Fehlerpfad  Dfp_Layer_MANHYDR" UWORD OneToOne 1 100 0.00 65535.00 FORMAT "%8.2" ECU_ADDRESS 0x8FD8BE /end MEASUREMENT
/begin MEASUREMENT Dfp_Layer_MANLUFT_mp "Messpunkt fuer Fehlerpfad  Dfp_Layer_MANLUFT" UWORD OneToOne 1 100 0.00 65535.00 FORMAT "%8.2" ECU_ADDRESS 0x8FD8C0 /end MEASUREMENT
/begin MEASUREMENT Dfp_Layer_PMBATT_mp "Messpunkt fuer Fehlerpfad  Dfp_Layer_PMBATT" UWORD OneToOne 1 100 0.00 65535.00 FORMAT "%8.2" ECU_ADDRESS 0x8FD8C2 /end MEASUREMENT
/begin MEASUREMENT Dfp_Layer_PMBN_mp "Messpunkt fuer Fehlerpfad  Dfp_Layer_PMBN" UWORD OneToOne 1 100 0.00 65535.00 FORMAT "%8.2" ECU_ADDRESS 0x8FD8C4 /end MEASUREMENT
/begin MEASUREMENT Dfp_Layer_PMRUHVERL_mp "Messpunkt fuer Fehlerpfad  Dfp_Layer_PMRUHVERL" UWORD OneToOne 1 100 0.00 65535.00 FORMAT "%8.2" ECU_ADDRESS 0x8FD8C6 /end MEASUREMENT
/begin MEASUREMENT Dfp_Layer_QLT_mp "Messpunkt fuer Fehlerpfad  Dfp_Layer_QLT" UWORD OneToOne 1 100 0.00 65535.00 FORMAT "%8.2" ECU_ADDRESS 0x8FD8C8 /end MEASUREMENT
/begin MEASUREMENT Dfp_Layer_TANS_mp "Messpunkt fuer Fehlerpfad  Dfp_Layer_TANS" UWORD OneToOne 1 100 0.00 65535.00 FORMAT "%8.2" ECU_ADDRESS 0x8FD8CA /end MEASUREMENT
/begin MEASUREMENT Dfp_Layer_TOENS_mp "Messpunkt fuer Fehlerpfad  Dfp_Layer_TOENS" UWORD OneToOne 1 100 0.00 65535.00 FORMAT "%8.2" ECU_ADDRESS 0x8FD8CC /end MEASUREMENT
/begin MEASUREMENT Dfp_Layer_TUMG_mp "Messpunkt fuer Fehlerpfad  Dfp_Layer_TUMG" UWORD OneToOne 1 100 0.00 65535.00 FORMAT "%8.2" ECU_ADDRESS 0x8FD8CE /end MEASUREMENT
/begin MEASUREMENT Dfp_LIGovECUTransMode_mp "" UWORD OneToOne 1 100 0.00 65535.00 FORMAT "%8.2" ECU_ADDRESS 0x8FD8D0 /end MEASUREMENT
/begin MEASUREMENT Dfp_LPACD_Max_mp "Messpunkt fuer Fehlerpfad  Dfp_LPACD_Max" UWORD OneToOne 1 100 0.00 65535.00 FORMAT "%8.2" ECU_ADDRESS 0x8FD8D2 /end MEASUREMENT
/begin MEASUREMENT Dfp_LPACD_Min_mp "Messpunkt fuer Fehlerpfad  Dfp_LPACD_Min" UWORD OneToOne 1 100 0.00 65535.00 FORMAT "%8.2" ECU_ADDRESS 0x8FD8D4 /end MEASUREMENT
/begin MEASUREMENT Dfp_LPACD_SigNpl_mp "Messpunkt fuer Fehlerpfad  Dfp_LPACD_SigNpl" UWORD OneToOne 1 100 0.00 65535.00 FORMAT "%8.2" ECU_ADDRESS 0x8FD8D6 /end MEASUREMENT
/begin MEASUREMENT Dfp_LSUCDCircNernst0B1_mp "" UWORD OneToOne 1 100 0.00 65535.00 FORMAT "%8.2" ECU_ADDRESS 0x8FD8D8 /end MEASUREMENT
/begin MEASUREMENT Dfp_LSUCDCircNernst0B2_mp "" UWORD OneToOne 1 100 0.00 65535.00 FORMAT "%8.2" ECU_ADDRESS 0x8FD8DA /end MEASUREMENT
/begin MEASUREMENT Dfp_LSUCDCircPumpCur0B1_mp "" UWORD OneToOne 1 100 0.00 65535.00 FORMAT "%8.2" ECU_ADDRESS 0x8FD8DC /end MEASUREMENT
/begin MEASUREMENT Dfp_LSUCDCircPumpCur0B2_mp "" UWORD OneToOne 1 100 0.00 65535.00 FORMAT "%8.2" ECU_ADDRESS 0x8FD8DE /end MEASUREMENT
/begin MEASUREMENT Dfp_LSUCDCircVirtGnd0B1_mp "" UWORD OneToOne 1 100 0.00 65535.00 FORMAT "%8.2" ECU_ADDRESS 0x8FD8E0 /end MEASUREMENT
/begin MEASUREMENT Dfp_LSUCDCircVirtGnd0B2_mp "" UWORD OneToOne 1 100 0.00 65535.00 FORMAT "%8.2" ECU_ADDRESS 0x8FD8E2 /end MEASUREMENT
/begin MEASUREMENT Dfp_LSUCDHeater0B1_mp "" UWORD OneToOne 1 100 0.00 65535.00 FORMAT "%8.2" ECU_ADDRESS 0x8FD8E4 /end MEASUREMENT
/begin MEASUREMENT Dfp_LSUCDHeater0B2_mp "" UWORD OneToOne 1 100 0.00 65535.00 FORMAT "%8.2" ECU_ADDRESS 0x8FD8E6 /end MEASUREMENT
/begin MEASUREMENT Dfp_LSUCDHtCoup0B1_mp "" UWORD OneToOne 1 100 0.00 65535.00 FORMAT "%8.2" ECU_ADDRESS 0x8FD8E8 /end MEASUREMENT
/begin MEASUREMENT Dfp_LSUCDHtCoup0B2_mp "" UWORD OneToOne 1 100 0.00 65535.00 FORMAT "%8.2" ECU_ADDRESS 0x8FD8EA /end MEASUREMENT
/begin MEASUREMENT Dfp_LSUCDO20B1_mp "" UWORD OneToOne 1 100 0.00 65535.00 FORMAT "%8.2" ECU_ADDRESS 0x8FD8EC /end MEASUREMENT
/begin MEASUREMENT Dfp_LSUCDO20B2_mp "" UWORD OneToOne 1 100 0.00 65535.00 FORMAT "%8.2" ECU_ADDRESS 0x8FD8EE /end MEASUREMENT
/begin MEASUREMENT Dfp_LSUCDO2Clb0B1_mp "" UWORD OneToOne 1 100 0.00 65535.00 FORMAT "%8.2" ECU_ADDRESS 0x8FD8F0 /end MEASUREMENT
/begin MEASUREMENT Dfp_LSUCDO2Clb0B2_mp "" UWORD OneToOne 1 100 0.00 65535.00 FORMAT "%8.2" ECU_ADDRESS 0x8FD8F2 /end MEASUREMENT
/begin MEASUREMENT Dfp_LSUCDRiClb0B1_mp "" UWORD OneToOne 1 100 0.00 65535.00 FORMAT "%8.2" ECU_ADDRESS 0x8FD8F4 /end MEASUREMENT
/begin MEASUREMENT Dfp_LSUCDRiClb0B2_mp "" UWORD OneToOne 1 100 0.00 65535.00 FORMAT "%8.2" ECU_ADDRESS 0x8FD8F6 /end MEASUREMENT
/begin MEASUREMENT Dfp_LSUCDSPI0B1_mp "" UWORD OneToOne 1 100 0.00 65535.00 FORMAT "%8.2" ECU_ADDRESS 0x8FD8F8 /end MEASUREMENT
/begin MEASUREMENT Dfp_LSUCDSPI0B2_mp "" UWORD OneToOne 1 100 0.00 65535.00 FORMAT "%8.2" ECU_ADDRESS 0x8FD8FA /end MEASUREMENT
/begin MEASUREMENT Dfp_LSUCDSPIBattLow0B1_mp "" UWORD OneToOne 1 100 0.00 65535.00 FORMAT "%8.2" ECU_ADDRESS 0x8FD8FC /end MEASUREMENT
/begin MEASUREMENT Dfp_LSUCDSPIBattLow0B2_mp "" UWORD OneToOne 1 100 0.00 65535.00 FORMAT "%8.2" ECU_ADDRESS 0x8FD8FE /end MEASUREMENT
/begin MEASUREMENT Dfp_LSUCDWireIP0B1_mp "" UWORD OneToOne 1 100 0.00 65535.00 FORMAT "%8.2" ECU_ADDRESS 0x8FD900 /end MEASUREMENT
/begin MEASUREMENT Dfp_LSUCDWireIP0B2_mp "" UWORD OneToOne 1 100 0.00 65535.00 FORMAT "%8.2" ECU_ADDRESS 0x8FD902 /end MEASUREMENT
/begin MEASUREMENT Dfp_LSUCtlRiExc0B1_mp "" UWORD OneToOne 1 100 0.00 65535.00 FORMAT "%8.2" ECU_ADDRESS 0x8FD904 /end MEASUREMENT
/begin MEASUREMENT Dfp_LSUCtlRiExc0B2_mp "" UWORD OneToOne 1 100 0.00 65535.00 FORMAT "%8.2" ECU_ADDRESS 0x8FD906 /end MEASUREMENT
/begin MEASUREMENT Dfp_LSUMon1SensB1_mp "" UWORD OneToOne 1 100 0.00 65535.00 FORMAT "%8.2" ECU_ADDRESS 0x8FD908 /end MEASUREMENT
/begin MEASUREMENT Dfp_LSUMon1SensB2_mp "" UWORD OneToOne 1 100 0.00 65535.00 FORMAT "%8.2" ECU_ADDRESS 0x8FD90A /end MEASUREMENT
/begin MEASUREMENT Dfp_LSUMon2SensB1_mp "" UWORD OneToOne 1 100 0.00 65535.00 FORMAT "%8.2" ECU_ADDRESS 0x8FD90C /end MEASUREMENT
/begin MEASUREMENT Dfp_LSUMon2SensB2_mp "" UWORD OneToOne 1 100 0.00 65535.00 FORMAT "%8.2" ECU_ADDRESS 0x8FD90E /end MEASUREMENT
/begin MEASUREMENT Dfp_MeUnCDNoLoad_mp "Fehlerpfad für Lastabfall der Zumesseinheit" UWORD OneToOne 1 100 0.00 65535.00 FORMAT "%8.2" ECU_ADDRESS 0x8FD910 /end MEASUREMENT
/begin MEASUREMENT Dfp_MeUnCDSCBat_mp "Fehlerpfad für Kurzschluss zur Batteriespannung der Zumesseinheit" UWORD OneToOne 1 100 0.00 65535.00 FORMAT "%8.2" ECU_ADDRESS 0x8FD912 /end MEASUREMENT
/begin MEASUREMENT Dfp_MeUnCDSCGnd_mp "Fehlerpfad für Kurzschluss nach Masse der Zumesseinheit" UWORD OneToOne 1 100 0.00 65535.00 FORMAT "%8.2" ECU_ADDRESS 0x8FD914 /end MEASUREMENT
/begin MEASUREMENT Dfp_MeUnCD_ADC_mp "Fehlerpfad für die Signalerfassung des Stroms durch die Zumesseinheit" UWORD OneToOne 1 100 0.00 65535.00 FORMAT "%8.2" ECU_ADDRESS 0x8FD916 /end MEASUREMENT
/begin MEASUREMENT Dfp_MeUnCD_SigTst_mp "Messpunkt fuer Fehlerpfad  Dfp_MeUnCD_SigTst" UWORD OneToOne 1 100 0.00 65535.00 FORMAT "%8.2" ECU_ADDRESS 0x8FD918 /end MEASUREMENT
/begin MEASUREMENT Dfp_MIL_mp "Messpunkt fuer Fehlerpfad  Dfp_MIL" UWORD OneToOne 1 100 0.00 65535.00 FORMAT "%8.2" ECU_ADDRESS 0x8FD91A /end MEASUREMENT
/begin MEASUREMENT Dfp_Montr_mp "Messpunkt fuer Fehlerpfad  Dfp_Montr" UWORD OneToOne 1 100 0.00 65535.00 FORMAT "%8.2" ECU_ADDRESS 0x8FD91C /end MEASUREMENT
/begin MEASUREMENT Dfp_MRlyCD_mp "Messpunkt fuer Fehlerpfad  Dfp_MRlyCD" UWORD OneToOne 1 100 0.00 65535.00 FORMAT "%8.2" ECU_ADDRESS 0x8FD91E /end MEASUREMENT
/begin MEASUREMENT Dfp_MSidCD_Comm_mp "Messpunkt fuer Fehlerpfad  Dfp_MSidCD_Comm" UWORD OneToOne 1 100 0.00 65535.00 FORMAT "%8.2" ECU_ADDRESS 0x8FD920 /end MEASUREMENT
/begin MEASUREMENT Dfp_MSidCD_EcuMixed_mp "Messpunkt fuer Fehlerpfad  Dfp_MSidCD_EcuMixed" UWORD OneToOne 1 100 0.00 65535.00 FORMAT "%8.2" ECU_ADDRESS 0x8FD922 /end MEASUREMENT
/begin MEASUREMENT Dfp_MSidCD_Pin_mp "Messpunkt fuer Fehlerpfad  Dfp_MSidCD_Pin" UWORD OneToOne 1 100 0.00 65535.00 FORMAT "%8.2" ECU_ADDRESS 0x8FD924 /end MEASUREMENT
/begin MEASUREMENT Dfp_MSidCD_Select_mp "Messpunkt fuer Fehlerpfad  Dfp_MSidCD_Select" UWORD OneToOne 1 100 0.00 65535.00 FORMAT "%8.2" ECU_ADDRESS 0x8FD926 /end MEASUREMENT
/begin MEASUREMENT Dfp_MSidCD_Sel_INI_mp "Messpunkt fuer Fehlerpfad  Dfp_MSidCD_Sel_INI" UWORD OneToOne 1 100 0.00 65535.00 FORMAT "%8.2" ECU_ADDRESS 0x8FD928 /end MEASUREMENT
/begin MEASUREMENT Dfp_MSid_regEEPDiff_mp "Messpunkt fuer Fehlerpfad  Dfp_MSid_regEEPDiff" UWORD OneToOne 1 100 0.00 65535.00 FORMAT "%8.2" ECU_ADDRESS 0x8FD92A /end MEASUREMENT
/begin MEASUREMENT Dfp_MSid_SwCmp_mp "Fehlerpfad Master Slave Identification Softwareversionsvergleich" UWORD OneToOne 1 100 0.00 65535.00 FORMAT "%8.2" ECU_ADDRESS 0x8FD92C /end MEASUREMENT
/begin MEASUREMENT Dfp_MSMonConsist_mp "Messpunkt für Fehlerpfad für Dfp_MSMonConsist (Task-Counter-/Konsistenz-Fehler)" UWORD OneToOne 1 100 0.00 65535.00 FORMAT "%8.2" ECU_ADDRESS 0x8FD92E /end MEASUREMENT
/begin MEASUREMENT Dfp_MSMonPFlt1_mp "Messpunkt fuer Fehlerpfad  Dfp_MSMonPFlt1" UWORD OneToOne 1 100 0.00 65535.00 FORMAT "%8.2" ECU_ADDRESS 0x8FD930 /end MEASUREMENT
/begin MEASUREMENT Dfp_MSMonPFlt2_mp "Messpunkt fuer Fehlerpfad  Dfp_MSMonPFlt2" UWORD OneToOne 1 100 0.00 65535.00 FORMAT "%8.2" ECU_ADDRESS 0x8FD932 /end MEASUREMENT
/begin MEASUREMENT Dfp_MSMonPFlt3_mp "Messpunkt fuer Fehlerpfad  Dfp_MSMonPFlt3" UWORD OneToOne 1 100 0.00 65535.00 FORMAT "%8.2" ECU_ADDRESS 0x8FD934 /end MEASUREMENT
/begin MEASUREMENT Dfp_MSMonPFlt4_mp "Messpunkt fuer Fehlerpfad  Dfp_MSMonPFlt4" UWORD OneToOne 1 100 0.00 65535.00 FORMAT "%8.2" ECU_ADDRESS 0x8FD936 /end MEASUREMENT
/begin MEASUREMENT Dfp_MSMon_AirCtl_mp "Dfp zur syncronisation der Luftsystemfehler von Master und Slave" UWORD OneToOne 1 100 0.00 65535.00 FORMAT "%8.2" ECU_ADDRESS 0x8FD938 /end MEASUREMENT
/begin MEASUREMENT Dfp_MSMon_AirSys0_mp "Dfp zur syncronisation der Luftsystemfehler von Master und Slave" UWORD OneToOne 1 100 0.00 65535.00 FORMAT "%8.2" ECU_ADDRESS 0x8FD93A /end MEASUREMENT
/begin MEASUREMENT Dfp_MSMon_AirSys1_mp "Dfp zur syncronisation der Luftsystemfehler von Master und Slave" UWORD OneToOne 1 100 0.00 65535.00 FORMAT "%8.2" ECU_ADDRESS 0x8FD93C /end MEASUREMENT
/begin MEASUREMENT Dfp_MSMon_AirSys2_mp "Dfp zur syncronisation der Luftsystemfehler von Master und Slave" UWORD OneToOne 1 100 0.00 65535.00 FORMAT "%8.2" ECU_ADDRESS 0x8FD93E /end MEASUREMENT
/begin MEASUREMENT Dfp_MSMon_AirSys3_mp "Dfp zur syncronisation der Luftsystemfehler von Master und Slave" UWORD OneToOne 1 100 0.00 65535.00 FORMAT "%8.2" ECU_ADDRESS 0x8FD940 /end MEASUREMENT
/begin MEASUREMENT Dfp_MSMon_AirSys4_mp "Dfp zur syncronisation der Luftsystemfehler von Master und Slave" UWORD OneToOne 1 100 0.00 65535.00 FORMAT "%8.2" ECU_ADDRESS 0x8FD942 /end MEASUREMENT
/begin MEASUREMENT Dfp_MSMon_AirSys7_mp "Dfp zur syncronisation der Luftsystemfehler von Master und Slave" UWORD OneToOne 1 100 0.00 65535.00 FORMAT "%8.2" ECU_ADDRESS 0x8FD944 /end MEASUREMENT
/begin MEASUREMENT Dfp_MSMon_ARS_TO_mp "Messpunkt fuer Fehlerpfad  Dfp_MSMon_ARS_TO" UWORD OneToOne 1 100 0.00 65535.00 FORMAT "%8.2" ECU_ADDRESS 0x8FD946 /end MEASUREMENT
/begin MEASUREMENT Dfp_MSMon_CanDef_mp "Messpunkt fuer Fehlerpfad  Dfp_MSMon_CanDef" UWORD OneToOne 1 100 0.00 65535.00 FORMAT "%8.2" ECU_ADDRESS 0x8FD948 /end MEASUREMENT
/begin MEASUREMENT Dfp_MSMon_CoEng_OffVeh_mp "Fehlerpfad für irreversiblen Momenten abschaltung (Statusbyte 2)" UWORD OneToOne 1 100 0.00 65535.00 FORMAT "%8.2" ECU_ADDRESS 0x8FD94A /end MEASUREMENT
/begin MEASUREMENT Dfp_MSMon_CoEng_Rev1_mp "Fehlerpfad für reversiblen Momentenabschaltung (Statusbyte 2)" UWORD OneToOne 1 100 0.00 65535.00 FORMAT "%8.2" ECU_ADDRESS 0x8FD94C /end MEASUREMENT
/begin MEASUREMENT Dfp_MSMon_CoEng_Rev2_mp "Fehlerpfad für reversiblen Momentenabschaltung (Statusbyte 2)" UWORD OneToOne 1 100 0.00 65535.00 FORMAT "%8.2" ECU_ADDRESS 0x8FD94E /end MEASUREMENT
/begin MEASUREMENT Dfp_MSMon_CoEng_RevMS_mp "Fehlerpfad für reversiblen Momenten abschaltung (Statusbyte 2)" UWORD OneToOne 1 100 0.00 65535.00 FORMAT "%8.2" ECU_ADDRESS 0x8FD950 /end MEASUREMENT
/begin MEASUREMENT Dfp_MSMon_DSC_TO_mp "Messpunkt fuer Fehlerpfad  Dfp_MSMon_DSC_TO" UWORD OneToOne 1 100 0.00 65535.00 FORMAT "%8.2" ECU_ADDRESS 0x8FD952 /end MEASUREMENT
/begin MEASUREMENT Dfp_MSMon_EGS_TO_mp "Messpunkt fuer Fehlerpfad  Dfp_MSMon_EGS_TO" UWORD OneToOne 1 100 0.00 65535.00 FORMAT "%8.2" ECU_ADDRESS 0x8FD954 /end MEASUREMENT
/begin MEASUREMENT Dfp_MSMon_FrmMngCoEng_mp "Messpunkt fuer Fehlerpfad  Dfp_MSMon_FrmMngCoEng" UWORD OneToOne 1 100 0.00 65535.00 FORMAT "%8.2" ECU_ADDRESS 0x8FD956 /end MEASUREMENT
/begin MEASUREMENT Dfp_MSMon_FrmMngPT2_mp "Messpunkt fuer Fehlerpfad  Dfp_MSMon_FrmMngPT2" UWORD OneToOne 1 100 0.00 65535.00 FORMAT "%8.2" ECU_ADDRESS 0x8FD958 /end MEASUREMENT
/begin MEASUREMENT Dfp_MSMon_FrmMngPT_mp "Fehlerpfad enthaelt den CAN Status, welcher vom slave an den Master gesendet wird" UWORD OneToOne 1 100 0.00 65535.00 FORMAT "%8.2" ECU_ADDRESS 0x8FD95A /end MEASUREMENT
/begin MEASUREMENT Dfp_MSMon_Mil_mp "Fehlerpfad vom der MIL lampe vom Slave" UWORD OneToOne 1 100 0.00 65535.00 FORMAT "%8.2" ECU_ADDRESS 0x8FD95C /end MEASUREMENT
/begin MEASUREMENT Dfp_MSMon_mp "Messpunkt für Fehlerpfad  Dfp_MSMon  (Fehler des internen CAN)" UWORD OneToOne 1 100 0.00 65535.00 FORMAT "%8.2" ECU_ADDRESS 0x8FD95E /end MEASUREMENT
/begin MEASUREMENT Dfp_MSMon_NetMngPtCan_mp "" UWORD OneToOne 1 100 0.00 65535.00 FORMAT "%8.2" ECU_ADDRESS 0x8FD960 /end MEASUREMENT
/begin MEASUREMENT Dfp_MSMon_qLimErr_mp "Fehlerpfad für Mengenbegrenzungsfehler (status byte 1)" UWORD OneToOne 1 100 0.00 65535.00 FORMAT "%8.2" ECU_ADDRESS 0x8FD962 /end MEASUREMENT
/begin MEASUREMENT Dfp_MSMon_RailCDPMon_mp "" UWORD OneToOne 1 100 0.00 65535.00 FORMAT "%8.2" ECU_ADDRESS 0x8FD964 /end MEASUREMENT
/begin MEASUREMENT Dfp_MSMon_StEGS_mp "" UWORD OneToOne 1 100 0.00 65535.00 FORMAT "%8.2" ECU_ADDRESS 0x8FD966 /end MEASUREMENT
/begin MEASUREMENT Dfp_MSMon_SysLamp_mp "Fehlerpfad von der SysLampe vom Slave" UWORD OneToOne 1 100 0.00 65535.00 FORMAT "%8.2" ECU_ADDRESS 0x8FD968 /end MEASUREMENT
/begin MEASUREMENT Dfp_MSMon_trqCoDT_mp "Fehlerpfad für die Überwachung der Momentenabschaltbedingungen" UWORD OneToOne 1 100 0.00 65535.00 FORMAT "%8.2" ECU_ADDRESS 0x8FD96A /end MEASUREMENT
/begin MEASUREMENT Dfp_MSMon_trqCoVehLim_mp "Fehlerpfad für die Überwachung der Momentenabschaltbedingungen (status byte 1)" UWORD OneToOne 1 100 0.00 65535.00 FORMAT "%8.2" ECU_ADDRESS 0x8FD96C /end MEASUREMENT
/begin MEASUREMENT Dfp_MSMon_trqCoVeh_mp "Fehlerpfad für die Überwachung der Momentenabschaltbedingungen (status byte 1)" UWORD OneToOne 1 100 0.00 65535.00 FORMAT "%8.2" ECU_ADDRESS 0x8FD96E /end MEASUREMENT
/begin MEASUREMENT Dfp_MSMon_trqDesExtRev_mp "Fehlerpfad zur Überwachung der Momentenabschaltbedingungen (Statusbyte 1)" UWORD OneToOne 1 100 0.00 65535.00 FORMAT "%8.2" ECU_ADDRESS 0x8FD970 /end MEASUREMENT
/begin MEASUREMENT Dfp_MSMon_trqDesExt_mp "Fehlerpfad zur Überwachung der Momentenabschaltbedingungen (Statusbyte 1)" UWORD OneToOne 1 100 0.00 65535.00 FORMAT "%8.2" ECU_ADDRESS 0x8FD972 /end MEASUREMENT
/begin MEASUREMENT Dfp_MSMon_trqLimErr1_mp "Fehlerpfad zur Überwachung der Momentenabschaltbedingungen (Statusbyte 1)" UWORD OneToOne 1 100 0.00 65535.00 FORMAT "%8.2" ECU_ADDRESS 0x8FD974 /end MEASUREMENT
/begin MEASUREMENT Dfp_MSMon_trqLimErr2_mp "Fehlerpfad zur Überwachung der Momentenabschaltbedingungen (Statusbyte 1)" UWORD OneToOne 1 100 0.00 65535.00 FORMAT "%8.2" ECU_ADDRESS 0x8FD976 /end MEASUREMENT
/begin MEASUREMENT Dfp_MSMon_trqLimErr3_mp "" UWORD OneToOne 1 100 0.00 65535.00 FORMAT "%8.2" ECU_ADDRESS 0x8FD978 /end MEASUREMENT
/begin MEASUREMENT Dfp_MSMon_trqLimErr4_mp "" UWORD OneToOne 1 100 0.00 65535.00 FORMAT "%8.2" ECU_ADDRESS 0x8FD97A /end MEASUREMENT
/begin MEASUREMENT Dfp_MSMon_trqLimErr_mp "Fehlerpfad zur Überwachung der Momentenabschaltbedingungen (Statusbyte 1)" UWORD OneToOne 1 100 0.00 65535.00 FORMAT "%8.2" ECU_ADDRESS 0x8FD97C /end MEASUREMENT
/begin MEASUREMENT Dfp_MSMon_ZFCClbActv_mp "" UWORD OneToOne 1 100 0.00 65535.00 FORMAT "%8.2" ECU_ADDRESS 0x8FD97E /end MEASUREMENT
/begin MEASUREMENT Dfp_NetMngDeviceA_mp "Fehlerpfad für CAN Baustein A" UWORD OneToOne 1 100 0.00 65535.00 FORMAT "%8.2" ECU_ADDRESS 0x8FD980 /end MEASUREMENT
/begin MEASUREMENT Dfp_NetMngDeviceB_mp "Fehlerpfad für CAN Baustein B" UWORD OneToOne 1 100 0.00 65535.00 FORMAT "%8.2" ECU_ADDRESS 0x8FD982 /end MEASUREMENT
/begin MEASUREMENT Dfp_NetMngDeviceC_mp "Messpunkt fuer Fehlerpfad  Dfp_NetMngDeviceC" UWORD OneToOne 1 100 0.00 65535.00 FORMAT "%8.2" ECU_ADDRESS 0x8FD984 /end MEASUREMENT
/begin MEASUREMENT Dfp_NetMngPrvCanSlave_mp "" UWORD OneToOne 1 100 0.00 65535.00 FORMAT "%8.2" ECU_ADDRESS 0x8FD986 /end MEASUREMENT
/begin MEASUREMENT Dfp_NetMngPrvCan_mp "" UWORD OneToOne 1 100 0.00 65535.00 FORMAT "%8.2" ECU_ADDRESS 0x8FD988 /end MEASUREMENT
/begin MEASUREMENT Dfp_NetMngPtCanSlave_mp "" UWORD OneToOne 1 100 0.00 65535.00 FORMAT "%8.2" ECU_ADDRESS 0x8FD98A /end MEASUREMENT
/begin MEASUREMENT Dfp_NetMngPtCan_mp "" UWORD OneToOne 1 100 0.00 65535.00 FORMAT "%8.2" ECU_ADDRESS 0x8FD98C /end MEASUREMENT
/begin MEASUREMENT Dfp_OPSCD_anain_mp "Messpunkt fuer Fehlerpfad  Dfp_OPSCD_anain" UWORD OneToOne 1 100 0.00 65535.00 FORMAT "%8.2" ECU_ADDRESS 0x8FD98E /end MEASUREMENT
/begin MEASUREMENT Dfp_OPSCD_Lamp_mp "Fehlerpfad Endstufenfehler Öllampe" UWORD OneToOne 1 100 0.00 65535.00 FORMAT "%8.2" ECU_ADDRESS 0x8FD990 /end MEASUREMENT
/begin MEASUREMENT Dfp_OTSCD_mp "Fehlerpfad Öltemperaturwert" UWORD OneToOne 1 100 0.00 65535.00 FORMAT "%8.2" ECU_ADDRESS 0x8FD992 /end MEASUREMENT
/begin MEASUREMENT Dfp_OvRMonSigA_mp "Fehlerpfad für Drehzahlplausibilisierung in der Schubüberwachung" UWORD OneToOne 1 100 0.00 65535.00 FORMAT "%8.2" ECU_ADDRESS 0x8FD994 /end MEASUREMENT
/begin MEASUREMENT Dfp_OvRMon_mp "Messpunkt fuer Fehlerpfad  Dfp_OvRMon" UWORD OneToOne 1 100 0.00 65535.00 FORMAT "%8.2" ECU_ADDRESS 0x8FD996 /end MEASUREMENT
/begin MEASUREMENT Dfp_OxiCCDTPreB1_mp "Messpunkt fuer Fehlerpfad  Dfp_OxiCCDTPreB1" UWORD OneToOne 1 100 0.00 65535.00 FORMAT "%8.2" ECU_ADDRESS 0x8FD998 /end MEASUREMENT
/begin MEASUREMENT Dfp_OxiCCDTPreB2_mp "Messpunkt fuer Fehlerpfad  Dfp_OxiCCDTPreB2" UWORD OneToOne 1 100 0.00 65535.00 FORMAT "%8.2" ECU_ADDRESS 0x8FD99A /end MEASUREMENT
/begin MEASUREMENT Dfp_PCBS_mp "" UWORD OneToOne 1 100 0.00 65535.00 FORMAT "%8.2" ECU_ADDRESS 0x8FD99C /end MEASUREMENT
/begin MEASUREMENT Dfp_PCR_BalGvnr_mp "Fault path for PCR_balance Governor Monitoring" UWORD OneToOne 1 100 0.00 65535.00 FORMAT "%8.2" ECU_ADDRESS 0x8FD99E /end MEASUREMENT
/begin MEASUREMENT Dfp_PCR_GovDevNeg_mp "Messpunkt fuer Fehlerpfad  Dfp_PCR_GovDevNeg" UWORD OneToOne 1 100 0.00 65535.00 FORMAT "%8.2" ECU_ADDRESS 0x8FD9A0 /end MEASUREMENT
/begin MEASUREMENT Dfp_PCR_GovDevPos_mp "Messpunkt fuer Fehlerpfad  Dfp_PCR_GovDevPos" UWORD OneToOne 1 100 0.00 65535.00 FORMAT "%8.2" ECU_ADDRESS 0x8FD9A2 /end MEASUREMENT
/begin MEASUREMENT Dfp_PCR_LPGvnrDvtNeg_mp "Fehlerpfadmeßpunkt neg. Regelabweichung PCR-LP" UWORD OneToOne 1 100 0.00 65535.00 FORMAT "%8.2" ECU_ADDRESS 0x8FD9A4 /end MEASUREMENT
/begin MEASUREMENT Dfp_PCR_LPGvnrDvtPos_mp "Fehlerpfadmeßpunkt pos. Regelabweichung PCR-LP" UWORD OneToOne 1 100 0.00 65535.00 FORMAT "%8.2" ECU_ADDRESS 0x8FD9A6 /end MEASUREMENT
/begin MEASUREMENT Dfp_PCVCDNoLoad_mp "Messpunkt fuer Fehlerpfad Lastabfall des Druckregelventils" UWORD OneToOne 1 100 0.00 65535.00 FORMAT "%8.2" ECU_ADDRESS 0x8FD9A8 /end MEASUREMENT
/begin MEASUREMENT Dfp_PCVCDSCBat_mp "Messpunkt für Fehlerpfad Kurzschluss zur Batteriespannung des Druckregelventils" UWORD OneToOne 1 100 0.00 65535.00 FORMAT "%8.2" ECU_ADDRESS 0x8FD9AA /end MEASUREMENT
/begin MEASUREMENT Dfp_PCVCDSCGnd_mp "Messpunkt für Fehlerpfad Kurzschluss nach Masse des Druckregelventils" UWORD OneToOne 1 100 0.00 65535.00 FORMAT "%8.2" ECU_ADDRESS 0x8FD9AC /end MEASUREMENT
/begin MEASUREMENT Dfp_PCVCD_ADC_mp "Messpunkt fuer Fehlerpfad  Dfp_PCVCD_ADC" UWORD OneToOne 1 100 0.00 65535.00 FORMAT "%8.2" ECU_ADDRESS 0x8FD9AE /end MEASUREMENT
/begin MEASUREMENT Dfp_PCVCD_SigTst_mp "Messpunkt fuer Fehlerpfad  Dfp_PCVCD_SigTst" UWORD OneToOne 1 100 0.00 65535.00 FORMAT "%8.2" ECU_ADDRESS 0x8FD9B0 /end MEASUREMENT
/begin MEASUREMENT Dfp_PFltAPSensB1_mp "Fehlerfad für Atmosphärendrucksensor für Bank1" UWORD OneToOne 1 100 0.00 65535.00 FORMAT "%8.2" ECU_ADDRESS 0x8FD9B2 /end MEASUREMENT
/begin MEASUREMENT Dfp_PFltAPSensB2_mp "Fehlerfad für Atmosphärendrucksensor für Bank2" UWORD OneToOne 1 100 0.00 65535.00 FORMAT "%8.2" ECU_ADDRESS 0x8FD9B4 /end MEASUREMENT
/begin MEASUREMENT Dfp_PFltAPSPlaus_mp "Messpunkt fuer Fehlerpfad Dfp_PFltAPSPlaus" UWORD OneToOne 1 100 0.00 65535.00 FORMAT "%8.2" ECU_ADDRESS 0x8FD9B6 /end MEASUREMENT
/begin MEASUREMENT Dfp_PFltBPSPlaus_mp "Messpunkt fuer Fehlerpfad Dfp_PFltBPSPlaus" UWORD OneToOne 1 100 0.00 65535.00 FORMAT "%8.2" ECU_ADDRESS 0x8FD9B8 /end MEASUREMENT
/begin MEASUREMENT Dfp_PFltCDPPreB1_mp "Messpunkt fuer Fehlerpfad  Dfp_PFltCDPPreB1" UWORD OneToOne 1 100 0.00 65535.00 FORMAT "%8.2" ECU_ADDRESS 0x8FD9BA /end MEASUREMENT
/begin MEASUREMENT Dfp_PFltCDPPreB2_mp "Messpunkt fuer Fehlerpfad  Dfp_PFltCDPPreB2" UWORD OneToOne 1 100 0.00 65535.00 FORMAT "%8.2" ECU_ADDRESS 0x8FD9BC /end MEASUREMENT
/begin MEASUREMENT Dfp_PFltCDTPreB1_mp "Messpunkt fuer Fehlerpfad  Dfp_PFltCDTPreB1" UWORD OneToOne 1 100 0.00 65535.00 FORMAT "%8.2" ECU_ADDRESS 0x8FD9BE /end MEASUREMENT
/begin MEASUREMENT Dfp_PFltCDTPreB2_mp "Messpunkt fuer Fehlerpfad  Dfp_PFltCDTPreB2" UWORD OneToOne 1 100 0.00 65535.00 FORMAT "%8.2" ECU_ADDRESS 0x8FD9C0 /end MEASUREMENT
/begin MEASUREMENT Dfp_PFltCharB1_mp "Digitaler Fehlerpfad für Fliesswiderstand Partikelfilter für Bank1" UWORD OneToOne 1 100 0.00 65535.00 FORMAT "%8.2" ECU_ADDRESS 0x8FD9C2 /end MEASUREMENT
/begin MEASUREMENT Dfp_PFltCharB2_mp "Digitaler Fehlerpfad für Fliesswiderstand Partikelfilter für Bank2" UWORD OneToOne 1 100 0.00 65535.00 FORMAT "%8.2" ECU_ADDRESS 0x8FD9C4 /end MEASUREMENT
/begin MEASUREMENT Dfp_PFltDltOxiPreTwFlw_mp "Abgastemperaturabweichung zwicshen den beiden Abgasfluten vor OxiCat" UWORD OneToOne 1 100 0.00 65535.00 FORMAT "%8.2" ECU_ADDRESS 0x8FD9C6 /end MEASUREMENT
/begin MEASUREMENT Dfp_PFltDltPreTwFlw_mp "Fehlerpfad für Temperaturabweichung zwischen den Abgasfluten vor Diesel Partikelfilter" UWORD OneToOne 1 100 0.00 65535.00 FORMAT "%8.2" ECU_ADDRESS 0x8FD9C8 /end MEASUREMENT
/begin MEASUREMENT Dfp_PFltEngPrtB1_mp "Messpunkt fuer Fehlerpfad  Dfp_PFltEngPrt für Bank1" UWORD OneToOne 1 100 0.00 65535.00 FORMAT "%8.2" ECU_ADDRESS 0x8FD9CA /end MEASUREMENT
/begin MEASUREMENT Dfp_PFltEngPrtB2_mp "Messpunkt fuer Fehlerpfad  Dfp_PFltEngPrt für Bank2" UWORD OneToOne 1 100 0.00 65535.00 FORMAT "%8.2" ECU_ADDRESS 0x8FD9CC /end MEASUREMENT
/begin MEASUREMENT Dfp_PFltmSotDiffMaxB1_mp "Messpunkt fuer Fehlerpfad  Dfp_PFltmSotDiffMaxB1" UWORD OneToOne 1 100 0.00 65535.00 FORMAT "%8.2" ECU_ADDRESS 0x8FD9CE /end MEASUREMENT
/begin MEASUREMENT Dfp_PFltmSotDiffMaxB2_mp "Messpunkt fuer Fehlerpfad  Dfp_PFltmSotDiffMaxB2" UWORD OneToOne 1 100 0.00 65535.00 FORMAT "%8.2" ECU_ADDRESS 0x8FD9D0 /end MEASUREMENT
/begin MEASUREMENT Dfp_PFltOvldInhRgnB1_mp "" UWORD OneToOne 1 100 0.00 65535.00 FORMAT "%8.2" ECU_ADDRESS 0x8FD9D2 /end MEASUREMENT
/begin MEASUREMENT Dfp_PFltOvldInhRgnB2_mp "" UWORD OneToOne 1 100 0.00 65535.00 FORMAT "%8.2" ECU_ADDRESS 0x8FD9D4 /end MEASUREMENT
/begin MEASUREMENT Dfp_PFltOvldTrqLimB1_mp "" UWORD OneToOne 1 100 0.00 65535.00 FORMAT "%8.2" ECU_ADDRESS 0x8FD9D6 /end MEASUREMENT
/begin MEASUREMENT Dfp_PFltOvldTrqLimB2_mp "" UWORD OneToOne 1 100 0.00 65535.00 FORMAT "%8.2" ECU_ADDRESS 0x8FD9D8 /end MEASUREMENT
/begin MEASUREMENT Dfp_PFltPresDynPlausB1_mp "Messpunkt fuer Fehlerpfad  Dfp_PFltPresDynPlaus für Bank1" UWORD OneToOne 1 100 0.00 65535.00 FORMAT "%8.2" ECU_ADDRESS 0x8FD9DA /end MEASUREMENT
/begin MEASUREMENT Dfp_PFltPresDynPlausB2_mp "Messpunkt fuer Fehlerpfad  Dfp_PFltPresDynPlaus für Bank2" UWORD OneToOne 1 100 0.00 65535.00 FORMAT "%8.2" ECU_ADDRESS 0x8FD9DC /end MEASUREMENT
/begin MEASUREMENT Dfp_PFltPresPlausB1_mp "" UWORD OneToOne 1 100 0.00 65535.00 FORMAT "%8.2" ECU_ADDRESS 0x8FD9DE /end MEASUREMENT
/begin MEASUREMENT Dfp_PFltPresPlausB2_mp "" UWORD OneToOne 1 100 0.00 65535.00 FORMAT "%8.2" ECU_ADDRESS 0x8FD9E0 /end MEASUREMENT
/begin MEASUREMENT Dfp_PFltPresSensB1_mp "Messpunkt fuer Fehlerpfad  Dfp_PFltPresSens für Bank1" UWORD OneToOne 1 100 0.00 65535.00 FORMAT "%8.2" ECU_ADDRESS 0x8FD9E2 /end MEASUREMENT
/begin MEASUREMENT Dfp_PFltPresSensB2_mp "Messpunkt fuer Fehlerpfad  Dfp_PFltPresSens für Bank2" UWORD OneToOne 1 100 0.00 65535.00 FORMAT "%8.2" ECU_ADDRESS 0x8FD9E4 /end MEASUREMENT
/begin MEASUREMENT Dfp_PFltPresSensFrz_mp "Messpunkt fuer Fehlerpfad  Dfp_PFltPresSensFrz" UWORD OneToOne 1 100 0.00 65535.00 FORMAT "%8.2" ECU_ADDRESS 0x8FD9E6 /end MEASUREMENT
/begin MEASUREMENT Dfp_PFltPresSensHsLnB1_mp "Messpunkt fuer Fehlerpfad  Dfp_PFltPresSensHsLnB1" UWORD OneToOne 1 100 0.00 65535.00 FORMAT "%8.2" ECU_ADDRESS 0x8FD9E8 /end MEASUREMENT
/begin MEASUREMENT Dfp_PFltPresSensHsLnB2_mp "Messpunkt fuer Fehlerpfad  Dfp_PFltPresSensHsLnB2" UWORD OneToOne 1 100 0.00 65535.00 FORMAT "%8.2" ECU_ADDRESS 0x8FD9EA /end MEASUREMENT
/begin MEASUREMENT Dfp_PFltPresSensSotB1_mp "Messpunkt fuer Fehlerpfad  Dfp_PFltPresSensSotB1" UWORD OneToOne 1 100 0.00 65535.00 FORMAT "%8.2" ECU_ADDRESS 0x8FD9EC /end MEASUREMENT
/begin MEASUREMENT Dfp_PFltPresSensSotB2_mp "Messpunkt fuer Fehlerpfad  Dfp_PFltPresSensSotB2" UWORD OneToOne 1 100 0.00 65535.00 FORMAT "%8.2" ECU_ADDRESS 0x8FD9EE /end MEASUREMENT
/begin MEASUREMENT Dfp_PFltRgnPerm_mp "Messpunkt fuer Fehlerpfad  Dfp_PFltRgnPerm" UWORD OneToOne 1 100 0.00 65535.00 FORMAT "%8.2" ECU_ADDRESS 0x8FD9F0 /end MEASUREMENT
/begin MEASUREMENT Dfp_PFltTempDwnStrmB1_mp "Digitaler Fehlerpfad für zweiten Abgastemperatursensor" UWORD OneToOne 1 100 0.00 65535.00 FORMAT "%8.2" ECU_ADDRESS 0x8FD9F2 /end MEASUREMENT
/begin MEASUREMENT Dfp_PFltTempDwnStrmB2_mp "Digitaler Fehlerpfad für zweiten Abgastemperatursensor" UWORD OneToOne 1 100 0.00 65535.00 FORMAT "%8.2" ECU_ADDRESS 0x8FD9F4 /end MEASUREMENT
/begin MEASUREMENT Dfp_PFltTempSensB1_mp "Messpunkt fuer Fehlerpfad  Dfp_PFltTempSensB1" UWORD OneToOne 1 100 0.00 65535.00 FORMAT "%8.2" ECU_ADDRESS 0x8FD9F6 /end MEASUREMENT
/begin MEASUREMENT Dfp_PFltTempSensB2_mp "Messpunkt fuer Fehlerpfad  Dfp_PFltTempSensB2" UWORD OneToOne 1 100 0.00 65535.00 FORMAT "%8.2" ECU_ADDRESS 0x8FD9F8 /end MEASUREMENT
/begin MEASUREMENT Dfp_PFltTempUpStrmB1_mp "Digitaler Fehlerpfad für ersten Abgastemperatursensor" UWORD OneToOne 1 100 0.00 65535.00 FORMAT "%8.2" ECU_ADDRESS 0x8FD9FA /end MEASUREMENT
/begin MEASUREMENT Dfp_PFltTempUpStrmB2_mp "Digitaler Fehlerpfad für ersten Abgastemperatursensor" UWORD OneToOne 1 100 0.00 65535.00 FORMAT "%8.2" ECU_ADDRESS 0x8FD9FC /end MEASUREMENT
/begin MEASUREMENT Dfp_PFlt_tOxiPreMaxB1_mp "" UWORD OneToOne 1 100 0.00 65535.00 FORMAT "%8.2" ECU_ADDRESS 0x8FD9FE /end MEASUREMENT
/begin MEASUREMENT Dfp_PFlt_tOxiPreMaxB2_mp "" UWORD OneToOne 1 100 0.00 65535.00 FORMAT "%8.2" ECU_ADDRESS 0x8FDA00 /end MEASUREMENT
/begin MEASUREMENT Dfp_PFlt_tOxiPreMxRgnB1_mp "" UWORD OneToOne 1 100 0.00 65535.00 FORMAT "%8.2" ECU_ADDRESS 0x8FDA02 /end MEASUREMENT
/begin MEASUREMENT Dfp_PFlt_tOxiPreMxRgnB2_mp "" UWORD OneToOne 1 100 0.00 65535.00 FORMAT "%8.2" ECU_ADDRESS 0x8FDA04 /end MEASUREMENT
/begin MEASUREMENT Dfp_PFlt_tPreMaxB1_mp "" UWORD OneToOne 1 100 0.00 65535.00 FORMAT "%8.2" ECU_ADDRESS 0x8FDA06 /end MEASUREMENT
/begin MEASUREMENT Dfp_PFlt_tPreMaxB2_mp "" UWORD OneToOne 1 100 0.00 65535.00 FORMAT "%8.2" ECU_ADDRESS 0x8FDA08 /end MEASUREMENT
/begin MEASUREMENT Dfp_PFlt_tPreMaxRgnB1_mp "" UWORD OneToOne 1 100 0.00 65535.00 FORMAT "%8.2" ECU_ADDRESS 0x8FDA0A /end MEASUREMENT
/begin MEASUREMENT Dfp_PFlt_tPreMaxRgnB2_mp "" UWORD OneToOne 1 100 0.00 65535.00 FORMAT "%8.2" ECU_ADDRESS 0x8FDA0C /end MEASUREMENT
/begin MEASUREMENT Dfp_PresPlausDblDef_mp "Messpunkt fuer Fehlerpfad Dfp_PresPlausDblDef" UWORD OneToOne 1 100 0.00 65535.00 FORMAT "%8.2" ECU_ADDRESS 0x8FDA0E /end MEASUREMENT
/begin MEASUREMENT Dfp_QLTCD_mp "Messpunkt fuer Fehlerpfad  Dfp_QLTCD" UWORD OneToOne 1 100 0.00 65535.00 FORMAT "%8.2" ECU_ADDRESS 0x8FDA10 /end MEASUREMENT
/begin MEASUREMENT Dfp_RailCDOfsTst_mp "Fehlerpfad für Offset-Überwachung des Raildrucksensors" UWORD OneToOne 1 100 0.00 65535.00 FORMAT "%8.2" ECU_ADDRESS 0x8FDA12 /end MEASUREMENT
/begin MEASUREMENT Dfp_RailCD_mp "Messpunkt fuer Fehlerpfad  Dfp_RailCD" UWORD OneToOne 1 100 0.00 65535.00 FORMAT "%8.2" ECU_ADDRESS 0x8FDA14 /end MEASUREMENT
/begin MEASUREMENT Dfp_RailCD_PMonStrt_mp "Messpunkt fuer Fehlerpfad  Dfp_RailCD_PMonStrt" UWORD OneToOne 1 100 0.00 65535.00 FORMAT "%8.2" ECU_ADDRESS 0x8FDA16 /end MEASUREMENT
/begin MEASUREMENT Dfp_RailCPC1_mp "Messpunkt fuer Fehlerpfad  Dfp_RailCPC1" UWORD OneToOne 1 100 0.00 65535.00 FORMAT "%8.2" ECU_ADDRESS 0x8FDA18 /end MEASUREMENT
/begin MEASUREMENT Dfp_RailCPC3_mp "Messpunkt fuer Fehlerpfad  Dfp_RailCPC3" UWORD OneToOne 1 100 0.00 65535.00 FORMAT "%8.2" ECU_ADDRESS 0x8FDA1A /end MEASUREMENT
/begin MEASUREMENT Dfp_RailCPC4_mp "Messpunkt fuer Fehlerpfad  Dfp_RailCPC4" UWORD OneToOne 1 100 0.00 65535.00 FORMAT "%8.2" ECU_ADDRESS 0x8FDA1C /end MEASUREMENT
/begin MEASUREMENT Dfp_RailCtlModeMeUnDiag_mp "Messpunkt fuer Fehlerpfad  Dfp_RailCtlModeMeUnDiag" UWORD OneToOne 1 100 0.00 65535.00 FORMAT "%8.2" ECU_ADDRESS 0x8FDA1E /end MEASUREMENT
/begin MEASUREMENT Dfp_RailCtlModePCVDiag_mp "Messpunkt fuer Fehlerpfad  Dfp_RailCtlModePCVDiag" UWORD OneToOne 1 100 0.00 65535.00 FORMAT "%8.2" ECU_ADDRESS 0x8FDA20 /end MEASUREMENT
/begin MEASUREMENT Dfp_RailMeUn0_mp "Fehlerpfad für Überwachung auf positive Regelabweichung" UWORD OneToOne 1 100 0.00 65535.00 FORMAT "%8.2" ECU_ADDRESS 0x8FDA22 /end MEASUREMENT
/begin MEASUREMENT Dfp_RailMeUn1_mp "Fehlerpfad für Überwachung auf positive Regelabweichung und Sollwert des Volumenstroms durch die Zumesseinheit" UWORD OneToOne 1 100 0.00 65535.00 FORMAT "%8.2" ECU_ADDRESS 0x8FDA24 /end MEASUREMENT
/begin MEASUREMENT Dfp_RailMeUn2_mp "Fehlerpfad für Überwachung auf negative Regelabweichung bei Nullförderung" UWORD OneToOne 1 100 0.00 65535.00 FORMAT "%8.2" ECU_ADDRESS 0x8FDA26 /end MEASUREMENT
/begin MEASUREMENT Dfp_RailMeUn3_mp "Fehlerpfad für Überwachung auf minimalen Raildruck" UWORD OneToOne 1 100 0.00 65535.00 FORMAT "%8.2" ECU_ADDRESS 0x8FDA28 /end MEASUREMENT
/begin MEASUREMENT Dfp_RailMeUn4_mp "Fehlerpfad für Überwachung auf maximalen Raildruck" UWORD OneToOne 1 100 0.00 65535.00 FORMAT "%8.2" ECU_ADDRESS 0x8FDA2A /end MEASUREMENT
/begin MEASUREMENT Dfp_RailPCV0_mp "Fehlerpfad für Überwachung auf positive Regelabweichung" UWORD OneToOne 1 100 0.00 65535.00 FORMAT "%8.2" ECU_ADDRESS 0x8FDA2C /end MEASUREMENT
/begin MEASUREMENT Dfp_RailPCV1_mp "Fehlerpfad für Überwachung auf positive Regelabweichung kombiniert mit Stellgröße des Druckregelventils" UWORD OneToOne 1 100 0.00 65535.00 FORMAT "%8.2" ECU_ADDRESS 0x8FDA2E /end MEASUREMENT
/begin MEASUREMENT Dfp_RailPCV2_mp "Fehlerpfad für Überwachung auf negative Regelabweichung kombiniert mit Stellgröße des Druckregelventils" UWORD OneToOne 1 100 0.00 65535.00 FORMAT "%8.2" ECU_ADDRESS 0x8FDA30 /end MEASUREMENT
/begin MEASUREMENT Dfp_RailPCV3_mp "Fehlerpfad für Überwachung auf minimalen Raildruck" UWORD OneToOne 1 100 0.00 65535.00 FORMAT "%8.2" ECU_ADDRESS 0x8FDA32 /end MEASUREMENT
/begin MEASUREMENT Dfp_RailPCV4_mp "Fehlerpfad für Überwachung auf maximalen Raildruck" UWORD OneToOne 1 100 0.00 65535.00 FORMAT "%8.2" ECU_ADDRESS 0x8FDA34 /end MEASUREMENT
/begin MEASUREMENT Dfp_RailPCV5_mp "Fehlerpfad für Plausibilisierung des Raildrucks mit dem Strom durch das Druckregelventil" UWORD OneToOne 1 100 0.00 65535.00 FORMAT "%8.2" ECU_ADDRESS 0x8FDA36 /end MEASUREMENT
/begin MEASUREMENT Dfp_SOPTst_mp "Messpunkt fuer Fehlerpfad  Dfp_SOPTst" UWORD OneToOne 1 100 0.00 65535.00 FORMAT "%8.2" ECU_ADDRESS 0x8FDA38 /end MEASUREMENT
/begin MEASUREMENT Dfp_SSpMon1_mp "Meßpunkt des Fehlerpfades für Sensorversorgungsspannung 1" UWORD OneToOne 1 100 0.00 65535.00 FORMAT "%8.2" ECU_ADDRESS 0x8FDA3A /end MEASUREMENT
/begin MEASUREMENT Dfp_SSpMon2_mp "Meßpunkt des Fehlerpfades für Sensorversorgungsspannung 2" UWORD OneToOne 1 100 0.00 65535.00 FORMAT "%8.2" ECU_ADDRESS 0x8FDA3C /end MEASUREMENT
/begin MEASUREMENT Dfp_SSpMon3_mp "Meßpunkt des Fehlerpfades für Sensorversorgungsspannung 3" UWORD OneToOne 1 100 0.00 65535.00 FORMAT "%8.2" ECU_ADDRESS 0x8FDA3E /end MEASUREMENT
/begin MEASUREMENT Dfp_SSpMon4_mp "Messpunkt fuer Fehlerpfad  Dfp_SSpMon4" UWORD OneToOne 1 100 0.00 65535.00 FORMAT "%8.2" ECU_ADDRESS 0x8FDA40 /end MEASUREMENT
/begin MEASUREMENT Dfp_SSpMon5_mp "Messpunkt fuer Fehlerpfad  Dfp_SSpMon5" UWORD OneToOne 1 100 0.00 65535.00 FORMAT "%8.2" ECU_ADDRESS 0x8FDA42 /end MEASUREMENT
/begin MEASUREMENT Dfp_SSpMon6_mp "Messpunkt fuer Fehlerpfad  Dfp_SSpMon6" UWORD OneToOne 1 100 0.00 65535.00 FORMAT "%8.2" ECU_ADDRESS 0x8FDA44 /end MEASUREMENT
/begin MEASUREMENT Dfp_StrtCD_Actr_mp "Fehlerpfad für Starterrelais Endstufe" UWORD OneToOne 1 100 0.00 65535.00 FORMAT "%8.2" ECU_ADDRESS 0x8FDA46 /end MEASUREMENT
/begin MEASUREMENT Dfp_StSysTrqShutOff_mp "Zustand Fehlerpfad Start o. Kl.50" UWORD OneToOne 1 100 0.00 65535.00 FORMAT "%8.2" ECU_ADDRESS 0x8FDA48 /end MEASUREMENT
/begin MEASUREMENT Dfp_SWChk_CycSigChkDat_mp "Messpunkt fuer Fehlerpfad  Dfp_SWChk_CycSigChkDat" UWORD OneToOne 1 100 0.00 65535.00 FORMAT "%8.2" ECU_ADDRESS 0x8FDA4A /end MEASUREMENT
/begin MEASUREMENT Dfp_SWChk_CycSigChkPrg_mp "Messpunkt fuer Fehlerpfad  Dfp_SWChk_CycSigChkPrg" UWORD OneToOne 1 100 0.00 65535.00 FORMAT "%8.2" ECU_ADDRESS 0x8FDA4C /end MEASUREMENT
/begin MEASUREMENT Dfp_SysLamp_mp "Messpunkt fuer Fehlerpfad  Dfp_SysLamp" UWORD OneToOne 1 100 0.00 65535.00 FORMAT "%8.2" ECU_ADDRESS 0x8FDA4E /end MEASUREMENT
/begin MEASUREMENT Dfp_T15CD_mp "Messpunkt fuer Fehlerpfad  Dfp_T15CD" UWORD OneToOne 1 100 0.00 65535.00 FORMAT "%8.2" ECU_ADDRESS 0x8FDA50 /end MEASUREMENT
/begin MEASUREMENT Dfp_TGearbx_mp "Messpunkt fuer Fehlerpfad  Dfp_TGearbx" UWORD OneToOne 1 100 0.00 65535.00 FORMAT "%8.2" ECU_ADDRESS 0x8FDA52 /end MEASUREMENT
/begin MEASUREMENT Dfp_ThrVlvMon_mp " Dfp for Status line monitoring for TVA" UWORD OneToOne 1 100 0.00 65535.00 FORMAT "%8.2" ECU_ADDRESS 0x8FDA54 /end MEASUREMENT
/begin MEASUREMENT Dfp_TPUMon_mp "Messpunkt fuer Fehlerpfad  Dfp_TPUMon" UWORD OneToOne 1 100 0.00 65535.00 FORMAT "%8.2" ECU_ADDRESS 0x8FDA56 /end MEASUREMENT
/begin MEASUREMENT Dfp_TVACD_AirMon1_mp "" UWORD OneToOne 1 100 0.00 65535.00 FORMAT "%8.2" ECU_ADDRESS 0x8FDA58 /end MEASUREMENT
/begin MEASUREMENT Dfp_TVACD_AirMon2_mp "" UWORD OneToOne 1 100 0.00 65535.00 FORMAT "%8.2" ECU_ADDRESS 0x8FDA5A /end MEASUREMENT
/begin MEASUREMENT Dfp_TVACD_Max2_mp "Fehlerpfad für Kurzschluss nach Batteriespannung des 2ten Drosselklappenstellers" UWORD OneToOne 1 100 0.00 65535.00 FORMAT "%8.2" ECU_ADDRESS 0x8FDA5C /end MEASUREMENT
/begin MEASUREMENT Dfp_TVACD_Max_mp "Fehlerpfad für Kurzschluss nach Batteriespannung des Drosselklappenstellers" UWORD OneToOne 1 100 0.00 65535.00 FORMAT "%8.2" ECU_ADDRESS 0x8FDA5E /end MEASUREMENT
/begin MEASUREMENT Dfp_TVACD_Min2_mp "Fehlerpfad für Kurzschluss nach Masse des 2ten Drosselklappenstellers" UWORD OneToOne 1 100 0.00 65535.00 FORMAT "%8.2" ECU_ADDRESS 0x8FDA60 /end MEASUREMENT
/begin MEASUREMENT Dfp_TVACD_Min_mp "Fehlerpfad für Kurzschluss nach Masse des Drosselklappenstellers" UWORD OneToOne 1 100 0.00 65535.00 FORMAT "%8.2" ECU_ADDRESS 0x8FDA62 /end MEASUREMENT
/begin MEASUREMENT Dfp_TVACD_SigNpl2_mp "Fehlerpfad für Lastabfall und Übertemperatur des 2ten Drosselklappenstellers" UWORD OneToOne 1 100 0.00 65535.00 FORMAT "%8.2" ECU_ADDRESS 0x8FDA64 /end MEASUREMENT
/begin MEASUREMENT Dfp_TVACD_SigNpl_mp "Fehlerpfad für Lastabfall und Übertemperatur des Drosselklappenstellers" UWORD OneToOne 1 100 0.00 65535.00 FORMAT "%8.2" ECU_ADDRESS 0x8FDA66 /end MEASUREMENT
/begin MEASUREMENT Dfp_TVACD_TVADia1_mp "Messpunkt für Fehlerpfad Dfp_TVACD_TVADia1" UWORD OneToOne 1 100 0.00 65535.00 FORMAT "%8.2" ECU_ADDRESS 0x8FDA68 /end MEASUREMENT
/begin MEASUREMENT Dfp_TVACD_TVADia21_mp "Messpunkt fuer Fehlerpfad  Dfp_TVACD_TVADia21" UWORD OneToOne 1 100 0.00 65535.00 FORMAT "%8.2" ECU_ADDRESS 0x8FDA6A /end MEASUREMENT
/begin MEASUREMENT Dfp_TVACD_TVADia22_mp "Messpunkt fuer Fehlerpfad  Dfp_TVACD_TVADia22" UWORD OneToOne 1 100 0.00 65535.00 FORMAT "%8.2" ECU_ADDRESS 0x8FDA6C /end MEASUREMENT
/begin MEASUREMENT Dfp_TVACD_TVADia23_mp "Messpunkt fuer Fehlerpfad  Dfp_TVACD_TVADia23" UWORD OneToOne 1 100 0.00 65535.00 FORMAT "%8.2" ECU_ADDRESS 0x8FDA6E /end MEASUREMENT
/begin MEASUREMENT Dfp_TVACD_TVADia24_mp " Fehlerpfad für Drosselklappensteller Diagnose viertes Fenster auf 2" UWORD OneToOne 1 100 0.00 65535.00 FORMAT "%8.2" ECU_ADDRESS 0x8FDA70 /end MEASUREMENT
/begin MEASUREMENT Dfp_TVACD_TVADia2_mp "Messpunkt für Fehlerpfad Dfp_TVACD_TVADia2" UWORD OneToOne 1 100 0.00 65535.00 FORMAT "%8.2" ECU_ADDRESS 0x8FDA72 /end MEASUREMENT
/begin MEASUREMENT Dfp_TVACD_TVADia3_mp "Messpunkt für Fehlerpfad Dfp_TVACD_TVADia3" UWORD OneToOne 1 100 0.00 65535.00 FORMAT "%8.2" ECU_ADDRESS 0x8FDA74 /end MEASUREMENT
/begin MEASUREMENT Dfp_TVACD_TVADia4_mp "Fehlerpfad für Drosselklappensteller Diagnose viertes Fenster" UWORD OneToOne 1 100 0.00 65535.00 FORMAT "%8.2" ECU_ADDRESS 0x8FDA76 /end MEASUREMENT
/begin MEASUREMENT Dfp_VSACD_DiaDet_mp "Störungsweg für Diagnoselinienabfragung" UWORD OneToOne 1 100 0.00 65535.00 FORMAT "%8.2" ECU_ADDRESS 0x8FDA78 /end MEASUREMENT
/begin MEASUREMENT Dfp_VSACD_DioInDia1_mp "Messpunkt fuer Fehlerpfad  Dfp_VSACD_DioInDia1" UWORD OneToOne 1 100 0.00 65535.00 FORMAT "%8.2" ECU_ADDRESS 0x8FDA7A /end MEASUREMENT
/begin MEASUREMENT Dfp_VSACD_DioInDia2_mp "Messpunkt fuer Fehlerpfad  Dfp_VSACD_DioInDia2" UWORD OneToOne 1 100 0.00 65535.00 FORMAT "%8.2" ECU_ADDRESS 0x8FDA7C /end MEASUREMENT
/begin MEASUREMENT Dfp_VSACD_DioInDia3_mp "Messpunkt fuer Fehlerpfad  Dfp_VSACD_DioInDia3" UWORD OneToOne 1 100 0.00 65535.00 FORMAT "%8.2" ECU_ADDRESS 0x8FDA7E /end MEASUREMENT
/begin MEASUREMENT Dfp_VSACD_DioInDia4_mp "Messpunkt fuer Fehlerpfad  Dfp_VSACD_DioInDia4" UWORD OneToOne 1 100 0.00 65535.00 FORMAT "%8.2" ECU_ADDRESS 0x8FDA80 /end MEASUREMENT
/begin MEASUREMENT Dfp_VSACD_DioInMin_mp "Messpunkt fuer Fehlerpfad  Dfp_VSACD_DioInMin" UWORD OneToOne 1 100 0.00 65535.00 FORMAT "%8.2" ECU_ADDRESS 0x8FDA82 /end MEASUREMENT
/begin MEASUREMENT Dfp_VSACD_Max_mp "Fehlerpfad für Kurzschluss nach Batteriespannung des Drallniveaustellers" UWORD OneToOne 1 100 0.00 65535.00 FORMAT "%8.2" ECU_ADDRESS 0x8FDA84 /end MEASUREMENT
/begin MEASUREMENT Dfp_VSACD_Min_mp "Fehlerpfad für Kurzschluss nach Masse des Drallniveaustellers" UWORD OneToOne 1 100 0.00 65535.00 FORMAT "%8.2" ECU_ADDRESS 0x8FDA86 /end MEASUREMENT
/begin MEASUREMENT Dfp_VSACD_SigNpl_mp "Fehlerpfad für Lastabfall und Übertemperatur des Drallniveaustellers" UWORD OneToOne 1 100 0.00 65535.00 FORMAT "%8.2" ECU_ADDRESS 0x8FDA88 /end MEASUREMENT
/begin MEASUREMENT Dfp_VSACD_VSADia1_mp "Messpunkt fuer Fehlerpfad  Dfp_VSACD_VSADia1" UWORD OneToOne 1 100 0.00 65535.00 FORMAT "%8.2" ECU_ADDRESS 0x8FDA8A /end MEASUREMENT
/begin MEASUREMENT Dfp_VSACD_VSADia2_mp "Messpunkt fuer Fehlerpfad  Dfp_VSACD_VSADia2" UWORD OneToOne 1 100 0.00 65535.00 FORMAT "%8.2" ECU_ADDRESS 0x8FDA8C /end MEASUREMENT
/begin MEASUREMENT Dfp_VSACD_VSADia3_mp "Messpunkt fuer Fehlerpfad  Dfp_VSACD_VSADia3" UWORD OneToOne 1 100 0.00 65535.00 FORMAT "%8.2" ECU_ADDRESS 0x8FDA8E /end MEASUREMENT
/begin MEASUREMENT Dfp_VSACD_VSADia4_mp "Fehlerpfad für Drallklappensteller Diagnose viertes Fenster" UWORD OneToOne 1 100 0.00 65535.00 FORMAT "%8.2" ECU_ADDRESS 0x8FDA90 /end MEASUREMENT
/begin MEASUREMENT Dfp_VSSCD1_mp "Messpunkt fuer Fehlerpfad  Dfp_VSSCD1" UWORD OneToOne 1 100 0.00 65535.00 FORMAT "%8.2" ECU_ADDRESS 0x8FDA92 /end MEASUREMENT
/begin MEASUREMENT Dfp_VSSCD2_mp "Messpunkt fuer Fehlerpfad  Dfp_VSSCD2" UWORD OneToOne 1 100 0.00 65535.00 FORMAT "%8.2" ECU_ADDRESS 0x8FDA94 /end MEASUREMENT
/begin MEASUREMENT Dfp_WdCom_mp "Messpunkt fuer Fehlerpfad  Dfp_WdCom" UWORD OneToOne 1 100 0.00 65535.00 FORMAT "%8.2" ECU_ADDRESS 0x8FDA96 /end MEASUREMENT
/begin FUNCTION dsm_auto_dfpmp ""
 /begin OUT_MEASUREMENT Dfp_ACCDSwtin_mp Dfp_AccPedPlausBrk_mp Dfp_ACC_PlausTrqDes_mp Dfp_ACC_trqInr_mp Dfp_ACTrq_mp Dfp_ADCMon_mp Dfp_AddPCDTnkLvl_mp Dfp_AFSCDIdlAdjVal_mp Dfp_AFSCDLdAdjVal_mp Dfp_AFSCDPlAirPerCylDif_mp Dfp_AFSCD_AirTempDcyc2_mp Dfp_AFSCD_AirTempDcyc_mp Dfp_AFSCD_PlOffsDrft2_mp Dfp_AFSCD_PlOffsDrft_mp Dfp_AFSCD_PlSetyDrft_mp Dfp_AFSCD_SRCAirTemp2_mp Dfp_AFSCD_SRCAirTemp_mp Dfp_AFSCD_SRCBatt2_mp Dfp_AFSCD_SRCBatt_mp Dfp_AFSCD_SRCCorrAirm2_mp Dfp_AFSCD_SRCCorrAirm_mp Dfp_AFSCD_SRCRawAirm2_mp Dfp_AFSCD_SRCRawAirm_mp Dfp_AFSCD_SRCRefSigPer2_mp Dfp_AFSCD_SRCRefSigPer_mp Dfp_AirCtlGvnrDvtRgnMax_mp Dfp_AirCtlGvnrDvtRgnMin_mp Dfp_AirCtlGvnrDvtRgnMn2_mp Dfp_AirCtlGvnrDvtRgnMx2_mp Dfp_AirCtlPlateBreak_mp Dfp_AirCtlRmpTO_mp Dfp_AirCtl_GovNegDev2_mp Dfp_AirCtl_GovNegDev_mp Dfp_AirCtl_GovPosDev2_mp Dfp_AirCtl_GovPosDev_mp Dfp_AltCD_mp Dfp_AOHtCD_AOHtDia1_mp Dfp_AOHtCD_AOHtDia2_mp Dfp_AOHtCD_AOHtDia3_mp Dfp_AOHtCD_mp Dfp_APP1_mp Dfp_APP2_mp Dfp_APPCDCmpd_mp Dfp_APPSync_mp Dfp_APSCD_mp Dfp_ARS_mp Dfp_BattCD_mp Dfp_BPACD_BPADia1v2_mp Dfp_BPACD_BPADia1_mp Dfp_BPACD_BPADia2v2_mp Dfp_BPACD_BPADia2_mp Dfp_BPACD_BPADia3v2_mp Dfp_BPACD_BPADia3_mp Dfp_BPACD_BPADia4v2_mp Dfp_BPACD_BPADia4_mp Dfp_BPACD_Max2_mp Dfp_BPACD_Max_mp Dfp_BPACD_Min2_mp Dfp_BPACD_Min_mp Dfp_BPACD_SigNpl2_mp Dfp_BPACD_SigNpl_mp Dfp_BPSCD_mp Dfp_BrkCD_mp Dfp_Bss_mp Dfp_CBACD_mp Dfp_Clg_DynTst_mp Dfp_CmbChbMisfire1_mp Dfp_CmbChbMisfire2_mp Dfp_CmbChbMisfire3_mp Dfp_CmbChbMisfire4_mp Dfp_CmbChbMisfire5_mp Dfp_CmbChbMisfire6_mp Dfp_CmbChbMisfire7_mp Dfp_CmbChbMisfire8_mp Dfp_CmbChbMisfireMul_mp Dfp_CoDT_TRQ_Des_mp Dfp_CoDT_TRQ_Lead_mp Dfp_CoEng_GbxRpmRduc_mp Dfp_ConvCD_mp Dfp_CoVMDCSh_mp Dfp_CrCCDMFL_mp Dfp_CrCtl_vCrCtl_mp Dfp_CTSCD_mp Dfp_EATSCD_mp Dfp_EBAFCD_mp Dfp_EBFCD_mp Dfp_EBTSCD_mp Dfp_EBTSCD_OvrTemp_mp Dfp_EEPCDVarMng_mp Dfp_EGPpCD_mp Dfp_EGRCD_Max2_mp Dfp_EGRCD_Max_mp Dfp_EGRCD_Min2_mp Dfp_EGRCD_Min_mp Dfp_EGRCD_PWMInDia1_mp Dfp_EGRCD_PWMInDia21_mp Dfp_EGRCD_PWMInDia22_mp Dfp_EGRCD_PWMInDia23_mp Dfp_EGRCD_PWMInDia24_mp Dfp_EGRCD_PWMInDia2_mp Dfp_EGRCD_PWMInDia3_mp Dfp_EGRCD_PWMInDia4_mp Dfp_EGRCD_SigDia2_mp Dfp_EGRCD_SigDia_mp Dfp_EGRCD_SigNpl2_mp Dfp_EGRCD_SigNpl_mp Dfp_EGTOilLvlCrit_mp Dfp_EGTOilVscCrit_mp Dfp_EGTRgnOilDil_mp Dfp_EGTTempGvnrInrB1_mp Dfp_EGTTempGvnrInrB2_mp Dfp_EGTTempGvnrOutrB1_mp Dfp_EGTTempGvnrOutrB2_mp Dfp_EngMCaS1_mp Dfp_EngMCrS1_mp Dfp_EngMntCtlCD_mp Dfp_EngMOfsCaSCrS_mp Dfp_ETClbETFltInj1_mp Dfp_ETClbETFltInj2_mp Dfp_ETClbETFltInj3_mp Dfp_ETClbETFltInj4_mp Dfp_ETClbETFltInj5_mp Dfp_ETClbETFltInj6_mp Dfp_ETClbETFltInj7_mp Dfp_ETClbETFltInj8_mp Dfp_ETClbInj1_mp Dfp_ETClbInj2_mp Dfp_ETClbInj3_mp Dfp_ETClbInj4_mp Dfp_ETClbInj5_mp Dfp_ETClbInj6_mp Dfp_ETClbInj7_mp Dfp_ETClbInj8_mp Dfp_FanCD_FanCtlr1_mp Dfp_FanCD_FanCtlr2_mp Dfp_FanCD_FanCtlr3_mp Dfp_FanCD_mp Dfp_FBCqDvt_mp Dfp_FlFCD_mp Dfp_FlMngSmkDefect_mp Dfp_FlSCDT1_mp Dfp_FMAErrMod_mp Dfp_FMTC_NonMonotonMap_mp Dfp_FrmMngANFRADMOMPT_mp Dfp_FrmMngASC1_mp Dfp_FrmMngASC2_mp Dfp_FrmMngASC3_mp Dfp_FrmMngASC4_mp Dfp_FrmMngBOS_RESET2_mp Dfp_FrmMngBOS_RESET_mp Dfp_FrmMngDMANFAFS_mp Dfp_FrmMngDRMANFSSG_mp Dfp_FrmMngEGS1_mp Dfp_FrmMngEGS2_mp Dfp_FrmMngGEARBX_DATA2_mp Dfp_FrmMngGEARBX_DATA_mp Dfp_FrmMngHEAT_AC_mp Dfp_FrmMngINSTR2_mp Dfp_FrmMngINSTR3_mp Dfp_FrmMngLENKRADWINKEL_mp Dfp_FrmMngMILEAGE_RANGE_mp Dfp_FrmMngMSPHISYNC_mp Dfp_FrmMngMST4_mp Dfp_FrmMngMST5_mp Dfp_FrmMngOPCRCTLACC_mp Dfp_FrmMngParkConsumer_mp Dfp_FrmMngPRGG_CCTR_mp Dfp_FrmMngPWRMNG_LOADV_mp Dfp_FrmMngRQSTGEFAN_mp Dfp_FrmMngSLV4_mp Dfp_FrmMngSLV5_mp Dfp_FrmMngSSGErr_mp Dfp_FrmMngSSGShOff_mp Dfp_FrmMngSTAT_ANH_mp Dfp_FrmMngSTAT_ARS_mp Dfp_FrmMngSTAT_DSC_mp Dfp_FrmMngSTAT_EKP_mp Dfp_FrmMngSTAT_KOMBI_mp Dfp_FrmMngSTAT_SITZ_mp Dfp_FrmMngstCurr_mp Dfp_FrmMngStOBDGbxMilOf_mp Dfp_FrmMngStOBDGbxMilOn_mp Dfp_FrmMngswtPSPOff_mp Dfp_FrmMngTEMPRELTIME_mp Dfp_FrmMngTERMINAL_mp Dfp_FrmMngTIME_DATE_mp Dfp_FrmMngTORQUE_DSC_mp Dfp_FrmMngTORQUE_GEARBX_mp Dfp_FrmMngTrq_ReqACC_mp Dfp_FrmMngVEH_MOD_mp Dfp_FrmMngVELOCITY_mp Dfp_FrmMngWHEEL_SPEED_mp Dfp_FTSCD_mp Dfp_GearbxIncMax_mp Dfp_GlwCDGlwCirc1_mp Dfp_GlwCDGlwCirc2_mp Dfp_GlwCDGlwCirc3_mp Dfp_GlwCDGlwCirc4_mp Dfp_GlwCDGlwCirc5_mp Dfp_GlwCDGlwCirc6_mp Dfp_GlwCDGlwCirc7_mp Dfp_GlwCDGlwCirc8_mp Dfp_GlwCD_mp Dfp_GlwCtl_mp Dfp_HWEMonCom_mp Dfp_HWEMonEEPROM_mp Dfp_HWEMonRcyLocked_mp Dfp_HWEMonRcySuppressed_mp Dfp_HWEMonRcyVisible_mp Dfp_HWEMonUMaxSupply_mp Dfp_HWEMonUMinSupply_mp Dfp_IATSCD_CATSSec_mp Dfp_IATSCD_CATS_mp Dfp_IATSCD_mp Dfp_ImmCtlImmCD_mp Dfp_ImmCtlImmEep_mp Dfp_ImmCtlMpl_mp Dfp_IndSys1_mp Dfp_IndSys2_mp Dfp_InjCrv_InjLim_mp Dfp_InjCtlAdjQnt_mp Dfp_InjCtlDrift_mp Dfp_InjVCDActrChrg_mp Dfp_InjVCDActrEnrg1_mp Dfp_InjVCDActrEnrg2_mp Dfp_InjVCDActrEnrg3_mp Dfp_InjVCDActrEnrg4_mp Dfp_InjVCDActrEnrg5_mp Dfp_InjVCDActrEnrg6_mp Dfp_InjVCDActrEnrg7_mp Dfp_InjVCDActrEnrg8_mp Dfp_InjVCDActrVolt_mp Dfp_InjVCDClsBank1_mp Dfp_InjVCDClsBank2_mp Dfp_InjVCDMonCab_mp Dfp_InjVCDMonSwt_mp Dfp_InjVCDShOffDCDC_mp Dfp_InjVCDUBuf1_mp Dfp_InjVCDUBuf2_mp Dfp_InjVCD_CY370Ampl_mp Dfp_InjVCD_DrvTimeRcy_mp Dfp_InjVCD_DrvTime_mp Dfp_InjVCD_TPUErr_mp Dfp_InjVlvBnk1A_mp Dfp_InjVlvBnk1B_mp Dfp_InjVlvBnk2A_mp Dfp_InjVlvBnk2B_mp Dfp_InjVlvChipA_mp Dfp_InjVlvChipB_mp Dfp_InjVlvCyl1A_mp Dfp_InjVlvCyl1B_mp Dfp_InjVlvCyl1C_mp Dfp_InjVlvCyl2A_mp Dfp_InjVlvCyl2B_mp Dfp_InjVlvCyl2C_mp Dfp_InjVlvCyl3A_mp Dfp_InjVlvCyl3B_mp Dfp_InjVlvCyl3C_mp Dfp_InjVlvCyl4A_mp Dfp_InjVlvCyl4B_mp Dfp_InjVlvCyl4C_mp Dfp_InjVlvCyl5A_mp Dfp_InjVlvCyl5B_mp Dfp_InjVlvCyl5C_mp Dfp_InjVlvCyl6A_mp Dfp_InjVlvCyl6B_mp Dfp_InjVlvCyl6C_mp Dfp_InjVlvCyl7A_mp Dfp_InjVlvCyl7B_mp Dfp_InjVlvCyl7C_mp Dfp_InjVlvCyl8A_mp Dfp_InjVlvCyl8B_mp Dfp_InjVlvCyl8C_mp Dfp_InjVlvNVC1_mp Dfp_InjVlvNVC2_mp Dfp_InjVlvNVC3_mp Dfp_InjVlvNVC4_mp Dfp_InjVlvNVC5_mp Dfp_InjVlvNVC6_mp Dfp_InjVlvNVC7_mp Dfp_InjVlvNVC8_mp Dfp_KeyCheck_mp Dfp_Layer_BSD_mp Dfp_Layer_GEN_mp Dfp_Layer_IBS1_mp Dfp_Layer_IBS2_mp Dfp_Layer_IBS3_mp Dfp_Layer_MANHYDR_mp Dfp_Layer_MANLUFT_mp Dfp_Layer_PMBATT_mp Dfp_Layer_PMBN_mp Dfp_Layer_PMRUHVERL_mp Dfp_Layer_QLT_mp Dfp_Layer_TANS_mp Dfp_Layer_TOENS_mp Dfp_Layer_TUMG_mp Dfp_LIGovECUTransMode_mp Dfp_LPACD_Max_mp Dfp_LPACD_Min_mp Dfp_LPACD_SigNpl_mp Dfp_LSUCDCircNernst0B1_mp Dfp_LSUCDCircNernst0B2_mp Dfp_LSUCDCircPumpCur0B1_mp Dfp_LSUCDCircPumpCur0B2_mp Dfp_LSUCDCircVirtGnd0B1_mp Dfp_LSUCDCircVirtGnd0B2_mp Dfp_LSUCDHeater0B1_mp Dfp_LSUCDHeater0B2_mp Dfp_LSUCDHtCoup0B1_mp Dfp_LSUCDHtCoup0B2_mp Dfp_LSUCDO20B1_mp Dfp_LSUCDO20B2_mp Dfp_LSUCDO2Clb0B1_mp Dfp_LSUCDO2Clb0B2_mp Dfp_LSUCDRiClb0B1_mp Dfp_LSUCDRiClb0B2_mp Dfp_LSUCDSPI0B1_mp Dfp_LSUCDSPI0B2_mp Dfp_LSUCDSPIBattLow0B1_mp Dfp_LSUCDSPIBattLow0B2_mp Dfp_LSUCDWireIP0B1_mp Dfp_LSUCDWireIP0B2_mp Dfp_LSUCtlRiExc0B1_mp Dfp_LSUCtlRiExc0B2_mp Dfp_LSUMon1SensB1_mp Dfp_LSUMon1SensB2_mp Dfp_LSUMon2SensB1_mp Dfp_LSUMon2SensB2_mp Dfp_MeUnCDNoLoad_mp Dfp_MeUnCDSCBat_mp Dfp_MeUnCDSCGnd_mp Dfp_MeUnCD_ADC_mp Dfp_MeUnCD_SigTst_mp Dfp_MIL_mp Dfp_Montr_mp Dfp_MRlyCD_mp Dfp_MSidCD_Comm_mp Dfp_MSidCD_EcuMixed_mp Dfp_MSidCD_Pin_mp Dfp_MSidCD_Select_mp Dfp_MSidCD_Sel_INI_mp Dfp_MSid_regEEPDiff_mp Dfp_MSid_SwCmp_mp Dfp_MSMonConsist_mp Dfp_MSMonPFlt1_mp Dfp_MSMonPFlt2_mp Dfp_MSMonPFlt3_mp Dfp_MSMonPFlt4_mp Dfp_MSMon_AirCtl_mp Dfp_MSMon_AirSys0_mp Dfp_MSMon_AirSys1_mp Dfp_MSMon_AirSys2_mp Dfp_MSMon_AirSys3_mp Dfp_MSMon_AirSys4_mp Dfp_MSMon_AirSys7_mp Dfp_MSMon_ARS_TO_mp Dfp_MSMon_CanDef_mp Dfp_MSMon_CoEng_OffVeh_mp Dfp_MSMon_CoEng_Rev1_mp Dfp_MSMon_CoEng_Rev2_mp Dfp_MSMon_CoEng_RevMS_mp Dfp_MSMon_DSC_TO_mp Dfp_MSMon_EGS_TO_mp Dfp_MSMon_FrmMngCoEng_mp Dfp_MSMon_FrmMngPT2_mp Dfp_MSMon_FrmMngPT_mp Dfp_MSMon_Mil_mp Dfp_MSMon_mp Dfp_MSMon_NetMngPtCan_mp Dfp_MSMon_qLimErr_mp Dfp_MSMon_RailCDPMon_mp Dfp_MSMon_StEGS_mp Dfp_MSMon_SysLamp_mp Dfp_MSMon_trqCoDT_mp Dfp_MSMon_trqCoVehLim_mp Dfp_MSMon_trqCoVeh_mp Dfp_MSMon_trqDesExtRev_mp Dfp_MSMon_trqDesExt_mp Dfp_MSMon_trqLimErr1_mp Dfp_MSMon_trqLimErr2_mp Dfp_MSMon_trqLimErr3_mp Dfp_MSMon_trqLimErr4_mp Dfp_MSMon_trqLimErr_mp Dfp_MSMon_ZFCClbActv_mp Dfp_NetMngDeviceA_mp Dfp_NetMngDeviceB_mp Dfp_NetMngDeviceC_mp Dfp_NetMngPrvCanSlave_mp Dfp_NetMngPrvCan_mp Dfp_NetMngPtCanSlave_mp Dfp_NetMngPtCan_mp Dfp_OPSCD_anain_mp Dfp_OPSCD_Lamp_mp Dfp_OTSCD_mp Dfp_OvRMonSigA_mp Dfp_OvRMon_mp Dfp_OxiCCDTPreB1_mp Dfp_OxiCCDTPreB2_mp Dfp_PCBS_mp Dfp_PCR_BalGvnr_mp Dfp_PCR_GovDevNeg_mp Dfp_PCR_GovDevPos_mp Dfp_PCR_LPGvnrDvtNeg_mp Dfp_PCR_LPGvnrDvtPos_mp Dfp_PCVCDNoLoad_mp Dfp_PCVCDSCBat_mp Dfp_PCVCDSCGnd_mp Dfp_PCVCD_ADC_mp Dfp_PCVCD_SigTst_mp Dfp_PFltAPSensB1_mp Dfp_PFltAPSensB2_mp Dfp_PFltAPSPlaus_mp Dfp_PFltBPSPlaus_mp Dfp_PFltCDPPreB1_mp Dfp_PFltCDPPreB2_mp Dfp_PFltCDTPreB1_mp Dfp_PFltCDTPreB2_mp Dfp_PFltCharB1_mp Dfp_PFltCharB2_mp Dfp_PFltDltOxiPreTwFlw_mp Dfp_PFltDltPreTwFlw_mp Dfp_PFltEngPrtB1_mp Dfp_PFltEngPrtB2_mp Dfp_PFltmSotDiffMaxB1_mp Dfp_PFltmSotDiffMaxB2_mp Dfp_PFltOvldInhRgnB1_mp Dfp_PFltOvldInhRgnB2_mp Dfp_PFltOvldTrqLimB1_mp Dfp_PFltOvldTrqLimB2_mp Dfp_PFltPresDynPlausB1_mp Dfp_PFltPresDynPlausB2_mp Dfp_PFltPresPlausB1_mp Dfp_PFltPresPlausB2_mp Dfp_PFltPresSensB1_mp Dfp_PFltPresSensB2_mp Dfp_PFltPresSensFrz_mp Dfp_PFltPresSensHsLnB1_mp Dfp_PFltPresSensHsLnB2_mp Dfp_PFltPresSensSotB1_mp Dfp_PFltPresSensSotB2_mp Dfp_PFltRgnPerm_mp Dfp_PFltTempDwnStrmB1_mp Dfp_PFltTempDwnStrmB2_mp Dfp_PFltTempSensB1_mp Dfp_PFltTempSensB2_mp Dfp_PFltTempUpStrmB1_mp Dfp_PFltTempUpStrmB2_mp Dfp_PFlt_tOxiPreMaxB1_mp Dfp_PFlt_tOxiPreMaxB2_mp Dfp_PFlt_tOxiPreMxRgnB1_mp Dfp_PFlt_tOxiPreMxRgnB2_mp Dfp_PFlt_tPreMaxB1_mp Dfp_PFlt_tPreMaxB2_mp Dfp_PFlt_tPreMaxRgnB1_mp Dfp_PFlt_tPreMaxRgnB2_mp Dfp_PresPlausDblDef_mp Dfp_QLTCD_mp Dfp_RailCDOfsTst_mp Dfp_RailCD_mp Dfp_RailCD_PMonStrt_mp Dfp_RailCPC1_mp Dfp_RailCPC3_mp Dfp_RailCPC4_mp Dfp_RailCtlModeMeUnDiag_mp Dfp_RailCtlModePCVDiag_mp Dfp_RailMeUn0_mp Dfp_RailMeUn1_mp Dfp_RailMeUn2_mp Dfp_RailMeUn3_mp Dfp_RailMeUn4_mp Dfp_RailPCV0_mp Dfp_RailPCV1_mp Dfp_RailPCV2_mp Dfp_RailPCV3_mp Dfp_RailPCV4_mp Dfp_RailPCV5_mp Dfp_SOPTst_mp Dfp_SSpMon1_mp Dfp_SSpMon2_mp Dfp_SSpMon3_mp Dfp_SSpMon4_mp Dfp_SSpMon5_mp Dfp_SSpMon6_mp Dfp_StrtCD_Actr_mp Dfp_StSysTrqShutOff_mp Dfp_SWChk_CycSigChkDat_mp Dfp_SWChk_CycSigChkPrg_mp Dfp_SysLamp_mp Dfp_T15CD_mp Dfp_TGearbx_mp Dfp_ThrVlvMon_mp Dfp_TPUMon_mp Dfp_TVACD_AirMon1_mp Dfp_TVACD_AirMon2_mp Dfp_TVACD_Max2_mp Dfp_TVACD_Max_mp Dfp_TVACD_Min2_mp Dfp_TVACD_Min_mp Dfp_TVACD_SigNpl2_mp Dfp_TVACD_SigNpl_mp Dfp_TVACD_TVADia1_mp Dfp_TVACD_TVADia21_mp Dfp_TVACD_TVADia22_mp Dfp_TVACD_TVADia23_mp Dfp_TVACD_TVADia24_mp Dfp_TVACD_TVADia2_mp Dfp_TVACD_TVADia3_mp Dfp_TVACD_TVADia4_mp Dfp_VSACD_DiaDet_mp Dfp_VSACD_DioInDia1_mp Dfp_VSACD_DioInDia2_mp Dfp_VSACD_DioInDia3_mp Dfp_VSACD_DioInDia4_mp Dfp_VSACD_DioInMin_mp Dfp_VSACD_Max_mp Dfp_VSACD_Min_mp Dfp_VSACD_SigNpl_mp Dfp_VSACD_VSADia1_mp Dfp_VSACD_VSADia2_mp Dfp_VSACD_VSADia3_mp Dfp_VSACD_VSADia4_mp Dfp_VSSCD1_mp Dfp_VSSCD2_mp Dfp_WdCom_mp /end OUT_MEASUREMENT
/end FUNCTION
/begin FUNCTION dsm_auto_env16 "" /end FUNCTION
/begin COMPU_METHOD OneToOne "eins zu eins (physikalischer Wert ist gleich dem internen Wert)" RAT_FUNC "%6.2" "-" COEFFS 0 1 0 0 0 1 /end COMPU_METHOD
/end MODULE
/end PROJECT
