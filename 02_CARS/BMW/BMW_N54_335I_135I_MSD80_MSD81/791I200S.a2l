ASAP2_VERSION 1 41
/begin PROJECT MSD85 "Spray Guided DI-System with Piezo Injectors for 8-Cylinder"
/begin HEADER "_default_HeaderComment" PROJECT_NO _91 /end HEADER
/begin MODULE _default_ModuleName "_default_ModuleLongIdentifier"
/begin MOD_COMMON "_default_ModCommonComment" DEPOSIT ABSOLUTE BYTE_ORDER MSB_LAST ALIGNMENT_BYTE 1 ALIGNMENT_WORD 2 ALIGNMENT_LONG 2 ALIGNMENT_FLOAT32_IEEE 2 ALIGNMENT_FLOAT64_IEEE 4 /end MOD_COMMON
/begin MEASUREMENT lv_err_bn_msw "Present error BN2000" UBYTE _CNV_S_2_RANGE__0___1_CM 1 100. 0. 1. DISPLAY_IDENTIFIER LV_ERR_BN_MSW ECU_ADDRESS 0xd0007faa BIT_MASK 0x1 /end MEASUREMENT
/begin CHARACTERISTIC c_amp_hys "maximum value between two acquired ambient pressure values" VALUE 0xa080ba88 _REC_VAL_20_u2 5434. _CNV_A_R_LINEAR_____27_CM 0. 5434. DISPLAY_IDENTIFIER C_AMP_HYS FORMAT "%7.2" /end CHARACTERISTIC
/begin CHARACTERISTIC ip_amp_raw_cor__vs "correlation table for the linearization of the ambient pressure with the vehicle speed" CURVE 0xa0809f94 _REC_CUR_20_u2_u1 5434. _CNV_A_R_LINEAR_____27_CM 0. 5434. DISPLAY_IDENTIFIER IP_AMP_RAW_COR__VS FORMAT "%7.2"
 /begin AXIS_DESCR COM_AXIS vs _CNV_A_R_LINEAR_____6_CM 8 0. 255. FORMAT "%3.0" AXIS_PTS_REF ldp_vs__amp_raw_cor /end AXIS_DESCR
/end CHARACTERISTIC
/begin MEASUREMENT amp_mes "valid ambient pressure" UWORD _CNV_A_R_LINEAR_____27_CM 1 100. 0. 5434. DISPLAY_IDENTIFIER AMP_MES ECU_ADDRESS 0xd000a77c FORMAT "%7.2" /end MEASUREMENT
/begin MEASUREMENT amp_raw_prel "preliminary ambient pressure raw value" UWORD _CNV_A_R_LINEAR_____27_CM 1 100. 0. 5434. DISPLAY_IDENTIFIER AMP_RAW_PREL ECU_ADDRESS 0xd000035e FORMAT "%7.2" /end MEASUREMENT
/begin CHARACTERISTIC c_amp_crlc "correlation value for the compensation of the noise signal of the ambient pressure signal" VALUE 0xa080ba84 _REC_VAL_20_u1 0.99609375 _CNV_A_R_LINEAR_____28_CM 0. 0.99609375 DISPLAY_IDENTIFIER C_AMP_CRLC FORMAT "%5.3" /end CHARACTERISTIC
/begin CHARACTERISTIC c_fac_amp_min "BOT for FAC_AMP" VALUE 0xa080bcb4 _REC_VAL_20_u2 1.99996948242188 _CNV_A_R_LINEAR_____9_CM 0. 1.99996948242188 DISPLAY_IDENTIFIER C_FAC_AMP_MIN FORMAT "%7.5" /end CHARACTERISTIC
/begin CHARACTERISTIC c_fac_amp_max "TOP for FAC_AMP" VALUE 0xa080bcb2 _REC_VAL_20_u2 1.99996948242188 _CNV_A_R_LINEAR_____9_CM 0. 1.99996948242188 DISPLAY_IDENTIFIER C_FAC_AMP_MAX FORMAT "%7.5" /end CHARACTERISTIC
/begin MEASUREMENT fac_amp "factor of the ambient pressure related to the reference ambient pressure" UWORD _CNV_A_R_LINEAR_____9_CM 1 100. 0. 1.99996948242188 DISPLAY_IDENTIFIER FAC_AMP ECU_ADDRESS 0xd000a77e FORMAT "%7.5" /end MEASUREMENT
/begin MEASUREMENT fac_amp_prel "preliminary factor of the ambient pressure related to the reference ambient pressure" UWORD _CNV_A_R_LINEAR_____9_CM 1 100. 0. 1.99996948242188 DISPLAY_IDENTIFIER FAC_AMP_PREL ECU_ADDRESS 0xd0000360 FORMAT "%7.5" /end MEASUREMENT
/begin AXIS_PTS ldp_vs__amp_raw_cor "" 0xa08092ac vs _REC_AXS_20_u1 255. _CNV_A_R_LINEAR_____6_CM 8 0. 255. FORMAT "%3.0" /end AXIS_PTS
/begin CHARACTERISTIC ip_amp_raw__v_amp "correlation table for the linearization of the ambient pressure value acquisition with Motorola sensor" CURVE 0xa0809f84 _REC_CUR_20_u2_u2 5434. _CNV_A_R_LINEAR_____27_CM 0. 5434. DISPLAY_IDENTIFIER IP_AMP_RAW__V_AMP FORMAT "%7.2"
 /begin AXIS_DESCR COM_AXIS v_amp _CNV_A_R_LINEAR_____2_CM 8 0. 4.9951171875 FORMAT "%5.3" AXIS_PTS_REF ldp_v_amp__amp_raw /end AXIS_DESCR
/end CHARACTERISTIC
/begin AXIS_PTS ldp_v_amp__amp_raw "" 0xa080907c v_amp _REC_AXS_20_u2 4.9951171875 _CNV_A_R_LINEAR_____2_CM 8 0. 4.9951171875 FORMAT "%5.3" /end AXIS_PTS
/begin MEASUREMENT amp_cor "corrected ambient pressure" UWORD _CNV_A_R_LINEAR_____27_CM 1 100. 0. 5434. DISPLAY_IDENTIFIER AMP_COR ECU_ADDRESS 0xd0000362 FORMAT "%7.2" /end MEASUREMENT
/begin MEASUREMENT amp_raw "ambient pressure raw value" UWORD _CNV_A_R_LINEAR_____27_CM 1 100. 0. 5434. DISPLAY_IDENTIFIER AMP_RAW ECU_ADDRESS 0xd000035c FORMAT "%7.2" /end MEASUREMENT
/begin MEASUREMENT tq_loss_ars_av_can "torque loss actual value ARS from CAN" SWORD _CNV_A_R_LINEAR_____31_CM 1 100. -1024. 1023.96875 DISPLAY_IDENTIFIER TQ_LOSS_ARS_AV_CAN ECU_ADDRESS 0xd000a044 FORMAT "%8.2" /end MEASUREMENT
/begin MEASUREMENT tq_loss_ars_sp_can "torque loss setpoint ARS from CAN" SWORD _CNV_A_R_LINEAR_____31_CM 1 100. -1024. 1023.96875 DISPLAY_IDENTIFIER TQ_LOSS_ARS_SP_CAN ECU_ADDRESS 0xd000a046 FORMAT "%8.2" /end MEASUREMENT
/begin MEASUREMENT veh_key_nr "vehicle key number" UBYTE _CNV_A_R_LINEAR_____0_CM 1 100. 0. 15. DISPLAY_IDENTIFIER VEH_KEY_NR ECU_ADDRESS 0xd0000417 FORMAT "%2.0" /end MEASUREMENT
/begin MEASUREMENT state_ars_can "status anti roll stabilization via CAN" UBYTE _CNV_S_3_STATE_ARS__32_CM 1 100. 0. 3. DISPLAY_IDENTIFIER STATE_ARS_CAN ECU_ADDRESS 0xd00081bf /end MEASUREMENT
/begin MEASUREMENT state_igk_can "status ignition key via CAN" UBYTE _CNV_S_3_STATE_IGK__33_CM 1 100. 0. 2. DISPLAY_IDENTIFIER STATE_IGK_CAN ECU_ADDRESS 0xd00081c0 /end MEASUREMENT
/begin MEASUREMENT lv_tcs_lih_can "logical variable traction control system limp home" UBYTE _CNV_S_2_RANGE__0___1_CM 1 100. 0. 1. DISPLAY_IDENTIFIER LV_TCS_LIH_CAN ECU_ADDRESS 0xd000821d BIT_MASK 0x1 /end MEASUREMENT
/begin MEASUREMENT lv_tq_pste_3_can_ena "PSTE 3 (EHB3) torque request via CAN enabled" UBYTE _CNV_S_2_RANGE__0___1_CM 1 100. 0. 1. DISPLAY_IDENTIFIER LV_TQ_PSTE_3_CAN_ENA ECU_ADDRESS 0xd0008226 BIT_MASK 0x1 /end MEASUREMENT
/begin MEASUREMENT lv_tq_pste_3_can_lih "PSTE 3 (EHB3) torque request via CAN in limp home" UBYTE _CNV_S_2_RANGE__0___1_CM 1 100. 0. 1. DISPLAY_IDENTIFIER LV_TQ_PSTE_3_CAN_LIH ECU_ADDRESS 0xd0008227 BIT_MASK 0x1 /end MEASUREMENT
/begin MEASUREMENT lv_tq_pste_3_can_di "PSTE 3 (EHB3) torque request via CAN disabled" UBYTE _CNV_S_2_RANGE__0___1_CM 1 100. 0. 1. DISPLAY_IDENTIFIER LV_TQ_PSTE_3_CAN_DI ECU_ADDRESS 0xd0008228 BIT_MASK 0x1 /end MEASUREMENT
/begin MEASUREMENT state_tcs_intv "status traction control system via CAN" UBYTE _CNV_S_4_STATE_TCS__34_CM 1 100. 0. 3. DISPLAY_IDENTIFIER STATE_TCS_INTV ECU_ADDRESS 0xd00081e1 /end MEASUREMENT
/begin MEASUREMENT state_wal_can "logical variable fuel reserve" UBYTE _CNV_S_3_STATE_WAL__35_CM 1 100. 0. 3. DISPLAY_IDENTIFIER STATE_WAL_CAN ECU_ADDRESS 0xd0000437 /end MEASUREMENT
/begin MEASUREMENT t_ctr_rel_can "relative time counter (reseted at Kl. 30 OFF)" ULONG _CNV_A_R_LINEAR_____36_CM 1 100. 0. 4294967294. DISPLAY_IDENTIFIER T_CTR_REL_CAN ECU_ADDRESS 0xd00003ac FORMAT "%11.0" /end MEASUREMENT
/begin MEASUREMENT v_sp_gen "target generator voltage " UBYTE _CNV_A_R_LINEAR_____37_CM 1 100. 0. 26. DISPLAY_IDENTIFIER V_SP_GEN ECU_ADDRESS 0xd000043b FORMAT "%4.1" /end MEASUREMENT
/begin MEASUREMENT t_can "day counter absolute (counts the days at sufficient mains voltage )" UWORD _CNV_A_R_LINEAR_____38_CM 1 100. 0. 65534. DISPLAY_IDENTIFIER T_CAN ECU_ADDRESS 0xd000a05c FORMAT "%5.0" /end MEASUREMENT
/begin MEASUREMENT state_tcs_ctl "status closed looped control via CAN" UBYTE _CNV_S_10_STATE_TCS__39_CM 1 100. 0. 255. DISPLAY_IDENTIFIER STATE_TCS_CTL ECU_ADDRESS 0xd00081e2 /end MEASUREMENT
/begin MEASUREMENT state_tcs_dece "status closed loop control via CAN" UBYTE _CNV_S_5_STATE_TCS__40_CM 1 100. 0. 15. DISPLAY_IDENTIFIER STATE_TCS_DECE ECU_ADDRESS 0xd00081e3 /end MEASUREMENT
/begin MEASUREMENT ac_veh_lgt_tcs "vehicle acceleration (longitudinal) TCS" SWORD _CNV_A_R_LINEAR_____41_CM 1 100. -51.175 51.175 DISPLAY_IDENTIFIER AC_VEH_LGT_TCS ECU_ADDRESS 0xd000a04c FORMAT "%8.3" /end MEASUREMENT
/begin MEASUREMENT ac_veh_trv_tcs "vehicle acceleration (transversal) TCS" SWORD _CNV_A_R_LINEAR_____41_CM 1 100. -51.175 51.175 DISPLAY_IDENTIFIER AC_VEH_TRV_TCS ECU_ADDRESS 0xd000a04e FORMAT "%8.3" /end MEASUREMENT
/begin MEASUREMENT state_mod_gb "State mode gearbox : SSC (Sleeping Starter Clutch), SBC (Stand By Control)" UBYTE _CNV_S_5_STATE_MOD__42_CM 1 100. 0. 7. DISPLAY_IDENTIFIER STATE_MOD_GB ECU_ADDRESS 0xd00081e8 /end MEASUREMENT
/begin MEASUREMENT state_tcs_can "status traction control system via CAN" UBYTE _CNV_S_6_STATE_TCS__43_CM 1 100. 0. 7. DISPLAY_IDENTIFIER STATE_TCS_CAN ECU_ADDRESS 0xd0000420 /end MEASUREMENT
/begin MEASUREMENT state_temp_gb "State overtemperature gearbox  (AT)- request for cooling (overheating protection) via ECT" UBYTE _CNV_S_4_STATE_TEMP_44_CM 1 100. 0. 3. DISPLAY_IDENTIFIER STATE_TEMP_GB ECU_ADDRESS 0xd00081e6 /end MEASUREMENT
/begin MEASUREMENT temp_gb "Temperature gearbox (AT) - request for cooling (overheating protection) via ECF" UBYTE _CNV_A_R_LINEAR_____26_CM 1 100. -40. 215. DISPLAY_IDENTIFIER TEMP_GB ECU_ADDRESS 0xd00081e7 FORMAT "%3.0" /end MEASUREMENT
/begin CHARACTERISTIC c_temp_gb_sub "Default temperature for automatic gearbox in case of error TEMP_GB" VALUE 0xa080c313 _REC_VAL_20_u1 255. _CNV_A_R_LINEAR_____26_CM -40. 215. DISPLAY_IDENTIFIER C_TEMP_GB_SUB FORMAT "%3.0" /end CHARACTERISTIC
/begin MEASUREMENT vs_icl_disp "displayed vehicle speed (speedometer)" UWORD _CNV_A_R_LINEAR_____45_CM 1 100. 0. 409.4 DISPLAY_IDENTIFIER VS_ICL_DISP ECU_ADDRESS 0xd000a058 FORMAT "%5.1" /end MEASUREMENT
/begin MEASUREMENT lv_dcc_lih_can "LV indicating DCC intervention limp home" UBYTE _CNV_S_2_RANGE__0___1_CM 1 100. 0. 1. DISPLAY_IDENTIFIER LV_DCC_LIH_CAN ECU_ADDRESS 0xd0008218 BIT_MASK 0x1 /end MEASUREMENT
/begin MEASUREMENT lv_dcc_puc_inh "inhibitation of PUC required by DCC" UBYTE _CNV_S_2_RANGE__0___1_CM 1 100. 0. 1. DISPLAY_IDENTIFIER LV_DCC_PUC_INH ECU_ADDRESS 0xd000821a BIT_MASK 0x1 /end MEASUREMENT
/begin MEASUREMENT tq_dcc_slow_bn "torque target (slow) for DCC via CAN interface" SWORD _CNV_A_R_LINEAR_____31_CM 1 100. -1024. 1023.96875 DISPLAY_IDENTIFIER TQ_DCC_SLOW_BN ECU_ADDRESS 0xd000a03a FORMAT "%8.2" /end MEASUREMENT
/begin MEASUREMENT tq_dcc_fast_bn "torque target (fast) for DCC via CAN interface" SWORD _CNV_A_R_LINEAR_____31_CM 1 100. -1024. 1023.96875 DISPLAY_IDENTIFIER TQ_DCC_FAST_BN ECU_ADDRESS 0xd000a038 FORMAT "%8.2" /end MEASUREMENT
/begin MEASUREMENT state_etcu_intv "status traction control system via CAN" UBYTE _CNV_S_4_STATE_ETCU_46_CM 1 100. 0. 3. DISPLAY_IDENTIFIER STATE_ETCU_INTV ECU_ADDRESS 0xd00081e5 /end MEASUREMENT
/begin MEASUREMENT state_dcc_intv "status torque target DCC via CAN interface" UBYTE _CNV_S_4_STATE_DCC__47_CM 1 100. 0. 3. DISPLAY_IDENTIFIER STATE_DCC_INTV ECU_ADDRESS 0xd00081b6 /end MEASUREMENT
/begin MEASUREMENT state_dcc_puc_inh "status request PUC-inhibitation via CAN interface - DCC" UBYTE _CNV_S_3_STATE_DCC__48_CM 1 100. 0. 3. DISPLAY_IDENTIFIER STATE_DCC_PUC_INH ECU_ADDRESS 0xd00081b7 /end MEASUREMENT
/begin MEASUREMENT state_dcc "Status DCC" UBYTE _CNV_S_8_STATE_DCC_49_CM 1 100. 0. 7. DISPLAY_IDENTIFIER STATE_DCC ECU_ADDRESS 0xd00081b9 /end MEASUREMENT
/begin MEASUREMENT lv_dcc_off_ack "Acknowledge bit for switch-off DCC" UBYTE _CNV_S_2_RANGE__0___1_CM 1 100. 0. 1. DISPLAY_IDENTIFIER LV_DCC_OFF_ACK ECU_ADDRESS 0xd0008219 BIT_MASK 0x1 /end MEASUREMENT
/begin MEASUREMENT lv_err_tq_loss_ars_av_can "interface bit for TQ_LOSS_ARS calculation in case of error via CAN" UBYTE _CNV_S_2_RANGE__0___1_CM 1 100. 0. 1. DISPLAY_IDENTIFIER LV_ERR_TQ_LOSS_ARS_AV_CAN ECU_ADDRESS 0xd000821c BIT_MASK 0x1 /end MEASUREMENT
/begin MEASUREMENT lv_err_tq_loss_ars_sp_can "interface bit for TQ_LOSS_ARS calculation in case of error via CAN" UBYTE _CNV_S_2_RANGE__0___1_CM 1 100. 0. 1. DISPLAY_IDENTIFIER LV_ERR_TQ_LOSS_ARS_SP_CAN ECU_ADDRESS 0xd000821b BIT_MASK 0x1 /end MEASUREMENT
/begin MEASUREMENT lv_rly_st_can "status starter relay" UBYTE _CNV_S_2_RANGE__0___1_CM 1 100. 0. 1. DISPLAY_IDENTIFIER LV_RLY_ST_CAN ECU_ADDRESS 0xd000822a BIT_MASK 0x1 /end MEASUREMENT
/begin MEASUREMENT tcc_can_cas "free running test cycle counter CAS (alive counter)" UBYTE _CNV_A_R_LINEAR_____50_CM 1 100. 0. 14. DISPLAY_IDENTIFIER TCC_CAN_CAS ECU_ADDRESS 0xd000041a FORMAT "%2.0" /end MEASUREMENT
/begin MEASUREMENT tcc_can_etcu_3 "free running test cycle counter ETCU_3 (alive counter)" UBYTE _CNV_A_R_LINEAR_____50_CM 1 100. 0. 14. DISPLAY_IDENTIFIER TCC_CAN_ETCU_3 ECU_ADDRESS 0xd000042b FORMAT "%2.0" /end MEASUREMENT
/begin MEASUREMENT tq_tcs_fast_bn "torque target (fast) due to TCS via CAN" SWORD _CNV_A_R_LINEAR_____31_CM 1 100. -1024. 1023.96875 DISPLAY_IDENTIFIER TQ_TCS_FAST_BN ECU_ADDRESS 0xd000a048 FORMAT "%8.2" /end MEASUREMENT
/begin MEASUREMENT tcc_can_tq_dcc "free running test cycle counter TQ_DCC (alive counter)" UBYTE _CNV_A_R_LINEAR_____50_CM 1 100. 0. 14. DISPLAY_IDENTIFIER TCC_CAN_TQ_DCC ECU_ADDRESS 0xd000040b FORMAT "%2.0" /end MEASUREMENT
/begin MEASUREMENT tq_tcs_slow_bn "torque target (slow) due to TCS via CAN" SWORD _CNV_A_R_LINEAR_____31_CM 1 100. -1024. 1023.96875 DISPLAY_IDENTIFIER TQ_TCS_SLOW_BN ECU_ADDRESS 0xd000a04a FORMAT "%8.2" /end MEASUREMENT
/begin MEASUREMENT tq_gs_slow_bn "torque target (slow) for GS via CAN interface" SWORD _CNV_A_R_LINEAR_____31_CM 1 100. -1024. 1023.96875 DISPLAY_IDENTIFIER TQ_GS_SLOW_BN ECU_ADDRESS 0xd000a052 FORMAT "%8.2" /end MEASUREMENT
/begin MEASUREMENT tcc_can_tq_tcs "free running test cycle counter TQ_TCS (alive counter)" UBYTE _CNV_A_R_LINEAR_____50_CM 1 100. 0. 14. DISPLAY_IDENTIFIER TCC_CAN_TQ_TCS ECU_ADDRESS 0xd0000423 FORMAT "%2.0" /end MEASUREMENT
/begin MEASUREMENT lv_tq_dcc_inc_req "LV indicating torque increse required by DCC" UBYTE _CNV_S_2_RANGE__0___1_CM 1 100. 0. 1. DISPLAY_IDENTIFIER LV_TQ_DCC_INC_REQ ECU_ADDRESS 0xd0008216 BIT_MASK 0x1 /end MEASUREMENT
/begin MEASUREMENT tq_gs_fast_bn "torque target (fast) for GS via CAN interface " SWORD _CNV_A_R_LINEAR_____31_CM 1 100. -1024. 1023.96875 DISPLAY_IDENTIFIER TQ_GS_FAST_BN ECU_ADDRESS 0xd000a050 FORMAT "%8.2" /end MEASUREMENT
/begin MEASUREMENT tq_amt_fast_bn "torque target (fast) for AMT via CAN interface " SWORD _CNV_A_R_LINEAR_____31_CM 1 100. -1024. 1023.96875 DISPLAY_IDENTIFIER TQ_AMT_FAST_BN ECU_ADDRESS 0xd000a054 FORMAT "%8.2" /end MEASUREMENT
/begin MEASUREMENT tq_amt_slow_bn "torque target (slow) for AMT via CAN interface " SWORD _CNV_A_R_LINEAR_____31_CM 1 100. -1024. 1023.96875 DISPLAY_IDENTIFIER TQ_AMT_SLOW_BN ECU_ADDRESS 0xd000a056 FORMAT "%8.2" /end MEASUREMENT
/begin MEASUREMENT tcc_can_tq_etcu "free running test cycle counter TQ_ETCU (alive counter)" UBYTE _CNV_A_R_LINEAR_____50_CM 1 100. 0. 14. DISPLAY_IDENTIFIER TCC_CAN_TQ_ETCU ECU_ADDRESS 0xd0000427 FORMAT "%2.0" /end MEASUREMENT
/begin MEASUREMENT state_etcu_obd_err "status OBD-relevamt error - ETCU" UBYTE _CNV_S_3_STATE_ETCU_51_CM 1 100. 0. 2. DISPLAY_IDENTIFIER STATE_ETCU_OBD_ERR ECU_ADDRESS 0xd00081e4 /end MEASUREMENT
/begin MEASUREMENT state_amt_intv "status torque target AMT via CAN" UBYTE _CNV_S_4_STATE_ETCU_46_CM 1 100. 0. 3. DISPLAY_IDENTIFIER STATE_AMT_INTV ECU_ADDRESS 0xd00081ea /end MEASUREMENT
/begin MEASUREMENT state_acin_can "state air-conditioning request signal CAN" UBYTE _CNV_A_R_LINEAR_____0_CM 1 100. 0. 7. DISPLAY_IDENTIFIER STATE_ACIN_CAN ECU_ADDRESS 0xd0000436 FORMAT "%1.0" /end MEASUREMENT
/begin MEASUREMENT ctr_km_bn "vehicle kilometer BN reading from Kombi - for OBD" ULONG _CNV_A_R_LINEAR_____52_CM 1 100. 0. 16777215. DISPLAY_IDENTIFIER CTR_KM_BN ECU_ADDRESS 0xd000ad80 FORMAT "%8.0" /end MEASUREMENT
/begin MEASUREMENT tcc_can_tq_amt "free running test cycle counter TQ_AMT (alive counter)" UBYTE _CNV_A_R_LINEAR_____50_CM 1 100. 0. 14. DISPLAY_IDENTIFIER TCC_CAN_TQ_AMT ECU_ADDRESS 0xd000042f FORMAT "%2.0" /end MEASUREMENT
/begin MEASUREMENT t_ctr_swi_off_vb "shutdown counter battery-main-switch" UBYTE _CNV_A_R_LINEAR_____36_CM 1 100. 0. 255. DISPLAY_IDENTIFIER T_CTR_SWI_OFF_VB ECU_ADDRESS 0xd00081f7 FORMAT "%3.0" /end MEASUREMENT
/begin MEASUREMENT v_gen_tar "target generator voltage " UBYTE _CNV_R_R_spg_gencan_53_CM 1 100. 10.6 16.975 DISPLAY_IDENTIFIER V_GEN_TAR ECU_ADDRESS 0xd00081f3 FORMAT "%8.4" /end MEASUREMENT
/begin MEASUREMENT lv_key_vld "Valid key recognized - CAS" UBYTE _CNV_S_2_RANGE__0___1_CM 1 100. 0. 1. DISPLAY_IDENTIFIER LV_KEY_VLD ECU_ADDRESS 0xd000822c BIT_MASK 0x1 /end MEASUREMENT
/begin MEASUREMENT lv_key_vld_msg_failed "Valid key message failed - CAS" UBYTE _CNV_S_2_RANGE__0___1_CM 1 100. 0. 1. DISPLAY_IDENTIFIER LV_KEY_VLD_MSG_FAILED ECU_ADDRESS 0xd000822d BIT_MASK 0x1 /end MEASUREMENT
/begin MEASUREMENT ctr_imob_resp_rcv_can "ctr of received imob can messages" UBYTE _CNV_A_R_LINEAR_____0_CM 1 100. 0. 255. DISPLAY_IDENTIFIER CTR_IMOB_RESP_RCV_CAN ECU_ADDRESS 0xd000820d FORMAT "%3.0" /end MEASUREMENT
/begin MEASUREMENT idbosrst "ID2_BOS_resetting" UBYTE _CNV_A_R_LINEAR_____0_CM 1 100. 0. 255. DISPLAY_IDENTIFIER IDBOSRST ECU_ADDRESS 0xd00081f4 FORMAT "%3.0" /end MEASUREMENT
/begin MEASUREMENT vbost "availability_BOS_resetting" UBYTE _CNV_A_R_LINEAR_____0_CM 1 100. 0. 255. DISPLAY_IDENTIFIER VBOST ECU_ADDRESS 0xd00081f5 FORMAT "%3.0" /end MEASUREMENT
/begin MEASUREMENT zrbosr "counter_resetting_BOS_resetting" UBYTE _CNV_A_R_LINEAR_____0_CM 1 100. 0. 255. DISPLAY_IDENTIFIER ZRBOSR ECU_ADDRESS 0xd00081f6 FORMAT "%3.0" /end MEASUREMENT
/begin MEASUREMENT idfbosrt_w "ID_function_BOS_resetting" UWORD _CNV_A_R_LINEAR_____0_CM 1 100. 0. 65535. DISPLAY_IDENTIFIER IDFBOSRT_W ECU_ADDRESS 0xd000a05a FORMAT "%5.0" /end MEASUREMENT
/begin CHARACTERISTIC c_t_ctr_swi_off_vb_min "Threshold shutdown counter battery-main-switch" VALUE 0xa080c14b _REC_VAL_20_u1 255. _CNV_A_R_LINEAR_____36_CM 0. 255. DISPLAY_IDENTIFIER C_T_CTR_SWI_OFF_VB_MIN FORMAT "%3.0" /end CHARACTERISTIC
/begin CHARACTERISTIC c_v_sp_gen "Generator voltage (substitute value in case of  invalid signal from CAN)" VALUE 0xa080c40c _REC_VAL_20_u1 6.375000000000003 _CNV_R_R_spg_gencan_53_CM 10.6 16.975 DISPLAY_IDENTIFIER C_V_SP_GEN FORMAT "%8.4" /end CHARACTERISTIC
/begin MEASUREMENT tcc_can_icl "free running test cycle counter instrument cluster (alive counter)" UBYTE _CNV_A_R_LINEAR_____50_CM 1 100. 0. 14. DISPLAY_IDENTIFIER TCC_CAN_ICL ECU_ADDRESS 0xd0000438 FORMAT "%2.0" /end MEASUREMENT
/begin MEASUREMENT tcc_can_msw "alive counter MSW - SZL" UBYTE _CNV_A_R_LINEAR_____50_CM 1 100. 0. 14. DISPLAY_IDENTIFIER TCC_CAN_MSW ECU_ADDRESS 0xd0000433 FORMAT "%2.0" /end MEASUREMENT
/begin MEASUREMENT state_bn_msw "Status MSW BN (CAN)" UBYTE _CNV_S_13_STATE_BN_M_54_CM 1 100. 0. 127. DISPLAY_IDENTIFIER STATE_BN_MSW ECU_ADDRESS 0xd00081ec /end MEASUREMENT
/begin MEASUREMENT lv_err_ang_pste_can "interface bit for TQ_LOSS_PSTE calculation in case of error via CAN" UBYTE _CNV_S_2_RANGE__0___1_CM 1 100. 0. 1. DISPLAY_IDENTIFIER LV_ERR_ANG_PSTE_CAN ECU_ADDRESS 0xd0008220 BIT_MASK 0x1 /end MEASUREMENT
/begin MEASUREMENT tcc_can_ars "free running test cycle counter ARS (alive counter)" UBYTE _CNV_A_R_LINEAR_____50_CM 1 100. 0. 14. DISPLAY_IDENTIFIER TCC_CAN_ARS ECU_ADDRESS 0xd0000415 FORMAT "%2.0" /end MEASUREMENT
/begin MEASUREMENT lv_etcu_lih_can "logical value gear box limp home" UBYTE _CNV_S_2_RANGE__0___1_CM 1 100. 0. 1. DISPLAY_IDENTIFIER LV_ETCU_LIH_CAN ECU_ADDRESS 0xd000821e BIT_MASK 0x1 /end MEASUREMENT
/begin MEASUREMENT lv_amt_lih_can "logical variable AMT intervention limp home" UBYTE _CNV_S_2_RANGE__0___1_CM 1 100. 0. 1. DISPLAY_IDENTIFIER LV_AMT_LIH_CAN ECU_ADDRESS 0xd000821f BIT_MASK 0x1 /end MEASUREMENT
/begin MEASUREMENT state_st_tq_lim_gs "State starting torque limitation" UBYTE _CNV_S_3_STATE_ST_T_55_CM 1 100. 0. 3. DISPLAY_IDENTIFIER STATE_ST_TQ_LIM_GS ECU_ADDRESS 0xd00081e9 /end MEASUREMENT
/begin MEASUREMENT state_st_tq_lim_amt "State starting torque limitation for AMT" UBYTE _CNV_S_3_STATE_ST_T_55_CM 1 100. 0. 3. DISPLAY_IDENTIFIER STATE_ST_TQ_LIM_AMT ECU_ADDRESS 0xd00081eb /end MEASUREMENT
/begin MEASUREMENT lv_var_etcu "BN(SSG or EGS)-transmission recognized" UBYTE _CNV_S_2_RANGE__0___1_CM 1 100. 0. 1. DISPLAY_IDENTIFIER LV_VAR_ETCU ECU_ADDRESS 0xd0008b2a BIT_MASK 0x1 /end MEASUREMENT
/begin MEASUREMENT lv_var_veh_mod "auxiliary bit for activation of BN-Diag" UBYTE _CNV_S_2_RANGE__0___1_CM 1 100. 0. 1. DISPLAY_IDENTIFIER LV_VAR_VEH_MOD ECU_ADDRESS 0xd0008222 BIT_MASK 0x1 /end MEASUREMENT
/begin MEASUREMENT lv_var_efp_crash "EFP crash message detected" UBYTE _CNV_S_2_RANGE__0___1_CM 1 100. 0. 1. DISPLAY_IDENTIFIER LV_VAR_EFP_CRASH ECU_ADDRESS 0xd0008b2d BIT_MASK 0x1 /end MEASUREMENT
/begin MEASUREMENT lv_var_bn_msw "LV cruise control detected - BN2000" UBYTE _CNV_S_2_RANGE__0___1_CM 1 100. 0. 1. DISPLAY_IDENTIFIER LV_VAR_BN_MSW ECU_ADDRESS 0xd0008b28 BIT_MASK 0x1 /end MEASUREMENT
/begin MEASUREMENT lv_var_dcc "LV distance cruise control detected - BN2000" UBYTE _CNV_S_2_RANGE__0___1_CM 1 100. 0. 1. DISPLAY_IDENTIFIER LV_VAR_DCC ECU_ADDRESS 0xd0008b29 BIT_MASK 0x1 /end MEASUREMENT
/begin MEASUREMENT lv_var_ars "LV anti-roll-stabilisation detected - BN2000" UBYTE _CNV_S_2_RANGE__0___1_CM 1 100. 0. 1. DISPLAY_IDENTIFIER LV_VAR_ARS ECU_ADDRESS 0xd0008b27 BIT_MASK 0x1 /end MEASUREMENT
/begin MEASUREMENT state_veh_mod "vehicle mode" UBYTE _CNV_A_R_LINEAR_____0_CM 1 100. 0. 15. DISPLAY_IDENTIFIER STATE_VEH_MOD ECU_ADDRESS 0xd00081c2 FORMAT "%2.0" /end MEASUREMENT
/begin MEASUREMENT state_vs_icl_disp "status scaling of speedometer (displayed vehicle speed)" UBYTE _CNV_S_3_STATE_VS_I_56_CM 1 100. 0. 3. DISPLAY_IDENTIFIER STATE_VS_ICL_DISP ECU_ADDRESS 0xd00081b4 /end MEASUREMENT
/begin MEASUREMENT tcc_can_veh_mod "free running test cycle counter VEH_MOD (alive counter)" UBYTE _CNV_A_R_LINEAR_____50_CM 1 100. 0. 14. DISPLAY_IDENTIFIER TCC_CAN_VEH_MOD ECU_ADDRESS 0xd000041e FORMAT "%2.0" /end MEASUREMENT
/begin MEASUREMENT state_if_icl_bn_msw "status interface ICL/cruise control" UBYTE _CNV_A_R_LINEAR_____0_CM 1 100. 0. 7. DISPLAY_IDENTIFIER STATE_IF_ICL_BN_MSW ECU_ADDRESS 0xd00081b5 FORMAT "%1.0" /end MEASUREMENT
/begin CHARACTERISTIC c_tq_accin "Minimum torque ACCIN" VALUE 0xa080c354 _REC_VAL_20_u1 127. _CNV_A_R_LINEAR_____57_CM 0. 127. DISPLAY_IDENTIFIER C_TQ_ACCIN FORMAT "%5.1" /end CHARACTERISTIC
/begin CHARACTERISTIC c_tam_man_as "Ambient temperature TAM by application system" VALUE 0xa080c2b1 _REC_VAL_20_u1 190.5 _CNV_A_R_LINEAR_____17_CM -48. 142.5 DISPLAY_IDENTIFIER C_TAM_MAN_AS FORMAT "%5.1" /end CHARACTERISTIC
/begin MEASUREMENT tcc_can_tq_pste_2 "free running test cycle counter TQ_PSTE_2 (alive counter)" UBYTE _CNV_A_R_LINEAR_____50_CM 1 100. 0. 14. DISPLAY_IDENTIFIER TCC_CAN_TQ_PSTE_2 ECU_ADDRESS 0xd000040f FORMAT "%2.0" /end MEASUREMENT
/begin MEASUREMENT tcc_can_tq_pste_3 "free running test cycle counter TQ_PSTE_3 (alive counter)" UBYTE _CNV_A_R_LINEAR_____50_CM 1 100. 0. 14. DISPLAY_IDENTIFIER TCC_CAN_TQ_PSTE_3 ECU_ADDRESS 0xd0000413 FORMAT "%2.0" /end MEASUREMENT
/begin MEASUREMENT state_pste_2_intv "status torque target PSTE_2 via CAN interface" UBYTE _CNV_S_4_STATE_PSTE_59_CM 1 100. 0. 3. DISPLAY_IDENTIFIER STATE_PSTE_2_INTV ECU_ADDRESS 0xd00081bb /end MEASUREMENT
/begin MEASUREMENT state_pste_3_intv "state of PSTE 3 (EHB3) torque intervention " UBYTE _CNV_S_4_STATE_PSTE_60_CM 1 100. 0. 3. DISPLAY_IDENTIFIER STATE_PSTE_3_INTV ECU_ADDRESS 0xd00081be /end MEASUREMENT
/begin MEASUREMENT state_pste_3_err "Error state of PSTE 3 (EHB3)" UBYTE _CNV_S_8_STATE_PSTE_61_CM 1 100. 0. 7. DISPLAY_IDENTIFIER STATE_PSTE_3_ERR ECU_ADDRESS 0xd00081bd /end MEASUREMENT
/begin MEASUREMENT state_pste_3_src "Source of torque request due to steering " UBYTE _CNV_S_5_STATE_PSTE_62_CM 1 100. 0. 4. DISPLAY_IDENTIFIER STATE_PSTE_3_SRC ECU_ADDRESS 0xd00081bc /end MEASUREMENT
/begin MEASUREMENT tq_loss_pste_2_av_can "torque loss actual value PSTE_2 from CAN" SWORD _CNV_A_R_LINEAR_____31_CM 1 100. -1024. 1023.96875 DISPLAY_IDENTIFIER TQ_LOSS_PSTE_2_AV_CAN ECU_ADDRESS 0xd000a03c FORMAT "%8.2" /end MEASUREMENT
/begin MEASUREMENT tq_loss_pste_2_sp_can "torque loss setpoint PSTE_2 from CAN" SWORD _CNV_A_R_LINEAR_____31_CM 1 100. -1024. 1023.96875 DISPLAY_IDENTIFIER TQ_LOSS_PSTE_2_SP_CAN ECU_ADDRESS 0xd000a03e FORMAT "%8.2" /end MEASUREMENT
/begin MEASUREMENT tq_loss_pste_3_av_can "actual torque value for steering" SWORD _CNV_A_R_LINEAR_____31_CM 1 100. -1024. 1023.96875 DISPLAY_IDENTIFIER TQ_LOSS_PSTE_3_AV_CAN ECU_ADDRESS 0xd000a040 FORMAT "%8.2" /end MEASUREMENT
/begin MEASUREMENT tq_loss_pste_3_sp_can "setpoint torque value for steering" SWORD _CNV_A_R_LINEAR_____31_CM 1 100. -1024. 1023.96875 DISPLAY_IDENTIFIER TQ_LOSS_PSTE_3_SP_CAN ECU_ADDRESS 0xd000a042 FORMAT "%8.2" /end MEASUREMENT
/begin MEASUREMENT lv_pste_2_err "LV indicating AFS error (sent by AFS via CAN)" UBYTE _CNV_S_2_RANGE__0___1_CM 1 100. 0. 1. DISPLAY_IDENTIFIER LV_PSTE_2_ERR ECU_ADDRESS 0xd0008223 BIT_MASK 0x1 /end MEASUREMENT
/begin MEASUREMENT lv_pste_3_intv "PSTE 3 (EHB3) torque intervention active" UBYTE _CNV_S_2_RANGE__0___1_CM 1 100. 0. 1. DISPLAY_IDENTIFIER LV_PSTE_3_INTV ECU_ADDRESS 0xd0008225 BIT_MASK 0x1 /end MEASUREMENT
/begin MEASUREMENT state_brake_prs "status brake pressure via CAN" UBYTE _CNV_A_R_LINEAR_____0_CM 1 100. 0. 3. DISPLAY_IDENTIFIER STATE_BRAKE_PRS ECU_ADDRESS 0xd00081ee FORMAT "%1.0" /end MEASUREMENT
/begin MEASUREMENT lv_var_pste_2 "LV power steering detected - BN2000" UBYTE _CNV_S_2_RANGE__0___1_CM 1 100. 0. 1. DISPLAY_IDENTIFIER LV_VAR_PSTE_2 ECU_ADDRESS 0xd0008b2b BIT_MASK 0x1 /end MEASUREMENT
/begin MEASUREMENT lv_var_pste_3 "PSTE 3 (EHB3) device detected - BN2000" UBYTE _CNV_S_2_RANGE__0___1_CM 1 100. 0. 1. DISPLAY_IDENTIFIER LV_VAR_PSTE_3 ECU_ADDRESS 0xd0008b35 BIT_MASK 0x1 /end MEASUREMENT
/begin MEASUREMENT state_cru_bn "Status of Cruise Control for BN-CAN" UBYTE _CNV_A_R_LINEAR_____0_CM 1 100. 0. 255. DISPLAY_IDENTIFIER STATE_CRU_BN ECU_ADDRESS 0xd0000443 FORMAT "%3.0" /end MEASUREMENT
/begin MEASUREMENT nr_vs_cru_if "current vehicle speed step via CAN" UBYTE _CNV_A_R_LINEAR_____0_CM 1 100. 0. 15. DISPLAY_IDENTIFIER NR_VS_CRU_IF ECU_ADDRESS 0xd00081f8 FORMAT "%2.0" /end MEASUREMENT
/begin MEASUREMENT vs_step_if[0] "vehicle speed step from CAN" UWORD _CNV_A_R_LINEAR_____45_CM 1 100. 0. 409.4 DISPLAY_IDENTIFIER VS_STEP_IF_1 ECU_ADDRESS 0xd000a05e FORMAT "%5.1" /end MEASUREMENT
/begin MEASUREMENT vs_step_if[1] "vehicle speed step from CAN" UWORD _CNV_A_R_LINEAR_____45_CM 1 100. 0. 409.4 DISPLAY_IDENTIFIER VS_STEP_IF_2 ECU_ADDRESS 0xd000a060 FORMAT "%5.1" /end MEASUREMENT
/begin MEASUREMENT vs_step_if[2] "vehicle speed step from CAN" UWORD _CNV_A_R_LINEAR_____45_CM 1 100. 0. 409.4 DISPLAY_IDENTIFIER VS_STEP_IF_3 ECU_ADDRESS 0xd000a062 FORMAT "%5.1" /end MEASUREMENT
/begin MEASUREMENT lv_msg_prog_step_cru "message of “Programmierung Stufentempomat” received" UBYTE _CNV_S_2_RANGE__0___1_CM 1 100. 0. 1. DISPLAY_IDENTIFIER LV_MSG_PROG_STEP_CRU ECU_ADDRESS 0xd0008229 BIT_MASK 0x1 /end MEASUREMENT
/begin MEASUREMENT lv_ltg_hdlp_l_on "state low beam: 0 off, 1 on" UBYTE _CNV_S_2_RANGE__0___1_CM 1 100. 0. 1. DISPLAY_IDENTIFIER LV_LTG_HDLP_L_ON ECU_ADDRESS 0xd000822e BIT_MASK 0x1 /end MEASUREMENT
/begin MEASUREMENT lv_ltg_inl_on "state interior lighting: 0 off, 1 on" UBYTE _CNV_S_2_RANGE__0___1_CM 1 100. 0. 1. DISPLAY_IDENTIFIER LV_LTG_INL_ON ECU_ADDRESS 0xd000822f BIT_MASK 0x1 /end MEASUREMENT
/begin MEASUREMENT opg_value_hiv_perc "status aperture water valve" UBYTE _CNV_A_R_LINEAR_____5_CM 1 100. 0. 99.609375 DISPLAY_IDENTIFIER OPG_VALUE_HIV_PERC ECU_ADDRESS 0xd00081d1 FORMAT "%5.1" /end MEASUREMENT
/begin MEASUREMENT state_hiv "state water valve" UBYTE _CNV_A_R_LINEAR_____0_CM 1 100. 0. 15. DISPLAY_IDENTIFIER STATE_HIV ECU_ADDRESS 0xd00081d2 FORMAT "%2.0" /end MEASUREMENT
/begin MEASUREMENT heat_req_perc "request heat flow" UBYTE _CNV_A_R_LINEAR_____63_CM 1 100. 0. 100. DISPLAY_IDENTIFIER HEAT_REQ_PERC ECU_ADDRESS 0xd00081cf FORMAT "%5.1" /end MEASUREMENT
/begin CHARACTERISTIC c_ctr_ftl_not_vld "" VALUE 0xa080bb94 _REC_VAL_20_u1 255. _CNV_A_R_LINEAR_____0_CM 0. 255. DISPLAY_IDENTIFIER C_CTR_FTL_NOT_VLD FORMAT "%3.0" /end CHARACTERISTIC
/begin CHARACTERISTIC c_tam_sub "substitute TAM-temperature in case of TAM-failure" VALUE 0xa080c2bc _REC_VAL_20_u1 190.5 _CNV_A_R_LINEAR_____17_CM -48. 142.5 DISPLAY_IDENTIFIER C_TAM_SUB FORMAT "%5.1" /end CHARACTERISTIC
/begin CHARACTERISTIC lc_tam_man_as "Logical constant switch TAM from CAN or application system" VALUE 0xa080c5fa _REC_VAL_20_u1 1. _CNV_A_R_LINEAR_____0_CM 0. 1. DISPLAY_IDENTIFIER LC_TAM_MAN_AS FORMAT "%1.0" /end CHARACTERISTIC
/begin CHARACTERISTIC lc_tqi_maf_man "Logical constant to switch between two paths of the TQI_MAF calculation" VALUE 0xa080c610 _REC_VAL_20_u1 1. _CNV_A_R_LINEAR_____0_CM 0. 1. DISPLAY_IDENTIFIER LC_TQI_MAF_MAN FORMAT "%1.0" /end CHARACTERISTIC
/begin MEASUREMENT state_di_puc "state disable pull cut off" UBYTE _CNV_A_R_LINEAR_____0_CM 1 100. 0. 3. DISPLAY_IDENTIFIER STATE_DI_PUC ECU_ADDRESS 0xd00081d3 FORMAT "%1.0" /end MEASUREMENT
/begin MEASUREMENT state_sp_dyn_wheel "state follow dynamic" UBYTE _CNV_A_R_LINEAR_____0_CM 1 100. 0. 255. DISPLAY_IDENTIFIER STATE_SP_DYN_WHEEL ECU_ADDRESS 0xd00081d4 FORMAT "%3.0" /end MEASUREMENT
/begin MEASUREMENT tq_wheel_ldm_bn "Torque request by ldm" SWORD _CNV_A_R_LINEAR_____64_CM 1 100. -32768. 32767. DISPLAY_IDENTIFIER TQ_WHEEL_LDM_BN ECU_ADDRESS 0xd000a064 FORMAT "%6.0" /end MEASUREMENT
/begin MEASUREMENT tcc_can_ldm "free running test cycle counter TQ_DCC (alive counter)" UBYTE _CNV_A_R_LINEAR_____50_CM 1 100. 0. 14. DISPLAY_IDENTIFIER TCC_CAN_LDM ECU_ADDRESS 0xd0000450 FORMAT "%2.0" /end MEASUREMENT
/begin MEASUREMENT tcc_can_tq_wheel_1 "free running test cycle counter TQ_WHEEL_1 (alive counter)" UBYTE _CNV_A_R_LINEAR_____50_CM 1 100. 0. 14. DISPLAY_IDENTIFIER TCC_CAN_TQ_WHEEL_1 ECU_ADDRESS 0xd0000452 FORMAT "%2.0" /end MEASUREMENT
/begin MEASUREMENT tcc_can_tq_wheel_2 "free running test cycle counter TQ_WHEEL_2 (alive counter)" UBYTE _CNV_A_R_LINEAR_____50_CM 1 100. 0. 14. DISPLAY_IDENTIFIER TCC_CAN_TQ_WHEEL_2 ECU_ADDRESS 0xd0000453 FORMAT "%2.0" /end MEASUREMENT
/begin MEASUREMENT fac_gb_gain "Gear Box Gain" UWORD _CNV_A_R_LINEAR_____65_CM 1 100. 0. 8191.75 DISPLAY_IDENTIFIER FAC_GB_GAIN ECU_ADDRESS 0xd000a066 FORMAT "%6.1" /end MEASUREMENT
/begin MEASUREMENT lv_state_trl "state trailer: 0 off, 1 on" UBYTE _CNV_S_2_RANGE__0___1_CM 1 100. 0. 1. DISPLAY_IDENTIFIER LV_STATE_TRL ECU_ADDRESS 0xd0008230 BIT_MASK 0x1 /end MEASUREMENT
/begin MEASUREMENT lv_pow_clas_veh_can_rcv "Status vehicle power class received via CAN" UBYTE _CNV_S_2_RANGE__0___1_CM 1 100. 0. 1. DISPLAY_IDENTIFIER LV_POW_CLAS_VEH_CAN_RCV ECU_ADDRESS 0xd0008231 BIT_MASK 0x1 /end MEASUREMENT
/begin MEASUREMENT cur_wku_can "quiescent-current (vehicle-specific)" UBYTE _CNV_A_R_LINEAR_____66_CM 1 100. 0. 255. DISPLAY_IDENTIFIER CUR_WKU_CAN ECU_ADDRESS 0xd00081fb FORMAT "%3.0" /end MEASUREMENT
/begin MEASUREMENT cur_sc_min_can "minimum short-current (vehicle-specific)" UBYTE _CNV_A_R_LINEAR_____67_CM 1 100. 0. 2550. DISPLAY_IDENTIFIER CUR_SC_MIN_CAN ECU_ADDRESS 0xd00081fa FORMAT "%4.0" /end MEASUREMENT
/begin MEASUREMENT cur_sc_max_can "maximum short-current (vehicle-specific)" UBYTE _CNV_A_R_LINEAR_____67_CM 1 100. 0. 2550. DISPLAY_IDENTIFIER CUR_SC_MAX_CAN ECU_ADDRESS 0xd00081f9 FORMAT "%4.0" /end MEASUREMENT
/begin MEASUREMENT idx_bat_can "implemented battery" UBYTE _CNV_A_R_LINEAR_____0_CM 1 100. 0. 255. DISPLAY_IDENTIFIER IDX_BAT_CAN ECU_ADDRESS 0xd00081fc FORMAT "%3.0" /end MEASUREMENT
/begin MEASUREMENT lv_tq_wheel_ldm_bn_err "LV indicating torque request by ldm invalid" UBYTE _CNV_S_2_RANGE__0___1_CM 1 100. 0. 1. DISPLAY_IDENTIFIER LV_TQ_WHEEL_LDM_BN_ERR ECU_ADDRESS 0xd0008234 BIT_MASK 0x1 /end MEASUREMENT
/begin MEASUREMENT state_ldm_intv "state ldm" UBYTE _CNV_A_R_LINEAR_____0_CM 1 100. 0. 3. DISPLAY_IDENTIFIER STATE_LDM_INTV ECU_ADDRESS 0xd00081d6 FORMAT "%1.0" /end MEASUREMENT
/begin MEASUREMENT state_ldm "state ldm" UBYTE _CNV_A_R_LINEAR_____0_CM 1 100. 0. 15. DISPLAY_IDENTIFIER STATE_LDM ECU_ADDRESS 0xd00081d5 FORMAT "%2.0" /end MEASUREMENT
/begin MEASUREMENT lv_tq_wheel_ldm_req "LDM requested via CAN" UBYTE _CNV_S_2_RANGE__0___1_CM 1 100. 0. 1. DISPLAY_IDENTIFIER LV_TQ_WHEEL_LDM_REQ ECU_ADDRESS 0xd0008232 BIT_MASK 0x1 /end MEASUREMENT
/begin MEASUREMENT lv_ldm_lih_can "LDM LIH via CAN" UBYTE _CNV_S_2_RANGE__0___1_CM 1 100. 0. 1. DISPLAY_IDENTIFIER LV_LDM_LIH_CAN ECU_ADDRESS 0xd0008233 BIT_MASK 0x1 /end MEASUREMENT
/begin MEASUREMENT fac_is_inc_req "request IS-increase" UBYTE _CNV_A_R_LINEAR_____0_CM 1 100. 0. 255. DISPLAY_IDENTIFIER FAC_IS_INC_REQ ECU_ADDRESS 0xd00081f2 FORMAT "%3.0" /end MEASUREMENT
/begin MEASUREMENT fac_pow_mng_vst_cns "Powermanagement Standverbraucher" UBYTE _CNV_A_R_LINEAR_____0_CM 1 100. 0. 255. DISPLAY_IDENTIFIER FAC_POW_MNG_VST_CNS ECU_ADDRESS 0xd00081fd FORMAT "%3.0" ARRAY_SIZE 15 MATRIX_DIM 15 1 1 /end MEASUREMENT
/begin MEASUREMENT state_veh_cns "State vehicle consumer (Verbraucherstatus)" UBYTE _CNV_A_R_LINEAR_____0_CM 1 100. 0. 255. DISPLAY_IDENTIFIER STATE_VEH_CNS ECU_ADDRESS 0xd00081c4 FORMAT "%3.0" ARRAY_SIZE 10 MATRIX_DIM 10 1 1 /end MEASUREMENT
/begin MEASUREMENT state_ext_pow_cns "State power consumption (Sonderverbraucher)" UBYTE _CNV_A_R_LINEAR_____63_CM 1 100. 0. 100. DISPLAY_IDENTIFIER STATE_EXT_POW_CNS ECU_ADDRESS 0xd00081d0 FORMAT "%5.1" /end MEASUREMENT
/begin MEASUREMENT state_igk_hw "status ignition key (HW) via CAN" UBYTE _CNV_A_R_LINEAR_____0_CM 1 100. 0. 3. DISPLAY_IDENTIFIER STATE_IGK_HW ECU_ADDRESS 0xd00081c1 FORMAT "%1.0" /end MEASUREMENT
/begin MEASUREMENT lv_ecras_ctl_can_1 "ECRAS control via CAN step 1" UBYTE _CNV_S_2_RANGE__0___1_CM 1 100. 0. 1. DISPLAY_IDENTIFIER LV_ECRAS_CTL_CAN_1 ECU_ADDRESS 0xd0008235 BIT_MASK 0x1 /end MEASUREMENT
/begin MEASUREMENT lv_ecras_ctl_can_2 "ECRAS control via CAN step 2" UBYTE _CNV_S_2_RANGE__0___1_CM 1 100. 0. 1. DISPLAY_IDENTIFIER LV_ECRAS_CTL_CAN_2 ECU_ADDRESS 0xd0008236 BIT_MASK 0x1 /end MEASUREMENT
/begin MEASUREMENT qoil_ds_rst_can_1_5 "Restlaufleistung_BOS_Rueckstellung_1" SWORD _CNV_R_R_Def_km_sw__68_CM 1 100. -327680. 327670. DISPLAY_IDENTIFIER QOIL_DS_RST_CAN_1_5 ECU_ADDRESS 0xd000a06a FORMAT "%6.1" /end MEASUREMENT
/begin MEASUREMENT ctr_tout_n_ecf_can "Counter for timeout-detection ext. ECF-request" UBYTE _CNV_A_R_LINEAR_____0_CM 1 100. 0. 255. DISPLAY_IDENTIFIER CTR_TOUT_N_ECF_CAN ECU_ADDRESS 0xd00081e0 FORMAT "%3.0" /end MEASUREMENT
/begin MEASUREMENT lv_ldm_can_ini "Ini-values sent via CAN" UBYTE _CNV_S_2_RANGE__0___1_CM 1 100. 0. 1. DISPLAY_IDENTIFIER LV_LDM_CAN_INI ECU_ADDRESS 0xd0008237 BIT_MASK 0x1 /end MEASUREMENT
/begin MEASUREMENT lv_cc_test_bench_act "Checkcontrol test bench active" UBYTE _CNV_S_2_RANGE__0___1_CM 1 100. 0. 1. DISPLAY_IDENTIFIER LV_CC_TEST_BENCH_ACT ECU_ADDRESS 0xd0000475 BIT_MASK 0x1 /end MEASUREMENT
/begin MEASUREMENT state_etcu_prog_info "State mode ETCU" UBYTE _CNV_A_R_LINEAR_____0_CM 1 100. 0. 15. DISPLAY_IDENTIFIER STATE_ETCU_PROG_INFO ECU_ADDRESS 0xd00081ef FORMAT "%2.0" /end MEASUREMENT
/begin MEASUREMENT t_err_n_eng "Timer for sending RPM_ENG_ERR true or false without debounced CRK error" UBYTE _CNV_A_R_LINEAR_____3_CM 1 100. 0. 2.55 DISPLAY_IDENTIFIER T_ERR_N_ENG ECU_ADDRESS 0xd000820e FORMAT "%4.2" /end MEASUREMENT
/begin MEASUREMENT ipm_typ_fp "IPM-Fahrertyp zur Beeinflussung der Pedalauswertung" UBYTE _CNV_A_R_LINEAR_____0_CM 1 100. 0. 255. DISPLAY_IDENTIFIER IPM_TYP_FP ECU_ADDRESS 0xd000820f FORMAT "%3.0" /end MEASUREMENT
/begin MEASUREMENT ipm_typ_mdkw "IPM-Fahrertyp zur Beeinflussung der Soll-Momentenbestimmung" UBYTE _CNV_A_R_LINEAR_____0_CM 1 100. 0. 255. DISPLAY_IDENTIFIER IPM_TYP_MDKW ECU_ADDRESS 0xd0008210 FORMAT "%3.0" /end MEASUREMENT
/begin MEASUREMENT dm_ab_fws "Fahrwiderstand (Moment zur Bergkompensation)" SLONG _CNV_A_R_LINEAR_____69_CM 1 100. -214748364.8 214748364.8 DISPLAY_IDENTIFIER DM_AB_FWS ECU_ADDRESS 0xd000ad84 FORMAT "%12.1" /end MEASUREMENT
/begin MEASUREMENT state_dcc_off_req "status switch-off DCC" UBYTE _CNV_S_4_STATE_DCC__70_CM 1 100. 0. 3. DISPLAY_IDENTIFIER STATE_DCC_OFF_REQ ECU_ADDRESS 0xd00081b8 /end MEASUREMENT
/begin MEASUREMENT state_err_sym_tam_can "Error symptom for TAM sensor get via CAN" UBYTE _CNV_S_4_STATE_ERR__71_CM 1 100. 0. 4. DISPLAY_IDENTIFIER STATE_ERR_SYM_TAM_CAN ECU_ADDRESS 0xd0008211 /end MEASUREMENT
/begin MEASUREMENT state_err_sym_ftl_ri_can "Error symptom for left right tank level sensor get via CAN" UBYTE _CNV_S_4_STATE_ERR__71_CM 1 100. 0. 4. DISPLAY_IDENTIFIER STATE_ERR_SYM_FTL_RI_CAN ECU_ADDRESS 0xd0008213 /end MEASUREMENT
/begin MEASUREMENT state_err_sym_ftl_le_can "Error symptom for left fuel tank level sensor get via CAN" UBYTE _CNV_S_4_STATE_ERR__71_CM 1 100. 0. 4. DISPLAY_IDENTIFIER STATE_ERR_SYM_FTL_LE_CAN ECU_ADDRESS 0xd0008212 /end MEASUREMENT
/begin MEASUREMENT state_pbr "State of parking brake (get from can)" UBYTE _CNV_A_R_LINEAR_____0_CM 1 100. 0. 15. DISPLAY_IDENTIFIER STATE_PBR ECU_ADDRESS 0xd0008214 FORMAT "%2.0" /end MEASUREMENT
/begin MEASUREMENT state_hld_pbr "State of holding vehicle with parking brake (get from can)" UBYTE _CNV_A_R_LINEAR_____0_CM 1 100. 0. 3. DISPLAY_IDENTIFIER STATE_HLD_PBR ECU_ADDRESS 0xd0008215 FORMAT "%2.0" /end MEASUREMENT
/begin MEASUREMENT lv_key_aux "status Kl. R" UBYTE _CNV_S_2_RANGE__0___1_CM 1 100. 0. 1. DISPLAY_IDENTIFIER LV_KEY_AUX ECU_ADDRESS 0xd000822b BIT_MASK 0x1 /end MEASUREMENT
/begin MEASUREMENT cks_clc_req_pbr "Checksum REQ_PBR" UBYTE _CNV_A_R_LINEAR_____0_CM 1 100. 0. 255. DISPLAY_IDENTIFIER CKS_CLC_REQ_PBR ECU_ADDRESS 0xd0000463 FORMAT "%3.0" /end MEASUREMENT
/begin MEASUREMENT cks_can_req_pbr "checksum REQ_PBR from CAN" UBYTE _CNV_A_R_LINEAR_____0_CM 1 100. 0. 255. DISPLAY_IDENTIFIER CKS_CAN_REQ_PBR ECU_ADDRESS 0xd0000464 FORMAT "%3.0" /end MEASUREMENT
/begin MEASUREMENT tcc_can_req_pbr "free running test cycle counter REQ_PBR (alive counter)" UBYTE _CNV_A_R_LINEAR_____0_CM 1 100. 0. 15. DISPLAY_IDENTIFIER TCC_CAN_REQ_PBR ECU_ADDRESS 0xd0000465 FORMAT "%2.0" /end MEASUREMENT
/begin MEASUREMENT cks_can_pbr "checksum PBR from CAN" UBYTE _CNV_A_R_LINEAR_____0_CM 1 100. 0. 255. DISPLAY_IDENTIFIER CKS_CAN_PBR ECU_ADDRESS 0xd0000468 FORMAT "%3.0" /end MEASUREMENT
/begin MEASUREMENT cks_clc_pbr "checksum PBR" UBYTE _CNV_A_R_LINEAR_____0_CM 1 100. 0. 255. DISPLAY_IDENTIFIER CKS_CLC_PBR ECU_ADDRESS 0xd0000467 FORMAT "%3.0" /end MEASUREMENT
/begin MEASUREMENT lv_cft_mod_pbr "Bit indicating comfort mode of parking brake (get from can)" UBYTE _CNV_S_2_RANGE__0___1_CM 1 100. 0. 1. DISPLAY_IDENTIFIER LV_CFT_MOD_PBR ECU_ADDRESS 0xd000823a BIT_MASK 0x1 /end MEASUREMENT
/begin MEASUREMENT lv_hood_open "Engine hood open" UBYTE _CNV_S_2_RANGE__0___1_CM 1 100. 0. 1. DISPLAY_IDENTIFIER LV_HOOD_OPEN ECU_ADDRESS 0xd0008238 BIT_MASK 0x1 /end MEASUREMENT
/begin MEASUREMENT lv_driv_door_open "Driver door open" UBYTE _CNV_S_2_RANGE__0___1_CM 1 100. 0. 1. DISPLAY_IDENTIFIER LV_DRIV_DOOR_OPEN ECU_ADDRESS 0xd0008239 BIT_MASK 0x1 /end MEASUREMENT
/begin MEASUREMENT lv_state_err_can_tout "Timeout detected of service message OBD diagnosis" UBYTE _CNV_S_2_RANGE__0___1_CM 1 100. 0. 1. DISPLAY_IDENTIFIER LV_STATE_ERR_CAN_TOUT ECU_ADDRESS 0xd000823b BIT_MASK 0x1 /end MEASUREMENT
/begin MEASUREMENT tcc_can_pbr "free running test cycle counter PBR (alive counter)" UBYTE _CNV_A_R_LINEAR_____0_CM 1 100. 0. 15. DISPLAY_IDENTIFIER TCC_CAN_PBR ECU_ADDRESS 0xd0000469 FORMAT "%2.0" /end MEASUREMENT
/begin MEASUREMENT tcc_can_gs_idc "free running test cycle counter" UBYTE _CNV_A_R_LINEAR_____50_CM 1 100. 0. 14. DISPLAY_IDENTIFIER TCC_CAN_GS_IDC ECU_ADDRESS 0xd0000462 FORMAT "%2.0" /end MEASUREMENT
/begin MEASUREMENT tq_accin_can "ACC-torque from CAN" UBYTE _CNV_A_R_LINEAR_____57_CM 1 100. 0. 127.5 DISPLAY_IDENTIFIER TQ_ACCIN_CAN ECU_ADDRESS 0xd0008257 FORMAT "%5.2" /end MEASUREMENT
/begin MEASUREMENT ang_pste "sttering wheel sensor angle" SWORD _CNV_A_R_LINEAR_____72_CM 1 100. -1439.98976 1439.945815 DISPLAY_IDENTIFIER ANG_PSTE ECU_ADDRESS 0xd000a076 FORMAT "%8.3" /end MEASUREMENT
/begin MEASUREMENT brake_prs "Brake pressure" UBYTE _CNV_A_R_LINEAR_____73_CM 1 100. 0. 255. DISPLAY_IDENTIFIER BRAKE_PRS ECU_ADDRESS 0xd000823d FORMAT "%3.0" /end MEASUREMENT
/begin MEASUREMENT ctr_ftl_not_vld "Counter for messages with invalid FTL-value" UBYTE _CNV_A_R_LINEAR_____0_CM 1 100. 0. 255. DISPLAY_IDENTIFIER CTR_FTL_NOT_VLD ECU_ADDRESS 0xd0008253 FORMAT "%3.0" /end MEASUREMENT
/begin MEASUREMENT ctr_ftl_ri_not_vld "Counter for messages with invalid FTL_RI-value" UBYTE _CNV_A_R_LINEAR_____0_CM 1 100. 0. 255. DISPLAY_IDENTIFIER CTR_FTL_RI_NOT_VLD ECU_ADDRESS 0xd0008255 FORMAT "%3.0" /end MEASUREMENT
/begin MEASUREMENT ctr_ftl_le_not_vld "Counter for messages with invalid FTL_LE-value" UBYTE _CNV_A_R_LINEAR_____0_CM 1 100. 0. 255. DISPLAY_IDENTIFIER CTR_FTL_LE_NOT_VLD ECU_ADDRESS 0xd0008254 FORMAT "%3.0" /end MEASUREMENT
/begin MEASUREMENT ctr_km_can "vehicle kilometer reading from CAN message INSTR2" UWORD _CNV_A_R_LINEAR_____58_CM 1 100. 0. 655350. DISPLAY_IDENTIFIER CTR_KM_CAN ECU_ADDRESS 0xd000a074 FORMAT "%7.0" /end MEASUREMENT
/begin MEASUREMENT ftl "fuel tank level" UBYTE _CNV_A_R_LINEAR_____75_CM 1 100. 0. 127. DISPLAY_IDENTIFIER FTL ECU_ADDRESS 0xd0008250 FORMAT "%3.0" /end MEASUREMENT
/begin MEASUREMENT ftl_le "fuel tank level left" UBYTE _CNV_A_R_LINEAR_____75_CM 1 100. 0. 127. DISPLAY_IDENTIFIER FTL_LE ECU_ADDRESS 0xd0008251 FORMAT "%3.0" /end MEASUREMENT
/begin MEASUREMENT ftl_ri "fuel tank level right" UBYTE _CNV_A_R_LINEAR_____75_CM 1 100. 0. 127. DISPLAY_IDENTIFIER FTL_RI ECU_ADDRESS 0xd0008252 FORMAT "%3.0" /end MEASUREMENT
/begin MEASUREMENT gear_info "Gear information from EGS-ECU" UBYTE _CNV_A_R_LINEAR_____0_CM 1 100. 0. 7. DISPLAY_IDENTIFIER GEAR_INFO ECU_ADDRESS 0xd0008248 FORMAT "%2.0" /end MEASUREMENT
/begin MEASUREMENT lv_accin "LV ACC request" UBYTE _CNV_S_2_RANGE__0___1_CM 1 100. 0. 1. DISPLAY_IDENTIFIER LV_ACCIN ECU_ADDRESS 0xd000825a BIT_MASK 0x1 /end MEASUREMENT
/begin MEASUREMENT lv_acin "LV switch ACC readiness" UBYTE _CNV_S_2_RANGE__0___1_CM 1 100. 0. 1. DISPLAY_IDENTIFIER LV_ACIN ECU_ADDRESS 0xd0008259 BIT_MASK 0x1 /end MEASUREMENT
/begin MEASUREMENT lv_amt_es "LV indicating engine stop via CAN" UBYTE _CNV_S_2_RANGE__0___1_CM 1 100. 0. 1. DISPLAY_IDENTIFIER LV_AMT_ES ECU_ADDRESS 0xd000826b BIT_MASK 0x1 /end MEASUREMENT
/begin MEASUREMENT lv_err_vs_can "logical variable for VS_CAN error" UBYTE _CNV_S_2_RANGE__0___1_CM 1 100. 0. 1. DISPLAY_IDENTIFIER LV_ERR_VS_CAN ECU_ADDRESS 0xd0008240 BIT_MASK 0x1 /end MEASUREMENT
/begin MEASUREMENT lv_ftl_can_err "logical value erroneous fuel tank level signal" UBYTE _CNV_S_2_RANGE__0___1_CM 1 100. 0. 1. DISPLAY_IDENTIFIER LV_FTL_CAN_ERR ECU_ADDRESS 0xd000825e BIT_MASK 0x1 /end MEASUREMENT
/begin MEASUREMENT lv_ftl_le_can_err "logical variable erroneous fuel tank level (left) signal" UBYTE _CNV_S_2_RANGE__0___1_CM 1 100. 0. 1. DISPLAY_IDENTIFIER LV_FTL_LE_CAN_ERR ECU_ADDRESS 0xd0008260 BIT_MASK 0x1 /end MEASUREMENT
/begin MEASUREMENT lv_ftl_ri_can_err "logical variable erroneous fuel tank level (right) signal" UBYTE _CNV_S_2_RANGE__0___1_CM 1 100. 0. 1. DISPLAY_IDENTIFIER LV_FTL_RI_CAN_ERR ECU_ADDRESS 0xd0008261 BIT_MASK 0x1 /end MEASUREMENT
/begin MEASUREMENT lv_ftl_obd_inh_l "logical variable fuel reserve" UBYTE _CNV_S_2_RANGE__0___1_CM 1 100. 0. 1. DISPLAY_IDENTIFIER LV_FTL_OBD_INH_L ECU_ADDRESS 0xd000825d BIT_MASK 0x1 /end MEASUREMENT
/begin MEASUREMENT lv_ftl_tot_can_err "logical value erroneous fuel tank level signal - total FTL" UBYTE _CNV_S_2_RANGE______76_CM 1 100. 0. 1. DISPLAY_IDENTIFIER LV_FTL_TOT_CAN_ERR ECU_ADDRESS 0xd000825f /end MEASUREMENT
/begin MEASUREMENT lv_gs "LV indicating GS - AMT" UBYTE _CNV_S_2_RANGE__0___1_CM 1 100. 0. 1. DISPLAY_IDENTIFIER LV_GS ECU_ADDRESS 0xd000826a BIT_MASK 0x1 /end MEASUREMENT
/begin MEASUREMENT lv_gp "LV  indicating mode gearbox - AMT" UBYTE _CNV_S_2_RANGE__0___1_CM 1 100. 0. 1. DISPLAY_IDENTIFIER LV_GP ECU_ADDRESS 0xd000826c BIT_MASK 0x1 /end MEASUREMENT
/begin MEASUREMENT lv_plaus_asr_ctl "logical variable for ASR intervention is active" UBYTE _CNV_S_2_RANGE__0___1_CM 1 100. 0. 1. DISPLAY_IDENTIFIER LV_PLAUS_ASR_CTL ECU_ADDRESS 0xd0008241 BIT_MASK 0x1 /end MEASUREMENT
/begin MEASUREMENT lv_plaus_esp_ctl "logical variable for DSC intervention is active" UBYTE _CNV_S_2_RANGE__0___1_CM 1 100. 0. 1. DISPLAY_IDENTIFIER LV_PLAUS_ESP_CTL ECU_ADDRESS 0xd0008242 BIT_MASK 0x1 /end MEASUREMENT
/begin MEASUREMENT lv_pump_amt_on "LV  indicating status of hydraulic pump - AMT" UBYTE _CNV_S_2_RANGE__0___1_CM 1 100. 0. 1. DISPLAY_IDENTIFIER LV_PUMP_AMT_ON ECU_ADDRESS 0xd000826d BIT_MASK 0x1 /end MEASUREMENT
/begin MEASUREMENT lv_req_heat "LV increased heater power request" UBYTE _CNV_S_2_RANGE__0___1_CM 1 100. 0. 1. DISPLAY_IDENTIFIER LV_REQ_HEAT ECU_ADDRESS 0xd0008263 BIT_MASK 0x1 /end MEASUREMENT
/begin MEASUREMENT lv_req_tco_l "LV requirement for low coolant temperature" UBYTE _CNV_S_2_RANGE__0___1_CM 1 100. 0. 1. DISPLAY_IDENTIFIER LV_REQ_TCO_L ECU_ADDRESS 0xd000825b BIT_MASK 0x1 /end MEASUREMENT
/begin MEASUREMENT lv_tam_can_err "logical variable for erroneous ambient temperature signal" UBYTE _CNV_S_2_RANGE__0___1_CM 1 100. 0. 1. DISPLAY_IDENTIFIER LV_TAM_CAN_ERR ECU_ADDRESS 0xd000825c BIT_MASK 0x1 /end MEASUREMENT
/begin MEASUREMENT lv_tq_amt_dec_req "logical variable indicating torque decrease due to AMT intervention" UBYTE _CNV_S_2_RANGE__0___1_CM 1 100. 0. 1. DISPLAY_IDENTIFIER LV_TQ_AMT_DEC_REQ ECU_ADDRESS 0xd000826e BIT_MASK 0x1 /end MEASUREMENT
/begin MEASUREMENT lv_tq_amt_inc_req "logical variable indicating torque increase due to AMT intervention" UBYTE _CNV_S_2_RANGE__0___1_CM 1 100. 0. 1. DISPLAY_IDENTIFIER LV_TQ_AMT_INC_REQ ECU_ADDRESS 0xd000826f BIT_MASK 0x1 /end MEASUREMENT
/begin MEASUREMENT lv_tq_asr_req "logical variable for ASR request" UBYTE _CNV_S_2_RANGE__0___1_CM 1 100. 0. 1. DISPLAY_IDENTIFIER LV_TQ_ASR_REQ ECU_ADDRESS 0xd000823e BIT_MASK 0x1 /end MEASUREMENT
/begin MEASUREMENT lv_tq_msr_req "logical variable for MSR request" UBYTE _CNV_S_2_RANGE__0___1_CM 1 100. 0. 1. DISPLAY_IDENTIFIER LV_TQ_MSR_REQ ECU_ADDRESS 0xd000823f BIT_MASK 0x1 /end MEASUREMENT
/begin MEASUREMENT lv_tq_gs_inc_req "logical variable indicating torque increase due to gear shift intervention" UBYTE _CNV_S_2_RANGE__0___1_CM 1 100. 0. 1. DISPLAY_IDENTIFIER LV_TQ_GS_INC_REQ ECU_ADDRESS 0xd000824c BIT_MASK 0x1 /end MEASUREMENT
/begin MEASUREMENT lv_tq_gs_dec_req "logical variable indicating torque decrese due to gear shift intervention " UBYTE _CNV_S_2_RANGE__0___1_CM 1 100. 0. 1. DISPLAY_IDENTIFIER LV_TQ_GS_DEC_REQ ECU_ADDRESS 0xd000824b BIT_MASK 0x1 /end MEASUREMENT
/begin MEASUREMENT n_ecf "Setpoint step of electric cooling fan speed" UBYTE _CNV_A_R_LINEAR_____0_CM 1 100. 0. 15. DISPLAY_IDENTIFIER N_ECF ECU_ADDRESS 0xd000824f FORMAT "%2.0" /end MEASUREMENT
/begin MEASUREMENT n_gb "input shaft speed turbine/gearbox (AT) " UWORD _CNV_A_R_LINEAR_____79_CM 1 100. 0. 8191.75 DISPLAY_IDENTIFIER N_GB ECU_ADDRESS 0xd000a070 FORMAT "%7.2" /end MEASUREMENT
/begin MEASUREMENT n_max_amt_can "engine speed limit AMT via CAN" UWORD _CNV_A_R_LINEAR_____14_CM 1 100. 0. 8160. DISPLAY_IDENTIFIER N_MAX_AMT_CAN ECU_ADDRESS 0xd000a07a FORMAT "%4.0" /end MEASUREMENT
/begin MEASUREMENT state_amt_obd "status OBD gearbox" UBYTE _CNV_S_9_STATE_AMT__80_CM 1 100. 0. 15. DISPLAY_IDENTIFIER STATE_AMT_OBD ECU_ADDRESS 0xd0008267 /end MEASUREMENT
/begin MEASUREMENT state_cc "state of converter clutch (CC)" UBYTE _CNV_S_4_RANGE_STAT_81_CM 1 100. 0. 3. DISPLAY_IDENTIFIER STATE_CC ECU_ADDRESS 0xd0008249 /end MEASUREMENT
/begin MEASUREMENT state_etcu_obd "status OBD gearbox" UBYTE _CNV_S_9_STATE_AMT__80_CM 1 100. 0. 15. DISPLAY_IDENTIFIER STATE_ETCU_OBD ECU_ADDRESS 0xd000824a /end MEASUREMENT
/begin MEASUREMENT state_efp_crash_can "Request for switch off fuel pump after crash" UBYTE _CNV_A_R_LINEAR_____0_CM 1 100. 0. 3. DISPLAY_IDENTIFIER STATE_EFP_CRASH_CAN ECU_ADDRESS 0xd0008256 FORMAT "%2.0" /end MEASUREMENT
/begin MEASUREMENT state_gear_rev_can "state reverse gear: 0 inactiv, 1 activ" UBYTE _CNV_S_2_RANGE______76_CM 1 100. 0. 1. DISPLAY_IDENTIFIER STATE_GEAR_REV_CAN ECU_ADDRESS 0xd0008262 /end MEASUREMENT
/begin MEASUREMENT state_sens_ang_pste "status of wheel sensor" UBYTE _CNV_A_R_LINEAR_____0_CM 1 100. 0. 7. DISPLAY_IDENTIFIER STATE_SENS_ANG_PSTE ECU_ADDRESS 0xd0008264 FORMAT "%2.0" /end MEASUREMENT
/begin MEASUREMENT state_amt_obd_err "status OBD-relevant error - AMT" UBYTE _CNV_S_3_STATE_ETCU_51_CM 1 100. 0. 2. DISPLAY_IDENTIFIER STATE_AMT_OBD_ERR ECU_ADDRESS 0xd0008266 /end MEASUREMENT
/begin MEASUREMENT state_amt "status shift-process AMT via CAN" UBYTE _CNV_S_5_STATE_AMT_82_CM 1 100. 0. 7. DISPLAY_IDENTIFIER STATE_AMT ECU_ADDRESS 0xd0008268 /end MEASUREMENT
/begin MEASUREMENT state_clu_amt "status shift-process AMT via CAN" UBYTE _CNV_S_5_STATE_CLU__83_CM 1 100. 0. 7. DISPLAY_IDENTIFIER STATE_CLU_AMT ECU_ADDRESS 0xd0008269 /end MEASUREMENT
/begin MEASUREMENT t_rel_can "relative time counter" ULONG _CNV_A_R_LINEAR_____84_CM 1 100. 0. 4294967295. DISPLAY_IDENTIFIER T_REL_CAN ECU_ADDRESS 0xd000ad88 FORMAT "%10.0" /end MEASUREMENT
/begin MEASUREMENT tam "Ambient temperature" UBYTE _CNV_A_R_LINEAR_____17_CM 1 100. -48. 142.5 DISPLAY_IDENTIFIER TAM ECU_ADDRESS 0xd000824e FORMAT "%5.1" /end MEASUREMENT
/begin MEASUREMENT tq_conv_can "converter torque from ETCU" SWORD _CNV_A_R_LINEAR_____31_CM 1 100. -1024. 1023.96875 DISPLAY_IDENTIFIER TQ_CONV_CAN ECU_ADDRESS 0xd000a072 FORMAT "%6.2" /end MEASUREMENT
/begin MEASUREMENT vel_ang_pste "sttering wheel sensor velocity" SWORD _CNV_A_R_LINEAR_____85_CM 1 100. -1439.98976 1439.945815 DISPLAY_IDENTIFIER VEL_ANG_PSTE ECU_ADDRESS 0xd000a078 FORMAT "%8.3" /end MEASUREMENT
/begin MEASUREMENT vs_can "vehicle speed signal from CAN" UBYTE _CNV_A_R_LINEAR_____6_CM 1 100. 0. 255. DISPLAY_IDENTIFIER VS_CAN ECU_ADDRESS 0xd000823c FORMAT "%3.0" /end MEASUREMENT
/begin MEASUREMENT wheel "vehicle speed signal from CAN for cruise control" UWORD _CNV_A_R_LINEAR_____86_CM 1 100. 0. 511.99218 DISPLAY_IDENTIFIER WHEEL ECU_ADDRESS 0xd000a06e FORMAT "%7.3" /end MEASUREMENT
/begin MEASUREMENT ctr_diag_tcc_can_etcu_3 "Diagnosis counter for alive counter error symptom detection" UBYTE _CNV_A_R_LINEAR_____0_CM 1 100. 0. 255. DISPLAY_IDENTIFIER CTR_DIAG_TCC_CAN_ETCU_3 ECU_ADDRESS 0xd00082c4 FORMAT "%3.0" /end MEASUREMENT
/begin MEASUREMENT ctr_diag_tcc_can_icl "Diagnosis counter for alive counter error symptom detection" UBYTE _CNV_A_R_LINEAR_____0_CM 1 100. 0. 255. DISPLAY_IDENTIFIER CTR_DIAG_TCC_CAN_ICL ECU_ADDRESS 0xd0008288 FORMAT "%3.0" /end MEASUREMENT
/begin MEASUREMENT ctr_diag_tcc_can_msw "Diagnosis counter for alive counter error symptom detection" UBYTE _CNV_A_R_LINEAR_____0_CM 1 100. 0. 255. DISPLAY_IDENTIFIER CTR_DIAG_TCC_CAN_MSW ECU_ADDRESS 0xd000828c FORMAT "%3.0" /end MEASUREMENT
/begin MEASUREMENT ctr_diag_cks_etcu_3 "Diagnosis counter for checksum counter error symptom detection" UBYTE _CNV_A_R_LINEAR_____0_CM 1 100. 0. 255. DISPLAY_IDENTIFIER CTR_DIAG_CKS_ETCU_3 ECU_ADDRESS 0xd00082c5 FORMAT "%3.0" /end MEASUREMENT
/begin MEASUREMENT ctr_diag_cks_msw "Diagnosis counter for checksum counter error symptom detection" UBYTE _CNV_A_R_LINEAR_____0_CM 1 100. 0. 255. DISPLAY_IDENTIFIER CTR_DIAG_CKS_MSW ECU_ADDRESS 0xd000828d FORMAT "%3.0" /end MEASUREMENT
/begin MEASUREMENT ctr_diag_tout_cdn_door "Diagnosis counter for timeout counter error symptom detection" UBYTE _CNV_A_R_LINEAR_____0_CM 1 100. 0. 255. DISPLAY_IDENTIFIER CTR_DIAG_TOUT_CDN_DOOR ECU_ADDRESS 0xd00082ca FORMAT "%3.0" /end MEASUREMENT
/begin MEASUREMENT ctr_diag_tout_etcu_3 "Diagnosis counter for timeout counter error symptom detection" UBYTE _CNV_A_R_LINEAR_____0_CM 1 100. 0. 255. DISPLAY_IDENTIFIER CTR_DIAG_TOUT_ETCU_3 ECU_ADDRESS 0xd00082c6 FORMAT "%3.0" /end MEASUREMENT
/begin MEASUREMENT ctr_diag_tout_acc "Diagnosis counter for timeout counter error symptom detection" UBYTE _CNV_A_R_LINEAR_____0_CM 1 100. 0. 255. DISPLAY_IDENTIFIER CTR_DIAG_TOUT_ACC ECU_ADDRESS 0xd00082b2 FORMAT "%3.0" /end MEASUREMENT
/begin MEASUREMENT ctr_diag_tout_km_icl "Diagnosis counter for timeout counter error symptom detection" UBYTE _CNV_A_R_LINEAR_____0_CM 1 100. 0. 255. DISPLAY_IDENTIFIER CTR_DIAG_TOUT_KM_ICL ECU_ADDRESS 0xd00082aa FORMAT "%3.0" /end MEASUREMENT
/begin MEASUREMENT ctr_diag_tout_icl "Diagnosis counter for timeout counter error symptom detection" UBYTE _CNV_A_R_LINEAR_____0_CM 1 100. 0. 255. DISPLAY_IDENTIFIER CTR_DIAG_TOUT_ICL ECU_ADDRESS 0xd000828a FORMAT "%3.0" /end MEASUREMENT
/begin MEASUREMENT ctr_diag_tout_pow_vb "Diagnosis counter for timeout counter error symptom detection" UBYTE _CNV_A_R_LINEAR_____0_CM 1 100. 0. 255. DISPLAY_IDENTIFIER CTR_DIAG_TOUT_POW_VB ECU_ADDRESS 0xd0008296 FORMAT "%3.0" /end MEASUREMENT
/begin MEASUREMENT ctr_diag_tout_pow_gen "Diagnosis counter for timeout counter error symptom detection" UBYTE _CNV_A_R_LINEAR_____0_CM 1 100. 0. 255. DISPLAY_IDENTIFIER CTR_DIAG_TOUT_POW_GEN ECU_ADDRESS 0xd0008292 FORMAT "%3.0" /end MEASUREMENT
/begin MEASUREMENT ctr_diag_tout_msw "Diagnosis counter for timeout counter error symptom detection" UBYTE _CNV_A_R_LINEAR_____0_CM 1 100. 0. 255. DISPLAY_IDENTIFIER CTR_DIAG_TOUT_MSW ECU_ADDRESS 0xd000828e FORMAT "%3.0" /end MEASUREMENT
/begin MEASUREMENT ctr_diag_tout_t_icl "Diagnosis counter for timeout counter error symptom detection" UBYTE _CNV_A_R_LINEAR_____0_CM 1 100. 0. 255. DISPLAY_IDENTIFIER CTR_DIAG_TOUT_T_ICL ECU_ADDRESS 0xd00082a6 FORMAT "%3.0" /end MEASUREMENT
/begin MEASUREMENT ctr_diag_tcc_can_veh_mod "Diagnosis counter for alive counter error symptom detection" UBYTE _CNV_A_R_LINEAR_____0_CM 1 100. 0. 255. DISPLAY_IDENTIFIER CTR_DIAG_TCC_CAN_VEH_MOD ECU_ADDRESS 0xd00082b4 FORMAT "%3.0" /end MEASUREMENT
/begin MEASUREMENT ctr_diag_cks_veh_mod "Diagnosis counter for checksum counter error symptom detection" UBYTE _CNV_A_R_LINEAR_____0_CM 1 100. 0. 255. DISPLAY_IDENTIFIER CTR_DIAG_CKS_VEH_MOD ECU_ADDRESS 0xd00082b5 FORMAT "%3.0" /end MEASUREMENT
/begin MEASUREMENT ctr_diag_tout_veh_mod "Diagnosis counter for timeout counter error symptom detection" UBYTE _CNV_A_R_LINEAR_____0_CM 1 100. 0. 255. DISPLAY_IDENTIFIER CTR_DIAG_TOUT_VEH_MOD ECU_ADDRESS 0xd00082b6 FORMAT "%3.0" /end MEASUREMENT
/begin MEASUREMENT ctr_diag_tout_efp "Diagnosis counter for timeout counter error symptom detection" UBYTE _CNV_A_R_LINEAR_____0_CM 1 100. 0. 255. DISPLAY_IDENTIFIER CTR_DIAG_TOUT_EFP ECU_ADDRESS 0xd00082ba FORMAT "%3.0" /end MEASUREMENT
/begin MEASUREMENT ctr_diag_tout_efp_crash "Diagnosis counter for timeout counter error symptom detection" UBYTE _CNV_A_R_LINEAR_____0_CM 1 100. 0. 255. DISPLAY_IDENTIFIER CTR_DIAG_TOUT_EFP_CRASH ECU_ADDRESS 0xd00082be FORMAT "%3.0" /end MEASUREMENT
/begin MEASUREMENT lv_err_bn_acc "Present error BN2000" UBYTE _CNV_S_2_RANGE__0___1_CM 1 100. 0. 1. DISPLAY_IDENTIFIER LV_ERR_BN_ACC ECU_ADDRESS 0xd0007fa3 BIT_MASK 0x1 /end MEASUREMENT
/begin MEASUREMENT lv_err_bn_icl "Present error BN2000" UBYTE _CNV_S_2_RANGE__0___1_CM 1 100. 0. 1. DISPLAY_IDENTIFIER LV_ERR_BN_ICL ECU_ADDRESS 0xd0007fa7 BIT_MASK 0x1 /end MEASUREMENT
/begin MEASUREMENT lv_err_bn_km_icl "Present error BN2000" UBYTE _CNV_S_2_RANGE__0___1_CM 1 100. 0. 1. DISPLAY_IDENTIFIER LV_ERR_BN_KM_ICL ECU_ADDRESS 0xd0007fa6 BIT_MASK 0x1 /end MEASUREMENT
/begin MEASUREMENT lv_err_bn_pow_gen "Present error BN2000" UBYTE _CNV_S_2_RANGE__0___1_CM 1 100. 0. 1. DISPLAY_IDENTIFIER LV_ERR_BN_POW_GEN ECU_ADDRESS 0xd0007fa9 BIT_MASK 0x1 /end MEASUREMENT
/begin MEASUREMENT lv_err_bn_pow_vb "Present error BN2000" UBYTE _CNV_S_2_RANGE__0___1_CM 1 100. 0. 1. DISPLAY_IDENTIFIER LV_ERR_BN_POW_VB ECU_ADDRESS 0xd0007fa8 BIT_MASK 0x1 /end MEASUREMENT
/begin MEASUREMENT lv_err_bn_t_icl "Present error BN2000" UBYTE _CNV_S_2_RANGE__0___1_CM 1 100. 0. 1. DISPLAY_IDENTIFIER LV_ERR_BN_T_ICL ECU_ADDRESS 0xd0007fa4 BIT_MASK 0x1 /end MEASUREMENT
/begin MEASUREMENT lv_err_bn_tq_pste_2 "Present error BN2000" UBYTE _CNV_S_2_RANGE__0___1_CM 1 100. 0. 1. DISPLAY_IDENTIFIER LV_ERR_BN_TQ_PSTE_2 ECU_ADDRESS 0xd0007f96 BIT_MASK 0x1 /end MEASUREMENT
/begin MEASUREMENT lv_err_bn_tq_pste_3 "Present error BN2000" UBYTE _CNV_S_2_RANGE__0___1_CM 1 100. 0. 1. DISPLAY_IDENTIFIER LV_ERR_BN_TQ_PSTE_3 ECU_ADDRESS 0xd0007f97 BIT_MASK 0x1 /end MEASUREMENT
/begin MEASUREMENT lv_err_bn_efp "Present error BN2000" UBYTE _CNV_S_2_RANGE__0___1_CM 1 100. 0. 1. DISPLAY_IDENTIFIER LV_ERR_BN_EFP ECU_ADDRESS 0xd0007fb6 BIT_MASK 0x1 /end MEASUREMENT
/begin MEASUREMENT lv_err_bn_efp_crash "Present error BN2000" UBYTE _CNV_S_2_RANGE__0___1_CM 1 100. 0. 1. DISPLAY_IDENTIFIER LV_ERR_BN_EFP_CRASH ECU_ADDRESS 0xd0007fb2 BIT_MASK 0x1 /end MEASUREMENT
/begin MEASUREMENT lv_err_bn_gear_rev "Present error BN2000" UBYTE _CNV_S_2_RANGE__0___1_CM 1 100. 0. 1. DISPLAY_IDENTIFIER LV_ERR_BN_GEAR_REV ECU_ADDRESS 0xd0007fac BIT_MASK 0x1 /end MEASUREMENT
/begin MEASUREMENT ctr_diag_tout_gear_rev "Diagnosis counter for timeout counter error symptom detection" UBYTE _CNV_A_R_LINEAR_____0_CM 1 100. 0. 255. DISPLAY_IDENTIFIER CTR_DIAG_TOUT_GEAR_REV ECU_ADDRESS 0xd00082ae FORMAT "%3.0" /end MEASUREMENT
/begin MEASUREMENT lv_err_bn_ltg_hdlp_l "Present error BN2000" UBYTE _CNV_S_2_RANGE__0___1_CM 1 100. 0. 1. DISPLAY_IDENTIFIER LV_ERR_BN_LTG_HDLP_L ECU_ADDRESS 0xd0007fad BIT_MASK 0x1 /end MEASUREMENT
/begin MEASUREMENT ctr_diag_tout_ltg_hdlp_l "Diagnosis counter for timeout counter error symptom detection" UBYTE _CNV_A_R_LINEAR_____0_CM 1 100. 0. 255. DISPLAY_IDENTIFIER CTR_DIAG_TOUT_LTG_HDLP_L ECU_ADDRESS 0xd000829a FORMAT "%3.0" /end MEASUREMENT
/begin MEASUREMENT lv_err_bn_ldm "Present error BN2000" UBYTE _CNV_S_2_RANGE__0___1_CM 1 100. 0. 1. DISPLAY_IDENTIFIER LV_ERR_BN_LDM ECU_ADDRESS 0xd0007fae BIT_MASK 0x1 /end MEASUREMENT
/begin MEASUREMENT ctr_diag_tout_hiv "Diagnosis counter for timeout counter error symptom detection" UBYTE _CNV_A_R_LINEAR_____0_CM 1 100. 0. 255. DISPLAY_IDENTIFIER CTR_DIAG_TOUT_HIV ECU_ADDRESS 0xd00082c2 FORMAT "%3.0" /end MEASUREMENT
/begin MEASUREMENT lv_err_bn_hiv "Present error BN2000" UBYTE _CNV_S_2_RANGE__0___1_CM 1 100. 0. 1. DISPLAY_IDENTIFIER LV_ERR_BN_HIV ECU_ADDRESS 0xd0007fb0 BIT_MASK 0x1 /end MEASUREMENT
/begin MEASUREMENT ctr_diag_tout_trl "Diagnosis counter for timeout counter error symptom detection" UBYTE _CNV_A_R_LINEAR_____0_CM 1 100. 0. 255. DISPLAY_IDENTIFIER CTR_DIAG_TOUT_TRL ECU_ADDRESS 0xd00082a2 FORMAT "%3.0" /end MEASUREMENT
/begin MEASUREMENT lv_err_bn_trl "Present error BN2000" UBYTE _CNV_S_2_RANGE__0___1_CM 1 100. 0. 1. DISPLAY_IDENTIFIER LV_ERR_BN_TRL ECU_ADDRESS 0xd0007faf BIT_MASK 0x1 /end MEASUREMENT
/begin MEASUREMENT ctr_diag_tout_t_clk "Diagnosis counter for timeout counter error symptom detection" UBYTE _CNV_A_R_LINEAR_____0_CM 1 100. 0. 255. DISPLAY_IDENTIFIER CTR_DIAG_TOUT_T_CLK ECU_ADDRESS 0xd000829e FORMAT "%3.0" /end MEASUREMENT
/begin MEASUREMENT lv_err_bn_t_clk "Present error BN2000" UBYTE _CNV_S_2_RANGE__0___1_CM 1 100. 0. 1. DISPLAY_IDENTIFIER LV_ERR_BN_T_CLK ECU_ADDRESS 0xd0007fb1 BIT_MASK 0x1 /end MEASUREMENT
/begin MEASUREMENT lv_err_bn_etcu_disp "Present error BN2000" UBYTE _CNV_S_2_RANGE__0___1_CM 1 100. 0. 1. DISPLAY_IDENTIFIER LV_ERR_BN_ETCU_DISP ECU_ADDRESS 0xd0007fa1 BIT_MASK 0x1 /end MEASUREMENT
/begin MEASUREMENT lv_err_bn_cdn_door "Present error BN2000" UBYTE _CNV_S_2_RANGE__0___1_CM 1 100. 0. 1. DISPLAY_IDENTIFIER LV_ERR_BN_CDN_DOOR ECU_ADDRESS 0xd0007fb3 BIT_MASK 0x1 /end MEASUREMENT
/begin MEASUREMENT lv_err_bn_etcu_3 "Present error BN2000" UBYTE _CNV_S_2_RANGE__0___1_CM 1 100. 0. 1. DISPLAY_IDENTIFIER LV_ERR_BN_ETCU_3 ECU_ADDRESS 0xd0007fa0 BIT_MASK 0x1 /end MEASUREMENT
/begin MEASUREMENT lv_err_bn_cas "Present error BN2000" UBYTE _CNV_S_2_RANGE__0___1_CM 1 100. 0. 1. DISPLAY_IDENTIFIER LV_ERR_BN_CAS ECU_ADDRESS 0xd0007f99 BIT_MASK 0x1 /end MEASUREMENT
/begin MEASUREMENT lv_err_bn_req_pbr "Present error BN2000" UBYTE _CNV_S_2_RANGE__0___1_CM 1 100. 0. 1. DISPLAY_IDENTIFIER LV_ERR_BN_REQ_PBR ECU_ADDRESS 0xd0007fb4 BIT_MASK 0x1 /end MEASUREMENT
/begin MEASUREMENT lv_err_bn_pbr "Present error BN2000" UBYTE _CNV_S_2_RANGE__0___1_CM 1 100. 0. 1. DISPLAY_IDENTIFIER LV_ERR_BN_PBR ECU_ADDRESS 0xd0007fb5 BIT_MASK 0x1 /end MEASUREMENT
/begin MEASUREMENT ctr_diag_tcc_can_cas "Diagnosis counter for alive counter error symptom detection" UBYTE _CNV_A_R_LINEAR_____0_CM 1 100. 0. 255. DISPLAY_IDENTIFIER CTR_DIAG_TCC_CAN_CAS ECU_ADDRESS 0xd0008284 FORMAT "%3.0" /end MEASUREMENT
/begin MEASUREMENT ctr_diag_cks_cas "Diagnosis counter for checksum counter error symptom detection" UBYTE _CNV_A_R_LINEAR_____0_CM 1 100. 0. 255. DISPLAY_IDENTIFIER CTR_DIAG_CKS_CAS ECU_ADDRESS 0xd0008285 FORMAT "%3.0" /end MEASUREMENT
/begin MEASUREMENT ctr_diag_tout_cas "Diagnosis counter for timeout counter error symptom detection" UBYTE _CNV_A_R_LINEAR_____0_CM 1 100. 0. 255. DISPLAY_IDENTIFIER CTR_DIAG_TOUT_CAS ECU_ADDRESS 0xd0008286 FORMAT "%3.0" /end MEASUREMENT
/begin MEASUREMENT lv_cs_cus "Boolean for clutch switch detection" UBYTE _CNV_S_2_RANGE__0___1_CM 1 100. 0. 1. DISPLAY_IDENTIFIER LV_CS_CUS ECU_ADDRESS 0xd0008bcc BIT_MASK 0x1 /end MEASUREMENT
/begin MEASUREMENT lv_im_cs_pn "clutch switch" UBYTE _CNV_S_2_RANGE__0___1_CM 1 100. 0. 1. DISPLAY_IDENTIFIER LV_IM_CS_PN ECU_ADDRESS 0xd0008bcd BIT_MASK 0x1 /end MEASUREMENT
/begin MEASUREMENT lv_ct "Logical variable detection of driver passive" UBYTE _CNV_S_2_RANGE__0___1_CM 1 100. 0. 1. DISPLAY_IDENTIFIER LV_CT ECU_ADDRESS 0xd0008bd4 BIT_MASK 0x1 /end MEASUREMENT
/begin CHARACTERISTIC c_fac_tq_req_clu_is_hys "Hysteresis on threshold on FAC_TQ_REQ_CLU_for IS detection" VALUE 0xa080bd14 _REC_VAL_20_u2 1.99996948242188 _CNV_A_R_LINEAR_____9_CM 0. 1.99996948242188 DISPLAY_IDENTIFIER C_FAC_TQ_REQ_CLU_IS_HYS FORMAT "%7.5" /end CHARACTERISTIC
/begin CHARACTERISTIC ip_fac_tq_req_clu_is__n_32 "Threshold on FAC_TQ_REQ_CLU for IS detection" CURVE 0xa080abd4 _REC_CUR_20_u2_u1 1.99996948242188 _CNV_A_R_LINEAR_____9_CM 0. 1.99996948242188 DISPLAY_IDENTIFIER IP_FAC_TQ_REQ_CLU_IS__N_32 FORMAT "%7.5"
 /begin AXIS_DESCR COM_AXIS n_32 _CNV_A_R_LINEAR_____10_CM 3 0. 8160. FORMAT "%4.0" AXIS_PTS_REF ldp_n_32__fac_tq_req_clu_is /end AXIS_DESCR
/end CHARACTERISTIC
/begin AXIS_PTS ldp_n_32__fac_tq_req_clu_is "" 0xa0808992 n_32 _REC_AXS_20_u1 8160. _CNV_A_R_LINEAR_____10_CM 3 0. 8160. FORMAT "%4.0" /end AXIS_PTS
/begin MEASUREMENT lv_dt "Logical variable drive train engaged" UBYTE _CNV_S_2_RANGE__0___1_CM 1 100. 0. 1. DISPLAY_IDENTIFIER LV_DT ECU_ADDRESS 0xd0008bd0 BIT_MASK 0x1 /end MEASUREMENT
/begin CHARACTERISTIC c_vs_min_dt "Threshold for vehicle running and drive-train closed detection " VALUE 0xa080c4d8 _REC_VAL_20_u1 255. _CNV_A_R_LINEAR_____6_CM 0. 255. DISPLAY_IDENTIFIER C_VS_MIN_DT FORMAT "%3.0" /end CHARACTERISTIC
/begin MEASUREMENT lv_eng_run_can "Engine running status" UBYTE _CNV_S_2_RANGE__0___1_CM 1 100. 0. 1. DISPLAY_IDENTIFIER LV_ENG_RUN_CAN ECU_ADDRESS 0xd000047f BIT_MASK 0x1 /end MEASUREMENT
/begin MEASUREMENT n_can "Engine speed- converted for BN2000" UWORD _CNV_A_R_LINEAR_____170_CM 1 100. 0. 8160. DISPLAY_IDENTIFIER N_CAN ECU_ADDRESS 0xd00012be FORMAT "%6.1" /end MEASUREMENT
/begin MEASUREMENT ctr_ldm_can_ini "counter for sending ini-value of ST_INTF_PT" UBYTE _CNV_A_R_LINEAR_____36_CM 1 100. 0. 255. DISPLAY_IDENTIFIER CTR_LDM_CAN_INI ECU_ADDRESS 0xd0000406 FORMAT "%3.0" /end MEASUREMENT
/begin MEASUREMENT tcc_com_1_tq_crk_1 "Alive counter for communication on bus 1 (FlexRay)" UBYTE _CNV_A_R_LINEAR_____50_CM 1 100. 0. 14. DISPLAY_IDENTIFIER TCC_COM_1_TQ_CRK_1 ECU_ADDRESS 0xd0008557 FORMAT "%2.0" /end MEASUREMENT
/begin MEASUREMENT tcc_com_2_tq_crk_1 "Alive counter for communication on bus 2 (FA-CAN)" UBYTE _CNV_A_R_LINEAR_____50_CM 1 100. 0. 14. DISPLAY_IDENTIFIER TCC_COM_2_TQ_CRK_1 ECU_ADDRESS 0xd0008558 FORMAT "%2.0" /end MEASUREMENT
/begin MEASUREMENT tcc_com_3_tq_crk_1 "Alive counter for communication on bus 3 (A-CAN)" UBYTE _CNV_A_R_LINEAR_____50_CM 1 100. 0. 14. DISPLAY_IDENTIFIER TCC_COM_3_TQ_CRK_1 ECU_ADDRESS 0xd0008559 FORMAT "%2.0" /end MEASUREMENT
/begin MEASUREMENT tcc_com_2_tq_crk_2 "Alive counter for communication on bus 2 (FA-CAN)" UBYTE _CNV_A_R_LINEAR_____50_CM 1 100. 0. 14. DISPLAY_IDENTIFIER TCC_COM_2_TQ_CRK_2 ECU_ADDRESS 0xd000855c FORMAT "%2.0" /end MEASUREMENT
/begin MEASUREMENT tcc_com_3_tq_crk_2 "Alive counter for communication on bus 3 (A-CAN)" UBYTE _CNV_A_R_LINEAR_____50_CM 1 100. 0. 14. DISPLAY_IDENTIFIER TCC_COM_3_TQ_CRK_2 ECU_ADDRESS 0xd000855d FORMAT "%2.0" /end MEASUREMENT
/begin MEASUREMENT tcc_com_1_tq_crk_3 "Alive counter for communication on bus 1 (FlexRay)" UBYTE _CNV_A_R_LINEAR_____50_CM 1 100. 0. 14. DISPLAY_IDENTIFIER TCC_COM_1_TQ_CRK_3 ECU_ADDRESS 0xd0008561 FORMAT "%2.0" /end MEASUREMENT
/begin MEASUREMENT tcc_com_2_tq_crk_3 "Alive counter for communication on bus 2 (FA-CAN)" UBYTE _CNV_A_R_LINEAR_____50_CM 1 100. 0. 14. DISPLAY_IDENTIFIER TCC_COM_2_TQ_CRK_3 ECU_ADDRESS 0xd0008562 FORMAT "%2.0" /end MEASUREMENT
/begin MEASUREMENT tcc_com_3_tq_crk_3 "Alive counter for communication on bus 3 (A-CAN)" UBYTE _CNV_A_R_LINEAR_____50_CM 1 100. 0. 14. DISPLAY_IDENTIFIER TCC_COM_3_TQ_CRK_3 ECU_ADDRESS 0xd0008563 FORMAT "%2.0" /end MEASUREMENT
/begin MEASUREMENT tcc_com_1_tq_wheel "Alive counter for communication on bus 1 (FlexRay)" UBYTE _CNV_A_R_LINEAR_____50_CM 1 100. 0. 14. DISPLAY_IDENTIFIER TCC_COM_1_TQ_WHEEL ECU_ADDRESS 0xd0008564 FORMAT "%2.0" /end MEASUREMENT
/begin MEASUREMENT tcc_com_1_etcu_dt "Alive counter for communication on bus 1 (FlexRay)" UBYTE _CNV_A_R_LINEAR_____50_CM 1 100. 0. 14. DISPLAY_IDENTIFIER TCC_COM_1_ETCU_DT ECU_ADDRESS 0xd0008566 FORMAT "%2.0" /end MEASUREMENT
/begin MEASUREMENT tcc_com_2_etcu_dt "Alive counter for communication on bus 2 (FA-CAN)" UBYTE _CNV_A_R_LINEAR_____50_CM 1 100. 0. 14. DISPLAY_IDENTIFIER TCC_COM_2_ETCU_DT ECU_ADDRESS 0xd0008567 FORMAT "%2.0" /end MEASUREMENT
/begin MEASUREMENT tcc_com_1_info_dt_2 "Alive counter for communication on bus 1 (FlexRay)" UBYTE _CNV_A_R_LINEAR_____50_CM 1 100. 0. 14. DISPLAY_IDENTIFIER TCC_COM_1_INFO_DT_2 ECU_ADDRESS 0xd000856d FORMAT "%2.0" /end MEASUREMENT
/begin MEASUREMENT tcc_com_2_info_dt_2 "Alive counter for communication on FA_CAN" UBYTE _CNV_A_R_LINEAR_____50_CM 1 100. 0. 14. DISPLAY_IDENTIFIER TCC_COM_2_INFO_DT_2 ECU_ADDRESS 0xd000856e FORMAT "%2.0" /end MEASUREMENT
/begin MEASUREMENT tcc_com_3_info_dt_2 "Alive counter for communication on A_CAN" UBYTE _CNV_A_R_LINEAR_____50_CM 1 100. 0. 14. DISPLAY_IDENTIFIER TCC_COM_3_INFO_DT_2 ECU_ADDRESS 0xd000856f FORMAT "%2.0" /end MEASUREMENT
/begin MEASUREMENT tcc_com_1_pv "Alive counter for communication" UBYTE _CNV_A_R_LINEAR_____50_CM 1 100. 0. 14. DISPLAY_IDENTIFIER TCC_COM_1_PV ECU_ADDRESS 0xd0008571 FORMAT "%2.0" /end MEASUREMENT
/begin MEASUREMENT tcc_com_2_n "Alive counter for communication" UBYTE _CNV_A_R_LINEAR_____50_CM 1 100. 0. 14. DISPLAY_IDENTIFIER TCC_COM_2_N ECU_ADDRESS 0xd0008572 FORMAT "%2.0" /end MEASUREMENT
/begin CHARACTERISTIC c_min_vs_ratio "Minimum engine speed / vehicle speed ratio calculation" VALUE 0xa080bec6 _REC_VAL_20_u1 255. _CNV_A_R_LINEAR_____6_CM 0. 255. DISPLAY_IDENTIFIER C_MIN_VS_RATIO FORMAT "%3.0" /end CHARACTERISTIC
/begin CHARACTERISTIC id_gr_mt__n_vs_ratio "Index table for Gear Ratio detection" CURVE 0xa08099c4 _REC_CUR_20_u1_u1 255. _CNV_A_R_LINEAR_____0_CM 0. 255. DISPLAY_IDENTIFIER ID_GR_MT FORMAT "%3.0"
 /begin AXIS_DESCR COM_AXIS n_vs_ratio _CNV_A_R_LINEAR_____0_CM 13 0. 255. FORMAT "%3.0" AXIS_PTS_REF ldp_n_vs_ratio_gr_mt /end AXIS_DESCR
/end CHARACTERISTIC
/begin AXIS_PTS ldp_n_vs_ratio_gr_mt "" 0xa0808bc4 n_vs_ratio _REC_AXS_20_u1 255. _CNV_A_R_LINEAR_____0_CM 13 0. 255. FORMAT "%3.0" /end AXIS_PTS
/begin CHARACTERISTIC lc_rng_l "Manual switch for low range detection" VALUE 0xa080c5df _REC_VAL_20_u1 1. _CNV_A_R_LINEAR_____0_CM 0. 1. DISPLAY_IDENTIFIER LC_RNG_L FORMAT "%1.0" /end CHARACTERISTIC
/begin MEASUREMENT gr_mt "Manual transmission gear ratio" UBYTE _CNV_A_R_LINEAR_____0_CM 1 100. 0. 255. DISPLAY_IDENTIFIER GR_MT ECU_ADDRESS 0xd0008bc4 FORMAT "%3.0" /end MEASUREMENT
/begin MEASUREMENT gr_at "Automatic transmission gear ratio" UBYTE _CNV_A_R_LINEAR_____0_CM 1 100. 0. 255. DISPLAY_IDENTIFIER GR_AT ECU_ADDRESS 0xd0008bc5 FORMAT "%3.0" /end MEASUREMENT
/begin MEASUREMENT lv_rng_l "Logical variable for engaged low range" UBYTE _CNV_S_2_RANGE__0___1_CM 1 100. 0. 1. DISPLAY_IDENTIFIER LV_RNG_L ECU_ADDRESS 0xd0008bc9 BIT_MASK 0x1 /end MEASUREMENT
/begin MEASUREMENT lv_dri "Logical variable for engaged drive" UBYTE _CNV_S_2_RANGE__0___1_CM 1 100. 0. 1. DISPLAY_IDENTIFIER LV_DRI ECU_ADDRESS 0xd0008bcb BIT_MASK 0x1 /end MEASUREMENT
/begin MEASUREMENT gear "" UBYTE _CNV_A_R_LINEAR_____0_CM 1 100. 0. 255. DISPLAY_IDENTIFIER GEAR ECU_ADDRESS 0xd0008bc6 FORMAT "%3.0" /end MEASUREMENT
/begin MEASUREMENT gear_ef "Gear ratio used for exhaust flap functionality" UBYTE _CNV_A_R_LINEAR_____0_CM 1 100. 0. 255. DISPLAY_IDENTIFIER GEAR_EF ECU_ADDRESS 0xd0008bc7 FORMAT "%3.0" /end MEASUREMENT
/begin MEASUREMENT state_gear_rev_at_amt "AT/AMT reverse gear (activ = 1, inactive = 0)" UBYTE _CNV_S_2_RANGE______76_CM 1 100. 0. 1. DISPLAY_IDENTIFIER STATE_GEAR_REV_AT_AMT ECU_ADDRESS 0xd0008bc8 /end MEASUREMENT
/begin MEASUREMENT n_vs_ratio "Engine speed / vehicle speed ratio" UBYTE _CNV_A_R_LINEAR_____184_CM 1 100. 0. 255. DISPLAY_IDENTIFIER N_VS_RATIO ECU_ADDRESS 0xd0000d18 FORMAT "%3.0" /end MEASUREMENT
/begin MEASUREMENT fac_gr "Factor for setpoint/actual reduction ratio of rear axle" UWORD _CNV_A_R_LINEAR_____9_CM 1 100. 0. 1.99996948242188 DISPLAY_IDENTIFIER FAC_GR ECU_ADDRESS 0xd0000d14 FORMAT "%7.5" /end MEASUREMENT
/begin MEASUREMENT fac_gr_mmv_av "Rear axle ratio adaptation value" UWORD _CNV_A_R_LINEAR_____9_CM 1 100. 0. 1.99996948242188 DISPLAY_IDENTIFIER FAC_GR_MMV_AV ECU_ADDRESS 0xd000a784 FORMAT "%7.5" /end MEASUREMENT
/begin MEASUREMENT gr_rax_av "Current rear axle ratio" UWORD _CNV_A_R_LINEAR_____28_CM 1 100. 0. 255.99609375 DISPLAY_IDENTIFIER GR_RAX_AV ECU_ADDRESS 0xd0000d16 FORMAT "%7.3" /end MEASUREMENT
/begin CHARACTERISTIC c_gr_rax_sp "Rear axle ratio of standard rear axle" VALUE 0xa080bda6 _REC_VAL_20_u2 255.99609375 _CNV_A_R_LINEAR_____28_CM 0. 255.99609375 DISPLAY_IDENTIFIER C_GR_RAX_SP FORMAT "%7.3" /end CHARACTERISTIC
/begin CHARACTERISTIC c_crlc_fac_gr "Correlation constant for adaptation of the rear axle" VALUE 0xa080bae2 _REC_VAL_20_u1 0.99609375 _CNV_A_R_LINEAR_____185_CM 0. 0.99609375 DISPLAY_IDENTIFIER C_CRLC_FAC_GR FORMAT "%5.3" /end CHARACTERISTIC
/begin CHARACTERISTIC c_n_vs_cru_gear2_puc_sp "N/VS ratio in case of PUC in 2nd gear with standard rear axle" VALUE 0xa080bfdd _REC_VAL_20_u1 255. _CNV_A_R_LINEAR_____184_CM 0. 255. DISPLAY_IDENTIFIER C_N_VS_CRU_GEAR2_PUC_SP FORMAT "%3.0" /end CHARACTERISTIC
/begin CHARACTERISTIC c_n_vs_cru_grd_fac_gr_max "Gradient of N/VS ratio below which FAC_GR is adapted" VALUE 0xa080bfde _REC_VAL_20_u1 255. _CNV_A_R_LINEAR_____184_CM 0. 255. DISPLAY_IDENTIFIER C_N_VS_CRU_GRD_FAC_GR_MAX FORMAT "%3.0" /end CHARACTERISTIC
/begin MEASUREMENT lv_rng_l_at "Logical variable for engaged low range AT" UBYTE _CNV_S_2_RANGE__0___1_CM 1 100. 0. 1. DISPLAY_IDENTIFIER LV_RNG_L_AT ECU_ADDRESS 0xd0008bca BIT_MASK 0x1 /end MEASUREMENT
/begin CHARACTERISTIC c_state_etcu_prog_info "manual switch for activating low range AT detection" VALUE 0xa080c0e1 _REC_VAL_20_u1 255. _CNV_A_R_LINEAR_____0_CM 0. 255. DISPLAY_IDENTIFIER C_STATE_ETCU_PROG_INFO FORMAT "%3.0" /end CHARACTERISTIC
/begin MEASUREMENT lv_err_bn_tq_etcu "Present error BN2000" UBYTE _CNV_S_2_RANGE__0___1_CM 1 100. 0. 1. DISPLAY_IDENTIFIER LV_ERR_BN_TQ_ETCU ECU_ADDRESS 0xd0007f9d BIT_MASK 0x1 /end MEASUREMENT
/begin MEASUREMENT maf_kgh_mes_bas[0] "Raw air-mass flow measured (without correction, to be used for diagnosis only)" UWORD _CNV_A_R_LINEAR_____215_CM 1 100. 0. 2047.96875 DISPLAY_IDENTIFIER MAF_KGH_MES_BAS[1] ECU_ADDRESS 0xd000a430 FORMAT "%7.2" /end MEASUREMENT
/begin MEASUREMENT maf_kgh_mes_bas[1] "Raw air-mass flow measured (without correction, to be used for diagnosis only)" UWORD _CNV_A_R_LINEAR_____215_CM 1 100. 0. 2047.96875 DISPLAY_IDENTIFIER MAF_KGH_MES_BAS[2] ECU_ADDRESS 0xd000a432 FORMAT "%7.2" /end MEASUREMENT
/begin MEASUREMENT maf_mes[0] "Mass air flow per segment" UWORD _CNV_A_R_LINEAR_____111_CM 1 100. 0. 1389. DISPLAY_IDENTIFIER MAF_MES[1] ECU_ADDRESS 0xd000a434 FORMAT "%7.2" /end MEASUREMENT
/begin MEASUREMENT maf_mes[1] "Mass air flow per segment" UWORD _CNV_A_R_LINEAR_____111_CM 1 100. 0. 1389. DISPLAY_IDENTIFIER MAF_MES[2] ECU_ADDRESS 0xd000a436 FORMAT "%7.2" /end MEASUREMENT
/begin MEASUREMENT maf_kgh_mes[0] "Mass air flow per segment measured" UWORD _CNV_A_R_LINEAR_____215_CM 1 100. 0. 2047.96875 DISPLAY_IDENTIFIER MAF_KGH_MES[1] ECU_ADDRESS 0xd000a42c FORMAT "%7.2" /end MEASUREMENT
/begin MEASUREMENT maf_kgh_mes[1] "Mass air flow per segment measured" UWORD _CNV_A_R_LINEAR_____215_CM 1 100. 0. 2047.96875 DISPLAY_IDENTIFIER MAF_KGH_MES[2] ECU_ADDRESS 0xd000a42e FORMAT "%7.2" /end MEASUREMENT
/begin AXIS_PTS ldp_n__pq_sp_puls "" 0xa0808aac n _REC_AXS_20_u2 816. _CNV_A_R_LINEAR_____14_CM 6 0. 8160. FORMAT "%4.0" /end AXIS_PTS
/begin CHARACTERISTIC ip_pq_sp_puls "PQ-threshold for LV_MAF_PULS" CURVE 0xa080b364 _REC_CUR_20_u2_u2 0.9999847412109381 _CNV_A_R_LINEAR_____89_CM 0. 0.9999847412109381 DISPLAY_IDENTIFIER IP_PQ_SP_PULS FORMAT "%7.5"
 /begin AXIS_DESCR COM_AXIS n _CNV_A_R_LINEAR_____14_CM 6 0. 8160. FORMAT "%4.0" AXIS_PTS_REF ldp_n__pq_sp_puls /end AXIS_DESCR
/end CHARACTERISTIC
/begin CHARACTERISTIC c_pq_sp_hys_puls "Hysteresis for PQ-threshold for LV_MAF_PULS" VALUE 0xa080c082 _REC_VAL_20_u2 0.9999847412109381 _CNV_A_R_LINEAR_____89_CM 0. 0.9999847412109381 DISPLAY_IDENTIFIER C_PQ_SP_HYS_PULS FORMAT "%7.5" /end CHARACTERISTIC
/begin MEASUREMENT lv_maf_puls "Boolean for wrong air flow acquisition" UBYTE _CNV_S_2_RANGE__0___1_CM 1 100. 0. 1. DISPLAY_IDENTIFIER LV_MAF_PULS ECU_ADDRESS 0xd00088d4 BIT_MASK 0x1 /end MEASUREMENT
/begin CHARACTERISTIC ip_fac_maf_kgh_cor "Correction for MAF_KGH_MES depending on MAF_KGH_MES_BAS" MAP 0xa0814554 _REC_MAP_20_u1_u2_u1 1.9921875 _CNV_A_R_LINEAR_____103_CM 0. 1.9921875 DISPLAY_IDENTIFIER IP_FAC_MAF_KGH_COR FORMAT "%5.3"
 /begin AXIS_DESCR COM_AXIS NO_INPUT_QUANTITY _CNV_A_R_LINEAR_____215_CM 16 0. 2047.96875 FORMAT "%7.2" AXIS_PTS_REF ldp_maf_kgh_mes_bas /end AXIS_DESCR
 /begin AXIS_DESCR COM_AXIS tia _CNV_A_R_LINEAR_____17_CM 6 -48. 142.5 FORMAT "%6.2" AXIS_PTS_REF ldp_tia_ip_fac_maf_kgh_cor /end AXIS_DESCR
/end CHARACTERISTIC
/begin AXIS_PTS ldp_maf_kgh_mes_bas "" 0xa08088b0 NO_INPUT_QUANTITY _REC_AXS_20_u2 2047.96875 _CNV_A_R_LINEAR_____215_CM 16 0. 2047.96875 FORMAT "%7.2" /end AXIS_PTS
/begin AXIS_PTS ldp_tia_ip_fac_maf_kgh_cor "" 0xa0808e8e tia _REC_AXS_20_u1 190.5 _CNV_A_R_LINEAR_____17_CM 6 -48. 142.5 FORMAT "%6.2" /end AXIS_PTS
/begin MEASUREMENT maf_kgh_mes_tcha[0] "corrected mass air flow up turbo charger, measured per segment" UWORD _CNV_A_R_LINEAR_____215_CM 1 100. 0. 2047.96875 DISPLAY_IDENTIFIER MAF_KGH_MES_TCHA[1] ECU_ADDRESS 0xd000a438 FORMAT "%7.2" /end MEASUREMENT
/begin MEASUREMENT maf_kgh_mes_tcha[1] "corrected mass air flow up turbo charger, measured per segment" UWORD _CNV_A_R_LINEAR_____215_CM 1 100. 0. 2047.96875 DISPLAY_IDENTIFIER MAF_KGH_MES_TCHA[2] ECU_ADDRESS 0xd000a43a FORMAT "%7.2" /end MEASUREMENT
/begin MEASUREMENT maf_kgh_mes_bas_tcha[0] "Raw air-mass flow up turbo chager measured (without correction, to be used for diagnosis only)" UWORD _CNV_A_R_LINEAR_____215_CM 1 100. 0. 2047.96875 DISPLAY_IDENTIFIER MAF_KGH_MES_BAS_TCHA[1] ECU_ADDRESS 0xd000a43c FORMAT "%7.2" /end MEASUREMENT
/begin MEASUREMENT maf_kgh_mes_bas_tcha[1] "Raw air-mass flow up turbo chager measured (without correction, to be used for diagnosis only)" UWORD _CNV_A_R_LINEAR_____215_CM 1 100. 0. 2047.96875 DISPLAY_IDENTIFIER MAF_KGH_MES_BAS_TCHA[2] ECU_ADDRESS 0xd000a43e FORMAT "%7.2" /end MEASUREMENT
/begin CHARACTERISTIC c_maf_mmv_dif_crlc "MAF moving mean value filtering factor" VALUE 0xa080be46 _REC_VAL_20_u1 9.9609375e-002 _CNV_A_R_LINEAR_____28_CM 0. 0.99609375 DISPLAY_IDENTIFIER C_MAF_MMV_DIF_CRLC FORMAT "%5.3" /end CHARACTERISTIC
/begin MEASUREMENT maf_kgh "Mass air flow per segment" UWORD _CNV_A_R_LINEAR_____215_CM 1 100. 0. 2047.96875 DISPLAY_IDENTIFIER MAF_KGH ECU_ADDRESS 0xd000a440 FORMAT "%7.2" /end MEASUREMENT
/begin MEASUREMENT maf_dif "Mass air flow difference per segment" SWORD _CNV_A_R_LINEAR_____202_CM 1 100. -694.5 694.478806 DISPLAY_IDENTIFIER MAF_DIF ECU_ADDRESS 0xd000a442 FORMAT "%7.2" /end MEASUREMENT
/begin CHARACTERISTIC c_maf_mmv_hys "Threshold for detecting raising MAF_MMV" VALUE 0xa080be48 _REC_VAL_20_u2 694.5 _CNV_A_R_LINEAR_____225_CM 0. 694.5 DISPLAY_IDENTIFIER C_MAF_MMV_HYS FORMAT "%6.2" /end CHARACTERISTIC
/begin MEASUREMENT maf_mmv "MAF moving mean value" UWORD _CNV_A_R_LINEAR_____111_CM 1 100. 0. 1389. DISPLAY_IDENTIFIER MAF_MMV ECU_ADDRESS 0xd000a444 FORMAT "%6.2" /end MEASUREMENT
/begin CHARACTERISTIC ip_teg_egr__maf_cyl "Temperature on the exhaust side of the EGR-Valve" CURVE 0xa080b508 _REC_CUR_20_u2_u2 2047. _CNV_A_R_LINEAR_____130_CM 0. 2047. DISPLAY_IDENTIFIER IP_TEG_EGR__MAF_CYL FORMAT "%7.2"
 /begin AXIS_DESCR COM_AXIS maf_cyl _CNV_A_R_LINEAR_____215_CM 8 0. 2047.96875 FORMAT "%6.2" AXIS_PTS_REF ldpm_maf_cyl_ex /end AXIS_DESCR
/end CHARACTERISTIC
/begin CHARACTERISTIC lc_teg_swi "Manual switch from TEG_EGR=TEG_CAT_DOWN_MDL_1 (=0)  to IP_TEG_EGR (MAF_CYL) ( =1)" VALUE 0xa080c5ff _REC_VAL_20_u1 1. _CNV_A_R_LINEAR_____0_CM 0. 1. DISPLAY_IDENTIFIER LC_TEG_SWI FORMAT "%2.0" /end CHARACTERISTIC
/begin CHARACTERISTIC lc_teg_cat_down_mdl_swi "Manual switch from TEG_EGR=TEG_CAT_DOWN_MDL_x bank 1 or 2" VALUE 0xa080c5fe _REC_VAL_20_u1 1. _CNV_A_R_LINEAR_____0_CM 0. 1. DISPLAY_IDENTIFIER LC_TEG_CAT_DOWN_MDL_SWI FORMAT "%2.0" /end CHARACTERISTIC
/begin MEASUREMENT prs_ex "Pressure in the exhaust system" UWORD _CNV_A_R_LINEAR_____27_CM 1 100. 0. 5434. DISPLAY_IDENTIFIER PRS_EX ECU_ADDRESS 0xd000a450 FORMAT "%7.2" /end MEASUREMENT
/begin MEASUREMENT prs_ex_inc "increase of exhaust pressure in comparison to ambient pressure" UWORD _CNV_A_R_LINEAR_____27_CM 1 100. 0. 5434. DISPLAY_IDENTIFIER PRS_EX_INC ECU_ADDRESS 0xd000a452 FORMAT "%7.2" /end MEASUREMENT
/begin CHARACTERISTIC ip_prs_ex_inc "pressure increase in the exhaust pipe" CURVE 0xa080b388 _REC_CUR_20_u2_u2 5434. _CNV_A_R_LINEAR_____27_CM 0. 5434. DISPLAY_IDENTIFIER IP_PRS_EX_INC FORMAT "%7.2"
 /begin AXIS_DESCR COM_AXIS maf_cyl _CNV_A_R_LINEAR_____215_CM 8 0. 2047.96875 FORMAT "%6.2" AXIS_PTS_REF ldpm_maf_cyl_ex /end AXIS_DESCR
/end CHARACTERISTIC
/begin AXIS_PTS ldpm_maf_cyl_ex "" 0xa08094a0 maf_cyl _REC_AXS_20_u2 2047.96875 _CNV_A_R_LINEAR_____215_CM 8 0. 2047.96875 FORMAT "%6.2" /end AXIS_PTS
/begin MEASUREMENT maf_flow_ex "air mass flow out of the exhaust manifold" UWORD _CNV_A_R_LINEAR_____215_CM 1 100. 0. 2047.96875 DISPLAY_IDENTIFIER MAF_FLOW_EX ECU_ADDRESS 0xd000a454 FORMAT "%7.2" /end MEASUREMENT
/begin AXIS_PTS ldpm_maf_flow_egr "" 0xa08094c4 maf_flow_ex _REC_AXS_20_u2 2047.96875 _CNV_A_R_LINEAR_____215_CM 8 0. 2047.96875 FORMAT "%6.2" /end AXIS_PTS
/begin CHARACTERISTIC ip_prs_ex_egr_inc "pressure increase in the exhaust pipe (for MAF_EGR-Calculation)" CURVE 0xa080b378 _REC_CUR_20_u2_u2 5434. _CNV_A_R_LINEAR_____27_CM 0. 5434. DISPLAY_IDENTIFIER IP_PRS_EX_EGR_INC FORMAT "%7.2"
 /begin AXIS_DESCR COM_AXIS maf_flow_ex _CNV_A_R_LINEAR_____215_CM 8 0. 2047.96875 FORMAT "%6.2" AXIS_PTS_REF ldpm_maf_flow_egr /end AXIS_DESCR
/end CHARACTERISTIC
/begin MEASUREMENT prs_ex_egr "Pressure in the exhaust system (for MAF_EGR Calculation)" UWORD _CNV_A_R_LINEAR_____27_CM 1 100. 0. 5434. DISPLAY_IDENTIFIER PRS_EX_EGR ECU_ADDRESS 0xd000a456 FORMAT "%7.2" /end MEASUREMENT
/begin MEASUREMENT prs_ex_egr_inc "Increase of Pressure in the exhaust system (for MAF_EGR Calculation)" UWORD _CNV_A_R_LINEAR_____27_CM 1 100. 0. 5434. DISPLAY_IDENTIFIER PRS_EX_EGR_INC ECU_ADDRESS 0xd000a458 FORMAT "%7.2" /end MEASUREMENT
/begin CHARACTERISTIC c_tcyl_stnd "standard temperature in cylinder" VALUE 0xa080c2ed _REC_VAL_20_u1 28.575 _CNV_A_R_LINEAR_____17_CM -48. 142.5 DISPLAY_IDENTIFIER C_TCYL_STND FORMAT "%5.1" /end CHARACTERISTIC
/begin CHARACTERISTIC c_tco_stnd "standard coolant temperature" VALUE 0xa080c2e5 _REC_VAL_20_u1 28.575 _CNV_A_R_LINEAR_____17_CM -48. 142.5 DISPLAY_IDENTIFIER C_TCO_STND FORMAT "%5.1" /end CHARACTERISTIC
/begin CHARACTERISTIC c_tia_im_stnd "standard intake air temperature" VALUE 0xa080c329 _REC_VAL_20_u1 28.575 _CNV_A_R_LINEAR_____17_CM -48. 142.5 DISPLAY_IDENTIFIER C_TIA_IM_STND FORMAT "%5.1" /end CHARACTERISTIC
/begin MEASUREMENT eff_vol_temp_cor "volumetric efficiency correction factor due to temperature effects" UWORD _CNV_A_R_LINEAR_____9_CM 1 100. 0. 1.99996948242188 DISPLAY_IDENTIFIER EFF_VOL_TEMP_COR ECU_ADDRESS 0xd0001348 FORMAT "%7.5" /end MEASUREMENT
/begin MEASUREMENT eff_vol_temp_cor_mmv "filtered volumetric efficiency correction factor due to temperature effects" UWORD _CNV_A_R_LINEAR_____9_CM 1 100. 0. 1.99996948242188 DISPLAY_IDENTIFIER EFF_VOL_TEMP_COR_MMV ECU_ADDRESS 0xd000a45c FORMAT "%7.5" /end MEASUREMENT
/begin CHARACTERISTIC ip_crlc_eff_vol_temp_cor "Volumetric efficiency filtering" CURVE 0xa080a03c _REC_CUR_20_u1_u1 0.99609375 _CNV_A_R_LINEAR_____28_CM 0. 0.99609375 DISPLAY_IDENTIFIER IP_CRLC_EFF_VOL_TEMP_COR FORMAT "%5.3"
 /begin AXIS_DESCR COM_AXIS n_32 _CNV_A_R_LINEAR_____10_CM 6 0. 8160. FORMAT "%4.0" AXIS_PTS_REF ldp_n_32_ip_crlc_eff_vol_temp /end AXIS_DESCR
/end CHARACTERISTIC
/begin CHARACTERISTIC ip_eff_tco_fac__n_32__maf "Volumetric efficiency weighting factor versus cooling temperature" MAP 0xa080a170 _REC_MAP_20_u1_u1_u2 0.99609375 _CNV_A_R_LINEAR_____28_CM 0. 0.99609375 DISPLAY_IDENTIFIER IP_EFF_TCO_FAC__N_32__MAF FORMAT "%5.3"
 /begin AXIS_DESCR COM_AXIS n_32 _CNV_A_R_LINEAR_____10_CM 8 0. 8160. FORMAT "%4.0" AXIS_PTS_REF ldpm_n_32__eff_vol_cor /end AXIS_DESCR
 /begin AXIS_DESCR COM_AXIS maf _CNV_A_R_LINEAR_____111_CM 8 0. 1389. FORMAT "%7.2" AXIS_PTS_REF ldpm_maf__eff_vol_cor /end AXIS_DESCR
/end CHARACTERISTIC
/begin CHARACTERISTIC ip_eff_tia_im_fac__n_32__maf "Volumetric effiency weighting factor versus intake manifold gas temperature" MAP 0xa080a1b0 _REC_MAP_20_u1_u1_u2 0.99609375 _CNV_A_R_LINEAR_____28_CM 0. 0.99609375 DISPLAY_IDENTIFIER IP_EFF_TIA_IM_FAC__N_32__MAF FORMAT "%5.3"
 /begin AXIS_DESCR COM_AXIS n_32 _CNV_A_R_LINEAR_____10_CM 8 0. 8160. FORMAT "%4.0" AXIS_PTS_REF ldpm_n_32__eff_vol_cor /end AXIS_DESCR
 /begin AXIS_DESCR COM_AXIS maf _CNV_A_R_LINEAR_____111_CM 8 0. 1389. FORMAT "%7.2" AXIS_PTS_REF ldpm_maf__eff_vol_cor /end AXIS_DESCR
/end CHARACTERISTIC
/begin AXIS_PTS ldp_n_32_ip_crlc_eff_vol_temp "" 0xa08089d8 n_32 _REC_AXS_20_u1 8160. _CNV_A_R_LINEAR_____10_CM 6 0. 8160. FORMAT "%4.0" /end AXIS_PTS
/begin AXIS_PTS ldpm_n_32__eff_vol_cor "" 0xa08095d4 n_32 _REC_AXS_20_u1 8160. _CNV_A_R_LINEAR_____10_CM 8 0. 8160. FORMAT "%4.0" /end AXIS_PTS
/begin AXIS_PTS ldpm_maf__eff_vol_cor "" 0xa080948c maf _REC_AXS_20_u2 1389. _CNV_A_R_LINEAR_____111_CM 8 0. 1389. FORMAT "%7.2" /end AXIS_PTS
/begin CHARACTERISTIC c_n_dif_crlc "Correlation factor for N_DIF_MMV calculation" VALUE 0xa080bf1c _REC_VAL_20_u1 0.99609375 _CNV_A_R_LINEAR_____28_CM 0. 0.99609375 DISPLAY_IDENTIFIER C_N_DIF_CRLC FORMAT "%5.3" /end CHARACTERISTIC
/begin CHARACTERISTIC c_n_dif_min_mmv "Minimum filtering constant" VALUE 0xa080bf28 _REC_VAL_20_s2 408. _CNV_A_R_LINEAR_____14_CM -4080. 0. DISPLAY_IDENTIFIER C_N_DIF_MIN_MMV FORMAT "%6.0" /end CHARACTERISTIC
/begin MEASUREMENT n_dif_cor "Idle speed control value" SWORD _CNV_A_R_LINEAR_____14_CM 1 100. -4096. 4064. DISPLAY_IDENTIFIER N_DIF_COR ECU_ADDRESS 0xd000a612 FORMAT "%4.0" /end MEASUREMENT
/begin MEASUREMENT n_dif_mmv "N_DIF moving mean value" SWORD _CNV_A_R_LINEAR_____14_CM 1 100. -8160. 8160. DISPLAY_IDENTIFIER N_DIF_MMV ECU_ADDRESS 0xd000a616 FORMAT "%4.0" /end MEASUREMENT
/begin MEASUREMENT n_max_tol_st "Top level end of start engine speed" UBYTE _CNV_A_R_LINEAR_____10_CM 1 100. 0. 8160. DISPLAY_IDENTIFIER N_MAX_TOL_ST ECU_ADDRESS 0xd00089c8 FORMAT "%4.0" /end MEASUREMENT
/begin CHARACTERISTIC c_n_dif_fac "Weighting factor for the idle speed variable controller" VALUE 0xa080bf24 _REC_VAL_20_u1 0.99609375 _CNV_A_R_LINEAR_____28_CM 0. 0.99609375 DISPLAY_IDENTIFIER C_N_DIF_FAC FORMAT "%5.3" /end CHARACTERISTIC
/begin CHARACTERISTIC ip_dri_acin_n_sp_is "Nominal idle speed with DRIVE (A/T) engaged and air conditioner switched on" CURVE 0xa080a140 _REC_CUR_20_u2_u1 8160. _CNV_A_R_LINEAR_____14_CM 0. 8160. DISPLAY_IDENTIFIER IP_DRI_ACIN_N_SP_IS FORMAT "%4.0"
 /begin AXIS_DESCR COM_AXIS tco _CNV_A_R_LINEAR_____17_CM 8 -48. 142.5 FORMAT "%5.1" AXIS_PTS_REF ldpm_tco_n_sp_1 /end AXIS_DESCR
/end CHARACTERISTIC
/begin MEASUREMENT n_dif_st "Engine speed deviation N_MAX_TOL_ST - N" SWORD _CNV_A_R_LINEAR_____14_CM 1 100. -32768. 32767. DISPLAY_IDENTIFIER N_DIF_ST ECU_ADDRESS 0xd000a614 FORMAT "%6.0" /end MEASUREMENT
/begin MEASUREMENT n_sp_is_ratio "Ratio actual engine speed versus engine speed setpoint at idle" UWORD _CNV_A_R_LINEAR_____115_CM 1 100. 0. 7.9998779296875 DISPLAY_IDENTIFIER N_SP_IS_RATIO ECU_ADDRESS 0xd000a618 FORMAT "%6.4" /end MEASUREMENT
/begin CHARACTERISTIC ip_n_sp_is_lih "Idle speed setpoint in case of limp home" CURVE 0xa080b164 _REC_CUR_20_u2_u1 8160. _CNV_A_R_LINEAR_____14_CM 0. 8160. DISPLAY_IDENTIFIER IP_N_SP_IS_LIH FORMAT "%4.0"
 /begin AXIS_DESCR COM_AXIS tco _CNV_A_R_LINEAR_____17_CM 8 -48. 142.5 FORMAT "%5.1" AXIS_PTS_REF ldpm_tco_n_sp_1 /end AXIS_DESCR
/end CHARACTERISTIC
/begin CHARACTERISTIC ip_dri_n_sp_is_lih "Idle speed setpoint in case of limp home and engaged drivetrain" CURVE 0xa080a160 _REC_CUR_20_u2_u1 8160. _CNV_A_R_LINEAR_____14_CM 0. 8160. DISPLAY_IDENTIFIER IP_DRI_N_SP_IS_LIH FORMAT "%4.0"
 /begin AXIS_DESCR COM_AXIS tco _CNV_A_R_LINEAR_____17_CM 8 -48. 142.5 FORMAT "%5.1" AXIS_PTS_REF ldpm_tco_n_sp_1 /end AXIS_DESCR
/end CHARACTERISTIC
/begin CHARACTERISTIC ip_n_sp_is "Nominal idle speed without additional load on the engine" CURVE 0xa080b134 _REC_CUR_20_u2_u1 8160. _CNV_A_R_LINEAR_____14_CM 0. 8160. DISPLAY_IDENTIFIER IP_N_SP_IS FORMAT "%4.0"
 /begin AXIS_DESCR COM_AXIS tco _CNV_A_R_LINEAR_____17_CM 8 -48. 142.5 FORMAT "%5.1" AXIS_PTS_REF ldpm_tco_n_sp_1 /end AXIS_DESCR
/end CHARACTERISTIC
/begin MEASUREMENT n_dif "Engine speed deviation N_SP_IS_N" SWORD _CNV_A_R_LINEAR_____14_CM 1 100. -4096. 4064. DISPLAY_IDENTIFIER N_DIF ECU_ADDRESS 0xd000a610 FORMAT "%4.0" /end MEASUREMENT
/begin MEASUREMENT n_sp_is_pow "Active nominal idle speed setpoint by power management active" UWORD _CNV_A_R_LINEAR_____14_CM 1 100. 0. 8160. DISPLAY_IDENTIFIER N_SP_IS_POW ECU_ADDRESS 0xd0001468 FORMAT "%4.0" /end MEASUREMENT
/begin MEASUREMENT n_sp_is_2 "basis idle speed setpoint" UWORD _CNV_A_R_LINEAR_____14_CM 1 100. 0. 8160. DISPLAY_IDENTIFIER N_SP_IS_2 ECU_ADDRESS 0xd000a60a FORMAT "%4.0" /end MEASUREMENT
/begin MEASUREMENT n_sp_is_3 "greatest of all idle speed setpoints" UWORD _CNV_A_R_LINEAR_____14_CM 1 100. 0. 8160. DISPLAY_IDENTIFIER N_SP_IS_3 ECU_ADDRESS 0xd000a60c FORMAT "%4.0" /end MEASUREMENT
/begin MEASUREMENT lv_req_heat_n_sp_is "LV Idle Speed setpoint required from heating control unit" UBYTE _CNV_S_2_RANGE__0___1_CM 1 100. 0. 1. DISPLAY_IDENTIFIER LV_REQ_HEAT_N_SP_IS ECU_ADDRESS 0xd0001490 BIT_MASK 0x1 /end MEASUREMENT
/begin CHARACTERISTIC ip_acin_n_sp_is "Nominal idle speed with air conditioner switched on" CURVE 0xa0809f6c _REC_CUR_20_u2_u1 8160. _CNV_A_R_LINEAR_____14_CM 0. 8160. DISPLAY_IDENTIFIER IP_ACIN_N_SP_IS FORMAT "%4.0"
 /begin AXIS_DESCR COM_AXIS tco _CNV_A_R_LINEAR_____17_CM 8 -48. 142.5 FORMAT "%5.1" AXIS_PTS_REF ldpm_tco_n_sp_1 /end AXIS_DESCR
/end CHARACTERISTIC
/begin CHARACTERISTIC ip_fac_n_sp_ofs_kwp "TCO factor for N_SP_OFS_KWP" CURVE 0xa080a3bc _REC_CUR_20_u1_u1 0.99610001 _CNV_A_R_LINEAR_____18_CM 0. 0.99610001 DISPLAY_IDENTIFIER IP_FAC_N_SP_OFS_KWP FORMAT "%5.3"
 /begin AXIS_DESCR COM_AXIS tco _CNV_A_R_LINEAR_____17_CM 8 -48. 142.5 FORMAT "%5.1" AXIS_PTS_REF ldpm_tco_n_sp_1 /end AXIS_DESCR
/end CHARACTERISTIC
/begin CHARACTERISTIC ip_t_ast_min_n_sp_is_cs "Minimum delay time after start for drive-off-support idle speed" CURVE 0xa080b3f0 _REC_CUR_20_u2_u1 6553.5 _CNV_A_R_LINEAR_____4_CM 0. 6553.5 DISPLAY_IDENTIFIER IP_T_AST_MIN_N_SP_IS_CS FORMAT "%6.1"
 /begin AXIS_DESCR COM_AXIS tco _CNV_A_R_LINEAR_____17_CM 8 -48. 142.5 FORMAT "%5.1" AXIS_PTS_REF ldpm_tco_n_sp_1 /end AXIS_DESCR
/end CHARACTERISTIC
/begin CHARACTERISTIC c_n_sp_ofs_kwp_max "Upper threshold for tester offset" VALUE 0xa080bfd2 _REC_VAL_20_u2 32767. _CNV_A_R_LINEAR_____14_CM 0. 32767. DISPLAY_IDENTIFIER C_N_SP_OFS_KWP_MAX FORMAT "%5.0" /end CHARACTERISTIC
/begin CHARACTERISTIC c_tam_hys "Ambient temperature threshold idle speed at heater request" VALUE 0xa080c2b0 _REC_VAL_20_u1 48. _CNV_A_R_LINEAR_____25_CM 0. 48. DISPLAY_IDENTIFIER C_TAM_HYS FORMAT "%4.1" /end CHARACTERISTIC
/begin CHARACTERISTIC c_n_sp_heat_mt "Idle speed at heater request, manual transmission vehicle" VALUE 0xa080bfba _REC_VAL_20_u2 8160. _CNV_A_R_LINEAR_____14_CM 0. 8160. DISPLAY_IDENTIFIER C_N_SP_HEAT_MT FORMAT "%4.0" /end CHARACTERISTIC
/begin CHARACTERISTIC c_n_sp_heat_at "Idle speed at heater request, automatic transmission vehicle" VALUE 0xa080bfb8 _REC_VAL_20_u2 8160. _CNV_A_R_LINEAR_____14_CM 0. 8160. DISPLAY_IDENTIFIER C_N_SP_HEAT_AT FORMAT "%4.0" /end CHARACTERISTIC
/begin CHARACTERISTIC c_n_sp_dec_cs "Decrement engine speed setpoint for drive-off-support" VALUE 0xa080bfb4 _REC_VAL_20_u1 15.875 _CNV_A_R_LINEAR_____230_CM 6.25e-002 15.9375 DISPLAY_IDENTIFIER C_N_SP_DEC_CS FORMAT "%7.4" /end CHARACTERISTIC
/begin CHARACTERISTIC c_n_sp_is_sa_eol "Idle speed setpoint during the \"secondary air function end of line test'" VALUE 0xa080bfcc _REC_VAL_20_u2 8160. _CNV_A_R_LINEAR_____14_CM 0. 8160. DISPLAY_IDENTIFIER C_N_SP_IS_SA_EOL FORMAT "%4.0" /end CHARACTERISTIC
/begin CHARACTERISTIC c_n_sp_lgrd_is "Nominal idle speed change limitation" VALUE 0xa080bfd0 _REC_VAL_20_u1 3.175 _CNV_A_R_LINEAR_____230_CM 6.25e-002 15.9375 DISPLAY_IDENTIFIER C_N_SP_LGRD_IS FORMAT "%7.4" /end CHARACTERISTIC
/begin MEASUREMENT n_sp_is "resulting idle speed setpoint" UWORD _CNV_A_R_LINEAR_____14_CM 1 100. 0. 8160. DISPLAY_IDENTIFIER N_SP_IS ECU_ADDRESS 0xd000a608 FORMAT "%4.0" /end MEASUREMENT
/begin CHARACTERISTIC c_dri_vs_min_vb "Minimum vehicle speed for activating battery charging in case LV_DRI = 1" VALUE 0xa080bc50 _REC_VAL_20_u1 255. _CNV_A_R_LINEAR_____6_CM 0. 255. DISPLAY_IDENTIFIER C_DRI_VS_MIN_VB FORMAT "%3.0" /end CHARACTERISTIC
/begin CHARACTERISTIC c_vs_max_n_sp_cs "Maximum vehicle speed for drive-off-support" VALUE 0xa080c4d1 _REC_VAL_20_u1 255. _CNV_A_R_LINEAR_____6_CM 0. 255. DISPLAY_IDENTIFIER C_VS_MAX_N_SP_CS FORMAT "%3.0" /end CHARACTERISTIC
/begin CHARACTERISTIC c_vs_hys_n_sp_cs "vehicle speed hysteresis for VS threshold drive off support" VALUE 0xa080c4c2 _REC_VAL_20_u1 255. _CNV_A_R_LINEAR_____6_CM 0. 255. DISPLAY_IDENTIFIER C_VS_HYS_N_SP_CS FORMAT "%3.0" /end CHARACTERISTIC
/begin CHARACTERISTIC lc_is_n_sp_cs_dis "LC to switch on/off LV_IS  condition for drive off support" VALUE 0xa080c59b _REC_VAL_20_u1 1. _CNV_A_R_LINEAR_____0_CM 0. 1. DISPLAY_IDENTIFIER LC_IS_N_SP_CS_DIS FORMAT "%2.0" /end CHARACTERISTIC
/begin CHARACTERISTIC c_n_sp_is_pste_2_at "Idle speed setpoint PSTE_2, automatic transmission vehicle" VALUE 0xa080bfc4 _REC_VAL_20_u2 8160. _CNV_A_R_LINEAR_____14_CM 0. 8160. DISPLAY_IDENTIFIER C_N_SP_IS_PSTE_2_AT FORMAT "%4.0" /end CHARACTERISTIC
/begin CHARACTERISTIC c_n_sp_is_pste_2_mt "Idle speed setpoint PSTE_2, manual  transmission vehicle" VALUE 0xa080bfc6 _REC_VAL_20_u2 8160. _CNV_A_R_LINEAR_____14_CM 0. 8160. DISPLAY_IDENTIFIER C_N_SP_IS_PSTE_2_MT FORMAT "%4.0" /end CHARACTERISTIC
/begin CHARACTERISTIC c_n_sp_is_ars_mt "Idle speed setpoint ARS, manual  transmission vehicle" VALUE 0xa080bfc2 _REC_VAL_20_u2 8160. _CNV_A_R_LINEAR_____14_CM 0. 8160. DISPLAY_IDENTIFIER C_N_SP_IS_ARS_MT FORMAT "%4.0" /end CHARACTERISTIC
/begin CHARACTERISTIC c_n_sp_is_ars_at "Idle speed setpoint ARS, automatic  transmission vehicle" VALUE 0xa080bfc0 _REC_VAL_20_u2 8160. _CNV_A_R_LINEAR_____14_CM 0. 8160. DISPLAY_IDENTIFIER C_N_SP_IS_ARS_AT FORMAT "%4.0" /end CHARACTERISTIC
/begin CHARACTERISTIC c_vs_max_n_sp_is_ars "Maximum vehicle speed for  N_SP_IS_ARS" VALUE 0xa080c4d2 _REC_VAL_20_u1 255. _CNV_A_R_LINEAR_____6_CM 0. 255. DISPLAY_IDENTIFIER C_VS_MAX_N_SP_IS_ARS FORMAT "%3.0" /end CHARACTERISTIC
/begin CHARACTERISTIC c_vs_min_n_sp_is_ars "Minimum vehicle speed for  N_SP_IS_ARS" VALUE 0xa080c4de _REC_VAL_20_u1 255. _CNV_A_R_LINEAR_____6_CM 0. 255. DISPLAY_IDENTIFIER C_VS_MIN_N_SP_IS_ARS FORMAT "%3.0" /end CHARACTERISTIC
/begin MEASUREMENT lv_n_sp_is_cs "1: conditions for increased idle speed / torque reserve for drive-off-support fulfilled" UBYTE _CNV_S_2_RANGE__0___1_CM 1 100. 0. 1. DISPLAY_IDENTIFIER LV_N_SP_IS_CS ECU_ADDRESS 0xd00089c9 BIT_MASK 0x1 /end MEASUREMENT
/begin MEASUREMENT lv_n_sp_is_pste "1: conditions for increased idle speed / torque reserve for power steering" UBYTE _CNV_S_2_RANGE__0___1_CM 1 100. 0. 1. DISPLAY_IDENTIFIER LV_N_SP_IS_PSTE ECU_ADDRESS 0xd00089ca BIT_MASK 0x1 /end MEASUREMENT
/begin MEASUREMENT lv_n_sp_is_pste_2 "1: conditions for increased idle speed / torque reserve for power steering for second VS threshold" UBYTE _CNV_S_2_RANGE__0___1_CM 1 100. 0. 1. DISPLAY_IDENTIFIER LV_N_SP_IS_PSTE_2 ECU_ADDRESS 0xd00089cb BIT_MASK 0x1 /end MEASUREMENT
/begin AXIS_PTS ldpm_tco_n_sp_1 "" 0xa08097f4 tco _REC_AXS_20_u1 190.5 _CNV_A_R_LINEAR_____17_CM 8 -48. 142.5 FORMAT "%5.1" /end AXIS_PTS
/begin CHARACTERISTIC ip_dri_n_sp_is "Nominal idle speed with DRIVE  (A/T) engaged" CURVE 0xa080a150 _REC_CUR_20_u2_u1 8160. _CNV_A_R_LINEAR_____14_CM 0. 8160. DISPLAY_IDENTIFIER IP_DRI_N_SP_IS FORMAT "%4.0"
 /begin AXIS_DESCR COM_AXIS tco _CNV_A_R_LINEAR_____17_CM 8 -48. 142.5 FORMAT "%5.1" AXIS_PTS_REF ldpm_tco_n_sp_1 /end AXIS_DESCR
/end CHARACTERISTIC
/begin CHARACTERISTIC ip_n_sp_is_toil_at "Minimum idle speed for TOIL with AT" CURVE 0xa080b18c _REC_CUR_20_u2_u1 8160. _CNV_A_R_LINEAR_____14_CM 0. 8160. DISPLAY_IDENTIFIER IP_N_SP_IS_TOIL_AT FORMAT "%4.0"
 /begin AXIS_DESCR COM_AXIS toil _CNV_A_R_LINEAR_____26_CM 4 -40. 160. FORMAT "%3.0" AXIS_PTS_REF ldpm_toil_n_sp_is_toil /end AXIS_DESCR
/end CHARACTERISTIC
/begin AXIS_PTS ldpm_tco_n_sp_is_pste "" 0xa08097fe tco _REC_AXS_20_u1 190.5 _CNV_A_R_LINEAR_____17_CM 6 -48. 142.5 FORMAT "%6.2" /end AXIS_PTS
/begin AXIS_PTS ldpm_toil_n_sp_is_toil "" 0xa080987a toil _REC_AXS_20_u1 200. _CNV_A_R_LINEAR_____26_CM 4 -40. 160. FORMAT "%3.0" /end AXIS_PTS
/begin CHARACTERISTIC ip_n_sp_is_pste_2 "Idle speed setpoint for power steering for VS >= C_VS_MIN_N_SP_PSTE_2" CURVE 0xa080b180 _REC_CUR_20_u2_u1 8160. _CNV_A_R_LINEAR_____14_CM 0. 8160. DISPLAY_IDENTIFIER IP_N_SP_IS_PSTE_2 FORMAT "%4.0"
 /begin AXIS_DESCR COM_AXIS tco _CNV_A_R_LINEAR_____17_CM 6 -48. 142.5 FORMAT "%6.2" AXIS_PTS_REF ldpm_tco_n_sp_is_pste /end AXIS_DESCR
/end CHARACTERISTIC
/begin CHARACTERISTIC ip_n_sp_is_pste "Idle speed setpoint for power steering" CURVE 0xa080b174 _REC_CUR_20_u2_u1 8160. _CNV_A_R_LINEAR_____14_CM 0. 8160. DISPLAY_IDENTIFIER IP_N_SP_IS_PSTE FORMAT "%4.0"
 /begin AXIS_DESCR COM_AXIS tco _CNV_A_R_LINEAR_____17_CM 6 -48. 142.5 FORMAT "%6.2" AXIS_PTS_REF ldpm_tco_n_sp_is_pste /end AXIS_DESCR
/end CHARACTERISTIC
/begin CHARACTERISTIC c_n_sp_ofs_kwp_min "Lower threshold for tester offset" VALUE 0xa080bfd4 _REC_VAL_20_u2 32767. _CNV_A_R_LINEAR_____231_CM -32768. -1. DISPLAY_IDENTIFIER C_N_SP_OFS_KWP_MIN FORMAT "%6.0" /end CHARACTERISTIC
/begin CHARACTERISTIC c_n_sp_inc_cs "Increment engine speed setpoint for drive-off-support" VALUE 0xa080bfbc _REC_VAL_20_u1 15.875 _CNV_A_R_LINEAR_____230_CM 6.25e-002 15.9375 DISPLAY_IDENTIFIER C_N_SP_INC_CS FORMAT "%7.4" /end CHARACTERISTIC
/begin CHARACTERISTIC c_n_sp_inc_pste "Increment engine speed setpoint for power steering" VALUE 0xa080bfbe _REC_VAL_20_u1 15.875 _CNV_A_R_LINEAR_____230_CM 6.25e-002 15.9375 DISPLAY_IDENTIFIER C_N_SP_INC_PSTE FORMAT "%7.4" /end CHARACTERISTIC
/begin CHARACTERISTIC c_n_sp_dec_pste "Decrement engine speed setpoint for power steering" VALUE 0xa080bfb7 _REC_VAL_20_u1 15.875 _CNV_A_R_LINEAR_____230_CM 6.25e-002 15.9375 DISPLAY_IDENTIFIER C_N_SP_DEC_PSTE FORMAT "%7.4" /end CHARACTERISTIC
/begin CHARACTERISTIC c_dly_n_sp_dec_pste "Delay time for decrement engine speed setpoint for power steering" VALUE 0xa080bc4e _REC_VAL_20_u2 654.35 _CNV_A_R_LINEAR_____3_CM 1. 655.35 DISPLAY_IDENTIFIER C_DLY_N_SP_DEC_PSTE FORMAT "%6.2" /end CHARACTERISTIC
/begin CHARACTERISTIC c_vs_min_n_sp_pste "Minimum vehicle speed threshould for N_SP_PSTE" VALUE 0xa080c4df _REC_VAL_20_u1 255. _CNV_A_R_LINEAR_____6_CM 0. 255. DISPLAY_IDENTIFIER C_VS_MIN_N_SP_PSTE FORMAT "%3.0" /end CHARACTERISTIC
/begin CHARACTERISTIC c_vs_min_n_sp_pste_2 "Minimum vehicle speed threshould for N_SP_PSTE_2" VALUE 0xa080c4e0 _REC_VAL_20_u1 255. _CNV_A_R_LINEAR_____6_CM 0. 255. DISPLAY_IDENTIFIER C_VS_MIN_N_SP_PSTE_2 FORMAT "%3.0" /end CHARACTERISTIC
/begin CHARACTERISTIC c_ang_pste_isc "Minimum ANG_PSTE for N_SP_PSTE" VALUE 0xa080ba9a _REC_VAL_20_u2 1439.945815 _CNV_A_R_LINEAR_____72_CM 0. 1439.945815 DISPLAY_IDENTIFIER C_ANG_PSTE_ISC FORMAT "%8.2" /end CHARACTERISTIC
/begin CHARACTERISTIC c_vel_ang_pste_isc "Minimum VEL_ANG_PSTE for N_SP_PSTE" VALUE 0xa080c436 _REC_VAL_20_u2 1439.945815 _CNV_A_R_LINEAR_____72_CM 0. 1439.945815 DISPLAY_IDENTIFIER C_VEL_ANG_PSTE_ISC FORMAT "%8.2" /end CHARACTERISTIC
/begin CHARACTERISTIC c_n_sp_inc_pl "Increment idle speed setpoint for part load" VALUE 0xa080bfbd _REC_VAL_20_u1 15.875 _CNV_A_R_LINEAR_____230_CM 6.25e-002 15.9375 DISPLAY_IDENTIFIER C_N_SP_INC_PL FORMAT "%7.4" /end CHARACTERISTIC
/begin CHARACTERISTIC c_n_sp_dec_pl "Decrement idle speed setpoint for part load" VALUE 0xa080bfb6 _REC_VAL_20_u1 15.875 _CNV_A_R_LINEAR_____230_CM 6.25e-002 15.9375 DISPLAY_IDENTIFIER C_N_SP_DEC_PL FORMAT "%7.4" /end CHARACTERISTIC
/begin CHARACTERISTIC ip_n_sp_is_toil_mt "Minimum idle speed for TOIL with MT" CURVE 0xa080b194 _REC_CUR_20_u2_u1 8160. _CNV_A_R_LINEAR_____14_CM 0. 8160. DISPLAY_IDENTIFIER IP_N_SP_IS_TOIL_MT FORMAT "%4.0"
 /begin AXIS_DESCR COM_AXIS toil _CNV_A_R_LINEAR_____26_CM 4 -40. 160. FORMAT "%3.0" AXIS_PTS_REF ldpm_toil_n_sp_is_toil /end AXIS_DESCR
/end CHARACTERISTIC
/begin CHARACTERISTIC c_toil_thd_n_sp_is "TOIL threshold for idle speed setpoint" VALUE 0xa080c350 _REC_VAL_20_u1 200. _CNV_A_R_LINEAR_____26_CM -40. 160. DISPLAY_IDENTIFIER C_TOIL_THD_N_SP_IS FORMAT "%3.0" /end CHARACTERISTIC
/begin CHARACTERISTIC c_toil_hys_n_sp_is "TOIL hysteresis for idle speed setpoint" VALUE 0xa080c34a _REC_VAL_20_u1 200. _CNV_A_R_LINEAR_____26_CM -40. 160. DISPLAY_IDENTIFIER C_TOIL_HYS_N_SP_IS FORMAT "%3.0" /end CHARACTERISTIC
/begin AXIS_PTS ldpm_iga_n_sp_is_knk "" 0xa0809462 iga_mv_adj_knk_cus _REC_AXS_20_u1 48. _CNV_A_R_LINEAR_____198_CM 4 -48. 0. FORMAT "%7.3" /end AXIS_PTS
/begin CHARACTERISTIC c_iga_adj_thd_n_sp_is "Spark retard threshold for activating idle speed setpoint N_SP_IS_KNK" VALUE 0xa080bdaf _REC_VAL_20_u1 9.6 _CNV_A_R_LINEAR_____198_CM -48. 0. DISPLAY_IDENTIFIER C_IGA_ADJ_THD_N_SP_IS FORMAT "%7.3" /end CHARACTERISTIC
/begin CHARACTERISTIC c_iga_adj_hys_n_sp_is "Spark retard hystersis for idle speed setpoint N_SP_IS_KNK" VALUE 0xa080bdae _REC_VAL_20_u1 9.6 _CNV_A_R_LINEAR_____198_CM -48. 0. DISPLAY_IDENTIFIER C_IGA_ADJ_HYS_N_SP_IS FORMAT "%7.3" /end CHARACTERISTIC
/begin CHARACTERISTIC ip_n_sp_is_cs_opm_1 "Idle speed setpoint for drive-off-support - manual transmission in operation mode 1" CURVE 0xa080b144 _REC_CUR_20_u2_u1 8160. _CNV_A_R_LINEAR_____14_CM 0. 8160. DISPLAY_IDENTIFIER IP_N_SP_IS_CS_OPM_1 FORMAT "%4.0"
 /begin AXIS_DESCR COM_AXIS toil _CNV_A_R_LINEAR_____26_CM 8 -40. 160. FORMAT "%3.0" AXIS_PTS_REF ldp_toil_ip_n_sp_is_cs_opm_1 /end AXIS_DESCR
/end CHARACTERISTIC
/begin CHARACTERISTIC ip_n_sp_is_cs_opm_2 "Idle speed setpoint for drive-off-support - manual transmission in operation mode 2" CURVE 0xa080b154 _REC_CUR_20_u2_u1 8160. _CNV_A_R_LINEAR_____14_CM 0. 8160. DISPLAY_IDENTIFIER IP_N_SP_IS_CS_OPM_2 FORMAT "%4.0"
 /begin AXIS_DESCR COM_AXIS toil _CNV_A_R_LINEAR_____26_CM 8 -40. 160. FORMAT "%3.0" AXIS_PTS_REF ldp_toil_ip_n_sp_is_cs_opm_1 /end AXIS_DESCR
/end CHARACTERISTIC
/begin AXIS_PTS ldp_toil_ip_n_sp_is_cs_opm_1 "" 0xa0808f0c toil _REC_AXS_20_u1 200. _CNV_A_R_LINEAR_____26_CM 8 -40. 160. FORMAT "%3.0" /end AXIS_PTS
/begin CHARACTERISTIC ip_n_sp_is_pl_opm_1 "Nominal idle speed at part load in operation mode 1" MAP 0xa081572c _REC_MAP_20_u2_u2_u2 8160. _CNV_A_R_LINEAR_____14_CM 0. 8160. DISPLAY_IDENTIFIER IP_N_SP_IS_PL_OPM_1 FORMAT "%4.0"
 /begin AXIS_DESCR COM_AXIS n _CNV_A_R_LINEAR_____14_CM 6 0. 8160. FORMAT "%4.0" AXIS_PTS_REF ldp_n_n_sp_is_pl_opm_1 /end AXIS_DESCR
 /begin AXIS_DESCR COM_AXIS tq_loss _CNV_A_R_LINEAR_____87_CM 6 -1024. 1023.96875 FORMAT "%6.2" AXIS_PTS_REF ldp_tq_loss_n_sp_is_pl_opm_1 /end AXIS_DESCR
/end CHARACTERISTIC
/begin CHARACTERISTIC ip_n_sp_is_pl_opm_2 "Nominal idle speed at part load in operation mode 2" MAP 0xa0815774 _REC_MAP_20_u2_u2_u2 8160. _CNV_A_R_LINEAR_____14_CM 0. 8160. DISPLAY_IDENTIFIER IP_N_SP_IS_PL_OPM_2 FORMAT "%4.0"
 /begin AXIS_DESCR COM_AXIS n _CNV_A_R_LINEAR_____14_CM 6 0. 8160. FORMAT "%4.0" AXIS_PTS_REF ldp_n_n_sp_is_pl_opm_1 /end AXIS_DESCR
 /begin AXIS_DESCR COM_AXIS tq_loss _CNV_A_R_LINEAR_____87_CM 6 -1024. 1023.96875 FORMAT "%6.2" AXIS_PTS_REF ldp_tq_loss_n_sp_is_pl_opm_1 /end AXIS_DESCR
/end CHARACTERISTIC
/begin CHARACTERISTIC ip_n_sp_is_pl_amt_opm_1 "Nominal idle speed at PL variant AMT in operation mode 1" MAP 0xa081569c _REC_MAP_20_u2_u2_u2 8160. _CNV_A_R_LINEAR_____14_CM 0. 8160. DISPLAY_IDENTIFIER IP_N_SP_IS_PL_AMT_OPM_1 FORMAT "%4.0"
 /begin AXIS_DESCR COM_AXIS n _CNV_A_R_LINEAR_____14_CM 6 0. 8160. FORMAT "%4.0" AXIS_PTS_REF ldp_n_n_sp_is_pl_amt_opm_1 /end AXIS_DESCR
 /begin AXIS_DESCR COM_AXIS tq_loss _CNV_A_R_LINEAR_____87_CM 6 -1024. 1023.96875 FORMAT "%6.2" AXIS_PTS_REF ldp_tq_loss_n_sp_is_pl_amt_opm_1 /end AXIS_DESCR
/end CHARACTERISTIC
/begin CHARACTERISTIC ip_n_sp_is_pl_amt_opm_2 "Nominal idle speed at PL variant AMT in operation mode 2" MAP 0xa08156e4 _REC_MAP_20_u2_u2_u2 8160. _CNV_A_R_LINEAR_____14_CM 0. 8160. DISPLAY_IDENTIFIER IP_N_SP_IS_PL_AMT_OPM_2 FORMAT "%4.0"
 /begin AXIS_DESCR COM_AXIS n _CNV_A_R_LINEAR_____14_CM 6 0. 8160. FORMAT "%4.0" AXIS_PTS_REF ldp_n_n_sp_is_pl_amt_opm_1 /end AXIS_DESCR
 /begin AXIS_DESCR COM_AXIS tq_loss _CNV_A_R_LINEAR_____87_CM 6 -1024. 1023.96875 FORMAT "%6.2" AXIS_PTS_REF ldp_tq_loss_n_sp_is_pl_amt_opm_1 /end AXIS_DESCR
/end CHARACTERISTIC
/begin AXIS_PTS ldp_n_n_sp_is_pl_opm_1 "" 0xa0808b8c n _REC_AXS_20_u2 8160. _CNV_A_R_LINEAR_____14_CM 6 0. 8160. FORMAT "%4.0" /end AXIS_PTS
/begin AXIS_PTS ldp_n_n_sp_is_pl_amt_opm_1 "" 0xa0808b7c n _REC_AXS_20_u2 8160. _CNV_A_R_LINEAR_____14_CM 6 0. 8160. FORMAT "%4.0" /end AXIS_PTS
/begin AXIS_PTS ldp_tq_loss_n_sp_is_pl_opm_1 "" 0xa0809000 tq_loss _REC_AXS_20_u2 2047.96875 _CNV_A_R_LINEAR_____87_CM 6 -1024. 1023.96875 FORMAT "%6.2" /end AXIS_PTS
/begin AXIS_PTS ldp_tq_loss_n_sp_is_pl_amt_opm_1 "" 0xa0808ff0 tq_loss _REC_AXS_20_u2 2047.96875 _CNV_A_R_LINEAR_____87_CM 6 -1024. 1023.96875 FORMAT "%6.2" /end AXIS_PTS
/begin MEASUREMENT n_sp_is_cs "idle speed setpoints for DROF" UWORD _CNV_A_R_LINEAR_____14_CM 1 100. 1. 8160. DISPLAY_IDENTIFIER N_SP_IS_CS ECU_ADDRESS 0xd000a60e FORMAT "%4.0" /end MEASUREMENT
/begin MEASUREMENT n_sp_is_pwr_stab "Idle speed setpoint for power supply stability" UWORD _CNV_A_R_LINEAR_____14_CM 1 100. 0. 8160. DISPLAY_IDENTIFIER N_SP_IS_PWR_STAB ECU_ADDRESS 0xd000146a FORMAT "%4.0" /end MEASUREMENT
/begin CHARACTERISTIC c_n_sp_is_pwr_stab "Idle speed setpoint for power supply stability" VALUE 0xa080bfc8 _REC_VAL_20_u2 8160. _CNV_A_R_LINEAR_____14_CM 0. 8160. DISPLAY_IDENTIFIER C_N_SP_IS_PWR_STAB FORMAT "%4.0" /end CHARACTERISTIC
/begin CHARACTERISTIC c_n_sp_is_pwr_stab_dri "Idle speed setpoint for power supply stability and driving position engaged" VALUE 0xa080bfca _REC_VAL_20_u2 8160. _CNV_A_R_LINEAR_____14_CM 0. 8160. DISPLAY_IDENTIFIER C_N_SP_IS_PWR_STAB_DRI FORMAT "%4.0" /end CHARACTERISTIC
/begin CHARACTERISTIC c_n_sp_lgrd_is_lih "Nominal idle speed change limitation with active limp home" VALUE 0xa080bfd1 _REC_VAL_20_u1 12.7 _CNV_A_R_LINEAR_____232_CM 0.25 63.75 DISPLAY_IDENTIFIER C_N_SP_LGRD_IS_LIH FORMAT "%5.2" /end CHARACTERISTIC
/begin CHARACTERISTIC c_n_sp_dec_is_ch_dri "Idle speed change limitation during catalyst heating and LV_DRI = 1" VALUE 0xa080bfb5 _REC_VAL_20_u1 3.175 _CNV_A_R_LINEAR_____230_CM 6.25e-002 15.9375 DISPLAY_IDENTIFIER C_N_SP_DEC_IS_CH_DRI FORMAT "%7.4" /end CHARACTERISTIC
/begin CHARACTERISTIC id_n_sp_is_knk_at "Minimum idle speed for spark retard due to knocking with AT" CURVE 0xa0809d54 _REC_CUR_20_u2_u1 8160. _CNV_A_R_LINEAR_____14_CM 0. 8160. DISPLAY_IDENTIFIER ID_N_SP_IS_KNK_AT FORMAT "%4.0"
 /begin AXIS_DESCR COM_AXIS iga_mv_adj_knk_cus _CNV_A_R_LINEAR_____198_CM 4 -48. 0. FORMAT "%7.3" AXIS_PTS_REF ldpm_iga_n_sp_is_knk /end AXIS_DESCR
/end CHARACTERISTIC
/begin CHARACTERISTIC id_n_sp_is_knk_mt "Minimum idle speed for spark retard due to knocking with MT" CURVE 0xa0809d5c _REC_CUR_20_u2_u1 8160. _CNV_A_R_LINEAR_____14_CM 0. 8160. DISPLAY_IDENTIFIER ID_N_SP_IS_KNK_MT FORMAT "%4.0"
 /begin AXIS_DESCR COM_AXIS iga_mv_adj_knk_cus _CNV_A_R_LINEAR_____198_CM 4 -48. 0. FORMAT "%7.3" AXIS_PTS_REF ldpm_iga_n_sp_is_knk /end AXIS_DESCR
/end CHARACTERISTIC
/begin CHARACTERISTIC c_tam_n_sp_heat "Ambient temperature threshold idle speed at heater request" VALUE 0xa080c2b9 _REC_VAL_20_u1 190.5 _CNV_A_R_LINEAR_____17_CM -48. 142.5 DISPLAY_IDENTIFIER C_TAM_N_SP_HEAT FORMAT "%5.1" /end CHARACTERISTIC
/begin CHARACTERISTIC c_tam_n_sp_is_knk "Ambient temperature for N_SP_IS_KNK calculation" VALUE 0xa080c2ba _REC_VAL_20_u1 190.5 _CNV_A_R_LINEAR_____17_CM -48. 142.5 DISPLAY_IDENTIFIER C_TAM_N_SP_IS_KNK FORMAT "%5.1" /end CHARACTERISTIC
/begin CHARACTERISTIC c_nt_so2p_ext_adj_act "idle speed setpoints for SO2P in service" VALUE 0xa080c03a _REC_VAL_20_u2 8160. _CNV_A_R_LINEAR_____14_CM 0. 8160. DISPLAY_IDENTIFIER C_NT_SO2P_EXT_ADJ_ACT FORMAT "%4.0" /end CHARACTERISTIC
/begin AXIS_PTS ldpm_gear "" 0xa0809418 gear _REC_AXS_20_u1 255. _CNV_A_R_LINEAR_____0_CM 9 0. 255. FORMAT "%3.0" /end AXIS_PTS
/begin MEASUREMENT n_max_thd_1 "Actual engine speed limit depending on TCO-orange area (BN2000)" UWORD _CNV_A_R_LINEAR_____14_CM 1 100. 0. 8160. DISPLAY_IDENTIFIER N_MAX_THD_1 ECU_ADDRESS 0xd000a622 FORMAT "%4.0" /end MEASUREMENT
/begin MEASUREMENT n_max_thd_2 "Actual engine speed limit depending on TCO-red area (BN2000)" UWORD _CNV_A_R_LINEAR_____14_CM 1 100. 0. 8160. DISPLAY_IDENTIFIER N_MAX_THD_2 ECU_ADDRESS 0xd000a624 FORMAT "%4.0" /end MEASUREMENT
/begin MEASUREMENT lv_vs_max "Boolean for vehicle speed limitation active" UBYTE _CNV_S_2_RANGE__0___1_CM 1 100. 0. 1. DISPLAY_IDENTIFIER LV_VS_MAX ECU_ADDRESS 0xd00089d0 BIT_MASK 0x1 /end MEASUREMENT
/begin MEASUREMENT vs_ratio "Ratio between vehicle speed limit and actual vehicle speed" UWORD _CNV_A_R_LINEAR_____241_CM 1 100. 0. 31.99951171875 DISPLAY_IDENTIFIER VS_RATIO ECU_ADDRESS 0xd00014be FORMAT "%7.4" /end MEASUREMENT
/begin CHARACTERISTIC ip_n_max_etc_lih "Engine speed limit for  ETC limp home modus due ETC error" CURVE 0xa080b0a4 _REC_CUR_20_u2_u1 8160. _CNV_A_R_LINEAR_____14_CM 0. 8160. DISPLAY_IDENTIFIER IP_N_MAX_ETC_LIH FORMAT "%4.0"
 /begin AXIS_DESCR COM_AXIS pv_av _CNV_A_R_LINEAR_____5_CM 4 0. 99.609375 FORMAT "%5.2" AXIS_PTS_REF ldp_pv_av_n_max_etc_lih_2 /end AXIS_DESCR
/end CHARACTERISTIC
/begin CHARACTERISTIC c_n_max_etc_lih "Engine speed limitation in case of  a fault detection by throttle monitoring or ETC safety concept" VALUE 0xa080bf84 _REC_VAL_20_u2 8160. _CNV_A_R_LINEAR_____14_CM 0. 8160. DISPLAY_IDENTIFIER C_N_MAX_ETC_LIH FORMAT "%4.0" /end CHARACTERISTIC
/begin CHARACTERISTIC c_n_max_thd_min "Minimum allowed engine speed threshold" VALUE 0xa080bf92 _REC_VAL_20_u2 8160. _CNV_A_R_LINEAR_____14_CM 0. 8160. DISPLAY_IDENTIFIER C_N_MAX_THD_MIN FORMAT "%4.0" /end CHARACTERISTIC
/begin MEASUREMENT n_max_vs_max "Engine speed limit in case of vehicle speed limitation" UWORD _CNV_A_R_LINEAR_____14_CM 1 100. 0. 8160. DISPLAY_IDENTIFIER N_MAX_VS_MAX ECU_ADDRESS 0xd00014bc FORMAT "%4.0" /end MEASUREMENT
/begin CHARACTERISTIC c_vs_max_amt "Vehicle speed limitation threshold - SSG" VALUE 0xa080c4c9 _REC_VAL_20_u1 255. _CNV_A_R_LINEAR_____6_CM 0. 255. DISPLAY_IDENTIFIER C_VS_MAX_AMT FORMAT "%3.0" /end CHARACTERISTIC
/begin CHARACTERISTIC c_n_max_amt_add "offset for engine speed limit during gear shift phase 1 and 2" VALUE 0xa080bf5a _REC_VAL_20_u2 979.2000000000001 _CNV_A_R_LINEAR_____14_CM 0. 8160. DISPLAY_IDENTIFIER C_N_MAX_AMT_ADD FORMAT "%4.0" /end CHARACTERISTIC
/begin CHARACTERISTIC c_n_max_amt_gp "engine speed limit in case of SSG-error (gear protection active, LV_GP=1)" VALUE 0xa080bf5c _REC_VAL_20_u2 979.2000000000001 _CNV_A_R_LINEAR_____14_CM 0. 8160. DISPLAY_IDENTIFIER C_N_MAX_AMT_GP FORMAT "%4.0" /end CHARACTERISTIC
/begin CHARACTERISTIC id_n_max_mt "Basic Engine speed limit MT-Vehicle" CURVE 0xa0809d40 _REC_CUR_20_u2_u1 8160. _CNV_A_R_LINEAR_____14_CM 0. 8160. DISPLAY_IDENTIFIER ID_N_MAX_MT FORMAT "%4.0"
 /begin AXIS_DESCR COM_AXIS gear _CNV_A_R_LINEAR_____0_CM 9 0. 255. FORMAT "%3.0" AXIS_PTS_REF ldpm_gear /end AXIS_DESCR
/end CHARACTERISTIC
/begin CHARACTERISTIC id_n_max_amt "Basic Engine speed limit AMT-Vehicle" CURVE 0xa0809cb4 _REC_CUR_20_u2_u1 8160. _CNV_A_R_LINEAR_____14_CM 0. 8160. DISPLAY_IDENTIFIER ID_N_MAX_AMT FORMAT "%4.0"
 /begin AXIS_DESCR COM_AXIS gear _CNV_A_R_LINEAR_____0_CM 9 0. 255. FORMAT "%3.0" AXIS_PTS_REF ldpm_gear /end AXIS_DESCR
/end CHARACTERISTIC
/begin CHARACTERISTIC id_n_max_at "Basic Engine speed limit AT-Vehicle" CURVE 0xa0809cc8 _REC_CUR_20_u2_u1 8160. _CNV_A_R_LINEAR_____14_CM 0. 8160. DISPLAY_IDENTIFIER ID_N_MAX_AT FORMAT "%4.0"
 /begin AXIS_DESCR COM_AXIS gear _CNV_A_R_LINEAR_____0_CM 9 0. 255. FORMAT "%3.0" AXIS_PTS_REF ldpm_gear /end AXIS_DESCR
/end CHARACTERISTIC
/begin CHARACTERISTIC id_n_max_h_mt "Increased engine speed limit MT-vehicle" CURVE 0xa0809d2c _REC_CUR_20_u2_u1 8160. _CNV_A_R_LINEAR_____14_CM 0. 8160. DISPLAY_IDENTIFIER ID_N_MAX_H_MT FORMAT "%4.0"
 /begin AXIS_DESCR COM_AXIS gear _CNV_A_R_LINEAR_____0_CM 9 0. 255. FORMAT "%3.0" AXIS_PTS_REF ldpm_gear /end AXIS_DESCR
/end CHARACTERISTIC
/begin CHARACTERISTIC id_n_max_h_amt "Increased engine speed limit AMT-vehicle" CURVE 0xa0809cf0 _REC_CUR_20_u2_u1 8160. _CNV_A_R_LINEAR_____14_CM 0. 8160. DISPLAY_IDENTIFIER ID_N_MAX_H_AMT FORMAT "%4.0"
 /begin AXIS_DESCR COM_AXIS gear _CNV_A_R_LINEAR_____0_CM 9 0. 255. FORMAT "%3.0" AXIS_PTS_REF ldpm_gear /end AXIS_DESCR
/end CHARACTERISTIC
/begin CHARACTERISTIC id_n_max_h_at "Increased engine speed limit AT-vehicle" CURVE 0xa0809d04 _REC_CUR_20_u2_u1 8160. _CNV_A_R_LINEAR_____14_CM 0. 8160. DISPLAY_IDENTIFIER ID_N_MAX_H_AT FORMAT "%4.0"
 /begin AXIS_DESCR COM_AXIS gear _CNV_A_R_LINEAR_____0_CM 9 0. 255. FORMAT "%3.0" AXIS_PTS_REF ldpm_gear /end AXIS_DESCR
/end CHARACTERISTIC
/begin CHARACTERISTIC id_t_n_max_h_amt "Time for increased engine speed limit,AMT vehicle" CURVE 0xa0809e4c _REC_CUR_20_u2_u1 6553.5 _CNV_A_R_LINEAR_____4_CM 0. 6553.5 DISPLAY_IDENTIFIER ID_T_N_MAX_H_AMT FORMAT "%5.1"
 /begin AXIS_DESCR COM_AXIS gear _CNV_A_R_LINEAR_____0_CM 9 0. 255. FORMAT "%3.0" AXIS_PTS_REF ldpm_gear /end AXIS_DESCR
/end CHARACTERISTIC
/begin CHARACTERISTIC id_t_n_max_h_mt "Time for increased engine speed limit, MT vehicle" CURVE 0xa0809e88 _REC_CUR_20_u2_u1 6553.5 _CNV_A_R_LINEAR_____4_CM 0. 6553.5 DISPLAY_IDENTIFIER ID_T_N_MAX_H_MT FORMAT "%5.1"
 /begin AXIS_DESCR COM_AXIS gear _CNV_A_R_LINEAR_____0_CM 9 0. 255. FORMAT "%3.0" AXIS_PTS_REF ldpm_gear /end AXIS_DESCR
/end CHARACTERISTIC
/begin CHARACTERISTIC id_t_n_max_h_at "Time for increased engine speed limit, AT vehicle" CURVE 0xa0809e60 _REC_CUR_20_u2_u1 6553.5 _CNV_A_R_LINEAR_____4_CM 0. 6553.5 DISPLAY_IDENTIFIER ID_T_N_MAX_H_AT FORMAT "%5.1"
 /begin AXIS_DESCR COM_AXIS gear _CNV_A_R_LINEAR_____0_CM 9 0. 255. FORMAT "%3.0" AXIS_PTS_REF ldpm_gear /end AXIS_DESCR
/end CHARACTERISTIC
/begin CHARACTERISTIC id_n_dec_n_max_h_mt "Stepwidth to basic engine speed limit, MT vehicle" CURVE 0xa0809c38 _REC_CUR_20_u2_u1 8160. _CNV_A_R_LINEAR_____14_CM 0. 8160. DISPLAY_IDENTIFIER ID_N_DEC_N_MAX_H_MT FORMAT "%4.0"
 /begin AXIS_DESCR COM_AXIS gear _CNV_A_R_LINEAR_____0_CM 9 0. 255. FORMAT "%3.0" AXIS_PTS_REF ldpm_gear /end AXIS_DESCR
/end CHARACTERISTIC
/begin CHARACTERISTIC id_n_dec_n_max_h_amt "Stepwidth to basic engine speed limit, AMT vehicle" CURVE 0xa0809bfc _REC_CUR_20_u2_u1 8160. _CNV_A_R_LINEAR_____14_CM 0. 8160. DISPLAY_IDENTIFIER ID_N_DEC_N_MAX_H_AMT FORMAT "%4.0"
 /begin AXIS_DESCR COM_AXIS gear _CNV_A_R_LINEAR_____0_CM 9 0. 255. FORMAT "%3.0" AXIS_PTS_REF ldpm_gear /end AXIS_DESCR
/end CHARACTERISTIC
/begin CHARACTERISTIC id_n_dec_n_max_h_at "Stepwidth to basic engine speed limit, AT vehicle" CURVE 0xa0809c10 _REC_CUR_20_u2_u1 8160. _CNV_A_R_LINEAR_____14_CM 0. 8160. DISPLAY_IDENTIFIER ID_N_DEC_N_MAX_H_AT FORMAT "%4.0"
 /begin AXIS_DESCR COM_AXIS gear _CNV_A_R_LINEAR_____0_CM 9 0. 255. FORMAT "%3.0" AXIS_PTS_REF ldpm_gear /end AXIS_DESCR
/end CHARACTERISTIC
/begin CHARACTERISTIC c_n_max_dri_rvl "Engine speed limit AT-vehicle in reverse gear" VALUE 0xa080bf7a _REC_VAL_20_u2 8160. _CNV_A_R_LINEAR_____14_CM 0. 8160. DISPLAY_IDENTIFIER C_N_MAX_DRI_RVL FORMAT "%4.0" /end CHARACTERISTIC
/begin CHARACTERISTIC c_vs_thd_n_max_h_mt "VS threshold for increased engine speed limit, MT vehicle" VALUE 0xa080c503 _REC_VAL_20_u1 255. _CNV_A_R_LINEAR_____6_CM 0. 255. DISPLAY_IDENTIFIER C_VS_THD_N_MAX_H_MT FORMAT "%3.0" /end CHARACTERISTIC
/begin CHARACTERISTIC c_vs_thd_n_max_h_amt "VS threshold for increased engine speed limit, AMT vehicle" VALUE 0xa080c500 _REC_VAL_20_u1 255. _CNV_A_R_LINEAR_____6_CM 0. 255. DISPLAY_IDENTIFIER C_VS_THD_N_MAX_H_AMT FORMAT "%3.0" /end CHARACTERISTIC
/begin CHARACTERISTIC c_vs_thd_n_max_h_at "VS threshold for increased engine speed limit, AT vehicle" VALUE 0xa080c501 _REC_VAL_20_u1 255. _CNV_A_R_LINEAR_____6_CM 0. 255. DISPLAY_IDENTIFIER C_VS_THD_N_MAX_H_AT FORMAT "%3.0" /end CHARACTERISTIC
/begin CHARACTERISTIC c_t_max_n_max_h_amt "Maximum time after exceeding the VS threshold, AMT vehicle" VALUE 0xa080c1f2 _REC_VAL_20_u1 25.5 _CNV_A_R_LINEAR_____4_CM 0. 25.5 DISPLAY_IDENTIFIER C_T_MAX_N_MAX_H_AMT FORMAT "%4.1" /end CHARACTERISTIC
/begin CHARACTERISTIC c_t_max_n_max_h_at "Maximum time after exceeding the VS threshold, AT vehicle" VALUE 0xa080c1f3 _REC_VAL_20_u1 25.5 _CNV_A_R_LINEAR_____4_CM 0. 25.5 DISPLAY_IDENTIFIER C_T_MAX_N_MAX_H_AT FORMAT "%4.1" /end CHARACTERISTIC
/begin MEASUREMENT lv_n_max_h "Boolean for Increased Engine speed limitation active" UBYTE _CNV_S_2_RANGE__0___1_CM 1 100. 0. 1. DISPLAY_IDENTIFIER LV_N_MAX_H ECU_ADDRESS 0xd00014d2 BIT_MASK 0x1 /end MEASUREMENT
/begin MEASUREMENT lv_n_max_etc_lih "Engine speed limitation active" UBYTE _CNV_S_2_RANGE__0___1_CM 1 100. 0. 1. DISPLAY_IDENTIFIER LV_N_MAX_ETC_LIH ECU_ADDRESS 0xd00089d1 BIT_MASK 0x1 /end MEASUREMENT
/begin MEASUREMENT n_max_thd "Actual engine speed limit" UWORD _CNV_A_R_LINEAR_____14_CM 1 100. 0. 8160. DISPLAY_IDENTIFIER N_MAX_THD ECU_ADDRESS 0xd000a620 FORMAT "%4.0" /end MEASUREMENT
/begin MEASUREMENT t_gear_vs_max "Time since the last gear shift." UBYTE _CNV_A_R_LINEAR_____4_CM 1 100. 0. 25.5 DISPLAY_IDENTIFIER T_GEAR_VS_MAX ECU_ADDRESS 0xd00014cc FORMAT "%4.1" /end MEASUREMENT
/begin CHARACTERISTIC c_t_max_n_max_h_mt "Maximum time after exceeding the VS threshold, MT vehicle" VALUE 0xa080c1f5 _REC_VAL_20_u1 25.5 _CNV_A_R_LINEAR_____4_CM 0. 25.5 DISPLAY_IDENTIFIER C_T_MAX_N_MAX_H_MT FORMAT "%4.1" /end CHARACTERISTIC
/begin CHARACTERISTIC c_t_gear_vs_max_at "Time for calculating N_MAX_VS_MAX after a gear shift with AT." VALUE 0xa080c1d2 _REC_VAL_20_u1 25.5 _CNV_A_R_LINEAR_____4_CM 0. 25.5 DISPLAY_IDENTIFIER C_T_GEAR_VS_MAX_AT FORMAT "%4.1" /end CHARACTERISTIC
/begin CHARACTERISTIC c_t_gear_vs_max_mt "Time for calculating N_MAX_VS_MAX after a gear shift with MT." VALUE 0xa080c1d3 _REC_VAL_20_u1 25.5 _CNV_A_R_LINEAR_____4_CM 0. 25.5 DISPLAY_IDENTIFIER C_T_GEAR_VS_MAX_MT FORMAT "%4.1" /end CHARACTERISTIC
/begin CHARACTERISTIC c_vs_max_hys "Hysteresis of vehicle speed limitation " VALUE 0xa080c4ce _REC_VAL_20_u1 255. _CNV_A_R_LINEAR_____6_CM 0. 255. DISPLAY_IDENTIFIER C_VS_MAX_HYS FORMAT "%3.0" /end CHARACTERISTIC
/begin CHARACTERISTIC c_vs_max_0_dft "Vehicle speed limitation threshold 0 - default value" VALUE 0xa080c4c4 _REC_VAL_20_u1 255. _CNV_A_R_LINEAR_____6_CM 0. 255. DISPLAY_IDENTIFIER C_VS_MAX_0_DFT FORMAT "%3.0" /end CHARACTERISTIC
/begin CHARACTERISTIC c_vs_max_1 "Vehicle speed limitation threshold 1" VALUE 0xa080c4c5 _REC_VAL_20_u1 255. _CNV_A_R_LINEAR_____6_CM 0. 255. DISPLAY_IDENTIFIER C_VS_MAX_1 FORMAT "%3.0" /end CHARACTERISTIC
/begin CHARACTERISTIC c_vs_max_2 "Vehicle speed limitation threshold 2" VALUE 0xa080c4c6 _REC_VAL_20_u1 255. _CNV_A_R_LINEAR_____6_CM 0. 255. DISPLAY_IDENTIFIER C_VS_MAX_2 FORMAT "%3.0" /end CHARACTERISTIC
/begin CHARACTERISTIC c_vs_max_3 "Vehicle speed limitation threshold 3" VALUE 0xa080c4c7 _REC_VAL_20_u1 255. _CNV_A_R_LINEAR_____6_CM 0. 255. DISPLAY_IDENTIFIER C_VS_MAX_3 FORMAT "%3.0" /end CHARACTERISTIC
/begin CHARACTERISTIC ip_n_max_1__tco "engine speed limit (orange area) depending on TOIL - BN2000" CURVE 0xa080b084 _REC_CUR_20_u2_u1 8160. _CNV_A_R_LINEAR_____14_CM 0. 8160. DISPLAY_IDENTIFIER IP_N_MAX_1__TCO FORMAT "%4.0"
 /begin AXIS_DESCR COM_AXIS tco _CNV_A_R_LINEAR_____17_CM 4 -48. 142.5 FORMAT "%6.2" AXIS_PTS_REF ldp_tco__n_max_1 /end AXIS_DESCR
/end CHARACTERISTIC
/begin CHARACTERISTIC ip_n_max_2__tco "engine speed limit (red area) depending on TOIL - BN2000" CURVE 0xa080b08c _REC_CUR_20_u2_u1 8160. _CNV_A_R_LINEAR_____14_CM 0. 8160. DISPLAY_IDENTIFIER IP_N_MAX_2__TCO FORMAT "%4.0"
 /begin AXIS_DESCR COM_AXIS tco _CNV_A_R_LINEAR_____17_CM 4 -48. 142.5 FORMAT "%6.2" AXIS_PTS_REF ldp_tco__n_max_2 /end AXIS_DESCR
/end CHARACTERISTIC
/begin AXIS_PTS ldp_tco__n_max_1 "" 0xa0808de0 tco _REC_AXS_20_u1 190.5 _CNV_A_R_LINEAR_____17_CM 4 -48. 142.5 FORMAT "%6.2" /end AXIS_PTS
/begin AXIS_PTS ldp_tco__n_max_2 "" 0xa0808de6 tco _REC_AXS_20_u1 190.5 _CNV_A_R_LINEAR_____17_CM 4 -48. 142.5 FORMAT "%6.2" /end AXIS_PTS
/begin CHARACTERISTIC c_n_max_egy_1 "Engine speed limit in case of production energy spare mode (Fertigungsmodus)" VALUE 0xa080bf7e _REC_VAL_20_u2 8160. _CNV_A_R_LINEAR_____14_CM 0. 8160. DISPLAY_IDENTIFIER C_N_MAX_EGY_1 FORMAT "%4.0" /end CHARACTERISTIC
/begin CHARACTERISTIC c_n_max_egy_2 "Engine speed limit in case of transportation energy spare mode (Transportmodus)" VALUE 0xa080bf80 _REC_VAL_20_u2 8160. _CNV_A_R_LINEAR_____14_CM 0. 8160. DISPLAY_IDENTIFIER C_N_MAX_EGY_2 FORMAT "%4.0" /end CHARACTERISTIC
/begin CHARACTERISTIC c_n_max_egy_3 "Engine speed limit in case of garage energy spare mode (Werkstattmodus)" VALUE 0xa080bf82 _REC_VAL_20_u2 8160. _CNV_A_R_LINEAR_____14_CM 0. 8160. DISPLAY_IDENTIFIER C_N_MAX_EGY_3 FORMAT "%4.0" /end CHARACTERISTIC
/begin AXIS_PTS ldp_vs_n_max_drof "" 0xa0809304 vs _REC_AXS_20_u1 255. _CNV_A_R_LINEAR_____6_CM 8 0. 255. FORMAT "%3.0" /end AXIS_PTS
/begin AXIS_PTS ldp_pv_av_n_max_etc_lih_2 "" 0xa0808c84 pv_av _REC_AXS_20_u1 99.609375 _CNV_A_R_LINEAR_____5_CM 4 0. 99.609375 FORMAT "%5.2" /end AXIS_PTS
/begin CHARACTERISTIC ip_n_max_drof__vs "Engine speed limit to avoid max torque at jump start" CURVE 0xa080b094 _REC_CUR_20_u2_u1 8160. _CNV_A_R_LINEAR_____14_CM 0. 8160. DISPLAY_IDENTIFIER IP_N_MAX_DROF__VS FORMAT "%4.0"
 /begin AXIS_DESCR COM_AXIS vs _CNV_A_R_LINEAR_____6_CM 8 0. 255. FORMAT "%3.0" AXIS_PTS_REF ldp_vs_n_max_drof /end AXIS_DESCR
/end CHARACTERISTIC
/begin CHARACTERISTIC c_t_max_n_max_h_at_man "Maximum time after exceeding the VS threshold, AT vehicle in 'M' (manual) mode" VALUE 0xa080c1f4 _REC_VAL_20_u1 25.5 _CNV_A_R_LINEAR_____4_CM 0. 25.5 DISPLAY_IDENTIFIER C_T_MAX_N_MAX_H_AT_MAN FORMAT "%4.1" /end CHARACTERISTIC
/begin CHARACTERISTIC c_vs_thd_n_max_h_at_man "VS threshold for increased engine speed limit, AT vehicle in 'M' (manual) mode" VALUE 0xa080c502 _REC_VAL_20_u1 255. _CNV_A_R_LINEAR_____6_CM 0. 255. DISPLAY_IDENTIFIER C_VS_THD_N_MAX_H_AT_MAN FORMAT "%3.0" /end CHARACTERISTIC
/begin CHARACTERISTIC id_n_max_at_man "Basic Engine speed limit AT-Vehicle in 'M' (manual) mode" CURVE 0xa0809cdc _REC_CUR_20_u2_u1 8160. _CNV_A_R_LINEAR_____14_CM 0. 8160. DISPLAY_IDENTIFIER ID_N_MAX_AT_MAN FORMAT "%4.0"
 /begin AXIS_DESCR COM_AXIS gear _CNV_A_R_LINEAR_____0_CM 9 0. 255. FORMAT "%3.0" AXIS_PTS_REF ldpm_gear /end AXIS_DESCR
/end CHARACTERISTIC
/begin CHARACTERISTIC id_n_max_h_at_man "Increased engine speed limit AT-vehicle in 'M' (manual) mode" CURVE 0xa0809d18 _REC_CUR_20_u2_u1 8160. _CNV_A_R_LINEAR_____14_CM 0. 8160. DISPLAY_IDENTIFIER ID_N_MAX_H_AT_MAN FORMAT "%4.0"
 /begin AXIS_DESCR COM_AXIS gear _CNV_A_R_LINEAR_____0_CM 9 0. 255. FORMAT "%3.0" AXIS_PTS_REF ldpm_gear /end AXIS_DESCR
/end CHARACTERISTIC
/begin CHARACTERISTIC id_t_n_max_h_at_man "Time for increased engine speed limit, AT vehicle in 'M' (manual) mode" CURVE 0xa0809e74 _REC_CUR_20_u2_u1 6553.5 _CNV_A_R_LINEAR_____4_CM 0. 6553.5 DISPLAY_IDENTIFIER ID_T_N_MAX_H_AT_MAN FORMAT "%5.1"
 /begin AXIS_DESCR COM_AXIS gear _CNV_A_R_LINEAR_____0_CM 9 0. 255. FORMAT "%3.0" AXIS_PTS_REF ldpm_gear /end AXIS_DESCR
/end CHARACTERISTIC
/begin CHARACTERISTIC id_n_dec_n_max_h_at_man "Stepwidth to basic engine speed limit, AT vehicle in 'M' (manual) mode" CURVE 0xa0809c24 _REC_CUR_20_u2_u1 8160. _CNV_A_R_LINEAR_____14_CM 0. 8160. DISPLAY_IDENTIFIER ID_N_DEC_N_MAX_H_AT_MAN FORMAT "%4.0"
 /begin AXIS_DESCR COM_AXIS gear _CNV_A_R_LINEAR_____0_CM 9 0. 255. FORMAT "%3.0" AXIS_PTS_REF ldpm_gear /end AXIS_DESCR
/end CHARACTERISTIC
/begin MEASUREMENT maf_hb "same as MAF but with a lower resolution (HB means High Byte)" UBYTE _CNV_A_R_LINEAR_____15_CM 1 100. 0. 1389. DISPLAY_IDENTIFIER MAF_HB ECU_ADDRESS 0xd0008b59 FORMAT "%4.0" /end MEASUREMENT
/begin MEASUREMENT tqi_asr_fast_req_can "Relative indicated engine torque request by ASR (fast path)" SWORD _CNV_A_R_LINEAR_____31_CM 1 100. -1024. 1023.96875 DISPLAY_IDENTIFIER TQI_ASR_FAST_REQ_CAN ECU_ADDRESS 0xd000a73e FORMAT "%8.2" /end MEASUREMENT
/begin MEASUREMENT tqi_msr_req_can "Relative indicated engine torque request by MSR" SWORD _CNV_A_R_LINEAR_____31_CM 1 100. -1024. 1023.96875 DISPLAY_IDENTIFIER TQI_MSR_REQ_CAN ECU_ADDRESS 0xd000a740 FORMAT "%8.2" /end MEASUREMENT
/begin MEASUREMENT tqi_asr_slow_req_can "Relative indicated engine torque request by ASR (slow path)" SWORD _CNV_A_R_LINEAR_____31_CM 1 100. -1024. 1023.96875 DISPLAY_IDENTIFIER TQI_ASR_SLOW_REQ_CAN ECU_ADDRESS 0xd000a742 FORMAT "%8.2" /end MEASUREMENT
/begin MEASUREMENT tqi_asr_fast_can "relative indicated engine torque requested by ASR (fast path)" UBYTE _CNV_A_R_LINEAR_____5_CM 1 100. 0. 99.609375 DISPLAY_IDENTIFIER TQI_ASR_FAST_CAN ECU_ADDRESS 0xd0008b8c FORMAT "%5.1" /end MEASUREMENT
/begin MEASUREMENT tqi_msr_can "relative indicated engine torque requested by MSR" UBYTE _CNV_A_R_LINEAR_____5_CM 1 100. 0. 99.609375 DISPLAY_IDENTIFIER TQI_MSR_CAN ECU_ADDRESS 0xd0008b8d FORMAT "%5.1" /end MEASUREMENT
/begin MEASUREMENT tqi_asr_slow_can "relative indicated engine torque requested by ASR (slow path)" UBYTE _CNV_A_R_LINEAR_____5_CM 1 100. 0. 99.609375 DISPLAY_IDENTIFIER TQI_ASR_SLOW_CAN ECU_ADDRESS 0xd0008b8e FORMAT "%5.1" /end MEASUREMENT
/begin MEASUREMENT tqi_gs_fast_req "Absolute torque request during gearshift intervention - fast" SWORD _CNV_A_R_LINEAR_____31_CM 1 100. -1024. 1023.96875 DISPLAY_IDENTIFIER TQI_GS_FAST_REQ ECU_ADDRESS 0xd000a744 FORMAT "%8.2" /end MEASUREMENT
/begin MEASUREMENT tqi_gs_slow_req "Absolute torque request during gearshift intervention - slow" SWORD _CNV_A_R_LINEAR_____31_CM 1 100. -1024. 1023.96875 DISPLAY_IDENTIFIER TQI_GS_SLOW_REQ ECU_ADDRESS 0xd000a746 FORMAT "%8.2" /end MEASUREMENT
/begin MEASUREMENT tqi_gs_fast_req_can "Relative torque request during gearshift intervention - fast" UBYTE _CNV_A_R_LINEAR_____185_CM 1 100. 0. 0.99609375 DISPLAY_IDENTIFIER TQI_GS_FAST_REQ_CAN ECU_ADDRESS 0xd0008b91 FORMAT "%5.3" /end MEASUREMENT
/begin MEASUREMENT tqi_gs_slow_req_can "Relative torque request during gearshift intervention - slow" UBYTE _CNV_A_R_LINEAR_____185_CM 1 100. 0. 0.99609375 DISPLAY_IDENTIFIER TQI_GS_SLOW_REQ_CAN ECU_ADDRESS 0xd0008b92 FORMAT "%5.3" /end MEASUREMENT
/begin MEASUREMENT lv_ctop "State convertible top: 0 = closed, 1 = open" UBYTE _CNV_S_2_RANGE______76_CM 1 100. 0. 1. DISPLAY_IDENTIFIER LV_CTOP ECU_ADDRESS 0xd0008b93 /end MEASUREMENT
/begin MEASUREMENT tqi_amt_req " torque request SSG" SWORD _CNV_A_R_LINEAR_____31_CM 1 100. -1024. 1023.96875 DISPLAY_IDENTIFIER TQI_AMT_REQ ECU_ADDRESS 0xd000a748 FORMAT "%8.2" /end MEASUREMENT
/begin MEASUREMENT tqi_slow_amt_req " torque request (slow) SSG" SWORD _CNV_A_R_LINEAR_____31_CM 1 100. -1024. 1023.96875 DISPLAY_IDENTIFIER TQI_SLOW_AMT_REQ ECU_ADDRESS 0xd000a74a FORMAT "%8.2" /end MEASUREMENT
/begin MEASUREMENT tqi_amt_req_can "torque requested SSG via CAN" UBYTE _CNV_A_R_LINEAR_____5_CM 1 100. 0. 99.609375 DISPLAY_IDENTIFIER TQI_AMT_REQ_CAN ECU_ADDRESS 0xd0008b94 FORMAT "%5.1" /end MEASUREMENT
/begin MEASUREMENT lv_city "sttering wheel sensor angle" UBYTE _CNV_S_2_RANGE__0___1_CM 1 100. 0. 1. DISPLAY_IDENTIFIER LV_CITY ECU_ADDRESS 0xd0008b95 BIT_MASK 0x1 /end MEASUREMENT
/begin CHARACTERISTIC c_pv_grd_lih_max "Max. (positive) pedal gradient in case of an error" VALUE 0xa080c090 _REC_VAL_20_u2 99.99847412109381 _CNV_A_R_LINEAR_____8_CM 0. 99.99847412109381 DISPLAY_IDENTIFIER C_PV_GRD_LIH_MAX /end CHARACTERISTIC
/begin CHARACTERISTIC c_v_pvs_hys_fil "Area of the dejitter-filters" VALUE 0xa080c3f0 _REC_VAL_20_u1 1.24511719 _CNV_A_R_LINEAR_____248_CM 0. 1.24511719 DISPLAY_IDENTIFIER C_V_PVS_HYS_FIL FORMAT "%4.3" /end CHARACTERISTIC
/begin MEASUREMENT v_pvs_fil_1 "Filtered PVS-voltage value for channel 1" UWORD _CNV_A_R_LINEAR_____2_CM 1 100. 0. 4.9951171875 DISPLAY_IDENTIFIER V_PVS_FIL_1 ECU_ADDRESS 0xd00015ec FORMAT "%5.3" /end MEASUREMENT
/begin MEASUREMENT v_pvs_fil_2 "Filtered PVS-voltage value for channel 2" UWORD _CNV_A_R_LINEAR_____2_CM 1 100. 0. 4.9951171875 DISPLAY_IDENTIFIER V_PVS_FIL_2 ECU_ADDRESS 0xd00015ee FORMAT "%5.3" /end MEASUREMENT
/begin CHARACTERISTIC c_pvs_slop_1 "Slope value of  the pedal value 1" VALUE 0xa080c097 _REC_VAL_20_u1 79.6875 _CNV_A_R_LINEAR_____249_CM 0. 79.6875 DISPLAY_IDENTIFIER C_PVS_SLOP_1 FORMAT "%4.1" /end CHARACTERISTIC
/begin CHARACTERISTIC c_pvs_slop_2 "Slope value of  the pedal value 2" VALUE 0xa080c098 _REC_VAL_20_u1 79.6875 _CNV_A_R_LINEAR_____249_CM 0. 79.6875 DISPLAY_IDENTIFIER C_PVS_SLOP_2 FORMAT "%4.1" /end CHARACTERISTIC
/begin MEASUREMENT lv_kd "Flag for Kick-Down-Recognition (internally recognized from both PVS-voltages)" UBYTE _CNV_S_2_RANGE__0___1_CM 1 100. 0. 1. DISPLAY_IDENTIFIER LV_KD ECU_ADDRESS 0xd00089df BIT_MASK 0x1 /end MEASUREMENT
/begin CHARACTERISTIC c_v_pvs_ofs_1 "Offset of the pedal value 1" VALUE 0xa080c3fe _REC_VAL_20_u1 1.24511719 _CNV_A_R_LINEAR_____248_CM 0. 1.24511719 DISPLAY_IDENTIFIER C_V_PVS_OFS_1 FORMAT "%5.3" /end CHARACTERISTIC
/begin CHARACTERISTIC c_v_pvs_ofs_2 "Offset of the pedal value 2" VALUE 0xa080c3ff _REC_VAL_20_u1 1.24511719 _CNV_A_R_LINEAR_____248_CM 0. 1.24511719 DISPLAY_IDENTIFIER C_V_PVS_OFS_2 FORMAT "%5.3" /end CHARACTERISTIC
/begin CHARACTERISTIC c_pv_av_bls_not_plaus_lgrd "Change limitation of pedal position in case of an PV_AV/Brake implausibility" VALUE 0xa080c08c _REC_VAL_20_u2 99.99847412109381 _CNV_A_R_LINEAR_____8_CM 0. 99.99847412109381 DISPLAY_IDENTIFIER C_PV_AV_BLS_NOT_PLAUS_LGRD /end CHARACTERISTIC
/begin CHARACTERISTIC c_pv_av_bls_not_plaus_hys "Hysteresis in case of an PV_AV/Brake implausibility" VALUE 0xa080c08b _REC_VAL_20_u1 99.609375 _CNV_A_R_LINEAR_____5_CM 0. 99.609375 DISPLAY_IDENTIFIER C_PV_AV_BLS_NOT_PLAUS_HYS FORMAT "%4.1" /end CHARACTERISTIC
/begin MEASUREMENT pv_av_2 "degree of activation of the accelerator pedal from PVS-channel 2" UBYTE _CNV_A_R_LINEAR_____5_CM 1 100. 0. 99.609375 DISPLAY_IDENTIFIER PV_AV_2 ECU_ADDRESS 0xd00089dd FORMAT "%3.1" /end MEASUREMENT
/begin CHARACTERISTIC c_pv_av_bls_not_plaus "Pedal position in case of an PV_AV/Brake implausibility" VALUE 0xa080c08a _REC_VAL_20_u1 99.609375 _CNV_A_R_LINEAR_____5_CM 0. 99.609375 DISPLAY_IDENTIFIER C_PV_AV_BLS_NOT_PLAUS FORMAT "%4.1" /end CHARACTERISTIC
/begin MEASUREMENT pv_av_1 "degree of activation of the accelerator pedal from PVS-channel 1" UBYTE _CNV_A_R_LINEAR_____5_CM 1 100. 0. 99.609375 DISPLAY_IDENTIFIER PV_AV_1 ECU_ADDRESS 0xd00089dc FORMAT "%3.1" /end MEASUREMENT
/begin MEASUREMENT pv_av_raw "Global degree of activation of the gas pedal" UBYTE _CNV_A_R_LINEAR_____5_CM 1 100. 0. 99.609375 DISPLAY_IDENTIFIER PV_AV_RAW ECU_ADDRESS 0xd00089de FORMAT "%3.1" /end MEASUREMENT
/begin CHARACTERISTIC ip_pv_lih_max "Max. pedal position in case of an error" CURVE 0xa080b3a8 _REC_CUR_20_u1_u1 99.609375 _CNV_A_R_LINEAR_____5_CM 0. 99.609375 DISPLAY_IDENTIFIER IP_PV_LIH_MAX FORMAT "%4.1"
 /begin AXIS_DESCR COM_AXIS n_32 _CNV_A_R_LINEAR_____10_CM 6 0. 8160. FORMAT "%4.0" AXIS_PTS_REF ldp_n_32__pv_lih_max /end AXIS_DESCR
/end CHARACTERISTIC
/begin CHARACTERISTIC c_v_pvs_thd_kd_hys "Hysteresis of kick down recognition Channel 1" VALUE 0xa080c401 _REC_VAL_20_u1 4.998 _CNV_A_R_LINEAR_____199_CM 0. 4.998 DISPLAY_IDENTIFIER C_V_PVS_THD_KD_HYS FORMAT "%6.4" /end CHARACTERISTIC
/begin CHARACTERISTIC c_v_pvs_thd_kd "Difference between C_V_PVS_SP_FL_1 and kick-down-recognition (Channel 1)" VALUE 0xa080c400 _REC_VAL_20_u1 4.998 _CNV_A_R_LINEAR_____199_CM 0. 4.998 DISPLAY_IDENTIFIER C_V_PVS_THD_KD FORMAT "%6.4" /end CHARACTERISTIC
/begin AXIS_PTS ldp_n_32__pv_lih_max "" 0xa080899c n_32 _REC_AXS_20_u1 816. _CNV_A_R_LINEAR_____10_CM 6 0. 8160. FORMAT "%4.0" /end AXIS_PTS
/begin MEASUREMENT pv_cus_1 "degree of activation of the accelerator pedal from PVS-channel 1 with higher resolution for customer purposes" UWORD _CNV_A_R_LINEAR_____8_CM 1 100. 0. 99.99847412109381 DISPLAY_IDENTIFIER PV_CUS_1 ECU_ADDRESS 0xd000a634 /end MEASUREMENT
/begin MEASUREMENT pv_cus_2 "degree of activation of the accelerator pedal from PVS-channel 2 with higher resolution for customer purposes" UWORD _CNV_A_R_LINEAR_____8_CM 1 100. 0. 99.99847412109381 DISPLAY_IDENTIFIER PV_CUS_2 ECU_ADDRESS 0xd000a636 /end MEASUREMENT
/begin MEASUREMENT pv_cus_raw "Global degree of activation of the gas pedal with higher resolution for customer purpose" UWORD _CNV_A_R_LINEAR_____8_CM 1 100. 0. 99.99847412109381 DISPLAY_IDENTIFIER PV_CUS_RAW ECU_ADDRESS 0xd000a638 /end MEASUREMENT
/begin MEASUREMENT lv_err_prel_teg_pcat_down "Temp. after precatalyst antibounce flag" UBYTE _CNV_S_2_RANGE______252_R_CM 1 100. 0. 255. DISPLAY_IDENTIFIER LV_ERR_PREL_TEG_PCAT_DOWN ECU_ADDRESS 0xd0008a04 BIT_MASK 0x1 /end MEASUREMENT
/begin CHARACTERISTIC c_vp_teg_pcat_down_diag_min "minimum voltage threshold for erroe detection" VALUE 0xa080c47c _REC_VAL_20_u2 4.999847 _CNV_A_R_LINEAR_____172_CM 0. 4.999847 DISPLAY_IDENTIFIER C_VP_TEG_PCAT_DOWN_DIAG_MIN FORMAT "%7.5" /end CHARACTERISTIC
/begin CHARACTERISTIC c_vp_teg_pcat_down_diag_max "maximum voltage threshold for erroe detection" VALUE 0xa080c47a _REC_VAL_20_u2 4.999847 _CNV_A_R_LINEAR_____172_CM 0. 4.999847 DISPLAY_IDENTIFIER C_VP_TEG_PCAT_DOWN_DIAG_MAX FORMAT "%7.5" /end CHARACTERISTIC
/begin CHARACTERISTIC c_vp_teg_mes_grd_max "maximum voltage gradient threshold for error detection" VALUE 0xa080c478 _REC_VAL_20_u2 4.999847 _CNV_A_R_LINEAR_____172_CM 0. 4.999847 DISPLAY_IDENTIFIER C_VP_TEG_MES_GRD_MAX FORMAT "%7.5" /end CHARACTERISTIC
/begin MEASUREMENT lv_err_teg_pcat_down "Temp. after precatalyst error flag" UBYTE _CNV_S_2_RANGE______252_R_CM 1 100. 0. 255. DISPLAY_IDENTIFIER LV_ERR_TEG_PCAT_DOWN ECU_ADDRESS 0xd0007fd8 BIT_MASK 0x1 /end MEASUREMENT
/begin CHARACTERISTIC c_cam_op_ex "outlet valves total opening angle" VALUE 0xa080ba9f _REC_VAL_20_u1 95.625 _CNV_A_R_LINEAR_____253_CM 175. 270.625 DISPLAY_IDENTIFIER C_CAM_OP_EX FORMAT "%5.1" /end CHARACTERISTIC
/begin CHARACTERISTIC c_tia_grd_max_diag "Maximum permissible gradient for TIA" VALUE 0xa080c326 _REC_VAL_20_u1 38.1 _CNV_A_R_LINEAR_____254_CM 0. 190.5 DISPLAY_IDENTIFIER C_TIA_GRD_MAX_DIAG FORMAT "%4.1" /end CHARACTERISTIC
/begin MEASUREMENT tia_mes[0] "Intake air temperature raw value" UBYTE _CNV_A_R_LINEAR_____17_CM 1 100. -48. 142.5 DISPLAY_IDENTIFIER TIA_MES[1] ECU_ADDRESS 0xd00089f4 FORMAT "%5.1" /end MEASUREMENT
/begin MEASUREMENT tia_mes[1] "Intake air temperature raw value" UBYTE _CNV_A_R_LINEAR_____17_CM 1 100. -48. 142.5 DISPLAY_IDENTIFIER TIA_MES[2] ECU_ADDRESS 0xd00089f5 FORMAT "%5.1" /end MEASUREMENT
/begin CHARACTERISTIC c_tco_diag "TCO threshold for calculation of substitutes" VALUE 0xa080c2c0 _REC_VAL_20_u1 28.575 _CNV_A_R_LINEAR_____17_CM -48. 142.5 DISPLAY_IDENTIFIER C_TCO_DIAG FORMAT "%5.1" /end CHARACTERISTIC
/begin CHARACTERISTIC c_tia_sub_tol "Upper TIA substitue value" VALUE 0xa080c32e _REC_VAL_20_u1 28.575 _CNV_A_R_LINEAR_____17_CM -48. 142.5 DISPLAY_IDENTIFIER C_TIA_SUB_TOL FORMAT "%5.1" /end CHARACTERISTIC
/begin MEASUREMENT tia "Intake air temperature" UBYTE _CNV_A_R_LINEAR_____17_CM 1 100. -48. 142.5 DISPLAY_IDENTIFIER TIA ECU_ADDRESS 0xd00089f0 FORMAT "%5.1" /end MEASUREMENT
/begin MEASUREMENT tia_st "Intake air temperature at ST" UBYTE _CNV_A_R_LINEAR_____17_CM 1 100. -48. 142.5 DISPLAY_IDENTIFIER TIA_ST ECU_ADDRESS 0xd00089f2 FORMAT "%5.1" /end MEASUREMENT
/begin MEASUREMENT tia_sub "Substitute value intake air temperature" UBYTE _CNV_A_R_LINEAR_____17_CM 1 100. -48. 142.5 DISPLAY_IDENTIFIER TIA_SUB ECU_ADDRESS 0xd00089f1 FORMAT "%3.0" /end MEASUREMENT
/begin CHARACTERISTIC c_tia_sub_bol "Lower TIA substitute value" VALUE 0xa080c32d _REC_VAL_20_u1 28.575 _CNV_A_R_LINEAR_____17_CM -48. 142.5 DISPLAY_IDENTIFIER C_TIA_SUB_BOL FORMAT "%5.1" /end CHARACTERISTIC
/begin MEASUREMENT tia_thr_mes[0] "Intake air temperature at the throttle raw value" UBYTE _CNV_A_R_LINEAR_____17_CM 1 100. -48. 142.5 DISPLAY_IDENTIFIER TIA_THR_MES[1] ECU_ADDRESS 0xd00089f8 FORMAT "%6.2" /end MEASUREMENT
/begin MEASUREMENT tia_thr_mes[1] "Intake air temperature at the throttle raw value" UBYTE _CNV_A_R_LINEAR_____17_CM 1 100. -48. 142.5 DISPLAY_IDENTIFIER TIA_THR_MES[2] ECU_ADDRESS 0xd00089f9 FORMAT "%6.2" /end MEASUREMENT
/begin MEASUREMENT tia_thr_st "Intake air temperature at the throttle at Start" UBYTE _CNV_A_R_LINEAR_____17_CM 1 100. -48. 142.5 DISPLAY_IDENTIFIER TIA_THR_ST ECU_ADDRESS 0xd00089fa FORMAT "%6.2" /end MEASUREMENT
/begin MEASUREMENT tia_thr_sub "Substitute value intake air temperature at throttle" UBYTE _CNV_A_R_LINEAR_____17_CM 1 100. -48. 142.5 DISPLAY_IDENTIFIER TIA_THR_SUB ECU_ADDRESS 0xd00089f7 FORMAT "%3.0" /end MEASUREMENT
/begin CHARACTERISTIC c_tia_thr_sub_bol "Lower TIA_THR substitute value" VALUE 0xa080c331 _REC_VAL_20_u1 28.575 _CNV_A_R_LINEAR_____17_CM -48. 142.5 DISPLAY_IDENTIFIER C_TIA_THR_SUB_BOL FORMAT "%5.1" /end CHARACTERISTIC
/begin CHARACTERISTIC c_tia_thr_sub_tol "Upper TIA_THR substitute value" VALUE 0xa080c332 _REC_VAL_20_u1 28.575 _CNV_A_R_LINEAR_____17_CM -48. 142.5 DISPLAY_IDENTIFIER C_TIA_THR_SUB_TOL FORMAT "%5.1" /end CHARACTERISTIC
/begin CHARACTERISTIC c_tia_thr_grd_max_diag "Maximum permissible gradient for TIA_THR" VALUE 0xa080c330 _REC_VAL_20_u1 28.575 _CNV_A_R_LINEAR_____25_CM 0. 190.5 DISPLAY_IDENTIFIER C_TIA_THR_GRD_MAX_DIAG FORMAT "%5.1" /end CHARACTERISTIC
/begin MEASUREMENT tia_thr "Intake air temperature at the throttle" UBYTE _CNV_A_R_LINEAR_____17_CM 1 100. -48. 142.5 DISPLAY_IDENTIFIER TIA_THR ECU_ADDRESS 0xd00089f6 FORMAT "%6.2" /end MEASUREMENT
/begin MEASUREMENT vp_tia_thr[0] "Voltage value of the intake air temperature sensor at throttle" UWORD _CNV_A_R_LINEAR_____172_CM 1 100. 0. 4.999847 DISPLAY_IDENTIFIER VP_TIA_THR[1] ECU_ADDRESS 0xd000a648 FORMAT "%7.5" /end MEASUREMENT
/begin MEASUREMENT vp_tia_thr[1] "Voltage value of the intake air temperature sensor at throttle" UWORD _CNV_A_R_LINEAR_____172_CM 1 100. 0. 4.999847 DISPLAY_IDENTIFIER VP_TIA_THR[2] ECU_ADDRESS 0xd000a64a FORMAT "%7.5" /end MEASUREMENT
/begin MEASUREMENT vp_tia[0] "Voltage value of the intake air temperature sensor" UWORD _CNV_A_R_LINEAR_____172_CM 1 100. 0. 4.999847 DISPLAY_IDENTIFIER VP_TIA[1] ECU_ADDRESS 0xd000a644 FORMAT "%7.5" /end MEASUREMENT
/begin MEASUREMENT vp_tia[1] "Voltage value of the intake air temperature sensor" UWORD _CNV_A_R_LINEAR_____172_CM 1 100. 0. 4.999847 DISPLAY_IDENTIFIER VP_TIA[2] ECU_ADDRESS 0xd000a646 FORMAT "%7.5" /end MEASUREMENT
/begin AXIS_PTS ldp_vp_tia_thr "" 0xa0809264 online_dummy _REC_AXS_20_u2 4.4998623 _CNV_A_R_LINEAR_____172_CM 16 0. 4.999847 FORMAT "%7.5" /end AXIS_PTS
/begin AXIS_PTS ldp_vp_tia_tia "" 0xa0809288 online_dummy _REC_AXS_20_u2 4.4998623 _CNV_A_R_LINEAR_____172_CM 16 0. 4.999847 FORMAT "%7.5" /end AXIS_PTS
/begin CHARACTERISTIC ip_tia_thr__vp_tia_thr "NTC characteristic, measuring point at throttle" CURVE 0xa080b6d4 _REC_CUR_20_u1_u2 28.575 _CNV_A_R_LINEAR_____17_CM -48. 142.5 DISPLAY_IDENTIFIER IP_TIA_THR__VP_TIA_THR FORMAT "%5.1"
 /begin AXIS_DESCR COM_AXIS online_dummy _CNV_A_R_LINEAR_____172_CM 16 0. 4.999847 FORMAT "%7.5" AXIS_PTS_REF ldp_vp_tia_thr /end AXIS_DESCR
/end CHARACTERISTIC
/begin CHARACTERISTIC ip_tia__vp_tia "NTC characteristic" CURVE 0xa080b6c4 _REC_CUR_20_u1_u2 28.575 _CNV_A_R_LINEAR_____17_CM -48. 142.5 DISPLAY_IDENTIFIER IP_TIA__VP_TIA FORMAT "%5.1"
 /begin AXIS_DESCR COM_AXIS online_dummy _CNV_A_R_LINEAR_____172_CM 16 0. 4.999847 FORMAT "%7.5" AXIS_PTS_REF ldp_vp_tia_tia /end AXIS_DESCR
/end CHARACTERISTIC
/begin CHARACTERISTIC ip_tq_loss_acc_inp "ACC torque loss due to engine-speed and ACC torque demand" MAP 0xa081693c _REC_MAP_20_u2_u1_u1 2047.96875 _CNV_A_R_LINEAR_____87_CM -1024. 1023.96875 DISPLAY_IDENTIFIER IP_TQ_LOSS_ACC_INP FORMAT "%6.2"
 /begin AXIS_DESCR COM_AXIS n_32 _CNV_A_R_LINEAR_____10_CM 6 0. 8160. FORMAT "%4.0" AXIS_PTS_REF ldp_n_32__tq_loss_acc /end AXIS_DESCR
 /begin AXIS_DESCR COM_AXIS tq_accin_can _CNV_A_R_LINEAR_____57_CM 6 0. 127.5 FORMAT "%5.2" AXIS_PTS_REF ldp_tq_accin_can__tq_loss_acc /end AXIS_DESCR
/end CHARACTERISTIC
/begin AXIS_PTS ldp_n_32__tq_loss_acc "" 0xa08089ca n_32 _REC_AXS_20_u1 8160. _CNV_A_R_LINEAR_____10_CM 6 0. 8160. FORMAT "%4.0" /end AXIS_PTS
/begin AXIS_PTS ldp_tq_accin_can__tq_loss_acc "" 0xa0808f4e tq_accin_can _REC_AXS_20_u1 127.5 _CNV_A_R_LINEAR_____57_CM 6 0. 127.5 FORMAT "%5.2" /end AXIS_PTS
/begin MEASUREMENT lv_err_bn_etcu "Present error BN2000" UBYTE _CNV_S_2_RANGE__0___1_CM 1 100. 0. 1. DISPLAY_IDENTIFIER LV_ERR_BN_ETCU ECU_ADDRESS 0xd0007f9e BIT_MASK 0x1 /end MEASUREMENT
/begin MEASUREMENT lv_err_bn_etcu_2 "Present error BN2000" UBYTE _CNV_S_2_RANGE__0___1_CM 1 100. 0. 1. DISPLAY_IDENTIFIER LV_ERR_BN_ETCU_2 ECU_ADDRESS 0xd0007f9f BIT_MASK 0x1 /end MEASUREMENT
/begin MEASUREMENT lv_err_bn_tq_amt "Present error BN2000" UBYTE _CNV_S_2_RANGE__0___1_CM 1 100. 0. 1. DISPLAY_IDENTIFIER LV_ERR_BN_TQ_AMT ECU_ADDRESS 0xd0007fa2 BIT_MASK 0x1 /end MEASUREMENT
/begin MEASUREMENT lv_err_bn_ars "Present error BN2000" UBYTE _CNV_S_2_RANGE__0___1_CM 1 100. 0. 1. DISPLAY_IDENTIFIER LV_ERR_BN_ARS ECU_ADDRESS 0xd0007f98 BIT_MASK 0x1 /end MEASUREMENT
/begin MEASUREMENT lv_err_bn_tq_tcs "Present error BN2000" UBYTE _CNV_S_2_RANGE__0___1_CM 1 100. 0. 1. DISPLAY_IDENTIFIER LV_ERR_BN_TQ_TCS ECU_ADDRESS 0xd0007f9a BIT_MASK 0x1 /end MEASUREMENT
/begin MEASUREMENT lv_err_bn_vs_tcs "Present error BN2000" UBYTE _CNV_S_2_RANGE__0___1_CM 1 100. 0. 1. DISPLAY_IDENTIFIER LV_ERR_BN_VS_TCS ECU_ADDRESS 0xd0007f9b BIT_MASK 0x1 /end MEASUREMENT
/begin MEASUREMENT lv_err_bn_tcs "Present error BN2000" UBYTE _CNV_S_2_RANGE__0___1_CM 1 100. 0. 1. DISPLAY_IDENTIFIER LV_ERR_BN_TCS ECU_ADDRESS 0xd0007f9c BIT_MASK 0x1 /end MEASUREMENT
/begin MEASUREMENT lv_err_tq_req_can "Torque request via CAN not plausible" UBYTE _CNV_S_2_RANGE__0___1_CM 1 100. 0. 1. DISPLAY_IDENTIFIER LV_ERR_TQ_REQ_CAN ECU_ADDRESS 0xd0007fc5 BIT_MASK 0x1 /end MEASUREMENT
/begin MEASUREMENT state_tq_can_plaus "" UBYTE _CNV_A_R_LINEAR_____0_CM 1 100. 0. 255. DISPLAY_IDENTIFIER STATE_TQ_CAN_PLAUS ECU_ADDRESS 0xd0008e48 FORMAT "%3.0" /end MEASUREMENT
/begin CHARACTERISTIC c_state_tq_can_plaus_ena "Mask for selective enabling of diagnoses" VALUE 0xa080c0f8 _REC_VAL_20_u1 255. _CNV_A_R_LINEAR_____0_CM 0. 255. DISPLAY_IDENTIFIER C_STATE_TQ_CAN_PLAUS_ENA FORMAT "%3.0" /end CHARACTERISTIC
/begin CHARACTERISTIC lc_tq_can_plaus_info "LC for selective information of diagnosis" VALUE 0xa080c605 _REC_VAL_20_u1 255. _CNV_A_R_LINEAR_____0_CM 0. 255. DISPLAY_IDENTIFIER LC_TQ_CAN_PLAUS_INFO FORMAT "%3.0" /end CHARACTERISTIC
/begin MEASUREMENT lv_err_bn_ang_pste "Present error BN2000" UBYTE _CNV_S_2_RANGE__0___1_CM 1 100. 0. 1. DISPLAY_IDENTIFIER LV_ERR_BN_ANG_PSTE ECU_ADDRESS 0xd0007fab BIT_MASK 0x1 /end MEASUREMENT
/begin MEASUREMENT lv_vb_jump "Boolean for  over voltage - ( Passive / Active )" UBYTE _CNV_S_2_RANGE__0___1_CM 1 100. 0. 1. DISPLAY_IDENTIFIER LV_VB_JUMP ECU_ADDRESS 0xd0008be1 BIT_MASK 0x1 /end MEASUREMENT
/begin CHARACTERISTIC c_crlc_vb "Low pass filter constant for VB_MMV" VALUE 0xa080bb17 _REC_VAL_20_u1 0.99609375 _CNV_A_R_LINEAR_____28_CM 0. 0.99609375 DISPLAY_IDENTIFIER C_CRLC_VB FORMAT "%5.3" /end CHARACTERISTIC
/begin MEASUREMENT vb_mmv "Moving mean value of battery voltage VB" UBYTE _CNV_A_R_LINEAR_____272_CM 1 100. 0. 25.8984375 DISPLAY_IDENTIFIER VB_MMV ECU_ADDRESS 0xd0008bde FORMAT "%9.6" /end MEASUREMENT
/begin MEASUREMENT lv_cdn_vb_obd1 "Boolean for battery voltage condition fullfilled for OBD-I diagnosis" UBYTE _CNV_S_2_RANGE__0___1_CM 1 100. 0. 1. DISPLAY_IDENTIFIER LV_CDN_VB_OBD1 ECU_ADDRESS 0xd0008be2 BIT_MASK 0x1 /end MEASUREMENT
/begin MEASUREMENT lv_cdn_vb_obd2 "Boolean for battery voltage condition fullfilled for OBD-II diagnosis" UBYTE _CNV_S_2_RANGE__0___1_CM 1 100. 0. 1. DISPLAY_IDENTIFIER LV_CDN_VB_OBD2 ECU_ADDRESS 0xd0008be3 BIT_MASK 0x1 /end MEASUREMENT
/begin CHARACTERISTIC c_vb_min_jump "VB-threshold for maximium permissible battery voltage" VALUE 0xa080c42c _REC_VAL_20_u1 7.76953125 _CNV_A_R_LINEAR_____272_CM 0. 25.8984375 DISPLAY_IDENTIFIER C_VB_MIN_JUMP FORMAT "%9.6" /end CHARACTERISTIC
/begin CHARACTERISTIC c_vb_min_obd2 "VB-threshold for minimum permissible battery voltage for OBD2-diagnosis" VALUE 0xa080c430 _REC_VAL_20_u1 7.76953125 _CNV_A_R_LINEAR_____272_CM 0. 25.8984375 DISPLAY_IDENTIFIER C_VB_MIN_OBD2 FORMAT "%9.6" /end CHARACTERISTIC
/begin CHARACTERISTIC c_vb_min_can_diag "Battery Voltage threshold for CAN diagnosis" VALUE 0xa080c428 _REC_VAL_20_u1 25.8984375 _CNV_A_R_LINEAR_____272_CM 0. 25.8984375 DISPLAY_IDENTIFIER C_VB_MIN_CAN_DIAG FORMAT "%9.6" /end CHARACTERISTIC
/begin MEASUREMENT vb "Relay - Battery Voltage" UBYTE _CNV_A_R_LINEAR_____272_CM 1 100. 0. 25.8984375 DISPLAY_IDENTIFIER VB ECU_ADDRESS 0xd0008bdc FORMAT "%9.6" /end MEASUREMENT
/begin MEASUREMENT vb_secu "Battery Voltage secured for dwell computation" UBYTE _CNV_A_R_LINEAR_____272_CM 1 100. 0. 25.8984375 DISPLAY_IDENTIFIER VB_SECU ECU_ADDRESS 0xd0001828 FORMAT "%9.6" /end MEASUREMENT
/begin MEASUREMENT v_igk "Key - Battery Voltage" UBYTE _CNV_A_R_LINEAR_____272_CM 1 100. 0. 25.8984375 DISPLAY_IDENTIFIER V_IGK ECU_ADDRESS 0xd0008bdd FORMAT "%9.6" /end MEASUREMENT
/begin MEASUREMENT lv_cdn_vb_min_diag "Boolean for battery voltage condition fullfilled for remaining diagnosis" UBYTE _CNV_S_2_RANGE__0___1_CM 1 100. 0. 1. DISPLAY_IDENTIFIER LV_CDN_VB_MIN_DIAG ECU_ADDRESS 0xd0008be6 BIT_MASK 0x1 /end MEASUREMENT
/begin CHARACTERISTIC c_vb_max_obd1 "VB-threshold for maximium permissible battery voltage for OBD1-diagnosis" VALUE 0xa080c420 _REC_VAL_20_u1 7.76953125 _CNV_A_R_LINEAR_____272_CM 0. 25.8984375 DISPLAY_IDENTIFIER C_VB_MAX_OBD1 FORMAT "%9.6" /end CHARACTERISTIC
/begin CHARACTERISTIC c_vb_min_obd1 "VB-threshold for minimum permissible battery voltage for OBD1-diagnosis" VALUE 0xa080c42f _REC_VAL_20_u1 7.76953125 _CNV_A_R_LINEAR_____272_CM 0. 25.8984375 DISPLAY_IDENTIFIER C_VB_MIN_OBD1 FORMAT "%9.6" /end CHARACTERISTIC
/begin CHARACTERISTIC c_vb_max_obd2 "VB-threshold for maximium permissible battery voltage for OBD2-diagnosis" VALUE 0xa080c421 _REC_VAL_20_u1 7.76953125 _CNV_A_R_LINEAR_____272_CM 0. 25.8984375 DISPLAY_IDENTIFIER C_VB_MAX_OBD2 FORMAT "%9.6" /end CHARACTERISTIC
/begin CHARACTERISTIC c_t_min_can_diag "VB time condition - diagnosis of timeout CAN messages" VALUE 0xa080c20c _REC_VAL_20_u1 2550. _CNV_A_R_LINEAR_____20_CM 0. 2550. DISPLAY_IDENTIFIER C_T_MIN_CAN_DIAG FORMAT "%4.0" /end CHARACTERISTIC
/begin CHARACTERISTIC c_vb_min_diag "Battery Voltage threshold for low voltage detection for remaining diagnosis" VALUE 0xa080c42a _REC_VAL_20_u1 7.76953125 _CNV_A_R_LINEAR_____272_CM 0. 25.8984375 DISPLAY_IDENTIFIER C_VB_MIN_DIAG FORMAT "%9.6" /end CHARACTERISTIC
/begin MEASUREMENT lv_cdn_vb_can_diag "Boolean for battery voltage condition fullfilled for CAN diagnosis" UBYTE _CNV_S_2_RANGE__0___1_CM 1 100. 0. 1. DISPLAY_IDENTIFIER LV_CDN_VB_CAN_DIAG ECU_ADDRESS 0xd0008be4 BIT_MASK 0x1 /end MEASUREMENT
/begin MEASUREMENT lv_wake_up "Wake up signal detected" UBYTE _CNV_S_2_RANGE__0___1_CM 1 100. 0. 1. DISPLAY_IDENTIFIER LV_WAKE_UP ECU_ADDRESS 0xd0008be8 BIT_MASK 0x1 /end MEASUREMENT
/begin CHARACTERISTIC c_vb_min_bn_diag "Battery Voltage threshold for BN2000 diagnosis" VALUE 0xa080c426 _REC_VAL_20_u1 7.76953125 _CNV_A_R_LINEAR_____272_CM 0. 25.8984375 DISPLAY_IDENTIFIER C_VB_MIN_BN_DIAG FORMAT "%9.6" /end CHARACTERISTIC
/begin MEASUREMENT lv_cdn_vb_bn_diag "Boolean for battery voltage condition fullfilled for BN2000 diagnosis" UBYTE _CNV_S_2_RANGE__0___1_CM 1 100. 0. 1. DISPLAY_IDENTIFIER LV_CDN_VB_BN_DIAG ECU_ADDRESS 0xd0008be5 BIT_MASK 0x1 /end MEASUREMENT
/begin MEASUREMENT lv_igk "Boolean for ignition key status - ( Passive / Active )" UBYTE _CNV_S_2_RANGE__0___1_CM 1 100. 0. 1. DISPLAY_IDENTIFIER LV_IGK ECU_ADDRESS 0xd0008be0 BIT_MASK 0x1 /end MEASUREMENT
/begin MEASUREMENT state_plaus_igk_bn "state plausibility IGK - signal via CAN/via HW  (BN2000 only)" UBYTE _CNV_A_R_LINEAR_____0_CM 1 100. 0. 8. DISPLAY_IDENTIFIER STATE_PLAUS_IGK_BN ECU_ADDRESS 0xd0008bdf FORMAT "%2.0" /end MEASUREMENT
/begin MEASUREMENT lv_igk_prel "Preliminary ignition flag for ignition switch off" UBYTE _CNV_S_2_RANGE__0___1_CM 1 100. 0. 1. DISPLAY_IDENTIFIER LV_IGK_PREL ECU_ADDRESS 0xd0008be9 BIT_MASK 0x1 /end MEASUREMENT
/begin MEASUREMENT lv_cdn_vb_can_tq_diag "Boolean for battery voltage condition fullfilled for BN2000 diagnosis" UBYTE _CNV_S_2_RANGE__0___1_CM 1 100. 0. 1. DISPLAY_IDENTIFIER LV_CDN_VB_CAN_TQ_DIAG ECU_ADDRESS 0xd0008be7 BIT_MASK 0x1 /end MEASUREMENT
/begin CHARACTERISTIC c_vb_min_can_tq_diag "Battery Voltage threshold for CAN_TQ interfaces" VALUE 0xa080c429 _REC_VAL_20_u1 25.8984375 _CNV_A_R_LINEAR_____272_CM 0. 25.8984375 DISPLAY_IDENTIFIER C_VB_MIN_CAN_TQ_DIAG FORMAT "%9.6" /end CHARACTERISTIC
/begin MEASUREMENT vs_edge_av.edge_ctr "actual value of vehicle speed tooth counter" UWORD _CNV_A_R_LINEAR_____0_CM 1 100. 0. 65535. DISPLAY_IDENTIFIER VS_EDGE_CTR_AV ECU_ADDRESS 0xd000a7a4 FORMAT "%5.0" /end MEASUREMENT
/begin MEASUREMENT vs_edge_av.edge_t "actual timestamp of last tooth" ULONG _CNV_A_R_LINEAR_____273_CM 1 100. 0. 34359738.36 DISPLAY_IDENTIFIER VS_EDGE_T_AV ECU_ADDRESS 0xd000a7a6 FORMAT "%12.3" /end MEASUREMENT
/begin CHARACTERISTIC c_vs_min_run "minimum vehicle speed for detection of running vehicle" VALUE 0xa080c4ea _REC_VAL_20_u1 25.5 _CNV_A_R_LINEAR_____6_CM 0. 255. DISPLAY_IDENTIFIER C_VS_MIN_RUN FORMAT "%3.0" /end CHARACTERISTIC
/begin MEASUREMENT lv_vs_run "Boolean for running vehicle" UBYTE _CNV_S_2_RANGE__0___1_CM 1 100. 0. 1. DISPLAY_IDENTIFIER LV_VS_RUN ECU_ADDRESS 0xd0008bed BIT_MASK 0x1 /end MEASUREMENT
/begin CHARACTERISTIC c_t_vst "Time delay for detection of vehicle speed" VALUE 0xa080c2a4 _REC_VAL_20_u1 19. _CNV_A_R_LINEAR_____20_CM 10. 200. DISPLAY_IDENTIFIER C_T_VST FORMAT "%3.0" /end CHARACTERISTIC
/begin CHARACTERISTIC c_vs_edge_sum_min "Minimum number of wheel segments for evaluation of vehicle speedy gonzales" VALUE 0xa080c4b7 _REC_VAL_20_u1 25.4 _CNV_A_R_LINEAR_____0_CM 1. 255. DISPLAY_IDENTIFIER C_VS_EDGE_SUM_MIN FORMAT "%3.0" /end CHARACTERISTIC
/begin MEASUREMENT vs_sens "vehicle speed calculated from vehicle speed sensor" UWORD _CNV_A_R_LINEAR_____86_CM 1 100. 0. 511.99218 DISPLAY_IDENTIFIER VS_SENS ECU_ADDRESS 0xd000a7aa FORMAT "%7.3" /end MEASUREMENT
/begin MEASUREMENT vs_sens_grd "Vehicle speed gradient calculated from VS_SENS" SWORD _CNV_A_R_LINEAR_____274_CM 1 100. -256. 255.9921875 DISPLAY_IDENTIFIER VS_SENS_GRD ECU_ADDRESS 0xd0001852 FORMAT "%8.3" /end MEASUREMENT
/begin MEASUREMENT lv_vst "boolean for stopped vehicle" UBYTE _CNV_S_2_RANGE__0___1_CM 1 100. 0. 1. DISPLAY_IDENTIFIER LV_VST ECU_ADDRESS 0xd000185c BIT_MASK 0x1 /end MEASUREMENT
/begin CHARACTERISTIC c_vs_fac "" VALUE 0xa080c4ba _REC_VAL_20_u4 0.291271 _CNV_A_R_LINEAR_____275_CM 0. 0.291271 DISPLAY_IDENTIFIER C_VS_FAC FORMAT "%10.9" /end CHARACTERISTIC
/begin MEASUREMENT vs "vehicle speed" UBYTE _CNV_A_R_LINEAR_____6_CM 1 100. 0. 255. DISPLAY_IDENTIFIER VS ECU_ADDRESS 0xd0008bec FORMAT "%3.0" /end MEASUREMENT
/begin MEASUREMENT vs_h "vehicle speed high range" UWORD _CNV_A_R_LINEAR_____86_CM 1 100. 0. 511.99218 DISPLAY_IDENTIFIER VS_H ECU_ADDRESS 0xd000a7ac FORMAT "%7.3" /end MEASUREMENT
/begin MEASUREMENT vs_edge_t_av_dif "actual timestamp difference" ULONG _CNV_A_R_LINEAR_____273_CM 1 100. 0. 34359738.36 DISPLAY_IDENTIFIER VS_EDGE_T_AV_DIF ECU_ADDRESS 0xd0001854 FORMAT "%12.3" /end MEASUREMENT
/begin MEASUREMENT vs_edge_t_av_max "actual maximum timestamp of last tooth" ULONG _CNV_A_R_LINEAR_____273_CM 1 100. 0. 34359738.36 DISPLAY_IDENTIFIER VS_EDGE_T_AV_MAX ECU_ADDRESS 0xd0001858 FORMAT "%12.3" /end MEASUREMENT
/begin MEASUREMENT dist "Distance accumulation [100m]" ULONG _CNV_A_R_LINEAR_____434_CM 1 100. 0. 429496729500. DISPLAY_IDENTIFIER DIST ECU_ADDRESS 0xd000ba2c FORMAT "%13.0" /end MEASUREMENT
/begin MEASUREMENT lv_err_plaus_igk_bn "plausibility error of IGK-signal from CAN/HW" UBYTE _CNV_S_2_RANGE__0___1_CM 1 100. 0. 1. DISPLAY_IDENTIFIER LV_ERR_PLAUS_IGK_BN ECU_ADDRESS 0xd0007fc4 BIT_MASK 0x1 /end MEASUREMENT
/begin MEASUREMENT put[0] "Pressure upstream the throttle (Turbo)" UWORD _CNV_A_R_LINEAR_____27_CM 1 100. 0. 5434. DISPLAY_IDENTIFIER PUT[1] ECU_ADDRESS 0xd000a460 FORMAT "%7.2" /end MEASUREMENT
/begin MEASUREMENT put[1] "Pressure upstream the throttle (Turbo)" UWORD _CNV_A_R_LINEAR_____27_CM 1 100. 0. 5434. DISPLAY_IDENTIFIER PUT[2] ECU_ADDRESS 0xd000a462 FORMAT "%7.2" /end MEASUREMENT
/begin MEASUREMENT put_max "Maximum possible pressure upstream throttle" UWORD _CNV_A_R_LINEAR_____27_CM 1 100. 0. 5434. DISPLAY_IDENTIFIER PUT_MAX ECU_ADDRESS 0xd000a464 FORMAT "%7.2" /end MEASUREMENT
/begin CHARACTERISTIC ip_amp_dec "pressure decrease in the air cleaner" CURVE 0xa0809f7c _REC_CUR_20_u2_u2 5434. _CNV_A_R_LINEAR_____27_CM 0. 5434. DISPLAY_IDENTIFIER IP_AMP_DEC FORMAT "%7.2"
 /begin AXIS_DESCR COM_AXIS maf_thr _CNV_A_R_LINEAR_____215_CM 4 0. 2047.96875 FORMAT "%6.2" AXIS_PTS_REF ldp_maf_thr_ip_amp_dec /end AXIS_DESCR
/end CHARACTERISTIC
/begin AXIS_PTS ldp_maf_thr_ip_amp_dec "" 0xa08088f4 maf_thr _REC_AXS_20_u2 2047.96875 _CNV_A_R_LINEAR_____215_CM 4 0. 2047.96875 FORMAT "%6.2" /end AXIS_PTS
/begin MEASUREMENT toil "Oil temperature" UBYTE _CNV_A_R_LINEAR_____26_CM 1 100. -40. 160. DISPLAY_IDENTIFIER TOIL ECU_ADDRESS 0xd0008709 FORMAT "%3.0" /end MEASUREMENT
/begin MEASUREMENT toil_stop "Oil temperature at transition to ES" UBYTE _CNV_A_R_LINEAR_____26_CM 1 100. -40. 160. DISPLAY_IDENTIFIER TOIL_STOP ECU_ADDRESS 0xd000870a FORMAT "%3.0" /end MEASUREMENT
/begin CHARACTERISTIC c_toil_sub_diag "Substitude value for TOIL" VALUE 0xa080c34f _REC_VAL_20_u1 200. _CNV_A_R_LINEAR_____26_CM -40. 160. DISPLAY_IDENTIFIER C_TOIL_SUB_DIAG FORMAT "%3.0" /end CHARACTERISTIC
/begin MEASUREMENT egr_ratio "MAF_EGR/MAF_CYL" UWORD _CNV_A_R_LINEAR_____8_CM 1 100. 0. 99.99847412109381 DISPLAY_IDENTIFIER EGR_RATIO ECU_ADDRESS 0xd00072d2 /end MEASUREMENT
/begin MEASUREMENT maf_cyl "Mass air flow out of intake manifold" UWORD _CNV_A_R_LINEAR_____215_CM 1 100. 0. 2047.96875 DISPLAY_IDENTIFIER MAF_CYL ECU_ADDRESS 0xd00072da FORMAT "%7.2" /end MEASUREMENT
/begin MEASUREMENT map "Manifold air pressure" UWORD _CNV_A_R_LINEAR_____27_CM 1 100. 0. 5434. DISPLAY_IDENTIFIER MAP ECU_ADDRESS 0xd00072de FORMAT "%7.2" /end MEASUREMENT
/begin MEASUREMENT maf "Air mass (predicted) for calculation of basic fuel injection" UWORD _CNV_A_R_LINEAR_____111_CM 1 100. 0. 1389. DISPLAY_IDENTIFIER MAF ECU_ADDRESS 0xd00072e6 FORMAT "%6.2" /end MEASUREMENT
/begin CHARACTERISTIC lc_maf_tcha_mes "Switch for calculation of Mshfm_ist/m by model (0) or by sensor (1), only for N54" VALUE 0xa080c5a7 _REC_VAL_20_u1 1. _CNV_A_R_LINEAR_____0_CM 0. 1. DISPLAY_IDENTIFIER LC_MAF_TCHA_MES FORMAT "%1.0" /end CHARACTERISTIC
/begin CHARACTERISTIC c_fac_maf_tcha "Factor for conversion of mass air flow from one to two banks" VALUE 0xa080bcde _REC_VAL_20_u2 3.99993896484375 _CNV_A_R_LINEAR_____24_CM 0. 3.99993896484375 DISPLAY_IDENTIFIER C_FAC_MAF_TCHA FORMAT "%7.5" /end CHARACTERISTIC
/begin MEASUREMENT maf_thr "theoretical value of air mass flow [kg/h]" UWORD _CNV_A_R_LINEAR_____215_CM 1 100. 0. 2047.96875 DISPLAY_IDENTIFIER MAF_THR ECU_ADDRESS 0xd00072e8 FORMAT "%7.2" /end MEASUREMENT
/begin MEASUREMENT maf_scav_ext "Delta RF" UWORD _CNV_A_R_LINEAR_____111_CM 1 100. 0. 1389. DISPLAY_IDENTIFIER MAF_SCAV_EXT ECU_ADDRESS 0xd00072ea FORMAT "%7.2" /end MEASUREMENT
/begin MEASUREMENT pv_max "Maximum selection of pedal value interpretation" UBYTE _CNV_A_R_LINEAR_____5_CM 1 100. 0. 99.609375 DISPLAY_IDENTIFIER PV_MAX ECU_ADDRESS 0xd0008684 FORMAT "%3.1" /end MEASUREMENT
/begin MEASUREMENT pv_av "Corrected pedal value interpretation" UBYTE _CNV_A_R_LINEAR_____5_CM 1 100. 0. 99.609375 DISPLAY_IDENTIFIER PV_AV ECU_ADDRESS 0xd0008686 FORMAT "%3.1" /end MEASUREMENT
/begin MEASUREMENT pv_cru "Pedal value interpretation of Cruise control" UBYTE _CNV_A_R_LINEAR_____5_CM 1 100. 0. 99.609375 DISPLAY_IDENTIFIER PV_CRU ECU_ADDRESS 0xd0008685 FORMAT "%4.1" /end MEASUREMENT
/begin MEASUREMENT pv_av_grd "Pedal value gradient" UBYTE _CNV_A_R_LINEAR_____535_CM 1 100. -1250. 1240.234 DISPLAY_IDENTIFIER PV_AV_GRD ECU_ADDRESS 0xd0008687 FORMAT "%6.1" /end MEASUREMENT
/begin MEASUREMENT fac_maf_max "Ratio between MAF und MAX_COR" UWORD _CNV_A_R_LINEAR_____9_CM 1 100. 0. 1.99996948242188 DISPLAY_IDENTIFIER FAC_MAF_MAX ECU_ADDRESS 0xd000a448 FORMAT "%7.5" /end MEASUREMENT
/begin MEASUREMENT pq_egr "Pressure quotient at the EGR - valve" UWORD _CNV_A_R_LINEAR_____89_CM 1 100. 0. 0.9999847412109381 DISPLAY_IDENTIFIER PQ_EGR ECU_ADDRESS 0xd000a44a FORMAT "%7.5" /end MEASUREMENT
/begin MEASUREMENT maf_fg_cyl "Fresh air mass flow in the cylinder" UWORD _CNV_A_R_LINEAR_____215_CM 1 100. 0. 2047.96875 DISPLAY_IDENTIFIER MAF_FG_CYL ECU_ADDRESS 0xd000a44c FORMAT "%7.2" /end MEASUREMENT
/begin MEASUREMENT t_absv_com "Absolut life time of vehicle received from bus communication" ULONG _CNV_A_R_LINEAR_____36_CM 1 100. 0. 4294967294. DISPLAY_IDENTIFIER T_ABSV_COM ECU_ADDRESS 0xd000ad94 FORMAT "%11.0" /end MEASUREMENT
/begin MEASUREMENT tq_loss_cord_av "actual TQ loss caused by chassis consumers" SWORD _CNV_A_R_LINEAR_____31_CM 1 100. -1024. 1023.96875 DISPLAY_IDENTIFIER TQ_LOSS_CORD_AV ECU_ADDRESS 0xd000a0b4 FORMAT "%8.2" /end MEASUREMENT
/begin MEASUREMENT tq_loss_cord_sp "expected TQ loss caused by chassis consumers" SWORD _CNV_A_R_LINEAR_____31_CM 1 100. -1024. 1023.96875 DISPLAY_IDENTIFIER TQ_LOSS_CORD_SP ECU_ADDRESS 0xd000a0b6 FORMAT "%8.2" /end MEASUREMENT
/begin MEASUREMENT tq_loss_cord_pred "predicted TQ loss caused by chassis consumers" SWORD _CNV_A_R_LINEAR_____31_CM 1 100. -1024. 1023.96875 DISPLAY_IDENTIFIER TQ_LOSS_CORD_PRED ECU_ADDRESS 0xd000a0b8 FORMAT "%8.2" /end MEASUREMENT
/begin MEASUREMENT tq_loss_cord_max "maximum TQ loss caused by chassis consumers" SWORD _CNV_A_R_LINEAR_____31_CM 1 100. -1024. 1023.96875 DISPLAY_IDENTIFIER TQ_LOSS_CORD_MAX ECU_ADDRESS 0xd000a0ba FORMAT "%8.2" /end MEASUREMENT
/begin MEASUREMENT tq_wheel_driv_asi "Requested TQ wheel from driver assistant system" SWORD _CNV_A_R_LINEAR_____64_CM 1 100. -32768. 32767. DISPLAY_IDENTIFIER TQ_WHEEL_DRIV_ASI ECU_ADDRESS 0xd000a0bc FORMAT "%6.0" /end MEASUREMENT
/begin MEASUREMENT v_teg_tur_up[0] "Voltage exhaust gas temperatur upstream of turbo charger" UWORD _CNV_A_R_LINEAR_____172_CM 1 100. 0. 4.999847 DISPLAY_IDENTIFIER V_TEG_TUR_UP[0] ECU_ADDRESS 0xd000a664 FORMAT "%6.4" /end MEASUREMENT
/begin MEASUREMENT v_teg_tur_up[1] "Voltage exhaust gas temperatur upstream of turbo charger" UWORD _CNV_A_R_LINEAR_____172_CM 1 100. 0. 4.999847 DISPLAY_IDENTIFIER V_TEG_TUR_UP[1] ECU_ADDRESS 0xd000a666 FORMAT "%6.4" /end MEASUREMENT
/begin MEASUREMENT v_teg_tur_up_mmv[0] "Voltage exhaust gas temperatur meanvalue upstream of turbo charger" UWORD _CNV_A_R_LINEAR_____172_CM 1 100. 0. 4.999847 DISPLAY_IDENTIFIER V_TEG_TUR_UP_MMV[0] ECU_ADDRESS 0xd000a660 FORMAT "%6.4" /end MEASUREMENT
/begin MEASUREMENT v_teg_tur_up_mmv[1] "Voltage exhaust gas temperatur meanvalue upstream of turbo charger" UWORD _CNV_A_R_LINEAR_____172_CM 1 100. 0. 4.999847 DISPLAY_IDENTIFIER V_TEG_TUR_UP_MMV[1] ECU_ADDRESS 0xd000a662 FORMAT "%6.4" /end MEASUREMENT
/begin MEASUREMENT teg_tur_up_mes[0] "measured exhaust gas temperature upstream of turbo charger" UWORD _CNV_A_R_LINEAR_____925_CM 1 100. -273.15 1773.85 DISPLAY_IDENTIFIER TEG_TUR_UP_MES[0] ECU_ADDRESS 0xd000a65c FORMAT "%8.3" /end MEASUREMENT
/begin MEASUREMENT teg_tur_up_mes[1] "measured exhaust gas temperature upstream of turbo charger" UWORD _CNV_A_R_LINEAR_____925_CM 1 100. -273.15 1773.85 DISPLAY_IDENTIFIER TEG_TUR_UP_MES[1] ECU_ADDRESS 0xd000a65e FORMAT "%8.3" /end MEASUREMENT
/begin MEASUREMENT state_swi_gear "State of Schaltpaddel for changing gears ( get via CAN and sent to gear box )" UBYTE _CNV_A_R_LINEAR_____0_CM 1 100. 0. 15. DISPLAY_IDENTIFIER STATE_SWI_GEAR ECU_ADDRESS 0xd00085f0 FORMAT "%2.0" /end MEASUREMENT
/begin MEASUREMENT tq_wheel_tcs_slow "Target wheel torque on powertrain for slow stabilization" SWORD _CNV_A_R_LINEAR_____446_CM 1 100. -32768. 32767. DISPLAY_IDENTIFIER TQ_WHEEL_TCS_SLOW ECU_ADDRESS 0xd000a0a4 FORMAT "%6.0" /end MEASUREMENT
/begin MEASUREMENT tq_wheel_tcs_fast "Target wheel torque on powertrain for slow stabilization" SWORD _CNV_A_R_LINEAR_____446_CM 1 100. -32768. 32767. DISPLAY_IDENTIFIER TQ_WHEEL_TCS_FAST ECU_ADDRESS 0xd000a0a6 FORMAT "%6.0" /end MEASUREMENT
/begin MEASUREMENT tqb_sum_tcs "Actual-value to braking-torque" SWORD _CNV_A_R_LINEAR_____446_CM 1 100. -32768. 32767. DISPLAY_IDENTIFIER TQB_SUM_TCS ECU_ADDRESS 0xd000a0a8 FORMAT "%6.0" /end MEASUREMENT
/begin MEASUREMENT n_wheel_re_le "Actual-value for RPM wheel rear left" SWORD _CNV_A_R_LINEAR_____930_CM 1 100. -512. 511.98 DISPLAY_IDENTIFIER N_WHEEL_RE_LE ECU_ADDRESS 0xd000a0aa FORMAT "%7.2" /end MEASUREMENT
/begin MEASUREMENT n_wheel_re_ri "Actual-value for RPM wheel rear right" SWORD _CNV_A_R_LINEAR_____930_CM 1 100. -512. 511.98 DISPLAY_IDENTIFIER N_WHEEL_RE_RI ECU_ADDRESS 0xd000a0ac FORMAT "%7.2" /end MEASUREMENT
/begin MEASUREMENT n_wheel_fn_le "Actual-value for RPM wheel front left" SWORD _CNV_A_R_LINEAR_____930_CM 1 100. -512. 511.98 DISPLAY_IDENTIFIER N_WHEEL_FN_LE ECU_ADDRESS 0xd000a0ae FORMAT "%7.2" /end MEASUREMENT
/begin MEASUREMENT n_wheel_fn_ri "Actual-value for RPM wheel front right" SWORD _CNV_A_R_LINEAR_____930_CM 1 100. -512. 511.98 DISPLAY_IDENTIFIER N_WHEEL_FN_RI ECU_ADDRESS 0xd000a0b0 FORMAT "%7.2" /end MEASUREMENT
/begin COMPU_METHOD _CNV_A_R_LINEAR_____0_CM "" RAT_FUNC "%6.3" "-" COEFFS 0 1. 0. 0 0 1 /end COMPU_METHOD
/begin COMPU_METHOD _CNV_S_2_RANGE__0___1_CM "" TAB_VERB "%6.3" "-" COMPU_TAB_REF _CNV_S_2_RANGE__0___1 /end COMPU_METHOD
/begin COMPU_VTAB _CNV_S_2_RANGE__0___1 "" TAB_VERB 2 0 "0" 1 "1" /end COMPU_VTAB
/begin COMPU_METHOD _CNV_A_R_LINEAR_____2_CM "" RAT_FUNC "%6.3" "V" COEFFS 0 204.8 0. 0 0 1 /end COMPU_METHOD
/begin COMPU_METHOD _CNV_A_R_LINEAR_____3_CM "" RAT_FUNC "%6.3" "s" COEFFS 0 100. 0. 0 0 1 /end COMPU_METHOD
/begin COMPU_METHOD _CNV_A_R_LINEAR_____4_CM "" RAT_FUNC "%6.3" "s" COEFFS 0 10. 0. 0 0 1 /end COMPU_METHOD
/begin COMPU_METHOD _CNV_A_R_LINEAR_____5_CM "" RAT_FUNC "%6.3" "%" COEFFS 0 2.56 0. 0 0 1 /end COMPU_METHOD
/begin COMPU_METHOD _CNV_A_R_LINEAR_____6_CM "" RAT_FUNC "%6.3" "km/h" COEFFS 0 1. 0. 0 0 1 /end COMPU_METHOD
/begin COMPU_METHOD _CNV_A_R_LINEAR_____8_CM "" RAT_FUNC "%6.3" "%" COEFFS 0 655.3599999999997 0. 0 0 1 /end COMPU_METHOD
/begin COMPU_METHOD _CNV_A_R_LINEAR_____9_CM "" RAT_FUNC "%6.3" "-" COEFFS 0 32767.99999999992 0. 0 0 1 /end COMPU_METHOD
/begin COMPU_METHOD _CNV_A_R_LINEAR_____10_CM "" RAT_FUNC "%6.3" "rpm" COEFFS 0 3.125e-002 0. 0 0 1 /end COMPU_METHOD
/begin COMPU_METHOD _CNV_A_R_LINEAR_____14_CM "" RAT_FUNC "%6.3" "rpm" COEFFS 0 1. 0. 0 0 1 /end COMPU_METHOD
/begin COMPU_METHOD _CNV_A_R_LINEAR_____15_CM "" RAT_FUNC "%6.3" "mg/stk" COEFFS 0 0.183585313174946 0. 0 0 1 /end COMPU_METHOD
/begin COMPU_METHOD _CNV_A_R_LINEAR_____17_CM "" RAT_FUNC "%6.3" "°C" COEFFS 0 1.333333333333333 64. 0 0 1 /end COMPU_METHOD
/begin COMPU_METHOD _CNV_A_R_LINEAR_____18_CM "" RAT_FUNC "%6.3" "-" COEFFS 0 255.9983911655618 0. 0 0 1 /end COMPU_METHOD
/begin COMPU_METHOD _CNV_A_R_LINEAR_____20_CM "" RAT_FUNC "%6.3" "ms" COEFFS 0 0.1 0. 0 0 1 /end COMPU_METHOD
/begin COMPU_METHOD _CNV_A_R_LINEAR_____24_CM "" RAT_FUNC "%6.3" "-" COEFFS 0 16384. 0. 0 0 1 /end COMPU_METHOD
/begin COMPU_METHOD _CNV_A_R_LINEAR_____25_CM "" RAT_FUNC "%6.3" "°C" COEFFS 0 1.333333333333333 0. 0 0 1 /end COMPU_METHOD
/begin COMPU_METHOD _CNV_A_R_LINEAR_____26_CM "" RAT_FUNC "%6.3" "°C" COEFFS 0 1. 40. 0 0 1 /end COMPU_METHOD
/begin COMPU_METHOD _CNV_A_R_LINEAR_____27_CM "" RAT_FUNC "%6.3" "hPa" COEFFS 0 12.06017666543982 0. 0 0 1 /end COMPU_METHOD
/begin COMPU_METHOD _CNV_A_R_LINEAR_____28_CM "" RAT_FUNC "%6.3" "-" COEFFS 0 256. 0. 0 0 1 /end COMPU_METHOD
/begin COMPU_METHOD _CNV_A_R_LINEAR_____31_CM "" RAT_FUNC "%6.3" "Nm" COEFFS 0 32. 0. 0 0 1 /end COMPU_METHOD
/begin COMPU_METHOD _CNV_S_3_STATE_ARS__32_CM "" TAB_VERB "%6.3" "" COMPU_TAB_REF _CNV_S_3_STATE_ARS__32 /end COMPU_METHOD
/begin COMPU_VTAB _CNV_S_3_STATE_ARS__32 "" TAB_VERB 3 0 "INACTIVE" 1 "ACTIVE" 3 "INVALID SIGNAL" /end COMPU_VTAB
/begin COMPU_METHOD _CNV_S_3_STATE_IGK__33_CM "" TAB_VERB "%6.3" "" COMPU_TAB_REF _CNV_S_3_STATE_IGK__33 /end COMPU_METHOD
/begin COMPU_VTAB _CNV_S_3_STATE_IGK__33 "" TAB_VERB 3 0 "IGK OFF" 1 "IGK ON" 2 "INVALID SIGNAL" /end COMPU_VTAB
/begin COMPU_METHOD _CNV_S_4_STATE_TCS__34_CM "" TAB_VERB "%6.3" "" COMPU_TAB_REF _CNV_S_4_STATE_TCS__34 /end COMPU_METHOD
/begin COMPU_VTAB _CNV_S_4_STATE_TCS__34 "" TAB_VERB 4 0 "NO INTERVENTION" 1 "MSR INTERVENTION" 2 "ASR INTERVENTION" 3 "INTERFACE LOCKED" /end COMPU_VTAB
/begin COMPU_METHOD _CNV_S_3_STATE_WAL__35_CM "" TAB_VERB "%6.3" "" COMPU_TAB_REF _CNV_S_3_STATE_WAL__35 /end COMPU_METHOD
/begin COMPU_VTAB _CNV_S_3_STATE_WAL__35 "" TAB_VERB 3 0 "OFF" 1 "YELLOW" 3 "signal invalid" /end COMPU_VTAB
/begin COMPU_METHOD _CNV_A_R_LINEAR_____36_CM "" RAT_FUNC "%6.3" "s" COEFFS 0 1. 0. 0 0 1 /end COMPU_METHOD
/begin COMPU_METHOD _CNV_A_R_LINEAR_____37_CM "" RAT_FUNC "%6.3" "V" COEFFS 0 9.807692307692308 0. 0 0 1 /end COMPU_METHOD
/begin COMPU_METHOD _CNV_A_R_LINEAR_____38_CM "" RAT_FUNC "%6.3" "Day" COEFFS 0 1. 0. 0 0 1 /end COMPU_METHOD
/begin COMPU_METHOD _CNV_S_10_STATE_TCS__39_CM "" TAB_VERB "%6.3" "" COMPU_TAB_REF _CNV_S_10_STATE_TCS__39 /end COMPU_METHOD
/begin COMPU_VTAB _CNV_S_10_STATE_TCS__39 "" TAB_VERB 10 0 "NO_CONTROL" 1 "ABS_CONTROL" 2 "ASR_CONTROL" 4 "TCS_CONTROL" 8 "HBA_CONTROL" 16 "MSR_CONTROL" 32 "EBV_CONTROL" 64 "DYNO_ACTIVE" 254 "MULTI_CONTROL" 255 "SIGNAL INVALID" /end COMPU_VTAB
/begin COMPU_METHOD _CNV_S_5_STATE_TCS__40_CM "" TAB_VERB "%6.3" "" COMPU_TAB_REF _CNV_S_5_STATE_TCS__40 /end COMPU_METHOD
/begin COMPU_VTAB _CNV_S_5_STATE_TCS__40 "" TAB_VERB 5 0 "NO_INTERVENTION" 1 "DCC_INTV_ACCEPTED" 2 "EMF_INTV_ACCEPTED" 3 "HBA_INTV_ACCEPTED" 15 "SIGNAL INVALID" /end COMPU_VTAB
/begin COMPU_METHOD _CNV_A_R_LINEAR_____41_CM "" RAT_FUNC "%6.3" "m/s²" COEFFS 0 640. 0. 0 0 1 /end COMPU_METHOD
/begin COMPU_METHOD _CNV_S_5_STATE_MOD__42_CM "" TAB_VERB "%6.3" "" COMPU_TAB_REF _CNV_S_5_STATE_MOD__42 /end COMPU_METHOD
/begin COMPU_VTAB _CNV_S_5_STATE_MOD__42 "" TAB_VERB 5 0 "SSC_SBC_OFF" 1 "SSC_ON" 2 "SBC_ON" 3 "SSC_SBC_ON" 7 "INVALID_SIGNAL" /end COMPU_VTAB
/begin COMPU_METHOD _CNV_S_6_STATE_TCS__43_CM "" TAB_VERB "%6.3" "" COMPU_TAB_REF _CNV_S_6_STATE_TCS__43 /end COMPU_METHOD
/begin COMPU_VTAB _CNV_S_6_STATE_TCS__43 "" TAB_VERB 6 0 "VALID" 1 "PASSIV" 2 "DEFECTIVE" 4 "TRACTION MODE" 6 "UNDERVOLTAGE_TCS" 7 "INVALID SIGNAL" /end COMPU_VTAB
/begin COMPU_METHOD _CNV_S_4_STATE_TEMP_44_CM "" TAB_VERB "%6.3" "" COMPU_TAB_REF _CNV_S_4_STATE_TEMP_44 /end COMPU_METHOD
/begin COMPU_VTAB _CNV_S_4_STATE_TEMP_44 "" TAB_VERB 4 0 "NO_REQUEST" 1 "ACTIVE_STEP_1" 2 "ACTIVE_STEP_2" 3 "INVALID_SIGNAL" /end COMPU_VTAB
/begin COMPU_METHOD _CNV_A_R_LINEAR_____45_CM "" RAT_FUNC "%6.3" "km/h" COEFFS 0 10. 0. 0 0 1 /end COMPU_METHOD
/begin COMPU_METHOD _CNV_S_4_STATE_ETCU_46_CM "" TAB_VERB "%6.3" "" COMPU_TAB_REF _CNV_S_4_STATE_ETCU_46 /end COMPU_METHOD
/begin COMPU_VTAB _CNV_S_4_STATE_ETCU_46 "" TAB_VERB 4 0 "NO INTERVENTION" 1 "TORQUE_INCREASE" 2 "TORQUE_DECREASE" 3 "INTERFACE LOCKED" /end COMPU_VTAB
/begin COMPU_METHOD _CNV_S_4_STATE_DCC__47_CM "" TAB_VERB "%6.3" "" COMPU_TAB_REF _CNV_S_4_STATE_DCC__47 /end COMPU_METHOD
/begin COMPU_VTAB _CNV_S_4_STATE_DCC__47 "" TAB_VERB 4 0 "NO_INTERVENTION" 1 "TORQUE_INCREASE" 2 "INVALID_SIGNAL" 3 "INVALID_SIGNAL" /end COMPU_VTAB
/begin COMPU_METHOD _CNV_S_3_STATE_DCC__48_CM "" TAB_VERB "%6.3" "" COMPU_TAB_REF _CNV_S_3_STATE_DCC__48 /end COMPU_METHOD
/begin COMPU_VTAB _CNV_S_3_STATE_DCC__48 "" TAB_VERB 3 0 "NO_REQUEST" 1 "INHIBIT_PUC" 3 "INVALID_SIGNAL" /end COMPU_VTAB
/begin COMPU_METHOD _CNV_S_8_STATE_DCC_49_CM "" TAB_VERB "%6.3" "" COMPU_TAB_REF _CNV_S_8_STATE_DCC_49 /end COMPU_METHOD
/begin COMPU_VTAB _CNV_S_8_STATE_DCC_49 "" TAB_VERB 8 0 "INACTIVE" 1 "STAND_BY" 2 "NORMAL" 3 "RESERVE" 4 "BRAKE_ACTIVE" 5 "DRIVER_ACTIVE" 6 "RESERVE" 7 "INVALID_SIGNAL" /end COMPU_VTAB
/begin COMPU_METHOD _CNV_A_R_LINEAR_____50_CM "" RAT_FUNC "%6.3" "" COEFFS 0 1. 0. 0 0 1 /end COMPU_METHOD
/begin COMPU_METHOD _CNV_S_3_STATE_ETCU_51_CM "" TAB_VERB "%6.3" "" COMPU_TAB_REF _CNV_S_3_STATE_ETCU_51 /end COMPU_METHOD
/begin COMPU_VTAB _CNV_S_3_STATE_ETCU_51 "" TAB_VERB 3 0 "NO_OBD_ERROR" 1 "OBD_ERROR" 2 "INVALID_SIGNAL" /end COMPU_VTAB
/begin COMPU_METHOD _CNV_A_R_LINEAR_____52_CM "" RAT_FUNC "%6.3" "km" COEFFS 0 1. 0. 0 0 1 /end COMPU_METHOD
/begin COMPU_METHOD _CNV_R_R_spg_gencan_53_CM "" RAT_FUNC "%6.3" "V" COEFFS 0. 40. -424. 0. 0. 1. /end COMPU_METHOD
/begin COMPU_METHOD _CNV_S_13_STATE_BN_M_54_CM "" TAB_VERB "%6.3" "" COMPU_TAB_REF _CNV_S_13_STATE_BN_M_54 /end COMPU_METHOD
/begin COMPU_VTAB _CNV_S_13_STATE_BN_M_54 "" TAB_VERB 13 0 "NO_ACTION" 1 "TIP_PRE" 2 "TIP_POST" 4 "PRESS_PRE" 8 "PRESS_POST" 16 "TIP UP or DOWN" 64 "TIP_AXIAL" 65 "TIP_AXIAL" 66 "TIP_AXIAL" 68 "TIP_POST" 72 "PRESS_POST" 80 "TIP UP or DOWN" 127 "INVALID SIGNAL" /end COMPU_VTAB
/begin COMPU_METHOD _CNV_S_3_STATE_ST_T_55_CM "" TAB_VERB "%6.3" "" COMPU_TAB_REF _CNV_S_3_STATE_ST_T_55 /end COMPU_METHOD
/begin COMPU_VTAB _CNV_S_3_STATE_ST_T_55 "" TAB_VERB 3 0 "NO_INTERVENTION" 1 "INTERVENTION" 3 "INVALID_SIGNAL" /end COMPU_VTAB
/begin COMPU_METHOD _CNV_S_3_STATE_VS_I_56_CM "" TAB_VERB "%6.3" "" COMPU_TAB_REF _CNV_S_3_STATE_VS_I_56 /end COMPU_METHOD
/begin COMPU_VTAB _CNV_S_3_STATE_VS_I_56 "" TAB_VERB 3 0 "km/h" 1 "mph" 3 "INVALID SIGNAL" /end COMPU_VTAB
/begin COMPU_METHOD _CNV_A_R_LINEAR_____57_CM "" RAT_FUNC "%6.3" "Nm" COEFFS 0 2. 0. 0 0 1 /end COMPU_METHOD
/begin COMPU_METHOD _CNV_A_R_LINEAR_____58_CM "" RAT_FUNC "%6.3" "km" COEFFS 0 0.1 0. 0 0 1 /end COMPU_METHOD
/begin COMPU_METHOD _CNV_S_4_STATE_PSTE_59_CM "" TAB_VERB "%6.3" "" COMPU_TAB_REF _CNV_S_4_STATE_PSTE_59 /end COMPU_METHOD
/begin COMPU_VTAB _CNV_S_4_STATE_PSTE_59 "" TAB_VERB 4 0 "NO INTERVENTION" 1 "TORQUE INCREASE" 2 "TORQUE DECREASE" 3 "INVALID SIGNAL" /end COMPU_VTAB
/begin COMPU_METHOD _CNV_S_4_STATE_PSTE_60_CM "" TAB_VERB "%6.3" "" COMPU_TAB_REF _CNV_S_4_STATE_PSTE_60 /end COMPU_METHOD
/begin COMPU_VTAB _CNV_S_4_STATE_PSTE_60 "" TAB_VERB 4 0 "RESERVED" 1 "NO_INTERVENTION" 2 "INTERVENTION_ACTIVE" 3 "INVALID_SIGNAL" /end COMPU_VTAB
/begin COMPU_METHOD _CNV_S_8_STATE_PSTE_61_CM "" TAB_VERB "%6.3" "" COMPU_TAB_REF _CNV_S_8_STATE_PSTE_61 /end COMPU_METHOD
/begin COMPU_VTAB _CNV_S_8_STATE_PSTE_61 "" TAB_VERB 8 0 "NO_ERROR" 1 "NO_SENSOR" 2 "SENSOR_ERROR" 3 "SENSOR_AND_MODEL_ERROR" 4 "SENSOR_ERROR_TEMP" 5 "SENSOR_AND_MODEL_ERROR_TEMP" 6 "NOT_USED" 7 "SIGNAL_INVALID" /end COMPU_VTAB
/begin COMPU_METHOD _CNV_S_5_STATE_PSTE_62_CM "" TAB_VERB "%6.3" "" COMPU_TAB_REF _CNV_S_5_STATE_PSTE_62 /end COMPU_METHOD
/begin COMPU_VTAB _CNV_S_5_STATE_PSTE_62 "" TAB_VERB 5 0 "NORMAL_STEERING" 1 "AFS" 2 "EPS" 3 "RESERVED" 4 "INVALID_SIGNAL" /end COMPU_VTAB
/begin COMPU_METHOD _CNV_A_R_LINEAR_____63_CM "" RAT_FUNC "%6.3" "%" COEFFS 0 2. 0. 0 0 1 /end COMPU_METHOD
/begin COMPU_METHOD _CNV_A_R_LINEAR_____64_CM "" RAT_FUNC "%6.3" "Nm" COEFFS 0 1. 0. 0 0 1 /end COMPU_METHOD
/begin COMPU_METHOD _CNV_A_R_LINEAR_____65_CM "" RAT_FUNC "%6.3" "1/m" COEFFS 0 8. 0. 0 0 1 /end COMPU_METHOD
/begin COMPU_METHOD _CNV_A_R_LINEAR_____66_CM "" RAT_FUNC "%6.3" "mA" COEFFS 0 1. 0. 0 0 1 /end COMPU_METHOD
/begin COMPU_METHOD _CNV_A_R_LINEAR_____67_CM "" RAT_FUNC "%6.3" "A" COEFFS 0 0.1 0. 0 0 1 /end COMPU_METHOD
/begin COMPU_METHOD _CNV_R_R_Def_km_sw__68_CM "Def_km_sw_q10" RAT_FUNC "%6.3" "km" COEFFS 0. 1. 0. 0. 0. 10. /end COMPU_METHOD
/begin COMPU_METHOD _CNV_A_R_LINEAR_____69_CM "" RAT_FUNC "%6.3" "Nm" COEFFS 0 9.999999997671694 -0.5 0 0 1 /end COMPU_METHOD
/begin COMPU_METHOD _CNV_S_4_STATE_DCC__70_CM "" TAB_VERB "%6.3" "" COMPU_TAB_REF _CNV_S_4_STATE_DCC__70 /end COMPU_METHOD
/begin COMPU_VTAB _CNV_S_4_STATE_DCC__70 "" TAB_VERB 4 0 "reserved" 1 "SYS_OFF" 2 "SYS_OK" 3 "INVALID_SIGNAL" /end COMPU_VTAB
/begin COMPU_METHOD _CNV_S_4_STATE_ERR__71_CM "" TAB_VERB "%6.3" "" COMPU_TAB_REF _CNV_S_4_STATE_ERR__71 /end COMPU_METHOD
/begin COMPU_VTAB _CNV_S_4_STATE_ERR__71 "" TAB_VERB 4 0 "NO_SYM" 1 "SCP" 2 "SCG" 4 "OL" /end COMPU_VTAB
/begin COMPU_METHOD _CNV_A_R_LINEAR_____72_CM "" RAT_FUNC "%6.3" "°STW" COEFFS 0 22.75571737399022 0. 0 0 1 /end COMPU_METHOD
/begin COMPU_METHOD _CNV_A_R_LINEAR_____73_CM "" RAT_FUNC "%6.3" "bar" COEFFS 0 1. 0. 0 0 1 /end COMPU_METHOD
/begin COMPU_METHOD _CNV_A_R_LINEAR_____75_CM "" RAT_FUNC "%6.3" "l" COEFFS 0 1. 0. 0 0 1 /end COMPU_METHOD
/begin COMPU_METHOD _CNV_S_2_RANGE______76_CM "" TAB_VERB "%6.3" "" COMPU_TAB_REF _CNV_S_2_RANGE______76 /end COMPU_METHOD
/begin COMPU_VTAB _CNV_S_2_RANGE______76 "" TAB_VERB 2 0 "0" 1 "1" /end COMPU_VTAB
/begin COMPU_METHOD _CNV_A_R_LINEAR_____79_CM "" RAT_FUNC "%6.3" "rpm" COEFFS 0 8. 0. 0 0 1 /end COMPU_METHOD
/begin COMPU_METHOD _CNV_S_9_STATE_AMT__80_CM "" TAB_VERB "%6.3" "" COMPU_TAB_REF _CNV_S_9_STATE_AMT__80 /end COMPU_METHOD
/begin COMPU_VTAB _CNV_S_9_STATE_AMT__80 "" TAB_VERB 9 0 "MIL_OFF" 2 "MIL_OFF" 4 "MIL_ON" 6 "MIL_ON" 8 "MIL_FLL" 10 "MIL_FLL" 12 "IDLE" 14 "INI_VALUE" 15 "INVALID_SIGNAL" /end COMPU_VTAB
/begin COMPU_METHOD _CNV_S_4_RANGE_STAT_81_CM "" TAB_VERB "%6.3" "" COMPU_TAB_REF _CNV_S_4_RANGE_STAT_81 /end COMPU_METHOD
/begin COMPU_VTAB _CNV_S_4_RANGE_STAT_81 "" TAB_VERB 4 0 "CC open" 1 "CC controlled" 2 "CC closed" 3 "not defined" /end COMPU_VTAB
/begin COMPU_METHOD _CNV_S_5_STATE_AMT_82_CM "" TAB_VERB "%6.3" "" COMPU_TAB_REF _CNV_S_5_STATE_AMT_82 /end COMPU_METHOD
/begin COMPU_VTAB _CNV_S_5_STATE_AMT_82 "" TAB_VERB 5 0 "NO INTERVENTION" 1 "TORQUE_DECREASE" 2 "N_REGULATION" 3 "TORQUE_INCREASE" 7 "INVALID_SIGNAL" /end COMPU_VTAB
/begin COMPU_METHOD _CNV_S_5_STATE_CLU__83_CM "" TAB_VERB "%6.3" "" COMPU_TAB_REF _CNV_S_5_STATE_CLU__83 /end COMPU_METHOD
/begin COMPU_VTAB _CNV_S_5_STATE_CLU__83 "" TAB_VERB 5 0 "CLU_OPEN" 1 "CREEPING" 2 "DRIVE_OFF" 3 "CLU_CLOSED" 7 "INVALID_SIGNAL" /end COMPU_VTAB
/begin COMPU_METHOD _CNV_A_R_LINEAR_____84_CM "" RAT_FUNC "%6.3" "min" COEFFS 0 1. 0. 0 0 1 /end COMPU_METHOD
/begin COMPU_METHOD _CNV_A_R_LINEAR_____85_CM "" RAT_FUNC "%6.3" "°STW/s" COEFFS 0 22.75571737399022 0. 0 0 1 /end COMPU_METHOD
/begin COMPU_METHOD _CNV_A_R_LINEAR_____86_CM "" RAT_FUNC "%6.3" "km/h" COEFFS 0 128.0000018750286 0. 0 0 1 /end COMPU_METHOD
/begin COMPU_METHOD _CNV_A_R_LINEAR_____87_CM "" RAT_FUNC "%6.3" "Nm" COEFFS 0 32. 32768. 0 0 1 /end COMPU_METHOD
/begin COMPU_METHOD _CNV_A_R_LINEAR_____89_CM "" RAT_FUNC "%6.3" "-" COEFFS 0 65535.99999999996 0. 0 0 1 /end COMPU_METHOD
/begin COMPU_METHOD _CNV_A_R_LINEAR_____103_CM "" RAT_FUNC "%6.3" "-" COEFFS 0 128. 0. 0 0 1 /end COMPU_METHOD
/begin COMPU_METHOD _CNV_A_R_LINEAR_____111_CM "" RAT_FUNC "%6.3" "mg/stk" COEFFS 0 47.18142548596112 0. 0 0 1 /end COMPU_METHOD
/begin COMPU_METHOD _CNV_A_R_LINEAR_____115_CM "" RAT_FUNC "%6.3" "-" COEFFS 0 8192. 0. 0 0 1 /end COMPU_METHOD
/begin COMPU_METHOD _CNV_A_R_LINEAR_____130_CM "" RAT_FUNC "%6.3" "°C" COEFFS 0 16. 0. 0 0 1 /end COMPU_METHOD
/begin COMPU_METHOD _CNV_A_R_LINEAR_____170_CM "" RAT_FUNC "%6.3" "rpm" COEFFS 0 4. 0. 0 0 1 /end COMPU_METHOD
/begin COMPU_METHOD _CNV_A_R_LINEAR_____172_CM "" RAT_FUNC "%6.3" "V" COEFFS 0 6553.60054017653 0. 0 0 1 /end COMPU_METHOD
/begin COMPU_METHOD _CNV_A_R_LINEAR_____184_CM "" RAT_FUNC "%6.3" "h/(km*min)" COEFFS 0 1. 0. 0 0 1 /end COMPU_METHOD
/begin COMPU_METHOD _CNV_A_R_LINEAR_____185_CM "" RAT_FUNC "%6.3" "" COEFFS 0 256. 0. 0 0 1 /end COMPU_METHOD
/begin COMPU_METHOD _CNV_A_R_LINEAR_____198_CM "" RAT_FUNC "%6.3" "°CRK" COEFFS 0 2.666666666666667 128. 0 0 1 /end COMPU_METHOD
/begin COMPU_METHOD _CNV_A_R_LINEAR_____199_CM "" RAT_FUNC "%6.3" "V" COEFFS 0 51.0204081632653 0. 0 0 1 /end COMPU_METHOD
/begin COMPU_METHOD _CNV_A_R_LINEAR_____202_CM "" RAT_FUNC "%6.3" "mg/stk" COEFFS 0 47.18214541280769 -1.080506262951531e-005 0 0 1 /end COMPU_METHOD
/begin COMPU_METHOD _CNV_A_R_LINEAR_____215_CM "" RAT_FUNC "%6.3" "kg/h" COEFFS 0 32. 0. 0 0 1 /end COMPU_METHOD
/begin COMPU_METHOD _CNV_A_R_LINEAR_____225_CM "" RAT_FUNC "%6.3" "mg/stk" COEFFS 0 47.18070554355651 0. 0 0 1 /end COMPU_METHOD
/begin COMPU_METHOD _CNV_A_R_LINEAR_____230_CM "" RAT_FUNC "%6.3" "rpm/10ms" COEFFS 0 16. 0. 0 0 1 /end COMPU_METHOD
/begin COMPU_METHOD _CNV_A_R_LINEAR_____231_CM "" RAT_FUNC "%6.3" "rpm" COEFFS 0 1. 65536. 0 0 1 /end COMPU_METHOD
/begin COMPU_METHOD _CNV_A_R_LINEAR_____232_CM "" RAT_FUNC "%6.3" "rpm/10ms" COEFFS 0 4. 0. 0 0 1 /end COMPU_METHOD
/begin COMPU_METHOD _CNV_A_R_LINEAR_____241_CM "" RAT_FUNC "%6.3" "-" COEFFS 0 2048. 0. 0 0 1 /end COMPU_METHOD
/begin COMPU_METHOD _CNV_A_R_LINEAR_____248_CM "" RAT_FUNC "%6.3" "V" COEFFS 0 204.7999995887937 0. 0 0 1 /end COMPU_METHOD
/begin COMPU_METHOD _CNV_A_R_LINEAR_____249_CM "" RAT_FUNC "%6.3" "%/V" COEFFS 0 3.2 0. 0 0 1 /end COMPU_METHOD
/begin COMPU_METHOD _CNV_S_2_RANGE______252_R_CM "" TAB_VERB "%6.3" "-" COMPU_TAB_REF _CNV_S_2_RANGE______252_R /end COMPU_METHOD
/begin COMPU_VTAB_RANGE _CNV_S_2_RANGE______252_R "" 2 0 0 "0" 1 255 "1" /end COMPU_VTAB_RANGE
/begin COMPU_METHOD _CNV_A_R_LINEAR_____253_CM "" RAT_FUNC "%6.3" "°CRK" COEFFS 0 2.666666666666667 -466.6666666666666 0 0 1 /end COMPU_METHOD
/begin COMPU_METHOD _CNV_A_R_LINEAR_____254_CM "" RAT_FUNC "%6.3" "°C/500ms" COEFFS 0 1.333333333333333 0. 0 0 1 /end COMPU_METHOD
/begin COMPU_METHOD _CNV_A_R_LINEAR_____272_CM "Battery voltage" RAT_FUNC "%6.3" "V" COEFFS 0 9.846153846153847 0. 0 0 1 /end COMPU_METHOD
/begin COMPU_METHOD _CNV_A_R_LINEAR_____273_CM "" RAT_FUNC "%6.3" "ms" COEFFS 0 125. 0. 0 0 1 /end COMPU_METHOD
/begin COMPU_METHOD _CNV_A_R_LINEAR_____274_CM "" RAT_FUNC "%6.3" "(km/h)/10ms" COEFFS 0 128. 0. 0 0 1 /end COMPU_METHOD
/begin COMPU_METHOD _CNV_A_R_LINEAR_____275_CM "" RAT_FUNC "%6.3" "m" COEFFS 0 57600021.97266463 0. 0 0 1 /end COMPU_METHOD
/begin COMPU_METHOD _CNV_A_R_LINEAR_____434_CM "" RAT_FUNC "%6.3" "m" COEFFS 0 1.e-002 0. 0 0 1 /end COMPU_METHOD
/begin COMPU_METHOD _CNV_A_R_LINEAR_____446_CM "" RAT_FUNC "%6.3" "A" COEFFS 0 1. 0. 0 0 1 /end COMPU_METHOD
/begin COMPU_METHOD _CNV_A_R_LINEAR_____535_CM "" RAT_FUNC "%6.3" "%/s" COEFFS 0 0.1024000154202376 128.000019275297 0 0 1 /end COMPU_METHOD
/begin COMPU_METHOD _CNV_A_R_LINEAR_____925_CM "" RAT_FUNC "%6.3" "°C" COEFFS 0 32. 8740.799999999999 0 0 1 /end COMPU_METHOD
/begin COMPU_METHOD _CNV_A_R_LINEAR_____930_CM "" RAT_FUNC "%6.3" "rpm" COEFFS 0 64.00027344284068 0.1400027344279806 0 0 1 /end COMPU_METHOD
/begin RECORD_LAYOUT _REC_VAL_20_u1 FNC_VALUES 1 UBYTE COLUMN_DIR DIRECT /end RECORD_LAYOUT
/begin RECORD_LAYOUT _REC_VAL_20_u2 FNC_VALUES 1 UWORD COLUMN_DIR DIRECT /end RECORD_LAYOUT
/begin RECORD_LAYOUT _REC_AXS_20_u1 NO_AXIS_PTS_X 1 UBYTE AXIS_PTS_X 2 UBYTE INDEX_INCR DIRECT /end RECORD_LAYOUT
/begin RECORD_LAYOUT _REC_MAP_20_u2_u1_u1 FNC_VALUES 1 UWORD COLUMN_DIR DIRECT /end RECORD_LAYOUT
/begin RECORD_LAYOUT _REC_CUR_20_u1_u1 FNC_VALUES 1 UBYTE COLUMN_DIR DIRECT /end RECORD_LAYOUT
/begin RECORD_LAYOUT _REC_VAL_20_s2 FNC_VALUES 1 SWORD COLUMN_DIR DIRECT /end RECORD_LAYOUT
/begin RECORD_LAYOUT _REC_AXS_20_u2 NO_AXIS_PTS_X 1 UWORD AXIS_PTS_X 2 UWORD INDEX_INCR DIRECT /end RECORD_LAYOUT
/begin RECORD_LAYOUT _REC_CUR_20_u2_u1 FNC_VALUES 1 UWORD COLUMN_DIR DIRECT /end RECORD_LAYOUT
/begin RECORD_LAYOUT _REC_CUR_20_u2_u2 FNC_VALUES 1 UWORD COLUMN_DIR DIRECT /end RECORD_LAYOUT
/begin RECORD_LAYOUT _REC_CUR_20_u1_u2 FNC_VALUES 1 UBYTE COLUMN_DIR DIRECT /end RECORD_LAYOUT
/begin RECORD_LAYOUT _REC_MAP_20_u2_u2_u2 FNC_VALUES 1 UWORD COLUMN_DIR DIRECT /end RECORD_LAYOUT
/begin RECORD_LAYOUT _REC_VAL_20_u4 FNC_VALUES 1 ULONG COLUMN_DIR DIRECT /end RECORD_LAYOUT
/begin RECORD_LAYOUT _REC_MAP_20_u1_u2_u1 FNC_VALUES 1 UBYTE COLUMN_DIR DIRECT /end RECORD_LAYOUT
/begin RECORD_LAYOUT _REC_MAP_20_u1_u1_u2 FNC_VALUES 1 UBYTE COLUMN_DIR DIRECT /end RECORD_LAYOUT
/begin FUNCTION SYS_Engine_speed_setpoint_calculation "_Engine speed setpoint calculation"
 /begin DEF_CHARACTERISTIC c_n_dif_crlc c_n_dif_min_mmv c_n_dif_fac ip_dri_acin_n_sp_is ip_n_sp_is_lih ip_dri_n_sp_is_lih ip_n_sp_is ip_acin_n_sp_is ip_fac_n_sp_ofs_kwp ip_t_ast_min_n_sp_is_cs c_n_sp_ofs_kwp_max c_tam_hys c_n_sp_heat_mt c_n_sp_heat_at c_n_sp_dec_cs c_n_sp_is_sa_eol c_n_sp_lgrd_is c_dri_vs_min_vb c_vs_max_n_sp_cs c_vs_hys_n_sp_cs lc_is_n_sp_cs_dis c_n_sp_is_pste_2_at c_n_sp_is_pste_2_mt c_n_sp_is_ars_mt c_n_sp_is_ars_at c_vs_max_n_sp_is_ars c_vs_min_n_sp_is_ars ip_dri_n_sp_is ip_n_sp_is_toil_at ip_n_sp_is_pste_2 ip_n_sp_is_pste c_n_sp_ofs_kwp_min c_n_sp_inc_cs c_n_sp_inc_pste c_n_sp_dec_pste c_dly_n_sp_dec_pste c_vs_min_n_sp_pste c_vs_min_n_sp_pste_2 c_ang_pste_isc c_vel_ang_pste_isc c_n_sp_inc_pl c_n_sp_dec_pl ip_n_sp_is_toil_mt c_toil_thd_n_sp_is c_toil_hys_n_sp_is c_iga_adj_thd_n_sp_is c_iga_adj_hys_n_sp_is ip_n_sp_is_cs_opm_1 ip_n_sp_is_cs_opm_2 ip_n_sp_is_pl_opm_1 ip_n_sp_is_pl_opm_2 ip_n_sp_is_pl_amt_opm_1 ip_n_sp_is_pl_amt_opm_2 c_n_sp_is_pwr_stab c_n_sp_is_pwr_stab_dri c_n_sp_lgrd_is_lih c_n_sp_dec_is_ch_dri id_n_sp_is_knk_at id_n_sp_is_knk_mt c_tam_n_sp_heat c_tam_n_sp_is_knk c_nt_so2p_ext_adj_act /end DEF_CHARACTERISTIC
 /begin OUT_MEASUREMENT n_dif_cor n_dif_mmv n_max_tol_st n_dif_st n_sp_is_ratio n_dif n_sp_is_pow n_sp_is_2 n_sp_is_3 lv_req_heat_n_sp_is n_sp_is lv_n_sp_is_cs lv_n_sp_is_pste lv_n_sp_is_pste_2 n_sp_is_cs n_sp_is_pwr_stab /end OUT_MEASUREMENT
/end FUNCTION
/begin FUNCTION SYS_Engine_speed_limit_coordination "_Engine speed limit coordination"
 /begin DEF_CHARACTERISTIC ip_n_max_etc_lih c_n_max_etc_lih c_n_max_thd_min c_vs_max_amt c_n_max_amt_add c_n_max_amt_gp id_n_max_mt id_n_max_amt id_n_max_at id_n_max_h_mt id_n_max_h_amt id_n_max_h_at id_t_n_max_h_amt id_t_n_max_h_mt id_t_n_max_h_at id_n_dec_n_max_h_mt id_n_dec_n_max_h_amt id_n_dec_n_max_h_at c_n_max_dri_rvl c_vs_thd_n_max_h_mt c_vs_thd_n_max_h_amt c_vs_thd_n_max_h_at c_t_max_n_max_h_amt c_t_max_n_max_h_at c_t_max_n_max_h_mt c_t_gear_vs_max_at c_t_gear_vs_max_mt c_vs_max_hys c_vs_max_0_dft c_vs_max_1 c_vs_max_2 c_vs_max_3 ip_n_max_1__tco ip_n_max_2__tco c_n_max_egy_1 c_n_max_egy_2 c_n_max_egy_3 ip_n_max_drof__vs c_t_max_n_max_h_at_man c_vs_thd_n_max_h_at_man id_n_max_at_man id_n_max_h_at_man id_t_n_max_h_at_man id_n_dec_n_max_h_at_man /end DEF_CHARACTERISTIC
 /begin OUT_MEASUREMENT n_max_thd_1 n_max_thd_2 lv_vs_max vs_ratio n_max_vs_max lv_n_max_h lv_n_max_etc_lih n_max_thd t_gear_vs_max /end OUT_MEASUREMENT
/end FUNCTION
/begin FUNCTION SYS_Mass_airflow_variables "_Mass airflow variables"
 /begin DEF_CHARACTERISTIC ip_pq_sp_puls c_pq_sp_hys_puls ip_fac_maf_kgh_cor c_maf_mmv_dif_crlc c_maf_mmv_hys /end DEF_CHARACTERISTIC
 /begin OUT_MEASUREMENT maf_kgh_mes_bas[0] maf_kgh_mes_bas[1] maf_mes[0] maf_mes[1] maf_kgh_mes[0] maf_kgh_mes[1] lv_maf_puls maf_kgh_mes_tcha[0] maf_kgh_mes_tcha[1] maf_kgh_mes_bas_tcha[0] maf_kgh_mes_bas_tcha[1] maf_kgh maf_dif maf_mmv /end OUT_MEASUREMENT
/end FUNCTION
/begin FUNCTION SYS_Intake_manifold_model "_Intake manifold model" /begin DEF_CHARACTERISTIC lc_maf_tcha_mes c_fac_maf_tcha /end DEF_CHARACTERISTIC
 /begin OUT_MEASUREMENT maf_flow_ex maf_hb egr_ratio maf_cyl map maf maf_thr maf_scav_ext fac_maf_max pq_egr maf_fg_cyl /end OUT_MEASUREMENT
/end FUNCTION
/begin FUNCTION SYS_Pressure_decrease_in_the_air_filter "_Pressure decrease in the air filter" /begin DEF_CHARACTERISTIC ip_amp_dec /end DEF_CHARACTERISTIC /begin OUT_MEASUREMENT put[0] put[1] put_max /end OUT_MEASUREMENT /end FUNCTION
/begin FUNCTION SYS_Volumetric_efficiency "_Volumetric efficiency"
 /begin DEF_CHARACTERISTIC c_tcyl_stnd c_tco_stnd c_tia_im_stnd ip_crlc_eff_vol_temp_cor ip_eff_tco_fac__n_32__maf ip_eff_tia_im_fac__n_32__maf /end DEF_CHARACTERISTIC
 /begin OUT_MEASUREMENT eff_vol_temp_cor eff_vol_temp_cor_mmv /end OUT_MEASUREMENT
/end FUNCTION
/begin FUNCTION SYS_Vehicle_speed_variables "_Vehicle speed variables" /begin DEF_CHARACTERISTIC c_vs_min_run c_t_vst c_vs_edge_sum_min c_vs_fac /end DEF_CHARACTERISTIC
 /begin OUT_MEASUREMENT vs_edge_av.edge_ctr vs_edge_av.edge_t lv_vs_run vs_sens vs_sens_grd lv_vst vs vs_h vs_edge_t_av_dif vs_edge_t_av_max /end OUT_MEASUREMENT
/end FUNCTION
/begin FUNCTION SYS_Battery_voltage "_Battery voltage"
 /begin DEF_CHARACTERISTIC c_crlc_vb c_vb_min_jump c_vb_min_obd2 c_vb_min_can_diag c_vb_max_obd1 c_vb_min_obd1 c_vb_max_obd2 c_t_min_can_diag c_vb_min_diag c_vb_min_bn_diag c_vb_min_can_tq_diag /end DEF_CHARACTERISTIC
 /begin OUT_MEASUREMENT lv_vb_jump vb_mmv lv_cdn_vb_obd1 lv_cdn_vb_obd2 vb vb_secu v_igk lv_cdn_vb_min_diag lv_cdn_vb_can_diag lv_cdn_vb_bn_diag lv_igk state_plaus_igk_bn lv_igk_prel lv_cdn_vb_can_tq_diag /end OUT_MEASUREMENT
/end FUNCTION
/begin FUNCTION SYS_Air_temperature "_Air temperature"
 /begin DEF_CHARACTERISTIC c_tia_grd_max_diag c_tco_diag c_tia_sub_tol c_tia_sub_bol c_tia_thr_sub_bol c_tia_thr_sub_tol c_tia_thr_grd_max_diag ip_tia_thr__vp_tia_thr ip_tia__vp_tia /end DEF_CHARACTERISTIC
 /begin OUT_MEASUREMENT tia_mes[0] tia_mes[1] tia tia_st tia_sub tia_thr_mes[0] tia_thr_mes[1] tia_thr_st tia_thr_sub tia_thr vp_tia_thr[0] vp_tia_thr[1] vp_tia[0] vp_tia[1] /end OUT_MEASUREMENT
/end FUNCTION
/begin FUNCTION SYS_Exhaust_temperature_variables "_Exhaust temperature variables"
 /begin DEF_CHARACTERISTIC c_vp_teg_pcat_down_diag_min c_vp_teg_pcat_down_diag_max c_vp_teg_mes_grd_max /end DEF_CHARACTERISTIC
 /begin OUT_MEASUREMENT lv_err_prel_teg_pcat_down lv_err_teg_pcat_down v_teg_tur_up[0] v_teg_tur_up[1] v_teg_tur_up_mmv[0] v_teg_tur_up_mmv[1] teg_tur_up_mes[0] teg_tur_up_mes[1] /end OUT_MEASUREMENT
/end FUNCTION
/begin FUNCTION SYS_Determination_of_accelerator_pedal_value "_Determination of accelerator pedal value"
 /begin DEF_CHARACTERISTIC c_pv_grd_lih_max c_v_pvs_hys_fil c_pvs_slop_1 c_pvs_slop_2 c_v_pvs_ofs_1 c_v_pvs_ofs_2 c_pv_av_bls_not_plaus_lgrd c_pv_av_bls_not_plaus_hys c_pv_av_bls_not_plaus ip_pv_lih_max c_v_pvs_thd_kd_hys c_v_pvs_thd_kd /end DEF_CHARACTERISTIC
 /begin OUT_MEASUREMENT v_pvs_fil_1 v_pvs_fil_2 lv_kd pv_av_2 pv_av_1 pv_av_raw pv_cus_1 pv_cus_2 pv_cus_raw pv_max pv_av pv_cru pv_av_grd /end OUT_MEASUREMENT
/end FUNCTION
/begin FUNCTION SYS_Infinitely_Variable_Valve_Timing_IVVT_Variables "_Infinitely Variable Valve Timing IVVT Variables" /begin DEF_CHARACTERISTIC c_cam_op_ex /end DEF_CHARACTERISTIC /end FUNCTION
/begin FUNCTION SYS_Gear_ratio_detection "_Gear ratio detection"
 /begin DEF_CHARACTERISTIC c_min_vs_ratio id_gr_mt__n_vs_ratio lc_rng_l c_gr_rax_sp c_crlc_fac_gr c_n_vs_cru_gear2_puc_sp c_n_vs_cru_grd_fac_gr_max c_state_etcu_prog_info /end DEF_CHARACTERISTIC
 /begin OUT_MEASUREMENT gr_mt gr_at lv_rng_l lv_dri gear_ef state_gear_rev_at_amt n_vs_ratio fac_gr fac_gr_mmv_av gr_rax_av lv_rng_l_at /end OUT_MEASUREMENT
/end FUNCTION
/begin FUNCTION SYS_Drive_train_engaged "_Drive train engaged" /begin DEF_CHARACTERISTIC c_vs_min_dt /end DEF_CHARACTERISTIC /begin OUT_MEASUREMENT lv_dt /end OUT_MEASUREMENT /end FUNCTION
/begin FUNCTION SYS_Clutch_switch_detection "_Clutch switch detection" /begin OUT_MEASUREMENT lv_cs_cus lv_im_cs_pn /end OUT_MEASUREMENT /end FUNCTION
/begin FUNCTION SYS_Input_messages "_Input messages"
 /begin DEF_CHARACTERISTIC c_temp_gb_sub c_t_ctr_swi_off_vb_min c_v_sp_gen c_tq_accin c_tam_man_as c_ctr_ftl_not_vld c_tam_sub lc_tam_man_as lc_tqi_maf_man ip_tq_loss_acc_inp c_state_tq_can_plaus_ena lc_tq_can_plaus_info /end DEF_CHARACTERISTIC
 /begin OUT_MEASUREMENT lv_err_bn_msw tq_loss_ars_av_can tq_loss_ars_sp_can veh_key_nr state_ars_can state_igk_can lv_tcs_lih_can lv_tq_pste_3_can_ena lv_tq_pste_3_can_lih lv_tq_pste_3_can_di state_tcs_intv state_wal_can t_ctr_rel_can v_sp_gen t_can state_tcs_ctl state_tcs_dece ac_veh_lgt_tcs ac_veh_trv_tcs state_mod_gb state_tcs_can state_temp_gb temp_gb vs_icl_disp lv_dcc_lih_can lv_dcc_puc_inh tq_dcc_slow_bn tq_dcc_fast_bn state_etcu_intv state_dcc_intv state_dcc_puc_inh state_dcc lv_dcc_off_ack lv_err_tq_loss_ars_av_can lv_err_tq_loss_ars_sp_can lv_rly_st_can tcc_can_cas tcc_can_etcu_3 tq_tcs_fast_bn tcc_can_tq_dcc tq_tcs_slow_bn tq_gs_slow_bn tcc_can_tq_tcs lv_tq_dcc_inc_req tq_gs_fast_bn tq_amt_fast_bn tq_amt_slow_bn tcc_can_tq_etcu state_etcu_obd_err state_amt_intv state_acin_can ctr_km_bn tcc_can_tq_amt t_ctr_swi_off_vb v_gen_tar lv_key_vld lv_key_vld_msg_failed ctr_imob_resp_rcv_can idbosrst vbost zrbosr idfbosrt_w tcc_can_icl tcc_can_msw state_bn_msw lv_err_ang_pste_can tcc_can_ars lv_etcu_lih_can lv_amt_lih_can state_st_tq_lim_gs state_st_tq_lim_amt lv_var_etcu lv_var_veh_mod lv_var_efp_crash lv_var_bn_msw lv_var_dcc lv_var_ars state_veh_mod state_vs_icl_disp tcc_can_veh_mod state_if_icl_bn_msw tcc_can_tq_pste_2 tcc_can_tq_pste_3 state_pste_2_intv state_pste_3_intv state_pste_3_err state_pste_3_src tq_loss_pste_2_av_can tq_loss_pste_2_sp_can tq_loss_pste_3_av_can tq_loss_pste_3_sp_can lv_pste_2_err lv_pste_3_intv state_brake_prs lv_var_pste_2 lv_var_pste_3 state_cru_bn nr_vs_cru_if vs_step_if[0] vs_step_if[1] vs_step_if[2] lv_msg_prog_step_cru lv_ltg_hdlp_l_on lv_ltg_inl_on opg_value_hiv_perc state_hiv heat_req_perc state_di_puc state_sp_dyn_wheel tq_wheel_ldm_bn tcc_can_ldm tcc_can_tq_wheel_1 tcc_can_tq_wheel_2 fac_gb_gain lv_state_trl lv_pow_clas_veh_can_rcv cur_wku_can cur_sc_min_can cur_sc_max_can idx_bat_can lv_tq_wheel_ldm_bn_err state_ldm_intv state_ldm lv_tq_wheel_ldm_req lv_ldm_lih_can fac_is_inc_req fac_pow_mng_vst_cns state_veh_cns state_ext_pow_cns state_igk_hw lv_ecras_ctl_can_1 lv_ecras_ctl_can_2 qoil_ds_rst_can_1_5 ctr_tout_n_ecf_can lv_ldm_can_ini lv_cc_test_bench_act state_etcu_prog_info t_err_n_eng ipm_typ_fp ipm_typ_mdkw dm_ab_fws state_dcc_off_req state_err_sym_tam_can state_err_sym_ftl_ri_can state_err_sym_ftl_le_can state_pbr state_hld_pbr lv_key_aux cks_clc_req_pbr cks_can_req_pbr tcc_can_req_pbr cks_can_pbr cks_clc_pbr lv_cft_mod_pbr lv_hood_open lv_driv_door_open lv_state_err_can_tout tcc_can_pbr tcc_can_gs_idc tq_accin_can ang_pste brake_prs ctr_ftl_not_vld ctr_ftl_ri_not_vld ctr_ftl_le_not_vld ctr_km_can ftl ftl_le ftl_ri gear_info lv_accin lv_acin lv_amt_es lv_err_vs_can lv_ftl_can_err lv_ftl_le_can_err lv_ftl_ri_can_err lv_ftl_obd_inh_l lv_ftl_tot_can_err lv_gs lv_gp lv_plaus_asr_ctl lv_plaus_esp_ctl lv_pump_amt_on lv_req_heat lv_req_tco_l lv_tam_can_err lv_tq_amt_dec_req lv_tq_amt_inc_req lv_tq_asr_req lv_tq_msr_req lv_tq_gs_inc_req lv_tq_gs_dec_req n_ecf n_gb n_max_amt_can state_amt_obd state_cc state_etcu_obd state_efp_crash_can state_gear_rev_can state_sens_ang_pste state_amt_obd_err state_amt state_clu_amt t_rel_can tam tq_conv_can vel_ang_pste vs_can wheel ctr_diag_tcc_can_etcu_3 ctr_diag_tcc_can_icl ctr_diag_tcc_can_msw ctr_diag_cks_etcu_3 ctr_diag_cks_msw ctr_diag_tout_cdn_door ctr_diag_tout_etcu_3 ctr_diag_tout_acc ctr_diag_tout_km_icl ctr_diag_tout_icl ctr_diag_tout_pow_vb ctr_diag_tout_pow_gen ctr_diag_tout_msw ctr_diag_tout_t_icl ctr_diag_tcc_can_veh_mod ctr_diag_cks_veh_mod ctr_diag_tout_veh_mod ctr_diag_tout_efp ctr_diag_tout_efp_crash lv_err_bn_acc lv_err_bn_icl lv_err_bn_km_icl lv_err_bn_pow_gen lv_err_bn_pow_vb lv_err_bn_t_icl lv_err_bn_tq_pste_2 lv_err_bn_tq_pste_3 lv_err_bn_efp lv_err_bn_efp_crash lv_err_bn_gear_rev ctr_diag_tout_gear_rev lv_err_bn_ltg_hdlp_l ctr_diag_tout_ltg_hdlp_l lv_err_bn_ldm ctr_diag_tout_hiv lv_err_bn_hiv ctr_diag_tout_trl lv_err_bn_trl ctr_diag_tout_t_clk lv_err_bn_t_clk lv_err_bn_etcu_disp lv_err_bn_cdn_door lv_err_bn_etcu_3 lv_err_bn_cas lv_err_bn_req_pbr lv_err_bn_pbr ctr_diag_tcc_can_cas ctr_diag_cks_cas ctr_diag_tout_cas lv_eng_run_can n_can ctr_ldm_can_ini tcc_com_1_tq_crk_1 tcc_com_2_tq_crk_1 tcc_com_3_tq_crk_1 tcc_com_2_tq_crk_2 tcc_com_3_tq_crk_2 tcc_com_1_tq_crk_3 tcc_com_2_tq_crk_3 tcc_com_3_tq_crk_3 tcc_com_1_tq_wheel tcc_com_1_etcu_dt tcc_com_2_etcu_dt tcc_com_1_info_dt_2 tcc_com_2_info_dt_2 tcc_com_3_info_dt_2 tcc_com_1_pv tcc_com_2_n gear lv_err_bn_tq_etcu tqi_asr_fast_req_can tqi_msr_req_can tqi_asr_slow_req_can tqi_asr_fast_can tqi_msr_can tqi_asr_slow_can tqi_gs_fast_req tqi_gs_slow_req tqi_gs_fast_req_can tqi_gs_slow_req_can lv_ctop tqi_amt_req tqi_slow_amt_req tqi_amt_req_can lv_city lv_err_bn_etcu lv_err_bn_etcu_2 lv_err_bn_tq_amt lv_err_bn_ars lv_err_bn_tq_tcs lv_err_bn_vs_tcs lv_err_bn_tcs lv_err_tq_req_can state_tq_can_plaus lv_err_bn_ang_pste lv_wake_up dist lv_err_plaus_igk_bn t_absv_com tq_loss_cord_av tq_loss_cord_sp tq_loss_cord_pred tq_loss_cord_max tq_wheel_driv_asi state_swi_gear tq_wheel_tcs_slow tq_wheel_tcs_fast tqb_sum_tcs n_wheel_re_le n_wheel_re_ri n_wheel_fn_le n_wheel_fn_ri /end OUT_MEASUREMENT
/end FUNCTION
/begin FUNCTION SYS_Oil_temperature "_Oil temperature" /begin DEF_CHARACTERISTIC c_toil_sub_diag /end DEF_CHARACTERISTIC /begin OUT_MEASUREMENT toil toil_stop /end OUT_MEASUREMENT /end FUNCTION
/begin FUNCTION SYS_Ambient_pressure_variables "_Ambient pressure variables"
 /begin DEF_CHARACTERISTIC c_amp_hys ip_amp_raw_cor__vs c_amp_crlc c_fac_amp_min c_fac_amp_max ip_amp_raw__v_amp /end DEF_CHARACTERISTIC
 /begin OUT_MEASUREMENT amp_mes amp_raw_prel fac_amp fac_amp_prel amp_cor amp_raw /end OUT_MEASUREMENT
/end FUNCTION
/begin FUNCTION SYS_System_variables_in_the_exhaust_pipe "_System variables in the exhaust pipe"
 /begin DEF_CHARACTERISTIC ip_teg_egr__maf_cyl lc_teg_swi lc_teg_cat_down_mdl_swi ip_prs_ex_inc ip_prs_ex_egr_inc /end DEF_CHARACTERISTIC
 /begin OUT_MEASUREMENT prs_ex prs_ex_inc prs_ex_egr prs_ex_egr_inc /end OUT_MEASUREMENT
/end FUNCTION
/begin FUNCTION SYS_Detection_of_Driver_Passive "_Detection of Driver Passive" /begin DEF_CHARACTERISTIC c_fac_tq_req_clu_is_hys ip_fac_tq_req_clu_is__n_32 /end DEF_CHARACTERISTIC /begin OUT_MEASUREMENT lv_ct /end OUT_MEASUREMENT /end FUNCTION
/end MODULE
/end PROJECT
