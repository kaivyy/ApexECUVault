ASAP2_VERSION 1 30
/begin PROJECT MSS65-inj "Generiert am 14.10.05 um 11:34:36"
/begin HEADER "" VERSION "R341" /end HEADER
/begin MODULE _MSS65-inj "Generiert am 14.10.05 um 11:34:36"
/begin MOD_COMMON "" BYTE_ORDER MSB_FIRST ALIGNMENT_BYTE 1 ALIGNMENT_WORD 2 ALIGNMENT_LONG 4 ALIGNMENT_FLOAT32_IEEE 4 ALIGNMENT_FLOAT64_IEEE 8 /end MOD_COMMON
/begin CHARACTERISTIC K_ED_DMTL_GROBLECK.INC_NACH_EINTRAG "Filtererhoehung nach Fehlerspeichereintrag" VALUE 0x71388 TKW_VV_VV_UB 100.0 FORMULA_0003 0.0 255.0 /end CHARACTERISTIC
/begin CHARACTERISTIC K_ED_DMTL_GROBLECK.INC_VOR_EINTRAG "Filtererhoehung vorm Fehlerspeichereintrag" VALUE 0x71386 TKW_VV_VV_UB 100.0 FORMULA_0003 0.0 255.0 /end CHARACTERISTIC
/begin CHARACTERISTIC K_ED_DMTL_GROBLECK.KLASSENINDEX "Auswahl der Fehlerklasse" VALUE 0x7138A TKW_VV_VV_UB 100.0 FORMULA_0003 0.0 8.0 /end CHARACTERISTIC
/begin CHARACTERISTIC K_ED_DMTL_GROBLECK.OK_SCHWELLE "Filterschwelle fuer Fehleraustrag" VALUE 0x71385 TKW_VV_VV_UB 100.0 FORMULA_0003 0.0 255.0 /end CHARACTERISTIC
/begin CHARACTERISTIC K_ED_DMTL_GROBLECK.P_CODE_OPENLOAD "P-Code fuer die Art OPENLOAD" VALUE 0x71380 TKW_VV_VV_UW 100.0 FORMULA_0010 0.0 65535.0 /end CHARACTERISTIC
/begin CHARACTERISTIC K_ED_DMTL_GROBLECK.P_CODE_SH_TO_GND "P-Code fuer die Art SH_TO_GND" VALUE 0x7137E TKW_VV_VV_UW 100.0 FORMULA_0010 0.0 65535.0 /end CHARACTERISTIC
/begin CHARACTERISTIC K_ED_DMTL_GROBLECK.P_CODE_SH_TO_UB "P-Code fuer die Art SH_TO_UB" VALUE 0x7137C TKW_VV_VV_UW 100.0 FORMULA_0010 0.0 65535.0 /end CHARACTERISTIC
/begin CHARACTERISTIC K_ED_DMTL_GROBLECK.P_CODE_UNPLAUSIBEL "P-Code fuer die Art UNPLAUSIBEL" VALUE 0x71382 TKW_VV_VV_UW 100.0 FORMULA_0010 0.0 65535.0 /end CHARACTERISTIC
/begin CHARACTERISTIC K_ED_DMTL_H.DEC_NACH_EINTRAG "Filterverringerung nach Fehlerspeichereintrag" VALUE 0x7136F TKW_VV_VV_UB 100.0 FORMULA_0003 0.0 255.0 /end CHARACTERISTIC
/begin CHARACTERISTIC K_ED_DMTL_H.DEC_VOR_EINTRAG "Filterverringerung vorm Fehlerspeichereintrag" VALUE 0x7136D TKW_VV_VV_UB 100.0 FORMULA_0003 0.0 255.0 /end CHARACTERISTIC
/begin CHARACTERISTIC K_ED_DMTL_H.FEHLERSCHWELLE "Filterschwelle fuer Fehlereintrag" VALUE 0x7136A TKW_VV_VV_UB 100.0 FORMULA_0003 0.0 255.0 /end CHARACTERISTIC
/begin CHARACTERISTIC K_ED_DMTL_H.INC_NACH_EINTRAG "Filtererhoehung nach Fehlerspeichereintrag" VALUE 0x7136E TKW_VV_VV_UB 100.0 FORMULA_0003 0.0 255.0 /end CHARACTERISTIC
/begin CHARACTERISTIC K_ED_DMTL_H.INC_VOR_EINTRAG "Filtererhoehung vorm Fehlerspeichereintrag" VALUE 0x7136C TKW_VV_VV_UB 100.0 FORMULA_0003 0.0 255.0 /end CHARACTERISTIC
/begin CHARACTERISTIC K_ED_DMTL_H.KLASSENINDEX "Auswahl der Fehlerklasse" VALUE 0x71370 TKW_VV_VV_UB 100.0 FORMULA_0003 0.0 8.0 /end CHARACTERISTIC
/begin CHARACTERISTIC K_ED_DMTL_H.OK_SCHWELLE "Filterschwelle fuer Fehleraustrag" VALUE 0x7136B TKW_VV_VV_UB 100.0 FORMULA_0003 0.0 255.0 /end CHARACTERISTIC
/begin CHARACTERISTIC K_ED_DMTL_H.P_CODE_OPENLOAD "P-Code fuer die Art OPENLOAD" VALUE 0x71366 TKW_VV_VV_UW 100.0 FORMULA_0010 0.0 65535.0 /end CHARACTERISTIC
/begin CHARACTERISTIC K_ED_DMTL_H.P_CODE_SH_TO_GND "P-Code fuer die Art SH_TO_GND" VALUE 0x71364 TKW_VV_VV_UW 100.0 FORMULA_0010 0.0 65535.0 /end CHARACTERISTIC
/begin CHARACTERISTIC K_ED_DMTL_H.P_CODE_SH_TO_UB "P-Code fuer die Art SH_TO_UB" VALUE 0x71362 TKW_VV_VV_UW 100.0 FORMULA_0010 0.0 65535.0 /end CHARACTERISTIC
/begin CHARACTERISTIC K_ED_DMTL_H.P_CODE_UNPLAUSIBEL "P-Code fuer die Art UNPLAUSIBEL" VALUE 0x71368 TKW_VV_VV_UW 100.0 FORMULA_0010 0.0 65535.0 /end CHARACTERISTIC
/begin CHARACTERISTIC K_ED_DMTL_P.DEC_NACH_EINTRAG "Filterverringerung nach Fehlerspeichereintrag" VALUE 0x7133B TKW_VV_VV_UB 100.0 FORMULA_0003 0.0 255.0 /end CHARACTERISTIC
/begin CHARACTERISTIC K_ED_DMTL_P.DEC_VOR_EINTRAG "Filterverringerung vorm Fehlerspeichereintrag" VALUE 0x71339 TKW_VV_VV_UB 100.0 FORMULA_0003 0.0 255.0 /end CHARACTERISTIC
/begin CHARACTERISTIC K_ED_DMTL_P.FEHLERSCHWELLE "Filterschwelle fuer Fehlereintrag" VALUE 0x71336 TKW_VV_VV_UB 100.0 FORMULA_0003 0.0 255.0 /end CHARACTERISTIC
/begin CHARACTERISTIC K_ED_DMTL_P.INC_NACH_EINTRAG "Filtererhoehung nach Fehlerspeichereintrag" VALUE 0x7133A TKW_VV_VV_UB 100.0 FORMULA_0003 0.0 255.0 /end CHARACTERISTIC
/begin CHARACTERISTIC K_ED_DMTL_P.INC_VOR_EINTRAG "Filtererhoehung vorm Fehlerspeichereintrag" VALUE 0x71338 TKW_VV_VV_UB 100.0 FORMULA_0003 0.0 255.0 /end CHARACTERISTIC
/begin CHARACTERISTIC K_ED_DMTL_P.KLASSENINDEX "Auswahl der Fehlerklasse" VALUE 0x7133C TKW_VV_VV_UB 100.0 FORMULA_0003 0.0 8.0 /end CHARACTERISTIC
/begin CHARACTERISTIC K_ED_DMTL_P.OK_SCHWELLE "Filterschwelle fuer Fehleraustrag" VALUE 0x71337 TKW_VV_VV_UB 100.0 FORMULA_0003 0.0 255.0 /end CHARACTERISTIC
/begin CHARACTERISTIC K_ED_DMTL_P.P_CODE_OPENLOAD "P-Code fuer die Art OPENLOAD" VALUE 0x71332 TKW_VV_VV_UW 100.0 FORMULA_0010 0.0 65535.0 /end CHARACTERISTIC
/begin CHARACTERISTIC K_ED_DMTL_P.P_CODE_SH_TO_GND "P-Code fuer die Art SH_TO_GND" VALUE 0x71330 TKW_VV_VV_UW 100.0 FORMULA_0010 0.0 65535.0 /end CHARACTERISTIC
/begin CHARACTERISTIC K_ED_DMTL_P.P_CODE_SH_TO_UB "P-Code fuer die Art SH_TO_UB" VALUE 0x7132E TKW_VV_VV_UW 100.0 FORMULA_0010 0.0 65535.0 /end CHARACTERISTIC
/begin CHARACTERISTIC K_ED_DMTL_P.P_CODE_UNPLAUSIBEL "P-Code fuer die Art UNPLAUSIBEL" VALUE 0x71334 TKW_VV_VV_UW 100.0 FORMULA_0010 0.0 65535.0 /end CHARACTERISTIC
/begin CHARACTERISTIC K_ED_DMTL_V.DEC_NACH_EINTRAG "Filterverringerung nach Fehlerspeichereintrag" VALUE 0x71355 TKW_VV_VV_UB 100.0 FORMULA_0003 0.0 255.0 /end CHARACTERISTIC
/begin CHARACTERISTIC K_ED_DMTL_V.DEC_VOR_EINTRAG "Filterverringerung vorm Fehlerspeichereintrag" VALUE 0x71353 TKW_VV_VV_UB 100.0 FORMULA_0003 0.0 255.0 /end CHARACTERISTIC
/begin CHARACTERISTIC K_ED_DMTL_V.FEHLERSCHWELLE "Filterschwelle fuer Fehlereintrag" VALUE 0x71350 TKW_VV_VV_UB 100.0 FORMULA_0003 0.0 255.0 /end CHARACTERISTIC
/begin CHARACTERISTIC K_ED_DMTL_V.INC_NACH_EINTRAG "Filtererhoehung nach Fehlerspeichereintrag" VALUE 0x71354 TKW_VV_VV_UB 100.0 FORMULA_0003 0.0 255.0 /end CHARACTERISTIC
/begin CHARACTERISTIC K_ED_DMTL_V.INC_VOR_EINTRAG "Filtererhoehung vorm Fehlerspeichereintrag" VALUE 0x71352 TKW_VV_VV_UB 100.0 FORMULA_0003 0.0 255.0 /end CHARACTERISTIC
/begin CHARACTERISTIC K_ED_DMTL_V.KLASSENINDEX "Auswahl der Fehlerklasse" VALUE 0x71356 TKW_VV_VV_UB 100.0 FORMULA_0003 0.0 8.0 /end CHARACTERISTIC
/begin CHARACTERISTIC K_ED_DMTL_V.OK_SCHWELLE "Filterschwelle fuer Fehleraustrag" VALUE 0x71351 TKW_VV_VV_UB 100.0 FORMULA_0003 0.0 255.0 /end CHARACTERISTIC
/begin CHARACTERISTIC K_ED_DMTL_V.P_CODE_OPENLOAD "P-Code fuer die Art OPENLOAD" VALUE 0x7134C TKW_VV_VV_UW 100.0 FORMULA_0010 0.0 65535.0 /end CHARACTERISTIC
/begin CHARACTERISTIC K_ED_DMTL_V.P_CODE_SH_TO_GND "P-Code fuer die Art SH_TO_GND" VALUE 0x7134A TKW_VV_VV_UW 100.0 FORMULA_0010 0.0 65535.0 /end CHARACTERISTIC
/begin CHARACTERISTIC K_ED_DMTL_V.P_CODE_SH_TO_UB "P-Code fuer die Art SH_TO_UB" VALUE 0x71348 TKW_VV_VV_UW 100.0 FORMULA_0010 0.0 65535.0 /end CHARACTERISTIC
/begin CHARACTERISTIC K_ED_DMTL_V.P_CODE_UNPLAUSIBEL "P-Code fuer die Art UNPLAUSIBEL" VALUE 0x7134E TKW_VV_VV_UW 100.0 FORMULA_0010 0.0 65535.0 /end CHARACTERISTIC
/begin CHARACTERISTIC K_ED_E2_INJ.DEC_NACH_EINTRAG "Filterverringerung nach Fehlerspeichereintrag" VALUE 0x7184F TKW_VV_VV_UB 100.0 FORMULA_0003 0.0 255.0 /end CHARACTERISTIC
/begin CHARACTERISTIC K_ED_E2_INJ.DEC_VOR_EINTRAG "Filterverringerung vorm Fehlerspeichereintrag" VALUE 0x7184D TKW_VV_VV_UB 100.0 FORMULA_0003 0.0 255.0 /end CHARACTERISTIC
/begin CHARACTERISTIC K_ED_E2_INJ.FEHLERSCHWELLE "Filterschwelle fuer Fehlereintrag" VALUE 0x7184A TKW_VV_VV_UB 100.0 FORMULA_0003 0.0 255.0 /end CHARACTERISTIC
/begin CHARACTERISTIC K_ED_E2_INJ.INC_NACH_EINTRAG "Filtererhoehung nach Fehlerspeichereintrag" VALUE 0x7184E TKW_VV_VV_UB 100.0 FORMULA_0003 0.0 255.0 /end CHARACTERISTIC
/begin CHARACTERISTIC K_ED_E2_INJ.INC_VOR_EINTRAG "Filtererhoehung vorm Fehlerspeichereintrag" VALUE 0x7184C TKW_VV_VV_UB 100.0 FORMULA_0003 0.0 255.0 /end CHARACTERISTIC
/begin CHARACTERISTIC K_ED_E2_INJ.KLASSENINDEX "Auswahl der Fehlerklasse" VALUE 0x71850 TKW_VV_VV_UB 100.0 FORMULA_0003 0.0 8.0 /end CHARACTERISTIC
/begin CHARACTERISTIC K_ED_E2_INJ.OK_SCHWELLE "Filterschwelle fuer Fehleraustrag" VALUE 0x7184B TKW_VV_VV_UB 100.0 FORMULA_0003 0.0 255.0 /end CHARACTERISTIC
/begin CHARACTERISTIC K_ED_E2_INJ.P_CODE_OPENLOAD "P-Code fuer die Art OPENLOAD" VALUE 0x71846 TKW_VV_VV_UW 100.0 FORMULA_0010 0.0 65535.0 /end CHARACTERISTIC
/begin CHARACTERISTIC K_ED_E2_INJ.P_CODE_SH_TO_GND "P-Code fuer die Art SH_TO_GND" VALUE 0x71844 TKW_VV_VV_UW 100.0 FORMULA_0010 0.0 65535.0 /end CHARACTERISTIC
/begin CHARACTERISTIC K_ED_E2_INJ.P_CODE_SH_TO_UB "P-Code fuer die Art SH_TO_UB" VALUE 0x71842 TKW_VV_VV_UW 100.0 FORMULA_0010 0.0 65535.0 /end CHARACTERISTIC
/begin CHARACTERISTIC K_ED_E2_INJ.P_CODE_UNPLAUSIBEL "P-Code fuer die Art UNPLAUSIBEL" VALUE 0x71848 TKW_VV_VV_UW 100.0 FORMULA_0010 0.0 65535.0 /end CHARACTERISTIC
/begin CHARACTERISTIC K_ED_EBOX_ELU.DEC_NACH_EINTRAG "Filterverringerung nach Fehlerspeichereintrag" VALUE 0x71765 TKW_VV_VV_UB 100.0 FORMULA_0003 0.0 255.0 /end CHARACTERISTIC
/begin CHARACTERISTIC K_ED_EBOX_ELU.DEC_VOR_EINTRAG "Filterverringerung vorm Fehlerspeichereintrag" VALUE 0x71763 TKW_VV_VV_UB 100.0 FORMULA_0003 0.0 255.0 /end CHARACTERISTIC
/begin CHARACTERISTIC K_ED_EBOX_ELU.FEHLERSCHWELLE "Filterschwelle fuer Fehlereintrag" VALUE 0x71760 TKW_VV_VV_UB 100.0 FORMULA_0003 0.0 255.0 /end CHARACTERISTIC
/begin CHARACTERISTIC K_ED_EBOX_ELU.INC_NACH_EINTRAG "Filtererhoehung nach Fehlerspeichereintrag" VALUE 0x71764 TKW_VV_VV_UB 100.0 FORMULA_0003 0.0 255.0 /end CHARACTERISTIC
/begin CHARACTERISTIC K_ED_EBOX_ELU.INC_VOR_EINTRAG "Filtererhoehung vorm Fehlerspeichereintrag" VALUE 0x71762 TKW_VV_VV_UB 100.0 FORMULA_0003 0.0 255.0 /end CHARACTERISTIC
/begin CHARACTERISTIC K_ED_EBOX_ELU.KLASSENINDEX "Auswahl der Fehlerklasse" VALUE 0x71766 TKW_VV_VV_UB 100.0 FORMULA_0003 0.0 8.0 /end CHARACTERISTIC
/begin CHARACTERISTIC K_ED_EBOX_ELU.OK_SCHWELLE "Filterschwelle fuer Fehleraustrag" VALUE 0x71761 TKW_VV_VV_UB 100.0 FORMULA_0003 0.0 255.0 /end CHARACTERISTIC
/begin CHARACTERISTIC K_ED_EBOX_ELU.P_CODE_OPENLOAD "P-Code fuer die Art OPENLOAD" VALUE 0x7175C TKW_VV_VV_UW 100.0 FORMULA_0010 0.0 65535.0 /end CHARACTERISTIC
/begin CHARACTERISTIC K_ED_EBOX_ELU.P_CODE_SH_TO_GND "P-Code fuer die Art SH_TO_GND" VALUE 0x7175A TKW_VV_VV_UW 100.0 FORMULA_0010 0.0 65535.0 /end CHARACTERISTIC
/begin CHARACTERISTIC K_ED_EBOX_ELU.P_CODE_SH_TO_UB "P-Code fuer die Art SH_TO_UB" VALUE 0x71758 TKW_VV_VV_UW 100.0 FORMULA_0010 0.0 65535.0 /end CHARACTERISTIC
/begin CHARACTERISTIC K_ED_EBOX_ELU.P_CODE_UNPLAUSIBEL "P-Code fuer die Art UNPLAUSIBEL" VALUE 0x7175E TKW_VV_VV_UW 100.0 FORMULA_0010 0.0 65535.0 /end CHARACTERISTIC
/begin CHARACTERISTIC K_ED_EKP_PWM.DEC_NACH_EINTRAG "Filterverringerung nach Fehlerspeichereintrag" VALUE 0x71425 TKW_VV_VV_UB 100.0 FORMULA_0003 0.0 255.0 /end CHARACTERISTIC
/begin CHARACTERISTIC K_ED_EKP_PWM.DEC_VOR_EINTRAG "Filterverringerung vorm Fehlerspeichereintrag" VALUE 0x71423 TKW_VV_VV_UB 100.0 FORMULA_0003 0.0 255.0 /end CHARACTERISTIC
/begin CHARACTERISTIC K_ED_EKP_PWM.FEHLERSCHWELLE "Filterschwelle fuer Fehlereintrag" VALUE 0x71420 TKW_VV_VV_UB 100.0 FORMULA_0003 0.0 255.0 /end CHARACTERISTIC
/begin CHARACTERISTIC K_ED_EKP_PWM.INC_NACH_EINTRAG "Filtererhoehung nach Fehlerspeichereintrag" VALUE 0x71424 TKW_VV_VV_UB 100.0 FORMULA_0003 0.0 255.0 /end CHARACTERISTIC
/begin CHARACTERISTIC K_ED_EKP_PWM.INC_VOR_EINTRAG "Filtererhoehung vorm Fehlerspeichereintrag" VALUE 0x71422 TKW_VV_VV_UB 100.0 FORMULA_0003 0.0 255.0 /end CHARACTERISTIC
/begin CHARACTERISTIC K_ED_EKP_PWM.KLASSENINDEX "Auswahl der Fehlerklasse" VALUE 0x71426 TKW_VV_VV_UB 100.0 FORMULA_0003 0.0 8.0 /end CHARACTERISTIC
/begin CHARACTERISTIC K_ED_EKP_PWM.OK_SCHWELLE "Filterschwelle fuer Fehleraustrag" VALUE 0x71421 TKW_VV_VV_UB 100.0 FORMULA_0003 0.0 255.0 /end CHARACTERISTIC
/begin CHARACTERISTIC K_ED_EKP_PWM.P_CODE_OPENLOAD "P-Code fuer die Art OPENLOAD" VALUE 0x7141C TKW_VV_VV_UW 100.0 FORMULA_0010 0.0 65535.0 /end CHARACTERISTIC
/begin CHARACTERISTIC K_ED_EKP_PWM.P_CODE_SH_TO_GND "P-Code fuer die Art SH_TO_GND" VALUE 0x7141A TKW_VV_VV_UW 100.0 FORMULA_0010 0.0 65535.0 /end CHARACTERISTIC
/begin CHARACTERISTIC K_ED_EKP_PWM.P_CODE_SH_TO_UB "P-Code fuer die Art SH_TO_UB" VALUE 0x71418 TKW_VV_VV_UW 100.0 FORMULA_0010 0.0 65535.0 /end CHARACTERISTIC
/begin CHARACTERISTIC K_ED_EKP_PWM.P_CODE_UNPLAUSIBEL "P-Code fuer die Art UNPLAUSIBEL" VALUE 0x7141E TKW_VV_VV_UW 100.0 FORMULA_0010 0.0 65535.0 /end CHARACTERISTIC
/begin CHARACTERISTIC K_ED_ELU.DEC_NACH_EINTRAG "Filterverringerung nach Fehlerspeichereintrag" VALUE 0x719EF TKW_VV_VV_UB 100.0 FORMULA_0003 0.0 255.0 /end CHARACTERISTIC
/begin CHARACTERISTIC K_ED_ELU.DEC_VOR_EINTRAG "Filterverringerung vorm Fehlerspeichereintrag" VALUE 0x719ED TKW_VV_VV_UB 100.0 FORMULA_0003 0.0 255.0 /end CHARACTERISTIC
/begin CHARACTERISTIC K_ED_ELU.FEHLERSCHWELLE "Filterschwelle fuer Fehlereintrag" VALUE 0x719EA TKW_VV_VV_UB 100.0 FORMULA_0003 0.0 255.0 /end CHARACTERISTIC
/begin CHARACTERISTIC K_ED_ELU.INC_NACH_EINTRAG "Filtererhoehung nach Fehlerspeichereintrag" VALUE 0x719EE TKW_VV_VV_UB 100.0 FORMULA_0003 0.0 255.0 /end CHARACTERISTIC
/begin CHARACTERISTIC K_ED_ELU.INC_VOR_EINTRAG "Filtererhoehung vorm Fehlerspeichereintrag" VALUE 0x719EC TKW_VV_VV_UB 100.0 FORMULA_0003 0.0 255.0 /end CHARACTERISTIC
/begin CHARACTERISTIC K_ED_ELU.KLASSENINDEX "Auswahl der Fehlerklasse" VALUE 0x719F0 TKW_VV_VV_UB 100.0 FORMULA_0003 0.0 8.0 /end CHARACTERISTIC
/begin CHARACTERISTIC K_ED_ELU.OK_SCHWELLE "Filterschwelle fuer Fehleraustrag" VALUE 0x719EB TKW_VV_VV_UB 100.0 FORMULA_0003 0.0 255.0 /end CHARACTERISTIC
/begin CHARACTERISTIC K_ED_ELU.P_CODE_OPENLOAD "P-Code fuer die Art OPENLOAD" VALUE 0x719E6 TKW_VV_VV_UW 100.0 FORMULA_0010 0.0 65535.0 /end CHARACTERISTIC
/begin CHARACTERISTIC K_ED_ELU.P_CODE_SH_TO_GND "P-Code fuer die Art SH_TO_GND" VALUE 0x719E4 TKW_VV_VV_UW 100.0 FORMULA_0010 0.0 65535.0 /end CHARACTERISTIC
/begin CHARACTERISTIC K_ED_ELU.P_CODE_SH_TO_UB "P-Code fuer die Art SH_TO_UB" VALUE 0x719E2 TKW_VV_VV_UW 100.0 FORMULA_0010 0.0 65535.0 /end CHARACTERISTIC
/begin CHARACTERISTIC K_ED_ELU.P_CODE_UNPLAUSIBEL "P-Code fuer die Art UNPLAUSIBEL" VALUE 0x719E8 TKW_VV_VV_UW 100.0 FORMULA_0010 0.0 65535.0 /end CHARACTERISTIC
/begin CHARACTERISTIC K_ED_ELUP.DEC_NACH_EINTRAG "Filterverringerung nach Fehlerspeichereintrag" VALUE 0x719D5 TKW_VV_VV_UB 100.0 FORMULA_0003 0.0 255.0 /end CHARACTERISTIC
/begin CHARACTERISTIC K_ED_ELUP.DEC_VOR_EINTRAG "Filterverringerung vorm Fehlerspeichereintrag" VALUE 0x719D3 TKW_VV_VV_UB 100.0 FORMULA_0003 0.0 255.0 /end CHARACTERISTIC
/begin CHARACTERISTIC K_ED_ELUP.FEHLERSCHWELLE "Filterschwelle fuer Fehlereintrag" VALUE 0x719D0 TKW_VV_VV_UB 100.0 FORMULA_0003 0.0 255.0 /end CHARACTERISTIC
/begin CHARACTERISTIC K_ED_ELUP.INC_NACH_EINTRAG "Filtererhoehung nach Fehlerspeichereintrag" VALUE 0x719D4 TKW_VV_VV_UB 100.0 FORMULA_0003 0.0 255.0 /end CHARACTERISTIC
/begin CHARACTERISTIC K_ED_ELUP.INC_VOR_EINTRAG "Filtererhoehung vorm Fehlerspeichereintrag" VALUE 0x719D2 TKW_VV_VV_UB 100.0 FORMULA_0003 0.0 255.0 /end CHARACTERISTIC
/begin CHARACTERISTIC K_ED_ELUP.KLASSENINDEX "Auswahl der Fehlerklasse" VALUE 0x719D6 TKW_VV_VV_UB 100.0 FORMULA_0003 0.0 8.0 /end CHARACTERISTIC
/begin CHARACTERISTIC K_ED_ELUP.OK_SCHWELLE "Filterschwelle fuer Fehleraustrag" VALUE 0x719D1 TKW_VV_VV_UB 100.0 FORMULA_0003 0.0 255.0 /end CHARACTERISTIC
/begin CHARACTERISTIC K_ED_ELUP.P_CODE_OPENLOAD "P-Code fuer die Art OPENLOAD" VALUE 0x719CC TKW_VV_VV_UW 100.0 FORMULA_0010 0.0 65535.0 /end CHARACTERISTIC
/begin CHARACTERISTIC K_ED_ELUP.P_CODE_SH_TO_GND "P-Code fuer die Art SH_TO_GND" VALUE 0x719CA TKW_VV_VV_UW 100.0 FORMULA_0010 0.0 65535.0 /end CHARACTERISTIC
/begin CHARACTERISTIC K_ED_ELUP.P_CODE_SH_TO_UB "P-Code fuer die Art SH_TO_UB" VALUE 0x719C8 TKW_VV_VV_UW 100.0 FORMULA_0010 0.0 65535.0 /end CHARACTERISTIC
/begin CHARACTERISTIC K_ED_ELUP.P_CODE_UNPLAUSIBEL "P-Code fuer die Art UNPLAUSIBEL" VALUE 0x719CE TKW_VV_VV_UW 100.0 FORMULA_0010 0.0 65535.0 /end CHARACTERISTIC
/begin CHARACTERISTIC K_ED_EV1.DEC_NACH_EINTRAG "Filterverringerung nach Fehlerspeichereintrag" VALUE 0x711B5 TKW_VV_VV_UB 100.0 FORMULA_0003 0.0 255.0 /end CHARACTERISTIC
/begin CHARACTERISTIC K_ED_EV1.DEC_VOR_EINTRAG "Filterverringerung vorm Fehlerspeichereintrag" VALUE 0x711B3 TKW_VV_VV_UB 100.0 FORMULA_0003 0.0 255.0 /end CHARACTERISTIC
/begin CHARACTERISTIC K_ED_EV1.FEHLERSCHWELLE "Filterschwelle fuer Fehlereintrag" VALUE 0x711B0 TKW_VV_VV_UB 100.0 FORMULA_0003 0.0 255.0 /end CHARACTERISTIC
/begin CHARACTERISTIC K_ED_EV1.INC_NACH_EINTRAG "Filtererhoehung nach Fehlerspeichereintrag" VALUE 0x711B4 TKW_VV_VV_UB 100.0 FORMULA_0003 0.0 255.0 /end CHARACTERISTIC
/begin CHARACTERISTIC K_ED_EV1.INC_VOR_EINTRAG "Filtererhoehung vorm Fehlerspeichereintrag" VALUE 0x711B2 TKW_VV_VV_UB 100.0 FORMULA_0003 0.0 255.0 /end CHARACTERISTIC
/begin CHARACTERISTIC K_ED_EV1.KLASSENINDEX "Auswahl der Fehlerklasse" VALUE 0x711B6 TKW_VV_VV_UB 100.0 FORMULA_0003 0.0 8.0 /end CHARACTERISTIC
/begin CHARACTERISTIC K_ED_EV1.OK_SCHWELLE "Filterschwelle fuer Fehleraustrag" VALUE 0x711B1 TKW_VV_VV_UB 100.0 FORMULA_0003 0.0 255.0 /end CHARACTERISTIC
/begin CHARACTERISTIC K_ED_EV1.P_CODE_OPENLOAD "P-Code fuer die Art OPENLOAD" VALUE 0x711AC TKW_VV_VV_UW 100.0 FORMULA_0010 0.0 65535.0 /end CHARACTERISTIC
/begin CHARACTERISTIC K_ED_EV1.P_CODE_SH_TO_GND "P-Code fuer die Art SH_TO_GND" VALUE 0x711AA TKW_VV_VV_UW 100.0 FORMULA_0010 0.0 65535.0 /end CHARACTERISTIC
/begin CHARACTERISTIC K_ED_EV1.P_CODE_SH_TO_UB "P-Code fuer die Art SH_TO_UB" VALUE 0x711A8 TKW_VV_VV_UW 100.0 FORMULA_0010 0.0 65535.0 /end CHARACTERISTIC
/begin CHARACTERISTIC K_ED_EV1.P_CODE_UNPLAUSIBEL "P-Code fuer die Art UNPLAUSIBEL" VALUE 0x711AE TKW_VV_VV_UW 100.0 FORMULA_0010 0.0 65535.0 /end CHARACTERISTIC
/begin CHARACTERISTIC K_ED_EV10.DEC_NACH_EINTRAG "Filterverringerung nach Fehlerspeichereintrag" VALUE 0x7129F TKW_VV_VV_UB 100.0 FORMULA_0003 0.0 255.0 /end CHARACTERISTIC
/begin CHARACTERISTIC K_ED_EV10.DEC_VOR_EINTRAG "Filterverringerung vorm Fehlerspeichereintrag" VALUE 0x7129D TKW_VV_VV_UB 100.0 FORMULA_0003 0.0 255.0 /end CHARACTERISTIC
/begin CHARACTERISTIC K_ED_EV10.FEHLERSCHWELLE "Filterschwelle fuer Fehlereintrag" VALUE 0x7129A TKW_VV_VV_UB 100.0 FORMULA_0003 0.0 255.0 /end CHARACTERISTIC
/begin CHARACTERISTIC K_ED_EV10.INC_NACH_EINTRAG "Filtererhoehung nach Fehlerspeichereintrag" VALUE 0x7129E TKW_VV_VV_UB 100.0 FORMULA_0003 0.0 255.0 /end CHARACTERISTIC
/begin CHARACTERISTIC K_ED_EV10.INC_VOR_EINTRAG "Filtererhoehung vorm Fehlerspeichereintrag" VALUE 0x7129C TKW_VV_VV_UB 100.0 FORMULA_0003 0.0 255.0 /end CHARACTERISTIC
/begin CHARACTERISTIC K_ED_EV10.KLASSENINDEX "Auswahl der Fehlerklasse" VALUE 0x712A0 TKW_VV_VV_UB 100.0 FORMULA_0003 0.0 8.0 /end CHARACTERISTIC
/begin CHARACTERISTIC K_ED_EV10.OK_SCHWELLE "Filterschwelle fuer Fehleraustrag" VALUE 0x7129B TKW_VV_VV_UB 100.0 FORMULA_0003 0.0 255.0 /end CHARACTERISTIC
/begin CHARACTERISTIC K_ED_EV10.P_CODE_OPENLOAD "P-Code fuer die Art OPENLOAD" VALUE 0x71296 TKW_VV_VV_UW 100.0 FORMULA_0010 0.0 65535.0 /end CHARACTERISTIC
/begin CHARACTERISTIC K_ED_EV10.P_CODE_SH_TO_GND "P-Code fuer die Art SH_TO_GND" VALUE 0x71294 TKW_VV_VV_UW 100.0 FORMULA_0010 0.0 65535.0 /end CHARACTERISTIC
/begin CHARACTERISTIC K_ED_EV10.P_CODE_SH_TO_UB "P-Code fuer die Art SH_TO_UB" VALUE 0x71292 TKW_VV_VV_UW 100.0 FORMULA_0010 0.0 65535.0 /end CHARACTERISTIC
/begin CHARACTERISTIC K_ED_EV10.P_CODE_UNPLAUSIBEL "P-Code fuer die Art UNPLAUSIBEL" VALUE 0x71298 TKW_VV_VV_UW 100.0 FORMULA_0010 0.0 65535.0 /end CHARACTERISTIC
/begin CHARACTERISTIC K_ED_EV2.DEC_NACH_EINTRAG "Filterverringerung nach Fehlerspeichereintrag" VALUE 0x711CF TKW_VV_VV_UB 100.0 FORMULA_0003 0.0 255.0 /end CHARACTERISTIC
/begin CHARACTERISTIC K_ED_EV2.DEC_VOR_EINTRAG "Filterverringerung vorm Fehlerspeichereintrag" VALUE 0x711CD TKW_VV_VV_UB 100.0 FORMULA_0003 0.0 255.0 /end CHARACTERISTIC
/begin CHARACTERISTIC K_ED_EV2.FEHLERSCHWELLE "Filterschwelle fuer Fehlereintrag" VALUE 0x711CA TKW_VV_VV_UB 100.0 FORMULA_0003 0.0 255.0 /end CHARACTERISTIC
/begin CHARACTERISTIC K_ED_EV2.INC_NACH_EINTRAG "Filtererhoehung nach Fehlerspeichereintrag" VALUE 0x711CE TKW_VV_VV_UB 100.0 FORMULA_0003 0.0 255.0 /end CHARACTERISTIC
/begin CHARACTERISTIC K_ED_EV2.INC_VOR_EINTRAG "Filtererhoehung vorm Fehlerspeichereintrag" VALUE 0x711CC TKW_VV_VV_UB 100.0 FORMULA_0003 0.0 255.0 /end CHARACTERISTIC
/begin CHARACTERISTIC K_ED_EV2.KLASSENINDEX "Auswahl der Fehlerklasse" VALUE 0x711D0 TKW_VV_VV_UB 100.0 FORMULA_0003 0.0 8.0 /end CHARACTERISTIC
/begin CHARACTERISTIC K_ED_EV2.OK_SCHWELLE "Filterschwelle fuer Fehleraustrag" VALUE 0x711CB TKW_VV_VV_UB 100.0 FORMULA_0003 0.0 255.0 /end CHARACTERISTIC
/begin CHARACTERISTIC K_ED_EV2.P_CODE_OPENLOAD "P-Code fuer die Art OPENLOAD" VALUE 0x711C6 TKW_VV_VV_UW 100.0 FORMULA_0010 0.0 65535.0 /end CHARACTERISTIC
/begin CHARACTERISTIC K_ED_EV2.P_CODE_SH_TO_GND "P-Code fuer die Art SH_TO_GND" VALUE 0x711C4 TKW_VV_VV_UW 100.0 FORMULA_0010 0.0 65535.0 /end CHARACTERISTIC
/begin CHARACTERISTIC K_ED_EV2.P_CODE_SH_TO_UB "P-Code fuer die Art SH_TO_UB" VALUE 0x711C2 TKW_VV_VV_UW 100.0 FORMULA_0010 0.0 65535.0 /end CHARACTERISTIC
/begin CHARACTERISTIC K_ED_EV2.P_CODE_UNPLAUSIBEL "P-Code fuer die Art UNPLAUSIBEL" VALUE 0x711C8 TKW_VV_VV_UW 100.0 FORMULA_0010 0.0 65535.0 /end CHARACTERISTIC
/begin CHARACTERISTIC K_ED_EV3.DEC_NACH_EINTRAG "Filterverringerung nach Fehlerspeichereintrag" VALUE 0x711E9 TKW_VV_VV_UB 100.0 FORMULA_0003 0.0 255.0 /end CHARACTERISTIC
/begin CHARACTERISTIC K_ED_EV3.DEC_VOR_EINTRAG "Filterverringerung vorm Fehlerspeichereintrag" VALUE 0x711E7 TKW_VV_VV_UB 100.0 FORMULA_0003 0.0 255.0 /end CHARACTERISTIC
/begin CHARACTERISTIC K_ED_EV3.FEHLERSCHWELLE "Filterschwelle fuer Fehlereintrag" VALUE 0x711E4 TKW_VV_VV_UB 100.0 FORMULA_0003 0.0 255.0 /end CHARACTERISTIC
/begin CHARACTERISTIC K_ED_EV3.INC_NACH_EINTRAG "Filtererhoehung nach Fehlerspeichereintrag" VALUE 0x711E8 TKW_VV_VV_UB 100.0 FORMULA_0003 0.0 255.0 /end CHARACTERISTIC
/begin CHARACTERISTIC K_ED_EV3.INC_VOR_EINTRAG "Filtererhoehung vorm Fehlerspeichereintrag" VALUE 0x711E6 TKW_VV_VV_UB 100.0 FORMULA_0003 0.0 255.0 /end CHARACTERISTIC
/begin CHARACTERISTIC K_ED_EV3.KLASSENINDEX "Auswahl der Fehlerklasse" VALUE 0x711EA TKW_VV_VV_UB 100.0 FORMULA_0003 0.0 8.0 /end CHARACTERISTIC
/begin CHARACTERISTIC K_ED_EV3.OK_SCHWELLE "Filterschwelle fuer Fehleraustrag" VALUE 0x711E5 TKW_VV_VV_UB 100.0 FORMULA_0003 0.0 255.0 /end CHARACTERISTIC
/begin CHARACTERISTIC K_ED_EV3.P_CODE_OPENLOAD "P-Code fuer die Art OPENLOAD" VALUE 0x711E0 TKW_VV_VV_UW 100.0 FORMULA_0010 0.0 65535.0 /end CHARACTERISTIC
/begin CHARACTERISTIC K_ED_EV3.P_CODE_SH_TO_GND "P-Code fuer die Art SH_TO_GND" VALUE 0x711DE TKW_VV_VV_UW 100.0 FORMULA_0010 0.0 65535.0 /end CHARACTERISTIC
/begin CHARACTERISTIC K_ED_EV3.P_CODE_SH_TO_UB "P-Code fuer die Art SH_TO_UB" VALUE 0x711DC TKW_VV_VV_UW 100.0 FORMULA_0010 0.0 65535.0 /end CHARACTERISTIC
/begin CHARACTERISTIC K_ED_EV3.P_CODE_UNPLAUSIBEL "P-Code fuer die Art UNPLAUSIBEL" VALUE 0x711E2 TKW_VV_VV_UW 100.0 FORMULA_0010 0.0 65535.0 /end CHARACTERISTIC
/begin CHARACTERISTIC K_ED_EV4.DEC_NACH_EINTRAG "Filterverringerung nach Fehlerspeichereintrag" VALUE 0x71203 TKW_VV_VV_UB 100.0 FORMULA_0003 0.0 255.0 /end CHARACTERISTIC
/begin CHARACTERISTIC K_ED_EV4.DEC_VOR_EINTRAG "Filterverringerung vorm Fehlerspeichereintrag" VALUE 0x71201 TKW_VV_VV_UB 100.0 FORMULA_0003 0.0 255.0 /end CHARACTERISTIC
/begin CHARACTERISTIC K_ED_EV4.FEHLERSCHWELLE "Filterschwelle fuer Fehlereintrag" VALUE 0x711FE TKW_VV_VV_UB 100.0 FORMULA_0003 0.0 255.0 /end CHARACTERISTIC
/begin CHARACTERISTIC K_ED_EV4.INC_NACH_EINTRAG "Filtererhoehung nach Fehlerspeichereintrag" VALUE 0x71202 TKW_VV_VV_UB 100.0 FORMULA_0003 0.0 255.0 /end CHARACTERISTIC
/begin CHARACTERISTIC K_ED_EV4.INC_VOR_EINTRAG "Filtererhoehung vorm Fehlerspeichereintrag" VALUE 0x71200 TKW_VV_VV_UB 100.0 FORMULA_0003 0.0 255.0 /end CHARACTERISTIC
/begin CHARACTERISTIC K_ED_EV4.KLASSENINDEX "Auswahl der Fehlerklasse" VALUE 0x71204 TKW_VV_VV_UB 100.0 FORMULA_0003 0.0 8.0 /end CHARACTERISTIC
/begin CHARACTERISTIC K_ED_EV4.OK_SCHWELLE "Filterschwelle fuer Fehleraustrag" VALUE 0x711FF TKW_VV_VV_UB 100.0 FORMULA_0003 0.0 255.0 /end CHARACTERISTIC
/begin CHARACTERISTIC K_ED_EV4.P_CODE_OPENLOAD "P-Code fuer die Art OPENLOAD" VALUE 0x711FA TKW_VV_VV_UW 100.0 FORMULA_0010 0.0 65535.0 /end CHARACTERISTIC
/begin CHARACTERISTIC K_ED_EV4.P_CODE_SH_TO_GND "P-Code fuer die Art SH_TO_GND" VALUE 0x711F8 TKW_VV_VV_UW 100.0 FORMULA_0010 0.0 65535.0 /end CHARACTERISTIC
/begin CHARACTERISTIC K_ED_EV4.P_CODE_SH_TO_UB "P-Code fuer die Art SH_TO_UB" VALUE 0x711F6 TKW_VV_VV_UW 100.0 FORMULA_0010 0.0 65535.0 /end CHARACTERISTIC
/begin CHARACTERISTIC K_ED_EV4.P_CODE_UNPLAUSIBEL "P-Code fuer die Art UNPLAUSIBEL" VALUE 0x711FC TKW_VV_VV_UW 100.0 FORMULA_0010 0.0 65535.0 /end CHARACTERISTIC
/begin CHARACTERISTIC K_ED_EV5.DEC_NACH_EINTRAG "Filterverringerung nach Fehlerspeichereintrag" VALUE 0x7121D TKW_VV_VV_UB 100.0 FORMULA_0003 0.0 255.0 /end CHARACTERISTIC
/begin CHARACTERISTIC K_ED_EV5.DEC_VOR_EINTRAG "Filterverringerung vorm Fehlerspeichereintrag" VALUE 0x7121B TKW_VV_VV_UB 100.0 FORMULA_0003 0.0 255.0 /end CHARACTERISTIC
/begin CHARACTERISTIC K_ED_EV5.FEHLERSCHWELLE "Filterschwelle fuer Fehlereintrag" VALUE 0x71218 TKW_VV_VV_UB 100.0 FORMULA_0003 0.0 255.0 /end CHARACTERISTIC
/begin CHARACTERISTIC K_ED_EV5.INC_NACH_EINTRAG "Filtererhoehung nach Fehlerspeichereintrag" VALUE 0x7121C TKW_VV_VV_UB 100.0 FORMULA_0003 0.0 255.0 /end CHARACTERISTIC
/begin CHARACTERISTIC K_ED_EV5.INC_VOR_EINTRAG "Filtererhoehung vorm Fehlerspeichereintrag" VALUE 0x7121A TKW_VV_VV_UB 100.0 FORMULA_0003 0.0 255.0 /end CHARACTERISTIC
/begin CHARACTERISTIC K_ED_EV5.KLASSENINDEX "Auswahl der Fehlerklasse" VALUE 0x7121E TKW_VV_VV_UB 100.0 FORMULA_0003 0.0 8.0 /end CHARACTERISTIC
/begin CHARACTERISTIC K_ED_EV5.OK_SCHWELLE "Filterschwelle fuer Fehleraustrag" VALUE 0x71219 TKW_VV_VV_UB 100.0 FORMULA_0003 0.0 255.0 /end CHARACTERISTIC
/begin CHARACTERISTIC K_ED_EV5.P_CODE_OPENLOAD "P-Code fuer die Art OPENLOAD" VALUE 0x71214 TKW_VV_VV_UW 100.0 FORMULA_0010 0.0 65535.0 /end CHARACTERISTIC
/begin CHARACTERISTIC K_ED_EV5.P_CODE_SH_TO_GND "P-Code fuer die Art SH_TO_GND" VALUE 0x71212 TKW_VV_VV_UW 100.0 FORMULA_0010 0.0 65535.0 /end CHARACTERISTIC
/begin CHARACTERISTIC K_ED_EV5.P_CODE_SH_TO_UB "P-Code fuer die Art SH_TO_UB" VALUE 0x71210 TKW_VV_VV_UW 100.0 FORMULA_0010 0.0 65535.0 /end CHARACTERISTIC
/begin CHARACTERISTIC K_ED_EV5.P_CODE_UNPLAUSIBEL "P-Code fuer die Art UNPLAUSIBEL" VALUE 0x71216 TKW_VV_VV_UW 100.0 FORMULA_0010 0.0 65535.0 /end CHARACTERISTIC
/begin CHARACTERISTIC K_ED_EV6.DEC_NACH_EINTRAG "Filterverringerung nach Fehlerspeichereintrag" VALUE 0x71237 TKW_VV_VV_UB 100.0 FORMULA_0003 0.0 255.0 /end CHARACTERISTIC
/begin CHARACTERISTIC K_ED_EV6.DEC_VOR_EINTRAG "Filterverringerung vorm Fehlerspeichereintrag" VALUE 0x71235 TKW_VV_VV_UB 100.0 FORMULA_0003 0.0 255.0 /end CHARACTERISTIC
/begin CHARACTERISTIC K_ED_EV6.FEHLERSCHWELLE "Filterschwelle fuer Fehlereintrag" VALUE 0x71232 TKW_VV_VV_UB 100.0 FORMULA_0003 0.0 255.0 /end CHARACTERISTIC
/begin CHARACTERISTIC K_ED_EV6.INC_NACH_EINTRAG "Filtererhoehung nach Fehlerspeichereintrag" VALUE 0x71236 TKW_VV_VV_UB 100.0 FORMULA_0003 0.0 255.0 /end CHARACTERISTIC
/begin CHARACTERISTIC K_ED_EV6.INC_VOR_EINTRAG "Filtererhoehung vorm Fehlerspeichereintrag" VALUE 0x71234 TKW_VV_VV_UB 100.0 FORMULA_0003 0.0 255.0 /end CHARACTERISTIC
/begin CHARACTERISTIC K_ED_EV6.KLASSENINDEX "Auswahl der Fehlerklasse" VALUE 0x71238 TKW_VV_VV_UB 100.0 FORMULA_0003 0.0 8.0 /end CHARACTERISTIC
/begin CHARACTERISTIC K_ED_EV6.OK_SCHWELLE "Filterschwelle fuer Fehleraustrag" VALUE 0x71233 TKW_VV_VV_UB 100.0 FORMULA_0003 0.0 255.0 /end CHARACTERISTIC
/begin CHARACTERISTIC K_ED_EV6.P_CODE_OPENLOAD "P-Code fuer die Art OPENLOAD" VALUE 0x7122E TKW_VV_VV_UW 100.0 FORMULA_0010 0.0 65535.0 /end CHARACTERISTIC
/begin CHARACTERISTIC K_ED_EV6.P_CODE_SH_TO_GND "P-Code fuer die Art SH_TO_GND" VALUE 0x7122C TKW_VV_VV_UW 100.0 FORMULA_0010 0.0 65535.0 /end CHARACTERISTIC
/begin CHARACTERISTIC K_ED_EV6.P_CODE_SH_TO_UB "P-Code fuer die Art SH_TO_UB" VALUE 0x7122A TKW_VV_VV_UW 100.0 FORMULA_0010 0.0 65535.0 /end CHARACTERISTIC
/begin CHARACTERISTIC K_ED_EV6.P_CODE_UNPLAUSIBEL "P-Code fuer die Art UNPLAUSIBEL" VALUE 0x71230 TKW_VV_VV_UW 100.0 FORMULA_0010 0.0 65535.0 /end CHARACTERISTIC
/begin CHARACTERISTIC K_ED_EV7.DEC_NACH_EINTRAG "Filterverringerung nach Fehlerspeichereintrag" VALUE 0x71251 TKW_VV_VV_UB 100.0 FORMULA_0003 0.0 255.0 /end CHARACTERISTIC
/begin CHARACTERISTIC K_ED_EV7.DEC_VOR_EINTRAG "Filterverringerung vorm Fehlerspeichereintrag" VALUE 0x7124F TKW_VV_VV_UB 100.0 FORMULA_0003 0.0 255.0 /end CHARACTERISTIC
/begin CHARACTERISTIC K_ED_EV7.FEHLERSCHWELLE "Filterschwelle fuer Fehlereintrag" VALUE 0x7124C TKW_VV_VV_UB 100.0 FORMULA_0003 0.0 255.0 /end CHARACTERISTIC
/begin CHARACTERISTIC K_ED_EV7.INC_NACH_EINTRAG "Filtererhoehung nach Fehlerspeichereintrag" VALUE 0x71250 TKW_VV_VV_UB 100.0 FORMULA_0003 0.0 255.0 /end CHARACTERISTIC
/begin CHARACTERISTIC K_ED_EV7.INC_VOR_EINTRAG "Filtererhoehung vorm Fehlerspeichereintrag" VALUE 0x7124E TKW_VV_VV_UB 100.0 FORMULA_0003 0.0 255.0 /end CHARACTERISTIC
/begin CHARACTERISTIC K_ED_EV7.KLASSENINDEX "Auswahl der Fehlerklasse" VALUE 0x71252 TKW_VV_VV_UB 100.0 FORMULA_0003 0.0 8.0 /end CHARACTERISTIC
/begin CHARACTERISTIC K_ED_EV7.OK_SCHWELLE "Filterschwelle fuer Fehleraustrag" VALUE 0x7124D TKW_VV_VV_UB 100.0 FORMULA_0003 0.0 255.0 /end CHARACTERISTIC
/begin CHARACTERISTIC K_ED_EV7.P_CODE_OPENLOAD "P-Code fuer die Art OPENLOAD" VALUE 0x71248 TKW_VV_VV_UW 100.0 FORMULA_0010 0.0 65535.0 /end CHARACTERISTIC
/begin CHARACTERISTIC K_ED_EV7.P_CODE_SH_TO_GND "P-Code fuer die Art SH_TO_GND" VALUE 0x71246 TKW_VV_VV_UW 100.0 FORMULA_0010 0.0 65535.0 /end CHARACTERISTIC
/begin CHARACTERISTIC K_ED_EV7.P_CODE_SH_TO_UB "P-Code fuer die Art SH_TO_UB" VALUE 0x71244 TKW_VV_VV_UW 100.0 FORMULA_0010 0.0 65535.0 /end CHARACTERISTIC
/begin CHARACTERISTIC K_ED_EV7.P_CODE_UNPLAUSIBEL "P-Code fuer die Art UNPLAUSIBEL" VALUE 0x7124A TKW_VV_VV_UW 100.0 FORMULA_0010 0.0 65535.0 /end CHARACTERISTIC
/begin CHARACTERISTIC K_ED_EV8.DEC_NACH_EINTRAG "Filterverringerung nach Fehlerspeichereintrag" VALUE 0x7126B TKW_VV_VV_UB 100.0 FORMULA_0003 0.0 255.0 /end CHARACTERISTIC
/begin CHARACTERISTIC K_ED_EV8.DEC_VOR_EINTRAG "Filterverringerung vorm Fehlerspeichereintrag" VALUE 0x71269 TKW_VV_VV_UB 100.0 FORMULA_0003 0.0 255.0 /end CHARACTERISTIC
/begin CHARACTERISTIC K_ED_EV8.FEHLERSCHWELLE "Filterschwelle fuer Fehlereintrag" VALUE 0x71266 TKW_VV_VV_UB 100.0 FORMULA_0003 0.0 255.0 /end CHARACTERISTIC
/begin CHARACTERISTIC K_ED_EV8.INC_NACH_EINTRAG "Filtererhoehung nach Fehlerspeichereintrag" VALUE 0x7126A TKW_VV_VV_UB 100.0 FORMULA_0003 0.0 255.0 /end CHARACTERISTIC
/begin CHARACTERISTIC K_ED_EV8.INC_VOR_EINTRAG "Filtererhoehung vorm Fehlerspeichereintrag" VALUE 0x71268 TKW_VV_VV_UB 100.0 FORMULA_0003 0.0 255.0 /end CHARACTERISTIC
/begin CHARACTERISTIC K_ED_EV8.KLASSENINDEX "Auswahl der Fehlerklasse" VALUE 0x7126C TKW_VV_VV_UB 100.0 FORMULA_0003 0.0 8.0 /end CHARACTERISTIC
/begin CHARACTERISTIC K_ED_EV8.OK_SCHWELLE "Filterschwelle fuer Fehleraustrag" VALUE 0x71267 TKW_VV_VV_UB 100.0 FORMULA_0003 0.0 255.0 /end CHARACTERISTIC
/begin CHARACTERISTIC K_ED_EV8.P_CODE_OPENLOAD "P-Code fuer die Art OPENLOAD" VALUE 0x71262 TKW_VV_VV_UW 100.0 FORMULA_0010 0.0 65535.0 /end CHARACTERISTIC
/begin CHARACTERISTIC K_ED_EV8.P_CODE_SH_TO_GND "P-Code fuer die Art SH_TO_GND" VALUE 0x71260 TKW_VV_VV_UW 100.0 FORMULA_0010 0.0 65535.0 /end CHARACTERISTIC
/begin CHARACTERISTIC K_ED_EV8.P_CODE_SH_TO_UB "P-Code fuer die Art SH_TO_UB" VALUE 0x7125E TKW_VV_VV_UW 100.0 FORMULA_0010 0.0 65535.0 /end CHARACTERISTIC
/begin CHARACTERISTIC K_ED_EV8.P_CODE_UNPLAUSIBEL "P-Code fuer die Art UNPLAUSIBEL" VALUE 0x71264 TKW_VV_VV_UW 100.0 FORMULA_0010 0.0 65535.0 /end CHARACTERISTIC
/begin CHARACTERISTIC K_ED_EV9.DEC_NACH_EINTRAG "Filterverringerung nach Fehlerspeichereintrag" VALUE 0x71285 TKW_VV_VV_UB 100.0 FORMULA_0003 0.0 255.0 /end CHARACTERISTIC
/begin CHARACTERISTIC K_ED_EV9.DEC_VOR_EINTRAG "Filterverringerung vorm Fehlerspeichereintrag" VALUE 0x71283 TKW_VV_VV_UB 100.0 FORMULA_0003 0.0 255.0 /end CHARACTERISTIC
/begin CHARACTERISTIC K_ED_EV9.FEHLERSCHWELLE "Filterschwelle fuer Fehlereintrag" VALUE 0x71280 TKW_VV_VV_UB 100.0 FORMULA_0003 0.0 255.0 /end CHARACTERISTIC
/begin CHARACTERISTIC K_ED_EV9.INC_NACH_EINTRAG "Filtererhoehung nach Fehlerspeichereintrag" VALUE 0x71284 TKW_VV_VV_UB 100.0 FORMULA_0003 0.0 255.0 /end CHARACTERISTIC
/begin CHARACTERISTIC K_ED_EV9.INC_VOR_EINTRAG "Filtererhoehung vorm Fehlerspeichereintrag" VALUE 0x71282 TKW_VV_VV_UB 100.0 FORMULA_0003 0.0 255.0 /end CHARACTERISTIC
/begin CHARACTERISTIC K_ED_EV9.KLASSENINDEX "Auswahl der Fehlerklasse" VALUE 0x71286 TKW_VV_VV_UB 100.0 FORMULA_0003 0.0 8.0 /end CHARACTERISTIC
/begin CHARACTERISTIC K_ED_EV9.OK_SCHWELLE "Filterschwelle fuer Fehleraustrag" VALUE 0x71281 TKW_VV_VV_UB 100.0 FORMULA_0003 0.0 255.0 /end CHARACTERISTIC
/begin CHARACTERISTIC K_ED_EV9.P_CODE_OPENLOAD "P-Code fuer die Art OPENLOAD" VALUE 0x7127C TKW_VV_VV_UW 100.0 FORMULA_0010 0.0 65535.0 /end CHARACTERISTIC
/begin CHARACTERISTIC K_ED_EV9.P_CODE_SH_TO_GND "P-Code fuer die Art SH_TO_GND" VALUE 0x7127A TKW_VV_VV_UW 100.0 FORMULA_0010 0.0 65535.0 /end CHARACTERISTIC
/begin CHARACTERISTIC K_ED_EV9.P_CODE_SH_TO_UB "P-Code fuer die Art SH_TO_UB" VALUE 0x71278 TKW_VV_VV_UW 100.0 FORMULA_0010 0.0 65535.0 /end CHARACTERISTIC
/begin CHARACTERISTIC K_ED_EV9.P_CODE_UNPLAUSIBEL "P-Code fuer die Art UNPLAUSIBEL" VALUE 0x7127E TKW_VV_VV_UW 100.0 FORMULA_0010 0.0 65535.0 /end CHARACTERISTIC
/begin CHARACTERISTIC K_ED_EWS_MAN.DEC_NACH_EINTRAG "Filterverringerung nach Fehlerspeichereintrag" VALUE 0x716C9 TKW_VV_VV_UB 100.0 FORMULA_0003 0.0 255.0 /end CHARACTERISTIC
/begin CHARACTERISTIC K_ED_EWS_MAN.DEC_VOR_EINTRAG "Filterverringerung vorm Fehlerspeichereintrag" VALUE 0x716C7 TKW_VV_VV_UB 100.0 FORMULA_0003 0.0 255.0 /end CHARACTERISTIC
/begin CHARACTERISTIC K_ED_EWS_MAN.FEHLERSCHWELLE "Filterschwelle fuer Fehlereintrag" VALUE 0x716C4 TKW_VV_VV_UB 100.0 FORMULA_0003 0.0 255.0 /end CHARACTERISTIC
/begin CHARACTERISTIC K_ED_EWS_MAN.INC_NACH_EINTRAG "Filtererhoehung nach Fehlerspeichereintrag" VALUE 0x716C8 TKW_VV_VV_UB 100.0 FORMULA_0003 0.0 255.0 /end CHARACTERISTIC
/begin CHARACTERISTIC K_ED_EWS_MAN.INC_VOR_EINTRAG "Filtererhoehung vorm Fehlerspeichereintrag" VALUE 0x716C6 TKW_VV_VV_UB 100.0 FORMULA_0003 0.0 255.0 /end CHARACTERISTIC
/begin CHARACTERISTIC K_ED_EWS_MAN.KLASSENINDEX "Auswahl der Fehlerklasse" VALUE 0x716CA TKW_VV_VV_UB 100.0 FORMULA_0003 0.0 8.0 /end CHARACTERISTIC
/begin CHARACTERISTIC K_ED_EWS_MAN.OK_SCHWELLE "Filterschwelle fuer Fehleraustrag" VALUE 0x716C5 TKW_VV_VV_UB 100.0 FORMULA_0003 0.0 255.0 /end CHARACTERISTIC
/begin CHARACTERISTIC K_ED_EWS_MAN.P_CODE_OPENLOAD "P-Code fuer die Art OPENLOAD" VALUE 0x716C0 TKW_VV_VV_UW 100.0 FORMULA_0010 0.0 65535.0 /end CHARACTERISTIC
/begin CHARACTERISTIC K_ED_EWS_MAN.P_CODE_SH_TO_GND "P-Code fuer die Art SH_TO_GND" VALUE 0x716BE TKW_VV_VV_UW 100.0 FORMULA_0010 0.0 65535.0 /end CHARACTERISTIC
/begin CHARACTERISTIC K_ED_EWS_MAN.P_CODE_SH_TO_UB "P-Code fuer die Art SH_TO_UB" VALUE 0x716BC TKW_VV_VV_UW 100.0 FORMULA_0010 0.0 65535.0 /end CHARACTERISTIC
/begin CHARACTERISTIC K_ED_EWS_MAN.P_CODE_UNPLAUSIBEL "P-Code fuer die Art UNPLAUSIBEL" VALUE 0x716C2 TKW_VV_VV_UW 100.0 FORMULA_0010 0.0 65535.0 /end CHARACTERISTIC
/begin CHARACTERISTIC K_ED_EWS_SCI.DEC_NACH_EINTRAG "Filterverringerung nach Fehlerspeichereintrag" VALUE 0x716AF TKW_VV_VV_UB 100.0 FORMULA_0003 0.0 255.0 /end CHARACTERISTIC
/begin CHARACTERISTIC K_ED_EWS_SCI.DEC_VOR_EINTRAG "Filterverringerung vorm Fehlerspeichereintrag" VALUE 0x716AD TKW_VV_VV_UB 100.0 FORMULA_0003 0.0 255.0 /end CHARACTERISTIC
/begin CHARACTERISTIC K_ED_EWS_SCI.FEHLERSCHWELLE "Filterschwelle fuer Fehlereintrag" VALUE 0x716AA TKW_VV_VV_UB 100.0 FORMULA_0003 0.0 255.0 /end CHARACTERISTIC
/begin CHARACTERISTIC K_ED_EWS_SCI.INC_NACH_EINTRAG "Filtererhoehung nach Fehlerspeichereintrag" VALUE 0x716AE TKW_VV_VV_UB 100.0 FORMULA_0003 0.0 255.0 /end CHARACTERISTIC
/begin CHARACTERISTIC K_ED_EWS_SCI.INC_VOR_EINTRAG "Filtererhoehung vorm Fehlerspeichereintrag" VALUE 0x716AC TKW_VV_VV_UB 100.0 FORMULA_0003 0.0 255.0 /end CHARACTERISTIC
/begin CHARACTERISTIC K_ED_EWS_SCI.KLASSENINDEX "Auswahl der Fehlerklasse" VALUE 0x716B0 TKW_VV_VV_UB 100.0 FORMULA_0003 0.0 8.0 /end CHARACTERISTIC
/begin CHARACTERISTIC K_ED_EWS_SCI.OK_SCHWELLE "Filterschwelle fuer Fehleraustrag" VALUE 0x716AB TKW_VV_VV_UB 100.0 FORMULA_0003 0.0 255.0 /end CHARACTERISTIC
/begin CHARACTERISTIC K_ED_EWS_SCI.P_CODE_OPENLOAD "P-Code fuer die Art OPENLOAD" VALUE 0x716A6 TKW_VV_VV_UW 100.0 FORMULA_0010 0.0 65535.0 /end CHARACTERISTIC
/begin CHARACTERISTIC K_ED_EWS_SCI.P_CODE_SH_TO_GND "P-Code fuer die Art SH_TO_GND" VALUE 0x716A4 TKW_VV_VV_UW 100.0 FORMULA_0010 0.0 65535.0 /end CHARACTERISTIC
/begin CHARACTERISTIC K_ED_EWS_SCI.P_CODE_SH_TO_UB "P-Code fuer die Art SH_TO_UB" VALUE 0x716A2 TKW_VV_VV_UW 100.0 FORMULA_0010 0.0 65535.0 /end CHARACTERISTIC
/begin CHARACTERISTIC K_ED_EWS_SCI.P_CODE_UNPLAUSIBEL "P-Code fuer die Art UNPLAUSIBEL" VALUE 0x716A8 TKW_VV_VV_UW 100.0 FORMULA_0010 0.0 65535.0 /end CHARACTERISTIC
/begin CHARACTERISTIC K_ED_FETRAWE.DEC_NACH_EINTRAG "Filterverringerung nach Fehlerspeichereintrag" VALUE 0x7196D TKW_VV_VV_UB 100.0 FORMULA_0003 0.0 255.0 /end CHARACTERISTIC
/begin CHARACTERISTIC K_ED_FETRAWE.DEC_VOR_EINTRAG "Filterverringerung vorm Fehlerspeichereintrag" VALUE 0x7196B TKW_VV_VV_UB 100.0 FORMULA_0003 0.0 255.0 /end CHARACTERISTIC
/begin CHARACTERISTIC K_ED_FETRAWE.FEHLERSCHWELLE "Filterschwelle fuer Fehlereintrag" VALUE 0x71968 TKW_VV_VV_UB 100.0 FORMULA_0003 0.0 255.0 /end CHARACTERISTIC
/begin CHARACTERISTIC K_ED_FETRAWE.INC_NACH_EINTRAG "Filtererhoehung nach Fehlerspeichereintrag" VALUE 0x7196C TKW_VV_VV_UB 100.0 FORMULA_0003 0.0 255.0 /end CHARACTERISTIC
/begin CHARACTERISTIC K_ED_FETRAWE.INC_VOR_EINTRAG "Filtererhoehung vorm Fehlerspeichereintrag" VALUE 0x7196A TKW_VV_VV_UB 100.0 FORMULA_0003 0.0 255.0 /end CHARACTERISTIC
/begin CHARACTERISTIC K_ED_FETRAWE.KLASSENINDEX "Auswahl der Fehlerklasse" VALUE 0x7196E TKW_VV_VV_UB 100.0 FORMULA_0003 0.0 8.0 /end CHARACTERISTIC
/begin CHARACTERISTIC K_ED_FETRAWE.OK_SCHWELLE "Filterschwelle fuer Fehleraustrag" VALUE 0x71969 TKW_VV_VV_UB 100.0 FORMULA_0003 0.0 255.0 /end CHARACTERISTIC
/begin CHARACTERISTIC K_ED_FETRAWE.P_CODE_OPENLOAD "P-Code fuer die Art OPENLOAD" VALUE 0x71964 TKW_VV_VV_UW 100.0 FORMULA_0010 0.0 65535.0 /end CHARACTERISTIC
/begin CHARACTERISTIC K_ED_FETRAWE.P_CODE_SH_TO_GND "P-Code fuer die Art SH_TO_GND" VALUE 0x71962 TKW_VV_VV_UW 100.0 FORMULA_0010 0.0 65535.0 /end CHARACTERISTIC
/begin CHARACTERISTIC K_ED_FETRAWE.P_CODE_SH_TO_UB "P-Code fuer die Art SH_TO_UB" VALUE 0x71960 TKW_VV_VV_UW 100.0 FORMULA_0010 0.0 65535.0 /end CHARACTERISTIC
/begin CHARACTERISTIC K_ED_FETRAWE.P_CODE_UNPLAUSIBEL "P-Code fuer die Art UNPLAUSIBEL" VALUE 0x71966 TKW_VV_VV_UW 100.0 FORMULA_0010 0.0 65535.0 /end CHARACTERISTIC
/begin CHARACTERISTIC K_ED_FI_BSD.DEC_NACH_EINTRAG "Filterverringerung nach Fehlerspeichereintrag" VALUE 0x71591 TKW_VV_VV_UB 100.0 FORMULA_0003 0.0 255.0 /end CHARACTERISTIC
/begin CHARACTERISTIC K_ED_FI_BSD.DEC_VOR_EINTRAG "Filterverringerung vorm Fehlerspeichereintrag" VALUE 0x7158F TKW_VV_VV_UB 100.0 FORMULA_0003 0.0 255.0 /end CHARACTERISTIC
/begin CHARACTERISTIC K_ED_FI_BSD.FEHLERSCHWELLE "Filterschwelle fuer Fehlereintrag" VALUE 0x7158C TKW_VV_VV_UB 100.0 FORMULA_0003 0.0 255.0 /end CHARACTERISTIC
/begin CHARACTERISTIC K_ED_FI_BSD.INC_NACH_EINTRAG "Filtererhoehung nach Fehlerspeichereintrag" VALUE 0x71590 TKW_VV_VV_UB 100.0 FORMULA_0003 0.0 255.0 /end CHARACTERISTIC
/begin CHARACTERISTIC K_ED_FI_BSD.INC_VOR_EINTRAG "Filtererhoehung vorm Fehlerspeichereintrag" VALUE 0x7158E TKW_VV_VV_UB 100.0 FORMULA_0003 0.0 255.0 /end CHARACTERISTIC
/begin CHARACTERISTIC K_ED_FI_BSD.KLASSENINDEX "Auswahl der Fehlerklasse" VALUE 0x71592 TKW_VV_VV_UB 100.0 FORMULA_0003 0.0 8.0 /end CHARACTERISTIC
/begin CHARACTERISTIC K_ED_FI_BSD.OK_SCHWELLE "Filterschwelle fuer Fehleraustrag" VALUE 0x7158D TKW_VV_VV_UB 100.0 FORMULA_0003 0.0 255.0 /end CHARACTERISTIC
/begin CHARACTERISTIC K_ED_FI_BSD.P_CODE_OPENLOAD "P-Code fuer die Art OPENLOAD" VALUE 0x71588 TKW_VV_VV_UW 100.0 FORMULA_0010 0.0 65535.0 /end CHARACTERISTIC
/begin CHARACTERISTIC K_ED_FI_BSD.P_CODE_SH_TO_GND "P-Code fuer die Art SH_TO_GND" VALUE 0x71586 TKW_VV_VV_UW 100.0 FORMULA_0010 0.0 65535.0 /end CHARACTERISTIC
/begin CHARACTERISTIC K_ED_FI_BSD.P_CODE_SH_TO_UB "P-Code fuer die Art SH_TO_UB" VALUE 0x71584 TKW_VV_VV_UW 100.0 FORMULA_0010 0.0 65535.0 /end CHARACTERISTIC
/begin CHARACTERISTIC K_ED_FI_BSD.P_CODE_UNPLAUSIBEL "P-Code fuer die Art UNPLAUSIBEL" VALUE 0x7158A TKW_VV_VV_UW 100.0 FORMULA_0010 0.0 65535.0 /end CHARACTERISTIC
/begin CHARACTERISTIC K_ED_FI_BSD_0.DEC_NACH_EINTRAG "Filterverringerung nach Fehlerspeichereintrag" VALUE 0x716E3 TKW_VV_VV_UB 100.0 FORMULA_0003 0.0 255.0 /end CHARACTERISTIC
/begin CHARACTERISTIC K_ED_FI_BSD_0.DEC_VOR_EINTRAG "Filterverringerung vorm Fehlerspeichereintrag" VALUE 0x716E1 TKW_VV_VV_UB 100.0 FORMULA_0003 0.0 255.0 /end CHARACTERISTIC
/begin CHARACTERISTIC K_ED_FI_BSD_0.FEHLERSCHWELLE "Filterschwelle fuer Fehlereintrag" VALUE 0x716DE TKW_VV_VV_UB 100.0 FORMULA_0003 0.0 255.0 /end CHARACTERISTIC
/begin CHARACTERISTIC K_ED_FI_BSD_0.INC_NACH_EINTRAG "Filtererhoehung nach Fehlerspeichereintrag" VALUE 0x716E2 TKW_VV_VV_UB 100.0 FORMULA_0003 0.0 255.0 /end CHARACTERISTIC
/begin CHARACTERISTIC K_ED_FI_BSD_0.INC_VOR_EINTRAG "Filtererhoehung vorm Fehlerspeichereintrag" VALUE 0x716E0 TKW_VV_VV_UB 100.0 FORMULA_0003 0.0 255.0 /end CHARACTERISTIC
/begin CHARACTERISTIC K_ED_FI_BSD_0.KLASSENINDEX "Auswahl der Fehlerklasse" VALUE 0x716E4 TKW_VV_VV_UB 100.0 FORMULA_0003 0.0 8.0 /end CHARACTERISTIC
/begin CHARACTERISTIC K_ED_FI_BSD_0.OK_SCHWELLE "Filterschwelle fuer Fehleraustrag" VALUE 0x716DF TKW_VV_VV_UB 100.0 FORMULA_0003 0.0 255.0 /end CHARACTERISTIC
/begin CHARACTERISTIC K_ED_FI_BSD_0.P_CODE_OPENLOAD "P-Code fuer die Art OPENLOAD" VALUE 0x716DA TKW_VV_VV_UW 100.0 FORMULA_0010 0.0 65535.0 /end CHARACTERISTIC
/begin CHARACTERISTIC K_ED_FI_BSD_0.P_CODE_SH_TO_GND "P-Code fuer die Art SH_TO_GND" VALUE 0x716D8 TKW_VV_VV_UW 100.0 FORMULA_0010 0.0 65535.0 /end CHARACTERISTIC
/begin CHARACTERISTIC K_ED_FI_BSD_0.P_CODE_SH_TO_UB "P-Code fuer die Art SH_TO_UB" VALUE 0x716D6 TKW_VV_VV_UW 100.0 FORMULA_0010 0.0 65535.0 /end CHARACTERISTIC
/begin CHARACTERISTIC K_ED_FI_BSD_0.P_CODE_UNPLAUSIBEL "P-Code fuer die Art UNPLAUSIBEL" VALUE 0x716DC TKW_VV_VV_UW 100.0 FORMULA_0010 0.0 65535.0 /end CHARACTERISTIC
/begin CHARACTERISTIC K_ED_FI_BSD_6.DEC_NACH_EINTRAG "Filterverringerung nach Fehlerspeichereintrag" VALUE 0x716FD TKW_VV_VV_UB 100.0 FORMULA_0003 0.0 255.0 /end CHARACTERISTIC
/begin CHARACTERISTIC K_ED_FI_BSD_6.DEC_VOR_EINTRAG "Filterverringerung vorm Fehlerspeichereintrag" VALUE 0x716FB TKW_VV_VV_UB 100.0 FORMULA_0003 0.0 255.0 /end CHARACTERISTIC
/begin CHARACTERISTIC K_ED_FI_BSD_6.FEHLERSCHWELLE "Filterschwelle fuer Fehlereintrag" VALUE 0x716F8 TKW_VV_VV_UB 100.0 FORMULA_0003 0.0 255.0 /end CHARACTERISTIC
/begin CHARACTERISTIC K_ED_FI_BSD_6.INC_NACH_EINTRAG "Filtererhoehung nach Fehlerspeichereintrag" VALUE 0x716FC TKW_VV_VV_UB 100.0 FORMULA_0003 0.0 255.0 /end CHARACTERISTIC
/begin CHARACTERISTIC K_ED_FI_BSD_6.INC_VOR_EINTRAG "Filtererhoehung vorm Fehlerspeichereintrag" VALUE 0x716FA TKW_VV_VV_UB 100.0 FORMULA_0003 0.0 255.0 /end CHARACTERISTIC
/begin CHARACTERISTIC K_ED_FI_BSD_6.KLASSENINDEX "Auswahl der Fehlerklasse" VALUE 0x716FE TKW_VV_VV_UB 100.0 FORMULA_0003 0.0 8.0 /end CHARACTERISTIC
/begin CHARACTERISTIC K_ED_FI_BSD_6.OK_SCHWELLE "Filterschwelle fuer Fehleraustrag" VALUE 0x716F9 TKW_VV_VV_UB 100.0 FORMULA_0003 0.0 255.0 /end CHARACTERISTIC
/begin CHARACTERISTIC K_ED_FI_BSD_6.P_CODE_OPENLOAD "P-Code fuer die Art OPENLOAD" VALUE 0x716F4 TKW_VV_VV_UW 100.0 FORMULA_0010 0.0 65535.0 /end CHARACTERISTIC
/begin CHARACTERISTIC K_ED_FI_BSD_6.P_CODE_SH_TO_GND "P-Code fuer die Art SH_TO_GND" VALUE 0x716F2 TKW_VV_VV_UW 100.0 FORMULA_0010 0.0 65535.0 /end CHARACTERISTIC
/begin CHARACTERISTIC K_ED_FI_BSD_6.P_CODE_SH_TO_UB "P-Code fuer die Art SH_TO_UB" VALUE 0x716F0 TKW_VV_VV_UW 100.0 FORMULA_0010 0.0 65535.0 /end CHARACTERISTIC
/begin CHARACTERISTIC K_ED_FI_BSD_6.P_CODE_UNPLAUSIBEL "P-Code fuer die Art UNPLAUSIBEL" VALUE 0x716F6 TKW_VV_VV_UW 100.0 FORMULA_0010 0.0 65535.0 /end CHARACTERISTIC
/begin CHARACTERISTIC K_ED_FI_BSDGLOB.DEC_NACH_EINTRAG "Filterverringerung nach Fehlerspeichereintrag" VALUE 0x71717 TKW_VV_VV_UB 100.0 FORMULA_0003 0.0 255.0 /end CHARACTERISTIC
/begin CHARACTERISTIC K_ED_FI_BSDGLOB.DEC_VOR_EINTRAG "Filterverringerung vorm Fehlerspeichereintrag" VALUE 0x71715 TKW_VV_VV_UB 100.0 FORMULA_0003 0.0 255.0 /end CHARACTERISTIC
/begin CHARACTERISTIC K_ED_FI_BSDGLOB.FEHLERSCHWELLE "Filterschwelle fuer Fehlereintrag" VALUE 0x71712 TKW_VV_VV_UB 100.0 FORMULA_0003 0.0 255.0 /end CHARACTERISTIC
/begin CHARACTERISTIC K_ED_FI_BSDGLOB.INC_NACH_EINTRAG "Filtererhoehung nach Fehlerspeichereintrag" VALUE 0x71716 TKW_VV_VV_UB 100.0 FORMULA_0003 0.0 255.0 /end CHARACTERISTIC
/begin CHARACTERISTIC K_ED_FI_BSDGLOB.INC_VOR_EINTRAG "Filtererhoehung vorm Fehlerspeichereintrag" VALUE 0x71714 TKW_VV_VV_UB 100.0 FORMULA_0003 0.0 255.0 /end CHARACTERISTIC
/begin CHARACTERISTIC K_ED_FI_BSDGLOB.KLASSENINDEX "Auswahl der Fehlerklasse" VALUE 0x71718 TKW_VV_VV_UB 100.0 FORMULA_0003 0.0 8.0 /end CHARACTERISTIC
/begin CHARACTERISTIC K_ED_FI_BSDGLOB.OK_SCHWELLE "Filterschwelle fuer Fehleraustrag" VALUE 0x71713 TKW_VV_VV_UB 100.0 FORMULA_0003 0.0 255.0 /end CHARACTERISTIC
/begin CHARACTERISTIC K_ED_FI_BSDGLOB.P_CODE_OPENLOAD "P-Code fuer die Art OPENLOAD" VALUE 0x7170E TKW_VV_VV_UW 100.0 FORMULA_0010 0.0 65535.0 /end CHARACTERISTIC
/begin CHARACTERISTIC K_ED_FI_BSDGLOB.P_CODE_SH_TO_GND "P-Code fuer die Art SH_TO_GND" VALUE 0x7170C TKW_VV_VV_UW 100.0 FORMULA_0010 0.0 65535.0 /end CHARACTERISTIC
/begin CHARACTERISTIC K_ED_FI_BSDGLOB.P_CODE_SH_TO_UB "P-Code fuer die Art SH_TO_UB" VALUE 0x7170A TKW_VV_VV_UW 100.0 FORMULA_0010 0.0 65535.0 /end CHARACTERISTIC
/begin CHARACTERISTIC K_ED_FI_BSDGLOB.P_CODE_UNPLAUSIBEL "P-Code fuer die Art UNPLAUSIBEL" VALUE 0x71710 TKW_VV_VV_UW 100.0 FORMULA_0010 0.0 65535.0 /end CHARACTERISTIC
/begin CHARACTERISTIC K_ED_FI_GEN.DEC_NACH_EINTRAG "Filterverringerung nach Fehlerspeichereintrag" VALUE 0x71577 TKW_VV_VV_UB 100.0 FORMULA_0003 0.0 255.0 /end CHARACTERISTIC
/begin CHARACTERISTIC K_ED_FI_GEN.DEC_VOR_EINTRAG "Filterverringerung vorm Fehlerspeichereintrag" VALUE 0x71575 TKW_VV_VV_UB 100.0 FORMULA_0003 0.0 255.0 /end CHARACTERISTIC
/begin CHARACTERISTIC K_ED_FI_GEN.FEHLERSCHWELLE "Filterschwelle fuer Fehlereintrag" VALUE 0x71572 TKW_VV_VV_UB 100.0 FORMULA_0003 0.0 255.0 /end CHARACTERISTIC
/begin CHARACTERISTIC K_ED_FI_GEN.INC_NACH_EINTRAG "Filtererhoehung nach Fehlerspeichereintrag" VALUE 0x71576 TKW_VV_VV_UB 100.0 FORMULA_0003 0.0 255.0 /end CHARACTERISTIC
/begin CHARACTERISTIC K_ED_FI_GEN.INC_VOR_EINTRAG "Filtererhoehung vorm Fehlerspeichereintrag" VALUE 0x71574 TKW_VV_VV_UB 100.0 FORMULA_0003 0.0 255.0 /end CHARACTERISTIC
/begin CHARACTERISTIC K_ED_FI_GEN.KLASSENINDEX "Auswahl der Fehlerklasse" VALUE 0x71578 TKW_VV_VV_UB 100.0 FORMULA_0003 0.0 8.0 /end CHARACTERISTIC
/begin CHARACTERISTIC K_ED_FI_GEN.OK_SCHWELLE "Filterschwelle fuer Fehleraustrag" VALUE 0x71573 TKW_VV_VV_UB 100.0 FORMULA_0003 0.0 255.0 /end CHARACTERISTIC
/begin CHARACTERISTIC K_ED_FI_GEN.P_CODE_OPENLOAD "P-Code fuer die Art OPENLOAD" VALUE 0x7156E TKW_VV_VV_UW 100.0 FORMULA_0010 0.0 65535.0 /end CHARACTERISTIC
/begin CHARACTERISTIC K_ED_FI_GEN.P_CODE_SH_TO_GND "P-Code fuer die Art SH_TO_GND" VALUE 0x7156C TKW_VV_VV_UW 100.0 FORMULA_0010 0.0 65535.0 /end CHARACTERISTIC
/begin CHARACTERISTIC K_ED_FI_GEN.P_CODE_SH_TO_UB "P-Code fuer die Art SH_TO_UB" VALUE 0x7156A TKW_VV_VV_UW 100.0 FORMULA_0010 0.0 65535.0 /end CHARACTERISTIC
/begin CHARACTERISTIC K_ED_FI_GEN.P_CODE_UNPLAUSIBEL "P-Code fuer die Art UNPLAUSIBEL" VALUE 0x71570 TKW_VV_VV_UW 100.0 FORMULA_0010 0.0 65535.0 /end CHARACTERISTIC
/begin CHARACTERISTIC K_ED_FI_IBS1.DEC_NACH_EINTRAG "Filterverringerung nach Fehlerspeichereintrag" VALUE 0x715C5 TKW_VV_VV_UB 100.0 FORMULA_0003 0.0 255.0 /end CHARACTERISTIC
/begin CHARACTERISTIC K_ED_FI_IBS1.DEC_VOR_EINTRAG "Filterverringerung vorm Fehlerspeichereintrag" VALUE 0x715C3 TKW_VV_VV_UB 100.0 FORMULA_0003 0.0 255.0 /end CHARACTERISTIC
/begin CHARACTERISTIC K_ED_FI_IBS1.FEHLERSCHWELLE "Filterschwelle fuer Fehlereintrag" VALUE 0x715C0 TKW_VV_VV_UB 100.0 FORMULA_0003 0.0 255.0 /end CHARACTERISTIC
/begin CHARACTERISTIC K_ED_FI_IBS1.INC_NACH_EINTRAG "Filtererhoehung nach Fehlerspeichereintrag" VALUE 0x715C4 TKW_VV_VV_UB 100.0 FORMULA_0003 0.0 255.0 /end CHARACTERISTIC
/begin CHARACTERISTIC K_ED_FI_IBS1.INC_VOR_EINTRAG "Filtererhoehung vorm Fehlerspeichereintrag" VALUE 0x715C2 TKW_VV_VV_UB 100.0 FORMULA_0003 0.0 255.0 /end CHARACTERISTIC
/begin CHARACTERISTIC K_ED_FI_IBS1.KLASSENINDEX "Auswahl der Fehlerklasse" VALUE 0x715C6 TKW_VV_VV_UB 100.0 FORMULA_0003 0.0 8.0 /end CHARACTERISTIC
/begin CHARACTERISTIC K_ED_FI_IBS1.OK_SCHWELLE "Filterschwelle fuer Fehleraustrag" VALUE 0x715C1 TKW_VV_VV_UB 100.0 FORMULA_0003 0.0 255.0 /end CHARACTERISTIC
/begin CHARACTERISTIC K_ED_FI_IBS1.P_CODE_OPENLOAD "P-Code fuer die Art OPENLOAD" VALUE 0x715BC TKW_VV_VV_UW 100.0 FORMULA_0010 0.0 65535.0 /end CHARACTERISTIC
/begin CHARACTERISTIC K_ED_FI_IBS1.P_CODE_SH_TO_GND "P-Code fuer die Art SH_TO_GND" VALUE 0x715BA TKW_VV_VV_UW 100.0 FORMULA_0010 0.0 65535.0 /end CHARACTERISTIC
/begin CHARACTERISTIC K_ED_FI_IBS1.P_CODE_SH_TO_UB "P-Code fuer die Art SH_TO_UB" VALUE 0x715B8 TKW_VV_VV_UW 100.0 FORMULA_0010 0.0 65535.0 /end CHARACTERISTIC
/begin CHARACTERISTIC K_ED_FI_IBS1.P_CODE_UNPLAUSIBEL "P-Code fuer die Art UNPLAUSIBEL" VALUE 0x715BE TKW_VV_VV_UW 100.0 FORMULA_0010 0.0 65535.0 /end CHARACTERISTIC
/begin CHARACTERISTIC K_ED_FI_IBS2.DEC_NACH_EINTRAG "Filterverringerung nach Fehlerspeichereintrag" VALUE 0x715DF TKW_VV_VV_UB 100.0 FORMULA_0003 0.0 255.0 /end CHARACTERISTIC
/begin CHARACTERISTIC K_ED_FI_IBS2.DEC_VOR_EINTRAG "Filterverringerung vorm Fehlerspeichereintrag" VALUE 0x715DD TKW_VV_VV_UB 100.0 FORMULA_0003 0.0 255.0 /end CHARACTERISTIC
/begin CHARACTERISTIC K_ED_FI_IBS2.FEHLERSCHWELLE "Filterschwelle fuer Fehlereintrag" VALUE 0x715DA TKW_VV_VV_UB 100.0 FORMULA_0003 0.0 255.0 /end CHARACTERISTIC
/begin CHARACTERISTIC K_ED_FI_IBS2.INC_NACH_EINTRAG "Filtererhoehung nach Fehlerspeichereintrag" VALUE 0x715DE TKW_VV_VV_UB 100.0 FORMULA_0003 0.0 255.0 /end CHARACTERISTIC
/begin CHARACTERISTIC K_ED_FI_IBS2.INC_VOR_EINTRAG "Filtererhoehung vorm Fehlerspeichereintrag" VALUE 0x715DC TKW_VV_VV_UB 100.0 FORMULA_0003 0.0 255.0 /end CHARACTERISTIC
/begin CHARACTERISTIC K_ED_FI_IBS2.KLASSENINDEX "Auswahl der Fehlerklasse" VALUE 0x715E0 TKW_VV_VV_UB 100.0 FORMULA_0003 0.0 8.0 /end CHARACTERISTIC
/begin CHARACTERISTIC K_ED_FI_IBS2.OK_SCHWELLE "Filterschwelle fuer Fehleraustrag" VALUE 0x715DB TKW_VV_VV_UB 100.0 FORMULA_0003 0.0 255.0 /end CHARACTERISTIC
/begin CHARACTERISTIC K_ED_FI_IBS2.P_CODE_OPENLOAD "P-Code fuer die Art OPENLOAD" VALUE 0x715D6 TKW_VV_VV_UW 100.0 FORMULA_0010 0.0 65535.0 /end CHARACTERISTIC
/begin CHARACTERISTIC K_ED_FI_IBS2.P_CODE_SH_TO_GND "P-Code fuer die Art SH_TO_GND" VALUE 0x715D4 TKW_VV_VV_UW 100.0 FORMULA_0010 0.0 65535.0 /end CHARACTERISTIC
/begin CHARACTERISTIC K_ED_FI_IBS2.P_CODE_SH_TO_UB "P-Code fuer die Art SH_TO_UB" VALUE 0x715D2 TKW_VV_VV_UW 100.0 FORMULA_0010 0.0 65535.0 /end CHARACTERISTIC
/begin CHARACTERISTIC K_ED_FI_IBS2.P_CODE_UNPLAUSIBEL "P-Code fuer die Art UNPLAUSIBEL" VALUE 0x715D8 TKW_VV_VV_UW 100.0 FORMULA_0010 0.0 65535.0 /end CHARACTERISTIC
/begin CHARACTERISTIC K_ED_FI_IBS3.DEC_NACH_EINTRAG "Filterverringerung nach Fehlerspeichereintrag" VALUE 0x715F9 TKW_VV_VV_UB 100.0 FORMULA_0003 0.0 255.0 /end CHARACTERISTIC
/begin CHARACTERISTIC K_ED_FI_IBS3.DEC_VOR_EINTRAG "Filterverringerung vorm Fehlerspeichereintrag" VALUE 0x715F7 TKW_VV_VV_UB 100.0 FORMULA_0003 0.0 255.0 /end CHARACTERISTIC
/begin CHARACTERISTIC K_ED_FI_IBS3.FEHLERSCHWELLE "Filterschwelle fuer Fehlereintrag" VALUE 0x715F4 TKW_VV_VV_UB 100.0 FORMULA_0003 0.0 255.0 /end CHARACTERISTIC
/begin CHARACTERISTIC K_ED_FI_IBS3.INC_NACH_EINTRAG "Filtererhoehung nach Fehlerspeichereintrag" VALUE 0x715F8 TKW_VV_VV_UB 100.0 FORMULA_0003 0.0 255.0 /end CHARACTERISTIC
/begin CHARACTERISTIC K_ED_FI_IBS3.INC_VOR_EINTRAG "Filtererhoehung vorm Fehlerspeichereintrag" VALUE 0x715F6 TKW_VV_VV_UB 100.0 FORMULA_0003 0.0 255.0 /end CHARACTERISTIC
/begin CHARACTERISTIC K_ED_FI_IBS3.KLASSENINDEX "Auswahl der Fehlerklasse" VALUE 0x715FA TKW_VV_VV_UB 100.0 FORMULA_0003 0.0 8.0 /end CHARACTERISTIC
/begin CHARACTERISTIC K_ED_FI_IBS3.OK_SCHWELLE "Filterschwelle fuer Fehleraustrag" VALUE 0x715F5 TKW_VV_VV_UB 100.0 FORMULA_0003 0.0 255.0 /end CHARACTERISTIC
/begin CHARACTERISTIC K_ED_FI_IBS3.P_CODE_OPENLOAD "P-Code fuer die Art OPENLOAD" VALUE 0x715F0 TKW_VV_VV_UW 100.0 FORMULA_0010 0.0 65535.0 /end CHARACTERISTIC
/begin CHARACTERISTIC K_ED_FI_IBS3.P_CODE_SH_TO_GND "P-Code fuer die Art SH_TO_GND" VALUE 0x715EE TKW_VV_VV_UW 100.0 FORMULA_0010 0.0 65535.0 /end CHARACTERISTIC
/begin CHARACTERISTIC K_ED_FI_IBS3.P_CODE_SH_TO_UB "P-Code fuer die Art SH_TO_UB" VALUE 0x715EC TKW_VV_VV_UW 100.0 FORMULA_0010 0.0 65535.0 /end CHARACTERISTIC
/begin CHARACTERISTIC K_ED_FI_IBS3.P_CODE_UNPLAUSIBEL "P-Code fuer die Art UNPLAUSIBEL" VALUE 0x715F2 TKW_VV_VV_UW 100.0 FORMULA_0010 0.0 65535.0 /end CHARACTERISTIC
/begin CHARACTERISTIC K_ED_FI_PMBATT.DEC_NACH_EINTRAG "Filterverringerung nach Fehlerspeichereintrag" VALUE 0x7162D TKW_VV_VV_UB 100.0 FORMULA_0003 0.0 255.0 /end CHARACTERISTIC
/begin CHARACTERISTIC K_ED_FI_PMBATT.DEC_VOR_EINTRAG "Filterverringerung vorm Fehlerspeichereintrag" VALUE 0x7162B TKW_VV_VV_UB 100.0 FORMULA_0003 0.0 255.0 /end CHARACTERISTIC
/begin CHARACTERISTIC K_ED_FI_PMBATT.FEHLERSCHWELLE "Filterschwelle fuer Fehlereintrag" VALUE 0x71628 TKW_VV_VV_UB 100.0 FORMULA_0003 0.0 255.0 /end CHARACTERISTIC
/begin CHARACTERISTIC K_ED_FI_PMBATT.INC_NACH_EINTRAG "Filtererhoehung nach Fehlerspeichereintrag" VALUE 0x7162C TKW_VV_VV_UB 100.0 FORMULA_0003 0.0 255.0 /end CHARACTERISTIC
/begin CHARACTERISTIC K_ED_FI_PMBATT.INC_VOR_EINTRAG "Filtererhoehung vorm Fehlerspeichereintrag" VALUE 0x7162A TKW_VV_VV_UB 100.0 FORMULA_0003 0.0 255.0 /end CHARACTERISTIC
/begin CHARACTERISTIC K_ED_FI_PMBATT.KLASSENINDEX "Auswahl der Fehlerklasse" VALUE 0x7162E TKW_VV_VV_UB 100.0 FORMULA_0003 0.0 8.0 /end CHARACTERISTIC
/begin CHARACTERISTIC K_ED_FI_PMBATT.OK_SCHWELLE "Filterschwelle fuer Fehleraustrag" VALUE 0x71629 TKW_VV_VV_UB 100.0 FORMULA_0003 0.0 255.0 /end CHARACTERISTIC
/begin CHARACTERISTIC K_ED_FI_PMBATT.P_CODE_OPENLOAD "P-Code fuer die Art OPENLOAD" VALUE 0x71624 TKW_VV_VV_UW 100.0 FORMULA_0010 0.0 65535.0 /end CHARACTERISTIC
/begin CHARACTERISTIC K_ED_FI_PMBATT.P_CODE_SH_TO_GND "P-Code fuer die Art SH_TO_GND" VALUE 0x71622 TKW_VV_VV_UW 100.0 FORMULA_0010 0.0 65535.0 /end CHARACTERISTIC
/begin CHARACTERISTIC K_ED_FI_PMBATT.P_CODE_SH_TO_UB "P-Code fuer die Art SH_TO_UB" VALUE 0x71620 TKW_VV_VV_UW 100.0 FORMULA_0010 0.0 65535.0 /end CHARACTERISTIC
/begin CHARACTERISTIC K_ED_FI_PMBATT.P_CODE_UNPLAUSIBEL "P-Code fuer die Art UNPLAUSIBEL" VALUE 0x71626 TKW_VV_VV_UW 100.0 FORMULA_0010 0.0 65535.0 /end CHARACTERISTIC
/begin CHARACTERISTIC K_ED_FI_PMBN.DEC_NACH_EINTRAG "Filterverringerung nach Fehlerspeichereintrag" VALUE 0x71613 TKW_VV_VV_UB 100.0 FORMULA_0003 0.0 255.0 /end CHARACTERISTIC
/begin CHARACTERISTIC K_ED_FI_PMBN.DEC_VOR_EINTRAG "Filterverringerung vorm Fehlerspeichereintrag" VALUE 0x71611 TKW_VV_VV_UB 100.0 FORMULA_0003 0.0 255.0 /end CHARACTERISTIC
/begin CHARACTERISTIC K_ED_FI_PMBN.FEHLERSCHWELLE "Filterschwelle fuer Fehlereintrag" VALUE 0x7160E TKW_VV_VV_UB 100.0 FORMULA_0003 0.0 255.0 /end CHARACTERISTIC
/begin CHARACTERISTIC K_ED_FI_PMBN.INC_NACH_EINTRAG "Filtererhoehung nach Fehlerspeichereintrag" VALUE 0x71612 TKW_VV_VV_UB 100.0 FORMULA_0003 0.0 255.0 /end CHARACTERISTIC
/begin CHARACTERISTIC K_ED_FI_PMBN.INC_VOR_EINTRAG "Filtererhoehung vorm Fehlerspeichereintrag" VALUE 0x71610 TKW_VV_VV_UB 100.0 FORMULA_0003 0.0 255.0 /end CHARACTERISTIC
/begin CHARACTERISTIC K_ED_FI_PMBN.KLASSENINDEX "Auswahl der Fehlerklasse" VALUE 0x71614 TKW_VV_VV_UB 100.0 FORMULA_0003 0.0 8.0 /end CHARACTERISTIC
/begin CHARACTERISTIC K_ED_FI_PMBN.OK_SCHWELLE "Filterschwelle fuer Fehleraustrag" VALUE 0x7160F TKW_VV_VV_UB 100.0 FORMULA_0003 0.0 255.0 /end CHARACTERISTIC
/begin CHARACTERISTIC K_ED_FI_PMBN.P_CODE_OPENLOAD "P-Code fuer die Art OPENLOAD" VALUE 0x7160A TKW_VV_VV_UW 100.0 FORMULA_0010 0.0 65535.0 /end CHARACTERISTIC
/begin CHARACTERISTIC K_ED_FI_PMBN.P_CODE_SH_TO_GND "P-Code fuer die Art SH_TO_GND" VALUE 0x71608 TKW_VV_VV_UW 100.0 FORMULA_0010 0.0 65535.0 /end CHARACTERISTIC
/begin CHARACTERISTIC K_ED_FI_PMBN.P_CODE_SH_TO_UB "P-Code fuer die Art SH_TO_UB" VALUE 0x71606 TKW_VV_VV_UW 100.0 FORMULA_0010 0.0 65535.0 /end CHARACTERISTIC
/begin CHARACTERISTIC K_ED_FI_PMBN.P_CODE_UNPLAUSIBEL "P-Code fuer die Art UNPLAUSIBEL" VALUE 0x7160C TKW_VV_VV_UW 100.0 FORMULA_0010 0.0 65535.0 /end CHARACTERISTIC
/begin CHARACTERISTIC K_ED_FI_PMRUHVERL.DEC_NACH_EINTRAG "Filterverringerung nach Fehlerspeichereintrag" VALUE 0x71731 TKW_VV_VV_UB 100.0 FORMULA_0003 0.0 255.0 /end CHARACTERISTIC
/begin CHARACTERISTIC K_ED_FI_PMRUHVERL.DEC_VOR_EINTRAG "Filterverringerung vorm Fehlerspeichereintrag" VALUE 0x7172F TKW_VV_VV_UB 100.0 FORMULA_0003 0.0 255.0 /end CHARACTERISTIC
/begin CHARACTERISTIC K_ED_FI_PMRUHVERL.FEHLERSCHWELLE "Filterschwelle fuer Fehlereintrag" VALUE 0x7172C TKW_VV_VV_UB 100.0 FORMULA_0003 0.0 255.0 /end CHARACTERISTIC
/begin CHARACTERISTIC K_ED_FI_PMRUHVERL.INC_NACH_EINTRAG "Filtererhoehung nach Fehlerspeichereintrag" VALUE 0x71730 TKW_VV_VV_UB 100.0 FORMULA_0003 0.0 255.0 /end CHARACTERISTIC
/begin CHARACTERISTIC K_ED_FI_PMRUHVERL.INC_VOR_EINTRAG "Filtererhoehung vorm Fehlerspeichereintrag" VALUE 0x7172E TKW_VV_VV_UB 100.0 FORMULA_0003 0.0 255.0 /end CHARACTERISTIC
/begin CHARACTERISTIC K_ED_FI_PMRUHVERL.KLASSENINDEX "Auswahl der Fehlerklasse" VALUE 0x71732 TKW_VV_VV_UB 100.0 FORMULA_0003 0.0 8.0 /end CHARACTERISTIC
/begin CHARACTERISTIC K_ED_FI_PMRUHVERL.OK_SCHWELLE "Filterschwelle fuer Fehleraustrag" VALUE 0x7172D TKW_VV_VV_UB 100.0 FORMULA_0003 0.0 255.0 /end CHARACTERISTIC
/begin CHARACTERISTIC K_ED_FI_PMRUHVERL.P_CODE_OPENLOAD "P-Code fuer die Art OPENLOAD" VALUE 0x71728 TKW_VV_VV_UW 100.0 FORMULA_0010 0.0 65535.0 /end CHARACTERISTIC
/begin CHARACTERISTIC K_ED_FI_PMRUHVERL.P_CODE_SH_TO_GND "P-Code fuer die Art SH_TO_GND" VALUE 0x71726 TKW_VV_VV_UW 100.0 FORMULA_0010 0.0 65535.0 /end CHARACTERISTIC
/begin CHARACTERISTIC K_ED_FI_PMRUHVERL.P_CODE_SH_TO_UB "P-Code fuer die Art SH_TO_UB" VALUE 0x71724 TKW_VV_VV_UW 100.0 FORMULA_0010 0.0 65535.0 /end CHARACTERISTIC
/begin CHARACTERISTIC K_ED_FI_PMRUHVERL.P_CODE_UNPLAUSIBEL "P-Code fuer die Art UNPLAUSIBEL" VALUE 0x7172A TKW_VV_VV_UW 100.0 FORMULA_0010 0.0 65535.0 /end CHARACTERISTIC
/begin CHARACTERISTIC K_ED_FI_QLT.DEC_NACH_EINTRAG "Filterverringerung nach Fehlerspeichereintrag" VALUE 0x715AB TKW_VV_VV_UB 100.0 FORMULA_0003 0.0 255.0 /end CHARACTERISTIC
/begin CHARACTERISTIC K_ED_FI_QLT.DEC_VOR_EINTRAG "Filterverringerung vorm Fehlerspeichereintrag" VALUE 0x715A9 TKW_VV_VV_UB 100.0 FORMULA_0003 0.0 255.0 /end CHARACTERISTIC
/begin CHARACTERISTIC K_ED_FI_QLT.FEHLERSCHWELLE "Filterschwelle fuer Fehlereintrag" VALUE 0x715A6 TKW_VV_VV_UB 100.0 FORMULA_0003 0.0 255.0 /end CHARACTERISTIC
/begin CHARACTERISTIC K_ED_FI_QLT.INC_NACH_EINTRAG "Filtererhoehung nach Fehlerspeichereintrag" VALUE 0x715AA TKW_VV_VV_UB 100.0 FORMULA_0003 0.0 255.0 /end CHARACTERISTIC
/begin CHARACTERISTIC K_ED_FI_QLT.INC_VOR_EINTRAG "Filtererhoehung vorm Fehlerspeichereintrag" VALUE 0x715A8 TKW_VV_VV_UB 100.0 FORMULA_0003 0.0 255.0 /end CHARACTERISTIC
/begin CHARACTERISTIC K_ED_FI_QLT.KLASSENINDEX "Auswahl der Fehlerklasse" VALUE 0x715AC TKW_VV_VV_UB 100.0 FORMULA_0003 0.0 8.0 /end CHARACTERISTIC
/begin CHARACTERISTIC K_ED_FI_QLT.OK_SCHWELLE "Filterschwelle fuer Fehleraustrag" VALUE 0x715A7 TKW_VV_VV_UB 100.0 FORMULA_0003 0.0 255.0 /end CHARACTERISTIC
/begin CHARACTERISTIC K_ED_FI_QLT.P_CODE_OPENLOAD "P-Code fuer die Art OPENLOAD" VALUE 0x715A2 TKW_VV_VV_UW 100.0 FORMULA_0010 0.0 65535.0 /end CHARACTERISTIC
/begin CHARACTERISTIC K_ED_FI_QLT.P_CODE_SH_TO_GND "P-Code fuer die Art SH_TO_GND" VALUE 0x715A0 TKW_VV_VV_UW 100.0 FORMULA_0010 0.0 65535.0 /end CHARACTERISTIC
/begin CHARACTERISTIC K_ED_FI_QLT.P_CODE_SH_TO_UB "P-Code fuer die Art SH_TO_UB" VALUE 0x7159E TKW_VV_VV_UW 100.0 FORMULA_0010 0.0 65535.0 /end CHARACTERISTIC
/begin CHARACTERISTIC K_ED_FI_QLT.P_CODE_UNPLAUSIBEL "P-Code fuer die Art UNPLAUSIBEL" VALUE 0x715A4 TKW_VV_VV_UW 100.0 FORMULA_0010 0.0 65535.0 /end CHARACTERISTIC
/begin CHARACTERISTIC K_ED_FI_TOENS.DEC_NACH_EINTRAG "Filterverringerung nach Fehlerspeichereintrag" VALUE 0x7174B TKW_VV_VV_UB 100.0 FORMULA_0003 0.0 255.0 /end CHARACTERISTIC
/begin CHARACTERISTIC K_ED_FI_TOENS.DEC_VOR_EINTRAG "Filterverringerung vorm Fehlerspeichereintrag" VALUE 0x71749 TKW_VV_VV_UB 100.0 FORMULA_0003 0.0 255.0 /end CHARACTERISTIC
/begin CHARACTERISTIC K_ED_FI_TOENS.FEHLERSCHWELLE "Filterschwelle fuer Fehlereintrag" VALUE 0x71746 TKW_VV_VV_UB 100.0 FORMULA_0003 0.0 255.0 /end CHARACTERISTIC
/begin CHARACTERISTIC K_ED_FI_TOENS.INC_NACH_EINTRAG "Filtererhoehung nach Fehlerspeichereintrag" VALUE 0x7174A TKW_VV_VV_UB 100.0 FORMULA_0003 0.0 255.0 /end CHARACTERISTIC
/begin CHARACTERISTIC K_ED_FI_TOENS.INC_VOR_EINTRAG "Filtererhoehung vorm Fehlerspeichereintrag" VALUE 0x71748 TKW_VV_VV_UB 100.0 FORMULA_0003 0.0 255.0 /end CHARACTERISTIC
/begin CHARACTERISTIC K_ED_FI_TOENS.KLASSENINDEX "Auswahl der Fehlerklasse" VALUE 0x7174C TKW_VV_VV_UB 100.0 FORMULA_0003 0.0 8.0 /end CHARACTERISTIC
/begin CHARACTERISTIC K_ED_FI_TOENS.OK_SCHWELLE "Filterschwelle fuer Fehleraustrag" VALUE 0x71747 TKW_VV_VV_UB 100.0 FORMULA_0003 0.0 255.0 /end CHARACTERISTIC
/begin CHARACTERISTIC K_ED_FI_TOENS.P_CODE_OPENLOAD "P-Code fuer die Art OPENLOAD" VALUE 0x71742 TKW_VV_VV_UW 100.0 FORMULA_0010 0.0 65535.0 /end CHARACTERISTIC
/begin CHARACTERISTIC K_ED_FI_TOENS.P_CODE_SH_TO_GND "P-Code fuer die Art SH_TO_GND" VALUE 0x71740 TKW_VV_VV_UW 100.0 FORMULA_0010 0.0 65535.0 /end CHARACTERISTIC
/begin CHARACTERISTIC K_ED_FI_TOENS.P_CODE_SH_TO_UB "P-Code fuer die Art SH_TO_UB" VALUE 0x7173E TKW_VV_VV_UW 100.0 FORMULA_0010 0.0 65535.0 /end CHARACTERISTIC
/begin CHARACTERISTIC K_ED_FI_TOENS.P_CODE_UNPLAUSIBEL "P-Code fuer die Art UNPLAUSIBEL" VALUE 0x71744 TKW_VV_VV_UW 100.0 FORMULA_0010 0.0 65535.0 /end CHARACTERISTIC
/begin CHARACTERISTIC K_ED_FPLAU1.DEC_NACH_EINTRAG "Filterverringerung nach Fehlerspeichereintrag" VALUE 0x70CD5 TKW_VV_VV_UB 100.0 FORMULA_0003 0.0 255.0 /end CHARACTERISTIC
/begin CHARACTERISTIC K_ED_FPLAU1.DEC_VOR_EINTRAG "Filterverringerung vorm Fehlerspeichereintrag" VALUE 0x70CD3 TKW_VV_VV_UB 100.0 FORMULA_0003 0.0 255.0 /end CHARACTERISTIC
/begin CHARACTERISTIC K_ED_FPLAU1.FEHLERSCHWELLE "Filterschwelle fuer Fehlereintrag" VALUE 0x70CD0 TKW_VV_VV_UB 100.0 FORMULA_0003 0.0 255.0 /end CHARACTERISTIC
/begin CHARACTERISTIC K_ED_FPLAU1.INC_NACH_EINTRAG "Filtererhoehung nach Fehlerspeichereintrag" VALUE 0x70CD4 TKW_VV_VV_UB 100.0 FORMULA_0003 0.0 255.0 /end CHARACTERISTIC
/begin CHARACTERISTIC K_ED_FPLAU1.INC_VOR_EINTRAG "Filtererhoehung vorm Fehlerspeichereintrag" VALUE 0x70CD2 TKW_VV_VV_UB 100.0 FORMULA_0003 0.0 255.0 /end CHARACTERISTIC
/begin CHARACTERISTIC K_ED_FPLAU1.KLASSENINDEX "Auswahl der Fehlerklasse" VALUE 0x70CD6 TKW_VV_VV_UB 100.0 FORMULA_0003 0.0 8.0 /end CHARACTERISTIC
/begin CHARACTERISTIC K_ED_FPLAU1.OK_SCHWELLE "Filterschwelle fuer Fehleraustrag" VALUE 0x70CD1 TKW_VV_VV_UB 100.0 FORMULA_0003 0.0 255.0 /end CHARACTERISTIC
/begin CHARACTERISTIC K_ED_FPLAU1.P_CODE_OPENLOAD "P-Code fuer die Art OPENLOAD" VALUE 0x70CCC TKW_VV_VV_UW 100.0 FORMULA_0010 0.0 65535.0 /end CHARACTERISTIC
/begin CHARACTERISTIC K_ED_FPLAU1.P_CODE_SH_TO_GND "P-Code fuer die Art SH_TO_GND" VALUE 0x70CCA TKW_VV_VV_UW 100.0 FORMULA_0010 0.0 65535.0 /end CHARACTERISTIC
/begin CHARACTERISTIC K_ED_FPLAU1.P_CODE_SH_TO_UB "P-Code fuer die Art SH_TO_UB" VALUE 0x70CC8 TKW_VV_VV_UW 100.0 FORMULA_0010 0.0 65535.0 /end CHARACTERISTIC
/begin CHARACTERISTIC K_ED_FPLAU1.P_CODE_UNPLAUSIBEL "P-Code fuer die Art UNPLAUSIBEL" VALUE 0x70CCE TKW_VV_VV_UW 100.0 FORMULA_0010 0.0 65535.0 /end CHARACTERISTIC
/begin CHARACTERISTIC K_ED_FPLAU2.DEC_NACH_EINTRAG "Filterverringerung nach Fehlerspeichereintrag" VALUE 0x70CEF TKW_VV_VV_UB 100.0 FORMULA_0003 0.0 255.0 /end CHARACTERISTIC
/begin CHARACTERISTIC K_ED_FPLAU2.DEC_VOR_EINTRAG "Filterverringerung vorm Fehlerspeichereintrag" VALUE 0x70CED TKW_VV_VV_UB 100.0 FORMULA_0003 0.0 255.0 /end CHARACTERISTIC
/begin CHARACTERISTIC K_ED_FPLAU2.FEHLERSCHWELLE "Filterschwelle fuer Fehlereintrag" VALUE 0x70CEA TKW_VV_VV_UB 100.0 FORMULA_0003 0.0 255.0 /end CHARACTERISTIC
/begin CHARACTERISTIC K_ED_FPLAU2.INC_NACH_EINTRAG "Filtererhoehung nach Fehlerspeichereintrag" VALUE 0x70CEE TKW_VV_VV_UB 100.0 FORMULA_0003 0.0 255.0 /end CHARACTERISTIC
/begin CHARACTERISTIC K_ED_FPLAU2.INC_VOR_EINTRAG "Filtererhoehung vorm Fehlerspeichereintrag" VALUE 0x70CEC TKW_VV_VV_UB 100.0 FORMULA_0003 0.0 255.0 /end CHARACTERISTIC
/begin CHARACTERISTIC K_ED_FPLAU2.KLASSENINDEX "Auswahl der Fehlerklasse" VALUE 0x70CF0 TKW_VV_VV_UB 100.0 FORMULA_0003 0.0 8.0 /end CHARACTERISTIC
/begin CHARACTERISTIC K_ED_FPLAU2.OK_SCHWELLE "Filterschwelle fuer Fehleraustrag" VALUE 0x70CEB TKW_VV_VV_UB 100.0 FORMULA_0003 0.0 255.0 /end CHARACTERISTIC
/begin CHARACTERISTIC K_ED_FPLAU2.P_CODE_OPENLOAD "P-Code fuer die Art OPENLOAD" VALUE 0x70CE6 TKW_VV_VV_UW 100.0 FORMULA_0010 0.0 65535.0 /end CHARACTERISTIC
/begin CHARACTERISTIC K_ED_FPLAU2.P_CODE_SH_TO_GND "P-Code fuer die Art SH_TO_GND" VALUE 0x70CE4 TKW_VV_VV_UW 100.0 FORMULA_0010 0.0 65535.0 /end CHARACTERISTIC
/begin CHARACTERISTIC K_ED_FPLAU2.P_CODE_SH_TO_UB "P-Code fuer die Art SH_TO_UB" VALUE 0x70CE2 TKW_VV_VV_UW 100.0 FORMULA_0010 0.0 65535.0 /end CHARACTERISTIC
/begin CHARACTERISTIC K_ED_FPLAU2.P_CODE_UNPLAUSIBEL "P-Code fuer die Art UNPLAUSIBEL" VALUE 0x70CE8 TKW_VV_VV_UW 100.0 FORMULA_0010 0.0 65535.0 /end CHARACTERISTIC
/begin CHARACTERISTIC K_ED_FST.DEC_NACH_EINTRAG "Filterverringerung nach Fehlerspeichereintrag" VALUE 0x718EB TKW_VV_VV_UB 100.0 FORMULA_0003 0.0 255.0 /end CHARACTERISTIC
/begin CHARACTERISTIC K_ED_FST.DEC_VOR_EINTRAG "Filterverringerung vorm Fehlerspeichereintrag" VALUE 0x718E9 TKW_VV_VV_UB 100.0 FORMULA_0003 0.0 255.0 /end CHARACTERISTIC
/begin CHARACTERISTIC K_ED_FST.FEHLERSCHWELLE "Filterschwelle fuer Fehlereintrag" VALUE 0x718E6 TKW_VV_VV_UB 100.0 FORMULA_0003 0.0 255.0 /end CHARACTERISTIC
/begin CHARACTERISTIC K_ED_FST.INC_NACH_EINTRAG "Filtererhoehung nach Fehlerspeichereintrag" VALUE 0x718EA TKW_VV_VV_UB 100.0 FORMULA_0003 0.0 255.0 /end CHARACTERISTIC
/begin CHARACTERISTIC K_ED_FST.INC_VOR_EINTRAG "Filtererhoehung vorm Fehlerspeichereintrag" VALUE 0x718E8 TKW_VV_VV_UB 100.0 FORMULA_0003 0.0 255.0 /end CHARACTERISTIC
/begin CHARACTERISTIC K_ED_FST.KLASSENINDEX "Auswahl der Fehlerklasse" VALUE 0x718EC TKW_VV_VV_UB 100.0 FORMULA_0003 0.0 8.0 /end CHARACTERISTIC
/begin CHARACTERISTIC K_ED_FST.OK_SCHWELLE "Filterschwelle fuer Fehleraustrag" VALUE 0x718E7 TKW_VV_VV_UB 100.0 FORMULA_0003 0.0 255.0 /end CHARACTERISTIC
/begin CHARACTERISTIC K_ED_FST.P_CODE_OPENLOAD "P-Code fuer die Art OPENLOAD" VALUE 0x718E2 TKW_VV_VV_UW 100.0 FORMULA_0010 0.0 65535.0 /end CHARACTERISTIC
/begin CHARACTERISTIC K_ED_FST.P_CODE_SH_TO_GND "P-Code fuer die Art SH_TO_GND" VALUE 0x718E0 TKW_VV_VV_UW 100.0 FORMULA_0010 0.0 65535.0 /end CHARACTERISTIC
/begin CHARACTERISTIC K_ED_FST.P_CODE_SH_TO_UB "P-Code fuer die Art SH_TO_UB" VALUE 0x718DE TKW_VV_VV_UW 100.0 FORMULA_0010 0.0 65535.0 /end CHARACTERISTIC
/begin CHARACTERISTIC K_ED_FST.P_CODE_UNPLAUSIBEL "P-Code fuer die Art UNPLAUSIBEL" VALUE 0x718E4 TKW_VV_VV_UW 100.0 FORMULA_0010 0.0 65535.0 /end CHARACTERISTIC
/begin CHARACTERISTIC K_ED_FST_GEBER.DEC_NACH_EINTRAG "Filterverringerung nach Fehlerspeichereintrag" VALUE 0x71ABF TKW_VV_VV_UB 100.0 FORMULA_0003 0.0 255.0 /end CHARACTERISTIC
/begin CHARACTERISTIC K_ED_FST_GEBER.DEC_VOR_EINTRAG "Filterverringerung vorm Fehlerspeichereintrag" VALUE 0x71ABD TKW_VV_VV_UB 100.0 FORMULA_0003 0.0 255.0 /end CHARACTERISTIC
/begin CHARACTERISTIC K_ED_FST_GEBER.FEHLERSCHWELLE "Filterschwelle fuer Fehlereintrag" VALUE 0x71ABA TKW_VV_VV_UB 100.0 FORMULA_0003 0.0 255.0 /end CHARACTERISTIC
/begin CHARACTERISTIC K_ED_FST_GEBER.INC_NACH_EINTRAG "Filtererhoehung nach Fehlerspeichereintrag" VALUE 0x71ABE TKW_VV_VV_UB 100.0 FORMULA_0003 0.0 255.0 /end CHARACTERISTIC
/begin CHARACTERISTIC K_ED_FST_GEBER.INC_VOR_EINTRAG "Filtererhoehung vorm Fehlerspeichereintrag" VALUE 0x71ABC TKW_VV_VV_UB 100.0 FORMULA_0003 0.0 255.0 /end CHARACTERISTIC
/begin CHARACTERISTIC K_ED_FST_GEBER.KLASSENINDEX "Auswahl der Fehlerklasse" VALUE 0x71AC0 TKW_VV_VV_UB 100.0 FORMULA_0003 0.0 8.0 /end CHARACTERISTIC
/begin CHARACTERISTIC K_ED_FST_GEBER.OK_SCHWELLE "Filterschwelle fuer Fehleraustrag" VALUE 0x71ABB TKW_VV_VV_UB 100.0 FORMULA_0003 0.0 255.0 /end CHARACTERISTIC
/begin CHARACTERISTIC K_ED_FST_GEBER.P_CODE_OPENLOAD "P-Code fuer die Art OPENLOAD" VALUE 0x71AB6 TKW_VV_VV_UW 100.0 FORMULA_0010 0.0 65535.0 /end CHARACTERISTIC
/begin CHARACTERISTIC K_ED_FST_GEBER.P_CODE_SH_TO_GND "P-Code fuer die Art SH_TO_GND" VALUE 0x71AB4 TKW_VV_VV_UW 100.0 FORMULA_0010 0.0 65535.0 /end CHARACTERISTIC
/begin CHARACTERISTIC K_ED_FST_GEBER.P_CODE_SH_TO_UB "P-Code fuer die Art SH_TO_UB" VALUE 0x71AB2 TKW_VV_VV_UW 100.0 FORMULA_0010 0.0 65535.0 /end CHARACTERISTIC
/begin CHARACTERISTIC K_ED_FST_GEBER.P_CODE_UNPLAUSIBEL "P-Code fuer die Art UNPLAUSIBEL" VALUE 0x71AB8 TKW_VV_VV_UW 100.0 FORMULA_0010 0.0 65535.0 /end CHARACTERISTIC
/begin CHARACTERISTIC K_ED_HFM1.DEC_NACH_EINTRAG "Filterverringerung nach Fehlerspeichereintrag" VALUE 0x70913 TKW_VV_VV_UB 100.0 FORMULA_0003 0.0 255.0 /end CHARACTERISTIC
/begin CHARACTERISTIC K_ED_HFM1.DEC_VOR_EINTRAG "Filterverringerung vorm Fehlerspeichereintrag" VALUE 0x70911 TKW_VV_VV_UB 100.0 FORMULA_0003 0.0 255.0 /end CHARACTERISTIC
/begin CHARACTERISTIC K_ED_HFM1.FEHLERSCHWELLE "Filterschwelle fuer Fehlereintrag" VALUE 0x7090E TKW_VV_VV_UB 100.0 FORMULA_0003 0.0 255.0 /end CHARACTERISTIC
/begin CHARACTERISTIC K_ED_HFM1.INC_NACH_EINTRAG "Filtererhoehung nach Fehlerspeichereintrag" VALUE 0x70912 TKW_VV_VV_UB 100.0 FORMULA_0003 0.0 255.0 /end CHARACTERISTIC
/begin CHARACTERISTIC K_ED_HFM1.INC_VOR_EINTRAG "Filtererhoehung vorm Fehlerspeichereintrag" VALUE 0x70910 TKW_VV_VV_UB 100.0 FORMULA_0003 0.0 255.0 /end CHARACTERISTIC
/begin CHARACTERISTIC K_ED_HFM1.KLASSENINDEX "Auswahl der Fehlerklasse" VALUE 0x70914 TKW_VV_VV_UB 100.0 FORMULA_0003 0.0 8.0 /end CHARACTERISTIC
/begin CHARACTERISTIC K_ED_HFM1.OK_SCHWELLE "Filterschwelle fuer Fehleraustrag" VALUE 0x7090F TKW_VV_VV_UB 100.0 FORMULA_0003 0.0 255.0 /end CHARACTERISTIC
/begin CHARACTERISTIC K_ED_HFM1.P_CODE_OPENLOAD "P-Code fuer die Art OPENLOAD" VALUE 0x7090A TKW_VV_VV_UW 100.0 FORMULA_0010 0.0 65535.0 /end CHARACTERISTIC
/begin CHARACTERISTIC K_ED_HFM1.P_CODE_SH_TO_GND "P-Code fuer die Art SH_TO_GND" VALUE 0x70908 TKW_VV_VV_UW 100.0 FORMULA_0010 0.0 65535.0 /end CHARACTERISTIC
/begin CHARACTERISTIC K_ED_HFM1.P_CODE_SH_TO_UB "P-Code fuer die Art SH_TO_UB" VALUE 0x70906 TKW_VV_VV_UW 100.0 FORMULA_0010 0.0 65535.0 /end CHARACTERISTIC
/begin CHARACTERISTIC K_ED_HFM1.P_CODE_UNPLAUSIBEL "P-Code fuer die Art UNPLAUSIBEL" VALUE 0x7090C TKW_VV_VV_UW 100.0 FORMULA_0010 0.0 65535.0 /end CHARACTERISTIC
/begin CHARACTERISTIC K_ED_HFM2.DEC_NACH_EINTRAG "Filterverringerung nach Fehlerspeichereintrag" VALUE 0x7092D TKW_VV_VV_UB 100.0 FORMULA_0003 0.0 255.0 /end CHARACTERISTIC
/begin CHARACTERISTIC K_ED_HFM2.DEC_VOR_EINTRAG "Filterverringerung vorm Fehlerspeichereintrag" VALUE 0x7092B TKW_VV_VV_UB 100.0 FORMULA_0003 0.0 255.0 /end CHARACTERISTIC
/begin CHARACTERISTIC K_ED_HFM2.FEHLERSCHWELLE "Filterschwelle fuer Fehlereintrag" VALUE 0x70928 TKW_VV_VV_UB 100.0 FORMULA_0003 0.0 255.0 /end CHARACTERISTIC
/begin CHARACTERISTIC K_ED_HFM2.INC_NACH_EINTRAG "Filtererhoehung nach Fehlerspeichereintrag" VALUE 0x7092C TKW_VV_VV_UB 100.0 FORMULA_0003 0.0 255.0 /end CHARACTERISTIC
/begin CHARACTERISTIC K_ED_HFM2.INC_VOR_EINTRAG "Filtererhoehung vorm Fehlerspeichereintrag" VALUE 0x7092A TKW_VV_VV_UB 100.0 FORMULA_0003 0.0 255.0 /end CHARACTERISTIC
/begin CHARACTERISTIC K_ED_HFM2.KLASSENINDEX "Auswahl der Fehlerklasse" VALUE 0x7092E TKW_VV_VV_UB 100.0 FORMULA_0003 0.0 8.0 /end CHARACTERISTIC
/begin CHARACTERISTIC K_ED_HFM2.OK_SCHWELLE "Filterschwelle fuer Fehleraustrag" VALUE 0x70929 TKW_VV_VV_UB 100.0 FORMULA_0003 0.0 255.0 /end CHARACTERISTIC
/begin CHARACTERISTIC K_ED_HFM2.P_CODE_OPENLOAD "P-Code fuer die Art OPENLOAD" VALUE 0x70924 TKW_VV_VV_UW 100.0 FORMULA_0010 0.0 65535.0 /end CHARACTERISTIC
/begin CHARACTERISTIC K_ED_HFM2.P_CODE_SH_TO_GND "P-Code fuer die Art SH_TO_GND" VALUE 0x70922 TKW_VV_VV_UW 100.0 FORMULA_0010 0.0 65535.0 /end CHARACTERISTIC
/begin CHARACTERISTIC K_ED_HFM2.P_CODE_SH_TO_UB "P-Code fuer die Art SH_TO_UB" VALUE 0x70920 TKW_VV_VV_UW 100.0 FORMULA_0010 0.0 65535.0 /end CHARACTERISTIC
/begin CHARACTERISTIC K_ED_HFM2.P_CODE_UNPLAUSIBEL "P-Code fuer die Art UNPLAUSIBEL" VALUE 0x70926 TKW_VV_VV_UW 100.0 FORMULA_0010 0.0 65535.0 /end CHARACTERISTIC
/begin CHARACTERISTIC K_ED_INDEX_135_INJ.DEC_NACH_EINTRAG "Filterverringerung nach Fehlerspeichereintrag" VALUE 0x71695 TKW_VV_VV_UB 100.0 FORMULA_0003 0.0 255.0 /end CHARACTERISTIC
/begin CHARACTERISTIC K_ED_INDEX_135_INJ.DEC_VOR_EINTRAG "Filterverringerung vorm Fehlerspeichereintrag" VALUE 0x71693 TKW_VV_VV_UB 100.0 FORMULA_0003 0.0 255.0 /end CHARACTERISTIC
/begin CHARACTERISTIC K_ED_INDEX_135_INJ.FEHLERSCHWELLE "Filterschwelle fuer Fehlereintrag" VALUE 0x71690 TKW_VV_VV_UB 100.0 FORMULA_0003 0.0 255.0 /end CHARACTERISTIC
/begin CHARACTERISTIC K_ED_INDEX_135_INJ.INC_NACH_EINTRAG "Filtererhoehung nach Fehlerspeichereintrag" VALUE 0x71694 TKW_VV_VV_UB 100.0 FORMULA_0003 0.0 255.0 /end CHARACTERISTIC
/begin CHARACTERISTIC K_ED_INDEX_135_INJ.INC_VOR_EINTRAG "Filtererhoehung vorm Fehlerspeichereintrag" VALUE 0x71692 TKW_VV_VV_UB 100.0 FORMULA_0003 0.0 255.0 /end CHARACTERISTIC
/begin CHARACTERISTIC K_ED_INDEX_135_INJ.KLASSENINDEX "Auswahl der Fehlerklasse" VALUE 0x71696 TKW_VV_VV_UB 100.0 FORMULA_0003 0.0 8.0 /end CHARACTERISTIC
/begin CHARACTERISTIC K_ED_INDEX_135_INJ.OK_SCHWELLE "Filterschwelle fuer Fehleraustrag" VALUE 0x71691 TKW_VV_VV_UB 100.0 FORMULA_0003 0.0 255.0 /end CHARACTERISTIC
/begin CHARACTERISTIC K_ED_INDEX_135_INJ.P_CODE_OPENLOAD "P-Code fuer die Art OPENLOAD" VALUE 0x7168C TKW_VV_VV_UW 100.0 FORMULA_0010 0.0 65535.0 /end CHARACTERISTIC
/begin CHARACTERISTIC K_ED_INDEX_135_INJ.P_CODE_SH_TO_GND "P-Code fuer die Art SH_TO_GND" VALUE 0x7168A TKW_VV_VV_UW 100.0 FORMULA_0010 0.0 65535.0 /end CHARACTERISTIC
/begin CHARACTERISTIC K_ED_INDEX_135_INJ.P_CODE_SH_TO_UB "P-Code fuer die Art SH_TO_UB" VALUE 0x71688 TKW_VV_VV_UW 100.0 FORMULA_0010 0.0 65535.0 /end CHARACTERISTIC
/begin CHARACTERISTIC K_ED_INDEX_135_INJ.P_CODE_UNPLAUSIBEL "P-Code fuer die Art UNPLAUSIBEL" VALUE 0x7168E TKW_VV_VV_UW 100.0 FORMULA_0010 0.0 65535.0 /end CHARACTERISTIC
/begin CHARACTERISTIC K_ED_INDEX_15_INJ.DEC_NACH_EINTRAG "Filterverringerung nach Fehlerspeichereintrag" VALUE 0x70A65 TKW_VV_VV_UB 100.0 FORMULA_0003 0.0 255.0 /end CHARACTERISTIC
/begin CHARACTERISTIC K_ED_INDEX_15_INJ.DEC_VOR_EINTRAG "Filterverringerung vorm Fehlerspeichereintrag" VALUE 0x70A63 TKW_VV_VV_UB 100.0 FORMULA_0003 0.0 255.0 /end CHARACTERISTIC
/begin CHARACTERISTIC K_ED_INDEX_15_INJ.FEHLERSCHWELLE "Filterschwelle fuer Fehlereintrag" VALUE 0x70A60 TKW_VV_VV_UB 100.0 FORMULA_0003 0.0 255.0 /end CHARACTERISTIC
/begin CHARACTERISTIC K_ED_INDEX_15_INJ.INC_NACH_EINTRAG "Filtererhoehung nach Fehlerspeichereintrag" VALUE 0x70A64 TKW_VV_VV_UB 100.0 FORMULA_0003 0.0 255.0 /end CHARACTERISTIC
/begin CHARACTERISTIC K_ED_INDEX_15_INJ.INC_VOR_EINTRAG "Filtererhoehung vorm Fehlerspeichereintrag" VALUE 0x70A62 TKW_VV_VV_UB 100.0 FORMULA_0003 0.0 255.0 /end CHARACTERISTIC
/begin CHARACTERISTIC K_ED_INDEX_15_INJ.KLASSENINDEX "Auswahl der Fehlerklasse" VALUE 0x70A66 TKW_VV_VV_UB 100.0 FORMULA_0003 0.0 8.0 /end CHARACTERISTIC
/begin CHARACTERISTIC K_ED_INDEX_15_INJ.OK_SCHWELLE "Filterschwelle fuer Fehleraustrag" VALUE 0x70A61 TKW_VV_VV_UB 100.0 FORMULA_0003 0.0 255.0 /end CHARACTERISTIC
/begin CHARACTERISTIC K_ED_INDEX_15_INJ.P_CODE_OPENLOAD "P-Code fuer die Art OPENLOAD" VALUE 0x70A5C TKW_VV_VV_UW 100.0 FORMULA_0010 0.0 65535.0 /end CHARACTERISTIC
/begin CHARACTERISTIC K_ED_INDEX_15_INJ.P_CODE_SH_TO_GND "P-Code fuer die Art SH_TO_GND" VALUE 0x70A5A TKW_VV_VV_UW 100.0 FORMULA_0010 0.0 65535.0 /end CHARACTERISTIC
/begin CHARACTERISTIC K_ED_INDEX_15_INJ.P_CODE_SH_TO_UB "P-Code fuer die Art SH_TO_UB" VALUE 0x70A58 TKW_VV_VV_UW 100.0 FORMULA_0010 0.0 65535.0 /end CHARACTERISTIC
/begin CHARACTERISTIC K_ED_INDEX_15_INJ.P_CODE_UNPLAUSIBEL "P-Code fuer die Art UNPLAUSIBEL" VALUE 0x70A5E TKW_VV_VV_UW 100.0 FORMULA_0010 0.0 65535.0 /end CHARACTERISTIC
/begin CHARACTERISTIC K_ED_INDEX_196_INJ.DEC_NACH_EINTRAG "Filterverringerung nach Fehlerspeichereintrag" VALUE 0x71CC7 TKW_VV_VV_UB 100.0 FORMULA_0003 0.0 255.0 /end CHARACTERISTIC
/begin CHARACTERISTIC K_ED_INDEX_196_INJ.DEC_VOR_EINTRAG "Filterverringerung vorm Fehlerspeichereintrag" VALUE 0x71CC5 TKW_VV_VV_UB 100.0 FORMULA_0003 0.0 255.0 /end CHARACTERISTIC
/begin CHARACTERISTIC K_ED_INDEX_196_INJ.FEHLERSCHWELLE "Filterschwelle fuer Fehlereintrag" VALUE 0x71CC2 TKW_VV_VV_UB 100.0 FORMULA_0003 0.0 255.0 /end CHARACTERISTIC
/begin CHARACTERISTIC K_ED_INDEX_196_INJ.INC_NACH_EINTRAG "Filtererhoehung nach Fehlerspeichereintrag" VALUE 0x71CC6 TKW_VV_VV_UB 100.0 FORMULA_0003 0.0 255.0 /end CHARACTERISTIC
/begin CHARACTERISTIC K_ED_INDEX_196_INJ.INC_VOR_EINTRAG "Filtererhoehung vorm Fehlerspeichereintrag" VALUE 0x71CC4 TKW_VV_VV_UB 100.0 FORMULA_0003 0.0 255.0 /end CHARACTERISTIC
/begin CHARACTERISTIC K_ED_INDEX_196_INJ.KLASSENINDEX "Auswahl der Fehlerklasse" VALUE 0x71CC8 TKW_VV_VV_UB 100.0 FORMULA_0003 0.0 8.0 /end CHARACTERISTIC
/begin CHARACTERISTIC K_ED_INDEX_196_INJ.OK_SCHWELLE "Filterschwelle fuer Fehleraustrag" VALUE 0x71CC3 TKW_VV_VV_UB 100.0 FORMULA_0003 0.0 255.0 /end CHARACTERISTIC
/begin CHARACTERISTIC K_ED_INDEX_196_INJ.P_CODE_OPENLOAD "P-Code fuer die Art OPENLOAD" VALUE 0x71CBE TKW_VV_VV_UW 100.0 FORMULA_0010 0.0 65535.0 /end CHARACTERISTIC
/begin CHARACTERISTIC K_ED_INDEX_196_INJ.P_CODE_SH_TO_GND "P-Code fuer die Art SH_TO_GND" VALUE 0x71CBC TKW_VV_VV_UW 100.0 FORMULA_0010 0.0 65535.0 /end CHARACTERISTIC
/begin CHARACTERISTIC K_ED_INDEX_196_INJ.P_CODE_SH_TO_UB "P-Code fuer die Art SH_TO_UB" VALUE 0x71CBA TKW_VV_VV_UW 100.0 FORMULA_0010 0.0 65535.0 /end CHARACTERISTIC
/begin CHARACTERISTIC K_ED_INDEX_196_INJ.P_CODE_UNPLAUSIBEL "P-Code fuer die Art UNPLAUSIBEL" VALUE 0x71CC0 TKW_VV_VV_UW 100.0 FORMULA_0010 0.0 65535.0 /end CHARACTERISTIC
/begin CHARACTERISTIC K_ED_INDEX_197_INJ.DEC_NACH_EINTRAG "Filterverringerung nach Fehlerspeichereintrag" VALUE 0x71CE1 TKW_VV_VV_UB 100.0 FORMULA_0003 0.0 255.0 /end CHARACTERISTIC
/begin CHARACTERISTIC K_ED_INDEX_197_INJ.DEC_VOR_EINTRAG "Filterverringerung vorm Fehlerspeichereintrag" VALUE 0x71CDF TKW_VV_VV_UB 100.0 FORMULA_0003 0.0 255.0 /end CHARACTERISTIC
/begin CHARACTERISTIC K_ED_INDEX_197_INJ.FEHLERSCHWELLE "Filterschwelle fuer Fehlereintrag" VALUE 0x71CDC TKW_VV_VV_UB 100.0 FORMULA_0003 0.0 255.0 /end CHARACTERISTIC
/begin CHARACTERISTIC K_ED_INDEX_197_INJ.INC_NACH_EINTRAG "Filtererhoehung nach Fehlerspeichereintrag" VALUE 0x71CE0 TKW_VV_VV_UB 100.0 FORMULA_0003 0.0 255.0 /end CHARACTERISTIC
/begin CHARACTERISTIC K_ED_INDEX_197_INJ.INC_VOR_EINTRAG "Filtererhoehung vorm Fehlerspeichereintrag" VALUE 0x71CDE TKW_VV_VV_UB 100.0 FORMULA_0003 0.0 255.0 /end CHARACTERISTIC
/begin CHARACTERISTIC K_ED_INDEX_197_INJ.KLASSENINDEX "Auswahl der Fehlerklasse" VALUE 0x71CE2 TKW_VV_VV_UB 100.0 FORMULA_0003 0.0 8.0 /end CHARACTERISTIC
/begin CHARACTERISTIC K_ED_INDEX_197_INJ.OK_SCHWELLE "Filterschwelle fuer Fehleraustrag" VALUE 0x71CDD TKW_VV_VV_UB 100.0 FORMULA_0003 0.0 255.0 /end CHARACTERISTIC
/begin CHARACTERISTIC K_ED_INDEX_197_INJ.P_CODE_OPENLOAD "P-Code fuer die Art OPENLOAD" VALUE 0x71CD8 TKW_VV_VV_UW 100.0 FORMULA_0010 0.0 65535.0 /end CHARACTERISTIC
/begin CHARACTERISTIC K_ED_INDEX_197_INJ.P_CODE_SH_TO_GND "P-Code fuer die Art SH_TO_GND" VALUE 0x71CD6 TKW_VV_VV_UW 100.0 FORMULA_0010 0.0 65535.0 /end CHARACTERISTIC
/begin CHARACTERISTIC K_ED_INDEX_197_INJ.P_CODE_SH_TO_UB "P-Code fuer die Art SH_TO_UB" VALUE 0x71CD4 TKW_VV_VV_UW 100.0 FORMULA_0010 0.0 65535.0 /end CHARACTERISTIC
/begin CHARACTERISTIC K_ED_INDEX_197_INJ.P_CODE_UNPLAUSIBEL "P-Code fuer die Art UNPLAUSIBEL" VALUE 0x71CDA TKW_VV_VV_UW 100.0 FORMULA_0010 0.0 65535.0 /end CHARACTERISTIC
/begin CHARACTERISTIC K_ED_INDEX_198_INJ.DEC_NACH_EINTRAG "Filterverringerung nach Fehlerspeichereintrag" VALUE 0x71CFB TKW_VV_VV_UB 100.0 FORMULA_0003 0.0 255.0 /end CHARACTERISTIC
/begin CHARACTERISTIC K_ED_INDEX_198_INJ.DEC_VOR_EINTRAG "Filterverringerung vorm Fehlerspeichereintrag" VALUE 0x71CF9 TKW_VV_VV_UB 100.0 FORMULA_0003 0.0 255.0 /end CHARACTERISTIC
/begin CHARACTERISTIC K_ED_INDEX_198_INJ.FEHLERSCHWELLE "Filterschwelle fuer Fehlereintrag" VALUE 0x71CF6 TKW_VV_VV_UB 100.0 FORMULA_0003 0.0 255.0 /end CHARACTERISTIC
/begin CHARACTERISTIC K_ED_INDEX_198_INJ.INC_NACH_EINTRAG "Filtererhoehung nach Fehlerspeichereintrag" VALUE 0x71CFA TKW_VV_VV_UB 100.0 FORMULA_0003 0.0 255.0 /end CHARACTERISTIC
/begin CHARACTERISTIC K_ED_INDEX_198_INJ.INC_VOR_EINTRAG "Filtererhoehung vorm Fehlerspeichereintrag" VALUE 0x71CF8 TKW_VV_VV_UB 100.0 FORMULA_0003 0.0 255.0 /end CHARACTERISTIC
/begin CHARACTERISTIC K_ED_INDEX_198_INJ.KLASSENINDEX "Auswahl der Fehlerklasse" VALUE 0x71CFC TKW_VV_VV_UB 100.0 FORMULA_0003 0.0 8.0 /end CHARACTERISTIC
/begin CHARACTERISTIC K_ED_INDEX_198_INJ.OK_SCHWELLE "Filterschwelle fuer Fehleraustrag" VALUE 0x71CF7 TKW_VV_VV_UB 100.0 FORMULA_0003 0.0 255.0 /end CHARACTERISTIC
/begin CHARACTERISTIC K_ED_INDEX_198_INJ.P_CODE_OPENLOAD "P-Code fuer die Art OPENLOAD" VALUE 0x71CF2 TKW_VV_VV_UW 100.0 FORMULA_0010 0.0 65535.0 /end CHARACTERISTIC
/begin CHARACTERISTIC K_ED_INDEX_198_INJ.P_CODE_SH_TO_GND "P-Code fuer die Art SH_TO_GND" VALUE 0x71CF0 TKW_VV_VV_UW 100.0 FORMULA_0010 0.0 65535.0 /end CHARACTERISTIC
/begin CHARACTERISTIC K_ED_INDEX_198_INJ.P_CODE_SH_TO_UB "P-Code fuer die Art SH_TO_UB" VALUE 0x71CEE TKW_VV_VV_UW 100.0 FORMULA_0010 0.0 65535.0 /end CHARACTERISTIC
/begin CHARACTERISTIC K_ED_INDEX_198_INJ.P_CODE_UNPLAUSIBEL "P-Code fuer die Art UNPLAUSIBEL" VALUE 0x71CF4 TKW_VV_VV_UW 100.0 FORMULA_0010 0.0 65535.0 /end CHARACTERISTIC
/begin CHARACTERISTIC K_ED_INDEX_199_INJ.DEC_NACH_EINTRAG "Filterverringerung nach Fehlerspeichereintrag" VALUE 0x71D15 TKW_VV_VV_UB 100.0 FORMULA_0003 0.0 255.0 /end CHARACTERISTIC
/begin CHARACTERISTIC K_ED_INDEX_199_INJ.DEC_VOR_EINTRAG "Filterverringerung vorm Fehlerspeichereintrag" VALUE 0x71D13 TKW_VV_VV_UB 100.0 FORMULA_0003 0.0 255.0 /end CHARACTERISTIC
/begin CHARACTERISTIC K_ED_INDEX_199_INJ.FEHLERSCHWELLE "Filterschwelle fuer Fehlereintrag" VALUE 0x71D10 TKW_VV_VV_UB 100.0 FORMULA_0003 0.0 255.0 /end CHARACTERISTIC
/begin CHARACTERISTIC K_ED_INDEX_199_INJ.INC_NACH_EINTRAG "Filtererhoehung nach Fehlerspeichereintrag" VALUE 0x71D14 TKW_VV_VV_UB 100.0 FORMULA_0003 0.0 255.0 /end CHARACTERISTIC
/begin CHARACTERISTIC K_ED_INDEX_199_INJ.INC_VOR_EINTRAG "Filtererhoehung vorm Fehlerspeichereintrag" VALUE 0x71D12 TKW_VV_VV_UB 100.0 FORMULA_0003 0.0 255.0 /end CHARACTERISTIC
/begin CHARACTERISTIC K_ED_INDEX_199_INJ.KLASSENINDEX "Auswahl der Fehlerklasse" VALUE 0x71D16 TKW_VV_VV_UB 100.0 FORMULA_0003 0.0 8.0 /end CHARACTERISTIC
/begin CHARACTERISTIC K_ED_INDEX_199_INJ.OK_SCHWELLE "Filterschwelle fuer Fehleraustrag" VALUE 0x71D11 TKW_VV_VV_UB 100.0 FORMULA_0003 0.0 255.0 /end CHARACTERISTIC
/begin CHARACTERISTIC K_ED_INDEX_199_INJ.P_CODE_OPENLOAD "P-Code fuer die Art OPENLOAD" VALUE 0x71D0C TKW_VV_VV_UW 100.0 FORMULA_0010 0.0 65535.0 /end CHARACTERISTIC
/begin CHARACTERISTIC K_ED_INDEX_199_INJ.P_CODE_SH_TO_GND "P-Code fuer die Art SH_TO_GND" VALUE 0x71D0A TKW_VV_VV_UW 100.0 FORMULA_0010 0.0 65535.0 /end CHARACTERISTIC
/begin CHARACTERISTIC K_ED_INDEX_199_INJ.P_CODE_SH_TO_UB "P-Code fuer die Art SH_TO_UB" VALUE 0x71D08 TKW_VV_VV_UW 100.0 FORMULA_0010 0.0 65535.0 /end CHARACTERISTIC
/begin CHARACTERISTIC K_ED_INDEX_199_INJ.P_CODE_UNPLAUSIBEL "P-Code fuer die Art UNPLAUSIBEL" VALUE 0x71D0E TKW_VV_VV_UW 100.0 FORMULA_0010 0.0 65535.0 /end CHARACTERISTIC
/begin CHARACTERISTIC K_ED_INDEX_200_INJ.DEC_NACH_EINTRAG "Filterverringerung nach Fehlerspeichereintrag" VALUE 0x71D2F TKW_VV_VV_UB 100.0 FORMULA_0003 0.0 255.0 /end CHARACTERISTIC
/begin CHARACTERISTIC K_ED_INDEX_200_INJ.DEC_VOR_EINTRAG "Filterverringerung vorm Fehlerspeichereintrag" VALUE 0x71D2D TKW_VV_VV_UB 100.0 FORMULA_0003 0.0 255.0 /end CHARACTERISTIC
/begin CHARACTERISTIC K_ED_INDEX_200_INJ.FEHLERSCHWELLE "Filterschwelle fuer Fehlereintrag" VALUE 0x71D2A TKW_VV_VV_UB 100.0 FORMULA_0003 0.0 255.0 /end CHARACTERISTIC
/begin CHARACTERISTIC K_ED_INDEX_200_INJ.INC_NACH_EINTRAG "Filtererhoehung nach Fehlerspeichereintrag" VALUE 0x71D2E TKW_VV_VV_UB 100.0 FORMULA_0003 0.0 255.0 /end CHARACTERISTIC
/begin CHARACTERISTIC K_ED_INDEX_200_INJ.INC_VOR_EINTRAG "Filtererhoehung vorm Fehlerspeichereintrag" VALUE 0x71D2C TKW_VV_VV_UB 100.0 FORMULA_0003 0.0 255.0 /end CHARACTERISTIC
/begin CHARACTERISTIC K_ED_INDEX_200_INJ.KLASSENINDEX "Auswahl der Fehlerklasse" VALUE 0x71D30 TKW_VV_VV_UB 100.0 FORMULA_0003 0.0 8.0 /end CHARACTERISTIC
/begin CHARACTERISTIC K_ED_INDEX_200_INJ.OK_SCHWELLE "Filterschwelle fuer Fehleraustrag" VALUE 0x71D2B TKW_VV_VV_UB 100.0 FORMULA_0003 0.0 255.0 /end CHARACTERISTIC
/begin CHARACTERISTIC K_ED_INDEX_200_INJ.P_CODE_OPENLOAD "P-Code fuer die Art OPENLOAD" VALUE 0x71D26 TKW_VV_VV_UW 100.0 FORMULA_0010 0.0 65535.0 /end CHARACTERISTIC
/begin CHARACTERISTIC K_ED_INDEX_200_INJ.P_CODE_SH_TO_GND "P-Code fuer die Art SH_TO_GND" VALUE 0x71D24 TKW_VV_VV_UW 100.0 FORMULA_0010 0.0 65535.0 /end CHARACTERISTIC
/begin CHARACTERISTIC K_ED_INDEX_200_INJ.P_CODE_SH_TO_UB "P-Code fuer die Art SH_TO_UB" VALUE 0x71D22 TKW_VV_VV_UW 100.0 FORMULA_0010 0.0 65535.0 /end CHARACTERISTIC
/begin CHARACTERISTIC K_ED_INDEX_200_INJ.P_CODE_UNPLAUSIBEL "P-Code fuer die Art UNPLAUSIBEL" VALUE 0x71D28 TKW_VV_VV_UW 100.0 FORMULA_0010 0.0 65535.0 /end CHARACTERISTIC
/begin CHARACTERISTIC K_ED_INDEX_201_INJ.DEC_NACH_EINTRAG "Filterverringerung nach Fehlerspeichereintrag" VALUE 0x71D49 TKW_VV_VV_UB 100.0 FORMULA_0003 0.0 255.0 /end CHARACTERISTIC
/begin CHARACTERISTIC K_ED_INDEX_201_INJ.DEC_VOR_EINTRAG "Filterverringerung vorm Fehlerspeichereintrag" VALUE 0x71D47 TKW_VV_VV_UB 100.0 FORMULA_0003 0.0 255.0 /end CHARACTERISTIC
/begin CHARACTERISTIC K_ED_INDEX_201_INJ.FEHLERSCHWELLE "Filterschwelle fuer Fehlereintrag" VALUE 0x71D44 TKW_VV_VV_UB 100.0 FORMULA_0003 0.0 255.0 /end CHARACTERISTIC
/begin CHARACTERISTIC K_ED_INDEX_201_INJ.INC_NACH_EINTRAG "Filtererhoehung nach Fehlerspeichereintrag" VALUE 0x71D48 TKW_VV_VV_UB 100.0 FORMULA_0003 0.0 255.0 /end CHARACTERISTIC
/begin CHARACTERISTIC K_ED_INDEX_201_INJ.INC_VOR_EINTRAG "Filtererhoehung vorm Fehlerspeichereintrag" VALUE 0x71D46 TKW_VV_VV_UB 100.0 FORMULA_0003 0.0 255.0 /end CHARACTERISTIC
/begin CHARACTERISTIC K_ED_INDEX_201_INJ.KLASSENINDEX "Auswahl der Fehlerklasse" VALUE 0x71D4A TKW_VV_VV_UB 100.0 FORMULA_0003 0.0 8.0 /end CHARACTERISTIC
/begin CHARACTERISTIC K_ED_INDEX_201_INJ.OK_SCHWELLE "Filterschwelle fuer Fehleraustrag" VALUE 0x71D45 TKW_VV_VV_UB 100.0 FORMULA_0003 0.0 255.0 /end CHARACTERISTIC
/begin CHARACTERISTIC K_ED_INDEX_201_INJ.P_CODE_OPENLOAD "P-Code fuer die Art OPENLOAD" VALUE 0x71D40 TKW_VV_VV_UW 100.0 FORMULA_0010 0.0 65535.0 /end CHARACTERISTIC
/begin CHARACTERISTIC K_ED_INDEX_201_INJ.P_CODE_SH_TO_GND "P-Code fuer die Art SH_TO_GND" VALUE 0x71D3E TKW_VV_VV_UW 100.0 FORMULA_0010 0.0 65535.0 /end CHARACTERISTIC
/begin CHARACTERISTIC K_ED_INDEX_201_INJ.P_CODE_SH_TO_UB "P-Code fuer die Art SH_TO_UB" VALUE 0x71D3C TKW_VV_VV_UW 100.0 FORMULA_0010 0.0 65535.0 /end CHARACTERISTIC
/begin CHARACTERISTIC K_ED_INDEX_201_INJ.P_CODE_UNPLAUSIBEL "P-Code fuer die Art UNPLAUSIBEL" VALUE 0x71D42 TKW_VV_VV_UW 100.0 FORMULA_0010 0.0 65535.0 /end CHARACTERISTIC
/begin CHARACTERISTIC K_ED_INDEX_202_INJ.DEC_NACH_EINTRAG "Filterverringerung nach Fehlerspeichereintrag" VALUE 0x71D63 TKW_VV_VV_UB 100.0 FORMULA_0003 0.0 255.0 /end CHARACTERISTIC
/begin CHARACTERISTIC K_ED_INDEX_202_INJ.DEC_VOR_EINTRAG "Filterverringerung vorm Fehlerspeichereintrag" VALUE 0x71D61 TKW_VV_VV_UB 100.0 FORMULA_0003 0.0 255.0 /end CHARACTERISTIC
/begin CHARACTERISTIC K_ED_INDEX_202_INJ.FEHLERSCHWELLE "Filterschwelle fuer Fehlereintrag" VALUE 0x71D5E TKW_VV_VV_UB 100.0 FORMULA_0003 0.0 255.0 /end CHARACTERISTIC
/begin CHARACTERISTIC K_ED_INDEX_202_INJ.INC_NACH_EINTRAG "Filtererhoehung nach Fehlerspeichereintrag" VALUE 0x71D62 TKW_VV_VV_UB 100.0 FORMULA_0003 0.0 255.0 /end CHARACTERISTIC
/begin CHARACTERISTIC K_ED_INDEX_202_INJ.INC_VOR_EINTRAG "Filtererhoehung vorm Fehlerspeichereintrag" VALUE 0x71D60 TKW_VV_VV_UB 100.0 FORMULA_0003 0.0 255.0 /end CHARACTERISTIC
/begin CHARACTERISTIC K_ED_INDEX_202_INJ.KLASSENINDEX "Auswahl der Fehlerklasse" VALUE 0x71D64 TKW_VV_VV_UB 100.0 FORMULA_0003 0.0 8.0 /end CHARACTERISTIC
/begin CHARACTERISTIC K_ED_INDEX_202_INJ.OK_SCHWELLE "Filterschwelle fuer Fehleraustrag" VALUE 0x71D5F TKW_VV_VV_UB 100.0 FORMULA_0003 0.0 255.0 /end CHARACTERISTIC
/begin CHARACTERISTIC K_ED_INDEX_202_INJ.P_CODE_OPENLOAD "P-Code fuer die Art OPENLOAD" VALUE 0x71D5A TKW_VV_VV_UW 100.0 FORMULA_0010 0.0 65535.0 /end CHARACTERISTIC
/begin CHARACTERISTIC K_ED_INDEX_202_INJ.P_CODE_SH_TO_GND "P-Code fuer die Art SH_TO_GND" VALUE 0x71D58 TKW_VV_VV_UW 100.0 FORMULA_0010 0.0 65535.0 /end CHARACTERISTIC
/begin CHARACTERISTIC K_ED_INDEX_202_INJ.P_CODE_SH_TO_UB "P-Code fuer die Art SH_TO_UB" VALUE 0x71D56 TKW_VV_VV_UW 100.0 FORMULA_0010 0.0 65535.0 /end CHARACTERISTIC
/begin CHARACTERISTIC K_ED_INDEX_202_INJ.P_CODE_UNPLAUSIBEL "P-Code fuer die Art UNPLAUSIBEL" VALUE 0x71D5C TKW_VV_VV_UW 100.0 FORMULA_0010 0.0 65535.0 /end CHARACTERISTIC
/begin CHARACTERISTIC K_ED_INDEX_203_INJ.DEC_NACH_EINTRAG "Filterverringerung nach Fehlerspeichereintrag" VALUE 0x71D7D TKW_VV_VV_UB 100.0 FORMULA_0003 0.0 255.0 /end CHARACTERISTIC
/begin CHARACTERISTIC K_ED_INDEX_203_INJ.DEC_VOR_EINTRAG "Filterverringerung vorm Fehlerspeichereintrag" VALUE 0x71D7B TKW_VV_VV_UB 100.0 FORMULA_0003 0.0 255.0 /end CHARACTERISTIC
/begin CHARACTERISTIC K_ED_INDEX_203_INJ.FEHLERSCHWELLE "Filterschwelle fuer Fehlereintrag" VALUE 0x71D78 TKW_VV_VV_UB 100.0 FORMULA_0003 0.0 255.0 /end CHARACTERISTIC
/begin CHARACTERISTIC K_ED_INDEX_203_INJ.INC_NACH_EINTRAG "Filtererhoehung nach Fehlerspeichereintrag" VALUE 0x71D7C TKW_VV_VV_UB 100.0 FORMULA_0003 0.0 255.0 /end CHARACTERISTIC
/begin CHARACTERISTIC K_ED_INDEX_203_INJ.INC_VOR_EINTRAG "Filtererhoehung vorm Fehlerspeichereintrag" VALUE 0x71D7A TKW_VV_VV_UB 100.0 FORMULA_0003 0.0 255.0 /end CHARACTERISTIC
/begin CHARACTERISTIC K_ED_INDEX_203_INJ.KLASSENINDEX "Auswahl der Fehlerklasse" VALUE 0x71D7E TKW_VV_VV_UB 100.0 FORMULA_0003 0.0 8.0 /end CHARACTERISTIC
/begin CHARACTERISTIC K_ED_INDEX_203_INJ.OK_SCHWELLE "Filterschwelle fuer Fehleraustrag" VALUE 0x71D79 TKW_VV_VV_UB 100.0 FORMULA_0003 0.0 255.0 /end CHARACTERISTIC
/begin CHARACTERISTIC K_ED_INDEX_203_INJ.P_CODE_OPENLOAD "P-Code fuer die Art OPENLOAD" VALUE 0x71D74 TKW_VV_VV_UW 100.0 FORMULA_0010 0.0 65535.0 /end CHARACTERISTIC
/begin CHARACTERISTIC K_ED_INDEX_203_INJ.P_CODE_SH_TO_GND "P-Code fuer die Art SH_TO_GND" VALUE 0x71D72 TKW_VV_VV_UW 100.0 FORMULA_0010 0.0 65535.0 /end CHARACTERISTIC
/begin CHARACTERISTIC K_ED_INDEX_203_INJ.P_CODE_SH_TO_UB "P-Code fuer die Art SH_TO_UB" VALUE 0x71D70 TKW_VV_VV_UW 100.0 FORMULA_0010 0.0 65535.0 /end CHARACTERISTIC
/begin CHARACTERISTIC K_ED_INDEX_203_INJ.P_CODE_UNPLAUSIBEL "P-Code fuer die Art UNPLAUSIBEL" VALUE 0x71D76 TKW_VV_VV_UW 100.0 FORMULA_0010 0.0 65535.0 /end CHARACTERISTIC
/begin CHARACTERISTIC K_ED_INDEX_204_INJ.DEC_NACH_EINTRAG "Filterverringerung nach Fehlerspeichereintrag" VALUE 0x71D97 TKW_VV_VV_UB 100.0 FORMULA_0003 0.0 255.0 /end CHARACTERISTIC
/begin CHARACTERISTIC K_ED_INDEX_204_INJ.DEC_VOR_EINTRAG "Filterverringerung vorm Fehlerspeichereintrag" VALUE 0x71D95 TKW_VV_VV_UB 100.0 FORMULA_0003 0.0 255.0 /end CHARACTERISTIC
/begin CHARACTERISTIC K_ED_INDEX_204_INJ.FEHLERSCHWELLE "Filterschwelle fuer Fehlereintrag" VALUE 0x71D92 TKW_VV_VV_UB 100.0 FORMULA_0003 0.0 255.0 /end CHARACTERISTIC
/begin CHARACTERISTIC K_ED_INDEX_204_INJ.INC_NACH_EINTRAG "Filtererhoehung nach Fehlerspeichereintrag" VALUE 0x71D96 TKW_VV_VV_UB 100.0 FORMULA_0003 0.0 255.0 /end CHARACTERISTIC
/begin CHARACTERISTIC K_ED_INDEX_204_INJ.INC_VOR_EINTRAG "Filtererhoehung vorm Fehlerspeichereintrag" VALUE 0x71D94 TKW_VV_VV_UB 100.0 FORMULA_0003 0.0 255.0 /end CHARACTERISTIC
/begin CHARACTERISTIC K_ED_INDEX_204_INJ.KLASSENINDEX "Auswahl der Fehlerklasse" VALUE 0x71D98 TKW_VV_VV_UB 100.0 FORMULA_0003 0.0 8.0 /end CHARACTERISTIC
/begin CHARACTERISTIC K_ED_INDEX_204_INJ.OK_SCHWELLE "Filterschwelle fuer Fehleraustrag" VALUE 0x71D93 TKW_VV_VV_UB 100.0 FORMULA_0003 0.0 255.0 /end CHARACTERISTIC
/begin CHARACTERISTIC K_ED_INDEX_204_INJ.P_CODE_OPENLOAD "P-Code fuer die Art OPENLOAD" VALUE 0x71D8E TKW_VV_VV_UW 100.0 FORMULA_0010 0.0 65535.0 /end CHARACTERISTIC
/begin CHARACTERISTIC K_ED_INDEX_204_INJ.P_CODE_SH_TO_GND "P-Code fuer die Art SH_TO_GND" VALUE 0x71D8C TKW_VV_VV_UW 100.0 FORMULA_0010 0.0 65535.0 /end CHARACTERISTIC
/begin CHARACTERISTIC K_ED_INDEX_204_INJ.P_CODE_SH_TO_UB "P-Code fuer die Art SH_TO_UB" VALUE 0x71D8A TKW_VV_VV_UW 100.0 FORMULA_0010 0.0 65535.0 /end CHARACTERISTIC
/begin CHARACTERISTIC K_ED_INDEX_204_INJ.P_CODE_UNPLAUSIBEL "P-Code fuer die Art UNPLAUSIBEL" VALUE 0x71D90 TKW_VV_VV_UW 100.0 FORMULA_0010 0.0 65535.0 /end CHARACTERISTIC
/begin CHARACTERISTIC K_ED_INDEX_205_INJ.DEC_NACH_EINTRAG "Filterverringerung nach Fehlerspeichereintrag" VALUE 0x71DB1 TKW_VV_VV_UB 100.0 FORMULA_0003 0.0 255.0 /end CHARACTERISTIC
/begin CHARACTERISTIC K_ED_INDEX_205_INJ.DEC_VOR_EINTRAG "Filterverringerung vorm Fehlerspeichereintrag" VALUE 0x71DAF TKW_VV_VV_UB 100.0 FORMULA_0003 0.0 255.0 /end CHARACTERISTIC
/begin CHARACTERISTIC K_ED_INDEX_205_INJ.FEHLERSCHWELLE "Filterschwelle fuer Fehlereintrag" VALUE 0x71DAC TKW_VV_VV_UB 100.0 FORMULA_0003 0.0 255.0 /end CHARACTERISTIC
/begin CHARACTERISTIC K_ED_INDEX_205_INJ.INC_NACH_EINTRAG "Filtererhoehung nach Fehlerspeichereintrag" VALUE 0x71DB0 TKW_VV_VV_UB 100.0 FORMULA_0003 0.0 255.0 /end CHARACTERISTIC
/begin CHARACTERISTIC K_ED_INDEX_205_INJ.INC_VOR_EINTRAG "Filtererhoehung vorm Fehlerspeichereintrag" VALUE 0x71DAE TKW_VV_VV_UB 100.0 FORMULA_0003 0.0 255.0 /end CHARACTERISTIC
/begin CHARACTERISTIC K_ED_INDEX_205_INJ.KLASSENINDEX "Auswahl der Fehlerklasse" VALUE 0x71DB2 TKW_VV_VV_UB 100.0 FORMULA_0003 0.0 8.0 /end CHARACTERISTIC
/begin CHARACTERISTIC K_ED_INDEX_205_INJ.OK_SCHWELLE "Filterschwelle fuer Fehleraustrag" VALUE 0x71DAD TKW_VV_VV_UB 100.0 FORMULA_0003 0.0 255.0 /end CHARACTERISTIC
/begin CHARACTERISTIC K_ED_INDEX_205_INJ.P_CODE_OPENLOAD "P-Code fuer die Art OPENLOAD" VALUE 0x71DA8 TKW_VV_VV_UW 100.0 FORMULA_0010 0.0 65535.0 /end CHARACTERISTIC
/begin CHARACTERISTIC K_ED_INDEX_205_INJ.P_CODE_SH_TO_GND "P-Code fuer die Art SH_TO_GND" VALUE 0x71DA6 TKW_VV_VV_UW 100.0 FORMULA_0010 0.0 65535.0 /end CHARACTERISTIC
/begin CHARACTERISTIC K_ED_INDEX_205_INJ.P_CODE_SH_TO_UB "P-Code fuer die Art SH_TO_UB" VALUE 0x71DA4 TKW_VV_VV_UW 100.0 FORMULA_0010 0.0 65535.0 /end CHARACTERISTIC
/begin CHARACTERISTIC K_ED_INDEX_205_INJ.P_CODE_UNPLAUSIBEL "P-Code fuer die Art UNPLAUSIBEL" VALUE 0x71DAA TKW_VV_VV_UW 100.0 FORMULA_0010 0.0 65535.0 /end CHARACTERISTIC
/begin CHARACTERISTIC K_ED_INDEX_206_INJ.DEC_NACH_EINTRAG "Filterverringerung nach Fehlerspeichereintrag" VALUE 0x71DCB TKW_VV_VV_UB 100.0 FORMULA_0003 0.0 255.0 /end CHARACTERISTIC
/begin CHARACTERISTIC K_ED_INDEX_206_INJ.DEC_VOR_EINTRAG "Filterverringerung vorm Fehlerspeichereintrag" VALUE 0x71DC9 TKW_VV_VV_UB 100.0 FORMULA_0003 0.0 255.0 /end CHARACTERISTIC
/begin CHARACTERISTIC K_ED_INDEX_206_INJ.FEHLERSCHWELLE "Filterschwelle fuer Fehlereintrag" VALUE 0x71DC6 TKW_VV_VV_UB 100.0 FORMULA_0003 0.0 255.0 /end CHARACTERISTIC
/begin CHARACTERISTIC K_ED_INDEX_206_INJ.INC_NACH_EINTRAG "Filtererhoehung nach Fehlerspeichereintrag" VALUE 0x71DCA TKW_VV_VV_UB 100.0 FORMULA_0003 0.0 255.0 /end CHARACTERISTIC
/begin CHARACTERISTIC K_ED_INDEX_206_INJ.INC_VOR_EINTRAG "Filtererhoehung vorm Fehlerspeichereintrag" VALUE 0x71DC8 TKW_VV_VV_UB 100.0 FORMULA_0003 0.0 255.0 /end CHARACTERISTIC
/begin CHARACTERISTIC K_ED_INDEX_206_INJ.KLASSENINDEX "Auswahl der Fehlerklasse" VALUE 0x71DCC TKW_VV_VV_UB 100.0 FORMULA_0003 0.0 8.0 /end CHARACTERISTIC
/begin CHARACTERISTIC K_ED_INDEX_206_INJ.OK_SCHWELLE "Filterschwelle fuer Fehleraustrag" VALUE 0x71DC7 TKW_VV_VV_UB 100.0 FORMULA_0003 0.0 255.0 /end CHARACTERISTIC
/begin CHARACTERISTIC K_ED_INDEX_206_INJ.P_CODE_OPENLOAD "P-Code fuer die Art OPENLOAD" VALUE 0x71DC2 TKW_VV_VV_UW 100.0 FORMULA_0010 0.0 65535.0 /end CHARACTERISTIC
/begin CHARACTERISTIC K_ED_INDEX_206_INJ.P_CODE_SH_TO_GND "P-Code fuer die Art SH_TO_GND" VALUE 0x71DC0 TKW_VV_VV_UW 100.0 FORMULA_0010 0.0 65535.0 /end CHARACTERISTIC
/begin CHARACTERISTIC K_ED_INDEX_206_INJ.P_CODE_SH_TO_UB "P-Code fuer die Art SH_TO_UB" VALUE 0x71DBE TKW_VV_VV_UW 100.0 FORMULA_0010 0.0 65535.0 /end CHARACTERISTIC
/begin CHARACTERISTIC K_ED_INDEX_206_INJ.P_CODE_UNPLAUSIBEL "P-Code fuer die Art UNPLAUSIBEL" VALUE 0x71DC4 TKW_VV_VV_UW 100.0 FORMULA_0010 0.0 65535.0 /end CHARACTERISTIC
/begin CHARACTERISTIC K_ED_INDEX_207_INJ.DEC_NACH_EINTRAG "Filterverringerung nach Fehlerspeichereintrag" VALUE 0x71DE5 TKW_VV_VV_UB 100.0 FORMULA_0003 0.0 255.0 /end CHARACTERISTIC
/begin CHARACTERISTIC K_ED_INDEX_207_INJ.DEC_VOR_EINTRAG "Filterverringerung vorm Fehlerspeichereintrag" VALUE 0x71DE3 TKW_VV_VV_UB 100.0 FORMULA_0003 0.0 255.0 /end CHARACTERISTIC
/begin CHARACTERISTIC K_ED_INDEX_207_INJ.FEHLERSCHWELLE "Filterschwelle fuer Fehlereintrag" VALUE 0x71DE0 TKW_VV_VV_UB 100.0 FORMULA_0003 0.0 255.0 /end CHARACTERISTIC
/begin CHARACTERISTIC K_ED_INDEX_207_INJ.INC_NACH_EINTRAG "Filtererhoehung nach Fehlerspeichereintrag" VALUE 0x71DE4 TKW_VV_VV_UB 100.0 FORMULA_0003 0.0 255.0 /end CHARACTERISTIC
/begin CHARACTERISTIC K_ED_INDEX_207_INJ.INC_VOR_EINTRAG "Filtererhoehung vorm Fehlerspeichereintrag" VALUE 0x71DE2 TKW_VV_VV_UB 100.0 FORMULA_0003 0.0 255.0 /end CHARACTERISTIC
/begin CHARACTERISTIC K_ED_INDEX_207_INJ.KLASSENINDEX "Auswahl der Fehlerklasse" VALUE 0x71DE6 TKW_VV_VV_UB 100.0 FORMULA_0003 0.0 8.0 /end CHARACTERISTIC
/begin CHARACTERISTIC K_ED_INDEX_207_INJ.OK_SCHWELLE "Filterschwelle fuer Fehleraustrag" VALUE 0x71DE1 TKW_VV_VV_UB 100.0 FORMULA_0003 0.0 255.0 /end CHARACTERISTIC
/begin CHARACTERISTIC K_ED_INDEX_207_INJ.P_CODE_OPENLOAD "P-Code fuer die Art OPENLOAD" VALUE 0x71DDC TKW_VV_VV_UW 100.0 FORMULA_0010 0.0 65535.0 /end CHARACTERISTIC
/begin CHARACTERISTIC K_ED_INDEX_207_INJ.P_CODE_SH_TO_GND "P-Code fuer die Art SH_TO_GND" VALUE 0x71DDA TKW_VV_VV_UW 100.0 FORMULA_0010 0.0 65535.0 /end CHARACTERISTIC
/begin CHARACTERISTIC K_ED_INDEX_207_INJ.P_CODE_SH_TO_UB "P-Code fuer die Art SH_TO_UB" VALUE 0x71DD8 TKW_VV_VV_UW 100.0 FORMULA_0010 0.0 65535.0 /end CHARACTERISTIC
/begin CHARACTERISTIC K_ED_INDEX_207_INJ.P_CODE_UNPLAUSIBEL "P-Code fuer die Art UNPLAUSIBEL" VALUE 0x71DDE TKW_VV_VV_UW 100.0 FORMULA_0010 0.0 65535.0 /end CHARACTERISTIC
/begin CHARACTERISTIC K_ED_INDEX_208_INJ.DEC_NACH_EINTRAG "Filterverringerung nach Fehlerspeichereintrag" VALUE 0x71DFF TKW_VV_VV_UB 100.0 FORMULA_0003 0.0 255.0 /end CHARACTERISTIC
/begin CHARACTERISTIC K_ED_INDEX_208_INJ.DEC_VOR_EINTRAG "Filterverringerung vorm Fehlerspeichereintrag" VALUE 0x71DFD TKW_VV_VV_UB 100.0 FORMULA_0003 0.0 255.0 /end CHARACTERISTIC
/begin CHARACTERISTIC K_ED_INDEX_208_INJ.FEHLERSCHWELLE "Filterschwelle fuer Fehlereintrag" VALUE 0x71DFA TKW_VV_VV_UB 100.0 FORMULA_0003 0.0 255.0 /end CHARACTERISTIC
/begin CHARACTERISTIC K_ED_INDEX_208_INJ.INC_NACH_EINTRAG "Filtererhoehung nach Fehlerspeichereintrag" VALUE 0x71DFE TKW_VV_VV_UB 100.0 FORMULA_0003 0.0 255.0 /end CHARACTERISTIC
/begin CHARACTERISTIC K_ED_INDEX_208_INJ.INC_VOR_EINTRAG "Filtererhoehung vorm Fehlerspeichereintrag" VALUE 0x71DFC TKW_VV_VV_UB 100.0 FORMULA_0003 0.0 255.0 /end CHARACTERISTIC
/begin CHARACTERISTIC K_ED_INDEX_208_INJ.KLASSENINDEX "Auswahl der Fehlerklasse" VALUE 0x71E00 TKW_VV_VV_UB 100.0 FORMULA_0003 0.0 8.0 /end CHARACTERISTIC
/begin CHARACTERISTIC K_ED_INDEX_208_INJ.OK_SCHWELLE "Filterschwelle fuer Fehleraustrag" VALUE 0x71DFB TKW_VV_VV_UB 100.0 FORMULA_0003 0.0 255.0 /end CHARACTERISTIC
/begin CHARACTERISTIC K_ED_INDEX_208_INJ.P_CODE_OPENLOAD "P-Code fuer die Art OPENLOAD" VALUE 0x71DF6 TKW_VV_VV_UW 100.0 FORMULA_0010 0.0 65535.0 /end CHARACTERISTIC
/begin CHARACTERISTIC K_ED_INDEX_208_INJ.P_CODE_SH_TO_GND "P-Code fuer die Art SH_TO_GND" VALUE 0x71DF4 TKW_VV_VV_UW 100.0 FORMULA_0010 0.0 65535.0 /end CHARACTERISTIC
/begin CHARACTERISTIC K_ED_INDEX_208_INJ.P_CODE_SH_TO_UB "P-Code fuer die Art SH_TO_UB" VALUE 0x71DF2 TKW_VV_VV_UW 100.0 FORMULA_0010 0.0 65535.0 /end CHARACTERISTIC
/begin CHARACTERISTIC K_ED_INDEX_208_INJ.P_CODE_UNPLAUSIBEL "P-Code fuer die Art UNPLAUSIBEL" VALUE 0x71DF8 TKW_VV_VV_UW 100.0 FORMULA_0010 0.0 65535.0 /end CHARACTERISTIC
/begin CHARACTERISTIC K_ED_INDEX_209_INJ.DEC_NACH_EINTRAG "Filterverringerung nach Fehlerspeichereintrag" VALUE 0x71E19 TKW_VV_VV_UB 100.0 FORMULA_0003 0.0 255.0 /end CHARACTERISTIC
/begin CHARACTERISTIC K_ED_INDEX_209_INJ.DEC_VOR_EINTRAG "Filterverringerung vorm Fehlerspeichereintrag" VALUE 0x71E17 TKW_VV_VV_UB 100.0 FORMULA_0003 0.0 255.0 /end CHARACTERISTIC
/begin CHARACTERISTIC K_ED_INDEX_209_INJ.FEHLERSCHWELLE "Filterschwelle fuer Fehlereintrag" VALUE 0x71E14 TKW_VV_VV_UB 100.0 FORMULA_0003 0.0 255.0 /end CHARACTERISTIC
/begin CHARACTERISTIC K_ED_INDEX_209_INJ.INC_NACH_EINTRAG "Filtererhoehung nach Fehlerspeichereintrag" VALUE 0x71E18 TKW_VV_VV_UB 100.0 FORMULA_0003 0.0 255.0 /end CHARACTERISTIC
/begin CHARACTERISTIC K_ED_INDEX_209_INJ.INC_VOR_EINTRAG "Filtererhoehung vorm Fehlerspeichereintrag" VALUE 0x71E16 TKW_VV_VV_UB 100.0 FORMULA_0003 0.0 255.0 /end CHARACTERISTIC
/begin CHARACTERISTIC K_ED_INDEX_209_INJ.KLASSENINDEX "Auswahl der Fehlerklasse" VALUE 0x71E1A TKW_VV_VV_UB 100.0 FORMULA_0003 0.0 8.0 /end CHARACTERISTIC
/begin CHARACTERISTIC K_ED_INDEX_209_INJ.OK_SCHWELLE "Filterschwelle fuer Fehleraustrag" VALUE 0x71E15 TKW_VV_VV_UB 100.0 FORMULA_0003 0.0 255.0 /end CHARACTERISTIC
/begin CHARACTERISTIC K_ED_INDEX_209_INJ.P_CODE_OPENLOAD "P-Code fuer die Art OPENLOAD" VALUE 0x71E10 TKW_VV_VV_UW 100.0 FORMULA_0010 0.0 65535.0 /end CHARACTERISTIC
/begin CHARACTERISTIC K_ED_INDEX_209_INJ.P_CODE_SH_TO_GND "P-Code fuer die Art SH_TO_GND" VALUE 0x71E0E TKW_VV_VV_UW 100.0 FORMULA_0010 0.0 65535.0 /end CHARACTERISTIC
/begin CHARACTERISTIC K_ED_INDEX_209_INJ.P_CODE_SH_TO_UB "P-Code fuer die Art SH_TO_UB" VALUE 0x71E0C TKW_VV_VV_UW 100.0 FORMULA_0010 0.0 65535.0 /end CHARACTERISTIC
/begin CHARACTERISTIC K_ED_INDEX_209_INJ.P_CODE_UNPLAUSIBEL "P-Code fuer die Art UNPLAUSIBEL" VALUE 0x71E12 TKW_VV_VV_UW 100.0 FORMULA_0010 0.0 65535.0 /end CHARACTERISTIC
/begin CHARACTERISTIC K_ED_INDEX_210_INJ.DEC_NACH_EINTRAG "Filterverringerung nach Fehlerspeichereintrag" VALUE 0x71E33 TKW_VV_VV_UB 100.0 FORMULA_0003 0.0 255.0 /end CHARACTERISTIC
/begin CHARACTERISTIC K_ED_INDEX_210_INJ.DEC_VOR_EINTRAG "Filterverringerung vorm Fehlerspeichereintrag" VALUE 0x71E31 TKW_VV_VV_UB 100.0 FORMULA_0003 0.0 255.0 /end CHARACTERISTIC
/begin CHARACTERISTIC K_ED_INDEX_210_INJ.FEHLERSCHWELLE "Filterschwelle fuer Fehlereintrag" VALUE 0x71E2E TKW_VV_VV_UB 100.0 FORMULA_0003 0.0 255.0 /end CHARACTERISTIC
/begin CHARACTERISTIC K_ED_INDEX_210_INJ.INC_NACH_EINTRAG "Filtererhoehung nach Fehlerspeichereintrag" VALUE 0x71E32 TKW_VV_VV_UB 100.0 FORMULA_0003 0.0 255.0 /end CHARACTERISTIC
/begin CHARACTERISTIC K_ED_INDEX_210_INJ.INC_VOR_EINTRAG "Filtererhoehung vorm Fehlerspeichereintrag" VALUE 0x71E30 TKW_VV_VV_UB 100.0 FORMULA_0003 0.0 255.0 /end CHARACTERISTIC
/begin CHARACTERISTIC K_ED_INDEX_210_INJ.KLASSENINDEX "Auswahl der Fehlerklasse" VALUE 0x71E34 TKW_VV_VV_UB 100.0 FORMULA_0003 0.0 8.0 /end CHARACTERISTIC
/begin CHARACTERISTIC K_ED_INDEX_210_INJ.OK_SCHWELLE "Filterschwelle fuer Fehleraustrag" VALUE 0x71E2F TKW_VV_VV_UB 100.0 FORMULA_0003 0.0 255.0 /end CHARACTERISTIC
/begin CHARACTERISTIC K_ED_INDEX_210_INJ.P_CODE_OPENLOAD "P-Code fuer die Art OPENLOAD" VALUE 0x71E2A TKW_VV_VV_UW 100.0 FORMULA_0010 0.0 65535.0 /end CHARACTERISTIC
/begin CHARACTERISTIC K_ED_INDEX_210_INJ.P_CODE_SH_TO_GND "P-Code fuer die Art SH_TO_GND" VALUE 0x71E28 TKW_VV_VV_UW 100.0 FORMULA_0010 0.0 65535.0 /end CHARACTERISTIC
/begin CHARACTERISTIC K_ED_INDEX_210_INJ.P_CODE_SH_TO_UB "P-Code fuer die Art SH_TO_UB" VALUE 0x71E26 TKW_VV_VV_UW 100.0 FORMULA_0010 0.0 65535.0 /end CHARACTERISTIC
/begin CHARACTERISTIC K_ED_INDEX_210_INJ.P_CODE_UNPLAUSIBEL "P-Code fuer die Art UNPLAUSIBEL" VALUE 0x71E2C TKW_VV_VV_UW 100.0 FORMULA_0010 0.0 65535.0 /end CHARACTERISTIC
/begin CHARACTERISTIC K_ED_INDEX_211_INJ.DEC_NACH_EINTRAG "Filterverringerung nach Fehlerspeichereintrag" VALUE 0x71E4D TKW_VV_VV_UB 100.0 FORMULA_0003 0.0 255.0 /end CHARACTERISTIC
/begin CHARACTERISTIC K_ED_INDEX_211_INJ.DEC_VOR_EINTRAG "Filterverringerung vorm Fehlerspeichereintrag" VALUE 0x71E4B TKW_VV_VV_UB 100.0 FORMULA_0003 0.0 255.0 /end CHARACTERISTIC
/begin CHARACTERISTIC K_ED_INDEX_211_INJ.FEHLERSCHWELLE "Filterschwelle fuer Fehlereintrag" VALUE 0x71E48 TKW_VV_VV_UB 100.0 FORMULA_0003 0.0 255.0 /end CHARACTERISTIC
/begin CHARACTERISTIC K_ED_INDEX_211_INJ.INC_NACH_EINTRAG "Filtererhoehung nach Fehlerspeichereintrag" VALUE 0x71E4C TKW_VV_VV_UB 100.0 FORMULA_0003 0.0 255.0 /end CHARACTERISTIC
/begin CHARACTERISTIC K_ED_INDEX_211_INJ.INC_VOR_EINTRAG "Filtererhoehung vorm Fehlerspeichereintrag" VALUE 0x71E4A TKW_VV_VV_UB 100.0 FORMULA_0003 0.0 255.0 /end CHARACTERISTIC
/begin CHARACTERISTIC K_ED_INDEX_211_INJ.KLASSENINDEX "Auswahl der Fehlerklasse" VALUE 0x71E4E TKW_VV_VV_UB 100.0 FORMULA_0003 0.0 8.0 /end CHARACTERISTIC
/begin CHARACTERISTIC K_ED_INDEX_211_INJ.OK_SCHWELLE "Filterschwelle fuer Fehleraustrag" VALUE 0x71E49 TKW_VV_VV_UB 100.0 FORMULA_0003 0.0 255.0 /end CHARACTERISTIC
/begin CHARACTERISTIC K_ED_INDEX_211_INJ.P_CODE_OPENLOAD "P-Code fuer die Art OPENLOAD" VALUE 0x71E44 TKW_VV_VV_UW 100.0 FORMULA_0010 0.0 65535.0 /end CHARACTERISTIC
/begin CHARACTERISTIC K_ED_INDEX_211_INJ.P_CODE_SH_TO_GND "P-Code fuer die Art SH_TO_GND" VALUE 0x71E42 TKW_VV_VV_UW 100.0 FORMULA_0010 0.0 65535.0 /end CHARACTERISTIC
/begin CHARACTERISTIC K_ED_INDEX_211_INJ.P_CODE_SH_TO_UB "P-Code fuer die Art SH_TO_UB" VALUE 0x71E40 TKW_VV_VV_UW 100.0 FORMULA_0010 0.0 65535.0 /end CHARACTERISTIC
/begin CHARACTERISTIC K_ED_INDEX_211_INJ.P_CODE_UNPLAUSIBEL "P-Code fuer die Art UNPLAUSIBEL" VALUE 0x71E46 TKW_VV_VV_UW 100.0 FORMULA_0010 0.0 65535.0 /end CHARACTERISTIC
/begin CHARACTERISTIC K_ED_INDEX_212_INJ.DEC_NACH_EINTRAG "Filterverringerung nach Fehlerspeichereintrag" VALUE 0x71E67 TKW_VV_VV_UB 100.0 FORMULA_0003 0.0 255.0 /end CHARACTERISTIC
/begin CHARACTERISTIC K_ED_INDEX_212_INJ.DEC_VOR_EINTRAG "Filterverringerung vorm Fehlerspeichereintrag" VALUE 0x71E65 TKW_VV_VV_UB 100.0 FORMULA_0003 0.0 255.0 /end CHARACTERISTIC
/begin CHARACTERISTIC K_ED_INDEX_212_INJ.FEHLERSCHWELLE "Filterschwelle fuer Fehlereintrag" VALUE 0x71E62 TKW_VV_VV_UB 100.0 FORMULA_0003 0.0 255.0 /end CHARACTERISTIC
/begin CHARACTERISTIC K_ED_INDEX_212_INJ.INC_NACH_EINTRAG "Filtererhoehung nach Fehlerspeichereintrag" VALUE 0x71E66 TKW_VV_VV_UB 100.0 FORMULA_0003 0.0 255.0 /end CHARACTERISTIC
/begin CHARACTERISTIC K_ED_INDEX_212_INJ.INC_VOR_EINTRAG "Filtererhoehung vorm Fehlerspeichereintrag" VALUE 0x71E64 TKW_VV_VV_UB 100.0 FORMULA_0003 0.0 255.0 /end CHARACTERISTIC
/begin CHARACTERISTIC K_ED_INDEX_212_INJ.KLASSENINDEX "Auswahl der Fehlerklasse" VALUE 0x71E68 TKW_VV_VV_UB 100.0 FORMULA_0003 0.0 8.0 /end CHARACTERISTIC
/begin CHARACTERISTIC K_ED_INDEX_212_INJ.OK_SCHWELLE "Filterschwelle fuer Fehleraustrag" VALUE 0x71E63 TKW_VV_VV_UB 100.0 FORMULA_0003 0.0 255.0 /end CHARACTERISTIC
/begin CHARACTERISTIC K_ED_INDEX_212_INJ.P_CODE_OPENLOAD "P-Code fuer die Art OPENLOAD" VALUE 0x71E5E TKW_VV_VV_UW 100.0 FORMULA_0010 0.0 65535.0 /end CHARACTERISTIC
/begin CHARACTERISTIC K_ED_INDEX_212_INJ.P_CODE_SH_TO_GND "P-Code fuer die Art SH_TO_GND" VALUE 0x71E5C TKW_VV_VV_UW 100.0 FORMULA_0010 0.0 65535.0 /end CHARACTERISTIC
/begin CHARACTERISTIC K_ED_INDEX_212_INJ.P_CODE_SH_TO_UB "P-Code fuer die Art SH_TO_UB" VALUE 0x71E5A TKW_VV_VV_UW 100.0 FORMULA_0010 0.0 65535.0 /end CHARACTERISTIC
/begin CHARACTERISTIC K_ED_INDEX_212_INJ.P_CODE_UNPLAUSIBEL "P-Code fuer die Art UNPLAUSIBEL" VALUE 0x71E60 TKW_VV_VV_UW 100.0 FORMULA_0010 0.0 65535.0 /end CHARACTERISTIC
/begin CHARACTERISTIC K_ED_INDEX_213_INJ.DEC_NACH_EINTRAG "Filterverringerung nach Fehlerspeichereintrag" VALUE 0x71E81 TKW_VV_VV_UB 100.0 FORMULA_0003 0.0 255.0 /end CHARACTERISTIC
/begin CHARACTERISTIC K_ED_INDEX_213_INJ.DEC_VOR_EINTRAG "Filterverringerung vorm Fehlerspeichereintrag" VALUE 0x71E7F TKW_VV_VV_UB 100.0 FORMULA_0003 0.0 255.0 /end CHARACTERISTIC
/begin CHARACTERISTIC K_ED_INDEX_213_INJ.FEHLERSCHWELLE "Filterschwelle fuer Fehlereintrag" VALUE 0x71E7C TKW_VV_VV_UB 100.0 FORMULA_0003 0.0 255.0 /end CHARACTERISTIC
/begin CHARACTERISTIC K_ED_INDEX_213_INJ.INC_NACH_EINTRAG "Filtererhoehung nach Fehlerspeichereintrag" VALUE 0x71E80 TKW_VV_VV_UB 100.0 FORMULA_0003 0.0 255.0 /end CHARACTERISTIC
/begin CHARACTERISTIC K_ED_INDEX_213_INJ.INC_VOR_EINTRAG "Filtererhoehung vorm Fehlerspeichereintrag" VALUE 0x71E7E TKW_VV_VV_UB 100.0 FORMULA_0003 0.0 255.0 /end CHARACTERISTIC
/begin CHARACTERISTIC K_ED_INDEX_213_INJ.KLASSENINDEX "Auswahl der Fehlerklasse" VALUE 0x71E82 TKW_VV_VV_UB 100.0 FORMULA_0003 0.0 8.0 /end CHARACTERISTIC
/begin CHARACTERISTIC K_ED_INDEX_213_INJ.OK_SCHWELLE "Filterschwelle fuer Fehleraustrag" VALUE 0x71E7D TKW_VV_VV_UB 100.0 FORMULA_0003 0.0 255.0 /end CHARACTERISTIC
/begin CHARACTERISTIC K_ED_INDEX_213_INJ.P_CODE_OPENLOAD "P-Code fuer die Art OPENLOAD" VALUE 0x71E78 TKW_VV_VV_UW 100.0 FORMULA_0010 0.0 65535.0 /end CHARACTERISTIC
/begin CHARACTERISTIC K_ED_INDEX_213_INJ.P_CODE_SH_TO_GND "P-Code fuer die Art SH_TO_GND" VALUE 0x71E76 TKW_VV_VV_UW 100.0 FORMULA_0010 0.0 65535.0 /end CHARACTERISTIC
/begin CHARACTERISTIC K_ED_INDEX_213_INJ.P_CODE_SH_TO_UB "P-Code fuer die Art SH_TO_UB" VALUE 0x71E74 TKW_VV_VV_UW 100.0 FORMULA_0010 0.0 65535.0 /end CHARACTERISTIC
/begin CHARACTERISTIC K_ED_INDEX_213_INJ.P_CODE_UNPLAUSIBEL "P-Code fuer die Art UNPLAUSIBEL" VALUE 0x71E7A TKW_VV_VV_UW 100.0 FORMULA_0010 0.0 65535.0 /end CHARACTERISTIC
/begin CHARACTERISTIC K_ED_INDEX_214_INJ.DEC_NACH_EINTRAG "Filterverringerung nach Fehlerspeichereintrag" VALUE 0x71E9B TKW_VV_VV_UB 100.0 FORMULA_0003 0.0 255.0 /end CHARACTERISTIC
/begin CHARACTERISTIC K_ED_INDEX_214_INJ.DEC_VOR_EINTRAG "Filterverringerung vorm Fehlerspeichereintrag" VALUE 0x71E99 TKW_VV_VV_UB 100.0 FORMULA_0003 0.0 255.0 /end CHARACTERISTIC
/begin CHARACTERISTIC K_ED_INDEX_214_INJ.FEHLERSCHWELLE "Filterschwelle fuer Fehlereintrag" VALUE 0x71E96 TKW_VV_VV_UB 100.0 FORMULA_0003 0.0 255.0 /end CHARACTERISTIC
/begin CHARACTERISTIC K_ED_INDEX_214_INJ.INC_NACH_EINTRAG "Filtererhoehung nach Fehlerspeichereintrag" VALUE 0x71E9A TKW_VV_VV_UB 100.0 FORMULA_0003 0.0 255.0 /end CHARACTERISTIC
/begin CHARACTERISTIC K_ED_INDEX_214_INJ.INC_VOR_EINTRAG "Filtererhoehung vorm Fehlerspeichereintrag" VALUE 0x71E98 TKW_VV_VV_UB 100.0 FORMULA_0003 0.0 255.0 /end CHARACTERISTIC
/begin CHARACTERISTIC K_ED_INDEX_214_INJ.KLASSENINDEX "Auswahl der Fehlerklasse" VALUE 0x71E9C TKW_VV_VV_UB 100.0 FORMULA_0003 0.0 8.0 /end CHARACTERISTIC
/begin CHARACTERISTIC K_ED_INDEX_214_INJ.OK_SCHWELLE "Filterschwelle fuer Fehleraustrag" VALUE 0x71E97 TKW_VV_VV_UB 100.0 FORMULA_0003 0.0 255.0 /end CHARACTERISTIC
/begin CHARACTERISTIC K_ED_INDEX_214_INJ.P_CODE_OPENLOAD "P-Code fuer die Art OPENLOAD" VALUE 0x71E92 TKW_VV_VV_UW 100.0 FORMULA_0010 0.0 65535.0 /end CHARACTERISTIC
/begin CHARACTERISTIC K_ED_INDEX_214_INJ.P_CODE_SH_TO_GND "P-Code fuer die Art SH_TO_GND" VALUE 0x71E90 TKW_VV_VV_UW 100.0 FORMULA_0010 0.0 65535.0 /end CHARACTERISTIC
/begin CHARACTERISTIC K_ED_INDEX_214_INJ.P_CODE_SH_TO_UB "P-Code fuer die Art SH_TO_UB" VALUE 0x71E8E TKW_VV_VV_UW 100.0 FORMULA_0010 0.0 65535.0 /end CHARACTERISTIC
/begin CHARACTERISTIC K_ED_INDEX_214_INJ.P_CODE_UNPLAUSIBEL "P-Code fuer die Art UNPLAUSIBEL" VALUE 0x71E94 TKW_VV_VV_UW 100.0 FORMULA_0010 0.0 65535.0 /end CHARACTERISTIC
/begin CHARACTERISTIC K_ED_INDEX_215_INJ.DEC_NACH_EINTRAG "Filterverringerung nach Fehlerspeichereintrag" VALUE 0x71EB5 TKW_VV_VV_UB 100.0 FORMULA_0003 0.0 255.0 /end CHARACTERISTIC
/begin CHARACTERISTIC K_ED_INDEX_215_INJ.DEC_VOR_EINTRAG "Filterverringerung vorm Fehlerspeichereintrag" VALUE 0x71EB3 TKW_VV_VV_UB 100.0 FORMULA_0003 0.0 255.0 /end CHARACTERISTIC
/begin CHARACTERISTIC K_ED_INDEX_215_INJ.FEHLERSCHWELLE "Filterschwelle fuer Fehlereintrag" VALUE 0x71EB0 TKW_VV_VV_UB 100.0 FORMULA_0003 0.0 255.0 /end CHARACTERISTIC
/begin CHARACTERISTIC K_ED_INDEX_215_INJ.INC_NACH_EINTRAG "Filtererhoehung nach Fehlerspeichereintrag" VALUE 0x71EB4 TKW_VV_VV_UB 100.0 FORMULA_0003 0.0 255.0 /end CHARACTERISTIC
/begin CHARACTERISTIC K_ED_INDEX_215_INJ.INC_VOR_EINTRAG "Filtererhoehung vorm Fehlerspeichereintrag" VALUE 0x71EB2 TKW_VV_VV_UB 100.0 FORMULA_0003 0.0 255.0 /end CHARACTERISTIC
/begin CHARACTERISTIC K_ED_INDEX_215_INJ.KLASSENINDEX "Auswahl der Fehlerklasse" VALUE 0x71EB6 TKW_VV_VV_UB 100.0 FORMULA_0003 0.0 8.0 /end CHARACTERISTIC
/begin CHARACTERISTIC K_ED_INDEX_215_INJ.OK_SCHWELLE "Filterschwelle fuer Fehleraustrag" VALUE 0x71EB1 TKW_VV_VV_UB 100.0 FORMULA_0003 0.0 255.0 /end CHARACTERISTIC
/begin CHARACTERISTIC K_ED_INDEX_215_INJ.P_CODE_OPENLOAD "P-Code fuer die Art OPENLOAD" VALUE 0x71EAC TKW_VV_VV_UW 100.0 FORMULA_0010 0.0 65535.0 /end CHARACTERISTIC
/begin CHARACTERISTIC K_ED_INDEX_215_INJ.P_CODE_SH_TO_GND "P-Code fuer die Art SH_TO_GND" VALUE 0x71EAA TKW_VV_VV_UW 100.0 FORMULA_0010 0.0 65535.0 /end CHARACTERISTIC
/begin CHARACTERISTIC K_ED_INDEX_215_INJ.P_CODE_SH_TO_UB "P-Code fuer die Art SH_TO_UB" VALUE 0x71EA8 TKW_VV_VV_UW 100.0 FORMULA_0010 0.0 65535.0 /end CHARACTERISTIC
/begin CHARACTERISTIC K_ED_INDEX_215_INJ.P_CODE_UNPLAUSIBEL "P-Code fuer die Art UNPLAUSIBEL" VALUE 0x71EAE TKW_VV_VV_UW 100.0 FORMULA_0010 0.0 65535.0 /end CHARACTERISTIC
/begin CHARACTERISTIC K_ED_INDEX_216_INJ.DEC_NACH_EINTRAG "Filterverringerung nach Fehlerspeichereintrag" VALUE 0x71ECF TKW_VV_VV_UB 100.0 FORMULA_0003 0.0 255.0 /end CHARACTERISTIC
/begin CHARACTERISTIC K_ED_INDEX_216_INJ.DEC_VOR_EINTRAG "Filterverringerung vorm Fehlerspeichereintrag" VALUE 0x71ECD TKW_VV_VV_UB 100.0 FORMULA_0003 0.0 255.0 /end CHARACTERISTIC
/begin CHARACTERISTIC K_ED_INDEX_216_INJ.FEHLERSCHWELLE "Filterschwelle fuer Fehlereintrag" VALUE 0x71ECA TKW_VV_VV_UB 100.0 FORMULA_0003 0.0 255.0 /end CHARACTERISTIC
/begin CHARACTERISTIC K_ED_INDEX_216_INJ.INC_NACH_EINTRAG "Filtererhoehung nach Fehlerspeichereintrag" VALUE 0x71ECE TKW_VV_VV_UB 100.0 FORMULA_0003 0.0 255.0 /end CHARACTERISTIC
/begin CHARACTERISTIC K_ED_INDEX_216_INJ.INC_VOR_EINTRAG "Filtererhoehung vorm Fehlerspeichereintrag" VALUE 0x71ECC TKW_VV_VV_UB 100.0 FORMULA_0003 0.0 255.0 /end CHARACTERISTIC
/begin CHARACTERISTIC K_ED_INDEX_216_INJ.KLASSENINDEX "Auswahl der Fehlerklasse" VALUE 0x71ED0 TKW_VV_VV_UB 100.0 FORMULA_0003 0.0 8.0 /end CHARACTERISTIC
/begin CHARACTERISTIC K_ED_INDEX_216_INJ.OK_SCHWELLE "Filterschwelle fuer Fehleraustrag" VALUE 0x71ECB TKW_VV_VV_UB 100.0 FORMULA_0003 0.0 255.0 /end CHARACTERISTIC
/begin CHARACTERISTIC K_ED_INDEX_216_INJ.P_CODE_OPENLOAD "P-Code fuer die Art OPENLOAD" VALUE 0x71EC6 TKW_VV_VV_UW 100.0 FORMULA_0010 0.0 65535.0 /end CHARACTERISTIC
/begin CHARACTERISTIC K_ED_INDEX_216_INJ.P_CODE_SH_TO_GND "P-Code fuer die Art SH_TO_GND" VALUE 0x71EC4 TKW_VV_VV_UW 100.0 FORMULA_0010 0.0 65535.0 /end CHARACTERISTIC
/begin CHARACTERISTIC K_ED_INDEX_216_INJ.P_CODE_SH_TO_UB "P-Code fuer die Art SH_TO_UB" VALUE 0x71EC2 TKW_VV_VV_UW 100.0 FORMULA_0010 0.0 65535.0 /end CHARACTERISTIC
/begin CHARACTERISTIC K_ED_INDEX_216_INJ.P_CODE_UNPLAUSIBEL "P-Code fuer die Art UNPLAUSIBEL" VALUE 0x71EC8 TKW_VV_VV_UW 100.0 FORMULA_0010 0.0 65535.0 /end CHARACTERISTIC
/begin CHARACTERISTIC K_ED_INDEX_217_INJ.DEC_NACH_EINTRAG "Filterverringerung nach Fehlerspeichereintrag" VALUE 0x71EE9 TKW_VV_VV_UB 100.0 FORMULA_0003 0.0 255.0 /end CHARACTERISTIC
/begin CHARACTERISTIC K_ED_INDEX_217_INJ.DEC_VOR_EINTRAG "Filterverringerung vorm Fehlerspeichereintrag" VALUE 0x71EE7 TKW_VV_VV_UB 100.0 FORMULA_0003 0.0 255.0 /end CHARACTERISTIC
/begin CHARACTERISTIC K_ED_INDEX_217_INJ.FEHLERSCHWELLE "Filterschwelle fuer Fehlereintrag" VALUE 0x71EE4 TKW_VV_VV_UB 100.0 FORMULA_0003 0.0 255.0 /end CHARACTERISTIC
/begin CHARACTERISTIC K_ED_INDEX_217_INJ.INC_NACH_EINTRAG "Filtererhoehung nach Fehlerspeichereintrag" VALUE 0x71EE8 TKW_VV_VV_UB 100.0 FORMULA_0003 0.0 255.0 /end CHARACTERISTIC
/begin CHARACTERISTIC K_ED_INDEX_217_INJ.INC_VOR_EINTRAG "Filtererhoehung vorm Fehlerspeichereintrag" VALUE 0x71EE6 TKW_VV_VV_UB 100.0 FORMULA_0003 0.0 255.0 /end CHARACTERISTIC
/begin CHARACTERISTIC K_ED_INDEX_217_INJ.KLASSENINDEX "Auswahl der Fehlerklasse" VALUE 0x71EEA TKW_VV_VV_UB 100.0 FORMULA_0003 0.0 8.0 /end CHARACTERISTIC
/begin CHARACTERISTIC K_ED_INDEX_217_INJ.OK_SCHWELLE "Filterschwelle fuer Fehleraustrag" VALUE 0x71EE5 TKW_VV_VV_UB 100.0 FORMULA_0003 0.0 255.0 /end CHARACTERISTIC
/begin CHARACTERISTIC K_ED_INDEX_217_INJ.P_CODE_OPENLOAD "P-Code fuer die Art OPENLOAD" VALUE 0x71EE0 TKW_VV_VV_UW 100.0 FORMULA_0010 0.0 65535.0 /end CHARACTERISTIC
/begin CHARACTERISTIC K_ED_INDEX_217_INJ.P_CODE_SH_TO_GND "P-Code fuer die Art SH_TO_GND" VALUE 0x71EDE TKW_VV_VV_UW 100.0 FORMULA_0010 0.0 65535.0 /end CHARACTERISTIC
/begin CHARACTERISTIC K_ED_INDEX_217_INJ.P_CODE_SH_TO_UB "P-Code fuer die Art SH_TO_UB" VALUE 0x71EDC TKW_VV_VV_UW 100.0 FORMULA_0010 0.0 65535.0 /end CHARACTERISTIC
/begin CHARACTERISTIC K_ED_INDEX_217_INJ.P_CODE_UNPLAUSIBEL "P-Code fuer die Art UNPLAUSIBEL" VALUE 0x71EE2 TKW_VV_VV_UW 100.0 FORMULA_0010 0.0 65535.0 /end CHARACTERISTIC
/begin CHARACTERISTIC K_ED_INDEX_218_INJ.DEC_NACH_EINTRAG "Filterverringerung nach Fehlerspeichereintrag" VALUE 0x71F03 TKW_VV_VV_UB 100.0 FORMULA_0003 0.0 255.0 /end CHARACTERISTIC
/begin CHARACTERISTIC K_ED_INDEX_218_INJ.DEC_VOR_EINTRAG "Filterverringerung vorm Fehlerspeichereintrag" VALUE 0x71F01 TKW_VV_VV_UB 100.0 FORMULA_0003 0.0 255.0 /end CHARACTERISTIC
/begin CHARACTERISTIC K_ED_INDEX_218_INJ.FEHLERSCHWELLE "Filterschwelle fuer Fehlereintrag" VALUE 0x71EFE TKW_VV_VV_UB 100.0 FORMULA_0003 0.0 255.0 /end CHARACTERISTIC
/begin CHARACTERISTIC K_ED_INDEX_218_INJ.INC_NACH_EINTRAG "Filtererhoehung nach Fehlerspeichereintrag" VALUE 0x71F02 TKW_VV_VV_UB 100.0 FORMULA_0003 0.0 255.0 /end CHARACTERISTIC
/begin CHARACTERISTIC K_ED_INDEX_218_INJ.INC_VOR_EINTRAG "Filtererhoehung vorm Fehlerspeichereintrag" VALUE 0x71F00 TKW_VV_VV_UB 100.0 FORMULA_0003 0.0 255.0 /end CHARACTERISTIC
/begin CHARACTERISTIC K_ED_INDEX_218_INJ.KLASSENINDEX "Auswahl der Fehlerklasse" VALUE 0x71F04 TKW_VV_VV_UB 100.0 FORMULA_0003 0.0 8.0 /end CHARACTERISTIC
/begin CHARACTERISTIC K_ED_INDEX_218_INJ.OK_SCHWELLE "Filterschwelle fuer Fehleraustrag" VALUE 0x71EFF TKW_VV_VV_UB 100.0 FORMULA_0003 0.0 255.0 /end CHARACTERISTIC
/begin CHARACTERISTIC K_ED_INDEX_218_INJ.P_CODE_OPENLOAD "P-Code fuer die Art OPENLOAD" VALUE 0x71EFA TKW_VV_VV_UW 100.0 FORMULA_0010 0.0 65535.0 /end CHARACTERISTIC
/begin CHARACTERISTIC K_ED_INDEX_218_INJ.P_CODE_SH_TO_GND "P-Code fuer die Art SH_TO_GND" VALUE 0x71EF8 TKW_VV_VV_UW 100.0 FORMULA_0010 0.0 65535.0 /end CHARACTERISTIC
/begin CHARACTERISTIC K_ED_INDEX_218_INJ.P_CODE_SH_TO_UB "P-Code fuer die Art SH_TO_UB" VALUE 0x71EF6 TKW_VV_VV_UW 100.0 FORMULA_0010 0.0 65535.0 /end CHARACTERISTIC
/begin CHARACTERISTIC K_ED_INDEX_218_INJ.P_CODE_UNPLAUSIBEL "P-Code fuer die Art UNPLAUSIBEL" VALUE 0x71EFC TKW_VV_VV_UW 100.0 FORMULA_0010 0.0 65535.0 /end CHARACTERISTIC
/begin CHARACTERISTIC K_ED_INDEX_219_INJ.DEC_NACH_EINTRAG "Filterverringerung nach Fehlerspeichereintrag" VALUE 0x71F1D TKW_VV_VV_UB 100.0 FORMULA_0003 0.0 255.0 /end CHARACTERISTIC
/begin CHARACTERISTIC K_ED_INDEX_219_INJ.DEC_VOR_EINTRAG "Filterverringerung vorm Fehlerspeichereintrag" VALUE 0x71F1B TKW_VV_VV_UB 100.0 FORMULA_0003 0.0 255.0 /end CHARACTERISTIC
/begin CHARACTERISTIC K_ED_INDEX_219_INJ.FEHLERSCHWELLE "Filterschwelle fuer Fehlereintrag" VALUE 0x71F18 TKW_VV_VV_UB 100.0 FORMULA_0003 0.0 255.0 /end CHARACTERISTIC
/begin CHARACTERISTIC K_ED_INDEX_219_INJ.INC_NACH_EINTRAG "Filtererhoehung nach Fehlerspeichereintrag" VALUE 0x71F1C TKW_VV_VV_UB 100.0 FORMULA_0003 0.0 255.0 /end CHARACTERISTIC
/begin CHARACTERISTIC K_ED_INDEX_219_INJ.INC_VOR_EINTRAG "Filtererhoehung vorm Fehlerspeichereintrag" VALUE 0x71F1A TKW_VV_VV_UB 100.0 FORMULA_0003 0.0 255.0 /end CHARACTERISTIC
/begin CHARACTERISTIC K_ED_INDEX_219_INJ.KLASSENINDEX "Auswahl der Fehlerklasse" VALUE 0x71F1E TKW_VV_VV_UB 100.0 FORMULA_0003 0.0 8.0 /end CHARACTERISTIC
/begin CHARACTERISTIC K_ED_INDEX_219_INJ.OK_SCHWELLE "Filterschwelle fuer Fehleraustrag" VALUE 0x71F19 TKW_VV_VV_UB 100.0 FORMULA_0003 0.0 255.0 /end CHARACTERISTIC
/begin CHARACTERISTIC K_ED_INDEX_219_INJ.P_CODE_OPENLOAD "P-Code fuer die Art OPENLOAD" VALUE 0x71F14 TKW_VV_VV_UW 100.0 FORMULA_0010 0.0 65535.0 /end CHARACTERISTIC
/begin CHARACTERISTIC K_ED_INDEX_219_INJ.P_CODE_SH_TO_GND "P-Code fuer die Art SH_TO_GND" VALUE 0x71F12 TKW_VV_VV_UW 100.0 FORMULA_0010 0.0 65535.0 /end CHARACTERISTIC
/begin CHARACTERISTIC K_ED_INDEX_219_INJ.P_CODE_SH_TO_UB "P-Code fuer die Art SH_TO_UB" VALUE 0x71F10 TKW_VV_VV_UW 100.0 FORMULA_0010 0.0 65535.0 /end CHARACTERISTIC
/begin CHARACTERISTIC K_ED_INDEX_219_INJ.P_CODE_UNPLAUSIBEL "P-Code fuer die Art UNPLAUSIBEL" VALUE 0x71F16 TKW_VV_VV_UW 100.0 FORMULA_0010 0.0 65535.0 /end CHARACTERISTIC
/begin CHARACTERISTIC K_ED_INDEX_220_INJ.DEC_NACH_EINTRAG "Filterverringerung nach Fehlerspeichereintrag" VALUE 0x71F37 TKW_VV_VV_UB 100.0 FORMULA_0003 0.0 255.0 /end CHARACTERISTIC
/begin CHARACTERISTIC K_ED_INDEX_220_INJ.DEC_VOR_EINTRAG "Filterverringerung vorm Fehlerspeichereintrag" VALUE 0x71F35 TKW_VV_VV_UB 100.0 FORMULA_0003 0.0 255.0 /end CHARACTERISTIC
/begin CHARACTERISTIC K_ED_INDEX_220_INJ.FEHLERSCHWELLE "Filterschwelle fuer Fehlereintrag" VALUE 0x71F32 TKW_VV_VV_UB 100.0 FORMULA_0003 0.0 255.0 /end CHARACTERISTIC
/begin CHARACTERISTIC K_ED_INDEX_220_INJ.INC_NACH_EINTRAG "Filtererhoehung nach Fehlerspeichereintrag" VALUE 0x71F36 TKW_VV_VV_UB 100.0 FORMULA_0003 0.0 255.0 /end CHARACTERISTIC
/begin CHARACTERISTIC K_ED_INDEX_220_INJ.INC_VOR_EINTRAG "Filtererhoehung vorm Fehlerspeichereintrag" VALUE 0x71F34 TKW_VV_VV_UB 100.0 FORMULA_0003 0.0 255.0 /end CHARACTERISTIC
/begin CHARACTERISTIC K_ED_INDEX_220_INJ.KLASSENINDEX "Auswahl der Fehlerklasse" VALUE 0x71F38 TKW_VV_VV_UB 100.0 FORMULA_0003 0.0 8.0 /end CHARACTERISTIC
/begin CHARACTERISTIC K_ED_INDEX_220_INJ.OK_SCHWELLE "Filterschwelle fuer Fehleraustrag" VALUE 0x71F33 TKW_VV_VV_UB 100.0 FORMULA_0003 0.0 255.0 /end CHARACTERISTIC
/begin CHARACTERISTIC K_ED_INDEX_220_INJ.P_CODE_OPENLOAD "P-Code fuer die Art OPENLOAD" VALUE 0x71F2E TKW_VV_VV_UW 100.0 FORMULA_0010 0.0 65535.0 /end CHARACTERISTIC
/begin CHARACTERISTIC K_ED_INDEX_220_INJ.P_CODE_SH_TO_GND "P-Code fuer die Art SH_TO_GND" VALUE 0x71F2C TKW_VV_VV_UW 100.0 FORMULA_0010 0.0 65535.0 /end CHARACTERISTIC
/begin CHARACTERISTIC K_ED_INDEX_220_INJ.P_CODE_SH_TO_UB "P-Code fuer die Art SH_TO_UB" VALUE 0x71F2A TKW_VV_VV_UW 100.0 FORMULA_0010 0.0 65535.0 /end CHARACTERISTIC
/begin CHARACTERISTIC K_ED_INDEX_220_INJ.P_CODE_UNPLAUSIBEL "P-Code fuer die Art UNPLAUSIBEL" VALUE 0x71F30 TKW_VV_VV_UW 100.0 FORMULA_0010 0.0 65535.0 /end CHARACTERISTIC
/begin CHARACTERISTIC K_ED_INDEX_221_INJ.DEC_NACH_EINTRAG "Filterverringerung nach Fehlerspeichereintrag" VALUE 0x71F51 TKW_VV_VV_UB 100.0 FORMULA_0003 0.0 255.0 /end CHARACTERISTIC
/begin CHARACTERISTIC K_ED_INDEX_221_INJ.DEC_VOR_EINTRAG "Filterverringerung vorm Fehlerspeichereintrag" VALUE 0x71F4F TKW_VV_VV_UB 100.0 FORMULA_0003 0.0 255.0 /end CHARACTERISTIC
/begin CHARACTERISTIC K_ED_INDEX_221_INJ.FEHLERSCHWELLE "Filterschwelle fuer Fehlereintrag" VALUE 0x71F4C TKW_VV_VV_UB 100.0 FORMULA_0003 0.0 255.0 /end CHARACTERISTIC
/begin CHARACTERISTIC K_ED_INDEX_221_INJ.INC_NACH_EINTRAG "Filtererhoehung nach Fehlerspeichereintrag" VALUE 0x71F50 TKW_VV_VV_UB 100.0 FORMULA_0003 0.0 255.0 /end CHARACTERISTIC
/begin CHARACTERISTIC K_ED_INDEX_221_INJ.INC_VOR_EINTRAG "Filtererhoehung vorm Fehlerspeichereintrag" VALUE 0x71F4E TKW_VV_VV_UB 100.0 FORMULA_0003 0.0 255.0 /end CHARACTERISTIC
/begin CHARACTERISTIC K_ED_INDEX_221_INJ.KLASSENINDEX "Auswahl der Fehlerklasse" VALUE 0x71F52 TKW_VV_VV_UB 100.0 FORMULA_0003 0.0 8.0 /end CHARACTERISTIC
/begin CHARACTERISTIC K_ED_INDEX_221_INJ.OK_SCHWELLE "Filterschwelle fuer Fehleraustrag" VALUE 0x71F4D TKW_VV_VV_UB 100.0 FORMULA_0003 0.0 255.0 /end CHARACTERISTIC
/begin CHARACTERISTIC K_ED_INDEX_221_INJ.P_CODE_OPENLOAD "P-Code fuer die Art OPENLOAD" VALUE 0x71F48 TKW_VV_VV_UW 100.0 FORMULA_0010 0.0 65535.0 /end CHARACTERISTIC
/begin CHARACTERISTIC K_ED_INDEX_221_INJ.P_CODE_SH_TO_GND "P-Code fuer die Art SH_TO_GND" VALUE 0x71F46 TKW_VV_VV_UW 100.0 FORMULA_0010 0.0 65535.0 /end CHARACTERISTIC
/begin CHARACTERISTIC K_ED_INDEX_221_INJ.P_CODE_SH_TO_UB "P-Code fuer die Art SH_TO_UB" VALUE 0x71F44 TKW_VV_VV_UW 100.0 FORMULA_0010 0.0 65535.0 /end CHARACTERISTIC
/begin CHARACTERISTIC K_ED_INDEX_221_INJ.P_CODE_UNPLAUSIBEL "P-Code fuer die Art UNPLAUSIBEL" VALUE 0x71F4A TKW_VV_VV_UW 100.0 FORMULA_0010 0.0 65535.0 /end CHARACTERISTIC
/begin CHARACTERISTIC K_ED_INDEX_222_INJ.DEC_NACH_EINTRAG "Filterverringerung nach Fehlerspeichereintrag" VALUE 0x71F6B TKW_VV_VV_UB 100.0 FORMULA_0003 0.0 255.0 /end CHARACTERISTIC
/begin CHARACTERISTIC K_ED_INDEX_222_INJ.DEC_VOR_EINTRAG "Filterverringerung vorm Fehlerspeichereintrag" VALUE 0x71F69 TKW_VV_VV_UB 100.0 FORMULA_0003 0.0 255.0 /end CHARACTERISTIC
/begin CHARACTERISTIC K_ED_INDEX_222_INJ.FEHLERSCHWELLE "Filterschwelle fuer Fehlereintrag" VALUE 0x71F66 TKW_VV_VV_UB 100.0 FORMULA_0003 0.0 255.0 /end CHARACTERISTIC
/begin CHARACTERISTIC K_ED_INDEX_222_INJ.INC_NACH_EINTRAG "Filtererhoehung nach Fehlerspeichereintrag" VALUE 0x71F6A TKW_VV_VV_UB 100.0 FORMULA_0003 0.0 255.0 /end CHARACTERISTIC
/begin CHARACTERISTIC K_ED_INDEX_222_INJ.INC_VOR_EINTRAG "Filtererhoehung vorm Fehlerspeichereintrag" VALUE 0x71F68 TKW_VV_VV_UB 100.0 FORMULA_0003 0.0 255.0 /end CHARACTERISTIC
/begin CHARACTERISTIC K_ED_INDEX_222_INJ.KLASSENINDEX "Auswahl der Fehlerklasse" VALUE 0x71F6C TKW_VV_VV_UB 100.0 FORMULA_0003 0.0 8.0 /end CHARACTERISTIC
/begin CHARACTERISTIC K_ED_INDEX_222_INJ.OK_SCHWELLE "Filterschwelle fuer Fehleraustrag" VALUE 0x71F67 TKW_VV_VV_UB 100.0 FORMULA_0003 0.0 255.0 /end CHARACTERISTIC
/begin CHARACTERISTIC K_ED_INDEX_222_INJ.P_CODE_OPENLOAD "P-Code fuer die Art OPENLOAD" VALUE 0x71F62 TKW_VV_VV_UW 100.0 FORMULA_0010 0.0 65535.0 /end CHARACTERISTIC
/begin CHARACTERISTIC K_ED_INDEX_222_INJ.P_CODE_SH_TO_GND "P-Code fuer die Art SH_TO_GND" VALUE 0x71F60 TKW_VV_VV_UW 100.0 FORMULA_0010 0.0 65535.0 /end CHARACTERISTIC
/begin CHARACTERISTIC K_ED_INDEX_222_INJ.P_CODE_SH_TO_UB "P-Code fuer die Art SH_TO_UB" VALUE 0x71F5E TKW_VV_VV_UW 100.0 FORMULA_0010 0.0 65535.0 /end CHARACTERISTIC
/begin CHARACTERISTIC K_ED_INDEX_222_INJ.P_CODE_UNPLAUSIBEL "P-Code fuer die Art UNPLAUSIBEL" VALUE 0x71F64 TKW_VV_VV_UW 100.0 FORMULA_0010 0.0 65535.0 /end CHARACTERISTIC
/begin CHARACTERISTIC K_ED_INDEX_223_INJ.DEC_NACH_EINTRAG "Filterverringerung nach Fehlerspeichereintrag" VALUE 0x71F85 TKW_VV_VV_UB 100.0 FORMULA_0003 0.0 255.0 /end CHARACTERISTIC
/begin CHARACTERISTIC K_ED_INDEX_223_INJ.DEC_VOR_EINTRAG "Filterverringerung vorm Fehlerspeichereintrag" VALUE 0x71F83 TKW_VV_VV_UB 100.0 FORMULA_0003 0.0 255.0 /end CHARACTERISTIC
/begin CHARACTERISTIC K_ED_INDEX_223_INJ.FEHLERSCHWELLE "Filterschwelle fuer Fehlereintrag" VALUE 0x71F80 TKW_VV_VV_UB 100.0 FORMULA_0003 0.0 255.0 /end CHARACTERISTIC
/begin CHARACTERISTIC K_ED_INDEX_223_INJ.INC_NACH_EINTRAG "Filtererhoehung nach Fehlerspeichereintrag" VALUE 0x71F84 TKW_VV_VV_UB 100.0 FORMULA_0003 0.0 255.0 /end CHARACTERISTIC
/begin CHARACTERISTIC K_ED_INDEX_223_INJ.INC_VOR_EINTRAG "Filtererhoehung vorm Fehlerspeichereintrag" VALUE 0x71F82 TKW_VV_VV_UB 100.0 FORMULA_0003 0.0 255.0 /end CHARACTERISTIC
/begin CHARACTERISTIC K_ED_INDEX_223_INJ.KLASSENINDEX "Auswahl der Fehlerklasse" VALUE 0x71F86 TKW_VV_VV_UB 100.0 FORMULA_0003 0.0 8.0 /end CHARACTERISTIC
/begin CHARACTERISTIC K_ED_INDEX_223_INJ.OK_SCHWELLE "Filterschwelle fuer Fehleraustrag" VALUE 0x71F81 TKW_VV_VV_UB 100.0 FORMULA_0003 0.0 255.0 /end CHARACTERISTIC
/begin CHARACTERISTIC K_ED_INDEX_223_INJ.P_CODE_OPENLOAD "P-Code fuer die Art OPENLOAD" VALUE 0x71F7C TKW_VV_VV_UW 100.0 FORMULA_0010 0.0 65535.0 /end CHARACTERISTIC
/begin CHARACTERISTIC K_ED_INDEX_223_INJ.P_CODE_SH_TO_GND "P-Code fuer die Art SH_TO_GND" VALUE 0x71F7A TKW_VV_VV_UW 100.0 FORMULA_0010 0.0 65535.0 /end CHARACTERISTIC
/begin CHARACTERISTIC K_ED_INDEX_223_INJ.P_CODE_SH_TO_UB "P-Code fuer die Art SH_TO_UB" VALUE 0x71F78 TKW_VV_VV_UW 100.0 FORMULA_0010 0.0 65535.0 /end CHARACTERISTIC
/begin CHARACTERISTIC K_ED_INDEX_223_INJ.P_CODE_UNPLAUSIBEL "P-Code fuer die Art UNPLAUSIBEL" VALUE 0x71F7E TKW_VV_VV_UW 100.0 FORMULA_0010 0.0 65535.0 /end CHARACTERISTIC
/begin CHARACTERISTIC K_ED_KAT_OBD1.DEC_NACH_EINTRAG "Filterverringerung nach Fehlerspeichereintrag" VALUE 0x71529 TKW_VV_VV_UB 100.0 FORMULA_0003 0.0 255.0 /end CHARACTERISTIC
/begin CHARACTERISTIC K_ED_KAT_OBD1.DEC_VOR_EINTRAG "Filterverringerung vorm Fehlerspeichereintrag" VALUE 0x71527 TKW_VV_VV_UB 100.0 FORMULA_0003 0.0 255.0 /end CHARACTERISTIC
/begin CHARACTERISTIC K_ED_KAT_OBD1.FEHLERSCHWELLE "Filterschwelle fuer Fehlereintrag" VALUE 0x71524 TKW_VV_VV_UB 100.0 FORMULA_0003 0.0 255.0 /end CHARACTERISTIC
/begin CHARACTERISTIC K_ED_KAT_OBD1.INC_NACH_EINTRAG "Filtererhoehung nach Fehlerspeichereintrag" VALUE 0x71528 TKW_VV_VV_UB 100.0 FORMULA_0003 0.0 255.0 /end CHARACTERISTIC
/begin CHARACTERISTIC K_ED_KAT_OBD1.INC_VOR_EINTRAG "Filtererhoehung vorm Fehlerspeichereintrag" VALUE 0x71526 TKW_VV_VV_UB 100.0 FORMULA_0003 0.0 255.0 /end CHARACTERISTIC
/begin CHARACTERISTIC K_ED_KAT_OBD1.KLASSENINDEX "Auswahl der Fehlerklasse" VALUE 0x7152A TKW_VV_VV_UB 100.0 FORMULA_0003 0.0 8.0 /end CHARACTERISTIC
/begin CHARACTERISTIC K_ED_KAT_OBD1.OK_SCHWELLE "Filterschwelle fuer Fehleraustrag" VALUE 0x71525 TKW_VV_VV_UB 100.0 FORMULA_0003 0.0 255.0 /end CHARACTERISTIC
/begin CHARACTERISTIC K_ED_KAT_OBD1.P_CODE_OPENLOAD "P-Code fuer die Art OPENLOAD" VALUE 0x71520 TKW_VV_VV_UW 100.0 FORMULA_0010 0.0 65535.0 /end CHARACTERISTIC
/begin CHARACTERISTIC K_ED_KAT_OBD1.P_CODE_SH_TO_GND "P-Code fuer die Art SH_TO_GND" VALUE 0x7151E TKW_VV_VV_UW 100.0 FORMULA_0010 0.0 65535.0 /end CHARACTERISTIC
/begin CHARACTERISTIC K_ED_KAT_OBD1.P_CODE_SH_TO_UB "P-Code fuer die Art SH_TO_UB" VALUE 0x7151C TKW_VV_VV_UW 100.0 FORMULA_0010 0.0 65535.0 /end CHARACTERISTIC
/begin CHARACTERISTIC K_ED_KAT_OBD1.P_CODE_UNPLAUSIBEL "P-Code fuer die Art UNPLAUSIBEL" VALUE 0x71522 TKW_VV_VV_UW 100.0 FORMULA_0010 0.0 65535.0 /end CHARACTERISTIC
/begin CHARACTERISTIC K_ED_KAT_OBD2.DEC_NACH_EINTRAG "Filterverringerung nach Fehlerspeichereintrag" VALUE 0x71543 TKW_VV_VV_UB 100.0 FORMULA_0003 0.0 255.0 /end CHARACTERISTIC
/begin CHARACTERISTIC K_ED_KAT_OBD2.DEC_VOR_EINTRAG "Filterverringerung vorm Fehlerspeichereintrag" VALUE 0x71541 TKW_VV_VV_UB 100.0 FORMULA_0003 0.0 255.0 /end CHARACTERISTIC
/begin CHARACTERISTIC K_ED_KAT_OBD2.FEHLERSCHWELLE "Filterschwelle fuer Fehlereintrag" VALUE 0x7153E TKW_VV_VV_UB 100.0 FORMULA_0003 0.0 255.0 /end CHARACTERISTIC
/begin CHARACTERISTIC K_ED_KAT_OBD2.INC_NACH_EINTRAG "Filtererhoehung nach Fehlerspeichereintrag" VALUE 0x71542 TKW_VV_VV_UB 100.0 FORMULA_0003 0.0 255.0 /end CHARACTERISTIC
/begin CHARACTERISTIC K_ED_KAT_OBD2.INC_VOR_EINTRAG "Filtererhoehung vorm Fehlerspeichereintrag" VALUE 0x71540 TKW_VV_VV_UB 100.0 FORMULA_0003 0.0 255.0 /end CHARACTERISTIC
/begin CHARACTERISTIC K_ED_KAT_OBD2.KLASSENINDEX "Auswahl der Fehlerklasse" VALUE 0x71544 TKW_VV_VV_UB 100.0 FORMULA_0003 0.0 8.0 /end CHARACTERISTIC
/begin CHARACTERISTIC K_ED_KAT_OBD2.OK_SCHWELLE "Filterschwelle fuer Fehleraustrag" VALUE 0x7153F TKW_VV_VV_UB 100.0 FORMULA_0003 0.0 255.0 /end CHARACTERISTIC
/begin CHARACTERISTIC K_ED_KAT_OBD2.P_CODE_OPENLOAD "P-Code fuer die Art OPENLOAD" VALUE 0x7153A TKW_VV_VV_UW 100.0 FORMULA_0010 0.0 65535.0 /end CHARACTERISTIC
/begin CHARACTERISTIC K_ED_KAT_OBD2.P_CODE_SH_TO_GND "P-Code fuer die Art SH_TO_GND" VALUE 0x71538 TKW_VV_VV_UW 100.0 FORMULA_0010 0.0 65535.0 /end CHARACTERISTIC
/begin CHARACTERISTIC K_ED_KAT_OBD2.P_CODE_SH_TO_UB "P-Code fuer die Art SH_TO_UB" VALUE 0x71536 TKW_VV_VV_UW 100.0 FORMULA_0010 0.0 65535.0 /end CHARACTERISTIC
/begin CHARACTERISTIC K_ED_KAT_OBD2.P_CODE_UNPLAUSIBEL "P-Code fuer die Art UNPLAUSIBEL" VALUE 0x7153C TKW_VV_VV_UW 100.0 FORMULA_0010 0.0 65535.0 /end CHARACTERISTIC
/begin CHARACTERISTIC K_ED_KATS_B1.DEC_NACH_EINTRAG "Filterverringerung nach Fehlerspeichereintrag" VALUE 0x71A57 TKW_VV_VV_UB 100.0 FORMULA_0003 0.0 255.0 /end CHARACTERISTIC
/begin CHARACTERISTIC K_ED_KATS_B1.DEC_VOR_EINTRAG "Filterverringerung vorm Fehlerspeichereintrag" VALUE 0x71A55 TKW_VV_VV_UB 100.0 FORMULA_0003 0.0 255.0 /end CHARACTERISTIC
/begin CHARACTERISTIC K_ED_KATS_B1.FEHLERSCHWELLE "Filterschwelle fuer Fehlereintrag" VALUE 0x71A52 TKW_VV_VV_UB 100.0 FORMULA_0003 0.0 255.0 /end CHARACTERISTIC
/begin CHARACTERISTIC K_ED_KATS_B1.INC_NACH_EINTRAG "Filtererhoehung nach Fehlerspeichereintrag" VALUE 0x71A56 TKW_VV_VV_UB 100.0 FORMULA_0003 0.0 255.0 /end CHARACTERISTIC
/begin CHARACTERISTIC K_ED_KATS_B1.INC_VOR_EINTRAG "Filtererhoehung vorm Fehlerspeichereintrag" VALUE 0x71A54 TKW_VV_VV_UB 100.0 FORMULA_0003 0.0 255.0 /end CHARACTERISTIC
/begin CHARACTERISTIC K_ED_KATS_B1.KLASSENINDEX "Auswahl der Fehlerklasse" VALUE 0x71A58 TKW_VV_VV_UB 100.0 FORMULA_0003 0.0 8.0 /end CHARACTERISTIC
/begin CHARACTERISTIC K_ED_KATS_B1.OK_SCHWELLE "Filterschwelle fuer Fehleraustrag" VALUE 0x71A53 TKW_VV_VV_UB 100.0 FORMULA_0003 0.0 255.0 /end CHARACTERISTIC
/begin CHARACTERISTIC K_ED_KATS_B1.P_CODE_OPENLOAD "P-Code fuer die Art OPENLOAD" VALUE 0x71A4E TKW_VV_VV_UW 100.0 FORMULA_0010 0.0 65535.0 /end CHARACTERISTIC
/begin CHARACTERISTIC K_ED_KATS_B1.P_CODE_SH_TO_GND "P-Code fuer die Art SH_TO_GND" VALUE 0x71A4C TKW_VV_VV_UW 100.0 FORMULA_0010 0.0 65535.0 /end CHARACTERISTIC
/begin CHARACTERISTIC K_ED_KATS_B1.P_CODE_SH_TO_UB "P-Code fuer die Art SH_TO_UB" VALUE 0x71A4A TKW_VV_VV_UW 100.0 FORMULA_0010 0.0 65535.0 /end CHARACTERISTIC
/begin CHARACTERISTIC K_ED_KATS_B1.P_CODE_UNPLAUSIBEL "P-Code fuer die Art UNPLAUSIBEL" VALUE 0x71A50 TKW_VV_VV_UW 100.0 FORMULA_0010 0.0 65535.0 /end CHARACTERISTIC
/begin CHARACTERISTIC K_ED_KATS_B2.DEC_NACH_EINTRAG "Filterverringerung nach Fehlerspeichereintrag" VALUE 0x71A71 TKW_VV_VV_UB 100.0 FORMULA_0003 0.0 255.0 /end CHARACTERISTIC
/begin CHARACTERISTIC K_ED_KATS_B2.DEC_VOR_EINTRAG "Filterverringerung vorm Fehlerspeichereintrag" VALUE 0x71A6F TKW_VV_VV_UB 100.0 FORMULA_0003 0.0 255.0 /end CHARACTERISTIC
/begin CHARACTERISTIC K_ED_KATS_B2.FEHLERSCHWELLE "Filterschwelle fuer Fehlereintrag" VALUE 0x71A6C TKW_VV_VV_UB 100.0 FORMULA_0003 0.0 255.0 /end CHARACTERISTIC
/begin CHARACTERISTIC K_ED_KATS_B2.INC_NACH_EINTRAG "Filtererhoehung nach Fehlerspeichereintrag" VALUE 0x71A70 TKW_VV_VV_UB 100.0 FORMULA_0003 0.0 255.0 /end CHARACTERISTIC
/begin CHARACTERISTIC K_ED_KATS_B2.INC_VOR_EINTRAG "Filtererhoehung vorm Fehlerspeichereintrag" VALUE 0x71A6E TKW_VV_VV_UB 100.0 FORMULA_0003 0.0 255.0 /end CHARACTERISTIC
/begin CHARACTERISTIC K_ED_KATS_B2.KLASSENINDEX "Auswahl der Fehlerklasse" VALUE 0x71A72 TKW_VV_VV_UB 100.0 FORMULA_0003 0.0 8.0 /end CHARACTERISTIC
/begin CHARACTERISTIC K_ED_KATS_B2.OK_SCHWELLE "Filterschwelle fuer Fehleraustrag" VALUE 0x71A6D TKW_VV_VV_UB 100.0 FORMULA_0003 0.0 255.0 /end CHARACTERISTIC
/begin CHARACTERISTIC K_ED_KATS_B2.P_CODE_OPENLOAD "P-Code fuer die Art OPENLOAD" VALUE 0x71A68 TKW_VV_VV_UW 100.0 FORMULA_0010 0.0 65535.0 /end CHARACTERISTIC
/begin CHARACTERISTIC K_ED_KATS_B2.P_CODE_SH_TO_GND "P-Code fuer die Art SH_TO_GND" VALUE 0x71A66 TKW_VV_VV_UW 100.0 FORMULA_0010 0.0 65535.0 /end CHARACTERISTIC
/begin CHARACTERISTIC K_ED_KATS_B2.P_CODE_SH_TO_UB "P-Code fuer die Art SH_TO_UB" VALUE 0x71A64 TKW_VV_VV_UW 100.0 FORMULA_0010 0.0 65535.0 /end CHARACTERISTIC
/begin CHARACTERISTIC K_ED_KATS_B2.P_CODE_UNPLAUSIBEL "P-Code fuer die Art UNPLAUSIBEL" VALUE 0x71A6A TKW_VV_VV_UW 100.0 FORMULA_0010 0.0 65535.0 /end CHARACTERISTIC
/begin CHARACTERISTIC K_ED_KGE1.DEC_NACH_EINTRAG "Filterverringerung nach Fehlerspeichereintrag" VALUE 0x718B7 TKW_VV_VV_UB 100.0 FORMULA_0003 0.0 255.0 /end CHARACTERISTIC
/begin CHARACTERISTIC K_ED_KGE1.DEC_VOR_EINTRAG "Filterverringerung vorm Fehlerspeichereintrag" VALUE 0x718B5 TKW_VV_VV_UB 100.0 FORMULA_0003 0.0 255.0 /end CHARACTERISTIC
/begin CHARACTERISTIC K_ED_KGE1.FEHLERSCHWELLE "Filterschwelle fuer Fehlereintrag" VALUE 0x718B2 TKW_VV_VV_UB 100.0 FORMULA_0003 0.0 255.0 /end CHARACTERISTIC
/begin CHARACTERISTIC K_ED_KGE1.INC_NACH_EINTRAG "Filtererhoehung nach Fehlerspeichereintrag" VALUE 0x718B6 TKW_VV_VV_UB 100.0 FORMULA_0003 0.0 255.0 /end CHARACTERISTIC
/begin CHARACTERISTIC K_ED_KGE1.INC_VOR_EINTRAG "Filtererhoehung vorm Fehlerspeichereintrag" VALUE 0x718B4 TKW_VV_VV_UB 100.0 FORMULA_0003 0.0 255.0 /end CHARACTERISTIC
/begin CHARACTERISTIC K_ED_KGE1.KLASSENINDEX "Auswahl der Fehlerklasse" VALUE 0x718B8 TKW_VV_VV_UB 100.0 FORMULA_0003 0.0 8.0 /end CHARACTERISTIC
/begin CHARACTERISTIC K_ED_KGE1.OK_SCHWELLE "Filterschwelle fuer Fehleraustrag" VALUE 0x718B3 TKW_VV_VV_UB 100.0 FORMULA_0003 0.0 255.0 /end CHARACTERISTIC
/begin CHARACTERISTIC K_ED_KGE1.P_CODE_OPENLOAD "P-Code fuer die Art OPENLOAD" VALUE 0x718AE TKW_VV_VV_UW 100.0 FORMULA_0010 0.0 65535.0 /end CHARACTERISTIC
/begin CHARACTERISTIC K_ED_KGE1.P_CODE_SH_TO_GND "P-Code fuer die Art SH_TO_GND" VALUE 0x718AC TKW_VV_VV_UW 100.0 FORMULA_0010 0.0 65535.0 /end CHARACTERISTIC
/begin CHARACTERISTIC K_ED_KGE1.P_CODE_SH_TO_UB "P-Code fuer die Art SH_TO_UB" VALUE 0x718AA TKW_VV_VV_UW 100.0 FORMULA_0010 0.0 65535.0 /end CHARACTERISTIC
/begin CHARACTERISTIC K_ED_KGE1.P_CODE_UNPLAUSIBEL "P-Code fuer die Art UNPLAUSIBEL" VALUE 0x718B0 TKW_VV_VV_UW 100.0 FORMULA_0010 0.0 65535.0 /end CHARACTERISTIC
/begin CHARACTERISTIC K_ED_KGE2.DEC_NACH_EINTRAG "Filterverringerung nach Fehlerspeichereintrag" VALUE 0x718D1 TKW_VV_VV_UB 100.0 FORMULA_0003 0.0 255.0 /end CHARACTERISTIC
/begin CHARACTERISTIC K_ED_KGE2.DEC_VOR_EINTRAG "Filterverringerung vorm Fehlerspeichereintrag" VALUE 0x718CF TKW_VV_VV_UB 100.0 FORMULA_0003 0.0 255.0 /end CHARACTERISTIC
/begin CHARACTERISTIC K_ED_KGE2.FEHLERSCHWELLE "Filterschwelle fuer Fehlereintrag" VALUE 0x718CC TKW_VV_VV_UB 100.0 FORMULA_0003 0.0 255.0 /end CHARACTERISTIC
/begin CHARACTERISTIC K_ED_KGE2.INC_NACH_EINTRAG "Filtererhoehung nach Fehlerspeichereintrag" VALUE 0x718D0 TKW_VV_VV_UB 100.0 FORMULA_0003 0.0 255.0 /end CHARACTERISTIC
/begin CHARACTERISTIC K_ED_KGE2.INC_VOR_EINTRAG "Filtererhoehung vorm Fehlerspeichereintrag" VALUE 0x718CE TKW_VV_VV_UB 100.0 FORMULA_0003 0.0 255.0 /end CHARACTERISTIC
/begin CHARACTERISTIC K_ED_KGE2.KLASSENINDEX "Auswahl der Fehlerklasse" VALUE 0x718D2 TKW_VV_VV_UB 100.0 FORMULA_0003 0.0 8.0 /end CHARACTERISTIC
/begin CHARACTERISTIC K_ED_KGE2.OK_SCHWELLE "Filterschwelle fuer Fehleraustrag" VALUE 0x718CD TKW_VV_VV_UB 100.0 FORMULA_0003 0.0 255.0 /end CHARACTERISTIC
/begin CHARACTERISTIC K_ED_KGE2.P_CODE_OPENLOAD "P-Code fuer die Art OPENLOAD" VALUE 0x718C8 TKW_VV_VV_UW 100.0 FORMULA_0010 0.0 65535.0 /end CHARACTERISTIC
/begin CHARACTERISTIC K_ED_KGE2.P_CODE_SH_TO_GND "P-Code fuer die Art SH_TO_GND" VALUE 0x718C6 TKW_VV_VV_UW 100.0 FORMULA_0010 0.0 65535.0 /end CHARACTERISTIC
/begin CHARACTERISTIC K_ED_KGE2.P_CODE_SH_TO_UB "P-Code fuer die Art SH_TO_UB" VALUE 0x718C4 TKW_VV_VV_UW 100.0 FORMULA_0010 0.0 65535.0 /end CHARACTERISTIC
/begin CHARACTERISTIC K_ED_KGE2.P_CODE_UNPLAUSIBEL "P-Code fuer die Art UNPLAUSIBEL" VALUE 0x718CA TKW_VV_VV_UW 100.0 FORMULA_0010 0.0 65535.0 /end CHARACTERISTIC
/begin CHARACTERISTIC K_ED_KSD1.DEC_NACH_EINTRAG "Filterverringerung nach Fehlerspeichereintrag" VALUE 0x71A23 TKW_VV_VV_UB 100.0 FORMULA_0003 0.0 255.0 /end CHARACTERISTIC
/begin CHARACTERISTIC K_ED_KSD1.DEC_VOR_EINTRAG "Filterverringerung vorm Fehlerspeichereintrag" VALUE 0x71A21 TKW_VV_VV_UB 100.0 FORMULA_0003 0.0 255.0 /end CHARACTERISTIC
/begin CHARACTERISTIC K_ED_KSD1.FEHLERSCHWELLE "Filterschwelle fuer Fehlereintrag" VALUE 0x71A1E TKW_VV_VV_UB 100.0 FORMULA_0003 0.0 255.0 /end CHARACTERISTIC
/begin CHARACTERISTIC K_ED_KSD1.INC_NACH_EINTRAG "Filtererhoehung nach Fehlerspeichereintrag" VALUE 0x71A22 TKW_VV_VV_UB 100.0 FORMULA_0003 0.0 255.0 /end CHARACTERISTIC
/begin CHARACTERISTIC K_ED_KSD1.INC_VOR_EINTRAG "Filtererhoehung vorm Fehlerspeichereintrag" VALUE 0x71A20 TKW_VV_VV_UB 100.0 FORMULA_0003 0.0 255.0 /end CHARACTERISTIC
/begin CHARACTERISTIC K_ED_KSD1.KLASSENINDEX "Auswahl der Fehlerklasse" VALUE 0x71A24 TKW_VV_VV_UB 100.0 FORMULA_0003 0.0 8.0 /end CHARACTERISTIC
/begin CHARACTERISTIC K_ED_KSD1.OK_SCHWELLE "Filterschwelle fuer Fehleraustrag" VALUE 0x71A1F TKW_VV_VV_UB 100.0 FORMULA_0003 0.0 255.0 /end CHARACTERISTIC
/begin CHARACTERISTIC K_ED_KSD1.P_CODE_OPENLOAD "P-Code fuer die Art OPENLOAD" VALUE 0x71A1A TKW_VV_VV_UW 100.0 FORMULA_0010 0.0 65535.0 /end CHARACTERISTIC
/begin CHARACTERISTIC K_ED_KSD1.P_CODE_SH_TO_GND "P-Code fuer die Art SH_TO_GND" VALUE 0x71A18 TKW_VV_VV_UW 100.0 FORMULA_0010 0.0 65535.0 /end CHARACTERISTIC
/begin CHARACTERISTIC K_ED_KSD1.P_CODE_SH_TO_UB "P-Code fuer die Art SH_TO_UB" VALUE 0x71A16 TKW_VV_VV_UW 100.0 FORMULA_0010 0.0 65535.0 /end CHARACTERISTIC
/begin CHARACTERISTIC K_ED_KSD1.P_CODE_UNPLAUSIBEL "P-Code fuer die Art UNPLAUSIBEL" VALUE 0x71A1C TKW_VV_VV_UW 100.0 FORMULA_0010 0.0 65535.0 /end CHARACTERISTIC
/begin CHARACTERISTIC K_ED_KSD2.DEC_NACH_EINTRAG "Filterverringerung nach Fehlerspeichereintrag" VALUE 0x71A3D TKW_VV_VV_UB 100.0 FORMULA_0003 0.0 255.0 /end CHARACTERISTIC
/begin CHARACTERISTIC K_ED_KSD2.DEC_VOR_EINTRAG "Filterverringerung vorm Fehlerspeichereintrag" VALUE 0x71A3B TKW_VV_VV_UB 100.0 FORMULA_0003 0.0 255.0 /end CHARACTERISTIC
/begin CHARACTERISTIC K_ED_KSD2.FEHLERSCHWELLE "Filterschwelle fuer Fehlereintrag" VALUE 0x71A38 TKW_VV_VV_UB 100.0 FORMULA_0003 0.0 255.0 /end CHARACTERISTIC
/begin CHARACTERISTIC K_ED_KSD2.INC_NACH_EINTRAG "Filtererhoehung nach Fehlerspeichereintrag" VALUE 0x71A3C TKW_VV_VV_UB 100.0 FORMULA_0003 0.0 255.0 /end CHARACTERISTIC
/begin CHARACTERISTIC K_ED_KSD2.INC_VOR_EINTRAG "Filtererhoehung vorm Fehlerspeichereintrag" VALUE 0x71A3A TKW_VV_VV_UB 100.0 FORMULA_0003 0.0 255.0 /end CHARACTERISTIC
/begin CHARACTERISTIC K_ED_KSD2.KLASSENINDEX "Auswahl der Fehlerklasse" VALUE 0x71A3E TKW_VV_VV_UB 100.0 FORMULA_0003 0.0 8.0 /end CHARACTERISTIC
/begin CHARACTERISTIC K_ED_KSD2.OK_SCHWELLE "Filterschwelle fuer Fehleraustrag" VALUE 0x71A39 TKW_VV_VV_UB 100.0 FORMULA_0003 0.0 255.0 /end CHARACTERISTIC
/begin CHARACTERISTIC K_ED_KSD2.P_CODE_OPENLOAD "P-Code fuer die Art OPENLOAD" VALUE 0x71A34 TKW_VV_VV_UW 100.0 FORMULA_0010 0.0 65535.0 /end CHARACTERISTIC
/begin CHARACTERISTIC K_ED_KSD2.P_CODE_SH_TO_GND "P-Code fuer die Art SH_TO_GND" VALUE 0x71A32 TKW_VV_VV_UW 100.0 FORMULA_0010 0.0 65535.0 /end CHARACTERISTIC
/begin CHARACTERISTIC K_ED_KSD2.P_CODE_SH_TO_UB "P-Code fuer die Art SH_TO_UB" VALUE 0x71A30 TKW_VV_VV_UW 100.0 FORMULA_0010 0.0 65535.0 /end CHARACTERISTIC
/begin CHARACTERISTIC K_ED_KSD2.P_CODE_UNPLAUSIBEL "P-Code fuer die Art UNPLAUSIBEL" VALUE 0x71A36 TKW_VV_VV_UW 100.0 FORMULA_0010 0.0 65535.0 /end CHARACTERISTIC
/begin CHARACTERISTIC K_ED_KW.DEC_NACH_EINTRAG "Filterverringerung nach Fehlerspeichereintrag" VALUE 0x71869 TKW_VV_VV_UB 100.0 FORMULA_0003 0.0 255.0 /end CHARACTERISTIC
/begin CHARACTERISTIC K_ED_KW.DEC_VOR_EINTRAG "Filterverringerung vorm Fehlerspeichereintrag" VALUE 0x71867 TKW_VV_VV_UB 100.0 FORMULA_0003 0.0 255.0 /end CHARACTERISTIC
/begin CHARACTERISTIC K_ED_KW.FEHLERSCHWELLE "Filterschwelle fuer Fehlereintrag" VALUE 0x71864 TKW_VV_VV_UB 100.0 FORMULA_0003 0.0 255.0 /end CHARACTERISTIC
/begin CHARACTERISTIC K_ED_KW.INC_NACH_EINTRAG "Filtererhoehung nach Fehlerspeichereintrag" VALUE 0x71868 TKW_VV_VV_UB 100.0 FORMULA_0003 0.0 255.0 /end CHARACTERISTIC
/begin CHARACTERISTIC K_ED_KW.INC_VOR_EINTRAG "Filtererhoehung vorm Fehlerspeichereintrag" VALUE 0x71866 TKW_VV_VV_UB 100.0 FORMULA_0003 0.0 255.0 /end CHARACTERISTIC
/begin CHARACTERISTIC K_ED_KW.KLASSENINDEX "Auswahl der Fehlerklasse" VALUE 0x7186A TKW_VV_VV_UB 100.0 FORMULA_0003 0.0 8.0 /end CHARACTERISTIC
/begin CHARACTERISTIC K_ED_KW.OK_SCHWELLE "Filterschwelle fuer Fehleraustrag" VALUE 0x71865 TKW_VV_VV_UB 100.0 FORMULA_0003 0.0 255.0 /end CHARACTERISTIC
/begin CHARACTERISTIC K_ED_KW.P_CODE_OPENLOAD "P-Code fuer die Art OPENLOAD" VALUE 0x71860 TKW_VV_VV_UW 100.0 FORMULA_0010 0.0 65535.0 /end CHARACTERISTIC
/begin CHARACTERISTIC K_ED_KW.P_CODE_SH_TO_GND "P-Code fuer die Art SH_TO_GND" VALUE 0x7185E TKW_VV_VV_UW 100.0 FORMULA_0010 0.0 65535.0 /end CHARACTERISTIC
/begin CHARACTERISTIC K_ED_KW.P_CODE_SH_TO_UB "P-Code fuer die Art SH_TO_UB" VALUE 0x7185C TKW_VV_VV_UW 100.0 FORMULA_0010 0.0 65535.0 /end CHARACTERISTIC
/begin CHARACTERISTIC K_ED_KW.P_CODE_UNPLAUSIBEL "P-Code fuer die Art UNPLAUSIBEL" VALUE 0x71862 TKW_VV_VV_UW 100.0 FORMULA_0010 0.0 65535.0 /end CHARACTERISTIC
/begin CHARACTERISTIC K_ED_LA1_ADAPT.DEC_NACH_EINTRAG "Filterverringerung nach Fehlerspeichereintrag" VALUE 0x71883 TKW_VV_VV_UB 100.0 FORMULA_0003 0.0 255.0 /end CHARACTERISTIC
/begin CHARACTERISTIC K_ED_LA1_ADAPT.DEC_VOR_EINTRAG "Filterverringerung vorm Fehlerspeichereintrag" VALUE 0x71881 TKW_VV_VV_UB 100.0 FORMULA_0003 0.0 255.0 /end CHARACTERISTIC
/begin CHARACTERISTIC K_ED_LA1_ADAPT.FEHLERSCHWELLE "Filterschwelle fuer Fehlereintrag" VALUE 0x7187E TKW_VV_VV_UB 100.0 FORMULA_0003 0.0 255.0 /end CHARACTERISTIC
/begin CHARACTERISTIC K_ED_LA1_ADAPT.INC_NACH_EINTRAG "Filtererhoehung nach Fehlerspeichereintrag" VALUE 0x71882 TKW_VV_VV_UB 100.0 FORMULA_0003 0.0 255.0 /end CHARACTERISTIC
/begin CHARACTERISTIC K_ED_LA1_ADAPT.INC_VOR_EINTRAG "Filtererhoehung vorm Fehlerspeichereintrag" VALUE 0x71880 TKW_VV_VV_UB 100.0 FORMULA_0003 0.0 255.0 /end CHARACTERISTIC
/begin CHARACTERISTIC K_ED_LA1_ADAPT.KLASSENINDEX "Auswahl der Fehlerklasse" VALUE 0x71884 TKW_VV_VV_UB 100.0 FORMULA_0003 0.0 8.0 /end CHARACTERISTIC
/begin CHARACTERISTIC K_ED_LA1_ADAPT.OK_SCHWELLE "Filterschwelle fuer Fehleraustrag" VALUE 0x7187F TKW_VV_VV_UB 100.0 FORMULA_0003 0.0 255.0 /end CHARACTERISTIC
/begin CHARACTERISTIC K_ED_LA1_ADAPT.P_CODE_OPENLOAD "P-Code fuer die Art OPENLOAD" VALUE 0x7187A TKW_VV_VV_UW 100.0 FORMULA_0010 0.0 65535.0 /end CHARACTERISTIC
/begin CHARACTERISTIC K_ED_LA1_ADAPT.P_CODE_SH_TO_GND "P-Code fuer die Art SH_TO_GND" VALUE 0x71878 TKW_VV_VV_UW 100.0 FORMULA_0010 0.0 65535.0 /end CHARACTERISTIC
/begin CHARACTERISTIC K_ED_LA1_ADAPT.P_CODE_SH_TO_UB "P-Code fuer die Art SH_TO_UB" VALUE 0x71876 TKW_VV_VV_UW 100.0 FORMULA_0010 0.0 65535.0 /end CHARACTERISTIC
/begin CHARACTERISTIC K_ED_LA1_ADAPT.P_CODE_UNPLAUSIBEL "P-Code fuer die Art UNPLAUSIBEL" VALUE 0x7187C TKW_VV_VV_UW 100.0 FORMULA_0010 0.0 65535.0 /end CHARACTERISTIC
/begin CHARACTERISTIC K_ED_LA1_TRIM_AD.DEC_NACH_EINTRAG "Filterverringerung nach Fehlerspeichereintrag" VALUE 0x71B5B TKW_VV_VV_UB 100.0 FORMULA_0003 0.0 255.0 /end CHARACTERISTIC
/begin CHARACTERISTIC K_ED_LA1_TRIM_AD.DEC_VOR_EINTRAG "Filterverringerung vorm Fehlerspeichereintrag" VALUE 0x71B59 TKW_VV_VV_UB 100.0 FORMULA_0003 0.0 255.0 /end CHARACTERISTIC
/begin CHARACTERISTIC K_ED_LA1_TRIM_AD.FEHLERSCHWELLE "Filterschwelle fuer Fehlereintrag" VALUE 0x71B56 TKW_VV_VV_UB 100.0 FORMULA_0003 0.0 255.0 /end CHARACTERISTIC
/begin CHARACTERISTIC K_ED_LA1_TRIM_AD.INC_NACH_EINTRAG "Filtererhoehung nach Fehlerspeichereintrag" VALUE 0x71B5A TKW_VV_VV_UB 100.0 FORMULA_0003 0.0 255.0 /end CHARACTERISTIC
/begin CHARACTERISTIC K_ED_LA1_TRIM_AD.INC_VOR_EINTRAG "Filtererhoehung vorm Fehlerspeichereintrag" VALUE 0x71B58 TKW_VV_VV_UB 100.0 FORMULA_0003 0.0 255.0 /end CHARACTERISTIC
/begin CHARACTERISTIC K_ED_LA1_TRIM_AD.KLASSENINDEX "Auswahl der Fehlerklasse" VALUE 0x71B5C TKW_VV_VV_UB 100.0 FORMULA_0003 0.0 8.0 /end CHARACTERISTIC
/begin CHARACTERISTIC K_ED_LA1_TRIM_AD.OK_SCHWELLE "Filterschwelle fuer Fehleraustrag" VALUE 0x71B57 TKW_VV_VV_UB 100.0 FORMULA_0003 0.0 255.0 /end CHARACTERISTIC
/begin CHARACTERISTIC K_ED_LA1_TRIM_AD.P_CODE_OPENLOAD "P-Code fuer die Art OPENLOAD" VALUE 0x71B52 TKW_VV_VV_UW 100.0 FORMULA_0010 0.0 65535.0 /end CHARACTERISTIC
/begin CHARACTERISTIC K_ED_LA1_TRIM_AD.P_CODE_SH_TO_GND "P-Code fuer die Art SH_TO_GND" VALUE 0x71B50 TKW_VV_VV_UW 100.0 FORMULA_0010 0.0 65535.0 /end CHARACTERISTIC
/begin CHARACTERISTIC K_ED_LA1_TRIM_AD.P_CODE_SH_TO_UB "P-Code fuer die Art SH_TO_UB" VALUE 0x71B4E TKW_VV_VV_UW 100.0 FORMULA_0010 0.0 65535.0 /end CHARACTERISTIC
/begin CHARACTERISTIC K_ED_LA1_TRIM_AD.P_CODE_UNPLAUSIBEL "P-Code fuer die Art UNPLAUSIBEL" VALUE 0x71B54 TKW_VV_VV_UW 100.0 FORMULA_0010 0.0 65535.0 /end CHARACTERISTIC
/begin CHARACTERISTIC K_ED_LA2_ADAPT.DEC_NACH_EINTRAG "Filterverringerung nach Fehlerspeichereintrag" VALUE 0x7189D TKW_VV_VV_UB 100.0 FORMULA_0003 0.0 255.0 /end CHARACTERISTIC
/begin CHARACTERISTIC K_ED_LA2_ADAPT.DEC_VOR_EINTRAG "Filterverringerung vorm Fehlerspeichereintrag" VALUE 0x7189B TKW_VV_VV_UB 100.0 FORMULA_0003 0.0 255.0 /end CHARACTERISTIC
/begin CHARACTERISTIC K_ED_LA2_ADAPT.FEHLERSCHWELLE "Filterschwelle fuer Fehlereintrag" VALUE 0x71898 TKW_VV_VV_UB 100.0 FORMULA_0003 0.0 255.0 /end CHARACTERISTIC
/begin CHARACTERISTIC K_ED_LA2_ADAPT.INC_NACH_EINTRAG "Filtererhoehung nach Fehlerspeichereintrag" VALUE 0x7189C TKW_VV_VV_UB 100.0 FORMULA_0003 0.0 255.0 /end CHARACTERISTIC
/begin CHARACTERISTIC K_ED_LA2_ADAPT.INC_VOR_EINTRAG "Filtererhoehung vorm Fehlerspeichereintrag" VALUE 0x7189A TKW_VV_VV_UB 100.0 FORMULA_0003 0.0 255.0 /end CHARACTERISTIC
/begin CHARACTERISTIC K_ED_LA2_ADAPT.KLASSENINDEX "Auswahl der Fehlerklasse" VALUE 0x7189E TKW_VV_VV_UB 100.0 FORMULA_0003 0.0 8.0 /end CHARACTERISTIC
/begin CHARACTERISTIC K_ED_LA2_ADAPT.OK_SCHWELLE "Filterschwelle fuer Fehleraustrag" VALUE 0x71899 TKW_VV_VV_UB 100.0 FORMULA_0003 0.0 255.0 /end CHARACTERISTIC
/begin CHARACTERISTIC K_ED_LA2_ADAPT.P_CODE_OPENLOAD "P-Code fuer die Art OPENLOAD" VALUE 0x71894 TKW_VV_VV_UW 100.0 FORMULA_0010 0.0 65535.0 /end CHARACTERISTIC
/begin CHARACTERISTIC K_ED_LA2_ADAPT.P_CODE_SH_TO_GND "P-Code fuer die Art SH_TO_GND" VALUE 0x71892 TKW_VV_VV_UW 100.0 FORMULA_0010 0.0 65535.0 /end CHARACTERISTIC
/begin CHARACTERISTIC K_ED_LA2_ADAPT.P_CODE_SH_TO_UB "P-Code fuer die Art SH_TO_UB" VALUE 0x71890 TKW_VV_VV_UW 100.0 FORMULA_0010 0.0 65535.0 /end CHARACTERISTIC
/begin CHARACTERISTIC K_ED_LA2_ADAPT.P_CODE_UNPLAUSIBEL "P-Code fuer die Art UNPLAUSIBEL" VALUE 0x71896 TKW_VV_VV_UW 100.0 FORMULA_0010 0.0 65535.0 /end CHARACTERISTIC
/begin CHARACTERISTIC K_ED_LA2_TRIM_AD.DEC_NACH_EINTRAG "Filterverringerung nach Fehlerspeichereintrag" VALUE 0x71B75 TKW_VV_VV_UB 100.0 FORMULA_0003 0.0 255.0 /end CHARACTERISTIC
/begin CHARACTERISTIC K_ED_LA2_TRIM_AD.DEC_VOR_EINTRAG "Filterverringerung vorm Fehlerspeichereintrag" VALUE 0x71B73 TKW_VV_VV_UB 100.0 FORMULA_0003 0.0 255.0 /end CHARACTERISTIC
/begin CHARACTERISTIC K_ED_LA2_TRIM_AD.FEHLERSCHWELLE "Filterschwelle fuer Fehlereintrag" VALUE 0x71B70 TKW_VV_VV_UB 100.0 FORMULA_0003 0.0 255.0 /end CHARACTERISTIC
/begin CHARACTERISTIC K_ED_LA2_TRIM_AD.INC_NACH_EINTRAG "Filtererhoehung nach Fehlerspeichereintrag" VALUE 0x71B74 TKW_VV_VV_UB 100.0 FORMULA_0003 0.0 255.0 /end CHARACTERISTIC
/begin CHARACTERISTIC K_ED_LA2_TRIM_AD.INC_VOR_EINTRAG "Filtererhoehung vorm Fehlerspeichereintrag" VALUE 0x71B72 TKW_VV_VV_UB 100.0 FORMULA_0003 0.0 255.0 /end CHARACTERISTIC
/begin CHARACTERISTIC K_ED_LA2_TRIM_AD.KLASSENINDEX "Auswahl der Fehlerklasse" VALUE 0x71B76 TKW_VV_VV_UB 100.0 FORMULA_0003 0.0 8.0 /end CHARACTERISTIC
/begin CHARACTERISTIC K_ED_LA2_TRIM_AD.OK_SCHWELLE "Filterschwelle fuer Fehleraustrag" VALUE 0x71B71 TKW_VV_VV_UB 100.0 FORMULA_0003 0.0 255.0 /end CHARACTERISTIC
/begin CHARACTERISTIC K_ED_LA2_TRIM_AD.P_CODE_OPENLOAD "P-Code fuer die Art OPENLOAD" VALUE 0x71B6C TKW_VV_VV_UW 100.0 FORMULA_0010 0.0 65535.0 /end CHARACTERISTIC
/begin CHARACTERISTIC K_ED_LA2_TRIM_AD.P_CODE_SH_TO_GND "P-Code fuer die Art SH_TO_GND" VALUE 0x71B6A TKW_VV_VV_UW 100.0 FORMULA_0010 0.0 65535.0 /end CHARACTERISTIC
/begin CHARACTERISTIC K_ED_LA2_TRIM_AD.P_CODE_SH_TO_UB "P-Code fuer die Art SH_TO_UB" VALUE 0x71B68 TKW_VV_VV_UW 100.0 FORMULA_0010 0.0 65535.0 /end CHARACTERISTIC
/begin CHARACTERISTIC K_ED_LA2_TRIM_AD.P_CODE_UNPLAUSIBEL "P-Code fuer die Art UNPLAUSIBEL" VALUE 0x71B6E TKW_VV_VV_UW 100.0 FORMULA_0010 0.0 65535.0 /end CHARACTERISTIC
/begin CHARACTERISTIC K_ED_LAM1_REG.DEC_NACH_EINTRAG "Filterverringerung nach Fehlerspeichereintrag" VALUE 0x710B1 TKW_VV_VV_UB 100.0 FORMULA_0003 0.0 255.0 /end CHARACTERISTIC
/begin CHARACTERISTIC K_ED_LAM1_REG.DEC_VOR_EINTRAG "Filterverringerung vorm Fehlerspeichereintrag" VALUE 0x710AF TKW_VV_VV_UB 100.0 FORMULA_0003 0.0 255.0 /end CHARACTERISTIC
/begin CHARACTERISTIC K_ED_LAM1_REG.FEHLERSCHWELLE "Filterschwelle fuer Fehlereintrag" VALUE 0x710AC TKW_VV_VV_UB 100.0 FORMULA_0003 0.0 255.0 /end CHARACTERISTIC
/begin CHARACTERISTIC K_ED_LAM1_REG.INC_NACH_EINTRAG "Filtererhoehung nach Fehlerspeichereintrag" VALUE 0x710B0 TKW_VV_VV_UB 100.0 FORMULA_0003 0.0 255.0 /end CHARACTERISTIC
/begin CHARACTERISTIC K_ED_LAM1_REG.INC_VOR_EINTRAG "Filtererhoehung vorm Fehlerspeichereintrag" VALUE 0x710AE TKW_VV_VV_UB 100.0 FORMULA_0003 0.0 255.0 /end CHARACTERISTIC
/begin CHARACTERISTIC K_ED_LAM1_REG.KLASSENINDEX "Auswahl der Fehlerklasse" VALUE 0x710B2 TKW_VV_VV_UB 100.0 FORMULA_0003 0.0 8.0 /end CHARACTERISTIC
/begin CHARACTERISTIC K_ED_LAM1_REG.OK_SCHWELLE "Filterschwelle fuer Fehleraustrag" VALUE 0x710AD TKW_VV_VV_UB 100.0 FORMULA_0003 0.0 255.0 /end CHARACTERISTIC
/begin CHARACTERISTIC K_ED_LAM1_REG.P_CODE_OPENLOAD "P-Code fuer die Art OPENLOAD" VALUE 0x710A8 TKW_VV_VV_UW 100.0 FORMULA_0010 0.0 65535.0 /end CHARACTERISTIC
/begin CHARACTERISTIC K_ED_LAM1_REG.P_CODE_SH_TO_GND "P-Code fuer die Art SH_TO_GND" VALUE 0x710A6 TKW_VV_VV_UW 100.0 FORMULA_0010 0.0 65535.0 /end CHARACTERISTIC
/begin CHARACTERISTIC K_ED_LAM1_REG.P_CODE_SH_TO_UB "P-Code fuer die Art SH_TO_UB" VALUE 0x710A4 TKW_VV_VV_UW 100.0 FORMULA_0010 0.0 65535.0 /end CHARACTERISTIC
/begin CHARACTERISTIC K_ED_LAM1_REG.P_CODE_UNPLAUSIBEL "P-Code fuer die Art UNPLAUSIBEL" VALUE 0x710AA TKW_VV_VV_UW 100.0 FORMULA_0010 0.0 65535.0 /end CHARACTERISTIC
/begin CHARACTERISTIC K_ED_LAM2_REG.DEC_NACH_EINTRAG "Filterverringerung nach Fehlerspeichereintrag" VALUE 0x710CB TKW_VV_VV_UB 100.0 FORMULA_0003 0.0 255.0 /end CHARACTERISTIC
/begin CHARACTERISTIC K_ED_LAM2_REG.DEC_VOR_EINTRAG "Filterverringerung vorm Fehlerspeichereintrag" VALUE 0x710C9 TKW_VV_VV_UB 100.0 FORMULA_0003 0.0 255.0 /end CHARACTERISTIC
/begin CHARACTERISTIC K_ED_LAM2_REG.FEHLERSCHWELLE "Filterschwelle fuer Fehlereintrag" VALUE 0x710C6 TKW_VV_VV_UB 100.0 FORMULA_0003 0.0 255.0 /end CHARACTERISTIC
/begin CHARACTERISTIC K_ED_LAM2_REG.INC_NACH_EINTRAG "Filtererhoehung nach Fehlerspeichereintrag" VALUE 0x710CA TKW_VV_VV_UB 100.0 FORMULA_0003 0.0 255.0 /end CHARACTERISTIC
/begin CHARACTERISTIC K_ED_LAM2_REG.INC_VOR_EINTRAG "Filtererhoehung vorm Fehlerspeichereintrag" VALUE 0x710C8 TKW_VV_VV_UB 100.0 FORMULA_0003 0.0 255.0 /end CHARACTERISTIC
/begin CHARACTERISTIC K_ED_LAM2_REG.KLASSENINDEX "Auswahl der Fehlerklasse" VALUE 0x710CC TKW_VV_VV_UB 100.0 FORMULA_0003 0.0 8.0 /end CHARACTERISTIC
/begin CHARACTERISTIC K_ED_LAM2_REG.OK_SCHWELLE "Filterschwelle fuer Fehleraustrag" VALUE 0x710C7 TKW_VV_VV_UB 100.0 FORMULA_0003 0.0 255.0 /end CHARACTERISTIC
/begin CHARACTERISTIC K_ED_LAM2_REG.P_CODE_OPENLOAD "P-Code fuer die Art OPENLOAD" VALUE 0x710C2 TKW_VV_VV_UW 100.0 FORMULA_0010 0.0 65535.0 /end CHARACTERISTIC
/begin CHARACTERISTIC K_ED_LAM2_REG.P_CODE_SH_TO_GND "P-Code fuer die Art SH_TO_GND" VALUE 0x710C0 TKW_VV_VV_UW 100.0 FORMULA_0010 0.0 65535.0 /end CHARACTERISTIC
/begin CHARACTERISTIC K_ED_LAM2_REG.P_CODE_SH_TO_UB "P-Code fuer die Art SH_TO_UB" VALUE 0x710BE TKW_VV_VV_UW 100.0 FORMULA_0010 0.0 65535.0 /end CHARACTERISTIC
/begin CHARACTERISTIC K_ED_LAM2_REG.P_CODE_UNPLAUSIBEL "P-Code fuer die Art UNPLAUSIBEL" VALUE 0x710C4 TKW_VV_VV_UW 100.0 FORMULA_0010 0.0 65535.0 /end CHARACTERISTIC
/begin CHARACTERISTIC K_ED_LANK1.DEC_NACH_EINTRAG "Filterverringerung nach Fehlerspeichereintrag" VALUE 0x70B83 TKW_VV_VV_UB 100.0 FORMULA_0003 0.0 255.0 /end CHARACTERISTIC
/begin CHARACTERISTIC K_ED_LANK1.DEC_VOR_EINTRAG "Filterverringerung vorm Fehlerspeichereintrag" VALUE 0x70B81 TKW_VV_VV_UB 100.0 FORMULA_0003 0.0 255.0 /end CHARACTERISTIC
/begin CHARACTERISTIC K_ED_LANK1.FEHLERSCHWELLE "Filterschwelle fuer Fehlereintrag" VALUE 0x70B7E TKW_VV_VV_UB 100.0 FORMULA_0003 0.0 255.0 /end CHARACTERISTIC
/begin CHARACTERISTIC K_ED_LANK1.INC_NACH_EINTRAG "Filtererhoehung nach Fehlerspeichereintrag" VALUE 0x70B82 TKW_VV_VV_UB 100.0 FORMULA_0003 0.0 255.0 /end CHARACTERISTIC
/begin CHARACTERISTIC K_ED_LANK1.INC_VOR_EINTRAG "Filtererhoehung vorm Fehlerspeichereintrag" VALUE 0x70B80 TKW_VV_VV_UB 100.0 FORMULA_0003 0.0 255.0 /end CHARACTERISTIC
/begin CHARACTERISTIC K_ED_LANK1.KLASSENINDEX "Auswahl der Fehlerklasse" VALUE 0x70B84 TKW_VV_VV_UB 100.0 FORMULA_0003 0.0 8.0 /end CHARACTERISTIC
/begin CHARACTERISTIC K_ED_LANK1.OK_SCHWELLE "Filterschwelle fuer Fehleraustrag" VALUE 0x70B7F TKW_VV_VV_UB 100.0 FORMULA_0003 0.0 255.0 /end CHARACTERISTIC
/begin CHARACTERISTIC K_ED_LANK1.P_CODE_OPENLOAD "P-Code fuer die Art OPENLOAD" VALUE 0x70B7A TKW_VV_VV_UW 100.0 FORMULA_0010 0.0 65535.0 /end CHARACTERISTIC
/begin CHARACTERISTIC K_ED_LANK1.P_CODE_SH_TO_GND "P-Code fuer die Art SH_TO_GND" VALUE 0x70B78 TKW_VV_VV_UW 100.0 FORMULA_0010 0.0 65535.0 /end CHARACTERISTIC
/begin CHARACTERISTIC K_ED_LANK1.P_CODE_SH_TO_UB "P-Code fuer die Art SH_TO_UB" VALUE 0x70B76 TKW_VV_VV_UW 100.0 FORMULA_0010 0.0 65535.0 /end CHARACTERISTIC
/begin CHARACTERISTIC K_ED_LANK1.P_CODE_UNPLAUSIBEL "P-Code fuer die Art UNPLAUSIBEL" VALUE 0x70B7C TKW_VV_VV_UW 100.0 FORMULA_0010 0.0 65535.0 /end CHARACTERISTIC
/begin CHARACTERISTIC K_ED_LANK1_OBD_S.DEC_NACH_EINTRAG "Filterverringerung nach Fehlerspeichereintrag" VALUE 0x70D23 TKW_VV_VV_UB 100.0 FORMULA_0003 0.0 255.0 /end CHARACTERISTIC
/begin CHARACTERISTIC K_ED_LANK1_OBD_S.DEC_VOR_EINTRAG "Filterverringerung vorm Fehlerspeichereintrag" VALUE 0x70D21 TKW_VV_VV_UB 100.0 FORMULA_0003 0.0 255.0 /end CHARACTERISTIC
/begin CHARACTERISTIC K_ED_LANK1_OBD_S.FEHLERSCHWELLE "Filterschwelle fuer Fehlereintrag" VALUE 0x70D1E TKW_VV_VV_UB 100.0 FORMULA_0003 0.0 255.0 /end CHARACTERISTIC
/begin CHARACTERISTIC K_ED_LANK1_OBD_S.INC_NACH_EINTRAG "Filtererhoehung nach Fehlerspeichereintrag" VALUE 0x70D22 TKW_VV_VV_UB 100.0 FORMULA_0003 0.0 255.0 /end CHARACTERISTIC
/begin CHARACTERISTIC K_ED_LANK1_OBD_S.INC_VOR_EINTRAG "Filtererhoehung vorm Fehlerspeichereintrag" VALUE 0x70D20 TKW_VV_VV_UB 100.0 FORMULA_0003 0.0 255.0 /end CHARACTERISTIC
/begin CHARACTERISTIC K_ED_LANK1_OBD_S.KLASSENINDEX "Auswahl der Fehlerklasse" VALUE 0x70D24 TKW_VV_VV_UB 100.0 FORMULA_0003 0.0 8.0 /end CHARACTERISTIC
/begin CHARACTERISTIC K_ED_LANK1_OBD_S.OK_SCHWELLE "Filterschwelle fuer Fehleraustrag" VALUE 0x70D1F TKW_VV_VV_UB 100.0 FORMULA_0003 0.0 255.0 /end CHARACTERISTIC
/begin CHARACTERISTIC K_ED_LANK1_OBD_S.P_CODE_OPENLOAD "P-Code fuer die Art OPENLOAD" VALUE 0x70D1A TKW_VV_VV_UW 100.0 FORMULA_0010 0.0 65535.0 /end CHARACTERISTIC
/begin CHARACTERISTIC K_ED_LANK1_OBD_S.P_CODE_SH_TO_GND "P-Code fuer die Art SH_TO_GND" VALUE 0x70D18 TKW_VV_VV_UW 100.0 FORMULA_0010 0.0 65535.0 /end CHARACTERISTIC
/begin CHARACTERISTIC K_ED_LANK1_OBD_S.P_CODE_SH_TO_UB "P-Code fuer die Art SH_TO_UB" VALUE 0x70D16 TKW_VV_VV_UW 100.0 FORMULA_0010 0.0 65535.0 /end CHARACTERISTIC
/begin CHARACTERISTIC K_ED_LANK1_OBD_S.P_CODE_UNPLAUSIBEL "P-Code fuer die Art UNPLAUSIBEL" VALUE 0x70D1C TKW_VV_VV_UW 100.0 FORMULA_0010 0.0 65535.0 /end CHARACTERISTIC
/begin CHARACTERISTIC K_ED_LANK1_OBD_WE.DEC_NACH_EINTRAG "Filterverringerung nach Fehlerspeichereintrag" VALUE 0x71BC3 TKW_VV_VV_UB 100.0 FORMULA_0003 0.0 255.0 /end CHARACTERISTIC
/begin CHARACTERISTIC K_ED_LANK1_OBD_WE.DEC_VOR_EINTRAG "Filterverringerung vorm Fehlerspeichereintrag" VALUE 0x71BC1 TKW_VV_VV_UB 100.0 FORMULA_0003 0.0 255.0 /end CHARACTERISTIC
/begin CHARACTERISTIC K_ED_LANK1_OBD_WE.FEHLERSCHWELLE "Filterschwelle fuer Fehlereintrag" VALUE 0x71BBE TKW_VV_VV_UB 100.0 FORMULA_0003 0.0 255.0 /end CHARACTERISTIC
/begin CHARACTERISTIC K_ED_LANK1_OBD_WE.INC_NACH_EINTRAG "Filtererhoehung nach Fehlerspeichereintrag" VALUE 0x71BC2 TKW_VV_VV_UB 100.0 FORMULA_0003 0.0 255.0 /end CHARACTERISTIC
/begin CHARACTERISTIC K_ED_LANK1_OBD_WE.INC_VOR_EINTRAG "Filtererhoehung vorm Fehlerspeichereintrag" VALUE 0x71BC0 TKW_VV_VV_UB 100.0 FORMULA_0003 0.0 255.0 /end CHARACTERISTIC
/begin CHARACTERISTIC K_ED_LANK1_OBD_WE.KLASSENINDEX "Auswahl der Fehlerklasse" VALUE 0x71BC4 TKW_VV_VV_UB 100.0 FORMULA_0003 0.0 8.0 /end CHARACTERISTIC
/begin CHARACTERISTIC K_ED_LANK1_OBD_WE.OK_SCHWELLE "Filterschwelle fuer Fehleraustrag" VALUE 0x71BBF TKW_VV_VV_UB 100.0 FORMULA_0003 0.0 255.0 /end CHARACTERISTIC
/begin CHARACTERISTIC K_ED_LANK1_OBD_WE.P_CODE_OPENLOAD "P-Code fuer die Art OPENLOAD" VALUE 0x71BBA TKW_VV_VV_UW 100.0 FORMULA_0010 0.0 65535.0 /end CHARACTERISTIC
/begin CHARACTERISTIC K_ED_LANK1_OBD_WE.P_CODE_SH_TO_GND "P-Code fuer die Art SH_TO_GND" VALUE 0x71BB8 TKW_VV_VV_UW 100.0 FORMULA_0010 0.0 65535.0 /end CHARACTERISTIC
/begin CHARACTERISTIC K_ED_LANK1_OBD_WE.P_CODE_SH_TO_UB "P-Code fuer die Art SH_TO_UB" VALUE 0x71BB6 TKW_VV_VV_UW 100.0 FORMULA_0010 0.0 65535.0 /end CHARACTERISTIC
/begin CHARACTERISTIC K_ED_LANK1_OBD_WE.P_CODE_UNPLAUSIBEL "P-Code fuer die Art UNPLAUSIBEL" VALUE 0x71BBC TKW_VV_VV_UW 100.0 FORMULA_0010 0.0 65535.0 /end CHARACTERISTIC
/begin CHARACTERISTIC K_ED_LANK1_OPENLOAD.DEC_NACH_EINTRAG "Filterverringerung nach Fehlerspeichereintrag" VALUE 0x71B8F TKW_VV_VV_UB 100.0 FORMULA_0003 0.0 255.0 /end CHARACTERISTIC
/begin CHARACTERISTIC K_ED_LANK1_OPENLOAD.DEC_VOR_EINTRAG "Filterverringerung vorm Fehlerspeichereintrag" VALUE 0x71B8D TKW_VV_VV_UB 100.0 FORMULA_0003 0.0 255.0 /end CHARACTERISTIC
/begin CHARACTERISTIC K_ED_LANK1_OPENLOAD.FEHLERSCHWELLE "Filterschwelle fuer Fehlereintrag" VALUE 0x71B8A TKW_VV_VV_UB 100.0 FORMULA_0003 0.0 255.0 /end CHARACTERISTIC
/begin CHARACTERISTIC K_ED_LANK1_OPENLOAD.INC_NACH_EINTRAG "Filtererhoehung nach Fehlerspeichereintrag" VALUE 0x71B8E TKW_VV_VV_UB 100.0 FORMULA_0003 0.0 255.0 /end CHARACTERISTIC
/begin CHARACTERISTIC K_ED_LANK1_OPENLOAD.INC_VOR_EINTRAG "Filtererhoehung vorm Fehlerspeichereintrag" VALUE 0x71B8C TKW_VV_VV_UB 100.0 FORMULA_0003 0.0 255.0 /end CHARACTERISTIC
/begin CHARACTERISTIC K_ED_LANK1_OPENLOAD.KLASSENINDEX "Auswahl der Fehlerklasse" VALUE 0x71B90 TKW_VV_VV_UB 100.0 FORMULA_0003 0.0 8.0 /end CHARACTERISTIC
/begin CHARACTERISTIC K_ED_LANK1_OPENLOAD.OK_SCHWELLE "Filterschwelle fuer Fehleraustrag" VALUE 0x71B8B TKW_VV_VV_UB 100.0 FORMULA_0003 0.0 255.0 /end CHARACTERISTIC
/begin CHARACTERISTIC K_ED_LANK1_OPENLOAD.P_CODE_OPENLOAD "P-Code fuer die Art OPENLOAD" VALUE 0x71B86 TKW_VV_VV_UW 100.0 FORMULA_0010 0.0 65535.0 /end CHARACTERISTIC
/begin CHARACTERISTIC K_ED_LANK1_OPENLOAD.P_CODE_SH_TO_GND "P-Code fuer die Art SH_TO_GND" VALUE 0x71B84 TKW_VV_VV_UW 100.0 FORMULA_0010 0.0 65535.0 /end CHARACTERISTIC
/begin CHARACTERISTIC K_ED_LANK1_OPENLOAD.P_CODE_SH_TO_UB "P-Code fuer die Art SH_TO_UB" VALUE 0x71B82 TKW_VV_VV_UW 100.0 FORMULA_0010 0.0 65535.0 /end CHARACTERISTIC
/begin COMPU_METHOD FORMULA_0003 "FORMULA_0003" RAT_FUNC "%3.0" "-" COEFFS 0 1 0 0 0 1 /end COMPU_METHOD
/begin COMPU_METHOD FORMULA_0010 "FORMULA_0010" RAT_FUNC "%5.0" "-" COEFFS 0 1 0 0 0 1 /end COMPU_METHOD
/begin FUNCTION Eigendiagnose ""
 /begin DEF_CHARACTERISTIC K_ED_DMTL_GROBLECK.INC_NACH_EINTRAG K_ED_DMTL_GROBLECK.INC_VOR_EINTRAG K_ED_DMTL_GROBLECK.KLASSENINDEX K_ED_DMTL_GROBLECK.OK_SCHWELLE K_ED_DMTL_GROBLECK.P_CODE_OPENLOAD K_ED_DMTL_GROBLECK.P_CODE_SH_TO_GND K_ED_DMTL_GROBLECK.P_CODE_SH_TO_UB K_ED_DMTL_GROBLECK.P_CODE_UNPLAUSIBEL K_ED_DMTL_H.DEC_NACH_EINTRAG K_ED_DMTL_H.DEC_VOR_EINTRAG K_ED_DMTL_H.FEHLERSCHWELLE K_ED_DMTL_H.INC_NACH_EINTRAG K_ED_DMTL_H.INC_VOR_EINTRAG K_ED_DMTL_H.KLASSENINDEX K_ED_DMTL_H.OK_SCHWELLE K_ED_DMTL_H.P_CODE_OPENLOAD K_ED_DMTL_H.P_CODE_SH_TO_GND K_ED_DMTL_H.P_CODE_SH_TO_UB K_ED_DMTL_H.P_CODE_UNPLAUSIBEL K_ED_DMTL_P.DEC_NACH_EINTRAG K_ED_DMTL_P.DEC_VOR_EINTRAG K_ED_DMTL_P.FEHLERSCHWELLE K_ED_DMTL_P.INC_NACH_EINTRAG K_ED_DMTL_P.INC_VOR_EINTRAG K_ED_DMTL_P.KLASSENINDEX K_ED_DMTL_P.OK_SCHWELLE K_ED_DMTL_P.P_CODE_OPENLOAD K_ED_DMTL_P.P_CODE_SH_TO_GND K_ED_DMTL_P.P_CODE_SH_TO_UB K_ED_DMTL_P.P_CODE_UNPLAUSIBEL K_ED_DMTL_V.DEC_NACH_EINTRAG K_ED_DMTL_V.DEC_VOR_EINTRAG K_ED_DMTL_V.FEHLERSCHWELLE K_ED_DMTL_V.INC_NACH_EINTRAG K_ED_DMTL_V.INC_VOR_EINTRAG K_ED_DMTL_V.KLASSENINDEX K_ED_DMTL_V.OK_SCHWELLE K_ED_DMTL_V.P_CODE_OPENLOAD K_ED_DMTL_V.P_CODE_SH_TO_GND K_ED_DMTL_V.P_CODE_SH_TO_UB K_ED_DMTL_V.P_CODE_UNPLAUSIBEL K_ED_E2_INJ.DEC_NACH_EINTRAG K_ED_E2_INJ.DEC_VOR_EINTRAG K_ED_E2_INJ.FEHLERSCHWELLE K_ED_E2_INJ.INC_NACH_EINTRAG K_ED_E2_INJ.INC_VOR_EINTRAG K_ED_E2_INJ.KLASSENINDEX K_ED_E2_INJ.OK_SCHWELLE K_ED_E2_INJ.P_CODE_OPENLOAD K_ED_E2_INJ.P_CODE_SH_TO_GND K_ED_E2_INJ.P_CODE_SH_TO_UB K_ED_E2_INJ.P_CODE_UNPLAUSIBEL K_ED_EBOX_ELU.DEC_NACH_EINTRAG K_ED_EBOX_ELU.DEC_VOR_EINTRAG K_ED_EBOX_ELU.FEHLERSCHWELLE K_ED_EBOX_ELU.INC_NACH_EINTRAG K_ED_EBOX_ELU.INC_VOR_EINTRAG K_ED_EBOX_ELU.KLASSENINDEX K_ED_EBOX_ELU.OK_SCHWELLE K_ED_EBOX_ELU.P_CODE_OPENLOAD K_ED_EBOX_ELU.P_CODE_SH_TO_GND K_ED_EBOX_ELU.P_CODE_SH_TO_UB K_ED_EBOX_ELU.P_CODE_UNPLAUSIBEL K_ED_EKP_PWM.DEC_NACH_EINTRAG K_ED_EKP_PWM.DEC_VOR_EINTRAG K_ED_EKP_PWM.FEHLERSCHWELLE K_ED_EKP_PWM.INC_NACH_EINTRAG K_ED_EKP_PWM.INC_VOR_EINTRAG K_ED_EKP_PWM.KLASSENINDEX K_ED_EKP_PWM.OK_SCHWELLE K_ED_EKP_PWM.P_CODE_OPENLOAD K_ED_EKP_PWM.P_CODE_SH_TO_GND K_ED_EKP_PWM.P_CODE_SH_TO_UB K_ED_EKP_PWM.P_CODE_UNPLAUSIBEL K_ED_ELU.DEC_NACH_EINTRAG K_ED_ELU.DEC_VOR_EINTRAG K_ED_ELU.FEHLERSCHWELLE K_ED_ELU.INC_NACH_EINTRAG K_ED_ELU.INC_VOR_EINTRAG K_ED_ELU.KLASSENINDEX K_ED_ELU.OK_SCHWELLE K_ED_ELU.P_CODE_OPENLOAD K_ED_ELU.P_CODE_SH_TO_GND K_ED_ELU.P_CODE_SH_TO_UB K_ED_ELU.P_CODE_UNPLAUSIBEL K_ED_ELUP.DEC_NACH_EINTRAG K_ED_ELUP.DEC_VOR_EINTRAG K_ED_ELUP.FEHLERSCHWELLE K_ED_ELUP.INC_NACH_EINTRAG K_ED_ELUP.INC_VOR_EINTRAG K_ED_ELUP.KLASSENINDEX K_ED_ELUP.OK_SCHWELLE K_ED_ELUP.P_CODE_OPENLOAD K_ED_ELUP.P_CODE_SH_TO_GND K_ED_ELUP.P_CODE_SH_TO_UB K_ED_ELUP.P_CODE_UNPLAUSIBEL K_ED_EV1.DEC_NACH_EINTRAG K_ED_EV1.DEC_VOR_EINTRAG K_ED_EV1.FEHLERSCHWELLE K_ED_EV1.INC_NACH_EINTRAG K_ED_EV1.INC_VOR_EINTRAG K_ED_EV1.KLASSENINDEX K_ED_EV1.OK_SCHWELLE K_ED_EV1.P_CODE_OPENLOAD K_ED_EV1.P_CODE_SH_TO_GND K_ED_EV1.P_CODE_SH_TO_UB K_ED_EV1.P_CODE_UNPLAUSIBEL K_ED_EV10.DEC_NACH_EINTRAG K_ED_EV10.DEC_VOR_EINTRAG K_ED_EV10.FEHLERSCHWELLE K_ED_EV10.INC_NACH_EINTRAG K_ED_EV10.INC_VOR_EINTRAG K_ED_EV10.KLASSENINDEX K_ED_EV10.OK_SCHWELLE K_ED_EV10.P_CODE_OPENLOAD K_ED_EV10.P_CODE_SH_TO_GND K_ED_EV10.P_CODE_SH_TO_UB K_ED_EV10.P_CODE_UNPLAUSIBEL K_ED_EV2.DEC_NACH_EINTRAG K_ED_EV2.DEC_VOR_EINTRAG K_ED_EV2.FEHLERSCHWELLE K_ED_EV2.INC_NACH_EINTRAG K_ED_EV2.INC_VOR_EINTRAG K_ED_EV2.KLASSENINDEX K_ED_EV2.OK_SCHWELLE K_ED_EV2.P_CODE_OPENLOAD K_ED_EV2.P_CODE_SH_TO_GND K_ED_EV2.P_CODE_SH_TO_UB K_ED_EV2.P_CODE_UNPLAUSIBEL K_ED_EV3.DEC_NACH_EINTRAG K_ED_EV3.DEC_VOR_EINTRAG K_ED_EV3.FEHLERSCHWELLE K_ED_EV3.INC_NACH_EINTRAG K_ED_EV3.INC_VOR_EINTRAG K_ED_EV3.KLASSENINDEX K_ED_EV3.OK_SCHWELLE K_ED_EV3.P_CODE_OPENLOAD K_ED_EV3.P_CODE_SH_TO_GND K_ED_EV3.P_CODE_SH_TO_UB K_ED_EV3.P_CODE_UNPLAUSIBEL K_ED_EV4.DEC_NACH_EINTRAG K_ED_EV4.DEC_VOR_EINTRAG K_ED_EV4.FEHLERSCHWELLE K_ED_EV4.INC_NACH_EINTRAG K_ED_EV4.INC_VOR_EINTRAG K_ED_EV4.KLASSENINDEX K_ED_EV4.OK_SCHWELLE K_ED_EV4.P_CODE_OPENLOAD K_ED_EV4.P_CODE_SH_TO_GND K_ED_EV4.P_CODE_SH_TO_UB K_ED_EV4.P_CODE_UNPLAUSIBEL K_ED_EV5.DEC_NACH_EINTRAG K_ED_EV5.DEC_VOR_EINTRAG K_ED_EV5.FEHLERSCHWELLE K_ED_EV5.INC_NACH_EINTRAG K_ED_EV5.INC_VOR_EINTRAG K_ED_EV5.KLASSENINDEX K_ED_EV5.OK_SCHWELLE K_ED_EV5.P_CODE_OPENLOAD K_ED_EV5.P_CODE_SH_TO_GND K_ED_EV5.P_CODE_SH_TO_UB K_ED_EV5.P_CODE_UNPLAUSIBEL K_ED_EV6.DEC_NACH_EINTRAG K_ED_EV6.DEC_VOR_EINTRAG K_ED_EV6.FEHLERSCHWELLE K_ED_EV6.INC_NACH_EINTRAG K_ED_EV6.INC_VOR_EINTRAG K_ED_EV6.KLASSENINDEX K_ED_EV6.OK_SCHWELLE K_ED_EV6.P_CODE_OPENLOAD K_ED_EV6.P_CODE_SH_TO_GND K_ED_EV6.P_CODE_SH_TO_UB K_ED_EV6.P_CODE_UNPLAUSIBEL K_ED_EV7.DEC_NACH_EINTRAG K_ED_EV7.DEC_VOR_EINTRAG K_ED_EV7.FEHLERSCHWELLE K_ED_EV7.INC_NACH_EINTRAG K_ED_EV7.INC_VOR_EINTRAG K_ED_EV7.KLASSENINDEX K_ED_EV7.OK_SCHWELLE K_ED_EV7.P_CODE_OPENLOAD K_ED_EV7.P_CODE_SH_TO_GND K_ED_EV7.P_CODE_SH_TO_UB K_ED_EV7.P_CODE_UNPLAUSIBEL K_ED_EV8.DEC_NACH_EINTRAG K_ED_EV8.DEC_VOR_EINTRAG K_ED_EV8.FEHLERSCHWELLE K_ED_EV8.INC_NACH_EINTRAG K_ED_EV8.INC_VOR_EINTRAG K_ED_EV8.KLASSENINDEX K_ED_EV8.OK_SCHWELLE K_ED_EV8.P_CODE_OPENLOAD K_ED_EV8.P_CODE_SH_TO_GND K_ED_EV8.P_CODE_SH_TO_UB K_ED_EV8.P_CODE_UNPLAUSIBEL K_ED_EV9.DEC_NACH_EINTRAG K_ED_EV9.DEC_VOR_EINTRAG K_ED_EV9.FEHLERSCHWELLE K_ED_EV9.INC_NACH_EINTRAG K_ED_EV9.INC_VOR_EINTRAG K_ED_EV9.KLASSENINDEX K_ED_EV9.OK_SCHWELLE K_ED_EV9.P_CODE_OPENLOAD K_ED_EV9.P_CODE_SH_TO_GND K_ED_EV9.P_CODE_SH_TO_UB K_ED_EV9.P_CODE_UNPLAUSIBEL K_ED_EWS_MAN.DEC_NACH_EINTRAG K_ED_EWS_MAN.DEC_VOR_EINTRAG K_ED_EWS_MAN.FEHLERSCHWELLE K_ED_EWS_MAN.INC_NACH_EINTRAG K_ED_EWS_MAN.INC_VOR_EINTRAG K_ED_EWS_MAN.KLASSENINDEX K_ED_EWS_MAN.OK_SCHWELLE K_ED_EWS_MAN.P_CODE_OPENLOAD K_ED_EWS_MAN.P_CODE_SH_TO_GND K_ED_EWS_MAN.P_CODE_SH_TO_UB K_ED_EWS_MAN.P_CODE_UNPLAUSIBEL K_ED_EWS_SCI.DEC_NACH_EINTRAG K_ED_EWS_SCI.DEC_VOR_EINTRAG K_ED_EWS_SCI.FEHLERSCHWELLE K_ED_EWS_SCI.INC_NACH_EINTRAG K_ED_EWS_SCI.INC_VOR_EINTRAG K_ED_EWS_SCI.KLASSENINDEX K_ED_EWS_SCI.OK_SCHWELLE K_ED_EWS_SCI.P_CODE_OPENLOAD K_ED_EWS_SCI.P_CODE_SH_TO_GND K_ED_EWS_SCI.P_CODE_SH_TO_UB K_ED_EWS_SCI.P_CODE_UNPLAUSIBEL K_ED_FETRAWE.DEC_NACH_EINTRAG K_ED_FETRAWE.DEC_VOR_EINTRAG K_ED_FETRAWE.FEHLERSCHWELLE K_ED_FETRAWE.INC_NACH_EINTRAG K_ED_FETRAWE.INC_VOR_EINTRAG K_ED_FETRAWE.KLASSENINDEX K_ED_FETRAWE.OK_SCHWELLE K_ED_FETRAWE.P_CODE_OPENLOAD K_ED_FETRAWE.P_CODE_SH_TO_GND K_ED_FETRAWE.P_CODE_SH_TO_UB K_ED_FETRAWE.P_CODE_UNPLAUSIBEL K_ED_FI_BSD.DEC_NACH_EINTRAG K_ED_FI_BSD.DEC_VOR_EINTRAG K_ED_FI_BSD.FEHLERSCHWELLE K_ED_FI_BSD.INC_NACH_EINTRAG K_ED_FI_BSD.INC_VOR_EINTRAG K_ED_FI_BSD.KLASSENINDEX K_ED_FI_BSD.OK_SCHWELLE K_ED_FI_BSD.P_CODE_OPENLOAD K_ED_FI_BSD.P_CODE_SH_TO_GND K_ED_FI_BSD.P_CODE_SH_TO_UB K_ED_FI_BSD.P_CODE_UNPLAUSIBEL K_ED_FI_BSD_0.DEC_NACH_EINTRAG K_ED_FI_BSD_0.DEC_VOR_EINTRAG K_ED_FI_BSD_0.FEHLERSCHWELLE K_ED_FI_BSD_0.INC_NACH_EINTRAG K_ED_FI_BSD_0.INC_VOR_EINTRAG K_ED_FI_BSD_0.KLASSENINDEX K_ED_FI_BSD_0.OK_SCHWELLE K_ED_FI_BSD_0.P_CODE_OPENLOAD K_ED_FI_BSD_0.P_CODE_SH_TO_GND K_ED_FI_BSD_0.P_CODE_SH_TO_UB K_ED_FI_BSD_0.P_CODE_UNPLAUSIBEL K_ED_FI_BSD_6.DEC_NACH_EINTRAG K_ED_FI_BSD_6.DEC_VOR_EINTRAG K_ED_FI_BSD_6.FEHLERSCHWELLE K_ED_FI_BSD_6.INC_NACH_EINTRAG K_ED_FI_BSD_6.INC_VOR_EINTRAG K_ED_FI_BSD_6.KLASSENINDEX K_ED_FI_BSD_6.OK_SCHWELLE K_ED_FI_BSD_6.P_CODE_OPENLOAD K_ED_FI_BSD_6.P_CODE_SH_TO_GND K_ED_FI_BSD_6.P_CODE_SH_TO_UB K_ED_FI_BSD_6.P_CODE_UNPLAUSIBEL K_ED_FI_BSDGLOB.DEC_NACH_EINTRAG K_ED_FI_BSDGLOB.DEC_VOR_EINTRAG K_ED_FI_BSDGLOB.FEHLERSCHWELLE K_ED_FI_BSDGLOB.INC_NACH_EINTRAG K_ED_FI_BSDGLOB.INC_VOR_EINTRAG K_ED_FI_BSDGLOB.KLASSENINDEX K_ED_FI_BSDGLOB.OK_SCHWELLE K_ED_FI_BSDGLOB.P_CODE_OPENLOAD K_ED_FI_BSDGLOB.P_CODE_SH_TO_GND K_ED_FI_BSDGLOB.P_CODE_SH_TO_UB K_ED_FI_BSDGLOB.P_CODE_UNPLAUSIBEL K_ED_FI_GEN.DEC_NACH_EINTRAG K_ED_FI_GEN.DEC_VOR_EINTRAG K_ED_FI_GEN.FEHLERSCHWELLE K_ED_FI_GEN.INC_NACH_EINTRAG K_ED_FI_GEN.INC_VOR_EINTRAG K_ED_FI_GEN.KLASSENINDEX K_ED_FI_GEN.OK_SCHWELLE K_ED_FI_GEN.P_CODE_OPENLOAD K_ED_FI_GEN.P_CODE_SH_TO_GND K_ED_FI_GEN.P_CODE_SH_TO_UB K_ED_FI_GEN.P_CODE_UNPLAUSIBEL K_ED_FI_IBS1.DEC_NACH_EINTRAG K_ED_FI_IBS1.DEC_VOR_EINTRAG K_ED_FI_IBS1.FEHLERSCHWELLE K_ED_FI_IBS1.INC_NACH_EINTRAG K_ED_FI_IBS1.INC_VOR_EINTRAG K_ED_FI_IBS1.KLASSENINDEX K_ED_FI_IBS1.OK_SCHWELLE K_ED_FI_IBS1.P_CODE_OPENLOAD K_ED_FI_IBS1.P_CODE_SH_TO_GND K_ED_FI_IBS1.P_CODE_SH_TO_UB K_ED_FI_IBS1.P_CODE_UNPLAUSIBEL K_ED_FI_IBS2.DEC_NACH_EINTRAG K_ED_FI_IBS2.DEC_VOR_EINTRAG K_ED_FI_IBS2.FEHLERSCHWELLE K_ED_FI_IBS2.INC_NACH_EINTRAG K_ED_FI_IBS2.INC_VOR_EINTRAG K_ED_FI_IBS2.KLASSENINDEX K_ED_FI_IBS2.OK_SCHWELLE K_ED_FI_IBS2.P_CODE_OPENLOAD K_ED_FI_IBS2.P_CODE_SH_TO_GND K_ED_FI_IBS2.P_CODE_SH_TO_UB K_ED_FI_IBS2.P_CODE_UNPLAUSIBEL K_ED_FI_IBS3.DEC_NACH_EINTRAG K_ED_FI_IBS3.DEC_VOR_EINTRAG K_ED_FI_IBS3.FEHLERSCHWELLE K_ED_FI_IBS3.INC_NACH_EINTRAG K_ED_FI_IBS3.INC_VOR_EINTRAG K_ED_FI_IBS3.KLASSENINDEX K_ED_FI_IBS3.OK_SCHWELLE K_ED_FI_IBS3.P_CODE_OPENLOAD K_ED_FI_IBS3.P_CODE_SH_TO_GND K_ED_FI_IBS3.P_CODE_SH_TO_UB K_ED_FI_IBS3.P_CODE_UNPLAUSIBEL K_ED_FI_PMBATT.DEC_NACH_EINTRAG K_ED_FI_PMBATT.DEC_VOR_EINTRAG K_ED_FI_PMBATT.FEHLERSCHWELLE K_ED_FI_PMBATT.INC_NACH_EINTRAG K_ED_FI_PMBATT.INC_VOR_EINTRAG K_ED_FI_PMBATT.KLASSENINDEX K_ED_FI_PMBATT.OK_SCHWELLE K_ED_FI_PMBATT.P_CODE_OPENLOAD K_ED_FI_PMBATT.P_CODE_SH_TO_GND K_ED_FI_PMBATT.P_CODE_SH_TO_UB K_ED_FI_PMBATT.P_CODE_UNPLAUSIBEL K_ED_FI_PMBN.DEC_NACH_EINTRAG K_ED_FI_PMBN.DEC_VOR_EINTRAG K_ED_FI_PMBN.FEHLERSCHWELLE K_ED_FI_PMBN.INC_NACH_EINTRAG K_ED_FI_PMBN.INC_VOR_EINTRAG K_ED_FI_PMBN.KLASSENINDEX K_ED_FI_PMBN.OK_SCHWELLE K_ED_FI_PMBN.P_CODE_OPENLOAD K_ED_FI_PMBN.P_CODE_SH_TO_GND K_ED_FI_PMBN.P_CODE_SH_TO_UB K_ED_FI_PMBN.P_CODE_UNPLAUSIBEL K_ED_FI_PMRUHVERL.DEC_NACH_EINTRAG K_ED_FI_PMRUHVERL.DEC_VOR_EINTRAG K_ED_FI_PMRUHVERL.FEHLERSCHWELLE K_ED_FI_PMRUHVERL.INC_NACH_EINTRAG K_ED_FI_PMRUHVERL.INC_VOR_EINTRAG K_ED_FI_PMRUHVERL.KLASSENINDEX K_ED_FI_PMRUHVERL.OK_SCHWELLE K_ED_FI_PMRUHVERL.P_CODE_OPENLOAD K_ED_FI_PMRUHVERL.P_CODE_SH_TO_GND K_ED_FI_PMRUHVERL.P_CODE_SH_TO_UB K_ED_FI_PMRUHVERL.P_CODE_UNPLAUSIBEL K_ED_FI_QLT.DEC_NACH_EINTRAG K_ED_FI_QLT.DEC_VOR_EINTRAG K_ED_FI_QLT.FEHLERSCHWELLE K_ED_FI_QLT.INC_NACH_EINTRAG K_ED_FI_QLT.INC_VOR_EINTRAG K_ED_FI_QLT.KLASSENINDEX K_ED_FI_QLT.OK_SCHWELLE K_ED_FI_QLT.P_CODE_OPENLOAD K_ED_FI_QLT.P_CODE_SH_TO_GND K_ED_FI_QLT.P_CODE_SH_TO_UB K_ED_FI_QLT.P_CODE_UNPLAUSIBEL K_ED_FI_TOENS.DEC_NACH_EINTRAG K_ED_FI_TOENS.DEC_VOR_EINTRAG K_ED_FI_TOENS.FEHLERSCHWELLE K_ED_FI_TOENS.INC_NACH_EINTRAG K_ED_FI_TOENS.INC_VOR_EINTRAG K_ED_FI_TOENS.KLASSENINDEX K_ED_FI_TOENS.OK_SCHWELLE K_ED_FI_TOENS.P_CODE_OPENLOAD K_ED_FI_TOENS.P_CODE_SH_TO_GND K_ED_FI_TOENS.P_CODE_SH_TO_UB K_ED_FI_TOENS.P_CODE_UNPLAUSIBEL K_ED_FPLAU1.DEC_NACH_EINTRAG K_ED_FPLAU1.DEC_VOR_EINTRAG K_ED_FPLAU1.FEHLERSCHWELLE K_ED_FPLAU1.INC_NACH_EINTRAG K_ED_FPLAU1.INC_VOR_EINTRAG K_ED_FPLAU1.KLASSENINDEX K_ED_FPLAU1.OK_SCHWELLE K_ED_FPLAU1.P_CODE_OPENLOAD K_ED_FPLAU1.P_CODE_SH_TO_GND K_ED_FPLAU1.P_CODE_SH_TO_UB K_ED_FPLAU1.P_CODE_UNPLAUSIBEL K_ED_FPLAU2.DEC_NACH_EINTRAG K_ED_FPLAU2.DEC_VOR_EINTRAG K_ED_FPLAU2.FEHLERSCHWELLE K_ED_FPLAU2.INC_NACH_EINTRAG K_ED_FPLAU2.INC_VOR_EINTRAG K_ED_FPLAU2.KLASSENINDEX K_ED_FPLAU2.OK_SCHWELLE K_ED_FPLAU2.P_CODE_OPENLOAD K_ED_FPLAU2.P_CODE_SH_TO_GND K_ED_FPLAU2.P_CODE_SH_TO_UB K_ED_FPLAU2.P_CODE_UNPLAUSIBEL K_ED_FST.DEC_NACH_EINTRAG K_ED_FST.DEC_VOR_EINTRAG K_ED_FST.FEHLERSCHWELLE K_ED_FST.INC_NACH_EINTRAG K_ED_FST.INC_VOR_EINTRAG K_ED_FST.KLASSENINDEX K_ED_FST.OK_SCHWELLE K_ED_FST.P_CODE_OPENLOAD K_ED_FST.P_CODE_SH_TO_GND K_ED_FST.P_CODE_SH_TO_UB K_ED_FST.P_CODE_UNPLAUSIBEL K_ED_FST_GEBER.DEC_NACH_EINTRAG K_ED_FST_GEBER.DEC_VOR_EINTRAG K_ED_FST_GEBER.FEHLERSCHWELLE K_ED_FST_GEBER.INC_NACH_EINTRAG K_ED_FST_GEBER.INC_VOR_EINTRAG K_ED_FST_GEBER.KLASSENINDEX K_ED_FST_GEBER.OK_SCHWELLE K_ED_FST_GEBER.P_CODE_OPENLOAD K_ED_FST_GEBER.P_CODE_SH_TO_GND K_ED_FST_GEBER.P_CODE_SH_TO_UB K_ED_FST_GEBER.P_CODE_UNPLAUSIBEL K_ED_HFM1.DEC_NACH_EINTRAG K_ED_HFM1.DEC_VOR_EINTRAG K_ED_HFM1.FEHLERSCHWELLE K_ED_HFM1.INC_NACH_EINTRAG K_ED_HFM1.INC_VOR_EINTRAG K_ED_HFM1.KLASSENINDEX K_ED_HFM1.OK_SCHWELLE K_ED_HFM1.P_CODE_OPENLOAD K_ED_HFM1.P_CODE_SH_TO_GND K_ED_HFM1.P_CODE_SH_TO_UB K_ED_HFM1.P_CODE_UNPLAUSIBEL K_ED_HFM2.DEC_NACH_EINTRAG K_ED_HFM2.DEC_VOR_EINTRAG K_ED_HFM2.FEHLERSCHWELLE K_ED_HFM2.INC_NACH_EINTRAG K_ED_HFM2.INC_VOR_EINTRAG K_ED_HFM2.KLASSENINDEX K_ED_HFM2.OK_SCHWELLE K_ED_HFM2.P_CODE_OPENLOAD K_ED_HFM2.P_CODE_SH_TO_GND K_ED_HFM2.P_CODE_SH_TO_UB K_ED_HFM2.P_CODE_UNPLAUSIBEL K_ED_INDEX_135_INJ.DEC_NACH_EINTRAG K_ED_INDEX_135_INJ.DEC_VOR_EINTRAG K_ED_INDEX_135_INJ.FEHLERSCHWELLE K_ED_INDEX_135_INJ.INC_NACH_EINTRAG K_ED_INDEX_135_INJ.INC_VOR_EINTRAG K_ED_INDEX_135_INJ.KLASSENINDEX K_ED_INDEX_135_INJ.OK_SCHWELLE K_ED_INDEX_135_INJ.P_CODE_OPENLOAD K_ED_INDEX_135_INJ.P_CODE_SH_TO_GND K_ED_INDEX_135_INJ.P_CODE_SH_TO_UB K_ED_INDEX_135_INJ.P_CODE_UNPLAUSIBEL K_ED_INDEX_15_INJ.DEC_NACH_EINTRAG K_ED_INDEX_15_INJ.DEC_VOR_EINTRAG K_ED_INDEX_15_INJ.FEHLERSCHWELLE K_ED_INDEX_15_INJ.INC_NACH_EINTRAG K_ED_INDEX_15_INJ.INC_VOR_EINTRAG K_ED_INDEX_15_INJ.KLASSENINDEX K_ED_INDEX_15_INJ.OK_SCHWELLE K_ED_INDEX_15_INJ.P_CODE_OPENLOAD K_ED_INDEX_15_INJ.P_CODE_SH_TO_GND K_ED_INDEX_15_INJ.P_CODE_SH_TO_UB K_ED_INDEX_15_INJ.P_CODE_UNPLAUSIBEL K_ED_INDEX_196_INJ.DEC_NACH_EINTRAG K_ED_INDEX_196_INJ.DEC_VOR_EINTRAG K_ED_INDEX_196_INJ.FEHLERSCHWELLE K_ED_INDEX_196_INJ.INC_NACH_EINTRAG K_ED_INDEX_196_INJ.INC_VOR_EINTRAG K_ED_INDEX_196_INJ.KLASSENINDEX K_ED_INDEX_196_INJ.OK_SCHWELLE K_ED_INDEX_196_INJ.P_CODE_OPENLOAD K_ED_INDEX_196_INJ.P_CODE_SH_TO_GND K_ED_INDEX_196_INJ.P_CODE_SH_TO_UB K_ED_INDEX_196_INJ.P_CODE_UNPLAUSIBEL K_ED_INDEX_197_INJ.DEC_NACH_EINTRAG K_ED_INDEX_197_INJ.DEC_VOR_EINTRAG K_ED_INDEX_197_INJ.FEHLERSCHWELLE K_ED_INDEX_197_INJ.INC_NACH_EINTRAG K_ED_INDEX_197_INJ.INC_VOR_EINTRAG K_ED_INDEX_197_INJ.KLASSENINDEX K_ED_INDEX_197_INJ.OK_SCHWELLE K_ED_INDEX_197_INJ.P_CODE_OPENLOAD K_ED_INDEX_197_INJ.P_CODE_SH_TO_GND K_ED_INDEX_197_INJ.P_CODE_SH_TO_UB K_ED_INDEX_197_INJ.P_CODE_UNPLAUSIBEL K_ED_INDEX_198_INJ.DEC_NACH_EINTRAG K_ED_INDEX_198_INJ.DEC_VOR_EINTRAG K_ED_INDEX_198_INJ.FEHLERSCHWELLE K_ED_INDEX_198_INJ.INC_NACH_EINTRAG K_ED_INDEX_198_INJ.INC_VOR_EINTRAG K_ED_INDEX_198_INJ.KLASSENINDEX K_ED_INDEX_198_INJ.OK_SCHWELLE K_ED_INDEX_198_INJ.P_CODE_OPENLOAD K_ED_INDEX_198_INJ.P_CODE_SH_TO_GND K_ED_INDEX_198_INJ.P_CODE_SH_TO_UB K_ED_INDEX_198_INJ.P_CODE_UNPLAUSIBEL K_ED_INDEX_199_INJ.DEC_NACH_EINTRAG K_ED_INDEX_199_INJ.DEC_VOR_EINTRAG K_ED_INDEX_199_INJ.FEHLERSCHWELLE K_ED_INDEX_199_INJ.INC_NACH_EINTRAG K_ED_INDEX_199_INJ.INC_VOR_EINTRAG K_ED_INDEX_199_INJ.KLASSENINDEX K_ED_INDEX_199_INJ.OK_SCHWELLE K_ED_INDEX_199_INJ.P_CODE_OPENLOAD K_ED_INDEX_199_INJ.P_CODE_SH_TO_GND K_ED_INDEX_199_INJ.P_CODE_SH_TO_UB K_ED_INDEX_199_INJ.P_CODE_UNPLAUSIBEL K_ED_INDEX_200_INJ.DEC_NACH_EINTRAG K_ED_INDEX_200_INJ.DEC_VOR_EINTRAG K_ED_INDEX_200_INJ.FEHLERSCHWELLE K_ED_INDEX_200_INJ.INC_NACH_EINTRAG K_ED_INDEX_200_INJ.INC_VOR_EINTRAG K_ED_INDEX_200_INJ.KLASSENINDEX K_ED_INDEX_200_INJ.OK_SCHWELLE K_ED_INDEX_200_INJ.P_CODE_OPENLOAD K_ED_INDEX_200_INJ.P_CODE_SH_TO_GND K_ED_INDEX_200_INJ.P_CODE_SH_TO_UB K_ED_INDEX_200_INJ.P_CODE_UNPLAUSIBEL K_ED_INDEX_201_INJ.DEC_NACH_EINTRAG K_ED_INDEX_201_INJ.DEC_VOR_EINTRAG K_ED_INDEX_201_INJ.FEHLERSCHWELLE K_ED_INDEX_201_INJ.INC_NACH_EINTRAG K_ED_INDEX_201_INJ.INC_VOR_EINTRAG K_ED_INDEX_201_INJ.KLASSENINDEX K_ED_INDEX_201_INJ.OK_SCHWELLE K_ED_INDEX_201_INJ.P_CODE_OPENLOAD K_ED_INDEX_201_INJ.P_CODE_SH_TO_GND K_ED_INDEX_201_INJ.P_CODE_SH_TO_UB K_ED_INDEX_201_INJ.P_CODE_UNPLAUSIBEL K_ED_INDEX_202_INJ.DEC_NACH_EINTRAG K_ED_INDEX_202_INJ.DEC_VOR_EINTRAG K_ED_INDEX_202_INJ.FEHLERSCHWELLE K_ED_INDEX_202_INJ.INC_NACH_EINTRAG K_ED_INDEX_202_INJ.INC_VOR_EINTRAG K_ED_INDEX_202_INJ.KLASSENINDEX K_ED_INDEX_202_INJ.OK_SCHWELLE K_ED_INDEX_202_INJ.P_CODE_OPENLOAD K_ED_INDEX_202_INJ.P_CODE_SH_TO_GND K_ED_INDEX_202_INJ.P_CODE_SH_TO_UB K_ED_INDEX_202_INJ.P_CODE_UNPLAUSIBEL K_ED_INDEX_203_INJ.DEC_NACH_EINTRAG K_ED_INDEX_203_INJ.DEC_VOR_EINTRAG K_ED_INDEX_203_INJ.FEHLERSCHWELLE K_ED_INDEX_203_INJ.INC_NACH_EINTRAG K_ED_INDEX_203_INJ.INC_VOR_EINTRAG K_ED_INDEX_203_INJ.KLASSENINDEX K_ED_INDEX_203_INJ.OK_SCHWELLE K_ED_INDEX_203_INJ.P_CODE_OPENLOAD K_ED_INDEX_203_INJ.P_CODE_SH_TO_GND K_ED_INDEX_203_INJ.P_CODE_SH_TO_UB K_ED_INDEX_203_INJ.P_CODE_UNPLAUSIBEL K_ED_INDEX_204_INJ.DEC_NACH_EINTRAG K_ED_INDEX_204_INJ.DEC_VOR_EINTRAG K_ED_INDEX_204_INJ.FEHLERSCHWELLE K_ED_INDEX_204_INJ.INC_NACH_EINTRAG K_ED_INDEX_204_INJ.INC_VOR_EINTRAG K_ED_INDEX_204_INJ.KLASSENINDEX K_ED_INDEX_204_INJ.OK_SCHWELLE K_ED_INDEX_204_INJ.P_CODE_OPENLOAD K_ED_INDEX_204_INJ.P_CODE_SH_TO_GND K_ED_INDEX_204_INJ.P_CODE_SH_TO_UB K_ED_INDEX_204_INJ.P_CODE_UNPLAUSIBEL K_ED_INDEX_205_INJ.DEC_NACH_EINTRAG K_ED_INDEX_205_INJ.DEC_VOR_EINTRAG K_ED_INDEX_205_INJ.FEHLERSCHWELLE K_ED_INDEX_205_INJ.INC_NACH_EINTRAG K_ED_INDEX_205_INJ.INC_VOR_EINTRAG K_ED_INDEX_205_INJ.KLASSENINDEX K_ED_INDEX_205_INJ.OK_SCHWELLE K_ED_INDEX_205_INJ.P_CODE_OPENLOAD K_ED_INDEX_205_INJ.P_CODE_SH_TO_GND K_ED_INDEX_205_INJ.P_CODE_SH_TO_UB K_ED_INDEX_205_INJ.P_CODE_UNPLAUSIBEL K_ED_INDEX_206_INJ.DEC_NACH_EINTRAG K_ED_INDEX_206_INJ.DEC_VOR_EINTRAG K_ED_INDEX_206_INJ.FEHLERSCHWELLE K_ED_INDEX_206_INJ.INC_NACH_EINTRAG K_ED_INDEX_206_INJ.INC_VOR_EINTRAG K_ED_INDEX_206_INJ.KLASSENINDEX K_ED_INDEX_206_INJ.OK_SCHWELLE K_ED_INDEX_206_INJ.P_CODE_OPENLOAD K_ED_INDEX_206_INJ.P_CODE_SH_TO_GND K_ED_INDEX_206_INJ.P_CODE_SH_TO_UB K_ED_INDEX_206_INJ.P_CODE_UNPLAUSIBEL K_ED_INDEX_207_INJ.DEC_NACH_EINTRAG K_ED_INDEX_207_INJ.DEC_VOR_EINTRAG K_ED_INDEX_207_INJ.FEHLERSCHWELLE K_ED_INDEX_207_INJ.INC_NACH_EINTRAG K_ED_INDEX_207_INJ.INC_VOR_EINTRAG K_ED_INDEX_207_INJ.KLASSENINDEX K_ED_INDEX_207_INJ.OK_SCHWELLE K_ED_INDEX_207_INJ.P_CODE_OPENLOAD K_ED_INDEX_207_INJ.P_CODE_SH_TO_GND K_ED_INDEX_207_INJ.P_CODE_SH_TO_UB K_ED_INDEX_207_INJ.P_CODE_UNPLAUSIBEL K_ED_INDEX_208_INJ.DEC_NACH_EINTRAG K_ED_INDEX_208_INJ.DEC_VOR_EINTRAG K_ED_INDEX_208_INJ.FEHLERSCHWELLE K_ED_INDEX_208_INJ.INC_NACH_EINTRAG K_ED_INDEX_208_INJ.INC_VOR_EINTRAG K_ED_INDEX_208_INJ.KLASSENINDEX K_ED_INDEX_208_INJ.OK_SCHWELLE K_ED_INDEX_208_INJ.P_CODE_OPENLOAD K_ED_INDEX_208_INJ.P_CODE_SH_TO_GND K_ED_INDEX_208_INJ.P_CODE_SH_TO_UB K_ED_INDEX_208_INJ.P_CODE_UNPLAUSIBEL K_ED_INDEX_209_INJ.DEC_NACH_EINTRAG K_ED_INDEX_209_INJ.DEC_VOR_EINTRAG K_ED_INDEX_209_INJ.FEHLERSCHWELLE K_ED_INDEX_209_INJ.INC_NACH_EINTRAG K_ED_INDEX_209_INJ.INC_VOR_EINTRAG K_ED_INDEX_209_INJ.KLASSENINDEX K_ED_INDEX_209_INJ.OK_SCHWELLE K_ED_INDEX_209_INJ.P_CODE_OPENLOAD K_ED_INDEX_209_INJ.P_CODE_SH_TO_GND K_ED_INDEX_209_INJ.P_CODE_SH_TO_UB K_ED_INDEX_209_INJ.P_CODE_UNPLAUSIBEL K_ED_INDEX_210_INJ.DEC_NACH_EINTRAG K_ED_INDEX_210_INJ.DEC_VOR_EINTRAG K_ED_INDEX_210_INJ.FEHLERSCHWELLE K_ED_INDEX_210_INJ.INC_NACH_EINTRAG K_ED_INDEX_210_INJ.INC_VOR_EINTRAG K_ED_INDEX_210_INJ.KLASSENINDEX K_ED_INDEX_210_INJ.OK_SCHWELLE K_ED_INDEX_210_INJ.P_CODE_OPENLOAD K_ED_INDEX_210_INJ.P_CODE_SH_TO_GND K_ED_INDEX_210_INJ.P_CODE_SH_TO_UB K_ED_INDEX_210_INJ.P_CODE_UNPLAUSIBEL K_ED_INDEX_211_INJ.DEC_NACH_EINTRAG K_ED_INDEX_211_INJ.DEC_VOR_EINTRAG K_ED_INDEX_211_INJ.FEHLERSCHWELLE K_ED_INDEX_211_INJ.INC_NACH_EINTRAG K_ED_INDEX_211_INJ.INC_VOR_EINTRAG K_ED_INDEX_211_INJ.KLASSENINDEX K_ED_INDEX_211_INJ.OK_SCHWELLE K_ED_INDEX_211_INJ.P_CODE_OPENLOAD K_ED_INDEX_211_INJ.P_CODE_SH_TO_GND K_ED_INDEX_211_INJ.P_CODE_SH_TO_UB K_ED_INDEX_211_INJ.P_CODE_UNPLAUSIBEL K_ED_INDEX_212_INJ.DEC_NACH_EINTRAG K_ED_INDEX_212_INJ.DEC_VOR_EINTRAG K_ED_INDEX_212_INJ.FEHLERSCHWELLE K_ED_INDEX_212_INJ.INC_NACH_EINTRAG K_ED_INDEX_212_INJ.INC_VOR_EINTRAG K_ED_INDEX_212_INJ.KLASSENINDEX K_ED_INDEX_212_INJ.OK_SCHWELLE K_ED_INDEX_212_INJ.P_CODE_OPENLOAD K_ED_INDEX_212_INJ.P_CODE_SH_TO_GND K_ED_INDEX_212_INJ.P_CODE_SH_TO_UB K_ED_INDEX_212_INJ.P_CODE_UNPLAUSIBEL K_ED_INDEX_213_INJ.DEC_NACH_EINTRAG K_ED_INDEX_213_INJ.DEC_VOR_EINTRAG K_ED_INDEX_213_INJ.FEHLERSCHWELLE K_ED_INDEX_213_INJ.INC_NACH_EINTRAG K_ED_INDEX_213_INJ.INC_VOR_EINTRAG K_ED_INDEX_213_INJ.KLASSENINDEX K_ED_INDEX_213_INJ.OK_SCHWELLE K_ED_INDEX_213_INJ.P_CODE_OPENLOAD K_ED_INDEX_213_INJ.P_CODE_SH_TO_GND K_ED_INDEX_213_INJ.P_CODE_SH_TO_UB K_ED_INDEX_213_INJ.P_CODE_UNPLAUSIBEL K_ED_INDEX_214_INJ.DEC_NACH_EINTRAG K_ED_INDEX_214_INJ.DEC_VOR_EINTRAG K_ED_INDEX_214_INJ.FEHLERSCHWELLE K_ED_INDEX_214_INJ.INC_NACH_EINTRAG K_ED_INDEX_214_INJ.INC_VOR_EINTRAG K_ED_INDEX_214_INJ.KLASSENINDEX K_ED_INDEX_214_INJ.OK_SCHWELLE K_ED_INDEX_214_INJ.P_CODE_OPENLOAD K_ED_INDEX_214_INJ.P_CODE_SH_TO_GND K_ED_INDEX_214_INJ.P_CODE_SH_TO_UB K_ED_INDEX_214_INJ.P_CODE_UNPLAUSIBEL K_ED_INDEX_215_INJ.DEC_NACH_EINTRAG K_ED_INDEX_215_INJ.DEC_VOR_EINTRAG K_ED_INDEX_215_INJ.FEHLERSCHWELLE K_ED_INDEX_215_INJ.INC_NACH_EINTRAG K_ED_INDEX_215_INJ.INC_VOR_EINTRAG K_ED_INDEX_215_INJ.KLASSENINDEX K_ED_INDEX_215_INJ.OK_SCHWELLE K_ED_INDEX_215_INJ.P_CODE_OPENLOAD K_ED_INDEX_215_INJ.P_CODE_SH_TO_GND K_ED_INDEX_215_INJ.P_CODE_SH_TO_UB K_ED_INDEX_215_INJ.P_CODE_UNPLAUSIBEL K_ED_INDEX_216_INJ.DEC_NACH_EINTRAG K_ED_INDEX_216_INJ.DEC_VOR_EINTRAG K_ED_INDEX_216_INJ.FEHLERSCHWELLE K_ED_INDEX_216_INJ.INC_NACH_EINTRAG K_ED_INDEX_216_INJ.INC_VOR_EINTRAG K_ED_INDEX_216_INJ.KLASSENINDEX K_ED_INDEX_216_INJ.OK_SCHWELLE K_ED_INDEX_216_INJ.P_CODE_OPENLOAD K_ED_INDEX_216_INJ.P_CODE_SH_TO_GND K_ED_INDEX_216_INJ.P_CODE_SH_TO_UB K_ED_INDEX_216_INJ.P_CODE_UNPLAUSIBEL K_ED_INDEX_217_INJ.DEC_NACH_EINTRAG K_ED_INDEX_217_INJ.DEC_VOR_EINTRAG K_ED_INDEX_217_INJ.FEHLERSCHWELLE K_ED_INDEX_217_INJ.INC_NACH_EINTRAG K_ED_INDEX_217_INJ.INC_VOR_EINTRAG K_ED_INDEX_217_INJ.KLASSENINDEX K_ED_INDEX_217_INJ.OK_SCHWELLE K_ED_INDEX_217_INJ.P_CODE_OPENLOAD K_ED_INDEX_217_INJ.P_CODE_SH_TO_GND K_ED_INDEX_217_INJ.P_CODE_SH_TO_UB K_ED_INDEX_217_INJ.P_CODE_UNPLAUSIBEL K_ED_INDEX_218_INJ.DEC_NACH_EINTRAG K_ED_INDEX_218_INJ.DEC_VOR_EINTRAG K_ED_INDEX_218_INJ.FEHLERSCHWELLE K_ED_INDEX_218_INJ.INC_NACH_EINTRAG K_ED_INDEX_218_INJ.INC_VOR_EINTRAG K_ED_INDEX_218_INJ.KLASSENINDEX K_ED_INDEX_218_INJ.OK_SCHWELLE K_ED_INDEX_218_INJ.P_CODE_OPENLOAD K_ED_INDEX_218_INJ.P_CODE_SH_TO_GND K_ED_INDEX_218_INJ.P_CODE_SH_TO_UB K_ED_INDEX_218_INJ.P_CODE_UNPLAUSIBEL K_ED_INDEX_219_INJ.DEC_NACH_EINTRAG K_ED_INDEX_219_INJ.DEC_VOR_EINTRAG K_ED_INDEX_219_INJ.FEHLERSCHWELLE K_ED_INDEX_219_INJ.INC_NACH_EINTRAG K_ED_INDEX_219_INJ.INC_VOR_EINTRAG K_ED_INDEX_219_INJ.KLASSENINDEX K_ED_INDEX_219_INJ.OK_SCHWELLE K_ED_INDEX_219_INJ.P_CODE_OPENLOAD K_ED_INDEX_219_INJ.P_CODE_SH_TO_GND K_ED_INDEX_219_INJ.P_CODE_SH_TO_UB K_ED_INDEX_219_INJ.P_CODE_UNPLAUSIBEL K_ED_INDEX_220_INJ.DEC_NACH_EINTRAG K_ED_INDEX_220_INJ.DEC_VOR_EINTRAG K_ED_INDEX_220_INJ.FEHLERSCHWELLE K_ED_INDEX_220_INJ.INC_NACH_EINTRAG K_ED_INDEX_220_INJ.INC_VOR_EINTRAG K_ED_INDEX_220_INJ.KLASSENINDEX K_ED_INDEX_220_INJ.OK_SCHWELLE K_ED_INDEX_220_INJ.P_CODE_OPENLOAD K_ED_INDEX_220_INJ.P_CODE_SH_TO_GND K_ED_INDEX_220_INJ.P_CODE_SH_TO_UB K_ED_INDEX_220_INJ.P_CODE_UNPLAUSIBEL K_ED_INDEX_221_INJ.DEC_NACH_EINTRAG K_ED_INDEX_221_INJ.DEC_VOR_EINTRAG K_ED_INDEX_221_INJ.FEHLERSCHWELLE K_ED_INDEX_221_INJ.INC_NACH_EINTRAG K_ED_INDEX_221_INJ.INC_VOR_EINTRAG K_ED_INDEX_221_INJ.KLASSENINDEX K_ED_INDEX_221_INJ.OK_SCHWELLE K_ED_INDEX_221_INJ.P_CODE_OPENLOAD K_ED_INDEX_221_INJ.P_CODE_SH_TO_GND K_ED_INDEX_221_INJ.P_CODE_SH_TO_UB K_ED_INDEX_221_INJ.P_CODE_UNPLAUSIBEL K_ED_INDEX_222_INJ.DEC_NACH_EINTRAG K_ED_INDEX_222_INJ.DEC_VOR_EINTRAG K_ED_INDEX_222_INJ.FEHLERSCHWELLE K_ED_INDEX_222_INJ.INC_NACH_EINTRAG K_ED_INDEX_222_INJ.INC_VOR_EINTRAG K_ED_INDEX_222_INJ.KLASSENINDEX K_ED_INDEX_222_INJ.OK_SCHWELLE K_ED_INDEX_222_INJ.P_CODE_OPENLOAD K_ED_INDEX_222_INJ.P_CODE_SH_TO_GND K_ED_INDEX_222_INJ.P_CODE_SH_TO_UB K_ED_INDEX_222_INJ.P_CODE_UNPLAUSIBEL K_ED_INDEX_223_INJ.DEC_NACH_EINTRAG K_ED_INDEX_223_INJ.DEC_VOR_EINTRAG K_ED_INDEX_223_INJ.FEHLERSCHWELLE K_ED_INDEX_223_INJ.INC_NACH_EINTRAG K_ED_INDEX_223_INJ.INC_VOR_EINTRAG K_ED_INDEX_223_INJ.KLASSENINDEX K_ED_INDEX_223_INJ.OK_SCHWELLE K_ED_INDEX_223_INJ.P_CODE_OPENLOAD K_ED_INDEX_223_INJ.P_CODE_SH_TO_GND K_ED_INDEX_223_INJ.P_CODE_SH_TO_UB K_ED_INDEX_223_INJ.P_CODE_UNPLAUSIBEL K_ED_KAT_OBD1.DEC_NACH_EINTRAG K_ED_KAT_OBD1.DEC_VOR_EINTRAG K_ED_KAT_OBD1.FEHLERSCHWELLE K_ED_KAT_OBD1.INC_NACH_EINTRAG K_ED_KAT_OBD1.INC_VOR_EINTRAG K_ED_KAT_OBD1.KLASSENINDEX K_ED_KAT_OBD1.OK_SCHWELLE K_ED_KAT_OBD1.P_CODE_OPENLOAD K_ED_KAT_OBD1.P_CODE_SH_TO_GND K_ED_KAT_OBD1.P_CODE_SH_TO_UB K_ED_KAT_OBD1.P_CODE_UNPLAUSIBEL K_ED_KAT_OBD2.DEC_NACH_EINTRAG K_ED_KAT_OBD2.DEC_VOR_EINTRAG K_ED_KAT_OBD2.FEHLERSCHWELLE K_ED_KAT_OBD2.INC_NACH_EINTRAG K_ED_KAT_OBD2.INC_VOR_EINTRAG K_ED_KAT_OBD2.KLASSENINDEX K_ED_KAT_OBD2.OK_SCHWELLE K_ED_KAT_OBD2.P_CODE_OPENLOAD K_ED_KAT_OBD2.P_CODE_SH_TO_GND K_ED_KAT_OBD2.P_CODE_SH_TO_UB K_ED_KAT_OBD2.P_CODE_UNPLAUSIBEL K_ED_KATS_B1.DEC_NACH_EINTRAG K_ED_KATS_B1.DEC_VOR_EINTRAG K_ED_KATS_B1.FEHLERSCHWELLE K_ED_KATS_B1.INC_NACH_EINTRAG K_ED_KATS_B1.INC_VOR_EINTRAG K_ED_KATS_B1.KLASSENINDEX K_ED_KATS_B1.OK_SCHWELLE K_ED_KATS_B1.P_CODE_OPENLOAD K_ED_KATS_B1.P_CODE_SH_TO_GND K_ED_KATS_B1.P_CODE_SH_TO_UB K_ED_KATS_B1.P_CODE_UNPLAUSIBEL K_ED_KATS_B2.DEC_NACH_EINTRAG K_ED_KATS_B2.DEC_VOR_EINTRAG K_ED_KATS_B2.FEHLERSCHWELLE K_ED_KATS_B2.INC_NACH_EINTRAG K_ED_KATS_B2.INC_VOR_EINTRAG K_ED_KATS_B2.KLASSENINDEX K_ED_KATS_B2.OK_SCHWELLE K_ED_KATS_B2.P_CODE_OPENLOAD K_ED_KATS_B2.P_CODE_SH_TO_GND K_ED_KATS_B2.P_CODE_SH_TO_UB K_ED_KATS_B2.P_CODE_UNPLAUSIBEL K_ED_KGE1.DEC_NACH_EINTRAG K_ED_KGE1.DEC_VOR_EINTRAG K_ED_KGE1.FEHLERSCHWELLE K_ED_KGE1.INC_NACH_EINTRAG K_ED_KGE1.INC_VOR_EINTRAG K_ED_KGE1.KLASSENINDEX K_ED_KGE1.OK_SCHWELLE K_ED_KGE1.P_CODE_OPENLOAD K_ED_KGE1.P_CODE_SH_TO_GND K_ED_KGE1.P_CODE_SH_TO_UB K_ED_KGE1.P_CODE_UNPLAUSIBEL K_ED_KGE2.DEC_NACH_EINTRAG K_ED_KGE2.DEC_VOR_EINTRAG K_ED_KGE2.FEHLERSCHWELLE K_ED_KGE2.INC_NACH_EINTRAG K_ED_KGE2.INC_VOR_EINTRAG K_ED_KGE2.KLASSENINDEX K_ED_KGE2.OK_SCHWELLE K_ED_KGE2.P_CODE_OPENLOAD K_ED_KGE2.P_CODE_SH_TO_GND K_ED_KGE2.P_CODE_SH_TO_UB K_ED_KGE2.P_CODE_UNPLAUSIBEL K_ED_KSD1.DEC_NACH_EINTRAG K_ED_KSD1.DEC_VOR_EINTRAG K_ED_KSD1.FEHLERSCHWELLE K_ED_KSD1.INC_NACH_EINTRAG K_ED_KSD1.INC_VOR_EINTRAG K_ED_KSD1.KLASSENINDEX K_ED_KSD1.OK_SCHWELLE K_ED_KSD1.P_CODE_OPENLOAD K_ED_KSD1.P_CODE_SH_TO_GND K_ED_KSD1.P_CODE_SH_TO_UB K_ED_KSD1.P_CODE_UNPLAUSIBEL K_ED_KSD2.DEC_NACH_EINTRAG K_ED_KSD2.DEC_VOR_EINTRAG K_ED_KSD2.FEHLERSCHWELLE K_ED_KSD2.INC_NACH_EINTRAG K_ED_KSD2.INC_VOR_EINTRAG K_ED_KSD2.KLASSENINDEX K_ED_KSD2.OK_SCHWELLE K_ED_KSD2.P_CODE_OPENLOAD K_ED_KSD2.P_CODE_SH_TO_GND K_ED_KSD2.P_CODE_SH_TO_UB K_ED_KSD2.P_CODE_UNPLAUSIBEL K_ED_KW.DEC_NACH_EINTRAG K_ED_KW.DEC_VOR_EINTRAG K_ED_KW.FEHLERSCHWELLE K_ED_KW.INC_NACH_EINTRAG K_ED_KW.INC_VOR_EINTRAG K_ED_KW.KLASSENINDEX K_ED_KW.OK_SCHWELLE K_ED_KW.P_CODE_OPENLOAD K_ED_KW.P_CODE_SH_TO_GND K_ED_KW.P_CODE_SH_TO_UB K_ED_KW.P_CODE_UNPLAUSIBEL K_ED_LA1_ADAPT.DEC_NACH_EINTRAG K_ED_LA1_ADAPT.DEC_VOR_EINTRAG K_ED_LA1_ADAPT.FEHLERSCHWELLE K_ED_LA1_ADAPT.INC_NACH_EINTRAG K_ED_LA1_ADAPT.INC_VOR_EINTRAG K_ED_LA1_ADAPT.KLASSENINDEX K_ED_LA1_ADAPT.OK_SCHWELLE K_ED_LA1_ADAPT.P_CODE_OPENLOAD K_ED_LA1_ADAPT.P_CODE_SH_TO_GND K_ED_LA1_ADAPT.P_CODE_SH_TO_UB K_ED_LA1_ADAPT.P_CODE_UNPLAUSIBEL K_ED_LA1_TRIM_AD.DEC_NACH_EINTRAG K_ED_LA1_TRIM_AD.DEC_VOR_EINTRAG K_ED_LA1_TRIM_AD.FEHLERSCHWELLE K_ED_LA1_TRIM_AD.INC_NACH_EINTRAG K_ED_LA1_TRIM_AD.INC_VOR_EINTRAG K_ED_LA1_TRIM_AD.KLASSENINDEX K_ED_LA1_TRIM_AD.OK_SCHWELLE K_ED_LA1_TRIM_AD.P_CODE_OPENLOAD K_ED_LA1_TRIM_AD.P_CODE_SH_TO_GND K_ED_LA1_TRIM_AD.P_CODE_SH_TO_UB K_ED_LA1_TRIM_AD.P_CODE_UNPLAUSIBEL K_ED_LA2_ADAPT.DEC_NACH_EINTRAG K_ED_LA2_ADAPT.DEC_VOR_EINTRAG K_ED_LA2_ADAPT.FEHLERSCHWELLE K_ED_LA2_ADAPT.INC_NACH_EINTRAG K_ED_LA2_ADAPT.INC_VOR_EINTRAG K_ED_LA2_ADAPT.KLASSENINDEX K_ED_LA2_ADAPT.OK_SCHWELLE K_ED_LA2_ADAPT.P_CODE_OPENLOAD K_ED_LA2_ADAPT.P_CODE_SH_TO_GND K_ED_LA2_ADAPT.P_CODE_SH_TO_UB K_ED_LA2_ADAPT.P_CODE_UNPLAUSIBEL K_ED_LA2_TRIM_AD.DEC_NACH_EINTRAG K_ED_LA2_TRIM_AD.DEC_VOR_EINTRAG K_ED_LA2_TRIM_AD.FEHLERSCHWELLE K_ED_LA2_TRIM_AD.INC_NACH_EINTRAG K_ED_LA2_TRIM_AD.INC_VOR_EINTRAG K_ED_LA2_TRIM_AD.KLASSENINDEX K_ED_LA2_TRIM_AD.OK_SCHWELLE K_ED_LA2_TRIM_AD.P_CODE_OPENLOAD K_ED_LA2_TRIM_AD.P_CODE_SH_TO_GND K_ED_LA2_TRIM_AD.P_CODE_SH_TO_UB K_ED_LA2_TRIM_AD.P_CODE_UNPLAUSIBEL K_ED_LAM1_REG.DEC_NACH_EINTRAG K_ED_LAM1_REG.DEC_VOR_EINTRAG K_ED_LAM1_REG.FEHLERSCHWELLE K_ED_LAM1_REG.INC_NACH_EINTRAG K_ED_LAM1_REG.INC_VOR_EINTRAG K_ED_LAM1_REG.KLASSENINDEX K_ED_LAM1_REG.OK_SCHWELLE K_ED_LAM1_REG.P_CODE_OPENLOAD K_ED_LAM1_REG.P_CODE_SH_TO_GND K_ED_LAM1_REG.P_CODE_SH_TO_UB K_ED_LAM1_REG.P_CODE_UNPLAUSIBEL K_ED_LAM2_REG.DEC_NACH_EINTRAG K_ED_LAM2_REG.DEC_VOR_EINTRAG K_ED_LAM2_REG.FEHLERSCHWELLE K_ED_LAM2_REG.INC_NACH_EINTRAG K_ED_LAM2_REG.INC_VOR_EINTRAG K_ED_LAM2_REG.KLASSENINDEX K_ED_LAM2_REG.OK_SCHWELLE K_ED_LAM2_REG.P_CODE_OPENLOAD K_ED_LAM2_REG.P_CODE_SH_TO_GND K_ED_LAM2_REG.P_CODE_SH_TO_UB K_ED_LAM2_REG.P_CODE_UNPLAUSIBEL K_ED_LANK1.DEC_NACH_EINTRAG K_ED_LANK1.DEC_VOR_EINTRAG K_ED_LANK1.FEHLERSCHWELLE K_ED_LANK1.INC_NACH_EINTRAG K_ED_LANK1.INC_VOR_EINTRAG K_ED_LANK1.KLASSENINDEX K_ED_LANK1.OK_SCHWELLE K_ED_LANK1.P_CODE_OPENLOAD K_ED_LANK1.P_CODE_SH_TO_GND K_ED_LANK1.P_CODE_SH_TO_UB K_ED_LANK1.P_CODE_UNPLAUSIBEL K_ED_LANK1_OBD_S.DEC_NACH_EINTRAG K_ED_LANK1_OBD_S.DEC_VOR_EINTRAG K_ED_LANK1_OBD_S.FEHLERSCHWELLE K_ED_LANK1_OBD_S.INC_NACH_EINTRAG K_ED_LANK1_OBD_S.INC_VOR_EINTRAG K_ED_LANK1_OBD_S.KLASSENINDEX K_ED_LANK1_OBD_S.OK_SCHWELLE K_ED_LANK1_OBD_S.P_CODE_OPENLOAD K_ED_LANK1_OBD_S.P_CODE_SH_TO_GND K_ED_LANK1_OBD_S.P_CODE_SH_TO_UB K_ED_LANK1_OBD_S.P_CODE_UNPLAUSIBEL K_ED_LANK1_OBD_WE.DEC_NACH_EINTRAG K_ED_LANK1_OBD_WE.DEC_VOR_EINTRAG K_ED_LANK1_OBD_WE.FEHLERSCHWELLE K_ED_LANK1_OBD_WE.INC_NACH_EINTRAG K_ED_LANK1_OBD_WE.INC_VOR_EINTRAG K_ED_LANK1_OBD_WE.KLASSENINDEX K_ED_LANK1_OBD_WE.OK_SCHWELLE K_ED_LANK1_OBD_WE.P_CODE_OPENLOAD K_ED_LANK1_OBD_WE.P_CODE_SH_TO_GND K_ED_LANK1_OBD_WE.P_CODE_SH_TO_UB K_ED_LANK1_OBD_WE.P_CODE_UNPLAUSIBEL K_ED_LANK1_OPENLOAD.DEC_NACH_EINTRAG K_ED_LANK1_OPENLOAD.DEC_VOR_EINTRAG K_ED_LANK1_OPENLOAD.FEHLERSCHWELLE K_ED_LANK1_OPENLOAD.INC_NACH_EINTRAG K_ED_LANK1_OPENLOAD.INC_VOR_EINTRAG K_ED_LANK1_OPENLOAD.KLASSENINDEX K_ED_LANK1_OPENLOAD.OK_SCHWELLE K_ED_LANK1_OPENLOAD.P_CODE_OPENLOAD K_ED_LANK1_OPENLOAD.P_CODE_SH_TO_GND K_ED_LANK1_OPENLOAD.P_CODE_SH_TO_UB /end DEF_CHARACTERISTIC
/end FUNCTION
/begin RECORD_LAYOUT TKW_VV_VV_UB FNC_VALUES 1 UBYTE COLUMN_DIR DIRECT /end RECORD_LAYOUT
/begin RECORD_LAYOUT TKW_VV_VV_UW FNC_VALUES 1 UWORD COLUMN_DIR DIRECT /end RECORD_LAYOUT
/end MODULE
/end PROJECT
