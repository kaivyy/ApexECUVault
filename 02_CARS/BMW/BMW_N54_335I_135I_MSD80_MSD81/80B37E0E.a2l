ASAP2_VERSION 1 41
/begin PROJECT MSD70 "Spray Guided DI-System with Piezo Injectors for 6-Cylinder"
/begin HEADER "_default_HeaderComment" PROJECT_NO _0B /end HEADER
/begin MODULE _default_ModuleName "_default_ModuleLongIdentifier"
/begin MOD_COMMON "_default_ModCommonComment" DEPOSIT ABSOLUTE BYTE_ORDER MSB_LAST ALIGNMENT_BYTE 1 ALIGNMENT_WORD 2 ALIGNMENT_LONG 2 ALIGNMENT_FLOAT32_IEEE 2 ALIGNMENT_FLOAT64_IEEE 4 /end MOD_COMMON
/begin CHARACTERISTIC c_crk_cyl_lam_1 "factor for different distance between lambda sensor and cylinder individual exaust-valves" VALUE 0xa10291ca _REC_VAL_20_s1 1440. _CNV_A_R_LINEAR_____109_CM -720. 720. DISPLAY_IDENTIFIER C_CRK_CYL_LAM_1 FORMAT "%4.0" /end CHARACTERISTIC
/begin CHARACTERISTIC c_crk_cyl_lam_2 "factor for different distance between lambda sensor and cylinder individual exaust-valves" VALUE 0xa10291cb _REC_VAL_20_s1 1440. _CNV_A_R_LINEAR_____109_CM -720. 720. DISPLAY_IDENTIFIER C_CRK_CYL_LAM_2 FORMAT "%4.0" /end CHARACTERISTIC
/begin CHARACTERISTIC c_crk_cyl_lam_3 "factor for different distance between lambda sensor and cylinder individual exaust-valves" VALUE 0xa10291cc _REC_VAL_20_s1 1440. _CNV_A_R_LINEAR_____109_CM -720. 720. DISPLAY_IDENTIFIER C_CRK_CYL_LAM_3 FORMAT "%4.0" /end CHARACTERISTIC
/begin CHARACTERISTIC c_crk_cyl_lam_4 "factor for different distance between lambda sensor and cylinder individual exaust-valves" VALUE 0xa10291cd _REC_VAL_20_s1 1440. _CNV_A_R_LINEAR_____109_CM -720. 720. DISPLAY_IDENTIFIER C_CRK_CYL_LAM_4 FORMAT "%4.0" /end CHARACTERISTIC
/begin CHARACTERISTIC c_crk_cyl_lam_5 "factor for different distance between lambda sensor and cylinder individual exaust-valves" VALUE 0xa10291ce _REC_VAL_20_s1 1440. _CNV_A_R_LINEAR_____109_CM -720. 720. DISPLAY_IDENTIFIER C_CRK_CYL_LAM_5 FORMAT "%4.0" /end CHARACTERISTIC
/begin CHARACTERISTIC c_crk_cyl_lam_0 "factor for different distance between lambda sensor and cylinder individual exaust-valves" VALUE 0xa10291c9 _REC_VAL_20_s1 1440. _CNV_A_R_LINEAR_____109_CM -720. 720. DISPLAY_IDENTIFIER C_CRK_CYL_LAM_0 FORMAT "%4.0" /end CHARACTERISTIC
/begin MEASUREMENT ti_cyl_lam[0] "factor for the injection time correction of cylinder x" SWORD _CNV_A_R_LINEAR_____110_CM 1 100. -50. 49.9984741210938 DISPLAY_IDENTIFIER TI_CYL_LAM[0] ECU_ADDRESS 0xd0004f14 FORMAT "%7.3" /end MEASUREMENT
/begin MEASUREMENT ti_cyl_lam[1] "factor for the injection time correction of cylinder x" SWORD _CNV_A_R_LINEAR_____110_CM 1 100. -50. 49.9984741210938 DISPLAY_IDENTIFIER TI_CYL_LAM[1] ECU_ADDRESS 0xd0004f16 FORMAT "%7.3" /end MEASUREMENT
/begin MEASUREMENT ti_cyl_lam[2] "factor for the injection time correction of cylinder x" SWORD _CNV_A_R_LINEAR_____110_CM 1 100. -50. 49.9984741210938 DISPLAY_IDENTIFIER TI_CYL_LAM[2] ECU_ADDRESS 0xd0004f18 FORMAT "%7.3" /end MEASUREMENT
/begin MEASUREMENT ti_cyl_lam[3] "factor for the injection time correction of cylinder x" SWORD _CNV_A_R_LINEAR_____110_CM 1 100. -50. 49.9984741210938 DISPLAY_IDENTIFIER TI_CYL_LAM[3] ECU_ADDRESS 0xd0004f1a FORMAT "%7.3" /end MEASUREMENT
/begin MEASUREMENT ti_cyl_lam[4] "factor for the injection time correction of cylinder x" SWORD _CNV_A_R_LINEAR_____110_CM 1 100. -50. 49.9984741210938 DISPLAY_IDENTIFIER TI_CYL_LAM[4] ECU_ADDRESS 0xd0004f1c FORMAT "%7.3" /end MEASUREMENT
/begin MEASUREMENT ti_cyl_lam[5] "factor for the injection time correction of cylinder x" SWORD _CNV_A_R_LINEAR_____110_CM 1 100. -50. 49.9984741210938 DISPLAY_IDENTIFIER TI_CYL_LAM[5] ECU_ADDRESS 0xd0004f1e FORMAT "%7.3" /end MEASUREMENT
/begin MEASUREMENT ti_cyl_lam_add[0] "additive factor for the injection time correction of cylinder x" SWORD _CNV_A_R_LINEAR_____111_CM 1 100. -131.072 131.068 DISPLAY_IDENTIFIER TI_CYL_LAM_ADD[0] ECU_ADDRESS 0xd0004f20 FORMAT "%8.3" /end MEASUREMENT
/begin MEASUREMENT ti_cyl_lam_add[1] "additive factor for the injection time correction of cylinder x" SWORD _CNV_A_R_LINEAR_____111_CM 1 100. -131.072 131.068 DISPLAY_IDENTIFIER TI_CYL_LAM_ADD[1] ECU_ADDRESS 0xd0004f22 FORMAT "%8.3" /end MEASUREMENT
/begin MEASUREMENT ti_cyl_lam_add[2] "additive factor for the injection time correction of cylinder x" SWORD _CNV_A_R_LINEAR_____111_CM 1 100. -131.072 131.068 DISPLAY_IDENTIFIER TI_CYL_LAM_ADD[2] ECU_ADDRESS 0xd0004f24 FORMAT "%8.3" /end MEASUREMENT
/begin MEASUREMENT ti_cyl_lam_add[3] "additive factor for the injection time correction of cylinder x" SWORD _CNV_A_R_LINEAR_____111_CM 1 100. -131.072 131.068 DISPLAY_IDENTIFIER TI_CYL_LAM_ADD[3] ECU_ADDRESS 0xd0004f26 FORMAT "%8.3" /end MEASUREMENT
/begin MEASUREMENT ti_cyl_lam_add[4] "additive factor for the injection time correction of cylinder x" SWORD _CNV_A_R_LINEAR_____111_CM 1 100. -131.072 131.068 DISPLAY_IDENTIFIER TI_CYL_LAM_ADD[4] ECU_ADDRESS 0xd0004f28 FORMAT "%8.3" /end MEASUREMENT
/begin MEASUREMENT ti_cyl_lam_add[5] "additive factor for the injection time correction of cylinder x" SWORD _CNV_A_R_LINEAR_____111_CM 1 100. -131.072 131.068 DISPLAY_IDENTIFIER TI_CYL_LAM_ADD[5] ECU_ADDRESS 0xd0004f2a FORMAT "%8.3" /end MEASUREMENT
/begin MEASUREMENT ti_cyl_lam_lim_not[0] "unlimited output of the cylinder individual controller" SWORD _CNV_A_R_LINEAR_____110_CM 1 100. -50. 49.9984741210938 DISPLAY_IDENTIFIER TI_CYL_LAM_LIM_NOT[0] ECU_ADDRESS 0xc00002fc FORMAT "%7.3" /end MEASUREMENT
/begin MEASUREMENT ti_cyl_lam_lim_not[1] "unlimited output of the cylinder individual controller" SWORD _CNV_A_R_LINEAR_____110_CM 1 100. -50. 49.9984741210938 DISPLAY_IDENTIFIER TI_CYL_LAM_LIM_NOT[1] ECU_ADDRESS 0xc00002fe FORMAT "%7.3" /end MEASUREMENT
/begin MEASUREMENT ti_cyl_lam_lim_not[2] "unlimited output of the cylinder individual controller" SWORD _CNV_A_R_LINEAR_____110_CM 1 100. -50. 49.9984741210938 DISPLAY_IDENTIFIER TI_CYL_LAM_LIM_NOT[2] ECU_ADDRESS 0xc0000300 FORMAT "%7.3" /end MEASUREMENT
/begin MEASUREMENT ti_cyl_lam_lim_not[3] "unlimited output of the cylinder individual controller" SWORD _CNV_A_R_LINEAR_____110_CM 1 100. -50. 49.9984741210938 DISPLAY_IDENTIFIER TI_CYL_LAM_LIM_NOT[3] ECU_ADDRESS 0xc0000302 FORMAT "%7.3" /end MEASUREMENT
/begin MEASUREMENT ti_cyl_lam_lim_not[4] "unlimited output of the cylinder individual controller" SWORD _CNV_A_R_LINEAR_____110_CM 1 100. -50. 49.9984741210938 DISPLAY_IDENTIFIER TI_CYL_LAM_LIM_NOT[4] ECU_ADDRESS 0xc0000304 FORMAT "%7.3" /end MEASUREMENT
/begin MEASUREMENT ti_cyl_lam_lim_not[5] "unlimited output of the cylinder individual controller" SWORD _CNV_A_R_LINEAR_____110_CM 1 100. -50. 49.9984741210938 DISPLAY_IDENTIFIER TI_CYL_LAM_LIM_NOT[5] ECU_ADDRESS 0xc0000306 FORMAT "%7.3" /end MEASUREMENT
/begin MEASUREMENT fac_cyl_lam_int[0] "unlimited output of the cylinder individual controller" SWORD _CNV_A_R_LINEAR_____110_CM 1 100. -50. 49.9984741210938 DISPLAY_IDENTIFIER FAC_CYL_LAM_INT[0] ECU_ADDRESS 0xc0000308 FORMAT "%7.3" /end MEASUREMENT
/begin MEASUREMENT fac_cyl_lam_int[1] "unlimited output of the cylinder individual controller" SWORD _CNV_A_R_LINEAR_____110_CM 1 100. -50. 49.9984741210938 DISPLAY_IDENTIFIER FAC_CYL_LAM_INT[1] ECU_ADDRESS 0xc000030a FORMAT "%7.3" /end MEASUREMENT
/begin MEASUREMENT fac_cyl_lam_int[2] "unlimited output of the cylinder individual controller" SWORD _CNV_A_R_LINEAR_____110_CM 1 100. -50. 49.9984741210938 DISPLAY_IDENTIFIER FAC_CYL_LAM_INT[2] ECU_ADDRESS 0xc000030c FORMAT "%7.3" /end MEASUREMENT
/begin MEASUREMENT fac_cyl_lam_int[3] "unlimited output of the cylinder individual controller" SWORD _CNV_A_R_LINEAR_____110_CM 1 100. -50. 49.9984741210938 DISPLAY_IDENTIFIER FAC_CYL_LAM_INT[3] ECU_ADDRESS 0xc000030e FORMAT "%7.3" /end MEASUREMENT
/begin MEASUREMENT fac_cyl_lam_int[4] "unlimited output of the cylinder individual controller" SWORD _CNV_A_R_LINEAR_____110_CM 1 100. -50. 49.9984741210938 DISPLAY_IDENTIFIER FAC_CYL_LAM_INT[4] ECU_ADDRESS 0xc0000310 FORMAT "%7.3" /end MEASUREMENT
/begin MEASUREMENT fac_cyl_lam_int[5] "unlimited output of the cylinder individual controller" SWORD _CNV_A_R_LINEAR_____110_CM 1 100. -50. 49.9984741210938 DISPLAY_IDENTIFIER FAC_CYL_LAM_INT[5] ECU_ADDRESS 0xc0000312 FORMAT "%7.3" /end MEASUREMENT
/begin MEASUREMENT fac_cyl_lam[0] "output of the cylinder individual controller, shifted by its mean value" SWORD _CNV_A_R_LINEAR_____110_CM 1 100. -50. 49.9984741210938 DISPLAY_IDENTIFIER FAC_CYL_LAM[0] ECU_ADDRESS 0xd0004f08 FORMAT "%7.3" /end MEASUREMENT
/begin MEASUREMENT fac_cyl_lam[1] "output of the cylinder individual controller, shifted by its mean value" SWORD _CNV_A_R_LINEAR_____110_CM 1 100. -50. 49.9984741210938 DISPLAY_IDENTIFIER FAC_CYL_LAM[1] ECU_ADDRESS 0xd0004f0a FORMAT "%7.3" /end MEASUREMENT
/begin MEASUREMENT fac_cyl_lam[2] "output of the cylinder individual controller, shifted by its mean value" SWORD _CNV_A_R_LINEAR_____110_CM 1 100. -50. 49.9984741210938 DISPLAY_IDENTIFIER FAC_CYL_LAM[2] ECU_ADDRESS 0xd0004f0c FORMAT "%7.3" /end MEASUREMENT
/begin MEASUREMENT fac_cyl_lam[3] "output of the cylinder individual controller, shifted by its mean value" SWORD _CNV_A_R_LINEAR_____110_CM 1 100. -50. 49.9984741210938 DISPLAY_IDENTIFIER FAC_CYL_LAM[3] ECU_ADDRESS 0xd0004f0e FORMAT "%7.3" /end MEASUREMENT
/begin MEASUREMENT fac_cyl_lam[4] "output of the cylinder individual controller, shifted by its mean value" SWORD _CNV_A_R_LINEAR_____110_CM 1 100. -50. 49.9984741210938 DISPLAY_IDENTIFIER FAC_CYL_LAM[4] ECU_ADDRESS 0xd0004f10 FORMAT "%7.3" /end MEASUREMENT
/begin MEASUREMENT fac_cyl_lam[5] "output of the cylinder individual controller, shifted by its mean value" SWORD _CNV_A_R_LINEAR_____110_CM 1 100. -50. 49.9984741210938 DISPLAY_IDENTIFIER FAC_CYL_LAM[5] ECU_ADDRESS 0xd0004f12 FORMAT "%7.3" /end MEASUREMENT
/begin MEASUREMENT delta_lamb_err_cyl_sel[0] "weighted estimation error" SWORD _CNV_A_R_LINEAR_____112_CM 1 100. -8. 7.99975586 DISPLAY_IDENTIFIER DELTA_LAMB_ERR_CYL_SEL[0] ECU_ADDRESS 0xc0000314 FORMAT "%7.4" /end MEASUREMENT
/begin MEASUREMENT delta_lamb_err_cyl_sel[1] "weighted estimation error" SWORD _CNV_A_R_LINEAR_____112_CM 1 100. -8. 7.99975586 DISPLAY_IDENTIFIER DELTA_LAMB_ERR_CYL_SEL[1] ECU_ADDRESS 0xc0000316 FORMAT "%7.4" /end MEASUREMENT
/begin MEASUREMENT delta_lamb_err_cyl_sel[2] "weighted estimation error" SWORD _CNV_A_R_LINEAR_____112_CM 1 100. -8. 7.99975586 DISPLAY_IDENTIFIER DELTA_LAMB_ERR_CYL_SEL[2] ECU_ADDRESS 0xc0000318 FORMAT "%7.4" /end MEASUREMENT
/begin MEASUREMENT delta_lamb_err_cyl_sel[3] "weighted estimation error" SWORD _CNV_A_R_LINEAR_____112_CM 1 100. -8. 7.99975586 DISPLAY_IDENTIFIER DELTA_LAMB_ERR_CYL_SEL[3] ECU_ADDRESS 0xc000031a FORMAT "%7.4" /end MEASUREMENT
/begin MEASUREMENT delta_lamb_err_cyl_sel[4] "weighted estimation error" SWORD _CNV_A_R_LINEAR_____112_CM 1 100. -8. 7.99975586 DISPLAY_IDENTIFIER DELTA_LAMB_ERR_CYL_SEL[4] ECU_ADDRESS 0xc000031c FORMAT "%7.4" /end MEASUREMENT
/begin MEASUREMENT delta_lamb_err_cyl_sel[5] "weighted estimation error" SWORD _CNV_A_R_LINEAR_____112_CM 1 100. -8. 7.99975586 DISPLAY_IDENTIFIER DELTA_LAMB_ERR_CYL_SEL[5] ECU_ADDRESS 0xc000031e FORMAT "%7.4" /end MEASUREMENT
/begin MEASUREMENT delta_lamb_dif_cyl[0] "control error for each cylinder" SWORD _CNV_A_R_LINEAR_____11_CM 1 100. -8. 7.99975586 DISPLAY_IDENTIFIER DELTA_LAMB_DIF_CYL[0] ECU_ADDRESS 0xd0004efc FORMAT "%7.4" /end MEASUREMENT
/begin MEASUREMENT delta_lamb_dif_cyl[1] "control error for each cylinder" SWORD _CNV_A_R_LINEAR_____11_CM 1 100. -8. 7.99975586 DISPLAY_IDENTIFIER DELTA_LAMB_DIF_CYL[1] ECU_ADDRESS 0xd0004efe FORMAT "%7.4" /end MEASUREMENT
/begin MEASUREMENT delta_lamb_dif_cyl[2] "control error for each cylinder" SWORD _CNV_A_R_LINEAR_____11_CM 1 100. -8. 7.99975586 DISPLAY_IDENTIFIER DELTA_LAMB_DIF_CYL[2] ECU_ADDRESS 0xd0004f00 FORMAT "%7.4" /end MEASUREMENT
/begin MEASUREMENT delta_lamb_dif_cyl[3] "control error for each cylinder" SWORD _CNV_A_R_LINEAR_____11_CM 1 100. -8. 7.99975586 DISPLAY_IDENTIFIER DELTA_LAMB_DIF_CYL[3] ECU_ADDRESS 0xd0004f02 FORMAT "%7.4" /end MEASUREMENT
/begin MEASUREMENT delta_lamb_dif_cyl[4] "control error for each cylinder" SWORD _CNV_A_R_LINEAR_____11_CM 1 100. -8. 7.99975586 DISPLAY_IDENTIFIER DELTA_LAMB_DIF_CYL[4] ECU_ADDRESS 0xd0004f04 FORMAT "%7.4" /end MEASUREMENT
/begin MEASUREMENT delta_lamb_dif_cyl[5] "control error for each cylinder" SWORD _CNV_A_R_LINEAR_____11_CM 1 100. -8. 7.99975586 DISPLAY_IDENTIFIER DELTA_LAMB_DIF_CYL[5] ECU_ADDRESS 0xd0004f06 FORMAT "%7.4" /end MEASUREMENT
/begin MEASUREMENT vls_cyl_sel[0] "upstream oxygen sensor voltage (cylinder individual)" UWORD _CNV_A_R_LINEAR_____2_CM 1 100. 0. 4.9951171875 DISPLAY_IDENTIFIER VLS_CYL_SEL[0] ECU_ADDRESS 0xc0000338 FORMAT "%5.3" /end MEASUREMENT
/begin MEASUREMENT vls_cyl_sel[1] "upstream oxygen sensor voltage (cylinder individual)" UWORD _CNV_A_R_LINEAR_____2_CM 1 100. 0. 4.9951171875 DISPLAY_IDENTIFIER VLS_CYL_SEL[1] ECU_ADDRESS 0xc000033a FORMAT "%5.3" /end MEASUREMENT
/begin MEASUREMENT vls_cyl_sel[2] "upstream oxygen sensor voltage (cylinder individual)" UWORD _CNV_A_R_LINEAR_____2_CM 1 100. 0. 4.9951171875 DISPLAY_IDENTIFIER VLS_CYL_SEL[2] ECU_ADDRESS 0xc000033c FORMAT "%5.3" /end MEASUREMENT
/begin MEASUREMENT vls_cyl_sel[3] "upstream oxygen sensor voltage (cylinder individual)" UWORD _CNV_A_R_LINEAR_____2_CM 1 100. 0. 4.9951171875 DISPLAY_IDENTIFIER VLS_CYL_SEL[3] ECU_ADDRESS 0xc000033e FORMAT "%5.3" /end MEASUREMENT
/begin MEASUREMENT vls_cyl_sel[4] "upstream oxygen sensor voltage (cylinder individual)" UWORD _CNV_A_R_LINEAR_____2_CM 1 100. 0. 4.9951171875 DISPLAY_IDENTIFIER VLS_CYL_SEL[4] ECU_ADDRESS 0xc0000340 FORMAT "%5.3" /end MEASUREMENT
/begin MEASUREMENT vls_cyl_sel[5] "upstream oxygen sensor voltage (cylinder individual)" UWORD _CNV_A_R_LINEAR_____2_CM 1 100. 0. 4.9951171875 DISPLAY_IDENTIFIER VLS_CYL_SEL[5] ECU_ADDRESS 0xc0000342 FORMAT "%5.3" /end MEASUREMENT
/begin MEASUREMENT crk_cyl_lam[0] "value of phase displacement" UBYTE _CNV_A_R_LINEAR_____109_CM 1 100. 0. 1440. DISPLAY_IDENTIFIER CRK_CYL_LAM[0] ECU_ADDRESS 0xd0003b10 FORMAT "%4.0" /end MEASUREMENT
/begin MEASUREMENT crk_cyl_lam[1] "value of phase displacement" UBYTE _CNV_A_R_LINEAR_____109_CM 1 100. 0. 1440. DISPLAY_IDENTIFIER CRK_CYL_LAM[1] ECU_ADDRESS 0xd0003b11 FORMAT "%4.0" /end MEASUREMENT
/begin MEASUREMENT crk_cyl_lam[2] "value of phase displacement" UBYTE _CNV_A_R_LINEAR_____109_CM 1 100. 0. 1440. DISPLAY_IDENTIFIER CRK_CYL_LAM[2] ECU_ADDRESS 0xd0003b12 FORMAT "%4.0" /end MEASUREMENT
/begin MEASUREMENT crk_cyl_lam[3] "value of phase displacement" UBYTE _CNV_A_R_LINEAR_____109_CM 1 100. 0. 1440. DISPLAY_IDENTIFIER CRK_CYL_LAM[3] ECU_ADDRESS 0xd0003b13 FORMAT "%4.0" /end MEASUREMENT
/begin MEASUREMENT crk_cyl_lam[4] "value of phase displacement" UBYTE _CNV_A_R_LINEAR_____109_CM 1 100. 0. 1440. DISPLAY_IDENTIFIER CRK_CYL_LAM[4] ECU_ADDRESS 0xd0003b14 FORMAT "%4.0" /end MEASUREMENT
/begin MEASUREMENT crk_cyl_lam[5] "value of phase displacement" UBYTE _CNV_A_R_LINEAR_____109_CM 1 100. 0. 1440. DISPLAY_IDENTIFIER CRK_CYL_LAM[5] ECU_ADDRESS 0xd0003b15 FORMAT "%4.0" /end MEASUREMENT
/begin MEASUREMENT delta_lamb_cyl_sel_cq_1 "characteristic value of the estimated values" UWORD _CNV_A_R_LINEAR_____113_CM 1 100. 0. 7.9998779296875 DISPLAY_IDENTIFIER DELTA_LAMB_CYL_SEL_CQ_1 ECU_ADDRESS 0xd0004f44 FORMAT "%6.4" /end MEASUREMENT
/begin MEASUREMENT delta_lamb_cyl_sel_cq_2 "characteristic value of the estimated values" UWORD _CNV_A_R_LINEAR_____113_CM 1 100. 0. 7.9998779296875 DISPLAY_IDENTIFIER DELTA_LAMB_CYL_SEL_CQ_2 ECU_ADDRESS 0xd0004f46 FORMAT "%6.4" /end MEASUREMENT
/begin MEASUREMENT lv_lam_cyl_act_1 "cylinder individual lambda control is active" UBYTE _CNV_S_2_RANGE__0___1_CM 1 100. 0. 1. DISPLAY_IDENTIFIER LV_LAM_CYL_ACT_1 ECU_ADDRESS 0xd0003b1a BIT_MASK 0x1 /end MEASUREMENT
/begin MEASUREMENT lv_lam_cyl_act_2 "cylinder individual lambda control is active" UBYTE _CNV_S_2_RANGE__0___1_CM 1 100. 0. 1. DISPLAY_IDENTIFIER LV_LAM_CYL_ACT_2 ECU_ADDRESS 0xd0003b1b BIT_MASK 0x1 /end MEASUREMENT
/begin MEASUREMENT cyl_lam_1.delta_lamb_av "signal value of the WRAF sensor, sampled with an appropriate resolution and shifted by its mean value" SWORD _CNV_A_R_LINEAR_____11_CM 1 100. -8. 7.99975586 DISPLAY_IDENTIFIER DELTA_LAMB_AV_1 ECU_ADDRESS 0xc00002dc FORMAT "%7.4" /end MEASUREMENT
/begin MEASUREMENT cyl_lam_1.delta_lamb_mdl "estimated value of the WRAF sensor" SWORD _CNV_A_R_LINEAR_____11_CM 1 100. -8. 7.99975586 DISPLAY_IDENTIFIER DELTA_LAMB_MDL_1 ECU_ADDRESS 0xc00002de FORMAT "%7.4" /end MEASUREMENT
/begin MEASUREMENT cyl_lam_1.delta_lamb_err_raw "difference between the measured and the estimated value of the WRAF sensor" SWORD _CNV_A_R_LINEAR_____11_CM 1 100. -8. 7.99975586 DISPLAY_IDENTIFIER DELTA_LAMB_ERR_RAW_1 ECU_ADDRESS 0xc00002e0 FORMAT "%7.4" /end MEASUREMENT
/begin MEASUREMENT cyl_lam_1.delta_lamb_err "weighted estimation error" SWORD _CNV_A_R_LINEAR_____112_CM 1 100. -8. 7.99975586 DISPLAY_IDENTIFIER DELTA_LAMB_ERR_1 ECU_ADDRESS 0xc00002e2 FORMAT "%7.4" /end MEASUREMENT
/begin MEASUREMENT cyl_lam_1.delta_lamb_cyl_sel "reassembled signal, made of individual adjusted signals" SWORD _CNV_A_R_LINEAR_____11_CM 1 100. -8. 7.99975586 DISPLAY_IDENTIFIER DELTA_LAMB_CYL_SEL_1 ECU_ADDRESS 0xc00002e4 FORMAT "%7.4" /end MEASUREMENT
/begin MEASUREMENT cyl_lam_1.fac_t "time factor for the exponential function for the sensor model" UWORD _CNV_A_R_LINEAR_____114_CM 1 100. 0. 63.99902344 DISPLAY_IDENTIFIER FAC_T_1 ECU_ADDRESS 0xc00002e6 FORMAT "%7.4" /end MEASUREMENT
/begin MEASUREMENT cyl_lam_1.lv_lam_cyl_sel_seg_ref_cll "Segment based reference flag to close the control loop" UBYTE _CNV_S_2_RANGE__0___1_CM 1 100. 0. 1. DISPLAY_IDENTIFIER LV_LAM_CYL_SEL_SEG_REF_CLL_1 ECU_ADDRESS 0xc00002e8 BIT_MASK 0x1 /end MEASUREMENT
/begin MEASUREMENT cyl_lam_2.delta_lamb_av "signal value of the WRAF sensor, sampled with an appropriate resolution and shifted by its mean value" SWORD _CNV_A_R_LINEAR_____11_CM 1 100. -8. 7.99975586 DISPLAY_IDENTIFIER DELTA_LAMB_AV_2 ECU_ADDRESS 0xc00002ec FORMAT "%7.4" /end MEASUREMENT
/begin MEASUREMENT cyl_lam_2.delta_lamb_mdl "estimated value of the WRAF sensor" SWORD _CNV_A_R_LINEAR_____11_CM 1 100. -8. 7.99975586 DISPLAY_IDENTIFIER DELTA_LAMB_MDL_2 ECU_ADDRESS 0xc00002ee FORMAT "%7.4" /end MEASUREMENT
/begin MEASUREMENT cyl_lam_2.delta_lamb_err_raw "difference between the measured and the estimated value of the WRAF sensor" SWORD _CNV_A_R_LINEAR_____11_CM 1 100. -8. 7.99975586 DISPLAY_IDENTIFIER DELTA_LAMB_ERR_RAW_2 ECU_ADDRESS 0xc00002f0 FORMAT "%7.4" /end MEASUREMENT
/begin MEASUREMENT cyl_lam_2.delta_lamb_err "weighted estimation error" SWORD _CNV_A_R_LINEAR_____112_CM 1 100. -8. 7.99975586 DISPLAY_IDENTIFIER DELTA_LAMB_ERR_2 ECU_ADDRESS 0xc00002f2 FORMAT "%7.4" /end MEASUREMENT
/begin MEASUREMENT cyl_lam_2.delta_lamb_cyl_sel "reassembled signal, made of individual adjusted signals" SWORD _CNV_A_R_LINEAR_____11_CM 1 100. -8. 7.99975586 DISPLAY_IDENTIFIER DELTA_LAMB_CYL_SEL_2 ECU_ADDRESS 0xc00002f4 FORMAT "%7.4" /end MEASUREMENT
/begin MEASUREMENT cyl_lam_2.fac_t "time factor for the exponential function for the sensor model" UWORD _CNV_A_R_LINEAR_____114_CM 1 100. 0. 63.99902344 DISPLAY_IDENTIFIER FAC_T_2 ECU_ADDRESS 0xc00002f6 FORMAT "%7.4" /end MEASUREMENT
/begin MEASUREMENT cyl_lam_2.lv_lam_cyl_sel_seg_ref_cll "Segment based reference flag to close the control loop" UBYTE _CNV_S_2_RANGE__0___1_CM 1 100. 0. 1. DISPLAY_IDENTIFIER LV_LAM_CYL_SEL_SEG_REF_CLL_2 ECU_ADDRESS 0xc00002f8 BIT_MASK 0x1 /end MEASUREMENT
/begin CHARACTERISTIC c_cyl_lam_out_min "lower limit of the cylinder individual controller output" VALUE 0xa10292f2 _REC_VAL_20_s2 99.99847412109381 _CNV_A_R_LINEAR_____110_CM -50. 49.9984741210938 DISPLAY_IDENTIFIER C_CYL_LAM_OUT_MIN FORMAT "%7.3" /end CHARACTERISTIC
/begin CHARACTERISTIC c_cyl_lam_out_max "upper limit of the cylinder individual controller output" VALUE 0xa10292f0 _REC_VAL_20_s2 99.99847412109381 _CNV_A_R_LINEAR_____110_CM -50. 49.9984741210938 DISPLAY_IDENTIFIER C_CYL_LAM_OUT_MAX FORMAT "%7.3" /end CHARACTERISTIC
/begin CHARACTERISTIC c_cyl_lam_diag_min "lower diagnosis limit of the cylinder individual controller output" VALUE 0xa10292ee _REC_VAL_20_s2 99.99847412109381 _CNV_A_R_LINEAR_____110_CM -50. 49.9984741210938 DISPLAY_IDENTIFIER C_CYL_LAM_DIAG_MIN FORMAT "%7.3" /end CHARACTERISTIC
/begin CHARACTERISTIC c_delta_lamb_cyl_sp "setpoint value" VALUE 0xa10292fc _REC_VAL_20_s2 15.99975586 _CNV_A_R_LINEAR_____11_CM -8. 7.99975586 DISPLAY_IDENTIFIER C_DELTA_LAMB_CYL_SP FORMAT "%7.4" /end CHARACTERISTIC
/begin CHARACTERISTIC c_crlc_adj_fac "correlation constant for the adaptation" VALUE 0xa10291d3 _REC_VAL_20_u1 0.99609375 _CNV_A_R_LINEAR_____27_CM 0. 0.99609375 DISPLAY_IDENTIFIER C_CRLC_ADJ_FAC FORMAT "%5.3" /end CHARACTERISTIC
/begin CHARACTERISTIC c_crlc_exv_fac_0 "exhaust-valve manifold-port correlation factor" VALUE 0xa10291e4 _REC_VAL_20_u2 1.99996948242188 _CNV_A_R_LINEAR_____8_CM 0. 1.99996948242188 DISPLAY_IDENTIFIER C_CRLC_EXV_FAC_0 FORMAT "%7.5" /end CHARACTERISTIC
/begin CHARACTERISTIC c_crlc_exv_fac_1 "exhaust-valve manifold-port correlation factor" VALUE 0xa10291e6 _REC_VAL_20_u2 1.99996948242188 _CNV_A_R_LINEAR_____8_CM 0. 1.99996948242188 DISPLAY_IDENTIFIER C_CRLC_EXV_FAC_1 FORMAT "%7.5" /end CHARACTERISTIC
/begin CHARACTERISTIC c_crlc_exv_fac_2 "exhaust-valve manifold-port correlation factor" VALUE 0xa10291e8 _REC_VAL_20_u2 1.99996948242188 _CNV_A_R_LINEAR_____8_CM 0. 1.99996948242188 DISPLAY_IDENTIFIER C_CRLC_EXV_FAC_2 FORMAT "%7.5" /end CHARACTERISTIC
/begin CHARACTERISTIC c_crlc_exv_fac_3 "exhaust-valve manifold-port correlation factor" VALUE 0xa10291ea _REC_VAL_20_u2 1.99996948242188 _CNV_A_R_LINEAR_____8_CM 0. 1.99996948242188 DISPLAY_IDENTIFIER C_CRLC_EXV_FAC_3 FORMAT "%7.5" /end CHARACTERISTIC
/begin CHARACTERISTIC c_crlc_exv_fac_4 "exhaust-valve manifold-port correlation factor" VALUE 0xa10291ec _REC_VAL_20_u2 1.99996948242188 _CNV_A_R_LINEAR_____8_CM 0. 1.99996948242188 DISPLAY_IDENTIFIER C_CRLC_EXV_FAC_4 FORMAT "%7.5" /end CHARACTERISTIC
/begin CHARACTERISTIC c_crlc_exv_fac_5 "exhaust-valve manifold-port correlation factor" VALUE 0xa10291ee _REC_VAL_20_u2 1.99996948242188 _CNV_A_R_LINEAR_____8_CM 0. 1.99996948242188 DISPLAY_IDENTIFIER C_CRLC_EXV_FAC_5 FORMAT "%7.5" /end CHARACTERISTIC
/begin CHARACTERISTIC c_crlc_exv_fac_6 "exhaust-valve manifold-port correlation factor" VALUE 0xa10291f0 _REC_VAL_20_u2 1.99996948242188 _CNV_A_R_LINEAR_____8_CM 0. 1.99996948242188 DISPLAY_IDENTIFIER C_CRLC_EXV_FAC_6 FORMAT "%7.5" /end CHARACTERISTIC
/begin CHARACTERISTIC c_crlc_exv_fac_7 "exhaust-valve manifold-port correlation factor" VALUE 0xa10291f2 _REC_VAL_20_u2 1.99996948242188 _CNV_A_R_LINEAR_____8_CM 0. 1.99996948242188 DISPLAY_IDENTIFIER C_CRLC_EXV_FAC_7 FORMAT "%7.5" /end CHARACTERISTIC
/begin CHARACTERISTIC c_crk_cyl_lam_6 "factor for different distance between lambda sensor and cylinder individual exaust-valves" VALUE 0xa10291cf _REC_VAL_20_s1 1440. _CNV_A_R_LINEAR_____109_CM -720. 720. DISPLAY_IDENTIFIER C_CRK_CYL_LAM_6 FORMAT "%4.0" /end CHARACTERISTIC
/begin CHARACTERISTIC c_crk_cyl_lam_7 "factor for different distance between lambda sensor and cylinder individual exaust-valves" VALUE 0xa10291d0 _REC_VAL_20_s1 1440. _CNV_A_R_LINEAR_____109_CM -720. 720. DISPLAY_IDENTIFIER C_CRK_CYL_LAM_7 FORMAT "%4.0" /end CHARACTERISTIC
/begin AXIS_PTS ldp_vls_cyl_sel_ip_lamb_cyl_1 "" 0xa102179c online_dummy _REC_AXS_20_u2 4.9951171875 _CNV_A_R_LINEAR_____2_CM 16 0. 4.9951171875 FORMAT "%5.3" /end AXIS_PTS
/begin AXIS_PTS ldp_vls_cyl_sel_ip_lamb_cyl_2 "" 0xa10217c0 online_dummy _REC_AXS_20_u2 4.9951171875 _CNV_A_R_LINEAR_____2_CM 16 0. 4.9951171875 FORMAT "%5.3" /end AXIS_PTS
/begin AXIS_PTS ldpm_fac_t_2_1_cybl "" 0xa1021a54 online_dummy _REC_AXS_20_u2 63.99902344 _CNV_A_R_LINEAR_____114_CM 16 0. 63.99902344 FORMAT "%7.4" /end AXIS_PTS
/begin AXIS_PTS ldpm_n_1_cybl "" 0xa1021d08 n _REC_AXS_20_u2 8160. _CNV_A_R_LINEAR_____13_CM 8 0. 8160. FORMAT "%4.0" /end AXIS_PTS
/begin AXIS_PTS ldpm_maf_1_cybl "" 0xa1021b88 maf _REC_AXS_20_u2 1389. _CNV_A_R_LINEAR_____108_CM 8 0. 1389. FORMAT "%7.2" /end AXIS_PTS
/begin AXIS_PTS ldpm_n_32_1_cybl "" 0xa1021d78 n_32 _REC_AXS_20_u1 8160. _CNV_A_R_LINEAR_____9_CM 6 0. 8160. FORMAT "%4.0" /end AXIS_PTS
/begin CHARACTERISTIC ip_lamb_cyl_1 "characteristic curve of the WRAF sensor" CURVE 0xa1025f70 _REC_CUR_20_u2_u2 7.999755859375 _CNV_A_R_LINEAR_____115_CM 0. 7.999755859375 DISPLAY_IDENTIFIER IP_LAMB_CYL_1 FORMAT "%7.4"
 /begin AXIS_DESCR COM_AXIS online_dummy _CNV_A_R_LINEAR_____2_CM 16 0. 4.9951171875 FORMAT "%5.3" AXIS_PTS_REF ldp_vls_cyl_sel_ip_lamb_cyl_1 /end AXIS_DESCR
/end CHARACTERISTIC
/begin CHARACTERISTIC ip_lamb_cyl_2 "characteristic curve of the WRAF sensor" CURVE 0xa1025f90 _REC_CUR_20_u2_u2 7.999755859375 _CNV_A_R_LINEAR_____115_CM 0. 7.999755859375 DISPLAY_IDENTIFIER IP_LAMB_CYL_2 FORMAT "%7.4"
 /begin AXIS_DESCR COM_AXIS online_dummy _CNV_A_R_LINEAR_____2_CM 16 0. 4.9951171875 FORMAT "%5.3" AXIS_PTS_REF ldp_vls_cyl_sel_ip_lamb_cyl_2 /end AXIS_DESCR
/end CHARACTERISTIC
/begin CHARACTERISTIC ip_exp_lamb_mdl_1 "exponential function for the sensor model" CURVE 0xa102340c _REC_CUR_20_u2_u2 0.9999847412109381 _CNV_A_R_LINEAR_____68_CM 0. 0.9999847412109381 DISPLAY_IDENTIFIER IP_EXP_LAMB_MDL_1 FORMAT "%7.5"
 /begin AXIS_DESCR COM_AXIS online_dummy _CNV_A_R_LINEAR_____114_CM 16 0. 63.99902344 FORMAT "%7.4" AXIS_PTS_REF ldpm_fac_t_1_1_cybl /end AXIS_DESCR
/end CHARACTERISTIC
/begin CHARACTERISTIC ip_exp_lamb_mdl_2 "exponential function for the sensor model" CURVE 0xa102342c _REC_CUR_20_u2_u2 0.9999847412109381 _CNV_A_R_LINEAR_____68_CM 0. 0.9999847412109381 DISPLAY_IDENTIFIER IP_EXP_LAMB_MDL_2 FORMAT "%7.5"
 /begin AXIS_DESCR COM_AXIS online_dummy _CNV_A_R_LINEAR_____114_CM 16 0. 63.99902344 FORMAT "%7.4" AXIS_PTS_REF ldpm_fac_t_2_1_cybl /end AXIS_DESCR
/end CHARACTERISTIC
/begin CHARACTERISTIC ip_n1_fac_lamb_mdl_1 "N1 coefficient of the sensor model" CURVE 0xa10261c0 _REC_CUR_20_u2_u2 0.9999847412109381 _CNV_A_R_LINEAR_____68_CM 0. 0.9999847412109381 DISPLAY_IDENTIFIER IP_N1_FAC_LAMB_MDL_1 FORMAT "%7.5"
 /begin AXIS_DESCR COM_AXIS online_dummy _CNV_A_R_LINEAR_____114_CM 16 0. 63.99902344 FORMAT "%7.4" AXIS_PTS_REF ldpm_fac_t_1_1_cybl /end AXIS_DESCR
/end CHARACTERISTIC
/begin CHARACTERISTIC ip_n1_fac_lamb_mdl_2 "N1 coefficient of the sensor model" CURVE 0xa10261e0 _REC_CUR_20_u2_u2 0.9999847412109381 _CNV_A_R_LINEAR_____68_CM 0. 0.9999847412109381 DISPLAY_IDENTIFIER IP_N1_FAC_LAMB_MDL_2 FORMAT "%7.5"
 /begin AXIS_DESCR COM_AXIS online_dummy _CNV_A_R_LINEAR_____114_CM 16 0. 63.99902344 FORMAT "%7.4" AXIS_PTS_REF ldpm_fac_t_2_1_cybl /end AXIS_DESCR
/end CHARACTERISTIC
/begin CHARACTERISTIC ip_n2_fac_lamb_mdl_2 "N2 coefficient of the sensor model" CURVE 0xa1026220 _REC_CUR_20_u2_u2 0.9999847412109381 _CNV_A_R_LINEAR_____68_CM 0. 0.9999847412109381 DISPLAY_IDENTIFIER IP_N2_FAC_LAMB_MDL_2 FORMAT "%7.5"
 /begin AXIS_DESCR COM_AXIS online_dummy _CNV_A_R_LINEAR_____114_CM 16 0. 63.99902344 FORMAT "%7.4" AXIS_PTS_REF ldpm_fac_t_2_1_cybl /end AXIS_DESCR
/end CHARACTERISTIC
/begin CHARACTERISTIC ip_crk_syn_1 "phase displacement" MAP 0xa1023090 _REC_MAP_20_u1_u2_u2 1440. _CNV_A_R_LINEAR_____109_CM 0. 1440. DISPLAY_IDENTIFIER IP_CRK_SYN_1 FORMAT "%4.0"
 /begin AXIS_DESCR COM_AXIS n _CNV_A_R_LINEAR_____13_CM 8 0. 8160. FORMAT "%4.0" AXIS_PTS_REF ldpm_n_1_cybl /end AXIS_DESCR
 /begin AXIS_DESCR COM_AXIS maf _CNV_A_R_LINEAR_____108_CM 8 0. 1389. FORMAT "%7.2" AXIS_PTS_REF ldpm_maf_1_cybl /end AXIS_DESCR
/end CHARACTERISTIC
/begin CHARACTERISTIC ip_crk_syn_2 "phase displacement" MAP 0xa10230d0 _REC_MAP_20_u1_u2_u2 1440. _CNV_A_R_LINEAR_____109_CM 0. 1440. DISPLAY_IDENTIFIER IP_CRK_SYN_2 FORMAT "%4.0"
 /begin AXIS_DESCR COM_AXIS n _CNV_A_R_LINEAR_____13_CM 8 0. 8160. FORMAT "%4.0" AXIS_PTS_REF ldpm_n_1_cybl /end AXIS_DESCR
 /begin AXIS_DESCR COM_AXIS maf _CNV_A_R_LINEAR_____108_CM 8 0. 1389. FORMAT "%7.2" AXIS_PTS_REF ldpm_maf_1_cybl /end AXIS_DESCR
/end CHARACTERISTIC
/begin CHARACTERISTIC ip_fac_err_lam_sel "weight coefficient" CURVE 0xa1023934 _REC_CUR_20_u2_u2 255.99609375 _CNV_A_R_LINEAR_____116_CM 0. 255.99609375 DISPLAY_IDENTIFIER IP_FAC_ERR_LAM_SEL FORMAT "%7.4"
 /begin AXIS_DESCR COM_AXIS online_dummy _CNV_A_R_LINEAR_____117_CM 6 0. 1.99996948242188 FORMAT "%7.5" AXIS_PTS_REF ldp_t1_lamb_cyl_i_ip_fac_err /end AXIS_DESCR
/end CHARACTERISTIC
/begin CHARACTERISTIC ip_crlc_cyl_lam "correlation characteristic for AFR equalisation" MAP 0xa1023110 _REC_MAP_20_u2_u2_u2 1.99997 _CNV_A_R_LINEAR_____118_CM 0. 1.99997 DISPLAY_IDENTIFIER IP_CRLC_CYL_LAM FORMAT "%7.5"
 /begin AXIS_DESCR COM_AXIS n _CNV_A_R_LINEAR_____13_CM 8 0. 8160. FORMAT "%4.0" AXIS_PTS_REF ldpm_n_1_cybl /end AXIS_DESCR
 /begin AXIS_DESCR COM_AXIS maf _CNV_A_R_LINEAR_____108_CM 8 0. 1389. FORMAT "%7.2" AXIS_PTS_REF ldpm_maf_1_cybl /end AXIS_DESCR
/end CHARACTERISTIC
/begin CHARACTERISTIC ip_t1_lamb_cyl_sel_1 "time lag of the lambda sensor model specified for cylinder individual lambda control" MAP 0xa10277e0 _REC_MAP_20_u2_u2_u2 1.99996948242188 _CNV_A_R_LINEAR_____117_CM 0. 1.99996948242188 DISPLAY_IDENTIFIER IP_T1_LAMB_CYL_SEL_1 FORMAT "%7.5"
 /begin AXIS_DESCR COM_AXIS n _CNV_A_R_LINEAR_____13_CM 8 0. 8160. FORMAT "%4.0" AXIS_PTS_REF ldpm_n_1_cybl /end AXIS_DESCR
 /begin AXIS_DESCR COM_AXIS maf _CNV_A_R_LINEAR_____108_CM 8 0. 1389. FORMAT "%7.2" AXIS_PTS_REF ldpm_maf_1_cybl /end AXIS_DESCR
/end CHARACTERISTIC
/begin CHARACTERISTIC ip_t1_lamb_cyl_sel_2 "time lag of the lambda sensor model specified for cylinder individual lambda control" MAP 0xa1027860 _REC_MAP_20_u2_u2_u2 1.99996948242188 _CNV_A_R_LINEAR_____117_CM 0. 1.99996948242188 DISPLAY_IDENTIFIER IP_T1_LAMB_CYL_SEL_2 FORMAT "%7.5"
 /begin AXIS_DESCR COM_AXIS n _CNV_A_R_LINEAR_____13_CM 8 0. 8160. FORMAT "%4.0" AXIS_PTS_REF ldpm_n_1_cybl /end AXIS_DESCR
 /begin AXIS_DESCR COM_AXIS maf _CNV_A_R_LINEAR_____108_CM 8 0. 1389. FORMAT "%7.2" AXIS_PTS_REF ldpm_maf_1_cybl /end AXIS_DESCR
/end CHARACTERISTIC
/begin MEASUREMENT lv_cyl_lam_lim_max_0 "status detection of upper limit outrun" UBYTE _CNV_S_2_RANGE__0___1_CM 1 100. 0. 1. DISPLAY_IDENTIFIER LV_CYL_LAM_LIM_MAX_0 ECU_ADDRESS 0xd0003b1f BIT_MASK 0x1 /end MEASUREMENT
/begin MEASUREMENT lv_cyl_lam_lim_max_1 "status detection of upper limit outrun" UBYTE _CNV_S_2_RANGE__0___1_CM 1 100. 0. 1. DISPLAY_IDENTIFIER LV_CYL_LAM_LIM_MAX_1 ECU_ADDRESS 0xd0003b20 BIT_MASK 0x1 /end MEASUREMENT
/begin MEASUREMENT lv_cyl_lam_lim_max_2 "status detection of upper limit outrun" UBYTE _CNV_S_2_RANGE__0___1_CM 1 100. 0. 1. DISPLAY_IDENTIFIER LV_CYL_LAM_LIM_MAX_2 ECU_ADDRESS 0xd0003b21 BIT_MASK 0x1 /end MEASUREMENT
/begin MEASUREMENT lv_cyl_lam_lim_max_3 "status detection of upper limit outrun" UBYTE _CNV_S_2_RANGE__0___1_CM 1 100. 0. 1. DISPLAY_IDENTIFIER LV_CYL_LAM_LIM_MAX_3 ECU_ADDRESS 0xd0003b29 BIT_MASK 0x1 /end MEASUREMENT
/begin MEASUREMENT lv_cyl_lam_lim_max_4 "status detection of upper limit outrun" UBYTE _CNV_S_2_RANGE__0___1_CM 1 100. 0. 1. DISPLAY_IDENTIFIER LV_CYL_LAM_LIM_MAX_4 ECU_ADDRESS 0xd0003b2d BIT_MASK 0x1 /end MEASUREMENT
/begin MEASUREMENT lv_cyl_lam_lim_max_5 "status detection of upper limit outrun" UBYTE _CNV_S_2_RANGE__0___1_CM 1 100. 0. 1. DISPLAY_IDENTIFIER LV_CYL_LAM_LIM_MAX_5 ECU_ADDRESS 0xd0003b31 BIT_MASK 0x1 /end MEASUREMENT
/begin MEASUREMENT lv_cyl_lam_lim_min_0 "status detection of lower limit outrun" UBYTE _CNV_S_2_RANGE__0___1_CM 1 100. 0. 1. DISPLAY_IDENTIFIER LV_CYL_LAM_LIM_MIN_0 ECU_ADDRESS 0xd0003b1c BIT_MASK 0x1 /end MEASUREMENT
/begin MEASUREMENT lv_cyl_lam_lim_min_1 "status detection of lower limit outrun" UBYTE _CNV_S_2_RANGE__0___1_CM 1 100. 0. 1. DISPLAY_IDENTIFIER LV_CYL_LAM_LIM_MIN_1 ECU_ADDRESS 0xd0003b1d BIT_MASK 0x1 /end MEASUREMENT
/begin MEASUREMENT lv_cyl_lam_lim_min_2 "status detection of lower limit outrun" UBYTE _CNV_S_2_RANGE__0___1_CM 1 100. 0. 1. DISPLAY_IDENTIFIER LV_CYL_LAM_LIM_MIN_2 ECU_ADDRESS 0xd0003b1e BIT_MASK 0x1 /end MEASUREMENT
/begin MEASUREMENT lv_cyl_lam_lim_min_3 "status detection of lower limit outrun" UBYTE _CNV_S_2_RANGE__0___1_CM 1 100. 0. 1. DISPLAY_IDENTIFIER LV_CYL_LAM_LIM_MIN_3 ECU_ADDRESS 0xd0003b28 BIT_MASK 0x1 /end MEASUREMENT
/begin MEASUREMENT lv_cyl_lam_lim_min_4 "status detection of lower limit outrun" UBYTE _CNV_S_2_RANGE__0___1_CM 1 100. 0. 1. DISPLAY_IDENTIFIER LV_CYL_LAM_LIM_MIN_4 ECU_ADDRESS 0xd0003b2c BIT_MASK 0x1 /end MEASUREMENT
/begin MEASUREMENT lv_cyl_lam_lim_min_5 "status detection of lower limit outrun" UBYTE _CNV_S_2_RANGE__0___1_CM 1 100. 0. 1. DISPLAY_IDENTIFIER LV_CYL_LAM_LIM_MIN_5 ECU_ADDRESS 0xd0003b30 BIT_MASK 0x1 /end MEASUREMENT
/begin MEASUREMENT lv_cyl_lam_diag_lim_max_0 "diagnosis status detection of upper limit outrun" UBYTE _CNV_S_2_RANGE__0___1_CM 1 100. 0. 1. DISPLAY_IDENTIFIER LV_CYL_LAM_DIAG_LIM_MAX_0 ECU_ADDRESS 0xd0003b25 BIT_MASK 0x1 /end MEASUREMENT
/begin MEASUREMENT lv_cyl_lam_diag_lim_max_1 "diagnosis status detection of upper limit outrun" UBYTE _CNV_S_2_RANGE__0___1_CM 1 100. 0. 1. DISPLAY_IDENTIFIER LV_CYL_LAM_DIAG_LIM_MAX_1 ECU_ADDRESS 0xd0003b26 BIT_MASK 0x1 /end MEASUREMENT
/begin MEASUREMENT lv_cyl_lam_diag_lim_max_2 "diagnosis status detection of upper limit outrun" UBYTE _CNV_S_2_RANGE__0___1_CM 1 100. 0. 1. DISPLAY_IDENTIFIER LV_CYL_LAM_DIAG_LIM_MAX_2 ECU_ADDRESS 0xd0003b27 BIT_MASK 0x1 /end MEASUREMENT
/begin MEASUREMENT lv_cyl_lam_diag_lim_max_3 "diagnosis status detection of upper limit outrun" UBYTE _CNV_S_2_RANGE__0___1_CM 1 100. 0. 1. DISPLAY_IDENTIFIER LV_CYL_LAM_DIAG_LIM_MAX_3 ECU_ADDRESS 0xd0003b2b BIT_MASK 0x1 /end MEASUREMENT
/begin MEASUREMENT lv_cyl_lam_diag_lim_max_4 "diagnosis status detection of upper limit outrun" UBYTE _CNV_S_2_RANGE__0___1_CM 1 100. 0. 1. DISPLAY_IDENTIFIER LV_CYL_LAM_DIAG_LIM_MAX_4 ECU_ADDRESS 0xd0003b2f BIT_MASK 0x1 /end MEASUREMENT
/begin MEASUREMENT lv_cyl_lam_diag_lim_max_5 "diagnosis status detection of upper limit outrun" UBYTE _CNV_S_2_RANGE__0___1_CM 1 100. 0. 1. DISPLAY_IDENTIFIER LV_CYL_LAM_DIAG_LIM_MAX_5 ECU_ADDRESS 0xd0003b33 BIT_MASK 0x1 /end MEASUREMENT
/begin MEASUREMENT lv_cyl_lam_diag_lim_min_0 "diagnosis status detection of lower limit outrun" UBYTE _CNV_S_2_RANGE__0___1_CM 1 100. 0. 1. DISPLAY_IDENTIFIER LV_CYL_LAM_DIAG_LIM_MIN_0 ECU_ADDRESS 0xd0003b22 BIT_MASK 0x1 /end MEASUREMENT
/begin MEASUREMENT lv_cyl_lam_diag_lim_min_1 "diagnosis status detection of lower limit outrun" UBYTE _CNV_S_2_RANGE__0___1_CM 1 100. 0. 1. DISPLAY_IDENTIFIER LV_CYL_LAM_DIAG_LIM_MIN_1 ECU_ADDRESS 0xd0003b23 BIT_MASK 0x1 /end MEASUREMENT
/begin MEASUREMENT lv_cyl_lam_diag_lim_min_2 "diagnosis status detection of lower limit outrun" UBYTE _CNV_S_2_RANGE__0___1_CM 1 100. 0. 1. DISPLAY_IDENTIFIER LV_CYL_LAM_DIAG_LIM_MIN_2 ECU_ADDRESS 0xd0003b24 BIT_MASK 0x1 /end MEASUREMENT
/begin MEASUREMENT lv_cyl_lam_diag_lim_min_3 "diagnosis status detection of lower limit outrun" UBYTE _CNV_S_2_RANGE__0___1_CM 1 100. 0. 1. DISPLAY_IDENTIFIER LV_CYL_LAM_DIAG_LIM_MIN_3 ECU_ADDRESS 0xd0003b2a BIT_MASK 0x1 /end MEASUREMENT
/begin MEASUREMENT lv_cyl_lam_diag_lim_min_4 "diagnosis status detection of lower limit outrun" UBYTE _CNV_S_2_RANGE__0___1_CM 1 100. 0. 1. DISPLAY_IDENTIFIER LV_CYL_LAM_DIAG_LIM_MIN_4 ECU_ADDRESS 0xd0003b2e BIT_MASK 0x1 /end MEASUREMENT
/begin MEASUREMENT lv_cyl_lam_diag_lim_min_5 "diagnosis status detection of lower limit outrun" UBYTE _CNV_S_2_RANGE__0___1_CM 1 100. 0. 1. DISPLAY_IDENTIFIER LV_CYL_LAM_DIAG_LIM_MIN_5 ECU_ADDRESS 0xd0003b32 BIT_MASK 0x1 /end MEASUREMENT
/begin CHARACTERISTIC c_cyl_lam_diag_max "upper diagnosis limit of the cylinder individual controller output" VALUE 0xa10292ec _REC_VAL_20_s2 99.99847412109381 _CNV_A_R_LINEAR_____110_CM -50. 49.9984741210938 DISPLAY_IDENTIFIER C_CYL_LAM_DIAG_MAX FORMAT "%7.3" /end CHARACTERISTIC
/begin CHARACTERISTIC c_ti_cyl_lam_absv_dec "absolute dectrement constant to increase or decrease the cylinder individual injection correction" VALUE 0xa1029a3c _REC_VAL_20_u2 49.99847412 _CNV_A_R_LINEAR_____119_CM 0. 49.99847412 DISPLAY_IDENTIFIER C_TI_CYL_LAM_ABSV_DEC /end CHARACTERISTIC
/begin CHARACTERISTIC lc_adapt_cor_out "adaptation switch" VALUE 0xa1029d05 _REC_VAL_20_u1 1. _CNV_A_R_LINEAR_____0_CM 0. 1. DISPLAY_IDENTIFIER LC_ADAPT_COR_OUT FORMAT "%1.0" /end CHARACTERISTIC
/begin AXIS_PTS ldp_t1_lamb_cyl_i_ip_fac_err "" 0xa1021168 online_dummy _REC_AXS_20_u2 1.99996948242188 _CNV_A_R_LINEAR_____117_CM 6 0. 1.99996948242188 FORMAT "%7.5" /end AXIS_PTS
/begin MEASUREMENT state_lam_cyl_sel_2 "state of cylinder individual lambda control" UBYTE _CNV_S_4_RANGE_STAT_120_CM 1 100. 0. 3. DISPLAY_IDENTIFIER STATE_LAM_CYL_SEL_2 ECU_ADDRESS 0xd0003b18 /end MEASUREMENT
/begin MEASUREMENT fac_lam_cyl_sel_adj[0] "adaptive correction factor" SWORD _CNV_A_R_LINEAR_____110_CM 1 100. -50. 49.9984741210938 DISPLAY_IDENTIFIER FAC_LAM_CYL_SEL_ADJ[0] ECU_ADDRESS 0xd0004f2c FORMAT "%7.3" /end MEASUREMENT
/begin MEASUREMENT fac_lam_cyl_sel_adj[1] "adaptive correction factor" SWORD _CNV_A_R_LINEAR_____110_CM 1 100. -50. 49.9984741210938 DISPLAY_IDENTIFIER FAC_LAM_CYL_SEL_ADJ[1] ECU_ADDRESS 0xd0004f2e FORMAT "%7.3" /end MEASUREMENT
/begin MEASUREMENT fac_lam_cyl_sel_adj[2] "adaptive correction factor" SWORD _CNV_A_R_LINEAR_____110_CM 1 100. -50. 49.9984741210938 DISPLAY_IDENTIFIER FAC_LAM_CYL_SEL_ADJ[2] ECU_ADDRESS 0xd0004f30 FORMAT "%7.3" /end MEASUREMENT
/begin MEASUREMENT fac_lam_cyl_sel_adj[3] "adaptive correction factor" SWORD _CNV_A_R_LINEAR_____110_CM 1 100. -50. 49.9984741210938 DISPLAY_IDENTIFIER FAC_LAM_CYL_SEL_ADJ[3] ECU_ADDRESS 0xd0004f32 FORMAT "%7.3" /end MEASUREMENT
/begin MEASUREMENT fac_lam_cyl_sel_adj[4] "adaptive correction factor" SWORD _CNV_A_R_LINEAR_____110_CM 1 100. -50. 49.9984741210938 DISPLAY_IDENTIFIER FAC_LAM_CYL_SEL_ADJ[4] ECU_ADDRESS 0xd0004f34 FORMAT "%7.3" /end MEASUREMENT
/begin MEASUREMENT fac_lam_cyl_sel_adj[5] "adaptive correction factor" SWORD _CNV_A_R_LINEAR_____110_CM 1 100. -50. 49.9984741210938 DISPLAY_IDENTIFIER FAC_LAM_CYL_SEL_ADJ[5] ECU_ADDRESS 0xd0004f36 FORMAT "%7.3" /end MEASUREMENT
/begin MEASUREMENT fac_lam_cyl_sel_adj_cst[0] "adaptive correction factor under engine-cold condition" SWORD _CNV_A_R_LINEAR_____110_CM 1 100. -50. 49.9984741210938 DISPLAY_IDENTIFIER FAC_LAM_CYL_SEL_ADJ_CST[0] ECU_ADDRESS 0xd0004f38 FORMAT "%7.3" /end MEASUREMENT
/begin MEASUREMENT fac_lam_cyl_sel_adj_cst[1] "adaptive correction factor under engine-cold condition" SWORD _CNV_A_R_LINEAR_____110_CM 1 100. -50. 49.9984741210938 DISPLAY_IDENTIFIER FAC_LAM_CYL_SEL_ADJ_CST[1] ECU_ADDRESS 0xd0004f3a FORMAT "%7.3" /end MEASUREMENT
/begin MEASUREMENT fac_lam_cyl_sel_adj_cst[2] "adaptive correction factor under engine-cold condition" SWORD _CNV_A_R_LINEAR_____110_CM 1 100. -50. 49.9984741210938 DISPLAY_IDENTIFIER FAC_LAM_CYL_SEL_ADJ_CST[2] ECU_ADDRESS 0xd0004f3c FORMAT "%7.3" /end MEASUREMENT
/begin MEASUREMENT fac_lam_cyl_sel_adj_cst[3] "adaptive correction factor under engine-cold condition" SWORD _CNV_A_R_LINEAR_____110_CM 1 100. -50. 49.9984741210938 DISPLAY_IDENTIFIER FAC_LAM_CYL_SEL_ADJ_CST[3] ECU_ADDRESS 0xd0004f3e FORMAT "%7.3" /end MEASUREMENT
/begin MEASUREMENT fac_lam_cyl_sel_adj_cst[4] "adaptive correction factor under engine-cold condition" SWORD _CNV_A_R_LINEAR_____110_CM 1 100. -50. 49.9984741210938 DISPLAY_IDENTIFIER FAC_LAM_CYL_SEL_ADJ_CST[4] ECU_ADDRESS 0xd0004f40 FORMAT "%7.3" /end MEASUREMENT
/begin MEASUREMENT fac_lam_cyl_sel_adj_cst[5] "adaptive correction factor under engine-cold condition" SWORD _CNV_A_R_LINEAR_____110_CM 1 100. -50. 49.9984741210938 DISPLAY_IDENTIFIER FAC_LAM_CYL_SEL_ADJ_CST[5] ECU_ADDRESS 0xd0004f42 FORMAT "%7.3" /end MEASUREMENT
/begin MEASUREMENT fac_lam_cyl_sel_adj_fil[0] "adaptation filter output" SWORD _CNV_A_R_LINEAR_____110_CM 1 100. -50. 49.9984741210938 DISPLAY_IDENTIFIER FAC_LAM_CYL_SEL_ADJ_FIL[0] ECU_ADDRESS 0xc0000360 FORMAT "%7.3" /end MEASUREMENT
/begin MEASUREMENT fac_lam_cyl_sel_adj_fil[1] "adaptation filter output" SWORD _CNV_A_R_LINEAR_____110_CM 1 100. -50. 49.9984741210938 DISPLAY_IDENTIFIER FAC_LAM_CYL_SEL_ADJ_FIL[1] ECU_ADDRESS 0xc0000362 FORMAT "%7.3" /end MEASUREMENT
/begin MEASUREMENT fac_lam_cyl_sel_adj_fil[2] "adaptation filter output" SWORD _CNV_A_R_LINEAR_____110_CM 1 100. -50. 49.9984741210938 DISPLAY_IDENTIFIER FAC_LAM_CYL_SEL_ADJ_FIL[2] ECU_ADDRESS 0xc0000364 FORMAT "%7.3" /end MEASUREMENT
/begin MEASUREMENT fac_lam_cyl_sel_adj_fil[3] "adaptation filter output" SWORD _CNV_A_R_LINEAR_____110_CM 1 100. -50. 49.9984741210938 DISPLAY_IDENTIFIER FAC_LAM_CYL_SEL_ADJ_FIL[3] ECU_ADDRESS 0xc0000366 FORMAT "%7.3" /end MEASUREMENT
/begin MEASUREMENT fac_lam_cyl_sel_adj_fil[4] "adaptation filter output" SWORD _CNV_A_R_LINEAR_____110_CM 1 100. -50. 49.9984741210938 DISPLAY_IDENTIFIER FAC_LAM_CYL_SEL_ADJ_FIL[4] ECU_ADDRESS 0xc0000368 FORMAT "%7.3" /end MEASUREMENT
/begin MEASUREMENT fac_lam_cyl_sel_adj_fil[5] "adaptation filter output" SWORD _CNV_A_R_LINEAR_____110_CM 1 100. -50. 49.9984741210938 DISPLAY_IDENTIFIER FAC_LAM_CYL_SEL_ADJ_FIL[5] ECU_ADDRESS 0xc000036a FORMAT "%7.3" /end MEASUREMENT
/begin MEASUREMENT fac_lam_cyl_sel_adj_cst_fil[0] "adaptation filter output under engine-cold condition" SWORD _CNV_A_R_LINEAR_____110_CM 1 100. -50. 49.9984741210938 DISPLAY_IDENTIFIER FAC_LAM_CYL_SEL_ADJ_CST_FIL[0] ECU_ADDRESS 0xc000036c FORMAT "%7.3" /end MEASUREMENT
/begin MEASUREMENT fac_lam_cyl_sel_adj_cst_fil[1] "adaptation filter output under engine-cold condition" SWORD _CNV_A_R_LINEAR_____110_CM 1 100. -50. 49.9984741210938 DISPLAY_IDENTIFIER FAC_LAM_CYL_SEL_ADJ_CST_FIL[1] ECU_ADDRESS 0xc000036e FORMAT "%7.3" /end MEASUREMENT
/begin MEASUREMENT fac_lam_cyl_sel_adj_cst_fil[2] "adaptation filter output under engine-cold condition" SWORD _CNV_A_R_LINEAR_____110_CM 1 100. -50. 49.9984741210938 DISPLAY_IDENTIFIER FAC_LAM_CYL_SEL_ADJ_CST_FIL[2] ECU_ADDRESS 0xc0000370 FORMAT "%7.3" /end MEASUREMENT
/begin MEASUREMENT fac_lam_cyl_sel_adj_cst_fil[3] "adaptation filter output under engine-cold condition" SWORD _CNV_A_R_LINEAR_____110_CM 1 100. -50. 49.9984741210938 DISPLAY_IDENTIFIER FAC_LAM_CYL_SEL_ADJ_CST_FIL[3] ECU_ADDRESS 0xc0000372 FORMAT "%7.3" /end MEASUREMENT
/begin MEASUREMENT fac_lam_cyl_sel_adj_cst_fil[4] "adaptation filter output under engine-cold condition" SWORD _CNV_A_R_LINEAR_____110_CM 1 100. -50. 49.9984741210938 DISPLAY_IDENTIFIER FAC_LAM_CYL_SEL_ADJ_CST_FIL[4] ECU_ADDRESS 0xc0000374 FORMAT "%7.3" /end MEASUREMENT
/begin MEASUREMENT fac_lam_cyl_sel_adj_cst_fil[5] "adaptation filter output under engine-cold condition" SWORD _CNV_A_R_LINEAR_____110_CM 1 100. -50. 49.9984741210938 DISPLAY_IDENTIFIER FAC_LAM_CYL_SEL_ADJ_CST_FIL[5] ECU_ADDRESS 0xc0000376 FORMAT "%7.3" /end MEASUREMENT
/begin MEASUREMENT state_lam_cyl_sel_1 "state of cylinder individual lambda control" UBYTE _CNV_S_4_RANGE_STAT_120_CM 1 100. 0. 3. DISPLAY_IDENTIFIER STATE_LAM_CYL_SEL_1 ECU_ADDRESS 0xd0003b16 /end MEASUREMENT
/begin MEASUREMENT state_lam_cyl_sel_adj_2 "state of cylinder individual lambda control adaptation" UBYTE _CNV_S_5_RANGE_STAT_121_CM 1 100. 0. 4. DISPLAY_IDENTIFIER STATE_LAM_CYL_SEL_ADJ_2 ECU_ADDRESS 0xd0003b19 /end MEASUREMENT
/begin CHARACTERISTIC c_t_lam_cyl_adj "time recurrence for adaptation update" VALUE 0xa10298ad _REC_VAL_20_u1 255. _CNV_A_R_LINEAR_____35_CM 0. 255. DISPLAY_IDENTIFIER C_T_LAM_CYL_ADJ FORMAT "%3.0" /end CHARACTERISTIC
/begin CHARACTERISTIC c_t_lam_cyl_adj_cst "time recurrence for adaptation update under engine cold condition" VALUE 0xa10298ae _REC_VAL_20_u1 255. _CNV_A_R_LINEAR_____35_CM 0. 255. DISPLAY_IDENTIFIER C_T_LAM_CYL_ADJ_CST FORMAT "%3.0" /end CHARACTERISTIC
/begin CHARACTERISTIC c_tco_lam_cyl_min "Minimum coolant temperature for the activation - nominal condition" VALUE 0xa10299d0 _REC_VAL_20_u1 190.5 _CNV_A_R_LINEAR_____16_CM -48. 142.5 DISPLAY_IDENTIFIER C_TCO_LAM_CYL_MIN FORMAT "%6.2" /end CHARACTERISTIC
/begin CHARACTERISTIC c_tco_lam_cyl_cst_min "Minimum coolant temperature for the activation of CILC under cold condition" VALUE 0xa10299cf _REC_VAL_20_u1 190.5 _CNV_A_R_LINEAR_____16_CM -48. 142.5 DISPLAY_IDENTIFIER C_TCO_LAM_CYL_CST_MIN FORMAT "%6.2" /end CHARACTERISTIC
/begin CHARACTERISTIC c_tco_lam_cyl_cst_max "Maximum coolant temperature for the activation of CILC under cold condition" VALUE 0xa10299ce _REC_VAL_20_u1 190.5 _CNV_A_R_LINEAR_____16_CM -48. 142.5 DISPLAY_IDENTIFIER C_TCO_LAM_CYL_CST_MAX FORMAT "%6.2" /end CHARACTERISTIC
/begin CHARACTERISTIC c_crlc_cyl_fil "correlation constant for the filter output" VALUE 0xa10291dc _REC_VAL_20_u2 0.9999847412109381 _CNV_A_R_LINEAR_____68_CM 0. 0.9999847412109381 DISPLAY_IDENTIFIER C_CRLC_CYL_FIL FORMAT "%7.5" /end CHARACTERISTIC
/begin CHARACTERISTIC c_crlc_adj_fac_cst "Correlation constant for the adaptation under engine cold condition" VALUE 0xa10291d4 _REC_VAL_20_u1 0.99609375 _CNV_A_R_LINEAR_____27_CM 0. 0.99609375 DISPLAY_IDENTIFIER C_CRLC_ADJ_FAC_CST FORMAT "%5.3" /end CHARACTERISTIC
/begin CHARACTERISTIC c_crlc_lam_cyl_cst_fil "Correlation constant for the filter output under engine cold condition" VALUE 0xa1029202 _REC_VAL_20_u2 0.9999847412109381 _CNV_A_R_LINEAR_____68_CM 0. 0.9999847412109381 DISPLAY_IDENTIFIER C_CRLC_LAM_CYL_CST_FIL FORMAT "%7.5" /end CHARACTERISTIC
/begin CHARACTERISTIC lc_lam_cyl_sel_opl "switch for open loop operation" VALUE 0xa1029d71 _REC_VAL_20_u1 1. _CNV_A_R_LINEAR_____0_CM 0. 1. DISPLAY_IDENTIFIER LC_LAM_CYL_SEL_OPL FORMAT "%1.0" /end CHARACTERISTIC
/begin CHARACTERISTIC lc_fac_lam_cyl_sel_adj_cst_ena "Switch enabling the adaptation under engine cold condition ( =1)" VALUE 0xa1029d35 _REC_VAL_20_u1 1. _CNV_A_R_LINEAR_____0_CM 0. 1. DISPLAY_IDENTIFIER LC_FAC_LAM_CYL_SEL_ADJ_CST_ENA FORMAT "%1.0" /end CHARACTERISTIC
/begin CHARACTERISTIC ip_maf_lam_cyl_sel_adj_fac_min "min. threshold for calculation of cylinder individual lambda adaptation" CURVE 0xa1026140 _REC_CUR_20_u2_u1 1389. _CNV_A_R_LINEAR_____108_CM 0. 1389. DISPLAY_IDENTIFIER IP_MAF_LAM_CYL_SEL_ADJ_FAC_MIN FORMAT "%7.2"
 /begin AXIS_DESCR COM_AXIS n_32 _CNV_A_R_LINEAR_____9_CM 6 0. 8160. FORMAT "%4.0" AXIS_PTS_REF ldpm_n_32_1_cybl /end AXIS_DESCR
/end CHARACTERISTIC
/begin CHARACTERISTIC ip_maf_lam_cyl_sel_adj_cst_min "min. threshold for calculation of cylinder individual lambda adaptation under engine cold condition" CURVE 0xa1026128 _REC_CUR_20_u2_u1 1389. _CNV_A_R_LINEAR_____108_CM 0. 1389. DISPLAY_IDENTIFIER IP_MAF_LAM_CYL_SEL_ADJ_CST_MIN FORMAT "%7.2"
 /begin AXIS_DESCR COM_AXIS n_32 _CNV_A_R_LINEAR_____9_CM 6 0. 8160. FORMAT "%4.0" AXIS_PTS_REF ldpm_n_32_1_cybl /end AXIS_DESCR
/end CHARACTERISTIC
/begin CHARACTERISTIC ip_maf_lam_cyl_sel_adj_fac_max "max. threshold for calculation of cylinder individual lambda adaptation" CURVE 0xa1026134 _REC_CUR_20_u2_u1 1389. _CNV_A_R_LINEAR_____108_CM 0. 1389. DISPLAY_IDENTIFIER IP_MAF_LAM_CYL_SEL_ADJ_FAC_MAX FORMAT "%7.2"
 /begin AXIS_DESCR COM_AXIS n_32 _CNV_A_R_LINEAR_____9_CM 6 0. 8160. FORMAT "%4.0" AXIS_PTS_REF ldpm_n_32_1_cybl /end AXIS_DESCR
/end CHARACTERISTIC
/begin CHARACTERISTIC ip_maf_lam_cyl_sel_adj_cst_max "max. threshold for calculation of cylinder individual lambda adaptation under engine cold condition" CURVE 0xa102611c _REC_CUR_20_u2_u1 1389. _CNV_A_R_LINEAR_____108_CM 0. 1389. DISPLAY_IDENTIFIER IP_MAF_LAM_CYL_SEL_ADJ_CST_MAX FORMAT "%7.2"
 /begin AXIS_DESCR COM_AXIS n_32 _CNV_A_R_LINEAR_____9_CM 6 0. 8160. FORMAT "%4.0" AXIS_PTS_REF ldpm_n_32_1_cybl /end AXIS_DESCR
/end CHARACTERISTIC
/begin CHARACTERISTIC ip_n2_fac_lamb_mdl_1 "N2 coefficient of the sensor model" CURVE 0xa1026200 _REC_CUR_20_u2_u2 0.9999847412109381 _CNV_A_R_LINEAR_____68_CM 0. 0.9999847412109381 DISPLAY_IDENTIFIER IP_N2_FAC_LAMB_MDL_1 FORMAT "%7.5"
 /begin AXIS_DESCR COM_AXIS online_dummy _CNV_A_R_LINEAR_____114_CM 16 0. 63.99902344 FORMAT "%7.4" AXIS_PTS_REF ldpm_fac_t_1_1_cybl /end AXIS_DESCR
/end CHARACTERISTIC
/begin AXIS_PTS ldpm_fac_t_1_1_cybl "" 0xa1021a30 online_dummy _REC_AXS_20_u2 63.99902344 _CNV_A_R_LINEAR_____114_CM 16 0. 63.99902344 FORMAT "%7.4" /end AXIS_PTS
/begin AXIS_PTS ldpm_tco_1_cybl "" 0xa1022202 tco _REC_AXS_20_u1 190.5 _CNV_A_R_LINEAR_____16_CM 6 -48. 142.5 FORMAT "%6.2" /end AXIS_PTS
/begin CHARACTERISTIC ip_crlc_fac_lam_cyl_sel_adj "Weighting correlation factor of cylinder individual lambda adaptation part  achieved under nominal condition" CURVE 0xa1023198 _REC_CUR_20_u2_u1 0.9999847412109381 _CNV_A_R_LINEAR_____68_CM 0. 0.9999847412109381 DISPLAY_IDENTIFIER IP_CRLC_FAC_LAM_CYL_SEL_ADJ FORMAT "%7.5"
 /begin AXIS_DESCR COM_AXIS tco _CNV_A_R_LINEAR_____16_CM 6 -48. 142.5 FORMAT "%6.2" AXIS_PTS_REF ldpm_tco_1_cybl /end AXIS_DESCR
/end CHARACTERISTIC
/begin CHARACTERISTIC ip_crlc_fac_lam_cyl_sel_adj_cst "Weighting correlation factor of cylinder individual lambda adaptation part  achieved under engine cold condition" CURVE 0xa10231a4 _REC_CUR_20_u2_u1 0.9999847412109381 _CNV_A_R_LINEAR_____68_CM 0. 0.9999847412109381 DISPLAY_IDENTIFIER IP_CRLC_FAC_LAM_CYL_SEL_ADJ_CST FORMAT "%7.5"
 /begin AXIS_DESCR COM_AXIS tco _CNV_A_R_LINEAR_____16_CM 6 -48. 142.5 FORMAT "%6.2" AXIS_PTS_REF ldpm_tco_1_cybl /end AXIS_DESCR
/end CHARACTERISTIC
/begin MEASUREMENT delta_lamb_cyl[0] "individual adjusted signal" SWORD _CNV_A_R_LINEAR_____11_CM 1 100. -8. 7.99975586 DISPLAY_IDENTIFIER DELTA_LAMB_CYL[0] ECU_ADDRESS 0xc0000320 FORMAT "%7.4" /end MEASUREMENT
/begin MEASUREMENT delta_lamb_cyl[1] "individual adjusted signal" SWORD _CNV_A_R_LINEAR_____11_CM 1 100. -8. 7.99975586 DISPLAY_IDENTIFIER DELTA_LAMB_CYL[1] ECU_ADDRESS 0xc0000322 FORMAT "%7.4" /end MEASUREMENT
/begin MEASUREMENT delta_lamb_cyl[2] "individual adjusted signal" SWORD _CNV_A_R_LINEAR_____11_CM 1 100. -8. 7.99975586 DISPLAY_IDENTIFIER DELTA_LAMB_CYL[2] ECU_ADDRESS 0xc0000324 FORMAT "%7.4" /end MEASUREMENT
/begin MEASUREMENT delta_lamb_cyl[3] "individual adjusted signal" SWORD _CNV_A_R_LINEAR_____11_CM 1 100. -8. 7.99975586 DISPLAY_IDENTIFIER DELTA_LAMB_CYL[3] ECU_ADDRESS 0xc0000326 FORMAT "%7.4" /end MEASUREMENT
/begin MEASUREMENT delta_lamb_cyl[4] "individual adjusted signal" SWORD _CNV_A_R_LINEAR_____11_CM 1 100. -8. 7.99975586 DISPLAY_IDENTIFIER DELTA_LAMB_CYL[4] ECU_ADDRESS 0xc0000328 FORMAT "%7.4" /end MEASUREMENT
/begin MEASUREMENT delta_lamb_cyl[5] "individual adjusted signal" SWORD _CNV_A_R_LINEAR_____11_CM 1 100. -8. 7.99975586 DISPLAY_IDENTIFIER DELTA_LAMB_CYL[5] ECU_ADDRESS 0xc000032a FORMAT "%7.4" /end MEASUREMENT
/begin MEASUREMENT lamb_cyl_sel[0] "Cylinder individual lambda value" UWORD _CNV_A_R_LINEAR_____115_CM 1 100. 0. 7.999755859375 DISPLAY_IDENTIFIER LAMB_CYL_SEL[0] ECU_ADDRESS 0xc000032c FORMAT "%7.4" /end MEASUREMENT
/begin MEASUREMENT lamb_cyl_sel[1] "Cylinder individual lambda value" UWORD _CNV_A_R_LINEAR_____115_CM 1 100. 0. 7.999755859375 DISPLAY_IDENTIFIER LAMB_CYL_SEL[1] ECU_ADDRESS 0xc000032e FORMAT "%7.4" /end MEASUREMENT
/begin MEASUREMENT lamb_cyl_sel[2] "Cylinder individual lambda value" UWORD _CNV_A_R_LINEAR_____115_CM 1 100. 0. 7.999755859375 DISPLAY_IDENTIFIER LAMB_CYL_SEL[2] ECU_ADDRESS 0xc0000330 FORMAT "%7.4" /end MEASUREMENT
/begin MEASUREMENT lamb_cyl_sel[3] "Cylinder individual lambda value" UWORD _CNV_A_R_LINEAR_____115_CM 1 100. 0. 7.999755859375 DISPLAY_IDENTIFIER LAMB_CYL_SEL[3] ECU_ADDRESS 0xc0000332 FORMAT "%7.4" /end MEASUREMENT
/begin MEASUREMENT lamb_cyl_sel[4] "Cylinder individual lambda value" UWORD _CNV_A_R_LINEAR_____115_CM 1 100. 0. 7.999755859375 DISPLAY_IDENTIFIER LAMB_CYL_SEL[4] ECU_ADDRESS 0xc0000334 FORMAT "%7.4" /end MEASUREMENT
/begin MEASUREMENT lamb_cyl_sel[5] "Cylinder individual lambda value" UWORD _CNV_A_R_LINEAR_____115_CM 1 100. 0. 7.999755859375 DISPLAY_IDENTIFIER LAMB_CYL_SEL[5] ECU_ADDRESS 0xc0000336 FORMAT "%7.4" /end MEASUREMENT
/begin CHARACTERISTIC lc_lam_cyl_sel_err_rst "Switch enabling the reset of adaptation values in case of error ( =1)" VALUE 0xa1029d70 _REC_VAL_20_u1 1. _CNV_A_R_LINEAR_____0_CM 0. 1. DISPLAY_IDENTIFIER LC_LAM_CYL_SEL_ERR_RST FORMAT "%1.0" /end CHARACTERISTIC
/begin CHARACTERISTIC lc_lamb_delta_mdl_hld "Calculation switch for the choice of the discretization method of the sensor model (0 means  zoh,  1 means foh)" VALUE 0xa1029d72 _REC_VAL_20_u1 1. _CNV_A_R_LINEAR_____0_CM 0. 1. DISPLAY_IDENTIFIER LC_LAMB_DELTA_MDL_HLD FORMAT "%1.0" /end CHARACTERISTIC
/begin MEASUREMENT state_lam_cyl_sel_adj_1 "state of cylinder individual lambda control adaptation" UBYTE _CNV_S_5_RANGE_STAT_121_CM 1 100. 0. 4. DISPLAY_IDENTIFIER STATE_LAM_CYL_SEL_ADJ_1 ECU_ADDRESS 0xd0003b17 /end MEASUREMENT
/begin MEASUREMENT ctr_t_lam_cyl_adj_1 "Timer of cylinder individual lambda control adaptation" UBYTE _CNV_A_R_LINEAR_____35_CM 1 100. 0. 255. DISPLAY_IDENTIFIER CTR_T_LAM_CYL_ADJ_1 ECU_ADDRESS 0xc00003c8 FORMAT "%3.0" /end MEASUREMENT
/begin MEASUREMENT ctr_t_lam_cyl_adj_2 "Timer of cylinder individual lambda control adaptation" UBYTE _CNV_A_R_LINEAR_____35_CM 1 100. 0. 255. DISPLAY_IDENTIFIER CTR_T_LAM_CYL_ADJ_2 ECU_ADDRESS 0xc00003c9 FORMAT "%3.0" /end MEASUREMENT
/begin CHARACTERISTIC c_n_min_maf_diag "Engine speed condition" VALUE 0xa1029638 _REC_VAL_20_u1 2448. _CNV_A_R_LINEAR_____9_CM 0. 8160. DISPLAY_IDENTIFIER C_N_MIN_MAF_DIAG FORMAT "%4.0" /end CHARACTERISTIC
/begin MEASUREMENT lv_err_maf "MAF error detected" UBYTE _CNV_S_2_RANGE__0___1_CM 1 100. 0. 1. DISPLAY_IDENTIFIER LV_ERR_MAF ECU_ADDRESS 0xd00033bf BIT_MASK 0x1 /end MEASUREMENT
/begin CHARACTERISTIC c_v_maf_max_diag "Threshold value V_MAF to detect short circuit in signal wire to VB" VALUE 0xa1029b6a _REC_VAL_20_u1 4.98046875 _CNV_A_R_LINEAR_____195_CM 0. 4.98046875 DISPLAY_IDENTIFIER C_V_MAF_MAX_DIAG FORMAT "%4.2" /end CHARACTERISTIC
/begin CHARACTERISTIC c_v_maf_diag_ini "Initial value for V_MAF_DIAG calculation" VALUE 0xa1029b69 _REC_VAL_20_u1 4.98046875 _CNV_A_R_LINEAR_____195_CM 0. 4.98046875 DISPLAY_IDENTIFIER C_V_MAF_DIAG_INI FORMAT "%4.2" /end CHARACTERISTIC
/begin CHARACTERISTIC c_ang_exc_vvl_min_maf_diag "Threshold value ANG_EXC_VVL to detect Short circuit in signal wire to earth or wire break" VALUE 0xa102919e _REC_VAL_20_u2 200. _CNV_A_R_LINEAR_____220_CM 0. 200. DISPLAY_IDENTIFIER C_ANG_EXC_VVL_MIN_MAF_DIAG FORMAT "%7.3" /end CHARACTERISTIC
/begin CHARACTERISTIC c_tps_min_maf_diag "Throttle position threshold for detection of mass air flow signal line shorted to ground or broken" VALUE 0xa1029a9e _REC_VAL_20_u2 119.5 _CNV_A_R_LINEAR_____221_CM 0. 119.5 DISPLAY_IDENTIFIER C_TPS_MIN_MAF_DIAG FORMAT "%7.3" /end CHARACTERISTIC
/begin AXIS_PTS ldp_n_32__crlc_v_maf_diag "" 0xa1020d6c n_32 _REC_AXS_20_u1 8160. _CNV_A_R_LINEAR_____9_CM 4 0. 8160. FORMAT "%4.0" /end AXIS_PTS
/begin CHARACTERISTIC id_crlc_v_maf_diag__n_32 "Filtering factor for MAF diagnosis" CURVE 0xa1022438 _REC_CUR_20_u2_u1 0.99610001 _CNV_A_R_LINEAR_____222_CM 0. 0.99610001 DISPLAY_IDENTIFIER ID_CRLC_V_MAF_DIAG__N_32 FORMAT "%7.5"
 /begin AXIS_DESCR COM_AXIS n_32 _CNV_A_R_LINEAR_____9_CM 4 0. 8160. FORMAT "%4.0" AXIS_PTS_REF ldp_n_32__crlc_v_maf_diag /end AXIS_DESCR
/end CHARACTERISTIC
/begin CHARACTERISTIC c_v_maf_min_diag "Threshold value V_MAF to detect short circuit in signal wire to earth or wire break" VALUE 0xa1029b6b _REC_VAL_20_u1 4.98046875 _CNV_A_R_LINEAR_____195_CM 0. 4.98046875 DISPLAY_IDENTIFIER C_V_MAF_MIN_DIAG FORMAT "%4.2" /end CHARACTERISTIC
/begin MEASUREMENT v_maf_diag "Filtered V_MAF value for diagnosis" UBYTE _CNV_A_R_LINEAR_____189_CM 1 100. 0. 4.998 DISPLAY_IDENTIFIER V_MAF_DIAG ECU_ADDRESS 0xc00008a4 FORMAT "%6.4" /end MEASUREMENT
/begin MEASUREMENT v_maf_diag_l "Calculated V_MAF value for readiness" UBYTE _CNV_A_R_LINEAR_____189_CM 1 100. 0. 4.998 DISPLAY_IDENTIFIER V_MAF_DIAG_L ECU_ADDRESS 0xc00008a5 FORMAT "%6.4" /end MEASUREMENT
/begin MEASUREMENT v_maf_diag_h "Calculated V_MAF value for readiness" UBYTE _CNV_A_R_LINEAR_____189_CM 1 100. 0. 4.998 DISPLAY_IDENTIFIER V_MAF_DIAG_H ECU_ADDRESS 0xc00008a6 FORMAT "%6.4" /end MEASUREMENT
/begin MEASUREMENT lv_maf_ready_l "Flag that indicates that readyness L is reached" UBYTE _CNV_S_2_RANGE__0___1_CM 1 100. 0. 1. DISPLAY_IDENTIFIER LV_MAF_READY_L ECU_ADDRESS 0xc00008a7 BIT_MASK 0x1 /end MEASUREMENT
/begin MEASUREMENT lv_maf_ready_h "Flag that indicates that readyness L is reached" UBYTE _CNV_S_2_RANGE__0___1_CM 1 100. 0. 1. DISPLAY_IDENTIFIER LV_MAF_READY_H ECU_ADDRESS 0xc00008a8 BIT_MASK 0x1 /end MEASUREMENT
/begin MEASUREMENT lv_poil_swi "logical variable oil pressure switch (1 = warning lamp on)" UBYTE _CNV_S_2_RANGE__0___1_CM 1 100. 0. 1. DISPLAY_IDENTIFIER LV_POIL_SWI ECU_ADDRESS 0xd0003ca4 BIT_MASK 0x1 /end MEASUREMENT
/begin CHARACTERISTIC c_t_dly_tia_diag "Delay time for diagnosis activation" VALUE 0xa102987a _REC_VAL_20_u2 32767.5 _CNV_A_R_LINEAR_____253_CM 0. 32767.5 DISPLAY_IDENTIFIER C_T_DLY_TIA_DIAG FORMAT "%6.1" /end CHARACTERISTIC
/begin CHARACTERISTIC c_v_tia_max_diag "TIA threshold for short to ground - TIA diagnosis" VALUE 0xa1029ba0 _REC_VAL_20_u1 0.7497 _CNV_A_R_LINEAR_____189_CM 0. 4.998 DISPLAY_IDENTIFIER C_V_TIA_MAX_DIAG FORMAT "%6.4" /end CHARACTERISTIC
/begin CHARACTERISTIC c_v_tia_min_diag "TIA threshold for short to VB or line break - TIA diagnosis" VALUE 0xa1029ba1 _REC_VAL_20_u1 0.7497 _CNV_A_R_LINEAR_____189_CM 0. 4.998 DISPLAY_IDENTIFIER C_V_TIA_MIN_DIAG FORMAT "%6.4" /end CHARACTERISTIC
/begin CHARACTERISTIC c_tia_dif_diag "minimum temperature difference to detect a non-stucking tia signal" VALUE 0xa1029a4a _REC_VAL_20_u1 190.5 _CNV_A_R_LINEAR_____24_CM 0. 190.5 DISPLAY_IDENTIFIER C_TIA_DIF_DIAG FORMAT "%5.1" /end CHARACTERISTIC
/begin CHARACTERISTIC c_tia_plaus_dif_err "tia - offset to max/min range to detect a error" VALUE 0xa1029a54 _REC_VAL_20_u1 190.5 _CNV_A_R_LINEAR_____24_CM 0. 190.5 DISPLAY_IDENTIFIER C_TIA_PLAUS_DIF_ERR FORMAT "%5.1" /end CHARACTERISTIC
/begin CHARACTERISTIC c_t_vs_min_tia_plaus_diag "minimum time period with a certain vehicle speed to expect a moving tia signal" VALUE 0xa10299ae _REC_VAL_20_u2 32767.5 _CNV_A_R_LINEAR_____253_CM 0. 32767.5 DISPLAY_IDENTIFIER C_T_VS_MIN_TIA_PLAUS_DIAG FORMAT "%6.1" /end CHARACTERISTIC
/begin CHARACTERISTIC c_vs_min_tia_plaus_diag "minimum temperature difference to detect a non-stucking tia signal" VALUE 0xa1029cc9 _REC_VAL_20_u1 255. _CNV_A_R_LINEAR_____6_CM 0. 255. DISPLAY_IDENTIFIER C_VS_MIN_TIA_PLAUS_DIAG FORMAT "%3.0" /end CHARACTERISTIC
/begin CHARACTERISTIC c_tam_min_tia_plaus_diag "minimum ambient temperture to activate the diagnosis condition" VALUE 0xa10299c4 _REC_VAL_20_u1 190.5 _CNV_A_R_LINEAR_____16_CM -48. 142.5 DISPLAY_IDENTIFIER C_TAM_MIN_TIA_PLAUS_DIAG FORMAT "%5.1" /end CHARACTERISTIC
/begin MEASUREMENT lv_err_tia "TIA error present" UBYTE _CNV_S_2_RANGE__0___1_CM 1 100. 0. 1. DISPLAY_IDENTIFIER LV_ERR_TIA ECU_ADDRESS 0xd0003b68 BIT_MASK 0x1 /end MEASUREMENT
/begin MEASUREMENT lv_err_tia_el "Electrical TIA error" UBYTE _CNV_S_2_RANGE__0___1_CM 1 100. 0. 1. DISPLAY_IDENTIFIER LV_ERR_TIA_EL ECU_ADDRESS 0xd00033bc BIT_MASK 0x1 /end MEASUREMENT
/begin MEASUREMENT lv_err_tia_plaus "Temperature air sensor plausibility error" UBYTE _CNV_S_2_RANGE__0___1_CM 1 100. 0. 1. DISPLAY_IDENTIFIER LV_ERR_TIA_PLAUS ECU_ADDRESS 0xd000348a BIT_MASK 0x1 /end MEASUREMENT
/begin MEASUREMENT tia_plaus_min_diag "minimum expected tia" UBYTE _CNV_A_R_LINEAR_____16_CM 1 100. -48. 142.5 DISPLAY_IDENTIFIER TIA_PLAUS_MIN_DIAG ECU_ADDRESS 0xc0000c81 FORMAT "%5.1" /end MEASUREMENT
/begin MEASUREMENT tia_dif_diag "difference between tia and tia_st" UBYTE _CNV_A_R_LINEAR_____24_CM 1 100. 0. 190.5 DISPLAY_IDENTIFIER TIA_DIF_DIAG ECU_ADDRESS 0xc0000c84 FORMAT "%5.1" /end MEASUREMENT
/begin MEASUREMENT t_vs_tia_plaus_diag "time period - vehicle is driven with certain speed" UWORD _CNV_A_R_LINEAR_____253_CM 1 100. 0. 32767.5 DISPLAY_IDENTIFIER T_VS_TIA_PLAUS_DIAG ECU_ADDRESS 0xc0000c78 FORMAT "%6.1" /end MEASUREMENT
/begin MEASUREMENT t_is_tia_plaus_diag "time period - vehicle is driven in idle" UWORD _CNV_A_R_LINEAR_____253_CM 1 100. 0. 32767.5 DISPLAY_IDENTIFIER T_IS_TIA_PLAUS_DIAG ECU_ADDRESS 0xc0000c7a FORMAT "%6.1" /end MEASUREMENT
/begin MEASUREMENT lv_dif_cdn_tia_plaus_diag "flag indicating that tia signal was moving" UBYTE _CNV_S_2_RANGE__0___1_CM 1 100. 0. 1. DISPLAY_IDENTIFIER LV_DIF_CDN_TIA_PLAUS_DIAG ECU_ADDRESS 0xc0000c86 BIT_MASK 0x1 /end MEASUREMENT
/begin MEASUREMENT lv_vs_cdn_tia_plaus_diag "flag indicating that vehicle speed condition is reached" UBYTE _CNV_S_2_RANGE__0___1_CM 1 100. 0. 1. DISPLAY_IDENTIFIER LV_VS_CDN_TIA_PLAUS_DIAG ECU_ADDRESS 0xc0000c87 BIT_MASK 0x1 /end MEASUREMENT
/begin MEASUREMENT lv_is_cdn_tia_plaus_diag "Flag indicating that vehicle idle condition is reached" UBYTE _CNV_S_2_RANGE__0___1_CM 1 100. 0. 1. DISPLAY_IDENTIFIER LV_IS_CDN_TIA_PLAUS_DIAG ECU_ADDRESS 0xc0000c88 BIT_MASK 0x1 /end MEASUREMENT
/begin MEASUREMENT tia_plaus_max_diag "maximum expected tia" UBYTE _CNV_A_R_LINEAR_____16_CM 1 100. -48. 142.5 DISPLAY_IDENTIFIER TIA_PLAUS_MAX_DIAG ECU_ADDRESS 0xc0000c80 FORMAT "%5.1" /end MEASUREMENT
/begin MEASUREMENT tia_dif_max_diag "Maximum reached TIA" UBYTE _CNV_A_R_LINEAR_____16_CM 1 100. -48. 142.5 DISPLAY_IDENTIFIER TIA_DIF_MAX_DIAG ECU_ADDRESS 0xc0000c82 FORMAT "%5.1" /end MEASUREMENT
/begin MEASUREMENT tia_dif_min_diag "Minimum reached TIA" UBYTE _CNV_A_R_LINEAR_____16_CM 1 100. -48. 142.5 DISPLAY_IDENTIFIER TIA_DIF_MIN_DIAG ECU_ADDRESS 0xc0000c83 FORMAT "%5.1" /end MEASUREMENT
/begin CHARACTERISTIC c_tco_min_is_cdn_tia_plaus "" VALUE 0xa10299e3 _REC_VAL_20_u1 190.5 _CNV_A_R_LINEAR_____16_CM -48. 142.5 DISPLAY_IDENTIFIER C_TCO_MIN_IS_CDN_TIA_PLAUS FORMAT "%6.2" /end CHARACTERISTIC
/begin CHARACTERISTIC id_t_is_min_tia_plaus_diag "" CURVE 0xa1022f38 _REC_CUR_20_u2_u1 32767.5 _CNV_A_R_LINEAR_____253_CM 0. 32767.5 DISPLAY_IDENTIFIER ID_T_IS_MIN_TIA_PLAUS_DIAG FORMAT "%6.1"
 /begin AXIS_DESCR COM_AXIS tam _CNV_A_R_LINEAR_____16_CM 4 -48. 142.5 FORMAT "%5.1" AXIS_PTS_REF ldp_tam_tia_plaus_diag /end AXIS_DESCR
/end CHARACTERISTIC
/begin AXIS_PTS ldp_tam_tia_plaus_diag "" 0xa102125e tam _REC_AXS_20_u1 190.5 _CNV_A_R_LINEAR_____16_CM 4 -48. 142.5 FORMAT "%5.1" /end AXIS_PTS
/begin MEASUREMENT ctr_is_cdn_tia_plaus "Cyle counter for T_IS condition" UBYTE _CNV_A_R_LINEAR_____0_CM 1 100. 0. 255. DISPLAY_IDENTIFIER CTR_IS_CDN_TIA_PLAUS ECU_ADDRESS 0xc0000c85 FORMAT "%3.0" /end MEASUREMENT
/begin CHARACTERISTIC c_vs_max_is_cdn_tia_plaus "Maximum VS for valid IS condition" VALUE 0xa1029cae _REC_VAL_20_u1 255. _CNV_A_R_LINEAR_____6_CM 0. 255. DISPLAY_IDENTIFIER C_VS_MAX_IS_CDN_TIA_PLAUS FORMAT "%3.0" /end CHARACTERISTIC
/begin CHARACTERISTIC c_ctr_is_cdn_tia_plaus "Number of valide IS condition cycles" VALUE 0xa102929e _REC_VAL_20_u1 255. _CNV_A_R_LINEAR_____0_CM 0. 255. DISPLAY_IDENTIFIER C_CTR_IS_CDN_TIA_PLAUS FORMAT "%3.0" /end CHARACTERISTIC
/begin CHARACTERISTIC c_maf_min_int_cdn_tia_plaus "Threshold MAF to enable MAF_CYL integral" VALUE 0xa102955a _REC_VAL_20_u2 1389. _CNV_A_R_LINEAR_____108_CM 0. 1389. DISPLAY_IDENTIFIER C_MAF_MIN_INT_CDN_TIA_PLAUS FORMAT "%7.2" /end CHARACTERISTIC
/begin MEASUREMENT t_load_is_cdn_tia_plaus "Time period - vehicle is driven with high load" UWORD _CNV_A_R_LINEAR_____253_CM 1 100. 0. 32767.5 DISPLAY_IDENTIFIER T_LOAD_IS_CDN_TIA_PLAUS ECU_ADDRESS 0xc0000c7c FORMAT "%6.1" /end MEASUREMENT
/begin MEASUREMENT lv_load_is_cdn_tia_plaus "Flag indicating that vehicle was driven with high load to enter in idle condition" UBYTE _CNV_S_2_RANGE__0___1_CM 1 100. 0. 1. DISPLAY_IDENTIFIER LV_LOAD_IS_CDN_TIA_PLAUS ECU_ADDRESS 0xc0000c89 BIT_MASK 0x1 /end MEASUREMENT
/begin CHARACTERISTIC c_tam_max_tia_plaus_diag "Maximum ambient temperture to activate the diagnosis condition" VALUE 0xa10299bf _REC_VAL_20_u1 190.5 _CNV_A_R_LINEAR_____16_CM -48. 142.5 DISPLAY_IDENTIFIER C_TAM_MAX_TIA_PLAUS_DIAG FORMAT "%5.1" /end CHARACTERISTIC
/begin CHARACTERISTIC c_t_load_is_cdn_tia_plaus "Threshold for load timer to enter IS condition" VALUE 0xa10298b4 _REC_VAL_20_u2 32767.5 _CNV_A_R_LINEAR_____253_CM 0. 32767.5 DISPLAY_IDENTIFIER C_T_LOAD_IS_CDN_TIA_PLAUS FORMAT "%6.1" /end CHARACTERISTIC
/begin MEASUREMENT vb_mes "Battery voltage value measured (10 bits)" UWORD _CNV_A_R_LINEAR_____445_CM 1 100. 0. 28.7055 DISPLAY_IDENTIFIER VB_MES ECU_ADDRESS 0xd0005014 FORMAT "%5.2" /end MEASUREMENT
/begin MEASUREMENT v_igk_mes "Computed ignition key voltage" UWORD _CNV_A_R_LINEAR_____445_CM 1 100. 0. 28.7055 DISPLAY_IDENTIFIER V_IGK_MES ECU_ADDRESS 0xd0005000 FORMAT "%5.2" /end MEASUREMENT
/begin MEASUREMENT lv_err_mec_ivvt_in "Error flag for functional error on the inlet CAM adjustment" UBYTE _CNV_S_2_RANGE__0___1_CM 1 100. 0. 1. DISPLAY_IDENTIFIER LV_ERR_MEC_IVVT_IN ECU_ADDRESS 0xd0003477 BIT_MASK 0x1 /end MEASUREMENT
/begin MEASUREMENT lv_err_mec_ivvt_ex "Error flag for functional error on the exhaust CAM adjustment" UBYTE _CNV_S_2_RANGE__0___1_CM 1 100. 0. 1. DISPLAY_IDENTIFIER LV_ERR_MEC_IVVT_EX ECU_ADDRESS 0xd0003478 BIT_MASK 0x1 /end MEASUREMENT
/begin MEASUREMENT lv_err_ivvt "Global error flag IVVT" UBYTE _CNV_S_2_RANGE__0___1_CM 1 100. 0. 1. DISPLAY_IDENTIFIER LV_ERR_IVVT ECU_ADDRESS 0xd00037f4 BIT_MASK 0x1 /end MEASUREMENT
/begin MEASUREMENT v_amp "Ambient pressure sensor raw acquisition" UWORD _CNV_A_R_LINEAR_____2_CM 1 100. 0. 4.9951171875 DISPLAY_IDENTIFIER V_AMP ECU_ADDRESS 0xd0004fc8 FORMAT "%5.3" /end MEASUREMENT
/begin MEASUREMENT v_tia "Intake air temperature sensor raw acquisition." UBYTE _CNV_A_R_LINEAR_____458_CM 1 100. 0. 4.998 DISPLAY_IDENTIFIER V_TIA ECU_ADDRESS 0xd0003ba8 FORMAT "%5.3" /end MEASUREMENT
/begin MEASUREMENT v_pvs_1 "Pedal value sensor 1 raw acquisition" UWORD _CNV_A_R_LINEAR_____2_CM 1 100. 0. 4.9951171875 DISPLAY_IDENTIFIER V_PVS_1 ECU_ADDRESS 0xd0004fca FORMAT "%5.3" /end MEASUREMENT
/begin MEASUREMENT v_pvs_2 "Pedal value sensor 2 raw acquisition" UWORD _CNV_A_R_LINEAR_____2_CM 1 100. 0. 4.9951171875 DISPLAY_IDENTIFIER V_PVS_2 ECU_ADDRESS 0xd0004fcc FORMAT "%5.3" /end MEASUREMENT
/begin MEASUREMENT v_tps_1 "Throttle position sensor 1 raw acquisition." UWORD _CNV_A_R_LINEAR_____2_CM 1 100. 0. 4.9951171875 DISPLAY_IDENTIFIER V_TPS_1 ECU_ADDRESS 0xd0004fd2 FORMAT "%5.3" /end MEASUREMENT
/begin MEASUREMENT v_tps_2 "Throttle position sensor 2 raw acquisition." UWORD _CNV_A_R_LINEAR_____2_CM 1 100. 0. 4.9951171875 DISPLAY_IDENTIFIER V_TPS_2 ECU_ADDRESS 0xd0004fd4 FORMAT "%5.3" /end MEASUREMENT
/begin MEASUREMENT vcc_pvs_1 "Voltage supply for pedal value sensor 1 (and TPS) raw acquisition" UWORD _CNV_A_R_LINEAR_____252_CM 1 100. 0. 9.9902 DISPLAY_IDENTIFIER VCC_PVS_1 ECU_ADDRESS 0xd0004fce FORMAT "%5.3" /end MEASUREMENT
/begin MEASUREMENT vcc_pvs_2 "Voltage supply for pedal value sensor 2 raw acquisition" UWORD _CNV_A_R_LINEAR_____252_CM 1 100. 0. 9.9902 DISPLAY_IDENTIFIER VCC_PVS_2 ECU_ADDRESS 0xd0004fd0 FORMAT "%5.3" /end MEASUREMENT
/begin MEASUREMENT v_teg_pcat_down_1 "Catalyst temperature sensor raw acquisition - cylinder bank 1" UWORD _CNV_A_R_LINEAR_____2_CM 1 100. 0. 4.9951171875 DISPLAY_IDENTIFIER V_TEG_PCAT_DOWN_1 ECU_ADDRESS 0xd0004fd8 FORMAT "%5.3" /end MEASUREMENT
/begin MEASUREMENT v_teg_pcat_down_2 "Catalyst temperature sensor raw acquisition - cylinder bank 2" UWORD _CNV_A_R_LINEAR_____2_CM 1 100. 0. 4.9951171875 DISPLAY_IDENTIFIER V_TEG_PCAT_DOWN_2 ECU_ADDRESS 0xd0004fda FORMAT "%5.3" /end MEASUREMENT
/begin MEASUREMENT v_tecu "ECU temperature sensor raw acquisition" UWORD _CNV_A_R_LINEAR_____2_CM 1 100. 0. 4.9951171875 DISPLAY_IDENTIFIER V_TECU ECU_ADDRESS 0xd0004fde FORMAT "%5.3" /end MEASUREMENT
/begin MEASUREMENT v_fps "Fuel pressure sensor raw acquisition" UWORD _CNV_A_R_LINEAR_____2_CM 1 100. 0. 4.9951171875 DISPLAY_IDENTIFIER V_FPS ECU_ADDRESS 0xd0004fe4 FORMAT "%5.3" /end MEASUREMENT
/begin MEASUREMENT v_saf "" UBYTE _CNV_A_R_LINEAR_____189_CM 1 100. 0. 4.998 DISPLAY_IDENTIFIER V_SAF ECU_ADDRESS 0xd0003c54 FORMAT "%6.4" /end MEASUREMENT
/begin MEASUREMENT v_maf "Mass air flow sensor raw acquisition" UBYTE _CNV_A_R_LINEAR_____189_CM 1 100. 0. 4.998 DISPLAY_IDENTIFIER V_MAF ECU_ADDRESS 0xd0003ba9 FORMAT "%6.4" /end MEASUREMENT
/begin MEASUREMENT vb_bas "Battery voltage after relay raw acquisition" UWORD _CNV_A_R_LINEAR_____2_CM 1 100. 0. 4.9951171875 DISPLAY_IDENTIFIER VB_BAS ECU_ADDRESS 0xd0004fea FORMAT "%5.3" /end MEASUREMENT
/begin MEASUREMENT v_igk_bas "Battery voltage after key raw acquisition" UWORD _CNV_A_R_LINEAR_____2_CM 1 100. 0. 4.9951171875 DISPLAY_IDENTIFIER V_IGK_BAS ECU_ADDRESS 0xd0004fe8 FORMAT "%5.3" /end MEASUREMENT
/begin MEASUREMENT v_pvs_2_mc "Pedal value sensor 2 raw acquisition for Monitoring Level 2 MC" UBYTE _CNV_A_R_LINEAR_____189_CM 1 100. 0. 4.998 DISPLAY_IDENTIFIER V_PVS_2_MC ECU_ADDRESS 0xd0003bab FORMAT "%6.4" /end MEASUREMENT
/begin MEASUREMENT v_pvs_2_mu "Pedal value sensor 2 raw acquisition for Monitoring Level 2 MU" UBYTE _CNV_A_R_LINEAR_____189_CM 1 100. 0. 4.998 DISPLAY_IDENTIFIER V_PVS_2_MU ECU_ADDRESS 0xd0003bac FORMAT "%6.4" /end MEASUREMENT
/begin MEASUREMENT v_egr "Position feedback EGR valve" UWORD _CNV_A_R_LINEAR_____2_CM 1 100. 0. 4.9951171875 DISPLAY_IDENTIFIER V_EGR ECU_ADDRESS 0xd0004fe6 FORMAT "%5.3" /end MEASUREMENT
/begin MEASUREMENT v_tia_tcha "Voltage for temperature sensor up turbocharger" UBYTE _CNV_A_R_LINEAR_____458_CM 1 100. 0. 4.998 DISPLAY_IDENTIFIER V_TIA_TCHA ECU_ADDRESS 0xd0003baa FORMAT "%5.3" /end MEASUREMENT
/begin MEASUREMENT lv_im_bls "brake light switch" UBYTE _CNV_S_2_RANGE__0___1_CM 1 100. 0. 1. DISPLAY_IDENTIFIER LV_IM_BLS ECU_ADDRESS 0xd0003bca BIT_MASK 0x1 /end MEASUREMENT
/begin MEASUREMENT lv_im_bts "brake test switch" UBYTE _CNV_S_2_RANGE__0___1_CM 1 100. 0. 1. DISPLAY_IDENTIFIER LV_IM_BTS ECU_ADDRESS 0xd0003bc9 BIT_MASK 0x1 /end MEASUREMENT
/begin MEASUREMENT lv_im_cs_pn "clutch switch" UBYTE _CNV_S_2_RANGE__0___1_CM 1 100. 0. 1. DISPLAY_IDENTIFIER LV_IM_CS_PN ECU_ADDRESS 0xd0003bc8 BIT_MASK 0x1 /end MEASUREMENT
/begin MEASUREMENT lv_inh_nt_agi_err "inhibition of the NOx catalyst aging adaptation due to error on sensor or subsystem" UBYTE _CNV_S_2_RANGE__0___1_CM 1 100. 0. 1. DISPLAY_IDENTIFIER LV_INH_NT_AGI_ERR ECU_ADDRESS 0xd0003a39 BIT_MASK 0x1 /end MEASUREMENT
/begin MEASUREMENT tnt_mdl_nt_agi_dyw_1 "NOx trap temperature of limited dynamic window out of TNT_MDL_MV" UWORD _CNV_A_R_LINEAR_____197_CM 1 100. 0. 1023.984375 DISPLAY_IDENTIFIER TNT_MDL_NT_AGI_DYW_1 ECU_ADDRESS 0xc0000068 FORMAT "%7.2" /end MEASUREMENT
/begin MEASUREMENT tnt_mdl_nt_agi_dyw_2 "NOx trap temperature of limited dynamic window out of TNT_MDL_MV" UWORD _CNV_A_R_LINEAR_____197_CM 1 100. 0. 1023.984375 DISPLAY_IDENTIFIER TNT_MDL_NT_AGI_DYW_2 ECU_ADDRESS 0xc000006a FORMAT "%7.2" /end MEASUREMENT
/begin MEASUREMENT lv_inh_nt_agi "flag inhibiting the NOx catalyst aging adaptation" UBYTE _CNV_S_2_RANGE__0___1_CM 1 100. 0. 1. DISPLAY_IDENTIFIER LV_INH_NT_AGI ECU_ADDRESS 0xd0003a38 BIT_MASK 0x1 /end MEASUREMENT
/begin MEASUREMENT lv_inh_nt_agi_tnt "inhibition of the NOx catalyst aging adaptation due to temperature window control" UBYTE _CNV_S_2_RANGE__0___1_CM 1 100. 0. 1. DISPLAY_IDENTIFIER LV_INH_NT_AGI_TNT ECU_ADDRESS 0xc000006c BIT_MASK 0x1 /end MEASUREMENT
/begin MEASUREMENT lv_inh_nt_agi_thd "inhibition of the NOx catalyst aging adaptation due to MFF or N" UBYTE _CNV_S_2_RANGE__0___1_CM 1 100. 0. 1. DISPLAY_IDENTIFIER LV_INH_NT_AGI_THD ECU_ADDRESS 0xc000006d BIT_MASK 0x1 /end MEASUREMENT
/begin MEASUREMENT lv_inh_nt_agi_bas "flag inhibiting the NOx catalyst aging adaptation" UBYTE _CNV_S_2_RANGE__0___1_CM 1 100. 0. 1. DISPLAY_IDENTIFIER LV_INH_NT_AGI_BAS ECU_ADDRESS 0xd0003a3a BIT_MASK 0x1 /end MEASUREMENT
/begin MEASUREMENT lv_nt_agi_obs_ena "Activation Conditions for continuous Aging Observation" UBYTE _CNV_S_2_RANGE__0___1_CM 1 100. 0. 1. DISPLAY_IDENTIFIER LV_NT_AGI_OBS_ENA ECU_ADDRESS 0xd0003a3c BIT_MASK 0x1 /end MEASUREMENT
/begin MEASUREMENT lv_nt_agi_obs_egr_ena "Activation Conditions for continuous Aging Observation" UBYTE _CNV_S_2_RANGE__0___1_CM 1 100. 0. 1. DISPLAY_IDENTIFIER LV_NT_AGI_OBS_EGR_ENA ECU_ADDRESS 0xd0003a3d BIT_MASK 0x1 /end MEASUREMENT
/begin MEASUREMENT lv_nox_sens_max_adj "Flag to enable adjustment of NOx Sensor threshold for regeneration by aging adaptation" UBYTE _CNV_S_2_RANGE__0___1_CM 1 100. 0. 1. DISPLAY_IDENTIFIER LV_NOX_SENS_MAX_ADJ ECU_ADDRESS 0xd0003a3b BIT_MASK 0x1 /end MEASUREMENT
/begin MEASUREMENT lv_inh_nt_agi_tnt_bas "inhibition of the NOx catalyst aging adaptation due to temperature window control" UBYTE _CNV_S_2_RANGE__0___1_CM 1 100. 0. 1. DISPLAY_IDENTIFIER LV_INH_NT_AGI_TNT_BAS ECU_ADDRESS 0xd0003a3e BIT_MASK 0x1 /end MEASUREMENT
/begin MEASUREMENT nt_agi "NOx trap aging factor" UWORD _CNV_A_R_LINEAR_____68_CM 1 100. 0. 0.9999847412109381 DISPLAY_IDENTIFIER NT_AGI ECU_ADDRESS 0xd0004dfc FORMAT "%7.5" /end MEASUREMENT
/begin MEASUREMENT nt_agi_sul "NOx trap aging factor due to sulphor load" UWORD _CNV_A_R_LINEAR_____68_CM 1 100. 0. 0.9999847412109381 DISPLAY_IDENTIFIER NT_AGI_SUL ECU_ADDRESS 0xd0004dfe FORMAT "%7.5" /end MEASUREMENT
/begin MEASUREMENT nt_agi_sul_1 "NOx trap aging factor due to sulphur load ( bench selective )" ULONG _CNV_A_R_LINEAR_____518_CM 1 100. 0. 1. DISPLAY_IDENTIFIER NT_AGI_SUL_1 ECU_ADDRESS 0xd0005560 FORMAT "%12.10" /end MEASUREMENT
/begin MEASUREMENT nt_agi_sul_2 "NOx trap aging factor due to sulphur load ( bench selective )" ULONG _CNV_A_R_LINEAR_____518_CM 1 100. 0. 1. DISPLAY_IDENTIFIER NT_AGI_SUL_2 ECU_ADDRESS 0xd0005568 FORMAT "%12.10" /end MEASUREMENT
/begin MEASUREMENT nt_agi_thermo "NOx trap aging factor due to thermal aging" UWORD _CNV_A_R_LINEAR_____68_CM 1 100. 0. 0.9999847412109381 DISPLAY_IDENTIFIER NT_AGI_THERMO ECU_ADDRESS 0xd0004e00 FORMAT "%7.5" /end MEASUREMENT
/begin MEASUREMENT nt_agi_thermo_1 "NOx trap aging factor due to thermal aging ( bench selective )" UWORD _CNV_A_R_LINEAR_____68_CM 1 100. 0. 0.9999847412109381 DISPLAY_IDENTIFIER NT_AGI_THERMO_1 ECU_ADDRESS 0xd0004dee FORMAT "%7.5" /end MEASUREMENT
/begin MEASUREMENT nt_agi_thermo_2 "NOx trap aging factor due to thermal aging ( bench selective )" UWORD _CNV_A_R_LINEAR_____68_CM 1 100. 0. 0.9999847412109381 DISPLAY_IDENTIFIER NT_AGI_THERMO_2 ECU_ADDRESS 0xd0004de6 FORMAT "%7.5" /end MEASUREMENT
/begin MEASUREMENT nt_agi_bas_1 "NOx trap aging factor base value (not defined in binary Lambda-Sensor mode)" UWORD _CNV_A_R_LINEAR_____68_CM 1 100. 0. 0.9999847412109381 DISPLAY_IDENTIFIER NT_AGI_BAS_1 ECU_ADDRESS 0xc00009e2 FORMAT "%7.5" /end MEASUREMENT
/begin MEASUREMENT nt_agi_bas_2 "NOx trap aging factor base value (not defined in binary Lambda-Sensor mode)" UWORD _CNV_A_R_LINEAR_____68_CM 1 100. 0. 0.9999847412109381 DISPLAY_IDENTIFIER NT_AGI_BAS_2 ECU_ADDRESS 0xc00009e6 FORMAT "%7.5" /end MEASUREMENT
/begin MEASUREMENT nt_agi_ntld "NOx trap aging factor" UWORD _CNV_A_R_LINEAR_____68_CM 1 100. 0. 0.9999847412109381 DISPLAY_IDENTIFIER NT_AGI_NTLD ECU_ADDRESS 0xd0004df4 FORMAT "%7.5" /end MEASUREMENT
/begin MEASUREMENT nt_agi_s_red "NOx trap aging factor" UWORD _CNV_A_R_LINEAR_____68_CM 1 100. 0. 0.9999847412109381 DISPLAY_IDENTIFIER NT_AGI_S_RED ECU_ADDRESS 0xd0004df2 FORMAT "%7.5" /end MEASUREMENT
/begin MEASUREMENT nt_agi_obs_1 "quick aging monitoring value (bench selective)" UWORD _CNV_A_R_LINEAR_____68_CM 1 100. 0. 0.9999847412109381 DISPLAY_IDENTIFIER NT_AGI_OBS_1 ECU_ADDRESS 0xd0004df0 FORMAT "%7.5" /end MEASUREMENT
/begin MEASUREMENT nt_agi_obs "quick aging monitoring value" UWORD _CNV_A_R_LINEAR_____68_CM 1 100. 0. 0.9999847412109381 DISPLAY_IDENTIFIER NT_AGI_OBS ECU_ADDRESS 0xd0004df6 FORMAT "%7.5" /end MEASUREMENT
/begin MEASUREMENT nt_agi_obs_2 "quick aging monitoring value (bench selective)" UWORD _CNV_A_R_LINEAR_____68_CM 1 100. 0. 0.9999847412109381 DISPLAY_IDENTIFIER NT_AGI_OBS_2 ECU_ADDRESS 0xd0004de8 FORMAT "%7.5" /end MEASUREMENT
/begin MEASUREMENT nox_eff_1 "actual NOx trap efficiency (not defined in binary Lambda-Sensor mode) ( bench selective )" UWORD _CNV_A_R_LINEAR_____68_CM 1 100. 0. 0.9999847412109381 DISPLAY_IDENTIFIER NOX_EFF_1 ECU_ADDRESS 0xc00009e0 FORMAT "%7.5" /end MEASUREMENT
/begin MEASUREMENT nox_eff_2 "actual NOx trap efficiency (not defined in binary Lambda-Sensor mode) ( bench selective )" UWORD _CNV_A_R_LINEAR_____68_CM 1 100. 0. 0.9999847412109381 DISPLAY_IDENTIFIER NOX_EFF_2 ECU_ADDRESS 0xc00009e4 FORMAT "%7.5" /end MEASUREMENT
/begin MEASUREMENT nt_sul_agi "interface variable for update of sulphur release model by aging function" UWORD _CNV_A_R_LINEAR_____495_CM 1 100. 0. 10485.6 DISPLAY_IDENTIFIER NT_SUL_AGI ECU_ADDRESS 0xd0004dfa FORMAT "%7.1" /end MEASUREMENT
/begin MEASUREMENT nt_sul_upd "interface variable for update of sulphur model by aging function" UWORD _CNV_A_R_LINEAR_____495_CM 1 100. 0. 10485.6 DISPLAY_IDENTIFIER NT_SUL_UPD ECU_ADDRESS 0xd0004df8 FORMAT "%7.1" /end MEASUREMENT
/begin MEASUREMENT lv_nt_afs_req_agi "logical value for the request of lambda = 1 operation " UBYTE _CNV_S_2_RANGE__0___1_CM 1 100. 0. 1. DISPLAY_IDENTIFIER LV_NT_AFS_REQ_AGI ECU_ADDRESS 0xd0003a4a BIT_MASK 0x1 /end MEASUREMENT
/begin MEASUREMENT lv_agi_ad_trig "Logical value for the request of adaptation of aging factor" UBYTE _CNV_S_2_RANGE__0___1_CM 1 100. 0. 1. DISPLAY_IDENTIFIER LV_AGI_AD_TRIG ECU_ADDRESS 0xc00009e9 BIT_MASK 0x1 /end MEASUREMENT
/begin MEASUREMENT lv_so2p_req_1 "request of a desulfation " UBYTE _CNV_S_2_RANGE__0___1_CM 1 100. 0. 1. DISPLAY_IDENTIFIER LV_SO2P_REQ_1 ECU_ADDRESS 0xd0003a4b BIT_MASK 0x1 /end MEASUREMENT
/begin MEASUREMENT lv_so2p_req_2 "request of a desulfation (forces catalyst heating)" UBYTE _CNV_S_2_RANGE__0___1_CM 1 100. 0. 1. DISPLAY_IDENTIFIER LV_SO2P_REQ_2 ECU_ADDRESS 0xd0003a4c BIT_MASK 0x1 /end MEASUREMENT
/begin MEASUREMENT lv_cdn_nt_agi_thermo_ad "flag: thermal aging adaption enabled (due to low sulphur load)" UBYTE _CNV_S_2_RANGE__0___1_CM 1 100. 0. 1. DISPLAY_IDENTIFIER LV_CDN_NT_AGI_THERMO_AD ECU_ADDRESS 0xd0003a4e BIT_MASK 0x1 /end MEASUREMENT
/begin MEASUREMENT lv_agi_vld "Logical value for completed aging adaptation" UBYTE _CNV_S_2_RANGE__0___1_CM 1 100. 0. 1. DISPLAY_IDENTIFIER LV_AGI_VLD ECU_ADDRESS 0xd0003a4d BIT_MASK 0x1 /end MEASUREMENT
/begin MEASUREMENT lv_nt_agi_bas_ena "basic aging factor calculation enabled" UBYTE _CNV_S_2_RANGE__0___1_CM 1 100. 0. 1. DISPLAY_IDENTIFIER LV_NT_AGI_BAS_ENA ECU_ADDRESS 0xc00009eb BIT_MASK 0x1 /end MEASUREMENT
/begin MEASUREMENT lv_nt_agi_ena_tmp "temporary value for LV_NT_AGI_ENA calculation" UBYTE _CNV_S_2_RANGE__0___1_CM 1 100. 0. 1. DISPLAY_IDENTIFIER LV_NT_AGI_ENA_TMP ECU_ADDRESS 0xc00009ec BIT_MASK 0x1 /end MEASUREMENT
/begin MEASUREMENT lv_nt_agi_ena "aging factor (sulphor or thermal) calculation enabled" UBYTE _CNV_S_2_RANGE__0___1_CM 1 100. 0. 1. DISPLAY_IDENTIFIER LV_NT_AGI_ENA ECU_ADDRESS 0xd0003a52 BIT_MASK 0x1 /end MEASUREMENT
/begin MEASUREMENT lv_nt_agi_ena_tnt "temperature initialisation condition for aging adaptation given" UBYTE _CNV_S_2_RANGE__0___1_CM 1 100. 0. 1. DISPLAY_IDENTIFIER LV_NT_AGI_ENA_TNT ECU_ADDRESS 0xc00009ed BIT_MASK 0x1 /end MEASUREMENT
/begin MEASUREMENT lv_nt_agi_ena_afs "value for HOM_REQ before aging adaptation" UBYTE _CNV_S_2_RANGE__0___1_CM 1 100. 0. 1. DISPLAY_IDENTIFIER LV_NT_AGI_ENA_AFS ECU_ADDRESS 0xd0003a50 BIT_MASK 0x1 /end MEASUREMENT
/begin MEASUREMENT lv_nt_agi_ena_afs_tmp "temporary value for HOM_REQ before aging adaptation" UBYTE _CNV_S_2_RANGE__0___1_CM 1 100. 0. 1. DISPLAY_IDENTIFIER LV_NT_AGI_ENA_AFS_TMP ECU_ADDRESS 0xd0003a51 BIT_MASK 0x1 /end MEASUREMENT
/begin MEASUREMENT lv_egr_ratio_sp_agi_act "request to close EGR valve for better NT aging adaptation performance" UBYTE _CNV_S_2_RANGE__0___1_CM 1 100. 0. 1. DISPLAY_IDENTIFIER LV_EGR_RATIO_SP_AGI_ACT ECU_ADDRESS 0xd0003a4f BIT_MASK 0x1 /end MEASUREMENT
/begin MEASUREMENT ctr_nt_agi_ad "counter of aging adaptations attempts (with closed EGR valve)" UBYTE _CNV_A_R_LINEAR_____0_CM 1 100. 0. 254. DISPLAY_IDENTIFIER CTR_NT_AGI_AD ECU_ADDRESS 0xc00009e8 FORMAT "%3.0" /end MEASUREMENT
/begin MEASUREMENT ctr_nt_agi_ad_cmpl "counter of completed aging adaptation cycles during driving cycle" UBYTE _CNV_A_R_LINEAR_____0_CM 1 100. 0. 254. DISPLAY_IDENTIFIER CTR_NT_AGI_AD_CMPL ECU_ADDRESS 0xd0003a48 FORMAT "%3.0" /end MEASUREMENT
/begin MEASUREMENT ctr_nt_agi_ad_cmpl_sum "counter of completed aging adaptations" UWORD _CNV_A_R_LINEAR_____0_CM 1 100. 0. 65535. DISPLAY_IDENTIFIER CTR_NT_AGI_AD_CMPL_SUM ECU_ADDRESS 0xd0004de0 FORMAT "%5.0" /end MEASUREMENT
/begin CHARACTERISTIC c_nt_agi_1 "NOx trap aging factor threshold for the desulfation request 1" VALUE 0xa10296c0 _REC_VAL_20_u2 0.9999847412109381 _CNV_A_R_LINEAR_____68_CM 0. 0.9999847412109381 DISPLAY_IDENTIFIER C_NT_AGI_1 FORMAT "%7.5" /end CHARACTERISTIC
/begin CHARACTERISTIC c_nt_agi_2 "NOx trap aging factor threshold for the desulfation request 2" VALUE 0xa10296c2 _REC_VAL_20_u2 0.9999847412109381 _CNV_A_R_LINEAR_____68_CM 0. 0.9999847412109381 DISPLAY_IDENTIFIER C_NT_AGI_2 FORMAT "%7.5" /end CHARACTERISTIC
/begin CHARACTERISTIC c_nt_agi_3 "NOx trap aging factor threshold for the request of lambda = 1 operation" VALUE 0xa10296c4 _REC_VAL_20_u2 0.9999847412109381 _CNV_A_R_LINEAR_____68_CM 0. 0.9999847412109381 DISPLAY_IDENTIFIER C_NT_AGI_3 FORMAT "%7.5" /end CHARACTERISTIC
/begin CHARACTERISTIC c_nt_agi_ini_1 "NOx trap aging factor initializing value (branch selective)" VALUE 0xa10296c6 _REC_VAL_20_u2 0.9999847412109381 _CNV_A_R_LINEAR_____68_CM 0. 0.9999847412109381 DISPLAY_IDENTIFIER C_NT_AGI_INI_1 FORMAT "%7.5" /end CHARACTERISTIC
/begin CHARACTERISTIC c_nt_agi_ini_2 "NOx trap aging factor initializing value (branch selective)" VALUE 0xa10296c8 _REC_VAL_20_u2 0.9999847412109381 _CNV_A_R_LINEAR_____68_CM 0. 0.9999847412109381 DISPLAY_IDENTIFIER C_NT_AGI_INI_2 FORMAT "%7.5" /end CHARACTERISTIC
/begin CHARACTERISTIC c_nt_agi_ntld_man "Manual set of NT_AGI_NTLD" VALUE 0xa10296cc _REC_VAL_20_u2 0.9999847412109381 _CNV_A_R_LINEAR_____68_CM 0. 0.9999847412109381 DISPLAY_IDENTIFIER C_NT_AGI_NTLD_MAN FORMAT "%7.5" /end CHARACTERISTIC
/begin CHARACTERISTIC c_nt_agi_s_red_man "Manual set of NT_AGI_S_RED" VALUE 0xa10296d6 _REC_VAL_20_u2 0.9999847412109381 _CNV_A_R_LINEAR_____68_CM 0. 0.9999847412109381 DISPLAY_IDENTIFIER C_NT_AGI_S_RED_MAN FORMAT "%7.5" /end CHARACTERISTIC
/begin CHARACTERISTIC c_nt_agi_obs_min "aging monitoring minimum threshold to request of lambda=1 operation" VALUE 0xa10296ce _REC_VAL_20_u2 0.9999847412109381 _CNV_A_R_LINEAR_____68_CM 0. 0.9999847412109381 DISPLAY_IDENTIFIER C_NT_AGI_OBS_MIN FORMAT "%7.5" /end CHARACTERISTIC
/begin CHARACTERISTIC c_nt_agi_obs_min_is "aging monitoring minimum threshold to request of lambda=1 operation during idle speed" VALUE 0xa10296d4 _REC_VAL_20_u2 0.9999847412109381 _CNV_A_R_LINEAR_____68_CM 0. 0.9999847412109381 DISPLAY_IDENTIFIER C_NT_AGI_OBS_MIN_IS FORMAT "%7.5" /end CHARACTERISTIC
/begin CHARACTERISTIC c_crlc_nt_agi_thermo_inc "correlation constant for the calculation of the aging factor (increasing factor)" VALUE 0xa1029230 _REC_VAL_20_u2 0.9999847412109381 _CNV_A_R_LINEAR_____68_CM 0. 0.9999847412109381 DISPLAY_IDENTIFIER C_CRLC_NT_AGI_THERMO_INC FORMAT "%7.5" /end CHARACTERISTIC
/begin CHARACTERISTIC c_crlc_nt_agi_thermo_dec "correlation constant for the calculation of the aging factor (decreasing factor)" VALUE 0xa102922e _REC_VAL_20_u2 0.9999847412109381 _CNV_A_R_LINEAR_____68_CM 0. 0.9999847412109381 DISPLAY_IDENTIFIER C_CRLC_NT_AGI_THERMO_DEC FORMAT "%7.5" /end CHARACTERISTIC
/begin CHARACTERISTIC c_crlc_nt_agi_sul "correlation constant for the calculation of the aging factor due to sulphur load" VALUE 0xa102922c _REC_VAL_20_u2 0.9999847412109381 _CNV_A_R_LINEAR_____68_CM 0. 0.9999847412109381 DISPLAY_IDENTIFIER C_CRLC_NT_AGI_SUL FORMAT "%7.5" /end CHARACTERISTIC
/begin CHARACTERISTIC c_crlc_nt_agi_obs "filter constant for NT_AGI_OBS calculation" VALUE 0xa102922a _REC_VAL_20_u2 0.9999847412109381 _CNV_A_R_LINEAR_____68_CM 0. 0.9999847412109381 DISPLAY_IDENTIFIER C_CRLC_NT_AGI_OBS FORMAT "%7.5" /end CHARACTERISTIC
/begin CHARACTERISTIC c_nt_sul_max_1 "sulphor model threshold to request set desulfation request 1" VALUE 0xa10296ea _REC_VAL_20_u2 10485.6 _CNV_A_R_LINEAR_____495_CM 0. 10485.6 DISPLAY_IDENTIFIER C_NT_SUL_MAX_1 FORMAT "%7.1" /end CHARACTERISTIC
/begin CHARACTERISTIC c_nt_sul_max_2 "sulphor model threshold to request set desulfation request 2" VALUE 0xa10296ec _REC_VAL_20_u2 10485.6 _CNV_A_R_LINEAR_____495_CM 0. 10485.6 DISPLAY_IDENTIFIER C_NT_SUL_MAX_2 FORMAT "%7.1" /end CHARACTERISTIC
/begin CHARACTERISTIC c_nt_sul_max_3 "sulphor model threshold for the request of lambda=1 operation" VALUE 0xa10296ee _REC_VAL_20_u2 10485.6 _CNV_A_R_LINEAR_____495_CM 0. 10485.6 DISPLAY_IDENTIFIER C_NT_SUL_MAX_3 FORMAT "%7.1" /end CHARACTERISTIC
/begin CHARACTERISTIC c_sul_thd_agi_thermo "threshold for reset of thermal aging adaptation / SUL no more neglectable" VALUE 0xa10297d0 _REC_VAL_20_u2 10485.6 _CNV_A_R_LINEAR_____495_CM 0. 10485.6 DISPLAY_IDENTIFIER C_SUL_THD_AGI_THERMO FORMAT "%7.1" /end CHARACTERISTIC
/begin CHARACTERISTIC c_nt_sul_ext_adj "sulphor load initialisation value by scan tool" VALUE 0xa10296e6 _REC_VAL_20_u2 10485.6 _CNV_A_R_LINEAR_____495_CM 0. 10485.6 DISPLAY_IDENTIFIER C_NT_SUL_EXT_ADJ FORMAT "%7.1" /end CHARACTERISTIC
/begin CHARACTERISTIC c_ctr_nt_agi_ad_max "max. number of attemps for adaptation (incl. successful attempts)" VALUE 0xa10292b3 _REC_VAL_20_u1 255. _CNV_A_R_LINEAR_____0_CM 0. 255. DISPLAY_IDENTIFIER C_CTR_NT_AGI_AD_MAX FORMAT "%3.0" /end CHARACTERISTIC
/begin CHARACTERISTIC c_ctr_nt_agi_ad_cmpl_max "max. number of successful adaptations per cycle" VALUE 0xa10292b2 _REC_VAL_20_u1 255. _CNV_A_R_LINEAR_____0_CM 0. 255. DISPLAY_IDENTIFIER C_CTR_NT_AGI_AD_CMPL_MAX FORMAT "%3.0" /end CHARACTERISTIC
/begin CHARACTERISTIC c_nox_ppm_min_agi "min. NOx sensor signal threshold for enabling an aging adaptation" VALUE 0xa10296b2 _REC_VAL_20_u2 1500. _CNV_A_R_LINEAR_____499_CM 0. 1500. DISPLAY_IDENTIFIER C_NOX_PPM_MIN_AGI FORMAT "%4.0" /end CHARACTERISTIC
/begin CHARACTERISTIC c_tnt_mdl_nt_agi_obs_ini "threshold for setting the quick aging monitoring values" VALUE 0xa1029a72 _REC_VAL_20_u1 1020. _CNV_A_R_LINEAR_____490_CM 0. 1020. DISPLAY_IDENTIFIER C_TNT_MDL_NT_AGI_OBS_INI FORMAT "%4.0" /end CHARACTERISTIC
/begin CHARACTERISTIC c_tnt_mdl_agi_ena_tnt "threshold for temperature initialisation condition" VALUE 0xa1029a59 _REC_VAL_20_u1 1020. _CNV_A_R_LINEAR_____490_CM 0. 1020. DISPLAY_IDENTIFIER C_TNT_MDL_AGI_ENA_TNT FORMAT "%4.0" /end CHARACTERISTIC
/begin CHARACTERISTIC c_t_afl_max_agi_ena "maximum lean phase time without aging enabling bit yet set" VALUE 0xa10297ec _REC_VAL_20_u2 1310.7 _CNV_A_R_LINEAR_____107_CM 0. 1310.7 DISPLAY_IDENTIFIER C_T_AFL_MAX_AGI_ENA FORMAT "%7.2" /end CHARACTERISTIC
/begin CHARACTERISTIC c_vs_obs_min "vehicle speed threshold to switch aging monitoring" VALUE 0xa1029ccc _REC_VAL_20_u1 255. _CNV_A_R_LINEAR_____6_CM 0. 255. DISPLAY_IDENTIFIER C_VS_OBS_MIN FORMAT "%3.0" /end CHARACTERISTIC
/begin CHARACTERISTIC lc_nt_agi_ini_man "Manual reset of the logical variables for desulfation" VALUE 0xa1029da4 _REC_VAL_20_u1 1. _CNV_A_R_LINEAR_____0_CM 0. 1. DISPLAY_IDENTIFIER LC_NT_AGI_INI_MAN FORMAT "%1.0" /end CHARACTERISTIC
/begin CHARACTERISTIC lc_nt_agi_man "Logical constant for manual switch of aging factor determination" VALUE 0xa1029da5 _REC_VAL_20_u1 1. _CNV_A_R_LINEAR_____0_CM 0. 1. DISPLAY_IDENTIFIER LC_NT_AGI_MAN FORMAT "%1.0" /end CHARACTERISTIC
/begin CHARACTERISTIC lc_nt_agi_sul_ini "NOx trap aging factor due sulphur load initializing value (branch selective)" VALUE 0xa1029da9 _REC_VAL_20_u1 1. _CNV_A_R_LINEAR_____0_CM 0. 1. DISPLAY_IDENTIFIER LC_NT_AGI_SUL_INI FORMAT "%1.0" /end CHARACTERISTIC
/begin CHARACTERISTIC lc_nt_agi_thermo_ini "NOx trap aging factor due thermo aging initializing value (branch selective)" VALUE 0xa1029daa _REC_VAL_20_u1 1. _CNV_A_R_LINEAR_____0_CM 0. 1. DISPLAY_IDENTIFIER LC_NT_AGI_THERMO_INI FORMAT "%1.0" /end CHARACTERISTIC
/begin CHARACTERISTIC lc_agi_ad_trig_man "Manual trigger for starting aging adaptation" VALUE 0xa1029d07 _REC_VAL_20_u1 1. _CNV_A_R_LINEAR_____0_CM 0. 1. DISPLAY_IDENTIFIER LC_AGI_AD_TRIG_MAN FORMAT "%1.0" /end CHARACTERISTIC
/begin CHARACTERISTIC lc_sul_thermo_cor "Logical constant for switching between absolut and relativ NT_SUL" VALUE 0xa1029de0 _REC_VAL_20_u1 1. _CNV_A_R_LINEAR_____0_CM 0. 1. DISPLAY_IDENTIFIER LC_SUL_THERMO_COR FORMAT "%1.0" /end CHARACTERISTIC
/begin CHARACTERISTIC lc_ena_sul_upd "Logical constant to enable adaptation between sulphur modell and aging factor determination" VALUE 0xa1029d31 _REC_VAL_20_u1 1. _CNV_A_R_LINEAR_____0_CM 0. 1. DISPLAY_IDENTIFIER LC_ENA_SUL_UPD FORMAT "%1.0" /end CHARACTERISTIC
/begin CHARACTERISTIC lc_sul_upd "Logical constant to enable calibration of NT_AGI_SUL with sulphur modell" VALUE 0xa1029de1 _REC_VAL_20_u1 1. _CNV_A_R_LINEAR_____0_CM 0. 1. DISPLAY_IDENTIFIER LC_SUL_UPD FORMAT "%1.0" /end CHARACTERISTIC
/begin CHARACTERISTIC lc_nt_agi_nt_sul_mpg "Logical constant to enable calibration of NT_SUL with aging determination" VALUE 0xa1029da7 _REC_VAL_20_u1 1. _CNV_A_R_LINEAR_____0_CM 0. 1. DISPLAY_IDENTIFIER LC_NT_AGI_NT_SUL_MPG FORMAT "%1.0" /end CHARACTERISTIC
/begin CHARACTERISTIC lc_nt_agi_min "Logical constant for selecting NT_AGI" VALUE 0xa1029da6 _REC_VAL_20_u1 1. _CNV_A_R_LINEAR_____0_CM 0. 1. DISPLAY_IDENTIFIER LC_NT_AGI_MIN FORMAT "%1.0" /end CHARACTERISTIC
/begin CHARACTERISTIC lc_nt_agi_egr_close "switch: close EGR during aging adaptation" VALUE 0xa1029da3 _REC_VAL_20_u1 1. _CNV_A_R_LINEAR_____0_CM 0. 1. DISPLAY_IDENTIFIER LC_NT_AGI_EGR_CLOSE FORMAT "%1.0" /end CHARACTERISTIC
/begin CHARACTERISTIC lc_nt_agi_obs_ini "switch for manual initialisation of quick aging monitoring values" VALUE 0xa1029da8 _REC_VAL_20_u1 1. _CNV_A_R_LINEAR_____0_CM 0. 1. DISPLAY_IDENTIFIER LC_NT_AGI_OBS_INI FORMAT "%1.0" /end CHARACTERISTIC
/begin CHARACTERISTIC lc_nt_agi_ad_ctr_rst_tnt "switch for resetting the adaptation cycle counters depending on NT temperature" VALUE 0xa1029da2 _REC_VAL_20_u1 1. _CNV_A_R_LINEAR_____0_CM 0. 1. DISPLAY_IDENTIFIER LC_NT_AGI_AD_CTR_RST_TNT FORMAT "%1.0" /end CHARACTERISTIC
/begin CHARACTERISTIC lc_nox_ad_cmpl_off "switch to ignore NOx raw emission adaptation" VALUE 0xa1029d85 _REC_VAL_20_u1 1. _CNV_A_R_LINEAR_____0_CM 0. 1. DISPLAY_IDENTIFIER LC_NOX_AD_CMPL_OFF FORMAT "%1.0" /end CHARACTERISTIC
/begin CHARACTERISTIC c_state_nt_agi_ntld "Mode to switch NT_AGI_NTLD" VALUE 0xa10297b5 _REC_VAL_20_u1 3. _CNV_S_4_STATE_NT_A_519_CM 0. 3. DISPLAY_IDENTIFIER C_STATE_NT_AGI_NTLD /end CHARACTERISTIC
/begin CHARACTERISTIC c_state_nt_agi_s_red "Mode to switch NT_AGI_S_RED" VALUE 0xa10297b6 _REC_VAL_20_u1 3. _CNV_S_4_STATE_NT_A_519_CM 0. 3. DISPLAY_IDENTIFIER C_STATE_NT_AGI_S_RED /end CHARACTERISTIC
/begin AXIS_PTS ldp_nt_sul_ip_nt_agi_nt_sul "" 0xa10210e4 nt_sul_upd _REC_AXS_20_u2 10485.6 _CNV_A_R_LINEAR_____495_CM 6 0. 10485.6 FORMAT "%7.1" /end AXIS_PTS
/begin AXIS_PTS ldp_nt_agi_sul_ip_nt_sul_nt_agi "" 0xa10210a8 nt_agi_sul _REC_AXS_20_u2 0.9999847412109381 _CNV_A_R_LINEAR_____68_CM 6 0. 0.9999847412109381 FORMAT "%7.5" /end AXIS_PTS
/begin CHARACTERISTIC ip_ntld_agi "NOx trap loading degree, has to be invers to IP_NT_EFF_BAS" MAP 0xa1026e18 _REC_MAP_20_u2_u2_u2 0.9999847412109381 _CNV_A_R_LINEAR_____68_CM 0. 0.9999847412109381 DISPLAY_IDENTIFIER IP_NTLD_AGI FORMAT "%7.5"
 /begin AXIS_DESCR COM_AXIS nox_eff_1 _CNV_A_R_LINEAR_____68_CM 8 0. 0.9999847412109381 FORMAT "%7.5" AXIS_PTS_REF ldpm_nox_eff /end AXIS_DESCR
 /begin AXIS_DESCR COM_AXIS tnt_mdl_mv _CNV_A_R_LINEAR_____197_CM 8 0. 1023.984375 FORMAT "%7.2" AXIS_PTS_REF ldpm_tnt_mdl_nox_nt /end AXIS_DESCR
/end CHARACTERISTIC
/begin CHARACTERISTIC ip_nt_agi_nt_sul "Correlation sulphur loading - aging factor due to sulphur load" CURVE 0xa1026adc _REC_CUR_20_u2_u2 0.9999847412109381 _CNV_A_R_LINEAR_____68_CM 0. 0.9999847412109381 DISPLAY_IDENTIFIER IP_NT_AGI_NT_SUL FORMAT "%7.5"
 /begin AXIS_DESCR COM_AXIS nt_sul_upd _CNV_A_R_LINEAR_____495_CM 6 0. 10485.6 FORMAT "%7.1" AXIS_PTS_REF ldp_nt_sul_ip_nt_agi_nt_sul /end AXIS_DESCR
/end CHARACTERISTIC
/begin CHARACTERISTIC ip_nt_sul_nt_agi "Correlation aging factor due to sulphur load - sulphur loading" CURVE 0xa1026de0 _REC_CUR_20_u2_u2 10485.6 _CNV_A_R_LINEAR_____495_CM 0. 10485.6 DISPLAY_IDENTIFIER IP_NT_SUL_NT_AGI FORMAT "%7.1"
 /begin AXIS_DESCR COM_AXIS nt_agi_sul _CNV_A_R_LINEAR_____68_CM 6 0. 0.9999847412109381 FORMAT "%7.5" AXIS_PTS_REF ldp_nt_agi_sul_ip_nt_sul_nt_agi /end AXIS_DESCR
/end CHARACTERISTIC
/begin CHARACTERISTIC ip_nt_sul_h_min "NOx trap sulphur loading threshold (for high sulphured fuel) for desulfation request 2" CURVE 0xa1026da4 _REC_CUR_20_u2_u2 10485.6 _CNV_A_R_LINEAR_____495_CM 0. 10485.6 DISPLAY_IDENTIFIER IP_NT_SUL_H_MIN FORMAT "%7.1"
 /begin AXIS_DESCR COM_AXIS nt_agi_thermo _CNV_A_R_LINEAR_____68_CM 6 0. 0.9999847412109381 FORMAT "%7.5" AXIS_PTS_REF ldpm_nt_agi_thermo /end AXIS_DESCR
/end CHARACTERISTIC
/begin CHARACTERISTIC c_nt_agi_thermo_min "NOx trap aging factor threshold for the irreversible request of lambda=1 operation" VALUE 0xa10296da _REC_VAL_20_u2 0.9999847412109381 _CNV_A_R_LINEAR_____68_CM 0. 0.9999847412109381 DISPLAY_IDENTIFIER C_NT_AGI_THERMO_MIN FORMAT "%7.5" /end CHARACTERISTIC
/begin MEASUREMENT nt_sul_agi_1 "interface variable for update of sulphur release model by aging function ( bench selective )" UWORD _CNV_A_R_LINEAR_____495_CM 1 100. 0. 10485.6 DISPLAY_IDENTIFIER NT_SUL_AGI_1 ECU_ADDRESS 0xd0004de2 FORMAT "%7.1" /end MEASUREMENT
/begin MEASUREMENT nt_sul_agi_2 "interface variable for update of sulphur release model by aging function ( bench selective )" UWORD _CNV_A_R_LINEAR_____495_CM 1 100. 0. 10485.6 DISPLAY_IDENTIFIER NT_SUL_AGI_2 ECU_ADDRESS 0xd0004dea FORMAT "%7.1" /end MEASUREMENT
/begin MEASUREMENT ntld_agi_1 "\"reverse\" NOx trap loading degree ( bench selective )" UWORD _CNV_A_R_LINEAR_____68_CM 1 100. 0. 0.9999847412109381 DISPLAY_IDENTIFIER NTLD_AGI_1 ECU_ADDRESS 0xd0004de4 FORMAT "%7.5" /end MEASUREMENT
/begin MEASUREMENT ntld_agi_2 "\"reverse\" NOx trap loading degree ( bench selective )" UWORD _CNV_A_R_LINEAR_____68_CM 1 100. 0. 0.9999847412109381 DISPLAY_IDENTIFIER NTLD_AGI_2 ECU_ADDRESS 0xd0004dec FORMAT "%7.5" /end MEASUREMENT
/begin MEASUREMENT lv_so2p_req_fq "logical value for active FQ adaption" UBYTE _CNV_S_2_RANGE__0___1_CM 1 100. 0. 1. DISPLAY_IDENTIFIER LV_SO2P_REQ_FQ ECU_ADDRESS 0xd0003a54 BIT_MASK 0x1 /end MEASUREMENT
/begin MEASUREMENT fac_su_conc_fuel "Interface factor to sulphur model for calibration fuel sulphur concentration" UBYTE _CNV_A_R_LINEAR_____0_CM 1 100. 0. 255. DISPLAY_IDENTIFIER FAC_SU_CONC_FUEL ECU_ADDRESS 0xd0003a49 FORMAT "%3.0" /end MEASUREMENT
/begin MEASUREMENT lv_nt_afs_req_agi_tmp_3 "logical value for the request of lambda =1 operation" UBYTE _CNV_S_2_RANGE__0___1_CM 1 100. 0. 1. DISPLAY_IDENTIFIER LV_NT_AFS_REQ_AGI_TMP_3 ECU_ADDRESS 0xd0003a53 BIT_MASK 0x1 /end MEASUREMENT
/begin MEASUREMENT lv_nt_afs_req_agi_tmp_2 "logical value for the request of lambda =1 operation" UBYTE _CNV_S_2_RANGE__0___1_CM 1 100. 0. 1. DISPLAY_IDENTIFIER LV_NT_AFS_REQ_AGI_TMP_2 ECU_ADDRESS 0xd0003a55 BIT_MASK 0x1 /end MEASUREMENT
/begin MEASUREMENT lv_nt_afs_req_agi_tmp_1 "logical value for the request of lambda =1 operation" UBYTE _CNV_S_2_RANGE__0___1_CM 1 100. 0. 1. DISPLAY_IDENTIFIER LV_NT_AFS_REQ_AGI_TMP_1 ECU_ADDRESS 0xd0003a56 BIT_MASK 0x1 /end MEASUREMENT
/begin MEASUREMENT ctr_nt_agi_so2p_fq "counter of completed aging adaptation during FQ adaption" UWORD _CNV_A_R_LINEAR_____0_CM 1 100. 0. 65535. DISPLAY_IDENTIFIER CTR_NT_AGI_SO2P_FQ ECU_ADDRESS 0xd0004e02 FORMAT "%5.0" /end MEASUREMENT
/begin MEASUREMENT dif_ctr_nt_agi_cmpl_sum "completed aging adaptation due to FQ adaption" UWORD _CNV_A_R_LINEAR_____0_CM 1 100. 0. 65535. DISPLAY_IDENTIFIER DIF_CTR_NT_AGI_CMPL_SUM ECU_ADDRESS 0xd0004e04 FORMAT "%5.0" /end MEASUREMENT
/begin MEASUREMENT nt_agi_so2p_fq "NOx trap aging factor" UWORD _CNV_A_R_LINEAR_____68_CM 1 100. 0. 0.9999847412109381 DISPLAY_IDENTIFIER NT_AGI_SO2P_FQ ECU_ADDRESS 0xd0004e06 FORMAT "%7.5" /end MEASUREMENT
/begin MEASUREMENT nt_agi_so2p_fq_sum "sum of NOx trap aging factor during FQ adaption" ULONG _CNV_A_R_LINEAR_____520_CM 1 100. 0. 255.999985 DISPLAY_IDENTIFIER NT_AGI_SO2P_FQ_SUM ECU_ADDRESS 0xd0005564 FORMAT "%9.5" /end MEASUREMENT
/begin AXIS_PTS ldpm_nox_eff "" 0xa1022118 nox_eff_1 _REC_AXS_20_u2 0.9999847412109381 _CNV_A_R_LINEAR_____68_CM 8 0. 0.9999847412109381 FORMAT "%7.5" /end AXIS_PTS
/begin AXIS_PTS ldpm_tnt_mdl_nox_nt "" 0xa1022344 tnt_mdl_mv _REC_AXS_20_u2 1023.984375 _CNV_A_R_LINEAR_____197_CM 8 0. 1023.984375 FORMAT "%7.2" /end AXIS_PTS
/begin AXIS_PTS ldpm_nt_agi_thermo "" 0xa1022138 nt_agi_thermo _REC_AXS_20_u2 0.9999847412109381 _CNV_A_R_LINEAR_____68_CM 6 0. 0.9999847412109381 FORMAT "%7.5" /end AXIS_PTS
/begin CHARACTERISTIC c_nt_agi_obs_min_egr_err "aging_monitoring minimum threshold to request I 1 operation if EGR valve stucked close" VALUE 0xa10296d2 _REC_VAL_20_u2 0.9999847412109381 _CNV_A_R_LINEAR_____68_CM 0. 0.9999847412109381 DISPLAY_IDENTIFIER C_NT_AGI_OBS_MIN_EGR_ERR FORMAT "%7.5" /end CHARACTERISTIC
/begin CHARACTERISTIC ip_ntld_agi_ef_close "NOx trap loading degree, has to be inverse to IP_NT_EFF_BAS_EF_CLOSE" MAP 0xa1026e98 _REC_MAP_20_u2_u2_u2 0.9999847412109381 _CNV_A_R_LINEAR_____68_CM 0. 0.9999847412109381 DISPLAY_IDENTIFIER IP_NTLD_AGI_EF_CLOSE FORMAT "%7.5"
 /begin AXIS_DESCR COM_AXIS nox_eff_1 _CNV_A_R_LINEAR_____68_CM 8 0. 0.9999847412109381 FORMAT "%7.5" AXIS_PTS_REF ldpm_nox_eff /end AXIS_DESCR
 /begin AXIS_DESCR COM_AXIS tnt_mdl_mv _CNV_A_R_LINEAR_____197_CM 8 0. 1023.984375 FORMAT "%7.2" AXIS_PTS_REF ldpm_tnt_mdl_nox_nt /end AXIS_DESCR
/end CHARACTERISTIC
/begin CHARACTERISTIC ip_nt_sul_max_2_deac "sulphur model threshold to request reset desulfation request 2" CURVE 0xa1026dc8 _REC_CUR_20_u2_u2 10485.6 _CNV_A_R_LINEAR_____495_CM 0. 10485.6 DISPLAY_IDENTIFIER IP_NT_SUL_MAX_2_DEAC FORMAT "%7.1"
 /begin AXIS_DESCR COM_AXIS nt_agi_thermo _CNV_A_R_LINEAR_____68_CM 6 0. 0.9999847412109381 FORMAT "%7.5" AXIS_PTS_REF ldpm_nt_agi_thermo /end AXIS_DESCR
/end CHARACTERISTIC
/begin CHARACTERISTIC ip_nt_sul_max_2 "sulphur model threshold to request set desulfation request 2" CURVE 0xa1026dbc _REC_CUR_20_u2_u2 10485.6 _CNV_A_R_LINEAR_____495_CM 0. 10485.6 DISPLAY_IDENTIFIER IP_NT_SUL_MAX_2 FORMAT "%7.1"
 /begin AXIS_DESCR COM_AXIS nt_agi_thermo _CNV_A_R_LINEAR_____68_CM 6 0. 0.9999847412109381 FORMAT "%7.5" AXIS_PTS_REF ldpm_nt_agi_thermo /end AXIS_DESCR
/end CHARACTERISTIC
/begin CHARACTERISTIC ip_nt_sul_max_3 "sulphur model threshold to request I 1 operation" CURVE 0xa1026dd4 _REC_CUR_20_u2_u2 10485.6 _CNV_A_R_LINEAR_____495_CM 0. 10485.6 DISPLAY_IDENTIFIER IP_NT_SUL_MAX_3 FORMAT "%7.1"
 /begin AXIS_DESCR COM_AXIS nt_agi_thermo _CNV_A_R_LINEAR_____68_CM 6 0. 0.9999847412109381 FORMAT "%7.5" AXIS_PTS_REF ldpm_nt_agi_thermo /end AXIS_DESCR
/end CHARACTERISTIC
/begin CHARACTERISTIC c_nt_agi_obs_min_2 "aging monitoring minimum threshold 2 to request I 1 operation" VALUE 0xa10296d0 _REC_VAL_20_u2 0.9999847412109381 _CNV_A_R_LINEAR_____68_CM 0. 0.9999847412109381 DISPLAY_IDENTIFIER C_NT_AGI_OBS_MIN_2 FORMAT "%7.5" /end CHARACTERISTIC
/begin CHARACTERISTIC c_nt_sul_so2p_fq "sulphur model value to start FQ-desulfation" VALUE 0xa10296f2 _REC_VAL_20_u2 10485.6 _CNV_A_R_LINEAR_____495_CM 0. 10485.6 DISPLAY_IDENTIFIER C_NT_SUL_SO2P_FQ FORMAT "%7.1" /end CHARACTERISTIC
/begin CHARACTERISTIC c_fac_su_conc_fuel "Interface factor to sulphur model for calibrating fuel sulphur concentration" VALUE 0xa102939c _REC_VAL_20_u1 255. _CNV_A_R_LINEAR_____0_CM 0. 255. DISPLAY_IDENTIFIER C_FAC_SU_CONC_FUEL FORMAT "%3.0" /end CHARACTERISTIC
/begin CHARACTERISTIC c_ctr_nt_agi_so2p_fq_min "counter threshold or aging adaption after FQ-desulfation" VALUE 0xa10292b4 _REC_VAL_20_u2 65535. _CNV_A_R_LINEAR_____0_CM 0. 65535. DISPLAY_IDENTIFIER C_CTR_NT_AGI_SO2P_FQ_MIN FORMAT "%5.0" /end CHARACTERISTIC
/begin CHARACTERISTIC c_ntld_so2p_fq "NOx loading degree to stop aging adaption after FQ-desulfation" VALUE 0xa1029710 _REC_VAL_20_u2 0.9999847412109381 _CNV_A_R_LINEAR_____68_CM 0. 0.9999847412109381 DISPLAY_IDENTIFIER C_NTLD_SO2P_FQ FORMAT "%7.5" /end CHARACTERISTIC
/begin CHARACTERISTIC c_nt_agi_thermo_so2p_fq_ini "Initial aging value after FQ-desulfation" VALUE 0xa10296dc _REC_VAL_20_u2 0.9999847412109381 _CNV_A_R_LINEAR_____68_CM 0. 0.9999847412109381 DISPLAY_IDENTIFIER C_NT_AGI_THERMO_SO2P_FQ_INI FORMAT "%7.5" /end CHARACTERISTIC
/begin CHARACTERISTIC c_delta_crk_out_min "Lower limit of the adapted phase displacement" VALUE 0xa10292f7 _REC_VAL_20_s1 1440. _CNV_A_R_LINEAR_____109_CM -720. 720. DISPLAY_IDENTIFIER C_DELTA_CRK_OUT_MIN FORMAT "%4.0" /end CHARACTERISTIC
/begin CHARACTERISTIC c_crlc_delta_lamb_cyl_cq_fil "correlation constant for the filter output" VALUE 0xa10291de _REC_VAL_20_u2 0.9999847412109381 _CNV_A_R_LINEAR_____68_CM 0. 0.9999847412109381 DISPLAY_IDENTIFIER C_CRLC_DELTA_LAMB_CYL_CQ_FIL FORMAT "%7.5" /end CHARACTERISTIC
/begin CHARACTERISTIC c_delta_lamb_cyl_sel_cq_ad_thd "Adaptation-release threshold" VALUE 0xa10292fa _REC_VAL_20_u2 0.9999847412109381 _CNV_A_R_LINEAR_____68_CM 0. 0.9999847412109381 DISPLAY_IDENTIFIER C_DELTA_LAMB_CYL_SEL_CQ_AD_THD FORMAT "%7.5" /end CHARACTERISTIC
/begin MEASUREMENT cyl_lam_psa_1.delta_lamb_cyl_sel_cq_fil "Filter value of characteristic quantity of estimated cylinder individual lambda deviation" UWORD _CNV_A_R_LINEAR_____68_CM 1 100. 0. 0.9999847412109381 DISPLAY_IDENTIFIER DELTA_LAMB_CYL_SEL_CQ_FIL_1 ECU_ADDRESS 0xd0004ecc FORMAT "%7.5" /end MEASUREMENT
/begin MEASUREMENT cyl_lam_psa_1.ctr_cq_mon_pha_shift_ad "Period of CQ monitoring" UWORD _CNV_A_R_LINEAR_____0_CM 1 100. 0. 65535. DISPLAY_IDENTIFIER CTR_CQ_MON_PHA_SHIFT_AD_1 ECU_ADDRESS 0xd0004ece FORMAT "%5.0" /end MEASUREMENT
/begin MEASUREMENT cyl_lam_psa_1.ctr_cq_max_osc "Duration of exceeded CQ limit" UWORD _CNV_A_R_LINEAR_____0_CM 1 100. 0. 65535. DISPLAY_IDENTIFIER CTR_CQ_MAX_OSC_1 ECU_ADDRESS 0xd0004ed0 FORMAT "%5.0" /end MEASUREMENT
/begin MEASUREMENT cyl_lam_psa_1.ctr_resp_lam_cyl_sel "Response time for adaptation result" UWORD _CNV_A_R_LINEAR_____0_CM 1 100. 0. 65535. DISPLAY_IDENTIFIER CTR_RESP_LAM_CYL_SEL_1 ECU_ADDRESS 0xd0004ed2 FORMAT "%5.0" /end MEASUREMENT
/begin MEASUREMENT cyl_lam_psa_1.delta_crk_cyl_lam "value of adapted phase displacement" SBYTE _CNV_A_R_LINEAR_____109_CM 1 100. -720. 720. DISPLAY_IDENTIFIER DELTA_CRK_CYL_LAM_1 ECU_ADDRESS 0xd0004ed4 FORMAT "%4.0" /end MEASUREMENT
/begin MEASUREMENT cyl_lam_psa_1.crk_cyl_lam_int "output of the integral-action" SBYTE _CNV_A_R_LINEAR_____109_CM 1 100. -720. 720. DISPLAY_IDENTIFIER CRK_CYL_LAM_INT_1 ECU_ADDRESS 0xd0004ed5 FORMAT "%4.0" /end MEASUREMENT
/begin MEASUREMENT cyl_lam_psa_1.crk_cyl_lam_delta_ini "Initial CRK - adaptation value" SBYTE _CNV_A_R_LINEAR_____109_CM 1 100. -720. 720. DISPLAY_IDENTIFIER CRK_CYL_LAM_DELTA_INI_1 ECU_ADDRESS 0xd0004ed6 FORMAT "%4.0" /end MEASUREMENT
/begin MEASUREMENT cyl_lam_psa_1.crk_chg_fac_pha_shift_ad "recursive change factor" UBYTE _CNV_A_R_LINEAR_____0_CM 1 100. 1. 120. DISPLAY_IDENTIFIER CRK_CHG_FAC_PHA_SHIFT_AD_1 ECU_ADDRESS 0xd0004ed8 FORMAT "%3.0" /end MEASUREMENT
/begin MEASUREMENT cyl_lam_psa_1.state_delta_crk_cyl_lam "Adaptation state" UBYTE _CNV_S_7_RANGE_STAT_562_CM 1 100. 0. 6. DISPLAY_IDENTIFIER STATE_DELTA_CRK_CYL_LAM_1 ECU_ADDRESS 0xd0004ed9 /end MEASUREMENT
/begin MEASUREMENT cyl_lam_psa_1.ctr_resp_cyc_lam_cyl_sel "Counter for evaluation of cylinder individual lambda control response" UBYTE _CNV_A_R_LINEAR_____0_CM 1 100. 0. 255. DISPLAY_IDENTIFIER CTR_RESP_CYC_LAM_CYL_SEL_1 ECU_ADDRESS 0xd0004eda FORMAT "%3.0" /end MEASUREMENT
/begin MEASUREMENT cyl_lam_psa_1.ctr_ti_cyl_lam_dif_absv "Counter for improved cycles of cylinder individual lambda control response - TI_CYL_LAM based" UBYTE _CNV_A_R_LINEAR_____0_CM 1 100. 0. 255. DISPLAY_IDENTIFIER CTR_TI_CYL_LAM_DIF_ABSV_1 ECU_ADDRESS 0xd0004edb FORMAT "%3.0" /end MEASUREMENT
/begin MEASUREMENT cyl_lam_psa_1.ctr_cq_fil_fall "Counter for improved cycles of cylinder individual lambda control response - CQ based" UBYTE _CNV_A_R_LINEAR_____0_CM 1 100. 0. 255. DISPLAY_IDENTIFIER CTR_CQ_FIL_FALL_1 ECU_ADDRESS 0xd0004edc FORMAT "%3.0" /end MEASUREMENT
/begin MEASUREMENT cyl_lam_psa_1.lv_delta_crk_cyl_lam_err "error flag" UBYTE _CNV_S_2_RANGE__0___1_CM 1 100. 0. 1. DISPLAY_IDENTIFIER LV_DELTA_CRK_CYL_LAM_ERR_1 ECU_ADDRESS 0xd0004edd BIT_MASK 0x1 /end MEASUREMENT
/begin MEASUREMENT cyl_lam_psa_1.lv_ti_cyl_lam_osc "Oscillation detected" UBYTE _CNV_S_2_RANGE__0___1_CM 1 100. 0. 1. DISPLAY_IDENTIFIER LV_TI_CYL_LAM_OSC_1 ECU_ADDRESS 0xd0004ede BIT_MASK 0x1 /end MEASUREMENT
/begin MEASUREMENT cyl_lam_psa_1.lv_ti_cyl_lam_lim_osc "Alternating limitation detected" UBYTE _CNV_S_2_RANGE__0___1_CM 1 100. 0. 1. DISPLAY_IDENTIFIER LV_TI_CYL_LAM_LIM_OSC_1 ECU_ADDRESS 0xd0004edf BIT_MASK 0x1 /end MEASUREMENT
/begin MEASUREMENT cyl_lam_psa_1.lv_state_delta_crk_wait "Waiting for adaptation response" UBYTE _CNV_S_2_RANGE__0___1_CM 1 100. 0. 1. DISPLAY_IDENTIFIER LV_STATE_DELTA_CRK_WAIT_1 ECU_ADDRESS 0xd0004ee0 BIT_MASK 0x1 /end MEASUREMENT
/begin MEASUREMENT cyl_lam_psa_2.delta_lamb_cyl_sel_cq_fil "Filter value of characteristic quantity of estimated cylinder individual lambda deviation" UWORD _CNV_A_R_LINEAR_____68_CM 1 100. 0. 0.9999847412109381 DISPLAY_IDENTIFIER DELTA_LAMB_CYL_SEL_CQ_FIL_2 ECU_ADDRESS 0xd0004ee4 FORMAT "%7.5" /end MEASUREMENT
/begin MEASUREMENT cyl_lam_psa_2.ctr_cq_mon_pha_shift_ad "Period of CQ monitoring" UWORD _CNV_A_R_LINEAR_____0_CM 1 100. 0. 65535. DISPLAY_IDENTIFIER CTR_CQ_MON_PHA_SHIFT_AD_2 ECU_ADDRESS 0xd0004ee6 FORMAT "%5.0" /end MEASUREMENT
/begin MEASUREMENT cyl_lam_psa_2.ctr_cq_max_osc "Duration of exceeded CQ limit" UWORD _CNV_A_R_LINEAR_____0_CM 1 100. 0. 65535. DISPLAY_IDENTIFIER CTR_CQ_MAX_OSC_2 ECU_ADDRESS 0xd0004ee8 FORMAT "%5.0" /end MEASUREMENT
/begin MEASUREMENT cyl_lam_psa_2.ctr_resp_lam_cyl_sel "Response time for adaptation result" UWORD _CNV_A_R_LINEAR_____0_CM 1 100. 0. 65535. DISPLAY_IDENTIFIER CTR_RESP_LAM_CYL_SEL_2 ECU_ADDRESS 0xd0004eea FORMAT "%5.0" /end MEASUREMENT
/begin MEASUREMENT cyl_lam_psa_2.delta_crk_cyl_lam "value of adapted phase displacement" SBYTE _CNV_A_R_LINEAR_____109_CM 1 100. -720. 720. DISPLAY_IDENTIFIER DELTA_CRK_CYL_LAM_2 ECU_ADDRESS 0xd0004eec FORMAT "%4.0" /end MEASUREMENT
/begin MEASUREMENT cyl_lam_psa_2.crk_cyl_lam_int "output of the integral-action" SBYTE _CNV_A_R_LINEAR_____109_CM 1 100. -720. 720. DISPLAY_IDENTIFIER CRK_CYL_LAM_INT_2 ECU_ADDRESS 0xd0004eed FORMAT "%4.0" /end MEASUREMENT
/begin MEASUREMENT cyl_lam_psa_2.crk_cyl_lam_delta_ini "Initial CRK - adaptation value" SBYTE _CNV_A_R_LINEAR_____109_CM 1 100. -720. 720. DISPLAY_IDENTIFIER CRK_CYL_LAM_DELTA_INI_2 ECU_ADDRESS 0xd0004eee FORMAT "%4.0" /end MEASUREMENT
/begin MEASUREMENT cyl_lam_psa_2.crk_chg_fac_pha_shift_ad "recursive change factor" UBYTE _CNV_A_R_LINEAR_____0_CM 1 100. 1. 120. DISPLAY_IDENTIFIER CRK_CHG_FAC_PHA_SHIFT_AD_2 ECU_ADDRESS 0xd0004ef0 FORMAT "%3.0" /end MEASUREMENT
/begin MEASUREMENT cyl_lam_psa_2.state_delta_crk_cyl_lam "Adaptation state" UBYTE _CNV_S_7_RANGE_STAT_562_CM 1 100. 0. 6. DISPLAY_IDENTIFIER STATE_DELTA_CRK_CYL_LAM_2 ECU_ADDRESS 0xd0004ef1 /end MEASUREMENT
/begin MEASUREMENT cyl_lam_psa_2.ctr_resp_cyc_lam_cyl_sel "Counter for evaluation of cylinder individual lambda control response" UBYTE _CNV_A_R_LINEAR_____0_CM 1 100. 0. 255. DISPLAY_IDENTIFIER CTR_RESP_CYC_LAM_CYL_SEL_2 ECU_ADDRESS 0xd0004ef2 FORMAT "%3.0" /end MEASUREMENT
/begin MEASUREMENT cyl_lam_psa_2.ctr_ti_cyl_lam_dif_absv "Counter for improved cycles of cylinder individual lambda control response - TI_CYL_LAM based" UBYTE _CNV_A_R_LINEAR_____0_CM 1 100. 0. 255. DISPLAY_IDENTIFIER CTR_TI_CYL_LAM_DIF_ABSV_2 ECU_ADDRESS 0xd0004ef3 FORMAT "%3.0" /end MEASUREMENT
/begin MEASUREMENT cyl_lam_psa_2.ctr_cq_fil_fall "Counter for improved cycles of cylinder individual lambda control response - CQ based" UBYTE _CNV_A_R_LINEAR_____0_CM 1 100. 0. 255. DISPLAY_IDENTIFIER CTR_CQ_FIL_FALL_2 ECU_ADDRESS 0xd0004ef4 FORMAT "%3.0" /end MEASUREMENT
/begin MEASUREMENT cyl_lam_psa_2.lv_delta_crk_cyl_lam_err "error flag" UBYTE _CNV_S_2_RANGE__0___1_CM 1 100. 0. 1. DISPLAY_IDENTIFIER LV_DELTA_CRK_CYL_LAM_ERR_2 ECU_ADDRESS 0xd0004ef5 BIT_MASK 0x1 /end MEASUREMENT
/begin MEASUREMENT cyl_lam_psa_2.lv_ti_cyl_lam_osc "Oscillation detected" UBYTE _CNV_S_2_RANGE__0___1_CM 1 100. 0. 1. DISPLAY_IDENTIFIER LV_TI_CYL_LAM_OSC_2 ECU_ADDRESS 0xd0004ef6 BIT_MASK 0x1 /end MEASUREMENT
/begin MEASUREMENT cyl_lam_psa_2.lv_ti_cyl_lam_lim_osc "Alternating limitation detected" UBYTE _CNV_S_2_RANGE__0___1_CM 1 100. 0. 1. DISPLAY_IDENTIFIER LV_TI_CYL_LAM_LIM_OSC_2 ECU_ADDRESS 0xd0004ef7 BIT_MASK 0x1 /end MEASUREMENT
/begin MEASUREMENT cyl_lam_psa_2.lv_state_delta_crk_wait "Waiting for adaptation response" UBYTE _CNV_S_2_RANGE__0___1_CM 1 100. 0. 1. DISPLAY_IDENTIFIER LV_STATE_DELTA_CRK_WAIT_2 ECU_ADDRESS 0xd0004ef8 BIT_MASK 0x1 /end MEASUREMENT
/begin MEASUREMENT ti_cyl_lam_save[0] "Value of the saved cylinder individual lambda controller output" SWORD _CNV_A_R_LINEAR_____110_CM 1 100. -50. 49.9984741210938 DISPLAY_IDENTIFIER TI_CYL_LAM_SAVE[0] ECU_ADDRESS 0xc00003cc FORMAT "%7.3" /end MEASUREMENT
/begin MEASUREMENT ti_cyl_lam_save[1] "Value of the saved cylinder individual lambda controller output" SWORD _CNV_A_R_LINEAR_____110_CM 1 100. -50. 49.9984741210938 DISPLAY_IDENTIFIER TI_CYL_LAM_SAVE[1] ECU_ADDRESS 0xc00003ce FORMAT "%7.3" /end MEASUREMENT
/begin MEASUREMENT ti_cyl_lam_save[2] "Value of the saved cylinder individual lambda controller output" SWORD _CNV_A_R_LINEAR_____110_CM 1 100. -50. 49.9984741210938 DISPLAY_IDENTIFIER TI_CYL_LAM_SAVE[2] ECU_ADDRESS 0xc00003d0 FORMAT "%7.3" /end MEASUREMENT
/begin MEASUREMENT ti_cyl_lam_save[3] "Value of the saved cylinder individual lambda controller output" SWORD _CNV_A_R_LINEAR_____110_CM 1 100. -50. 49.9984741210938 DISPLAY_IDENTIFIER TI_CYL_LAM_SAVE[3] ECU_ADDRESS 0xc00003d2 FORMAT "%7.3" /end MEASUREMENT
/begin MEASUREMENT ti_cyl_lam_save[4] "Value of the saved cylinder individual lambda controller output" SWORD _CNV_A_R_LINEAR_____110_CM 1 100. -50. 49.9984741210938 DISPLAY_IDENTIFIER TI_CYL_LAM_SAVE[4] ECU_ADDRESS 0xc00003d4 FORMAT "%7.3" /end MEASUREMENT
/begin MEASUREMENT ti_cyl_lam_save[5] "Value of the saved cylinder individual lambda controller output" SWORD _CNV_A_R_LINEAR_____110_CM 1 100. -50. 49.9984741210938 DISPLAY_IDENTIFIER TI_CYL_LAM_SAVE[5] ECU_ADDRESS 0xc00003d6 FORMAT "%7.3" /end MEASUREMENT
/begin MEASUREMENT ctr_sum_ti_cyl_lam_osc[0] "Duration of oscillation monitoring" UWORD _CNV_A_R_LINEAR_____0_CM 1 100. 0. 65535. DISPLAY_IDENTIFIER CTR_SUM_TI_CYL_LAM_OSC[0] ECU_ADDRESS 0xc00003d8 FORMAT "%5.0" /end MEASUREMENT
/begin MEASUREMENT ctr_sum_ti_cyl_lam_osc[1] "Duration of oscillation monitoring" UWORD _CNV_A_R_LINEAR_____0_CM 1 100. 0. 65535. DISPLAY_IDENTIFIER CTR_SUM_TI_CYL_LAM_OSC[1] ECU_ADDRESS 0xc00003da FORMAT "%5.0" /end MEASUREMENT
/begin MEASUREMENT ctr_sum_ti_cyl_lam_osc[2] "Duration of oscillation monitoring" UWORD _CNV_A_R_LINEAR_____0_CM 1 100. 0. 65535. DISPLAY_IDENTIFIER CTR_SUM_TI_CYL_LAM_OSC[2] ECU_ADDRESS 0xc00003dc FORMAT "%5.0" /end MEASUREMENT
/begin MEASUREMENT ctr_sum_ti_cyl_lam_osc[3] "Duration of oscillation monitoring" UWORD _CNV_A_R_LINEAR_____0_CM 1 100. 0. 65535. DISPLAY_IDENTIFIER CTR_SUM_TI_CYL_LAM_OSC[3] ECU_ADDRESS 0xc00003de FORMAT "%5.0" /end MEASUREMENT
/begin MEASUREMENT ctr_sum_ti_cyl_lam_osc[4] "Duration of oscillation monitoring" UWORD _CNV_A_R_LINEAR_____0_CM 1 100. 0. 65535. DISPLAY_IDENTIFIER CTR_SUM_TI_CYL_LAM_OSC[4] ECU_ADDRESS 0xc00003e0 FORMAT "%5.0" /end MEASUREMENT
/begin MEASUREMENT ctr_sum_ti_cyl_lam_osc[5] "Duration of oscillation monitoring" UWORD _CNV_A_R_LINEAR_____0_CM 1 100. 0. 65535. DISPLAY_IDENTIFIER CTR_SUM_TI_CYL_LAM_OSC[5] ECU_ADDRESS 0xc00003e2 FORMAT "%5.0" /end MEASUREMENT
/begin MEASUREMENT lv_ti_cyl_lam_osc_max_thd[0] "Flag indicating the upper limit of cylinder individual lambda control was reached - oscillation monitoring" UBYTE _CNV_S_2_RANGE__0___1_CM 1 100. 0. 1. DISPLAY_IDENTIFIER LV_TI_CYL_LAM_OSC_MAX_THD[0] ECU_ADDRESS 0xc00003ea BIT_MASK 0x1 /end MEASUREMENT
/begin MEASUREMENT lv_ti_cyl_lam_osc_max_thd[1] "Flag indicating the upper limit of cylinder individual lambda control was reached - oscillation monitoring" UBYTE _CNV_S_2_RANGE__0___1_CM 1 100. 0. 1. DISPLAY_IDENTIFIER LV_TI_CYL_LAM_OSC_MAX_THD[1] ECU_ADDRESS 0xc00003eb BIT_MASK 0x1 /end MEASUREMENT
/begin MEASUREMENT lv_ti_cyl_lam_osc_max_thd[2] "Flag indicating the upper limit of cylinder individual lambda control was reached - oscillation monitoring" UBYTE _CNV_S_2_RANGE__0___1_CM 1 100. 0. 1. DISPLAY_IDENTIFIER LV_TI_CYL_LAM_OSC_MAX_THD[2] ECU_ADDRESS 0xc00003ec BIT_MASK 0x1 /end MEASUREMENT
/begin MEASUREMENT lv_ti_cyl_lam_osc_max_thd[3] "Flag indicating the upper limit of cylinder individual lambda control was reached - oscillation monitoring" UBYTE _CNV_S_2_RANGE__0___1_CM 1 100. 0. 1. DISPLAY_IDENTIFIER LV_TI_CYL_LAM_OSC_MAX_THD[3] ECU_ADDRESS 0xc00003ed BIT_MASK 0x1 /end MEASUREMENT
/begin MEASUREMENT lv_ti_cyl_lam_osc_max_thd[4] "Flag indicating the upper limit of cylinder individual lambda control was reached - oscillation monitoring" UBYTE _CNV_S_2_RANGE__0___1_CM 1 100. 0. 1. DISPLAY_IDENTIFIER LV_TI_CYL_LAM_OSC_MAX_THD[4] ECU_ADDRESS 0xc00003ee BIT_MASK 0x1 /end MEASUREMENT
/begin MEASUREMENT lv_ti_cyl_lam_osc_max_thd[5] "Flag indicating the upper limit of cylinder individual lambda control was reached - oscillation monitoring" UBYTE _CNV_S_2_RANGE__0___1_CM 1 100. 0. 1. DISPLAY_IDENTIFIER LV_TI_CYL_LAM_OSC_MAX_THD[5] ECU_ADDRESS 0xc00003ef BIT_MASK 0x1 /end MEASUREMENT
/begin MEASUREMENT lv_ti_cyl_lam_osc_min_thd[0] "Flag indicating the lower limit of cylinder individual lambda control was reached - oscillation monitoring" UBYTE _CNV_S_2_RANGE__0___1_CM 1 100. 0. 1. DISPLAY_IDENTIFIER LV_TI_CYL_LAM_OSC_MIN_THD[0] ECU_ADDRESS 0xc00003f0 BIT_MASK 0x1 /end MEASUREMENT
/begin MEASUREMENT lv_ti_cyl_lam_osc_min_thd[1] "Flag indicating the lower limit of cylinder individual lambda control was reached - oscillation monitoring" UBYTE _CNV_S_2_RANGE__0___1_CM 1 100. 0. 1. DISPLAY_IDENTIFIER LV_TI_CYL_LAM_OSC_MIN_THD[1] ECU_ADDRESS 0xc00003f1 BIT_MASK 0x1 /end MEASUREMENT
/begin MEASUREMENT lv_ti_cyl_lam_osc_min_thd[2] "Flag indicating the lower limit of cylinder individual lambda control was reached - oscillation monitoring" UBYTE _CNV_S_2_RANGE__0___1_CM 1 100. 0. 1. DISPLAY_IDENTIFIER LV_TI_CYL_LAM_OSC_MIN_THD[2] ECU_ADDRESS 0xc00003f2 BIT_MASK 0x1 /end MEASUREMENT
/begin MEASUREMENT lv_ti_cyl_lam_osc_min_thd[3] "Flag indicating the lower limit of cylinder individual lambda control was reached - oscillation monitoring" UBYTE _CNV_S_2_RANGE__0___1_CM 1 100. 0. 1. DISPLAY_IDENTIFIER LV_TI_CYL_LAM_OSC_MIN_THD[3] ECU_ADDRESS 0xc00003f3 BIT_MASK 0x1 /end MEASUREMENT
/begin MEASUREMENT lv_ti_cyl_lam_osc_min_thd[4] "Flag indicating the lower limit of cylinder individual lambda control was reached - oscillation monitoring" UBYTE _CNV_S_2_RANGE__0___1_CM 1 100. 0. 1. DISPLAY_IDENTIFIER LV_TI_CYL_LAM_OSC_MIN_THD[4] ECU_ADDRESS 0xc00003f4 BIT_MASK 0x1 /end MEASUREMENT
/begin MEASUREMENT lv_ti_cyl_lam_osc_min_thd[5] "Flag indicating the lower limit of cylinder individual lambda control was reached - oscillation monitoring" UBYTE _CNV_S_2_RANGE__0___1_CM 1 100. 0. 1. DISPLAY_IDENTIFIER LV_TI_CYL_LAM_OSC_MIN_THD[5] ECU_ADDRESS 0xc00003f5 BIT_MASK 0x1 /end MEASUREMENT
/begin CHARACTERISTIC c_crk_cyl_lam_delta_ini "CRK - initial constant" VALUE 0xa10291d1 _REC_VAL_20_s1 1440. _CNV_A_R_LINEAR_____109_CM -720. 720. DISPLAY_IDENTIFIER C_CRK_CYL_LAM_DELTA_INI FORMAT "%4.0" /end CHARACTERISTIC
/begin CHARACTERISTIC c_ctr_sum_ti_cyl_lam_osc_max "Maximum time of oscillation monitoring - TI_CYL_LAM - based" VALUE 0xa10292c4 _REC_VAL_20_u2 65535. _CNV_A_R_LINEAR_____0_CM 0. 65535. DISPLAY_IDENTIFIER C_CTR_SUM_TI_CYL_LAM_OSC_MAX FORMAT "%5.0" /end CHARACTERISTIC
/begin CHARACTERISTIC c_ctr_cq_mon_pha_shift_ad_max "Maximum time of oscillation monitoring - CQ - based" VALUE 0xa1029254 _REC_VAL_20_u2 65535. _CNV_A_R_LINEAR_____0_CM 0. 65535. DISPLAY_IDENTIFIER C_CTR_CQ_MON_PHA_SHIFT_AD_MAX FORMAT "%5.0" /end CHARACTERISTIC
/begin CHARACTERISTIC c_ctr_resp_min_lam_cyl_sel "Minimum response time for adaptation result" VALUE 0xa10292ba _REC_VAL_20_u2 65535. _CNV_A_R_LINEAR_____0_CM 0. 65535. DISPLAY_IDENTIFIER C_CTR_RESP_MIN_LAM_CYL_SEL FORMAT "%5.0" /end CHARACTERISTIC
/begin CHARACTERISTIC lc_crk_cyl_lam_delta_out "adaptation switch" VALUE 0xa1029d11 _REC_VAL_20_u1 1. _CNV_A_R_LINEAR_____0_CM 0. 1. DISPLAY_IDENTIFIER LC_CRK_CYL_LAM_DELTA_OUT FORMAT "%1.0" /end CHARACTERISTIC
/begin CHARACTERISTIC lc_crk_delta_cq_swi "Adaptation via characteristic quantity" VALUE 0xa1029d12 _REC_VAL_20_u1 1. _CNV_A_R_LINEAR_____0_CM 0. 1. DISPLAY_IDENTIFIER LC_CRK_DELTA_CQ_SWI FORMAT "%1.0" /end CHARACTERISTIC
/begin CHARACTERISTIC c_ctr_cq_min_pha_shift_ad "Minimum time of exceeded CQ limit to request the adaptation" VALUE 0xa1029252 _REC_VAL_20_u2 65535. _CNV_A_R_LINEAR_____0_CM 0. 65535. DISPLAY_IDENTIFIER C_CTR_CQ_MIN_PHA_SHIFT_AD FORMAT "%5.0" /end CHARACTERISTIC
/begin CHARACTERISTIC c_ti_cyl_lam_max_pha_shift_ad "Upper limit of  TI_CYL_LAM value to detect the oscillation" VALUE 0xa1029a40 _REC_VAL_20_s2 99.99847412109381 _CNV_A_R_LINEAR_____110_CM -50. 49.9984741210938 DISPLAY_IDENTIFIER C_TI_CYL_LAM_MAX_PHA_SHIFT_AD FORMAT "%7.3" /end CHARACTERISTIC
/begin CHARACTERISTIC c_ti_cyl_lam_min_pha_shift_ad "Lower limit of  TI_CYL_LAM value to detect the oscillation" VALUE 0xa1029a42 _REC_VAL_20_s2 99.99847412109381 _CNV_A_R_LINEAR_____110_CM -50. 49.9984741210938 DISPLAY_IDENTIFIER C_TI_CYL_LAM_MIN_PHA_SHIFT_AD FORMAT "%7.3" /end CHARACTERISTIC
/begin CHARACTERISTIC c_crk_chg_fac_max "Upper limit of the CRK change factor" VALUE 0xa10291c7 _REC_VAL_20_u1 119. _CNV_A_R_LINEAR_____0_CM 1. 120. DISPLAY_IDENTIFIER C_CRK_CHG_FAC_MAX FORMAT "%3.0" /end CHARACTERISTIC
/begin CHARACTERISTIC c_delta_crk_out_max "Upper limit of the adapted phase displacement" VALUE 0xa10292f6 _REC_VAL_20_s1 1440. _CNV_A_R_LINEAR_____109_CM -720. 720. DISPLAY_IDENTIFIER C_DELTA_CRK_OUT_MAX FORMAT "%4.0" /end CHARACTERISTIC
/begin CHARACTERISTIC c_crk_chg_step "CRK change step" VALUE 0xa10291c8 _REC_VAL_20_s1 1440. _CNV_A_R_LINEAR_____109_CM -720. 720. DISPLAY_IDENTIFIER C_CRK_CHG_STEP FORMAT "%4.0" /end CHARACTERISTIC
/begin CHARACTERISTIC c_ctr_resp_cyc_min_lam_cyl_sel "Minimum number of response cycles to evaluate the adaptation result" VALUE 0xa10292b8 _REC_VAL_20_u1 255. _CNV_A_R_LINEAR_____0_CM 0. 255. DISPLAY_IDENTIFIER C_CTR_RESP_CYC_MIN_LAM_CYL_SEL FORMAT "%3.0" /end CHARACTERISTIC
/begin CHARACTERISTIC c_ctr_ti_cyl_lam_dif_absv_min "Least number of improvement cycles to extend the waiting time for evaluation of adaptation result - TI_CYL_LAM - based" VALUE 0xa10292c8 _REC_VAL_20_u1 255. _CNV_A_R_LINEAR_____0_CM 0. 255. DISPLAY_IDENTIFIER C_CTR_TI_CYL_LAM_DIF_ABSV_MIN FORMAT "%3.0" /end CHARACTERISTIC
/begin CHARACTERISTIC c_ctr_ti_cyl_lam_dif_absv_ok "Minimum number of improved cycles to accept the adaptation value - TI_CYL_LAM - based" VALUE 0xa10292c9 _REC_VAL_20_u1 255. _CNV_A_R_LINEAR_____0_CM 0. 255. DISPLAY_IDENTIFIER C_CTR_TI_CYL_LAM_DIF_ABSV_OK FORMAT "%3.0" /end CHARACTERISTIC
/begin CHARACTERISTIC c_ctr_cq_fil_fall_min "Least number of improvement cycles to extend the waiting time for evaluation of adaptation result - CQ - based" VALUE 0xa102924f _REC_VAL_20_u1 255. _CNV_A_R_LINEAR_____0_CM 0. 255. DISPLAY_IDENTIFIER C_CTR_CQ_FIL_FALL_MIN FORMAT "%3.0" /end CHARACTERISTIC
/begin CHARACTERISTIC c_ctr_cq_fil_fall_ok "Minimum number of improved cycles to accept the adaptation value - CQ - based" VALUE 0xa1029250 _REC_VAL_20_u1 255. _CNV_A_R_LINEAR_____0_CM 0. 255. DISPLAY_IDENTIFIER C_CTR_CQ_FIL_FALL_OK FORMAT "%3.0" /end CHARACTERISTIC
/begin CHARACTERISTIC c_ti_cyl_lam_dif_absv_max "Maximum of allowed TI_CYL_LAM oscillation space" VALUE 0xa1029a3e _REC_VAL_20_s2 99.99847412109381 _CNV_A_R_LINEAR_____110_CM -50. 49.9984741210938 DISPLAY_IDENTIFIER C_TI_CYL_LAM_DIF_ABSV_MAX FORMAT "%7.3" /end CHARACTERISTIC
/begin CHARACTERISTIC c_crk_cyl_lam_ini_red "CRK - initial reduction factor" VALUE 0xa10291d2 _REC_VAL_20_u1 720. _CNV_A_R_LINEAR_____109_CM 0. 720. DISPLAY_IDENTIFIER C_CRK_CYL_LAM_INI_RED FORMAT "%3.0" /end CHARACTERISTIC
/begin CHARACTERISTIC c_nr_seg_ref_cbk_ex_2 "Segment number for identification of the first fired cylinder of exhaust bank 2" VALUE 0xa10296bb _REC_VAL_20_u1 7. _CNV_A_R_LINEAR_____0_CM 0. 7. DISPLAY_IDENTIFIER C_NR_SEG_REF_CBK_EX_2 FORMAT "%3.0" /end CHARACTERISTIC
/begin CHARACTERISTIC c_egy_level_iv_bal_ofs "Cylinder balancing injection valve energy level offset" VALUE 0xa1029354 _REC_VAL_20_s2 100. _CNV_A_R_INJR_LINEA_480_CM -50. 50. DISPLAY_IDENTIFIER C_EGY_LEVEL_IV_BAL_OFS FORMAT "%7.3" /end CHARACTERISTIC
/begin MEASUREMENT egy_level_iv_bal_adj[0] "Cylinder balancing injection valve energy level adjustment" SWORD _CNV_A_R_INJR_LINEA_480_CM 1 100. -50. 50. DISPLAY_IDENTIFIER EGY_LEVEL_IV_BAL_ADJ[0] ECU_ADDRESS 0xc0000c2c FORMAT "%7.3" /end MEASUREMENT
/begin MEASUREMENT egy_level_iv_bal_adj[1] "Cylinder balancing injection valve energy level adjustment" SWORD _CNV_A_R_INJR_LINEA_480_CM 1 100. -50. 50. DISPLAY_IDENTIFIER EGY_LEVEL_IV_BAL_ADJ[1] ECU_ADDRESS 0xc0000c2e FORMAT "%7.3" /end MEASUREMENT
/begin MEASUREMENT egy_level_iv_bal_adj[2] "Cylinder balancing injection valve energy level adjustment" SWORD _CNV_A_R_INJR_LINEA_480_CM 1 100. -50. 50. DISPLAY_IDENTIFIER EGY_LEVEL_IV_BAL_ADJ[2] ECU_ADDRESS 0xc0000c30 FORMAT "%7.3" /end MEASUREMENT
/begin MEASUREMENT egy_level_iv_bal_adj[3] "Cylinder balancing injection valve energy level adjustment" SWORD _CNV_A_R_INJR_LINEA_480_CM 1 100. -50. 50. DISPLAY_IDENTIFIER EGY_LEVEL_IV_BAL_ADJ[3] ECU_ADDRESS 0xc0000c32 FORMAT "%7.3" /end MEASUREMENT
/begin MEASUREMENT egy_level_iv_bal_adj[4] "Cylinder balancing injection valve energy level adjustment" SWORD _CNV_A_R_INJR_LINEA_480_CM 1 100. -50. 50. DISPLAY_IDENTIFIER EGY_LEVEL_IV_BAL_ADJ[4] ECU_ADDRESS 0xc0000c34 FORMAT "%7.3" /end MEASUREMENT
/begin MEASUREMENT egy_level_iv_bal_adj[5] "Cylinder balancing injection valve energy level adjustment" SWORD _CNV_A_R_INJR_LINEA_480_CM 1 100. -50. 50. DISPLAY_IDENTIFIER EGY_LEVEL_IV_BAL_ADJ[5] ECU_ADDRESS 0xc0000c36 FORMAT "%7.3" /end MEASUREMENT
/begin MEASUREMENT nr_cyc_egy_level_iv_bal_ctl_max "Corresponding segment number of the controller that has reached the maximum limit" UBYTE _CNV_A_R_LINEAR_____0_CM 1 100. 0. 255. DISPLAY_IDENTIFIER NR_CYC_EGY_LEVEL_IV_BAL_CTL_MAX ECU_ADDRESS 0xc0000c5a FORMAT "%3.0" /end MEASUREMENT
/begin MEASUREMENT egy_level_iv_bal_ctl[0] "Cylinder balancing injection valve energy level control" SWORD _CNV_A_R_INJR_LINEA_480_CM 1 100. -50. 50. DISPLAY_IDENTIFIER EGY_LEVEL_IV_BAL_CTL[0] ECU_ADDRESS 0xc0000c3c FORMAT "%7.3" /end MEASUREMENT
/begin MEASUREMENT egy_level_iv_bal_ctl[1] "Cylinder balancing injection valve energy level control" SWORD _CNV_A_R_INJR_LINEA_480_CM 1 100. -50. 50. DISPLAY_IDENTIFIER EGY_LEVEL_IV_BAL_CTL[1] ECU_ADDRESS 0xc0000c3e FORMAT "%7.3" /end MEASUREMENT
/begin MEASUREMENT egy_level_iv_bal_ctl[2] "Cylinder balancing injection valve energy level control" SWORD _CNV_A_R_INJR_LINEA_480_CM 1 100. -50. 50. DISPLAY_IDENTIFIER EGY_LEVEL_IV_BAL_CTL[2] ECU_ADDRESS 0xc0000c40 FORMAT "%7.3" /end MEASUREMENT
/begin MEASUREMENT egy_level_iv_bal_ctl[3] "Cylinder balancing injection valve energy level control" SWORD _CNV_A_R_INJR_LINEA_480_CM 1 100. -50. 50. DISPLAY_IDENTIFIER EGY_LEVEL_IV_BAL_CTL[3] ECU_ADDRESS 0xc0000c42 FORMAT "%7.3" /end MEASUREMENT
/begin MEASUREMENT egy_level_iv_bal_ctl[4] "Cylinder balancing injection valve energy level control" SWORD _CNV_A_R_INJR_LINEA_480_CM 1 100. -50. 50. DISPLAY_IDENTIFIER EGY_LEVEL_IV_BAL_CTL[4] ECU_ADDRESS 0xc0000c44 FORMAT "%7.3" /end MEASUREMENT
/begin MEASUREMENT egy_level_iv_bal_ctl[5] "Cylinder balancing injection valve energy level control" SWORD _CNV_A_R_INJR_LINEA_480_CM 1 100. -50. 50. DISPLAY_IDENTIFIER EGY_LEVEL_IV_BAL_CTL[5] ECU_ADDRESS 0xc0000c46 FORMAT "%7.3" /end MEASUREMENT
/begin MEASUREMENT egy_level_iv_bal[0] "Cylinder balancing injection valve energy level" SWORD _CNV_A_R_INJR_LINEA_480_CM 1 100. -50. 50. DISPLAY_IDENTIFIER EGY_LEVEL_IV_BAL[0] ECU_ADDRESS 0xd00051f4 FORMAT "%7.3" /end MEASUREMENT
/begin MEASUREMENT egy_level_iv_bal[1] "Cylinder balancing injection valve energy level" SWORD _CNV_A_R_INJR_LINEA_480_CM 1 100. -50. 50. DISPLAY_IDENTIFIER EGY_LEVEL_IV_BAL[1] ECU_ADDRESS 0xd00051f6 FORMAT "%7.3" /end MEASUREMENT
/begin MEASUREMENT egy_level_iv_bal[2] "Cylinder balancing injection valve energy level" SWORD _CNV_A_R_INJR_LINEA_480_CM 1 100. -50. 50. DISPLAY_IDENTIFIER EGY_LEVEL_IV_BAL[2] ECU_ADDRESS 0xd00051f8 FORMAT "%7.3" /end MEASUREMENT
/begin MEASUREMENT egy_level_iv_bal[3] "Cylinder balancing injection valve energy level" SWORD _CNV_A_R_INJR_LINEA_480_CM 1 100. -50. 50. DISPLAY_IDENTIFIER EGY_LEVEL_IV_BAL[3] ECU_ADDRESS 0xd00051fa FORMAT "%7.3" /end MEASUREMENT
/begin MEASUREMENT egy_level_iv_bal[4] "Cylinder balancing injection valve energy level" SWORD _CNV_A_R_INJR_LINEA_480_CM 1 100. -50. 50. DISPLAY_IDENTIFIER EGY_LEVEL_IV_BAL[4] ECU_ADDRESS 0xd00051fc FORMAT "%7.3" /end MEASUREMENT
/begin MEASUREMENT egy_level_iv_bal[5] "Cylinder balancing injection valve energy level" SWORD _CNV_A_R_INJR_LINEA_480_CM 1 100. -50. 50. DISPLAY_IDENTIFIER EGY_LEVEL_IV_BAL[5] ECU_ADDRESS 0xd00051fe FORMAT "%7.3" /end MEASUREMENT
/begin MEASUREMENT ti_add_bal[0] "Total cylinder balancing additive correction value" SWORD _CNV_A_R_LINEAR_____233_CM 1 100. -32.768 32.767 DISPLAY_IDENTIFIER TI_ADD_BAL[0] ECU_ADDRESS 0xd00051d0 FORMAT "%7.3" /end MEASUREMENT
/begin MEASUREMENT ti_add_bal[1] "Total cylinder balancing additive correction value" SWORD _CNV_A_R_LINEAR_____233_CM 1 100. -32.768 32.767 DISPLAY_IDENTIFIER TI_ADD_BAL[1] ECU_ADDRESS 0xd00051d2 FORMAT "%7.3" /end MEASUREMENT
/begin MEASUREMENT ti_add_bal[2] "Total cylinder balancing additive correction value" SWORD _CNV_A_R_LINEAR_____233_CM 1 100. -32.768 32.767 DISPLAY_IDENTIFIER TI_ADD_BAL[2] ECU_ADDRESS 0xd00051d4 FORMAT "%7.3" /end MEASUREMENT
/begin MEASUREMENT ti_add_bal[3] "Total cylinder balancing additive correction value" SWORD _CNV_A_R_LINEAR_____233_CM 1 100. -32.768 32.767 DISPLAY_IDENTIFIER TI_ADD_BAL[3] ECU_ADDRESS 0xd00051d6 FORMAT "%7.3" /end MEASUREMENT
/begin MEASUREMENT ti_add_bal[4] "Total cylinder balancing additive correction value" SWORD _CNV_A_R_LINEAR_____233_CM 1 100. -32.768 32.767 DISPLAY_IDENTIFIER TI_ADD_BAL[4] ECU_ADDRESS 0xd00051d8 FORMAT "%7.3" /end MEASUREMENT
/begin MEASUREMENT ti_add_bal[5] "Total cylinder balancing additive correction value" SWORD _CNV_A_R_LINEAR_____233_CM 1 100. -32.768 32.767 DISPLAY_IDENTIFIER TI_ADD_BAL[5] ECU_ADDRESS 0xd00051da FORMAT "%7.3" /end MEASUREMENT
/begin MEASUREMENT fac_ti_bal[0] "Total cylinder balancing multiple correction factor" UWORD _CNV_A_R_LINEAR_____8_CM 1 100. 0. 1.99996948242188 DISPLAY_IDENTIFIER FAC_TI_BAL[0] ECU_ADDRESS 0xd00051dc FORMAT "%7.5" /end MEASUREMENT
/begin MEASUREMENT fac_ti_bal[1] "Total cylinder balancing multiple correction factor" UWORD _CNV_A_R_LINEAR_____8_CM 1 100. 0. 1.99996948242188 DISPLAY_IDENTIFIER FAC_TI_BAL[1] ECU_ADDRESS 0xd00051de FORMAT "%7.5" /end MEASUREMENT
/begin MEASUREMENT fac_ti_bal[2] "Total cylinder balancing multiple correction factor" UWORD _CNV_A_R_LINEAR_____8_CM 1 100. 0. 1.99996948242188 DISPLAY_IDENTIFIER FAC_TI_BAL[2] ECU_ADDRESS 0xd00051e0 FORMAT "%7.5" /end MEASUREMENT
/begin MEASUREMENT fac_ti_bal[3] "Total cylinder balancing multiple correction factor" UWORD _CNV_A_R_LINEAR_____8_CM 1 100. 0. 1.99996948242188 DISPLAY_IDENTIFIER FAC_TI_BAL[3] ECU_ADDRESS 0xd00051e2 FORMAT "%7.5" /end MEASUREMENT
/begin MEASUREMENT fac_ti_bal[4] "Total cylinder balancing multiple correction factor" UWORD _CNV_A_R_LINEAR_____8_CM 1 100. 0. 1.99996948242188 DISPLAY_IDENTIFIER FAC_TI_BAL[4] ECU_ADDRESS 0xd00051e4 FORMAT "%7.5" /end MEASUREMENT
/begin MEASUREMENT fac_ti_bal[5] "Total cylinder balancing multiple correction factor" UWORD _CNV_A_R_LINEAR_____8_CM 1 100. 0. 1.99996948242188 DISPLAY_IDENTIFIER FAC_TI_BAL[5] ECU_ADDRESS 0xd00051e6 FORMAT "%7.5" /end MEASUREMENT
/begin MEASUREMENT fac_ti_sum_bal[0] "Cylinder balancing multiple correction factor summary" SWORD _CNV_A_R_LINEAR_____275_CM 1 100. -1. 0.999969482421875 DISPLAY_IDENTIFIER FAC_TI_SUM_BAL[0] ECU_ADDRESS 0xc0000c14 FORMAT "%8.5" /end MEASUREMENT
/begin MEASUREMENT fac_ti_sum_bal[1] "Cylinder balancing multiple correction factor summary" SWORD _CNV_A_R_LINEAR_____275_CM 1 100. -1. 0.999969482421875 DISPLAY_IDENTIFIER FAC_TI_SUM_BAL[1] ECU_ADDRESS 0xc0000c16 FORMAT "%8.5" /end MEASUREMENT
/begin MEASUREMENT fac_ti_sum_bal[2] "Cylinder balancing multiple correction factor summary" SWORD _CNV_A_R_LINEAR_____275_CM 1 100. -1. 0.999969482421875 DISPLAY_IDENTIFIER FAC_TI_SUM_BAL[2] ECU_ADDRESS 0xc0000c18 FORMAT "%8.5" /end MEASUREMENT
/begin MEASUREMENT fac_ti_sum_bal[3] "Cylinder balancing multiple correction factor summary" SWORD _CNV_A_R_LINEAR_____275_CM 1 100. -1. 0.999969482421875 DISPLAY_IDENTIFIER FAC_TI_SUM_BAL[3] ECU_ADDRESS 0xc0000c1a FORMAT "%8.5" /end MEASUREMENT
/begin MEASUREMENT fac_ti_sum_bal[4] "Cylinder balancing multiple correction factor summary" SWORD _CNV_A_R_LINEAR_____275_CM 1 100. -1. 0.999969482421875 DISPLAY_IDENTIFIER FAC_TI_SUM_BAL[4] ECU_ADDRESS 0xc0000c1c FORMAT "%8.5" /end MEASUREMENT
/begin MEASUREMENT fac_ti_sum_bal[5] "Cylinder balancing multiple correction factor summary" SWORD _CNV_A_R_LINEAR_____275_CM 1 100. -1. 0.999969482421875 DISPLAY_IDENTIFIER FAC_TI_SUM_BAL[5] ECU_ADDRESS 0xc0000c1e FORMAT "%8.5" /end MEASUREMENT
/begin MEASUREMENT fac_ti_dif_bal[0] "Cylinder balancing multiple correction factor difference" SWORD _CNV_A_R_LINEAR_____275_CM 1 100. -1. 0.999969482421875 DISPLAY_IDENTIFIER FAC_TI_DIF_BAL[0] ECU_ADDRESS 0xc0000c20 FORMAT "%8.5" /end MEASUREMENT
/begin MEASUREMENT fac_ti_dif_bal[1] "Cylinder balancing multiple correction factor difference" SWORD _CNV_A_R_LINEAR_____275_CM 1 100. -1. 0.999969482421875 DISPLAY_IDENTIFIER FAC_TI_DIF_BAL[1] ECU_ADDRESS 0xc0000c22 FORMAT "%8.5" /end MEASUREMENT
/begin MEASUREMENT fac_ti_dif_bal[2] "Cylinder balancing multiple correction factor difference" SWORD _CNV_A_R_LINEAR_____275_CM 1 100. -1. 0.999969482421875 DISPLAY_IDENTIFIER FAC_TI_DIF_BAL[2] ECU_ADDRESS 0xc0000c24 FORMAT "%8.5" /end MEASUREMENT
/begin MEASUREMENT fac_ti_dif_bal[3] "Cylinder balancing multiple correction factor difference" SWORD _CNV_A_R_LINEAR_____275_CM 1 100. -1. 0.999969482421875 DISPLAY_IDENTIFIER FAC_TI_DIF_BAL[3] ECU_ADDRESS 0xc0000c26 FORMAT "%8.5" /end MEASUREMENT
/begin MEASUREMENT fac_ti_dif_bal[4] "Cylinder balancing multiple correction factor difference" SWORD _CNV_A_R_LINEAR_____275_CM 1 100. -1. 0.999969482421875 DISPLAY_IDENTIFIER FAC_TI_DIF_BAL[4] ECU_ADDRESS 0xc0000c28 FORMAT "%8.5" /end MEASUREMENT
/begin MEASUREMENT fac_ti_dif_bal[5] "Cylinder balancing multiple correction factor difference" SWORD _CNV_A_R_LINEAR_____275_CM 1 100. -1. 0.999969482421875 DISPLAY_IDENTIFIER FAC_TI_DIF_BAL[5] ECU_ADDRESS 0xc0000c2a FORMAT "%8.5" /end MEASUREMENT
/begin MEASUREMENT ctr_step_fac_ti_bal[0] "Number of cylinder balancing multiple correction steps" SBYTE _CNV_A_R_LINEAR_____0_CM 1 100. -128. 127. DISPLAY_IDENTIFIER CTR_STEP_FAC_TI_BAL[0] ECU_ADDRESS 0xc0000c54 FORMAT "%4.0" /end MEASUREMENT
/begin MEASUREMENT ctr_step_fac_ti_bal[1] "Number of cylinder balancing multiple correction steps" SBYTE _CNV_A_R_LINEAR_____0_CM 1 100. -128. 127. DISPLAY_IDENTIFIER CTR_STEP_FAC_TI_BAL[1] ECU_ADDRESS 0xc0000c55 FORMAT "%4.0" /end MEASUREMENT
/begin MEASUREMENT ctr_step_fac_ti_bal[2] "Number of cylinder balancing multiple correction steps" SBYTE _CNV_A_R_LINEAR_____0_CM 1 100. -128. 127. DISPLAY_IDENTIFIER CTR_STEP_FAC_TI_BAL[2] ECU_ADDRESS 0xc0000c56 FORMAT "%4.0" /end MEASUREMENT
/begin MEASUREMENT ctr_step_fac_ti_bal[3] "Number of cylinder balancing multiple correction steps" SBYTE _CNV_A_R_LINEAR_____0_CM 1 100. -128. 127. DISPLAY_IDENTIFIER CTR_STEP_FAC_TI_BAL[3] ECU_ADDRESS 0xc0000c57 FORMAT "%4.0" /end MEASUREMENT
/begin MEASUREMENT ctr_step_fac_ti_bal[4] "Number of cylinder balancing multiple correction steps" SBYTE _CNV_A_R_LINEAR_____0_CM 1 100. -128. 127. DISPLAY_IDENTIFIER CTR_STEP_FAC_TI_BAL[4] ECU_ADDRESS 0xc0000c58 FORMAT "%4.0" /end MEASUREMENT
/begin MEASUREMENT ctr_step_fac_ti_bal[5] "Number of cylinder balancing multiple correction steps" SBYTE _CNV_A_R_LINEAR_____0_CM 1 100. -128. 127. DISPLAY_IDENTIFIER CTR_STEP_FAC_TI_BAL[5] ECU_ADDRESS 0xc0000c59 FORMAT "%4.0" /end MEASUREMENT
/begin MEASUREMENT egy_level_iv_bal_ctl_max[0] "Cylinder balancing injection valve energy level maximum controller output value reached" UWORD _CNV_A_R_LINEAR_____0_CM 1 100. 0. 65535. DISPLAY_IDENTIFIER EGY_LEVEL_IV_BAL_CTL_MAX[0] ECU_ADDRESS 0xc0000c48 FORMAT "%5.0" /end MEASUREMENT
/begin MEASUREMENT egy_level_iv_bal_ctl_max[1] "Cylinder balancing injection valve energy level maximum controller output value reached" UWORD _CNV_A_R_LINEAR_____0_CM 1 100. 0. 65535. DISPLAY_IDENTIFIER EGY_LEVEL_IV_BAL_CTL_MAX[1] ECU_ADDRESS 0xc0000c4a FORMAT "%5.0" /end MEASUREMENT
/begin MEASUREMENT egy_level_iv_bal_ctl_max[2] "Cylinder balancing injection valve energy level maximum controller output value reached" UWORD _CNV_A_R_LINEAR_____0_CM 1 100. 0. 65535. DISPLAY_IDENTIFIER EGY_LEVEL_IV_BAL_CTL_MAX[2] ECU_ADDRESS 0xc0000c4c FORMAT "%5.0" /end MEASUREMENT
/begin MEASUREMENT egy_level_iv_bal_ctl_max[3] "Cylinder balancing injection valve energy level maximum controller output value reached" UWORD _CNV_A_R_LINEAR_____0_CM 1 100. 0. 65535. DISPLAY_IDENTIFIER EGY_LEVEL_IV_BAL_CTL_MAX[3] ECU_ADDRESS 0xc0000c4e FORMAT "%5.0" /end MEASUREMENT
/begin MEASUREMENT egy_level_iv_bal_ctl_max[4] "Cylinder balancing injection valve energy level maximum controller output value reached" UWORD _CNV_A_R_LINEAR_____0_CM 1 100. 0. 65535. DISPLAY_IDENTIFIER EGY_LEVEL_IV_BAL_CTL_MAX[4] ECU_ADDRESS 0xc0000c50 FORMAT "%5.0" /end MEASUREMENT
/begin MEASUREMENT egy_level_iv_bal_ctl_max[5] "Cylinder balancing injection valve energy level maximum controller output value reached" UWORD _CNV_A_R_LINEAR_____0_CM 1 100. 0. 65535. DISPLAY_IDENTIFIER EGY_LEVEL_IV_BAL_CTL_MAX[5] ECU_ADDRESS 0xc0000c52 FORMAT "%5.0" /end MEASUREMENT
/begin MEASUREMENT ctr_dly_ti_bal_cor_ena "Segment counter to delay cylinder balancing TI correction activation" UBYTE _CNV_A_R_LINEAR_____0_CM 1 100. 0. 255. DISPLAY_IDENTIFIER CTR_DLY_TI_BAL_COR_ENA ECU_ADDRESS 0xc0000c5b FORMAT "%3.0" /end MEASUREMENT
/begin CHARACTERISTIC c_egy_level_iv_bal_max_neg "Maximum negative threshold for injection valve energy level value" VALUE 0xa1029350 _REC_VAL_20_s2 100. _CNV_A_R_INJR_LINEA_480_CM -50. 50. DISPLAY_IDENTIFIER C_EGY_LEVEL_IV_BAL_MAX_NEG FORMAT "%7.3" /end CHARACTERISTIC
/begin CHARACTERISTIC c_egy_level_iv_bal_max_pos "Maximum positive threshold for injection valve energy level value" VALUE 0xa1029352 _REC_VAL_20_s2 100. _CNV_A_R_INJR_LINEA_480_CM -50. 50. DISPLAY_IDENTIFIER C_EGY_LEVEL_IV_BAL_MAX_POS FORMAT "%7.3" /end CHARACTERISTIC
/begin CHARACTERISTIC c_fac_ti_bal_act_man "Manual adjustment of activation conditions for injection valve energy level calculation" VALUE 0xa10293a5 _REC_VAL_20_u1 3. _CNV_S_4_CYBL_RANGE_563_CM 0. 3. DISPLAY_IDENTIFIER C_FAC_TI_BAL_ACT_MAN /end CHARACTERISTIC
/begin CHARACTERISTIC c_fac_ti_dif_bal "Threshold for cylinder balancing multiple correction difference" VALUE 0xa10293a6 _REC_VAL_20_u2 1.99996948242188 _CNV_A_R_LINEAR_____8_CM 0. 1.99996948242188 DISPLAY_IDENTIFIER C_FAC_TI_DIF_BAL FORMAT "%7.5" /end CHARACTERISTIC
/begin CHARACTERISTIC lc_fac_ti_bal_cor "Manual switch for cylinder balancing multiple correction at every engine operating state" VALUE 0xa1029d37 _REC_VAL_20_u1 1. _CNV_A_R_LINEAR_____0_CM 0. 1. DISPLAY_IDENTIFIER LC_FAC_TI_BAL_COR FORMAT "%1.0" /end CHARACTERISTIC
/begin CHARACTERISTIC lc_fac_ti_bal_rst_man "Manual switch for cylinder balancing multiple correction reset" VALUE 0xa1029d38 _REC_VAL_20_u1 1. _CNV_A_R_LINEAR_____0_CM 0. 1. DISPLAY_IDENTIFIER LC_FAC_TI_BAL_RST_MAN FORMAT "%1.0" /end CHARACTERISTIC
/begin CHARACTERISTIC c_ctr_dly_ti_bal_cor_ini "Segment counter initialization value to delay cylinder balancing TI correction activation" VALUE 0xa1029293 _REC_VAL_20_u1 255. _CNV_A_R_LINEAR_____0_CM 0. 255. DISPLAY_IDENTIFIER C_CTR_DLY_TI_BAL_COR_INI FORMAT "%3.0" /end CHARACTERISTIC
/begin MEASUREMENT egy_level_iv_bal_conv[0] "Cylinder balancing injection valve energy level converter output" SWORD _CNV_A_R_INJR_LINEA_480_CM 1 100. -50. 50. DISPLAY_IDENTIFIER EGY_LEVEL_IV_BAL_CONV[0] ECU_ADDRESS 0xd00051e8 FORMAT "%7.3" /end MEASUREMENT
/begin MEASUREMENT egy_level_iv_bal_conv[1] "Cylinder balancing injection valve energy level converter output" SWORD _CNV_A_R_INJR_LINEA_480_CM 1 100. -50. 50. DISPLAY_IDENTIFIER EGY_LEVEL_IV_BAL_CONV[1] ECU_ADDRESS 0xd00051ea FORMAT "%7.3" /end MEASUREMENT
/begin MEASUREMENT egy_level_iv_bal_conv[2] "Cylinder balancing injection valve energy level converter output" SWORD _CNV_A_R_INJR_LINEA_480_CM 1 100. -50. 50. DISPLAY_IDENTIFIER EGY_LEVEL_IV_BAL_CONV[2] ECU_ADDRESS 0xd00051ec FORMAT "%7.3" /end MEASUREMENT
/begin MEASUREMENT egy_level_iv_bal_conv[3] "Cylinder balancing injection valve energy level converter output" SWORD _CNV_A_R_INJR_LINEA_480_CM 1 100. -50. 50. DISPLAY_IDENTIFIER EGY_LEVEL_IV_BAL_CONV[3] ECU_ADDRESS 0xd00051ee FORMAT "%7.3" /end MEASUREMENT
/begin MEASUREMENT egy_level_iv_bal_conv[4] "Cylinder balancing injection valve energy level converter output" SWORD _CNV_A_R_INJR_LINEA_480_CM 1 100. -50. 50. DISPLAY_IDENTIFIER EGY_LEVEL_IV_BAL_CONV[4] ECU_ADDRESS 0xd00051f0 FORMAT "%7.3" /end MEASUREMENT
/begin MEASUREMENT egy_level_iv_bal_conv[5] "Cylinder balancing injection valve energy level converter output" SWORD _CNV_A_R_INJR_LINEA_480_CM 1 100. -50. 50. DISPLAY_IDENTIFIER EGY_LEVEL_IV_BAL_CONV[5] ECU_ADDRESS 0xd00051f2 FORMAT "%7.3" /end MEASUREMENT
/begin MEASUREMENT egy_level_iv_bal_lim "Cylinder balancing injection valve energy level converter output limited" SWORD _CNV_A_R_INJR_LINEA_480_CM 1 100. -50. 50. DISPLAY_IDENTIFIER EGY_LEVEL_IV_BAL_LIM ECU_ADDRESS 0xc0000c38 FORMAT "%7.3" /end MEASUREMENT
/begin AXIS_PTS ldp_fac_ti_sum_bal_ip_egy_bal "" 0xa10209ac online_dummy _REC_AXS_20_u2 1.99996948 _CNV_A_R_LINEAR_____249_CM 8 -1. 0.99996948 FORMAT "%8.5" /end AXIS_PTS
/begin AXIS_PTS ldp_n_ip_fac_egy_iv_bal_cor "" 0xa1020f40 n _REC_AXS_20_u2 8160. _CNV_A_R_LINEAR_____13_CM 8 0. 8160. FORMAT "%4.0" /end AXIS_PTS
/begin AXIS_PTS ldp_mff_sp_mv_ip_fac_egy_bal "" 0xa1020d4c mff_sp_mv _REC_AXS_20_u2 1389. _CNV_A_R_LINEAR_____108_CM 8 0. 1389. FORMAT "%7.2" /end AXIS_PTS
/begin CHARACTERISTIC ip_egy_level_iv_bal_conv "Index table for cylinder balancing injection valve energy level conversion" CURVE 0xa10233f0 _REC_CUR_20_u2_u2 100. _CNV_A_R_INJR_LINEA_540_CM -50. 50. DISPLAY_IDENTIFIER IP_EGY_LEVEL_IV_BAL_CONV FORMAT "%7.3"
 /begin AXIS_DESCR COM_AXIS online_dummy _CNV_A_R_LINEAR_____249_CM 8 -1. 0.99996948 FORMAT "%8.5" AXIS_PTS_REF ldp_fac_ti_sum_bal_ip_egy_bal /end AXIS_DESCR
/end CHARACTERISTIC
/begin CHARACTERISTIC ip_fac_egy_level_iv_bal_cor "Index table for cylinder balancing injection valve energy level correction factor" MAP 0xa10238b4 _REC_MAP_20_u2_u2_u2 1.99996948242188 _CNV_A_R_LINEAR_____8_CM 0. 1.99996948242188 DISPLAY_IDENTIFIER IP_FAC_EGY_LEVEL_IV_BAL_COR FORMAT "%7.5"
 /begin AXIS_DESCR COM_AXIS n _CNV_A_R_LINEAR_____13_CM 8 0. 8160. FORMAT "%4.0" AXIS_PTS_REF ldp_n_ip_fac_egy_iv_bal_cor /end AXIS_DESCR
 /begin AXIS_DESCR COM_AXIS mff_sp_mv _CNV_A_R_LINEAR_____108_CM 8 0. 1389. FORMAT "%7.2" AXIS_PTS_REF ldp_mff_sp_mv_ip_fac_egy_bal /end AXIS_DESCR
/end CHARACTERISTIC
/begin MEASUREMENT lv_inh_diag_tia_plaus "Inhibition of TIA plaus diagnosis due to present error" UBYTE _CNV_S_2_RANGE__0___1_CM 1 100. 0. 1. DISPLAY_IDENTIFIER LV_INH_DIAG_TIA_PLAUS ECU_ADDRESS 0xd0003b6d BIT_MASK 0x1 /end MEASUREMENT
/begin MEASUREMENT state_rbm_tia_plaus "Interface of TIA_PLAUS monitor with the Rate-Based Monitoring statistics" UBYTE _CNV_A_R_LINEAR_____0_CM 1 100. 0. 7. DISPLAY_IDENTIFIER STATE_RBM_TIA_PLAUS ECU_ADDRESS 0xd0003b6c FORMAT "%1.0" /end MEASUREMENT
/begin MEASUREMENT lv_inh_diag_maf "Inhibition of MAF diagnosis" UBYTE _CNV_S_2_RANGE__0___1_CM 1 100. 0. 1. DISPLAY_IDENTIFIER LV_INH_DIAG_MAF ECU_ADDRESS 0xd0003a0d BIT_MASK 0x1 /end MEASUREMENT
/begin MEASUREMENT lv_maf_bls_diag "MAF error and brake is active" UBYTE _CNV_S_2_RANGE__0___1_CM 1 100. 0. 1. DISPLAY_IDENTIFIER LV_MAF_BLS_DIAG ECU_ADDRESS 0xd0003a0e BIT_MASK 0x1 /end MEASUREMENT
/begin MEASUREMENT state_rbm_maf "Interface of MAF monitor with the Rate-Based Monitoring statistics" UBYTE _CNV_A_R_LINEAR_____0_CM 1 100. 0. 7. DISPLAY_IDENTIFIER STATE_RBM_MAF ECU_ADDRESS 0xd0003a0c FORMAT "%1.0" /end MEASUREMENT
/begin MEASUREMENT er_stnd_ti_add_er_bal "Controller input value at additive path of cylinder balancing via TI intervention" SWORD _CNV_A_R_LINEAR_____130_CM 1 100. -325.78 325.770057983398 DISPLAY_IDENTIFIER ER_STND_TI_ADD_ER_BAL ECU_ADDRESS 0xc000043e FORMAT "%8.3" /end MEASUREMENT
/begin MEASUREMENT lv_er_stnd_ti_add_er_bal "Flag for controller input at additive path of cylinder balancing via TI intervention" UBYTE _CNV_S_2_RANGE__0___1_CM 1 100. 0. 1. DISPLAY_IDENTIFIER LV_ER_STND_TI_ADD_ER_BAL ECU_ADDRESS 0xc000046b BIT_MASK 0x1 /end MEASUREMENT
/begin MEASUREMENT ti_add_er_bal_ctl "Controller output value at additive path of cylinder balancing via TI intervention" SWORD _CNV_A_R_LINEAR_____233_CM 1 100. -32.768 32.767 DISPLAY_IDENTIFIER TI_ADD_ER_BAL_CTL ECU_ADDRESS 0xc0000440 FORMAT "%7.3" /end MEASUREMENT
/begin MEASUREMENT ti_add_er_bal_ctl_p "P-part of the controller output value at additive path of cylinder balancing via TI intervention" SWORD _CNV_A_R_LINEAR_____233_CM 1 100. -32.768 32.767 DISPLAY_IDENTIFIER TI_ADD_ER_BAL_CTL_P ECU_ADDRESS 0xc0000442 FORMAT "%7.3" /end MEASUREMENT
/begin MEASUREMENT ti_add_er_bal_ctl_i[0] "I-part of the controller output value at additive path of cylinder balancing via TI intervention" SWORD _CNV_A_R_LINEAR_____233_CM 1 100. -32.768 32.767 DISPLAY_IDENTIFIER TI_ADD_ER_BAL_CTL_I[0] ECU_ADDRESS 0xc0000444 FORMAT "%7.3" /end MEASUREMENT
/begin MEASUREMENT ti_add_er_bal_ctl_i[1] "I-part of the controller output value at additive path of cylinder balancing via TI intervention" SWORD _CNV_A_R_LINEAR_____233_CM 1 100. -32.768 32.767 DISPLAY_IDENTIFIER TI_ADD_ER_BAL_CTL_I[1] ECU_ADDRESS 0xc0000446 FORMAT "%7.3" /end MEASUREMENT
/begin MEASUREMENT ti_add_er_bal_ctl_i[2] "I-part of the controller output value at additive path of cylinder balancing via TI intervention" SWORD _CNV_A_R_LINEAR_____233_CM 1 100. -32.768 32.767 DISPLAY_IDENTIFIER TI_ADD_ER_BAL_CTL_I[2] ECU_ADDRESS 0xc0000448 FORMAT "%7.3" /end MEASUREMENT
/begin MEASUREMENT ti_add_er_bal_ctl_i[3] "I-part of the controller output value at additive path of cylinder balancing via TI intervention" SWORD _CNV_A_R_LINEAR_____233_CM 1 100. -32.768 32.767 DISPLAY_IDENTIFIER TI_ADD_ER_BAL_CTL_I[3] ECU_ADDRESS 0xc000044a FORMAT "%7.3" /end MEASUREMENT
/begin MEASUREMENT ti_add_er_bal_ctl_i[4] "I-part of the controller output value at additive path of cylinder balancing via TI intervention" SWORD _CNV_A_R_LINEAR_____233_CM 1 100. -32.768 32.767 DISPLAY_IDENTIFIER TI_ADD_ER_BAL_CTL_I[4] ECU_ADDRESS 0xc000044c FORMAT "%7.3" /end MEASUREMENT
/begin MEASUREMENT ti_add_er_bal_ctl_i[5] "I-part of the controller output value at additive path of cylinder balancing via TI intervention" SWORD _CNV_A_R_LINEAR_____233_CM 1 100. -32.768 32.767 DISPLAY_IDENTIFIER TI_ADD_ER_BAL_CTL_I[5] ECU_ADDRESS 0xc000044e FORMAT "%7.3" /end MEASUREMENT
/begin MEASUREMENT ti_add_er_bal_ctl_max "Controller output value maximum limit reached at additive path of cylinder balancing via TI intervention" UWORD _CNV_A_R_LINEAR_____0_CM 1 100. 0. 65535. DISPLAY_IDENTIFIER TI_ADD_ER_BAL_CTL_MAX ECU_ADDRESS 0xc000043c FORMAT "%5.0" /end MEASUREMENT
/begin MEASUREMENT ti_add_er_bal_lim[0] "Limited controller output value at additive path of cylinder balancing via TI intervention" SWORD _CNV_A_R_LINEAR_____233_CM 1 100. -32.768 32.767 DISPLAY_IDENTIFIER TI_ADD_ER_BAL_LIM[0] ECU_ADDRESS 0xc0000450 FORMAT "%7.3" /end MEASUREMENT
/begin MEASUREMENT ti_add_er_bal_lim[1] "Limited controller output value at additive path of cylinder balancing via TI intervention" SWORD _CNV_A_R_LINEAR_____233_CM 1 100. -32.768 32.767 DISPLAY_IDENTIFIER TI_ADD_ER_BAL_LIM[1] ECU_ADDRESS 0xc0000452 FORMAT "%7.3" /end MEASUREMENT
/begin MEASUREMENT ti_add_er_bal_lim[2] "Limited controller output value at additive path of cylinder balancing via TI intervention" SWORD _CNV_A_R_LINEAR_____233_CM 1 100. -32.768 32.767 DISPLAY_IDENTIFIER TI_ADD_ER_BAL_LIM[2] ECU_ADDRESS 0xc0000454 FORMAT "%7.3" /end MEASUREMENT
/begin MEASUREMENT ti_add_er_bal_lim[3] "Limited controller output value at additive path of cylinder balancing via TI intervention" SWORD _CNV_A_R_LINEAR_____233_CM 1 100. -32.768 32.767 DISPLAY_IDENTIFIER TI_ADD_ER_BAL_LIM[3] ECU_ADDRESS 0xc0000456 FORMAT "%7.3" /end MEASUREMENT
/begin MEASUREMENT ti_add_er_bal_lim[4] "Limited controller output value at additive path of cylinder balancing via TI intervention" SWORD _CNV_A_R_LINEAR_____233_CM 1 100. -32.768 32.767 DISPLAY_IDENTIFIER TI_ADD_ER_BAL_LIM[4] ECU_ADDRESS 0xc0000458 FORMAT "%7.3" /end MEASUREMENT
/begin MEASUREMENT ti_add_er_bal_lim[5] "Limited controller output value at additive path of cylinder balancing via TI intervention" SWORD _CNV_A_R_LINEAR_____233_CM 1 100. -32.768 32.767 DISPLAY_IDENTIFIER TI_ADD_ER_BAL_LIM[5] ECU_ADDRESS 0xc000045a FORMAT "%7.3" /end MEASUREMENT
/begin MEASUREMENT ti_add_er_bal_cor[0] "Corrected additive correction value for cylinder balancing via TI intervention" SWORD _CNV_A_R_LINEAR_____233_CM 1 100. -32.768 32.767 DISPLAY_IDENTIFIER TI_ADD_ER_BAL_COR[0] ECU_ADDRESS 0xc000045c FORMAT "%7.3" /end MEASUREMENT
/begin MEASUREMENT ti_add_er_bal_cor[1] "Corrected additive correction value for cylinder balancing via TI intervention" SWORD _CNV_A_R_LINEAR_____233_CM 1 100. -32.768 32.767 DISPLAY_IDENTIFIER TI_ADD_ER_BAL_COR[1] ECU_ADDRESS 0xc000045e FORMAT "%7.3" /end MEASUREMENT
/begin MEASUREMENT ti_add_er_bal_cor[2] "Corrected additive correction value for cylinder balancing via TI intervention" SWORD _CNV_A_R_LINEAR_____233_CM 1 100. -32.768 32.767 DISPLAY_IDENTIFIER TI_ADD_ER_BAL_COR[2] ECU_ADDRESS 0xc0000460 FORMAT "%7.3" /end MEASUREMENT
/begin MEASUREMENT ti_add_er_bal_cor[3] "Corrected additive correction value for cylinder balancing via TI intervention" SWORD _CNV_A_R_LINEAR_____233_CM 1 100. -32.768 32.767 DISPLAY_IDENTIFIER TI_ADD_ER_BAL_COR[3] ECU_ADDRESS 0xc0000462 FORMAT "%7.3" /end MEASUREMENT
/begin MEASUREMENT ti_add_er_bal_cor[4] "Corrected additive correction value for cylinder balancing via TI intervention" SWORD _CNV_A_R_LINEAR_____233_CM 1 100. -32.768 32.767 DISPLAY_IDENTIFIER TI_ADD_ER_BAL_COR[4] ECU_ADDRESS 0xc0000464 FORMAT "%7.3" /end MEASUREMENT
/begin MEASUREMENT ti_add_er_bal_cor[5] "Corrected additive correction value for cylinder balancing via TI intervention" SWORD _CNV_A_R_LINEAR_____233_CM 1 100. -32.768 32.767 DISPLAY_IDENTIFIER TI_ADD_ER_BAL_COR[5] ECU_ADDRESS 0xc0000466 FORMAT "%7.3" /end MEASUREMENT
/begin MEASUREMENT ti_add_er_bal[0] "Additive correction value for cylinder balancing via TI intervention" SWORD _CNV_A_R_LINEAR_____233_CM 1 100. -32.768 32.767 DISPLAY_IDENTIFIER TI_ADD_ER_BAL[0] ECU_ADDRESS 0xd0005170 FORMAT "%7.3" /end MEASUREMENT
/begin MEASUREMENT ti_add_er_bal[1] "Additive correction value for cylinder balancing via TI intervention" SWORD _CNV_A_R_LINEAR_____233_CM 1 100. -32.768 32.767 DISPLAY_IDENTIFIER TI_ADD_ER_BAL[1] ECU_ADDRESS 0xd0005172 FORMAT "%7.3" /end MEASUREMENT
/begin MEASUREMENT ti_add_er_bal[2] "Additive correction value for cylinder balancing via TI intervention" SWORD _CNV_A_R_LINEAR_____233_CM 1 100. -32.768 32.767 DISPLAY_IDENTIFIER TI_ADD_ER_BAL[2] ECU_ADDRESS 0xd0005174 FORMAT "%7.3" /end MEASUREMENT
/begin MEASUREMENT ti_add_er_bal[3] "Additive correction value for cylinder balancing via TI intervention" SWORD _CNV_A_R_LINEAR_____233_CM 1 100. -32.768 32.767 DISPLAY_IDENTIFIER TI_ADD_ER_BAL[3] ECU_ADDRESS 0xd0005176 FORMAT "%7.3" /end MEASUREMENT
/begin MEASUREMENT ti_add_er_bal[4] "Additive correction value for cylinder balancing via TI intervention" SWORD _CNV_A_R_LINEAR_____233_CM 1 100. -32.768 32.767 DISPLAY_IDENTIFIER TI_ADD_ER_BAL[4] ECU_ADDRESS 0xd0005178 FORMAT "%7.3" /end MEASUREMENT
/begin MEASUREMENT ti_add_er_bal[5] "Additive correction value for cylinder balancing via TI intervention" SWORD _CNV_A_R_LINEAR_____233_CM 1 100. -32.768 32.767 DISPLAY_IDENTIFIER TI_ADD_ER_BAL[5] ECU_ADDRESS 0xd000517a FORMAT "%7.3" /end MEASUREMENT
/begin MEASUREMENT ti_add_ad_er_bal[0] "Additive adaptation value for cylinder balancing via TI intervention" SWORD _CNV_A_R_LINEAR_____233_CM 1 100. -32.768 32.767 DISPLAY_IDENTIFIER TI_ADD_AD_ER_BAL[0] ECU_ADDRESS 0xd000517c FORMAT "%7.3" /end MEASUREMENT
/begin MEASUREMENT ti_add_ad_er_bal[1] "Additive adaptation value for cylinder balancing via TI intervention" SWORD _CNV_A_R_LINEAR_____233_CM 1 100. -32.768 32.767 DISPLAY_IDENTIFIER TI_ADD_AD_ER_BAL[1] ECU_ADDRESS 0xd000517e FORMAT "%7.3" /end MEASUREMENT
/begin MEASUREMENT ti_add_ad_er_bal[2] "Additive adaptation value for cylinder balancing via TI intervention" SWORD _CNV_A_R_LINEAR_____233_CM 1 100. -32.768 32.767 DISPLAY_IDENTIFIER TI_ADD_AD_ER_BAL[2] ECU_ADDRESS 0xd0005180 FORMAT "%7.3" /end MEASUREMENT
/begin MEASUREMENT ti_add_ad_er_bal[3] "Additive adaptation value for cylinder balancing via TI intervention" SWORD _CNV_A_R_LINEAR_____233_CM 1 100. -32.768 32.767 DISPLAY_IDENTIFIER TI_ADD_AD_ER_BAL[3] ECU_ADDRESS 0xd0005182 FORMAT "%7.3" /end MEASUREMENT
/begin MEASUREMENT ti_add_ad_er_bal[4] "Additive adaptation value for cylinder balancing via TI intervention" SWORD _CNV_A_R_LINEAR_____233_CM 1 100. -32.768 32.767 DISPLAY_IDENTIFIER TI_ADD_AD_ER_BAL[4] ECU_ADDRESS 0xd0005184 FORMAT "%7.3" /end MEASUREMENT
/begin MEASUREMENT ti_add_ad_er_bal[5] "Additive adaptation value for cylinder balancing via TI intervention" SWORD _CNV_A_R_LINEAR_____233_CM 1 100. -32.768 32.767 DISPLAY_IDENTIFIER TI_ADD_AD_ER_BAL[5] ECU_ADDRESS 0xd0005186 FORMAT "%7.3" /end MEASUREMENT
/begin MEASUREMENT nr_cyc_ti_add_er_bal_ctl_max "Corresponding segment number of the controller that has reached the maximum limit (additive TI path)" UBYTE _CNV_A_R_LINEAR_____0_CM 1 100. 0. 255. DISPLAY_IDENTIFIER NR_CYC_TI_ADD_ER_BAL_CTL_MAX ECU_ADDRESS 0xc0000468 FORMAT "%3.0" /end MEASUREMENT
/begin CHARACTERISTIC c_er_stnd_thd_pos_ti_add_bal "Positive threshold for ER input value at additive path of cylinder balancing via TI intervention" VALUE 0xa1029368 _REC_VAL_20_s2 651.5500579833979 _CNV_A_R_LINEAR_____130_CM -325.78 325.770057983398 DISPLAY_IDENTIFIER C_ER_STND_THD_POS_TI_ADD_BAL FORMAT "%8.3" /end CHARACTERISTIC
/begin CHARACTERISTIC c_er_stnd_thd_neg_ti_add_bal "Negative threshold for ER input value at additive path of  cylinder balancing via TI intervention" VALUE 0xa1029364 _REC_VAL_20_s2 651.5500579833979 _CNV_A_R_LINEAR_____130_CM -325.78 325.770057983398 DISPLAY_IDENTIFIER C_ER_STND_THD_NEG_TI_ADD_BAL FORMAT "%8.3" /end CHARACTERISTIC
/begin CHARACTERISTIC c_ti_add_er_bal_ctl_max_pos "Positive maximum limit for controller output at additive path of cylinder balancing via TI intervention" VALUE 0xa1029a38 _REC_VAL_20_s2 65.535 _CNV_A_R_LINEAR_____233_CM -32.768 32.767 DISPLAY_IDENTIFIER C_TI_ADD_ER_BAL_CTL_MAX_POS FORMAT "%7.3" /end CHARACTERISTIC
/begin CHARACTERISTIC c_ti_add_er_bal_ctl_max_neg "Negative maximum limit for controller output at additive path of cylinder balancing via TI intervention" VALUE 0xa1029a36 _REC_VAL_20_s2 65.535 _CNV_A_R_LINEAR_____233_CM -32.768 32.767 DISPLAY_IDENTIFIER C_TI_ADD_ER_BAL_CTL_MAX_NEG FORMAT "%7.3" /end CHARACTERISTIC
/begin CHARACTERISTIC c_cycnr_ti_er_bal "Number of cycles for calculation of controller output values for cylinder balancing via TI intervention" VALUE 0xa10292e7 _REC_VAL_20_u1 254. _CNV_A_R_LINEAR_____0_CM 1. 255. DISPLAY_IDENTIFIER C_CYCNR_TI_ER_BAL FORMAT "%3.0" /end CHARACTERISTIC
/begin CHARACTERISTIC lc_ti_er_bal_cor "Manual switch for overall correction of controller output values for cylinder balancing via TI intervention" VALUE 0xa1029df1 _REC_VAL_20_u1 1. _CNV_A_R_LINEAR_____0_CM 0. 1. DISPLAY_IDENTIFIER LC_TI_ER_BAL_COR FORMAT "%1.0" /end CHARACTERISTIC
/begin CHARACTERISTIC lc_ti_add_ad_er_bal_rst_man "Manual reset of additive adaptation values for cylinder balancing via TI intervention" VALUE 0xa1029dee _REC_VAL_20_u1 1. _CNV_A_R_LINEAR_____0_CM 0. 1. DISPLAY_IDENTIFIER LC_TI_ADD_AD_ER_BAL_RST_MAN FORMAT "%1.0" /end CHARACTERISTIC
/begin CHARACTERISTIC c_ti_add_er_bal_rst "Reset of additive correction- and adaptation values for cylinder balancing via TI intervention" VALUE 0xa1029a3a _REC_VAL_20_u1 2. _CNV_S_3_CYBL_RANGE_806_CM 0. 2. DISPLAY_IDENTIFIER C_TI_ADD_ER_BAL_RST /end CHARACTERISTIC
/begin AXIS_PTS ldp_er_stnd_ti_add_ip_p_er_bal "" 0xa102097c er_stnd_ti_add_er_bal _REC_AXS_20_u2 651.5500579833979 _CNV_A_R_LINEAR_____128_CM 8 -325.78 325.770057983398 FORMAT "%8.3" /end AXIS_PTS
/begin CHARACTERISTIC ip_ti_add_p_er_bal "Controller P-part value for additive path of cylinder balancing via TI intervention" CURVE 0xa1027e94 _REC_CUR_20_u2_u2 65.535 _CNV_A_R_INJR_LINEA_476_CM -32.768 32.767 DISPLAY_IDENTIFIER IP_TI_ADD_P_ER_BAL FORMAT "%7.3"
 /begin AXIS_DESCR COM_AXIS er_stnd_ti_add_er_bal _CNV_A_R_LINEAR_____128_CM 8 -325.78 325.770057983398 FORMAT "%8.3" AXIS_PTS_REF ldp_er_stnd_ti_add_ip_p_er_bal /end AXIS_DESCR
/end CHARACTERISTIC
/begin AXIS_PTS ldp_er_stnd_ti_add_ip_i_er_bal "" 0xa1020968 er_stnd_ti_add_er_bal _REC_AXS_20_u2 651.5500579833979 _CNV_A_R_LINEAR_____128_CM 8 -325.78 325.770057983398 FORMAT "%8.3" /end AXIS_PTS
/begin CHARACTERISTIC ip_ti_add_i_er_bal "Controller I-part value for additive path of cylinder balancing via TI intervention" CURVE 0xa1027e84 _REC_CUR_20_u2_u2 65.535 _CNV_A_R_INJR_LINEA_476_CM -32.768 32.767 DISPLAY_IDENTIFIER IP_TI_ADD_I_ER_BAL FORMAT "%7.3"
 /begin AXIS_DESCR COM_AXIS er_stnd_ti_add_er_bal _CNV_A_R_LINEAR_____128_CM 8 -325.78 325.770057983398 FORMAT "%8.3" AXIS_PTS_REF ldp_er_stnd_ti_add_ip_i_er_bal /end AXIS_DESCR
/end CHARACTERISTIC
/begin CHARACTERISTIC lc_ti_add_er_bal_rst_man "Manual reset of additive correction values for cylinder balancing via TI intervention" VALUE 0xa1029df0 _REC_VAL_20_u1 1. _CNV_A_R_LINEAR_____0_CM 0. 1. DISPLAY_IDENTIFIER LC_TI_ADD_ER_BAL_RST_MAN FORMAT "%1.0" /end CHARACTERISTIC
/begin MEASUREMENT er_stnd_fac_ti_er_bal "Controller input value at multiple path of cylinder balancing via TI intervention" SWORD _CNV_A_R_LINEAR_____130_CM 1 100. -325.78 325.770057983398 DISPLAY_IDENTIFIER ER_STND_FAC_TI_ER_BAL ECU_ADDRESS 0xc0000472 FORMAT "%8.3" /end MEASUREMENT
/begin MEASUREMENT lv_er_stnd_fac_ti_er_bal "Flag for controller input at multiple path of cylinder balancing via TI intervention" UBYTE _CNV_S_2_RANGE__0___1_CM 1 100. 0. 1. DISPLAY_IDENTIFIER LV_ER_STND_FAC_TI_ER_BAL ECU_ADDRESS 0xc000049f BIT_MASK 0x1 /end MEASUREMENT
/begin MEASUREMENT fac_ti_er_bal_ctl "Controller output value at multiple path of cylinder balancing via TI intervention" SWORD _CNV_A_R_LINEAR_____275_CM 1 100. -1. 0.999969482421875 DISPLAY_IDENTIFIER FAC_TI_ER_BAL_CTL ECU_ADDRESS 0xc0000474 FORMAT "%8.5" /end MEASUREMENT
/begin MEASUREMENT fac_ti_er_bal_ctl_p "P-part of the controller output value at multiple path of cylinder balancing via TI intervention" SWORD _CNV_A_R_LINEAR_____275_CM 1 100. -1. 0.999969482421875 DISPLAY_IDENTIFIER FAC_TI_ER_BAL_CTL_P ECU_ADDRESS 0xc0000476 FORMAT "%8.5" /end MEASUREMENT
/begin MEASUREMENT fac_ti_er_bal_ctl_i[0] "I-part of the controller output value at multiple path of cylinder balancing via TI intervention" SWORD _CNV_A_R_LINEAR_____275_CM 1 100. -1. 0.999969482421875 DISPLAY_IDENTIFIER FAC_TI_ER_BAL_CTL_I[0] ECU_ADDRESS 0xc0000478 FORMAT "%8.5" /end MEASUREMENT
/begin MEASUREMENT fac_ti_er_bal_ctl_i[1] "I-part of the controller output value at multiple path of cylinder balancing via TI intervention" SWORD _CNV_A_R_LINEAR_____275_CM 1 100. -1. 0.999969482421875 DISPLAY_IDENTIFIER FAC_TI_ER_BAL_CTL_I[1] ECU_ADDRESS 0xc000047a FORMAT "%8.5" /end MEASUREMENT
/begin MEASUREMENT fac_ti_er_bal_ctl_i[2] "I-part of the controller output value at multiple path of cylinder balancing via TI intervention" SWORD _CNV_A_R_LINEAR_____275_CM 1 100. -1. 0.999969482421875 DISPLAY_IDENTIFIER FAC_TI_ER_BAL_CTL_I[2] ECU_ADDRESS 0xc000047c FORMAT "%8.5" /end MEASUREMENT
/begin MEASUREMENT fac_ti_er_bal_ctl_i[3] "I-part of the controller output value at multiple path of cylinder balancing via TI intervention" SWORD _CNV_A_R_LINEAR_____275_CM 1 100. -1. 0.999969482421875 DISPLAY_IDENTIFIER FAC_TI_ER_BAL_CTL_I[3] ECU_ADDRESS 0xc000047e FORMAT "%8.5" /end MEASUREMENT
/begin MEASUREMENT fac_ti_er_bal_ctl_i[4] "I-part of the controller output value at multiple path of cylinder balancing via TI intervention" SWORD _CNV_A_R_LINEAR_____275_CM 1 100. -1. 0.999969482421875 DISPLAY_IDENTIFIER FAC_TI_ER_BAL_CTL_I[4] ECU_ADDRESS 0xc0000480 FORMAT "%8.5" /end MEASUREMENT
/begin MEASUREMENT fac_ti_er_bal_ctl_i[5] "I-part of the controller output value at multiple path of cylinder balancing via TI intervention" SWORD _CNV_A_R_LINEAR_____275_CM 1 100. -1. 0.999969482421875 DISPLAY_IDENTIFIER FAC_TI_ER_BAL_CTL_I[5] ECU_ADDRESS 0xc0000482 FORMAT "%8.5" /end MEASUREMENT
/begin MEASUREMENT fac_ti_er_bal_ctl_max "Controller output value maximum limit reached at multiple path of cylinder balancing via TI intervention" UWORD _CNV_A_R_LINEAR_____0_CM 1 100. 0. 65535. DISPLAY_IDENTIFIER FAC_TI_ER_BAL_CTL_MAX ECU_ADDRESS 0xc0000470 FORMAT "%5.0" /end MEASUREMENT
/begin MEASUREMENT fac_ti_er_bal_lim[0] "Limited controller output value at multiple path of cylinder balancing via TI intervention" SWORD _CNV_A_R_LINEAR_____275_CM 1 100. -1. 0.999969482421875 DISPLAY_IDENTIFIER FAC_TI_ER_BAL_LIM[0] ECU_ADDRESS 0xc0000484 FORMAT "%8.5" /end MEASUREMENT
/begin MEASUREMENT fac_ti_er_bal_lim[1] "Limited controller output value at multiple path of cylinder balancing via TI intervention" SWORD _CNV_A_R_LINEAR_____275_CM 1 100. -1. 0.999969482421875 DISPLAY_IDENTIFIER FAC_TI_ER_BAL_LIM[1] ECU_ADDRESS 0xc0000486 FORMAT "%8.5" /end MEASUREMENT
/begin MEASUREMENT fac_ti_er_bal_lim[2] "Limited controller output value at multiple path of cylinder balancing via TI intervention" SWORD _CNV_A_R_LINEAR_____275_CM 1 100. -1. 0.999969482421875 DISPLAY_IDENTIFIER FAC_TI_ER_BAL_LIM[2] ECU_ADDRESS 0xc0000488 FORMAT "%8.5" /end MEASUREMENT
/begin MEASUREMENT fac_ti_er_bal_lim[3] "Limited controller output value at multiple path of cylinder balancing via TI intervention" SWORD _CNV_A_R_LINEAR_____275_CM 1 100. -1. 0.999969482421875 DISPLAY_IDENTIFIER FAC_TI_ER_BAL_LIM[3] ECU_ADDRESS 0xc000048a FORMAT "%8.5" /end MEASUREMENT
/begin MEASUREMENT fac_ti_er_bal_lim[4] "Limited controller output value at multiple path of cylinder balancing via TI intervention" SWORD _CNV_A_R_LINEAR_____275_CM 1 100. -1. 0.999969482421875 DISPLAY_IDENTIFIER FAC_TI_ER_BAL_LIM[4] ECU_ADDRESS 0xc000048c FORMAT "%8.5" /end MEASUREMENT
/begin MEASUREMENT fac_ti_er_bal_lim[5] "Limited controller output value at multiple path of cylinder balancing via TI intervention" SWORD _CNV_A_R_LINEAR_____275_CM 1 100. -1. 0.999969482421875 DISPLAY_IDENTIFIER FAC_TI_ER_BAL_LIM[5] ECU_ADDRESS 0xc000048e FORMAT "%8.5" /end MEASUREMENT
/begin MEASUREMENT fac_ti_er_bal_cor[0] "Corrected multiple correction value for cylinder balancing via TI intervention" SWORD _CNV_A_R_LINEAR_____275_CM 1 100. -1. 0.999969482421875 DISPLAY_IDENTIFIER FAC_TI_ER_BAL_COR[0] ECU_ADDRESS 0xc0000490 FORMAT "%8.5" /end MEASUREMENT
/begin MEASUREMENT fac_ti_er_bal_cor[1] "Corrected multiple correction value for cylinder balancing via TI intervention" SWORD _CNV_A_R_LINEAR_____275_CM 1 100. -1. 0.999969482421875 DISPLAY_IDENTIFIER FAC_TI_ER_BAL_COR[1] ECU_ADDRESS 0xc0000492 FORMAT "%8.5" /end MEASUREMENT
/begin MEASUREMENT fac_ti_er_bal_cor[2] "Corrected multiple correction value for cylinder balancing via TI intervention" SWORD _CNV_A_R_LINEAR_____275_CM 1 100. -1. 0.999969482421875 DISPLAY_IDENTIFIER FAC_TI_ER_BAL_COR[2] ECU_ADDRESS 0xc0000494 FORMAT "%8.5" /end MEASUREMENT
/begin MEASUREMENT fac_ti_er_bal_cor[3] "Corrected multiple correction value for cylinder balancing via TI intervention" SWORD _CNV_A_R_LINEAR_____275_CM 1 100. -1. 0.999969482421875 DISPLAY_IDENTIFIER FAC_TI_ER_BAL_COR[3] ECU_ADDRESS 0xc0000496 FORMAT "%8.5" /end MEASUREMENT
/begin MEASUREMENT fac_ti_er_bal_cor[4] "Corrected multiple correction value for cylinder balancing via TI intervention" SWORD _CNV_A_R_LINEAR_____275_CM 1 100. -1. 0.999969482421875 DISPLAY_IDENTIFIER FAC_TI_ER_BAL_COR[4] ECU_ADDRESS 0xc0000498 FORMAT "%8.5" /end MEASUREMENT
/begin MEASUREMENT fac_ti_er_bal_cor[5] "Corrected multiple correction value for cylinder balancing via TI intervention" SWORD _CNV_A_R_LINEAR_____275_CM 1 100. -1. 0.999969482421875 DISPLAY_IDENTIFIER FAC_TI_ER_BAL_COR[5] ECU_ADDRESS 0xc000049a FORMAT "%8.5" /end MEASUREMENT
/begin MEASUREMENT fac_ti_er_bal[0] "Multiple correction value for cylinder balancing via TI intervention" SWORD _CNV_A_R_LINEAR_____275_CM 1 100. -1. 0.999969482421875 DISPLAY_IDENTIFIER FAC_TI_ER_BAL[0] ECU_ADDRESS 0xd0005188 FORMAT "%8.5" /end MEASUREMENT
/begin MEASUREMENT fac_ti_er_bal[1] "Multiple correction value for cylinder balancing via TI intervention" SWORD _CNV_A_R_LINEAR_____275_CM 1 100. -1. 0.999969482421875 DISPLAY_IDENTIFIER FAC_TI_ER_BAL[1] ECU_ADDRESS 0xd000518a FORMAT "%8.5" /end MEASUREMENT
/begin MEASUREMENT fac_ti_er_bal[2] "Multiple correction value for cylinder balancing via TI intervention" SWORD _CNV_A_R_LINEAR_____275_CM 1 100. -1. 0.999969482421875 DISPLAY_IDENTIFIER FAC_TI_ER_BAL[2] ECU_ADDRESS 0xd000518c FORMAT "%8.5" /end MEASUREMENT
/begin MEASUREMENT fac_ti_er_bal[3] "Multiple correction value for cylinder balancing via TI intervention" SWORD _CNV_A_R_LINEAR_____275_CM 1 100. -1. 0.999969482421875 DISPLAY_IDENTIFIER FAC_TI_ER_BAL[3] ECU_ADDRESS 0xd000518e FORMAT "%8.5" /end MEASUREMENT
/begin MEASUREMENT fac_ti_er_bal[4] "Multiple correction value for cylinder balancing via TI intervention" SWORD _CNV_A_R_LINEAR_____275_CM 1 100. -1. 0.999969482421875 DISPLAY_IDENTIFIER FAC_TI_ER_BAL[4] ECU_ADDRESS 0xd0005190 FORMAT "%8.5" /end MEASUREMENT
/begin MEASUREMENT fac_ti_er_bal[5] "Multiple correction value for cylinder balancing via TI intervention" SWORD _CNV_A_R_LINEAR_____275_CM 1 100. -1. 0.999969482421875 DISPLAY_IDENTIFIER FAC_TI_ER_BAL[5] ECU_ADDRESS 0xd0005192 FORMAT "%8.5" /end MEASUREMENT
/begin MEASUREMENT fac_ti_ad_er_bal[0] "Multiple adaptation value for cylinder balancing via TI intervention" SWORD _CNV_A_R_LINEAR_____275_CM 1 100. -1. 0.999969482421875 DISPLAY_IDENTIFIER FAC_TI_AD_ER_BAL[0] ECU_ADDRESS 0xd0005194 FORMAT "%8.5" /end MEASUREMENT
/begin MEASUREMENT fac_ti_ad_er_bal[1] "Multiple adaptation value for cylinder balancing via TI intervention" SWORD _CNV_A_R_LINEAR_____275_CM 1 100. -1. 0.999969482421875 DISPLAY_IDENTIFIER FAC_TI_AD_ER_BAL[1] ECU_ADDRESS 0xd0005196 FORMAT "%8.5" /end MEASUREMENT
/begin MEASUREMENT fac_ti_ad_er_bal[2] "Multiple adaptation value for cylinder balancing via TI intervention" SWORD _CNV_A_R_LINEAR_____275_CM 1 100. -1. 0.999969482421875 DISPLAY_IDENTIFIER FAC_TI_AD_ER_BAL[2] ECU_ADDRESS 0xd0005198 FORMAT "%8.5" /end MEASUREMENT
/begin MEASUREMENT fac_ti_ad_er_bal[3] "Multiple adaptation value for cylinder balancing via TI intervention" SWORD _CNV_A_R_LINEAR_____275_CM 1 100. -1. 0.999969482421875 DISPLAY_IDENTIFIER FAC_TI_AD_ER_BAL[3] ECU_ADDRESS 0xd000519a FORMAT "%8.5" /end MEASUREMENT
/begin MEASUREMENT fac_ti_ad_er_bal[4] "Multiple adaptation value for cylinder balancing via TI intervention" SWORD _CNV_A_R_LINEAR_____275_CM 1 100. -1. 0.999969482421875 DISPLAY_IDENTIFIER FAC_TI_AD_ER_BAL[4] ECU_ADDRESS 0xd000519c FORMAT "%8.5" /end MEASUREMENT
/begin MEASUREMENT fac_ti_ad_er_bal[5] "Multiple adaptation value for cylinder balancing via TI intervention" SWORD _CNV_A_R_LINEAR_____275_CM 1 100. -1. 0.999969482421875 DISPLAY_IDENTIFIER FAC_TI_AD_ER_BAL[5] ECU_ADDRESS 0xd000519e FORMAT "%8.5" /end MEASUREMENT
/begin MEASUREMENT nr_cyc_fac_ti_er_bal_ctl_max "Corresponding segment number of the controller that has reached the maximum limit (multiple TI path)" UBYTE _CNV_A_R_LINEAR_____0_CM 1 100. 0. 255. DISPLAY_IDENTIFIER NR_CYC_FAC_TI_ER_BAL_CTL_MAX ECU_ADDRESS 0xc000049c FORMAT "%3.0" /end MEASUREMENT
/begin CHARACTERISTIC c_er_stnd_thd_pos_fac_ti_bal "Positive threshold for ER input value at multiple path of cylinder balancing via TI intervention" VALUE 0xa1029366 _REC_VAL_20_s2 651.5500579833979 _CNV_A_R_LINEAR_____130_CM -325.78 325.770057983398 DISPLAY_IDENTIFIER C_ER_STND_THD_POS_FAC_TI_BAL FORMAT "%8.3" /end CHARACTERISTIC
/begin CHARACTERISTIC c_er_stnd_thd_neg_fac_ti_bal "Negative threshold for ER input value at multiple path of  cylinder balancing via TI intervention" VALUE 0xa1029362 _REC_VAL_20_s2 651.5500579833979 _CNV_A_R_LINEAR_____130_CM -325.78 325.770057983398 DISPLAY_IDENTIFIER C_ER_STND_THD_NEG_FAC_TI_BAL FORMAT "%8.3" /end CHARACTERISTIC
/begin CHARACTERISTIC c_fac_ti_er_bal_ctl_max_pos "Positive maximum limit for controller output at multiple path of cylinder balancing via TI intervention" VALUE 0xa10293aa _REC_VAL_20_s2 1.999969482421875 _CNV_A_R_LINEAR_____275_CM -1. 0.999969482421875 DISPLAY_IDENTIFIER C_FAC_TI_ER_BAL_CTL_MAX_POS FORMAT "%8.5" /end CHARACTERISTIC
/begin CHARACTERISTIC c_fac_ti_er_bal_ctl_max_neg "Negative maximum limit for controller output at multiple path of cylinder balancing via TI intervention" VALUE 0xa10293a8 _REC_VAL_20_s2 1.999969482421875 _CNV_A_R_LINEAR_____275_CM -1. 0.999969482421875 DISPLAY_IDENTIFIER C_FAC_TI_ER_BAL_CTL_MAX_NEG FORMAT "%8.5" /end CHARACTERISTIC
/begin CHARACTERISTIC lc_fac_ti_ad_er_bal_rst_man "Manual reset of multiple adaptation values for cylinder balancing via TI intervention" VALUE 0xa1029d36 _REC_VAL_20_u1 1. _CNV_A_R_LINEAR_____0_CM 0. 1. DISPLAY_IDENTIFIER LC_FAC_TI_AD_ER_BAL_RST_MAN FORMAT "%1.0" /end CHARACTERISTIC
/begin CHARACTERISTIC c_fac_ti_er_bal_rst "Reset of multiple correction- and adaptation values for cylinder balancing via TI intervention" VALUE 0xa10293ac _REC_VAL_20_u1 2. _CNV_S_3_CYBL_RANGE_806_CM 0. 2. DISPLAY_IDENTIFIER C_FAC_TI_ER_BAL_RST /end CHARACTERISTIC
/begin AXIS_PTS ldp_er_stnd_fac_ti_ip_p_er_bal "" 0xa1020954 er_stnd_fac_ti_er_bal _REC_AXS_20_u2 651.5500579833979 _CNV_A_R_LINEAR_____128_CM 8 -325.78 325.770057983398 FORMAT "%8.3" /end AXIS_PTS
/begin CHARACTERISTIC ip_fac_ti_p_er_bal "Controller P-part value for multiple path of cylinder balancing via TI intervention" CURVE 0xa102428c _REC_CUR_20_u2_u2 1.99996948 _CNV_A_R_LINEAR_____249_CM -1. 0.99996948 DISPLAY_IDENTIFIER IP_FAC_TI_P_ER_BAL FORMAT "%8.5"
 /begin AXIS_DESCR COM_AXIS er_stnd_fac_ti_er_bal _CNV_A_R_LINEAR_____128_CM 8 -325.78 325.770057983398 FORMAT "%8.3" AXIS_PTS_REF ldp_er_stnd_fac_ti_ip_p_er_bal /end AXIS_DESCR
/end CHARACTERISTIC
/begin AXIS_PTS ldp_er_stnd_fac_ti_ip_i_er_bal "" 0xa1020940 er_stnd_fac_ti_er_bal _REC_AXS_20_u2 651.5500579833979 _CNV_A_R_LINEAR_____128_CM 8 -325.78 325.770057983398 FORMAT "%8.3" /end AXIS_PTS
/begin CHARACTERISTIC ip_fac_ti_i_er_bal "Controller I-part value for multiple path of cylinder balancing via TI intervention" CURVE 0xa102427c _REC_CUR_20_u2_u2 1.99996948 _CNV_A_R_LINEAR_____249_CM -1. 0.99996948 DISPLAY_IDENTIFIER IP_FAC_TI_I_ER_BAL FORMAT "%8.5"
 /begin AXIS_DESCR COM_AXIS er_stnd_fac_ti_er_bal _CNV_A_R_LINEAR_____128_CM 8 -325.78 325.770057983398 FORMAT "%8.3" AXIS_PTS_REF ldp_er_stnd_fac_ti_ip_i_er_bal /end AXIS_DESCR
/end CHARACTERISTIC
/begin CHARACTERISTIC lc_fac_ti_er_bal_rst_man "Manual reset of multiple correction values for cylinder balancing via TI intervention" VALUE 0xa1029d39 _REC_VAL_20_u1 1. _CNV_A_R_LINEAR_____0_CM 0. 1. DISPLAY_IDENTIFIER LC_FAC_TI_ER_BAL_RST_MAN FORMAT "%1.0" /end CHARACTERISTIC
/begin MEASUREMENT maf_sum "accumulated mass air flow measurements for segment number (2n), n = 1,2,3,..." ULONG _CNV_A_R_LINEAR_____812_CM 1 100. 0. 67108863.98 DISPLAY_IDENTIFIER MAF_SUM ECU_ADDRESS 0xd000579c FORMAT "%11.2" /end MEASUREMENT
/begin MEASUREMENT maf_sum_1 "accumulated mass air flow measurements for segment number (2n-1), n = 1,2,3,..." ULONG _CNV_A_R_LINEAR_____812_CM 1 100. 0. 67108863.98 DISPLAY_IDENTIFIER MAF_SUM_1 ECU_ADDRESS 0xd00057a0 FORMAT "%11.2" /end MEASUREMENT
/begin MEASUREMENT maf_ctr "accumulated mass air flow measurements for segment number (2n), n = 1,2,3,..." UWORD _CNV_A_R_LINEAR_____0_CM 1 100. 0. 65535. DISPLAY_IDENTIFIER MAF_CTR ECU_ADDRESS 0xd0004fec FORMAT "%5.0" /end MEASUREMENT
/begin MEASUREMENT maf_ctr_1 "accumulated mass air flow measurements for segment number (2n-1), n = 1,2,3,..." UWORD _CNV_A_R_LINEAR_____0_CM 1 100. 0. 65535. DISPLAY_IDENTIFIER MAF_CTR_1 ECU_ADDRESS 0xd0004fee FORMAT "%5.0" /end MEASUREMENT
/begin MEASUREMENT lv_maf_seg "indicates if segment number is even or odd in order to choose MAF_SUM / MAF_CTR or MAF_SUM_1 / MAF_CTR_1" UBYTE _CNV_S_2_RANGE__0___1_CM 1 100. 0. 1. DISPLAY_IDENTIFIER LV_MAF_SEG ECU_ADDRESS 0xd0003bb0 BIT_MASK 0x1 /end MEASUREMENT
/begin CHARACTERISTIC id_maf_tab "conversion table for MAF value" MAP 0xa1022b6c _REC_MAP_20_u2_u1_u1 1023.984375 _CNV_A_R_LINEAR_____318_CM 0. 1023.984375 DISPLAY_IDENTIFIER ID_MAF_TAB FORMAT "%7.2"
 /begin AXIS_DESCR COM_AXIS online_dummy _CNV_A_R_LINEAR_____0_CM 16 0. 255. FORMAT "%3.0" AXIS_PTS_REF ldp_id_maf_tab_1 /end AXIS_DESCR
 /begin AXIS_DESCR COM_AXIS online_dummy _CNV_A_R_LINEAR_____0_CM 16 0. 255. FORMAT "%3.0" AXIS_PTS_REF ldp_id_maf_tab_2 /end AXIS_DESCR
/end CHARACTERISTIC
/begin AXIS_PTS ldp_id_maf_tab_1 "" 0xa1020b18 online_dummy _REC_AXS_20_u1 255. _CNV_A_R_LINEAR_____0_CM 16 0. 255. FORMAT "%3.0" /end AXIS_PTS
/begin AXIS_PTS ldp_id_maf_tab_2 "" 0xa1020b2c online_dummy _REC_AXS_20_u1 255. _CNV_A_R_LINEAR_____0_CM 16 0. 255. FORMAT "%3.0" /end AXIS_PTS
/begin MEASUREMENT lv_key_off "Boolean for ignition key status (ON / OFF)" UBYTE _CNV_S_2_RANGE__0___1_CM 1 100. 0. 1. DISPLAY_IDENTIFIER LV_KEY_OFF ECU_ADDRESS 0xd0003bc0 BIT_MASK 0x1 /end MEASUREMENT
/begin MEASUREMENT ivvtpwm_1 "PWM for outlet VANOS" UWORD _CNV_A_R_LINEAR_____7_CM 1 100. 0. 99.99847412109381 DISPLAY_IDENTIFIER IVVTPWM_1 ECU_ADDRESS 0xd00054ae FORMAT "%5.2" /end MEASUREMENT
/begin MEASUREMENT ivvtpwm_0 "PWM for inlet VANOS" UWORD _CNV_A_R_LINEAR_____7_CM 1 100. 0. 99.99847412109381 DISPLAY_IDENTIFIER IVVTPWM_0 ECU_ADDRESS 0xd00054ac FORMAT "%5.2" /end MEASUREMENT
/begin COMPU_METHOD _CNV_A_R_LINEAR_____0_CM "" RAT_FUNC "%6.3" "-" COEFFS 0 1. 0. 0 0 1 /end COMPU_METHOD
/begin COMPU_METHOD _CNV_S_2_RANGE__0___1_CM "" TAB_VERB "%6.3" "-" COMPU_TAB_REF _CNV_S_2_RANGE__0___1 /end COMPU_METHOD
/begin COMPU_VTAB _CNV_S_2_RANGE__0___1 "" TAB_VERB 2 0 "0" 1 "1" /end COMPU_VTAB
/begin COMPU_METHOD _CNV_A_R_LINEAR_____2_CM "" RAT_FUNC "%6.3" "V" COEFFS 0 204.8 0. 0 0 1 /end COMPU_METHOD
/begin COMPU_METHOD _CNV_A_R_LINEAR_____6_CM "" RAT_FUNC "%6.3" "km/h" COEFFS 0 1. 0. 0 0 1 /end COMPU_METHOD
/begin COMPU_METHOD _CNV_A_R_LINEAR_____7_CM "" RAT_FUNC "%6.3" "%" COEFFS 0 655.3599999999997 0. 0 0 1 /end COMPU_METHOD
/begin COMPU_METHOD _CNV_A_R_LINEAR_____8_CM "" RAT_FUNC "%6.3" "-" COEFFS 0 32767.99999999992 0. 0 0 1 /end COMPU_METHOD
/begin COMPU_METHOD _CNV_A_R_LINEAR_____9_CM "" RAT_FUNC "%6.3" "rpm" COEFFS 0 3.125e-002 0. 0 0 1 /end COMPU_METHOD
/begin COMPU_METHOD _CNV_A_R_LINEAR_____11_CM "" RAT_FUNC "%6.3" "-" COEFFS 0 4095.999999839998 -1.280019205296412e-006 0 0 1 /end COMPU_METHOD
/begin COMPU_METHOD _CNV_A_R_LINEAR_____13_CM "" RAT_FUNC "%6.3" "rpm" COEFFS 0 1. 0. 0 0 1 /end COMPU_METHOD
/begin COMPU_METHOD _CNV_A_R_LINEAR_____16_CM "" RAT_FUNC "%6.3" "°C" COEFFS 0 1.333333333333333 64. 0 0 1 /end COMPU_METHOD
/begin COMPU_METHOD _CNV_A_R_LINEAR_____24_CM "" RAT_FUNC "%6.3" "°C" COEFFS 0 1.333333333333333 0. 0 0 1 /end COMPU_METHOD
/begin COMPU_METHOD _CNV_A_R_LINEAR_____27_CM "" RAT_FUNC "%6.3" "-" COEFFS 0 256. 0. 0 0 1 /end COMPU_METHOD
/begin COMPU_METHOD _CNV_A_R_LINEAR_____35_CM "" RAT_FUNC "%6.3" "s" COEFFS 0 1. 0. 0 0 1 /end COMPU_METHOD
/begin COMPU_METHOD _CNV_A_R_LINEAR_____68_CM "" RAT_FUNC "%6.3" "-" COEFFS 0 65535.99999999996 0. 0 0 1 /end COMPU_METHOD
/begin COMPU_METHOD _CNV_A_R_LINEAR_____107_CM "" RAT_FUNC "%6.3" "s" COEFFS 0 50. 0. 0 0 1 /end COMPU_METHOD
/begin COMPU_METHOD _CNV_A_R_LINEAR_____108_CM "" RAT_FUNC "%6.3" "mg/stk" COEFFS 0 47.18142548596112 0. 0 0 1 /end COMPU_METHOD
/begin COMPU_METHOD _CNV_A_R_LINEAR_____109_CM "" RAT_FUNC "%6.3" "°CRK" COEFFS 0 0.1666666666666667 0. 0 0 1 /end COMPU_METHOD
/begin COMPU_METHOD _CNV_A_R_LINEAR_____110_CM "" RAT_FUNC "%6.3" "%" COEFFS 0 655.3599999999997 -1.455191522836685e-011 0 0 1 /end COMPU_METHOD
/begin COMPU_METHOD _CNV_A_R_LINEAR_____111_CM "" RAT_FUNC "%6.3" "ms" COEFFS 0 250. 0. 0 0 1 /end COMPU_METHOD
/begin COMPU_METHOD _CNV_A_R_LINEAR_____112_CM "" RAT_FUNC "%6.3" "1/s" COEFFS 0 4095.999999839998 -1.280019205296412e-006 0 0 1 /end COMPU_METHOD
/begin COMPU_METHOD _CNV_A_R_LINEAR_____113_CM "" RAT_FUNC "%6.3" "-" COEFFS 0 8192. 0. 0 0 1 /end COMPU_METHOD
/begin COMPU_METHOD _CNV_A_R_LINEAR_____114_CM "" RAT_FUNC "%6.3" "-" COEFFS 0 1023.999999959999 0. 0 0 1 /end COMPU_METHOD
/begin COMPU_METHOD _CNV_A_R_LINEAR_____115_CM "" RAT_FUNC "%6.3" "-" COEFFS 0 4096. 0. 0 0 1 /end COMPU_METHOD
/begin COMPU_METHOD _CNV_A_R_LINEAR_____116_CM "" RAT_FUNC "%6.3" "1/s" COEFFS 0 256. 0. 0 0 1 /end COMPU_METHOD
/begin COMPU_METHOD _CNV_A_R_LINEAR_____117_CM "" RAT_FUNC "%6.3" "s" COEFFS 0 32767.99999999992 0. 0 0 1 /end COMPU_METHOD
/begin COMPU_METHOD _CNV_A_R_LINEAR_____118_CM "" RAT_FUNC "%6.3" "%" COEFFS 0 32767.9915198728 0. 0 0 1 /end COMPU_METHOD
/begin COMPU_METHOD _CNV_A_R_LINEAR_____119_CM "" RAT_FUNC "%6.3" "%" COEFFS 0 655.3600000143365 0. 0 0 1 /end COMPU_METHOD
/begin COMPU_METHOD _CNV_S_4_RANGE_STAT_120_CM "" TAB_VERB "%6.3" "-" COMPU_TAB_REF _CNV_S_4_RANGE_STAT_120 /end COMPU_METHOD
/begin COMPU_VTAB _CNV_S_4_RANGE_STAT_120 "" TAB_VERB 4 0 "PAS" 1 "OPL" 2 "WAIT" 3 "CLL" /end COMPU_VTAB
/begin COMPU_METHOD _CNV_S_5_RANGE_STAT_121_CM "" TAB_VERB "%6.3" "-" COMPU_TAB_REF _CNV_S_5_RANGE_STAT_121 /end COMPU_METHOD
/begin COMPU_VTAB _CNV_S_5_RANGE_STAT_121 "" TAB_VERB 5 0 "PAS" 1 "WAIT_ENG_COLD" 2 "ADJ_ENG_COLD" 3 "WAIT_ENG_NOM" 4 "ADJ_ENG_NOM" /end COMPU_VTAB
/begin COMPU_METHOD _CNV_A_R_LINEAR_____128_CM "" RAT_FUNC "%6.3" "1/s²" COEFFS 0 100.5832156670146 32768.00000000002 0 0 1 /end COMPU_METHOD
/begin COMPU_METHOD _CNV_A_R_LINEAR_____130_CM "" RAT_FUNC "%6.3" "1/s²" COEFFS 0 100.5832156670146 2.182787284255028e-011 0 0 1 /end COMPU_METHOD
/begin COMPU_METHOD _CNV_A_R_LINEAR_____189_CM "" RAT_FUNC "%6.3" "V" COEFFS 0 51.0204081632653 0. 0 0 1 /end COMPU_METHOD
/begin COMPU_METHOD _CNV_A_R_LINEAR_____195_CM "" RAT_FUNC "%6.3" "V" COEFFS 0 51.2 0. 0 0 1 /end COMPU_METHOD
/begin COMPU_METHOD _CNV_A_R_LINEAR_____197_CM "" RAT_FUNC "%6.3" "°C" COEFFS 0 64. 0. 0 0 1 /end COMPU_METHOD
/begin COMPU_METHOD _CNV_A_R_LINEAR_____220_CM "" RAT_FUNC "%6.3" "Grad" COEFFS 0 45.51 0. 0 0 1 /end COMPU_METHOD
/begin COMPU_METHOD _CNV_A_R_LINEAR_____221_CM "" RAT_FUNC "%6.3" "°TPS" COEFFS 0 137.0962343096234 0. 0 0 1 /end COMPU_METHOD
/begin COMPU_METHOD _CNV_A_R_LINEAR_____222_CM "" RAT_FUNC "%6.3" "-" COEFFS 0 65791.58652954937 0. 0 0 1 /end COMPU_METHOD
/begin COMPU_METHOD _CNV_A_R_LINEAR_____233_CM "" RAT_FUNC "%6.3" "ms" COEFFS 0 1000. 0. 0 0 1 /end COMPU_METHOD
/begin COMPU_METHOD _CNV_A_R_LINEAR_____249_CM "" RAT_FUNC "%6.3" "-" COEFFS 0 32768.00003968061 32768.00003968061 0 0 1 /end COMPU_METHOD
/begin COMPU_METHOD _CNV_A_R_LINEAR_____252_CM "" RAT_FUNC "%6.3" "V" COEFFS 0 102.4003523452984 0. 0 0 1 /end COMPU_METHOD
/begin COMPU_METHOD _CNV_A_R_LINEAR_____253_CM "" RAT_FUNC "%6.3" "s" COEFFS 0 2. 0. 0 0 1 /end COMPU_METHOD
/begin COMPU_METHOD _CNV_A_R_LINEAR_____275_CM "" RAT_FUNC "%6.3" "-" COEFFS 0 32768. 0. 0 0 1 /end COMPU_METHOD
/begin COMPU_METHOD _CNV_A_R_LINEAR_____318_CM "" RAT_FUNC "%6.3" "kg/h" COEFFS 0 64. 0. 0 0 1 /end COMPU_METHOD
/begin COMPU_METHOD _CNV_A_R_LINEAR_____445_CM "" RAT_FUNC "%6.3" "V" COEFFS 0 35.63776976537597 0. 0 0 1 /end COMPU_METHOD
/begin COMPU_METHOD _CNV_A_R_LINEAR_____458_CM "" RAT_FUNC "%6.3" "-" COEFFS 0 51.0204081632653 0. 0 0 1 /end COMPU_METHOD
/begin COMPU_METHOD _CNV_A_R_INJR_LINEA_476_CM "" RAT_FUNC "%6.3" "ms" COEFFS 0 1000. 32768. 0 0 1 /end COMPU_METHOD
/begin COMPU_METHOD _CNV_A_R_INJR_LINEA_480_CM "" RAT_FUNC "%6.3" "%" COEFFS 0 163.84 0. 0 0 1 /end COMPU_METHOD
/begin COMPU_METHOD _CNV_A_R_LINEAR_____490_CM "" RAT_FUNC "%6.3" "°C" COEFFS 0 0.25 0. 0 0 1 /end COMPU_METHOD
/begin COMPU_METHOD _CNV_A_R_LINEAR_____495_CM "" RAT_FUNC "%6.3" "mg" COEFFS 0 6.25 0. 0 0 1 /end COMPU_METHOD
/begin COMPU_METHOD _CNV_A_R_LINEAR_____499_CM "" RAT_FUNC "%6.3" "ppm" COEFFS 0 1. 0. 0 0 1 /end COMPU_METHOD
/begin COMPU_METHOD _CNV_A_R_LINEAR_____518_CM "" RAT_FUNC "%6.3" "-" COEFFS 0 4294967295. 0. 0 0 1 /end COMPU_METHOD
/begin COMPU_METHOD _CNV_S_4_STATE_NT_A_519_CM "" TAB_VERB "%6.3" "-" COMPU_TAB_REF _CNV_S_4_STATE_NT_A_519 /end COMPU_METHOD
/begin COMPU_VTAB _CNV_S_4_STATE_NT_A_519 "" TAB_VERB 4 0 "ALL" 1 "THERMO" 2 "SUL" 3 "MAN" /end COMPU_VTAB
/begin COMPU_METHOD _CNV_A_R_LINEAR_____520_CM "" RAT_FUNC "%6.3" "-" COEFFS 0 65535.99993374999 0. 0 0 1 /end COMPU_METHOD
/begin COMPU_METHOD _CNV_A_R_INJR_LINEA_540_CM "" RAT_FUNC "%6.3" "%" COEFFS 0 163.84 8192. 0 0 1 /end COMPU_METHOD
/begin COMPU_METHOD _CNV_S_7_RANGE_STAT_562_CM "" TAB_VERB "%6.3" "-" COMPU_TAB_REF _CNV_S_7_RANGE_STAT_562 /end COMPU_METHOD
/begin COMPU_VTAB _CNV_S_7_RANGE_STAT_562 "" TAB_VERB 7 0 "AD_PAS" 1 "AD_ACT" 2 "AD_CDN" 3 "AD_INI" 4 "AD_DEC" 5 "AD_INC" 6 "AD_HOLD" /end COMPU_VTAB
/begin COMPU_METHOD _CNV_S_4_CYBL_RANGE_563_CM "" TAB_VERB "%6.3" "-" COMPU_TAB_REF _CNV_S_4_CYBL_RANGE_563 /end COMPU_METHOD
/begin COMPU_VTAB _CNV_S_4_CYBL_RANGE_563 "" TAB_VERB 4 0 "Disable" 1 "Adjustment" 2 "Control" 3 "ADJ&CTL" /end COMPU_VTAB
/begin COMPU_METHOD _CNV_S_3_CYBL_RANGE_806_CM "" TAB_VERB "%6.3" "-" COMPU_TAB_REF _CNV_S_3_CYBL_RANGE_806 /end COMPU_METHOD
/begin COMPU_VTAB _CNV_S_3_CYBL_RANGE_806 "" TAB_VERB 3 0 "INI_ZERO" 1 "INI_CTL" 2 "INI_AD" /end COMPU_VTAB
/begin COMPU_METHOD _CNV_A_R_LINEAR_____812_CM "" RAT_FUNC "%6.3" "kg/h" COEFFS 0 64.00000000417234 0. 0 0 1 /end COMPU_METHOD
/begin RECORD_LAYOUT _REC_VAL_20_u1 FNC_VALUES 1 UBYTE COLUMN_DIR DIRECT /end RECORD_LAYOUT
/begin RECORD_LAYOUT _REC_VAL_20_u2 FNC_VALUES 1 UWORD COLUMN_DIR DIRECT /end RECORD_LAYOUT
/begin RECORD_LAYOUT _REC_AXS_20_u1 NO_AXIS_PTS_X 1 UBYTE AXIS_PTS_X 2 UBYTE INDEX_INCR DIRECT /end RECORD_LAYOUT
/begin RECORD_LAYOUT _REC_MAP_20_u2_u1_u1 FNC_VALUES 1 UWORD COLUMN_DIR DIRECT /end RECORD_LAYOUT
/begin RECORD_LAYOUT _REC_VAL_20_s2 FNC_VALUES 1 SWORD COLUMN_DIR DIRECT /end RECORD_LAYOUT
/begin RECORD_LAYOUT _REC_AXS_20_u2 NO_AXIS_PTS_X 1 UWORD AXIS_PTS_X 2 UWORD INDEX_INCR DIRECT /end RECORD_LAYOUT
/begin RECORD_LAYOUT _REC_CUR_20_u2_u1 FNC_VALUES 1 UWORD COLUMN_DIR DIRECT /end RECORD_LAYOUT
/begin RECORD_LAYOUT _REC_CUR_20_u2_u2 FNC_VALUES 1 UWORD COLUMN_DIR DIRECT /end RECORD_LAYOUT
/begin RECORD_LAYOUT _REC_VAL_20_s1 FNC_VALUES 1 SBYTE COLUMN_DIR DIRECT /end RECORD_LAYOUT
/begin RECORD_LAYOUT _REC_MAP_20_u2_u2_u2 FNC_VALUES 1 UWORD COLUMN_DIR DIRECT /end RECORD_LAYOUT
/begin RECORD_LAYOUT _REC_MAP_20_u1_u2_u2 FNC_VALUES 1 UBYTE COLUMN_DIR DIRECT /end RECORD_LAYOUT
/begin FUNCTION INJ_NOx_Catalyst_aging "_NOx Catalyst aging"
 /begin DEF_CHARACTERISTIC c_nt_agi_1 c_nt_agi_2 c_nt_agi_3 c_nt_agi_ini_1 c_nt_agi_ini_2 c_nt_agi_ntld_man c_nt_agi_s_red_man c_nt_agi_obs_min c_nt_agi_obs_min_is c_crlc_nt_agi_thermo_inc c_crlc_nt_agi_thermo_dec c_crlc_nt_agi_sul c_crlc_nt_agi_obs c_nt_sul_max_1 c_nt_sul_max_2 c_nt_sul_max_3 c_sul_thd_agi_thermo c_nt_sul_ext_adj c_ctr_nt_agi_ad_max c_ctr_nt_agi_ad_cmpl_max c_nox_ppm_min_agi c_tnt_mdl_nt_agi_obs_ini c_tnt_mdl_agi_ena_tnt c_t_afl_max_agi_ena c_vs_obs_min lc_nt_agi_ini_man lc_nt_agi_man lc_nt_agi_sul_ini lc_nt_agi_thermo_ini lc_agi_ad_trig_man lc_sul_thermo_cor lc_ena_sul_upd lc_sul_upd lc_nt_agi_nt_sul_mpg lc_nt_agi_min lc_nt_agi_egr_close lc_nt_agi_obs_ini lc_nt_agi_ad_ctr_rst_tnt lc_nox_ad_cmpl_off c_state_nt_agi_ntld c_state_nt_agi_s_red ldp_nt_sul_ip_nt_agi_nt_sul ldp_nt_agi_sul_ip_nt_sul_nt_agi ip_ntld_agi ip_nt_agi_nt_sul ip_nt_sul_nt_agi ip_nt_sul_h_min c_nt_agi_thermo_min ldpm_nox_eff ldpm_tnt_mdl_nox_nt ldpm_nt_agi_thermo c_nt_agi_obs_min_egr_err ip_ntld_agi_ef_close ip_nt_sul_max_2_deac ip_nt_sul_max_2 ip_nt_sul_max_3 c_nt_agi_obs_min_2 c_nt_sul_so2p_fq c_fac_su_conc_fuel c_ctr_nt_agi_so2p_fq_min c_ntld_so2p_fq c_nt_agi_thermo_so2p_fq_ini /end DEF_CHARACTERISTIC
 /begin OUT_MEASUREMENT lv_inh_nt_agi_err tnt_mdl_nt_agi_dyw_1 tnt_mdl_nt_agi_dyw_2 lv_inh_nt_agi lv_inh_nt_agi_tnt lv_inh_nt_agi_thd lv_inh_nt_agi_bas lv_nt_agi_obs_ena lv_nt_agi_obs_egr_ena lv_nox_sens_max_adj lv_inh_nt_agi_tnt_bas nt_agi nt_agi_sul nt_agi_sul_1 nt_agi_sul_2 nt_agi_thermo nt_agi_thermo_1 nt_agi_thermo_2 nt_agi_bas_1 nt_agi_bas_2 nt_agi_ntld nt_agi_s_red nt_agi_obs_1 nt_agi_obs nt_agi_obs_2 nox_eff_1 nox_eff_2 nt_sul_agi nt_sul_upd lv_nt_afs_req_agi lv_agi_ad_trig lv_so2p_req_1 lv_so2p_req_2 lv_cdn_nt_agi_thermo_ad lv_agi_vld lv_nt_agi_bas_ena lv_nt_agi_ena_tmp lv_nt_agi_ena lv_nt_agi_ena_tnt lv_nt_agi_ena_afs lv_nt_agi_ena_afs_tmp lv_egr_ratio_sp_agi_act ctr_nt_agi_ad ctr_nt_agi_ad_cmpl ctr_nt_agi_ad_cmpl_sum nt_sul_agi_1 nt_sul_agi_2 ntld_agi_1 ntld_agi_2 lv_so2p_req_fq fac_su_conc_fuel lv_nt_afs_req_agi_tmp_3 lv_nt_afs_req_agi_tmp_2 lv_nt_afs_req_agi_tmp_1 ctr_nt_agi_so2p_fq dif_ctr_nt_agi_cmpl_sum nt_agi_so2p_fq nt_agi_so2p_fq_sum /end OUT_MEASUREMENT
/end FUNCTION
/begin FUNCTION INJ_Phase_Shift_Adapt "_Phase_Shift_Adapt"
 /begin DEF_CHARACTERISTIC c_delta_crk_out_min c_crlc_delta_lamb_cyl_cq_fil c_delta_lamb_cyl_sel_cq_ad_thd c_crk_cyl_lam_delta_ini c_ctr_sum_ti_cyl_lam_osc_max c_ctr_cq_mon_pha_shift_ad_max c_ctr_resp_min_lam_cyl_sel lc_crk_cyl_lam_delta_out lc_crk_delta_cq_swi c_ctr_cq_min_pha_shift_ad c_ti_cyl_lam_max_pha_shift_ad c_ti_cyl_lam_min_pha_shift_ad c_crk_chg_fac_max c_delta_crk_out_max c_crk_chg_step c_ctr_resp_cyc_min_lam_cyl_sel c_ctr_ti_cyl_lam_dif_absv_min c_ctr_ti_cyl_lam_dif_absv_ok c_ctr_cq_fil_fall_min c_ctr_cq_fil_fall_ok c_ti_cyl_lam_dif_absv_max c_crk_cyl_lam_ini_red c_nr_seg_ref_cbk_ex_2 /end DEF_CHARACTERISTIC
 /begin OUT_MEASUREMENT cyl_lam_psa_1.delta_lamb_cyl_sel_cq_fil cyl_lam_psa_1.ctr_cq_mon_pha_shift_ad cyl_lam_psa_1.ctr_cq_max_osc cyl_lam_psa_1.ctr_resp_lam_cyl_sel cyl_lam_psa_1.delta_crk_cyl_lam cyl_lam_psa_1.crk_cyl_lam_int cyl_lam_psa_1.crk_cyl_lam_delta_ini cyl_lam_psa_1.crk_chg_fac_pha_shift_ad cyl_lam_psa_1.state_delta_crk_cyl_lam cyl_lam_psa_1.ctr_resp_cyc_lam_cyl_sel cyl_lam_psa_1.ctr_ti_cyl_lam_dif_absv cyl_lam_psa_1.ctr_cq_fil_fall cyl_lam_psa_1.lv_delta_crk_cyl_lam_err cyl_lam_psa_1.lv_ti_cyl_lam_osc cyl_lam_psa_1.lv_ti_cyl_lam_lim_osc cyl_lam_psa_1.lv_state_delta_crk_wait cyl_lam_psa_2.delta_lamb_cyl_sel_cq_fil cyl_lam_psa_2.ctr_cq_mon_pha_shift_ad cyl_lam_psa_2.ctr_cq_max_osc cyl_lam_psa_2.ctr_resp_lam_cyl_sel cyl_lam_psa_2.delta_crk_cyl_lam cyl_lam_psa_2.crk_cyl_lam_int cyl_lam_psa_2.crk_cyl_lam_delta_ini cyl_lam_psa_2.crk_chg_fac_pha_shift_ad cyl_lam_psa_2.state_delta_crk_cyl_lam cyl_lam_psa_2.ctr_resp_cyc_lam_cyl_sel cyl_lam_psa_2.ctr_ti_cyl_lam_dif_absv cyl_lam_psa_2.ctr_cq_fil_fall cyl_lam_psa_2.lv_delta_crk_cyl_lam_err cyl_lam_psa_2.lv_ti_cyl_lam_osc cyl_lam_psa_2.lv_ti_cyl_lam_lim_osc cyl_lam_psa_2.lv_state_delta_crk_wait ti_cyl_lam_save[0] ti_cyl_lam_save[1] ti_cyl_lam_save[2] ti_cyl_lam_save[3] ti_cyl_lam_save[4] ti_cyl_lam_save[5] ctr_sum_ti_cyl_lam_osc[0] ctr_sum_ti_cyl_lam_osc[1] ctr_sum_ti_cyl_lam_osc[2] ctr_sum_ti_cyl_lam_osc[3] ctr_sum_ti_cyl_lam_osc[4] ctr_sum_ti_cyl_lam_osc[5] lv_ti_cyl_lam_osc_max_thd[0] lv_ti_cyl_lam_osc_max_thd[1] lv_ti_cyl_lam_osc_max_thd[2] lv_ti_cyl_lam_osc_max_thd[3] lv_ti_cyl_lam_osc_max_thd[4] lv_ti_cyl_lam_osc_max_thd[5] lv_ti_cyl_lam_osc_min_thd[0] lv_ti_cyl_lam_osc_min_thd[1] lv_ti_cyl_lam_osc_min_thd[2] lv_ti_cyl_lam_osc_min_thd[3] lv_ti_cyl_lam_osc_min_thd[4] lv_ti_cyl_lam_osc_min_thd[5] /end OUT_MEASUREMENT
/end FUNCTION
/begin FUNCTION INJ_Cyl_Bal_via_Lam_Sens "_Cyl_Bal_via_Lam_Sens"
 /begin DEF_CHARACTERISTIC c_crk_cyl_lam_1 c_crk_cyl_lam_2 c_crk_cyl_lam_3 c_crk_cyl_lam_4 c_crk_cyl_lam_5 c_crk_cyl_lam_0 c_cyl_lam_out_min c_cyl_lam_out_max c_cyl_lam_diag_min c_delta_lamb_cyl_sp c_crlc_adj_fac c_crlc_exv_fac_0 c_crlc_exv_fac_1 c_crlc_exv_fac_2 c_crlc_exv_fac_3 c_crlc_exv_fac_4 c_crlc_exv_fac_5 c_crlc_exv_fac_6 c_crlc_exv_fac_7 c_crk_cyl_lam_6 c_crk_cyl_lam_7 ldp_vls_cyl_sel_ip_lamb_cyl_1 ldp_vls_cyl_sel_ip_lamb_cyl_2 ldpm_fac_t_2_1_cybl ldpm_n_1_cybl ldpm_maf_1_cybl ldpm_n_32_1_cybl ip_lamb_cyl_1 ip_lamb_cyl_2 ip_exp_lamb_mdl_1 ip_exp_lamb_mdl_2 ip_n1_fac_lamb_mdl_1 ip_n1_fac_lamb_mdl_2 ip_n2_fac_lamb_mdl_2 ip_crk_syn_1 ip_crk_syn_2 ip_fac_err_lam_sel ip_crlc_cyl_lam ip_t1_lamb_cyl_sel_1 ip_t1_lamb_cyl_sel_2 c_cyl_lam_diag_max c_ti_cyl_lam_absv_dec lc_adapt_cor_out ldp_t1_lamb_cyl_i_ip_fac_err c_t_lam_cyl_adj c_t_lam_cyl_adj_cst c_tco_lam_cyl_min c_tco_lam_cyl_cst_min c_tco_lam_cyl_cst_max c_crlc_cyl_fil c_crlc_adj_fac_cst c_crlc_lam_cyl_cst_fil lc_lam_cyl_sel_opl lc_fac_lam_cyl_sel_adj_cst_ena ip_maf_lam_cyl_sel_adj_fac_min ip_maf_lam_cyl_sel_adj_cst_min ip_maf_lam_cyl_sel_adj_fac_max ip_maf_lam_cyl_sel_adj_cst_max ip_n2_fac_lamb_mdl_1 ldpm_fac_t_1_1_cybl ldpm_tco_1_cybl ip_crlc_fac_lam_cyl_sel_adj ip_crlc_fac_lam_cyl_sel_adj_cst lc_lam_cyl_sel_err_rst lc_lamb_delta_mdl_hld /end DEF_CHARACTERISTIC
 /begin OUT_MEASUREMENT ti_cyl_lam[0] ti_cyl_lam[1] ti_cyl_lam[2] ti_cyl_lam[3] ti_cyl_lam[4] ti_cyl_lam[5] ti_cyl_lam_add[0] ti_cyl_lam_add[1] ti_cyl_lam_add[2] ti_cyl_lam_add[3] ti_cyl_lam_add[4] ti_cyl_lam_add[5] ti_cyl_lam_lim_not[0] ti_cyl_lam_lim_not[1] ti_cyl_lam_lim_not[2] ti_cyl_lam_lim_not[3] ti_cyl_lam_lim_not[4] ti_cyl_lam_lim_not[5] fac_cyl_lam_int[0] fac_cyl_lam_int[1] fac_cyl_lam_int[2] fac_cyl_lam_int[3] fac_cyl_lam_int[4] fac_cyl_lam_int[5] fac_cyl_lam[0] fac_cyl_lam[1] fac_cyl_lam[2] fac_cyl_lam[3] fac_cyl_lam[4] fac_cyl_lam[5] delta_lamb_err_cyl_sel[0] delta_lamb_err_cyl_sel[1] delta_lamb_err_cyl_sel[2] delta_lamb_err_cyl_sel[3] delta_lamb_err_cyl_sel[4] delta_lamb_err_cyl_sel[5] delta_lamb_dif_cyl[0] delta_lamb_dif_cyl[1] delta_lamb_dif_cyl[2] delta_lamb_dif_cyl[3] delta_lamb_dif_cyl[4] delta_lamb_dif_cyl[5] vls_cyl_sel[0] vls_cyl_sel[1] vls_cyl_sel[2] vls_cyl_sel[3] vls_cyl_sel[4] vls_cyl_sel[5] crk_cyl_lam[0] crk_cyl_lam[1] crk_cyl_lam[2] crk_cyl_lam[3] crk_cyl_lam[4] crk_cyl_lam[5] delta_lamb_cyl_sel_cq_1 delta_lamb_cyl_sel_cq_2 lv_lam_cyl_act_1 lv_lam_cyl_act_2 cyl_lam_1.delta_lamb_av cyl_lam_1.delta_lamb_mdl cyl_lam_1.delta_lamb_err_raw cyl_lam_1.delta_lamb_err cyl_lam_1.delta_lamb_cyl_sel cyl_lam_1.fac_t cyl_lam_1.lv_lam_cyl_sel_seg_ref_cll cyl_lam_2.delta_lamb_av cyl_lam_2.delta_lamb_mdl cyl_lam_2.delta_lamb_err_raw cyl_lam_2.delta_lamb_err cyl_lam_2.delta_lamb_cyl_sel cyl_lam_2.fac_t cyl_lam_2.lv_lam_cyl_sel_seg_ref_cll lv_cyl_lam_lim_max_0 lv_cyl_lam_lim_max_1 lv_cyl_lam_lim_max_2 lv_cyl_lam_lim_max_3 lv_cyl_lam_lim_max_4 lv_cyl_lam_lim_max_5 lv_cyl_lam_lim_min_0 lv_cyl_lam_lim_min_1 lv_cyl_lam_lim_min_2 lv_cyl_lam_lim_min_3 lv_cyl_lam_lim_min_4 lv_cyl_lam_lim_min_5 lv_cyl_lam_diag_lim_max_0 lv_cyl_lam_diag_lim_max_1 lv_cyl_lam_diag_lim_max_2 lv_cyl_lam_diag_lim_max_3 lv_cyl_lam_diag_lim_max_4 lv_cyl_lam_diag_lim_max_5 lv_cyl_lam_diag_lim_min_0 lv_cyl_lam_diag_lim_min_1 lv_cyl_lam_diag_lim_min_2 lv_cyl_lam_diag_lim_min_3 lv_cyl_lam_diag_lim_min_4 lv_cyl_lam_diag_lim_min_5 state_lam_cyl_sel_2 fac_lam_cyl_sel_adj[0] fac_lam_cyl_sel_adj[1] fac_lam_cyl_sel_adj[2] fac_lam_cyl_sel_adj[3] fac_lam_cyl_sel_adj[4] fac_lam_cyl_sel_adj[5] fac_lam_cyl_sel_adj_cst[0] fac_lam_cyl_sel_adj_cst[1] fac_lam_cyl_sel_adj_cst[2] fac_lam_cyl_sel_adj_cst[3] fac_lam_cyl_sel_adj_cst[4] fac_lam_cyl_sel_adj_cst[5] fac_lam_cyl_sel_adj_fil[0] fac_lam_cyl_sel_adj_fil[1] fac_lam_cyl_sel_adj_fil[2] fac_lam_cyl_sel_adj_fil[3] fac_lam_cyl_sel_adj_fil[4] fac_lam_cyl_sel_adj_fil[5] fac_lam_cyl_sel_adj_cst_fil[0] fac_lam_cyl_sel_adj_cst_fil[1] fac_lam_cyl_sel_adj_cst_fil[2] fac_lam_cyl_sel_adj_cst_fil[3] fac_lam_cyl_sel_adj_cst_fil[4] fac_lam_cyl_sel_adj_cst_fil[5] state_lam_cyl_sel_1 state_lam_cyl_sel_adj_2 delta_lamb_cyl[0] delta_lamb_cyl[1] delta_lamb_cyl[2] delta_lamb_cyl[3] delta_lamb_cyl[4] delta_lamb_cyl[5] lamb_cyl_sel[0] lamb_cyl_sel[1] lamb_cyl_sel[2] lamb_cyl_sel[3] lamb_cyl_sel[4] lamb_cyl_sel[5] state_lam_cyl_sel_adj_1 ctr_t_lam_cyl_adj_1 ctr_t_lam_cyl_adj_2 /end OUT_MEASUREMENT
/end FUNCTION
/begin FUNCTION INJ_Coord_Inj_Time_Cor_Fac_CYLB "_Coord_Inj_Time_Cor_Fac_CYLB"
 /begin DEF_CHARACTERISTIC c_egy_level_iv_bal_ofs c_egy_level_iv_bal_max_neg c_egy_level_iv_bal_max_pos c_fac_ti_bal_act_man c_fac_ti_dif_bal lc_fac_ti_bal_cor lc_fac_ti_bal_rst_man c_ctr_dly_ti_bal_cor_ini ldp_fac_ti_sum_bal_ip_egy_bal ldp_n_ip_fac_egy_iv_bal_cor ldp_mff_sp_mv_ip_fac_egy_bal ip_egy_level_iv_bal_conv ip_fac_egy_level_iv_bal_cor /end DEF_CHARACTERISTIC
 /begin OUT_MEASUREMENT egy_level_iv_bal_adj[0] egy_level_iv_bal_adj[1] egy_level_iv_bal_adj[2] egy_level_iv_bal_adj[3] egy_level_iv_bal_adj[4] egy_level_iv_bal_adj[5] nr_cyc_egy_level_iv_bal_ctl_max egy_level_iv_bal_ctl[0] egy_level_iv_bal_ctl[1] egy_level_iv_bal_ctl[2] egy_level_iv_bal_ctl[3] egy_level_iv_bal_ctl[4] egy_level_iv_bal_ctl[5] egy_level_iv_bal[0] egy_level_iv_bal[1] egy_level_iv_bal[2] egy_level_iv_bal[3] egy_level_iv_bal[4] egy_level_iv_bal[5] ti_add_bal[0] ti_add_bal[1] ti_add_bal[2] ti_add_bal[3] ti_add_bal[4] ti_add_bal[5] fac_ti_bal[0] fac_ti_bal[1] fac_ti_bal[2] fac_ti_bal[3] fac_ti_bal[4] fac_ti_bal[5] fac_ti_sum_bal[0] fac_ti_sum_bal[1] fac_ti_sum_bal[2] fac_ti_sum_bal[3] fac_ti_sum_bal[4] fac_ti_sum_bal[5] fac_ti_dif_bal[0] fac_ti_dif_bal[1] fac_ti_dif_bal[2] fac_ti_dif_bal[3] fac_ti_dif_bal[4] fac_ti_dif_bal[5] ctr_step_fac_ti_bal[0] ctr_step_fac_ti_bal[1] ctr_step_fac_ti_bal[2] ctr_step_fac_ti_bal[3] ctr_step_fac_ti_bal[4] ctr_step_fac_ti_bal[5] egy_level_iv_bal_ctl_max[0] egy_level_iv_bal_ctl_max[1] egy_level_iv_bal_ctl_max[2] egy_level_iv_bal_ctl_max[3] egy_level_iv_bal_ctl_max[4] egy_level_iv_bal_ctl_max[5] ctr_dly_ti_bal_cor_ena egy_level_iv_bal_conv[0] egy_level_iv_bal_conv[1] egy_level_iv_bal_conv[2] egy_level_iv_bal_conv[3] egy_level_iv_bal_conv[4] egy_level_iv_bal_conv[5] egy_level_iv_bal_lim /end OUT_MEASUREMENT
/end FUNCTION
/begin FUNCTION INJ_Cyl_Bal_via_Mul_TI_Intervent "_Cyl_Bal_via_Mul_TI_Intervent"
 /begin DEF_CHARACTERISTIC c_er_stnd_thd_pos_fac_ti_bal c_er_stnd_thd_neg_fac_ti_bal c_fac_ti_er_bal_ctl_max_pos c_fac_ti_er_bal_ctl_max_neg lc_fac_ti_ad_er_bal_rst_man c_fac_ti_er_bal_rst ldp_er_stnd_fac_ti_ip_p_er_bal ip_fac_ti_p_er_bal ldp_er_stnd_fac_ti_ip_i_er_bal ip_fac_ti_i_er_bal lc_fac_ti_er_bal_rst_man /end DEF_CHARACTERISTIC
 /begin OUT_MEASUREMENT er_stnd_fac_ti_er_bal lv_er_stnd_fac_ti_er_bal fac_ti_er_bal_ctl fac_ti_er_bal_ctl_p fac_ti_er_bal_ctl_i[0] fac_ti_er_bal_ctl_i[1] fac_ti_er_bal_ctl_i[2] fac_ti_er_bal_ctl_i[3] fac_ti_er_bal_ctl_i[4] fac_ti_er_bal_ctl_i[5] fac_ti_er_bal_ctl_max fac_ti_er_bal_lim[0] fac_ti_er_bal_lim[1] fac_ti_er_bal_lim[2] fac_ti_er_bal_lim[3] fac_ti_er_bal_lim[4] fac_ti_er_bal_lim[5] fac_ti_er_bal_cor[0] fac_ti_er_bal_cor[1] fac_ti_er_bal_cor[2] fac_ti_er_bal_cor[3] fac_ti_er_bal_cor[4] fac_ti_er_bal_cor[5] fac_ti_er_bal[0] fac_ti_er_bal[1] fac_ti_er_bal[2] fac_ti_er_bal[3] fac_ti_er_bal[4] fac_ti_er_bal[5] fac_ti_ad_er_bal[0] fac_ti_ad_er_bal[1] fac_ti_ad_er_bal[2] fac_ti_ad_er_bal[3] fac_ti_ad_er_bal[4] fac_ti_ad_er_bal[5] nr_cyc_fac_ti_er_bal_ctl_max /end OUT_MEASUREMENT
/end FUNCTION
/begin FUNCTION INJ_Cyl_Bal_via_Add_TI_Intervent "_Cyl_Bal_via_Add_TI_Intervent"
 /begin DEF_CHARACTERISTIC c_er_stnd_thd_pos_ti_add_bal c_er_stnd_thd_neg_ti_add_bal c_ti_add_er_bal_ctl_max_pos c_ti_add_er_bal_ctl_max_neg c_cycnr_ti_er_bal lc_ti_er_bal_cor lc_ti_add_ad_er_bal_rst_man c_ti_add_er_bal_rst ldp_er_stnd_ti_add_ip_p_er_bal ip_ti_add_p_er_bal ldp_er_stnd_ti_add_ip_i_er_bal ip_ti_add_i_er_bal lc_ti_add_er_bal_rst_man /end DEF_CHARACTERISTIC
 /begin OUT_MEASUREMENT er_stnd_ti_add_er_bal lv_er_stnd_ti_add_er_bal ti_add_er_bal_ctl ti_add_er_bal_ctl_p ti_add_er_bal_ctl_i[0] ti_add_er_bal_ctl_i[1] ti_add_er_bal_ctl_i[2] ti_add_er_bal_ctl_i[3] ti_add_er_bal_ctl_i[4] ti_add_er_bal_ctl_i[5] ti_add_er_bal_ctl_max ti_add_er_bal_lim[0] ti_add_er_bal_lim[1] ti_add_er_bal_lim[2] ti_add_er_bal_lim[3] ti_add_er_bal_lim[4] ti_add_er_bal_lim[5] ti_add_er_bal_cor[0] ti_add_er_bal_cor[1] ti_add_er_bal_cor[2] ti_add_er_bal_cor[3] ti_add_er_bal_cor[4] ti_add_er_bal_cor[5] ti_add_er_bal[0] ti_add_er_bal[1] ti_add_er_bal[2] ti_add_er_bal[3] ti_add_er_bal[4] ti_add_er_bal[5] ti_add_ad_er_bal[0] ti_add_ad_er_bal[1] ti_add_ad_er_bal[2] ti_add_ad_er_bal[3] ti_add_ad_er_bal[4] ti_add_ad_er_bal[5] nr_cyc_ti_add_er_bal_ctl_max /end OUT_MEASUREMENT
/end FUNCTION
/begin FUNCTION C_2_BIO "C_2_BIO"
 /begin SUB_FUNCTION BIO_Standard_analog_inputs BIO_Keyword_Protocol_2000 BIO_Logic_inputs BIO_Acquisition_of_after_ignition_key_battery_voltage BIO_MSW_interface BIO_Acquisition_of_oil_pressure_switch BIO_PWM_outputs /end SUB_FUNCTION
/end FUNCTION
/begin FUNCTION BIO_Standard_analog_inputs "_Standard analog inputs" /begin DEF_CHARACTERISTIC id_maf_tab /end DEF_CHARACTERISTIC
 /begin OUT_MEASUREMENT v_amp v_tia v_pvs_1 v_pvs_2 v_tps_1 v_tps_2 vcc_pvs_1 vcc_pvs_2 v_teg_pcat_down_1 v_teg_pcat_down_2 v_tecu v_fps v_saf v_maf vb_bas v_igk_bas v_pvs_2_mc v_pvs_2_mu v_egr v_tia_tcha maf_sum maf_sum_1 maf_ctr maf_ctr_1 lv_maf_seg /end OUT_MEASUREMENT
/end FUNCTION
/begin FUNCTION BIO_Keyword_Protocol_2000 "_Keyword Protocol 2000" /end FUNCTION
/begin FUNCTION BIO_Logic_inputs "_Logic inputs" /begin OUT_MEASUREMENT lv_im_bls lv_im_bts lv_im_cs_pn /end OUT_MEASUREMENT /end FUNCTION
/begin FUNCTION BIO_Acquisition_of_after_ignition_key_battery_voltage "_Acquisition of after ignition key battery voltage" /begin OUT_MEASUREMENT vb_mes v_igk_mes lv_key_off /end OUT_MEASUREMENT /end FUNCTION
/begin FUNCTION BIO_MSW_interface "_MSW interface" /end FUNCTION
/begin FUNCTION BIO_Acquisition_of_oil_pressure_switch "_Acquisition of oil pressure switch" /begin OUT_MEASUREMENT lv_poil_swi /end OUT_MEASUREMENT /end FUNCTION
/begin FUNCTION BIO_PWM_outputs "_PWM outputs" /begin OUT_MEASUREMENT ivvtpwm_1 ivvtpwm_0 /end OUT_MEASUREMENT /end FUNCTION
/begin FUNCTION C_A_DIA ""
 /begin SUB_FUNCTION DIA_Mass_air_flow_meter DIA_Intake_air_temperature_sensor DIA_IVVT_diagnosis DIA_Fuel_pump_relay_RLY_EFP DIA_Ambient_pressure_sensor DIA_Oil_temperature_sensor_TOIL DIA_Knock_sensor_diagnosis DIA_Vehicle_speed_signal_diagnosis DIA_Ignition_system_diagnosis DIA_Throttle_position_sensor_diagnosis DIA_ETC_driver_diagnosis DIA_Generator_diagnosis DIA_Air_Condition_Compressor_Control_Relay_Diagnosis__RLY_ACCOUT_ DIA_Main_Relay_Diagnosis__RLY_MAIN_ DIA_Idle_Speed_Control_Diagnosis DIA_CAN_diagnosis DIA_Multifunctional_steering_wheel__MSW_ DIA_Pedal_value_sensor_diagnosis DIA_Brake_light_switch_diagnosis__BLS_BTS_ DIA_Idle_Speed_Actuator_Diagnosis DIA_Engine_roughness_idle_diagnosis DIA_Immobilizer_signal_diagnosis DIA_Exhaust_flap_diagnosis DIA_Anti_bounce_algorithm DIA_Torque_Request_for_Safety_Diagnosis DIA_E_box_cooling_fan_diagnosis DIA_ECU_temperature_sensor_diagnosis DIA_Tank_leakage_pump_diagnosis DIA_SOF_diagnosis DIA_TPS___ETC_Limp_Home_Manager DIA_Diagnosis_Oil_temperature_and_level_sensor___DTOENS_ DIA_BSD_Diagnosis DIA_Starter_Output_Diagnosis DIA_Oil_pressure_switch_diagnosis DIA_CAN_diagnosis_for_EFP_control DIA_ETC_Actuator_diagnosis_and_Adaptation DIA_Electric_solenoid_valve_diagnosis DIA_AMT_intervention_plausibility DIA_GS_intervention_plausibility_Diagnosis DIA_Distance_cruise_control_diagnosis DIA_Electronically_controlled_radiator_shutter_diagnosis DIA_Upstream_oxygen_sensor_signal_monitoring DIA_CAN_diagnosis_for_NOX_control DIA_NOx_Sensor_Diagnosis___OBD_I DIA_Clutch_switch_diagnosis DIA_ECU_selftest DIA_SPI_Bus_diagnosis DIA_Automatic_gear_shift_signal_diagnosis DIA_Diagnosis_Electrical_Controlled_Waterpump DIA_IS_Control_Diag DIA_IS_Control_Diag__AI DIA_Fuel_reserve_diagnosis DIA_Vima_actuator_feedback_diagnosis DIA_Ambient_temperature_sensor DIA_Engine_Off_Duration_diagnosis DIA_LDM_diagnosis__LV_ERR_LDM_ DIA_Fuel_Pressure_Actuator_Diag DIA_Fuel_Pressure_Sensor_Diag DIA_Fuel_Pressure_Actuator_Diag_AI DIA_Fuel_Pressure_Sensor_Diag_AI DIA_FUP_EFP_Sensor_Diag__AI DIA_FUP_EFP_Sensor_Diag Energy_spare_mode_diag /end SUB_FUNCTION
/end FUNCTION
/begin FUNCTION DIA_Mass_air_flow_meter "_Mass air flow meter"
 /begin DEF_CHARACTERISTIC c_n_min_maf_diag c_v_maf_max_diag c_v_maf_diag_ini c_ang_exc_vvl_min_maf_diag c_tps_min_maf_diag id_crlc_v_maf_diag__n_32 c_v_maf_min_diag /end DEF_CHARACTERISTIC
 /begin OUT_MEASUREMENT lv_err_maf v_maf_diag v_maf_diag_l v_maf_diag_h lv_maf_ready_l lv_maf_ready_h lv_inh_diag_maf lv_maf_bls_diag state_rbm_maf /end OUT_MEASUREMENT
/end FUNCTION
/begin FUNCTION DIA_Intake_air_temperature_sensor "_Intake air temperature sensor"
 /begin DEF_CHARACTERISTIC c_t_dly_tia_diag c_v_tia_max_diag c_v_tia_min_diag c_tia_dif_diag c_tia_plaus_dif_err c_t_vs_min_tia_plaus_diag c_vs_min_tia_plaus_diag c_tam_min_tia_plaus_diag c_tco_min_is_cdn_tia_plaus id_t_is_min_tia_plaus_diag ldp_tam_tia_plaus_diag c_vs_max_is_cdn_tia_plaus c_ctr_is_cdn_tia_plaus c_maf_min_int_cdn_tia_plaus c_tam_max_tia_plaus_diag c_t_load_is_cdn_tia_plaus /end DEF_CHARACTERISTIC
 /begin OUT_MEASUREMENT lv_err_tia lv_err_tia_el lv_err_tia_plaus tia_plaus_min_diag tia_dif_diag t_vs_tia_plaus_diag t_is_tia_plaus_diag lv_dif_cdn_tia_plaus_diag lv_vs_cdn_tia_plaus_diag lv_is_cdn_tia_plaus_diag tia_plaus_max_diag tia_dif_max_diag tia_dif_min_diag ctr_is_cdn_tia_plaus t_load_is_cdn_tia_plaus lv_load_is_cdn_tia_plaus lv_inh_diag_tia_plaus state_rbm_tia_plaus /end OUT_MEASUREMENT
/end FUNCTION
/begin FUNCTION DIA_IVVT_diagnosis "_IVVT diagnosis" /begin OUT_MEASUREMENT lv_err_mec_ivvt_in lv_err_mec_ivvt_ex lv_err_ivvt /end OUT_MEASUREMENT /end FUNCTION
/end MODULE
/end PROJECT
