ASAP2_VERSION 1 3
/begin PROJECT _725D601B "725D601B"
/begin HEADER "" VERSION "_725D601B" PROJECT_NO _725D601B /end HEADER
/begin MODULE DIM ""
/begin MOD_COMMON "" BYTE_ORDER MSB_FIRST ALIGNMENT_BYTE 1 ALIGNMENT_WORD 2 ALIGNMENT_LONG 2 ALIGNMENT_FLOAT32_IEEE 4 /end MOD_COMMON
/begin CHARACTERISTIC ACCC_T_UM "Fehlerzeit f¸r ACC-Eingriff-‹berwachnung der Funktions¸berwachung" VALUE 0xFCF0E0 KwUb 255.0 dez 0.00 255.0 FORMAT "%5.1" /end CHARACTERISTIC
/begin CHARACTERISTIC BRACC_T_UM "Entprellzeit f¸r bet‰tigte Bremse in der Funktions¸berwachung f¸r ACC" VALUE 0xFCF0E8 KwUb 5100.00 t20ms_ub_b5100 0.00 5100.00 /end CHARACTERISTIC
/begin CHARACTERISTIC BREMS_T_UM "Entprellzeit f¸r bet‰tigte Bremse in der Funktions¸berwachung" VALUE 0xFCF0E9 KwUb 5100.00 t20ms_ub_b5100 0.00 5100.00 /end CHARACTERISTIC
/begin CHARACTERISTIC CWBZMSR_UC "Codewort zur Aktivierung d. Botschaftsz‰hlerpr¸fung im Befehlstest" VALUE 0xFCF0F3 KwUb 255.0 dez 0.00 255.0 FORMAT "%5.1" /end CHARACTERISTIC
/begin CHARACTERISTIC CWBZMSR_UM "Codewort zur Aktivierung d. Botschaftsz‰hlerpr¸fung" VALUE 0xFCF0EF KwUb 255.0 dez 0.00 255.0 FORMAT "%5.1" /end CHARACTERISTIC
/begin CHARACTERISTIC CWFADTEV "Wird von BMW nachgeliefert" VALUE 0xFCC9C0 KwUb 255.0 dez 0.00 255.0 FORMAT "%5.1" /end CHARACTERISTIC
/begin CHARACTERISTIC CWIBSDETEC "Codewort zum Setzen von B_ibsdetec" VALUE 0xFCC9C1 KwUb 255.0 dez 0.00 255.0 FORMAT "%5.1" /end CHARACTERISTIC
/begin CHARACTERISTIC CWLROFF "Drehzahlschwelle f¸r Loadresp-Funktion des Generators ausschalten" VALUE 0xFCC9C2 KwUb 255.0 dez 0.00 255.0 FORMAT "%5.1" /end CHARACTERISTIC
/begin CHARACTERISTIC CWMDKOMX "Codewort MDKOMX: Begrenzungsmoment Klimakompressor" VALUE 0xFCC9C3 KwUb 127.5 md_q0p5 0.00 127.5 FORMAT "%5.1" /end CHARACTERISTIC
/begin CHARACTERISTIC CWSTAEN "Codewort f¸r konfigurierbare ""Ansteuerung Automatik-Start""" VALUE 0xFC220E KwUb 255.0 dez 0.00 255.0 FORMAT "%5.1" /end CHARACTERISTIC
/begin CHARACTERISTIC CWTEACFG "ausserordentliche Konfiguration der Tankentl¸ftung" VALUE 0xFD4DE2 KwUb 255.0 dez 0.00 255.0 FORMAT "%5.1" /end CHARACTERISTIC
/begin CHARACTERISTIC CW_BDE_UC "Codewort f¸r Benzindirekteinspritzung im Befehlstest" VALUE 0xFC09A1 KwUb 255.0 dez 0.00 255.0 FORMAT "%5.1" /end CHARACTERISTIC
/begin CHARACTERISTIC DBACCMX_UM "Fehlerschwelle Botschaftsz‰hler in ACC-Botschaft" VALUE 0xFCF0E1 KwUb 255.0 dez 0.00 255.0 FORMAT "%5.1" /end CHARACTERISTIC
/begin CHARACTERISTIC DBACC_T_UM "Fehlerentprellung:  Fehler in Botschaftsz‰hler der ACC-Botschaft" VALUE 0xFCF0E2 KwUb 255.0 dez 0.00 255.0 FORMAT "%5.1" /end CHARACTERISTIC
/begin CHARACTERISTIC DBDSCMX_UC "Maximale Botschaftsz‰lerdifferenz bei ‹berwachung der DSC-Botschaft in BT" VALUE 0xFC09F6 KwUb 5100.00 t20ms_ub_b5100 0.00 5100.00 /end CHARACTERISTIC
/begin CHARACTERISTIC DBDSCMX_UM "Maximal zul‰ssige ƒnderung des Botschaftsz‰hlers zwischen 2 Berechnungen" VALUE 0xFCF0F0 KwUb 5100.00 t20ms_ub_b5100 0.00 5100.00 /end CHARACTERISTIC
/begin CHARACTERISTIC DBDSC_T_UC "Fehlertoleranzzeit bei fehlender Aktualisierung des DSC Botschaftsz‰hlers in BT" VALUE 0xFC09F7 KwUb 5100.00 t20ms_ub_b5100 0.00 5100.00 /end CHARACTERISTIC
/begin CHARACTERISTIC DBDSC_T_UM "Fehlertoleranzzeit bei fehlender Aktualisierung des DSC Botschaftsz‰hlers" VALUE 0xFCF0F1 KwUb 5100.00 t20ms_ub_b5100 0.00 5100.00 /end CHARACTERISTIC
/begin CHARACTERISTIC DBEGSMX_UC "Maximale Botschaftsz‰lerdifferenz bei ‹berwachung der EGS-Botschaft in BT" VALUE 0xFC0AB9 KwUb 2550.00 t10ms_ub_b2550 0.00 2550.00 /end CHARACTERISTIC
/begin CHARACTERISTIC DBEGS_T_UC "Fehlerzeit bei Fehler in Botschaftsz‰hler der EGS-Botschaft im Befehlstest" VALUE 0xFC0ABA KwUb 2550.00 t10ms_ub_b2550 0.00 2550.00 /end CHARACTERISTIC
/begin CHARACTERISTIC DBFGRMX_UM "Fehlerschwelle Botschaftsz‰hler in FGR-Botschaft" VALUE 0xFCF0EA KwUb 5100.00 t20ms_ub_b5100 0.00 5100.00 /end CHARACTERISTIC
/begin CHARACTERISTIC DBFGR_T_UM "Fehlerentprellung:  Fehler in Botschaftsz‰hler der FGR-Botschaft" VALUE 0xFCF0EB KwUb 5100.00 t20ms_ub_b5100 0.00 5100.00 /end CHARACTERISTIC
/begin CHARACTERISTIC DBSZL_T_UM "Fehlerentprellung:  Botschaftsunterbrechung der FGR-Botschaft" VALUE 0xFCF0EC KwUb 5100.00 t20ms_ub_b5100 0.00 5100.00 /end CHARACTERISTIC
/begin CHARACTERISTIC DFTEAHB "Schwelle Gemischanteil Tankentl¸ftung zum Setzen Bit ""Hohe Beladung""" VALUE 0xFD4938 KwSb 1.992 fak_sb_b1 -1.000 0.9922 FORMAT "%5.3" /end CHARACTERISTIC
/begin CHARACTERISTIC DNOTDFTEAD "Hysterese ftead-Schwelle zur Ausblendung TD" VALUE 0xFCCA5A KwWS16 127.9980 fak_sw_b64 -64.00000 63.99805 FORMAT "%8.5" /end CHARACTERISTIC
/begin CHARACTERISTIC DSTEMIN "Minimalwert f¸r Weitertransport in Totzeitglied Gemischtransport" VALUE 0xFCCA82 KwUw 0.9999695 fak_uw_b2 0.00 0.9999695 FORMAT "%9.7" /end CHARACTERISTIC
/begin CHARACTERISTIC DUETMOT "Delta Motor¸bertemperatur-Schwelle" VALUE 0xFC2220 KwUb 191.3 temp_ub_b191p25 0.00 191.3 FORMAT "%5.1" /end CHARACTERISTIC
/begin CHARACTERISTIC DZWKFMX_UC "Max-Wertbegrenzung f¸r Delta-ZW-Wirkungsgradkoeffizient f¸r Befehlstest" VALUE 0xFC0CB6 KwUb 11.20 fak_q0p0439 0.00 11.20 FORMAT "%5.2" /end CHARACTERISTIC
/begin CHARACTERISTIC DZWKFMX_UM "Max-Wertbegrenzung f¸r Delta-ZW-Wirkungsgradkoeffizient in der Funktions¸berw." VALUE 0xFCF10B KwUb 11.20 fak_q0p0439 0.00 11.20 FORMAT "%5.2" /end CHARACTERISTIC
/begin CHARACTERISTIC FBTEB "Faktor Begrenzung Lerngeschwindigkeit f¸r Beladung" CURVE 0xFD4939 KlAUbSstUbWUb 0.9961 fak_ub_b1 0.00 0.9961
 /begin AXIS_DESCR STD_AXIS ftefvab fak_ub_b0p03125 6 0.00 0.03113 FORMAT "%7.5" DEPOSIT ABSOLUTE /end AXIS_DESCR
/end CHARACTERISTIC
/begin CHARACTERISTIC FBTEVA "Faktor ftefva-abh‰ngige Lerngeschwindigkeit der Beladung" CURVE 0xFD4946 KlAUbSstUbWUb 0.9961 fak_ub_b1 0.00 0.9961 /begin AXIS_DESCR STD_AXIS ftefva fak_ub_b0p5 6 0.00 0.4980 DEPOSIT ABSOLUTE /end AXIS_DESCR /end CHARACTERISTIC
/begin CHARACTERISTIC FETATEBN "Kennlinie f¸r drehzahlabh‰ngigen Sollwert des Motorwirkungsgrades" CURVE 0xFD4953 KlAUbSstUbWUb 0.9961 fak_ub_b1 0.00 0.9961
 /begin AXIS_DESCR STD_AXIS nmot nmot_ub_q40 5 0.00 10200. FORMAT "%5.0" DEPOSIT ABSOLUTE /end AXIS_DESCR
/end CHARACTERISTIC
/begin CHARACTERISTIC FGRC_BFGR_DAT_UC "" VAL_BLK 0xFC09A2 KwbUb 255.0 dez 0.00 255.0 FORMAT "%5.1" NUMBER 16 /end CHARACTERISTIC
/begin CHARACTERISTIC FGRC_MIFA_DAT_UC "" VAL_BLK 0xFC09B2 KwbUb 99.61 rel_ub_b99p6 0.00 99.61 FORMAT "%5.2" NUMBER 16 /end CHARACTERISTIC
/begin CHARACTERISTIC FGRC_SFLAGS_DAT_UC "" VAL_BLK 0xFC09C2 KwbUb 255.0 dez 0.00 255.0 FORMAT "%5.1" NUMBER 16 /end CHARACTERISTIC
/begin CHARACTERISTIC FGRC_VFGR_DAT_UC "" VAL_BLK 0xFC09D2 KwbUw 511.9922 vfzg_uw_q0p00781 0.00 511.9922 FORMAT "%8.4" NUMBER 16 /end CHARACTERISTIC
/begin CHARACTERISTIC FGRE_T_UM "Fehlerentprellung: Fehler in Botschaftsabsicherung der FGR-Botschaft" VALUE 0xFCF0ED KwUb 255.0 dez 0.00 255.0 FORMAT "%5.1" /end CHARACTERISTIC
/begin CHARACTERISTIC FGR_T_UM "Entprellung Bedienhebel-Information in der ‹berwachung" VALUE 0xFCF0EE KwUb 5100.00 t20ms_ub_b5100 0.00 5100.00 /end CHARACTERISTIC
/begin CHARACTERISTIC FKATEB "Kennlinie Kraftstoffanteil Tankentl¸ftung abh. von te / TEMIN" CURVE 0xFD495E KlAUbSstUbWUb 0.9961 fak_ub_b1 0.00 0.9961
 /begin AXIS_DESCR STD_AXIS qtetemin fak_ub_b4 5 0.00 3.984 FORMAT "%5.3" DEPOSIT ABSOLUTE /end AXIS_DESCR
/end CHARACTERISTIC
/begin CHARACTERISTIC FQTEDL "Kennlinie Faktor f¸r exponentielle Absteuerung Sp¸lrate" CURVE 0xFD4969 KlAUbSstUbWUb 1.992 fak_ub_b2 0.00 1.992 FORMAT "%5.3"
 /begin AXIS_DESCR STD_AXIS dmlftef fak_ub_b0p5 5 0.00 0.4980 DEPOSIT ABSOLUTE /end AXIS_DESCR
/end CHARACTERISTIC
/begin CHARACTERISTIC FQTEVA "Progression bei Sp¸lratenaufsteuerung" CURVE 0xFD4974 KlAUbSstUbWUb 15.94 fak_ub_b16 0.00 15.94 FORMAT "%5.2" /begin AXIS_DESCR STD_AXIS ftefva fak_ub_b0p5 6 0.00 0.4980 DEPOSIT ABSOLUTE /end AXIS_DESCR /end CHARACTERISTIC
/begin CHARACTERISTIC FRHB "fr-Schwelle f¸r mˆgliches R¸cksetzten Flip-Flop ""Hohe Beladung""" VALUE 0xFD4981 KwUb 1.992 fak_ub_b2 0.00 1.992 FORMAT "%5.3" /end CHARACTERISTIC
/begin CHARACTERISTIC FSRFTEF "Faktor Steilheit Sp¸lratenregelung in der N‰he des gew¸nschten Krafstoffanteils" VALUE 0xFCCA5E KwUb 59.75 fak_ub_b64 4.000 63.75 FORMAT "%5.2" /end CHARACTERISTIC
/begin CHARACTERISTIC FTEADAB "Schwelle Beladung f¸r Abbruch TE-Phase" VALUE 0xFD4982 KwSb 127.5 fak_sb_b64 -64.00 63.50 FORMAT "%5.2" /end CHARACTERISTIC
/begin CHARACTERISTIC FTEADMX "Maximalwert der Beladung des AKF's" VALUE 0xFD4983 KwSb 127.5 fak_sb_b64 -64.00 63.50 FORMAT "%5.2" /end CHARACTERISTIC
/begin CHARACTERISTIC FTEFHB "Schwelle f¸r Sp¸lrate Tankentl¸ftung f¸r Erkennung hohe Beladung" VALUE 0xFD4984 KwUb 0.4980 fak_ub_b0p5 0.00 0.4980 /end CHARACTERISTIC
/begin CHARACTERISTIC FTEHB "Schwelle f¸r Faktor Tankentl¸ftung f¸r Erkennung hohe Beladung" VALUE 0xFD4985 KwSb 127.5 fak_sb_b64 -64.00 63.50 FORMAT "%5.2" /end CHARACTERISTIC
/begin CHARACTERISTIC FTEINIX "Kennlinie Max. Sp¸lrate abh‰ngig vom Integral Massenstrom TE nach TE Stop" CURVE 0xFD4986 KlAUbSstUbWUb 0.1992 fak_ub_b0p5 0.00 0.1992
 /begin AXIS_DESCR STD_AXIS imsteini m_ub_q0p0444 5 0.00 11.32 FORMAT "%5.2" DEPOSIT ABSOLUTE /end AXIS_DESCR
/end CHARACTERISTIC
/begin CHARACTERISTIC FUMRBRK "Faktor Umrechnung HC-Konzentration in Beladung ftead" VALUE 0xFD4991 KwUb 31.88 fak_ub_b32 0.00 31.88 FORMAT "%5.2" /end CHARACTERISTIC
/begin CHARACTERISTIC FVERMN "Kennlinie Faktor Vermischung Regeneriergas Tankentl¸ftung mit Frischluft" CURVE 0xFCCA5F KlAUbSstUbWUb 0.9961 fak_ub_b1 0.00 0.9961
 /begin AXIS_DESCR STD_AXIS nmot nmot_ub_q40 6 0.00 10200. FORMAT "%5.0" DEPOSIT ABSOLUTE /end AXIS_DESCR
/end CHARACTERISTIC
/begin CHARACTERISTIC FVERZDYN "Dynamischer Faktor Verzˆgerung Regeneriergas zw. Drosselklappe, Einspritzventil" CURVE 0xFCCA84 GklWUw 0.003905886 t_min_q5p96em8 0.00 0.003905886 FORMAT "%11.9"
 /begin AXIS_DESCR COM_AXIS qmsdyn fak_ub_b16 5 0.00 15.94 FORMAT "%5.2" AXIS_PTS_REF SQM05TEUB /end AXIS_DESCR
/end CHARACTERISTIC
/begin CHARACTERISTIC FVRMDYN "dynamischer Faktor Vermischung Regeneriergas Tankentl¸ftung mit Frischluft" CURVE 0xFCCA6C GklWUb 7.969 fak_ub_b8 0.00 7.969 FORMAT "%5.3"
 /begin AXIS_DESCR COM_AXIS qmsdyn fak_ub_b16 5 0.00 15.94 FORMAT "%5.2" AXIS_PTS_REF SQM05TEUB /end AXIS_DESCR
/end CHARACTERISTIC
/begin CHARACTERISTIC IHAMN "" VALUE 0xFCC9C4 KwUb 4.980 fak_q0p0195 0.00 4.980 FORMAT "%5.3" /end CHARACTERISTIC
/begin CHARACTERISTIC IMSTTPINI "Ersatzwert f¸r imsteini bei noch nicht erfolgtem B_atmtpa" VALUE 0xFCCA71 KwUb 11.32 m_ub_q0p0444 0.00 11.32 FORMAT "%5.2" /end CHARACTERISTIC
/begin CHARACTERISTIC KFDMP0_UC "Kennfeld 0 f¸r pedalabh‰ngigen Teil der Verlustmomente im Befehlstest" MAP 0xFC0F47 GkfWUb 99.61 rel_ub_b99p6 0.00 99.61 FORMAT "%5.2"
 /begin AXIS_DESCR COM_AXIS spsn_uc spg_ub_q0p019 8 0.00 4.980 FORMAT "%5.3" AXIS_PTS_REF MZUL_SPSNV08_UC /end AXIS_DESCR
 /begin AXIS_DESCR COM_AXIS nmot_uc nmot_ub_q40 8 0.00 10200. FORMAT "%5.0" AXIS_PTS_REF MZUL_NMV08_UC /end AXIS_DESCR
/end CHARACTERISTIC
/begin CHARACTERISTIC KFDMP1_UC "Kennfeld 1 f¸r pedalabh‰ngigen Teil der Verlustmomente im Befehlstest" MAP 0xFC0F87 GkfWUb 99.61 rel_ub_b99p6 0.00 99.61 FORMAT "%5.2"
 /begin AXIS_DESCR COM_AXIS spsn_uc spg_ub_q0p019 8 0.00 4.980 FORMAT "%5.3" AXIS_PTS_REF MZUL_SPSNV08_UC /end AXIS_DESCR
 /begin AXIS_DESCR COM_AXIS nmot_uc nmot_ub_q40 8 0.00 10200. FORMAT "%5.0" AXIS_PTS_REF MZUL_NMV08_UC /end AXIS_DESCR
/end CHARACTERISTIC
/begin CHARACTERISTIC KFDMT0_UC "Kennfeld 0 zur Ber¸cksichtigung temperaturabh‰ngiger Momente im Befehlstest" MAP 0xFC0FC7 GkfWUb 99.61 rel_ub_b99p6 0.00 99.61 FORMAT "%5.2"
 /begin AXIS_DESCR COM_AXIS tmotmn_uc temp_ub_q0p75_o48 8 -48.00 143.3 FORMAT "%5.1" AXIS_PTS_REF TMOV08_UC /end AXIS_DESCR
 /begin AXIS_DESCR COM_AXIS nmot_uc nmot_ub_q40 8 0.00 10200. FORMAT "%5.0" AXIS_PTS_REF MZUL_NMV08_UC /end AXIS_DESCR
/end CHARACTERISTIC
/begin CHARACTERISTIC KFDMT1_UC "Kennfeld 1 zur Ber¸cksichtigung temperaturabh‰ngiger Momente im Befehlstest" MAP 0xFC1007 GkfWUb 99.61 rel_ub_b99p6 0.00 99.61 FORMAT "%5.2"
 /begin AXIS_DESCR COM_AXIS tmotmn_uc temp_ub_q0p75_o48 8 -48.00 143.3 FORMAT "%5.1" AXIS_PTS_REF TMOV08_UC /end AXIS_DESCR
 /begin AXIS_DESCR COM_AXIS nmot_uc nmot_ub_q40 8 0.00 10200. FORMAT "%5.0" AXIS_PTS_REF MZUL_NMV08_UC /end AXIS_DESCR
/end CHARACTERISTIC
/begin CHARACTERISTIC KFDPSTE "Kennfeld Solldifferenzdruck bei TE" MAP 0xFD4A24 KfAxSwAySwSstxSwSstySwWSw 2559.961 p_q0p039 -1280.000 1279.961 FORMAT "%8.3"
 /begin AXIS_DESCR STD_AXIS ml_w_teb m_uw_b6553p5 10 -3276.800 3276.700 FORMAT "%8.3" DEPOSIT ABSOLUTE /end AXIS_DESCR
 /begin AXIS_DESCR STD_AXIS fteadmod_w fak_sw_b64 6 -64.00000 63.99805 FORMAT "%8.5" DEPOSIT ABSOLUTE /end AXIS_DESCR
/end CHARACTERISTIC
/begin CHARACTERISTIC KFDZWKF_UC "Kennfeld Koeffizient f¸r Delta-ZW-Wirkungsgrad f¸r Befehlstest" MAP 0xFC0CB7 GkfWUb 11.20 fak_q0p0439 0.00 11.20 FORMAT "%5.2"
 /begin AXIS_DESCR COM_AXIS rl_uc rel_ub_q0p75 8 0.00 191.3 FORMAT "%5.1" AXIS_PTS_REF MIST_RLV08_UC /end AXIS_DESCR
 /begin AXIS_DESCR COM_AXIS nmot_uc nmot_ub_q40 8 0.00 10200. FORMAT "%5.0" AXIS_PTS_REF MIST_NMV08_UC /end AXIS_DESCR
/end CHARACTERISTIC
/begin CHARACTERISTIC KFDZWKF_UM "Kennfeld Koeffizient f¸r Delta-ZW-Wirkungsgrad in der Funktions¸berwachung" MAP 0xFCF10C GkfWUb 11.20 fak_q0p0439 0.00 11.20 FORMAT "%5.2"
 /begin AXIS_DESCR COM_AXIS rl_um rel_ub_q0p75 8 0.00 191.3 FORMAT "%5.1" AXIS_PTS_REF RLV08_UM /end AXIS_DESCR
 /begin AXIS_DESCR COM_AXIS nmot_um nmot_ub_q40 8 0.00 10200. FORMAT "%5.0" AXIS_PTS_REF NMV08_UM /end AXIS_DESCR
/end CHARACTERISTIC
/begin CHARACTERISTIC KFETATE "Kennfeld gew¸nscher Wirkungsgrad bei Tankentl¸ftung bei Erreichen te = TEMIN" MAP 0xFD4AC0 KfAxUwAyUwSstxSwSstyUwWUw 50.00000 rel_q0p00195 50.00000 100.0000 FORMAT "%8.4"
 /begin AXIS_DESCR STD_AXIS fteadf_w fak_q0p00195 3 -64.00000 63.99805 FORMAT "%8.5" DEPOSIT ABSOLUTE /end AXIS_DESCR
 /begin AXIS_DESCR STD_AXIS mifa_w rel_uw_b100 5 0.00 99.99847 FORMAT "%8.5" DEPOSIT ABSOLUTE /end AXIS_DESCR
/end CHARACTERISTIC
/begin CHARACTERISTIC KFFQTEFR "KF stetige Grenzwertregelung" MAP 0xFD4AF2 KfAxUwAyUwSstxUwSstyUwWSw 31.87500 fak_sb_b16 -16.00000 15.87500 FORMAT "%8.5"
 /begin AXIS_DESCR STD_AXIS ml_w m_uw_b6553p5 8 0.00 6553.500 FORMAT "%8.3" DEPOSIT ABSOLUTE /end AXIS_DESCR
 /begin AXIS_DESCR STD_AXIS frmxa_w fak_uw_b2 8 0.00 1.999969 FORMAT "%8.6" DEPOSIT ABSOLUTE /end AXIS_DESCR
/end CHARACTERISTIC
/begin CHARACTERISTIC KFFTEAN "Kennfeld Maximale Sp¸lrate bei Notlauftankentl¸ftung" MAP 0xFD4B96 KfAxUwAyUwSstxUwSstyUwWUw 0.1992188 fak_ub_b0p5 0.00 0.1992188 FORMAT "%9.7"
 /begin AXIS_DESCR STD_AXIS nmot_w nmot_uw_q0p25 10 0.00 16383.75 FORMAT "%8.2" DEPOSIT ABSOLUTE /end AXIS_DESCR
 /begin AXIS_DESCR STD_AXIS rlsol_w rel_uw_q0p0234 10 0.00 1535.977 FORMAT "%8.3" DEPOSIT ABSOLUTE /end AXIS_DESCR
/end CHARACTERISTIC
/begin CHARACTERISTIC KFFTEAX "Kennfeld maximale Sp¸lrate" MAP 0xFD4992 KfAxUbAyUbSstxUwSstyUbWUb 0.1992 fak_ub_b0p5 0.00 0.1992
 /begin AXIS_DESCR STD_AXIS ml_w m_uw_b6553p5 5 0.00 6553.500 FORMAT "%8.3" DEPOSIT ABSOLUTE /end AXIS_DESCR
 /begin AXIS_DESCR STD_AXIS tans temp_ub_q0p75_o48 4 -48.00 143.3 FORMAT "%5.1" DEPOSIT ABSOLUTE /end AXIS_DESCR
/end CHARACTERISTIC
/begin CHARACTERISTIC KFMDST "Startmoment" MAP 0xFC8DF6 KfAxUbAyUbSstxUbSstyUwWUw 199.9969 rel_uw_b200 0.00 199.9969 FORMAT "%8.4"
 /begin AXIS_DESCR STD_AXIS tmot temp_ub_q0p75_o48 8 -48.00 143.3 FORMAT "%5.1" DEPOSIT ABSOLUTE /end AXIS_DESCR
 /begin AXIS_DESCR STD_AXIS qnst_w fak_uw_b2 6 0.00 1.999969 FORMAT "%8.6" DEPOSIT ABSOLUTE /end AXIS_DESCR
/end CHARACTERISTIC
/begin CHARACTERISTIC KFMDSTGD "Startmoment im gedrosselten Betrieb" MAP 0xFC8E6C KfAxUbAyUbSstxUbSstyUwWUw 199.9969 rel_uw_b200 0.00 199.9969 FORMAT "%8.4"
 /begin AXIS_DESCR STD_AXIS tmot temp_ub_q0p75_o48 8 -48.00 143.3 FORMAT "%5.1" DEPOSIT ABSOLUTE /end AXIS_DESCR
 /begin AXIS_DESCR STD_AXIS qnst_w fak_uw_b2 6 0.00 1.999969 FORMAT "%8.6" DEPOSIT ABSOLUTE /end AXIS_DESCR
/end CHARACTERISTIC
/begin CHARACTERISTIC KFMI_UC "Kennfeld optimales Motormoment im Befehlstest" MAP 0xFC0CF7 GkfWUb 99.61 rel_ub_b99p6 0.00 99.61 FORMAT "%5.2"
 /begin AXIS_DESCR COM_AXIS rl_uc rel_ub_q0p75 8 0.00 191.3 FORMAT "%5.1" AXIS_PTS_REF MIST_RLV08_UC /end AXIS_DESCR
 /begin AXIS_DESCR COM_AXIS nmot_uc nmot_ub_q40 8 0.00 10200. FORMAT "%5.0" AXIS_PTS_REF MIST_NMV08_UC /end AXIS_DESCR
/end CHARACTERISTIC
/begin CHARACTERISTIC KFMI_UM "Kennfeld optimales Motormoment in der Funktions¸berwachung" MAP 0xFCF14C GkfWUb 99.61 rel_ub_b99p6 0.00 99.61 FORMAT "%5.2"
 /begin AXIS_DESCR COM_AXIS rl_um rel_ub_q0p75 8 0.00 191.3 FORMAT "%5.1" AXIS_PTS_REF RLV08_UM /end AXIS_DESCR
 /begin AXIS_DESCR COM_AXIS nmot_um nmot_ub_q40 8 0.00 10200. FORMAT "%5.0" AXIS_PTS_REF NMV08_UM /end AXIS_DESCR
/end CHARACTERISTIC
/begin CHARACTERISTIC KFMOF_UC "Kennfeld f¸r Offset-Toleranz abh‰ngig vom zul‰ssigen Moment im Befehlstest" MAP 0xFC1047 GkfWUb 99.61 rel_ub_b99p6 0.00 99.61 FORMAT "%5.2"
 /begin AXIS_DESCR COM_AXIS mz_uc rel_ub_b99p6 8 0.00 99.61 FORMAT "%5.2" AXIS_PTS_REF MDV08_UC /end AXIS_DESCR
 /begin AXIS_DESCR COM_AXIS nmot_uc nmot_ub_q40 8 0.00 10200. FORMAT "%5.0" AXIS_PTS_REF MZUL_NMV08_UC /end AXIS_DESCR
/end CHARACTERISTIC
/begin CHARACTERISTIC KFNDDPSTE "Kennfeld nmot-Gewichtung des TE-Differenzdruckoffsets" MAP 0xFD4C8A KfAxUwAyUwSstxUwSstyUwWSw 2559.961 p_q0p039 -1280.000 1279.961 FORMAT "%8.3"
 /begin AXIS_DESCR STD_AXIS nmot_w nmot_uw_q0p25 6 0.00 16383.75 FORMAT "%8.2" DEPOSIT ABSOLUTE /end AXIS_DESCR
 /begin AXIS_DESCR STD_AXIS nddpste_in p_q0p039s32768 8 -1280.00 1279.96 FORMAT "%7.2" DEPOSIT ABSOLUTE /end AXIS_DESCR
/end CHARACTERISTIC
/begin CHARACTERISTIC KFPZU0_UC "Kennfeld 0 f¸r rel. zul. Moment aus der Pedalstellung im Befehlstest" MAP 0xFC1087 GkfWUb 99.61 rel_ub_b99p6 0.00 99.61 FORMAT "%5.2"
 /begin AXIS_DESCR COM_AXIS spsn_uc spg_ub_q0p019 8 0.00 4.980 FORMAT "%5.3" AXIS_PTS_REF MZUL_SPSNV08_UC /end AXIS_DESCR
 /begin AXIS_DESCR COM_AXIS nmot_uc nmot_ub_q40 8 0.00 10200. FORMAT "%5.0" AXIS_PTS_REF MZUL_NMV08_UC /end AXIS_DESCR
/end CHARACTERISTIC
/begin CHARACTERISTIC KFPZU1_UC "Kennfeld 1 f¸r rel. zul. Moment aus der Pedalstellung im Befehlstest" MAP 0xFC10C7 GkfWUb 99.61 rel_ub_b99p6 0.00 99.61 FORMAT "%5.2"
 /begin AXIS_DESCR COM_AXIS spsn_uc spg_ub_q0p019 8 0.00 4.980 FORMAT "%5.3" AXIS_PTS_REF MZUL_SPSNV08_UC /end AXIS_DESCR
 /begin AXIS_DESCR COM_AXIS nmot_uc nmot_ub_q40 8 0.00 10200. FORMAT "%5.0" AXIS_PTS_REF MZUL_NMV08_UC /end AXIS_DESCR
/end CHARACTERISTIC
/begin CHARACTERISTIC KFQTE "Kennfeld Auf-/Absteuergeschwindigkeit der Sollsp¸lrate Tankentl¸ftung" MAP 0xFD4D0A KfAxUwAyUwSstxUwSstyUwWSw 3.12494432 perio_ub_b0p012207 -1.56249600 1.56244832
 /begin AXIS_DESCR STD_AXIS ml_w m_uw_b6553p5 8 0.00 6553.500 FORMAT "%8.3" DEPOSIT ABSOLUTE /end AXIS_DESCR
 /begin AXIS_DESCR STD_AXIS frmit fak_ub_b2 8 0.00 1.992 FORMAT "%5.3" DEPOSIT ABSOLUTE /end AXIS_DESCR
/end CHARACTERISTIC
/begin CHARACTERISTIC KFTADMS "dynamischer Bewertungsfaktor f¸r das Absteuern des TEV" MAP 0xFCCA46 GkfWU8 1.992 fak_ub_b2 0.00 1.992 FORMAT "%5.3"
 /begin AXIS_DESCR COM_AXIS dmssginr fak_sb_b1 5 -1.000 0.9922 FORMAT "%5.3" AXIS_PTS_REF SDM05TESB /end AXIS_DESCR
 /begin AXIS_DESCR COM_AXIS nmot nmot_ub_q40 4 0.00 10200. FORMAT "%5.0" AXIS_PTS_REF SNM04TEUB /end AXIS_DESCR
/end CHARACTERISTIC
/begin CHARACTERISTIC KFTATX "Kennfeld f¸r maximales Tastverh‰ltnis" MAP 0xFD49B6 KfAxUbAyUbSstxUwSstyUbWUb 99.61 rel_ub_b99p6 0.00 99.61 FORMAT "%5.2"
 /begin AXIS_DESCR STD_AXIS ml_w m_uw_b6553p5 10 0.00 6553.500 FORMAT "%8.3" DEPOSIT ABSOLUTE /end AXIS_DESCR
 /begin AXIS_DESCR STD_AXIS pspu fak_ub_b2 6 0.00 1.992 FORMAT "%5.3" DEPOSIT ABSOLUTE /end AXIS_DESCR
/end CHARACTERISTIC
/begin CHARACTERISTIC KFTEKA "Kennfeld Sollkraftstoffanteil bei Regenerierung" MAP 0xFD4DAE KfAxUbAyUbSstxUbSstyUbWSb 0.9922 fak_sb_b1 0.00 0.9922
 /begin AXIS_DESCR STD_AXIS nmot nmot_ub_q40 5 0.00 10200. FORMAT "%5.0" DEPOSIT ABSOLUTE /end AXIS_DESCR
 /begin AXIS_DESCR STD_AXIS rl rel_ub_q0p75 5 0.00 191.3 FORMAT "%5.1" DEPOSIT ABSOLUTE /end AXIS_DESCR
/end CHARACTERISTIC
/begin CHARACTERISTIC KFZW_UC "Kennfeld f¸r optimalen Z¸ndwinkel im Befehlstest" MAP 0xFC0D37 GkfWSb 191.3 zw_sb_q0p75 -96.00 95.25 FORMAT "%5.2"
 /begin AXIS_DESCR COM_AXIS rl_uc rel_ub_q0p75 8 0.00 191.3 FORMAT "%5.1" AXIS_PTS_REF MIST_RLV08_UC /end AXIS_DESCR
 /begin AXIS_DESCR COM_AXIS nmot_uc nmot_ub_q40 8 0.00 10200. FORMAT "%5.0" AXIS_PTS_REF MIST_NMV08_UC /end AXIS_DESCR
/end CHARACTERISTIC
/begin CHARACTERISTIC KFZW_UM "Kennfeld f¸r optimalen Z¸ndwinkel in der Funktions¸berwachung" MAP 0xFCF18C GkfWSb 191.3 zw_sb_q0p75 -96.00 95.25 FORMAT "%5.2"
 /begin AXIS_DESCR COM_AXIS rl_um rel_ub_q0p75 8 0.00 191.3 FORMAT "%5.1" AXIS_PTS_REF RLV08_UM /end AXIS_DESCR
 /begin AXIS_DESCR COM_AXIS nmot_um nmot_ub_q40 8 0.00 10200. FORMAT "%5.0" AXIS_PTS_REF NMV08_UM /end AXIS_DESCR
/end CHARACTERISTIC
/begin CHARACTERISTIC KHCTEMN "Minimalwert HC-Konzentration Regeneriergas Tankentl¸ftung" VALUE 0xFD4A0E KwSb 3.984 fak_sb_b2 -2.000 1.984 FORMAT "%5.3" /end CHARACTERISTIC
/begin CHARACTERISTIC KHCTEMX "Maximalwert HC-Konzentration Regeneriergas Tankentl¸ftung" VALUE 0xFD4A0F KwSb 3.984 fak_sb_b2 -2.000 1.984 FORMAT "%5.3" /end CHARACTERISTIC
/begin CHARACTERISTIC KLDZWQ_UC "Kennlinie zur Deltaz¸ndwinkel (quadratisch) f¸r Befehlstest" CURVE 0xFC0D77 KlAUbSstUbWUb 90.72 kwq_ub_q0p35576 0.00 90.72 FORMAT "%5.2"
 /begin AXIS_DESCR STD_AXIS dzw_uc zw_ub_q0p75 8 0.00 191.3 FORMAT "%5.1" DEPOSIT ABSOLUTE /end AXIS_DESCR
/end CHARACTERISTIC
/begin CHARACTERISTIC KLDZWQ_UM "Kennlinie zur Deltaz¸ndwinkel (quadratisch) in Funktions¸berwachung" CURVE 0xFCF1CC KlAUbSstUbWUb 90.72 kwq_ub_q0p35576 0.00 90.72 FORMAT "%5.2"
 /begin AXIS_DESCR STD_AXIS dzw_um zw_ub_q0p75 8 0.00 191.3 FORMAT "%5.1" DEPOSIT ABSOLUTE /end AXIS_DESCR
/end CHARACTERISTIC
/begin CHARACTERISTIC KLFAKSP_UC "Kennlinie f¸r Wirkungsgrad abh‰ngig von Aufteilung im Befehlstest" CURVE 0xFC0D88 GklWUb 100.0 rel_ub_b127p5 0.00 100.0 FORMAT "%5.1"
 /begin AXIS_DESCR COM_AXIS nmot_uc nmot_ub_q40 8 0.00 10200. FORMAT "%5.0" AXIS_PTS_REF MIST_NMV08_UC /end AXIS_DESCR
/end CHARACTERISTIC
/begin CHARACTERISTIC KLFAKSP_UM "Kennlinie f¸r Wirkungsgrad abh‰ngig von Aufteilung in der Funktions¸berwachung" CURVE 0xFCF1DD GklWUb 100.0 rel_ub_b127p5 0.00 100.0 FORMAT "%5.1"
 /begin AXIS_DESCR COM_AXIS nmot_um nmot_ub_q40 8 0.00 10200. FORMAT "%5.0" AXIS_PTS_REF NMV08_UM /end AXIS_DESCR
/end CHARACTERISTIC
/begin CHARACTERISTIC KLFILGWRTE "Kennlinie f¸r frmit abh‰ngige Grenzwertberechnung" CURVE 0xFD4A10 KlAUbSstUbWUb 255.0 dez 0.00 255.0 FORMAT "%5.1"
 /begin AXIS_DESCR STD_AXIS frmit fak_ub_b2 6 0.00 1.992 FORMAT "%5.3" DEPOSIT ABSOLUTE /end AXIS_DESCR
/end CHARACTERISTIC
/begin CHARACTERISTIC KLLLRZU_UC "Kennlinie zul‰ssiges Moment der Leerlaufregelung im Befehlstest" CURVE 0xFC1107 GklWUb 99.61 rel_ub_b99p6 0.00 99.61 FORMAT "%5.2"
 /begin AXIS_DESCR COM_AXIS nmot_uc nmot_ub_q40 8 0.00 10200. FORMAT "%5.0" AXIS_PTS_REF MZUL_NMV08_UC /end AXIS_DESCR
/end CHARACTERISTIC
/begin CHARACTERISTIC KLMIMAX_UC "Kennlinie maximales indiziertes Moment im Befehlstest" CURVE 0xFC110F GklWUb 99.61 rel_ub_b99p6 0.00 99.61 FORMAT "%5.2"
 /begin AXIS_DESCR COM_AXIS nmot_uc nmot_ub_q40 8 0.00 10200. FORMAT "%5.0" AXIS_PTS_REF MZUL_NMV08_UC /end AXIS_DESCR
/end CHARACTERISTIC
/begin CHARACTERISTIC KLMIMIN_UC "Kennlinie minimales indiziertes Moment im Befehlstest" CURVE 0xFC1117 GklWUb 99.61 rel_ub_b99p6 0.00 99.61 FORMAT "%5.2"
 /begin AXIS_DESCR COM_AXIS nmot_uc nmot_ub_q40 8 0.00 10200. FORMAT "%5.0" AXIS_PTS_REF MZUL_NMV08_UC /end AXIS_DESCR
/end CHARACTERISTIC
/begin CHARACTERISTIC KLMZUMN_UC "Kenlinie f¸r drehzahlabh‰ngiges zul. Moment im Befehlstest" CURVE 0xFC111F GklWUb 99.61 rel_ub_b99p6 0.00 99.61 FORMAT "%5.2"
 /begin AXIS_DESCR COM_AXIS nmot_uc nmot_ub_q40 8 0.00 10200. FORMAT "%5.0" AXIS_PTS_REF MZUL_NMV08_UC /end AXIS_DESCR
/end CHARACTERISTIC
/begin CHARACTERISTIC KLNPED_UC "pedalsollwertabh. Drehzahlbegr. in der DK-Antrieb-Ersatzfunktion; Befehlstest" CURVE 0xFC0BC2 KlAUbSstUbWUb 10200. nmot_ub_q40 0.00 10200. FORMAT "%5.0"
 /begin AXIS_DESCR STD_AXIS spsn_uc spg_ub_q0p019 8 0.00 4.980 FORMAT "%5.3" DEPOSIT ABSOLUTE /end AXIS_DESCR
/end CHARACTERISTIC
/begin CHARACTERISTIC KLZL1_UC "Kennlinie zur lambdaabh‰ngigen Z¸ndwinkelkorrekturen 1.Bank im Befehlstest" CURVE 0xFC0D90 KlAUbSstUbWUb 191.3 zw_ub_q0p75 0.00 191.3 FORMAT "%5.1"
 /begin AXIS_DESCR STD_AXIS lamb1_uc fak_ub_b8 8 0.00 7.969 FORMAT "%5.3" DEPOSIT ABSOLUTE /end AXIS_DESCR
/end CHARACTERISTIC
/begin CHARACTERISTIC KLZL1_UM "Kennlinie zur lambdaabh‰ngigen Z¸ndwinkelkorrekturen 1.Bank in  der Fkt¸ko" CURVE 0xFCF1E5 KlAUbSstUbWUb 191.3 zw_ub_q0p75 0.00 191.3 FORMAT "%5.1"
 /begin AXIS_DESCR STD_AXIS lamb1_um fak_ub_b8 8 0.00 7.969 FORMAT "%5.3" DEPOSIT ABSOLUTE /end AXIS_DESCR
/end CHARACTERISTIC
/begin CHARACTERISTIC KLZL2_UC "Kennlinie zur lambdaabh‰ngigen Z¸ndwinkelkorrekturen 2.Bank im Befhelstest" CURVE 0xFC0DA1 KlAUbSstUbWUb 191.3 zw_ub_q0p75 0.00 191.3 FORMAT "%5.1"
 /begin AXIS_DESCR STD_AXIS lamb2_uc fak_ub_b8 8 0.00 7.969 FORMAT "%5.3" DEPOSIT ABSOLUTE /end AXIS_DESCR
/end CHARACTERISTIC
/begin CHARACTERISTIC KLZL2_UM "Kennlinie zur lambdaabh‰ngigen Z¸ndwinkelkorrekturen 2.Bank in  der Fkt¸ko" CURVE 0xFCF1F6 KlAUbSstUbWUb 191.3 zw_ub_q0p75 0.00 191.3 FORMAT "%5.1"
 /begin AXIS_DESCR STD_AXIS lamb2_um fak_ub_b8 8 0.00 7.969 FORMAT "%5.3" DEPOSIT ABSOLUTE /end AXIS_DESCR
/end CHARACTERISTIC
/begin CHARACTERISTIC LAMTEMN "minimale Lambda-Schwelle, bei der die Tankentl¸ftung aktiv sein kann" VALUE 0xFD4DE6 KwUw 0.2028809 fak_uw_b16 0.7971191 1.000000 FORMAT "%8.6" /end CHARACTERISTIC
/begin CHARACTERISTIC LAMTEMX "maximale Lambda-Schwelle, bei der die Tankentl¸ftung aktiv sein kann" VALUE 0xFD4DE8 KwUw 0.3000488 fak_uw_b16 1.000000 1.300049 FORMAT "%8.6" /end CHARACTERISTIC
/begin AXIS_PTS MDV08_UC "St¸tzstellenverteilung f¸r Moment im Befehlstest" 0xFC1127 mz_uc SstAUbSstUb 99.61 rel_ub_b99p6 8 0.00 99.61 FORMAT "%5.2" DEPOSIT ABSOLUTE /end AXIS_PTS
/begin CHARACTERISTIC MIST_FRKSCH_DAT_UC "" VAL_BLK 0xFC0DB2 KwbUb 0.9961 fak_ub_b1 0.00 0.9961 NUMBER 16 /end CHARACTERISTIC
/begin CHARACTERISTIC MIST_LAMB1_DAT_UC "" VAL_BLK 0xFC0DC2 KwbUb 7.969 fak_ub_b8 0.00 7.969 FORMAT "%5.3" NUMBER 16 /end CHARACTERISTIC
/begin CHARACTERISTIC MIST_LAMB2_DAT_UC "" VAL_BLK 0xFC0DD2 KwbUb 7.969 fak_ub_b8 0.00 7.969 FORMAT "%5.3" NUMBER 16 /end CHARACTERISTIC
/begin CHARACTERISTIC MIST_NMOT_DAT_UC "" VAL_BLK 0xFC0DE2 KwbUb 10200. nmot_ub_q40 0.00 10200. FORMAT "%5.0" NUMBER 16 /end CHARACTERISTIC
/begin AXIS_PTS MIST_NMV08_UC "" 0xFC0DF2 nmot_uc SstAUbSstUb 10200. nmot_ub_q40 8 0.00 10200. FORMAT "%5.0" DEPOSIT ABSOLUTE /end AXIS_PTS
/begin AXIS_PTS MIST_RLV08_UC "" 0xFC0DFB rl_uc SstAUbSstUb 191.3 rel_ub_q0p75 8 0.00 191.3 FORMAT "%5.1" DEPOSIT ABSOLUTE /end AXIS_PTS
/begin CHARACTERISTIC MIST_RL_DAT_UC "" VAL_BLK 0xFC0E04 KwbUb 191.3 rel_ub_q0p75 0.00 191.3 FORMAT "%5.1" NUMBER 16 /end CHARACTERISTIC
/begin CHARACTERISTIC MIST_ZW1_DAT_UC "" VAL_BLK 0xFC0E14 KwbUb 191.3 zw_sb_q0p75 0.00 191.3 FORMAT "%5.1" NUMBER 16 /end CHARACTERISTIC
/begin CHARACTERISTIC MIST_ZW2_DAT_UC "" VAL_BLK 0xFC0E24 KwbUb 191.3 zw_sb_q0p75 0.00 191.3 FORMAT "%5.1" NUMBER 16 /end CHARACTERISTIC
/begin CHARACTERISTIC MNHUBFTEMN "Minimalwert Faktor Ein-/Ausblendung Teildrosselung f¸r TE" VALUE 0xFD4DD4 KwUw 3.999939 fak_uw_b4 0.00 3.999939 FORMAT "%8.6" /end CHARACTERISTIC
/begin CHARACTERISTIC MSDKLMMN "minimaler Massenstrom ¸ber Drosselklappe in TE" VALUE 0xFCCA8E KwUw 6553.500 m_uw_b6553p5 0.00 6553.500 FORMAT "%8.3" /end CHARACTERISTIC
/begin CHARACTERISTIC MSRC_BMSR_DAT_UC "" VAL_BLK 0xFC09F8 KwbUb 255.0 dez 0.00 255.0 FORMAT "%5.1" NUMBER 16 /end CHARACTERISTIC
/begin CHARACTERISTIC MSRC_BZDSCA_DAT_UC "" VAL_BLK 0xFC0A08 KwbUb 255.0 dez 0.00 255.0 FORMAT "%5.1" NUMBER 16 /end CHARACTERISTIC
/begin CHARACTERISTIC MSRC_BZDSC_DAT_UC "" VAL_BLK 0xFC0A18 KwbUb 255.0 dez 0.00 255.0 FORMAT "%5.1" NUMBER 16 /end CHARACTERISTIC
/begin CHARACTERISTIC MSRC_CODCAN_DAT_UC "" VAL_BLK 0xFC0A28 KwbUb 255.0 dez 0.00 255.0 FORMAT "%5.1" NUMBER 16 /end CHARACTERISTIC
/begin CHARACTERISTIC MSRC_CSDSC_DAT_UC "" VAL_BLK 0xFC0A38 KwbUb 255.0 dez 0.00 255.0 FORMAT "%5.1" NUMBER 16 /end CHARACTERISTIC
/begin CHARACTERISTIC MSRC_C_DAT_UC "" VAL_BLK 0xFC0A48 KwbUb 5100.00 t20ms_ub_b5100 0.00 5100.00 NUMBER 16 /end CHARACTERISTIC
/begin CHARACTERISTIC MSRC_DBDSC_DAT_UC "" VAL_BLK 0xFC0A58 KwbUb 5100.00 t20ms_ub_b5100 0.00 5100.00 NUMBER 16 /end CHARACTERISTIC
/begin CHARACTERISTIC MSRC_MIMSRCPL_DAT_UC "" VAL_BLK 0xFC0A68 KwbUb 255.0 dez 0.00 255.0 FORMAT "%5.1" NUMBER 16 /end CHARACTERISTIC
/begin CHARACTERISTIC MSRC_MIMSR_DAT_UC "" VAL_BLK 0xFC0A78 KwbUb 99.61 rel_ub_b99p6 0.00 99.61 FORMAT "%5.2" NUMBER 16 /end CHARACTERISTIC
/begin CHARACTERISTIC MSRC_MKSASRL_DAT_UC "" VAL_BLK 0xFC0A88 KwbUb 255.0 dez 0.00 255.0 FORMAT "%5.1" NUMBER 16 /end CHARACTERISTIC
/begin CHARACTERISTIC MSRC_MKSASRS_DAT_UC "" VAL_BLK 0xFC0A98 KwbUb 255.0 dez 0.00 255.0 FORMAT "%5.1" NUMBER 16 /end CHARACTERISTIC
/begin CHARACTERISTIC MSRC_SBIT_DAT_UC "" VAL_BLK 0xFC0AA8 KwbUb 255.0 dez 0.00 255.0 FORMAT "%5.1" NUMBER 16 /end CHARACTERISTIC
/begin CHARACTERISTIC MSRC_T_UC "Fehlerzeit f¸r MSR-Eingriff-‹berwachung des Befehlstests" VALUE 0xFC0AB8 KwUb 5100.00 t20ms_ub_b5100 0.00 5100.00 /end CHARACTERISTIC
/begin CHARACTERISTIC MSRC_T_UM "Fehlerzeit f¸r MSR-Eingriff-‹berwachung der Funktions¸berwachung" VALUE 0xFCF0F2 KwUb 5100.00 t20ms_ub_b5100 0.00 5100.00 /end CHARACTERISTIC
/begin CHARACTERISTIC MVER_C_DAT_UC "" VAL_BLK 0xFC0E34 KwbUb 255.0 dez 0.00 255.0 FORMAT "%5.1" NUMBER 16 /end CHARACTERISTIC
/begin CHARACTERISTIC MVER_MI_DAT_UC "" VAL_BLK 0xFC0E44 KwbUb 255.0 dez 0.00 255.0 FORMAT "%5.1" NUMBER 16 /end CHARACTERISTIC
/begin CHARACTERISTIC MVER_MZF_DAT_UC "" VAL_BLK 0xFC0E54 KwbUb 255.0 dez 0.00 255.0 FORMAT "%5.1" NUMBER 16 /end CHARACTERISTIC
/begin CHARACTERISTIC MVER_MZO_DAT_UC "" VAL_BLK 0xFC0E64 KwbUb 255.0 dez 0.00 255.0 FORMAT "%5.1" NUMBER 16 /end CHARACTERISTIC
/begin CHARACTERISTIC MVER_RFLAGS_DAT_UC "" VAL_BLK 0xFC0E74 KwbUb 255.0 dez 0.00 255.0 FORMAT "%5.1" NUMBER 16 /end CHARACTERISTIC
/begin CHARACTERISTIC MVER_T_UC "Fehlerzeit beim Momentenvergleich im Befehlstest" VALUE 0xFC0E84 KwUb 10200.0 t40ms_ub_b10200 0.00 10200.0 FORMAT "%7.1" /end CHARACTERISTIC
/begin CHARACTERISTIC MVER_T_UM "Fehlerzeit beim Momentenvergleich in der Funktions¸berwachung" VALUE 0xFCF207 KwUb 10200.0 t40ms_ub_b10200 0.00 10200.0 FORMAT "%7.1" /end CHARACTERISTIC
/begin CHARACTERISTIC MZFFIL_UC "Filter-Zeitkonstante f¸r verzˆgertes Moment im Befehlstest" VALUE 0xFC0E85 KwUb 10159.4 zk40ms_ub_b10200 40.6299 10200.0 FORMAT "%7.1" /end CHARACTERISTIC
/begin CHARACTERISTIC MZFFIL_UM "Filter-Zeitkonstante f¸r verzˆgertes Moment in der Funktions¸berwachung" VALUE 0xFCF208 KwUb 10159.4 zk40ms_ub_b10200 40.6299 10200.0 FORMAT "%7.1" /end CHARACTERISTIC
/begin CHARACTERISTIC MZFTV_UC "Verzugszeit f¸r zul‰ssiges Moment mz_um im Befehlstest" VALUE 0xFC0E86 KwUb 280.000 t40ms_ub_b10200 40.0000 320.000 FORMAT "%7.3" /end CHARACTERISTIC
/begin CHARACTERISTIC MZFTV_UM "Verzugszeit f¸r zul‰ssiges Moment mz_um in der Funktions¸berwachg" VALUE 0xFCF209 KwUb 280.000 t40ms_ub_b10200 40.0000 320.000 FORMAT "%7.3" /end CHARACTERISTIC
/begin CHARACTERISTIC MZF_LOW_DAT_UC "" VAL_BLK 0xFC0E87 KwbUb 0.3891 rel_ub_q0p00153 0.00 0.3891 NUMBER 16 /end CHARACTERISTIC
/begin CHARACTERISTIC MZF_MZF_DAT_UC "" VAL_BLK 0xFC0E97 KwbUb 99.61 rel_ub_b99p6 0.00 99.61 FORMAT "%5.2" NUMBER 16 /end CHARACTERISTIC
/begin CHARACTERISTIC MZF_MZ_DAT_UC "" VAL_BLK 0xFC0EA7 KwbUb 99.61 rel_ub_b99p6 0.00 99.61 FORMAT "%5.2" NUMBER 16 /end CHARACTERISTIC
/begin CHARACTERISTIC MZF_PTR_DAT_UC "" VAL_BLK 0xFC0EB7 KwbUb 255.0 dez 0.00 255.0 FORMAT "%5.1" NUMBER 16 /end CHARACTERISTIC
/begin CHARACTERISTIC MZF_REG_DAT_UC "" MAP 0xFC0EC7 KfWUb 99.61 rel_ub_b99p6 0.00 99.61 FORMAT "%5.2"
 /begin AXIS_DESCR FIX_AXIS mzf_x_uc dez 16 0.00 15.00 FORMAT "%5.2" FIX_AXIS_PAR 0 0 16 /end AXIS_DESCR
 /begin AXIS_DESCR FIX_AXIS mzf_y_uc dez 8 0.00 7.000 FORMAT "%5.3" FIX_AXIS_PAR 0 0 8 /end AXIS_DESCR
/end CHARACTERISTIC
/begin CHARACTERISTIC MZUL_MFGR_DAT_UC "" VAL_BLK 0xFC1130 KwbUb 99.61 rel_ub_q0p3906 0.00 99.61 FORMAT "%5.2" NUMBER 16 /end CHARACTERISTIC
/begin CHARACTERISTIC MZUL_MMSR_DAT_UC "" VAL_BLK 0xFC1140 KwbUb 99.61 rel_ub_q0p3906 0.00 99.61 FORMAT "%5.2" NUMBER 16 /end CHARACTERISTIC
/begin CHARACTERISTIC MZUL_MRLINI_DAT_UC "" VAL_BLK 0xFC1150 KwbUb 191.3 rel_ub_q0p75 0.00 191.3 FORMAT "%5.1" NUMBER 16 /end CHARACTERISTIC
/begin CHARACTERISTIC MZUL_MSGS_DAT_UC "" VAL_BLK 0xFC1160 KwbUb 99.61 rel_ub_q0p3906 0.00 99.61 FORMAT "%5.2" NUMBER 16 /end CHARACTERISTIC
/begin CHARACTERISTIC MZUL_NFLAGS_DAT_UC "" VAL_BLK 0xFC1170 KwbUb 255.0 dez 0.00 255.0 FORMAT "%5.1" NUMBER 16 /end CHARACTERISTIC
/begin CHARACTERISTIC MZUL_NMOT_DAT_UC "" VAL_BLK 0xFC1180 KwbUb 10200. nmot_ub_q40 0.00 10200. FORMAT "%5.0" NUMBER 16 /end CHARACTERISTIC
/begin AXIS_PTS MZUL_NMV08_UC "" 0xFC1190 nmot_uc SstAUbSstUb 10200. nmot_ub_q40 8 0.00 10200. FORMAT "%5.0" DEPOSIT ABSOLUTE /end AXIS_PTS
/begin AXIS_PTS MZUL_SPSNV08_UC "" 0xFC1199 spsn_uc SstAUbSstUb 4.980 spg_ub_q0p019 8 0.00 4.980 FORMAT "%5.3" DEPOSIT ABSOLUTE /end AXIS_PTS
/begin CHARACTERISTIC MZUL_SPSN_DAT_UC "" VAL_BLK 0xFC11A2 KwbUb 4.980 spg_ub_q0p019 0.00 4.980 FORMAT "%5.3" NUMBER 16 /end CHARACTERISTIC
/begin CHARACTERISTIC MZUL_TMOT_DAT_UC "" VAL_BLK 0xFC11B2 KwbUb 191.3 temp_ub_q0p75_o48 -48.00 143.3 FORMAT "%5.1" NUMBER 16 /end CHARACTERISTIC
/begin CHARACTERISTIC MZUL_VKPEDCH_DAT_UC "" VAL_BLK 0xFC11C2 KwbUb 255.0 dez 0.00 255.0 FORMAT "%5.1" NUMBER 16 /end CHARACTERISTIC
/begin CHARACTERISTIC MZUL_ZFLAGS_DAT_UC "" VAL_BLK 0xFC11D2 KwbUb 255.0 dez 0.00 255.0 FORMAT "%5.1" NUMBER 16 /end CHARACTERISTIC
/begin AXIS_PTS NMV08_UM "St¸tzstellenverteilung f¸r Motordrehzahl in der Funktions¸berwachung" 0xFCF402 nmot_um SstAUbSstUb 10200. nmot_ub_q40 8 0.00 10200. FORMAT "%5.0" DEPOSIT ABSOLUTE /end AXIS_PTS
/begin CHARACTERISTIC NOTDFTEAD "ftead-Schwelle zur Ausblendung der TD" VALUE 0xFCCA5C KwWS16 127.9980 fak_sw_b64 -64.00000 63.99805 FORMAT "%8.5" /end CHARACTERISTIC
/begin CHARACTERISTIC NSTMXM "Drehzahlschwelle f¸r Startende autom. Start f(TMOT)" CURVE 0xFC220F KlAUbSstUbWUb 10200. nmot_ub_q40 0.00 10200. FORMAT "%5.0"
 /begin AXIS_DESCR STD_AXIS tmot temp_ub_q0p75_o48 4 -48.00 143.3 FORMAT "%5.1" DEPOSIT ABSOLUTE /end AXIS_DESCR
/end CHARACTERISTIC
/begin CHARACTERISTIC NVERZMN "minimale Drehzahl f¸r Verzˆgerung" VALUE 0xFCCA90 KwUw 16383.75 nmot_uw_q0p25 0.00 16383.75 FORMAT "%8.2" /end CHARACTERISTIC
/begin CHARACTERISTIC REAC_C1_DAT_UC "" VAL_BLK 0xFC0BD3 KwbUb 255.0 dez 0.00 255.0 FORMAT "%5.1" NUMBER 16 /end CHARACTERISTIC
/begin CHARACTERISTIC REAC_C2_DAT_UC "" VAL_BLK 0xFC0BE3 KwbUb 255.0 dez 0.00 255.0 FORMAT "%5.1" NUMBER 16 /end CHARACTERISTIC
/begin CHARACTERISTIC REAC_EVZAUS_DAT_UC "" VAL_BLK 0xFC0BF3 KwbUb 255.0 dez 0.00 255.0 FORMAT "%5.1" NUMBER 16 /end CHARACTERISTIC
/begin CHARACTERISTIC REAC_FUELA_DATH_UC "" VAL_BLK 0xFC0C36 KwbUw 4095.938 vfzg_uw_q0p0625 0.00 4095.938 FORMAT "%8.3" NUMBER 16 /end CHARACTERISTIC
/begin CHARACTERISTIC REAC_FUELA_DATL_UC "" VAL_BLK 0xFC0C56 KwbUw 4095.938 vfzg_uw_q0p0625 0.00 4095.938 FORMAT "%8.3" NUMBER 16 /end CHARACTERISTIC
/begin CHARACTERISTIC REAC_FUEL_DATH_UC "" VAL_BLK 0xFC0C76 KwbUw 4095.938 vfzg_uw_q0p0625 0.00 4095.938 FORMAT "%8.3" NUMBER 16 /end CHARACTERISTIC
/begin CHARACTERISTIC REAC_FUEL_DATL_UC "" VAL_BLK 0xFC0C96 KwbUw 4095.938 vfzg_uw_q0p0625 0.00 4095.938 FORMAT "%8.3" NUMBER 16 /end CHARACTERISTIC
/begin CHARACTERISTIC REAC_NMOT_DAT_UC "" VAL_BLK 0xFC0C03 KwbUb 10200. nmot_ub_q40 0.00 10200. FORMAT "%5.0" NUMBER 16 /end CHARACTERISTIC
/begin CHARACTERISTIC REAC_RFLAGS_DAT_UC "" VAL_BLK 0xFC0C13 KwbUb 255.0 dez 0.00 255.0 FORMAT "%5.1" NUMBER 16 /end CHARACTERISTIC
/begin CHARACTERISTIC REAC_SPSN_DAT_UC "" VAL_BLK 0xFC0C23 KwbUb 4.980 spg_ub_q0p019 0.00 4.980 FORMAT "%5.3" NUMBER 16 /end CHARACTERISTIC
/begin CHARACTERISTIC REAC_T1_UC "Fehlerzeit bei der Funktions-Fehlerreaktions¸berwachung im Befehlstest" VALUE 0xFC0C33 KwUb 10200.0 t40ms_ub_b10200 0.00 10200.0 FORMAT "%7.1" /end CHARACTERISTIC
/begin CHARACTERISTIC REAC_T2_UC "Fehlerzeit bei der Funktions¸berwachungs-Fehlerreaktions¸berw. im Befehlstest" VALUE 0xFC0C34 KwUb 10200.0 t40ms_ub_b10200 0.00 10200.0 FORMAT "%7.1" /end CHARACTERISTIC
/begin CHARACTERISTIC RKC_MRLINI_DAT_UC "" VAL_BLK 0xFC0991 KwbUb 255.0 dez 0.00 255.0 FORMAT "%5.1" NUMBER 16 /end CHARACTERISTIC
/begin AXIS_PTS RLV08_UM "Stutzstellenverteilung f¸r Lastinfo in der Funktions¸berwachung" 0xFCF0C3 rl_um SstAUbSstUb 191.3 rel_ub_q0p75 8 0.00 191.3 FORMAT "%5.1" DEPOSIT ABSOLUTE /end AXIS_PTS
/begin AXIS_PTS SDM05TESB "dmssginr abh‰ngige St¸tzstellen (Anzahl 5)" 0xFC1330 dmssginr SstAU8SstS8 1.992 fak_sb_b1 5 -1.000 0.9922 FORMAT "%5.3" DEPOSIT ABSOLUTE /end AXIS_PTS
/begin CHARACTERISTIC SGSC_BSGS_DAT_UC "" VAL_BLK 0xFC0ABB KwbUb 255.0 dez 0.00 255.0 FORMAT "%5.1" NUMBER 16 /end CHARACTERISTIC
/begin CHARACTERISTIC SGSC_BZEGSA_DAT_UC "" VAL_BLK 0xFC0ACB KwbUb 255.0 dez 0.00 255.0 FORMAT "%5.1" NUMBER 16 /end CHARACTERISTIC
/begin CHARACTERISTIC SGSC_BZEGS_DAT_UC "" VAL_BLK 0xFC0ADB KwbUb 255.0 dez 0.00 255.0 FORMAT "%5.1" NUMBER 16 /end CHARACTERISTIC
/begin CHARACTERISTIC SGSC_CODCAN_DAT_UC "" VAL_BLK 0xFC0AEB KwbUb 255.0 dez 0.00 255.0 FORMAT "%5.1" NUMBER 16 /end CHARACTERISTIC
/begin CHARACTERISTIC SGSC_CODGET_DAT_UC "" VAL_BLK 0xFC0AFB KwbUb 255.0 dez 0.00 255.0 FORMAT "%5.1" NUMBER 16 /end CHARACTERISTIC
/begin CHARACTERISTIC SGSC_CSEGS_DAT_UC "" VAL_BLK 0xFC0B0B KwbUb 255.0 dez 0.00 255.0 FORMAT "%5.1" NUMBER 16 /end CHARACTERISTIC
/begin CHARACTERISTIC SGSC_C_DAT_UC "" VAL_BLK 0xFC0B1B KwbUb 5100.00 t20ms_ub_b5100 0.00 5100.00 NUMBER 16 /end CHARACTERISTIC
/begin CHARACTERISTIC SGSC_DBEGS_DAT_UC "" VAL_BLK 0xFC0B2B KwbUb 5100.00 t20ms_ub_b5100 0.00 5100.00 NUMBER 16 /end CHARACTERISTIC
/begin CHARACTERISTIC SGSC_MISGSCPL_DAT_UC "" VAL_BLK 0xFC0B3B KwbUb 255.0 dez 0.00 255.0 FORMAT "%5.1" NUMBER 16 /end CHARACTERISTIC
/begin CHARACTERISTIC SGSC_MISGS_DAT_UC "" VAL_BLK 0xFC0B4B KwbUb 99.61 rel_ub_b99p6 0.00 99.61 FORMAT "%5.2" NUMBER 16 /end CHARACTERISTIC
/begin CHARACTERISTIC SGSC_MKSGES_DAT_UC "" VAL_BLK 0xFC0B5B KwbUb 255.0 dez 0.00 255.0 FORMAT "%5.1" NUMBER 16 /end CHARACTERISTIC
/begin CHARACTERISTIC SGSC_MKSGS_DAT_UC "" VAL_BLK 0xFC0B6B KwbUb 255.0 dez 0.00 255.0 FORMAT "%5.1" NUMBER 16 /end CHARACTERISTIC
/begin CHARACTERISTIC SGSC_MKSWAND_DAT_UC "" VAL_BLK 0xFC0B7B KwbUb 255.0 dez 0.00 255.0 FORMAT "%5.1" NUMBER 16 /end CHARACTERISTIC
/begin CHARACTERISTIC SGSC_NOREL_DAT_UC "" VAL_BLK 0xFC0B8B KwbUb 255.0 dez 0.00 255.0 FORMAT "%5.1" NUMBER 16 /end CHARACTERISTIC
/begin CHARACTERISTIC SGSC_OBD_DAT_UC "" VAL_BLK 0xFC0B9B KwbUb 255.0 dez 0.00 255.0 FORMAT "%5.1" NUMBER 16 /end CHARACTERISTIC
/begin CHARACTERISTIC SGSC_SBIT_DAT_UC "" VAL_BLK 0xFC0BAB KwbUb 255.0 dez 0.00 255.0 FORMAT "%5.1" NUMBER 16 /end CHARACTERISTIC
/begin CHARACTERISTIC SGSC_T_UC "Fehlerzeit f¸r SGS-Eingriff-‹berwachung des Befehlstestes" VALUE 0xFC0BBB KwUb 2550.00 t10ms_ub_b2550 0.00 2550.00 /end CHARACTERISTIC
/begin CHARACTERISTIC SKADRHZ_UC "Motorgrenzdrehzahl f¸r komplette Einspritzausblendung bei SKA in Befehlstest" VALUE 0xFC0C35 KwUb 10200. nmot_ub_q40 0.00 10200. FORMAT "%5.0" /end CHARACTERISTIC
/begin AXIS_PTS SML06TEUB "ml abh‰ngige St¸tzstellen (Anzahl 6)" 0xFCF810 ml SstAUbSstUb 1020. m_ub_b1020 6 0.00 1020. FORMAT "%5.0" DEPOSIT ABSOLUTE /end AXIS_PTS
/begin AXIS_PTS SNM04TEUB "Motordrehzahl-abh‰ngige St¸tzstellen (Anzahl =4)" 0xFC1358 nmot SstAU8SstU8 10200. nmot_ub_q40 4 0.00 10200. FORMAT "%5.0" DEPOSIT ABSOLUTE /end AXIS_PTS
/begin CHARACTERISTIC SPSNLL_UC "Maximale Spannung f¸r Leergas im Befehlstest" VALUE 0xFC11E2 KwUb 4.980 spg_ub_q0p019 0.00 4.980 FORMAT "%5.3" /end CHARACTERISTIC
/begin AXIS_PTS SQM05TEUB "Luftmassenquotient-abh‰ngige St¸tzstellen (Anzahl =5)" 0xFC13EC qmsdyn SstAUbSstUb 15.94 fak_ub_b16 5 0.00 15.94 FORMAT "%5.2" DEPOSIT ABSOLUTE /end AXIS_PTS
/begin CHARACTERISTIC TANMX "Maximale Zeit f¸r Automatik-Start" VALUE 0xFC221A KwUw 655.3500 t10msxs_uw_b655p35 0.00 655.3500 FORMAT "%8.4" /end CHARACTERISTIC
/begin CHARACTERISTIC TBSDLRT "Entprellzeit IBS-Erkennung" VALUE 0xFCC9C5 KwUb 25.50 t_q0p1 0.00 25.50 FORMAT "%5.2" /end CHARACTERISTIC
/begin CHARACTERISTIC TFTEINI "Zeit f¸r Erkennung TE Stop" VALUE 0xFCCA92 KwUw 6553.500 t100msxs_uw_b6553p5 0.00 6553.500 FORMAT "%8.3" /end CHARACTERISTIC
/begin CHARACTERISTIC TFTEINITP "Verzˆgerung B_atmtpa f¸r imsteini" VALUE 0xFCCA94 KwUw 6553.500 t100msxs_uw_b6553p5 0.00 6553.500 FORMAT "%8.3" /end CHARACTERISTIC
/begin CHARACTERISTIC TMOMIN_UC "Minimal plausible Motortemperatur im Befehlstest" VALUE 0xFC11E3 KwUb 191.3 temp_ub_q0p75_o48 -48.00 143.3 FORMAT "%5.1" /end CHARACTERISTIC
/begin AXIS_PTS TMOV08_UC "St¸tzstellenverteilung f¸r Motortemperatur im Befehlstest" 0xFC11E4 tmotmn_uc SstAUbSstUb 191.3 temp_ub_q0p75_o48 8 -48.00 143.3 FORMAT "%5.1" DEPOSIT ABSOLUTE /end AXIS_PTS
/begin CHARACTERISTIC TMSTTE "Starttemperaturschwelle, bei der die TE sofort aktiv werden kann" VALUE 0xFD4DE3 KwUb 191.3 temp_ub_q0p75_o48 -48.00 143.3 FORMAT "%5.1" /end CHARACTERISTIC
/begin CHARACTERISTIC TMTE "TMOT - Schwelle f¸r Tankentl¸ftung" VALUE 0xFD4DE4 KwUb 191.3 temp_ub_q0p75_o48 -48.00 143.3 FORMAT "%5.1" /end CHARACTERISTIC
/begin CHARACTERISTIC TPAST "Entprellzeit f¸r automatischen Start" VALUE 0xFC2218 KwUb 2.550 t10msxs_ub_b2p55 0.00 2.550 FORMAT "%5.3" /end CHARACTERISTIC
/begin CHARACTERISTIC TQTEAB "Zeit f¸r Absteuerung Sp¸lrate Tankentl¸ftung" VALUE 0xFCCA72 KwUb 81.28 t20msxs_ub_q0p32 0.3200 81.60 FORMAT "%5.2" /end CHARACTERISTIC
/begin CHARACTERISTIC TQTEDAB "Zeit f¸r schnelle Absteuerung Sp¸lrate Tankentl¸ftung" VALUE 0xFCCA73 KwUb 81.28 t20msxs_ub_q0p32 0.3200 81.60 FORMAT "%5.2" /end CHARACTERISTIC
/begin CHARACTERISTIC TSTA "Wartezeit bis Erkennung blockierter Motor" VALUE 0xFC221C KwUw 655.3500 t10msxs_uw_b655p35 0.00 655.3500 FORMAT "%8.4" /end CHARACTERISTIC
/begin CHARACTERISTIC TTEAUS "Zeit nach Start bis TEB aktiv wird" VALUE 0xFD4DEA KwUw 195.0000 t100msxs_uw_q100 5.000000 200.0000 FORMAT "%8.4" /end CHARACTERISTIC
/begin CHARACTERISTIC TUETM "Zeit¸bertemperatur nach Start" VALUE 0xFC2222 KwUw 655.3500 t_q0p01 0.00 655.3500 FORMAT "%8.4" /end CHARACTERISTIC
/begin CHARACTERISTIC TVSATEM "Verzˆgerungszeit f¸r TEV zu nach SA-Bereitschaft" CURVE 0xFCCA74 KlAUbSstUbWUb 5.100 t20msxs_ub_b5p1 0.00 5.100 FORMAT "%5.3"
 /begin AXIS_DESCR STD_AXIS tmot temp_ub_q0p75_o48 6 -48.00 143.3 FORMAT "%5.1" DEPOSIT ABSOLUTE /end AXIS_DESCR
/end CHARACTERISTIC
/begin CHARACTERISTIC TVSTANKL15 "Applizierbare Verzˆgerungszeit von KL15 ein (HR ein) bis Starterfreigabe (E60)" VALUE 0xFC2219 KwUb 2.550 t10msxs_ub_b2p55 0.00 2.550 FORMAT "%5.3" /end CHARACTERISTIC
/begin CHARACTERISTIC TWSTA "Zeit f¸r Wiederholstart enable nach Abw¸rgen" VALUE 0xFC221E KwUw 655.3500 t10msxs_uw_b655p35 0.00 655.3500 FORMAT "%8.4" /end CHARACTERISTIC
/begin CHARACTERISTIC UBDHLSUMN "Batteriespannungsschwelle zur Freigabe der Heizer-Diagnose LSU" VALUE 0xFCC9CE KwUw 25.59961 spg_q0p00039 0.00 25.59961 FORMAT "%8.5" /end CHARACTERISTIC
/begin CHARACTERISTIC UBDHLSUMX "obere Batteriespannungsschwelle f¸r die  Heizer-Diagnose LSU" VALUE 0xFCC9D0 KwUw 25.59961 spg_q0p00039 0.00 25.59961 FORMAT "%8.5" /end CHARACTERISTIC
/begin CHARACTERISTIC UEGET "" CURVE 0xFCC9C6 FklWUb 4.980 fak_q0p0195 0.00 4.980 FORMAT "%5.3"
 /begin AXIS_DESCR FIX_AXIS gangi dez 8 0.00 7.000 FORMAT "%5.3" FIX_AXIS_PAR 0 0 8 /end AXIS_DESCR
/end CHARACTERISTIC
/begin CHARACTERISTIC UETMOT "Motor¸bertemperatur-Schwelle" VALUE 0xFC2221 KwUb 191.3 temp_ub_q0p75_o48 -48.00 143.3 FORMAT "%5.1" /end CHARACTERISTIC
/begin CHARACTERISTIC VMINACC_UC "Minimalgeschwindigkeit f¸r ACC-Betrieb im Befehlstest" VALUE 0xFC09F2 KwUw 511.9922 vfzg_uw_q0p00781 0.00 511.9922 FORMAT "%8.4" /end CHARACTERISTIC
/begin CHARACTERISTIC VMINACC_UM "Minimalgeschwindigkeit f¸r ACC-Betrieb in der Funktions¸berwachung" VALUE 0xFCF0E4 KwUw 511.9922 vfzg_uw_q0p00781 0.00 511.9922 FORMAT "%8.4" /end CHARACTERISTIC
/begin CHARACTERISTIC VMIN_UC "Minimalgeschwindigkeit f¸r FGR-Betrieb im Befehlstest" VALUE 0xFC09F4 KwUw 511.9922 vfzg_uw_q0p00781 0.00 511.9922 FORMAT "%8.4" /end CHARACTERISTIC
/begin CHARACTERISTIC VMIN_UM "Minimalgeschwindigkeit f¸r FGR-Betrieb in der Funktions¸berwachung" VALUE 0xFCF0E6 KwUw 511.9922 vfzg_uw_q0p00781 0.00 511.9922 FORMAT "%8.4" /end CHARACTERISTIC
/begin CHARACTERISTIC ZBTEML "Integrationsgeschwindigkeit Beladungsfaktor" CURVE 0xFD4A1D GklWUb 6.101 perio_ub_b6p125 0.00 6.101 FORMAT "%5.3"
 /begin AXIS_DESCR COM_AXIS ml m_ub_b1020 6 0.00 1020. FORMAT "%5.0" AXIS_PTS_REF SML06TEUB /end AXIS_DESCR
/end CHARACTERISTIC
/begin CHARACTERISTIC ZDDPSSOLTE "Zeitkonstante f¸r Filter TE-Differenzdruckoffset" VALUE 0xFD4DD6 KwUw 1309.9800107 zk20msxs_uw_b1310 0.019989318685 1310.0000000 FORMAT "%12.7" /end CHARACTERISTIC
/begin CHARACTERISTIC ZETATE "Rampensteilheit f¸r Ver‰nderung Motorwirkungsgrad durch Tankentl¸ftung" VALUE 0xFD4DD8 KwUw 1279.590 rgrad_uw_b1280 0.3906250 1279.980 FORMAT "%8.3" /end CHARACTERISTIC
/begin CHARACTERISTIC ZFTEADMOD "Zeitkonstante f¸r ftead-Modell zur TE-Differenzdrucksteuerung" VALUE 0xFD4DDA KwUw 799.98779278 t20msxs_uw_q800 0.012207217517 800.00000000 FORMAT "%12.8" /end CHARACTERISTIC
/begin CHARACTERISTIC ZKFTEAD "Zeitkonstante gefilteter Faktor Beladung Sp¸lstrom bei Tankentl¸ftung" VALUE 0xFD4DDC KwUw 6553.4999985 zk100msxs_uw_b6553 0.10000152590 6553.6000000 FORMAT "%12.7" /end CHARACTERISTIC
/begin CHARACTERISTIC ZMLTE "Zeitkonstante f¸r ml-Filter in beladungsabh. Tankentl¸ftung" VALUE 0xFD4DDE KwUw 6553.4999985 zk100msxs_uw_b655 0.10000152590 6553.6000000 FORMAT "%12.7" /end CHARACTERISTIC
/begin CHARACTERISTIC ZMSSGIN "Filterzeitkonstante f¸r Berechnung der relativen ƒnderung von mssgin_w" VALUE 0xFD4A23 KwUb 25.4996 zk100msxs_ub_b25p5 0.100392 25.6000 FORMAT "%7.4" /end CHARACTERISTIC
/begin CHARACTERISTIC ZTETDONOFF "Zeitkonstante f¸r TD-Aus-/Einblendung bei TE" VALUE 0xFD4DE0 KwUw 639.99023423 t20msxs_uw_q640 0.0097657740139 640.00000000 FORMAT "%12.8" /end CHARACTERISTIC
/begin MEASUREMENT abfgrc_uc "Befehlstest: Modulspezifischer Antwortbeitrag aus %UFFGRC" UWORD dez 1 100 0 65535 FORMAT "%8.2" ECU_ADDRESS 0x403D66 /end MEASUREMENT
/begin MEASUREMENT abmist_uc "Befehlstest: Modulspezifischer Antwortbeitrag aus %UFMIST" UWORD dez 1 100 0 65535 FORMAT "%8.2" ECU_ADDRESS 0x403D7C /end MEASUREMENT
/begin MEASUREMENT abmsrc_uc "Befehlstest: Modulspezifischer Antwortbeitrag aus %UFMSRC" UWORD dez 1 100 0 65535 FORMAT "%8.2" ECU_ADDRESS 0x403D6A /end MEASUREMENT
/begin MEASUREMENT abmver_uc "Befehlstest: Modulspezifischer Antwortbeitrag aus %UFMVER" UWORD dez 1 100 0 65535 FORMAT "%8.2" ECU_ADDRESS 0x403D80 /end MEASUREMENT
/begin MEASUREMENT abmzf_uc "Befehlstest: Modulspezifischer Antwortbeitrag aus %UFMZF" UWORD dez 1 100 0 65535 FORMAT "%8.2" ECU_ADDRESS 0x403D84 /end MEASUREMENT
/begin MEASUREMENT abmzul_uc "Befehlstest: Modulspezifischer Antwortbeitrag aus %UFMZUL" UWORD dez 1 100 0 65535 FORMAT "%8.2" ECU_ADDRESS 0x403D86 /end MEASUREMENT
/begin MEASUREMENT abreac_uc "Befehlstest: Modulspezifischer Antwortbeitrag aus %UFREAC" UWORD dez 1 100 0 65535 FORMAT "%8.2" ECU_ADDRESS 0x403D7A /end MEASUREMENT
/begin MEASUREMENT abrkc_uc "Befehlstest: Modulspezifischer Antwortbeitrag aus %UFRKC" UWORD dez 1 100 0 65535 FORMAT "%8.2" ECU_ADDRESS 0x403D62 /end MEASUREMENT
/begin MEASUREMENT absgsc_uc "Befehlstest: Modulspezifischer Antwortbeitrag aus %UFSGSC" UWORD dez 1 100 0 65535 FORMAT "%8.2" ECU_ADDRESS 0x403D72 /end MEASUREMENT
/begin MEASUREMENT accctr_um "Status Drehmomentenregelung ACC in der Funktions¸berwachung" UBYTE dez 1 100 0 255 FORMAT "%5.1" ECU_ADDRESS 0x3FA3B2 /end MEASUREMENT
/begin MEASUREMENT accc_c_um "Fehlerz‰hler: Botschaftsabsicherung ACC-Botschaft" UBYTE dez 1 100 0 255 FORMAT "%5.1" ECU_ADDRESS 0x3F98CE /end MEASUREMENT
/begin MEASUREMENT accc_c_ur "Doppelablage (DA) f¸r ACCC_C_UM" UBYTE dez 1 100 0 255 FORMAT "%5.1" ECU_ADDRESS 0x3F99C0 /end MEASUREMENT
/begin MEASUREMENT accstat_um "ACC-Anforderungs-Status (CAN) aus der Funktions¸berwachung" UBYTE dez 1 100 0 255 FORMAT "%5.1" ECU_ADDRESS 0x3FA3B3 /end MEASUREMENT
/begin MEASUREMENT accsyof_um "Statusbyte der Systemabschaltung ACC" UBYTE dez 1 100 0 255 FORMAT "%5.1" ECU_ADDRESS 0x3FA3B4 /end MEASUREMENT
/begin MEASUREMENT Adevhubs "Adaptionswert Einlaﬂventil Hub" SWORD hub_uw_q0p001 1 100 -32.768 32.767 FORMAT "%8.5" ECU_ADDRESS 0x40480A /end MEASUREMENT
/begin MEASUREMENT Adexws "Adaptionswert Exzenterwellenwinkel" SWORD wink_q0p00039 1 100 -12.8 12.7996 FORMAT "%8.5" ECU_ADDRESS 0x40480C /end MEASUREMENT
/begin MEASUREMENT ahkat "Mittelwert der Amplitude Sondensignal hinter Kat. korrigiert mit KB" UBYTE fak_ub_b1 1 100 0 0.996094 ECU_ADDRESS 0x403CE9 /end MEASUREMENT
/begin MEASUREMENT ahkat2 "Mittelwert der Amplitude Sondensignal hinter Kat. korrigiert mit KB (2.Bank)" UBYTE fak_ub_b1 1 100 0 0.996094 ECU_ADDRESS 0x403CEA /end MEASUREMENT
/begin MEASUREMENT AS_cantdi "Ausgang schalten CAN-Treiber disable (CANTDI) im CY3xx" UBYTE B_TRUE 1 100 0 1 BIT_MASK 0x1 FORMAT "%13.11" ECU_ADDRESS 0x3FC2DE /end MEASUREMENT
/begin MEASUREMENT AS_epee "Flash programing control" UBYTE B_TRUE 1 100 0 1 BIT_MASK 0x1 FORMAT "%13.11" ECU_ADDRESS 0x3FC2DF /end MEASUREMENT
/begin MEASUREMENT AS_mar "margin MPC 555" UBYTE B_TRUE 1 100 0 1 BIT_MASK 0x1 FORMAT "%13.11" ECU_ADDRESS 0x3FC2E0 /end MEASUREMENT
/begin MEASUREMENT AS_res "" UBYTE B_TRUE 1 100 0 1 BIT_MASK 0x1 FORMAT "%13.11" ECU_ADDRESS 0x3FC2E1 /end MEASUREMENT
/begin MEASUREMENT azlrdkt "Lambdaregler-Zwangsamplitude aus Kat-Diagnose" UBYTE fak_ub_b0p25 1 100 0 0.249023 FORMAT "%11.9" ECU_ADDRESS 0x403CEB /end MEASUREMENT
/begin MEASUREMENT bbhz_m "Maﬂnahmenaforderung Zuheizen" UBYTE DEZ 1 100 0 255 FORMAT "%5.1" ECU_ADDRESS 0x4035C4 /end MEASUREMENT
/begin MEASUREMENT bracc_c_um "Entprellz‰hler f¸r bet‰tigte Bremse in der Funktions¸berwachung" UBYTE t20ms_ub_b5100 1 100 0 5100 ECU_ADDRESS 0x3F98DD /end MEASUREMENT
/begin MEASUREMENT bracc_c_ur "Doppelablage (DA) f¸r BRACC_C_UM" UBYTE dez 1 100 0 255 FORMAT "%5.1" ECU_ADDRESS 0x3F99C5 /end MEASUREMENT
/begin MEASUREMENT brems_c_um "Entprellz‰hler f¸r bet‰tigte Bremse in der Funktions¸berwachung" UBYTE t20ms_ub_b5100 1 100 0 5100 ECU_ADDRESS 0x3F98DE /end MEASUREMENT
/begin MEASUREMENT brems_c_ur "Doppelablage (DA) f¸r BREMS_C_UM" UBYTE dez 1 100 0 255 FORMAT "%5.1" ECU_ADDRESS 0x3F99C6 /end MEASUREMENT
/begin MEASUREMENT bz_acca_um "Botschaftsz‰hler (alter Wert) der ACC-Canbotschaft in der ‹berwachung" UBYTE dez 1 100 0 255 FORMAT "%5.1" ECU_ADDRESS 0x3F98CF /end MEASUREMENT
/begin MEASUREMENT bz_acca_ur "Doppelablage (DA) f¸r BZ_ACCA_UM" UBYTE dez 1 100 0 255 FORMAT "%5.1" ECU_ADDRESS 0x3F99C1 /end MEASUREMENT
/begin MEASUREMENT bz_dsca_uc "Botschaftsz‰hler (alter Wert) der DSC-CAN-Botschaft im Befehlstest" UBYTE dez 1 100 0 255 FORMAT "%5.1" ECU_ADDRESS 0x403A88 /end MEASUREMENT
/begin MEASUREMENT bz_dsca_um "DSC - Botschaftsz‰hler aus vorhergehender Berechung in der FU" UBYTE dez 1 100 0 255 FORMAT "%5.1" ECU_ADDRESS 0x3F98E9 /end MEASUREMENT
/begin MEASUREMENT bz_dsca_ur "Doppelablage (DA) f¸r BZ_DSCA_UM" UBYTE dez 1 100 0 255 FORMAT "%5.1" ECU_ADDRESS 0x3F99CD /end MEASUREMENT
/begin MEASUREMENT bz_egsa_uc "Botschaftsz‰hler (alter Wert) der EGS-CAN-Botschaft im Befehlstest" UBYTE dez 1 100 0 255 FORMAT "%5.1" ECU_ADDRESS 0x403A91 /end MEASUREMENT
/begin MEASUREMENT bz_fgra_um "Botschaftsz‰hler (alter Wert) der FGR-Canbotschaft in der ‹berwachung" UBYTE t20ms_ub_b5100 1 100 0 5100 ECU_ADDRESS 0x3F98DF /end MEASUREMENT
/begin MEASUREMENT bz_fgra_ur "Doppelablage (DA) f¸r BZ_FGRA_UM" UBYTE dez 1 100 0 255 FORMAT "%5.1" ECU_ADDRESS 0x3F99C7 /end MEASUREMENT
/begin MEASUREMENT bz_szla_um "Z‰hler SZL-Botschaften empfangen (alter Wert)" UBYTE t20ms_ub_b5100 1 100 0 5100 ECU_ADDRESS 0x3F98E0 /end MEASUREMENT
/begin MEASUREMENT bz_szla_ur "Doppelablage (DA) f¸r BZ_SZLA_UM" UBYTE dez 1 100 0 255 FORMAT "%5.1" ECU_ADDRESS 0x3F99C8 /end MEASUREMENT
/begin MEASUREMENT B_abstgp "Bedingung Abstellzeitermittlung g¸ltig und plausibel" UBYTE B_TRUE 1 100 0 1 BIT_MASK 0x1 FORMAT "%13.11" ECU_ADDRESS 0x3FC2E2 /end MEASUREMENT
/begin MEASUREMENT B_accen_um "ACC-Einschaltung g¸ltig in der Funktions¸berwachung" UBYTE B_TRUE 1 100 0 1 BIT_MASK 0x1 FORMAT "%13.11" ECU_ADDRESS 0x3F98C8 /end MEASUREMENT
/begin MEASUREMENT B_agr "Bedingung AGR ein" UBYTE B_TRUE 1 100 0 1 BIT_MASK 0x1 FORMAT "%13.11" ECU_ADDRESS 0x3FC2E3 /end MEASUREMENT
/begin MEASUREMENT B_ansklet "Stellglieddiagnose Ansaugklappe:  Eingriff Tester" UBYTE B_TRUE 1 100 0 1 BIT_MASK 0x1 FORMAT "%13.11" ECU_ADDRESS 0x3FC1E2 /end MEASUREMENT
/begin MEASUREMENT B_atmng "Bedingung modellierte Temperaturen aus %ATM nicht g¸lig" UBYTE B_TRUE 1 100 0 1 BIT_MASK 0x1 FORMAT "%13.11" ECU_ADDRESS 0x3FC2E4 /end MEASUREMENT
/begin MEASUREMENT B_bgwrte "" UBYTE B_TRUE 1 100 0 1 BIT_MASK 0x1 FORMAT "%13.11" ECU_ADDRESS 0x3FC34F /end MEASUREMENT
/begin MEASUREMENT B_bkva "Bedingung BKV angesteuert" UBYTE B_TRUE 1 100 0 1 BIT_MASK 0x1 FORMAT "%13.11" ECU_ADDRESS 0x3FC2E5 /end MEASUREMENT
/begin MEASUREMENT B_bkvleer "Bedingung Bremskraftverst‰rker ohne ausreichenden Unterdruck" UBYTE B_TRUE 1 100 0 1 BIT_MASK 0x1 FORMAT "%13.11" ECU_ADDRESS 0x3FC2E6 /end MEASUREMENT
/begin MEASUREMENT B_bkvv "Bedingung BKV verbaut (f¸r Auswertung Bremse)" UBYTE B_TRUE 1 100 0 1 BIT_MASK 0x1 FORMAT "%13.11" ECU_ADDRESS 0x3FC2E7 /end MEASUREMENT
/begin MEASUREMENT B_bt "Bedingung Bauteileansteuerung  allgemein" UBYTE B_TRUE 1 100 0 1 BIT_MASK 0x1 FORMAT "%13.11" ECU_ADDRESS 0x3FC1E3 /end MEASUREMENT
/begin MEASUREMENT B_btakr "Bedingung Bauteileansteuerung;  Abgasklappe" UBYTE B_TRUE 1 100 0 1 BIT_MASK 0x1 FORMAT "%13.11" ECU_ADDRESS 0x3FC1E4 /end MEASUREMENT
/begin MEASUREMENT B_btakrst "Bedingung Bauteileansteuerung;  Abgasklappe ...ST" UBYTE B_TRUE 1 100 0 1 BIT_MASK 0x1 FORMAT "%13.11" ECU_ADDRESS 0x3FC1E5 /end MEASUREMENT
/begin MEASUREMENT B_btanskl "Bedingung Bauteileansteuerung: Ansaugklappe" UBYTE B_TRUE 1 100 0 1 BIT_MASK 0x1 FORMAT "%13.11" ECU_ADDRESS 0x3FC1E6 /end MEASUREMENT
/begin MEASUREMENT B_btdisa "Bedingung Bauteileansteuerung;  geregelte Saugrohrumschaltung" UBYTE B_TRUE 1 100 0 1 BIT_MASK 0x1 FORMAT "%13.11" ECU_ADDRESS 0x3FC1E7 /end MEASUREMENT
/begin MEASUREMENT B_btdmh "Bedingung Bauteileansteuerung; DM-TL Heizer" UBYTE B_TRUE 1 100 0 1 BIT_MASK 0x1 FORMAT "%13.11" ECU_ADDRESS 0x3FC1E8 /end MEASUREMENT
/begin MEASUREMENT B_btdmmv "Bedingung Bauteileansteuerung; DM-TL Magnetventil" UBYTE B_TRUE 1 100 0 1 BIT_MASK 0x1 FORMAT "%13.11" ECU_ADDRESS 0x3FC1E9 /end MEASUREMENT
/begin MEASUREMENT B_btdmpm "Bedingung Bauteileansteuerung; DM-TL Pumpenmotor" UBYTE B_TRUE 1 100 0 1 BIT_MASK 0x1 FORMAT "%13.11" ECU_ADDRESS 0x3FC1EA /end MEASUREMENT
/begin MEASUREMENT B_btebl "Bedingung Bauteileansteuerung; elektr. E-Box L¸fter" UBYTE B_TRUE 1 100 0 1 BIT_MASK 0x1 FORMAT "%13.11" ECU_ADDRESS 0x3FC1EB /end MEASUREMENT
/begin MEASUREMENT B_bteepcl "Bedingung Bauteileansteuerung;  EML-Lampe (enable)" UBYTE B_TRUE 1 100 0 1 BIT_MASK 0x1 FORMAT "%13.11" ECU_ADDRESS 0x3FC1EC /end MEASUREMENT
/begin MEASUREMENT B_btefgr "Bedingung Bauteileansteuerung;  Bereitschaftsanzeige FGR-Mainswitch" UBYTE B_TRUE 1 100 0 1 BIT_MASK 0x1 FORMAT "%13.11" ECU_ADDRESS 0x3FC1ED /end MEASUREMENT
/begin MEASUREMENT B_btekp "Bedingung Bauteileansteuerung; Elektrokraftstoffpumpe" UBYTE B_TRUE 1 100 0 1 BIT_MASK 0x1 FORMAT "%13.11" ECU_ADDRESS 0x3FC1EE /end MEASUREMENT
/begin MEASUREMENT B_btemil "Bedingung Bauteileansteuerung;  Fehlerlampe (MIL)" UBYTE B_TRUE 1 100 0 1 BIT_MASK 0x1 FORMAT "%13.11" ECU_ADDRESS 0x3FC1EF /end MEASUREMENT
/begin MEASUREMENT B_btepcl "Bedingung Bauteileansteuerung;  EML-Lampe" UBYTE B_TRUE 1 100 0 1 BIT_MASK 0x1 FORMAT "%13.11" ECU_ADDRESS 0x3FC1F0 /end MEASUREMENT
/begin MEASUREMENT B_btev1 "Bauteileansteuerung Einspritzventil 1" UBYTE B_TRUE 1 100 0 1 BIT_MASK 0x1 FORMAT "%13.11" ECU_ADDRESS 0x3FC1F1 /end MEASUREMENT
/begin MEASUREMENT B_btev2 "Bauteileansteuerung Einspritzventil 2" UBYTE B_TRUE 1 100 0 1 BIT_MASK 0x1 FORMAT "%13.11" ECU_ADDRESS 0x3FC1F2 /end MEASUREMENT
/begin MEASUREMENT B_btev3 "Bauteileansteuerung Einspritzventil 3" UBYTE B_TRUE 1 100 0 1 BIT_MASK 0x1 FORMAT "%13.11" ECU_ADDRESS 0x3FC1F3 /end MEASUREMENT
/begin MEASUREMENT B_btev4 "Bauteileansteuerung Einspritzventil 4" UBYTE B_TRUE 1 100 0 1 BIT_MASK 0x1 FORMAT "%13.11" ECU_ADDRESS 0x3FC1F4 /end MEASUREMENT
/begin MEASUREMENT B_btev5 "Bauteileansteuerung Einspritzventil 5" UBYTE B_TRUE 1 100 0 1 BIT_MASK 0x1 FORMAT "%13.11" ECU_ADDRESS 0x3FC1F5 /end MEASUREMENT
/begin MEASUREMENT B_btev6 "Bauteileansteuerung Einspritzventil 6" UBYTE B_TRUE 1 100 0 1 BIT_MASK 0x1 FORMAT "%13.11" ECU_ADDRESS 0x3FC1F6 /end MEASUREMENT
/begin MEASUREMENT B_btev7 "Bauteileansteuerung Einspritzventil 7" UBYTE B_TRUE 1 100 0 1 BIT_MASK 0x1 FORMAT "%13.11" ECU_ADDRESS 0x3FC1F7 /end MEASUREMENT
/begin MEASUREMENT B_btev8 "Bauteileansteuerung Einspritzventil 8" UBYTE B_TRUE 1 100 0 1 BIT_MASK 0x1 FORMAT "%13.11" ECU_ADDRESS 0x3FC1F8 /end MEASUREMENT
/begin MEASUREMENT B_btfgr "Bedingung Bauteileansteuerung;  Bereitschaftsanzeige FGR-Mainswitch" UBYTE B_TRUE 1 100 0 1 BIT_MASK 0x1 FORMAT "%13.11" ECU_ADDRESS 0x3FC1F9 /end MEASUREMENT
/begin MEASUREMENT B_btgdvhub "" UBYTE B_TRUE 1 100 0 1 BIT_MASK 0x1 FORMAT "%13.11" ECU_ADDRESS 0x3FC1FA /end MEASUREMENT
/begin MEASUREMENT B_bthsh "Bedingung Bauteileansteuerung; LS-Heizung hinter Kat." UBYTE B_TRUE 1 100 0 1 BIT_MASK 0x1 FORMAT "%13.11" ECU_ADDRESS 0x3FC1FB /end MEASUREMENT
/begin MEASUREMENT B_bthsh2 "Bedingung Bauteileansteuerung; LS-Heizung hinter Kat. Bank 2" UBYTE B_TRUE 1 100 0 1 BIT_MASK 0x1 FORMAT "%13.11" ECU_ADDRESS 0x3FC1FC /end MEASUREMENT
/begin MEASUREMENT B_bthsv "Bedingung Bauteileansteuerung; LS-Heizung vor Kat." UBYTE B_TRUE 1 100 0 1 BIT_MASK 0x1 FORMAT "%13.11" ECU_ADDRESS 0x3FC1FD /end MEASUREMENT
/begin MEASUREMENT B_bthsv2 "Bedingung Bauteileansteuerung; LS-Heizung vor Kat. Bank 2" UBYTE B_TRUE 1 100 0 1 BIT_MASK 0x1 FORMAT "%13.11" ECU_ADDRESS 0x3FC1FE /end MEASUREMENT
/begin MEASUREMENT B_btkos "Bedingung Bauteileansteuerung; Klimakompressor" UBYTE B_TRUE 1 100 0 1 BIT_MASK 0x1 FORMAT "%13.11" ECU_ADDRESS 0x3FC1FF /end MEASUREMENT
/begin MEASUREMENT B_btmil "Bedingung Bauteileansteuerung;  Fehlerlampe (MIL)" UBYTE B_TRUE 1 100 0 1 BIT_MASK 0x1 FORMAT "%13.11" ECU_ADDRESS 0x3FC200 /end MEASUREMENT
/begin MEASUREMENT B_btslp "Bedingung Bauteileansteuerung; Sekund‰rluftpumpe" UBYTE B_TRUE 1 100 0 1 BIT_MASK 0x1 FORMAT "%13.11" ECU_ADDRESS 0x3FC201 /end MEASUREMENT
/begin MEASUREMENT B_btsta "Bedingung Bauteileansteuerung; Startrelais" UBYTE B_TRUE 1 100 0 1 BIT_MASK 0x1 FORMAT "%13.11" ECU_ADDRESS 0x3FC202 /end MEASUREMENT
/begin MEASUREMENT B_bttev "Bedingung Bauteileansteuerung; Tankentl¸ftungsventil" UBYTE B_TRUE 1 100 0 1 BIT_MASK 0x1 FORMAT "%13.11" ECU_ADDRESS 0x3FC203 /end MEASUREMENT
/begin MEASUREMENT B_btvsa "Bedingung Bauteileansteuerung; NW-Verstellung Auslass-Ventil" UBYTE B_TRUE 1 100 0 1 BIT_MASK 0x1 FORMAT "%13.11" ECU_ADDRESS 0x3FC204 /end MEASUREMENT
/begin MEASUREMENT B_btvsa2 "Bedingung Bauteileansteuerung; NW-Verstellung Auslass-Ventil, Bank 2" UBYTE B_TRUE 1 100 0 1 BIT_MASK 0x1 FORMAT "%13.11" ECU_ADDRESS 0x3FC205 /end MEASUREMENT
/begin MEASUREMENT B_btvse "Bedingung Bauteileansteuerung; NW-Verstellung Einlass-Ventil" UBYTE B_TRUE 1 100 0 1 BIT_MASK 0x1 FORMAT "%13.11" ECU_ADDRESS 0x3FC206 /end MEASUREMENT
/begin MEASUREMENT B_btvse2 "Bedingung Bauteileansteuerung; NW-Verstellung Einlass-Ventil, Bank2" UBYTE B_TRUE 1 100 0 1 BIT_MASK 0x1 FORMAT "%13.11" ECU_ADDRESS 0x3FC207 /end MEASUREMENT
/begin MEASUREMENT B_btvvta "Bedingung Bauteileansteuerung;  VVT-Steuerung" UBYTE B_TRUE 1 100 0 1 BIT_MASK 0x1 FORMAT "%13.11" ECU_ADDRESS 0x3FC208 /end MEASUREMENT
/begin MEASUREMENT B_btvvta2 "Bedingung Bauteileansteuerung;  VVT-Steuerung, Bank 2" UBYTE B_TRUE 1 100 0 1 BIT_MASK 0x1 FORMAT "%13.11" ECU_ADDRESS 0x3FC209 /end MEASUREMENT
/begin MEASUREMENT B_btvvte "Bedingung Bauteileansteuerung;  VVT-Enable Leitung" UBYTE B_TRUE 1 100 0 1 BIT_MASK 0x1 FORMAT "%13.11" ECU_ADDRESS 0x3FC20A /end MEASUREMENT
/begin MEASUREMENT B_ccevsok "Bedingung Ereignissgesteuerte CC-Sendeanforderung wurde erfolgreich umgesetzt" UBYTE B_TRUE 1 100 0 1 BIT_MASK 0x1 FORMAT "%13.11" ECU_ADDRESS 0x3FC2E8 /end MEASUREMENT
/begin MEASUREMENT B_clhtoel "Bedingung: Loeschen der Uebertemperatursicherung ueber Tester" UBYTE B_TRUE 1 100 0 1 BIT_MASK 0x1 FORMAT "%13.11" ECU_ADDRESS 0x3FC20B /end MEASUREMENT
/begin MEASUREMENT B_clradbbo "Bedingung: Adaptionswerte Bereichserk. Benzin im Oel selektiv loeschen" UBYTE B_TRUE 1 100 0 1 BIT_MASK 0x1 FORMAT "%13.11" ECU_ADDRESS 0x3FC2E9 /end MEASUREMENT
/begin MEASUREMENT B_clradiha "Bedingung: Adaptionswerte Hinterachsuebersetzung selektiv loeschen" UBYTE B_TRUE 1 100 0 1 BIT_MASK 0x4 FORMAT "%13.11" ECU_ADDRESS 0x40306C /end MEASUREMENT
/begin MEASUREMENT B_clradkr "Bedingung: Adaptionswerte Klopfregelung selektiv loeschen" UBYTE B_TRUE 1 100 0 1 BIT_MASK 0x1 FORMAT "%13.11" ECU_ADDRESS 0x3FC2EA /end MEASUREMENT
/begin MEASUREMENT B_clradkrd "Bedingung: Adaptionswerte Dynamikvorhalt  selektiv loeschen" UBYTE B_TRUE 1 100 0 1 BIT_MASK 0x1 FORMAT "%13.11" ECU_ADDRESS 0x3FC2EB /end MEASUREMENT
/begin MEASUREMENT B_clradmsz "Bedingung: Adaptionswerte Massenstrom zum Saugrohr selektiv loeschen" UBYTE B_TRUE 1 100 0 1 BIT_MASK 0x1 FORMAT "%13.11" ECU_ADDRESS 0x3FC2EC /end MEASUREMENT
/begin MEASUREMENT B_clradvvt "Bedingung: Adaptionswerte VVT selektiv loeschen" UBYTE B_TRUE 1 100 0 1 BIT_MASK 0x1 FORMAT "%13.11" ECU_ADDRESS 0x3FC2ED /end MEASUREMENT
/begin MEASUREMENT B_clvar "Bedingung Variante Lˆschen ¸ber KWP 2000* Service" UBYTE B_TRUE 1 100 0 1 BIT_MASK 0x1 FORMAT "%13.11" ECU_ADDRESS 0x3FE1CE /end MEASUREMENT
/begin MEASUREMENT B_craus "Ausgewertet durch LREB: Werkstattbit zum Stillegen LR" UBYTE DEZ 1 100 0 1 BIT_MASK 0x1 FORMAT "%5.3" ECU_ADDRESS 0x3FC2EE /end MEASUREMENT
/begin MEASUREMENT B_crdmtl "DMTL-Sperr-Bedingung aus CRash-Signal" UBYTE B_TRUE 1 100 0 1 BIT_MASK 0x1 FORMAT "%13.11" ECU_ADDRESS 0x3FC2EF /end MEASUREMENT
/begin MEASUREMENT B_cvt "Bedingung continuously variable transmission" UBYTE B_TRUE 1 100 0 1 BIT_MASK 0x1 FORMAT "%13.11" ECU_ADDRESS 0x3FC2F0 /end MEASUREMENT
/begin MEASUREMENT B_dktlp "Umschaltung der Lambdaregelungsparameter angefordert" UBYTE B_TRUE 1 100 0 1 BIT_MASK 0x1 FORMAT "%13.11" ECU_ADDRESS 0x3FC2F1 /end MEASUREMENT
/begin MEASUREMENT B_dldpte "Anforderung TEV schlieﬂen aus Tankentl¸ftungsdiagnose" UBYTE B_TRUE 1 100 0 1 BIT_MASK 0x1 FORMAT "%13.11" ECU_ADDRESS 0x3FC2F2 /end MEASUREMENT
/begin MEASUREMENT B_dmhet "Bedingung Anforderung Endstufentest DMTL-Heizung" UBYTE B_TRUE 1 100 0 1 BIT_MASK 0x1 FORMAT "%13.11" ECU_ADDRESS 0x3FC20C /end MEASUREMENT
/begin MEASUREMENT B_dmmvet "Bedingung Endstufentest DMTL-Magnetventil an" UBYTE B_TRUE 1 100 0 1 BIT_MASK 0x1 FORMAT "%13.11" ECU_ADDRESS 0x3FC20D /end MEASUREMENT
/begin MEASUREMENT B_dmpmet "Bedingung Endstufentest DMTL-Pumpenmotor an" UBYTE B_TRUE 1 100 0 1 BIT_MASK 0x1 FORMAT "%13.11" ECU_ADDRESS 0x3FC20E /end MEASUREMENT
/begin MEASUREMENT B_dmtlhe "Bedingung Hauptfreigabe Grob-/Kleinstleckmessung" UBYTE B_TRUE 1 100 0 1 BIT_MASK 0x1 FORMAT "%13.11" ECU_ADDRESS 0x3FC2F3 /end MEASUREMENT
/begin MEASUREMENT B_dmtltz "Bedingung TEV soll geschlossen werden" UBYTE B_TRUE 1 100 0 1 BIT_MASK 0x1 FORMAT "%13.11" ECU_ADDRESS 0x3FC2F4 /end MEASUREMENT
/begin MEASUREMENT B_druck "Bedingung Drucklospr¸fung erf¸llt, System drucklos" UBYTE B_TRUE 1 100 0 1 BIT_MASK 0x1 FORMAT "%13.11" ECU_ADDRESS 0x3FC2F5 /end MEASUREMENT
/begin MEASUREMENT B_dslsk "Bedingung Diagnose Sekund‰rluftsystem f¸r Kurztest" UBYTE B_TRUE 1 100 0 1 BIT_MASK 0x1 FORMAT "%13.11" ECU_ADDRESS 0x3FC2F6 /end MEASUREMENT
/begin MEASUREMENT B_dtefrr "Bedingung Lambdareglerreset bei Tankentl¸ftungsdiagnose" UBYTE DEZ 1 100 0 1 BIT_MASK 0x1 FORMAT "%5.3" ECU_ADDRESS 0x3FC2F7 /end MEASUREMENT
/begin MEASUREMENT B_dtekfa "Bedingung Funktionsanforderung Feinstleckpruefung" UBYTE B_TRUE 1 100 0 1 BIT_MASK 0x1 FORMAT "%13.11" ECU_ADDRESS 0x3FC2F8 /end MEASUREMENT
/begin MEASUREMENT B_dtevhnd "Wird von BMW nachgeliefert" UBYTE B_TRUE 1 100 0 1 BIT_MASK 0x1 FORMAT "%13.11" ECU_ADDRESS 0x3FC2F9 /end MEASUREMENT
/begin MEASUREMENT B_dwg "Bedingung f¸r Diagnose Waste- Gate" UBYTE B_TRUE 1 100 0 1 BIT_MASK 0x1 FORMAT "%13.11" ECU_ADDRESS 0x3FC2FA /end MEASUREMENT
/begin MEASUREMENT B_eblet "Stellglieddiagnose E-Box L¸ftersteuerung: Eingriff Tester" UBYTE B_TRUE 1 100 0 1 BIT_MASK 0x1 FORMAT "%13.11" ECU_ADDRESS 0x3FC20F /end MEASUREMENT
/begin MEASUREMENT B_eblvar "Bedingung E-Box-L¸fter vorhanden" UBYTE B_TRUE 1 100 0 1 BIT_MASK 0x1 FORMAT "%13.11" ECU_ADDRESS 0x3FC2FB /end MEASUREMENT
/begin MEASUREMENT B_edmtl "Fehlertyp 'Error' erkannt (DMTL-Modul)" UBYTE B_TRUE 1 100 0 1 BIT_MASK 0x1 FORMAT "%13.11" ECU_ADDRESS 0x3FC356 /end MEASUREMENT
/begin MEASUREMENT B_egscok "Bedingung Getriebebotschaft CAN empfangen" UBYTE B_TRUE 1 100 0 1 BIT_MASK 0x1 FORMAT "%13.11" ECU_ADDRESS 0x3FC2FC /end MEASUREMENT
/begin MEASUREMENT B_ekpet "Stellglieddiagnose EKP: Eingriff Tester" UBYTE B_TRUE 1 100 0 1 BIT_MASK 0x1 FORMAT "%13.11" ECU_ADDRESS 0x3FC210 /end MEASUREMENT
/begin MEASUREMENT B_elsu "Bedingung Fehler oder Fehler-Vormerkung LSU (keine Betriebsbereitschaft)" UBYTE B_TRUE 1 100 0 1 BIT_MASK 0x1 FORMAT "%13.11" ECU_ADDRESS 0x3FC2FD /end MEASUREMENT
/begin MEASUREMENT B_elsu2 "Bedingung Fehler oder Fehler-Vormerkung LSU Bank2 (keine Betriebsbereitschaft)" UBYTE B_TRUE 1 100 0 1 BIT_MASK 0x1 FORMAT "%13.11" ECU_ADDRESS 0x3FC2FE /end MEASUREMENT
/begin MEASUREMENT B_etr "Bedingung elektrische Thermostatregelung" UBYTE B_TRUE 1 100 0 1 BIT_MASK 0x1 FORMAT "%13.11" ECU_ADDRESS 0x3FC2FF /end MEASUREMENT
/begin MEASUREMENT B_etret "Bedingung elektr. Thermostatregelung ein ¸ber Tester" UBYTE B_TRUE 1 100 0 1 BIT_MASK 0x1 FORMAT "%13.11" ECU_ADDRESS 0x3FC211 /end MEASUREMENT
/begin MEASUREMENT B_fa "Bedingung Funktionsanforderung allgemein" UBYTE B_TRUE 1 100 0 1 BIT_MASK 0x1 FORMAT "%13.11" ECU_ADDRESS 0x3FC1C8 /end MEASUREMENT
/begin MEASUREMENT B_faadav "" UBYTE B_TRUE 1 100 0 1 BIT_MASK 0x2 FORMAT "%13.11" ECU_ADDRESS 0x40306C /end MEASUREMENT
/begin MEASUREMENT B_faan "Bedingung Funktionsanforderung Allgemeine Drehzahlerhˆhung" UBYTE B_TRUE 1 100 0 1 BIT_MASK 0x1 FORMAT "%13.11" ECU_ADDRESS 0x3FC300 /end MEASUREMENT
/begin MEASUREMENT B_faatm "Bedingung Funktionsanforderung kurze Taupunktendezeiten" UBYTE B_TRUE 1 100 0 1 BIT_MASK 0x1 FORMAT "%13.11" ECU_ADDRESS 0x3FC301 /end MEASUREMENT
/begin MEASUREMENT B_fabttreg "Bedingung: Adaptionswerte fuer Batterietausch Loeschen" UBYTE B_TRUE 1 100 0 1 BIT_MASK 0x1 FORMAT "%13.11" ECU_ADDRESS 0x40306C /end MEASUREMENT
/begin MEASUREMENT B_fadisa "Bedingung Testeranforderung Anschlaglernen" UBYTE B_TRUE 1 100 0 1 BIT_MASK 0x1 FORMAT "%13.11" ECU_ADDRESS 0x3FC1C9 /end MEASUREMENT
/begin MEASUREMENT B_fadk "Kompressionstest mit VVT u. konst. DK-Wink" UBYTE B_TRUE 1 100 0 1 BIT_MASK 0x1 FORMAT "%13.11" ECU_ADDRESS 0x3FC1CA /end MEASUREMENT
/begin MEASUREMENT B_fadmet "Bedingung DMTL-Endstufen Diagnosetestersteuerung" UBYTE B_TRUE 1 100 0 1 BIT_MASK 0x1 FORMAT "%13.11" ECU_ADDRESS 0x3FC212 /end MEASUREMENT
/begin MEASUREMENT B_fadmtg "Bedingung Funktionsanforderung Tankentl¸ftungssystem Groblecktest" UBYTE B_TRUE 1 100 0 1 BIT_MASK 0x1 FORMAT "%13.11" ECU_ADDRESS 0x3FC302 /end MEASUREMENT
/begin MEASUREMENT B_fadmtle "Bedingung Funktionsanforderung Tankentl¸ftungssystem, Enable" UBYTE B_TRUE 1 100 0 1 BIT_MASK 0x1 FORMAT "%13.11" ECU_ADDRESS 0x3FC1CB /end MEASUREMENT
/begin MEASUREMENT B_fadmtls "Bedingung Funktionsanforderung Tankentl¸ftungssystem, gestoppt" UBYTE B_TRUE 1 100 0 1 BIT_MASK 0x1 FORMAT "%13.11" ECU_ADDRESS 0x3FC1CC /end MEASUREMENT
/begin MEASUREMENT B_fadylsu "Bedingung Funktionsanforderung Dynamikdiagnose der LSU" UBYTE B_TRUE 1 100 0 1 BIT_MASK 0x1 FORMAT "%13.11" ECU_ADDRESS 0x3FC1CD /end MEASUREMENT
/begin MEASUREMENT B_fadylsu2 "Bedingung Funktionsanforderung Dynamikdiagnose der LSU, Bank2" UBYTE B_TRUE 1 100 0 1 BIT_MASK 0x1 FORMAT "%13.11" ECU_ADDRESS 0x3FC1CE /end MEASUREMENT
/begin MEASUREMENT B_faetr "Bedingung Funktionsanforderung elektr. Thermostatregelung" UBYTE B_TRUE 1 100 0 1 BIT_MASK 0x1 FORMAT "%13.11" ECU_ADDRESS 0x3FC213 /end MEASUREMENT
/begin MEASUREMENT B_faevz "Bedingung Zylinderausblendung durch Tester" UBYTE B_TRUE 1 100 0 1 BIT_MASK 0x1 FORMAT "%13.11" ECU_ADDRESS 0x3FC1CF /end MEASUREMENT
/begin MEASUREMENT B_faglf "Bedingung Funktionsanforderung: gesteuerte Luftf¸hrung" UBYTE B_TRUE 1 100 0 1 BIT_MASK 0x1 FORMAT "%13.11" ECU_ADDRESS 0x3FC214 /end MEASUREMENT
/begin MEASUREMENT B_fahisrst "Bedingung Funktionsanforderung Start Steuern Histogramm Reset" UBYTE B_TRUE 1 100 0 1 BIT_MASK 0x1 FORMAT "%13.11" ECU_ADDRESS 0x3FC215 /end MEASUREMENT
/begin MEASUREMENT B_fakat "Bedingung Funktionsanforderung Katalysator¸berwachung" UBYTE B_TRUE 1 100 0 1 BIT_MASK 0x1 FORMAT "%13.11" ECU_ADDRESS 0x3FC1D0 /end MEASUREMENT
/begin MEASUREMENT B_fakat2 "Bedingung Funktionanforderung Katalysator¸berwachung (Stereo 2.Bank)" UBYTE B_TRUE 1 100 0 1 BIT_MASK 0x1 FORMAT "%13.11" ECU_ADDRESS 0x3FC1D1 /end MEASUREMENT
/begin MEASUREMENT B_fakvs "Funktionsaufforderung Diagnose Kraftstoffsystem f¸r Schnelltest" UBYTE B_TRUE 1 100 0 1 BIT_MASK 0x1 FORMAT "%13.11" ECU_ADDRESS 0x3FC303 /end MEASUREMENT
/begin MEASUREMENT B_falls "Bedingung: Funktionsanforderung Drehzahl‰nderung durch Tester" UBYTE B_TRUE 1 100 0 1 BIT_MASK 0x1 FORMAT "%13.11" ECU_ADDRESS 0x3FC1D2 /end MEASUREMENT
/begin MEASUREMENT B_falr "Bedingung: Funktionsanforderung Lambdaregelung aus" UBYTE B_TRUE 1 100 0 1 BIT_MASK 0x1 FORMAT "%13.11" ECU_ADDRESS 0x3FC1D3 /end MEASUREMENT
/begin MEASUREMENT B_falra "Bedingung: Funktionsanforderung Lambdaregelung-Adaption" UBYTE B_TRUE 1 100 0 1 BIT_MASK 0x1 FORMAT "%13.11" ECU_ADDRESS 0x3FC1D4 /end MEASUREMENT
/begin MEASUREMENT B_falrshk "Bedingung Funktionsanforderung LRSHK" UBYTE B_TRUE 1 100 0 1 BIT_MASK 0x1 FORMAT "%13.11" ECU_ADDRESS 0x3FC304 /end MEASUREMENT
/begin MEASUREMENT B_falsh "Bedingung Funktionsanforderung Lambda-Sonde hinter KAT" UBYTE B_TRUE 1 100 0 1 BIT_MASK 0x1 FORMAT "%13.11" ECU_ADDRESS 0x3FC1D5 /end MEASUREMENT
/begin MEASUREMENT B_falsh2 "Bedingung Funktionsanforderung Lambda-Sonde hinter KAT Bank2" UBYTE B_TRUE 1 100 0 1 BIT_MASK 0x1 FORMAT "%13.11" ECU_ADDRESS 0x3FC1D6 /end MEASUREMENT
/begin MEASUREMENT B_falsv "Bedingung Funktionsanforderung Lambda-Sonde vor KAT" UBYTE B_TRUE 1 100 0 1 BIT_MASK 0x1 FORMAT "%13.11" ECU_ADDRESS 0x3FC1D7 /end MEASUREMENT
/begin MEASUREMENT B_falsv2 "Bedingung Funktionsanforderung Lambda-Sonde vor KAT Bank2" UBYTE B_TRUE 1 100 0 1 BIT_MASK 0x1 FORMAT "%13.11" ECU_ADDRESS 0x3FC1D8 /end MEASUREMENT
/begin MEASUREMENT B_famls "Bedingung Funktionsanforderung Motorl¸fter" UBYTE B_TRUE 1 100 0 1 BIT_MASK 0x1 FORMAT "%13.11" ECU_ADDRESS 0x3FC216 /end MEASUREMENT
/begin MEASUREMENT B_fanwsaa "Bedingung Funktionsanforderung Diagnose NWS aktiv (Auslaﬂ)" UBYTE B_TRUE 1 100 0 1 BIT_MASK 0x1 FORMAT "%13.11" ECU_ADDRESS 0x3FC305 /end MEASUREMENT
/begin MEASUREMENT B_fanwsea "Bedingung Funktionsanforderung Diagnose NWS aktiv (Einlaﬂ)" UBYTE B_TRUE 1 100 0 1 BIT_MASK 0x1 FORMAT "%13.11" ECU_ADDRESS 0x3FC306 /end MEASUREMENT
/begin MEASUREMENT B_fapllsu "Bedingung Funktionsanforderung Plausibilit‰tsdiagnose der LSU" UBYTE B_TRUE 1 100 0 1 BIT_MASK 0x1 FORMAT "%13.11" ECU_ADDRESS 0x3FC1D9 /end MEASUREMENT
/begin MEASUREMENT B_fapllsu2 "Bedingung Funktionsanforderung Plausibilit‰tsdiagnose der  LSU (Bank2)" UBYTE B_TRUE 1 100 0 1 BIT_MASK 0x1 FORMAT "%13.11" ECU_ADDRESS 0x3FC1DA /end MEASUREMENT
/begin MEASUREMENT B_fapmmess "Bedingung Funktionsansteuerung Steuern Messmethode PM" UBYTE B_TRUE 1 100 0 1 BIT_MASK 0x1 FORMAT "%13.11" ECU_ADDRESS 0x3FC1DB /end MEASUREMENT
/begin MEASUREMENT B_fash "Bedingung Funktionsanforderung Schwingungspr¸fung" UBYTE B_TRUE 1 100 0 1 BIT_MASK 0x1 FORMAT "%13.11" ECU_ADDRESS 0x3FC307 /end MEASUREMENT
/begin MEASUREMENT B_fash2 "Bedingung Funktionsanforderung Schwingungspr¸fung Bank2" UBYTE B_TRUE 1 100 0 1 BIT_MASK 0x1 FORMAT "%13.11" ECU_ADDRESS 0x3FC308 /end MEASUREMENT
/begin MEASUREMENT B_fasls "Bedingung Funktionsanforderung Sekund‰rluftsystem" UBYTE B_TRUE 1 100 0 1 BIT_MASK 0x1 FORMAT "%13.11" ECU_ADDRESS 0x3FC1DC /end MEASUREMENT
/begin MEASUREMENT B_fates "Bedingung Funktionsanforderung Tankentl¸ftungssystem" UBYTE B_TRUE 1 100 0 1 BIT_MASK 0x1 FORMAT "%13.11" ECU_ADDRESS 0x3FC1DD /end MEASUREMENT
/begin MEASUREMENT B_favvtal "Bedingung Funktionsanforderung VVT-Anschlag lernen" UBYTE B_TRUE 1 100 0 1 BIT_MASK 0x1 FORMAT "%13.11" ECU_ADDRESS 0x3FC1DE /end MEASUREMENT
/begin MEASUREMENT B_fgrat_um "Bedingung Aus-Tip am FGR-Bedienhebel in der Funktions¸berwachung" UBYTE B_TRUE 1 100 0 1 BIT_MASK 0x1 FORMAT "%13.11" ECU_ADDRESS 0x3F98D4 /end MEASUREMENT
/begin MEASUREMENT B_fgren_um "FGR-/ACC-Einschaltung aus Bedienhebel g¸ltig in der Funktions¸berwachung" UBYTE B_TRUE 1 100 0 1 BIT_MASK 0x1 FORMAT "%13.11" ECU_ADDRESS 0x3F98D5 /end MEASUREMENT
/begin MEASUREMENT B_fgrsb_um "Bedingung Setzen/Beschleunigen am FGR-Bedienhebel in Funktions¸berwachung" UBYTE B_TRUE 1 100 0 1 BIT_MASK 0x1 FORMAT "%13.11" ECU_ADDRESS 0x3F98D6 /end MEASUREMENT
/begin MEASUREMENT B_fgrsd_um "Bedingung Step-Down am FGR-Bedienhebel in Funktions¸berwachung" UBYTE B_TRUE 1 100 0 1 BIT_MASK 0x1 FORMAT "%13.11" ECU_ADDRESS 0x3F98D7 /end MEASUREMENT
/begin MEASUREMENT B_fgrsu_um "Bedingung Step-Up am FGR-Bedienhebel in Funktions¸berwachung" UBYTE B_TRUE 1 100 0 1 BIT_MASK 0x1 FORMAT "%13.11" ECU_ADDRESS 0x3F98D8 /end MEASUREMENT
/begin MEASUREMENT B_fgrsv_um "Bedingung Setzen/Verzˆgern am FGR-Bedienhebel in Funktions¸berwachung" UBYTE B_TRUE 1 100 0 1 BIT_MASK 0x1 FORMAT "%13.11" ECU_ADDRESS 0x3F98D9 /end MEASUREMENT
/begin MEASUREMENT B_fgrwa_um "Bedingung Wiederaufnahme am FGR-Bedienhebel in Funktions¸berwachung" UBYTE B_TRUE 1 100 0 1 BIT_MASK 0x1 FORMAT "%13.11" ECU_ADDRESS 0x3F98DA /end MEASUREMENT
/begin MEASUREMENT B_fgr_bt "" UBYTE B_TRUE 1 100 0 1 BIT_MASK 0x1 FORMAT "%13.11" ECU_ADDRESS 0x3FBEC1 /end MEASUREMENT
/begin MEASUREMENT B_fgr_uc "FGR-/ACC-Momenteneingriff im Befehlstest erlaubt" UBYTE B_TRUE 1 100 0 1 BIT_MASK 0x1 FORMAT "%13.11" ECU_ADDRESS 0x3FBEC2 /end MEASUREMENT
/begin MEASUREMENT B_fgr_um "FGR-/ACC-Momenteneingriff in der Funktions¸berwachung erlaubt" UBYTE B_TRUE 1 100 0 1 BIT_MASK 0x1 FORMAT "%13.11" ECU_ADDRESS 0x3F98D2 /end MEASUREMENT
/begin MEASUREMENT B_fhz "Bedingung Frontscheibenheizung" UBYTE B_TRUE 1 100 0 1 BIT_MASK 0x1 FORMAT "%13.11" ECU_ADDRESS 0x3FC309 /end MEASUREMENT
/begin MEASUREMENT b_flags_uc "Ebene 3 Byte f¸r Botschaft¸berwachung (alte Toggle Bits)" UBYTE dez 1 100 0 255 FORMAT "%5.1" ECU_ADDRESS 0x403A80 /end MEASUREMENT
/begin MEASUREMENT B_ftedab "Bedingung Sp¸lrate f¸r Diagnose zusteuern" UBYTE B_TRUE 1 100 0 1 BIT_MASK 0x1 FORMAT "%13.11" ECU_ADDRESS 0x3FC30A /end MEASUREMENT
/begin MEASUREMENT B_glfet "Bedingung gesteuerte Luftf¸hrung Testeranforderung" UBYTE B_TRUE 1 100 0 1 BIT_MASK 0x1 FORMAT "%13.11" ECU_ADDRESS 0x3FC217 /end MEASUREMENT
/begin MEASUREMENT B_grdst "Bedingung Grundeinstellung" UBYTE B_TRUE 1 100 0 1 BIT_MASK 0x1 FORMAT "%13.11" ECU_ADDRESS 0x3FC1DF /end MEASUREMENT
/begin MEASUREMENT B_gsaf "Bedingung Getriebe-Schalteingriff-Anforderung" UBYTE B_TRUE 1 100 0 1 BIT_MASK 0x1 FORMAT "%13.11" ECU_ADDRESS 0x3FC30B /end MEASUREMENT
/begin MEASUREMENT B_gwrte "Bedingung fr-Grenzwertregelung Tankentl¸ftung aktiv" UBYTE B_TRUE 1 100 0 1 BIT_MASK 0x1 FORMAT "%13.11" ECU_ADDRESS 0x3FC350 /end MEASUREMENT
/begin MEASUREMENT B_hkwnll "Bedingung Leerlaufanhebung durch HKW" UBYTE B_TRUE 1 100 0 1 BIT_MASK 0x1 FORMAT "%13.11" ECU_ADDRESS 0x3FC30C /end MEASUREMENT
/begin MEASUREMENT B_hsh2et "Bedingung LS-Heizung hinter KAT Bank 2 ein ¸ber Tester" UBYTE B_TRUE 1 100 0 1 BIT_MASK 0x1 FORMAT "%13.11" ECU_ADDRESS 0x3FC218 /end MEASUREMENT
/begin MEASUREMENT B_hshet "Bedingung LS-Heizung hinter KAT Bank 1 ein ¸ber Tester" UBYTE B_TRUE 1 100 0 1 BIT_MASK 0x1 FORMAT "%13.11" ECU_ADDRESS 0x3FC219 /end MEASUREMENT
/begin MEASUREMENT B_hsvet "Bedingung LS-Heizung vor KAT Bank 1 ein ¸ber Tester" UBYTE B_TRUE 1 100 0 1 BIT_MASK 0x1 FORMAT "%13.11" ECU_ADDRESS 0x3FC21A /end MEASUREMENT
/begin MEASUREMENT B_hsvet2 "Bedingung LS-Heizung vor KAT Bank 2 ein ¸ber Tester" UBYTE B_TRUE 1 100 0 1 BIT_MASK 0x1 FORMAT "%13.11" ECU_ADDRESS 0x3FC21B /end MEASUREMENT
/begin MEASUREMENT B_hz "Bedingung Zuheizmaﬂnahme ein (Klima, Heater)" UBYTE B_TRUE 1 100 0 1 BIT_MASK 0x1 FORMAT "%13.11" ECU_ADDRESS 0x3FC30D /end MEASUREMENT
/begin MEASUREMENT B_ibsdetec "Bedingung IBS erkannt" UBYTE B_TRUE 1 100 0 1 BIT_MASK 0x1 FORMAT "%13.11" ECU_ADDRESS 0x3FE28C /end MEASUREMENT
/begin MEASUREMENT B_i_ska_uc "Ebene 3 irreversibles Fehlerbit fuer BT" UBYTE B_TRUE 1 100 0 1 BIT_MASK 0x1 FORMAT "%13.11" ECU_ADDRESS 0x3FBEC0 /end MEASUREMENT
/begin MEASUREMENT B_kftkr "" UBYTE B_TRUE 1 100 0 1 BIT_MASK 0x1 FORMAT "%13.11" ECU_ADDRESS 0x3FC30E /end MEASUREMENT
/begin MEASUREMENT B_klmzu_uc "Bedingung  KLMZUMN im Befehlstest" UBYTE B_TRUE 1 100 0 1 BIT_MASK 0x1 FORMAT "%13.11" ECU_ADDRESS 0x3FBED2 /end MEASUREMENT
/begin MEASUREMENT B_koset "Stellglieddiagnose Klimakompressor-Relais: Eingriff Tester" UBYTE B_TRUE 1 100 0 1 BIT_MASK 0x1 FORMAT "%13.11" ECU_ADDRESS 0x3FC21C /end MEASUREMENT
/begin MEASUREMENT B_ldeffw "Bedingung : definiertes Soll-Lambda Bank1 durch Fahrerwunsch" UBYTE B_TRUE 1 100 0 1 BIT_MASK 0x1 FORMAT "%13.11" ECU_ADDRESS 0x3FC30F /end MEASUREMENT
/begin MEASUREMENT B_lowra "Bedingung Zwischengelege f¸r Low Range zugeschaltet" UBYTE B_TRUE 1 100 0 1 BIT_MASK 0x1 FORMAT "%13.11" ECU_ADDRESS 0x3FC310 /end MEASUREMENT
/begin MEASUREMENT B_lrar "Bedingung reduzierte Korrekturbereiche in der LRA" UBYTE B_TRUE 1 100 0 1 BIT_MASK 0x1 FORMAT "%13.11" ECU_ADDRESS 0x3FC351 /end MEASUREMENT
/begin MEASUREMENT B_lrasp "Bedingung stop LRA wegen LSU-Fehler" UBYTE B_TRUE 1 100 0 1 BIT_MASK 0x1 FORMAT "%13.11" ECU_ADDRESS 0x3FC311 /end MEASUREMENT
/begin MEASUREMENT B_lrasp2 "Bedingung stop LRA wegen LSU-Fehler, Bank 2" UBYTE B_TRUE 1 100 0 1 BIT_MASK 0x1 FORMAT "%13.11" ECU_ADDRESS 0x3FC312 /end MEASUREMENT
/begin MEASUREMENT B_lrndia "Bedingung: DV-E-Adaption und Pr¸fungen per Diagnose-Tester aktivieren" UBYTE B_TRUE 1 100 0 1 BIT_MASK 0x1 FORMAT "%13.11" ECU_ADDRESS 0x3FC313 /end MEASUREMENT
/begin MEASUREMENT B_lroff "Bedingung: Drehzahlschwelle f¸r Loadresponse-Funktion des Generators ausschalten" UBYTE B_TRUE 1 100 0 1 BIT_MASK 0x1 FORMAT "%13.11" ECU_ADDRESS 0x3FC314 /end MEASUREMENT
/begin MEASUREMENT B_lroff2 "Bedingung: Drehzahlschwelle f¸r Loadresponse-Funktion des Generators ausschalten" UBYTE B_TRUE 1 100 0 1 BIT_MASK 0x1 FORMAT "%13.11" ECU_ADDRESS 0x3FC315 /end MEASUREMENT
/begin MEASUREMENT B_lsvvsp "Bedingung Vertauschte Lambda-Sonden, Regelung sperren" UBYTE B_TRUE 1 100 0 1 BIT_MASK 0x1 FORMAT "%13.11" ECU_ADDRESS 0x3FC316 /end MEASUREMENT
/begin MEASUREMENT B_masterhw "Bedingung Master-SG gem‰ﬂ Codier-Pin (plausibilisiert)" UBYTE B_TRUE 1 100 0 1 BIT_MASK 0x1 FORMAT "%13.11" ECU_ADDRESS 0x3FC317 /end MEASUREMENT
/begin MEASUREMENT B_mdacc_um "Bedingung Momentenanforderung ACC ¸ber CAN" UBYTE B_TRUE 1 100 0 1 BIT_MASK 0x1 FORMAT "%13.11" ECU_ADDRESS 0x3F98C9 /end MEASUREMENT
/begin MEASUREMENT B_mdegs_uc "Bedingung Momentenanforderung EGS ¸ber CAN im Befehlstest" UBYTE B_TRUE 1 100 0 1 BIT_MASK 0x1 FORMAT "%13.11" ECU_ADDRESS 0x3FBEC8 /end MEASUREMENT
/begin MEASUREMENT B_mdmin "Bedingung minimal erreichbares indiziertes Moment erreicht" UBYTE B_TRUE 1 100 0 1 BIT_MASK 0x1 FORMAT "%13.11" ECU_ADDRESS 0x3FC318 /end MEASUREMENT
/begin MEASUREMENT B_mdwaner "Bedingung Fehler auf mdwan_w" UBYTE B_TRUE 1 100 0 1 BIT_MASK 0x1 FORMAT "%13.11" ECU_ADDRESS 0x3FC319 /end MEASUREMENT
/begin MEASUREMENT B_newentry "Bedingung Eintrag in Fehlerspeicher" UBYTE B_TRUE 1 100 0 1 BIT_MASK 0x1 FORMAT "%13.11" ECU_ADDRESS 0x3FC31A /end MEASUREMENT
/begin MEASUREMENT B_nnot "Bedingung Drehzahlanhebung im Notlauf" UBYTE DEZ 1 100 0 1 BIT_MASK 0x1 FORMAT "%5.3" ECU_ADDRESS 0x3FC31B /end MEASUREMENT
/begin MEASUREMENT B_noacc_um "Bedingung keine ‹bernahme des ACC-Momentes in E2" UBYTE B_TRUE 1 100 0 1 BIT_MASK 0x1 FORMAT "%13.11" ECU_ADDRESS 0x3F98CA /end MEASUREMENT
/begin MEASUREMENT B_nomilkl "No MIL on bei Feinleck" UBYTE B_TRUE 1 100 0 1 BIT_MASK 0x1 FORMAT "%13.11" ECU_ADDRESS 0x3FC31C /end MEASUREMENT
/begin MEASUREMENT B_nomsr_bt "MSR-Momentenvorgabe in der Funktions¸berwachung nicht ¸bernommen im Befehlstest" UBYTE B_TRUE 1 100 0 1 BIT_MASK 0x1 FORMAT "%13.11" ECU_ADDRESS 0x3FBEC3 /end MEASUREMENT
/begin MEASUREMENT B_nomsr_uc "MSR-Momentenvorgabe im Befehlstest nicht ¸bernommen" UBYTE B_TRUE 1 100 0 1 BIT_MASK 0x1 FORMAT "%13.11" ECU_ADDRESS 0x3FBEC4 /end MEASUREMENT
/begin MEASUREMENT B_nomsr_um "MSR-Momentenvorgabe in der Funktions¸berwachung nicht ¸bernommen" UBYTE B_TRUE 1 100 0 1 BIT_MASK 0x1 FORMAT "%13.11" ECU_ADDRESS 0x3F98E5 /end MEASUREMENT
/begin MEASUREMENT B_nosgs_bt "Verbot des SGS-Eingriffs im Befehlstest" UBYTE B_TRUE 1 100 0 1 BIT_MASK 0x1 FORMAT "%13.11" ECU_ADDRESS 0x3FBEC9 /end MEASUREMENT
/begin MEASUREMENT B_nosgs_uc "SGS-Momentenvorgabe im Befehlstest nicht ¸bernommen" UBYTE B_TRUE 1 100 0 1 BIT_MASK 0x1 FORMAT "%13.11" ECU_ADDRESS 0x3FBECA /end MEASUREMENT
/begin MEASUREMENT B_nouetm "Bedingung keine ‹bertemperatur im Nachlauf" UBYTE B_TRUE 1 100 0 1 BIT_MASK 0x1 FORMAT "%13.11" ECU_ADDRESS 0x3FE0BA /end MEASUREMENT
/begin MEASUREMENT B_npacc_um "Bedingung ACC-SG Checksumme fehlerhaft" UBYTE B_TRUE 1 100 0 1 BIT_MASK 0x1 FORMAT "%13.11" ECU_ADDRESS 0x3F98CB /end MEASUREMENT
/begin MEASUREMENT B_npdsc_uc "Bedingung DSC-SG Checksumme im Befehlstest  fehlerhaft" UBYTE B_TRUE 1 100 0 1 BIT_MASK 0x1 FORMAT "%13.11" ECU_ADDRESS 0x3FBEC5 /end MEASUREMENT
/begin MEASUREMENT B_npdsc_um "Bedingung DSC-SG Checksumme fehlerhaft" UBYTE B_TRUE 1 100 0 1 BIT_MASK 0x1 FORMAT "%13.11" ECU_ADDRESS 0x3F98E6 /end MEASUREMENT
/begin MEASUREMENT B_npegs_uc "Bedingung EGS-SG Checksummeim Befehlstest  fehlerhaft" UBYTE B_TRUE 1 100 0 1 BIT_MASK 0x1 FORMAT "%13.11" ECU_ADDRESS 0x3FBECB /end MEASUREMENT
/begin MEASUREMENT B_npszl_um "Bedingung SZL-SG Checksumme fehlerhaft" UBYTE B_TRUE 1 100 0 1 BIT_MASK 0x1 FORMAT "%13.11" ECU_ADDRESS 0x3F98DB /end MEASUREMENT
/begin MEASUREMENT B_nstabk "Bedingung Standabkopplung" UBYTE B_TRUE 1 100 0 1 BIT_MASK 0x1 FORMAT "%13.11" ECU_ADDRESS 0x3FC31D /end MEASUREMENT
/begin MEASUREMENT B_nws "Bedingung Nockenwellensteuerung" UBYTE B_TRUE 1 100 0 1 BIT_MASK 0x1 FORMAT "%13.11" ECU_ADDRESS 0x3FC31E /end MEASUREMENT
/begin MEASUREMENT B_qtedab "Bedingung schnelle Absteuerung der Sp¸lrate" UBYTE B_TRUE 1 100 0 1 BIT_MASK 0x1 FORMAT "%13.11" ECU_ADDRESS 0x3FC357 /end MEASUREMENT
/begin MEASUREMENT B_rineza "Bedingung Abschaltung Ri-Messtrom LSU/CJ120 wegen Einzelzylinder-Erkennung" UBYTE B_TRUE 1 100 0 1 BIT_MASK 0x1 FORMAT "%13.11" ECU_ADDRESS 0x3FC31F /end MEASUREMENT
/begin MEASUREMENT B_rineza2 "Bedingung Abschaltung Ri-Messtrom LSU2 / CJ120 wegen Einzelzylinder-Erkennung" UBYTE B_TRUE 1 100 0 1 BIT_MASK 0x1 FORMAT "%13.11" ECU_ADDRESS 0x3FC320 /end MEASUREMENT
/begin MEASUREMENT B_ripuv "Bedingung Strom-Pumpen f¸r Sonde vor KAT" UBYTE B_TRUE 1 100 0 1 BIT_MASK 0x1 FORMAT "%13.11" ECU_ADDRESS 0x3FC321 /end MEASUREMENT
/begin MEASUREMENT B_ripuv2 "Bedingung Strom-Pumpen f¸r Sonde vor KAT Bank2" UBYTE B_TRUE 1 100 0 1 BIT_MASK 0x1 FORMAT "%13.11" ECU_ADDRESS 0x3FC322 /end MEASUREMENT
/begin MEASUREMENT B_sacvt "Bedingung Schubabschaltunterst¸tzung f¸r CVT-Getriebe" UBYTE B_TRUE 1 100 0 1 BIT_MASK 0x1 FORMAT "%13.11" ECU_ADDRESS 0x3FC323 /end MEASUREMENT
/begin MEASUREMENT B_savac_um "Bedingung: Schubabschalteverbot von ACC" UBYTE B_TRUE 1 100 0 1 BIT_MASK 0x1 FORMAT "%13.11" ECU_ADDRESS 0x3F98CC /end MEASUREMENT
/begin MEASUREMENT B_sch "Bedingung Betriebsart Schicht" UBYTE B_TRUE 1 100 0 1 BIT_MASK 0x1 FORMAT "%13.11" ECU_ADDRESS 0x3FC324 /end MEASUREMENT
/begin MEASUREMENT B_siacc_um "Bedingung ACC-SG Alivecounter wird nicht korrekt inkrement. bzw. bleibt stehen" UBYTE B_TRUE 1 100 0 1 BIT_MASK 0x1 FORMAT "%13.11" ECU_ADDRESS 0x3F98CD /end MEASUREMENT
/begin MEASUREMENT B_sidsc_uc "Bedingung DSC-SG Alivecounter wird in BT nicht korrekt inkr. bzw. bleibt stehen" UBYTE B_TRUE 1 100 0 1 BIT_MASK 0x1 FORMAT "%13.11" ECU_ADDRESS 0x3FBEC6 /end MEASUREMENT
/begin MEASUREMENT B_sidsc_um "Bedingung DSC-SG Alivecounter wird nicht korrekt inkrement. bzw. bleibt stehen" UBYTE B_TRUE 1 100 0 1 BIT_MASK 0x1 FORMAT "%13.11" ECU_ADDRESS 0x3F98E7 /end MEASUREMENT
/begin MEASUREMENT B_siegs_uc "Bedingung EGS-SG Alivecounter wird in BT nicht korrekt inkr. bzw. bleibt stehen" UBYTE B_TRUE 1 100 0 1 BIT_MASK 0x1 FORMAT "%13.11" ECU_ADDRESS 0x3FBECC /end MEASUREMENT
/begin MEASUREMENT B_siszl_um "Bedingung SZL-SG Alivecounter wird nicht korrekt inkrement. bzw. bleibt stehen" UBYTE B_TRUE 1 100 0 1 BIT_MASK 0x1 FORMAT "%13.11" ECU_ADDRESS 0x3F98DC /end MEASUREMENT
/begin MEASUREMENT B_sl "Bedingung Servo-Lenkung" UBYTE B_TRUE 1 100 0 1 BIT_MASK 0x1 FORMAT "%13.11" ECU_ADDRESS 0x3FC325 /end MEASUREMENT
/begin MEASUREMENT B_slpet "Stellglieddiagnose SLP: Eingriff Tester" UBYTE B_TRUE 1 100 0 1 BIT_MASK 0x1 FORMAT "%13.11" ECU_ADDRESS 0x3FC21D /end MEASUREMENT
/begin MEASUREMENT B_sptvar "Bedingung Sporttaster vorhanden" UBYTE B_TRUE 1 100 0 1 BIT_MASK 0x1 FORMAT "%13.11" ECU_ADDRESS 0x3FC326 /end MEASUREMENT
/begin MEASUREMENT B_sta "Bedingung automatischer Start" UBYTE B_TRUE 1 100 0 1 BIT_MASK 0x1 FORMAT "%13.11" ECU_ADDRESS 0x3FC048 /end MEASUREMENT
/begin MEASUREMENT B_sta0ag "Bedingung Start-Automatik AG-Fzg" UBYTE B_TRUE 1 100 0 1 BIT_MASK 0x1 FORMAT "%13.11" ECU_ADDRESS 0x3FE920 /end MEASUREMENT
/begin MEASUREMENT B_staa "Bedingung Startadaption aktiv im Nachstart" UBYTE B_TRUE 1 100 0 1 BIT_MASK 0x1 FORMAT "%13.11" ECU_ADDRESS 0x3FC327 /end MEASUREMENT
/begin MEASUREMENT B_staet "Stellglieddiagnose Startrelais: Eingriff Tester" UBYTE B_TRUE 1 100 0 1 BIT_MASK 0x1 FORMAT "%13.11" ECU_ADDRESS 0x3FC21E /end MEASUREMENT
/begin MEASUREMENT B_stares5v "Bedingung 5V-Reset im Start" UBYTE B_TRUE 1 100 0 1 BIT_MASK 0x1 FORMAT "%13.11" ECU_ADDRESS 0x3FC049 /end MEASUREMENT
/begin MEASUREMENT B_strvar "Bedingung Starterrelais an Motorsteuerung angeschlossen" UBYTE B_TRUE 1 100 0 1 BIT_MASK 0x1 FORMAT "%13.11" ECU_ADDRESS 0x3FC328 /end MEASUREMENT
/begin MEASUREMENT B_svuerf "Bedingung Sondenspannung vor KAT erfassen" UBYTE B_TRUE 1 100 0 1 BIT_MASK 0x1 FORMAT "%13.11" ECU_ADDRESS 0x3FC329 /end MEASUREMENT
/begin MEASUREMENT B_svuerf2 "Bedingung Sondenspannung vor KAT erfassen Bank2" UBYTE B_TRUE 1 100 0 1 BIT_MASK 0x1 FORMAT "%13.11" ECU_ADDRESS 0x3FC32A /end MEASUREMENT
/begin MEASUREMENT B_te "Bedingung Tankentl¸ftung" UBYTE B_TRUE 1 100 0 1 BIT_MASK 0x1 FORMAT "%13.11" ECU_ADDRESS 0x3FC358 /end MEASUREMENT
/begin MEASUREMENT B_teabb "Bedingung Tankentl¸ftung abbruchbereit" UBYTE B_TRUE 1 100 0 1 BIT_MASK 0x1 FORMAT "%13.11" ECU_ADDRESS 0x3FC352 /end MEASUREMENT
/begin MEASUREMENT B_teakt "Bedingung Tankentl¸ftung aktiv (normaler Betrieb oder Notlauf)" UBYTE B_TRUE 1 100 0 1 BIT_MASK 0x1 FORMAT "%13.11" ECU_ADDRESS 0x3FC353 /end MEASUREMENT
/begin MEASUREMENT B_tef "Bedingung Tankentl¸ftung prinzipiell freigegeben" UBYTE B_TRUE 1 100 0 1 BIT_MASK 0x1 FORMAT "%13.11" ECU_ADDRESS 0x3FC359 /end MEASUREMENT
/begin MEASUREMENT B_tehb "Bedingung Tankentl¸ftung mit hoher Beladung" UBYTE B_TRUE 1 100 0 1 BIT_MASK 0x1 FORMAT "%13.11" ECU_ADDRESS 0x3FC354 /end MEASUREMENT
/begin MEASUREMENT B_tehbx "Bedingung Beladungsintegrator ftead am Maximalanschlag" UBYTE B_TRUE 1 100 0 1 BIT_MASK 0x1 FORMAT "%13.11" ECU_ADDRESS 0x3FC355 /end MEASUREMENT
/begin MEASUREMENT B_tei "Bedingung Tankentl¸ftung funktionsintern" UBYTE B_TRUE 1 100 0 1 BIT_MASK 0x1 FORMAT "%13.11" ECU_ADDRESS 0x3FC35A /end MEASUREMENT
/begin MEASUREMENT B_ten "Bedingung Tankentl¸ftung im Notlaufbetrieb (ohne Lambdaregelung)" UBYTE B_TRUE 1 100 0 1 BIT_MASK 0x1 FORMAT "%13.11" ECU_ADDRESS 0x3FC35B /end MEASUREMENT
/begin MEASUREMENT B_tevet "Condition purge valve on by tester" UBYTE B_TRUE 1 100 0 1 BIT_MASK 0x1 FORMAT "%13.11" ECU_ADDRESS 0x3FC21F /end MEASUREMENT
/begin MEASUREMENT B_teza "Bedingung Tankentl¸ftung zwangsaktiv" UBYTE B_TRUE 1 100 0 1 BIT_MASK 0x1 FORMAT "%13.11" ECU_ADDRESS 0x3FC32B /end MEASUREMENT
/begin MEASUREMENT B_tfst2ok "CAN: Fuellstandssignal Geber 2 okay" UBYTE B_TRUE 1 100 0 1 BIT_MASK 0x1 FORMAT "%13.11" ECU_ADDRESS 0x3FC32C /end MEASUREMENT
/begin MEASUREMENT B_tfstok "CAN: Fuellstandssignal Geber 1 okay" UBYTE B_TRUE 1 100 0 1 BIT_MASK 0x1 FORMAT "%13.11" ECU_ADDRESS 0x3FC32D /end MEASUREMENT
/begin MEASUREMENT B_toensvar "Bedingung ÷lniveausensor (TOENS) vorhanden" UBYTE B_TRUE 1 100 0 1 BIT_MASK 0x1 FORMAT "%13.11" ECU_ADDRESS 0x3FC32E /end MEASUREMENT
/begin MEASUREMENT B_txuget "Bedingung Untersetzungsgetriebe mit TXU" UBYTE B_TRUE 1 100 0 1 BIT_MASK 0x1 FORMAT "%13.11" ECU_ADDRESS 0x3FC32F /end MEASUREMENT
/begin MEASUREMENT B_uetm "Bedingung ‹bertemperatur" UBYTE B_TRUE 1 100 0 1 BIT_MASK 0x1 FORMAT "%13.11" ECU_ADDRESS 0x3FC04A /end MEASUREMENT
/begin MEASUREMENT B_uetmc "Bedingung ‹bertemperatur; CAN-Sende-Botschaft" UBYTE B_TRUE 1 100 0 1 BIT_MASK 0x1 FORMAT "%13.11" ECU_ADDRESS 0x3FC04B /end MEASUREMENT
/begin MEASUREMENT B_vs "Bedingung Ventilhub gross" UBYTE B_TRUE 1 100 0 1 BIT_MASK 0x1 FORMAT "%13.11" ECU_ADDRESS 0x3FC330 /end MEASUREMENT
/begin MEASUREMENT B_vvteet "Testervorgabe VVT-Enable Leitung" UBYTE B_TRUE 1 100 0 1 BIT_MASK 0x1 FORMAT "%13.11" ECU_ADDRESS 0x3FC220 /end MEASUREMENT
/begin MEASUREMENT B_wdksap "DK-Steuerung ¸ber Festwert, Bit 1 hat Priorit‰t" UBYTE B_TRUE 1 100 0 1 BIT_MASK 0x1 FORMAT "%13.11" ECU_ADDRESS 0x3FC1E0 /end MEASUREMENT
/begin MEASUREMENT can_id_uc "Botschafts-Identifier im Befehlstest" UBYTE dez 1 100 0 255 FORMAT "%5.1" ECU_ADDRESS 0x403A92 /end MEASUREMENT
/begin MEASUREMENT codcan_uc "Umschaltung CAN11/CAN12 (BMW) im Befehlstest" UBYTE dez 1 100 0 255 FORMAT "%5.1" ECU_ADDRESS 0x403A89 /end MEASUREMENT
/begin MEASUREMENT codcan_um "Umschaltung CAN11/CAN12 (BMW) in Funktions¸berwachung" UBYTE dez 1 100 0 255 FORMAT "%5.1" ECU_ADDRESS 0x3F98D0 /end MEASUREMENT
/begin MEASUREMENT codcan_ur "Doppelablage (DA) f¸r CODCAN_UM" UBYTE dez 1 100 0 255 FORMAT "%5.1" ECU_ADDRESS 0x3F99C2 /end MEASUREMENT
/begin MEASUREMENT codget_bt "Codierung Getriebe im Befehlstest" UBYTE dez 1 100 0 255 FORMAT "%5.1" ECU_ADDRESS 0x403A93 /end MEASUREMENT
/begin MEASUREMENT c_flags_uc "Ebene 3 Byte fuer Info aus CAN-Botschaft" UBYTE dez 1 100 0 255 FORMAT "%5.1" ECU_ADDRESS 0x3F988C /end MEASUREMENT
/begin MEASUREMENT dbacc_c_um "Fehlerz‰hler: Botschaftsabsicherung ACC-Botschaft (Alive)" UBYTE dez 1 100 0 255 FORMAT "%5.1" ECU_ADDRESS 0x3F98D1 /end MEASUREMENT
/begin MEASUREMENT dbacc_c_ur "Doppelablage (DA) f¸r DBACC_C_UM" UBYTE dez 1 100 0 255 FORMAT "%5.1" ECU_ADDRESS 0x3F99C3 /end MEASUREMENT
/begin MEASUREMENT dbawcnt "Array: Aussetzerz‰hler" UWORD DEZ 1 100 0 65535 FORMAT "%8.2" ARRAY_SIZE 12 ECU_ADDRESS 0x40480E /end MEASUREMENT
/begin MEASUREMENT dbawstatus "Status der Diagnosefunktion DBAW" UBYTE DEZ 1 100 0 255 FORMAT "%5.1" ECU_ADDRESS 0x4039B5 /end MEASUREMENT
/begin MEASUREMENT dbdsc_c_uc "Fehlerz‰hler: Botschaftsabsicherung DSC-Botschaft (Alive) im Befehlstest" UBYTE t20ms_ub_b5100 1 100 0 5100 ECU_ADDRESS 0x403A8A /end MEASUREMENT
/begin MEASUREMENT dbdsc_c_um "Fehlerz‰hler Botschaftsabsicherung DSC-Botschaft (Alive)" UBYTE t20ms_ub_b5100 1 100 0 5100 ECU_ADDRESS 0x3F98EA /end MEASUREMENT
/begin MEASUREMENT dbdsc_c_ur "Doppelablage (DA) f¸r DBDSC_C_UM" UBYTE dez 1 100 0 255 FORMAT "%5.1" ECU_ADDRESS 0x3F99CE /end MEASUREMENT
/begin MEASUREMENT dbegs_c_uc "Fehlerz‰hler: Botschaftsabsicherung EGS-Botschaft (Alive) im Befehlstest" UBYTE t10ms_ub_b2550 1 100 0 2550 ECU_ADDRESS 0x403A94 /end MEASUREMENT
/begin MEASUREMENT dbfgr_c_um "Fehlerz‰hler: Botschaftsabsicherung FGR-Botschaft (Alive)" UBYTE t20ms_ub_b5100 1 100 0 5100 ECU_ADDRESS 0x3F98E1 /end MEASUREMENT
/begin MEASUREMENT dbfgr_c_ur "Doppelablage (DA) f¸r DBFGR_C_UM" UBYTE dez 1 100 0 255 FORMAT "%5.1" ECU_ADDRESS 0x3F99C9 /end MEASUREMENT
/begin MEASUREMENT dbszl_c_um "Fehlerz‰hler: Botschaftsunterbrechung FGR-Botschaft" UBYTE dez 1 100 0 255 FORMAT "%5.1" ECU_ADDRESS 0x3F98E2 /end MEASUREMENT
/begin MEASUREMENT dbszl_c_ur "Doppelablage (DA) f¸r DBSZL_C_UM" UBYTE dez 1 100 0 255 FORMAT "%5.1" ECU_ADDRESS 0x3F99CA /end MEASUREMENT
/begin MEASUREMENT devoff "EV-Ausblendmaske bei Testeranforderung" UBYTE dez 1 100 0 255 FORMAT "%5.1" ECU_ADDRESS 0x40398C /end MEASUREMENT
/begin MEASUREMENT dftef_w "Eingang Integrator Sp¸lrate" SWORD perio_sw_b1p562 1 100 -1.562 1.56195 FORMAT "%8.6" ECU_ADDRESS 0x404326 /end MEASUREMENT
/begin MEASUREMENT disatst "Testersollwert bei geregelter Saugrohrumschaltung (DISA)" UBYTE rel_ub_b100 1 100 0 99.6094 FORMAT "%5.2" ECU_ADDRESS 0x403064 /end MEASUREMENT
/begin MEASUREMENT dkatefrg "Abweichung Kraftstoffanteil Tankentl¸ftung bei Sollsp¸lrate von Zielwert" SBYTE fak_sb_b1 1 100 -1 0.992188 FORMAT "%5.3" ECU_ADDRESS 0x403D16 /end MEASUREMENT
/begin MEASUREMENT dkhc_w "Eingang Integrator HC-Konzentration" SWORD perio_sw_b6p125 1 100 -6.125 6.12481 FORMAT "%8.6" ECU_ADDRESS 0x40367A /end MEASUREMENT
/begin MEASUREMENT dmlftef "Produkt Sp¸lrate mal prozentuale Luftmassen‰nderung" UBYTE fak_ub_b0p5 1 100 0 0.498047 ECU_ADDRESS 0x403D17 /end MEASUREMENT
/begin MEASUREMENT dmllrl_w "geforderte Drehmoment‰nderung von der LLR (Anteil Luftpfad)" SWORD rel_sw_b100 1 100 -100 99.9969 FORMAT "%8.4" ECU_ADDRESS 0x4042D4 /end MEASUREMENT
/begin MEASUREMENT dmrkrll "Eingriffsmoment der Klopfregelung" UWORD rel_q0p09726 1 100 0 6399.3 FORMAT "%8.3" ECU_ADDRESS 0x406428 /end MEASUREMENT
/begin MEASUREMENT dmssginr "relative ƒnderung des Massenstromes mssgin_w" SBYTE fak_sb_b1 1 100 -1 0.992188 FORMAT "%5.3" ECU_ADDRESS 0x403D18 /end MEASUREMENT
/begin MEASUREMENT dpssolte_w "Solldifferenzdruck bei TE" SWORD p_q0p039 1 100 -1280 1279.96 FORMAT "%8.3" ECU_ADDRESS 0x40483A /end MEASUREMENT
/begin MEASUREMENT dpstevf_w "TE-Differenzdruckoffset vor Filter" SWORD p_q0p039 1 100 -1280 1279.96 FORMAT "%8.3" ECU_ADDRESS 0x40483C /end MEASUREMENT
/begin MEASUREMENT dpste_w "" SWORD p_q0p039 1 100 -1280 1279.96 FORMAT "%8.3" ECU_ADDRESS 0x40483E /end MEASUREMENT
/begin MEASUREMENT drlfue_w "Lastkorrektur des F¸llungsreglers" SWORD rel_sw_q0p0234 1 100 -768 767.977 FORMAT "%8.4" ECU_ADDRESS 0x4042D6 /end MEASUREMENT
/begin MEASUREMENT drrev_sta "Zustand der Synchronisation" UBYTE dez 1 100 0 255 FORMAT "%5.1" ECU_ADDRESS 0x403976 /end MEASUREMENT
/begin MEASUREMENT dscstat_uc "DSC-Status aus Befehlstest" UBYTE dez 1 100 0 255 FORMAT "%5.1" ECU_ADDRESS 0x403A8B /end MEASUREMENT
/begin MEASUREMENT dscstat_um "DSC-Anforderungs-Status (CAN) aus der Funktions¸berwachung" UBYTE dez 1 100 0 255 FORMAT "%5.1" ECU_ADDRESS 0x3FA3BE /end MEASUREMENT
/begin MEASUREMENT dstert20_w "Normierte Weitertransportstrecke Regeneriergas im Saugrohr im 20ms-Raster" UWORD fak_uw_b2 1 100 0 1.99997 FORMAT "%8.6" ECU_ADDRESS 0x404328 /end MEASUREMENT
/begin MEASUREMENT dzw1_uc "Delta Z¸ndwinkel lambdaabh‰ngig (1. Bank) im Befehlstest" UBYTE zw_ub_q0p75 1 100 0 191.25 FORMAT "%5.1" ECU_ADDRESS 0x403AA5 /end MEASUREMENT
/begin MEASUREMENT dzw1_um "Delta Z¸ndwinkel lambdaabh‰ngig (1. Bank) in der Funktions¸berwachung" UBYTE zw_ub_q0p75 1 100 0 191.25 FORMAT "%5.1" ECU_ADDRESS 0x3F99E0 /end MEASUREMENT
/begin MEASUREMENT dzw2_uc "Delta Z¸ndwinkel lambdaabh‰ngig (2. Bank) im Befehlstest" UBYTE zw_ub_q0p75 1 100 0 191.25 FORMAT "%5.1" ECU_ADDRESS 0x403AA6 /end MEASUREMENT
/begin MEASUREMENT dzw2_um "Delta Z¸ndwinkel lambdaabh‰ngig (2.Bank) in der Funktions¸berwachung" UBYTE zw_ub_q0p75 1 100 0 191.25 FORMAT "%5.1" ECU_ADDRESS 0x3F99E1 /end MEASUREMENT
/begin MEASUREMENT dzwkoef_uc "Koeffizient auf delta Z¸ndwinkel f¸r Befehlstest" UBYTE fak_q0p0439 1 100 0 11.1961 FORMAT "%5.2" ECU_ADDRESS 0x403AA7 /end MEASUREMENT
/begin MEASUREMENT dzwkoef_um "Koeffizient auf delta Z¸ndwinkel in der Funktions¸berwachung" UBYTE fak_q0p0439 1 100 0 11.1961 FORMAT "%5.2" ECU_ADDRESS 0x3F99E2 /end MEASUREMENT
/begin MEASUREMENT dzwq_uc "Delta Z¸ndwinkel (quadratisch) f¸r Befehlstest" UBYTE kwq_ub_q0p35576 1 100 0 90.72 FORMAT "%5.2" ECU_ADDRESS 0x403AA8 /end MEASUREMENT
/begin MEASUREMENT dzwq_um "Delta Z¸ndwinkel (quadratisch) in der Funktions¸berwachung" UBYTE kwq_ub_q0p35576 1 100 0 90.72 FORMAT "%5.2" ECU_ADDRESS 0x3F99E3 /end MEASUREMENT
/begin MEASUREMENT dzw_uc "Delta Z¸ndwinkel zwischen zwopt und zwout im Befehlstest" UBYTE zw_ub_q0p75 1 100 0 191.25 FORMAT "%5.1" ECU_ADDRESS 0x403AA9 /end MEASUREMENT
/begin MEASUREMENT dzw_um "Delta Z¸ndwinkel zwischen zwopt und zwout in der Funktions¸berwachung" UBYTE zw_ub_q0p75 1 100 0 191.25 FORMAT "%5.1" ECU_ADDRESS 0x3F9900 /end MEASUREMENT
/begin MEASUREMENT dzw_ur "Doppelablage (DA) f¸r DZW_UM" UBYTE dez 1 100 0 255 FORMAT "%5.1" ECU_ADDRESS 0x3F99E4 /end MEASUREMENT
/begin MEASUREMENT egsstat_uc "EGS-Status aus Befehlstest" UBYTE dez 1 100 0 255 FORMAT "%5.1" ECU_ADDRESS 0x403A95 /end MEASUREMENT
/begin MEASUREMENT egstemp_uc "EGS-Status Getriebe-‹bertemperatur aus Befehlstest" UBYTE dez 1 100 0 255 FORMAT "%5.1" ECU_ADDRESS 0x403A96 /end MEASUREMENT
/begin MEASUREMENT ehz_pw "Heizleistungsanforderung an EZH" UBYTE rel_ub_b100 1 100 0 99.6094 FORMAT "%5.2" ECU_ADDRESS 0x4035C5 /end MEASUREMENT
/begin MEASUREMENT ei_msrc_uc "irreversibles Fehlerbit bei der MSR-‹berwachung im Befehlstest" UBYTE B_TRUE 1 100 0 1 BIT_MASK 0x1 FORMAT "%13.11" ECU_ADDRESS 0x3FBEC7 /end MEASUREMENT
/begin MEASUREMENT ei_msrc_um "irreversibles Fehlerbit bei der MSR-‹berwachung der Funktions¸berwachung" UBYTE B_TRUE 1 100 0 1 BIT_MASK 0x1 FORMAT "%13.11" ECU_ADDRESS 0x3F98E8 /end MEASUREMENT
/begin MEASUREMENT ei_mver_uc "Ebene 3 irreversibles Fehlerbit fuer URCMVER aus BT" UBYTE B_TRUE 1 100 0 1 BIT_MASK 0x1 FORMAT "%13.11" ECU_ADDRESS 0x3FBED1 /end MEASUREMENT
/begin MEASUREMENT ei_mver_um "irreversibles Fehlerbit beim Momentenvergleich der Funktions¸berwachung" UBYTE B_TRUE 1 100 0 1 BIT_MASK 0x1 FORMAT "%13.11" ECU_ADDRESS 0x3F9903 /end MEASUREMENT
/begin MEASUREMENT ei_reac_uc "Ebene 3 irreversibles Fehlerbit fuer UFREAC aus BT" UBYTE B_TRUE 1 100 0 1 BIT_MASK 0x1 FORMAT "%13.11" ECU_ADDRESS 0x3FBED0 /end MEASUREMENT
/begin MEASUREMENT ei_rkc_uc "irreversibles Fehlerbit der Lambda Plausibilisierung im BT" UBYTE B_TRUE 1 100 0 1 BIT_MASK 0x1 FORMAT "%13.11" ECU_ADDRESS 0x3FBEBF /end MEASUREMENT
/begin MEASUREMENT ei_sgsc_uc "irreversibles Fehlerbit bei der SGS-‹berwachung im Befehlstest" UBYTE B_TRUE 1 100 0 1 BIT_MASK 0x1 FORMAT "%13.11" ECU_ADDRESS 0x3FBECD /end MEASUREMENT
/begin MEASUREMENT errorCntTcsort "" UBYTE dez 1 100 0 255 FORMAT "%5.1" ECU_ADDRESS 0x402874 /end MEASUREMENT
/begin MEASUREMENT etafrks_uc "Wirkungsgrad wegen Aufteilungsfaktor zw. 1. und 2. Einspritzung im BT" UBYTE rel_ub_b127p5 1 100 0 127.5 FORMAT "%5.1" ECU_ADDRESS 0x403AAA /end MEASUREMENT
/begin MEASUREMENT etafrks_um "Wirkungsgrad wegen Aufteilungsfaktor zw. 1. und 2. Einspritzung" UBYTE rel_ub_b127p5 1 100 0 127.5 FORMAT "%5.1" ECU_ADDRESS 0x3F99E5 /end MEASUREMENT
/begin MEASUREMENT etate "Motorwirkungsgrad bei Tankentl¸ftung mit hoher Beladung" UBYTE rel_ub_b127p5 1 100 0 127.5 FORMAT "%5.1" ECU_ADDRESS 0x403670 /end MEASUREMENT
/begin MEASUREMENT etateint "Integrator Motrwirkungsgrad bei Tankentl¸ftung" UBYTE rel_ub_b127p5 1 100 0 127.5 FORMAT "%5.1" ECU_ADDRESS 0x403671 /end MEASUREMENT
/begin MEASUREMENT etatesol "beladungsabh‰ngiger Soll-Motorwirkungsgrad bei Betrieb mit Tankentl¸ftung" UBYTE rel_ub_b127p5 1 100 0 127.5 FORMAT "%5.1" ECU_ADDRESS 0x403672 /end MEASUREMENT
/begin MEASUREMENT etazw_uc "Ist-Z¸ndwinkelwirkungsgrad im Befehlstest" UBYTE rel_ub_b127p5 1 100 0 127.5 FORMAT "%5.1" ECU_ADDRESS 0x403AAB /end MEASUREMENT
/begin MEASUREMENT etazw_um "Ist-Z¸ndwinkelwirkungsgrad in der Funktions¸berwachung" UBYTE rel_ub_b127p5 1 100 0 127.5 FORMAT "%5.1" ECU_ADDRESS 0x3F99E6 /end MEASUREMENT
/begin MEASUREMENT evhbi2_w "Istwert Hubverstellung Bank2. ‹bergabe an ‹berwachung" UWORD wink_uw_q0p1 1 100 0 6553.5 FORMAT "%8.3" ECU_ADDRESS 0x40462E /end MEASUREMENT
/begin MEASUREMENT evhbi_w "Istwert Hubverstellung. ‹bergabe an ‹berwachung" UWORD wink_uw_q0p1 1 100 0 6553.5 FORMAT "%8.3" ECU_ADDRESS 0x404630 /end MEASUREMENT
/begin MEASUREMENT evzaust_bt "" UBYTE dez 1 100 0 255 FORMAT "%5.1" ECU_ADDRESS 0x403AA1 /end MEASUREMENT
/begin MEASUREMENT E_disasch "Fehlerflag" UBYTE dez 1 100 0 255 FORMAT "%5.1" ECU_ADDRESS 0x4035A0 /end MEASUREMENT
/begin MEASUREMENT fbetate "gew¸nschter Motorwirkungsgrad als f(nmot) bei TE zur Vermeidung von te <= TEMIN" UBYTE fak_ub_b1 1 100 0 0.996094 ECU_ADDRESS 0x403673 /end MEASUREMENT
/begin MEASUREMENT fbkate "Faktor Kraftstoffanteil Tankentl¸ftung abh‰ngig von te / TEMIN" UBYTE fak_ub_b1 1 100 0 0.996094 ECU_ADDRESS 0x403D19 /end MEASUREMENT
/begin MEASUREMENT fgrbh_um "abgesicherte FGR-Bedienhebel-Rohinformation vom SZL-SG" UBYTE dez 1 100 0 255 FORMAT "%5.1" ECU_ADDRESS 0x3FA3BC /end MEASUREMENT
/begin MEASUREMENT fgre_c_um "Fehlerz‰hler: Botschaftsabsicherung FGR-Botschaft" UBYTE dez 1 100 0 255 FORMAT "%5.1" ECU_ADDRESS 0x3F98E3 /end MEASUREMENT
/begin MEASUREMENT fgre_c_ur "Doppelablage (DA) f¸r FGRE_C_UM" UBYTE dez 1 100 0 255 FORMAT "%5.1" ECU_ADDRESS 0x3F99CB /end MEASUREMENT
/begin MEASUREMENT fgr_c_um "Entprellz‰hler FGR-Freigabe" UBYTE t20ms_ub_b5100 1 100 0 5100 ECU_ADDRESS 0x3F98E4 /end MEASUREMENT
/begin MEASUREMENT fgr_c_ur "Doppelablage (DA) f¸r FGR_C_UM" UBYTE dez 1 100 0 255 FORMAT "%5.1" ECU_ADDRESS 0x3F99CC /end MEASUREMENT
/begin MEASUREMENT fgwrte "Eingriff Grenzwertregelung Tankentl¸ftung" SBYTE fak_sb_b16 1 100 -16 15.875 FORMAT "%5.2" ECU_ADDRESS 0x403674 /end MEASUREMENT
/begin MEASUREMENT fkateapp "Faktor applizierter Krafstoffanteil Tankentl¸ftung" SBYTE fak_sb_b1 1 100 -1 0.992188 FORMAT "%5.3" ECU_ADDRESS 0x403675 /end MEASUREMENT
/begin MEASUREMENT fkatefrg "Faktor Kraftstoffanteil Tankentl¸ftung bei Sollsp¸lrate" SBYTE fak_sb_b1 1 100 -1 0.992188 FORMAT "%5.3" ECU_ADDRESS 0x403D1A /end MEASUREMENT
/begin MEASUREMENT fkatei "Faktor Kraftstoffanteil Tankentl¸ftung (aktueller Istwert)" SBYTE fak_sb_b1 1 100 -1 0.992188 FORMAT "%5.3" ECU_ADDRESS 0x403D1B /end MEASUREMENT
/begin MEASUREMENT fkates "Faktor Kraftstoffanteil Tankentl¸ftung (Sollwert)" SBYTE fak_sb_b1 1 100 -1 0.992188 FORMAT "%5.3" ECU_ADDRESS 0x403676 /end MEASUREMENT
/begin MEASUREMENT fngwrte "Faktor Regelung Sp¸lrate nach Grenzwertregeleingriff" SBYTE fak_sb_b16 1 100 -16 15.875 FORMAT "%5.2" ECU_ADDRESS 0x403D1C /end MEASUREMENT
/begin MEASUREMENT frdter_w "Faktor Regelung Referenz f¸r TE-Diagnose" UWORD dez 1 100 0 65535 FORMAT "%8.2" ECU_ADDRESS 0x4035A2 /end MEASUREMENT
/begin MEASUREMENT fregfte "Faktor Regelung Sp¸lrate vor Grenzwertregeleingriff" SBYTE fak_sb_b16 1 100 -16 15.875 FORMAT "%5.2" ECU_ADDRESS 0x403D1D /end MEASUREMENT
/begin MEASUREMENT frksch_uc "FRKSCH_UM im Befehlstest" UBYTE fak_ub_b1 1 100 0 0.996094 ECU_ADDRESS 0x3F9902 /end MEASUREMENT
/begin MEASUREMENT frmit "Bei Stereo-LR: Mittelwert des fr,fr2 oder bei Ausfall einer Bank: fr der i.O. Bk" UBYTE fak_ub_b2 1 100 0 1.99219 FORMAT "%5.3" ECU_ADDRESS 0x403D1E /end MEASUREMENT
/begin MEASUREMENT frmit_w "Mittelwert aus fr und fr2 (16 bit)" UWORD fak_uw_b2 1 100 0 1.99997 FORMAT "%8.6" ECU_ADDRESS 0x40432A /end MEASUREMENT
/begin MEASUREMENT frmxa "fr-Max-Auschlag: Bei Stereo-LR: der fr, der am weitesten von 1.0 entfernt" UBYTE fak_ub_b2 1 100 0 1.99219 FORMAT "%5.3" ECU_ADDRESS 0x403D1F /end MEASUREMENT
/begin MEASUREMENT frmxaold_w "Mittelwert Lambdaregler - alter Wert (16 bit)" UWORD fak_uw_b2 1 100 0 1.99997 FORMAT "%8.6" ECU_ADDRESS 0x40432C /end MEASUREMENT
/begin MEASUREMENT frmxa_w "fr-Max-Ausschlag: Bei Stereo LR der fr, der am weitesten von 1.0 weg (16 bit)" UWORD fak_uw_b2 1 100 0 1.99997 FORMAT "%8.6" ECU_ADDRESS 0x40432E /end MEASUREMENT
/begin MEASUREMENT ftadmste "Bewrtungsfaktor f¸r Absteuern des TEV bei dynamischer Vorg‰nge" UBYTE fak_ub_b2 1 100 0 1.99219 FORMAT "%5.3" ECU_ADDRESS 0x403D20 /end MEASUREMENT
/begin MEASUREMENT fteadf "gefilteter Faktor Tankentl¸ftungs-Adaption" SBYTE fak_sb_q0p5 1 100 -64 63.5 FORMAT "%5.2" ECU_ADDRESS 0x403677 /end MEASUREMENT
/begin MEASUREMENT fteadf_w "gefilteter Faktor Tankentl¸ftungs-Adaption" SWORD fak_q0p00195 1 100 -64 63.998 FORMAT "%8.5" ECU_ADDRESS 0x40367C /end MEASUREMENT
/begin MEASUREMENT fteadmod_w "ftead-Modell zur TE-Differenzdrucksteuerung" SWORD fak_sw_b64 1 100 -64 63.998 FORMAT "%8.5" ECU_ADDRESS 0x40367E /end MEASUREMENT
/begin MEASUREMENT ftead_w "Faktor Tankentl¸ftungs-Adaption" SWORD fak_sw_b64 1 100 -64 63.998 FORMAT "%8.5" ECU_ADDRESS 0x403680 /end MEASUREMENT
/begin MEASUREMENT ftefsold_w "Letzter Sollwert der Sp¸lrate Tankentl¸ftung vor Absteuerung" UWORD fak_uw_b0p5 1 100 0 0.499992 FORMAT "%9.7" ECU_ADDRESS 0x404330 /end MEASUREMENT
/begin MEASUREMENT ftefsoll_w "Sollwert der Sp¸lrate Tankentl¸ftung" UWORD fak_uw_b0p5 1 100 0 0.499992 FORMAT "%9.7" ECU_ADDRESS 0x404332 /end MEASUREMENT
/begin MEASUREMENT ftefva "Sp¸lrate der Tankentl¸ftung" UBYTE fak_ub_b0p5 1 100 0 0.498047 ECU_ADDRESS 0x403D21 /end MEASUREMENT
/begin MEASUREMENT ftefvab "Begrenzungswert der Sp¸lrate Tankentl¸ftung" UBYTE fak_ub_b0p03125 1 100 0 0.0311279 FORMAT "%7.5" ECU_ADDRESS 0x403678 /end MEASUREMENT
/begin MEASUREMENT ftefvamx_w "max. Sp¸lrate (Begrenzung absolut, 16 bit)" UWORD fak_uw_b0p5 1 100 0 0.499992 FORMAT "%9.7" ECU_ADDRESS 0x404334 /end MEASUREMENT
/begin MEASUREMENT ftefva_w "Sp¸lrate Tankentl¸ftung" UWORD fak_uw_b0p5 1 100 0 0.499992 FORMAT "%9.7" ECU_ADDRESS 0x404336 /end MEASUREMENT
/begin MEASUREMENT fteml "Aufsteuergeschwindigkeit der Sp¸lrate und des Massenstroms TEV" SWORD perio_ub_b0p012207 1 100 -1.5625 1.56245 ECU_ADDRESS 0x403682 /end MEASUREMENT
/begin MEASUREMENT fuel_co_bt "" ULONG dez 1 100 0 4.29497e+009 FORMAT "%13.2" ECU_ADDRESS 0x40489C /end MEASUREMENT
/begin MEASUREMENT fuel_co_uc "Um ein Abarbeitungsraster verzˆgerte (alte) Einspritzzeit im Befehlstest" ULONG dez 1 100 0 4.29497e+009 FORMAT "%13.2" ECU_ADDRESS 0x4048A0 /end MEASUREMENT
/begin MEASUREMENT fukaba_w "‹K-Adaptions-Faktor BA" UWORD fak_uw_b4 1 100 0 3.99994 FORMAT "%8.6" ECU_ADDRESS 0x4035B0 /end MEASUREMENT
/begin MEASUREMENT fukava_w "‹K-Adaptions-Faktor VA" UWORD fak_uw_b4 1 100 0 3.99994 FORMAT "%8.6" ECU_ADDRESS 0x4035B2 /end MEASUREMENT
/begin MEASUREMENT fvermte_w "Faktor Vermischung Regeneriergas im Saugrohr" UWORD fak_uw_b1 1 100 0 0.999985 FORMAT "%9.7" ECU_ADDRESS 0x404338 /end MEASUREMENT
/begin MEASUREMENT geli_dflim2 "" UBYTE rel_ub_b100 1 100 0 255.078 FORMAT "%5.1" ECU_ADDRESS 0x4039B6 /end MEASUREMENT
/begin MEASUREMENT gwrtectr "Z‰hler f¸r frmit abh‰ngige Grenzwertverechnung" UWORD dez 1 100 0 65535 FORMAT "%8.2" ECU_ADDRESS 0x40433A /end MEASUREMENT
/begin MEASUREMENT hsh2tim "Zeitzaehler Bauteileansteuerung LS hinter KAT Bank 2" UBYTE dez 1 100 0 255 FORMAT "%5.1" ECU_ADDRESS 0x403C8B /end MEASUREMENT
/begin MEASUREMENT hshtim "Zeitzaehler Bauteileansteuerung LS hinter KAT" UBYTE dez 1 100 0 255 FORMAT "%5.1" ECU_ADDRESS 0x403C8C /end MEASUREMENT
/begin MEASUREMENT hsv2tim "Zeitzaehler Bauteileansteuerung LS vor KAT Bank 2" UBYTE dez 1 100 0 255 FORMAT "%5.1" ECU_ADDRESS 0x403C8D /end MEASUREMENT
/begin MEASUREMENT hsvtim "Zeitzaehler Bauteileansteuerung LS vor KAT" UBYTE dez 1 100 0 255 FORMAT "%5.1" ECU_ADDRESS 0x403C8E /end MEASUREMENT
/begin MEASUREMENT igenmess "gemessener Generatorstrom" UWORD dez 1 100 0 65535 FORMAT "%8.2" ECU_ADDRESS 0x4042D8 /end MEASUREMENT
/begin MEASUREMENT imsteini "Integral Massenstrom TEV nach l‰ngerem TE-Stop" UBYTE m_ub_q0p0444 1 100 0 11.322 FORMAT "%5.2" ECU_ADDRESS 0x403679 /end MEASUREMENT
/begin MEASUREMENT inisynmon "Monitor-Array mit Gr¸nden der letzten Anforderung einer Neusynchronisation" UWORD dez 1 100 0 65535 FORMAT "%8.2" ARRAY_SIZE 2 ECU_ADDRESS 0x404762 /end MEASUREMENT
/begin MEASUREMENT iprefanf "Referenzpumpstrom LSU" UBYTE dez 1 100 0 255 FORMAT "%5.1" ECU_ADDRESS 0x4035C6 /end MEASUREMENT
/begin MEASUREMENT iprefanf2 "Referenzpumpstrom LSU 2" UBYTE dez 1 100 0 255 FORMAT "%5.1" ECU_ADDRESS 0x4035C7 /end MEASUREMENT
/begin MEASUREMENT khc_w "Adaptierte HC-Konzentration Regenerierstrom" SWORD fak_sw_b2 1 100 -2 1.99994 FORMAT "%8.6" ECU_ADDRESS 0x403684 /end MEASUREMENT
/begin MEASUREMENT kopwm "Klimakompressor-Signal als PWM-Signal" UBYTE rel_ub_b99p6 1 100 0 99.6094 FORMAT "%5.2" ECU_ADDRESS 0x4035A4 /end MEASUREMENT
/begin MEASUREMENT kstaa "Aktueller Startmengenadaptionsfaktor" UBYTE fak_ub_b2 1 100 0 1.99219 FORMAT "%5.3" ECU_ADDRESS 0x4035A5 /end MEASUREMENT
/begin MEASUREMENT kteev_w "Konzentration Regeneriergas im Saugrohr auf Hˆhe der Einspritzventile" UWORD fak_uw_b1 1 100 0 0.999985 FORMAT "%9.7" ECU_ADDRESS 0x40433C /end MEASUREMENT
/begin MEASUREMENT ktetevvz_w "Konzentration Regeneriergas im Saugrohr verzˆgert" UWORD fak_uw_b1 1 100 0 0.999985 FORMAT "%9.7" ECU_ADDRESS 0x40433E /end MEASUREMENT
/begin MEASUREMENT ktetev_w "Konzentration Regeneriergas im Saugrohr auf Hˆhe vom TEV" UWORD fak_uw_b1 1 100 0 0.999985 FORMAT "%9.7" ECU_ADDRESS 0x404340 /end MEASUREMENT
/begin MEASUREMENT lamb1_uc "Lambdawert im Brennraum bei Lambdasplit (1.Bank) im Befehlstest" UBYTE fak_ub_b8 1 100 0 7.96875 FORMAT "%5.3" ECU_ADDRESS 0x403AAC /end MEASUREMENT
/begin MEASUREMENT lamb2_uc "Lambdawert im Brennraum bei Lambdasplit (2.Bank) im Befehlstest" UBYTE fak_ub_b8 1 100 0 7.96875 FORMAT "%5.3" ECU_ADDRESS 0x403AAD /end MEASUREMENT
/begin MEASUREMENT lamsbrs2_w "Soll-Lambda-Brennraum bezogen auf die Einbauort der Sonde (Bank 2)" UWORD fak_uw_b16 1 100 0 15.9998 FORMAT "%8.5" ECU_ADDRESS 0x4042DA /end MEASUREMENT
/begin MEASUREMENT lamsbrs_w "Soll-Lambda-Brennraum bezogen auf die Einbauort der Sonde" UWORD fak_uw_b16 1 100 0 15.9998 FORMAT "%8.5" ECU_ADDRESS 0x4042DC /end MEASUREMENT
/begin MEASUREMENT lsunpstat "Statusbyte: Teilpr¸fungserkennung f¸r Plausibilit‰tsfehler" UBYTE dez 1 100 0 255 FORMAT "%5.1" ECU_ADDRESS 0x4035C8 /end MEASUREMENT
/begin MEASUREMENT lsunpstat2 "Statusbyte: Teilpr¸fungserkennung f¸r Plausibilit‰tsfehler, Bank 2" UBYTE dez 1 100 0 255 FORMAT "%5.1" ECU_ADDRESS 0x4035C9 /end MEASUREMENT
/begin MEASUREMENT m6cddmtl "Mode 6 - Speicher: Component ID f¸r DM-TL Tankleckdiagnose" UBYTE DEZ 1 100 0 255 FORMAT "%5.1" ECU_ADDRESS 0x4035CA /end MEASUREMENT
/begin MEASUREMENT m6sddmtl_w "Mode 6 - Speicher: Schwellwert bei DM-TL Tankleckdiagnose" UBYTE DEZ 1 100 0 255 FORMAT "%5.1" ECU_ADDRESS 0x4035CB /end MEASUREMENT
/begin MEASUREMENT m6wddmtl_w "Mode 6 - Speicher: Messwert DM-TL Tankleckdiagnose" UBYTE DEZ 1 100 0 255 FORMAT "%5.1" ECU_ADDRESS 0x4035CC /end MEASUREMENT
/begin MEASUREMENT mdif_w_uc "Differenz zwischen zul‰ssigem und Ist-Moment im Befehlstest" SWORD rel_ub_b99p6 1 100 -12800 12799.6 FORMAT "%8.2" ECU_ADDRESS 0x403D82 /end MEASUREMENT
/begin MEASUREMENT mdif_w_um "Differenz zwischen zul‰ssigem und Ist-Moment in der Funktions¸berwachung" SWORD rel_ub_b99p6 1 100 -12800 12799.6 FORMAT "%8.2" ECU_ADDRESS 0x3F99EE /end MEASUREMENT
/begin MEASUREMENT mdkomx "Begrenzungsmoment Klimakompressor" UBYTE md_q0p5 1 100 0 127.5 FORMAT "%5.1" ECU_ADDRESS 0x4035CD /end MEASUREMENT
/begin MEASUREMENT mdslw_w "Verlustmoment: Ladungswechsel" UWORD rel_uw_b100 1 100 0 99.9985 FORMAT "%8.5" ECU_ADDRESS 0x4042DE /end MEASUREMENT
/begin MEASUREMENT mdst08_uc "" ULONG dez 1 100 0 4.29497e+009 FORMAT "%13.2" ECU_ADDRESS 0x4048A8 /end MEASUREMENT
/begin MEASUREMENT mdvervf_w "ungefiltertes Verlustmoment" UWORD rel_uw_b100 1 100 0 99.9985 FORMAT "%8.5" ECU_ADDRESS 0x4042E0 /end MEASUREMENT
/begin MEASUREMENT mfgr_uc "Momentenwunsch aus der Fahrgeschwindigkeitsregelung im Befehlstest" UBYTE rel_ub_b99p6 1 100 0 99.6094 FORMAT "%5.2" ECU_ADDRESS 0x403A86 /end MEASUREMENT
/begin MEASUREMENT mfgr_um "Momentenwunsch aus der Fahrgeschwindigkeitsregelung f¸r die Funktions¸berwachung" UBYTE rel_ub_b99p6 1 100 0 99.6094 FORMAT "%5.2" ECU_ADDRESS 0x3F98D3 /end MEASUREMENT
/begin MEASUREMENT mfgr_ur "Doppelablage (DA) f¸r MFGR_UM" UBYTE dez 1 100 0 255 FORMAT "%5.1" ECU_ADDRESS 0x3F99C4 /end MEASUREMENT
/begin MEASUREMENT miasrl_uc "ASR-Momentenvorgabe f¸r Eingriff ¸ber Luftpfad im Befehlstest" UBYTE rel_ub_b99p6 1 100 0 99.6094 FORMAT "%5.2" ECU_ADDRESS 0x403D6C /end MEASUREMENT
/begin MEASUREMENT miasrl_um "ASR-Momentenvorgabe f¸r Eingriff ¸ber Luftpfad in der Funktions¸berwachung" UBYTE rel_ub_b99p6 1 100 0 99.6094 FORMAT "%5.2" ECU_ADDRESS 0x3FA3BF /end MEASUREMENT
/begin MEASUREMENT miasrs_uc "ASR-Momentenvorgabe f¸r schnellen Eingriff im Befehlstest" UBYTE rel_ub_b99p6 1 100 0 99.6094 FORMAT "%5.2" ECU_ADDRESS 0x403D6D /end MEASUREMENT
/begin MEASUREMENT miasrs_um "ASR-Momentenvorgabe f¸r schnellen Eingriff in der Funktions¸berwachung" UBYTE rel_ub_b99p6 1 100 0 99.6094 FORMAT "%5.2" ECU_ADDRESS 0x3FA3C0 /end MEASUREMENT
/begin MEASUREMENT mifa_bt "Indiziertes Fahrerwunschmoment im Befehlstest" UBYTE rel_ub_b99p6 1 100 0 99.6094 FORMAT "%5.2" ECU_ADDRESS 0x403A87 /end MEASUREMENT
/begin MEASUREMENT mimsrcpl_bt "" UBYTE dez 1 100 0 255 FORMAT "%5.1" ECU_ADDRESS 0x403A8C /end MEASUREMENT
/begin MEASUREMENT mimsr_bt "Indiziertes Soll-Motormoment MSR im Befehlstest" UBYTE rel_ub_b99p6 1 100 0 99.6094 FORMAT "%5.2" ECU_ADDRESS 0x403A8D /end MEASUREMENT
/begin MEASUREMENT mimsr_uc "Indiziertes Soll-Motormoment MSR aus CAN-Botschaft im Befehlstest" UBYTE rel_ub_b99p6 1 100 0 99.6094 FORMAT "%5.2" ECU_ADDRESS 0x403A8E /end MEASUREMENT
/begin MEASUREMENT mimsr_um "Indiziertes Soll Motormoment MSR" UBYTE rel_ub_b99p6 1 100 0 99.6094 FORMAT "%5.2" ECU_ADDRESS 0x3FA3C1 /end MEASUREMENT
/begin MEASUREMENT mims_w "indiziertes Motormoment zum Motorschutz" UWORD rel_uw_b100 1 100 0 99.9985 FORMAT "%8.5" ECU_ADDRESS 0x4042E2 /end MEASUREMENT
/begin MEASUREMENT miopt_uc "optimales indiziertes Moment im Befehlstest" UBYTE rel_ub_b99p6 1 100 0 99.6094 FORMAT "%5.2" ECU_ADDRESS 0x403AAE /end MEASUREMENT
/begin MEASUREMENT miopt_um "optimales indiziertes Moment in der Funktions¸berwachung" UBYTE rel_ub_b99p6 1 100 0 99.6094 FORMAT "%5.2" ECU_ADDRESS 0x3F99E7 /end MEASUREMENT
/begin MEASUREMENT misgscpl_bt "" UBYTE dez 1 100 0 255 FORMAT "%5.1" ECU_ADDRESS 0x403A97 /end MEASUREMENT
/begin MEASUREMENT misgs_bt "Indiziertes Sollmoment von SGS im Befehelstest" UBYTE rel_ub_b99p6 1 100 0 99.6094 FORMAT "%5.2" ECU_ADDRESS 0x403A98 /end MEASUREMENT
/begin MEASUREMENT mistt "Startmoment" UBYTE rel_ub_b99p6 1 100 0 99.6094 FORMAT "%5.2" ECU_ADDRESS 0x403CB5 /end MEASUREMENT
/begin MEASUREMENT mitebg_w "Momentvorgabe f¸r Mindestf¸llung Tankentl¸ftung" UWORD rel_uw_b100 1 100 0 99.9985 FORMAT "%8.5" ECU_ADDRESS 0x404342 /end MEASUREMENT
/begin MEASUREMENT mizsolv_u "Indiziertes resultierendes Sollmoment f¸r ZW-Eingriff vor Momentenbegrenzung" UBYTE rel_ub_b100 1 100 0 99.6094 FORMAT "%5.2" ECU_ADDRESS 0x4039B7 /end MEASUREMENT
/begin MEASUREMENT mi_uc "Berechnetes Ist-Moment im Befehlstest" UBYTE rel_ub_b99p6 1 100 0 99.6094 FORMAT "%5.2" ECU_ADDRESS 0x403AAF /end MEASUREMENT
/begin MEASUREMENT mi_um "Berechnetes Ist-Moment in der Funktions¸berwachung" UBYTE rel_ub_b99p6 1 100 0 99.6094 FORMAT "%5.2" ECU_ADDRESS 0x3F9901 /end MEASUREMENT
/begin MEASUREMENT mi_ur "Doppelablage (DA) f¸r MI_UM" UBYTE dez 1 100 0 255 FORMAT "%5.1" ECU_ADDRESS 0x3F99E8 /end MEASUREMENT
/begin MEASUREMENT mkpracc_um "Momentenverstellbereich positiv vom ACC (Soll-Kupplungsmoment)" SWORD md_q0p5 1 100 -16384 16383.5 FORMAT "%8.2" ECU_ADDRESS 0x3FA3B8 /end MEASUREMENT
/begin MEASUREMENT mksacc_um "Momentenanforderung vom ACC (Soll-Kupplungsmoment)" SWORD md_q0p5 1 100 -16384 16383.5 FORMAT "%8.2" ECU_ADDRESS 0x3FA3BA /end MEASUREMENT
/begin MEASUREMENT mksasrl_uc "Momentenanforderung vom DSC, langsammer Eingriff im Befehlstest" SWORD md_q0p5 1 100 -16384 16383.5 FORMAT "%8.2" ECU_ADDRESS 0x403D6E /end MEASUREMENT
/begin MEASUREMENT mksasrl_um "Momentenanforderung vom DSC, langsammer Eingriff  (Soll-Kupplungsmoment)" SWORD md_q0p5 1 100 -16384 16383.5 FORMAT "%8.2" ECU_ADDRESS 0x3FA3C2 /end MEASUREMENT
/begin MEASUREMENT mksasrs_uc "Momentenanforderung vom DSC, schneller Eingriff im Befehlstest" SWORD md_q0p5 1 100 -16384 16383.5 FORMAT "%8.2" ECU_ADDRESS 0x403D70 /end MEASUREMENT
/begin MEASUREMENT mksasrs_um "Momentenanforderung vom DSC, schneller Eingriff  (Soll-Kupplungsmoment)" SWORD md_q0p5 1 100 -16384 16383.5 FORMAT "%8.2" ECU_ADDRESS 0x3FA3C4 /end MEASUREMENT
/begin MEASUREMENT mksges_uc "SGS-Kupplungsmoment Getriebeschutz aus Befehlstest" SWORD md_q0p5 1 100 -16384 16383.5 FORMAT "%8.2" ECU_ADDRESS 0x403D74 /end MEASUREMENT
/begin MEASUREMENT mksgs_uc "SGS-Kupplungsmoment aus Befehlstest" SWORD md_q0p5 1 100 -16384 16383.5 FORMAT "%8.2" ECU_ADDRESS 0x403D76 /end MEASUREMENT
/begin MEASUREMENT mkswand_uc "SGS-Kupplungsmoment Aufnahmemoment des Wandlers aus Befehlstest" UBYTE md_q0p5 1 100 0 127.5 FORMAT "%5.1" ECU_ADDRESS 0x403A99 /end MEASUREMENT
/begin MEASUREMENT ml_w_teb "" SWORD m_uw_b6553p5 1 100 0 3276.7 FORMAT "%8.3" ECU_ADDRESS 0x404840 /end MEASUREMENT
/begin MEASUREMENT mmsr_uc "zul‰ssiger MSR-Momentenwunsch f¸r die Funktions¸berwachung" UBYTE rel_ub_b99p6 1 100 0 99.6094 FORMAT "%5.2" ECU_ADDRESS 0x403A8F /end MEASUREMENT
/begin MEASUREMENT mmsr_um "zul‰ssiger MSR-Momentenwunsch f¸r die Funktions¸berwachung" UBYTE rel_ub_b99p6 1 100 0 99.6094 FORMAT "%5.2" ECU_ADDRESS 0x3F98EB /end MEASUREMENT
/begin MEASUREMENT mmsr_ur "Doppelablage (DA) f¸r MMSR_UM" UBYTE dez 1 100 0 255 FORMAT "%5.1" ECU_ADDRESS 0x3F99CF /end MEASUREMENT
/begin MEASUREMENT mnhubfte_w "Faktor Ein-/Ausblendung Teildrosselung f¸r TE" UWORD fak_uw_b4 1 100 0 3.99994 FORMAT "%8.6" ECU_ADDRESS 0x404344 /end MEASUREMENT
/begin MEASUREMENT mped_uc "zul‰ssiges indiziertes Moment aus Fahrpedal im Befehlstest" UBYTE rel_ub_b99p6 1 100 0 99.6094 FORMAT "%5.2" ECU_ADDRESS 0x403AC4 /end MEASUREMENT
/begin MEASUREMENT mrlini_uc "zul. Momentes bei Umschaltung der ‹berw. auf Luftmasse zur Initialsierung im BT" UBYTE rel_ub_b99p6 1 100 0 99.6094 FORMAT "%5.2" ECU_ADDRESS 0x403A7F /end MEASUREMENT
/begin MEASUREMENT mrstt_w "relatives Startmoment" UWORD rel_uw_b200 1 100 0 199.997 FORMAT "%8.4" ECU_ADDRESS 0x404152 /end MEASUREMENT
/begin MEASUREMENT msgs_uc "Soll- Motormoment aus Getriebe¸berwachung im Befehlstest" UBYTE rel_ub_b99p6 1 100 0 99.6094 FORMAT "%5.2" ECU_ADDRESS 0x403A9A /end MEASUREMENT
/begin MEASUREMENT msntetev_w "normierter, ¸berkritischer Massenstrom durch das TEV" UWORD m_uw_b25p6 1 100 0 25.5996 FORMAT "%8.5" ECU_ADDRESS 0x404826 /end MEASUREMENT
/begin MEASUREMENT msrc_c_uc "Fehlerz‰hler f¸r MSR-‹berwachung des Befehlstestes" UBYTE t20ms_ub_b5100 1 100 0 5100 ECU_ADDRESS 0x403A90 /end MEASUREMENT
/begin MEASUREMENT msrc_c_um "Fehlerz‰hler f¸r MSR-Eingriff-‹berwachung der Funktions¸berwachung" UBYTE t20ms_ub_b5100 1 100 0 5100 ECU_ADDRESS 0x3F98EC /end MEASUREMENT
/begin MEASUREMENT msrc_c_ur "Doppelablage (DA) f¸r MSRC_C_UM" UBYTE dez 1 100 0 255 FORMAT "%5.1" ECU_ADDRESS 0x3F99D0 /end MEASUREMENT
/begin MEASUREMENT mssginmn_w "Minmaler ins Saugrohr strˆmender Massenstrom (Drosselklappe + TEV)" UWORD m_uw_b6553p5 1 100 0 6553.5 FORMAT "%8.3" ECU_ADDRESS 0x404346 /end MEASUREMENT
/begin MEASUREMENT mssgin_w "Ins Saugrohr strˆmender Massenstrom (Drosselklappe + TEV)" UWORD m_uw_b6553p5 1 100 0 6553.5 FORMAT "%8.3" ECU_ADDRESS 0x404348 /end MEASUREMENT
/begin MEASUREMENT mssp_w "Massenstrom ¸ber das Ventil der Saugstrahlpumpe" UWORD m_uw_b25p6 1 100 0 25.5996 FORMAT "%8.5" ECU_ADDRESS 0x4035B4 /end MEASUREMENT
/begin MEASUREMENT msteev_w "Massenstrom Regeneriergas auf Hˆhe Einspritzventil" UWORD m_uw_b25p6 1 100 0 25.5996 FORMAT "%8.5" ECU_ADDRESS 0x40434A /end MEASUREMENT
/begin MEASUREMENT mstesmx_w "Maximal mˆglicher Sollmassenstrom Tankentl¸ftung" UWORD m_uw_b25p6 1 100 0 25.5996 FORMAT "%8.5" ECU_ADDRESS 0x40434C /end MEASUREMENT
/begin MEASUREMENT mstesoll_w "Massenstrom Tankentl¸ftung ins Saugrohr, Sollwert" UWORD m_uw_b25p6 1 100 0 25.5996 FORMAT "%8.5" ECU_ADDRESS 0x40434E /end MEASUREMENT
/begin MEASUREMENT mver_c_uc "Fehlerz‰hler f¸r Momentenvergleich im Befehlstest" UBYTE t40ms_ub_b10200 1 100 0 10200 FORMAT "%7.1" ECU_ADDRESS 0x403AB5 /end MEASUREMENT
/begin MEASUREMENT mver_c_um "Fehlerz‰hler f¸r Momentenvergleich der Funktions¸berwachung" UBYTE t40ms_ub_b10200 1 100 0 10200 FORMAT "%7.1" ECU_ADDRESS 0x3F9904 /end MEASUREMENT
/begin MEASUREMENT mver_c_ur "Doppelablage (DA) f¸r MVER_C_UM" UBYTE dez 1 100 0 255 FORMAT "%5.1" ECU_ADDRESS 0x3F99EC /end MEASUREMENT
/begin MEASUREMENT mzfo_uc "Gefiltertes zul‰ssiges Moment inclusive Offset im Befehlstest" UBYTE rel_ub_b99p6 1 100 0 99.6094 FORMAT "%5.2" ECU_ADDRESS 0x403AB6 /end MEASUREMENT
/begin MEASUREMENT mzfo_um "gefiltertes zul‰ssiges Moment inclusive Offset in der Funktions¸berwachung" UBYTE rel_ub_b99p6 1 100 0 99.6094 FORMAT "%5.2" ECU_ADDRESS 0x3F99ED /end MEASUREMENT
/begin MEASUREMENT mzf_l_uc "Nachkommastellen f¸r gefiltertes zul‰ssiges Moment des Befehlstestes" UBYTE rel_ub_q0p00153 1 100 0 0.389074 ECU_ADDRESS 0x403AB7 /end MEASUREMENT
/begin MEASUREMENT mzf_l_um "Nachkommastellen f¸r gefiltertes zul‰ssiges Moment der Funktions¸berwachung" UBYTE rel_ub_q0p00153 1 100 0 0.389074 ECU_ADDRESS 0x3F9905 /end MEASUREMENT
/begin MEASUREMENT mzf_l_ur "Doppelablage (DA) f¸r MZF_L_UM" UBYTE dez 1 100 0 255 FORMAT "%5.1" ECU_ADDRESS 0x3F99F0 /end MEASUREMENT
/begin MEASUREMENT mzf_p_uc "Zeiger des Schieberegisters f¸r Verzugszeit mzf_r_ur im Momentenfilter des BT" UBYTE dez 1 100 0 255 FORMAT "%5.1" ECU_ADDRESS 0x403AB8 /end MEASUREMENT
/begin MEASUREMENT mzf_p_um "Zeiger des Schieberegisters f¸r Verzugszeit mzf_r_um im Momentenfilter der FU" UBYTE dez 1 100 0 255 FORMAT "%5.1" ECU_ADDRESS 0x3F9906 /end MEASUREMENT
/begin MEASUREMENT mzf_p_ur "Doppelablage (DA) f¸r MZF_P_UM" UBYTE dez 1 100 0 255 FORMAT "%5.1" ECU_ADDRESS 0x3F99F1 /end MEASUREMENT
/begin MEASUREMENT mzf_r_uc "Schieberegister f¸r Verzugszeit im Momentenfilter des Befehlstestes" UBYTE rel_ub_b99p6 1 100 0 99.6094 FORMAT "%5.2" ARRAY_SIZE 8 ECU_ADDRESS 0x403AB9 /end MEASUREMENT
/begin MEASUREMENT mzf_r_um "Schieberegister f¸r Verzugszeit im Momentenfilter der Funktions¸berwachung" UBYTE rel_ub_b99p6 1 100 0 99.6094 FORMAT "%5.2" ARRAY_SIZE 8 ECU_ADDRESS 0x3F9907 /end MEASUREMENT
/begin MEASUREMENT mzf_r_ur "Doppelablage (DA) f¸r MZF_R_UM" UBYTE dez 1 100 0 255 FORMAT "%5.1" ARRAY_SIZE 8 ECU_ADDRESS 0x3F99F2 /end MEASUREMENT
/begin MEASUREMENT mzf_uc "gefiltertes zul‰ssiges Moment im Befehlstest" UBYTE rel_ub_b99p6 1 100 0 99.6094 FORMAT "%5.2" ECU_ADDRESS 0x403AC1 /end MEASUREMENT
/begin MEASUREMENT mzf_um "gefiltertes zul‰ssiges Moment der Funktions¸berwachung" UBYTE rel_ub_b99p6 1 100 0 99.6094 FORMAT "%5.2" ECU_ADDRESS 0x3F990F /end MEASUREMENT
/begin MEASUREMENT mzf_ur "Doppelablage (DA) f¸r MZF_UM" UBYTE dez 1 100 0 255 FORMAT "%5.1" ECU_ADDRESS 0x3F99FA /end MEASUREMENT
/begin MEASUREMENT mzf_x_uc "" UBYTE dez 1 100 0 255 FORMAT "%5.1" ECU_ADDRESS 0x403AC2 /end MEASUREMENT
/begin MEASUREMENT mzf_y_uc "" UBYTE dez 1 100 0 255 FORMAT "%5.1" ECU_ADDRESS 0x403AC3 /end MEASUREMENT
/begin MEASUREMENT mzo_uc "Toleranz-Offset f¸r das zul‰ssige Moment im Befehlstest" UBYTE rel_ub_b99p6 1 100 0 99.6094 FORMAT "%5.2" ECU_ADDRESS 0x403AC5 /end MEASUREMENT
/begin MEASUREMENT mz_uc "resultierendes zul‰ssiges Moment im Befehlstest" UBYTE rel_ub_b99p6 1 100 0 99.6094 FORMAT "%5.2" ECU_ADDRESS 0x403AC6 /end MEASUREMENT
/begin MEASUREMENT nadmtll_w "Anzahl begonnener Leckmessungen" UWORD DEZ 1 100 0 65535 FORMAT "%8.2" ECU_ADDRESS 0x4035B8 /end MEASUREMENT
/begin MEASUREMENT nddpste_in "" UWORD p_q0p039s32768 1 100 -1280 1279.96 FORMAT "%7.2" ECU_ADDRESS 0x404842 /end MEASUREMENT
/begin MEASUREMENT nmot_uc "Motordrehzahl im Befehlstest" UBYTE nmot_ub_q40 1 100 0 10200 FORMAT "%5.0" ECU_ADDRESS 0x403AC7 /end MEASUREMENT
/begin MEASUREMENT nmst08_uc "" ULONG dez 1 100 0 4.29497e+009 FORMAT "%13.2" ECU_ADDRESS 0x4048AC /end MEASUREMENT
/begin MEASUREMENT nn_w1_w "" SWORD fak_sw_b32 1 100 -32 31.999 FORMAT "%8.5" ARRAY_SIZE 3 ECU_ADDRESS 0x40478A /end MEASUREMENT
/begin MEASUREMENT nn_w2_w "" SWORD fak_sw_b32 1 100 -32 31.999 FORMAT "%8.5" ARRAY_SIZE 3 ECU_ADDRESS 0x404790 /end MEASUREMENT
/begin MEASUREMENT nsc_c_uc "Nachstart-Zeitz‰hler Nachstartaufweitung im Befehlstest" UWORD t40msxs_uw_q0p04 1 100 0 2621.4 FORMAT "%8.3" ECU_ADDRESS 0x403D7E /end MEASUREMENT
/begin MEASUREMENT nska_uc "Grenzdrehzahl bei aktiver Fehlerreaktion im Befehlstest" UBYTE nmot_ub_q40 1 100 0 10200 FORMAT "%5.0" ECU_ADDRESS 0x403AA2 /end MEASUREMENT
/begin MEASUREMENT nsolfa "Leerlaufsolldrehzahl, Funktionsanforderung Tester" UBYTE nmot_ub_q10 1 100 0 2550 FORMAT "%5.0" ECU_ADDRESS 0x403C89 /end MEASUREMENT
/begin MEASUREMENT ntglm_w "Gesamtzahl durchgefuehrte Grobleckmessungen" UWORD DEZ 1 100 0 65535 FORMAT "%8.2" ECU_ADDRESS 0x4035BA /end MEASUREMENT
/begin MEASUREMENT ntklm_w "Gesamtzahl durchgefuehrte Kleinstleckmessungen" UWORD DEZ 1 100 0 65535 FORMAT "%8.2" ECU_ADDRESS 0x4035BC /end MEASUREMENT
/begin MEASUREMENT n_flags_uc "Byte f¸r Nachstart-Bits des Befehlstestes" UBYTE dez 1 100 0 255 FORMAT "%5.1" ECU_ADDRESS 0x403A81 /end MEASUREMENT
/begin MEASUREMENT Oelnivak "Aktuelles Oelniveau korrigiert" UBYTE tog_ub_q0p5 1 100 0 127.5 FORMAT "%5.1" ECU_ADDRESS 0x4039B8 /end MEASUREMENT
/begin MEASUREMENT oelstandr "Relativer F¸llstand des Motorˆls" UBYTE rel_ub_b99p6 1 100 0 99.6094 FORMAT "%5.2" ECU_ADDRESS 0x4035CE /end MEASUREMENT
/begin MEASUREMENT ofwnktest "" SWORD wink_uw_q0p1 1 100 -3276.8 3276.7 FORMAT "%8.3" ECU_ADDRESS 0x40306A /end MEASUREMENT
/begin MEASUREMENT ofwtstber "DUMMY - noch nicht benutzt" UBYTE dez 1 100 0 255 FORMAT "%5.1" ECU_ADDRESS 0x403C8F /end MEASUREMENT
/begin MEASUREMENT pabnav2_w "Abgasdruck nach Auslaﬂentil (Bank2)" UWORD p_uw_q0p078 1 100 0 5119.92 FORMAT "%8.3" ECU_ADDRESS 0x404828 /end MEASUREMENT
/begin MEASUREMENT pabnav_w "Abgasdruck nach Auslaﬂventil" UWORD p_uw_q0p078 1 100 0 5119.92 FORMAT "%8.3" ECU_ADDRESS 0x40482A /end MEASUREMENT
/begin MEASUREMENT psagr_w "Partialdruck durch externes Restgas (Restluft+Inertgas)" UWORD p_uw_q0p039 1 100 0 2559.96 FORMAT "%8.3" ECU_ADDRESS 0x4035A6 /end MEASUREMENT
/begin MEASUREMENT psl "÷ldruck von der Servo-Lenkung" UBYTE dez 1 100 0 255 FORMAT "%5.1" ECU_ADDRESS 0x4035A8 /end MEASUREMENT
/begin MEASUREMENT pspu "Quotient Saugrohrdruck Umgebungsdruck" UBYTE fak_ub_b2 1 100 0 1.99219 FORMAT "%5.3" ECU_ADDRESS 0x403D22 /end MEASUREMENT
/begin MEASUREMENT pte "Tankdifferenzdruck, Eingangssignal, (nach AD-Wandler)" UBYTE p_sb_q32 1 100 0 63.75 FORMAT "%5.2" ECU_ADDRESS 0x4035A9 /end MEASUREMENT
/begin MEASUREMENT pwfPattern_hwpwf "" ULONG dez 1 100 0 4.29497e+009 FORMAT "%13.2" ECU_ADDRESS 0x4035C0 /end MEASUREMENT
/begin MEASUREMENT qmsdyn "Quotient aus ml_w und mssgin_w" UBYTE fak_ub_b16 1 100 0 15.9375 FORMAT "%5.2" ECU_ADDRESS 0x403D23 /end MEASUREMENT
/begin MEASUREMENT qnst_w "Drehzahlquotient im Start" UWORD fak_uw_b2 1 100 0 1.99997 FORMAT "%8.6" ECU_ADDRESS 0x404154 /end MEASUREMENT
/begin MEASUREMENT qtetemin "Quotient: te / TEMIN f¸r BDE teh_w/teminh_w bzw. tes_w/temins" UBYTE fak_ub_b4 1 100 0 3.98438 FORMAT "%5.3" ECU_ADDRESS 0x403D24 /end MEASUREMENT
/begin MEASUREMENT r5msCtr "Counter 5ms-Raster" ULONG dez 1 100 0 4.29497e+009 FORMAT "%13.2" ECU_ADDRESS 0x404C08 /end MEASUREMENT
/begin MEASUREMENT raster_um "Allgemeiner Z‰hler des 10ms Raster der Funktions¸berwachung" UWORD dez 1 100 0 65535 FORMAT "%8.2" ECU_ADDRESS 0x403D64 /end MEASUREMENT
/begin MEASUREMENT reac_c1_uc "Fehlerz‰hler 1 f¸r Fehlerreaktions¸berwachung im Befehlstest" UBYTE t40ms_ub_b10200 1 100 0 10200 FORMAT "%7.1" ECU_ADDRESS 0x403AA3 /end MEASUREMENT
/begin MEASUREMENT reac_c2_uc "Fehlerz‰hler 2 f¸r Fehlerreaktions¸berwachung im Befehlstest" UBYTE t40ms_ub_b10200 1 100 0 10200 FORMAT "%7.1" ECU_ADDRESS 0x403AA4 /end MEASUREMENT
/begin MEASUREMENT rinv2_w "Istwert (word) Innenwiderstand Ri-Nernstzelle der Lambdasonde vor KAT Bank2" UWORD r_uw_q2 1 100 0 131070 FORMAT "%8.1" ECU_ADDRESS 0x4042E4 /end MEASUREMENT
/begin MEASUREMENT rinv_w "Istwert (word) Innenwiderstand Ri-Nernstzelle der Lambdasonde vor KAT" UWORD r_uw_q2 1 100 0 131070 FORMAT "%8.1" ECU_ADDRESS 0x4042E6 /end MEASUREMENT
/begin MEASUREMENT rirext_w "relative Inertgas-F¸llung aus externem AGR" UWORD rel_uw_q0p0234 1 100 0 1535.98 FORMAT "%8.3" ECU_ADDRESS 0x4042E8 /end MEASUREMENT
/begin MEASUREMENT rkte_w "Relativer Gemischanteil Tankentl¸ftung" SWORD rel_sw_q0p0468 1 100 -1536 1535.95 FORMAT "%8.3" ECU_ADDRESS 0x404350 /end MEASUREMENT
/begin MEASUREMENT rkwez_w "Vektor additive Kraftstoffmenge bei Wiedereinsetzen" UWORD t1p0usxms 1 100 0 65.535 FORMAT "%8.5" ARRAY_SIZE 8 ECU_ADDRESS 0x3FB6C0 /end MEASUREMENT
/begin MEASUREMENT rlmxs_w "maximal erreichbare F¸llung" UWORD rel_uw_q0p0234 1 100 0 1535.98 FORMAT "%8.3" ECU_ADDRESS 0x4035BE /end MEASUREMENT
/begin MEASUREMENT rlst08_uc "rlst08_um im Befehlstest" ULONG dez 1 100 0 4.29497e+009 FORMAT "%13.2" ECU_ADDRESS 0x4048A4 /end MEASUREMENT
/begin MEASUREMENT rlteev_w "Relative F¸llung verursacht durch Regeneriergas Tankentl¸ftung" UWORD rel_uw_b192 1 100 0 191.997 FORMAT "%8.4" ECU_ADDRESS 0x404352 /end MEASUREMENT
/begin MEASUREMENT rl_uc "relative Luftf¸llung im Befehlstest" UBYTE rel_ub_q0p75 1 100 0 191.25 FORMAT "%5.1" ECU_ADDRESS 0x403AB0 /end MEASUREMENT
/begin MEASUREMENT rqacc_um "Anforderung Schubabschalteverbot in ‹berwachung" UBYTE dez 1 100 0 255 FORMAT "%5.1" ECU_ADDRESS 0x3FA3B5 /end MEASUREMENT
/begin MEASUREMENT r_flags_uc "Byte f¸r Fehlerreaktions-Bits des Befehlstest" UBYTE dez 1 100 0 255 FORMAT "%5.1" ECU_ADDRESS 0x403A82 /end MEASUREMENT
/begin MEASUREMENT sgsc_c_uc "Fehlerz‰hler f¸r Getriebe¸berwachung des Befehlstestes" UBYTE t10ms_ub_b2550 1 100 0 2550 ECU_ADDRESS 0x403A9B /end MEASUREMENT
/begin MEASUREMENT spnst08_uc "" ULONG dez 1 100 0 4.29497e+009 FORMAT "%13.2" ECU_ADDRESS 0x4048B0 /end MEASUREMENT
/begin MEASUREMENT spsn_uc "Pedalwert (8 Bit) im Befehlstest" UBYTE spg_ub_q0p019 1 100 0 4.98047 FORMAT "%5.3" ECU_ADDRESS 0x403AC8 /end MEASUREMENT
/begin MEASUREMENT stacc_um "Status ACC in der ‹berwachung" UBYTE dez 1 100 0 255 FORMAT "%5.1" ECU_ADDRESS 0x3FA3B6 /end MEASUREMENT
/begin MEASUREMENT startddisa "Flag: Diagnose starten" UBYTE dez 1 100 0 255 FORMAT "%5.1" ECU_ADDRESS 0x4035A1 /end MEASUREMENT
/begin MEASUREMENT stoelnfm "Status erforderliche Nachf¸llmenge Motorˆl" UBYTE dez 1 100 0 255 FORMAT "%5.1" ECU_ADDRESS 0x4035CF /end MEASUREMENT
/begin MEASUREMENT STRBLI_Bits_1 "" UBYTE dez 1 100 0 255 FORMAT "%5.1" ECU_ADDRESS 0x40306C /end MEASUREMENT
/begin MEASUREMENT systemStackUsage "" UWORD fak_uw_b1 1 100 0 0.999985 FORMAT "%9.7" ECU_ADDRESS 0x4034DE /end MEASUREMENT
/begin MEASUREMENT s_flags_uc "Byte f¸r Status-Bits des Befehlstests" UBYTE dez 1 100 0 255 FORMAT "%5.1" ECU_ADDRESS 0x403A83 /end MEASUREMENT
/begin MEASUREMENT tahso2_w "Abgastemperatur an Sonde hinter Kat aus Modell, Bank 2" UWORD temp_q0p0234_o273 1 100 -273.15 1262.83 FORMAT "%8.3" ECU_ADDRESS 0x402B70 /end MEASUREMENT
/begin MEASUREMENT tahsoab2_w "Abgastemperatur beim Abstellen des Motors an Sonde hinter Kat aus Modell, Bank2" UWORD temp_q0p0234_o273 1 100 -273.15 1262.83 FORMAT "%8.3" ECU_ADDRESS 0x402B72 /end MEASUREMENT
/begin MEASUREMENT tahsoab_w "Abgastemperatur beim Abstellen des Motors an Sonde hinter Kat aus Modell" UWORD temp_q0p0234_o273 1 100 -273.15 1262.83 FORMAT "%8.3" ECU_ADDRESS 0x402B74 /end MEASUREMENT
/begin MEASUREMENT tahsom2_w "Abgastemperatur an Sonde hinter Kat aus Modell, Bank 2" UWORD temp_q0p0234_o273 1 100 -273.15 1262.83 FORMAT "%8.3" ECU_ADDRESS 0x402B76 /end MEASUREMENT
/begin MEASUREMENT tahsom_w "Abgastemperatur an Sonde hinter Kat aus Modell" UWORD temp_q0p0234_o273 1 100 -273.15 1262.83 FORMAT "%8.3" ECU_ADDRESS 0x402B78 /end MEASUREMENT
/begin MEASUREMENT tahso_w "Abgastemperatur an Sonde hinter Kat aus Modell" UWORD temp_q0p0234_o273 1 100 -273.15 1262.83 FORMAT "%8.3" ECU_ADDRESS 0x402B7A /end MEASUREMENT
/begin MEASUREMENT taikrm2_w "Abgastemperatur im Kr¸mmer (Zusammenf¸hrung aller Zylinder) aus Modell, Bank 2" UWORD temp_q0p0234_o273 1 100 -273.15 1262.83 FORMAT "%8.3" ECU_ADDRESS 0x402B7C /end MEASUREMENT
/begin MEASUREMENT taikrm_w "Abgastemperatur im Kr¸mmer (Zusammenf¸hrung aller Zylinder) aus Modell" UWORD temp_q0p0234_o273 1 100 -273.15 1262.83 FORMAT "%8.3" ECU_ADDRESS 0x402B7E /end MEASUREMENT
/begin MEASUREMENT talsuf "gefilterte Abgastemperatur aus Modell" UBYTE temp_ub_q5_o50 1 100 -50 1225 FORMAT "%5.0" ECU_ADDRESS 0x4035AC /end MEASUREMENT
/begin MEASUREMENT talsuf2 "gefilterte Abgastemperatur aus Modell, Bank2" UBYTE temp_ub_q5_o50 1 100 -50 1225 FORMAT "%5.0" ECU_ADDRESS 0x4035AD /end MEASUREMENT
/begin MEASUREMENT tamldia "Tastverh‰ltnis E-L¸fter Diagnoseeingriff" UBYTE rel_ub_b100 1 100 0 99.6094 FORMAT "%5.2" ECU_ADDRESS 0x403065 /end MEASUREMENT
/begin MEASUREMENT tanhkm2_w "Abgastemperatur nach Hauptkat aus Modell, Bank2" UWORD temp_q0p0234_o273 1 100 -273.15 1262.83 FORMAT "%8.3" ECU_ADDRESS 0x402B80 /end MEASUREMENT
/begin MEASUREMENT tanhkm_w "Abgastemperatur hinter Hauptkat aus Modell" UWORD temp_q0p0234_o273 1 100 -273.15 1262.83 FORMAT "%8.3" ECU_ADDRESS 0x402B82 /end MEASUREMENT
/begin MEASUREMENT tanvk2_w "Abgastemperatur nach dem Vorkat, Bank 2" UWORD temp_q0p0234_o273 1 100 -273.15 1262.83 FORMAT "%8.3" ECU_ADDRESS 0x402B84 /end MEASUREMENT
/begin MEASUREMENT tanvkm2_w "Modellierte Abgastemperatur hinter dem Vorkatalysator, Bank 2" UWORD temp_q0p0234_o273 1 100 -273.15 1262.83 FORMAT "%8.3" ECU_ADDRESS 0x402B86 /end MEASUREMENT
/begin MEASUREMENT tanvkm_w "Modellierte Abgastemperatur hinter dem Vorkatalysator" UWORD temp_q0p0234_o273 1 100 -273.15 1262.83 FORMAT "%8.3" ECU_ADDRESS 0x402B88 /end MEASUREMENT
/begin MEASUREMENT tanvk_w "Abgastemperatur nach dem Vorkat" UWORD temp_q0p0234_o273 1 100 -273.15 1262.83 FORMAT "%8.3" ECU_ADDRESS 0x402B8A /end MEASUREMENT
/begin MEASUREMENT tateist_w "aktuelles Ist-Tastverh‰ltnis Tankentl¸ftungsventil (16 Bit)" UWORD rel_uw_b100 1 100 0 99.9985 FORMAT "%8.5" ECU_ADDRESS 0x4042EA /end MEASUREMENT
/begin MEASUREMENT tatuk "Ansaugluft- oder Umgebungstemperatur, Ausgabe in Grad C, intern in Kelvin" UBYTE temp_q6_o273 1 100 -273.15 1256.85 FORMAT "%5.0" ECU_ADDRESS 0x402BB4 /end MEASUREMENT
/begin MEASUREMENT tatuk_w "Ansaugluft- oder Umgebungstemperatur, Ausgabe in Grad C, intern in Kelvin" UWORD temp_q0p0234_o273 1 100 -273.15 1256.85 FORMAT "%8.3" ECU_ADDRESS 0x402B8C /end MEASUREMENT
/begin MEASUREMENT tavhkm2_w "Abgastemperatur vor Hauptkat aus Modell, Bank 2" UWORD temp_q0p0234_o273 1 100 -273.15 1262.83 FORMAT "%8.3" ECU_ADDRESS 0x402B8E /end MEASUREMENT
/begin MEASUREMENT tavhkm_w "Abgastemperatur vor Hauptkat aus Modell" UWORD temp_q0p0234_o273 1 100 -273.15 1262.83 FORMAT "%8.3" ECU_ADDRESS 0x402B90 /end MEASUREMENT
/begin MEASUREMENT tavrom2_w "Abgastemperatur im Rohrst¸ck vor Vorkat modelliert (Bank2)" UWORD temp_q0p0234_o273 1 100 -273.15 1262.83 FORMAT "%8.3" ECU_ADDRESS 0x402B92 /end MEASUREMENT
/begin MEASUREMENT tavrom_w "Abgastemperatur im Rohrstuck nach Kr¸mmer modelliert" UWORD temp_q0p0234_o273 1 100 -273.15 1262.83 FORMAT "%8.3" ECU_ADDRESS 0x402B94 /end MEASUREMENT
/begin MEASUREMENT tavso2_w "Abgastemperatur an Sonde vor Kat aus Modell, Bank 2" UWORD temp_q0p0234_o273 1 100 -273.15 1262.83 FORMAT "%8.3" ECU_ADDRESS 0x402B96 /end MEASUREMENT
/begin MEASUREMENT tavsoab2_w "Abgastemperatur beim Abstellen des Motors an Sonde vor Kat aus Modell, Bank2" UWORD temp_q0p0234_o273 1 100 -273.15 1262.83 FORMAT "%8.3" ECU_ADDRESS 0x402B98 /end MEASUREMENT
/begin MEASUREMENT tavsoab_w "Abgastemperatur beim Abstellen des Motors an Sonde vor Kat aus Modell" UWORD temp_q0p0234_o273 1 100 -273.15 1262.83 FORMAT "%8.3" ECU_ADDRESS 0x402B9A /end MEASUREMENT
/begin MEASUREMENT tavsom2_w "Abgastemperatur an Sonde vor Kat aus Modell, Bank 2" UWORD temp_q0p0234_o273 1 100 -273.15 1262.83 FORMAT "%8.3" ECU_ADDRESS 0x402B9C /end MEASUREMENT
/begin MEASUREMENT tavsom_w "Abgastemperatur an Sonde vor Kat aus Modell" UWORD temp_q0p0234_o273 1 100 -273.15 1262.83 FORMAT "%8.3" ECU_ADDRESS 0x402B9E /end MEASUREMENT
/begin MEASUREMENT tavso_w "Abgastemperatur an Sonde vor Kat aus Modell" UWORD temp_q0p0234_o273 1 100 -273.15 1262.83 FORMAT "%8.3" ECU_ADDRESS 0x402BA0 /end MEASUREMENT
/begin MEASUREMENT tavvkm2_w "Abgastemperatur vor Vorkat aus Modell, Bank2" UWORD temp_q0p0234_o273 1 100 -273.15 1262.83 FORMAT "%8.3" ECU_ADDRESS 0x402BA2 /end MEASUREMENT
/begin MEASUREMENT tavvkm_w "Abgastemperatur vor Vorkat aus Modell" UWORD temp_q0p0234_o273 1 100 -273.15 1262.83 FORMAT "%8.3" ECU_ADDRESS 0x402BA4 /end MEASUREMENT
/begin MEASUREMENT tedub "korrigierte Einschaltdauer der LSU-Heizung" UBYTE t10msxs_ub_b2p55 1 100 0 2.55 FORMAT "%5.3" ECU_ADDRESS 0x403CEC /end MEASUREMENT
/begin MEASUREMENT tedub2 "korrigierte Einschaltdauer der LSU-Heizung Bank2" UBYTE t10msxs_ub_b2p55 1 100 0 2.55 FORMAT "%5.3" ECU_ADDRESS 0x403CED /end MEASUREMENT
/begin MEASUREMENT tevtim "Zeitzaehler Bauteileansteuerung TEV" UBYTE dez 1 100 0 255 FORMAT "%5.1" ECU_ADDRESS 0x403C90 /end MEASUREMENT
/begin MEASUREMENT tfst2 "Tankfuellstand Tank 2" UBYTE fuel_ub_q1 1 100 0 255 FORMAT "%5.1" ECU_ADDRESS 0x4039B9 /end MEASUREMENT
/begin MEASUREMENT tibsrxok "Entprellzeit f¸r IBS-Lernroutine" UBYTE t_q0p1 1 100 0 25.5 FORMAT "%5.2" ECU_ADDRESS 0x4039BA /end MEASUREMENT
/begin MEASUREMENT tistzyl "Zylindernummer der ersten Einspritzung und Z¸ndung" UBYTE dez 1 100 0 255 FORMAT "%5.1" ECU_ADDRESS 0x403CEE /end MEASUREMENT
/begin MEASUREMENT tkatmf "gefilterte Katalysatortemperatur aus Modell" UBYTE temp_ub_q5_o50 1 100 -50 1225 FORMAT "%5.0" ECU_ADDRESS 0x4035AE /end MEASUREMENT
/begin MEASUREMENT tkatmf2 "gefilterte Katalysatortemperatur aus Modell, Bank2" UBYTE temp_ub_q5_o50 1 100 -50 1225 FORMAT "%5.0" ECU_ADDRESS 0x4035AF /end MEASUREMENT
/begin MEASUREMENT tkihkm2_w "Temperatur Katalysator im Hauptkat aus  Modell, Bank2" UWORD temp_q0p0234_o273 1 100 -273.15 1262.83 FORMAT "%8.3" ECU_ADDRESS 0x402BA6 /end MEASUREMENT
/begin MEASUREMENT tkihkm_w "Temperatur Katalysator im Hauptkat aus Modell" UWORD temp_q0p0234_o273 1 100 -273.15 1262.83 FORMAT "%8.3" ECU_ADDRESS 0x402BA8 /end MEASUREMENT
/begin MEASUREMENT tkiuem2_w "Temperatur Katalysator im ¸berwachten Kat aus Modell, Bank 2" UWORD temp_q0p0234_o273 1 100 -273.15 1262.83 FORMAT "%8.3" ECU_ADDRESS 0x402BAA /end MEASUREMENT
/begin MEASUREMENT tkiuem_w "Temperatur Katalysator im ¸berwachten Kat aus Modell" UWORD temp_q0p0234_o273 1 100 -273.15 1262.83 FORMAT "%8.3" ECU_ADDRESS 0x402BAC /end MEASUREMENT
/begin MEASUREMENT tkivkm2_w "Temperatur im Vorkatalysator nach dem ersten Teil des Monolithen, Bank2" UWORD temp_q0p0234_o273 1 100 -273.15 1262.83 FORMAT "%8.3" ECU_ADDRESS 0x402BAE /end MEASUREMENT
/begin MEASUREMENT tkivkm_w "Temperatur im Vorkatalysator nach dem ersten Teil des Monolithen" UWORD temp_q0p0234_o273 1 100 -273.15 1262.83 FORMAT "%8.3" ECU_ADDRESS 0x402BB0 /end MEASUREMENT
/begin MEASUREMENT tmost08_uc "" ULONG dez 1 100 0 4.29497e+009 FORMAT "%13.2" ECU_ADDRESS 0x4048B4 /end MEASUREMENT
/begin MEASUREMENT tmotk "Motor-Temperatur, Ausgabe in Grad C, intern in Kelvin" UBYTE temp_q6_o273 1 100 -273.15 1256.85 FORMAT "%5.0" ECU_ADDRESS 0x402BB5 /end MEASUREMENT
/begin MEASUREMENT tmotk_w "Motor-Temperatur, Ausgabe in Grad C, intern in Kelvin" UWORD temp_q0p0234_o273 1 100 -273.15 1256.85 FORMAT "%8.3" ECU_ADDRESS 0x402BB2 /end MEASUREMENT
/begin MEASUREMENT tmotmn_uc "Minimal plausible Motortemperatur im Befehlstest" UBYTE temp_ub_q0p75_o48 1 100 -48 143.25 FORMAT "%5.1" ECU_ADDRESS 0x403AC9 /end MEASUREMENT
/begin MEASUREMENT tmot_uc "Motor-Temperatur im Befehlstest" UBYTE temp_ub_q0p75_o48 1 100 -48 143.25 FORMAT "%5.1" ECU_ADDRESS 0x403ACA /end MEASUREMENT
/begin MEASUREMENT tmst_w "Motorstarttemperatur" UWORD temp_uw_q0p75_o48 1 100 -48 49103.3 FORMAT "%8.2" ECU_ADDRESS 0x4035B6 /end MEASUREMENT
/begin MEASUREMENT tolc "÷ltemperatur aus Kombibotschaft od. aus COWIV abh‰ngig von LH" UBYTE temp_ub_q0p75_o48 1 100 -48 143.25 FORMAT "%5.1" ECU_ADDRESS 0x403CEF /end MEASUREMENT
/begin MEASUREMENT tpsvkmf2_w "gefilterter Periodendauerwert des Sondensignals vor Kat, Bank2 (Word)" UWORD t10msxs_uw_b655p35 1 100 0 655.35 FORMAT "%8.4" ECU_ADDRESS 0x3FE28E /end MEASUREMENT
/begin MEASUREMENT tpsvkmf_w "gefilterter Periodendauerwert des Sondensignals vor Kat. (Word)" UWORD t10msxs_uw_b655p35 1 100 0 655.35 FORMAT "%8.4" ECU_ADDRESS 0x3FE290 /end MEASUREMENT
/begin MEASUREMENT tvavhzkr "" UBYTE rel_ub_b100 1 100 0 99.6094 FORMAT "%5.2" ECU_ADDRESS 0x4035D0 /end MEASUREMENT
/begin MEASUREMENT tvstakl15 "Verzˆgerungszeit von KL15 ein (HR ein) bis  Starterfreigabe" UBYTE t10msxs_ub_b2p55 1 100 0 2.55 FORMAT "%5.3" ECU_ADDRESS 0x3FE0B9 /end MEASUREMENT
/begin MEASUREMENT tzlrdkt_w "Lambdaregler-Periodendauer aus Katdiagnose" UWORD t10msxs_uw_b655p35 1 100 0 655.35 FORMAT "%8.4" ECU_ADDRESS 0x4042EC /end MEASUREMENT
/begin MEASUREMENT t_bthsh "Ausschaltzeit Tastverhaeltnis f¸r Bauteileansteuerung LS hinter KAT" UBYTE dez 1 100 0 255 FORMAT "%5.1" ECU_ADDRESS 0x403C91 /end MEASUREMENT
/begin MEASUREMENT t_bthsh2 "Ausschaltzeit Tastverhaeltnis f¸r Bauteileansteuerung LS hinter KAT Bank 2" UBYTE dez 1 100 0 255 FORMAT "%5.1" ECU_ADDRESS 0x403C92 /end MEASUREMENT
/begin MEASUREMENT t_bthsv "Ausschaltzeit Tastverhaeltnis f¸r Bauteileansteuerung LS vor KAT" UBYTE dez 1 100 0 255 FORMAT "%5.1" ECU_ADDRESS 0x403C93 /end MEASUREMENT
/begin MEASUREMENT t_bthsv2 "Ausschaltzeit Tastverhaeltnis f¸r Bauteileansteuerung LS vor KAT Bank 2" UBYTE dez 1 100 0 255 FORMAT "%5.1" ECU_ADDRESS 0x403C94 /end MEASUREMENT
/begin MEASUREMENT t_bttev "Ausschaltzeit Tastverhaeltnis f¸r Bauteileansteuerung TEV" UBYTE dez 1 100 0 255 FORMAT "%5.1" ECU_ADDRESS 0x403C95 /end MEASUREMENT
/begin MEASUREMENT t_bttim "Timeoutzaehler fuer Bauteileansteuerung ¸ber Tester" UBYTE dez 1 100 0 255 FORMAT "%5.1" ECU_ADDRESS 0x403C96 /end MEASUREMENT
/begin MEASUREMENT t_flags_uc "Byte f¸r Tempomat-Bits des Befehlstests" UBYTE dez 1 100 0 255 FORMAT "%5.1" ECU_ADDRESS 0x403A84 /end MEASUREMENT
/begin MEASUREMENT udsl_w "Spannung Drucksensor Ladedruck (word)" UWORD spg_uw_q0p00488 1 100 0 319.995 FORMAT "%8.4" ECU_ADDRESS 0x4042EE /end MEASUREMENT
/begin MEASUREMENT UetmNvBits "" UBYTE dez 1 100 0 255 FORMAT "%5.1" ECU_ADDRESS 0x3FE0BA /end MEASUREMENT
/begin MEASUREMENT uevges "‹bersetzungsverh‰ltnis gesamt" UBYTE fak_q0p1 1 100 0 25.5 FORMAT "%5.2" ECU_ADDRESS 0x403CF0 /end MEASUREMENT
/begin MEASUREMENT uhsv "Spannung an der Heizerendstufe vor Kat" UBYTE spg_ub_b5 1 100 0 4.98047 FORMAT "%5.3" ECU_ADDRESS 0x403CF1 /end MEASUREMENT
/begin MEASUREMENT uhsv2 "Spannung an der Heizerendstufe 2 vor Kat" UBYTE spg_ub_b5 1 100 0 4.98047 FORMAT "%5.3" ECU_ADDRESS 0x403CF2 /end MEASUREMENT
/begin MEASUREMENT userStackUsage "" UWORD fak_uw_b1 1 100 0 0.999985 FORMAT "%9.7" ECU_ADDRESS 0x4034E0 /end MEASUREMENT
/begin MEASUREMENT usvk "Spannung Lambdasonde vor Kat" UBYTE spg_ub_q0p0052_o0p2 1 100 -0.2 1.13 FORMAT "%5.3" ECU_ADDRESS 0x403CF3 /end MEASUREMENT
/begin MEASUREMENT usvk2 "Spannung Lambdasonde vor Kat 2" UBYTE spg_ub_q0p0052_o0p2 1 100 -0.2 1.13 FORMAT "%5.3" ECU_ADDRESS 0x403CF4 /end MEASUREMENT
/begin MEASUREMENT usvkk2_w "LSU-Spannung vor Kat, korrigiert Bank2" UWORD spg_uw_q0p00488 1 100 0 319.995 FORMAT "%8.4" ECU_ADDRESS 0x4042F0 /end MEASUREMENT
/begin MEASUREMENT usvkk_w "LSU-Spannung vor Kat, korrigiert" UWORD spg_uw_q0p00488 1 100 0 319.995 FORMAT "%8.4" ECU_ADDRESS 0x4042F2 /end MEASUREMENT
/begin MEASUREMENT uulsuf2_w "gefilterte Sondenspannung vor Kat einer Breitbandlambdasonde Bank2" UWORD spg_uw_q0p00488 1 100 0 319.995 FORMAT "%8.4" ECU_ADDRESS 0x4042F4 /end MEASUREMENT
/begin MEASUREMENT uulsuf_w "gefilterte Sondenspannung vor Kat einer Breitbandlambdasonde" UWORD spg_uw_q0p00488 1 100 0 319.995 FORMAT "%8.4" ECU_ADDRESS 0x4042F6 /end MEASUREMENT
/begin MEASUREMENT uusvk2_u "ADC-Spannung Lambdasonde vor Katalysator 2 (Byte)" UBYTE spg_ub_b5 1 100 0 4.98047 FORMAT "%5.3" ECU_ADDRESS 0x403CF5 /end MEASUREMENT
/begin MEASUREMENT uusvk2_w "ADC-Spannung Lambdasonde vor Katalysator 2 (Word)" UWORD spg_uw_q0p00488 1 100 0 319.995 FORMAT "%8.4" ECU_ADDRESS 0x40482C /end MEASUREMENT
/begin MEASUREMENT uusvk_u "ADC-Spannung Lambdasonde vor Katalysator (Byte)" UBYTE spg_ub_b5 1 100 0 4.98047 FORMAT "%5.3" ECU_ADDRESS 0x403CF6 /end MEASUREMENT
/begin MEASUREMENT uusvmb2_w "Spannung (word, 1 ms-Raster) Lambdasonde mit Widerstand belastet vor KAT Bank2" UWORD spg_uw_q0p00488 1 100 0 319.995 FORMAT "%8.4" ECU_ADDRESS 0x4042F8 /end MEASUREMENT
/begin MEASUREMENT uusvmb_w "Spannung (word, 1 ms-Raster) Lambdasonde mit Widerstand belastet vor KAT" UWORD spg_uw_q0p00488 1 100 0 319.995 FORMAT "%8.4" ECU_ADDRESS 0x4042FA /end MEASUREMENT
/begin MEASUREMENT uusvob2_w "ADC-Spannung (word, 1 ms-Raster) Sonde ohne Belastung vor Katalysator Bank2" UWORD spg_uw_q0p00488 1 100 0 319.995 FORMAT "%8.4" ECU_ADDRESS 0x4042FC /end MEASUREMENT
/begin MEASUREMENT uusvob_w "ADC-Spannung (word, 1 ms-Raster) Sonde ohne Belastung vor Katalysator" UWORD spg_uw_q0p00488 1 100 0 319.995 FORMAT "%8.4" ECU_ADDRESS 0x4042FE /end MEASUREMENT
/begin MEASUREMENT vfgr_bt "" UWORD vfzg_uw_q0p00781 1 100 0 511.992 FORMAT "%8.4" ECU_ADDRESS 0x403D68 /end MEASUREMENT
/begin MEASUREMENT vkpedch_uc "Variantenkriterium f¸r Pedal-Charakteristik im Befehlstest" UBYTE dez 1 100 0 255 FORMAT "%5.1" ECU_ADDRESS 0x403ACB /end MEASUREMENT
/begin MEASUREMENT Vsa_btsoll "Spreizungsvorgabe Tester f¸r AVANOS" UBYTE wkw_q0p8_o128 1 100 -102.4 101.6 FORMAT "%7.3" ECU_ADDRESS 0x4035AA /end MEASUREMENT
/begin MEASUREMENT vsdmr "Vorgabe Drehmomentreserve ¸ber Verstellsystem VSxy" UBYTE rel_ub_q0p3906 1 100 0 99.6094 FORMAT "%5.2" ECU_ADDRESS 0x403CF7 /end MEASUREMENT
/begin MEASUREMENT Vse_btsoll "Spreizungsvorgabe Tester f¸r EVANOS" UBYTE wkw_q0p8_o128 1 100 -102.4 101.6 FORMAT "%7.3" ECU_ADDRESS 0x4035AB /end MEASUREMENT
/begin MEASUREMENT vsfpses "Faktor zur Verstellung Saugrohrdruck zur Applikation Einspritzung" UBYTE fak_ub_b2 1 100 0 1.99219 FORMAT "%5.3" ECU_ADDRESS 0x403CF8 /end MEASUREMENT
/begin MEASUREMENT vsfrk "Korrektur der relativen Kraftstoffmasse ¸ber Verstellsysteme" UBYTE fak_ub_b1p25_o0p75 1 100 0.75 1.24805 FORMAT "%5.3" ECU_ADDRESS 0x403CF9 /end MEASUREMENT
/begin MEASUREMENT vske "verstellbarer Offset f¸r Klopferkennungsschwelle ¸ber VS20" SBYTE fak_ub_b4 1 100 -2 1.98438 FORMAT "%5.3" ECU_ADDRESS 0x403CFA /end MEASUREMENT
/begin MEASUREMENT vsns "ƒnderung der Solldrehzahl ¸ber Verstellsystem VSxy" SBYTE nmot_sb_q10 1 100 -1280 1270 FORMAT "%5.0" ECU_ADDRESS 0x403CFB /end MEASUREMENT
/begin MEASUREMENT vsvw "ƒnderung Einspritzvorlagerungswinkel ¸ber Verstellsystem" SBYTE zw_sb_q6 1 100 -768 762 FORMAT "%5.1" ECU_ADDRESS 0x403CFC /end MEASUREMENT
/begin MEASUREMENT vszw "Z¸ndwinkelkorrektur durch Verstellsystem" SBYTE zw_sb_q0p75 1 100 -96 95.25 FORMAT "%5.2" ECU_ADDRESS 0x403CFD /end MEASUREMENT
/begin MEASUREMENT vszwkr "Zylinderindividuelle ZW-Verstellung durch Verstellsystem" SBYTE zw_sb_qn0p75 1 100 -95.25 96 FORMAT "%5.2" ARRAY_SIZE 8 ECU_ADDRESS 0x403CFE /end MEASUREMENT
/begin MEASUREMENT vvtaet "Excenterwinkelvorgabe vom Tester" UBYTE rel_ub_b100 1 100 0 99.6094 FORMAT "%5.2" ECU_ADDRESS 0x403066 /end MEASUREMENT
/begin MEASUREMENT vvtaet2 "" UBYTE rel_ub_b100 1 100 0 99.6094 FORMAT "%5.2" ECU_ADDRESS 0x403067 /end MEASUREMENT
/begin MEASUREMENT vvtal "VVT-Anschlag lernen" UBYTE dez 1 100 0 255 FORMAT "%5.1" ECU_ADDRESS 0x403C8A /end MEASUREMENT
/begin MEASUREMENT wnwatst "Vorsteuerwert f¸r Auslass-Nockenwellenwinkel; Vorgabe Diagnosetester" UBYTE wkw_q0p8_o128 1 100 -102.4 101.6 FORMAT "%7.3" ECU_ADDRESS 0x403068 /end MEASUREMENT
/begin MEASUREMENT wnwetst "Vorsteuerwert f¸r Einlass-Nockenwellenwinkel; Vorgabe Diagnosetester" UBYTE wkw_q0p8_o128 1 100 -102.4 101.6 FORMAT "%7.3" ECU_ADDRESS 0x403069 /end MEASUREMENT
/begin MEASUREMENT zw1_uc "Ausgabe-Z¸ndwinkel ohne Lambakorrekturen (1.Bank)  im Befehlstest" SBYTE zw_sb_q0p75 1 100 -96 95.25 FORMAT "%5.2" ECU_ADDRESS 0x403AB1 /end MEASUREMENT
/begin MEASUREMENT zw2_uc "Ausgabe-Z¸ndwinkel (2.Bank) ohne Lambakorrekturen im Befehlstest" SBYTE zw_sb_q0p75 1 100 -96 95.25 FORMAT "%5.2" ECU_ADDRESS 0x403AB2 /end MEASUREMENT
/begin MEASUREMENT zwopt_uc "optimaler Z¸ndwinkel im Befehlstest" SBYTE zw_sb_q0p75 1 100 -96 95.25 FORMAT "%5.2" ECU_ADDRESS 0x403AB3 /end MEASUREMENT
/begin MEASUREMENT zwopt_um "optimaler Z¸ndwinkel in der Funktions¸berwachung" SBYTE zw_sb_q0p75 1 100 -96 95.25 FORMAT "%5.2" ECU_ADDRESS 0x3F99E9 /end MEASUREMENT
/begin MEASUREMENT zwout_uc "Ausgabe-Z¸ndwinkel im Befehlstest" SBYTE zw_sb_q0p75 1 100 -96 95.25 FORMAT "%5.2" ECU_ADDRESS 0x403AB4 /end MEASUREMENT
/begin MEASUREMENT zwout_um "Ausgabe-Z¸ndwinkel f¸r die Funktions¸berwachung" SBYTE zw_sb_q0p75 1 100 -96 95.25 FORMAT "%5.2" ECU_ADDRESS 0x3F99EA /end MEASUREMENT
/begin MEASUREMENT z_flags_uc "Byte f¸r Status-Bits beim 2-SG-Konzept im Befehlstestes" UBYTE dez 1 100 0 255 FORMAT "%5.1" ECU_ADDRESS 0x403A85 /end MEASUREMENT
/begin FUNCTION STA "25.30     Startautomatik" /begin DEF_CHARACTERISTIC CWSTAEN NSTMXM TANMX TPAST TSTA TVSTANKL15 TWSTA /end DEF_CHARACTERISTIC
 /begin IN_MEASUREMENT B_estart B_ez B_fs B_nldg B_recRes5v B_recSta B_stend B_stprel codcan nmot nmot_w tmot /end IN_MEASUREMENT
 /begin OUT_MEASUREMENT B_sta B_stares5v tvstakl15 /end OUT_MEASUREMENT
 /begin LOC_MEASUREMENT B_sta0ag /end LOC_MEASUREMENT
/end FUNCTION
/begin FUNCTION STACKMON "" /begin OUT_MEASUREMENT systemStackUsage userStackUsage /end OUT_MEASUREMENT /end FUNCTION
/begin FUNCTION STMD "6.20      Startmoment" /begin DEF_CHARACTERISTIC KFMDST KFMDSTGD /end DEF_CHARACTERISTIC /begin IN_MEASUREMENT B_gdst B_llrein mimin_w mimxl1_w mrfamx_w nmotz nsst tmot /end IN_MEASUREMENT /begin OUT_MEASUREMENT mistt mrstt_w /end OUT_MEASUREMENT /begin LOC_MEASUREMENT qnst_w /end LOC_MEASUREMENT /end FUNCTION
/begin FUNCTION SWADP "9.130     Software-Adapter"
 /begin DEF_CHARACTERISTIC CWFADTEV CWIBSDETEC CWLROFF CWMDKOMX IHAMN TBSDLRT UBDHLSUMN UBDHLSUMX UEGET /end DEF_CHARACTERISTIC
 /begin IN_MEASUREMENT B_clvar B_egs1cok fcmEnd gangi ht_IbsStatus iha lamsons2_w lamsons_w msabg2_w msabg_w mstedte_w rlumax_w tateist tkatm tkatm2 tmst tol wnwatst wnwetst /end IN_MEASUREMENT
 /begin OUT_MEASUREMENT Adevhubs Adexws ahkat ahkat2 AS_cantdi AS_epee AS_mar AS_res azlrdkt bbhz_m B_abstgp B_agr B_atmng B_bkva B_bkvleer B_bkvv B_ccevsok B_clradbbo B_clradkr B_clradkrd B_clradmsz B_clradvvt B_craus B_crdmtl B_cvt B_dktlp B_dldpte B_dmtlhe B_dmtltz B_druck B_dslsk B_dtefrr B_dtekfa B_dtevhnd B_dwg B_eblvar B_egscok B_elsu B_elsu2 B_etr B_faan B_faatm B_fadmtg B_fakvs B_falrshk B_fanwsaa B_fanwsea B_fash B_fash2 B_fhz B_ftedab B_gsaf B_hkwnll B_hz B_ibsdetec B_kftkr B_ldeffw B_lowra B_lrasp B_lrasp2 B_lrndia B_lroff B_lroff2 B_lsvvsp B_masterhw B_mdmin B_mdwaner B_newentry B_nnot B_nomilkl B_nstabk B_nws B_rineza B_rineza2 B_ripuv B_ripuv2 B_sacvt B_sch B_sl B_sptvar B_staa B_strvar B_svuerf B_svuerf2 B_teza B_tfst2ok B_tfstok B_toensvar B_txuget B_vs dbawcnt dbawstatus dmllrl_w dmrkrll drlfue_w ehz_pw E_disasch frdter_w fukaba_w fukava_w geli_dflim2 igenmess iprefanf iprefanf2 kopwm kstaa lamsbrs2_w lamsbrs_w lsunpstat lsunpstat2 m6cddmtl m6sddmtl_w m6wddmtl_w mdkomx mdslw_w mdvervf_w mims_w mizsolv_u msntetev_w mssp_w nadmtll_w ntglm_w ntklm_w Oelnivak oelstandr pabnav2_w pabnav_w psagr_w psl pte pwfPattern_hwpwf r5msCtr rinv2_w rinv_w rirext_w rkwez_w rlmxs_w startddisa stoelnfm talsuf talsuf2 tateist_w tedub tedub2 tfst2 tibsrxok tistzyl tkatmf tkatmf2 tmst_w tolc tpsvkmf2_w tpsvkmf_w tvavhzkr tzlrdkt_w udsl_w uevges uhsv uhsv2 usvk usvk2 usvkk2_w usvkk_w uulsuf2_w uulsuf_w uusvk2_u uusvk2_w uusvk_u uusvmb2_w uusvmb_w uusvob2_w uusvob_w Vsa_btsoll vsdmr Vse_btsoll vsfpses vsfrk vske vsns vsvw vszw vszwkr /end OUT_MEASUREMENT
/end FUNCTION
/begin FUNCTION SYSKON "Systemkonstanten" /end FUNCTION
/begin FUNCTION SYSYNC "4.40      System-Synchronisation" /begin IN_MEASUREMENT B_nachl B_nmin B_stprel B_wakeup sync_level synstate /end IN_MEASUREMENT /begin OUT_MEASUREMENT drrev_sta inisynmon /end OUT_MEASUREMENT /end FUNCTION
/begin FUNCTION SY_DFPM40 "" /end FUNCTION
/begin FUNCTION T2CNV "1.10      KWP2000: Umrechnungsmodul f¸r Testerausgabe" /begin IN_MEASUREMENT nn_w1 nn_w2 /end IN_MEASUREMENT /begin OUT_MEASUREMENT nn_w1_w nn_w2_w /end OUT_MEASUREMENT /end FUNCTION
/begin FUNCTION T2DFA "KWP2000; Diagnosefunktion aktivieren"
 /begin IN_MEASUREMENT B_admtll B_clradiha B_fabttreg B_kl15 B_ll B_nmot B_st devoff nmot_w /end IN_MEASUREMENT
 /begin OUT_MEASUREMENT B_fa B_fadisa B_fadk B_fadmtle B_fadmtls B_fadylsu B_fadylsu2 B_faevz B_fakat B_fakat2 B_falls B_falr B_falra B_falsh B_falsh2 B_falsv B_falsv2 B_fapllsu B_fapllsu2 B_fapmmess B_fasls B_fates B_favvtal B_grdst B_wdksap nsolfa vvtal /end OUT_MEASUREMENT
/end FUNCTION
/begin FUNCTION T2DTCS "2.40      KWP2000: Read Diagnostic Trouble Codes By Status" /begin IN_MEASUREMENT fcmEnd /end IN_MEASUREMENT /end FUNCTION
/begin FUNCTION T2IOCBLI "1.10"
 /begin REF_CHARACTERISTIC DI_SCHALT NFSACVMN NFSACVMX NFSMVMN NFSMVMX NLLMVMN NLLMVMX NSACMVMN NSACMVMX NSLBVMN NSLBVMX TMNV TMNVFS /end REF_CHARACTERISTIC
 /begin IN_MEASUREMENT anznmax anzpbr_w B_ac B_acc B_afsvar B_agr B_akrfz B_arsvar B_ascpkw B_autget B_cddmtl B_cotrim B_eblvar B_elue600 B_eluevar B_glfvar B_ibsdetec B_kovar B_mfl B_nokatfz B_nsabg B_pn B_slpvar B_slvvar B_sptvar B_strvar B_toensvar B_txuget codcan codget co_pot Disa_spg dnfsacmv dnfsmv dnllmv dnsacmv dnslbv fr2_w fr_w gangi kmstnmax kmstpbr_w lalsuvj2_w lalsuvj_w minhubvs minhubvsnv minhub_w mshfm_w nmaxvk_w nmot nmot_w nsol ps_w pu_w rml S_VSGDVHUB S_VSMNHB S_VSMNHBNV tans te_w tka tkatm tkatm2 tmot tmst tnse_u toel_w tol tsg tumg uddss_w udkp1v_w udkp1_w udkp2_w udsu_w ugen uhfm_w uhsh uhsh2 uhsv uhsv2 upwg1_w upwg2_w urinlsu2_w urinlsu_w uthk uthk2 uulsuv2_w uulsuv_w uuptes_w uushk2_w uushk_w vfzg wdkba wnwi_w wped wtans wtka wtmot wtsg wub zwout /end IN_MEASUREMENT
 /begin OUT_MEASUREMENT B_ansklet B_bt B_btakr B_btakrst B_btanskl B_btdisa B_btdmh B_btdmmv B_btdmpm B_btebl B_bteepcl B_btefgr B_btekp B_btemil B_btepcl B_btev1 B_btev2 B_btev3 B_btev4 B_btev5 B_btev6 B_btev7 B_btev8 B_btfgr B_btgdvhub B_bthsh B_bthsh2 B_bthsv B_bthsv2 B_btkos B_btmil B_btslp B_btsta B_bttev B_btvsa B_btvsa2 B_btvse B_btvse2 B_btvvta B_btvvta2 B_btvvte B_clhtoel B_clvar B_dmhet B_dmmvet B_dmpmet B_eblet B_ekpet B_etret B_fadmet B_faetr B_faglf B_fahisrst B_famls B_glfet B_hsh2et B_hshet B_hsvet B_hsvet2 B_koset B_slpet B_staet B_tevet B_vvteet disatst hsh2tim hshtim hsv2tim hsvtim ofwnktest ofwtstber tamldia tevtim t_bthsh t_bthsh2 t_bthsv t_bthsv2 t_bttev t_bttim vvtaet vvtaet2 wnwatst wnwetst /end OUT_MEASUREMENT
/end FUNCTION
/begin FUNCTION T2RDBCI "1.80" /begin REF_CHARACTERISTIC OFWNKMX /end REF_CHARACTERISTIC
 /begin IN_MEASUREMENT Bgl_flags1 Bgl_flags2 Bgl_flags3 Bgl_flags4 bos01_w bosbtvfbk bosstate B_akr B_atmtpa B_atmtpk B_bgl B_bglrdy B_bl B_br B_ebl B_eculock B_ekp B_estart B_etr B_fbgl B_fe B_fofr1 B_fs B_hshe B_hshe2 B_hsve B_hsve2 B_ibsdetec B_kd B_kh B_kl15 B_ko B_koe B_krdws B_kuppl B_ll B_llk B_lltd B_lr B_lr2 B_lrnrdy B_mil B_milfb B_minhubvs B_nmot B_nsub B_nvrbupok B_pedsport B_pn B_sa B_sbbhk B_sbbhk2 B_sbbvk B_sbbvk2 B_slp B_slv B_ssll B_sta B_tdadon B_te B_teakt B_tehb B_vl B_vvtnotl co_pot_w dbawcnt dbawstatus deltagvfi dffgen dfmonitor dfrmoff_w dfseresz_w dlahi2_w dlahi_w dmllri_w dmrllr_w dmvadfk_w dmvadfs_w dmvadko_w dmvadll_w dmvad_w dpsraus_i dpssol_w dps_w dwkr dynlsu2_w dynlsu_w dzws evhubi2_w evhubi_w evhubs_w exwinks_w exwnki2_w exwnki_w fakiha fcmEnd fdlubbgl_w fho_w fkmsdka_w fkmsdk_w fkmsvvta_w fkmsvvt_w flub1_w flub2_w fofresz fprstep_c fr2_w fra2_w fra_w fr_w ftbr_w ftvdk gvist ibhwversi ibswbase ibswchang idfbosmgt lamsoni2_w lamsoni_w lrnstep_c lutsfi1_w lutsfi2_w lutsfi3_w lutsfi4_w lutsfi5_w lutsfi6_w lutsfi7_w lutsfi8_w mdgen mdko mdwan_w miist_w mimin_w minadrdy minhubfak minhubvsi minhub_roh minhub_w msdif_w mshfm_w msndko_w msnvvtoll msnvvto_w nadmtll_w ndiprfo_w nkfl nmot_w nn_w1_w nn_w2_w nsol nsol_w ntglm_w ntklm_w ofwnkadbg ofwnkbg1 ofwnkbg2 ozkvbog ozkvbsm_ul ozoelkm ozoelzeit ozpermbog ozpermex ozpermlow ozpermoff ozrwkvb ozrwperm pminfo1 pminfo2 rinh2_w rinh_w rkat2_w rkats_w rkat_w rkrn_w rlsol_w rl_w rmslt snibs ssllcnt tabgm taml tans tateist te2_w tedub tedub2 te_w tkalin tmot tnse_w tsg tumg ub upwg1_w upwg_w uulsuv2_w uulsuv_w vfzg Vsa2adp Vsa2adp_fl Vsa2spri Vsa2sprs Vsa2tv Vsa_adp Vsa_adp_fl Vsa_spri Vsa_sprs Vsa_tv Vse2adp Vse2adp_fl Vse2spri Vse2sprs Vse2tv Vse_adp Vse_adp_fl Vse_spri Vse_sprs Vse_tv vssekp vvtstatus vvt_es vvt_es2 vvt_iw vvt_iw2 vvt_sw vvt_sw2 vvt_tv vvt_tv2 wdkba wdkba_w wdks_w wnwkwa_w wnwkwe_w wped_w zbibs zrbosmld zwist zwout /end IN_MEASUREMENT
/end FUNCTION
/begin FUNCTION t2wdbci "" /begin REF_CHARACTERISTIC CWKATVAR CWVMAXCOD /end REF_CHARACTERISTIC /begin IN_MEASUREMENT bosbtvfbkt idfbosrtt nmot_w top_w zrbosrt /end IN_MEASUREMENT /end FUNCTION
/begin FUNCTION TC1MOD "23.40     Testerkommunikation CARB; Mode 1" /begin REF_CHARACTERISTIC CWKONFLS CWOBD /end REF_CHARACTERISTIC
 /begin IN_MEASUREMENT B_cdkvs B_cdmd B_kmmilsct B_lsh B_lsh2 B_lsv B_lsv2 B_milstat B_sls B_slsfz evsup1 fcmEnd flglrs flglrs2 fr2_w fra2_w fra_w fr_w iplsuvj2_w iplsuvj_w kmstmil_w lalsuvj2_w lalsuvj_w mshfm_w nmot_w ready rml tanslin tmotlin udkp1_w ushkj ushkj2 vfzg zwzyl1 /end IN_MEASUREMENT
/end FUNCTION
/begin FUNCTION TC6MOD "22.130    Testerkommunikation CARB/EOBD; Mode/Service 6, Ausgabe Pr¸fschwellen"
 /begin IN_MEASUREMENT B_cddmtl B_cdkatsp B_cdkatspf B_cdsls B_cdtes B_cwdslt B_cwdthm m6cdmtk m6cdmtl m6cktsp m6cktsp2 m6cmsl m6cmsl2 m6cmslv m6cmslv2 m6ctesg m6cthm m6sdmtk_w m6sdmtl_w m6sktsp2_w m6sktsp_w m6smsl2_w m6smslv2_w m6smslv_w m6smsl_w m6stesg_w m6sthm_w m6wdmtk_w m6wdmtl_w m6wktsp2_w m6wktsp_w m6wmsl2_w m6wmslv2_w m6wmslv_w m6wmsl_w m6wtesg_w m6wthm_w tc6tesc tc6tess tc6tesw /end IN_MEASUREMENT
/end FUNCTION
/begin FUNCTION TC8MOD "23.10     Testerkommunikation CARB; Mode 8, Funktionsaktivierungen" /begin IN_MEASUREMENT B_m8te B_mde8e stpdmtlm8 /end IN_MEASUREMENT /end FUNCTION
/begin FUNCTION TC9MOD "17.10     Testerkommunikation CARB; Mode 9, Request Vehicle Information"
 /begin IN_MEASUREMENT B_cksbrdy B_cksbrdy2 B_eepwf B_mde9e CALIBID1 CALIBID2 cvn cvn2 /end IN_MEASUREMENT
/end FUNCTION
/begin FUNCTION TCSORT "3.40      Testerkommunikation CARB; Sortierfunktion" /begin IN_MEASUREMENT cw_erfil fcmEnd FCMTab ffzdfp /end IN_MEASUREMENT /begin OUT_MEASUREMENT errorCntTcsort /end OUT_MEASUREMENT /end FUNCTION
/begin FUNCTION TEB "103.100   Tankentl¸ftung beladungsabh‰ngig"
 /begin DEF_CHARACTERISTIC DFTEAHB DNOTDFTEAD DSTEMIN FBTEB FBTEVA FETATEBN FKATEB FQTEDL FQTEVA FRHB FSRFTEF FTEADAB FTEADMX FTEFHB FTEHB FTEINIX FUMRBRK FVERMN FVERZDYN FVRMDYN IMSTTPINI KFDPSTE KFETATE KFFQTEFR KFFTEAN KFFTEAX KFNDDPSTE KFQTE KFTADMS KFTATX KFTEKA KHCTEMN KHCTEMX KLFILGWRTE MNHUBFTEMN MSDKLMMN NOTDFTEAD NVERZMN TFTEINI TFTEINITP TQTEAB TQTEDAB TVSATEM ZBTEML ZDDPSSOLTE ZETATE ZFTEADMOD ZKFTEAD ZMLTE ZMSSGIN ZTETDONOFF /end DEF_CHARACTERISTIC
 /begin REF_CHARACTERISTIC KUMSRL SDM05TESB SML06TEUB SNM04TEUB SQM05TEUB TEMIN /end REF_CHARACTERISTIC
 /begin IN_MEASUREMENT B_atmtpa B_evloc B_frmax B_frmax2 B_frmin B_frmin2 B_katfz B_lr B_lr2 B_nmot B_nswo1 B_qtedab B_sab B_te B_tef B_tei B_ten B_tep dpssol_w dps_uw dps_w esst_sdm05tesb esst_sml06teub esst_snm04teub esst_sqm05teub frm2_w frm_w kfdps_aus mifa_w miopt_w ml mlsol_w ml_w msdkalm_w mste mstedte_w msteo_w mste_w nmot nmot_w ps_w pu rl rlsol_w tans te2_w te_w tmot wdkba /end IN_MEASUREMENT
 /begin OUT_MEASUREMENT B_lrar B_teabb B_tehb B_tehbx dmssginr dpssolte_w dpstevf_w dpste_w etate fkatei frmit frmit_w frmxa fteadf fteadmod_w ftead_w ftefva_w mitebg_w mnhubfte_w mstesoll_w nddpste_in qmsdyn rkte_w /end OUT_MEASUREMENT
 /begin LOC_MEASUREMENT B_bgwrte B_gwrte B_teakt dftef_w dkatefrg dkhc_w dmlftef dstert20_w etateint etatesol fbetate fbkate fgwrte fkateapp fkatefrg fkates fngwrte fregfte frmxaold_w frmxa_w ftadmste fteadf_w ftefsold_w ftefsoll_w ftefva ftefvab ftefvamx_w fteml fvermte_w gwrtectr imsteini khc_w kteev_w ktetevvz_w ktetev_w ml_w_teb mssginmn_w mssgin_w msteev_w mstesmx_w pspu qtetemin rlteev_w /end LOC_MEASUREMENT
/end FUNCTION
/begin FUNCTION TEBEB "14.20     Einschaltbedingungen Tankentl¸ftung" /begin DEF_CHARACTERISTIC CWTEACFG LAMTEMN LAMTEMX TMSTTE TMTE TTEAUS /end DEF_CHARACTERISTIC
 /begin IN_MEASUREMENT B_atmtpa B_dldpte B_dllra B_dsls B_dteaa B_eobdlr B_fraoan B_ftedab B_lamka B_lamka2 B_lamsdef B_lr B_lr2 B_lrssa B_lrssa2 B_m8te B_mdarv B_mlrsa B_sbbvk B_sbbvk2 B_sls B_stend B_tep B_tldinfo B_tldobd lamsons_w tateist_w tmot tmst /end IN_MEASUREMENT
 /begin OUT_MEASUREMENT B_edmtl B_qtedab B_te B_tef B_tei B_ten /end OUT_MEASUREMENT
/end FUNCTION
/begin FUNCTION TEMPKON "4.40      Temperatur-Konvertermodul"
 /begin IN_MEASUREMENT tabgm2_w tabgmab tabgmab2 tabgm_w tatu tikatm2_w tikatm_w tkatm2_w tkatmab tkatmab2 tkatm_w tmot /end IN_MEASUREMENT
 /begin OUT_MEASUREMENT tahso2_w tahsoab2_w tahsoab_w tahsom2_w tahsom_w tahso_w taikrm2_w taikrm_w tanhkm2_w tanhkm_w tanvk2_w tanvkm2_w tanvkm_w tanvk_w tatuk tatuk_w tavhkm2_w tavhkm_w tavrom2_w tavrom_w tavso2_w tavsoab2_w tavsoab_w tavsom2_w tavsom_w tavso_w tavvkm2_w tavvkm_w tkihkm2_w tkihkm_w tkiuem2_w tkiuem_w tkivkm2_w tkivkm_w tmotk tmotk_w /end OUT_MEASUREMENT
/end FUNCTION
/begin FUNCTION TI_CB_CERDD "" /end FUNCTION
/begin FUNCTION TI_CB_NS "" /end FUNCTION
/begin FUNCTION TI_CB_RERDTC "" /begin IN_MEASUREMENT fcmEnd /end IN_MEASUREMENT /end FUNCTION
/begin FUNCTION TI_CB_RFCMS "" /begin IN_MEASUREMENT fcmEnd /end IN_MEASUREMENT /end FUNCTION
/begin FUNCTION TI_CB_ROSMR ""
 /begin REF_CHARACTERISTIC DLAHISATO DLAHISATU DYNLSUTO DYNLSUTU LAMSSAMN LAMSSAMX USMNSHMN USMNSHMX USMXSHMN USMXSHMX USRHKSHJ /end REF_CHARACTERISTIC
 /begin IN_MEASUREMENT B_lsh B_lsh2 B_lsv B_lsv2 dlahisa dlahisa2 dynlsusa dynlsusa2 lamsisa lamsisa2 lamsosa lamsosa2 usmnshn usmnshn2 usmxshn usmxshn2 /end IN_MEASUREMENT
/end FUNCTION
/begin FUNCTION TI_CB_RPTFF "" /begin IN_MEASUREMENT B_xff ffzdfp /end IN_MEASUREMENT /end FUNCTION
/begin FUNCTION TI_CB_UTILITIES "" /begin IN_MEASUREMENT fcmEnd /end IN_MEASUREMENT /end FUNCTION
/begin FUNCTION TI_K2_CDI_B "" /begin IN_MEASUREMENT fcmEnd /end IN_MEASUREMENT /end FUNCTION
/begin FUNCTION ti_k2_er_b "" /begin IN_MEASUREMENT nmot_w /end IN_MEASUREMENT /end FUNCTION
/begin FUNCTION ti_k2_rdbli_b "" /begin REF_CHARACTERISTIC NUEMAX /end REF_CHARACTERISTIC
 /begin IN_MEASUREMENT anznmax anzpbr_w B_acc B_admtll B_agrrdy B_bl B_br B_cdagr B_cdhsv B_cdlsv B_cdsls B_cdtes B_dylsu B_dylsu2 B_dylsuav B_dylsuav2 B_fgrat B_fgrhsa B_fgrtbe B_fgrtse B_fgrtve B_fgrtwa B_fhz B_gap B_hshe B_hshe2 B_hsrdy B_hsve B_hsve2 B_katfz B_katrdy B_ko B_kutoelh B_lkrall B_ll B_lr B_lr2 B_lsrdy B_nac B_nftev B_nsub B_sa B_sbbhk B_sbbhk2 B_sbbvk B_sbbvk2 B_slp B_slsrdy B_tesrdy B_umae B_vl disa_sta dkatstat dkatstat2 evz_austot fcmEnd flglrs flglrs2 fr2_w fr_w gangtoelh ipteskf_w iptglmn_w iptref_w kmstmil_w kmstnmax kmstpbr_w kmtoelh kva_korr llsstat lutsfi1_w lutsfi2_w lutsfi3_w lutsfi4_w lutsfi5_w lutsfi6_w lutsfi7_w lutsfi8_w L_fgr miist_w mitoelh mshfm_w nmaxvk_w nmottoelh nmot_w nsol ntoelh1 oscdktf2_w oscdktf_w slsstat stpdmtl stpdmtla svvtansch svvtansch2 tans tesstat tmot tmottoelh toelh toelhkos top_w tumgtoelh ub upwg1_w uulsuv2_w uulsuv_w vfzgtoelh wdkba wnwi_w wpedtoelh zwout /end IN_MEASUREMENT
/end FUNCTION
/begin FUNCTION TI_K2_SPC_B "" /begin IN_MEASUREMENT B_bt B_fa nmot /end IN_MEASUREMENT /end FUNCTION
/begin FUNCTION ti_k2_sprbli_b ""
 /begin IN_MEASUREMENT B_clradbbo B_clradfof B_clradhoe B_clradkr B_clradkrd B_clradllr B_clradlr B_clradlra B_clradlrh B_clradmhb B_clradmsz B_clradvvt B_fadisa B_fadk B_fadmtle B_fadmtls B_fadylsu B_fadylsu2 B_faevz B_fakat B_fakat2 B_falls B_falr B_falra B_falsh B_falsh2 B_falsv B_falsv2 B_fapllsu B_fapllsu2 B_fapmmess B_fasls B_fates B_favvtal B_grdst B_wdksap /end IN_MEASUREMENT
/end FUNCTION
/begin FUNCTION ti_k2_strbli_b ""
 /begin IN_MEASUREMENT B_auswrt B_clradbbo B_clradfof B_clradhoe B_clradkr B_clradkrd B_clradllr B_clradlr B_clradlra B_clradlrh B_clradmhb B_clradmsz B_clradvvt B_dylsu B_dylsu2 B_dylsuav B_dylsuav2 B_eepwf B_fa B_fadisa B_fadk B_fadmtle B_fadmtls B_faevz B_fakat B_fakat2 B_falls B_falr B_falra B_falsh B_falsh2 B_falsv B_falsv2 B_fapmmess B_fasls B_fates B_favvtal B_gap B_grdst B_inistw B_kl15 B_ll B_nmot B_resstw B_st B_timerr B_wdksap codcan disa_sta evz_austot flglrs flglrs2 llsstat nmot_w nsolfa pm_akt pm_fre pm_mod pm_ta pm_td slsstat stw_prog_frei_mod stw_prog_frei_ta stw_prog_frei_td svvtansch svvtansch2 tesstat tmot top_w ttimout vvtal /end IN_MEASUREMENT
 /begin OUT_MEASUREMENT B_clradiha B_faadav B_fabttreg devoff STRBLI_Bits_1 /end OUT_MEASUREMENT
/end FUNCTION
/begin FUNCTION ti_k2_wdbli_b "" /begin IN_MEASUREMENT kva_korr /end IN_MEASUREMENT /end FUNCTION
/begin FUNCTION TI_UTILIT "" /begin IN_MEASUREMENT fcmEnd /end IN_MEASUREMENT /end FUNCTION
/begin FUNCTION ti_vm_dnmt_b "" /begin IN_MEASUREMENT nmot_w /end IN_MEASUREMENT /end FUNCTION
/begin FUNCTION UCFGRC ""
 /begin DEF_CHARACTERISTIC FGRC_BFGR_DAT_UC FGRC_MIFA_DAT_UC FGRC_SFLAGS_DAT_UC FGRC_VFGR_DAT_UC VMINACC_UC VMIN_UC /end DEF_CHARACTERISTIC
 /begin IN_MEASUREMENT aktqu_uc /end IN_MEASUREMENT
 /begin OUT_MEASUREMENT abfgrc_uc B_fgr_bt B_fgr_uc mfgr_uc mifa_bt vfgr_bt /end OUT_MEASUREMENT
/end FUNCTION
/begin FUNCTION UCMIST ""
 /begin DEF_CHARACTERISTIC DZWKFMX_UC KFDZWKF_UC KFMI_UC KFZW_UC KLDZWQ_UC KLFAKSP_UC KLZL1_UC KLZL2_UC MIST_FRKSCH_DAT_UC MIST_LAMB1_DAT_UC MIST_LAMB2_DAT_UC MIST_NMOT_DAT_UC MIST_NMV08_UC MIST_RLV08_UC MIST_RL_DAT_UC MIST_ZW1_DAT_UC MIST_ZW2_DAT_UC /end DEF_CHARACTERISTIC
 /begin IN_MEASUREMENT aktqu_uc nmot_uc nmst08_uc /end IN_MEASUREMENT
 /begin OUT_MEASUREMENT abmist_uc dzwkoef_uc dzwq_uc frksch_uc lamb1_uc lamb2_uc mi_uc nsc_c_uc rlst08_uc rl_uc /end OUT_MEASUREMENT
 /begin LOC_MEASUREMENT dzw1_uc dzw2_uc dzw_uc etafrks_uc etazw_uc miopt_uc zw1_uc zw2_uc zwopt_uc zwout_uc /end LOC_MEASUREMENT
/end FUNCTION
/begin FUNCTION UCMSRC ""
 /begin DEF_CHARACTERISTIC CWBZMSR_UC DBDSCMX_UC DBDSC_T_UC MSRC_BMSR_DAT_UC MSRC_BZDSCA_DAT_UC MSRC_BZDSC_DAT_UC MSRC_CODCAN_DAT_UC MSRC_CSDSC_DAT_UC MSRC_C_DAT_UC MSRC_DBDSC_DAT_UC MSRC_MIMSRCPL_DAT_UC MSRC_MIMSR_DAT_UC MSRC_MKSASRL_DAT_UC MSRC_MKSASRS_DAT_UC MSRC_SBIT_DAT_UC MSRC_T_UC /end DEF_CHARACTERISTIC
 /begin IN_MEASUREMENT aktqu_uc /end IN_MEASUREMENT
 /begin OUT_MEASUREMENT abmsrc_uc B_nomsr_bt B_nomsr_uc B_npdsc_uc B_sidsc_uc codcan_uc dscstat_uc ei_msrc_uc miasrl_uc miasrs_uc mimsrcpl_bt mimsr_bt mimsr_uc mksasrl_uc mksasrs_uc mmsr_uc /end OUT_MEASUREMENT
 /begin LOC_MEASUREMENT bz_dsca_uc dbdsc_c_uc msrc_c_uc /end LOC_MEASUREMENT
/end FUNCTION
/begin FUNCTION UCMVER ""
 /begin DEF_CHARACTERISTIC MVER_C_DAT_UC MVER_MI_DAT_UC MVER_MZF_DAT_UC MVER_MZO_DAT_UC MVER_RFLAGS_DAT_UC MVER_T_UC /end DEF_CHARACTERISTIC
 /begin IN_MEASUREMENT aktqu_uc B_i_ska_uc mi_uc mzf_uc mzo_uc /end IN_MEASUREMENT
 /begin OUT_MEASUREMENT abmver_uc ei_mver_uc mver_c_uc mzfo_uc /end OUT_MEASUREMENT
 /begin LOC_MEASUREMENT mdif_w_uc /end LOC_MEASUREMENT
/end FUNCTION
/begin FUNCTION UCMZF ""
 /begin DEF_CHARACTERISTIC MZFFIL_UC MZFTV_UC MZF_LOW_DAT_UC MZF_MZF_DAT_UC MZF_MZ_DAT_UC MZF_PTR_DAT_UC MZF_REG_DAT_UC /end DEF_CHARACTERISTIC
 /begin IN_MEASUREMENT aktqu_uc mz_uc /end IN_MEASUREMENT
 /begin OUT_MEASUREMENT abmzf_uc mzf_l_uc mzf_p_uc mzf_r_uc mzf_uc /end OUT_MEASUREMENT
 /begin LOC_MEASUREMENT mzf_x_uc mzf_y_uc /end LOC_MEASUREMENT
/end FUNCTION
/begin FUNCTION UCMZUL ""
 /begin DEF_CHARACTERISTIC KFDMP0_UC KFDMP1_UC KFDMT0_UC KFDMT1_UC KFMOF_UC KFPZU0_UC KFPZU1_UC KLLLRZU_UC KLMIMAX_UC KLMIMIN_UC KLMZUMN_UC MDV08_UC MZUL_MFGR_DAT_UC MZUL_MMSR_DAT_UC MZUL_MRLINI_DAT_UC MZUL_MSGS_DAT_UC MZUL_NFLAGS_DAT_UC MZUL_NMOT_DAT_UC MZUL_NMV08_UC MZUL_SPSNV08_UC MZUL_SPSN_DAT_UC MZUL_TMOT_DAT_UC MZUL_VKPEDCH_DAT_UC MZUL_ZFLAGS_DAT_UC SPSNLL_UC TMOMIN_UC TMOV08_UC /end DEF_CHARACTERISTIC
 /begin IN_MEASUREMENT aktqu_uc mfgr_uc mmsr_uc mrlini_uc msgs_uc /end IN_MEASUREMENT
 /begin OUT_MEASUREMENT abmzul_uc B_klmzu_uc mped_uc mzo_uc mz_uc nmot_uc nmst08_uc spnst08_uc spsn_uc tmot_uc vkpedch_uc /end OUT_MEASUREMENT
 /begin LOC_MEASUREMENT mdst08_uc tmost08_uc tmotmn_uc /end LOC_MEASUREMENT
/end FUNCTION
/begin FUNCTION UCREAC ""
 /begin DEF_CHARACTERISTIC KLNPED_UC REAC_C1_DAT_UC REAC_C2_DAT_UC REAC_EVZAUS_DAT_UC REAC_FUELA_DATH_UC REAC_FUELA_DATL_UC REAC_FUEL_DATH_UC REAC_FUEL_DATL_UC REAC_NMOT_DAT_UC REAC_RFLAGS_DAT_UC REAC_SPSN_DAT_UC REAC_T1_UC REAC_T2_UC SKADRHZ_UC /end DEF_CHARACTERISTIC
 /begin IN_MEASUREMENT aktqu_uc B_i_ska_uc nmot_uc spsn_uc /end IN_MEASUREMENT
 /begin OUT_MEASUREMENT abreac_uc ei_reac_uc evzaust_bt fuel_co_bt fuel_co_uc reac_c1_uc reac_c2_uc /end OUT_MEASUREMENT
 /begin LOC_MEASUREMENT nska_uc /end LOC_MEASUREMENT
/end FUNCTION
/begin FUNCTION UCRKC "" /begin DEF_CHARACTERISTIC RKC_MRLINI_DAT_UC /end DEF_CHARACTERISTIC /begin IN_MEASUREMENT aktqu_uc /end IN_MEASUREMENT /begin OUT_MEASUREMENT abrkc_uc ei_rkc_uc mrlini_uc /end OUT_MEASUREMENT /end FUNCTION
/begin FUNCTION UCSGSC ""
 /begin DEF_CHARACTERISTIC DBEGSMX_UC DBEGS_T_UC SGSC_BSGS_DAT_UC SGSC_BZEGSA_DAT_UC SGSC_BZEGS_DAT_UC SGSC_CODCAN_DAT_UC SGSC_CODGET_DAT_UC SGSC_CSEGS_DAT_UC SGSC_C_DAT_UC SGSC_DBEGS_DAT_UC SGSC_MISGSCPL_DAT_UC SGSC_MISGS_DAT_UC SGSC_MKSGES_DAT_UC SGSC_MKSGS_DAT_UC SGSC_MKSWAND_DAT_UC SGSC_NOREL_DAT_UC SGSC_OBD_DAT_UC SGSC_SBIT_DAT_UC SGSC_T_UC /end DEF_CHARACTERISTIC
 /begin IN_MEASUREMENT aktqu_uc codcan_uc /end IN_MEASUREMENT
 /begin OUT_MEASUREMENT absgsc_uc B_mdegs_uc B_nosgs_bt B_nosgs_uc B_npegs_uc B_siegs_uc can_id_uc codget_bt egsstat_uc egstemp_uc ei_sgsc_uc misgscpl_bt misgs_bt mksges_uc mksgs_uc mkswand_uc msgs_uc /end OUT_MEASUREMENT
 /begin LOC_MEASUREMENT bz_egsa_uc dbegs_c_uc sgsc_c_uc /end LOC_MEASUREMENT
/end FUNCTION
/begin FUNCTION UCURAM "" /begin DEF_CHARACTERISTIC CW_BDE_UC /end DEF_CHARACTERISTIC
 /begin OUT_MEASUREMENT b_flags_uc B_i_ska_uc c_flags_uc n_flags_uc r_flags_uc s_flags_uc t_flags_uc z_flags_uc /end OUT_MEASUREMENT
/end FUNCTION
/begin FUNCTION UEINVVT "1.20      EGAS ‹berwachungskonzept: Eingangssignale f¸r VVT-Grˆﬂen" /begin IN_MEASUREMENT evhubi2_w evhubi_w /end IN_MEASUREMENT /begin OUT_MEASUREMENT evhbi2_w evhbi_w /end OUT_MEASUREMENT /end FUNCTION
/begin FUNCTION UETM "2.10      Motor¸bertemperatur-Anzeige" /begin DEF_CHARACTERISTIC DUETMOT TUETM UETMOT /end DEF_CHARACTERISTIC /begin IN_MEASUREMENT B_kl15 B_pwf B_stend nmot tmot tnst_w /end IN_MEASUREMENT /begin OUT_MEASUREMENT B_uetm B_uetmc UetmNvBits /end OUT_MEASUREMENT /begin LOC_MEASUREMENT B_nouetm /end LOC_MEASUREMENT /end FUNCTION
/begin FUNCTION UFABLAUF "" /begin OUT_MEASUREMENT raster_um /end OUT_MEASUREMENT /end FUNCTION
/begin FUNCTION UFACCC "9.20      EGAS ‹berwachungskonzept: ACC Eingangssignal¸berwachung der Funktion¸berwachung" /begin DEF_CHARACTERISTIC ACCC_T_UM DBACCMX_UM DBACC_T_UM /end DEF_CHARACTERISTIC /begin IN_MEASUREMENT B_accab B_noacc_fr codcan modul_c_um raster_um /end IN_MEASUREMENT
 /begin OUT_MEASUREMENT accctr_um accstat_um accsyof_um B_accen_um B_mdacc_um B_noacc_um B_npacc_um B_savac_um B_siacc_um codcan_um mkpracc_um mksacc_um /end OUT_MEASUREMENT
 /begin LOC_MEASUREMENT accc_c_um accc_c_ur bz_acca_um bz_acca_ur codcan_ur dbacc_c_um dbacc_c_ur rqacc_um stacc_um /end LOC_MEASUREMENT
/end FUNCTION
/begin FUNCTION UFEING "12.30     EGAS ‹berwachungskonzept: Eingangssignal¸bernahme f¸r Funktions¸berwachung" /begin IN_MEASUREMENT B_i_ska_fr B_notlu_fr B_ub_ok modul_c_um raster_um /end IN_MEASUREMENT /end FUNCTION
/begin FUNCTION UFFGRC "6.40      EGAS ‹berwachungskonzept: FGR-‹berwachung der Funktions¸berwachung" /begin DEF_CHARACTERISTIC VMINACC_UM VMIN_UM /end DEF_CHARACTERISTIC /begin IN_MEASUREMENT B_fgr mifa modul_c_um raster_um vfgr_w /end IN_MEASUREMENT /begin OUT_MEASUREMENT B_fgr_um mfgr_um /end OUT_MEASUREMENT /begin LOC_MEASUREMENT mfgr_ur /end LOC_MEASUREMENT /end FUNCTION
/begin FUNCTION UFFGRE "35.10     EGAS ‹berwachungskonzept: FGR-Eingangsinfos f¸r die Funktions¸berwachung"
 /begin DEF_CHARACTERISTIC BRACC_T_UM BREMS_T_UM DBFGRMX_UM DBFGR_T_UM DBSZL_T_UM FGRE_T_UM FGR_T_UM /end DEF_CHARACTERISTIC
 /begin IN_MEASUREMENT B_acc B_fgrab B_fgrat B_fgren B_fgrhsa B_fgrtbe B_fgrtve B_fgrtwa codcan_um modul_c_um raster_um szlbctr S_bls S_brs /end IN_MEASUREMENT
 /begin OUT_MEASUREMENT B_fgrat_um B_fgren_um B_fgrsb_um B_fgrsd_um B_fgrsu_um B_fgrsv_um B_fgrwa_um B_npszl_um B_siszl_um fgrbh_um /end OUT_MEASUREMENT
 /begin LOC_MEASUREMENT bracc_c_um bracc_c_ur brems_c_um brems_c_ur bz_fgra_um bz_fgra_ur bz_szla_um bz_szla_ur dbfgr_c_um dbfgr_c_ur dbszl_c_um dbszl_c_ur fgre_c_um fgre_c_ur fgr_c_um fgr_c_ur /end LOC_MEASUREMENT
/end FUNCTION
/begin FUNCTION UFMIST "13.10     EGAS ‹berwachungskonzept: Ist-Moment der Funktions¸berwachung"
 /begin DEF_CHARACTERISTIC DZWKFMX_UM KFDZWKF_UM KFMI_UM KFZW_UM KLDZWQ_UM KLFAKSP_UM KLZL1_UM KLZL2_UM /end DEF_CHARACTERISTIC
 /begin REF_CHARACTERISTIC NMV08_UM RLV08_UM /end REF_CHARACTERISTIC
 /begin IN_MEASUREMENT frksch_um lamb1_um lamb2_um modul_c_um nmot_um nmst08_um raster_um rlst08_um rl_um zw1_um zw2_um /end IN_MEASUREMENT
 /begin OUT_MEASUREMENT dzwkoef_um dzwq_um mi_um /end OUT_MEASUREMENT
 /begin LOC_MEASUREMENT dzw1_um dzw2_um dzw_um dzw_ur etafrks_um etazw_um miopt_um mi_ur zwopt_um zwout_um /end LOC_MEASUREMENT
/end FUNCTION
/begin FUNCTION UFMSRC "33.10     EGAS ‹berwachungskonzept: MSR-Eingriff-‹berwachung f¸r die Funktions¸berwachung" /begin DEF_CHARACTERISTIC CWBZMSR_UM DBDSCMX_UM DBDSC_T_UM MSRC_T_UM /end DEF_CHARACTERISTIC
 /begin IN_MEASUREMENT B_nomsr_fr codcan codcan_um mimsr mimsrcpl modul_c_um raster_um /end IN_MEASUREMENT
 /begin OUT_MEASUREMENT B_nomsr_um B_npdsc_um B_sidsc_um dscstat_um ei_msrc_um miasrl_um miasrs_um mimsr_um mksasrl_um mksasrs_um mmsr_um /end OUT_MEASUREMENT
 /begin LOC_MEASUREMENT bz_dsca_um bz_dsca_ur dbdsc_c_um dbdsc_c_ur mmsr_ur msrc_c_um msrc_c_ur /end LOC_MEASUREMENT
/end FUNCTION
/begin FUNCTION UFMVER "4.10      EGAS ‹berwachungskonzept: Momentenvergleich der Funktions¸berwachung" /begin DEF_CHARACTERISTIC MVER_T_UM /end DEF_CHARACTERISTIC /begin IN_MEASUREMENT B_i_ska_um mi_um modul_c_um mzf_um mzo_um raster_um /end IN_MEASUREMENT /begin OUT_MEASUREMENT ei_mver_um /end OUT_MEASUREMENT /begin LOC_MEASUREMENT mdif_w_um mver_c_um mver_c_ur mzfo_um /end LOC_MEASUREMENT /end FUNCTION
/begin FUNCTION UFMZF "2.10      EGAS ‹berwachungskonzept: Momentenfilter f¸r die Funktions¸berwachung" /begin DEF_CHARACTERISTIC MZFFIL_UM MZFTV_UM /end DEF_CHARACTERISTIC /begin IN_MEASUREMENT modul_c_um mz_um raster_um /end IN_MEASUREMENT /begin OUT_MEASUREMENT mzf_um /end OUT_MEASUREMENT
 /begin LOC_MEASUREMENT mzf_l_um mzf_l_ur mzf_p_um mzf_p_ur mzf_r_um mzf_r_ur mzf_ur /end LOC_MEASUREMENT
/end FUNCTION
/begin COMPU_METHOD B_TRUE "boolsche Zust‰nde, positive Logik" TAB_VERB "%6.3" "" COMPU_TAB_REF B_TRUE /end COMPU_METHOD
/begin COMPU_VTAB B_TRUE "boolsche Zust‰nde, positive Logik" TAB_VERB 2 0 "----" 1 "TRUE" /end COMPU_VTAB
/begin COMPU_METHOD DEZ "1 : 1 Umrechnug (dez/hex)" RAT_FUNC "%6.2" "" COEFFS 0 1 0 0 0 1 /end COMPU_METHOD
/begin COMPU_METHOD dez "1 : 1 Umrechnug (dez/hex)" RAT_FUNC "%6.2" "" COEFFS 0 1 0 0 0 1 /end COMPU_METHOD
/begin COMPU_METHOD fak_q0p00195 "" RAT_FUNC "%6.4" "-" COEFFS 0 65536 0 0 0 128 /end COMPU_METHOD
/begin COMPU_METHOD fak_q0p0195 "" RAT_FUNC "%6.4" "-" COEFFS 0 256 0 0 0 5 /end COMPU_METHOD
/begin COMPU_METHOD fak_q0p0439 "" RAT_FUNC "%6.4" "%/(Grad KWQ)" COEFFS 0 32 0 0 0 1.405 /end COMPU_METHOD
/begin COMPU_METHOD fak_q0p1 "" RAT_FUNC "%6.3" "-" COEFFS 0 1 0 0 0 0.1 /end COMPU_METHOD
/begin COMPU_METHOD fak_sb_b1 "" RAT_FUNC "%6.4" "-" COEFFS 0 256 0 0 0 2 /end COMPU_METHOD
/begin COMPU_METHOD fak_sb_b16 "" RAT_FUNC "%6.3" "-" COEFFS 0 256 0 0 0 32 /end COMPU_METHOD
/begin COMPU_METHOD fak_sb_b2 "" RAT_FUNC "%6.4" "-" COEFFS 0 256 0 0 0 4 /end COMPU_METHOD
/begin COMPU_METHOD fak_sb_b64 "" RAT_FUNC "%6.3" "-" COEFFS 0 256 0 0 0 128 /end COMPU_METHOD
/begin COMPU_METHOD fak_sb_q0p5 "" RAT_FUNC "%6.3" "-" COEFFS 0 256 0 0 0 128 /end COMPU_METHOD
/begin COMPU_METHOD fak_sw_b2 "" RAT_FUNC "%7.6" "-" COEFFS 0 65536 0 0 0 4 /end COMPU_METHOD
/begin COMPU_METHOD fak_sw_b32 "" RAT_FUNC "%6.5" "-" COEFFS 0 65536 0 0 0 64 /end COMPU_METHOD
/begin COMPU_METHOD fak_sw_b64 "" RAT_FUNC "%6.4" "-" COEFFS 0 65536 0 0 0 128 /end COMPU_METHOD
/begin COMPU_METHOD fak_ub_b0p03125 "" RAT_FUNC "%6.5" "-" COEFFS 0 256 0 0 0 0.03125 /end COMPU_METHOD
/begin COMPU_METHOD fak_ub_b0p25 "" RAT_FUNC "%10.7" "-" COEFFS 0 256 0 0 0 0.25 /end COMPU_METHOD
/begin COMPU_METHOD fak_ub_b0p5 "" RAT_FUNC "%6.4" "-" COEFFS 0 256 0 0 0 0.5 /end COMPU_METHOD
/begin COMPU_METHOD fak_ub_b1 "" RAT_FUNC "%6.4" "-" COEFFS 0 256 0 0 0 1 /end COMPU_METHOD
/begin COMPU_METHOD fak_ub_b16 "" RAT_FUNC "%6.4" "-" COEFFS 0 256 0 0 0 16 /end COMPU_METHOD
/begin COMPU_METHOD fak_ub_b1p25_o0p75 "" RAT_FUNC "%6.3" "-" COEFFS 0 1 -0.75 0 0 0.00195313 /end COMPU_METHOD
/begin COMPU_METHOD fak_ub_b2 "" RAT_FUNC "%6.4" "-" COEFFS 0 256 0 0 0 2 /end COMPU_METHOD
/begin COMPU_METHOD fak_ub_b32 "" RAT_FUNC "%6.3" "-" COEFFS 0 256 0 0 0 32 /end COMPU_METHOD
/begin COMPU_METHOD fak_ub_b4 "" RAT_FUNC "%6.4" "-" COEFFS 0 256 0 0 0 4 /end COMPU_METHOD
/begin COMPU_METHOD fak_ub_b64 "" RAT_FUNC "%6.3" "-" COEFFS 0 256 0 0 0 64 /end COMPU_METHOD
/begin COMPU_METHOD fak_ub_b8 "" RAT_FUNC "%6.4" "-" COEFFS 0 256 0 0 0 8 /end COMPU_METHOD
/begin COMPU_METHOD fak_uw_b0p5 "" RAT_FUNC "%8.7" "-" COEFFS 0 65536 0 0 0 0.5 /end COMPU_METHOD
/begin COMPU_METHOD fak_uw_b1 "" RAT_FUNC "%7.6" "-" COEFFS 0 65536 0 0 0 1 /end COMPU_METHOD
/begin COMPU_METHOD fak_uw_b16 "" RAT_FUNC "%6.5" "-" COEFFS 0 65536 0 0 0 16 /end COMPU_METHOD
/begin COMPU_METHOD fak_uw_b2 "" RAT_FUNC "%7.6" "-" COEFFS 0 65536 0 0 0 2 /end COMPU_METHOD
/begin COMPU_METHOD fak_uw_b4 "" RAT_FUNC "%7.6" "-" COEFFS 0 65536 0 0 0 4 /end COMPU_METHOD
/begin COMPU_METHOD fuel_ub_q1 "" RAT_FUNC "%6.2" "l" COEFFS 0 1 0 0 0 1 /end COMPU_METHOD
/begin COMPU_METHOD hub_uw_q0p001 "" RAT_FUNC "%6.5" "mm" COEFFS 0 1000 0 0 0 1 /end COMPU_METHOD
/begin COMPU_METHOD kwq_ub_q0p35576 "" RAT_FUNC "%6.3" "Grad KWQ" COEFFS 0 25500 0 0 0 9072 /end COMPU_METHOD
/begin COMPU_METHOD md_q0p5 "" RAT_FUNC "%6.3" "Nm" COEFFS 0 1 0 0 0 0.5 /end COMPU_METHOD
/begin COMPU_METHOD m_ub_b1020 "" RAT_FUNC "%6.2" "kg/h" COEFFS 0 1 0 0 0 4 /end COMPU_METHOD
/begin COMPU_METHOD m_ub_q0p0444 "" RAT_FUNC "%6.4" "g" COEFFS 0 1 0 0 0 0.0444 /end COMPU_METHOD
/begin COMPU_METHOD m_uw_b25p6 "" RAT_FUNC "%6.5" "kg/h" COEFFS 0 65536 0 0 0 25.6 /end COMPU_METHOD
/begin COMPU_METHOD m_uw_b6553p5 "" RAT_FUNC "%6.3" "kg/h" COEFFS 0 1 0 0 0 0.1 /end COMPU_METHOD
/begin COMPU_METHOD nmot_sb_q10 "" RAT_FUNC "%6.1" "1/min" COEFFS 0 1 0 0 0 10 /end COMPU_METHOD
/begin COMPU_METHOD nmot_ub_q10 "" RAT_FUNC "%6.1" "1/min" COEFFS 0 1 0 0 0 10 /end COMPU_METHOD
/begin COMPU_METHOD nmot_ub_q40 "" RAT_FUNC "%6.1" "1/min" COEFFS 0 1 0 0 0 40 /end COMPU_METHOD
/begin COMPU_METHOD nmot_uw_q0p25 "" RAT_FUNC "%6.3" "1/min" COEFFS 0 1 0 0 0 0.25 /end COMPU_METHOD
/begin COMPU_METHOD perio_sw_b1p562 "" RAT_FUNC "%7.6" "1/s" COEFFS 0 65536 0 0 0 3.124 /end COMPU_METHOD
/begin COMPU_METHOD perio_sw_b6p125 "" RAT_FUNC "%6.5" "1/s" COEFFS 0 65536 0 0 0 12.25 /end COMPU_METHOD
/begin COMPU_METHOD perio_ub_b0p012207 "" RAT_FUNC "%10.8" "1/s" COEFFS 0 256 0 0 0 0.012207 /end COMPU_METHOD
/begin COMPU_METHOD perio_ub_b6p125 "" RAT_FUNC "%6.4" "1/s" COEFFS 0 256 0 0 0 6.125 /end COMPU_METHOD
/begin COMPU_METHOD p_q0p039 "" RAT_FUNC "%6.4" "hPa" COEFFS 0 256 0 0 0 10 /end COMPU_METHOD
/begin COMPU_METHOD p_q0p039s32768 "" RAT_FUNC "%7.1" "hPa" COEFFS 0 256 327680 0 0 10 /end COMPU_METHOD
/begin COMPU_METHOD p_sb_q32 "" RAT_FUNC "%6.3" "hPa" COEFFS 0 256 0 0 0 64 /end COMPU_METHOD
/begin COMPU_METHOD p_uw_q0p039 "" RAT_FUNC "%6.4" "hPa" COEFFS 0 256 0 0 0 10 /end COMPU_METHOD
/begin COMPU_METHOD p_uw_q0p078 "" RAT_FUNC "%6.4" "hPa" COEFFS 0 256 0 0 0 20 /end COMPU_METHOD
/begin COMPU_METHOD rel_q0p00195 "" RAT_FUNC "%6.4" "%" COEFFS 0 65536 0 0 0 128 /end COMPU_METHOD
/begin COMPU_METHOD rel_q0p09726 "" RAT_FUNC "%6.3" "%" COEFFS 0 255 0 0 0 24.9 /end COMPU_METHOD
/begin COMPU_METHOD rel_sw_b100 "" RAT_FUNC "%6.4" "%" COEFFS 0 32768 0 0 0 100 /end COMPU_METHOD
/begin COMPU_METHOD rel_sw_q0p0234 "" RAT_FUNC "%6.4" "%/seg" COEFFS 0 32 0 0 0 0.75 /end COMPU_METHOD
/begin COMPU_METHOD rel_sw_q0p0468 "" RAT_FUNC "%6.4" "%" COEFFS 0 65536 0 0 0 3072 /end COMPU_METHOD
/begin COMPU_METHOD rel_ub_b100 "" RAT_FUNC "%6.3" "%" COEFFS 0 256 0 0 0 100 /end COMPU_METHOD
/begin COMPU_METHOD rel_ub_b127p5 "" RAT_FUNC "%6.3" "%" COEFFS 0 2 0 0 0 1 /end COMPU_METHOD
/begin COMPU_METHOD rel_ub_b99p6 "" RAT_FUNC "%6.3" "%" COEFFS 0 256 0 0 0 100 /end COMPU_METHOD
/begin COMPU_METHOD rel_ub_q0p00153 "" RAT_FUNC "%6.4" "%" COEFFS 0 256 0 0 0 0.3906 /end COMPU_METHOD
/begin COMPU_METHOD rel_ub_q0p3906 "" RAT_FUNC "%6.3" "%" COEFFS 0 256 0 0 0 100 /end COMPU_METHOD
/begin COMPU_METHOD rel_ub_q0p75 "" RAT_FUNC "%6.3" "%" COEFFS 0 1 0 0 0 0.75 /end COMPU_METHOD
/begin COMPU_METHOD rel_uw_b100 "" RAT_FUNC "%6.4" "%" COEFFS 0 65536 0 0 0 100 /end COMPU_METHOD
/begin COMPU_METHOD rel_uw_b192 "" RAT_FUNC "%6.4" "%" COEFFS 0 65536 0 0 0 192 /end COMPU_METHOD
/begin COMPU_METHOD rel_uw_b200 "" RAT_FUNC "%6.4" "%" COEFFS 0 65536 0 0 0 200 /end COMPU_METHOD
/begin COMPU_METHOD rel_uw_q0p0234 "" RAT_FUNC "%6.4" "%" COEFFS 0 32 0 0 0 0.75 /end COMPU_METHOD
/begin COMPU_METHOD rgrad_uw_b1280 "" RAT_FUNC "%6.4" "%/s" COEFFS 0 65536 0 0 0 1280 /end COMPU_METHOD
/begin COMPU_METHOD r_uw_q2 "" RAT_FUNC "%6.2" "Ohm" COEFFS 0 1 0 0 0 2 /end COMPU_METHOD
/begin COMPU_METHOD spg_q0p00039 "" RAT_FUNC "%6.5" "V" COEFFS 0 1 0 0 0 0.000390625 /end COMPU_METHOD
/begin COMPU_METHOD spg_ub_b5 "" RAT_FUNC "%6.4" "V" COEFFS 0 256 0 0 0 5 /end COMPU_METHOD
/begin COMPU_METHOD spg_ub_q0p0052_o0p2 "" RAT_FUNC "%6.3" "V" COEFFS 0 255 51 0 0 1.33 /end COMPU_METHOD
/begin COMPU_METHOD spg_ub_q0p019 "" RAT_FUNC "%6.4" "V" COEFFS 0 256 0 0 0 5 /end COMPU_METHOD
/begin COMPU_METHOD spg_uw_q0p00488 "" RAT_FUNC "%6.4" "V" COEFFS 0 1024 0 0 0 5 /end COMPU_METHOD
/begin COMPU_METHOD t100msxs_uw_b6553p5 "" RAT_FUNC "%6.3" "s" COEFFS 0 1 0 0 0 0.1 /end COMPU_METHOD
/begin COMPU_METHOD t100msxs_uw_q100 "" RAT_FUNC "%6.3" "s" COEFFS 0 1 0 0 0 0.1 /end COMPU_METHOD
/begin COMPU_METHOD t10msxs_ub_b2p55 "" RAT_FUNC "%6.4" "s" COEFFS 0 1 0 0 0 0.01 /end COMPU_METHOD
/begin COMPU_METHOD t10msxs_uw_b655p35 "" RAT_FUNC "%6.4" "s" COEFFS 0 1 0 0 0 0.01 /end COMPU_METHOD
/begin COMPU_METHOD t10ms_ub_b2550 "" RAT_FUNC "%7.2" "ms" COEFFS 0 1 0 0 0 10 /end COMPU_METHOD
/begin COMPU_METHOD t1p0usxms "" RAT_FUNC "%6.5" "ms" COEFFS 0 1000 0 0 0 1 /end COMPU_METHOD
/begin COMPU_METHOD t20msxs_ub_b5p1 "" RAT_FUNC "%6.4" "s" COEFFS 0 1 0 0 0 0.02 /end COMPU_METHOD
/begin COMPU_METHOD t20msxs_ub_q0p32 "" RAT_FUNC "%6.3" "s" COEFFS 0 256 0 0 0 81.92 /end COMPU_METHOD
/begin COMPU_METHOD t20msxs_uw_q640 "" RAT_FUNC "%6.2" "s" COEFFS 0 0 640 0 1 0 /end COMPU_METHOD
/begin COMPU_METHOD t20msxs_uw_q800 "" RAT_FUNC "%6.2" "s" COEFFS 0 0 800 0 1 0 /end COMPU_METHOD
/begin COMPU_METHOD t20ms_ub_b5100 "" RAT_FUNC "%7.2" "ms" COEFFS 0 1 0 0 0 20 /end COMPU_METHOD
/begin COMPU_METHOD t40msxs_uw_q0p04 "" RAT_FUNC "%6.4" "s" COEFFS 0 1 0 0 0 0.04 /end COMPU_METHOD
/begin COMPU_METHOD t40ms_ub_b10200 "" RAT_FUNC "%7.2" "ms" COEFFS 0 1 0 0 0 40 /end COMPU_METHOD
/begin COMPU_METHOD temp_q0p0234_o273 "" RAT_FUNC "%6.1" "Grad C" COEFFS 0 1 273.15 0 0 0.0234375 /end COMPU_METHOD
/begin COMPU_METHOD temp_q6_o273 "" RAT_FUNC "%6.1" "Grad C" COEFFS 0 1 273.15 0 0 6 /end COMPU_METHOD
/begin COMPU_METHOD temp_ub_b191p25 "" RAT_FUNC "%6.3" "Grad C" COEFFS 0 1 0 0 0 0.75 /end COMPU_METHOD
/begin COMPU_METHOD temp_ub_q0p75_o48 "" RAT_FUNC "%6.2" "Grad C" COEFFS 0 1 48 0 0 0.75 /end COMPU_METHOD
/begin COMPU_METHOD temp_ub_q5_o50 "" RAT_FUNC "%6.2" "Grad C" COEFFS 0 1 50 0 0 5 /end COMPU_METHOD
/begin COMPU_METHOD temp_uw_q0p75_o48 "" RAT_FUNC "%6.2" "Grad C" COEFFS 0 1 48 0 0 0.75 /end COMPU_METHOD
/begin COMPU_METHOD tog_ub_q0p5 "" RAT_FUNC "%6.3" "" COEFFS 0 2 0 0 0 1 /end COMPU_METHOD
/begin COMPU_METHOD t_min_q5p96em8 "" RAT_FUNC "%10.9" "min" COEFFS 0 1 0 0 0 5.96e-008 /end COMPU_METHOD
/begin COMPU_METHOD t_q0p01 "" RAT_FUNC "%6.4" "s" COEFFS 0 100 0 0 0 1 /end COMPU_METHOD
/begin COMPU_METHOD t_q0p1 "" RAT_FUNC "%6.3" "s" COEFFS 0 10 0 0 0 1 /end COMPU_METHOD
/begin COMPU_METHOD vfzg_uw_q0p00781 "" RAT_FUNC "%6.4" "km/h" COEFFS 0 1 0 0 0 0.0078125 /end COMPU_METHOD
/begin COMPU_METHOD vfzg_uw_q0p0625 "" RAT_FUNC "%6.4" "km/h" COEFFS 0 1 0 0 0 0.0625 /end COMPU_METHOD
/begin COMPU_METHOD wink_q0p00039 "" RAT_FUNC "%6.5" "Grad" COEFFS 0 2560 0 0 0 1 /end COMPU_METHOD
/begin COMPU_METHOD wink_uw_q0p1 "" RAT_FUNC "%6.3" "Grad" COEFFS 0 10 0 0 0 1 /end COMPU_METHOD
/begin COMPU_METHOD wkw_q0p8_o128 "" RAT_FUNC "%7.5" "Grad KW" COEFFS 0 10 1024 0 0 8 /end COMPU_METHOD
/begin COMPU_METHOD zk100msxs_ub_b25p5 "" RAT_FUNC "%6.3" "s" COEFFS 0 0 256 0 10 0 /end COMPU_METHOD
/begin COMPU_METHOD zk100msxs_uw_b655 "" RAT_FUNC "%6.1" "s" COEFFS 0 0 65536 0 10 0 /end COMPU_METHOD
/begin COMPU_METHOD zk100msxs_uw_b6553 "" RAT_FUNC "%6.1" "s" COEFFS 0 0 65536 0 10 0 /end COMPU_METHOD
/begin COMPU_METHOD zk20msxs_uw_b1310 "" RAT_FUNC "%6.1" "s" COEFFS 0 0 1310 0 1 0 /end COMPU_METHOD
/begin COMPU_METHOD zk40ms_ub_b10200 "" RAT_FUNC "%6.1" "ms" COEFFS 0 0 10240 0 1 40 /end COMPU_METHOD
/begin COMPU_METHOD zw_sb_q0p75 "" RAT_FUNC "%6.3" "Grad KW" COEFFS 0 255 0 0 0 191.25 /end COMPU_METHOD
/begin COMPU_METHOD zw_sb_q6 "" RAT_FUNC "%6.2" "Grad KW" COEFFS 0 1 0 0 0 6 /end COMPU_METHOD
/begin COMPU_METHOD zw_sb_qn0p75 "" RAT_FUNC "%6.4" "Grad KW" COEFFS 0 1 0 0 0 -0.75 /end COMPU_METHOD
/begin COMPU_METHOD zw_ub_q0p75 "" RAT_FUNC "%6.3" "Grad KW" COEFFS 0 255 0 0 0 191.25 /end COMPU_METHOD
/begin RECORD_LAYOUT FklWUb FNC_VALUES 1 UBYTE COLUMN_DIR DIRECT /end RECORD_LAYOUT
/begin RECORD_LAYOUT GkfWSb FNC_VALUES 1 SBYTE COLUMN_DIR DIRECT /end RECORD_LAYOUT
/begin RECORD_LAYOUT GkfWU8 FNC_VALUES 1 UBYTE COLUMN_DIR DIRECT /end RECORD_LAYOUT
/begin RECORD_LAYOUT GkfWUb FNC_VALUES 1 UBYTE COLUMN_DIR DIRECT /end RECORD_LAYOUT
/begin RECORD_LAYOUT GklWUb FNC_VALUES 1 UBYTE COLUMN_DIR DIRECT /end RECORD_LAYOUT
/begin RECORD_LAYOUT GklWUw FNC_VALUES 1 UWORD COLUMN_DIR DIRECT /end RECORD_LAYOUT
/begin RECORD_LAYOUT KfAxSwAySwSstxSwSstySwWSw NO_AXIS_PTS_X 1 SWORD NO_AXIS_PTS_Y 2 SWORD AXIS_PTS_X 3 SWORD INDEX_INCR DIRECT AXIS_PTS_Y 4 SWORD INDEX_INCR DIRECT FNC_VALUES 5 SWORD COLUMN_DIR DIRECT /end RECORD_LAYOUT
/begin RECORD_LAYOUT KfAxUbAyUbSstxUbSstyUbWSb NO_AXIS_PTS_X 1 UBYTE NO_AXIS_PTS_Y 2 UBYTE AXIS_PTS_X 3 UBYTE INDEX_INCR DIRECT AXIS_PTS_Y 4 UBYTE INDEX_INCR DIRECT FNC_VALUES 5 SBYTE COLUMN_DIR DIRECT /end RECORD_LAYOUT
/begin RECORD_LAYOUT KfAxUbAyUbSstxUbSstyUwWUw NO_AXIS_PTS_X 1 UBYTE NO_AXIS_PTS_Y 2 UBYTE AXIS_PTS_X 3 UBYTE INDEX_INCR DIRECT AXIS_PTS_Y 4 UWORD INDEX_INCR DIRECT FNC_VALUES 5 UWORD COLUMN_DIR DIRECT /end RECORD_LAYOUT
/begin RECORD_LAYOUT KfAxUbAyUbSstxUwSstyUbWUb NO_AXIS_PTS_X 1 UBYTE NO_AXIS_PTS_Y 2 UBYTE AXIS_PTS_X 3 UWORD INDEX_INCR DIRECT AXIS_PTS_Y 4 UBYTE INDEX_INCR DIRECT FNC_VALUES 5 UBYTE COLUMN_DIR DIRECT /end RECORD_LAYOUT
/begin RECORD_LAYOUT KfAxUwAyUwSstxSwSstyUwWUw NO_AXIS_PTS_X 1 UWORD NO_AXIS_PTS_Y 2 UWORD AXIS_PTS_X 3 SWORD INDEX_INCR DIRECT AXIS_PTS_Y 4 UWORD INDEX_INCR DIRECT FNC_VALUES 5 UWORD COLUMN_DIR DIRECT /end RECORD_LAYOUT
/begin RECORD_LAYOUT KfAxUwAyUwSstxUwSstyUwWSw NO_AXIS_PTS_X 1 UWORD NO_AXIS_PTS_Y 2 UWORD AXIS_PTS_X 3 UWORD INDEX_INCR DIRECT AXIS_PTS_Y 4 UWORD INDEX_INCR DIRECT FNC_VALUES 5 SWORD COLUMN_DIR DIRECT /end RECORD_LAYOUT
/begin RECORD_LAYOUT KfAxUwAyUwSstxUwSstyUwWUw NO_AXIS_PTS_X 1 UWORD NO_AXIS_PTS_Y 2 UWORD AXIS_PTS_X 3 UWORD INDEX_INCR DIRECT AXIS_PTS_Y 4 UWORD INDEX_INCR DIRECT FNC_VALUES 5 UWORD COLUMN_DIR DIRECT /end RECORD_LAYOUT
/begin RECORD_LAYOUT KfWUb FNC_VALUES 1 UBYTE COLUMN_DIR DIRECT /end RECORD_LAYOUT
/begin RECORD_LAYOUT KlAUbSstUbWUb NO_AXIS_PTS_X 1 UBYTE AXIS_PTS_X 2 UBYTE INDEX_INCR DIRECT FNC_VALUES 3 UBYTE COLUMN_DIR DIRECT /end RECORD_LAYOUT
/begin RECORD_LAYOUT KwbUb FNC_VALUES 1 UBYTE COLUMN_DIR DIRECT /end RECORD_LAYOUT
/begin RECORD_LAYOUT KwbUw FNC_VALUES 1 UWORD COLUMN_DIR DIRECT /end RECORD_LAYOUT
/begin RECORD_LAYOUT KwSb FNC_VALUES 1 SBYTE COLUMN_DIR DIRECT /end RECORD_LAYOUT
/begin RECORD_LAYOUT KwUb FNC_VALUES 1 UBYTE COLUMN_DIR DIRECT /end RECORD_LAYOUT
/begin RECORD_LAYOUT KwUw FNC_VALUES 1 UWORD COLUMN_DIR DIRECT /end RECORD_LAYOUT
/begin RECORD_LAYOUT KwWS16 FNC_VALUES 1 SWORD COLUMN_DIR DIRECT /end RECORD_LAYOUT
/begin RECORD_LAYOUT SstAU8SstS8 NO_AXIS_PTS_X 1 SBYTE AXIS_PTS_X 2 SBYTE INDEX_INCR DIRECT /end RECORD_LAYOUT
/begin RECORD_LAYOUT SstAU8SstU8 NO_AXIS_PTS_X 1 UBYTE AXIS_PTS_X 2 UBYTE INDEX_INCR DIRECT /end RECORD_LAYOUT
/begin RECORD_LAYOUT SstAUbSstUb NO_AXIS_PTS_X 1 UBYTE AXIS_PTS_X 2 UBYTE INDEX_INCR DIRECT /end RECORD_LAYOUT
/end MODULE
/end PROJECT
