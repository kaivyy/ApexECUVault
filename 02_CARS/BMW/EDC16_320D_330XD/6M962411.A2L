ASAP2_VERSION 1 3
/begin PROJECT P411 "BMW DDE6.0 6-Zylinder V96.2 14.10.2004"
/begin HEADER "" VERSION "V96.2_6Z" PROJECT_NO P411 /end HEADER
/begin MODULE DIM ""
/begin MOD_COMMON "" BYTE_ORDER MSB_FIRST ALIGNMENT_BYTE 1 ALIGNMENT_WORD 2 ALIGNMENT_LONG 4 ALIGNMENT_FLOAT32_IEEE 4 /end MOD_COMMON
/begin CHARACTERISTIC S_BSDKOORD "" VALUE 0x000C1206 TKW_VV_VV_UB 100.0 Identity 0.0 1.0000 /begin FUNCTION_LIST DIBS /end FUNCTION_LIST /end CHARACTERISTIC
/begin CHARACTERISTIC K_MSKIBSDFP "Bitmaske Generator Fehler-> DFP" VALUE 0x000C1207 TKW_VV_VV_UB 100.0 Def_st_ub_q1 0.0 255.0000 /begin FUNCTION_LIST DIBS /end FUNCTION_LIST /end CHARACTERISTIC
/begin CHARACTERISTIC K_MSKIBSDFP2 "" VALUE 0x000C1208 TKW_VV_VV_UB 100.0 Def_st_ub_q1 0.0 255.0000 /begin FUNCTION_LIST DIBS /end FUNCTION_LIST /end CHARACTERISTIC
/begin CHARACTERISTIC K_MSKIBSDIAG "Test AK disable Diagnose" VALUE 0x000C1209 TKW_VV_VV_UB 100.0 Def_st_ub_q1 0.0 255.0000 /begin FUNCTION_LIST DIBS /end FUNCTION_LIST /end CHARACTERISTIC
/begin CHARACTERISTIC K_MSKIBSERR "" VALUE 0x000C120A TKW_VV_VV_UB 100.0 ident 0.0 255.0000 /begin FUNCTION_LIST DIBS /end FUNCTION_LIST /end CHARACTERISTIC
/begin CHARACTERISTIC K_MSKIBSERR2 "" VALUE 0x000C120B TKW_VV_VV_UB 100.0 ident 0.0 255.0000 /begin FUNCTION_LIST DIBS /end FUNCTION_LIST /end CHARACTERISTIC
/begin CHARACTERISTIC K_TOGMAXUNPL "" VALUE 0x000C120C TKW_VV_VV_UL 100.0 Def_dez_ul_q1 0.0 2147483647.0000 /begin FUNCTION_LIST DQLT /end FUNCTION_LIST /end CHARACTERISTIC
/begin CHARACTERISTIC K_TOG_CNTMAX "" VALUE 0x000C1210 TKW_VV_VV_UL 100.0 Def_dez_ul_q1 0.0 4294967295.0000 /begin FUNCTION_LIST DQLT /end FUNCTION_LIST /end CHARACTERISTIC
/begin CHARACTERISTIC K_OZDIAGNMOT "Mindestdrehzahl zur QLT-Diagnose" VALUE 0x000C1214 TKW_VV_VV_SW 100.0 Def_n_sw_q1p0 -32768.0000 32767.0000 /begin FUNCTION_LIST DQLT /end FUNCTION_LIST /end CHARACTERISTIC
/begin CHARACTERISTIC K_OZDIAGNMOT2 "Max Drehzahl zur QLT-Diagnose" VALUE 0x000C1216 TKW_VV_VV_SW 100.0 Def_n_sw_q1p0 -32768.0000 32767.0000 /begin FUNCTION_LIST DQLT /end FUNCTION_LIST /end CHARACTERISTIC
/begin CHARACTERISTIC K_OZTEMPQERR "Temperaturschwelle für den Permittivitätsfehler" VALUE 0x000C1218 TKW_VV_VV_SW 100.0 Def_t_sw_q0p1 -3276.8000 3276.7000 /begin FUNCTION_LIST DQLT /end FUNCTION_LIST FORMAT "%4.1" /end CHARACTERISTIC
/begin CHARACTERISTIC K_DTOG_UBMIN "" VALUE 0x000C121A TKW_VV_VV_UW 100.0 Def_u_uw_q0p0942 0.0 6173.3970 /begin FUNCTION_LIST DQLT /end FUNCTION_LIST FORMAT "%4.1" /end CHARACTERISTIC
/begin CHARACTERISTIC K_OZDIAGSPG "Spannung, unterhalb der die Diagnose ausgeblendet wird" VALUE 0x000C121C TKW_VV_VV_UW 100.0 Def_u_uw_q0p0942 0.0 6173.3970 /begin FUNCTION_LIST DQLT /end FUNCTION_LIST FORMAT "%4.1" /end CHARACTERISTIC
/begin CHARACTERISTIC K_OZERRD "Entprellzeit Sensor- und Kommunikationsfehler" VALUE 0x000C121E TKW_VV_VV_UW 100.0 Def_dez_uw_q1 0.0 65535.0000 /begin FUNCTION_LIST DQLT /end FUNCTION_LIST /end CHARACTERISTIC
/begin CHARACTERISTIC K_OZHEAL "Entprellzeit Fehler-Healing" VALUE 0x000C1220 TKW_VV_VV_UW 100.0 Def_dez_uw_q1 0.0 65535.0000 /begin FUNCTION_LIST DQLT /end FUNCTION_LIST /end CHARACTERISTIC
/begin CHARACTERISTIC S_OZBSDKOORD "BSD Koordinator aktiv" VALUE 0x000C1222 TKW_VV_VV_UB 100.0 Def_dez_ub_q1 0.0 255.0000 /begin FUNCTION_LIST DQLT /end FUNCTION_LIST /end CHARACTERISTIC
/begin CHARACTERISTIC K_DNMOT "" VALUE 0x000C1224 TKW_VV_VV_SW 100.0 Def_n_sw_q1p0 -32768.0000 32767.0000 /begin FUNCTION_LIST ELMOTENTL /end FUNCTION_LIST /end CHARACTERISTIC
/begin CHARACTERISTIC K_MAXDT1_HY "" VALUE 0x000C1226 TKW_VV_VV_SW 100.0 Def_n_sw_q1p0 -32768.0000 32767.0000 /begin FUNCTION_LIST ELMOTENTL /end FUNCTION_LIST /end CHARACTERISTIC
/begin CHARACTERISTIC K_MINDT1_HY "" VALUE 0x000C1228 TKW_VV_VV_SW 100.0 Def_n_sw_q1p0 -32768.0000 32767.0000 /begin FUNCTION_LIST ELMOTENTL /end FUNCTION_LIST /end CHARACTERISTIC
/begin CHARACTERISTIC K_NKWMAX_HS "" VALUE 0x000C122A TKW_VV_VV_SW 100.0 Def_n_sw_q1p0 -32768.0000 32767.0000 /begin FUNCTION_LIST ELMOTENTL /end FUNCTION_LIST /end CHARACTERISTIC
/begin CHARACTERISTIC K_NKWMIN_HY "" VALUE 0x000C122C TKW_VV_VV_SW 100.0 Def_n_sw_q1p0 -32768.0000 32767.0000 /begin FUNCTION_LIST ELMOTENTL /end FUNCTION_LIST /end CHARACTERISTIC
/begin CHARACTERISTIC K_PWGMAX_HY "" VALUE 0x000C122E TKW_VV_VV_SW 100.0 Def_wdk_sw_q0p0244 -800.0000 799.9755 /begin FUNCTION_LIST ELMOTENTL /end FUNCTION_LIST FORMAT "%5.2" /end CHARACTERISTIC
/begin CHARACTERISTIC K_PWGMIN_HY "" VALUE 0x000C1230 TKW_VV_VV_SW 100.0 Def_wdk_sw_q0p0244 -800.0000 799.9755 /begin FUNCTION_LIST ELMOTENTL /end FUNCTION_LIST FORMAT "%5.2" /end CHARACTERISTIC
/begin CHARACTERISTIC K_WAFS "" VALUE 0x000C1232 TKW_VV_VV_SW 100.0 Def_w_sw_q0p1 -3276.8000 3276.7000 /begin FUNCTION_LIST ELMOTENTL /end FUNCTION_LIST FORMAT "%5.2" /end CHARACTERISTIC
/begin CHARACTERISTIC K_WDAFS "" VALUE 0x000C1234 TKW_VV_VV_SW 100.0 Def_w_sw_q0p1 -3276.8000 3276.7000 /begin FUNCTION_LIST ELMOTENTL /end FUNCTION_LIST FORMAT "%5.2" /end CHARACTERISTIC
/begin CHARACTERISTIC K_TD_DELAY1 "" VALUE 0x000C1236 TKW_VV_VV_UW 100.0 Def_td_uw_q0p1 0.0 6553.5000 /begin FUNCTION_LIST ELMOTENTL /end FUNCTION_LIST FORMAT "%4.1" /end CHARACTERISTIC
/begin CHARACTERISTIC K_TD_DELAY2 "" VALUE 0x000C1238 TKW_VV_VV_UW 100.0 Def_td_uw_q0p1 0.0 6553.5000 /begin FUNCTION_LIST ELMOTENTL /end FUNCTION_LIST FORMAT "%4.1" /end CHARACTERISTIC
/begin CHARACTERISTIC K_TD_DELAY3 "" VALUE 0x000C123A TKW_VV_VV_UW 100.0 Def_td_uw_q0p1 0.0 6553.5000 /begin FUNCTION_LIST ELMOTENTL /end FUNCTION_LIST FORMAT "%4.1" /end CHARACTERISTIC
/begin CHARACTERISTIC K_TD_DOWN "" VALUE 0x000C123C TKW_VV_VV_UW 100.0 Def_td_uw_q0p1 0.0 6553.5000 /begin FUNCTION_LIST ELMOTENTL /end FUNCTION_LIST FORMAT "%4.1" /end CHARACTERISTIC
/begin CHARACTERISTIC K_TD_GEAR "" VALUE 0x000C123E TKW_VV_VV_UW 100.0 Def_td_uw_q0p1 0.0 6553.5000 /begin FUNCTION_LIST ELMOTENTL /end FUNCTION_LIST FORMAT "%4.1" /end CHARACTERISTIC
/begin CHARACTERISTIC K_TD_HOLD "" VALUE 0x000C1240 TKW_VV_VV_UW 100.0 Def_td_uw_q0p1 0.0 6553.5000 /begin FUNCTION_LIST ELMOTENTL /end FUNCTION_LIST FORMAT "%4.1" /end CHARACTERISTIC
/begin CHARACTERISTIC K_TD_HOLDNO "" VALUE 0x000C1242 TKW_VV_VV_UW 100.0 Def_td_uw_q0p1 0.0 6553.5000 /begin FUNCTION_LIST ELMOTENTL /end FUNCTION_LIST FORMAT "%4.1" /end CHARACTERISTIC
/begin CHARACTERISTIC K_TD_UP "" VALUE 0x000C1244 TKW_VV_VV_UW 100.0 Def_td_uw_q0p1 0.0 6553.5000 /begin FUNCTION_LIST ELMOTENTL /end FUNCTION_LIST FORMAT "%4.1" /end CHARACTERISTIC
/begin CHARACTERISTIC K_TODPRIO0 "" VALUE 0x000C1246 TKW_VV_VV_UW 100.0 Def_td_uw_q0p1 0.0 6553.5000 /begin FUNCTION_LIST ELMOTENTL /end FUNCTION_LIST FORMAT "%4.1" /end CHARACTERISTIC
/begin CHARACTERISTIC K_TPDNMOT "" VALUE 0x000C1248 TKW_VV_VV_UW 100.0 Def_dez_uw_q1 1.0000 65535.0000 /begin FUNCTION_LIST ELMOTENTL /end FUNCTION_LIST /end CHARACTERISTIC
/begin CHARACTERISTIC K_VMAX_HY "Fz-Geschwindigkeit" VALUE 0x000C124A TKW_VV_VV_UW 100.0 Def_v_uw_q1p0 0.0 65535.0000 /begin FUNCTION_LIST ELMOTENTL /end FUNCTION_LIST /end CHARACTERISTIC
/begin CHARACTERISTIC K_VMIN_HY "Fz-Geschwindigkeit" VALUE 0x000C124C TKW_VV_VV_UW 100.0 Def_v_uw_q1p0 0.0 65535.0000 /begin FUNCTION_LIST ELMOTENTL /end FUNCTION_LIST /end CHARACTERISTIC
/begin CHARACTERISTIC KL_VLPRIO41 "" CURVE 0x000C124E TKL_SW_VV_UW 100.0 Def_td_uw_q0p1 0.0 6553.5000 /begin FUNCTION_LIST ELMOTENTL /end FUNCTION_LIST
 /begin AXIS_DESCR STD_AXIS Tmot Def_t_sw_q0p01 4 -327.6800 327.6700 FORMAT "%5.2" /end AXIS_DESCR
 FORMAT "%4.1" /end CHARACTERISTIC
/begin CHARACTERISTIC KL_VLPRIO42 "" CURVE 0x000C1260 TKL_SW_VV_UW 100.0 Def_td_uw_q0p1 0.0 6553.5000 /begin FUNCTION_LIST ELMOTENTL /end FUNCTION_LIST
 /begin AXIS_DESCR STD_AXIS Tmot Def_t_sw_q0p01 4 -327.6800 327.6700 FORMAT "%5.2" /end AXIS_DESCR
 FORMAT "%4.1" /end CHARACTERISTIC
/begin CHARACTERISTIC KL_VLPRIO43 "" CURVE 0x000C1272 TKL_SW_VV_UW 100.0 Def_td_uw_q0p1 0.0 6553.5000 /begin FUNCTION_LIST ELMOTENTL /end FUNCTION_LIST
 /begin AXIS_DESCR STD_AXIS Tmot Def_t_sw_q0p01 4 -327.6800 327.6700 FORMAT "%5.2" /end AXIS_DESCR
 FORMAT "%4.1" /end CHARACTERISTIC
/begin CHARACTERISTIC KF_PRIO_UP "" MAP 0x000C1284 TKF_UW_SW_SW 100.0 Def_rf_sw_q0p01 -327.6800 327.6700 /begin FUNCTION_LIST ELMOTENTL /end FUNCTION_LIST
 /begin AXIS_DESCR STD_AXIS Tmot Def_t_sw_q0p01 8 -327.6800 327.6700 FORMAT "%5.2" /end AXIS_DESCR
 /begin AXIS_DESCR STD_AXIS Pu Def_p_uw_q0p039 8 0.0 2559.9609 FORMAT "%5.2" /end AXIS_DESCR
 FORMAT "%7.4" /end CHARACTERISTIC
/begin CHARACTERISTIC KF_PRIO_HOLD "" MAP 0x000C1326 TKF_UW_SW_SW 100.0 Def_dez_sw_q1 -32768.0000 32767.0000 /begin FUNCTION_LIST ELMOTENTL /end FUNCTION_LIST
 /begin AXIS_DESCR STD_AXIS Tmot Def_t_sw_q0p01 8 -327.6800 327.6700 FORMAT "%5.2" /end AXIS_DESCR
 /begin AXIS_DESCR STD_AXIS Pu Def_p_uw_q0p039 8 0.0 2559.9609 FORMAT "%5.2" /end AXIS_DESCR
/end CHARACTERISTIC
/begin CHARACTERISTIC KF_PRIO_4 "" MAP 0x000C13C8 TKF_UW_SW_SW 100.0 Def_rf_sw_q0p01 -327.6800 327.6700 /begin FUNCTION_LIST ELMOTENTL /end FUNCTION_LIST
 /begin AXIS_DESCR STD_AXIS Tmot Def_t_sw_q0p01 8 -327.6800 327.6700 FORMAT "%5.2" /end AXIS_DESCR
 /begin AXIS_DESCR STD_AXIS Pu Def_p_uw_q0p039 8 0.0 2559.9609 FORMAT "%5.2" /end AXIS_DESCR
 FORMAT "%7.4" /end CHARACTERISTIC
/begin CHARACTERISTIC KF_PRIO_NO "" MAP 0x000C146A TKF_UW_SW_SW 100.0 Def_dez_sw_q1 -32768.0000 32767.0000 /begin FUNCTION_LIST ELMOTENTL /end FUNCTION_LIST
 /begin AXIS_DESCR STD_AXIS Tmot Def_t_sw_q0p01 8 -327.6800 327.6700 FORMAT "%5.2" /end AXIS_DESCR
 /begin AXIS_DESCR STD_AXIS Pu Def_p_uw_q0p039 8 0.0 2559.9609 FORMAT "%5.2" /end AXIS_DESCR
/end CHARACTERISTIC
/begin CHARACTERISTIC K_GENUEBSETZ1 "Generatoruebersetzung1" VALUE 0x000C1564 TKW_VV_VV_UB 100.0 Def_f_ub_b4 0.0 3.9843 /begin FUNCTION_LIST IMDGEN_1PR /end FUNCTION_LIST /end CHARACTERISTIC
/begin CHARACTERISTIC K_GENUEBSETZ2 "Generatoruebersetzung2" VALUE 0x000C1565 TKW_VV_VV_UB 100.0 Def_f_ub_b4 0.0 3.9843 /begin FUNCTION_LIST IMDGEN_1PR /end FUNCTION_LIST /end CHARACTERISTIC
/begin CHARACTERISTIC K_GENUEBSETZ3 "Generatoruebersetzung3" VALUE 0x000C1566 TKW_VV_VV_UB 100.0 Def_f_ub_b4 0.0 3.9843 /begin FUNCTION_LIST IMDGEN_1PR /end FUNCTION_LIST /end CHARACTERISTIC
/begin CHARACTERISTIC K_GENUEBSETZ4 "Generatoruebersetzung4" VALUE 0x000C1567 TKW_VV_VV_UB 100.0 Def_f_ub_b4 0.0 3.9843 /begin FUNCTION_LIST IMDGEN_1PR /end FUNCTION_LIST /end CHARACTERISTIC
/begin CHARACTERISTIC KF_IGENKA2 "Kaltkennfeld 2 Generator" MAP 0x000C15A6 TKF_SW_UW_UB 100.0 Def_i_ub_q1 0.0 255.0000 /begin FUNCTION_LIST IMDGEN_1PR /end FUNCTION_LIST /begin AXIS_DESCR STD_AXIS U_gen Def_u_uw_q0p1 7 0.0 6553.5000 FORMAT "%6.3" /end AXIS_DESCR /begin AXIS_DESCR STD_AXIS N_gen Def_n_sw_q1p0 9 -32768.0000 32767.0000 /end AXIS_DESCR /end CHARACTERISTIC
/begin CHARACTERISTIC KF_IGENWA2 "Warmkennfeld 2 Generator" MAP 0x000C1608 TKF_SW_UB_UB 100.0 Def_i_ub_q1 0.0 255.0000 /begin FUNCTION_LIST IMDGEN_1PR /end FUNCTION_LIST /begin AXIS_DESCR STD_AXIS Gen_i_kaltun Def_i_ub_q1 6 0.0 255.0000 /end AXIS_DESCR
 /begin AXIS_DESCR STD_AXIS Tgen_end Def_t_sw_q0p1 7 -3276.8000 3276.7000 FORMAT "%4.1" /end AXIS_DESCR
/end CHARACTERISTIC
/begin CHARACTERISTIC KF_IGENWA1 "Warmkennfeld 1 Generator" MAP 0x000C1648 TKF_SW_UB_UB 100.0 Def_i_ub_q1 0.0 255.0000 /begin FUNCTION_LIST IMDGEN_1PR /end FUNCTION_LIST /begin AXIS_DESCR STD_AXIS Gen_i_kaltun Def_i_ub_q1 6 0.0 255.0000 /end AXIS_DESCR
 /begin AXIS_DESCR STD_AXIS Tgen_end Def_t_sw_q0p1 7 -3276.8000 3276.7000 FORMAT "%4.1" /end AXIS_DESCR
/end CHARACTERISTIC
/begin CHARACTERISTIC KF_IGENKA3 "Kaltkennfeld 3 Generator" MAP 0x000C1688 TKF_SW_UW_UB 100.0 Def_i_ub_q1 0.0 255.0000 /begin FUNCTION_LIST IMDGEN_1PR /end FUNCTION_LIST /begin AXIS_DESCR STD_AXIS U_gen Def_u_uw_q0p1 7 0.0 6553.5000 FORMAT "%6.3" /end AXIS_DESCR /begin AXIS_DESCR STD_AXIS N_gen Def_n_sw_q1p0 9 -32768.0000 32767.0000 /end AXIS_DESCR /end CHARACTERISTIC
/begin CHARACTERISTIC KF_IGENWA4 "Warmkennfeld 4 Generator" MAP 0x000C16EA TKF_SW_UB_UB 100.0 Def_i_ub_q1 0.0 255.0000 /begin FUNCTION_LIST IMDGEN_1PR /end FUNCTION_LIST /begin AXIS_DESCR STD_AXIS Gen_i_kaltun Def_i_ub_q1 6 0.0 255.0000 /end AXIS_DESCR
 /begin AXIS_DESCR STD_AXIS Tgen_end Def_t_sw_q0p1 7 -3276.8000 3276.7000 FORMAT "%4.1" /end AXIS_DESCR
/end CHARACTERISTIC
/begin CHARACTERISTIC KF_IGENWA3 "Warmkennfeld  3 Generator" MAP 0x000C172A TKF_SW_UB_UB 100.0 Def_i_ub_q1 0.0 255.0000 /begin FUNCTION_LIST IMDGEN_1PR /end FUNCTION_LIST /begin AXIS_DESCR STD_AXIS Gen_i_kaltun Def_i_ub_q1 6 0.0 255.0000 /end AXIS_DESCR
 /begin AXIS_DESCR STD_AXIS Tgen_end Def_t_sw_q0p1 7 -3276.8000 3276.7000 FORMAT "%4.1" /end AXIS_DESCR
/end CHARACTERISTIC
/begin CHARACTERISTIC KF_IGENKA1 "Kaltkennfeld 1 Generator" MAP 0x000C176A TKF_SW_UW_UB 100.0 Def_i_ub_q1 0.0 255.0000 /begin FUNCTION_LIST IMDGEN_1PR /end FUNCTION_LIST /begin AXIS_DESCR STD_AXIS U_gen Def_u_uw_q0p1 7 0.0 6553.5000 FORMAT "%6.3" /end AXIS_DESCR /begin AXIS_DESCR STD_AXIS N_gen Def_n_sw_q1p0 9 -32768.0000 32767.0000 /end AXIS_DESCR /end CHARACTERISTIC
/begin CHARACTERISTIC KF_IGENKA4 "Kaltkennfeld 4 Generator" MAP 0x000C17CC TKF_SW_UW_UB 100.0 Def_i_ub_q1 0.0 255.0000 /begin FUNCTION_LIST IMDGEN_1PR /end FUNCTION_LIST /begin AXIS_DESCR STD_AXIS U_gen Def_u_uw_q0p1 7 0.0 6553.5000 FORMAT "%6.3" /end AXIS_DESCR /begin AXIS_DESCR STD_AXIS N_gen Def_n_sw_q1p0 9 -32768.0000 32767.0000 /end AXIS_DESCR /end CHARACTERISTIC
/begin CHARACTERISTIC K_ENGENTANS "Schwelle Motortemperatur fuer Freigabe Generaturansaugluft " VALUE 0x000C150C TKW_VV_VV_SW 100.0 Def_t_sw_q0p1 -3276.8000 3276.7000 /begin FUNCTION_LIST IMDGEN_1PR /end FUNCTION_LIST FORMAT "%4.1" /end CHARACTERISTIC
/begin CHARACTERISTIC K_GENMDNMOF "Offset des Generatormoments" VALUE 0x000C150E TKW_VV_VV_SW 100.0 Def_m_sw_q0p1 -3276.8000 3276.7000 /begin FUNCTION_LIST IMDGEN_1PR /end FUNCTION_LIST FORMAT "%5.2" /end CHARACTERISTIC
/begin CHARACTERISTIC K_GENTEMPAPP "Geneeratortemperatur mauelle Vorgabe" VALUE 0x000C1510 TKW_VV_VV_SW 100.0 Def_t_sw_q0p1 -3276.8000 3276.7000 /begin FUNCTION_LIST IMDGEN_1PR /end FUNCTION_LIST FORMAT "%4.1" /end CHARACTERISTIC
/begin CHARACTERISTIC K_GENTMOTDT "" VALUE 0x000C1512 TKW_VV_VV_SW 100.0 Def_t_sw_q0p1 -3276.8000 3276.7000 /begin FUNCTION_LIST IMDGEN_1PR /end FUNCTION_LIST FORMAT "%4.1" /end CHARACTERISTIC
/begin CHARACTERISTIC K_GENTMOTOF1 "Offset Generatoransaugluft" VALUE 0x000C1514 TKW_VV_VV_SW 100.0 Def_t_sw_q0p1 -3276.8000 3276.7000 /begin FUNCTION_LIST IMDGEN_1PR /end FUNCTION_LIST FORMAT "%4.1" /end CHARACTERISTIC
/begin CHARACTERISTIC K_GENTMOTOF2 "Offset Generatoransaugluft" VALUE 0x000C1516 TKW_VV_VV_SW 100.0 Def_t_sw_q0p1 -3276.8000 3276.7000 /begin FUNCTION_LIST IMDGEN_1PR /end FUNCTION_LIST FORMAT "%4.1" /end CHARACTERISTIC
/begin CHARACTERISTIC K_GENTMOTOF3 "Offset Generatoransaugluft" VALUE 0x000C1518 TKW_VV_VV_SW 100.0 Def_t_sw_q0p1 -3276.8000 3276.7000 /begin FUNCTION_LIST IMDGEN_1PR /end FUNCTION_LIST FORMAT "%4.1" /end CHARACTERISTIC
/begin CHARACTERISTIC K_GENTMOTOF4 "Offset Generatoransaugluft" VALUE 0x000C151A TKW_VV_VV_SW 100.0 Def_t_sw_q0p1 -3276.8000 3276.7000 /begin FUNCTION_LIST IMDGEN_1PR /end FUNCTION_LIST FORMAT "%4.1" /end CHARACTERISTIC
/begin CHARACTERISTIC K_GENRS0_1 "Generatorstatorwiderstand1 bei 25°" VALUE 0x000C151C TKW_VV_VV_UW 100.0 Def_f_uw_b1 0.0 9.99984741210938e-1 /begin FUNCTION_LIST IMDGEN_1PR /end FUNCTION_LIST /end CHARACTERISTIC
/begin CHARACTERISTIC K_GENRS0_2 "Generatorstatorwiderstand2 bei 25°" VALUE 0x000C151E TKW_VV_VV_UW 100.0 Def_f_uw_b1 0.0 9.99984741210938e-1 /begin FUNCTION_LIST IMDGEN_1PR /end FUNCTION_LIST /end CHARACTERISTIC
/begin CHARACTERISTIC K_GENRS0_3 "Generatorstatorwiderstand3 bei 25°" VALUE 0x000C1520 TKW_VV_VV_UW 100.0 Def_f_uw_b1 0.0 9.99984741210938e-1 /begin FUNCTION_LIST IMDGEN_1PR /end FUNCTION_LIST /end CHARACTERISTIC
/begin CHARACTERISTIC K_GENRS0_4 "Generatorstatorwiderstand4 bei 25°" VALUE 0x000C1522 TKW_VV_VV_UW 100.0 Def_f_uw_b1 0.0 9.99984741210938e-1 /begin FUNCTION_LIST IMDGEN_1PR /end FUNCTION_LIST /end CHARACTERISTIC
/begin CHARACTERISTIC K_GENVFZGSW "geschwindigkeitsabhängige Generatoransaugluftschwelle" VALUE 0x000C1524 TKW_VV_VV_UW 100.0 Def_v_uw_q1p0 0.0 65535.0000 /begin FUNCTION_LIST IMDGEN_1PR /end FUNCTION_LIST /end CHARACTERISTIC
/begin CHARACTERISTIC K_GEN_IGOF "Offsetwert Generatorstrom" VALUE 0x000C1526 TKW_VV_VV_UW 100.0 Def_f_uw_b2048 0.0 254.0000 /begin FUNCTION_LIST IMDGEN_1PR /end FUNCTION_LIST FORMAT "%5.2" /end CHARACTERISTIC
/begin CHARACTERISTIC K_TSTFIL_IN "" VALUE 0x000C1528 TKW_VV_VV_UW 100.0 Def_t_uw_q0p075 0.0 49151.2500 /begin FUNCTION_LIST IMDGEN_1PR /end FUNCTION_LIST FORMAT "%5.2" /end CHARACTERISTIC
/begin CHARACTERISTIC K_ZMGENIG "" VALUE 0x000C152A TKW_VV_VV_UW 100.0 Def_f_uw_b1 0.0 9.99984741210938e-1 /begin FUNCTION_LIST IMDGEN_1PR /end FUNCTION_LIST /end CHARACTERISTIC
/begin CHARACTERISTIC K_ZMGENS0HZ1 "Zeitkonstante Generatorstator1 Aufheizung im Stand" VALUE 0x000C152C TKW_VV_VV_UW 100.0 Def_f_uw_b1 0.0 9.99984741210938e-1 /begin FUNCTION_LIST IMDGEN_1PR /end FUNCTION_LIST /end CHARACTERISTIC
/begin CHARACTERISTIC K_ZMGENS0HZ2 "Zeitkonstante Generatorstator2 Aufheizung im Stand" VALUE 0x000C152E TKW_VV_VV_UW 100.0 Def_f_uw_b1 0.0 9.99984741210938e-1 /begin FUNCTION_LIST IMDGEN_1PR /end FUNCTION_LIST /end CHARACTERISTIC
/begin CHARACTERISTIC K_ZMGENS0HZ3 "Zeitkonstante Generatorstator3 Aufheizung im Stand" VALUE 0x000C1530 TKW_VV_VV_UW 100.0 Def_f_uw_b1 0.0 9.99984741210938e-1 /begin FUNCTION_LIST IMDGEN_1PR /end FUNCTION_LIST /end CHARACTERISTIC
/begin CHARACTERISTIC K_ZMGENS0HZ4 "Zeitkonstante Generatorstator4 Aufheizung im Stand" VALUE 0x000C1532 TKW_VV_VV_UW 100.0 Def_f_uw_b1 0.0 9.99984741210938e-1 /begin FUNCTION_LIST IMDGEN_1PR /end FUNCTION_LIST /end CHARACTERISTIC
/begin CHARACTERISTIC K_ZMGENS0KL1 "Zeitkonstante Abkühlung Generator im Stand1" VALUE 0x000C1534 TKW_VV_VV_UW 100.0 Def_f_uw_b1 0.0 9.99984741210938e-1 /begin FUNCTION_LIST IMDGEN_1PR /end FUNCTION_LIST /end CHARACTERISTIC
/begin CHARACTERISTIC K_ZMGENS0KL2 "Zeitkonstante Abkühlung Generator im Stand2" VALUE 0x000C1536 TKW_VV_VV_UW 100.0 Def_f_uw_b1 0.0 9.99984741210938e-1 /begin FUNCTION_LIST IMDGEN_1PR /end FUNCTION_LIST /end CHARACTERISTIC
/begin CHARACTERISTIC K_ZMGENS0KL3 "Zeitkonstante Abkühlung Generator im Stand3" VALUE 0x000C1538 TKW_VV_VV_UW 100.0 Def_f_uw_b1 0.0 9.99984741210938e-1 /begin FUNCTION_LIST IMDGEN_1PR /end FUNCTION_LIST /end CHARACTERISTIC
/begin CHARACTERISTIC K_ZMGENS0KL4 "Zeitkonstante Abkühlung Generator im Stand4" VALUE 0x000C153A TKW_VV_VV_UW 100.0 Def_f_uw_b1 0.0 9.99984741210938e-1 /begin FUNCTION_LIST IMDGEN_1PR /end FUNCTION_LIST /end CHARACTERISTIC
/begin CHARACTERISTIC K_ZMGENSTHZ1 "Zeitkonstante Generatorstator1 Aufheizung" VALUE 0x000C153C TKW_VV_VV_UW 100.0 Def_f_uw_b1 0.0 9.99984741210938e-1 /begin FUNCTION_LIST IMDGEN_1PR /end FUNCTION_LIST /end CHARACTERISTIC
/begin CHARACTERISTIC K_ZMGENSTHZ2 "Zeitkonstante Generatorstator2 Aufheizung" VALUE 0x000C153E TKW_VV_VV_UW 100.0 Def_f_uw_b1 0.0 9.99984741210938e-1 /begin FUNCTION_LIST IMDGEN_1PR /end FUNCTION_LIST /end CHARACTERISTIC
/begin CHARACTERISTIC K_ZMGENSTHZ3 "Zeitkonstante Generatorstator3 Aufheizung" VALUE 0x000C1540 TKW_VV_VV_UW 100.0 Def_f_uw_b1 0.0 9.99984741210938e-1 /begin FUNCTION_LIST IMDGEN_1PR /end FUNCTION_LIST /end CHARACTERISTIC
/begin CHARACTERISTIC K_ZMGENSTHZ4 "Zeitkonstante Generatorstator4 Aufheizung" VALUE 0x000C1542 TKW_VV_VV_UW 100.0 Def_f_uw_b1 0.0 9.99984741210938e-1 /begin FUNCTION_LIST IMDGEN_1PR /end FUNCTION_LIST /end CHARACTERISTIC
/begin CHARACTERISTIC K_ZMGENSTKL1 "Zeitkonstante Abkühlung Generator1" VALUE 0x000C1544 TKW_VV_VV_UW 100.0 Def_f_uw_b1 0.0 9.99984741210938e-1 /begin FUNCTION_LIST IMDGEN_1PR /end FUNCTION_LIST /end CHARACTERISTIC
/begin CHARACTERISTIC K_ZMGENSTKL2 "Zeitkonstante Abkühlung Generator2" VALUE 0x000C1546 TKW_VV_VV_UW 100.0 Def_f_uw_b1 0.0 9.99984741210938e-1 /begin FUNCTION_LIST IMDGEN_1PR /end FUNCTION_LIST /end CHARACTERISTIC
/begin CHARACTERISTIC K_ZMGENSTKL3 "Zeitkonstante Abkühlung Generator3" VALUE 0x000C1548 TKW_VV_VV_UW 100.0 Def_f_uw_b1 0.0 9.99984741210938e-1 /begin FUNCTION_LIST IMDGEN_1PR /end FUNCTION_LIST /end CHARACTERISTIC
/begin CHARACTERISTIC K_ZMGENSTKL4 "Zeitkonstante Abkühlung Generator4" VALUE 0x000C154A TKW_VV_VV_UW 100.0 Def_f_uw_b1 0.0 9.99984741210938e-1 /begin FUNCTION_LIST IMDGEN_1PR /end FUNCTION_LIST /end CHARACTERISTIC
/begin CHARACTERISTIC K_ZMGENTWA "" VALUE 0x000C154C TKW_VV_VV_UW 100.0 Def_f_uw_b1 0.0 9.99984741210938e-1 /begin FUNCTION_LIST IMDGEN_1PR /end FUNCTION_LIST /end CHARACTERISTIC
/begin CHARACTERISTIC K_ZMGN0TANS1 "Zeitkonstante Generatoransaugluft1 bei vfzg = 0" VALUE 0x000C154E TKW_VV_VV_UW 100.0 Def_f_uw_b1 0.0 9.99984741210938e-1 /begin FUNCTION_LIST IMDGEN_1PR /end FUNCTION_LIST /end CHARACTERISTIC
/begin CHARACTERISTIC K_ZMGN0TANS2 "Zeitkonstante Generatoransaugluft2 bei vfzg = 0" VALUE 0x000C1550 TKW_VV_VV_UW 100.0 Def_f_uw_b1 0.0 9.99984741210938e-1 /begin FUNCTION_LIST IMDGEN_1PR /end FUNCTION_LIST /end CHARACTERISTIC
/begin CHARACTERISTIC K_ZMGN0TANS3 "Zeitkonstante Generatoransaugluft3 bei vfzg = 0" VALUE 0x000C1552 TKW_VV_VV_UW 100.0 Def_f_uw_b1 0.0 9.99984741210938e-1 /begin FUNCTION_LIST IMDGEN_1PR /end FUNCTION_LIST /end CHARACTERISTIC
/begin CHARACTERISTIC K_ZMGN0TANS4 "Zeitkonstante Generatoransaugluft4 bei vfzg = 0" VALUE 0x000C1554 TKW_VV_VV_UW 100.0 Def_f_uw_b1 0.0 9.99984741210938e-1 /begin FUNCTION_LIST IMDGEN_1PR /end FUNCTION_LIST /end CHARACTERISTIC
/begin CHARACTERISTIC K_ZMGNTANS1 "Zeitkonstante Generatoransaugluft1" VALUE 0x000C1556 TKW_VV_VV_UW 100.0 Def_f_uw_b1 0.0 9.99984741210938e-1 /begin FUNCTION_LIST IMDGEN_1PR /end FUNCTION_LIST /end CHARACTERISTIC
/begin CHARACTERISTIC K_ZMGNTANS2 "Zeitkonstante Generatoransaugluft2" VALUE 0x000C1558 TKW_VV_VV_UW 100.0 Def_f_uw_b1 0.0 9.99984741210938e-1 /begin FUNCTION_LIST IMDGEN_1PR /end FUNCTION_LIST /end CHARACTERISTIC
/begin CHARACTERISTIC K_ZMGNTANS3 "Zeitkonstante Generatoransaugluft3" VALUE 0x000C155A TKW_VV_VV_UW 100.0 Def_f_uw_b1 0.0 9.99984741210938e-1 /begin FUNCTION_LIST IMDGEN_1PR /end FUNCTION_LIST /end CHARACTERISTIC
/begin CHARACTERISTIC K_ZMGNTANS4 "Zeitkonstante Generatoransaugluft3" VALUE 0x000C155C TKW_VV_VV_UW 100.0 Def_f_uw_b1 0.0 9.99984741210938e-1 /begin FUNCTION_LIST IMDGEN_1PR /end FUNCTION_LIST /end CHARACTERISTIC
/begin CHARACTERISTIC K_ZMIGMISCH "Zeitkonstante IG Mischung" VALUE 0x000C155E TKW_VV_VV_UW 100.0 Def_f_uw_b1 0.0 9.99984741210938e-1 /begin FUNCTION_LIST IMDGEN_1PR /end FUNCTION_LIST /end CHARACTERISTIC
/begin CHARACTERISTIC K_ZMTESTFIL "" VALUE 0x000C1560 TKW_VV_VV_UW 100.0 Def_f_uw_b1 0.0 9.99984741210938e-1 /begin FUNCTION_LIST IMDGEN_1PR /end FUNCTION_LIST /end CHARACTERISTIC
/begin CHARACTERISTIC K_DF_DEAKAPP "Df-Schwelle für IG 0A Zwangssetzung" VALUE 0x000C1568 TKW_VV_VV_UB 100.0 Def_f_ub_b100 0.0 99.6093 /begin FUNCTION_LIST IMDGEN_1PR /end FUNCTION_LIST /end CHARACTERISTIC
/begin CHARACTERISTIC K_EN_MDGEN "" VALUE 0x000C1569 TKW_VV_VV_UB 100.0 Def_st_ub_q1 0.0 255.0000 /begin FUNCTION_LIST IMDGEN_1PR /end FUNCTION_LIST /end CHARACTERISTIC
/begin CHARACTERISTIC K_GENDIFAK1 "Stromfaktor Diode1" VALUE 0x000C156A TKW_VV_VV_UB 100.0 Def_f_ub_b1 0.0 0.9960 /begin FUNCTION_LIST IMDGEN_1PR /end FUNCTION_LIST /end CHARACTERISTIC
/begin CHARACTERISTIC K_GENDIFAK2 "Stromfaktor Diode2" VALUE 0x000C156B TKW_VV_VV_UB 100.0 Def_f_ub_b1 0.0 0.9960 /begin FUNCTION_LIST IMDGEN_1PR /end FUNCTION_LIST /end CHARACTERISTIC
/begin CHARACTERISTIC K_GENDIFAK3 "Stromfaktor Diode3" VALUE 0x000C156C TKW_VV_VV_UB 100.0 Def_f_ub_b1 0.0 0.9960 /begin FUNCTION_LIST IMDGEN_1PR /end FUNCTION_LIST /end CHARACTERISTIC
/begin CHARACTERISTIC K_GENDIFAK4 "Stromfaktor Diode4" VALUE 0x000C156D TKW_VV_VV_UB 100.0 Def_f_ub_b1 0.0 0.9960 /begin FUNCTION_LIST IMDGEN_1PR /end FUNCTION_LIST /end CHARACTERISTIC
/begin CHARACTERISTIC K_GENITYP "Generatorstrotyp 0=gerechnet / 1=gemessen" VALUE 0x000C156E TKW_VV_VV_UB 100.0 Def_st_ub_q1 0.0 1.0000 /begin FUNCTION_LIST IMDGEN_1PR /end FUNCTION_LIST /end CHARACTERISTIC
/begin CHARACTERISTIC K_GENSTFAK1 "Stromfaktor Statorspule" VALUE 0x000C156F TKW_VV_VV_UB 100.0 Def_f_ub_b1 0.0 0.9960 /begin FUNCTION_LIST IMDGEN_1PR /end FUNCTION_LIST /end CHARACTERISTIC
/begin CHARACTERISTIC K_GENSTFAK2 "Stromfaktor Statorspule2" VALUE 0x000C1570 TKW_VV_VV_UB 100.0 Def_f_ub_b1 0.0 0.9960 /begin FUNCTION_LIST IMDGEN_1PR /end FUNCTION_LIST /end CHARACTERISTIC
/begin CHARACTERISTIC K_GENSTFAK3 "Stromfaktor Statorspule3" VALUE 0x000C1571 TKW_VV_VV_UB 100.0 Def_f_ub_b1 0.0 0.9960 /begin FUNCTION_LIST IMDGEN_1PR /end FUNCTION_LIST /end CHARACTERISTIC
/begin CHARACTERISTIC K_GENSTFAK4 "Stromfaktor Statorspule4" VALUE 0x000C1572 TKW_VV_VV_UB 100.0 Def_f_ub_b1 0.0 0.9960 /begin FUNCTION_LIST IMDGEN_1PR /end FUNCTION_LIST /end CHARACTERISTIC
/begin CHARACTERISTIC K_GENTEMPMAN "Manuelle Generatorvorgabe" VALUE 0x000C1573 TKW_VV_VV_UB 100.0 Def_st_ub_q1 0.0 255.0000 /begin FUNCTION_LIST IMDGEN_1PR /end FUNCTION_LIST /end CHARACTERISTIC
/begin CHARACTERISTIC K_GENTYP "Generatortyp" VALUE 0x000C1574 TKW_VV_VV_UB 100.0 Def_st_ub_q1 0.0 255.0000 /begin FUNCTION_LIST IMDGEN_1PR /end FUNCTION_LIST /end CHARACTERISTIC
/begin CHARACTERISTIC K_GENUMGTYP "" VALUE 0x000C1575 TKW_VV_VV_UB 100.0 Def_st_ub_q1 0.0 255.0000 /begin FUNCTION_LIST IMDGEN_1PR /end FUNCTION_LIST /end CHARACTERISTIC
/begin CHARACTERISTIC K_IGBASIS "Generatorgrundstrombedarf FZG " VALUE 0x000C1576 TKW_VV_VV_UB 100.0 Def_i_ub_q1 0.0 255.0000 /begin FUNCTION_LIST IMDGEN_1PR /end FUNCTION_LIST /end CHARACTERISTIC
/begin CHARACTERISTIC K_IGBASISOFF "Generatorgrundstrombedarf FZG bei Genred" VALUE 0x000C1577 TKW_VV_VV_UB 100.0 Def_i_ub_q1 0.0 255.0000 /begin FUNCTION_LIST IMDGEN_1PR /end FUNCTION_LIST /end CHARACTERISTIC
/begin CHARACTERISTIC K_IGNOTWERT "" VALUE 0x000C1578 TKW_VV_VV_UB 100.0 Def_i_ub_q1 0.0 255.0000 /begin FUNCTION_LIST IMDGEN_1PR /end FUNCTION_LIST /end CHARACTERISTIC
/begin CHARACTERISTIC K_MANAWNUMM "" VALUE 0x000C1579 TKW_VV_VV_UB 100.0 Def_st_ub_q1 0.0 255.0000 /begin FUNCTION_LIST IMDGEN_1PR /end FUNCTION_LIST /end CHARACTERISTIC
/begin CHARACTERISTIC K_PRELLGTMOT "Prellzeit für Tmot-Schwelle" VALUE 0x000C157A TKW_VV_VV_UB 100.0 Def_td_ub_q1 0.0 255.0000 /begin FUNCTION_LIST IMDGEN_1PR /end FUNCTION_LIST /end CHARACTERISTIC
/begin CHARACTERISTIC K_TIGMISCH "" VALUE 0x000C157B TKW_VV_VV_UB 100.0 Def_td_ub_q0p01 0.0 2.5500 /begin FUNCTION_LIST IMDGEN_1PR /end FUNCTION_LIST /end CHARACTERISTIC
/begin CHARACTERISTIC K_TSTCNTEN "" VALUE 0x000C157C TKW_VV_VV_UB 100.0 Def_st_ub_q1 0.0 255.0000 /begin FUNCTION_LIST IMDGEN_1PR /end FUNCTION_LIST /end CHARACTERISTIC
/begin CHARACTERISTIC K_TSTFIL_INI "" VALUE 0x000C157D TKW_VV_VV_UB 100.0 Def_st_ub_q1 0.0 255.0000 /begin FUNCTION_LIST IMDGEN_1PR /end FUNCTION_LIST /end CHARACTERISTIC
/begin CHARACTERISTIC K_UDIODERMS1 "RMS-Schwellspannung Generatordiode1" VALUE 0x000C157E TKW_VV_VV_UB 100.0 Def_f_ub_b2 0.0 1.9921 /begin FUNCTION_LIST IMDGEN_1PR /end FUNCTION_LIST /end CHARACTERISTIC
/begin CHARACTERISTIC K_UDIODERMS2 "RMS-Schwellspannung Generatordiode2" VALUE 0x000C157F TKW_VV_VV_UB 100.0 Def_f_ub_b2 0.0 1.9921 /begin FUNCTION_LIST IMDGEN_1PR /end FUNCTION_LIST /end CHARACTERISTIC
/begin CHARACTERISTIC K_UDIODERMS3 "RMS-Schwellspannung Generatordiode3" VALUE 0x000C1580 TKW_VV_VV_UB 100.0 Def_f_ub_b2 0.0 1.9921 /begin FUNCTION_LIST IMDGEN_1PR /end FUNCTION_LIST /end CHARACTERISTIC
/begin CHARACTERISTIC K_UDIODERMS4 "RMS-Schwellspannung Generatordiode3" VALUE 0x000C1581 TKW_VV_VV_UB 100.0 Def_f_ub_b2 0.0 1.9921 /begin FUNCTION_LIST IMDGEN_1PR /end FUNCTION_LIST /end CHARACTERISTIC
/begin CHARACTERISTIC S_IGMISCH "" VALUE 0x000C1582 TKW_VV_VV_UB 100.0 Identity 0.0 1.0000 /begin FUNCTION_LIST IMDGEN_1PR /end FUNCTION_LIST /end CHARACTERISTIC
/begin CHARACTERISTIC S_RDGENTYP "" VALUE 0x000C1583 TKW_VV_VV_UB 100.0 Def_st_ub_q1 0.0 255.0000 /begin FUNCTION_LIST IMDGEN_1PR /end FUNCTION_LIST /end CHARACTERISTIC
/begin CHARACTERISTIC K_GENTYPFELD "Generatorkennfeldzuordnung" VAL_BLK 0x000C1584 TKW_VV_VV_UB 100.0 Def_st_ub_q1 0.0 255.0000 /begin FUNCTION_LIST IMDGEN_1PR /end FUNCTION_LIST NUMBER 33 /end CHARACTERISTIC
/begin CHARACTERISTIC KL_RTH0FAK3 "RTHfaktor3 ueber Generatorstrom" CURVE 0x000C182E TKL_UB_VV_UB 100.0 Def_f_ub_b4 0.0 3.9843 /begin FUNCTION_LIST IMDGEN_1PR /end FUNCTION_LIST /begin AXIS_DESCR STD_AXIS I_gen_end Def_i_ub_q1 11 0.0 255.0000 /end AXIS_DESCR /end CHARACTERISTIC
/begin CHARACTERISTIC KL_GENTETA4 "Temperatur_eta_faktor Generator4" CURVE 0x000C1846 TKL_SW_VV_UW 100.0 Def_f_uw_b2 0.0 1.9999 /begin FUNCTION_LIST IMDGEN_1PR /end FUNCTION_LIST
 /begin AXIS_DESCR STD_AXIS Tgen Def_t_sw_q0p1 3 -3276.8000 3276.7000 FORMAT "%4.1" /end AXIS_DESCR
/end CHARACTERISTIC
/begin CHARACTERISTIC KL_RTHGEN2 "RTH-Kennfeld Generator2" CURVE 0x000C1854 TKL_SW_VV_UW 100.0 Def_f_uw_b64 0.0 1.0000 /begin FUNCTION_LIST IMDGEN_1PR /end FUNCTION_LIST /begin AXIS_DESCR STD_AXIS N_gen Def_n_sw_q1p0 6 -32768.0000 32767.0000 /end AXIS_DESCR FORMAT "%7.4" /end CHARACTERISTIC
/begin CHARACTERISTIC KL_GENTETA3 "Temperatur_eta_faktor Generator3" CURVE 0x000C186E TKL_SW_VV_UW 100.0 Def_f_uw_b2 0.0 1.9999 /begin FUNCTION_LIST IMDGEN_1PR /end FUNCTION_LIST
 /begin AXIS_DESCR STD_AXIS Tgen Def_t_sw_q0p1 3 -3276.8000 3276.7000 FORMAT "%4.1" /end AXIS_DESCR
/end CHARACTERISTIC
/begin CHARACTERISTIC KL_RTH0FAK1 "RTHfaktor1 ueber Generatorstrom" CURVE 0x000C187C TKL_UB_VV_UB 100.0 Def_f_ub_b4 0.0 3.9843 /begin FUNCTION_LIST IMDGEN_1PR /end FUNCTION_LIST /begin AXIS_DESCR STD_AXIS I_gen_end Def_i_ub_q1 11 0.0 255.0000 /end AXIS_DESCR /end CHARACTERISTIC
/begin CHARACTERISTIC KL_RTHGEN1 "RTH-Kennfeld Generator1" CURVE 0x000C1894 TKL_SW_VV_UW 100.0 Def_f_uw_b64 0.0 1.0000 /begin FUNCTION_LIST IMDGEN_1PR /end FUNCTION_LIST /begin AXIS_DESCR STD_AXIS N_gen Def_n_sw_q1p0 6 -32768.0000 32767.0000 /end AXIS_DESCR FORMAT "%7.4" /end CHARACTERISTIC
/begin CHARACTERISTIC KL_RTH0FAK4 "RTHfaktor4 ueber Generatorstrom" CURVE 0x000C18AE TKL_UB_VV_UB 100.0 Def_f_ub_b4 0.0 3.9843 /begin FUNCTION_LIST IMDGEN_1PR /end FUNCTION_LIST /begin AXIS_DESCR STD_AXIS I_gen_end Def_i_ub_q1 11 0.0 255.0000 /end AXIS_DESCR /end CHARACTERISTIC
/begin CHARACTERISTIC KL_GENEXP2 "Abkühlkurve Generator2" CURVE 0x000C18C6 TKL_UW_VV_UB 100.0 Def_f_ub_b1 0.0 0.9960 /begin FUNCTION_LIST IMDGEN_1PR /end FUNCTION_LIST /begin AXIS_DESCR STD_AXIS Tn_abstell Def_st_uw_q1 13 0.0 65535.0000 /end AXIS_DESCR /end CHARACTERISTIC
/begin CHARACTERISTIC KL_RTHGEN3 "RTH-Kennfeld Generator3" CURVE 0x000C18F0 TKL_SW_VV_UW 100.0 Def_f_uw_b64 0.0 1.0000 /begin FUNCTION_LIST IMDGEN_1PR /end FUNCTION_LIST /begin AXIS_DESCR STD_AXIS N_gen Def_n_sw_q1p0 6 -32768.0000 32767.0000 /end AXIS_DESCR FORMAT "%7.4" /end CHARACTERISTIC
/begin CHARACTERISTIC KL_RTHFAK2 "RTHfaktor2 ueber Generatorstrom Fahrt" CURVE 0x000C190A TKL_UB_VV_UB 100.0 Def_f_ub_b4 0.0 3.9843 /begin FUNCTION_LIST IMDGEN_1PR /end FUNCTION_LIST /begin AXIS_DESCR STD_AXIS I_gen_end Def_i_ub_q1 11 0.0 255.0000 /end AXIS_DESCR /end CHARACTERISTIC
/begin CHARACTERISTIC KL_GENEXP1 "Abkühlkurve Generator1" CURVE 0x000C1922 TKL_UW_VV_UB 100.0 Def_f_ub_b1 0.0 0.9960 /begin FUNCTION_LIST IMDGEN_1PR /end FUNCTION_LIST /begin AXIS_DESCR STD_AXIS Tn_abstell Def_st_uw_q1 13 0.0 65535.0000 /end AXIS_DESCR /end CHARACTERISTIC
/begin CHARACTERISTIC KL_TANSGEN4 "Kennlinie Generatoransaugluft4" CURVE 0x000C194C TKL_UW_VV_SW 100.0 Def_t_sw_q0p1 -3276.8000 3276.7000 /begin FUNCTION_LIST IMDGEN_1PR /end FUNCTION_LIST /begin AXIS_DESCR STD_AXIS NO_INPUT_QUANTITY Def_v_uw_q1p0 10 0.0 360.0000 /end AXIS_DESCR FORMAT "%4.1" /end CHARACTERISTIC
/begin CHARACTERISTIC KL_GENEXP4 "Abkühlkurve Generator4" CURVE 0x000C1976 TKL_UW_VV_UB 100.0 Def_f_ub_b1 0.0 0.9960 /begin FUNCTION_LIST IMDGEN_1PR /end FUNCTION_LIST /begin AXIS_DESCR STD_AXIS Tn_abstell Def_st_uw_q1 13 0.0 65535.0000 /end AXIS_DESCR /end CHARACTERISTIC
/begin CHARACTERISTIC KL_TANSGEN3 "Kennlinie Generatoransaugluft3" CURVE 0x000C19A0 TKL_UW_VV_SW 100.0 Def_t_sw_q0p1 -3276.8000 3276.7000 /begin FUNCTION_LIST IMDGEN_1PR /end FUNCTION_LIST /begin AXIS_DESCR STD_AXIS NO_INPUT_QUANTITY Def_v_uw_q1p0 10 0.0 360.0000 /end AXIS_DESCR FORMAT "%4.1" /end CHARACTERISTIC
/begin CHARACTERISTIC KL_TANSGEN1 "Kennlinie Generatoransaugluft1" CURVE 0x000C19CA TKL_UW_VV_SW 100.0 Def_t_sw_q0p1 -3276.8000 3276.7000 /begin FUNCTION_LIST IMDGEN_1PR /end FUNCTION_LIST /begin AXIS_DESCR STD_AXIS NO_INPUT_QUANTITY Def_v_uw_q1p0 10 0.0 360.0000 /end AXIS_DESCR FORMAT "%4.1" /end CHARACTERISTIC
/begin CHARACTERISTIC KL_RTHFAK3 "RTHfaktor3 ueber Generatorstrom Fahrt" CURVE 0x000C19F4 TKL_UB_VV_UB 100.0 Def_f_ub_b4 0.0 3.9843 /begin FUNCTION_LIST IMDGEN_1PR /end FUNCTION_LIST /begin AXIS_DESCR STD_AXIS I_gen_end Def_i_ub_q1 11 0.0 255.0000 /end AXIS_DESCR /end CHARACTERISTIC
/begin CHARACTERISTIC KL_TANSGEN2 "Kennlinie Generatoransaugluft2" CURVE 0x000C1A0C TKL_UW_VV_SW 100.0 Def_t_sw_q0p1 -3276.8000 3276.7000 /begin FUNCTION_LIST IMDGEN_1PR /end FUNCTION_LIST /begin AXIS_DESCR STD_AXIS NO_INPUT_QUANTITY Def_v_uw_q1p0 10 0.0 360.0000 /end AXIS_DESCR FORMAT "%4.1" /end CHARACTERISTIC
/begin CHARACTERISTIC KL_RTHFAK4 "RTHfaktor4 ueber Generatorstrom Fahrt" CURVE 0x000C1A36 TKL_UB_VV_UB 100.0 Def_f_ub_b4 0.0 3.9843 /begin FUNCTION_LIST IMDGEN_1PR /end FUNCTION_LIST /begin AXIS_DESCR STD_AXIS I_gen_end Def_i_ub_q1 11 0.0 255.0000 /end AXIS_DESCR /end CHARACTERISTIC
/begin CHARACTERISTIC KL_GENEXP3 "Abkühlkurve Generator3" CURVE 0x000C1A4E TKL_UW_VV_UB 100.0 Def_f_ub_b1 0.0 0.9960 /begin FUNCTION_LIST IMDGEN_1PR /end FUNCTION_LIST /begin AXIS_DESCR STD_AXIS Tn_abstell Def_st_uw_q1 13 0.0 65535.0000 /end AXIS_DESCR /end CHARACTERISTIC
/begin CHARACTERISTIC KL_FPDIODE3 "Verlustleistungsfaktor eines Diodenpaars" CURVE 0x000C1A78 TKL_SW_VV_UB 100.0 Def_f_ub_b2 0.0 1.9921 /begin FUNCTION_LIST IMDGEN_1PR /end FUNCTION_LIST
 /begin AXIS_DESCR STD_AXIS Tgen Def_t_sw_q0p1 5 -3276.8000 3276.7000 FORMAT "%4.1" /end AXIS_DESCR
/end CHARACTERISTIC
/begin CHARACTERISTIC KL_GENTETA1 "Temperatur_eta_faktor Generator1" CURVE 0x000C1A8A TKL_SW_VV_UW 100.0 Def_f_uw_b2 0.0 1.9999 /begin FUNCTION_LIST IMDGEN_1PR /end FUNCTION_LIST
 /begin AXIS_DESCR STD_AXIS Tgen Def_t_sw_q0p1 3 -3276.8000 3276.7000 FORMAT "%4.1" /end AXIS_DESCR
/end CHARACTERISTIC
/begin CHARACTERISTIC KL_RTH0FAK2 "RTHfaktor 2 ueber Generatorstrom" CURVE 0x000C1A98 TKL_UB_VV_UB 100.0 Def_f_ub_b4 0.0 3.9843 /begin FUNCTION_LIST IMDGEN_1PR /end FUNCTION_LIST /begin AXIS_DESCR STD_AXIS I_gen_end Def_i_ub_q1 11 0.0 255.0000 /end AXIS_DESCR /end CHARACTERISTIC
/begin CHARACTERISTIC KL_FPDIODE1 "Verlustleistungsfaktor eines Diodenpaars1" CURVE 0x000C1AB0 TKL_SW_VV_UB 100.0 Def_f_ub_b2 0.0 1.9921 /begin FUNCTION_LIST IMDGEN_1PR /end FUNCTION_LIST
 /begin AXIS_DESCR STD_AXIS Tgen Def_t_sw_q0p1 5 -3276.8000 3276.7000 FORMAT "%4.1" /end AXIS_DESCR
/end CHARACTERISTIC
/begin CHARACTERISTIC KL_RTHGEN4 "RTH-Kennfeld Generator4" CURVE 0x000C1AC2 TKL_SW_VV_UW 100.0 Def_f_uw_b64 0.0 1.0000 /begin FUNCTION_LIST IMDGEN_1PR /end FUNCTION_LIST /begin AXIS_DESCR STD_AXIS N_gen Def_n_sw_q1p0 6 -32768.0000 32767.0000 /end AXIS_DESCR FORMAT "%7.4" /end CHARACTERISTIC
/begin CHARACTERISTIC KL_GENTETA2 "Temperatur_eta_faktor Generator2" CURVE 0x000C1ADC TKL_SW_VV_UW 100.0 Def_f_uw_b2 0.0 1.9999 /begin FUNCTION_LIST IMDGEN_1PR /end FUNCTION_LIST
 /begin AXIS_DESCR STD_AXIS Tgen Def_t_sw_q0p1 3 -3276.8000 3276.7000 FORMAT "%4.1" /end AXIS_DESCR
/end CHARACTERISTIC
/begin CHARACTERISTIC KL_RTHFAK1 "RTHfaktor ueber Generatorstrom" CURVE 0x000C1AEA TKL_UB_VV_UB 100.0 Def_f_ub_b4 0.0 3.9843 /begin FUNCTION_LIST IMDGEN_1PR /end FUNCTION_LIST /begin AXIS_DESCR STD_AXIS I_gen_end Def_i_ub_q1 11 0.0 255.0000 /end AXIS_DESCR /end CHARACTERISTIC
/begin CHARACTERISTIC KL_FPDIODE4 "Verlustleistungsfaktor eines Diodenpaars4" CURVE 0x000C1B02 TKL_SW_VV_UB 100.0 Def_f_ub_b2 0.0 1.9921 /begin FUNCTION_LIST IMDGEN_1PR /end FUNCTION_LIST
 /begin AXIS_DESCR STD_AXIS Tgen Def_t_sw_q0p1 5 -3276.8000 3276.7000 FORMAT "%4.1" /end AXIS_DESCR
/end CHARACTERISTIC
/begin CHARACTERISTIC KL_FPDIODE2 "Verlustleistungsfaktor eines Diodenpaars2" CURVE 0x000C1B14 TKL_SW_VV_UB 100.0 Def_f_ub_b2 0.0 1.9921 /begin FUNCTION_LIST IMDGEN_1PR /end FUNCTION_LIST
 /begin AXIS_DESCR STD_AXIS Tgen Def_t_sw_q0p1 5 -3276.8000 3276.7000 FORMAT "%4.1" /end AXIS_DESCR
/end CHARACTERISTIC
/begin CHARACTERISTIC KF_GENWETA1 "Wirkungsgrad1 Generator mit 2*PI" MAP 0x000C1B26 TKF_SW_UB_UB 100.0 Def_f_ub_b8 0.0 7.9687 /begin FUNCTION_LIST IMDGEN_1PR /end FUNCTION_LIST /begin AXIS_DESCR STD_AXIS I_gm Def_i_ub_q1 8 0.0 255.0000 /end AXIS_DESCR /begin AXIS_DESCR STD_AXIS N_gen Def_n_sw_q1p0 8 -32768.0000 32767.0000 /end AXIS_DESCR /end CHARACTERISTIC
/begin CHARACTERISTIC KF_GENWETA2 "Wirkungsgrad2 Generator mit 2*PI" MAP 0x000C1B80 TKF_SW_UB_UB 100.0 Def_f_ub_b8 0.0 7.9687 /begin FUNCTION_LIST IMDGEN_1PR /end FUNCTION_LIST /begin AXIS_DESCR STD_AXIS I_gm Def_i_ub_q1 8 0.0 255.0000 /end AXIS_DESCR /begin AXIS_DESCR STD_AXIS N_gen Def_n_sw_q1p0 8 -32768.0000 32767.0000 /end AXIS_DESCR /end CHARACTERISTIC
/begin CHARACTERISTIC KF_MDGENFIL "Filterung Generatormoment" MAP 0x000C1BDA TKF_SW_SW_UW 100.0 Def_f_uw_b1 0.0 9.99984741210938e-1 /begin FUNCTION_LIST IMDGEN_1PR /end FUNCTION_LIST
 /begin AXIS_DESCR STD_AXIS Md_gennmufi Def_m_sw_q0p1 6 -3276.8000 3276.7000 FORMAT "%5.2" /end AXIS_DESCR
 /begin AXIS_DESCR STD_AXIS Nkw Def_n_sw_q1p0 6 -32768.0000 32767.0000 /end AXIS_DESCR
/end CHARACTERISTIC
/begin CHARACTERISTIC KF_GENWETA4 "Wirkungsgrad4 Generator mit 2*PI" MAP 0x000C1C3C TKF_SW_UB_UB 100.0 Def_f_ub_b8 0.0 7.9687 /begin FUNCTION_LIST IMDGEN_1PR /end FUNCTION_LIST /begin AXIS_DESCR STD_AXIS I_gm Def_i_ub_q1 8 0.0 255.0000 /end AXIS_DESCR /begin AXIS_DESCR STD_AXIS N_gen Def_n_sw_q1p0 8 -32768.0000 32767.0000 /end AXIS_DESCR /end CHARACTERISTIC
/begin CHARACTERISTIC KF_GENWETA3 "Wirkungsgrad3 Generator mit 2*PI" MAP 0x000C1C96 TKF_SW_UB_UB 100.0 Def_f_ub_b8 0.0 7.9687 /begin FUNCTION_LIST IMDGEN_1PR /end FUNCTION_LIST /begin AXIS_DESCR STD_AXIS I_gm Def_i_ub_q1 8 0.0 255.0000 /end AXIS_DESCR /begin AXIS_DESCR STD_AXIS N_gen Def_n_sw_q1p0 8 -32768.0000 32767.0000 /end AXIS_DESCR /end CHARACTERISTIC
/begin CHARACTERISTIC KF_IGENDF2 "Generatorstrom2 DF-Kennfeld" MAP 0x000C1CF0 TKF_UB_UB_UB 100.0 Def_i_ub_q1 0.0 255.0000 /begin FUNCTION_LIST IMDGEN_1PR /end FUNCTION_LIST /begin AXIS_DESCR STD_AXIS Dffgen Def_f_ub_b100 7 0.0 99.6093 /end AXIS_DESCR /begin AXIS_DESCR STD_AXIS I_genmax Def_i_ub_q1 8 0.0 255.0000 /end AXIS_DESCR /end CHARACTERISTIC
/begin CHARACTERISTIC KF_IGENDF1 "Generatorstrom1 DF-Kennfeld" MAP 0x000C1D39 TKF_UB_UB_UB 100.0 Def_i_ub_q1 0.0 255.0000 /begin FUNCTION_LIST IMDGEN_1PR /end FUNCTION_LIST /begin AXIS_DESCR STD_AXIS Dffgen Def_f_ub_b100 7 0.0 99.6093 /end AXIS_DESCR /begin AXIS_DESCR STD_AXIS I_genmax Def_i_ub_q1 8 0.0 255.0000 /end AXIS_DESCR /end CHARACTERISTIC
/begin CHARACTERISTIC KF_IGENDF4 "Generatorstrom4 DF-Kennfeld" MAP 0x000C1D82 TKF_UB_UB_UB 100.0 Def_i_ub_q1 0.0 255.0000 /begin FUNCTION_LIST IMDGEN_1PR /end FUNCTION_LIST /begin AXIS_DESCR STD_AXIS Dffgen Def_f_ub_b100 7 0.0 99.6093 /end AXIS_DESCR /begin AXIS_DESCR STD_AXIS I_genmax Def_i_ub_q1 8 0.0 255.0000 /end AXIS_DESCR /end CHARACTERISTIC
/begin CHARACTERISTIC KF_IGENDF3 "Generatorstrom3 DF-Kennfeld" MAP 0x000C1DCB TKF_UB_UB_UB 100.0 Def_i_ub_q1 0.0 255.0000 /begin FUNCTION_LIST IMDGEN_1PR /end FUNCTION_LIST /begin AXIS_DESCR STD_AXIS Dffgen Def_f_ub_b100 7 0.0 99.6093 /end AXIS_DESCR /begin AXIS_DESCR STD_AXIS I_genmax Def_i_ub_q1 8 0.0 255.0000 /end AXIS_DESCR /end CHARACTERISTIC
/begin CHARACTERISTIC K_ENISOC0 "" VALUE 0x000C1E18 TKW_VV_VV_UB 100.0 Def_i_ub_q0p02 0.0 5.1000 /begin FUNCTION_LIST KT_IBS /end FUNCTION_LIST /end CHARACTERISTIC
/begin CHARACTERISTIC K_ENUSOC0 "" VALUE 0x000C1E19 TKW_VV_VV_UB 100.0 Def_u_ub_q0p064_o6 6.0000 22.3200 /begin FUNCTION_LIST KT_IBS /end FUNCTION_LIST /end CHARACTERISTIC
/begin CHARACTERISTIC K_T1SOC0 "" VALUE 0x000C1E1A TKW_VV_VV_UB 100.0 Def_td_ub_q256 0.0 65280.0000 /begin FUNCTION_LIST KT_IBS /end FUNCTION_LIST /end CHARACTERISTIC
/begin CHARACTERISTIC K_T2SOC0 "" VALUE 0x000C1E1B TKW_VV_VV_UB 100.0 Def_td_ub_q256 0.0 65280.0000 /begin FUNCTION_LIST KT_IBS /end FUNCTION_LIST /end CHARACTERISTIC
/begin CHARACTERISTIC K_T3SOC0 "" VALUE 0x000C1E1C TKW_VV_VV_UB 100.0 Def_td_ub_q256 0.0 65280.0000 /begin FUNCTION_LIST KT_IBS /end FUNCTION_LIST /end CHARACTERISTIC
/begin CHARACTERISTIC K_ISTARTTRIG "" VALUE 0x000C1E1D TKW_VV_VV_UB 100.0 Def_i_ub_q5p12 0.0 1305.6000 /begin FUNCTION_LIST KT_IBS /end FUNCTION_LIST /end CHARACTERISTIC
/begin CHARACTERISTIC K_TNUSTART "" VALUE 0x000C1E1E TKW_VV_VV_UB 100.0 Def_td_ub_q0p0125 0.0 3.1875 /begin FUNCTION_LIST KT_IBS /end FUNCTION_LIST /end CHARACTERISTIC
/begin CHARACTERISTIC K_TNUSTARTFL "" VALUE 0x000C1E1F TKW_VV_VV_UB 100.0 Def_td_ub_q0p002_o01 0.0100 0.5200 /begin FUNCTION_LIST KT_IBS /end FUNCTION_LIST /end CHARACTERISTIC
/begin CHARACTERISTIC K_UTIEFAPP "" VALUE 0x000C1E20 TKW_VV_VV_UB 100.0 Def_u_ub_q0p064_o6 6.0000 22.3200 /begin FUNCTION_LIST KT_IBS /end FUNCTION_LIST /end CHARACTERISTIC
/begin CHARACTERISTIC K_T_UTIEFSET "" VALUE 0x000C1E21 TKW_VV_VV_UB 100.0 Def_td_ub_q1 0.0 255.0000 /begin FUNCTION_LIST KT_IBS /end FUNCTION_LIST /end CHARACTERISTIC
/begin CHARACTERISTIC K_TSLEEPRUH "" VALUE 0x000C1E22 TKW_VV_VV_UB 100.0 Def_td_ub_q16 0.0 4080.0000 /begin FUNCTION_LIST KT_IBS /end FUNCTION_LIST /end CHARACTERISTIC
/begin CHARACTERISTIC K_T1SCHWELLE "" VALUE 0x000C1E23 TKW_VV_VV_UB 100.0 Def_i_ub_q0p04 0.0 10.2000 /begin FUNCTION_LIST KT_IBS /end FUNCTION_LIST /end CHARACTERISTIC
/begin CHARACTERISTIC K_T2SCHWELLE "" VALUE 0x000C1E24 TKW_VV_VV_UB 100.0 Def_i_ub_q0p04 0.0 10.2000 /begin FUNCTION_LIST KT_IBS /end FUNCTION_LIST /end CHARACTERISTIC
/begin CHARACTERISTIC K_T3SCHWELLE "" VALUE 0x000C1E25 TKW_VV_VV_UB 100.0 Def_i_ub_q0p04 0.0 10.2000 /begin FUNCTION_LIST KT_IBS /end FUNCTION_LIST /end CHARACTERISTIC
/begin CHARACTERISTIC K_ISLEEPGRZ "" VALUE 0x000C1E26 TKW_VV_VV_UB 100.0 Def_i_ub_q0p02 0.0 5.1000 /begin FUNCTION_LIST KT_IBS /end FUNCTION_LIST /end CHARACTERISTIC
/begin CHARACTERISTIC K_DI1000TGRZ "" VALUE 0x000C1E27 TKW_VV_VV_UB 100.0 Def_td_ub_q1 0.0 255.0000 /begin FUNCTION_LIST KT_IBS /end FUNCTION_LIST /end CHARACTERISTIC
/begin CHARACTERISTIC K_DUIGRZ "" VALUE 0x000C1E28 TKW_VV_VV_UB 100.0 Def_i_ub_q0p02 0.0 5.1000 /begin FUNCTION_LIST KT_IBS /end FUNCTION_LIST /end CHARACTERISTIC
/begin CHARACTERISTIC K_DTMAXGRZI "" VALUE 0x000C1E29 TKW_VV_VV_UB 100.0 Def_td_ub_q1 0.0 255.0000 /begin FUNCTION_LIST KT_IBS /end FUNCTION_LIST /end CHARACTERISTIC
/begin CHARACTERISTIC K_DILOWGRZ "" VALUE 0x000C1E2A TKW_VV_VV_UB 100.0 Def_i_ub_q0p02 0.0 5.1000 /begin FUNCTION_LIST KT_IBS /end FUNCTION_LIST /end CHARACTERISTIC
/begin CHARACTERISTIC K_DIHIGHGRZ "" VALUE 0x000C1E2B TKW_VV_VV_UB 100.0 Def_i_ub_q0p08 0.0 20.4000 /begin FUNCTION_LIST KT_IBS /end FUNCTION_LIST /end CHARACTERISTIC
/begin CHARACTERISTIC K_DUMINTGRZ "" VALUE 0x000C1E2C TKW_VV_VV_UB 100.0 Def_td_ub_q0p05 0.0 12.7500 /begin FUNCTION_LIST KT_IBS /end FUNCTION_LIST /end CHARACTERISTIC
/begin CHARACTERISTIC K_DKL15FIL "" VALUE 0x000C1E2D TKW_VV_VV_UB 100.0 Def_td_ub_q0p00625 0.0 1.5937 /begin FUNCTION_LIST KT_IBS /end FUNCTION_LIST /end CHARACTERISTIC
/begin CHARACTERISTIC K_DUREFMAX "" VALUE 0x000C1E2E TKW_VV_VV_UB 100.0 Def_u_ub_q0p0196 0.0 4.9980 /begin FUNCTION_LIST KT_IBS /end FUNCTION_LIST /end CHARACTERISTIC
/begin CHARACTERISTIC K_DI200STG "" VALUE 0x000C1E2F TKW_VV_VV_UB 100.0 Def_i_ub_q0p02 0.0 5.1000 /begin FUNCTION_LIST KT_IBS /end FUNCTION_LIST /end CHARACTERISTIC
/begin CHARACTERISTIC K_DI1000STG "" VALUE 0x000C1E30 TKW_VV_VV_UB 100.0 Def_i_ub_q0p08 0.0 20.4000 /begin FUNCTION_LIST KT_IBS /end FUNCTION_LIST /end CHARACTERISTIC
/begin CHARACTERISTIC K_DI200DT "" VALUE 0x000C1E31 TKW_VV_VV_UB 100.0 Def_td_ub_q0p05 0.0 12.7500 /begin FUNCTION_LIST KT_IBS /end FUNCTION_LIST /end CHARACTERISTIC
/begin CHARACTERISTIC K_DI1000DT "" VALUE 0x000C1E32 TKW_VV_VV_UB 100.0 Def_td_ub_q0p05 0.0 12.7500 /begin FUNCTION_LIST KT_IBS /end FUNCTION_LIST /end CHARACTERISTIC
/begin CHARACTERISTIC K_TMPCOM_MUL "" VALUE 0x000C1E33 TKW_VV_VV_UB 100.0 Def_dez_ub_q1 0.0 255.0000 /begin FUNCTION_LIST KT_IBS /end FUNCTION_LIST /end CHARACTERISTIC
/begin CHARACTERISTIC K_TMPCOM_DIV "" VALUE 0x000C1E34 TKW_VV_VV_UB 100.0 Def_dez_ub_q1 0.0 255.0000 /begin FUNCTION_LIST KT_IBS /end FUNCTION_LIST /end CHARACTERISTIC
/begin CHARACTERISTIC K_DIPL5 "" VALUE 0x000C1E35 TKW_VV_VV_UB 100.0 Def_dez_ub_q1 0.0 255.0000 /begin FUNCTION_LIST KT_IBS /end FUNCTION_LIST /end CHARACTERISTIC
/begin CHARACTERISTIC K_DIPL6 "" VALUE 0x000C1E36 TKW_VV_VV_UB 100.0 Def_dez_ub_q1 0.0 255.0000 /begin FUNCTION_LIST KT_IBS /end FUNCTION_LIST /end CHARACTERISTIC
/begin CHARACTERISTIC K_DIPL7 "" VALUE 0x000C1E37 TKW_VV_VV_UB 100.0 Def_dez_ub_q1 0.0 255.0000 /begin FUNCTION_LIST KT_IBS /end FUNCTION_LIST /end CHARACTERISTIC
/begin CHARACTERISTIC K_DIPL8 "" VALUE 0x000C1E38 TKW_VV_VV_UB 100.0 Def_dez_ub_q1 0.0 255.0000 /begin FUNCTION_LIST KT_IBS /end FUNCTION_LIST /end CHARACTERISTIC
/begin CHARACTERISTIC K_DUREFMINI "" VALUE 0x000C1E39 TKW_VV_VV_UB 100.0 Def_u_ub_q0p0196 0.0 4.9980 /begin FUNCTION_LIST KT_IBS /end FUNCTION_LIST /end CHARACTERISTIC
/begin CHARACTERISTIC K_IBTEMPMAXI "" VALUE 0x000C1E3A TKW_VV_VV_UB 100.0 Def_dez_ub_q1 0.0 255.0000 /begin FUNCTION_LIST KT_IBS /end FUNCTION_LIST /end CHARACTERISTIC
/begin CHARACTERISTIC K_IBTEMPMINI "" VALUE 0x000C1E3B TKW_VV_VV_UB 100.0 Def_dez_ub_q1 0.0 255.0000 /begin FUNCTION_LIST KT_IBS /end FUNCTION_LIST /end CHARACTERISTIC
/begin CHARACTERISTIC K_IBSVERSION "Liste der kompatiblen IBS SW- Versionen" VAL_BLK 0x000C1E3C TKW_VV_VV_UB 100.0 Def_dez_ub_q1 0.0 255.0000 /begin FUNCTION_LIST KT_IBS /end FUNCTION_LIST NUMBER 16 /end CHARACTERISTIC
/begin CHARACTERISTIC K_ENABSDIBS "kt_ibs enable Kommunikation" VALUE 0x000C1E4C TKW_VV_VV_UB 100.0 Def_dez_ub_q1 0.0 255.0000 /begin FUNCTION_LIST KT_IBS /end FUNCTION_LIST /end CHARACTERISTIC
/begin CHARACTERISTIC K_ERREPEAT "EBSD Fehler repeat" VALUE 0x000C1E4D TKW_VV_VV_UB 100.0 Def_dez_ub_q1 0.0 255.0000 /begin FUNCTION_LIST KT_IBS /end FUNCTION_LIST /end CHARACTERISTIC
/begin CHARACTERISTIC K_IBUNPLADEL "EBSD Fehler repeat" VALUE 0x000C1E4E TKW_VV_VV_UB 100.0 Def_dez_ub_q1 0.0 255.0000 /begin FUNCTION_LIST KT_IBS /end FUNCTION_LIST /end CHARACTERISTIC
/begin CHARACTERISTIC K_IBSTSTERR "EBSD Fehler repeat" VALUE 0x000C1E4F TKW_VV_VV_UB 100.0 Def_dez_ub_q1 0.0 255.0000 /begin FUNCTION_LIST KT_IBS /end FUNCTION_LIST /end CHARACTERISTIC
/begin CHARACTERISTIC K_S_CLERRIBS "IBS Fehlerlöschen schaltbar" VALUE 0x000C1E50 TKW_VV_VV_UB 100.0 Def_dez_ub_q1 0.0 255.0000 /begin FUNCTION_LIST KT_IBS /end FUNCTION_LIST /end CHARACTERISTIC
/begin CHARACTERISTIC K_T_CLERRIBS "" VALUE 0x000C1E51 TKW_VV_VV_UB 100.0 Def_dez_ub_q1 0.0 255.0000 /begin FUNCTION_LIST KT_IBS /end FUNCTION_LIST /end CHARACTERISTIC
/begin CHARACTERISTIC K_SLEEPWAIT "" VALUE 0x000C1E52 TKW_VV_VV_UB 100.0 ident 0.0 255.0000 /begin FUNCTION_LIST KT_IBS /end FUNCTION_LIST /end CHARACTERISTIC
/begin CHARACTERISTIC K_TPT1TICO "" VALUE 0x000C1E14 TKW_VV_VV_UW 100.0 Def_td_uw_q0p05 0.0 3276.7500 /begin FUNCTION_LIST KT_IBS /end FUNCTION_LIST FORMAT "%5.2" /end CHARACTERISTIC
/begin CHARACTERISTIC K_LBATTMAXK "maximale Batterieladespannung Kofferraum" VALUE 0x000C1E54 TKW_VV_VV_SW 100.0 Def_u_sw_b128 0.0 127.9960 /begin FUNCTION_LIST LBATTCAL /end FUNCTION_LIST FORMAT "%6.3" /end CHARACTERISTIC
/begin CHARACTERISTIC K_LBATTMAXM "maximale Batterieladespannung" VALUE 0x000C1E56 TKW_VV_VV_SW 100.0 Def_u_sw_b128 0.0 127.9960 /begin FUNCTION_LIST LBATTCAL /end FUNCTION_LIST FORMAT "%6.3" /end CHARACTERISTIC
/begin CHARACTERISTIC K_LBATTMIN "minmale Batterieladespannung Licht an" VALUE 0x000C1E58 TKW_VV_VV_SW 100.0 Def_u_sw_b128 0.0 127.9960 /begin FUNCTION_LIST LBATTCAL /end FUNCTION_LIST FORMAT "%6.3" /end CHARACTERISTIC
/begin CHARACTERISTIC K_LBATTTUMG "" VALUE 0x000C1E5A TKW_VV_VV_SW 100.0 Def_t_sw_q0p1 -3276.8000 3276.7000 /begin FUNCTION_LIST LBATTCAL /end FUNCTION_LIST FORMAT "%4.1" /end CHARACTERISTIC
/begin CHARACTERISTIC K_LBATTTUMGBA "" VALUE 0x000C1E5C TKW_VV_VV_SW 100.0 Def_t_sw_q0p1 -3276.8000 3276.7000 /begin FUNCTION_LIST LBATTCAL /end FUNCTION_LIST FORMAT "%4.1" /end CHARACTERISTIC
/begin CHARACTERISTIC K_UKOMPK "Applikationswert Kompensationsspannung Kafferraum" VALUE 0x000C1E5E TKW_VV_VV_SW 100.0 Def_u_sw_b128 0.0 127.9960 /begin FUNCTION_LIST LBATTCAL /end FUNCTION_LIST FORMAT "%6.3" /end CHARACTERISTIC
/begin CHARACTERISTIC K_UKOMPM "Applikationswert Kompensationsspannung Motorraum" VALUE 0x000C1E60 TKW_VV_VV_SW 100.0 Def_u_sw_b128 0.0 127.9960 /begin FUNCTION_LIST LBATTCAL /end FUNCTION_LIST FORMAT "%6.3" /end CHARACTERISTIC
/begin CHARACTERISTIC K_RLEITUNGK "Widerstand Ladeleitung Batterie Kofferraum" VALUE 0x000C1E8E TKW_VV_VV_UB 100.0 Def_f_ub_b32 0.0 31.8750 /begin FUNCTION_LIST LBATTCAL /end FUNCTION_LIST /end CHARACTERISTIC
/begin CHARACTERISTIC K_RLEITUNGM "Widerstand Ladeleitung Batterie Motorraum" VALUE 0x000C1E8F TKW_VV_VV_UB 100.0 Def_f_ub_b32 0.0 31.8750 /begin FUNCTION_LIST LBATTCAL /end FUNCTION_LIST /end CHARACTERISTIC
/begin CHARACTERISTIC K_TIMERDLY "Verzoegerungszeit für Startwertberechnung" VALUE 0x000C1E90 TKW_VV_VV_UB 100.0 Def_dez_ub_q1 0.0 255.0000 /begin FUNCTION_LIST LBATTCAL /end FUNCTION_LIST /end CHARACTERISTIC
/begin CHARACTERISTIC S_LBATT1 "Applikationsschalter1 Auswahl Ersatztemperatur" VALUE 0x000C1E91 TKW_VV_VV_UB 100.0 Identity 0.0 1.0000 /begin FUNCTION_LIST LBATTCAL /end FUNCTION_LIST /end CHARACTERISTIC
/begin CHARACTERISTIC S_LBATT2 "Applikationsschalter2 Auswahl Ersatztemperatur" VALUE 0x000C1E92 TKW_VV_VV_UB 100.0 Identity 0.0 1.0000 /begin FUNCTION_LIST LBATTCAL /end FUNCTION_LIST /end CHARACTERISTIC
/begin CHARACTERISTIC K_DTANSKOR "Ansaugluftmodelloffset Aussentemperatur" VALUE 0x000C1E62 TKW_VV_VV_SW 100.0 Def_t_sw_q0p1 -3276.8000 3276.7000 /begin FUNCTION_LIST LBATTCAL /end FUNCTION_LIST FORMAT "%4.1" /end CHARACTERISTIC
/begin CHARACTERISTIC K_NMINUMG "Drehzahlschwelle Aussentemperaturmodell" VALUE 0x000C1E64 TKW_VV_VV_SW 100.0 Def_n_sw_q1p0 0.0 32767.0000 /begin FUNCTION_LIST LBATTCAL /end FUNCTION_LIST /end CHARACTERISTIC
/begin CHARACTERISTIC K_OFTUMGCAN "Offset Umgebungstemperatur CAN" VALUE 0x000C1E66 TKW_VV_VV_SW 100.0 Def_t_sw_q0p1 -3276.8000 3276.7000 /begin FUNCTION_LIST LBATTCAL /end FUNCTION_LIST FORMAT "%4.1" /end CHARACTERISTIC
/begin CHARACTERISTIC K_OFULADE "Offset Ladekennlinie Batthinten" VALUE 0x000C1E68 TKW_VV_VV_SW 100.0 Def_u_sw_b128 -128.0000 127.9960 /begin FUNCTION_LIST LBATTCAL /end FUNCTION_LIST FORMAT "%6.3" /end CHARACTERISTIC
/begin CHARACTERISTIC K_PLBATTUMG "Plausibilisierung-Schwelle Batterieumgebungstemperatur" VALUE 0x000C1E6A TKW_VV_VV_SW 100.0 Def_t_sw_q0p1 0.0 3276.7000 /begin FUNCTION_LIST LBATTCAL /end FUNCTION_LIST FORMAT "%4.1" /end CHARACTERISTIC
/begin CHARACTERISTIC K_TBATINIMAN "Applikation INITWERT Batterietemperatur" VALUE 0x000C1E6C TKW_VV_VV_SW 100.0 Def_t_sw_q0p1 0.0 3276.7000 /begin FUNCTION_LIST LBATTCAL /end FUNCTION_LIST FORMAT "%4.1" /end CHARACTERISTIC
/begin CHARACTERISTIC K_TUMGINI "Initialisierungswert Aussentemperaturmodell" VALUE 0x000C1E6E TKW_VV_VV_SW 100.0 Def_t_sw_q0p1 -3276.8000 3276.7000 /begin FUNCTION_LIST LBATTCAL /end FUNCTION_LIST FORMAT "%4.1" /end CHARACTERISTIC
/begin CHARACTERISTIC K_UBATTNORM "Batterienormspannung" VALUE 0x000C1E70 TKW_VV_VV_SW 100.0 Def_u_sw_b128 -128.0000 127.9960 /begin FUNCTION_LIST LBATTCAL /end FUNCTION_LIST FORMAT "%6.3" /end CHARACTERISTIC
/begin CHARACTERISTIC K_BATTHTAUVG "Zeitkonstante Batterie hinten bei VFZG>" VALUE 0x000C1E72 TKW_VV_VV_UW 100.0 Def_f_uw_b1 0.0 9.99984741210938e-1 /begin FUNCTION_LIST LBATTCAL /end FUNCTION_LIST /end CHARACTERISTIC
/begin CHARACTERISTIC K_BATTHTAUVK "Zeitkonstante Batterie hinten bei VFZG<" VALUE 0x000C1E74 TKW_VV_VV_UW 100.0 Def_f_uw_b1 0.0 9.99984741210938e-1 /begin FUNCTION_LIST LBATTCAL /end FUNCTION_LIST /end CHARACTERISTIC
/begin CHARACTERISTIC K_BATTVTAUVG "Zeitkonstante Batterie vorne bei VFZG>" VALUE 0x000C1E76 TKW_VV_VV_UW 100.0 Def_f_uw_b1 0.0 9.99984741210938e-1 /begin FUNCTION_LIST LBATTCAL /end FUNCTION_LIST /end CHARACTERISTIC
/begin CHARACTERISTIC K_BATTVTAUVK "Zeitkonstante Batterie bei VFZG<Zeitkonstante Batterie bei VFZG>" VALUE 0x000C1E78 TKW_VV_VV_UW 100.0 Def_f_uw_b1 0.0 9.99984741210938e-1 /begin FUNCTION_LIST LBATTCAL /end FUNCTION_LIST /end CHARACTERISTIC
/begin CHARACTERISTIC K_BATT_ALFAH "Alphatau-Wert Batterie hinten" VALUE 0x000C1E7A TKW_VV_VV_UW 100.0 Def_f_uw_b1 1.52587890625e-5 9.99984741210938e-1 /begin FUNCTION_LIST LBATTCAL /end FUNCTION_LIST /end CHARACTERISTIC
/begin CHARACTERISTIC K_BATT_ALFAV "Alphatau-Wert Batterie vorne" VALUE 0x000C1E7C TKW_VV_VV_UW 100.0 Def_f_uw_b1 1.52587890625e-5 9.99984741210938e-1 /begin FUNCTION_LIST LBATTCAL /end FUNCTION_LIST /end CHARACTERISTIC
/begin CHARACTERISTIC K_BATT_BETAV "Beta-Wert Batterie vorne" VALUE 0x000C1E7E TKW_VV_VV_UW 100.0 Def_f_uw_b1 1.52587890625e-5 9.99984741210938e-1 /begin FUNCTION_LIST LBATTCAL /end FUNCTION_LIST /end CHARACTERISTIC
/begin CHARACTERISTIC K_BATVFZGTAU "VFZG-Umschaltschwelle TAU Batterie" VALUE 0x000C1E80 TKW_VV_VV_UW 100.0 Def_v_uw_q1p0 0.0 65535.0000 /begin FUNCTION_LIST LBATTCAL /end FUNCTION_LIST /end CHARACTERISTIC
/begin CHARACTERISTIC K_ILMINUMG "integrierte Lufmassenschwelle Aussentemperaturmodell" VALUE 0x000C1E82 TKW_VV_VV_UW 100.0 Def_lm_uw_q0p000444 0.0 29.1266 /begin FUNCTION_LIST LBATTCAL /end FUNCTION_LIST FORMAT "%7.4" /end CHARACTERISTIC
/begin CHARACTERISTIC K_TBATTFTAUV "Zeitkonstante 5*Tau Batterievorne" VALUE 0x000C1E84 TKW_VV_VV_UW 100.0 Def_st_uw_q1 0.0 65535.0000 /begin FUNCTION_LIST LBATTCAL /end FUNCTION_LIST /end CHARACTERISTIC
/begin CHARACTERISTIC K_TBATTTAUFH "Zeitkonstante Batterie 5*Tau hinten" VALUE 0x000C1E86 TKW_VV_VV_UW 100.0 Def_st_uw_q1 0.0 65535.0000 /begin FUNCTION_LIST LBATTCAL /end FUNCTION_LIST /end CHARACTERISTIC
/begin CHARACTERISTIC K_TUMGTAU "Zeitkonstante 5*Tau Aussentemperatur" VALUE 0x000C1E88 TKW_VV_VV_UW 100.0 Def_st_uw_q1 0.0 65535.0000 /begin FUNCTION_LIST LBATTCAL /end FUNCTION_LIST /end CHARACTERISTIC
/begin CHARACTERISTIC K_ULADE_TAU "Batterieladespannungs Zeitkonstante" VALUE 0x000C1E8A TKW_VV_VV_UW 100.0 Def_f_uw_b1 0.0 9.99984741210938e-1 /begin FUNCTION_LIST LBATTCAL /end FUNCTION_LIST /end CHARACTERISTIC
/begin CHARACTERISTIC K_VMINUMG "Fahrzeuggeschwindigkeitsschwelle Aussentemperaturmodell" VALUE 0x000C1E8C TKW_VV_VV_UW 100.0 Def_v_uw_q1p0 0.0 65535.0000 /begin FUNCTION_LIST LBATTCAL /end FUNCTION_LIST /end CHARACTERISTIC
/begin CHARACTERISTIC CW_BATTCOD "Enable Handcodierung" VALUE 0x000C1E93 TKW_VV_VV_UB 100.0 Def_st_ub_q1 0.0 2.0000 /begin FUNCTION_LIST LBATTCAL /end FUNCTION_LIST /end CHARACTERISTIC
/begin CHARACTERISTIC K_APPTBATINI "Enable Applikation Initwert Batterietemperatur" VALUE 0x000C1E94 TKW_VV_VV_UB 100.0 Def_st_ub_q1 0.0 255.0000 /begin FUNCTION_LIST LBATTCAL /end FUNCTION_LIST /end CHARACTERISTIC
/begin CHARACTERISTIC K_BATTORT0 "Batterieeinbauort No1" VALUE 0x000C1E95 TKW_VV_VV_UB 100.0 Def_st_ub_q1 0.0 2.0000 /begin FUNCTION_LIST LBATTCAL /end FUNCTION_LIST /end CHARACTERISTIC
/begin CHARACTERISTIC K_BATTORT2 "Batterieeinbauort No2" VALUE 0x000C1E96 TKW_VV_VV_UB 100.0 Def_st_ub_q1 0.0 2.0000 /begin FUNCTION_LIST LBATTCAL /end FUNCTION_LIST /end CHARACTERISTIC
/begin CHARACTERISTIC K_MCOBATTORT "Codierung Hand Batterieeinbauort" VALUE 0x000C1E97 TKW_VV_VV_UB 100.0 Def_st_ub_q1 0.0 2.0000 /begin FUNCTION_LIST LBATTCAL /end FUNCTION_LIST /end CHARACTERISTIC
/begin CHARACTERISTIC S_LBATTAPPL "" VALUE 0x000C1E98 TKW_VV_VV_UB 100.0 Identity 0.0 1.0000 /begin FUNCTION_LIST LBATTCAL /end FUNCTION_LIST /end CHARACTERISTIC
/begin CHARACTERISTIC KL_LADEKENNL "Batterieladespannungskennlinie" CURVE 0x000C1E9A TKL_SW_VV_SW 100.0 Def_u_sw_b128 0.0 127.9960 /begin FUNCTION_LIST LBATTCAL /end FUNCTION_LIST
 /begin AXIS_DESCR STD_AXIS T_battabst Def_t_sw_q0p1 6 -3276.8000 3276.7000 FORMAT "%4.1" /end AXIS_DESCR
 FORMAT "%6.3" /end CHARACTERISTIC
/begin CHARACTERISTIC KL_EXPBETAV "Funktion EXP (-BETA*tabst_w)" CURVE 0x000C1EB4 TKL_UW_VV_UW 100.0 Def_f_uw_b1 0.0 9.99984741210938e-1 /begin FUNCTION_LIST LBATTCAL /end FUNCTION_LIST /begin AXIS_DESCR STD_AXIS NO_INPUT_QUANTITY Def_st_uw_q1 11 0.0 65535.0000 /end AXIS_DESCR /end CHARACTERISTIC
/begin CHARACTERISTIC KL_BATTLSTR "Geschwindigkeitsfaktor Batterieumgebungstemperatur" CURVE 0x000C1EE2 TKL_UW_VV_UW 100.0 Def_f_uw_b256 0.0 255.9960 /begin FUNCTION_LIST LBATTCAL /end FUNCTION_LIST /begin AXIS_DESCR STD_AXIS NO_INPUT_QUANTITY Def_v_uw_q1p0 6 0.0 360.0000 /end AXIS_DESCR FORMAT "%6.3" /end CHARACTERISTIC
/begin CHARACTERISTIC KL_EXPALV "Funktion EXP(-ALPHA*tabst_w) hinten" CURVE 0x000C1EFC TKL_UW_VV_UW 100.0 Def_f_uw_b1 0.0 9.99984741210938e-1 /begin FUNCTION_LIST LBATTCAL /end FUNCTION_LIST /begin AXIS_DESCR STD_AXIS Tn_abstell Def_st_uw_q1 11 0.0 65535.0000 /end AXIS_DESCR /end CHARACTERISTIC
/begin CHARACTERISTIC KL_EXPALH "Funktion EXP(-ALPHA*tabst_w) hinten" CURVE 0x000C1F2A TKL_UW_VV_UW 100.0 Def_f_uw_b1 0.0 9.99984741210938e-1 /begin FUNCTION_LIST LBATTCAL /end FUNCTION_LIST /begin AXIS_DESCR STD_AXIS NO_INPUT_QUANTITY Def_st_uw_q1 11 0.0 65535.0000 /end AXIS_DESCR /end CHARACTERISTIC
/begin CHARACTERISTIC K_TNNSTART "Zeittriggerschwelle nach Motorstart" VALUE 0x000C1F58 TKW_VV_VV_UW 100.0 Def_td_uw_q0p01 0.0 655.3500 /begin FUNCTION_LIST LDSTGEN /end FUNCTION_LIST FORMAT "%5.2" /end CHARACTERISTIC
/begin CHARACTERISTIC K_APPUPLLDST "Applikationswert St_ldstgen für Nachlauf" VALUE 0x000C1F5A TKW_VV_VV_UB 100.0 Def_st_ub_q1 0.0 255.0000 /begin FUNCTION_LIST LDSTGEN /end FUNCTION_LIST /end CHARACTERISTIC
/begin CHARACTERISTIC K_DFMODE "DF-Mode-Schalter themermisch/elektrisch" VALUE 0x000C1F5B TKW_VV_VV_UB 100.0 Def_st_ub_q1 0.0 255.0000 /begin FUNCTION_LIST LDSTGEN /end FUNCTION_LIST /end CHARACTERISTIC
/begin CHARACTERISTIC K_DFS_MAX "DF-Auslastung Maximalschwelle" VALUE 0x000C1F5C TKW_VV_VV_UB 100.0 Def_f_ub_b100 0.0 99.6093 /begin FUNCTION_LIST LDSTGEN /end FUNCTION_LIST /end CHARACTERISTIC
/begin CHARACTERISTIC K_DFS_MIN "DF-Auslastung Minimalschwelle" VALUE 0x000C1F5D TKW_VV_VV_UB 100.0 Def_f_ub_b100 0.0 99.6093 /begin FUNCTION_LIST LDSTGEN /end FUNCTION_LIST /end CHARACTERISTIC
/begin CHARACTERISTIC K_DFS_MITT "DF-Auslastung Mittelschwelle" VALUE 0x000C1F5E TKW_VV_VV_UB 100.0 Def_f_ub_b100 0.0 99.6093 /begin FUNCTION_LIST LDSTGEN /end FUNCTION_LIST /end CHARACTERISTIC
/begin CHARACTERISTIC K_GENLDDFMAX "Schwell Anzeige maximaler Auslastungsgrad Generator" VALUE 0x000C1F5F TKW_VV_VV_UB 100.0 Def_f_ub_b100 0.0 99.6093 /begin FUNCTION_LIST LDSTGEN /end FUNCTION_LIST /end CHARACTERISTIC
/begin CHARACTERISTIC K_IERRFIL "Filterkonstante für Filterung Erregerstrom" VALUE 0x000C1F60 TKW_VV_VV_UB 100.0 Def_f_ub_b1 0.0040 0.9960 /begin FUNCTION_LIST LDSTGEN /end FUNCTION_LIST /end CHARACTERISTIC
/begin CHARACTERISTIC KL_GENLDST "Auslastungsgrad Generator" CURVE 0x000C1F62 TKL_SW_VV_UB 100.0 Def_f_ub_b100 0.0 99.6093 /begin FUNCTION_LIST LDSTGEN /end FUNCTION_LIST
 /begin AXIS_DESCR STD_AXIS Tgen Def_t_sw_q0p1 6 -3276.8000 3276.7000 FORMAT "%4.1" /end AXIS_DESCR
/end CHARACTERISTIC
/begin CHARACTERISTIC K_DSOCHYST "Hystereschwelle SOC" VALUE 0x000C1F76 TKW_VV_VV_SW 100.0 Def_f_sw_b100 -100.0000 99.9969 /begin FUNCTION_LIST LLPMCTRL /end FUNCTION_LIST FORMAT "%6.3" /end CHARACTERISTIC
/begin CHARACTERISTIC K_DSOCLLANH "Abstand zur Stfgrz, bei der die LLDZanh aktiviert wird." VALUE 0x000C1F78 TKW_VV_VV_SW 100.0 Def_f_sw_b100 -100.0000 99.9969 /begin FUNCTION_LIST LLPMCTRL /end FUNCTION_LIST FORMAT "%6.3" /end CHARACTERISTIC
/begin CHARACTERISTIC K_NLLMIN "Motordrehzahl unterhalb derer die LLDZanh. zurueckgenommen wird." VALUE 0x000C1F7A TKW_VV_VV_SW 100.0 Def_n_sw_q1p0 -32768.0000 32767.0000 /begin FUNCTION_LIST LLPMCTRL /end FUNCTION_LIST /end CHARACTERISTIC
/begin CHARACTERISTIC K_DFLLMIN "DF unterhalb derer die LLDZanh. zurueckgenommen wird." VALUE 0x000C1F7C TKW_VV_VV_UB 100.0 Def_f_ub_b100 0.0 99.6093 /begin FUNCTION_LIST LLPMCTRL /end FUNCTION_LIST /end CHARACTERISTIC
/begin CHARACTERISTIC K_DFMAX "Obere Schwelle DF Signal" VALUE 0x000C1F7D TKW_VV_VV_UB 100.0 Def_f_ub_b100 0.0 99.6093 /begin FUNCTION_LIST LLPMCTRL /end FUNCTION_LIST /end CHARACTERISTIC
/begin CHARACTERISTIC K_LLANHAPP "LLDZanh.-level, falls Generator fehlerhaft ist." VALUE 0x000C1F7E TKW_VV_VV_UB 100.0 Def_st_ub_q1 0.0 255.0000 /begin FUNCTION_LIST LLPMCTRL /end FUNCTION_LIST /end CHARACTERISTIC
/begin CHARACTERISTIC K_LLPMAPP "Handapplikationswert für Leerlaufdrehzahlvorgabe" VALUE 0x000C1F7F TKW_VV_VV_UB 100.0 Def_st_ub_q1 0.0 255.0000 /begin FUNCTION_LIST LLPMCTRL /end FUNCTION_LIST /end CHARACTERISTIC
/begin CHARACTERISTIC S_N_IDLIBS "Schalter zum manuellen Setzen von LL aktiv" VALUE 0x000C1F80 TKW_VV_VV_UB 100.0 Identity 0.0 1.0000 /begin FUNCTION_LIST LLPMCTRL /end FUNCTION_LIST /end CHARACTERISTIC
/begin CHARACTERISTIC K_NSUBO "N_soll bei Batterieladebilanz zu niedrig" VALUE 0x000C1F82 TKW_VV_VV_SW 100.0 Def_n_sw_q1p0 0.0 32767.0000 /begin FUNCTION_LIST LLRANH /end FUNCTION_LIST /end CHARACTERISTIC
/begin CHARACTERISTIC K_NSUBU "N_soll bei Ladebilanz iO" VALUE 0x000C1F84 TKW_VV_VV_SW 100.0 Def_n_sw_q1p0 0.0 32767.0000 /begin FUNCTION_LIST LLRANH /end FUNCTION_LIST /end CHARACTERISTIC
/begin CHARACTERISTIC K_APP_LLAH "Kennwert zum Umschalten auf Applikationskonstante" VALUE 0x000C1F86 TKW_VV_VV_UB 100.0 Def_st_ub_q1 0.0 255.0000 /begin FUNCTION_LIST LLRANH /end FUNCTION_LIST /end CHARACTERISTIC
/begin CHARACTERISTIC K_GENLLAHAPP "Applikationskonstente zum Setzen B_idlespec" VALUE 0x000C1F87 TKW_VV_VV_UB 100.0 Def_st_ub_q1 0.0 255.0000 /begin FUNCTION_LIST LLRANH /end FUNCTION_LIST /end CHARACTERISTIC
/begin CHARACTERISTIC K_NKW_SCH "Drehzahlschwelle für Grenzmomentberechnung" VALUE 0x000C1F88 TKW_VV_VV_SW 100.0 Def_n_sw_q1p0 0.0 32767.0000 /begin FUNCTION_LIST LOADRESP /end FUNCTION_LIST /end CHARACTERISTIC
/begin CHARACTERISTIC K_DMDGEN_SCHMN "" VALUE 0x000C1F8A TKW_VV_VV_SW 100.0 Def_m_sw_q0p1 -3276.8000 3276.7000 /begin FUNCTION_LIST LOADRESP /end FUNCTION_LIST FORMAT "%5.2" /end CHARACTERISTIC
/begin CHARACTERISTIC K_DMDGEN_SCHMX "" VALUE 0x000C1F8C TKW_VV_VV_SW 100.0 Def_m_sw_q0p1 -3276.8000 3276.7000 /begin FUNCTION_LIST LOADRESP /end FUNCTION_LIST FORMAT "%5.2" /end CHARACTERISTIC
/begin CHARACTERISTIC K_DSOCMIN "" VALUE 0x000C1F8E TKW_VV_VV_SW 100.0 Def_f_sw_b100 -100.0000 99.9969 /begin FUNCTION_LIST LOADRESP /end FUNCTION_LIST FORMAT "%6.3" /end CHARACTERISTIC
/begin CHARACTERISTIC K_MDGNHYS "Hysterese für Drehzahlschwelle Generator-Maximalmomentbegrenzung" VALUE 0x000C1F90 TKW_VV_VV_SW 100.0 Def_n_sw_q1p0 -32768.0000 32767.0000 /begin FUNCTION_LIST LOADRESP /end FUNCTION_LIST /end CHARACTERISTIC
/begin CHARACTERISTIC K_MDGNMAX "Maximaldrehzahl für Generator-Maximalmomentbegrenzung" VALUE 0x000C1F92 TKW_VV_VV_SW 100.0 Def_n_sw_q1p0 -32768.0000 32767.0000 /begin FUNCTION_LIST LOADRESP /end FUNCTION_LIST /end CHARACTERISTIC
/begin CHARACTERISTIC K_MGMAXAPP "Applikationswert Genratormaximalmoment" VALUE 0x000C1F94 TKW_VV_VV_SW 100.0 Def_m_sw_q0p1 -3276.8000 3276.7000 /begin FUNCTION_LIST LOADRESP /end FUNCTION_LIST FORMAT "%5.2" /end CHARACTERISTIC
/begin CHARACTERISTIC K_NGENOFMN "" VALUE 0x000C1F96 TKW_VV_VV_SW 100.0 Def_n_sw_q1p0 -32768.0000 32767.0000 /begin FUNCTION_LIST LOADRESP /end FUNCTION_LIST /end CHARACTERISTIC
/begin CHARACTERISTIC K_NGENOFMX "" VALUE 0x000C1F98 TKW_VV_VV_SW 100.0 Def_n_sw_q1p0 -32768.0000 32767.0000 /begin FUNCTION_LIST LOADRESP /end FUNCTION_LIST /end CHARACTERISTIC
/begin CHARACTERISTIC K_NMXGENOF "Motordrehzahlschwelle für Generatorzuschaltung" VALUE 0x000C1F9A TKW_VV_VV_SW 100.0 Def_n_sw_q1p0 -32768.0000 32767.0000 /begin FUNCTION_LIST LOADRESP /end FUNCTION_LIST /end CHARACTERISTIC
/begin CHARACTERISTIC K_RLMXGENOF "relative Luftfüllungschwelle für Generatorzuschaltung" VALUE 0x000C1F9C TKW_VV_VV_SW 100.0 Def_rf_sw_q0p01 -327.6800 327.6700 /begin FUNCTION_LIST LOADRESP /end FUNCTION_LIST FORMAT "%7.4" /end CHARACTERISTIC
/begin CHARACTERISTIC K_TATMGENOF "Motordrehzahlschwelle  Katalysatortemperatur" VALUE 0x000C1F9E TKW_VV_VV_SW 100.0 Def_t_sw_q0p1 -3276.8000 3276.7000 /begin FUNCTION_LIST LOADRESP /end FUNCTION_LIST FORMAT "%4.1" /end CHARACTERISTIC
/begin CHARACTERISTIC K_TGENOFMN "" VALUE 0x000C1FA0 TKW_VV_VV_SW 100.0 Def_t_sw_q0p1 -3276.8000 3276.7000 /begin FUNCTION_LIST LOADRESP /end FUNCTION_LIST FORMAT "%4.1" /end CHARACTERISTIC
/begin CHARACTERISTIC K_TGENOFMX "" VALUE 0x000C1FA2 TKW_VV_VV_SW 100.0 Def_t_sw_q0p1 -3276.8000 3276.7000 /begin FUNCTION_LIST LOADRESP /end FUNCTION_LIST FORMAT "%4.1" /end CHARACTERISTIC
/begin CHARACTERISTIC K_TMOTABGNMN "minimale Motorabstelltemperatur für Generatorreduzierung" VALUE 0x000C1FA4 TKW_VV_VV_SW 100.0 Def_t_sw_q0p01 -327.6800 327.6700 /begin FUNCTION_LIST LOADRESP /end FUNCTION_LIST FORMAT "%5.2" /end CHARACTERISTIC
/begin CHARACTERISTIC K_TUMGGNMN "minimale Umgebungstemperatur für Generatorreduzierung" VALUE 0x000C1FA6 TKW_VV_VV_SW 100.0 Def_t_sw_q0p1 -3276.8000 3276.7000 /begin FUNCTION_LIST LOADRESP /end FUNCTION_LIST FORMAT "%4.1" /end CHARACTERISTIC
/begin CHARACTERISTIC K_TUMGGNMX "maximale Umgebungstemperatur für Generatorreduzierung" VALUE 0x000C1FA8 TKW_VV_VV_SW 100.0 Def_t_sw_q0p1 -3276.8000 3276.7000 /begin FUNCTION_LIST LOADRESP /end FUNCTION_LIST FORMAT "%4.1" /end CHARACTERISTIC
/begin CHARACTERISTIC K_TABSTGNMN "minimale Abstellzeit für Generatorreduzierung" VALUE 0x000C1FAA TKW_VV_VV_UW 100.0 Def_st_uw_q1 0.0 65535.0000 /begin FUNCTION_LIST LOADRESP /end FUNCTION_LIST /end CHARACTERISTIC
/begin CHARACTERISTIC K_TABSTGNMX "maximale Abstellzeit für Generatorreduzierung" VALUE 0x000C1FAC TKW_VV_VV_UW 100.0 Def_st_uw_q1 0.0 65535.0000 /begin FUNCTION_LIST LOADRESP /end FUNCTION_LIST /end CHARACTERISTIC
/begin CHARACTERISTIC K_TDMDGEN_VERZAUS "" VALUE 0x000C1FAE TKW_VV_VV_UW 100.0 Def_td_uw_q0p01 0.0 655.3500 /begin FUNCTION_LIST LOADRESP /end FUNCTION_LIST FORMAT "%5.2" /end CHARACTERISTIC
/begin CHARACTERISTIC K_TDMDGEN_VERZEIN "" VALUE 0x000C1FB0 TKW_VV_VV_UW 100.0 Def_td_uw_q0p01 0.0 655.3500 /begin FUNCTION_LIST LOADRESP /end FUNCTION_LIST FORMAT "%5.2" /end CHARACTERISTIC
/begin CHARACTERISTIC K_VGENOFMN "Geschwindigkeitgeneratorabschaltschwelle bei Vollastbeschleunigung" VALUE 0x000C1FB2 TKW_VV_VV_UW 100.0 Def_v_uw_q1p0 0.0 65535.0000 /begin FUNCTION_LIST LOADRESP /end FUNCTION_LIST /end CHARACTERISTIC
/begin CHARACTERISTIC K_VGENOGMX "Geschwindigkeitgeneratorzuschaltschwelle bei Vollastbeschleunigung" VALUE 0x000C1FB4 TKW_VV_VV_UW 100.0 Def_v_uw_q1p0 0.0 65535.0000 /begin FUNCTION_LIST LOADRESP /end FUNCTION_LIST /end CHARACTERISTIC
/begin CHARACTERISTIC K_VZLORESOFV "Geschwindigkeitsschwelle für Generatorzuschaltung" VALUE 0x000C1FB6 TKW_VV_VV_UW 100.0 Def_v_uw_q1p0 0.0 65535.0000 /begin FUNCTION_LIST LOADRESP /end FUNCTION_LIST /end CHARACTERISTIC
/begin CHARACTERISTIC CW_BNS_LR "Codewort zur Einrechnung Bordnetzstabilität in Loadresponse" VALUE 0x000C1FB8 TKW_VV_VV_UB 100.0 Def_st_ub_q1 0.0 1.0000 /begin FUNCTION_LIST LOADRESP /end FUNCTION_LIST /end CHARACTERISTIC
/begin CHARACTERISTIC K_APPLROFF "" VALUE 0x000C1FB9 TKW_VV_VV_UB 100.0 Identity 0.0 1.0000 /begin FUNCTION_LIST LOADRESP /end FUNCTION_LIST /end CHARACTERISTIC
/begin CHARACTERISTIC K_BGAPP "Applikationswert Generatorbegrenzung über Maximalmoment" VALUE 0x000C1FBA TKW_VV_VV_UB 100.0 Identity 0.0 1.0000 /begin FUNCTION_LIST LOADRESP /end FUNCTION_LIST /end CHARACTERISTIC
/begin CHARACTERISTIC K_ENAPPLGOFF "Enable Generatorauschaltsteuerung" VALUE 0x000C1FBB TKW_VV_VV_UB 100.0 Def_st_ub_q1 0.0 255.0000 /begin FUNCTION_LIST LOADRESP /end FUNCTION_LIST /end CHARACTERISTIC
/begin CHARACTERISTIC K_ENAPPLRESP "Enable Handsteuerung Loadresponse" VALUE 0x000C1FBC TKW_VV_VV_UB 100.0 Def_st_ub_q1 0.0 255.0000 /begin FUNCTION_LIST LOADRESP /end FUNCTION_LIST /end CHARACTERISTIC
/begin CHARACTERISTIC K_FHOGNMN "minimaler Wichtungsfaktor fuer minimale HFM-Luftmassen Schwelle in Abhaengigkeit von d.Hoehe fuer Generatorreduzierung" VALUE 0x000C1FBD TKW_VV_VV_UB 100.0 Def_f_ub_b4 0.0 3.9843 /begin FUNCTION_LIST LOADRESP /end FUNCTION_LIST /end CHARACTERISTIC
/begin CHARACTERISTIC K_LRBNS "Loadrespo´nse bei Warnung Bordnetzstabilität gefährdet" VALUE 0x000C1FBE TKW_VV_VV_UB 100.0 Def_td_ub_q0p1 0.0 25.5000 /begin FUNCTION_LIST LOADRESP /end FUNCTION_LIST /end CHARACTERISTIC
/begin CHARACTERISTIC K_LRESPAPP "Load-Response Applikation" VALUE 0x000C1FBF TKW_VV_VV_UB 100.0 Def_td_ub_q0p1 0.0 25.5000 /begin FUNCTION_LIST LOADRESP /end FUNCTION_LIST /end CHARACTERISTIC
/begin CHARACTERISTIC K_TGENOFVL "Generatorsabschaltzeit bei Vollastbeschleunigung" VALUE 0x000C1FC0 TKW_VV_VV_UB 100.0 Def_dez_ub_q1 0.0 255.0000 /begin FUNCTION_LIST LOADRESP /end FUNCTION_LIST /end CHARACTERISTIC
/begin CHARACTERISTIC K_TLORESPST "Startloadresponse" VALUE 0x000C1FC1 TKW_VV_VV_UB 100.0 Def_td_ub_q0p1 0.0 25.5000 /begin FUNCTION_LIST LOADRESP /end FUNCTION_LIST /end CHARACTERISTIC
/begin CHARACTERISTIC K_TVLOFHYST "Hysterese Generatorvollastabschaltung" VALUE 0x000C1FC2 TKW_VV_VV_UB 100.0 Def_dez_ub_q1 0.0 255.0000 /begin FUNCTION_LIST LOADRESP /end FUNCTION_LIST /end CHARACTERISTIC
/begin CHARACTERISTIC S_LORESLL "Schalter Kennlinienausschaltzeit " VALUE 0x000C1FC3 TKW_VV_VV_UB 100.0 Identity 0.0 1.0000 /begin FUNCTION_LIST LOADRESP /end FUNCTION_LIST /end CHARACTERISTIC
/begin CHARACTERISTIC S_MGAPP "Schalter für Applikationswert Genratormaximalmoment" VALUE 0x000C1FC4 TKW_VV_VV_UB 100.0 Identity 0.0 1.0000 /begin FUNCTION_LIST LOADRESP /end FUNCTION_LIST /end CHARACTERISTIC
/begin CHARACTERISTIC S_SAPP "Schalter für Applikationswert Begrenzungsstrategie" VALUE 0x000C1FC5 TKW_VV_VV_UB 100.0 Identity 0.0 1.0000 /begin FUNCTION_LIST LOADRESP /end FUNCTION_LIST /end CHARACTERISTIC
/begin CHARACTERISTIC S_TLACTIV "Schalter, um Grenzmoment in allen Motorzuständen freizugeben" VALUE 0x000C1FC6 TKW_VV_VV_UB 100.0 Identity 0.0 1.0000 /begin FUNCTION_LIST LOADRESP /end FUNCTION_LIST /end CHARACTERISTIC
/begin CHARACTERISTIC KL_LORESPM "Motorabhängiger Loadresponse-Faktor" CURVE 0x000C1FC8 TKL_SW_VV_UB 100.0 Def_f_ub_b4 0.0 3.9843 /begin FUNCTION_LIST LOADRESP /end FUNCTION_LIST
 /begin AXIS_DESCR STD_AXIS Tmot Def_t_sw_q0p01 6 -327.6800 327.6700 FORMAT "%5.2" /end AXIS_DESCR
/end CHARACTERISTIC
/begin CHARACTERISTIC KF_ZLRRESOFV "Kennfeld Generatorausschaltzeit bei Fahrt" MAP 0x000C1FDC TKF_UW_SW_UB 100.0 Def_td_ub_q1 0.0 255.0000 /begin FUNCTION_LIST LOADRESP /end FUNCTION_LIST
 /begin AXIS_DESCR STD_AXIS Tmot_start Def_t_sw_q0p01 4 -327.6800 327.6700 FORMAT "%5.2" /end AXIS_DESCR
 /begin AXIS_DESCR STD_AXIS Km_st Def_km_uw_q10 4 0.0 655350.0000 /end AXIS_DESCR
/end CHARACTERISTIC
/begin CHARACTERISTIC KF_LRMAXG "Loadresponse bei begrenztem Generatormoment" MAP 0x000C1FFE TKF_SW_UB_UB 100.0 Def_td_ub_q0p1 0.0 25.5000 /begin FUNCTION_LIST LOADRESP /end FUNCTION_LIST /begin AXIS_DESCR STD_AXIS Na_bnanteil Def_f_ub_b2 8 0.0 1.9921 /end AXIS_DESCR
 /begin AXIS_DESCR STD_AXIS Rf Def_rf_sw_q0p01 8 -327.6800 327.6700 FORMAT "%7.4" /end AXIS_DESCR
/end CHARACTERISTIC
/begin CHARACTERISTIC KF_ZLRESOF "Kennfeld Generatorausschaltzeit bei Stillstand" MAP 0x000C2058 TKF_UW_SW_UB 100.0 Def_td_ub_q1 0.0 255.0000 /begin FUNCTION_LIST LOADRESP /end FUNCTION_LIST
 /begin AXIS_DESCR STD_AXIS Tmot_start Def_t_sw_q0p01 4 -327.6800 327.6700 FORMAT "%5.2" /end AXIS_DESCR
 /begin AXIS_DESCR STD_AXIS Km_st Def_km_uw_q10 4 0.0 655350.0000 /end AXIS_DESCR
/end CHARACTERISTIC
/begin CHARACTERISTIC KF_LORESP "Kennfeld Loadresponse ueber Motordrehzahl und rel. Luftmasse" MAP 0x000C207A TKF_SW_SW_UB 100.0 Def_td_ub_q0p1 0.0 25.5000 /begin FUNCTION_LIST LOADRESP /end FUNCTION_LIST /begin AXIS_DESCR STD_AXIS Nkw Def_n_sw_q1p0 6 -32768.0000 32767.0000 /end AXIS_DESCR
 /begin AXIS_DESCR STD_AXIS Rf Def_rf_sw_q0p01 6 -327.6800 327.6700 FORMAT "%7.4" /end AXIS_DESCR
/end CHARACTERISTIC
/begin MEASUREMENT St_dibs1.B_ifbsak "BSD Kommunikation zum IBS gestoert" UBYTE Def_bit_ub_2 0 0 0.0 255.0 ECU_ADDRESS 0x007FF002 /begin FUNCTION_LIST DIBS /end FUNCTION_LIST BIT_MASK 0x4 /end MEASUREMENT
/begin MEASUREMENT St_dibs1.B_ifebsak "Fehler erweiterte BSD Kommunikation zum IBS" UBYTE Def_bit_ub_3 0 0 0.0 255.0 ECU_ADDRESS 0x007FF002 /begin FUNCTION_LIST DIBS /end FUNCTION_LIST BIT_MASK 0x8 /end MEASUREMENT
/begin MEASUREMENT St_dibs1.B_ifuplak "Fehler IBS Version unplausibel" UBYTE Def_bit_ub_4 0 0 0.0 255.0 ECU_ADDRESS 0x007FF002 /begin FUNCTION_LIST DIBS /end FUNCTION_LIST BIT_MASK 0x10 /end MEASUREMENT
/begin MEASUREMENT St_dibs1 "Statuswort" UBYTE Def_st_ub_q1 0 0 0.0 255.0000 ECU_ADDRESS 0x007FF002 /begin FUNCTION_LIST DIBS /end FUNCTION_LIST /end MEASUREMENT
/begin MEASUREMENT St_dibs2.B_ifisak "IBS Stromfehler" UBYTE Def_bit_ub_0 0 0 0.0 255.0 ECU_ADDRESS 0x007FF003 /begin FUNCTION_LIST DIBS /end FUNCTION_LIST BIT_MASK 0x1 /end MEASUREMENT
/begin MEASUREMENT St_dibs2.B_ifusak "IBS Spannungsfehler" UBYTE Def_bit_ub_1 0 0 0.0 255.0 ECU_ADDRESS 0x007FF003 /begin FUNCTION_LIST DIBS /end FUNCTION_LIST BIT_MASK 0x2 /end MEASUREMENT
/begin MEASUREMENT St_dibs2.B_iftempak "IBS Temperaturfehler" UBYTE Def_bit_ub_2 0 0 0.0 255.0 ECU_ADDRESS 0x007FF003 /begin FUNCTION_LIST DIBS /end FUNCTION_LIST BIT_MASK 0x4 /end MEASUREMENT
/begin MEASUREMENT St_dibs2.B_ifwugdak "IBS KL15 Masseschluss" UBYTE Def_bit_ub_3 0 0 0.0 255.0 ECU_ADDRESS 0x007FF003 /begin FUNCTION_LIST DIBS /end FUNCTION_LIST BIT_MASK 0x8 /end MEASUREMENT
/begin MEASUREMENT St_dibs2.B_ifwuplak "" UBYTE Def_bit_ub_4 0 0 0.0 255.0 ECU_ADDRESS 0x007FF003 /begin FUNCTION_LIST DIBS /end FUNCTION_LIST BIT_MASK 0x10 /end MEASUREMENT
/begin MEASUREMENT St_dibs2.B_ifsysak "" UBYTE Def_bit_ub_5 0 0 0.0 255.0 ECU_ADDRESS 0x007FF003 /begin FUNCTION_LIST DIBS /end FUNCTION_LIST BIT_MASK 0x20 /end MEASUREMENT
/begin MEASUREMENT St_dibs2 "Statuswort" UBYTE Def_st_ub_q1 0 0 0.0 255.0000 ECU_ADDRESS 0x007FF003 /begin FUNCTION_LIST DIBS /end FUNCTION_LIST /end MEASUREMENT
/begin MEASUREMENT St_dibs0.B_dibloc1 "Signal nv lave loc zur Flankenerkennung" UBYTE Def_bit_ub_0 0 0 0.0 255.0 ECU_ADDRESS 0x008004D0 /begin FUNCTION_LIST DIBS /end FUNCTION_LIST BIT_MASK 0x1 /end MEASUREMENT
/begin MEASUREMENT St_dibs0.B_dibloc2 "Signal nv lave loc zur Flankenerkennung" UBYTE Def_bit_ub_1 0 0 0.0 255.0 ECU_ADDRESS 0x008004D0 /begin FUNCTION_LIST DIBS /end FUNCTION_LIST BIT_MASK 0x2 /end MEASUREMENT
/begin MEASUREMENT St_dibs0 "Statuswort" UBYTE Def_st_ub_q1 0 0 0.0 255.0000 ECU_ADDRESS 0x008004D0 /begin FUNCTION_LIST DIBS /end FUNCTION_LIST /end MEASUREMENT
/begin MEASUREMENT Ibs1_errstat "" UWORD Def_st_uw_q1 0 0 0.0 65535.0000 ECU_ADDRESS 0x008004C6 /begin FUNCTION_LIST DIBS /end FUNCTION_LIST /end MEASUREMENT
/begin MEASUREMENT Ibs2_errstat "" UWORD Def_st_uw_q1 0 0 0.0 65535.0000 ECU_ADDRESS 0x008004C8 /begin FUNCTION_LIST DIBS /end FUNCTION_LIST /end MEASUREMENT
/begin MEASUREMENT Ibs3_errstat "" UWORD Def_st_uw_q1 0 0 0.0 65535.0000 ECU_ADDRESS 0x008004CA /begin FUNCTION_LIST DIBS /end FUNCTION_LIST /end MEASUREMENT
/begin MEASUREMENT T_count_dibs1 "" UBYTE Def_i_ub_q1 0 0 0.0 255.0000 ECU_ADDRESS 0x008004CC /begin FUNCTION_LIST DIBS /end FUNCTION_LIST /end MEASUREMENT
/begin MEASUREMENT T_count_dibs2 "" UBYTE Def_i_ub_q1 0 0 0.0 255.0000 ECU_ADDRESS 0x008004CD /begin FUNCTION_LIST DIBS /end FUNCTION_LIST /end MEASUREMENT
/begin MEASUREMENT T_count_dibs3 "" UBYTE ident 0 0 0.0 255.0000 ECU_ADDRESS 0x008004CE /begin FUNCTION_LIST DIBS /end FUNCTION_LIST /end MEASUREMENT
/begin MEASUREMENT T_count_dibs4 "" UBYTE ident 0 0 0.0 255.0000 ECU_ADDRESS 0x008004CF /begin FUNCTION_LIST DIBS /end FUNCTION_LIST /end MEASUREMENT
/begin MEASUREMENT Ibsderrs2 "Fehlerzähler IBS EBSD Kommunikation" UWORD Def_dez_uw_q1 0 0 0.0 65535.0000 ECU_ADDRESS 0x008004D2 /begin FUNCTION_LIST DIBS /end FUNCTION_LIST /end MEASUREMENT
/begin MEASUREMENT Ibsderrs1 "Fehlerzähler IBS BSD Kommunikation" UBYTE Def_dez_ub_q1 0 0 0.0 255.0000 ECU_ADDRESS 0x008004D4 /begin FUNCTION_LIST DIBS /end FUNCTION_LIST /end MEASUREMENT
/begin MEASUREMENT Ibspreco2 "Vorteiler /10 fuer Ibsderrs2" UBYTE Def_dez_ub_q1 0 0 0.0 255.0000 ECU_ADDRESS 0x008004D5 /begin FUNCTION_LIST DIBS /end FUNCTION_LIST /end MEASUREMENT
/begin MEASUREMENT St_dqlt0.B_ozlerr "Messfehler Ölniveau" UBYTE Def_bit_ub_0 0 0 0.0 255.0 ECU_ADDRESS 0x007FF004 /begin FUNCTION_LIST DQLT /end FUNCTION_LIST BIT_MASK 0x1 /end MEASUREMENT
/begin MEASUREMENT St_dqlt0.B_ozqerr "Messfehler Ölzustand" UBYTE Def_bit_ub_1 0 0 0.0 255.0 ECU_ADDRESS 0x007FF004 /begin FUNCTION_LIST DQLT /end FUNCTION_LIST BIT_MASK 0x2 /end MEASUREMENT
/begin MEASUREMENT St_dqlt0.B_ozterr "Messfehler Öltemperatur" UBYTE Def_bit_ub_2 0 0 0.0 255.0 ECU_ADDRESS 0x007FF004 /begin FUNCTION_LIST DQLT /end FUNCTION_LIST BIT_MASK 0x4 /end MEASUREMENT
/begin MEASUREMENT St_dqlt0.B_td_ogerr "" UBYTE Def_bit_ub_3 0 0 0.0 255.0 ECU_ADDRESS 0x007FF004 /begin FUNCTION_LIST DQLT /end FUNCTION_LIST BIT_MASK 0x8 /end MEASUREMENT
/begin MEASUREMENT St_dqlt0.B_td_ogupl "" UBYTE Def_bit_ub_4 0 0 0.0 255.0 ECU_ADDRESS 0x007FF004 /begin FUNCTION_LIST DQLT /end FUNCTION_LIST BIT_MASK 0x10 /end MEASUREMENT
/begin MEASUREMENT St_dqlt0.B_ozkttoens "Töns-Sensor verbaut" UBYTE Def_bit_ub_5 0 0 0.0 255.0 ECU_ADDRESS 0x007FF004 /begin FUNCTION_LIST DQLT /end FUNCTION_LIST BIT_MASK 0x20 /end MEASUREMENT
/begin MEASUREMENT St_dqlt0.B_ozerrbsd "BSD global Fehler" UBYTE Def_bit_ub_6 0 0 0.0 255.0 ECU_ADDRESS 0x007FF004 /begin FUNCTION_LIST DQLT /end FUNCTION_LIST BIT_MASK 0x40 /end MEASUREMENT
/begin MEASUREMENT St_dqlt0.B_ozdiagnmotok "Motordrehzahl ok für die Diagnose" UBYTE Def_bit_ub_7 0 0 0.0 255.0 ECU_ADDRESS 0x007FF004 /begin FUNCTION_LIST DQLT /end FUNCTION_LIST BIT_MASK 0x80 /end MEASUREMENT
/begin MEASUREMENT St_dqlt0 "Statuswort" UBYTE Def_st_ub_q1 0 0 0.0 255.0000 ECU_ADDRESS 0x007FF004 /begin FUNCTION_LIST DQLT /end FUNCTION_LIST /end MEASUREMENT
/begin MEASUREMENT St_dqlt1.B_ozerr "Sensorfehler in FS eingetragen" UBYTE Def_bit_ub_0 0 0 0.0 255.0 ECU_ADDRESS 0x007FF005 /begin FUNCTION_LIST DQLT /end FUNCTION_LIST BIT_MASK 0x1 /end MEASUREMENT
/begin MEASUREMENT St_dqlt1.B_ozfbsd2 "BSD Sensor Fehler von FI_BSD_4" UBYTE Def_bit_ub_1 0 0 0.0 255.0 ECU_ADDRESS 0x007FF005 /begin FUNCTION_LIST DQLT /end FUNCTION_LIST BIT_MASK 0x2 /end MEASUREMENT
/begin MEASUREMENT St_dqlt1 "Statuswort" UBYTE Def_st_ub_q1 0 0 0.0 255.0000 ECU_ADDRESS 0x007FF005 /begin FUNCTION_LIST DQLT /end FUNCTION_LIST /end MEASUREMENT
/begin MEASUREMENT St_oz_o.B_oztemic "QLT-Temic verbaut" UBYTE Def_bit_ub_0 0 0 0.0 255.0 ECU_ADDRESS 0x007FB1F4 /begin FUNCTION_LIST DQLT /end FUNCTION_LIST BIT_MASK 0x1 /end MEASUREMENT
/begin MEASUREMENT St_oz_o.B_mol_sf "Sensorfehler in FS eingetragen für CC-Meldung" UBYTE Def_bit_ub_1 0 0 0.0 255.0 ECU_ADDRESS 0x007FB1F4 /begin FUNCTION_LIST DQLT /end FUNCTION_LIST BIT_MASK 0x2 /end MEASUREMENT
/begin MEASUREMENT St_oz_o "Statuswort" UBYTE Def_st_ub_q1 0 0 0.0 255.0000 ECU_ADDRESS 0x007FB1F4 /begin FUNCTION_LIST DQLT /end FUNCTION_LIST /end MEASUREMENT
/begin MEASUREMENT Oz_permerrz "" UBYTE Def_dez_ub_q1 0 0 0.0 255.0000 ECU_ADDRESS 0x008004E2 /begin FUNCTION_LIST DQLT /end FUNCTION_LIST /end MEASUREMENT
/begin MEASUREMENT Oz_diagtoens "Töns Diagnose Byte" UWORD Def_dez_uw_q1 0 0 0.0 65535.0000 ECU_ADDRESS 0x008004D6 /begin FUNCTION_LIST DQLT /end FUNCTION_LIST /end MEASUREMENT
/begin MEASUREMENT St_elmot1.B_np0_rf "" UBYTE Def_bit_ub_0 0 0 0.0 255.0 ECU_ADDRESS 0x008004FE /begin FUNCTION_LIST ELMOTENTL /end FUNCTION_LIST BIT_MASK 0x1 /end MEASUREMENT
/begin MEASUREMENT St_elmot1.B_np0_v "" UBYTE Def_bit_ub_1 0 0 0.0 255.0 ECU_ADDRESS 0x008004FE /begin FUNCTION_LIST ELMOTENTL /end FUNCTION_LIST BIT_MASK 0x2 /end MEASUREMENT
/begin MEASUREMENT St_elmot1.B_np0_nkw "" UBYTE Def_bit_ub_3 0 0 0.0 255.0 ECU_ADDRESS 0x008004FE /begin FUNCTION_LIST ELMOTENTL /end FUNCTION_LIST BIT_MASK 0x8 /end MEASUREMENT
/begin MEASUREMENT St_elmot1.B_hp1_vtod "" UBYTE Def_bit_ub_5 0 0 0.0 255.0 ECU_ADDRESS 0x008004FE /begin FUNCTION_LIST ELMOTENTL /end FUNCTION_LIST BIT_MASK 0x20 /end MEASUREMENT
/begin MEASUREMENT St_elmot1.B_hp1_ntod "" UBYTE Def_bit_ub_6 0 0 0.0 255.0 ECU_ADDRESS 0x008004FE /begin FUNCTION_LIST ELMOTENTL /end FUNCTION_LIST BIT_MASK 0x40 /end MEASUREMENT
/begin MEASUREMENT St_elmot1.B_up_absafs "" UBYTE Def_bit_ub_7 0 0 0.0 255.0 ECU_ADDRESS 0x008004FE /begin FUNCTION_LIST ELMOTENTL /end FUNCTION_LIST BIT_MASK 0x80 /end MEASUREMENT
/begin MEASUREMENT St_elmot1 "Statuswort" UBYTE Def_st_ub_q1 0 0 0.0 255.0000 ECU_ADDRESS 0x008004FE /begin FUNCTION_LIST ELMOTENTL /end FUNCTION_LIST /end MEASUREMENT
/begin MEASUREMENT St_elmot2.B_hp2_vtod "" UBYTE Def_bit_ub_0 0 0 0.0 255.0 ECU_ADDRESS 0x008004FF /begin FUNCTION_LIST ELMOTENTL /end FUNCTION_LIST BIT_MASK 0x1 /end MEASUREMENT
/begin MEASUREMENT St_elmot2.B_hp2_ntod "" UBYTE Def_bit_ub_1 0 0 0.0 255.0 ECU_ADDRESS 0x008004FF /begin FUNCTION_LIST ELMOTENTL /end FUNCTION_LIST BIT_MASK 0x2 /end MEASUREMENT
/begin MEASUREMENT St_elmot2.B_up_rfvtod "" UBYTE Def_bit_ub_2 0 0 0.0 255.0 ECU_ADDRESS 0x008004FF /begin FUNCTION_LIST ELMOTENTL /end FUNCTION_LIST BIT_MASK 0x4 /end MEASUREMENT
/begin MEASUREMENT St_elmot2.B_up_rfntod "" UBYTE Def_bit_ub_3 0 0 0.0 255.0 ECU_ADDRESS 0x008004FF /begin FUNCTION_LIST ELMOTENTL /end FUNCTION_LIST BIT_MASK 0x8 /end MEASUREMENT
/begin MEASUREMENT St_elmot2.B_up_rf4 "" UBYTE Def_bit_ub_4 0 0 0.0 255.0 ECU_ADDRESS 0x008004FF /begin FUNCTION_LIST ELMOTENTL /end FUNCTION_LIST BIT_MASK 0x10 /end MEASUREMENT
/begin MEASUREMENT St_elmot2.B_nzgofsum "" UBYTE Def_bit_ub_5 0 0 0.0 255.0 ECU_ADDRESS 0x008004FF /begin FUNCTION_LIST ELMOTENTL /end FUNCTION_LIST BIT_MASK 0x20 /end MEASUREMENT
/begin MEASUREMENT St_elmot2.B_up_gangi0 "" UBYTE Def_bit_ub_7 0 0 0.0 255.0 ECU_ADDRESS 0x008004FF /begin FUNCTION_LIST ELMOTENTL /end FUNCTION_LIST BIT_MASK 0x80 /end MEASUREMENT
/begin MEASUREMENT St_elmot2 "Statuswort" UBYTE Def_st_ub_q1 0 0 0.0 255.0000 ECU_ADDRESS 0x008004FF /begin FUNCTION_LIST ELMOTENTL /end FUNCTION_LIST /end MEASUREMENT
/begin MEASUREMENT St_elmotentl.B_prio "" UBYTE Def_bit_ub_3 0 0 0.0 255.0 ECU_ADDRESS 0x00800500 /begin FUNCTION_LIST ELMOTENTL /end FUNCTION_LIST BIT_MASK 0x8 /end MEASUREMENT
/begin MEASUREMENT St_elmotentl.B_priovdelay "" UBYTE Def_bit_ub_4 0 0 0.0 255.0 ECU_ADDRESS 0x00800500 /begin FUNCTION_LIST ELMOTENTL /end FUNCTION_LIST BIT_MASK 0x10 /end MEASUREMENT
/begin MEASUREMENT St_elmotentl.B_nzgof1 "" UBYTE Def_bit_ub_5 0 0 0.0 255.0 ECU_ADDRESS 0x00800500 /begin FUNCTION_LIST ELMOTENTL /end FUNCTION_LIST BIT_MASK 0x20 /end MEASUREMENT
/begin MEASUREMENT St_elmotentl.B_nzgof2 "" UBYTE Def_bit_ub_6 0 0 0.0 255.0 ECU_ADDRESS 0x00800500 /begin FUNCTION_LIST ELMOTENTL /end FUNCTION_LIST BIT_MASK 0x40 /end MEASUREMENT
/begin MEASUREMENT St_elmotentl.B_nzgof3 "" UBYTE Def_bit_ub_7 0 0 0.0 255.0 ECU_ADDRESS 0x00800500 /begin FUNCTION_LIST ELMOTENTL /end FUNCTION_LIST BIT_MASK 0x80 /end MEASUREMENT
/begin MEASUREMENT St_elmotentl "Statuswort" UBYTE Def_st_ub_q1 0 0 0.0 255.0000 ECU_ADDRESS 0x00800500 /begin FUNCTION_LIST ELMOTENTL /end FUNCTION_LIST /end MEASUREMENT
/begin MEASUREMENT St_elmottime.B_inold_1 "" UBYTE Def_bit_ub_1 0 0 0.0 255.0 ECU_ADDRESS 0x00800501 /begin FUNCTION_LIST ELMOTENTL /end FUNCTION_LIST BIT_MASK 0x2 /end MEASUREMENT
/begin MEASUREMENT St_elmottime.B_inold_2 "" UBYTE Def_bit_ub_2 0 0 0.0 255.0 ECU_ADDRESS 0x00800501 /begin FUNCTION_LIST ELMOTENTL /end FUNCTION_LIST BIT_MASK 0x4 /end MEASUREMENT
/begin MEASUREMENT St_elmottime.B_inold_3 "" UBYTE Def_bit_ub_3 0 0 0.0 255.0 ECU_ADDRESS 0x00800501 /begin FUNCTION_LIST ELMOTENTL /end FUNCTION_LIST BIT_MASK 0x8 /end MEASUREMENT
/begin MEASUREMENT St_elmottime.B_inold_4 "" UBYTE Def_bit_ub_4 0 0 0.0 255.0 ECU_ADDRESS 0x00800501 /begin FUNCTION_LIST ELMOTENTL /end FUNCTION_LIST BIT_MASK 0x10 /end MEASUREMENT
/begin MEASUREMENT St_elmottime.B_inold_5 "" UBYTE Def_bit_ub_5 0 0 0.0 255.0 ECU_ADDRESS 0x00800501 /begin FUNCTION_LIST ELMOTENTL /end FUNCTION_LIST BIT_MASK 0x20 /end MEASUREMENT
/begin MEASUREMENT St_elmottime.B_inold_6 "" UBYTE Def_bit_ub_6 0 0 0.0 255.0 ECU_ADDRESS 0x00800501 /begin FUNCTION_LIST ELMOTENTL /end FUNCTION_LIST BIT_MASK 0x40 /end MEASUREMENT
/begin MEASUREMENT St_elmottime "Statuswort" UBYTE Def_st_ub_q1 0 0 0.0 255.0000 ECU_ADDRESS 0x00800501 /begin FUNCTION_LIST ELMOTENTL /end FUNCTION_LIST /end MEASUREMENT
/begin MEASUREMENT St_entlast_loc "" UBYTE Def_dez_ub_q1 0 0 0.0 255.0000 ECU_ADDRESS 0x00800502 /begin FUNCTION_LIST ELMOTENTL /end FUNCTION_LIST /end MEASUREMENT
/begin MEASUREMENT Dnmottp "" SWORD Def_n_sw_q1p0 0 0 -32768.0000 32767.0000 ECU_ADDRESS 0x008004E4 /begin FUNCTION_LIST ELMOTENTL /end FUNCTION_LIST /end MEASUREMENT
/begin MEASUREMENT Dnmotvtp "" SWORD Def_n_sw_q1p0 0 0 -32768.0000 32767.0000 ECU_ADDRESS 0x008004E6 /begin FUNCTION_LIST ELMOTENTL /end FUNCTION_LIST /end MEASUREMENT
/begin MEASUREMENT F_prio_4 "" SWORD Def_rf_sw_q0p01 0 0 -327.6800 327.6700 ECU_ADDRESS 0x008004E8 /begin FUNCTION_LIST ELMOTENTL /end FUNCTION_LIST /end MEASUREMENT
/begin MEASUREMENT F_prio_down "" SWORD Def_dez_sw_q1 0 0 -32768.0000 32767.0000 ECU_ADDRESS 0x008004EA /begin FUNCTION_LIST ELMOTENTL /end FUNCTION_LIST /end MEASUREMENT
/begin MEASUREMENT F_prio_hold "" SWORD Def_dez_sw_q1 0 0 -32768.0000 32767.0000 ECU_ADDRESS 0x008004EC /begin FUNCTION_LIST ELMOTENTL /end FUNCTION_LIST /end MEASUREMENT
/begin MEASUREMENT F_prio_up "" SWORD Def_rf_sw_q0p01 0 0 -327.6800 327.6700 ECU_ADDRESS 0x008004EE /begin FUNCTION_LIST ELMOTENTL /end FUNCTION_LIST /end MEASUREMENT
/begin MEASUREMENT Timecount_0 "" UWORD Def_td_uw_q0p1 0 0 0.0 6553.5000 ECU_ADDRESS 0x008004F0 /begin FUNCTION_LIST ELMOTENTL /end FUNCTION_LIST /end MEASUREMENT
/begin MEASUREMENT Timecount_1 "" UWORD Def_td_uw_q0p1 0 0 0.0 6553.5000 ECU_ADDRESS 0x008004F2 /begin FUNCTION_LIST ELMOTENTL /end FUNCTION_LIST /end MEASUREMENT
/begin MEASUREMENT Timecount_2 "" UWORD Def_td_uw_q0p1 0 0 0.0 6553.5000 ECU_ADDRESS 0x008004F4 /begin FUNCTION_LIST ELMOTENTL /end FUNCTION_LIST /end MEASUREMENT
/begin MEASUREMENT Timecount_3 "" UWORD Def_td_uw_q0p1 0 0 0.0 6553.5000 ECU_ADDRESS 0x008004F6 /begin FUNCTION_LIST ELMOTENTL /end FUNCTION_LIST /end MEASUREMENT
/begin MEASUREMENT Timecount_4 "" UWORD Def_td_uw_q0p1 0 0 0.0 6553.5000 ECU_ADDRESS 0x008004F8 /begin FUNCTION_LIST ELMOTENTL /end FUNCTION_LIST /end MEASUREMENT
/begin MEASUREMENT Timecount_5 "" UWORD Def_td_uw_q0p1 0 0 0.0 6553.5000 ECU_ADDRESS 0x008004FA /begin FUNCTION_LIST ELMOTENTL /end FUNCTION_LIST /end MEASUREMENT
/begin MEASUREMENT Timecount_6 "" UWORD Def_td_uw_q0p1 0 0 0.0 6553.5000 ECU_ADDRESS 0x008004FC /begin FUNCTION_LIST ELMOTENTL /end FUNCTION_LIST /end MEASUREMENT
/begin MEASUREMENT St_imdgen0.B_firstemp "Bedingung Generatorstarttemperatur-Berechnung" UBYTE Def_bit_ub_0 0 0 0.0 255.0 ECU_ADDRESS 0x007FBFD8 /begin FUNCTION_LIST IMDGEN_1PR /end FUNCTION_LIST BIT_MASK 0x1 /end MEASUREMENT
/begin MEASUREMENT St_imdgen0.B_gene "Generatormoment enable/disable" UBYTE Def_bit_ub_1 0 0 0.0 255.0 ECU_ADDRESS 0x007FBFD8 /begin FUNCTION_LIST IMDGEN_1PR /end FUNCTION_LIST BIT_MASK 0x2 /end MEASUREMENT
/begin MEASUREMENT St_imdgen0.B_generken "" UBYTE Def_bit_ub_2 0 0 0.0 255.0 ECU_ADDRESS 0x007FBFD8 /begin FUNCTION_LIST IMDGEN_1PR /end FUNCTION_LIST BIT_MASK 0x4 /end MEASUREMENT
/begin MEASUREMENT St_imdgen0 "Statuswort" UBYTE Def_st_ub_q1 0 0 0.0 255.0000 ECU_ADDRESS 0x007FBFD8 /begin FUNCTION_LIST IMDGEN_1PR /end FUNCTION_LIST /end MEASUREMENT
/begin MEASUREMENT St_imdgen_nv0.B_genfkupl "Generatortyp unplausibel" UBYTE Def_bit_ub_0 0 0 0.0 255.0 ECU_ADDRESS 0x007FF034 /begin FUNCTION_LIST IMDGEN_1PR /end FUNCTION_LIST BIT_MASK 0x1 /end MEASUREMENT
/begin MEASUREMENT St_imdgen_nv0.B_heizen "Bedingung Generator in Heizphase" UBYTE Def_bit_ub_1 0 0 0.0 255.0 ECU_ADDRESS 0x007FF034 /begin FUNCTION_LIST IMDGEN_1PR /end FUNCTION_LIST BIT_MASK 0x2 /end MEASUREMENT
/begin MEASUREMENT St_imdgen_nv0 "Statuswort" UBYTE Def_st_ub_q1 0 0 0.0 255.0000 ECU_ADDRESS 0x007FF034 /begin FUNCTION_LIST IMDGEN_1PR /end FUNCTION_LIST /end MEASUREMENT
/begin MEASUREMENT Md_gennm "gefiltertes Generatormoment absolut Ausgang" SWORD Def_m_sw_q0p1 0 0 -3276.8000 3276.7000 ECU_ADDRESS 0x007FF010 /begin FUNCTION_LIST IMDGEN_1PR /end FUNCTION_LIST /end MEASUREMENT
/begin MEASUREMENT Tgen "Generatortemperatur" SWORD Def_t_sw_q0p1 0 0 -3276.8000 3276.7000 ECU_ADDRESS 0x007FF012 /begin FUNCTION_LIST IMDGEN_1PR /end FUNCTION_LIST /end MEASUREMENT
/begin MEASUREMENT Tgen_end "Generatortemperatur endgültig" SWORD Def_t_sw_q0p1 0 0 -3276.8000 3276.7000 ECU_ADDRESS 0x007FF014 /begin FUNCTION_LIST IMDGEN_1PR /end FUNCTION_LIST /end MEASUREMENT
/begin MEASUREMENT Md_genvf "relatives Generatordrehmoment" UWORD Def_f_uw_b100 0 0 0.0 99.9984 ECU_ADDRESS 0x007FF016 /begin FUNCTION_LIST IMDGEN_1PR /end FUNCTION_LIST /end MEASUREMENT
/begin MEASUREMENT I_gen "Generatorstrom" UBYTE Def_i_ub_q1 0 0 0.0 255.0000 ECU_ADDRESS 0x007FF035 /begin FUNCTION_LIST IMDGEN_1PR /end FUNCTION_LIST /end MEASUREMENT
/begin MEASUREMENT I_genmax "korrigiertes DF Signal ueber Temperatur, Generatordrehzahl, Generatorspannung" UBYTE Def_i_ub_q1 0 0 0.0 255.0000 ECU_ADDRESS 0x007FF036 /begin FUNCTION_LIST IMDGEN_1PR /end FUNCTION_LIST /end MEASUREMENT
/begin MEASUREMENT Ierrgrenz "Grenzertrregerstrom" UBYTE Def_i_ub_q0p125 0 0 0.0 31.8750 ECU_ADDRESS 0x007FF037 /begin FUNCTION_LIST IMDGEN_1PR /end FUNCTION_LIST /end MEASUREMENT
/begin MEASUREMENT Tgen_ab "Abstelltemperatur Generator" SWORD Def_t_sw_q0p1 0 0 -3276.8000 3276.7000 ECU_ADDRESS 0x00800514 /begin FUNCTION_LIST IMDGEN_1PR /end FUNCTION_LIST /end MEASUREMENT
/begin MEASUREMENT Gen_awnumm "Generatorkennfeldnummer" UBYTE Def_st_ub_q1 0 0 0.0 255.0000 ECU_ADDRESS 0x00800516 /begin FUNCTION_LIST IMDGEN_1PR /end FUNCTION_LIST /end MEASUREMENT
/begin MEASUREMENT Gen_feta "Generatorwirkungsgrad Berechnnugsterm" ULONG Def_eta_ul_b8192 0 0 1.9073486328125e-6 5000.0000 ECU_ADDRESS 0x007FF008 /begin FUNCTION_LIST IMDGEN_1PR /end FUNCTION_LIST /end MEASUREMENT
/begin MEASUREMENT P_gen_ab "elektrische Generatorleistung" ULONG Def_pwr_ul_q0p03125 0 0 0.0 4096.0000 ECU_ADDRESS 0x007FF00C /begin FUNCTION_LIST IMDGEN_1PR /end FUNCTION_LIST /end MEASUREMENT
/begin MEASUREMENT Gen_dts "Temperaturerhoehung im Generatorstator" SWORD Def_t_sw_q0p1 0 0 -3276.8000 3276.7000 ECU_ADDRESS 0x00800504 /begin FUNCTION_LIST IMDGEN_1PR /end FUNCTION_LIST /end MEASUREMENT
/begin MEASUREMENT Gen_tansend "Generatoransaugluftendwert" SWORD Def_t_sw_q0p1 0 0 -3276.8000 3276.7000 ECU_ADDRESS 0x00800506 /begin FUNCTION_LIST IMDGEN_1PR /end FUNCTION_LIST /end MEASUREMENT
/begin MEASUREMENT Tgen_fil "gefilterte Generatortemperatur" SWORD Def_t_sw_q0p1 0 0 -3276.8000 3276.7000 ECU_ADDRESS 0x00800508 /begin FUNCTION_LIST IMDGEN_1PR /end FUNCTION_LIST /end MEASUREMENT
/begin MEASUREMENT Fdib_ig "" SWORD Def_i_sw_q1 0 0 -32768.0000 32767.0000 ECU_ADDRESS 0x007FF018 /begin FUNCTION_LIST IMDGEN_1PR /end FUNCTION_LIST /end MEASUREMENT
/begin MEASUREMENT Gen_sttemp "Generatorstarttemperatur" SWORD Def_t_sw_q0p1 0 0 -3276.8000 3276.7000 ECU_ADDRESS 0x007FF01A /begin FUNCTION_LIST IMDGEN_1PR /end FUNCTION_LIST /end MEASUREMENT
/begin MEASUREMENT Gen_tans "Generatoransauglufttemperatur" SWORD Def_t_sw_q0p1 0 0 -3276.8000 3276.7000 ECU_ADDRESS 0x007FF01C /begin FUNCTION_LIST IMDGEN_1PR /end FUNCTION_LIST /end MEASUREMENT
/begin MEASUREMENT Md_genfil "gefiltertes Generatormoment absolut" SWORD Def_m_sw_q0p1 0 0 -3276.8000 3276.7000 ECU_ADDRESS 0x007FF01E /begin FUNCTION_LIST IMDGEN_1PR /end FUNCTION_LIST /end MEASUREMENT
/begin MEASUREMENT Md_gennmufi "Generatormoment absolut" SWORD Def_m_sw_q0p1 0 0 -3276.8000 3276.7000 ECU_ADDRESS 0x007FF020 /begin FUNCTION_LIST IMDGEN_1PR /end FUNCTION_LIST /end MEASUREMENT
/begin MEASUREMENT N_gen "Generatordrehzahl" SWORD Def_n_sw_q1p0 0 0 0.0 32767.0000 ECU_ADDRESS 0x007FF022 /begin FUNCTION_LIST IMDGEN_1PR /end FUNCTION_LIST /end MEASUREMENT
/begin MEASUREMENT Nkw_s "Motordrehzahl U/s" SWORD Def_n_sw_q1p0 0 0 -32768.0000 32767.0000 ECU_ADDRESS 0x007FF024 /begin FUNCTION_LIST IMDGEN_1PR /end FUNCTION_LIST /end MEASUREMENT
/begin MEASUREMENT Tgen_dt "Temperaturdifferenz zwischen Abstelltemperatur und Umgebungstemperatur" SWORD Def_t_sw_q0p1 0 0 -48.0000 384.0000 ECU_ADDRESS 0x007FF026 /begin FUNCTION_LIST IMDGEN_1PR /end FUNCTION_LIST /end MEASUREMENT
/begin MEASUREMENT Tgen_exp "Delta Abkühltemperatur" SWORD Def_t_sw_q0p1 0 0 -48.0000 384.0000 ECU_ADDRESS 0x007FF028 /begin FUNCTION_LIST IMDGEN_1PR /end FUNCTION_LIST /end MEASUREMENT
/begin MEASUREMENT Gen_rs "Statorwiderstand" UWORD Def_f_uw_b1 0 0 0.0 9.99984741210938e-1 ECU_ADDRESS 0x0080050A /begin FUNCTION_LIST IMDGEN_1PR /end FUNCTION_LIST /end MEASUREMENT
/begin MEASUREMENT Gen_spv "Generatorstatorverlustleistung" UWORD Def_f_uw_b2048 0 0 0.0 2047.9687 ECU_ADDRESS 0x0080050C /begin FUNCTION_LIST IMDGEN_1PR /end FUNCTION_LIST /end MEASUREMENT
/begin MEASUREMENT Tst_countv "Testcounter-Wert" UWORD Def_st_uw_q1 0 0 0.0 65535.0000 ECU_ADDRESS 0x0080050E /begin FUNCTION_LIST IMDGEN_1PR /end FUNCTION_LIST /end MEASUREMENT
/begin MEASUREMENT Tst_fil_out "Testfilter Ausgang" UWORD Def_t_uw_q0p075 0 0 0.0 768.0000 ECU_ADDRESS 0x00800510 /begin FUNCTION_LIST IMDGEN_1PR /end FUNCTION_LIST /end MEASUREMENT
/begin MEASUREMENT Gen_teta "Wirkungsgrad Generator W*PI temperaturkompensiert" UWORD Def_f_uw_b32 0 0 0.0 31.9995 ECU_ADDRESS 0x007FF02A /begin FUNCTION_LIST IMDGEN_1PR /end FUNCTION_LIST /end MEASUREMENT
/begin MEASUREMENT Gen_weta "Wirkungsgrad Generator mit Omega*PI" UWORD Def_f_uw_b32 0 0 0.0 31.9995 ECU_ADDRESS 0x007FF02C /begin FUNCTION_LIST IMDGEN_1PR /end FUNCTION_LIST /end MEASUREMENT
/begin MEASUREMENT I_gen_nafil "Generatorstrom nach Filter" UWORD Def_i_uw_q0p03125 0 0 0.0 256.0000 ECU_ADDRESS 0x007FF02E /begin FUNCTION_LIST IMDGEN_1PR /end FUNCTION_LIST /end MEASUREMENT
/begin MEASUREMENT I_gen_vorfil "Generatorstrom vor Filter" UWORD Def_i_uw_q0p03125 0 0 0.0 256.0000 ECU_ADDRESS 0x007FF030 /begin FUNCTION_LIST IMDGEN_1PR /end FUNCTION_LIST /end MEASUREMENT
/begin MEASUREMENT Md_genrel "relatives Generatormoment Ausgang" UWORD Def_f_uw_b100 0 0 0.0 99.9984 ECU_ADDRESS 0x007FF032 /begin FUNCTION_LIST IMDGEN_1PR /end FUNCTION_LIST /end MEASUREMENT
/begin MEASUREMENT Gen_i_kaltun "DF korrektiert ueber Generatordrehzahl" UBYTE Def_i_ub_q1 0 0 0.0 255.0000 ECU_ADDRESS 0x00800512 /begin FUNCTION_LIST IMDGEN_1PR /end FUNCTION_LIST /end MEASUREMENT
/begin MEASUREMENT Gen_nummer "Erkannte Generatornummer" UBYTE Def_st_ub_q1 0 0 0.0 255.0000 ECU_ADDRESS 0x007FF038 /begin FUNCTION_LIST IMDGEN_1PR /end FUNCTION_LIST /end MEASUREMENT
/begin MEASUREMENT I_basis "Basis Strombedarf FZG mit SLP" UBYTE Def_i_ub_q1 0 0 0.0 255.0000 ECU_ADDRESS 0x007FF039 /begin FUNCTION_LIST IMDGEN_1PR /end FUNCTION_LIST /end MEASUREMENT
/begin MEASUREMENT I_gen_end "Generatorstrom gemessen / gerechnet" UBYTE Def_i_ub_q1 0 0 0.0 254.0000 ECU_ADDRESS 0x007FF03A /begin FUNCTION_LIST IMDGEN_1PR /end FUNCTION_LIST /end MEASUREMENT
/begin MEASUREMENT I_gen_g "Generatorstrom gesamt" UBYTE Def_i_ub_q1 0 0 0.0 255.0000 ECU_ADDRESS 0x007FF03B /begin FUNCTION_LIST IMDGEN_1PR /end FUNCTION_LIST /end MEASUREMENT
/begin MEASUREMENT I_gm "Generatormischstrom" UBYTE Def_i_ub_q1 0 0 0.0 255.0000 ECU_ADDRESS 0x007FF03C /begin FUNCTION_LIST IMDGEN_1PR /end FUNCTION_LIST /end MEASUREMENT
/begin MEASUREMENT I_gvor "Stromwert nach Überblendung" UBYTE Def_i_ub_q1 0 0 0.0 255.0000 ECU_ADDRESS 0x007FF03D /begin FUNCTION_LIST IMDGEN_1PR /end FUNCTION_LIST /end MEASUREMENT
/begin MEASUREMENT St_sleep.B_sleepwait "Signal Verzoegerung Sleep Indication" UBYTE Def_bit_ub_0 0 0 0.0 255.0 ECU_ADDRESS 0x007FC60C /begin FUNCTION_LIST KT_IBS /end FUNCTION_LIST BIT_MASK 0x1 /end MEASUREMENT
/begin MEASUREMENT St_sleep "Statuswort Einschlafverhalten" UBYTE Def_st_ub_q1 0 0 0.0 255.0000 ECU_ADDRESS 0x007FC60C /begin FUNCTION_LIST KT_IBS /end FUNCTION_LIST /end MEASUREMENT
/begin MEASUREMENT St_ibsreg4.B_startfgk "Bedingung Startfähigkeit gefährdet" UBYTE Def_bit_ub_0 0 0 0.0 255.0 ECU_ADDRESS 0x0080056C /begin FUNCTION_LIST KT_IBS /end FUNCTION_LIST BIT_MASK 0x1 /end MEASUREMENT
/begin MEASUREMENT St_ibsreg4.B_strtaw "Bedingung Startauswertung gerechnet" UBYTE Def_bit_ub_1 0 0 0.0 255.0 ECU_ADDRESS 0x0080056C /begin FUNCTION_LIST KT_IBS /end FUNCTION_LIST BIT_MASK 0x2 /end MEASUREMENT
/begin MEASUREMENT St_ibsreg4.B_ibspwf "Bedingung IBS powerfail erkannt" UBYTE Def_bit_ub_4 0 0 0.0 255.0 ECU_ADDRESS 0x0080056C /begin FUNCTION_LIST KT_IBS /end FUNCTION_LIST BIT_MASK 0x10 /end MEASUREMENT
/begin MEASUREMENT St_ibsreg4.B_tiefset "Bedingung Tiefentladung" UBYTE Def_bit_ub_5 0 0 0.0 255.0 ECU_ADDRESS 0x0080056C /begin FUNCTION_LIST KT_IBS /end FUNCTION_LIST BIT_MASK 0x20 /end MEASUREMENT
/begin MEASUREMENT St_ibsreg4 "Statuswort ibsreg4" UBYTE Def_st_ub_q1 0 0 0.0 255.0000 ECU_ADDRESS 0x0080056C /begin FUNCTION_LIST KT_IBS /end FUNCTION_LIST /end MEASUREMENT
/begin MEASUREMENT St_ibsreg5.B_fsclr "Bedingung IBS interne Fehler loeschen" UBYTE Def_bit_ub_3 0 0 0.0 255.0 ECU_ADDRESS 0x0080056D /begin FUNCTION_LIST KT_IBS /end FUNCTION_LIST BIT_MASK 0x8 /end MEASUREMENT
/begin MEASUREMENT St_ibsreg5 "Statuswort ibsreg5" UBYTE Def_st_ub_q1 0 0 0.0 255.0000 ECU_ADDRESS 0x0080056D /begin FUNCTION_LIST KT_IBS /end FUNCTION_LIST /end MEASUREMENT
/begin MEASUREMENT Ibs_reg5 "IBS Register 5 Var.not used: now St_ibsreg5" UBYTE Def_dez_ub_q1 0 0 0.0 255.0000 ECU_ADDRESS 0x0080056E /begin FUNCTION_LIST KT_IBS /end FUNCTION_LIST /end MEASUREMENT
/begin MEASUREMENT Ibs_errors "Fehler Reg. aus IBS gelesen" UBYTE Def_dez_ub_q1 0 0 0.0 255.0000 ECU_ADDRESS 0x0080056F /begin FUNCTION_LIST KT_IBS /end FUNCTION_LIST /end MEASUREMENT
/begin MEASUREMENT Ibs_msgind "Index auf EBSD Botschaft" UBYTE Def_dez_ub_q1 0 0 0.0 255.0000 ECU_ADDRESS 0x00800570 /begin FUNCTION_LIST KT_IBS /end FUNCTION_LIST /end MEASUREMENT
/begin MEASUREMENT Ibs_msgsta "EBSD Fehler Status" UBYTE Def_dez_ub_q1 0 0 0.0 255.0000 ECU_ADDRESS 0x00800571 /begin FUNCTION_LIST KT_IBS /end FUNCTION_LIST /end MEASUREMENT
/begin MEASUREMENT Kt_ibsstatus "Status BSD Statemachine" UBYTE Def_dez_ub_q1 0 0 0.0 255.0000 ECU_ADDRESS 0x00800572 /begin FUNCTION_LIST KT_IBS /end FUNCTION_LIST /end MEASUREMENT
/begin MEASUREMENT Ibs_start "Status Statemachine Startup Kommunikation" UBYTE Def_dez_ub_q1 0 0 0.0 255.0000 ECU_ADDRESS 0x00800573 /begin FUNCTION_LIST KT_IBS /end FUNCTION_LIST /end MEASUREMENT
/begin MEASUREMENT Comcontrol "Kontrolle Diagnose Modul DIBS" UBYTE Def_dez_ub_q1 0 0 0.0 255.0000 ECU_ADDRESS 0x00800574 /begin FUNCTION_LIST KT_IBS /end FUNCTION_LIST /end MEASUREMENT
/begin MEASUREMENT St_ibebsd1.B_ibs_msgrdy "Bedingung EBSD Botschaft von IBS empfangen" UBYTE Def_bit_ub_0 0 0 0.0 255.0 ECU_ADDRESS 0x00800575 /begin FUNCTION_LIST KT_IBS /end FUNCTION_LIST BIT_MASK 0x1 /end MEASUREMENT
/begin MEASUREMENT St_ibebsd1.B_ibs_msgwri "Bedingung EBSD Übertragungsrichtung schreiben" UBYTE Def_bit_ub_1 0 0 0.0 255.0 ECU_ADDRESS 0x00800575 /begin FUNCTION_LIST KT_IBS /end FUNCTION_LIST BIT_MASK 0x2 /end MEASUREMENT
/begin MEASUREMENT St_ibebsd1.B_eb_txok "Bedingung EBSD Übertragungsrichtung schreiben" UBYTE Def_bit_ub_2 0 0 0.0 255.0 ECU_ADDRESS 0x00800575 /begin FUNCTION_LIST KT_IBS /end FUNCTION_LIST BIT_MASK 0x4 /end MEASUREMENT
/begin MEASUREMENT St_ibebsd1.B_eb_busy "Bedingung EBSD Übertragungsrichtung schreiben" UBYTE Def_bit_ub_3 0 0 0.0 255.0 ECU_ADDRESS 0x00800575 /begin FUNCTION_LIST KT_IBS /end FUNCTION_LIST BIT_MASK 0x8 /end MEASUREMENT
/begin MEASUREMENT St_ibebsd1 "Statuswort ibebsd1" UBYTE Def_st_ub_q1 0 0 0.0 255.0000 ECU_ADDRESS 0x00800575 /begin FUNCTION_LIST KT_IBS /end FUNCTION_LIST /end MEASUREMENT
/begin MEASUREMENT St_ibserr.B_ibfbsd "Bedingung BSD Fehler" UBYTE Def_bit_ub_0 0 0 0.0 255.0 ECU_ADDRESS 0x00800576 /begin FUNCTION_LIST KT_IBS /end FUNCTION_LIST BIT_MASK 0x1 /end MEASUREMENT
/begin MEASUREMENT St_ibserr.B_ibfebsd "Bedingung EBSD Fehler" UBYTE Def_bit_ub_1 0 0 0.0 255.0 ECU_ADDRESS 0x00800576 /begin FUNCTION_LIST KT_IBS /end FUNCTION_LIST BIT_MASK 0x2 /end MEASUREMENT
/begin MEASUREMENT St_ibserr.B_ibunplau "Bedingung IBS Version unplausibel" UBYTE Def_bit_ub_2 0 0 0.0 255.0 ECU_ADDRESS 0x00800576 /begin FUNCTION_LIST KT_IBS /end FUNCTION_LIST BIT_MASK 0x4 /end MEASUREMENT
/begin MEASUREMENT St_ibserr "Statuswort ibserr" UBYTE Def_st_ub_q1 0 0 0.0 255.0000 ECU_ADDRESS 0x00800576 /begin FUNCTION_LIST KT_IBS /end FUNCTION_LIST /end MEASUREMENT
/begin MEASUREMENT St_ibmix.B_ibrhilo "toggle Bit Register0/ 1 hi- od. lo byte" UBYTE Def_bit_ub_0 0 0 0.0 255.0 ECU_ADDRESS 0x00800577 /begin FUNCTION_LIST KT_IBS /end FUNCTION_LIST BIT_MASK 0x1 /end MEASUREMENT
/begin MEASUREMENT St_ibmix.B_ibttog "global toggle bit" UBYTE Def_bit_ub_1 0 0 0.0 255.0 ECU_ADDRESS 0x00800577 /begin FUNCTION_LIST KT_IBS /end FUNCTION_LIST BIT_MASK 0x2 /end MEASUREMENT
/begin MEASUREMENT St_ibmix "Statuswort ibmix" UBYTE Def_st_ub_q1 0 0 0.0 255.0000 ECU_ADDRESS 0x00800577 /begin FUNCTION_LIST KT_IBS /end FUNCTION_LIST /end MEASUREMENT
/begin MEASUREMENT Ibswbase "IBS Software Baseline" UBYTE Def_dez_ub_q1 0 0 0.0 255.0000 ECU_ADDRESS 0x00800578 /begin FUNCTION_LIST KT_IBS /end FUNCTION_LIST /end MEASUREMENT
/begin MEASUREMENT Ibswchang "IBS Software Änderungs Status" UBYTE Def_dez_ub_q1 0 0 0.0 255.0000 ECU_ADDRESS 0x00800579 /begin FUNCTION_LIST KT_IBS /end FUNCTION_LIST /end MEASUREMENT
/begin MEASUREMENT Ibhwversi "IBS Hardware Version" UBYTE Def_dez_ub_q1 0 0 0.0 255.0000 ECU_ADDRESS 0x0080057A /begin FUNCTION_LIST KT_IBS /end FUNCTION_LIST /end MEASUREMENT
/begin MEASUREMENT Ib_parlen "Länge IBS Parameterliste" UBYTE Def_dez_ub_q1 0 0 0.0 255.0000 ECU_ADDRESS 0x0080057B /begin FUNCTION_LIST KT_IBS /end FUNCTION_LIST /end MEASUREMENT
/begin MEASUREMENT Ibsiicctri "IBS Fehlerzähler" UBYTE Def_dez_ub_q1 0 0 0.0 255.0000 ECU_ADDRESS 0x0080057C /begin FUNCTION_LIST KT_IBS /end FUNCTION_LIST /end MEASUREMENT
/begin MEASUREMENT Ibsbclctri "IBS Fehlerzähler" UBYTE Def_dez_ub_q1 0 0 0.0 255.0000 ECU_ADDRESS 0x0080057D /begin FUNCTION_LIST KT_IBS /end FUNCTION_LIST /end MEASUREMENT
/begin MEASUREMENT Ibseromctr "IBS Fehlerzähler" UBYTE Def_dez_ub_q1 0 0 0.0 255.0000 ECU_ADDRESS 0x0080057E /begin FUNCTION_LIST KT_IBS /end FUNCTION_LIST /end MEASUREMENT
/begin MEASUREMENT Ibsramctr "IBS Fehlerzähler" UBYTE Def_dez_ub_q1 0 0 0.0 255.0000 ECU_ADDRESS 0x0080057F /begin FUNCTION_LIST KT_IBS /end FUNCTION_LIST /end MEASUREMENT
/begin MEASUREMENT Ibspromctr "IBS Fehlerzähler" UBYTE Def_dez_ub_q1 0 0 0.0 255.0000 ECU_ADDRESS 0x00800580 /begin FUNCTION_LIST KT_IBS /end FUNCTION_LIST /end MEASUREMENT
/begin MEASUREMENT Ibsdncsctr "IBS Fehlerzähler download checksum" UBYTE Def_dez_ub_q1 0 0 0.0 255.0000 ECU_ADDRESS 0x00800581 /begin FUNCTION_LIST KT_IBS /end FUNCTION_LIST /end MEASUREMENT
/begin MEASUREMENT T_battsoci "T_battsoc0, Rohwert aus IBS" UBYTE Def_dez_ub_q1 0 0 0.0 255.0000 ECU_ADDRESS 0x00800582 /begin FUNCTION_LIST KT_IBS /end FUNCTION_LIST /end MEASUREMENT
/begin MEASUREMENT Tbatt_maxi "T_batt_max, Rohwert aus IBS" UBYTE Def_dez_ub_q1 0 0 0.0 255.0000 ECU_ADDRESS 0x00800583 /begin FUNCTION_LIST KT_IBS /end FUNCTION_LIST /end MEASUREMENT
/begin MEASUREMENT Tbatt_mini "T_batt_min, Rohwert aus IBS" UBYTE Def_dez_ub_q1 0 0 0.0 255.0000 ECU_ADDRESS 0x00800584 /begin FUNCTION_LIST KT_IBS /end FUNCTION_LIST /end MEASUREMENT
/begin MEASUREMENT Ibslvdctr "IBS Fehlerzähler" UWORD Def_dez_uw_q1 0 0 0.0 65535.0000 ECU_ADDRESS 0x00800524 /begin FUNCTION_LIST KT_IBS /end FUNCTION_LIST /end MEASUREMENT
/begin MEASUREMENT I_batt "Batteriestrom von IBS gemessen" UWORD Def_i_uw_q0p08_o200 0 0 -200.0000 5042.8000 ECU_ADDRESS 0x00800526 /begin FUNCTION_LIST KT_IBS /end FUNCTION_LIST /end MEASUREMENT
/begin MEASUREMENT U_batt "Batteriespannung von IBS gemessen" UWORD Def_u_uw_q0p25em3_o6 0 0 6.0000 22.3837 ECU_ADDRESS 0x00800528 /begin FUNCTION_LIST KT_IBS /end FUNCTION_LIST /end MEASUREMENT
/begin MEASUREMENT Ibsborctr "IBS Fehlerzähler" UWORD Def_dez_uw_q1 0 0 0.0 65535.0000 ECU_ADDRESS 0x0080052A /begin FUNCTION_LIST KT_IBS /end FUNCTION_LIST /end MEASUREMENT
/begin MEASUREMENT Ibswdtctr "IBS Fehlerzähler watchdog" UWORD Def_dez_uw_q1 0 0 0.0 65535.0000 ECU_ADDRESS 0x0080052C /begin FUNCTION_LIST KT_IBS /end FUNCTION_LIST /end MEASUREMENT
/begin MEASUREMENT Ibsporctr "IBS Fehlerzähler power on" UWORD Def_dez_uw_q1 0 0 0.0 65535.0000 ECU_ADDRESS 0x0080052E /begin FUNCTION_LIST KT_IBS /end FUNCTION_LIST /end MEASUREMENT
/begin MEASUREMENT Ibsptyctr "IBS Fehlerzähler BSD parity" UWORD Def_dez_uw_q1 0 0 0.0 65535.0000 ECU_ADDRESS 0x00800530 /begin FUNCTION_LIST KT_IBS /end FUNCTION_LIST /end MEASUREMENT
/begin MEASUREMENT Qlad "Delta Batterieladung" UWORD Def_ql_uw_q0p0182 0 0 0.0 1192.7502 ECU_ADDRESS 0x00800532 /begin FUNCTION_LIST KT_IBS /end FUNCTION_LIST /end MEASUREMENT
/begin MEASUREMENT Qelad "Delta Batterieentladung" UWORD Def_ql_uw_q0p0182 0 0 0.0 1192.7502 ECU_ADDRESS 0x00800534 /begin FUNCTION_LIST KT_IBS /end FUNCTION_LIST /end MEASUREMENT
/begin MEASUREMENT I_soc0 "Strom bei Ruhespannungsmessung" SWORD Def_i_sw_q0p02 0 0 -655.3600 655.3400 ECU_ADDRESS 0x00800536 /begin FUNCTION_LIST KT_IBS /end FUNCTION_LIST /end MEASUREMENT
/begin MEASUREMENT T_battsoc0 "Batterietemperatur bei Ruhespannungsmessung" SWORD Def_t_sw_q0p1 0 0 -3276.8000 3276.7000 ECU_ADDRESS 0x00800538 /begin FUNCTION_LIST KT_IBS /end FUNCTION_LIST /end MEASUREMENT
/begin MEASUREMENT U1soc0 "Ruhespannung 1" UWORD Def_u_uw_q0p25em3_o6 0 0 6.0000 22.3837 ECU_ADDRESS 0x0080053A /begin FUNCTION_LIST KT_IBS /end FUNCTION_LIST /end MEASUREMENT
/begin MEASUREMENT U2soc0 "Ruhespannung 1" UWORD Def_u_uw_q0p25em3_o6 0 0 6.0000 22.3837 ECU_ADDRESS 0x0080053C /begin FUNCTION_LIST KT_IBS /end FUNCTION_LIST /end MEASUREMENT
/begin MEASUREMENT U3soc0 "Ruhespannung 1" UWORD Def_u_uw_q0p25em3_o6 0 0 6.0000 22.3837 ECU_ADDRESS 0x0080053E /begin FUNCTION_LIST KT_IBS /end FUNCTION_LIST /end MEASUREMENT
/begin MEASUREMENT Qladsoc0 "Ladung bei Ruhespannungsmessung" UWORD Def_ql_uw_q0p0182 0 0 0.0 1192.7502 ECU_ADDRESS 0x00800540 /begin FUNCTION_LIST KT_IBS /end FUNCTION_LIST /end MEASUREMENT
/begin MEASUREMENT Qeladsoc0 "Entladung bei Ruhespannungsmessung" UWORD Def_ql_uw_q0p0182 0 0 0.0 1192.7502 ECU_ADDRESS 0x00800542 /begin FUNCTION_LIST KT_IBS /end FUNCTION_LIST /end MEASUREMENT
/begin MEASUREMENT U_vorstart "Spannung vor Start" UWORD Def_u_uw_q0p25em3_o6 0 0 6.0000 22.3837 ECU_ADDRESS 0x00800544 /begin FUNCTION_LIST KT_IBS /end FUNCTION_LIST /end MEASUREMENT
/begin MEASUREMENT U_tnstart "Spannung im Start" UWORD Def_u_uw_q0p25em3_o6 0 0 6.0000 22.3837 ECU_ADDRESS 0x00800546 /begin FUNCTION_LIST KT_IBS /end FUNCTION_LIST /end MEASUREMENT
/begin MEASUREMENT I_vorstart "Batteriestrom vor Start" UWORD Def_i_uw_q0p02_o200 0 0 -200.0000 1110.7000 ECU_ADDRESS 0x00800548 /begin FUNCTION_LIST KT_IBS /end FUNCTION_LIST /end MEASUREMENT
/begin MEASUREMENT I_tnstart "Batteriestrom im Start" UWORD Def_i_uw_q0p02 0 0 0.0 1310.7000 ECU_ADDRESS 0x0080054A /begin FUNCTION_LIST KT_IBS /end FUNCTION_LIST /end MEASUREMENT
/begin MEASUREMENT T1histiruh "Ruhestromhistogramm Klasse 1" UWORD Def_dez_uw_q1 0 0 0.0 65535.0000 ECU_ADDRESS 0x0080054C /begin FUNCTION_LIST KT_IBS /end FUNCTION_LIST /end MEASUREMENT
/begin MEASUREMENT T2histiruh "Ruhestromhistogramm Klasse 2" UWORD Def_dez_uw_q1 0 0 0.0 65535.0000 ECU_ADDRESS 0x0080054E /begin FUNCTION_LIST KT_IBS /end FUNCTION_LIST /end MEASUREMENT
/begin MEASUREMENT T3histiruh "Ruhestromhistogramm Klasse 3" UWORD Def_dez_uw_q1 0 0 0.0 65535.0000 ECU_ADDRESS 0x00800550 /begin FUNCTION_LIST KT_IBS /end FUNCTION_LIST /end MEASUREMENT
/begin MEASUREMENT T4histiruh "Ruhestromhistogramm Klasse 4" UWORD Def_dez_uw_q1 0 0 0.0 65535.0000 ECU_ADDRESS 0x00800552 /begin FUNCTION_LIST KT_IBS /end FUNCTION_LIST /end MEASUREMENT
/begin MEASUREMENT T_batt_ibs "Batterietemperatur" SWORD Def_t_sw_q0p1 0 0 -3276.8000 3276.7000 ECU_ADDRESS 0x00800554 /begin FUNCTION_LIST KT_IBS /end FUNCTION_LIST /end MEASUREMENT
/begin MEASUREMENT T_batt_max "Maximale Batt. Temperatur bei Stillstand" SWORD Def_t_sw_q0p1 0 0 -3276.8000 3276.7000 ECU_ADDRESS 0x00800556 /begin FUNCTION_LIST KT_IBS /end FUNCTION_LIST /end MEASUREMENT
/begin MEASUREMENT T_batt_min "Minimale Batt. Temperatur bei Stillstand" SWORD Def_t_sw_q0p1 0 0 -3276.8000 3276.7000 ECU_ADDRESS 0x00800558 /begin FUNCTION_LIST KT_IBS /end FUNCTION_LIST /end MEASUREMENT
/begin MEASUREMENT Ktupcsctr "kt_ibs Fehlerzähler EBSD Checksumme" UWORD Def_dez_uw_q1 0 0 0.0 65535.0000 ECU_ADDRESS 0x0080055A /begin FUNCTION_LIST KT_IBS /end FUNCTION_LIST /end MEASUREMENT
/begin MEASUREMENT Zbibs "Zusbaunummer" ULONG Def_dez_ul_q1 0 0 0.0 2147483647.0000 ECU_ADDRESS 0x00800518 /begin FUNCTION_LIST KT_IBS /end FUNCTION_LIST /end MEASUREMENT
/begin MEASUREMENT Snibs "Seriennummer" ULONG Def_dez_ul_q1 0 0 0.0 2147483647.0000 ECU_ADDRESS 0x0080051C /begin FUNCTION_LIST KT_IBS /end FUNCTION_LIST /end MEASUREMENT
/begin MEASUREMENT Ebsd_varin "Index EBSD Variable" UBYTE Def_dez_ub_q1 0 0 0.0 255.0000 ECU_ADDRESS 0x00800585 /begin FUNCTION_LIST KT_IBS /end FUNCTION_LIST /end MEASUREMENT
/begin MEASUREMENT Ebsd_nbyt "Länge EBSD Variable" UBYTE Def_dez_ub_q1 0 0 0.0 255.0000 ECU_ADDRESS 0x00800586 /begin FUNCTION_LIST KT_IBS /end FUNCTION_LIST /end MEASUREMENT
/begin MEASUREMENT Unind "EBSD Puffer Index" UBYTE Def_dez_ub_q1 0 0 0.0 255.0000 ECU_ADDRESS 0x00800587 /begin FUNCTION_LIST KT_IBS /end FUNCTION_LIST /end MEASUREMENT
/begin MEASUREMENT Ebsd_adr "EBSD Adresse im IBS" UBYTE Def_dez_ub_q1 0 0 0.0 255.0000 ECU_ADDRESS 0x00800588 /begin FUNCTION_LIST KT_IBS /end FUNCTION_LIST /end MEASUREMENT
/begin MEASUREMENT Ebsd_errdir "EBSD Übertragungsrichtung bei Fehler" UBYTE Def_dez_ub_q1 0 0 0.0 255.0000 ECU_ADDRESS 0x00800589 /begin FUNCTION_LIST KT_IBS /end FUNCTION_LIST /end MEASUREMENT
/begin MEASUREMENT Ebsd_errin "EBSD Index bei Fehler" UBYTE Def_dez_ub_q1 0 0 0.0 255.0000 ECU_ADDRESS 0x0080058A /begin FUNCTION_LIST KT_IBS /end FUNCTION_LIST /end MEASUREMENT
/begin MEASUREMENT Ebsd_errep "EBSD Fehler repeat timer" UBYTE Def_dez_ub_q1 0 0 0.0 255.0000 ECU_ADDRESS 0x0080058B /begin FUNCTION_LIST KT_IBS /end FUNCTION_LIST /end MEASUREMENT
/begin MEASUREMENT Ebsd_timo "EBSD Fehler timeout counter" UBYTE Def_dez_ub_q1 0 0 0.0 255.0000 ECU_ADDRESS 0x0080058C /begin FUNCTION_LIST KT_IBS /end FUNCTION_LIST /end MEASUREMENT
/begin MEASUREMENT R5cyctim "Timer f. zyklisches Senden IBS Reg. 5" UBYTE Def_dez_ub_q1 0 0 0.0 255.0000 ECU_ADDRESS 0x0080058D /begin FUNCTION_LIST KT_IBS /end FUNCTION_LIST /end MEASUREMENT
/begin MEASUREMENT Fsclctr "Hilfszaehler IBS Fehler loeschen" UBYTE Def_dez_ub_q1 0 0 0.0 255.0000 ECU_ADDRESS 0x0080058E /begin FUNCTION_LIST KT_IBS /end FUNCTION_LIST /end MEASUREMENT
/begin MEASUREMENT Ktib_chk16 "Checksumme EBSD Übertragung intern" UWORD Def_dez_uw_q1 0 0 0.0 65535.0000 ECU_ADDRESS 0x0080055C /begin FUNCTION_LIST KT_IBS /end FUNCTION_LIST /end MEASUREMENT
/begin MEASUREMENT Ib_chk16 "Checksumme EBSD Übertragung aus IBS" UWORD Def_dez_uw_q1 0 0 0.0 65535.0000 ECU_ADDRESS 0x0080055E /begin FUNCTION_LIST KT_IBS /end FUNCTION_LIST /end MEASUREMENT
/begin MEASUREMENT Chk16_ibs "Checksumme Parameter aus IBS" UWORD Def_dez_uw_q1 0 0 0.0 65535.0000 ECU_ADDRESS 0x00800560 /begin FUNCTION_LIST KT_IBS /end FUNCTION_LIST /end MEASUREMENT
/begin MEASUREMENT Chkpara "Checksumme Parameter intern" UWORD Def_dez_uw_q1 0 0 0.0 65535.0000 ECU_ADDRESS 0x00800562 /begin FUNCTION_LIST KT_IBS /end FUNCTION_LIST /end MEASUREMENT
/begin MEASUREMENT Acfzgl "Fahrzeuglängsbeschleunigung" SBYTE Def_ac_sb_q0p25 0 0 -32.0000 31.7500 ECU_ADDRESS 0x007FC656 /begin FUNCTION_LIST LAYER /end FUNCTION_LIST /end MEASUREMENT
/begin MEASUREMENT Acfzgq "Fahrzeugquerbeschleunigung" SBYTE Def_ac_sb_q0p25 0 0 -32.0000 31.7500 ECU_ADDRESS 0x007FC657 /begin FUNCTION_LIST LAYER /end FUNCTION_LIST /end MEASUREMENT
/begin MEASUREMENT Batt_coort "codierter Batterieeinbauort" UBYTE Def_dez_ub_q1 0 0 0.0 255.0000 ECU_ADDRESS 0x007FC658 /begin FUNCTION_LIST LAYER /end FUNCTION_LIST /end MEASUREMENT
/begin MEASUREMENT Bordnetz "ausgewähltes Bordnetz(0x01 => CAN11H, 0x02 => CAN12H(BN2000))" UBYTE Def_st_ub_q1 0 0 0.0 255.0000 ECU_ADDRESS 0x007FC659 /begin FUNCTION_LIST LAYER /end FUNCTION_LIST /end MEASUREMENT
/begin MEASUREMENT Bosbtvfbkt "Verfügbarkeit vom Tester" UBYTE Def_dez_ub_q1 0 0 0.0 255.0000 ECU_ADDRESS 0x007FC65A /begin FUNCTION_LIST LAYER /end FUNCTION_LIST /end MEASUREMENT
/begin MEASUREMENT Bosjzielt "Zieltermin_Jahr vom Tester" UBYTE Def_dez_ub_q1 0 0 0.0 255.0000 ECU_ADDRESS 0x007FC65B /begin FUNCTION_LIST LAYER /end FUNCTION_LIST /end MEASUREMENT
/begin MEASUREMENT Bosmzielt "Zieltermin_Monat vom Tester" UBYTE Def_dez_ub_q1 0 0 0.0 255.0000 ECU_ADDRESS 0x007FC65C /begin FUNCTION_LIST LAYER /end FUNCTION_LIST /end MEASUREMENT
/begin MEASUREMENT Bosprog2t "Prognose_Intervall_Zeit vom Tester" UBYTE Def_dez_ub_q1 0 0 0.0 255.0000 ECU_ADDRESS 0x007FC65D /begin FUNCTION_LIST LAYER /end FUNCTION_LIST /end MEASUREMENT
/begin MEASUREMENT Bosrlsmr "Restlaufstrecke Motoröl vom Kombi" SWORD Def_km_sw_q10 0 0 -327680.0000 327670.0000 ECU_ADDRESS 0x007FC65E /begin FUNCTION_LIST LAYER /end FUNCTION_LIST /end MEASUREMENT
/begin MEASUREMENT Bosrlsmt "Restlaufstrecke Motoröl vom Tester" SWORD Def_km_sw_q10 0 0 -327680.0000 327670.0000 ECU_ADDRESS 0x007FC660 /begin FUNCTION_LIST LAYER /end FUNCTION_LIST /end MEASUREMENT
/begin MEASUREMENT Bosrw2t "Prognose_Intervall_Weg vom Tester" UBYTE Def_km_ub_q1000 0 0 0.0 255000.0000 ECU_ADDRESS 0x007FC662 /begin FUNCTION_LIST LAYER /end FUNCTION_LIST /end MEASUREMENT
/begin MEASUREMENT Bosv "Verfügbarkeit vom Kombi" UBYTE Def_dez_ub_q1 0 0 0.0 255.0000 ECU_ADDRESS 0x007FC663 /begin FUNCTION_LIST LAYER /end FUNCTION_LIST /end MEASUREMENT
/begin MEASUREMENT Bsdcontrol "3 Byte Schnittstelle für kt_ibs" UBYTE Def_dez_ub_q1 0 0 0.0 255.0000 ECU_ADDRESS 0x007FC664 /begin FUNCTION_LIST LAYER /end FUNCTION_LIST /end MEASUREMENT
/begin MEASUREMENT Bsddata "3 Byte Schnittstelle kt_ibs" UBYTE Def_dez_ub_q1 0 0 0.0 255.0000 ECU_ADDRESS 0x007FC665 /begin FUNCTION_LIST LAYER /end FUNCTION_LIST /end MEASUREMENT
/begin MEASUREMENT Bsdgencv "Chipversion Generator 1" UBYTE Def_st_ub_q1 0 0 0.0 255.0000 ECU_ADDRESS 0x007FC666 /begin FUNCTION_LIST LAYER /end FUNCTION_LIST /end MEASUREMENT
/begin MEASUREMENT Bsdgenregv "Reglerversion Generator 1" UBYTE Def_st_ub_q1 0 0 0.0 255.0000 ECU_ADDRESS 0x007FC667 /begin FUNCTION_LIST LAYER /end FUNCTION_LIST /end MEASUREMENT
/begin MEASUREMENT Bsdregadr "3 Byte Schnittstelle für kt_ibs" UBYTE Def_dez_ub_q1 0 0 0.0 255.0000 ECU_ADDRESS 0x007FC668 /begin FUNCTION_LIST LAYER /end FUNCTION_LIST /end MEASUREMENT
/begin MEASUREMENT Dfgrob "Grobwert Auslastungsgrad Generator 1" UBYTE Def_st_ub_q1 0 0 0.0 255.0000 ECU_ADDRESS 0x007FC669 /begin FUNCTION_LIST LAYER /end FUNCTION_LIST /end MEASUREMENT
/begin MEASUREMENT Dfsiggen "Auslastungsgrad Generator 1" UBYTE Def_f_ub_b100 0 0 0.0 99.6093 ECU_ADDRESS 0x007FC66A /begin FUNCTION_LIST LAYER /end FUNCTION_LIST /end MEASUREMENT
/begin MEASUREMENT Dmd_gen "max. Momentenanstieg Motor für Generator" SWORD Def_dm_sw_q0p1 0 0 -3276.8000 3276.7000 ECU_ADDRESS 0x007FC66C /begin FUNCTION_LIST LAYER /end FUNCTION_LIST /end MEASUREMENT
/begin MEASUREMENT Fahrzeug "Fahrzeugtypbezeichnung (E60 = 60, E65 = 65, E46 = 46, E70 = 70)" UBYTE Def_dez_ub_q1 0 0 0.0 255.0000 ECU_ADDRESS 0x007FC66E /begin FUNCTION_LIST LAYER /end FUNCTION_LIST /end MEASUREMENT
/begin MEASUREMENT Fho "Korrekturfaktor Höhe" UWORD Def_f_uw_b2 0 0 0.0 1.9999 ECU_ADDRESS 0x007FC670 /begin FUNCTION_LIST LAYER /end FUNCTION_LIST /end MEASUREMENT
/begin MEASUREMENT Fid_manhydr "Funktionsidentifier Mandetek Hydraulikpfad" UBYTE Def_dez_ub_q1 0 0 0.0 255.0000 ECU_ADDRESS 0x007FC672 /begin FUNCTION_LIST LAYER /end FUNCTION_LIST /end MEASUREMENT
/begin MEASUREMENT Fid_manluft "Funktionsidentifier Mandetek Luftpfad" UBYTE Def_dez_ub_q1 0 0 0.0 255.0000 ECU_ADDRESS 0x007FC673 /begin FUNCTION_LIST LAYER /end FUNCTION_LIST /end MEASUREMENT
/begin MEASUREMENT Gangi "Aktueller Gang intern" UBYTE Def_dez_ub_q1 0 0 0.0 255.0000 ECU_ADDRESS 0x007FC674 /begin FUNCTION_LIST LAYER /end FUNCTION_LIST /end MEASUREMENT
/begin MEASUREMENT Gen_manufak "Herstellercode Generator 1" UBYTE Def_st_ub_q1 0 0 0.0 255.0000 ECU_ADDRESS 0x007FC675 /begin FUNCTION_LIST LAYER /end FUNCTION_LIST /end MEASUREMENT
/begin MEASUREMENT Gen_typkenn "Kennung Generatortyp Generator 1" UBYTE Def_st_ub_q1 0 0 0.0 255.0000 ECU_ADDRESS 0x007FC676 /begin FUNCTION_LIST LAYER /end FUNCTION_LIST /end MEASUREMENT
/begin MEASUREMENT I_pregelv "Strom Raildruckregelventil" SWORD Def_i_sw_q0039 0 0 -128.0000 127.9960 ECU_ADDRESS 0x007FC678 /begin FUNCTION_LIST LAYER /end FUNCTION_LIST /end MEASUREMENT
/begin MEASUREMENT I_zme "Strom Zumesseinheit" SWORD Def_i_sw_q0039 0 0 -128.0000 127.9960 ECU_ADDRESS 0x007FC67A /begin FUNCTION_LIST LAYER /end FUNCTION_LIST /end MEASUREMENT
/begin MEASUREMENT Id_bosrst "Kennung vom Tester für Ölservice" UBYTE Def_dez_ub_q1 0 0 0.0 255.0000 ECU_ADDRESS 0x007FC67C /begin FUNCTION_LIST LAYER /end FUNCTION_LIST /end MEASUREMENT
/begin MEASUREMENT Id_bosrtt "ID f. BOS-Reset v. Tester" UBYTE Def_dez_ub_q1 0 0 0.0 255.0000 ECU_ADDRESS 0x007FC67D /begin FUNCTION_LIST LAYER /end FUNCTION_LIST /end MEASUREMENT
/begin MEASUREMENT Id_bosrtw "ID f. Motoröl v. Kombi" UWORD Def_dez_uw_q1 0 0 0.0 65535.0000 ECU_ADDRESS 0x007FC67E /begin FUNCTION_LIST LAYER /end FUNCTION_LIST /end MEASUREMENT
/begin MEASUREMENT Ierr "Erregerstrom Generator 1" UBYTE Def_i_ub_q0p125 0 0 0.0 31.8750 ECU_ADDRESS 0x007FC680 /begin FUNCTION_LIST LAYER /end FUNCTION_LIST /end MEASUREMENT
/begin MEASUREMENT Ierr_grenz_ext "Grenzerregerstrom vom Tester" UBYTE Def_i_ub_q0p125 0 0 0.0 31.8750 ECU_ADDRESS 0x007FC681 /begin FUNCTION_LIST LAYER /end FUNCTION_LIST /end MEASUREMENT
/begin MEASUREMENT Ierrfgrenz "Kopie begrenzter Erregerstrom Generator 1" UBYTE Def_i_ub_q0p125 0 0 0.0 31.8750 ECU_ADDRESS 0x007FC682 /begin FUNCTION_LIST LAYER /end FUNCTION_LIST /end MEASUREMENT
/begin MEASUREMENT Km_st "Kilometerstand" UWORD Def_km_uw_q10 0 0 0.0 655350.0000 ECU_ADDRESS 0x007FC684 /begin FUNCTION_LIST LAYER /end FUNCTION_LIST /end MEASUREMENT
/begin MEASUREMENT Kvaverbr "Kraftstoffverbrauch" UWORD Def_dez_uw_q1 0 0 0.0 65535.0000 ECU_ADDRESS 0x007FC686 /begin FUNCTION_LIST LAYER /end FUNCTION_LIST /end MEASUREMENT
/begin MEASUREMENT L_pwmout "Tastverhältnis E-Lüfter" UBYTE Def_tv_ub_q0p390625 0 0 0.0 99.6093 ECU_ADDRESS 0x007FC688 /begin FUNCTION_LIST LAYER /end FUNCTION_LIST /end MEASUREMENT
/begin MEASUREMENT La_ist1 "Lambdaistwert" UWORD Def_f_uw_b16 0 0 0.0 15.9997 ECU_ADDRESS 0x007FC68A /begin FUNCTION_LIST LAYER /end FUNCTION_LIST /end MEASUREMENT
/begin MEASUREMENT Md_mgmax "maximalmoment Generator" SWORD Def_m_sw_q0p1 0 0 -3276.8000 3276.7000 ECU_ADDRESS 0x007FC68C /begin FUNCTION_LIST LAYER /end FUNCTION_LIST /end MEASUREMENT
/begin MEASUREMENT Me_ist "Einspritzmasse aktuell" SWORD Def_me_sw_q0p01 0 0 -327.6800 327.6700 ECU_ADDRESS 0x007FC68E /begin FUNCTION_LIST LAYER /end FUNCTION_LIST /end MEASUREMENT
/begin MEASUREMENT Ml "Luftmasse pro Zylinder" SWORD Def_ml_sw_q0p1 0 0 -3276.8000 3276.7000 ECU_ADDRESS 0x007FC690 /begin FUNCTION_LIST LAYER /end FUNCTION_LIST /end MEASUREMENT
/begin MEASUREMENT Mslui "integrierte Luftmasse" UWORD Def_lm_uw_q0p000444 0 0 0.0 29.1266 ECU_ADDRESS 0x007FC692 /begin FUNCTION_LIST LAYER /end FUNCTION_LIST /end MEASUREMENT
/begin MEASUREMENT N_idlms "Leerlaufdrehzahlanhebung von Powermodul" UBYTE Def_st_ub_q1 0 0 0.0 255.0000 ECU_ADDRESS 0x007FC694 /begin FUNCTION_LIST LAYER /end FUNCTION_LIST /end MEASUREMENT
/begin MEASUREMENT Na_bnanteil "Bordnetzanteil Nebebaggregate" UBYTE Def_f_ub_b2 0 0 0.0 1.9921 ECU_ADDRESS 0x007FC695 /begin FUNCTION_LIST LAYER /end FUNCTION_LIST /end MEASUREMENT
/begin MEASUREMENT Nkw "Motordrehzahl an der Kurbelwelle" SWORD Def_n_sw_q1p0 0 0 -32768.0000 32767.0000 ECU_ADDRESS 0x007FC696 /begin FUNCTION_LIST LAYER /end FUNCTION_LIST /end MEASUREMENT
/begin MEASUREMENT Nsllm "Solldrehzahl im Leerlauf ohne Fahrstufe" SWORD Def_n_sw_q1p0 0 0 -32768.0000 32767.0000 ECU_ADDRESS 0x007FC698 /begin FUNCTION_LIST LAYER /end FUNCTION_LIST /end MEASUREMENT
/begin MEASUREMENT Oz_datstat "Status Anzeige Uhrzeit Datum" UBYTE Def_dez_ub_q1 0 0 0.0 255.0000 ECU_ADDRESS 0x007FC69A /begin FUNCTION_LIST LAYER /end FUNCTION_LIST /end MEASUREMENT
/begin MEASUREMENT Oz_dieselein "Dieseleintrag in Liter" UWORD Def_dez_uw_q0p01 0 0 0.0 655.3500 ECU_ADDRESS 0x007FC69C /begin FUNCTION_LIST LAYER /end FUNCTION_LIST /end MEASUREMENT
/begin MEASUREMENT Oz_nivr "Rohwert Ölniveau vom Sensor" UBYTE Def_dez_ub_q1 0 0 0.0 255.0000 ECU_ADDRESS 0x007FC69E /begin FUNCTION_LIST LAYER /end FUNCTION_LIST /end MEASUREMENT
/begin MEASUREMENT Oz_permr "Rohwert Permittivität v. Sensor" UWORD Def_dez_uw_q1 0 0 0.0 65535.0000 ECU_ADDRESS 0x007FC6A0 /begin FUNCTION_LIST LAYER /end FUNCTION_LIST /end MEASUREMENT
/begin MEASUREMENT Oz_resetr "Status der Resetart vom Kombi" UBYTE Def_dez_ub_q1 0 0 0.0 255.0000 ECU_ADDRESS 0x007FC6A2 /begin FUNCTION_LIST LAYER /end FUNCTION_LIST /end MEASUREMENT
/begin MEASUREMENT Oz_status "Statusinfo vom Sensor" UBYTE Def_dez_ub_q1 0 0 0.0 255.0000 ECU_ADDRESS 0x007FC6A3 /begin FUNCTION_LIST LAYER /end FUNCTION_LIST /end MEASUREMENT
/begin MEASUREMENT Oz_tempr "Rohwert Öltemperatur v. Sensor" UBYTE Def_dez_ub_q1 0 0 0.0 255.0000 ECU_ADDRESS 0x007FC6A4 /begin FUNCTION_LIST LAYER /end FUNCTION_LIST /end MEASUREMENT
/begin MEASUREMENT P_gle "Glühleistung" UWORD Def_p_uw_q0p039 0 0 0.0 2559.9609 ECU_ADDRESS 0x007FC6A6 /begin FUNCTION_LIST LAYER /end FUNCTION_LIST /end MEASUREMENT
/begin MEASUREMENT Pld "Ladedruck" SWORD Def_p_sw_q1 0 0 -32768.0000 32767.0000 ECU_ADDRESS 0x007FC6A8 /begin FUNCTION_LIST LAYER /end FUNCTION_LIST /end MEASUREMENT
/begin MEASUREMENT Pu "Umgebungsluftdruck" UWORD Def_p_uw_q0p039 0 0 0.0 2559.9609 ECU_ADDRESS 0x007FC6AA /begin FUNCTION_LIST LAYER /end FUNCTION_LIST /end MEASUREMENT
/begin MEASUREMENT Pwg_ist "Pedalwert Fahrerwunsch in %" SWORD Def_wdk_sw_q0p0244 0 0 -800.0000 799.9755 ECU_ADDRESS 0x007FC6AC /begin FUNCTION_LIST LAYER /end FUNCTION_LIST /end MEASUREMENT
/begin MEASUREMENT Rf "relative Füllung" SWORD Def_rf_sw_q0p01 0 0 -327.6800 327.6700 ECU_ADDRESS 0x007FC6AE /begin FUNCTION_LIST LAYER /end FUNCTION_LIST /end MEASUREMENT
/begin MEASUREMENT St_instr3_1 "Statusbyte CAN Botschaft Instr3" UBYTE Def_st_ub_q1 0 0 0.0 255.0000 ECU_ADDRESS 0x007FC6B0 /begin FUNCTION_LIST LAYER /end FUNCTION_LIST /end MEASUREMENT
/begin MEASUREMENT St_nwf "-" UBYTE Def_st_ub_q1 0 0 0.0 255.0000 ECU_ADDRESS 0x007FC6B1 /begin FUNCTION_LIST LAYER /end FUNCTION_LIST /end MEASUREMENT
/begin MEASUREMENT St_ptc_pwr "Statusrückmeldung für individuelle Ansteuerung für einen Sonderverbraucher (PTC)" UBYTE Def_f_ub_b127p5 0 0 0.0 127.5000 ECU_ADDRESS 0x007FC6B2 /begin FUNCTION_LIST LAYER /end FUNCTION_LIST /end MEASUREMENT
/begin MEASUREMENT T_jahr "Borddatum" UWORD Def_dez_uw_q1 0 0 0.0 65535.0000 ECU_ADDRESS 0x007FC6B4 /begin FUNCTION_LIST LAYER /end FUNCTION_LIST /end MEASUREMENT
/begin MEASUREMENT T_monate "Borddatum" UBYTE Def_dez_ub_q1 0 0 0.0 255.0000 ECU_ADDRESS 0x007FC6B6 /begin FUNCTION_LIST LAYER /end FUNCTION_LIST /end MEASUREMENT
/begin MEASUREMENT T_tag "Borddatum" UBYTE Def_dez_ub_q1 0 0 0.0 255.0000 ECU_ADDRESS 0x007FC6B7 /begin FUNCTION_LIST LAYER /end FUNCTION_LIST /end MEASUREMENT
/begin MEASUREMENT Tans "Ansauglufttemperatur" SWORD Def_t_sw_q0p1 0 0 -3276.8000 3276.7000 ECU_ADDRESS 0x007FC6B8 /begin FUNCTION_LIST LAYER /end FUNCTION_LIST /end MEASUREMENT
/begin MEASUREMENT Tchip "Chiptemperatur Generator 1" SWORD Def_t_sw_q0p1 0 0 -3276.8000 3276.7000 ECU_ADDRESS 0x007FC6BA /begin FUNCTION_LIST LAYER /end FUNCTION_LIST /end MEASUREMENT
/begin MEASUREMENT Td_og_cnt "Zähler für fallende Flanken im TÖNS_Signal" UBYTE Def_dez_ub_q1 0 0 0.0 255.0000 ECU_ADDRESS 0x007FC6BC /begin FUNCTION_LIST LAYER /end FUNCTION_LIST /end MEASUREMENT
/begin MEASUREMENT Td_og_icnt "Zeit zwischen 2 Fallenden Flanken" UWORD Def_td_uw_q0p01 0 0 0.0 655.3500 ECU_ADDRESS 0x007FC6BE /begin FUNCTION_LIST LAYER /end FUNCTION_LIST /end MEASUREMENT
/begin MEASUREMENT Td_og_tk "Abkühlzeit von TÖNS" UWORD Def_td_uw_q0p1 0 0 0.0 6553.5000 ECU_ADDRESS 0x007FC6C0 /begin FUNCTION_LIST LAYER /end FUNCTION_LIST /end MEASUREMENT
/begin MEASUREMENT Td_og_tr "Referntzeit" UWORD Def_td_uw_q0p1 0 0 0.0 6553.5000 ECU_ADDRESS 0x007FC6C2 /begin FUNCTION_LIST LAYER /end FUNCTION_LIST /end MEASUREMENT
/begin MEASUREMENT Td_og_tv "Temperaturzeit von TÖNS" UWORD Def_td_uw_q0p1 0 0 0.0 6553.5000 ECU_ADDRESS 0x007FC6C4 /begin FUNCTION_LIST LAYER /end FUNCTION_LIST /end MEASUREMENT
/begin MEASUREMENT Td_og_uplcnt "Zähler für unplausible signale" UBYTE Def_dez_ub_q1 0 0 0.0 255.0000 ECU_ADDRESS 0x007FC6C6 /begin FUNCTION_LIST LAYER /end FUNCTION_LIST /end MEASUREMENT
/begin MEASUREMENT Td_rdgenreg2 "Auslesezeit für DF-Signal und Diagnose" UBYTE Def_td_ub_q0p1 0 0 0.0 25.5000 ECU_ADDRESS 0x007FC6C7 /begin FUNCTION_LIST LAYER /end FUNCTION_LIST /end MEASUREMENT
/begin MEASUREMENT Tkat_mod "modellierte Katalysatortemperatur" SWORD Def_t_sw_q0p1 0 0 -3276.8000 3276.7000 ECU_ADDRESS 0x007FC6C8 /begin FUNCTION_LIST LAYER /end FUNCTION_LIST /end MEASUREMENT
/begin MEASUREMENT Tlrfgen "Kopie Generator1 LR Vorgabe auf Bus gelegt" UBYTE Def_td_ub_q0p1 0 0 0.0 25.5000 ECU_ADDRESS 0x007FC6CA /begin FUNCTION_LIST LAYER /end FUNCTION_LIST /end MEASUREMENT
/begin MEASUREMENT Tlrgen_ext "Loadresponse vom Tester" UBYTE Def_td_ub_q0p1 0 0 0.0 25.5000 ECU_ADDRESS 0x007FC6CB /begin FUNCTION_LIST LAYER /end FUNCTION_LIST /end MEASUREMENT
/begin MEASUREMENT Tluft "Lufttemperatur" SWORD Def_t_sw_q0p01 0 0 -327.6800 327.6700 ECU_ADDRESS 0x007FC6CC /begin FUNCTION_LIST LAYER /end FUNCTION_LIST /end MEASUREMENT
/begin MEASUREMENT Tmot "Kühlwassertemperatur" SWORD Def_t_sw_q0p01 0 0 -327.6800 327.6700 ECU_ADDRESS 0x007FC6CE /begin FUNCTION_LIST LAYER /end FUNCTION_LIST /end MEASUREMENT
/begin MEASUREMENT Tmot_start "Motorstarttemperatur" SWORD Def_t_sw_q0p01 0 0 -327.6800 327.6700 ECU_ADDRESS 0x007FC6D0 /begin FUNCTION_LIST LAYER /end FUNCTION_LIST /end MEASUREMENT
/begin MEASUREMENT Tn_abstell "Abstellzeit" UWORD Def_dez_uw_q1 0 0 0.0 65535.0000 ECU_ADDRESS 0x007FC6D2 /begin FUNCTION_LIST LAYER /end FUNCTION_LIST /end MEASUREMENT
/begin MEASUREMENT Toel_mdl "Modelltemperatur Motoröl" SWORD Def_t_sw_q0p1 0 0 -3276.8000 3276.7000 ECU_ADDRESS 0x007FC6D4 /begin FUNCTION_LIST LAYER /end FUNCTION_LIST /end MEASUREMENT
/begin MEASUREMENT Tumg "Umgebungstemperatur" SWORD Def_t_sw_q0p1 0 0 -3276.8000 3276.7000 ECU_ADDRESS 0x007FC6D6 /begin FUNCTION_LIST LAYER /end FUNCTION_LIST /end MEASUREMENT
/begin MEASUREMENT Tumg_can "Umgebungstemperatur" SWORD Def_t_sw_q0p1 0 0 -3276.8000 3276.7000 ECU_ADDRESS 0x007FC6D8 /begin FUNCTION_LIST LAYER /end FUNCTION_LIST /end MEASUREMENT
/begin MEASUREMENT Tv_agr "Tastverhältnis AGR-Steller" SWORD Def_tv_sw_q0p01 0 0 -327.6800 327.6700 ECU_ADDRESS 0x007FC6DA /begin FUNCTION_LIST LAYER /end FUNCTION_LIST /end MEASUREMENT
/begin MEASUREMENT Tv_pld "Tastverhältnis Ladedrucksteller" SWORD Def_tv_sw_q0p01 0 0 -327.6800 327.6700 ECU_ADDRESS 0x007FC6DC /begin FUNCTION_LIST LAYER /end FUNCTION_LIST /end MEASUREMENT
/begin MEASUREMENT Tv_pldl "Tastverhältnis Ladedrucksteller low" SWORD Def_tv_sw_q0p01 0 0 -327.6800 327.6700 ECU_ADDRESS 0x007FC6DE /begin FUNCTION_LIST LAYER /end FUNCTION_LIST /end MEASUREMENT
/begin MEASUREMENT Twasser "Wassertemperatur" SWORD Def_t_sw_q0p01 0 0 -327.6800 327.6700 ECU_ADDRESS 0x007FC6E0 /begin FUNCTION_LIST LAYER /end FUNCTION_LIST /end MEASUREMENT
/begin MEASUREMENT U_fgen "kopierter Wert von zum Generator gesendeter Sollspannung Generator 1" UWORD Def_u_uw_q0p1 0 0 0.0 6553.5000 ECU_ADDRESS 0x007FC6E2 /begin FUNCTION_LIST LAYER /end FUNCTION_LIST /end MEASUREMENT
/begin MEASUREMENT U_gen_ext "physikalischer Wert Generatorsollspannung für Generator 1 vom Tester" UWORD Def_u_uw_q0p1 0 0 0.0 6553.5000 ECU_ADDRESS 0x007FC6E4 /begin FUNCTION_LIST LAYER /end FUNCTION_LIST /end MEASUREMENT
/begin MEASUREMENT U_gen_slp "Spannungsanforderung Sekundärluftpumpe" UWORD Def_u_uw_q0p1 0 0 0.0 6553.5000 ECU_ADDRESS 0x007FC6E6 /begin FUNCTION_LIST LAYER /end FUNCTION_LIST /end MEASUREMENT
/begin MEASUREMENT U_gensollpm "Sollwert Spannung vom Powermodul" SWORD Def_u_sw_b128 0 0 -128.0000 127.9960 ECU_ADDRESS 0x007FC6E8 /begin FUNCTION_LIST LAYER /end FUNCTION_LIST /end MEASUREMENT
/begin MEASUREMENT Ub "Bordnetzspannung" UWORD Def_u_uw_q0p0942 0 0 0.0 6173.3970 ECU_ADDRESS 0x007FC6EA /begin FUNCTION_LIST LAYER /end FUNCTION_LIST /end MEASUREMENT
/begin MEASUREMENT Uregnom "Nominalspannung Regler Generator 1" UWORD Def_u_uw_q0p1 0 0 0.0 6553.5000 ECU_ADDRESS 0x007FC6EC /begin FUNCTION_LIST LAYER /end FUNCTION_LIST /end MEASUREMENT
/begin MEASUREMENT V "Fahrzeuggeschwindigkeit" UWORD Def_v_uw_q1p0 0 0 0.0 360.0000 ECU_ADDRESS 0x007FC6EE /begin FUNCTION_LIST LAYER /end FUNCTION_LIST /end MEASUREMENT
/begin MEASUREMENT W_afs "Lenkradwinkel" SWORD Def_wdk_sw_q0p1 0 0 -3276.8000 3276.7000 ECU_ADDRESS 0x007FC6F0 /begin FUNCTION_LIST LAYER /end FUNCTION_LIST /end MEASUREMENT
/begin MEASUREMENT W_dafs "Geschwindigkeit Lenkradwinkel" SWORD Def_wdk_sw_q0p1 0 0 -3276.8000 3276.7000 ECU_ADDRESS 0x007FC6F2 /begin FUNCTION_LIST LAYER /end FUNCTION_LIST /end MEASUREMENT
/begin MEASUREMENT W_ub "ungefilterte Bordnetzspannung [0 .. 24,021 V]" UBYTE Def_u_ub_q0p0942 0 0 0.0 24.0210 ECU_ADDRESS 0x007FC6F4 /begin FUNCTION_LIST LAYER /end FUNCTION_LIST /end MEASUREMENT
/begin MEASUREMENT Wped "Pedalwertgeberposition" SWORD Def_tv_sw_q0p0244 0 0 -800.0000 799.9755 ECU_ADDRESS 0x007FC6F6 /begin FUNCTION_LIST LAYER /end FUNCTION_LIST /end MEASUREMENT
/begin MEASUREMENT Zrbosr "Servicezähler vom Kombi" UBYTE Def_dez_ub_q1 0 0 0.0 255.0000 ECU_ADDRESS 0x007FC6F8 /begin FUNCTION_LIST LAYER /end FUNCTION_LIST /end MEASUREMENT
/begin MEASUREMENT Zrbosrt "Servicezählerstand v. Tester" UBYTE Def_dez_ub_q1 0 0 0.0 255.0000 ECU_ADDRESS 0x007FC6F9 /begin FUNCTION_LIST LAYER /end FUNCTION_LIST /end MEASUREMENT
/begin MEASUREMENT Ztageabs "Tagezähler vom Kombi" UWORD Def_dez_uw_q1 0 0 0.0 65535.0000 ECU_ADDRESS 0x007FC6FA /begin FUNCTION_LIST LAYER /end FUNCTION_LIST /end MEASUREMENT
/begin MEASUREMENT St_agr.B_agrok "Bedingung Abgasrückführung ok" UBYTE Def_bit_ub_1 0 0 0.0 255.0 ECU_ADDRESS 0x007FC6FC /begin FUNCTION_LIST LAYER /end FUNCTION_LIST BIT_MASK 0x2 /end MEASUREMENT
/begin MEASUREMENT St_agr "Statusbyte agr" UBYTE Def_st_ub_q1 0 0 0.0 255.0000 ECU_ADDRESS 0x007FC6FC /begin FUNCTION_LIST LAYER /end FUNCTION_LIST /end MEASUREMENT
/begin MEASUREMENT St_bls.B_bls "Bedingung Bremslichtschalter" UBYTE Def_bit_ub_0 0 0 0.0 255.0 ECU_ADDRESS 0x007FC6FD /begin FUNCTION_LIST LAYER /end FUNCTION_LIST BIT_MASK 0x1 /end MEASUREMENT
/begin MEASUREMENT St_bls "Statuswort Bremslichtschalter" UBYTE Def_st_ub_q1 0 0 0.0 255.0000 ECU_ADDRESS 0x007FC6FD /begin FUNCTION_LIST LAYER /end FUNCTION_LIST /end MEASUREMENT
/begin MEASUREMENT St_ckl15.B_ckl30 "Bedingung Klemme R (über CAN)" UBYTE Def_bit_ub_1 0 0 0.0 255.0 ECU_ADDRESS 0x007FC6FE /begin FUNCTION_LIST LAYER /end FUNCTION_LIST BIT_MASK 0x2 /end MEASUREMENT
/begin MEASUREMENT St_ckl15.B_ckl50 "Bedingung Klemme 50 (über CAN)" UBYTE Def_bit_ub_0 0 0 0.0 255.0 ECU_ADDRESS 0x007FC6FE /begin FUNCTION_LIST LAYER /end FUNCTION_LIST BIT_MASK 0x1 /end MEASUREMENT
/begin MEASUREMENT St_ckl15 "Statusbyte Klemmensignale vom CAN" UBYTE Def_st_ub_q1 0 0 0.0 255.0000 ECU_ADDRESS 0x007FC6FE /begin FUNCTION_LIST LAYER /end FUNCTION_LIST /end MEASUREMENT
/begin MEASUREMENT St_egs.B_fs "Bedingung Fahrstufe" UBYTE Def_bit_ub_0 0 0 0.0 255.0 ECU_ADDRESS 0x007FC6FF /begin FUNCTION_LIST LAYER /end FUNCTION_LIST BIT_MASK 0x1 /end MEASUREMENT
/begin MEASUREMENT St_egs "Statusbyte Automatikgetriebe" UBYTE Def_st_ub_q1 0 0 0.0 255.0000 ECU_ADDRESS 0x007FC6FF /begin FUNCTION_LIST LAYER /end FUNCTION_LIST /end MEASUREMENT
/begin MEASUREMENT St_gen_ext.B_gen_ext "Bedingung Testeransteuerung Generator" UBYTE Def_bit_ub_0 0 0 0.0 255.0 ECU_ADDRESS 0x007FC700 /begin FUNCTION_LIST LAYER /end FUNCTION_LIST BIT_MASK 0x1 /end MEASUREMENT
/begin MEASUREMENT St_gen_ext.B_ierr_ext "Bedingung Anforderung Grenzerregerstrom vom Tester" UBYTE Def_bit_ub_2 0 0 0.0 255.0 ECU_ADDRESS 0x007FC700 /begin FUNCTION_LIST LAYER /end FUNCTION_LIST BIT_MASK 0x4 /end MEASUREMENT
/begin MEASUREMENT St_gen_ext.B_loadre_ext "Bedingung Anforderung Loadresponse vom Tester" UBYTE Def_bit_ub_1 0 0 0.0 255.0 ECU_ADDRESS 0x007FC700 /begin FUNCTION_LIST LAYER /end FUNCTION_LIST BIT_MASK 0x2 /end MEASUREMENT
/begin MEASUREMENT St_gen_ext "Statusbyte Generator extern" UBYTE Def_st_ub_q1 0 0 0.0 255.0000 ECU_ADDRESS 0x007FC700 /begin FUNCTION_LIST LAYER /end FUNCTION_LIST /end MEASUREMENT
/begin MEASUREMENT St_genallg.B_abliactiv "Bedingung Abblendlicht aktiv" UBYTE Def_bit_ub_1 0 0 0.0 255.0 ECU_ADDRESS 0x007FC701 /begin FUNCTION_LIST LAYER /end FUNCTION_LIST BIT_MASK 0x2 /end MEASUREMENT
/begin MEASUREMENT St_genallg.B_bsdprot1 "Bedingung BSD Protokollinhalt für BSD 1 Regler" UBYTE Def_bit_ub_3 0 0 0.0 255.0 ECU_ADDRESS 0x007FC701 /begin FUNCTION_LIST LAYER /end FUNCTION_LIST BIT_MASK 0x8 /end MEASUREMENT
/begin MEASUREMENT St_genallg.B_bsdprot2 "Bedingung BSD Protokollinhalt für BSD 2 Regler" UBYTE Def_bit_ub_4 0 0 0.0 255.0 ECU_ADDRESS 0x007FC701 /begin FUNCTION_LIST LAYER /end FUNCTION_LIST BIT_MASK 0x10 /end MEASUREMENT
/begin MEASUREMENT St_genallg.B_iliactiv "Bedingung Innenlicht aktiv" UBYTE Def_bit_ub_0 0 0 0.0 255.0 ECU_ADDRESS 0x007FC701 /begin FUNCTION_LIST LAYER /end FUNCTION_LIST BIT_MASK 0x1 /end MEASUREMENT
/begin MEASUREMENT St_genallg.B_rd_gentyp "Bedingung Schalter APK zum Auslesen Hersteller und Generatortyp" UBYTE Def_bit_ub_5 0 0 0.0 255.0 ECU_ADDRESS 0x007FC701 /begin FUNCTION_LIST LAYER /end FUNCTION_LIST BIT_MASK 0x20 /end MEASUREMENT
/begin MEASUREMENT St_genallg "Statusbyte Generator allgemein" UBYTE Def_st_ub_q1 0 0 0.0 255.0000 ECU_ADDRESS 0x007FC701 /begin FUNCTION_LIST LAYER /end FUNCTION_LIST /end MEASUREMENT
/begin MEASUREMENT St_generator.B_crashgen "Bedingung Generator abschalten bei Crash" UBYTE Def_bit_ub_6 0 0 0.0 255.0 ECU_ADDRESS 0x007FC702 /begin FUNCTION_LIST LAYER /end FUNCTION_LIST BIT_MASK 0x40 /end MEASUREMENT
/begin MEASUREMENT St_generator.B_genactiv "Bedingung Generatorinterface 1 aktiv" UBYTE Def_bit_ub_0 0 0 0.0 255.0 ECU_ADDRESS 0x007FC702 /begin FUNCTION_LIST LAYER /end FUNCTION_LIST BIT_MASK 0x1 /end MEASUREMENT
/begin MEASUREMENT St_generator.B_genfbsd "Bedingung Kommunikationsverlust BSD Generator 1" UBYTE Def_bit_ub_2 0 0 0.0 255.0 ECU_ADDRESS 0x007FC702 /begin FUNCTION_LIST LAYER /end FUNCTION_LIST BIT_MASK 0x4 /end MEASUREMENT
/begin MEASUREMENT St_generator.B_genfel "Bedingung Generatorfehler elektrisch Generator 1" UBYTE Def_bit_ub_3 0 0 0.0 255.0 ECU_ADDRESS 0x007FC702 /begin FUNCTION_LIST LAYER /end FUNCTION_LIST BIT_MASK 0x8 /end MEASUREMENT
/begin MEASUREMENT St_generator.B_genfht "Bedingung Generatorzustand hohe Temparatur Generator 1" UBYTE Def_bit_ub_4 0 0 0.0 255.0 ECU_ADDRESS 0x007FC702 /begin FUNCTION_LIST LAYER /end FUNCTION_LIST BIT_MASK 0x10 /end MEASUREMENT
/begin MEASUREMENT St_generator.B_genfme "Bedingung Generatorfehler mechanisch Generator 1" UBYTE Def_bit_ub_5 0 0 0.0 255.0 ECU_ADDRESS 0x007FC702 /begin FUNCTION_LIST LAYER /end FUNCTION_LIST BIT_MASK 0x20 /end MEASUREMENT
/begin MEASUREMENT St_generator "Statusbyte Generator" UBYTE Def_st_ub_q1 0 0 0.0 255.0000 ECU_ADDRESS 0x007FC702 /begin FUNCTION_LIST LAYER /end FUNCTION_LIST /end MEASUREMENT
/begin MEASUREMENT St_gengrenz.B_bnnio "Bedingung Bordnetzt n.i.o." UBYTE Def_bit_ub_2 0 0 0.0 255.0 ECU_ADDRESS 0x007FC703 /begin FUNCTION_LIST LAYER /end FUNCTION_LIST BIT_MASK 0x4 /end MEASUREMENT
/begin MEASUREMENT St_gengrenz "Statusbyte Gengrenz" UBYTE Def_st_ub_q1 0 0 0.0 255.0000 ECU_ADDRESS 0x007FC703 /begin FUNCTION_LIST LAYER /end FUNCTION_LIST /end MEASUREMENT
/begin MEASUREMENT St_genll.B_lrfoff "Bedingung Kopie Drehzahlschwelle für LR-Funktion Generator 1 aktiv" UBYTE Def_bit_ub_0 0 0 0.0 255.0 ECU_ADDRESS 0x007FC704 /begin FUNCTION_LIST LAYER /end FUNCTION_LIST BIT_MASK 0x1 /end MEASUREMENT
/begin MEASUREMENT St_genll.B_lrreg1ak "Bedingung LR-Register 1 aktiv Generator 1" UBYTE Def_bit_ub_2 0 0 0.0 255.0 ECU_ADDRESS 0x007FC704 /begin FUNCTION_LIST LAYER /end FUNCTION_LIST BIT_MASK 0x4 /end MEASUREMENT
/begin MEASUREMENT St_genll "Statusbyte LR-Eingänge Generator" UBYTE Def_st_ub_q1 0 0 0.0 255.0000 ECU_ADDRESS 0x007FC704 /begin FUNCTION_LIST LAYER /end FUNCTION_LIST /end MEASUREMENT
/begin MEASUREMENT St_getriebe.B_autget "Bedingung Automatikgetriebe verbaut" UBYTE Def_bit_ub_0 0 0 0.0 255.0 ECU_ADDRESS 0x007FC705 /begin FUNCTION_LIST LAYER /end FUNCTION_LIST BIT_MASK 0x1 /end MEASUREMENT
/begin MEASUREMENT St_getriebe "Statuswort Getriebe" UBYTE Def_st_ub_q1 0 0 0.0 255.0000 ECU_ADDRESS 0x007FC705 /begin FUNCTION_LIST LAYER /end FUNCTION_LIST /end MEASUREMENT
/begin MEASUREMENT St_imdgen_1s.B_genhtkrit "Diodentemperatur im kritischen Bereich" UBYTE Def_bit_ub_1 0 0 0.0 255.0 ECU_ADDRESS 0x007FC706 /begin FUNCTION_LIST LAYER /end FUNCTION_LIST BIT_MASK 0x2 /end MEASUREMENT
/begin MEASUREMENT St_imdgen_1s.B_tdiodekrit "Generatormoment enable/disable" UBYTE Def_bit_ub_3 0 0 0.0 255.0 ECU_ADDRESS 0x007FC706 /begin FUNCTION_LIST LAYER /end FUNCTION_LIST BIT_MASK 0x8 /end MEASUREMENT
/begin MEASUREMENT St_imdgen_1s "Statusbyte imdgen_1s" UBYTE Def_st_ub_q1 0 0 0.0 255.0000 ECU_ADDRESS 0x007FC706 /begin FUNCTION_LIST LAYER /end FUNCTION_LIST /end MEASUREMENT
/begin MEASUREMENT St_kl15.B_kl15_ep "Bedingung Kl. 15 gesetzt" UBYTE Def_bit_ub_0 0 0 0.0 255.0 ECU_ADDRESS 0x007FC707 /begin FUNCTION_LIST LAYER /end FUNCTION_LIST BIT_MASK 0x1 /end MEASUREMENT
/begin MEASUREMENT St_kl15 "Statusbyte Klemme 15" UBYTE Def_st_ub_q1 0 0 0.0 255.0000 ECU_ADDRESS 0x007FC707 /begin FUNCTION_LIST LAYER /end FUNCTION_LIST /end MEASUREMENT
/begin MEASUREMENT St_llr.B_llrein "Bedingung Leerlaufregler ist aktiv" UWORD Def_bit_uw_0 0 0 0.0 65535.0 ECU_ADDRESS 0x007FC708 /begin FUNCTION_LIST LAYER /end FUNCTION_LIST BIT_MASK 0x1 /end MEASUREMENT
/begin MEASUREMENT St_llr "Statusword Leerlaufregler" UWORD Def_st_uw_q1 0 0 0.0 65535.0000 ECU_ADDRESS 0x007FC708 /begin FUNCTION_LIST LAYER /end FUNCTION_LIST /end MEASUREMENT
/begin MEASUREMENT St_lsu.B_lsuakt "Bedingung Lambdasonde betriebsbereit" UBYTE Def_bit_ub_1 0 0 0.0 255.0 ECU_ADDRESS 0x007FC70A /begin FUNCTION_LIST LAYER /end FUNCTION_LIST BIT_MASK 0x2 /end MEASUREMENT
/begin MEASUREMENT St_lsu "Statusbyte lsu" UBYTE Def_st_ub_q1 0 0 0.0 255.0000 ECU_ADDRESS 0x007FC70A /begin FUNCTION_LIST LAYER /end FUNCTION_LIST /end MEASUREMENT
/begin MEASUREMENT St_master.B_masterhw "Bedingung Master-SG" UBYTE Def_bit_ub_0 0 0 0.0 255.0 ECU_ADDRESS 0x007FC70B /begin FUNCTION_LIST LAYER /end FUNCTION_LIST BIT_MASK 0x1 /end MEASUREMENT
/begin MEASUREMENT St_master "Statusbyte Master" UBYTE Def_st_ub_q1 0 0 0.0 255.0000 ECU_ADDRESS 0x007FC70B /begin FUNCTION_LIST LAYER /end FUNCTION_LIST /end MEASUREMENT
/begin MEASUREMENT St_mdaddon.B_mdao_pwg "Momentenerhöhung durch den Pedalwertgeber" UBYTE Def_bit_ub_0 0 0 0.0 255.0 ECU_ADDRESS 0x007FC70C /begin FUNCTION_LIST LAYER /end FUNCTION_LIST BIT_MASK 0x1 /end MEASUREMENT
/begin MEASUREMENT St_mdaddon.B_mdao_v "Momentenerhöhung durch die Fahrgeschwindigkeit" UBYTE Def_bit_ub_1 0 0 0.0 255.0 ECU_ADDRESS 0x007FC70C /begin FUNCTION_LIST LAYER /end FUNCTION_LIST BIT_MASK 0x2 /end MEASUREMENT
/begin MEASUREMENT St_mdaddon.B_mdao_nkw "Momentenerhöhung durch die Motordrehzahl" UBYTE Def_bit_ub_2 0 0 0.0 255.0 ECU_ADDRESS 0x007FC70C /begin FUNCTION_LIST LAYER /end FUNCTION_LIST BIT_MASK 0x4 /end MEASUREMENT
/begin MEASUREMENT St_mdaddon.B_mdao_dnkw "Momentenerhöhung durch den Gradient der Motordrehzahl" UBYTE Def_bit_ub_3 0 0 0.0 255.0 ECU_ADDRESS 0x007FC70C /begin FUNCTION_LIST LAYER /end FUNCTION_LIST BIT_MASK 0x8 /end MEASUREMENT
/begin MEASUREMENT St_mdaddon.B_mdao_bls "Momentenerhöhung durch das Bremspedal" UBYTE Def_bit_ub_4 0 0 0.0 255.0 ECU_ADDRESS 0x007FC70C /begin FUNCTION_LIST LAYER /end FUNCTION_LIST BIT_MASK 0x10 /end MEASUREMENT
/begin MEASUREMENT St_mdaddon.B_mdao_timer "Bedingung B_mdao_timer == true, dann keine Erhöhung möglich" UBYTE Def_bit_ub_5 0 0 0.0 255.0 ECU_ADDRESS 0x007FC70C /begin FUNCTION_LIST LAYER /end FUNCTION_LIST BIT_MASK 0x20 /end MEASUREMENT
/begin MEASUREMENT St_mdaddon.B_mdao_all "Bedingung B_mdao_all == true, dann Erhöhung möglich (Bits 0-4 gesetzt)" UBYTE Def_bit_ub_6 0 0 0.0 255.0 ECU_ADDRESS 0x007FC70C /begin FUNCTION_LIST LAYER /end FUNCTION_LIST BIT_MASK 0x40 /end MEASUREMENT
/begin MEASUREMENT St_mdaddon.B_mdao_aktiv "Bedingung B_mdao_aktiv == true, dann Erhöhung aktiv" UBYTE Def_bit_ub_7 0 0 0.0 255.0 ECU_ADDRESS 0x007FC70C /begin FUNCTION_LIST LAYER /end FUNCTION_LIST BIT_MASK 0x80 /end MEASUREMENT
/begin MEASUREMENT St_mdaddon "vorübergehende additive Momenterhöhung des Bergrenzungsmomentes" UBYTE Def_st_ub_q1 0 0 0.0 255.0000 ECU_ADDRESS 0x007FC70C /begin FUNCTION_LIST LAYER /end FUNCTION_LIST /end MEASUREMENT
/begin MEASUREMENT St_mdna.B_lastab "Bedingung Lastabwurf" UBYTE Def_bit_ub_0 0 0 0.0 255.0 ECU_ADDRESS 0x007FC70D /begin FUNCTION_LIST LAYER /end FUNCTION_LIST BIT_MASK 0x1 /end MEASUREMENT
/begin MEASUREMENT St_mdna "Statusbyte Momentenaufnahme der Nebenaggregate" UBYTE Def_st_ub_q1 0 0 0.0 255.0000 ECU_ADDRESS 0x007FC70D /begin FUNCTION_LIST LAYER /end FUNCTION_LIST /end MEASUREMENT
/begin MEASUREMENT St_mkwchn.B_kwdreht "Bedingung drehende Kurbelwelle erkannt" UBYTE Def_bit_ub_5 0 0 0.0 255.0 ECU_ADDRESS 0x007FC70E /begin FUNCTION_LIST LAYER /end FUNCTION_LIST BIT_MASK 0x20 /end MEASUREMENT
/begin MEASUREMENT St_mkwchn "Statusbyte Masterkurbelwelle" UBYTE Def_st_ub_q1 0 0 0.0 255.0000 ECU_ADDRESS 0x007FC70E /begin FUNCTION_LIST LAYER /end FUNCTION_LIST /end MEASUREMENT
/begin MEASUREMENT St_motzustd.B_ll "Bedingung Leerlauf" UWORD Def_bit_uw_3 0 0 0.0 65535.0 ECU_ADDRESS 0x007FC710 /begin FUNCTION_LIST LAYER /end FUNCTION_LIST BIT_MASK 0x8 /end MEASUREMENT
/begin MEASUREMENT St_motzustd.B_vl "Bedingung Volllast" UWORD Def_bit_uw_5 0 0 0.0 65535.0 ECU_ADDRESS 0x007FC710 /begin FUNCTION_LIST LAYER /end FUNCTION_LIST BIT_MASK 0x20 /end MEASUREMENT
/begin MEASUREMENT St_motzustd "Statuswort Motorzustand" UWORD Def_st_uw_q1 0 0 0.0 65535.0000 ECU_ADDRESS 0x007FC710 /begin FUNCTION_LIST LAYER /end FUNCTION_LIST /end MEASUREMENT
/begin MEASUREMENT St_oz.B_anhang "Bedingung Anhänger erkannt" UBYTE Def_bit_ub_0 0 0 0.0 255.0 ECU_ADDRESS 0x007FC712 /begin FUNCTION_LIST LAYER /end FUNCTION_LIST BIT_MASK 0x1 /end MEASUREMENT
/begin MEASUREMENT St_oz.B_ozfbsd "Bedingung Fehler BSD-Kommunikation" UBYTE Def_bit_ub_1 0 0 0.0 255.0 ECU_ADDRESS 0x007FC712 /begin FUNCTION_LIST LAYER /end FUNCTION_LIST BIT_MASK 0x2 /end MEASUREMENT
/begin MEASUREMENT St_oz.B_ozdieselein "Oz_dieselein ist plausibel" UBYTE Def_bit_ub_2 0 0 0.0 255.0 ECU_ADDRESS 0x007FC712 /begin FUNCTION_LIST LAYER /end FUNCTION_LIST BIT_MASK 0x4 /end MEASUREMENT
/begin MEASUREMENT St_oz "Statuswort Eingangsgröáen Ölzustandssensor" UBYTE Def_dez_ub_q1 0 0 0.0 255.0000 ECU_ADDRESS 0x007FC712 /begin FUNCTION_LIST LAYER /end FUNCTION_LIST /end MEASUREMENT
/begin MEASUREMENT St_oz_i.B_td_og "Bedingung Abkühlzeit gültig" UBYTE Def_bit_ub_0 0 0 0.0 255.0 ECU_ADDRESS 0x007FC713 /begin FUNCTION_LIST LAYER /end FUNCTION_LIST BIT_MASK 0x1 /end MEASUREMENT
/begin MEASUREMENT St_oz_i.B_td_ogok "Bedingung State-Machine 1x gültig gerechnet" UBYTE Def_bit_ub_4 0 0 0.0 255.0 ECU_ADDRESS 0x007FC713 /begin FUNCTION_LIST LAYER /end FUNCTION_LIST BIT_MASK 0x10 /end MEASUREMENT
/begin MEASUREMENT St_oz_i.B_toel "Bedingung tr und tv gültig" UBYTE Def_bit_ub_1 0 0 0.0 255.0 ECU_ADDRESS 0x007FC713 /begin FUNCTION_LIST LAYER /end FUNCTION_LIST BIT_MASK 0x2 /end MEASUREMENT
/begin MEASUREMENT St_oz_i "Statusbyte für Eingang OZ" UBYTE Def_dez_ub_q1 0 0 0.0 255.0000 ECU_ADDRESS 0x007FC713 /begin FUNCTION_LIST LAYER /end FUNCTION_LIST /end MEASUREMENT
/begin MEASUREMENT St_pld.B_pldrk "Bedingung Ladedruckregelklappe" UBYTE Def_bit_ub_2 0 0 0.0 255.0 ECU_ADDRESS 0x007FC714 /begin FUNCTION_LIST LAYER /end FUNCTION_LIST BIT_MASK 0x4 /end MEASUREMENT
/begin MEASUREMENT St_pld.B_pldok "Bedingung Ladedruckregelung ok" UBYTE Def_bit_ub_1 0 0 0.0 255.0 ECU_ADDRESS 0x007FC714 /begin FUNCTION_LIST LAYER /end FUNCTION_LIST BIT_MASK 0x2 /end MEASUREMENT
/begin MEASUREMENT St_pld "Statusbyte pld" UBYTE Def_st_ub_q1 0 0 0.0 255.0000 ECU_ADDRESS 0x007FC714 /begin FUNCTION_LIST LAYER /end FUNCTION_LIST /end MEASUREMENT
/begin MEASUREMENT St_pmi.B_fabttreg "Bedingung Batterietausch registrieren" UBYTE Def_bit_ub_1 0 0 0.0 255.0 ECU_ADDRESS 0x007FC715 /begin FUNCTION_LIST LAYER /end FUNCTION_LIST BIT_MASK 0x2 /end MEASUREMENT
/begin MEASUREMENT St_pmi.B_fahisrst "Bedingung Histogrammreset" UBYTE Def_bit_ub_2 0 0 0.0 255.0 ECU_ADDRESS 0x007FC715 /begin FUNCTION_LIST LAYER /end FUNCTION_LIST BIT_MASK 0x4 /end MEASUREMENT
/begin MEASUREMENT St_pmi "Statusbyte LCP-Eingänge" UBYTE Def_st_ub_q1 0 0 0.0 255.0000 ECU_ADDRESS 0x007FC715 /begin FUNCTION_LIST LAYER /end FUNCTION_LIST /end MEASUREMENT
/begin MEASUREMENT St_pwf.B_pwf "Bedingung Powerfail" UBYTE Def_bit_ub_0 0 0 0.0 255.0 ECU_ADDRESS 0x007FC716 /begin FUNCTION_LIST LAYER /end FUNCTION_LIST BIT_MASK 0x1 /end MEASUREMENT
/begin MEASUREMENT St_pwf "Statusbyte Powerfail" UBYTE Def_st_ub_q1 0 0 0.0 255.0000 ECU_ADDRESS 0x007FC716 /begin FUNCTION_LIST LAYER /end FUNCTION_LIST /end MEASUREMENT
/begin MEASUREMENT St_sawe.B_sa "Bedingung Schubabschaltung" UBYTE Def_bit_ub_3 0 0 0.0 255.0 ECU_ADDRESS 0x007FC717 /begin FUNCTION_LIST LAYER /end FUNCTION_LIST BIT_MASK 0x8 /end MEASUREMENT
/begin MEASUREMENT St_sawe "Statusbyte Schubabschaltung(Wiedereinsetzen" UBYTE Def_st_ub_q1 0 0 0.0 255.0000 ECU_ADDRESS 0x007FC717 /begin FUNCTION_LIST LAYER /end FUNCTION_LIST /end MEASUREMENT
/begin MEASUREMENT St_slp.B_genslp "Bedingung Spannungsanforderung Sekundärluftpumpe" UBYTE Def_bit_ub_2 0 0 0.0 255.0 ECU_ADDRESS 0x007FC718 /begin FUNCTION_LIST LAYER /end FUNCTION_LIST BIT_MASK 0x4 /end MEASUREMENT
/begin MEASUREMENT St_slp "Statusbyte Sekundärluftpumpe" UBYTE Def_st_ub_q1 0 0 0.0 255.0000 ECU_ADDRESS 0x007FC718 /begin FUNCTION_LIST LAYER /end FUNCTION_LIST /end MEASUREMENT
/begin MEASUREMENT St_sls.B_sls "Bedingung Sekundärluftsystem aktiv" UBYTE Def_bit_ub_0 0 0 0.0 255.0 ECU_ADDRESS 0x007FC719 /begin FUNCTION_LIST LAYER /end FUNCTION_LIST BIT_MASK 0x1 /end MEASUREMENT
/begin MEASUREMENT St_sls "Statuswort Sekundärluftsystem" UBYTE Def_st_ub_q1 0 0 0.0 255.0000 ECU_ADDRESS 0x007FC719 /begin FUNCTION_LIST LAYER /end FUNCTION_LIST /end MEASUREMENT
/begin MEASUREMENT St_tan.B_taners "Bedingung Ansaugluft auf Ersatzwert" UBYTE Def_bit_ub_0 0 0 0.0 255.0 ECU_ADDRESS 0x007FC71A /begin FUNCTION_LIST LAYER /end FUNCTION_LIST BIT_MASK 0x1 /end MEASUREMENT
/begin MEASUREMENT St_tan "Statusbyte Bedingung für Startwertberechnung" UBYTE Def_st_ub_q1 0 0 0.0 255.0000 ECU_ADDRESS 0x007FC71A /begin FUNCTION_LIST LAYER /end FUNCTION_LIST /end MEASUREMENT
/begin MEASUREMENT St_tum.B_tumers "Bedingung Umgebungstemperaturersatzwert" UBYTE Def_bit_ub_0 0 0 0.0 255.0 ECU_ADDRESS 0x007FC71B /begin FUNCTION_LIST LAYER /end FUNCTION_LIST BIT_MASK 0x1 /end MEASUREMENT
/begin MEASUREMENT St_tum "Statusbyte Umgebungstemperatur" UBYTE Def_st_ub_q1 0 0 0.0 255.0000 ECU_ADDRESS 0x007FC71B /begin FUNCTION_LIST LAYER /end FUNCTION_LIST /end MEASUREMENT
/begin MEASUREMENT St_zwktibs.B_ibsactiv "Bedingung Kommunikation IBS vorhanden" UBYTE Def_bit_ub_0 0 0 0.0 255.0 ECU_ADDRESS 0x007FC71C /begin FUNCTION_LIST LAYER /end FUNCTION_LIST BIT_MASK 0x1 /end MEASUREMENT
/begin MEASUREMENT St_zwktibs "Statusbyte Zwktibs" UBYTE Def_st_ub_q1 0 0 0.0 255.0000 ECU_ADDRESS 0x007FC71C /begin FUNCTION_LIST LAYER /end FUNCTION_LIST /end MEASUREMENT
/begin MEASUREMENT Batt_class "Klassifizierung der in diesem Fzg. eingebauten Batterie" UBYTE Def_dez_ub_q1 0 0 0.0 255.0000 ECU_ADDRESS 0x008005B0 /begin FUNCTION_LIST LAYER /end FUNCTION_LIST /end MEASUREMENT
/begin MEASUREMENT Bosfxid2r "ID_Funktion_BOS_Rückstellung_2" UWORD Def_dez_uw_q1 0 0 0.0 65535.0000 ECU_ADDRESS 0x008005B2 /begin FUNCTION_LIST LAYER /end FUNCTION_LIST /end MEASUREMENT
/begin MEASUREMENT Bosid2r "ID_2_BOS_Rückstellung_2" UBYTE Def_dez_ub_q1 0 0 0.0 255.0000 ECU_ADDRESS 0x008005B4 /begin FUNCTION_LIST LAYER /end FUNCTION_LIST /end MEASUREMENT
/begin MEASUREMENT Bosjzielr "Zieltermin_Jahr_BOS_Rückstellung_2" UBYTE Def_dez_ub_q1 0 0 0.0 255.0000 ECU_ADDRESS 0x008005B5 /begin FUNCTION_LIST LAYER /end FUNCTION_LIST /end MEASUREMENT
/begin MEASUREMENT Bosmzielr "Zieltermin_Monat_BOS_Rückstellung_2" UBYTE Def_dez_ub_q1 0 0 0.0 255.0000 ECU_ADDRESS 0x008005B6 /begin FUNCTION_LIST LAYER /end FUNCTION_LIST /end MEASUREMENT
/begin MEASUREMENT Bosprog2r "Prognose_Intervall_Zeit_BOS_Rückstellung_2" UBYTE Def_dez_ub_q1 0 0 0.0 255.0000 ECU_ADDRESS 0x008005B7 /begin FUNCTION_LIST LAYER /end FUNCTION_LIST /end MEASUREMENT
/begin MEASUREMENT Bosrw2r "Prognose_Intervall_Weg_BOS_Rückstellung_2" UBYTE Def_km_ub_q1000 0 0 0.0 255000.0000 ECU_ADDRESS 0x008005B8 /begin FUNCTION_LIST LAYER /end FUNCTION_LIST /end MEASUREMENT
/begin MEASUREMENT Ikurz_ogr "obere Grenze Kurzschlussstrom vom CAS" UBYTE Def_i_ub_q10 0 0 0.0 2550.0000 ECU_ADDRESS 0x008005B9 /begin FUNCTION_LIST LAYER /end FUNCTION_LIST /end MEASUREMENT
/begin MEASUREMENT Ikurz_ugr "untere Grenze Kurzschlussstrom vom CAS" UBYTE Def_i_ub_q10 0 0 0.0 2550.0000 ECU_ADDRESS 0x008005BA /begin FUNCTION_LIST LAYER /end FUNCTION_LIST /end MEASUREMENT
/begin MEASUREMENT Iwakeupgr "Fahrzeugspezifischer Ruhestrom" UBYTE Def_i_ub_q0p001 0 0 0.0 0.2550 ECU_ADDRESS 0x008005BB /begin FUNCTION_LIST LAYER /end FUNCTION_LIST /end MEASUREMENT
/begin MEASUREMENT Km_st_1 "Wegstrecke_km auf 1km genau" ULONG Def_dez_ul_q1 0 0 0.0 2147483647.0000 ECU_ADDRESS 0x008005BC /begin FUNCTION_LIST LAYER /end FUNCTION_LIST /end MEASUREMENT
/begin MEASUREMENT Oz_lf1c "Länderfaktor 1 codiert" UBYTE Def_lf_ub_q0p01 0 0 0.0 2.5500 ECU_ADDRESS 0x008005C0 /begin FUNCTION_LIST LAYER /end FUNCTION_LIST /end MEASUREMENT
/begin MEASUREMENT Oz_lf2c "Länderfaktor 2 codiert" UBYTE Def_lf_ub_q0p01 0 0 0.0 2.5500 ECU_ADDRESS 0x008005C1 /begin FUNCTION_LIST LAYER /end FUNCTION_LIST /end MEASUREMENT
/begin MEASUREMENT Pmsv "angemeldete Powermanagment Standverbraucher" UBYTE Def_dez_ub_q1 0 0 0.0 255.0000 ECU_ADDRESS 0x008005C4 ARRAY_SIZE 15 /begin FUNCTION_LIST LAYER /end FUNCTION_LIST /end MEASUREMENT
/begin MEASUREMENT Tmot_abstell "Motorabstelltemperatur" SWORD Def_t_sw_q0p01 0 0 -327.6800 327.6700 ECU_ADDRESS 0x008005D4 /begin FUNCTION_LIST LAYER /end FUNCTION_LIST /end MEASUREMENT
/begin MEASUREMENT Tn_abstellm "Abstellzeit in Minuten" UWORD Def_tn_uw_q1 0 0 0.0 65535.0000 ECU_ADDRESS 0x008005D6 /begin FUNCTION_LIST LAYER /end FUNCTION_LIST /end MEASUREMENT
/begin MEASUREMENT St_devxdetec.B_dev0detec "BSD Dev. 0 gelernt" UBYTE Def_bit_ub_0 0 0 0.0 255.0 ECU_ADDRESS 0x008005D8 /begin FUNCTION_LIST LAYER /end FUNCTION_LIST BIT_MASK 0x1 /end MEASUREMENT
/begin MEASUREMENT St_devxdetec.B_dev1detec "BSD Dev. 1 gelernt" UBYTE Def_bit_ub_1 0 0 0.0 255.0 ECU_ADDRESS 0x008005D8 /begin FUNCTION_LIST LAYER /end FUNCTION_LIST BIT_MASK 0x2 /end MEASUREMENT
/begin MEASUREMENT St_devxdetec.B_dev2detec "BSD Dev. 2 gelernt" UBYTE Def_bit_ub_2 0 0 0.0 255.0 ECU_ADDRESS 0x008005D8 /begin FUNCTION_LIST LAYER /end FUNCTION_LIST BIT_MASK 0x4 /end MEASUREMENT
/begin MEASUREMENT St_devxdetec.B_dev3detec "BSD Dev. 3 gelernt" UBYTE Def_bit_ub_3 0 0 0.0 255.0 ECU_ADDRESS 0x008005D8 /begin FUNCTION_LIST LAYER /end FUNCTION_LIST BIT_MASK 0x8 /end MEASUREMENT
/begin MEASUREMENT St_devxdetec.B_dev4detec "BSD Dev. 4 gelernt" UBYTE Def_bit_ub_4 0 0 0.0 255.0 ECU_ADDRESS 0x008005D8 /begin FUNCTION_LIST LAYER /end FUNCTION_LIST BIT_MASK 0x10 /end MEASUREMENT
/begin MEASUREMENT St_devxdetec.B_dev5detec "BSD Dev. 5 gelernt" UBYTE Def_bit_ub_5 0 0 0.0 255.0 ECU_ADDRESS 0x008005D8 /begin FUNCTION_LIST LAYER /end FUNCTION_LIST BIT_MASK 0x20 /end MEASUREMENT
/begin MEASUREMENT St_devxdetec.B_dev6detec "BSD Dev. 6 gelernt" UBYTE Def_bit_ub_6 0 0 0.0 255.0 ECU_ADDRESS 0x008005D8 /begin FUNCTION_LIST LAYER /end FUNCTION_LIST BIT_MASK 0x40 /end MEASUREMENT
/begin MEASUREMENT St_devxdetec.B_dev7detec "BSD Dev. 7 gelernt" UBYTE Def_bit_ub_7 0 0 0.0 255.0 ECU_ADDRESS 0x008005D8 /begin FUNCTION_LIST LAYER /end FUNCTION_LIST BIT_MASK 0x80 /end MEASUREMENT
/begin MEASUREMENT St_devxdetec "Ergebnis BSD-Lernfunktion" UBYTE Def_dez_ub_q1 0 0 0.0 255.0000 ECU_ADDRESS 0x008005D8 /begin FUNCTION_LIST LAYER /end FUNCTION_LIST /end MEASUREMENT
/begin MEASUREMENT St_elu.B_elu600 "Bedingung Elüftertyp" UBYTE Def_bit_ub_0 0 0 0.0 255.0 ECU_ADDRESS 0x008005D9 /begin FUNCTION_LIST LAYER /end FUNCTION_LIST BIT_MASK 0x1 /end MEASUREMENT
/begin MEASUREMENT St_elu "Statusbyte Elüfter" UBYTE Def_st_ub_q1 0 0 0.0 255.0000 ECU_ADDRESS 0x008005D9 /begin FUNCTION_LIST LAYER /end FUNCTION_LIST /end MEASUREMENT
/begin MEASUREMENT St_ibs.B_ibsdetec "Bedingung IBS erkannt" UBYTE Def_bit_ub_0 0 0 0.0 255.0 ECU_ADDRESS 0x008005DA /begin FUNCTION_LIST LAYER /end FUNCTION_LIST BIT_MASK 0x1 /end MEASUREMENT
/begin MEASUREMENT St_ibs "Statusbyte IBS" UBYTE Def_st_ub_q1 0 0 0.0 255.0000 ECU_ADDRESS 0x008005DA /begin FUNCTION_LIST LAYER /end FUNCTION_LIST /end MEASUREMENT
/begin MEASUREMENT St_pmbnstab.B_nachlend "Bedingung Nachlauf beendet" UBYTE Def_bit_ub_0 0 0 0.0 255.0 ECU_ADDRESS 0x008005DB /begin FUNCTION_LIST LAYER /end FUNCTION_LIST BIT_MASK 0x1 /end MEASUREMENT
/begin MEASUREMENT St_pmbnstab "Statusbyte Bordnetzstabilität" UBYTE Def_st_ub_q1 0 0 0.0 255.0000 ECU_ADDRESS 0x008005DB /begin FUNCTION_LIST LAYER /end FUNCTION_LIST /end MEASUREMENT
/begin MEASUREMENT St_pmi_nv.B_fapmmess "Bedingung Messmethode PM" UBYTE Def_bit_ub_0 0 0 0.0 255.0 ECU_ADDRESS 0x008005DC /begin FUNCTION_LIST LAYER /end FUNCTION_LIST BIT_MASK 0x1 /end MEASUREMENT
/begin MEASUREMENT St_pmi_nv.B_ulcp "Bedingung ULCP aktiv" UBYTE Def_bit_ub_1 0 0 0.0 255.0 ECU_ADDRESS 0x008005DC /begin FUNCTION_LIST LAYER /end FUNCTION_LIST BIT_MASK 0x2 /end MEASUREMENT
/begin MEASUREMENT St_pmi_nv "Statusbyte LCP-Eingänge nv" UBYTE Def_st_ub_q1 0 0 0.0 255.0000 ECU_ADDRESS 0x008005DC /begin FUNCTION_LIST LAYER /end FUNCTION_LIST /end MEASUREMENT
/begin MEASUREMENT St_start.B_sta "Bedingung Automatikstart" UBYTE Def_bit_ub_7 0 0 0.0 255.0 ECU_ADDRESS 0x008005DD /begin FUNCTION_LIST LAYER /end FUNCTION_LIST BIT_MASK 0x80 /end MEASUREMENT
/begin MEASUREMENT St_start.B_startende "Bedingung Startende" UBYTE Def_bit_ub_3 0 0 0.0 255.0 ECU_ADDRESS 0x008005DD /begin FUNCTION_LIST LAYER /end FUNCTION_LIST BIT_MASK 0x8 /end MEASUREMENT
/begin MEASUREMENT St_start "Statusbyte Start" UBYTE Def_st_ub_q1 0 0 0.0 255.0000 ECU_ADDRESS 0x008005DD /begin FUNCTION_LIST LAYER /end FUNCTION_LIST /end MEASUREMENT
/begin MEASUREMENT St_lbattcal0.B_lbatteinih "Ende Initialisierungsphase Lbattcal Batterie hinten" UBYTE Def_bit_ub_0 0 0 0.0 255.0 ECU_ADDRESS 0x007FF03E /begin FUNCTION_LIST LBATTCAL /end FUNCTION_LIST BIT_MASK 0x1 /end MEASUREMENT
/begin MEASUREMENT St_lbattcal0.B_lbatteiniv "Ende Initialisierungsphase Lbattcal Batterie vorne" UBYTE Def_bit_ub_1 0 0 0.0 255.0 ECU_ADDRESS 0x007FF03E /begin FUNCTION_LIST LBATTCAL /end FUNCTION_LIST BIT_MASK 0x2 /end MEASUREMENT
/begin MEASUREMENT St_lbattcal0.B_lbattenh "Enable Batterie hinten" UBYTE Def_bit_ub_2 0 0 0.0 255.0 ECU_ADDRESS 0x007FF03E /begin FUNCTION_LIST LBATTCAL /end FUNCTION_LIST BIT_MASK 0x4 /end MEASUREMENT
/begin MEASUREMENT St_lbattcal0.B_lbattenv "Enable Batterie vorne" UBYTE Def_bit_ub_3 0 0 0.0 255.0 ECU_ADDRESS 0x007FF03E /begin FUNCTION_LIST LBATTCAL /end FUNCTION_LIST BIT_MASK 0x8 /end MEASUREMENT
/begin MEASUREMENT St_lbattcal0.B_lbattinit "Initialisierung LBATTCAL beendet" UBYTE Def_bit_ub_4 0 0 0.0 255.0 ECU_ADDRESS 0x007FF03E /begin FUNCTION_LIST LBATTCAL /end FUNCTION_LIST BIT_MASK 0x10 /end MEASUREMENT
/begin MEASUREMENT St_lbattcal0.B_dly_tbi "Bedingung für Startwertberechnung" UBYTE Def_bit_ub_5 0 0 0.0 255.0 ECU_ADDRESS 0x007FF03E /begin FUNCTION_LIST LBATTCAL /end FUNCTION_LIST BIT_MASK 0x20 /end MEASUREMENT
/begin MEASUREMENT St_lbattcal0 "Statuswort" UBYTE Def_st_ub_q1 0 0 0.0 255.0000 ECU_ADDRESS 0x007FF03E /begin FUNCTION_LIST LBATTCAL /end FUNCTION_LIST /end MEASUREMENT
/begin MEASUREMENT U_kompk "Zwischengröße" SWORD Def_u_sw_b128 0 0 0.0 127.9960 ECU_ADDRESS 0x008005DE /begin FUNCTION_LIST LBATTCAL /end FUNCTION_LIST /end MEASUREMENT
/begin MEASUREMENT U_kompm "Zwischengröße" SWORD Def_u_sw_b128 0 0 0.0 127.9960 ECU_ADDRESS 0x008005E0 /begin FUNCTION_LIST LBATTCAL /end FUNCTION_LIST /end MEASUREMENT
/begin MEASUREMENT U_lade "Zwischengröße" SWORD Def_u_sw_b128 0 0 0.0 127.9960 ECU_ADDRESS 0x008005E2 /begin FUNCTION_LIST LBATTCAL /end FUNCTION_LIST /end MEASUREMENT
/begin MEASUREMENT T_batt_lb "Batterietemperatur" SWORD Def_t_sw_q0p1 0 0 -3276.8000 3276.7000 ECU_ADDRESS 0x008005E8 /begin FUNCTION_LIST LBATTCAL /end FUNCTION_LIST /end MEASUREMENT
/begin MEASUREMENT Tumg_ers "Aussentemperatur oder Ersatzwert" SWORD Def_t_sw_q0p1 0 0 -3276.8000 3276.7000 ECU_ADDRESS 0x008005EA /begin FUNCTION_LIST LBATTCAL /end FUNCTION_LIST /end MEASUREMENT
/begin MEASUREMENT U_gensollm "Generatorsollspannung" SWORD Def_u_sw_b128 0 0 -128.0000 127.9960 ECU_ADDRESS 0x008005EC /begin FUNCTION_LIST LBATTCAL /end FUNCTION_LIST /end MEASUREMENT
/begin MEASUREMENT T_battabst "Batterieabstelltemperatur" SWORD Def_t_sw_q0p1 0 0 -3276.8000 3276.7000 ECU_ADDRESS 0x00800600 /begin FUNCTION_LIST LBATTCAL /end FUNCTION_LIST /end MEASUREMENT
/begin MEASUREMENT Tumg_abst "Abstell-Aussentemperatur" SWORD Def_t_sw_q0p1 0 0 -3276.8000 3276.7000 ECU_ADDRESS 0x00800602 /begin FUNCTION_LIST LBATTCAL /end FUNCTION_LIST /end MEASUREMENT
/begin MEASUREMENT Tumg_battab "Abstell-Umgebungstemperatur Batterie" SWORD Def_t_sw_q0p1 0 0 -3276.8000 3276.7000 ECU_ADDRESS 0x00800604 /begin FUNCTION_LIST LBATTCAL /end FUNCTION_LIST /end MEASUREMENT
/begin MEASUREMENT T_batstiniv "Starttemperatur Batterie vorne" SWORD Def_t_sw_q0p1 0 0 -3276.8000 3276.7000 ECU_ADDRESS 0x008005EE /begin FUNCTION_LIST LBATTCAL /end FUNCTION_LIST /end MEASUREMENT
/begin MEASUREMENT T_batt_ini "Startwert Batterietemperatur" SWORD Def_t_sw_q0p1 0 0 -3276.8000 3276.7000 ECU_ADDRESS 0x008005F0 /begin FUNCTION_LIST LBATTCAL /end FUNCTION_LIST /end MEASUREMENT
/begin MEASUREMENT T_batt_zw "Temporäre Batterietemperatur" SWORD Def_t_sw_q0p1 0 0 -3276.8000 3276.7000 ECU_ADDRESS 0x008005F2 /begin FUNCTION_LIST LBATTCAL /end FUNCTION_LIST /end MEASUREMENT
/begin MEASUREMENT T_batt_zw2 "Temporäre Zwischengroesse" SWORD Def_t_sw_q0p1 0 0 -3276.8000 3276.7000 ECU_ADDRESS 0x008005F4 /begin FUNCTION_LIST LBATTCAL /end FUNCTION_LIST /end MEASUREMENT
/begin MEASUREMENT T_batt_zw3 "" SWORD Def_t_sw_q0p1 0 0 -3276.8000 3276.7000 ECU_ADDRESS 0x008005F6 /begin FUNCTION_LIST LBATTCAL /end FUNCTION_LIST /end MEASUREMENT
/begin MEASUREMENT Tumg_dt "Temporäre zwischengroesse" SWORD Def_t_sw_q0p1 0 0 -3276.8000 3276.7000 ECU_ADDRESS 0x008005F8 /begin FUNCTION_LIST LBATTCAL /end FUNCTION_LIST /end MEASUREMENT
/begin MEASUREMENT Tumg_tp "" SWORD Def_t_sw_q0p1 0 0 -3276.8000 3276.7000 ECU_ADDRESS 0x008005FA /begin FUNCTION_LIST LBATTCAL /end FUNCTION_LIST /end MEASUREMENT
/begin MEASUREMENT Batt_tfil "Zeitkonstante Batterie" UWORD Def_f_uw_b1 0 0 0.0 9.99984741210938e-1 ECU_ADDRESS 0x008005FC /begin FUNCTION_LIST LBATTCAL /end FUNCTION_LIST /end MEASUREMENT
/begin MEASUREMENT Batt_ort "Batterieeinbauort" UBYTE Def_st_ub_q1 0 0 0.0 255.0000 ECU_ADDRESS 0x008005FE /begin FUNCTION_LIST LBATTCAL /end FUNCTION_LIST /end MEASUREMENT
/begin MEASUREMENT N_nstart "Motordrehzahl nach Motorstart" SWORD Def_n_sw_q1p0 0 0 -32768.0000 32767.0000 ECU_ADDRESS 0x007FF040 /begin FUNCTION_LIST LDSTGEN /end FUNCTION_LIST /end MEASUREMENT
/begin MEASUREMENT Dfpropval "" UWORD Def_f_uw_b32 0 0 0.0 31.9995 ECU_ADDRESS 0x007FF042 /begin FUNCTION_LIST LDSTGEN /end FUNCTION_LIST /end MEASUREMENT
/begin MEASUREMENT Dffgen "ss_msv.dat" UBYTE Def_f_ub_b100 0 0 0.0 99.6093 ECU_ADDRESS 0x007FF044 /begin FUNCTION_LIST LDSTGEN /end FUNCTION_LIST /end MEASUREMENT
/begin MEASUREMENT St_ldstgen "Lastzustand Generator elektrisch/thermisch" UBYTE Def_st_ub_q1 0 0 0.0 255.0000 ECU_ADDRESS 0x007FF045 /begin FUNCTION_LIST LDSTGEN /end FUNCTION_LIST /end MEASUREMENT
/begin MEASUREMENT Dfsumme "DFMonitor Summe FASTA" FLOAT32_IEEE Def_f_r32 0 0 1.0000 340282346638528860000000000000000000000.0 ECU_ADDRESS 0x00800608 /begin FUNCTION_LIST LDSTGEN /end FUNCTION_LIST /end MEASUREMENT
/begin MEASUREMENT Dfwanzahl "DF-Wertezähler" FLOAT32_IEEE Def_f_r32 0 0 1.0000 340282346638528860000000000000000000000.0 ECU_ADDRESS 0x0080060C /begin FUNCTION_LIST LDSTGEN /end FUNCTION_LIST /end MEASUREMENT
/begin MEASUREMENT Dfmonitor "DF-Monitor für FASTA" UBYTE Def_f_ub_b100 0 0 0.0 99.6093 ECU_ADDRESS 0x00800610 /begin FUNCTION_LIST LDSTGEN /end FUNCTION_LIST /end MEASUREMENT
/begin MEASUREMENT Ierr_fil "Gefilterter Erregerstrom" UBYTE Def_i_ub_q0p125 0 0 0.0 31.8750 ECU_ADDRESS 0x00800606 /begin FUNCTION_LIST LDSTGEN /end FUNCTION_LIST /end MEASUREMENT
/begin MEASUREMENT N_idlibs "Leerlaufdrehzahlvorgabe von LC-Powermanagement" UBYTE Def_st_ub_q1 0 0 0.0 255.0000 ECU_ADDRESS 0x00800611 /begin FUNCTION_LIST LLPMCTRL /end FUNCTION_LIST /end MEASUREMENT
/begin MEASUREMENT St_llranh0.B_idlgspec "" UBYTE Def_bit_ub_0 0 0 0.0 255.0 ECU_ADDRESS 0x007FC9A9 /begin FUNCTION_LIST LLRANH /end FUNCTION_LIST BIT_MASK 0x1 /end MEASUREMENT
/begin MEASUREMENT St_llranh0.B_nsub "Bedingung für Solldrehzahlanhebung bei niedriger Batteriespannung" UBYTE Def_bit_ub_1 0 0 0.0 255.0 ECU_ADDRESS 0x007FC9A9 /begin FUNCTION_LIST LLRANH /end FUNCTION_LIST BIT_MASK 0x2 /end MEASUREMENT
/begin MEASUREMENT St_llranh0.B_idl_tp "Temporäres Berechnungsbit" UBYTE Def_bit_ub_2 0 0 0.0 255.0 ECU_ADDRESS 0x007FC9A9 /begin FUNCTION_LIST LLRANH /end FUNCTION_LIST BIT_MASK 0x4 /end MEASUREMENT
/begin MEASUREMENT St_llranh0 "Statuswort" UBYTE Def_st_ub_q1 0 0 0.0 255.0000 ECU_ADDRESS 0x007FC9A9 /begin FUNCTION_LIST LLRANH /end FUNCTION_LIST /end MEASUREMENT
/begin MEASUREMENT Nslb "N_soll Korrektur von Ladebilanz Batterie" SWORD Def_n_sw_q1p0 0 0 0.0 32767.0000 ECU_ADDRESS 0x00800612 /begin FUNCTION_LIST LLRANH /end FUNCTION_LIST /end MEASUREMENT
/begin MEASUREMENT St_dmdblock.B_timmin "" UBYTE Def_bit_ub_0 0 0 0.0 255.0 ECU_ADDRESS 0x007FF048 /begin FUNCTION_LIST LOADRESP /end FUNCTION_LIST BIT_MASK 0x1 /end MEASUREMENT
/begin MEASUREMENT St_dmdblock.B_timmax "" UBYTE Def_bit_ub_1 0 0 0.0 255.0 ECU_ADDRESS 0x007FF048 /begin FUNCTION_LIST LOADRESP /end FUNCTION_LIST BIT_MASK 0x2 /end MEASUREMENT
/begin MEASUREMENT St_dmdblock.B_dmd_frei "" UBYTE Def_bit_ub_2 0 0 0.0 255.0 ECU_ADDRESS 0x007FF048 /begin FUNCTION_LIST LOADRESP /end FUNCTION_LIST BIT_MASK 0x4 /end MEASUREMENT
/begin MEASUREMENT St_dmdblock "Statuswort" UBYTE Def_st_ub_q1 0 0 0.0 255.0000 ECU_ADDRESS 0x007FF048 /begin FUNCTION_LIST LOADRESP /end FUNCTION_LIST /end MEASUREMENT
/begin MEASUREMENT St_loadresp.B_lroff "" UBYTE Def_bit_ub_0 0 0 0.0 255.0 ECU_ADDRESS 0x007FF049 /begin FUNCTION_LIST LOADRESP /end FUNCTION_LIST BIT_MASK 0x1 /end MEASUREMENT
/begin MEASUREMENT St_loadresp.B_lroff2 "" UBYTE Def_bit_ub_1 0 0 0.0 255.0 ECU_ADDRESS 0x007FF049 /begin FUNCTION_LIST LOADRESP /end FUNCTION_LIST BIT_MASK 0x2 /end MEASUREMENT
/begin MEASUREMENT St_loadresp "Statuswort" UBYTE Def_st_ub_q1 0 0 0.0 255.0000 ECU_ADDRESS 0x007FF049 /begin FUNCTION_LIST LOADRESP /end FUNCTION_LIST /end MEASUREMENT
/begin MEASUREMENT St_loadresp0.B_genoffst "Bedingung Generatorabschaltung im Start" UBYTE Def_bit_ub_0 0 0 0.0 255.0 ECU_ADDRESS 0x007FF04A /begin FUNCTION_LIST LOADRESP /end FUNCTION_LIST BIT_MASK 0x1 /end MEASUREMENT
/begin MEASUREMENT St_loadresp0.B_genoffmd "Abschaltung Generator angefordert" UBYTE Def_bit_ub_1 0 0 0.0 255.0 ECU_ADDRESS 0x007FF04A /begin FUNCTION_LIST LOADRESP /end FUNCTION_LIST BIT_MASK 0x2 /end MEASUREMENT
/begin MEASUREMENT St_loadresp0.B_fub "Bedingung: Fehler Batteriespannungssensor" UBYTE Def_bit_ub_2 0 0 0.0 255.0 ECU_ADDRESS 0x007FF04A /begin FUNCTION_LIST LOADRESP /end FUNCTION_LIST BIT_MASK 0x4 /end MEASUREMENT
/begin MEASUREMENT St_loadresp0 "Statuswort" UBYTE Def_st_ub_q1 0 0 0.0 255.0000 ECU_ADDRESS 0x007FF04A /begin FUNCTION_LIST LOADRESP /end FUNCTION_LIST /end MEASUREMENT
/begin MEASUREMENT St_loadresp10ms.B_mdgrenz "Bedingung Generator im Modus Momentenbegrenzung" UBYTE Def_bit_ub_0 0 0 0.0 255.0 ECU_ADDRESS 0x007FF04B /begin FUNCTION_LIST LOADRESP /end FUNCTION_LIST BIT_MASK 0x1 /end MEASUREMENT
/begin MEASUREMENT St_loadresp10ms "Statuswort" UBYTE Def_st_ub_q1 0 0 0.0 255.0000 ECU_ADDRESS 0x007FF04B /begin FUNCTION_LIST LOADRESP /end FUNCTION_LIST /end MEASUREMENT
/begin MEASUREMENT St_loadresp_nv0.B_genoffvl "Bedingung Generatorabschaltung bei Vollast" UBYTE Def_bit_ub_0 0 0 0.0 255.0 ECU_ADDRESS 0x00800616 /begin FUNCTION_LIST LOADRESP /end FUNCTION_LIST BIT_MASK 0x1 /end MEASUREMENT
/begin MEASUREMENT St_loadresp_nv0 "Statuswort" UBYTE Def_st_ub_q1 0 0 0.0 255.0000 ECU_ADDRESS 0x00800616 /begin FUNCTION_LIST LOADRESP /end FUNCTION_LIST /end MEASUREMENT
/begin MEASUREMENT Md_grenz "Maximalmoment Generator an BSDII" SWORD Def_m_sw_q0p1 0 0 -3276.8000 3276.7000 ECU_ADDRESS 0x007FF046 /begin FUNCTION_LIST LOADRESP /end FUNCTION_LIST /end MEASUREMENT
/begin MEASUREMENT Tlrgen "Sollwert Load- Response- Zeit Generator" UBYTE Def_td_ub_q0p1 0 0 0.0 25.5000 ECU_ADDRESS 0x00800614 /begin FUNCTION_LIST LOADRESP /end FUNCTION_LIST /end MEASUREMENT
/begin MEASUREMENT Tlrgen2 "Sollwert Load- Response- Zeit Generator2" UBYTE Def_td_ub_q0p1 0 0 0.0 25.5000 ECU_ADDRESS 0x00800615 /begin FUNCTION_LIST LOADRESP /end FUNCTION_LIST /end MEASUREMENT
/begin MEASUREMENT Z_dmdblock "" UBYTE Def_dez_ub_q1 0 0 0.0 255.0000 ECU_ADDRESS 0x00800617 /begin FUNCTION_LIST LOADRESP /end FUNCTION_LIST /end MEASUREMENT
/begin MEASUREMENT Loadresp "Loadresponse Zeit aus Kennfeldrechnung (alte Version)" UBYTE Def_td_ub_q0p1 0 0 0.0 25.5000 ECU_ADDRESS 0x007FF04C /begin FUNCTION_LIST LOADRESP /end FUNCTION_LIST /end MEASUREMENT
/begin FUNCTION DIBS "DIBS" /end FUNCTION
/begin FUNCTION DQLT "DQLT" /end FUNCTION
/begin FUNCTION ELMOTENTL "ELMOTENTL" /end FUNCTION
/begin FUNCTION IMDGEN_1PR "IMDGEN_1PR" /end FUNCTION
/begin FUNCTION KT_IBS "KT_IBS" /end FUNCTION
/begin FUNCTION LAYER "LAYER" /end FUNCTION
/begin FUNCTION LBATTCAL "LBATTCAL" /end FUNCTION
/begin FUNCTION LDSTGEN "LDSTGEN" /end FUNCTION
/begin FUNCTION LLPMCTRL "LLPMCTRL" /end FUNCTION
/begin FUNCTION LLRANH "LLRANH" /end FUNCTION
/begin FUNCTION LOADRESP "LOADRESP" /end FUNCTION
/begin COMPU_METHOD Def_i_sw_q1 "Def_i_sw_q1" RAT_FUNC "%8.3" "A" COEFFS 0 1 0 0 0 1 /end COMPU_METHOD
/begin COMPU_METHOD Def_t_sw_q0p1 "Def_t_sw_q0p1" RAT_FUNC "%6.1" "°C" COEFFS 0 10 0 0 0 1 /end COMPU_METHOD
/begin COMPU_METHOD Def_u_uw_q0p0942 "Def_u_uw_q0p0942" RAT_FUNC "%6.1" "V" COEFFS 0 1 0 0 0 0.0942 /end COMPU_METHOD
/begin COMPU_METHOD Def_f_ub_b8 "Def_f_ub_b8" RAT_FUNC "%5.2" "-" COEFFS 0 256 0 0 0 8 /end COMPU_METHOD
/begin COMPU_METHOD Def_v_uw_q1p0 "Def_v_uw_q1p0" RAT_FUNC "%5.0" "km/h" COEFFS 0 1 0 0 0 1 /end COMPU_METHOD
/begin COMPU_METHOD Def_tv_ub_q0p390625 "Def_tv_ub_q0p390625" RAT_FUNC "%5.2" "%" COEFFS 0 256 0 0 0 100 /end COMPU_METHOD
/begin COMPU_METHOD Def_bit_ub_0 "Def_bit_ub_0" TAB_VERB "%5.2" "-" COMPU_TAB_REF Def_bit_ub_0_VTAB /end COMPU_METHOD
/begin COMPU_METHOD Def_st_ub_q1 "Def_st_ub_q1" RAT_FUNC "%3.0" "-" COEFFS 0 1 0 0 0 1 /end COMPU_METHOD
/begin COMPU_METHOD Def_n_sw_q1p0 "Def_n_sw_q1p0" RAT_FUNC "%5.0" "Upm" COEFFS 0 1 0 0 0 1 /end COMPU_METHOD
/begin COMPU_METHOD Def_f_ub_b100 "Def_f_ub_b100" RAT_FUNC "%5.2" "%" COEFFS 0 256 0 0 0 100 /end COMPU_METHOD
/begin COMPU_METHOD Def_i_ub_q1 "Def_i_ub_q1" RAT_FUNC "%6.3" "" COEFFS 0 1 0 0 0 1 /end COMPU_METHOD
/begin COMPU_METHOD Def_td_ub_q0p1 "Def_td_ub_q0p1" RAT_FUNC "%4.1" "s" COEFFS 0 10 0 0 0 1 /end COMPU_METHOD
/begin COMPU_METHOD Def_t_sw_q0p01 "Def_t_sw_q0p01" RAT_FUNC "%7.2" "°C" COEFFS 0 100 0 0 0 1 /end COMPU_METHOD
/begin COMPU_METHOD Def_me_sw_q0p01 "Def_me_sw_q0p01" RAT_FUNC "%8.3" "mg/cyc" COEFFS 0 100 0 0 0 1 /end COMPU_METHOD
/begin COMPU_METHOD Def_dez_uw_q1 "Def_dez_uw_q1" RAT_FUNC "%5.0" "-" COEFFS 0 1 0 0 0 1 /end COMPU_METHOD
/begin COMPU_METHOD ident "ident" RAT_FUNC "%4.1" "-" COEFFS 0 1 0 0 0 1 /end COMPU_METHOD
/begin COMPU_METHOD Def_dez_ub_q1 "Def_dez_ub_q1" RAT_FUNC "%3.0" "-" COEFFS 0 1 0 0 0 1 /end COMPU_METHOD
/begin COMPU_METHOD Def_f_ub_b1 "Def_f_ub_b1" RAT_FUNC "%6.3" "-" COEFFS 0 256 0 0 0 1 /end COMPU_METHOD
/begin COMPU_METHOD Def_ml_sw_q0p1 "Def_ml_sw_q0p1" RAT_FUNC "%7.2" "mg/Hub" COEFFS 0 10 0 0 0 1 /end COMPU_METHOD
/begin COMPU_METHOD Def_bit_ub_1 "Def_bit_ub_1" TAB_VERB "%5.2" "-" COMPU_TAB_REF Def_bit_ub_1_VTAB /end COMPU_METHOD
/begin COMPU_METHOD Def_bit_ub_2 "Def_bit_ub_2" TAB_VERB "%5.2" "-" COMPU_TAB_REF Def_bit_ub_2_VTAB /end COMPU_METHOD
/begin COMPU_METHOD Def_bit_ub_3 "Def_bit_ub_3" TAB_VERB "%5.2" "-" COMPU_TAB_REF Def_bit_ub_3_VTAB /end COMPU_METHOD
/begin COMPU_METHOD Def_bit_ub_4 "Def_bit_ub_4" TAB_VERB "%5.2" "-" COMPU_TAB_REF Def_bit_ub_4_VTAB /end COMPU_METHOD
/begin COMPU_METHOD Def_bit_ub_5 "Def_bit_ub_5" TAB_VERB "%5.2" "-" COMPU_TAB_REF Def_bit_ub_5_VTAB /end COMPU_METHOD
/begin COMPU_METHOD Def_bit_ub_6 "Def_bit_ub_6" TAB_VERB "%5.2" "-" COMPU_TAB_REF Def_bit_ub_6_VTAB /end COMPU_METHOD
/begin COMPU_METHOD Def_bit_ub_7 "Def_bit_ub_7" TAB_VERB "%5.2" "-" COMPU_TAB_REF Def_bit_ub_7_VTAB /end COMPU_METHOD
/begin COMPU_METHOD Def_st_uw_q1 "Def_st_uw_q1" RAT_FUNC "%5.0" "-" COEFFS 0 1 0 0 0 1 /end COMPU_METHOD
/begin COMPU_METHOD Def_td_uw_q0p1 "Def_td_uw_q0p1" RAT_FUNC "%6.1" "s" COEFFS 0 10 0 0 0 1 /end COMPU_METHOD
/begin COMPU_METHOD Identity "Identity" RAT_FUNC "%4.1" "-" COEFFS 0 1 0 0 0 1 /end COMPU_METHOD
/begin COMPU_METHOD Def_dez_ul_q1 "Def_dez_ul_q1" RAT_FUNC "%7.0" "-" COEFFS 0 1 0 0 0 1 /end COMPU_METHOD
/begin COMPU_METHOD Def_rf_sw_q0p01 "Def_rf_sw_q0p01" RAT_FUNC "%9.4" "%" COEFFS 0 100 0 0 0 1 /end COMPU_METHOD
/begin COMPU_METHOD Def_dez_sw_q1 "Def_dez_sw_q1" RAT_FUNC "%5.0" "-" COEFFS 0 1 0 0 0 1 /end COMPU_METHOD
/begin COMPU_METHOD Def_wdk_sw_q0p0244 "Def_wdk_sw_q0p0244" RAT_FUNC "%7.2" "%" COEFFS 0 4096 0 0 0 100 /end COMPU_METHOD
/begin COMPU_METHOD Def_w_sw_q0p1 "Def_w_sw_q0p1" RAT_FUNC "%7.2" "øKW" COEFFS 0 10 0 0 0 1 /end COMPU_METHOD
/begin COMPU_METHOD Def_p_uw_q0p039 "Def_p_uw_q0p039" RAT_FUNC "%7.2" "hPa" COEFFS 0 256 0 0 0 10 /end COMPU_METHOD
/begin COMPU_METHOD Def_m_sw_q0p1 "Def_m_sw_q0p1" RAT_FUNC "%7.2" "Nm" COEFFS 0 10 0 0 0 1 /end COMPU_METHOD
/begin COMPU_METHOD Def_f_uw_b100 "Def_f_uw_b100" RAT_FUNC "%8.3" "%" COEFFS 0 65536 0 0 0 100 /end COMPU_METHOD
/begin COMPU_METHOD Def_i_ub_q0p125 "Def_i_ub_q0p125" RAT_FUNC "%6.3" "A" COEFFS 0 8 0 0 0 1 /end COMPU_METHOD
/begin COMPU_METHOD Def_f_ub_b4 "Def_f_ub_b4" RAT_FUNC "%5.2" "-" COEFFS 0 256 0 0 0 4 /end COMPU_METHOD
/begin COMPU_METHOD Def_u_uw_q0p1 "Def_u_uw_q0p1" RAT_FUNC "%8.3" "V" COEFFS 0 10 0 0 0 1 /end COMPU_METHOD
/begin COMPU_METHOD Def_eta_ul_b8192 "Def_eta_ul_b8192" RAT_FUNC "%14.6" "-" COEFFS 0 524288 0 0 0 1 /end COMPU_METHOD
/begin COMPU_METHOD Def_pwr_ul_q0p03125 "Def_pwr_ul_q0p03125" RAT_FUNC "%10.3" "-" COEFFS 0 65536 0 0 0 2048 /end COMPU_METHOD
/begin COMPU_METHOD Def_f_uw_b1 "Def_f_uw_b1" RAT_FUNC "%14.5" "-" COEFFS 0 65536 0 0 0 1 /end COMPU_METHOD
/begin COMPU_METHOD Def_f_uw_b2048 "Def_f_uw_b2048" RAT_FUNC "%7.2" "-" COEFFS 0 65536 0 0 0 2048 /end COMPU_METHOD
/begin COMPU_METHOD Def_t_uw_q0p075 "Def_t_uw_q0p075" RAT_FUNC "%7.2" "°C" COEFFS 0 1 0 0 0 0.75 /end COMPU_METHOD
/begin COMPU_METHOD Def_f_uw_b32 "Def_f_uw_b32" RAT_FUNC "%9.4" "-" COEFFS 0 65536 0 0 0 32 /end COMPU_METHOD
/begin COMPU_METHOD Def_i_uw_q0p03125 "Def_i_uw_q0p03125" RAT_FUNC "%8.3" "A" COEFFS 0 65536 0 0 0 2048 /end COMPU_METHOD
/begin COMPU_METHOD Def_td_ub_q1 "Def_td_ub_q1" RAT_FUNC "%5.2" "s" COEFFS 0 1 0 0 0 1 /end COMPU_METHOD
/begin COMPU_METHOD Def_td_ub_q0p01 "Def_td_ub_q0p01" RAT_FUNC "%5.2" "s" COEFFS 0 100 0 0 0 1 /end COMPU_METHOD
/begin COMPU_METHOD Def_f_ub_b2 "Def_f_ub_b2" RAT_FUNC "%6.3" "-" COEFFS 0 256 0 0 0 2 /end COMPU_METHOD
/begin COMPU_METHOD Def_f_uw_b2 "Def_f_uw_b2" RAT_FUNC "%14.5" "-" COEFFS 0 65536 0 0 0 2 /end COMPU_METHOD
/begin COMPU_METHOD Def_f_uw_b64 "Def_f_uw_b64" RAT_FUNC "%9.4" "-" COEFFS 0 65536 0 0 0 64 /end COMPU_METHOD
/begin COMPU_METHOD Def_i_uw_q0p08_o200 "Def_i_uw_q0p08_o200" RAT_FUNC "%8.3" "" COEFFS 0 25 5000 0 0 2 /end COMPU_METHOD
/begin COMPU_METHOD Def_u_uw_q0p25em3_o6 "Def_u_uw_q0p25em3_o6" RAT_FUNC "%9.4" "" COEFFS 0 -4000 24000 0 0 -1 /end COMPU_METHOD
/begin COMPU_METHOD Def_ql_uw_q0p0182 "Def_ql_uw_q0p0182" RAT_FUNC "%8.3" "Ah" COEFFS 0 989 0 0 0 18 /end COMPU_METHOD
/begin COMPU_METHOD Def_i_sw_q0p02 "Def_i_sw_q0p02" RAT_FUNC "%8.3" "A" COEFFS 0 50 0 0 0 1 /end COMPU_METHOD
/begin COMPU_METHOD Def_i_uw_q0p02_o200 "Def_i_uw_q0p02_o200" RAT_FUNC "%7.2" "A" COEFFS 0 50 10000 0 0 1 /end COMPU_METHOD
/begin COMPU_METHOD Def_i_uw_q0p02 "Def_i_uw_q0p02" RAT_FUNC "%8.3" "A" COEFFS 0 1 0 0 0 0.02 /end COMPU_METHOD
/begin COMPU_METHOD Def_i_ub_q0p02 "Def_i_ub_q0p02" RAT_FUNC "%5.2" "A" COEFFS 0 50 0 0 0 1 /end COMPU_METHOD
/begin COMPU_METHOD Def_u_ub_q0p064_o6 "Def_u_ub_q0p064_o6" RAT_FUNC "%5.2" "V" COEFFS 0 -125 750 0 0 -8 /end COMPU_METHOD
/begin COMPU_METHOD Def_td_ub_q256 "Def_td_ub_q256" RAT_FUNC "%5.2" "s" COEFFS 0 1 0 0 0 256 /end COMPU_METHOD
/begin COMPU_METHOD Def_i_ub_q5p12 "Def_i_ub_q5p12" RAT_FUNC "%5.2" "" COEFFS 0 25 0 0 0 128 /end COMPU_METHOD
/begin COMPU_METHOD Def_td_ub_q0p0125 "Def_td_ub_q0p0125" RAT_FUNC "%5.2" "s" COEFFS 0 80 0 0 0 1 /end COMPU_METHOD
/begin COMPU_METHOD Def_td_ub_q0p002_o01 "Def_td_ub_q0p002_o01" RAT_FUNC "%6.3" "s" COEFFS 0 -1 0.01 0 0 -0.002 /end COMPU_METHOD
/begin COMPU_METHOD Def_td_ub_q16 "Def_td_ub_q16" RAT_FUNC "%5.2" "s" COEFFS 0 1 0 0 0 16 /end COMPU_METHOD
/begin COMPU_METHOD Def_i_ub_q0p04 "Def_i_ub_q0p04" RAT_FUNC "%5.2" "A" COEFFS 0 25 0 0 0 1 /end COMPU_METHOD
/begin COMPU_METHOD Def_i_ub_q0p08 "Def_i_ub_q0p08" RAT_FUNC "%5.2" "A" COEFFS 0 25 0 0 0 2 /end COMPU_METHOD
/begin COMPU_METHOD Def_td_ub_q0p05 "Def_td_ub_q0p05" RAT_FUNC "%5.2" "s" COEFFS 0 20 0 0 0 1 /end COMPU_METHOD
/begin COMPU_METHOD Def_td_ub_q0p00625 "Def_td_ub_q0p00625" RAT_FUNC "%7.4" "s" COEFFS 0 160 0 0 0 1 /end COMPU_METHOD
/begin COMPU_METHOD Def_u_ub_q0p0196 "Def_u_ub_q0p0196" RAT_FUNC "%7.4" "V" COEFFS 0 1 0 0 0 0.0196 /end COMPU_METHOD
/begin COMPU_METHOD Def_td_uw_q0p05 "Def_td_uw_q0p05" RAT_FUNC "%7.2" "s" COEFFS 0 20 0 0 0 1 /end COMPU_METHOD
/begin COMPU_METHOD Def_ac_sb_q0p25 "Def_ac_sb_q0p25" RAT_FUNC "%4.1" "-" COEFFS 0 4 0 0 0 1 /end COMPU_METHOD
/begin COMPU_METHOD Def_km_sw_q10 "Def_km_sw_q10" RAT_FUNC "%6.1" "km" COEFFS 0 1 0 0 0 10 /end COMPU_METHOD
/begin COMPU_METHOD Def_km_ub_q1000 "Def_km_ub_q1000" RAT_FUNC "%3.0" "km" COEFFS 0 1 0 0 0 1000 /end COMPU_METHOD
/begin COMPU_METHOD Def_dm_sw_q0p1 "Def_dm_sw_q0p1" RAT_FUNC "%7.2" "Nm/s" COEFFS 0 10 0 0 0 1 /end COMPU_METHOD
/begin COMPU_METHOD Def_i_sw_q0039 "Def_i_sw_q0039" RAT_FUNC "%8.3" "mA" COEFFS 0 256 0 0 0 1 /end COMPU_METHOD
/begin COMPU_METHOD Def_km_uw_q10 "Def_km_uw_q10" RAT_FUNC "%5.0" "km" COEFFS 0 1 0 0 0 10 /end COMPU_METHOD
/begin COMPU_METHOD Def_f_uw_b16 "Def_f_uw_b16" RAT_FUNC "%9.4" "-" COEFFS 0 65536 0 0 0 16 /end COMPU_METHOD
/begin COMPU_METHOD Def_lm_uw_q0p000444 "Def_lm_uw_q0p000444" RAT_FUNC "%9.4" "kg" COEFFS 0 2250 0 0 0 1 /end COMPU_METHOD
/begin COMPU_METHOD Def_dez_uw_q0p01 "Def_dez_uw_q0p01" RAT_FUNC "%8.3" "-" COEFFS 0 100 0 0 0 1 /end COMPU_METHOD
/begin COMPU_METHOD Def_p_sw_q1 "Def_p_sw_q1" RAT_FUNC "%6.1" "hPa" COEFFS 0 1 0 0 0 1 /end COMPU_METHOD
/begin COMPU_METHOD Def_f_ub_b127p5 "Def_f_ub_b127p5" RAT_FUNC "%5.2" "%" COEFFS 0 2 0 0 0 1 /end COMPU_METHOD
/begin COMPU_METHOD Def_td_uw_q0p01 "Def_td_uw_q0p01" RAT_FUNC "%7.2" "s" COEFFS 0 100 0 0 0 1 /end COMPU_METHOD
/begin COMPU_METHOD Def_tv_sw_q0p01 "Def_tv_sw_q0p01" RAT_FUNC "%8.3" "%" COEFFS 0 100 0 0 0 1 /end COMPU_METHOD
/begin COMPU_METHOD Def_u_sw_b128 "Def_u_sw_b128" RAT_FUNC "%8.3" "V" COEFFS 0 256 0 0 0 1 /end COMPU_METHOD
/begin COMPU_METHOD Def_wdk_sw_q0p1 "Def_wdk_sw_q0p1" RAT_FUNC "%7.2" "-" COEFFS 0 10 0 0 0 1 /end COMPU_METHOD
/begin COMPU_METHOD Def_u_ub_q0p0942 "Def_u_ub_q0p0942" RAT_FUNC "%7.4" "V" COEFFS 0 1 0 0 0 0.0942 /end COMPU_METHOD
/begin COMPU_METHOD Def_tv_sw_q0p0244 "Def_tv_sw_q0p0244" RAT_FUNC "%7.2" "%" COEFFS 0 4096 0 0 0 100 /end COMPU_METHOD
/begin COMPU_METHOD Def_bit_uw_0 "Def_bit_uw_0" TAB_VERB "%7.2" "-" COMPU_TAB_REF Def_bit_uw_0_VTAB /end COMPU_METHOD
/begin COMPU_METHOD Def_bit_uw_3 "Def_bit_uw_3" TAB_VERB "%7.2" "-" COMPU_TAB_REF Def_bit_uw_3_VTAB /end COMPU_METHOD
/begin COMPU_METHOD Def_bit_uw_5 "Def_bit_uw_5" TAB_VERB "%7.2" "-" COMPU_TAB_REF Def_bit_uw_5_VTAB /end COMPU_METHOD
/begin COMPU_METHOD Def_i_ub_q10 "Def_i_ub_q10" RAT_FUNC "%5.2" "A" COEFFS 0 1 0 0 0 10 /end COMPU_METHOD
/begin COMPU_METHOD Def_i_ub_q0p001 "Def_i_ub_q0p001" RAT_FUNC "%6.3" "A" COEFFS 0 1000 0 0 0 1 /end COMPU_METHOD
/begin COMPU_METHOD Def_lf_ub_q0p01 "Def_lf_ub_q0p01" RAT_FUNC "%5.2" "-" COEFFS 0 100 0 0 0 1 /end COMPU_METHOD
/begin COMPU_METHOD Def_tn_uw_q1 "Def_tn_uw_q1" RAT_FUNC "%7.2" "min" COEFFS 0 1 0 0 0 1 /end COMPU_METHOD
/begin COMPU_METHOD Def_f_ub_b32 "Def_f_ub_b32" RAT_FUNC "%5.2" "-" COEFFS 0 256 0 0 0 32 /end COMPU_METHOD
/begin COMPU_METHOD Def_f_uw_b256 "Def_f_uw_b256" RAT_FUNC "%8.3" "-" COEFFS 0 65536 0 0 0 256 /end COMPU_METHOD
/begin COMPU_METHOD Def_f_r32 "Def_f_r32" RAT_FUNC "%14.7" "-" COEFFS 0 1 0 0 0 1 /end COMPU_METHOD
/begin COMPU_METHOD Def_f_sw_b100 "Def_f_sw_b100" RAT_FUNC "%8.3" "-" COEFFS 0 32768 0 0 0 100 /end COMPU_METHOD
/begin COMPU_VTAB Def_bit_ub_0_VTAB "Def_bit_ub_0_VTAB" TAB_VERB 2 0 "FALSE" 1 "TRUE" /end COMPU_VTAB
/begin COMPU_VTAB Def_bit_ub_1_VTAB "Def_bit_ub_1_VTAB" TAB_VERB 2 0 "FALSE" 1 "TRUE" /end COMPU_VTAB
/begin COMPU_VTAB Def_bit_ub_2_VTAB "Def_bit_ub_2_VTAB" TAB_VERB 2 0 "FALSE" 1 "TRUE" /end COMPU_VTAB
/begin COMPU_VTAB Def_bit_ub_3_VTAB "Def_bit_ub_3_VTAB" TAB_VERB 2 0 "FALSE" 1 "TRUE" /end COMPU_VTAB
/begin COMPU_VTAB Def_bit_ub_4_VTAB "Def_bit_ub_4_VTAB" TAB_VERB 2 0 "FALSE" 1 "TRUE" /end COMPU_VTAB
/begin COMPU_VTAB Def_bit_ub_5_VTAB "Def_bit_ub_5_VTAB" TAB_VERB 2 0 "FALSE" 1 "TRUE" /end COMPU_VTAB
/begin COMPU_VTAB Def_bit_ub_6_VTAB "Def_bit_ub_6_VTAB" TAB_VERB 2 0 "FALSE" 1 "TRUE" /end COMPU_VTAB
/begin COMPU_VTAB Def_bit_ub_7_VTAB "Def_bit_ub_7_VTAB" TAB_VERB 2 0 "FALSE" 1 "TRUE" /end COMPU_VTAB
/begin COMPU_VTAB Def_bit_uw_0_VTAB "Def_bit_uw_0_VTAB" TAB_VERB 2 0 "FALSE" 1 "TRUE" /end COMPU_VTAB
/begin COMPU_VTAB Def_bit_uw_3_VTAB "Def_bit_uw_3_VTAB" TAB_VERB 2 0 "FALSE" 1 "TRUE" /end COMPU_VTAB
/begin COMPU_VTAB Def_bit_uw_5_VTAB "Def_bit_uw_5_VTAB" TAB_VERB 2 0 "FALSE" 1 "TRUE" /end COMPU_VTAB
/begin RECORD_LAYOUT TKW_VV_VV_UW FNC_VALUES 1 UWORD COLUMN_DIR DIRECT /end RECORD_LAYOUT
/begin RECORD_LAYOUT TKW_VV_VV_SW FNC_VALUES 1 SWORD COLUMN_DIR DIRECT /end RECORD_LAYOUT
/begin RECORD_LAYOUT TKL_UW_VV_UB NO_AXIS_PTS_X 1 UBYTE RESERVED 2 BYTE AXIS_PTS_X 3 UWORD INDEX_INCR DIRECT FNC_VALUES 4 UBYTE COLUMN_DIR DIRECT /end RECORD_LAYOUT
/begin RECORD_LAYOUT TKL_UW_VV_UW NO_AXIS_PTS_X 1 UBYTE RESERVED 2 BYTE AXIS_PTS_X 3 UWORD INDEX_INCR DIRECT FNC_VALUES 4 UWORD COLUMN_DIR DIRECT /end RECORD_LAYOUT
/begin RECORD_LAYOUT TKL_SW_VV_UW NO_AXIS_PTS_X 1 UBYTE RESERVED 2 BYTE AXIS_PTS_X 3 SWORD INDEX_INCR DIRECT FNC_VALUES 4 UWORD COLUMN_DIR DIRECT /end RECORD_LAYOUT
/begin RECORD_LAYOUT TKW_VV_VV_UB FNC_VALUES 1 UBYTE COLUMN_DIR DIRECT /end RECORD_LAYOUT
/begin RECORD_LAYOUT TKF_UB_UB_UB NO_AXIS_PTS_X 1 UBYTE NO_AXIS_PTS_Y 2 UBYTE AXIS_PTS_X 3 UBYTE INDEX_INCR DIRECT AXIS_PTS_Y 4 UBYTE INDEX_INCR DIRECT FNC_VALUES 5 UBYTE COLUMN_DIR DIRECT /end RECORD_LAYOUT
/begin RECORD_LAYOUT TKW_VV_VV_UL FNC_VALUES 1 ULONG COLUMN_DIR DIRECT /end RECORD_LAYOUT
/begin RECORD_LAYOUT TKF_UW_SW_SW NO_AXIS_PTS_X 1 UBYTE NO_AXIS_PTS_Y 2 UBYTE AXIS_PTS_X 3 SWORD INDEX_INCR DIRECT AXIS_PTS_Y 4 UWORD INDEX_INCR DIRECT FNC_VALUES 5 SWORD COLUMN_DIR DIRECT /end RECORD_LAYOUT
/begin RECORD_LAYOUT TKL_UB_VV_UB NO_AXIS_PTS_X 1 UBYTE RESERVED 2 BYTE AXIS_PTS_X 3 UBYTE INDEX_INCR DIRECT FNC_VALUES 4 UBYTE COLUMN_DIR DIRECT /end RECORD_LAYOUT
/begin RECORD_LAYOUT TKL_UW_VV_SW NO_AXIS_PTS_X 1 UBYTE RESERVED 2 BYTE AXIS_PTS_X 3 UWORD INDEX_INCR DIRECT FNC_VALUES 4 SWORD COLUMN_DIR DIRECT /end RECORD_LAYOUT
/begin RECORD_LAYOUT TKL_SW_VV_UB NO_AXIS_PTS_X 1 UBYTE RESERVED 2 BYTE AXIS_PTS_X 3 SWORD INDEX_INCR DIRECT FNC_VALUES 4 UBYTE COLUMN_DIR DIRECT /end RECORD_LAYOUT
/begin RECORD_LAYOUT TKF_SW_UB_UB NO_AXIS_PTS_X 1 UBYTE NO_AXIS_PTS_Y 2 UBYTE AXIS_PTS_X 3 UBYTE INDEX_INCR DIRECT AXIS_PTS_Y 4 SWORD INDEX_INCR DIRECT FNC_VALUES 5 UBYTE COLUMN_DIR DIRECT /end RECORD_LAYOUT
/begin RECORD_LAYOUT TKF_SW_UW_UB NO_AXIS_PTS_X 1 UBYTE NO_AXIS_PTS_Y 2 UBYTE AXIS_PTS_X 3 UWORD INDEX_INCR DIRECT AXIS_PTS_Y 4 SWORD INDEX_INCR DIRECT FNC_VALUES 5 UBYTE COLUMN_DIR DIRECT /end RECORD_LAYOUT
/begin RECORD_LAYOUT TKF_SW_SW_UW NO_AXIS_PTS_X 1 UBYTE NO_AXIS_PTS_Y 2 UBYTE AXIS_PTS_X 3 SWORD INDEX_INCR DIRECT AXIS_PTS_Y 4 SWORD INDEX_INCR DIRECT FNC_VALUES 5 UWORD COLUMN_DIR DIRECT /end RECORD_LAYOUT
/begin RECORD_LAYOUT TKL_SW_VV_SW NO_AXIS_PTS_X 1 UBYTE RESERVED 2 BYTE AXIS_PTS_X 3 SWORD INDEX_INCR DIRECT FNC_VALUES 4 SWORD COLUMN_DIR DIRECT /end RECORD_LAYOUT
/begin RECORD_LAYOUT TKF_UW_SW_UB NO_AXIS_PTS_X 1 UBYTE NO_AXIS_PTS_Y 2 UBYTE AXIS_PTS_X 3 SWORD INDEX_INCR DIRECT AXIS_PTS_Y 4 UWORD INDEX_INCR DIRECT FNC_VALUES 5 UBYTE COLUMN_DIR DIRECT /end RECORD_LAYOUT
/begin RECORD_LAYOUT TKF_SW_SW_UB NO_AXIS_PTS_X 1 UBYTE NO_AXIS_PTS_Y 2 UBYTE AXIS_PTS_X 3 SWORD INDEX_INCR DIRECT AXIS_PTS_Y 4 SWORD INDEX_INCR DIRECT FNC_VALUES 5 UBYTE COLUMN_DIR DIRECT /end RECORD_LAYOUT
/end MODULE
/end PROJECT
