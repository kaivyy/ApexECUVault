ASAP2_VERSION 1 41
/begin PROJECT MSD70 "Spray Guided DI-System with Piezo Injectors for 6-Cylinder"
/begin HEADER "_default_HeaderComment" PROJECT_NO _0B /end HEADER
/begin MODULE _default_ModuleName "_default_ModuleLongIdentifier"
/begin MOD_COMMON "_default_ModCommonComment" DEPOSIT ABSOLUTE BYTE_ORDER MSB_LAST ALIGNMENT_BYTE 1 ALIGNMENT_WORD 2 ALIGNMENT_LONG 2 ALIGNMENT_FLOAT32_IEEE 2 ALIGNMENT_FLOAT64_IEEE 4 /end MOD_COMMON
/begin MEASUREMENT Anzzykl_hd "" UWORD _CNV_R_R_Def_dez_sl_575_CM 1 100. 0. 65535. DISPLAY_IDENTIFIER ANZZYKL_HD ECU_ADDRESS 0xd0007818 FORMAT "%5.0" /end MEASUREMENT
/begin MEASUREMENT Bosbtvfbk "Rest-Verfügbarkeit Motoröl in Prozent" UBYTE _CNV_R_R_Def_dez_sl_575_CM 1 100. 0. 255. DISPLAY_IDENTIFIER BOSBTVFBK ECU_ADDRESS 0xc000405a FORMAT "%3.0" /end MEASUREMENT
/begin MEASUREMENT Bosfxid2 "Zieltermin_Monat_BOS_Rückstellung_2" SWORD _CNV_R_R_Def_dez_sl_575_CM 1 100. -32768. 32767. DISPLAY_IDENTIFIER BOSFXID2 ECU_ADDRESS 0xc0004056 FORMAT "%5.0" /end MEASUREMENT
/begin MEASUREMENT Bosid2 "Zieltermin_Monat_BOS_Rückstellung_2" UBYTE _CNV_R_R_Def_dez_sl_575_CM 1 100. 0. 255. DISPLAY_IDENTIFIER BOSID2 ECU_ADDRESS 0xc000405b FORMAT "%3.0" /end MEASUREMENT
/begin MEASUREMENT Bosjziel "Zieltermin_Monat_BOS_Rückstellung_2" UBYTE _CNV_R_R_Def_dez_sl_575_CM 1 100. 0. 255. DISPLAY_IDENTIFIER BOSJZIEL ECU_ADDRESS 0xc000405c FORMAT "%3.0" /end MEASUREMENT
/begin MEASUREMENT Bosmziel "Zieltermin_Monat_BOS_Meldung_2" UBYTE _CNV_R_R_Def_dez_sl_575_CM 1 100. 0. 255. DISPLAY_IDENTIFIER BOSMZIEL ECU_ADDRESS 0xc000405d FORMAT "%3.0" /end MEASUREMENT
/begin MEASUREMENT Bosprog2 "Prognose_Intervall_Zeit_BOS_Meldung_2" UBYTE _CNV_R_R_Def_dez_sl_575_CM 1 100. 0. 255. DISPLAY_IDENTIFIER BOSPROG2 ECU_ADDRESS 0xc000405e FORMAT "%3.0" /end MEASUREMENT
/begin MEASUREMENT Bosres "Zieltermin_Monat_BOS_Rückstellung_2" UBYTE _CNV_R_R_Def_dez_sl_575_CM 1 100. 0. 255. DISPLAY_IDENTIFIER BOSRES ECU_ADDRESS 0xc000405f FORMAT "%3.0" /end MEASUREMENT
/begin MEASUREMENT Bosrlsm "Ausgabewert Restlaufstrecke Motoröl" SWORD _CNV_R_R_Def_km_sw__64_CM 1 100. -327680. 327670. DISPLAY_IDENTIFIER BOSRLSM ECU_ADDRESS 0xc0004058 FORMAT "%6.1" /end MEASUREMENT
/begin MEASUREMENT Bosrw2 "Prognose_Intervall_Weg_BOS_Meldung_2" UBYTE _CNV_R_R_Def_km_ub__443_CM 1 100. 0. 255000. DISPLAY_IDENTIFIER BOSRW2 ECU_ADDRESS 0xc0004060 FORMAT "%3.0" /end MEASUREMENT
/begin MEASUREMENT Bosstate "Einheit der BOS-Info (km)" UBYTE _CNV_R_R_Def_dez_sl_575_CM 1 100. 0. 255. DISPLAY_IDENTIFIER BOSSTATE ECU_ADDRESS 0xc0004ff0 FORMAT "%3.0" /end MEASUREMENT
/begin MEASUREMENT Ddzw_ldkr "Differenz Spätstellung d. Klopfregelung im Turbobetrieb" SWORD _CNV_R_R_Def_zw_sw__599_CM 1 100. -3276.8 3276.7 DISPLAY_IDENTIFIER DDZW_LDKR ECU_ADDRESS 0xc00026e0 FORMAT "%6.1" /end MEASUREMENT
/begin MEASUREMENT Deltadff "Gradient des vom Generator empfangenen Lastsignals" SBYTE _CNV_R_R_Def_f_sb_b_600_CM 1 100. -64. 63.5 DISPLAY_IDENTIFIER DELTADFF ECU_ADDRESS 0xc000524e FORMAT "%5.2" /end MEASUREMENT
/begin MEASUREMENT Dffgenschz "Zähler für Generatorlastschwnkungen zur Leerlauf-Solldrehzahlanhebung" UBYTE _CNV_R_R_Def_dez_sl_575_CM 1 100. 0. 255. DISPLAY_IDENTIFIER DFFGENSCHZ ECU_ADDRESS 0xc000524f FORMAT "%3.0" /end MEASUREMENT
/begin MEASUREMENT Dlasoll_stat12 "Diff. Solllambda im Brennraum ohne Pulsation Bank 1/2 (homogen)" SWORD _CNV_R_R_Def_f_sw_b_607_CM 1 100. -8. 7.9997 DISPLAY_IDENTIFIER DLASOLL_STAT12 ECU_ADDRESS 0xd00077ea FORMAT "%9.4" /end MEASUREMENT
/begin MEASUREMENT Dnkw "Drehzahlabweichung bei Leerlaufregelung" SWORD _CNV_R_R_Def_n_sw_q_612_CM 1 100. -32768. 32767. DISPLAY_IDENTIFIER DNKW ECU_ADDRESS 0xc000524a FORMAT "%5.0" /end MEASUREMENT
/begin MEASUREMENT Drf_agr_s "Differenz zum Androsseln wegen AGR in Schicht" SWORD _CNV_R_R_Def_rf_sw__616_CM 1 100. -327.68 327.67 DISPLAY_IDENTIFIER DRF_AGR_S ECU_ADDRESS 0xd000786a FORMAT "%9.4" /end MEASUREMENT
/begin MEASUREMENT Drf_soll "Delta Soll Rf im 10ms-Raster" SWORD _CNV_R_R_Def_rf_sw__616_CM 1 100. -327.68 327.67 DISPLAY_IDENTIFIER DRF_SOLL ECU_ADDRESS 0xd000770a FORMAT "%9.4" /end MEASUREMENT
/begin MEASUREMENT Drf_te_s "Delta Rf wegen TE im Schicht" SWORD _CNV_R_R_Def_rf_sw__616_CM 1 100. -327.68 327.67 DISPLAY_IDENTIFIER DRF_TE_S ECU_ADDRESS 0xd000780a FORMAT "%9.4" /end MEASUREMENT
/begin MEASUREMENT Drfopt_hs "Quotient zwichen Rf und Rfopt (homogen-schicht)" SWORD _CNV_R_R_Def_eta_sw_617_CM 1 100. -200. 199.9938 DISPLAY_IDENTIFIER DRFOPT_HS ECU_ADDRESS 0xd0007856 FORMAT "%8.3" /end MEASUREMENT
/begin MEASUREMENT Drfopt_s "Quotient zwichen Rf und Rfopt (schicht)" SWORD _CNV_R_R_Def_eta_sw_617_CM 1 100. -200. 199.9938 DISPLAY_IDENTIFIER DRFOPT_S ECU_ADDRESS 0xd00077e4 FORMAT "%8.3" /end MEASUREMENT
/begin MEASUREMENT Drfoptres_hs "Quotient zwichen Rf_soll_s und Rf_opt_s (homogen-schicht)" SWORD _CNV_R_R_Def_eta_sw_617_CM 1 100. -200. 199.9938 DISPLAY_IDENTIFIER DRFOPTRES_HS ECU_ADDRESS 0xd000785a FORMAT "%8.3" /end MEASUREMENT
/begin MEASUREMENT Drfoptres_s "Quotient zwichen Rf_soll_s und Rf_opt_s (schicht)" SWORD _CNV_R_R_Def_eta_sw_617_CM 1 100. -200. 199.9938 DISPLAY_IDENTIFIER DRFOPTRES_S ECU_ADDRESS 0xd0007858 FORMAT "%8.3" /end MEASUREMENT
/begin MEASUREMENT Dzw_krkorll "Deltazündwinkel Klopfregelung LL" SWORD _CNV_R_R_Def_zw_sw__599_CM 1 100. -50. 60. DISPLAY_IDENTIFIER DZW_KRKORLL ECU_ADDRESS 0xd00078c6 FORMAT "%6.1" /end MEASUREMENT
/begin MEASUREMENT Dzw_krkorlls "Deltazündwinkel Klopfregelung LL spät" SWORD _CNV_R_R_Def_zw_sw__624_CM 1 100. -64. 63.998 DISPLAY_IDENTIFIER DZW_KRKORLLS ECU_ADDRESS 0xd00078ca FORMAT "%8.3" /end MEASUREMENT
/begin MEASUREMENT Dzw_ldkr "Spätstellung d. Klopfregelung im Turbobetrieb" SWORD _CNV_R_R_Def_zw_sw__599_CM 1 100. -3276.8 3276.7 DISPLAY_IDENTIFIER DZW_LDKR ECU_ADDRESS 0xc00026e2 FORMAT "%6.1" /end MEASUREMENT
/begin MEASUREMENT Dzw_ldkrdyn "Spätstellung d. Klopfregelung im Turbobetrieb - dyn. Anteil" SWORD _CNV_R_R_Def_zw_sw__599_CM 1 100. -3276.8 3276.7 DISPLAY_IDENTIFIER DZW_LDKRDYN ECU_ADDRESS 0xc00026e4 FORMAT "%6.1" /end MEASUREMENT
/begin MEASUREMENT Dzw_ldkrob "Spätstellung d. klopregelung - Overboost -Betrieb" SWORD _CNV_R_R_Def_zw_sw__599_CM 1 100. -3276.8 3276.7 DISPLAY_IDENTIFIER DZW_LDKROB ECU_ADDRESS 0xc00026e6 FORMAT "%6.1" /end MEASUREMENT
/begin MEASUREMENT Dzw_ldkrstat "Spätstellung d. Klopfregelung im Turbobetrieb - stat. Anteil" SWORD _CNV_R_R_Def_zw_sw__599_CM 1 100. -3276.8 3276.7 DISPLAY_IDENTIFIER DZW_LDKRSTAT ECU_ADDRESS 0xc000468c FORMAT "%6.1" /end MEASUREMENT
/begin MEASUREMENT Eta_bas_s "" UWORD _CNV_R_R_Def_eta_uw_627_CM 1 100. 0. 199.9969 DISPLAY_IDENTIFIER ETA_BAS_S ECU_ADDRESS 0xd00076dc FORMAT "%8.3" /end MEASUREMENT
/begin MEASUREMENT Eta_hs "Gesamtwirkungsgrad (homogen-schicht)" UWORD _CNV_R_R_Def_eta_uw_627_CM 1 100. 0. 199.9969 DISPLAY_IDENTIFIER ETA_HS ECU_ADDRESS 0xd00076e2 FORMAT "%8.3" /end MEASUREMENT
/begin MEASUREMENT Eta_lamte_s "Wirkungsgrad des Lamda in Brennraum durch TE" UWORD _CNV_R_R_Def_eta_uw_627_CM 1 100. 0. 199.9969 DISPLAY_IDENTIFIER ETA_LAMTE_S ECU_ADDRESS 0xd0007860 FORMAT "%8.3" /end MEASUREMENT
/begin MEASUREMENT Eta_res "Wirkungsgrad angeforderte Momentenreserve" SWORD _CNV_R_R_Def_eta_sw_628_CM 1 100. 0. 100. DISPLAY_IDENTIFIER ETA_RES ECU_ADDRESS 0xd0007662 FORMAT "%8.3" /end MEASUREMENT
/begin MEASUREMENT Eta_rkte_s "Volumenwirkungsgrad der eingespritzten Kraftstoffmenge" UWORD _CNV_R_R_Def_eta_uw_627_CM 1 100. 0. 199.9969 DISPLAY_IDENTIFIER ETA_RKTE_S ECU_ADDRESS 0xd000785e FORMAT "%8.3" /end MEASUREMENT
/begin MEASUREMENT Eta_te_s "Wirkungsgrad TE in Schicht" UWORD _CNV_R_R_Def_eta_uw_627_CM 1 100. 0. 199.9969 DISPLAY_IDENTIFIER ETA_TE_S ECU_ADDRESS 0xd000785c FORMAT "%8.3" /end MEASUREMENT
/begin MEASUREMENT Eta_zw_minres "min Wirkungsgrad der Momentenreserve" SWORD _CNV_R_R_Def_eta_sw_628_CM 1 100. 0. 100. DISPLAY_IDENTIFIER ETA_ZW_MINRES ECU_ADDRESS 0xd000764e FORMAT "%8.3" /end MEASUREMENT
/begin MEASUREMENT Eta_zwsoll "Eta_zwsoll" SWORD _CNV_R_R_Def_eta_sw_617_CM 1 100. -200. 199.9938 DISPLAY_IDENTIFIER ETA_ZWSOLL ECU_ADDRESS 0xd0007868 FORMAT "%8.3" /end MEASUREMENT
/begin MEASUREMENT Etarf_hs "Wirkungsgrad auf Rk_kor_s (homogen-schicht)" UWORD _CNV_R_R_Def_eta_uw_627_CM 1 100. 0. 199.9969 DISPLAY_IDENTIFIER ETARF_HS ECU_ADDRESS 0xd00076e0 FORMAT "%8.3" /end MEASUREMENT
/begin MEASUREMENT Etarf_s "Wirkungsgrad auf Rk_kor_s (schicht)" UWORD _CNV_R_R_Def_eta_uw_627_CM 1 100. 0. 199.9969 DISPLAY_IDENTIFIER ETARF_S ECU_ADDRESS 0xd00076de FORMAT "%8.3" /end MEASUREMENT
/begin MEASUREMENT Etarfres_hs "Wirkungsgrad auf Rfoptres (homogen-schicht)" UWORD _CNV_R_R_Def_eta_uw_627_CM 1 100. 0. 199.9969 DISPLAY_IDENTIFIER ETARFRES_HS ECU_ADDRESS 0xd0007864 FORMAT "%8.3" /end MEASUREMENT
/begin MEASUREMENT Etarfres_s "Wirkungsgrad auf Rfoptres (schicht)" UWORD _CNV_R_R_Def_eta_uw_627_CM 1 100. 0. 199.9969 DISPLAY_IDENTIFIER ETARFRES_S ECU_ADDRESS 0xd0007862 FORMAT "%8.3" /end MEASUREMENT
/begin MEASUREMENT F_drfte_s "Faktor TE im Schicht" SWORD _CNV_R_R_Def_f_uw_b_579_CM 1 100. -1. 0.9999 DISPLAY_IDENTIFIER F_DRFTE_S ECU_ADDRESS 0xd0007802 FORMAT "%14.5" /end MEASUREMENT
/begin MEASUREMENT F_etatemin_s "" UWORD _CNV_R_R_Def_eta_uw_627_CM 1 100. 0. 199.9969 DISPLAY_IDENTIFIER F_ETATEMIN_S ECU_ADDRESS 0xd00076da FORMAT "%8.3" /end MEASUREMENT
/begin MEASUREMENT F_rk2_h "" UWORD _CNV_R_R_Def_f_uw_b_633_CM 1 100. 0. 1. DISPLAY_IDENTIFIER F_RK2_H ECU_ADDRESS 0xd0007720 FORMAT "%9.4" /end MEASUREMENT
/begin MEASUREMENT F_rkkorrf "" UWORD _CNV_R_R_Def_f_uw_b_579_CM 1 100. 0. 1.9999 DISPLAY_IDENTIFIER F_RKKORRF ECU_ADDRESS 0xd0007722 FORMAT "%14.5" ARRAY_SIZE 2 MATRIX_DIM 2 1 1 /end MEASUREMENT
/begin MEASUREMENT Frfmxkrld "Faktor f. Rfmax-Reduzierung" UWORD _CNV_R_R_Def_f_uw_b_579_CM 1 100. 0. 1.9999 DISPLAY_IDENTIFIER FRFMXKRLD ECU_ADDRESS 0xc00026ee FORMAT "%14.5" /end MEASUREMENT
/begin MEASUREMENT Frfmxkrldk "Faktor f. Rfmax-Reduz. - Kurzzeitanteil" UWORD _CNV_R_R_Def_f_uw_b_579_CM 1 100. 0. 1.9999 DISPLAY_IDENTIFIER FRFMXKRLDK ECU_ADDRESS 0xc00026f0 FORMAT "%14.5" /end MEASUREMENT
/begin MEASUREMENT Frfmxkrldl "Faktor f. Rfmax-Reduz. - Langzeitanteil" UWORD _CNV_R_R_Def_f_uw_b_579_CM 1 100. 0. 1.9999 DISPLAY_IDENTIFIER FRFMXKRLDL ECU_ADDRESS 0xc00026f2 FORMAT "%14.5" /end MEASUREMENT
/begin MEASUREMENT Frfmxkrob "Faktor f. Rfmax-Reduz. - bei Overboost" UWORD _CNV_R_R_Def_f_uw_b_579_CM 1 100. 0. 1.9999 DISPLAY_IDENTIFIER FRFMXKROB ECU_ADDRESS 0xc00026f4 FORMAT "%14.5" /end MEASUREMENT
/begin MEASUREMENT Frfmxtald "Faktor max. Fuellung" UWORD _CNV_R_R_Def_f_uw_b_579_CM 1 100. 0. 1.9999 DISPLAY_IDENTIFIER FRFMXTALD ECU_ADDRESS 0xc00026f6 FORMAT "%14.5" /end MEASUREMENT
/begin MEASUREMENT Frfmxtmld "Faktor max Fuellung" UWORD _CNV_R_R_Def_f_uw_b_579_CM 1 100. 0. 1.9999 DISPLAY_IDENTIFIER FRFMXTMLD ECU_ADDRESS 0xc00026f8 FORMAT "%14.5" /end MEASUREMENT
/begin MEASUREMENT Id_bosmg "Kennung für BOS-Meldung = Ölservice-Info" UWORD _CNV_R_R_Def_dez_sl_575_CM 1 100. 0. 65535. DISPLAY_IDENTIFIER ID_BOSMG ECU_ADDRESS 0xc0004fee FORMAT "%5.0" /end MEASUREMENT
/begin MEASUREMENT Id_bosmgt "Kennung für BOS-Meldung vom Tester" UBYTE _CNV_R_R_Def_dez_sl_575_CM 1 100. 0. 255. DISPLAY_IDENTIFIER ID_BOSMGT ECU_ADDRESS 0xc0004ff1 FORMAT "%3.0" /end MEASUREMENT
/begin MEASUREMENT Id_bosmsg "Kennung für BOS-Meldung vom Kombi" UBYTE _CNV_R_R_Def_dez_sl_575_CM 1 100. 0. 255. DISPLAY_IDENTIFIER ID_BOSMSG ECU_ADDRESS 0xc0004ff2 FORMAT "%3.0" /end MEASUREMENT
/begin MEASUREMENT Ierrgrenz_ll "Grenzerregerstrombegrenzung Generator" UBYTE _CNV_R_R_Def_i_ub_q_645_CM 1 100. 0. 31.875 DISPLAY_IDENTIFIER IERRGRENZ_LL ECU_ADDRESS 0xd00072e1 /end MEASUREMENT
/begin MEASUREMENT La_bas_h "Basis Lambda (homogen)" UWORD _CNV_R_R_Def_f_uw_b_594_CM 1 100. 0. 15.9997 DISPLAY_IDENTIFIER LA_BAS_H ECU_ADDRESS 0xd000781e FORMAT "%9.4" /end MEASUREMENT
/begin MEASUREMENT La_ist1 "Lambda-Istwert" UWORD _CNV_R_R_Def_f_uw_b_594_CM 1 100. 0. 15.9997 DISPLAY_IDENTIFIER LA_IST1 ECU_ADDRESS 0xd0007554 FORMAT "%9.4" /end MEASUREMENT
/begin MEASUREMENT La_ist2 "Lambda-Istwert Bank2" UWORD _CNV_R_R_Def_f_uw_b_594_CM 1 100. 0. 15.9997 DISPLAY_IDENTIFIER LA_IST2 ECU_ADDRESS 0xd0007558 FORMAT "%9.4" /end MEASUREMENT
/begin MEASUREMENT La_ist_m "Mittelwert der Lambda-Istwerte" UWORD _CNV_R_R_Def_f_uw_b_594_CM 1 100. 0. 15.9997 DISPLAY_IDENTIFIER LA_IST_M ECU_ADDRESS 0xd000755a FORMAT "%9.4" /end MEASUREMENT
/begin MEASUREMENT La_soll_h "Soll Lambda (homogen)" UWORD _CNV_R_R_Def_f_uw_b_594_CM 1 100. 0. 15.9997 DISPLAY_IDENTIFIER LA_SOLL_H ECU_ADDRESS 0xd0007820 FORMAT "%9.4" /end MEASUREMENT
/begin MEASUREMENT La_soll_stat1 "Solllambda im Brennraum ohne Pulsation Bank 1 (homogen)" UWORD _CNV_R_R_Def_f_uw_b_594_CM 1 100. 0. 15.9997 DISPLAY_IDENTIFIER LA_SOLL_STAT1 ECU_ADDRESS 0xd00077e6 FORMAT "%9.4" /end MEASUREMENT
/begin MEASUREMENT La_soll_stat2 "Solllambda im Brennraum ohne Pulsation Bank 2 (homogen)" UWORD _CNV_R_R_Def_f_uw_b_594_CM 1 100. 0. 15.9997 DISPLAY_IDENTIFIER LA_SOLL_STAT2 ECU_ADDRESS 0xd00077e8 FORMAT "%9.4" /end MEASUREMENT
/begin MEASUREMENT La_sollreg1 "Solllambda für Lambdaregler Bank 1 (homogen)" UWORD _CNV_R_R_Def_f_uw_b_594_CM 1 100. 0. 15.9997 DISPLAY_IDENTIFIER LA_SOLLREG1 ECU_ADDRESS 0xd00077ec FORMAT "%9.4" /end MEASUREMENT
/begin MEASUREMENT La_sollreg2 "Solllambda für Lambdaregler Bank 2 (homogen)" UWORD _CNV_R_R_Def_f_uw_b_594_CM 1 100. 0. 15.9997 DISPLAY_IDENTIFIER LA_SOLLREG2 ECU_ADDRESS 0xd00077ee FORMAT "%9.4" /end MEASUREMENT
/begin MEASUREMENT Lamb_es_s "Lambda vom Einspritzung in Schicht" UWORD _CNV_R_R_Def_f_uw_b_594_CM 1 100. 0. 15.9997 DISPLAY_IDENTIFIER LAMB_ES_S ECU_ADDRESS 0xd000781c FORMAT "%9.4" /end MEASUREMENT
/begin MEASUREMENT Lamb_te "Lambda im Brennraum durch TE" UWORD _CNV_R_R_Def_f_uw_b_594_CM 1 100. 0. 15.9997 DISPLAY_IDENTIFIER LAMB_TE ECU_ADDRESS 0xd000781a FORMAT "%9.4" /end MEASUREMENT
/begin MEASUREMENT Md_res "Momentenreserve" SWORD _CNV_R_R_Def_m_sw_q_574_CM 1 100. -3276.8 3276.7 DISPLAY_IDENTIFIER MD_RES ECU_ADDRESS 0xd0007652 FORMAT "%7.2" /end MEASUREMENT
/begin MEASUREMENT Md_res_anf "angeforderte Momentenreserve" SWORD _CNV_R_R_Def_m_sw_q_574_CM 1 100. -3276.8 3276.7 DISPLAY_IDENTIFIER MD_RES_ANF ECU_ADDRESS 0xd0007664 FORMAT "%7.2" /end MEASUREMENT
/begin MEASUREMENT Md_res_anf1 "angeforderte Momentenreserve Rohwert" SWORD _CNV_R_R_Def_m_sw_q_574_CM 1 100. -3276.8 3276.7 DISPLAY_IDENTIFIER MD_RES_ANF1 ECU_ADDRESS 0xd000766e FORMAT "%7.2" /end MEASUREMENT
/begin MEASUREMENT Md_res_katreg "Momentenreserve Katregeneration" SWORD _CNV_R_R_Def_m_sw_q_574_CM 1 100. -3276.8 3276.7 DISPLAY_IDENTIFIER MD_RES_KATREG ECU_ADDRESS 0xd000766c FORMAT "%7.2" /end MEASUREMENT
/begin MEASUREMENT Md_res_krll "Momentenreserve Klopfregelung LL" SWORD _CNV_R_R_Def_m_sw_q_574_CM 1 100. -3276.8 3276.7 DISPLAY_IDENTIFIER MD_RES_KRLL ECU_ADDRESS 0xd00078c4 FORMAT "%7.2" /end MEASUREMENT
/begin MEASUREMENT Md_res_max "max mögliche Momentenreserve" SWORD _CNV_R_R_Def_m_sw_q_574_CM 1 100. -3276.8 3276.7 DISPLAY_IDENTIFIER MD_RES_MAX ECU_ADDRESS 0xd0007654 FORMAT "%7.2" /end MEASUREMENT
/begin MEASUREMENT Mdi_bas_hs "" SWORD _CNV_R_R_Def_m_sw_q_574_CM 1 100. -3276.8 3276.7 DISPLAY_IDENTIFIER MDI_BAS_HS ECU_ADDRESS 0xd0007710 FORMAT "%7.2" /end MEASUREMENT
/begin MEASUREMENT Mdi_bas_s "" SWORD _CNV_R_R_Def_m_sw_q_574_CM 1 100. -3276.8 3276.7 DISPLAY_IDENTIFIER MDI_BAS_S ECU_ADDRESS 0xd000770e FORMAT "%7.2" /end MEASUREMENT
/begin MEASUREMENT Mdi_fzdyn_korr "" SWORD _CNV_R_R_Def_m_sw_q_574_CM 1 100. -3276.8 3276.7 DISPLAY_IDENTIFIER MDI_FZDYN_KORR ECU_ADDRESS 0xd0007668 FORMAT "%7.2" /end MEASUREMENT
/begin MEASUREMENT Mdi_fzdyn_korr1 "" SWORD _CNV_R_R_Def_m_sw_q_574_CM 1 100. -3276.8 3276.7 DISPLAY_IDENTIFIER MDI_FZDYN_KORR1 ECU_ADDRESS 0xd000766a FORMAT "%7.2" /end MEASUREMENT
/begin MEASUREMENT Mdi_min_ba "" SWORD _CNV_R_R_Def_m_sw_q_574_CM 1 100. -3276.8 3276.7 DISPLAY_IDENTIFIER MDI_MIN_BA ECU_ADDRESS 0xd0007800 FORMAT "%7.2" /end MEASUREMENT
/begin MEASUREMENT Mdi_min_hs "" SWORD _CNV_R_R_Def_m_sw_q_574_CM 1 100. -3276.8 3276.7 DISPLAY_IDENTIFIER MDI_MIN_HS ECU_ADDRESS 0xd00077fe FORMAT "%7.2" /end MEASUREMENT
/begin MEASUREMENT Mdi_min_s "" SWORD _CNV_R_R_Def_m_sw_q_574_CM 1 100. -3276.8 3276.7 DISPLAY_IDENTIFIER MDI_MIN_S ECU_ADDRESS 0xd00076d8 FORMAT "%7.2" /end MEASUREMENT
/begin MEASUREMENT Mdi_res "Inneres Moment nach Dynamikfilterung incl. Momentenreserve" SWORD _CNV_R_R_Def_m_sw_q_574_CM 1 100. -3276.8 3276.7 DISPLAY_IDENTIFIER MDI_RES ECU_ADDRESS 0xd0007660 FORMAT "%7.2" /end MEASUREMENT
/begin MEASUREMENT Mdi_res_anf "inneres Moment incl. Momentenreserve" SWORD _CNV_R_R_Def_m_sw_q_574_CM 1 100. -3276.8 3276.7 DISPLAY_IDENTIFIER MDI_RES_ANF ECU_ADDRESS 0xd0007666 FORMAT "%7.2" /end MEASUREMENT
/begin MEASUREMENT Mdi_res_anfkh "inneres Moment incl. Momentenreserve für Katheizen" SWORD _CNV_R_R_Def_m_sw_q_574_CM 1 100. -3276.8 3276.7 DISPLAY_IDENTIFIER MDI_RES_ANFKH ECU_ADDRESS 0xd0007670 FORMAT "%7.2" /end MEASUREMENT
/begin MEASUREMENT Mdi_res_anfmx "" SWORD _CNV_R_R_Def_m_sw_q_574_CM 1 100. -3276.8 3276.7 DISPLAY_IDENTIFIER MDI_RES_ANFMX ECU_ADDRESS 0xd0007650 FORMAT "%7.2" /end MEASUREMENT
/begin MEASUREMENT Mdi_res_max "inneres Moment incl. max mögliche Momentenreserve ohne Einfluss LL" SWORD _CNV_R_R_Def_m_sw_q_574_CM 1 100. -3276.8 3276.7 DISPLAY_IDENTIFIER MDI_RES_MAX ECU_ADDRESS 0xd000765c FORMAT "%7.2" /end MEASUREMENT
/begin MEASUREMENT Mdi_res_maxll "inneres Moment incl. max mögliche Momentenreserve mit Einfluss LL" SWORD _CNV_R_R_Def_m_sw_q_574_CM 1 100. -3276.8 3276.7 DISPLAY_IDENTIFIER MDI_RES_MAXLL ECU_ADDRESS 0xd000765e FORMAT "%7.2" /end MEASUREMENT
/begin MEASUREMENT Mdi_ressoll "" SWORD _CNV_R_R_Def_m_sw_q_574_CM 1 100. -3276.8 3276.7 DISPLAY_IDENTIFIER MDI_RESSOLL ECU_ADDRESS 0xd000770c FORMAT "%7.2" /end MEASUREMENT
/begin MEASUREMENT Mdi_zw_min "Minimales Zündwinkel, gefiltert" SWORD _CNV_R_R_Def_m_sw_q_574_CM 1 100. -3276.8 3276.7 DISPLAY_IDENTIFIER MDI_ZW_MIN ECU_ADDRESS 0xd0007808 FORMAT "%7.2" /end MEASUREMENT
/begin MEASUREMENT Mdi_zw_sollf "Minimales Zündwinkel, aus dem Filter" SWORD _CNV_R_R_Def_m_sw_q_574_CM 1 100. -3276.8 3276.7 DISPLAY_IDENTIFIER MDI_ZW_SOLLF ECU_ADDRESS 0xd0007804 FORMAT "%7.2" /end MEASUREMENT
/begin MEASUREMENT Mdi_zwmin_fil "Mdi_ist_m -> 0.0 Filter" SWORD _CNV_R_R_Def_m_sw_q_574_CM 1 100. -3276.8 3276.7 DISPLAY_IDENTIFIER MDI_ZWMIN_FIL ECU_ADDRESS 0xd0007806 FORMAT "%7.2" /end MEASUREMENT
/begin MEASUREMENT Mdk_res "Kupplungsmoment nach Dynamikfilterung incl. Momentenreserve" SWORD _CNV_R_R_Def_m_sw_q_574_CM 1 100. -3276.8 3276.7 DISPLAY_IDENTIFIER MDK_RES ECU_ADDRESS 0xd0007656 FORMAT "%7.2" /end MEASUREMENT
/begin MEASUREMENT Mk_hom_soll_1 "Soll-Kraftstoffmasse Bank1 homogen" UWORD _CNV_R_R_Def_mk_uw__661_CM 1 100. 0. 1389. DISPLAY_IDENTIFIER MK_HOM_SOLL_1 ECU_ADDRESS 0xd00077ac FORMAT "%7.2" ARRAY_SIZE 2 MATRIX_DIM 2 1 1 /end MEASUREMENT
/begin MEASUREMENT Mk_hom_soll_2 "Soll-Kraftstoffmasse Bank2 homogen" UWORD _CNV_R_R_Def_mk_uw__661_CM 1 100. 0. 1389. DISPLAY_IDENTIFIER MK_HOM_SOLL_2 ECU_ADDRESS 0xd00077b0 FORMAT "%7.2" ARRAY_SIZE 2 MATRIX_DIM 2 1 1 /end MEASUREMENT
/begin MEASUREMENT Mk_soll_h "Soll-Kraftstoffmasse homogen zylinderindividuell" UWORD _CNV_R_R_Def_mk_uw__661_CM 1 100. 0. 1389. DISPLAY_IDENTIFIER MK_SOLL_H ECU_ADDRESS 0xd00077b4 FORMAT "%7.2" ARRAY_SIZE 12 MATRIX_DIM 6 2 1 /end MEASUREMENT
/begin MEASUREMENT Mk_soll_s "Soll-Kraftstoffmasse schicht" UWORD _CNV_R_R_Def_mk_uw__661_CM 1 100. 0. 1389. DISPLAY_IDENTIFIER MK_SOLL_S ECU_ADDRESS 0xd0007726 FORMAT "%7.2" /end MEASUREMENT
/begin MEASUREMENT Mkzyl_soll_hs "Soll-Kraftstoffmasse homogen-schicht zylinderindividuell" UWORD _CNV_R_R_Def_mk_uw__661_CM 1 100. 0. 1389. DISPLAY_IDENTIFIER MKZYL_SOLL_HS ECU_ADDRESS 0xd000774c FORMAT "%7.2" ARRAY_SIZE 12 MATRIX_DIM 6 2 1 /end MEASUREMENT
/begin MEASUREMENT Mkzyl_soll_s "Soll-Kraftstoffmasse schicht zylinderindividuell" UWORD _CNV_R_R_Def_mk_uw__661_CM 1 100. 0. 1389. DISPLAY_IDENTIFIER MKZYL_SOLL_S ECU_ADDRESS 0xd0007728 FORMAT "%7.2" ARRAY_SIZE 18 MATRIX_DIM 6 3 1 /end MEASUREMENT
/begin MEASUREMENT Ms_res_max "max Luftmassenstrom der durch Momentenreserve angefordert werden kann" UWORD _CNV_R_R_Def_ms_uw__611_CM 1 100. 0. 2047.9687 DISPLAY_IDENTIFIER MS_RES_MAX ECU_ADDRESS 0xd000765a FORMAT "%8.3" /end MEASUREMENT
/begin MEASUREMENT Mslam "Massenstrom aus Lambda und Kraftstoffmasse berechnet" UWORD _CNV_R_R_Def_ms_uw__611_CM 1 100. 0. 2047.9687 DISPLAY_IDENTIFIER MSLAM ECU_ADDRESS 0xd0007550 FORMAT "%8.3" /end MEASUREMENT
/begin MEASUREMENT Mslam1 "Massenstrom aus Lambda und Kraftstoffmasse berechnet Bank 1" UWORD _CNV_R_R_Def_ms_uw__611_CM 1 100. 0. 2047.9687 DISPLAY_IDENTIFIER MSLAM1 ECU_ADDRESS 0xd0007552 FORMAT "%8.3" /end MEASUREMENT
/begin MEASUREMENT Mslam2 "Massenstrom aus Lambda und Kraftstoffmasse berechnet Bank 2" UWORD _CNV_R_R_Def_ms_uw__611_CM 1 100. 0. 2047.9687 DISPLAY_IDENTIFIER MSLAM2 ECU_ADDRESS 0xd0007556 FORMAT "%8.3" /end MEASUREMENT
/begin MEASUREMENT N_ozmw "kurzzeitiger Mittelwert Drehzahl" SWORD _CNV_R_R_Def_n_sw_q_612_CM 1 100. -32767. 32767. DISPLAY_IDENTIFIER N_OZMW ECU_ADDRESS 0xc000501e FORMAT "%5.0" /end MEASUREMENT
/begin MEASUREMENT Oz_abstellm "Abstellzeit für OZ" UWORD _CNV_R_R_Def_tn_uw__671_CM 1 100. 0. 65535. DISPLAY_IDENTIFIER OZ_ABSTELLM ECU_ADDRESS 0xc00040a4 FORMAT "%7.2" /end MEASUREMENT
/begin MEASUREMENT Oz_beschcnt "Zähler Beschleunigungsausblendung" UBYTE _CNV_R_R_Def_dez_sl_575_CM 1 100. 0. 255. DISPLAY_IDENTIFIER OZ_BESCHCNT ECU_ADDRESS 0xc0005035 FORMAT "%3.0" /end MEASUREMENT
/begin MEASUREMENT Oz_cttagini "Tag beim Ölwechsel" SWORD _CNV_R_R_Def_dez_sl_575_CM 1 100. -32768. 32767. DISPLAY_IDENTIFIER OZ_CTTAGINI ECU_ADDRESS 0xc000410a FORMAT "%5.0" /end MEASUREMENT
/begin MEASUREMENT Oz_dkm "" UWORD _CNV_R_R_Def_f_uw_b_629_CM 1 100. 0. 9.999800000000001 DISPLAY_IDENTIFIER OZ_DKM ECU_ADDRESS 0xc000502a FORMAT "%9.4" /end MEASUREMENT
/begin MEASUREMENT Oz_dpermsi "" SBYTE _CNV_R_R_Def_dez_sl_575_CM 1 100. -128. 127. DISPLAY_IDENTIFIER OZ_DPERMSI ECU_ADDRESS 0xc0005052 FORMAT "%3.0" /end MEASUREMENT
/begin MEASUREMENT Oz_hoehe "" SWORD _CNV_R_R_Def_f_sw_b_607_CM 1 100. -8. 7.9997 DISPLAY_IDENTIFIER OZ_HOEHE ECU_ADDRESS 0xc0005020 FORMAT "%9.4" /end MEASUREMENT
/begin MEASUREMENT Oz_intprog "Prognose_Intervall_Zeit_BOS_Meldung_2" UBYTE _CNV_R_R_Def_dez_sl_575_CM 1 100. 0. 255. DISPLAY_IDENTIFIER OZ_INTPROG ECU_ADDRESS 0xc0005090 FORMAT "%3.0" /end MEASUREMENT
/begin MEASUREMENT Oz_kmlow "Kilometerstand letzter Ölwechsel" SWORD _CNV_R_R_Def_km_sw__64_CM 1 100. -327680. 327670. DISPLAY_IDENTIFIER OZ_KMLOW ECU_ADDRESS 0xc0004066 FORMAT "%6.1" /end MEASUREMENT
/begin MEASUREMENT Oz_kmreg "Schieberegister Kilometerstand" UWORD _CNV_R_R_Def_km_sw__64_CM 1 100. 0. 655350. DISPLAY_IDENTIFIER OZ_KMREG ECU_ADDRESS 0xc00040b8 FORMAT "%5.0" ARRAY_SIZE 15 MATRIX_DIM 15 1 1 /end MEASUREMENT
/begin MEASUREMENT Oz_kmstrw0 "Kilometerstand bei Restweg = Null" UWORD _CNV_R_R_Def_km_sw__64_CM 1 100. 0. 655350. DISPLAY_IDENTIFIER OZ_KMSTRW0 ECU_ADDRESS 0xc000410e FORMAT "%5.0" /end MEASUREMENT
/begin MEASUREMENT Oz_krz2cnt "KurzMw 2 Zähler" UBYTE _CNV_R_R_Def_dez_sl_575_CM 1 100. 0. 255. DISPLAY_IDENTIFIER OZ_KRZ2CNT ECU_ADDRESS 0xc0005036 FORMAT "%3.0" /end MEASUREMENT
/begin MEASUREMENT Oz_krzcnt "" UBYTE _CNV_R_R_Def_dez_sl_575_CM 1 100. 0. 255. DISPLAY_IDENTIFIER OZ_KRZCNT ECU_ADDRESS 0xc0005037 FORMAT "%3.0" /end MEASUREMENT
/begin MEASUREMENT Oz_krzkor2 "Mittelwert von zwei KurzMw" UBYTE _CNV_R_R_Def_niv_ub_672_CM 1 100. 0. 74.70699999999999 DISPLAY_IDENTIFIER OZ_KRZKOR2 ECU_ADDRESS 0xc0005038 FORMAT "%5.2" /end MEASUREMENT
/begin MEASUREMENT Oz_krzkor2k "Mittelwert von zwei KurzMw Steigungs korrigiert" UBYTE _CNV_R_R_Def_niv_ub_672_CM 1 100. 0. 74.70699999999999 DISPLAY_IDENTIFIER OZ_KRZKOR2K ECU_ADDRESS 0xc0005039 FORMAT "%5.2" /end MEASUREMENT
/begin MEASUREMENT Oz_krzmw "" UBYTE _CNV_R_R_Def_niv_ub_672_CM 1 100. 0. 74.70699999999999 DISPLAY_IDENTIFIER OZ_KRZMW ECU_ADDRESS 0xc000503a FORMAT "%5.2" /end MEASUREMENT
/begin MEASUREMENT Oz_krzmwkor "" UBYTE _CNV_R_R_Def_niv_ub_672_CM 1 100. 0. 74.70699999999999 DISPLAY_IDENTIFIER OZ_KRZMWKOR ECU_ADDRESS 0xc000503b FORMAT "%5.2" /end MEASUREMENT
/begin MEASUREMENT Oz_krzor "kurzzeitiger Mittelwert Orientierungsmessung Niveau" UBYTE _CNV_R_R_Def_niv_ub_672_CM 1 100. 0. 74.70699999999999 DISPLAY_IDENTIFIER OZ_KRZOR ECU_ADDRESS 0xc0005014 FORMAT "%5.2" /end MEASUREMENT
/begin MEASUREMENT Oz_kvbdiff "" ULONG _CNV_R_R_Def_fuel_u_673_CM 1 100. 0. 100. DISPLAY_IDENTIFIER OZ_KVBDIFF ECU_ADDRESS 0xc0005092 FORMAT "%11.4" /end MEASUREMENT
/begin MEASUREMENT Oz_kvbmw "" ULONG _CNV_R_R_Def_fuel_u_673_CM 1 100. 0. 100. DISPLAY_IDENTIFIER OZ_KVBMW ECU_ADDRESS 0xc0004102 FORMAT "%11.4" /end MEASUREMENT
/begin MEASUREMENT Oz_kvbmwtmp "" UWORD _CNV_R_R_Def_f_uw_b_580_CM 1 100. 0. 63.999 DISPLAY_IDENTIFIER OZ_KVBMWTMP ECU_ADDRESS 0xc000509e FORMAT "%9.4" /end MEASUREMENT
/begin MEASUREMENT Oz_kvbmx "" UWORD _CNV_R_R_Def_dez_sl_575_CM 1 100. 0. 65535. DISPLAY_IDENTIFIER OZ_KVBMX ECU_ADDRESS 0xc00050a0 FORMAT "%5.0" /end MEASUREMENT
/begin MEASUREMENT Oz_kvbog "zugeteilte Bonuskraftstoffmenge" UWORD _CNV_R_R_Def_dez_sl_575_CM 1 100. 0. 65535. DISPLAY_IDENTIFIER OZ_KVBOG ECU_ADDRESS 0xc0004110 FORMAT "%5.0" /end MEASUREMENT
/begin MEASUREMENT Oz_kvbsm "" ULONG _CNV_R_R_Def_fuel_u_673_CM 1 100. 0. 10000. DISPLAY_IDENTIFIER OZ_KVBSM ECU_ADDRESS 0xc0005096 FORMAT "%11.4" /end MEASUREMENT
/begin MEASUREMENT Oz_kvbsm_ul "" ULONG _CNV_R_R_Def_fuel_u_673_CM 1 100. 0. 524287.9998 DISPLAY_IDENTIFIER OZ_KVBSM_UL ECU_ADDRESS 0xc0004106 FORMAT "%11.4" /end MEASUREMENT
/begin MEASUREMENT Oz_kvbtmp2 "" UWORD _CNV_R_R_Def_km_sw__64_CM 1 100. 0. 655350. DISPLAY_IDENTIFIER OZ_KVBTMP2 ECU_ADDRESS 0xc00050a2 FORMAT "%5.0" /end MEASUREMENT
/begin MEASUREMENT Oz_langmw "Langzeitmittelwert berechnet" UBYTE _CNV_R_R_Def_niv_ub_672_CM 1 100. 0. 74.70699999999999 DISPLAY_IDENTIFIER OZ_LANGMW ECU_ADDRESS 0xc00040ac FORMAT "%5.2" /end MEASUREMENT
/begin MEASUREMENT Oz_lbmw "" SBYTE _CNV_R_R_Def_f_sb_b_674_CM 1 100. -2. 1.9843 DISPLAY_IDENTIFIER OZ_LBMW ECU_ADDRESS 0xc0005032 FORMAT "%5.2" /end MEASUREMENT
/begin MEASUREMENT Oz_leit_dum "" UBYTE _CNV_R_R_Def_dez_sl_575_CM 1 100. 0. 255. DISPLAY_IDENTIFIER OZ_LEIT_DUM ECU_ADDRESS 0xc0005010 FORMAT "%3.0" /end MEASUREMENT
/begin MEASUREMENT Oz_lf1t "Länderfaktor 1" UBYTE _CNV_R_R_Def_lf_ub__675_CM 1 100. 0. 2.55 DISPLAY_IDENTIFIER OZ_LF1T ECU_ADDRESS 0xc0004116 FORMAT "%5.2" /end MEASUREMENT
/begin MEASUREMENT Oz_lf2t "Länderfaktor 2" UBYTE _CNV_R_R_Def_lf_ub__675_CM 1 100. 0. 2.55 DISPLAY_IDENTIFIER OZ_LF2T ECU_ADDRESS 0xc0004117 FORMAT "%5.2" /end MEASUREMENT
/begin MEASUREMENT Oz_lgmwcnt "" UBYTE _CNV_R_R_Def_dez_sl_575_CM 1 100. 0. 255. DISPLAY_IDENTIFIER OZ_LGMWCNT ECU_ADDRESS 0xc000503c FORMAT "%3.0" /end MEASUREMENT
/begin MEASUREMENT Oz_litges "Gesamtverbrauch für Ölwechsel" UWORD _CNV_R_R_Def_dez_sl_575_CM 1 100. 0. 65535. DISPLAY_IDENTIFIER OZ_LITGES ECU_ADDRESS 0xc00050a4 FORMAT "%5.0" /end MEASUREMENT
/begin MEASUREMENT Oz_litgesk "Gesamtverbrauch für Ölwechsel" UWORD _CNV_R_R_Def_dez_sl_575_CM 1 100. 0. 65535. DISPLAY_IDENTIFIER OZ_LITGESK ECU_ADDRESS 0xc00050a6 FORMAT "%5.0" /end MEASUREMENT
/begin MEASUREMENT Oz_lowcnt "Zähler zur Sicherung der Ölwechselinformationen" UBYTE _CNV_R_R_Def_dez_sl_575_CM 1 100. 0. 255. DISPLAY_IDENTIFIER OZ_LOWCNT ECU_ADDRESS 0xc000409d FORMAT "%3.0" /end MEASUREMENT
/begin MEASUREMENT Oz_lowkm "Register für KM-Stand beim Ölwechsel" UWORD _CNV_R_R_Def_km_sw__64_CM 1 100. 0. 655350. DISPLAY_IDENTIFIER OZ_LOWKM ECU_ADDRESS 0xc0004074 FORMAT "%5.0" ARRAY_SIZE 6 MATRIX_DIM 6 1 1 /end MEASUREMENT
/begin MEASUREMENT Oz_lowperex "Register für extrapoliertes Er beim Ölwechsel" UWORD _CNV_R_R_Def_perm_u_676_CM 1 100. 0. 5.9999 DISPLAY_IDENTIFIER OZ_LOWPEREX ECU_ADDRESS 0xc0004080 FORMAT "%14.5" ARRAY_SIZE 6 MATRIX_DIM 6 1 1 /end MEASUREMENT
/begin MEASUREMENT Oz_lowperm0 "Register für Er nach Ölwechsel" UWORD _CNV_R_R_Def_perm_u_676_CM 1 100. 0. 5.9999 DISPLAY_IDENTIFIER OZ_LOWPERM0 ECU_ADDRESS 0xc000408c FORMAT "%14.5" ARRAY_SIZE 6 MATRIX_DIM 6 1 1 /end MEASUREMENT
/begin MEASUREMENT Oz_lowrwanz "Register für Restweganzeige beim Ölwechsel" SWORD _CNV_R_R_Def_km_sw__64_CM 1 100. -327680. 327670. DISPLAY_IDENTIFIER OZ_LOWRWANZ ECU_ADDRESS 0xc0004068 FORMAT "%6.1" ARRAY_SIZE 6 MATRIX_DIM 6 1 1 /end MEASUREMENT
/begin MEASUREMENT Oz_lp "oz level picture" UBYTE _CNV_R_R_Def_dez_sl_575_CM 1 100. 0. 255. DISPLAY_IDENTIFIER OZ_LP ECU_ADDRESS 0xc0005015 FORMAT "%3.0" /end MEASUREMENT
/begin MEASUREMENT Oz_lv "oz level value" UBYTE _CNV_R_R_Def_dez_sl_575_CM 1 100. 0. 255. DISPLAY_IDENTIFIER OZ_LV ECU_ADDRESS 0xc0005016 FORMAT "%3.0" /end MEASUREMENT
/begin MEASUREMENT Oz_manip "geänderter Servicezähler" UBYTE _CNV_R_R_Def_dez_sl_575_CM 1 100. 0. 255. DISPLAY_IDENTIFIER OZ_MANIP ECU_ADDRESS 0xc0005000 FORMAT "%3.0" /end MEASUREMENT
/begin MEASUREMENT Oz_manipt "Manipulation" UBYTE _CNV_R_R_Def_dez_sl_575_CM 1 100. 0. 255. DISPLAY_IDENTIFIER OZ_MANIPT ECU_ADDRESS 0xc000409e FORMAT "%3.0" /end MEASUREMENT
/begin MEASUREMENT Oz_niv "Ölniveau ungefiltert" UBYTE _CNV_R_R_Def_niv_ub_672_CM 1 100. 0. 74.70699999999999 DISPLAY_IDENTIFIER OZ_NIV ECU_ADDRESS 0xc0005001 FORMAT "%5.2" /end MEASUREMENT
/begin MEASUREMENT Oz_nivakt "Aktuelles Niveau für den Tester" UBYTE _CNV_R_R_Def_niv_ub_672_CM 1 100. 0. 74.70699999999999 DISPLAY_IDENTIFIER OZ_NIVAKT ECU_ADDRESS 0xc0005017 FORMAT "%5.2" /end MEASUREMENT
/begin MEASUREMENT Oz_nivkm "letzter Kilometerstand bei dem ein neuer Langzeitmittelwert Niveau vorlag und kein Öl nachgefüllt wurde" UWORD _CNV_R_R_Def_km_sw__64_CM 1 100. 0. 655350. DISPLAY_IDENTIFIER OZ_NIVKM ECU_ADDRESS 0xc00040d6 FORMAT "%5.0" /end MEASUREMENT
/begin MEASUREMENT Oz_nivkor "Aktuelles Niveau Temperatur korrigiert" UBYTE _CNV_R_R_Def_niv_ub_672_CM 1 100. 0. 74.70699999999999 DISPLAY_IDENTIFIER OZ_NIVKOR ECU_ADDRESS 0xc000503d FORMAT "%5.2" /end MEASUREMENT
/begin MEASUREMENT Oz_nivkrzt "Kurzmittelwert-Niveau für den Tester" UBYTE _CNV_R_R_Def_niv_ub_672_CM 1 100. 0. 74.70699999999999 DISPLAY_IDENTIFIER OZ_NIVKRZT ECU_ADDRESS 0xc0005018 FORMAT "%5.2" /end MEASUREMENT
/begin MEASUREMENT Oz_nivlanglit "LangMw in Liter" UBYTE _CNV_R_R_Def_niv_ub_677_CM 1 100. 0. 25.5 DISPLAY_IDENTIFIER OZ_NIVLANGLIT ECU_ADDRESS 0xc00050a8 FORMAT "%5.2" /end MEASUREMENT
/begin MEASUREMENT Oz_nivlangt "Langmittelwert für den Tester" UBYTE _CNV_R_R_Def_niv_ub_672_CM 1 100. 0. 74.70699999999999 DISPLAY_IDENTIFIER OZ_NIVLANGT ECU_ADDRESS 0xc00040ad FORMAT "%5.2" /end MEASUREMENT
/begin MEASUREMENT Oz_nivlit "Ölniveau in Liter" UBYTE _CNV_R_R_Def_niv_ub_677_CM 1 100. 0. 25.5 DISPLAY_IDENTIFIER OZ_NIVLIT ECU_ADDRESS 0xc0005019 FORMAT "%5.2" /end MEASUREMENT
/begin MEASUREMENT Oz_nivnfm "Nachfüllmenge" UBYTE _CNV_R_R_Def_niv_ub_678_CM 1 100. 0. 7.9687 DISPLAY_IDENTIFIER OZ_NIVNFM ECU_ADDRESS 0xc000501a FORMAT "%5.2" /end MEASUREMENT
/begin MEASUREMENT Oz_nivrers "Ersatzniveau-Rohwert" UBYTE _CNV_R_R_Def_dez_sl_575_CM 1 100. 0. 255. DISPLAY_IDENTIFIER OZ_NIVRERS ECU_ADDRESS 0xc000500a FORMAT "%3.0" /end MEASUREMENT
/begin MEASUREMENT Oz_nivt "begrenzter Niveau-Rohwert" UBYTE _CNV_R_R_Def_dez_sl_575_CM 1 100. 0. 255. DISPLAY_IDENTIFIER OZ_NIVT ECU_ADDRESS 0xc000500b FORMAT "%3.0" /end MEASUREMENT
/begin MEASUREMENT Oz_nivzeit "Zeit nach dem KF_OZZEIT" UWORD _CNV_R_R_Def_td_uw__679_CM 1 100. 0. 655.35 DISPLAY_IDENTIFIER OZ_NIVZEIT ECU_ADDRESS 0xc000502c FORMAT "%7.2" /end MEASUREMENT
/begin MEASUREMENT Oz_nmotf "" SWORD _CNV_R_R_Def_n_sw_q_612_CM 1 100. -32768. 32767. DISPLAY_IDENTIFIER OZ_NMOTF ECU_ADDRESS 0xc0005022 FORMAT "%5.0" /end MEASUREMENT
/begin MEASUREMENT Oz_nmotfm "Drehzehlmittelwert Töns" SWORD _CNV_R_R_Def_n_sw_q_612_CM 1 100. -32768. 32767. DISPLAY_IDENTIFIER OZ_NMOTFM ECU_ADDRESS 0xc0005024 FORMAT "%5.0" /end MEASUREMENT
/begin MEASUREMENT Oz_oelkm "Ölkilometer" UWORD _CNV_R_R_Def_km_sw__64_CM 1 100. 0. 655350. DISPLAY_IDENTIFIER OZ_OELKM ECU_ADDRESS 0xc0004098 FORMAT "%5.0" /end MEASUREMENT
/begin MEASUREMENT Oz_oelnivak "" UBYTE _CNV_R_R_Def_td_ub__680_CM 1 100. 0. 127.5 DISPLAY_IDENTIFIER OZ_OELNIVAK ECU_ADDRESS 0xc000503e /end MEASUREMENT
/begin MEASUREMENT Oz_oelnivaknk "" UBYTE _CNV_R_R_Def_td_ub__680_CM 1 100. 0. 127.5 DISPLAY_IDENTIFIER OZ_OELNIVAKNK ECU_ADDRESS 0xc000503f /end MEASUREMENT
/begin MEASUREMENT Oz_oelnivkurz "" UBYTE _CNV_R_R_Def_td_ub__680_CM 1 100. 0. 127.5 DISPLAY_IDENTIFIER OZ_OELNIVKURZ ECU_ADDRESS 0xc0005040 /end MEASUREMENT
/begin MEASUREMENT Oz_oelnivm "10er Mittelwert Töns nicht korrigiet" UBYTE _CNV_R_R_Def_td_ub__680_CM 1 100. 0. 127.5 DISPLAY_IDENTIFIER OZ_OELNIVM ECU_ADDRESS 0xc0005041 /end MEASUREMENT
/begin MEASUREMENT Oz_oelnivnorm "" UBYTE _CNV_R_R_Def_td_ub__680_CM 1 100. 0. 127.5 DISPLAY_IDENTIFIER OZ_OELNIVNORM ECU_ADDRESS 0xc0005042 /end MEASUREMENT
/begin MEASUREMENT Oz_oelnivori "" UBYTE _CNV_R_R_Def_td_ub__680_CM 1 100. 0. 127.5 DISPLAY_IDENTIFIER OZ_OELNIVORI ECU_ADDRESS 0xc0005043 /end MEASUREMENT
/begin MEASUREMENT Oz_oelverbr "Berechneter Ölverbrauch" UWORD _CNV_R_R_Def_dez_sl_575_CM 1 100. 0. 65535. DISPLAY_IDENTIFIER OZ_OELVERBR ECU_ADDRESS 0xc00040a6 FORMAT "%5.0" /end MEASUREMENT
/begin MEASUREMENT Oz_oelzeit "Öl-Alter in Monate" UWORD _CNV_R_R_Def_dez_sl_575_CM 1 100. 0. 65535. DISPLAY_IDENTIFIER OZ_OELZEIT ECU_ADDRESS 0xc000508a FORMAT "%5.0" /end MEASUREMENT
/begin MEASUREMENT Oz_oelzeitt "Öl-Alter in Tage" UWORD _CNV_R_R_Def_dez_sl_575_CM 1 100. 0. 65535. DISPLAY_IDENTIFIER OZ_OELZEITT ECU_ADDRESS 0xc000508c FORMAT "%5.0" /end MEASUREMENT
/begin MEASUREMENT Oz_oricnt "Orientierungszähler" UBYTE _CNV_R_R_Def_dez_sl_575_CM 1 100. 0. 255. DISPLAY_IDENTIFIER OZ_ORICNT ECU_ADDRESS 0xc0005044 FORMAT "%3.0" /end MEASUREMENT
/begin MEASUREMENT Oz_orikor "OriMw korrigiert" UBYTE _CNV_R_R_Def_niv_ub_672_CM 1 100. 0. 74.70699999999999 DISPLAY_IDENTIFIER OZ_ORIKOR ECU_ADDRESS 0xc000501b FORMAT "%5.2" /end MEASUREMENT
/begin MEASUREMENT Oz_peil "" UBYTE _CNV_R_R_Def_niv_ub_672_CM 1 100. 0. 74.70699999999999 DISPLAY_IDENTIFIER OZ_PEIL ECU_ADDRESS 0xc0005045 FORMAT "%5.2" /end MEASUREMENT
/begin MEASUREMENT Oz_peilaltanz "Letzter Wert, der die Anzeige geändert hat" UBYTE _CNV_R_R_Def_niv_ub_672_CM 1 100. 0. 74.70699999999999 DISPLAY_IDENTIFIER OZ_PEILALTANZ ECU_ADDRESS 0xc00040ae FORMAT "%5.2" /end MEASUREMENT
/begin MEASUREMENT Oz_peilkm "Max Ziel km im Fehlerfall" UWORD _CNV_R_R_Def_km_sw__64_CM 1 100. 0. 655350. DISPLAY_IDENTIFIER OZ_PEILKM ECU_ADDRESS 0xc000502e FORMAT "%5.0" /end MEASUREMENT
/begin MEASUREMENT Oz_peilkmalt "Km Stand beim 1. Sensorfehler" UWORD _CNV_R_R_Def_km_sw__64_CM 1 100. 0. 655350. DISPLAY_IDENTIFIER OZ_PEILKMALT ECU_ADDRESS 0xc00040a8 FORMAT "%5.0" /end MEASUREMENT
/begin MEASUREMENT Oz_peillang "Letzter angeforderter Wert für die Peilstabanzeige" UBYTE _CNV_R_R_Def_niv_ub_672_CM 1 100. 0. 74.70699999999999 DISPLAY_IDENTIFIER OZ_PEILLANG ECU_ADDRESS 0xc00040af FORMAT "%5.2" /end MEASUREMENT
/begin MEASUREMENT Oz_peiloben "Obere Grenze aktuelles Balkens" UBYTE _CNV_R_R_Def_niv_ub_672_CM 1 100. 0. 74.70699999999999 DISPLAY_IDENTIFIER OZ_PEILOBEN ECU_ADDRESS 0xc0005046 FORMAT "%5.2" /end MEASUREMENT
/begin MEASUREMENT Oz_peilunten "Obere Grenze aktuelles Balkens" UBYTE _CNV_R_R_Def_niv_ub_672_CM 1 100. 0. 74.70699999999999 DISPLAY_IDENTIFIER OZ_PEILUNTEN ECU_ADDRESS 0xc0005047 FORMAT "%5.2" /end MEASUREMENT
/begin MEASUREMENT Oz_perm "Permittivität ungefiltert" UWORD _CNV_R_R_Def_perm_u_676_CM 1 100. 0. 5.9999 DISPLAY_IDENTIFIER OZ_PERM ECU_ADDRESS 0xc0004ffc FORMAT "%14.5" /end MEASUREMENT
/begin MEASUREMENT Oz_permakt "Permittivität für den Tester" UWORD _CNV_R_R_Def_perm_u_676_CM 1 100. 0. 5.9999 DISPLAY_IDENTIFIER OZ_PERMAKT ECU_ADDRESS 0xc0004ffe FORMAT "%14.5" /end MEASUREMENT
/begin MEASUREMENT Oz_permanz "Anzahl der Messwerte im Schieberegister" SBYTE _CNV_R_R_Def_dez_sl_575_CM 1 100. -128. 127. DISPLAY_IDENTIFIER OZ_PERMANZ ECU_ADDRESS 0xc00040fe FORMAT "%3.0" /end MEASUREMENT
/begin MEASUREMENT Oz_permbog "zugeteilter Permittivitätsbonus" UWORD _CNV_R_R_Def_perm_u_676_CM 1 100. 0. 5.9999 DISPLAY_IDENTIFIER OZ_PERMBOG ECU_ADDRESS 0xc0004112 FORMAT "%14.5" /end MEASUREMENT
/begin MEASUREMENT Oz_permex "Permittivität für Bewertung aufbereitet (extrapoliert)" UWORD _CNV_R_R_Def_perm_u_676_CM 1 100. 0. 5.9999 DISPLAY_IDENTIFIER OZ_PERMEX ECU_ADDRESS 0xc00040d8 FORMAT "%14.5" /end MEASUREMENT
/begin MEASUREMENT Oz_permlow "aufbereitete Permittivität bei letztem Ölwechsel" UWORD _CNV_R_R_Def_perm_u_676_CM 1 100. 0. 5.9999 DISPLAY_IDENTIFIER OZ_PERMLOW ECU_ADDRESS 0xc00040da FORMAT "%14.5" /end MEASUREMENT
/begin MEASUREMENT Oz_permoff "Offset für Permittivitätskorrektur" UWORD _CNV_R_R_Def_perm_u_676_CM 1 100. 0. 5.9999 DISPLAY_IDENTIFIER OZ_PERMOFF ECU_ADDRESS 0xc0005050 FORMAT "%14.5" /end MEASUREMENT
/begin MEASUREMENT Oz_permoff_oz "Offset für Permittivitätskorrektur" SWORD _CNV_R_R_Def_perm_s_681_CM 1 100. -6. 5.9998 DISPLAY_IDENTIFIER OZ_PERMOFF_OZ ECU_ADDRESS 0xc00040b6 FORMAT "%9.4" /end MEASUREMENT
/begin MEASUREMENT Oz_permreg "Schieberegister Permittivität" UWORD _CNV_R_R_Def_perm_u_676_CM 1 100. 0. 5.9999 DISPLAY_IDENTIFIER OZ_PERMREG ECU_ADDRESS 0xc00040dc FORMAT "%14.5" ARRAY_SIZE 15 MATRIX_DIM 15 1 1 /end MEASUREMENT
/begin MEASUREMENT Oz_permt "begrenzter Permittivitäts-Rohwert" UWORD _CNV_R_R_Def_dez_sl_575_CM 1 100. 0. 1024. DISPLAY_IDENTIFIER OZ_PERMT ECU_ADDRESS 0xc0005006 FORMAT "%5.0" /end MEASUREMENT
/begin MEASUREMENT Oz_perref "Ersatzpermittivität" UWORD _CNV_R_R_Def_dez_sl_575_CM 1 100. 0. 1024. DISPLAY_IDENTIFIER OZ_PERREF ECU_ADDRESS 0xc000409a FORMAT "%5.0" /end MEASUREMENT
/begin MEASUREMENT Oz_prfstrg "Zähler für Delta Er-Ermittlung" UWORD _CNV_R_R_Def_dez_sl_575_CM 1 100. 0. 65535. DISPLAY_IDENTIFIER OZ_PRFSTRG ECU_ADDRESS 0xc00040fa FORMAT "%5.0" /end MEASUREMENT
/begin MEASUREMENT Oz_pzdivp "Verhältnis oz_luftalt/oz_luftneu" UWORD _CNV_R_R_Def_f_uw_b_579_CM 1 100. 0. 1.9999 DISPLAY_IDENTIFIER OZ_PZDIVP ECU_ADDRESS 0xc0005030 FORMAT "%14.5" /end MEASUREMENT
/begin MEASUREMENT Oz_qbmw "" SBYTE _CNV_R_R_Def_f_sb_b_674_CM 1 100. -2. 1.9843 DISPLAY_IDENTIFIER OZ_QBMW ECU_ADDRESS 0xc0005033 FORMAT "%5.2" /end MEASUREMENT
/begin MEASUREMENT Oz_reset "Zieltermin_Monat_BOS_Rückstellung_2" UBYTE _CNV_R_R_Def_dez_sl_575_CM 1 100. 0. 255. DISPLAY_IDENTIFIER OZ_RESET ECU_ADDRESS 0xc0004ff3 FORMAT "%3.0" /end MEASUREMENT
/begin MEASUREMENT Oz_rwanz "anzuzeigender Restweg" SWORD _CNV_R_R_Def_km_sw__64_CM 1 100. -327680. 327670. DISPLAY_IDENTIFIER OZ_RWANZ ECU_ADDRESS 0xc000410c FORMAT "%6.1" /end MEASUREMENT
/begin MEASUREMENT Oz_rwde "Restweg laut Dieseleintrag" SWORD _CNV_R_R_Def_km_sw__64_CM 1 100. -327680. 327670. DISPLAY_IDENTIFIER OZ_RWDE ECU_ADDRESS 0xc000509a FORMAT "%6.1" /end MEASUREMENT
/begin MEASUREMENT Oz_rwkvb "" SWORD _CNV_R_R_Def_km_sw__64_CM 1 100. -327680. 327670. DISPLAY_IDENTIFIER OZ_RWKVB ECU_ADDRESS 0xc0005084 FORMAT "%6.1" /end MEASUREMENT
/begin MEASUREMENT Oz_rwp "Zwischengröße Restwegberechnung" SWORD _CNV_R_R_Def_km_sw__64_CM 1 100. -327680. 327670. DISPLAY_IDENTIFIER OZ_RWP ECU_ADDRESS 0xc000509c FORMAT "%6.1" /end MEASUREMENT
/begin MEASUREMENT Oz_rwpeil "Restweg laut Peilstab" SWORD _CNV_R_R_Def_km_sw__64_CM 1 100. -327680. 327670. DISPLAY_IDENTIFIER OZ_RWPEIL ECU_ADDRESS 0xc00040a2 FORMAT "%6.1" /end MEASUREMENT
/begin MEASUREMENT Oz_rwperm "Restweg aus Permittivität abgeleitet" SWORD _CNV_R_R_Def_km_sw__64_CM 1 100. -327680. 327670. DISPLAY_IDENTIFIER OZ_RWPERM ECU_ADDRESS 0xc0005086 FORMAT "%6.1" /end MEASUREMENT
/begin MEASUREMENT Oz_rwprog "Prognose_Intervall_Weg_BOS_Meldung_2" UWORD _CNV_R_R_Def_km_sw__64_CM 1 100. 0. 655350. DISPLAY_IDENTIFIER OZ_RWPROG ECU_ADDRESS 0xc000508e FORMAT "%5.0" /end MEASUREMENT
/begin MEASUREMENT Oz_rwprueck "" UBYTE _CNV_R_R_Def_km_ub__443_CM 1 100. 0. 255000. DISPLAY_IDENTIFIER OZ_RWPRUECK ECU_ADDRESS 0xc000409f FORMAT "%3.0" /end MEASUREMENT
/begin MEASUREMENT Oz_rwrueck "" SWORD _CNV_R_R_Def_km_sw__64_CM 1 100. -327680. 327670. DISPLAY_IDENTIFIER OZ_RWRUECK ECU_ADDRESS 0xc0004ff8 FORMAT "%6.1" /end MEASUREMENT
/begin MEASUREMENT Oz_rwzeit "Restweg laut Zeitverlauf" SWORD _CNV_R_R_Def_km_sw__64_CM 1 100. -327680. 327670. DISPLAY_IDENTIFIER OZ_RWZEIT ECU_ADDRESS 0xc0005088 FORMAT "%6.1" /end MEASUREMENT
/begin MEASUREMENT Oz_steigung "" SWORD _CNV_R_R_Def_f_sw_b_634_CM 1 100. -64. 63.998 DISPLAY_IDENTIFIER OZ_STEIGUNG ECU_ADDRESS 0xc0005026 FORMAT "%8.3" /end MEASUREMENT
/begin MEASUREMENT Oz_svcntchg "geänderter Servicezähler" UBYTE _CNV_R_R_Def_dez_sl_575_CM 1 100. 0. 255. DISPLAY_IDENTIFIER OZ_SVCNTCHG ECU_ADDRESS 0xc0005002 FORMAT "%3.0" /end MEASUREMENT
/begin MEASUREMENT Oz_temp "Öltemperatur ungefiltert" SWORD _CNV_R_R_Def_t_sw_q_618_CM 1 100. -3276.8 3276.7 DISPLAY_IDENTIFIER OZ_TEMP ECU_ADDRESS 0xc0004ffa FORMAT "%6.1" /end MEASUREMENT
/begin MEASUREMENT Oz_tempakt "Ausgabe Öltemperatur für den Tester" SWORD _CNV_R_R_Def_t_sw_q_618_CM 1 100. -3276.8 3276.7 DISPLAY_IDENTIFIER OZ_TEMPAKT ECU_ADDRESS 0xc0004fec FORMAT "%6.1" /end MEASUREMENT
/begin MEASUREMENT Oz_tempf "" SWORD _CNV_R_R_Def_t_sw_q_618_CM 1 100. -3276.8 3276.7 DISPLAY_IDENTIFIER OZ_TEMPF ECU_ADDRESS 0xc00050ac FORMAT "%6.1" /end MEASUREMENT
/begin MEASUREMENT Oz_tempmdl "Interne Modelltemperatur (NG6)" SWORD _CNV_R_R_Def_t_sw_q_618_CM 1 100. -3276.8 3276.7 DISPLAY_IDENTIFIER OZ_TEMPMDL ECU_ADDRESS 0xc00050ae FORMAT "%6.1" /end MEASUREMENT
/begin MEASUREMENT Oz_tempt "begrenzter Temperatur-Rohwert" UWORD _CNV_R_R_Def_dez_sl_575_CM 1 100. 0. 65535. DISPLAY_IDENTIFIER OZ_TEMPT ECU_ADDRESS 0xc0005008 FORMAT "%5.0" /end MEASUREMENT
/begin MEASUREMENT Oz_testtoel2 "" SWORD _CNV_R_R_Def_t_sw_q_618_CM 1 100. -3276.8 3276.7 DISPLAY_IDENTIFIER OZ_TESTTOEL2 ECU_ADDRESS 0xc0005028 FORMAT "%6.1" /end MEASUREMENT
/begin MEASUREMENT Oz_todeltime "Zähler Ausheizzeit (nichtflüchtig)" UWORD _CNV_R_R_Def_td_uw__682_CM 1 100. 0. 65535. DISPLAY_IDENTIFIER OZ_TODELTIME ECU_ADDRESS 0xc00040fc FORMAT "%5.0" /end MEASUREMENT
/begin MEASUREMENT Oz_tog_i "" UBYTE _CNV_R_R_Def_dez_sl_575_CM 1 100. 0. 255. DISPLAY_IDENTIFIER OZ_TOG_I ECU_ADDRESS 0xc0005048 FORMAT "%3.0" /end MEASUREMENT
/begin MEASUREMENT Oz_togbwi "" UBYTE _CNV_R_R_Def_dez_sl_575_CM 1 100. 0. 255. DISPLAY_IDENTIFIER OZ_TOGBWI ECU_ADDRESS 0xc0005049 FORMAT "%3.0" /end MEASUREMENT
/begin MEASUREMENT Oz_togki "" UBYTE _CNV_R_R_Def_dez_sl_575_CM 1 100. 0. 255. DISPLAY_IDENTIFIER OZ_TOGKI ECU_ADDRESS 0xc000504a FORMAT "%3.0" /end MEASUREMENT
/begin MEASUREMENT Oz_uefcnt "Zähler Überfüllung" UBYTE _CNV_R_R_Def_dez_sl_575_CM 1 100. 0. 255. DISPLAY_IDENTIFIER OZ_UEFCNT ECU_ADDRESS 0xc000504b FORMAT "%3.0" /end MEASUREMENT
/begin MEASUREMENT Oz_uefzcnt "Zwischenzähler Überfüllung" SBYTE _CNV_R_R_Def_dez_sl_575_CM 1 100. -128. 127. DISPLAY_IDENTIFIER OZ_UEFZCNT ECU_ADDRESS 0xc0005034 FORMAT "%3.0" /end MEASUREMENT
/begin MEASUREMENT Oz_utzeit "Zeit Öl in Übertemperatur" UWORD _CNV_R_R_Def_dez_sl_575_CM 1 100. 0. 65535. DISPLAY_IDENTIFIER OZ_UTZEIT ECU_ADDRESS 0xc0004114 FORMAT "%5.0" /end MEASUREMENT
/begin MEASUREMENT Oz_verbkmalt "Km-Stand letzter Ölverbrauch-Berechnung" UWORD _CNV_R_R_Def_km_sw__64_CM 1 100. 0. 655350. DISPLAY_IDENTIFIER OZ_VERBKMALT ECU_ADDRESS 0xc00040aa FORMAT "%5.0" /end MEASUREMENT
/begin MEASUREMENT Oz_verbnivalt "Ölniveau letzter Ölverbrauch-Berechnung" UBYTE _CNV_R_R_Def_niv_ub_672_CM 1 100. 0. 74.70699999999999 DISPLAY_IDENTIFIER OZ_VERBNIVALT ECU_ADDRESS 0xc00040b0 FORMAT "%5.2" /end MEASUREMENT
/begin MEASUREMENT Oz_vfanz "anzuzeigende Verfügbarkeit" UBYTE _CNV_R_R_Def_lf_ub__675_CM 1 100. 0. 2.55 DISPLAY_IDENTIFIER OZ_VFANZ ECU_ADDRESS 0xc0005091 FORMAT "%5.2" /end MEASUREMENT
/begin MEASUREMENT Oz_vfbdmew "Verfügbarkeit aus Kombi bei DME-Wechsel" SBYTE _CNV_R_R_Def_dez_sl_575_CM 1 100. -128. 127. DISPLAY_IDENTIFIER OZ_VFBDMEW ECU_ADDRESS 0xc000409c FORMAT "%3.0" /end MEASUREMENT
/begin MEASUREMENT Oz_vfkvb "Verfügbarkeit aus Kraftstoffverbrauch" UBYTE _CNV_R_R_Def_lf_ub__675_CM 1 100. 0. 2.55 DISPLAY_IDENTIFIER OZ_VFKVB ECU_ADDRESS 0xc00050a9 FORMAT "%5.2" /end MEASUREMENT
/begin MEASUREMENT Oz_vfperm "Verfügbarkeit aus der Permittivität" UBYTE _CNV_R_R_Def_lf_ub__675_CM 1 100. 0. 2.55 DISPLAY_IDENTIFIER OZ_VFPERM ECU_ADDRESS 0xc00050aa FORMAT "%5.2" /end MEASUREMENT
/begin MEASUREMENT Oz_vfzeit "Verfügbarkeit aus Zeit" UBYTE _CNV_R_R_Def_lf_ub__675_CM 1 100. 0. 2.55 DISPLAY_IDENTIFIER OZ_VFZEIT ECU_ADDRESS 0xc00050ab FORMAT "%5.2" /end MEASUREMENT
/begin MEASUREMENT Oz_visc_dum "" UBYTE _CNV_R_R_Def_dez_sl_575_CM 1 100. 0. 255. DISPLAY_IDENTIFIER OZ_VISC_DUM ECU_ADDRESS 0xc00050b4 FORMAT "%3.0" /end MEASUREMENT
/begin MEASUREMENT Oz_vormw "vorgezogener Mittelwert Niveau" UBYTE _CNV_R_R_Def_niv_ub_672_CM 1 100. 0. 74.70699999999999 DISPLAY_IDENTIFIER OZ_VORMW ECU_ADDRESS 0xc000501c FORMAT "%5.2" /end MEASUREMENT
/begin MEASUREMENT Oz_vormwcnt "" UBYTE _CNV_R_R_Def_dez_sl_575_CM 1 100. 0. 255. DISPLAY_IDENTIFIER OZ_VORMWCNT ECU_ADDRESS 0xc000504c FORMAT "%3.0" /end MEASUREMENT
/begin MEASUREMENT Oz_zieljahr "" UBYTE _CNV_R_R_Def_dez_sl_575_CM 1 100. 0. 255. DISPLAY_IDENTIFIER OZ_ZIELJAHR ECU_ADDRESS 0xc0004118 FORMAT "%3.0" /end MEASUREMENT
/begin MEASUREMENT Oz_zielmon "" UBYTE _CNV_R_R_Def_dez_sl_575_CM 1 100. 0. 255. DISPLAY_IDENTIFIER OZ_ZIELMON ECU_ADDRESS 0xc0004119 FORMAT "%3.0" /end MEASUREMENT
/begin MEASUREMENT Oz_zjbdmew "" UBYTE _CNV_R_R_Def_dez_sl_575_CM 1 100. 0. 255. DISPLAY_IDENTIFIER OZ_ZJBDMEW ECU_ADDRESS 0xc0005003 FORMAT "%3.0" /end MEASUREMENT
/begin MEASUREMENT Oz_zmbdmew "" UBYTE _CNV_R_R_Def_dez_sl_575_CM 1 100. 0. 255. DISPLAY_IDENTIFIER OZ_ZMBDMEW ECU_ADDRESS 0xc0005004 FORMAT "%3.0" /end MEASUREMENT
/begin MEASUREMENT Rf_agr_s "Reletive Füllung Androsseln wegen AGR in Schicht" SWORD _CNV_R_R_Def_rf_sw__616_CM 1 100. -327.68 327.67 DISPLAY_IDENTIFIER RF_AGR_S ECU_ADDRESS 0xd000786c FORMAT "%9.4" /end MEASUREMENT
/begin MEASUREMENT Rf_bas_hs "Soll-Luftmasse (homogen-schicht)" SWORD _CNV_R_R_Def_rf_sw__616_CM 1 100. -327.68 327.67 DISPLAY_IDENTIFIER RF_BAS_HS ECU_ADDRESS 0xd00077fa FORMAT "%9.4" /end MEASUREMENT
/begin MEASUREMENT Rf_bas_s "Soll-Rf (schicht)" SWORD _CNV_R_R_Def_rf_sw__616_CM 1 100. -327.68 327.67 DISPLAY_IDENTIFIER RF_BAS_S ECU_ADDRESS 0xd000784c FORMAT "%9.4" /end MEASUREMENT
/begin MEASUREMENT Rf_kh_s "Soll-Luftmasse durch KH (schicht)" SWORD _CNV_R_R_Def_rf_sw__616_CM 1 100. -327.68 327.67 DISPLAY_IDENTIFIER RF_KH_S ECU_ADDRESS 0xd00077f8 FORMAT "%9.4" /end MEASUREMENT
/begin MEASUREMENT Rf_max_agr "" SWORD _CNV_R_R_Def_rf_sw__616_CM 1 100. -327.68 327.67 DISPLAY_IDENTIFIER RF_MAX_AGR ECU_ADDRESS 0xd0007706 FORMAT "%9.4" /end MEASUREMENT
/begin MEASUREMENT Rf_min "minimales Rf" SWORD _CNV_R_R_Def_rf_sw__616_CM 1 100. -327.68 327.67 DISPLAY_IDENTIFIER RF_MIN ECU_ADDRESS 0xd0007708 FORMAT "%9.4" /end MEASUREMENT
/begin MEASUREMENT Rf_opt_hs "Optimales Rf (homogen-schicht)" SWORD _CNV_R_R_Def_rf_sw__616_CM 1 100. -327.68 327.67 DISPLAY_IDENTIFIER RF_OPT_HS ECU_ADDRESS 0xd0007850 FORMAT "%9.4" /end MEASUREMENT
/begin MEASUREMENT Rf_opt_s "Optimales Rf (schicht)" SWORD _CNV_R_R_Def_rf_sw__616_CM 1 100. -327.68 327.67 DISPLAY_IDENTIFIER RF_OPT_S ECU_ADDRESS 0xd000784a FORMAT "%9.4" /end MEASUREMENT
/begin MEASUREMENT Rf_optres_hs "Optimales Rf (homogen-schicht)" SWORD _CNV_R_R_Def_rf_sw__616_CM 1 100. -327.68 327.67 DISPLAY_IDENTIFIER RF_OPTRES_HS ECU_ADDRESS 0xd0007854 FORMAT "%9.4" /end MEASUREMENT
/begin MEASUREMENT Rf_optres_s "Optimales Rf (schicht)" SWORD _CNV_R_R_Def_rf_sw__616_CM 1 100. -327.68 327.67 DISPLAY_IDENTIFIER RF_OPTRES_S ECU_ADDRESS 0xd0007852 FORMAT "%9.4" /end MEASUREMENT
/begin MEASUREMENT Rf_res_max "Maximale rel. Füllung aus MD-Reserve für Katheizen" SWORD _CNV_R_R_Def_rf_sw__616_CM 1 100. -327.68 327.67 DISPLAY_IDENTIFIER RF_RES_MAX ECU_ADDRESS 0xd0007658 FORMAT "%9.4" /end MEASUREMENT
/begin MEASUREMENT Rf_soll "Soll Rf des Momentenmanagers" SWORD _CNV_R_R_Def_rf_sw__616_CM 1 100. -327.68 327.67 DISPLAY_IDENTIFIER RF_SOLL ECU_ADDRESS 0xd0007704 FORMAT "%9.4" /end MEASUREMENT
/begin MEASUREMENT Rf_soll_h "Soll Rf des Momentenmanagers (homogen)" SWORD _CNV_R_R_Def_rf_sw__616_CM 1 100. -327.68 327.67 DISPLAY_IDENTIFIER RF_SOLL_H ECU_ADDRESS 0xd000771e FORMAT "%9.4" /end MEASUREMENT
/begin MEASUREMENT Rf_soll_hs "Soll Rf des Momentenmanagers (homogen-schicht)" SWORD _CNV_R_R_Def_rf_sw__616_CM 1 100. -327.68 327.67 DISPLAY_IDENTIFIER RF_SOLL_HS ECU_ADDRESS 0xd000771c FORMAT "%9.4" /end MEASUREMENT
/begin MEASUREMENT Rf_soll_s "Soll Rf des Momentenmanagers (schicht)" SWORD _CNV_R_R_Def_rf_sw__616_CM 1 100. -327.68 327.67 DISPLAY_IDENTIFIER RF_SOLL_S ECU_ADDRESS 0xd000771a FORMAT "%9.4" /end MEASUREMENT
/begin MEASUREMENT Rf_te_s "Rf wegen TE im Schicht" SWORD _CNV_R_R_Def_rf_sw__616_CM 1 100. -327.68 327.67 DISPLAY_IDENTIFIER RF_TE_S ECU_ADDRESS 0xd000780c FORMAT "%9.4" /end MEASUREMENT
/begin MEASUREMENT Rfgrdmax "Rf_soll Filterung Gradient" SWORD _CNV_R_R_Def_rf_sw__616_CM 1 100. -327.68 327.67 DISPLAY_IDENTIFIER RFGRDMAX ECU_ADDRESS 0xd000786e FORMAT "%9.4" /end MEASUREMENT
/begin MEASUREMENT Rflam "Relative Füllung aus Lambda und Kraftstoffmasse berechnet" UWORD _CNV_R_R_Def_rf_sw__616_CM 1 100. 0. 655.35 DISPLAY_IDENTIFIER RFLAM ECU_ADDRESS 0xd0007564 FORMAT "%9.4" /end MEASUREMENT
/begin MEASUREMENT Rflam2 "Relative Füllung aus Lambda und Kraftstoffmasse berechnet Bank 2" UWORD _CNV_R_R_Def_rf_sw__616_CM 1 100. 0. 655.35 DISPLAY_IDENTIFIER RFLAM2 ECU_ADDRESS 0xd000756a FORMAT "%9.4" /end MEASUREMENT
/begin MEASUREMENT Rfmin_kh_s "Minimale Soll-Luftmasse durch KH (schicht)" SWORD _CNV_R_R_Def_rf_sw__616_CM 1 100. -327.68 327.67 DISPLAY_IDENTIFIER RFMIN_KH_S ECU_ADDRESS 0xd00077f6 FORMAT "%9.4" /end MEASUREMENT
/begin MEASUREMENT Rfmin_te_s "Minimales Rf wegen TE im Schicht" SWORD _CNV_R_R_Def_rf_sw__616_CM 1 100. -327.68 327.67 DISPLAY_IDENTIFIER RFMIN_TE_S ECU_ADDRESS 0xd000780e FORMAT "%9.4" /end MEASUREMENT
/begin MEASUREMENT Rfmxatl "Max. Fuellung im Turbo-Betrieb" SWORD _CNV_R_R_Def_rf_sw__616_CM 1 100. -327.68 327.67 DISPLAY_IDENTIFIER RFMXATL ECU_ADDRESS 0xc00026de FORMAT "%9.4" /end MEASUREMENT
/begin MEASUREMENT Rfmxkorr "Max. Turbo-Luftaufwand korrigiert" SWORD _CNV_R_R_Def_rf_sw__616_CM 1 100. -327.68 327.67 DISPLAY_IDENTIFIER RFMXKORR ECU_ADDRESS 0xc00026e8 FORMAT "%9.4" /end MEASUREMENT
/begin MEASUREMENT Rfmxldms "Max. Fuellung" SWORD _CNV_R_R_Def_rf_sw__616_CM 1 100. -327.68 327.67 DISPLAY_IDENTIFIER RFMXLDMS ECU_ADDRESS 0xc00026ea FORMAT "%9.4" /end MEASUREMENT
/begin MEASUREMENT Rfmxldts "Max. Fuellung" SWORD _CNV_R_R_Def_rf_sw__616_CM 1 100. -327.68 327.67 DISPLAY_IDENTIFIER RFMXLDTS ECU_ADDRESS 0xc00026ec FORMAT "%9.4" /end MEASUREMENT
/begin MEASUREMENT Rk1_hs "" SWORD _CNV_R_R_Def_rk_sw__697_CM 1 100. -1600. 1599.9511 DISPLAY_IDENTIFIER RK1_HS ECU_ADDRESS 0xd0007830 FORMAT "%8.3" /end MEASUREMENT
/begin MEASUREMENT Rk1_s "" SWORD _CNV_R_R_Def_rk_sw__697_CM 1 100. -1600. 1599.9511 DISPLAY_IDENTIFIER RK1_S ECU_ADDRESS 0xd000782c FORMAT "%8.3" /end MEASUREMENT
/begin MEASUREMENT Rk2_hs "" SWORD _CNV_R_R_Def_rk_sw__697_CM 1 100. -1600. 1599.9511 DISPLAY_IDENTIFIER RK2_HS ECU_ADDRESS 0xd0007832 FORMAT "%8.3" /end MEASUREMENT
/begin MEASUREMENT Rk2_s "" SWORD _CNV_R_R_Def_rk_sw__697_CM 1 100. -1600. 1599.9511 DISPLAY_IDENTIFIER RK2_S ECU_ADDRESS 0xd000782e FORMAT "%8.3" /end MEASUREMENT
/begin MEASUREMENT Rk3_khkh_s "" SWORD _CNV_R_R_Def_rk_sw__697_CM 1 100. -1600. 1599.9511 DISPLAY_IDENTIFIER RK3_KHKH_S ECU_ADDRESS 0xd00076e8 FORMAT "%8.3" /end MEASUREMENT
/begin MEASUREMENT Rk3_khmdi_s "Rk_soll KH für 3. Einspritzung (schicht)" SWORD _CNV_R_R_Def_rk_sw__697_CM 1 100. -1600. 1599.9511 DISPLAY_IDENTIFIER RK3_KHMDI_S ECU_ADDRESS 0xd00077d6 FORMAT "%8.3" /end MEASUREMENT
/begin MEASUREMENT Rk3_khsoll_s "Rk3_khsoll_s" SWORD _CNV_R_R_Def_rk_sw__697_CM 1 100. -1600. 1599.9511 DISPLAY_IDENTIFIER RK3_KHSOLL_S ECU_ADDRESS 0xd0007866 FORMAT "%8.3" /end MEASUREMENT
/begin MEASUREMENT Rk3_soll_s "Rk_soll KH für 3. Einspritzung (schicht)" SWORD _CNV_R_R_Def_rk_sw__697_CM 1 100. -1600. 1599.9511 DISPLAY_IDENTIFIER RK3_SOLL_S ECU_ADDRESS 0xd00077d8 FORMAT "%8.3" /end MEASUREMENT
/begin MEASUREMENT Rk3maxmdi "Maximal mögliches Rk_soll für 3. Einspritzung (schicht)" SWORD _CNV_R_R_Def_rk_sw__697_CM 1 100. -1600. 1599.9511 DISPLAY_IDENTIFIER RK3MAXMDI ECU_ADDRESS 0xd00077d4 FORMAT "%8.3" /end MEASUREMENT
/begin MEASUREMENT Rk_1_td "rel Kraftstoffmasse Bank 1 verzögert" UWORD _CNV_R_R_Def_rk_sw__697_CM 1 100. 0. 3199.9511 DISPLAY_IDENTIFIER RK_1_TD ECU_ADDRESS 0xd0007566 FORMAT "%8.3" /end MEASUREMENT
/begin MEASUREMENT Rk_1_tdf "rel Kraftstoffmasse Bank 1 verzögert gefiltert" UWORD _CNV_R_R_Def_rk_sw__697_CM 1 100. 0. 3199.9511 DISPLAY_IDENTIFIER RK_1_TDF ECU_ADDRESS 0xd0007568 FORMAT "%8.3" /end MEASUREMENT
/begin MEASUREMENT Rk_2_td "rel Kraftstoffmasse Bank 2 verzögert" UWORD _CNV_R_R_Def_rk_sw__697_CM 1 100. 0. 3199.9511 DISPLAY_IDENTIFIER RK_2_TD ECU_ADDRESS 0xd000756c FORMAT "%8.3" /end MEASUREMENT
/begin MEASUREMENT Rk_2_tdf "rel Kraftstoffmasse Bank 2 verzögert gefiltert" UWORD _CNV_R_R_Def_rk_sw__697_CM 1 100. 0. 3199.9511 DISPLAY_IDENTIFIER RK_2_TDF ECU_ADDRESS 0xd000756e FORMAT "%8.3" /end MEASUREMENT
/begin MEASUREMENT Rk_bas_h "" SWORD _CNV_R_R_Def_rk_sw__697_CM 1 100. -1600. 1599.9511 DISPLAY_IDENTIFIER RK_BAS_H ECU_ADDRESS 0xd00076ee FORMAT "%8.3" ARRAY_SIZE 2 MATRIX_DIM 2 1 1 /end MEASUREMENT
/begin MEASUREMENT Rk_bas_hs "Optimales Rk_soll ohne Mdi_bas-Begrenzung (homogen-schicht)" SWORD _CNV_R_R_Def_rk_sw__697_CM 1 100. -1600. 1599.9511 DISPLAY_IDENTIFIER RK_BAS_HS ECU_ADDRESS 0xd00077f4 FORMAT "%8.3" /end MEASUREMENT
/begin MEASUREMENT Rk_bas_s "Soll-Rk (schicht)" SWORD _CNV_R_R_Def_rk_sw__697_CM 1 100. -1600. 1599.9511 DISPLAY_IDENTIFIER RK_BAS_S ECU_ADDRESS 0xd000784e FORMAT "%8.3" /end MEASUREMENT
/begin MEASUREMENT Rk_kh "" SWORD _CNV_R_R_Def_rk_sw__697_CM 1 100. -1600. 1599.9511 DISPLAY_IDENTIFIER RK_KH ECU_ADDRESS 0xd00076e6 FORMAT "%8.3" /end MEASUREMENT
/begin MEASUREMENT Rk_kor_h "Rk_soll mit Wirkungsgrad korrigiert (homogen)" SWORD _CNV_R_R_Def_rk_sw__697_CM 1 100. -1600. 1599.9511 DISPLAY_IDENTIFIER RK_KOR_H ECU_ADDRESS 0xd00077ce FORMAT "%8.3" /end MEASUREMENT
/begin MEASUREMENT Rk_kor_hs "Korrigiertes Rk_soll (homogen-schicht)" SWORD _CNV_R_R_Def_rk_sw__697_CM 1 100. -1600. 1599.9511 DISPLAY_IDENTIFIER RK_KOR_HS ECU_ADDRESS 0xd00077d2 FORMAT "%8.3" /end MEASUREMENT
/begin MEASUREMENT Rk_kor_s "Korrigiertes Rk_soll (schicht)" SWORD _CNV_R_R_Def_rk_sw__697_CM 1 100. -1600. 1599.9511 DISPLAY_IDENTIFIER RK_KOR_S ECU_ADDRESS 0xd00077d0 FORMAT "%8.3" /end MEASUREMENT
/begin MEASUREMENT Rk_korres_hs "Korrigiertes Rk_soll mit Momentenreserve (homogen-schicht)" SWORD _CNV_R_R_Def_rk_sw__697_CM 1 100. -1600. 1599.9511 DISPLAY_IDENTIFIER RK_KORRES_HS ECU_ADDRESS 0xd0007718 FORMAT "%8.3" /end MEASUREMENT
/begin MEASUREMENT Rk_korres_s "Korrigiertes Rk_soll mit Momentenreserve (schicht)" SWORD _CNV_R_R_Def_rk_sw__697_CM 1 100. -1600. 1599.9511 DISPLAY_IDENTIFIER RK_KORRES_S ECU_ADDRESS 0xd0007716 FORMAT "%8.3" /end MEASUREMENT
/begin MEASUREMENT Rk_korzw_h "Soll-Kraftstoffmasse ZW-korrigiert (homogen)" SWORD _CNV_R_R_Def_rk_sw__697_CM 1 100. -1600. 1599.9511 DISPLAY_IDENTIFIER RK_KORZW_H ECU_ADDRESS 0xd00077fc FORMAT "%8.3" /end MEASUREMENT
/begin MEASUREMENT Rk_lamreg "" SWORD _CNV_R_R_Def_rk_sw__697_CM 1 100. -1600. 1599.9511 DISPLAY_IDENTIFIER RK_LAMREG ECU_ADDRESS 0xd0007834 FORMAT "%8.3" ARRAY_SIZE 2 MATRIX_DIM 2 1 1 /end MEASUREMENT
/begin MEASUREMENT Rk_laprio_h "rel. Kraftstoffmasse mit Lambda priorisiert bankweise (homogen)" SWORD _CNV_R_R_Def_rk_sw__697_CM 1 100. -1600. 1599.9511 DISPLAY_IDENTIFIER RK_LAPRIO_H ECU_ADDRESS 0xd0007822 FORMAT "%8.3" ARRAY_SIZE 2 MATRIX_DIM 2 1 1 /end MEASUREMENT
/begin MEASUREMENT Rk_max_h "maximales Rk_soll (homogen)" SWORD _CNV_R_R_Def_rk_sw__697_CM 1 100. -1600. 1599.9511 DISPLAY_IDENTIFIER RK_MAX_H ECU_ADDRESS 0xd0007826 FORMAT "%8.3" /end MEASUREMENT
/begin MEASUREMENT Rk_maxbg_hs "Maximale Begrenzung Rk_soll (homogen-schicht)" SWORD _CNV_R_R_Def_rk_sw__697_CM 1 100. -1600. 1599.9511 DISPLAY_IDENTIFIER RK_MAXBG_HS ECU_ADDRESS 0xd0007714 FORMAT "%8.3" /end MEASUREMENT
/begin MEASUREMENT Rk_maxbg_s "Maximale Begrenzung Rk_soll (schicht)" SWORD _CNV_R_R_Def_rk_sw__697_CM 1 100. -1600. 1599.9511 DISPLAY_IDENTIFIER RK_MAXBG_S ECU_ADDRESS 0xd0007712 FORMAT "%8.3" /end MEASUREMENT
/begin MEASUREMENT Rk_mdprio_h "MD-Prio Rk_soll (homogen)" SWORD _CNV_R_R_Def_rk_sw__697_CM 1 100. -1600. 1599.9511 DISPLAY_IDENTIFIER RK_MDPRIO_H ECU_ADDRESS 0xd000782a FORMAT "%8.3" /end MEASUREMENT
/begin MEASUREMENT Rk_min_h "minimales Rk_soll (homogen)" SWORD _CNV_R_R_Def_rk_sw__697_CM 1 100. -1600. 1599.9511 DISPLAY_IDENTIFIER RK_MIN_H ECU_ADDRESS 0xd00077e0 FORMAT "%8.3" /end MEASUREMENT
/begin MEASUREMENT Rk_minbg_hs "Minimale Begrenzung Rk_soll (homogen-schicht)" SWORD _CNV_R_R_Def_rk_sw__697_CM 1 100. -1600. 1599.9511 DISPLAY_IDENTIFIER RK_MINBG_HS ECU_ADDRESS 0xd00077e2 FORMAT "%8.3" /end MEASUREMENT
/begin MEASUREMENT Rk_minbg_s "Minimale Begrenzung Rk_soll (schicht)" SWORD _CNV_R_R_Def_rk_sw__697_CM 1 100. -1600. 1599.9511 DISPLAY_IDENTIFIER RK_MINBG_S ECU_ADDRESS 0xd0007838 FORMAT "%8.3" /end MEASUREMENT
/begin MEASUREMENT Rk_opt_h "optimales Rk_soll (homogen)" SWORD _CNV_R_R_Def_rk_sw__697_CM 1 100. -1600. 1599.9511 DISPLAY_IDENTIFIER RK_OPT_H ECU_ADDRESS 0xd0007828 FORMAT "%8.3" /end MEASUREMENT
/begin MEASUREMENT Rk_opt_hs "Optimales Rk_soll (homogen-schicht)" SWORD _CNV_R_R_Def_rk_sw__697_CM 1 100. -1600. 1599.9511 DISPLAY_IDENTIFIER RK_OPT_HS ECU_ADDRESS 0xd000783c FORMAT "%8.3" /end MEASUREMENT
/begin MEASUREMENT Rk_opt_s "Optimales Rk_soll (schicht)" SWORD _CNV_R_R_Def_rk_sw__697_CM 1 100. -1600. 1599.9511 DISPLAY_IDENTIFIER RK_OPT_S ECU_ADDRESS 0xd000783a FORMAT "%8.3" /end MEASUREMENT
/begin MEASUREMENT Rk_optres_hs "Optimales Rk_soll mit Momentenreserve (homogen-schicht)" SWORD _CNV_R_R_Def_rk_sw__697_CM 1 100. -1600. 1599.9511 DISPLAY_IDENTIFIER RK_OPTRES_HS ECU_ADDRESS 0xd0007840 FORMAT "%8.3" /end MEASUREMENT
/begin MEASUREMENT Rk_optres_s "Optimales Rk_soll mit Momentenreserve (schicht)" SWORD _CNV_R_R_Def_rk_sw__697_CM 1 100. -1600. 1599.9511 DISPLAY_IDENTIFIER RK_OPTRES_S ECU_ADDRESS 0xd000783e FORMAT "%8.3" /end MEASUREMENT
/begin MEASUREMENT Rk_soll "rel Soll-Kraftstoffmasse" SWORD _CNV_R_R_Def_rk_sw__697_CM 1 100. -1600. 1599.9511 DISPLAY_IDENTIFIER RK_SOLL ECU_ADDRESS 0xd00076e4 FORMAT "%8.3" /end MEASUREMENT
/begin MEASUREMENT Rk_soll_h "rel Soll-Kraftstoffmasse (homogen)" SWORD _CNV_R_R_Def_rk_sw__697_CM 1 100. -1600. 1599.9511 DISPLAY_IDENTIFIER RK_SOLL_H ECU_ADDRESS 0xd00077dc FORMAT "%8.3" /end MEASUREMENT
/begin MEASUREMENT Rk_soll_hs "rel Soll-Kraftstoffmasse (homogen-schicht)" SWORD _CNV_R_R_Def_rk_sw__697_CM 1 100. -1600. 1599.9511 DISPLAY_IDENTIFIER RK_SOLL_HS ECU_ADDRESS 0xd00077de FORMAT "%8.3" /end MEASUREMENT
/begin MEASUREMENT Rk_soll_s "rel Soll-Kraftstoffmasse (schicht)" SWORD _CNV_R_R_Def_rk_sw__697_CM 1 100. -1600. 1599.9511 DISPLAY_IDENTIFIER RK_SOLL_S ECU_ADDRESS 0xd00077cc FORMAT "%8.3" /end MEASUREMENT
/begin MEASUREMENT Rk_sollm_h "Relative Kraftstoffmasse Mittelwert (homogen)" SWORD _CNV_R_R_Def_rk_sw__697_CM 1 100. -1600. 1599.9511 DISPLAY_IDENTIFIER RK_SOLLM_H ECU_ADDRESS 0xd0007702 FORMAT "%8.3" /end MEASUREMENT
/begin MEASUREMENT Rk_sollm_hs "" SWORD _CNV_R_R_Def_rk_sw__697_CM 1 100. -1600. 1599.9511 DISPLAY_IDENTIFIER RK_SOLLM_HS ECU_ADDRESS 0xd00076ec FORMAT "%8.3" /end MEASUREMENT
/begin MEASUREMENT Rk_sollm_s "" SWORD _CNV_R_R_Def_rk_sw__697_CM 1 100. -1600. 1599.9511 DISPLAY_IDENTIFIER RK_SOLLM_S ECU_ADDRESS 0xd00076ea FORMAT "%8.3" /end MEASUREMENT
/begin MEASUREMENT Rk_sollstart "rel Soll-Kraftstoffmasse im Start" SWORD _CNV_R_R_Def_rk_sw__697_CM 1 100. -1600. 1599.9511 DISPLAY_IDENTIFIER RK_SOLLSTART ECU_ADDRESS 0xd0007816 FORMAT "%8.3" /end MEASUREMENT
/begin MEASUREMENT Rk_solltmp_s "Rk_soll Zwischengröße (schicht)" SWORD _CNV_R_R_Def_rk_sw__697_CM 1 100. -1600. 1599.9511 DISPLAY_IDENTIFIER RK_SOLLTMP_S ECU_ADDRESS 0xd00077da FORMAT "%8.3" /end MEASUREMENT
/begin MEASUREMENT Rk_vlo_hs "" SWORD _CNV_R_R_Def_rk_sw__697_CM 1 100. -1600. 1599.9511 DISPLAY_IDENTIFIER RK_VLO_HS ECU_ADDRESS 0xd0007844 FORMAT "%8.3" /end MEASUREMENT
/begin MEASUREMENT Rk_vlo_s "" SWORD _CNV_R_R_Def_rk_sw__697_CM 1 100. -1600. 1599.9511 DISPLAY_IDENTIFIER RK_VLO_S ECU_ADDRESS 0xd0007842 FORMAT "%8.3" /end MEASUREMENT
/begin MEASUREMENT Rk_vlu_hs "" SWORD _CNV_R_R_Def_rk_sw__697_CM 1 100. -1600. 1599.9511 DISPLAY_IDENTIFIER RK_VLU_HS ECU_ADDRESS 0xd0007848 FORMAT "%8.3" /end MEASUREMENT
/begin MEASUREMENT Rk_vlu_s "" SWORD _CNV_R_R_Def_rk_sw__697_CM 1 100. -1600. 1599.9511 DISPLAY_IDENTIFIER RK_VLU_S ECU_ADDRESS 0xd0007846 FORMAT "%8.3" /end MEASUREMENT
/begin MEASUREMENT Rksoll_h "Relative Kraftstoffmasse bankweise (homogen)" SWORD _CNV_R_R_Def_rk_sw__697_CM 1 100. -1600. 1599.9511 DISPLAY_IDENTIFIER RKSOLL_H ECU_ADDRESS 0xd00076fe FORMAT "%8.3" ARRAY_SIZE 2 MATRIX_DIM 2 1 1 /end MEASUREMENT
/begin MEASUREMENT Rksoll_h1 "Relative Kraftstoffmasse Bank1 je Einspritzung (homogen)" SWORD _CNV_R_R_Def_rk_sw__697_CM 1 100. -1600. 1599.9511 DISPLAY_IDENTIFIER RKSOLL_H1 ECU_ADDRESS 0xd00076f2 FORMAT "%8.3" ARRAY_SIZE 3 MATRIX_DIM 3 1 1 /end MEASUREMENT
/begin MEASUREMENT Rksoll_h2 "Relative Kraftstoffmasse Bank2 je Einspritzung (homogen)" SWORD _CNV_R_R_Def_rk_sw__697_CM 1 100. -1600. 1599.9511 DISPLAY_IDENTIFIER RKSOLL_H2 ECU_ADDRESS 0xd00076f8 FORMAT "%8.3" ARRAY_SIZE 3 MATRIX_DIM 3 1 1 /end MEASUREMENT
/begin MEASUREMENT Rksoll_hs "Relative Soll-Kraftstoffmasse je Einspritzung (homogen-schicht)" SWORD _CNV_R_R_Def_rk_sw__697_CM 1 100. -1600. 1599.9511 DISPLAY_IDENTIFIER RKSOLL_HS ECU_ADDRESS 0xd0007788 FORMAT "%8.3" ARRAY_SIZE 18 MATRIX_DIM 6 3 1 /end MEASUREMENT
/begin MEASUREMENT Rksoll_s "Relative Soll-Kraftstoffmasse je Einspritzung (schicht)" SWORD _CNV_R_R_Def_rk_sw__697_CM 1 100. -1600. 1599.9511 DISPLAY_IDENTIFIER RKSOLL_S ECU_ADDRESS 0xd0007764 FORMAT "%8.3" ARRAY_SIZE 18 MATRIX_DIM 6 3 1 /end MEASUREMENT
/begin MEASUREMENT Rkte_kh "" SWORD _CNV_R_R_Def_rk_sw__697_CM 1 100. -1600. 1599.9511 DISPLAY_IDENTIFIER RKTE_KH ECU_ADDRESS 0xd0007814 FORMAT "%8.3" /end MEASUREMENT
/begin MEASUREMENT Rkte_kh_s "Anteil an der Tankentluftungsmenge, der zu einer Exotherme im Kat beitragt" SWORD _CNV_R_R_Def_rk_sw__697_CM 1 100. -1600. 1599.9511 DISPLAY_IDENTIFIER RKTE_KH_S ECU_ADDRESS 0xd0007812 FORMAT "%8.3" /end MEASUREMENT
/begin MEASUREMENT Rkte_max "Maximal zulässige Kraftstoffmenge über TEV" SWORD _CNV_R_R_Def_rk_sw__697_CM 1 100. -1600. 1599.9511 DISPLAY_IDENTIFIER RKTE_MAX ECU_ADDRESS 0xd00077f0 FORMAT "%8.3" /end MEASUREMENT
/begin MEASUREMENT Rkte_md "Momentenrelevanter Teil der Kraftstoffmasse über TEV" SWORD _CNV_R_R_Def_rk_sw__697_CM 1 100. -1600. 1599.9511 DISPLAY_IDENTIFIER RKTE_MD ECU_ADDRESS 0xd00077f2 FORMAT "%8.3" /end MEASUREMENT
/begin MEASUREMENT Rkte_md_s "Anteil an der Tankentluftungsmenge, der zum Md beitragt" SWORD _CNV_R_R_Def_rk_sw__697_CM 1 100. -1600. 1599.9511 DISPLAY_IDENTIFIER RKTE_MD_S ECU_ADDRESS 0xd0007810 FORMAT "%8.3" /end MEASUREMENT
/begin MEASUREMENT St_bvmdi "Statuswort BVMDI" UBYTE _CNV_R_R_Def_dez_sl_575_CM 1 100. 0. 255. DISPLAY_IDENTIFIER ST_BVMDI ECU_ADDRESS 0xd00076d6 FORMAT "%3.0" /end MEASUREMENT
/begin MEASUREMENT St_mdres "Status Momentenreserve" UBYTE _CNV_R_R_Def_dez_sl_575_CM 1 100. 0. 255. DISPLAY_IDENTIFIER ST_MDRES ECU_ADDRESS 0xd000764c FORMAT "%3.0" /end MEASUREMENT
/begin MEASUREMENT St_mdres.B_md_res "Bedingung Momentenreserve aktiv" UBYTE _CNV_S_1_Def_bit_ub_700_CM 1 100. 0. 0. DISPLAY_IDENTIFIER B_MD_RES ECU_ADDRESS 0xd000764c BIT_MASK 0x1 /end MEASUREMENT
/begin MEASUREMENT St_mdres.B_mdres_akt "Status Momentenreserve" UBYTE _CNV_S_1_Def_bit_ub_700_CM 1 100. 0. 0. DISPLAY_IDENTIFIER B_MDRES_AKT ECU_ADDRESS 0xd000764c BIT_MASK 0x2 /end MEASUREMENT
/begin MEASUREMENT St_mdreskrll "Statuswort MDRESKRLL" UBYTE _CNV_R_R_Def_dez_sl_575_CM 1 100. 0. 255. DISPLAY_IDENTIFIER ST_MDRESKRLL ECU_ADDRESS 0xd00078c8 FORMAT "%3.0" /end MEASUREMENT
/begin MEASUREMENT St_mdreskrll.B_mdres_krll "Bedingung Momentenreserve der KR im LL" UBYTE _CNV_S_1_Def_bit_ub_700_CM 1 100. 0. 0. DISPLAY_IDENTIFIER B_MDRES_KRLL ECU_ADDRESS 0xd00078c8 BIT_MASK 0x2 /end MEASUREMENT
/begin MEASUREMENT St_mdreskrll.B_zwe_krll "Bedingung Zündwinkeleingriff der KR im LL" UBYTE _CNV_S_1_Def_bit_ub_700_CM 1 100. 0. 0. DISPLAY_IDENTIFIER B_ZWE_KRLL ECU_ADDRESS 0xd00078c8 BIT_MASK 0x1 /end MEASUREMENT
/begin MEASUREMENT St_mdrfmxatl_intern "Statuswort" UBYTE _CNV_R_R_Def_dez_sl_575_CM 1 100. 0. 255. DISPLAY_IDENTIFIER ST_MDRFMXATL_INTERN ECU_ADDRESS 0xc00026dc FORMAT "%3.0" /end MEASUREMENT
/begin MEASUREMENT St_mdrfmxatl_intern.B_bgrfmxld "Bed. Fuellung begrenzt" UBYTE _CNV_S_1_Def_bit_ub_700_CM 1 100. 0. 0. DISPLAY_IDENTIFIER B_BGRFMXLD ECU_ADDRESS 0xc00026dc BIT_MASK 0x1 /end MEASUREMENT
/begin MEASUREMENT St_mdrk "Statuswort MDRK" UBYTE _CNV_R_R_Def_dez_sl_575_CM 1 100. 0. 255. DISPLAY_IDENTIFIER ST_MDRK ECU_ADDRESS 0xd00076d4 FORMAT "%3.0" /end MEASUREMENT
/begin MEASUREMENT St_mdrk.B_doe_h "Bedingung Doppeleinspritzung aktiv (homogen)" UBYTE _CNV_S_1_Def_bit_ub_700_CM 1 100. 0. 0. DISPLAY_IDENTIFIER B_DOE_H ECU_ADDRESS 0xd00076d4 BIT_MASK 0x40 /end MEASUREMENT
/begin MEASUREMENT St_mdrk.B_doe_hs "Bedingung Doppeleinspritzung aktiv (homogen-schicht)" UBYTE _CNV_S_1_Def_bit_ub_700_CM 1 100. 0. 0. DISPLAY_IDENTIFIER B_DOE_HS ECU_ADDRESS 0xd00076d4 BIT_MASK 0x10 /end MEASUREMENT
/begin MEASUREMENT St_mdrk.B_doe_s "Bedingung Doppeleinspritzung aktiv (schicht)" UBYTE _CNV_S_1_Def_bit_ub_700_CM 1 100. 0. 0. DISPLAY_IDENTIFIER B_DOE_S ECU_ADDRESS 0xd00076d4 BIT_MASK 0x8 /end MEASUREMENT
/begin MEASUREMENT St_mdrk.B_f_nobv "Bedingung keine Wunschbetriebsart erlaubt" UBYTE _CNV_S_1_Def_bit_ub_700_CM 1 100. 0. 0. DISPLAY_IDENTIFIER B_F_NOBV ECU_ADDRESS 0xd00076d4 BIT_MASK 0x4 /end MEASUREMENT
/begin MEASUREMENT St_mdrk.B_la_prio "Bedingung Vorgabe Rk mit Lambda Priorität" UBYTE _CNV_S_1_Def_bit_ub_700_CM 1 100. 0. 0. DISPLAY_IDENTIFIER B_LA_PRIO ECU_ADDRESS 0xd00076d4 BIT_MASK 0x1 /end MEASUREMENT
/begin MEASUREMENT St_mdrk.B_laprio_h "Statuswort MDRK" UBYTE _CNV_S_1_Def_bit_ub_700_CM 1 100. 0. 0. DISPLAY_IDENTIFIER B_LAPRIO_H ECU_ADDRESS 0xd00076d4 BIT_MASK 0x20 /end MEASUREMENT
/begin MEASUREMENT St_mdrk.B_rk_resmax "Bedingung Momentenreserve kann im Homogenen nich über ZW abgebaut werden" UBYTE _CNV_S_1_Def_bit_ub_700_CM 1 100. 0. 0. DISPLAY_IDENTIFIER B_RK_RESMAX ECU_ADDRESS 0xd00076d4 BIT_MASK 0x2 /end MEASUREMENT
/begin MEASUREMENT St_mdrk2 "Statuswort MDRK" UBYTE _CNV_R_R_Def_dez_sl_575_CM 1 100. 0. 255. DISPLAY_IDENTIFIER ST_MDRK2 ECU_ADDRESS 0xd00076d5 FORMAT "%3.0" /end MEASUREMENT
/begin MEASUREMENT St_mdrk2.B_espr_start "Bedingung B_espr_start" UBYTE _CNV_S_1_Def_bit_ub_700_CM 1 100. 0. 0. DISPLAY_IDENTIFIER B_ESPR_START ECU_ADDRESS 0xd00076d5 BIT_MASK 0x2 /end MEASUREMENT
/begin MEASUREMENT St_mdrk2.B_hd_start "Bedingung hoher Kraftstoffdruck im Start" UBYTE _CNV_S_1_Def_bit_ub_700_CM 1 100. 0. 0. DISPLAY_IDENTIFIER B_HD_START ECU_ADDRESS 0xd00076d5 BIT_MASK 0x1 /end MEASUREMENT
/begin MEASUREMENT St_mdrk2.B_hsplit "Bedingung B_hsplit" UBYTE _CNV_S_1_Def_bit_ub_700_CM 1 100. 0. 0. DISPLAY_IDENTIFIER B_HSPLIT ECU_ADDRESS 0xd00076d5 BIT_MASK 0x8 /end MEASUREMENT
/begin MEASUREMENT St_mdrk2.B_klopfen_s "Bedingung B_klopfen_s" UBYTE _CNV_S_1_Def_bit_ub_700_CM 1 100. 0. 0. DISPLAY_IDENTIFIER B_KLOPFEN_S ECU_ADDRESS 0xd00076d5 BIT_MASK 0x10 /end MEASUREMENT
/begin MEASUREMENT St_mdrk2.B_nesps "Bedingung B_nesps" UBYTE _CNV_S_1_Def_bit_ub_700_CM 1 100. 0. 0. DISPLAY_IDENTIFIER B_NESPS ECU_ADDRESS 0xd00076d5 BIT_MASK 0x4 /end MEASUREMENT
/begin MEASUREMENT St_mdrk2.B_rfsollfil_dec "Bedingung Rf_soll Filterung aktiv" UBYTE _CNV_S_1_Def_bit_ub_700_CM 1 100. 0. 0. DISPLAY_IDENTIFIER B_RFSOLLFIL_DEC ECU_ADDRESS 0xd00076d5 BIT_MASK 0x40 /end MEASUREMENT
/begin MEASUREMENT St_mdrk2.B_rfsollfil_inc "Bedingung Rf_soll Filterung aktiv" UBYTE _CNV_S_1_Def_bit_ub_700_CM 1 100. 0. 0. DISPLAY_IDENTIFIER B_RFSOLLFIL_INC ECU_ADDRESS 0xd00076d5 BIT_MASK 0x20 /end MEASUREMENT
/begin MEASUREMENT St_mdrk2.B_zwladif "Bedingung ZW-Eingriff durch Lambdadiff. aktiv" UBYTE _CNV_S_1_Def_bit_ub_700_CM 1 100. 0. 0. DISPLAY_IDENTIFIER B_ZWLADIF ECU_ADDRESS 0xd00076d5 BIT_MASK 0x80 /end MEASUREMENT
/begin MEASUREMENT St_mslam "Status MSLAM" UBYTE _CNV_R_R_Def_dez_sl_575_CM 1 100. 0. 255. DISPLAY_IDENTIFIER ST_MSLAM ECU_ADDRESS 0xd000754c FORMAT "%3.0" /end MEASUREMENT
/begin MEASUREMENT St_mslam.B_emslam "Status MSLAM" UBYTE _CNV_S_1_Def_bit_ub_700_CM 1 100. 0. 0. DISPLAY_IDENTIFIER B_EMSLAM ECU_ADDRESS 0xd000754c BIT_MASK 0x4 /end MEASUREMENT
/begin MEASUREMENT St_mslam.B_emslam2 "Status MSLAM" UBYTE _CNV_S_1_Def_bit_ub_700_CM 1 100. 0. 0. DISPLAY_IDENTIFIER B_EMSLAM2 ECU_ADDRESS 0xd000754c BIT_MASK 0x8 /end MEASUREMENT
/begin MEASUREMENT St_mslam.B_emslam2_tmp "Status MSLAM" UBYTE _CNV_S_1_Def_bit_ub_700_CM 1 100. 0. 0. DISPLAY_IDENTIFIER B_EMSLAM2_TMP ECU_ADDRESS 0xd000754c BIT_MASK 0x20 /end MEASUREMENT
/begin MEASUREMENT St_mslam.B_emslam_tmp "Status MSLAM" UBYTE _CNV_S_1_Def_bit_ub_700_CM 1 100. 0. 0. DISPLAY_IDENTIFIER B_EMSLAM_TMP ECU_ADDRESS 0xd000754c BIT_MASK 0x10 /end MEASUREMENT
/begin MEASUREMENT St_mslam.B_lamsonden_ok "Status MSLAM" UBYTE _CNV_S_1_Def_bit_ub_700_CM 1 100. 0. 0. DISPLAY_IDENTIFIER B_LAMSONDEN_OK ECU_ADDRESS 0xd000754c BIT_MASK 0x40 /end MEASUREMENT
/begin MEASUREMENT St_mslam.B_mslam_fg "Status MSLAM" UBYTE _CNV_S_1_Def_bit_ub_700_CM 1 100. 0. 0. DISPLAY_IDENTIFIER B_MSLAM_FG ECU_ADDRESS 0xd000754c BIT_MASK 0x80 /end MEASUREMENT
/begin MEASUREMENT St_mslam.B_mslam_on "Status MSLAM" UBYTE _CNV_S_1_Def_bit_ub_700_CM 1 100. 0. 0. DISPLAY_IDENTIFIER B_MSLAM_ON ECU_ADDRESS 0xd000754c BIT_MASK 0x2 /end MEASUREMENT
/begin MEASUREMENT St_mslam.B_sa_fe "Status MSLAM" UBYTE _CNV_S_1_Def_bit_ub_700_CM 1 100. 0. 0. DISPLAY_IDENTIFIER B_SA_FE ECU_ADDRESS 0xd000754c BIT_MASK 0x1 /end MEASUREMENT
/begin MEASUREMENT St_mslam2 "Status2 MSLAM" UBYTE _CNV_R_R_Def_dez_sl_575_CM 1 100. 0. 255. DISPLAY_IDENTIFIER ST_MSLAM2 ECU_ADDRESS 0xd000754d FORMAT "%3.0" /end MEASUREMENT
/begin MEASUREMENT St_mslam2.B_drfsoll_dyn "Rf_soll Dynamik" UBYTE _CNV_S_1_Def_bit_ub_700_CM 1 100. 0. 0. DISPLAY_IDENTIFIER B_DRFSOLL_DYN ECU_ADDRESS 0xd000754d BIT_MASK 0x10 /end MEASUREMENT
/begin MEASUREMENT St_mslam2.B_mdarv_latched "Status2 MSLAM" UBYTE _CNV_S_1_Def_bit_ub_700_CM 1 100. 0. 0. DISPLAY_IDENTIFIER B_MDARV_LATCHED ECU_ADDRESS 0xd000754d BIT_MASK 0x1 /end MEASUREMENT
/begin MEASUREMENT St_mslam2.B_mslamstp_md "Status2 MSLAM" UBYTE _CNV_S_1_Def_bit_ub_700_CM 1 100. 0. 0. DISPLAY_IDENTIFIER B_MSLAMSTP_MD ECU_ADDRESS 0xd000754d BIT_MASK 0x2 /end MEASUREMENT
/begin MEASUREMENT St_mslam2.B_mslamstp_md2 "Status2 MSLAM" UBYTE _CNV_S_1_Def_bit_ub_700_CM 1 100. 0. 0. DISPLAY_IDENTIFIER B_MSLAMSTP_MD2 ECU_ADDRESS 0xd000754d BIT_MASK 0x4 /end MEASUREMENT
/begin MEASUREMENT St_mslam2.B_sasmg "Status2 MSLAM" UBYTE _CNV_S_1_Def_bit_ub_700_CM 1 100. 0. 0. DISPLAY_IDENTIFIER B_SASMG ECU_ADDRESS 0xd000754d BIT_MASK 0x8 /end MEASUREMENT
/begin MEASUREMENT St_mslam2.B_spuelmslam_off "Status2 MSLAM" UBYTE _CNV_S_1_Def_bit_ub_700_CM 1 100. 0. 0. DISPLAY_IDENTIFIER B_SPUELMSLAM_OFF ECU_ADDRESS 0xd000754d BIT_MASK 0x20 /end MEASUREMENT
/begin MEASUREMENT St_ozbg0 "Statuswort" UBYTE _CNV_R_R_Def_dez_sl_575_CM 1 100. 0. 255. DISPLAY_IDENTIFIER ST_OZBG0 ECU_ADDRESS 0xd0006b18 FORMAT "%3.0" /end MEASUREMENT
/begin MEASUREMENT St_ozbg0.B_bosmsgc "Bedingung für Absetzen einer BOS-Meldung" UBYTE _CNV_S_1_Def_bit_ub_700_CM 1 100. 0. 0. DISPLAY_IDENTIFIER B_BOSMSGC ECU_ADDRESS 0xd0006b18 BIT_MASK 0x1 /end MEASUREMENT
/begin MEASUREMENT St_ozbg0.B_mol_vb "Bedingung Ölverbrauchswarnung" UBYTE _CNV_S_1_Def_bit_ub_700_CM 1 100. 0. 0. DISPLAY_IDENTIFIER B_MOL_VB ECU_ADDRESS 0xd0006b18 BIT_MASK 0x2 /end MEASUREMENT
/begin MEASUREMENT St_ozbg0.B_mol_vl "Bedingung Ölverlustwarnung" UBYTE _CNV_S_1_Def_bit_ub_700_CM 1 100. 0. 0. DISPLAY_IDENTIFIER B_MOL_VL ECU_ADDRESS 0xd0006b18 BIT_MASK 0x4 /end MEASUREMENT
/begin MEASUREMENT St_ozbg0.B_oeltemp "Bedingung für CAN-Ausgabe der Öltemperatur" UBYTE _CNV_S_1_Def_bit_ub_700_CM 1 100. 0. 0. DISPLAY_IDENTIFIER B_OELTEMP ECU_ADDRESS 0xd0006b18 BIT_MASK 0x8 /end MEASUREMENT
/begin MEASUREMENT St_ozbg0.B_oelverb "Statuswort" UBYTE _CNV_S_1_Def_bit_ub_700_CM 1 100. 0. 0. DISPLAY_IDENTIFIER B_OELVERB ECU_ADDRESS 0xd0006b18 BIT_MASK 0x10 /end MEASUREMENT
/begin MEASUREMENT St_ozbg0.B_oelverl "Statuswort" UBYTE _CNV_S_1_Def_bit_ub_700_CM 1 100. 0. 0. DISPLAY_IDENTIFIER B_OELVERL ECU_ADDRESS 0xd0006b18 BIT_MASK 0x20 /end MEASUREMENT
/begin MEASUREMENT St_ozbg_nv0 "Statuswort" UBYTE _CNV_R_R_Def_dez_sl_575_CM 1 100. 0. 255. DISPLAY_IDENTIFIER ST_OZBG_NV0 ECU_ADDRESS 0xc0004054 FORMAT "%3.0" /end MEASUREMENT
/begin MEASUREMENT St_ozbg_nv0.B_ozkl15 "Merker für Einschalten Kl. 15" UBYTE _CNV_S_1_Def_bit_ub_700_CM 1 100. 0. 0. DISPLAY_IDENTIFIER B_OZKL15 ECU_ADDRESS 0xc0004054 BIT_MASK 0x1 /end MEASUREMENT
/begin MEASUREMENT St_ozgg0 "Statuswort" UBYTE _CNV_R_R_Def_dez_sl_575_CM 1 100. 0. 255. DISPLAY_IDENTIFIER ST_OZGG0 ECU_ADDRESS 0xd0006b1c FORMAT "%3.0" /end MEASUREMENT
/begin MEASUREMENT St_ozgg0.B_oelwech "Bedingung Ölwechsel erfolgt" UBYTE _CNV_S_1_Def_bit_ub_700_CM 1 100. 0. 0. DISPLAY_IDENTIFIER B_OELWECH ECU_ADDRESS 0xd0006b1c BIT_MASK 0x1 /end MEASUREMENT
/begin MEASUREMENT St_ozgg0.B_ozniv "Bedingung Niveausignal in Ordnung" UBYTE _CNV_S_1_Def_bit_ub_700_CM 1 100. 0. 0. DISPLAY_IDENTIFIER B_OZNIV ECU_ADDRESS 0xd0006b1c BIT_MASK 0x2 /end MEASUREMENT
/begin MEASUREMENT St_ozgg0.B_ozperm "Bedingung Permittivitätssignal in Ordnung" UBYTE _CNV_S_1_Def_bit_ub_700_CM 1 100. 0. 0. DISPLAY_IDENTIFIER B_OZPERM ECU_ADDRESS 0xd0006b1c BIT_MASK 0x4 /end MEASUREMENT
/begin MEASUREMENT St_ozgg0.B_oztemp "Bedingung Temperatursignal in Ordnung" UBYTE _CNV_S_1_Def_bit_ub_700_CM 1 100. 0. 0. DISPLAY_IDENTIFIER B_OZTEMP ECU_ADDRESS 0xd0006b1c BIT_MASK 0x8 /end MEASUREMENT
/begin MEASUREMENT St_ozgg0.B_ozvfchg "Bedingung für geänderte Verfügbarkeit" UBYTE _CNV_S_1_Def_bit_ub_700_CM 1 100. 0. 0. DISPLAY_IDENTIFIER B_OZVFCHG ECU_ADDRESS 0xd0006b1c BIT_MASK 0x10 /end MEASUREMENT
/begin MEASUREMENT St_ozgg0.B_ozvfchgt "Statuswort" UBYTE _CNV_S_1_Def_bit_ub_700_CM 1 100. 0. 0. DISPLAY_IDENTIFIER B_OZVFCHGT ECU_ADDRESS 0xd0006b1c BIT_MASK 0x40 /end MEASUREMENT
/begin MEASUREMENT St_ozgg0.B_ozzeitdmew "Statuswort" UBYTE _CNV_S_1_Def_bit_ub_700_CM 1 100. 0. 0. DISPLAY_IDENTIFIER B_OZZEITDMEW ECU_ADDRESS 0xd0006b1c BIT_MASK 0x80 /end MEASUREMENT
/begin MEASUREMENT St_ozgg0.B_svcntchg "Bedingung für über Tester geänderten Servicezähler" UBYTE _CNV_S_1_Def_bit_ub_700_CM 1 100. 0. 0. DISPLAY_IDENTIFIER B_SVCNTCHG ECU_ADDRESS 0xd0006b1c BIT_MASK 0x20 /end MEASUREMENT
/begin MEASUREMENT St_ozgg1 "Statuswort" UBYTE _CNV_R_R_Def_dez_sl_575_CM 1 100. 0. 255. DISPLAY_IDENTIFIER ST_OZGG1 ECU_ADDRESS 0xd0006b1d FORMAT "%3.0" /end MEASUREMENT
/begin MEASUREMENT St_ozgg1.B_ozmanip "Statuswort" UBYTE _CNV_S_1_Def_bit_ub_700_CM 1 100. 0. 0. DISPLAY_IDENTIFIER B_OZMANIP ECU_ADDRESS 0xd0006b1d BIT_MASK 0x4 /end MEASUREMENT
/begin MEASUREMENT St_ozgg1.B_ozreset "BOS Reset (Ölwechsel)" UBYTE _CNV_S_1_Def_bit_ub_700_CM 1 100. 0. 0. DISPLAY_IDENTIFIER B_OZRESET ECU_ADDRESS 0xd0006b1d BIT_MASK 0x20 /end MEASUREMENT
/begin MEASUREMENT St_ozgg1.B_ozresetcan "Reset BOS vom Kombi (CAN)" UBYTE _CNV_S_1_Def_bit_ub_700_CM 1 100. 0. 0. DISPLAY_IDENTIFIER B_OZRESETCAN ECU_ADDRESS 0xd0006b1d BIT_MASK 0x10 /end MEASUREMENT
/begin MEASUREMENT St_ozgg1.B_ozresett "Reset vom Tester" UBYTE _CNV_S_1_Def_bit_ub_700_CM 1 100. 0. 0. DISPLAY_IDENTIFIER B_OZRESETT ECU_ADDRESS 0xd0006b1d BIT_MASK 0x8 /end MEASUREMENT
/begin MEASUREMENT St_ozgg1.B_ozvfchgc "Bedingung für geänderte Verfügbarkeit vom Kombi über Restweg" UBYTE _CNV_S_1_Def_bit_ub_700_CM 1 100. 0. 0. DISPLAY_IDENTIFIER B_OZVFCHGC ECU_ADDRESS 0xd0006b1d BIT_MASK 0x1 /end MEASUREMENT
/begin MEASUREMENT St_ozgg1.B_ozvfchgcc "Bedingung für geänderte Verfügbarkeit vom Kombi" UBYTE _CNV_S_1_Def_bit_ub_700_CM 1 100. 0. 0. DISPLAY_IDENTIFIER B_OZVFCHGCC ECU_ADDRESS 0xd0006b1d BIT_MASK 0x2 /end MEASUREMENT
/begin MEASUREMENT St_ozgg_nv0 "Statuswort" UBYTE _CNV_R_R_Def_dez_sl_575_CM 1 100. 0. 255. DISPLAY_IDENTIFIER ST_OZGG_NV0 ECU_ADDRESS 0xc0004064 FORMAT "%3.0" /end MEASUREMENT
/begin MEASUREMENT St_ozgg_nv0.B_dmeini "Bedingung für neue noch nicht initialisierte DME" UBYTE _CNV_S_1_Def_bit_ub_700_CM 1 100. 0. 0. DISPLAY_IDENTIFIER B_DMEINI ECU_ADDRESS 0xc0004064 BIT_MASK 0x1 /end MEASUREMENT
/begin MEASUREMENT St_ozgg_nv0.B_dmewech "Bedingung für getauschte DME zur Aktualisierung der BOS-Werte" UBYTE _CNV_S_1_Def_bit_ub_700_CM 1 100. 0. 0. DISPLAY_IDENTIFIER B_DMEWECH ECU_ADDRESS 0xc0004064 BIT_MASK 0x2 /end MEASUREMENT
/begin MEASUREMENT St_ozgg_nv0.B_factoryres "Statuswort" UBYTE _CNV_S_1_Def_bit_ub_700_CM 1 100. 0. 0. DISPLAY_IDENTIFIER B_FACTORYRES ECU_ADDRESS 0xc0004064 BIT_MASK 0x4 /end MEASUREMENT
/begin MEASUREMENT St_oznivdl0 "Statuswort" UBYTE _CNV_R_R_Def_dez_sl_575_CM 1 100. 0. 255. DISPLAY_IDENTIFIER ST_OZNIVDL0 ECU_ADDRESS 0xd0006b20 FORMAT "%3.0" /end MEASUREMENT
/begin MEASUREMENT St_oznivdl0.B_oelnivnorm "Statuswort" UBYTE _CNV_S_1_Def_bit_ub_700_CM 1 100. 0. 0. DISPLAY_IDENTIFIER B_OELNIVNORM ECU_ADDRESS 0xd0006b20 BIT_MASK 0x40 /end MEASUREMENT
/begin MEASUREMENT St_oznivdl0.B_ozkrzkor "Bedingung drehzahlkorrigierter Kurzzeit Niveaumittelwert berechnet" UBYTE _CNV_S_1_Def_bit_ub_700_CM 1 100. 0. 0. DISPLAY_IDENTIFIER B_OZKRZKOR ECU_ADDRESS 0xd0006b20 BIT_MASK 0x2 /end MEASUREMENT
/begin MEASUREMENT St_oznivdl0.B_ozkrzl "Statuswort" UBYTE _CNV_S_1_Def_bit_ub_700_CM 1 100. 0. 0. DISPLAY_IDENTIFIER B_OZKRZL ECU_ADDRESS 0xd0006b20 BIT_MASK 0x80 /end MEASUREMENT
/begin MEASUREMENT St_oznivdl0.B_ozkrzlkor "Statuswort" UBYTE _CNV_S_1_Def_bit_ub_700_CM 1 100. 0. 0. DISPLAY_IDENTIFIER B_OZKRZLKOR ECU_ADDRESS 0xd0006b20 BIT_MASK 0x20 /end MEASUREMENT
/begin MEASUREMENT St_oznivdl0.B_ozlangmw "Bedingung Langzeit-Mittelwert berechnet" UBYTE _CNV_S_1_Def_bit_ub_700_CM 1 100. 0. 0. DISPLAY_IDENTIFIER B_OZLANGMW ECU_ADDRESS 0xd0006b20 BIT_MASK 0x4 /end MEASUREMENT
/begin MEASUREMENT St_oznivdl0.B_oznivb "Statuswort" UBYTE _CNV_S_1_Def_bit_ub_700_CM 1 100. 0. 0. DISPLAY_IDENTIFIER B_OZNIVB ECU_ADDRESS 0xd0006b20 BIT_MASK 0x1 /end MEASUREMENT
/begin MEASUREMENT St_oznivdl0.B_ozor "Bedingung Orientierungsmessung erfolgt" UBYTE _CNV_S_1_Def_bit_ub_700_CM 1 100. 0. 0. DISPLAY_IDENTIFIER B_OZOR ECU_ADDRESS 0xd0006b20 BIT_MASK 0x8 /end MEASUREMENT
/begin MEASUREMENT St_oznivdl0.B_ozvormw "Bedingung vorgezogener Mittelwert berechnet" UBYTE _CNV_S_1_Def_bit_ub_700_CM 1 100. 0. 0. DISPLAY_IDENTIFIER B_OZVORMW ECU_ADDRESS 0xd0006b20 BIT_MASK 0x10 /end MEASUREMENT
/begin MEASUREMENT St_oznivdl1 "Statuswort" UBYTE _CNV_R_R_Def_dez_sl_575_CM 1 100. 0. 255. DISPLAY_IDENTIFIER ST_OZNIVDL1 ECU_ADDRESS 0xd0006b21 FORMAT "%3.0" /end MEASUREMENT
/begin MEASUREMENT St_oznivdl1.B_ozfahrt "Das Fahrzeug hat sich bewegt" UBYTE _CNV_S_1_Def_bit_ub_700_CM 1 100. 0. 0. DISPLAY_IDENTIFIER B_OZFAHRT ECU_ADDRESS 0xd0006b21 BIT_MASK 0x10 /end MEASUREMENT
/begin MEASUREMENT St_oznivdl1.B_ozkrzkor2 "Ein Mittelwert von zwei KurzMw ist da" UBYTE _CNV_S_1_Def_bit_ub_700_CM 1 100. 0. 0. DISPLAY_IDENTIFIER B_OZKRZKOR2 ECU_ADDRESS 0xd0006b21 BIT_MASK 0x1 /end MEASUREMENT
/begin MEASUREMENT St_oznivdl1.B_ozkrzkornb "Bedingung drehzahlkorrigierter Kurzzeit Niveaumittelwert und nicht drehzahlbegrenzt berechnet" UBYTE _CNV_S_1_Def_bit_ub_700_CM 1 100. 0. 0. DISPLAY_IDENTIFIER B_OZKRZKORNB ECU_ADDRESS 0xd0006b21 BIT_MASK 0x2 /end MEASUREMENT
/begin MEASUREMENT St_oznivdl1.B_ozml "Anforderung Messung läuft" UBYTE _CNV_S_1_Def_bit_ub_700_CM 1 100. 0. 0. DISPLAY_IDENTIFIER B_OZML ECU_ADDRESS 0xd0006b21 BIT_MASK 0x40 /end MEASUREMENT
/begin MEASUREMENT St_oznivdl1.B_ozmreset "Reset der Messungen (beim INI2-Sprung)" UBYTE _CNV_S_1_Def_bit_ub_700_CM 1 100. 0. 0. DISPLAY_IDENTIFIER B_OZMRESET ECU_ADDRESS 0xd0006b21 BIT_MASK 0x80 /end MEASUREMENT
/begin MEASUREMENT St_oznivdl1.B_ozoelcheck "Statuswort" UBYTE _CNV_S_1_Def_bit_ub_700_CM 1 100. 0. 0. DISPLAY_IDENTIFIER B_OZOELCHECK ECU_ADDRESS 0xd0006b21 BIT_MASK 0x4 /end MEASUREMENT
/begin MEASUREMENT St_oznivdl1.B_ozoelchok "Statuswort" UBYTE _CNV_S_1_Def_bit_ub_700_CM 1 100. 0. 0. DISPLAY_IDENTIFIER B_OZOELCHOK ECU_ADDRESS 0xd0006b21 BIT_MASK 0x8 /end MEASUREMENT
/begin MEASUREMENT St_oznivdl1.B_ozueberf "Überfüllung entdeckt" UBYTE _CNV_S_1_Def_bit_ub_700_CM 1 100. 0. 0. DISPLAY_IDENTIFIER B_OZUEBERF ECU_ADDRESS 0xd0006b21 BIT_MASK 0x20 /end MEASUREMENT
/begin MEASUREMENT St_oznivdl_nv0 "Statuswort" UBYTE _CNV_R_R_Def_dez_sl_575_CM 1 100. 0. 255. DISPLAY_IDENTIFIER ST_OZNIVDL_NV0 ECU_ADDRESS 0xc00040a0 FORMAT "%3.0" /end MEASUREMENT
/begin MEASUREMENT St_oznivdl_nv0.B_ozabzlang "Abstellzeit zu lang für die anzeige des letzten Wertes" UBYTE _CNV_S_1_Def_bit_ub_700_CM 1 100. 0. 0. DISPLAY_IDENTIFIER B_OZABZLANG ECU_ADDRESS 0xc00040a0 BIT_MASK 0x20 /end MEASUREMENT
/begin MEASUREMENT St_oznivdl_nv0.B_ozlmwneu "Langzeit-Mittelwert berechnet in der letzten Fahrt" UBYTE _CNV_S_1_Def_bit_ub_700_CM 1 100. 0. 0. DISPLAY_IDENTIFIER B_OZLMWNEU ECU_ADDRESS 0xc00040a0 BIT_MASK 0x4 /end MEASUREMENT
/begin MEASUREMENT St_oznivdl_nv0.B_ozlw1 "Bedingung mindestens 1 gültiger Langzeitmittelwert war vorhanden" UBYTE _CNV_S_1_Def_bit_ub_700_CM 1 100. 0. 0. DISPLAY_IDENTIFIER B_OZLW1 ECU_ADDRESS 0xc00040a0 BIT_MASK 0x1 /end MEASUREMENT
/begin MEASUREMENT St_oznivdl_nv0.B_oznachf "Nachfüllung erkannt" UBYTE _CNV_S_1_Def_bit_ub_700_CM 1 100. 0. 0. DISPLAY_IDENTIFIER B_OZNACHF ECU_ADDRESS 0xc00040a0 BIT_MASK 0x8 /end MEASUREMENT
/begin MEASUREMENT St_oznivdl_nv0.B_ozoelwech "Ölwechsel für die Peilstabanzeige" UBYTE _CNV_S_1_Def_bit_ub_700_CM 1 100. 0. 0. DISPLAY_IDENTIFIER B_OZOELWECH ECU_ADDRESS 0xc00040a0 BIT_MASK 0x10 /end MEASUREMENT
/begin MEASUREMENT St_oznivdl_nv0.B_ozpeilerr "Statuswort" UBYTE _CNV_S_1_Def_bit_ub_700_CM 1 100. 0. 0. DISPLAY_IDENTIFIER B_OZPEILERR ECU_ADDRESS 0xc00040a0 BIT_MASK 0x2 /end MEASUREMENT
/begin MEASUREMENT St_ozperm0 "Statuswort" UBYTE _CNV_R_R_Def_dez_sl_575_CM 1 100. 0. 255. DISPLAY_IDENTIFIER ST_OZPERM0 ECU_ADDRESS 0xd0006b24 FORMAT "%3.0" /end MEASUREMENT
/begin MEASUREMENT St_ozperm0.B_calcdper "Bedingung für Berechnung Restweg aus Er" UBYTE _CNV_S_1_Def_bit_ub_700_CM 1 100. 0. 0. DISPLAY_IDENTIFIER B_CALCDPER ECU_ADDRESS 0xd0006b24 BIT_MASK 0x1 /end MEASUREMENT
/begin MEASUREMENT St_ozperm0.B_ozpermgl "Statuswort" UBYTE _CNV_S_1_Def_bit_ub_700_CM 1 100. 0. 0. DISPLAY_IDENTIFIER B_OZPERMGL ECU_ADDRESS 0xd0006b24 BIT_MASK 0x2 /end MEASUREMENT
/begin MEASUREMENT St_ozperm0.B_ozpermpl "Statuswort" UBYTE _CNV_S_1_Def_bit_ub_700_CM 1 100. 0. 0. DISPLAY_IDENTIFIER B_OZPERMPL ECU_ADDRESS 0xd0006b24 BIT_MASK 0x4 /end MEASUREMENT
/begin MEASUREMENT St_ozperm0.B_ozpermpld "Statuswort" UBYTE _CNV_S_1_Def_bit_ub_700_CM 1 100. 0. 0. DISPLAY_IDENTIFIER B_OZPERMPLD ECU_ADDRESS 0xd0006b24 BIT_MASK 0x8 /end MEASUREMENT
/begin MEASUREMENT St_ozperm_nv0 "Statuswort" UBYTE _CNV_R_R_Def_dez_sl_575_CM 1 100. 0. 255. DISPLAY_IDENTIFIER ST_OZPERM_NV0 ECU_ADDRESS 0xc00040b4 FORMAT "%3.0" /end MEASUREMENT
/begin MEASUREMENT St_ozperm_nv0.B_ozdperm "Bedingung Delta Er-Ermittlung aktiv" UBYTE _CNV_S_1_Def_bit_ub_700_CM 1 100. 0. 0. DISPLAY_IDENTIFIER B_OZDPERM ECU_ADDRESS 0xc00040b4 BIT_MASK 0x10 /end MEASUREMENT
/begin MEASUREMENT St_ozperm_nv0.B_ozer0ok "Bedingung Permittivität beim letztem Ölwechsel endgültig berechnet" UBYTE _CNV_S_1_Def_bit_ub_700_CM 1 100. 0. 0. DISPLAY_IDENTIFIER B_OZER0OK ECU_ADDRESS 0xc00040b4 BIT_MASK 0x8 /end MEASUREMENT
/begin MEASUREMENT St_ozperm_nv0.B_ozeranz "Bedingung für Anzeige Restweg aus Er" UBYTE _CNV_S_1_Def_bit_ub_700_CM 1 100. 0. 0. DISPLAY_IDENTIFIER B_OZERANZ ECU_ADDRESS 0xc00040b4 BIT_MASK 0x2 /end MEASUREMENT
/begin MEASUREMENT St_ozperm_nv0.B_ozerplt "Bedingung Ausheizzeit erfüllt" UBYTE _CNV_S_1_Def_bit_ub_700_CM 1 100. 0. 0. DISPLAY_IDENTIFIER B_OZERPLT ECU_ADDRESS 0xc00040b4 BIT_MASK 0x20 /end MEASUREMENT
/begin MEASUREMENT St_ozperm_nv0.B_ozper0ok "Bedingung, dass gültiger Start-Permittivitätswert vorliegt" UBYTE _CNV_S_1_Def_bit_ub_700_CM 1 100. 0. 0. DISPLAY_IDENTIFIER B_OZPER0OK ECU_ADDRESS 0xc00040b4 BIT_MASK 0x1 /end MEASUREMENT
/begin MEASUREMENT St_ozperm_nv0.B_ozregstg "Bedingung Schieberegistersteuerung" UBYTE _CNV_S_1_Def_bit_ub_700_CM 1 100. 0. 0. DISPLAY_IDENTIFIER B_OZREGSTG ECU_ADDRESS 0xc00040b4 BIT_MASK 0x4 /end MEASUREMENT
/begin MEASUREMENT St_ozrestkm_0 "Statuswort" UBYTE _CNV_R_R_Def_dez_sl_575_CM 1 100. 0. 255. DISPLAY_IDENTIFIER ST_OZRESTKM_0 ECU_ADDRESS 0xd0006b28 FORMAT "%3.0" /end MEASUREMENT
/begin MEASUREMENT St_ozrestkm_0.B_oznoperm "Keine Berechnung von Permittivität für die Restlaufstrecke" UBYTE _CNV_S_1_Def_bit_ub_700_CM 1 100. 0. 0. DISPLAY_IDENTIFIER B_OZNOPERM ECU_ADDRESS 0xd0006b28 BIT_MASK 0x1 /end MEASUREMENT
/begin MEASUREMENT St_ozrestkm_nv0 "Statuswort" UBYTE _CNV_R_R_Def_dez_sl_575_CM 1 100. 0. 255. DISPLAY_IDENTIFIER ST_OZRESTKM_NV0 ECU_ADDRESS 0xc0004100 FORMAT "%3.0" /end MEASUREMENT
/begin MEASUREMENT St_ozrestkm_nv0.B_ozcntini "Tageberechnung initialisiert" UBYTE _CNV_S_1_Def_bit_ub_700_CM 1 100. 0. 0. DISPLAY_IDENTIFIER B_OZCNTINI ECU_ADDRESS 0xc0004100 BIT_MASK 0x8 /end MEASUREMENT
/begin MEASUREMENT St_ozrestkm_nv0.B_ozini "Statuswort" UBYTE _CNV_S_1_Def_bit_ub_700_CM 1 100. 0. 0. DISPLAY_IDENTIFIER B_OZINI ECU_ADDRESS 0xc0004100 BIT_MASK 0x4 /end MEASUREMENT
/begin MEASUREMENT St_ozrestkm_nv0.B_ozvfk "Prognose und KVB aus der Kombi-Verfügbarkeit berechnet " UBYTE _CNV_S_1_Def_bit_ub_700_CM 1 100. 0. 0. DISPLAY_IDENTIFIER B_OZVFK ECU_ADDRESS 0xc0004100 BIT_MASK 0x2 /end MEASUREMENT
/begin MEASUREMENT St_ozrestkm_nv0.B_rwanz0 "Bedingung für Restweganzeige = Null" UBYTE _CNV_S_1_Def_bit_ub_700_CM 1 100. 0. 0. DISPLAY_IDENTIFIER B_RWANZ0 ECU_ADDRESS 0xc0004100 BIT_MASK 0x1 /end MEASUREMENT
/begin MEASUREMENT St_pgenllred "Statuswort" UBYTE _CNV_R_R_Def_dez_sl_575_CM 1 100. 0. 255. DISPLAY_IDENTIFIER ST_PGENLLRED ECU_ADDRESS 0xd00072e0 FORMAT "%3.0" /end MEASUREMENT
/begin MEASUREMENT St_pgenllred.B_geli "Bedingung Generatorlastbegrenzung für Leerlaufstabilisierung" UBYTE _CNV_S_1_Def_bit_ub_700_CM 1 100. 0. 0. DISPLAY_IDENTIFIER B_GELI ECU_ADDRESS 0xd00072e0 BIT_MASK 0x2 /end MEASUREMENT
/begin MEASUREMENT St_pgenllred.B_nsubgen "Bedingung Leerlaufsolldrehzahlanhebung bei erkannten Generatorlastschwankung" UBYTE _CNV_S_1_Def_bit_ub_700_CM 1 100. 0. 0. DISPLAY_IDENTIFIER B_NSUBGEN ECU_ADDRESS 0xd00072e0 BIT_MASK 0x1 /end MEASUREMENT
/begin MEASUREMENT St_pgenllred.B_pgenllerk "Bedingung Generatorlimitierung wegen LL-Sägen erkannt" UBYTE _CNV_S_1_Def_bit_ub_700_CM 1 100. 0. 0. DISPLAY_IDENTIFIER B_PGENLLERK ECU_ADDRESS 0xd00072e0 BIT_MASK 0x4 /end MEASUREMENT
/begin MEASUREMENT St_pgenllred_200ms "Statuswort" UBYTE _CNV_R_R_Def_dez_sl_575_CM 1 100. 0. 255. DISPLAY_IDENTIFIER ST_PGENLLRED_200MS ECU_ADDRESS 0xc0005248 FORMAT "%3.0" /end MEASUREMENT
/begin MEASUREMENT St_pgenllred_200ms.B_dffaktiv "Bedingung Auswertung des Generatorlastsignals für Leerlaufregelung aktiv" UBYTE _CNV_S_1_Def_bit_ub_700_CM 1 100. 0. 0. DISPLAY_IDENTIFIER B_DFFAKTIV ECU_ADDRESS 0xc0005248 BIT_MASK 0x2 /end MEASUREMENT
/begin MEASUREMENT St_pgenllred_200ms.B_nsubg_r "Resetbedingung für LL Anhebung GEN" UBYTE _CNV_S_1_Def_bit_ub_700_CM 1 100. 0. 0. DISPLAY_IDENTIFIER B_NSUBG_R ECU_ADDRESS 0xc0005248 BIT_MASK 0x4 /end MEASUREMENT
/begin MEASUREMENT St_pgenllred_200ms.B_nsubgen1 "Temporäre Zwischengröße für LL Anhebung Generator" UBYTE _CNV_S_1_Def_bit_ub_700_CM 1 100. 0. 0. DISPLAY_IDENTIFIER B_NSUBGEN1 ECU_ADDRESS 0xc0005248 BIT_MASK 0x8 /end MEASUREMENT
/begin MEASUREMENT St_pgenllred_200ms.B_pgenllfa "Bedingung für Rücksetzen erkanntes LL-Sägen durch Generator" UBYTE _CNV_S_1_Def_bit_ub_700_CM 1 100. 0. 0. DISPLAY_IDENTIFIER B_PGENLLFA ECU_ADDRESS 0xc0005248 BIT_MASK 0x10 /end MEASUREMENT
/begin MEASUREMENT St_pgenllred_200ms.B_pgenredllve "Bedingung Fehler Fahrzeuggeschwindigkeit erkannt" UBYTE _CNV_S_1_Def_bit_ub_700_CM 1 100. 0. 0. DISPLAY_IDENTIFIER B_PGENREDLLVE ECU_ADDRESS 0xc0005248 BIT_MASK 0x1 /end MEASUREMENT
/begin MEASUREMENT Td_mslam "Zeitverzögerung Rk_1 und Rk_2" UBYTE _CNV_R_R_Def_td_ub__711_CM 1 100. 0. 2550. DISPLAY_IDENTIFIER TD_MSLAM ECU_ADDRESS 0xd0007561 FORMAT "%4.1" /end MEASUREMENT
/begin MEASUREMENT Td_mslampt1 "Zeitkonstante für PT1 Filter für Zeitverzögerung Rk_1 und Rk_2" UWORD _CNV_R_R_Def_zk10ms_709_CM 1 100. 1.e-002 655.36 DISPLAY_IDENTIFIER TD_MSLAMPT1 ECU_ADDRESS 0xd000755e FORMAT "%9.4" /end MEASUREMENT
/begin MEASUREMENT Td_mszyl "Zeitverzögerung Rk_1 und Rk_2" UBYTE _CNV_R_R_Def_td_ub__711_CM 1 100. 0. 2550. DISPLAY_IDENTIFIER TD_MSZYL ECU_ADDRESS 0xd000755c FORMAT "%4.1" /end MEASUREMENT
/begin MEASUREMENT Td_mszyl_kw "Zeitverzögerung Rk_1 und Rk_2" UBYTE _CNV_R_R_Def_td_ub__711_CM 1 100. 0. 2550. DISPLAY_IDENTIFIER TD_MSZYL_KW ECU_ADDRESS 0xd0007560 FORMAT "%4.1" /end MEASUREMENT
/begin MEASUREMENT Td_vwl "Zeitverzögerung Wese" UBYTE _CNV_R_R_Def_td_ub__711_CM 1 100. 0. 2550. DISPLAY_IDENTIFIER TD_VWL ECU_ADDRESS 0xd0007562 FORMAT "%4.1" /end MEASUREMENT
/begin MEASUREMENT Tdffgen "Zeitzähler für Erkennung Generatorlastschwankung für Leerlaufanhebung" UWORD _CNV_R_R_Def_td_uw__712_CM 1 100. 0. 13107. DISPLAY_IDENTIFIER TDFFGEN ECU_ADDRESS 0xc000524c FORMAT "%6.1" /end MEASUREMENT
/begin MEASUREMENT Toel "Ausgabewert Motoröltemperatur für LoCAN" SWORD _CNV_R_R_Def_t_sw_q_618_CM 1 100. -3276.8 3276.7 DISPLAY_IDENTIFIER TOEL ECU_ADDRESS 0xc0002790 FORMAT "%6.1" /end MEASUREMENT
/begin MEASUREMENT Toel_oz "Ausgabe Öltemperatur" SWORD _CNV_R_R_Def_t_sw_q_618_CM 1 100. -3276.8 3276.7 DISPLAY_IDENTIFIER TOEL_OZ ECU_ADDRESS 0xc0002792 FORMAT "%6.1" /end MEASUREMENT
/begin MEASUREMENT V_pgenllkor "Fahrzeuggeschwindigkeit korrigiert" UWORD _CNV_R_R_Def_v_uw_q_724_CM 1 100. 0. 6553.5 DISPLAY_IDENTIFIER V_PGENLLKOR ECU_ADDRESS 0xd00072e2 FORMAT "%7.2" /end MEASUREMENT
/begin MEASUREMENT Zrbosmld "anzuzeigender Zähler für durchgeführten Ölservice" UBYTE _CNV_R_R_Def_dez_sl_575_CM 1 100. 0. 255. DISPLAY_IDENTIFIER ZRBOSMLD ECU_ADDRESS 0xc0004061 FORMAT "%3.0" /end MEASUREMENT
/begin MEASUREMENT Zyl_misfire_diag "Status MISFIRE" UBYTE _CNV_R_R_Def_dez_sl_575_CM 1 100. 0. 255. DISPLAY_IDENTIFIER ZYL_MISFIRE_DIAG ECU_ADDRESS 0xd000754e FORMAT "%3.0" /end MEASUREMENT
/begin CHARACTERISTIC CW_KHM "Codewort KHM" VALUE 0xa101a2c4 _REC_VAL_20_u1 99.45 _CNV_R_R_Def_dez_sl_575_CM 0. 255. FORMAT "%3.0" /end CHARACTERISTIC
/begin CHARACTERISTIC CW_MDMSLAM_CONFB1 "Configuration, Misfireerkennung, Bank1" VALUE 0xa1019ac0 _REC_VAL_20_u1 99.45 _CNV_R_R_Def_dez_sl_575_CM 0. 255. FORMAT "%3.0" /end CHARACTERISTIC
/begin CHARACTERISTIC CW_MDMSLAM_CONFB2 "Configuration, Misfireerkennung, Bank2" VALUE 0xa1019ac1 _REC_VAL_20_u1 99.45 _CNV_R_R_Def_dez_sl_575_CM 0. 255. FORMAT "%3.0" /end CHARACTERISTIC
/begin CHARACTERISTIC KF_AGR "" MAP 0xa101a2f0 _REC_MAP_52_UBYTE_s2_s2_u2 100. _CNV_R_R_Def_eta_sw_628_CM 0. 100.
 /begin AXIS_DESCR STD_AXIS Nkw _CNV_R_R_Def_n_sw_q_612_CM 8 -32768. 32767. FORMAT "%5.0" /end AXIS_DESCR
 /begin AXIS_DESCR STD_AXIS Agr_rate _CNV_R_R_Def_tvpwm__736_CM 6 0. 100. /end AXIS_DESCR
/end CHARACTERISTIC
/begin CHARACTERISTIC KF_ETARKTE_S "" MAP 0xa101a9bc _REC_MAP_52_UBYTE_u2_s2_s2 99.99845000000002 _CNV_R_R_Def_eta_uw_627_CM 0. 199.9969
 /begin AXIS_DESCR STD_AXIS Nkw _CNV_R_R_Def_n_sw_q_612_CM 8 -32768. 32767. FORMAT "%5.0" /end AXIS_DESCR
 /begin AXIS_DESCR STD_AXIS Rk1_s _CNV_R_R_Def_rk_sw__697_CM 8 -1600. 1599.9511 /end AXIS_DESCR
/end CHARACTERISTIC
/begin CHARACTERISTIC KF_ETATEMIN_S "" MAP 0xa101a874 _REC_MAP_52_UBYTE_u2_s2_s2 99.99845000000002 _CNV_R_R_Def_eta_uw_627_CM 0. 199.9969
 /begin AXIS_DESCR STD_AXIS Nkw _CNV_R_R_Def_n_sw_q_612_CM 8 -32768. 32767. FORMAT "%5.0" /end AXIS_DESCR
 /begin AXIS_DESCR STD_AXIS Rk1_s _CNV_R_R_Def_rk_sw__697_CM 8 -1600. 1599.9511 /end AXIS_DESCR
/end CHARACTERISTIC
/begin CHARACTERISTIC KF_FRFMXKRK "Faktor RF" MAP 0xa101ce0c _REC_MAP_52_UBYTE_u2_s2_s2 1.9999 _CNV_R_R_Def_f_uw_b_579_CM 0. 1.9999 FORMAT "%14.5"
 /begin AXIS_DESCR STD_AXIS Nkw _CNV_R_R_Def_n_sw_q_612_CM 6 -32768. 32767. FORMAT "%5.0" /end AXIS_DESCR
 /begin AXIS_DESCR STD_AXIS Dzw_ldkrdyn _CNV_R_R_Def_zw_sw__599_CM 6 -50. 60. FORMAT "%4.1" /end AXIS_DESCR
/end CHARACTERISTIC
/begin CHARACTERISTIC KF_FRFMXKRL "Faktor RF" MAP 0xa101cd44 _REC_MAP_52_UBYTE_u2_s2_s2 1.9999 _CNV_R_R_Def_f_uw_b_579_CM 0. 1.9999 FORMAT "%14.5"
 /begin AXIS_DESCR STD_AXIS Nkw _CNV_R_R_Def_n_sw_q_612_CM 6 -32768. 32767. FORMAT "%5.0" /end AXIS_DESCR
 /begin AXIS_DESCR STD_AXIS Dzw_ldkrstat _CNV_R_R_Def_zw_sw__599_CM 6 -50. 60. FORMAT "%4.1" /end AXIS_DESCR
/end CHARACTERISTIC
/begin CHARACTERISTIC KF_FRFMXKROB "Faktor RF" MAP 0xa101cce0 _REC_MAP_52_UBYTE_u2_s2_s2 1.9999 _CNV_R_R_Def_f_uw_b_579_CM 0. 1.9999 FORMAT "%14.5"
 /begin AXIS_DESCR STD_AXIS Nkw _CNV_R_R_Def_n_sw_q_612_CM 6 -32768. 32767. FORMAT "%5.0" /end AXIS_DESCR
 /begin AXIS_DESCR STD_AXIS Dzw_ldkrob _CNV_R_R_Def_zw_sw__599_CM 6 -50. 60. FORMAT "%4.1" /end AXIS_DESCR
/end CHARACTERISTIC
/begin CHARACTERISTIC KF_FRFMXTALD "Faktor Max. Fuellung" MAP 0xa101cda8 _REC_MAP_52_UBYTE_u2_s2_s2 1.9999 _CNV_R_R_Def_f_uw_b_579_CM 0. 1.9999 FORMAT "%14.5"
 /begin AXIS_DESCR STD_AXIS Nkw _CNV_R_R_Def_n_sw_q_612_CM 6 -32768. 32767. FORMAT "%5.0" /end AXIS_DESCR
 /begin AXIS_DESCR STD_AXIS Tans _CNV_R_R_Def_t_sw_q_618_CM 6 -3276.8 3276.7 FORMAT "%4.1" /end AXIS_DESCR
/end CHARACTERISTIC
/begin CHARACTERISTIC KF_FRK2_H "" MAP 0xa101bf18 _REC_MAP_52_UBYTE_u2_s2_s2 1. _CNV_R_R_Def_f_uw_b_633_CM 0. 1. FORMAT "%7.4"
 /begin AXIS_DESCR STD_AXIS Nkw _CNV_R_R_Def_n_sw_q_612_CM 12 -32768. 32767. FORMAT "%5.0" /end AXIS_DESCR
 /begin AXIS_DESCR STD_AXIS Rk_sollm_h _CNV_R_R_Def_rk_sw__697_CM 12 -1600. 1599.9511 /end AXIS_DESCR
/end CHARACTERISTIC
/begin CHARACTERISTIC KF_FRKKORRF_1 "" MAP 0xa101c314 _REC_MAP_52_UBYTE_u2_s2_s2 1.9999 _CNV_R_R_Def_f_uw_b_579_CM 0. 1.9999 FORMAT "%14.5"
 /begin AXIS_DESCR STD_AXIS Nkw _CNV_R_R_Def_n_sw_q_612_CM 16 -32768. 32767. FORMAT "%5.0" /end AXIS_DESCR
 /begin AXIS_DESCR STD_AXIS Rf _CNV_R_R_Def_rf_sw__616_CM 16 -327.68 327.67 FORMAT "%7.4" /end AXIS_DESCR
/end CHARACTERISTIC
/begin CHARACTERISTIC KF_FRKKORRF_2 "" MAP 0xa101c558 _REC_MAP_52_UBYTE_u2_s2_s2 1.9999 _CNV_R_R_Def_f_uw_b_579_CM 0. 1.9999 FORMAT "%14.5"
 /begin AXIS_DESCR STD_AXIS Nkw _CNV_R_R_Def_n_sw_q_612_CM 16 -32768. 32767. FORMAT "%5.0" /end AXIS_DESCR
 /begin AXIS_DESCR STD_AXIS Rf _CNV_R_R_Def_rf_sw__616_CM 16 -327.68 327.67 FORMAT "%7.4" /end AXIS_DESCR
/end CHARACTERISTIC
/begin CHARACTERISTIC KF_FRKSTRED "" MAP 0xa101c79c _REC_MAP_52_UBYTE_u2_u2_s2 1.9999 _CNV_R_R_Def_f_uw_b_579_CM 0. 1.9999 FORMAT "%14.5"
 /begin AXIS_DESCR STD_AXIS Zr_seg_nstart _CNV_R_R_Def_dez_sl_575_CM 16 0. 65535. FORMAT "%5.0" /end AXIS_DESCR
 /begin AXIS_DESCR STD_AXIS Tmot _CNV_R_R_Def_t_sw_q_620_CM 6 -327.68 327.67 FORMAT "%5.2" /end AXIS_DESCR
/end CHARACTERISTIC
/begin CHARACTERISTIC KF_LABAS_H "Kennfeld Basis Lambda (homogen)" MAP 0xa101a67c _REC_MAP_52_UBYTE_u2_s2_s2 15.9997 _CNV_R_R_Def_f_uw_b_594_CM 0. 15.9997 FORMAT "%7.4"
 /begin AXIS_DESCR STD_AXIS Nkw _CNV_R_R_Def_n_sw_q_612_CM 12 -32768. 32767. FORMAT "%5.0" /end AXIS_DESCR
 /begin AXIS_DESCR STD_AXIS Rk_korzw_h _CNV_R_R_Def_rk_sw__697_CM 12 -1600. 1599.9511 /end AXIS_DESCR
/end CHARACTERISTIC
/begin CHARACTERISTIC KF_MDIBAS_HS "-" MAP 0xa101b068 _REC_MAP_52_UBYTE_s2_s2_s2 131.07 _CNV_R_R_Def_m_sw_q_574_CM -3276.8 3276.7 FORMAT "%5.2"
 /begin AXIS_DESCR STD_AXIS Nkw _CNV_R_R_Def_n_sw_q_612_CM 10 -32768. 32767. FORMAT "%5.0" /end AXIS_DESCR
 /begin AXIS_DESCR STD_AXIS Rf _CNV_R_R_Def_rf_sw__616_CM 12 -327.68 327.67 FORMAT "%7.4" /end AXIS_DESCR
/end CHARACTERISTIC
/begin CHARACTERISTIC KF_MDIBAS_S "-" MAP 0xa101ae28 _REC_MAP_52_UBYTE_s2_s2_s2 131.07 _CNV_R_R_Def_m_sw_q_574_CM -3276.8 3276.7 FORMAT "%5.2"
 /begin AXIS_DESCR STD_AXIS Nkw _CNV_R_R_Def_n_sw_q_612_CM 10 -32768. 32767. FORMAT "%5.0" /end AXIS_DESCR
 /begin AXIS_DESCR STD_AXIS Rf _CNV_R_R_Def_rf_sw__616_CM 12 -327.68 327.67 FORMAT "%7.4" /end AXIS_DESCR
/end CHARACTERISTIC
/begin CHARACTERISTIC KF_MDIMIN_HS "" MAP 0xa101b4e8 _REC_MAP_52_UBYTE_s2_s2_s2 131.07 _CNV_R_R_Def_m_sw_q_574_CM -3276.8 3276.7 FORMAT "%5.2"
 /begin AXIS_DESCR STD_AXIS Nkw _CNV_R_R_Def_n_sw_q_612_CM 10 -32768. 32767. FORMAT "%5.0" /end AXIS_DESCR
 /begin AXIS_DESCR STD_AXIS Rf _CNV_R_R_Def_rf_sw__616_CM 12 -327.68 327.67 FORMAT "%7.4" /end AXIS_DESCR
/end CHARACTERISTIC
/begin CHARACTERISTIC KF_MDIMIN_S "" MAP 0xa101b3c8 _REC_MAP_52_UBYTE_s2_s2_s2 131.07 _CNV_R_R_Def_m_sw_q_574_CM -3276.8 3276.7 FORMAT "%5.2"
 /begin AXIS_DESCR STD_AXIS Nkw _CNV_R_R_Def_n_sw_q_612_CM 10 -32768. 32767. FORMAT "%5.0" /end AXIS_DESCR
 /begin AXIS_DESCR STD_AXIS Rf _CNV_R_R_Def_rf_sw__616_CM 12 -327.68 327.67 FORMAT "%7.4" /end AXIS_DESCR
/end CHARACTERISTIC
/begin CHARACTERISTIC KF_OZKORRNIV "Niveaukorrektur nach Startzeit und Temperatur" MAP 0xa100e08c _REC_MAP_52_UBYTE_s2_s2_u2 74.9999 _CNV_R_R_Def_niv_ub_672_CM -37.7929 37.207 FORMAT "%5.2"
 /begin AXIS_DESCR STD_AXIS Oz_tempf _CNV_R_R_Def_t_sw_q_618_CM 6 -3276.8 3276.7 FORMAT "%4.1" /end AXIS_DESCR
 /begin AXIS_DESCR STD_AXIS Oz_nivzeit _CNV_R_R_Def_td_uw__679_CM 4 0. 655.35 FORMAT "%5.2" /end AXIS_DESCR
/end CHARACTERISTIC
/begin CHARACTERISTIC KF_OZKORRORI "Kennfeld für die Korrektur des OriMw mit Abstellzeit und Öltemperatur" MAP 0xa100e064 _REC_MAP_52_UBYTE_s2_s2_u2 74.70699999999999 _CNV_R_R_Def_niv_ub_672_CM -37.5 37.207 FORMAT "%5.2"
 /begin AXIS_DESCR STD_AXIS Toel _CNV_R_R_Def_t_sw_q_618_CM 4 -3276.8 3276.7 FORMAT "%4.1" /end AXIS_DESCR
 /begin AXIS_DESCR STD_AXIS Tn_abstellm _CNV_R_R_Def_tn_uw__671_CM 3 0. 65535. FORMAT "%5.2" /end AXIS_DESCR
/end CHARACTERISTIC
/begin CHARACTERISTIC KF_OZTEMPMDL "Öl-Modelltemperatur" MAP 0xa100e170 _REC_MAP_52_UBYTE_s2_s2_s2 131.07 _CNV_R_R_Def_t_sw_q_618_CM -3276.8 3276.7 FORMAT "%4.1"
 /begin AXIS_DESCR STD_AXIS Tmot _CNV_R_R_Def_t_sw_q_620_CM 4 -327.68 327.67 FORMAT "%5.2" /end AXIS_DESCR
 /begin AXIS_DESCR STD_AXIS Nkw _CNV_R_R_Def_n_sw_q_612_CM 4 -32768. 32767. FORMAT "%5.0" /end AXIS_DESCR
/end CHARACTERISTIC
/begin CHARACTERISTIC KF_OZZEIT "Zusammenführüng Abstellzeit und Startzeit" MAP 0xa100e0d4 _REC_MAP_52_UBYTE_u2_u2_u2 98.30250000000001 _CNV_R_R_Def_td_uw__679_CM 0. 655.35 FORMAT "%5.2"
 /begin AXIS_DESCR STD_AXIS Tn_start_10 _CNV_R_R_Def_td_uw__679_CM 6 0. 655.35 FORMAT "%5.2" /end AXIS_DESCR
 /begin AXIS_DESCR STD_AXIS Oz_abstellm _CNV_R_R_Def_tn_uw__671_CM 4 0. 65535. FORMAT "%5.2" /end AXIS_DESCR
/end CHARACTERISTIC
/begin CHARACTERISTIC KF_PLDMXNTA "Max. Ladedruck" MAP 0xa101ce70 _REC_MAP_52_UBYTE_u2_s2_s2 102.398436 _CNV_R_R_Def_p_sw_q_578_CM 0. 2559.9609 FORMAT "%5.2"
 /begin AXIS_DESCR STD_AXIS Nkw _CNV_R_R_Def_n_sw_q_612_CM 6 -32768. 32767. FORMAT "%5.0" /end AXIS_DESCR
 /begin AXIS_DESCR STD_AXIS Tans _CNV_R_R_Def_t_sw_q_618_CM 6 -3276.8 3276.7 FORMAT "%4.1" /end AXIS_DESCR
/end CHARACTERISTIC
/begin CHARACTERISTIC KF_PLDMXNTA_S "Max. Ladedruck im Status Sportbetrieb" MAP 0xa101ced4 _REC_MAP_52_UBYTE_u2_s2_s2 102.398436 _CNV_R_R_Def_p_sw_q_578_CM 0. 2559.9609 FORMAT "%5.2"
 /begin AXIS_DESCR STD_AXIS Nkw _CNV_R_R_Def_n_sw_q_612_CM 6 -32768. 32767. FORMAT "%5.0" /end AXIS_DESCR
 /begin AXIS_DESCR STD_AXIS Tans _CNV_R_R_Def_t_sw_q_618_CM 6 -3276.8 3276.7 FORMAT "%4.1" /end AXIS_DESCR
/end CHARACTERISTIC
/begin CHARACTERISTIC KF_RFBAS_HS "Optimales Rk_soll ohne Mdi_bas-Begrenzung (homogen-schicht)" MAP 0xa101bcd4 _REC_MAP_52_UBYTE_s2_s2_s2 98.30250000000001 _CNV_R_R_Def_rf_sw__616_CM -327.68 327.67 FORMAT "%7.4"
 /begin AXIS_DESCR STD_AXIS Nkw _CNV_R_R_Def_n_sw_q_612_CM 16 -32768. 32767. FORMAT "%5.0" /end AXIS_DESCR
 /begin AXIS_DESCR STD_AXIS NO_INPUT_QUANTITY _CNV_R_R_Def_rk_sw__697_CM 16 -1600. 1599.9511 /end AXIS_DESCR
/end CHARACTERISTIC
/begin CHARACTERISTIC KF_RFBAS_S "" MAP 0xa101b84c _REC_MAP_52_UBYTE_s2_s2_s2 98.30250000000001 _CNV_R_R_Def_rf_sw__616_CM -327.68 327.67 FORMAT "%7.4"
 /begin AXIS_DESCR STD_AXIS Nkw _CNV_R_R_Def_n_sw_q_612_CM 16 -32768. 32767. FORMAT "%5.0" /end AXIS_DESCR
 /begin AXIS_DESCR STD_AXIS Rk_bas_s _CNV_R_R_Def_rk_sw__697_CM 16 -1600. 1599.9511 /end AXIS_DESCR
/end CHARACTERISTIC
/begin CHARACTERISTIC KF_RFMINKH_S "" MAP 0xa101a918 _REC_MAP_52_UBYTE_s2_s2_s2 98.30250000000001 _CNV_R_R_Def_rf_sw__616_CM -327.68 327.67 FORMAT "%7.4"
 /begin AXIS_DESCR STD_AXIS Nkw _CNV_R_R_Def_n_sw_q_612_CM 8 -32768. 32767. FORMAT "%5.0" /end AXIS_DESCR
 /begin AXIS_DESCR STD_AXIS Rk_bas_s _CNV_R_R_Def_rk_sw__697_CM 8 -1600. 1599.9511 /end AXIS_DESCR
/end CHARACTERISTIC
/begin CHARACTERISTIC KF_RFMINSA_1 "-" MAP 0xa101c90c _REC_MAP_52_UBYTE_s2_s2_s2 98.30250000000001 _CNV_R_R_Def_rf_sw__616_CM -327.68 327.67 FORMAT "%7.4"
 /begin AXIS_DESCR STD_AXIS Nkw _CNV_R_R_Def_n_sw_q_612_CM 8 -32768. 32767. FORMAT "%5.0" /end AXIS_DESCR
 /begin AXIS_DESCR STD_AXIS Tmot _CNV_R_R_Def_t_sw_q_620_CM 6 -327.68 327.67 FORMAT "%5.2" /end AXIS_DESCR
/end CHARACTERISTIC
/begin CHARACTERISTIC KF_RFMINTE_S "" MAP 0xa101a7d0 _REC_MAP_52_UBYTE_s2_s2_s2 98.30250000000001 _CNV_R_R_Def_rf_sw__616_CM -327.68 327.67 FORMAT "%7.4"
 /begin AXIS_DESCR STD_AXIS Nkw _CNV_R_R_Def_n_sw_q_612_CM 8 -32768. 32767. FORMAT "%5.0" /end AXIS_DESCR
 /begin AXIS_DESCR STD_AXIS Rk_bas_s _CNV_R_R_Def_rk_sw__697_CM 8 -1600. 1599.9511 /end AXIS_DESCR
/end CHARACTERISTIC
/begin CHARACTERISTIC KF_RFMIN_1 "-" MAP 0xa101c88c _REC_MAP_52_UBYTE_s2_s2_s2 98.30250000000001 _CNV_R_R_Def_rf_sw__616_CM -327.68 327.67 FORMAT "%7.4"
 /begin AXIS_DESCR STD_AXIS Nkw _CNV_R_R_Def_n_sw_q_612_CM 8 -32768. 32767. FORMAT "%5.0" /end AXIS_DESCR
 /begin AXIS_DESCR STD_AXIS Tmot _CNV_R_R_Def_t_sw_q_620_CM 6 -327.68 327.67 FORMAT "%5.2" /end AXIS_DESCR
/end CHARACTERISTIC
/begin CHARACTERISTIC KF_RFOPT_HS "" MAP 0xa101ba90 _REC_MAP_52_UBYTE_s2_s2_s2 98.30250000000001 _CNV_R_R_Def_rf_sw__616_CM -327.68 327.67 FORMAT "%7.4"
 /begin AXIS_DESCR STD_AXIS Nkw _CNV_R_R_Def_n_sw_q_612_CM 16 -32768. 32767. FORMAT "%5.0" /end AXIS_DESCR
 /begin AXIS_DESCR STD_AXIS NO_INPUT_QUANTITY _CNV_R_R_Def_rk_sw__697_CM 16 -1600. 1599.9511 /end AXIS_DESCR
/end CHARACTERISTIC
/begin CHARACTERISTIC KF_RFOPT_S "" MAP 0xa101b608 _REC_MAP_52_UBYTE_s2_s2_s2 98.30250000000001 _CNV_R_R_Def_rf_sw__616_CM -327.68 327.67 FORMAT "%7.4"
 /begin AXIS_DESCR STD_AXIS Nkw _CNV_R_R_Def_n_sw_q_612_CM 16 -32768. 32767. FORMAT "%5.0" /end AXIS_DESCR
 /begin AXIS_DESCR STD_AXIS Rk_opt_s _CNV_R_R_Def_rk_sw__697_CM 16 -1600. 1599.9511 /end AXIS_DESCR
/end CHARACTERISTIC
/begin CHARACTERISTIC KF_RK2_HS "" MAP 0xa101c1c0 _REC_MAP_52_UBYTE_s2_s2_s2 95.99853300000001 _CNV_R_R_Def_rk_sw__697_CM -1600. 1599.9511
 /begin AXIS_DESCR STD_AXIS Nkw _CNV_R_R_Def_n_sw_q_612_CM 12 -32768. 32767. FORMAT "%5.0" /end AXIS_DESCR
 /begin AXIS_DESCR STD_AXIS Rk_soll_hs _CNV_R_R_Def_rk_sw__697_CM 12 -1600. 1599.9511 /end AXIS_DESCR
/end CHARACTERISTIC
/begin CHARACTERISTIC KF_RK2_S "" MAP 0xa101c06c _REC_MAP_52_UBYTE_s2_s2_s2 95.99853300000001 _CNV_R_R_Def_rk_sw__697_CM -1600. 1599.9511
 /begin AXIS_DESCR STD_AXIS Nkw _CNV_R_R_Def_n_sw_q_612_CM 12 -32768. 32767. FORMAT "%5.0" /end AXIS_DESCR
 /begin AXIS_DESCR STD_AXIS Rk_soll_s _CNV_R_R_Def_rk_sw__697_CM 12 -1600. 1599.9511 /end AXIS_DESCR
/end CHARACTERISTIC
/begin CHARACTERISTIC KF_RKLAM_KOR "Korrekturkennfeld" MAP 0xa1019ca4 _REC_MAP_52_UBYTE_u2_u2_s2 1.9999 _CNV_R_R_Def_f_uw_b_579_CM 0. 1.9999 FORMAT "%14.5"
 /begin AXIS_DESCR STD_AXIS NO_INPUT_QUANTITY _CNV_R_R_Def_rk_uw__696_CM 8 0. 31.9995 FORMAT "%7.4" /end AXIS_DESCR
 /begin AXIS_DESCR STD_AXIS Nkw _CNV_R_R_Def_n_sw_q_612_CM 8 -32768. 32767. FORMAT "%5.0" /end AXIS_DESCR
/end CHARACTERISTIC
/begin CHARACTERISTIC KF_RKMAXBG_HS "Maximale Begrenzung rel. Krafstoffmasse (homogen-schicht)" MAP 0xa101af48 _REC_MAP_52_UBYTE_s2_s2_s2 95.99853300000001 _CNV_R_R_Def_rk_sw__697_CM -1600. 1599.9511
 /begin AXIS_DESCR STD_AXIS Nkw _CNV_R_R_Def_n_sw_q_612_CM 10 -32768. 32767. FORMAT "%5.0" /end AXIS_DESCR
 /begin AXIS_DESCR STD_AXIS Rf _CNV_R_R_Def_rf_sw__616_CM 12 -327.68 327.67 FORMAT "%7.4" /end AXIS_DESCR
/end CHARACTERISTIC
/begin CHARACTERISTIC KF_RKMAXBG_S "Maximale Begrenzung rel. Krafstoffmasse (schicht)" MAP 0xa101ad08 _REC_MAP_52_UBYTE_s2_s2_s2 95.99853300000001 _CNV_R_R_Def_rk_sw__697_CM -1600. 1599.9511
 /begin AXIS_DESCR STD_AXIS Nkw _CNV_R_R_Def_n_sw_q_612_CM 10 -32768. 32767. FORMAT "%5.0" /end AXIS_DESCR
 /begin AXIS_DESCR STD_AXIS Rf _CNV_R_R_Def_rf_sw__616_CM 12 -327.68 327.67 FORMAT "%7.4" /end AXIS_DESCR
/end CHARACTERISTIC
/begin CHARACTERISTIC KF_RKMINBG_HS "Minimale Begrenzung rel. Krafstoffmasse (homogen-schicht)" MAP 0xa101b2a8 _REC_MAP_52_UBYTE_s2_s2_s2 95.99853300000001 _CNV_R_R_Def_rk_sw__697_CM -1600. 1599.9511
 /begin AXIS_DESCR STD_AXIS Nkw _CNV_R_R_Def_n_sw_q_612_CM 10 -32768. 32767. FORMAT "%5.0" /end AXIS_DESCR
 /begin AXIS_DESCR STD_AXIS Rf _CNV_R_R_Def_rf_sw__616_CM 12 -327.68 327.67 FORMAT "%7.4" /end AXIS_DESCR
/end CHARACTERISTIC
/begin CHARACTERISTIC KF_RKMINBG_S "Minimale Begrenzung rel. Krafstoffmasse (schicht)" MAP 0xa101b188 _REC_MAP_52_UBYTE_s2_s2_s2 95.99853300000001 _CNV_R_R_Def_rk_sw__697_CM -1600. 1599.9511
 /begin AXIS_DESCR STD_AXIS Nkw _CNV_R_R_Def_n_sw_q_612_CM 10 -32768. 32767. FORMAT "%5.0" /end AXIS_DESCR
 /begin AXIS_DESCR STD_AXIS Rf _CNV_R_R_Def_rf_sw__616_CM 12 -327.68 327.67 FORMAT "%7.4" /end AXIS_DESCR
/end CHARACTERISTIC
/begin CHARACTERISTIC KF_RKMIN_H "Faktor Krafstoffmasse homogen Bank2" MAP 0xa101aa60 _REC_MAP_52_UBYTE_s2_s2_s2 95.99853300000001 _CNV_R_R_Def_rk_sw__697_CM -1600. 1599.9511
 /begin AXIS_DESCR STD_AXIS Nkw _CNV_R_R_Def_n_sw_q_612_CM 12 -32768. 32767. FORMAT "%5.0" /end AXIS_DESCR
 /begin AXIS_DESCR STD_AXIS Rf _CNV_R_R_Def_rf_sw__616_CM 12 -327.68 327.67 FORMAT "%7.4" /end AXIS_DESCR
/end CHARACTERISTIC
/begin CHARACTERISTIC KF_RKSTART "Relative Krafstoffmasse im Start" MAP 0xa101abb4 _REC_MAP_52_UBYTE_s2_s2_s2 95.99853300000001 _CNV_R_R_Def_rk_sw__697_CM -1600. 1599.9511
 /begin AXIS_DESCR STD_AXIS Nkw _CNV_R_R_Def_n_sw_q_612_CM 12 -32768. 32767. FORMAT "%5.0" /end AXIS_DESCR
 /begin AXIS_DESCR STD_AXIS Tmot _CNV_R_R_Def_t_sw_q_620_CM 12 -327.68 327.67 FORMAT "%5.2" /end AXIS_DESCR
/end CHARACTERISTIC
/begin CHARACTERISTIC KF_TDRKLAM "Kennfeld zur Variablen Verzögerung von Rk_1 und Rk_2" MAP 0xa1019b9c _REC_MAP_52_u1_s2_s2 102. _CNV_R_R_Def_td_ub__711_CM 0. 2550. FORMAT "%4.1"
 /begin AXIS_DESCR STD_AXIS Nkw _CNV_R_R_Def_n_sw_q_612_CM 8 -32768. 32767. FORMAT "%5.0" /end AXIS_DESCR
 /begin AXIS_DESCR STD_AXIS Rf _CNV_R_R_Def_rf_sw__616_CM 8 -327.68 327.67 FORMAT "%7.4" /end AXIS_DESCR
/end CHARACTERISTIC
/begin CHARACTERISTIC KF_TDRKLAMF "Kennfeld zur Fiulterung der Variablen Verzögerung von Rk_1 und Rk_2" MAP 0xa1019c00 _REC_MAP_52_UBYTE_u2_s2_s2 655.35 _CNV_R_R_Def_zk10ms_709_CM 1.e-002 655.36 FORMAT "%7.4"
 /begin AXIS_DESCR STD_AXIS Nkw _CNV_R_R_Def_n_sw_q_612_CM 8 -32768. 32767. FORMAT "%5.0" /end AXIS_DESCR
 /begin AXIS_DESCR STD_AXIS Rf _CNV_R_R_Def_rf_sw__616_CM 8 -327.68 327.67 FORMAT "%7.4" /end AXIS_DESCR
/end CHARACTERISTIC
/begin CHARACTERISTIC KL_DRFSOLL_MSLAM "Maximal zulässiges Drf_soll für FG MSLAM" CURVE 0xa1019aec _REC_CUR_TKL_UW_VV__s2_s2 98.30250000000001 _CNV_R_R_Def_rf_sw__616_CM -327.68 327.67 FORMAT "%7.4"
 /begin AXIS_DESCR STD_AXIS Tmot _CNV_R_R_Def_t_sw_q_620_CM 6 -327.68 327.67 FORMAT "%5.2" /end AXIS_DESCR
/end CHARACTERISTIC
/begin CHARACTERISTIC KL_DZW_KRFR "KL Deltazümdwinkel Klopfregelung früh" CURVE 0xa101cb04 _REC_CUR_TKL_UW_VV__s2_s2 99.83843999999999 _CNV_R_R_Def_zw_sw__624_CM -64. 63.998
 /begin AXIS_DESCR STD_AXIS Nkw _CNV_R_R_Def_n_sw_q_612_CM 8 -32768. 32767. FORMAT "%5.0" /end AXIS_DESCR
/end CHARACTERISTIC
/begin CHARACTERISTIC KL_DZW_KRSP "KL Deltazümdwinkel Klopfregelung spät" CURVE 0xa101cae0 _REC_CUR_TKL_UW_VV__s2_s2 99.83843999999999 _CNV_R_R_Def_zw_sw__624_CM -64. 63.998
 /begin AXIS_DESCR STD_AXIS Dzw_mm _CNV_R_R_Def_zw_sw__599_CM 8 -50. 60. FORMAT "%4.1" /end AXIS_DESCR
/end CHARACTERISTIC
/begin CHARACTERISTIC KL_ETAESTE_S "" CURVE 0xa101a3fc _REC_CUR_TKL_UW_VV__u2_u2 99.99845000000002 _CNV_R_R_Def_eta_uw_627_CM 0. 199.9969
 /begin AXIS_DESCR STD_AXIS Lamb_es_s _CNV_R_R_Def_f_uw_b_594_CM 8 0. 15.9997 FORMAT "%7.4" /end AXIS_DESCR
/end CHARACTERISTIC
/begin CHARACTERISTIC KL_ETALAMTE_S "" CURVE 0xa101a420 _REC_CUR_TKL_UW_VV__u2_u2 99.99845000000002 _CNV_R_R_Def_eta_uw_627_CM 0. 199.9969
 /begin AXIS_DESCR STD_AXIS Lamb_te _CNV_R_R_Def_f_uw_b_594_CM 8 0. 15.9997 FORMAT "%7.4" /end AXIS_DESCR
/end CHARACTERISTIC
/begin CHARACTERISTIC KL_ETARF_HS "Wirkungsgrad Rfopt zu Rkopt (homogen-schicht)" CURVE 0xa101a470 _REC_CUR_TKL_UW_VV__u2_s2 99.99845000000002 _CNV_R_R_Def_eta_uw_627_CM 0. 199.9969
 /begin AXIS_DESCR STD_AXIS Drfopt_hs _CNV_R_R_Def_eta_sw_617_CM 10 -200. 199.9938 /end AXIS_DESCR
/end CHARACTERISTIC
/begin CHARACTERISTIC KL_ETARF_S "Wirkungsgrad Rfopt zu Rkopt (schicht)" CURVE 0xa101a444 _REC_CUR_TKL_UW_VV__u2_s2 99.99845000000002 _CNV_R_R_Def_eta_uw_627_CM 0. 199.9969
 /begin AXIS_DESCR STD_AXIS Drfopt_s _CNV_R_R_Def_eta_sw_617_CM 10 -200. 199.9938 /end AXIS_DESCR
/end CHARACTERISTIC
/begin CHARACTERISTIC KL_FDRFTE "" CURVE 0xa101a3d0 _REC_CUR_TKL_UW_VV__s2_u2 1.9999 _CNV_R_R_Def_f_uw_b_579_CM -1. 0.9999 FORMAT "%14.5"
 /begin AXIS_DESCR STD_AXIS F_etatemin_s _CNV_R_R_Def_eta_uw_627_CM 10 0. 199.9969 /end AXIS_DESCR
/end CHARACTERISTIC
/begin CHARACTERISTIC KL_FRFMXTMLD "Faktor Max. Fuellung" CURVE 0xa101ccb0 _REC_CUR_TKL_UW_VV__u2_s2 1.9999 _CNV_R_R_Def_f_uw_b_579_CM 0. 1.9999 FORMAT "%14.5"
 /begin AXIS_DESCR STD_AXIS Tmot _CNV_R_R_Def_t_sw_q_620_CM 6 -327.68 327.67 FORMAT "%5.2" /end AXIS_DESCR
/end CHARACTERISTIC
/begin CHARACTERISTIC KL_FRK2ST_H "" CURVE 0xa101a5c0 _REC_CUR_TKL_UW_VV__u2_s2 1. _CNV_R_R_Def_f_uw_b_633_CM 0. 1. FORMAT "%7.4"
 /begin AXIS_DESCR STD_AXIS Nkw _CNV_R_R_Def_n_sw_q_612_CM 10 -32768. 32767. FORMAT "%5.0" /end AXIS_DESCR
/end CHARACTERISTIC
/begin CHARACTERISTIC KL_FRKSTP "" CURVE 0xa101a5ec _REC_CUR_TKL_UW_VV__u2_u2 0.9999 _CNV_R_R_Def_f_uw_b_591_CM 0. 0.9999 FORMAT "%14.5"
 /begin AXIS_DESCR STD_AXIS Prail_ist _CNV_R_R_Def_p_uw_q_685_CM 10 0. 39.9993 FORMAT "%7.4" /end AXIS_DESCR
/end CHARACTERISTIC
/begin CHARACTERISTIC KL_FRKVL_HS "" CURVE 0xa101a634 _REC_CUR_TKL_UW_VV__u2_u2 3.9999 _CNV_R_R_Def_f_sw_b_608_CM 0. 3.9999 FORMAT "%14.5"
 /begin AXIS_DESCR STD_AXIS F_tvdkho _CNV_R_R_Def_f_sw_b_608_CM 6 0. 3.9999 FORMAT "%14.5" /end AXIS_DESCR
/end CHARACTERISTIC
/begin CHARACTERISTIC KL_FRKVL_S "" CURVE 0xa101a618 _REC_CUR_TKL_UW_VV__u2_u2 3.9999 _CNV_R_R_Def_f_sw_b_608_CM 0. 3.9999 FORMAT "%14.5"
 /begin AXIS_DESCR STD_AXIS F_tvdkho _CNV_R_R_Def_f_sw_b_608_CM 6 0. 3.9999 FORMAT "%14.5" /end AXIS_DESCR
/end CHARACTERISTIC
/begin CHARACTERISTIC KL_FUPSRF_ATL "" CURVE 0xa101cbe8 _REC_CUR_TKL_UW_VV__u2_s2 0.299995422363281 _CNV_R_R_Def_f_uw_b_639_CM 0. 0.299995422363281 FORMAT "%14.6"
 /begin AXIS_DESCR STD_AXIS Nkw _CNV_R_R_Def_n_sw_q_612_CM 12 -32768. 32767. FORMAT "%5.0" /end AXIS_DESCR
/end CHARACTERISTIC
/begin CHARACTERISTIC KL_GELIKMIE "Faktor für Generatorlastbegrenzung für Leerlaufstabilisierung" CURVE 0xa1017ce0 _REC_CUR_TKL_UW_VV__u1_u1 1.9921 _CNV_R_R_Def_f_ub_b_625_CM 0. 1.9921 /begin AXIS_DESCR STD_AXIS Ierr _CNV_R_R_Def_i_ub_q_645_CM 6 0. 31.875 /end AXIS_DESCR /end CHARACTERISTIC
/begin CHARACTERISTIC KL_INVTANSIG "Approximation inverse tansig-Funktion" CURVE 0xa100ad90 _REC_CUR_TKL_UW_VV__S4_S4 0. _CNV_R_R_Def_dez_sl_575_CM -1000000000000. 0. FORMAT "%14.7"
 /begin AXIS_DESCR STD_AXIS NO_INPUT_QUANTITY _CNV_R_R_Def_dez_sl_575_CM 10 -1000000000000. 0. FORMAT "%14.7" /end AXIS_DESCR
/end CHARACTERISTIC
/begin CHARACTERISTIC KL_KHMAX_S "" CURVE 0xa101a49c _REC_CUR_TKL_UW_VV__s2_s2 99.99844999999999 _CNV_R_R_Def_f_sw_b_597_CM -100. 99.9969
 /begin AXIS_DESCR STD_AXIS Nkw _CNV_R_R_Def_n_sw_q_612_CM 6 -32768. 32767. FORMAT "%5.0" /end AXIS_DESCR
/end CHARACTERISTIC
/begin CHARACTERISTIC KL_KORRKFVST "" CURVE 0xa1019ad8 _REC_CUR_TKL_UW_VV__u2_u2 63.99900000000001 _CNV_R_R_Def_f_uw_b_580_CM 0. 63.999 FORMAT "%7.4"
 /begin AXIS_DESCR STD_AXIS F_vst _CNV_R_R_Def_f_uw_b_580_CM 4 0. 63.999 FORMAT "%7.4" /end AXIS_DESCR
/end CHARACTERISTIC
/begin CHARACTERISTIC KL_LALIUS "Lambdalinearisierung, LSU-Sonde vor Katalysator" CURVE 0xa1019b40 _REC_CUR_TKL_UW_VV__u2_u2 15.9997 _CNV_R_R_Def_f_uw_b_594_CM 0. 15.9997 FORMAT "%7.4" /begin AXIS_DESCR STD_AXIS Ulams_1 _CNV_R_R_Def_u_uw_q_720_CM 22 0. 4.9951 /end AXIS_DESCR /end CHARACTERISTIC
/begin CHARACTERISTIC KL_LAMX_ATL "Max. Turbo-Luftaufwand" CURVE 0xa101cbb4 _REC_CUR_TKL_UW_VV__s2_s2 98.30250000000001 _CNV_R_R_Def_rf_sw__616_CM -327.68 327.67 FORMAT "%7.4"
 /begin AXIS_DESCR STD_AXIS Nkw _CNV_R_R_Def_n_sw_q_612_CM 12 -32768. 32767. FORMAT "%5.0" /end AXIS_DESCR
/end CHARACTERISTIC
/begin CHARACTERISTIC KL_LAMX_ATLS "Max. Turbo-Luftaufwand im Sport-Modus" CURVE 0xa101cb80 _REC_CUR_TKL_UW_VV__s2_s2 98.30250000000001 _CNV_R_R_Def_rf_sw__616_CM -327.68 327.67 FORMAT "%7.4"
 /begin AXIS_DESCR STD_AXIS Nkw _CNV_R_R_Def_n_sw_q_612_CM 12 -32768. 32767. FORMAT "%5.0" /end AXIS_DESCR
/end CHARACTERISTIC
/begin CHARACTERISTIC KL_LDRFKRA "RF Schwelle" CURVE 0xa101cc1c _REC_CUR_TKL_UW_VV__s2_s2 98.30250000000001 _CNV_R_R_Def_rf_sw__616_CM -327.68 327.67 FORMAT "%7.4"
 /begin AXIS_DESCR STD_AXIS Nkw _CNV_R_R_Def_n_sw_q_612_CM 6 -32768. 32767. FORMAT "%5.0" /end AXIS_DESCR
/end CHARACTERISTIC
/begin CHARACTERISTIC KL_MDRESKRLL "KL Momentenreserve Klopfregelung LL" CURVE 0xa101cb28 _REC_CUR_TKL_UW_VV__s2_s2 131.07 _CNV_R_R_Def_m_sw_q_574_CM -3276.8 3276.7 FORMAT "%5.2"
 /begin AXIS_DESCR STD_AXIS Dzw_krkorlls _CNV_R_R_Def_zw_sw__624_CM 8 -64. 63.998 /end AXIS_DESCR
/end CHARACTERISTIC
/begin CHARACTERISTIC KL_OZBEFKL "Befüllkennlinie" CURVE 0xa100de84 _REC_CUR_TKL_UW_VV__u1_u1 25.5 _CNV_R_R_Def_niv_ub_677_CM 0. 25.5 FORMAT "%5.2"
 /begin AXIS_DESCR STD_AXIS Oz_nivkrzt _CNV_R_R_Def_niv_ub_672_CM 6 0. 74.70699999999999 FORMAT "%5.2" /end AXIS_DESCR
/end CHARACTERISTIC
/begin CHARACTERISTIC KL_OZKRZMW2 "Anzahl 10er Pakete für Steigungsberechnung in Abhängigkeit von der gefahrenen Strecke" CURVE 0xa100df40 _REC_CUR_TKL_UW_VV__u1_u2 99.45 _CNV_R_R_Def_dez_sl_575_CM 0. 255. FORMAT "%3.0"
 /begin AXIS_DESCR STD_AXIS Oz_dkm _CNV_R_R_Def_f_uw_b_629_CM 4 0. 9.999800000000001 FORMAT "%7.4" /end AXIS_DESCR
/end CHARACTERISTIC
/begin CHARACTERISTIC KL_OZLBNIV "Korrektur der Längbeschleunigungseffekte beim 10er Paket QLT" CURVE 0xa100dfdc _REC_CUR_TKL_UW_VV__s1_s1 74.70699999999999 _CNV_R_R_Def_niv_ub_672_CM -37.5 37.207 FORMAT "%5.2"
 /begin AXIS_DESCR STD_AXIS Oz_lbmw _CNV_R_R_Def_f_sb_b_674_CM 8 -2. 1.9843 FORMAT "%5.2" /end AXIS_DESCR
/end CHARACTERISTIC
/begin CHARACTERISTIC KL_OZLN "y = ln x" CURVE 0xa100df24 _REC_CUR_TKL_UW_VV__s2_u2 1.999969482421875 _CNV_R_R_Def_f_uw_b_579_CM -1. 0.999969482421875 FORMAT "%14.5"
 /begin AXIS_DESCR STD_AXIS Oz_pzdivp _CNV_R_R_Def_f_uw_b_579_CM 6 0. 1.9999 FORMAT "%14.5" /end AXIS_DESCR
/end CHARACTERISTIC
/begin CHARACTERISTIC KL_OZNFDELTA "Delta für die Nachfüllerkennung" CURVE 0xa100e024 _REC_CUR_TKL_UW_VV__u1_u1 74.70699999999999 _CNV_R_R_Def_niv_ub_672_CM 0. 74.70699999999999 FORMAT "%5.2"
 /begin AXIS_DESCR STD_AXIS Oz_peillang _CNV_R_R_Def_niv_ub_672_CM 6 0. 74.70699999999999 FORMAT "%5.2" /end AXIS_DESCR
/end CHARACTERISTIC
/begin CHARACTERISTIC KL_OZNMNIVKL "Kennlinie für Drehzahlkorrektur des Niveaus" CURVE 0xa100dff0 _REC_CUR_TKL_UW_VV__s1_s2 74.70699999999999 _CNV_R_R_Def_niv_ub_672_CM -37.5 37.207 FORMAT "%5.2"
 /begin AXIS_DESCR STD_AXIS N_ozmw _CNV_R_R_Def_n_sw_q_612_CM 16 -32768. 32767. FORMAT "%5.0" /end AXIS_DESCR
/end CHARACTERISTIC
/begin CHARACTERISTIC KL_OZORBERO "Toleranz für Orientierungsmessung nach oben in mm" CURVE 0xa100dfcc _REC_CUR_TKL_UW_VV__u1_u1 74.70699999999999 _CNV_R_R_Def_niv_ub_672_CM 0. 74.70699999999999 FORMAT "%5.2"
 /begin AXIS_DESCR STD_AXIS Oz_peillang _CNV_R_R_Def_niv_ub_672_CM 6 0. 74.70699999999999 FORMAT "%5.2" /end AXIS_DESCR
/end CHARACTERISTIC
/begin CHARACTERISTIC KL_OZPERMKL "Skalierungskennlinie Permittivität" CURVE 0xa100de68 _REC_CUR_TKL_UW_VV__u2_u2 5.9999 _CNV_R_R_Def_perm_u_676_CM 0. 5.9999 FORMAT "%14.5"
 /begin AXIS_DESCR STD_AXIS Oz_permt _CNV_R_R_Def_dez_sl_575_CM 2 0. 65535. FORMAT "%5.0" /end AXIS_DESCR
/end CHARACTERISTIC
/begin CHARACTERISTIC KL_OZQBNIV "Korrektur der Querbeschleunigungseffekte beim 10er Paket QLT" CURVE 0xa100e034 _REC_CUR_TKL_UW_VV__s1_s1 74.70699999999999 _CNV_R_R_Def_niv_ub_672_CM -37.5 37.207 FORMAT "%5.2"
 /begin AXIS_DESCR STD_AXIS Oz_qbmw _CNV_R_R_Def_f_sb_b_674_CM 8 -2. 1.9843 FORMAT "%5.2" /end AXIS_DESCR
/end CHARACTERISTIC
/begin CHARACTERISTIC KL_OZSTNIV "Korrektur der Steigungseffekte beim 20er Paket QLT" CURVE 0xa100e048 _REC_CUR_TKL_UW_VV__s1_s2 74.70699999999999 _CNV_R_R_Def_niv_ub_672_CM -37.5 37.207 FORMAT "%5.2"
 /begin AXIS_DESCR STD_AXIS Oz_steigung _CNV_R_R_Def_f_sw_b_634_CM 8 -64. 63.998 /end AXIS_DESCR
/end CHARACTERISTIC
/begin CHARACTERISTIC KL_OZTEMPKL "" CURVE 0xa100de74 _REC_CUR_TKL_UW_VV__s2_u2 131.07 _CNV_R_R_Def_t_sw_q_618_CM -3276.8 3276.7 FORMAT "%4.1"
 /begin AXIS_DESCR STD_AXIS Oz_tempt _CNV_R_R_Def_dez_sl_575_CM 2 0. 65535. FORMAT "%5.0" /end AXIS_DESCR
/end CHARACTERISTIC
/begin CHARACTERISTIC KL_OZVERDFAK "Verdünnungsfaktor von Dieseleintrag" CURVE 0xa100e154 _REC_CUR_TKL_UW_VV__u2_u2 0.9999847412109381 _CNV_R_R_Def_f_uw_b_591_CM 0. 0.9999847412109381 FORMAT "%14.5"
 /begin AXIS_DESCR STD_AXIS NO_INPUT_QUANTITY _CNV_R_R_Def_f_uw_b_591_CM 5 0. 0.9999 FORMAT "%14.5" /end AXIS_DESCR
/end CHARACTERISTIC
/begin CHARACTERISTIC KL_PIRG_ATL "" CURVE 0xa101cc38 _REC_CUR_TKL_UW_VV__u2_s2 102.398436 _CNV_R_R_Def_p_sw_q_578_CM 0. 2559.9609 FORMAT "%5.2"
 /begin AXIS_DESCR STD_AXIS Nkw _CNV_R_R_Def_n_sw_q_612_CM 12 -32768. 32767. FORMAT "%5.0" /end AXIS_DESCR
/end CHARACTERISTIC
/begin CHARACTERISTIC KL_PLDMXN "Max. Ladedruck" CURVE 0xa101cb50 _REC_CUR_TKL_UW_VV__u2_s2 102.398436 _CNV_R_R_Def_p_sw_q_578_CM 0. 2559.9609 FORMAT "%5.2"
 /begin AXIS_DESCR STD_AXIS Nkw _CNV_R_R_Def_n_sw_q_612_CM 6 -32768. 32767. FORMAT "%5.0" /end AXIS_DESCR
/end CHARACTERISTIC
/begin CHARACTERISTIC KL_PRAIL_MIN "" CURVE 0xa101a650 _REC_CUR_TKL_UW_VV__u2_s2 39.9993 _CNV_R_R_Def_p_uw_q_685_CM 0. 39.9993 FORMAT "%7.4"
 /begin AXIS_DESCR STD_AXIS Tmot _CNV_R_R_Def_t_sw_q_620_CM 10 -327.68 327.67 FORMAT "%5.2" /end AXIS_DESCR
/end CHARACTERISTIC
/begin CHARACTERISTIC KL_RFGRDMAX "Wirkungsgrad Rfopt zu Rkopt (schicht)" CURVE 0xa101a3a4 _REC_CUR_TKL_UW_VV__s2_s2 98.30250000000001 _CNV_R_R_Def_rf_sw__616_CM -327.68 327.67 FORMAT "%7.4"
 /begin AXIS_DESCR STD_AXIS Dmdkw_soll _CNV_R_R_Def_m_sw_q_574_CM 10 -3276.8 3276.7 FORMAT "%5.2" /end AXIS_DESCR
/end CHARACTERISTIC
/begin CHARACTERISTIC KL_RFMXELDO "Max. Fuellung" CURVE 0xa101cc80 _REC_CUR_TKL_UW_VV__s2_s2 98.30250000000001 _CNV_R_R_Def_rf_sw__616_CM -327.68 327.67 FORMAT "%7.4"
 /begin AXIS_DESCR STD_AXIS Nkw _CNV_R_R_Def_n_sw_q_612_CM 6 -32768. 32767. FORMAT "%5.0" /end AXIS_DESCR
/end CHARACTERISTIC
/begin CHARACTERISTIC KL_RKMINDOE_HS "" CURVE 0xa101a594 _REC_CUR_TKL_UW_VV__s2_s2 95.99853300000001 _CNV_R_R_Def_rk_sw__697_CM -1600. 1599.9511
 /begin AXIS_DESCR STD_AXIS Nkw _CNV_R_R_Def_n_sw_q_612_CM 10 -32768. 32767. FORMAT "%5.0" /end AXIS_DESCR
/end CHARACTERISTIC
/begin CHARACTERISTIC KL_RKMINDOE_S "" CURVE 0xa101a568 _REC_CUR_TKL_UW_VV__s2_s2 95.99853300000001 _CNV_R_R_Def_rk_sw__697_CM -1600. 1599.9511
 /begin AXIS_DESCR STD_AXIS Nkw _CNV_R_R_Def_n_sw_q_612_CM 10 -32768. 32767. FORMAT "%5.0" /end AXIS_DESCR
/end CHARACTERISTIC
/begin CHARACTERISTIC KL_RKUKG_MSLAM "" CURVE 0xa1019b24 _REC_CUR_TKL_UW_VV__u2_s2 1.9999 _CNV_R_R_Def_f_uw_b_579_CM 0. 1.9999 FORMAT "%14.5"
 /begin AXIS_DESCR STD_AXIS Tmot _CNV_R_R_Def_t_sw_q_620_CM 6 -327.68 327.67 FORMAT "%5.2" /end AXIS_DESCR
/end CHARACTERISTIC
/begin CHARACTERISTIC KL_RKVLO_HS "" CURVE 0xa101a4e4 _REC_CUR_TKL_UW_VV__s2_s2 95.99853300000001 _CNV_R_R_Def_rk_sw__697_CM -1600. 1599.9511
 /begin AXIS_DESCR STD_AXIS Nkw _CNV_R_R_Def_n_sw_q_612_CM 10 -32768. 32767. FORMAT "%5.0" /end AXIS_DESCR
/end CHARACTERISTIC
/begin CHARACTERISTIC KL_RKVLO_S "" CURVE 0xa101a4b8 _REC_CUR_TKL_UW_VV__s2_s2 95.99853300000001 _CNV_R_R_Def_rk_sw__697_CM -1600. 1599.9511
 /begin AXIS_DESCR STD_AXIS Nkw _CNV_R_R_Def_n_sw_q_612_CM 10 -32768. 32767. FORMAT "%5.0" /end AXIS_DESCR
/end CHARACTERISTIC
/begin CHARACTERISTIC KL_RKVLU_HS "" CURVE 0xa101a53c _REC_CUR_TKL_UW_VV__s2_s2 95.99853300000001 _CNV_R_R_Def_rk_sw__697_CM -1600. 1599.9511
 /begin AXIS_DESCR STD_AXIS Nkw _CNV_R_R_Def_n_sw_q_612_CM 10 -32768. 32767. FORMAT "%5.0" /end AXIS_DESCR
/end CHARACTERISTIC
/begin CHARACTERISTIC KL_RKVLU_S "" CURVE 0xa101a510 _REC_CUR_TKL_UW_VV__s2_s2 95.99853300000001 _CNV_R_R_Def_rk_sw__697_CM -1600. 1599.9511
 /begin AXIS_DESCR STD_AXIS Nkw _CNV_R_R_Def_n_sw_q_612_CM 10 -32768. 32767. FORMAT "%5.0" /end AXIS_DESCR
/end CHARACTERISTIC
/begin CHARACTERISTIC KL_TANSIG "Approximation tansig-Funktion" CURVE 0xa100ad3c _REC_CUR_TKL_UW_VV__S4_S4 0. _CNV_R_R_Def_dez_sl_575_CM -1000000000000. 0. FORMAT "%14.7"
 /begin AXIS_DESCR STD_AXIS NO_INPUT_QUANTITY _CNV_R_R_Def_dez_sl_575_CM 10 -1000000000000. 0. FORMAT "%14.7" /end AXIS_DESCR
/end CHARACTERISTIC
/begin CHARACTERISTIC KL_TDRFSOLL_MSLAM "Verzögerungszeit Drf_soll für FG MSLAM" CURVE 0xa1019b08 _REC_CUR_TKL_UW_VV__u2_s2 98.30250000000001 _CNV_R_R_Def_td_uw__679_CM 0. 655.35 FORMAT "%5.2"
 /begin AXIS_DESCR STD_AXIS Tmot _CNV_R_R_Def_t_sw_q_620_CM 6 -327.68 327.67 FORMAT "%5.2" /end AXIS_DESCR
/end CHARACTERISTIC
/begin CHARACTERISTIC KL_TKKRLDAB "Zeitkonstante f. Aenderung Spätstellung" CURVE 0xa101cccc _REC_CUR_TKL_UW_VV__u1_s2 12.7 _CNV_R_R_Def_td_ub__749_CM 5.e-002 12.75 FORMAT "%5.2"
 /begin AXIS_DESCR STD_AXIS Nkw _CNV_R_R_Def_n_sw_q_612_CM 6 -32768. 32767. FORMAT "%5.0" /end AXIS_DESCR
/end CHARACTERISTIC
/begin CHARACTERISTIC KL_TKKRLDAUF "Zeitkonstante f. Aenderung Spätstellung" CURVE 0xa101cb6c _REC_CUR_TKL_UW_VV__u1_s2 12.7 _CNV_R_R_Def_td_ub__749_CM 5.e-002 12.75 FORMAT "%5.2"
 /begin AXIS_DESCR STD_AXIS Nkw _CNV_R_R_Def_n_sw_q_612_CM 6 -32768. 32767. FORMAT "%5.0" /end AXIS_DESCR
/end CHARACTERISTIC
/begin CHARACTERISTIC KL_TKTOENIV "Umstetzung Tk -> Oelnivau" CURVE 0xa100df50 _REC_CUR_TKL_UW_VV__u2_u2 131.07 _CNV_R_R_Def_td_ub__593_CM 0. 6553.5 FORMAT "%4.1"
 /begin AXIS_DESCR STD_AXIS Td_og_tk _CNV_R_R_Def_td_ub__593_CM 8 0. 6553.5 FORMAT "%4.1" /end AXIS_DESCR
/end CHARACTERISTIC
/begin CHARACTERISTIC KL_TLKRLDAB "Zeitkonstante f. Spätstellung aus Klopfregelung" CURVE 0xa101cc9c _REC_CUR_TKL_UW_VV__u1_s2 12.7 _CNV_R_R_Def_td_ub__749_CM 5.e-002 12.75 FORMAT "%5.2"
 /begin AXIS_DESCR STD_AXIS Nkw _CNV_R_R_Def_n_sw_q_612_CM 6 -32768. 32767. FORMAT "%5.0" /end AXIS_DESCR
/end CHARACTERISTIC
/begin CHARACTERISTIC KL_TLKRLDAUF "Zeitkonstante f. Spätstellung aus Klopfregelung" CURVE 0xa101cc6c _REC_CUR_TKL_UW_VV__u1_s2 12.7 _CNV_R_R_Def_td_ub__749_CM 5.e-002 12.75 FORMAT "%5.2"
 /begin AXIS_DESCR STD_AXIS Nkw _CNV_R_R_Def_n_sw_q_612_CM 6 -32768. 32767. FORMAT "%5.0" /end AXIS_DESCR
/end CHARACTERISTIC
/begin CHARACTERISTIC KL_TOGNKOR "" CURVE 0xa100df98 _REC_CUR_TKL_UW_VV__s1_s2 74.70699999999999 _CNV_R_R_Def_niv_ub_672_CM -37.5 37.207 FORMAT "%5.2"
 /begin AXIS_DESCR STD_AXIS Oz_nmotfm _CNV_R_R_Def_n_sw_q_612_CM 16 -32768. 32767. FORMAT "%5.0" /end AXIS_DESCR
/end CHARACTERISTIC
/begin CHARACTERISTIC KL_TVTOEL "" CURVE 0xa100df74 _REC_CUR_TKL_UW_VV__s2_u2 131.07 _CNV_R_R_Def_t_sw_q_618_CM -3276.8 3276.7 FORMAT "%4.1"
 /begin AXIS_DESCR STD_AXIS NO_INPUT_QUANTITY _CNV_R_R_Def_td_ub__593_CM 8 0. 6553.5 FORMAT "%4.1" /end AXIS_DESCR
/end CHARACTERISTIC
/begin CHARACTERISTIC K_CW_OZ "" VALUE 0xa100de80 _REC_VAL_20_u2 0. _CNV_R_R_Def_dez_sl_575_CM 0. 65535. FORMAT "%5.0" /end CHARACTERISTIC
/begin CHARACTERISTIC K_CW_OZ_2 "" VALUE 0xa100de54 _REC_VAL_20_u2 0. _CNV_R_R_Def_dez_sl_575_CM 0. 65535. FORMAT "%5.0" /end CHARACTERISTIC
/begin CHARACTERISTIC K_DELTADFFMX "Gradientenschwelle des Generator-Lastsignals für Leerlauf-Solldrehzahlanhebung" VALUE 0xa1017cd4 _REC_VAL_20_s1 99.45 _CNV_R_R_Def_f_sb_b_600_CM -64. 63.5 FORMAT "%5.2" /end CHARACTERISTIC
/begin CHARACTERISTIC K_DFFLIM "Schwelle für Generatorlast zum Rücksetzen der Leerlauf-Solldrehzahlanhebung" VALUE 0xa1017cd5 _REC_VAL_20_u1 99.60930000000001 _CNV_R_R_Def_f_ub_b_602_CM 0. 99.60930000000001 FORMAT "%5.2" /end CHARACTERISTIC
/begin CHARACTERISTIC K_DFFLLANH "Schwelle für Generatorlast zum Aktivieren der Leerlauf-Solldrehzahlanhebung" VALUE 0xa1017cd6 _REC_VAL_20_u1 99.60930000000001 _CNV_R_R_Def_f_ub_b_602_CM 0. 99.60930000000001 FORMAT "%5.2" /end CHARACTERISTIC
/begin CHARACTERISTIC K_DFFSCHZMX "Zählerschwelle für Aktivieren der Leerlauf-Solldrehzahlanhebung bei Generatorlastschw." VALUE 0xa1017cd7 _REC_VAL_20_u1 99.45 _CNV_R_R_Def_dez_sl_575_CM 0. 255. FORMAT "%3.0" /end CHARACTERISTIC
/begin CHARACTERISTIC K_DLASOLL_MAX "Maximale Lambdasolldifferenz Bank 1/2" VALUE 0xa101a2d0 _REC_VAL_20_s2 15.9997 _CNV_R_R_Def_f_sw_b_607_CM -8. 7.9997 FORMAT "%7.4" /end CHARACTERISTIC
/begin CHARACTERISTIC K_DMDKW_MX "Schwelle unter dem Rf_soll Filturung erlaubt wird" VALUE 0xa101a39a _REC_VAL_20_s2 131.07 _CNV_R_R_Def_m_sw_q_574_CM -3276.8 3276.7 FORMAT "%5.2" /end CHARACTERISTIC
/begin CHARACTERISTIC K_DOLNIV "Hysteresis Töns oelverb und oelverl" VALUE 0xa100deea _REC_VAL_20_u1 99.45 _CNV_R_R_Def_td_ub__680_CM 0. 127.5 /end CHARACTERISTIC
/begin CHARACTERISTIC K_DRFAGRMX "Maximal zulässige Differenz AGR Androsseln" VALUE 0xa101a396 _REC_VAL_20_s2 98.30250000000001 _CNV_R_R_Def_rf_sw__616_CM -327.68 327.67 FORMAT "%7.4" /end CHARACTERISTIC
/begin CHARACTERISTIC K_DRFSOLL_FILT "Umschalter Filtermethode Drf_soll" VALUE 0xa101a2cf _REC_VAL_20_u1 5. _CNV_R_R_Def_dez_sl_575_CM 0. 5. FORMAT "%3.0" /end CHARACTERISTIC
/begin CHARACTERISTIC K_DRFSPUELMN_MSLAM "" VALUE 0xa1019ac4 _REC_VAL_20_s2 98.30250000000001 _CNV_R_R_Def_rf_sw__616_CM -327.68 327.67 FORMAT "%7.4" /end CHARACTERISTIC
/begin CHARACTERISTIC K_DRFTEMX "Maximal zulässige Differenz TE Androsseln" VALUE 0xa101a398 _REC_VAL_20_s2 98.30250000000001 _CNV_R_R_Def_rf_sw__616_CM -327.68 327.67 FORMAT "%7.4" /end CHARACTERISTIC
/begin CHARACTERISTIC K_DZWKRLLMNS "Deltazündwinkel Klopfregelung LL min." VALUE 0xa101cadc _REC_VAL_20_s2 99.83843999999999 _CNV_R_R_Def_zw_sw__624_CM -64. 63.998 /end CHARACTERISTIC
/begin CHARACTERISTIC K_DZWKRLLMX "Deltazündwinkel Klopfregelung LL max." VALUE 0xa101cade _REC_VAL_20_s2 100.1 _CNV_R_R_Def_zw_sw__599_CM -50. 60. FORMAT "%4.1" /end CHARACTERISTIC
/begin CHARACTERISTIC K_DZWKRMN "Deltazündwinkel Klopfregelung min." VALUE 0xa101cada _REC_VAL_20_s2 100.1 _CNV_R_R_Def_zw_sw__599_CM -50. 60. FORMAT "%4.1" /end CHARACTERISTIC
/begin CHARACTERISTIC K_ETAMAX_SPLIT "" VALUE 0xa101a380 _REC_VAL_20_s2 99.99844999999999 _CNV_R_R_Def_eta_sw_617_CM -200. 199.9938 /end CHARACTERISTIC
/begin CHARACTERISTIC K_ETAZYLAUS_MSLAM "" VALUE 0xa1019ac6 _REC_VAL_20_s2 100. _CNV_R_R_Def_eta_sw_628_CM 0. 100. /end CHARACTERISTIC
/begin CHARACTERISTIC K_ETA_KH_S "Applikationswert Wirkungsgrad KH (schicht)" VALUE 0xa101a37e _REC_VAL_20_s2 99.99379999999999 _CNV_R_R_Def_eta_sw_617_CM 6.2e-003 199.9938 /end CHARACTERISTIC
/begin CHARACTERISTIC K_FDRFSOLL_FILT "Faktor für Drfsoll-Überhöhung" VALUE 0xa101a2d6 _REC_VAL_20_u2 7.9998 _CNV_R_R_Def_f_uw_b_631_CM 0. 7.9998 FORMAT "%7.4" /end CHARACTERISTIC
/begin CHARACTERISTIC K_FMSLAMON "Grenzwert für Faktor Vorsteuerung" VALUE 0xa1019ad0 _REC_VAL_20_u2 63.99900000000001 _CNV_R_R_Def_f_uw_b_580_CM 0. 63.999 FORMAT "%7.4" /end CHARACTERISTIC
/begin CHARACTERISTIC K_FRK2APP_H "" VALUE 0xa101a2e4 _REC_VAL_20_u2 1. _CNV_R_R_Def_f_uw_b_633_CM 0. 1. FORMAT "%7.4" /end CHARACTERISTIC
/begin CHARACTERISTIC K_GELIIEAPP "Applikationswert Generatorlastbegrenzung für Leerlaufsolldrehzahlberechnung" VALUE 0xa1017cd8 _REC_VAL_20_u1 31.875 _CNV_R_R_Def_i_ub_q_645_CM 0. 31.875 /end CHARACTERISTIC
/begin CHARACTERISTIC K_GELIIEZK "Zeitkonstante für Filterung Generatorlastsignal (Leerlaufsolldrehzahlberechnung)" VALUE 0xa1017cd9 _REC_VAL_20_u1 0.996 _CNV_R_R_Def_f_ub_b_573_CM 0. 0.996 /end CHARACTERISTIC
/begin CHARACTERISTIC K_GELISETAPP "Aoolikationswert Generatorlastbegrenzung für Leerlaufstabilisierung" VALUE 0xa1017cda _REC_VAL_20_u1 1. _CNV_R_R_Def_dez_sl_575_CM 0. 1. FORMAT "%3.0" /end CHARACTERISTIC
/begin CHARACTERISTIC K_GELIVMAX "Maximale Fahrzeuggeschwindigkeit für Generatorlastbegrenzung" VALUE 0xa1017cc4 _REC_VAL_20_u2 131.07 _CNV_R_R_Def_v_uw_q_724_CM 0. 6553.5 FORMAT "%5.2" /end CHARACTERISTIC
/begin CHARACTERISTIC K_KHHYS_S "" VALUE 0xa101a2ec _REC_VAL_20_s2 99.99844999999999 _CNV_R_R_Def_f_sw_b_597_CM -100. 99.9969 /end CHARACTERISTIC
/begin CHARACTERISTIC K_LAMDMAX "Maximales Lambda" VALUE 0xa101a390 _REC_VAL_20_u2 15.9997 _CNV_R_R_Def_f_uw_b_594_CM 0. 15.9997 FORMAT "%7.4" /end CHARACTERISTIC
/begin CHARACTERISTIC K_LAMIN_H "Lambadgrenze fett (homogen)" VALUE 0xa101a39c _REC_VAL_20_u2 15.9997 _CNV_R_R_Def_f_uw_b_594_CM 0. 15.9997 FORMAT "%7.4" /end CHARACTERISTIC
/begin CHARACTERISTIC K_LAMMNMSLAM "La_ist MIN Schwelle" VALUE 0xa1019ac8 _REC_VAL_20_u2 15.9997 _CNV_R_R_Def_f_uw_b_594_CM 0. 15.9997 FORMAT "%7.4" /end CHARACTERISTIC
/begin CHARACTERISTIC K_LAMMXMSLAM "La_ist MAX Schwelle" VALUE 0xa1019aca _REC_VAL_20_u2 15.9997 _CNV_R_R_Def_f_uw_b_594_CM 0. 15.9997 FORMAT "%7.4" /end CHARACTERISTIC
/begin CHARACTERISTIC K_LLWDNMAX "Obere Schwelle Drehzahlabweichung im Leerlauf für Erkennung Generatorlastschwankung" VALUE 0xa1017cb8 _REC_VAL_20_s2 0. _CNV_R_R_Def_n_sw_q_612_CM -32768. 32767. FORMAT "%5.0" /end CHARACTERISTIC
/begin CHARACTERISTIC K_LLWDNMIN "Untere Schwelle Drehzahlabweichung im Leerlauf für Erkennung Generatorlastschwankung" VALUE 0xa1017cba _REC_VAL_20_s2 0. _CNV_R_R_Def_n_sw_q_612_CM -32768. 32767. FORMAT "%5.0" /end CHARACTERISTIC
/begin CHARACTERISTIC K_MDIZWSCHW "Mdi-Schwelle" VALUE 0xa101a374 _REC_VAL_20_s2 131.07 _CNV_R_R_Def_m_sw_q_574_CM -3276.8 3276.7 FORMAT "%5.2" /end CHARACTERISTIC
/begin CHARACTERISTIC K_MDRESMN_FGRHYS "Hysterese min . Reservemoment bei aktivem FGR" VALUE 0xa1019d4a _REC_VAL_20_s2 131.07 _CNV_R_R_Def_m_sw_q_574_CM -3276.8 3276.7 FORMAT "%5.2" /end CHARACTERISTIC
/begin CHARACTERISTIC K_MDRESMN_HYS "Hysterese min . Reservemoment" VALUE 0xa1019d4e _REC_VAL_20_s2 131.07 _CNV_R_R_Def_m_sw_q_574_CM -3276.8 3276.7 FORMAT "%5.2" /end CHARACTERISTIC
/begin CHARACTERISTIC K_MDRES_MN "min . Reservemoment" VALUE 0xa1019d50 _REC_VAL_20_s2 131.07 _CNV_R_R_Def_m_sw_q_574_CM -3276.8 3276.7 FORMAT "%5.2" /end CHARACTERISTIC
/begin CHARACTERISTIC K_MDRES_MNFGR "min . Reservemoment bei aktivem FGR" VALUE 0xa1019d4c _REC_VAL_20_s2 131.07 _CNV_R_R_Def_m_sw_q_574_CM -3276.8 3276.7 FORMAT "%5.2" /end CHARACTERISTIC
/begin CHARACTERISTIC K_NACHFUELL12 "Nachfüll Erste Balken von Peistab" VALUE 0xa100deeb _REC_VAL_20_u1 99.45 _CNV_R_R_Def_dez_sl_575_CM 0. 255. FORMAT "%3.0" /end CHARACTERISTIC
/begin CHARACTERISTIC K_NACHFUELL25 "Nachfüll Zweite Balken von Peistab" VALUE 0xa100deec _REC_VAL_20_u1 99.45 _CNV_R_R_Def_dez_sl_575_CM 0. 255. FORMAT "%3.0" /end CHARACTERISTIC
/begin CHARACTERISTIC K_NACHFUELL38 "Nachfüll Dritte Balken von Peistab" VALUE 0xa100deed _REC_VAL_20_u1 99.45 _CNV_R_R_Def_dez_sl_575_CM 0. 255. FORMAT "%3.0" /end CHARACTERISTIC
/begin CHARACTERISTIC K_NACHFUELL53 "Nachfüll Vierte Balken von Peistab" VALUE 0xa100deee _REC_VAL_20_u1 99.45 _CNV_R_R_Def_dez_sl_575_CM 0. 255. FORMAT "%3.0" /end CHARACTERISTIC
/begin CHARACTERISTIC K_NACHFUELL69 "Nachfüll Fünfte Balken von Peistab" VALUE 0xa100deef _REC_VAL_20_u1 99.45 _CNV_R_R_Def_dez_sl_575_CM 0. 255. FORMAT "%3.0" /end CHARACTERISTIC
/begin CHARACTERISTIC K_NACHFUELL85 "Nachfüll Sechte Balken von Peistab" VALUE 0xa100def0 _REC_VAL_20_u1 99.45 _CNV_R_R_Def_dez_sl_575_CM 0. 255. FORMAT "%3.0" /end CHARACTERISTIC
/begin CHARACTERISTIC K_NACHFUELL95 "Nachfüll Siebte Balken von Peistab" VALUE 0xa100def1 _REC_VAL_20_u1 99.45 _CNV_R_R_Def_dez_sl_575_CM 0. 255. FORMAT "%3.0" /end CHARACTERISTIC
/begin CHARACTERISTIC K_NMOTLLANH "Motordrehzahlschwelle für Rücksetzen der Leerlaufanhebung Generatorlast" VALUE 0xa1017cbc _REC_VAL_20_s2 0. _CNV_R_R_Def_n_sw_q_612_CM -32768. 32767. FORMAT "%5.0" /end CHARACTERISTIC
/begin CHARACTERISTIC K_NSTATLLANH "Schwelle Leerlaufsolldrehzahl zum Aktivieren der Leerlaufanhebung Generatorlast" VALUE 0xa1017cbe _REC_VAL_20_s2 0. _CNV_R_R_Def_n_sw_q_612_CM -32768. 32767. FORMAT "%5.0" /end CHARACTERISTIC
/begin CHARACTERISTIC K_OZABSTELL "Mindestwert für die Übernahme der Abstellzeit" VALUE 0xa100debe _REC_VAL_20_u2 0. _CNV_R_R_Def_tn_uw__671_CM 0. 65535. FORMAT "%5.2" /end CHARACTERISTIC
/begin CHARACTERISTIC K_OZALTANZABZ "Abstellzeit für die Ausgabe der letzten Anzeige nach dem Ölcheck" VALUE 0xa100dec0 _REC_VAL_20_u2 0. _CNV_R_R_Def_tn_uw__671_CM 0. 65535. FORMAT "%5.2" /end CHARACTERISTIC
/begin CHARACTERISTIC K_OZANFANZ "BOS-Startanzeigewert Restlaufstrecke" VALUE 0xa100e138 _REC_VAL_20_u2 0. _CNV_R_R_Def_km_sw__64_CM 0. 655350. FORMAT "%5.0" /end CHARACTERISTIC
/begin CHARACTERISTIC K_OZBESCHAUS "Zahl Ausgeblendet bei Lengsbescheunigung" VALUE 0xa100def2 _REC_VAL_20_u1 99.45 _CNV_R_R_Def_dez_sl_575_CM 0. 255. FORMAT "%3.0" /end CHARACTERISTIC
/begin CHARACTERISTIC K_OZBZKMSTK1 "Bezugsintervall" VALUE 0xa100de5a _REC_VAL_20_u1 0. _CNV_R_R_Def_km_ub__443_CM 0. 255000. FORMAT "%3.0" /end CHARACTERISTIC
/begin CHARACTERISTIC K_OZDAEMPF "" VALUE 0xa100e14a _REC_VAL_20_u1 0.249 _CNV_R_R_Def_f_ub_b_763_CM 0. 0.249 FORMAT "%7.4" /end CHARACTERISTIC
/begin CHARACTERISTIC K_OZKEINLUFT "1 = Luftausblendung deaktiviert" VALUE 0xa100def3 _REC_VAL_20_u1 99.45 _CNV_R_R_Def_dez_sl_575_CM 0. 255. FORMAT "%3.0" /end CHARACTERISTIC
/begin CHARACTERISTIC K_OZKMMAXK11 "Maximalintervall" VALUE 0xa100e13a _REC_VAL_20_u2 0. _CNV_R_R_Def_km_sw__64_CM 0. 655350. FORMAT "%5.0" /end CHARACTERISTIC
/begin CHARACTERISTIC K_OZKMUPL "" VALUE 0xa100de58 _REC_VAL_20_u2 0. _CNV_R_R_Def_km_sw__64_CM 0. 655350. FORMAT "%5.0" /end CHARACTERISTIC
/begin CHARACTERISTIC K_OZKVB96 "Typprüfkraftstoffverbrauch" VALUE 0xa100e14b _REC_VAL_20_u1 31.875 _CNV_R_R_Def_f_ub_b_695_CM 0. 31.875 FORMAT "%5.2" /end CHARACTERISTIC
/begin CHARACTERISTIC K_OZKVB96A "Typprüfkraftstoffverbrauch Automatikgetriebe" VALUE 0xa100e14c _REC_VAL_20_u1 31.875 _CNV_R_R_Def_f_ub_b_695_CM 0. 31.875 FORMAT "%5.2" /end CHARACTERISTIC
/begin CHARACTERISTIC K_OZKVBMXK18 "maximal zulässige Gesamtkraftstoffbonusmenge" VALUE 0xa100e13c _REC_VAL_20_u2 0. _CNV_R_R_Def_dez_sl_575_CM 0. 65535. FORMAT "%5.0" /end CHARACTERISTIC
/begin CHARACTERISTIC K_OZKVBOK16 "Kraftstoffbonusmenge in [l] je 0,5l Ölnachfüllung" VALUE 0xa100e13e _REC_VAL_20_u2 0. _CNV_R_R_Def_dez_sl_575_CM 0. 65535. FORMAT "%5.0" /end CHARACTERISTIC
/begin CHARACTERISTIC K_OZLBESCHN "Negative Längsbeschleunigung Ausblendung-Schwelle " VALUE 0xa100dede _REC_VAL_20_s1 63.75 _CNV_R_R_Def_ac_sb__572_CM -32. 31.75 FORMAT "%4.1" /end CHARACTERISTIC
/begin CHARACTERISTIC K_OZLBESCHORI "Längsbeschleunigung Ausblendung-Schwelle beim OriMw" VALUE 0xa100dedf _REC_VAL_20_s1 63.75 _CNV_R_R_Def_ac_sb__572_CM -32. 31.75 FORMAT "%4.1" /end CHARACTERISTIC
/begin CHARACTERISTIC K_OZLBESCHP "Positive Längsbeschleunigung Ausblendung-Schwelle " VALUE 0xa100dee0 _REC_VAL_20_s1 63.75 _CNV_R_R_Def_ac_sb__572_CM -32. 31.75 FORMAT "%4.1" /end CHARACTERISTIC
/begin CHARACTERISTIC K_OZLBESCHST "Längsbeschleunigung Ausblendung-Schwelle im Stand" VALUE 0xa100dee1 _REC_VAL_20_s1 63.75 _CNV_R_R_Def_ac_sb__572_CM -32. 31.75 FORMAT "%4.1" /end CHARACTERISTIC
/begin CHARACTERISTIC K_OZLF1 "Länderfaktor 1 Festwert" VALUE 0xa100e14d _REC_VAL_20_u1 2.55 _CNV_R_R_Def_lf_ub__675_CM 0. 2.55 FORMAT "%5.2" /end CHARACTERISTIC
/begin CHARACTERISTIC K_OZLF2 "Länderfaktor 2 Festwert" VALUE 0xa100e14e _REC_VAL_20_u1 2.55 _CNV_R_R_Def_lf_ub__675_CM 0. 2.55 FORMAT "%5.2" /end CHARACTERISTIC
/begin CHARACTERISTIC K_OZLUFTMAX "Plausibel max luftsprung" VALUE 0xa100dec2 _REC_VAL_20_u2 102.398436 _CNV_R_R_Def_p_sw_q_578_CM 0. 2559.9609 /end CHARACTERISTIC
/begin CHARACTERISTIC K_OZMAXSLOPE "Maximale erlaubte Steigung" VALUE 0xa100de96 _REC_VAL_20_s2 99.83843999999999 _CNV_R_R_Def_f_sw_b_634_CM -64. 63.998 /end CHARACTERISTIC
/begin CHARACTERISTIC K_OZMINSLOPE "Kleinste erlaubte Steigung (<0)" VALUE 0xa100de98 _REC_VAL_20_s2 99.83843999999999 _CNV_R_R_Def_f_sw_b_634_CM -64. 63.998 /end CHARACTERISTIC
/begin CHARACTERISTIC K_OZMNKMBO "Wegstrecke ab der eine Bonuszuteilung erfolgt" VALUE 0xa100e140 _REC_VAL_20_u2 0. _CNV_R_R_Def_km_sw__64_CM 0. 655350. FORMAT "%5.0" /end CHARACTERISTIC
/begin CHARACTERISTIC K_OZMWK "Anzahl der Messwerte für Kurzzeit-Mittelwert Niveau" VALUE 0xa100def4 _REC_VAL_20_u1 99.45 _CNV_R_R_Def_dez_sl_575_CM 0. 255. FORMAT "%3.0" /end CHARACTERISTIC
/begin CHARACTERISTIC K_OZMWL "Anzahl der Messwerte für Langzeit-Mittelwert Niveau" VALUE 0xa100dec4 _REC_VAL_20_u2 0. _CNV_R_R_Def_dez_sl_575_CM 0. 65535. FORMAT "%5.0" /end CHARACTERISTIC
/begin CHARACTERISTIC K_OZMWOR "Anzahl der Messwerte für Orientierungsmessung" VALUE 0xa100dec6 _REC_VAL_20_u2 0. _CNV_R_R_Def_dez_sl_575_CM 0. 65535. FORMAT "%5.0" /end CHARACTERISTIC
/begin CHARACTERISTIC K_OZMWV "Anzahl der Messwerte für vorgezogenen Mittelwert Niveau" VALUE 0xa100dec8 _REC_VAL_20_u2 0. _CNV_R_R_Def_dez_sl_575_CM 0. 65535. FORMAT "%5.0" /end CHARACTERISTIC
/begin CHARACTERISTIC K_OZMXOHK15 "Max Tage für den Ölservice" VALUE 0xa100e142 _REC_VAL_20_u2 0. _CNV_R_R_Def_dez_sl_575_CM 0. 65535. FORMAT "%5.0" /end CHARACTERISTIC
/begin CHARACTERISTIC K_OZNFCNT "Anzahl Werte für Nachfüllerkennung" VALUE 0xa100de92 _REC_VAL_20_u4 0. _CNV_R_R_Def_dez_sl_575_CM 0. 4294967295. FORMAT "%7.0" /end CHARACTERISTIC
/begin CHARACTERISTIC K_OZNFERR "Nachfüllmengenanzeige bei PreCheck OK" VALUE 0xa100def5 _REC_VAL_20_u1 99.45 _CNV_R_R_Def_dez_sl_575_CM 0. 255. FORMAT "%3.0" /end CHARACTERISTIC
/begin CHARACTERISTIC K_OZNFML "Nachfüllmengenanzeige bei " VALUE 0xa100def6 _REC_VAL_20_u1 99.45 _CNV_R_R_Def_dez_sl_575_CM 0. 255. FORMAT "%3.0" /end CHARACTERISTIC
/begin CHARACTERISTIC K_OZNFOELCKO "Nachfüllmengenanzeige bei PreCheck KO" VALUE 0xa100def7 _REC_VAL_20_u1 99.45 _CNV_R_R_Def_dez_sl_575_CM 0. 255. FORMAT "%3.0" /end CHARACTERISTIC
/begin CHARACTERISTIC K_OZNFOELCOK "Nachfüllmengenanzeige bei PreCheck OK" VALUE 0xa100def8 _REC_VAL_20_u1 99.45 _CNV_R_R_Def_dez_sl_575_CM 0. 255. FORMAT "%3.0" /end CHARACTERISTIC
/begin CHARACTERISTIC K_OZNFTMPMAX "obere Temperaturgrenze für Nachfüllerkennung" VALUE 0xa100de9a _REC_VAL_20_s2 131.07 _CNV_R_R_Def_t_sw_q_618_CM -3276.8 3276.7 FORMAT "%4.1" /end CHARACTERISTIC
/begin CHARACTERISTIC K_OZNFTMPMIN "untere Temperaturgrenze für Nachfüllerkennung" VALUE 0xa100de9c _REC_VAL_20_s2 131.07 _CNV_R_R_Def_t_sw_q_618_CM -3276.8 3276.7 FORMAT "%4.1" /end CHARACTERISTIC
/begin CHARACTERISTIC K_OZNIVKL "" VALUE 0xa100de62 _REC_VAL_20_u1 74.70699999999999 _CNV_R_R_Def_niv_ub_672_CM 0. 74.70699999999999 FORMAT "%5.2" /end CHARACTERISTIC
/begin CHARACTERISTIC K_OZNIVMMLIT "Umrechnungsfaktor für Ölniveau von mm in Liter" VALUE 0xa100def9 _REC_VAL_20_u1 0.249 _CNV_R_R_Def_f_ub_b_763_CM 0. 0.249 FORMAT "%7.4" /end CHARACTERISTIC
/begin CHARACTERISTIC K_OZNIVNFM05 "Niveauschwelle für Erkennung 0,5 Liter nachgefüllt" VALUE 0xa100defa _REC_VAL_20_u1 7.9687 _CNV_R_R_Def_f_ub_b_739_CM 0. 7.9687 FORMAT "%5.2" /end CHARACTERISTIC
/begin CHARACTERISTIC K_OZNIVNFM10 "Niveauschwelle für Erkennung 1,0 Liter nachgefüllt" VALUE 0xa100defb _REC_VAL_20_u1 7.9687 _CNV_R_R_Def_f_ub_b_739_CM 0. 7.9687 FORMAT "%5.2" /end CHARACTERISTIC
/begin CHARACTERISTIC K_OZNMOTMAX "obere Drehzahlgrenze für drehzahlkorrigierten Niveaumittelwert" VALUE 0xa100de9e _REC_VAL_20_s2 0. _CNV_R_R_Def_n_sw_q_612_CM -32768. 32767. FORMAT "%5.0" /end CHARACTERISTIC
/begin CHARACTERISTIC K_OZNMOTMIN "untere Drehzahlgrenze für drehzahlkorrigierten Niveaumittelwert" VALUE 0xa100dea0 _REC_VAL_20_s2 0. _CNV_R_R_Def_n_sw_q_612_CM -32768. 32767. FORMAT "%5.0" /end CHARACTERISTIC
/begin CHARACTERISTIC K_OZOELCABZ "Minimale Abstellzeit für den ÖlCheck" VALUE 0xa100deca _REC_VAL_20_u2 0. _CNV_R_R_Def_tn_uw__671_CM 0. 65535. FORMAT "%5.2" /end CHARACTERISTIC
/begin CHARACTERISTIC K_OZOELCOK "PreDriveCheck-Schwelle" VALUE 0xa100defc _REC_VAL_20_u1 74.70699999999999 _CNV_R_R_Def_niv_ub_672_CM 0. 74.70699999999999 FORMAT "%5.2" /end CHARACTERISTIC
/begin CHARACTERISTIC K_OZOELCVERZ "Verzögerung für den Ölcheck" VALUE 0xa100defd _REC_VAL_20_u1 99.45 _CNV_R_R_Def_dez_sl_575_CM 0. 255. FORMAT "%3.0" /end CHARACTERISTIC
/begin CHARACTERISTIC K_OZOELKMPL "gefahrene Strecke nach Ölwechsel, ab wo Er-Auswertung erfolgt" VALUE 0xa100e124 _REC_VAL_20_u2 0. _CNV_R_R_Def_km_sw__64_CM 0. 655350. FORMAT "%5.0" /end CHARACTERISTIC
/begin CHARACTERISTIC K_OZOELMEN "Ölmenge für den Dieseleintrag" VALUE 0xa100e14f _REC_VAL_20_u1 25.5 _CNV_R_R_Def_niv_ub_677_CM 0. 25.5 FORMAT "%5.2" /end CHARACTERISTIC
/begin CHARACTERISTIC K_OZOELVERB "Ölverbrauch" VALUE 0xa100decc _REC_VAL_20_u2 0. _CNV_R_R_Def_dez_sl_575_CM 0. 65535. FORMAT "%5.0" /end CHARACTERISTIC
/begin CHARACTERISTIC K_OZORBERU "Toleranz für Orientierungsmessung nach unten in mm" VALUE 0xa100defe _REC_VAL_20_u1 74.70699999999999 _CNV_R_R_Def_niv_ub_672_CM 0. 74.70699999999999 FORMAT "%5.2" /end CHARACTERISTIC
/begin CHARACTERISTIC K_OZORIPEILTZO "Ausgabeniveau für die tote Zone Orientierung-Check Peilstab mit alter Anzeige >= Mitte" VALUE 0xa100deff _REC_VAL_20_u1 74.70699999999999 _CNV_R_R_Def_niv_ub_672_CM 0. 74.70699999999999 FORMAT "%5.2" /end CHARACTERISTIC
/begin CHARACTERISTIC K_OZORIPEILTZU "Ausgabeniveau für die tote Zone Orientierung-Check Peilstab mit alter Anzeige < Mitte" VALUE 0xa100df00 _REC_VAL_20_u1 74.70699999999999 _CNV_R_R_Def_niv_ub_672_CM 0. 74.70699999999999 FORMAT "%5.2" /end CHARACTERISTIC
/begin CHARACTERISTIC K_OZPEIL12 "Erste Balken von Peistab" VALUE 0xa100df01 _REC_VAL_20_u1 74.70699999999999 _CNV_R_R_Def_niv_ub_672_CM 0. 74.70699999999999 FORMAT "%5.2" /end CHARACTERISTIC
/begin CHARACTERISTIC K_OZPEIL25 "Zweite Balken von Peistab" VALUE 0xa100df02 _REC_VAL_20_u1 74.70699999999999 _CNV_R_R_Def_niv_ub_672_CM 0. 74.70699999999999 FORMAT "%5.2" /end CHARACTERISTIC
/begin CHARACTERISTIC K_OZPEIL38 "Dritte Balken von Peistab" VALUE 0xa100df03 _REC_VAL_20_u1 74.70699999999999 _CNV_R_R_Def_niv_ub_672_CM 0. 74.70699999999999 FORMAT "%5.2" /end CHARACTERISTIC
/begin CHARACTERISTIC K_OZPEIL53 "Vierte Balken von Peistab" VALUE 0xa100df04 _REC_VAL_20_u1 74.70699999999999 _CNV_R_R_Def_niv_ub_672_CM 0. 74.70699999999999 FORMAT "%5.2" /end CHARACTERISTIC
/begin CHARACTERISTIC K_OZPEIL69 "Fünfte Balken von Peistab" VALUE 0xa100df05 _REC_VAL_20_u1 74.70699999999999 _CNV_R_R_Def_niv_ub_672_CM 0. 74.70699999999999 FORMAT "%5.2" /end CHARACTERISTIC
/begin CHARACTERISTIC K_OZPEIL85 "Sechte Balken von Peistab" VALUE 0xa100df06 _REC_VAL_20_u1 74.70699999999999 _CNV_R_R_Def_niv_ub_672_CM 0. 74.70699999999999 FORMAT "%5.2" /end CHARACTERISTIC
/begin CHARACTERISTIC K_OZPEILDO "Delta + Hysterese Peilstab" VALUE 0xa100df07 _REC_VAL_20_u1 74.70699999999999 _CNV_R_R_Def_niv_ub_672_CM 0. 74.70699999999999 FORMAT "%5.2" /end CHARACTERISTIC
/begin CHARACTERISTIC K_OZPEILDOMIN "Delta + Hysterese Peilstab bei Min" VALUE 0xa100df08 _REC_VAL_20_u1 74.70699999999999 _CNV_R_R_Def_niv_ub_672_CM 0. 74.70699999999999 FORMAT "%5.2" /end CHARACTERISTIC
/begin CHARACTERISTIC K_OZPEILDU "Delta - Hysterese Peilstab" VALUE 0xa100df09 _REC_VAL_20_u1 74.70699999999999 _CNV_R_R_Def_niv_ub_672_CM 0. 74.70699999999999 FORMAT "%5.2" /end CHARACTERISTIC
/begin CHARACTERISTIC K_OZPEILDU38 "Delta - Hysterese Peilstab bei 1/4" VALUE 0xa100df0a _REC_VAL_20_u1 74.70699999999999 _CNV_R_R_Def_niv_ub_672_CM 0. 74.70699999999999 FORMAT "%5.2" /end CHARACTERISTIC
/begin CHARACTERISTIC K_OZPEILERR "Balkenanzeige im Fehlerfall" VALUE 0xa100df0b _REC_VAL_20_u1 99.45 _CNV_R_R_Def_dez_sl_575_CM 0. 255. FORMAT "%3.0" /end CHARACTERISTIC
/begin CHARACTERISTIC K_OZPEILKSPR "Max zulässiger Niveau-Unterschied zwischen alten Anzeige und VorMw" VALUE 0xa100df0c _REC_VAL_20_u1 74.70699999999999 _CNV_R_R_Def_niv_ub_672_CM 0. 74.70699999999999 FORMAT "%5.2" /end CHARACTERISTIC
/begin CHARACTERISTIC K_OZPEILLP85 "Bankenanzeige für Niveau bei 85%" VALUE 0xa100df0d _REC_VAL_20_u1 99.45 _CNV_R_R_Def_dez_sl_575_CM 0. 255. FORMAT "%3.0" /end CHARACTERISTIC
/begin CHARACTERISTIC K_OZPEILML "Balkenanzeige bei Messung läuft" VALUE 0xa100df0e _REC_VAL_20_u1 99.45 _CNV_R_R_Def_dez_sl_575_CM 0. 255. FORMAT "%3.0" /end CHARACTERISTIC
/begin CHARACTERISTIC K_OZPEILOELCKO "Balkenanzeige bei ÖlCheck KO" VALUE 0xa100df0f _REC_VAL_20_u1 99.45 _CNV_R_R_Def_dez_sl_575_CM 0. 255. FORMAT "%3.0" /end CHARACTERISTIC
/begin CHARACTERISTIC K_OZPEILOELCOK "Balkenanzeige bei ÖlCheck OK" VALUE 0xa100df10 _REC_VAL_20_u1 99.45 _CNV_R_R_Def_dez_sl_575_CM 0. 255. FORMAT "%3.0" /end CHARACTERISTIC
/begin CHARACTERISTIC K_OZPEILSPRUNG "Max zulässiger Niveau-Unterschied zwischen LangMw" VALUE 0xa100df11 _REC_VAL_20_u1 74.70699999999999 _CNV_R_R_Def_niv_ub_672_CM 0. 74.70699999999999 FORMAT "%5.2" /end CHARACTERISTIC
/begin CHARACTERISTIC K_OZPERBOK17 "Er-Bonusbetrag je 0,5l Ölnachfüllung" VALUE 0xa100e144 _REC_VAL_20_u2 5.9999 _CNV_R_R_Def_perm_u_676_CM 0. 5.9999 FORMAT "%14.5" /end CHARACTERISTIC
/begin CHARACTERISTIC K_OZPERBRK14 "Begrenzungsfaktor für Restweg aus der Permittivität" VALUE 0xa100e150 _REC_VAL_20_u1 5.9765 _CNV_R_R_Def_kw_sw__622_CM 0. 5.9765 /end CHARACTERISTIC
/begin CHARACTERISTIC K_OZPERMCOK5 "minimale Anzahl der Messwerte für einen gültigen Permittivitätswert" VALUE 0xa100e126 _REC_VAL_20_u2 0. _CNV_R_R_Def_dez_sl_575_CM 0. 65535. FORMAT "%5.0" /end CHARACTERISTIC
/begin CHARACTERISTIC K_OZPERMMIN "minimaler Permittivitätswert für gültige Auswertung" VALUE 0xa100e128 _REC_VAL_20_u2 5.9999 _CNV_R_R_Def_perm_u_676_CM 0. 5.9999 FORMAT "%14.5" /end CHARACTERISTIC
/begin CHARACTERISTIC K_OZPERMMNIV "Niveauschwelle für gültige Permittivitätsauswertung" VALUE 0xa100e132 _REC_VAL_20_u1 74.70699999999999 _CNV_R_R_Def_niv_ub_672_CM 0. 74.70699999999999 FORMAT "%5.2" /end CHARACTERISTIC
/begin CHARACTERISTIC K_OZPERMNK3 "Drehzahlschwelle für Er-Ausblendung" VALUE 0xa100e11c _REC_VAL_20_s2 0. _CNV_R_R_Def_n_sw_q_612_CM -32768. 32767. FORMAT "%5.0" /end CHARACTERISTIC
/begin CHARACTERISTIC K_OZPERMRMIN "Grenze für Niveauberechnung aus Permittivität" VALUE 0xa100de5c _REC_VAL_20_u2 0. _CNV_R_R_Def_dez_sl_575_CM 0. 65535. FORMAT "%5.0" /end CHARACTERISTIC
/begin CHARACTERISTIC K_OZPERMTIK6 "Mittelungszeitraum Permittivität" VALUE 0xa100e12a _REC_VAL_20_u2 0. _CNV_R_R_Def_td_uw__682_CM 0. 65535. FORMAT "%5.0" /end CHARACTERISTIC
/begin CHARACTERISTIC K_OZPERMTIK8 "Ausheizzeit" VALUE 0xa100e12c _REC_VAL_20_u2 0. _CNV_R_R_Def_td_uw__682_CM 0. 65535. FORMAT "%5.0" /end CHARACTERISTIC
/begin CHARACTERISTIC K_OZPERMTIK9 "maximale Zeit nach B_ozpermpl = true, Neustart und oztempf < OZPERMTI in der eine gültige Messung erfolgen kann (Kaltzeitschwelle)" VALUE 0xa100e12e _REC_VAL_20_u2 0. _CNV_R_R_Def_td_uw__682_CM 0. 65535. FORMAT "%5.0" /end CHARACTERISTIC
/begin CHARACTERISTIC K_OZPERMTK12 "Untere Temperaturgrenze Messfenster Permittivität" VALUE 0xa100e11e _REC_VAL_20_s2 131.07 _CNV_R_R_Def_t_sw_q_618_CM -3276.8 3276.7 FORMAT "%4.1" /end CHARACTERISTIC
/begin CHARACTERISTIC K_OZPERMTK13 "Obere Temperaturgrenze Messfenster Permittivität" VALUE 0xa100e120 _REC_VAL_20_s2 131.07 _CNV_R_R_Def_t_sw_q_618_CM -3276.8 3276.7 FORMAT "%4.1" /end CHARACTERISTIC
/begin CHARACTERISTIC K_OZPERMTK4 "Abklingzeit Drehzahlschwelle" VALUE 0xa100e130 _REC_VAL_20_u2 0. _CNV_R_R_Def_td_uw__682_CM 0. 65535. FORMAT "%5.0" /end CHARACTERISTIC
/begin CHARACTERISTIC K_OZPERMTK7 "Ausheiztemperatur" VALUE 0xa100e122 _REC_VAL_20_s2 131.07 _CNV_R_R_Def_t_sw_q_618_CM -3276.8 3276.7 FORMAT "%4.1" /end CHARACTERISTIC
/begin CHARACTERISTIC K_OZPERXK10 "zulässige Permittivitätsänderung im Ölwechselintervall" VALUE 0xa100e146 _REC_VAL_20_u2 5.9999 _CNV_R_R_Def_perm_u_676_CM 0. 5.9999 FORMAT "%14.5" /end CHARACTERISTIC
/begin CHARACTERISTIC K_OZPRREFMAX "Maximum für Referenzpermittivität" VALUE 0xa100de5e _REC_VAL_20_u2 102.4 _CNV_R_R_Def_dez_sl_575_CM 0. 1024. FORMAT "%5.0" /end CHARACTERISTIC
/begin CHARACTERISTIC K_OZPRREFMIN "Minimum für Referenzpermittivität" VALUE 0xa100de60 _REC_VAL_20_u2 102.4 _CNV_R_R_Def_dez_sl_575_CM 0. 1024. FORMAT "%5.0" /end CHARACTERISTIC
/begin CHARACTERISTIC K_OZQBESCHN "Negative Querbeschleunigung Ausblendung-Schwelle " VALUE 0xa100dee2 _REC_VAL_20_s1 63.75 _CNV_R_R_Def_ac_sb__572_CM -32. 31.75 FORMAT "%4.1" /end CHARACTERISTIC
/begin CHARACTERISTIC K_OZQBESCHORI "Querbeschleunigung Ausblendung-Schwelle Beim OriMw" VALUE 0xa100dee3 _REC_VAL_20_s1 63.75 _CNV_R_R_Def_ac_sb__572_CM -32. 31.75 FORMAT "%4.1" /end CHARACTERISTIC
/begin CHARACTERISTIC K_OZQBESCHP "Positive Querbeschleunigung Ausblendung-Schwelle " VALUE 0xa100dee4 _REC_VAL_20_s1 63.75 _CNV_R_R_Def_ac_sb__572_CM -32. 31.75 FORMAT "%4.1" /end CHARACTERISTIC
/begin CHARACTERISTIC K_OZQBESCHST "Querbeschleunigung Ausblendung-Schwelle im Stand" VALUE 0xa100dee5 _REC_VAL_20_s1 63.75 _CNV_R_R_Def_ac_sb__572_CM -32. 31.75 FORMAT "%4.1" /end CHARACTERISTIC
/begin CHARACTERISTIC K_OZRESBOST "Delay für die Rücksetzung der Tester-Bos-Anforderung" VALUE 0xa100de63 _REC_VAL_20_u1 99.45 _CNV_R_R_Def_dez_sl_575_CM 0. 255. FORMAT "%3.0" /end CHARACTERISTIC
/begin CHARACTERISTIC K_OZSTANDVERZ "Verzögerung für Fahrzeug steht" VALUE 0xa100df12 _REC_VAL_20_u1 99.45 _CNV_R_R_Def_dez_sl_575_CM 0. 255. FORMAT "%3.0" /end CHARACTERISTIC
/begin CHARACTERISTIC K_OZSTARTABZ "Mindestlaufzeit für die Übernahme der Abstellzeit" VALUE 0xa100dece _REC_VAL_20_u2 98.30250000000001 _CNV_R_R_Def_td_uw__679_CM 0. 655.35 FORMAT "%5.2" /end CHARACTERISTIC
/begin CHARACTERISTIC K_OZSTARTVERZ "QLT Start Verzögerung nach Drehzal" VALUE 0xa100df13 _REC_VAL_20_u1 99.45 _CNV_R_R_Def_dez_sl_575_CM 0. 255. FORMAT "%3.0" /end CHARACTERISTIC
/begin CHARACTERISTIC K_OZSTMINW "Minimale Strecke für die Steigungserkennung" VALUE 0xa100ded0 _REC_VAL_20_u2 9.999800000000001 _CNV_R_R_Def_f_uw_b_629_CM 0. 9.999800000000001 FORMAT "%7.4" /end CHARACTERISTIC
/begin CHARACTERISTIC K_OZSTZYK "" VALUE 0xa100de64 _REC_VAL_20_u1 99.45 _CNV_R_R_Def_dez_sl_575_CM 0. 255. FORMAT "%3.0" /end CHARACTERISTIC
/begin CHARACTERISTIC K_OZTAGCTERR "Wert für unplausibel Tagezähler" VALUE 0xa100e148 _REC_VAL_20_u2 0. _CNV_R_R_Def_dez_sl_575_CM 0. 65535. FORMAT "%5.0" /end CHARACTERISTIC
/begin CHARACTERISTIC K_OZTEMPBW "Temperaturschwelle Öltemperatur Motor betriebswarm" VALUE 0xa100dea2 _REC_VAL_20_s2 131.07 _CNV_R_R_Def_t_sw_q_618_CM -3276.8 3276.7 FORMAT "%4.1" /end CHARACTERISTIC
/begin CHARACTERISTIC K_OZTLPF "Faktor für den LowPass-Filter Öltemperatur" VALUE 0xa100e16c _REC_VAL_20_u2 99.9984 _CNV_R_R_Def_f_uw_b_576_CM 0. 99.9984 /end CHARACTERISTIC
/begin CHARACTERISTIC K_OZTLPFMDL "Faktor für den LowPass-Filter Öltemperatur beim Modelltemperatur" VALUE 0xa100e16e _REC_VAL_20_u2 99.9984 _CNV_R_R_Def_f_uw_b_576_CM 0. 99.9984 /end CHARACTERISTIC
/begin CHARACTERISTIC K_OZTORMAX "Temperaturschwelle für Orientierungsmessung" VALUE 0xa100dea4 _REC_VAL_20_s2 131.07 _CNV_R_R_Def_t_sw_q_618_CM -3276.8 3276.7 FORMAT "%4.1" /end CHARACTERISTIC
/begin CHARACTERISTIC K_OZTORMIN "Mindest Temperatur für OrientierungMw QLT" VALUE 0xa100dea6 _REC_VAL_20_s2 98.30250000000001 _CNV_R_R_Def_t_sw_q_620_CM -327.68 327.67 FORMAT "%5.2" /end CHARACTERISTIC
/begin CHARACTERISTIC K_OZUEBERF "Schwelle für die Überfüllung" VALUE 0xa100df14 _REC_VAL_20_u1 74.70699999999999 _CNV_R_R_Def_niv_ub_672_CM 0. 74.70699999999999 FORMAT "%5.2" /end CHARACTERISTIC
/begin CHARACTERISTIC K_OZUEBERTEMP "Schwelle für die Ölsübertemperatur-Kontrolle" VALUE 0xa100e136 _REC_VAL_20_s2 131.07 _CNV_R_R_Def_t_sw_q_618_CM -3276.8 3276.7 FORMAT "%4.1" /end CHARACTERISTIC
/begin CHARACTERISTIC K_OZUEFCNT "Anzahl Werte für Überfüllung" VALUE 0xa100df15 _REC_VAL_20_u1 99.45 _CNV_R_R_Def_dez_sl_575_CM 0. 255. FORMAT "%3.0" /end CHARACTERISTIC
/begin CHARACTERISTIC K_OZUEFNLB "Negative Längsbeschleunigungsgrenze für die Überfüllung" VALUE 0xa100dee6 _REC_VAL_20_s1 63.75 _CNV_R_R_Def_ac_sb__572_CM -32. 31.75 FORMAT "%4.1" /end CHARACTERISTIC
/begin CHARACTERISTIC K_OZUEFNQB "Negative Querbeschleunigungsgrenze für die Überfüllung" VALUE 0xa100dee7 _REC_VAL_20_s1 63.75 _CNV_R_R_Def_ac_sb__572_CM -32. 31.75 FORMAT "%4.1" /end CHARACTERISTIC
/begin CHARACTERISTIC K_OZUEFNST "Maximale negative Steigung für die Überfüllungserkenung" VALUE 0xa100dea8 _REC_VAL_20_s2 99.83843999999999 _CNV_R_R_Def_f_sw_b_634_CM -64. 63.998 /end CHARACTERISTIC
/begin CHARACTERISTIC K_OZUEFODZ "Obere Drehzahlgrenze für die Überfüllungserkennung" VALUE 0xa100deaa _REC_VAL_20_s2 0. _CNV_R_R_Def_n_sw_q_612_CM -32768. 32767. FORMAT "%5.0" /end CHARACTERISTIC
/begin CHARACTERISTIC K_OZUEFPLB "Positive Längsbeschleunigungsgrenze für die Überfüllung" VALUE 0xa100dee8 _REC_VAL_20_s1 63.75 _CNV_R_R_Def_ac_sb__572_CM -32. 31.75 FORMAT "%4.1" /end CHARACTERISTIC
/begin CHARACTERISTIC K_OZUEFPQB "Positive Querbeschleunigungsgrenze für die Überfüllung" VALUE 0xa100dee9 _REC_VAL_20_s1 63.75 _CNV_R_R_Def_ac_sb__572_CM -32. 31.75 FORMAT "%4.1" /end CHARACTERISTIC
/begin CHARACTERISTIC K_OZUEFPST "Maximale positive Steigung für die Überfüllungserkenung" VALUE 0xa100deac _REC_VAL_20_s2 99.83843999999999 _CNV_R_R_Def_f_sw_b_634_CM -64. 63.998 /end CHARACTERISTIC
/begin CHARACTERISTIC K_OZUEFTEM "Mindestöltemperatur für die Überfüllungserkennung" VALUE 0xa100deae _REC_VAL_20_s2 131.07 _CNV_R_R_Def_t_sw_q_618_CM -3276.8 3276.7 FORMAT "%4.1" /end CHARACTERISTIC
/begin CHARACTERISTIC K_OZUEFUDZ "Untere Drehzahlgrenze für die Überfüllungserkennung" VALUE 0xa100deb0 _REC_VAL_20_s2 0. _CNV_R_R_Def_n_sw_q_612_CM -32768. 32767. FORMAT "%5.0" /end CHARACTERISTIC
/begin CHARACTERISTIC K_OZUEFVERZ "Verzögerung für erkennung Überfüllung" VALUE 0xa100df16 _REC_VAL_20_u1 99.45 _CNV_R_R_Def_dez_sl_575_CM 0. 255. FORMAT "%3.0" /end CHARACTERISTIC
/begin CHARACTERISTIC K_OZUTFAK "Faktor für den Kraftstoffverbrauch bei Übertemperatur" VALUE 0xa100e151 _REC_VAL_20_u1 99.45 _CNV_R_R_Def_dez_sl_575_CM 0. 255. FORMAT "%3.0" /end CHARACTERISTIC
/begin CHARACTERISTIC K_OZVERBDKM "Delta km für die Ölverbrauch-Berechnung" VALUE 0xa100ded2 _REC_VAL_20_u2 0. _CNV_R_R_Def_km_sw__64_CM 0. 655350. FORMAT "%5.0" /end CHARACTERISTIC
/begin CHARACTERISTIC K_OZVERBFAK "Faktor für die Anpassung des Ölverbrauches" VALUE 0xa100df17 _REC_VAL_20_u1 7.9687 _CNV_R_R_Def_f_ub_b_739_CM 0. 7.9687 FORMAT "%5.2" /end CHARACTERISTIC
/begin CHARACTERISTIC K_OZVERLORI "Schwelle für Orientierungswert Ölniveau (Verlustwarnung)" VALUE 0xa100de82 _REC_VAL_20_u1 74.70699999999999 _CNV_R_R_Def_niv_ub_672_CM 0. 74.70699999999999 FORMAT "%5.2" /end CHARACTERISTIC
/begin CHARACTERISTIC K_OZVERZERRBSD "Verzögerung für Peilstab-Fehlerfall beim BSD-Fehler" VALUE 0xa100df18 _REC_VAL_20_u1 99.45 _CNV_R_R_Def_dez_sl_575_CM 0. 255. FORMAT "%3.0" /end CHARACTERISTIC
/begin CHARACTERISTIC K_OZVORMV "Korrektur von Vormw für Peilstab" VALUE 0xa100deb2 _REC_VAL_20_s2 63.999 _CNV_R_R_Def_f_sw_b_577_CM -32. 31.999 FORMAT "%7.4" /end CHARACTERISTIC
/begin CHARACTERISTIC K_OZVORPEILMIN "Niveau Ausgabe (für die Peilstabanzeige) bei VorMw auf min und LangMw über 1/4" VALUE 0xa100df19 _REC_VAL_20_u1 74.70699999999999 _CNV_R_R_Def_niv_ub_672_CM 0. 74.70699999999999 FORMAT "%5.2" /end CHARACTERISTIC
/begin CHARACTERISTIC K_OZZEITFAKT "Bereich der gesamten Laufstrecke wo die Berechnung des Zeit-RW Beainfluss hat" VALUE 0xa100e134 _REC_VAL_20_u1 0.996 _CNV_R_R_Def_f_ub_b_573_CM 0. 0.996 /end CHARACTERISTIC
/begin CHARACTERISTIC K_OZZEITINT "Zeitintervall für Ölwechsel in Monate (CBS4)" VALUE 0xa100e152 _REC_VAL_20_u1 99.45 _CNV_R_R_Def_dez_sl_575_CM 0. 255. FORMAT "%3.0" /end CHARACTERISTIC
/begin CHARACTERISTIC K_OZZEITST "Delta Zeit für Luftdruck messsung" VALUE 0xa100df1a _REC_VAL_20_u1 99.45 _CNV_R_R_Def_td_uw__682_CM 0. 255. FORMAT "%5.2" /end CHARACTERISTIC
/begin CHARACTERISTIC K_OZZYKCBS "Zeitabstand fürs zyklisch Senden der CBS-Nachricht" VALUE 0xa100de56 _REC_VAL_20_u1 99.45 _CNV_R_R_Def_dez_sl_575_CM 0. 255. FORMAT "%3.0" /end CHARACTERISTIC
/begin CHARACTERISTIC K_PT1NMOT "Konstant für Lowpass Filter Drehzahl Töns" VALUE 0xa100df1b _REC_VAL_20_u1 99.60930000000001 _CNV_R_R_Def_f_ub_b_602_CM 0. 99.60930000000001 FORMAT "%5.2" /end CHARACTERISTIC
/begin CHARACTERISTIC K_PT1TOEL "Konstant für Lowpass Filter ÖltemperaturTöns" VALUE 0xa100ded4 _REC_VAL_20_u2 99.9984 _CNV_R_R_Def_f_uw_b_576_CM 0. 99.9984 /end CHARACTERISTIC
/begin CHARACTERISTIC K_PWGLLANH "Fahrpedalwinkel-Schwelle für Rücksetzen der Leerlaufanhebung Generatorlast" VALUE 0xa1017cc0 _REC_VAL_20_s2 95.99852999999999 _CNV_R_R_Def_wdk_sw_691_CM -800. 799.9755 FORMAT "%5.2" /end CHARACTERISTIC
/begin CHARACTERISTIC K_P_HDSTABBR "" VALUE 0xa101a394 _REC_VAL_20_u2 39.9993 _CNV_R_R_Def_p_uw_q_685_CM 0. 39.9993 FORMAT "%7.4" /end CHARACTERISTIC
/begin CHARACTERISTIC K_RFAPP "" VALUE 0xa101a2e6 _REC_VAL_20_s2 98.30250000000001 _CNV_R_R_Def_rf_sw__616_CM -327.68 327.67 FORMAT "%7.4" /end CHARACTERISTIC
/begin CHARACTERISTIC K_RK2APP_HS "" VALUE 0xa101a2e8 _REC_VAL_20_s2 95.99853300000001 _CNV_R_R_Def_rk_sw__697_CM -1600. 1599.9511 /end CHARACTERISTIC
/begin CHARACTERISTIC K_RK2APP_S "" VALUE 0xa101a2ea _REC_VAL_20_s2 95.99853300000001 _CNV_R_R_Def_rk_sw__697_CM -1600. 1599.9511 /end CHARACTERISTIC
/begin CHARACTERISTIC K_RK2MIN_H "" VALUE 0xa101a384 _REC_VAL_20_s2 95.99853300000001 _CNV_R_R_Def_rk_sw__697_CM -1600. 1599.9511 /end CHARACTERISTIC
/begin CHARACTERISTIC K_RK3APP_S "Applikationswert Krafstoffmasse 3. Einspritzung (schicht)" VALUE 0xa101a2e2 _REC_VAL_20_s2 95.99853300000001 _CNV_R_R_Def_rk_sw__697_CM -1600. 1599.9511 /end CHARACTERISTIC
/begin CHARACTERISTIC K_RK3MIN_S "" VALUE 0xa101a386 _REC_VAL_20_s2 95.99853300000001 _CNV_R_R_Def_rk_sw__697_CM -1600. 1599.9511 /end CHARACTERISTIC
/begin CHARACTERISTIC K_RKADDAPP_H "Applikationswert Krafstoffmasse (homogen)" VALUE 0xa101a2dc _REC_VAL_20_s2 95.99853300000001 _CNV_R_R_Def_rk_sw__697_CM -1600. 1599.9511 /end CHARACTERISTIC
/begin CHARACTERISTIC K_RKAPP_H "Applikationswert Krafstoffmasse (homogen)" VALUE 0xa101a2da _REC_VAL_20_s2 95.99853300000001 _CNV_R_R_Def_rk_sw__697_CM -1600. 1599.9511 /end CHARACTERISTIC
/begin CHARACTERISTIC K_RKAPP_HS "Applikationswert Krafstoffmasse (homogen-schicht)" VALUE 0xa101a2de _REC_VAL_20_s2 95.99853300000001 _CNV_R_R_Def_rk_sw__697_CM -1600. 1599.9511 /end CHARACTERISTIC
/begin CHARACTERISTIC K_RKAPP_S "Applikationswert Krafstoffmasse (schicht)" VALUE 0xa101a2e0 _REC_VAL_20_s2 95.99853300000001 _CNV_R_R_Def_rk_sw__697_CM -1600. 1599.9511 /end CHARACTERISTIC
/begin CHARACTERISTIC K_RKHYSDOE_HS "" VALUE 0xa101a38c _REC_VAL_20_s2 95.99853300000001 _CNV_R_R_Def_rk_sw__697_CM -1600. 1599.9511 /end CHARACTERISTIC
/begin CHARACTERISTIC K_RKHYSDOE_S "" VALUE 0xa101a388 _REC_VAL_20_s2 95.99853300000001 _CNV_R_R_Def_rk_sw__697_CM -1600. 1599.9511 /end CHARACTERISTIC
/begin CHARACTERISTIC K_RKSOLL3APP_H "Applikationswert Krafstoffmasse (homogen)" VALUE 0xa101a382 _REC_VAL_20_s2 95.99853300000001 _CNV_R_R_Def_rk_sw__697_CM -1600. 1599.9511 /end CHARACTERISTIC
/begin CHARACTERISTIC K_RKTEVAPP_S "Rktev APPL" VALUE 0xa101a370 _REC_VAL_20_s2 95.99853300000001 _CNV_R_R_Def_rk_sw__697_CM -1600. 1599.9511 /end CHARACTERISTIC
/begin CHARACTERISTIC K_RKTE_MAX "" VALUE 0xa101a2d8 _REC_VAL_20_s2 95.99853300000001 _CNV_R_R_Def_rk_sw__697_CM -1600. 1599.9511 /end CHARACTERISTIC
/begin CHARACTERISTIC K_TDFDTMAX "Zeitschwelle zum Erkennen Drehzahlabweichung durch Generatorlastschwankung" VALUE 0xa1017cc6 _REC_VAL_20_u2 131.07 _CNV_R_R_Def_td_uw__712_CM 0. 13107. FORMAT "%4.1" /end CHARACTERISTIC
/begin CHARACTERISTIC K_TDFFABLF "Zeitschwelle (Tdffgen) zum Rücksetzen der Leerlaufanhebung" VALUE 0xa1017cc8 _REC_VAL_20_u2 131.07 _CNV_R_R_Def_td_uw__712_CM 0. 13107. FORMAT "%4.1" /end CHARACTERISTIC
/begin CHARACTERISTIC K_TDFFMAX "Maximale Periodendauer Generatorlastschwankungen  für Leerlaufstabilisierung" VALUE 0xa1017cca _REC_VAL_20_u2 131.07 _CNV_R_R_Def_td_uw__712_CM 0. 13107. FORMAT "%4.1" /end CHARACTERISTIC
/begin CHARACTERISTIC K_TDFFMIN "Minimale Periodendauer Generatorlastschwankungen für Leerlaufstabilisierung" VALUE 0xa1017ccc _REC_VAL_20_u2 131.07 _CNV_R_R_Def_td_uw__712_CM 0. 13107. FORMAT "%4.1" /end CHARACTERISTIC
/begin CHARACTERISTIC K_TDNHOLD "Haltezeit für Bedingung Drehzahlabweichung durch Generatorlastschwankung" VALUE 0xa1017cdb _REC_VAL_20_u1 51. _CNV_R_R_Def_td_uw__712_CM 0. 51. FORMAT "%4.1" /end CHARACTERISTIC
/begin CHARACTERISTIC K_TD_MAXRFFIL "Filterungszeit für Rf_soll" VALUE 0xa101a39e _REC_VAL_20_u1 2.55 _CNV_R_R_Def_td_uw__679_CM 0. 2.55 FORMAT "%5.2" /end CHARACTERISTIC
/begin CHARACTERISTIC K_TD_MSLAMKW "Delta-Winkel für Verzögerungszeitberechnung Rk-Filter" VALUE 0xa1019ad2 _REC_VAL_20_u2 107.518355 _CNV_R_R_Def_kw_sw__622_CM 0. 1535.9765 /end CHARACTERISTIC
/begin CHARACTERISTIC K_TD_SPUELSPERR "Mslam-Sperrzeit" VALUE 0xa1019ac2 _REC_VAL_20_u1 2.55 _CNV_R_R_Def_td_uw__679_CM 0. 2.55 FORMAT "%5.2" /end CHARACTERISTIC
/begin CHARACTERISTIC K_TMDMSLMD_OFF "" VALUE 0xa1019ad4 _REC_VAL_20_u2 98.30250000000001 _CNV_R_R_Def_td_uw__679_CM 0. 655.35 FORMAT "%5.2" /end CHARACTERISTIC
/begin CHARACTERISTIC K_TMOTLLANH "Motortemperatur-Schwelle zum Aktivieren der Leerlaufanhebung Generatorlast" VALUE 0xa1017cc2 _REC_VAL_20_s2 98.30250000000001 _CNV_R_R_Def_t_sw_q_620_CM -327.68 327.67 FORMAT "%5.2" /end CHARACTERISTIC
/begin CHARACTERISTIC K_TMOTMINHS_HYS "Hyst Tmot-Schwelle für Schicht möglich" VALUE 0xa101a37c _REC_VAL_20_s2 98.30250000000001 _CNV_R_R_Def_t_sw_q_620_CM -327.68 327.67 FORMAT "%5.2" /end CHARACTERISTIC
/begin CHARACTERISTIC K_TMOTMINS_HYS "Hyst Tmot-Schwelle für Schicht möglich" VALUE 0xa101a378 _REC_VAL_20_s2 98.30250000000001 _CNV_R_R_Def_t_sw_q_620_CM -327.68 327.67 FORMAT "%5.2" /end CHARACTERISTIC
/begin CHARACTERISTIC K_TMOTMIN_HDST "" VALUE 0xa101a38a _REC_VAL_20_s2 98.30250000000001 _CNV_R_R_Def_t_sw_q_620_CM -327.68 327.67 FORMAT "%5.2" /end CHARACTERISTIC
/begin CHARACTERISTIC K_TMOTMIN_HS "Tmot-Schwelle für Homogen-Schicht möglich" VALUE 0xa101a37a _REC_VAL_20_s2 98.30250000000001 _CNV_R_R_Def_t_sw_q_620_CM -327.68 327.67 FORMAT "%5.2" /end CHARACTERISTIC
/begin CHARACTERISTIC K_TMOTMIN_S "Tmot-Schwelle für Schicht möglich" VALUE 0xa101a376 _REC_VAL_20_s2 98.30250000000001 _CNV_R_R_Def_t_sw_q_620_CM -327.68 327.67 FORMAT "%5.2" /end CHARACTERISTIC
/begin CHARACTERISTIC K_TNSTLLANH "Zeitschwelle nach Startende zum Aktivieren der Leerlaufanhebung Generatorlast" VALUE 0xa1017cce _REC_VAL_20_u2 98.30250000000001 _CNV_R_R_Def_td_uw__679_CM 0. 655.35 FORMAT "%5.2" /end CHARACTERISTIC
/begin CHARACTERISTIC K_TOGANZ "" VALUE 0xa100ded6 _REC_VAL_20_u2 89.97 _CNV_R_R_Def_dez_sl_575_CM 1. 3000. FORMAT "%5.0" /end CHARACTERISTIC
/begin CHARACTERISTIC K_TOGKURZANZ "" VALUE 0xa100ded8 _REC_VAL_20_u2 99.90000000000001 _CNV_R_R_Def_dez_sl_575_CM 1. 1000. FORMAT "%5.0" /end CHARACTERISTIC
/begin CHARACTERISTIC K_TOGMWK "" VALUE 0xa100df1c _REC_VAL_20_u1 99. _CNV_R_R_Def_dez_sl_575_CM 1. 100. FORMAT "%3.0" /end CHARACTERISTIC
/begin CHARACTERISTIC K_TOGNMAX "" VALUE 0xa100deb4 _REC_VAL_20_s2 0. _CNV_R_R_Def_n_sw_q_612_CM -32768. 32767. FORMAT "%5.0" /end CHARACTERISTIC
/begin CHARACTERISTIC K_TOGNMIN "" VALUE 0xa100deb6 _REC_VAL_20_s2 0. _CNV_R_R_Def_n_sw_q_612_CM -32768. 32767. FORMAT "%5.0" /end CHARACTERISTIC
/begin CHARACTERISTIC K_TOGORIANZ "" VALUE 0xa100df1d _REC_VAL_20_u1 99.06 _CNV_R_R_Def_dez_sl_575_CM 1. 255. FORMAT "%3.0" /end CHARACTERISTIC
/begin CHARACTERISTIC K_TOGSTARTVERZ "Töns Start Verzögerung nach Drehzal" VALUE 0xa100deda _REC_VAL_20_u2 0. _CNV_R_R_Def_dez_sl_575_CM 0. 65535. FORMAT "%5.0" /end CHARACTERISTIC
/begin CHARACTERISTIC K_TOGTMORIMAX "Tmot Schwelle Orientierungsmessung" VALUE 0xa100deb8 _REC_VAL_20_s2 98.30250000000001 _CNV_R_R_Def_t_sw_q_620_CM -327.68 327.67 FORMAT "%5.2" /end CHARACTERISTIC
/begin CHARACTERISTIC K_TOGTMORIMIN "Mindest Temperatur für OrientirungMw Töns" VALUE 0xa100deba _REC_VAL_20_s2 98.30250000000001 _CNV_R_R_Def_t_sw_q_620_CM -327.68 327.67 FORMAT "%5.2" /end CHARACTERISTIC
/begin CHARACTERISTIC K_TOGTMOT "" VALUE 0xa100debc _REC_VAL_20_s2 98.30250000000001 _CNV_R_R_Def_t_sw_q_620_CM -327.68 327.67 FORMAT "%5.2" /end CHARACTERISTIC
/begin CHARACTERISTIC K_TOGVERBKZ "" VALUE 0xa100df1e _REC_VAL_20_u1 99.45 _CNV_R_R_Def_td_ub__680_CM 0. 127.5 /end CHARACTERISTIC
/begin CHARACTERISTIC K_TOGVERBNOR "" VALUE 0xa100df1f _REC_VAL_20_u1 99.45 _CNV_R_R_Def_td_ub__680_CM 0. 127.5 /end CHARACTERISTIC
/begin CHARACTERISTIC K_TOGVERLKZ "" VALUE 0xa100df20 _REC_VAL_20_u1 99.45 _CNV_R_R_Def_td_ub__680_CM 0. 127.5 /end CHARACTERISTIC
/begin CHARACTERISTIC K_TOGVERLNOR "" VALUE 0xa100df21 _REC_VAL_20_u1 99.45 _CNV_R_R_Def_td_ub__680_CM 0. 127.5 /end CHARACTERISTIC
/begin CHARACTERISTIC K_TOGVERZOEG "" VALUE 0xa100df22 _REC_VAL_20_u1 99.45 _CNV_R_R_Def_dez_sl_575_CM 0. 255. FORMAT "%3.0" /end CHARACTERISTIC
/begin CHARACTERISTIC K_TRTYP "" VALUE 0xa100dedc _REC_VAL_20_u2 98.30250000000001 _CNV_R_R_Def_td_uw__679_CM 0. 655.35 FORMAT "%5.2" /end CHARACTERISTIC
/begin CHARACTERISTIC K_TVSAMSLAM "Verzögerungszeit für B_sa" VALUE 0xa1019acc _REC_VAL_20_u2 98.30250000000001 _CNV_R_R_Def_td_uw__679_CM 0. 655.35 FORMAT "%5.2" /end CHARACTERISTIC
/begin CHARACTERISTIC K_TVSAVMSLAM "Verzögerungszeit für B_sa, im LL" VALUE 0xa1019ace _REC_VAL_20_u2 98.30250000000001 _CNV_R_R_Def_td_uw__679_CM 0. 655.35 FORMAT "%5.2" /end CHARACTERISTIC
/begin CHARACTERISTIC K_UFAKRKMK "Umrechnungsfaktor Rk nach Mk" VALUE 0xa101a38e _REC_VAL_20_u2 63.99900000000001 _CNV_R_R_Def_f_uw_b_580_CM 0. 63.999 FORMAT "%7.4" /end CHARACTERISTIC
/begin CHARACTERISTIC K_VFZGGENFIL "Filterkonstante Filterung V" VALUE 0xa1017cd0 _REC_VAL_20_u2 0.9999694824218756 _CNV_R_R_Def_f_uw_b_591_CM 1.52587890625e-005 0.9999847412109381 FORMAT "%14.5" /end CHARACTERISTIC
/begin CHARACTERISTIC K_VFZGGENKOR "Korrekturfaktor für V" VALUE 0xa1017cdc _REC_VAL_20_u1 7.9687 _CNV_R_R_Def_f_ub_b_739_CM 0. 7.9687 FORMAT "%5.2" /end CHARACTERISTIC
/begin CHARACTERISTIC K_VFZGLLANH "Fahrgeschwindigkeits-Schwelle ¨ fur R¨ ucksetzen der Leerlaufanhebung Generatorlast" VALUE 0xa1017cd2 _REC_VAL_20_u2 0. _CNV_R_R_Def_v_uw_q_723_CM 0. 65535. FORMAT "%5.0" /end CHARACTERISTIC
/begin CHARACTERISTIC K_ZKRFSOLL1 "Filterzeitkonstante Drf_soll-Filter" VALUE 0xa101a2d2 _REC_VAL_20_u2 99.9984 _CNV_R_R_Def_f_uw_b_576_CM 0. 99.9984 /end CHARACTERISTIC
/begin CHARACTERISTIC K_ZKRFSOLL2 "Filterzeitkonstante Drf_soll-Filter 2" VALUE 0xa101a2d4 _REC_VAL_20_u2 99.9984 _CNV_R_R_Def_f_uw_b_576_CM 0. 99.9984 /end CHARACTERISTIC
/begin CHARACTERISTIC K_ZK_MDIZWFIL "Mdi-Schwelle" VALUE 0xa101a372 _REC_VAL_20_u2 655.35 _CNV_R_R_Def_zk10ms_709_CM 1.e-002 655.36 FORMAT "%7.4" /end CHARACTERISTIC
/begin CHARACTERISTIC K_ZYKLHD_MAX "" VALUE 0xa101a392 _REC_VAL_20_u2 0. _CNV_R_R_Def_dez_sl_575_CM 0. 65535. FORMAT "%5.0" /end CHARACTERISTIC
/begin CHARACTERISTIC S_AGRIG_SOLL "" VALUE 0xa101a2ce _REC_VAL_20_u1 99.45 _CNV_R_R_Def_dez_sl_575_CM 0. 255. FORMAT "%3.0" /end CHARACTERISTIC
/begin CHARACTERISTIC S_ATL_FSP "Fehlerspeicher vorhanden" VALUE 0xa101cb4c _REC_VAL_20_u1 1. _CNV_R_R_Def_dez_sl_575_CM 0. 1. FORMAT "%3.0" /end CHARACTERISTIC
/begin CHARACTERISTIC S_BERMSLAMON "Schalter MSLAM berechnen erzwingen" VALUE 0xa1019ab9 _REC_VAL_20_u1 99.45 _CNV_R_R_Def_dez_sl_575_CM 0. 255. FORMAT "%3.0" /end CHARACTERISTIC
/begin CHARACTERISTIC S_FRK2APP_H "" VALUE 0xa101a2c6 _REC_VAL_20_u1 1. _CNV_R_R_Def_dez_sl_575_CM 0. 1. FORMAT "%3.0" /end CHARACTERISTIC
/begin CHARACTERISTIC S_GELIBIEAPP "Applikation Generatorlastbegrenzung für Leerlaufstabilisierung" VALUE 0xa1017cdd _REC_VAL_20_u1 1. _CNV_R_R_Def_dez_sl_575_CM 0. 1. FORMAT "%3.0" /end CHARACTERISTIC
/begin CHARACTERISTIC S_KHDI "1: Momentenreserve aus Kathheizmanager einrechnen" VALUE 0xa1019d48 _REC_VAL_20_u1 99.45 _CNV_R_R_Def_dez_sl_575_CM 0. 255. FORMAT "%3.0" /end CHARACTERISTIC
/begin CHARACTERISTIC S_LAM_SON "Schalter Zulieferer-Lambda oder Kennfeld-Lambda" VALUE 0xa1019ab8 _REC_VAL_20_u1 99.45 _CNV_R_R_Def_dez_sl_575_CM 0. 255. FORMAT "%3.0" /end CHARACTERISTIC
/begin CHARACTERISTIC S_LA_SOLL_KO "Schalter La_soll_ko1/2 = 16" VALUE 0xa101a3a0 _REC_VAL_20_u1 1. _CNV_R_R_Def_dez_sl_575_CM 0. 1. FORMAT "%3.0" /end CHARACTERISTIC
/begin CHARACTERISTIC S_LA_SPUEL "Schalter Einrechnung Spuelluft" VALUE 0xa101a36f _REC_VAL_20_u1 99.45 _CNV_R_R_Def_dez_sl_575_CM 0. 255. FORMAT "%3.0" /end CHARACTERISTIC
/begin CHARACTERISTIC S_MDARV_AKT "Schalter Misfirediagnose zu aktivieren" VALUE 0xa1019abe _REC_VAL_20_u1 99.45 _CNV_R_R_Def_dez_sl_575_CM 0. 255. FORMAT "%3.0" /end CHARACTERISTIC
/begin CHARACTERISTIC S_MDRES_KRLL "Schalter Momentenreserve der KR im LL" VALUE 0xa101cad8 _REC_VAL_20_u1 99.45 _CNV_R_R_Def_dez_sl_575_CM 0. 255. FORMAT "%3.0" /end CHARACTERISTIC
/begin CHARACTERISTIC S_MDRKHOM "Schalter MDRK im Zustand homgen aktiv" VALUE 0xa101a3a1 _REC_VAL_20_u1 1. _CNV_R_R_Def_dez_sl_575_CM 0. 1. FORMAT "%3.0" /end CHARACTERISTIC
/begin CHARACTERISTIC S_MSLAMMDSTP_ENTP "Schalter Entprellterfehler zu nutzen" VALUE 0xa1019abf _REC_VAL_20_u1 99.45 _CNV_R_R_Def_dez_sl_575_CM 0. 255. FORMAT "%3.0" /end CHARACTERISTIC
/begin CHARACTERISTIC S_MSTE_KOR "Schalter Korrektur Massenstrom über Mste" VALUE 0xa1019abb _REC_VAL_20_u1 99.45 _CNV_R_R_Def_dez_sl_575_CM 0. 255. FORMAT "%3.0" /end CHARACTERISTIC
/begin CHARACTERISTIC S_PGENLL_AKT "Aktivierung Leistungsreduzierung Generator durch Generatorlastschwankung" VALUE 0xa1017cde _REC_VAL_20_u1 1. _CNV_R_R_Def_dez_sl_575_CM 0. 1. FORMAT "%3.0" /end CHARACTERISTIC
/begin CHARACTERISTIC S_RFAPP "" VALUE 0xa101a2c7 _REC_VAL_20_u1 1. _CNV_R_R_Def_dez_sl_575_CM 0. 1. FORMAT "%3.0" /end CHARACTERISTIC
/begin CHARACTERISTIC S_RFSOLLFIL_APP "Schalter Rf_soll Schalter permanent aktivieren" VALUE 0xa101a3a2 _REC_VAL_20_u1 1. _CNV_R_R_Def_dez_sl_575_CM 0. 1. FORMAT "%3.0" /end CHARACTERISTIC
/begin CHARACTERISTIC S_RFSOLLFIL_ON "Schalter Rf_soll Filterung erlauben" VALUE 0xa101a3a3 _REC_VAL_20_u1 1. _CNV_R_R_Def_dez_sl_575_CM 0. 1. FORMAT "%3.0" /end CHARACTERISTIC
/begin CHARACTERISTIC S_RK2APP_HS "" VALUE 0xa101a2c9 _REC_VAL_20_u1 1. _CNV_R_R_Def_dez_sl_575_CM 0. 1. FORMAT "%3.0" /end CHARACTERISTIC
/begin CHARACTERISTIC S_RK2APP_S "" VALUE 0xa101a2c8 _REC_VAL_20_u1 1. _CNV_R_R_Def_dez_sl_575_CM 0. 1. FORMAT "%3.0" /end CHARACTERISTIC
/begin CHARACTERISTIC S_RK3APP_S "Applikationsschalter Krafstoffmasse 3. Einspritzung (schicht)" VALUE 0xa101a2cd _REC_VAL_20_u1 99.45 _CNV_R_R_Def_dez_sl_575_CM 0. 255. FORMAT "%3.0" /end CHARACTERISTIC
/begin CHARACTERISTIC S_RKAPP_H "" VALUE 0xa101a2ca _REC_VAL_20_u1 1. _CNV_R_R_Def_dez_sl_575_CM 0. 1. FORMAT "%3.0" /end CHARACTERISTIC
/begin CHARACTERISTIC S_RKAPP_HS "" VALUE 0xa101a2cc _REC_VAL_20_u1 1. _CNV_R_R_Def_dez_sl_575_CM 0. 1. FORMAT "%3.0" /end CHARACTERISTIC
/begin CHARACTERISTIC S_RKAPP_S "" VALUE 0xa101a2cb _REC_VAL_20_u1 1. _CNV_R_R_Def_dez_sl_575_CM 0. 1. FORMAT "%3.0" /end CHARACTERISTIC
/begin CHARACTERISTIC S_RKTEVAPP_S "Schalter Rktev über Applikationskonstant" VALUE 0xa101a36e _REC_VAL_20_u1 99.45 _CNV_R_R_Def_dez_sl_575_CM 0. 255. FORMAT "%3.0" /end CHARACTERISTIC
/begin CHARACTERISTIC S_RKTEV_KOR "Schalter Korrektur Massenstrom über Rktev" VALUE 0xa1019aba _REC_VAL_20_u1 99.45 _CNV_R_R_Def_dez_sl_575_CM 0. 255. FORMAT "%3.0" /end CHARACTERISTIC
/begin CHARACTERISTIC S_SCH_CLC "Schalter Berechnung homogen-schicht und schicht aktiv" VALUE 0xa101a2c5 _REC_VAL_20_u1 1. _CNV_R_R_Def_dez_sl_575_CM 0. 1. FORMAT "%3.0" /end CHARACTERISTIC
/begin CHARACTERISTIC S_TEMSLAM "Schalter Freigabe MSLAM über B_te" VALUE 0xa1019abd _REC_VAL_20_u1 99.45 _CNV_R_R_Def_dez_sl_575_CM 0. 255. FORMAT "%3.0" /end CHARACTERISTIC
/begin CHARACTERISTIC S_TEMXMSLAM "Schalter Freigabe MSLAM über B_temson" VALUE 0xa1019abc _REC_VAL_20_u1 99.45 _CNV_R_R_Def_dez_sl_575_CM 0. 255. FORMAT "%3.0" /end CHARACTERISTIC
/begin CHARACTERISTIC S_ZWMINFIL_AUS "Schalter Zwmin filter auszuschalten" VALUE 0xa101a39f _REC_VAL_20_u1 1. _CNV_R_R_Def_dez_sl_575_CM 0. 1. FORMAT "%3.0" /end CHARACTERISTIC
/begin COMPU_METHOD _CNV_R_R_Def_km_sw__64_CM "Def_km_sw_q10" RAT_FUNC "%6.3" "km" COEFFS 0. 1. 0. 0. 0. 10. /end COMPU_METHOD
/begin COMPU_METHOD _CNV_R_R_Def_km_ub__443_CM "Def_km_ub_q1000" RAT_FUNC "%6.3" "km" COEFFS 0. 1. 0. 0. 0. 1000. /end COMPU_METHOD
/begin COMPU_METHOD _CNV_R_R_Def_ac_sb__572_CM "Def_ac_sb_q0p25" RAT_FUNC "%6.3" "-" COEFFS 0. 4. 0. 0. 0. 1. /end COMPU_METHOD
/begin COMPU_METHOD _CNV_R_R_Def_f_ub_b_573_CM "Def_f_ub_b1" RAT_FUNC "%6.3" "-" COEFFS 0. 256. 0. 0. 0. 1. /end COMPU_METHOD
/begin COMPU_METHOD _CNV_R_R_Def_m_sw_q_574_CM "Def_m_sw_q0p1" RAT_FUNC "%6.3" "Nm" COEFFS 0. 10. 0. 0. 0. 1. /end COMPU_METHOD
/begin COMPU_METHOD _CNV_R_R_Def_dez_sl_575_CM "Def_dez_sl_q1" RAT_FUNC "%6.3" "-" COEFFS 0. 1. 0. 0. 0. 1. /end COMPU_METHOD
/begin COMPU_METHOD _CNV_R_R_Def_f_uw_b_576_CM "Def_f_uw_b100" RAT_FUNC "%6.3" "%" COEFFS 0. 65536. 0. 0. 0. 100. /end COMPU_METHOD
/begin COMPU_METHOD _CNV_R_R_Def_f_sw_b_577_CM "Def_f_sw_b32" RAT_FUNC "%6.3" "-" COEFFS 0. 32768. 0. 0. 0. 32. /end COMPU_METHOD
/begin COMPU_METHOD _CNV_R_R_Def_p_sw_q_578_CM "Def_p_sw_q0p039" RAT_FUNC "%6.3" "hPa" COEFFS 0. 256. 0. 0. 0. 10. /end COMPU_METHOD
/begin COMPU_METHOD _CNV_R_R_Def_f_uw_b_579_CM "Def_f_uw_b2" RAT_FUNC "%6.3" "-" COEFFS 0. 65536. 0. 0. 0. 2. /end COMPU_METHOD
/begin COMPU_METHOD _CNV_R_R_Def_f_uw_b_580_CM "Def_f_uw_b64" RAT_FUNC "%6.3" "-" COEFFS 0. 65536. 0. 0. 0. 64. /end COMPU_METHOD
/begin COMPU_METHOD _CNV_R_R_Def_f_uw_b_591_CM "Def_f_uw_b1" RAT_FUNC "%6.3" "-" COEFFS 0. 65536. 0. 0. 0. 1. /end COMPU_METHOD
/begin COMPU_METHOD _CNV_R_R_Def_td_ub__593_CM "Def_td_ub_q0p1" RAT_FUNC "%6.3" "s" COEFFS 0. 10. 0. 0. 0. 1. /end COMPU_METHOD
/begin COMPU_METHOD _CNV_R_R_Def_f_uw_b_594_CM "Def_f_uw_b16" RAT_FUNC "%6.3" "-" COEFFS 0. 65536. 0. 0. 0. 16. /end COMPU_METHOD
/begin COMPU_METHOD _CNV_R_R_Def_f_sw_b_597_CM "Def_f_sw_b100" RAT_FUNC "%6.3" "-" COEFFS 0. 32768. 0. 0. 0. 100. /end COMPU_METHOD
/begin COMPU_METHOD _CNV_R_R_Def_zw_sw__599_CM "Def_zw_sw_q0p1" RAT_FUNC "%6.3" "°" COEFFS 0. 10. 0. 0. 0. 1. /end COMPU_METHOD
/begin COMPU_METHOD _CNV_R_R_Def_f_sb_b_600_CM "Def_f_sb_b64" RAT_FUNC "%6.3" "-" COEFFS 0. 128. 0. 0. 0. 64. /end COMPU_METHOD
/begin COMPU_METHOD _CNV_R_R_Def_f_ub_b_602_CM "Def_f_ub_b100" RAT_FUNC "%6.3" "%" COEFFS 0. 256. 0. 0. 0. 100. /end COMPU_METHOD
/begin COMPU_METHOD _CNV_R_R_Def_f_sw_b_607_CM "Def_f_sw_b8" RAT_FUNC "%6.3" "-" COEFFS 0. 32768. 0. 0. 0. 8. /end COMPU_METHOD
/begin COMPU_METHOD _CNV_R_R_Def_f_sw_b_608_CM "Def_f_sw_b2" RAT_FUNC "%6.3" "-" COEFFS 0. 65536. 0. 0. 0. 4. /end COMPU_METHOD
/begin COMPU_METHOD _CNV_R_R_Def_ms_uw__611_CM "Def_ms_uw_q0p03125" RAT_FUNC "%6.3" "kg/h" COEFFS 0. 32. 0. 0. 0. 1. /end COMPU_METHOD
/begin COMPU_METHOD _CNV_R_R_Def_n_sw_q_612_CM "Def_n_sw_q1p0" RAT_FUNC "%6.3" "Upm" COEFFS 0. 1. 0. 0. 0. 1. /end COMPU_METHOD
/begin COMPU_METHOD _CNV_R_R_Def_rf_sw__616_CM "Def_rf_sw_q0p01" RAT_FUNC "%6.3" "%" COEFFS 0. 100. 0. 0. 0. 1. /end COMPU_METHOD
/begin COMPU_METHOD _CNV_R_R_Def_eta_sw_617_CM "Def_eta_sw_b200" RAT_FUNC "%6.3" "%" COEFFS 0. 32768. 0. 0. 0. 200. /end COMPU_METHOD
/begin COMPU_METHOD _CNV_R_R_Def_t_sw_q_618_CM "Def_t_sw_q0p1" RAT_FUNC "%6.3" "°C" COEFFS 0. 10. 0. 0. 0. 1. /end COMPU_METHOD
/begin COMPU_METHOD _CNV_R_R_Def_t_sw_q_620_CM "Def_t_sw_q0p01" RAT_FUNC "%6.3" "°C" COEFFS 0. 100. 0. 0. 0. 1. /end COMPU_METHOD
/begin COMPU_METHOD _CNV_R_R_Def_kw_sw__622_CM "Def_kw_sw_q0p0234" RAT_FUNC "%6.3" "°KW" COEFFS 0. 256. 0. 0. 0. 6. /end COMPU_METHOD
/begin COMPU_METHOD _CNV_R_R_Def_zw_sw__624_CM "Def_zw_sw_b64" RAT_FUNC "%6.3" "°" COEFFS 0. 32768. 0. 0. 0. 64. /end COMPU_METHOD
/begin COMPU_METHOD _CNV_R_R_Def_f_ub_b_625_CM "Def_f_ub_b2" RAT_FUNC "%6.3" "-" COEFFS 0. 256. 0. 0. 0. 2. /end COMPU_METHOD
/begin COMPU_METHOD _CNV_R_R_Def_eta_uw_627_CM "Def_eta_uw_b200" RAT_FUNC "%6.3" "%" COEFFS 0. 65536. 0. 0. 0. 200. /end COMPU_METHOD
/begin COMPU_METHOD _CNV_R_R_Def_eta_sw_628_CM "Def_eta_sw_q0p00305" RAT_FUNC "%6.3" "%" COEFFS 0. 32767. 0. 0. 0. 100. /end COMPU_METHOD
/begin COMPU_METHOD _CNV_R_R_Def_f_uw_b_629_CM "Def_f_uw_b10" RAT_FUNC "%6.3" "%" COEFFS 0. 65536. 0. 0. 0. 10. /end COMPU_METHOD
/begin COMPU_METHOD _CNV_R_R_Def_f_uw_b_631_CM "Def_f_uw_b8" RAT_FUNC "%6.3" "-" COEFFS 0. 65536. 0. 0. 0. 8. /end COMPU_METHOD
/begin COMPU_METHOD _CNV_R_R_Def_f_uw_b_633_CM "Def_f_uw_b1p0" RAT_FUNC "%6.3" "-" COEFFS 0. 65535. 0. 0. 0. 1. /end COMPU_METHOD
/begin COMPU_METHOD _CNV_R_R_Def_f_sw_b_634_CM "Def_f_sw_b64" RAT_FUNC "%6.3" "-" COEFFS 0. 65536. 0. 0. 0. 128. /end COMPU_METHOD
/begin COMPU_METHOD _CNV_R_R_Def_f_uw_b_639_CM "Def_f_uw_b0p3" RAT_FUNC "%6.3" "%/hPa" COEFFS 0. 65536. 0. 0. 0. 0.3 /end COMPU_METHOD
/begin COMPU_METHOD _CNV_R_R_Def_i_ub_q_645_CM "Def_i_ub_q0p125" RAT_FUNC "%6.3" "A" COEFFS 0. 8. 0. 0. 0. 1. /end COMPU_METHOD
/begin COMPU_METHOD _CNV_R_R_Def_mk_uw__661_CM "Def_mk_uw_b1389" RAT_FUNC "%6.3" "mg/hub" COEFFS 0. 65535. 0. 0. 0. 1389. /end COMPU_METHOD
/begin COMPU_METHOD _CNV_R_R_Def_tn_uw__671_CM "Def_tn_uw_q1" RAT_FUNC "%6.3" "min" COEFFS 0. 1. 0. 0. 0. 1. /end COMPU_METHOD
/begin COMPU_METHOD _CNV_R_R_Def_niv_ub_672_CM "Def_niv_ub_b75" RAT_FUNC "%6.3" "" COEFFS 0. 256. 0. 0. 0. 75. /end COMPU_METHOD
/begin COMPU_METHOD _CNV_R_R_Def_fuel_u_673_CM "Def_fuel_ul_q0p000122" RAT_FUNC "%6.3" "" COEFFS 0. 8192. 0. 0. 0. 1. /end COMPU_METHOD
/begin COMPU_METHOD _CNV_R_R_Def_f_sb_b_674_CM "Def_f_sb_b2" RAT_FUNC "%6.3" "-" COEFFS 0. 128. 0. 0. 0. 2. /end COMPU_METHOD
/begin COMPU_METHOD _CNV_R_R_Def_lf_ub__675_CM "Def_lf_ub_q0p01" RAT_FUNC "%6.3" "-" COEFFS 0. 100. 0. 0. 0. 1. /end COMPU_METHOD
/begin COMPU_METHOD _CNV_R_R_Def_perm_u_676_CM "Def_perm_uw_b6" RAT_FUNC "%6.3" "-" COEFFS 0. 65536. 0. 0. 0. 6. /end COMPU_METHOD
/begin COMPU_METHOD _CNV_R_R_Def_niv_ub_677_CM "Def_niv_ub_q0p1" RAT_FUNC "%6.3" "l" COEFFS 0. 10. 0. 0. 0. 1. /end COMPU_METHOD
/begin COMPU_METHOD _CNV_R_R_Def_niv_ub_678_CM "Def_niv_ub_b8" RAT_FUNC "%6.3" "" COEFFS 0. 256. 0. 0. 0. 8. /end COMPU_METHOD
/begin COMPU_METHOD _CNV_R_R_Def_td_uw__679_CM "Def_td_uw_q0p01" RAT_FUNC "%6.3" "s" COEFFS 0. 100. 0. 0. 0. 1. /end COMPU_METHOD
/begin COMPU_METHOD _CNV_R_R_Def_td_ub__680_CM "Def_td_ub_q0p5" RAT_FUNC "%6.3" "s" COEFFS 0. 2. 0. 0. 0. 1. /end COMPU_METHOD
/begin COMPU_METHOD _CNV_R_R_Def_perm_s_681_CM "Def_perm_sw_b6" RAT_FUNC "%6.3" "-" COEFFS 0. 65536. 0. 0. 0. 12. /end COMPU_METHOD
/begin COMPU_METHOD _CNV_R_R_Def_td_uw__682_CM "Def_td_uw_q1" RAT_FUNC "%6.3" "s" COEFFS 0. 1. 0. 0. 0. 1. /end COMPU_METHOD
/begin COMPU_METHOD _CNV_R_R_Def_p_uw_q_685_CM "Def_p_uw_q0p0061" RAT_FUNC "%6.3" "MPa" COEFFS 0. 65536. 0. 0. 0. 40. /end COMPU_METHOD
/begin COMPU_METHOD _CNV_R_R_Def_wdk_sw_691_CM "Def_wdk_sw_q0p0244" RAT_FUNC "%6.3" "%" COEFFS 0. 4096. 0. 0. 0. 100. /end COMPU_METHOD
/begin COMPU_METHOD _CNV_R_R_Def_f_ub_b_695_CM "Def_f_ub_b32" RAT_FUNC "%6.3" "-" COEFFS 0. 256. 0. 0. 0. 32. /end COMPU_METHOD
/begin COMPU_METHOD _CNV_R_R_Def_rk_uw__696_CM "Def_rk_uw_b16" RAT_FUNC "%6.3" "-" COEFFS 0. 2048. 0. 0. 0. 1. /end COMPU_METHOD
/begin COMPU_METHOD _CNV_R_R_Def_rk_sw__697_CM "Def_rk_sw_b1600" RAT_FUNC "%6.3" "%" COEFFS 0. 2048. 0. 0. 0. 100. /end COMPU_METHOD
/begin COMPU_METHOD _CNV_S_1_Def_bit_ub_700_CM "Def_bit_ub_0" TAB_VERB "%6.3" "-" COMPU_TAB_REF _CNV_S_1_Def_bit_ub_700 /end COMPU_METHOD
/begin COMPU_VTAB _CNV_S_1_Def_bit_ub_700 "Def_bit_ub_0" TAB_VERB 1 0 "FALSE" /end COMPU_VTAB
/begin COMPU_METHOD _CNV_R_R_Def_zk10ms_709_CM "Def_zk10ms_uw_b655p36" RAT_FUNC "%6.3" "s" COEFFS 0. 0. 655.36 0. 1. 0. /end COMPU_METHOD
/begin COMPU_METHOD _CNV_R_R_Def_td_ub__711_CM "Def_td_ub_b2550" RAT_FUNC "%6.3" "ms" COEFFS 0. 1. 0. 0. 0. 10. /end COMPU_METHOD
/begin COMPU_METHOD _CNV_R_R_Def_td_uw__712_CM "Def_td_uw_q0p2" RAT_FUNC "%6.3" "s" COEFFS 0. 5. 0. 0. 0. 1. /end COMPU_METHOD
/begin COMPU_METHOD _CNV_R_R_Def_u_uw_q_720_CM "Def_u_uw_q0p00488" RAT_FUNC "%6.3" "V" COEFFS 0. 1024. 0. 0. 0. 5. /end COMPU_METHOD
/begin COMPU_METHOD _CNV_R_R_Def_v_uw_q_723_CM "Def_v_uw_q1p0" RAT_FUNC "%6.3" "km/h" COEFFS 0. 1. 0. 0. 0. 1. /end COMPU_METHOD
/begin COMPU_METHOD _CNV_R_R_Def_v_uw_q_724_CM "Def_v_uw_q0p1" RAT_FUNC "%6.3" "km/h" COEFFS 0. 10. 0. 0. 0. 1. /end COMPU_METHOD
/begin COMPU_METHOD _CNV_R_R_Def_tvpwm__736_CM "Def_tvpwm_uw_q0p00153" RAT_FUNC "%6.3" "%" COEFFS 0. 65535. 0. 0. 0. 100. /end COMPU_METHOD
/begin COMPU_METHOD _CNV_R_R_Def_f_ub_b_739_CM "Def_f_ub_b8" RAT_FUNC "%6.3" "-" COEFFS 0. 256. 0. 0. 0. 8. /end COMPU_METHOD
/begin COMPU_METHOD _CNV_R_R_Def_td_ub__749_CM "Def_td_ub_q0p05" RAT_FUNC "%6.3" "s" COEFFS 0. 20. 0. 0. 0. 1. /end COMPU_METHOD
/begin COMPU_METHOD _CNV_R_R_Def_f_ub_b_763_CM "Def_f_ub_b0p25" RAT_FUNC "%6.3" "-" COEFFS 0. 256. 0. 0. 0. 0.25 /end COMPU_METHOD
/begin RECORD_LAYOUT _REC_VAL_20_u1 FNC_VALUES 1 UBYTE COLUMN_DIR DIRECT /end RECORD_LAYOUT
/begin RECORD_LAYOUT _REC_VAL_20_u2 FNC_VALUES 1 UWORD COLUMN_DIR DIRECT /end RECORD_LAYOUT
/begin RECORD_LAYOUT _REC_VAL_20_s2 FNC_VALUES 1 SWORD COLUMN_DIR DIRECT /end RECORD_LAYOUT
/begin RECORD_LAYOUT _REC_VAL_20_s1 FNC_VALUES 1 SBYTE COLUMN_DIR DIRECT /end RECORD_LAYOUT
/begin RECORD_LAYOUT _REC_VAL_20_u4 FNC_VALUES 1 ULONG COLUMN_DIR DIRECT /end RECORD_LAYOUT
/begin RECORD_LAYOUT _REC_MAP_52_UBYTE_s2_s2_u2 NO_AXIS_PTS_X 1 UBYTE NO_AXIS_PTS_Y 2 UBYTE AXIS_PTS_X 3 SWORD INDEX_INCR DIRECT AXIS_PTS_Y 4 UWORD INDEX_INCR DIRECT FNC_VALUES 5 SWORD COLUMN_DIR DIRECT /end RECORD_LAYOUT
/begin RECORD_LAYOUT _REC_MAP_52_UBYTE_u2_s2_s2 NO_AXIS_PTS_X 1 UBYTE NO_AXIS_PTS_Y 2 UBYTE AXIS_PTS_X 3 SWORD INDEX_INCR DIRECT AXIS_PTS_Y 4 SWORD INDEX_INCR DIRECT FNC_VALUES 5 UWORD COLUMN_DIR DIRECT /end RECORD_LAYOUT
/begin RECORD_LAYOUT _REC_MAP_52_UBYTE_u2_u2_u2 NO_AXIS_PTS_X 1 UBYTE NO_AXIS_PTS_Y 2 UBYTE AXIS_PTS_X 3 UWORD INDEX_INCR DIRECT AXIS_PTS_Y 4 UWORD INDEX_INCR DIRECT FNC_VALUES 5 UWORD COLUMN_DIR DIRECT /end RECORD_LAYOUT
/begin RECORD_LAYOUT _REC_MAP_52_u1_s2_s2 NO_AXIS_PTS_X 1 UBYTE NO_AXIS_PTS_Y 2 UBYTE AXIS_PTS_X 3 SWORD INDEX_INCR DIRECT AXIS_PTS_Y 4 SWORD INDEX_INCR DIRECT FNC_VALUES 5 UBYTE COLUMN_DIR DIRECT /end RECORD_LAYOUT
/begin RECORD_LAYOUT _REC_MAP_52_UBYTE_s2_s2_s2 NO_AXIS_PTS_X 1 UBYTE NO_AXIS_PTS_Y 2 UBYTE AXIS_PTS_X 3 SWORD INDEX_INCR DIRECT AXIS_PTS_Y 4 SWORD INDEX_INCR DIRECT FNC_VALUES 5 SWORD COLUMN_DIR DIRECT /end RECORD_LAYOUT
/begin RECORD_LAYOUT _REC_MAP_52_UBYTE_u2_u2_s2 NO_AXIS_PTS_X 1 UBYTE NO_AXIS_PTS_Y 2 UBYTE AXIS_PTS_X 3 UWORD INDEX_INCR DIRECT AXIS_PTS_Y 4 SWORD INDEX_INCR DIRECT FNC_VALUES 5 UWORD COLUMN_DIR DIRECT /end RECORD_LAYOUT
/begin RECORD_LAYOUT _REC_CUR_TKL_UW_VV__u2_u2 NO_AXIS_PTS_X 1 UBYTE RESERVED 2 BYTE AXIS_PTS_X 3 UWORD INDEX_INCR DIRECT FNC_VALUES 4 UWORD COLUMN_DIR DIRECT /end RECORD_LAYOUT
/begin RECORD_LAYOUT _REC_CUR_TKL_UW_VV__u2_s2 NO_AXIS_PTS_X 1 UBYTE RESERVED 2 BYTE AXIS_PTS_X 3 SWORD INDEX_INCR DIRECT FNC_VALUES 4 UWORD COLUMN_DIR DIRECT /end RECORD_LAYOUT
/begin RECORD_LAYOUT _REC_CUR_TKL_UW_VV__u1_s2 NO_AXIS_PTS_X 1 UBYTE RESERVED 2 BYTE AXIS_PTS_X 3 SWORD INDEX_INCR DIRECT FNC_VALUES 4 UBYTE COLUMN_DIR DIRECT /end RECORD_LAYOUT
/begin RECORD_LAYOUT _REC_CUR_TKL_UW_VV__u1_u2 NO_AXIS_PTS_X 1 UBYTE RESERVED 2 BYTE AXIS_PTS_X 3 UWORD INDEX_INCR DIRECT FNC_VALUES 4 UBYTE COLUMN_DIR DIRECT /end RECORD_LAYOUT
/begin RECORD_LAYOUT _REC_CUR_TKL_UW_VV__s2_u2 NO_AXIS_PTS_X 1 UBYTE RESERVED 2 BYTE AXIS_PTS_X 3 UWORD INDEX_INCR DIRECT FNC_VALUES 4 SWORD COLUMN_DIR DIRECT /end RECORD_LAYOUT
/begin RECORD_LAYOUT _REC_CUR_TKL_UW_VV__s2_s2 NO_AXIS_PTS_X 1 UBYTE RESERVED 2 BYTE AXIS_PTS_X 3 SWORD INDEX_INCR DIRECT FNC_VALUES 4 SWORD COLUMN_DIR DIRECT /end RECORD_LAYOUT
/begin RECORD_LAYOUT _REC_CUR_TKL_UW_VV__u1_u1 NO_AXIS_PTS_X 1 UBYTE RESERVED 2 BYTE AXIS_PTS_X 3 UBYTE INDEX_INCR DIRECT FNC_VALUES 4 UBYTE COLUMN_DIR DIRECT /end RECORD_LAYOUT
/begin RECORD_LAYOUT _REC_CUR_TKL_UW_VV__S4_S4 NO_AXIS_PTS_X 1 UBYTE RESERVED 2 BYTE AXIS_PTS_X 3 FLOAT32_IEEE INDEX_INCR DIRECT FNC_VALUES 4 FLOAT32_IEEE COLUMN_DIR DIRECT /end RECORD_LAYOUT
/begin RECORD_LAYOUT _REC_CUR_TKL_UW_VV__s1_s2 NO_AXIS_PTS_X 1 UBYTE RESERVED 2 BYTE AXIS_PTS_X 3 SWORD INDEX_INCR DIRECT FNC_VALUES 4 SBYTE COLUMN_DIR DIRECT /end RECORD_LAYOUT
/begin RECORD_LAYOUT _REC_CUR_TKL_UW_VV__s1_s1 NO_AXIS_PTS_X 1 UBYTE RESERVED 2 BYTE AXIS_PTS_X 3 SBYTE INDEX_INCR DIRECT FNC_VALUES 4 SBYTE COLUMN_DIR DIRECT /end RECORD_LAYOUT
/begin FUNCTION MDRES ""
 /begin DEF_CHARACTERISTIC K_MDRESMN_FGRHYS K_MDRESMN_HYS K_MDRES_MN K_MDRES_MNFGR S_KHDI /end DEF_CHARACTERISTIC
 /begin OUT_MEASUREMENT Eta_res Eta_zw_minres Md_res Md_res_anf Md_res_anf1 Md_res_katreg Md_res_max Mdi_fzdyn_korr Mdi_fzdyn_korr1 Mdi_res Mdi_res_anf Mdi_res_anfkh Mdi_res_anfmx Mdi_res_max Mdi_res_maxll Mdk_res Ms_res_max Rf_res_max St_mdres St_mdres.B_md_res St_mdres.B_mdres_akt /end OUT_MEASUREMENT
/end FUNCTION
/begin FUNCTION MDRESKRLL ""
 /begin DEF_CHARACTERISTIC KL_DZW_KRFR KL_DZW_KRSP KL_MDRESKRLL K_DZWKRLLMNS K_DZWKRLLMX K_DZWKRMN S_MDRES_KRLL /end DEF_CHARACTERISTIC
 /begin OUT_MEASUREMENT Dzw_krkorll Dzw_krkorlls Md_res_krll St_mdreskrll St_mdreskrll.B_mdres_krll St_mdreskrll.B_zwe_krll /end OUT_MEASUREMENT
/end FUNCTION
/begin FUNCTION MDRFMXATL ""
 /begin DEF_CHARACTERISTIC KF_FRFMXKRK KF_FRFMXKRL KF_FRFMXKROB KF_FRFMXTALD KF_PLDMXNTA KF_PLDMXNTA_S KL_FRFMXTMLD KL_FUPSRF_ATL KL_LAMX_ATL KL_LAMX_ATLS KL_LDRFKRA KL_PIRG_ATL KL_PLDMXN KL_RFMXELDO KL_TKKRLDAB KL_TKKRLDAUF KL_TLKRLDAB KL_TLKRLDAUF S_ATL_FSP /end DEF_CHARACTERISTIC
 /begin OUT_MEASUREMENT Ddzw_ldkr Dzw_ldkr Dzw_ldkrdyn Dzw_ldkrob Dzw_ldkrstat Frfmxkrld Frfmxkrldk Frfmxkrldl Frfmxkrob Frfmxtald Frfmxtmld Rfmxatl Rfmxkorr Rfmxldms Rfmxldts St_mdrfmxatl_intern St_mdrfmxatl_intern.B_bgrfmxld /end OUT_MEASUREMENT
/end FUNCTION
/begin FUNCTION MDRK ""
 /begin DEF_CHARACTERISTIC CW_KHM KF_AGR KF_ETARKTE_S KF_ETATEMIN_S KF_FRK2_H KF_FRKKORRF_1 KF_FRKKORRF_2 KF_FRKSTRED KF_LABAS_H KF_MDIBAS_HS KF_MDIBAS_S KF_MDIMIN_HS KF_MDIMIN_S KF_RFBAS_HS KF_RFBAS_S KF_RFMINKH_S KF_RFMINSA_1 KF_RFMINTE_S KF_RFMIN_1 KF_RFOPT_HS KF_RFOPT_S KF_RK2_HS KF_RK2_S KF_RKMAXBG_HS KF_RKMAXBG_S KF_RKMINBG_HS KF_RKMINBG_S KF_RKMIN_H KF_RKSTART KL_ETAESTE_S KL_ETALAMTE_S KL_ETARF_HS KL_ETARF_S KL_FDRFTE KL_FRK2ST_H KL_FRKSTP KL_FRKVL_HS KL_FRKVL_S KL_KHMAX_S KL_PRAIL_MIN KL_RFGRDMAX KL_RKMINDOE_HS KL_RKMINDOE_S KL_RKVLO_HS KL_RKVLO_S KL_RKVLU_HS KL_RKVLU_S K_DLASOLL_MAX K_DMDKW_MX K_DRFAGRMX K_DRFSOLL_FILT K_DRFTEMX K_ETAMAX_SPLIT K_ETA_KH_S K_FDRFSOLL_FILT K_FRK2APP_H K_KHHYS_S K_LAMDMAX K_LAMIN_H K_MDIZWSCHW K_P_HDSTABBR K_RFAPP K_RK2APP_HS K_RK2APP_S K_RK2MIN_H K_RK3APP_S K_RK3MIN_S K_RKADDAPP_H K_RKAPP_H K_RKAPP_HS K_RKAPP_S K_RKHYSDOE_HS K_RKHYSDOE_S K_RKSOLL3APP_H K_RKTEVAPP_S K_RKTE_MAX K_TD_MAXRFFIL K_TMOTMINHS_HYS K_TMOTMINS_HYS K_TMOTMIN_HDST K_TMOTMIN_HS K_TMOTMIN_S K_UFAKRKMK K_ZKRFSOLL1 K_ZKRFSOLL2 K_ZK_MDIZWFIL K_ZYKLHD_MAX S_AGRIG_SOLL S_FRK2APP_H S_LA_SOLL_KO S_LA_SPUEL S_MDRKHOM S_RFAPP S_RFSOLLFIL_APP S_RFSOLLFIL_ON S_RK2APP_HS S_RK2APP_S S_RK3APP_S S_RKAPP_H S_RKAPP_HS S_RKAPP_S S_RKTEVAPP_S S_SCH_CLC S_ZWMINFIL_AUS /end DEF_CHARACTERISTIC
 /begin OUT_MEASUREMENT Anzzykl_hd Dlasoll_stat12 Drf_agr_s Drf_soll Drf_te_s Drfopt_hs Drfopt_s Drfoptres_hs Drfoptres_s Eta_bas_s Eta_hs Eta_lamte_s Eta_rkte_s Eta_te_s Eta_zwsoll Etarf_hs Etarf_s Etarfres_hs Etarfres_s F_drfte_s F_etatemin_s F_rk2_h F_rkkorrf La_bas_h La_soll_h La_soll_stat1 La_soll_stat2 La_sollreg1 La_sollreg2 Lamb_es_s Lamb_te Mdi_bas_hs Mdi_bas_s Mdi_min_ba Mdi_min_hs Mdi_min_s Mdi_ressoll Mdi_zw_min Mdi_zw_sollf Mdi_zwmin_fil Mk_hom_soll_1 Mk_hom_soll_2 Mk_soll_h Mk_soll_s Mkzyl_soll_hs Mkzyl_soll_s Rf_agr_s Rf_bas_hs Rf_bas_s Rf_kh_s Rf_max_agr Rf_min Rf_opt_hs Rf_opt_s Rf_optres_hs Rf_optres_s Rf_soll Rf_soll_h Rf_soll_hs Rf_soll_s Rf_te_s Rfgrdmax Rfmin_kh_s Rfmin_te_s Rk1_hs Rk1_s Rk2_hs Rk2_s Rk3_khkh_s Rk3_khmdi_s Rk3_khsoll_s Rk3_soll_s Rk3maxmdi Rk_bas_h Rk_bas_hs Rk_bas_s Rk_kh Rk_kor_h Rk_kor_hs Rk_kor_s Rk_korres_hs Rk_korres_s Rk_korzw_h Rk_lamreg Rk_laprio_h Rk_max_h Rk_maxbg_hs Rk_maxbg_s Rk_mdprio_h Rk_min_h Rk_minbg_hs Rk_minbg_s Rk_opt_h Rk_opt_hs Rk_opt_s Rk_optres_hs Rk_optres_s Rk_soll Rk_soll_h Rk_soll_hs Rk_soll_s Rk_sollm_h Rk_sollm_hs Rk_sollm_s Rk_sollstart Rk_solltmp_s Rk_vlo_hs Rk_vlo_s Rk_vlu_hs Rk_vlu_s Rksoll_h Rksoll_h1 Rksoll_h2 Rksoll_hs Rksoll_s Rkte_kh Rkte_kh_s Rkte_max Rkte_md Rkte_md_s St_bvmdi St_mdrk St_mdrk.B_doe_h St_mdrk.B_doe_hs St_mdrk.B_doe_s St_mdrk.B_f_nobv St_mdrk.B_la_prio St_mdrk.B_laprio_h St_mdrk.B_rk_resmax St_mdrk2 St_mdrk2.B_espr_start St_mdrk2.B_hd_start St_mdrk2.B_hsplit St_mdrk2.B_klopfen_s St_mdrk2.B_nesps St_mdrk2.B_rfsollfil_dec St_mdrk2.B_rfsollfil_inc St_mdrk2.B_zwladif /end OUT_MEASUREMENT
/end FUNCTION
/begin FUNCTION MLP "" /begin DEF_CHARACTERISTIC KL_INVTANSIG KL_TANSIG /end DEF_CHARACTERISTIC /end FUNCTION
/begin FUNCTION MSLAM ""
 /begin DEF_CHARACTERISTIC CW_MDMSLAM_CONFB1 CW_MDMSLAM_CONFB2 KF_RKLAM_KOR KF_TDRKLAM KF_TDRKLAMF KL_DRFSOLL_MSLAM KL_KORRKFVST KL_LALIUS KL_RKUKG_MSLAM KL_TDRFSOLL_MSLAM K_DRFSPUELMN_MSLAM K_ETAZYLAUS_MSLAM K_FMSLAMON K_LAMMNMSLAM K_LAMMXMSLAM K_TD_MSLAMKW K_TD_SPUELSPERR K_TMDMSLMD_OFF K_TVSAMSLAM K_TVSAVMSLAM S_BERMSLAMON S_LAM_SON S_MDARV_AKT S_MSLAMMDSTP_ENTP S_MSTE_KOR S_RKTEV_KOR S_TEMSLAM S_TEMXMSLAM /end DEF_CHARACTERISTIC
 /begin OUT_MEASUREMENT La_ist1 La_ist2 La_ist_m Mslam Mslam1 Mslam2 Rflam Rflam2 Rk_1_td Rk_1_tdf Rk_2_td Rk_2_tdf St_mslam St_mslam.B_emslam St_mslam.B_emslam2 St_mslam.B_emslam2_tmp St_mslam.B_emslam_tmp St_mslam.B_lamsonden_ok St_mslam.B_mslam_fg St_mslam.B_mslam_on St_mslam.B_sa_fe St_mslam2 St_mslam2.B_drfsoll_dyn St_mslam2.B_mdarv_latched St_mslam2.B_mslamstp_md St_mslam2.B_mslamstp_md2 St_mslam2.B_sasmg St_mslam2.B_spuelmslam_off Td_mslam Td_mslampt1 Td_mszyl Td_mszyl_kw Td_vwl Zyl_misfire_diag /end OUT_MEASUREMENT
/end FUNCTION
/begin FUNCTION NO_FUNCTION "" /end FUNCTION
/begin FUNCTION OZBG "" /begin DEF_CHARACTERISTIC K_CW_OZ_2 K_OZZYKCBS /end DEF_CHARACTERISTIC
 /begin OUT_MEASUREMENT Bosbtvfbk Bosfxid2 Bosid2 Bosjziel Bosmziel Bosprog2 Bosres Bosrlsm Bosrw2 Bosstate Id_bosmg Id_bosmgt Id_bosmsg Oz_reset Oz_tempakt St_ozbg0 St_ozbg0.B_bosmsgc St_ozbg0.B_mol_vb St_ozbg0.B_mol_vl St_ozbg0.B_oeltemp St_ozbg0.B_oelverb St_ozbg0.B_oelverl St_ozbg_nv0 St_ozbg_nv0.B_ozkl15 Toel Toel_oz Zrbosmld /end OUT_MEASUREMENT
/end FUNCTION
/begin FUNCTION OZGG ""
 /begin DEF_CHARACTERISTIC KL_OZPERMKL KL_OZTEMPKL K_OZBZKMSTK1 K_OZKMUPL K_OZNIVKL K_OZPERMRMIN K_OZPRREFMAX K_OZPRREFMIN K_OZRESBOST K_OZSTZYK /end DEF_CHARACTERISTIC
 /begin OUT_MEASUREMENT Oz_kmlow Oz_lowcnt Oz_lowkm Oz_lowperex Oz_lowperm0 Oz_lowrwanz Oz_manip Oz_manipt Oz_niv Oz_nivrers Oz_nivt Oz_oelkm Oz_perm Oz_permakt Oz_permt Oz_perref Oz_rwprueck Oz_rwrueck Oz_svcntchg Oz_temp Oz_tempt Oz_vfbdmew Oz_zjbdmew Oz_zmbdmew St_ozgg0 St_ozgg0.B_oelwech St_ozgg0.B_ozniv St_ozgg0.B_ozperm St_ozgg0.B_oztemp St_ozgg0.B_ozvfchg St_ozgg0.B_ozvfchgt St_ozgg0.B_ozzeitdmew St_ozgg0.B_svcntchg St_ozgg1 St_ozgg1.B_ozmanip St_ozgg1.B_ozreset St_ozgg1.B_ozresetcan St_ozgg1.B_ozresett St_ozgg1.B_ozvfchgc St_ozgg1.B_ozvfchgcc St_ozgg_nv0 St_ozgg_nv0.B_dmeini St_ozgg_nv0.B_dmewech St_ozgg_nv0.B_factoryres /end OUT_MEASUREMENT
/end FUNCTION
/begin FUNCTION OZLEIT "" /begin OUT_MEASUREMENT Oz_leit_dum /end OUT_MEASUREMENT /end FUNCTION
/begin FUNCTION OZNIVDL ""
 /begin DEF_CHARACTERISTIC KF_OZKORRNIV KF_OZKORRORI KF_OZZEIT KL_OZBEFKL KL_OZKRZMW2 KL_OZLBNIV KL_OZLN KL_OZNFDELTA KL_OZNMNIVKL KL_OZORBERO KL_OZQBNIV KL_OZSTNIV KL_TKTOENIV KL_TOGNKOR KL_TVTOEL K_CW_OZ K_DOLNIV K_NACHFUELL12 K_NACHFUELL25 K_NACHFUELL38 K_NACHFUELL53 K_NACHFUELL69 K_NACHFUELL85 K_NACHFUELL95 K_OZABSTELL K_OZALTANZABZ K_OZBESCHAUS K_OZKEINLUFT K_OZLBESCHN K_OZLBESCHORI K_OZLBESCHP K_OZLBESCHST K_OZLUFTMAX K_OZMAXSLOPE K_OZMINSLOPE K_OZMWK K_OZMWL K_OZMWOR K_OZMWV K_OZNFCNT K_OZNFERR K_OZNFML K_OZNFOELCKO K_OZNFOELCOK K_OZNFTMPMAX K_OZNFTMPMIN K_OZNIVMMLIT K_OZNIVNFM05 K_OZNIVNFM10 K_OZNMOTMAX K_OZNMOTMIN K_OZOELCABZ K_OZOELCOK K_OZOELCVERZ K_OZOELVERB K_OZORBERU K_OZORIPEILTZO K_OZORIPEILTZU K_OZPEIL12 K_OZPEIL25 K_OZPEIL38 K_OZPEIL53 K_OZPEIL69 K_OZPEIL85 K_OZPEILDO K_OZPEILDOMIN K_OZPEILDU K_OZPEILDU38 K_OZPEILERR K_OZPEILKSPR K_OZPEILLP85 K_OZPEILML K_OZPEILOELCKO K_OZPEILOELCOK K_OZPEILSPRUNG K_OZQBESCHN K_OZQBESCHORI K_OZQBESCHP K_OZQBESCHST K_OZSTANDVERZ K_OZSTARTABZ K_OZSTARTVERZ K_OZSTMINW K_OZTEMPBW K_OZTORMAX K_OZTORMIN K_OZUEBERF K_OZUEFCNT K_OZUEFNLB K_OZUEFNQB K_OZUEFNST K_OZUEFODZ K_OZUEFPLB K_OZUEFPQB K_OZUEFPST K_OZUEFTEM K_OZUEFUDZ K_OZUEFVERZ K_OZVERBDKM K_OZVERBFAK K_OZVERLORI K_OZVERZERRBSD K_OZVORMV K_OZVORPEILMIN K_OZZEITST K_PT1NMOT K_PT1TOEL K_TOGANZ K_TOGKURZANZ K_TOGMWK K_TOGNMAX K_TOGNMIN K_TOGORIANZ K_TOGSTARTVERZ K_TOGTMORIMAX K_TOGTMORIMIN K_TOGTMOT K_TOGVERBKZ K_TOGVERBNOR K_TOGVERLKZ K_TOGVERLNOR K_TOGVERZOEG K_TRTYP /end DEF_CHARACTERISTIC
 /begin OUT_MEASUREMENT N_ozmw Oz_abstellm Oz_beschcnt Oz_dkm Oz_hoehe Oz_krz2cnt Oz_krzcnt Oz_krzkor2 Oz_krzkor2k Oz_krzmw Oz_krzmwkor Oz_krzor Oz_langmw Oz_lbmw Oz_lgmwcnt Oz_lp Oz_lv Oz_nivakt Oz_nivkor Oz_nivkrzt Oz_nivlangt Oz_nivlit Oz_nivnfm Oz_nivzeit Oz_nmotf Oz_nmotfm Oz_oelnivak Oz_oelnivaknk Oz_oelnivkurz Oz_oelnivm Oz_oelnivnorm Oz_oelnivori Oz_oelverbr Oz_oricnt Oz_orikor Oz_peil Oz_peilaltanz Oz_peilkm Oz_peilkmalt Oz_peillang Oz_peiloben Oz_peilunten Oz_pzdivp Oz_qbmw Oz_rwpeil Oz_steigung Oz_testtoel2 Oz_tog_i Oz_togbwi Oz_togki Oz_uefcnt Oz_uefzcnt Oz_verbkmalt Oz_verbnivalt Oz_vormw Oz_vormwcnt St_oznivdl0 St_oznivdl0.B_oelnivnorm St_oznivdl0.B_ozkrzkor St_oznivdl0.B_ozkrzl St_oznivdl0.B_ozkrzlkor St_oznivdl0.B_ozlangmw St_oznivdl0.B_oznivb St_oznivdl0.B_ozor St_oznivdl0.B_ozvormw St_oznivdl1 St_oznivdl1.B_ozfahrt St_oznivdl1.B_ozkrzkor2 St_oznivdl1.B_ozkrzkornb St_oznivdl1.B_ozml St_oznivdl1.B_ozmreset St_oznivdl1.B_ozoelcheck St_oznivdl1.B_ozoelchok St_oznivdl1.B_ozueberf St_oznivdl_nv0 St_oznivdl_nv0.B_ozabzlang St_oznivdl_nv0.B_ozlmwneu St_oznivdl_nv0.B_ozlw1 St_oznivdl_nv0.B_oznachf St_oznivdl_nv0.B_ozoelwech St_oznivdl_nv0.B_ozpeilerr /end OUT_MEASUREMENT
/end FUNCTION
/begin FUNCTION OZPERM ""
 /begin DEF_CHARACTERISTIC K_OZOELKMPL K_OZPERMCOK5 K_OZPERMMIN K_OZPERMMNIV K_OZPERMNK3 K_OZPERMTIK6 K_OZPERMTIK8 K_OZPERMTIK9 K_OZPERMTK12 K_OZPERMTK13 K_OZPERMTK4 K_OZPERMTK7 /end DEF_CHARACTERISTIC
 /begin OUT_MEASUREMENT Oz_dpermsi Oz_kmreg Oz_nivkm Oz_permanz Oz_permex Oz_permlow Oz_permoff Oz_permoff_oz Oz_permreg Oz_prfstrg Oz_todeltime St_ozperm0 St_ozperm0.B_calcdper St_ozperm0.B_ozpermgl St_ozperm0.B_ozpermpl St_ozperm0.B_ozpermpld St_ozperm_nv0 St_ozperm_nv0.B_ozdperm St_ozperm_nv0.B_ozer0ok St_ozperm_nv0.B_ozeranz St_ozperm_nv0.B_ozerplt St_ozperm_nv0.B_ozper0ok St_ozperm_nv0.B_ozregstg /end OUT_MEASUREMENT
/end FUNCTION
/begin FUNCTION OZRESTKM ""
 /begin DEF_CHARACTERISTIC KL_OZVERDFAK K_OZANFANZ K_OZDAEMPF K_OZKMMAXK11 K_OZKVB96 K_OZKVB96A K_OZKVBMXK18 K_OZKVBOK16 K_OZLF1 K_OZLF2 K_OZMNKMBO K_OZMXOHK15 K_OZOELMEN K_OZPERBOK17 K_OZPERBRK14 K_OZPERXK10 K_OZTAGCTERR K_OZUEBERTEMP K_OZUTFAK K_OZZEITFAKT K_OZZEITINT /end DEF_CHARACTERISTIC
 /begin OUT_MEASUREMENT Oz_cttagini Oz_intprog Oz_kmstrw0 Oz_kvbdiff Oz_kvbmw Oz_kvbmwtmp Oz_kvbmx Oz_kvbog Oz_kvbsm Oz_kvbsm_ul Oz_kvbtmp2 Oz_lf1t Oz_lf2t Oz_litges Oz_litgesk Oz_nivlanglit Oz_oelzeit Oz_oelzeitt Oz_permbog Oz_rwanz Oz_rwde Oz_rwkvb Oz_rwp Oz_rwperm Oz_rwprog Oz_rwzeit Oz_utzeit Oz_vfanz Oz_vfkvb Oz_vfperm Oz_vfzeit Oz_zieljahr Oz_zielmon St_ozrestkm_0 St_ozrestkm_0.B_oznoperm St_ozrestkm_nv0 St_ozrestkm_nv0.B_ozcntini St_ozrestkm_nv0.B_ozini St_ozrestkm_nv0.B_ozvfk St_ozrestkm_nv0.B_rwanz0 /end OUT_MEASUREMENT
/end FUNCTION
/begin FUNCTION OZTEMP "" /begin DEF_CHARACTERISTIC KF_OZTEMPMDL K_OZTLPF K_OZTLPFMDL /end DEF_CHARACTERISTIC /begin OUT_MEASUREMENT Oz_tempf Oz_tempmdl /end OUT_MEASUREMENT /end FUNCTION
/begin FUNCTION OZVISC "" /begin OUT_MEASUREMENT Oz_visc_dum /end OUT_MEASUREMENT /end FUNCTION
/begin FUNCTION PGENLLRED ""
 /begin DEF_CHARACTERISTIC KL_GELIKMIE K_DELTADFFMX K_DFFLIM K_DFFLLANH K_DFFSCHZMX K_GELIIEAPP K_GELIIEZK K_GELISETAPP K_GELIVMAX K_LLWDNMAX K_LLWDNMIN K_NMOTLLANH K_NSTATLLANH K_PWGLLANH K_TDFDTMAX K_TDFFABLF K_TDFFMAX K_TDFFMIN K_TDNHOLD K_TMOTLLANH K_TNSTLLANH K_VFZGGENFIL K_VFZGGENKOR K_VFZGLLANH S_GELIBIEAPP S_PGENLL_AKT /end DEF_CHARACTERISTIC
 /begin OUT_MEASUREMENT Deltadff Dffgenschz Dnkw Ierrgrenz_ll St_pgenllred St_pgenllred.B_geli St_pgenllred.B_nsubgen St_pgenllred.B_pgenllerk St_pgenllred_200ms St_pgenllred_200ms.B_dffaktiv St_pgenllred_200ms.B_nsubg_r St_pgenllred_200ms.B_nsubgen1 St_pgenllred_200ms.B_pgenllfa St_pgenllred_200ms.B_pgenredllve Tdffgen V_pgenllkor /end OUT_MEASUREMENT
/end FUNCTION
/end MODULE
/end PROJECT
