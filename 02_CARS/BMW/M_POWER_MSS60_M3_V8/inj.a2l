ASAP2_VERSION 1 30
/begin PROJECT MSS65-inj "Generiert am 14.10.05 um 11:34:36"
/begin HEADER "" VERSION "R341" /end HEADER
/begin MODULE _MSS65-inj "Generiert am 14.10.05 um 11:34:36"
/begin MOD_COMMON "" BYTE_ORDER MSB_FIRST ALIGNMENT_BYTE 1 ALIGNMENT_WORD 2 ALIGNMENT_LONG 4 ALIGNMENT_FLOAT32_IEEE 4 ALIGNMENT_FLOAT64_IEEE 8 /end MOD_COMMON
/begin CHARACTERISTIC K_IPK_INJ_T_SYNC_MAX "Wartezeit INJ auf IGN" VALUE 0x72E44 TKW_VV_VV_UL 100.0 FORMULA_0352 0.0 500.0 FORMAT "%4.1" /end CHARACTERISTIC
/begin CHARACTERISTIC K_KATS_CFG "Schalter fuer KATS Konfig" VALUE 0x72E5C TKW_VV_VV_UB 100.0 FORMULA_0729 0.0 255.0 /end CHARACTERISTIC
/begin CHARACTERISTIC K_KATS_I_MAX "Max I-Anteil" VALUE 0x72E4E TKW_VV_VV_SW 100.0 FORMULA_0025 0.0 0.4000000059604645 FORMAT "%6.3" /end CHARACTERISTIC
/begin CHARACTERISTIC K_KATS_I_MIN "Max I-Anteil" VALUE 0x72E50 TKW_VV_VV_SW 100.0 FORMULA_0199 -0.4000000059604645 0.0 FORMAT "%7.4" /end CHARACTERISTIC
/begin CHARACTERISTIC K_KATS_LAM_GRAD_NEG "Aenderungsbegr. neg" VALUE 0x72E4C TKW_VV_VV_UW 100.0 FORMULA_0728 0.0 3.999000072479248 FORMAT "%6.3" /end CHARACTERISTIC
/begin CHARACTERISTIC K_KATS_LAM_GRAD_POS "Aenderungsbegr. pos" VALUE 0x72E4A TKW_VV_VV_UW 100.0 FORMULA_0728 0.0 3.999000072479248 FORMAT "%6.3" /end CHARACTERISTIC
/begin CHARACTERISTIC K_KATS_LAM_MIN "Lambda min fuer Katschutz" VALUE 0x72E48 TKW_VV_VV_UW 100.0 FORMULA_0025 0.0 3.999000072479248 FORMAT "%6.3" /end CHARACTERISTIC
/begin CHARACTERISTIC K_KATS_LAM_P_DELTA_MAX "Gradientenschwelle fuer Uergang Einfangen -> Eingeregelt" VALUE 0x72E54 TKW_VV_VV_SW 100.0 FORMULA_0199 -2.0 1.999899983406067 FORMAT "%7.4" /end CHARACTERISTIC
/begin CHARACTERISTIC K_KATS_T_LAM_MIN "Fehlerzeit in der kats_lam_soll gleich K_KATS_LAM_MIN" VALUE 0x72E5A TKW_VV_VV_UW 100.0 FORMULA_0071 0.0 6553.5 FORMAT "%4.1" /end CHARACTERISTIC
/begin CHARACTERISTIC K_KATS_T_MAX "Maximale Kattemperatur" VALUE 0x72E52 TKW_VV_VV_SW 100.0 FORMULA_0023 300.0 1100.0 FORMAT "%4.1" /end CHARACTERISTIC
/begin CHARACTERISTIC K_KATS_T_MAX_PST "Maximale Kattemperatur fuer Pruefstand" VALUE 0x72E56 TKW_VV_VV_SW 100.0 FORMULA_0023 300.0 1100.0 FORMAT "%4.1" /end CHARACTERISTIC
/begin CHARACTERISTIC K_KATS_TKAT_MESS_MAX "Maximale Kattemperatur fuer Diagnose" VALUE 0x72E58 TKW_VV_VV_SW 100.0 FORMULA_0023 -80.0 1400.0 FORMAT "%4.1" /end CHARACTERISTIC
/begin CHARACTERISTIC K_KGE_AX_BERG "Laengsbeschleunigung-Berg f. Sperren" VALUE 0x72EB4 TKW_VV_VV_SW 100.0 FORMULA_0123 -20.0 20.0 FORMAT "%5.2" /end CHARACTERISTIC
/begin CHARACTERISTIC K_KGE_AY "Querbeschleunigung f. Sperren" VALUE 0x72EB2 TKW_VV_VV_SW 100.0 FORMULA_0123 -20.0 20.0 FORMAT "%5.2" /end CHARACTERISTIC
/begin CHARACTERISTIC K_KGE_HFM_TAU "Tau fuer hfm_5ms" VALUE 0x72EA6 TKW_VV_VV_UB 100.0 FORMULA_0645 5.100000184029341e-003 1.279999971389771 /end CHARACTERISTIC
/begin CHARACTERISTIC K_KGE_LL_T_DELAY "Delayzeit fuer Diagnose-Start im LL" VALUE 0x72EA8 TKW_VV_VV_UW 100.0 FORMULA_0021 0.0 655.0 FORMAT "%5.2" /end CHARACTERISTIC
/begin CHARACTERISTIC K_KGE_LL_T_DIAG "LL-Zeit nach der die Diagnose ausgewertet wird" VALUE 0x72EAA TKW_VV_VV_UW 100.0 FORMULA_0021 0.0 655.0 FORMAT "%5.2" /end CHARACTERISTIC
/begin CHARACTERISTIC K_KGE_OZ_NIVR_MAX "Sperrniveau fuer max Oelniveau" VALUE 0x72EBB TKW_VV_VV_UB 100.0 FORMULA_0436 0.0 74.70700073242188 /end CHARACTERISTIC
/begin CHARACTERISTIC K_KGE_OZ_NIVR_MIN "Sperrniveau fuer min Oelniveau" VALUE 0x72EB8 TKW_VV_VV_UB 100.0 FORMULA_0731 0.1000000014901161 75.0 /end CHARACTERISTIC
/begin CHARACTERISTIC K_KGE_PUMG_MAX "Sperrniveau fuer max Pumg" VALUE 0x72EBC TKW_VV_VV_SW 100.0 FORMULA_0075 400.0 1200.0 FORMAT "%4.1" /end CHARACTERISTIC
/begin CHARACTERISTIC K_KGE_RSTART_T "Zeit nach abgelaufener Diagnose bis Diagnose neu startet" VALUE 0x72EAC TKW_VV_VV_UW 100.0 FORMULA_0021 0.0 655.0 FORMAT "%5.2" /end CHARACTERISTIC
/begin CHARACTERISTIC K_KGE_SEG_IDX_INTG "Segmentindex fuer das Abweichungsintegral" VAL_BLK 0x72EB9 TKW_VV_VV_UB 100.0 FORMULA_0037 0.0 255.0 NUMBER 2 /end CHARACTERISTIC
/begin CHARACTERISTIC K_KGE_TIME_ML "Sperrzeit Diagnose nach Start" VALUE 0x72EB6 TKW_VV_VV_UW 100.0 FORMULA_0021 0.0 655.0 FORMAT "%5.2" /end CHARACTERISTIC
/begin CHARACTERISTIC K_KGE_TMOT "TMOT-Schwelle f. Freigabe" VALUE 0x72EAE TKW_VV_VV_SW 100.0 FORMULA_0023 -50.0 170.0 FORMAT "%4.1" /end CHARACTERISTIC
/begin CHARACTERISTIC K_KGE_TOEL "TOEL-Schwelle f. Freigabe" VALUE 0x72EB0 TKW_VV_VV_SW 100.0 FORMULA_0023 -50.0 170.0 FORMAT "%4.1" /end CHARACTERISTIC
/begin CHARACTERISTIC K_KW_ED_DELTA_N "Max zul. Nockenwellendrehzahl im Startversuch bei n immer noch null." VALUE 0x72F32 TKW_VV_VV_SW 100.0 FORMULA_0006 0.0 10000.0 /end CHARACTERISTIC
/begin CHARACTERISTIC K_KW_ED_DELTA_N_RATE "Fehlerrate Startversuch." VALUE 0x72F38 TKW_VV_VV_UW 100.0 FORMULA_0010 0.0 65535.0 /end CHARACTERISTIC
/begin CHARACTERISTIC K_KW_ED_DELTA_U "Max zul. Abweichung der mittleren Differenzspannung." VALUE 0x72F36 TKW_VV_VV_SW 100.0 FORMULA_0114 0.0 1023.0 /end CHARACTERISTIC
/begin CHARACTERISTIC K_KW_ED_MAX_RATE "Max zul. Fehlerrate." VALUE 0x72F40 TKW_VV_VV_UW 100.0 FORMULA_0010 0.0 65535.0 /end CHARACTERISTIC
/begin CHARACTERISTIC K_KW_ED_N_DROP "Max zul. Abrissdrehzahl." VALUE 0x72F34 TKW_VV_VV_SW 100.0 FORMULA_0006 0.0 10000.0 /end CHARACTERISTIC
/begin CHARACTERISTIC K_KW_ED_N_DROP_RATE "Fehlerrate Abriss." VALUE 0x72F3A TKW_VV_VV_UW 100.0 FORMULA_0010 0.0 65535.0 /end CHARACTERISTIC
/begin CHARACTERISTIC K_KW_ED_SH_TO_GND_RATE "Fehlerrate Kurzschluss nach Masse." VALUE 0x72F3E TKW_VV_VV_UW 100.0 FORMULA_0010 0.0 65535.0 /end CHARACTERISTIC
/begin CHARACTERISTIC K_KW_ED_SH_TO_UB_RATE "Fehlerrate Kurzschluss nach Ub." VALUE 0x72F3C TKW_VV_VV_UW 100.0 FORMULA_0010 0.0 65535.0 /end CHARACTERISTIC
/begin CHARACTERISTIC K_LA_TRIM_CFG "Freigabe Trimmregelung" VALUE 0x72F42 TKW_VV_VV_UW 100.0 FORMULA_0912 0.0 1.0 FORMAT "%5.2" /end CHARACTERISTIC
/begin CHARACTERISTIC K_LA_TRIM_DIAG_CFG "Freigabe Trimmregelungsdiagnose" VALUE 0x72F46 TKW_VV_VV_UW 100.0 FORMULA_0799 0.0 1.0 FORMAT "%5.2" /end CHARACTERISTIC
/begin CHARACTERISTIC K_LA_TRIM_DIAG_I_AD_F "Aufweitungsfaktor auf d. I-Adaptionss-Bereichsgrenzen" VALUE 0x72F8E TKW_VV_VV_UW 100.0 FORMULA_0073 0.0 4.0 FORMAT "%6.3" /end CHARACTERISTIC
/begin CHARACTERISTIC K_LA_TRIM_DIAG_I_AD_MAX_SCHW "Schwelle f. Anzahl I-Adaption max. Begrenzung" VALUE 0x72F92 TKW_VV_VV_UW 100.0 FORMULA_0010 0.0 65535.0 /end CHARACTERISTIC
/begin CHARACTERISTIC K_LA_TRIM_DIAG_I_AD_MIN_SCHW "Schwelle f. Anzahl I-Adaption min. Begrenzung" VALUE 0x72F90 TKW_VV_VV_UW 100.0 FORMULA_0010 0.0 65535.0 /end CHARACTERISTIC
/begin CHARACTERISTIC K_LA_TRIM_DIAG_I_ED_F "Aufweitungsfaktor auf d. I-Anteils-Bereichsgrenzen" VALUE 0x72F86 TKW_VV_VV_UW 100.0 FORMULA_0073 0.0 4.0 FORMAT "%6.3" /end CHARACTERISTIC
/begin CHARACTERISTIC K_LA_TRIM_DIAG_I_MAX_SCHW "Schwelle f. Anzahl I-Anteil max. Begrenzung" VALUE 0x72F84 TKW_VV_VV_UW 100.0 FORMULA_0010 0.0 65535.0 /end CHARACTERISTIC
/begin CHARACTERISTIC K_LA_TRIM_DIAG_I_MIN_SCHW "Schwelle f. Anzahl I-Anteil min. Begrenzung" VALUE 0x72F82 TKW_VV_VV_UW 100.0 FORMULA_0010 0.0 65535.0 /end CHARACTERISTIC
/begin CHARACTERISTIC K_LA_TRIM_DIAG_I_T "min. Zeit fuer Anschlag d. I-Aneiles" VALUE 0x72F94 TKW_VV_VV_UW 100.0 FORMULA_0021 0.0 655.3499755859375 FORMAT "%5.2" /end CHARACTERISTIC
/begin CHARACTERISTIC K_LA_TRIM_DIAG_P_SCHW "Anzahl P-Anteil-Fkt.-Durchlaeufe " VALUE 0x72F80 TKW_VV_VV_UW 100.0 FORMULA_0010 0.0 65535.0 /end CHARACTERISTIC
/begin CHARACTERISTIC K_LA_TRIM_DLY_T "Verz.-Zeit nach Abbruch Trimmregelung" VALUE 0x72F64 TKW_VV_VV_UW 100.0 FORMULA_0021 0.0 655.3499755859375 FORMAT "%5.2" /end CHARACTERISTIC
/begin CHARACTERISTIC K_LA_TRIM_DYN_DELTA_RF "RF-Delta fur Freigabe Trimmregelung" VALUE 0x72F5C TKW_VV_VV_SW 100.0 FORMULA_0007 0.0 2.0 FORMAT "%6.3" /end CHARACTERISTIC
/begin CHARACTERISTIC K_LA_TRIM_DYN_RF_T "Sperrzeit für Trimmregelung nach rf-Dynamik" VALUE 0x72F5E TKW_VV_VV_UW 100.0 FORMULA_0021 0.0 655.0 FORMAT "%5.2" /end CHARACTERISTIC
/begin CHARACTERISTIC K_LA_TRIM_DYN_T "Verz.-Zeit nach begr. Dyn" VALUE 0x72F62 TKW_VV_VV_UW 100.0 FORMULA_0021 0.0 655.3499755859375 FORMAT "%5.2" /end CHARACTERISTIC
/begin CHARACTERISTIC K_LA_TRIM_FKT_CFG "Auswahl Trimmregelung-Fkt." VALUE 0x72F44 TKW_VV_VV_UW 100.0 FORMULA_0913 1.0 16.0 FORMAT "%5.2" BIT_MASK 0xF /end CHARACTERISTIC
/begin CHARACTERISTIC K_LA_TRIM_I_AD_F "Uebernahme I-Anteil in AD-Wert" VALUE 0x72F76 TKW_VV_VV_UW 100.0 FORMULA_0001 0.0 100.0 FORMAT "%4.1" /end CHARACTERISTIC
/begin CHARACTERISTIC K_LA_TRIM_I_AD_MAX "max. I-Adaptionsanteil" VALUE 0x72F6E TKW_VV_VV_SW 100.0 FORMULA_0025 -2.0 1.998999953269959 FORMAT "%6.3" /end CHARACTERISTIC
/begin CHARACTERISTIC K_LA_TRIM_I_AD_MCS "I-Adaptionsanteil - MCS-Popel-Groesse fuer CFG-RESET" VALUE 0x72F98 TKW_VV_VV_SW 100.0 FORMULA_0025 -2.0 1.998999953269959 FORMAT "%6.3" /end CHARACTERISTIC
/begin CHARACTERISTIC K_LA_TRIM_I_AD_MIN "min. I-Adaptionsanteil" VALUE 0x72F70 TKW_VV_VV_SW 100.0 FORMULA_0025 -2.0 1.998999953269959 FORMAT "%6.3" /end CHARACTERISTIC
/begin CHARACTERISTIC K_LA_TRIM_I_GMW_DLY "Verz.-Zeit nach Eintitt ins I-GMW-Band" VALUE 0x72F60 TKW_VV_VV_UW 100.0 FORMULA_0914 0.0 65535.0 FORMAT "%5.2" /end CHARACTERISTIC
/begin CHARACTERISTIC K_LA_TRIM_I_GMW_MAX "max. gemittelter I-Anteil der Trimmregelung" VALUE 0x72F6A TKW_VV_VV_SW 100.0 FORMULA_0025 -2.0 1.998999953269959 FORMAT "%6.3" /end CHARACTERISTIC
/begin CHARACTERISTIC K_LA_TRIM_I_GMW_MIN "min. gemittelter I-Anteil der Trimmregelung" VALUE 0x72F6C TKW_VV_VV_SW 100.0 FORMULA_0025 -2.0 1.998999953269959 FORMAT "%6.3" /end CHARACTERISTIC
/begin CHARACTERISTIC K_LA_TRIM_I_GMW_TAU "Zeitkonstante gem. I-Anteil" VALUE 0x72F74 TKW_VV_VV_UB 100.0 FORMULA_0715 1.003999948501587 256.0 /end CHARACTERISTIC
/begin CHARACTERISTIC K_LA_TRIM_I_MAX "max. I-Anteil der Trimmregelung" VALUE 0x72F66 TKW_VV_VV_SW 100.0 FORMULA_0025 -2.0 1.998999953269959 FORMAT "%6.3" /end CHARACTERISTIC
/begin CHARACTERISTIC K_LA_TRIM_I_MIN "min. I-Anteil der Trimmregelung" VALUE 0x72F68 TKW_VV_VV_SW 100.0 FORMULA_0025 -2.0 1.998999953269959 FORMAT "%6.3" /end CHARACTERISTIC
/begin CHARACTERISTIC K_LA_TRIM_I_US_DELTA_MAX "OFFSET fuer max. Schwelle d. I-Anteil Ermittlung" VALUE 0x72F7C TKW_VV_VV_UW 100.0 FORMULA_0536 0.0 1200.0 /end CHARACTERISTIC
/begin CHARACTERISTIC K_LA_TRIM_I_US_DELTA_MIN "OFFSET fuer min. Schwelle d. I-Anteil Ermittlung" VALUE 0x72F7A TKW_VV_VV_UW 100.0 FORMULA_0536 0.0 1200.0 /end CHARACTERISTIC
/begin CHARACTERISTIC K_LA_TRIM_LAA_F_TE "max. TE-Offset auf LAA-Faktor" VALUE 0x72F4E TKW_VV_VV_SW 100.0 FORMULA_0024 -1.0 0.9998999834060669 FORMAT "%7.4" /end CHARACTERISTIC
/begin CHARACTERISTIC K_LA_TRIM_LAM_DELTA_MAX "LA-Regelabweichung - Freigabe Trimmregelung" VALUE 0x72F96 TKW_VV_VV_SW 100.0 FORMULA_0025 -2.0 1.999899983406067 FORMAT "%6.3" /end CHARACTERISTIC
/begin CHARACTERISTIC K_LA_TRIM_P_ANZ_MAX "max. Anzahl der P-Anteil Triggerungen" VALUE 0x72F78 TKW_VV_VV_UW 100.0 FORMULA_0010 0.0 65535.0 /end CHARACTERISTIC
/begin CHARACTERISTIC K_LA_TRIM_P_MAX "max. P-Anteil der Trimmregelung" VALUE 0x72F50 TKW_VV_VV_SW 100.0 FORMULA_0025 -2.0 1.998999953269959 FORMAT "%6.3" /end CHARACTERISTIC
/begin CHARACTERISTIC K_LA_TRIM_P_MIN "min. P-Anteil der Trimmregelung" VALUE 0x72F52 TKW_VV_VV_SW 100.0 FORMULA_0025 -2.0 1.998999953269959 FORMAT "%6.3" /end CHARACTERISTIC
/begin CHARACTERISTIC K_LA_TRIM_P_US_OFFSET "OFFSET fuer Verhinderung P-Anteil Toggeln" VALUE 0x72F7E TKW_VV_VV_UW 100.0 FORMULA_0536 0.0 1200.0 /end CHARACTERISTIC
/begin CHARACTERISTIC K_LA_TRIM_RF_HYS "Hsysterese f. relative Füllung - LA-TRIM" VALUE 0x72F48 TKW_VV_VV_SW 100.0 FORMULA_0007 0.0 2.0 FORMAT "%6.3" /end CHARACTERISTIC
/begin CHARACTERISTIC K_LA_TRIM_TABG_NKAT "min. NKAT-Abgastemperatur" VALUE 0x72F4A TKW_VV_VV_SW 100.0 FORMULA_0023 -50.0 1250.0 FORMAT "%4.1" /end CHARACTERISTIC
/begin CHARACTERISTIC K_LA_TRIM_TAN_MAX "max. TAN-Schwelle" VALUE 0x72F8A TKW_VV_VV_SW 100.0 FORMULA_0023 -50.0 170.0 FORMAT "%4.1" /end CHARACTERISTIC
/begin CHARACTERISTIC K_LA_TRIM_TAN_MIN "min. TAN-Schwelle" VALUE 0x72F88 TKW_VV_VV_SW 100.0 FORMULA_0023 -50.0 170.0 FORMAT "%4.1" /end CHARACTERISTIC
/begin CHARACTERISTIC K_LA_TRIM_TE_C_AKF_MAX "max. Konzentration aus AKF" VALUE 0x72F4C TKW_VV_VV_UW 100.0 FORMULA_0199 0.0 2.0 FORMAT "%7.4" /end CHARACTERISTIC
/begin CHARACTERISTIC K_LA_TRIM_US_EINGER "Hys.-Spannung f. I-Regler-STOP" VALUE 0x72F54 TKW_VV_VV_UW 100.0 FORMULA_0536 0.0 1200.0 /end CHARACTERISTIC
/begin CHARACTERISTIC K_LA_TRIM_US_EINGESCHW "Hys.-Sp.-Erkennung Signal eingeschw." VALUE 0x72F56 TKW_VV_VV_UW 100.0 FORMULA_0536 0.0 1200.0 /end CHARACTERISTIC
/begin CHARACTERISTIC K_LA_TRIM_US_O2_MAX "Hysterese f. Freigabe O2-Beladung (obere Schwelle)" VALUE 0x72F58 TKW_VV_VV_UW 100.0 FORMULA_0536 0.0 1200.0 /end CHARACTERISTIC
/begin CHARACTERISTIC K_LA_TRIM_US_O2_MIN "Hysterese f. Freigabe O2-Beladung (untere Schwelle)" VALUE 0x72F5A TKW_VV_VV_UW 100.0 FORMULA_0536 0.0 1200.0 /end CHARACTERISTIC
/begin CHARACTERISTIC K_LA_TRIM_US_SOLL_GRAD "AEBG. d. SOLL-Spannung" VALUE 0x72F72 TKW_VV_VV_UW 100.0 FORMULA_0915 0.0 1200.0 /end CHARACTERISTIC
/begin CHARACTERISTIC K_LA_TRIM_V_SCHWELLE "max. Geschwindigkeitsschwelle" VALUE 0x72F8C TKW_VV_VV_SW 100.0 FORMULA_0076 -80.0 360.0 FORMAT "%4.1" /end CHARACTERISTIC
/begin CHARACTERISTIC K_LAA_CFG "Freigabe Lambdaadaption" VALUE 0x73672 TKW_VV_VV_UW 100.0 FORMULA_0787 0.0 1.0 FORMAT "%5.2" /end CHARACTERISTIC
/begin CHARACTERISTIC K_LAA_F_GRAD "LAA-F-Gradient" VALUE 0x736AA TKW_VV_VV_UW 100.0 FORMULA_0024 0.0 1.998999953269959 FORMAT "%7.4" /end CHARACTERISTIC
/begin CHARACTERISTIC K_LAA_F_MAX "max. Adaptionsfaktor" VALUE 0x73696 TKW_VV_VV_UW 100.0 FORMULA_0024 0.0 1.998999953269959 FORMAT "%7.4" /end CHARACTERISTIC
/begin CHARACTERISTIC K_LAA_F_MCS_B1 "MCS-INIT Adaptionsfaktor" VALUE 0x73692 TKW_VV_VV_UW 100.0 FORMULA_0024 0.0 1.998999953269959 FORMAT "%7.4" /end CHARACTERISTIC
/begin CHARACTERISTIC K_LAA_F_MCS_B2 "MCS-INIT Adaptionsfaktor" VALUE 0x73694 TKW_VV_VV_UW 100.0 FORMULA_0024 0.0 1.998999953269959 FORMAT "%7.4" /end CHARACTERISTIC
/begin CHARACTERISTIC K_LAA_F_MIN "min. Adaptionsfaktor" VALUE 0x73698 TKW_VV_VV_UW 100.0 FORMULA_0024 0.0 1.998999953269959 FORMAT "%7.4" /end CHARACTERISTIC
/begin CHARACTERISTIC K_LAA_F_N_MAX "max. Drehzahl f. Faktor-LAA" VALUE 0x73680 TKW_VV_VV_SW 100.0 FORMULA_0006 0.0 10000.0 /end CHARACTERISTIC
/begin CHARACTERISTIC K_LAA_F_N_MIN "min. Drehzahl f. Faktor-LAA" VALUE 0x7367E TKW_VV_VV_SW 100.0 FORMULA_0006 0.0 10000.0 /end CHARACTERISTIC
/begin CHARACTERISTIC K_LAA_F_RF_MAX "max. relative Füllung f. Faktor-LAA" VALUE 0x73688 TKW_VV_VV_SW 100.0 FORMULA_0007 0.0 2.0 FORMAT "%6.3" /end CHARACTERISTIC
/begin CHARACTERISTIC K_LAA_F_RF_MIN "min. relative Füllung f. Faktor-LAA" VALUE 0x73686 TKW_VV_VV_SW 100.0 FORMULA_0007 0.0 2.0 FORMAT "%6.3" /end CHARACTERISTIC
/begin CHARACTERISTIC K_LAA_F_T_ADAPT "Adaptionszeitraum f. F-Adaption" VALUE 0x7368C TKW_VV_VV_UW 100.0 FORMULA_0763 0.0 65535.0 /end CHARACTERISTIC
/begin CHARACTERISTIC K_LAA_F_TE_GRAD "LAA-F-Gradient" VALUE 0x736AC TKW_VV_VV_UW 100.0 FORMULA_0024 0.0 1.998999953269959 FORMAT "%7.4" /end CHARACTERISTIC
/begin CHARACTERISTIC K_LAA_F_TE_MAX "max. Offset auf LAA-Faktor ueber TE" VALUE 0x7369A TKW_VV_VV_SW 100.0 FORMULA_0024 -1.0 0.9998999834060669 FORMAT "%7.4" /end CHARACTERISTIC
/begin CHARACTERISTIC K_LAA_F_TE_MIN "min. Offset auf LAA-Faktor ueber TE" VALUE 0x7369C TKW_VV_VV_SW 100.0 FORMULA_0024 -1.0 0.9998999834060669 FORMAT "%7.4" /end CHARACTERISTIC
/begin CHARACTERISTIC K_LAA_F_TE_N_MAX "max. Drehzahl f. TE-LAA" VALUE 0x7367C TKW_VV_VV_SW 100.0 FORMULA_0006 0.0 10000.0 /end CHARACTERISTIC
/begin CHARACTERISTIC K_LAA_F_TE_RAMPE "Abregelwert fuer laa_f_te" VALUE 0x736B0 TKW_VV_VV_UW 100.0 FORMULA_0024 0.0 1.998999953269959 FORMAT "%7.4" /end CHARACTERISTIC
/begin CHARACTERISTIC K_LAA_F_TE_RF_MAX "max. relative Füllung f. TE-LAA" VALUE 0x73684 TKW_VV_VV_SW 100.0 FORMULA_0007 0.0 2.0 FORMAT "%6.3" /end CHARACTERISTIC
/begin CHARACTERISTIC K_LAA_F_TE_T_ADAPT "Adaptionszeitraum f. F-TE-Adaption" VALUE 0x7368E TKW_VV_VV_UW 100.0 FORMULA_0763 0.0 65535.0 /end CHARACTERISTIC
/begin CHARACTERISTIC K_LAA_LAM_REG_F_DELTA "Regelabweichung f. stationaere LAA" VALUE 0x736AE TKW_VV_VV_UW 100.0 FORMULA_0024 0.0 1.998999953269959 FORMAT "%7.4" /end CHARACTERISTIC
/begin CHARACTERISTIC K_LAA_OFFS_GRAD "LAA-OFFEST-Gradient" VALUE 0x736A8 TKW_VV_VV_SW 100.0 FORMULA_0535 0.0 511.0 FORMAT "%6.3" /end CHARACTERISTIC
/begin CHARACTERISTIC K_LAA_OFFS_MAX "max. Offset-Adaption" VALUE 0x736A2 TKW_VV_VV_SW 100.0 FORMULA_0535 -512.0 511.0 FORMAT "%6.3" /end CHARACTERISTIC
/begin CHARACTERISTIC K_LAA_OFFS_MCS_B1 "MCS-INIT Offset-Adaption" VALUE 0x7369E TKW_VV_VV_SW 100.0 FORMULA_0535 -512.0 511.0 FORMAT "%6.3" /end CHARACTERISTIC
/begin CHARACTERISTIC K_LAA_OFFS_MCS_B2 "MCS-INIT Offset-Adaption" VALUE 0x736A0 TKW_VV_VV_SW 100.0 FORMULA_0535 -512.0 511.0 FORMAT "%6.3" /end CHARACTERISTIC
/begin CHARACTERISTIC K_LAA_OFFS_MIN "min. Offset-Adaption" VALUE 0x736A4 TKW_VV_VV_SW 100.0 FORMULA_0535 -512.0 511.0 FORMAT "%6.3" /end CHARACTERISTIC
/begin CHARACTERISTIC K_LAA_OFFS_N_MAX "max. Drehzahl f. Offset-LAA" VALUE 0x73682 TKW_VV_VV_SW 100.0 FORMULA_0006 0.0 10000.0 /end CHARACTERISTIC
/begin CHARACTERISTIC K_LAA_OFFS_RF_MAX "max. relative Füllung f. Offset-LAA" VALUE 0x7368A TKW_VV_VV_SW 100.0 FORMULA_0007 0.0 2.0 FORMAT "%6.3" /end CHARACTERISTIC
/begin CHARACTERISTIC K_LAA_OFFS_T_ADAPT "Adaptionszeitraum f. OFFS-Adaption" VALUE 0x73690 TKW_VV_VV_UW 100.0 FORMULA_0763 0.0 65535.0 /end CHARACTERISTIC
/begin CHARACTERISTIC K_LAA_PKS_MAX "max. PKS-Schwelle f. LAA" VALUE 0x7367A TKW_VV_VV_SW 100.0 FORMULA_0110 0.0 10.0 FORMAT "%6.3" /end CHARACTERISTIC
/begin CHARACTERISTIC K_LAA_RESET_CFG "Ruecksetzen d. Lambdaadaption" VALUE 0x73674 TKW_VV_VV_UW 100.0 FORMULA_0788 0.0 1.0 FORMAT "%5.2" /end CHARACTERISTIC
/begin CHARACTERISTIC K_LAA_TAN_MAX "max. TAN-Schwelle fuer LAA" VALUE 0x73676 TKW_VV_VV_SW 100.0 FORMULA_0023 -50.0 170.0 FORMAT "%4.1" /end CHARACTERISTIC
/begin CHARACTERISTIC K_LAA_TI_IST_MIN "min. SOLL-TI" VALUE 0x736A6 TKW_VV_VV_UW 100.0 FORMULA_0786 0.0 65.53500366210938 FORMAT "%5.2" /end CHARACTERISTIC
/begin CHARACTERISTIC K_LAA_TMOT_MIN "min. TMOT-Schwelle f. LAA" VALUE 0x73678 TKW_VV_VV_SW 100.0 FORMULA_0023 -50.0 170.0 FORMAT "%4.1" /end CHARACTERISTIC
/begin CHARACTERISTIC K_LAM_DIAG_CFG "Diagnose LAM_REG/LAA-Anschlag" VALUE 0x736B4 TKW_VV_VV_UW 100.0 FORMULA_0790 0.0 1.0 FORMAT "%5.2" /end CHARACTERISTIC
/begin CHARACTERISTIC K_LAM_DIAG_LAA_F_HYS "Faktor-Hysterese fuer LAA-Diag." VALUE 0x736BC TKW_VV_VV_UW 100.0 FORMULA_0024 0.0 1.998999953269959 FORMAT "%7.4" /end CHARACTERISTIC
/begin CHARACTERISTIC K_LAM_DIAG_LAA_OFFS_HYS "Offset-Hysterese fuer LAA-Diag." VALUE 0x736BE TKW_VV_VV_SW 100.0 FORMULA_0535 -512.0 511.0 FORMAT "%6.3" /end CHARACTERISTIC
/begin CHARACTERISTIC K_LAM_DIAG_LAA_T "Diagnosezeit - LA-Adaptionanschlag" VALUE 0x736B8 TKW_VV_VV_UW 100.0 FORMULA_0071 0.0 6553.5 FORMAT "%4.1" /end CHARACTERISTIC
/begin CHARACTERISTIC K_LAM_DIAG_REG_T "Diagnosezeit - LA-Regleranschlag" VALUE 0x736B6 TKW_VV_VV_UW 100.0 FORMULA_0071 0.0 6553.5 FORMAT "%4.1" /end CHARACTERISTIC
/begin CHARACTERISTIC K_LAM_REG_CFG "Freigabe Lambdaregler" VALUE 0x7364C TKW_VV_VV_UW 100.0 FORMULA_0783 0.0 1.0 FORMAT "%5.2" /end CHARACTERISTIC
/begin CHARACTERISTIC K_LAM_REG_DELTA_MAX "max. Reglerabweichung" VALUE 0x73662 TKW_VV_VV_SW 100.0 FORMULA_0025 -2.0 1.999899983406067 FORMAT "%6.3" /end CHARACTERISTIC
/begin CHARACTERISTIC K_LAM_REG_DELTA_MIN "min. Reglerabweichung" VALUE 0x73660 TKW_VV_VV_SW 100.0 FORMULA_0025 -2.0 1.999899983406067 FORMAT "%6.3" /end CHARACTERISTIC
/begin CHARACTERISTIC K_LAM_REG_DELTA_STAT_MAX "Regelabweichung f. stationaeren Zustand" VALUE 0x73664 TKW_VV_VV_UW 100.0 FORMULA_0025 0.0 3.999000072479248 FORMAT "%6.3" /end CHARACTERISTIC
/begin CHARACTERISTIC K_LAM_REG_DELTA_STAT_MAX_TE "Regelabweichung f. stat. Zustand bei TE" VALUE 0x73666 TKW_VV_VV_UW 100.0 FORMULA_0025 0.0 3.999000072479248 FORMAT "%6.3" /end CHARACTERISTIC
/begin CHARACTERISTIC K_LAM_REG_DELTA_STAT_TRIM "Regelabweichung f. stat. Zustand - Trimmregelung" VALUE 0x73668 TKW_VV_VV_UW 100.0 FORMULA_0025 0.0 3.999000072479248 FORMAT "%6.3" /end CHARACTERISTIC
/begin CHARACTERISTIC K_LAM_REG_F_MAX "Regelabweichung f. stationaeren Zustand" VALUE 0x7366C TKW_VV_VV_UW 100.0 FORMULA_0024 0.0 1.998999953269959 FORMAT "%7.4" /end CHARACTERISTIC
/begin CHARACTERISTIC K_LAM_REG_F_MIN "Regelabweichung f. stationaeren Zustand" VALUE 0x7366A TKW_VV_VV_UW 100.0 FORMULA_0024 0.0 1.998999953269959 FORMAT "%7.4" /end CHARACTERISTIC
/begin CHARACTERISTIC K_LAM_REG_IST_MW_MAX "max. IST_Lambdawert" VALUE 0x7365A TKW_VV_VV_UW 100.0 FORMULA_0025 0.0 3.999000072479248 FORMAT "%6.3" /end CHARACTERISTIC
/begin CHARACTERISTIC K_LAM_REG_IST_MW_MIN "min. IST-Lambdawert" VALUE 0x73658 TKW_VV_VV_UW 100.0 FORMULA_0025 0.0 3.999000072479248 FORMAT "%6.3" /end CHARACTERISTIC
/begin CHARACTERISTIC K_LAM_REG_RESET_CFG "RESET Lambdaregler" VALUE 0x73652 TKW_VV_VV_UW 100.0 FORMULA_0785 0.0 1.0 FORMAT "%5.2" /end CHARACTERISTIC
/begin CHARACTERISTIC K_LAM_REG_RESET_SA_TMOT_MIN "min. TMOT-Schwelle f. LAA" VALUE 0x73670 TKW_VV_VV_SW 100.0 FORMULA_0023 -50.0 170.0 FORMAT "%4.1" /end CHARACTERISTIC
/begin CHARACTERISTIC K_LAM_REG_SOLL_MAX "max. SOLL_Lambdawert" VALUE 0x7365E TKW_VV_VV_UW 100.0 FORMULA_0025 0.0 3.999000072479248 FORMAT "%6.3" /end CHARACTERISTIC
/begin CHARACTERISTIC K_LAM_REG_SOLL_MIN "min. SOLL-Lambdawert" VALUE 0x7365C TKW_VV_VV_UW 100.0 FORMULA_0025 0.0 3.999000072479248 FORMAT "%6.3" /end CHARACTERISTIC
/begin CHARACTERISTIC K_LAM_REG_START_TIME "Verzaegerungszeit nach Startende" VALUE 0x73654 TKW_VV_VV_UW 100.0 FORMULA_0021 0.0 655.3499755859375 FORMAT "%5.2" /end CHARACTERISTIC
/begin CHARACTERISTIC K_LAM_REG_T_SLP_VERZ "Wartezeit LA-Regler nach aktiver SLP" VALUE 0x736BA TKW_VV_VV_UW 100.0 FORMULA_0752 0.0 65.53500366210938 FORMAT "%6.3" /end CHARACTERISTIC
/begin CHARACTERISTIC K_LAM_REG_TI_IST_MIN "min. SOLL-TI" VALUE 0x73656 TKW_VV_VV_UW 100.0 FORMULA_0786 0.0 65.53500366210938 FORMAT "%5.2" /end CHARACTERISTIC
/begin CHARACTERISTIC K_LAM_REG_TN_TU_F "Tuningfaktor Nachstellzeit" VALUE 0x7366F TKW_VV_VV_UB 100.0 FORMULA_0638 0.0 1.99210000038147 /end CHARACTERISTIC
/begin CHARACTERISTIC K_LAM_REG_TV_TU_F "Tuningfaktor Vorhaltezeit" VALUE 0x7366E TKW_VV_VV_UB 100.0 FORMULA_0638 0.0 1.99210000038147 /end CHARACTERISTIC
/begin CHARACTERISTIC K_LAM_SOLL_ADD_KONV_GRAD "Pulshub - Aenderungsbegrenzung" VALUE 0x73986 TKW_VV_VV_UW 100.0 FORMULA_0025 0.0 3.999000072479248 FORMAT "%6.3" /end CHARACTERISTIC
/begin CHARACTERISTIC K_LAM_SOLL_FETT_ERK "FETT-Erkennung f. MS_KAT-Adaption" VALUE 0x73974 TKW_VV_VV_UW 100.0 FORMULA_0025 0.0 3.999000072479248 FORMAT "%6.3" /end CHARACTERISTIC
/begin CHARACTERISTIC K_LAM_SOLL_FILT_F "Filterfaktor f. lam_soll_filt" VALUE 0x7397E TKW_VV_VV_UW 100.0 FORMULA_0806 0.0 511.9920959472656 FORMAT "%5.2" /end CHARACTERISTIC
/begin CHARACTERISTIC K_LAM_SOLL_FILT_INIT_CFG "Initialisierung des Sollwertfilters" VALUE 0x7399A TKW_VV_VV_UB 100.0 FORMULA_0809 0.0 1.0 /end CHARACTERISTIC
/begin CHARACTERISTIC K_LAM_SOLL_KATH_DELTA_NEG "neg. Aenderungsbegr. in SL (frueher KATH)" VALUE 0x7396E TKW_VV_VV_SW 100.0 FORMULA_0803 0.0 -2.0 FORMAT "%6.3" /end CHARACTERISTIC
/begin CHARACTERISTIC K_LAM_SOLL_KATH_DELTA_POS "pos. Aenderungsbegr. in SL (frueher KATH)" VALUE 0x7396C TKW_VV_VV_UW 100.0 FORMULA_0802 0.0 1.998999953269959 FORMAT "%6.3" /end CHARACTERISTIC
/begin CHARACTERISTIC K_LAM_SOLL_KATH_T_ML_MAX "max. Zeit fuer den Zustand SL (frueher KATH-Heizen)" VALUE 0x73966 TKW_VV_VV_UW 100.0 FORMULA_0800 0.0 65535.0 /end CHARACTERISTIC
/begin CHARACTERISTIC K_LAM_SOLL_KONV_CFG "KONV-Pulsgenerator" VALUE 0x73962 TKW_VV_VV_UW 100.0 FORMULA_0799 0.0 1.0 FORMAT "%5.2" /end CHARACTERISTIC
/begin CHARACTERISTIC K_LAM_SOLL_KR_KATS "KR-LA-Faktor" VALUE 0x73984 TKW_VV_VV_UW 100.0 FORMULA_0807 0.0 1.0 FORMAT "%6.3" /end CHARACTERISTIC
/begin CHARACTERISTIC K_LAM_SOLL_MAX "MAX-Begrenzung LAM_SOLL" VALUE 0x73988 TKW_VV_VV_UW 100.0 FORMULA_0025 0.0 3.999000072479248 FORMAT "%6.3" /end CHARACTERISTIC
/begin CHARACTERISTIC K_LAM_SOLL_MIN "MIN-Begrenzung LAM_SOLL" VALUE 0x7398A TKW_VV_VV_UW 100.0 FORMULA_0025 0.0 3.999000072479248 FORMAT "%6.3" /end CHARACTERISTIC
/begin CHARACTERISTIC K_LAM_SOLL_MS_KAT_F_OBD "Wichtungsfak. auf Lambdapulshub bei KAT_ZUST_PASSIV" VALUE 0x73960 TKW_VV_VV_UW 100.0 FORMULA_0073 0.0 1.0 FORMAT "%6.3" /end CHARACTERISTIC
/begin CHARACTERISTIC K_LAM_SOLL_MS_KAT_MIN "KAT befuellt mit min. Sauerstoffmasse" VALUE 0x73976 TKW_VV_VV_SW 100.0 FORMULA_0804 -3276.800048828125 3276.699951171875 FORMAT "%4.1" /end CHARACTERISTIC
/begin CHARACTERISTIC K_LAM_SOLL_MS_KAT_OFFSET_OBD "OFFSET auf min. Sauerstoffmasse im Zustand PASSIV" VALUE 0x73998 TKW_VV_VV_SW 100.0 FORMULA_0804 -3276.800048828125 3276.699951171875 FORMAT "%4.1" /end CHARACTERISTIC
/begin CHARACTERISTIC K_LAM_SOLL_MS_KAT_SOLL_MAX_OBD "max. gespeicherte Sauerstoffmasse im KAT - O2-Ermittlung" VALUE 0x73978 TKW_VV_VV_SW 100.0 FORMULA_0804 -3276.800048828125 3276.699951171875 FORMAT "%4.1" /end CHARACTERISTIC
/begin CHARACTERISTIC K_LAM_SOLL_O2_ANT "Sauerstoffanteil d. Luft" VALUE 0x73980 TKW_VV_VV_UW 100.0 FORMULA_0806 0.0 511.9920959472656 FORMAT "%5.2" /end CHARACTERISTIC
/begin CHARACTERISTIC K_LAM_SOLL_OFFS_MCS "LAM-SOLL-Offset - Fummeloffset" VALUE 0x73964 TKW_VV_VV_SW 100.0 FORMULA_0025 -2.0 1.999899983406067 FORMAT "%6.3" /end CHARACTERISTIC
/begin CHARACTERISTIC K_LAM_SOLL_PULS_AUSR_CFG "O2-Ausraeumfunktion" VALUE 0x7398C TKW_VV_VV_UW 100.0 FORMULA_0799 0.0 1.0 FORMAT "%5.2" /end CHARACTERISTIC
/begin CHARACTERISTIC K_LAM_SOLL_PULS_AUSR_SL_CFG "O2-Ausraeumfunktion - nach SLP-Betrieb" VALUE 0x7398E TKW_VV_VV_UW 100.0 FORMULA_0799 0.0 1.0 FORMAT "%5.2" /end CHARACTERISTIC
/begin CHARACTERISTIC K_LAM_SOLL_PULS_AUSR_SL_T "Verzaegerungszeit nach Startende" VALUE 0x73996 TKW_VV_VV_UW 100.0 FORMULA_0021 0.0 655.3499755859375 FORMAT "%5.2" /end CHARACTERISTIC
/begin CHARACTERISTIC K_LAM_SOLL_PULS_LANK_CFG "O2-Ausraeumfunktion - Fuehrung duch NKAT-Signal" VALUE 0x73990 TKW_VV_VV_UW 100.0 FORMULA_0808 0.0 1.0 FORMAT "%5.2" /end CHARACTERISTIC
/begin CHARACTERISTIC K_LAM_SOLL_PULS_LANK_MAX "O2-Ausraeumfunktion - max. Schwelle fuer NKAT-Fuehrung" VALUE 0x73992 TKW_VV_VV_SW 100.0 FORMULA_0536 -1200.0 1200.0 /end CHARACTERISTIC
/begin CHARACTERISTIC K_LAM_SOLL_PULS_LANK_MIN "O2-Ausraeumfunktion - min. Schwelle fuer NKAT-Fuehrung" VALUE 0x73994 TKW_VV_VV_SW 100.0 FORMULA_0536 -1200.0 1200.0 /end CHARACTERISTIC
/begin CHARACTERISTIC K_LAM_SOLL_PULS_O2_HYST "min. Schwelle f. Berechnung Sauerstoffmassengradient" VALUE 0x73982 TKW_VV_VV_UW 100.0 FORMULA_0025 0.0 3.999000072479248 FORMAT "%6.3" /end CHARACTERISTIC
/begin CHARACTERISTIC K_LAM_SOLL_T_FETT_MIN "min. Zeit in FETT f. Adaption" VALUE 0x7397C TKW_VV_VV_UW 100.0 FORMULA_0805 0.0 655.3499755859375 /end CHARACTERISTIC
/begin CHARACTERISTIC K_LAM_SOLL_T_SA_SLP_MIN "min. Zeit in SA/SLP-ON f. Adaption" VALUE 0x7397A TKW_VV_VV_UW 100.0 FORMULA_0805 0.0 655.3499755859375 /end CHARACTERISTIC
/begin CHARACTERISTIC K_LAM_SOLL_WL_DELTA_NEG "neg. Aenderungsbegr. im WL" VALUE 0x73972 TKW_VV_VV_SW 100.0 FORMULA_0803 0.0 -2.0 FORMAT "%6.3" /end CHARACTERISTIC
/begin CHARACTERISTIC K_LAM_SOLL_WL_DELTA_POS "pos. Aenderungsbegr. im WL" VALUE 0x73970 TKW_VV_VV_UW 100.0 FORMULA_0802 0.0 1.998999953269959 FORMAT "%6.3" /end CHARACTERISTIC
/begin CHARACTERISTIC K_LAM_SOLL_WL_TMOT_HYS "TMOT-Schwelle f. WL-Zustand-Erkennung" VALUE 0x7396A TKW_VV_VV_SW 100.0 FORMULA_0801 -1000.0 1000.0 FORMAT "%4.1" /end CHARACTERISTIC
/begin CHARACTERISTIC K_LAM_SOLL_WL_TMOT_MAX "TMOT-Schwelle f. WL-Zustand-Erkennung" VALUE 0x73968 TKW_VV_VV_SW 100.0 FORMULA_0023 -50.0 170.0 FORMAT "%4.1" /end CHARACTERISTIC
/begin CHARACTERISTIC K_LAVK_AD_GAIN_CNT "Zaehler fuer GAIN-Sondenadapt." VALUE 0x7362E TKW_VV_VV_UW 100.0 FORMULA_0010 0.0 65535.0 /end CHARACTERISTIC
/begin CHARACTERISTIC K_LAVK_AD_GAIN_CNT_MIN "MIN-Zaehler fuer GAIN-Sondenadaption" VALUE 0x7362C TKW_VV_VV_UW 100.0 FORMULA_0010 0.0 65535.0 /end CHARACTERISTIC
/begin CHARACTERISTIC K_LAVK_AD_GAIN_GRAD "max. GAIN-Gradient" VALUE 0x73640 TKW_VV_VV_UW 100.0 FORMULA_0073 0.0 4.0 FORMAT "%6.3" /end CHARACTERISTIC
/begin CHARACTERISTIC K_LAVK_AD_GAIN_MIN "MIN-Schwelle f. GAIN-Sondenadaption" VALUE 0x7363C TKW_VV_VV_UW 100.0 FORMULA_0536 0.0 5000.0 /end CHARACTERISTIC
/begin CHARACTERISTIC K_LAVK_AD_GAIN_ML_MIN "MIN-Luftmasse pro Bank" VALUE 0x73642 TKW_VV_VV_SW 100.0 FORMULA_0103 -100.0 1400.0 FORMAT "%4.1" /end CHARACTERISTIC
/begin CHARACTERISTIC K_LAVK_AD_GAIN_NV_MAX "max. Grenze fuer GAIN-Sonden-Adapt." VALUE 0x73648 TKW_VV_VV_UW 100.0 FORMULA_0073 0.0 4.0 FORMAT "%6.3" /end CHARACTERISTIC
/begin CHARACTERISTIC K_LAVK_AD_GAIN_NV_MIN "min. Grenze fuer GAIN-Sonden-Adapt." VALUE 0x7364A TKW_VV_VV_UW 100.0 FORMULA_0073 0.0 4.0 FORMAT "%6.3" /end CHARACTERISTIC
/begin CHARACTERISTIC K_LAVK_AD_GAIN_T "MIN-Zeit zwischen zwei GAIN-Adapt." VALUE 0x73632 TKW_VV_VV_UW 100.0 FORMULA_0021 0.0 655.0 FORMAT "%5.2" /end CHARACTERISTIC
/begin CHARACTERISTIC K_LAVK_AD_GAIN_T1 "Filterkoeffizient - GAIN-Sondenadapt." VALUE 0x73636 TKW_VV_VV_UW 100.0 FORMULA_0591 0.0 655350.0 /end CHARACTERISTIC
/begin CHARACTERISTIC K_LAVK_AD_MAX "MAX-AD-Wert d. Sondensignals" VALUE 0x7361C TKW_VV_VV_UW 100.0 FORMULA_0536 0.0 5000.0 /end CHARACTERISTIC
/begin CHARACTERISTIC K_LAVK_AD_MIN "MIN-AD-Wert d. Sondensignals" VALUE 0x7361A TKW_VV_VV_UW 100.0 FORMULA_0536 0.0 5000.0 /end CHARACTERISTIC
/begin CHARACTERISTIC K_LAVK_AD_OFFS_CNT "Zaehler fuer OFFSET-Sondenadaption" VALUE 0x73628 TKW_VV_VV_UW 100.0 FORMULA_0010 0.0 65535.0 /end CHARACTERISTIC
/begin CHARACTERISTIC K_LAVK_AD_OFFS_CNT_MIN "MIN-Zaehler fuer OFFSET-Sondenadaption" VALUE 0x73624 TKW_VV_VV_UW 100.0 FORMULA_0010 0.0 65535.0 /end CHARACTERISTIC
/begin CHARACTERISTIC K_LAVK_AD_OFFS_CNT_MIN_MS "MIN-Zaehler fuer MS-OFFSET-Sondenadapt." VALUE 0x73626 TKW_VV_VV_UW 100.0 FORMULA_0010 0.0 65535.0 /end CHARACTERISTIC
/begin CHARACTERISTIC K_LAVK_AD_OFFS_CNT_MS "Zaehler fuer MS-OFFSET-Sondenadapt." VALUE 0x7362A TKW_VV_VV_UW 100.0 FORMULA_0010 0.0 65535.0 /end CHARACTERISTIC
/begin CHARACTERISTIC K_LAVK_AD_OFFS_GRAD "max. OFFEST-Gradient" VALUE 0x7363E TKW_VV_VV_UW 100.0 FORMULA_0536 0.0 5000.0 /end CHARACTERISTIC
/begin CHARACTERISTIC K_LAVK_AD_OFFS_MAX "MAX-Schwelle f. Offset-Sondenadaption" VALUE 0x73638 TKW_VV_VV_UW 100.0 FORMULA_0536 0.0 5000.0 /end CHARACTERISTIC
/begin CHARACTERISTIC K_LAVK_AD_OFFS_MIN "MIN-Schwelle f. Offset-Sondenadaption" VALUE 0x7363A TKW_VV_VV_UW 100.0 FORMULA_0536 0.0 5000.0 /end CHARACTERISTIC
/begin CHARACTERISTIC K_LAVK_AD_OFFS_NV_MAX "max. Grenze fuer OFFEST-Sonden-Adapt." VALUE 0x73644 TKW_VV_VV_SW 100.0 FORMULA_0536 -5000.0 5000.0 /end CHARACTERISTIC
/begin CHARACTERISTIC K_LAVK_AD_OFFS_NV_MIN "min. Grenze fuer OFFEST-Sonden-Adapt." VALUE 0x73646 TKW_VV_VV_SW 100.0 FORMULA_0536 -5000.0 5000.0 /end CHARACTERISTIC
/begin CHARACTERISTIC K_LAVK_AD_OFFS_T "MIN-Zeit zwischen zwei OFFSET-Adapt." VALUE 0x73630 TKW_VV_VV_UW 100.0 FORMULA_0021 0.0 655.0 FORMAT "%5.2" /end CHARACTERISTIC
/begin CHARACTERISTIC K_LAVK_AD_OFFS_T1 "Filterkoeffizient - OFFSET-Sondenadapt." VALUE 0x73634 TKW_VV_VV_UW 100.0 FORMULA_0591 0.0 655350.0 /end CHARACTERISTIC
/begin CHARACTERISTIC K_LAVK_AD_RESET "RESET d. Sondenadaption" VALUE 0x73650 TKW_VV_VV_UW 100.0 FORMULA_0784 0.0 1.0 FORMAT "%5.2" /end CHARACTERISTIC
/begin CHARACTERISTIC K_LAVK_AD_TEST " d. Sondenadaption" VALUE 0x73618 TKW_VV_VV_UW 100.0 FORMULA_0782 0.0 1.0 FORMAT "%5.2" /end CHARACTERISTIC
/begin CHARACTERISTIC K_LAVK_ATIC42_ICP_ENABLE_B1 "ATIC42 ICP Einspeisung" VALUE 0x7450A TKW_VV_VV_UB 100.0 FORMULA_0879 0.0 1.0 /end CHARACTERISTIC
/begin CHARACTERISTIC K_LAVK_ATIC42_ICP_ENABLE_B2 "ATIC42 ICP Einspeisung" VALUE 0x7450B TKW_VV_VV_UB 100.0 FORMULA_0879 0.0 1.0 /end CHARACTERISTIC
/begin CHARACTERISTIC K_LAVK_ATIC42_ICP_VALUE_B1 "ATIC42 ICP Wert" VALUE 0x74512 TKW_VV_VV_UB 100.0 FORMULA_0881 5.0 160.0 /end CHARACTERISTIC
/begin CHARACTERISTIC K_LAVK_ATIC42_ICP_VALUE_B2 "ATIC42 ICP Wert" VALUE 0x74513 TKW_VV_VV_UB 100.0 FORMULA_0881 5.0 160.0 /end CHARACTERISTIC
/begin CHARACTERISTIC K_LAVK_ATIC42_IP_OFFSET_MEAS_B1 "ATIC42 Pumpstromoffset-Messung" VALUE 0x74508 TKW_VV_VV_UB 100.0 FORMULA_0879 0.0 1.0 /end CHARACTERISTIC
/begin CHARACTERISTIC K_LAVK_ATIC42_IP_OFFSET_MEAS_B2 "ATIC42 Pumpstromoffset-Messung" VALUE 0x74509 TKW_VV_VV_UB 100.0 FORMULA_0879 0.0 1.0 /end CHARACTERISTIC
/begin CHARACTERISTIC K_LAVK_ATIC42_PIN_CFG_B1 "ATIC42 PIN-Freigabe" VALUE 0x74518 TKW_VV_VV_UB 100.0 FORMULA_0884 0.0 1.0 /end CHARACTERISTIC
/begin CHARACTERISTIC K_LAVK_ATIC42_PIN_CFG_B2 "ATIC42 PIN-Freigabe" VALUE 0x74519 TKW_VV_VV_UB 100.0 FORMULA_0884 0.0 1.0 /end CHARACTERISTIC
/begin CHARACTERISTIC K_LAVK_ATIC42_PROTEC_TIME_B1 "ATIC42 Zeit in der der Sensor nach einem Fehler getrennt wird" VALUE 0x74514 TKW_VV_VV_UB 100.0 FORMULA_0882 0.800000011920929 1.5 /end CHARACTERISTIC
/begin CHARACTERISTIC K_LAVK_ATIC42_PROTEC_TIME_B2 "ATIC42 Zeit in der der Sensor nach einem Fehler getrennt wird" VALUE 0x74515 TKW_VV_VV_UB 100.0 FORMULA_0882 0.800000011920929 1.5 /end CHARACTERISTIC
/begin CHARACTERISTIC K_LAVK_ATIC42_RI_CALIB_B1 "ATIC42 Innenwiderstands Kalibrierung" VALUE 0x7450C TKW_VV_VV_UB 100.0 FORMULA_0879 0.0 1.0 /end CHARACTERISTIC
/begin CHARACTERISTIC K_LAVK_ATIC42_RI_CALIB_B2 "ATIC42 Innenwiderstands Kalibrierung" VALUE 0x7450D TKW_VV_VV_UB 100.0 FORMULA_0879 0.0 1.0 /end CHARACTERISTIC
/begin CHARACTERISTIC K_LAVK_ATIC42_RI_MEAS_FREQ_B1 "ATIC42 Frequenz der Oszillators zur Innenwiderstandsmessung" VALUE 0x74516 TKW_VV_VV_UB 100.0 FORMULA_0883 2.0 9.875 /end CHARACTERISTIC
/begin CHARACTERISTIC K_LAVK_ATIC42_RI_MEAS_FREQ_B2 "ATIC42 Frequenz der Oszillators zur Innenwiderstandsmessung" VALUE 0x74517 TKW_VV_VV_UB 100.0 FORMULA_0883 2.0 9.875 /end CHARACTERISTIC
/begin CHARACTERISTIC K_LAVK_ATIC42_RI_OSCI_B1 "ATIC42 Innenwiderstands Oszillator" VALUE 0x7450E TKW_VV_VV_UB 100.0 FORMULA_0879 0.0 1.0 /end CHARACTERISTIC
/begin CHARACTERISTIC K_LAVK_ATIC42_RI_OSCI_B2 "ATIC42 Innenwiderstands Oszillator" VALUE 0x7450F TKW_VV_VV_UB 100.0 FORMULA_0879 0.0 1.0 /end CHARACTERISTIC
/begin CHARACTERISTIC K_LAVK_ATIC42_SENSOR_B1 "ATIC42 Lambda Sonde" VALUE 0x74510 TKW_VV_VV_UB 100.0 FORMULA_0880 0.0 1.0 /end CHARACTERISTIC
/begin CHARACTERISTIC K_LAVK_ATIC42_SENSOR_B2 "ATIC42 Lambda Sonde" VALUE 0x74511 TKW_VV_VV_UB 100.0 FORMULA_0880 0.0 1.0 /end CHARACTERISTIC
/begin CHARACTERISTIC K_LAVK_FILT_CFG "Filterung IST-LA-Wert" VALUE 0x736B2 TKW_VV_VV_UW 100.0 FORMULA_0789 0.0 1.0 FORMAT "%5.2" /end CHARACTERISTIC
/begin CHARACTERISTIC K_LAVK_GAIN_LAM_SCHW "Umschaltschw. f. Signalverstaerkung" VALUE 0x73622 TKW_VV_VV_UW 100.0 FORMULA_0025 0.0 3.999000072479248 FORMAT "%6.3" /end CHARACTERISTIC
/begin CHARACTERISTIC K_LAVK_R7 "Widerstand R7" VALUE 0x73620 TKW_VV_VV_UW 100.0 FORMULA_0541 0.0 6553.5 FORMAT "%4.1" /end CHARACTERISTIC
/begin CHARACTERISTIC K_LAVK_US_LUFT_REF "Referenzspannung LUFT" VALUE 0x7364E TKW_VV_VV_UW 100.0 FORMULA_0536 0.0 5000.0 /end CHARACTERISTIC
/begin CHARACTERISTIC K_LAVK_US_REF "Referenzspannung lambda=1,0" VALUE 0x7361E TKW_VV_VV_UW 100.0 FORMULA_0536 0.0 5000.0 /end CHARACTERISTIC
/begin CHARACTERISTIC K_PKS_OBD_SOLL_DYN_TAU "Filterkonstante fuer Kraftstoffpumpen-Solldruck" VALUE 0x758AA TKW_VV_VV_UB 100.0 FORMULA_0658 1.009999960660934e-002 2.559999942779541 /end CHARACTERISTIC
/begin CHARACTERISTIC K_PKSR_ADAP_DELTA_FAK "PKSR-Adaptionsfaktor inc/-decrement" VALUE 0x758D2 TKW_VV_VV_SW 100.0 FORMULA_1041 0.0 3.200000047683716 FORMAT "%7.4" /end CHARACTERISTIC
/begin CHARACTERISTIC K_PKSR_ADAP_DELTA_OFF "PKSR-Adaptions Offset increment/decrement" VALUE 0x758CA TKW_VV_VV_SW 100.0 FORMULA_0557 0.0 1.0 FORMAT "%6.3" /end CHARACTERISTIC
/begin CHARACTERISTIC K_PKSR_ADAP_DIAG_T "Zeit im Adationsanschlag bis Fehlereintrag" VALUE 0x758F6 TKW_VV_VV_UW 100.0 FORMULA_0593 0.0 120.0 /end CHARACTERISTIC
/begin CHARACTERISTIC K_PKSR_ADAP_FAK_MAX "Max Adaptionsfaktor" VALUE 0x758E0 TKW_VV_VV_UW 100.0 FORMULA_0558 1.0 2.0 FORMAT "%7.4" /end CHARACTERISTIC
/begin CHARACTERISTIC K_PKSR_ADAP_FAK_MIN "Min Adaptionsfaktor" VALUE 0x758DE TKW_VV_VV_UW 100.0 FORMULA_0558 0.5 1.0 FORMAT "%7.4" /end CHARACTERISTIC
/begin CHARACTERISTIC K_PKSR_ADAP_FAK_ML_MIN "ml Schwelle fuer Faktor-Adaption ein" VALUE 0x758D4 TKW_VV_VV_SW 100.0 FORMULA_0103 -100.0 1400.0 FORMAT "%4.1" /end CHARACTERISTIC
/begin CHARACTERISTIC K_PKSR_ADAP_FAK_N_MIN "n Schwelle fuer Faktor-Adaption ein" VALUE 0x758D6 TKW_VV_VV_SW 100.0 FORMULA_0006 0.0 10000.0 /end CHARACTERISTIC
/begin CHARACTERISTIC K_PKSR_ADAP_OFF_MAX "Max Adaptionsoffset" VALUE 0x758DA TKW_VV_VV_SW 100.0 FORMULA_0557 0.0 15.0 FORMAT "%6.3" /end CHARACTERISTIC
/begin CHARACTERISTIC K_PKSR_ADAP_OFF_MIN "Min Adaptionsoffset" VALUE 0x758DC TKW_VV_VV_SW 100.0 FORMULA_0557 -15.0 0.0 FORMAT "%6.3" /end CHARACTERISTIC
/begin CHARACTERISTIC K_PKSR_ADAP_OFF_ML_MAX "ML Schwelle fuer Offset Adaption aus" VALUE 0x758CC TKW_VV_VV_SW 100.0 FORMULA_0103 -100.0 1400.0 FORMAT "%4.1" /end CHARACTERISTIC
/begin CHARACTERISTIC K_PKSR_ADAP_OFF_N_MAX "n Schwelle fuer Offset Adaption aus" VALUE 0x758CE TKW_VV_VV_SW 100.0 FORMULA_0006 0.0 10000.0 /end CHARACTERISTIC
/begin CHARACTERISTIC K_PKSR_ADAP_OFF_N_NORM "n Normierungswert fuer Verhaeltnis" VALUE 0x758D0 TKW_VV_VV_SW 100.0 FORMULA_0006 0.0 10000.0 /end CHARACTERISTIC
/begin CHARACTERISTIC K_PKSR_ADAP_RESET "Reset der Adaption" VALUE 0x758D8 TKW_VV_VV_UB 100.0 FORMULA_1042 0.0 1.0 BIT_MASK 0x1 /end CHARACTERISTIC
/begin CHARACTERISTIC K_PKSR_CFG "Konfiguration Kraftstoffdruckregelung" VALUE 0x758BE TKW_VV_VV_UB 100.0 FORMULA_1038 0.0 255.0 /end CHARACTERISTIC
/begin CHARACTERISTIC K_PKSR_DIAG "Diagnosebedingung f. Kraftstoffdruckregelung setzen" VALUE 0x758C2 TKW_VV_VV_UB 100.0 FORMULA_1039 0.0 255.0 /end CHARACTERISTIC
/begin CHARACTERISTIC K_PKSR_EKP_100_PSOLL_RAMPE "Delta fuer Rampe nach EKP_100Prozent auf Sollwert" VALUE 0x758BF TKW_VV_VV_UB 100.0 FORMULA_1033 0.0 10.0 /end CHARACTERISTIC
/begin CHARACTERISTIC K_PKSR_EKP_VORL_RESET "Reset fuer EKP Vorlaufsperre" VALUE 0x758F4 TKW_VV_VV_UW 100.0 FORMULA_0597 0.0 120.0 FORMAT "%5.2" /end CHARACTERISTIC
/begin CHARACTERISTIC K_PKSR_EXD_DELTA_P_VL "Schwelle Druckabfall Vorlauf" VALUE 0x758E8 TKW_VV_VV_SW 100.0 FORMULA_0110 0.0 5.0 FORMAT "%6.3" /end CHARACTERISTIC
/begin CHARACTERISTIC K_PKSR_EXD_DELTA_TV "Schwelle fuer max. Abweichung der Vorsteuerung und Regler" VALUE 0x758E2 TKW_VV_VV_SW 100.0 FORMULA_0161 0.0 20.0 FORMAT "%4.1" /end CHARACTERISTIC
/begin CHARACTERISTIC K_PKSR_EXD_EKP1_TV_MAX "Max. TV fuer EKP1 ohne EKP2" VALUE 0x758EA TKW_VV_VV_SW 100.0 FORMULA_0161 0.0 100.0 FORMAT "%4.1" /end CHARACTERISTIC
/begin CHARACTERISTIC K_PKSR_EXD_FSTLITH_MIN "Min.Schwelle fuer Fuelstand linke Tankhaelfte zu Diagnose" VALUE 0x758E6 TKW_VV_VV_UB 100.0 FORMULA_0559 0.0 100.0 /end CHARACTERISTIC
/begin CHARACTERISTIC K_PKSR_EXD_NMAX "N-MAX bei Prueflauf7" VALUE 0x758F2 TKW_VV_VV_SW 100.0 FORMULA_0006 0.0 10000.0 /end CHARACTERISTIC
/begin CHARACTERISTIC K_PKSR_EXD_P_GRAD_REL "Rel. Gradientenschwelle Erkennung DR-Oeffnungsbeginn" VALUE 0x758F1 TKW_VV_VV_UB 100.0 FORMULA_1043 0.0 100.0 /end CHARACTERISTIC
/begin CHARACTERISTIC K_PKSR_EXD_PDELTA_DR "Schwelle fuer min. Druckanstieg Oeff.beginn und Ende" VALUE 0x758E4 TKW_VV_VV_SW 100.0 FORMULA_0110 0.0 2.0 FORMAT "%6.3" /end CHARACTERISTIC
/begin CHARACTERISTIC K_PKSR_EXD_PDIF_T_ADAP "Adaptionszeit Gradient Druckanstieg" VALUE 0x758F0 TKW_VV_VV_UB 100.0 FORMULA_0461 0.0 25.5 /end CHARACTERISTIC
/begin CHARACTERISTIC K_PKSR_EXD_TAU_PDIF_PL "Filterkonstante fuer pksr_exd_pdif delta" VALUE 0x758EF TKW_VV_VV_UB 100.0 FORMULA_0679 0.1004000008106232 25.60000038146973 /end CHARACTERISTIC
/begin CHARACTERISTIC K_PKSR_EXD_TAU_PKS_PL "Filterkonstante fuer pks_rel Prueflauf" VALUE 0x758EE TKW_VV_VV_UB 100.0 FORMULA_0658 1.009999960660934e-002 2.559999942779541 /end CHARACTERISTIC
/begin CHARACTERISTIC K_PKSR_EXD_TV_65 "TV bei fuer Ermittlung Druckabfall" VALUE 0x758F8 TKW_VV_VV_SW 100.0 FORMULA_0161 -100.0 100.0 FORMAT "%4.1" /end CHARACTERISTIC
/begin CHARACTERISTIC K_PKSR_EXD_V_SSPLITH "Schwelle SSP Delta" VALUE 0x758E7 TKW_VV_VV_UB 100.0 FORMULA_0559 0.0 100.0 /end CHARACTERISTIC
/begin CHARACTERISTIC K_PKSR_I_ANTEIL_MAX "I-Anteil Max-Wert" VALUE 0x758B2 TKW_VV_VV_SW 100.0 FORMULA_0161 -50.0 50.0 FORMAT "%4.1" /end CHARACTERISTIC
/begin CHARACTERISTIC K_PKSR_I_ANTEIL_MIN "I-Anteil Min-Wert" VALUE 0x758B0 TKW_VV_VV_SW 100.0 FORMULA_0161 -50.0 50.0 FORMAT "%4.1" /end CHARACTERISTIC
/begin CHARACTERISTIC K_PKSR_MAX_TV_GEREGELT "Max. TV fuer geregelten Betrieb" VALUE 0x758EC TKW_VV_VV_SW 100.0 FORMULA_0161 -100.0 100.0 FORMAT "%4.1" /end CHARACTERISTIC
/begin CHARACTERISTIC K_PKSR_MLSOLL_EKP2 "Einschaltschwelle Fuellungsvorgabe f. EKP2" VALUE 0x758BA TKW_VV_VV_SW 100.0 FORMULA_0103 -100.0 1400.0 FORMAT "%4.1" /end CHARACTERISTIC
/begin CHARACTERISTIC K_PKSR_MLSOLL_HYS_EKP2 "Hysterese Fuellungsvorgabe f. Ein-/Ausschalten der EKP2" VALUE 0x758BC TKW_VV_VV_SW 100.0 FORMULA_0103 -100.0 1400.0 FORMAT "%4.1" /end CHARACTERISTIC
/begin CHARACTERISTIC K_PKSR_N_EKP2 "Einschaltschwelle Motordrehzahl f. EKP2" VALUE 0x758B6 TKW_VV_VV_SW 100.0 FORMULA_0006 0.0 10000.0 /end CHARACTERISTIC
/begin CHARACTERISTIC K_PKSR_N_HYS_EKP2 "Hysterese Motordrehzahl f. Ein-/Ausschalten der EKP2" VALUE 0x758B8 TKW_VV_VV_SW 100.0 FORMULA_0006 0.0 10000.0 /end CHARACTERISTIC
/begin CHARACTERISTIC K_PKSR_P_SSP_SA "Kraftstoffdruck an SSPs bei SA" VALUE 0x758AC TKW_VV_VV_SW 100.0 FORMULA_0110 0.0 10.0 FORMAT "%6.3" /end CHARACTERISTIC
/begin CHARACTERISTIC K_PKSR_PERIOD "Periodendauer der EKP-PWM" VALUE 0x758C8 TKW_VV_VV_UW 100.0 FORMULA_1040 1.0 65.0 FORMAT "%4.1" /end CHARACTERISTIC
/begin CHARACTERISTIC K_PKSR_PSOLL_MECH "Kraftstoffsolldruck des mechanischen Druckreglers" VALUE 0x758AE TKW_VV_VV_SW 100.0 FORMULA_0110 0.0 10.0 FORMAT "%6.3" /end CHARACTERISTIC
/begin CHARACTERISTIC K_PKSR_T_ABST "Nachlauf nach KLA" VALUE 0x758C6 TKW_VV_VV_UW 100.0 FORMULA_0021 0.0 655.0 FORMAT "%5.2" /end CHARACTERISTIC
/begin CHARACTERISTIC K_PKSR_T_VORLAUF "Vorlaufzeit der EKP bei KL15 EIN" VALUE 0x758C4 TKW_VV_VV_UW 100.0 FORMULA_0021 0.0 655.0 FORMAT "%5.2" /end CHARACTERISTIC
/begin CHARACTERISTIC K_PKSR_TMIN_EKP2 "Mindesteinschaltzeit d. EKP2" VALUE 0x758B4 TKW_VV_VV_SW 100.0 FORMULA_0021 0.0 10.0 FORMAT "%5.2" /end CHARACTERISTIC
/begin CHARACTERISTIC K_PKSR_TV_DIAG "vorerst Ersatz f. Diagnose: auszugebender TV-Wert" VALUE 0x758C0 TKW_VV_VV_SW 100.0 FORMULA_0161 0.0 100.0 FORMAT "%4.1" /end CHARACTERISTIC
/begin CHARACTERISTIC KF_LA_TRIM_AD_WICHT "Wichtungsfaktor auf lam_trim_ad" MAP 0x734D4 TKF_SW_SW_UW 100.0 FORMULA_0916 0.0 10.0 FORMAT "%5.2" /begin AXIS_DESCR STD_AXIS n FORMULA_0006 8 0.0 10000.0 MAX_GRAD 0.0 /end AXIS_DESCR
 /begin AXIS_DESCR STD_AXIS rf FORMULA_0007 8 0.0 2.0 MAX_GRAD 0.0 FORMAT "%6.3" /end AXIS_DESCR
/end CHARACTERISTIC
/begin CHARACTERISTIC KF_LA_TRIM_I "I-Anteil - Trimmregelung" MAP 0x731AA TKF_SW_SW_UW 100.0 FORMULA_0908 0.0 819.0 FORMAT "%5.2" /begin AXIS_DESCR STD_AXIS n FORMULA_0006 8 0.0 10000.0 MAX_GRAD 0.0 /end AXIS_DESCR
 /begin AXIS_DESCR STD_AXIS rf FORMULA_0007 8 0.0 2.0 MAX_GRAD 0.0 FORMAT "%6.3" /end AXIS_DESCR
/end CHARACTERISTIC
/begin CHARACTERISTIC KF_LA_TRIM_I_DLY "Haltezeit für I-Anteil" MAP 0x73390 TKF_SW_SW_UW 100.0 FORMULA_0021 0.0 655.3499755859375 FORMAT "%5.2" /begin AXIS_DESCR STD_AXIS n FORMULA_0006 8 0.0 10000.0 MAX_GRAD 0.0 /end AXIS_DESCR
 /begin AXIS_DESCR STD_AXIS rf FORMULA_0007 8 0.0 2.0 MAX_GRAD 0.0 FORMAT "%6.3" /end AXIS_DESCR
/end CHARACTERISTIC
/begin CHARACTERISTIC KF_LA_TRIM_I_GMW_WICHT "Wichtungsfaktor auf lam_trim_i_gmw" MAP 0x73576 TKF_SW_SW_UW 100.0 FORMULA_0916 0.0 10.0 FORMAT "%5.2" /begin AXIS_DESCR STD_AXIS n FORMULA_0006 8 0.0 10000.0 MAX_GRAD 0.0 /end AXIS_DESCR
 /begin AXIS_DESCR STD_AXIS rf FORMULA_0007 8 0.0 2.0 MAX_GRAD 0.0 FORMAT "%6.3" /end AXIS_DESCR
/end CHARACTERISTIC
/begin CHARACTERISTIC KF_LA_TRIM_P "P-Anteil - Trimmregelung" MAP 0x73108 TKF_SW_SW_UW 100.0 FORMULA_0025 0.0 3.999000072479248 FORMAT "%6.3" /begin AXIS_DESCR STD_AXIS n FORMULA_0006 8 0.0 10000.0 MAX_GRAD 0.0 /end AXIS_DESCR
 /begin AXIS_DESCR STD_AXIS rf FORMULA_0007 8 0.0 2.0 MAX_GRAD 0.0 FORMAT "%6.3" /end AXIS_DESCR
/end CHARACTERISTIC
/begin CHARACTERISTIC KF_LA_TRIM_P_ABR "Abregelungszeit P-Anteil" MAP 0x73432 TKF_SW_SW_UW 100.0 FORMULA_0021 0.0 655.3499755859375 FORMAT "%5.2" /begin AXIS_DESCR STD_AXIS n FORMULA_0006 8 0.0 10000.0 MAX_GRAD 0.0 /end AXIS_DESCR
 /begin AXIS_DESCR STD_AXIS rf FORMULA_0007 8 0.0 2.0 MAX_GRAD 0.0 FORMAT "%6.3" /end AXIS_DESCR
/end CHARACTERISTIC
/begin CHARACTERISTIC KF_LA_TRIM_P_DLY "Haltezeit für P-Anteil" MAP 0x7324C TKF_SW_SW_UW 100.0 FORMULA_0021 0.0 655.3499755859375 FORMAT "%5.2" /begin AXIS_DESCR STD_AXIS n FORMULA_0006 8 0.0 10000.0 MAX_GRAD 0.0 /end AXIS_DESCR
 /begin AXIS_DESCR STD_AXIS rf FORMULA_0007 8 0.0 2.0 MAX_GRAD 0.0 FORMAT "%6.3" /end AXIS_DESCR
/end CHARACTERISTIC
/begin CHARACTERISTIC KF_LA_TRIM_P_WAIT "Warteezeit für weiteren P-Anteil" MAP 0x732EE TKF_SW_SW_UW 100.0 FORMULA_0021 0.0 655.3499755859375 FORMAT "%5.2" /begin AXIS_DESCR STD_AXIS n FORMULA_0006 8 0.0 10000.0 MAX_GRAD 0.0 /end AXIS_DESCR
 /begin AXIS_DESCR STD_AXIS rf FORMULA_0007 8 0.0 2.0 MAX_GRAD 0.0 FORMAT "%6.3" /end AXIS_DESCR
/end CHARACTERISTIC
/begin CHARACTERISTIC KF_LA_TRIM_USN_SOLL "NKAT-Sollspannung - Trimmregelung" MAP 0x73066 TKF_SW_SW_UW 100.0 FORMULA_0536 0.0 1200.0 /begin AXIS_DESCR STD_AXIS n FORMULA_0006 8 0.0 10000.0 MAX_GRAD 0.0 /end AXIS_DESCR
 /begin AXIS_DESCR STD_AXIS rf FORMULA_0007 8 0.0 2.0 MAX_GRAD 0.0 FORMAT "%6.3" /end AXIS_DESCR
/end CHARACTERISTIC
/begin CHARACTERISTIC KF_LAM_REG_K "Reglerverstaerkung" MAP 0x737F8 TKF_SW_SW_SW 100.0 FORMULA_0754 -2.0 2.0 FORMAT "%5.2"
 /begin AXIS_DESCR STD_AXIS lam_delta_lim FORMULA_0025 7 -2.0 1.999899983406067 MAX_GRAD 0.0 FORMAT "%6.3" /end AXIS_DESCR
 /begin AXIS_DESCR STD_AXIS wf_mks_rel FORMULA_0073 3 0.0 31.99900054931641 MAX_GRAD 0.0 FORMAT "%6.3" /end AXIS_DESCR
/end CHARACTERISTIC
/begin CHARACTERISTIC KF_LAM_REG_KORR_F "Korrekturfaktor fuer Reglerverstaerkung" MAP 0x73838 TKF_SW_SW_UW 100.0 FORMULA_0073 0.0 4.0 FORMAT "%6.3"
 /begin AXIS_DESCR STD_AXIS lam_soll FORMULA_0025 4 0.0 1.999899983406067 MAX_GRAD 0.0 FORMAT "%6.3" /end AXIS_DESCR
 /begin AXIS_DESCR STD_AXIS tmot FORMULA_0023 4 -50.0 170.0 MAX_GRAD 0.0 FORMAT "%4.1" /end AXIS_DESCR
/end CHARACTERISTIC
/begin CHARACTERISTIC KF_LAM_REG_WF_MKS_REL_MAX "max. rel. Eingriff - WF-Modell" MAP 0x7389C TKF_SW_SW_UW 100.0 FORMULA_0073 0.0 4.0 FORMAT "%6.3" /begin AXIS_DESCR STD_AXIS n FORMULA_0006 6 0.0 10000.0 MAX_GRAD 0.0 /end AXIS_DESCR
 /begin AXIS_DESCR STD_AXIS rf FORMULA_0007 6 0.0 2.0 MAX_GRAD 0.0 FORMAT "%6.3" /end AXIS_DESCR
/end CHARACTERISTIC
/begin CHARACTERISTIC KF_LAM_REG_WF_VERZ_F "Verzoegerungsfaktor - Wandfilmeingriff" MAP 0x738FE TKF_SW_SW_UW 100.0 FORMULA_0793 0.0 127.9980010986328 FORMAT "%4.1" /begin AXIS_DESCR STD_AXIS n FORMULA_0006 6 0.0 10000.0 MAX_GRAD 0.0 /end AXIS_DESCR
 /begin AXIS_DESCR STD_AXIS rf FORMULA_0007 6 0.0 2.0 MAX_GRAD 0.0 FORMAT "%6.3" /end AXIS_DESCR
/end CHARACTERISTIC
/begin CHARACTERISTIC KF_LAM_SOLL_ADD_KONV "Lambdapulshub in Richtung MAGER/FETT" MAP 0x74178 TKF_SW_SW_UW 100.0 FORMULA_0025 0.0 3.999000072479248 FORMAT "%6.3" /begin AXIS_DESCR STD_AXIS n FORMULA_0006 8 0.0 10000.0 MAX_GRAD 0.0 /end AXIS_DESCR
 /begin AXIS_DESCR STD_AXIS rf FORMULA_0007 8 0.0 2.0 MAX_GRAD 0.0 FORMAT "%6.3" /end AXIS_DESCR
/end CHARACTERISTIC
/begin CHARACTERISTIC KF_LAM_SOLL_ADD_NEG_OBD "Lambdapulshub in Richtung FETT" MAP 0x74116 TKF_SW_SW_UW 100.0 FORMULA_0025 0.0 3.999000072479248 FORMAT "%6.3" /begin AXIS_DESCR STD_AXIS n FORMULA_0006 6 0.0 10000.0 MAX_GRAD 0.0 /end AXIS_DESCR
 /begin AXIS_DESCR STD_AXIS rf FORMULA_0007 6 0.0 2.0 MAX_GRAD 0.0 FORMAT "%6.3" /end AXIS_DESCR
/end CHARACTERISTIC
/begin CHARACTERISTIC KF_LAM_SOLL_ADD_POS_OBD "Lambdapulshub in Richtung MAGER" MAP 0x740B4 TKF_SW_SW_UW 100.0 FORMULA_0025 0.0 3.999000072479248 FORMAT "%6.3" /begin AXIS_DESCR STD_AXIS n FORMULA_0006 6 0.0 10000.0 MAX_GRAD 0.0 /end AXIS_DESCR
 /begin AXIS_DESCR STD_AXIS rf FORMULA_0007 6 0.0 2.0 MAX_GRAD 0.0 FORMAT "%6.3" /end AXIS_DESCR
/end CHARACTERISTIC
/begin CHARACTERISTIC KF_LAM_SOLL_AUSS_KATS "KATS-Lambda beim SK-Manager" MAP 0x73E4A TKF_SW_SW_UW 100.0 FORMULA_0025 0.0 3.999000072479248 FORMAT "%6.3" /begin AXIS_DESCR STD_AXIS n FORMULA_0006 6 0.0 10000.0 MAX_GRAD 0.0 /end AXIS_DESCR
 /begin AXIS_DESCR STD_AXIS rf FORMULA_0007 6 0.0 2.0 MAX_GRAD 0.0 FORMAT "%6.3" /end AXIS_DESCR
/end CHARACTERISTIC
/begin CHARACTERISTIC KF_LAM_SOLL_AUSS_OFFS "OFFSET auf KATS-Lambda beim SK-Manager" MAP 0x73EAC TKF_SW_SW_UW 100.0 FORMULA_0025 0.0 3.999000072479248 FORMAT "%6.3" /begin AXIS_DESCR STD_AXIS n FORMULA_0006 6 0.0 10000.0 MAX_GRAD 0.0 /end AXIS_DESCR
 /begin AXIS_DESCR STD_AXIS rf FORMULA_0007 6 0.0 2.0 MAX_GRAD 0.0 FORMAT "%6.3" /end AXIS_DESCR
/end CHARACTERISTIC
/begin CHARACTERISTIC KF_LAM_SOLL_GRUND "SOLL-Lambda - Normalbetrieb" MAP 0x73B44 TKF_SW_SW_UW 100.0 FORMULA_0025 0.800000011920929 1.019999980926514 FORMAT "%6.3" /begin AXIS_DESCR STD_AXIS n FORMULA_0006 12 0.0 10000.0 MAX_GRAD 0.0 /end AXIS_DESCR
 /begin AXIS_DESCR STD_AXIS rf FORMULA_0007 12 0.0 2.0 MAX_GRAD 0.0 FORMAT "%6.3" /end AXIS_DESCR
/end CHARACTERISTIC
/begin CHARACTERISTIC KF_LAM_SOLL_GRUND_PST "SOLL-Lambda - Normalbetrieb PST" MAP 0x73C96 TKF_SW_SW_UW 100.0 FORMULA_0025 0.0 3.999000072479248 FORMAT "%6.3" /begin AXIS_DESCR STD_AXIS n FORMULA_0006 12 0.0 10000.0 MAX_GRAD 0.0 /end AXIS_DESCR
 /begin AXIS_DESCR STD_AXIS rf FORMULA_0007 12 0.0 2.0 MAX_GRAD 0.0 FORMAT "%6.3" /end AXIS_DESCR
/end CHARACTERISTIC
/begin CHARACTERISTIC KF_LAM_SOLL_KR_KATS_OFFS "TZ-OFFSET aus KR" MAP 0x73DE8 TKF_SW_SW_SW 100.0 FORMULA_0102 -100.0 60.0 FORMAT "%4.1" /begin AXIS_DESCR STD_AXIS n FORMULA_0006 6 0.0 10000.0 MAX_GRAD 0.0 /end AXIS_DESCR
 /begin AXIS_DESCR STD_AXIS rf FORMULA_0007 6 0.0 2.0 MAX_GRAD 0.0 FORMAT "%6.3" /end AXIS_DESCR
/end CHARACTERISTIC
/begin CHARACTERISTIC KF_LAM_SOLL_MS_KAT_SOLL_MAX "relative Vorgabe fuer max. gespeicherte Sauerstoffmasse im KAT" MAP 0x73F0E TKF_SW_SW_SW 100.0 FORMULA_0001 0.0 100.0 FORMAT "%4.1" /begin AXIS_DESCR STD_AXIS n FORMULA_0006 8 0.0 10000.0 MAX_GRAD 0.0 /end AXIS_DESCR
 /begin AXIS_DESCR STD_AXIS rf FORMULA_0007 8 0.0 2.0 MAX_GRAD 0.0 FORMAT "%6.3" /end AXIS_DESCR
/end CHARACTERISTIC
/begin CHARACTERISTIC KF_LAM_SOLL_MS_KAT_SOLL_MIN "relative Vorgabe fuer min. gespeicherte Sauerstoffmasse im KAT" MAP 0x73FB0 TKF_SW_SW_SW 100.0 FORMULA_0001 0.0 100.0 FORMAT "%4.1" /begin AXIS_DESCR STD_AXIS n FORMULA_0006 8 0.0 10000.0 MAX_GRAD 0.0 /end AXIS_DESCR
 /begin AXIS_DESCR STD_AXIS rf FORMULA_0007 8 0.0 2.0 MAX_GRAD 0.0 FORMAT "%6.3" /end AXIS_DESCR
/end CHARACTERISTIC
/begin CHARACTERISTIC KF_LAM_SOLL_MS_KAT_SOLL_MIN_OBD "min. gespeicherte Sauerstoffmasse im KAT - O2-Ermittlung" MAP 0x74052 TKF_SW_SW_SW 100.0 FORMULA_0090 -3276.800048828125 3276.699951171875 FORMAT "%5.2" /begin AXIS_DESCR STD_AXIS n FORMULA_0006 6 0.0 10000.0 MAX_GRAD 0.0 /end AXIS_DESCR
 /begin AXIS_DESCR STD_AXIS rf FORMULA_0007 6 0.0 2.0 MAX_GRAD 0.0 FORMAT "%6.3" /end AXIS_DESCR
/end CHARACTERISTIC
/begin CHARACTERISTIC KF_LAM_SOLL_PULS_OFFS_AUSR "Pulshub - O2-Ausraeumfunktion" MAP 0x7421A TKF_SW_SW_UW 100.0 FORMULA_0025 0.0 3.999000072479248 FORMAT "%6.3" /begin AXIS_DESCR STD_AXIS n FORMULA_0006 8 0.0 10000.0 MAX_GRAD 0.0 /end AXIS_DESCR
 /begin AXIS_DESCR STD_AXIS rf FORMULA_0007 8 0.0 2.0 MAX_GRAD 0.0 FORMAT "%6.3" /end AXIS_DESCR
/end CHARACTERISTIC
/begin CHARACTERISTIC KF_LAM_SOLL_TAU1_ABG "Zeitkonstante Abgassystem u. Sonde" MAP 0x73AFE TKF_SW_SW_UW 100.0 FORMULA_0761 0.0 2097.0 /begin AXIS_DESCR STD_AXIS n FORMULA_0006 6 0.0 10000.0 MAX_GRAD 0.0 /end AXIS_DESCR
 /begin AXIS_DESCR STD_AXIS rf FORMULA_0007 4 0.0 2.0 MAX_GRAD 0.0 FORMAT "%6.3" /end AXIS_DESCR
/end CHARACTERISTIC
/begin CHARACTERISTIC KF_LAM_SOLL_WL "SOLL-Lambda - Warmlaufbetrieb" MAP 0x73A5C TKF_SW_SW_UW 100.0 FORMULA_0025 0.0 3.999000072479248 FORMAT "%6.3" /begin AXIS_DESCR STD_AXIS n FORMULA_0006 8 0.0 10000.0 MAX_GRAD 0.0 /end AXIS_DESCR
 /begin AXIS_DESCR STD_AXIS rf FORMULA_0007 8 0.0 2.0 MAX_GRAD 0.0 FORMAT "%6.3" /end AXIS_DESCR
/end CHARACTERISTIC
/begin CHARACTERISTIC KF_LAM_SOLL_WL_F "Korrekturfak. f. Zustand Warmlaufbetrieb" MAP 0x742BC TKF_SW_SW_UW 100.0 FORMULA_0073 0.0 4.0 FORMAT "%6.3"
 /begin AXIS_DESCR STD_AXIS tmot FORMULA_0023 8 -50.0 170.0 MAX_GRAD 0.0 FORMAT "%4.1" /end AXIS_DESCR
 /begin AXIS_DESCR STD_AXIS pumg FORMULA_0075 4 400.0 1200.0 MAX_GRAD 0.0 FORMAT "%4.1" /end AXIS_DESCR
/end CHARACTERISTIC
/begin CHARACTERISTIC KF_LAVK_FILT_T1 "Fiterkonstante IST-LA-Wert" MAP 0x7386A TKF_SW_SW_UW 100.0 FORMULA_0761 0.0 2097.0
 /begin AXIS_DESCR STD_AXIS lam_delta_lim FORMULA_0025 4 -2.0 1.999899983406067 MAX_GRAD 0.0 FORMAT "%6.3" /end AXIS_DESCR
 /begin AXIS_DESCR STD_AXIS n FORMULA_0006 4 0.0 10000.0 MAX_GRAD 0.0 /end AXIS_DESCR
/end CHARACTERISTIC
/begin CHARACTERISTIC KF_PKSR_PSOLL_QSOLL_TV "Tastverhaeltnis über Absolut-Solldruck u. Volumenstrom" MAP 0x75972 TKF_SW_SW_SW 100.0 FORMULA_0161 -100.0 3199.90234375 FORMAT "%4.1"
 /begin AXIS_DESCR STD_AXIS Volumenstrom FORMULA_0746 10 0.0 400.0 MAX_GRAD 0.0 FORMAT "%4.1" /end AXIS_DESCR
 /begin AXIS_DESCR STD_AXIS pks_soll FORMULA_0110 8 0.0 20.0 MAX_GRAD 0.0 FORMAT "%6.3" /end AXIS_DESCR
/end CHARACTERISTIC
/begin CHARACTERISTIC KF_PKSR_RF_N_PSOLL "Kraftstoffsolldruck (rel.) über Motorlast u. Drehzahl" MAP 0x75A38 TKF_SW_SW_SW 100.0 FORMULA_0110 0.0 10.0 FORMAT "%6.3"
 /begin AXIS_DESCR STD_AXIS rf FORMULA_0007 6 0.0 2.0 MAX_GRAD 0.0 FORMAT "%6.3" /end AXIS_DESCR
 /begin AXIS_DESCR STD_AXIS n FORMULA_0006 8 0.0 10000.0 MAX_GRAD 0.0 /end AXIS_DESCR
/end CHARACTERISTIC
/begin CHARACTERISTIC KL_KATS_LAM_I "I-Anteil Katschutz" CURVE 0x72E94 TKL_SW_VV_SW 100.0 FORMULA_0199 -0.5 0.5 FORMAT "%7.4"
 /begin AXIS_DESCR STD_AXIS tabg_mkat_b1 FORMULA_0074 4 -500.0 500.0 MAX_GRAD 0.0 FORMAT "%4.1" /end AXIS_DESCR
/end CHARACTERISTIC
/begin CHARACTERISTIC KL_KATS_MDL_LAM_OFFS "Lambda offset Katschutz" CURVE 0x72E82 TKL_SW_VV_SW 100.0 FORMULA_0025 -0.5 0.5 FORMAT "%6.3"
 /begin AXIS_DESCR STD_AXIS tabg_mdl_delta FORMULA_0074 4 -500.0 500.0 MAX_GRAD 0.0 FORMAT "%4.1" /end AXIS_DESCR
/end CHARACTERISTIC
/begin CHARACTERISTIC KL_KATS_NKAT_LAM_OFFS "Lambda offset Katschutz" CURVE 0x72E5E TKL_SW_VV_SW 100.0 FORMULA_0025 -0.5 0.5 FORMAT "%6.3"
 /begin AXIS_DESCR STD_AXIS tabg_nkat_delta FORMULA_0074 4 -500.0 500.0 MAX_GRAD 0.0 FORMAT "%4.1" /end AXIS_DESCR
/end CHARACTERISTIC
/begin CHARACTERISTIC KL_KATS_VKAT_LAM_OFFS "Lambda offset Katschutz" CURVE 0x72E70 TKL_SW_VV_SW 100.0 FORMULA_0025 -0.5 0.5 FORMAT "%6.3"
 /begin AXIS_DESCR STD_AXIS tabg_vkat_delta FORMULA_0074 4 -500.0 500.0 MAX_GRAD 0.0 FORMAT "%4.1" /end AXIS_DESCR
/end CHARACTERISTIC
/begin CHARACTERISTIC KL_KGE_MIN_INTG_B1 "Min-Schwelle fuer Integralwert IO Bank1" CURVE 0x72EBE TKL_SW_VV_UW 100.0 FORMULA_0564 0.0 6553.5 FORMAT "%4.1"
 /begin AXIS_DESCR STD_AXIS pumg FORMULA_0075 4 400.0 1200.0 MAX_GRAD 0.0 FORMAT "%4.1" /end AXIS_DESCR
/end CHARACTERISTIC
/begin CHARACTERISTIC KL_KGE_MIN_INTG_B2 "Min-Schwelle fuer Integralwert IO Bank2" CURVE 0x72ED0 TKL_SW_VV_UW 100.0 FORMULA_0564 0.0 6553.5 FORMAT "%4.1"
 /begin AXIS_DESCR STD_AXIS pumg FORMULA_0075 4 400.0 1200.0 MAX_GRAD 0.0 FORMAT "%4.1" /end AXIS_DESCR
/end CHARACTERISTIC
/begin CHARACTERISTIC KL_KGE_OZ_NIVR_KOR "Korrektur ueber OZ_NIV" CURVE 0x72EE2 TKL_UW_VV_UW 100.0 FORMULA_0073 0.0 4.0 FORMAT "%6.3"
 /begin AXIS_DESCR STD_AXIS Oz_nivr FORMULA_0603 3 0.1000000014901161 75.0 MAX_GRAD 0.0 FORMAT "%5.2" /end AXIS_DESCR
/end CHARACTERISTIC
/begin CHARACTERISTIC KL_LA_TRIM_I_FAK_OBD "Faktor I-Anteil aus KAT-Alterung" CURVE 0x72F9A TKL_UW_VV_UW 100.0 FORMULA_0073 0.0 4.0 FORMAT "%6.3"
 /begin AXIS_DESCR STD_AXIS kat_obd_wert FORMULA_0025 8 0.0 3.999000072479248 MAX_GRAD 0.0 FORMAT "%6.3" /end AXIS_DESCR
/end CHARACTERISTIC
/begin CHARACTERISTIC KL_LA_TRIM_I_GMW_RF_MAX "max. relative Füllung - Mittelwert I-Anteil" CURVE 0x73044 TKL_SW_VV_SW 100.0 FORMULA_0007 0.0 2.0 FORMAT "%6.3" /begin AXIS_DESCR STD_AXIS n FORMULA_0006 8 0.0 10000.0 MAX_GRAD 0.0 /end AXIS_DESCR /end CHARACTERISTIC
/begin CHARACTERISTIC KL_LA_TRIM_I_GMW_RF_MIN "min. relative Füllung - Mittelwert I-Anteil" CURVE 0x73022 TKL_SW_VV_SW 100.0 FORMULA_0007 0.0 2.0 FORMAT "%6.3" /begin AXIS_DESCR STD_AXIS n FORMULA_0006 8 0.0 10000.0 MAX_GRAD 0.0 /end AXIS_DESCR /end CHARACTERISTIC
/begin CHARACTERISTIC KL_LA_TRIM_P_FAK_OBD "Faktor P-Anteil aus KAT-Alterung" CURVE 0x72FBC TKL_UW_VV_UW 100.0 FORMULA_0073 0.0 4.0 FORMAT "%6.3"
 /begin AXIS_DESCR STD_AXIS kat_obd_wert FORMULA_0025 8 0.0 3.999000072479248 MAX_GRAD 0.0 FORMAT "%6.3" /end AXIS_DESCR
/end CHARACTERISTIC
/begin CHARACTERISTIC KL_LA_TRIM_RF_MAX "max. relative Füllung - LA-TRIM" CURVE 0x73000 TKL_SW_VV_SW 100.0 FORMULA_0007 0.0 2.0 FORMAT "%6.3" /begin AXIS_DESCR STD_AXIS n FORMULA_0006 8 0.0 10000.0 MAX_GRAD 0.0 /end AXIS_DESCR /end CHARACTERISTIC
/begin CHARACTERISTIC KL_LA_TRIM_RF_MIN "min. relative Füllung - LA-TRIM" CURVE 0x72FDE TKL_SW_VV_SW 100.0 FORMULA_0007 0.0 2.0 FORMAT "%6.3" /begin AXIS_DESCR STD_AXIS n FORMULA_0006 8 0.0 10000.0 MAX_GRAD 0.0 /end AXIS_DESCR /end CHARACTERISTIC
/begin CHARACTERISTIC KL_LAM_IST "IST-Lambda" CURVE 0x736EE TKL_SW_VV_UW 100.0 FORMULA_0025 0.0 3.999000072479248 FORMAT "%6.3"
 /begin AXIS_DESCR STD_AXIS lavk_ip_korr FORMULA_0750 24 -10.0 9.999600410461426 MAX_GRAD 0.0 FORMAT "%7.4" /end AXIS_DESCR
/end CHARACTERISTIC
/begin CHARACTERISTIC KL_LAM_REG_RESET_SA_ML_SUM "min. aufsummierter Luftmassenstr. im ZUST_SA" CURVE 0x737D6 TKL_SW_VV_UW 100.0 FORMULA_0792 0.0 65535.0 /begin AXIS_DESCR STD_AXIS n FORMULA_0006 8 0.0 10000.0 MAX_GRAD 0.0 /end AXIS_DESCR /end CHARACTERISTIC
/begin CHARACTERISTIC KL_LAM_REG_T_SA_VERZ "Wartezeit LA-Regler nach SA" CURVE 0x737B4 TKL_SW_VV_UW 100.0 FORMULA_0752 0.0 65.53500366210938 FORMAT "%6.3" /begin AXIS_DESCR STD_AXIS n FORMULA_0006 8 0.0 10000.0 MAX_GRAD 0.0 /end AXIS_DESCR /end CHARACTERISTIC
/begin CHARACTERISTIC KL_LAM_SOLL_ADD_KAT_ALT_F "Wichtungsfaktor ueber KAT-Alterung" CURVE 0x739EC TKL_UW_VV_UW 100.0 FORMULA_0073 0.0 4.0 FORMAT "%6.3"
 /begin AXIS_DESCR STD_AXIS kat_obd_wert_nv FORMULA_0025 6 0.0 3.999000072479248 MAX_GRAD 0.0 FORMAT "%6.3" /end AXIS_DESCR
/end CHARACTERISTIC
/begin CHARACTERISTIC KL_LAM_SOLL_AUSS_F "Korrekturfak. f. Zustand Sicherheitskonzept" CURVE 0x73A06 TKL_SW_VV_UW 100.0 FORMULA_0073 0.0 4.0 FORMAT "%6.3"
 /begin AXIS_DESCR STD_AXIS tmot_modell FORMULA_0023 8 -50.0 170.0 MAX_GRAD 0.0 FORMAT "%4.1" /end AXIS_DESCR
/end CHARACTERISTIC
/begin CHARACTERISTIC KL_LAM_SOLL_MS_KAT_MAX "KAT befuellt mit max. Sauerstoffmasse" CURVE 0x73A28 TKL_UW_VV_SW 100.0 FORMULA_0804 -3276.800048828125 3276.699951171875 FORMAT "%4.1"
 /begin AXIS_DESCR STD_AXIS kat_obd_wert_gesamt_nv FORMULA_0025 6 0.0 3.999000072479248 MAX_GRAD 0.0 FORMAT "%6.3" /end AXIS_DESCR
/end CHARACTERISTIC
/begin CHARACTERISTIC KL_LAM_SOLL_MS_KAT_SOLL_HYS "relative Vorgabe d. Hysterese auf max. Sauerstoffmasse" CURVE 0x73A42 TKL_UW_VV_SW 100.0 FORMULA_0001 0.0 100.0 FORMAT "%4.1"
 /begin AXIS_DESCR STD_AXIS kat_obd_wert_gesamt_nv FORMULA_0025 6 0.0 3.999000072479248 MAX_GRAD 0.0 FORMAT "%6.3" /end AXIS_DESCR
/end CHARACTERISTIC
/begin CHARACTERISTIC KL_LAM_SOLL_PULS_ADD_OBD "Pulshub f. Pulsgenerator OBD" CURVE 0x739E2 TKL_UW_VV_SW 100.0 FORMULA_0025 -2.0 1.999899983406067 FORMAT "%6.3" /begin AXIS_DESCR STD_AXIS Abgasbank FORMULA_0010 2 1.0 2.0 MAX_GRAD 0.0 /end AXIS_DESCR /end CHARACTERISTIC
/begin CHARACTERISTIC KL_LAM_SOLL_PULS_PW_OBD "Pulsdauer f. Pulsgenerator OBD" CURVE 0x739D8 TKL_UW_VV_UW 100.0 FORMULA_0021 0.0 655.3499755859375 FORMAT "%5.2" /begin AXIS_DESCR STD_AXIS Abgasbank FORMULA_0010 2 1.0 2.0 MAX_GRAD 0.0 /end AXIS_DESCR /end CHARACTERISTIC
/begin CHARACTERISTIC KL_LAM_SOLL_START "SOLL-Lambda von START -> ML" CURVE 0x7399C TKL_SW_VV_UW 100.0 FORMULA_0025 0.0 3.999000072479248 FORMAT "%6.3"
 /begin AXIS_DESCR STD_AXIS tmot FORMULA_0023 6 -50.0 170.0 MAX_GRAD 0.0 FORMAT "%4.1" /end AXIS_DESCR
/end CHARACTERISTIC
/begin CHARACTERISTIC KL_LAM_SOLL_VL "SOLL-Lambda - Vollast" CURVE 0x739B6 TKL_SW_VV_UW 100.0 FORMULA_0025 0.0 3.999000072479248 FORMAT "%6.3" /begin AXIS_DESCR STD_AXIS n FORMULA_0006 8 0.0 10000.0 MAX_GRAD 0.0 /end AXIS_DESCR /end CHARACTERISTIC
/begin CHARACTERISTIC KL_LAVK_IST_F "Adaptionsfaktor der Lambdasonde" CURVE 0x736CA TKL_UW_VV_UW 100.0 FORMULA_0073 0.0 4.0 FORMAT "%6.3" /begin AXIS_DESCR STD_AXIS Abgasbank FORMULA_0010 2 1.0 2.0 MAX_GRAD 0.0 /end AXIS_DESCR /end CHARACTERISTIC
/begin CHARACTERISTIC KL_LAVK_IST_OFFS "Adaptionsoffset der Lambdasonde" CURVE 0x736C0 TKL_UW_VV_SW 100.0 FORMULA_0536 -5000.0 5000.0 /begin AXIS_DESCR STD_AXIS Abgasbank FORMULA_0010 2 1.0 2.0 MAX_GRAD 0.0 /end AXIS_DESCR /end CHARACTERISTIC
/begin CHARACTERISTIC KL_LAVK_P_KORR_F_FETT "Korrekturfaktor FETT - Druckgang Sonde" CURVE 0x73750 TKL_SW_VV_UW 100.0 FORMULA_0073 0.0 4.0 FORMAT "%6.3"
 /begin AXIS_DESCR STD_AXIS pabg FORMULA_0075 12 0.0 2000.0 MAX_GRAD 0.0 FORMAT "%4.1" /end AXIS_DESCR
/end CHARACTERISTIC
/begin CHARACTERISTIC KL_LAVK_P_KORR_F_MAGER "Korrekturfaktor MAGER - Druckgang Sonde" CURVE 0x73782 TKL_SW_VV_UW 100.0 FORMULA_0073 0.0 4.0 FORMAT "%6.3"
 /begin AXIS_DESCR STD_AXIS pabg FORMULA_0075 12 0.0 2000.0 MAX_GRAD 0.0 FORMAT "%4.1" /end AXIS_DESCR
/end CHARACTERISTIC
/begin CHARACTERISTIC KL_LAVK_T_KORR_F "Korrekturfaktor - Temperaturgang Sonde" CURVE 0x736D4 TKL_SW_VV_UW 100.0 FORMULA_0073 0.0 4.0 FORMAT "%6.3"
 /begin AXIS_DESCR STD_AXIS lshvk_temp_dif FORMULA_0791 6 -1300.0 1300.0 MAX_GRAD 0.0 /end AXIS_DESCR
/end CHARACTERISTIC
/begin CHARACTERISTIC KL_PKSR_100P_DAUER_TMOT "Dauer 100% Laufzeit bei kaltem Motor" CURVE 0x75958 TKL_SW_VV_UW 100.0 FORMULA_0021 0.0 655.0 FORMAT "%5.2"
 /begin AXIS_DESCR STD_AXIS tmot_start FORMULA_0023 6 -50.0 170.0 MAX_GRAD 0.0 FORMAT "%4.1" /end AXIS_DESCR
/end CHARACTERISTIC
/begin CHARACTERISTIC KL_PKSR_I_FAKTOR "I-Faktor über Druckabweichung" CURVE 0x75926 TKL_SW_VV_UW 100.0 FORMULA_1045 0.0 1000.0 FORMAT "%4.1"
 /begin AXIS_DESCR STD_AXIS p_diff FORMULA_0110 5 -10.0 10.0 MAX_GRAD 0.0 FORMAT "%6.3" /end AXIS_DESCR
/end CHARACTERISTIC
/begin CHARACTERISTIC KL_PKSR_P_FAKTOR "P-Faktor ueber Druckabweichung" CURVE 0x75910 TKL_SW_VV_UW 100.0 FORMULA_1044 0.0 500.0 FORMAT "%4.1"
 /begin AXIS_DESCR STD_AXIS p_diff FORMULA_0110 5 -10.0 10.0 MAX_GRAD 0.0 FORMAT "%6.3" /end AXIS_DESCR
/end CHARACTERISTIC
/begin CHARACTERISTIC KL_PKSR_QSSP_PKS "Volumenstrom SSPs über Istdruck (rel.)" CURVE 0x758FA TKL_SW_VV_SW 100.0 FORMULA_0746 0.0 250.0 FORMAT "%4.1"
 /begin AXIS_DESCR STD_AXIS pks_rel FORMULA_0110 5 0.0 10.0 MAX_GRAD 0.0 FORMAT "%6.3" /end AXIS_DESCR
/end CHARACTERISTIC
/begin CHARACTERISTIC KL_PKSR_TKSM_PSOLL "Kraftstoffsolldruck ueber Temperatur" CURVE 0x7593C TKL_SW_VV_SW 100.0 FORMULA_0110 0.0 10.0 FORMAT "%6.3"
 /begin AXIS_DESCR STD_AXIS tksm FORMULA_0023 4 -50.0 170.0 MAX_GRAD 0.0 FORMAT "%4.1" /end AXIS_DESCR
/end CHARACTERISTIC
/begin CHARACTERISTIC KL_PKSR_TV_HARDWARE "Korrekturkennlinie TV f. Helbako A-Muster" CURVE 0x7594E TKL_SW_VV_SW 100.0 FORMULA_0161 0.0 100.0 FORMAT "%4.1"
 /begin AXIS_DESCR STD_AXIS tv_in FORMULA_0161 2 0.0 100.0 MAX_GRAD 0.0 FORMAT "%4.1" /end AXIS_DESCR
/end CHARACTERISTIC
/begin MEASUREMENT Bsdcontrol "3 Byte Schnittstelle für kt_ibs" UBYTE FORMULA_1245 0 0.0 0.0 255.0 READ_WRITE ECU_ADDRESS 0x3FB0D8 /end MEASUREMENT
/begin MEASUREMENT Bsddata "3 Byte Schnittstelle kt_ibs" UBYTE FORMULA_0003 0 0.0 0.0 255.0 READ_WRITE ECU_ADDRESS 0x3FB0DA /end MEASUREMENT
/begin MEASUREMENT Bsdregadr "3 Byte Schnittstelle für kt_ibs" UBYTE FORMULA_0003 0 0.0 0.0 255.0 READ_WRITE ECU_ADDRESS 0x3FB0D9 /end MEASUREMENT
/begin MEASUREMENT ipk_error_100ms.cnt "Fehlerzaehler" UBYTE FORMULA_0003 0 0.0 0.0 255.0 READ_WRITE ECU_ADDRESS 0x3FC056 /end MEASUREMENT
/begin MEASUREMENT ipk_error_100ms.type "Fehlertype" UBYTE FORMULA_0351 0 0.0 0.0 255.0 READ_WRITE ECU_ADDRESS 0x3FC055 /end MEASUREMENT
/begin MEASUREMENT ipk_error_10ms.cnt "Fehlerzaehler" UBYTE FORMULA_0003 0 0.0 0.0 255.0 READ_WRITE ECU_ADDRESS 0x3FC054 /end MEASUREMENT
/begin MEASUREMENT ipk_error_10ms.type "Fehlertype" UBYTE FORMULA_0351 0 0.0 0.0 255.0 READ_WRITE ECU_ADDRESS 0x3FC053 /end MEASUREMENT
/begin MEASUREMENT ipk_error_5ms.cnt "Fehlerzaehler" UBYTE FORMULA_0003 0 0.0 0.0 255.0 READ_WRITE ECU_ADDRESS 0x3FC052 /end MEASUREMENT
/begin MEASUREMENT ipk_error_5ms.type "Fehlertype" UBYTE FORMULA_0351 0 0.0 0.0 255.0 READ_WRITE ECU_ADDRESS 0x3FC051 /end MEASUREMENT
/begin MEASUREMENT ipk_error_bgnd.cnt "Fehlerzaehler" UBYTE FORMULA_0003 0 0.0 0.0 255.0 READ_WRITE ECU_ADDRESS 0x3FC058 /end MEASUREMENT
/begin MEASUREMENT ipk_error_bgnd.type "Fehlertype" UBYTE FORMULA_0351 0 0.0 0.0 255.0 READ_WRITE ECU_ADDRESS 0x3FC057 /end MEASUREMENT
/begin MEASUREMENT ipk_error_kwp.cnt "Fehlerzaehler" UBYTE FORMULA_0003 0 0.0 0.0 255.0 READ_WRITE ECU_ADDRESS 0x3FC05A /end MEASUREMENT
/begin MEASUREMENT ipk_error_kwp.type "Fehlertype" UBYTE FORMULA_0351 0 0.0 0.0 255.0 READ_WRITE ECU_ADDRESS 0x3FC059 /end MEASUREMENT
/begin MEASUREMENT ipk_error_segm.cnt "Fehlerzaehler" UBYTE FORMULA_0003 0 0.0 0.0 255.0 READ_WRITE ECU_ADDRESS 0x3FC050 /end MEASUREMENT
/begin MEASUREMENT ipk_error_segm.type "Fehlertype" UBYTE FORMULA_0351 0 0.0 0.0 255.0 READ_WRITE ECU_ADDRESS 0x3FC04F /end MEASUREMENT
/begin MEASUREMENT kats_ausloeser_b1 "Temperatur die den Kats ausgeloest hat" UBYTE FORMULA_0727 0 0.0 0.0 255.0 READ_WRITE ECU_ADDRESS 0x3FC072 /end MEASUREMENT
/begin MEASUREMENT kats_ausloeser_b2 "Temperatur die den Kats ausgeloest hat" UBYTE FORMULA_0727 0 0.0 0.0 255.0 READ_WRITE ECU_ADDRESS 0x3FC073 /end MEASUREMENT
/begin MEASUREMENT kats_lam_i_b1 "I-Anteil Katschutz" SWORD FORMULA_0199 0 0.0 -0.5 0.5 READ_WRITE ECU_ADDRESS 0x3FC078 /end MEASUREMENT
/begin MEASUREMENT kats_lam_i_b2 "I-Anteil Katschutz" SWORD FORMULA_0199 0 0.0 -0.5 0.5 READ_WRITE ECU_ADDRESS 0x3FC07A /end MEASUREMENT
/begin MEASUREMENT kats_lam_min_t "Zeit in der lam_min Begrenzung" UWORD FORMULA_0071 0 0.0 0.0 6553.5 READ_WRITE ARRAY_SIZE 2 ECU_ADDRESS 0x3FC084 MATRIX_DIM 2 1 1 /end MEASUREMENT
/begin MEASUREMENT kats_lam_p_b1 "P-Anteil Katschutz" SWORD FORMULA_0025 0 0.0 -0.5 0.5 READ_WRITE ECU_ADDRESS 0x3FC074 /end MEASUREMENT
/begin MEASUREMENT kats_lam_p_b2 "P-Anteil Katschutz" SWORD FORMULA_0025 0 0.0 -0.5 0.5 READ_WRITE ECU_ADDRESS 0x3FC076 /end MEASUREMENT
/begin MEASUREMENT kats_lam_p_delta_max_b1 "Gradient des P-Anteils" SWORD FORMULA_0199 0 0.0 -2.0 1.999899983406067 READ_WRITE ECU_ADDRESS 0x3FC07C /end MEASUREMENT
/begin MEASUREMENT kats_lam_p_delta_max_b2 "Gradient des P-Anteils" SWORD FORMULA_0199 0 0.0 -2.0 1.999899983406067 READ_WRITE ECU_ADDRESS 0x3FC07E /end MEASUREMENT
/begin MEASUREMENT kats_lam_p_max_b1 "MAX P-Anteil im Zustand Einfangen" SWORD FORMULA_0025 0 0.0 -0.5 0.5 READ_WRITE ECU_ADDRESS 0x3FC080 /end MEASUREMENT
/begin MEASUREMENT kats_lam_p_max_b2 "MAX P-Anteil im Zustand Einfangen" SWORD FORMULA_0025 0 0.0 -0.5 0.5 READ_WRITE ECU_ADDRESS 0x3FC082 /end MEASUREMENT
/begin MEASUREMENT kats_lam_soll_b1 "SOLL-Lambda + KAT-SCHUTZ" UWORD FORMULA_0025 0 0.0 0.0 3.999000072479248 READ_WRITE ECU_ADDRESS 0x3FC068 /end MEASUREMENT
/begin MEASUREMENT kats_lam_soll_b2 "SOLL-Lambda + KAT-SCHUTZ" UWORD FORMULA_0025 0 0.0 0.0 3.999000072479248 READ_WRITE ECU_ADDRESS 0x3FC06A /end MEASUREMENT
/begin MEASUREMENT kats_lam_soll_roh_b1 "SOLL-Lambda - nach Maxauswahl der Offsets" UWORD FORMULA_0025 0 0.0 0.0 3.999000072479248 READ_WRITE ECU_ADDRESS 0x3FC06C /end MEASUREMENT
/begin MEASUREMENT kats_lam_soll_roh_b2 "SOLL-Lambda - nach Maxauswahl der Offsets" UWORD FORMULA_0025 0 0.0 0.0 3.999000072479248 READ_WRITE ECU_ADDRESS 0x3FC06E /end MEASUREMENT
/begin MEASUREMENT kats_mdl_lam_offs_b1 "Kats Lambda offset aus nkat(Modell)" SWORD FORMULA_0025 0 0.0 -0.5 0.5 READ_WRITE ECU_ADDRESS 0x3FC060 /end MEASUREMENT
/begin MEASUREMENT kats_mdl_lam_offs_b2 "Kats Lambda offset aus nkat(Modell)" SWORD FORMULA_0025 0 0.0 -0.5 0.5 READ_WRITE ECU_ADDRESS 0x3FC062 /end MEASUREMENT
/begin MEASUREMENT kats_nkat_lam_offs_b1 "Kats Lambda soll aus nkat(Messung)" SWORD FORMULA_0025 0 0.0 -0.5 0.5 READ_WRITE ECU_ADDRESS 0x3FC064 /end MEASUREMENT
/begin MEASUREMENT kats_nkat_lam_offs_b2 "Kats Lambda soll aus nkat(Messung)" SWORD FORMULA_0025 0 0.0 -0.5 0.5 READ_WRITE ECU_ADDRESS 0x3FC066 /end MEASUREMENT
/begin MEASUREMENT kats_st_b1 "Katschutz-Status" UBYTE FORMULA_0726 0 0.0 0.0 255.0 READ_WRITE ECU_ADDRESS 0x3FC070 /end MEASUREMENT
/begin MEASUREMENT kats_st_b2 "Katschutz-Status" UBYTE FORMULA_0726 0 0.0 0.0 255.0 READ_WRITE ECU_ADDRESS 0x3FC071 /end MEASUREMENT
/begin MEASUREMENT kats_vkat_lam_offs_b1 "Kats Lambda-Offset aus vkat" SWORD FORMULA_0025 0 0.0 -0.5 0.5 READ_WRITE ECU_ADDRESS 0x3FC05C /end MEASUREMENT
/begin MEASUREMENT kats_vkat_lam_offs_b2 "Kats Lambda-Offset aus vkat" SWORD FORMULA_0025 0 0.0 -0.5 0.5 READ_WRITE ECU_ADDRESS 0x3FC05E /end MEASUREMENT
/begin MEASUREMENT kge_ml_abs_b1 "Luftmassenstrom-AC absolut" SWORD FORMULA_0103 0 0.0 -100.0 1400.0 READ_WRITE ECU_ADDRESS 0x3FC090 /end MEASUREMENT
/begin MEASUREMENT kge_ml_abs_b2 "Luftmassenstrom-AC absolut" SWORD FORMULA_0103 0 0.0 -100.0 1400.0 READ_WRITE ECU_ADDRESS 0x3FC092 /end MEASUREMENT
/begin MEASUREMENT kge_ml_ac_b1 "Luftmassenstrom ohne Gleichanteil (AC)" SWORD FORMULA_0103 0 0.0 -100.0 1400.0 READ_WRITE ECU_ADDRESS 0x3FC08C /end MEASUREMENT
/begin MEASUREMENT kge_ml_ac_b2 "Luftmassenstrom ohne Gleichanteil (AC)" SWORD FORMULA_0103 0 0.0 -100.0 1400.0 READ_WRITE ECU_ADDRESS 0x3FC08E /end MEASUREMENT
/begin MEASUREMENT kge_ml_fil_b1 "Luftmassenstrom gefiltert" SWORD FORMULA_0103 0 0.0 -100.0 1400.0 READ_WRITE ECU_ADDRESS 0x3FC088 /end MEASUREMENT
/begin MEASUREMENT kge_ml_fil_b2 "Luftmassenstrom gefiltert" SWORD FORMULA_0103 0 0.0 -100.0 1400.0 READ_WRITE ECU_ADDRESS 0x3FC08A /end MEASUREMENT
/begin MEASUREMENT kge_ml_intg_b1 "Luftmassenstrom-Integral ueber Diagnosezeit" UWORD FORMULA_0564 0 0.0 0.0 6553.5 READ_WRITE ECU_ADDRESS 0x3FC094 /end MEASUREMENT
/begin MEASUREMENT kge_ml_intg_b2 "Luftmassenstrom-Integral ueber Diagnosezeit" UWORD FORMULA_0564 0 0.0 0.0 6553.5 READ_WRITE ECU_ADDRESS 0x3FC096 /end MEASUREMENT
/begin MEASUREMENT kge_ml_intg_kor "Luftmassenstrom-Integral ueber Diagnosezeit korregiert" UWORD FORMULA_0564 0 0.0 0.0 6553.5 READ_WRITE ARRAY_SIZE 2 ECU_ADDRESS 0x3FC098 MATRIX_DIM 2 1 1 /end MEASUREMENT
/begin MEASUREMENT kge_ml_mw_intg "Mittelwert Luftmassenstrom-Integral ueber mehrer Fenster" UWORD FORMULA_0564 0 0.0 0.0 6553.5 READ_WRITE ARRAY_SIZE 2 ECU_ADDRESS 0x3FC0A2 MATRIX_DIM 2 1 1 /end MEASUREMENT
/begin MEASUREMENT kge_status_b1 "Statusvariable Kurbelgehaeuseentlueftungsdiagnose" UBYTE FORMULA_0730 0 0.0 0.0 8.0 READ_WRITE ECU_ADDRESS 0x3FC09C /end MEASUREMENT
/begin MEASUREMENT kge_status_b2 "Statusvariable Kurbelgehaeuseentlueftungsdiagnose" UBYTE FORMULA_0730 0 0.0 0.0 8.0 READ_WRITE ECU_ADDRESS 0x3FC09D /end MEASUREMENT
/begin MEASUREMENT kge_time_ll_b1 "Zeit seit keiner Sperrbedingung" UWORD FORMULA_0109 0 0.0 0.0 325.0 READ_WRITE ECU_ADDRESS 0x3FC09E /end MEASUREMENT
/begin MEASUREMENT kge_time_ll_b2 "Zeit seit keiner Sperrbedingung" UWORD FORMULA_0109 0 0.0 0.0 325.0 READ_WRITE ECU_ADDRESS 0x3FC0A0 /end MEASUREMENT
/begin MEASUREMENT kw_ed_delta_n_rate "Aktuelle Fehlerrate Startversuch." UWORD FORMULA_0010 0 0.0 0.0 65535.0 READ_WRITE ECU_ADDRESS 0x3FC1B8 /end MEASUREMENT
/begin MEASUREMENT kw_ed_n_drop_rate "Aktuelle Fehlerrate Abriss." UWORD FORMULA_0010 0 0.0 0.0 65535.0 READ_WRITE ECU_ADDRESS 0x3FC1BA /end MEASUREMENT
/begin MEASUREMENT kw_ed_sh_to_gnd_rate "Aktuelle Fehlerrate Kurzschluss nach Masse." UWORD FORMULA_0010 0 0.0 0.0 65535.0 READ_WRITE ECU_ADDRESS 0x3FC1BE /end MEASUREMENT
/begin MEASUREMENT kw_ed_sh_to_ub_rate "Aktuelle Fehlerrate Kurzschluss nach Ub." UWORD FORMULA_0010 0 0.0 0.0 65535.0 READ_WRITE ECU_ADDRESS 0x3FC1BC /end MEASUREMENT
/begin MEASUREMENT la_trim_diag_f_b1 "Fett-Verdacht" UWORD FORMULA_0911 0 0 0.0 255.0 READ_WRITE BIT_MASK 0x2 ECU_ADDRESS 0x3FC264 /end MEASUREMENT
/begin MEASUREMENT la_trim_diag_f_b2 "Fett-Verdacht" UWORD FORMULA_0911 0 0 0.0 255.0 READ_WRITE BIT_MASK 0x2 ECU_ADDRESS 0x3FC266 /end MEASUREMENT
/begin MEASUREMENT la_trim_diag_i_ad_f_b1 "Aufweitungsfaktor auf d. I-Adaptions-Bereichsgrenzen" UWORD FORMULA_0073 0 0.0 0.0 4.0 READ_WRITE ECU_ADDRESS 0x3FC268 /end MEASUREMENT
/begin MEASUREMENT la_trim_diag_i_ad_f_b2 "Aufweitungsfaktor auf d. I-Adaptions-Bereichsgrenzen" UWORD FORMULA_0073 0 0.0 0.0 4.0 READ_WRITE ECU_ADDRESS 0x3FC26A /end MEASUREMENT
/begin MEASUREMENT la_trim_diag_i_ad_max_cnt_b1 "Anzahl I-Adaption max. Begrenzung" UWORD FORMULA_0010 0 0.0 0.0 65535.0 READ_WRITE ECU_ADDRESS 0x3FC270 /end MEASUREMENT
/begin MEASUREMENT la_trim_diag_i_ad_max_cnt_b2 "Anzahl I-Adaption max. Begrenzung" UWORD FORMULA_0010 0 0.0 0.0 65535.0 READ_WRITE ECU_ADDRESS 0x3FC272 /end MEASUREMENT
/begin MEASUREMENT la_trim_diag_i_ad_min_cnt_b1 "Anzahl I-Adaption min. Begrenzung" UWORD FORMULA_0010 0 0.0 0.0 65535.0 READ_WRITE ECU_ADDRESS 0x3FC26C /end MEASUREMENT
/begin MEASUREMENT la_trim_diag_i_ad_min_cnt_b2 "Anzahl I-Adaption min. Begrenzung" UWORD FORMULA_0010 0 0.0 0.0 65535.0 READ_WRITE ECU_ADDRESS 0x3FC26E /end MEASUREMENT
/begin MEASUREMENT la_trim_diag_i_ed_f_b1 "Aufweitungsfaktor auf d. I-Anteils-Bereichsgrenzen" UWORD FORMULA_0073 0 0.0 0.0 4.0 READ_WRITE ECU_ADDRESS 0x3FC258 /end MEASUREMENT
/begin MEASUREMENT la_trim_diag_i_ed_f_b2 "Aufweitungsfaktor auf d. I-Anteils-Bereichsgrenzen" UWORD FORMULA_0073 0 0.0 0.0 4.0 READ_WRITE ECU_ADDRESS 0x3FC25A /end MEASUREMENT
/begin MEASUREMENT la_trim_diag_i_max_cnt_b1 "Anzahl I-Anteil max. Begrenzung" UWORD FORMULA_0010 0 0.0 0.0 65535.0 READ_WRITE ECU_ADDRESS 0x3FC260 /end MEASUREMENT
/begin MEASUREMENT la_trim_diag_i_max_cnt_b2 "Anzahl I-Anteil max. Begrenzung" UWORD FORMULA_0010 0 0.0 0.0 65535.0 READ_WRITE ECU_ADDRESS 0x3FC262 /end MEASUREMENT
/begin MEASUREMENT la_trim_diag_i_min_cnt_b1 "Anzahl I-Anteil min. Begrenzung" UWORD FORMULA_0010 0 0.0 0.0 65535.0 READ_WRITE ECU_ADDRESS 0x3FC25C /end MEASUREMENT
/begin MEASUREMENT la_trim_diag_i_min_cnt_b2 "Anzahl I-Anteil min. Begrenzung" UWORD FORMULA_0010 0 0.0 0.0 65535.0 READ_WRITE ECU_ADDRESS 0x3FC25E /end MEASUREMENT
/begin MEASUREMENT la_trim_diag_m_b1 "Mager-Verdacht" UWORD FORMULA_0910 0 0 0.0 255.0 READ_WRITE BIT_MASK 0x1 ECU_ADDRESS 0x3FC264 /end MEASUREMENT
/begin MEASUREMENT la_trim_diag_m_b2 "Mager-Verdacht" UWORD FORMULA_0910 0 0 0.0 255.0 READ_WRITE BIT_MASK 0x1 ECU_ADDRESS 0x3FC266 /end MEASUREMENT
/begin MEASUREMENT la_trim_diag_p_cnt_b1 "Anzahl P-Anteil-Fkt.-Durchlaeufe " UWORD FORMULA_0010 0 0.0 0.0 65535.0 READ_WRITE ECU_ADDRESS 0x3FC254 /end MEASUREMENT
/begin MEASUREMENT la_trim_diag_p_cnt_b2 "Anzahl P-Anteil-Fkt.-Durchlaeufe " UWORD FORMULA_0010 0 0.0 0.0 65535.0 READ_WRITE ECU_ADDRESS 0x3FC256 /end MEASUREMENT
/begin MEASUREMENT la_trim_diag_st_b1 "LA-Trimmregelung-Diagnose" UWORD FORMULA_0080 0 0.0 0.0 65535.0 READ_WRITE ECU_ADDRESS 0x3FC264 /end MEASUREMENT
/begin MEASUREMENT la_trim_diag_st_b2 "LA-Trimmregelung-Diagnose" UWORD FORMULA_0080 0 0.0 0.0 65535.0 READ_WRITE ECU_ADDRESS 0x3FC266 /end MEASUREMENT
/begin MEASUREMENT la_trim_i_b1 "wirkender I-Anteil" SWORD FORMULA_0025 0 0.0 -2.0 1.998999953269959 READ_WRITE ECU_ADDRESS 0x3FC22C /end MEASUREMENT
/begin MEASUREMENT la_trim_i_b2 "wirkender I-Anteil" SWORD FORMULA_0025 0 0.0 -2.0 1.998999953269959 READ_WRITE ECU_ADDRESS 0x3FC22E /end MEASUREMENT
/begin MEASUREMENT la_trim_i_dly_b1 "Haltezeit für I-Anteil" UWORD FORMULA_0021 0 0.0 0.0 655.3499755859375 READ_WRITE ECU_ADDRESS 0x3FC244 /end MEASUREMENT
/begin MEASUREMENT la_trim_i_dly_b2 "Haltezeit für I-Anteil" UWORD FORMULA_0021 0 0.0 0.0 655.3499755859375 READ_WRITE ECU_ADDRESS 0x3FC246 /end MEASUREMENT
/begin MEASUREMENT la_trim_i_f_b1 "I-Anteil - Trimmregelung" UWORD FORMULA_0908 0 0.0 0.0 819.0 READ_WRITE ECU_ADDRESS 0x3FC220 /end MEASUREMENT
/begin MEASUREMENT la_trim_i_f_b2 "I-Anteil - Trimmregelung" UWORD FORMULA_0908 0 0.0 0.0 819.0 READ_WRITE ECU_ADDRESS 0x3FC222 /end MEASUREMENT
/begin MEASUREMENT la_trim_i_fak_obd_b1 "Faktor I-Anteil aus KAT-Alterung" UWORD FORMULA_0073 0 0.0 0.0 4.0 READ_WRITE ECU_ADDRESS 0x3FC238 /end MEASUREMENT
/begin MEASUREMENT la_trim_i_fak_obd_b2 "Faktor I-Anteil aus KAT-Alterung" UWORD FORMULA_0073 0 0.0 0.0 4.0 READ_WRITE ECU_ADDRESS 0x3FC23A /end MEASUREMENT
/begin MEASUREMENT la_trim_i_gmw_b1 "wirkender I-Anteil - gemittelt" SWORD FORMULA_0025 0 0.0 -2.0 1.998999953269959 READ_WRITE ECU_ADDRESS 0x3FC230 /end MEASUREMENT
/begin MEASUREMENT la_trim_i_gmw_b2 "wirkender I-Anteil - gemittelt" SWORD FORMULA_0025 0 0.0 -2.0 1.998999953269959 READ_WRITE ECU_ADDRESS 0x3FC232 /end MEASUREMENT
/begin MEASUREMENT la_trim_i_inc_b1 "Integratorwert auf wirkenden I-Anteil" SWORD FORMULA_0199 0 0.0 -2.0 1.998999953269959 READ_WRITE ECU_ADDRESS 0x3FC224 /end MEASUREMENT
/begin MEASUREMENT la_trim_i_inc_b2 "Integratorwert auf wirkenden I-Anteil" SWORD FORMULA_0199 0 0.0 -2.0 1.998999953269959 READ_WRITE ECU_ADDRESS 0x3FC226 /end MEASUREMENT
/begin MEASUREMENT la_trim_lam_soll_b1 "LAM-SOLL-OFFSET der Trimmregelung" SWORD FORMULA_0025 0 0.0 -2.0 1.998999953269959 READ_WRITE ECU_ADDRESS 0x3FC234 /end MEASUREMENT
/begin MEASUREMENT la_trim_lam_soll_b2 "LAM-SOLL-OFFSET der Trimmregelung" SWORD FORMULA_0025 0 0.0 -2.0 1.998999953269959 READ_WRITE ECU_ADDRESS 0x3FC236 /end MEASUREMENT
/begin MEASUREMENT la_trim_p_abr_b1 "Abregelungszeit P-Anteil" UWORD FORMULA_0021 0 0.0 0.0 655.3499755859375 READ_WRITE ECU_ADDRESS 0x3FC248 /end MEASUREMENT
/begin MEASUREMENT la_trim_p_abr_b2 "Abregelungszeit P-Anteil" UWORD FORMULA_0021 0 0.0 0.0 655.3499755859375 READ_WRITE ECU_ADDRESS 0x3FC24A /end MEASUREMENT
/begin MEASUREMENT la_trim_p_anz_b1 "Anzahl der P-Anteil Triggerungen" UWORD FORMULA_0010 0 0.0 0.0 65535.0 READ_WRITE ECU_ADDRESS 0x3FC218 /end MEASUREMENT
/begin MEASUREMENT la_trim_p_anz_b2 "Anzahl der P-Anteil Triggerungen" UWORD FORMULA_0010 0 0.0 0.0 65535.0 READ_WRITE ECU_ADDRESS 0x3FC21A /end MEASUREMENT
/begin MEASUREMENT la_trim_p_b1 "wirkender P-Anteil" SWORD FORMULA_0025 0 0.0 -2.0 1.998999953269959 READ_WRITE ECU_ADDRESS 0x3FC228 /end MEASUREMENT
/begin MEASUREMENT la_trim_p_b2 "wirkender P-Anteil" SWORD FORMULA_0025 0 0.0 -2.0 1.998999953269959 READ_WRITE ECU_ADDRESS 0x3FC22A /end MEASUREMENT
/begin MEASUREMENT la_trim_p_dez_b1 "Abregelungswert P-Anteil" SLONG FORMULA_0909 0 0.0 0.0 3.999 READ_WRITE ECU_ADDRESS 0x3FC24C /end MEASUREMENT
/begin MEASUREMENT la_trim_p_dez_b2 "Abregelungswert P-Anteil" SLONG FORMULA_0909 0 0.0 0.0 3.999 READ_WRITE ECU_ADDRESS 0x3FC250 /end MEASUREMENT
/begin MEASUREMENT la_trim_p_dly_b1 "Haltezeit für P-Anteil" UWORD FORMULA_0021 0 0.0 0.0 655.3499755859375 READ_WRITE ECU_ADDRESS 0x3FC23C /end MEASUREMENT
/begin MEASUREMENT la_trim_p_dly_b2 "Haltezeit für P-Anteil" UWORD FORMULA_0021 0 0.0 0.0 655.3499755859375 READ_WRITE ECU_ADDRESS 0x3FC23E /end MEASUREMENT
/begin MEASUREMENT la_trim_p_f_b1 "P-Anteil - Trimmregelung" UWORD FORMULA_0025 0 0.0 0.0 0.5 READ_WRITE ECU_ADDRESS 0x3FC21C /end MEASUREMENT
/begin MEASUREMENT la_trim_p_f_b2 "P-Anteil - Trimmregelung" UWORD FORMULA_0025 0 0.0 0.0 0.5 READ_WRITE ECU_ADDRESS 0x3FC21E /end MEASUREMENT
/begin MEASUREMENT la_trim_p_fak_obd_b1 "Faktor P-Anteil aus KAT-Alterung" UWORD FORMULA_0073 0 0.0 0.0 4.0 READ_WRITE ECU_ADDRESS 0x3FC214 /end MEASUREMENT
/begin MEASUREMENT la_trim_p_fak_obd_b2 "Faktor P-Anteil aus KAT-Alterung" UWORD FORMULA_0073 0 0.0 0.0 4.0 READ_WRITE ECU_ADDRESS 0x3FC216 /end MEASUREMENT
/begin MEASUREMENT la_trim_p_wait_b1 "Wartezeit für weiteren P-Anteil" UWORD FORMULA_0021 0 0.0 0.0 655.3499755859375 READ_WRITE ECU_ADDRESS 0x3FC240 /end MEASUREMENT
/begin MEASUREMENT la_trim_p_wait_b2 "Wartezeit für weiteren P-Anteil" UWORD FORMULA_0021 0 0.0 0.0 655.3499755859375 READ_WRITE ECU_ADDRESS 0x3FC242 /end MEASUREMENT
/begin MEASUREMENT la_trim_st_b1 "LA-Trimmregelung-Status" UWORD FORMULA_0080 0 0.0 0.0 65535.0 READ_WRITE ECU_ADDRESS 0x3FC200 /end MEASUREMENT
/begin MEASUREMENT la_trim_st_b2 "LA-Trimmregelung-Status" UWORD FORMULA_0080 0 0.0 0.0 65535.0 READ_WRITE ECU_ADDRESS 0x3FC202 /end MEASUREMENT
/begin MEASUREMENT la_trim_st_cfg_b1 "Allgemeine Freigabe" UWORD FORMULA_0885 0 0 0.0 255.0 READ_WRITE BIT_MASK 0x1 ECU_ADDRESS 0x3FC200 /end MEASUREMENT
/begin MEASUREMENT la_trim_st_cfg_b2 "Allgemeine Freigabe" UWORD FORMULA_0885 0 0 0.0 255.0 READ_WRITE BIT_MASK 0x1 ECU_ADDRESS 0x3FC202 /end MEASUREMENT
/begin MEASUREMENT la_trim_st_error_b1 "Fehlerbedingungen" UWORD FORMULA_0896 0 0 0.0 255.0 READ_WRITE BIT_MASK 0x2000 ECU_ADDRESS 0x3FC200 /end MEASUREMENT
/begin MEASUREMENT la_trim_st_error_b2 "Fehlerbedingungen" UWORD FORMULA_0896 0 0 0.0 255.0 READ_WRITE BIT_MASK 0x2000 ECU_ADDRESS 0x3FC202 /end MEASUREMENT
/begin MEASUREMENT la_trim_st_kats_b1 "KAT-Schutz" UWORD FORMULA_0891 0 0 0.0 255.0 READ_WRITE BIT_MASK 0x100 ECU_ADDRESS 0x3FC200 /end MEASUREMENT
/begin MEASUREMENT la_trim_st_kats_b2 "KAT-Schutz" UWORD FORMULA_0891 0 0 0.0 255.0 READ_WRITE BIT_MASK 0x100 ECU_ADDRESS 0x3FC202 /end MEASUREMENT
/begin MEASUREMENT la_trim_st_kh_b1 "KAT-Heizen" UWORD FORMULA_0892 0 0 0.0 255.0 READ_WRITE BIT_MASK 0x200 ECU_ADDRESS 0x3FC200 /end MEASUREMENT
/begin MEASUREMENT la_trim_st_kh_b2 "KAT-Heizen" UWORD FORMULA_0892 0 0 0.0 255.0 READ_WRITE BIT_MASK 0x200 ECU_ADDRESS 0x3FC202 /end MEASUREMENT
/begin MEASUREMENT la_trim_st_laa_lim_b1 "Kraftstoffsystem" UWORD FORMULA_0895 0 0 0.0 255.0 READ_WRITE BIT_MASK 0x1000 ECU_ADDRESS 0x3FC200 /end MEASUREMENT
/begin MEASUREMENT la_trim_st_laa_lim_b2 "Kraftstoffsystem" UWORD FORMULA_0895 0 0 0.0 255.0 READ_WRITE BIT_MASK 0x1000 ECU_ADDRESS 0x3FC202 /end MEASUREMENT
/begin MEASUREMENT la_trim_st_nkat_verf_b1 "NKAT-Sonden Verfuegbarkeit" UWORD FORMULA_0888 0 0 0.0 255.0 READ_WRITE BIT_MASK 0x10 ECU_ADDRESS 0x3FC200 /end MEASUREMENT
/begin MEASUREMENT la_trim_st_nkat_verf_b2 "NKAT-Sonden Verfuegbarkeit" UWORD FORMULA_0888 0 0 0.0 255.0 READ_WRITE BIT_MASK 0x10 ECU_ADDRESS 0x3FC202 /end MEASUREMENT
/begin MEASUREMENT la_trim_st_rf_b1 "RF-Schwellen" UWORD FORMULA_0886 0 0 0.0 255.0 READ_WRITE BIT_MASK 0x4 ECU_ADDRESS 0x3FC200 /end MEASUREMENT
/begin MEASUREMENT la_trim_st_rf_b2 "RF-Schwellen" UWORD FORMULA_0886 0 0 0.0 255.0 READ_WRITE BIT_MASK 0x4 ECU_ADDRESS 0x3FC202 /end MEASUREMENT
/begin MEASUREMENT la_trim_st_sk_b1 "SK-Manger" UWORD FORMULA_0894 0 0 0.0 255.0 READ_WRITE BIT_MASK 0x800 ECU_ADDRESS 0x3FC200 /end MEASUREMENT
/begin MEASUREMENT la_trim_st_sk_b2 "SK-Manger" UWORD FORMULA_0894 0 0 0.0 255.0 READ_WRITE BIT_MASK 0x800 ECU_ADDRESS 0x3FC202 /end MEASUREMENT
/begin MEASUREMENT la_trim_st_slp_b1 "Sekundaerluftbetrieb" UWORD FORMULA_0893 0 0 0.0 255.0 READ_WRITE BIT_MASK 0x400 ECU_ADDRESS 0x3FC200 /end MEASUREMENT
/begin MEASUREMENT la_trim_st_slp_b2 "Sekundaerluftbetrieb" UWORD FORMULA_0893 0 0 0.0 255.0 READ_WRITE BIT_MASK 0x400 ECU_ADDRESS 0x3FC202 /end MEASUREMENT
/begin MEASUREMENT la_trim_st_soll_add_b1 "LAM-SOLL Aktivitaeten" UWORD FORMULA_0897 0 0 0.0 255.0 READ_WRITE BIT_MASK 0x4000 ECU_ADDRESS 0x3FC200 /end MEASUREMENT
/begin MEASUREMENT la_trim_st_soll_add_b2 "LAM-SOLL Aktivitaeten" UWORD FORMULA_0897 0 0 0.0 255.0 READ_WRITE BIT_MASK 0x4000 ECU_ADDRESS 0x3FC202 /end MEASUREMENT
/begin MEASUREMENT la_trim_st_soll_norm_b1 "LAM-SOLL-NORM & LA-Regler" UWORD FORMULA_0887 0 0 0.0 255.0 READ_WRITE BIT_MASK 0x8 ECU_ADDRESS 0x3FC200 /end MEASUREMENT
/begin MEASUREMENT la_trim_st_soll_norm_b2 "LAM-SOLL-NORM & LA-Regler" UWORD FORMULA_0887 0 0 0.0 255.0 READ_WRITE BIT_MASK 0x8 ECU_ADDRESS 0x3FC202 /end MEASUREMENT
/begin MEASUREMENT la_trim_st_te_b1 "TE-AKF-Beladung/TEFC aktiv" UWORD FORMULA_0890 0 0 0.0 255.0 READ_WRITE BIT_MASK 0x40 ECU_ADDRESS 0x3FC200 /end MEASUREMENT
/begin MEASUREMENT la_trim_st_te_b2 "TE-AKF-Beladung/TEFC aktiv" UWORD FORMULA_0890 0 0 0.0 255.0 READ_WRITE BIT_MASK 0x40 ECU_ADDRESS 0x3FC202 /end MEASUREMENT
/begin MEASUREMENT la_trim_st_temperatur_b1 "Abgastemp./Ansaugtemp.Schwellen" UWORD FORMULA_0889 0 0 0.0 255.0 READ_WRITE BIT_MASK 0x20 ECU_ADDRESS 0x3FC200 /end MEASUREMENT
/begin MEASUREMENT la_trim_st_temperatur_b2 "Abgastemp./Ansaugtemp.Schwellen" UWORD FORMULA_0889 0 0 0.0 255.0 READ_WRITE BIT_MASK 0x20 ECU_ADDRESS 0x3FC202 /end MEASUREMENT
/begin MEASUREMENT la_trim_st_v_b1 "V-Schwelle" UWORD FORMULA_0898 0 0 0.0 255.0 READ_WRITE BIT_MASK 0x8000 ECU_ADDRESS 0x3FC200 /end MEASUREMENT
/begin MEASUREMENT la_trim_st_v_b2 "V-Schwelle" UWORD FORMULA_0898 0 0 0.0 255.0 READ_WRITE BIT_MASK 0x8000 ECU_ADDRESS 0x3FC202 /end MEASUREMENT
/begin MEASUREMENT la_trim_us_diff_b1 "Diff. NKAT-Spannung IST zu SOLL" SWORD FORMULA_0536 0 0.0 0.0 1200.0 READ_WRITE ECU_ADDRESS 0x3FC20C /end MEASUREMENT
/begin MEASUREMENT la_trim_us_diff_b2 "Diff. NKAT-Spannung IST zu SOLL" SWORD FORMULA_0536 0 0.0 0.0 1200.0 READ_WRITE ECU_ADDRESS 0x3FC20E /end MEASUREMENT
/begin MEASUREMENT la_trim_usn_aebg_b1 "aebg. SOLL-NKAT-Spannung" UWORD FORMULA_0536 0 0.0 0.0 1200.0 READ_WRITE ECU_ADDRESS 0x3FC210 /end MEASUREMENT
/begin MEASUREMENT la_trim_usn_aebg_b2 "aebg. SOLL-NKAT-Spannung" UWORD FORMULA_0536 0 0.0 0.0 1200.0 READ_WRITE ECU_ADDRESS 0x3FC212 /end MEASUREMENT
/begin MEASUREMENT la_trim_usn_soll_b1 "SOLL-NKAT-Spannung" UWORD FORMULA_0536 0 0.0 0.0 1200.0 READ_WRITE ECU_ADDRESS 0x3FC208 /end MEASUREMENT
/begin MEASUREMENT la_trim_usn_soll_b2 "SOLL-NKAT-Spannung" UWORD FORMULA_0536 0 0.0 0.0 1200.0 READ_WRITE ECU_ADDRESS 0x3FC20A /end MEASUREMENT
/begin MEASUREMENT la_trim_zust_ad_erm_b1 "AD-Wert Ermittlung" UWORD FORMULA_0905 0 0 0.0 255.0 READ_WRITE BIT_MASK 0x80 ECU_ADDRESS 0x3FC204 /end MEASUREMENT
/begin MEASUREMENT la_trim_zust_ad_erm_b2 "AD-Wert Ermittlung" UWORD FORMULA_0905 0 0 0.0 255.0 READ_WRITE BIT_MASK 0x80 ECU_ADDRESS 0x3FC206 /end MEASUREMENT
/begin MEASUREMENT la_trim_zust_b1 "LA-Trimmregelung-interner Zustand" UWORD FORMULA_0080 0 0.0 0.0 65535.0 READ_WRITE ECU_ADDRESS 0x3FC204 /end MEASUREMENT
/begin MEASUREMENT la_trim_zust_b2 "LA-Trimmregelung-interner Zustand" UWORD FORMULA_0080 0 0.0 0.0 65535.0 READ_WRITE ECU_ADDRESS 0x3FC206 /end MEASUREMENT
/begin MEASUREMENT la_trim_zust_i_ad_max_b1 "AD-Anteil - MAX-Begrenzung" UWORD FORMULA_0906 0 0 0.0 255.0 READ_WRITE BIT_MASK 0x100 ECU_ADDRESS 0x3FC204 /end MEASUREMENT
/begin MEASUREMENT la_trim_zust_i_ad_max_b2 "AD-Anteil - MAX-Begrenzung" UWORD FORMULA_0906 0 0 0.0 255.0 READ_WRITE BIT_MASK 0x100 ECU_ADDRESS 0x3FC206 /end MEASUREMENT
/begin MEASUREMENT la_trim_zust_i_ad_min_b1 "AD-Anteil - MIN-Begrenzung" UWORD FORMULA_0907 0 0 0.0 255.0 READ_WRITE BIT_MASK 0x200 ECU_ADDRESS 0x3FC204 /end MEASUREMENT
/begin MEASUREMENT la_trim_zust_i_ad_min_b2 "AD-Anteil - MIN-Begrenzung" UWORD FORMULA_0907 0 0 0.0 255.0 READ_WRITE BIT_MASK 0x200 ECU_ADDRESS 0x3FC206 /end MEASUREMENT
/begin MEASUREMENT la_trim_zust_i_b1 "I-Anteil-Verzoegerungzeit" UWORD FORMULA_0843 0 0 0.0 255.0 READ_WRITE BIT_MASK 0x2 ECU_ADDRESS 0x3FC204 /end MEASUREMENT
/begin MEASUREMENT la_trim_zust_i_b2 "I-Anteil-Verzoegerungzeit" UWORD FORMULA_0843 0 0 0.0 255.0 READ_WRITE BIT_MASK 0x2 ECU_ADDRESS 0x3FC206 /end MEASUREMENT
/begin MEASUREMENT la_trim_zust_i_gmw_aktiv_b1 "Ermittlung GMW-I-Anteil" UWORD FORMULA_0773 0 0 0.0 255.0 READ_WRITE BIT_MASK 0x400 ECU_ADDRESS 0x3FC204 /end MEASUREMENT
/begin MEASUREMENT la_trim_zust_i_gmw_aktiv_b2 "Ermittlung GMW-I-Anteil" UWORD FORMULA_0773 0 0 0.0 255.0 READ_WRITE BIT_MASK 0x400 ECU_ADDRESS 0x3FC206 /end MEASUREMENT
/begin MEASUREMENT la_trim_zust_i_init_gmw_b1 "I-Anteil vorbelegen" UWORD FORMULA_0901 0 0 0.0 255.0 READ_WRITE BIT_MASK 0x8 ECU_ADDRESS 0x3FC204 /end MEASUREMENT
/begin MEASUREMENT la_trim_zust_i_init_gmw_b2 "I-Anteil vorbelegen" UWORD FORMULA_0901 0 0 0.0 255.0 READ_WRITE BIT_MASK 0x8 ECU_ADDRESS 0x3FC206 /end MEASUREMENT
/begin MEASUREMENT la_trim_zust_i_max_b1 "Diagnose I-Anteil - MAX-Begrenzung" UWORD FORMULA_0903 0 0 0.0 255.0 READ_WRITE BIT_MASK 0x20 ECU_ADDRESS 0x3FC204 /end MEASUREMENT
/begin MEASUREMENT la_trim_zust_i_max_b2 "Diagnose I-Anteil - MAX-Begrenzung" UWORD FORMULA_0903 0 0 0.0 255.0 READ_WRITE BIT_MASK 0x20 ECU_ADDRESS 0x3FC206 /end MEASUREMENT
/begin MEASUREMENT la_trim_zust_i_min_b1 "Diagnose I-Anteil - MIN-Begrenzung" UWORD FORMULA_0904 0 0 0.0 255.0 READ_WRITE BIT_MASK 0x40 ECU_ADDRESS 0x3FC204 /end MEASUREMENT
/begin MEASUREMENT la_trim_zust_i_min_b2 "Diagnose I-Anteil - MIN-Begrenzung" UWORD FORMULA_0904 0 0 0.0 255.0 READ_WRITE BIT_MASK 0x40 ECU_ADDRESS 0x3FC206 /end MEASUREMENT
/begin MEASUREMENT la_trim_zust_p_abger_b1 "P-Anteil ist abgeregelt" UWORD FORMULA_0900 0 0 0.0 255.0 READ_WRITE BIT_MASK 0x4 ECU_ADDRESS 0x3FC204 /end MEASUREMENT
/begin MEASUREMENT la_trim_zust_p_abger_b2 "P-Anteil ist abgeregelt" UWORD FORMULA_0900 0 0 0.0 255.0 READ_WRITE BIT_MASK 0x4 ECU_ADDRESS 0x3FC206 /end MEASUREMENT
/begin MEASUREMENT la_trim_zust_p_b1 "P-Anteil Ermittlung abgeschlossen" UWORD FORMULA_0899 0 0 0.0 255.0 READ_WRITE BIT_MASK 0x1 ECU_ADDRESS 0x3FC204 /end MEASUREMENT
/begin MEASUREMENT la_trim_zust_p_b2 "P-Anteil Ermittlung abgeschlossen" UWORD FORMULA_0899 0 0 0.0 255.0 READ_WRITE BIT_MASK 0x1 ECU_ADDRESS 0x3FC206 /end MEASUREMENT
/begin MEASUREMENT la_trim_zust_us_o2_b1 "O2-Beladung freigeben - ueber Trimmregelung" UWORD FORMULA_0902 0 0 0.0 255.0 READ_WRITE BIT_MASK 0x10 ECU_ADDRESS 0x3FC204 /end MEASUREMENT
/begin MEASUREMENT la_trim_zust_us_o2_b2 "O2-Beladung freigeben - ueber Trimmregelung" UWORD FORMULA_0902 0 0 0.0 255.0 READ_WRITE BIT_MASK 0x10 ECU_ADDRESS 0x3FC206 /end MEASUREMENT
/begin MEASUREMENT laa_f_b1 "Faktor-Lambdaadaption" UWORD FORMULA_0024 0 0.0 0.0 1.998999953269959 READ_WRITE ECU_ADDRESS 0x3FC360 /end MEASUREMENT
/begin MEASUREMENT laa_f_b2 "Faktor-Lambdaadaption" UWORD FORMULA_0024 0 0.0 0.0 1.998999953269959 READ_WRITE ECU_ADDRESS 0x3FC362 /end MEASUREMENT
/begin MEASUREMENT laa_f_mw_cnt_b1 "Zaehlervariable f. Mittelwertbildung" UWORD FORMULA_0010 0 0.0 0.0 65535.0 READ_WRITE ECU_ADDRESS 0x3FC378 /end MEASUREMENT
/begin MEASUREMENT laa_f_mw_cnt_b2 "Zaehlervariable f. Mittelwertbildung" UWORD FORMULA_0010 0 0.0 0.0 65535.0 READ_WRITE ECU_ADDRESS 0x3FC37A /end MEASUREMENT
/begin MEASUREMENT laa_f_mw_t_b1 "Zeitzaehler f. Mittelwertbildung" UWORD FORMULA_0763 0 0.0 0.0 65535.0 READ_WRITE ECU_ADDRESS 0x3FC36C /end MEASUREMENT
/begin MEASUREMENT laa_f_mw_t_b2 "Zeitzaehler f. Mittelwertbildung" UWORD FORMULA_0763 0 0.0 0.0 65535.0 READ_WRITE ECU_ADDRESS 0x3FC36E /end MEASUREMENT
/begin MEASUREMENT laa_f_te_mw_cnt_b1 "Zaehlervariable f. Mittelwertbildung" UWORD FORMULA_0010 0 0.0 0.0 65535.0 READ_WRITE ECU_ADDRESS 0x3FC37C /end MEASUREMENT
/begin MEASUREMENT laa_f_te_mw_cnt_b2 "Zaehlervariable f. Mittelwertbildung" UWORD FORMULA_0010 0 0.0 0.0 65535.0 READ_WRITE ECU_ADDRESS 0x3FC37E /end MEASUREMENT
/begin MEASUREMENT laa_f_te_mw_t_b1 "Zeitzaehler f. Mittelwertbildung" UWORD FORMULA_0763 0 0.0 0.0 65535.0 READ_WRITE ECU_ADDRESS 0x3FC370 /end MEASUREMENT
/begin MEASUREMENT laa_f_te_mw_t_b2 "Zeitzaehler f. Mittelwertbildung" UWORD FORMULA_0763 0 0.0 0.0 65535.0 READ_WRITE ECU_ADDRESS 0x3FC372 /end MEASUREMENT
/begin MEASUREMENT laa_offs_begr_b1 "Offset-Wert aus Aenderungsbegr." SWORD FORMULA_0535 0 0.0 -512.0 511.0 READ_WRITE ECU_ADDRESS 0x3FC364 /end MEASUREMENT
/begin MEASUREMENT laa_offs_begr_b2 "Offset-Wert aus Aenderungsbegr." SWORD FORMULA_0535 0 0.0 -512.0 511.0 READ_WRITE ECU_ADDRESS 0x3FC366 /end MEASUREMENT
/begin MEASUREMENT laa_offs_mw_cnt_b1 "Zaehlervariable f. Mittelwertbildung" UWORD FORMULA_0010 0 0.0 0.0 65535.0 READ_WRITE ECU_ADDRESS 0x3FC374 /end MEASUREMENT
/begin MEASUREMENT laa_offs_mw_cnt_b2 "Zaehlervariable f. Mittelwertbildung" UWORD FORMULA_0010 0 0.0 0.0 65535.0 READ_WRITE ECU_ADDRESS 0x3FC376 /end MEASUREMENT
/begin MEASUREMENT laa_offs_mw_t_b1 "Zeitzaehler f. Mittelwertbildung" UWORD FORMULA_0763 0 0.0 0.0 65535.0 READ_WRITE ECU_ADDRESS 0x3FC368 /end MEASUREMENT
/begin MEASUREMENT laa_offs_mw_t_b2 "Zeitzaehler f. Mittelwertbildung" UWORD FORMULA_0763 0 0.0 0.0 65535.0 READ_WRITE ECU_ADDRESS 0x3FC36A /end MEASUREMENT
/begin MEASUREMENT lam.atic42_ip_gain_b1 "ATIC42 IP-GAIN" UWORD FORMULA_0749 0 0 0.0 255.0 READ_WRITE BIT_MASK 0x8 ECU_ADDRESS 0x3FC2C4 /end MEASUREMENT
/begin MEASUREMENT lam.atic42_ip_gain_b2 "ATIC42 IP-GAIN" UWORD FORMULA_0749 0 0 0.0 255.0 READ_WRITE BIT_MASK 0x8 ECU_ADDRESS 0x3FC30E /end MEASUREMENT
/begin MEASUREMENT lam.laa_f_begr_b1 "LAA-F-Begr." UWORD FORMULA_0756 0 0.0 0.0 65535.0 READ_WRITE BIT_MASK 0x300 ECU_ADDRESS 0x3FC2F8 /end MEASUREMENT
/begin MEASUREMENT lam.laa_f_begr_b2 "LAA-F-Begr." UWORD FORMULA_0756 0 0.0 0.0 65535.0 READ_WRITE BIT_MASK 0x300 ECU_ADDRESS 0x3FC342 /end MEASUREMENT
/begin MEASUREMENT lam.laa_f_te_begr_b1 "LAA-F-TE-Begr." UWORD FORMULA_0757 0 0.0 0.0 65535.0 READ_WRITE BIT_MASK 0xC00 ECU_ADDRESS 0x3FC2F8 /end MEASUREMENT
/begin MEASUREMENT lam.laa_f_te_begr_b2 "LAA-F-TE-Begr." UWORD FORMULA_0757 0 0.0 0.0 65535.0 READ_WRITE BIT_MASK 0xC00 ECU_ADDRESS 0x3FC342 /end MEASUREMENT
/begin MEASUREMENT lam.laa_offs_begr_b1 "LAA-OFFS-Begr." UWORD FORMULA_0758 0 0.0 0.0 65535.0 READ_WRITE BIT_MASK 0x3000 ECU_ADDRESS 0x3FC2F8 /end MEASUREMENT
/begin MEASUREMENT lam.laa_offs_begr_b2 "LAA-OFFS-Begr." UWORD FORMULA_0758 0 0.0 0.0 65535.0 READ_WRITE BIT_MASK 0x3000 ECU_ADDRESS 0x3FC342 /end MEASUREMENT
/begin MEASUREMENT lam.laa_stat_b1 "LAA-Stationaer" UWORD FORMULA_0760 0 0 0.0 255.0 READ_WRITE BIT_MASK 0x8000 ECU_ADDRESS 0x3FC2F8 /end MEASUREMENT
/begin MEASUREMENT lam.laa_stat_b2 "LAA-Stationaer" UWORD FORMULA_0760 0 0 0.0 255.0 READ_WRITE BIT_MASK 0x8000 ECU_ADDRESS 0x3FC342 /end MEASUREMENT
/begin MEASUREMENT lam.laa_status_b1 "LA-Adaption-Status" UWORD FORMULA_0755 0 0.0 0.0 65535.0 READ_WRITE BIT_MASK 0x1F ECU_ADDRESS 0x3FC2F8 /end MEASUREMENT
/begin MEASUREMENT lam.laa_status_b2 "LA-Adaption-Status" UWORD FORMULA_0755 0 0.0 0.0 65535.0 READ_WRITE BIT_MASK 0x1F ECU_ADDRESS 0x3FC342 /end MEASUREMENT
/begin MEASUREMENT lam.laa_ti_ist_b1 "TI_IST-Schwelle" UWORD FORMULA_0759 0 0 0.0 255.0 READ_WRITE BIT_MASK 0x4000 ECU_ADDRESS 0x3FC2F8 /end MEASUREMENT
/begin MEASUREMENT lam.laa_ti_ist_b2 "TI_IST-Schwelle" UWORD FORMULA_0759 0 0 0.0 255.0 READ_WRITE BIT_MASK 0x4000 ECU_ADDRESS 0x3FC342 /end MEASUREMENT
/begin MEASUREMENT lam.lavk_status_b1 "Sonden-Status" UWORD FORMULA_0748 0 0.0 0.0 65535.0 READ_WRITE BIT_MASK 0x7 ECU_ADDRESS 0x3FC2C4 /end MEASUREMENT
/begin MEASUREMENT lam.lavk_status_b2 "Sonden-Status" UWORD FORMULA_0748 0 0.0 0.0 65535.0 READ_WRITE BIT_MASK 0x7 ECU_ADDRESS 0x3FC30E /end MEASUREMENT
/begin MEASUREMENT lam_b1.ad_gain_cnt "Zahler fuer Glaettungszeit" UWORD FORMULA_0010 0 0.0 0.0 65535.0 READ_WRITE ECU_ADDRESS 0x3FC2E4 /end MEASUREMENT
/begin MEASUREMENT lam_b1.ad_offs_cnt "Zahler fuer Glaettungszeit" UWORD FORMULA_0010 0 0.0 0.0 65535.0 READ_WRITE ECU_ADDRESS 0x3FC2E2 /end MEASUREMENT
/begin MEASUREMENT lam_b1.ip_gain "Pumpstromverstaerkung" UWORD FORMULA_0010 0 0.0 8.0 16.0 READ_WRITE ECU_ADDRESS 0x3FC2D0 /end MEASUREMENT
/begin MEASUREMENT lam_b1.ist_ad "LAM-IST aus Kennlinie" UWORD FORMULA_0025 0 0.0 0.0 3.999000072479248 READ_WRITE ECU_ADDRESS 0x3FC2DA /end MEASUREMENT
/begin MEASUREMENT lam_b1.ist_mw_grad "Gradient d. LA-IST-MW" SWORD FORMULA_0751 0 0.0 -1.900000032037497e-003 1.900000032037497e-003 READ_WRITE ECU_ADDRESS 0x3FC2DE /end MEASUREMENT
/begin MEASUREMENT lam_b1.laa_f_te "Offset auf LAA-Faktor ueber TE" SWORD FORMULA_0024 0 0.0 -1.0 0.9998999834060669 READ_WRITE ECU_ADDRESS 0x3FC2FE /end MEASUREMENT
/begin MEASUREMENT lam_b1.laa_f_te_grad_neg "Abregelwert fuer Vergessen des LAA-Faktor ueber TE" UWORD FORMULA_0024 0 0.0 0.0 1.998999953269959 READ_WRITE ECU_ADDRESS 0x3FC302 /end MEASUREMENT
/begin MEASUREMENT lam_b1.laa_ml_f "Ermittlung Luftmassenfaktor" UWORD FORMULA_0024 0 0.0 0.0 1.998999953269959 READ_WRITE ECU_ADDRESS 0x3FC2FC /end MEASUREMENT
/begin MEASUREMENT lam_b1.laa_ml_f_te "Ermittlung TE-Luftmassenfaktor" UWORD FORMULA_0024 0 0.0 0.0 1.998999953269959 READ_WRITE ECU_ADDRESS 0x3FC304 /end MEASUREMENT
/begin MEASUREMENT lam_b1.laa_ml_offs "Ermittlung Luftmassenoffset" SWORD FORMULA_0535 0 0.0 -512.0 511.0 READ_WRITE ECU_ADDRESS 0x3FC2FA /end MEASUREMENT
/begin MEASUREMENT lam_b1.laa_st "LA-Adaption-Status" UWORD FORMULA_0080 0 0.0 0.0 65535.0 READ_WRITE ECU_ADDRESS 0x3FC2F8 /end MEASUREMENT
/begin MEASUREMENT lam_b1.lavk_ad "AD-Wert d. Sondensignals" UWORD FORMULA_0536 0 0.0 0.0 5000.0 READ_WRITE ECU_ADDRESS 0x3FC2C6 /end MEASUREMENT
/begin MEASUREMENT lam_b1.lavk_ad_gain_filt "gem. AD-Wert f. Sondenadapt." UWORD FORMULA_0536 0 0.0 0.0 5000.0 READ_WRITE ECU_ADDRESS 0x3FC2E8 /end MEASUREMENT
/begin MEASUREMENT lam_b1.lavk_ad_korr "korrigierter AD-Wert." SWORD FORMULA_0536 0 0.0 -5000.0 5000.0 READ_WRITE ECU_ADDRESS 0x3FC2CA /end MEASUREMENT
/begin MEASUREMENT lam_b1.lavk_ad_mw "AD-Wert d. Sondensignals - 1kHz-Abtastung" UWORD FORMULA_0536 0 0.0 0.0 5000.0 READ_WRITE ECU_ADDRESS 0x3FC2C8 /end MEASUREMENT
/begin MEASUREMENT lam_b1.lavk_ad_mw_korr "korrigierter AD-Wert. - 1kHz-Abtastung" SWORD FORMULA_0536 0 0.0 -5000.0 5000.0 READ_WRITE ECU_ADDRESS 0x3FC2CC /end MEASUREMENT
/begin MEASUREMENT lam_b1.lavk_ad_offs_filt "gem. AD-Wert f. OFFSET-Sondenadapt." UWORD FORMULA_0536 0 0.0 0.0 5000.0 READ_WRITE ECU_ADDRESS 0x3FC2E6 /end MEASUREMENT
/begin MEASUREMENT lam_b1.lavk_filt_konst "IST-LA-Filterkonstante" UWORD FORMULA_0762 0 0.0 0.0 7.999800205230713 READ_WRITE ECU_ADDRESS 0x3FC30A /end MEASUREMENT
/begin MEASUREMENT lam_b1.lavk_ip "Pumpsptrom" SWORD FORMULA_0750 0 0.0 -10.0 9.999600410461426 READ_WRITE ECU_ADDRESS 0x3FC2D2 /end MEASUREMENT
/begin MEASUREMENT lam_b1.lavk_ip_korr "korrigierter Pumpsptrom" SWORD FORMULA_0750 0 0.0 -10.0 9.999600410461426 READ_WRITE ECU_ADDRESS 0x3FC2D6 /end MEASUREMENT
/begin MEASUREMENT lam_b1.lavk_ip_mw "Pumpsptrom - 1kHz-Abtastung" SWORD FORMULA_0750 0 0.0 -10.0 9.999600410461426 READ_WRITE ECU_ADDRESS 0x3FC2D4 /end MEASUREMENT
/begin MEASUREMENT lam_b1.lavk_ip_mw_korr "korrigierter Pumpsptrom - 1kHz-Abtastung" SWORD FORMULA_0750 0 0.0 -10.0 9.999600410461426 READ_WRITE ECU_ADDRESS 0x3FC2D8 /end MEASUREMENT
/begin MEASUREMENT lam_b1.lavk_korr_f "Ip-Korrekturfaktor" UWORD FORMULA_0073 0 0.0 0.0 4.0 READ_WRITE ECU_ADDRESS 0x3FC2CE /end MEASUREMENT
/begin MEASUREMENT lam_b1.lavk_st "Sonden-Status" UWORD FORMULA_0080 0 0.0 0.0 65535.0 READ_WRITE ECU_ADDRESS 0x3FC2C4 /end MEASUREMENT
/begin MEASUREMENT lam_b1.lavk_tau1 "TAU1 - IST-LA-Filter" UWORD FORMULA_0761 0 0.0 0.0 2097.0 READ_WRITE ECU_ADDRESS 0x3FC306 /end MEASUREMENT
/begin MEASUREMENT lam_b1.mks_soll_zyl "gefilterte SOLL-Kraftstoffmasse" UWORD FORMULA_0111 0 0.0 0.0 1023.984313964844 READ_WRITE ECU_ADDRESS 0x3FC2EA /end MEASUREMENT
/begin MEASUREMENT lam_b1.ml_delta "absolute Regelabweichung" SWORD FORMULA_0111 0 0.0 -512.0 511.9843139648438 READ_WRITE ECU_ADDRESS 0x3FC2F6 /end MEASUREMENT
/begin MEASUREMENT lam_b1.reg_k "Verstaerkungsfaktor" SWORD FORMULA_0754 0 0.0 -2.0 2.0 READ_WRITE ECU_ADDRESS 0x3FC2F4 /end MEASUREMENT
/begin MEASUREMENT lam_b1.reg_tn_i "Nachstellzeit - I-Anteil" UWORD FORMULA_0753 0 0.0 0.0 2097.1201171875 READ_WRITE ECU_ADDRESS 0x3FC2F0 /end MEASUREMENT
/begin MEASUREMENT lam_b1.reg_tn_roh "Nachstellzeit - roh" UWORD FORMULA_0753 0 0.0 0.0 2097.1201171875 READ_WRITE ECU_ADDRESS 0x3FC2EE /end MEASUREMENT
/begin MEASUREMENT lam_b1.reg_tv_d "Nachstellzeit - D-Anteil" UWORD FORMULA_0753 0 0.0 0.0 2097.1201171875 READ_WRITE ECU_ADDRESS 0x3FC2F2 /end MEASUREMENT
/begin MEASUREMENT lam_b1.wf_verz_time "Verzoegerungszeit f. WF-Eingriff" UWORD FORMULA_0752 0 0.0 0.0 65.53500366210938 READ_WRITE ECU_ADDRESS 0x3FC2EC /end MEASUREMENT
/begin MEASUREMENT lam_b1.zahn_nr "aktueller KW-Zahn" UWORD FORMULA_0010 0 0.0 0.0 65535.0 READ_WRITE ECU_ADDRESS 0x3FC2E0 /end MEASUREMENT
/begin MEASUREMENT lam_b2.ad_gain_cnt "Zahler fuer Glaettungszeit" UWORD FORMULA_0010 0 0.0 0.0 65535.0 READ_WRITE ECU_ADDRESS 0x3FC32E /end MEASUREMENT
/begin MEASUREMENT lam_b2.ad_offs_cnt "Zahler fuer Glaettungszeit" UWORD FORMULA_0010 0 0.0 0.0 65535.0 READ_WRITE ECU_ADDRESS 0x3FC32C /end MEASUREMENT
/begin MEASUREMENT lam_b2.ip_gain "Pumpstromverstaerkung" UWORD FORMULA_0010 0 0.0 8.0 16.0 READ_WRITE ECU_ADDRESS 0x3FC31A /end MEASUREMENT
/begin MEASUREMENT lam_b2.ist_ad "LAM-IST aus Kennlinie" UWORD FORMULA_0025 0 0.0 0.0 3.999000072479248 READ_WRITE ECU_ADDRESS 0x3FC324 /end MEASUREMENT
/begin MEASUREMENT lam_b2.ist_mw_grad "Gradient d. LA-IST-MW" SWORD FORMULA_0751 0 0.0 -1.900000032037497e-003 1.900000032037497e-003 READ_WRITE ECU_ADDRESS 0x3FC328 /end MEASUREMENT
/begin MEASUREMENT lam_b2.laa_f_te "Offset auf LAA-Faktor ueber TE" SWORD FORMULA_0024 0 0.0 -1.0 0.9998999834060669 READ_WRITE ECU_ADDRESS 0x3FC348 /end MEASUREMENT
/begin MEASUREMENT lam_b2.laa_f_te_grad_neg "Abregelwert fuer Vergessen des LAA-Faktor ueber TE" UWORD FORMULA_0024 0 0.0 0.0 1.998999953269959 READ_WRITE ECU_ADDRESS 0x3FC34C /end MEASUREMENT
/begin MEASUREMENT lam_b2.laa_ml_f "Ermittlung Luftmassenfaktor" UWORD FORMULA_0024 0 0.0 0.0 1.998999953269959 READ_WRITE ECU_ADDRESS 0x3FC346 /end MEASUREMENT
/begin MEASUREMENT lam_b2.laa_ml_f_te "Ermittlung TE-Luftmassenfaktor" UWORD FORMULA_0024 0 0.0 0.0 1.998999953269959 READ_WRITE ECU_ADDRESS 0x3FC34E /end MEASUREMENT
/begin MEASUREMENT lam_b2.laa_ml_offs "Ermittlung Luftmassenoffset" SWORD FORMULA_0535 0 0.0 -512.0 511.0 READ_WRITE ECU_ADDRESS 0x3FC344 /end MEASUREMENT
/begin MEASUREMENT lam_b2.laa_st "LA-Adaption-Status" UWORD FORMULA_0080 0 0.0 0.0 65535.0 READ_WRITE ECU_ADDRESS 0x3FC342 /end MEASUREMENT
/begin MEASUREMENT lam_b2.lavk_ad "AD-Wert d. Sondensignals" UWORD FORMULA_0536 0 0.0 0.0 5000.0 READ_WRITE ECU_ADDRESS 0x3FC310 /end MEASUREMENT
/begin MEASUREMENT lam_b2.lavk_ad_gain_filt "gem. AD-Wert f. Sondenadapt." UWORD FORMULA_0536 0 0.0 0.0 5000.0 READ_WRITE ECU_ADDRESS 0x3FC332 /end MEASUREMENT
/begin MEASUREMENT lam_b2.lavk_ad_korr "korrigierter AD-Wert." SWORD FORMULA_0536 0 0.0 -5000.0 5000.0 READ_WRITE ECU_ADDRESS 0x3FC314 /end MEASUREMENT
/begin MEASUREMENT lam_b2.lavk_ad_mw "AD-Wert d. Sondensignals - 1kHz-Abtastung" UWORD FORMULA_0536 0 0.0 0.0 5000.0 READ_WRITE ECU_ADDRESS 0x3FC312 /end MEASUREMENT
/begin MEASUREMENT lam_b2.lavk_ad_mw_korr "korrigierter AD-Wert. - 1kHz-Abtastung" SWORD FORMULA_0536 0 0.0 -5000.0 5000.0 READ_WRITE ECU_ADDRESS 0x3FC316 /end MEASUREMENT
/begin MEASUREMENT lam_b2.lavk_ad_offs_filt "gem. AD-Wert f. OFFSET-Sondenadapt." UWORD FORMULA_0536 0 0.0 0.0 5000.0 READ_WRITE ECU_ADDRESS 0x3FC330 /end MEASUREMENT
/begin MEASUREMENT lam_b2.lavk_filt_konst "IST-LA-Filterkonstante" UWORD FORMULA_0762 0 0.0 0.0 7.999800205230713 READ_WRITE ECU_ADDRESS 0x3FC354 /end MEASUREMENT
/begin MEASUREMENT lam_b2.lavk_ip "Pumpsptrom" SWORD FORMULA_0750 0 0.0 -10.0 9.999600410461426 READ_WRITE ECU_ADDRESS 0x3FC31C /end MEASUREMENT
/begin MEASUREMENT lam_b2.lavk_ip_korr "korrigierter Pumpsptrom" SWORD FORMULA_0750 0 0.0 -10.0 9.999600410461426 READ_WRITE ECU_ADDRESS 0x3FC320 /end MEASUREMENT
/begin MEASUREMENT lam_b2.lavk_ip_mw "Pumpsptrom - 1kHz-Abtastung" SWORD FORMULA_0750 0 0.0 -10.0 9.999600410461426 READ_WRITE ECU_ADDRESS 0x3FC31E /end MEASUREMENT
/begin MEASUREMENT lam_b2.lavk_ip_mw_korr "korrigierter Pumpsptrom - 1kHz-Abtastung" SWORD FORMULA_0750 0 0.0 -10.0 9.999600410461426 READ_WRITE ECU_ADDRESS 0x3FC322 /end MEASUREMENT
/begin MEASUREMENT lam_b2.lavk_korr_f "Ip-Korrekturfaktor" UWORD FORMULA_0073 0 0.0 0.0 4.0 READ_WRITE ECU_ADDRESS 0x3FC318 /end MEASUREMENT
/begin MEASUREMENT lam_b2.lavk_st "Sonden-Status" UWORD FORMULA_0080 0 0.0 0.0 65535.0 READ_WRITE ECU_ADDRESS 0x3FC30E /end MEASUREMENT
/begin MEASUREMENT lam_b2.lavk_tau1 "TAU1 - IST-LA-Filter" UWORD FORMULA_0761 0 0.0 0.0 2097.0 READ_WRITE ECU_ADDRESS 0x3FC350 /end MEASUREMENT
/begin MEASUREMENT lam_b2.mks_soll_zyl "gefilterte SOLL-Kraftstoffmasse" UWORD FORMULA_0111 0 0.0 0.0 1023.984313964844 READ_WRITE ECU_ADDRESS 0x3FC334 /end MEASUREMENT
/begin MEASUREMENT lam_b2.ml_delta "absolute Regelabweichung" SWORD FORMULA_0111 0 0.0 -512.0 511.9843139648438 READ_WRITE ECU_ADDRESS 0x3FC340 /end MEASUREMENT
/begin MEASUREMENT lam_b2.reg_k "Verstaerkungsfaktor" SWORD FORMULA_0754 0 0.0 -2.0 2.0 READ_WRITE ECU_ADDRESS 0x3FC33E /end MEASUREMENT
/begin MEASUREMENT lam_b2.reg_tn_i "Nachstellzeit - I-Anteil" UWORD FORMULA_0753 0 0.0 0.0 2097.1201171875 READ_WRITE ECU_ADDRESS 0x3FC33A /end MEASUREMENT
/begin MEASUREMENT lam_b2.reg_tn_roh "Nachstellzeit - roh" UWORD FORMULA_0753 0 0.0 0.0 2097.1201171875 READ_WRITE ECU_ADDRESS 0x3FC338 /end MEASUREMENT
/begin MEASUREMENT lam_b2.reg_tv_d "Nachstellzeit - D-Anteil" UWORD FORMULA_0753 0 0.0 0.0 2097.1201171875 READ_WRITE ECU_ADDRESS 0x3FC33C /end MEASUREMENT
/begin MEASUREMENT lam_b2.wf_verz_time "Verzoegerungszeit f. WF-Eingriff" UWORD FORMULA_0752 0 0.0 0.0 65.53500366210938 READ_WRITE ECU_ADDRESS 0x3FC336 /end MEASUREMENT
/begin MEASUREMENT lam_b2.zahn_nr "aktueller KW-Zahn" UWORD FORMULA_0010 0 0.0 0.0 65535.0 READ_WRITE ECU_ADDRESS 0x3FC32A /end MEASUREMENT
/begin MEASUREMENT lam_diag_la_adapt_scdn_b1 "Diagnose LAA-Adaption - SCDN" UWORD FORMULA_0781 0 0 0.0 255.0 READ_WRITE BIT_MASK 0x80 ECU_ADDRESS 0x3FC3DC /end MEASUREMENT
/begin MEASUREMENT lam_diag_la_adapt_scdn_b2 "Diagnose LAA-Adaption - SCDN" UWORD FORMULA_0781 0 0 0.0 255.0 READ_WRITE BIT_MASK 0x80 ECU_ADDRESS 0x3FC3DE /end MEASUREMENT
/begin MEASUREMENT lam_diag_laa_f_cnt_b1 "Zahler fuer LAA-Faktoranschlagszeit" UWORD FORMULA_0010 0 0.0 0.0 65535.0 READ_WRITE ECU_ADDRESS 0x3FC3F4 /end MEASUREMENT
/begin MEASUREMENT lam_diag_laa_f_cnt_b2 "Zahler fuer LAA-Faktoranschlagszeit" UWORD FORMULA_0010 0 0.0 0.0 65535.0 READ_WRITE ECU_ADDRESS 0x3FC3F6 /end MEASUREMENT
/begin MEASUREMENT lam_diag_laa_f_max_aktiv_b1 "oberer LAA-Faktor-Anschlag" UWORD FORMULA_0776 0 0 0.0 255.0 READ_WRITE BIT_MASK 0x4 ECU_ADDRESS 0x3FC3DC /end MEASUREMENT
/begin MEASUREMENT lam_diag_laa_f_max_aktiv_b2 "oberer LAA-Faktor-Anschlag" UWORD FORMULA_0776 0 0 0.0 255.0 READ_WRITE BIT_MASK 0x4 ECU_ADDRESS 0x3FC3DE /end MEASUREMENT
/begin MEASUREMENT lam_diag_laa_f_min_aktiv_b1 "unterer LAA-Faktor-Anschlag" UWORD FORMULA_0777 0 0 0.0 255.0 READ_WRITE BIT_MASK 0x8 ECU_ADDRESS 0x3FC3DC /end MEASUREMENT
/begin MEASUREMENT lam_diag_laa_f_min_aktiv_b2 "unterer LAA-Faktor-Anschlag" UWORD FORMULA_0777 0 0 0.0 255.0 READ_WRITE BIT_MASK 0x8 ECU_ADDRESS 0x3FC3DE /end MEASUREMENT
/begin MEASUREMENT lam_diag_laa_f_t_b1 "LAA-Faktoranschlagszeit" UWORD FORMULA_0071 0 0.0 0.0 6553.5 READ_WRITE ECU_ADDRESS 0x3FC3E8 /end MEASUREMENT
/begin MEASUREMENT lam_diag_laa_f_t_b2 "LAA-Faktoranschlagszeit" UWORD FORMULA_0071 0 0.0 0.0 6553.5 READ_WRITE ECU_ADDRESS 0x3FC3EA /end MEASUREMENT
/begin MEASUREMENT lam_diag_laa_io_t_b1 "LAA-Aanschlag - Heilung" UWORD FORMULA_0010 0 0.0 0.0 65535.0 READ_WRITE ECU_ADDRESS 0x3FC3EC /end MEASUREMENT
/begin MEASUREMENT lam_diag_laa_io_t_b2 "LAA-Aanschlag - Heilung" UWORD FORMULA_0010 0 0.0 0.0 65535.0 READ_WRITE ECU_ADDRESS 0x3FC3EE /end MEASUREMENT
/begin MEASUREMENT lam_diag_laa_offs_cnt_b1 "Zeit fuer LAA-Offsetanschlagszeit" UWORD FORMULA_0010 0 0.0 0.0 65535.0 READ_WRITE ECU_ADDRESS 0x3FC3F8 /end MEASUREMENT
/begin MEASUREMENT lam_diag_laa_offs_cnt_b2 "Zeit fuer LAA-Offsetanschlagszeit" UWORD FORMULA_0010 0 0.0 0.0 65535.0 READ_WRITE ECU_ADDRESS 0x3FC3FA /end MEASUREMENT
/begin MEASUREMENT lam_diag_laa_offs_max_aktiv_b1 "oberer LAA-Offset-Anschlag" UWORD FORMULA_0778 0 0 0.0 255.0 READ_WRITE BIT_MASK 0x10 ECU_ADDRESS 0x3FC3DC /end MEASUREMENT
/begin MEASUREMENT lam_diag_laa_offs_max_aktiv_b2 "oberer LAA-Offset-Anschlag" UWORD FORMULA_0778 0 0 0.0 255.0 READ_WRITE BIT_MASK 0x10 ECU_ADDRESS 0x3FC3DE /end MEASUREMENT
/begin MEASUREMENT lam_diag_laa_offs_min_aktiv_b1 "unterer LAA-Offset-Anschlag" UWORD FORMULA_0779 0 0 0.0 255.0 READ_WRITE BIT_MASK 0x20 ECU_ADDRESS 0x3FC3DC /end MEASUREMENT
/begin MEASUREMENT lam_diag_laa_offs_min_aktiv_b2 "unterer LAA-Offset-Anschlag" UWORD FORMULA_0779 0 0 0.0 255.0 READ_WRITE BIT_MASK 0x20 ECU_ADDRESS 0x3FC3DE /end MEASUREMENT
/begin MEASUREMENT lam_diag_laa_offs_t_b1 "LAA-Offsetanschlagszeit" UWORD FORMULA_0071 0 0.0 0.0 6553.5 READ_WRITE ECU_ADDRESS 0x3FC3F0 /end MEASUREMENT
/begin MEASUREMENT lam_diag_laa_offs_t_b2 "LAA-Offsetanschlagszeit" UWORD FORMULA_0071 0 0.0 0.0 6553.5 READ_WRITE ECU_ADDRESS 0x3FC3F2 /end MEASUREMENT
/begin MEASUREMENT lam_diag_lam_reg_scdn_b1 "Diagnose LA-Regler - SCDN" UWORD FORMULA_0780 0 0 0.0 255.0 READ_WRITE BIT_MASK 0x40 ECU_ADDRESS 0x3FC3DC /end MEASUREMENT
/begin MEASUREMENT lam_diag_lam_reg_scdn_b2 "Diagnose LA-Regler - SCDN" UWORD FORMULA_0780 0 0 0.0 255.0 READ_WRITE BIT_MASK 0x40 ECU_ADDRESS 0x3FC3DE /end MEASUREMENT
/begin MEASUREMENT lam_diag_reg_io_t_b1 "LA-Regleranschlag - Heilung" UWORD FORMULA_0010 0 0.0 0.0 65535.0 READ_WRITE ECU_ADDRESS 0x3FC3E4 /end MEASUREMENT
/begin MEASUREMENT lam_diag_reg_io_t_b2 "LA-Regleranschlag - Heilung" UWORD FORMULA_0010 0 0.0 0.0 65535.0 READ_WRITE ECU_ADDRESS 0x3FC3E6 /end MEASUREMENT
/begin MEASUREMENT lam_diag_reg_max_aktiv_b1 "oberer LA-Regler-Anschlag" UWORD FORMULA_0774 0 0 0.0 255.0 READ_WRITE BIT_MASK 0x1 ECU_ADDRESS 0x3FC3DC /end MEASUREMENT
/begin MEASUREMENT lam_diag_reg_max_aktiv_b2 "oberer LA-Regler-Anschlag" UWORD FORMULA_0774 0 0 0.0 255.0 READ_WRITE BIT_MASK 0x1 ECU_ADDRESS 0x3FC3DE /end MEASUREMENT
/begin MEASUREMENT lam_diag_reg_min_aktiv_b1 "unterer LA-Regler-Anschlag" UWORD FORMULA_0775 0 0 0.0 255.0 READ_WRITE BIT_MASK 0x2 ECU_ADDRESS 0x3FC3DC /end MEASUREMENT
/begin MEASUREMENT lam_diag_reg_min_aktiv_b2 "unterer LA-Regler-Anschlag" UWORD FORMULA_0775 0 0 0.0 255.0 READ_WRITE BIT_MASK 0x2 ECU_ADDRESS 0x3FC3DE /end MEASUREMENT
/begin MEASUREMENT lam_diag_reg_t_b1 "LA-Regleranschlag - Start" UWORD FORMULA_0010 0 0.0 0.0 65535.0 READ_WRITE ECU_ADDRESS 0x3FC3E0 /end MEASUREMENT
/begin MEASUREMENT lam_diag_reg_t_b2 "LA-Regleranschlag - Start" UWORD FORMULA_0010 0 0.0 0.0 65535.0 READ_WRITE ECU_ADDRESS 0x3FC3E2 /end MEASUREMENT
/begin MEASUREMENT lam_diag_st_b1 "Status LA-Anschlagsdiagnose" UWORD FORMULA_0080 0 0.0 0.0 65535.0 READ_WRITE ECU_ADDRESS 0x3FC3DC /end MEASUREMENT
/begin MEASUREMENT lam_diag_st_b2 "Status LA-Anschlagsdiagnose" UWORD FORMULA_0080 0 0.0 0.0 65535.0 READ_WRITE ECU_ADDRESS 0x3FC3DE /end MEASUREMENT
/begin MEASUREMENT lam_ist "Lambda Istwert" UWORD FORMULA_0025 0 0.0 0.0 3.999000072479248 READ_WRITE ARRAY_SIZE 10 ECU_ADDRESS 0x3FC380 MATRIX_DIM 10 1 1 /end MEASUREMENT
/begin MEASUREMENT lam_ist_mw_korr_b1 "korrigierter Mittelwert IST-Lambda" UWORD FORMULA_0025 0 0.0 0.0 3.999000072479248 READ_WRITE ECU_ADDRESS 0x3FC49A /end MEASUREMENT
/begin MEASUREMENT lam_ist_mw_korr_b2 "korrigierter Mittelwert IST-Lambda" UWORD FORMULA_0025 0 0.0 0.0 3.999000072479248 READ_WRITE ECU_ADDRESS 0x3FC49C /end MEASUREMENT
/begin MEASUREMENT lam_ist_seg "Lambda Istwert - 1kHz-Abtastung" UWORD FORMULA_0025 0 0.0 0.0 3.999000072479248 READ_WRITE ARRAY_SIZE 10 ECU_ADDRESS 0x3FC394 MATRIX_DIM 10 1 1 /end MEASUREMENT
/begin MEASUREMENT lam_ml_delta_rel "relative Regelabweichung" SWORD FORMULA_0764 0 0.0 -1.0 0.9998999834060669 READ_WRITE ARRAY_SIZE 6 ECU_ADDRESS 0x3FC3BC MATRIX_DIM 6 1 1 /end MEASUREMENT
/begin MEASUREMENT lam_reg_f_max_b1 "max. Regeleingriff" UWORD FORMULA_0024 0 0.0 0.0 1.998999953269959 READ_WRITE ECU_ADDRESS 0x3FC35C /end MEASUREMENT
/begin MEASUREMENT lam_reg_f_max_b2 "max. Regeleingriff" UWORD FORMULA_0024 0 0.0 0.0 1.998999953269959 READ_WRITE ECU_ADDRESS 0x3FC35E /end MEASUREMENT
/begin MEASUREMENT lam_reg_f_min_b1 "min. Regeleingriff" UWORD FORMULA_0024 0 0.0 0.0 1.998999953269959 READ_WRITE ECU_ADDRESS 0x3FC358 /end MEASUREMENT
/begin MEASUREMENT lam_reg_f_min_b2 "min. Regeleingriff" UWORD FORMULA_0024 0 0.0 0.0 1.998999953269959 READ_WRITE ECU_ADDRESS 0x3FC35A /end MEASUREMENT
/begin MEASUREMENT lam_soll_add_kat_alt_f_b1 "Wichtungsfaktor ueber KAT-Alterung" UWORD FORMULA_0073 0 0.0 0.0 4.0 READ_WRITE ECU_ADDRESS 0x3FC4A2 /end MEASUREMENT
/begin MEASUREMENT lam_soll_add_kat_alt_f_b2 "Wichtungsfaktor ueber KAT-Alterung" UWORD FORMULA_0073 0 0.0 0.0 4.0 READ_WRITE ECU_ADDRESS 0x3FC4A4 /end MEASUREMENT
/begin MEASUREMENT lam_soll_auss_f "Korrekturfak. f. Zustand Sicherheitskonzept" UWORD FORMULA_0073 0 0.0 0.0 4.0 READ_WRITE ECU_ADDRESS 0x3FC4A6 /end MEASUREMENT
/begin MEASUREMENT lam_soll_auss_offs "OFFSET auf KATS-Lambda beim SK-Manager" UWORD FORMULA_0025 0 0.0 0.0 3.999000072479248 READ_WRITE ECU_ADDRESS 0x3FC4A8 /end MEASUREMENT
/begin MEASUREMENT lam_soll_bz_md "md f. Uebergang TL -> VL" SWORD FORMULA_0001 0 0.0 0.0 100.0 READ_WRITE ECU_ADDRESS 0x3FC470 /end MEASUREMENT
/begin MEASUREMENT lam_soll_ms_kat_f_obd "Wichtungsfaktor fuer B_KAT_ZUST_PASSIV" UWORD FORMULA_0073 0 0.0 0.0 4.0 READ_WRITE ECU_ADDRESS 0x3FC494 /end MEASUREMENT
/begin MEASUREMENT lam_soll_ms_kat_max "MAX. Sauerstoffmasse im KAT" SWORD FORMULA_0090 0 0.0 -3276.800048828125 3276.699951171875 READ_WRITE ECU_ADDRESS 0x3FC4AA /end MEASUREMENT
/begin MEASUREMENT lam_soll_ms_kat_offs_obd "OFFSET auf min. Sauerstoffmasse im Zustand PASSIV" SWORD FORMULA_0090 0 0.0 -3276.800048828125 3276.699951171875 READ_WRITE ECU_ADDRESS 0x3FC4AC /end MEASUREMENT
/begin MEASUREMENT lam_soll_ms_kat_soll_max "max. gespeicherte Sauerstoffmasse im KAT" SWORD FORMULA_0090 0 0.0 -3276.800048828125 3276.699951171875 READ_WRITE ECU_ADDRESS 0x3FC490 /end MEASUREMENT
/begin MEASUREMENT lam_soll_ms_kat_soll_min "min. gespeicherte Sauerstoffmasse im KAT" SWORD FORMULA_0090 0 0.0 -3276.800048828125 3276.699951171875 READ_WRITE ECU_ADDRESS 0x3FC492 /end MEASUREMENT
/begin MEASUREMENT lam_soll_ms_kat_trig_sa_b1 "Triggerung SA-Sauerstoffausrauemfunktion" UBYTE FORMULA_0798 0 0.0 0.0 255.0 READ_WRITE ECU_ADDRESS 0x3FC4B0 /end MEASUREMENT
/begin MEASUREMENT lam_soll_ms_kat_trig_sa_b2 "Triggerung SA-Sauerstoffausrauemfunktion" UBYTE FORMULA_0798 0 0.0 0.0 255.0 READ_WRITE ECU_ADDRESS 0x3FC4B1 /end MEASUREMENT
/begin MEASUREMENT lam_soll_ms_kat_trig_schw "Schwelle fuer SA-Sauerstoffausrauemfunktion" SWORD FORMULA_0090 0 0.0 -3276.800048828125 3276.699951171875 READ_WRITE ECU_ADDRESS 0x3FC4B2 /end MEASUREMENT
/begin MEASUREMENT lam_soll_norm_b1 "SOLL-Lambda - Bezugsgroesse Lambda-SOLL" UWORD FORMULA_0025 0 0.0 0.0 3.999000072479248 READ_WRITE ECU_ADDRESS 0x3FC488 /end MEASUREMENT
/begin MEASUREMENT lam_soll_norm_b2 "SOLL-Lambda - Bezugsgroesse Lambda-SOLL" UWORD FORMULA_0025 0 0.0 0.0 3.999000072479248 READ_WRITE ECU_ADDRESS 0x3FC48A /end MEASUREMENT
/begin MEASUREMENT lam_soll_start "SOLL-Lambda von START -> ML" UWORD FORMULA_0025 0 0.0 0.0 3.999000072479248 READ_WRITE ECU_ADDRESS 0x3FC48C /end MEASUREMENT
/begin MEASUREMENT lam_soll_tau1_abg "Zeitkonstante Abgassystem u. Sonde" UWORD FORMULA_0761 0 0.0 0.0 2097.0 READ_WRITE ECU_ADDRESS 0x3FC472 /end MEASUREMENT
/begin MEASUREMENT lam_soll_verz "verzoegertes SOLL-Lambda" UWORD FORMULA_0025 0 0.0 0.0 3.999000072479248 READ_WRITE ARRAY_SIZE 10 ECU_ADDRESS 0x3FC45C MATRIX_DIM 10 1 1 /end MEASUREMENT
/begin MEASUREMENT lam_soll_vl_norm_b1 "Uebergang nach Vollast" UBYTE FORMULA_0797 0 0.0 0.0 255.0 READ_WRITE ECU_ADDRESS 0x3FC4AE /end MEASUREMENT
/begin MEASUREMENT lam_soll_vl_norm_b2 "Uebergang nach Vollast" UBYTE FORMULA_0797 0 0.0 0.0 255.0 READ_WRITE ECU_ADDRESS 0x3FC4AF /end MEASUREMENT
/begin MEASUREMENT lam_soll_wf_f "Korrekturfak. f. Zustand Warmlaufbetrieb" UWORD FORMULA_0073 0 0.0 0.0 4.0 READ_WRITE ECU_ADDRESS 0x3FC48E /end MEASUREMENT
/begin MEASUREMENT lam_w_b1.ml_zyl_filt "gefilterte zyl. Luftmasse in mg/ASP" SWORD FORMULA_0090 0 0.0 -3276.699951171875 3276.699951171875 READ_WRITE ECU_ADDRESS 0x3FC420 /end MEASUREMENT
/begin MEASUREMENT lam_w_b1.soll_add_konv "Pulshub - Konvertierung" SWORD FORMULA_0025 0 0.0 -2.0 1.999899983406067 READ_WRITE ECU_ADDRESS 0x3FC412 /end MEASUREMENT
/begin MEASUREMENT lam_w_b1.soll_add_temp "additiver Pulshub - vor AEBG" SWORD FORMULA_0025 0 0.0 -2.0 1.999899983406067 READ_WRITE ECU_ADDRESS 0x3FC418 /end MEASUREMENT
/begin MEASUREMENT lam_w_b1.soll_bas "gewuenschtes SOLL-Lambda" UWORD FORMULA_0025 0 0.0 0.0 3.999000072479248 READ_WRITE ECU_ADDRESS 0x3FC406 /end MEASUREMENT
/begin MEASUREMENT lam_w_b1.soll_bas_diff "lam_soll_bas-lam_soll_bas_lim" SWORD FORMULA_0025 0 0.0 -2.0 1.999899983406067 READ_WRITE ECU_ADDRESS 0x3FC40A /end MEASUREMENT
/begin MEASUREMENT lam_w_b1.soll_bas_lim "aenderungsbegr. SOLL-Lambda" UWORD FORMULA_0025 0 0.0 0.0 3.999000072479248 READ_WRITE ECU_ADDRESS 0x3FC408 /end MEASUREMENT
/begin MEASUREMENT lam_w_b1.soll_delta_neg "neg. Aenderungsbegrenzung" SWORD FORMULA_0025 0 0.0 -2.0 1.999899983406067 READ_WRITE ECU_ADDRESS 0x3FC410 /end MEASUREMENT
/begin MEASUREMENT lam_w_b1.soll_delta_pos "pos. Aenderungsbegrenzung" SWORD FORMULA_0025 0 0.0 -2.0 1.999899983406067 READ_WRITE ECU_ADDRESS 0x3FC40E /end MEASUREMENT
/begin MEASUREMENT lam_w_b1.soll_filt "gefiltertes LAM_SOLL" UWORD FORMULA_0025 0 0.0 0.0 3.999000072479248 READ_WRITE ECU_ADDRESS 0x3FC41A /end MEASUREMENT
/begin MEASUREMENT lam_w_b1.soll_filt_konst "SOLL-Filterkonstante" UWORD FORMULA_0762 0 0.0 0.0 7.999800205230713 READ_WRITE ECU_ADDRESS 0x3FC41E /end MEASUREMENT
/begin MEASUREMENT lam_w_b1.soll_kr_kats_offs "LAM-SOLL-OFFSET aus KR" SWORD FORMULA_0025 0 0.0 -2.0 1.999899983406067 READ_WRITE ECU_ADDRESS 0x3FC42A /end MEASUREMENT
/begin MEASUREMENT lam_w_b1.soll_ms_kat_delta "zugefuehrte Sauerstoffmasse im KAT/ASP" SWORD FORMULA_0796 0 0.0 -819.2000122070313 819.1749877929688 READ_WRITE ECU_ADDRESS 0x3FC414 /end MEASUREMENT
/begin MEASUREMENT lam_w_b1.soll_ms_kat_init "Ausgangspunkt f. Sauerstoffmassenintegration im KAT" SWORD FORMULA_0090 0 0.0 -3276.800048828125 3276.699951171875 READ_WRITE ECU_ADDRESS 0x3FC416 /end MEASUREMENT
/begin MEASUREMENT lam_w_b1.soll_st "LAM_SOLL-Status" UWORD FORMULA_0795 0 0.0 0.0 65535.0 READ_WRITE BIT_MASK 0x1FF ECU_ADDRESS 0x3FC402 /end MEASUREMENT
/begin MEASUREMENT lam_w_b1.soll_stat "SOLL-Lambda entsprechend dem LAM_SOLL-Zustand" UWORD FORMULA_0025 0 0.0 0.0 3.999000072479248 READ_WRITE ECU_ADDRESS 0x3FC404 /end MEASUREMENT
/begin MEASUREMENT lam_w_b1.soll_tau1 "TAU1 - SOLL-Filter" UWORD FORMULA_0761 0 0.0 0.0 2097.0 READ_WRITE ECU_ADDRESS 0x3FC41C /end MEASUREMENT
/begin MEASUREMENT lam_w_b1.soll_vl_bezug "Bezugswert f. Ermittlung VL-SOLL-Lambda" UWORD FORMULA_0025 0 0.0 0.0 3.999000072479248 READ_WRITE ECU_ADDRESS 0x3FC40C /end MEASUREMENT
/begin MEASUREMENT lam_w_b1.soll_zust_st "Zustandsautomat LAM_SOLL" UWORD FORMULA_0794 0 0.0 0.0 65535.0 READ_WRITE BIT_MASK 0xFFF ECU_ADDRESS 0x3FC400 /end MEASUREMENT
/begin MEASUREMENT lam_w_b1.tz_offs_kats "TZ-OFFSET aus KR" SWORD FORMULA_0102 0 0.0 -50.0 60.0 READ_WRITE ECU_ADDRESS 0x3FC428 /end MEASUREMENT
/begin MEASUREMENT lam_w_b2.ml_zyl_filt "gefilterte zyl. Luftmasse in mg/ASP" SWORD FORMULA_0090 0 0.0 -3276.699951171875 3276.699951171875 READ_WRITE ECU_ADDRESS 0x3FC44E /end MEASUREMENT
/begin MEASUREMENT lam_w_b2.soll_add_konv "Pulshub - Konvertierung" SWORD FORMULA_0025 0 0.0 -2.0 1.999899983406067 READ_WRITE ECU_ADDRESS 0x3FC440 /end MEASUREMENT
/begin MEASUREMENT lam_w_b2.soll_add_temp "additiver Pulshub - vor AEBG" SWORD FORMULA_0025 0 0.0 -2.0 1.999899983406067 READ_WRITE ECU_ADDRESS 0x3FC446 /end MEASUREMENT
/begin MEASUREMENT lam_w_b2.soll_bas "gewuenschtes SOLL-Lambda" UWORD FORMULA_0025 0 0.0 0.0 3.999000072479248 READ_WRITE ECU_ADDRESS 0x3FC434 /end MEASUREMENT
/begin MEASUREMENT lam_w_b2.soll_bas_diff "lam_soll_bas-lam_soll_bas_lim" SWORD FORMULA_0025 0 0.0 -2.0 1.999899983406067 READ_WRITE ECU_ADDRESS 0x3FC438 /end MEASUREMENT
/begin MEASUREMENT lam_w_b2.soll_bas_lim "aenderungsbegr. SOLL-Lambda" UWORD FORMULA_0025 0 0.0 0.0 3.999000072479248 READ_WRITE ECU_ADDRESS 0x3FC436 /end MEASUREMENT
/begin MEASUREMENT lam_w_b2.soll_delta_neg "neg. Aenderungsbegrenzung" SWORD FORMULA_0025 0 0.0 -2.0 1.999899983406067 READ_WRITE ECU_ADDRESS 0x3FC43E /end MEASUREMENT
/begin MEASUREMENT lam_w_b2.soll_delta_pos "pos. Aenderungsbegrenzung" SWORD FORMULA_0025 0 0.0 -2.0 1.999899983406067 READ_WRITE ECU_ADDRESS 0x3FC43C /end MEASUREMENT
/begin MEASUREMENT lam_w_b2.soll_filt "gefiltertes LAM_SOLL" UWORD FORMULA_0025 0 0.0 0.0 3.999000072479248 READ_WRITE ECU_ADDRESS 0x3FC448 /end MEASUREMENT
/begin MEASUREMENT lam_w_b2.soll_filt_konst "SOLL-Filterkonstante" UWORD FORMULA_0762 0 0.0 0.0 7.999800205230713 READ_WRITE ECU_ADDRESS 0x3FC44C /end MEASUREMENT
/begin MEASUREMENT lam_w_b2.soll_kr_kats_offs "LAM-SOLL-OFFSET aus KR" SWORD FORMULA_0025 0 0.0 -2.0 1.999899983406067 READ_WRITE ECU_ADDRESS 0x3FC458 /end MEASUREMENT
/begin MEASUREMENT lam_w_b2.soll_ms_kat_delta "zugefuehrte Sauerstoffmasse im KAT/ASP" SWORD FORMULA_0796 0 0.0 -819.2000122070313 819.1749877929688 READ_WRITE ECU_ADDRESS 0x3FC442 /end MEASUREMENT
/begin MEASUREMENT lam_w_b2.soll_ms_kat_init "Ausgangspunkt f. Sauerstoffmassenintegration im KAT" SWORD FORMULA_0090 0 0.0 -3276.800048828125 3276.699951171875 READ_WRITE ECU_ADDRESS 0x3FC444 /end MEASUREMENT
/begin MEASUREMENT lam_w_b2.soll_st "LAM_SOLL-Status" UWORD FORMULA_0795 0 0.0 0.0 65535.0 READ_WRITE BIT_MASK 0x1FF ECU_ADDRESS 0x3FC430 /end MEASUREMENT
/begin MEASUREMENT lam_w_b2.soll_stat "SOLL-Lambda entsprechend dem LAM_SOLL-Zustand" UWORD FORMULA_0025 0 0.0 0.0 3.999000072479248 READ_WRITE ECU_ADDRESS 0x3FC432 /end MEASUREMENT
/begin MEASUREMENT lam_w_b2.soll_tau1 "TAU1 - SOLL-Filter" UWORD FORMULA_0761 0 0.0 0.0 2097.0 READ_WRITE ECU_ADDRESS 0x3FC44A /end MEASUREMENT
/begin MEASUREMENT lam_w_b2.soll_vl_bezug "Bezugswert f. Ermittlung VL-SOLL-Lambda" UWORD FORMULA_0025 0 0.0 0.0 3.999000072479248 READ_WRITE ECU_ADDRESS 0x3FC43A /end MEASUREMENT
/begin MEASUREMENT lam_w_b2.soll_zust_st "Zustandsautomat LAM_SOLL" UWORD FORMULA_0794 0 0.0 0.0 65535.0 READ_WRITE BIT_MASK 0xFFF ECU_ADDRESS 0x3FC42E /end MEASUREMENT
/begin MEASUREMENT lam_w_b2.tz_offs_kats "TZ-OFFSET aus KR" SWORD FORMULA_0102 0 0.0 -50.0 60.0 READ_WRITE ECU_ADDRESS 0x3FC456 /end MEASUREMENT
/begin MEASUREMENT lavk_ad_gain_cnt_t_b1 "GAIN-Glaettungszeit" UWORD FORMULA_0772 0 0 0.0 255.0 READ_WRITE BIT_MASK 0x200 ECU_ADDRESS 0x3FC3C8 /end MEASUREMENT
/begin MEASUREMENT lavk_ad_gain_cnt_t_b2 "GAIN-Glaettungszeit" UWORD FORMULA_0772 0 0 0.0 255.0 READ_WRITE BIT_MASK 0x200 ECU_ADDRESS 0x3FC3CA /end MEASUREMENT
/begin MEASUREMENT lavk_ad_gain_delta_t_b1 "Delta-Zeit zwischen 2 GAIN-Adaptionen" ULONG FORMULA_0147 0 0.0 0.0 655.0 READ_WRITE ECU_ADDRESS 0x3FC3CC /end MEASUREMENT
/begin MEASUREMENT lavk_ad_gain_delta_t_b2 "Delta-Zeit zwischen 2 GAIN-Adaptionen" ULONG FORMULA_0147 0 0.0 0.0 655.0 READ_WRITE ECU_ADDRESS 0x3FC3D0 /end MEASUREMENT
/begin MEASUREMENT lavk_ad_gain_freig_b1 "GAIN-Sondenadaption FREIGABE" UWORD FORMULA_0771 0 0 0.0 255.0 READ_WRITE BIT_MASK 0x100 ECU_ADDRESS 0x3FC3C8 /end MEASUREMENT
/begin MEASUREMENT lavk_ad_gain_freig_b2 "GAIN-Sondenadaption FREIGABE" UWORD FORMULA_0771 0 0 0.0 255.0 READ_WRITE BIT_MASK 0x100 ECU_ADDRESS 0x3FC3CA /end MEASUREMENT
/begin MEASUREMENT lavk_ad_gain_st_b1 "GAIN-Sondenadaption" UWORD FORMULA_0773 0 0 0.0 255.0 READ_WRITE BIT_MASK 0x400 ECU_ADDRESS 0x3FC3C8 /end MEASUREMENT
/begin MEASUREMENT lavk_ad_gain_st_b2 "GAIN-Sondenadaption" UWORD FORMULA_0773 0 0 0.0 255.0 READ_WRITE BIT_MASK 0x400 ECU_ADDRESS 0x3FC3CA /end MEASUREMENT
/begin MEASUREMENT lavk_ad_offs_cnt_t_b1 "OFFSET-Glaettungszeit" UWORD FORMULA_0768 0 0 0.0 255.0 READ_WRITE BIT_MASK 0x8 ECU_ADDRESS 0x3FC3C8 /end MEASUREMENT
/begin MEASUREMENT lavk_ad_offs_cnt_t_b2 "OFFSET-Glaettungszeit" UWORD FORMULA_0768 0 0 0.0 255.0 READ_WRITE BIT_MASK 0x8 ECU_ADDRESS 0x3FC3CA /end MEASUREMENT
/begin MEASUREMENT lavk_ad_offs_delta_t_b1 "Delta-Zeit zwischen 2 OFFSET-Adaptionen" ULONG FORMULA_0147 0 0.0 0.0 655.0 READ_WRITE ECU_ADDRESS 0x3FC3D4 /end MEASUREMENT
/begin MEASUREMENT lavk_ad_offs_delta_t_b2 "Delta-Zeit zwischen 2 OFFSET-Adaptionen" ULONG FORMULA_0147 0 0.0 0.0 655.0 READ_WRITE ECU_ADDRESS 0x3FC3D8 /end MEASUREMENT
/begin MEASUREMENT lavk_ad_offs_freig_b1 "OFFSET-Sondenadaption FREIGABE" UWORD FORMULA_0770 0 0 0.0 255.0 READ_WRITE BIT_MASK 0x20 ECU_ADDRESS 0x3FC3C8 /end MEASUREMENT
/begin MEASUREMENT lavk_ad_offs_freig_b2 "OFFSET-Sondenadaption FREIGABE" UWORD FORMULA_0770 0 0 0.0 255.0 READ_WRITE BIT_MASK 0x20 ECU_ADDRESS 0x3FC3CA /end MEASUREMENT
/begin MEASUREMENT lavk_ad_offs_ml_b1 "OFFSET-Sondenadaption bei ML" UWORD FORMULA_0766 0 0 0.0 255.0 READ_WRITE BIT_MASK 0x2 ECU_ADDRESS 0x3FC3C8 /end MEASUREMENT
/begin MEASUREMENT lavk_ad_offs_ml_b2 "OFFSET-Sondenadaption bei ML" UWORD FORMULA_0766 0 0 0.0 255.0 READ_WRITE BIT_MASK 0x2 ECU_ADDRESS 0x3FC3CA /end MEASUREMENT
/begin MEASUREMENT lavk_ad_offs_ms_b1 "OFFSET-Sondenadaption bei MS" UWORD FORMULA_0765 0 0 0.0 255.0 READ_WRITE BIT_MASK 0x1 ECU_ADDRESS 0x3FC3C8 /end MEASUREMENT
/begin MEASUREMENT lavk_ad_offs_ms_b2 "OFFSET-Sondenadaption bei MS" UWORD FORMULA_0765 0 0 0.0 255.0 READ_WRITE BIT_MASK 0x1 ECU_ADDRESS 0x3FC3CA /end MEASUREMENT
/begin MEASUREMENT lavk_ad_offs_spi_b1 "OFFSET-Sondenadaption - ATIC42" UWORD FORMULA_0767 0 0 0.0 255.0 READ_WRITE BIT_MASK 0x4 ECU_ADDRESS 0x3FC3C8 /end MEASUREMENT
/begin MEASUREMENT lavk_ad_offs_spi_b2 "OFFSET-Sondenadaption - ATIC42" UWORD FORMULA_0767 0 0 0.0 255.0 READ_WRITE BIT_MASK 0x4 ECU_ADDRESS 0x3FC3CA /end MEASUREMENT
/begin MEASUREMENT lavk_ad_offs_st_b1 "OFFSET-Sondenadaption" UWORD FORMULA_0769 0 0 0.0 255.0 READ_WRITE BIT_MASK 0x10 ECU_ADDRESS 0x3FC3C8 /end MEASUREMENT
/begin MEASUREMENT lavk_ad_offs_st_b2 "OFFSET-Sondenadaption" UWORD FORMULA_0769 0 0 0.0 255.0 READ_WRITE BIT_MASK 0x10 ECU_ADDRESS 0x3FC3CA /end MEASUREMENT
/begin MEASUREMENT lavk_ad_st_b1 "Sondenadation-Status" UWORD FORMULA_0080 0 0.0 0.0 65535.0 READ_WRITE ECU_ADDRESS 0x3FC3C8 /end MEASUREMENT
/begin MEASUREMENT lavk_ad_st_b2 "Sondenadation-Status" UWORD FORMULA_0080 0 0.0 0.0 65535.0 READ_WRITE ECU_ADDRESS 0x3FC3CA /end MEASUREMENT
/begin MEASUREMENT lavk_atic42_cnt_b1 "Ablaufzaeker SPI ATIC42" UBYTE FORMULA_0003 0 0.0 0.0 10.0 READ_WRITE ECU_ADDRESS 0x3FC5C0 /end MEASUREMENT
/begin MEASUREMENT lavk_atic42_cnt_b2 "Ablaufzaeker SPI ATIC42" UBYTE FORMULA_0003 0 0.0 0.0 10.0 READ_WRITE ECU_ADDRESS 0x3FC5C1 /end MEASUREMENT
/begin MEASUREMENT lavk_atic42_diag_byte_b1 "ATIC42 - Diagnose Byte" UBYTE FORMULA_0003 0 0.0 0.0 255.0 READ_WRITE ECU_ADDRESS 0x3FC5DA /end MEASUREMENT
/begin MEASUREMENT lavk_atic42_diag_byte_b2 "ATIC42 - Diagnose Byte" UBYTE FORMULA_0003 0 0.0 0.0 255.0 READ_WRITE ECU_ADDRESS 0x3FC5DB /end MEASUREMENT
/begin MEASUREMENT lavk_atic42_diag_st_b1 "" UBYTE FORMULA_0878 0 0 0.0 255.0 READ_WRITE BIT_MASK 0x1 ECU_ADDRESS 0x3FC5E0 /end MEASUREMENT
/begin MEASUREMENT lavk_atic42_diag_st_b2 "" UBYTE FORMULA_0878 0 0 0.0 255.0 READ_WRITE BIT_MASK 0x1 ECU_ADDRESS 0x3FC5E1 /end MEASUREMENT
/begin MEASUREMENT lavk_atic42_icp_enable_b1 "ATIC42 ICP Einspeisung" UBYTE FORMULA_0867 0 0 0.0 255.0 READ_WRITE BIT_MASK 0x4 ECU_ADDRESS 0x3FC5C2 /end MEASUREMENT
/begin MEASUREMENT lavk_atic42_icp_enable_b2 "ATIC42 ICP Einspeisung" UBYTE FORMULA_0867 0 0 0.0 255.0 READ_WRITE BIT_MASK 0x4 ECU_ADDRESS 0x3FC5C3 /end MEASUREMENT
/begin MEASUREMENT lavk_atic42_icp_value_b1 "ATIC42 ICP Wert" UWORD FORMULA_0875 0 0.0 5.0 160.0 READ_WRITE ECU_ADDRESS 0x3FC5CC /end MEASUREMENT
/begin MEASUREMENT lavk_atic42_icp_value_b2 "ATIC42 ICP Wert" UWORD FORMULA_0875 0 0.0 5.0 160.0 READ_WRITE ECU_ADDRESS 0x3FC5CE /end MEASUREMENT
/begin MEASUREMENT lavk_atic42_identity_b1 "" UWORD FORMULA_0010 0 0.0 0.0 65535.0 READ_WRITE ECU_ADDRESS 0x3FC5DC /end MEASUREMENT
/begin MEASUREMENT lavk_atic42_identity_b2 "" UWORD FORMULA_0010 0 0.0 0.0 65535.0 READ_WRITE ECU_ADDRESS 0x3FC5DE /end MEASUREMENT
/begin MEASUREMENT lavk_atic42_ip_gain_b1 "ATIC42 Pumpstromverstaerkung" UBYTE FORMULA_0865 0 0 0.0 255.0 READ_WRITE BIT_MASK 0x1 ECU_ADDRESS 0x3FC5C2 /end MEASUREMENT
/begin MEASUREMENT lavk_atic42_ip_gain_b2 "ATIC42 Pumpstromverstaerkung" UBYTE FORMULA_0865 0 0 0.0 255.0 READ_WRITE BIT_MASK 0x1 ECU_ADDRESS 0x3FC5C3 /end MEASUREMENT
/begin MEASUREMENT lavk_atic42_ip_loop_enable_b1 "ATIC42 Pumpstrom Regelung" UBYTE FORMULA_0873 0 0 0.0 255.0 READ_WRITE BIT_MASK 0x1 ECU_ADDRESS 0x3FC5C8 /end MEASUREMENT
/begin MEASUREMENT lavk_atic42_ip_loop_enable_b2 "ATIC42 Pumpstrom Regelung" UBYTE FORMULA_0873 0 0 0.0 255.0 READ_WRITE BIT_MASK 0x1 ECU_ADDRESS 0x3FC5C9 /end MEASUREMENT
/begin MEASUREMENT lavk_atic42_ip_loop_enable_spi_b1 "ATIC42 Pumpstrom Regelung" UBYTE FORMULA_0868 0 0 0.0 255.0 READ_WRITE BIT_MASK 0x8 ECU_ADDRESS 0x3FC5C2 /end MEASUREMENT
/begin MEASUREMENT lavk_atic42_ip_loop_enable_spi_b2 "ATIC42 Pumpstrom Regelung" UBYTE FORMULA_0868 0 0 0.0 255.0 READ_WRITE BIT_MASK 0x8 ECU_ADDRESS 0x3FC5C3 /end MEASUREMENT
/begin MEASUREMENT lavk_atic42_ip_offset_meas_b1 "ATIC42 Pumpstromoffset-Messung" UBYTE FORMULA_0866 0 0 0.0 255.0 READ_WRITE BIT_MASK 0x2 ECU_ADDRESS 0x3FC5C2 /end MEASUREMENT
/begin MEASUREMENT lavk_atic42_ip_offset_meas_b2 "ATIC42 Pumpstromoffset-Messung" UBYTE FORMULA_0866 0 0 0.0 255.0 READ_WRITE BIT_MASK 0x2 ECU_ADDRESS 0x3FC5C3 /end MEASUREMENT
/begin MEASUREMENT lavk_atic42_ip_st_b1 "ATIC42-IP-Status" UBYTE FORMULA_0037 0 0.0 0.0 255.0 READ_WRITE ECU_ADDRESS 0x3FC5C2 /end MEASUREMENT
/begin MEASUREMENT lavk_atic42_ip_st_b2 "ATIC42-IP-Status" UBYTE FORMULA_0037 0 0.0 0.0 255.0 READ_WRITE ECU_ADDRESS 0x3FC5C3 /end MEASUREMENT
/begin MEASUREMENT lavk_atic42_mode_b1 "SPI Mode ATIC42" UBYTE FORMULA_0864 0 0.0 0.0 255.0 READ_WRITE ECU_ADDRESS 0x3FC5BE /end MEASUREMENT
/begin MEASUREMENT lavk_atic42_mode_b2 "SPI Mode ATIC42" UBYTE FORMULA_0864 0 0.0 0.0 255.0 READ_WRITE ECU_ADDRESS 0x3FC5BF /end MEASUREMENT
/begin MEASUREMENT lavk_atic42_pin_b1 "Pin-Freigabe" UBYTE FORMULA_0874 0 0 0.0 255.0 READ_WRITE BIT_MASK 0x1 ECU_ADDRESS 0x3FC5CA /end MEASUREMENT
/begin MEASUREMENT lavk_atic42_pin_b2 "Pin-Freigabe" UBYTE FORMULA_0874 0 0 0.0 255.0 READ_WRITE BIT_MASK 0x1 ECU_ADDRESS 0x3FC5CB /end MEASUREMENT
/begin MEASUREMENT lavk_atic42_pin_diag_b1 "ATIC42 - Pin Diagnose" UBYTE FORMULA_0003 0 0.0 0.0 255.0 READ_WRITE ECU_ADDRESS 0x3FC5D8 /end MEASUREMENT
/begin MEASUREMENT lavk_atic42_pin_diag_b2 "ATIC42 - Pin Diagnose" UBYTE FORMULA_0003 0 0.0 0.0 255.0 READ_WRITE ECU_ADDRESS 0x3FC5D9 /end MEASUREMENT
/begin MEASUREMENT lavk_atic42_protec_time_b1 "ATIC42 Zeit in der der Sensor nach einem Fehler getrennt wird" UWORD FORMULA_0876 0 0.0 0.800000011920929 1.5 READ_WRITE ECU_ADDRESS 0x3FC5D0 /end MEASUREMENT
/begin MEASUREMENT lavk_atic42_protec_time_b2 "ATIC42 Zeit in der der Sensor nach einem Fehler getrennt wird" UWORD FORMULA_0876 0 0.0 0.800000011920929 1.5 READ_WRITE ECU_ADDRESS 0x3FC5D2 /end MEASUREMENT
/begin MEASUREMENT lavk_atic42_ri_calib_b1 "ATIC42 Innenwiderstands Kalibrierung" UBYTE FORMULA_0869 0 0 0.0 255.0 READ_WRITE BIT_MASK 0x1 ECU_ADDRESS 0x3FC5C4 /end MEASUREMENT
/begin MEASUREMENT lavk_atic42_ri_calib_b2 "ATIC42 Innenwiderstands Kalibrierung" UBYTE FORMULA_0869 0 0 0.0 255.0 READ_WRITE BIT_MASK 0x1 ECU_ADDRESS 0x3FC5C5 /end MEASUREMENT
/begin MEASUREMENT lavk_atic42_ri_freq_b1 "ATIC42 Frequenz der Oszillators zur Innenwiderstandsmessung" UWORD FORMULA_0877 0 0.0 2.0 9.875 READ_WRITE ECU_ADDRESS 0x3FC5D4 /end MEASUREMENT
/begin MEASUREMENT lavk_atic42_ri_freq_b2 "ATIC42 Frequenz der Oszillators zur Innenwiderstandsmessung" UWORD FORMULA_0877 0 0.0 2.0 9.875 READ_WRITE ECU_ADDRESS 0x3FC5D6 /end MEASUREMENT
/begin MEASUREMENT lavk_atic42_ri_osci_b1 "ATIC42 Innenwiderstands Oszillator" UBYTE FORMULA_0866 0 0 0.0 255.0 READ_WRITE BIT_MASK 0x2 ECU_ADDRESS 0x3FC5C4 /end MEASUREMENT
/begin MEASUREMENT lavk_atic42_ri_osci_b2 "ATIC42 Innenwiderstands Oszillator" UBYTE FORMULA_0866 0 0 0.0 255.0 READ_WRITE BIT_MASK 0x2 ECU_ADDRESS 0x3FC5C5 /end MEASUREMENT
/begin MEASUREMENT lavk_atic42_ri_range_b1 "ATIC42 Innenwiderstands Messbereich" UBYTE FORMULA_0872 0 0 0.0 255.0 READ_WRITE BIT_MASK 0x1 ECU_ADDRESS 0x3FC5C6 /end MEASUREMENT
/begin MEASUREMENT lavk_atic42_ri_range_b2 "ATIC42 Innenwiderstands Messbereich" UBYTE FORMULA_0872 0 0 0.0 255.0 READ_WRITE BIT_MASK 0x1 ECU_ADDRESS 0x3FC5C7 /end MEASUREMENT
/begin MEASUREMENT lavk_atic42_ri_range_spi_b1 "ATIC42 Innenwiderstands Messbereich" UBYTE FORMULA_0871 0 0 0.0 255.0 READ_WRITE BIT_MASK 0x8 ECU_ADDRESS 0x3FC5C4 /end MEASUREMENT
/begin MEASUREMENT lavk_atic42_ri_range_spi_b2 "ATIC42 Innenwiderstands Messbereich" UBYTE FORMULA_0871 0 0 0.0 255.0 READ_WRITE BIT_MASK 0x8 ECU_ADDRESS 0x3FC5C5 /end MEASUREMENT
/begin MEASUREMENT lavk_atic42_ri_st_b1 "ATIC42-RI-Status" UBYTE FORMULA_0037 0 0.0 0.0 255.0 READ_WRITE ECU_ADDRESS 0x3FC5C4 /end MEASUREMENT
/begin MEASUREMENT lavk_atic42_ri_st_b2 "ATIC42-RI-Status" UBYTE FORMULA_0037 0 0.0 0.0 255.0 READ_WRITE ECU_ADDRESS 0x3FC5C5 /end MEASUREMENT
/begin MEASUREMENT lavk_atic42_sensor_b1 "ATIC42 Lambda Sonde" UBYTE FORMULA_0870 0 0 0.0 255.0 READ_WRITE BIT_MASK 0x4 ECU_ADDRESS 0x3FC5C4 /end MEASUREMENT
/begin MEASUREMENT lavk_atic42_sensor_b2 "ATIC42 Lambda Sonde" UBYTE FORMULA_0870 0 0 0.0 255.0 READ_WRITE BIT_MASK 0x4 ECU_ADDRESS 0x3FC5C5 /end MEASUREMENT
/begin MEASUREMENT lavk_spi_buffer_ret "SPi-Antwortpuffer" UWORD FORMULA_0010 0 0.0 0.0 65535.0 READ_WRITE ECU_ADDRESS 0x3FC5BC /end MEASUREMENT
/begin MEASUREMENT ml_zyl_verz "verzoegerte zyl. Luftmasse in mg/ASP" SWORD FORMULA_0090 0 0.0 -3276.699951171875 3276.699951171875 READ_WRITE ARRAY_SIZE 10 ECU_ADDRESS 0x3FC474 MATRIX_DIM 10 1 1 /end MEASUREMENT
/begin MEASUREMENT pks_soll "Sollwert Kraftstoffdruck, relativ" SWORD FORMULA_0110 0 0.0 0.0 10.0 READ_WRITE ECU_ADDRESS 0x3FCA7E /end MEASUREMENT
/begin MEASUREMENT pks_soll_dyn "Sollwert Kraftstoffdruck, gefiltert" SWORD FORMULA_0110 0 0.0 0.0 10.0 READ_WRITE ECU_ADDRESS 0x3FCA78 /end MEASUREMENT
/begin MEASUREMENT pks_soll_dyn_delta "Sollwert Kraftstoffdruck, Filter-Abweichung" SWORD FORMULA_0110 0 0.0 0.0 10.0 READ_WRITE ECU_ADDRESS 0x3FCA7A /end MEASUREMENT
/begin MEASUREMENT pks_soll_dyn_delta_max "Sollwert Kraftstoffdruck, Filter-Abweichung" SWORD FORMULA_0110 0 0.0 0.0 10.0 READ_WRITE ECU_ADDRESS 0x3FCA7C /end MEASUREMENT
/begin MEASUREMENT pksr_adap_diag_t "Zeit im Adaptionsanschlag" UWORD FORMULA_0593 0 0.0 0.0 65535.0 READ_WRITE ECU_ADDRESS 0x3FCAD0 /end MEASUREMENT
/begin MEASUREMENT pksr_adap_offset "PKSR-Adaptionsoffset" SWORD FORMULA_0557 0 0.0 -100.0 99.98999786376953 READ_WRITE ECU_ADDRESS 0x3FCAAC /end MEASUREMENT
/begin MEASUREMENT pksr_b_ekp1_diag "Diagnose EKP1" UBYTE FORMULA_0159 0 0.0 0.0 255.0 READ_WRITE ECU_ADDRESS 0x3FCAA4 /end MEASUREMENT
/begin MEASUREMENT pksr_b_kath "Bedingung Kath-Heizen" UBYTE FORMULA_0159 0 0.0 0.0 255.0 READ_WRITE ECU_ADDRESS 0x3FCAAB /end MEASUREMENT
/begin MEASUREMENT pksr_b_notlauf "Notlaufbedingung EKP" UBYTE FORMULA_0159 0 0.0 0.0 255.0 READ_WRITE ECU_ADDRESS 0x3FCAAA /end MEASUREMENT
/begin MEASUREMENT pksr_ekp_100_rampe "Delta fuer Rampe aus 100Proz" UBYTE FORMULA_1033 0 0.0 0.0 25.5 READ_WRITE ECU_ADDRESS 0x3FCA76 /end MEASUREMENT
/begin MEASUREMENT pksr_ekp2_enable1 "Zuschaltbedingung1 f. EKP2" SWORD FORMULA_1035 0 0.0 -32768.0 32767.0 READ_WRITE ECU_ADDRESS 0x3FCA98 /end MEASUREMENT
/begin MEASUREMENT pksr_ekp2_enable2 "Zuschaltbedingung2 f. EKP2" SWORD FORMULA_1035 0 0.0 -32768.0 32767.0 READ_WRITE ECU_ADDRESS 0x3FCA9C /end MEASUREMENT
/begin MEASUREMENT pksr_exd_delta_fst_0s "Fuellstandsdelta zwischen linker und rechter Tankhaelfte bei Anfang" SBYTE FORMULA_0559 0 0.0 -64.0 63.5 READ_WRITE ECU_ADDRESS 0x3FCAB2 /end MEASUREMENT
/begin MEASUREMENT pksr_exd_delta_fst_15s "Fuellstandsdelta zwischen linker und rechter Tankhaelfte nach 15s " SBYTE FORMULA_0559 0 0.0 -64.0 63.5 READ_WRITE ECU_ADDRESS 0x3FCABC /end MEASUREMENT
/begin MEASUREMENT pksr_exd_delta_p_vl "pksr_exd_pks65proz - pksr_exd_pks65proz_vl" SWORD FORMULA_0110 0 0.0 0.0 10.0 READ_WRITE ECU_ADDRESS 0x3FCAC2 /end MEASUREMENT
/begin MEASUREMENT pksr_exd_delta_ssp "pksr_exd_delta_fst_0s - pksr_exd_delta_fst_15s" SBYTE FORMULA_0559 0 0.0 -64.0 63.5 READ_WRITE ECU_ADDRESS 0x3FCABD /end MEASUREMENT
/begin MEASUREMENT pksr_exd_delta_tv25 "Delta zwischen Vorsteuerung und geregeltem TV bei 2.5bar" SWORD FORMULA_0161 0 0.0 -100.0 100.0 READ_WRITE ECU_ADDRESS 0x3FCAAE /end MEASUREMENT
/begin MEASUREMENT pksr_exd_delta_tv55 "Delta zwischen Vorsteuerung und geregeltem TV bei 5.5bar" SWORD FORMULA_0161 0 0.0 -100.0 100.0 READ_WRITE ECU_ADDRESS 0x3FCAB0 /end MEASUREMENT
/begin MEASUREMENT pksr_exd_diag_st "Diagstatus Prueflauf" UWORD FORMULA_1036 0 0.0 0.0 65535.0 READ_WRITE ECU_ADDRESS 0x3FCAC6 /end MEASUREMENT
/begin MEASUREMENT pksr_exd_fst_li_0s "Fuellstand linke Tankhaelfte bei Anfang" UBYTE FORMULA_0559 0 0.0 0.0 127.5 READ_WRITE ECU_ADDRESS 0x3FCAB3 /end MEASUREMENT
/begin MEASUREMENT pksr_exd_p_delta_dr "pksr_exd_p_max_dr - pksr_exd_p_oeffbeg_dr" SWORD FORMULA_0110 0 0.0 0.0 10.0 READ_WRITE ECU_ADDRESS 0x3FCABA /end MEASUREMENT
/begin MEASUREMENT pksr_exd_p_max_dr "PKS bei ca. 230 l/h Durchfluss durch Druckregler" SWORD FORMULA_0110 0 0.0 0.0 10.0 READ_WRITE ECU_ADDRESS 0x3FCAB8 /end MEASUREMENT
/begin MEASUREMENT pksr_exd_p_oeffbeg_dr "PKS bei 0 l/h Durchfluss durch Druckregler" SWORD FORMULA_0110 0 0.0 0.0 10.0 READ_WRITE ECU_ADDRESS 0x3FCAB4 /end MEASUREMENT
/begin MEASUREMENT pksr_exd_pdif "Differenzdruck pks_rel" SWORD FORMULA_1037 0 0.0 0.0 10.0 READ_WRITE ECU_ADDRESS 0x3FCACA /end MEASUREMENT
/begin MEASUREMENT pksr_exd_pdif_fil "gefilterter pksr_exd_pdif" SWORD FORMULA_1037 0 0.0 0.0 10.0 READ_WRITE ECU_ADDRESS 0x3FCACC /end MEASUREMENT
/begin MEASUREMENT pksr_exd_pks_fil "Kraftstoffdruck, relativ" SWORD FORMULA_0110 0 0.0 0.0 10.0 READ_WRITE ECU_ADDRESS 0x3FCAC8 /end MEASUREMENT
/begin MEASUREMENT pksr_exd_pks65proz "pks_rel bei 65% TV, md_fw_rel = 0%" SWORD FORMULA_0110 0 0.0 0.0 10.0 READ_WRITE ECU_ADDRESS 0x3FCABE /end MEASUREMENT
/begin MEASUREMENT pksr_exd_pks65proz_vl "pks_rel bei 65% TV, md_fw_rel = 100%" SWORD FORMULA_0110 0 0.0 0.0 10.0 READ_WRITE ECU_ADDRESS 0x3FCAC0 /end MEASUREMENT
/begin MEASUREMENT pksr_exd_t "Timer Prueflauf" UWORD FORMULA_0021 0 0.0 0.0 655.0 READ_WRITE ECU_ADDRESS 0x3FCAC4 /end MEASUREMENT
/begin MEASUREMENT pksr_exd_tv_oeffbeg_dr "TV bei 0 l/h Durchfluss durch Druckregler" SWORD FORMULA_0161 0 0.0 -100.0 100.0 READ_WRITE ECU_ADDRESS 0x3FCAB6 /end MEASUREMENT
/begin MEASUREMENT pksr_i_anteil "I-Anteil Kraftstoffdruckregler" SWORD FORMULA_0161 0 0.0 -100.0 100.0 READ_WRITE ECU_ADDRESS 0x3FCA8C /end MEASUREMENT
/begin MEASUREMENT pksr_p_anteil "P-Anteil Kraftstoffdruckregler" SWORD FORMULA_0161 0 0.0 -100.0 100.0 READ_WRITE ECU_ADDRESS 0x3FCA8A /end MEASUREMENT
/begin MEASUREMENT pksr_q_ekp "Volumenstrom EKP" SWORD FORMULA_0746 0 0.0 0.0 250.0 READ_WRITE ECU_ADDRESS 0x3FCA88 /end MEASUREMENT
/begin MEASUREMENT pksr_q_ssp "Volumenstrom Saugstrahlpumpen" SWORD FORMULA_0746 0 0.0 0.0 250.0 READ_WRITE ECU_ADDRESS 0x3FCA86 /end MEASUREMENT
/begin MEASUREMENT pksr_reg_time "Zeit im geregeltem Betrieb" UWORD FORMULA_0021 0 0.0 0.0 655.0 READ_WRITE ECU_ADDRESS 0x3FCACE /end MEASUREMENT
/begin MEASUREMENT pksr_s_anteil "Steuer-Anteil Kraftstoffdruckregler" SWORD FORMULA_0161 0 0.0 -100.0 100.0 READ_WRITE ECU_ADDRESS 0x3FCA94 /end MEASUREMENT
/begin MEASUREMENT pksr_status "Status Kraftstoffdruckregelung" UBYTE FORMULA_1034 0 0.0 0.0 255.0 READ_WRITE ECU_ADDRESS 0x3FCA96 /end MEASUREMENT
/begin MEASUREMENT pksr_t_abst "Abstelltimer" UWORD FORMULA_0021 0 0.0 0.0 655.0 READ_WRITE ECU_ADDRESS 0x3FCAA8 /end MEASUREMENT
/begin MEASUREMENT pksr_t_vorlauf "Vorlauftimer" UWORD FORMULA_0021 0 0.0 0.0 655.0 READ_WRITE ECU_ADDRESS 0x3FCAA6 /end MEASUREMENT
/begin MEASUREMENT pksr_tv "auszugebendes TV f. geregelte EKP" SWORD FORMULA_0161 0 0.0 -100.0 100.0 READ_WRITE ECU_ADDRESS 0x3FCA82 /end MEASUREMENT
/begin MEASUREMENT pksr_tv_diag "auszugebender Diagnosewert für Tastverhaeltnis" SWORD FORMULA_0161 0 0.0 -100.0 100.0 READ_WRITE ECU_ADDRESS 0x3FCA84 /end MEASUREMENT
/begin MEASUREMENT pksr_tv_regler "vom PI-Regler ermitteltes TV inkl. Spgs.-Korrektur" SWORD FORMULA_0161 0 0.0 -100.0 100.0 READ_WRITE ECU_ADDRESS 0x3FCA80 /end MEASUREMENT
/begin MEASUREMENT wf_mks_rel "relativer Eingriff WF-Modell" UWORD FORMULA_0073 0 0.0 0.0 4.0 READ_WRITE ARRAY_SIZE 10 ECU_ADDRESS 0x3FC3A8 MATRIX_DIM 10 1 1 /end MEASUREMENT
/begin COMPU_METHOD FORMULA_0001 "FORMULA_0001" RAT_FUNC "%6.1" "%" COEFFS 0 10.0 0.0 0 0.0 1.0 /end COMPU_METHOD
/begin COMPU_METHOD FORMULA_0003 "FORMULA_0003" RAT_FUNC "%3.0" "-" COEFFS 0 1 0 0 0 1 /end COMPU_METHOD
/begin COMPU_METHOD FORMULA_0006 "FORMULA_0006" RAT_FUNC "%5.0" "Upm" COEFFS 0 1 0 0 0 1 /end COMPU_METHOD
/begin COMPU_METHOD FORMULA_0007 "FORMULA_0007" RAT_FUNC "%8.3" "-" COEFFS 0 10000.0 0.0 0 0.0 1.0 /end COMPU_METHOD
/begin COMPU_METHOD FORMULA_0010 "FORMULA_0010" RAT_FUNC "%5.0" "-" COEFFS 0 1 0 0 0 1 /end COMPU_METHOD
/begin COMPU_METHOD FORMULA_0021 "FORMULA_0021" RAT_FUNC "%7.2" "s" COEFFS 0 100.0 0.0 0 0.0 1.0 /end COMPU_METHOD
/begin COMPU_METHOD FORMULA_0023 "FORMULA_0023" RAT_FUNC "%6.1" "°C" COEFFS 0 10.0 2732.0 0 0.0 1.0 /end COMPU_METHOD
/begin COMPU_METHOD FORMULA_0024 "FORMULA_0024" RAT_FUNC "%9.4" "-" COEFFS 0 32768.0 0.0 0 0.0 1.0 /end COMPU_METHOD
/begin COMPU_METHOD FORMULA_0025 "FORMULA_0025" RAT_FUNC "%8.3" "-" COEFFS 0 16384.0 0.0 0 0.0 1.0 /end COMPU_METHOD
/begin COMPU_METHOD FORMULA_0037 "FORMULA_0037" RAT_FUNC "%5.2" "-" COEFFS 0 1 0 0 0 1 /end COMPU_METHOD
/begin COMPU_METHOD FORMULA_0071 "FORMULA_0071" RAT_FUNC "%6.1" "s" COEFFS 0 10.0 0.0 0 0.0 1.0 /end COMPU_METHOD
/begin COMPU_METHOD FORMULA_0073 "FORMULA_0073" RAT_FUNC "%8.3" "-" COEFFS 0 1024.0 0.0 0 0.0 1.0 /end COMPU_METHOD
/begin COMPU_METHOD FORMULA_0074 "FORMULA_0074" RAT_FUNC "%6.1" "Kelvin" COEFFS 0 10.0 0.0 0 0.0 1.0 /end COMPU_METHOD
/begin COMPU_METHOD FORMULA_0075 "FORMULA_0075" RAT_FUNC "%6.1" "mbar" COEFFS 0 16.0 0.0 0 0.0 1.0 /end COMPU_METHOD
/begin COMPU_METHOD FORMULA_0076 "FORMULA_0076" RAT_FUNC "%6.1" "km/h" COEFFS 0 16.0 0.0 0 0.0 1.0 /end COMPU_METHOD
/begin COMPU_METHOD FORMULA_0080 "FORMULA_0080" RAT_FUNC "%7.2" "-" COEFFS 0 1 0 0 0 1 /end COMPU_METHOD
/begin COMPU_METHOD FORMULA_0090 "FORMULA_0090" RAT_FUNC "%7.2" "mg" COEFFS 0 10.0 0.0 0 0.0 1.0 /end COMPU_METHOD
/begin COMPU_METHOD FORMULA_0102 "FORMULA_0102" RAT_FUNC "%6.1" "°KW" COEFFS 0 10.0 0.0 0 0.0 1.0 /end COMPU_METHOD
/begin COMPU_METHOD FORMULA_0103 "FORMULA_0103" RAT_FUNC "%6.1" "kg/h" COEFFS 0 10.0 0.0 0 0.0 1.0 /end COMPU_METHOD
/begin COMPU_METHOD FORMULA_0109 "FORMULA_0109" RAT_FUNC "%7.2" "s" COEFFS 0 200.0 0.0 0 0.0 1.0 /end COMPU_METHOD
/begin COMPU_METHOD FORMULA_0110 "FORMULA_0110" RAT_FUNC "%8.3" "bar" COEFFS 0 1000.0 0.0 0 0.0 1.0 /end COMPU_METHOD
/begin COMPU_METHOD FORMULA_0111 "FORMULA_0111" RAT_FUNC "%7.2" "mg" COEFFS 0 64.0 0.0 0 0.0 1.0 /end COMPU_METHOD
/begin COMPU_METHOD FORMULA_0114 "FORMULA_0114" RAT_FUNC "%5.0" "digit" COEFFS 0 1 0 0 0 1 /end COMPU_METHOD
/begin COMPU_METHOD FORMULA_0123 "FORMULA_0123" RAT_FUNC "%7.2" "m/(s*s)" COEFFS 0 40.0 0.0 0 0.0 1.0 /end COMPU_METHOD
/begin COMPU_METHOD FORMULA_0147 "FORMULA_0147" RAT_FUNC "%9.2" "s" COEFFS 0 100.0 0.0 0 0.0 1.0 /end COMPU_METHOD
/begin COMPU_METHOD FORMULA_0159 "FORMULA_0159" TAB_VERB "%5.2" "-" COMPU_TAB_REF FORMULA_0159_VTAB /end COMPU_METHOD
/begin COMPU_METHOD FORMULA_0161 "FORMULA_0161" RAT_FUNC "%6.1" "%" COEFFS 0 10.24 0.0 0 0.0 1.0 /end COMPU_METHOD
/begin COMPU_METHOD FORMULA_0199 "FORMULA_0199" RAT_FUNC "%9.4" "-" COEFFS 0 16384.0 0.0 0 0.0 1.0 /end COMPU_METHOD
/begin COMPU_METHOD FORMULA_0351 "FORMULA_0351" TAB_VERB "%5.2" "-" COMPU_TAB_REF FORMULA_0351_VTAB /end COMPU_METHOD
/begin COMPU_METHOD FORMULA_0352 "FORMULA_0352" RAT_FUNC "%8.1" "ms" COEFFS 0 1000.0 0.0 0 0.0 1.0 /end COMPU_METHOD
/begin COMPU_METHOD FORMULA_0436 "FORMULA_0436" RAT_FUNC "%5.2" "mm" COEFFS 0 3.413333333333334 0.0 0 0.0 1.0 /end COMPU_METHOD
/begin COMPU_METHOD FORMULA_0461 "FORMULA_0461" RAT_FUNC "%4.1" "s" COEFFS 0 10.0 0.0 0 0.0 1.0 /end COMPU_METHOD
/begin COMPU_METHOD FORMULA_0535 "FORMULA_0535" RAT_FUNC "%8.3" "mg/ASP" COEFFS 0 64.0 0.0 0 0.0 1.0 /end COMPU_METHOD
/begin COMPU_METHOD FORMULA_0536 "FORMULA_0536" RAT_FUNC "%5.0" "mV" COEFFS 0 0.2048 0.0 0 0.0 1.0 /end COMPU_METHOD
/begin COMPU_METHOD FORMULA_0541 "FORMULA_0541" RAT_FUNC "%6.1" "Ohm" COEFFS 0 10.0 0.0 0 0.0 1.0 /end COMPU_METHOD
/begin COMPU_METHOD FORMULA_0557 "FORMULA_0557" RAT_FUNC "%8.3" "%" COEFFS 0 327.68 0.0 0 0.0 1.0 /end COMPU_METHOD
/begin COMPU_METHOD FORMULA_0558 "FORMULA_0558" RAT_FUNC "%9.4" "-" COEFFS 0 10000.0 0.0 0 0.0 1.0 /end COMPU_METHOD
/begin COMPU_METHOD FORMULA_0559 "FORMULA_0559" RAT_FUNC "%4.1" "l" COEFFS 0 2.0 0.0 0 0.0 1.0 /end COMPU_METHOD
/begin COMPU_METHOD FORMULA_0564 "FORMULA_0564" RAT_FUNC "%6.1" "kg*5ms/h" COEFFS 0 10.0 0.0 0 0.0 1.0 /end COMPU_METHOD
/begin COMPU_METHOD FORMULA_0591 "FORMULA_0591" RAT_FUNC "%5.0" "-" COEFFS 0 0.1 0.0 0 0.0 1.0 /end COMPU_METHOD
/begin COMPU_METHOD FORMULA_0593 "FORMULA_0593" RAT_FUNC "%5.0" "s" COEFFS 0 1 0 0 0 1 /end COMPU_METHOD
/begin COMPU_METHOD FORMULA_0597 "FORMULA_0597" RAT_FUNC "%7.2" "min" COEFFS 0 60.0 0.0 0 0.0 1.0 /end COMPU_METHOD
/begin COMPU_METHOD FORMULA_0603 "FORMULA_0603" RAT_FUNC "%7.2" "mm" COEFFS 0 3.37 0.0 0 0.0 1.0 /end COMPU_METHOD
/begin COMPU_METHOD FORMULA_0638 "FORMULA_0638" RAT_FUNC "%5.2" "" COEFFS 0 128.0 0.0 0 0.0 1.0 /end COMPU_METHOD
/begin COMPU_METHOD FORMULA_0645 "FORMULA_0645" RAT_FUNC "%6.3" "s" COEFFS 0 0 1.28 0 1 0 /end COMPU_METHOD
/begin COMPU_METHOD FORMULA_0658 "FORMULA_0658" RAT_FUNC "%5.2" "s" COEFFS 0 0 2.56 0 1 0 /end COMPU_METHOD
/begin COMPU_METHOD FORMULA_0679 "FORMULA_0679" RAT_FUNC "%5.2" "s" COEFFS 0 0 25.6 0 1 0 /end COMPU_METHOD
/begin COMPU_METHOD FORMULA_0715 "FORMULA_0715" RAT_FUNC "%5.2" "s" COEFFS 0 0 256 0 1 0 /end COMPU_METHOD
/begin COMPU_METHOD FORMULA_0726 "FORMULA_0726" TAB_VERB "%5.2" "-" COMPU_TAB_REF FORMULA_0726_VTAB /end COMPU_METHOD
/begin COMPU_METHOD FORMULA_0727 "FORMULA_0727" TAB_VERB "%5.2" "-" COMPU_TAB_REF FORMULA_0727_VTAB /end COMPU_METHOD
/begin COMPU_METHOD FORMULA_0728 "FORMULA_0728" RAT_FUNC "%8.3" "-/s" COEFFS 0 1638.4 0.0 0 0.0 1.0 /end COMPU_METHOD
/begin COMPU_METHOD FORMULA_0729 "FORMULA_0729" TAB_VERB "%3.0" "-" COMPU_TAB_REF FORMULA_0729_VTAB /end COMPU_METHOD
/begin COMPU_METHOD FORMULA_0730 "FORMULA_0730" TAB_VERB "%5.2" "-" COMPU_TAB_REF FORMULA_0730_VTAB /end COMPU_METHOD
/begin COMPU_METHOD FORMULA_0731 "FORMULA_0731" RAT_FUNC "%5.2" "mm" COEFFS 0 3.37 0.0 0 0.0 1.0 /end COMPU_METHOD
/begin COMPU_METHOD FORMULA_0746 "FORMULA_0746" RAT_FUNC "%6.1" "l/h" COEFFS 0 8.0 0.0 0 0.0 1.0 /end COMPU_METHOD
/begin COMPU_METHOD FORMULA_0748 "FORMULA_0748" TAB_VERB "%7.2" "-" COMPU_TAB_REF FORMULA_0748_VTAB /end COMPU_METHOD
/begin COMPU_METHOD FORMULA_0749 "FORMULA_0749" TAB_VERB "%7.2" "-" COMPU_TAB_REF FORMULA_0749_VTAB /end COMPU_METHOD
/begin COMPU_METHOD FORMULA_0750 "FORMULA_0750" RAT_FUNC "%9.4" "mA" COEFFS 0 3276.8 0.0 0 0.0 1.0 /end COMPU_METHOD
/begin COMPU_METHOD FORMULA_0751 "FORMULA_0751" RAT_FUNC "%9.4" "1/ms" COEFFS 0 16384000.0 0.0 0 0.0 1.0 /end COMPU_METHOD
/begin COMPU_METHOD FORMULA_0752 "FORMULA_0752" RAT_FUNC "%8.3" "s" COEFFS 0 1000.0 0.0 0 0.0 1.0 /end COMPU_METHOD
/begin COMPU_METHOD FORMULA_0753 "FORMULA_0753" RAT_FUNC "%7.2" "ms" COEFFS 0 31.25 0.0 0 0.0 1.0 /end COMPU_METHOD
/begin COMPU_METHOD FORMULA_0754 "FORMULA_0754" RAT_FUNC "%7.2" "-" COEFFS 0 256.0 0.0 0 0.0 1.0 /end COMPU_METHOD
/begin COMPU_METHOD FORMULA_0755 "FORMULA_0755" TAB_VERB "%7.2" "-" COMPU_TAB_REF FORMULA_0755_VTAB /end COMPU_METHOD
/begin COMPU_METHOD FORMULA_0756 "FORMULA_0756" TAB_VERB "%7.2" "-" COMPU_TAB_REF FORMULA_0756_VTAB /end COMPU_METHOD
/begin COMPU_METHOD FORMULA_0757 "FORMULA_0757" TAB_VERB "%7.2" "-" COMPU_TAB_REF FORMULA_0757_VTAB /end COMPU_METHOD
/begin COMPU_METHOD FORMULA_0758 "FORMULA_0758" TAB_VERB "%7.2" "-" COMPU_TAB_REF FORMULA_0758_VTAB /end COMPU_METHOD
/begin COMPU_METHOD FORMULA_0759 "FORMULA_0759" TAB_VERB "%7.2" "-" COMPU_TAB_REF FORMULA_0759_VTAB /end COMPU_METHOD
/begin COMPU_METHOD FORMULA_0760 "FORMULA_0760" TAB_VERB "%7.2" "-" COMPU_TAB_REF FORMULA_0760_VTAB /end COMPU_METHOD
/begin COMPU_METHOD FORMULA_0761 "FORMULA_0761" RAT_FUNC "%5.0" "ms" COEFFS 0 31.25 0.0 0 0.0 1.0 /end COMPU_METHOD
/begin COMPU_METHOD FORMULA_0762 "FORMULA_0762" RAT_FUNC "%8.3" "-" COEFFS 0 8192.0 0.0 0 0.0 1.0 /end COMPU_METHOD
/begin COMPU_METHOD FORMULA_0763 "FORMULA_0763" RAT_FUNC "%5.0" "ms" COEFFS 0 1 0 0 0 1 /end COMPU_METHOD
/begin COMPU_METHOD FORMULA_0764 "FORMULA_0764" RAT_FUNC "%8.3" "-" COEFFS 0 32768.0 0.0 0 0.0 1.0 /end COMPU_METHOD
/begin COMPU_METHOD FORMULA_0765 "FORMULA_0765" TAB_VERB "%7.2" "-" COMPU_TAB_REF FORMULA_0765_VTAB /end COMPU_METHOD
/begin COMPU_METHOD FORMULA_0766 "FORMULA_0766" TAB_VERB "%7.2" "-" COMPU_TAB_REF FORMULA_0766_VTAB /end COMPU_METHOD
/begin COMPU_METHOD FORMULA_0767 "FORMULA_0767" TAB_VERB "%7.2" "-" COMPU_TAB_REF FORMULA_0767_VTAB /end COMPU_METHOD
/begin COMPU_METHOD FORMULA_0768 "FORMULA_0768" TAB_VERB "%7.2" "-" COMPU_TAB_REF FORMULA_0768_VTAB /end COMPU_METHOD
/begin COMPU_METHOD FORMULA_0769 "FORMULA_0769" TAB_VERB "%7.2" "-" COMPU_TAB_REF FORMULA_0769_VTAB /end COMPU_METHOD
/begin COMPU_METHOD FORMULA_0770 "FORMULA_0770" TAB_VERB "%7.2" "-" COMPU_TAB_REF FORMULA_0770_VTAB /end COMPU_METHOD
/begin COMPU_METHOD FORMULA_0771 "FORMULA_0771" TAB_VERB "%7.2" "-" COMPU_TAB_REF FORMULA_0771_VTAB /end COMPU_METHOD
/begin COMPU_METHOD FORMULA_0772 "FORMULA_0772" TAB_VERB "%7.2" "-" COMPU_TAB_REF FORMULA_0772_VTAB /end COMPU_METHOD
/begin COMPU_METHOD FORMULA_0773 "FORMULA_0773" TAB_VERB "%7.2" "-" COMPU_TAB_REF FORMULA_0773_VTAB /end COMPU_METHOD
/begin COMPU_METHOD FORMULA_0774 "FORMULA_0774" TAB_VERB "%7.2" "-" COMPU_TAB_REF FORMULA_0774_VTAB /end COMPU_METHOD
/begin COMPU_METHOD FORMULA_0775 "FORMULA_0775" TAB_VERB "%7.2" "-" COMPU_TAB_REF FORMULA_0775_VTAB /end COMPU_METHOD
/begin COMPU_METHOD FORMULA_0776 "FORMULA_0776" TAB_VERB "%7.2" "-" COMPU_TAB_REF FORMULA_0776_VTAB /end COMPU_METHOD
/begin COMPU_METHOD FORMULA_0777 "FORMULA_0777" TAB_VERB "%7.2" "-" COMPU_TAB_REF FORMULA_0777_VTAB /end COMPU_METHOD
/begin COMPU_METHOD FORMULA_0778 "FORMULA_0778" TAB_VERB "%7.2" "-" COMPU_TAB_REF FORMULA_0778_VTAB /end COMPU_METHOD
/begin COMPU_METHOD FORMULA_0779 "FORMULA_0779" TAB_VERB "%7.2" "-" COMPU_TAB_REF FORMULA_0779_VTAB /end COMPU_METHOD
/begin COMPU_METHOD FORMULA_0780 "FORMULA_0780" TAB_VERB "%7.2" "-" COMPU_TAB_REF FORMULA_0780_VTAB /end COMPU_METHOD
/begin COMPU_METHOD FORMULA_0781 "FORMULA_0781" TAB_VERB "%7.2" "-" COMPU_TAB_REF FORMULA_0781_VTAB /end COMPU_METHOD
/begin COMPU_METHOD FORMULA_0782 "FORMULA_0782" TAB_VERB "%7.2" "-" COMPU_TAB_REF FORMULA_0782_VTAB /end COMPU_METHOD
/begin COMPU_METHOD FORMULA_0783 "FORMULA_0783" TAB_VERB "%7.2" "-" COMPU_TAB_REF FORMULA_0783_VTAB /end COMPU_METHOD
/begin COMPU_METHOD FORMULA_0784 "FORMULA_0784" TAB_VERB "%7.2" "-" COMPU_TAB_REF FORMULA_0784_VTAB /end COMPU_METHOD
/begin COMPU_METHOD FORMULA_0785 "FORMULA_0785" TAB_VERB "%7.2" "-" COMPU_TAB_REF FORMULA_0785_VTAB /end COMPU_METHOD
/begin COMPU_METHOD FORMULA_0786 "FORMULA_0786" RAT_FUNC "%7.2" "ms" COEFFS 0 1000.0 0.0 0 0.0 1.0 /end COMPU_METHOD
/begin COMPU_METHOD FORMULA_0787 "FORMULA_0787" TAB_VERB "%7.2" "-" COMPU_TAB_REF FORMULA_0787_VTAB /end COMPU_METHOD
/begin COMPU_METHOD FORMULA_0788 "FORMULA_0788" TAB_VERB "%7.2" "-" COMPU_TAB_REF FORMULA_0788_VTAB /end COMPU_METHOD
/begin COMPU_METHOD FORMULA_0789 "FORMULA_0789" TAB_VERB "%7.2" "-" COMPU_TAB_REF FORMULA_0789_VTAB /end COMPU_METHOD
/begin COMPU_METHOD FORMULA_0790 "FORMULA_0790" TAB_VERB "%7.2" "-" COMPU_TAB_REF FORMULA_0790_VTAB /end COMPU_METHOD
/begin COMPU_METHOD FORMULA_0791 "FORMULA_0791" RAT_FUNC "%5.0" "°C" COEFFS 0 1 0 0 0 1 /end COMPU_METHOD
/begin COMPU_METHOD FORMULA_0792 "FORMULA_0792" RAT_FUNC "%5.0" "mg" COEFFS 0 1 0 0 0 1 /end COMPU_METHOD
/begin COMPU_METHOD FORMULA_0793 "FORMULA_0793" RAT_FUNC "%6.1" "-" COEFFS 0 512.0 0.0 0 0.0 1.0 /end COMPU_METHOD
/begin COMPU_METHOD FORMULA_0794 "FORMULA_0794" TAB_VERB "%7.2" "-" COMPU_TAB_REF FORMULA_0794_VTAB /end COMPU_METHOD
/begin COMPU_METHOD FORMULA_0795 "FORMULA_0795" TAB_VERB "%7.2" "-" COMPU_TAB_REF FORMULA_0795_VTAB /end COMPU_METHOD
/begin COMPU_METHOD FORMULA_0796 "FORMULA_0796" RAT_FUNC "%8.3" "mg" COEFFS 0 40.0 0.0 0 0.0 1.0 /end COMPU_METHOD
/begin COMPU_METHOD FORMULA_0797 "FORMULA_0797" TAB_VERB "%5.2" "-" COMPU_TAB_REF FORMULA_0797_VTAB /end COMPU_METHOD
/begin COMPU_METHOD FORMULA_0798 "FORMULA_0798" TAB_VERB "%5.2" "-" COMPU_TAB_REF FORMULA_0798_VTAB /end COMPU_METHOD
/begin COMPU_METHOD FORMULA_0799 "FORMULA_0799" TAB_VERB "%7.2" "-" COMPU_TAB_REF FORMULA_0799_VTAB /end COMPU_METHOD
/begin COMPU_METHOD FORMULA_0800 "FORMULA_0800" RAT_FUNC "%5.0" "sec" COEFFS 0 1 0 0 0 1 /end COMPU_METHOD
/begin COMPU_METHOD FORMULA_0801 "FORMULA_0801" RAT_FUNC "%6.1" "°C" COEFFS 0 10.0 0.0 0 0.0 1.0 /end COMPU_METHOD
/begin COMPU_METHOD FORMULA_0802 "FORMULA_0802" RAT_FUNC "%8.3" "1/s" COEFFS 0 16384.0 0.0 0 0.0 1.0 /end COMPU_METHOD
/begin COMPU_METHOD FORMULA_0803 "FORMULA_0803" RAT_FUNC "%8.3" "-/s" COEFFS 0 16384.0 0.0 0 0.0 1.0 /end COMPU_METHOD
/begin COMPU_METHOD FORMULA_0804 "FORMULA_0804" RAT_FUNC "%6.1" "mg" COEFFS 0 10.0 0.0 0 0.0 1.0 /end COMPU_METHOD
/begin COMPU_METHOD FORMULA_0805 "FORMULA_0805" RAT_FUNC "%5.0" "sec" COEFFS 0 100.0 0.0 0 0.0 1.0 /end COMPU_METHOD
/begin COMPU_METHOD FORMULA_0806 "FORMULA_0806" RAT_FUNC "%7.2" "-" COEFFS 0 128.0 0.0 0 0.0 1.0 /end COMPU_METHOD
/begin COMPU_METHOD FORMULA_0807 "FORMULA_0807" RAT_FUNC "%8.3" "1/°KW" COEFFS 0 1024.0 0.0 0 0.0 1.0 /end COMPU_METHOD
/begin COMPU_METHOD FORMULA_0808 "FORMULA_0808" TAB_VERB "%7.2" "-" COMPU_TAB_REF FORMULA_0808_VTAB /end COMPU_METHOD
/begin COMPU_METHOD FORMULA_0809 "FORMULA_0809" TAB_VERB "%5.2" "-" COMPU_TAB_REF FORMULA_0809_VTAB /end COMPU_METHOD
/begin COMPU_METHOD FORMULA_0843 "FORMULA_0843" TAB_VERB "%7.2" "-" COMPU_TAB_REF FORMULA_0843_VTAB /end COMPU_METHOD
/begin COMPU_METHOD FORMULA_0864 "FORMULA_0864" TAB_VERB "%3.0" "-" COMPU_TAB_REF FORMULA_0864_VTAB /end COMPU_METHOD
/begin COMPU_METHOD FORMULA_0865 "FORMULA_0865" TAB_VERB "%5.2" "-" COMPU_TAB_REF FORMULA_0865_VTAB /end COMPU_METHOD
/begin COMPU_METHOD FORMULA_0866 "FORMULA_0866" TAB_VERB "%5.2" "-" COMPU_TAB_REF FORMULA_0866_VTAB /end COMPU_METHOD
/begin COMPU_METHOD FORMULA_0867 "FORMULA_0867" TAB_VERB "%5.2" "-" COMPU_TAB_REF FORMULA_0867_VTAB /end COMPU_METHOD
/begin COMPU_METHOD FORMULA_0868 "FORMULA_0868" TAB_VERB "%5.2" "-" COMPU_TAB_REF FORMULA_0868_VTAB /end COMPU_METHOD
/begin COMPU_METHOD FORMULA_0869 "FORMULA_0869" TAB_VERB "%5.2" "-" COMPU_TAB_REF FORMULA_0869_VTAB /end COMPU_METHOD
/begin COMPU_METHOD FORMULA_0870 "FORMULA_0870" TAB_VERB "%5.2" "-" COMPU_TAB_REF FORMULA_0870_VTAB /end COMPU_METHOD
/begin COMPU_METHOD FORMULA_0871 "FORMULA_0871" TAB_VERB "%5.2" "-" COMPU_TAB_REF FORMULA_0871_VTAB /end COMPU_METHOD
/begin COMPU_METHOD FORMULA_0872 "FORMULA_0872" TAB_VERB "%3.0" "-" COMPU_TAB_REF FORMULA_0872_VTAB /end COMPU_METHOD
/begin COMPU_METHOD FORMULA_0873 "FORMULA_0873" TAB_VERB "%3.0" "-" COMPU_TAB_REF FORMULA_0873_VTAB /end COMPU_METHOD
/begin COMPU_METHOD FORMULA_0874 "FORMULA_0874" TAB_VERB "%3.0" "-" COMPU_TAB_REF FORMULA_0874_VTAB /end COMPU_METHOD
/begin COMPU_METHOD FORMULA_0875 "FORMULA_0875" RAT_FUNC "%5.0" "uA" COEFFS 0 0.1941747572815534 -1.0 0 0.0 1.0 /end COMPU_METHOD
/begin COMPU_METHOD FORMULA_0876 "FORMULA_0876" RAT_FUNC "%6.1" "ms" COEFFS 0 10.0 -8.0 0 0.0 1.0 /end COMPU_METHOD
/begin COMPU_METHOD FORMULA_0877 "FORMULA_0877" RAT_FUNC "%8.3" "kHz" COEFFS 0 8.196721311475409 -16.00901639344263 0 0.0 1.0 /end COMPU_METHOD
/begin COMPU_METHOD FORMULA_0878 "FORMULA_0878" TAB_VERB "%3.0" "-" COMPU_TAB_REF FORMULA_0878_VTAB /end COMPU_METHOD
/begin COMPU_METHOD FORMULA_0879 "FORMULA_0879" TAB_VERB "%3.0" "-" COMPU_TAB_REF FORMULA_0879_VTAB /end COMPU_METHOD
/begin COMPU_METHOD FORMULA_0880 "FORMULA_0880" TAB_VERB "%3.0" "-" COMPU_TAB_REF FORMULA_0880_VTAB /end COMPU_METHOD
/begin COMPU_METHOD FORMULA_0881 "FORMULA_0881" RAT_FUNC "%3.0" "uA" COEFFS 0 0.1941747572815534 -1.0 0 0.0 1.0 /end COMPU_METHOD
/begin COMPU_METHOD FORMULA_0882 "FORMULA_0882" RAT_FUNC "%4.1" "ms" COEFFS 0 10.0 -8.0 0 0.0 1.0 /end COMPU_METHOD
/begin COMPU_METHOD FORMULA_0883 "FORMULA_0883" RAT_FUNC "%6.3" "kHz" COEFFS 0 8.196721311475409 -16.00901639344263 0 0.0 1.0 /end COMPU_METHOD
/begin COMPU_METHOD FORMULA_0884 "FORMULA_0884" TAB_VERB "%3.0" "-" COMPU_TAB_REF FORMULA_0884_VTAB /end COMPU_METHOD
/begin COMPU_METHOD FORMULA_0885 "FORMULA_0885" TAB_VERB "%7.2" "-" COMPU_TAB_REF FORMULA_0885_VTAB /end COMPU_METHOD
/begin COMPU_METHOD FORMULA_0886 "FORMULA_0886" TAB_VERB "%7.2" "-" COMPU_TAB_REF FORMULA_0886_VTAB /end COMPU_METHOD
/begin COMPU_METHOD FORMULA_0887 "FORMULA_0887" TAB_VERB "%7.2" "-" COMPU_TAB_REF FORMULA_0887_VTAB /end COMPU_METHOD
/begin COMPU_METHOD FORMULA_0888 "FORMULA_0888" TAB_VERB "%7.2" "-" COMPU_TAB_REF FORMULA_0888_VTAB /end COMPU_METHOD
/begin COMPU_METHOD FORMULA_0889 "FORMULA_0889" TAB_VERB "%7.2" "-" COMPU_TAB_REF FORMULA_0889_VTAB /end COMPU_METHOD
/begin COMPU_METHOD FORMULA_0890 "FORMULA_0890" TAB_VERB "%7.2" "-" COMPU_TAB_REF FORMULA_0890_VTAB /end COMPU_METHOD
/begin COMPU_METHOD FORMULA_0891 "FORMULA_0891" TAB_VERB "%7.2" "-" COMPU_TAB_REF FORMULA_0891_VTAB /end COMPU_METHOD
/begin COMPU_METHOD FORMULA_0892 "FORMULA_0892" TAB_VERB "%7.2" "-" COMPU_TAB_REF FORMULA_0892_VTAB /end COMPU_METHOD
/begin COMPU_METHOD FORMULA_0893 "FORMULA_0893" TAB_VERB "%7.2" "-" COMPU_TAB_REF FORMULA_0893_VTAB /end COMPU_METHOD
/begin COMPU_METHOD FORMULA_0894 "FORMULA_0894" TAB_VERB "%7.2" "-" COMPU_TAB_REF FORMULA_0894_VTAB /end COMPU_METHOD
/begin COMPU_METHOD FORMULA_0895 "FORMULA_0895" TAB_VERB "%7.2" "-" COMPU_TAB_REF FORMULA_0895_VTAB /end COMPU_METHOD
/begin COMPU_METHOD FORMULA_0896 "FORMULA_0896" TAB_VERB "%7.2" "-" COMPU_TAB_REF FORMULA_0896_VTAB /end COMPU_METHOD
/begin COMPU_METHOD FORMULA_0897 "FORMULA_0897" TAB_VERB "%7.2" "-" COMPU_TAB_REF FORMULA_0897_VTAB /end COMPU_METHOD
/begin COMPU_METHOD FORMULA_0898 "FORMULA_0898" TAB_VERB "%7.2" "-" COMPU_TAB_REF FORMULA_0898_VTAB /end COMPU_METHOD
/begin COMPU_METHOD FORMULA_0899 "FORMULA_0899" TAB_VERB "%7.2" "-" COMPU_TAB_REF FORMULA_0899_VTAB /end COMPU_METHOD
/begin COMPU_METHOD FORMULA_0900 "FORMULA_0900" TAB_VERB "%7.2" "-" COMPU_TAB_REF FORMULA_0900_VTAB /end COMPU_METHOD
/begin COMPU_METHOD FORMULA_0901 "FORMULA_0901" TAB_VERB "%7.2" "-" COMPU_TAB_REF FORMULA_0901_VTAB /end COMPU_METHOD
/begin COMPU_METHOD FORMULA_0902 "FORMULA_0902" TAB_VERB "%7.2" "-" COMPU_TAB_REF FORMULA_0902_VTAB /end COMPU_METHOD
/begin COMPU_METHOD FORMULA_0903 "FORMULA_0903" TAB_VERB "%7.2" "-" COMPU_TAB_REF FORMULA_0903_VTAB /end COMPU_METHOD
/begin COMPU_METHOD FORMULA_0904 "FORMULA_0904" TAB_VERB "%7.2" "-" COMPU_TAB_REF FORMULA_0904_VTAB /end COMPU_METHOD
/begin COMPU_METHOD FORMULA_0905 "FORMULA_0905" TAB_VERB "%7.2" "-" COMPU_TAB_REF FORMULA_0905_VTAB /end COMPU_METHOD
/begin COMPU_METHOD FORMULA_0906 "FORMULA_0906" TAB_VERB "%7.2" "-" COMPU_TAB_REF FORMULA_0906_VTAB /end COMPU_METHOD
/begin COMPU_METHOD FORMULA_0907 "FORMULA_0907" TAB_VERB "%7.2" "-" COMPU_TAB_REF FORMULA_0907_VTAB /end COMPU_METHOD
/begin COMPU_METHOD FORMULA_0908 "FORMULA_0908" RAT_FUNC "%7.2" "10exp-3 -/mV" COEFFS 0 80.0 0.0 0 0.0 1.0 /end COMPU_METHOD
/begin COMPU_METHOD FORMULA_0909 "FORMULA_0909" RAT_FUNC "%10.3" "-/s" COEFFS 0 16384.0 0.0 0 0.0 1.0 /end COMPU_METHOD
/begin COMPU_METHOD FORMULA_0910 "FORMULA_0910" TAB_VERB "%7.2" "-" COMPU_TAB_REF FORMULA_0910_VTAB /end COMPU_METHOD
/begin COMPU_METHOD FORMULA_0911 "FORMULA_0911" TAB_VERB "%7.2" "-" COMPU_TAB_REF FORMULA_0911_VTAB /end COMPU_METHOD
/begin COMPU_METHOD FORMULA_0912 "FORMULA_0912" TAB_VERB "%7.2" "-" COMPU_TAB_REF FORMULA_0912_VTAB /end COMPU_METHOD
/begin COMPU_METHOD FORMULA_0913 "FORMULA_0913" TAB_VERB "%7.2" "-" COMPU_TAB_REF FORMULA_0913_VTAB /end COMPU_METHOD
/begin COMPU_METHOD FORMULA_0914 "FORMULA_0914" RAT_FUNC "%7.2" "s" COEFFS 0 1 0 0 0 1 /end COMPU_METHOD
/begin COMPU_METHOD FORMULA_0915 "FORMULA_0915" RAT_FUNC "%5.0" "mV/10msec" COEFFS 0 0.2048 0.0 0 0.0 1.0 /end COMPU_METHOD
/begin COMPU_METHOD FORMULA_0916 "FORMULA_0916" RAT_FUNC "%7.2" "-" COEFFS 0 1024.0 0.0 0 0.0 1.0 /end COMPU_METHOD
/begin COMPU_METHOD FORMULA_1033 "FORMULA_1033" RAT_FUNC "%4.1" "bar/s" COEFFS 0 10.0 0.0 0 0.0 1.0 /end COMPU_METHOD
/begin COMPU_METHOD FORMULA_1034 "FORMULA_1034" TAB_VERB "%5.2" "-" COMPU_TAB_REF FORMULA_1034_VTAB /end COMPU_METHOD
/begin COMPU_METHOD FORMULA_1035 "FORMULA_1035" TAB_VERB "%7.2" "-" COMPU_TAB_REF FORMULA_1035_VTAB /end COMPU_METHOD
/begin COMPU_METHOD FORMULA_1036 "FORMULA_1036" TAB_VERB "%7.2" "-" COMPU_TAB_REF FORMULA_1036_VTAB /end COMPU_METHOD
/begin COMPU_METHOD FORMULA_1037 "FORMULA_1037" RAT_FUNC "%8.3" "bar/100ms" COEFFS 0 1000.0 0.0 0 0.0 1.0 /end COMPU_METHOD
/begin COMPU_METHOD FORMULA_1038 "FORMULA_1038" TAB_VERB "%5.2" "-" COMPU_TAB_REF FORMULA_1038_VTAB /end COMPU_METHOD
/begin COMPU_METHOD FORMULA_1039 "FORMULA_1039" TAB_VERB "%5.2" "-" COMPU_TAB_REF FORMULA_1039_VTAB /end COMPU_METHOD
/begin COMPU_METHOD FORMULA_1040 "FORMULA_1040" RAT_FUNC "%6.1" "ms" COEFFS 0 1000.0 0.0 0 0.0 1.0 /end COMPU_METHOD
/begin COMPU_METHOD FORMULA_1041 "FORMULA_1041" RAT_FUNC "%9.4" "-/5ms" COEFFS 0 10000.0 0.0 0 0.0 1.0 /end COMPU_METHOD
/begin COMPU_METHOD FORMULA_1042 "FORMULA_1042" TAB_VERB "%5.2" "-" COMPU_TAB_REF FORMULA_1042_VTAB /end COMPU_METHOD
/begin COMPU_METHOD FORMULA_1043 "FORMULA_1043" RAT_FUNC "%4.1" "%" COEFFS 0 2.55 0.0 0 0.0 1.0 /end COMPU_METHOD
/begin COMPU_METHOD FORMULA_1044 "FORMULA_1044" RAT_FUNC "%6.1" "%/bar" COEFFS 0 20.97152 0.0 0 0.0 1.0 /end COMPU_METHOD
/begin COMPU_METHOD FORMULA_1045 "FORMULA_1045" RAT_FUNC "%6.1" "%/(bar*s)" COEFFS 0 6.7109 0.0 0 0.0 1.0 /end COMPU_METHOD
/begin COMPU_METHOD FORMULA_1245 "FORMULA_1245" TAB_VERB "%3.0" "-" COMPU_TAB_REF FORMULA_1245_VTAB /end COMPU_METHOD
/begin COMPU_VTAB FORMULA_0159_VTAB "FORMULA_0159_VTAB" TAB_VERB 2 0 "AUS" 1 "EIN" DEFAULT_VALUE "ungueltig" /end COMPU_VTAB
/begin COMPU_VTAB FORMULA_0351_VTAB "FORMULA_0351_VTAB" TAB_VERB 4 0 "ok" 1 "no send/busy" 2 "csum nok" 4 "Stackbereich" DEFAULT_VALUE "ungueltig" /end COMPU_VTAB
/begin COMPU_VTAB FORMULA_0726_VTAB "FORMULA_0726_VTAB" TAB_VERB 3 0 "inaktive" 1 "einfangen" 2 "eingeregelt" DEFAULT_VALUE "ungueltig" /end COMPU_VTAB
/begin COMPU_VTAB FORMULA_0727_VTAB "FORMULA_0727_VTAB" TAB_VERB 4 0 "keiner" 1 "nkat" 2 "mdl" 4 "vkat" DEFAULT_VALUE "ungueltig" /end COMPU_VTAB
/begin COMPU_VTAB FORMULA_0729_VTAB "FORMULA_0729_VTAB" TAB_VERB 2 0 "TNKAT aus MDL" 1 "TNKAT aus tabg_kat" DEFAULT_VALUE "undef" /end COMPU_VTAB
/begin COMPU_VTAB FORMULA_0730_VTAB "FORMULA_0730_VTAB" TAB_VERB 4 0 "inaktiv" 1 "aktive" 64 "NIO" 128 "IO" /end COMPU_VTAB
/begin COMPU_VTAB FORMULA_0748_VTAB "FORMULA_0748_VTAB" TAB_VERB 3 1 "Sonde verf" 3 "Sonde FETT" 5 "Sonde MAGER" DEFAULT_VALUE "undefiniert" /end COMPU_VTAB
/begin COMPU_VTAB FORMULA_0749_VTAB "FORMULA_0749_VTAB" TAB_VERB 1 0 "GAIN8" DEFAULT_VALUE "GAIN16" /end COMPU_VTAB
/begin COMPU_VTAB FORMULA_0755_VTAB "FORMULA_0755_VTAB" TAB_VERB 5 1 "LAA-RESET" 2 "LAA-AUS" 4 "LAA-F" 8 "LAA-TE-F" 16 "LAA-OFFS" /end COMPU_VTAB
/begin COMPU_VTAB FORMULA_0756_VTAB "FORMULA_0756_VTAB" TAB_VERB 3 0 "-" 1 "F_MIN" 2 "F_MAX" /end COMPU_VTAB
/begin COMPU_VTAB FORMULA_0757_VTAB "FORMULA_0757_VTAB" TAB_VERB 3 0 "-" 1 "F_TE_MIN" 2 "F_TE_MAX" /end COMPU_VTAB
/begin COMPU_VTAB FORMULA_0758_VTAB "FORMULA_0758_VTAB" TAB_VERB 3 0 "-" 1 "OFFS_MIN" 2 "OFFS_MAX" /end COMPU_VTAB
/begin COMPU_VTAB FORMULA_0759_VTAB "FORMULA_0759_VTAB" TAB_VERB 1 0 "-" DEFAULT_VALUE "TI_IST" /end COMPU_VTAB
/begin COMPU_VTAB FORMULA_0760_VTAB "FORMULA_0760_VTAB" TAB_VERB 1 0 "no" DEFAULT_VALUE "yes" /end COMPU_VTAB
/begin COMPU_VTAB FORMULA_0765_VTAB "FORMULA_0765_VTAB" TAB_VERB 1 0 "inaktiv" DEFAULT_VALUE "MS" /end COMPU_VTAB
/begin COMPU_VTAB FORMULA_0766_VTAB "FORMULA_0766_VTAB" TAB_VERB 1 0 "inaktiv" DEFAULT_VALUE "ML" /end COMPU_VTAB
/begin COMPU_VTAB FORMULA_0767_VTAB "FORMULA_0767_VTAB" TAB_VERB 1 0 "inaktiv" DEFAULT_VALUE "aktiv" /end COMPU_VTAB
/begin COMPU_VTAB FORMULA_0768_VTAB "FORMULA_0768_VTAB" TAB_VERB 1 0 "laeuft" DEFAULT_VALUE "fertig" /end COMPU_VTAB
/begin COMPU_VTAB FORMULA_0769_VTAB "FORMULA_0769_VTAB" TAB_VERB 1 0 "inaktiv" DEFAULT_VALUE "aktiv" /end COMPU_VTAB
/begin COMPU_VTAB FORMULA_0770_VTAB "FORMULA_0770_VTAB" TAB_VERB 1 0 "inaktiv" DEFAULT_VALUE "aktiv" /end COMPU_VTAB
/begin COMPU_VTAB FORMULA_0771_VTAB "FORMULA_0771_VTAB" TAB_VERB 1 0 "inaktiv" DEFAULT_VALUE "aktiv" /end COMPU_VTAB
/begin COMPU_VTAB FORMULA_0772_VTAB "FORMULA_0772_VTAB" TAB_VERB 1 0 "laeuft" DEFAULT_VALUE "fertig" /end COMPU_VTAB
/begin COMPU_VTAB FORMULA_0773_VTAB "FORMULA_0773_VTAB" TAB_VERB 1 0 "inaktiv" DEFAULT_VALUE "aktiv" /end COMPU_VTAB
/begin COMPU_VTAB FORMULA_0774_VTAB "FORMULA_0774_VTAB" TAB_VERB 1 0 "inaktiv" DEFAULT_VALUE "Zeit laeuft" /end COMPU_VTAB
/begin COMPU_VTAB FORMULA_0775_VTAB "FORMULA_0775_VTAB" TAB_VERB 1 0 "inaktiv" DEFAULT_VALUE "Zeit laeuft" /end COMPU_VTAB
/begin COMPU_VTAB FORMULA_0776_VTAB "FORMULA_0776_VTAB" TAB_VERB 1 0 "inaktiv" DEFAULT_VALUE "Zeit laeuft" /end COMPU_VTAB
/begin COMPU_VTAB FORMULA_0777_VTAB "FORMULA_0777_VTAB" TAB_VERB 1 0 "inaktiv" DEFAULT_VALUE "Zeit laeuft" /end COMPU_VTAB
/begin COMPU_VTAB FORMULA_0778_VTAB "FORMULA_0778_VTAB" TAB_VERB 1 0 "inaktiv" DEFAULT_VALUE "Zeit laeuft" /end COMPU_VTAB
/begin COMPU_VTAB FORMULA_0779_VTAB "FORMULA_0779_VTAB" TAB_VERB 1 0 "inaktiv" DEFAULT_VALUE "Zeit laeuft" /end COMPU_VTAB
/begin COMPU_VTAB FORMULA_0780_VTAB "FORMULA_0780_VTAB" TAB_VERB 1 0 "-" DEFAULT_VALUE "SCDN" /end COMPU_VTAB
/begin COMPU_VTAB FORMULA_0781_VTAB "FORMULA_0781_VTAB" TAB_VERB 1 0 "-" DEFAULT_VALUE "SCDN" /end COMPU_VTAB
/begin COMPU_VTAB FORMULA_0782_VTAB "FORMULA_0782_VTAB" TAB_VERB 2 0 "automatisch" 1 "manuell" /end COMPU_VTAB
/begin COMPU_VTAB FORMULA_0783_VTAB "FORMULA_0783_VTAB" TAB_VERB 2 0 "Regler inaktiv" 1 "Regler aktiv" /end COMPU_VTAB
/begin COMPU_VTAB FORMULA_0784_VTAB "FORMULA_0784_VTAB" TAB_VERB 2 0 "ADAPTION" 1 "RESET" /end COMPU_VTAB
/begin COMPU_VTAB FORMULA_0785_VTAB "FORMULA_0785_VTAB" TAB_VERB 2 0 "keine RESET-Anforderung" 1 "LA-RESET-Anforderung" /end COMPU_VTAB
/begin COMPU_VTAB FORMULA_0787_VTAB "FORMULA_0787_VTAB" TAB_VERB 2 0 "Adaption inaktiv" 1 "Adaption aktiv" /end COMPU_VTAB
/begin COMPU_VTAB FORMULA_0788_VTAB "FORMULA_0788_VTAB" TAB_VERB 2 0 "RESET inaktiv" 1 "RESET aktiv" /end COMPU_VTAB
/begin COMPU_VTAB FORMULA_0789_VTAB "FORMULA_0789_VTAB" TAB_VERB 2 0 "keine Filterung" 1 "Filterung" /end COMPU_VTAB
/begin COMPU_VTAB FORMULA_0790_VTAB "FORMULA_0790_VTAB" TAB_VERB 2 0 "inaktiv" 1 "aktiv" /end COMPU_VTAB
/begin COMPU_VTAB FORMULA_0794_VTAB "FORMULA_0794_VTAB" TAB_VERB 21 1 "START" 2 "Normalbetrieb" 4 "SL-Betrieb" 8 "Klopfschutz" 16 "Warmlauf" 32 "Vollast" 64 "SK-Manager" 512 "BEGR-AKTIV" 513 "START/BEGR" 514 "NORMAL/BEGR" 516 "SL/BEGR" 520 "KR-Schutz/BEGR" 528 "WL/BEGR" 544 "VL/BEGR" 576 "SK/BEGR" 1024 "SL-BEGR" 2048 "WL-BEGR" 1536 "SL-BEGR/BEGR" 1540 "SL/BEGR" 2560 "WL-BEGR/BEGR" 2576 "WL/BEGR" DEFAULT_VALUE "undefiniert" /end COMPU_VTAB
/begin COMPU_VTAB FORMULA_0795_VTAB "FORMULA_0795_VTAB" TAB_VERB 19 1 "START" 2 "Normalbetrieb" 4 "SL-Betrieb" 8 "Klopfschutz" 16 "Warmlauf" 32 "Vollast" 64 "SK-Manager" 128 "KATS-AKTIV" 129 "KATS-AKTIV" 132 "KATS-AKTIV" 136 "KATS-AKTIV" 144 "KATS-AKTIV" 160 "KATS-AKTIV" 256 "PST-AKTIV" 257 "PST-AKTIV" 260 "PST-AKTIV" 264 "PST-AKTIV" 272 "PST-AKTIV" 288 "PST-AKTIV" DEFAULT_VALUE "undefiniert" /end COMPU_VTAB
/begin COMPU_VTAB FORMULA_0797_VTAB "FORMULA_0797_VTAB" TAB_VERB 2 1 "aus NORMAL-Zustand" 255 "aus WL-Zustand" DEFAULT_VALUE "keine VL" /end COMPU_VTAB
/begin COMPU_VTAB FORMULA_0798_VTAB "FORMULA_0798_VTAB" TAB_VERB 1 1 "Triggerung ueber SA" DEFAULT_VALUE "keine Triggerung" /end COMPU_VTAB
/begin COMPU_VTAB FORMULA_0799_VTAB "FORMULA_0799_VTAB" TAB_VERB 2 0 "inaktiv" 1 "aktiv" /end COMPU_VTAB
/begin COMPU_VTAB FORMULA_0808_VTAB "FORMULA_0808_VTAB" TAB_VERB 2 0 "no" 1 "yes" /end COMPU_VTAB
/begin COMPU_VTAB FORMULA_0809_VTAB "FORMULA_0809_VTAB" TAB_VERB 2 0 "LAM_IST_MW" 1 "LAM_SOLL" /end COMPU_VTAB
/begin COMPU_VTAB FORMULA_0843_VTAB "FORMULA_0843_VTAB" TAB_VERB 1 0 "inaktiv" DEFAULT_VALUE "aktiv" /end COMPU_VTAB
/begin COMPU_VTAB FORMULA_0864_VTAB "FORMULA_0864_VTAB" TAB_VERB 5 0 "IDLE" 1 "Init Sonde" 2 "RESET Sensor" 3 "Diagnose Sensor" 4 "Chip Code" /end COMPU_VTAB
/begin COMPU_VTAB FORMULA_0865_VTAB "FORMULA_0865_VTAB" TAB_VERB 1 0 "Gain 8" DEFAULT_VALUE "Gain 16" /end COMPU_VTAB
/begin COMPU_VTAB FORMULA_0866_VTAB "FORMULA_0866_VTAB" TAB_VERB 1 0 "Off" DEFAULT_VALUE "On" /end COMPU_VTAB
/begin COMPU_VTAB FORMULA_0867_VTAB "FORMULA_0867_VTAB" TAB_VERB 1 0 "Off" DEFAULT_VALUE "On" /end COMPU_VTAB
/begin COMPU_VTAB FORMULA_0868_VTAB "FORMULA_0868_VTAB" TAB_VERB 1 0 "Disable" DEFAULT_VALUE "Enable" /end COMPU_VTAB
/begin COMPU_VTAB FORMULA_0869_VTAB "FORMULA_0869_VTAB" TAB_VERB 1 0 "Off" DEFAULT_VALUE "On" /end COMPU_VTAB
/begin COMPU_VTAB FORMULA_0870_VTAB "FORMULA_0870_VTAB" TAB_VERB 1 0 "Disable" DEFAULT_VALUE "Enable" /end COMPU_VTAB
/begin COMPU_VTAB FORMULA_0871_VTAB "FORMULA_0871_VTAB" TAB_VERB 1 0 "Range 1" DEFAULT_VALUE "Range 2" /end COMPU_VTAB
/begin COMPU_VTAB FORMULA_0872_VTAB "FORMULA_0872_VTAB" TAB_VERB 2 0 "Range 1" 1 "Range 2" /end COMPU_VTAB
/begin COMPU_VTAB FORMULA_0873_VTAB "FORMULA_0873_VTAB" TAB_VERB 2 0 "Disable" 1 "Enable" /end COMPU_VTAB
/begin COMPU_VTAB FORMULA_0874_VTAB "FORMULA_0874_VTAB" TAB_VERB 2 0 "inaktiv" 1 "aktiv" /end COMPU_VTAB
/begin COMPU_VTAB FORMULA_0878_VTAB "FORMULA_0878_VTAB" TAB_VERB 2 0 "keine DIAG-Info" 1 "DIAG-Info" /end COMPU_VTAB
/begin COMPU_VTAB FORMULA_0879_VTAB "FORMULA_0879_VTAB" TAB_VERB 2 0 "Off" 1 "On" DEFAULT_VALUE "nicht definiert" /end COMPU_VTAB
/begin COMPU_VTAB FORMULA_0880_VTAB "FORMULA_0880_VTAB" TAB_VERB 2 0 "Disable" 1 "Enable" DEFAULT_VALUE "nicht definiert" /end COMPU_VTAB
/begin COMPU_VTAB FORMULA_0884_VTAB "FORMULA_0884_VTAB" TAB_VERB 2 0 "inaktiv" 1 "aktiv" DEFAULT_VALUE "nicht definiert" /end COMPU_VTAB
/begin COMPU_VTAB FORMULA_0885_VTAB "FORMULA_0885_VTAB" TAB_VERB 1 0 "inaktiv" DEFAULT_VALUE "aktiv" /end COMPU_VTAB
/begin COMPU_VTAB FORMULA_0886_VTAB "FORMULA_0886_VTAB" TAB_VERB 1 0 "verletzt" DEFAULT_VALUE "i.O." /end COMPU_VTAB
/begin COMPU_VTAB FORMULA_0887_VTAB "FORMULA_0887_VTAB" TAB_VERB 1 0 "nein" DEFAULT_VALUE "ja" /end COMPU_VTAB
/begin COMPU_VTAB FORMULA_0888_VTAB "FORMULA_0888_VTAB" TAB_VERB 1 0 "nein" DEFAULT_VALUE "ja" /end COMPU_VTAB
/begin COMPU_VTAB FORMULA_0889_VTAB "FORMULA_0889_VTAB" TAB_VERB 1 0 "n.i.O." DEFAULT_VALUE "i.O." /end COMPU_VTAB
/begin COMPU_VTAB FORMULA_0890_VTAB "FORMULA_0890_VTAB" TAB_VERB 1 0 "n.i.O." DEFAULT_VALUE "i.O." /end COMPU_VTAB
/begin COMPU_VTAB FORMULA_0891_VTAB "FORMULA_0891_VTAB" TAB_VERB 1 0 "aktiv" DEFAULT_VALUE "inaktiv" /end COMPU_VTAB
/begin COMPU_VTAB FORMULA_0892_VTAB "FORMULA_0892_VTAB" TAB_VERB 1 0 "aktiv" DEFAULT_VALUE "inaktiv" /end COMPU_VTAB
/begin COMPU_VTAB FORMULA_0893_VTAB "FORMULA_0893_VTAB" TAB_VERB 1 0 "aktiv" DEFAULT_VALUE "inaktiv" /end COMPU_VTAB
/begin COMPU_VTAB FORMULA_0894_VTAB "FORMULA_0894_VTAB" TAB_VERB 1 0 "aktiv" DEFAULT_VALUE "inaktiv" /end COMPU_VTAB
/begin COMPU_VTAB FORMULA_0895_VTAB "FORMULA_0895_VTAB" TAB_VERB 1 0 "n.i.O." DEFAULT_VALUE "i.O." /end COMPU_VTAB
/begin COMPU_VTAB FORMULA_0896_VTAB "FORMULA_0896_VTAB" TAB_VERB 1 0 "vorhanden" DEFAULT_VALUE "nicht vorhanden" /end COMPU_VTAB
/begin COMPU_VTAB FORMULA_0897_VTAB "FORMULA_0897_VTAB" TAB_VERB 1 0 "aktiv" DEFAULT_VALUE "inaktiv" /end COMPU_VTAB
/begin COMPU_VTAB FORMULA_0898_VTAB "FORMULA_0898_VTAB" TAB_VERB 1 0 "Verletzung" DEFAULT_VALUE "i.O." /end COMPU_VTAB
/begin COMPU_VTAB FORMULA_0899_VTAB "FORMULA_0899_VTAB" TAB_VERB 1 0 "-" DEFAULT_VALUE "P-Anteil" /end COMPU_VTAB
/begin COMPU_VTAB FORMULA_0900_VTAB "FORMULA_0900_VTAB" TAB_VERB 1 0 "-" DEFAULT_VALUE "abgeregelt" /end COMPU_VTAB
/begin COMPU_VTAB FORMULA_0901_VTAB "FORMULA_0901_VTAB" TAB_VERB 1 0 "-" DEFAULT_VALUE "I-Anteil auf I-GMW" /end COMPU_VTAB
/begin COMPU_VTAB FORMULA_0902_VTAB "FORMULA_0902_VTAB" TAB_VERB 1 0 "-" DEFAULT_VALUE "O2-Beladung" /end COMPU_VTAB
/begin COMPU_VTAB FORMULA_0903_VTAB "FORMULA_0903_VTAB" TAB_VERB 1 0 "-" DEFAULT_VALUE "I-MAX" /end COMPU_VTAB
/begin COMPU_VTAB FORMULA_0904_VTAB "FORMULA_0904_VTAB" TAB_VERB 1 0 "-" DEFAULT_VALUE "I-MIN" /end COMPU_VTAB
/begin COMPU_VTAB FORMULA_0905_VTAB "FORMULA_0905_VTAB" TAB_VERB 1 0 "-" DEFAULT_VALUE "AD-Wert" /end COMPU_VTAB
/begin COMPU_VTAB FORMULA_0906_VTAB "FORMULA_0906_VTAB" TAB_VERB 1 0 "-" DEFAULT_VALUE "AD-MAX" /end COMPU_VTAB
/begin COMPU_VTAB FORMULA_0907_VTAB "FORMULA_0907_VTAB" TAB_VERB 1 0 "-" DEFAULT_VALUE "AD-MIN" /end COMPU_VTAB
/begin COMPU_VTAB FORMULA_0910_VTAB "FORMULA_0910_VTAB" TAB_VERB 1 0 "-" DEFAULT_VALUE "M-Verdacht" /end COMPU_VTAB
/begin COMPU_VTAB FORMULA_0911_VTAB "FORMULA_0911_VTAB" TAB_VERB 1 0 "-" DEFAULT_VALUE "F-Verdacht" /end COMPU_VTAB
/begin COMPU_VTAB FORMULA_0912_VTAB "FORMULA_0912_VTAB" TAB_VERB 3 0 "inaktiv" 1 "aktiv" 2 "RESET" /end COMPU_VTAB
/begin COMPU_VTAB FORMULA_0913_VTAB "FORMULA_0913_VTAB" TAB_VERB 6 0 "AUS" 1 "P-Anteil" 2 "I-Anteil" 6 "I-Anteil+MW-Begr." 14 "I-Anteil+MW-Begr.+Adapt." 15 "komplett" /end COMPU_VTAB
/begin COMPU_VTAB FORMULA_1034_VTAB "FORMULA_1034_VTAB" TAB_VERB 7 1 "EKP 100%" 2 "EKP geregelt" 4 "EKP gesteuert" 8 "Diagnose EKP1" 16 "Diagnose EKP2" 32 "EKPs abgeschaltet" 64 "EKP_100_Relais" DEFAULT_VALUE "ungueltig" /end COMPU_VTAB
/begin COMPU_VTAB FORMULA_1035_VTAB "FORMULA_1035_VTAB" TAB_VERB 2 0 "AUS" 1 "EIN" DEFAULT_VALUE "ungueltig" /end COMPU_VTAB
/begin COMPU_VTAB FORMULA_1036_VTAB "FORMULA_1036_VTAB" TAB_VERB 6 0 "ALLES IO" 1 "SENSNIO2.5" 2 "SENSNIO5.5" 4 "EKP2 NIO" 8 "SSP NIO" 16 "PABFALL VORL" /end COMPU_VTAB
/begin COMPU_VTAB FORMULA_1038_VTAB "FORMULA_1038_VTAB" TAB_VERB 6 0 "EKP2 n, Si.gen. AUS" 1 "EKP2 j, Si.gen. AUS" 2 "EKP2 n, Si.gen. EIN" 3 "EKP2 j, Si.gen. EIN" 4 "EKP_100" 8 "CAN" DEFAULT_VALUE "undef" /end COMPU_VTAB
/begin COMPU_VTAB FORMULA_1039_VTAB "FORMULA_1039_VTAB" TAB_VERB 2 0 "EKP-Diagnose AUS" 1 "EKP-Diagnose EIN" DEFAULT_VALUE "ungueltig" /end COMPU_VTAB
/begin COMPU_VTAB FORMULA_1042_VTAB "FORMULA_1042_VTAB" TAB_VERB 2 0 "kein Reset" 1 "Reset aktiv" /end COMPU_VTAB
/begin COMPU_VTAB FORMULA_1245_VTAB "FORMULA_1245_VTAB" TAB_VERB 12 0 "BSD_IDLE" 1 "BSDHTOK" 2 "BSDWRITE" 4 "BSDDO/BSDHTOK" 5 "BSDDO/BSDHTOK" 7 "BSDDO/BSDWRITE/BSDHTOK" 8 "BSDBSY" 16 "BSDRXRDY" 17 "BSDRXRDY/BSDHTOK" 32 "BSDTXOK" 64 "BSDDTRQ" 48 "BSDTXIND" /end COMPU_VTAB
/begin FUNCTION Inter_Prozessor_Kommunikation "" /begin DEF_CHARACTERISTIC K_IPK_INJ_T_SYNC_MAX /end DEF_CHARACTERISTIC
 /begin OUT_MEASUREMENT ipk_error_100ms.cnt ipk_error_100ms.type ipk_error_10ms.cnt ipk_error_10ms.type ipk_error_5ms.cnt ipk_error_5ms.type ipk_error_bgnd.cnt ipk_error_bgnd.type ipk_error_kwp.cnt ipk_error_kwp.type ipk_error_segm.cnt ipk_error_segm.type /end OUT_MEASUREMENT
/end FUNCTION
/begin FUNCTION Katschutz ""
 /begin DEF_CHARACTERISTIC K_KATS_CFG K_KATS_I_MAX K_KATS_I_MIN K_KATS_LAM_GRAD_NEG K_KATS_LAM_GRAD_POS K_KATS_LAM_MIN K_KATS_LAM_P_DELTA_MAX K_KATS_T_LAM_MIN K_KATS_T_MAX K_KATS_T_MAX_PST K_KATS_TKAT_MESS_MAX KL_KATS_LAM_I KL_KATS_MDL_LAM_OFFS KL_KATS_NKAT_LAM_OFFS KL_KATS_VKAT_LAM_OFFS /end DEF_CHARACTERISTIC
 /begin OUT_MEASUREMENT kats_ausloeser_b1 kats_ausloeser_b2 kats_lam_i_b1 kats_lam_i_b2 kats_lam_min_t kats_lam_p_b1 kats_lam_p_b2 kats_lam_p_delta_max_b1 kats_lam_p_delta_max_b2 kats_lam_p_max_b1 kats_lam_p_max_b2 kats_lam_soll_b1 kats_lam_soll_b2 kats_lam_soll_roh_b1 kats_lam_soll_roh_b2 kats_mdl_lam_offs_b1 kats_mdl_lam_offs_b2 kats_nkat_lam_offs_b1 kats_nkat_lam_offs_b2 kats_st_b1 kats_st_b2 kats_vkat_lam_offs_b1 kats_vkat_lam_offs_b2 /end OUT_MEASUREMENT
/end FUNCTION
/begin FUNCTION KFIPOL "" /end FUNCTION
/begin FUNCTION KGE ""
 /begin DEF_CHARACTERISTIC K_KGE_AX_BERG K_KGE_AY K_KGE_HFM_TAU K_KGE_LL_T_DELAY K_KGE_LL_T_DIAG K_KGE_OZ_NIVR_MAX K_KGE_OZ_NIVR_MIN K_KGE_PUMG_MAX K_KGE_RSTART_T K_KGE_SEG_IDX_INTG K_KGE_TIME_ML K_KGE_TMOT K_KGE_TOEL KL_KGE_MIN_INTG_B1 KL_KGE_MIN_INTG_B2 KL_KGE_OZ_NIVR_KOR /end DEF_CHARACTERISTIC
 /begin OUT_MEASUREMENT kge_ml_abs_b1 kge_ml_abs_b2 kge_ml_ac_b1 kge_ml_ac_b2 kge_ml_fil_b1 kge_ml_fil_b2 kge_ml_intg_b1 kge_ml_intg_b2 kge_ml_intg_kor kge_ml_mw_intg kge_status_b1 kge_status_b2 kge_time_ll_b1 kge_time_ll_b2 /end OUT_MEASUREMENT
/end FUNCTION
/begin FUNCTION kl87 "" /end FUNCTION
/begin FUNCTION Kraftstoffdruckregelung ""
 /begin DEF_CHARACTERISTIC K_PKS_OBD_SOLL_DYN_TAU K_PKSR_ADAP_DELTA_FAK K_PKSR_ADAP_DELTA_OFF K_PKSR_ADAP_DIAG_T K_PKSR_ADAP_FAK_MAX K_PKSR_ADAP_FAK_MIN K_PKSR_ADAP_FAK_ML_MIN K_PKSR_ADAP_FAK_N_MIN K_PKSR_ADAP_OFF_MAX K_PKSR_ADAP_OFF_MIN K_PKSR_ADAP_OFF_ML_MAX K_PKSR_ADAP_OFF_N_MAX K_PKSR_ADAP_OFF_N_NORM K_PKSR_ADAP_RESET K_PKSR_CFG K_PKSR_DIAG K_PKSR_EKP_100_PSOLL_RAMPE K_PKSR_EKP_VORL_RESET K_PKSR_EXD_DELTA_P_VL K_PKSR_EXD_DELTA_TV K_PKSR_EXD_EKP1_TV_MAX K_PKSR_EXD_FSTLITH_MIN K_PKSR_EXD_NMAX K_PKSR_EXD_P_GRAD_REL K_PKSR_EXD_PDELTA_DR K_PKSR_EXD_PDIF_T_ADAP K_PKSR_EXD_TAU_PDIF_PL K_PKSR_EXD_TAU_PKS_PL K_PKSR_EXD_TV_65 K_PKSR_EXD_V_SSPLITH K_PKSR_I_ANTEIL_MAX K_PKSR_I_ANTEIL_MIN K_PKSR_MAX_TV_GEREGELT K_PKSR_MLSOLL_EKP2 K_PKSR_MLSOLL_HYS_EKP2 K_PKSR_N_EKP2 K_PKSR_N_HYS_EKP2 K_PKSR_P_SSP_SA K_PKSR_PERIOD K_PKSR_PSOLL_MECH K_PKSR_T_ABST K_PKSR_T_VORLAUF K_PKSR_TMIN_EKP2 K_PKSR_TV_DIAG KF_PKSR_PSOLL_QSOLL_TV KF_PKSR_RF_N_PSOLL KL_PKSR_100P_DAUER_TMOT KL_PKSR_I_FAKTOR KL_PKSR_P_FAKTOR KL_PKSR_QSSP_PKS KL_PKSR_TKSM_PSOLL KL_PKSR_TV_HARDWARE /end DEF_CHARACTERISTIC
 /begin OUT_MEASUREMENT pks_soll pks_soll_dyn pks_soll_dyn_delta pks_soll_dyn_delta_max pksr_adap_diag_t pksr_adap_offset pksr_b_ekp1_diag pksr_b_kath pksr_b_notlauf pksr_ekp_100_rampe pksr_ekp2_enable1 pksr_ekp2_enable2 pksr_exd_delta_fst_0s pksr_exd_delta_fst_15s pksr_exd_delta_p_vl pksr_exd_delta_ssp pksr_exd_delta_tv25 pksr_exd_delta_tv55 pksr_exd_diag_st pksr_exd_fst_li_0s pksr_exd_p_delta_dr pksr_exd_p_max_dr pksr_exd_p_oeffbeg_dr pksr_exd_pdif pksr_exd_pdif_fil pksr_exd_pks_fil pksr_exd_pks65proz pksr_exd_pks65proz_vl pksr_exd_t pksr_exd_tv_oeffbeg_dr pksr_i_anteil pksr_p_anteil pksr_q_ekp pksr_q_ssp pksr_reg_time pksr_s_anteil pksr_status pksr_t_abst pksr_t_vorlauf pksr_tv pksr_tv_diag pksr_tv_regler /end OUT_MEASUREMENT
/end FUNCTION
/begin FUNCTION KT_IBS "" /begin OUT_MEASUREMENT Bsdcontrol Bsddata Bsdregadr /end OUT_MEASUREMENT /end FUNCTION
/begin FUNCTION Kurbelwelle ""
 /begin DEF_CHARACTERISTIC K_KW_ED_DELTA_N K_KW_ED_DELTA_N_RATE K_KW_ED_DELTA_U K_KW_ED_MAX_RATE K_KW_ED_N_DROP K_KW_ED_N_DROP_RATE K_KW_ED_SH_TO_GND_RATE K_KW_ED_SH_TO_UB_RATE /end DEF_CHARACTERISTIC
 /begin OUT_MEASUREMENT kw_ed_delta_n_rate kw_ed_n_drop_rate kw_ed_sh_to_gnd_rate kw_ed_sh_to_ub_rate /end OUT_MEASUREMENT
/end FUNCTION
/begin FUNCTION KWP-Jobs "" /end FUNCTION
/begin FUNCTION KWP-Programmierung "" /end FUNCTION
/begin FUNCTION kwp_fetrawe "" /end FUNCTION
/begin FUNCTION la_TRIM ""
 /begin DEF_CHARACTERISTIC K_LA_TRIM_CFG K_LA_TRIM_DIAG_CFG K_LA_TRIM_DIAG_I_AD_F K_LA_TRIM_DIAG_I_AD_MAX_SCHW K_LA_TRIM_DIAG_I_AD_MIN_SCHW K_LA_TRIM_DIAG_I_ED_F K_LA_TRIM_DIAG_I_MAX_SCHW K_LA_TRIM_DIAG_I_MIN_SCHW K_LA_TRIM_DIAG_I_T K_LA_TRIM_DIAG_P_SCHW K_LA_TRIM_DLY_T K_LA_TRIM_DYN_DELTA_RF K_LA_TRIM_DYN_RF_T K_LA_TRIM_DYN_T K_LA_TRIM_FKT_CFG K_LA_TRIM_I_AD_F K_LA_TRIM_I_AD_MAX K_LA_TRIM_I_AD_MCS K_LA_TRIM_I_AD_MIN K_LA_TRIM_I_GMW_DLY K_LA_TRIM_I_GMW_MAX K_LA_TRIM_I_GMW_MIN K_LA_TRIM_I_GMW_TAU K_LA_TRIM_I_MAX K_LA_TRIM_I_MIN K_LA_TRIM_I_US_DELTA_MAX K_LA_TRIM_I_US_DELTA_MIN K_LA_TRIM_LAA_F_TE K_LA_TRIM_LAM_DELTA_MAX K_LA_TRIM_P_ANZ_MAX K_LA_TRIM_P_MAX K_LA_TRIM_P_MIN K_LA_TRIM_P_US_OFFSET K_LA_TRIM_RF_HYS K_LA_TRIM_TABG_NKAT K_LA_TRIM_TAN_MAX K_LA_TRIM_TAN_MIN K_LA_TRIM_TE_C_AKF_MAX K_LA_TRIM_US_EINGER K_LA_TRIM_US_EINGESCHW K_LA_TRIM_US_O2_MAX K_LA_TRIM_US_O2_MIN K_LA_TRIM_US_SOLL_GRAD K_LA_TRIM_V_SCHWELLE KF_LA_TRIM_AD_WICHT KF_LA_TRIM_I KF_LA_TRIM_I_DLY KF_LA_TRIM_I_GMW_WICHT KF_LA_TRIM_P KF_LA_TRIM_P_ABR KF_LA_TRIM_P_DLY KF_LA_TRIM_P_WAIT KF_LA_TRIM_USN_SOLL KL_LA_TRIM_I_FAK_OBD KL_LA_TRIM_I_GMW_RF_MAX KL_LA_TRIM_I_GMW_RF_MIN KL_LA_TRIM_P_FAK_OBD KL_LA_TRIM_RF_MAX KL_LA_TRIM_RF_MIN /end DEF_CHARACTERISTIC
 /begin OUT_MEASUREMENT la_trim_diag_f_b1 la_trim_diag_f_b2 la_trim_diag_i_ad_f_b1 la_trim_diag_i_ad_f_b2 la_trim_diag_i_ad_max_cnt_b1 la_trim_diag_i_ad_max_cnt_b2 la_trim_diag_i_ad_min_cnt_b1 la_trim_diag_i_ad_min_cnt_b2 la_trim_diag_i_ed_f_b1 la_trim_diag_i_ed_f_b2 la_trim_diag_i_max_cnt_b1 la_trim_diag_i_max_cnt_b2 la_trim_diag_i_min_cnt_b1 la_trim_diag_i_min_cnt_b2 la_trim_diag_m_b1 la_trim_diag_m_b2 la_trim_diag_p_cnt_b1 la_trim_diag_p_cnt_b2 la_trim_diag_st_b1 la_trim_diag_st_b2 la_trim_i_b1 la_trim_i_b2 la_trim_i_dly_b1 la_trim_i_dly_b2 la_trim_i_f_b1 la_trim_i_f_b2 la_trim_i_fak_obd_b1 la_trim_i_fak_obd_b2 la_trim_i_gmw_b1 la_trim_i_gmw_b2 la_trim_i_inc_b1 la_trim_i_inc_b2 la_trim_lam_soll_b1 la_trim_lam_soll_b2 la_trim_p_abr_b1 la_trim_p_abr_b2 la_trim_p_anz_b1 la_trim_p_anz_b2 la_trim_p_b1 la_trim_p_b2 la_trim_p_dez_b1 la_trim_p_dez_b2 la_trim_p_dly_b1 la_trim_p_dly_b2 la_trim_p_f_b1 la_trim_p_f_b2 la_trim_p_fak_obd_b1 la_trim_p_fak_obd_b2 la_trim_p_wait_b1 la_trim_p_wait_b2 la_trim_st_b1 la_trim_st_b2 la_trim_st_cfg_b1 la_trim_st_cfg_b2 la_trim_st_error_b1 la_trim_st_error_b2 la_trim_st_kats_b1 la_trim_st_kats_b2 la_trim_st_kh_b1 la_trim_st_kh_b2 la_trim_st_laa_lim_b1 la_trim_st_laa_lim_b2 la_trim_st_nkat_verf_b1 la_trim_st_nkat_verf_b2 la_trim_st_rf_b1 la_trim_st_rf_b2 la_trim_st_sk_b1 la_trim_st_sk_b2 la_trim_st_slp_b1 la_trim_st_slp_b2 la_trim_st_soll_add_b1 la_trim_st_soll_add_b2 la_trim_st_soll_norm_b1 la_trim_st_soll_norm_b2 la_trim_st_te_b1 la_trim_st_te_b2 la_trim_st_temperatur_b1 la_trim_st_temperatur_b2 la_trim_st_v_b1 la_trim_st_v_b2 la_trim_us_diff_b1 la_trim_us_diff_b2 la_trim_usn_aebg_b1 la_trim_usn_aebg_b2 la_trim_usn_soll_b1 la_trim_usn_soll_b2 la_trim_zust_ad_erm_b1 la_trim_zust_ad_erm_b2 la_trim_zust_b1 la_trim_zust_b2 la_trim_zust_i_ad_max_b1 la_trim_zust_i_ad_max_b2 la_trim_zust_i_ad_min_b1 la_trim_zust_i_ad_min_b2 la_trim_zust_i_b1 la_trim_zust_i_b2 la_trim_zust_i_gmw_aktiv_b1 la_trim_zust_i_gmw_aktiv_b2 la_trim_zust_i_init_gmw_b1 la_trim_zust_i_init_gmw_b2 la_trim_zust_i_max_b1 la_trim_zust_i_max_b2 la_trim_zust_i_min_b1 la_trim_zust_i_min_b2 la_trim_zust_p_abger_b1 la_trim_zust_p_abger_b2 la_trim_zust_p_b1 la_trim_zust_p_b2 la_trim_zust_us_o2_b1 la_trim_zust_us_o2_b2 /end OUT_MEASUREMENT
/end FUNCTION
/begin FUNCTION Lambda ""
 /begin DEF_CHARACTERISTIC K_LAA_CFG K_LAA_F_GRAD K_LAA_F_MAX K_LAA_F_MCS_B1 K_LAA_F_MCS_B2 K_LAA_F_MIN K_LAA_F_N_MAX K_LAA_F_N_MIN K_LAA_F_RF_MAX K_LAA_F_RF_MIN K_LAA_F_T_ADAPT K_LAA_F_TE_GRAD K_LAA_F_TE_MAX K_LAA_F_TE_MIN K_LAA_F_TE_N_MAX K_LAA_F_TE_RAMPE K_LAA_F_TE_RF_MAX K_LAA_F_TE_T_ADAPT K_LAA_LAM_REG_F_DELTA K_LAA_OFFS_GRAD K_LAA_OFFS_MAX K_LAA_OFFS_MCS_B1 K_LAA_OFFS_MCS_B2 K_LAA_OFFS_MIN K_LAA_OFFS_N_MAX K_LAA_OFFS_RF_MAX K_LAA_OFFS_T_ADAPT K_LAA_PKS_MAX K_LAA_RESET_CFG K_LAA_TAN_MAX K_LAA_TI_IST_MIN K_LAA_TMOT_MIN K_LAM_DIAG_CFG K_LAM_DIAG_LAA_F_HYS K_LAM_DIAG_LAA_OFFS_HYS K_LAM_DIAG_LAA_T K_LAM_DIAG_REG_T K_LAM_REG_CFG K_LAM_REG_DELTA_MAX K_LAM_REG_DELTA_MIN K_LAM_REG_DELTA_STAT_MAX K_LAM_REG_DELTA_STAT_MAX_TE K_LAM_REG_DELTA_STAT_TRIM K_LAM_REG_F_MAX K_LAM_REG_F_MIN K_LAM_REG_IST_MW_MAX K_LAM_REG_IST_MW_MIN K_LAM_REG_RESET_CFG K_LAM_REG_RESET_SA_TMOT_MIN K_LAM_REG_SOLL_MAX K_LAM_REG_SOLL_MIN K_LAM_REG_START_TIME K_LAM_REG_T_SLP_VERZ K_LAM_REG_TI_IST_MIN K_LAM_REG_TN_TU_F K_LAM_REG_TV_TU_F K_LAM_SOLL_ADD_KONV_GRAD K_LAM_SOLL_FETT_ERK K_LAM_SOLL_FILT_F K_LAM_SOLL_FILT_INIT_CFG K_LAM_SOLL_KATH_DELTA_NEG K_LAM_SOLL_KATH_DELTA_POS K_LAM_SOLL_KATH_T_ML_MAX K_LAM_SOLL_KONV_CFG K_LAM_SOLL_KR_KATS K_LAM_SOLL_MAX K_LAM_SOLL_MIN K_LAM_SOLL_MS_KAT_F_OBD K_LAM_SOLL_MS_KAT_MIN K_LAM_SOLL_MS_KAT_OFFSET_OBD K_LAM_SOLL_MS_KAT_SOLL_MAX_OBD K_LAM_SOLL_O2_ANT K_LAM_SOLL_OFFS_MCS K_LAM_SOLL_PULS_AUSR_CFG K_LAM_SOLL_PULS_AUSR_SL_CFG K_LAM_SOLL_PULS_AUSR_SL_T K_LAM_SOLL_PULS_LANK_CFG K_LAM_SOLL_PULS_LANK_MAX K_LAM_SOLL_PULS_LANK_MIN K_LAM_SOLL_PULS_O2_HYST K_LAM_SOLL_T_FETT_MIN K_LAM_SOLL_T_SA_SLP_MIN K_LAM_SOLL_WL_DELTA_NEG K_LAM_SOLL_WL_DELTA_POS K_LAM_SOLL_WL_TMOT_HYS K_LAM_SOLL_WL_TMOT_MAX K_LAVK_AD_GAIN_CNT K_LAVK_AD_GAIN_CNT_MIN K_LAVK_AD_GAIN_GRAD K_LAVK_AD_GAIN_MIN K_LAVK_AD_GAIN_ML_MIN K_LAVK_AD_GAIN_NV_MAX K_LAVK_AD_GAIN_NV_MIN K_LAVK_AD_GAIN_T K_LAVK_AD_GAIN_T1 K_LAVK_AD_MAX K_LAVK_AD_MIN K_LAVK_AD_OFFS_CNT K_LAVK_AD_OFFS_CNT_MIN K_LAVK_AD_OFFS_CNT_MIN_MS K_LAVK_AD_OFFS_CNT_MS K_LAVK_AD_OFFS_GRAD K_LAVK_AD_OFFS_MAX K_LAVK_AD_OFFS_MIN K_LAVK_AD_OFFS_NV_MAX K_LAVK_AD_OFFS_NV_MIN K_LAVK_AD_OFFS_T K_LAVK_AD_OFFS_T1 K_LAVK_AD_RESET K_LAVK_AD_TEST K_LAVK_ATIC42_ICP_ENABLE_B1 K_LAVK_ATIC42_ICP_ENABLE_B2 K_LAVK_ATIC42_ICP_VALUE_B1 K_LAVK_ATIC42_ICP_VALUE_B2 K_LAVK_ATIC42_IP_OFFSET_MEAS_B1 K_LAVK_ATIC42_IP_OFFSET_MEAS_B2 K_LAVK_ATIC42_PIN_CFG_B1 K_LAVK_ATIC42_PIN_CFG_B2 K_LAVK_ATIC42_PROTEC_TIME_B1 K_LAVK_ATIC42_PROTEC_TIME_B2 K_LAVK_ATIC42_RI_CALIB_B1 K_LAVK_ATIC42_RI_CALIB_B2 K_LAVK_ATIC42_RI_MEAS_FREQ_B1 K_LAVK_ATIC42_RI_MEAS_FREQ_B2 K_LAVK_ATIC42_RI_OSCI_B1 K_LAVK_ATIC42_RI_OSCI_B2 K_LAVK_ATIC42_SENSOR_B1 K_LAVK_ATIC42_SENSOR_B2 K_LAVK_FILT_CFG K_LAVK_GAIN_LAM_SCHW K_LAVK_R7 K_LAVK_US_LUFT_REF K_LAVK_US_REF KF_LAM_REG_K KF_LAM_REG_KORR_F KF_LAM_REG_WF_MKS_REL_MAX KF_LAM_REG_WF_VERZ_F KF_LAM_SOLL_ADD_KONV KF_LAM_SOLL_ADD_NEG_OBD KF_LAM_SOLL_ADD_POS_OBD KF_LAM_SOLL_AUSS_KATS KF_LAM_SOLL_AUSS_OFFS KF_LAM_SOLL_GRUND KF_LAM_SOLL_GRUND_PST KF_LAM_SOLL_KR_KATS_OFFS KF_LAM_SOLL_MS_KAT_SOLL_MAX KF_LAM_SOLL_MS_KAT_SOLL_MIN KF_LAM_SOLL_MS_KAT_SOLL_MIN_OBD KF_LAM_SOLL_PULS_OFFS_AUSR KF_LAM_SOLL_TAU1_ABG KF_LAM_SOLL_WL KF_LAM_SOLL_WL_F KF_LAVK_FILT_T1 KL_LAM_IST KL_LAM_REG_RESET_SA_ML_SUM KL_LAM_REG_T_SA_VERZ KL_LAM_SOLL_ADD_KAT_ALT_F KL_LAM_SOLL_AUSS_F KL_LAM_SOLL_MS_KAT_MAX KL_LAM_SOLL_MS_KAT_SOLL_HYS KL_LAM_SOLL_PULS_ADD_OBD KL_LAM_SOLL_PULS_PW_OBD KL_LAM_SOLL_START KL_LAM_SOLL_VL KL_LAVK_IST_F KL_LAVK_IST_OFFS KL_LAVK_P_KORR_F_FETT KL_LAVK_P_KORR_F_MAGER KL_LAVK_T_KORR_F /end DEF_CHARACTERISTIC
 /begin OUT_MEASUREMENT laa_f_b1 laa_f_b2 laa_f_mw_cnt_b1 laa_f_mw_cnt_b2 laa_f_mw_t_b1 laa_f_mw_t_b2 laa_f_te_mw_cnt_b1 laa_f_te_mw_cnt_b2 laa_f_te_mw_t_b1 laa_f_te_mw_t_b2 laa_offs_begr_b1 laa_offs_begr_b2 laa_offs_mw_cnt_b1 laa_offs_mw_cnt_b2 laa_offs_mw_t_b1 laa_offs_mw_t_b2 lam.atic42_ip_gain_b1 lam.atic42_ip_gain_b2 lam.laa_f_begr_b1 lam.laa_f_begr_b2 lam.laa_f_te_begr_b1 lam.laa_f_te_begr_b2 lam.laa_offs_begr_b1 lam.laa_offs_begr_b2 lam.laa_stat_b1 lam.laa_stat_b2 lam.laa_status_b1 lam.laa_status_b2 lam.laa_ti_ist_b1 lam.laa_ti_ist_b2 lam.lavk_status_b1 lam.lavk_status_b2 lam_b1.ad_gain_cnt lam_b1.ad_offs_cnt lam_b1.ip_gain lam_b1.ist_ad lam_b1.ist_mw_grad lam_b1.laa_f_te lam_b1.laa_f_te_grad_neg lam_b1.laa_ml_f lam_b1.laa_ml_f_te lam_b1.laa_ml_offs lam_b1.laa_st lam_b1.lavk_ad lam_b1.lavk_ad_gain_filt lam_b1.lavk_ad_korr lam_b1.lavk_ad_mw lam_b1.lavk_ad_mw_korr lam_b1.lavk_ad_offs_filt lam_b1.lavk_filt_konst lam_b1.lavk_ip lam_b1.lavk_ip_korr lam_b1.lavk_ip_mw lam_b1.lavk_ip_mw_korr lam_b1.lavk_korr_f lam_b1.lavk_st lam_b1.lavk_tau1 lam_b1.mks_soll_zyl lam_b1.ml_delta lam_b1.reg_k lam_b1.reg_tn_i lam_b1.reg_tn_roh lam_b1.reg_tv_d lam_b1.wf_verz_time lam_b1.zahn_nr lam_b2.ad_gain_cnt lam_b2.ad_offs_cnt lam_b2.ip_gain lam_b2.ist_ad lam_b2.ist_mw_grad lam_b2.laa_f_te lam_b2.laa_f_te_grad_neg lam_b2.laa_ml_f lam_b2.laa_ml_f_te lam_b2.laa_ml_offs lam_b2.laa_st lam_b2.lavk_ad lam_b2.lavk_ad_gain_filt lam_b2.lavk_ad_korr lam_b2.lavk_ad_mw lam_b2.lavk_ad_mw_korr lam_b2.lavk_ad_offs_filt lam_b2.lavk_filt_konst lam_b2.lavk_ip lam_b2.lavk_ip_korr lam_b2.lavk_ip_mw lam_b2.lavk_ip_mw_korr lam_b2.lavk_korr_f lam_b2.lavk_st lam_b2.lavk_tau1 lam_b2.mks_soll_zyl lam_b2.ml_delta lam_b2.reg_k lam_b2.reg_tn_i lam_b2.reg_tn_roh lam_b2.reg_tv_d lam_b2.wf_verz_time lam_b2.zahn_nr lam_diag_la_adapt_scdn_b1 lam_diag_la_adapt_scdn_b2 lam_diag_laa_f_cnt_b1 lam_diag_laa_f_cnt_b2 lam_diag_laa_f_max_aktiv_b1 lam_diag_laa_f_max_aktiv_b2 lam_diag_laa_f_min_aktiv_b1 lam_diag_laa_f_min_aktiv_b2 lam_diag_laa_f_t_b1 lam_diag_laa_f_t_b2 lam_diag_laa_io_t_b1 lam_diag_laa_io_t_b2 lam_diag_laa_offs_cnt_b1 lam_diag_laa_offs_cnt_b2 lam_diag_laa_offs_max_aktiv_b1 lam_diag_laa_offs_max_aktiv_b2 lam_diag_laa_offs_min_aktiv_b1 lam_diag_laa_offs_min_aktiv_b2 lam_diag_laa_offs_t_b1 lam_diag_laa_offs_t_b2 lam_diag_lam_reg_scdn_b1 lam_diag_lam_reg_scdn_b2 lam_diag_reg_io_t_b1 lam_diag_reg_io_t_b2 lam_diag_reg_max_aktiv_b1 lam_diag_reg_max_aktiv_b2 lam_diag_reg_min_aktiv_b1 lam_diag_reg_min_aktiv_b2 lam_diag_reg_t_b1 lam_diag_reg_t_b2 lam_diag_st_b1 lam_diag_st_b2 lam_ist lam_ist_mw_korr_b1 lam_ist_mw_korr_b2 lam_ist_seg lam_ml_delta_rel lam_reg_f_max_b1 lam_reg_f_max_b2 lam_reg_f_min_b1 lam_reg_f_min_b2 lam_soll_add_kat_alt_f_b1 lam_soll_add_kat_alt_f_b2 lam_soll_auss_f lam_soll_auss_offs lam_soll_bz_md lam_soll_ms_kat_f_obd lam_soll_ms_kat_max lam_soll_ms_kat_offs_obd lam_soll_ms_kat_soll_max lam_soll_ms_kat_soll_min lam_soll_ms_kat_trig_sa_b1 lam_soll_ms_kat_trig_sa_b2 lam_soll_ms_kat_trig_schw lam_soll_norm_b1 lam_soll_norm_b2 lam_soll_start lam_soll_tau1_abg lam_soll_verz lam_soll_vl_norm_b1 lam_soll_vl_norm_b2 lam_soll_wf_f lam_w_b1.ml_zyl_filt lam_w_b1.soll_add_konv lam_w_b1.soll_add_temp lam_w_b1.soll_bas lam_w_b1.soll_bas_diff lam_w_b1.soll_bas_lim lam_w_b1.soll_delta_neg lam_w_b1.soll_delta_pos lam_w_b1.soll_filt lam_w_b1.soll_filt_konst lam_w_b1.soll_kr_kats_offs lam_w_b1.soll_ms_kat_delta lam_w_b1.soll_ms_kat_init lam_w_b1.soll_st lam_w_b1.soll_stat lam_w_b1.soll_tau1 lam_w_b1.soll_vl_bezug lam_w_b1.soll_zust_st lam_w_b1.tz_offs_kats lam_w_b2.ml_zyl_filt lam_w_b2.soll_add_konv lam_w_b2.soll_add_temp lam_w_b2.soll_bas lam_w_b2.soll_bas_diff lam_w_b2.soll_bas_lim lam_w_b2.soll_delta_neg lam_w_b2.soll_delta_pos lam_w_b2.soll_filt lam_w_b2.soll_filt_konst lam_w_b2.soll_kr_kats_offs lam_w_b2.soll_ms_kat_delta lam_w_b2.soll_ms_kat_init lam_w_b2.soll_st lam_w_b2.soll_stat lam_w_b2.soll_tau1 lam_w_b2.soll_vl_bezug lam_w_b2.soll_zust_st lam_w_b2.tz_offs_kats lavk_ad_gain_cnt_t_b1 lavk_ad_gain_cnt_t_b2 lavk_ad_gain_delta_t_b1 lavk_ad_gain_delta_t_b2 lavk_ad_gain_freig_b1 lavk_ad_gain_freig_b2 lavk_ad_gain_st_b1 lavk_ad_gain_st_b2 lavk_ad_offs_cnt_t_b1 lavk_ad_offs_cnt_t_b2 lavk_ad_offs_delta_t_b1 lavk_ad_offs_delta_t_b2 lavk_ad_offs_freig_b1 lavk_ad_offs_freig_b2 lavk_ad_offs_ml_b1 lavk_ad_offs_ml_b2 lavk_ad_offs_ms_b1 lavk_ad_offs_ms_b2 lavk_ad_offs_spi_b1 lavk_ad_offs_spi_b2 lavk_ad_offs_st_b1 lavk_ad_offs_st_b2 lavk_ad_st_b1 lavk_ad_st_b2 lavk_atic42_cnt_b1 lavk_atic42_cnt_b2 lavk_atic42_diag_byte_b1 lavk_atic42_diag_byte_b2 lavk_atic42_diag_st_b1 lavk_atic42_diag_st_b2 lavk_atic42_icp_enable_b1 lavk_atic42_icp_enable_b2 lavk_atic42_icp_value_b1 lavk_atic42_icp_value_b2 lavk_atic42_identity_b1 lavk_atic42_identity_b2 lavk_atic42_ip_gain_b1 lavk_atic42_ip_gain_b2 lavk_atic42_ip_loop_enable_b1 lavk_atic42_ip_loop_enable_b2 lavk_atic42_ip_loop_enable_spi_b1 lavk_atic42_ip_loop_enable_spi_b2 lavk_atic42_ip_offset_meas_b1 lavk_atic42_ip_offset_meas_b2 lavk_atic42_ip_st_b1 lavk_atic42_ip_st_b2 lavk_atic42_mode_b1 lavk_atic42_mode_b2 lavk_atic42_pin_b1 lavk_atic42_pin_b2 lavk_atic42_pin_diag_b1 lavk_atic42_pin_diag_b2 lavk_atic42_protec_time_b1 lavk_atic42_protec_time_b2 lavk_atic42_ri_calib_b1 lavk_atic42_ri_calib_b2 lavk_atic42_ri_freq_b1 lavk_atic42_ri_freq_b2 lavk_atic42_ri_osci_b1 lavk_atic42_ri_osci_b2 lavk_atic42_ri_range_b1 lavk_atic42_ri_range_b2 lavk_atic42_ri_range_spi_b1 lavk_atic42_ri_range_spi_b2 lavk_atic42_ri_st_b1 lavk_atic42_ri_st_b2 lavk_atic42_sensor_b1 lavk_atic42_sensor_b2 lavk_spi_buffer_ret ml_zyl_verz wf_mks_rel /end OUT_MEASUREMENT
/end FUNCTION
/begin RECORD_LAYOUT TKF_SW_SW_SW FNC_VALUES 5 SWORD COLUMN_DIR DIRECT AXIS_PTS_X 3 SWORD INDEX_INCR DIRECT AXIS_PTS_Y 4 SWORD INDEX_INCR DIRECT NO_AXIS_PTS_X 1 UBYTE NO_AXIS_PTS_Y 2 UBYTE /end RECORD_LAYOUT
/begin RECORD_LAYOUT TKF_SW_SW_UW FNC_VALUES 5 UWORD COLUMN_DIR DIRECT AXIS_PTS_X 3 SWORD INDEX_INCR DIRECT AXIS_PTS_Y 4 SWORD INDEX_INCR DIRECT NO_AXIS_PTS_X 1 UBYTE NO_AXIS_PTS_Y 2 UBYTE /end RECORD_LAYOUT
/begin RECORD_LAYOUT TKL_SW_VV_SW FNC_VALUES 4 SWORD COLUMN_DIR DIRECT AXIS_PTS_X 3 SWORD INDEX_INCR DIRECT NO_AXIS_PTS_X 1 UBYTE RESERVED 2 BYTE /end RECORD_LAYOUT
/begin RECORD_LAYOUT TKL_SW_VV_UW FNC_VALUES 4 UWORD COLUMN_DIR DIRECT AXIS_PTS_X 3 SWORD INDEX_INCR DIRECT NO_AXIS_PTS_X 1 UBYTE RESERVED 2 BYTE /end RECORD_LAYOUT
/begin RECORD_LAYOUT TKL_UW_VV_SW FNC_VALUES 4 SWORD COLUMN_DIR DIRECT AXIS_PTS_X 3 UWORD INDEX_INCR DIRECT NO_AXIS_PTS_X 1 UBYTE RESERVED 2 BYTE /end RECORD_LAYOUT
/begin RECORD_LAYOUT TKL_UW_VV_UW FNC_VALUES 4 UWORD COLUMN_DIR DIRECT AXIS_PTS_X 3 UWORD INDEX_INCR DIRECT NO_AXIS_PTS_X 1 UBYTE RESERVED 2 BYTE /end RECORD_LAYOUT
/begin RECORD_LAYOUT TKW_VV_VV_SW FNC_VALUES 1 SWORD COLUMN_DIR DIRECT /end RECORD_LAYOUT
/begin RECORD_LAYOUT TKW_VV_VV_UB FNC_VALUES 1 UBYTE COLUMN_DIR DIRECT /end RECORD_LAYOUT
/begin RECORD_LAYOUT TKW_VV_VV_UL FNC_VALUES 1 ULONG COLUMN_DIR DIRECT /end RECORD_LAYOUT
/begin RECORD_LAYOUT TKW_VV_VV_UW FNC_VALUES 1 UWORD COLUMN_DIR DIRECT /end RECORD_LAYOUT
/end MODULE
/end PROJECT
