ASAP2_VERSION 1 3
/begin PROJECT P390 "BMW DDE6.2 6-Zylinder VR0.1 15.03.2004 CAN11/12H"
/begin HEADER "" VERSION "VR0.1_6Z_CAN11/12H" PROJECT_NO P390 /end HEADER
/begin MODULE DIM ""
/begin MOD_COMMON "" BYTE_ORDER MSB_FIRST ALIGNMENT_BYTE 1 ALIGNMENT_WORD 2 ALIGNMENT_LONG 4 ALIGNMENT_FLOAT32_IEEE 4 /end MOD_COMMON
/begin MEASUREMENT EATSCD_swtSig "Signalquelle Umgebungstemperatur (ADC oder CAN)" UBYTE OneToOne 1 100 0.00 255.0 FORMAT "%5.1" ECU_ADDRESS 0x7F8858 /end MEASUREMENT
/begin MEASUREMENT EATSCD_tAir "Umgebungstemperatur" SWORD Temp_Cels 1 100 -50.140 899.860 FORMAT "%8.3" ECU_ADDRESS 0x7F8C04 /end MEASUREMENT
/begin MEASUREMENT EATSCD_tAirLin "linearisierter Wert der Umgebungstemperatur" SWORD Temp_Cels 1 100 -50.140 899.860 FORMAT "%8.3" ECU_ADDRESS 0x7F8C06 /end MEASUREMENT
/begin MEASUREMENT EATSCD_uRaw "Spannungsrohwert der Umgebungstemperatur" SWORD Volt 1 100 0.00 5000.000 FORMAT "%8.3" ECU_ADDRESS 0x7F8C08 /end MEASUREMENT
/begin MEASUREMENT EBAFCD_stSigOut "source of activation for electrical power stage of EBAFCD output" UBYTE OneToOne 1 100 0.00 255.0 FORMAT "%5.1" ECU_ADDRESS 0x7F8859 /end MEASUREMENT
/begin MEASUREMENT EBAFCD_st_mp "Status of Engine Bay Air Flap" UBYTE OneToOne 1 100 0.00 255.0 FORMAT "%5.1" ECU_ADDRESS 0x8FED1C /end MEASUREMENT
/begin MEASUREMENT EBFCD_stOut "status output of EBFCD" UBYTE OneToOne 1 100 0.00 255.0 FORMAT "%5.1" ECU_ADDRESS 0x7F885A /end MEASUREMENT
/begin MEASUREMENT EBFCD_st_mp "Status of output of EBFCD" UBYTE OneToOne 1 100 0.00 255.0 FORMAT "%5.1" ECU_ADDRESS 0x8FED1D /end MEASUREMENT
/begin MEASUREMENT EBTSCD_tCIntLin "ECU temperature linearized value" SWORD Temp_Cels 1 100 -50.140 899.860 FORMAT "%8.3" ECU_ADDRESS 0x7F8C0A /end MEASUREMENT
/begin MEASUREMENT EBTSCD_tECU "ECU temperature current value" SWORD Temp_Cels 1 100 -50.140 899.860 FORMAT "%8.3" ECU_ADDRESS 0x7F8C0C /end MEASUREMENT
/begin MEASUREMENT EBTSCD_uRawTECU_mp "Raw sensor voltage" SWORD Volt 1 100 -160156.4 160151.5 FORMAT "%8.1" ECU_ADDRESS 0x8FED1E /end MEASUREMENT
/begin MEASUREMENT EEPCD_stErrSet "Allgemeiner Fehlerzustand bei der Aktivierung einer Konfiguration" UBYTE OneToOne 1 100 0.00 255.0 FORMAT "%5.1" ECU_ADDRESS 0x7F885B /end MEASUREMENT
/begin MEASUREMENT EEPCD_stMIL "Variant manager default status of MIL lamp" UBYTE OneToOne 1 100 0.00 255.0 FORMAT "%5.1" ECU_ADDRESS 0x7F885C /end MEASUREMENT
/begin MEASUREMENT EepDev_dBlockVal_mp "Mepßunkt der Anzeige eines gelesenen bzw. geschriebenen Blockinhaltes (max. 100 Byte)" ULONG OneToOne 1 100 0.00 4294967295.00 FORMAT "%13.2" ARRAY_SIZE 25 ECU_ADDRESS 0x802478 /end MEASUREMENT
/begin MEASUREMENT EepDev_stLastJob_mp "Status des letzten Lese- bzw. Schreibauftrages" UWORD OneToOne 1 100 0.00 65535.00 FORMAT "%8.2" ECU_ADDRESS 0x80256A /end MEASUREMENT
/begin MEASUREMENT EGPpCD_stActrOut "status of exhaust gas pressure pipe actuator" UBYTE OneToOne 1 100 0.00 255.0 FORMAT "%5.1" ECU_ADDRESS 0x7F885D /end MEASUREMENT
/begin MEASUREMENT EGPp_dvolSil_mp "Abgasvolumenstrom nach Partikelfilter" SWORD CubMtrPerHr 1 100 -3276.800 3276.700 FORMAT "%8.3" ECU_ADDRESS 0x8FED20 /end MEASUREMENT
/begin MEASUREMENT EGPp_pPstPFlt "Druckabfall des Abgassystems nach Partikelfilter" SWORD Pres_hPa 1 100 -32768.00 32767.00 FORMAT "%8.2" ECU_ADDRESS 0x7F8C10 /end MEASUREMENT
/begin MEASUREMENT EGPp_pPstPFltMap_mp "Druckabfall nach Partikelfilter aus Kennfeldberechnung" SWORD Pres_hPa 1 100 -32768.00 32767.00 FORMAT "%8.2" ECU_ADDRESS 0x8FED22 /end MEASUREMENT
/begin MEASUREMENT EGPp_pPstPFltSim_mp "Druckabfall nach Partikelfilter aus Simulation" SWORD Pres_hPa 1 100 -32768.00 32767.00 FORMAT "%8.2" ECU_ADDRESS 0x8FED24 /end MEASUREMENT
/begin MEASUREMENT EGPp_stLogicOut "Status of Exhaust gas pressure pump" UBYTE OneToOne 1 100 0.00 255.0 FORMAT "%5.1" ECU_ADDRESS 0x7F885E /end MEASUREMENT
/begin MEASUREMENT EGRCD_rCnv_mp "Tastverhältnis  basierend auf dem Ausgang des Abgasrückführreglers" SWORD DtyCyc 1 100 -327.6800 327.6700 FORMAT "%8.4" ECU_ADDRESS 0x8FED26 /end MEASUREMENT
/begin MEASUREMENT EGRCD_rOut "Tastverhältnis zür Endstufenansteuerung" SWORD DtyCyc 1 100 -327.6800 327.6700 FORMAT "%8.4" ECU_ADDRESS 0x7F8C12 /end MEASUREMENT
/begin MEASUREMENT EGRVlv_rEGR "Ansteuertastverhältnis für ARF-Ventil" SWORD Prc 1 100 -400.0000 399.9878 FORMAT "%8.4" ECU_ADDRESS 0x7F8C14 /end MEASUREMENT
/begin MEASUREMENT EGRVlv_rEGR2 "Sollwert für Abgasrückführung Coordinator 2" SWORD Prc 1 100 -400.0000 399.9878 FORMAT "%8.4" ECU_ADDRESS 0x7F8C16 /end MEASUREMENT
/begin MEASUREMENT EGRVlv_rEGR2Byp_mp "measuringpoint2 to be able to read value by ASCET before bypass" SWORD Prc 1 100 -400.0000 399.9878 FORMAT "%8.4" ECU_ADDRESS 0x8FED28 /end MEASUREMENT
/begin MEASUREMENT EGRVlv_rEGRByp_mp "Bypass-Label, Kopie von EGRVlv_rEGR" SWORD Prc 1 100 -400.0000 399.9878 FORMAT "%8.4" ECU_ADDRESS 0x8FED2A /end MEASUREMENT
/begin MEASUREMENT EGSys_AlpEGTube_mp "Wärmeübertragungskoeffizient zwischen Abgas und Abgasrohr" SWORD ThermalCoEff 1 100 -3276.800 3276.700 FORMAT "%8.3" ARRAY_SIZE 2 ECU_ADDRESS 0x8FEDB0 /end MEASUREMENT
/begin MEASUREMENT EGSys_AlpTubeEnv_mp "Wärmeübertragungskoeffizient zwischen Abgasrohr und Umgebung" SWORD ThermalCoEff 1 100 -3276.800 3276.700 FORMAT "%8.3" ARRAY_SIZE 2 ECU_ADDRESS 0x8FEDB4 /end MEASUREMENT
/begin MEASUREMENT EGSys_cndHtEGi_mp "Wärmeleitfähigkeit Abgas im Rohr" SWORD Fact 1 100 -4.000000 3.999878 FORMAT "%8.6" ARRAY_SIZE 2 ECU_ADDRESS 0x8FEDB8 /end MEASUREMENT
/begin MEASUREMENT EGSys_cndHtEGo_mp "Wärmeleitfähigkeit Luft ausserhalb des Rohres" SWORD Fact 1 100 -4.000000 3.999878 FORMAT "%8.6" ARRAY_SIZE 2 ECU_ADDRESS 0x8FEDBC /end MEASUREMENT
/begin MEASUREMENT EGSys_cpEGLSU_mp "Spezifische Wärmekapazität des Abgases" SWORD SpecificHeat 1 100 -3.276800 3.276700 FORMAT "%8.6" ARRAY_SIZE 1 ECU_ADDRESS 0x8FED2C /end MEASUREMENT
/begin MEASUREMENT EGSys_cpEGNSC_mp "Spezifische Wärmekapazität Abgas im NSC" SWORD SpecificHeat 1 100 -3.276800 3.276700 FORMAT "%8.6" ECU_ADDRESS 0x8FED74 /end MEASUREMENT
/begin MEASUREMENT EGSys_cpEGOxiCat_mp "Spezifische Wärmekapazität Abgas im Oxidationskatalysator" SWORD SpecificHeat 1 100 -3.276800 3.276700 FORMAT "%8.6" ECU_ADDRESS 0x8FED7C /end MEASUREMENT
/begin MEASUREMENT EGSys_cpEGTrbn_mp "Spezifische Wärmekapazität Abgas in Turbine" SWORD SpecificHeat 1 100 -3.276800 3.276700 FORMAT "%8.6" ECU_ADDRESS 0x8FEDA4 /end MEASUREMENT
/begin MEASUREMENT EGSys_cpEGTube_mp "Spezifsche Wärmekapazität Abgas im Abgasrohr" SWORD SpecificHeat 1 100 -3.276800 3.276700 FORMAT "%8.6" ARRAY_SIZE 2 ECU_ADDRESS 0x8FEDC0 /end MEASUREMENT
/begin MEASUREMENT EGSys_ctCldStrtLSU_mp "Zähler für wiederholte Kaltstarts" UBYTE OneToOne 1 100 0.00 255.0 FORMAT "%5.1" ARRAY_SIZE 1 ECU_ADDRESS 0x6F808D /end MEASUREMENT
/begin MEASUREMENT EGSys_dmEG "näherungsweiser Abgasmassenstrom" SWORD AirMassPerTime 1 100 -3276.800 3276.700 FORMAT "%8.3" ECU_ADDRESS 0x7F8C18 /end MEASUREMENT
/begin MEASUREMENT EGSys_dtTube_mp "Temperaturänderung Abgasrohr" SWORD Temp_Kelv_Sec 1 100 -327.6800 327.6700 FORMAT "%8.4" ARRAY_SIZE 2 ECU_ADDRESS 0x8FEDC4 /end MEASUREMENT
/begin MEASUREMENT EGSys_dwFlCmb_mp "Wärmestrom durch spät nacheingespritzte Kraftstoffmenge" SLONG Pwr1 1 100 -214748364.800 214748364.700 FORMAT "%13.3" ECU_ADDRESS 0x8FED80 /end MEASUREMENT
/begin MEASUREMENT EGSys_dwLSU_mp "Abgaswärmestrom an Sondenposition" SWORD Pwr_kW_Sec 1 100 -327.6800 327.6700 FORMAT "%8.4" ARRAY_SIZE 1 ECU_ADDRESS 0x8FED2E /end MEASUREMENT
/begin MEASUREMENT EGSys_dwTubeIn_mp "Eintretender Wärmestrom Abgasrohr" SLONG Pwr1 1 100 -214748364.800 214748364.700 FORMAT "%13.3" ARRAY_SIZE 2 ECU_ADDRESS 0x8FEDC8 /end MEASUREMENT
/begin MEASUREMENT EGSys_dwTubeOut_mp "Austretender Wärmestrom Abgasrohr" SLONG Pwr1 1 100 -214748364.800 214748364.700 FORMAT "%13.3" ARRAY_SIZE 2 ECU_ADDRESS 0x8FEDD0 /end MEASUREMENT
/begin MEASUREMENT EGSys_dwTube_mp "Wärmeänderung Abgasrohr" SLONG Pwr1 1 100 -214748364.800 214748364.700 FORMAT "%13.3" ARRAY_SIZE 2 ECU_ADDRESS 0x8FEDD8 /end MEASUREMENT
/begin MEASUREMENT EGSys_etaChrg_mp "Gesamtwirkungsgrad Turbolader" SWORD Fact 1 100 -4.000000 3.999878 FORMAT "%8.6" ECU_ADDRESS 0x8FEDA6 /end MEASUREMENT
/begin MEASUREMENT EGSys_facAirMass_mp "Luftmassen-Korrekturfaktor für stationäre Abgaskrümmertemperatur" SWORD Fact 1 100 -4.000000 3.999878 FORMAT "%8.6" ECU_ADDRESS 0x8FED62 /end MEASUREMENT
/begin MEASUREMENT EGSys_facPT1Chrg_mp "Variabler Faktor für thermische Zeitkonstante Lader" SWORD Fact_PT1 1 100 -256.0000 255.9922 FORMAT "%8.4" ECU_ADDRESS 0x8FEDA8 /end MEASUREMENT
/begin MEASUREMENT EGSys_facStrtDlv_mp "Förderbeginn-Korrekturfaktor für stationäre Abgaskrümmertemperatur" SWORD Fact 1 100 -4.000000 3.999878 FORMAT "%8.6" ECU_ADDRESS 0x8FED64 /end MEASUREMENT
/begin MEASUREMENT EGSys_NuTubeEnv_mp "Nusselt-Zahl Aussenumströmung Abgasrohr" SWORD OneToOne 1 100 -32768.00 32767.00 FORMAT "%8.2" ARRAY_SIZE 2 ECU_ADDRESS 0x8FEDE0 /end MEASUREMENT
/begin MEASUREMENT EGSys_NuTube_mp "Nusselt-Zahl im Abgasrohr" SWORD OneToOne 1 100 -32768.00 32767.00 FORMAT "%8.2" ARRAY_SIZE 2 ECU_ADDRESS 0x8FEDE4 /end MEASUREMENT
/begin MEASUREMENT EGSys_pExhGas "Abgasgegendruck" SWORD Pres_hPa 1 100 -32768.00 32767.00 FORMAT "%8.2" ARRAY_SIZE 1 ECU_ADDRESS 0x7F8C1A /end MEASUREMENT
/begin MEASUREMENT EGSys_phiDiffStrt_mp "Differenz zwischen Förderbeginn im Auslegungspunkt und aktuellem Wert" SWORD AngleCrS 1 100 -768.0000 767.9766 FORMAT "%8.4" ECU_ADDRESS 0x8FED66 /end MEASUREMENT
/begin MEASUREMENT EGSys_pwrCmpr_mp "Verdichterleistung" SWORD Pwr 1 100 -308831.1 308821.7 FORMAT "%8.1" ECU_ADDRESS 0x8FEDAA /end MEASUREMENT
/begin MEASUREMENT EGSys_qMIStd "Vor- und haupteingespritzte Kraftstoffmenge (im Brennraum verbrannt)" SWORD InjMassCyc 1 100 -327.6800 327.6700 FORMAT "%8.4" ECU_ADDRESS 0x7F8C1C /end MEASUREMENT
/begin MEASUREMENT EGSys_qPoIRgn "Spät nacheingespritzte Kraftstoffmenge (nicht im Brennraum verbrannt)" SWORD InjMassInj 1 100 -327.6800 327.6700 FORMAT "%8.4" ECU_ADDRESS 0x7F8C1E /end MEASUREMENT
/begin MEASUREMENT EGSys_rAirPerTime_mp "Verhältnis Luftmassenstrom im Auslegungspunkt zu aktuellem Wert" SWORD Fact 1 100 -4.000000 3.999878 FORMAT "%8.6" ECU_ADDRESS 0x8FED68 /end MEASUREMENT
/begin MEASUREMENT EGSys_ReTubeEnvInpCrv_mp "Messpunkt Eingangswert Kurve EGSys_NuTubeEnv_CUR" SWORD OneToOne 1 100 -32768.00 32767.00 FORMAT "%8.2" ECU_ADDRESS 0x8FEDE8 /end MEASUREMENT
/begin MEASUREMENT EGSys_ReTubeEnv_mp "Reynolds-Zahl Aussenumströmung Abgasrohr" SWORD OneToOne 1 100 -32768.00 32767.00 FORMAT "%8.2" ARRAY_SIZE 2 ECU_ADDRESS 0x8FEDEA /end MEASUREMENT
/begin MEASUREMENT EGSys_ReTubeInpCrv_mp "Messpunkt Eingang Kurve EGSys_NuTube_CUR" SWORD ReynoldsNum 1 100 -3276800. 3276700. FORMAT "%8.0" ECU_ADDRESS 0x8FEDEE /end MEASUREMENT
/begin MEASUREMENT EGSys_ReTube_mp "Reynolds-Zahl im Abgasrohr" SWORD ReynoldsNum 1 100 -3276800. 3276700. FORMAT "%8.0" ARRAY_SIZE 2 ECU_ADDRESS 0x8FEDF0 /end MEASUREMENT
/begin MEASUREMENT EGSys_rLmbdAprx "näherungsweiser Lambda-Wert" SWORD lambda 1 100 -32.76800 32.76700 FORMAT "%8.5" ECU_ADDRESS 0x7F8C20 /end MEASUREMENT
/begin MEASUREMENT EGSys_rPresCmpr_mp "Verdichterdruckverhältnis" SWORD Fact 1 100 -4.000000 3.999878 FORMAT "%8.6" ECU_ADDRESS 0x8FEDAC /end MEASUREMENT
/begin MEASUREMENT EGSys_rTempClnt_mp "Verhältnis Motorübertemperatur Motorstart / -stop" SWORD Fact 1 100 -4.000000 3.999878 FORMAT "%8.6" ECU_ADDRESS 0x8FED90 /end MEASUREMENT
/begin MEASUREMENT EGSys_rTimeNSC_mp "Verhältnis Standzeit zu Halbwertszeit NSC" SWORD Fact1 1 100 -256.0000 255.9922 FORMAT "%8.4" ECU_ADDRESS 0x8FED92 /end MEASUREMENT
/begin MEASUREMENT EGSys_rTimeOxiCat_mp "Verhältnis Standzeit zu Halbwertszeit Oxidationskatalysator" SWORD Fact1 1 100 -256.0000 255.9922 FORMAT "%8.4" ECU_ADDRESS 0x8FED94 /end MEASUREMENT
/begin MEASUREMENT EGSys_rTimeTrb_mp "Verhältnis-Stillstand-Zeit / Halbzeit-Periode turbocharger" SWORD Fact1 1 100 -256.0000 255.9922 FORMAT "%8.4" ECU_ADDRESS 0x8FED96 /end MEASUREMENT
/begin MEASUREMENT EGSys_rTimeTube_mp "Verhältnis Standzeit zu Halbwertszeit Abgasrohr" SWORD Fact1 1 100 -256.0000 255.9922 FORMAT "%8.4" ARRAY_SIZE 2 ECU_ADDRESS 0x8FED8C /end MEASUREMENT
/begin MEASUREMENT EGSys_sqTube_mp "Oberfläche Abgasrohr" SWORD Area 1 100 -4.000000 3.999878 FORMAT "%8.6" ARRAY_SIZE 2 ECU_ADDRESS 0x8FEDF4 /end MEASUREMENT
/begin MEASUREMENT EGSys_stHtgLSU "Statusbit Freigabe Sensor-Heizung" UBYTE OneToOne 1 100 0.00 255.0 FORMAT "%5.1" ARRAY_SIZE 1 ECU_ADDRESS 0x7F885F /end MEASUREMENT
/begin MEASUREMENT EGSys_stHtgLSULstTrp_mp "Status der Taupunktfreigabe des letzten Fahrzyklus" UBYTE OneToOne 1 100 0.00 255.0 FORMAT "%5.1" ARRAY_SIZE 1 ECU_ADDRESS 0x8FED30 /end MEASUREMENT
/begin MEASUREMENT EGSys_stHtgThresLSUHit_mp "Statusmessage für Überschreiten des Wärmemengenschwellwertes" UBYTE OneToOne 1 100 0.00 255.0 FORMAT "%5.1" ARRAY_SIZE 1 ECU_ADDRESS 0x8FED31 /end MEASUREMENT
/begin MEASUREMENT EGSys_stIntegIni_mp "Status Integrator Initialisierung" UBYTE OneToOne 1 100 0.00 255.0 FORMAT "%5.1" ARRAY_SIZE 1 ECU_ADDRESS 0x8FED32 /end MEASUREMENT
/begin MEASUREMENT EGSys_stPlsLSU_mp "Status-Bit gültiger Gaspuls" UBYTE OneToOne 1 100 0.00 255.0 FORMAT "%5.1" ARRAY_SIZE 1 ECU_ADDRESS 0x8FED33 /end MEASUREMENT
/begin MEASUREMENT EGSys_tAvrgEGTrbn_mp "Mittlere Abgastemperatur in Turbine" SWORD Temp_Cels 1 100 -50.140 899.860 FORMAT "%8.3" ECU_ADDRESS 0x8FEDAE /end MEASUREMENT
/begin MEASUREMENT EGSys_tAvrgEGTube_mp "Mittlere Abgastemperatur im Abgasrohr" SWORD Temp_Cels 1 100 -50.140 899.860 FORMAT "%8.3" ARRAY_SIZE 2 ECU_ADDRESS 0x8FEDF8 /end MEASUREMENT
/begin MEASUREMENT EGSys_tAvrgNSC_mp "Mittlere Temperatur NSC" SWORD Temp_Cels 1 100 -50.140 899.860 FORMAT "%8.3" ECU_ADDRESS 0x8FED76 /end MEASUREMENT
/begin MEASUREMENT EGSys_tAvrgOxiCat_mp "Mittlere Temperatur Oxidationskatalysator" SWORD Temp_Cels 1 100 -50.140 899.860 FORMAT "%8.3" ECU_ADDRESS 0x8FED84 /end MEASUREMENT
/begin MEASUREMENT EGSys_tCorrIAT_mp "Temperaturoffset aufgrund Schwankungen der Ansauglufttemperatur" SWORD TempDiff_Cels 1 100 -3276.800 3276.700 FORMAT "%8.3" ECU_ADDRESS 0x8FED6A /end MEASUREMENT
/begin MEASUREMENT EGSys_tCorrManf_mp "Temperaturoffset Krümmer bei kaltem Motor" SWORD TempDiff_Cels 1 100 -3276.800 3276.700 FORMAT "%8.3" ECU_ADDRESS 0x8FED6C /end MEASUREMENT
/begin MEASUREMENT EGSys_tDiffCldEng_mp "Abweichung aktuelle Motortemperatur von stationärem Wert" SWORD TempDiff_Cels 1 100 -3276.800 3276.700 FORMAT "%8.3" ECU_ADDRESS 0x8FED6E /end MEASUREMENT
/begin MEASUREMENT EGSys_tDiffEGTube_mp "Temperaturdifferenz Abgas / Abgasrohr" SWORD TempDiff_Cels 1 100 -3276.800 3276.700 FORMAT "%8.3" ARRAY_SIZE 2 ECU_ADDRESS 0x8FEDFC /end MEASUREMENT
/begin MEASUREMENT EGSys_tDiffIAT_mp "Differenz zwischen Ansaulglufttemperatur im Auslegungspunkt und aktuellem Wert" SWORD TempDiff_Cels 1 100 -3276.800 3276.700 FORMAT "%8.3" ECU_ADDRESS 0x8FED70 /end MEASUREMENT
/begin MEASUREMENT EGSys_tDiffTubeEnv_mp "Temperaturdifferenz Abgasrohr / Umgebung" SWORD TempDiff_Cels 1 100 -3276.800 3276.700 FORMAT "%8.3" ARRAY_SIZE 2 ECU_ADDRESS 0x8FEE00 /end MEASUREMENT
/begin MEASUREMENT EGSys_tEGLSU "Abgas-Temperatur an Sensor-Position" SWORD Temp_Cels 1 100 -50.140 899.860 FORMAT "%8.3" ARRAY_SIZE 1 ECU_ADDRESS 0x7F8C22 /end MEASUREMENT
/begin MEASUREMENT EGSys_tEGLSUInpCrv0_mp "Messpunkt Eingang der Kennlinien" SWORD Temp_Cels 1 100 -50.140 899.860 FORMAT "%8.3" ECU_ADDRESS 0x8FED3C /end MEASUREMENT
/begin MEASUREMENT EGSys_tEGLSUInpCrv1_mp "Messpunkt Eingang des Kennfeldes EGSys_wTresLSU1_MAP" SWORD Temp_Cels 1 100 -50.140 899.860 FORMAT "%8.3" ECU_ADDRESS 0x8FED3E /end MEASUREMENT
/begin MEASUREMENT EGSys_tEGLSUInpCrv2_mp "Messpunkt Eingang des Kennfeldes EGSys_wTresLSU2_MAP" SWORD Temp_Cels 1 100 -50.140 899.860 FORMAT "%8.3" ECU_ADDRESS 0x8FED40 /end MEASUREMENT
/begin MEASUREMENT EGSys_tEGLSUInpCrv3_mp "Messpunkt Eingang des Kennfeldes EGSys_wTresLSU3_MAP" SWORD Temp_Cels 1 100 -50.140 899.860 FORMAT "%8.3" ECU_ADDRESS 0x8FED42 /end MEASUREMENT
/begin MEASUREMENT EGSys_tEGPreNSC "Abgastemperatur am NSC-Eintritt" SWORD Temp_Cels 1 100 -50.140 899.860 FORMAT "%8.3" ECU_ADDRESS 0x7F8C24 /end MEASUREMENT
/begin MEASUREMENT EGSys_tEGPreOxiCat "Abgastemperatur am Oxidationskatalysator-Eintritt" SWORD Temp_Cels 1 100 -50.140 899.860 FORMAT "%8.3" ECU_ADDRESS 0x7F8C26 /end MEASUREMENT
/begin MEASUREMENT EGSys_tEGPreTrbn "Abgas-Temperatur vor Turbine" SWORD Temp_Cels 1 100 -50.140 899.860 FORMAT "%8.3" ECU_ADDRESS 0x7F8C28 /end MEASUREMENT
/begin MEASUREMENT EGSys_tEGPreTube "Abgastemperatur am Abgasrohr-Eintritt" SWORD Temp_Cels 1 100 -50.140 899.860 FORMAT "%8.3" ARRAY_SIZE 2 ECU_ADDRESS 0x7F91B4 /end MEASUREMENT
/begin MEASUREMENT EGSys_tEGPstTrbn "Abgas-Temperatur nach Turbolader" SWORD Temp_Cels 1 100 -50.140 899.860 FORMAT "%8.3" ECU_ADDRESS 0x7F8C2A /end MEASUREMENT
/begin MEASUREMENT EGSys_tEGPstTube "Abgastemperatur am Abgasrohr-Auslass" SWORD Temp_Cels 1 100 -50.140 899.860 FORMAT "%8.3" ARRAY_SIZE 2 ECU_ADDRESS 0x7F91B8 /end MEASUREMENT
/begin MEASUREMENT EGSys_tExcClntStrtCs_mp "Motorübertemperatur bei Motorstart" SWORD TempDiff_Cels 1 100 -3276.800 3276.700 FORMAT "%8.3" ECU_ADDRESS 0x8FED98 /end MEASUREMENT
/begin MEASUREMENT EGSys_tiClg_mp "Abkühlzeit" ULONG Time_s 1 100 0.00 42949672.9500 FORMAT "%13.4" ECU_ADDRESS 0x8FED9C /end MEASUREMENT
/begin MEASUREMENT EGSys_tIncrPoI_mp "Temperaturerhöhung im Oxidationskatalysator aufgrund später Nacheinspritzung" SWORD TempDiff_Cels 1 100 -3276.800 3276.700 FORMAT "%8.3" ECU_ADDRESS 0x8FED86 /end MEASUREMENT
/begin MEASUREMENT EGSys_tiRefClg_mp "Referenz-Abkühlzeit aus Motor-Abkühlung" ULONG Time_s 1 100 0.00 42949672.9500 FORMAT "%13.4" ECU_ADDRESS 0x8FEDA0 /end MEASUREMENT
/begin MEASUREMENT EGSys_tManfStat "stationäre Abgastemperatur im Abgaskrümmer" SWORD Temp_Cels 1 100 -50.140 899.860 FORMAT "%8.3" ECU_ADDRESS 0x7F8C2C /end MEASUREMENT
/begin MEASUREMENT EGSys_tManfStat_mp "stationäre Abgastemperatur im Abgaskrümmer ohne Korrekturen" SWORD Temp_Cels 1 100 -50.140 899.860 FORMAT "%8.3" ECU_ADDRESS 0x8FED72 /end MEASUREMENT
/begin MEASUREMENT EGSys_tMem_mp "Zwischenspeicher für Temperaturen" SWORD Temp_Cels 1 100 -50.140 899.860 FORMAT "%8.3" ARRAY_SIZE 14 ECU_ADDRESS 0x8FED44 /end MEASUREMENT
/begin MEASUREMENT EGSys_tMidEGTube_mp "Mittlere Temperatur zwischen Abgas und Abgasrohrwand" SWORD Temp_Cels 1 100 -50.140 899.860 FORMAT "%8.3" ARRAY_SIZE 2 ECU_ADDRESS 0x8FEE04 /end MEASUREMENT
/begin MEASUREMENT EGSys_tMidTubeEnv_mp "Mittlere Temperatur zwischen Abgasrohr und Umgebung" SWORD Temp_Cels 1 100 -50.140 899.860 FORMAT "%8.3" ARRAY_SIZE 2 ECU_ADDRESS 0x8FEE08 /end MEASUREMENT
/begin MEASUREMENT EGSys_tNSC "Temperatur NSC (Austritt)" SWORD Temp_Cels 1 100 -50.140 899.860 FORMAT "%8.3" ECU_ADDRESS 0x7F8C2E /end MEASUREMENT
/begin MEASUREMENT EGSys_tNSCExoIncr_mp "Temperaturerhöhung im NSC durch chemische Reaktionen" SWORD TempDiff_Cels 1 100 -3276.800 3276.700 FORMAT "%8.3" ECU_ADDRESS 0x8FED78 /end MEASUREMENT
/begin MEASUREMENT EGSys_tNSCStat_mp "Stationäre Temperatur NSC" SWORD Temp_Cels 1 100 -50.140 899.860 FORMAT "%8.3" ECU_ADDRESS 0x8FED7A /end MEASUREMENT
/begin MEASUREMENT EGSys_tNSCStrtCs "Temperatur NSC bei Motorstart" SWORD Temp_Cels 1 100 -50.140 899.860 FORMAT "%8.3" ECU_ADDRESS 0x7F8C30 /end MEASUREMENT
/begin MEASUREMENT EGSys_tOxiCat "Temperatur Oxidationskatalysator (Austritt)" SWORD Temp_Cels 1 100 -50.140 899.860 FORMAT "%8.3" ECU_ADDRESS 0x7F8C32 /end MEASUREMENT
/begin MEASUREMENT EGSys_tOxiCatExoIncr_mp "Temperaturerhöhung im Oxidationskatalysator durch chemische Reaktionen" SWORD TempDiff_Cels 1 100 -3276.800 3276.700 FORMAT "%8.3" ECU_ADDRESS 0x8FED88 /end MEASUREMENT
/begin MEASUREMENT EGSys_tOxiCatStat_mp "Stationäre Temperatur Oxidationskatalysator" SWORD Temp_Cels 1 100 -50.140 899.860 FORMAT "%8.3" ECU_ADDRESS 0x8FED8A /end MEASUREMENT
/begin MEASUREMENT EGSys_tOxiCatStrtCs "Temperatur Oxidationskatalysator bei Motorstart" SWORD Temp_Cels 1 100 -50.140 899.860 FORMAT "%8.3" ECU_ADDRESS 0x7F8C34 /end MEASUREMENT
/begin MEASUREMENT EGSys_tShOffTExcClnt_mp "Motorübertemperature bei Motorstop" SWORD TempDiff_Cels 1 100 -3276.800 3276.700 FORMAT "%8.3" ECU_ADDRESS 0x8FED60 /end MEASUREMENT
/begin MEASUREMENT EGSys_tTrbStrtCs "Turbocharger Temperatur an Maschinenanfang" SWORD Temp_Cels 1 100 -50.140 899.860 FORMAT "%8.3" ECU_ADDRESS 0x7F8C36 /end MEASUREMENT
/begin MEASUREMENT EGSys_tTube "Wandtemperatur Abgasrohr" SWORD Temp_Cels 1 100 -50.140 899.860 FORMAT "%8.3" ARRAY_SIZE 2 ECU_ADDRESS 0x7F91BC /end MEASUREMENT
/begin MEASUREMENT EGSys_tTubeStrtCs "Temperatur Abgasrohr bei Motorstart" SWORD Temp_Cels 1 100 -50.140 899.860 FORMAT "%8.3" ARRAY_SIZE 2 ECU_ADDRESS 0x7F91C0 /end MEASUREMENT
/begin MEASUREMENT EGSys_tWallLSU "Wandtemperatur am Sondeneinbauort" SWORD Temp_Cels 1 100 -50.140 899.860 FORMAT "%8.3" ARRAY_SIZE 1 ECU_ADDRESS 0x7F8C38 /end MEASUREMENT
/begin MEASUREMENT EGSys_wLSU_mp " integrierte Wärmemenge an Sensor-Position." SWORD Energy 1 100 -32768.00 32767.00 FORMAT "%8.2" ARRAY_SIZE 1 ECU_ADDRESS 0x6F808E /end MEASUREMENT
/begin MEASUREMENT EGSys_wThresLSUAct_mp "aktueller Wärmeschwellwert an Sensorposition." SWORD Energy 1 100 -32768.00 32767.00 FORMAT "%8.2" ARRAY_SIZE 1 ECU_ADDRESS 0x8FED34 /end MEASUREMENT
/begin MEASUREMENT EGSys_wThresLSUNoPls_mp "Hitzeschwelle ohne gültigen Gaspuls." SWORD Energy 1 100 -32768.00 32767.00 FORMAT "%8.2" ARRAY_SIZE 1 ECU_ADDRESS 0x8FED36 /end MEASUREMENT
/begin MEASUREMENT EGSys_wThresLSUPls_mp "Hitzeschwelle für gültigen Gaspuls" SWORD Energy 1 100 -32768.00 32767.00 FORMAT "%8.2" ARRAY_SIZE 1 ECU_ADDRESS 0x8FED38 /end MEASUREMENT
/begin MEASUREMENT EGSys_wThresLSU_mp "Grundlegender Wert-Hitzeschwelle-Sensor" SWORD Energy 1 100 -32768.00 32767.00 FORMAT "%8.2" ARRAY_SIZE 1 ECU_ADDRESS 0x8FED3A /end MEASUREMENT
/begin MEASUREMENT EGT_facRmpVal "Zentraler Rampenwert (drehzahlsynchron)" SWORD EGTSwt_S16 1 100 -2.000000 1.999939 FORMAT "%8.6" ECU_ADDRESS 0x7F8C3A /end MEASUREMENT
/begin MEASUREMENT EGT_facRmpValTempGvnr_mp "aktueller Rampenwert des EGT Temperaturreglers" ULONG EGTSwt 1 100 0.00 262.143999939 FORMAT "%13.9" ECU_ADDRESS 0x8FEE48 /end MEASUREMENT
/begin MEASUREMENT EGT_facRmp_mp "Rampenwert für Umwandlung 32bit -> 16bit" SWORD EGTSwt_S16 1 100 -2.000000 1.999939 FORMAT "%8.6" ECU_ADDRESS 0x8FEE4C /end MEASUREMENT
/begin MEASUREMENT EGT_mAirDesInrTempGvnr "Additive Luftmassensollwertkorrektur" SWORD AirMassPerCyl 1 100 -3276.800 3276.700 FORMAT "%8.3" ECU_ADDRESS 0x7F8C3C /end MEASUREMENT
/begin MEASUREMENT EGT_mAirDesTempGvnr "Temperaturreglerkorrektur für den Luftmassensollwert" SWORD AirMassPerCyl 1 100 -3276.800 3276.700 FORMAT "%8.3" ECU_ADDRESS 0x7F8C3E /end MEASUREMENT
/begin MEASUREMENT EGT_mAirLmbdTempGvnr_mp "Luftmassenkorrektur durch Lambda" SWORD AirMassPerCyl 1 100 -3276.800 3276.700 FORMAT "%8.3" ECU_ADDRESS 0x8FEE4E /end MEASUREMENT
/begin MEASUREMENT EGT_mAirTempGvnrMin_mp "Minimal mögliche Luftmassensollwertkorrektur" SWORD AirMassPerCyl 1 100 -3276.800 3276.700 FORMAT "%8.3" ECU_ADDRESS 0x8FEE1C /end MEASUREMENT
/begin MEASUREMENT EGT_mAirTempGvnrRng_mp "Korrekturbereich der Luftmassensollwertkorrektur" SWORD AirMassPerCyl 1 100 -3276.800 3276.700 FORMAT "%8.3" ECU_ADDRESS 0x8FEE1E /end MEASUREMENT
/begin MEASUREMENT EGT_phiPoI1TempGvnr "Additive Winkelkorrektur der verzögerten Nacheinspritzung" SWORD AngleCrS 1 100 -768.0000 767.9766 FORMAT "%8.4" ECU_ADDRESS 0x7F8C40 /end MEASUREMENT
/begin MEASUREMENT EGT_qHCTempGvnr "Additive Einpritzmengenkorrektur des HC-Dosierventils" SWORD InjMassInj 1 100 -327.6800 327.6700 FORMAT "%8.4" ECU_ADDRESS 0x7F8C42 /end MEASUREMENT
/begin MEASUREMENT EGT_qPoI1Min_mp "Minimal erlaubte Korrektur der angelagerten Nacheinspritzung" SWORD InjMassInj 1 100 -327.6800 327.6700 FORMAT "%8.4" ECU_ADDRESS 0x8FEE20 /end MEASUREMENT
/begin MEASUREMENT EGT_qPoI1OutrTempGvnr "Additive Korrektur der angelagerten Nacheinspritzung" SWORD InjMassInj 1 100 -327.6800 327.6700 FORMAT "%8.4" ECU_ADDRESS 0x7F8C44 /end MEASUREMENT
/begin MEASUREMENT EGT_qPoI1Rng_mp "Korrekturbereich der angelagerten Nacheinspritzung" SWORD InjMassInj 1 100 -327.6800 327.6700 FORMAT "%8.4" ECU_ADDRESS 0x8FEE22 /end MEASUREMENT
/begin MEASUREMENT EGT_qPoI1TempGvnr "EGT Temperaturregler PoI1 Menge während einer Regeneration" SWORD InjMassInj 1 100 -327.6800 327.6700 FORMAT "%8.4" ECU_ADDRESS 0x7F8C46 /end MEASUREMENT
/begin MEASUREMENT EGT_qPoI2InrTempGvnr "Additive fortgeschrittene Nacheinspritzmengenkorrektur" SWORD InjMassInj 1 100 -327.6800 327.6700 FORMAT "%8.4" ECU_ADDRESS 0x7F8C48 /end MEASUREMENT
/begin MEASUREMENT EGT_qPoI2Min_mp "Minimal erlaubte Korrekturmenge der angelagerten Nacheinspritzung" SWORD InjMassInj 1 100 -327.6800 327.6700 FORMAT "%8.4" ECU_ADDRESS 0x8FEE24 /end MEASUREMENT
/begin MEASUREMENT EGT_qPoI2Rng_mp "Korrekturbereich der Einpritzmengenkorrektur" SWORD InjMassInj 1 100 -327.6800 327.6700 FORMAT "%8.4" ECU_ADDRESS 0x8FEE26 /end MEASUREMENT
/begin MEASUREMENT EGT_qPoI2TempGvnr "EGT Temperaturreglerkorrektur der angelagerten Nacheinspritzung 2 während einer Partikelfilterregeneration" SWORD InjMassInj 1 100 -327.6800 327.6700 FORMAT "%8.4" ECU_ADDRESS 0x7F8C4A /end MEASUREMENT
/begin MEASUREMENT EGT_rIInrTempGvnr_mp "Reglerausgang des inneren Regelkreises: I-Anteil" SWORD EGTFact 1 100 -32.76800 32.76700 FORMAT "%8.5" ECU_ADDRESS 0x8FEE28 /end MEASUREMENT
/begin MEASUREMENT EGT_rInrTempGvnr_mp "Reglerausgang des inneren Regelkreises" SWORD EGTFact 1 100 -32.76800 32.76700 FORMAT "%8.5" ECU_ADDRESS 0x8FEE2A /end MEASUREMENT
/begin MEASUREMENT EGT_rIOutrTempGvnr_mp "Reglerausgang der äußeren Regelkreises: I-Anteil" SWORD EGTFact 1 100 -32.76800 32.76700 FORMAT "%8.5" ECU_ADDRESS 0x8FEE2C /end MEASUREMENT
/begin MEASUREMENT EGT_rOutrTempGvnr_mp "Regelerausgang des äußeren Regelkreises" SWORD EGTFact 1 100 -32.76800 32.76700 FORMAT "%8.5" ECU_ADDRESS 0x8FEE2E /end MEASUREMENT
/begin MEASUREMENT EGT_rPInrTempGvnr_mp "Regelerausgnag des inneren Regelkreises: P-Anteil" SWORD EGTFact 1 100 -32.76800 32.76700 FORMAT "%8.5" ECU_ADDRESS 0x8FEE30 /end MEASUREMENT
/begin MEASUREMENT EGT_rPOutrTempGvnr_mp "Reglerausgang des äußeren Regelkreises: P-Anteil" SWORD EGTFact 1 100 -32.76800 32.76700 FORMAT "%8.5" ECU_ADDRESS 0x8FEE32 /end MEASUREMENT
/begin MEASUREMENT EGT_rStyInrTempGvnr_mp "Modellierten stationärer Reglerausgang des inneren Regelkreises" SWORD EGTFact 1 100 -32.76800 32.76700 FORMAT "%8.5" ECU_ADDRESS 0x8FEE34 /end MEASUREMENT
/begin MEASUREMENT EGT_rStyOutrTempGvnr_mp "Modellierter stationärer Reglerausgang des äußeren Regelkreises" SWORD EGTFact 1 100 -32.76800 32.76700 FORMAT "%8.5" ECU_ADDRESS 0x8FEE36 /end MEASUREMENT
/begin MEASUREMENT EGT_st "Regenerationsanforderung für Abgasnachbehandlung (drehzahlsynchron)" ULONG OneToOne 1 100 0.00 4294967295.00 FORMAT "%13.2" ECU_ADDRESS 0x7F91C4 /end MEASUREMENT
/begin MEASUREMENT EGT_stClsThrVlv_mp "Maximale Androsselung aktiv" UBYTE OneToOne 1 100 0.00 255.0 FORMAT "%5.1" ECU_ADDRESS 0x8FEE38 /end MEASUREMENT
/begin MEASUREMENT EGT_stCoRgn "Innerer Zustand des Regenerationskoordinator (drehzahlsynchron)" UBYTE OneToOne 1 100 0.00 255.0 FORMAT "%5.1" ECU_ADDRESS 0x7F8860 /end MEASUREMENT
/begin MEASUREMENT EGT_stCoRgnOld_mp "Alter Wert für den inneren Zustand des Regenerationkoordinators" UBYTE OneToOne 1 100 0.00 255.0 FORMAT "%5.1" ECU_ADDRESS 0x8FEE0C /end MEASUREMENT
/begin MEASUREMENT EGT_stCoRgnTSync "Innerer Zustand des Regenerationskoordinator (zeitsynchron)" UBYTE OneToOne 1 100 0.00 255.0 FORMAT "%5.1" ECU_ADDRESS 0x7F8861 /end MEASUREMENT
/begin MEASUREMENT EGT_stDel "Verzögerte Regenerationsanforderung für Abgasnachbehandlung (drehzahl synchron)" UBYTE OneToOne 1 100 0.00 255.0 FORMAT "%5.1" ECU_ADDRESS 0x7F91C8 /end MEASUREMENT
/begin MEASUREMENT EGT_stLck "Status EGT_stTSync-Kopiervorgang (drehzahlsynchron)" UBYTE OneToOne 1 100 0.00 255.0 FORMAT "%5.1" ECU_ADDRESS 0x7F8862 /end MEASUREMENT
/begin MEASUREMENT EGT_stRgnOilDil_mp "Status Bit Bedingungen erfüllt für Ölverdünnung" UBYTE OneToOne 1 100 0.00 255.0 FORMAT "%5.1" ECU_ADDRESS 0x8FEE0D /end MEASUREMENT
/begin MEASUREMENT EGT_stTempGvnr "Status des Abgastemperaturreglers" UWORD OneToOne 1 100 0.00 65535.00 FORMAT "%8.2" ECU_ADDRESS 0x7F8C4C /end MEASUREMENT
/begin MEASUREMENT EGT_stTSync "Regenerationsanforderung für Abgasnachbehandlung (zeitsynchron)" ULONG OneToOne 1 100 0.00 4294967295.00 FORMAT "%13.2" ECU_ADDRESS 0x7F91CC /end MEASUREMENT
/begin MEASUREMENT EGT_stTSyncDes_mp "Regeneration demand for exhaust gas treatment for state machine" ULONG OneToOne 1 100 0.00 4294967295.00 FORMAT "%13.2" ECU_ADDRESS 0x8FEE10 /end MEASUREMENT
/begin MEASUREMENT EGT_stTSyncLck "Status Kopieren der Regenerationsanforderung (zeit-synchron)" UBYTE OneToOne 1 100 0.00 255.0 FORMAT "%5.1" ECU_ADDRESS 0x7F8863 /end MEASUREMENT
/begin MEASUREMENT EGT_swtRgnLck_mp "Schalter zur Unterdrückung der Regenerationsmaßnahmen" UBYTE OneToOne 1 100 0.00 255.0 FORMAT "%5.1" ECU_ADDRESS 0x8FEE14 /end MEASUREMENT
/begin MEASUREMENT EGT_tInrBiTrb "Temperatur des inneren Reglers für Bi-Turbo Motoren." SWORD Temp_Cels 1 100 -50.140 899.860 FORMAT "%8.3" ECU_ADDRESS 0x7F8C4E /end MEASUREMENT
/begin MEASUREMENT EGT_tInrCorMax_mp "Maximal erlaubte Korrektur des inneren Regelkreises" SWORD TempDiff_Cels 1 100 -3276.800 3276.700 FORMAT "%8.3" ECU_ADDRESS 0x8FEE3A /end MEASUREMENT
/begin MEASUREMENT EGT_tInrCorRng_mp "Korrekturbereich der Sollwertkorrektur des inneren Regelkreises" SWORD TempDiff_Cels 1 100 -3276.800 3276.700 FORMAT "%8.3" ECU_ADDRESS 0x8FEE3C /end MEASUREMENT
/begin MEASUREMENT EGT_tInrDesCorBiTrb "Vorgabe Korrekturwert des inneren Reglers für Bi_Turbo Motoren" SWORD Temp_Cels 1 100 -50.140 899.860 FORMAT "%8.3" ECU_ADDRESS 0x7F8C50 /end MEASUREMENT
/begin MEASUREMENT EGT_tInrDesCorTempGvnr "Solllwertkorrektur der inneren Kaskade" SWORD TempDiff_Cels 1 100 -3276.800 3276.700 FORMAT "%8.3" ECU_ADDRESS 0x7F8C52 /end MEASUREMENT
/begin MEASUREMENT EGT_tInrDesInTempGvnr "Kundenspezifischer Temperaturvorgabewert des inneren Reglers." SWORD Temp_Cels 1 100 -50.140 899.860 FORMAT "%8.3" ECU_ADDRESS 0x7F8C54 /end MEASUREMENT
/begin MEASUREMENT EGT_tInrDesTempGvnr "Sollwert für den inneren Abgastemperaturregelkreis" SWORD Temp_Cels 1 100 -50.140 899.860 FORMAT "%8.3" ECU_ADDRESS 0x7F8C56 /end MEASUREMENT
/begin MEASUREMENT EGT_tInrDvtTempGvnr_mp "Reglerabweichung des inneren Regelkreises" SWORD TempDiff_Cels 1 100 -3276.800 3276.700 FORMAT "%8.3" ECU_ADDRESS 0x8FEE3E /end MEASUREMENT
/begin MEASUREMENT EGT_tInrTempGvnr "Aktueller Wert des inneren Abgastemperaturreglers" SWORD Temp_Cels 1 100 -50.140 899.860 FORMAT "%8.3" ECU_ADDRESS 0x7F8C58 /end MEASUREMENT
/begin MEASUREMENT EGT_tiPoI1ActvCnt_mp "Wartezeit aktive PoI1" ULONG Time_s 1 100 0.00 42949672.9500 FORMAT "%13.4" ECU_ADDRESS 0x8FEE40 /end MEASUREMENT
/begin MEASUREMENT EGT_tiPoI2TempGvnr "Additive Einspritzzeitkorrektur" SWORD InjTime_us 1 100 -32768.00 32767.00 FORMAT "%8.2" ECU_ADDRESS 0x7F8C60 /end MEASUREMENT
/begin MEASUREMENT EGT_tiRgn "Zeit seit letzter Änderung von EGT_st (drehzahlsynchron)" ULONG Time_s 1 100 0.00 42949672.9500 FORMAT "%13.4" ECU_ADDRESS 0x7F91D0 /end MEASUREMENT
/begin MEASUREMENT EGT_tiRgnOilDil "Kritische Zeit für Ölverdünnung" ULONG Time_s 1 100 0.00 42949672.9500 FORMAT "%13.4" ECU_ADDRESS 0x7F91D4 /end MEASUREMENT
/begin MEASUREMENT EGT_tiRgnTSync "Zeit seit letzter Änderung von EGT_st (zeitsynchron)" ULONG Time_s 1 100 0.00 42949672.9500 FORMAT "%13.4" ECU_ADDRESS 0x7F91D8 /end MEASUREMENT
/begin MEASUREMENT EGT_tiRgnTSyncPre_mp "Gesamtzeit seit letzter EGT-Statusänderung" ULONG Time_s 1 100 0.00 42949672.9500 FORMAT "%13.4" ECU_ADDRESS 0x8FEE18 /end MEASUREMENT
/begin MEASUREMENT EGT_tiRmpSlpMax "Maximale Rampenlaufzeit für EGT-Mehrfachschalter" ULONG TimeEGTRmp 1 100 0.000000015258789066052715 65.536000000000001 FORMAT "%19.16" ECU_ADDRESS 0x7F91DC /end MEASUREMENT
/begin MEASUREMENT EGT_tOutrDesInTempGvnr "Kundenspezifischer Temperaturvorgabewert des äußeren Reglers." SWORD Temp_Cels 1 100 -50.140 899.860 FORMAT "%8.3" ECU_ADDRESS 0x7F8C5A /end MEASUREMENT
/begin MEASUREMENT EGT_tOutrDesTempGvnr "Sollwert des äußeren Abgastemperaturregelkreises" SWORD Temp_Cels 1 100 -50.140 899.860 FORMAT "%8.3" ECU_ADDRESS 0x7F8C5C /end MEASUREMENT
/begin MEASUREMENT EGT_tOutrDvtTempGvnr_mp "Reglerabweichung des äußeren Regelkreises" SWORD TempDiff_Cels 1 100 -3276.800 3276.700 FORMAT "%8.3" ECU_ADDRESS 0x8FEE44 /end MEASUREMENT
/begin MEASUREMENT EGT_tOutrTempGvnr "Aktueller Wert des äußeren Abgastemperaturregelkreises" SWORD Temp_Cels 1 100 -50.140 899.860 FORMAT "%8.3" ECU_ADDRESS 0x7F8C5E /end MEASUREMENT
/begin MEASUREMENT EMCCD_dcycCurrOff1_mp "Ausgang des Tastverhältnisses bei Strom AUS der EMCCD1-PWM-Endstufe bei der Strom-Regellogik" SWORD DtyCyc 1 100 -327.6800 327.6700 FORMAT "%8.4" ECU_ADDRESS 0x8FEE50 /end MEASUREMENT
/begin MEASUREMENT EMCCD_dcycCurrOff2_mp "Ausgang des Tastverhältnisses bei Strom AUS der EMCCD2-PWM-Endstufe bei der Strom-Regellogik" SWORD DtyCyc 1 100 -327.6800 327.6700 FORMAT "%8.4" ECU_ADDRESS 0x8FEE52 /end MEASUREMENT
/begin MEASUREMENT EMCCD_dcycCurrOn1_mp "Ausgang des Tastverhältnisses bei Strom EIN der EMCCD1-PWM-Endstufe bei der Strom-Regellogik" SWORD DtyCyc 1 100 -327.6800 327.6700 FORMAT "%8.4" ECU_ADDRESS 0x8FEE54 /end MEASUREMENT
/begin MEASUREMENT EMCCD_dcycCurrOn2_mp "Ausgang des Tastverhältnisses bei Strom EIN der EMCCD2-PWM-Endstufe bei der Strom-Regellogik" SWORD DtyCyc 1 100 -327.6800 327.6700 FORMAT "%8.4" ECU_ADDRESS 0x8FEE56 /end MEASUREMENT
/begin MEASUREMENT EMCCD_dcycMntCtlOut1_mp "Ausgang des Tastverhältnisses nach Begrenzung der EMCCD1-PWM-Endstufe bei der Strom-Regellogik" SWORD DtyCyc 1 100 -327.6800 327.6700 FORMAT "%8.4" ECU_ADDRESS 0x8FEE58 /end MEASUREMENT
/begin MEASUREMENT EMCCD_dcycMntCtlOut2_mp "Ausgang des Tastverhältnisses nach Begrenzung der EMCCD2-PWM-Endstufe bei der Strom-Regellogik" SWORD DtyCyc 1 100 -327.6800 327.6700 FORMAT "%8.4" ECU_ADDRESS 0x8FEE5A /end MEASUREMENT
/begin MEASUREMENT EMCCD_dcycOut1_mp "Ausgang des Tastverhältnisses ohne Begrenzung der EMCCD1-PWM-Endstufe bei der Strom-Regellogik" SWORD DtyCyc 1 100 -327.6800 327.6700 FORMAT "%8.4" ECU_ADDRESS 0x8FEE5C /end MEASUREMENT
/begin MEASUREMENT EMCCD_dcycOut2_mp "Ausgang des Tastverhältnisses ohne Begrenzung der EMCCD2-PWM-Endstufe bei der Strom-Regellogik" SWORD DtyCyc 1 100 -327.6800 327.6700 FORMAT "%8.4" ECU_ADDRESS 0x8FEE5E /end MEASUREMENT
/begin MEASUREMENT EMCCD_iActVal1 "An EMCCD1-PWM-Endstufe gemessener Strom bei der Strom-Regellogik" SWORD Curr 1 100 -32768.00 32767.00 FORMAT "%8.2" ECU_ADDRESS 0x7F8C62 /end MEASUREMENT
/begin MEASUREMENT EMCCD_iActVal2 "An EMCCD2-PWM-Endstufe gemessener Strom bei der Strom-Regellogik" SWORD Curr 1 100 -32768.00 32767.00 FORMAT "%8.2" ECU_ADDRESS 0x7F8C64 /end MEASUREMENT
/begin MEASUREMENT EMCCD_iActValFlt1_mp "An EMCCD1-PWM-Endstufe gemessener gefilterter Strom bei der Strom-Regellogik" SWORD Curr 1 100 -32768.00 32767.00 FORMAT "%8.2" ECU_ADDRESS 0x8FEE60 /end MEASUREMENT
/begin MEASUREMENT EMCCD_iActValFlt2_mp "An EMCCD2-PWM-Endstufe gemessener gefilterter Strom bei der Strom-Regellogik" SWORD Curr 1 100 -32768.00 32767.00 FORMAT "%8.2" ECU_ADDRESS 0x8FEE62 /end MEASUREMENT
/begin MEASUREMENT EMCCD_resAct1 "Widerstand bei der EMCCD1-PWM-Endstufe bei der Strom-Regellogik" SWORD Resist 1 100 -3276.800 3276.700 FORMAT "%8.3" ECU_ADDRESS 0x7F8C66 /end MEASUREMENT
/begin MEASUREMENT EMCCD_resAct2 "An EMCCD2-PWM-Endstufe gemessener Strom bei der Strom-Regellogik" SWORD Resist 1 100 -3276.800 3276.700 FORMAT "%8.3" ECU_ADDRESS 0x7F8C68 /end MEASUREMENT
/begin MEASUREMENT EMCCD_rHWE1_mp "Ausgang des Tastverhälnisses der EMCCD1-PWD-Endstufe" SWORD DtyCyc 1 100 -327.6800 327.6700 FORMAT "%8.4" ECU_ADDRESS 0x8FEE64 /end MEASUREMENT
/begin MEASUREMENT EMCCD_rHWE2_mp "Ausgang des Tastverhälnisses der EMCCD2-PWD-Endstufe" SWORD DtyCyc 1 100 -327.6800 327.6700 FORMAT "%8.4" ECU_ADDRESS 0x8FEE66 /end MEASUREMENT
/begin MEASUREMENT EMCCD_stOut_mp "Feststellung, ob im Start- oder Haltestromzustand" UBYTE OneToOne 1 100 0.00 255.0 FORMAT "%5.1" ECU_ADDRESS 0x8FEE68 /end MEASUREMENT
/begin MEASUREMENT EMCCD_uRawActVal1_mp "Bei der EMCCD1-PWM-Endstufe gemessener Spannungsrohwert bei Strom-Regellogik" SWORD Volt 1 100 -160156.4 160151.5 FORMAT "%8.1" ECU_ADDRESS 0x8FEE6A /end MEASUREMENT
/begin MEASUREMENT EMCCD_uRawActVal2_mp "Bei der EMCCD2-PWM-Endstufe gemessener Spannungsrohwert bei Strom-Regellogik" SWORD Volt 1 100 -160156.4 160151.5 FORMAT "%8.1" ECU_ADDRESS 0x8FEE6C /end MEASUREMENT
/begin MEASUREMENT EngMon_stShOffIrrCmb "Abschaltbotschaft an Abschaltkoordinator auf Grund irregulärer Verbrennung" UBYTE OneToOne 1 100 0.00 255.0 FORMAT "%5.1" ECU_ADDRESS 0x7F8877 /end MEASUREMENT
/begin MEASUREMENT EngM_ctIncErrSigDiagCaSDef_mp "Inkrementezaehlerstand zur Erkennung gestörtes Nockenwellensignal" UWORD OneToOne 1 100 0.00 65535.00 FORMAT "%8.2" ECU_ADDRESS 0x8FEE84 /end MEASUREMENT
/begin MEASUREMENT EngM_ctIncErrSigDiagCaSOk_mp "Inkrementezaehlerstand zur Erkennung gestörtes Nockenwellensignal geheilt" UWORD OneToOne 1 100 0.00 65535.00 FORMAT "%8.2" ECU_ADDRESS 0x8FEE86 /end MEASUREMENT
/begin MEASUREMENT EngM_ctIncErrSigDiagCrSDef_mp "Inkrementezaehlerstand zur Erkennung eines gestörten Kurbelwellensignal" UWORD OneToOne 1 100 0.00 65535.00 FORMAT "%8.2" ECU_ADDRESS 0x8FEE88 /end MEASUREMENT
/begin MEASUREMENT EngM_ctIncErrSigDiagCrSOK_mp "Inkrementezaehlerstand zur Erkennung Kurbelwellensignal ohne Störungen" UWORD OneToOne 1 100 0.00 65535.00 FORMAT "%8.2" ECU_ADDRESS 0x8FEE8A /end MEASUREMENT
/begin MEASUREMENT EngM_ctIncErrSigDiagmaxCaSDef_mp "maximaler Inkrementezaehlerstand bei Erkennung gestörtes Nockenwellensignal" UWORD OneToOne 1 100 0.00 65535.00 FORMAT "%8.2" ECU_ADDRESS 0x8FEE8C /end MEASUREMENT
/begin MEASUREMENT EngM_ctIncErrSigDiagmaxCaSOk_mp "maximaler Inkrementezaehlerstand bei Erkennung gestörtes Nockenwellensignal geheilt" UWORD OneToOne 1 100 0.00 65535.00 FORMAT "%8.2" ECU_ADDRESS 0x8FEE8E /end MEASUREMENT
/begin MEASUREMENT EngM_ctIncErrSigDiagmaxCrSDef_mp "maximeler Inkrementezaehlerstand bei Erkennung gestörtes Kurbelwellensignal" UWORD OneToOne 1 100 0.00 65535.00 FORMAT "%8.2" ECU_ADDRESS 0x8FEE90 /end MEASUREMENT
/begin MEASUREMENT EngM_ctIncNoSigDiagCaS_mp "Inkrementezaehlerstand zur Erkennung ausgefallenes Nockenwellensignal" UWORD OneToOne 1 100 0.00 65535.00 FORMAT "%8.2" ECU_ADDRESS 0x8FEE92 /end MEASUREMENT
/begin MEASUREMENT EngM_ctIncNoSigDiagmaxCaS_mp "maximaler Inkrementezaehlerstand bei Erkennung ausgefallenes Nockenwellensignal" UWORD OneToOne 1 100 0.00 65535.00 FORMAT "%8.2" ECU_ADDRESS 0x8FEE94 /end MEASUREMENT
/begin MEASUREMENT EngM_ctIntOvrLoad_mp "Anzahl der statischen Interrupts, bei denen der zeitliche Abstand zu kurz ist" UBYTE OneToOne 1 100 0.00 255.0 FORMAT "%5.1" ECU_ADDRESS 0x8FEE6F /end MEASUREMENT
/begin MEASUREMENT EngM_ctPhErrSigDiagCrSDef_mp "Anzahl Nockenwellenzaehne zur Erkennung eines gestörten Kurbelwellensignal" UWORD OneToOne 1 100 0.00 65535.00 FORMAT "%8.2" ECU_ADDRESS 0x8FEE96 /end MEASUREMENT
/begin MEASUREMENT EngM_ctPhErrSigDiagmaxCrSDef_mp "maximale Anzahl Nockenwellenzaehne bei Erkennung ausgefallenes Kurbelwellensignal" UWORD OneToOne 1 100 0.00 65535.00 FORMAT "%8.2" ECU_ADDRESS 0x8FEE98 /end MEASUREMENT
/begin MEASUREMENT EngM_ctPostSync_mp "Interruptzähler im State EngM_stSync = 64 (Post-Synchron)" UBYTE OneToOne 1 100 0.00 255.0 FORMAT "%5.1" ECU_ADDRESS 0x8FEE70 /end MEASUREMENT
/begin MEASUREMENT EngM_ctReSync_mp "Resynchronisationszähler, wird bei jeder Resynchronisation inkrementiert" UBYTE OneToOne 1 100 0.00 255.0 FORMAT "%5.1" ECU_ADDRESS 0x8FEE71 /end MEASUREMENT
/begin MEASUREMENT EngM_ctSpdtoZero_mp "Zähler Timeoutinterrupts bis Motordrehzahl  = Null" ULONG OneToOne 1 100 0.00 4294967295.00 FORMAT "%13.2" ECU_ADDRESS 0x8FEE9C /end MEASUREMENT
/begin MEASUREMENT EngM_ctVerSync_mp "Verif.zähler der Sync; Anzahl der MAIN, PILOT, UPDATE, SEGMENT Interrupts zur Plaus. der NW mit der KW" UBYTE OneToOne 1 100 0.00 255.0 FORMAT "%5.1" ECU_ADDRESS 0x8FEE72 /end MEASUREMENT
/begin MEASUREMENT EngM_nAvrgHysHigh_mp "engine speed hysteresis higher limit" SWORD EngN 1 100 -32768.00 32767.00 FORMAT "%8.2" ECU_ADDRESS 0x8FEEA0 /end MEASUREMENT
/begin MEASUREMENT EngM_nAvrgHysLow_mp "engine speed hysteresis lower limit" SWORD EngN 1 100 -32768.00 32767.00 FORMAT "%8.2" ECU_ADDRESS 0x8FEEA2 /end MEASUREMENT
/begin MEASUREMENT EngM_nDyn "dynamische Drehzahl" SWORD EngN 1 100 -32768.00 32767.00 FORMAT "%8.2" ECU_ADDRESS 0x7F8C78 /end MEASUREMENT
/begin MEASUREMENT EngM_nLISetDiff_mp "Betrag Leerlaufreglerabweichung" SWORD EngN 1 100 -32768.00 32767.00 FORMAT "%8.2" ECU_ADDRESS 0x8FEEB2 /end MEASUREMENT
/begin MEASUREMENT EngM_numCyl "Zylinderanzahl" UBYTE OneToOne 1 100 0.00 255.0 FORMAT "%5.1" ECU_ADDRESS 0x7F8866 /end MEASUREMENT
/begin MEASUREMENT EngM_numInt "Interreupt-Klasse" UBYTE OneToOne 1 100 0.00 255.0 FORMAT "%5.1" ECU_ADDRESS 0x7F8868 /end MEASUREMENT
/begin MEASUREMENT EngM_numLastTDC "Vorhergehender Zünd-OT" UBYTE OneToOne 1 100 0.00 255.0 FORMAT "%5.1" ECU_ADDRESS 0x7F8869 /end MEASUREMENT
/begin MEASUREMENT EngM_numRevCnt_mp "Zähler der Kurbelwellenumdrehungen" UWORD OneToOne 1 100 0.00 65535.00 FORMAT "%8.2" ECU_ADDRESS 0x8FEE74 /end MEASUREMENT
/begin MEASUREMENT EngM_numSyncTDC "Zylindernummer an dem die Synchronisation erkannt wurde" UBYTE OneToOne 1 100 0.00 255.0 FORMAT "%5.1" ECU_ADDRESS 0x7F886A /end MEASUREMENT
/begin MEASUREMENT EngM_numTDC "Aktueller Zünd-OT" UBYTE OneToOne 1 100 0.00 255.0 FORMAT "%5.1" ECU_ADDRESS 0x7F886B /end MEASUREMENT
/begin MEASUREMENT EngM_phiDiffTDC "Winkel zwischen TDC1 und dem in der Zündreihenfolge nächsten TDC auf diesem Steuergerät" SWORD AngleCrS 1 100 -768.0000 767.9766 FORMAT "%8.4" ECU_ADDRESS 0x7F8C7A /end MEASUREMENT
/begin MEASUREMENT EngM_phiInt "aktuelle Interrupt-Position" SWORD AngleCrS 1 100 -768.0000 767.9766 FORMAT "%8.4" ECU_ADDRESS 0x7F8C7C /end MEASUREMENT
/begin MEASUREMENT EngM_phiIntExt "aktuelle Interrupt-Position, extern vom Master zum Slave über CAN" SWORD AngleCrS 1 100 -768.0000 767.9766 FORMAT "%8.4" ECU_ADDRESS 0x7F8C7E /end MEASUREMENT
/begin MEASUREMENT EngM_phiIntExtCorr_mp "aktuelle Winkelposition an der Masterseite nach der Korrektur im Slave-Steuergerät" SWORD AngleCrS 1 100 -768.0000 767.9766 FORMAT "%8.4" ECU_ADDRESS 0x8FEE76 /end MEASUREMENT
/begin MEASUREMENT EngM_phiTDC "OT-Position der aktuellen Zumessung" SWORD AngleCrS 1 100 -768.0000 767.9766 FORMAT "%8.4" ECU_ADDRESS 0x7F8C82 /end MEASUREMENT
/begin MEASUREMENT EngM_rCurrProf_mp "" SWORD DtyCyc 1 100 -327.6800 327.6700 FORMAT "%8.4" ECU_ADDRESS 0x8FEEA4 /end MEASUREMENT
/begin MEASUREMENT EngM_SchedDelta_mp "Sprungweite in der Schedule-Tabelle" UBYTE OneToOne 1 100 0.00 255.0 FORMAT "%5.1" ECU_ADDRESS 0x8FEE78 /end MEASUREMENT
/begin MEASUREMENT EngM_SchedIndex_mp "Anzahl der abgearbeiteten Anweisungen der Schedule-Sequenz" UBYTE OneToOne 1 100 0.00 255.0 FORMAT "%5.1" ECU_ADDRESS 0x8FEE79 /end MEASUREMENT
/begin MEASUREMENT EngM_SchedLimitInt_mp "Nummer des Abschrankintervalls" UBYTE OneToOne 1 100 0.00 255.0 FORMAT "%5.1" ECU_ADDRESS 0x8FEE7A /end MEASUREMENT
/begin MEASUREMENT EngM_SchedSegID_mp "Nummer des Segments vor dem Interrupt" UBYTE OneToOne 1 100 0.00 255.0 FORMAT "%5.1" ECU_ADDRESS 0x8FEE7B /end MEASUREMENT
/begin MEASUREMENT EngM_stAdpt "Zustand Reibmomentenadaption" UBYTE OneToOne 1 100 0.00 255.0 FORMAT "%5.1" ECU_ADDRESS 0x7F886C /end MEASUREMENT
/begin MEASUREMENT EngM_stCaSExt "Statusinformation CaSCD_stPhaseSig_mp vom Mastersteuergeraet über CAN" UWORD OneToOne 1 100 0.00 65535.00 FORMAT "%8.2" ECU_ADDRESS 0x7F8C84 /end MEASUREMENT
/begin MEASUREMENT EngM_stCaSVerifyDiag "Statusinformation der Diagnose aus den VERIFY Zustand" UBYTE OneToOne 1 100 0.00 255.0 FORMAT "%5.1" ECU_ADDRESS 0x7F886D /end MEASUREMENT
/begin MEASUREMENT EngM_stEngMntCtl_mp "status of error bit values" UBYTE OneToOne 1 100 0.00 255.0 FORMAT "%5.1" ECU_ADDRESS 0x8FEEA6 /end MEASUREMENT
/begin MEASUREMENT EngM_stErrCanExt "CAN-Errorstatus der Botschaft MS_PHI_SNYC extern vom Master mit: EngM_phiIntExt, EngM_stNextExt" UBYTE OneToOne 1 100 0.00 255.0 FORMAT "%5.1" ECU_ADDRESS 0x7F886E /end MEASUREMENT
/begin MEASUREMENT EngM_stEvent "Interruptereignis" UBYTE OneToOne 1 100 0.00 255.0 FORMAT "%5.1" ECU_ADDRESS 0x7F886F /end MEASUREMENT
/begin MEASUREMENT EngM_stEventEnable_mp "n-synchrone Interrupts freigegeben" UWORD OneToOne 1 100 0.00 65535.00 FORMAT "%8.2" ECU_ADDRESS 0x8FEE7C /end MEASUREMENT
/begin MEASUREMENT EngM_stEventServed_mp "Aktuell bediente Interrupts" UWORD OneToOne 1 100 0.00 65535.00 FORMAT "%8.2" ECU_ADDRESS 0x8FEE7E /end MEASUREMENT
/begin MEASUREMENT EngM_stGbxRel_mp "Status Freigabebedingung: Antriebsstrang offen" UBYTE OneToOne 1 100 0.00 255.0 FORMAT "%5.1" ECU_ADDRESS 0x8FEEB4 /end MEASUREMENT
/begin MEASUREMENT EngM_stGenRel_mp "Status generelle Freigabebedingungen für Reibmomentenadaption" UBYTE OneToOne 1 100 0.00 255.0 FORMAT "%5.1" ECU_ADDRESS 0x8FEEB5 /end MEASUREMENT
/begin MEASUREMENT EngM_stInjCharSetVal "Zeigt den Zustand der erlaubten Einspritzungen" UBYTE OneToOne 1 100 0.00 255.0 FORMAT "%5.1" ECU_ADDRESS 0x7F8870 /end MEASUREMENT
/begin MEASUREMENT EngM_stNDiffRng_mp "Status Leerlaufreglerabweichung innerhalb zulässiger Schwellwerte" UBYTE OneToOne 1 100 0.00 255.0 FORMAT "%5.1" ECU_ADDRESS 0x8FEEB6 /end MEASUREMENT
/begin MEASUREMENT EngM_stNext "Meta-Status der KW- und NW-Ereignisverwaltung (Motorpositions-Management), ohne Interim-Zustände" UBYTE OneToOne 1 100 0.00 255.0 FORMAT "%5.1" ECU_ADDRESS 0x7F8871 /end MEASUREMENT
/begin MEASUREMENT EngM_stNextExt "Meta-Status der KW- und NW-Ereignisverwaltung, ohne Interim-Zustände, extern vom Master zum Slave über CAN" UBYTE OneToOne 1 100 0.00 255.0 FORMAT "%5.1" ECU_ADDRESS 0x7F8872 /end MEASUREMENT
/begin MEASUREMENT EngM_stOut "state of engine bearing depending on engine speed, engine temperature and gear state" UBYTE OneToOne 1 100 0.00 255.0 FORMAT "%5.1" ECU_ADDRESS 0x7F8873 /end MEASUREMENT
/begin MEASUREMENT EngM_stReliablAdpt "Zuverlässigkeitsstatus des adaptierten Verlustmoments" UBYTE OneToOne 1 100 0.00 255.0 FORMAT "%5.1" ECU_ADDRESS 0x7F8874 /end MEASUREMENT
/begin MEASUREMENT EngM_stSpd "Status der Motordrehzahl" UBYTE OneToOne 1 100 0.00 255.0 FORMAT "%5.1" ECU_ADDRESS 0x7F8875 /end MEASUREMENT
/begin MEASUREMENT EngM_stSync "Meta-Status der KW- und NW-Ereignisverwaltung (Motorpositions-Management)" UBYTE OneToOne 1 100 0.00 255.0 FORMAT "%5.1" ECU_ADDRESS 0x7F8876 /end MEASUREMENT
/begin MEASUREMENT EngM_stTrqFrcPDiffErr_mp "Statusmesspunkt für Ersatzdrehmomentverlust im Systemfehlerefall" UBYTE OneToOne 1 100 0.00 255.0 FORMAT "%5.1" ECU_ADDRESS 0x8FEEA7 /end MEASUREMENT
/begin MEASUREMENT EngM_tiDiffInt_mp "Differenz zwischen zwei statische interrupts" ULONG TimeSys_us 1 100 0.00 1228361874.73 FORMAT "%13.2" ECU_ADDRESS 0x8FEE80 /end MEASUREMENT
/begin MEASUREMENT EngM_tiSeg "Segmentzeit" UWORD TimeDT 1 100 0.00 65535.00 FORMAT "%8.2" ECU_ADDRESS 0x7F8C86 /end MEASUREMENT
/begin MEASUREMENT EngM_tiSegLimAvrg "gemittelte beschränkte Segmentzeit" UWORD TimeDT 1 100 0.00 65535.00 FORMAT "%8.2" ECU_ADDRESS 0x7F8C88 /end MEASUREMENT
/begin MEASUREMENT EngM_tiSegTwo "Dauer der vergangenen beiden Segmente" UWORD TimeDT 1 100 0.00 65535.00 FORMAT "%8.2" ECU_ADDRESS 0x7F8C8A /end MEASUREMENT
/begin MEASUREMENT EngM_trqDiffAdpt "Adaptiertes Differenzmoment" SWORD Trq 1 100 -3276.800 3276.700 FORMAT "%8.3" ECU_ADDRESS 0x7F8C8C /end MEASUREMENT
/begin MEASUREMENT EngM_trqFltACoff_mp "Adaptionsfilter-Ausgang für Zustand ""Klima Kompressor aus""" SWORD Trq 1 100 -3276.800 3276.700 FORMAT "%8.3" ECU_ADDRESS 0x8FEEB8 /end MEASUREMENT
/begin MEASUREMENT EngM_trqFltACon_mp "Adaptionsfilter-Ausgang für Zustand ""Klimakompressor an""" SWORD Trq 1 100 -3276.800 3276.700 FORMAT "%8.3" ECU_ADDRESS 0x8FEEBA /end MEASUREMENT
/begin MEASUREMENT EngM_trqFrc "aktuelles Reibmoment" SWORD Trq 1 100 -3276.800 3276.700 FORMAT "%8.3" ECU_ADDRESS 0x7F8C8E /end MEASUREMENT
/begin MEASUREMENT EngM_trqFrcPDiffLim_mp "limitierter Momentenverlust aufgrund Differenzdruck über Partikelfilter" SWORD Trq 1 100 -3276.800 3276.700 FORMAT "%8.3" ECU_ADDRESS 0x8FEEA8 /end MEASUREMENT
/begin MEASUREMENT EngM_trqFrcPDiffRaw_mp "Rohwert des Momentenverlustes aufgrund Differenzdruck über Partikelfilter" SWORD Trq 1 100 -3276.800 3276.700 FORMAT "%8.3" ECU_ADDRESS 0x8FEEAA /end MEASUREMENT
/begin MEASUREMENT EngM_trqFrcPDiff_mp "Momentenverlust aufgrund Differenzdruck über Partikelfilter" SWORD Trq 1 100 -3276.800 3276.700 FORMAT "%8.3" ECU_ADDRESS 0x8FEEAC /end MEASUREMENT
/begin MEASUREMENT EngM_trqFrcT_mp "ausgewählte Temperature zur Berechnung Reibmoment" SWORD Trq 1 100 -3276.800 3276.700 FORMAT "%8.3" ECU_ADDRESS 0x8FEEAE /end MEASUREMENT
/begin MEASUREMENT EngM_trqLossAdpt "Adaptiertes Gesamtverlustmoment des Motors" SWORD Trq 1 100 -3276.800 3276.700 FORMAT "%8.3" ECU_ADDRESS 0x7F8C90 /end MEASUREMENT
/begin MEASUREMENT EngM_trqLossCompl_mp "komplettes Motor-Verlustmoment" SWORD Trq 1 100 -3276.800 3276.700 FORMAT "%8.3" ECU_ADDRESS 0x8FEEBC /end MEASUREMENT
/begin MEASUREMENT EngM_trqLossDiff_mp "Differenzverlustmoment der Reibmomenten-Adaption" SWORD Trq 1 100 -3276.800 3276.700 FORMAT "%8.3" ECU_ADDRESS 0x8FEEBE /end MEASUREMENT
/begin MEASUREMENT EngM_tTrqFrc_mp "Ausgewählte Temperatur für die Reibmomentenberechnung" SWORD Temp_Cels 1 100 -50.140 899.860 FORMAT "%8.3" ECU_ADDRESS 0x8FEEB0 /end MEASUREMENT
/begin MEASUREMENT EngPrt_facOvhtPrvCT_mp "Faktor aus Kühlmitteltemperatur" SWORD Fact 1 100 -4.000000 3.999878 FORMAT "%8.6" ECU_ADDRESS 0x8FEEC0 /end MEASUREMENT
/begin MEASUREMENT EngPrt_facOvhtPrvFT_mp "Faktor aus Kraftstofftemperatur" SWORD Fact 1 100 -4.000000 3.999878 FORMAT "%8.6" ECU_ADDRESS 0x8FEEC2 /end MEASUREMENT
/begin MEASUREMENT EngPrt_facOvhtPrvOT_mp "Faktor aus Motoröltemperatur" SWORD Fact 1 100 -4.000000 3.999878 FORMAT "%8.6" ECU_ADDRESS 0x8FEEC4 /end MEASUREMENT
/begin MEASUREMENT EngPrt_facOvhtPrv_mp "Minimum der Temperaturfaktoren" SWORD Fact 1 100 -4.000000 3.999878 FORMAT "%8.6" ECU_ADDRESS 0x8FEEC6 /end MEASUREMENT
/begin MEASUREMENT EngPrt_facPrtLim "Motorschutzbegrenzungsfaktor" SWORD Fact 1 100 -4.000000 3.999878 FORMAT "%8.6" ECU_ADDRESS 0x7F8C92 /end MEASUREMENT
/begin MEASUREMENT EngPrt_qOvhtPrvNRng_mp "Begrenzungsmenge auf Grund der mittleren Drehzahl" SWORD InjMass 1 100 -327.6800 327.6700 FORMAT "%8.4" ECU_ADDRESS 0x8FEEC8 /end MEASUREMENT
/begin MEASUREMENT EngPrt_qOvhtPrvVRng_mp "Begrenzungsmenge auf Grund der Fahrzeuggeschwindigkeit" SWORD InjMass 1 100 -327.6800 327.6700 FORMAT "%8.4" ECU_ADDRESS 0x8FEECA /end MEASUREMENT
/begin MEASUREMENT EngPrt_qPrtLim "Begrenzungmenge zum thermischen Motorschutz" SWORD InjMass 1 100 -327.6800 327.6700 FORMAT "%8.4" ECU_ADDRESS 0x7F8C94 /end MEASUREMENT
/begin MEASUREMENT EngPrt_stFWOscDet "Status of fly wheel oscillation detection" UBYTE OneToOne 1 100 0.00 255.0 FORMAT "%5.1" ECU_ADDRESS 0x7F8878 /end MEASUREMENT
/begin MEASUREMENT EngPrt_stOvrSpd "Überdrehzahl-Status" UBYTE OneToOne 1 100 0.00 255.0 FORMAT "%5.1" ECU_ADDRESS 0x7F8879 /end MEASUREMENT
/begin MEASUREMENT EngPrt_stTrqRampSwitch_mp "status of rampswitch" UWORD OneToOne 1 100 0.00 65535.00 FORMAT "%8.2" ECU_ADDRESS 0x8FEECC /end MEASUREMENT
/begin MEASUREMENT EngPrt_trqLim "Begrenzungsmoment zum Schutz vor zu hohem Drehmoment (als inneres Motormoment)" SWORD Trq 1 100 -3276.800 3276.700 FORMAT "%8.3" ECU_ADDRESS 0x7F8C96 /end MEASUREMENT
/begin MEASUREMENT EngPrt_trqLimPrvLim_mp "" SWORD Trq 1 100 -3276.800 3276.700 FORMAT "%8.3" ECU_ADDRESS 0x8FEECE /end MEASUREMENT
/begin MEASUREMENT EngPrt_trqNLim "Begrenzungsmoment zum Schutz vor zu hoher Drehzahl (als inneres Motormoment)" SWORD Trq 1 100 -3276.800 3276.700 FORMAT "%8.3" ECU_ADDRESS 0x7F8C98 /end MEASUREMENT
/begin MEASUREMENT EngPrt_trqOvhtPrv "Begrenzungsmoment für Überhitzungsschutz" SWORD Trq 1 100 -3276.800 3276.700 FORMAT "%8.3" ECU_ADDRESS 0x7F8C9A /end MEASUREMENT
/begin MEASUREMENT EngPrt_trqPrtLim "resultierendes Begrenzungsmoment für Motormechanikschutz (inneres Motormoment)" SWORD Trq 1 100 -3276.800 3276.700 FORMAT "%8.3" ECU_ADDRESS 0x7F8C9C /end MEASUREMENT
/begin MEASUREMENT EngPrt_trqRamLim1_mp "Ausgang der Sekunde rampswitch" SWORD Trq 1 100 -3276.800 3276.700 FORMAT "%8.3" ECU_ADDRESS 0x8FEED0 /end MEASUREMENT
/begin MEASUREMENT EngPrt_trqRamLim_mp "Ausgang von erstem rampswitch" SWORD Trq 1 100 -3276.800 3276.700 FORMAT "%8.3" ECU_ADDRESS 0x8FEED2 /end MEASUREMENT
/begin MEASUREMENT Eng_dnAvrg "gemittelte Drehzahländerung pro Sekunde" SWORD dn_dZ20 1 100 -327680.0 327670.0 FORMAT "%8.1" ECU_ADDRESS 0x7F8C9E /end MEASUREMENT
/begin MEASUREMENT Eng_nAvrg "mittlere Motordrehzahl" SWORD EngN 1 100 -32768.00 32767.00 FORMAT "%8.2" ECU_ADDRESS 0x7F8CA0 /end MEASUREMENT
/begin MEASUREMENT Eng_nCurr "aktuelle Motordrehzahl" SWORD EngN 1 100 -32768.00 32767.00 FORMAT "%8.2" ECU_ADDRESS 0x7F8CA2 /end MEASUREMENT
/begin MEASUREMENT Eng_stOvrTemp "Status Übertemperatur" UBYTE OneToOne 1 100 0.00 255.0 FORMAT "%5.1" ECU_ADDRESS 0x7F887A /end MEASUREMENT
/begin MEASUREMENT Eng_stOvrTemp2 "Status Übertemperatur 2" UBYTE OneToOne 1 100 0.00 255.0 FORMAT "%5.1" ECU_ADDRESS 0x7F887B /end MEASUREMENT
/begin MEASUREMENT Eng_stOvrTemp_mp "Status Übertemperatur" UBYTE OneToOne 1 100 0.00 255.0 FORMAT "%5.1" ECU_ADDRESS 0x8FEE6E /end MEASUREMENT
/begin MEASUREMENT Eng_tEng "Motortemperatur" SWORD Temp_Cels 1 100 -50.140 899.860 FORMAT "%8.3" ECU_ADDRESS 0x7F8CA4 /end MEASUREMENT
/begin MEASUREMENT Eng_tFld "Motortemperatur-Feld" SWORD Temp_Cels 1 100 -50.140 899.860 FORMAT "%8.3" ARRAY_SIZE 3 ECU_ADDRESS 0x7F92AC /end MEASUREMENT
/begin MEASUREMENT Eng_trqCrvMax "maximales Moment des Momentenintervalls (über Drehzahl)" SWORD Trq 1 100 -3276.800 3276.700 FORMAT "%8.3" ECU_ADDRESS 0x7F8CAA /end MEASUREMENT
/begin MEASUREMENT Eng_tStrt "Motortemperatur beim Start" SWORD Temp_Cels 1 100 -50.140 899.860 FORMAT "%8.3" ECU_ADDRESS 0x7F8CA6 /end MEASUREMENT
/begin MEASUREMENT ErLpCD_OrdGlwLmp "Message vom Fehlerlampen Handler and Glühzeitsteuerung, steuert die Glühlampe bei Systemlampenfehlern an." UBYTE OneToOne 1 100 0.00 255.0 FORMAT "%5.1" ECU_ADDRESS 0x7F887C /end MEASUREMENT
/begin MEASUREMENT ErLpCD_stMil "Gesamtatus der MIL und Status der Aktivierungsquellen" UBYTE OneToOne 1 100 0.00 255.0 FORMAT "%5.1" ECU_ADDRESS 0x7F887D /end MEASUREMENT
/begin MEASUREMENT ErLpCD_stMilLmpTst "Status der MIL während Lampentest" UBYTE OneToOne 1 100 0.00 255.0 FORMAT "%5.1" ECU_ADDRESS 0x7F887E /end MEASUREMENT
/begin MEASUREMENT ErLpCD_stMilReq "Status der externen MIL Ansteuerungs Anforderung (Achtung: wechselt während der Ansteuerung dauernd den Zustand)" UBYTE OneToOne 1 100 0.00 255.0 FORMAT "%5.1" ECU_ADDRESS 0x7F887F /end MEASUREMENT
/begin MEASUREMENT ErLpCD_stSysLmp "Gesamtatus der System Lampe und Status der Aktivierungsquellen" UBYTE OneToOne 1 100 0.00 255.0 FORMAT "%5.1" ECU_ADDRESS 0x7F8880 /end MEASUREMENT
/begin MEASUREMENT ErLpCD_stSysLmpReq "Status der externen Systemlampen  Ansteuerungs Anforderung (Achtung: wechselt während der Ansteuerung dauernd den Zustand)" UBYTE OneToOne 1 100 0.00 255.0 FORMAT "%5.1" ECU_ADDRESS 0x7F8881 /end MEASUREMENT
/begin MEASUREMENT ErLpCD_stTstMIL_mp "Testzustand und Fehlerspeicheranforderung der MIL" UBYTE OneToOne 1 100 0.00 255.0 FORMAT "%5.1" ECU_ADDRESS 0x8FEED4 /end MEASUREMENT
/begin MEASUREMENT ErLpCD_stTstSysLmp_mp "Testzustand und Anforderung durch Fehlerspeicher für Systemlampe" UBYTE OneToOne 1 100 0.00 255.0 FORMAT "%5.1" ECU_ADDRESS 0x8FEED5 /end MEASUREMENT
/begin MEASUREMENT ESS_nBattMin "Leerlaufdrehzahl wegen schwacher Batterie" SWORD EngN 1 100 -32768.00 32767.00 FORMAT "%8.2" ECU_ADDRESS 0x7F8C6A /end MEASUREMENT
/begin MEASUREMENT ESS_nMax "Hoechstdrehzahl für ESS" SWORD EngN 1 100 -32768.00 32767.00 FORMAT "%8.2" ECU_ADDRESS 0x7F8C6C /end MEASUREMENT
/begin MEASUREMENT ESS_nMin "Leerlaufdrehzahl aus ESS" SWORD EngN 1 100 -32768.00 32767.00 FORMAT "%8.2" ECU_ADDRESS 0x7F8C6E /end MEASUREMENT
/begin MEASUREMENT ESS_pwrDes "Leistungsbedarf aller Aggregate des Bordnetzes" SWORD Pwr 1 100 -308831.1 308821.7 FORMAT "%8.1" ECU_ADDRESS 0x7F8C70 /end MEASUREMENT
/begin MEASUREMENT ESS_pwrLead "Vorhaltleistung des el. Bordnetzes" SWORD Pwr 1 100 -308831.1 308821.7 FORMAT "%8.1" ECU_ADDRESS 0x7F8C72 /end MEASUREMENT
/begin MEASUREMENT ETClb_ctInjCycl_mp "Aktuelle Anzahl der Einspritzzyklen für die Ansteuerdauerkalibrierung" UWORD OneToOne 1 100 0.00 65535.00 FORMAT "%8.2" ECU_ADDRESS 0x8FEF04 /end MEASUREMENT
/begin MEASUREMENT ETClb_ctLrn_mp "Lernzykluszähler für jeden Raildruck-Kalibrierpunkt der Ansteuerdauerkalibrierung" UWORD OneToOne 1 100 0.00 65535.00 FORMAT "%8.2" ARRAY_SIZE 3 ECU_ADDRESS 0x6F8090 /end MEASUREMENT
/begin MEASUREMENT ETClb_dtiETFlt0_mp "Gefilterte Ansteuerdauerdifferenz der Ansteuerdauerkalibrierung für jeden Zylinder beim Raildruck-Kalibrierpunkt 0" SWORD InjTime_us 1 100 -32768.00 32767.00 FORMAT "%8.2" ARRAY_SIZE 6 ECU_ADDRESS 0x6F8096 /end MEASUREMENT
/begin MEASUREMENT ETClb_dtiETFlt1_mp "Gefilterte Ansteuerdauerdifferenz der Ansteuerdauerkalibrierung für jeden Zylinder beim Raildruck-Kalibrierpunkt 1" SWORD InjTime_us 1 100 -32768.00 32767.00 FORMAT "%8.2" ARRAY_SIZE 6 ECU_ADDRESS 0x6F80A2 /end MEASUREMENT
/begin MEASUREMENT ETClb_dtiETFlt2_mp "Gefilterte Ansteuerdauerdifferenz der Ansteuerdauerkalibrierung für jeden Zylinder beim Raildruck-Kalibrierpunkt 2" SWORD InjTime_us 1 100 -32768.00 32767.00 FORMAT "%8.2" ARRAY_SIZE 6 ECU_ADDRESS 0x6F80AE /end MEASUREMENT
/begin MEASUREMENT ETClb_numCylCur_mp "Aktueller Zylinder für die Ansteuerdauerkalibrierung bei jedem Raildruck-Kalibrierpunkt" UBYTE OneToOne 1 100 0.00 255.0 FORMAT "%5.1" ARRAY_SIZE 3 ECU_ADDRESS 0x8FEED6 /end MEASUREMENT
/begin MEASUREMENT ETClb_numPres_mp "Aktueller Raildruck-Kalibrierpunkt der Ansteuerdauerkalibrierung" UBYTE OneToOne 1 100 0.00 255.0 FORMAT "%5.1" ECU_ADDRESS 0x8FEF06 /end MEASUREMENT
/begin MEASUREMENT ETClb_numRailPresClbPnt_mp "Anzahl der Raildruck-Kalibrierpunkte für die Ansteuerdauerkalibrierung" UBYTE OneToOne 1 100 0.00 255.0 FORMAT "%5.1" ECU_ADDRESS 0x8FEF07 /end MEASUREMENT
/begin MEASUREMENT ETClb_stCor "Statusanzeige der Freigaben für die Ansteuerdauerkorrektur der Nullmengenkalibrierung" UBYTE OneToOne 1 100 0.00 255.0 FORMAT "%5.1" ECU_ADDRESS 0x7F8864 /end MEASUREMENT
/begin MEASUREMENT ETClb_stDemCor_mp "Anforderung der Ansteuerdauerkorrektur der Ansteuerdauerkalibrierung" UBYTE OneToOne 1 100 0.00 255.0 FORMAT "%5.1" ECU_ADDRESS 0x8FEF08 /end MEASUREMENT
/begin MEASUREMENT ETClb_stEvalResult_mp "Ergebnis der Ansteuerdauerkalibrierungs-Einspritzungen" UBYTE ETClb_Eval_Rslt 1 100 0.00 2.00000000000 FORMAT "%13.11" ECU_ADDRESS 0x8FEF0C /end MEASUREMENT
/begin MEASUREMENT ETClb_stEval_mp "Zustand des Zustandsautomaten zur Auswertung der Ansteuerdauerkalibrierung" UBYTE ETClb_Eval_State 1 100 0.00 2.00000000000 FORMAT "%13.11" ARRAY_SIZE 3 ECU_ADDRESS 0x8FEF09 /end MEASUREMENT
/begin MEASUREMENT ETClb_stRailpClbPntErr_mp "Status der Begrenzung der Ansteuerdauer der ZFC Kalibrierung für jeden Raildruck-Kalibrierpunkt" UBYTE OneToOne 1 100 0.00 255.0 FORMAT "%5.1" ARRAY_SIZE 6 ECU_ADDRESS 0x6F80C4 /end MEASUREMENT
/begin MEASUREMENT ETClb_stRlsCylCor_mp "Zylinderspezifische Freigabe der Ansteuerdauerkorrektur der Ansteuerdauerkalibrierung" UBYTE OneToOne 1 100 0.00 255.0 FORMAT "%5.1" ECU_ADDRESS 0x6F80C2 /end MEASUREMENT
/begin MEASUREMENT ETClb_st_mp "Zustand der Ansteuerdauerkalibrierung" UBYTE ETClb_State 1 100 0.00 4.00000000000 FORMAT "%13.11" ECU_ADDRESS 0x6F80C3 /end MEASUREMENT
/begin MEASUREMENT ETClb_swtCorActv "SW-Schalter zur Aktivierung der Ansteuerdauerkorrektur der Nullmengenkalibrierung" UBYTE OneToOne 1 100 0.00 255.0 FORMAT "%5.1" ECU_ADDRESS 0x7F8865 /end MEASUREMENT
/begin MEASUREMENT ETClb_swtQckClb_mp "Anzeiger der Umschaltung auf schnelle Ansteuerdauerkalibrierung" UBYTE OneToOne 1 100 0.00 255.0 FORMAT "%5.1" ECU_ADDRESS 0x6F80BA /end MEASUREMENT
/begin MEASUREMENT ETClb_tiETChkCor0_mp "Ansteuerdauer der Nullmenge der ZFC nach Korrektur durch die IMA für Raildruck-Kalibrierpunkt 0" SWORD InjTime_us 1 100 -32768.00 32767.00 FORMAT "%8.2" ARRAY_SIZE 6 ECU_ADDRESS 0x8FEF0E /end MEASUREMENT
/begin MEASUREMENT ETClb_tiETChkCor1_mp "Ansteuerdauer der Nullmenge der ZFC nach Korrektur durch die IMA für Raildruck-Kalibrierpunkt 1" SWORD InjTime_us 1 100 -32768.00 32767.00 FORMAT "%8.2" ARRAY_SIZE 6 ECU_ADDRESS 0x8FEF1A /end MEASUREMENT
/begin MEASUREMENT ETClb_tiETChkCor2_mp "Ansteuerdauer der Nullmenge der ZFC nach Korrektur durch die IMA für Raildruck-Kalibrierpunkt 2" SWORD InjTime_us 1 100 -32768.00 32767.00 FORMAT "%8.2" ARRAY_SIZE 6 ECU_ADDRESS 0x8FEF26 /end MEASUREMENT
/begin MEASUREMENT ETClb_tiETCor0_mp "Ansteuerdauerkorrekturwert der Ansteuerdauer-Kalibrierung für den Raildruck-Kalibrierpunkt 0" SWORD InjTime_us 1 100 -32768.00 32767.00 FORMAT "%8.2" ARRAY_SIZE 6 ECU_ADDRESS 0x8FEEDA /end MEASUREMENT
/begin MEASUREMENT ETClb_tiETCor1_mp "Ansteuerdauerkorrekturwert der Ansteuerdauer-Kalibrierung für den Raildruck-Kalibrierpunkt 1" SWORD InjTime_us 1 100 -32768.00 32767.00 FORMAT "%8.2" ARRAY_SIZE 6 ECU_ADDRESS 0x8FEEE6 /end MEASUREMENT
/begin MEASUREMENT ETClb_tiETCor2_mp "Ansteuerdauerkorrekturwert der Ansteuerdauer-Kalibrierung für den Raildruck-Kalibrierpunkt 2" SWORD InjTime_us 1 100 -32768.00 32767.00 FORMAT "%8.2" ARRAY_SIZE 6 ECU_ADDRESS 0x8FEEF2 /end MEASUREMENT
/begin MEASUREMENT ETClb_tiETCur_mp "Aktuelle Ansteuerdauer der Ansteuerdauer-Kalibrierung für jeden Raildruck-Kalibrierpunkt" SWORD InjTime_us 1 100 -32768.00 32767.00 FORMAT "%8.2" ARRAY_SIZE 3 ECU_ADDRESS 0x8FEEFE /end MEASUREMENT
/begin MEASUREMENT ETClb_tiETMinEff_mp "Ansteuerdauer der Nullmenge des aktuellen Zylinder fuer jeden Raildruck-Kalibrierpunkt" SWORD InjTime_us 1 100 -32768.00 32767.00 FORMAT "%8.2" ARRAY_SIZE 3 ECU_ADDRESS 0x6F80BC /end MEASUREMENT
/begin MEASUREMENT FanCD_dcycRaw_mp "fanspeed transfered to dutycycle" SWORD DtyCyc 1 100 -327.6800 327.6700 FORMAT "%8.4" ECU_ADDRESS 0x6F80CA /end MEASUREMENT
/begin MEASUREMENT FanCtl_dcycAftRun_mp "Tastverhältnis im Nachlauf" SWORD DtyCyc 1 100 -327.6800 327.6700 FORMAT "%8.4" ECU_ADDRESS 0x8FEF32 /end MEASUREMENT
/begin MEASUREMENT FanCtl_dcycBattCor_mp "TV nach Batt-Korr. und Hysteresefunktion" SWORD DtyCyc 1 100 -327.6800 327.6700 FORMAT "%8.4" ECU_ADDRESS 0x8FEF34 /end MEASUREMENT
/begin MEASUREMENT FanCtl_dcycHysStart_mp "Startwert der Hysterese" SWORD DtyCyc 1 100 -327.6800 327.6700 FORMAT "%8.4" ECU_ADDRESS 0x8FEF36 /end MEASUREMENT
/begin MEASUREMENT FanCtl_dcycHys_mp "TV am Ausgang der Hysteresefunktion" SWORD DtyCyc 1 100 -327.6800 327.6700 FORMAT "%8.4" ECU_ADDRESS 0x8FEF38 /end MEASUREMENT
/begin MEASUREMENT FanCtl_dcycOut "Tastverhältnis, Lüfter" SWORD DtyCyc 1 100 -327.6800 327.6700 FORMAT "%8.4" ECU_ADDRESS 0x7F8CD8 /end MEASUREMENT
/begin MEASUREMENT FanCtl_dcycRaw_mp "Tastverhältnis Rohwert" SWORD DtyCyc 1 100 -327.6800 327.6700 FORMAT "%8.4" ECU_ADDRESS 0x8FEF3A /end MEASUREMENT
/begin MEASUREMENT FanCtl_facWghFctr_mp "weighting factor for fanspeed from CAN" SWORD Fact 1 100 -4.000000 3.999878 FORMAT "%8.6" ECU_ADDRESS 0x8FEF3C /end MEASUREMENT
/begin MEASUREMENT FanCtl_nSetGbxOilMap_mp "fanspeed dependend on vehicle speed and Oil temp" SWORD FanSpd 1 100 -3000.092 3000.000 FORMAT "%8.3" ECU_ADDRESS 0x8FEF3E /end MEASUREMENT
/begin MEASUREMENT FanCtl_nSetPntCAN_mp "fanspeed derived from CAN" SWORD FanSpd 1 100 -3000.092 3000.000 FORMAT "%8.3" ECU_ADDRESS 0x8FEF40 /end MEASUREMENT
/begin MEASUREMENT FanCtl_nSetPntMap_mp "fanspeed dependend on veh.speed and coolant temp." SWORD FanSpd 1 100 -3000.092 3000.000 FORMAT "%8.3" ECU_ADDRESS 0x8FEF42 /end MEASUREMENT
/begin MEASUREMENT FanCtl_nSetPoint "Endgültige Soll- Lüfterdrehzahl" SWORD FanSpd 1 100 -3000.092 3000.000 FORMAT "%8.3" ECU_ADDRESS 0x7F8CDA /end MEASUREMENT
/begin MEASUREMENT FanCtl_nSetPoint_mp "Lüfter-Drehzahlsollwert" SWORD FanSpd 1 100 -3000.092 3000.000 FORMAT "%8.3" ECU_ADDRESS 0x8FEF44 /end MEASUREMENT
/begin MEASUREMENT FanCtl_stAftRun "Statuswort, Lüftersteuerung" UBYTE OneToOne 1 100 0.00 255.0 FORMAT "%5.1" ECU_ADDRESS 0x7F8887 /end MEASUREMENT
/begin MEASUREMENT FanCtl_stDemFanShOff_mp "Ausschaltbitleiste für hohe Lenköltemperaturen" UBYTE OneToOne 1 100 0.00 255.0 FORMAT "%5.1" ECU_ADDRESS 0x8FEF46 /end MEASUREMENT
/begin MEASUREMENT FanCtl_stDemFan_mp "Einschaltbitleiste für hohe Lenköltemperaturen" UBYTE OneToOne 1 100 0.00 255.0 FORMAT "%5.1" ECU_ADDRESS 0x8FEF47 /end MEASUREMENT
/begin MEASUREMENT FanCtl_stHys_mp "Statuswort der Hysteresefunktion" UBYTE OneToOne 1 100 0.00 255.0 FORMAT "%5.1" ECU_ADDRESS 0x8FEF48 /end MEASUREMENT
/begin MEASUREMENT FanCtl_stLogic_mp "Statuswort der Ansteuerlogik" UBYTE OneToOne 1 100 0.00 255.0 FORMAT "%5.1" ECU_ADDRESS 0x8FEF49 /end MEASUREMENT
/begin MEASUREMENT FanCtl_stOut "Zustand Lüfternachlauf" UBYTE OneToOne 1 100 0.00 255.0 FORMAT "%5.1" ECU_ADDRESS 0x7F8CDC /end MEASUREMENT
/begin MEASUREMENT FanCtl_tClnt_mp "intern verwendete Kühlwassertemperatur" SWORD Temp_Cels 1 100 -50.140 899.860 FORMAT "%8.3" ECU_ADDRESS 0x8FEF4A /end MEASUREMENT
/begin MEASUREMENT FanCtl_tGbxOil_mp "Oil temp or Default Temp  for MAP i/p" SWORD Temp_Cels 1 100 -50.140 899.860 FORMAT "%8.3" ECU_ADDRESS 0x8FEF4C /end MEASUREMENT
/begin MEASUREMENT FBC_AALOut_mp "Ausgang des Antialiasingfiler" FLOAT32_IEEE OneToOne 1 100 -150000000. 150000000. FORMAT "%10.0" ECU_ADDRESS 0x8FEF64 /end MEASUREMENT
/begin MEASUREMENT FBC_Badpt "Adaptionsstatus" UBYTE OneToOne 1 100 0.00 255.0 FORMAT "%5.1" ECU_ADDRESS 0x7F8882 /end MEASUREMENT
/begin MEASUREMENT FBC_ctSegInt "interner Segmentzähler von FBC" UBYTE OneToOne 1 100 0.00 255.0 FORMAT "%5.1" ECU_ADDRESS 0x7F8884 /end MEASUREMENT
/begin MEASUREMENT FBC_dBPCaS "Array mit Bandpassausgängen" FLOAT32_IEEE OneToOne 1 100 -1.00000000E+35 1.00000000E+35 FORMAT "%10.0" ARRAY_SIZE 3 ECU_ADDRESS 0x7F930C /end MEASUREMENT
/begin MEASUREMENT FBC_dBPSum "FBC Mengenersatzsignal, Eingang PI-Regler" SWORD OneToOne 1 100 -32768.00 32767.00 FORMAT "%8.2" ECU_ADDRESS 0x7F8CAC /end MEASUREMENT
/begin MEASUREMENT FBC_DXadpt_mp "aktuelle Adaptionsgüte" SWORD Dxs 1 100 -0.8192000 0.8191750 FORMAT "%9.7" ECU_ADDRESS 0x8FEF68 /end MEASUREMENT
/begin MEASUREMENT FBC_DXSfn_mp "Ausgang des negativen Bewertungsfilter" SWORD Dxs 1 100 -0.8192000 0.8191750 FORMAT "%9.7" ARRAY_SIZE 12 ECU_ADDRESS 0x8FEF6A /end MEASUREMENT
/begin MEASUREMENT FBC_DXSfp_mp "Ausgang des positiven Bewertungsfilter" SWORD Dxs 1 100 -0.8192000 0.8191750 FORMAT "%9.7" ARRAY_SIZE 12 ECU_ADDRESS 0x8FEF82 /end MEASUREMENT
/begin MEASUREMENT FBC_DXSf_mp "relative,aktuelle und gefilterte Zahnteilungsfehler (Adaptionsfilter)" SWORD Dxs 1 100 -0.8192000 0.8191750 FORMAT "%9.7" ARRAY_SIZE 12 ECU_ADDRESS 0x8FEF9A /end MEASUREMENT
/begin MEASUREMENT FBC_DXSl_mp "relative, gefilterte Zahnteilungsfehler (Adaptionsfilter, eingelernte Werte)" SWORD Dxs 1 100 -0.8192000 0.8191750 FORMAT "%9.7" ARRAY_SIZE 12 ECU_ADDRESS 0x6F80CC /end MEASUREMENT
/begin MEASUREMENT FBC_DXS_mp "relative Zahnteilungsfehler (ungefiltert)" SWORD Dxs 1 100 -0.8192000 0.8191750 FORMAT "%9.7" ARRAY_SIZE 12 ECU_ADDRESS 0x8FEFB2 /end MEASUREMENT
/begin MEASUREMENT FBC_facBPNum_mp "aktuell verwendete Bandpasszählerkoeffizienten" SWORD FBC_BPfac 1 100 -60.00183 60.00000 FORMAT "%8.5" ARRAY_SIZE 3 ECU_ADDRESS 0x8FEF4E /end MEASUREMENT
/begin MEASUREMENT FBC_facSegVal_mp "aktuelle verwendete Segmentwahl" UWORD Per_Ratio 1 100 0.00 20.00000 FORMAT "%8.5" ARRAY_SIZE 3 ECU_ADDRESS 0x8FEF54 /end MEASUREMENT
/begin MEASUREMENT FBC_nMaxOvrRun_mp "maximale Drehzahl, bis zu der die Bandpässe berechnet werden" SWORD EngN 1 100 -32768.00 32767.00 FORMAT "%8.2" ECU_ADDRESS 0x8FEF5A /end MEASUREMENT
/begin MEASUREMENT FBC_q "Ausgangsmenge der Mengenausgleichsregelung" SWORD InjMass 1 100 -327.6800 327.6700 FORMAT "%8.4" ECU_ADDRESS 0x7F8CAE /end MEASUREMENT
/begin MEASUREMENT FBC_qDvtCyl "aktuelle zylinderindividuelle Korrekturmenge: I-Anteil" SWORD InjMass 1 100 -327.6800 327.6700 FORMAT "%8.4" ARRAY_SIZE 7 ECU_ADDRESS 0x7F9474 /end MEASUREMENT
/begin MEASUREMENT FBC_qDvtMax_mp "obere Integratorwertschwelle" SWORD InjMass 1 100 -327.6800 327.6700 FORMAT "%8.4" ECU_ADDRESS 0x8FEF5C /end MEASUREMENT
/begin MEASUREMENT FBC_qDvtMin_mp "untere Integratorwertschwelle" SWORD InjMass 1 100 -327.6800 327.6700 FORMAT "%8.4" ECU_ADDRESS 0x8FEF5E /end MEASUREMENT
/begin MEASUREMENT FBC_qLimAct "Aktuelle Begrenzungsmenge für FBC_q" SWORD InjMass 1 100 -327.6800 327.6700 FORMAT "%8.4" ECU_ADDRESS 0x7F8CB0 /end MEASUREMENT
/begin MEASUREMENT FBC_qSet "Wunschmenge mit FBC-Korrektur zum Zeitpunkt des jeweiligen MI-Interrupts." SWORD InjMass 1 100 -327.6800 327.6700 FORMAT "%8.4" ECU_ADDRESS 0x7F8CB2 /end MEASUREMENT
/begin MEASUREMENT FBC_RegionChng "signalisiert einen Wechsel der Lernregion in der FBC" UBYTE OneToOne 1 100 0.00 255.0 FORMAT "%5.1" ECU_ADDRESS 0x7F8883 /end MEASUREMENT
/begin MEASUREMENT FBC_Region_mp "Drehzahl-/Mengenbereich für ""regeln - steuern - inaktiv""" UBYTE OneToOne 1 100 0.00 255.0 FORMAT "%5.1" ECU_ADDRESS 0x8FEFCA /end MEASUREMENT
/begin MEASUREMENT FBC_stActive "Status FBC-Regler -> '1': Regeln; '0': Steuern" UBYTE OneToOne 1 100 0.00 255.0 FORMAT "%5.1" ECU_ADDRESS 0x7F8885 /end MEASUREMENT
/begin MEASUREMENT FBC_stDvt_mp "Status der Überwachung Integratorwerte" UBYTE OneToOne 1 100 0.00 255.0 FORMAT "%5.1" ECU_ADDRESS 0x8FEF60 /end MEASUREMENT
/begin MEASUREMENT FBC_stEqualInit "Initialisierungsstatus für FBC-Regler" UBYTE OneToOne 1 100 0.00 255.0 FORMAT "%5.1" ECU_ADDRESS 0x7F8886 /end MEASUREMENT
/begin MEASUREMENT FBC_stLearn "Bitfeld für Übergänge des Zustandsautomaten" UWORD OneToOne 1 100 0.00 65535.00 FORMAT "%8.2" ECU_ADDRESS 0x7F8CB4 /end MEASUREMENT
/begin MEASUREMENT FBC_stRegion_mp "Status  Regler in Abhängigkeit von Menge/Drehzahl ('regeln','steuern','inaktiv')" UBYTE OneToOne 1 100 0.00 255.0 FORMAT "%5.1" ECU_ADDRESS 0x8FEF61 /end MEASUREMENT
/begin MEASUREMENT FBC_stState_mp "Status des Zustandsautomates der Adaption" UBYTE FBC_LrnState 1 100 1.00000000000 5.00000000000 FORMAT "%13.11" ECU_ADDRESS 0x8FEFCB /end MEASUREMENT
/begin MEASUREMENT FBC_WheelLrnOut "Eingangsignal für FBC Bandpässe" FLOAT32_IEEE OneToOne 1 100 -1.00000000E+35 1.00000000E+35 FORMAT "%10.0" ECU_ADDRESS 0x7F91E0 /end MEASUREMENT
/begin MEASUREMENT FlFCD_stFlFltDebVal "Entprellter Zustand des Kraftstofffilters" UBYTE OneToOne 1 100 0.00 255.0 FORMAT "%5.1" ECU_ADDRESS 0x7F8888 /end MEASUREMENT
/begin MEASUREMENT FlFCD_stFlFltRawVal "Unentprellter Zustand des Kraftstofffilters" UBYTE OneToOne 1 100 0.00 255.0 FORMAT "%5.1" ECU_ADDRESS 0x7F8889 /end MEASUREMENT
/begin MEASUREMENT FlMng_mAirPerCylFltSmk_mp "PT1 filtered air mass per cylinder" SWORD AirMassPerCyl 1 100 -3276.800 3276.700 FORMAT "%8.3" ECU_ADDRESS 0x8FEFD6 /end MEASUREMENT
/begin MEASUREMENT FlMng_mAirPerCylLim_mp "begrenzte Luftmasse" SWORD AirMassPerCyl 1 100 -3276.800 3276.700 FORMAT "%8.3" ECU_ADDRESS 0x8FEFD8 /end MEASUREMENT
/begin MEASUREMENT FlMng_qFullLdRgl "Korrekturmenge der Volllastregelung" SWORD InjMass 1 100 -327.6800 327.6700 FORMAT "%8.4" ECU_ADDRESS 0x7F8CDE /end MEASUREMENT
/begin MEASUREMENT FlMng_qFullLdRglI_mp "I-Anteil der Vollastregelung" SLONG InjMass 1 100 -21474836.4800 21474836.4700 FORMAT "%13.4" ECU_ADDRESS 0x8FEFCC /end MEASUREMENT
/begin MEASUREMENT FlMng_qFullLdRglP_mp "P-Anteil der Vollastregelung" SWORD InjMass 1 100 -327.6800 327.6700 FORMAT "%8.4" ECU_ADDRESS 0x8FEFD0 /end MEASUREMENT
/begin MEASUREMENT FlMng_qLimSmk "Begrenzungsmenge zur Rauchbegrenzung" SWORD InjMass 1 100 -327.6800 327.6700 FORMAT "%8.4" ECU_ADDRESS 0x7F8CE0 /end MEASUREMENT
/begin MEASUREMENT FlMng_qLimSmkDefect_mp "Quantity to detect and in the case of an detached charge air tube" SWORD InjMass 1 100 -327.6800 327.6700 FORMAT "%8.4" ECU_ADDRESS 0x8FEFDA /end MEASUREMENT
/begin MEASUREMENT FlMng_qLimSmk_mp "rauchabhängige Mengenbegrenzung" SWORD InjMass 1 100 -327.6800 327.6700 FORMAT "%8.4" ECU_ADDRESS 0x8FEFDC /end MEASUREMENT
/begin MEASUREMENT FlMng_rLmbdAPSCor_mp "Lambda-Korrekturwertes in Abhängigkeit des Umgebungsdrucks für die Rauchbegrenzung" SWORD lambda 1 100 -32.76800 32.76700 FORMAT "%8.5" ECU_ADDRESS 0x8FEFDE /end MEASUREMENT
/begin MEASUREMENT FlMng_rLmbdRecDvt_mp "Kehrwert der Lambdaabweichung bei Volllastregelung" SWORD lambdaRec 1 100 -3.276800 3.276700 FORMAT "%8.6" ECU_ADDRESS 0x8FEFD2 /end MEASUREMENT
/begin MEASUREMENT FlMng_rLmbdSet "Stellgröße für Lambda-Regler" SWORD lambda 1 100 -32.76800 32.76700 FORMAT "%8.5" ECU_ADDRESS 0x7F8CE2 /end MEASUREMENT
/begin MEASUREMENT FlMng_rLmbdSmk_mp "Lambda-Wert der Rauchbegrenzung" SWORD lambda 1 100 -32.76800 32.76700 FORMAT "%8.5" ECU_ADDRESS 0x8FEFE0 /end MEASUREMENT
/begin MEASUREMENT FlMng_stCurrInp_mp "Status, welcher Eingang von EGT_RgnSwtE3 momentan berechnet werden muss" UBYTE OneToOne 1 100 0.00 255.0 FORMAT "%5.1" ECU_ADDRESS 0x8FEFE2 /end MEASUREMENT
/begin MEASUREMENT FlMng_stDefect_mp "Current defect stat" UBYTE OneToOne 1 100 0.00 255.0 FORMAT "%5.1" ECU_ADDRESS 0x8FEFE3 /end MEASUREMENT
/begin MEASUREMENT FlMng_stGearGroup_mp "Gear group status" SWORD OneToOne 1 100 -32768.00 32767.00 FORMAT "%8.2" ECU_ADDRESS 0x8FEFE4 /end MEASUREMENT
/begin MEASUREMENT FlMng_stMon_mp "Status der Einschaltlogik und Überwachung der VOllastregellung" UBYTE OneToOne 1 100 0.00 255.0 FORMAT "%5.1" ECU_ADDRESS 0x8FEFD4 /end MEASUREMENT
/begin MEASUREMENT FlMng_stSmkLim_mp "status of smoke limitation map switching" UBYTE OneToOne 1 100 0.00 255.0 FORMAT "%5.1" ECU_ADDRESS 0x8FEFE6 /end MEASUREMENT
/begin MEASUREMENT FlMng_swtFullLdRgl "Schalter zur (de)aktivierung der Vollastregelung" UBYTE OneToOne 1 100 0.00 255.0 FORMAT "%5.1" ECU_ADDRESS 0x7F888A /end MEASUREMENT
/begin MEASUREMENT FlMng_tiAirPerCylPT1_mp "Time constant for PT1 filtering of air mass per cylinder" ULONG TimeDelay_s 1 100 0.0000010000000 4294.9673 FORMAT "%9.4" ECU_ADDRESS 0x8FEFE8 /end MEASUREMENT
/begin MEASUREMENT FlSys_rhoFl "Koeffizient Kraftstoffdichte" SWORD RhoFuel 1 100 -3276.800 3276.700 FORMAT "%8.3" ECU_ADDRESS 0x7F8CE6 /end MEASUREMENT
/begin MEASUREMENT FlSys_stDeflate_mp "Aktivierung der Niederdruckentlueftung" UBYTE OneToOne 1 100 0.00 255.0 FORMAT "%5.1" ECU_ADDRESS 0x8FEFEC /end MEASUREMENT
/begin MEASUREMENT FlSys_stTemp_mp "Statusbits zur Erfassung der Kraftstoffsystemtemperatur" UBYTE OneToOne 1 100 0.00 255.0 FORMAT "%5.1" ECU_ADDRESS 0x8FEFED /end MEASUREMENT
/begin MEASUREMENT FlSys_swtTempSensCfg "Schalter, ob Kraftstofftemperaturfühler vorhanden" UBYTE OneToOne 1 100 0.00 255.0 FORMAT "%5.1" ECU_ADDRESS 0x7F888B /end MEASUREMENT
/begin MEASUREMENT FlSys_t "aktuelle Systemtemperatur" SWORD Temp_Cels 1 100 -50.140 899.860 FORMAT "%8.3" ECU_ADDRESS 0x7F8CE8 /end MEASUREMENT
/begin MEASUREMENT FMA_dqAbs_mp "Absolutwert der Einspritzmengenänderung für FMA" SWORD InjMassSec 1 100 -327.6800 327.6700 FORMAT "%8.4" ECU_ADDRESS 0x8FF000 /end MEASUREMENT
/begin MEASUREMENT FMA_drLmbdAbs_mp "Absolutwert der Lambdaänderung für FMA" SWORD lambdaSec 1 100 -32.76800 32.76700 FORMAT "%8.5" ECU_ADDRESS 0x8FF002 /end MEASUREMENT
/begin MEASUREMENT FMA_facAirSwtOff_mp "Ansauglufttemperaturabhängiger Abschaltfaktor der FMA" SWORD Fact 1 100 -4.000000 3.999878 FORMAT "%8.6" ECU_ADDRESS 0x8FF004 /end MEASUREMENT
/begin MEASUREMENT FMA_facAPSwtOff_mp "Atmosphärendruckabhängiger Abschaltfaktor der FMA" SWORD Fact 1 100 -4.000000 3.999878 FORMAT "%8.6" ECU_ADDRESS 0x8FF006 /end MEASUREMENT
/begin MEASUREMENT FMA_facEngSwtOff_mp "Motortemperaturabhängiger Abschaltfaktor der FMA" SWORD Fact 1 100 -4.000000 3.999878 FORMAT "%8.6" ECU_ADDRESS 0x8FF008 /end MEASUREMENT
/begin MEASUREMENT FMA_facFaultSwtOff_mp "Faktor für langsame FMA-Abschaltung bei schweren Systemfehlern" SWORD Fact 1 100 -4.000000 3.999878 FORMAT "%8.6" ECU_ADDRESS 0x8FF00A /end MEASUREMENT
/begin MEASUREMENT FMA_facFlSwtOff_mp "Kraftstofftemperaturabhängiger Abschaltfaktor der FMA" SWORD Fact 1 100 -4.000000 3.999878 FORMAT "%8.6" ECU_ADDRESS 0x8FF00C /end MEASUREMENT
/begin MEASUREMENT FMA_facNQSwtOff_mp "Drehzahl-/einspritzmengenabhängiger Abschaltfaktor der FMA für betriebsbereichsabhängige Abschaltung" SWORD Fact 1 100 -4.000000 3.999878 FORMAT "%8.6" ECU_ADDRESS 0x8FEFF4 /end MEASUREMENT
/begin MEASUREMENT FMA_facRgnSwtOff_mp "Regenerations-/ Applikationsabhängiger Abschaltfaktor der FMA" SWORD Fact 1 100 -4.000000 3.999878 FORMAT "%8.6" ECU_ADDRESS 0x8FF00E /end MEASUREMENT
/begin MEASUREMENT FMA_facSlpSwtOff_mp "Abschaltfaktor der FMA, gebildet aus den 4 oberen Abschaltfaktoren" SWORD Fact 1 100 -4.000000 3.999878 FORMAT "%8.6" ECU_ADDRESS 0x8FF010 /end MEASUREMENT
/begin MEASUREMENT FMA_facSwtOff "Abschaltfaktor zum langsamen Aus- und Einschalten der FMA" SWORD Fact 1 100 -4.000000 3.999878 FORMAT "%8.6" ECU_ADDRESS 0x7F8CB6 /end MEASUREMENT
/begin MEASUREMENT FMA_facSwtOffTot_mp "Gesamtabschaltfaktor zum langsamen Aus- und Einschalten der FMA" SWORD Fact 1 100 -4.000000 3.999878 FORMAT "%8.6" ECU_ADDRESS 0x8FEFF6 /end MEASUREMENT
/begin MEASUREMENT FMA_qAct_mp "Aus Lambda- und Luftmassenmessung ermittelte Einspritzmenge. ""Wirkliche"" Einspritzmenge der FMA" SWORD InjMass 1 100 -327.6800 327.6700 FORMAT "%8.4" ECU_ADDRESS 0x8FEFEE /end MEASUREMENT
/begin MEASUREMENT FMA_qCtl_mp "Für Bestimmung des Mengenfehlers verwendetes Mengensignal" SWORD InjMass 1 100 -327.6800 327.6700 FORMAT "%8.4" ECU_ADDRESS 0x8FEFF2 /end MEASUREMENT
/begin MEASUREMENT FMA_qDC "Von FMA ermittelter Einspritzmengenfehler bzw. -korrekturwert für Betriebsart Direct Control (Modellfehler)" SWORD InjMass 1 100 -327.6800 327.6700 FORMAT "%8.4" ECU_ADDRESS 0x7F8CB8 /end MEASUREMENT
/begin MEASUREMENT FMA_qDev_mp "Abweichung der ""wirklichen"" Einspritzmenge von der gewünschten Einspritzmenge in der FMA" SWORD InjMass 1 100 -327.6800 327.6700 FORMAT "%8.4" ECU_ADDRESS 0x8FEFF0 /end MEASUREMENT
/begin MEASUREMENT FMA_qDiff_mp "Differenz aus Einspritzmengenfehler und aktuellem Kennfeldwert" SWORD InjMass 1 100 -327.6800 327.6700 FORMAT "%8.4" ECU_ADDRESS 0x8FEFF8 /end MEASUREMENT
/begin MEASUREMENT FMA_qErrMod_mp "Aus Fehlermodell ermittelter Rohwert des Einspritzmengenfehlers" SWORD InjMass 1 100 -327.6800 327.6700 FORMAT "%8.4" ECU_ADDRESS 0x8FEFFA /end MEASUREMENT
/begin MEASUREMENT FMA_qIC "Von FMA ermittelter Einspritzmengenfehler bzw. -korrekturwert für Betriebsart Indirect Control (Modellfehler)" SWORD InjMass 1 100 -327.6800 327.6700 FORMAT "%8.4" ECU_ADDRESS 0x7F8CBA /end MEASUREMENT
/begin MEASUREMENT FMA_qMapRow0_mp "Kennfeldwerte für erste Mengenstützstelle (erste zeile von adaptive Kennfeld)" SWORD InjMass 1 100 -327.6800 327.6700 FORMAT "%8.4" ARRAY_SIZE 8 ECU_ADDRESS 0x6F80E6 /end MEASUREMENT
/begin MEASUREMENT FMA_qMapRow1_mp "Kennfeldwerte für zweite Mengenstützstelle (zweite zeile von adaptive Kennfeld)" SWORD InjMass 1 100 -327.6800 327.6700 FORMAT "%8.4" ARRAY_SIZE 8 ECU_ADDRESS 0x6F80F6 /end MEASUREMENT
/begin MEASUREMENT FMA_qMapRow2_mp "Kennfeldwerte für dritte Mengenstützstelle (dritte zeile von adaptive Kennfeld)" SWORD InjMass 1 100 -327.6800 327.6700 FORMAT "%8.4" ARRAY_SIZE 8 ECU_ADDRESS 0x6F8106 /end MEASUREMENT
/begin MEASUREMENT FMA_qMapRow3_mp "Kennfeldwerte für vierte Mengenstützstelle (vierte zeile von adaptive Kennfeld)" SWORD InjMass 1 100 -327.6800 327.6700 FORMAT "%8.4" ARRAY_SIZE 8 ECU_ADDRESS 0x6F8116 /end MEASUREMENT
/begin MEASUREMENT FMA_qMapRow4_mp "Kennfeldwerte für fünfte Mengenstützstelle (fünfte zeile von adaptive Kennfeld)" SWORD InjMass 1 100 -327.6800 327.6700 FORMAT "%8.4" ARRAY_SIZE 8 ECU_ADDRESS 0x6F8126 /end MEASUREMENT
/begin MEASUREMENT FMA_qMapRow5_mp "Kennfeldwerte für sechste Mengenstützstelle (sechste zeile von adaptive Kennfeld)" SWORD InjMass 1 100 -327.6800 327.6700 FORMAT "%8.4" ARRAY_SIZE 8 ECU_ADDRESS 0x6F8136 /end MEASUREMENT
/begin MEASUREMENT FMA_qMapRow6_mp "Kennfeldwerte für siebte Mengenstützstelle (siebte zeile von adaptive Kennfeld)" SWORD InjMass 1 100 -327.6800 327.6700 FORMAT "%8.4" ARRAY_SIZE 8 ECU_ADDRESS 0x6F8146 /end MEASUREMENT
/begin MEASUREMENT FMA_qMapRow7_mp "Kennfeldwerte für achte Mengenstützstelle (achte zeile von adaptive Kennfeld)" SWORD InjMass 1 100 -327.6800 327.6700 FORMAT "%8.4" ARRAY_SIZE 8 ECU_ADDRESS 0x6F8156 /end MEASUREMENT
/begin MEASUREMENT FMA_qReg_mp "Einspritzmengenfehler im aktuellen Lernbereich" SWORD InjMass 1 100 -327.6800 327.6700 FORMAT "%8.4" ECU_ADDRESS 0x8FEFFC /end MEASUREMENT
/begin MEASUREMENT FMA_qSetFil_mp "Initialisierungswert für Integrierer bzw. PT1-Filter" SWORD InjMass 1 100 -327.6800 327.6700 FORMAT "%8.4" ECU_ADDRESS 0x8FEFFE /end MEASUREMENT
/begin MEASUREMENT FMA_q_mp "Mit abshaltfactor multiplizierter Mengenfehler des Fehlermodells" SWORD InjMass 1 100 -327.6800 327.6700 FORMAT "%8.4" ECU_ADDRESS 0x6F80E4 /end MEASUREMENT
/begin MEASUREMENT FMA_stDynDlyd_mp "FMA-Status: Aktuell oder vor kurzem starke Änderung der Einspritzmenge (verzögerte Einspritzmengendynamik)" UBYTE OneToOne 1 100 0.00 255.0 FORMAT "%5.1" ECU_ADDRESS 0x8FF012 /end MEASUREMENT
/begin MEASUREMENT FMA_stDynLmbd_mp "FMA- Status: Aktuell oder bis vor kurzem starke Lambdaänderung" UBYTE OneToOne 1 100 0.00 255.0 FORMAT "%5.1" ECU_ADDRESS 0x8FF013 /end MEASUREMENT
/begin MEASUREMENT FMA_stNoAdapt_mp "Status: Adaption des FMA-Fehlermodells angehalten" UWORD OneToOne 1 100 0.00 65535.00 FORMAT "%8.2" ECU_ADDRESS 0x8FF014 /end MEASUREMENT
/begin MEASUREMENT FMA_stOvrRunDlyd_mp "FMA-Status: Aktuell oder bis vor kurzem Schubbetrieb (verzögerter Schubbetrieb)" UBYTE OneToOne 1 100 0.00 255.0 FORMAT "%5.1" ECU_ADDRESS 0x8FF016 /end MEASUREMENT
/begin MEASUREMENT FMA_stReset_mp "Status: FMA-Fehlermodell wird zurückgesetzt" UBYTE OneToOne 1 100 0.00 255.0 FORMAT "%5.1" ECU_ADDRESS 0x8FF017 /end MEASUREMENT
/begin MEASUREMENT FMA_stRngLmbd_mp "FMA_ Status: Lambda aktuell oder bis vor kurzem außerhalb" UBYTE OneToOne 1 100 0.00 255.0 FORMAT "%5.1" ECU_ADDRESS 0x8FF018 /end MEASUREMENT
/begin MEASUREMENT FMA_stSwtOff "Abschaltzustand der FMA" UWORD OneToOne 1 100 0.00 65535.00 FORMAT "%8.2" ECU_ADDRESS 0x7F8CBC /end MEASUREMENT
/begin MEASUREMENT FMA_tiFuncOp_mp "Betriebszeit des Fehlermodells seit der letzten Initialisierung der Lernwerte" SLONG Time_s 1 100 -21474836.4800 21474836.4700 FORMAT "%13.4" ECU_ADDRESS 0x6F8168 /end MEASUREMENT
/begin MEASUREMENT FMTC_etaCurr "aktueller Wirkunggsgrad (korrigiert)" SWORD Eta 1 100 -256.0000 255.9922 FORMAT "%8.4" ECU_ADDRESS 0x7F8CBE /end MEASUREMENT
/begin MEASUREMENT FMTC_etaCurrStd "aktueller Standard-Wirkungsgradfaktor (ohne Regenerationsmaßnahmen)" SWORD Eta 1 100 -256.0000 255.9922 FORMAT "%8.4" ECU_ADDRESS 0x7F8CC0 /end MEASUREMENT
/begin MEASUREMENT FMTC_facAirCor_mp "Eta-Korrekturfaktor für die Frischluft pro Zylinder" SWORD Fact 1 100 -4.000000 3.999878 FORMAT "%8.6" ECU_ADDRESS 0x8FF01A /end MEASUREMENT
/begin MEASUREMENT FMTC_facEtaCor "aktueller Wirkungsgradkorrekturwert" SWORD Fact 1 100 -4.000000 3.999878 FORMAT "%8.6" ECU_ADDRESS 0x7F8CC2 /end MEASUREMENT
/begin MEASUREMENT FMTC_facStrtInjCor_mp "Eta-Korrekturfaktor für den Spritzbeginn" SWORD Fact 1 100 -4.000000 3.999878 FORMAT "%8.6" ECU_ADDRESS 0x8FF01C /end MEASUREMENT
/begin MEASUREMENT FMTC_mAirDiff_mp "Differenz Luftmasse optimal-aktueller Wert" SWORD AirMassPerCyl 1 100 -3276.800 3276.700 FORMAT "%8.3" ECU_ADDRESS 0x8FF01E /end MEASUREMENT
/begin MEASUREMENT FMTC_mAirOpt_mp "Eta-Korrektur, Referenzwert für die Luft pro Zylinder" SWORD AirMassPerCyl 1 100 -3276.800 3276.700 FORMAT "%8.3" ECU_ADDRESS 0x8FF020 /end MEASUREMENT
/begin MEASUREMENT FMTC_phiStrtInjDiff_mp "Differenz Spritzbeginn optimal-aktueller Wert" SWORD AngleCrS 1 100 -768.0000 767.9766 FORMAT "%8.4" ECU_ADDRESS 0x8FF022 /end MEASUREMENT
/begin MEASUREMENT FMTC_phiStrtInjOpt_mp "aktueller Seferenzwert für Spritzbeginnkorrektur" SWORD AngleCrS 1 100 -768.0000 767.9766 FORMAT "%8.4" ECU_ADDRESS 0x8FF024 /end MEASUREMENT
/begin MEASUREMENT FMTC_qCurr "Einspritzmenge aktueller Wert" SWORD InjMass 1 100 -327.6800 327.6700 FORMAT "%8.4" ECU_ADDRESS 0x7F8CC4 /end MEASUREMENT
/begin MEASUREMENT FMTC_qDes "Einspritzmenge Wunschwert" SWORD InjMass 1 100 -327.6800 327.6700 FORMAT "%8.4" ECU_ADDRESS 0x7F8CC6 /end MEASUREMENT
/begin MEASUREMENT FMTC_qRaw "Einspritzmenge Rohwert (>Luftsystem)" SWORD InjMass 1 100 -327.6800 327.6700 FORMAT "%8.4" ECU_ADDRESS 0x7F8CC8 /end MEASUREMENT
/begin MEASUREMENT FMTC_qSet "Einspritzmenge Sollwert (>Einspritzung)" SWORD InjMass 1 100 -327.6800 327.6700 FORMAT "%8.4" ECU_ADDRESS 0x7F8CCA /end MEASUREMENT
/begin MEASUREMENT FMTC_qSetOptStd_mp "optimale Standardsollmenge ohne Korrekturen" SWORD InjMass 1 100 -327.6800 327.6700 FORMAT "%8.4" ECU_ADDRESS 0x8FF026 /end MEASUREMENT
/begin MEASUREMENT FMTC_qSetRgn1_mp "Regenerationseinspritzmenge Sollwert mit Berücksichtigung einer Regenerationsanforderung 1 der Abgasnachbehandlung" SWORD InjMass 1 100 -327.6800 327.6700 FORMAT "%8.4" ECU_ADDRESS 0x8FF028 /end MEASUREMENT
/begin MEASUREMENT FMTC_qSetRgn2_mp "Regenerationseinspritzmenge Sollwert mit Berücksichtigung einer Regenerationsanforderung 2 der Abgasnachbehandlung" SWORD InjMass 1 100 -327.6800 327.6700 FORMAT "%8.4" ECU_ADDRESS 0x8FF02A /end MEASUREMENT
/begin MEASUREMENT FMTC_qSetStd_mp "Standardeinspritzmenge Sollwert ohne Berücksichtigung der Regenerationsanforderung der Abgasnachbehandlung" SWORD InjMass 1 100 -327.6800 327.6700 FORMAT "%8.4" ECU_ADDRESS 0x8FF02C /end MEASUREMENT
/begin MEASUREMENT FMTC_qStrt "Einspritzmenge Startwert" SWORD InjMass 1 100 -327.6800 327.6700 FORMAT "%8.4" ECU_ADDRESS 0x7F8CCC /end MEASUREMENT
/begin MEASUREMENT FMTC_trqInr "aktuelles rückgerechnetes inneres Motormoment" SWORD Trq 1 100 -3276.800 3276.700 FORMAT "%8.3" ECU_ADDRESS 0x7F8CCE /end MEASUREMENT
/begin MEASUREMENT FMTC_trqInrLimSmk "Begrenzungsmoment Rauchgrenze" SWORD Trq 1 100 -3276.800 3276.700 FORMAT "%8.3" ECU_ADDRESS 0x7F8CD0 /end MEASUREMENT
/begin MEASUREMENT FrmMng_ctrIdxNo "index counter for velocities" UBYTE OneToOne 1 100 0.00 255.0 FORMAT "%5.1" ECU_ADDRESS 0x7F888F /end MEASUREMENT
/begin MEASUREMENT FrmMng_dOBDCtl_mp "Measuring Point for OBD status" UBYTE OneToOne 1 100 0.00 255.0 FORMAT "%5.1" ECU_ADDRESS 0x8FF02E /end MEASUREMENT
/begin MEASUREMENT FrmMng_nPSP "Ist-Drehzahl EKP" SWORD PSP_Spd 1 100 -32768.00 32767.00 FORMAT "%8.2" ECU_ADDRESS 0x7F8CFA /end MEASUREMENT
/begin MEASUREMENT FrmMng_numASC1byte0_mp "Rohwerte von der CAN-Botschaft ASC1" UBYTE OneToOne 1 100 0.00 255.0 FORMAT "%5.1" ECU_ADDRESS 0x8FF02F /end MEASUREMENT
/begin MEASUREMENT FrmMng_numASC1byte1_mp "Rohwerte von der CAN-Botschaft ASC1" UBYTE OneToOne 1 100 0.00 255.0 FORMAT "%5.1" ECU_ADDRESS 0x8FF030 /end MEASUREMENT
/begin MEASUREMENT FrmMng_numASC1byte2_mp "Rohwerte von der CAN-Botschaft ASC1" UBYTE OneToOne 1 100 0.00 255.0 FORMAT "%5.1" ECU_ADDRESS 0x8FF031 /end MEASUREMENT
/begin MEASUREMENT FrmMng_numASC1byte3_mp "Rohwerte von der CAN-Botschaft ASC1" UBYTE OneToOne 1 100 0.00 255.0 FORMAT "%5.1" ECU_ADDRESS 0x8FF032 /end MEASUREMENT
/begin MEASUREMENT FrmMng_numASC1byte4_mp "Rohwerte von der CAN-Botschaft ASC1" UBYTE OneToOne 1 100 0.00 255.0 FORMAT "%5.1" ECU_ADDRESS 0x8FF033 /end MEASUREMENT
/begin MEASUREMENT FrmMng_numASC1byte5_mp "Rohwerte von der CAN-Botschaft ASC1" UBYTE OneToOne 1 100 0.00 255.0 FORMAT "%5.1" ECU_ADDRESS 0x8FF034 /end MEASUREMENT
/begin MEASUREMENT FrmMng_numASC1byte6_mp "Rohwerte von der CAN-Botschaft ASC1" UBYTE OneToOne 1 100 0.00 255.0 FORMAT "%5.1" ECU_ADDRESS 0x8FF035 /end MEASUREMENT
/begin MEASUREMENT FrmMng_numASC1byte7_mp "Rohwerte von der CAN-Botschaft ASC1" UBYTE OneToOne 1 100 0.00 255.0 FORMAT "%5.1" ECU_ADDRESS 0x8FF036 /end MEASUREMENT
/begin MEASUREMENT FrmMng_numASC2byte0_mp "Rohwerte von der CAN-Botschaft ASC2" UBYTE OneToOne 1 100 0.00 255.0 FORMAT "%5.1" ECU_ADDRESS 0x8FF037 /end MEASUREMENT
/begin MEASUREMENT FrmMng_numASC2byte1_mp "Rohwerte von der CAN-Botschaft ASC2" UBYTE OneToOne 1 100 0.00 255.0 FORMAT "%5.1" ECU_ADDRESS 0x8FF038 /end MEASUREMENT
/begin MEASUREMENT FrmMng_numASC2byte2_mp "Rohwerte von der CAN-Botschaft ASC2" UBYTE OneToOne 1 100 0.00 255.0 FORMAT "%5.1" ECU_ADDRESS 0x8FF039 /end MEASUREMENT
/begin MEASUREMENT FrmMng_numASC2byte3_mp "Rohwerte von der CAN-Botschaft ASC2" UBYTE OneToOne 1 100 0.00 255.0 FORMAT "%5.1" ECU_ADDRESS 0x8FF03A /end MEASUREMENT
/begin MEASUREMENT FrmMng_numASC2byte4_mp "Rohwerte von der CAN-Botschaft ASC2" UBYTE OneToOne 1 100 0.00 255.0 FORMAT "%5.1" ECU_ADDRESS 0x8FF03B /end MEASUREMENT
/begin MEASUREMENT FrmMng_numASC2byte5_mp "Rohwerte von der CAN-Botschaft ASC2" UBYTE OneToOne 1 100 0.00 255.0 FORMAT "%5.1" ECU_ADDRESS 0x8FF03C /end MEASUREMENT
/begin MEASUREMENT FrmMng_numASC2byte6_mp "Rohwerte von der CAN-Botschaft ASC2" UBYTE OneToOne 1 100 0.00 255.0 FORMAT "%5.1" ECU_ADDRESS 0x8FF03D /end MEASUREMENT
/begin MEASUREMENT FrmMng_numASC2byte7_mp "Rohwerte von der CAN-Botschaft ASC2" UBYTE OneToOne 1 100 0.00 255.0 FORMAT "%5.1" ECU_ADDRESS 0x8FF03E /end MEASUREMENT
/begin MEASUREMENT FrmMng_numASC3byte0_mp "Rohwerte von der CAN-Botschaft ASC3" UBYTE OneToOne 1 100 0.00 255.0 FORMAT "%5.1" ECU_ADDRESS 0x8FF03F /end MEASUREMENT
/begin MEASUREMENT FrmMng_numASC3byte1_mp "Rohwerte von der CAN-Botschaft ASC3" UBYTE OneToOne 1 100 0.00 255.0 FORMAT "%5.1" ECU_ADDRESS 0x8FF040 /end MEASUREMENT
/begin MEASUREMENT FrmMng_numASC3byte2_mp "Rohwerte von der CAN-Botschaft ASC3" UBYTE OneToOne 1 100 0.00 255.0 FORMAT "%5.1" ECU_ADDRESS 0x8FF041 /end MEASUREMENT
/begin MEASUREMENT FrmMng_numASC3byte3_mp "Rohwerte von der CAN-Botschaft ASC3" UBYTE OneToOne 1 100 0.00 255.0 FORMAT "%5.1" ECU_ADDRESS 0x8FF042 /end MEASUREMENT
/begin MEASUREMENT FrmMng_numASC3byte4_mp "Rohwerte von der CAN-Botschaft ASC3" UBYTE OneToOne 1 100 0.00 255.0 FORMAT "%5.1" ECU_ADDRESS 0x8FF043 /end MEASUREMENT
/begin MEASUREMENT FrmMng_numASC3byte5_mp "Rohwerte von der CAN-Botschaft ASC3" UBYTE OneToOne 1 100 0.00 255.0 FORMAT "%5.1" ECU_ADDRESS 0x8FF044 /end MEASUREMENT
/begin MEASUREMENT FrmMng_numASC3byte6_mp "Rohwerte von der CAN-Botschaft ASC3" UBYTE OneToOne 1 100 0.00 255.0 FORMAT "%5.1" ECU_ADDRESS 0x8FF045 /end MEASUREMENT
/begin MEASUREMENT FrmMng_numASC3byte7_mp "Rohwerte von der CAN-Botschaft ASC3" UBYTE OneToOne 1 100 0.00 255.0 FORMAT "%5.1" ECU_ADDRESS 0x8FF046 /end MEASUREMENT
/begin MEASUREMENT FrmMng_numASC4byte0_mp "Rohwerte von der CAN-Botschaft ASC4" UBYTE OneToOne 1 100 0.00 255.0 FORMAT "%5.1" ECU_ADDRESS 0x8FF047 /end MEASUREMENT
/begin MEASUREMENT FrmMng_numASC4byte1_mp "Rohwerte von der CAN-Botschaft ASC4" UBYTE OneToOne 1 100 0.00 255.0 FORMAT "%5.1" ECU_ADDRESS 0x8FF048 /end MEASUREMENT
/begin MEASUREMENT FrmMng_numASC4byte2_mp "Rohwerte von der CAN-Botschaft ASC4" UBYTE OneToOne 1 100 0.00 255.0 FORMAT "%5.1" ECU_ADDRESS 0x8FF049 /end MEASUREMENT
/begin MEASUREMENT FrmMng_numASC4byte3_mp "Rohwerte von der CAN-Botschaft ASC4" UBYTE OneToOne 1 100 0.00 255.0 FORMAT "%5.1" ECU_ADDRESS 0x8FF04A /end MEASUREMENT
/begin MEASUREMENT FrmMng_numASC4byte4_mp "Rohwerte von der CAN-Botschaft ASC4" UBYTE OneToOne 1 100 0.00 255.0 FORMAT "%5.1" ECU_ADDRESS 0x8FF04B /end MEASUREMENT
/begin MEASUREMENT FrmMng_numASC4byte5_mp "Rohwerte von der CAN-Botschaft ASC4" UBYTE OneToOne 1 100 0.00 255.0 FORMAT "%5.1" ECU_ADDRESS 0x8FF04C /end MEASUREMENT
/begin MEASUREMENT FrmMng_numASC4byte6_mp "Rohwerte von der CAN-Botschaft ASC4" UBYTE OneToOne 1 100 0.00 255.0 FORMAT "%5.1" ECU_ADDRESS 0x8FF04D /end MEASUREMENT
/begin MEASUREMENT FrmMng_numASC4byte7_mp "Rohwerte von der CAN-Botschaft ASC4" UBYTE OneToOne 1 100 0.00 255.0 FORMAT "%5.1" ECU_ADDRESS 0x8FF04E /end MEASUREMENT
/begin MEASUREMENT FrmMng_numDDE1byte0_mp "Rohwerte für DDE1" UBYTE OneToOne 1 100 0.00 255.0 FORMAT "%5.1" ECU_ADDRESS 0x8FF04F /end MEASUREMENT
/begin MEASUREMENT FrmMng_numDDE1byte1_mp "Rohwete für DDE1" UBYTE OneToOne 1 100 0.00 255.0 FORMAT "%5.1" ECU_ADDRESS 0x8FF050 /end MEASUREMENT
/begin MEASUREMENT FrmMng_numDDE1byte2_mp "Rohwerte für DDE1" UBYTE OneToOne 1 100 0.00 255.0 FORMAT "%5.1" ECU_ADDRESS 0x8FF051 /end MEASUREMENT
/begin MEASUREMENT FrmMng_numDDE1byte3_mp "Rohwerte für DDE1" UBYTE OneToOne 1 100 0.00 255.0 FORMAT "%5.1" ECU_ADDRESS 0x8FF052 /end MEASUREMENT
/begin MEASUREMENT FrmMng_numDDE1byte4_mp "Rohwerte für DDE1" UBYTE OneToOne 1 100 0.00 255.0 FORMAT "%5.1" ECU_ADDRESS 0x8FF053 /end MEASUREMENT
/begin MEASUREMENT FrmMng_numDDE1byte5_mp "Rohwerte für DDE1" UBYTE OneToOne 1 100 0.00 255.0 FORMAT "%5.1" ECU_ADDRESS 0x8FF054 /end MEASUREMENT
/begin MEASUREMENT FrmMng_numDDE1byte6_mp "Rohwerte für DDE1" UBYTE OneToOne 1 100 0.00 255.0 FORMAT "%5.1" ECU_ADDRESS 0x8FF055 /end MEASUREMENT
/begin MEASUREMENT FrmMng_numDDE1byte7_mp "Rohwerte für DDE1" UBYTE OneToOne 1 100 0.00 255.0 FORMAT "%5.1" ECU_ADDRESS 0x8FF056 /end MEASUREMENT
/begin MEASUREMENT FrmMng_numDDE2byte0_mp "Rohwerte für DDE2" UBYTE OneToOne 1 100 0.00 255.0 FORMAT "%5.1" ECU_ADDRESS 0x8FF057 /end MEASUREMENT
/begin MEASUREMENT FrmMng_numDDE2byte1_mp "Rohwerte für DDE2" UBYTE OneToOne 1 100 0.00 255.0 FORMAT "%5.1" ECU_ADDRESS 0x8FF058 /end MEASUREMENT
/begin MEASUREMENT FrmMng_numDDE2byte2_mp "Rohwerte für DDE2" UBYTE OneToOne 1 100 0.00 255.0 FORMAT "%5.1" ECU_ADDRESS 0x8FF059 /end MEASUREMENT
/begin MEASUREMENT FrmMng_numDDE2byte3_mp "Rohwerte für DDE2" UBYTE OneToOne 1 100 0.00 255.0 FORMAT "%5.1" ECU_ADDRESS 0x8FF05A /end MEASUREMENT
/begin MEASUREMENT FrmMng_numDDE2byte4_mp "Rohwerte für DDE2" UBYTE OneToOne 1 100 0.00 255.0 FORMAT "%5.1" ECU_ADDRESS 0x8FF05B /end MEASUREMENT
/begin MEASUREMENT FrmMng_numDDE2byte5_mp "Rohwerte für DDE2" UBYTE OneToOne 1 100 0.00 255.0 FORMAT "%5.1" ECU_ADDRESS 0x8FF05C /end MEASUREMENT
/begin MEASUREMENT FrmMng_numDDE2byte6_mp "Rohwerte für DDE2" UBYTE OneToOne 1 100 0.00 255.0 FORMAT "%5.1" ECU_ADDRESS 0x8FF05D /end MEASUREMENT
/begin MEASUREMENT FrmMng_numDDE2byte7_mp "Rohwerte für DDE2" UBYTE OneToOne 1 100 0.00 255.0 FORMAT "%5.1" ECU_ADDRESS 0x8FF05E /end MEASUREMENT
/begin MEASUREMENT FrmMng_numDDE4byte0_mp "Rohwerte für DDE4" UBYTE OneToOne 1 100 0.00 255.0 FORMAT "%5.1" ECU_ADDRESS 0x8FF05F /end MEASUREMENT
/begin MEASUREMENT FrmMng_numDDE4byte1_mp "Rohwerte für DDE4" UBYTE OneToOne 1 100 0.00 255.0 FORMAT "%5.1" ECU_ADDRESS 0x8FF060 /end MEASUREMENT
/begin MEASUREMENT FrmMng_numDDE4byte2_mp "Rohwerte für DDE4" UBYTE OneToOne 1 100 0.00 255.0 FORMAT "%5.1" ECU_ADDRESS 0x8FF061 /end MEASUREMENT
/begin MEASUREMENT FrmMng_numDDE4byte3_mp "Rohwerte für DDE4" UBYTE OneToOne 1 100 0.00 255.0 FORMAT "%5.1" ECU_ADDRESS 0x8FF062 /end MEASUREMENT
/begin MEASUREMENT FrmMng_numDDE4byte4_mp "Rohwerte für DDE4" UBYTE OneToOne 1 100 0.00 255.0 FORMAT "%5.1" ECU_ADDRESS 0x8FF063 /end MEASUREMENT
/begin MEASUREMENT FrmMng_numDDE4byte5_mp "Rohwerte für DDE4" UBYTE OneToOne 1 100 0.00 255.0 FORMAT "%5.1" ECU_ADDRESS 0x8FF064 /end MEASUREMENT
/begin MEASUREMENT FrmMng_numDDE4byte6_mp "Rohwerte für DDE4" UBYTE OneToOne 1 100 0.00 255.0 FORMAT "%5.1" ECU_ADDRESS 0x8FF065 /end MEASUREMENT
/begin MEASUREMENT FrmMng_numDDE4byte7_mp "Rohwerte für DDE4" UBYTE OneToOne 1 100 0.00 255.0 FORMAT "%5.1" ECU_ADDRESS 0x8FF066 /end MEASUREMENT
/begin MEASUREMENT FrmMng_numEGS1byte0_mp "Rohwerte von der Can-Botschaft EGS1" UBYTE OneToOne 1 100 0.00 255.0 FORMAT "%5.1" ECU_ADDRESS 0x8FF067 /end MEASUREMENT
/begin MEASUREMENT FrmMng_numEGS1byte1_mp "Rohwerte von der Can-Botschaft EGS1" UBYTE OneToOne 1 100 0.00 255.0 FORMAT "%5.1" ECU_ADDRESS 0x8FF068 /end MEASUREMENT
/begin MEASUREMENT FrmMng_numEGS1byte2_mp "Rohwerte von der Can-Botschaft EGS1" UBYTE OneToOne 1 100 0.00 255.0 FORMAT "%5.1" ECU_ADDRESS 0x8FF069 /end MEASUREMENT
/begin MEASUREMENT FrmMng_numEGS1byte3_mp "Rohwerte von der Can-Botschaft EGS1" UBYTE OneToOne 1 100 0.00 255.0 FORMAT "%5.1" ECU_ADDRESS 0x8FF06A /end MEASUREMENT
/begin MEASUREMENT FrmMng_numEGS1byte4_mp "Rohwerte von der Can - Botschaft EGS1" UBYTE OneToOne 1 100 0.00 255.0 FORMAT "%5.1" ECU_ADDRESS 0x8FF06B /end MEASUREMENT
/begin MEASUREMENT FrmMng_numEGS1byte5_mp "Rohwerte von der Can - Botschaft EGS1" UBYTE OneToOne 1 100 0.00 255.0 FORMAT "%5.1" ECU_ADDRESS 0x8FF06C /end MEASUREMENT
/begin MEASUREMENT FrmMng_numEGS1byte6_mp "Rohwerte von der Canbotschaft EGS1" UBYTE OneToOne 1 100 0.00 255.0 FORMAT "%5.1" ECU_ADDRESS 0x8FF06D /end MEASUREMENT
/begin MEASUREMENT FrmMng_numEGS1byte7_mp "Rohwerte von der Canbotschaft EGS1" UBYTE OneToOne 1 100 0.00 255.0 FORMAT "%5.1" ECU_ADDRESS 0x8FF06E /end MEASUREMENT
/begin MEASUREMENT FrmMng_numEGS2byte0_mp "Rohwerte von der CAN-Botschaft EGS2" UBYTE OneToOne 1 100 0.00 255.0 FORMAT "%5.1" ECU_ADDRESS 0x8FF06F /end MEASUREMENT
/begin MEASUREMENT FrmMng_numEGS2byte1_mp "Rohwerte von der CAN-Botschaft EGS2" UBYTE OneToOne 1 100 0.00 255.0 FORMAT "%5.1" ECU_ADDRESS 0x8FF070 /end MEASUREMENT
/begin MEASUREMENT FrmMng_numEGS2byte2_mp "Rohwerte von der CAN-Botschaft EGS2" UBYTE OneToOne 1 100 0.00 255.0 FORMAT "%5.1" ECU_ADDRESS 0x8FF071 /end MEASUREMENT
/begin MEASUREMENT FrmMng_numEGS2byte3_mp "Rohwerte von der CAN-Botschaft EGS2" UBYTE OneToOne 1 100 0.00 255.0 FORMAT "%5.1" ECU_ADDRESS 0x8FF072 /end MEASUREMENT
/begin MEASUREMENT FrmMng_numEGS2byte4_mp "Rohwerte von der CAN-Botschaft EGS2" UBYTE OneToOne 1 100 0.00 255.0 FORMAT "%5.1" ECU_ADDRESS 0x8FF073 /end MEASUREMENT
/begin MEASUREMENT FrmMng_numEGS2byte5_mp "Rohwerte von der CAN-Botschaft EGS2" UBYTE OneToOne 1 100 0.00 255.0 FORMAT "%5.1" ECU_ADDRESS 0x8FF074 /end MEASUREMENT
/begin MEASUREMENT FrmMng_numEGS2byte6_mp "Rohwerte von der CAN-Botschaft EGS2" UBYTE OneToOne 1 100 0.00 255.0 FORMAT "%5.1" ECU_ADDRESS 0x8FF075 /end MEASUREMENT
/begin MEASUREMENT FrmMng_numEGS2byte7_mp "Rohwerte von der CAN-Botschaft EGS2" UBYTE OneToOne 1 100 0.00 255.0 FORMAT "%5.1" ECU_ADDRESS 0x8FF076 /end MEASUREMENT
/begin MEASUREMENT FrmMng_numEKPbyte0_mp "Byte 1 von EKP-CAN-Botschaft" UBYTE OneToOne 1 100 0.00 255.0 FORMAT "%5.1" ECU_ADDRESS 0x8FF077 /end MEASUREMENT
/begin MEASUREMENT FrmMng_numEKPbyte1_mp "Byte 2 von EKP-CAN-Botschaft" UBYTE OneToOne 1 100 0.00 255.0 FORMAT "%5.1" ECU_ADDRESS 0x8FF078 /end MEASUREMENT
/begin MEASUREMENT FrmMng_numEKPbyte2_mp "Byte 3 von EKP-CAN-Botschaft" UBYTE OneToOne 1 100 0.00 255.0 FORMAT "%5.1" ECU_ADDRESS 0x8FF079 /end MEASUREMENT
/begin MEASUREMENT FrmMng_numEKPbyte3_mp "Byte 4 von EKP-CAN-Botschaft" UBYTE OneToOne 1 100 0.00 255.0 FORMAT "%5.1" ECU_ADDRESS 0x8FF07A /end MEASUREMENT
/begin MEASUREMENT FrmMng_numINSTR2byte0_mp "Rohwert INSTR2-Byte0" UBYTE OneToOne 1 100 0.00 255.0 FORMAT "%5.1" ECU_ADDRESS 0x8FF07B /end MEASUREMENT
/begin MEASUREMENT FrmMng_numINSTR2byte1_mp "Rohwert INSTR2-Byte1" UBYTE OneToOne 1 100 0.00 255.0 FORMAT "%5.1" ECU_ADDRESS 0x8FF07C /end MEASUREMENT
/begin MEASUREMENT FrmMng_numINSTR2byte2_mp "Rohwert INSTR2-Byte2" UBYTE OneToOne 1 100 0.00 255.0 FORMAT "%5.1" ECU_ADDRESS 0x8FF07D /end MEASUREMENT
/begin MEASUREMENT FrmMng_numINSTR2byte3_mp "Rohwert INSTR2-Byte3" UBYTE OneToOne 1 100 0.00 255.0 FORMAT "%5.1" ECU_ADDRESS 0x8FF07E /end MEASUREMENT
/begin MEASUREMENT FrmMng_numINSTR2byte4_mp "Rohwert INSTR2-Byte4" UBYTE OneToOne 1 100 0.00 255.0 FORMAT "%5.1" ECU_ADDRESS 0x8FF07F /end MEASUREMENT
/begin MEASUREMENT FrmMng_numINSTR2byte5_mp "Rohwert INSTR2-Byte5" UBYTE OneToOne 1 100 0.00 255.0 FORMAT "%5.1" ECU_ADDRESS 0x8FF080 /end MEASUREMENT
/begin MEASUREMENT FrmMng_numINSTR2byte6_mp "Rohwert INSTR2-Byte6" UBYTE OneToOne 1 100 0.00 255.0 FORMAT "%5.1" ECU_ADDRESS 0x8FF081 /end MEASUREMENT
/begin MEASUREMENT FrmMng_numINSTR2byte7_mp "Rohwert INSTR2-Byte7" UBYTE OneToOne 1 100 0.00 255.0 FORMAT "%5.1" ECU_ADDRESS 0x8FF082 /end MEASUREMENT
/begin MEASUREMENT FrmMng_numINSTR3byte0_mp "Rohwert INSTR3-Byte0" UBYTE OneToOne 1 100 0.00 255.0 FORMAT "%5.1" ECU_ADDRESS 0x8FF083 /end MEASUREMENT
/begin MEASUREMENT FrmMng_numINSTR3byte1_mp "Rohwert INSTR3-Byte1" UBYTE OneToOne 1 100 0.00 255.0 FORMAT "%5.1" ECU_ADDRESS 0x8FF084 /end MEASUREMENT
/begin MEASUREMENT FrmMng_numINSTR3byte2_mp "Rohwert INSTR3-Byte2" UBYTE OneToOne 1 100 0.00 255.0 FORMAT "%5.1" ECU_ADDRESS 0x8FF085 /end MEASUREMENT
/begin MEASUREMENT FrmMng_numINSTR3byte3_mp "Rohwert INSTR3-Byte3" UBYTE OneToOne 1 100 0.00 255.0 FORMAT "%5.1" ECU_ADDRESS 0x8FF086 /end MEASUREMENT
/begin MEASUREMENT FrmMng_numINSTR3byte4_mp "Rohwert INSTR3-Byte4" UBYTE OneToOne 1 100 0.00 255.0 FORMAT "%5.1" ECU_ADDRESS 0x8FF087 /end MEASUREMENT
/begin MEASUREMENT FrmMng_numINSTR3byte5_mp "Rohwert INSTR3-Byte5" UBYTE OneToOne 1 100 0.00 255.0 FORMAT "%5.1" ECU_ADDRESS 0x8FF088 /end MEASUREMENT
/begin MEASUREMENT FrmMng_numINSTR3byte6_mp "Rohwert INSTR3-Byte6" UBYTE OneToOne 1 100 0.00 255.0 FORMAT "%5.1" ECU_ADDRESS 0x8FF089 /end MEASUREMENT
/begin MEASUREMENT FrmMng_numINSTR3byte7_mp "Rohwert INSTR3-Byte7" UBYTE OneToOne 1 100 0.00 255.0 FORMAT "%5.1" ECU_ADDRESS 0x8FF08A /end MEASUREMENT
/begin MEASUREMENT FrmMng_pAir "Atmosphärendruck über CAN" SWORD Pres_hPa 1 100 -32768.00 32767.00 FORMAT "%8.2" ECU_ADDRESS 0x7F8D04 /end MEASUREMENT
/begin MEASUREMENT FrmMng_rPSPSetPoint "Aktuelle Stellgröße der EKP-Regelung" SWORD Prc 1 100 -400.0000 399.9878 FORMAT "%8.4" ECU_ADDRESS 0x7F8D10 /end MEASUREMENT
/begin MEASUREMENT FrmMng_rTrqDCS_mp "Meßpunkt für Verhältnis MSR-Anforderungsmoment / Maximalmoment" SWORD Prc 1 100 -400.0000 399.9878 FORMAT "%8.4" ECU_ADDRESS 0x8FF08C /end MEASUREMENT
/begin MEASUREMENT FrmMng_rTrqGearbxFrc_mp "MD_GETRIEBE nach Normalisation" SWORD Prc 1 100 -400.0000 399.9878 FORMAT "%8.4" ECU_ADDRESS 0x8FF08E /end MEASUREMENT
/begin MEASUREMENT FrmMng_rTrqGearbx_mp "MD_IND_GS nach Normalisation" SWORD Prc 1 100 -400.0000 399.9878 FORMAT "%8.4" ECU_ADDRESS 0x8FF090 /end MEASUREMENT
/begin MEASUREMENT FrmMng_rTrqTCS_mp "Meßpunkt für Verhältnis ASR-Anforderungsmoment / Maximalmoment" SWORD Prc 1 100 -400.0000 399.9878 FORMAT "%8.4" ECU_ADDRESS 0x8FF092 /end MEASUREMENT
/begin MEASUREMENT FrmMng_stAC "Klimaanlagenzustand über CAN" UWORD OneToOne 1 100 0.00 65535.00 FORMAT "%8.2" ECU_ADDRESS 0x7F8D14 /end MEASUREMENT
/begin MEASUREMENT FrmMng_stACHtgReq "Heizleistungsanforderung über CAN" UBYTE OneToOne 1 100 0.00 255.0 FORMAT "%5.1" ECU_ADDRESS 0x7F889D /end MEASUREMENT
/begin MEASUREMENT FrmMng_stASC1Sig_mp "Signal-Error-Status ASC1" UWORD OneToOne 1 100 0.00 65535.00 FORMAT "%8.2" ECU_ADDRESS 0x8FF094 /end MEASUREMENT
/begin MEASUREMENT FrmMng_stASC2Sig_mp "Signal-Error-Status ASC2" UWORD OneToOne 1 100 0.00 65535.00 FORMAT "%8.2" ECU_ADDRESS 0x8FF096 /end MEASUREMENT
/begin MEASUREMENT FrmMng_stASC3Sig_mp "Signal-Error-Status ASC3" UWORD OneToOne 1 100 0.00 65535.00 FORMAT "%8.2" ECU_ADDRESS 0x8FF098 /end MEASUREMENT
/begin MEASUREMENT FrmMng_stASC4Sig_mp "Signalerrorstate ASC4" UWORD OneToOne 1 100 0.00 65535.00 FORMAT "%8.2" ECU_ADDRESS 0x8FF09A /end MEASUREMENT
/begin MEASUREMENT FrmMng_stASCok "status ASC Eingriff" UBYTE OneToOne 1 100 0.00 255.0 FORMAT "%5.1" ECU_ADDRESS 0x7F88A1 /end MEASUREMENT
/begin MEASUREMENT FrmMng_stBrkTCS_mp "Bremsstatus TCS" UBYTE OneToOne 1 100 0.00 255.0 FORMAT "%5.1" ECU_ADDRESS 0x8FF09C /end MEASUREMENT
/begin MEASUREMENT FrmMng_stCrCCDKey_mp "Bediensignal FGR" UBYTE OneToOne 1 100 0.00 255.0 FORMAT "%5.1" ECU_ADDRESS 0x8FF09D /end MEASUREMENT
/begin MEASUREMENT FrmMng_stCrCtlOff_mp "FGR Abschaltung von DSC" UBYTE OneToOne 1 100 0.00 255.0 FORMAT "%5.1" ECU_ADDRESS 0x8FF09E /end MEASUREMENT
/begin MEASUREMENT FrmMng_stDCSActive_mp "Signal B_MSR von CAN, MSR Eingriff aktiv" UBYTE OneToOne 1 100 0.00 255.0 FORMAT "%5.1" ECU_ADDRESS 0x8FF09F /end MEASUREMENT
/begin MEASUREMENT FrmMng_stDSCCtrl_mp "DSC Eingriff" UBYTE OneToOne 1 100 0.00 255.0 FORMAT "%5.1" ECU_ADDRESS 0x8FF0A0 /end MEASUREMENT
/begin MEASUREMENT FrmMng_stDSCDelay_mp "Status für DSC delay" UBYTE OneToOne 1 100 0.00 255.0 FORMAT "%5.1" ECU_ADDRESS 0x8FF0A1 /end MEASUREMENT
/begin MEASUREMENT FrmMng_stEGS1Sig_mp "Zustand des Getriebes" UWORD OneToOne 1 100 0.00 65535.00 FORMAT "%8.2" ECU_ADDRESS 0x8FF0A2 /end MEASUREMENT
/begin MEASUREMENT FrmMng_stEGS2Sig_mp "Signal-Error-Status EGS2" UWORD OneToOne 1 100 0.00 65535.00 FORMAT "%8.2" ECU_ADDRESS 0x8FF0A4 /end MEASUREMENT
/begin MEASUREMENT FrmMng_stEngRun_mp "Motorlaufzustand über CAN" UBYTE OneToOne 1 100 0.00 255.0 FORMAT "%5.1" ECU_ADDRESS 0x8FF0A6 /end MEASUREMENT
/begin MEASUREMENT FrmMng_stExc_ASC1_mp "Exceptionstate von CAN-Botschaft (errors, freeze, ...)" UWORD OneToOne 1 100 0.00 65535.00 FORMAT "%8.2" ECU_ADDRESS 0x8FF0A8 /end MEASUREMENT
/begin MEASUREMENT FrmMng_stExc_ASC2_mp "Exceptionstate von CAN-Botschaft (errors, freeze, ...)" UWORD OneToOne 1 100 0.00 65535.00 FORMAT "%8.2" ECU_ADDRESS 0x8FF0AA /end MEASUREMENT
/begin MEASUREMENT FrmMng_stExc_ASC3_mp "Exceptionstate von CAN-Botschaft (errors, freeze, ...)" UWORD OneToOne 1 100 0.00 65535.00 FORMAT "%8.2" ECU_ADDRESS 0x8FF0AC /end MEASUREMENT
/begin MEASUREMENT FrmMng_stExc_ASC4_mp "" UWORD OneToOne 1 100 0.00 65535.00 FORMAT "%8.2" ECU_ADDRESS 0x8FF0AE /end MEASUREMENT
/begin MEASUREMENT FrmMng_stExc_EGS1_mp "Exceptionstate von CAN-Botschaft ( errors, freeze, ... )" UWORD OneToOne 1 100 0.00 65535.00 FORMAT "%8.2" ECU_ADDRESS 0x8FF0B0 /end MEASUREMENT
/begin MEASUREMENT FrmMng_stExc_EGS2_mp "Exceptionstate von CAN-Botschaft (errors, freeze, ...)" UWORD OneToOne 1 100 0.00 65535.00 FORMAT "%8.2" ECU_ADDRESS 0x8FF0B2 /end MEASUREMENT
/begin MEASUREMENT FrmMng_stExc_INSTR2_mp "Exception-State INSTR2" UWORD OneToOne 1 100 0.00 65535.00 FORMAT "%8.2" ECU_ADDRESS 0x8FF0B4 /end MEASUREMENT
/begin MEASUREMENT FrmMng_stExc_INSTR3_mp "Exception-State INSTR3" UWORD OneToOne 1 100 0.00 65535.00 FORMAT "%8.2" ECU_ADDRESS 0x8FF0B6 /end MEASUREMENT
/begin MEASUREMENT FrmMng_stINSTR2Sig_mp "Signalerrorstatus INSTR2" UWORD OneToOne 1 100 0.00 65535.00 FORMAT "%8.2" ECU_ADDRESS 0x8FF0B8 /end MEASUREMENT
/begin MEASUREMENT FrmMng_stINSTR3Sig_mp "Signalerrorstatus INSTR3" UWORD OneToOne 1 100 0.00 65535.00 FORMAT "%8.2" ECU_ADDRESS 0x8FF0BA /end MEASUREMENT
/begin MEASUREMENT FrmMng_stOldstStart "vorheriger Start-Status" UBYTE OneToOne 1 100 0.00 255.0 FORMAT "%5.1" ECU_ADDRESS 0x7F88C3 /end MEASUREMENT
/begin MEASUREMENT FrmMng_stPRGG_CCTRSig "signalerrorstatus-message PRGG_CCTR" UWORD OneToOne 1 100 0.00 65535.00 FORMAT "%8.2" ECU_ADDRESS 0x7F8D36 /end MEASUREMENT
/begin MEASUREMENT FrmMng_stPSP "status der Diagnose der geregelten elektronischen Kraftstoffpumpe" UBYTE OneToOne 1 100 0.00 255.0 FORMAT "%5.1" ECU_ADDRESS 0x7F88C5 /end MEASUREMENT
/begin MEASUREMENT FrmMng_stSTAT_HDC "Zustand CAN-Botschaft S_HDC" UBYTE OneToOne 1 100 0.00 255.0 FORMAT "%5.1" ECU_ADDRESS 0x7F88D0 /end MEASUREMENT
/begin MEASUREMENT FrmMng_stTCSActive_mp "CAN-Signal B_ASC, ASC Eingriff aktiv" UBYTE OneToOne 1 100 0.00 255.0 FORMAT "%5.1" ECU_ADDRESS 0x8FF0BC /end MEASUREMENT
/begin MEASUREMENT FrmMng_stTCSCtrl_mp "ASC Eingriff" UBYTE OneToOne 1 100 0.00 255.0 FORMAT "%5.1" ECU_ADDRESS 0x8FF0BD /end MEASUREMENT
/begin MEASUREMENT FrmMng_stTrqDCSOk_mp "Status Freigabe MSR Eingriff" UBYTE OneToOne 1 100 0.00 255.0 FORMAT "%5.1" ECU_ADDRESS 0x8FF0BE /end MEASUREMENT
/begin MEASUREMENT FrmMng_stTrqTCSOk_mp "Status Freigabe ASC Eingriff" UBYTE OneToOne 1 100 0.00 255.0 FORMAT "%5.1" ECU_ADDRESS 0x8FF0BF /end MEASUREMENT
/begin MEASUREMENT FrmMng_stTSCDec "Status der reduzierenden Getriebeeingriffsanforderung vom Getriebesteuergerät (EGS)" UWORD OneToOne 1 100 0.00 65535.00 FORMAT "%8.2" ECU_ADDRESS 0x7F8D58 /end MEASUREMENT
/begin MEASUREMENT FrmMng_stTSCInc "Status der erhöhenden Getriebeeingriffsanforderung vom Getriebesteuergerät (EGS)" UWORD OneToOne 1 100 0.00 65535.00 FORMAT "%8.2" ECU_ADDRESS 0x7F8D5A /end MEASUREMENT
/begin MEASUREMENT FrmMng_tEnv "Umgebungstemperatur" SWORD Temp_Cels 1 100 -50.140 899.860 FORMAT "%8.3" ECU_ADDRESS 0x7F8D68 /end MEASUREMENT
/begin MEASUREMENT FrmMng_tiDayCouAbsl "day counter" UWORD OneToOne 1 100 0.00 65535.00 FORMAT "%8.2" ECU_ADDRESS 0x7F8D6C /end MEASUREMENT
/begin MEASUREMENT FrmMng_trqDCS "vom MSR gefordertes Getriebeausgangsmoment" SWORD Trq 1 100 -3276.800 3276.700 FORMAT "%8.3" ECU_ADDRESS 0x7F8D7A /end MEASUREMENT
/begin MEASUREMENT FrmMng_trqDCSRaw_mp "MSR Eingriff über CAN, Momentenrohwert" SWORD Trq 1 100 -3276.800 3276.700 FORMAT "%8.3" ECU_ADDRESS 0x8FF0C0 /end MEASUREMENT
/begin MEASUREMENT FrmMng_trqFrc "Reibmoment" SWORD Trq 1 100 -3276.800 3276.700 FORMAT "%8.3" ECU_ADDRESS 0x7F8D84 /end MEASUREMENT
/begin MEASUREMENT FrmMng_trqGbx "Torque set value from Gearbox" SWORD Trq 1 100 -3276.800 3276.700 FORMAT "%8.3" ECU_ADDRESS 0x7F8D86 /end MEASUREMENT
/begin MEASUREMENT FrmMng_trqGearbxDes_mp "Meßpunkt fuer Getriebe-Sollmoment" SWORD Trq 1 100 -3276.800 3276.700 FORMAT "%8.3" ECU_ADDRESS 0x8FF0C2 /end MEASUREMENT
/begin MEASUREMENT FrmMng_trqGearbxRaw_mp "= FrmMng_trqGearbxDec - EngM_trqFrc" SWORD Trq 1 100 -3276.800 3276.700 FORMAT "%8.3" ECU_ADDRESS 0x8FF0C4 /end MEASUREMENT
/begin MEASUREMENT FrmMng_trqTCS "vom ASR gefordertes Getriebeausgangsmoment" SWORD Trq 1 100 -3276.800 3276.700 FORMAT "%8.3" ECU_ADDRESS 0x7F8D94 /end MEASUREMENT
/begin MEASUREMENT FrmMng_trqTCSRaw_mp "ASC Eingriff über CAN, Momentenrohwert" SWORD Trq 1 100 -3276.800 3276.700 FORMAT "%8.3" ECU_ADDRESS 0x8FF0C6 /end MEASUREMENT
/begin MEASUREMENT FrmMng_trqTSCDec "Gefordertes reduzierende Kupplungsmoment vom Getriebesteuergerät (EGS)" SWORD Trq 1 100 -3276.800 3276.700 FORMAT "%8.3" ECU_ADDRESS 0x7F8D96 /end MEASUREMENT
/begin MEASUREMENT FrmMng_trqTSCInc "Gefordertes erhöhende Kupplungsmoment vom Getriebesteuergerät (EGS)" SWORD Trq 1 100 -3276.800 3276.700 FORMAT "%8.3" ECU_ADDRESS 0x7F8D98 /end MEASUREMENT
/begin MEASUREMENT FrmMng_vPrgNo1 "velocity No. 0,3,6,9,12" UWORD vfzg_uw_b512 1 100 0.00 511.9922 FORMAT "%8.4" ECU_ADDRESS 0x7F8DA4 /end MEASUREMENT
/begin MEASUREMENT FrmMng_vPrgNo2 "velocity No. 1,4,7,10,13" UWORD vfzg_uw_b512 1 100 0.00 511.9922 FORMAT "%8.4" ECU_ADDRESS 0x7F8DA6 /end MEASUREMENT
/begin MEASUREMENT FrmMng_vPrgNo3 "velocity No. 2,5,8,11,14" UWORD vfzg_uw_b512 1 100 0.00 511.9922 FORMAT "%8.4" ECU_ADDRESS 0x7F8DA8 /end MEASUREMENT
/begin MEASUREMENT PCR_rGvnrLP2 "" SWORD Prc 1 100 -400.0000 399.9878 FORMAT "%8.4" ECU_ADDRESS 0x7F9018 /end MEASUREMENT
/begin MEASUREMENT PFlt_tOxiPst "Temperatur nach dem Oxidations Katalysator" SWORD Temp_Cels 1 100 -50.140 899.860 FORMAT "%8.3" ECU_ADDRESS 0x7F9070 /end MEASUREMENT
/begin MEASUREMENT PFlt_tTurbPre "Temperatur vor dem Turbolader" SWORD Temp_Cels 1 100 -50.140 899.860 FORMAT "%8.3" ECU_ADDRESS 0x7F907A /end MEASUREMENT
/begin MEASUREMENT TVACD_stAirMon "Status des TVACD" UBYTE OneToOne 1 100 0.00 255.0 FORMAT "%5.1" ECU_ADDRESS 0x7F89DD /end MEASUREMENT
/begin MEASUREMENT Uhwe_ctAtomicLvl_mp "Interrupt Lock Level" ULONG OneToOne 1 100 0.00 4294967295.00 FORMAT "%13.2" ECU_ADDRESS 0x8FED18 /end MEASUREMENT
/begin FUNCTION dummy_proj_msg ""
 /begin OUT_MEASUREMENT EGT_tInrBiTrb EGT_tInrDesCorBiTrb EGT_tInrDesInTempGvnr EGT_tOutrDesInTempGvnr FrmMng_stACHtgReq PCR_rGvnrLP2 PFlt_tOxiPst PFlt_tTurbPre TVACD_stAirMon /end OUT_MEASUREMENT
/end FUNCTION
/begin FUNCTION dummy_uic "" /begin OUT_MEASUREMENT Uhwe_ctAtomicLvl_mp /end OUT_MEASUREMENT /end FUNCTION
/begin FUNCTION eatscd "Umgebungslufttemperaturerfassung" /begin DEF_CHARACTERISTIC /end DEF_CHARACTERISTIC /begin IN_MEASUREMENT EATSCD_uRaw /end IN_MEASUREMENT /end FUNCTION
/begin FUNCTION eatscd_msg "" /begin OUT_MEASUREMENT EATSCD_swtSig EATSCD_tAir EATSCD_tAirLin EATSCD_uRaw /end OUT_MEASUREMENT /end FUNCTION
/begin FUNCTION eatscd_uic "" /end FUNCTION
/begin FUNCTION ebafcd "Abluftklappensteuerung Komponententreiber" /begin DEF_CHARACTERISTIC /end DEF_CHARACTERISTIC /end FUNCTION
/begin FUNCTION ebafcd_msg "" /begin OUT_MEASUREMENT EBAFCD_stSigOut /end OUT_MEASUREMENT /end FUNCTION
/begin FUNCTION ebafcd_uic "" /begin OUT_MEASUREMENT EBAFCD_st_mp /end OUT_MEASUREMENT /end FUNCTION
/begin FUNCTION ebfcd_actoutebox "E-Box Cooler Fan component driver" /begin DEF_CHARACTERISTIC /end DEF_CHARACTERISTIC /end FUNCTION
/begin FUNCTION ebfcd_actoutebox_msg "" /begin OUT_MEASUREMENT EBFCD_stOut /end OUT_MEASUREMENT /end FUNCTION
/begin FUNCTION ebfcd_actoutebox_uic "" /begin OUT_MEASUREMENT EBFCD_st_mp /end OUT_MEASUREMENT /end FUNCTION
/begin FUNCTION ebtscd_gettempebox "ECU Temperature sensor component driver" /begin DEF_CHARACTERISTIC /end DEF_CHARACTERISTIC /begin IN_MEASUREMENT EBTSCD_uRawTECU_mp /end IN_MEASUREMENT /end FUNCTION
/begin FUNCTION ebtscd_gettempebox_msg "" /begin OUT_MEASUREMENT EBTSCD_tCIntLin EBTSCD_tECU /end OUT_MEASUREMENT /end FUNCTION
/begin FUNCTION ebtscd_gettempebox_uic "" /begin OUT_MEASUREMENT EBTSCD_uRawTECU_mp /end OUT_MEASUREMENT /end FUNCTION
/begin FUNCTION ecu "" /begin DEF_CHARACTERISTIC /end DEF_CHARACTERISTIC /end FUNCTION
/begin FUNCTION eepcd "Komponenten Treiber für EEPROM Zugriffe" /begin DEF_CHARACTERISTIC /end DEF_CHARACTERISTIC /end FUNCTION
/begin FUNCTION eepcd_msg "" /begin OUT_MEASUREMENT EEPCD_stErrSet EEPCD_stMIL /end OUT_MEASUREMENT /end FUNCTION
/begin FUNCTION eepinit "EEPROM Erstinitialisierung" /begin DEF_CHARACTERISTIC /end DEF_CHARACTERISTIC /end FUNCTION
/begin FUNCTION eepinit_develop "ließt Bloecke vom EEPROM und schreibt ein Byte an waelbare Positionen" /begin DEF_CHARACTERISTIC /end DEF_CHARACTERISTIC /begin OUT_MEASUREMENT EepDev_dBlockVal_mp EepDev_stLastJob_mp /end OUT_MEASUREMENT /end FUNCTION
/begin FUNCTION egppcd_actrout "Exhaust Gas pressure Pump Component Driver" /begin DEF_CHARACTERISTIC /end DEF_CHARACTERISTIC /end FUNCTION
/begin FUNCTION egppcd_actrout_msg "" /begin OUT_MEASUREMENT EGPpCD_stActrOut /end OUT_MEASUREMENT /end FUNCTION
/begin FUNCTION egppcd_actrout_uic "" /end FUNCTION
/begin FUNCTION egpp_logic "Calculates the status of the Exhaust gas pressure pump" /begin DEF_CHARACTERISTIC /end DEF_CHARACTERISTIC /begin IN_MEASUREMENT Eng_nAvrg InjCtl_qCurr /end IN_MEASUREMENT /end FUNCTION
/begin FUNCTION egpp_logic_msg "" /begin OUT_MEASUREMENT EGPp_stLogicOut /end OUT_MEASUREMENT /end FUNCTION
/begin FUNCTION egpp_logic_uic "" /end FUNCTION
/begin FUNCTION egpp_prescalc "Berechnung des Abgasdruckes" /begin DEF_CHARACTERISTIC /end DEF_CHARACTERISTIC /begin IN_MEASUREMENT EGPp_dvolSil_mp Eng_nAvrg InjCtl_qSetUnBal PFlt_tPstSim /end IN_MEASUREMENT /end FUNCTION
/begin FUNCTION egpp_prescalc_msg "" /begin OUT_MEASUREMENT EGPp_pPstPFlt /end OUT_MEASUREMENT /end FUNCTION
/begin FUNCTION egpp_prescalc_uic "" /begin OUT_MEASUREMENT EGPp_dvolSil_mp EGPp_pPstPFltMap_mp EGPp_pPstPFltSim_mp /end OUT_MEASUREMENT /end FUNCTION
/begin FUNCTION egrcd "Komponententreiber Abgasrückführsteller" /begin DEF_CHARACTERISTIC /end DEF_CHARACTERISTIC /begin IN_MEASUREMENT EGRVlv_rEGR Eng_nAvrg /end IN_MEASUREMENT /end FUNCTION
/begin FUNCTION egrcd_msg "" /begin OUT_MEASUREMENT EGRCD_rOut /end OUT_MEASUREMENT /end FUNCTION
/begin FUNCTION egrcd_uic "" /begin OUT_MEASUREMENT EGRCD_rCnv_mp /end OUT_MEASUREMENT /end FUNCTION
/begin FUNCTION egrvlv_co "Stellerkoordinator Abgasrückführung" /end FUNCTION
/begin FUNCTION egrvlv_co_msg "" /begin OUT_MEASUREMENT EGRVlv_rEGR EGRVlv_rEGR2 /end OUT_MEASUREMENT /end FUNCTION
/begin FUNCTION egrvlv_co_uic "" /begin DEF_CHARACTERISTIC /end DEF_CHARACTERISTIC /begin OUT_MEASUREMENT EGRVlv_rEGR2Byp_mp EGRVlv_rEGRByp_mp /end OUT_MEASUREMENT /end FUNCTION
/begin FUNCTION egsys_dewdet "Taupunktbestimmungslogik" /begin DEF_CHARACTERISTIC /end DEF_CHARACTERISTIC /begin IN_MEASUREMENT EGSys_tEGLSUInpCrv0_mp Eng_tEng /end IN_MEASUREMENT
 /begin OUT_MEASUREMENT EGSys_cpEGLSU_mp EGSys_ctCldStrtLSU_mp EGSys_dwLSU_mp EGSys_stHtgLSULstTrp_mp EGSys_stHtgThresLSUHit_mp EGSys_stIntegIni_mp EGSys_stPlsLSU_mp EGSys_wLSU_mp EGSys_wThresLSUAct_mp EGSys_wThresLSUNoPls_mp EGSys_wThresLSUPls_mp EGSys_wThresLSU_mp /end OUT_MEASUREMENT
/end FUNCTION
/begin FUNCTION egsys_dewdet_msg "" /begin OUT_MEASUREMENT EGSys_stHtgLSU /end OUT_MEASUREMENT /end FUNCTION
/begin FUNCTION egsys_dewdet_uic "" /end FUNCTION
/begin FUNCTION egsys_mdlbackpres "Berechnung des Abgasgegendrucks" /begin DEF_CHARACTERISTIC /end DEF_CHARACTERISTIC /begin IN_MEASUREMENT Eng_nAvrg InjCtl_qSetUnBal /end IN_MEASUREMENT /end FUNCTION
/begin FUNCTION egsys_mdlbackpres_msg "" /begin OUT_MEASUREMENT EGSys_pExhGas /end OUT_MEASUREMENT /end FUNCTION
/begin FUNCTION egsys_mdlbackpres_uic "" /end FUNCTION
/begin FUNCTION egsys_tegco "Schnittstellenkoordinator für Abgastemperaturmodell" /begin DEF_CHARACTERISTIC /end DEF_CHARACTERISTIC /begin IN_MEASUREMENT EGSys_rLmbdAprx /end IN_MEASUREMENT
 /begin OUT_MEASUREMENT EGSys_tEGLSUInpCrv0_mp EGSys_tEGLSUInpCrv1_mp EGSys_tEGLSUInpCrv2_mp EGSys_tEGLSUInpCrv3_mp EGSys_tMem_mp /end OUT_MEASUREMENT
/end FUNCTION
/begin FUNCTION egsys_tegco_msg ""
 /begin OUT_MEASUREMENT EGSys_dmEG EGSys_qMIStd EGSys_qPoIRgn EGSys_rLmbdAprx EGSys_tEGLSU EGSys_tEGPreNSC EGSys_tEGPreOxiCat EGSys_tEGPreTrbn EGSys_tEGPreTube EGSys_tWallLSU /end OUT_MEASUREMENT
/end FUNCTION
/begin FUNCTION egsys_tegco_uic "" /begin OUT_MEASUREMENT EGSys_tShOffTExcClnt_mp /end OUT_MEASUREMENT /end FUNCTION
/begin FUNCTION egsys_tegco_var "" /begin DEF_CHARACTERISTIC /end DEF_CHARACTERISTIC /end FUNCTION
/begin FUNCTION egsys_tegmod "Abgastemperaturmodell" /begin DEF_CHARACTERISTIC /end DEF_CHARACTERISTIC
 /begin IN_MEASUREMENT EGSys_phiDiffStrt_mp EGSys_rAirPerTime_mp EGSys_tDiffCldEng_mp EGSys_tDiffIAT_mp Eng_nAvrg InjCtl_qCurr /end IN_MEASUREMENT
/end FUNCTION
/begin FUNCTION egsys_tegmod_msg "" /begin OUT_MEASUREMENT EGSys_tManfStat /end OUT_MEASUREMENT /end FUNCTION
/begin FUNCTION egsys_tegmod_uic ""
 /begin OUT_MEASUREMENT EGSys_facAirMass_mp EGSys_facStrtDlv_mp EGSys_phiDiffStrt_mp EGSys_rAirPerTime_mp EGSys_tCorrIAT_mp EGSys_tCorrManf_mp EGSys_tDiffCldEng_mp EGSys_tDiffIAT_mp EGSys_tManfStat_mp /end OUT_MEASUREMENT
/end FUNCTION
/begin FUNCTION egsys_tnscmod "Temperaturmodell für NOx-Speicherkatalysator" /begin DEF_CHARACTERISTIC /end DEF_CHARACTERISTIC /begin IN_MEASUREMENT EGSys_rLmbdAprx EGSys_tAvrgNSC_mp /end IN_MEASUREMENT /end FUNCTION
/begin FUNCTION egsys_tnscmod_msg "" /begin OUT_MEASUREMENT EGSys_tNSC /end OUT_MEASUREMENT /end FUNCTION
/begin FUNCTION egsys_tnscmod_uic ""
 /begin OUT_MEASUREMENT EGSys_cpEGNSC_mp EGSys_tAvrgNSC_mp EGSys_tNSCExoIncr_mp EGSys_tNSCStat_mp /end OUT_MEASUREMENT
/end FUNCTION
/begin FUNCTION egsys_toxicatmod "Temperaturmodel für Oxidationskatalysator" /begin DEF_CHARACTERISTIC /end DEF_CHARACTERISTIC /begin IN_MEASUREMENT EGSys_rLmbdAprx EGSys_tAvrgOxiCat_mp /end IN_MEASUREMENT /end FUNCTION
/begin FUNCTION egsys_toxicatmod_msg "" /begin OUT_MEASUREMENT EGSys_tOxiCat /end OUT_MEASUREMENT /end FUNCTION
/begin FUNCTION egsys_toxicatmod_uic ""
 /begin OUT_MEASUREMENT EGSys_cpEGOxiCat_mp EGSys_dwFlCmb_mp EGSys_tAvrgOxiCat_mp EGSys_tIncrPoI_mp EGSys_tOxiCatExoIncr_mp EGSys_tOxiCatStat_mp /end OUT_MEASUREMENT
/end FUNCTION
/begin FUNCTION egsys_tstrtcalc "Temperaturmodell für Fahrzeugstillstand" /begin DEF_CHARACTERISTIC /end DEF_CHARACTERISTIC /begin IN_MEASUREMENT EGSys_rTempClnt_mp EGSys_rTimeTrb_mp /end IN_MEASUREMENT /begin OUT_MEASUREMENT EGSys_rTimeTube_mp /end OUT_MEASUREMENT /end FUNCTION
/begin FUNCTION egsys_tstrtcalc_msg ""
 /begin OUT_MEASUREMENT EGSys_tNSCStrtCs EGSys_tOxiCatStrtCs EGSys_tTrbStrtCs EGSys_tTubeStrtCs /end OUT_MEASUREMENT
/end FUNCTION
/begin FUNCTION egsys_tstrtcalc_uic ""
 /begin OUT_MEASUREMENT EGSys_rTempClnt_mp EGSys_rTimeNSC_mp EGSys_rTimeOxiCat_mp EGSys_rTimeTrb_mp EGSys_tExcClntStrtCs_mp EGSys_tiClg_mp EGSys_tiRefClg_mp /end OUT_MEASUREMENT
/end FUNCTION
/begin FUNCTION egsys_ttrbmod "" /begin DEF_CHARACTERISTIC /end DEF_CHARACTERISTIC /begin IN_MEASUREMENT AFSCD_dmAirPerTime EGSys_rPresCmpr_mp /end IN_MEASUREMENT /end FUNCTION
/begin FUNCTION egsys_ttrbmod_msg "" /begin OUT_MEASUREMENT EGSys_tEGPstTrbn /end OUT_MEASUREMENT /end FUNCTION
/begin FUNCTION egsys_ttrbmod_uic ""
 /begin OUT_MEASUREMENT EGSys_cpEGTrbn_mp EGSys_etaChrg_mp EGSys_facPT1Chrg_mp EGSys_pwrCmpr_mp EGSys_rPresCmpr_mp EGSys_tAvrgEGTrbn_mp /end OUT_MEASUREMENT
/end FUNCTION
/begin FUNCTION egsys_ttubemod "Temperaturmodell für Abgasrohr" /begin DEF_CHARACTERISTIC /end DEF_CHARACTERISTIC
 /begin OUT_MEASUREMENT EGSys_AlpEGTube_mp EGSys_AlpTubeEnv_mp EGSys_cndHtEGi_mp EGSys_cndHtEGo_mp EGSys_cpEGTube_mp EGSys_dtTube_mp EGSys_dwTubeIn_mp EGSys_dwTubeOut_mp EGSys_dwTube_mp EGSys_NuTubeEnv_mp EGSys_NuTube_mp EGSys_ReTubeEnvInpCrv_mp EGSys_ReTubeEnv_mp EGSys_ReTubeInpCrv_mp EGSys_ReTube_mp EGSys_sqTube_mp EGSys_tAvrgEGTube_mp EGSys_tDiffEGTube_mp EGSys_tDiffTubeEnv_mp EGSys_tMidEGTube_mp EGSys_tMidTubeEnv_mp /end OUT_MEASUREMENT
/end FUNCTION
/begin FUNCTION egsys_ttubemod_msg "" /begin OUT_MEASUREMENT EGSys_tEGPstTube EGSys_tTube /end OUT_MEASUREMENT /end FUNCTION
/begin FUNCTION egsys_ttubemod_uic "" /end FUNCTION
/begin FUNCTION egt_corgntsync "Regenerationskoordinator Abgasnachbehandlung (zeitsynchron)" /begin DEF_CHARACTERISTIC /end DEF_CHARACTERISTIC /end FUNCTION
/begin FUNCTION egt_corgntsync_msg ""
 /begin OUT_MEASUREMENT EGT_stCoRgnTSync EGT_stDel EGT_stTSync EGT_stTSyncLck EGT_tiRgnOilDil EGT_tiRgnTSync EGT_tiRmpSlpMax /end OUT_MEASUREMENT
/end FUNCTION
/begin FUNCTION egt_corgntsync_uic "" /begin DEF_CHARACTERISTIC /end DEF_CHARACTERISTIC
 /begin OUT_MEASUREMENT EGT_stCoRgnOld_mp EGT_stRgnOilDil_mp EGT_stTSyncDes_mp EGT_swtRgnLck_mp EGT_tiRgnTSyncPre_mp /end OUT_MEASUREMENT
/end FUNCTION
/begin FUNCTION egt_corgn_msg "" /begin OUT_MEASUREMENT EGT_facRmpVal EGT_st EGT_stCoRgn EGT_stLck EGT_tiRgn /end OUT_MEASUREMENT /end FUNCTION
/begin FUNCTION egt_corgn_uic "" /end FUNCTION
/begin FUNCTION egt_tempgvnr "EGT temperature governor" /begin DEF_CHARACTERISTIC /end DEF_CHARACTERISTIC /begin IN_MEASUREMENT Eng_nAvrg InjCtl_qSetUnBal /end IN_MEASUREMENT /end FUNCTION
/begin FUNCTION egt_tempgvnrdesval "Sollwertbildung des Abgastemperaturreglers" /begin DEF_CHARACTERISTIC /end DEF_CHARACTERISTIC
 /begin IN_MEASUREMENT Eng_nAvrg InjCtl_qSetUnBal PFlt_dmO2Aprx PFlt_mSot PFlt_tOxiPst PFlt_tTurbPre /end IN_MEASUREMENT
/end FUNCTION
/begin FUNCTION egt_tempgvnrdesval_msg ""
 /begin OUT_MEASUREMENT EGT_tInrDesTempGvnr EGT_tInrTempGvnr EGT_tOutrDesTempGvnr EGT_tOutrTempGvnr /end OUT_MEASUREMENT
/end FUNCTION
/begin FUNCTION egt_tempgvnrdesval_uic "" /end FUNCTION
/begin FUNCTION egt_tempgvnrmonitor "Überwachung des Abgastemperaturreglers" /begin DEF_CHARACTERISTIC /end DEF_CHARACTERISTIC /end FUNCTION
/begin FUNCTION egt_tempgvnrmonitor_msg "" /begin OUT_MEASUREMENT EGT_stTempGvnr /end OUT_MEASUREMENT /end FUNCTION
/begin FUNCTION egt_tempgvnrmonitor_uic "" /end FUNCTION
/begin FUNCTION egt_tempgvnroutval "Ausgabeschnittstelle der Abgastemperaturregelung" /begin DEF_CHARACTERISTIC /end DEF_CHARACTERISTIC
 /begin IN_MEASUREMENT EGT_facRmp_mp EGT_qPoI1OutrTempGvnr Eng_nAvrg InjCtl_qSetUnBal PFlt_rLmbd /end IN_MEASUREMENT
/end FUNCTION
/begin FUNCTION egt_tempgvnroutval_msg ""
 /begin OUT_MEASUREMENT EGT_mAirDesTempGvnr EGT_phiPoI1TempGvnr EGT_qHCTempGvnr EGT_qPoI1TempGvnr EGT_qPoI2TempGvnr EGT_tiPoI2TempGvnr /end OUT_MEASUREMENT
/end FUNCTION
/begin FUNCTION egt_tempgvnroutval_uic ""
 /begin OUT_MEASUREMENT EGT_facRmpValTempGvnr_mp EGT_facRmp_mp EGT_mAirLmbdTempGvnr_mp /end OUT_MEASUREMENT
/end FUNCTION
/begin FUNCTION egt_tempgvnr_msg ""
 /begin OUT_MEASUREMENT EGT_mAirDesInrTempGvnr EGT_qPoI1OutrTempGvnr EGT_qPoI2InrTempGvnr EGT_tInrDesCorTempGvnr /end OUT_MEASUREMENT
/end FUNCTION
/begin FUNCTION egt_tempgvnr_uic ""
 /begin OUT_MEASUREMENT EGT_mAirTempGvnrMin_mp EGT_mAirTempGvnrRng_mp EGT_qPoI1Min_mp EGT_qPoI1Rng_mp EGT_qPoI2Min_mp EGT_qPoI2Rng_mp EGT_rIInrTempGvnr_mp EGT_rInrTempGvnr_mp EGT_rIOutrTempGvnr_mp EGT_rOutrTempGvnr_mp EGT_rPInrTempGvnr_mp EGT_rPOutrTempGvnr_mp EGT_rStyInrTempGvnr_mp EGT_rStyOutrTempGvnr_mp EGT_stClsThrVlv_mp EGT_tInrCorMax_mp EGT_tInrCorRng_mp EGT_tInrDvtTempGvnr_mp EGT_tiPoI1ActvCnt_mp EGT_tOutrDvtTempGvnr_mp /end OUT_MEASUREMENT
/end FUNCTION
/begin FUNCTION emccd "Komponententreiber der Motorlagersteuerung" /begin DEF_CHARACTERISTIC /end DEF_CHARACTERISTIC
 /begin IN_MEASUREMENT BattCD_u EATSCD_tAir EMCCD_resAct1 EMCCD_uRawActVal1_mp EMCCD_uRawActVal2_mp Eng_tEng /end IN_MEASUREMENT
/end FUNCTION
/begin FUNCTION emccd_msg "" /begin OUT_MEASUREMENT EMCCD_iActVal1 EMCCD_iActVal2 EMCCD_resAct1 EMCCD_resAct2 /end OUT_MEASUREMENT /end FUNCTION
/begin FUNCTION emccd_uic ""
 /begin OUT_MEASUREMENT EMCCD_dcycCurrOff1_mp EMCCD_dcycCurrOff2_mp EMCCD_dcycCurrOn1_mp EMCCD_dcycCurrOn2_mp EMCCD_dcycMntCtlOut1_mp EMCCD_dcycMntCtlOut2_mp EMCCD_dcycOut1_mp EMCCD_dcycOut2_mp EMCCD_iActValFlt1_mp EMCCD_iActValFlt2_mp EMCCD_rHWE1_mp EMCCD_rHWE2_mp EMCCD_stOut_mp EMCCD_uRawActVal1_mp EMCCD_uRawActVal2_mp /end OUT_MEASUREMENT
/end FUNCTION
/begin FUNCTION eng "Motor" /begin DEF_CHARACTERISTIC /end DEF_CHARACTERISTIC /begin IN_MEASUREMENT Eng_nAvrg /end IN_MEASUREMENT /end FUNCTION
/begin FUNCTION engm "Motormechanik" /begin DEF_CHARACTERISTIC /end DEF_CHARACTERISTIC /end FUNCTION
/begin FUNCTION engmon_irrcmb "Verbrennungserkennung mit Lambdasonde" /end FUNCTION
/begin FUNCTION engmon_irrcmb_msg "" /begin OUT_MEASUREMENT EngMon_stShOffIrrCmb /end OUT_MEASUREMENT /end FUNCTION
/begin FUNCTION engmon_irrcmb_uic "" /end FUNCTION
/begin FUNCTION engm_ang "" /begin DEF_CHARACTERISTIC /end DEF_CHARACTERISTIC /end FUNCTION
/begin FUNCTION engm_angdiag "Diagnose des Kurbelwellen- und Nockenwellensignals" /begin DEF_CHARACTERISTIC /end DEF_CHARACTERISTIC /end FUNCTION
/begin FUNCTION engm_angdiag_uic ""
 /begin OUT_MEASUREMENT EngM_ctIncErrSigDiagCaSDef_mp EngM_ctIncErrSigDiagCaSOk_mp EngM_ctIncErrSigDiagCrSDef_mp EngM_ctIncErrSigDiagCrSOK_mp EngM_ctIncErrSigDiagmaxCaSDef_mp EngM_ctIncErrSigDiagmaxCaSOk_mp EngM_ctIncErrSigDiagmaxCrSDef_mp EngM_ctIncNoSigDiagCaS_mp EngM_ctIncNoSigDiagmaxCaS_mp EngM_ctPhErrSigDiagCrSDef_mp EngM_ctPhErrSigDiagmaxCrSDef_mp EngM_ctSpdtoZero_mp /end OUT_MEASUREMENT
/end FUNCTION
/begin FUNCTION engm_ang_msg ""
 /begin OUT_MEASUREMENT EngM_nDyn EngM_numInt EngM_numLastTDC EngM_numSyncTDC EngM_numTDC EngM_phiDiffTDC EngM_phiInt EngM_phiIntExt EngM_phiTDC EngM_stCaSExt EngM_stCaSVerifyDiag EngM_stErrCanExt EngM_stEvent EngM_stInjCharSetVal EngM_stNext EngM_stNextExt EngM_stSync EngM_tiSeg EngM_tiSegLimAvrg EngM_tiSegTwo /end OUT_MEASUREMENT
/end FUNCTION
/begin FUNCTION engm_ang_uic ""
 /begin OUT_MEASUREMENT EngM_ctIntOvrLoad_mp EngM_ctPostSync_mp EngM_ctReSync_mp EngM_ctVerSync_mp EngM_numRevCnt_mp EngM_phiIntExtCorr_mp EngM_SchedDelta_mp EngM_SchedIndex_mp EngM_SchedLimitInt_mp EngM_SchedSegID_mp EngM_stEventEnable_mp EngM_stEventServed_mp EngM_tiDiffInt_mp /end OUT_MEASUREMENT
/end FUNCTION
/begin FUNCTION engm_backup "Start und Betrieb des Motors nur mit Nockenwellensignal" /begin DEF_CHARACTERISTIC /end DEF_CHARACTERISTIC /end FUNCTION
/begin FUNCTION engm_backup_uic "" /end FUNCTION
/begin FUNCTION engm_engmntctl "Motorlagersteuerung" /begin DEF_CHARACTERISTIC /end DEF_CHARACTERISTIC /begin IN_MEASUREMENT Eng_tEng /end IN_MEASUREMENT /end FUNCTION
/begin FUNCTION engm_engmntctl_msg "" /begin OUT_MEASUREMENT EngM_stOut /end OUT_MEASUREMENT /end FUNCTION
/begin FUNCTION engm_engmntctl_uic ""
 /begin OUT_MEASUREMENT EngM_nAvrgHysHigh_mp EngM_nAvrgHysLow_mp EngM_rCurrProf_mp EngM_stEngMntCtl_mp /end OUT_MEASUREMENT
/end FUNCTION
/begin FUNCTION engm_msg "" /begin OUT_MEASUREMENT EngM_numCyl EngM_stSpd /end OUT_MEASUREMENT /end FUNCTION
/begin FUNCTION engm_soptst "" /end FUNCTION
/begin FUNCTION engm_tdsig "" /begin DEF_CHARACTERISTIC /end DEF_CHARACTERISTIC /end FUNCTION
/begin FUNCTION engm_trqfrc "aktuelles Reibmoment" /begin DEF_CHARACTERISTIC /end DEF_CHARACTERISTIC /begin IN_MEASUREMENT EngM_tTrqFrc_mp Eng_nAvrg /end IN_MEASUREMENT /end FUNCTION
/begin FUNCTION engm_trqfrcadpt "Reibmomentenadaption" /begin DEF_CHARACTERISTIC /end DEF_CHARACTERISTIC /end FUNCTION
/begin FUNCTION engm_trqfrcadpt_msg ""
 /begin OUT_MEASUREMENT EngM_stAdpt EngM_stReliablAdpt EngM_trqDiffAdpt EngM_trqLossAdpt /end OUT_MEASUREMENT
/end FUNCTION
/begin FUNCTION engm_trqfrcadpt_uic ""
 /begin OUT_MEASUREMENT EngM_nLISetDiff_mp EngM_stGbxRel_mp EngM_stGenRel_mp EngM_stNDiffRng_mp EngM_trqFltACoff_mp EngM_trqFltACon_mp EngM_trqLossCompl_mp EngM_trqLossDiff_mp /end OUT_MEASUREMENT
/end FUNCTION
/begin FUNCTION engm_trqfrc_msg "" /begin OUT_MEASUREMENT EngM_trqFrc /end OUT_MEASUREMENT /end FUNCTION
/begin FUNCTION engm_trqfrc_uic "" /begin DEF_CHARACTERISTIC /end DEF_CHARACTERISTIC
 /begin OUT_MEASUREMENT EngM_stTrqFrcPDiffErr_mp EngM_trqFrcPDiffLim_mp EngM_trqFrcPDiffRaw_mp EngM_trqFrcPDiff_mp EngM_trqFrcT_mp EngM_tTrqFrc_mp /end OUT_MEASUREMENT
/end FUNCTION
/begin FUNCTION engm_uic "" /end FUNCTION
/begin FUNCTION engprt "Motormechanikschutz" /begin DEF_CHARACTERISTIC /end DEF_CHARACTERISTIC /begin IN_MEASUREMENT APSCD_pVal Eng_nAvrg Eng_tEng Gearbx_stGear VSSCD_v /end IN_MEASUREMENT /end FUNCTION
/begin FUNCTION engprt_fwoscdet "" /begin DEF_CHARACTERISTIC /end DEF_CHARACTERISTIC /end FUNCTION
/begin FUNCTION engprt_fwoscdet_msg "" /begin OUT_MEASUREMENT EngPrt_stFWOscDet /end OUT_MEASUREMENT /end FUNCTION
/begin FUNCTION engprt_fwoscdet_uic "" /end FUNCTION
/begin FUNCTION engprt_msg ""
 /begin OUT_MEASUREMENT EngPrt_facPrtLim EngPrt_stOvrSpd EngPrt_trqLim EngPrt_trqNLim EngPrt_trqOvhtPrv EngPrt_trqPrtLim /end OUT_MEASUREMENT
/end FUNCTION
/begin FUNCTION engprt_prtlim_var_uic "" /end FUNCTION
/begin FUNCTION engprt_qprtlim "Begrenzungmenge zum thermischen Motorschutz" /begin DEF_CHARACTERISTIC /end DEF_CHARACTERISTIC
 /begin IN_MEASUREMENT CTSCD_tClnt EngPrt_facOvhtPrv_mp Eng_nAvrg FTSCD_tFuel OTSCD_tEngOil VSSCD_v /end IN_MEASUREMENT
/end FUNCTION
/begin FUNCTION engprt_qprtlim_msg "" /begin OUT_MEASUREMENT EngPrt_qPrtLim /end OUT_MEASUREMENT /end FUNCTION
/begin FUNCTION engprt_qprtlim_uic "" /begin DEF_CHARACTERISTIC /end DEF_CHARACTERISTIC
 /begin OUT_MEASUREMENT EngPrt_facOvhtPrvCT_mp EngPrt_facOvhtPrvFT_mp EngPrt_facOvhtPrvOT_mp EngPrt_facOvhtPrv_mp EngPrt_qOvhtPrvNRng_mp EngPrt_qOvhtPrvVRng_mp /end OUT_MEASUREMENT
/end FUNCTION
/begin FUNCTION engprt_uic "" /begin DEF_CHARACTERISTIC /end DEF_CHARACTERISTIC
 /begin OUT_MEASUREMENT EngPrt_stTrqRampSwitch_mp EngPrt_trqLimPrvLim_mp EngPrt_trqRamLim1_mp EngPrt_trqRamLim_mp /end OUT_MEASUREMENT
/end FUNCTION
/begin FUNCTION engprt_var_msg "" /end FUNCTION
/begin FUNCTION eng_msg ""
 /begin OUT_MEASUREMENT Eng_dnAvrg Eng_nAvrg Eng_nCurr Eng_stOvrTemp Eng_stOvrTemp2 Eng_trqCrvMax /end OUT_MEASUREMENT
/end FUNCTION
/begin FUNCTION eng_teng "Motortemperatur" /begin DEF_CHARACTERISTIC /end DEF_CHARACTERISTIC /end FUNCTION
/begin FUNCTION eng_teng_msg "" /begin OUT_MEASUREMENT Eng_tEng Eng_tFld Eng_tStrt /end OUT_MEASUREMENT /end FUNCTION
/begin FUNCTION eng_teng_uic "" /begin OUT_MEASUREMENT Eng_stOvrTemp_mp /end OUT_MEASUREMENT /end FUNCTION
/begin FUNCTION erlpcd "Fehlerlampe Komponententreiber" /begin DEF_CHARACTERISTIC /end DEF_CHARACTERISTIC /end FUNCTION
/begin FUNCTION erlpcd_msg ""
 /begin OUT_MEASUREMENT ErLpCD_OrdGlwLmp ErLpCD_stMil ErLpCD_stMilLmpTst ErLpCD_stMilReq ErLpCD_stSysLmp ErLpCD_stSysLmpReq /end OUT_MEASUREMENT
/end FUNCTION
/begin FUNCTION erlpcd_uic "" /begin OUT_MEASUREMENT ErLpCD_stTstMIL_mp ErLpCD_stTstSysLmp_mp /end OUT_MEASUREMENT /end FUNCTION
/begin FUNCTION ess_getnmin "Leerlaufanhebung bei schwacher Batterie" /begin DEF_CHARACTERISTIC /end DEF_CHARACTERISTIC /end FUNCTION
/begin FUNCTION ess_getnmin_uic "" /end FUNCTION
/begin FUNCTION ess_getnmin_var "" /begin DEF_CHARACTERISTIC /end DEF_CHARACTERISTIC /end FUNCTION
/begin FUNCTION ess_getnmin_var_uic "" /end FUNCTION
/begin FUNCTION ess_msg "" /begin OUT_MEASUREMENT ESS_nBattMin ESS_nMax ESS_nMin ESS_pwrDes ESS_pwrLead /end OUT_MEASUREMENT /end FUNCTION
/begin FUNCTION ess_updatedem "" /end FUNCTION
/begin FUNCTION ess_updatedem_uic "" /end FUNCTION
/begin FUNCTION etclb_calibration "Ansteuerdauer Kalibrierung" /begin DEF_CHARACTERISTIC /end DEF_CHARACTERISTIC
 /begin OUT_MEASUREMENT ETClb_ctLrn_mp ETClb_dtiETFlt0_mp ETClb_dtiETFlt1_mp ETClb_dtiETFlt2_mp ETClb_numCylCur_mp ETClb_swtQckClb_mp ETClb_tiETCor0_mp ETClb_tiETCor1_mp ETClb_tiETCor2_mp ETClb_tiETCur_mp ETClb_tiETMinEff_mp /end OUT_MEASUREMENT
/end FUNCTION
/begin FUNCTION etclb_calibration_msg "" /begin OUT_MEASUREMENT ETClb_stCor ETClb_swtCorActv /end OUT_MEASUREMENT /end FUNCTION
/begin FUNCTION etclb_calibration_uic ""
 /begin OUT_MEASUREMENT ETClb_ctInjCycl_mp ETClb_numPres_mp ETClb_numRailPresClbPnt_mp ETClb_stDemCor_mp ETClb_stRlsCylCor_mp ETClb_st_mp /end OUT_MEASUREMENT
/end FUNCTION
/begin FUNCTION etclb_eval "Auswertung von Einspritzungen fuer die Ansteuerdauer Kalibrierung" /begin DEF_CHARACTERISTIC /end DEF_CHARACTERISTIC /begin OUT_MEASUREMENT ETClb_stEval_mp ETClb_stRailpClbPntErr_mp /end OUT_MEASUREMENT /end FUNCTION
/begin FUNCTION etclb_eval_uic "" /begin OUT_MEASUREMENT ETClb_stEvalResult_mp /end OUT_MEASUREMENT /end FUNCTION
/begin FUNCTION etclb_lib "" /begin DEF_CHARACTERISTIC /end DEF_CHARACTERISTIC
 /begin OUT_MEASUREMENT ETClb_tiETChkCor0_mp ETClb_tiETChkCor1_mp ETClb_tiETChkCor2_mp /end OUT_MEASUREMENT
/end FUNCTION
/begin FUNCTION etclb_lib_uic "" /end FUNCTION
/begin FUNCTION fancd_co "Komponententreiber Lüfter Koordination" /begin DEF_CHARACTERISTIC /end DEF_CHARACTERISTIC /end FUNCTION
/begin FUNCTION fancd_co_uic "" /begin OUT_MEASUREMENT FanCD_dcycRaw_mp /end OUT_MEASUREMENT /end FUNCTION
/begin FUNCTION fancd_msg "" /end FUNCTION
/begin FUNCTION fanctl "Lüftersteuerung" /begin DEF_CHARACTERISTIC /end DEF_CHARACTERISTIC /begin IN_MEASUREMENT FanCtl_nSetPoint FanCtl_tClnt_mp FanCtl_tGbxOil_mp VSSCD_v /end IN_MEASUREMENT /end FUNCTION
/begin FUNCTION fanctl_msg ""
 /begin OUT_MEASUREMENT FanCtl_dcycOut FanCtl_nSetPoint FanCtl_stAftRun FanCtl_stOut /end OUT_MEASUREMENT
/end FUNCTION
/begin FUNCTION fanctl_uic ""
 /begin OUT_MEASUREMENT FanCtl_dcycAftRun_mp FanCtl_dcycBattCor_mp FanCtl_dcycHysStart_mp FanCtl_dcycHys_mp FanCtl_dcycRaw_mp FanCtl_facWghFctr_mp FanCtl_nSetGbxOilMap_mp FanCtl_nSetPntCAN_mp FanCtl_nSetPntMap_mp FanCtl_nSetPoint_mp FanCtl_stDemFanShOff_mp FanCtl_stDemFan_mp FanCtl_stHys_mp FanCtl_stLogic_mp FanCtl_tClnt_mp FanCtl_tGbxOil_mp /end OUT_MEASUREMENT
/end FUNCTION
/begin FUNCTION fbc_equal "Laufruheregler" /begin DEF_CHARACTERISTIC /end DEF_CHARACTERISTIC /begin IN_MEASUREMENT DrvTrn_rTransDT Eng_nAvrg InjCtl_qSetUnBal /end IN_MEASUREMENT /begin OUT_MEASUREMENT FBC_facBPNum_mp FBC_facSegVal_mp FBC_nMaxOvrRun_mp /end OUT_MEASUREMENT /end FUNCTION
/begin FUNCTION fbc_equal_uic "" /begin DEF_CHARACTERISTIC /end DEF_CHARACTERISTIC /begin OUT_MEASUREMENT FBC_qDvtMax_mp FBC_qDvtMin_mp FBC_stDvt_mp FBC_stRegion_mp /end OUT_MEASUREMENT /end FUNCTION
/begin FUNCTION fbc_msg ""
 /begin OUT_MEASUREMENT FBC_Badpt FBC_ctSegInt FBC_dBPCaS FBC_dBPSum FBC_q FBC_qDvtCyl FBC_qLimAct FBC_qSet FBC_RegionChng FBC_stActive FBC_stEqualInit FBC_stLearn FBC_WheelLrnOut /end OUT_MEASUREMENT
/end FUNCTION
/begin FUNCTION fbc_wheellrn "Antialiasingfilter und Geberradadaption" /begin DEF_CHARACTERISTIC /end DEF_CHARACTERISTIC
 /begin OUT_MEASUREMENT FBC_AALOut_mp FBC_DXadpt_mp FBC_DXSfn_mp FBC_DXSfp_mp FBC_DXSf_mp FBC_DXSl_mp FBC_DXS_mp FBC_Region_mp FBC_stState_mp /end OUT_MEASUREMENT
/end FUNCTION
/begin FUNCTION fbc_wheellrn_uic "" /begin DEF_CHARACTERISTIC /end DEF_CHARACTERISTIC /end FUNCTION
/begin FUNCTION flfcd "Kraftstoffilter Komponententreiber" /begin DEF_CHARACTERISTIC /end DEF_CHARACTERISTIC /end FUNCTION
/begin FUNCTION flfcd_msg "" /begin OUT_MEASUREMENT FlFCD_stFlFltDebVal FlFCD_stFlFltRawVal /end OUT_MEASUREMENT /end FUNCTION
/begin FUNCTION flfcd_uic "" /end FUNCTION
/begin FUNCTION flmng "Gemischbildung" /begin DEF_CHARACTERISTIC /end DEF_CHARACTERISTIC
 /begin IN_MEASUREMENT APSCD_pVal ASMod_mAirPerCylCorr Eng_nAvrg Eng_tEng FlMng_mAirPerCylFltSmk_mp IATSCD_tAir PCR_pBGDev /end IN_MEASUREMENT
/end FUNCTION
/begin FUNCTION flmng_fullldrgl "Volllastreglung" /begin DEF_CHARACTERISTIC /end DEF_CHARACTERISTIC /begin IN_MEASUREMENT Eng_nAvrg /end IN_MEASUREMENT /end FUNCTION
/begin FUNCTION flmng_fullldrgl_msg "" /begin OUT_MEASUREMENT FlMng_qFullLdRgl FlMng_swtFullLdRgl /end OUT_MEASUREMENT /end FUNCTION
/begin FUNCTION flmng_fullldrgl_uic ""
 /begin OUT_MEASUREMENT FlMng_qFullLdRglI_mp FlMng_qFullLdRglP_mp FlMng_rLmbdRecDvt_mp FlMng_stMon_mp /end OUT_MEASUREMENT
/end FUNCTION
/begin FUNCTION flmng_fullldrgl_var "" /end FUNCTION
/begin FUNCTION flmng_fullldrgl_var_uic "" /end FUNCTION
/begin FUNCTION flmng_msg "" /begin OUT_MEASUREMENT FlMng_qLimSmk FlMng_rLmbdSet /end OUT_MEASUREMENT /end FUNCTION
/begin FUNCTION flmng_uic ""
 /begin OUT_MEASUREMENT FlMng_mAirPerCylFltSmk_mp FlMng_mAirPerCylLim_mp FlMng_qLimSmkDefect_mp FlMng_qLimSmk_mp FlMng_rLmbdAPSCor_mp FlMng_rLmbdSmk_mp FlMng_stCurrInp_mp FlMng_stDefect_mp FlMng_stGearGroup_mp FlMng_stSmkLim_mp FlMng_tiAirPerCylPT1_mp /end OUT_MEASUREMENT
/end FUNCTION
/begin FUNCTION flmng_var "" /end FUNCTION
/begin FUNCTION flmng_var_uic "" /end FUNCTION
/begin FUNCTION flsys_calccnvfac "Berechnung Umwandlungsfaktor von Einspritzmenge nach Einspritzvolumen" /begin DEF_CHARACTERISTIC /end DEF_CHARACTERISTIC /begin IN_MEASUREMENT FTSCD_tFuel /end IN_MEASUREMENT /end FUNCTION
/begin FUNCTION flsys_calccnvfac_msg "" /begin OUT_MEASUREMENT FlSys_rhoFl /end OUT_MEASUREMENT /end FUNCTION
/begin FUNCTION flsys_calccnvfac_uic "" /end FUNCTION
/begin FUNCTION flsys_deflate "Entlueftung des Niederdruckkreislaufs" /begin DEF_CHARACTERISTIC /end DEF_CHARACTERISTIC /end FUNCTION
/begin FUNCTION flsys_deflate_uic "" /begin OUT_MEASUREMENT FlSys_stDeflate_mp /end OUT_MEASUREMENT /end FUNCTION
/begin FUNCTION flsys_shofftst "Test des niederdruckseitigen Abstellpfades" /end FUNCTION
/begin FUNCTION flsys_shofftst_uic "" /end FUNCTION
/begin FUNCTION flsys_temp "Kraftstoffsystem-Temperatur" /begin DEF_CHARACTERISTIC /end DEF_CHARACTERISTIC /end FUNCTION
/begin FUNCTION flsys_temp_msg "" /begin OUT_MEASUREMENT FlSys_swtTempSensCfg FlSys_t /end OUT_MEASUREMENT /end FUNCTION
/begin FUNCTION flsys_temp_uic "" /begin OUT_MEASUREMENT FlSys_stTemp_mp /end OUT_MEASUREMENT /end FUNCTION
/begin FUNCTION fma_adapt "Mengenmittelwertadaption - Adaption des Einspritzmengen-Fehlermodells" /begin DEF_CHARACTERISTIC /end DEF_CHARACTERISTIC /end FUNCTION
/begin FUNCTION fma_adapt_uic "" /begin OUT_MEASUREMENT FMA_qAct_mp FMA_qDev_mp /end OUT_MEASUREMENT /end FUNCTION
/begin FUNCTION fma_ctlcalc "Mengenmittelwertadaption - Berechnung des Einspritzmengenfehlers mittels adaptiver Steuerung" /begin DEF_CHARACTERISTIC /end DEF_CHARACTERISTIC /end FUNCTION
/begin FUNCTION fma_ctlcalc_msg "" /begin OUT_MEASUREMENT FMA_qDC FMA_qIC /end OUT_MEASUREMENT /end FUNCTION
/begin FUNCTION fma_ctlcalc_uic "" /begin OUT_MEASUREMENT FMA_qCtl_mp FMA_q_mp /end OUT_MEASUREMENT /end FUNCTION
/begin FUNCTION fma_errmod "Mengenmittelwertadaption - Algoithmen für Adaption und Auswertung des Fehlermodells für FMA_Adapt und FMA_CtlCalc" /begin DEF_CHARACTERISTIC /end DEF_CHARACTERISTIC /begin IN_MEASUREMENT Eng_nAvrg FMA_qCtl_mp /end IN_MEASUREMENT
 /begin OUT_MEASUREMENT FMA_qMapRow0_mp FMA_qMapRow1_mp FMA_qMapRow2_mp FMA_qMapRow3_mp FMA_qMapRow4_mp FMA_qMapRow5_mp FMA_qMapRow6_mp FMA_qMapRow7_mp /end OUT_MEASUREMENT
/end FUNCTION
/begin FUNCTION fma_errmod_uic ""
 /begin OUT_MEASUREMENT FMA_facNQSwtOff_mp FMA_facSwtOffTot_mp FMA_qDiff_mp FMA_qErrMod_mp FMA_qReg_mp FMA_qSetFil_mp FMA_tiFuncOp_mp /end OUT_MEASUREMENT
/end FUNCTION
/begin FUNCTION fma_monitor "Mengenmittelwertadaption - Überwachung und Abschaltung" /begin DEF_CHARACTERISTIC /end DEF_CHARACTERISTIC /begin IN_MEASUREMENT APSCD_pVal Eng_tEng FTSCD_tFuel IATSCD_tAir /end IN_MEASUREMENT /end FUNCTION
/begin FUNCTION fma_monitor_msg "" /begin OUT_MEASUREMENT FMA_facSwtOff FMA_stSwtOff /end OUT_MEASUREMENT /end FUNCTION
/begin FUNCTION fma_monitor_uic ""
 /begin OUT_MEASUREMENT FMA_dqAbs_mp FMA_drLmbdAbs_mp FMA_facAirSwtOff_mp FMA_facAPSwtOff_mp FMA_facEngSwtOff_mp FMA_facFaultSwtOff_mp FMA_facFlSwtOff_mp FMA_facRgnSwtOff_mp FMA_facSlpSwtOff_mp FMA_stDynDlyd_mp FMA_stDynLmbd_mp FMA_stNoAdapt_mp FMA_stOvrRunDlyd_mp FMA_stReset_mp FMA_stRngLmbd_mp /end OUT_MEASUREMENT
/end FUNCTION
/begin FUNCTION fmtc "Masse/Momenten-Wandler" /begin DEF_CHARACTERISTIC /end DEF_CHARACTERISTIC /begin IN_MEASUREMENT CoEng_trqInrSet Eng_nAvrg /end IN_MEASUREMENT /end FUNCTION
/begin FUNCTION fmtc_calccorr "Berchnung des Wirkungsgrad Korrekturfaktors" /begin DEF_CHARACTERISTIC /end DEF_CHARACTERISTIC
 /begin IN_MEASUREMENT CoEng_trqInrSet Eng_nAvrg FMTC_mAirDiff_mp FMTC_phiStrtInjDiff_mp /end IN_MEASUREMENT
/end FUNCTION
/begin FUNCTION fmtc_calccorr_msg "" /begin OUT_MEASUREMENT FMTC_facEtaCor /end OUT_MEASUREMENT /end FUNCTION
/begin FUNCTION fmtc_calccorr_uic ""
 /begin OUT_MEASUREMENT FMTC_facAirCor_mp FMTC_facStrtInjCor_mp FMTC_mAirDiff_mp FMTC_mAirOpt_mp FMTC_phiStrtInjDiff_mp FMTC_phiStrtInjOpt_mp /end OUT_MEASUREMENT
/end FUNCTION
/begin FUNCTION fmtc_msg ""
 /begin OUT_MEASUREMENT FMTC_etaCurr FMTC_etaCurrStd FMTC_qCurr FMTC_qDes FMTC_qRaw FMTC_qSet FMTC_qStrt FMTC_trqInr FMTC_trqInrLimSmk /end OUT_MEASUREMENT
/end FUNCTION
/begin FUNCTION fmtc_uic ""
 /begin OUT_MEASUREMENT FMTC_qSetOptStd_mp FMTC_qSetRgn1_mp FMTC_qSetRgn2_mp FMTC_qSetStd_mp /end OUT_MEASUREMENT
/end FUNCTION
/begin FUNCTION frmmng "CAN Message Frames für Übertragung und Empfang" /begin DEF_CHARACTERISTIC /end DEF_CHARACTERISTIC /begin IN_MEASUREMENT FrmMng_numACFanDes FrmMng_numRqStgEFan FrmMng_tEngRpm_mp /end IN_MEASUREMENT /end FUNCTION
/begin FUNCTION frmmng_11hex "" /begin DEF_CHARACTERISTIC /end DEF_CHARACTERISTIC /begin IN_MEASUREMENT Eng_nAvrg /end IN_MEASUREMENT /end FUNCTION
/begin FUNCTION frmmng_11hex_rx100ms_msg ""
 /begin OUT_MEASUREMENT FrmMng_stAC FrmMng_stSTAT_HDC FrmMng_stTSCDec FrmMng_stTSCInc FrmMng_trqTSCDec FrmMng_trqTSCInc /end OUT_MEASUREMENT
/end FUNCTION
/begin FUNCTION frmmng_11hex_uic ""
 /begin OUT_MEASUREMENT FrmMng_dOBDCtl_mp FrmMng_numASC1byte0_mp FrmMng_numASC1byte1_mp FrmMng_numASC1byte2_mp FrmMng_numASC1byte3_mp FrmMng_numASC1byte4_mp FrmMng_numASC1byte5_mp FrmMng_numASC1byte6_mp FrmMng_numASC1byte7_mp FrmMng_numASC2byte0_mp FrmMng_numASC2byte1_mp FrmMng_numASC2byte2_mp FrmMng_numASC2byte3_mp FrmMng_numASC2byte4_mp FrmMng_numASC2byte5_mp FrmMng_numASC2byte6_mp FrmMng_numASC2byte7_mp FrmMng_numASC3byte0_mp FrmMng_numASC3byte1_mp FrmMng_numASC3byte2_mp FrmMng_numASC3byte3_mp FrmMng_numASC3byte4_mp FrmMng_numASC3byte5_mp FrmMng_numASC3byte6_mp FrmMng_numASC3byte7_mp FrmMng_numASC4byte0_mp FrmMng_numASC4byte1_mp FrmMng_numASC4byte2_mp FrmMng_numASC4byte3_mp FrmMng_numASC4byte4_mp FrmMng_numASC4byte5_mp FrmMng_numASC4byte6_mp FrmMng_numASC4byte7_mp FrmMng_numDDE1byte0_mp FrmMng_numDDE1byte1_mp FrmMng_numDDE1byte2_mp FrmMng_numDDE1byte3_mp FrmMng_numDDE1byte4_mp FrmMng_numDDE1byte5_mp FrmMng_numDDE1byte6_mp FrmMng_numDDE1byte7_mp FrmMng_numDDE2byte0_mp FrmMng_numDDE2byte1_mp FrmMng_numDDE2byte2_mp FrmMng_numDDE2byte3_mp FrmMng_numDDE2byte4_mp FrmMng_numDDE2byte5_mp FrmMng_numDDE2byte6_mp FrmMng_numDDE2byte7_mp FrmMng_numDDE4byte0_mp FrmMng_numDDE4byte1_mp FrmMng_numDDE4byte2_mp FrmMng_numDDE4byte3_mp FrmMng_numDDE4byte4_mp FrmMng_numDDE4byte5_mp FrmMng_numDDE4byte6_mp FrmMng_numDDE4byte7_mp FrmMng_numEGS1byte0_mp FrmMng_numEGS1byte1_mp FrmMng_numEGS1byte2_mp FrmMng_numEGS1byte3_mp FrmMng_numEGS1byte4_mp FrmMng_numEGS1byte5_mp FrmMng_numEGS1byte6_mp FrmMng_numEGS1byte7_mp FrmMng_numEGS2byte0_mp FrmMng_numEGS2byte1_mp FrmMng_numEGS2byte2_mp FrmMng_numEGS2byte3_mp FrmMng_numEGS2byte4_mp FrmMng_numEGS2byte5_mp FrmMng_numEGS2byte6_mp FrmMng_numEGS2byte7_mp FrmMng_numEKPbyte0_mp FrmMng_numEKPbyte1_mp FrmMng_numEKPbyte2_mp FrmMng_numEKPbyte3_mp FrmMng_numINSTR2byte0_mp FrmMng_numINSTR2byte1_mp FrmMng_numINSTR2byte2_mp FrmMng_numINSTR2byte3_mp FrmMng_numINSTR2byte4_mp FrmMng_numINSTR2byte5_mp FrmMng_numINSTR2byte6_mp FrmMng_numINSTR2byte7_mp FrmMng_numINSTR3byte0_mp FrmMng_numINSTR3byte1_mp FrmMng_numINSTR3byte2_mp FrmMng_numINSTR3byte3_mp FrmMng_numINSTR3byte4_mp FrmMng_numINSTR3byte5_mp FrmMng_numINSTR3byte6_mp FrmMng_numINSTR3byte7_mp FrmMng_rTrqDCS_mp FrmMng_rTrqGearbxFrc_mp FrmMng_rTrqGearbx_mp FrmMng_rTrqTCS_mp FrmMng_stASC1Sig_mp FrmMng_stASC2Sig_mp FrmMng_stASC3Sig_mp FrmMng_stASC4Sig_mp FrmMng_stBrkTCS_mp FrmMng_stCrCCDKey_mp FrmMng_stCrCtlOff_mp FrmMng_stDCSActive_mp FrmMng_stDSCCtrl_mp FrmMng_stDSCDelay_mp FrmMng_stEGS1Sig_mp FrmMng_stEGS2Sig_mp FrmMng_stEngRun_mp FrmMng_stExc_ASC1_mp FrmMng_stExc_ASC2_mp FrmMng_stExc_ASC3_mp FrmMng_stExc_ASC4_mp FrmMng_stExc_EGS1_mp FrmMng_stExc_EGS2_mp FrmMng_stExc_INSTR2_mp FrmMng_stExc_INSTR3_mp FrmMng_stINSTR2Sig_mp FrmMng_stINSTR3Sig_mp FrmMng_stTCSActive_mp FrmMng_stTCSCtrl_mp FrmMng_stTrqDCSOk_mp FrmMng_stTrqTCSOk_mp FrmMng_trqDCSRaw_mp FrmMng_trqGearbxDes_mp FrmMng_trqGearbxRaw_mp FrmMng_trqTCSRaw_mp /end OUT_MEASUREMENT
/end FUNCTION
/begin FUNCTION frmmng_11hex_var_msg "" /begin OUT_MEASUREMENT FrmMng_stASCok FrmMng_stOldstStart FrmMng_trqFrc /end OUT_MEASUREMENT /end FUNCTION
/begin FUNCTION frmmng_conv "" /end FUNCTION
/begin FUNCTION frmmng_rx100ms_msg ""
 /begin OUT_MEASUREMENT FrmMng_ctrIdxNo FrmMng_nPSP FrmMng_pAir FrmMng_rPSPSetPoint FrmMng_stPRGG_CCTRSig FrmMng_stPSP FrmMng_tEnv FrmMng_tiDayCouAbsl FrmMng_trqDCS FrmMng_trqGbx FrmMng_trqTCS FrmMng_vPrgNo1 FrmMng_vPrgNo2 FrmMng_vPrgNo3 /end OUT_MEASUREMENT
/end FUNCTION
/begin COMPU_METHOD AirMassPerCyl "Luftmasse pro Zylinder" RAT_FUNC "%6.3" "mg/Hub" COEFFS 0 10 0 0 0 1 /end COMPU_METHOD
/begin COMPU_METHOD AirMassPerTime "Luftmasse pro Zeit" RAT_FUNC "%6.3" "Kg/h" COEFFS 0 10 0 0 0 1 /end COMPU_METHOD
/begin COMPU_METHOD AngleCrS "Winkel Kurbelwelle" RAT_FUNC "%6.4" "deg CrS" COEFFS 0 42.6666666666667 0 0 0 1 /end COMPU_METHOD
/begin COMPU_METHOD Area "Flaeche mit hoher Aufloesung" RAT_FUNC "%6.5" "m*m" COEFFS 0 8192 0 0 0 1 /end COMPU_METHOD
/begin COMPU_METHOD CubMtrPerHr "Volumsstrom in m^3/h" RAT_FUNC "%6.3" "m^3/h" COEFFS 0 10 0 0 0 1 /end COMPU_METHOD
/begin COMPU_METHOD Curr "Strom" RAT_FUNC "%6.2" "mA" COEFFS 0 1 0 0 0 1 /end COMPU_METHOD
/begin COMPU_METHOD dn_dZ20 "Motorbeschleunigung pro Zeit (dn/dt) (im 20 ms Raster)" RAT_FUNC "%6.1" "rmp/s" COEFFS 0 0.1 0 0 0 1 /end COMPU_METHOD
/begin COMPU_METHOD DtyCyc "Tastverhaeltnis" RAT_FUNC "%6.4" "%" COEFFS 0 100 0 0 0 1 /end COMPU_METHOD
/begin COMPU_METHOD Dxs "Prozentsatz fuer DXs (-100% ... 100%)" RAT_FUNC "%7.6" "%" COEFFS 0 40000 0 0 0 1 /end COMPU_METHOD
/begin COMPU_METHOD EGTFact "Umrechnung für EGT_TempGvnr Ausgabeschnittstellen und Messpunkte" RAT_FUNC "%6.5" "-" COEFFS 0 1000 0 0 0 1 /end COMPU_METHOD
/begin COMPU_METHOD EGTSwt "Umrechnung für EGT Rampenschalter (1 / 1000*2^14 )" RAT_FUNC "%10.9" "-" COEFFS 0 16384000 0 0 0 1 /end COMPU_METHOD
/begin COMPU_METHOD EGTSwt_S16 "Faktor (0...1) für sint16 Type mit 0.000061 Auflösung" RAT_FUNC "%7.6" "-" COEFFS 0 16384 0 0 0 1 /end COMPU_METHOD
/begin COMPU_METHOD Energy "Energie in Joule" RAT_FUNC "%6.2" "kJ" COEFFS 0 1 0 0 0 1 /end COMPU_METHOD
/begin COMPU_METHOD EngN "Motordrehzahl" RAT_FUNC "%6.2" "rpm" COEFFS 0 1 0 0 0 1 /end COMPU_METHOD
/begin COMPU_METHOD Eta "Umrechnugsformel für Wirkungsgradfaktor eta" RAT_FUNC "%6.4" "Nm/(mg/cyc)" COEFFS 0 128 0 0 0 1 /end COMPU_METHOD
/begin COMPU_METHOD ETClb_Eval_Rslt "Umrechnung der Zustände der  Ansteuerdauerkalibrierungsauswertung" TAB_VERB "%6.3" "-" COMPU_TAB_REF ETClb_Eval_Rslt /end COMPU_METHOD
/begin COMPU_VTAB ETClb_Eval_Rslt "Umrechnung der Zustände der  Ansteuerdauerkalibrierungsauswertung" TAB_VERB 3 0 "ZFC_ST_CLB_CONT" 1 "ZFC_ST_CLB_END" 2 "ZFC_ST_CLB_ERR" /end COMPU_VTAB
/begin COMPU_METHOD ETClb_Eval_State "Umrechnung der Zustände der Ausgabe des Zustandsautomaten der Evaluierung der Nullmengenkalibrierung" TAB_VERB "%6.3" "-" COMPU_TAB_REF ETClb_Eval_State /end COMPU_METHOD
/begin COMPU_VTAB ETClb_Eval_State "Umrechnung der Zustände der Ausgabe des Zustandsautomaten der Evaluierung der Nullmengenkalibrierung" TAB_VERB 3 0 "ETCLB_ST_EVAL_INIT" 1 "ETCLB_ST_EVAL_ADD" 2 "ETCLB_ST_EVAL_SUB" /end COMPU_VTAB
/begin COMPU_METHOD ETClb_State "Zustand des Zusandsautmaten der Ansteuerdauerkalibrierung" TAB_VERB "%6.3" "-" COMPU_TAB_REF ETClb_State /end COMPU_METHOD
/begin COMPU_VTAB ETClb_State "Zustand des Zusandsautmaten der Ansteuerdauerkalibrierung" TAB_VERB 5 0 "ETCLB_ST_NOT_ACTV" 1 "ETCLB_ST_START_ENERGIZE" 2 "ETCLB_ST_MEASURE" 3 "ETCLB_ST_EVALUATE" 4 "ETCLB_ST_DELAY" /end COMPU_VTAB
/begin COMPU_METHOD Fact "Faktor mit Auflösung 1 / 8192, hauptsächlich für einen Faktorenbereich 0...1 verwendet" RAT_FUNC "%6.5" "-" COEFFS 0 8192 0 0 0 1 /end COMPU_METHOD
/begin COMPU_METHOD Fact1 "Faktor mit Auflösung 0,01 (100 mal höherer Bereich als Fact)" RAT_FUNC "%6.4" "-" COEFFS 0 128 0 0 0 1 /end COMPU_METHOD
/begin COMPU_METHOD Fact_PT1 "Faktor um die Zeitkonstante eines PT1 filters festzulegen (Taupunktermittlung)" RAT_FUNC "%6.4" "W/K" COEFFS 0 128 0 0 0 1 /end COMPU_METHOD
/begin COMPU_METHOD FanSpd "(MAXSINT16 / FANSPD_MAX) * phys" RAT_FUNC "%6.3" "1/min" COEFFS 0 10.9223333333333 0 0 0 1 /end COMPU_METHOD
/begin COMPU_METHOD FBC_BPfac "Umrechnungsformel für drehmomentübersetzungsabhängige Bandpassverstärkung" RAT_FUNC "%6.4" "-" COEFFS 0 546.116666666667 0 0 0 1 /end COMPU_METHOD
/begin COMPU_METHOD FBC_LrnState "Zustände des FBC Zustandsautomaten" TAB_VERB "%6.3" "-" COMPU_TAB_REF FBC_LrnState /end COMPU_METHOD
/begin COMPU_VTAB FBC_LrnState "Zustände des FBC Zustandsautomaten" TAB_VERB 5 1 "INIT   " 2 "DX_WAIT" 3 "LEARN  " 4 "APPLY  " 5 "DELAY  " /end COMPU_VTAB
/begin COMPU_METHOD HeatCapacity "Waermekapazitaet einer Substanz" RAT_FUNC "%6.3" "J/K" COEFFS 0 10 0 0 0 1 /end COMPU_METHOD
/begin COMPU_METHOD IndSysTempFldSel "Auswahl für Lufttemperaturfeld" TAB_VERB "%6.3" "-" COMPU_TAB_REF IndSysTempFldSel /end COMPU_METHOD
/begin COMPU_VTAB IndSysTempFldSel "Auswahl für Lufttemperaturfeld" TAB_VERB 3 0 "IATSCD_tAir" 1 "AFSCD_tAir" 2 "EATSCD_tAir" /end COMPU_VTAB
/begin COMPU_METHOD InjMass "Einspritzmenge" RAT_FUNC "%6.4" "mg/hub" COEFFS 0 100 0 0 0 1 /end COMPU_METHOD
/begin COMPU_METHOD InjMassCorr "Korrektureinspritzmenge" RAT_FUNC "%6.5" "mg/hub" COEFFS 0 1000 0 0 0 1 /end COMPU_METHOD
/begin COMPU_METHOD InjMassCyc "Einspritzmenge pro Zyklus (mg/Zyklus)" RAT_FUNC "%6.4" "mg/cyc" COEFFS 0 100 0 0 0 1 /end COMPU_METHOD
/begin COMPU_METHOD InjMassInj "Einspritzmenge pro Einspritzung (mg/Einspritzung)" RAT_FUNC "%6.4" "mg/inj" COEFFS 0 100 0 0 0 1 /end COMPU_METHOD
/begin COMPU_METHOD InjMassNSlp "Steigung der Korrektureinspritzmenge aufgrund der Drehzahlrichtung" RAT_FUNC "%7.6" "(mg/hub)/rpm" COEFFS 0 10000 0 0 0 1 /end COMPU_METHOD
/begin COMPU_METHOD InjMassQSlp "Steigung der Korrektureinspritzmenge aufgrund der Mengenrichtung" RAT_FUNC "%6.4" "-" COEFFS 0 100 0 0 0 1 /end COMPU_METHOD
/begin COMPU_METHOD InjMassSec "Einspritzmenge pro Sekunde" RAT_FUNC "%6.4" "mg/hub/s" COEFFS 0 100 0 0 0 1 /end COMPU_METHOD
/begin COMPU_METHOD InjTime_ms "Einspritzzeit in Millisekunden" RAT_FUNC "%6.4" "ms" COEFFS 0 100 0 0 0 1 /end COMPU_METHOD
/begin COMPU_METHOD InjTime_us "Zeit in Microsekunden für das Einspritztiming" RAT_FUNC "%6.2" "us" COEFFS 0 1 0 0 0 1 /end COMPU_METHOD
/begin COMPU_METHOD Kd16_sqr_rpm2Nm "Wurzeldifferentialverstärkung Kd^0,5 für D2T2 (zweifach DT1), Motordrehzahl EngN zu Motormoment Trq" RAT_FUNC "%6.5" "(Nm/rpm)^0.5" COEFFS 0 1024 0 0 0 1 /end COMPU_METHOD
/begin COMPU_METHOD Kd_1 "Differentialverstärkung Kd (gleiche Einheit/Umrechnungsregel an Ein- und Ausgang; Umrechnung für sint16-Werte)" RAT_FUNC "%6.4" "1/1" COEFFS 0 512 0 0 0 1 /end COMPU_METHOD
/begin COMPU_METHOD Kd_InjMass2Ampc "Differentialverstärkung Kd (Einspritzmenge InjMass zu Luftmasse pro Zyl. AirMassPerCyl)" RAT_FUNC "%6.5" "(mg/Hub Luft)/(mg/Hub)" COEFFS 0 6553.6 0 0 0 1 /end COMPU_METHOD
/begin COMPU_METHOD Kd_InjMass2Prc "Differentialverstärkung (Einspritzmasse zu Prozent)" RAT_FUNC "%7.6" "%/(mg/Hub)" COEFFS 0 53687.0912 0 0 0 1 /end COMPU_METHOD
/begin COMPU_METHOD Kd_Lin_16 "Kd Verstärkung von linearen Kennlinien/-feldern" RAT_FUNC "%7.6" "1/1" COEFFS 0 32767 0 0 0 1 /end COMPU_METHOD
/begin COMPU_METHOD Kd_PerSec_20ms "differential gain (same unit as input and output) per time" RAT_FUNC "%6.5" "1/s" COEFFS 0 1310.72 0 0 0 1 /end COMPU_METHOD
/begin COMPU_METHOD Kd_pRail2Q_1 "Differentialverstärkung mit Normexponent (Raildruck zu Menge)" RAT_FUNC "%10.3" "mm^3/s/bar" COEFFS 0 40.960000 0 0 0 1 /end COMPU_METHOD
/begin COMPU_METHOD Kd_Pres2dpdt "differential gain(boost pressure to rate of change of boost pressure)" RAT_FUNC "%8.7" "hPa/sec/hPa" COEFFS 0 131072 0 0 0 1 /end COMPU_METHOD
/begin COMPU_METHOD Kd_Pres_hPa2Prc "Differentialverstärkung Kd (Druck Pres_hPa zu Prozent Prc)" RAT_FUNC "%9.8" "%/hPa" COEFFS 0 5368709.12 0 0 0 1 /end COMPU_METHOD
/begin COMPU_METHOD Kd_rpm2dndt "differential gain(engine speed to rate of change of engine speed)" RAT_FUNC "%8.7" "rmp/sec/rpm" COEFFS 0 131072 0 0 0 1 /end COMPU_METHOD
/begin COMPU_METHOD Kd_rpm2Nm_1 "Diferenzieller Verstärkungsfaktor (Umdrehungen nach Moment), Umrechnung für sint16 Werte." RAT_FUNC "%6.4" "Nm/rpm" COEFFS 0 320 0 0 0 1 /end COMPU_METHOD
/begin COMPU_METHOD Kd_Temp_Kelv2Dcyc "Differentialverstärkung Kd (Temperatur zu Tastverhältnis)" RAT_FUNC "%8.7" "%/(K)" COEFFS 0 655360 0 0 0 1 /end COMPU_METHOD
/begin COMPU_METHOD Kd_Vel2TrqPrp "Differentialverstärkung (Fahrgeschwindigkeit zu Vortriebsmoment)" RAT_FUNC "%6.5" "Nm/(km/h)" COEFFS 0 3276.8 0 0 0 1 /end COMPU_METHOD
/begin COMPU_METHOD Ki_1 "Integrale Verstärkung Ki (gleiche Einheit/Umrechnungsregel an Ein- und Ausgang; Umrechnung für sint16-Werte)" RAT_FUNC "%6.4" "1/s" COEFFS 0 67.108864 0 0 0 1 /end COMPU_METHOD
/begin COMPU_METHOD Ki_Ampc2Prc "Integralverstärkung (Luftmasse pro Zyl. AirMassPerCyl zu Prozent Prc)" RAT_FUNC "%7.6" "%/(mg/Hub Luft)/s" COEFFS 0 35184.372088832 0 0 0 1 /end COMPU_METHOD
/begin COMPU_METHOD Ki_curr2fact "Integralverstärkung (Strom Curr zu Faktor Fact)" RAT_FUNC "%10.9" "1/mA*s" COEFFS 0 35184372.088832 0 0 0 1 /end COMPU_METHOD
/begin COMPU_METHOD Ki_Kelv_Sec "Verstärkungskonstante für Integrator für zeitliche Ableitung der Temperatur" RAT_FUNC "%6.4" "1/s" COEFFS 0 429.4967296 0 0 0 1 /end COMPU_METHOD
/begin COMPU_METHOD Ki_LmbdRec2InjMass "Integrationsverstärkung (reziprokes Lambda zu Einspritzmenge)" RAT_FUNC "%6.4" "mg/stroke/s" COEFFS 0 42.94967296 0 0 0 1 /end COMPU_METHOD
/begin COMPU_METHOD Ki_pRail2Q_1 "Intgralverstärkung mit Normexponent (Raildruck zu Menge)" RAT_FUNC "%10.3" "mm^3/s^2/bar" COEFFS 0 10.737418 0 0 0 1 /end COMPU_METHOD
/begin COMPU_METHOD Ki_PrcEGRRmp_2_Prc "Integral Faktor (Prozent für EGR-Rampe zu Prozent)" RAT_FUNC "%7.6" "1/s" COEFFS 0 53687.0912 0 0 0 1 /end COMPU_METHOD
/begin COMPU_METHOD Ki_Pres_fac2hPa "Gain Conversion from Factor to Hpa" RAT_FUNC "%6.4" "hPa/s" COEFFS 0 268.435456 0 0 0 1 /end COMPU_METHOD
/begin COMPU_METHOD Ki_Pres_hPa2Prc "Integralverstärkung (Druck Pres_hPa zu Prozent Prc)" RAT_FUNC "%8.7" "%/(hPa*s)" COEFFS 0 351843.72088832 0 0 0 1 /end COMPU_METHOD
/begin COMPU_METHOD Ki_rpm2Nm_1 "Integrator Verstärkung (Umdrehungen nach Drehmoment), Umrechnung für sint16 Werte." RAT_FUNC "%6.4" "Nm/(rpm*s)" COEFFS 0 167.77216 0 0 0 1 /end COMPU_METHOD
/begin COMPU_METHOD Ki_Temp2EGTFact "Umrechnung für die Integrator Verstärkung des PI Reglers im EGT_TempGvnr [1/K]" RAT_FUNC "%8.7" "1/(K*s)" COEFFS 0 858993.4592 0 0 0 1 /end COMPU_METHOD
/begin COMPU_METHOD Ki_Temp_Kelv2Dcyc "Integralverstärkung (Temperatur zu Tastverhältnis)" RAT_FUNC "%7.6" "%/(K)" COEFFS 0 42949.67296 0 0 0 1 /end COMPU_METHOD
/begin COMPU_METHOD lambda "Lambda" RAT_FUNC "%6.5" "-" COEFFS 0 1000 0 0 0 1 /end COMPU_METHOD
/begin COMPU_METHOD lambdaRec "Kehrwert von Lambda" RAT_FUNC "%7.6" "-" COEFFS 0 10000 0 0 0 1 /end COMPU_METHOD
/begin COMPU_METHOD lambdaSec "Lambda Aenderungsrate" RAT_FUNC "%6.5" "-/s" COEFFS 0 1000 0 0 0 1 /end COMPU_METHOD
/begin COMPU_METHOD OneToOne "eins zu eins (physikalischer Wert ist gleich dem internen Wert)" RAT_FUNC "%6.2" "-" COEFFS 0 1 0 0 0 1 /end COMPU_METHOD
/begin COMPU_METHOD Per_Ratio "Umwandlung fuer Bereichsgewichtung" RAT_FUNC "%6.4" "-" COEFFS 0 256 0 0 0 1 /end COMPU_METHOD
/begin COMPU_METHOD Prc "Prozent, gleiche interne Auflösung wie Fact, aber Darstellung in Prozent (0...100%)" RAT_FUNC "%6.4" "%" COEFFS 0 81.92 0 0 0 1 /end COMPU_METHOD
/begin COMPU_METHOD Pres_hPa "Druck (angezeigt in [hPa])" RAT_FUNC "%6.2" "hPa" COEFFS 0 1 0 0 0 1 /end COMPU_METHOD
/begin COMPU_METHOD PSP_Spd "PSP speed in rpm" RAT_FUNC "%6.2" "rpm" COEFFS 0 1 0 0 0 1 /end COMPU_METHOD
/begin COMPU_METHOD Pwr "Leistung" RAT_FUNC "%6.2" "W" COEFFS 0 0.10610329539459 0 0 0 1 /end COMPU_METHOD
/begin COMPU_METHOD Pwr1 "Leistung mit Hoher Aufloesung" RAT_FUNC "%6.3" "W" COEFFS 0 10 0 0 0 1 /end COMPU_METHOD
/begin COMPU_METHOD Pwr_kW_Sec "Leistungsaenderungsrate in kW/s" RAT_FUNC "%6.4" "kW/s" COEFFS 0 100 0 0 0 1 /end COMPU_METHOD
/begin COMPU_METHOD Resist "Widerstand" RAT_FUNC "%6.3" "Ohm" COEFFS 0 10 0 0 0 1 /end COMPU_METHOD
/begin COMPU_METHOD ReynoldsNum "Reynolds Nummer um den thermischen Koeffizienten zu bestimmen" RAT_FUNC "%6.0" "-" COEFFS 0 0.01 0 0 0 1 /end COMPU_METHOD
/begin COMPU_METHOD RhoFuel "Kraftstoffdichte" RAT_FUNC "%6.3" "kg/m^3" COEFFS 0 10 0 0 0 1 /end COMPU_METHOD
/begin COMPU_METHOD SpecificHeat "spezifische Waermekapazitaet einer Substanz" RAT_FUNC "%7.6" "J/g/K" COEFFS 0 10000 0 0 0 1 /end COMPU_METHOD
/begin COMPU_METHOD TempDiff_Cels "difference/offset temperature displayed in degree celcius" RAT_FUNC "%6.3" "deg C" COEFFS 0 10 0 0 0 1 /end COMPU_METHOD
/begin COMPU_METHOD Temp_Cels "Temperatur dargestellt in °C (gleiche interne Darstellung wie Temp_Kelv)" RAT_FUNC "%6.1" "deg C" COEFFS 0 10 2731.4 0 0 1 /end COMPU_METHOD
/begin COMPU_METHOD Temp_Kelv_Sec "Temperaturaenderungsrate" RAT_FUNC "%6.4" "K/s" COEFFS 0 100 0 0 0 1 /end COMPU_METHOD
/begin COMPU_METHOD ThermalCoEff "Waermekoeffiziens einer Substanz" RAT_FUNC "%6.3" "W/m/m/K" COEFFS 0 10 0 0 0 1 /end COMPU_METHOD
/begin COMPU_METHOD TimeDelay_s "Zeitkonstante T1 (in s) für PT1, DT1, etc." RAT_FUNC "%9.3" "s" COEFFS 0 0 1 0 0.00023283064365387 0 /end COMPU_METHOD
/begin COMPU_METHOD TimeDT "Abtastzeit (in us) für Library Regler, Filter, etc." RAT_FUNC "%6.2" "us" COEFFS 0 1 0 0 0 1 /end COMPU_METHOD
/begin COMPU_METHOD TimeEGTRmp "Umrechnung  Zeit in Rampensteigung,  Verwendet in EGT-Bibliothek" RAT_FUNC "%6.3" "s" COEFFS 0 0 1 0 0.0152587890625 0 /end COMPU_METHOD
/begin COMPU_METHOD TimeSys_us "Zeit in [us] mit Systemzeit-Auflösung" RAT_FUNC "%6.3" "us" COEFFS 0 3.4965 0 0 0 1 /end COMPU_METHOD
/begin COMPU_METHOD Time_s "Zeit in s für Fehlerentprellung (DSM) und SW-Timer" RAT_FUNC "%6.4" "s" COEFFS 0 100 0 0 0 1 /end COMPU_METHOD
/begin COMPU_METHOD Trq "Motormoment" RAT_FUNC "%6.3" "Nm" COEFFS 0 10 0 0 0 1 /end COMPU_METHOD
/begin COMPU_METHOD vfzg_uw_b512 "ME9 Umwandlungen" RAT_FUNC "%6.4" "km/h" COEFFS 0 65536 0 0 0 512 /end COMPU_METHOD
/begin COMPU_METHOD Volt "Spannung in V (von ADC)" RAT_FUNC "%6.2" "mV" COEFFS 0 0.2046 0 0 0 1 /end COMPU_METHOD
/end MODULE
/end PROJECT
