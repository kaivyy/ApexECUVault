ASAP2_VERSION 1 41
/begin PROJECT MSD85 "Spray Guided DI-System with Piezo Injectors for 8-Cylinder"
/begin HEADER "_default_HeaderComment" PROJECT_NO _91 /end HEADER
/begin MODULE _default_ModuleName "_default_ModuleLongIdentifier"
/begin MOD_COMMON "_default_ModCommonComment" DEPOSIT ABSOLUTE BYTE_ORDER MSB_LAST ALIGNMENT_BYTE 1 ALIGNMENT_WORD 2 ALIGNMENT_LONG 2 ALIGNMENT_FLOAT32_IEEE 2 ALIGNMENT_FLOAT64_IEEE 4 /end MOD_COMMON
/begin MEASUREMENT lv_mil_act_req "Request of MIL activation by others" UBYTE _CNV_S_2_RANGE__0___1_CM 1 100. 0. 1. DISPLAY_IDENTIFIER LV_MIL_ACT_REQ ECU_ADDRESS 0xd0008145 /end MEASUREMENT
/begin MEASUREMENT lv_wal_1_act_req "Request of WAL_1 activation by others" UBYTE _CNV_S_2_RANGE__0___1_CM 1 100. 0. 1. DISPLAY_IDENTIFIER LV_WAL_1_ACT_REQ ECU_ADDRESS 0xd000814a /end MEASUREMENT
/begin MEASUREMENT lv_wal_2_act_req "Request of WAL_2 activation by others" UBYTE _CNV_S_2_RANGE__0___1_CM 1 100. 0. 1. DISPLAY_IDENTIFIER LV_WAL_2_ACT_REQ ECU_ADDRESS 0xd000814c /end MEASUREMENT
/begin AXIS_PTS ldp_1_id_err_dtc_info "" 0xa08028d4 errm_online_dummy _REC_AXS_20_u1 255. _CNV_A_R_LINEAR_____0_CM 4 0. 255. FORMAT "%3.0" /end AXIS_PTS
/begin MEASUREMENT Atlr1_k "Stellgroesse WG1 - korrigiert" UWORD _CNV_R_R_Def_f_uw_b_555_CM 1 100. 0. 99.9984 DISPLAY_IDENTIFIER ATLR1_K ECU_ADDRESS 0xd000ca3c FORMAT "%8.3" /end MEASUREMENT
/begin MEASUREMENT Atlr2_k "Stellgroesse WG2 - korrigiert" UWORD _CNV_R_R_Def_f_uw_b_555_CM 1 100. 0. 99.9984 DISPLAY_IDENTIFIER ATLR2_K ECU_ADDRESS 0xd000ca3e FORMAT "%8.3" /end MEASUREMENT
/begin MEASUREMENT Atlr_zwkor "Stellgroesse - Zuendwinkel korrigiert" UWORD _CNV_R_R_Def_f_uw_b_555_CM 1 100. 0. 99.9984 DISPLAY_IDENTIFIER ATLR_ZWKOR ECU_ADDRESS 0xd000ca32 FORMAT "%8.3" /end MEASUREMENT
/begin MEASUREMENT Bb_beratlad_i "ATL-Regler Adaption aktiv" UBYTE _CNV_R_R_Def_dez_sl_551_CM 1 100. 0. 1. DISPLAY_IDENTIFIER BB_BERATLAD_I ECU_ADDRESS 0xc000069e FORMAT "%3.0" ARRAY_SIZE 2 MATRIX_DIM 2 1 1 /end MEASUREMENT
/begin MEASUREMENT Dlam_bs1 "Lambda-Sollwertaenderung aus Bauteilschutz, Bank 1" SWORD _CNV_R_R_Def_f_sw_b_592_CM 1 100. -8. 7.9997 DISPLAY_IDENTIFIER DLAM_BS1 ECU_ADDRESS 0xc00074be FORMAT "%9.4" /end MEASUREMENT
/begin MEASUREMENT Dlam_bs2 "Lambda-Sollwertaenderung aus Bauteilschutz, Bank 2" SWORD _CNV_R_R_Def_f_sw_b_592_CM 1 100. -8. 7.9997 DISPLAY_IDENTIFIER DLAM_BS2 ECU_ADDRESS 0xc00074c0 FORMAT "%9.4" /end MEASUREMENT
/begin MEASUREMENT Dlam_bs_n54 "Bauteilschutz-Vorsteuerwert fuer N54" UBYTE _CNV_R_R_Def_f_ub_b_593_CM 1 100. 0. 0.498 DISPLAY_IDENTIFIER DLAM_BS_N54 ECU_ADDRESS 0xc000748e /end MEASUREMENT
/begin MEASUREMENT Dlam_bs_nok1 "Lambda-Sollwertaenderung aus Bauteilschutz fuer NOx-Kat, Bank 1" SWORD _CNV_R_R_Def_f_sw_b_592_CM 1 100. -8. 7.9997 DISPLAY_IDENTIFIER DLAM_BS_NOK1 ECU_ADDRESS 0xc00074c6 FORMAT "%9.4" /end MEASUREMENT
/begin MEASUREMENT Dlam_bs_nok2 "Lambda-Sollwertaenderung aus Bauteilschutzfuer NOx-Kat, Bank 2" SWORD _CNV_R_R_Def_f_sw_b_592_CM 1 100. -8. 7.9997 DISPLAY_IDENTIFIER DLAM_BS_NOK2 ECU_ADDRESS 0xc00074cc FORMAT "%9.4" /end MEASUREMENT
/begin MEASUREMENT Drfmx_ob "Delta Rfmax-Offset bei Overboost" SWORD _CNV_R_R_Def_rf_sw__598_CM 1 100. -327.68 327.67 DISPLAY_IDENTIFIER DRFMX_OB ECU_ADDRESS 0xc0000696 FORMAT "%9.4" /end MEASUREMENT
/begin MEASUREMENT Drfmxw_ob "Delta Rfmax-Offset bei Overboost" SWORD _CNV_R_R_Def_rf_sw__598_CM 1 100. 0. 327.67 DISPLAY_IDENTIFIER DRFMXW_OB ECU_ADDRESS 0xc0000698 FORMAT "%9.4" /end MEASUREMENT
/begin MEASUREMENT Dt_bsinok "Deltatemperatur zur Absenkung der BS Solltemperatur bei zu hoher Inkattemperatur NOX" SWORD _CNV_R_R_Def_t_sw_q_578_CM 1 100. -3276.8 3276.7 DISPLAY_IDENTIFIER DT_BSINOK ECU_ADDRESS 0xc00074da FORMAT "%6.1" /end MEASUREMENT
/begin MEASUREMENT Dt_bsivk "Deltatemperatur zur Absenkung der BS Solltemperatur bei zu hoher Inkattemperatur VK" SWORD _CNV_R_R_Def_t_sw_q_578_CM 1 100. -3276.8 3276.7 DISPLAY_IDENTIFIER DT_BSIVK ECU_ADDRESS 0xc00074dc FORMAT "%6.1" /end MEASUREMENT
/begin MEASUREMENT Dt_bsnn1 "Deltatemperatur fuer Solltemperaturberechnung ueber NN-Befragung Bank 1 VK" SWORD _CNV_R_R_Def_t_sw_q_578_CM 1 100. -3276.8 3276.7 DISPLAY_IDENTIFIER DT_BSNN1 ECU_ADDRESS 0xc0007596 FORMAT "%6.1" /end MEASUREMENT
/begin MEASUREMENT Dt_bsnn2 "Deltatemperatur fuer Solltemperaturberechnung ueber NN-Befragung Bank 2 VK" SWORD _CNV_R_R_Def_t_sw_q_578_CM 1 100. -3276.8 3276.7 DISPLAY_IDENTIFIER DT_BSNN2 ECU_ADDRESS 0xc0007598 FORMAT "%6.1" /end MEASUREMENT
/begin MEASUREMENT Dt_bsnn3 "Deltatemperatur fuer Solltemperaturberechnung ueber NN-Befragung Bank 1 NK-ATL" SWORD _CNV_R_R_Def_t_sw_q_578_CM 1 100. -3276.8 3276.7 DISPLAY_IDENTIFIER DT_BSNN3 ECU_ADDRESS 0xc000759a FORMAT "%6.1" /end MEASUREMENT
/begin MEASUREMENT Dt_bsnn4 "Deltatemperatur fuer Solltemperaturberechnung ueber NN-Befragung Bank 2 NK-ATL" SWORD _CNV_R_R_Def_t_sw_q_578_CM 1 100. -3276.8 3276.7 DISPLAY_IDENTIFIER DT_BSNN4 ECU_ADDRESS 0xc000759c FORMAT "%6.1" /end MEASUREMENT
/begin MEASUREMENT Dt_exo1 "Temperaturerhoehung durch Exotherme" SWORD _CNV_R_R_Def_t_sw_q_578_CM 1 100. -3276.8 3276.7 DISPLAY_IDENTIFIER DT_EXO1 ECU_ADDRESS 0xc0007734 FORMAT "%6.1" /end MEASUREMENT
/begin MEASUREMENT Dt_exo2 "Temperaturerhoehung durch Exotherme" SWORD _CNV_R_R_Def_t_sw_q_578_CM 1 100. -3276.8 3276.7 DISPLAY_IDENTIFIER DT_EXO2 ECU_ADDRESS 0xc0007736 FORMAT "%6.1" /end MEASUREMENT
/begin MEASUREMENT Dta_bs1 "Abweichung Abgastemperatur vor Kat Bank 1 von Sollwert" SWORD _CNV_R_R_Def_t_sw_q_578_CM 1 100. -3276.8 3276.7 DISPLAY_IDENTIFIER DTA_BS1 ECU_ADDRESS 0xc00074c2 FORMAT "%6.1" /end MEASUREMENT
/begin MEASUREMENT Dta_bs2 "Abweichung Abgastemperatur vor Kat Bank 2 von Sollwert" SWORD _CNV_R_R_Def_t_sw_q_578_CM 1 100. -3276.8 3276.7 DISPLAY_IDENTIFIER DTA_BS2 ECU_ADDRESS 0xc00074c4 FORMAT "%6.1" /end MEASUREMENT
/begin MEASUREMENT Dta_bs_nok1 "Abweichung Abgastemperatur vor NOx-Kat Bank 1 von Sollwert" SWORD _CNV_R_R_Def_t_sw_q_578_CM 1 100. -3276.8 3276.7 DISPLAY_IDENTIFIER DTA_BS_NOK1 ECU_ADDRESS 0xc00074c8 FORMAT "%6.1" /end MEASUREMENT
/begin MEASUREMENT Dta_bs_nok2 "Abweichung Abgastemperatur vor NOx-Kat Bank 2 von Sollwert" SWORD _CNV_R_R_Def_t_sw_q_578_CM 1 100. -3276.8 3276.7 DISPLAY_IDENTIFIER DTA_BS_NOK2 ECU_ADDRESS 0xc00074ca FORMAT "%6.1" /end MEASUREMENT
/begin MEASUREMENT Dtabg_exo1 "Temperaturerhoehung durch Exotherme" SWORD _CNV_R_R_Def_t_sw_q_578_CM 1 100. -3276.8 3276.7 DISPLAY_IDENTIFIER DTABG_EXO1 ECU_ADDRESS 0xc0007738 FORMAT "%6.1" /end MEASUREMENT
/begin MEASUREMENT Dtabg_exo2 "Temperaturerhoehung durch Exotherme" SWORD _CNV_R_R_Def_t_sw_q_578_CM 1 100. -3276.8 3276.7 DISPLAY_IDENTIFIER DTABG_EXO2 ECU_ADDRESS 0xc000773a FORMAT "%6.1" /end MEASUREMENT
/begin MEASUREMENT Dtexms "Exotherme Temperatur im Kat" SWORD _CNV_R_R_Def_t_sw_q_578_CM 1 100. -3276.8 3276.7 DISPLAY_IDENTIFIER DTEXMS ECU_ADDRESS 0xc000772c FORMAT "%6.1" /end MEASUREMENT
/begin MEASUREMENT Dtexmsik "Exotherme Temperatur im Kat" SWORD _CNV_R_R_Def_t_sw_q_578_CM 1 100. -3276.8 3276.7 DISPLAY_IDENTIFIER DTEXMSIK ECU_ADDRESS 0xc000772e FORMAT "%6.1" /end MEASUREMENT
/begin MEASUREMENT Dtwr1 "Ungefilterte Rohrwandtemperatur Rohr 1" SWORD _CNV_R_R_Def_t_sw_q_579_CM 1 100. -327.68 327.67 DISPLAY_IDENTIFIER DTWR1 ECU_ADDRESS 0xc0007754 FORMAT "%7.2" /end MEASUREMENT
/begin MEASUREMENT Dtwr10 "Ungefilterte Rohrwandtemperatur Rohr 10" SWORD _CNV_R_R_Def_t_sw_q_579_CM 1 100. -327.68 327.67 DISPLAY_IDENTIFIER DTWR10 ECU_ADDRESS 0xc000776a FORMAT "%7.2" /end MEASUREMENT
/begin MEASUREMENT Dtwr11 "Ungefilterte Rohrwandtemperatur Rohr 11" SWORD _CNV_R_R_Def_t_sw_q_579_CM 1 100. -327.68 327.67 DISPLAY_IDENTIFIER DTWR11 ECU_ADDRESS 0xc00077b2 FORMAT "%7.2" /end MEASUREMENT
/begin MEASUREMENT Dtwr11a "Ungefilterte Rohrwandtemperatur Rohr 11a (AGR)" SWORD _CNV_R_R_Def_t_sw_q_579_CM 1 100. -327.68 327.67 DISPLAY_IDENTIFIER DTWR11A ECU_ADDRESS 0xc00077b4 FORMAT "%7.2" /end MEASUREMENT
/begin MEASUREMENT Dtwr12 "Ungefilterte Rohrwandtemperatur Rohr 12" SWORD _CNV_R_R_Def_t_sw_q_579_CM 1 100. -327.68 327.67 DISPLAY_IDENTIFIER DTWR12 ECU_ADDRESS 0xc00077b6 FORMAT "%7.2" /end MEASUREMENT
/begin MEASUREMENT Dtwr12a "Ungefilterte Rohrwandtemperatur Rohr 12a" SWORD _CNV_R_R_Def_t_sw_q_579_CM 1 100. -327.68 327.67 DISPLAY_IDENTIFIER DTWR12A ECU_ADDRESS 0xc00077b8 FORMAT "%7.2" /end MEASUREMENT
/begin MEASUREMENT Dtwr13 "Ungefilterte Rohrwandtemperatur Rohr 13" SWORD _CNV_R_R_Def_t_sw_q_579_CM 1 100. -327.68 327.67 DISPLAY_IDENTIFIER DTWR13 ECU_ADDRESS 0xc00077ba FORMAT "%7.2" /end MEASUREMENT
/begin MEASUREMENT Dtwr14 "Ungefilterte Rohrwandtemperatur Rohr 14" SWORD _CNV_R_R_Def_t_sw_q_579_CM 1 100. -327.68 327.67 DISPLAY_IDENTIFIER DTWR14 ECU_ADDRESS 0xc00077bc FORMAT "%7.2" /end MEASUREMENT
/begin MEASUREMENT Dtwr14a "Ungefilterte Rohrwandtemperatur Rohr 14a" SWORD _CNV_R_R_Def_t_sw_q_579_CM 1 100. -327.68 327.67 DISPLAY_IDENTIFIER DTWR14A ECU_ADDRESS 0xc00077be FORMAT "%7.2" /end MEASUREMENT
/begin MEASUREMENT Dtwr15 "Ungefilterte Rohrwandtemperatur Rohr 15" SWORD _CNV_R_R_Def_t_sw_q_579_CM 1 100. -327.68 327.67 DISPLAY_IDENTIFIER DTWR15 ECU_ADDRESS 0xc00077c0 FORMAT "%7.2" /end MEASUREMENT
/begin MEASUREMENT Dtwr16 "Ungefilterte Rohrwandtemperatur Rohr 16" SWORD _CNV_R_R_Def_t_sw_q_579_CM 1 100. -327.68 327.67 DISPLAY_IDENTIFIER DTWR16 ECU_ADDRESS 0xc00077c2 FORMAT "%7.2" /end MEASUREMENT
/begin MEASUREMENT Dtwr2 "Ungefilterte Rohrwandtemperatur Rohr 2" SWORD _CNV_R_R_Def_t_sw_q_579_CM 1 100. -327.68 327.67 DISPLAY_IDENTIFIER DTWR2 ECU_ADDRESS 0xc0007756 FORMAT "%7.2" /end MEASUREMENT
/begin MEASUREMENT Dtwr3 "Ungefilterte Rohrwandtemperatur Rohr 3" SWORD _CNV_R_R_Def_t_sw_q_579_CM 1 100. -327.68 327.67 DISPLAY_IDENTIFIER DTWR3 ECU_ADDRESS 0xc0007758 FORMAT "%7.2" /end MEASUREMENT
/begin MEASUREMENT Dtwr4 "Ungefilterte Rohrwandtemperatur Rohr 4" SWORD _CNV_R_R_Def_t_sw_q_579_CM 1 100. -327.68 327.67 DISPLAY_IDENTIFIER DTWR4 ECU_ADDRESS 0xc000775a FORMAT "%7.2" /end MEASUREMENT
/begin MEASUREMENT Dtwr5 "Ungefilterte Rohrwandtemperatur Rohr 5" SWORD _CNV_R_R_Def_t_sw_q_579_CM 1 100. -327.68 327.67 DISPLAY_IDENTIFIER DTWR5 ECU_ADDRESS 0xc000775c FORMAT "%7.2" /end MEASUREMENT
/begin MEASUREMENT Dtwr6 "Ungefilterte Rohrwandtemperatur Rohr 6" SWORD _CNV_R_R_Def_t_sw_q_579_CM 1 100. -327.68 327.67 DISPLAY_IDENTIFIER DTWR6 ECU_ADDRESS 0xc000775e FORMAT "%7.2" /end MEASUREMENT
/begin MEASUREMENT Dtwr7 "Ungefilterte Rohrwandtemperatur Rohr 7" SWORD _CNV_R_R_Def_t_sw_q_579_CM 1 100. -327.68 327.67 DISPLAY_IDENTIFIER DTWR7 ECU_ADDRESS 0xc0007764 FORMAT "%7.2" /end MEASUREMENT
/begin MEASUREMENT Dtwr7a "Ungefilterte Rohrwandtemperatur Rohr 7a" SWORD _CNV_R_R_Def_t_sw_q_579_CM 1 100. -327.68 327.67 DISPLAY_IDENTIFIER DTWR7A ECU_ADDRESS 0xc0007760 FORMAT "%7.2" /end MEASUREMENT
/begin MEASUREMENT Dtwr8 "Ungefilterte Rohrwandtemperatur Rohr 8" SWORD _CNV_R_R_Def_t_sw_q_579_CM 1 100. -327.68 327.67 DISPLAY_IDENTIFIER DTWR8 ECU_ADDRESS 0xc0007766 FORMAT "%7.2" /end MEASUREMENT
/begin MEASUREMENT Dtwr8a "Ungefilterte Rohrwandtemperatur Rohr 8a" SWORD _CNV_R_R_Def_t_sw_q_579_CM 1 100. -327.68 327.67 DISPLAY_IDENTIFIER DTWR8A ECU_ADDRESS 0xc0007762 FORMAT "%7.2" /end MEASUREMENT
/begin MEASUREMENT Dtwr9 "Ungefilterte Rohrwandtemperatur Rohr 9" SWORD _CNV_R_R_Def_t_sw_q_579_CM 1 100. -327.68 327.67 DISPLAY_IDENTIFIER DTWR9 ECU_ADDRESS 0xc0007768 FORMAT "%7.2" /end MEASUREMENT
/begin MEASUREMENT Dtwr_wg1 "Delta-Wandtemperatur Bank 1 ueber Wastegate N54" SWORD _CNV_R_R_Def_t_sw_q_578_CM 1 100. -3276.8 3276.7 DISPLAY_IDENTIFIER DTWR_WG1 ECU_ADDRESS 0xc000774c FORMAT "%6.1" /end MEASUREMENT
/begin MEASUREMENT Dtwr_wg2 "Delta-Wandtemperatur Bank 2 ueber Wastegate N54" SWORD _CNV_R_R_Def_t_sw_q_578_CM 1 100. -3276.8 3276.7 DISPLAY_IDENTIFIER DTWR_WG2 ECU_ADDRESS 0xc000774e FORMAT "%6.1" /end MEASUREMENT
/begin MEASUREMENT Eta_zw_ist1_atm "Eta_zw_ist1 gefiltert" SWORD _CNV_R_R_Def_eta_sw_606_CM 1 100. 0. 100. DISPLAY_IDENTIFIER ETA_ZW_IST1_ATM ECU_ADDRESS 0xc00076f2 FORMAT "%8.3" /end MEASUREMENT
/begin MEASUREMENT Eta_zw_ist2_atm "Eta_zw_ist2 gefiltert" SWORD _CNV_R_R_Def_eta_sw_606_CM 1 100. 0. 100. DISPLAY_IDENTIFIER ETA_ZW_IST2_ATM ECU_ADDRESS 0xc00076f4 FORMAT "%8.3" /end MEASUREMENT
/begin MEASUREMENT Exonok1 "Beitrag aus Exothermie NoX-Kat 1 zur Abgastemperatur" SWORD _CNV_R_R_Def_t_sw_q_578_CM 1 100. -3276.8 3276.7 DISPLAY_IDENTIFIER EXONOK1 ECU_ADDRESS 0xc0007784 FORMAT "%6.1" /end MEASUREMENT
/begin MEASUREMENT Exonok2 "Beitrag aus Exothermie NoX-Kat 2 zur Abgastemperatur" SWORD _CNV_R_R_Def_t_sw_q_578_CM 1 100. -3276.8 3276.7 DISPLAY_IDENTIFIER EXONOK2 ECU_ADDRESS 0xc0007786 FORMAT "%6.1" /end MEASUREMENT
/begin MEASUREMENT F_atlad "Atl-Regler Adaptionsfaktor" UWORD _CNV_R_R_Def_f_uw_b_590_CM 1 100. 0. 1.9999 DISPLAY_IDENTIFIER F_ATLAD ECU_ADDRESS 0xc0004034 FORMAT "%14.5" /end MEASUREMENT
/begin MEASUREMENT F_atlad_i "Atl-Regler Adaptionsfaktor" UWORD _CNV_R_R_Def_f_uw_b_590_CM 1 100. 0. 1.9999 DISPLAY_IDENTIFIER F_ATLAD_I ECU_ADDRESS 0xc0004036 FORMAT "%14.5" ARRAY_SIZE 2 MATRIX_DIM 2 1 1 /end MEASUREMENT
/begin MEASUREMENT F_atlrivst_i "Faktor f. Verhältnis I-Anteil d. Regelung zur Vorsteuerung - Indikator f. ATL-Zustand" SWORD _CNV_R_R_Def_f_sw_b_616_CM 1 100. -2. 1.9999 DISPLAY_IDENTIFIER F_ATLRIVST_I ECU_ADDRESS 0xc00006a0 FORMAT "%14.5" ARRAY_SIZE 2 MATRIX_DIM 2 1 1 /end MEASUREMENT
/begin MEASUREMENT F_bs_i_nok "I-Anteil fuer Regler NOx-Kat" UWORD _CNV_R_R_Def_f_uw_b_590_CM 1 100. 0. 1.9999 DISPLAY_IDENTIFIER F_BS_I_NOK ECU_ADDRESS 0xc00074ec FORMAT "%14.5" /end MEASUREMENT
/begin MEASUREMENT F_bs_p_nok "P-Anteil fuer Regler NOx-Kat" UWORD _CNV_R_R_Def_f_uw_b_617_CM 1 100. 0. 63.999 DISPLAY_IDENTIFIER F_BS_P_NOK ECU_ADDRESS 0xc00074ea FORMAT "%9.4" /end MEASUREMENT
/begin MEASUREMENT F_msvld_diff "Massenstrom verteilung vor Verdichter Lader 2 zu 1" UWORD _CNV_R_R_Def_f_sw_b_616_CM 1 100. 0. 3.9999 DISPLAY_IDENTIFIER F_MSVLD_DIFF ECU_ADDRESS 0xd000cbf6 FORMAT "%14.5" /end MEASUREMENT
/begin MEASUREMENT F_wg1diag "Korrekturfaktor für Plausibilitätscheck" UWORD _CNV_R_R_Def_f_uw_b_590_CM 1 100. 0. 1.9999 DISPLAY_IDENTIFIER F_WG1DIAG ECU_ADDRESS 0xd000cbf8 FORMAT "%14.5" /end MEASUREMENT
/begin MEASUREMENT F_wg1k_ad "adaptierter Faktor f. Wastegate 1" UWORD _CNV_R_R_Def_f_uw_b_590_CM 1 100. 0. 1.9999 DISPLAY_IDENTIFIER F_WG1K_AD ECU_ADDRESS 0xc000403c FORMAT "%14.5" /end MEASUREMENT
/begin MEASUREMENT F_wg1k_fast "Korrekturfaktor Wastegate 1 schnell" UWORD _CNV_R_R_Def_f_uw_b_590_CM 1 100. 0. 1.9999 DISPLAY_IDENTIFIER F_WG1K_FAST ECU_ADDRESS 0xd000cbfa FORMAT "%14.5" /end MEASUREMENT
/begin MEASUREMENT F_wg1kor "Korrekturfaktor Wasgate 1" UWORD _CNV_R_R_Def_f_uw_b_590_CM 1 100. 0. 1.9999 DISPLAY_IDENTIFIER F_WG1KOR ECU_ADDRESS 0xd000cbf2 FORMAT "%14.5" /end MEASUREMENT
/begin MEASUREMENT F_wg2kor "Korrekturfaktor Wasgate 2" UWORD _CNV_R_R_Def_f_uw_b_590_CM 1 100. 0. 1.9999 DISPLAY_IDENTIFIER F_WG2KOR ECU_ADDRESS 0xd000cbf4 FORMAT "%14.5" /end MEASUREMENT
/begin MEASUREMENT Fatmtmot "zusaetzlicher Waermeuebergang Rohr an Umgebung" SWORD _CNV_R_R_Def_cxm_sw_627_CM 1 100. -128. 127.996 DISPLAY_IDENTIFIER FATMTMOT ECU_ADDRESS 0xc00076e6 FORMAT "%8.3" /end MEASUREMENT
/begin MEASUREMENT La_atm1 "unlimitierter Lambda-Wert für ATM Bank 1" UWORD _CNV_R_R_Def_f_uw_b_559_CM 1 100. 0. 15.9997 DISPLAY_IDENTIFIER LA_ATM1 ECU_ADDRESS 0xc000756c FORMAT "%9.4" /end MEASUREMENT
/begin MEASUREMENT La_atm2 "unlimitierter Lambda-Wert für ATM Bank 2" UWORD _CNV_R_R_Def_f_uw_b_559_CM 1 100. 0. 15.9997 DISPLAY_IDENTIFIER LA_ATM2 ECU_ADDRESS 0xc000756e FORMAT "%9.4" /end MEASUREMENT
/begin MEASUREMENT La_bs1 "Lambda-Sollwert aus Bauteilschutz, Bank 1" UWORD _CNV_R_R_Def_f_uw_b_559_CM 1 100. 0. 15.9997 DISPLAY_IDENTIFIER LA_BS1 ECU_ADDRESS 0xc0007498 FORMAT "%9.4" /end MEASUREMENT
/begin MEASUREMENT La_bs2 "Lambda-Sollwert aus Bauteilschutz, Bank 2" UWORD _CNV_R_R_Def_f_uw_b_559_CM 1 100. 0. 15.9997 DISPLAY_IDENTIFIER LA_BS2 ECU_ADDRESS 0xc000749a FORMAT "%9.4" /end MEASUREMENT
/begin MEASUREMENT La_bs_nn1 "Vorsteuer-Lambda aus inversem KNN, Bank 1 VK" UWORD _CNV_R_R_Def_f_uw_b_559_CM 1 100. 0. 15.9997 DISPLAY_IDENTIFIER LA_BS_NN1 ECU_ADDRESS 0xc0007564 FORMAT "%9.4" /end MEASUREMENT
/begin MEASUREMENT La_bs_nn1_ini "Gefilterter und begrenzter Vorsteuerwert Bank 1 VK" UWORD _CNV_R_R_Def_f_uw_b_559_CM 1 100. 0. 15.9997 DISPLAY_IDENTIFIER LA_BS_NN1_INI ECU_ADDRESS 0xc00074aa FORMAT "%9.4" /end MEASUREMENT
/begin MEASUREMENT La_bs_nn2 "Vorsteuer-Lambda aus inversem KNN, Bank 2 VK" UWORD _CNV_R_R_Def_f_uw_b_559_CM 1 100. 0. 15.9997 DISPLAY_IDENTIFIER LA_BS_NN2 ECU_ADDRESS 0xc0007566 FORMAT "%9.4" /end MEASUREMENT
/begin MEASUREMENT La_bs_nn2_ini "Gefilterter und begrenzter Vorsteuerwert Bank 2 VK" UWORD _CNV_R_R_Def_f_uw_b_559_CM 1 100. 0. 15.9997 DISPLAY_IDENTIFIER LA_BS_NN2_INI ECU_ADDRESS 0xc00074ac FORMAT "%9.4" /end MEASUREMENT
/begin MEASUREMENT La_bs_nn3 "Vorsteuer-Lambda aus inversem KNN, Bank 1 NK-ATL" UWORD _CNV_R_R_Def_f_uw_b_559_CM 1 100. 0. 15.9997 DISPLAY_IDENTIFIER LA_BS_NN3 ECU_ADDRESS 0xc0007568 FORMAT "%9.4" /end MEASUREMENT
/begin MEASUREMENT La_bs_nn3_ini "Gefilterter und begrenzter Vorsteuerwert Bank 1 NK-ATL" UWORD _CNV_R_R_Def_f_uw_b_559_CM 1 100. 0. 15.9997 DISPLAY_IDENTIFIER LA_BS_NN3_INI ECU_ADDRESS 0xc00074ae FORMAT "%9.4" /end MEASUREMENT
/begin MEASUREMENT La_bs_nn4 "Vorsteuer-Lambda aus inversem KNN, Bank 2 NK-ATL" UWORD _CNV_R_R_Def_f_uw_b_559_CM 1 100. 0. 15.9997 DISPLAY_IDENTIFIER LA_BS_NN4 ECU_ADDRESS 0xc000756a FORMAT "%9.4" /end MEASUREMENT
/begin MEASUREMENT La_bs_nn4_ini "Gefilterter und begrenzter Vorsteuerwert Bank 2 NK-ATL" UWORD _CNV_R_R_Def_f_uw_b_559_CM 1 100. 0. 15.9997 DISPLAY_IDENTIFIER LA_BS_NN4_INI ECU_ADDRESS 0xc00074b0 FORMAT "%9.4" /end MEASUREMENT
/begin MEASUREMENT La_bs_soll1 "Lambda-Sollwert aus Bauteilschutz, Bank 1" UWORD _CNV_R_R_Def_f_uw_b_559_CM 1 100. 0. 15.9997 DISPLAY_IDENTIFIER LA_BS_SOLL1 ECU_ADDRESS 0xc00074a6 FORMAT "%9.4" /end MEASUREMENT
/begin MEASUREMENT La_bs_soll2 "Lambda-Sollwert aus Bauteilschutz, Bank 2" UWORD _CNV_R_R_Def_f_uw_b_559_CM 1 100. 0. 15.9997 DISPLAY_IDENTIFIER LA_BS_SOLL2 ECU_ADDRESS 0xc00074a8 FORMAT "%9.4" /end MEASUREMENT
/begin MEASUREMENT La_bs_soll3 "Lambda-Sollwert aus Bauteilschutz fuer NOx-Kat, Bank 1" UWORD _CNV_R_R_Def_f_uw_b_559_CM 1 100. 0. 15.9997 DISPLAY_IDENTIFIER LA_BS_SOLL3 ECU_ADDRESS 0xc00074b2 FORMAT "%9.4" /end MEASUREMENT
/begin MEASUREMENT La_bs_soll4 "Lambda-Sollwert aus Bauteilschutz fuer NOx-Kat, Bank 2" UWORD _CNV_R_R_Def_f_uw_b_559_CM 1 100. 0. 15.9997 DISPLAY_IDENTIFIER LA_BS_SOLL4 ECU_ADDRESS 0xc00074b4 FORMAT "%9.4" /end MEASUREMENT
/begin MEASUREMENT La_vst1 "Gefilterter Lambda-Vorsteuerwert aus KNN, Bank 1 VK" UWORD _CNV_R_R_Def_f_uw_b_559_CM 1 100. 0. 15.9997 DISPLAY_IDENTIFIER LA_VST1 ECU_ADDRESS 0xc00074b6 FORMAT "%9.4" /end MEASUREMENT
/begin MEASUREMENT La_vst2 "Gefilterter Lambda-Vorsteuerwert aus KNN, Bank 2 VK" UWORD _CNV_R_R_Def_f_uw_b_559_CM 1 100. 0. 15.9997 DISPLAY_IDENTIFIER LA_VST2 ECU_ADDRESS 0xc00074b8 FORMAT "%9.4" /end MEASUREMENT
/begin MEASUREMENT La_vst3 "Gefilterter Lambda-Vorsteuerwert aus KNN, Bank 1 NK-ATL" UWORD _CNV_R_R_Def_f_uw_b_559_CM 1 100. 0. 15.9997 DISPLAY_IDENTIFIER LA_VST3 ECU_ADDRESS 0xc00074ba FORMAT "%9.4" /end MEASUREMENT
/begin MEASUREMENT La_vst4 "Gefilterter Lambda-Vorsteuerwert aus KNN, Bank 2 NK-ATL" UWORD _CNV_R_R_Def_f_uw_b_559_CM 1 100. 0. 15.9997 DISPLAY_IDENTIFIER LA_VST4 ECU_ADDRESS 0xc00074bc FORMAT "%9.4" /end MEASUREMENT
/begin MEASUREMENT Msturb_atm "Massenstrom Turbo ueber 200ms gemittelt" UWORD _CNV_R_R_Def_ms_uw__594_CM 1 100. 0. 2047.9687 DISPLAY_IDENTIFIER MSTURB_ATM ECU_ADDRESS 0xc0007694 FORMAT "%8.3" /end MEASUREMENT
/begin MEASUREMENT Mszyl_atm "Massenstrom Zylinder ueber 200ms gemittelt" UWORD _CNV_R_R_Def_ms_uw__594_CM 1 100. 0. 2047.9687 DISPLAY_IDENTIFIER MSZYL_ATM ECU_ADDRESS 0xc0007692 FORMAT "%8.3" /end MEASUREMENT
/begin MEASUREMENT Mszyl_bank "Massenstrom in einer Zylinderbank" UWORD _CNV_R_R_Def_ms_uw__594_CM 1 100. 0. 2047.9687 DISPLAY_IDENTIFIER MSZYL_BANK ECU_ADDRESS 0xc0007752 FORMAT "%8.3" /end MEASUREMENT
/begin MEASUREMENT Mszyl_ges_atm "Massenstrom gesamt ATM" UWORD _CNV_R_R_Def_ms_uw__594_CM 1 100. 0. 2047.9687 DISPLAY_IDENTIFIER MSZYL_GES_ATM ECU_ADDRESS 0xc000777a FORMAT "%8.3" /end MEASUREMENT
/begin MEASUREMENT Mszyl_int "Mszyl aufintegriert waehrend SA" UWORD _CNV_R_R_Def_m_uw_q_657_CM 1 100. 0. 20.0229 DISPLAY_IDENTIFIER MSZYL_INT ECU_ADDRESS 0xc0007594 FORMAT "%9.4" /end MEASUREMENT
/begin MEASUREMENT Mszyl_nagr "Massenstrom in Bank 1 abzueglich AGR-Massenstrom" UWORD _CNV_R_R_Def_ms_uw__594_CM 1 100. 0. 2047.9687 DISPLAY_IDENTIFIER MSZYL_NAGR ECU_ADDRESS 0xc0007778 FORMAT "%8.3" /end MEASUREMENT
/begin MEASUREMENT Mszyl_rohr "Massenstrom in einem Abgaskruemmer" UWORD _CNV_R_R_Def_ms_uw__594_CM 1 100. 0. 2047.9687 DISPLAY_IDENTIFIER MSZYL_ROHR ECU_ADDRESS 0xc0007750 FORMAT "%8.3" /end MEASUREMENT
/begin MEASUREMENT Nelueft_nox "E-Luefter Anforderung NOx Bauteilschutz" UBYTE _CNV_R_R_Def_f_ub_b_586_CM 1 100. 0. 99.60930000000001 DISPLAY_IDENTIFIER NELUEFT_NOX ECU_ADDRESS 0xc000748f FORMAT "%5.2" /end MEASUREMENT
/begin MEASUREMENT Nkw_atm "Motordrehzahl an der Kurbelwelle gemittelt ueber 200ms fuer ATM" SWORD _CNV_R_R_Def_n_sw_q_595_CM 1 100. -32768. 32767. DISPLAY_IDENTIFIER NKW_ATM ECU_ADDRESS 0xc0007572 FORMAT "%5.0" /end MEASUREMENT
/begin MEASUREMENT Nok_ta_1 "Zeitkonstante Filter fuer Innentemperatur NoX-Kat 1" UWORD _CNV_R_R_Def_td_uw__663_CM 1 100. 0. 65.535 DISPLAY_IDENTIFIER NOK_TA_1 ECU_ADDRESS 0xc000777c FORMAT "%8.3" /end MEASUREMENT
/begin MEASUREMENT Nok_ta_2 "Zeitkonstante Filter fuer Innentemperatur NoX-Kat 2" UWORD _CNV_R_R_Def_td_uw__663_CM 1 100. 0. 65.535 DISPLAY_IDENTIFIER NOK_TA_2 ECU_ADDRESS 0xc000777e FORMAT "%8.3" /end MEASUREMENT
/begin MEASUREMENT Nok_tb_1 "Zeitkonstante Filter fuer Temperatur nach NoX-Kat 1" UWORD _CNV_R_R_Def_td_uw__663_CM 1 100. 0. 65.535 DISPLAY_IDENTIFIER NOK_TB_1 ECU_ADDRESS 0xc0007780 FORMAT "%8.3" /end MEASUREMENT
/begin MEASUREMENT Nok_tb_2 "Zeitkonstante Filter fuer Temperatur nach NoX-Kat 2" UWORD _CNV_R_R_Def_td_uw__663_CM 1 100. 0. 65.535 DISPLAY_IDENTIFIER NOK_TB_2 ECU_ADDRESS 0xc0007782 FORMAT "%8.3" /end MEASUREMENT
/begin MEASUREMENT Rf_atm "Relative Luftfuellung gemittelt ueber 200ms fuer ATM" SWORD _CNV_R_R_Def_rf_sw__598_CM 1 100. -327.68 327.67 DISPLAY_IDENTIFIER RF_ATM ECU_ADDRESS 0xc0007570 FORMAT "%9.4" /end MEASUREMENT
/begin MEASUREMENT St_atlad "Statuswort" UBYTE _CNV_R_R_Def_dez_sl_551_CM 1 100. 0. 255. DISPLAY_IDENTIFIER ST_ATLAD ECU_ADDRESS 0xc000069c FORMAT "%3.0" /end MEASUREMENT
/begin MEASUREMENT St_atlad.B_atlad "ATL-Regler Adaption aktiv" UBYTE _CNV_S_2_Def_bit_ub_563_CM 1 100. 0. 1. DISPLAY_IDENTIFIER B_ATLAD ECU_ADDRESS 0xc000069c BIT_MASK 0x1 /end MEASUREMENT
/begin MEASUREMENT St_atlad.B_beratlad "ATL-Regler Adaption Grundbedingung gültig" UBYTE _CNV_S_2_Def_bit_ub_563_CM 1 100. 0. 1. DISPLAY_IDENTIFIER B_BERATLAD ECU_ADDRESS 0xc000069c BIT_MASK 0x2 /end MEASUREMENT
/begin MEASUREMENT St_atlaus "Statuswort" UBYTE _CNV_R_R_Def_dez_sl_551_CM 1 100. 0. 255. DISPLAY_IDENTIFIER ST_ATLAUS ECU_ADDRESS 0xd000cbd8 FORMAT "%3.0" /end MEASUREMENT
/begin MEASUREMENT St_atlaus.B_atl_rfmaxred "Bedingung Rf_max auf saugmotorische Volllast zu begrenzen" UBYTE _CNV_S_2_Def_bit_ub_563_CM 1 100. 0. 1. DISPLAY_IDENTIFIER B_ATL_RFMAXRED ECU_ADDRESS 0xd000cbd8 BIT_MASK 0x8 /end MEASUREMENT
/begin MEASUREMENT St_atlaus.B_atladp_off "Bedingung ATL Adaption auschalten" UBYTE _CNV_S_2_Def_bit_ub_563_CM 1 100. 0. 1. DISPLAY_IDENTIFIER B_ATLADP_OFF ECU_ADDRESS 0xd000cbd8 BIT_MASK 0x4 /end MEASUREMENT
/begin MEASUREMENT St_atlaus.B_atldiag_off "Bedingung ATL Diagnose auschalten" UBYTE _CNV_S_2_Def_bit_ub_563_CM 1 100. 0. 1. DISPLAY_IDENTIFIER B_ATLDIAG_OFF ECU_ADDRESS 0xd000cbd8 BIT_MASK 0x2 /end MEASUREMENT
/begin MEASUREMENT St_atlaus.B_atlreg_off "Bedingung ATL Regler auschalten" UBYTE _CNV_S_2_Def_bit_ub_563_CM 1 100. 0. 1. DISPLAY_IDENTIFIER B_ATLREG_OFF ECU_ADDRESS 0xd000cbd8 BIT_MASK 0x1 /end MEASUREMENT
/begin MEASUREMENT St_atldiag_10ms "Statuswort" UBYTE _CNV_R_R_Def_dez_sl_551_CM 1 100. 0. 255. DISPLAY_IDENTIFIER ST_ATLDIAG_10MS ECU_ADDRESS 0xd000cbd9 FORMAT "%3.0" /end MEASUREMENT
/begin MEASUREMENT St_atldiag_10ms.B_atl_err "ATL -Systemfehler - Eintrag im Fehlerspeicher" UBYTE _CNV_S_2_Def_bit_ub_563_CM 1 100. 0. 1. DISPLAY_IDENTIFIER B_ATL_ERR ECU_ADDRESS 0xd000cbd9 BIT_MASK 0x1 /end MEASUREMENT
/begin MEASUREMENT St_atldiag_10ms.B_atllekfast "ATL Leckage schnell - erkannt" UBYTE _CNV_S_2_Def_bit_ub_563_CM 1 100. 0. 1. DISPLAY_IDENTIFIER B_ATLLEKFAST ECU_ADDRESS 0xd000cbd9 BIT_MASK 0x4 /end MEASUREMENT
/begin MEASUREMENT St_atldiag_10ms.B_atlr_errmn "Reglerfehler - negative Richtung" UBYTE _CNV_S_2_Def_bit_ub_563_CM 1 100. 0. 1. DISPLAY_IDENTIFIER B_ATLR_ERRMN ECU_ADDRESS 0xd000cbd9 BIT_MASK 0x8 /end MEASUREMENT
/begin MEASUREMENT St_atldiag_10ms.B_atlr_errmx "Reglerfehler - positive Richtung" UBYTE _CNV_S_2_Def_bit_ub_563_CM 1 100. 0. 1. DISPLAY_IDENTIFIER B_ATLR_ERRMX ECU_ADDRESS 0xd000cbd9 BIT_MASK 0x10 /end MEASUREMENT
/begin MEASUREMENT St_atldiag_10ms.B_beratllek "ATL Leckageerkennung aktiv" UBYTE _CNV_S_2_Def_bit_ub_563_CM 1 100. 0. 1. DISPLAY_IDENTIFIER B_BERATLLEK ECU_ADDRESS 0xd000cbd9 BIT_MASK 0x2 /end MEASUREMENT
/begin MEASUREMENT St_atldiag_conf "Status externe ATL Fehler Konfiguration" UWORD _CNV_R_R_Def_dez_sl_551_CM 1 100. 0. 65535. DISPLAY_IDENTIFIER ST_ATLDIAG_CONF ECU_ADDRESS 0xd000cbdc FORMAT "%5.0" /end MEASUREMENT
/begin MEASUREMENT St_atldiag_ext "Status externe ATL Fehlereingriffe 10ms" UBYTE _CNV_R_R_Def_dez_sl_551_CM 1 100. 0. 255. DISPLAY_IDENTIFIER ST_ATLDIAG_EXT ECU_ADDRESS 0xd000cbde FORMAT "%3.0" /end MEASUREMENT
/begin MEASUREMENT St_atldiag_extfi "Status externe ATL Fehlereingriffe 100ms" UBYTE _CNV_R_R_Def_dez_sl_551_CM 1 100. 0. 255. DISPLAY_IDENTIFIER ST_ATLDIAG_EXTFI ECU_ADDRESS 0xc00006ac FORMAT "%3.0" /end MEASUREMENT
/begin MEASUREMENT St_atldiag_tmp "Statuswort" UBYTE _CNV_R_R_Def_dez_sl_551_CM 1 100. 0. 255. DISPLAY_IDENTIFIER ST_ATLDIAG_TMP ECU_ADDRESS 0xd000cbda FORMAT "%3.0" /end MEASUREMENT
/begin MEASUREMENT St_atldiag_tmp.B_fi_atllekfast "Fehler Leckage" UBYTE _CNV_S_2_Def_bit_ub_563_CM 1 100. 0. 1. DISPLAY_IDENTIFIER B_FI_ATLLEKFAST ECU_ADDRESS 0xd000cbda BIT_MASK 0x1 /end MEASUREMENT
/begin MEASUREMENT St_atldiag_tmp.B_fi_pldmn "Fehler Systemdiagnose" UBYTE _CNV_S_2_Def_bit_ub_563_CM 1 100. 0. 1. DISPLAY_IDENTIFIER B_FI_PLDMN ECU_ADDRESS 0xd000cbda BIT_MASK 0x4 /end MEASUREMENT
/begin MEASUREMENT St_atldiag_tmp.B_fi_pldmx "Fehler Systemdiagnose" UBYTE _CNV_S_2_Def_bit_ub_563_CM 1 100. 0. 1. DISPLAY_IDENTIFIER B_FI_PLDMX ECU_ADDRESS 0xd000cbda BIT_MASK 0x2 /end MEASUREMENT
/begin MEASUREMENT St_atlgls "Statuswort" UBYTE _CNV_R_R_Def_dez_sl_551_CM 1 100. 0. 255. DISPLAY_IDENTIFIER ST_ATLGLS ECU_ADDRESS 0xd000cbf0 FORMAT "%3.0" /end MEASUREMENT
/begin MEASUREMENT St_atlgls.B_atlgls_pl "Gleichlaufstellung - Plausibilitätscheck aktiv" UBYTE _CNV_S_2_Def_bit_ub_563_CM 1 100. 0. 1. DISPLAY_IDENTIFIER B_ATLGLS_PL ECU_ADDRESS 0xd000cbf0 BIT_MASK 0x1 /end MEASUREMENT
/begin MEASUREMENT St_atlgls.B_fi_atlgls "Fehler Gleichlaufsteuerung" UBYTE _CNV_S_2_Def_bit_ub_563_CM 1 100. 0. 1. DISPLAY_IDENTIFIER B_FI_ATLGLS ECU_ADDRESS 0xd000cbf0 BIT_MASK 0x20 /end MEASUREMENT
/begin MEASUREMENT St_atlgls.B_wg1plmn "Wastegate 1 Min -plausibel" UBYTE _CNV_S_2_Def_bit_ub_563_CM 1 100. 0. 1. DISPLAY_IDENTIFIER B_WG1PLMN ECU_ADDRESS 0xd000cbf0 BIT_MASK 0x2 /end MEASUREMENT
/begin MEASUREMENT St_atlgls.B_wg1plmn2 "Wastegate 1 Min -plausibel" UBYTE _CNV_S_2_Def_bit_ub_563_CM 1 100. 0. 1. DISPLAY_IDENTIFIER B_WG1PLMN2 ECU_ADDRESS 0xd000cbf0 BIT_MASK 0x8 /end MEASUREMENT
/begin MEASUREMENT St_atlgls.B_wg1plmx "Wastegate 1 Max -plausibel" UBYTE _CNV_S_2_Def_bit_ub_563_CM 1 100. 0. 1. DISPLAY_IDENTIFIER B_WG1PLMX ECU_ADDRESS 0xd000cbf0 BIT_MASK 0x4 /end MEASUREMENT
/begin MEASUREMENT St_atlgls.B_wg1plmx2 "Wastegate 1 Max -plausibel" UBYTE _CNV_S_2_Def_bit_ub_563_CM 1 100. 0. 1. DISPLAY_IDENTIFIER B_WG1PLMX2 ECU_ADDRESS 0xd000cbf0 BIT_MASK 0x10 /end MEASUREMENT
/begin MEASUREMENT St_atlob "Statuswort" UBYTE _CNV_R_R_Def_dez_sl_551_CM 1 100. 0. 255. DISPLAY_IDENTIFIER ST_ATLOB ECU_ADDRESS 0xc0000694 FORMAT "%3.0" /end MEASUREMENT
/begin MEASUREMENT St_atlob.B_atlob "Overboost Betrieb" UBYTE _CNV_S_2_Def_bit_ub_563_CM 1 100. 0. 1. DISPLAY_IDENTIFIER B_ATLOB ECU_ADDRESS 0xc0000694 BIT_MASK 0x1 /end MEASUREMENT
/begin MEASUREMENT St_atlob.B_atlob_sp "Overboost Betrieb gesperrt" UBYTE _CNV_S_2_Def_bit_ub_563_CM 1 100. 0. 1. DISPLAY_IDENTIFIER B_ATLOB_SP ECU_ADDRESS 0xc0000694 BIT_MASK 0x2 /end MEASUREMENT
/begin MEASUREMENT St_atlob_intern "Statuswort" UBYTE _CNV_R_R_Def_dez_sl_551_CM 1 100. 0. 255. DISPLAY_IDENTIFIER ST_ATLOB_INTERN ECU_ADDRESS 0xc0000695 FORMAT "%3.0" /end MEASUREMENT
/begin MEASUREMENT St_atlob_intern.B_atlob_akt "Overboost aktiviert" UBYTE _CNV_S_2_Def_bit_ub_563_CM 1 100. 0. 1. DISPLAY_IDENTIFIER B_ATLOB_AKT ECU_ADDRESS 0xc0000695 BIT_MASK 0x1 /end MEASUREMENT
/begin MEASUREMENT St_atlob_intern.B_atlob_end "Ende Overboost Betrieb " UBYTE _CNV_S_2_Def_bit_ub_563_CM 1 100. 0. 1. DISPLAY_IDENTIFIER B_ATLOB_END ECU_ADDRESS 0xc0000695 BIT_MASK 0x2 /end MEASUREMENT
/begin MEASUREMENT St_atlout "Statuswort" UBYTE _CNV_R_R_Def_dez_sl_551_CM 1 100. 0. 255. DISPLAY_IDENTIFIER ST_ATLOUT ECU_ADDRESS 0xd000ca30 FORMAT "%3.0" /end MEASUREMENT
/begin MEASUREMENT St_atlout.B_wg1_auf "Wastegate 1 geoeffnet" UBYTE _CNV_S_2_Def_bit_ub_563_CM 1 100. 0. 1. DISPLAY_IDENTIFIER B_WG1_AUF ECU_ADDRESS 0xd000ca30 BIT_MASK 0x1 /end MEASUREMENT
/begin MEASUREMENT St_atlout.B_wg2_auf "Wastegate 2 geoeffnet" UBYTE _CNV_S_2_Def_bit_ub_563_CM 1 100. 0. 1. DISPLAY_IDENTIFIER B_WG2_AUF ECU_ADDRESS 0xd000ca30 BIT_MASK 0x2 /end MEASUREMENT
/begin MEASUREMENT St_atlpump "Statuswort" UBYTE _CNV_R_R_Def_dez_sl_551_CM 1 100. 0. 255. DISPLAY_IDENTIFIER ST_ATLPUMP ECU_ADDRESS 0xd000cc10 FORMAT "%3.0" /end MEASUREMENT
/begin MEASUREMENT St_atlpump.B_atlpump1 "Lader1 pumpt" UBYTE _CNV_S_2_Def_bit_ub_563_CM 1 100. 0. 1. DISPLAY_IDENTIFIER B_ATLPUMP1 ECU_ADDRESS 0xd000cc10 BIT_MASK 0x2 /end MEASUREMENT
/begin MEASUREMENT St_atlpump.B_atlpump2 "Lader 2 pumpt" UBYTE _CNV_S_2_Def_bit_ub_563_CM 1 100. 0. 1. DISPLAY_IDENTIFIER B_ATLPUMP2 ECU_ADDRESS 0xd000cc10 BIT_MASK 0x4 /end MEASUREMENT
/begin MEASUREMENT St_atlpump.B_beratlpump "Berstimmung ATL-Pumpen aktiv" UBYTE _CNV_S_2_Def_bit_ub_563_CM 1 100. 0. 1. DISPLAY_IDENTIFIER B_BERATLPUMP ECU_ADDRESS 0xd000cc10 BIT_MASK 0x1 /end MEASUREMENT
/begin MEASUREMENT St_atmnn "Statuswort ATMNN" UBYTE _CNV_R_R_Def_dez_sl_551_CM 1 100. 0. 255. DISPLAY_IDENTIFIER ST_ATMNN ECU_ADDRESS 0xc0007540 FORMAT "%3.0" /end MEASUREMENT
/begin MEASUREMENT St_atmnn.B_sa_akt "Bedingung Schubabschaltung aktiv" UBYTE _CNV_S_2_Def_bit_ub_563_CM 1 100. 0. 1. DISPLAY_IDENTIFIER B_SA_AKT ECU_ADDRESS 0xc0007540 BIT_MASK 0x1 /end MEASUREMENT
/begin MEASUREMENT St_atmphintern "Status ATMPH (intern)" UBYTE _CNV_R_R_Def_dez_sl_551_CM 1 100. 0. 255. DISPLAY_IDENTIFIER ST_ATMPHINTERN ECU_ADDRESS 0xc0007650 FORMAT "%3.0" /end MEASUREMENT
/begin MEASUREMENT St_atmphintern.B_atmphreset "Reset ATMPH" UBYTE _CNV_S_2_Def_bit_ub_563_CM 1 100. 0. 1. DISPLAY_IDENTIFIER B_ATMPHRESET ECU_ADDRESS 0xc0007650 BIT_MASK 0x1 /end MEASUREMENT
/begin MEASUREMENT St_atmphintern.B_er_lklps "verzoegerte modifizierte Bedingung Luefterklappensteuerung" UBYTE _CNV_S_2_Def_bit_ub_563_CM 1 100. 0. 1. DISPLAY_IDENTIFIER B_ER_LKLPS ECU_ADDRESS 0xc0007650 BIT_MASK 0x8 /end MEASUREMENT
/begin MEASUREMENT St_atmphintern.B_lklps_atm "modifizierte Bedingung Luefterklappensteuerung" UBYTE _CNV_S_2_Def_bit_ub_563_CM 1 100. 0. 1. DISPLAY_IDENTIFIER B_LKLPS_ATM ECU_ADDRESS 0xc0007650 BIT_MASK 0x4 /end MEASUREMENT
/begin MEASUREMENT St_atmphintern.B_motoraus "Fallende Flanke B_startende" UBYTE _CNV_S_2_Def_bit_ub_563_CM 1 100. 0. 1. DISPLAY_IDENTIFIER B_MOTORAUS ECU_ADDRESS 0xc0007650 BIT_MASK 0x2 /end MEASUREMENT
/begin MEASUREMENT St_edge_rising "Status ATMPH (intern: steigende Flanken)" UBYTE _CNV_R_R_Def_dez_sl_551_CM 1 100. 0. 255. DISPLAY_IDENTIFIER ST_EDGE_RISING ECU_ADDRESS 0xc0007651 FORMAT "%3.0" /end MEASUREMENT
/begin MEASUREMENT St_edge_rising.B_ef_sa "Fallende Flanke B_sa liegt vor" UBYTE _CNV_S_2_Def_bit_ub_563_CM 1 100. 0. 1. DISPLAY_IDENTIFIER B_EF_SA ECU_ADDRESS 0xc0007651 BIT_MASK 0x8 /end MEASUREMENT
/begin MEASUREMENT St_edge_rising.B_er_atm_reset "Steigende Flanke B_atmphreset liegt vor" UBYTE _CNV_S_2_Def_bit_ub_563_CM 1 100. 0. 1. DISPLAY_IDENTIFIER B_ER_ATM_RESET ECU_ADDRESS 0xc0007651 BIT_MASK 0x2 /end MEASUREMENT
/begin MEASUREMENT St_edge_rising.B_er_sa "Steigende Flanke B_sa liegt vor" UBYTE _CNV_S_2_Def_bit_ub_563_CM 1 100. 0. 1. DISPLAY_IDENTIFIER B_ER_SA ECU_ADDRESS 0xc0007651 BIT_MASK 0x4 /end MEASUREMENT
/begin MEASUREMENT St_edge_rising.B_er_startende "Steigende Flanke B_startende liegt vor" UBYTE _CNV_S_2_Def_bit_ub_563_CM 1 100. 0. 1. DISPLAY_IDENTIFIER B_ER_STARTENDE ECU_ADDRESS 0xc0007651 BIT_MASK 0x1 /end MEASUREMENT
/begin MEASUREMENT St_edge_rising.B_sa_atmph "Verzoegertes Signal B_sa (nur Ausschaltverzoegerung)" UBYTE _CNV_S_2_Def_bit_ub_563_CM 1 100. 0. 1. DISPLAY_IDENTIFIER B_SA_ATMPH ECU_ADDRESS 0xc0007651 BIT_MASK 0x10 /end MEASUREMENT
/begin MEASUREMENT St_reg_bs1 "Statuswert Bauteilschutzregler Bank 1" UBYTE _CNV_R_R_Def_dez_sl_551_CM 1 100. 0. 255. DISPLAY_IDENTIFIER ST_REG_BS1 ECU_ADDRESS 0xc00074a1 FORMAT "%3.0" /end MEASUREMENT
/begin MEASUREMENT St_reg_bs2 "Statuswert Bauteilschutzregler Bank 2" UBYTE _CNV_R_R_Def_dez_sl_551_CM 1 100. 0. 255. DISPLAY_IDENTIFIER ST_REG_BS2 ECU_ADDRESS 0xc00074a2 FORMAT "%3.0" /end MEASUREMENT
/begin MEASUREMENT St_reg_bs3 "Statuswert Bauteilschutzregler fuer NOx-Kat Bank 1" UBYTE _CNV_R_R_Def_dez_sl_551_CM 1 100. 0. 255. DISPLAY_IDENTIFIER ST_REG_BS3 ECU_ADDRESS 0xc00074a3 FORMAT "%3.0" /end MEASUREMENT
/begin MEASUREMENT St_reg_bs4 "Statuswert Bauteilschutzregler fuer NOx-Kat Bank 2" UBYTE _CNV_R_R_Def_dez_sl_551_CM 1 100. 0. 255. DISPLAY_IDENTIFIER ST_REG_BS4 ECU_ADDRESS 0xc00074a4 FORMAT "%3.0" /end MEASUREMENT
/begin MEASUREMENT St_sa_atmph "Statusbyte Ausgang Schubabschaltung von ATMPH" UBYTE _CNV_R_R_Def_dez_sl_551_CM 1 100. 0. 255. DISPLAY_IDENTIFIER ST_SA_ATMPH ECU_ADDRESS 0xc0007652 FORMAT "%3.0" /end MEASUREMENT
/begin MEASUREMENT St_sa_atmph.B_vb_sa "Schubabschalten verboten wg. niedriger KatTemp." UBYTE _CNV_S_2_Def_bit_ub_563_CM 1 100. 0. 1. DISPLAY_IDENTIFIER B_VB_SA ECU_ADDRESS 0xc0007652 BIT_MASK 0x40 /end MEASUREMENT
/begin MEASUREMENT St_sa_atmph.B_vb_sa_nk "Schubabschalten verboten wg. niedriger NoX-KatTemp." UBYTE _CNV_S_2_Def_bit_ub_563_CM 1 100. 0. 1. DISPLAY_IDENTIFIER B_VB_SA_NK ECU_ADDRESS 0xc0007652 BIT_MASK 0x80 /end MEASUREMENT
/begin MEASUREMENT St_testbs "Statusbyte Bauteilschutz Fehlerbits" UBYTE _CNV_R_R_Def_dez_sl_551_CM 1 100. 0. 255. DISPLAY_IDENTIFIER ST_TESTBS ECU_ADDRESS 0xc000748d FORMAT "%3.0" /end MEASUREMENT
/begin MEASUREMENT St_testbs.B_FI_ABGAS_TSENS "Bedingung FI_ABGAS_TSENS aktiv" UBYTE _CNV_S_2_Def_bit_ub_563_CM 1 100. 0. 1. DISPLAY_IDENTIFIER B_FI_ABGAS_TSENS ECU_ADDRESS 0xc000748d BIT_MASK 0x80 /end MEASUREMENT
/begin MEASUREMENT St_testbs.B_FI_HFM "Bedingung FI_HFM aktiv" UBYTE _CNV_S_2_Def_bit_ub_563_CM 1 100. 0. 1. DISPLAY_IDENTIFIER B_FI_HFM ECU_ADDRESS 0xc000748d BIT_MASK 0x2 /end MEASUREMENT
/begin MEASUREMENT St_testbs.B_FI_HFMPL "Bedingung FI_HFMPL aktiv" UBYTE _CNV_S_2_Def_bit_ub_563_CM 1 100. 0. 1. DISPLAY_IDENTIFIER B_FI_HFMPL ECU_ADDRESS 0xc000748d BIT_MASK 0x1 /end MEASUREMENT
/begin MEASUREMENT St_testbs.B_FI_PUS "Bedingung FI_PUS aktiv" UBYTE _CNV_S_2_Def_bit_ub_563_CM 1 100. 0. 1. DISPLAY_IDENTIFIER B_FI_PUS ECU_ADDRESS 0xc000748d BIT_MASK 0x40 /end MEASUREMENT
/begin MEASUREMENT St_testbs.B_FI_TANS "Bedingung FI_TANS aktiv" UBYTE _CNV_S_2_Def_bit_ub_563_CM 1 100. 0. 1. DISPLAY_IDENTIFIER B_FI_TANS ECU_ADDRESS 0xc000748d BIT_MASK 0x8 /end MEASUREMENT
/begin MEASUREMENT St_testbs.B_FI_TKA "Bedingung FI_TKA aktiv" UBYTE _CNV_S_2_Def_bit_ub_563_CM 1 100. 0. 1. DISPLAY_IDENTIFIER B_FI_TKA ECU_ADDRESS 0xc000748d BIT_MASK 0x10 /end MEASUREMENT
/begin MEASUREMENT St_testbs.B_FI_TMOT "Bedingung FI_TMOT aktiv" UBYTE _CNV_S_2_Def_bit_ub_563_CM 1 100. 0. 1. DISPLAY_IDENTIFIER B_FI_TMOT ECU_ADDRESS 0xc000748d BIT_MASK 0x20 /end MEASUREMENT
/begin MEASUREMENT St_testbs.B_FI_VFZ "Bedingung FI_VFZ aktiv" UBYTE _CNV_S_2_Def_bit_ub_563_CM 1 100. 0. 1. DISPLAY_IDENTIFIER B_FI_VFZ ECU_ADDRESS 0xc000748d BIT_MASK 0x4 /end MEASUREMENT
/begin MEASUREMENT St_zwbts1 "Statusbyte Bauteilschutzfunktion" UBYTE _CNV_R_R_Def_dez_sl_551_CM 1 100. 0. 255. DISPLAY_IDENTIFIER ST_ZWBTS1 ECU_ADDRESS 0xc000748c FORMAT "%3.0" /end MEASUREMENT
/begin MEASUREMENT St_zwbts1.B_bs1 "Bedingung Bauteilschutz Bank 1 aktiv" UBYTE _CNV_S_2_Def_bit_ub_563_CM 1 100. 0. 1. DISPLAY_IDENTIFIER B_BS1 ECU_ADDRESS 0xc000748c BIT_MASK 0x1 /end MEASUREMENT
/begin MEASUREMENT St_zwbts1.B_bs2 "Bedingung Bauteilschutz Bank 2 aktiv" UBYTE _CNV_S_2_Def_bit_ub_563_CM 1 100. 0. 1. DISPLAY_IDENTIFIER B_BS2 ECU_ADDRESS 0xc000748c BIT_MASK 0x2 /end MEASUREMENT
/begin MEASUREMENT St_zwbts1.B_bsmager "Magerer Bauteilschutzmodus aktiv" UBYTE _CNV_S_2_Def_bit_ub_563_CM 1 100. 0. 1. DISPLAY_IDENTIFIER B_BSMAGER ECU_ADDRESS 0xc000748c BIT_MASK 0x4 /end MEASUREMENT
/begin MEASUREMENT St_zwbts1.B_lklpsaga "Luftklappe Auf Bauteilschutz" UBYTE _CNV_S_2_Def_bit_ub_563_CM 1 100. 0. 1. DISPLAY_IDENTIFIER B_LKLPSAGA ECU_ADDRESS 0xc000748c BIT_MASK 0x20 /end MEASUREMENT
/begin MEASUREMENT St_zwbts1.B_lklpsbs "Luftklappe Auf AGA" UBYTE _CNV_S_2_Def_bit_ub_563_CM 1 100. 0. 1. DISPLAY_IDENTIFIER B_LKLPSBS ECU_ADDRESS 0xc000748c BIT_MASK 0x10 /end MEASUREMENT
/begin MEASUREMENT St_zwbts1.B_lklpsmager "Luftklappe Auf Schichtbereich" UBYTE _CNV_S_2_Def_bit_ub_563_CM 1 100. 0. 1. DISPLAY_IDENTIFIER B_LKLPSMAGER ECU_ADDRESS 0xc000748c BIT_MASK 0x8 /end MEASUREMENT
/begin MEASUREMENT St_zwbtsakt "Statusbyte Bauteilschutzfunktion" UBYTE _CNV_R_R_Def_dez_sl_551_CM 1 100. 0. 255. DISPLAY_IDENTIFIER ST_ZWBTSAKT ECU_ADDRESS 0xc00074a0 FORMAT "%3.0" /end MEASUREMENT
/begin MEASUREMENT St_zwbtsakt.B_bsakt1 "Bedingung Bauteilschutz Bank 1 aktiv" UBYTE _CNV_S_2_Def_bit_ub_563_CM 1 100. 0. 1. DISPLAY_IDENTIFIER B_BSAKT1 ECU_ADDRESS 0xc00074a0 BIT_MASK 0x1 /end MEASUREMENT
/begin MEASUREMENT St_zwbtsakt.B_bsakt2 "Bedingung Bauteilschutz Bank 2 aktiv" UBYTE _CNV_S_2_Def_bit_ub_563_CM 1 100. 0. 1. DISPLAY_IDENTIFIER B_BSAKT2 ECU_ADDRESS 0xc00074a0 BIT_MASK 0x2 /end MEASUREMENT
/begin MEASUREMENT St_zwbtsakt.B_bsakt3 "Bedingung Bauteilschutz Bank 2 aktiv" UBYTE _CNV_S_2_Def_bit_ub_563_CM 1 100. 0. 1. DISPLAY_IDENTIFIER B_BSAKT3 ECU_ADDRESS 0xc00074a0 BIT_MASK 0x4 /end MEASUREMENT
/begin MEASUREMENT St_zwbtsakt.B_bsakt4 "Bedingung Bauteilschutz Bank 2 aktiv" UBYTE _CNV_S_2_Def_bit_ub_563_CM 1 100. 0. 1. DISPLAY_IDENTIFIER B_BSAKT4 ECU_ADDRESS 0xc00074a0 BIT_MASK 0x8 /end MEASUREMENT
/begin MEASUREMENT T_ikat1 "Temperatur im Kat Bank 1 dynamisch" SWORD _CNV_R_R_Def_t_sw_q_578_CM 1 100. -3276.8 3276.7 DISPLAY_IDENTIFIER T_IKAT1 ECU_ADDRESS 0xc000766c FORMAT "%6.1" /end MEASUREMENT
/begin MEASUREMENT T_ikat1_stat "Temperatur im Kat Bank 1 stationaer" SWORD _CNV_R_R_Def_t_sw_q_578_CM 1 100. -3276.8 3276.7 DISPLAY_IDENTIFIER T_IKAT1_STAT ECU_ADDRESS 0xc0007670 FORMAT "%6.1" /end MEASUREMENT
/begin MEASUREMENT T_ikat2 "Temperatur im Kat Bank 2 dynamisch" SWORD _CNV_R_R_Def_t_sw_q_578_CM 1 100. -3276.8 3276.7 DISPLAY_IDENTIFIER T_IKAT2 ECU_ADDRESS 0xc000766e FORMAT "%6.1" /end MEASUREMENT
/begin MEASUREMENT T_ikat2_stat "Temperatur im Kat Bank 2 stationaer" SWORD _CNV_R_R_Def_t_sw_q_578_CM 1 100. -3276.8 3276.7 DISPLAY_IDENTIFIER T_IKAT2_STAT ECU_ADDRESS 0xc0007672 FORMAT "%6.1" /end MEASUREMENT
/begin MEASUREMENT Tabg_agr "Abgastemperatur nach Rohr 11a (AGR-Ventil)" SWORD _CNV_R_R_Def_t_sw_q_578_CM 1 100. -3276.8 3276.7 DISPLAY_IDENTIFIER TABG_AGR ECU_ADDRESS 0xc0007726 FORMAT "%6.1" /end MEASUREMENT
/begin MEASUREMENT Tabg_aktdeakt_nokatl1 "die fuer die Aktivierung des BS herangezogene Abgastemp. vor NoxKat oder vor ATL Bank1" SWORD _CNV_R_R_Def_t_sw_q_578_CM 1 100. -3276.8 3276.7 DISPLAY_IDENTIFIER TABG_AKTDEAKT_NOKATL1 ECU_ADDRESS 0xc0007494 FORMAT "%6.1" /end MEASUREMENT
/begin MEASUREMENT Tabg_aktdeakt_nokatl2 "die fuer die Aktivierung des BS herangezogene Abgastemp. vor NoxKat oder vor ATL Bank2" SWORD _CNV_R_R_Def_t_sw_q_578_CM 1 100. -3276.8 3276.7 DISPLAY_IDENTIFIER TABG_AKTDEAKT_NOKATL2 ECU_ADDRESS 0xc0007496 FORMAT "%6.1" /end MEASUREMENT
/begin MEASUREMENT Tabg_aktdeakt_vk1 "die fuer die Aktivierung des BS herangezogene Abgastemperatur vor Kat Bank1" SWORD _CNV_R_R_Def_t_sw_q_578_CM 1 100. -3276.8 3276.7 DISPLAY_IDENTIFIER TABG_AKTDEAKT_VK1 ECU_ADDRESS 0xc0007490 FORMAT "%6.1" /end MEASUREMENT
/begin MEASUREMENT Tabg_aktdeakt_vk2 "die fuer die Aktivierung des BS herangezogene Abgastemperatur vor Kat Bank2" SWORD _CNV_R_R_Def_t_sw_q_578_CM 1 100. -3276.8 3276.7 DISPLAY_IDENTIFIER TABG_AKTDEAKT_VK2 ECU_ADDRESS 0xc0007492 FORMAT "%6.1" /end MEASUREMENT
/begin MEASUREMENT Tabg_anok1 "Abgastemperatur vor NoX-Kat Bank 1" SWORD _CNV_R_R_Def_t_sw_q_578_CM 1 100. -3276.8 3276.7 DISPLAY_IDENTIFIER TABG_ANOK1 ECU_ADDRESS 0xc000778e FORMAT "%6.1" /end MEASUREMENT
/begin MEASUREMENT Tabg_anok2 "Abgastemperatur vor NoX-Kat Bank 2" SWORD _CNV_R_R_Def_t_sw_q_578_CM 1 100. -3276.8 3276.7 DISPLAY_IDENTIFIER TABG_ANOK2 ECU_ADDRESS 0xc0007790 FORMAT "%6.1" /end MEASUREMENT
/begin MEASUREMENT Tabg_atf1 "Abgastemperaturfuehler Bank 1" SWORD _CNV_R_R_Def_t_sw_q_578_CM 1 100. -3276.8 3276.7 DISPLAY_IDENTIFIER TABG_ATF1 ECU_ADDRESS 0xc000773c FORMAT "%6.1" /end MEASUREMENT
/begin MEASUREMENT Tabg_atf2 "Abgastemperaturfuehler Bank 2" SWORD _CNV_R_R_Def_t_sw_q_578_CM 1 100. -3276.8 3276.7 DISPLAY_IDENTIFIER TABG_ATF2 ECU_ADDRESS 0xc000773e FORMAT "%6.1" /end MEASUREMENT
/begin MEASUREMENT Tabg_bank1 "Abgastemperatur Bank 1 aus KNN fuer N54" SWORD _CNV_R_R_Def_t_sw_q_578_CM 1 100. -3276.8 3276.7 DISPLAY_IDENTIFIER TABG_BANK1 ECU_ADDRESS 0xc000768a FORMAT "%6.1" /end MEASUREMENT
/begin MEASUREMENT Tabg_bank2 "Abgastemperatur Bank 2 aus KNN fuer N54" SWORD _CNV_R_R_Def_t_sw_q_578_CM 1 100. -3276.8 3276.7 DISPLAY_IDENTIFIER TABG_BANK2 ECU_ADDRESS 0xc000768c FORMAT "%6.1" /end MEASUREMENT
/begin MEASUREMENT Tabg_demax1 "Maximale Temperatur fuer Desulfatisierung Bank 1" SWORD _CNV_R_R_Def_t_sw_q_578_CM 1 100. -3276.8 3276.7 DISPLAY_IDENTIFIER TABG_DEMAX1 ECU_ADDRESS 0xc0007684 FORMAT "%6.1" /end MEASUREMENT
/begin MEASUREMENT Tabg_demax2 "Maximale Temperatur fuer Desulfatisierung Bank 2" SWORD _CNV_R_R_Def_t_sw_q_578_CM 1 100. -3276.8 3276.7 DISPLAY_IDENTIFIER TABG_DEMAX2 ECU_ADDRESS 0xc0007686 FORMAT "%6.1" /end MEASUREMENT
/begin MEASUREMENT Tabg_demaxav "Mittlere Maximale Temperatur fuer Desulfatisierung" SWORD _CNV_R_R_Def_t_sw_q_578_CM 1 100. -3276.8 3276.7 DISPLAY_IDENTIFIER TABG_DEMAXAV ECU_ADDRESS 0xc0007688 FORMAT "%6.1" /end MEASUREMENT
/begin MEASUREMENT Tabg_desul "max. Abgas-Temperatur im Unterbodenkat fuer Desulfatisierung" SWORD _CNV_R_R_Def_t_sw_q_578_CM 1 100. -3276.8 3276.7 DISPLAY_IDENTIFIER TABG_DESUL ECU_ADDRESS 0xc000770a FORMAT "%6.1" /end MEASUREMENT
/begin MEASUREMENT Tabg_desul1 "max. Temperatur im Unterbodenkat fuer Desulfatisierung Bank1" SWORD _CNV_R_R_Def_t_sw_q_578_CM 1 100. -3276.8 3276.7 DISPLAY_IDENTIFIER TABG_DESUL1 ECU_ADDRESS 0xc000770c FORMAT "%6.1" /end MEASUREMENT
/begin MEASUREMENT Tabg_desul2 "max. Temperatur im Unterbodenkat fuer Desulfatisierung Bank2" SWORD _CNV_R_R_Def_t_sw_q_578_CM 1 100. -3276.8 3276.7 DISPLAY_IDENTIFIER TABG_DESUL2 ECU_ADDRESS 0xc000770e FORMAT "%6.1" /end MEASUREMENT
/begin MEASUREMENT Tabg_filt "Gefilterte zylinderindividuelle Abgastemperatur aus Neuronalem Netz" SWORD _CNV_R_R_Def_t_sw_q_578_CM 1 100. -3276.8 3276.7 DISPLAY_IDENTIFIER TABG_FILT ECU_ADDRESS 0xc0007554 FORMAT "%6.1" ARRAY_SIZE 8 MATRIX_DIM 8 1 1 /end MEASUREMENT
/begin MEASUREMENT Tabg_fth "Abgastemperaturen am Kruemmereintritt" SWORD _CNV_R_R_Def_t_sw_q_578_CM 1 100. -3276.8 3276.7 DISPLAY_IDENTIFIER TABG_FTH ECU_ADDRESS 0xc00076b4 FORMAT "%6.1" ARRAY_SIZE 8 MATRIX_DIM 8 1 1 /end MEASUREMENT
/begin MEASUREMENT Tabg_ikat_av "Mittlere Temperatur im Kat" SWORD _CNV_R_R_Def_t_sw_q_578_CM 1 100. -3276.8 3276.7 DISPLAY_IDENTIFIER TABG_IKAT_AV ECU_ADDRESS 0xc0007674 FORMAT "%6.1" /end MEASUREMENT
/begin MEASUREMENT Tabg_inok1 "Abgastemperatur im NoX-Kat Bank 1" SWORD _CNV_R_R_Def_t_sw_q_578_CM 1 100. -3276.8 3276.7 DISPLAY_IDENTIFIER TABG_INOK1 ECU_ADDRESS 0xc00076ea FORMAT "%6.1" /end MEASUREMENT
/begin MEASUREMENT Tabg_inok2 "Abgastemperatur im NoX-Kat Bank 2" SWORD _CNV_R_R_Def_t_sw_q_578_CM 1 100. -3276.8 3276.7 DISPLAY_IDENTIFIER TABG_INOK2 ECU_ADDRESS 0xc00076ee FORMAT "%6.1" /end MEASUREMENT
/begin MEASUREMENT Tabg_izus "Abgastemperatur nach Zusammenfuehrung NoX-Kat" SWORD _CNV_R_R_Def_t_sw_q_578_CM 1 100. -3276.8 3276.7 DISPLAY_IDENTIFIER TABG_IZUS ECU_ADDRESS 0xc0007788 FORMAT "%6.1" /end MEASUREMENT
/begin MEASUREMENT Tabg_m1 "Mischabgastemperatur Bank 1" SWORD _CNV_R_R_Def_t_sw_q_578_CM 1 100. -3276.8 3276.7 DISPLAY_IDENTIFIER TABG_M1 ECU_ADDRESS 0xc0007706 FORMAT "%6.1" /end MEASUREMENT
/begin MEASUREMENT Tabg_m2 "Mischabgastemperatur Bank 2" SWORD _CNV_R_R_Def_t_sw_q_578_CM 1 100. -3276.8 3276.7 DISPLAY_IDENTIFIER TABG_M2 ECU_ADDRESS 0xc0007708 FORMAT "%6.1" /end MEASUREMENT
/begin MEASUREMENT Tabg_natl1 "Abgastemperatur Bank 1 Nach Turbolader N54" SWORD _CNV_R_R_Def_t_sw_q_578_CM 1 100. -3276.8 3276.7 DISPLAY_IDENTIFIER TABG_NATL1 ECU_ADDRESS 0xc0007654 FORMAT "%6.1" /end MEASUREMENT
/begin MEASUREMENT Tabg_natl1_fil "Abgastemperatur Bank 1 Nach Turbolader N54 gefiltert" SWORD _CNV_R_R_Def_t_sw_q_578_CM 1 100. -3276.8 3276.7 DISPLAY_IDENTIFIER TABG_NATL1_FIL ECU_ADDRESS 0xc0007658 FORMAT "%6.1" /end MEASUREMENT
/begin MEASUREMENT Tabg_natl2 "Abgastemperatur Bank 2 Nach Turbolader N54" SWORD _CNV_R_R_Def_t_sw_q_578_CM 1 100. -3276.8 3276.7 DISPLAY_IDENTIFIER TABG_NATL2 ECU_ADDRESS 0xc0007656 FORMAT "%6.1" /end MEASUREMENT
/begin MEASUREMENT Tabg_natl2_fil "Abgastemperatur Bank 2 Nach Turbolader N54 gefiltert" SWORD _CNV_R_R_Def_t_sw_q_578_CM 1 100. -3276.8 3276.7 DISPLAY_IDENTIFIER TABG_NATL2_FIL ECU_ADDRESS 0xc000765a FORMAT "%6.1" /end MEASUREMENT
/begin MEASUREMENT Tabg_nk1 "Abgastemperatur nach Kat Bank 1" SWORD _CNV_R_R_Def_t_sw_q_578_CM 1 100. -3276.8 3276.7 DISPLAY_IDENTIFIER TABG_NK1 ECU_ADDRESS 0xc000767e FORMAT "%6.1" /end MEASUREMENT
/begin MEASUREMENT Tabg_nk2 "Abgastemperatur nach Kat Bank 2" SWORD _CNV_R_R_Def_t_sw_q_578_CM 1 100. -3276.8 3276.7 DISPLAY_IDENTIFIER TABG_NK2 ECU_ADDRESS 0xc0007680 FORMAT "%6.1" /end MEASUREMENT
/begin MEASUREMENT Tabg_nk3 "Abgastemperatur nach Hauptkat" SWORD _CNV_R_R_Def_t_sw_q_578_CM 1 100. -3276.8 3276.7 DISPLAY_IDENTIFIER TABG_NK3 ECU_ADDRESS 0xc00076e2 FORMAT "%6.1" /end MEASUREMENT
/begin MEASUREMENT Tabg_nk3st "Abgastemperatur nach Kat 3 im Start" SWORD _CNV_R_R_Def_t_sw_q_578_CM 1 100. -3276.8 3276.7 DISPLAY_IDENTIFIER TABG_NK3ST ECU_ADDRESS 0xc00076e0 FORMAT "%6.1" /end MEASUREMENT
/begin MEASUREMENT Tabg_nk_av "Mittlere Abgastemperatur nach Kat" SWORD _CNV_R_R_Def_t_sw_q_578_CM 1 100. -3276.8 3276.7 DISPLAY_IDENTIFIER TABG_NK_AV ECU_ADDRESS 0xc0007682 FORMAT "%6.1" /end MEASUREMENT
/begin MEASUREMENT Tabg_nkab "Abgastemperatur nach Kat, NV" SWORD _CNV_R_R_Def_t_sw_q_578_CM 1 100. -3276.8 3276.7 DISPLAY_IDENTIFIER TABG_NKAB ECU_ADDRESS 0xc0004098 FORMAT "%6.1" /end MEASUREMENT
/begin MEASUREMENT Tabg_nks1 "Gefilterte Abgastemperatur nach Rohr 9 (nach Kat1) " SWORD _CNV_R_R_Def_t_sw_q_578_CM 1 100. -3276.8 3276.7 DISPLAY_IDENTIFIER TABG_NKS1 ECU_ADDRESS 0xc0007728 FORMAT "%6.1" /end MEASUREMENT
/begin MEASUREMENT Tabg_nks2 "Gefilterte Abgastemperatur nach Rohr 10 (nach Kat2) " SWORD _CNV_R_R_Def_t_sw_q_578_CM 1 100. -3276.8 3276.7 DISPLAY_IDENTIFIER TABG_NKS2 ECU_ADDRESS 0xc000772a FORMAT "%6.1" /end MEASUREMENT
/begin MEASUREMENT Tabg_nkst "Abgastemperatur nach Kat im Start" SWORD _CNV_R_R_Def_t_sw_q_578_CM 1 100. -3276.8 3276.7 DISPLAY_IDENTIFIER TABG_NKST ECU_ADDRESS 0xc00076a2 FORMAT "%6.1" /end MEASUREMENT
/begin MEASUREMENT Tabg_nnarr "Zylinderindividuelle Abgastemperatur aus Neuronalem Netz" SWORD _CNV_R_R_Def_t_sw_q_578_CM 1 100. -3276.8 3276.7 DISPLAY_IDENTIFIER TABG_NNARR ECU_ADDRESS 0xc0007544 FORMAT "%6.1" ARRAY_SIZE 8 MATRIX_DIM 8 1 1 /end MEASUREMENT
/begin MEASUREMENT Tabg_nnarrh "Abgastemperaturen mit Enthalpiekorrektur" SWORD _CNV_R_R_Def_t_sw_q_578_CM 1 100. -3276.8 3276.7 DISPLAY_IDENTIFIER TABG_NNARRH ECU_ADDRESS 0xc00076a4 FORMAT "%6.1" ARRAY_SIZE 8 MATRIX_DIM 8 1 1 /end MEASUREMENT
/begin MEASUREMENT Tabg_nnok1 "Abgastemperatur nach NoX-Kat Bank 1" SWORD _CNV_R_R_Def_t_sw_q_578_CM 1 100. -3276.8 3276.7 DISPLAY_IDENTIFIER TABG_NNOK1 ECU_ADDRESS 0xc0007710 FORMAT "%6.1" /end MEASUREMENT
/begin MEASUREMENT Tabg_nnok2 "Abgastemperatur nach NoX-Kat Bank 2" SWORD _CNV_R_R_Def_t_sw_q_578_CM 1 100. -3276.8 3276.7 DISPLAY_IDENTIFIER TABG_NNOK2 ECU_ADDRESS 0xc0007712 FORMAT "%6.1" /end MEASUREMENT
/begin MEASUREMENT Tabg_nok_av "Durchschnittliche Abgastemperatur NoX-Kat" SWORD _CNV_R_R_Def_t_sw_q_578_CM 1 100. -3276.8 3276.7 DISPLAY_IDENTIFIER TABG_NOK_AV ECU_ADDRESS 0xc0007714 FORMAT "%6.1" /end MEASUREMENT
/begin MEASUREMENT Tabg_nok_av1 "Durchschnittliche Abgastemperatur NoX-Kat, Bank 1" SWORD _CNV_R_R_Def_t_sw_q_578_CM 1 100. -3276.8 3276.7 DISPLAY_IDENTIFIER TABG_NOK_AV1 ECU_ADDRESS 0xc0007716 FORMAT "%6.1" /end MEASUREMENT
/begin MEASUREMENT Tabg_nok_av2 "Durchschnittliche Abgastemperatur NoX-Kat, Bank 2" SWORD _CNV_R_R_Def_t_sw_q_578_CM 1 100. -3276.8 3276.7 DISPLAY_IDENTIFIER TABG_NOK_AV2 ECU_ADDRESS 0xc0007718 FORMAT "%6.1" /end MEASUREMENT
/begin MEASUREMENT Tabg_nokab1 "Abgastemperatur NoxKat Bank 1" SWORD _CNV_R_R_Def_t_sw_q_578_CM 1 100. -3276.8 3276.7 DISPLAY_IDENTIFIER TABG_NOKAB1 ECU_ADDRESS 0xc00040aa FORMAT "%6.1" /end MEASUREMENT
/begin MEASUREMENT Tabg_nokab2 "Abgastemperatur NoxKat Bank 2" SWORD _CNV_R_R_Def_t_sw_q_578_CM 1 100. -3276.8 3276.7 DISPLAY_IDENTIFIER TABG_NOKAB2 ECU_ADDRESS 0xc00040ac FORMAT "%6.1" /end MEASUREMENT
/begin MEASUREMENT Tabg_nokmax "Maximale Abgastemperatur NoX-Kat" SWORD _CNV_R_R_Def_t_sw_q_578_CM 1 100. -3276.8 3276.7 DISPLAY_IDENTIFIER TABG_NOKMAX ECU_ADDRESS 0xc0007720 FORMAT "%6.1" /end MEASUREMENT
/begin MEASUREMENT Tabg_nokmax1 "Maximale Abgastemperatur NoX-Kat, Bank 1" SWORD _CNV_R_R_Def_t_sw_q_578_CM 1 100. -3276.8 3276.7 DISPLAY_IDENTIFIER TABG_NOKMAX1 ECU_ADDRESS 0xc0007722 FORMAT "%6.1" /end MEASUREMENT
/begin MEASUREMENT Tabg_nokmax2 "Maximale Abgastemperatur NoX-Kat, Bank 2" SWORD _CNV_R_R_Def_t_sw_q_578_CM 1 100. -3276.8 3276.7 DISPLAY_IDENTIFIER TABG_NOKMAX2 ECU_ADDRESS 0xc0007724 FORMAT "%6.1" /end MEASUREMENT
/begin MEASUREMENT Tabg_nokmin "Minimale Abgastemperatur NoX-Kat" SWORD _CNV_R_R_Def_t_sw_q_578_CM 1 100. -3276.8 3276.7 DISPLAY_IDENTIFIER TABG_NOKMIN ECU_ADDRESS 0xc000771a FORMAT "%6.1" /end MEASUREMENT
/begin MEASUREMENT Tabg_nokmin1 "Minimale Abgastemperatur NoX-Kat Bank 1" SWORD _CNV_R_R_Def_t_sw_q_578_CM 1 100. -3276.8 3276.7 DISPLAY_IDENTIFIER TABG_NOKMIN1 ECU_ADDRESS 0xc000771c FORMAT "%6.1" /end MEASUREMENT
/begin MEASUREMENT Tabg_nokmin2 "Minimale Abgastemperatur NoX-Kat Bank 2" SWORD _CNV_R_R_Def_t_sw_q_578_CM 1 100. -3276.8 3276.7 DISPLAY_IDENTIFIER TABG_NOKMIN2 ECU_ADDRESS 0xc000771e FORMAT "%6.1" /end MEASUREMENT
/begin MEASUREMENT Tabg_nokst1 "Start-Abgastemperatur nach NoX-Kat Bank 1" SWORD _CNV_R_R_Def_t_sw_q_578_CM 1 100. -3276.8 3276.7 DISPLAY_IDENTIFIER TABG_NOKST1 ECU_ADDRESS 0xc00076e8 FORMAT "%6.1" /end MEASUREMENT
/begin MEASUREMENT Tabg_nokst2 "Start-Abgastemperatur nach NoX-Kat Bank 2" SWORD _CNV_R_R_Def_t_sw_q_578_CM 1 100. -3276.8 3276.7 DISPLAY_IDENTIFIER TABG_NOKST2 ECU_ADDRESS 0xc00076ec FORMAT "%6.1" /end MEASUREMENT
/begin MEASUREMENT Tabg_nzus "Abgastemperatur nach Zusammenfuehrung" SWORD _CNV_R_R_Def_t_sw_q_578_CM 1 100. -3276.8 3276.7 DISPLAY_IDENTIFIER TABG_NZUS ECU_ADDRESS 0xc000779e FORMAT "%6.1" /end MEASUREMENT
/begin MEASUREMENT Tabg_r1 "Abgastemperatur nach Rohr 1" SWORD _CNV_R_R_Def_t_sw_q_578_CM 1 100. -3276.8 3276.7 DISPLAY_IDENTIFIER TABG_R1 ECU_ADDRESS 0xc0007696 FORMAT "%6.1" /end MEASUREMENT
/begin MEASUREMENT Tabg_r10 "Abgastemperatur nach Rohr 10" SWORD _CNV_R_R_Def_t_sw_q_578_CM 1 100. -3276.8 3276.7 DISPLAY_IDENTIFIER TABG_R10 ECU_ADDRESS 0xc000765e FORMAT "%6.1" /end MEASUREMENT
/begin MEASUREMENT Tabg_r11 "Abgastemperatur nach Rohr 11" SWORD _CNV_R_R_Def_t_sw_q_578_CM 1 100. -3276.8 3276.7 DISPLAY_IDENTIFIER TABG_R11 ECU_ADDRESS 0xc0007792 FORMAT "%6.1" /end MEASUREMENT
/begin MEASUREMENT Tabg_r12 "Abgastemperatur nach Rohr 12" SWORD _CNV_R_R_Def_t_sw_q_578_CM 1 100. -3276.8 3276.7 DISPLAY_IDENTIFIER TABG_R12 ECU_ADDRESS 0xc0007794 FORMAT "%6.1" /end MEASUREMENT
/begin MEASUREMENT Tabg_r13 "Abgastemperatur nach Rohr 13" SWORD _CNV_R_R_Def_t_sw_q_578_CM 1 100. -3276.8 3276.7 DISPLAY_IDENTIFIER TABG_R13 ECU_ADDRESS 0xc0007796 FORMAT "%6.1" /end MEASUREMENT
/begin MEASUREMENT Tabg_r14 "Abgastemperatur nach Rohr 14" SWORD _CNV_R_R_Def_t_sw_q_578_CM 1 100. -3276.8 3276.7 DISPLAY_IDENTIFIER TABG_R14 ECU_ADDRESS 0xc0007798 FORMAT "%6.1" /end MEASUREMENT
/begin MEASUREMENT Tabg_r15 "Abgastemperatur nach Rohr 15" SWORD _CNV_R_R_Def_t_sw_q_578_CM 1 100. -3276.8 3276.7 DISPLAY_IDENTIFIER TABG_R15 ECU_ADDRESS 0xc000779a FORMAT "%6.1" /end MEASUREMENT
/begin MEASUREMENT Tabg_r16 "Abgastemperatur nach Rohr 16" SWORD _CNV_R_R_Def_t_sw_q_578_CM 1 100. -3276.8 3276.7 DISPLAY_IDENTIFIER TABG_R16 ECU_ADDRESS 0xc000779c FORMAT "%6.1" /end MEASUREMENT
/begin MEASUREMENT Tabg_r2 "Abgastemperatur nach Rohr 2" SWORD _CNV_R_R_Def_t_sw_q_578_CM 1 100. -3276.8 3276.7 DISPLAY_IDENTIFIER TABG_R2 ECU_ADDRESS 0xc000776c FORMAT "%6.1" /end MEASUREMENT
/begin MEASUREMENT Tabg_r3 "Abgastemperatur nach Rohr 3" SWORD _CNV_R_R_Def_t_sw_q_578_CM 1 100. -3276.8 3276.7 DISPLAY_IDENTIFIER TABG_R3 ECU_ADDRESS 0xc000776e FORMAT "%6.1" /end MEASUREMENT
/begin MEASUREMENT Tabg_r4 "Abgastemperatur nach Rohr 4" SWORD _CNV_R_R_Def_t_sw_q_578_CM 1 100. -3276.8 3276.7 DISPLAY_IDENTIFIER TABG_R4 ECU_ADDRESS 0xc0007770 FORMAT "%6.1" /end MEASUREMENT
/begin MEASUREMENT Tabg_r5 "Abgastemperatur nach Rohr 5" SWORD _CNV_R_R_Def_t_sw_q_578_CM 1 100. -3276.8 3276.7 DISPLAY_IDENTIFIER TABG_R5 ECU_ADDRESS 0xc0007698 FORMAT "%6.1" /end MEASUREMENT
/begin MEASUREMENT Tabg_r6 "Abgastemperatur nach Rohr 6" SWORD _CNV_R_R_Def_t_sw_q_578_CM 1 100. -3276.8 3276.7 DISPLAY_IDENTIFIER TABG_R6 ECU_ADDRESS 0xc0007772 FORMAT "%6.1" /end MEASUREMENT
/begin MEASUREMENT Tabg_r7 "Abgastemperatur nach Rohr 7" SWORD _CNV_R_R_Def_t_sw_q_578_CM 1 100. -3276.8 3276.7 DISPLAY_IDENTIFIER TABG_R7 ECU_ADDRESS 0xc000769a FORMAT "%6.1" /end MEASUREMENT
/begin MEASUREMENT Tabg_r7a "Abgastemperatur nach Rohr 7a" SWORD _CNV_R_R_Def_t_sw_q_578_CM 1 100. -3276.8 3276.7 DISPLAY_IDENTIFIER TABG_R7A ECU_ADDRESS 0xc0007774 FORMAT "%6.1" /end MEASUREMENT
/begin MEASUREMENT Tabg_r8 "Abgastemperatur nach Rohr 8" SWORD _CNV_R_R_Def_t_sw_q_578_CM 1 100. -3276.8 3276.7 DISPLAY_IDENTIFIER TABG_R8 ECU_ADDRESS 0xc000769c FORMAT "%6.1" /end MEASUREMENT
/begin MEASUREMENT Tabg_r8a "Abgastemperatur nach Rohr 8a" SWORD _CNV_R_R_Def_t_sw_q_578_CM 1 100. -3276.8 3276.7 DISPLAY_IDENTIFIER TABG_R8A ECU_ADDRESS 0xc0007776 FORMAT "%6.1" /end MEASUREMENT
/begin MEASUREMENT Tabg_r9 "Abgastemperatur nach Rohr 9" SWORD _CNV_R_R_Def_t_sw_q_578_CM 1 100. -3276.8 3276.7 DISPLAY_IDENTIFIER TABG_R9 ECU_ADDRESS 0xc0007660 FORMAT "%6.1" /end MEASUREMENT
/begin MEASUREMENT Tabg_sens_mdl1 "Abgastemperatur aus Sensormodell fuer Bank 1" SWORD _CNV_R_R_Def_t_sw_q_578_CM 1 100. -3276.8 3276.7 DISPLAY_IDENTIFIER TABG_SENS_MDL1 ECU_ADDRESS 0xc000778a FORMAT "%6.1" /end MEASUREMENT
/begin MEASUREMENT Tabg_sens_mdl2 "Abgastemperatur aus Sensormodell fuer Bank 2" SWORD _CNV_R_R_Def_t_sw_q_578_CM 1 100. -3276.8 3276.7 DISPLAY_IDENTIFIER TABG_SENS_MDL2 ECU_ADDRESS 0xc000778c FORMAT "%6.1" /end MEASUREMENT
/begin MEASUREMENT Tabg_turb1 "Abgastemperatur Bank 1 Nach Turbine N54" SWORD _CNV_R_R_Def_t_sw_q_578_CM 1 100. -3276.8 3276.7 DISPLAY_IDENTIFIER TABG_TURB1 ECU_ADDRESS 0xc0007740 FORMAT "%6.1" /end MEASUREMENT
/begin MEASUREMENT Tabg_turb2 "Abgastemperatur Bank 2 Nach Turbine N54" SWORD _CNV_R_R_Def_t_sw_q_578_CM 1 100. -3276.8 3276.7 DISPLAY_IDENTIFIER TABG_TURB2 ECU_ADDRESS 0xc0007742 FORMAT "%6.1" /end MEASUREMENT
/begin MEASUREMENT Tabg_vk1 "Abgastemperatur vor Kat Bank 1" SWORD _CNV_R_R_Def_t_sw_q_578_CM 1 100. -3276.8 3276.7 DISPLAY_IDENTIFIER TABG_VK1 ECU_ADDRESS 0xc0007662 FORMAT "%6.1" /end MEASUREMENT
/begin MEASUREMENT Tabg_vk1ab "Abgastemperatur vor Kat, Bank 1, NV" SWORD _CNV_R_R_Def_t_sw_q_578_CM 1 100. -3276.8 3276.7 DISPLAY_IDENTIFIER TABG_VK1AB ECU_ADDRESS 0xc00040a6 FORMAT "%6.1" /end MEASUREMENT
/begin MEASUREMENT Tabg_vk1st "Abgastemperatur bei Start vor Kat, Bank 1" SWORD _CNV_R_R_Def_t_sw_q_578_CM 1 100. -3276.8 3276.7 DISPLAY_IDENTIFIER TABG_VK1ST ECU_ADDRESS 0xc00076d8 FORMAT "%6.1" /end MEASUREMENT
/begin MEASUREMENT Tabg_vk2 "Abgastemperatur vor Kat Bank 2" SWORD _CNV_R_R_Def_t_sw_q_578_CM 1 100. -3276.8 3276.7 DISPLAY_IDENTIFIER TABG_VK2 ECU_ADDRESS 0xc0007664 FORMAT "%6.1" /end MEASUREMENT
/begin MEASUREMENT Tabg_vk_av "Mittlere Abgastemperatur vor Kat" SWORD _CNV_R_R_Def_t_sw_q_578_CM 1 100. -3276.8 3276.7 DISPLAY_IDENTIFIER TABG_VK_AV ECU_ADDRESS 0xc000766a FORMAT "%6.1" /end MEASUREMENT
/begin MEASUREMENT Tabg_vl1 "Abgastemperatur vor Lader Bank 1" SWORD _CNV_R_R_Def_t_sw_q_578_CM 1 100. -3276.8 3276.7 DISPLAY_IDENTIFIER TABG_VL1 ECU_ADDRESS 0xc0007666 FORMAT "%6.1" /end MEASUREMENT
/begin MEASUREMENT Tabg_vl1ab "Abgastemperatur vor ATL, Bank 1, NV" SWORD _CNV_R_R_Def_t_sw_q_578_CM 1 100. -3276.8 3276.7 DISPLAY_IDENTIFIER TABG_VL1AB ECU_ADDRESS 0xc00040a8 FORMAT "%6.1" /end MEASUREMENT
/begin MEASUREMENT Tabg_vl1st "Abgastemperatur bei Start vor Lader, Bank 1" SWORD _CNV_R_R_Def_t_sw_q_578_CM 1 100. -3276.8 3276.7 DISPLAY_IDENTIFIER TABG_VL1ST ECU_ADDRESS 0xc00076da FORMAT "%6.1" /end MEASUREMENT
/begin MEASUREMENT Tabg_vl2 "Abgastemperatur vor Lader Bank 2" SWORD _CNV_R_R_Def_t_sw_q_578_CM 1 100. -3276.8 3276.7 DISPLAY_IDENTIFIER TABG_VL2 ECU_ADDRESS 0xc0007668 FORMAT "%6.1" /end MEASUREMENT
/begin MEASUREMENT Tabg_vnok1 "Abgastemperatur vor Nox-Kat 1" SWORD _CNV_R_R_Def_t_sw_q_578_CM 1 100. -3276.8 3276.7 DISPLAY_IDENTIFIER TABG_VNOK1 ECU_ADDRESS 0xc000768e FORMAT "%6.1" /end MEASUREMENT
/begin MEASUREMENT Tabg_vnok2 "Abgastemperatur vor Nox-Kat 2" SWORD _CNV_R_R_Def_t_sw_q_578_CM 1 100. -3276.8 3276.7 DISPLAY_IDENTIFIER TABG_VNOK2 ECU_ADDRESS 0xc0007690 FORMAT "%6.1" /end MEASUREMENT
/begin MEASUREMENT Tabg_wg1 "Abgastemperatur Bank 1 nach Wastegate N54" SWORD _CNV_R_R_Def_t_sw_q_578_CM 1 100. -3276.8 3276.7 DISPLAY_IDENTIFIER TABG_WG1 ECU_ADDRESS 0xc0007744 FORMAT "%6.1" /end MEASUREMENT
/begin MEASUREMENT Tabg_wg2 "Abgastemperatur Bank 2 nach Wastegate N54" SWORD _CNV_R_R_Def_t_sw_q_578_CM 1 100. -3276.8 3276.7 DISPLAY_IDENTIFIER TABG_WG2 ECU_ADDRESS 0xc0007746 FORMAT "%6.1" /end MEASUREMENT
/begin MEASUREMENT Tans_ini "Temp. Ansaugluft waehrend Initialisierung" SWORD _CNV_R_R_Def_t_sw_q_578_CM 1 100. -3276.8 3276.7 DISPLAY_IDENTIFIER TANS_INI ECU_ADDRESS 0xc00076f0 FORMAT "%6.1" /end MEASUREMENT
/begin MEASUREMENT Tbsaus1 "Ausschaltbedingung Regler Bank 1" SWORD _CNV_R_R_Def_t_sw_q_578_CM 1 100. -3276.8 3276.7 DISPLAY_IDENTIFIER TBSAUS1 ECU_ADDRESS 0xc00074d2 FORMAT "%6.1" /end MEASUREMENT
/begin MEASUREMENT Tbsaus2 "Ausschaltbedingung Regler Bank 2" SWORD _CNV_R_R_Def_t_sw_q_578_CM 1 100. -3276.8 3276.7 DISPLAY_IDENTIFIER TBSAUS2 ECU_ADDRESS 0xc00074d8 FORMAT "%6.1" /end MEASUREMENT
/begin MEASUREMENT Tbsaus3 "Ausschaltbedingung Regler Bank 1 NOx-Kat" SWORD _CNV_R_R_Def_t_sw_q_578_CM 1 100. -3276.8 3276.7 DISPLAY_IDENTIFIER TBSAUS3 ECU_ADDRESS 0xc00074e2 FORMAT "%6.1" /end MEASUREMENT
/begin MEASUREMENT Tbsaus4 "Ausschaltbedingung Regler Bank 2 NOx-Kat" SWORD _CNV_R_R_Def_t_sw_q_578_CM 1 100. -3276.8 3276.7 DISPLAY_IDENTIFIER TBSAUS4 ECU_ADDRESS 0xc00074e8 FORMAT "%6.1" /end MEASUREMENT
/begin MEASUREMENT Tbsein1 "Einschaltbedingung Regler Bank 1" SWORD _CNV_R_R_Def_t_sw_q_578_CM 1 100. -3276.8 3276.7 DISPLAY_IDENTIFIER TBSEIN1 ECU_ADDRESS 0xc00074d0 FORMAT "%6.1" /end MEASUREMENT
/begin MEASUREMENT Tbsein2 "Einschaltbedingung Regler Bank 2" SWORD _CNV_R_R_Def_t_sw_q_578_CM 1 100. -3276.8 3276.7 DISPLAY_IDENTIFIER TBSEIN2 ECU_ADDRESS 0xc00074d6 FORMAT "%6.1" /end MEASUREMENT
/begin MEASUREMENT Tbsein3 "Einschaltbedingung Regler Bank 1 NOx-Kat" SWORD _CNV_R_R_Def_t_sw_q_578_CM 1 100. -3276.8 3276.7 DISPLAY_IDENTIFIER TBSEIN3 ECU_ADDRESS 0xc00074e0 FORMAT "%6.1" /end MEASUREMENT
/begin MEASUREMENT Tbsein4 "Einschaltbedingung Regler Bank 2 NOx-Kat" SWORD _CNV_R_R_Def_t_sw_q_578_CM 1 100. -3276.8 3276.7 DISPLAY_IDENTIFIER TBSEIN4 ECU_ADDRESS 0xc00074e6 FORMAT "%6.1" /end MEASUREMENT
/begin MEASUREMENT Tmot_wgtz "Motor-Temperatur Verzoegerung am Wastegate" SWORD _CNV_R_R_Def_t_sw_q_579_CM 1 100. -327.68 327.67 DISPLAY_IDENTIFIER TMOT_WGTZ ECU_ADDRESS 0xd000ca38 FORMAT "%7.2" /end MEASUREMENT
/begin MEASUREMENT Tmr_r1 "Motorraumtemperatur fuer Rohr 1,2,3" SWORD _CNV_R_R_Def_t_sw_q_578_CM 1 100. -3276.8 3276.7 DISPLAY_IDENTIFIER TMR_R1 ECU_ADDRESS 0xc00076c4 FORMAT "%6.1" /end MEASUREMENT
/begin MEASUREMENT Tmr_r10 "Motorraumtemperatur fuer Rohr 10" SWORD _CNV_R_R_Def_t_sw_q_578_CM 1 100. -3276.8 3276.7 DISPLAY_IDENTIFIER TMR_R10 ECU_ADDRESS 0xc00076ce FORMAT "%6.1" /end MEASUREMENT
/begin MEASUREMENT Tmr_r11 "Motorraumtemperatur fuer Rohr 11" SWORD _CNV_R_R_Def_t_sw_q_578_CM 1 100. -3276.8 3276.7 DISPLAY_IDENTIFIER TMR_R11 ECU_ADDRESS 0xc00076e4 FORMAT "%6.1" /end MEASUREMENT
/begin MEASUREMENT Tmr_r4 "Motorraumtemperatur fuer Rohr 4,5,6" SWORD _CNV_R_R_Def_t_sw_q_578_CM 1 100. -3276.8 3276.7 DISPLAY_IDENTIFIER TMR_R4 ECU_ADDRESS 0xc00076c6 FORMAT "%6.1" /end MEASUREMENT
/begin MEASUREMENT Tmr_r7 "Motorraumtemperatur fuer Rohr 7" SWORD _CNV_R_R_Def_t_sw_q_578_CM 1 100. -3276.8 3276.7 DISPLAY_IDENTIFIER TMR_R7 ECU_ADDRESS 0xc00076c8 FORMAT "%6.1" /end MEASUREMENT
/begin MEASUREMENT Tmr_r8 "Motorraumtemperatur fuer Rohr 8" SWORD _CNV_R_R_Def_t_sw_q_578_CM 1 100. -3276.8 3276.7 DISPLAY_IDENTIFIER TMR_R8 ECU_ADDRESS 0xc00076ca FORMAT "%6.1" /end MEASUREMENT
/begin MEASUREMENT Tmr_r9 "Motorraumtemperatur fuer Rohr 9" SWORD _CNV_R_R_Def_t_sw_q_578_CM 1 100. -3276.8 3276.7 DISPLAY_IDENTIFIER TMR_R9 ECU_ADDRESS 0xc00076cc FORMAT "%6.1" /end MEASUREMENT
/begin MEASUREMENT Tnnnoksoll "Sollwert Abgastemperatur fuer Abfrage KNN unkorrigiert NK-ATL" SWORD _CNV_R_R_Def_t_sw_q_578_CM 1 100. -3276.8 3276.7 DISPLAY_IDENTIFIER TNNNOKSOLL ECU_ADDRESS 0xc000749e FORMAT "%6.1" /end MEASUREMENT
/begin MEASUREMENT Tnnsoll1 "Sollwert Abgastemperatur fuer Abfrage KNN, Bank 1 VK" SWORD _CNV_R_R_Def_t_sw_q_578_CM 1 100. -3276.8 3276.7 DISPLAY_IDENTIFIER TNNSOLL1 ECU_ADDRESS 0xc000759e FORMAT "%6.1" /end MEASUREMENT
/begin MEASUREMENT Tnnsoll2 "Sollwert Abgastemperatur fuer Abfrage KNN, Bank 2 VK" SWORD _CNV_R_R_Def_t_sw_q_578_CM 1 100. -3276.8 3276.7 DISPLAY_IDENTIFIER TNNSOLL2 ECU_ADDRESS 0xc00075a0 FORMAT "%6.1" /end MEASUREMENT
/begin MEASUREMENT Tnnsoll3 "Sollwert Abgastemperatur fuer Abfrage KNN, Bank 1 NK-ATL" SWORD _CNV_R_R_Def_t_sw_q_578_CM 1 100. -3276.8 3276.7 DISPLAY_IDENTIFIER TNNSOLL3 ECU_ADDRESS 0xc00075a2 FORMAT "%6.1" /end MEASUREMENT
/begin MEASUREMENT Tnnsoll4 "Sollwert Abgastemperatur fuer Abfrage KNN, Bank 2 NK-ATL" SWORD _CNV_R_R_Def_t_sw_q_578_CM 1 100. -3276.8 3276.7 DISPLAY_IDENTIFIER TNNSOLL4 ECU_ADDRESS 0xc00075a4 FORMAT "%6.1" /end MEASUREMENT
/begin MEASUREMENT Tnnvksoll "Sollwert Abgastemperatur fuer Abfrage KNN unkorrigiert VK" SWORD _CNV_R_R_Def_t_sw_q_578_CM 1 100. -3276.8 3276.7 DISPLAY_IDENTIFIER TNNVKSOLL ECU_ADDRESS 0xc000749c FORMAT "%6.1" /end MEASUREMENT
/begin MEASUREMENT Tnoksoll1 "Sollwert Abgastemperatur Bank 1 NOx-Kat" SWORD _CNV_R_R_Def_t_sw_q_578_CM 1 100. -3276.8 3276.7 DISPLAY_IDENTIFIER TNOKSOLL1 ECU_ADDRESS 0xc00074de FORMAT "%6.1" /end MEASUREMENT
/begin MEASUREMENT Tnoksoll2 "Sollwert Abgastemperatur Bank 2 NOx-Kat" SWORD _CNV_R_R_Def_t_sw_q_578_CM 1 100. -3276.8 3276.7 DISPLAY_IDENTIFIER TNOKSOLL2 ECU_ADDRESS 0xc00074e4 FORMAT "%6.1" /end MEASUREMENT
/begin MEASUREMENT Tvksoll1 "Sollwert Abgastemperatur Bank 1" SWORD _CNV_R_R_Def_t_sw_q_578_CM 1 100. -3276.8 3276.7 DISPLAY_IDENTIFIER TVKSOLL1 ECU_ADDRESS 0xc00074ce FORMAT "%6.1" /end MEASUREMENT
/begin MEASUREMENT Tvksoll2 "Sollwert Abgastemperatur Bank 2" SWORD _CNV_R_R_Def_t_sw_q_578_CM 1 100. -3276.8 3276.7 DISPLAY_IDENTIFIER TVKSOLL2 ECU_ADDRESS 0xc00074d4 FORMAT "%6.1" /end MEASUREMENT
/begin MEASUREMENT Tvwg "Tastverhaeltnis - Wastegateansteuerung" UWORD _CNV_R_R_Def_f_uw_b_555_CM 1 100. 0. 99.9984 DISPLAY_IDENTIFIER TVWG ECU_ADDRESS 0xd000ca34 FORMAT "%8.3" /end MEASUREMENT
/begin MEASUREMENT Tvwg1_k "Tastverhaeltnis korrigiert wegen Unterdruckdose" UWORD _CNV_R_R_Def_f_uw_b_555_CM 1 100. 0. 99.9984 DISPLAY_IDENTIFIER TVWG1_K ECU_ADDRESS 0xd000ca40 FORMAT "%8.3" /end MEASUREMENT
/begin MEASUREMENT Tvwg2 "Tastverhaeltnis - Wastegateansteuerung 2" UWORD _CNV_R_R_Def_f_uw_b_555_CM 1 100. 0. 99.9984 DISPLAY_IDENTIFIER TVWG2 ECU_ADDRESS 0xd000ca36 FORMAT "%8.3" /end MEASUREMENT
/begin MEASUREMENT Tvwg2_k "Tastverhaeltnis korrigiert wegen Unterdruckdose" UWORD _CNV_R_R_Def_f_uw_b_555_CM 1 100. 0. 99.9984 DISPLAY_IDENTIFIER TVWG2_K ECU_ADDRESS 0xd000ca42 FORMAT "%8.3" /end MEASUREMENT
/begin MEASUREMENT Tvwgkort "Wastegate Totzeit wegen Temperatureinfluss" SWORD _CNV_R_R_Def_rel_sw_562_CM 1 100. -100. 99.9969 DISPLAY_IDENTIFIER TVWGKORT ECU_ADDRESS 0xd000ca3a FORMAT "%8.3" /end MEASUREMENT
/begin MEASUREMENT Tw_m1 "Mischtemperatur Rohrwand Bank 1" SWORD _CNV_R_R_Def_t_sw_q_578_CM 1 100. -3276.8 3276.7 DISPLAY_IDENTIFIER TW_M1 ECU_ADDRESS 0xc0007676 FORMAT "%6.1" /end MEASUREMENT
/begin MEASUREMENT Tw_m1ab "Mischtemperatur Rohrwand Bank 1, NV" SWORD _CNV_R_R_Def_t_sw_q_578_CM 1 100. -3276.8 3276.7 DISPLAY_IDENTIFIER TW_M1AB ECU_ADDRESS 0xc000409a FORMAT "%6.1" /end MEASUREMENT
/begin MEASUREMENT Tw_m1st "Rohrwandtemperatur bei Start Bank1" SWORD _CNV_R_R_Def_t_sw_q_578_CM 1 100. -3276.8 3276.7 DISPLAY_IDENTIFIER TW_M1ST ECU_ADDRESS 0xc00076d0 FORMAT "%6.1" /end MEASUREMENT
/begin MEASUREMENT Tw_m2 "Mischtemperatur Rohrwand Bank 2" SWORD _CNV_R_R_Def_t_sw_q_578_CM 1 100. -3276.8 3276.7 DISPLAY_IDENTIFIER TW_M2 ECU_ADDRESS 0xc0007678 FORMAT "%6.1" /end MEASUREMENT
/begin MEASUREMENT Tw_m2ab "Mischtemperatur Rohrwand Bank 2, NV" SWORD _CNV_R_R_Def_t_sw_q_578_CM 1 100. -3276.8 3276.7 DISPLAY_IDENTIFIER TW_M2AB ECU_ADDRESS 0xc000409c FORMAT "%6.1" /end MEASUREMENT
/begin MEASUREMENT Tw_m2st "Rohrwandtemperatur bei Start Bank2" SWORD _CNV_R_R_Def_t_sw_q_578_CM 1 100. -3276.8 3276.7 DISPLAY_IDENTIFIER TW_M2ST ECU_ADDRESS 0xc00076d2 FORMAT "%6.1" /end MEASUREMENT
/begin MEASUREMENT Tw_nk1 "Rohrwandtemperatur nach Kat 1" SWORD _CNV_R_R_Def_t_sw_q_578_CM 1 100. -3276.8 3276.7 DISPLAY_IDENTIFIER TW_NK1 ECU_ADDRESS 0xc000767a FORMAT "%6.1" /end MEASUREMENT
/begin MEASUREMENT Tw_nk1ab "Wandtemperatur Bank 1, NV" SWORD _CNV_R_R_Def_t_sw_q_578_CM 1 100. -3276.8 3276.7 DISPLAY_IDENTIFIER TW_NK1AB ECU_ADDRESS 0xc000409e FORMAT "%6.1" /end MEASUREMENT
/begin MEASUREMENT Tw_nk1st "Rohrwandtemperatur nach Kat bei Start Bank1" SWORD _CNV_R_R_Def_t_sw_q_578_CM 1 100. -3276.8 3276.7 DISPLAY_IDENTIFIER TW_NK1ST ECU_ADDRESS 0xc00076dc FORMAT "%6.1" /end MEASUREMENT
/begin MEASUREMENT Tw_nk2 "Rohrwandtemperatur nach Kat 2" SWORD _CNV_R_R_Def_t_sw_q_578_CM 1 100. -3276.8 3276.7 DISPLAY_IDENTIFIER TW_NK2 ECU_ADDRESS 0xc000767c FORMAT "%6.1" /end MEASUREMENT
/begin MEASUREMENT Tw_nk2ab "Wandtemperatur Bank 2, NV" SWORD _CNV_R_R_Def_t_sw_q_578_CM 1 100. -3276.8 3276.7 DISPLAY_IDENTIFIER TW_NK2AB ECU_ADDRESS 0xc00040a0 FORMAT "%6.1" /end MEASUREMENT
/begin MEASUREMENT Tw_nk2st "Rohrwandtemperatur nach Kat bei Start Bank2" SWORD _CNV_R_R_Def_t_sw_q_578_CM 1 100. -3276.8 3276.7 DISPLAY_IDENTIFIER TW_NK2ST ECU_ADDRESS 0xc00076de FORMAT "%6.1" /end MEASUREMENT
/begin MEASUREMENT Tw_r1 "Rohrwandtemperatur 1" SWORD _CNV_R_R_Def_t_sw_q_578_CM 1 100. -3276.8 3276.7 DISPLAY_IDENTIFIER TW_R1 ECU_ADDRESS 0xc000765c FORMAT "%6.1" /end MEASUREMENT
/begin MEASUREMENT Tw_r11 "Rohrwandtemperatur 11" SWORD _CNV_R_R_Def_t_sw_q_578_CM 1 100. -3276.8 3276.7 DISPLAY_IDENTIFIER TW_R11 ECU_ADDRESS 0xc00077a0 FORMAT "%6.1" /end MEASUREMENT
/begin MEASUREMENT Tw_r11a "Rohrwandtemperatur 11a (AGR)" SWORD _CNV_R_R_Def_t_sw_q_578_CM 1 100. -3276.8 3276.7 DISPLAY_IDENTIFIER TW_R11A ECU_ADDRESS 0xc00077a2 FORMAT "%6.1" /end MEASUREMENT
/begin MEASUREMENT Tw_r12 "Rohrwandtemperatur 12" SWORD _CNV_R_R_Def_t_sw_q_578_CM 1 100. -3276.8 3276.7 DISPLAY_IDENTIFIER TW_R12 ECU_ADDRESS 0xc00077a4 FORMAT "%6.1" /end MEASUREMENT
/begin MEASUREMENT Tw_r12a "Rohrwandtemperatur 12a" SWORD _CNV_R_R_Def_t_sw_q_578_CM 1 100. -3276.8 3276.7 DISPLAY_IDENTIFIER TW_R12A ECU_ADDRESS 0xc00077a6 FORMAT "%6.1" /end MEASUREMENT
/begin MEASUREMENT Tw_r13 "Rohrwandtemperatur 13" SWORD _CNV_R_R_Def_t_sw_q_578_CM 1 100. -3276.8 3276.7 DISPLAY_IDENTIFIER TW_R13 ECU_ADDRESS 0xc00077a8 FORMAT "%6.1" /end MEASUREMENT
/begin MEASUREMENT Tw_r14 "Rohrwandtemperatur 14" SWORD _CNV_R_R_Def_t_sw_q_578_CM 1 100. -3276.8 3276.7 DISPLAY_IDENTIFIER TW_R14 ECU_ADDRESS 0xc00077aa FORMAT "%6.1" /end MEASUREMENT
/begin MEASUREMENT Tw_r14a "Rohrwandtemperatur 14a" SWORD _CNV_R_R_Def_t_sw_q_578_CM 1 100. -3276.8 3276.7 DISPLAY_IDENTIFIER TW_R14A ECU_ADDRESS 0xc00077ac FORMAT "%6.1" /end MEASUREMENT
/begin MEASUREMENT Tw_r15 "Rohrwandtemperatur 15" SWORD _CNV_R_R_Def_t_sw_q_578_CM 1 100. -3276.8 3276.7 DISPLAY_IDENTIFIER TW_R15 ECU_ADDRESS 0xc00077ae FORMAT "%6.1" /end MEASUREMENT
/begin MEASUREMENT Tw_r16 "Rohrwandtemperatur 16" SWORD _CNV_R_R_Def_t_sw_q_578_CM 1 100. -3276.8 3276.7 DISPLAY_IDENTIFIER TW_R16 ECU_ADDRESS 0xc00077b0 FORMAT "%6.1" /end MEASUREMENT
/begin MEASUREMENT Tw_r1ab "Wandtemperatur Kruemmer 1, NV" SWORD _CNV_R_R_Def_t_sw_q_578_CM 1 100. -3276.8 3276.7 DISPLAY_IDENTIFIER TW_R1AB ECU_ADDRESS 0xc00040a2 FORMAT "%6.1" /end MEASUREMENT
/begin MEASUREMENT Tw_r1st "Rohrwandtemperatur bei Start Kruemmer 1" SWORD _CNV_R_R_Def_t_sw_q_578_CM 1 100. -3276.8 3276.7 DISPLAY_IDENTIFIER TW_R1ST ECU_ADDRESS 0xc00076d4 FORMAT "%6.1" /end MEASUREMENT
/begin MEASUREMENT Tw_r2 "Rohrwandtemperatur 2" SWORD _CNV_R_R_Def_t_sw_q_578_CM 1 100. -3276.8 3276.7 DISPLAY_IDENTIFIER TW_R2 ECU_ADDRESS 0xc00076f8 FORMAT "%6.1" /end MEASUREMENT
/begin MEASUREMENT Tw_r3 "Rohrwandtemperatur 3" SWORD _CNV_R_R_Def_t_sw_q_578_CM 1 100. -3276.8 3276.7 DISPLAY_IDENTIFIER TW_R3 ECU_ADDRESS 0xc00076fa FORMAT "%6.1" /end MEASUREMENT
/begin MEASUREMENT Tw_r4 "Rohrwandtemperatur 4" SWORD _CNV_R_R_Def_t_sw_q_578_CM 1 100. -3276.8 3276.7 DISPLAY_IDENTIFIER TW_R4 ECU_ADDRESS 0xc00076fc FORMAT "%6.1" /end MEASUREMENT
/begin MEASUREMENT Tw_r4ab "Wandtemperatur Kruemmer 4, NV" SWORD _CNV_R_R_Def_t_sw_q_578_CM 1 100. -3276.8 3276.7 DISPLAY_IDENTIFIER TW_R4AB ECU_ADDRESS 0xc00040a4 FORMAT "%6.1" /end MEASUREMENT
/begin MEASUREMENT Tw_r4st "Rohrwandtemperatur bei Start Kruemmer 4" SWORD _CNV_R_R_Def_t_sw_q_578_CM 1 100. -3276.8 3276.7 DISPLAY_IDENTIFIER TW_R4ST ECU_ADDRESS 0xc00076d6 FORMAT "%6.1" /end MEASUREMENT
/begin MEASUREMENT Tw_r5 "Rohrwandtemperatur 5" SWORD _CNV_R_R_Def_t_sw_q_578_CM 1 100. -3276.8 3276.7 DISPLAY_IDENTIFIER TW_R5 ECU_ADDRESS 0xc00076fe FORMAT "%6.1" /end MEASUREMENT
/begin MEASUREMENT Tw_r6 "Rohrwandtemperatur 6" SWORD _CNV_R_R_Def_t_sw_q_578_CM 1 100. -3276.8 3276.7 DISPLAY_IDENTIFIER TW_R6 ECU_ADDRESS 0xc0007700 FORMAT "%6.1" /end MEASUREMENT
/begin MEASUREMENT Tw_r7a "Rohrwandtemperatur 7a" SWORD _CNV_R_R_Def_t_sw_q_578_CM 1 100. -3276.8 3276.7 DISPLAY_IDENTIFIER TW_R7A ECU_ADDRESS 0xc0007702 FORMAT "%6.1" /end MEASUREMENT
/begin MEASUREMENT Tw_r8a "Rohrwandtemperatur 8a" SWORD _CNV_R_R_Def_t_sw_q_578_CM 1 100. -3276.8 3276.7 DISPLAY_IDENTIFIER TW_R8A ECU_ADDRESS 0xc0007704 FORMAT "%6.1" /end MEASUREMENT
/begin MEASUREMENT Tw_wg1 "Wandtemperatur Bank 1 nach Wastegate N54" SWORD _CNV_R_R_Def_t_sw_q_578_CM 1 100. -3276.8 3276.7 DISPLAY_IDENTIFIER TW_WG1 ECU_ADDRESS 0xc0007748 FORMAT "%6.1" /end MEASUREMENT
/begin MEASUREMENT Tw_wg2 "Wandtemperatur Bank 2 nach Wastegate N54" SWORD _CNV_R_R_Def_t_sw_q_578_CM 1 100. -3276.8 3276.7 DISPLAY_IDENTIFIER TW_WG2 ECU_ADDRESS 0xc000774a FORMAT "%6.1" /end MEASUREMENT
/begin MEASUREMENT V_atm_b1 "Fahrzeuggeschwindigkeit korrigiert ueber E-Luefter-PWM, Bank 1" UWORD _CNV_R_R_Def_v_uw_q_726_CM 1 100. 0. 360. DISPLAY_IDENTIFIER V_ATM_B1 ECU_ADDRESS 0xc000769e FORMAT "%5.0" /end MEASUREMENT
/begin MEASUREMENT V_atm_b2 "Fahrzeuggeschwindigkeit korrigiert ueber E-Luefter-PWM, Bank 2" UWORD _CNV_R_R_Def_v_uw_q_726_CM 1 100. 0. 360. DISPLAY_IDENTIFIER V_ATM_B2 ECU_ADDRESS 0xc00076a0 FORMAT "%5.0" /end MEASUREMENT
/begin MEASUREMENT Zkatm_exo "Zeitkonstante PT1 fuer Filter Abgastemperatur nach Kat" UWORD _CNV_R_R_Def_td_uw__740_CM 1 100. 0. 5. DISPLAY_IDENTIFIER ZKATM_EXO ECU_ADDRESS 0xc0007730 FORMAT "%14.5" /end MEASUREMENT
/begin MEASUREMENT Zkatm_exoik "Zeitkonstante PT1 fuer Filter Abgastemperatur in Kat" UWORD _CNV_R_R_Def_td_uw__740_CM 1 100. 0. 5. DISPLAY_IDENTIFIER ZKATM_EXOIK ECU_ADDRESS 0xc0007732 FORMAT "%14.5" /end MEASUREMENT
/begin MEASUREMENT Zw_mean "Ueber 200ms gemittelter Zuendwinkel zylinderindividuell" FLOAT32_IEEE _CNV_R_R_Def_dez_sl_551_CM 1 100. -1000000000000. 10000000000000. DISPLAY_IDENTIFIER ZW_MEAN ECU_ADDRESS 0xc0007574 FORMAT "%14.7" ARRAY_SIZE 8 MATRIX_DIM 8 1 1 /end MEASUREMENT
/begin AXIS_PTS GAX_ATMNN "Neuronen des ATMNN-MLP" 0xa0819768 Modelle _REC_AXS_20_u1 255. _CNV_R_R_Def_dez_sl_551_CM 15 0. 255. FORMAT "%3.0" /end AXIS_PTS
/begin CHARACTERISTIC CW_ATLADP_OFF "Codeword ATL Adaption auszuschalten" VALUE 0xa0818666 _REC_VAL_20_u2 0. _CNV_R_R_Def_dez_sl_551_CM 0. 65535. FORMAT "%5.0" /end CHARACTERISTIC
/begin CHARACTERISTIC CW_ATLDIAG_OFF "Codeword ATL Diagnose auszuschalten" VALUE 0xa0818668 _REC_VAL_20_u2 0. _CNV_R_R_Def_dez_sl_551_CM 0. 65535. FORMAT "%5.0" /end CHARACTERISTIC
/begin CHARACTERISTIC CW_ATLREG_OFF "Codeword ATL Regler auszuschalten" VALUE 0xa081866a _REC_VAL_20_u2 0. _CNV_R_R_Def_dez_sl_551_CM 0. 65535. FORMAT "%5.0" /end CHARACTERISTIC
/begin CHARACTERISTIC CW_ATMOD "Codewort Auswahl Bauteilschutz-Lambda" VALUE 0xa081943a _REC_VAL_20_u1 99.45 _CNV_R_R_Def_dez_sl_551_CM 0. 255. FORMAT "%3.0" /end CHARACTERISTIC
/begin CHARACTERISTIC CW_RFMAXRED "Codeword Rf_max zu begrenzen" VALUE 0xa081866c _REC_VAL_20_u2 0. _CNV_R_R_Def_dez_sl_551_CM 0. 65535. FORMAT "%5.0" /end CHARACTERISTIC
/begin CHARACTERISTIC KF_ATM_ATLETA "Wirkungsgrad ATL" MAP 0xa081a150 _REC_MAP_52_u1_s2_s2 0.996 _CNV_R_R_Def_f_ub_b_553_CM 0. 0.996
 /begin AXIS_DESCR STD_AXIS Nkw _CNV_R_R_Def_n_sw_q_595_CM 8 -32768. 32767. FORMAT "%5.0" /end AXIS_DESCR
 /begin AXIS_DESCR STD_AXIS Rf _CNV_R_R_Def_rf_sw__598_CM 8 -327.68 327.67 FORMAT "%7.4" /end AXIS_DESCR
/end CHARACTERISTIC
/begin CHARACTERISTIC KF_ATM_ETAZW "Temperaturkorrekturfaktor abhaengig von Zuendwinkelwirkungsgrad" MAP 0xa0819bb4 _REC_MAP_52_UBYTE_u2_s2_s2 1.9999 _CNV_R_R_Def_f_uw_b_590_CM 0. 1.9999 FORMAT "%14.5"
 /begin AXIS_DESCR STD_AXIS Nkw_atm _CNV_R_R_Def_n_sw_q_595_CM 8 -32768. 32767. FORMAT "%5.0" /end AXIS_DESCR
 /begin AXIS_DESCR STD_AXIS Rf_atm _CNV_R_R_Def_rf_sw__598_CM 8 -327.68 327.67 FORMAT "%7.4" /end AXIS_DESCR
/end CHARACTERISTIC
/begin CHARACTERISTIC KF_ATM_FAKTH "Faktor Temperaturkorrektur durch Enthalpiemittelung" MAP 0xa0819b10 _REC_MAP_52_UBYTE_u2_s2_s2 1.9999 _CNV_R_R_Def_f_uw_b_590_CM 0. 1.9999 FORMAT "%14.5"
 /begin AXIS_DESCR STD_AXIS Nkw _CNV_R_R_Def_n_sw_q_595_CM 8 -32768. 32767. FORMAT "%5.0" /end AXIS_DESCR
 /begin AXIS_DESCR STD_AXIS Rf _CNV_R_R_Def_rf_sw__598_CM 8 -327.68 327.67 FORMAT "%7.4" /end AXIS_DESCR
/end CHARACTERISTIC
/begin CHARACTERISTIC KF_ATM_FAKTS "Faktor Temperaturkorrektur durch Enthalpiemittelung im Schichtbetrieb" MAP 0xa0819c58 _REC_MAP_52_UBYTE_u2_s2_s2 1.9999 _CNV_R_R_Def_f_uw_b_590_CM 0. 1.9999 FORMAT "%14.5"
 /begin AXIS_DESCR STD_AXIS Nkw _CNV_R_R_Def_n_sw_q_595_CM 8 -32768. 32767. FORMAT "%5.0" /end AXIS_DESCR
 /begin AXIS_DESCR STD_AXIS Rk_soll _CNV_R_R_Def_rk_sw__600_CM 8 -1600. 1599.9511 /end AXIS_DESCR
/end CHARACTERISTIC
/begin CHARACTERISTIC KF_ATM_FTH1 "Faktor Temperaturkorrektur durch Enthalpiemittelung Bank 1" MAP 0xa0819e44 _REC_MAP_52_UBYTE_u2_s2_s2 1.9999 _CNV_R_R_Def_f_uw_b_590_CM 0. 1.9999 FORMAT "%14.5"
 /begin AXIS_DESCR STD_AXIS Nkw _CNV_R_R_Def_n_sw_q_595_CM 8 -32768. 32767. FORMAT "%5.0" /end AXIS_DESCR
 /begin AXIS_DESCR STD_AXIS Rf _CNV_R_R_Def_rf_sw__598_CM 8 -327.68 327.67 FORMAT "%7.4" /end AXIS_DESCR
/end CHARACTERISTIC
/begin CHARACTERISTIC KF_ATM_FTH2 "Faktor Temperaturkorrektur durch Enthalpiemittelung Bank 2" MAP 0xa0819ee8 _REC_MAP_52_UBYTE_u2_s2_s2 1.9999 _CNV_R_R_Def_f_uw_b_590_CM 0. 1.9999 FORMAT "%14.5"
 /begin AXIS_DESCR STD_AXIS Nkw _CNV_R_R_Def_n_sw_q_595_CM 8 -32768. 32767. FORMAT "%5.0" /end AXIS_DESCR
 /begin AXIS_DESCR STD_AXIS Rf _CNV_R_R_Def_rf_sw__598_CM 8 -327.68 327.67 FORMAT "%7.4" /end AXIS_DESCR
/end CHARACTERISTIC
/begin CHARACTERISTIC KF_ATM_FTS1 "Faktor Temperaturkorrektur durch Enthalpiemittelung Bank 1 fuer Schichtbetrieb" MAP 0xa0819cfc _REC_MAP_52_UBYTE_u2_s2_s2 1.9999 _CNV_R_R_Def_f_uw_b_590_CM 0. 1.9999 FORMAT "%14.5"
 /begin AXIS_DESCR STD_AXIS Nkw _CNV_R_R_Def_n_sw_q_595_CM 8 -32768. 32767. FORMAT "%5.0" /end AXIS_DESCR
 /begin AXIS_DESCR STD_AXIS Rk_soll _CNV_R_R_Def_rk_sw__600_CM 8 -1600. 1599.9511 /end AXIS_DESCR
/end CHARACTERISTIC
/begin CHARACTERISTIC KF_ATM_FTS2 "Faktor Temperaturkorrektur durch Enthalpiemittelung Bank 2 fuer Schichtbetrieb" MAP 0xa0819da0 _REC_MAP_52_UBYTE_u2_s2_s2 1.9999 _CNV_R_R_Def_f_uw_b_590_CM 0. 1.9999 FORMAT "%14.5"
 /begin AXIS_DESCR STD_AXIS Nkw _CNV_R_R_Def_n_sw_q_595_CM 8 -32768. 32767. FORMAT "%5.0" /end AXIS_DESCR
 /begin AXIS_DESCR STD_AXIS Rk_soll _CNV_R_R_Def_rk_sw__600_CM 8 -1600. 1599.9511 /end AXIS_DESCR
/end CHARACTERISTIC
/begin CHARACTERISTIC KF_BS_MX "Maximalwert fuer Begrenzung Vorsteuerlambda aus ATMNN" MAP 0xa081957c _REC_MAP_52_u1_s2_s2 0.498 _CNV_R_R_Def_f_ub_q_741_CM 1. 1.498 FORMAT "%5.2"
 /begin AXIS_DESCR STD_AXIS Nkw _CNV_R_R_Def_n_sw_q_595_CM 4 -32768. 32767. FORMAT "%5.0" /end AXIS_DESCR
 /begin AXIS_DESCR STD_AXIS Rf _CNV_R_R_Def_rf_sw__598_CM 4 -327.68 327.67 FORMAT "%7.4" /end AXIS_DESCR
/end CHARACTERISTIC
/begin CHARACTERISTIC KF_BS_VST "Vorsteuerwert fuer Lambda GDI-Motor" MAP 0xa0819698 _REC_MAP_52_UBYTE_u2_s2_s2 15.9997 _CNV_R_R_Def_f_uw_b_559_CM 0. 15.9997 FORMAT "%7.4"
 /begin AXIS_DESCR STD_AXIS Nkw _CNV_R_R_Def_n_sw_q_595_CM 8 -32768. 32767. FORMAT "%5.0" /end AXIS_DESCR
 /begin AXIS_DESCR STD_AXIS Rf _CNV_R_R_Def_rf_sw__598_CM 4 -327.68 327.67 FORMAT "%7.4" /end AXIS_DESCR
/end CHARACTERISTIC
/begin CHARACTERISTIC KF_BS_VST_MAGER "Vorsteuerwert fuer Lambda GDI-Motor MAGER" MAP 0xa08196f4 _REC_MAP_52_UBYTE_u2_s2_s2 15.9997 _CNV_R_R_Def_f_uw_b_559_CM 0. 15.9997 FORMAT "%7.4"
 /begin AXIS_DESCR STD_AXIS Nkw _CNV_R_R_Def_n_sw_q_595_CM 8 -32768. 32767. FORMAT "%5.0" /end AXIS_DESCR
 /begin AXIS_DESCR STD_AXIS Rf _CNV_R_R_Def_rf_sw__598_CM 4 -327.68 327.67 FORMAT "%7.4" /end AXIS_DESCR
/end CHARACTERISTIC
/begin CHARACTERISTIC KF_BS_VST_N54 "Bauteilschutz-Vorsteuerwert fuer N54" MAP 0xa08195a0 _REC_MAP_52_u1_s2_s2 0.498 _CNV_R_R_Def_f_ub_b_593_CM 0. 0.498
 /begin AXIS_DESCR STD_AXIS Nkw _CNV_R_R_Def_n_sw_q_595_CM 10 -32768. 32767. FORMAT "%5.0" /end AXIS_DESCR
 /begin AXIS_DESCR STD_AXIS Dzw_mm _CNV_R_R_Def_zw_sw__604_CM 8 -50. 60. FORMAT "%4.1" /end AXIS_DESCR
/end CHARACTERISTIC
/begin CHARACTERISTIC KF_DRFMXW_OB "Delta Rfmax-Offset bei Overboost" MAP 0xa0817328 _REC_MAP_52_UBYTE_s2_s2_s2 98.30250000000001 _CNV_R_R_Def_rf_sw__598_CM -327.68 327.67 FORMAT "%7.4"
 /begin AXIS_DESCR STD_AXIS Nkw _CNV_R_R_Def_n_sw_q_595_CM 6 -32768. 32767. FORMAT "%5.0" /end AXIS_DESCR
 /begin AXIS_DESCR STD_AXIS Tans _CNV_R_R_Def_t_sw_q_578_CM 6 -3276.8 3276.7 FORMAT "%4.1" /end AXIS_DESCR
/end CHARACTERISTIC
/begin CHARACTERISTIC KF_FWGZUEKOR "Wastegate Korrekturfaktor auf Zuendwinkeleingriffe" MAP 0xa0817420 _REC_MAP_52_UBYTE_u2_u2_s2 1.9999 _CNV_R_R_Def_f_uw_b_590_CM 0. 1.9999 FORMAT "%14.5" /begin AXIS_DESCR STD_AXIS Mszyl _CNV_R_R_Def_ms_uw__594_CM 12 0. 2047.9687 /end AXIS_DESCR
 /begin AXIS_DESCR STD_AXIS NO_INPUT_QUANTITY _CNV_R_R_Def_zw_sw__604_CM 12 -50. 60. FORMAT "%4.1" /end AXIS_DESCR
/end CHARACTERISTIC
/begin CHARACTERISTIC KF_TA_NOKSOLL "Solltemperatur fuer Abgastemperatur NOxKat" MAP 0xa0819618 _REC_MAP_52_UBYTE_s2_s2_s2 131.07 _CNV_R_R_Def_t_sw_q_578_CM -3276.8 3276.7 FORMAT "%4.1"
 /begin AXIS_DESCR STD_AXIS Nkw _CNV_R_R_Def_n_sw_q_595_CM 8 -32768. 32767. FORMAT "%5.0" /end AXIS_DESCR
 /begin AXIS_DESCR STD_AXIS Rf _CNV_R_R_Def_rf_sw__598_CM 6 -327.68 327.67 FORMAT "%7.4" /end AXIS_DESCR
/end CHARACTERISTIC
/begin CHARACTERISTIC KF_TA_VKSOLL "Solltemperatur fuer Abgastemperatur Mischstrecke" MAP 0xa0819548 _REC_MAP_52_UBYTE_s2_s2_s2 131.07 _CNV_R_R_Def_t_sw_q_578_CM -3276.8 3276.7 FORMAT "%4.1"
 /begin AXIS_DESCR STD_AXIS Nkw _CNV_R_R_Def_n_sw_q_595_CM 4 -32768. 32767. FORMAT "%5.0" /end AXIS_DESCR
 /begin AXIS_DESCR STD_AXIS Rf _CNV_R_R_Def_rf_sw__598_CM 4 -327.68 327.67 FORMAT "%7.4" /end AXIS_DESCR
/end CHARACTERISTIC
/begin CHARACTERISTIC KF_WG1KOR "Wastegate 1 Korrekturfaktor" MAP 0xa081874c _REC_MAP_52_UBYTE_u2_u2_u2 1.9999 _CNV_R_R_Def_f_uw_b_590_CM 0. 1.9999 FORMAT "%14.5"
 /begin AXIS_DESCR STD_AXIS F_msvld_diff _CNV_R_R_Def_f_sw_b_616_CM 8 0. 3.9999 FORMAT "%14.5" /end AXIS_DESCR
 /begin AXIS_DESCR STD_AXIS Msvld _CNV_R_R_Def_ms_uw__594_CM 8 0. 2047.9687 /end AXIS_DESCR
/end CHARACTERISTIC
/begin CHARACTERISTIC KF_WG1_ZU2 "Grund - Gleichlaufkorrektur WG1 zu WG2 wegen Bauteilposition" MAP 0xa08187f0 _REC_MAP_52_UBYTE_u2_u2_u2 1.9999 _CNV_R_R_Def_f_uw_b_590_CM 0. 1.9999 FORMAT "%14.5"
 /begin AXIS_DESCR STD_AXIS F_pldsvld_f _CNV_R_R_Def_f_sw_b_616_CM 8 0. 3.9999 FORMAT "%14.5" /end AXIS_DESCR
 /begin AXIS_DESCR STD_AXIS Mssolatl_k _CNV_R_R_Def_ms_uw__594_CM 8 0. 2047.9687 /end AXIS_DESCR
/end CHARACTERISTIC
/begin CHARACTERISTIC KL_ATLRPID_MN "Regelgroesse untere Schwelle" CURVE 0xa08186a8 _REC_CUR_TKL_UW_VV__s2_s2 99.99844999999999 _CNV_R_R_Def_rel_sw_562_CM -100. 99.9969
 /begin AXIS_DESCR STD_AXIS Pld_diff _CNV_R_R_Def_p_sw_q_680_CM 4 -2560. 2559.9218 FORMAT "%5.2" /end AXIS_DESCR
/end CHARACTERISTIC
/begin CHARACTERISTIC KL_ATLRPID_MX "Regelgroesse obere Schwelle" CURVE 0xa0818694 _REC_CUR_TKL_UW_VV__s2_s2 99.99844999999999 _CNV_R_R_Def_rel_sw_562_CM -100. 99.9969
 /begin AXIS_DESCR STD_AXIS Pld_diff _CNV_R_R_Def_p_sw_q_680_CM 4 -2560. 2559.9218 FORMAT "%5.2" /end AXIS_DESCR
/end CHARACTERISTIC
/begin CHARACTERISTIC KL_ATMSAEX "Temperaturerhoehung durch Exotherme beim Schubabschalten" CURVE 0xa081a014 _REC_CUR_TKL_UW_VV__s2_u2 131.07 _CNV_R_R_Def_t_sw_q_578_CM -3276.8 3276.7 FORMAT "%4.1" /begin AXIS_DESCR STD_AXIS Mszyl _CNV_R_R_Def_ms_uw__594_CM 4 0. 2047.9687 /end AXIS_DESCR /end CHARACTERISTIC
/begin CHARACTERISTIC KL_ATMSAEXIK "Temperaturerhoehung im Kat durch Exotherme beim Schubabschalten" CURVE 0xa081a028 _REC_CUR_TKL_UW_VV__s2_u2 131.07 _CNV_R_R_Def_t_sw_q_578_CM -3276.8 3276.7 FORMAT "%4.1" /begin AXIS_DESCR STD_AXIS Mszyl _CNV_R_R_Def_ms_uw__594_CM 4 0. 2047.9687 /end AXIS_DESCR /end CHARACTERISTIC
/begin CHARACTERISTIC KL_ATM_ABGR1 "Faktor Waermeverlust an Wand vor Hauptkat Rohr 1" CURVE 0xa081a350 _REC_CUR_TKL_UW_VV__u2_u2 0.9999 _CNV_R_R_Def_f_uw_b_571_CM 0. 0.9999 FORMAT "%14.5"
 /begin AXIS_DESCR STD_AXIS NO_INPUT_QUANTITY _CNV_R_R_Def_ms_uw__594_CM 8 0. 2047.9687 /end AXIS_DESCR
/end CHARACTERISTIC
/begin CHARACTERISTIC KL_ATM_ABGR10 "Faktor Waermeverlust an Wand nach Kat Rohr 10" CURVE 0xa081a404 _REC_CUR_TKL_UW_VV__u2_u2 0.9999 _CNV_R_R_Def_f_uw_b_571_CM 0. 0.9999 FORMAT "%14.5"
 /begin AXIS_DESCR STD_AXIS NO_INPUT_QUANTITY _CNV_R_R_Def_ms_uw__594_CM 8 0. 2047.9687 /end AXIS_DESCR
/end CHARACTERISTIC
/begin CHARACTERISTIC KL_ATM_ABGR11 "Faktor Waermeverlust an Wand vor Hauptkat Rohr 11" CURVE 0xa081a64c _REC_CUR_TKL_UW_VV__u2_u2 0.9999 _CNV_R_R_Def_f_uw_b_571_CM 0. 0.9999 FORMAT "%14.5"
 /begin AXIS_DESCR STD_AXIS NO_INPUT_QUANTITY _CNV_R_R_Def_ms_uw__594_CM 8 0. 2047.9687 /end AXIS_DESCR
/end CHARACTERISTIC
/begin CHARACTERISTIC KL_ATM_ABGR11A "Faktor Waermeverlust an Wand vor Hauptkat Rohr 11a (AGR)" CURVE 0xa081a670 _REC_CUR_TKL_UW_VV__u2_u2 0.9999 _CNV_R_R_Def_f_uw_b_571_CM 0. 0.9999 FORMAT "%14.5"
 /begin AXIS_DESCR STD_AXIS NO_INPUT_QUANTITY _CNV_R_R_Def_ms_uw__594_CM 8 0. 2047.9687 /end AXIS_DESCR
/end CHARACTERISTIC
/begin CHARACTERISTIC KL_ATM_ABGR12 "Faktor Waermeverlust an Wand vor Hauptkat Rohr 12" CURVE 0xa081a694 _REC_CUR_TKL_UW_VV__u2_u2 0.9999 _CNV_R_R_Def_f_uw_b_571_CM 0. 0.9999 FORMAT "%14.5"
 /begin AXIS_DESCR STD_AXIS NO_INPUT_QUANTITY _CNV_R_R_Def_ms_uw__594_CM 8 0. 2047.9687 /end AXIS_DESCR
/end CHARACTERISTIC
/begin CHARACTERISTIC KL_ATM_ABGR12A "Faktor Waermeverlust an Wand vor Hauptkat Rohr 12a" CURVE 0xa081a6b8 _REC_CUR_TKL_UW_VV__u2_u2 0.9999 _CNV_R_R_Def_f_uw_b_571_CM 0. 0.9999 FORMAT "%14.5"
 /begin AXIS_DESCR STD_AXIS NO_INPUT_QUANTITY _CNV_R_R_Def_ms_uw__594_CM 8 0. 2047.9687 /end AXIS_DESCR
/end CHARACTERISTIC
/begin CHARACTERISTIC KL_ATM_ABGR13 "Faktor Waermeverlust an Wand vor Hauptkat Rohr 13" CURVE 0xa081a6dc _REC_CUR_TKL_UW_VV__u2_u2 0.9999 _CNV_R_R_Def_f_uw_b_571_CM 0. 0.9999 FORMAT "%14.5"
 /begin AXIS_DESCR STD_AXIS NO_INPUT_QUANTITY _CNV_R_R_Def_ms_uw__594_CM 8 0. 2047.9687 /end AXIS_DESCR
/end CHARACTERISTIC
/begin CHARACTERISTIC KL_ATM_ABGR14 "Faktor Waermeverlust an Wand vor Hauptkat Rohr 14" CURVE 0xa081a700 _REC_CUR_TKL_UW_VV__u2_u2 0.9999 _CNV_R_R_Def_f_uw_b_571_CM 0. 0.9999 FORMAT "%14.5"
 /begin AXIS_DESCR STD_AXIS NO_INPUT_QUANTITY _CNV_R_R_Def_ms_uw__594_CM 8 0. 2047.9687 /end AXIS_DESCR
/end CHARACTERISTIC
/begin CHARACTERISTIC KL_ATM_ABGR14A "Faktor Waermeverlust an Wand vor Hauptkat Rohr 14a" CURVE 0xa081a724 _REC_CUR_TKL_UW_VV__u2_u2 0.9999 _CNV_R_R_Def_f_uw_b_571_CM 0. 0.9999 FORMAT "%14.5"
 /begin AXIS_DESCR STD_AXIS NO_INPUT_QUANTITY _CNV_R_R_Def_ms_uw__594_CM 8 0. 2047.9687 /end AXIS_DESCR
/end CHARACTERISTIC
/begin CHARACTERISTIC KL_ATM_ABGR15 "Faktor Waermeverlust an Wand vor Hauptkat Rohr 15" CURVE 0xa081a748 _REC_CUR_TKL_UW_VV__u2_u2 0.9999 _CNV_R_R_Def_f_uw_b_571_CM 0. 0.9999 FORMAT "%14.5"
 /begin AXIS_DESCR STD_AXIS NO_INPUT_QUANTITY _CNV_R_R_Def_ms_uw__594_CM 8 0. 2047.9687 /end AXIS_DESCR
/end CHARACTERISTIC
/begin CHARACTERISTIC KL_ATM_ABGR16 "Faktor Waermeverlust an Wand vor Hauptkat Rohr 16" CURVE 0xa081a76c _REC_CUR_TKL_UW_VV__u2_u2 0.9999 _CNV_R_R_Def_f_uw_b_571_CM 0. 0.9999 FORMAT "%14.5"
 /begin AXIS_DESCR STD_AXIS NO_INPUT_QUANTITY _CNV_R_R_Def_ms_uw__594_CM 8 0. 2047.9687 /end AXIS_DESCR
/end CHARACTERISTIC
/begin CHARACTERISTIC KL_ATM_ABGR5 "Faktor Waermeverlust an Wand vor Hauptkat Rohr 5" CURVE 0xa081a374 _REC_CUR_TKL_UW_VV__u2_u2 0.9999 _CNV_R_R_Def_f_uw_b_571_CM 0. 0.9999 FORMAT "%14.5"
 /begin AXIS_DESCR STD_AXIS NO_INPUT_QUANTITY _CNV_R_R_Def_ms_uw__594_CM 8 0. 2047.9687 /end AXIS_DESCR
/end CHARACTERISTIC
/begin CHARACTERISTIC KL_ATM_ABGR7 "Faktor Waermeverlust an Wand vor Hauptkat Rohr 7" CURVE 0xa081a398 _REC_CUR_TKL_UW_VV__u2_u2 0.9999 _CNV_R_R_Def_f_uw_b_571_CM 0. 0.9999 FORMAT "%14.5"
 /begin AXIS_DESCR STD_AXIS NO_INPUT_QUANTITY _CNV_R_R_Def_ms_uw__594_CM 8 0. 2047.9687 /end AXIS_DESCR
/end CHARACTERISTIC
/begin CHARACTERISTIC KL_ATM_ABGR8 "Faktor Waermeverlust an Wand vor Hauptkat Rohr 8" CURVE 0xa081a3bc _REC_CUR_TKL_UW_VV__u2_u2 0.9999 _CNV_R_R_Def_f_uw_b_571_CM 0. 0.9999 FORMAT "%14.5"
 /begin AXIS_DESCR STD_AXIS NO_INPUT_QUANTITY _CNV_R_R_Def_ms_uw__594_CM 8 0. 2047.9687 /end AXIS_DESCR
/end CHARACTERISTIC
/begin CHARACTERISTIC KL_ATM_ABGR9 "Faktor Waermeverlust an Wand nach Kat Rohr 9" CURVE 0xa081a3e0 _REC_CUR_TKL_UW_VV__u2_u2 0.9999 _CNV_R_R_Def_f_uw_b_571_CM 0. 0.9999 FORMAT "%14.5"
 /begin AXIS_DESCR STD_AXIS NO_INPUT_QUANTITY _CNV_R_R_Def_ms_uw__594_CM 8 0. 2047.9687 /end AXIS_DESCR
/end CHARACTERISTIC
/begin CHARACTERISTIC KL_ATM_ABGRWG "Faktor Waermeverlust an Wand Wastegate" CURVE 0xa081a310 _REC_CUR_TKL_UW_VV__u2_u2 0.9999 _CNV_R_R_Def_f_uw_b_571_CM 0. 0.9999 FORMAT "%14.5"
 /begin AXIS_DESCR STD_AXIS NO_INPUT_QUANTITY _CNV_R_R_Def_ms_uw__594_CM 8 0. 2047.9687 /end AXIS_DESCR
/end CHARACTERISTIC
/begin CHARACTERISTIC KL_ATM_ABST "Faktor Einfluss Abstellzeit auf Abkuehlung Abgasanlage" CURVE 0xa0819ac4 _REC_CUR_TKL_UW_VV__u1_u2 0.996 _CNV_R_R_Def_f_ub_b_553_CM 0. 0.996
 /begin AXIS_DESCR STD_AXIS Tn_abstell _CNV_R_R_Def_dez_sl_551_CM 6 0. 65535. FORMAT "%5.0" /end AXIS_DESCR
/end CHARACTERISTIC
/begin CHARACTERISTIC KL_ATM_ABSTNK "Faktor Einfluss Abstellzeit auf Abkuehlung Abgasanlage nach Kat" CURVE 0xa0819ad8 _REC_CUR_TKL_UW_VV__u1_u2 0.996 _CNV_R_R_Def_f_ub_b_553_CM 0. 0.996
 /begin AXIS_DESCR STD_AXIS Tn_abstell _CNV_R_R_Def_dez_sl_551_CM 6 0. 65535. FORMAT "%5.0" /end AXIS_DESCR
/end CHARACTERISTIC
/begin CHARACTERISTIC KL_ATM_ATLKAP "Koeffizient abh. v. Isentropenexponent u. Druckverhaeltnis fuer ATL" CURVE 0xa081a12c _REC_CUR_TKL_UW_VV__u2_u2 1.9999 _CNV_R_R_Def_f_uw_b_590_CM 0. 1.9999 FORMAT "%14.5"
 /begin AXIS_DESCR STD_AXIS NO_INPUT_QUANTITY _CNV_R_R_Def_f_sw_b_616_CM 8 0. 3.9999 FORMAT "%14.5" /end AXIS_DESCR
/end CHARACTERISTIC
/begin CHARACTERISTIC KL_ATM_DTSL "Temperaturaenderung durch Sekundaerluft" CURVE 0xa08199b8 _REC_CUR_TKL_UW_VV__s2_u2 131.07 _CNV_R_R_Def_t_sw_q_578_CM -3276.8 3276.7 FORMAT "%4.1" /begin AXIS_DESCR STD_AXIS Ms_sl _CNV_R_R_Def_ms_uw__594_CM 4 0. 2047.9687 /end AXIS_DESCR /end CHARACTERISTIC
/begin CHARACTERISTIC KL_ATM_DTTMOT "Temperaturaenderung durch Motortemperatur" CURVE 0xa08199dc _REC_CUR_TKL_UW_VV__s2_s2 131.07 _CNV_R_R_Def_t_sw_q_578_CM -3276.8 3276.7 FORMAT "%4.1"
 /begin AXIS_DESCR STD_AXIS Tmot _CNV_R_R_Def_t_sw_q_579_CM 4 -327.68 327.67 FORMAT "%5.2" /end AXIS_DESCR
/end CHARACTERISTIC
/begin CHARACTERISTIC KL_ATM_DV "Geschwindigkeitskorrektur ueber Luefter-PWM" CURVE 0xa0819a60 _REC_CUR_TKL_UW_VV__u1_u1 99.45 _CNV_R_R_Def_v_ub_q_747_CM 0. 153. FORMAT "%5.2"
 /begin AXIS_DESCR STD_AXIS L_pwmout _CNV_R_R_Def_f_ub_b_586_CM 5 0. 99.60930000000001 FORMAT "%5.2" /end AXIS_DESCR
/end CHARACTERISTIC
/begin CHARACTERISTIC KL_ATM_ETAZW "Zuendwinkel-Wirkungsgradeinfluss auf Abgastemperatur" CURVE 0xa0819a3c _REC_CUR_TKL_UW_VV__u2_s2 1.9999 _CNV_R_R_Def_f_uw_b_590_CM 0. 1.9999 FORMAT "%14.5" /begin AXIS_DESCR STD_AXIS Eta_zw_ist1 _CNV_R_R_Def_eta_sw_606_CM 8 0. 100. /end AXIS_DESCR /end CHARACTERISTIC
/begin CHARACTERISTIC KL_ATM_FLA "Korrektur Lambdaeinfluss fuer mageren Bauteilschutz" CURVE 0xa08199f0 _REC_CUR_TKL_UW_VV__u1_u2 1.9921 _CNV_R_R_Def_f_ub_b_613_CM 0. 1.9921
 /begin AXIS_DESCR STD_AXIS NO_INPUT_QUANTITY _CNV_R_R_Def_f_uw_b_559_CM 6 0. 15.9997 FORMAT "%7.4" /end AXIS_DESCR
/end CHARACTERISTIC
/begin CHARACTERISTIC KL_ATM_FLAM "Faktor Einfluss Lambda auf Enthalpiekorrektur" CURVE 0xa0819a20 _REC_CUR_TKL_UW_VV__u2_u2 1.9999 _CNV_R_R_Def_f_uw_b_590_CM 0. 1.9999 FORMAT "%14.5"
 /begin AXIS_DESCR STD_AXIS La_ist1 _CNV_R_R_Def_f_uw_b_559_CM 6 0. 15.9997 FORMAT "%7.4" /end AXIS_DESCR
/end CHARACTERISTIC
/begin CHARACTERISTIC KL_ATM_FSA "Filterfaktor fuer Abgastemperatur bei Schubabschaltung" CURVE 0xa0819978 _REC_CUR_TKL_UW_VV__u2_u2 65.535 _CNV_R_R_Def_td_uw__663_CM 0. 65.535
 /begin AXIS_DESCR STD_AXIS Mszyl_int _CNV_R_R_Def_m_uw_q_657_CM 8 0. 20.0229 FORMAT "%7.4" /end AXIS_DESCR
/end CHARACTERISTIC
/begin CHARACTERISTIC KL_ATM_FSL "Gewichtung Temperaturaenderung durch Sekundaerluft" CURVE 0xa08199cc _REC_CUR_TKL_UW_VV__u1_u2 1. _CNV_R_R_Def_f_ub_b_619_CM 0. 1. /begin AXIS_DESCR STD_AXIS Mszyl _CNV_R_R_Def_ms_uw__594_CM 4 0. 2047.9687 /end AXIS_DESCR /end CHARACTERISTIC
/begin CHARACTERISTIC KL_ATM_FVBANK "Korrekturfaktor fuer Geschwindigkeitskorrektur Bank 2" CURVE 0xa0819a88 _REC_CUR_TKL_UW_VV__u1_u2 1.9921 _CNV_R_R_Def_f_ub_b_613_CM 0. 1.9921
 /begin AXIS_DESCR STD_AXIS V _CNV_R_R_Def_v_uw_q_726_CM 5 0. 360. FORMAT "%5.0" /end AXIS_DESCR
/end CHARACTERISTIC
/begin CHARACTERISTIC KL_ATM_FVLK0 "Faktor zur Geschwindigkeitskorrektur ueber Luefter-PWM bei Luefterklappenstellung 0" CURVE 0xa0819a9c _REC_CUR_TKL_UW_VV__u1_u2 1.9921 _CNV_R_R_Def_f_ub_b_613_CM 0. 1.9921
 /begin AXIS_DESCR STD_AXIS V _CNV_R_R_Def_v_uw_q_726_CM 5 0. 360. FORMAT "%5.0" /end AXIS_DESCR
/end CHARACTERISTIC
/begin CHARACTERISTIC KL_ATM_FVLK1 "Faktor zur Geschwindigkeitskorrektur ueber Luefter-PWM bei Luefterklappenstellung 1" CURVE 0xa0819ab0 _REC_CUR_TKL_UW_VV__u1_u2 1.9921 _CNV_R_R_Def_f_ub_b_613_CM 0. 1.9921
 /begin AXIS_DESCR STD_AXIS V _CNV_R_R_Def_v_uw_q_726_CM 5 0. 360. FORMAT "%5.0" /end AXIS_DESCR
/end CHARACTERISTIC
/begin CHARACTERISTIC KL_ATM_LA "Exotherme Temperaturabnahme bei Anfettung" CURVE 0xa0819fb0 _REC_CUR_TKL_UW_VV__s1_u2 3.9843 _CNV_R_R_Def_f_sb_b_669_CM -2. 1.9843 FORMAT "%5.2"
 /begin AXIS_DESCR STD_AXIS La_ist2 _CNV_R_R_Def_f_uw_b_559_CM 6 0. 15.9997 FORMAT "%7.4" /end AXIS_DESCR
/end CHARACTERISTIC
/begin CHARACTERISTIC KL_ATM_LAIK "Exotherme Temperaturabnahme bei Anfettung" CURVE 0xa0819fd8 _REC_CUR_TKL_UW_VV__s1_u2 3.9843 _CNV_R_R_Def_f_sb_b_669_CM -2. 1.9843 FORMAT "%5.2"
 /begin AXIS_DESCR STD_AXIS La_ist2 _CNV_R_R_Def_f_uw_b_559_CM 6 0. 15.9997 FORMAT "%7.4" /end AXIS_DESCR
/end CHARACTERISTIC
/begin CHARACTERISTIC KL_ATM_LAIK_S "Exotherme Temperaturabnahme bei Anfettung im Schichtbetrieb" CURVE 0xa0819fec _REC_CUR_TKL_UW_VV__s1_u2 3.9843 _CNV_R_R_Def_f_sb_b_669_CM -2. 1.9843 FORMAT "%5.2"
 /begin AXIS_DESCR STD_AXIS La_ist2 _CNV_R_R_Def_f_uw_b_559_CM 6 0. 15.9997 FORMAT "%7.4" /end AXIS_DESCR
/end CHARACTERISTIC
/begin CHARACTERISTIC KL_ATM_LA_S "Exotherme Temperaturabnahme bei Anfettung im Schichtbetrieb" CURVE 0xa0819fc4 _REC_CUR_TKL_UW_VV__s1_u2 3.9843 _CNV_R_R_Def_f_sb_b_669_CM -2. 1.9843 FORMAT "%5.2"
 /begin AXIS_DESCR STD_AXIS La_ist2 _CNV_R_R_Def_f_uw_b_559_CM 6 0. 15.9997 FORMAT "%7.4" /end AXIS_DESCR
/end CHARACTERISTIC
/begin CHARACTERISTIC KL_ATM_LK_DV "Geschwindigkeitskorrektur ueber Luefterklappenstellung" CURVE 0xa0819a70 _REC_CUR_TKL_UW_VV__s2_u2 100.8 _CNV_R_R_Def_v_uw_q_726_CM -180. 180. FORMAT "%5.0"
 /begin AXIS_DESCR STD_AXIS V _CNV_R_R_Def_v_uw_q_726_CM 5 0. 360. FORMAT "%5.0" /end AXIS_DESCR
/end CHARACTERISTIC
/begin CHARACTERISTIC KL_ATM_LK_V "Korrektur der Fahrzeuggeschwindigkeit durch Kuehlkanal" CURVE 0xa0819aec _REC_CUR_TKL_UW_VV__u2_u2 100.8 _CNV_R_R_Def_v_uw_q_726_CM 0. 360. FORMAT "%5.0"
 /begin AXIS_DESCR STD_AXIS V_atm_b1 _CNV_R_R_Def_v_uw_q_726_CM 8 0. 360. FORMAT "%5.0" /end AXIS_DESCR
/end CHARACTERISTIC
/begin CHARACTERISTIC KL_ATM_RUMG1 "Waermeverlust von Rohr vor Hauptkat an Umgebung durch Fahrtwind Rohr 1" CURVE 0xa081a470 _REC_CUR_TKL_UW_VV__s2_u2 99.83843999999999 _CNV_R_R_Def_cxm_sw_627_CM -128. 127.996
 /begin AXIS_DESCR STD_AXIS V_atm_b1 _CNV_R_R_Def_v_uw_q_726_CM 8 0. 360. FORMAT "%5.0" /end AXIS_DESCR
/end CHARACTERISTIC
/begin CHARACTERISTIC KL_ATM_RUMG10 "Waermeverlust von Rohr nach Kat an Umgebung durch Fahrtwind Rohr 10" CURVE 0xa081a524 _REC_CUR_TKL_UW_VV__s2_u2 99.83843999999999 _CNV_R_R_Def_cxm_sw_627_CM -128. 127.996
 /begin AXIS_DESCR STD_AXIS V_atm_b2 _CNV_R_R_Def_v_uw_q_726_CM 8 0. 360. FORMAT "%5.0" /end AXIS_DESCR
/end CHARACTERISTIC
/begin CHARACTERISTIC KL_ATM_RUMG11 "Waermeverlust von Rohr vor Hauptkat an Umgebung durch Fahrtwind Rohr 11" CURVE 0xa081a790 _REC_CUR_TKL_UW_VV__s2_u2 99.83843999999999 _CNV_R_R_Def_cxm_sw_627_CM -128. 127.996
 /begin AXIS_DESCR STD_AXIS V _CNV_R_R_Def_v_uw_q_726_CM 8 0. 360. FORMAT "%5.0" /end AXIS_DESCR
/end CHARACTERISTIC
/begin CHARACTERISTIC KL_ATM_RUMG11A "Waermeverlust von Rohr vor Hauptkat an Umgebung durch Fahrtwind Rohr 11a (AGR)" CURVE 0xa081a7b4 _REC_CUR_TKL_UW_VV__s2_u2 99.83843999999999 _CNV_R_R_Def_cxm_sw_627_CM -128. 127.996
 /begin AXIS_DESCR STD_AXIS V _CNV_R_R_Def_v_uw_q_726_CM 8 0. 360. FORMAT "%5.0" /end AXIS_DESCR
/end CHARACTERISTIC
/begin CHARACTERISTIC KL_ATM_RUMG12 "Waermeverlust von Rohr vor Hauptkat an Umgebung durch Fahrtwind Rohr 12" CURVE 0xa081a7d8 _REC_CUR_TKL_UW_VV__s2_u2 99.83843999999999 _CNV_R_R_Def_cxm_sw_627_CM -128. 127.996
 /begin AXIS_DESCR STD_AXIS V _CNV_R_R_Def_v_uw_q_726_CM 8 0. 360. FORMAT "%5.0" /end AXIS_DESCR
/end CHARACTERISTIC
/begin CHARACTERISTIC KL_ATM_RUMG12A "Waermeverlust von Rohr vor Hauptkat an Umgebung durch Fahrtwind Rohr 12a" CURVE 0xa081a7fc _REC_CUR_TKL_UW_VV__s2_u2 99.83843999999999 _CNV_R_R_Def_cxm_sw_627_CM -128. 127.996
 /begin AXIS_DESCR STD_AXIS V _CNV_R_R_Def_v_uw_q_726_CM 8 0. 360. FORMAT "%5.0" /end AXIS_DESCR
/end CHARACTERISTIC
/begin CHARACTERISTIC KL_ATM_RUMG13 "Waermeverlust von Rohr vor Hauptkat an Umgebung durch Fahrtwind Rohr 13" CURVE 0xa081a820 _REC_CUR_TKL_UW_VV__s2_u2 99.83843999999999 _CNV_R_R_Def_cxm_sw_627_CM -128. 127.996
 /begin AXIS_DESCR STD_AXIS V _CNV_R_R_Def_v_uw_q_726_CM 8 0. 360. FORMAT "%5.0" /end AXIS_DESCR
/end CHARACTERISTIC
/begin CHARACTERISTIC KL_ATM_RUMG14 "Waermeverlust von Rohr vor Hauptkat an Umgebung durch Fahrtwind Rohr 14" CURVE 0xa081a844 _REC_CUR_TKL_UW_VV__s2_u2 99.83843999999999 _CNV_R_R_Def_cxm_sw_627_CM -128. 127.996
 /begin AXIS_DESCR STD_AXIS V _CNV_R_R_Def_v_uw_q_726_CM 8 0. 360. FORMAT "%5.0" /end AXIS_DESCR
/end CHARACTERISTIC
/begin CHARACTERISTIC KL_ATM_RUMG14A "Waermeverlust von Rohr vor Hauptkat an Umgebung durch Fahrtwind Rohr 14a" CURVE 0xa081a868 _REC_CUR_TKL_UW_VV__s2_u2 99.83843999999999 _CNV_R_R_Def_cxm_sw_627_CM -128. 127.996
 /begin AXIS_DESCR STD_AXIS V _CNV_R_R_Def_v_uw_q_726_CM 8 0. 360. FORMAT "%5.0" /end AXIS_DESCR
/end CHARACTERISTIC
/begin CHARACTERISTIC KL_ATM_RUMG15 "Waermeverlust von Rohr vor Hauptkat an Umgebung durch Fahrtwind Rohr 15" CURVE 0xa081a88c _REC_CUR_TKL_UW_VV__s2_u2 99.83843999999999 _CNV_R_R_Def_cxm_sw_627_CM -128. 127.996
 /begin AXIS_DESCR STD_AXIS V _CNV_R_R_Def_v_uw_q_726_CM 8 0. 360. FORMAT "%5.0" /end AXIS_DESCR
/end CHARACTERISTIC
/begin CHARACTERISTIC KL_ATM_RUMG16 "Waermeverlust von Rohr vor Hauptkat an Umgebung durch Fahrtwind Rohr 16" CURVE 0xa081a8b0 _REC_CUR_TKL_UW_VV__s2_u2 99.83843999999999 _CNV_R_R_Def_cxm_sw_627_CM -128. 127.996
 /begin AXIS_DESCR STD_AXIS V _CNV_R_R_Def_v_uw_q_726_CM 8 0. 360. FORMAT "%5.0" /end AXIS_DESCR
/end CHARACTERISTIC
/begin CHARACTERISTIC KL_ATM_RUMG5 "Waermeverlust von Rohr vor Hauptkat an Umgebung durch Fahrtwind Rohr 5" CURVE 0xa081a494 _REC_CUR_TKL_UW_VV__s2_u2 99.83843999999999 _CNV_R_R_Def_cxm_sw_627_CM -128. 127.996
 /begin AXIS_DESCR STD_AXIS V_atm_b2 _CNV_R_R_Def_v_uw_q_726_CM 8 0. 360. FORMAT "%5.0" /end AXIS_DESCR
/end CHARACTERISTIC
/begin CHARACTERISTIC KL_ATM_RUMG7 "Waermeverlust von Rohr vor Hauptkat an Umgebung durch Fahrtwind Rohr 7" CURVE 0xa081a4b8 _REC_CUR_TKL_UW_VV__s2_u2 99.83843999999999 _CNV_R_R_Def_cxm_sw_627_CM -128. 127.996
 /begin AXIS_DESCR STD_AXIS V_atm_b1 _CNV_R_R_Def_v_uw_q_726_CM 8 0. 360. FORMAT "%5.0" /end AXIS_DESCR
/end CHARACTERISTIC
/begin CHARACTERISTIC KL_ATM_RUMG8 "Waermeverlust von Rohr vor Hauptkat an Umgebung durch Fahrtwind Rohr 8" CURVE 0xa081a4dc _REC_CUR_TKL_UW_VV__s2_u2 99.83843999999999 _CNV_R_R_Def_cxm_sw_627_CM -128. 127.996
 /begin AXIS_DESCR STD_AXIS V_atm_b2 _CNV_R_R_Def_v_uw_q_726_CM 8 0. 360. FORMAT "%5.0" /end AXIS_DESCR
/end CHARACTERISTIC
/begin CHARACTERISTIC KL_ATM_RUMG9 "Waermeverlust von Rohr nach Kat an Umgebung durch Fahrtwind Rohr 9" CURVE 0xa081a500 _REC_CUR_TKL_UW_VV__s2_u2 99.83843999999999 _CNV_R_R_Def_cxm_sw_627_CM -128. 127.996
 /begin AXIS_DESCR STD_AXIS V_atm_b1 _CNV_R_R_Def_v_uw_q_726_CM 8 0. 360. FORMAT "%5.0" /end AXIS_DESCR
/end CHARACTERISTIC
/begin CHARACTERISTIC KL_ATM_RUMGWG1 "Waermeverlust von Wastegate an Umgebung durch Fahrtwind Bank 1" CURVE 0xa081a428 _REC_CUR_TKL_UW_VV__s2_u2 99.83843999999999 _CNV_R_R_Def_cxm_sw_627_CM -128. 127.996
 /begin AXIS_DESCR STD_AXIS V_atm_b1 _CNV_R_R_Def_v_uw_q_726_CM 8 0. 360. FORMAT "%5.0" /end AXIS_DESCR
/end CHARACTERISTIC
/begin CHARACTERISTIC KL_ATM_RUMGWG2 "Waermeverlust von Wastegate an Umgebung durch Fahrtwind Bank 2" CURVE 0xa081a44c _REC_CUR_TKL_UW_VV__s2_u2 99.83843999999999 _CNV_R_R_Def_cxm_sw_627_CM -128. 127.996
 /begin AXIS_DESCR STD_AXIS V_atm_b1 _CNV_R_R_Def_v_uw_q_726_CM 8 0. 360. FORMAT "%5.0" /end AXIS_DESCR
/end CHARACTERISTIC
/begin CHARACTERISTIC KL_ATM_TMOTSA "Offset auf Abgasendtemperatur bei Schubabschaltung" CURVE 0xa081999c _REC_CUR_TKL_UW_VV__s2_u2 98.30250000000001 _CNV_R_R_Def_t_sw_q_579_CM -327.68 327.67 FORMAT "%5.2" /begin AXIS_DESCR STD_AXIS Mszyl _CNV_R_R_Def_ms_uw__594_CM 6 0. 2047.9687 /end AXIS_DESCR /end CHARACTERISTIC
/begin CHARACTERISTIC KL_ATM_WGMS "Korrektur des Wastegatemassenstroms bei kleinen Durchsaetzen" CURVE 0xa081a334 _REC_CUR_TKL_UW_VV__u2_u2 1.9999 _CNV_R_R_Def_f_uw_b_590_CM 0. 1.9999 FORMAT "%14.5"
 /begin AXIS_DESCR STD_AXIS NO_INPUT_QUANTITY _CNV_R_R_Def_ms_uw__594_CM 6 0. 2047.9687 /end AXIS_DESCR
/end CHARACTERISTIC
/begin CHARACTERISTIC KL_ATM_ZW "Exotherme Temperaturabnahme im Kat bei spaeterem Zuendwinkel" CURVE 0xa0819f9c _REC_CUR_TKL_UW_VV__s1_s2 3.9843 _CNV_R_R_Def_f_sb_b_669_CM -2. 1.9843 FORMAT "%5.2" /begin AXIS_DESCR STD_AXIS Eta_zw_ist2 _CNV_R_R_Def_eta_sw_606_CM 6 0. 100. /end AXIS_DESCR /end CHARACTERISTIC
/begin CHARACTERISTIC KL_ATM_ZWIK "Exotherme Temperaturabnahme im Kat bei spaeterem Zuendwinkel" CURVE 0xa081a000 _REC_CUR_TKL_UW_VV__s1_s2 3.9843 _CNV_R_R_Def_f_sb_b_669_CM -2. 1.9843 FORMAT "%5.2" /begin AXIS_DESCR STD_AXIS Eta_zw_ist2 _CNV_R_R_Def_eta_sw_606_CM 6 0. 100. /end AXIS_DESCR /end CHARACTERISTIC
/begin CHARACTERISTIC KL_BS_I_NOK "I-Anteil PID-Regler Bauteilschutz NOx-Kat" CURVE 0xa081951c _REC_CUR_TKL_UW_VV__u2_u2 1.9999 _CNV_R_R_Def_f_uw_b_590_CM 0. 1.9999 FORMAT "%14.5" /begin AXIS_DESCR STD_AXIS Mszyl _CNV_R_R_Def_ms_uw__594_CM 4 0. 2047.9687 /end AXIS_DESCR /end CHARACTERISTIC
/begin CHARACTERISTIC KL_BS_KATALT "Absenkung Sollwert fuer BS bei Katalterung" CURVE 0xa08194d8 _REC_CUR_TKL_UW_VV__s2_s2 131.07 _CNV_R_R_Def_t_sw_q_578_CM -3276.8 3276.7 FORMAT "%4.1"
 /begin AXIS_DESCR STD_AXIS F_grad_katalt _CNV_R_R_Def_f_sw_b_620_CM 4 -0.1 9.99e-002 FORMAT "%14.5" /end AXIS_DESCR
/end CHARACTERISTIC
/begin CHARACTERISTIC KL_BS_KKK_AUF "Forderung Luftklappe auf Schichtbereich" CURVE 0xa081948c _REC_CUR_TKL_UW_VV__s2_u2 131.07 _CNV_R_R_Def_t_sw_q_578_CM -3276.8 3276.7 FORMAT "%4.1"
 /begin AXIS_DESCR STD_AXIS F_katalt_tabg _CNV_R_R_Def_f_uw_b_571_CM 4 0. 0.9999 FORMAT "%14.5" /end AXIS_DESCR
/end CHARACTERISTIC
/begin CHARACTERISTIC KL_BS_KKK_BS "Forderung Luftklappe auf Bauteilschutz" CURVE 0xa08194b4 _REC_CUR_TKL_UW_VV__s2_u2 131.07 _CNV_R_R_Def_t_sw_q_578_CM -3276.8 3276.7 FORMAT "%4.1"
 /begin AXIS_DESCR STD_AXIS F_katalt_tabg _CNV_R_R_Def_f_uw_b_571_CM 4 0. 0.9999 FORMAT "%14.5" /end AXIS_DESCR
/end CHARACTERISTIC
/begin CHARACTERISTIC KL_BS_KKK_LUEFT "Fahrzeuggeschwindigkeit fuer Luftklappe Bauteilschutz" CURVE 0xa08194c8 _REC_CUR_TKL_UW_VV__u1_u2 99.60930000000001 _CNV_R_R_Def_f_ub_b_586_CM 0. 99.60930000000001 FORMAT "%5.2"
 /begin AXIS_DESCR STD_AXIS V _CNV_R_R_Def_v_uw_q_726_CM 4 0. 360. FORMAT "%5.0" /end AXIS_DESCR
/end CHARACTERISTIC
/begin CHARACTERISTIC KL_BS_KKK_ZU "Forderung Luftklappe zu Schichtbereich" CURVE 0xa08194a0 _REC_CUR_TKL_UW_VV__s2_u2 131.07 _CNV_R_R_Def_t_sw_q_578_CM -3276.8 3276.7 FORMAT "%4.1"
 /begin AXIS_DESCR STD_AXIS F_katalt_tabg _CNV_R_R_Def_f_uw_b_571_CM 4 0. 0.9999 FORMAT "%14.5" /end AXIS_DESCR
/end CHARACTERISTIC
/begin CHARACTERISTIC KL_BS_LAMAUSWAHL "Auswahl der Betriebsart fuer Rueckschaltung auf fetten BS-Modus" CURVE 0xa0819530 _REC_CUR_TKL_UW_VV__u1_u1 99.45 _CNV_R_R_Def_dez_sl_551_CM 0. 255. FORMAT "%3.0"
 /begin AXIS_DESCR STD_AXIS Lam_auswahl1 _CNV_R_R_Def_dez_sl_551_CM 10 0. 255. FORMAT "%3.0" /end AXIS_DESCR
/end CHARACTERISTIC
/begin CHARACTERISTIC KL_BS_P_NOK "P-Anteil PID-Regler Bauteilschutz NOx-Kat" CURVE 0xa0819508 _REC_CUR_TKL_UW_VV__u2_u2 63.99900000000001 _CNV_R_R_Def_f_uw_b_617_CM 0. 63.999 FORMAT "%7.4" /begin AXIS_DESCR STD_AXIS Mszyl _CNV_R_R_Def_ms_uw__594_CM 4 0. 2047.9687 /end AXIS_DESCR /end CHARACTERISTIC
/begin CHARACTERISTIC KL_BS_ZKNN "Filterkonstante fuer Filterung KNN-Vorsteuerwert" CURVE 0xa0819470 _REC_CUR_TKL_UW_VV__u2_u2 65.535 _CNV_R_R_Def_td_uw__663_CM 0. 65.535 /begin AXIS_DESCR STD_AXIS Mszyl _CNV_R_R_Def_ms_uw__594_CM 6 0. 2047.9687 /end AXIS_DESCR /end CHARACTERISTIC
/begin CHARACTERISTIC KL_DTA_IKAT "Absenkung Sollwert fuer BS bei zu hoher Inkattemperatur" CURVE 0xa08194ec _REC_CUR_TKL_UW_VV__s2_s2 131.07 _CNV_R_R_Def_t_sw_q_578_CM -3276.8 3276.7 FORMAT "%4.1"
 /begin AXIS_DESCR STD_AXIS NO_INPUT_QUANTITY _CNV_R_R_Def_t_sw_q_578_CM 6 -3276.8 3276.7 FORMAT "%4.1" /end AXIS_DESCR
/end CHARACTERISTIC
/begin CHARACTERISTIC KL_EXOMS1 "Exotherme Temperatur im Kat" CURVE 0xa081a2a0 _REC_CUR_TKL_UW_VV__s2_u2 131.07 _CNV_R_R_Def_t_sw_q_578_CM -3276.8 3276.7 FORMAT "%4.1"
 /begin AXIS_DESCR STD_AXIS Mszyl_atm _CNV_R_R_Def_ms_uw__594_CM 6 0. 2047.9687 /end AXIS_DESCR
/end CHARACTERISTIC
/begin CHARACTERISTIC KL_EXOMS1_S "Exotherme Temperatur im Kat bei Schichtbetrieb" CURVE 0xa081a2bc _REC_CUR_TKL_UW_VV__s2_u2 131.07 _CNV_R_R_Def_t_sw_q_578_CM -3276.8 3276.7 FORMAT "%4.1"
 /begin AXIS_DESCR STD_AXIS Mszyl_atm _CNV_R_R_Def_ms_uw__594_CM 6 0. 2047.9687 /end AXIS_DESCR
/end CHARACTERISTIC
/begin CHARACTERISTIC KL_EXOMS2 "Exotherme Temperatur im Kat Bank 2" CURVE 0xa081a2d8 _REC_CUR_TKL_UW_VV__s2_u2 131.07 _CNV_R_R_Def_t_sw_q_578_CM -3276.8 3276.7 FORMAT "%4.1"
 /begin AXIS_DESCR STD_AXIS Mszyl_atm _CNV_R_R_Def_ms_uw__594_CM 6 0. 2047.9687 /end AXIS_DESCR
/end CHARACTERISTIC
/begin CHARACTERISTIC KL_EXOMS2_S "Exotherme Temperatur im Kat Bank 2 bei Schichtbetrieb" CURVE 0xa081a2f4 _REC_CUR_TKL_UW_VV__s2_u2 131.07 _CNV_R_R_Def_t_sw_q_578_CM -3276.8 3276.7 FORMAT "%4.1"
 /begin AXIS_DESCR STD_AXIS Mszyl_atm _CNV_R_R_Def_ms_uw__594_CM 6 0. 2047.9687 /end AXIS_DESCR
/end CHARACTERISTIC
/begin CHARACTERISTIC KL_EXOMSIK1 "Exotherme Temperatur im Kat" CURVE 0xa081a214 _REC_CUR_TKL_UW_VV__s2_u2 131.07 _CNV_R_R_Def_t_sw_q_578_CM -3276.8 3276.7 FORMAT "%4.1"
 /begin AXIS_DESCR STD_AXIS Mszyl_atm _CNV_R_R_Def_ms_uw__594_CM 6 0. 2047.9687 /end AXIS_DESCR
/end CHARACTERISTIC
/begin CHARACTERISTIC KL_EXOMSIK1_S "Exotherme Temperatur im Kat bei Schichtbetrieb" CURVE 0xa081a230 _REC_CUR_TKL_UW_VV__s2_u2 131.07 _CNV_R_R_Def_t_sw_q_578_CM -3276.8 3276.7 FORMAT "%4.1"
 /begin AXIS_DESCR STD_AXIS Mszyl_atm _CNV_R_R_Def_ms_uw__594_CM 6 0. 2047.9687 /end AXIS_DESCR
/end CHARACTERISTIC
/begin CHARACTERISTIC KL_EXOMSIK2 "Exotherme Temperatur im Kat Bank 2" CURVE 0xa081a24c _REC_CUR_TKL_UW_VV__s2_u2 131.07 _CNV_R_R_Def_t_sw_q_578_CM -3276.8 3276.7 FORMAT "%4.1"
 /begin AXIS_DESCR STD_AXIS Mszyl_atm _CNV_R_R_Def_ms_uw__594_CM 6 0. 2047.9687 /end AXIS_DESCR
/end CHARACTERISTIC
/begin CHARACTERISTIC KL_EXOMSIK2_S "Exotherme Temperatur im Kat Bank 2 bei Schichtbetrieb" CURVE 0xa081a268 _REC_CUR_TKL_UW_VV__s2_u2 131.07 _CNV_R_R_Def_t_sw_q_578_CM -3276.8 3276.7 FORMAT "%4.1"
 /begin AXIS_DESCR STD_AXIS Mszyl_atm _CNV_R_R_Def_ms_uw__594_CM 6 0. 2047.9687 /end AXIS_DESCR
/end CHARACTERISTIC
/begin CHARACTERISTIC KL_FKWG1KOR "Filterkonstante für WG1KOR LowPass" CURVE 0xa0818704 _REC_CUR_TKL_UW_VV__u2_s2 0.9999847412109381 _CNV_R_R_Def_f_uw_b_571_CM 0. 0.9999847412109381 FORMAT "%14.5"
 /begin AXIS_DESCR STD_AXIS Pldrsoll_dyn _CNV_R_R_Def_p_sw_q_576_CM 8 -1280. 1279.9609 FORMAT "%5.2" /end AXIS_DESCR
/end CHARACTERISTIC
/begin CHARACTERISTIC KL_IKWG1K "Integrierbeiwert f. Adaption" CURVE 0xa0818728 _REC_CUR_TKL_UW_VV__u2_u2 0.9999847412109381 _CNV_R_R_Def_f_uw_b_571_CM 0. 0.9999847412109381 FORMAT "%14.5"
 /begin AXIS_DESCR STD_AXIS Mssolatl_k _CNV_R_R_Def_ms_uw__594_CM 8 0. 2047.9687 /end AXIS_DESCR
/end CHARACTERISTIC
/begin CHARACTERISTIC KL_K_EXH_MS "Einfluss Mszyl auf Exothermie im Kat bei Homogenbetrieb" CURVE 0xa081a62c _REC_CUR_TKL_UW_VV__u1_u2 99.609375 _CNV_R_R_Def_t_ub_b_749_CM 0. 398.4375 /begin AXIS_DESCR STD_AXIS Mszyl _CNV_R_R_Def_ms_uw__594_CM 10 0. 2047.9687 /end AXIS_DESCR /end CHARACTERISTIC
/begin CHARACTERISTIC KL_K_EXS_MS "Einfluss Mszyl auf Exothermie im Kat bei Schichtbetrieb" CURVE 0xa081a60c _REC_CUR_TKL_UW_VV__u1_u2 99.609375 _CNV_R_R_Def_t_ub_b_749_CM 0. 398.4375 /begin AXIS_DESCR STD_AXIS Mszyl _CNV_R_R_Def_ms_uw__594_CM 10 0. 2047.9687 /end AXIS_DESCR /end CHARACTERISTIC
/begin CHARACTERISTIC KL_N_EX_LA "Einfluss Lambda auf Exothermie im NoX-Kat" CURVE 0xa081a0ec _REC_CUR_TKL_UW_VV__u1_u2 2.55 _CNV_R_R_Def_lf_ub__670_CM 0. 2.55
 /begin AXIS_DESCR STD_AXIS NO_INPUT_QUANTITY _CNV_R_R_Def_f_uw_b_559_CM 10 0. 15.9997 FORMAT "%7.4" /end AXIS_DESCR
/end CHARACTERISTIC
/begin CHARACTERISTIC KL_N_EX_MS "Einfluss Mszyl auf Exothermie im NoX-Kat" CURVE 0xa081a10c _REC_CUR_TKL_UW_VV__u1_u2 99.609375 _CNV_R_R_Def_t_ub_b_749_CM 0. 398.4375 /begin AXIS_DESCR STD_AXIS Mszyl _CNV_R_R_Def_ms_uw__594_CM 10 0. 2047.9687 /end AXIS_DESCR /end CHARACTERISTIC
/begin CHARACTERISTIC KL_N_T_DECA "Zeitkonstante fuer Integrator Tabg_inok bei fallender Temperatur" CURVE 0xa081a068 _REC_CUR_TKL_UW_VV__u2_u2 65.535 _CNV_R_R_Def_td_uw__663_CM 0. 65.535 /begin AXIS_DESCR STD_AXIS Mszyl _CNV_R_R_Def_ms_uw__594_CM 10 0. 2047.9687 /end AXIS_DESCR /end CHARACTERISTIC
/begin CHARACTERISTIC KL_N_T_DECB "Zeitkonstante fuer Integrator Tabg_nnok bei fallender Temperatur" CURVE 0xa081a0c0 _REC_CUR_TKL_UW_VV__u2_u2 65.535 _CNV_R_R_Def_td_uw__663_CM 0. 65.535 /begin AXIS_DESCR STD_AXIS Mszyl _CNV_R_R_Def_ms_uw__594_CM 10 0. 2047.9687 /end AXIS_DESCR /end CHARACTERISTIC
/begin CHARACTERISTIC KL_N_T_INCA "Zeitkonstante fuer Integrator Tabg_inok bei steigender Temperatur" CURVE 0xa081a03c _REC_CUR_TKL_UW_VV__u2_u2 65.535 _CNV_R_R_Def_td_uw__663_CM 0. 65.535 /begin AXIS_DESCR STD_AXIS Mszyl _CNV_R_R_Def_ms_uw__594_CM 10 0. 2047.9687 /end AXIS_DESCR /end CHARACTERISTIC
/begin CHARACTERISTIC KL_N_T_INCB "Zeitkonstante fuer Integrator Tabg_nnok bei steigender Temperatur" CURVE 0xa081a094 _REC_CUR_TKL_UW_VV__u2_u2 65.535 _CNV_R_R_Def_td_uw__663_CM 0. 65.535 /begin AXIS_DESCR STD_AXIS Mszyl _CNV_R_R_Def_ms_uw__594_CM 10 0. 2047.9687 /end AXIS_DESCR /end CHARACTERISTIC
/begin CHARACTERISTIC KL_PLDLEK_MN "Unterer Grenzwert für Leckage-Bestimmung" CURVE 0xa08186bc _REC_CUR_TKL_UW_VV__u2_s2 3.9999 _CNV_R_R_Def_f_sw_b_616_CM 0. 3.9999 FORMAT "%14.5"
 /begin AXIS_DESCR STD_AXIS Nkw _CNV_R_R_Def_n_sw_q_595_CM 6 -32768. 32767. FORMAT "%5.0" /end AXIS_DESCR
/end CHARACTERISTIC
/begin CHARACTERISTIC KL_PLDLEK_MX "Oberer Grenzwert für Leckage-Bestimmung" CURVE 0xa0818678 _REC_CUR_TKL_UW_VV__u2_s2 3.9999 _CNV_R_R_Def_f_sw_b_616_CM 0. 3.9999 FORMAT "%14.5"
 /begin AXIS_DESCR STD_AXIS Nkw _CNV_R_R_Def_n_sw_q_595_CM 6 -32768. 32767. FORMAT "%5.0" /end AXIS_DESCR
/end CHARACTERISTIC
/begin CHARACTERISTIC KL_PLDPUMPMN "Rel. Ladedruck f. Pumpbestimmung" CURVE 0xa08188a0 _REC_CUR_TKL_UW_VV__u2_s2 3.9999 _CNV_R_R_Def_f_sw_b_616_CM 0. 3.9999 FORMAT "%14.5"
 /begin AXIS_DESCR STD_AXIS Nkw _CNV_R_R_Def_n_sw_q_595_CM 8 -32768. 32767. FORMAT "%5.0" /end AXIS_DESCR
/end CHARACTERISTIC
/begin CHARACTERISTIC KL_TABGFIL "Zeitkonstante Filterbank Abgastemperatur" CURVE 0xa081995c _REC_CUR_TKL_UW_VV__u2_u2 65.535 _CNV_R_R_Def_td_uw__663_CM 0. 65.535 /begin AXIS_DESCR STD_AXIS Mszyl _CNV_R_R_Def_ms_uw__594_CM 6 0. 2047.9687 /end AXIS_DESCR /end CHARACTERISTIC
/begin CHARACTERISTIC KL_TDATL_ERR "Verzoegerung f. Reglerfehler" CURVE 0xa08186d8 _REC_CUR_TKL_UW_VV__u1_u2 2.55 _CNV_R_R_Def_td_uw__673_CM 0. 2.55 FORMAT "%5.2"
 /begin AXIS_DESCR STD_AXIS Pu _CNV_R_R_Def_p_sw_q_576_CM 4 0. 2559.9609 FORMAT "%5.2" /end AXIS_DESCR
/end CHARACTERISTIC
/begin CHARACTERISTIC KL_TDOBAKTIV "Aktiv-Zeit Overboost Motordrehzahlabhängig" CURVE 0xa0817300 _REC_CUR_TKL_UW_VV__u1_s2 5.1 _CNV_R_R_Def_td_ub__753_CM 0. 5.1 FORMAT "%5.2"
 /begin AXIS_DESCR STD_AXIS Nkw _CNV_R_R_Def_n_sw_q_595_CM 6 -32768. 32767. FORMAT "%5.0" /end AXIS_DESCR
/end CHARACTERISTIC
/begin CHARACTERISTIC KL_TDOBEND "Verzögerung Ende Overboost Zustand" CURVE 0xa0817314 _REC_CUR_TKL_UW_VV__u1_s2 5.1 _CNV_R_R_Def_td_ub__753_CM 0. 5.1 FORMAT "%5.2"
 /begin AXIS_DESCR STD_AXIS Nkw _CNV_R_R_Def_n_sw_q_595_CM 6 -32768. 32767. FORMAT "%5.0" /end AXIS_DESCR
/end CHARACTERISTIC
/begin CHARACTERISTIC KL_TDOBSPERR "Zeit für Sperre Overboost nach Auslösung" CURVE 0xa08172ec _REC_CUR_TKL_UW_VV__u1_s2 5.1 _CNV_R_R_Def_td_ub__753_CM 0. 5.1 FORMAT "%5.2"
 /begin AXIS_DESCR STD_AXIS Nkw _CNV_R_R_Def_n_sw_q_595_CM 6 -32768. 32767. FORMAT "%5.0" /end AXIS_DESCR
/end CHARACTERISTIC
/begin CHARACTERISTIC KL_TDRFMXOB "Zeit f. Overboost Abregelung" CURVE 0xa08172d0 _REC_CUR_TKL_UW_VV__u2_s2 98.29950000000001 _CNV_R_R_Def_td_uw__673_CM 2.e-002 655.35 FORMAT "%5.2"
 /begin AXIS_DESCR STD_AXIS Nkw _CNV_R_R_Def_n_sw_q_595_CM 6 -32768. 32767. FORMAT "%5.0" /end AXIS_DESCR
/end CHARACTERISTIC
/begin CHARACTERISTIC KL_TVWGKORT "Temperatureinfluss auf Wastegateansteuerung" CURVE 0xa08173e8 _REC_CUR_TKL_UW_VV__s2_s2 99.99844999999999 _CNV_R_R_Def_rel_sw_562_CM -100. 99.9969
 /begin AXIS_DESCR STD_AXIS Tmot_wgtz _CNV_R_R_Def_t_sw_q_579_CM 8 -327.68 327.67 FORMAT "%5.2" /end AXIS_DESCR
/end CHARACTERISTIC
/begin CHARACTERISTIC KL_TVWGKORUB "Batteriekorrektur TV f. Wastegateansteuerung - bauteilbedingt  d. Unterdruckdose" CURVE 0xa081740c _REC_CUR_TKL_UW_VV__u2_u2 1.9999 _CNV_R_R_Def_f_uw_b_590_CM 0. 1.9999 FORMAT "%14.5"
 /begin AXIS_DESCR STD_AXIS Ub _CNV_R_R_Def_u_sb_q_583_CM 4 0. 6173.397 FORMAT "%4.1" /end AXIS_DESCR
/end CHARACTERISTIC
/begin CHARACTERISTIC KL_TVWG_DN "Stellwert -> Tastverhaeltnis f. schliessende Richtung" CURVE 0xa08173a0 _REC_CUR_TKL_UW_VV__u2_u2 99.9984 _CNV_R_R_Def_f_uw_b_555_CM 0. 99.9984 /begin AXIS_DESCR STD_AXIS Atlr2_k _CNV_R_R_Def_f_uw_b_555_CM 8 0. 99.9984 /end AXIS_DESCR /end CHARACTERISTIC
/begin CHARACTERISTIC KL_TVWG_UP "Stellwert -> Tastverhaeltnis f. oeffnende Richtung" CURVE 0xa08173c4 _REC_CUR_TKL_UW_VV__u2_u2 99.9984 _CNV_R_R_Def_f_uw_b_555_CM 0. 99.9984 /begin AXIS_DESCR STD_AXIS Atlr2_k _CNV_R_R_Def_f_uw_b_555_CM 8 0. 99.9984 /end AXIS_DESCR /end CHARACTERISTIC
/begin CHARACTERISTIC KL_WBIAS "Gewichte der Neuronen (verst. Schicht) fuer Biasterm, ATMNN" CURVE 0xa08198e4 _REC_CUR_20_S4_u1 11000000000000. _CNV_R_R_Def_dez_sl_551_CM -1000000000000. 10000000000000. FORMAT "%14.7"
 /begin AXIS_DESCR COM_AXIS Modelle _CNV_R_R_Def_dez_sl_551_CM 15 0. 255. FORMAT "%3.0" AXIS_PTS_REF GAX_ATMNN /end AXIS_DESCR
/end CHARACTERISTIC
/begin CHARACTERISTIC KL_WLA "Gewichte der Neuronen (verst. Schicht) fuer Eingang Lambda, ATMNN" CURVE 0xa08197b8 _REC_CUR_20_S4_u1 11000000000000. _CNV_R_R_Def_dez_sl_551_CM -1000000000000. 10000000000000. FORMAT "%14.7"
 /begin AXIS_DESCR COM_AXIS Modelle _CNV_R_R_Def_dez_sl_551_CM 15 0. 255. FORMAT "%3.0" AXIS_PTS_REF GAX_ATMNN /end AXIS_DESCR
/end CHARACTERISTIC
/begin CHARACTERISTIC KL_WNKW "Gewichte der Neuronen (verst. Schicht) fuer Eingang Drehzahl, ATMNN" CURVE 0xa08197f4 _REC_CUR_20_S4_u1 11000000000000. _CNV_R_R_Def_dez_sl_551_CM -1000000000000. 10000000000000. FORMAT "%14.7"
 /begin AXIS_DESCR COM_AXIS Modelle _CNV_R_R_Def_dez_sl_551_CM 15 0. 255. FORMAT "%3.0" AXIS_PTS_REF GAX_ATMNN /end AXIS_DESCR
/end CHARACTERISTIC
/begin CHARACTERISTIC KL_WOUT "Gewichte der Neuronen der Ausgangschicht, ATMNN" CURVE 0xa0819920 _REC_CUR_20_S4_u1 11000000000000. _CNV_R_R_Def_dez_sl_551_CM -1000000000000. 10000000000000. FORMAT "%14.7"
 /begin AXIS_DESCR COM_AXIS Modelle _CNV_R_R_Def_dez_sl_551_CM 15 0. 255. FORMAT "%3.0" AXIS_PTS_REF GAX_ATMNN /end AXIS_DESCR
/end CHARACTERISTIC
/begin CHARACTERISTIC KL_WRF "Gewichte der Neuronen (verst. Schicht) fuer Eingang Relative Fuellung, ATMNN" CURVE 0xa0819830 _REC_CUR_20_S4_u1 11000000000000. _CNV_R_R_Def_dez_sl_551_CM -1000000000000. 10000000000000. FORMAT "%14.7"
 /begin AXIS_DESCR COM_AXIS Modelle _CNV_R_R_Def_dez_sl_551_CM 15 0. 255. FORMAT "%3.0" AXIS_PTS_REF GAX_ATMNN /end AXIS_DESCR
/end CHARACTERISTIC
/begin CHARACTERISTIC KL_WVSA "Gewichte der Neuronen (verst. Schicht) fuer Eingang Auslassspreizung, ATMNN" CURVE 0xa08198a8 _REC_CUR_20_S4_u1 11000000000000. _CNV_R_R_Def_dez_sl_551_CM -1000000000000. 10000000000000. FORMAT "%14.7"
 /begin AXIS_DESCR COM_AXIS Modelle _CNV_R_R_Def_dez_sl_551_CM 15 0. 255. FORMAT "%3.0" AXIS_PTS_REF GAX_ATMNN /end AXIS_DESCR
/end CHARACTERISTIC
/begin CHARACTERISTIC KL_WVSE "Gewichte der Neuronen (verst. Schicht) fuer Eingang Einlassspreizung, ATMNN" CURVE 0xa081986c _REC_CUR_20_S4_u1 11000000000000. _CNV_R_R_Def_dez_sl_551_CM -1000000000000. 10000000000000. FORMAT "%14.7"
 /begin AXIS_DESCR COM_AXIS Modelle _CNV_R_R_Def_dez_sl_551_CM 15 0. 255. FORMAT "%3.0" AXIS_PTS_REF GAX_ATMNN /end AXIS_DESCR
/end CHARACTERISTIC
/begin CHARACTERISTIC KL_WZW "Gewichte der Neuronen (verst. Schicht) fuer Eingang Zuendwinkel, ATMNN" CURVE 0xa081977c _REC_CUR_20_S4_u1 11000000000000. _CNV_R_R_Def_dez_sl_551_CM -1000000000000. 10000000000000. FORMAT "%14.7"
 /begin AXIS_DESCR COM_AXIS Modelle _CNV_R_R_Def_dez_sl_551_CM 15 0. 255. FORMAT "%3.0" AXIS_PTS_REF GAX_ATMNN /end AXIS_DESCR
/end CHARACTERISTIC
/begin CHARACTERISTIC KL_ZK_EXO "Zeitkonstante Filter Abgastemp. nach Kat" CURVE 0xa081a284 _REC_CUR_TKL_UW_VV__u2_u2 5. _CNV_R_R_Def_td_uw__740_CM 0. 5. FORMAT "%14.5"
 /begin AXIS_DESCR STD_AXIS Mszyl_atm _CNV_R_R_Def_ms_uw__594_CM 6 0. 2047.9687 /end AXIS_DESCR
/end CHARACTERISTIC
/begin CHARACTERISTIC KL_ZK_EXOIK "Zeitkonstante Filter Abgastemp. im Kat" CURVE 0xa081a1f8 _REC_CUR_TKL_UW_VV__u2_u2 5. _CNV_R_R_Def_td_uw__740_CM 0. 5. FORMAT "%14.5"
 /begin AXIS_DESCR STD_AXIS Mszyl_atm _CNV_R_R_Def_ms_uw__594_CM 6 0. 2047.9687 /end AXIS_DESCR
/end CHARACTERISTIC
/begin CHARACTERISTIC KL_ZK_NK "Zeitkonstante Filter Abgastemp. nach Kat" CURVE 0xa081a548 _REC_CUR_TKL_UW_VV__u2_u2 65.535 _CNV_R_R_Def_td_uw__663_CM 0. 65.535 /begin AXIS_DESCR STD_AXIS Mszyl _CNV_R_R_Def_ms_uw__594_CM 6 0. 2047.9687 /end AXIS_DESCR /end CHARACTERISTIC
/begin CHARACTERISTIC KL_ZK_NL1 "Zeitkonstante Filter Abgastemp. nach Lader 1" CURVE 0xa081a5d4 _REC_CUR_TKL_UW_VV__u2_u2 65.535 _CNV_R_R_Def_td_uw__663_CM 0. 65.535 /begin AXIS_DESCR STD_AXIS Mszyl _CNV_R_R_Def_ms_uw__594_CM 6 0. 2047.9687 /end AXIS_DESCR /end CHARACTERISTIC
/begin CHARACTERISTIC KL_ZK_NL2 "Zeitkonstante Filter Abgastemp. nach Lader 2" CURVE 0xa081a5f0 _REC_CUR_TKL_UW_VV__u2_u2 65.535 _CNV_R_R_Def_td_uw__663_CM 0. 65.535 /begin AXIS_DESCR STD_AXIS Mszyl _CNV_R_R_Def_ms_uw__594_CM 6 0. 2047.9687 /end AXIS_DESCR /end CHARACTERISTIC
/begin CHARACTERISTIC KL_ZK_VK1 "Zeitkonstante Filter Abgastemp. vor Kat 1" CURVE 0xa081a564 _REC_CUR_TKL_UW_VV__u2_u2 65.535 _CNV_R_R_Def_td_uw__663_CM 0. 65.535 /begin AXIS_DESCR STD_AXIS Mszyl _CNV_R_R_Def_ms_uw__594_CM 6 0. 2047.9687 /end AXIS_DESCR /end CHARACTERISTIC
/begin CHARACTERISTIC KL_ZK_VK2 "Zeitkonstante Filter Abgastemp. vor Kat 1" CURVE 0xa081a580 _REC_CUR_TKL_UW_VV__u2_u2 65.535 _CNV_R_R_Def_td_uw__663_CM 0. 65.535 /begin AXIS_DESCR STD_AXIS Mszyl _CNV_R_R_Def_ms_uw__594_CM 6 0. 2047.9687 /end AXIS_DESCR /end CHARACTERISTIC
/begin CHARACTERISTIC KL_ZK_VL1 "Zeitkonstante Filter Abgastemp. vor Lader 1" CURVE 0xa081a59c _REC_CUR_TKL_UW_VV__u2_u2 65.535 _CNV_R_R_Def_td_uw__663_CM 0. 65.535 /begin AXIS_DESCR STD_AXIS Mszyl _CNV_R_R_Def_ms_uw__594_CM 6 0. 2047.9687 /end AXIS_DESCR /end CHARACTERISTIC
/begin CHARACTERISTIC KL_ZK_VL2 "Zeitkonstante Filter Abgastemp. vor Lader 2" CURVE 0xa081a5b8 _REC_CUR_TKL_UW_VV__u2_u2 65.535 _CNV_R_R_Def_td_uw__663_CM 0. 65.535 /begin AXIS_DESCR STD_AXIS Mszyl _CNV_R_R_Def_ms_uw__594_CM 6 0. 2047.9687 /end AXIS_DESCR /end CHARACTERISTIC
/begin CHARACTERISTIC K_ATLAD_MN "Atl-Regler Adaptionsfaktor - unterer Grenzwert" VALUE 0xa081863c _REC_VAL_20_s2 1.9999 _CNV_R_R_Def_f_sw_b_616_CM 0. 1.9999 FORMAT "%14.5" /end CHARACTERISTIC
/begin CHARACTERISTIC K_ATLAD_MX "Atl-Regler Adaptionsfaktor - oberer Grenzwert" VALUE 0xa081863e _REC_VAL_20_s2 1.9999 _CNV_R_R_Def_f_sw_b_616_CM 0. 1.9999 FORMAT "%14.5" /end CHARACTERISTIC
/begin CHARACTERISTIC K_ATLERR_UBMIN "Ub Min-Schwelle für ATL Error" VALUE 0xa081866e _REC_VAL_20_u2 123.46794 _CNV_R_R_Def_u_sb_q_583_CM 0. 6173.397 FORMAT "%4.1" /end CHARACTERISTIC
/begin CHARACTERISTIC K_ATMNN_ANZ "Anzahl Neuronen fuer ATMNN" VALUE 0xa0819754 _REC_VAL_20_u1 15. _CNV_R_R_Def_dez_sl_551_CM 0. 15. FORMAT "%3.0" /end CHARACTERISTIC
/begin CHARACTERISTIC K_ATMNN_EIN "Anzahl Eingaenge fuer ATMNN" VALUE 0xa0819755 _REC_VAL_20_u1 6. _CNV_R_R_Def_dez_sl_551_CM 0. 6. FORMAT "%3.0" /end CHARACTERISTIC
/begin CHARACTERISTIC K_ATMNOK_RES "Applikationseingriff Ruecksetzen Rohrwandtemperatur" VALUE 0xa0819a1c _REC_VAL_20_u1 1. _CNV_R_R_Def_dez_sl_551_CM 0. 1. FORMAT "%3.0" /end CHARACTERISTIC
/begin CHARACTERISTIC K_ATM_CPR1 "Absolute Waermekapazitaet Rohr vor Hauptkat = cp_Rohr * Masse Rohr Hauptkat" VALUE 0xa081a1b4 _REC_VAL_20_u2 163.835 _CNV_R_R_Def_cxm_uw_755_CM 0.25 16383.75 FORMAT "%5.2" /end CHARACTERISTIC
/begin CHARACTERISTIC K_ATM_CPR10 "Absolute Waermekapazitaet Rohr nach Kat = cp_Rohr * Masse Rohr Kat" VALUE 0xa081a1ca _REC_VAL_20_u2 163.835 _CNV_R_R_Def_cxm_uw_755_CM 0.25 16383.75 FORMAT "%5.2" /end CHARACTERISTIC
/begin CHARACTERISTIC K_ATM_CPR11 "Absolute Waermekapazitaet Rohr nach Kat = cp_Rohr * Masse Rohr Kat" VALUE 0xa081a1e0 _REC_VAL_20_u2 163.835 _CNV_R_R_Def_cxm_uw_755_CM 0.25 16383.75 FORMAT "%5.2" /end CHARACTERISTIC
/begin CHARACTERISTIC K_ATM_CPR11A "Absolute Waermekapazitaet Rohr nach Kat = cp_Rohr * Masse Rohr Kat" VALUE 0xa081a1e2 _REC_VAL_20_u2 163.835 _CNV_R_R_Def_cxm_uw_755_CM 0.25 16383.75 FORMAT "%5.2" /end CHARACTERISTIC
/begin CHARACTERISTIC K_ATM_CPR12 "Absolute Waermekapazitaet Rohr 12" VALUE 0xa081a1e4 _REC_VAL_20_u2 163.835 _CNV_R_R_Def_cxm_uw_755_CM 0.25 16383.75 FORMAT "%5.2" /end CHARACTERISTIC
/begin CHARACTERISTIC K_ATM_CPR12A "Absolute Waermekapazitaet Rohr 12a" VALUE 0xa081a1e6 _REC_VAL_20_u2 163.835 _CNV_R_R_Def_cxm_uw_755_CM 0.25 16383.75 FORMAT "%5.2" /end CHARACTERISTIC
/begin CHARACTERISTIC K_ATM_CPR13 "Absolute Waermekapazitaet Rohr 13" VALUE 0xa081a1e8 _REC_VAL_20_u2 163.835 _CNV_R_R_Def_cxm_uw_755_CM 0.25 16383.75 FORMAT "%5.2" /end CHARACTERISTIC
/begin CHARACTERISTIC K_ATM_CPR14 "Absolute Waermekapazitaet Rohr 14" VALUE 0xa081a1ea _REC_VAL_20_u2 163.835 _CNV_R_R_Def_cxm_uw_755_CM 0.25 16383.75 FORMAT "%5.2" /end CHARACTERISTIC
/begin CHARACTERISTIC K_ATM_CPR14A "Absolute Waermekapazitaet Rohr 14a" VALUE 0xa081a1ec _REC_VAL_20_u2 163.835 _CNV_R_R_Def_cxm_uw_755_CM 0.25 16383.75 FORMAT "%5.2" /end CHARACTERISTIC
/begin CHARACTERISTIC K_ATM_CPR15 "Absolute Waermekapazitaet Rohr 15" VALUE 0xa081a1ee _REC_VAL_20_u2 163.835 _CNV_R_R_Def_cxm_uw_755_CM 0.25 16383.75 FORMAT "%5.2" /end CHARACTERISTIC
/begin CHARACTERISTIC K_ATM_CPR16 "Absolute Waermekapazitaet Rohr 16" VALUE 0xa081a1f0 _REC_VAL_20_u2 163.835 _CNV_R_R_Def_cxm_uw_755_CM 0.25 16383.75 FORMAT "%5.2" /end CHARACTERISTIC
/begin CHARACTERISTIC K_ATM_CPR2 "Absolute Waermekapazitaet Rohr vor Hauptkat = cp_Rohr * Masse Rohr Hauptkat" VALUE 0xa081a1b6 _REC_VAL_20_u2 163.835 _CNV_R_R_Def_cxm_uw_755_CM 0.25 16383.75 FORMAT "%5.2" /end CHARACTERISTIC
/begin CHARACTERISTIC K_ATM_CPR3 "Absolute Waermekapazitaet Rohr vor Hauptkat = cp_Rohr * Masse Rohr Hauptkat" VALUE 0xa081a1b8 _REC_VAL_20_u2 163.835 _CNV_R_R_Def_cxm_uw_755_CM 0.25 16383.75 FORMAT "%5.2" /end CHARACTERISTIC
/begin CHARACTERISTIC K_ATM_CPR4 "Absolute Waermekapazitaet Rohr vor Hauptkat = cp_Rohr * Masse Rohr Hauptkat" VALUE 0xa081a1ba _REC_VAL_20_u2 163.835 _CNV_R_R_Def_cxm_uw_755_CM 0.25 16383.75 FORMAT "%5.2" /end CHARACTERISTIC
/begin CHARACTERISTIC K_ATM_CPR5 "Absolute Waermekapazitaet Rohr vor Hauptkat = cp_Rohr * Masse Rohr Hauptkat" VALUE 0xa081a1bc _REC_VAL_20_u2 163.835 _CNV_R_R_Def_cxm_uw_755_CM 0.25 16383.75 FORMAT "%5.2" /end CHARACTERISTIC
/begin CHARACTERISTIC K_ATM_CPR6 "Absolute Waermekapazitaet Rohr vor Hauptkat = cp_Rohr * Masse Rohr Hauptkat" VALUE 0xa081a1be _REC_VAL_20_u2 163.835 _CNV_R_R_Def_cxm_uw_755_CM 0.25 16383.75 FORMAT "%5.2" /end CHARACTERISTIC
/begin CHARACTERISTIC K_ATM_CPR7 "Absolute Waermekapazitaet Rohr vor Hauptkat = cp_Rohr * Masse Rohr Hauptkat" VALUE 0xa081a1c4 _REC_VAL_20_u2 163.835 _CNV_R_R_Def_cxm_uw_755_CM 0.25 16383.75 FORMAT "%5.2" /end CHARACTERISTIC
/begin CHARACTERISTIC K_ATM_CPR7A "Absolute Waermekapazitaet Rohr vor Hauptkat = cp_Rohr * Masse Rohr Hauptkat" VALUE 0xa081a1c0 _REC_VAL_20_u2 163.835 _CNV_R_R_Def_cxm_uw_755_CM 0.25 16383.75 FORMAT "%5.2" /end CHARACTERISTIC
/begin CHARACTERISTIC K_ATM_CPR8 "Absolute Waermekapazitaet Rohr vor Hauptkat = cp_Rohr * Masse Rohr Hauptkat" VALUE 0xa081a1c6 _REC_VAL_20_u2 163.835 _CNV_R_R_Def_cxm_uw_755_CM 0.25 16383.75 FORMAT "%5.2" /end CHARACTERISTIC
/begin CHARACTERISTIC K_ATM_CPR8A "Absolute Waermekapazitaet Rohr vor Hauptkat = cp_Rohr * Masse Rohr Hauptkat" VALUE 0xa081a1c2 _REC_VAL_20_u2 163.835 _CNV_R_R_Def_cxm_uw_755_CM 0.25 16383.75 FORMAT "%5.2" /end CHARACTERISTIC
/begin CHARACTERISTIC K_ATM_CPR9 "Absolute Waermekapazitaet Rohr nach Kat = cp_Rohr * Masse Rohr Kat" VALUE 0xa081a1c8 _REC_VAL_20_u2 163.835 _CNV_R_R_Def_cxm_uw_755_CM 0.25 16383.75 FORMAT "%5.2" /end CHARACTERISTIC
/begin CHARACTERISTIC K_ATM_CPRWG "Absolute Waermekapazitaet Wastegate = cp_Rohr * Masse Rohr Hauptkat" VALUE 0xa081a1b2 _REC_VAL_20_u2 163.835 _CNV_R_R_Def_cxm_uw_755_CM 0.25 16383.75 FORMAT "%5.2" /end CHARACTERISTIC
/begin CHARACTERISTIC K_ATM_DESUAPP "Applikationswert Temperaturerhoehung fuer Entschwefelung" VALUE 0xa081a1de _REC_VAL_20_s2 131.07 _CNV_R_R_Def_t_sw_q_578_CM -3276.8 3276.7 FORMAT "%4.1" /end CHARACTERISTIC
/begin CHARACTERISTIC K_ATM_FTANS "Gewichtung Referenztemperatur" VALUE 0xa081975b _REC_VAL_20_u1 1. _CNV_R_R_Def_f_ub_b_619_CM 0. 1. /end CHARACTERISTIC
/begin CHARACTERISTIC K_ATM_FTANS_R1 "Gewichtungsfaktor zwischen Tans und Tumg fuer Motorraumtemperatur Bank1" VALUE 0xa0819a12 _REC_VAL_20_u1 1.9921 _CNV_R_R_Def_f_ub_b_613_CM 0. 1.9921 /end CHARACTERISTIC
/begin CHARACTERISTIC K_ATM_FTANS_R10 "Gewichtungsfaktor zwischen Tans und Tumg fuer Motorraumtemperatur nach Kat Bank2" VALUE 0xa0819a17 _REC_VAL_20_u1 1.9921 _CNV_R_R_Def_f_ub_b_613_CM 0. 1.9921 /end CHARACTERISTIC
/begin CHARACTERISTIC K_ATM_FTANS_R4 "Gewichtungsfaktor zwischen Tans und Tumg fuer Motorraumtemperatur Bank2" VALUE 0xa0819a13 _REC_VAL_20_u1 1.9921 _CNV_R_R_Def_f_ub_b_613_CM 0. 1.9921 /end CHARACTERISTIC
/begin CHARACTERISTIC K_ATM_FTANS_R7 "Gewichtungsfaktor zwischen Tans und Tumg fuer Motorraumtemperatur Mischstrecke Bank1" VALUE 0xa0819a14 _REC_VAL_20_u1 1.9921 _CNV_R_R_Def_f_ub_b_613_CM 0. 1.9921 /end CHARACTERISTIC
/begin CHARACTERISTIC K_ATM_FTANS_R8 "Gewichtungsfaktor zwischen Tans und Tumg fuer Motorraumtemperatur Mischstrecke Bank2" VALUE 0xa0819a15 _REC_VAL_20_u1 1.9921 _CNV_R_R_Def_f_ub_b_613_CM 0. 1.9921 /end CHARACTERISTIC
/begin CHARACTERISTIC K_ATM_FTANS_R9 "Gewichtungsfaktor zwischen Tans und Tumg fuer Motorraumtemperatur nach Kat Bank1" VALUE 0xa0819a16 _REC_VAL_20_u1 1.9921 _CNV_R_R_Def_f_ub_b_613_CM 0. 1.9921 /end CHARACTERISTIC
/begin CHARACTERISTIC K_ATM_FTANS_TMR "Gewichtungsfaktor fuer Tans zur Berechnung der Motorraumtemperaturen" VALUE 0xa0819a11 _REC_VAL_20_u1 1.9921 _CNV_R_R_Def_f_ub_b_613_CM 0. 1.9921 /end CHARACTERISTIC
/begin CHARACTERISTIC K_ATM_FTMOT "Faktor des Motortemperatureinflusses auf Waermeverluste Hauptkat" VALUE 0xa0819a18 _REC_VAL_20_u1 2.55 _CNV_R_R_Def_cxm_ub_756_CM 0. 2.55 FORMAT "%5.2" /end CHARACTERISTIC
/begin CHARACTERISTIC K_ATM_LKLPS "Geschwindigkeits-Obergrenze fuer Luefterklappensteuerung" VALUE 0xa0819a06 _REC_VAL_20_u2 100.8 _CNV_R_R_Def_v_uw_q_726_CM 0. 360. FORMAT "%5.0" /end CHARACTERISTIC
/begin CHARACTERISTIC K_ATM_RESET "Applikationseingriff Ruecksetzen Rohrwandtemperatur" VALUE 0xa0819a19 _REC_VAL_20_u1 1. _CNV_R_R_Def_dez_sl_551_CM 0. 1. FORMAT "%3.0" /end CHARACTERISTIC
/begin CHARACTERISTIC K_ATM_SAIK_S "Haltezeit der Ausschaltverzoegerung im Kat fuer B_schicht" VALUE 0xa0819f8d _REC_VAL_20_u1 51. _CNV_R_R_Def_td_uw__718_CM 0. 51. FORMAT "%4.1" /end CHARACTERISTIC
/begin CHARACTERISTIC K_ATM_SA_S "Haltezeit der Ausschaltverzoegerung fuer B_schicht" VALUE 0xa0819f8c _REC_VAL_20_u1 51. _CNV_R_R_Def_td_uw__718_CM 0. 51. FORMAT "%4.1" /end CHARACTERISTIC
/begin CHARACTERISTIC K_ATM_TABGMX "Obergrenze fuer Abgastemperatur aus ATMNN" VALUE 0xa0819a08 _REC_VAL_20_s2 131.07 _CNV_R_R_Def_t_sw_q_578_CM -3276.8 3276.7 FORMAT "%4.1" /end CHARACTERISTIC
/begin CHARACTERISTIC K_ATM_TANSREF "Referenztemperatur bei der das KNN trainiert wurde" VALUE 0xa081975e _REC_VAL_20_s2 131.07 _CNV_R_R_Def_t_sw_q_578_CM -3276.8 3276.7 FORMAT "%4.1" /end CHARACTERISTIC
/begin CHARACTERISTIC K_ATM_TMOT "Referenz-Kuehlwassertemperatur für zusaetzl. Waermeuebergang Rohr an Umgebung" VALUE 0xa0819a0a _REC_VAL_20_s2 98.30250000000001 _CNV_R_R_Def_t_sw_q_579_CM -327.68 327.67 FORMAT "%5.2" /end CHARACTERISTIC
/begin CHARACTERISTIC K_ATM_UEB_CON "Koeffizient Sensormodell, konstanter Anteil" VALUE 0xa081a1d8 _REC_VAL_20_s2 131.07 _CNV_R_R_Def_t_sw_q_578_CM -3276.8 3276.7 FORMAT "%4.1" /end CHARACTERISTIC
/begin CHARACTERISTIC K_ATM_UEB_LA "Koeffizient Sensormodell fuer Eingang La_ist1" VALUE 0xa081a1d0 _REC_VAL_20_s2 63.999 _CNV_R_R_Def_f_sw_b_556_CM -32. 31.999 FORMAT "%7.4" /end CHARACTERISTIC
/begin CHARACTERISTIC K_ATM_UEB_LA2 "Koeffizient Sensormodell fuer Eingang La_ist2" VALUE 0xa081a1d2 _REC_VAL_20_s2 63.999 _CNV_R_R_Def_f_sw_b_556_CM -32. 31.999 FORMAT "%7.4" /end CHARACTERISTIC
/begin CHARACTERISTIC K_ATM_UEB_MA "Koeffizient Sensormodell fuer Eingang Msagr" VALUE 0xa081a1d4 _REC_VAL_20_s2 63.999 _CNV_R_R_Def_f_sw_b_556_CM -32. 31.999 FORMAT "%7.4" /end CHARACTERISTIC
/begin CHARACTERISTIC K_ATM_UEB_MS "Koeffizient Sensormodell fuer Eingang Msyzl" VALUE 0xa081a1cc _REC_VAL_20_s2 63.999 _CNV_R_R_Def_f_sw_b_556_CM -32. 31.999 FORMAT "%7.4" /end CHARACTERISTIC
/begin CHARACTERISTIC K_ATM_UEB_T "Koeffizient Sensormodell fuer Eingang Sensortemperatur" VALUE 0xa081a1d6 _REC_VAL_20_s2 63.999 _CNV_R_R_Def_f_sw_b_556_CM -32. 31.999 FORMAT "%7.4" /end CHARACTERISTIC
/begin CHARACTERISTIC K_ATM_UEB_V "Koeffizient Sensormodell fuer Eingang V" VALUE 0xa081a1ce _REC_VAL_20_s2 63.999 _CNV_R_R_Def_f_sw_b_556_CM -32. 31.999 FORMAT "%7.4" /end CHARACTERISTIC
/begin CHARACTERISTIC K_BSDELT1 "Delta Solltemperatur Abgas fuer Einschaltbedingung Regler" VALUE 0xa0819448 _REC_VAL_20_s2 131.07 _CNV_R_R_Def_t_sw_q_578_CM -3276.8 3276.7 FORMAT "%4.1" /end CHARACTERISTIC
/begin CHARACTERISTIC K_BSDELT2 "Delta Solltemperatur Abgas fuer Ausschaltbedingung Regler" VALUE 0xa081944a _REC_VAL_20_s2 131.07 _CNV_R_R_Def_t_sw_q_578_CM -3276.8 3276.7 FORMAT "%4.1" /end CHARACTERISTIC
/begin CHARACTERISTIC K_BSDELT3 "Delta Solltemperatur Abgas fuer Regler Bank 2" VALUE 0xa0819436 _REC_VAL_20_s2 131.07 _CNV_R_R_Def_t_sw_q_578_CM -3276.8 3276.7 FORMAT "%4.1" /end CHARACTERISTIC
/begin CHARACTERISTIC K_BSDELT4 "Delta Solltemperatur Abgas fuer Regler Bank 2 NOx-Kat" VALUE 0xa0819438 _REC_VAL_20_s2 131.07 _CNV_R_R_Def_t_sw_q_578_CM -3276.8 3276.7 FORMAT "%4.1" /end CHARACTERISTIC
/begin CHARACTERISTIC K_BSDELT5 "Delta Solltemperatur Abgas fuer Einschaltbedingung Regler Bank 1 NOx-Kat" VALUE 0xa081944c _REC_VAL_20_s2 131.07 _CNV_R_R_Def_t_sw_q_578_CM -3276.8 3276.7 FORMAT "%4.1" /end CHARACTERISTIC
/begin CHARACTERISTIC K_BSDELT6 "Delta Solltemperatur Abgas fuer Ausschaltbedingung Regler Bank 1 NOx-Kat" VALUE 0xa081944e _REC_VAL_20_s2 131.07 _CNV_R_R_Def_t_sw_q_578_CM -3276.8 3276.7 FORMAT "%4.1" /end CHARACTERISTIC
/begin CHARACTERISTIC K_BSDELT7 "Delta Solltemperatur Abgas fuer Einschaltbedingung Regler Bank 2 NOx-Kat" VALUE 0xa0819450 _REC_VAL_20_s2 131.07 _CNV_R_R_Def_t_sw_q_578_CM -3276.8 3276.7 FORMAT "%4.1" /end CHARACTERISTIC
/begin CHARACTERISTIC K_BSDELT8 "Delta Solltemperatur Abgas fuer Ausschaltbedingung Regler Bank 2 NOx-Kat" VALUE 0xa0819452 _REC_VAL_20_s2 131.07 _CNV_R_R_Def_t_sw_q_578_CM -3276.8 3276.7 FORMAT "%4.1" /end CHARACTERISTIC
/begin CHARACTERISTIC K_BSDELT_DESU "BS-Sollwerttemperaturabsenkung beim Desulfatisieren" VALUE 0xa0819446 _REC_VAL_20_s2 131.07 _CNV_R_R_Def_t_sw_q_578_CM -3276.8 3276.7 FORMAT "%4.1" /end CHARACTERISTIC
/begin CHARACTERISTIC K_BSLAMX "Lambda-Grenzwert" VALUE 0xa0819760 _REC_VAL_20_u2 15.9997 _CNV_R_R_Def_f_uw_b_559_CM 0. 15.9997 FORMAT "%7.4" /end CHARACTERISTIC
/begin CHARACTERISTIC K_BS_D "D-Anteil PID-Regler Bauteilschutz" VALUE 0xa0819462 _REC_VAL_20_u2 63.99900000000001 _CNV_R_R_Def_f_uw_b_617_CM 0. 63.999 FORMAT "%7.4" /end CHARACTERISTIC
/begin CHARACTERISTIC K_BS_D_NOK "D-Anteil PID-Regler Bauteilschutz NOx-Kat" VALUE 0xa0819464 _REC_VAL_20_u2 63.99900000000001 _CNV_R_R_Def_f_uw_b_617_CM 0. 63.999 FORMAT "%7.4" /end CHARACTERISTIC
/begin CHARACTERISTIC K_BS_I "I-Anteil PID-Regler Bauteilschutz" VALUE 0xa0819460 _REC_VAL_20_u2 1.9999 _CNV_R_R_Def_f_uw_b_590_CM 0. 1.9999 FORMAT "%14.5" /end CHARACTERISTIC
/begin CHARACTERISTIC K_BS_IMN "Minimalbegrenzung I-Anteil Regler Bauteilschutz" VALUE 0xa081946a _REC_VAL_20_s2 15.9997 _CNV_R_R_Def_f_sw_b_592_CM -8. 7.9997 FORMAT "%7.4" /end CHARACTERISTIC
/begin CHARACTERISTIC K_BS_IMX "Maximalbegrenzung I-Anteil Regler Bauteilschutz" VALUE 0xa081946c _REC_VAL_20_s2 15.9997 _CNV_R_R_Def_f_sw_b_592_CM -8. 7.9997 FORMAT "%7.4" /end CHARACTERISTIC
/begin CHARACTERISTIC K_BS_MN "Lambda-Minimalwert fuer Bauteilschutz" VALUE 0xa081945c _REC_VAL_20_u2 15.9997 _CNV_R_R_Def_f_uw_b_559_CM 0. 15.9997 FORMAT "%7.4" /end CHARACTERISTIC
/begin CHARACTERISTIC K_BS_P "P-Anteil PID-Regler Bauteilschutz" VALUE 0xa081945e _REC_VAL_20_u2 63.99900000000001 _CNV_R_R_Def_f_uw_b_617_CM 0. 63.999 FORMAT "%7.4" /end CHARACTERISTIC
/begin CHARACTERISTIC K_BS_REGMN "Minimalbegrenzung Reglerausgang Bauteilschutz" VALUE 0xa0819466 _REC_VAL_20_s2 15.9997 _CNV_R_R_Def_f_sw_b_592_CM -8. 7.9997 FORMAT "%7.4" /end CHARACTERISTIC
/begin CHARACTERISTIC K_BS_REGMX "Maximalbegrenzung Reglerausgang Bauteilschutz" VALUE 0xa0819468 _REC_VAL_20_s2 15.9997 _CNV_R_R_Def_f_sw_b_592_CM -8. 7.9997 FORMAT "%7.4" /end CHARACTERISTIC
/begin CHARACTERISTIC K_BS_ZKININN "Filterparameter fuer Initialisierungswert Vorsteuerfilter" VALUE 0xa081945a _REC_VAL_20_u2 65.535 _CNV_R_R_Def_td_uw__663_CM 0. 65.535 /end CHARACTERISTIC
/begin CHARACTERISTIC K_DELAY_SA "Zeit fuer Verzoegerung B_sa (fallende Flanke)" VALUE 0xa081a1f2 _REC_VAL_20_u1 51. _CNV_R_R_Def_td_uw__718_CM 0. 51. FORMAT "%4.1" /end CHARACTERISTIC
/begin CHARACTERISTIC K_DELAY_SAV "Zeitverzoegerung fuer SA-Verbot-Ruecknahme" VALUE 0xa081a1f3 _REC_VAL_20_u1 51. _CNV_R_R_Def_td_uw__718_CM 0. 51. FORMAT "%4.1" /end CHARACTERISTIC
/begin CHARACTERISTIC K_DTNN "Delta Solltemperatur Abgas fuer Befragung KNN" VALUE 0xa081975c _REC_VAL_20_s2 131.07 _CNV_R_R_Def_t_sw_q_578_CM -3276.8 3276.7 FORMAT "%4.1" /end CHARACTERISTIC
/begin CHARACTERISTIC K_FATLRI_OFS "Offset auf Faktor f. Verhältnis I-Anteil d. Regelung zur Vorsteuerung" VALUE 0xa0818640 _REC_VAL_20_s2 3.9999 _CNV_R_R_Def_f_sw_b_616_CM -2. 1.9999 FORMAT "%14.5" /end CHARACTERISTIC
/begin CHARACTERISTIC K_FEXODESU "Ersatzfaktor Berechnung Exothermie im NoX-Kat bei Desulfatisierung" VALUE 0xa0819f8f _REC_VAL_20_u1 2.55 _CNV_R_R_Def_lf_ub__670_CM 0. 2.55 /end CHARACTERISTIC
/begin CHARACTERISTIC K_FKWG1DIAG "Filterkonstante Wastegate Plausibilität" VALUE 0xa08186ec _REC_VAL_20_u2 0.9999847412109381 _CNV_R_R_Def_f_uw_b_571_CM 0. 0.9999847412109381 FORMAT "%14.5" /end CHARACTERISTIC
/begin CHARACTERISTIC K_FPLDSAD_MN "Min. Aufladefaktor f. Adaptiondurchfuehrung" VALUE 0xa0818650 _REC_VAL_20_u2 3.9999 _CNV_R_R_Def_f_sw_b_616_CM 0. 3.9999 FORMAT "%14.5" /end CHARACTERISTIC
/begin CHARACTERISTIC K_FPLDSAD_MX "Max. Aufladefaktor f. Adaptiondurchfuehrung" VALUE 0xa0818652 _REC_VAL_20_u2 3.9999 _CNV_R_R_Def_f_sw_b_616_CM 0. 3.9999 FORMAT "%14.5" /end CHARACTERISTIC
/begin CHARACTERISTIC K_IKATLAD "Intergrierbeiwert" VALUE 0xa0818654 _REC_VAL_20_u2 0.9999847412109381 _CNV_R_R_Def_f_uw_b_571_CM 0. 0.9999847412109381 FORMAT "%14.5" /end CHARACTERISTIC
/begin CHARACTERISTIC K_LABSOFF "Lambda-Offset fuer Vergleic von La_vst mit La_bas" VALUE 0xa0819454 _REC_VAL_20_s2 15.9997 _CNV_R_R_Def_f_sw_b_592_CM -8. 7.9997 FORMAT "%7.4" /end CHARACTERISTIC
/begin CHARACTERISTIC K_LA_BSPASS_FETT "Lambda-Sollwert bei deaktivierten fetten Bauteilschutz, Bank 1" VALUE 0xa0819456 _REC_VAL_20_u2 15.9997 _CNV_R_R_Def_f_uw_b_559_CM 0. 15.9997 FORMAT "%7.4" /end CHARACTERISTIC
/begin CHARACTERISTIC K_LA_BSPASS_MAGER "Lambda-Sollwert bei deaktivierten mageren Bauteilschutz, Bank 1" VALUE 0xa0819458 _REC_VAL_20_u2 15.9997 _CNV_R_R_Def_f_uw_b_559_CM 0. 15.9997 FORMAT "%7.4" /end CHARACTERISTIC
/begin CHARACTERISTIC K_MSVLDLEKF "Min. Änderung Massenstrom vor Verdichter bei Leckage" VALUE 0xa081865a _REC_VAL_20_s2 102.398435 _CNV_R_R_Def_ms_uw__594_CM -1024. 1023.9687 /end CHARACTERISTIC
/begin CHARACTERISTIC K_MSVLDPMPMN "Min. Änderung Massenstrom vor Verdichter bei pumpen" VALUE 0xa0818894 _REC_VAL_20_s2 102.398435 _CNV_R_R_Def_ms_uw__594_CM -1024. 1023.9687 /end CHARACTERISTIC
/begin CHARACTERISTIC K_MSVLDPMPMX "Max. Änderung Massenstrom vor Verdichter bei pumpen" VALUE 0xa0818896 _REC_VAL_20_s2 102.398435 _CNV_R_R_Def_ms_uw__594_CM -1024. 1023.9687 /end CHARACTERISTIC
/begin CHARACTERISTIC K_NKWAD_MN "Untere Drehzahlschwelle f. Adaption" VALUE 0xa0818642 _REC_VAL_20_s2 0. _CNV_R_R_Def_n_sw_q_595_CM -32768. 32767. FORMAT "%5.0" /end CHARACTERISTIC
/begin CHARACTERISTIC K_NKWAD_MX "Obere Drehzahlschwelle f. Adaption" VALUE 0xa0818644 _REC_VAL_20_s2 0. _CNV_R_R_Def_n_sw_q_595_CM -32768. 32767. FORMAT "%5.0" /end CHARACTERISTIC
/begin CHARACTERISTIC K_NKWLEK_MN "Untere Drehzahlschwelle f. Leckageerkennung" VALUE 0xa081865c _REC_VAL_20_s2 0. _CNV_R_R_Def_n_sw_q_595_CM -32768. 32767. FORMAT "%5.0" /end CHARACTERISTIC
/begin CHARACTERISTIC K_NKWLEK_MX "Obere Drehzahlschwelle f. Leckageerkennung" VALUE 0xa081865e _REC_VAL_20_s2 0. _CNV_R_R_Def_n_sw_q_595_CM -32768. 32767. FORMAT "%5.0" /end CHARACTERISTIC
/begin CHARACTERISTIC K_NKWPUMP_MN "Untere Drehzahlschwelle f. Pumpbestimmung" VALUE 0xa0818898 _REC_VAL_20_s2 0. _CNV_R_R_Def_n_sw_q_595_CM -32768. 32767. FORMAT "%5.0" /end CHARACTERISTIC
/begin CHARACTERISTIC K_NKWPUMP_MX "Obere Drehzahlschwelle f. Pumpbestimmung" VALUE 0xa081889a _REC_VAL_20_s2 0. _CNV_R_R_Def_n_sw_q_595_CM -32768. 32767. FORMAT "%5.0" /end CHARACTERISTIC
/begin CHARACTERISTIC K_NOK_AN "Anspringtemperatur NoXKat-Modell" VALUE 0xa0819f98 _REC_VAL_20_s2 131.07 _CNV_R_R_Def_t_sw_q_578_CM -3276.8 3276.7 FORMAT "%4.1" /end CHARACTERISTIC
/begin CHARACTERISTIC K_N_NOEXO "Temperaturbeitrag NoX-Kat ohne Exothermie" VALUE 0xa0819f9a _REC_VAL_20_s2 131.07 _CNV_R_R_Def_t_sw_q_578_CM -3276.8 3276.7 FORMAT "%4.1" /end CHARACTERISTIC
/begin CHARACTERISTIC K_PLDDGRD_OB "Gradient der Regeldifferenz für Overboost Ende" VALUE 0xa08172c4 _REC_VAL_20_s2 102.398436 _CNV_R_R_Def_p_sw_q_680_CM -2560. 2559.9218 FORMAT "%5.2" /end CHARACTERISTIC
/begin CHARACTERISTIC K_PLDDIFFAD "Max. Regeldifferenz f. aktive Adaption " VALUE 0xa0818646 _REC_VAL_20_s2 102.398436 _CNV_R_R_Def_p_sw_q_680_CM -2560. 2559.9218 FORMAT "%5.2" /end CHARACTERISTIC
/begin CHARACTERISTIC K_PLDDIFFGRD_OB "Gradient der Regeldifferenz zur Auslösung Overboost" VALUE 0xa08172c6 _REC_VAL_20_s2 102.398436 _CNV_R_R_Def_p_sw_q_680_CM -2560. 2559.9218 FORMAT "%5.2" /end CHARACTERISTIC
/begin CHARACTERISTIC K_PLDDIFF_OB "Regeldifferenz zur Auslösung Overboost" VALUE 0xa08172c8 _REC_VAL_20_s2 102.398436 _CNV_R_R_Def_p_sw_q_680_CM -2560. 2559.9218 FORMAT "%5.2" /end CHARACTERISTIC
/begin CHARACTERISTIC K_PLDDIFLEKF "Max. pos. Regeldifferenz - schnelle Diagnose" VALUE 0xa0818660 _REC_VAL_20_s2 102.398436 _CNV_R_R_Def_p_sw_q_576_CM -1280. 1279.9609 FORMAT "%5.2" /end CHARACTERISTIC
/begin CHARACTERISTIC K_PLDDPUMP "Änderung Ladedruck-Istwert bei Pumperkennung" VALUE 0xa081889c _REC_VAL_20_s2 102.398436 _CNV_R_R_Def_p_sw_q_576_CM -1280. 1279.9609 FORMAT "%5.2" /end CHARACTERISTIC
/begin CHARACTERISTIC K_PLDD_OB "Regeldifferenz für Overboost Ende" VALUE 0xa08172ca _REC_VAL_20_s2 102.398436 _CNV_R_R_Def_p_sw_q_680_CM -2560. 2559.9218 FORMAT "%5.2" /end CHARACTERISTIC
/begin CHARACTERISTIC K_PLDLEKF "Max. Änderung Laderdruck-Istwert - schnelle Diagnose" VALUE 0xa0818662 _REC_VAL_20_s2 102.398436 _CNV_R_R_Def_p_sw_q_576_CM -1280. 1279.9609 FORMAT "%5.2" /end CHARACTERISTIC
/begin CHARACTERISTIC K_PLDSDAD_MN "Min. Änderung Ladedruck-Sollwert f. Adaption" VALUE 0xa0818648 _REC_VAL_20_s2 102.398436 _CNV_R_R_Def_p_sw_q_576_CM -1280. 1279.9609 FORMAT "%5.2" /end CHARACTERISTIC
/begin CHARACTERISTIC K_PLDSDAD_MX "Max. Änderung Ladedruck-Sollwert f. Adaption" VALUE 0xa081864a _REC_VAL_20_s2 102.398436 _CNV_R_R_Def_p_sw_q_576_CM -1280. 1279.9609 FORMAT "%5.2" /end CHARACTERISTIC
/begin CHARACTERISTIC K_PLDSDPMPMN "Änderung Ladedruck-Sollwert bei Pumperkennung" VALUE 0xa081889e _REC_VAL_20_s2 102.398436 _CNV_R_R_Def_p_sw_q_576_CM -1280. 1279.9609 FORMAT "%5.2" /end CHARACTERISTIC
/begin CHARACTERISTIC K_PLDSLEKF "Min. Änderung Laderdruck Sollwert - schnelle Diagnose" VALUE 0xa0818664 _REC_VAL_20_s2 102.398436 _CNV_R_R_Def_p_sw_q_576_CM -1280. 1279.9609 FORMAT "%5.2" /end CHARACTERISTIC
/begin CHARACTERISTIC K_PLD_AUS "Schwelle Regelabweichung" VALUE 0xa08172cc _REC_VAL_20_s2 102.398436 _CNV_R_R_Def_p_sw_q_680_CM -2560. 2559.9218 FORMAT "%5.2" /end CHARACTERISTIC
/begin CHARACTERISTIC K_PLD_OBEND "Schwelle Regelabweichung f. Ende Overboost" VALUE 0xa08172ce _REC_VAL_20_s2 102.398436 _CNV_R_R_Def_p_sw_q_680_CM -2560. 2559.9218 FORMAT "%5.2" /end CHARACTERISTIC
/begin CHARACTERISTIC K_SATLIM "Abgastemperaturschwelle fuer SA-Verbot NOX-Kat" VALUE 0xa081a1da _REC_VAL_20_s2 131.07 _CNV_R_R_Def_t_sw_q_578_CM -3276.8 3276.7 FORMAT "%4.1" /end CHARACTERISTIC
/begin CHARACTERISTIC K_SATLIM_NK "Abgastemperaturschwelle fuer SA-Verbot VKat" VALUE 0xa081a1dc _REC_VAL_20_s2 131.07 _CNV_R_R_Def_t_sw_q_578_CM -3276.8 3276.7 FORMAT "%4.1" /end CHARACTERISTIC
/begin CHARACTERISTIC K_TABGEX "Kat-Anspringtemperatur" VALUE 0xa0819f92 _REC_VAL_20_s2 131.07 _CNV_R_R_Def_t_sw_q_578_CM -3276.8 3276.7 FORMAT "%4.1" /end CHARACTERISTIC
/begin CHARACTERISTIC K_TANSATLAD "Max. Ansauglufttemperatur für Regler-Adaption" VALUE 0xa081864c _REC_VAL_20_s2 131.07 _CNV_R_R_Def_t_sw_q_578_CM -3276.8 3276.7 FORMAT "%4.1" /end CHARACTERISTIC
/begin CHARACTERISTIC K_TA_VKSOLL_ATF "Delta Solltemperatur Abgas bei Fehler ATF" VALUE 0xa0819440 _REC_VAL_20_s2 131.07 _CNV_R_R_Def_t_sw_q_578_CM -3276.8 3276.7 FORMAT "%4.1" /end CHARACTERISTIC
/begin CHARACTERISTIC K_TA_VKSOLL_DELT "Delta Solltemperatur Abgas bei Fehler" VALUE 0xa0819442 _REC_VAL_20_s2 131.07 _CNV_R_R_Def_t_sw_q_578_CM -3276.8 3276.7 FORMAT "%4.1" /end CHARACTERISTIC
/begin CHARACTERISTIC K_TA_VKSOLL_DELT2 "Zusaetzliches zeitabhaengiges Delta Solltemperatur Abgas bei Fehler" VALUE 0xa0819444 _REC_VAL_20_s2 131.07 _CNV_R_R_Def_t_sw_q_578_CM -3276.8 3276.7 FORMAT "%4.1" /end CHARACTERISTIC
/begin CHARACTERISTIC K_TBS2 "Zeitverzoegerung nach Aktivierung BS fuer Sollwertdelta" VALUE 0xa081943f _REC_VAL_20_u1 99.45 _CNV_R_R_Def_td_ub__611_CM 0. 255. FORMAT "%5.2" /end CHARACTERISTIC
/begin CHARACTERISTIC K_TDATLLEKF "Verzoegerung f. schnelle Leckage-Erkennung" VALUE 0xa0818670 _REC_VAL_20_u2 98.30250000000001 _CNV_R_R_Def_td_uw__673_CM 0. 655.35 FORMAT "%5.2" /end CHARACTERISTIC
/begin CHARACTERISTIC K_TDATLR_ON "Verzoegerungszeit f. Diagnosebereitschaft nach Start  der Ladedruckregelung" VALUE 0xa0818672 _REC_VAL_20_u2 98.30250000000001 _CNV_R_R_Def_td_uw__673_CM 0. 655.35 FORMAT "%5.2" /end CHARACTERISTIC
/begin CHARACTERISTIC K_TDWG1PLMN "Verzögerungszeit min. WG-Check" VALUE 0xa08186ee _REC_VAL_20_u2 98.30250000000001 _CNV_R_R_Def_td_uw__673_CM 0. 655.35 FORMAT "%5.2" /end CHARACTERISTIC
/begin CHARACTERISTIC K_TDWG1PLMX "Verzögerungszeit max. WG-Check" VALUE 0xa08186f0 _REC_VAL_20_u2 98.30250000000001 _CNV_R_R_Def_td_uw__673_CM 0. 655.35 FORMAT "%5.2" /end CHARACTERISTIC
/begin CHARACTERISTIC K_TDWG_NGL "Verzoegerunsgzeit d. WG nach aktiver Gleichstellung" VALUE 0xa0818674 _REC_VAL_20_u2 98.30250000000001 _CNV_R_R_Def_td_uw__673_CM 0. 655.35 FORMAT "%5.2" /end CHARACTERISTIC
/begin CHARACTERISTIC K_TIKATOE "Temperaturkorrektur Kat ohne Exotherme" VALUE 0xa0819f96 _REC_VAL_20_s2 131.07 _CNV_R_R_Def_t_sw_q_578_CM -3276.8 3276.7 FORMAT "%4.1" /end CHARACTERISTIC
/begin CHARACTERISTIC K_TKATOE "Temperaturkorrektur Kat ohne Exotherme" VALUE 0xa0819f94 _REC_VAL_20_s2 131.07 _CNV_R_R_Def_t_sw_q_578_CM -3276.8 3276.7 FORMAT "%4.1" /end CHARACTERISTIC
/begin CHARACTERISTIC K_TMOTATLAD "Min. Motortemperatur für Regler-Adaption" VALUE 0xa081864e _REC_VAL_20_s2 98.30250000000001 _CNV_R_R_Def_t_sw_q_579_CM -327.68 327.67 FORMAT "%5.2" /end CHARACTERISTIC
/begin CHARACTERISTIC K_TRNOK_ST "Starttemperatur Rohrwand" VALUE 0xa0819a1a _REC_VAL_20_s2 131.07 _CNV_R_R_Def_t_sw_q_578_CM -3276.8 3276.7 FORMAT "%4.1" /end CHARACTERISTIC
/begin CHARACTERISTIC K_TR_ST "Starttemperatur Rohrwand" VALUE 0xa0819a0c _REC_VAL_20_s2 131.07 _CNV_R_R_Def_t_sw_q_578_CM -3276.8 3276.7 FORMAT "%4.1" /end CHARACTERISTIC
/begin CHARACTERISTIC K_TVWG "Tastverhaeltnis WG1 - manuell" VALUE 0xa0817390 _REC_VAL_20_u2 99.9984 _CNV_R_R_Def_f_uw_b_555_CM 0. 99.9984 /end CHARACTERISTIC
/begin CHARACTERISTIC K_TVWG2 "Tastverhaeltnis WG2 - manuell" VALUE 0xa0817392 _REC_VAL_20_u2 99.9984 _CNV_R_R_Def_f_uw_b_555_CM 0. 99.9984 /end CHARACTERISTIC
/begin CHARACTERISTIC K_TVWGMIN "Mindest Tastverhaeltnis f. Ansteuerung - bauteilbedingtes Verhalten d. Unterdruckdose" VALUE 0xa0817394 _REC_VAL_20_u2 99.9984 _CNV_R_R_Def_f_uw_b_555_CM 0. 99.9984 /end CHARACTERISTIC
/begin CHARACTERISTIC K_TVWG_GLAKT "Ansteuerung Wastegate bei Gleichstellung" VALUE 0xa0817396 _REC_VAL_20_u2 99.9984 _CNV_R_R_Def_f_uw_b_555_CM 0. 99.9984 /end CHARACTERISTIC
/begin CHARACTERISTIC K_TVWG_MN "Tastverhaeltnis Minimum" VALUE 0xa0817398 _REC_VAL_20_u2 99.9984 _CNV_R_R_Def_f_uw_b_555_CM 0. 99.9984 /end CHARACTERISTIC
/begin CHARACTERISTIC K_TVWG_MX "Tastverhaeltnis Maximum" VALUE 0xa081739a _REC_VAL_20_u2 99.9984 _CNV_R_R_Def_f_uw_b_555_CM 0. 99.9984 /end CHARACTERISTIC
/begin CHARACTERISTIC K_WG1DIAGMN "Min. Korrekturfaktor f. Wastegate 1" VALUE 0xa08186f2 _REC_VAL_20_u2 1.9999 _CNV_R_R_Def_f_uw_b_590_CM 0. 1.9999 FORMAT "%14.5" /end CHARACTERISTIC
/begin CHARACTERISTIC K_WG1DIAGMN2 "Min. Korrekturfaktor f. Wastegate 1" VALUE 0xa08186f4 _REC_VAL_20_u2 1.9999 _CNV_R_R_Def_f_uw_b_590_CM 0. 1.9999 FORMAT "%14.5" /end CHARACTERISTIC
/begin CHARACTERISTIC K_WG1DIAGMX "Max. Korrekturfaktor f. Wastegate 1" VALUE 0xa08186f6 _REC_VAL_20_u2 1.9999 _CNV_R_R_Def_f_uw_b_590_CM 0. 1.9999 FORMAT "%14.5" /end CHARACTERISTIC
/begin CHARACTERISTIC K_WG1DIAGMX2 "Max. Korrekturfaktor f. Wastegate 1" VALUE 0xa08186f8 _REC_VAL_20_u2 1.9999 _CNV_R_R_Def_f_uw_b_590_CM 0. 1.9999 FORMAT "%14.5" /end CHARACTERISTIC
/begin CHARACTERISTIC K_WG1KMN "Unter Adaption-Grenzwert f. WG-Korrektur" VALUE 0xa08186e8 _REC_VAL_20_s2 1.9999 _CNV_R_R_Def_f_sw_b_616_CM 0. 1.9999 FORMAT "%14.5" /end CHARACTERISTIC
/begin CHARACTERISTIC K_WG1KMX "Oberer Adaption-Grenzwert f. WG-Korrektur" VALUE 0xa08186ea _REC_VAL_20_s2 1.9999 _CNV_R_R_Def_f_sw_b_616_CM 0. 1.9999 FORMAT "%14.5" /end CHARACTERISTIC
/begin CHARACTERISTIC K_WG1KOR "Gleichlaufkorrektur WG1 - manuell" VALUE 0xa08186fa _REC_VAL_20_u2 1.9999 _CNV_R_R_Def_f_uw_b_590_CM 0. 1.9999 FORMAT "%14.5" /end CHARACTERISTIC
/begin CHARACTERISTIC K_WG2KOR "Gleichlaufkorrektur WG2 - manuell" VALUE 0xa08186fc _REC_VAL_20_u2 1.9999 _CNV_R_R_Def_f_uw_b_590_CM 0. 1.9999 FORMAT "%14.5" /end CHARACTERISTIC
/begin CHARACTERISTIC K_WOUT_BIAS "Gewichte des Biasterms der Ausgangschicht, ATMNN" VALUE 0xa0819762 _REC_VAL_20_S4 0. _CNV_R_R_Def_dez_sl_551_CM -1000000000000. 10000000000000. FORMAT "%14.7" /end CHARACTERISTIC
/begin CHARACTERISTIC K_ZK_TIKST "Filterparameter T_ikat_stat" VALUE 0xa0819f90 _REC_VAL_20_u2 5. _CNV_R_R_Def_td_uw__740_CM 0. 5. FORMAT "%14.5" /end CHARACTERISTIC
/begin CHARACTERISTIC K_ZK_WGTVTZ "Zeitkonstant Wastegate Tastverhaeltnis Totzeit " VALUE 0xa081739c _REC_VAL_20_u2 0.9999847412109381 _CNV_R_R_Def_f_uw_b_571_CM 0. 0.9999847412109381 FORMAT "%14.5" /end CHARACTERISTIC
/begin CHARACTERISTIC S_ATLGLS_PI "Umschaltung auf PI-Regler" VALUE 0xa08186fe _REC_VAL_20_u1 1. _CNV_R_R_Def_dez_sl_551_CM 0. 1. FORMAT "%3.0" /end CHARACTERISTIC
/begin CHARACTERISTIC S_ATL_FSP "Fehlerspeicher vorhanden" VALUE 0xa0818658 _REC_VAL_20_u1 1. _CNV_R_R_Def_dez_sl_551_CM 0. 1. FORMAT "%3.0" /end CHARACTERISTIC
/begin CHARACTERISTIC S_ATMNN_N53 "Umschalter Lambdaeingang auf Rk fuer N53" VALUE 0xa0819757 _REC_VAL_20_u1 1. _CNV_R_R_Def_dez_sl_551_CM 0. 1. FORMAT "%3.0" /end CHARACTERISTIC
/begin CHARACTERISTIC S_ATMPH_SENS "Umschalter auf Abgastemperatursensor fuer N53" VALUE 0xa081a1f4 _REC_VAL_20_u1 1. _CNV_R_R_Def_dez_sl_551_CM 0. 1. FORMAT "%3.0" /end CHARACTERISTIC
/begin CHARACTERISTIC S_ATMPH_SENS1 "Abgastemperatursensor auf Bank 1" VALUE 0xa081a1f6 _REC_VAL_20_u1 1. _CNV_R_R_Def_dez_sl_551_CM 0. 1. FORMAT "%3.0" /end CHARACTERISTIC
/begin CHARACTERISTIC S_ATMPH_SENS2 "Abgastemperatursensor auf Bank 2" VALUE 0xa081a1f7 _REC_VAL_20_u1 1. _CNV_R_R_Def_dez_sl_551_CM 0. 1. FORMAT "%3.0" /end CHARACTERISTIC
/begin CHARACTERISTIC S_ATM_BANK "Umschalter fuer bankweise, nicht zylinderselektive Berechnung" VALUE 0xa0819750 _REC_VAL_20_u1 1. _CNV_R_R_Def_dez_sl_551_CM 0. 1. FORMAT "%3.0" /end CHARACTERISTIC
/begin CHARACTERISTIC S_ATM_INVNN "Umschalter fuer invertierbares NN" VALUE 0xa0819752 _REC_VAL_20_u1 1. _CNV_R_R_Def_dez_sl_551_CM 0. 1. FORMAT "%3.0" /end CHARACTERISTIC
/begin CHARACTERISTIC S_ATM_MLPV3 "Umschalter fuer invertierbares NN mit 2 Vorsteuer-Ausgaengen" VALUE 0xa0819753 _REC_VAL_20_u1 1. _CNV_R_R_Def_dez_sl_551_CM 0. 1. FORMAT "%3.0" /end CHARACTERISTIC
/begin CHARACTERISTIC S_ATM_MSTURB "Umschalter Mszyl_atm oder Msturb_atm fuer Mszyl_rohr/bank" VALUE 0xa0819a05 _REC_VAL_20_u1 1. _CNV_R_R_Def_dez_sl_551_CM 0. 1. FORMAT "%3.0" /end CHARACTERISTIC
/begin CHARACTERISTIC S_ATM_N54 "Umschalter fuer bankweise, nicht zylinderselektive Berechnung" VALUE 0xa0819751 _REC_VAL_20_u1 1. _CNV_R_R_Def_dez_sl_551_CM 0. 1. FORMAT "%3.0" /end CHARACTERISTIC
/begin CHARACTERISTIC S_ATM_NOX "Schalter NOX Kat vorhanden" VALUE 0xa0819a04 _REC_VAL_20_u1 1. _CNV_R_R_Def_dez_sl_551_CM 0. 1. FORMAT "%3.0" /end CHARACTERISTIC
/begin CHARACTERISTIC S_ATM_TPVK "Abschaltung des Einflusses der Taupunkterkennung im Katmodell" VALUE 0xa0819f8e _REC_VAL_20_u1 1. _CNV_R_R_Def_dez_sl_551_CM 0. 1. FORMAT "%3.0" /end CHARACTERISTIC
/begin CHARACTERISTIC S_BSATL "Auswahl der Fuehrungsgroesse fuer BS-Regler Vor-Noxkat oder Vor-ATL" VALUE 0xa081943d _REC_VAL_20_u1 99.45 _CNV_R_R_Def_dez_sl_551_CM 0. 255. FORMAT "%3.0" /end CHARACTERISTIC
/begin CHARACTERISTIC S_BSINOK "Auswahl des Kats fuer Absenkung der BS-Solltemperatur" VALUE 0xa081943e _REC_VAL_20_u1 99.45 _CNV_R_R_Def_dez_sl_551_CM 0. 255. FORMAT "%3.0" /end CHARACTERISTIC
/begin CHARACTERISTIC S_BSMAGER "Auswahl des BS-Modus-Defaultwertes" VALUE 0xa081943b _REC_VAL_20_u1 99.45 _CNV_R_R_Def_dez_sl_551_CM 0. 255. FORMAT "%3.0" /end CHARACTERISTIC
/begin CHARACTERISTIC S_BSMAGEROFF "Auswahl fuer Vosteuer-lambda-abhaengige Deaktivierung des BS" VALUE 0xa081943c _REC_VAL_20_u1 99.45 _CNV_R_R_Def_dez_sl_551_CM 0. 255. FORMAT "%3.0" /end CHARACTERISTIC
/begin CHARACTERISTIC S_BS_SONDE "Auswahl BS entweder mit Sonden- oder Vorkattemperatur als Fuehrungsgroesse" VALUE 0xa0819434 _REC_VAL_20_u1 99.45 _CNV_R_R_Def_dez_sl_551_CM 0. 255. FORMAT "%3.0" /end CHARACTERISTIC
/begin CHARACTERISTIC S_ETAZWIST_MW "Umschalter Mittelwertfilter fuer Eta_zw_istx" VALUE 0xa0819a10 _REC_VAL_20_u1 1. _CNV_R_R_Def_dez_sl_551_CM 0. 1. FORMAT "%3.0" /end CHARACTERISTIC
/begin CHARACTERISTIC S_FUMU_BSNN "Umschalter Funktionsmuster Deltatemperatur BS-Sollwert" VALUE 0xa0819758 _REC_VAL_20_u1 1. _CNV_R_R_Def_dez_sl_551_CM 0. 1. FORMAT "%3.0" /end CHARACTERISTIC
/begin CHARACTERISTIC S_GLS2_MAN "Gleichlaufsteuerung WG2 - manuell" VALUE 0xa08186ff _REC_VAL_20_u1 1. _CNV_R_R_Def_dez_sl_551_CM 0. 1. FORMAT "%3.0" /end CHARACTERISTIC
/begin CHARACTERISTIC S_GLS_MAN "Gleichlaufsteuerung WG1 - manuell" VALUE 0xa0818700 _REC_VAL_20_u1 1. _CNV_R_R_Def_dez_sl_551_CM 0. 1. FORMAT "%3.0" /end CHARACTERISTIC
/begin CHARACTERISTIC S_MSTURB_MW "Umschalter Mittelwertfilter fuer Msturb" VALUE 0xa0819a0f _REC_VAL_20_u1 1. _CNV_R_R_Def_dez_sl_551_CM 0. 1. FORMAT "%3.0" /end CHARACTERISTIC
/begin CHARACTERISTIC S_MSZYL_MW "Umschalter Mittelwertfilter fuer Mszyl" VALUE 0xa0819a0e _REC_VAL_20_u1 1. _CNV_R_R_Def_dez_sl_551_CM 0. 1. FORMAT "%3.0" /end CHARACTERISTIC
/begin CHARACTERISTIC S_NKW_MW "Umschalter Mittelwertfilter fuer Nkw" VALUE 0xa0819759 _REC_VAL_20_u1 1. _CNV_R_R_Def_dez_sl_551_CM 0. 1. FORMAT "%3.0" /end CHARACTERISTIC
/begin CHARACTERISTIC S_RF_MW "Umschalter Mittelwertfilter fuer Rf" VALUE 0xa081975a _REC_VAL_20_u1 1. _CNV_R_R_Def_dez_sl_551_CM 0. 1. FORMAT "%3.0" /end CHARACTERISTIC
/begin CHARACTERISTIC S_TABGFIL "Einschalter Filterbank fuer Abgastemperaturen" VALUE 0xa0819756 _REC_VAL_20_u1 1. _CNV_R_R_Def_dez_sl_551_CM 0. 1. FORMAT "%3.0" /end CHARACTERISTIC
/begin CHARACTERISTIC S_TSENSTURB "Umschalter auf Abgastemperatursensor fuer N54" VALUE 0xa081a1f5 _REC_VAL_20_u1 1. _CNV_R_R_Def_dez_sl_551_CM 0. 1. FORMAT "%3.0" /end CHARACTERISTIC
/begin CHARACTERISTIC S_TVWG2_INV "Tastverhaeltnis WG2 invertieren" VALUE 0xa081739e _REC_VAL_20_u1 1. _CNV_R_R_Def_dez_sl_551_CM 0. 1. FORMAT "%3.0" /end CHARACTERISTIC
/begin CHARACTERISTIC S_TVWG2_MAN "Tastverhaeltnis WG2 - manuell" VALUE 0xa081738c _REC_VAL_20_u1 1. _CNV_R_R_Def_dez_sl_551_CM 0. 1. FORMAT "%3.0" /end CHARACTERISTIC
/begin CHARACTERISTIC S_TVWG_INV "Tastverhaeltnis WG1 invertieren" VALUE 0xa081738d _REC_VAL_20_u1 1. _CNV_R_R_Def_dez_sl_551_CM 0. 1. FORMAT "%3.0" /end CHARACTERISTIC
/begin CHARACTERISTIC S_TVWG_MAN "Tastverhaeltnis WG1 - manuell" VALUE 0xa081738e _REC_VAL_20_u1 1. _CNV_R_R_Def_dez_sl_551_CM 0. 1. FORMAT "%3.0" /end CHARACTERISTIC
/begin CHARACTERISTIC S_WGTK_TMOTR "Wastegate Temperatur Korrektur ueber Tmotraum als Parameter" VALUE 0xa081739f _REC_VAL_20_u1 1. _CNV_R_R_Def_dez_sl_551_CM 0. 1. FORMAT "%3.0" /end CHARACTERISTIC
/begin COMPU_METHOD _CNV_A_R_LINEAR_____0_CM "" RAT_FUNC "%6.3" "-" COEFFS 0 1. 0. 0 0 1 /end COMPU_METHOD
/begin COMPU_METHOD _CNV_S_2_RANGE__0___1_CM "" TAB_VERB "%6.3" "-" COMPU_TAB_REF _CNV_S_2_RANGE__0___1 /end COMPU_METHOD
/begin COMPU_VTAB _CNV_S_2_RANGE__0___1 "" TAB_VERB 2 0 "0" 1 "1" /end COMPU_VTAB
/begin COMPU_METHOD _CNV_R_R_Def_dez_sl_551_CM "Def_dez_sl_q1" RAT_FUNC "%6.3" "-" COEFFS 0. 1. 0. 0. 0. 1. /end COMPU_METHOD
/begin COMPU_METHOD _CNV_R_R_Def_f_ub_b_553_CM "Def_f_ub_b1" RAT_FUNC "%6.3" "-" COEFFS 0. 256. 0. 0. 0. 1. /end COMPU_METHOD
/begin COMPU_METHOD _CNV_R_R_Def_f_uw_b_555_CM "Def_f_uw_b100" RAT_FUNC "%6.3" "%" COEFFS 0. 65536. 0. 0. 0. 100. /end COMPU_METHOD
/begin COMPU_METHOD _CNV_R_R_Def_f_sw_b_556_CM "Def_f_sw_b32" RAT_FUNC "%6.3" "-" COEFFS 0. 32768. 0. 0. 0. 32. /end COMPU_METHOD
/begin COMPU_METHOD _CNV_R_R_Def_f_uw_b_559_CM "Def_f_uw_b16" RAT_FUNC "%6.3" "-" COEFFS 0. 65536. 0. 0. 0. 16. /end COMPU_METHOD
/begin COMPU_METHOD _CNV_R_R_Def_rel_sw_562_CM "Def_rel_sw_b100" RAT_FUNC "%6.3" "%" COEFFS 0. 32768. 0. 0. 0. 100. /end COMPU_METHOD
/begin COMPU_METHOD _CNV_S_2_Def_bit_ub_563_CM "Def_bit_ub_0" TAB_VERB "%6.3" "-" COMPU_TAB_REF _CNV_S_2_Def_bit_ub_563 /end COMPU_METHOD
/begin COMPU_VTAB _CNV_S_2_Def_bit_ub_563 "Def_bit_ub_0" TAB_VERB 2 0 "FALSE" 1 "TRUE" /end COMPU_VTAB
/begin COMPU_METHOD _CNV_R_R_Def_f_uw_b_571_CM "Def_f_uw_b1" RAT_FUNC "%6.3" "-" COEFFS 0. 65536. 0. 0. 0. 1. /end COMPU_METHOD
/begin COMPU_METHOD _CNV_R_R_Def_p_sw_q_576_CM "Def_p_sw_q0p039" RAT_FUNC "%6.3" "hPa" COEFFS 0. 256. 0. 0. 0. 10. /end COMPU_METHOD
/begin COMPU_METHOD _CNV_R_R_Def_t_sw_q_578_CM "Def_t_sw_q0p1" RAT_FUNC "%6.3" "°C" COEFFS 0. 10. 0. 0. 0. 1. /end COMPU_METHOD
/begin COMPU_METHOD _CNV_R_R_Def_t_sw_q_579_CM "Def_t_sw_q0p01" RAT_FUNC "%6.3" "°C" COEFFS 0. 100. 0. 0. 0. 1. /end COMPU_METHOD
/begin COMPU_METHOD _CNV_R_R_Def_u_sb_q_583_CM "Def_u_sb_q0p0942" RAT_FUNC "%6.3" "V" COEFFS 0. 1. 0. 0. 0. 9.420000000000001e-002 /end COMPU_METHOD
/begin COMPU_METHOD _CNV_R_R_Def_f_ub_b_586_CM "Def_f_ub_b100" RAT_FUNC "%6.3" "%" COEFFS 0. 256. 0. 0. 0. 100. /end COMPU_METHOD
/begin COMPU_METHOD _CNV_R_R_Def_f_uw_b_590_CM "Def_f_uw_b2" RAT_FUNC "%6.3" "-" COEFFS 0. 65536. 0. 0. 0. 2. /end COMPU_METHOD
/begin COMPU_METHOD _CNV_R_R_Def_f_sw_b_592_CM "Def_f_sw_b8" RAT_FUNC "%6.3" "-" COEFFS 0. 32768. 0. 0. 0. 8. /end COMPU_METHOD
/begin COMPU_METHOD _CNV_R_R_Def_f_ub_b_593_CM "Def_f_ub_b0p5" RAT_FUNC "%6.3" "-" COEFFS 0. 256. 0. 0. 0. 0.5 /end COMPU_METHOD
/begin COMPU_METHOD _CNV_R_R_Def_ms_uw__594_CM "Def_ms_uw_q0p03125" RAT_FUNC "%6.3" "kg/h" COEFFS 0. 32. 0. 0. 0. 1. /end COMPU_METHOD
/begin COMPU_METHOD _CNV_R_R_Def_n_sw_q_595_CM "Def_n_sw_q1p0" RAT_FUNC "%6.3" "Upm" COEFFS 0. 1. 0. 0. 0. 1. /end COMPU_METHOD
/begin COMPU_METHOD _CNV_R_R_Def_rf_sw__598_CM "Def_rf_sw_q0p01" RAT_FUNC "%6.3" "%" COEFFS 0. 100. 0. 0. 0. 1. /end COMPU_METHOD
/begin COMPU_METHOD _CNV_R_R_Def_rk_sw__600_CM "Def_rk_sw_b1600" RAT_FUNC "%6.3" "%" COEFFS 0. 2048. 0. 0. 0. 100. /end COMPU_METHOD
/begin COMPU_METHOD _CNV_R_R_Def_zw_sw__604_CM "Def_zw_sw_q0p1" RAT_FUNC "%6.3" "°" COEFFS 0. 10. 0. 0. 0. 1. /end COMPU_METHOD
/begin COMPU_METHOD _CNV_R_R_Def_eta_sw_606_CM "Def_eta_sw_q0p00305" RAT_FUNC "%6.3" "%" COEFFS 0. 32767. 0. 0. 0. 100. /end COMPU_METHOD
/begin COMPU_METHOD _CNV_R_R_Def_td_ub__611_CM "Def_td_ub_q1" RAT_FUNC "%6.3" "s" COEFFS 0. 1. 0. 0. 0. 1. /end COMPU_METHOD
/begin COMPU_METHOD _CNV_R_R_Def_f_ub_b_613_CM "Def_f_ub_b2" RAT_FUNC "%6.3" "-" COEFFS 0. 256. 0. 0. 0. 2. /end COMPU_METHOD
/begin COMPU_METHOD _CNV_R_R_Def_f_sw_b_616_CM "Def_f_sw_b2" RAT_FUNC "%6.3" "-" COEFFS 0. 65536. 0. 0. 0. 4. /end COMPU_METHOD
/begin COMPU_METHOD _CNV_R_R_Def_f_uw_b_617_CM "Def_f_uw_b64" RAT_FUNC "%6.3" "-" COEFFS 0. 65536. 0. 0. 0. 64. /end COMPU_METHOD
/begin COMPU_METHOD _CNV_R_R_Def_f_ub_b_619_CM "Def_f_ub_b1p0" RAT_FUNC "%6.3" "-" COEFFS 0. 255. 0. 0. 0. 1. /end COMPU_METHOD
/begin COMPU_METHOD _CNV_R_R_Def_f_sw_b_620_CM "Def_f_sw_b0p1" RAT_FUNC "%6.3" "-" COEFFS 0. 655360. 0. 0. 0. 2. /end COMPU_METHOD
/begin COMPU_METHOD _CNV_R_R_Def_cxm_sw_627_CM "Def_cxm_sw_q0p0039" RAT_FUNC "%6.3" "J/kg*K^2" COEFFS 0. 32768. 0. 0. 0. 128. /end COMPU_METHOD
/begin COMPU_METHOD _CNV_R_R_Def_m_uw_q_657_CM "Def_m_uw_q0p000305" RAT_FUNC "%6.3" "kg" COEFFS 0. 3273. 0. 0. 0. 1. /end COMPU_METHOD
/begin COMPU_METHOD _CNV_R_R_Def_td_uw__663_CM "Def_td_uw_q0p001" RAT_FUNC "%6.3" "ms" COEFFS 0. 1000. 0. 0. 0. 1. /end COMPU_METHOD
/begin COMPU_METHOD _CNV_R_R_Def_f_sb_b_669_CM "Def_f_sb_b2" RAT_FUNC "%6.3" "-" COEFFS 0. 128. 0. 0. 0. 2. /end COMPU_METHOD
/begin COMPU_METHOD _CNV_R_R_Def_lf_ub__670_CM "Def_lf_ub_q0p01" RAT_FUNC "%6.3" "-" COEFFS 0. 100. 0. 0. 0. 1. /end COMPU_METHOD
/begin COMPU_METHOD _CNV_R_R_Def_td_uw__673_CM "Def_td_uw_q0p01" RAT_FUNC "%6.3" "s" COEFFS 0. 100. 0. 0. 0. 1. /end COMPU_METHOD
/begin COMPU_METHOD _CNV_R_R_Def_p_sw_q_680_CM "Def_p_sw_q0p078" RAT_FUNC "%6.3" "hPa" COEFFS 0. 256. 0. 0. 0. 20. /end COMPU_METHOD
/begin COMPU_METHOD _CNV_R_R_Def_td_uw__718_CM "Def_td_uw_q0p2" RAT_FUNC "%6.3" "s" COEFFS 0. 5. 0. 0. 0. 1. /end COMPU_METHOD
/begin COMPU_METHOD _CNV_R_R_Def_v_uw_q_726_CM "Def_v_uw_q1p0" RAT_FUNC "%6.3" "km/h" COEFFS 0. 1. 0. 0. 0. 1. /end COMPU_METHOD
/begin COMPU_METHOD _CNV_R_R_Def_td_uw__740_CM "Def_td_uw_q0p000076" RAT_FUNC "%6.3" "" COEFFS 0. 13107. 0. 0. 0. 1. /end COMPU_METHOD
/begin COMPU_METHOD _CNV_R_R_Def_f_ub_q_741_CM "Def_f_ub_q0p5_o1p0" RAT_FUNC "%6.3" "-" COEFFS 0. -512. 512. 0. 0. -1. /end COMPU_METHOD
/begin COMPU_METHOD _CNV_R_R_Def_v_ub_q_747_CM "Def_v_ub_q0p6" RAT_FUNC "%6.3" "km/h" COEFFS 0. 10. 0. 0. 0. 6. /end COMPU_METHOD
/begin COMPU_METHOD _CNV_R_R_Def_t_ub_b_749_CM "Def_t_ub_b400" RAT_FUNC "%6.3" "s" COEFFS 0. 256. 0. 0. 0. 400. /end COMPU_METHOD
/begin COMPU_METHOD _CNV_R_R_Def_td_ub__753_CM "Def_td_ub_q0p02" RAT_FUNC "%6.3" "s" COEFFS 0. 50. 0. 0. 0. 1. /end COMPU_METHOD
/begin COMPU_METHOD _CNV_R_R_Def_cxm_uw_755_CM "Def_cxm_uw_b16384" RAT_FUNC "%6.3" "J/K" COEFFS 0. 4. 0. 0. 0. 1. /end COMPU_METHOD
/begin COMPU_METHOD _CNV_R_R_Def_cxm_ub_756_CM "Def_cxm_ub_q0p01" RAT_FUNC "%6.3" "J/s*K^2" COEFFS 0. 256. 0. 0. 0. 2.56 /end COMPU_METHOD
/begin RECORD_LAYOUT _REC_VAL_20_u1 FNC_VALUES 1 UBYTE COLUMN_DIR DIRECT /end RECORD_LAYOUT
/begin RECORD_LAYOUT _REC_VAL_20_u2 FNC_VALUES 1 UWORD COLUMN_DIR DIRECT /end RECORD_LAYOUT
/begin RECORD_LAYOUT _REC_AXS_20_u1 NO_AXIS_PTS_X 1 UBYTE AXIS_PTS_X 2 UBYTE INDEX_INCR DIRECT /end RECORD_LAYOUT
/begin RECORD_LAYOUT _REC_VAL_20_s2 FNC_VALUES 1 SWORD COLUMN_DIR DIRECT /end RECORD_LAYOUT
/begin RECORD_LAYOUT _REC_MAP_52_u1_s2_s2 NO_AXIS_PTS_X 1 UBYTE NO_AXIS_PTS_Y 2 UBYTE AXIS_PTS_X 3 SWORD INDEX_INCR DIRECT AXIS_PTS_Y 4 SWORD INDEX_INCR DIRECT FNC_VALUES 5 UBYTE COLUMN_DIR DIRECT /end RECORD_LAYOUT
/begin RECORD_LAYOUT _REC_MAP_52_UBYTE_u2_s2_s2 NO_AXIS_PTS_X 1 UBYTE NO_AXIS_PTS_Y 2 UBYTE AXIS_PTS_X 3 SWORD INDEX_INCR DIRECT AXIS_PTS_Y 4 SWORD INDEX_INCR DIRECT FNC_VALUES 5 UWORD COLUMN_DIR DIRECT /end RECORD_LAYOUT
/begin RECORD_LAYOUT _REC_MAP_52_UBYTE_s2_s2_s2 NO_AXIS_PTS_X 1 UBYTE NO_AXIS_PTS_Y 2 UBYTE AXIS_PTS_X 3 SWORD INDEX_INCR DIRECT AXIS_PTS_Y 4 SWORD INDEX_INCR DIRECT FNC_VALUES 5 SWORD COLUMN_DIR DIRECT /end RECORD_LAYOUT
/begin RECORD_LAYOUT _REC_MAP_52_UBYTE_u2_u2_u2 NO_AXIS_PTS_X 1 UBYTE NO_AXIS_PTS_Y 2 UBYTE AXIS_PTS_X 3 UWORD INDEX_INCR DIRECT AXIS_PTS_Y 4 UWORD INDEX_INCR DIRECT FNC_VALUES 5 UWORD COLUMN_DIR DIRECT /end RECORD_LAYOUT
/begin RECORD_LAYOUT _REC_MAP_52_UBYTE_u2_u2_s2 NO_AXIS_PTS_X 1 UBYTE NO_AXIS_PTS_Y 2 UBYTE AXIS_PTS_X 3 UWORD INDEX_INCR DIRECT AXIS_PTS_Y 4 SWORD INDEX_INCR DIRECT FNC_VALUES 5 UWORD COLUMN_DIR DIRECT /end RECORD_LAYOUT
/begin RECORD_LAYOUT _REC_CUR_TKL_UW_VV__u2_u2 NO_AXIS_PTS_X 1 UBYTE RESERVED 2 BYTE AXIS_PTS_X 3 UWORD INDEX_INCR DIRECT FNC_VALUES 4 UWORD COLUMN_DIR DIRECT /end RECORD_LAYOUT
/begin RECORD_LAYOUT _REC_CUR_TKL_UW_VV__u2_s2 NO_AXIS_PTS_X 1 UBYTE RESERVED 2 BYTE AXIS_PTS_X 3 SWORD INDEX_INCR DIRECT FNC_VALUES 4 UWORD COLUMN_DIR DIRECT /end RECORD_LAYOUT
/begin RECORD_LAYOUT _REC_CUR_TKL_UW_VV__u1_s2 NO_AXIS_PTS_X 1 UBYTE RESERVED 2 BYTE AXIS_PTS_X 3 SWORD INDEX_INCR DIRECT FNC_VALUES 4 UBYTE COLUMN_DIR DIRECT /end RECORD_LAYOUT
/begin RECORD_LAYOUT _REC_CUR_TKL_UW_VV__s2_s2 NO_AXIS_PTS_X 1 UBYTE RESERVED 2 BYTE AXIS_PTS_X 3 SWORD INDEX_INCR DIRECT FNC_VALUES 4 SWORD COLUMN_DIR DIRECT /end RECORD_LAYOUT
/begin RECORD_LAYOUT _REC_CUR_TKL_UW_VV__u1_u2 NO_AXIS_PTS_X 1 UBYTE RESERVED 2 BYTE AXIS_PTS_X 3 UWORD INDEX_INCR DIRECT FNC_VALUES 4 UBYTE COLUMN_DIR DIRECT /end RECORD_LAYOUT
/begin RECORD_LAYOUT _REC_CUR_TKL_UW_VV__s2_u2 NO_AXIS_PTS_X 1 UBYTE RESERVED 2 BYTE AXIS_PTS_X 3 UWORD INDEX_INCR DIRECT FNC_VALUES 4 SWORD COLUMN_DIR DIRECT /end RECORD_LAYOUT
/begin RECORD_LAYOUT _REC_CUR_TKL_UW_VV__u1_u1 NO_AXIS_PTS_X 1 UBYTE RESERVED 2 BYTE AXIS_PTS_X 3 UBYTE INDEX_INCR DIRECT FNC_VALUES 4 UBYTE COLUMN_DIR DIRECT /end RECORD_LAYOUT
/begin RECORD_LAYOUT _REC_CUR_TKL_UW_VV__s1_u2 NO_AXIS_PTS_X 1 UBYTE RESERVED 2 BYTE AXIS_PTS_X 3 UWORD INDEX_INCR DIRECT FNC_VALUES 4 SBYTE COLUMN_DIR DIRECT /end RECORD_LAYOUT
/begin RECORD_LAYOUT _REC_CUR_TKL_UW_VV__s1_s2 NO_AXIS_PTS_X 1 UBYTE RESERVED 2 BYTE AXIS_PTS_X 3 SWORD INDEX_INCR DIRECT FNC_VALUES 4 SBYTE COLUMN_DIR DIRECT /end RECORD_LAYOUT
/begin RECORD_LAYOUT _REC_CUR_20_S4_u1 FNC_VALUES 1 FLOAT32_IEEE COLUMN_DIR DIRECT /end RECORD_LAYOUT
/begin RECORD_LAYOUT _REC_VAL_20_S4 FNC_VALUES 1 FLOAT32_IEEE COLUMN_DIR DIRECT /end RECORD_LAYOUT
/begin FUNCTION ERRM_Lamp_Management_Appl_Inc "Lamp_Management_Appl_Inc" /begin OUT_MEASUREMENT lv_mil_act_req lv_wal_1_act_req lv_wal_2_act_req /end OUT_MEASUREMENT /end FUNCTION
/begin FUNCTION ERRM_DTC_Management_Appl_Inc "DTC_Management_Appl_Inc" /begin DEF_CHARACTERISTIC ldp_1_id_err_dtc_info /end DEF_CHARACTERISTIC /end FUNCTION
/begin FUNCTION Abgastemperaturmodell "Verantwortlich: W. Weuste, H. Gehrke; Umsetzer: F. Perschl" /begin SUB_FUNCTION ATMNN ATMPH BS /end SUB_FUNCTION /end FUNCTION
/begin FUNCTION ATMNN "ATM Neuronales Netz zur Modellierung der Motoraustrittstemperaturen"
 /begin DEF_CHARACTERISTIC GAX_ATMNN KL_ATM_DTSL KL_ATM_DTTMOT KL_ATM_FLA KL_ATM_FSA KL_ATM_FSL KL_ATM_TMOTSA KL_TABGFIL KL_WBIAS KL_WLA KL_WNKW KL_WOUT KL_WRF KL_WVSA KL_WVSE KL_WZW K_ATMNN_ANZ K_ATMNN_EIN K_ATM_FTANS K_ATM_TANSREF K_BSLAMX K_DTNN K_WOUT_BIAS S_ATMNN_N53 S_ATM_BANK S_ATM_INVNN S_ATM_MLPV3 S_ATM_N54 S_FUMU_BSNN S_NKW_MW S_RF_MW S_TABGFIL /end DEF_CHARACTERISTIC
 /begin REF_CHARACTERISTIC K_BSDELT3 K_BSDELT4 S_BS_SONDE /end REF_CHARACTERISTIC
 /begin OUT_MEASUREMENT Dt_bsnn1 Dt_bsnn2 Dt_bsnn3 Dt_bsnn4 La_atm1 La_atm2 La_bs_nn1 La_bs_nn2 La_bs_nn3 La_bs_nn4 Mszyl_int Nkw_atm Rf_atm St_atmnn St_atmnn.B_sa_akt Tabg_filt Tabg_nnarr Tnnsoll1 Tnnsoll2 Tnnsoll3 Tnnsoll4 Zw_mean /end OUT_MEASUREMENT
 /begin IN_MEASUREMENT La_abgas1 La_abgas2 La_ist1 La_ist2 Mszyl Nkw Rf St_sawe St_sawe.B_sa St_sawe.B_sae St_sawe.B_safast St_varkat St_varkat.B_varkat Tabg_natl1 Tabg_natl2 Tabg_r1 Tabg_r5 Tabg_r7 Tabg_r8 Tmot Tnnnoksoll Tnnvksoll Tumg Zw_md /end IN_MEASUREMENT
/end FUNCTION
/begin FUNCTION ATMPH "ATM Physikalische Modellierung des Abgastrakts"
 /begin DEF_CHARACTERISTIC KF_ATM_ATLETA KF_ATM_ETAZW KF_ATM_FAKTH KF_ATM_FAKTS KF_ATM_FTH1 KF_ATM_FTH2 KF_ATM_FTS1 KF_ATM_FTS2 KL_ATMSAEX KL_ATMSAEXIK KL_ATM_ABGR1 KL_ATM_ABGR10 KL_ATM_ABGR11 KL_ATM_ABGR11A KL_ATM_ABGR12 KL_ATM_ABGR12A KL_ATM_ABGR13 KL_ATM_ABGR14 KL_ATM_ABGR14A KL_ATM_ABGR15 KL_ATM_ABGR16 KL_ATM_ABGR5 KL_ATM_ABGR7 KL_ATM_ABGR8 KL_ATM_ABGR9 KL_ATM_ABGRWG KL_ATM_ABST KL_ATM_ABSTNK KL_ATM_ATLKAP KL_ATM_DV KL_ATM_ETAZW KL_ATM_FLAM KL_ATM_FVBANK KL_ATM_FVLK0 KL_ATM_FVLK1 KL_ATM_LA KL_ATM_LAIK KL_ATM_LAIK_S KL_ATM_LA_S KL_ATM_LK_DV KL_ATM_LK_V KL_ATM_RUMG1 KL_ATM_RUMG10 KL_ATM_RUMG11 KL_ATM_RUMG11A KL_ATM_RUMG12 KL_ATM_RUMG12A KL_ATM_RUMG13 KL_ATM_RUMG14 KL_ATM_RUMG14A KL_ATM_RUMG15 KL_ATM_RUMG16 KL_ATM_RUMG5 KL_ATM_RUMG7 KL_ATM_RUMG8 KL_ATM_RUMG9 KL_ATM_RUMGWG1 KL_ATM_RUMGWG2 KL_ATM_WGMS KL_ATM_ZW KL_ATM_ZWIK KL_EXOMS1 KL_EXOMS1_S KL_EXOMS2 KL_EXOMS2_S KL_EXOMSIK1 KL_EXOMSIK1_S KL_EXOMSIK2 KL_EXOMSIK2_S KL_K_EXH_MS KL_K_EXS_MS KL_N_EX_LA KL_N_EX_MS KL_N_T_DECA KL_N_T_DECB KL_N_T_INCA KL_N_T_INCB KL_ZK_EXO KL_ZK_EXOIK KL_ZK_NK KL_ZK_NL1 KL_ZK_NL2 KL_ZK_VK1 KL_ZK_VK2 KL_ZK_VL1 KL_ZK_VL2 K_ATMNOK_RES K_ATM_CPR1 K_ATM_CPR10 K_ATM_CPR11 K_ATM_CPR11A K_ATM_CPR12 K_ATM_CPR12A K_ATM_CPR13 K_ATM_CPR14 K_ATM_CPR14A K_ATM_CPR15 K_ATM_CPR16 K_ATM_CPR2 K_ATM_CPR3 K_ATM_CPR4 K_ATM_CPR5 K_ATM_CPR6 K_ATM_CPR7 K_ATM_CPR7A K_ATM_CPR8 K_ATM_CPR8A K_ATM_CPR9 K_ATM_CPRWG K_ATM_DESUAPP K_ATM_FTANS_R1 K_ATM_FTANS_R10 K_ATM_FTANS_R4 K_ATM_FTANS_R7 K_ATM_FTANS_R8 K_ATM_FTANS_R9 K_ATM_FTANS_TMR K_ATM_FTMOT K_ATM_LKLPS K_ATM_RESET K_ATM_SAIK_S K_ATM_SA_S K_ATM_TABGMX K_ATM_TMOT K_ATM_UEB_CON K_ATM_UEB_LA K_ATM_UEB_LA2 K_ATM_UEB_MA K_ATM_UEB_MS K_ATM_UEB_T K_ATM_UEB_V K_DELAY_SA K_DELAY_SAV K_FEXODESU K_NOK_AN K_N_NOEXO K_SATLIM K_SATLIM_NK K_TABGEX K_TIKATOE K_TKATOE K_TRNOK_ST K_TR_ST K_ZK_TIKST S_ATMPH_SENS S_ATMPH_SENS1 S_ATMPH_SENS2 S_ATM_MSTURB S_ATM_NOX S_ATM_TPVK S_ETAZWIST_MW S_MSTURB_MW S_MSZYL_MW S_TSENSTURB /end DEF_CHARACTERISTIC
 /begin REF_CHARACTERISTIC S_ATM_BANK /end REF_CHARACTERISTIC
 /begin OUT_MEASUREMENT Dt_exo1 Dt_exo2 Dtabg_exo1 Dtabg_exo2 Dtexms Dtexmsik Dtwr1 Dtwr10 Dtwr11 Dtwr11a Dtwr12 Dtwr12a Dtwr13 Dtwr14 Dtwr14a Dtwr15 Dtwr16 Dtwr2 Dtwr3 Dtwr4 Dtwr5 Dtwr6 Dtwr7 Dtwr7a Dtwr8 Dtwr8a Dtwr9 Dtwr_wg1 Dtwr_wg2 Eta_zw_ist1_atm Eta_zw_ist2_atm Exonok1 Exonok2 Fatmtmot Msturb_atm Mszyl_atm Mszyl_bank Mszyl_ges_atm Mszyl_nagr Mszyl_rohr Nok_ta_1 Nok_ta_2 Nok_tb_1 Nok_tb_2 St_atmphintern St_atmphintern.B_atmphreset St_atmphintern.B_er_lklps St_atmphintern.B_lklps_atm St_atmphintern.B_motoraus St_edge_rising St_edge_rising.B_ef_sa St_edge_rising.B_er_atm_reset St_edge_rising.B_er_sa St_edge_rising.B_er_startende St_edge_rising.B_sa_atmph St_sa_atmph St_sa_atmph.B_vb_sa St_sa_atmph.B_vb_sa_nk T_ikat1 T_ikat1_stat T_ikat2 T_ikat2_stat Tabg_agr Tabg_anok1 Tabg_anok2 Tabg_atf1 Tabg_atf2 Tabg_bank1 Tabg_bank2 Tabg_demax1 Tabg_demax2 Tabg_demaxav Tabg_desul Tabg_desul1 Tabg_desul2 Tabg_fth Tabg_ikat_av Tabg_inok1 Tabg_inok2 Tabg_izus Tabg_m1 Tabg_m2 Tabg_natl1 Tabg_natl1_fil Tabg_natl2 Tabg_natl2_fil Tabg_nk1 Tabg_nk2 Tabg_nk3 Tabg_nk3st Tabg_nk_av Tabg_nkab Tabg_nks1 Tabg_nks2 Tabg_nkst Tabg_nnarrh Tabg_nnok1 Tabg_nnok2 Tabg_nok_av Tabg_nok_av1 Tabg_nok_av2 Tabg_nokab1 Tabg_nokab2 Tabg_nokmax Tabg_nokmax1 Tabg_nokmax2 Tabg_nokmin Tabg_nokmin1 Tabg_nokmin2 Tabg_nokst1 Tabg_nokst2 Tabg_nzus Tabg_r1 Tabg_r10 Tabg_r11 Tabg_r12 Tabg_r13 Tabg_r14 Tabg_r15 Tabg_r16 Tabg_r2 Tabg_r3 Tabg_r4 Tabg_r5 Tabg_r6 Tabg_r7 Tabg_r7a Tabg_r8 Tabg_r8a Tabg_r9 Tabg_sens_mdl1 Tabg_sens_mdl2 Tabg_turb1 Tabg_turb2 Tabg_vk1 Tabg_vk1ab Tabg_vk1st Tabg_vk2 Tabg_vk_av Tabg_vl1 Tabg_vl1ab Tabg_vl1st Tabg_vl2 Tabg_vnok1 Tabg_vnok2 Tabg_wg1 Tabg_wg2 Tans_ini Tmr_r1 Tmr_r10 Tmr_r11 Tmr_r4 Tmr_r7 Tmr_r8 Tmr_r9 Tw_m1 Tw_m1ab Tw_m1st Tw_m2 Tw_m2ab Tw_m2st Tw_nk1 Tw_nk1ab Tw_nk1st Tw_nk2 Tw_nk2ab Tw_nk2st Tw_r1 Tw_r11 Tw_r11a Tw_r12 Tw_r12a Tw_r13 Tw_r14 Tw_r14a Tw_r15 Tw_r16 Tw_r1ab Tw_r1st Tw_r2 Tw_r3 Tw_r4 Tw_r4ab Tw_r4st Tw_r5 Tw_r6 Tw_r7a Tw_r8a Tw_wg1 Tw_wg2 V_atm_b1 V_atm_b2 Zkatm_exo Zkatm_exoik /end OUT_MEASUREMENT
 /begin IN_MEASUREMENT Eta_zw_ist1 Eta_zw_ist2 La_atm1 La_atm2 La_ist1 La_ist2 Msturb Msturbine Mswg Mszyl Nkw Nkw_atm Pak Pkat Rf Rf_atm Rk_soll St_atmnn St_atmnn.B_sa_akt St_pwf St_pwf.B_pwf St_sawe St_sawe.B_sa St_sawe.B_sae St_sawe.B_safast St_start St_start.B_jumpstart St_start.B_sta St_start.B_start St_start.B_startende St_start.B_wst St_testbs St_testbs.B_FI_ABGAS_TSENS St_testbs.B_FI_HFM St_testbs.B_FI_HFMPL St_testbs.B_FI_PUS St_testbs.B_FI_TANS St_testbs.B_FI_TKA St_testbs.B_FI_TMOT St_testbs.B_FI_VFZ Tabg_nnarr Tans Tmot Tumg V /end IN_MEASUREMENT
/end FUNCTION
/begin FUNCTION BS "ATM Bauteilschutz"
 /begin DEF_CHARACTERISTIC CW_ATMOD KF_BS_MX KF_BS_VST KF_BS_VST_MAGER KF_BS_VST_N54 KF_TA_NOKSOLL KF_TA_VKSOLL KL_BS_I_NOK KL_BS_KATALT KL_BS_KKK_AUF KL_BS_KKK_BS KL_BS_KKK_LUEFT KL_BS_KKK_ZU KL_BS_LAMAUSWAHL KL_BS_P_NOK KL_BS_ZKNN KL_DTA_IKAT K_BSDELT1 K_BSDELT2 K_BSDELT3 K_BSDELT4 K_BSDELT5 K_BSDELT6 K_BSDELT7 K_BSDELT8 K_BSDELT_DESU K_BS_D K_BS_D_NOK K_BS_I K_BS_IMN K_BS_IMX K_BS_MN K_BS_P K_BS_REGMN K_BS_REGMX K_BS_ZKININN K_LABSOFF K_LA_BSPASS_FETT K_LA_BSPASS_MAGER K_TA_VKSOLL_ATF K_TA_VKSOLL_DELT K_TA_VKSOLL_DELT2 K_TBS2 S_BSATL S_BSINOK S_BSMAGER S_BSMAGEROFF S_BS_SONDE /end DEF_CHARACTERISTIC
 /begin REF_CHARACTERISTIC K_TMOTMAX_ZSK S_ATM_INVNN S_ATM_MLPV3 /end REF_CHARACTERISTIC
 /begin OUT_MEASUREMENT Dlam_bs1 Dlam_bs2 Dlam_bs_n54 Dlam_bs_nok1 Dlam_bs_nok2 Dt_bsinok Dt_bsivk Dta_bs1 Dta_bs2 Dta_bs_nok1 Dta_bs_nok2 F_bs_i_nok F_bs_p_nok La_bs1 La_bs2 La_bs_nn1_ini La_bs_nn2_ini La_bs_nn3_ini La_bs_nn4_ini La_bs_soll1 La_bs_soll2 La_bs_soll3 La_bs_soll4 La_vst1 La_vst2 La_vst3 La_vst4 Nelueft_nox St_reg_bs1 St_reg_bs2 St_reg_bs3 St_reg_bs4 St_testbs St_testbs.B_FI_ABGAS_TSENS St_testbs.B_FI_HFM St_testbs.B_FI_HFMPL St_testbs.B_FI_PUS St_testbs.B_FI_TANS St_testbs.B_FI_TKA St_testbs.B_FI_TMOT St_testbs.B_FI_VFZ St_zwbts1 St_zwbts1.B_bs1 St_zwbts1.B_bs2 St_zwbts1.B_bsmager St_zwbts1.B_lklpsaga St_zwbts1.B_lklpsbs St_zwbts1.B_lklpsmager St_zwbtsakt St_zwbtsakt.B_bsakt1 St_zwbtsakt.B_bsakt2 St_zwbtsakt.B_bsakt3 St_zwbtsakt.B_bsakt4 Tabg_aktdeakt_nokatl1 Tabg_aktdeakt_nokatl2 Tabg_aktdeakt_vk1 Tabg_aktdeakt_vk2 Tbsaus1 Tbsaus2 Tbsaus3 Tbsaus4 Tbsein1 Tbsein2 Tbsein3 Tbsein4 Tnnnoksoll Tnnvksoll Tnoksoll1 Tnoksoll2 Tvksoll1 Tvksoll2 /end OUT_MEASUREMENT
 /begin IN_MEASUREMENT Ba_subist Dzw_krann Dzw_mm Dzwt La_bas1 La_bas2 La_bs_nn1 La_bs_nn2 La_bs_nn3 La_bs_nn4 Lam_auswahl1 Mszyl Nkw Rf St_cybl St_cybl.B_gl_ad St_cybl.B_gl_adder St_cybl.B_gl_adz St_cybl.B_gl_faker St_cybl.B_gl_hz St_cybl.B_gl_wg1 St_cybl.B_gl_wg2 St_cybl.B_gl_zsk St_cybl.B_gl_zsw St_cybl.B_gl_zswz St_gglsu2 St_gglsu2.B_sbblsu St_gglsu2.B_sbblsu2 St_kr St_kr.B_clradkr St_kr.B_krdws St_kr.B_krndy St_kr.B_zwkraa St_lamko St_lamko.B_bswl St_lamko.B_lainst_neg St_lamko.B_lainst_pos St_lamko.B_laprio_ko St_sawe St_sawe.B_sa St_sawe.B_sae St_sawe.B_safast St_varkat St_varkat.B_varkat St_zwbts1.B_bs1 St_zwbts1.B_bs2 St_zwbts1.B_bsmager St_zwbts1.B_lklpsaga St_zwbts1.B_lklpsbs St_zwbts1.B_lklpsmager T_ikat1 T_ikat2 Tabg_bank1 Tabg_bank2 Tabg_inok1 Tabg_inok2 Tabg_natl1 Tabg_natl1_fil Tabg_natl2 Tabg_natl2_fil Tabg_r7 Tabg_r8 Tabg_vk1 Tabg_vk2 Tabg_vl1 Tabg_vl2 Tabg_vnok1 Tabg_vnok2 Tmot /end IN_MEASUREMENT
/end FUNCTION
/begin FUNCTION atl_30_30_ ""
 /begin SUB_FUNCTION ATLAD ATLDIAG ATLGLS ATLOB ATLOUT ATLPUMP ATLREG ATLSTAT ULVOUT ULVREG /end SUB_FUNCTION
/end FUNCTION
/begin FUNCTION ATLAD ""
 /begin DEF_CHARACTERISTIC K_ATLAD_MN K_ATLAD_MX K_FATLRI_OFS K_FPLDSAD_MN K_FPLDSAD_MX K_IKATLAD K_NKWAD_MN K_NKWAD_MX K_PLDDIFFAD K_PLDSDAD_MN K_PLDSDAD_MX K_TANSATLAD K_TMOTATLAD /end DEF_CHARACTERISTIC
 /begin OUT_MEASUREMENT Bb_beratlad_i F_atlad F_atlad_i F_atlrivst_i St_atlad St_atlad.B_atlad St_atlad.B_beratlad /end OUT_MEASUREMENT
 /begin IN_MEASUREMENT Atlri_i Atlvst B_atlri_init_i F_pldsvld_f Pld_diff_fil_i Pldrsoll_dyn St_atlaus St_atlaus.B_atl_rfmaxred St_atlaus.B_atladp_off St_atlaus.B_atldiag_off St_atlaus.B_atlreg_off St_atldiag_10ms St_atldiag_10ms.B_atl_err St_atldiag_10ms.B_atllekfast St_atldiag_10ms.B_atlr_errmn St_atldiag_10ms.B_atlr_errmx St_atldiag_10ms.B_beratllek /end IN_MEASUREMENT
/end FUNCTION
/begin FUNCTION ATLDIAG ""
 /begin DEF_CHARACTERISTIC CW_ATLADP_OFF CW_ATLDIAG_OFF CW_ATLREG_OFF CW_RFMAXRED KL_ATLRPID_MN KL_ATLRPID_MX KL_PLDLEK_MN KL_PLDLEK_MX KL_TDATL_ERR K_ATLERR_UBMIN K_MSVLDLEKF K_NKWLEK_MN K_NKWLEK_MX K_PLDDIFLEKF K_PLDLEKF K_PLDSLEKF K_TDATLLEKF K_TDATLR_ON K_TDWG_NGL S_ATL_FSP /end DEF_CHARACTERISTIC
 /begin REF_CHARACTERISTIC CW_TVLD /end REF_CHARACTERISTIC
 /begin OUT_MEASUREMENT St_atlaus St_atlaus.B_atl_rfmaxred St_atlaus.B_atladp_off St_atlaus.B_atldiag_off St_atlaus.B_atlreg_off St_atldiag_10ms St_atldiag_10ms.B_atl_err St_atldiag_10ms.B_atllekfast St_atldiag_10ms.B_atlr_errmn St_atldiag_10ms.B_atlr_errmx St_atldiag_10ms.B_beratllek St_atldiag_conf St_atldiag_ext St_atldiag_extfi St_atldiag_tmp St_atldiag_tmp.B_fi_atllekfast St_atldiag_tmp.B_fi_pldmn St_atldiag_tmp.B_fi_pldmx /end OUT_MEASUREMENT
 /begin IN_MEASUREMENT Atlr Atlvst F_pldsvld_f Msvld_dyn Nkw Pld_diff Pldrsoll_dyn Pvdkds_dyn St_atlgls St_atlgls.B_atlgls_pl St_atlgls.B_fi_atlgls St_atlgls.B_wg1plmn St_atlgls.B_wg1plmn2 St_atlgls.B_wg1plmx St_atlgls.B_wg1plmx2 St_atlout St_atlout.B_wg1_auf St_atlout.B_wg2_auf St_atlstat St_atlstat.B_atl_bereit St_atlstat.B_atldyn St_atlstat.B_atlr St_atlstat.B_tvld_mod St_atlstat.B_ulvdyn St_atlstat.B_vlschalt St_drdiag_nv St_drdiag_nv.B_psabs_npl St_drdiag_nv.B_pu_npl St_drdiag_nv.B_pvdkds_npl St_eavnskt St_eavnskt.B_vsa2_err St_eavnskt.B_vsa_err St_eavnskt.B_vse2_err St_eavnskt.B_vse_err Zyl_misfire_diag /end IN_MEASUREMENT
/end FUNCTION
/begin FUNCTION ATLGLS ""
 /begin DEF_CHARACTERISTIC KF_WG1KOR KF_WG1_ZU2 KL_FKWG1KOR KL_IKWG1K K_FKWG1DIAG K_TDWG1PLMN K_TDWG1PLMX K_WG1DIAGMN K_WG1DIAGMN2 K_WG1DIAGMX K_WG1DIAGMX2 K_WG1KMN K_WG1KMX K_WG1KOR K_WG2KOR S_ATLGLS_PI S_GLS2_MAN S_GLS_MAN /end DEF_CHARACTERISTIC
 /begin OUT_MEASUREMENT F_msvld_diff F_wg1diag F_wg1k_ad F_wg1k_fast F_wg1kor F_wg2kor St_atlgls St_atlgls.B_atlgls_pl St_atlgls.B_fi_atlgls St_atlgls.B_wg1plmn St_atlgls.B_wg1plmn2 St_atlgls.B_wg1plmx St_atlgls.B_wg1plmx2 /end OUT_MEASUREMENT
 /begin IN_MEASUREMENT F_pldsvld_f Mssolatl_k Msvld Pldrsoll_dyn St_atlad St_atlad.B_atlad St_atlad.B_beratlad St_atlout St_atlout.B_wg1_auf St_atlout.B_wg2_auf St_atlstat St_atlstat.B_atl_bereit St_atlstat.B_atldyn St_atlstat.B_atlr St_atlstat.B_tvld_mod St_atlstat.B_ulvdyn St_atlstat.B_vlschalt St_pwf St_pwf.B_pwf /end IN_MEASUREMENT
/end FUNCTION
/begin FUNCTION ATLOB ""
 /begin DEF_CHARACTERISTIC KF_DRFMXW_OB KL_TDOBAKTIV KL_TDOBEND KL_TDOBSPERR KL_TDRFMXOB K_PLDDGRD_OB K_PLDDIFFGRD_OB K_PLDDIFF_OB K_PLDD_OB K_PLD_AUS K_PLD_OBEND /end DEF_CHARACTERISTIC
 /begin OUT_MEASUREMENT Drfmx_ob Drfmxw_ob St_atlob St_atlob.B_atlob St_atlob.B_atlob_sp St_atlob_intern St_atlob_intern.B_atlob_akt St_atlob_intern.B_atlob_end /end OUT_MEASUREMENT
 /begin IN_MEASUREMENT Nkw Pld_diff Pld_diff_grd St_atldiag_10ms St_atldiag_10ms.B_atl_err St_atldiag_10ms.B_atllekfast St_atldiag_10ms.B_atlr_errmn St_atldiag_10ms.B_atlr_errmx St_atldiag_10ms.B_beratllek St_atlstat St_atlstat.B_atl_bereit St_atlstat.B_atldyn St_atlstat.B_atlr St_atlstat.B_tvld_mod St_atlstat.B_ulvdyn St_atlstat.B_vlschalt St_start St_start.B_jumpstart St_start.B_sta St_start.B_start St_start.B_startende St_start.B_wst /end IN_MEASUREMENT
/end FUNCTION
/begin FUNCTION ATLOUT ""
 /begin DEF_CHARACTERISTIC KF_FWGZUEKOR KL_TVWGKORT KL_TVWGKORUB KL_TVWG_DN KL_TVWG_UP K_TVWG K_TVWG2 K_TVWGMIN K_TVWG_GLAKT K_TVWG_MN K_TVWG_MX K_ZK_WGTVTZ S_TVWG2_INV S_TVWG2_MAN S_TVWG_INV S_TVWG_MAN S_WGTK_TMOTR /end DEF_CHARACTERISTIC
 /begin REF_CHARACTERISTIC CW_GLAKTIV /end REF_CHARACTERISTIC
 /begin OUT_MEASUREMENT Atlr1_k Atlr2_k Atlr_zwkor St_atlout St_atlout.B_wg1_auf St_atlout.B_wg2_auf Tmot_wgtz Tvwg Tvwg1_k Tvwg2 Tvwg2_k Tvwgkort /end OUT_MEASUREMENT
 /begin IN_MEASUREMENT Atlr_i F_wg1kor F_wg2kor Mszyl St_atlstat St_atlstat.B_atl_bereit St_atlstat.B_atldyn St_atlstat.B_atlr St_atlstat.B_tvld_mod St_atlstat.B_ulvdyn St_atlstat.B_vlschalt Tmot Tmotraum Ub Zw_mw1 Zw_mw2 Zwstat_vt /end IN_MEASUREMENT
/end FUNCTION
/begin FUNCTION ATLPUMP ""
 /begin DEF_CHARACTERISTIC KL_PLDPUMPMN K_MSVLDPMPMN K_MSVLDPMPMX K_NKWPUMP_MN K_NKWPUMP_MX K_PLDDPUMP K_PLDSDPMPMN /end DEF_CHARACTERISTIC
 /begin REF_CHARACTERISTIC S_HFM_VG2 /end REF_CHARACTERISTIC
 /begin OUT_MEASUREMENT St_atlpump St_atlpump.B_atlpump1 St_atlpump.B_atlpump2 St_atlpump.B_beratlpump /end OUT_MEASUREMENT
 /begin IN_MEASUREMENT F_pldpu Msvld_dyn Nkw Pldrsoll_dyn Pvdkds_dyn /end IN_MEASUREMENT
/end FUNCTION
/end MODULE
/end PROJECT
